ASAP2_VERSION 1 31
/begin PROJECT ProjectName "Project Comment Goes Here"
/begin HEADER "Header Comments go here" /end HEADER
/begin MODULE ModuleName "Module Comment Goes Here"
/begin MOD_COMMON "Mod Common Comment Here" BYTE_ORDER MSB_LAST /end MOD_COMMON
/begin RECORD_LAYOUT Scalar_BOOLEAN FNC_VALUES 1 UBYTE COLUMN_DIR DIRECT /end RECORD_LAYOUT
/begin RECORD_LAYOUT Scalar_UBYTE FNC_VALUES 1 UBYTE COLUMN_DIR DIRECT /end RECORD_LAYOUT
/begin RECORD_LAYOUT Scalar_BYTE FNC_VALUES 1 SBYTE COLUMN_DIR DIRECT /end RECORD_LAYOUT
/begin RECORD_LAYOUT Scalar_UWORD FNC_VALUES 1 UWORD COLUMN_DIR DIRECT /end RECORD_LAYOUT
/begin RECORD_LAYOUT Scalar_SWORD FNC_VALUES 1 SWORD COLUMN_DIR DIRECT /end RECORD_LAYOUT
/begin RECORD_LAYOUT Scalar_FLOAT32_IEEE FNC_VALUES 1 FLOAT32_IEEE COLUMN_DIR DIRECT /end RECORD_LAYOUT
/begin RECORD_LAYOUT Lookup1D_BOOLEAN FNC_VALUES 1 UBYTE COLUMN_DIR DIRECT /end RECORD_LAYOUT
/begin RECORD_LAYOUT Lookup1D_X_BOOLEAN AXIS_PTS_X 1 UBYTE INDEX_INCR DIRECT /end RECORD_LAYOUT
/begin CHARACTERISTIC KINP_Pedal1Ref5V_V_ovrdval "" VALUE 0x0000 /* @ECU_Address@KINP_Pedal1Ref5V_V_ovrdval@ */ Scalar_FLOAT32_IEEE 0 SWC_INP_type_CM_single_V 0.0 10.0 /end CHARACTERISTIC
/begin CHARACTERISTIC KINP_Pedal2Ref5V_V_ovrdval "" VALUE 0x0000 /* @ECU_Address@KINP_Pedal2Ref5V_V_ovrdval@ */ Scalar_FLOAT32_IEEE 0 SWC_INP_type_CM_single_V 0.0 10.0 /end CHARACTERISTIC
/begin CHARACTERISTIC KINP_PowerOffTSet_cnt_ovrdval "" VALUE 0x0000 /* @ECU_Address@KINP_PowerOffTSet_cnt_ovrdval@ */ Scalar_FLOAT32_IEEE 0 SWC_INP_type_CM_single_cnt 1.0 128.0 /end CHARACTERISTIC
/begin CHARACTERISTIC KINP_RemoteACTemp_C_ovrdval "" VALUE 0x0000 /* @ECU_Address@KINP_RemoteACTemp_C_ovrdval@ */ Scalar_FLOAT32_IEEE 0 SWC_INP_type_CM_single_C 17.0 48.5 /end CHARACTERISTIC
/begin CHARACTERISTIC KINP_MemOffsetAccX_raw16_ovrdval "" VALUE 0x0000 /* @ECU_Address@KINP_MemOffsetAccX_raw16_ovrdval@ */ Scalar_SWORD 0 SWC_INP_type_CM_int16_raw16 -32768.0 32767.0 /end CHARACTERISTIC
/begin CHARACTERISTIC KINP_MemOffsetAccY_raw16_ovrdval "" VALUE 0x0000 /* @ECU_Address@KINP_MemOffsetAccY_raw16_ovrdval@ */ Scalar_SWORD 0 SWC_INP_type_CM_int16_raw16 -32768.0 32767.0 /end CHARACTERISTIC
/begin CHARACTERISTIC KINP_MemOffsetAccZ_raw16_ovrdval "" VALUE 0x0000 /* @ECU_Address@KINP_MemOffsetAccZ_raw16_ovrdval@ */ Scalar_SWORD 0 SWC_INP_type_CM_int16_raw16 -32768.0 32767.0 /end CHARACTERISTIC
/begin CHARACTERISTIC KINP_MemOffsetGyroX_raw16_ovrdval "" VALUE 0x0000 /* @ECU_Address@KINP_MemOffsetGyroX_raw16_ovrdval@ */ Scalar_SWORD 0 SWC_INP_type_CM_int16_raw16 -32768.0 32767.0 /end CHARACTERISTIC
/begin CHARACTERISTIC KINP_MemOffsetGyroY_raw16_ovrdval "" VALUE 0x0000 /* @ECU_Address@KINP_MemOffsetGyroY_raw16_ovrdval@ */ Scalar_SWORD 0 SWC_INP_type_CM_int16_raw16 -32768.0 32767.0 /end CHARACTERISTIC
/begin CHARACTERISTIC KINP_MemOffsetGyroZ_raw16_ovrdval "" VALUE 0x0000 /* @ECU_Address@KINP_MemOffsetGyroZ_raw16_ovrdval@ */ Scalar_SWORD 0 SWC_INP_type_CM_int16_raw16 -32768.0 32767.0 /end CHARACTERISTIC
/begin CHARACTERISTIC KINP_SensingAccX_raw16_ovrdval "" VALUE 0x0000 /* @ECU_Address@KINP_SensingAccX_raw16_ovrdval@ */ Scalar_SWORD 0 SWC_INP_type_CM_int16_raw16 -32768.0 32767.0 /end CHARACTERISTIC
/begin CHARACTERISTIC KINP_SensingAccY_raw16_ovrdval "" VALUE 0x0000 /* @ECU_Address@KINP_SensingAccY_raw16_ovrdval@ */ Scalar_SWORD 0 SWC_INP_type_CM_int16_raw16 -32768.0 32767.0 /end CHARACTERISTIC
/begin CHARACTERISTIC KINP_SensingAccZ_raw16_ovrdval "" VALUE 0x0000 /* @ECU_Address@KINP_SensingAccZ_raw16_ovrdval@ */ Scalar_SWORD 0 SWC_INP_type_CM_int16_raw16 -32768.0 32767.0 /end CHARACTERISTIC
/begin CHARACTERISTIC KINP_SensingGyroX_raw16_ovrdval "" VALUE 0x0000 /* @ECU_Address@KINP_SensingGyroX_raw16_ovrdval@ */ Scalar_SWORD 0 SWC_INP_type_CM_int16_raw16 -32768.0 32767.0 /end CHARACTERISTIC
/begin CHARACTERISTIC KINP_SensingGyroY_raw16_ovrdval "" VALUE 0x0000 /* @ECU_Address@KINP_SensingGyroY_raw16_ovrdval@ */ Scalar_SWORD 0 SWC_INP_type_CM_int16_raw16 -32768.0 32767.0 /end CHARACTERISTIC
/begin CHARACTERISTIC KINP_SensingGyroZ_raw16_ovrdval "" VALUE 0x0000 /* @ECU_Address@KINP_SensingGyroZ_raw16_ovrdval@ */ Scalar_SWORD 0 SWC_INP_type_CM_int16_raw16 -32768.0 32767.0 /end CHARACTERISTIC
/begin CHARACTERISTIC KINP_UWBpositionX_cm_ovrdval "" VALUE 0x0000 /* @ECU_Address@KINP_UWBpositionX_cm_ovrdval@ */ Scalar_SWORD 0 SWC_INP_type_CM_int16_cm -32728.0 32767.0 /end CHARACTERISTIC
/begin CHARACTERISTIC KINP_UWBpositionY_cm_ovrdval "" VALUE 0x0000 /* @ECU_Address@KINP_UWBpositionY_cm_ovrdval@ */ Scalar_SWORD 0 SWC_INP_type_CM_int16_cm -32728.0 32767.0 /end CHARACTERISTIC
/begin CHARACTERISTIC KINP_AuxBattVolmV_mV_ovrdval "" VALUE 0x0000 /* @ECU_Address@KINP_AuxBattVolmV_mV_ovrdval@ */ Scalar_UWORD 0 SWC_INP_type_CM_uint16_mV 0.0 65535.0 /end CHARACTERISTIC
/begin CHARACTERISTIC KINP_KeyFobAreaU16_enum_ovrdval "" VALUE 0x0000 /* @ECU_Address@KINP_KeyFobAreaU16_enum_ovrdval@ */ Scalar_UWORD 0 SWC_INP_type_CM_uint16_enum 0.0 65535.0 /end CHARACTERISTIC
/begin CHARACTERISTIC KINP_ReDoorLock_enum_ovrdval "" VALUE 0x0000 /* @ECU_Address@KINP_ReDoorLock_enum_ovrdval@ */ Scalar_UWORD 0 SWC_INP_type_CM_uint16_enum 0.0 65535.0 /end CHARACTERISTIC
/begin CHARACTERISTIC KINP_UIDBatVoltx1000_V_ovrdval "" VALUE 0x0000 /* @ECU_Address@KINP_UIDBatVoltx1000_V_ovrdval@ */ Scalar_UWORD 0 SWC_INP_type_CM_uint16_V 0.0 65535.0 /end CHARACTERISTIC
/begin CHARACTERISTIC KINP_UWB1Distance_cm_ovrdval "" VALUE 0x0000 /* @ECU_Address@KINP_UWB1Distance_cm_ovrdval@ */ Scalar_UWORD 0 SWC_INP_type_CM_uint16_cm 0.0 65535.0 /end CHARACTERISTIC
/begin CHARACTERISTIC KINP_UWB2Distance_cm_ovrdval "" VALUE 0x0000 /* @ECU_Address@KINP_UWB2Distance_cm_ovrdval@ */ Scalar_UWORD 0 SWC_INP_type_CM_uint16_cm 0.0 65535.0 /end CHARACTERISTIC
/begin CHARACTERISTIC KINP_UWB3Distance_cm_ovrdval "" VALUE 0x0000 /* @ECU_Address@KINP_UWB3Distance_cm_ovrdval@ */ Scalar_UWORD 0 SWC_INP_type_CM_uint16_cm 0.0 65535.0 /end CHARACTERISTIC
/begin CHARACTERISTIC KINP_UWB4Distance_cm_ovrdval "" VALUE 0x0000 /* @ECU_Address@KINP_UWB4Distance_cm_ovrdval@ */ Scalar_UWORD 0 SWC_INP_type_CM_uint16_cm 0.0 65535.0 /end CHARACTERISTIC
/begin CHARACTERISTIC KINP_UWB5Distance_cm_ovrdval "" VALUE 0x0000 /* @ECU_Address@KINP_UWB5Distance_cm_ovrdval@ */ Scalar_UWORD 0 SWC_INP_type_CM_uint16_cm 0.0 65535.0 /end CHARACTERISTIC
/begin CHARACTERISTIC KINP_AuxBattVolmV_mV_ovrdflg "" VALUE 0x0000 /* @ECU_Address@KINP_AuxBattVolmV_mV_ovrdflg@ */ Scalar_BOOLEAN 0 SWC_INP_type_CM_boolean_flg 0.0 1.0 /end CHARACTERISTIC
/begin CHARACTERISTIC KINP_BTConnectSta_enum_ovrdflg "" VALUE 0x0000 /* @ECU_Address@KINP_BTConnectSta_enum_ovrdflg@ */ Scalar_BOOLEAN 0 SWC_INP_type_CM_boolean_flg 0.0 1.0 /end CHARACTERISTIC
/begin CHARACTERISTIC KINP_CAN3BusOff_flg_ovrdflg "" VALUE 0x0000 /* @ECU_Address@KINP_CAN3BusOff_flg_ovrdflg@ */ Scalar_BOOLEAN 0 SWC_INP_type_CM_boolean_flg 0.0 1.0 /end CHARACTERISTIC
/begin CHARACTERISTIC KINP_CAN3BusOff_flg_ovrdval "" VALUE 0x0000 /* @ECU_Address@KINP_CAN3BusOff_flg_ovrdval@ */ Scalar_BOOLEAN 0 SWC_INP_type_CM_boolean_flg 0.0 1.0 /end CHARACTERISTIC
/begin CHARACTERISTIC KINP_CAN4BusOff_flg_ovrdflg "" VALUE 0x0000 /* @ECU_Address@KINP_CAN4BusOff_flg_ovrdflg@ */ Scalar_BOOLEAN 0 SWC_INP_type_CM_boolean_flg 0.0 1.0 /end CHARACTERISTIC
/begin CHARACTERISTIC KINP_CAN4BusOff_flg_ovrdval "" VALUE 0x0000 /* @ECU_Address@KINP_CAN4BusOff_flg_ovrdval@ */ Scalar_BOOLEAN 0 SWC_INP_type_CM_boolean_flg 0.0 1.0 /end CHARACTERISTIC
/begin CHARACTERISTIC KINP_CAN5BusOff_flg_ovrdflg "" VALUE 0x0000 /* @ECU_Address@KINP_CAN5BusOff_flg_ovrdflg@ */ Scalar_BOOLEAN 0 SWC_INP_type_CM_boolean_flg 0.0 1.0 /end CHARACTERISTIC
/begin CHARACTERISTIC KINP_CAN5BusOff_flg_ovrdval "" VALUE 0x0000 /* @ECU_Address@KINP_CAN5BusOff_flg_ovrdval@ */ Scalar_BOOLEAN 0 SWC_INP_type_CM_boolean_flg 0.0 1.0 /end CHARACTERISTIC
/begin CHARACTERISTIC KINP_CAN6BusOff_flg_ovrdflg "" VALUE 0x0000 /* @ECU_Address@KINP_CAN6BusOff_flg_ovrdflg@ */ Scalar_BOOLEAN 0 SWC_INP_type_CM_boolean_flg 0.0 1.0 /end CHARACTERISTIC
/begin CHARACTERISTIC KINP_CAN6BusOff_flg_ovrdval "" VALUE 0x0000 /* @ECU_Address@KINP_CAN6BusOff_flg_ovrdval@ */ Scalar_BOOLEAN 0 SWC_INP_type_CM_boolean_flg 0.0 1.0 /end CHARACTERISTIC
/begin CHARACTERISTIC KINP_CbnPreACEnaReq_enum_ovrdflg "" VALUE 0x0000 /* @ECU_Address@KINP_CbnPreACEnaReq_enum_ovrdflg@ */ Scalar_BOOLEAN 0 SWC_INP_type_CM_boolean_flg 0.0 1.0 /end CHARACTERISTIC
/begin CHARACTERISTIC KINP_ClearDTCcmd_flg_ovrdflg "" VALUE 0x0000 /* @ECU_Address@KINP_ClearDTCcmd_flg_ovrdflg@ */ Scalar_BOOLEAN 0 SWC_INP_type_CM_boolean_flg 0.0 1.0 /end CHARACTERISTIC
/begin CHARACTERISTIC KINP_ClearDTCcmd_flg_ovrdval "" VALUE 0x0000 /* @ECU_Address@KINP_ClearDTCcmd_flg_ovrdval@ */ Scalar_BOOLEAN 0 SWC_INP_type_CM_boolean_flg 0.0 1.0 /end CHARACTERISTIC
/begin CHARACTERISTIC KINP_ClearZevDTCcmd_flg_ovrdflg "" VALUE 0x0000 /* @ECU_Address@KINP_ClearZevDTCcmd_flg_ovrdflg@ */ Scalar_BOOLEAN 0 SWC_INP_type_CM_boolean_flg 0.0 1.0 /end CHARACTERISTIC
/begin CHARACTERISTIC KINP_ClearZevDTCcmd_flg_ovrdval "" VALUE 0x0000 /* @ECU_Address@KINP_ClearZevDTCcmd_flg_ovrdval@ */ Scalar_BOOLEAN 0 SWC_INP_type_CM_boolean_flg 0.0 1.0 /end CHARACTERISTIC
/begin CHARACTERISTIC KINP_DKCBTRSSI_dB_ovrdflg "" VALUE 0x0000 /* @ECU_Address@KINP_DKCBTRSSI_dB_ovrdflg@ */ Scalar_BOOLEAN 0 SWC_INP_type_CM_boolean_flg 0.0 1.0 /end CHARACTERISTIC
/begin CHARACTERISTIC KINP_FDCConnDrvWdwCtrlCmd_pct_ovrdflg "" VALUE 0x0000 /* @ECU_Address@KINP_FDCConnDrvWdwCtrlCmd_pct_ovrdflg@ */ Scalar_BOOLEAN 0 SWC_INP_type_CM_boolean_flg 0.0 1.0 /end CHARACTERISTIC
/begin CHARACTERISTIC KINP_FDCConnPasWdwCtrlCmd_pct_ovrdflg "" VALUE 0x0000 /* @ECU_Address@KINP_FDCConnPasWdwCtrlCmd_pct_ovrdflg@ */ Scalar_BOOLEAN 0 SWC_INP_type_CM_boolean_flg 0.0 1.0 /end CHARACTERISTIC
/begin CHARACTERISTIC KINP_FDCConnRLDWdwCtrlCmd_pct_ovrdflg "" VALUE 0x0000 /* @ECU_Address@KINP_FDCConnRLDWdwCtrlCmd_pct_ovrdflg@ */ Scalar_BOOLEAN 0 SWC_INP_type_CM_boolean_flg 0.0 1.0 /end CHARACTERISTIC
/begin CHARACTERISTIC KINP_FDCConnRRDWdwCtrlCmd_pct_ovrdflg "" VALUE 0x0000 /* @ECU_Address@KINP_FDCConnRRDWdwCtrlCmd_pct_ovrdflg@ */ Scalar_BOOLEAN 0 SWC_INP_type_CM_boolean_flg 0.0 1.0 /end CHARACTERISTIC
/begin CHARACTERISTIC KINP_KeyFobAreaU16_enum_ovrdflg "" VALUE 0x0000 /* @ECU_Address@KINP_KeyFobAreaU16_enum_ovrdflg@ */ Scalar_BOOLEAN 0 SWC_INP_type_CM_boolean_flg 0.0 1.0 /end CHARACTERISTIC
/begin CHARACTERISTIC KINP_MemOffsetAccX_raw16_ovrdflg "" VALUE 0x0000 /* @ECU_Address@KINP_MemOffsetAccX_raw16_ovrdflg@ */ Scalar_BOOLEAN 0 SWC_INP_type_CM_boolean_flg 0.0 1.0 /end CHARACTERISTIC
/begin CHARACTERISTIC KINP_MemOffsetAccY_raw16_ovrdflg "" VALUE 0x0000 /* @ECU_Address@KINP_MemOffsetAccY_raw16_ovrdflg@ */ Scalar_BOOLEAN 0 SWC_INP_type_CM_boolean_flg 0.0 1.0 /end CHARACTERISTIC
/begin CHARACTERISTIC KINP_MemOffsetAccZ_raw16_ovrdflg "" VALUE 0x0000 /* @ECU_Address@KINP_MemOffsetAccZ_raw16_ovrdflg@ */ Scalar_BOOLEAN 0 SWC_INP_type_CM_boolean_flg 0.0 1.0 /end CHARACTERISTIC
/begin CHARACTERISTIC KINP_MemOffsetGyroX_raw16_ovrdflg "" VALUE 0x0000 /* @ECU_Address@KINP_MemOffsetGyroX_raw16_ovrdflg@ */ Scalar_BOOLEAN 0 SWC_INP_type_CM_boolean_flg 0.0 1.0 /end CHARACTERISTIC
/begin CHARACTERISTIC KINP_MemOffsetGyroY_raw16_ovrdflg "" VALUE 0x0000 /* @ECU_Address@KINP_MemOffsetGyroY_raw16_ovrdflg@ */ Scalar_BOOLEAN 0 SWC_INP_type_CM_boolean_flg 0.0 1.0 /end CHARACTERISTIC
/begin CHARACTERISTIC KINP_MemOffsetGyroZ_raw16_ovrdflg "" VALUE 0x0000 /* @ECU_Address@KINP_MemOffsetGyroZ_raw16_ovrdflg@ */ Scalar_BOOLEAN 0 SWC_INP_type_CM_boolean_flg 0.0 1.0 /end CHARACTERISTIC
/begin CHARACTERISTIC KINP_NFCDoorSta_flg_ovrdflg "" VALUE 0x0000 /* @ECU_Address@KINP_NFCDoorSta_flg_ovrdflg@ */ Scalar_BOOLEAN 0 SWC_INP_type_CM_boolean_flg 0.0 1.0 /end CHARACTERISTIC
/begin CHARACTERISTIC KINP_NFCDoorSta_flg_ovrdval "" VALUE 0x0000 /* @ECU_Address@KINP_NFCDoorSta_flg_ovrdval@ */ Scalar_BOOLEAN 0 SWC_INP_type_CM_boolean_flg 0.0 1.0 /end CHARACTERISTIC
/begin CHARACTERISTIC KINP_NFCLidASta_flg_ovrdflg "" VALUE 0x0000 /* @ECU_Address@KINP_NFCLidASta_flg_ovrdflg@ */ Scalar_BOOLEAN 0 SWC_INP_type_CM_boolean_flg 0.0 1.0 /end CHARACTERISTIC
/begin CHARACTERISTIC KINP_NFCLidASta_flg_ovrdval "" VALUE 0x0000 /* @ECU_Address@KINP_NFCLidASta_flg_ovrdval@ */ Scalar_BOOLEAN 0 SWC_INP_type_CM_boolean_flg 0.0 1.0 /end CHARACTERISTIC
/begin CHARACTERISTIC KINP_NetworkReqCalled_flg_ovrdflg "" VALUE 0x0000 /* @ECU_Address@KINP_NetworkReqCalled_flg_ovrdflg@ */ Scalar_BOOLEAN 0 SWC_INP_type_CM_boolean_flg 0.0 1.0 /end CHARACTERISTIC
/begin CHARACTERISTIC KINP_NetworkReqCalled_flg_ovrdval "" VALUE 0x0000 /* @ECU_Address@KINP_NetworkReqCalled_flg_ovrdval@ */ Scalar_BOOLEAN 0 SWC_INP_type_CM_boolean_flg 0.0 1.0 /end CHARACTERISTIC
/begin CHARACTERISTIC KINP_Pedal1Ref5V_V_ovrdflg "" VALUE 0x0000 /* @ECU_Address@KINP_Pedal1Ref5V_V_ovrdflg@ */ Scalar_BOOLEAN 0 SWC_INP_type_CM_boolean_flg 0.0 1.0 /end CHARACTERISTIC
/begin CHARACTERISTIC KINP_Pedal2Ref5V_V_ovrdflg "" VALUE 0x0000 /* @ECU_Address@KINP_Pedal2Ref5V_V_ovrdflg@ */ Scalar_BOOLEAN 0 SWC_INP_type_CM_boolean_flg 0.0 1.0 /end CHARACTERISTIC
/begin CHARACTERISTIC KINP_PowerOffTSet_cnt_ovrdflg "" VALUE 0x0000 /* @ECU_Address@KINP_PowerOffTSet_cnt_ovrdflg@ */ Scalar_BOOLEAN 0 SWC_INP_type_CM_boolean_flg 0.0 1.0 /end CHARACTERISTIC
/begin CHARACTERISTIC KINP_ReDoorLock_enum_ovrdflg "" VALUE 0x0000 /* @ECU_Address@KINP_ReDoorLock_enum_ovrdflg@ */ Scalar_BOOLEAN 0 SWC_INP_type_CM_boolean_flg 0.0 1.0 /end CHARACTERISTIC
/begin CHARACTERISTIC KINP_ReOutsideMirror_enum_ovrdflg "" VALUE 0x0000 /* @ECU_Address@KINP_ReOutsideMirror_enum_ovrdflg@ */ Scalar_BOOLEAN 0 SWC_INP_type_CM_boolean_flg 0.0 1.0 /end CHARACTERISTIC
/begin CHARACTERISTIC KINP_RePwrReqTbox_enum_ovrdflg "" VALUE 0x0000 /* @ECU_Address@KINP_RePwrReqTbox_enum_ovrdflg@ */ Scalar_BOOLEAN 0 SWC_INP_type_CM_boolean_flg 0.0 1.0 /end CHARACTERISTIC
/begin CHARACTERISTIC KINP_ReRadio_flg_ovrdflg "" VALUE 0x0000 /* @ECU_Address@KINP_ReRadio_flg_ovrdflg@ */ Scalar_BOOLEAN 0 SWC_INP_type_CM_boolean_flg 0.0 1.0 /end CHARACTERISTIC
/begin CHARACTERISTIC KINP_ReRadio_flg_ovrdval "" VALUE 0x0000 /* @ECU_Address@KINP_ReRadio_flg_ovrdval@ */ Scalar_BOOLEAN 0 SWC_INP_type_CM_boolean_flg 0.0 1.0 /end CHARACTERISTIC
/begin CHARACTERISTIC KINP_RemoteACTemp_C_ovrdflg "" VALUE 0x0000 /* @ECU_Address@KINP_RemoteACTemp_C_ovrdflg@ */ Scalar_BOOLEAN 0 SWC_INP_type_CM_boolean_flg 0.0 1.0 /end CHARACTERISTIC
/begin CHARACTERISTIC KINP_RemoteAutoReq_flg_ovrdflg "" VALUE 0x0000 /* @ECU_Address@KINP_RemoteAutoReq_flg_ovrdflg@ */ Scalar_BOOLEAN 0 SWC_INP_type_CM_boolean_flg 0.0 1.0 /end CHARACTERISTIC
/begin CHARACTERISTIC KINP_RemoteAutoReq_flg_ovrdval "" VALUE 0x0000 /* @ECU_Address@KINP_RemoteAutoReq_flg_ovrdval@ */ Scalar_BOOLEAN 0 SWC_INP_type_CM_boolean_flg 0.0 1.0 /end CHARACTERISTIC
/begin CHARACTERISTIC KINP_SensingAccX_raw16_ovrdflg "" VALUE 0x0000 /* @ECU_Address@KINP_SensingAccX_raw16_ovrdflg@ */ Scalar_BOOLEAN 0 SWC_INP_type_CM_boolean_flg 0.0 1.0 /end CHARACTERISTIC
/begin CHARACTERISTIC KINP_SensingAccY_raw16_ovrdflg "" VALUE 0x0000 /* @ECU_Address@KINP_SensingAccY_raw16_ovrdflg@ */ Scalar_BOOLEAN 0 SWC_INP_type_CM_boolean_flg 0.0 1.0 /end CHARACTERISTIC
/begin CHARACTERISTIC KINP_SensingAccZ_raw16_ovrdflg "" VALUE 0x0000 /* @ECU_Address@KINP_SensingAccZ_raw16_ovrdflg@ */ Scalar_BOOLEAN 0 SWC_INP_type_CM_boolean_flg 0.0 1.0 /end CHARACTERISTIC
/begin CHARACTERISTIC KINP_SensingGyroX_raw16_ovrdflg "" VALUE 0x0000 /* @ECU_Address@KINP_SensingGyroX_raw16_ovrdflg@ */ Scalar_BOOLEAN 0 SWC_INP_type_CM_boolean_flg 0.0 1.0 /end CHARACTERISTIC
/begin CHARACTERISTIC KINP_SensingGyroY_raw16_ovrdflg "" VALUE 0x0000 /* @ECU_Address@KINP_SensingGyroY_raw16_ovrdflg@ */ Scalar_BOOLEAN 0 SWC_INP_type_CM_boolean_flg 0.0 1.0 /end CHARACTERISTIC
/begin CHARACTERISTIC KINP_SensingGyroZ_raw16_ovrdflg "" VALUE 0x0000 /* @ECU_Address@KINP_SensingGyroZ_raw16_ovrdflg@ */ Scalar_BOOLEAN 0 SWC_INP_type_CM_boolean_flg 0.0 1.0 /end CHARACTERISTIC
/begin CHARACTERISTIC KINP_TBOXRemotePW_enum_ovrdflg "" VALUE 0x0000 /* @ECU_Address@KINP_TBOXRemotePW_enum_ovrdflg@ */ Scalar_BOOLEAN 0 SWC_INP_type_CM_boolean_flg 0.0 1.0 /end CHARACTERISTIC
/begin CHARACTERISTIC KINP_UIDBatVoltx1000_V_ovrdflg "" VALUE 0x0000 /* @ECU_Address@KINP_UIDBatVoltx1000_V_ovrdflg@ */ Scalar_BOOLEAN 0 SWC_INP_type_CM_boolean_flg 0.0 1.0 /end CHARACTERISTIC
/begin CHARACTERISTIC KINP_UIDButtonCmd_enum_ovrdflg "" VALUE 0x0000 /* @ECU_Address@KINP_UIDButtonCmd_enum_ovrdflg@ */ Scalar_BOOLEAN 0 SWC_INP_type_CM_boolean_flg 0.0 1.0 /end CHARACTERISTIC
/begin CHARACTERISTIC KINP_UWB1Distance_cm_ovrdflg "" VALUE 0x0000 /* @ECU_Address@KINP_UWB1Distance_cm_ovrdflg@ */ Scalar_BOOLEAN 0 SWC_INP_type_CM_boolean_flg 0.0 1.0 /end CHARACTERISTIC
/begin CHARACTERISTIC KINP_UWB1Power_dB_ovrdflg "" VALUE 0x0000 /* @ECU_Address@KINP_UWB1Power_dB_ovrdflg@ */ Scalar_BOOLEAN 0 SWC_INP_type_CM_boolean_flg 0.0 1.0 /end CHARACTERISTIC
/begin CHARACTERISTIC KINP_UWB1RangingSta_enum_ovrdflg "" VALUE 0x0000 /* @ECU_Address@KINP_UWB1RangingSta_enum_ovrdflg@ */ Scalar_BOOLEAN 0 SWC_INP_type_CM_boolean_flg 0.0 1.0 /end CHARACTERISTIC
/begin CHARACTERISTIC KINP_UWB2Distance_cm_ovrdflg "" VALUE 0x0000 /* @ECU_Address@KINP_UWB2Distance_cm_ovrdflg@ */ Scalar_BOOLEAN 0 SWC_INP_type_CM_boolean_flg 0.0 1.0 /end CHARACTERISTIC
/begin CHARACTERISTIC KINP_UWB2Power_dB_ovrdflg "" VALUE 0x0000 /* @ECU_Address@KINP_UWB2Power_dB_ovrdflg@ */ Scalar_BOOLEAN 0 SWC_INP_type_CM_boolean_flg 0.0 1.0 /end CHARACTERISTIC
/begin CHARACTERISTIC KINP_UWB2RangingSta_enum_ovrdflg "" VALUE 0x0000 /* @ECU_Address@KINP_UWB2RangingSta_enum_ovrdflg@ */ Scalar_BOOLEAN 0 SWC_INP_type_CM_boolean_flg 0.0 1.0 /end CHARACTERISTIC
/begin CHARACTERISTIC KINP_UWB3Distance_cm_ovrdflg "" VALUE 0x0000 /* @ECU_Address@KINP_UWB3Distance_cm_ovrdflg@ */ Scalar_BOOLEAN 0 SWC_INP_type_CM_boolean_flg 0.0 1.0 /end CHARACTERISTIC
/begin CHARACTERISTIC KINP_UWB3Power_dB_ovrdflg "" VALUE 0x0000 /* @ECU_Address@KINP_UWB3Power_dB_ovrdflg@ */ Scalar_BOOLEAN 0 SWC_INP_type_CM_boolean_flg 0.0 1.0 /end CHARACTERISTIC
/begin CHARACTERISTIC KINP_UWB3RangingSta_enum_ovrdflg "" VALUE 0x0000 /* @ECU_Address@KINP_UWB3RangingSta_enum_ovrdflg@ */ Scalar_BOOLEAN 0 SWC_INP_type_CM_boolean_flg 0.0 1.0 /end CHARACTERISTIC
/begin CHARACTERISTIC KINP_UWB4Distance_cm_ovrdflg "" VALUE 0x0000 /* @ECU_Address@KINP_UWB4Distance_cm_ovrdflg@ */ Scalar_BOOLEAN 0 SWC_INP_type_CM_boolean_flg 0.0 1.0 /end CHARACTERISTIC
/begin CHARACTERISTIC KINP_UWB4Power_dB_ovrdflg "" VALUE 0x0000 /* @ECU_Address@KINP_UWB4Power_dB_ovrdflg@ */ Scalar_BOOLEAN 0 SWC_INP_type_CM_boolean_flg 0.0 1.0 /end CHARACTERISTIC
/begin CHARACTERISTIC KINP_UWB4RangingSta_enum_ovrdflg "" VALUE 0x0000 /* @ECU_Address@KINP_UWB4RangingSta_enum_ovrdflg@ */ Scalar_BOOLEAN 0 SWC_INP_type_CM_boolean_flg 0.0 1.0 /end CHARACTERISTIC
/begin CHARACTERISTIC KINP_UWB5Distance_cm_ovrdflg "" VALUE 0x0000 /* @ECU_Address@KINP_UWB5Distance_cm_ovrdflg@ */ Scalar_BOOLEAN 0 SWC_INP_type_CM_boolean_flg 0.0 1.0 /end CHARACTERISTIC
/begin CHARACTERISTIC KINP_UWB5Power_dB_ovrdflg "" VALUE 0x0000 /* @ECU_Address@KINP_UWB5Power_dB_ovrdflg@ */ Scalar_BOOLEAN 0 SWC_INP_type_CM_boolean_flg 0.0 1.0 /end CHARACTERISTIC
/begin CHARACTERISTIC KINP_UWB5RangingSta_enum_ovrdflg "" VALUE 0x0000 /* @ECU_Address@KINP_UWB5RangingSta_enum_ovrdflg@ */ Scalar_BOOLEAN 0 SWC_INP_type_CM_boolean_flg 0.0 1.0 /end CHARACTERISTIC
/begin CHARACTERISTIC KINP_UWBRangingON_flg_ovrdflg "" VALUE 0x0000 /* @ECU_Address@KINP_UWBRangingON_flg_ovrdflg@ */ Scalar_BOOLEAN 0 SWC_INP_type_CM_boolean_flg 0.0 1.0 /end CHARACTERISTIC
/begin CHARACTERISTIC KINP_UWBRangingON_flg_ovrdval "" VALUE 0x0000 /* @ECU_Address@KINP_UWBRangingON_flg_ovrdval@ */ Scalar_BOOLEAN 0 SWC_INP_type_CM_boolean_flg 0.0 1.0 /end CHARACTERISTIC
/begin CHARACTERISTIC KINP_UWBpositionX_cm_ovrdflg "" VALUE 0x0000 /* @ECU_Address@KINP_UWBpositionX_cm_ovrdflg@ */ Scalar_BOOLEAN 0 SWC_INP_type_CM_boolean_flg 0.0 1.0 /end CHARACTERISTIC
/begin CHARACTERISTIC KINP_UWBpositionY_cm_ovrdflg "" VALUE 0x0000 /* @ECU_Address@KINP_UWBpositionY_cm_ovrdflg@ */ Scalar_BOOLEAN 0 SWC_INP_type_CM_boolean_flg 0.0 1.0 /end CHARACTERISTIC
/begin CHARACTERISTIC KINP_DKCBTRSSI_dB_ovrdval "" VALUE 0x0000 /* @ECU_Address@KINP_DKCBTRSSI_dB_ovrdval@ */ Scalar_BYTE 0 SWC_INP_type_CM_int8_dB -128.0 127.0 /end CHARACTERISTIC
/begin CHARACTERISTIC KINP_UWB1Power_dB_ovrdval "" VALUE 0x0000 /* @ECU_Address@KINP_UWB1Power_dB_ovrdval@ */ Scalar_BYTE 0 SWC_INP_type_CM_int8_dB -128.0 127.0 /end CHARACTERISTIC
/begin CHARACTERISTIC KINP_UWB2Power_dB_ovrdval "" VALUE 0x0000 /* @ECU_Address@KINP_UWB2Power_dB_ovrdval@ */ Scalar_BYTE 0 SWC_INP_type_CM_int8_dB -128.0 127.0 /end CHARACTERISTIC
/begin CHARACTERISTIC KINP_UWB3Power_dB_ovrdval "" VALUE 0x0000 /* @ECU_Address@KINP_UWB3Power_dB_ovrdval@ */ Scalar_BYTE 0 SWC_INP_type_CM_int8_dB -128.0 127.0 /end CHARACTERISTIC
/begin CHARACTERISTIC KINP_UWB4Power_dB_ovrdval "" VALUE 0x0000 /* @ECU_Address@KINP_UWB4Power_dB_ovrdval@ */ Scalar_BYTE 0 SWC_INP_type_CM_int8_dB -128.0 127.0 /end CHARACTERISTIC
/begin CHARACTERISTIC KINP_UWB5Power_dB_ovrdval "" VALUE 0x0000 /* @ECU_Address@KINP_UWB5Power_dB_ovrdval@ */ Scalar_BYTE 0 SWC_INP_type_CM_int8_dB -128.0 127.0 /end CHARACTERISTIC
/begin CHARACTERISTIC KINP_BTConnectSta_enum_ovrdval "" VALUE 0x0000 /* @ECU_Address@KINP_BTConnectSta_enum_ovrdval@ */ Scalar_UBYTE 0 SWC_INP_type_CM_uint8_enum 0.0 255.0 /end CHARACTERISTIC
/begin CHARACTERISTIC KINP_CbnPreACEnaReq_enum_ovrdval "" VALUE 0x0000 /* @ECU_Address@KINP_CbnPreACEnaReq_enum_ovrdval@ */ Scalar_UBYTE 0 SWC_INP_type_CM_uint8_enum 0.0 3.0 /end CHARACTERISTIC
/begin CHARACTERISTIC KINP_FDCConnDrvWdwCtrlCmd_pct_ovrdval "" VALUE 0x0000 /* @ECU_Address@KINP_FDCConnDrvWdwCtrlCmd_pct_ovrdval@ */ Scalar_UBYTE 0 SWC_INP_type_CM_uint8_pct 0.0 255.0 /end CHARACTERISTIC
/begin CHARACTERISTIC KINP_FDCConnPasWdwCtrlCmd_pct_ovrdval "" VALUE 0x0000 /* @ECU_Address@KINP_FDCConnPasWdwCtrlCmd_pct_ovrdval@ */ Scalar_UBYTE 0 SWC_INP_type_CM_uint8_pct 0.0 255.0 /end CHARACTERISTIC
/begin CHARACTERISTIC KINP_FDCConnRLDWdwCtrlCmd_pct_ovrdval "" VALUE 0x0000 /* @ECU_Address@KINP_FDCConnRLDWdwCtrlCmd_pct_ovrdval@ */ Scalar_UBYTE 0 SWC_INP_type_CM_uint8_pct 0.0 255.0 /end CHARACTERISTIC
/begin CHARACTERISTIC KINP_FDCConnRRDWdwCtrlCmd_pct_ovrdval "" VALUE 0x0000 /* @ECU_Address@KINP_FDCConnRRDWdwCtrlCmd_pct_ovrdval@ */ Scalar_UBYTE 0 SWC_INP_type_CM_uint8_pct 0.0 255.0 /end CHARACTERISTIC
/begin CHARACTERISTIC KINP_ReOutsideMirror_enum_ovrdval "" VALUE 0x0000 /* @ECU_Address@KINP_ReOutsideMirror_enum_ovrdval@ */ Scalar_UBYTE 0 SWC_INP_type_CM_uint8_enum 0.0 3.0 /end CHARACTERISTIC
/begin CHARACTERISTIC KINP_RePwrReqTbox_enum_ovrdval "" VALUE 0x0000 /* @ECU_Address@KINP_RePwrReqTbox_enum_ovrdval@ */ Scalar_UBYTE 0 SWC_INP_type_CM_uint8_enum 0.0 6.0 /end CHARACTERISTIC
/begin CHARACTERISTIC KINP_TBOXRemotePW_enum_ovrdval "" VALUE 0x0000 /* @ECU_Address@KINP_TBOXRemotePW_enum_ovrdval@ */ Scalar_UBYTE 0 SWC_INP_type_CM_uint8_enum 0.0 16.0 /end CHARACTERISTIC
/begin CHARACTERISTIC KINP_UIDButtonCmd_enum_ovrdval "" VALUE 0x0000 /* @ECU_Address@KINP_UIDButtonCmd_enum_ovrdval@ */ Scalar_UBYTE 0 SWC_INP_type_CM_uint8_enum 0.0 255.0 /end CHARACTERISTIC
/begin CHARACTERISTIC KINP_UWB1RangingSta_enum_ovrdval "" VALUE 0x0000 /* @ECU_Address@KINP_UWB1RangingSta_enum_ovrdval@ */ Scalar_UBYTE 0 SWC_INP_type_CM_uint8_enum 0.0 255.0 /end CHARACTERISTIC
/begin CHARACTERISTIC KINP_UWB2RangingSta_enum_ovrdval "" VALUE 0x0000 /* @ECU_Address@KINP_UWB2RangingSta_enum_ovrdval@ */ Scalar_UBYTE 0 SWC_INP_type_CM_uint8_enum 0.0 255.0 /end CHARACTERISTIC
/begin CHARACTERISTIC KINP_UWB3RangingSta_enum_ovrdval "" VALUE 0x0000 /* @ECU_Address@KINP_UWB3RangingSta_enum_ovrdval@ */ Scalar_UBYTE 0 SWC_INP_type_CM_uint8_enum 0.0 255.0 /end CHARACTERISTIC
/begin CHARACTERISTIC KINP_UWB4RangingSta_enum_ovrdval "" VALUE 0x0000 /* @ECU_Address@KINP_UWB4RangingSta_enum_ovrdval@ */ Scalar_UBYTE 0 SWC_INP_type_CM_uint8_enum 0.0 255.0 /end CHARACTERISTIC
/begin CHARACTERISTIC KINP_UWB5RangingSta_enum_ovrdval "" VALUE 0x0000 /* @ECU_Address@KINP_UWB5RangingSta_enum_ovrdval@ */ Scalar_UBYTE 0 SWC_INP_type_CM_uint8_enum 0.0 255.0 /end CHARACTERISTIC
/begin MEASUREMENT VINP_TBOXHWVER_enum "" ULONG SWC_INP_type_CM_uint32_enum 0 0 0.0 4.294967295E+9 ECU_ADDRESS 0x0000 /* @ECU_Address@VINP_TBOXHWVER_enum@ */ /end MEASUREMENT
/begin MEASUREMENT VINP_TBOXSWVER_enum "" ULONG SWC_INP_type_CM_uint32_enum 0 0 0.0 4.294967295E+9 ECU_ADDRESS 0x0000 /* @ECU_Address@VINP_TBOXSWVER_enum@ */ /end MEASUREMENT
/begin MEASUREMENT VINP_Pedal1Ref5V_V "" FLOAT32_IEEE SWC_INP_type_CM_single_V 0 0 0.0 10.0 ECU_ADDRESS 0x0000 /* @ECU_Address@VINP_Pedal1Ref5V_V@ */ /end MEASUREMENT
/begin MEASUREMENT VINP_Pedal2Ref5V_V "" FLOAT32_IEEE SWC_INP_type_CM_single_V 0 0 0.0 10.0 ECU_ADDRESS 0x0000 /* @ECU_Address@VINP_Pedal2Ref5V_V@ */ /end MEASUREMENT
/begin MEASUREMENT VINP_PowerOffTSet_cnt "" FLOAT32_IEEE SWC_INP_type_CM_single_cnt 0 0 1.0 128.0 ECU_ADDRESS 0x0000 /* @ECU_Address@VINP_PowerOffTSet_cnt@ */ /end MEASUREMENT
/begin MEASUREMENT VINP_RemoteACTemp_C "" FLOAT32_IEEE SWC_INP_type_CM_single_C 0 0 17.0 48.5 ECU_ADDRESS 0x0000 /* @ECU_Address@VINP_RemoteACTemp_C@ */ /end MEASUREMENT
/begin MEASUREMENT VINP_OBCDCVoltInf_V "" FLOAT32_IEEE SWC_INP_type_CM_single_V 0 0 0.0 1228.2 ECU_ADDRESS 0x0000 /* @ECU_Address@VINP_OBCDCVoltInf_V@ */ /end MEASUREMENT
/begin MEASUREMENT VINP_DCDCTemp_C "" FLOAT32_IEEE SWC_INP_type_CM_single_C 0 0 -48.0 142.5 ECU_ADDRESS 0x0000 /* @ECU_Address@VINP_DCDCTemp_C@ */ /end MEASUREMENT
/begin MEASUREMENT VINP_OBCACCurrInf_A "" FLOAT32_IEEE SWC_INP_type_CM_single_A 0 0 -40.0 87.75 ECU_ADDRESS 0x0000 /* @ECU_Address@VINP_OBCACCurrInf_A@ */ /end MEASUREMENT
/begin MEASUREMENT VINP_OBCACVoltInf_V "" FLOAT32_IEEE SWC_INP_type_CM_single_V 0 0 0.0 409.4 ECU_ADDRESS 0x0000 /* @ECU_Address@VINP_OBCACVoltInf_V@ */ /end MEASUREMENT
/begin MEASUREMENT VINP_OBCTemp_C "" FLOAT32_IEEE SWC_INP_type_CM_single_C 0 0 -48.0 105.3 ECU_ADDRESS 0x0000 /* @ECU_Address@VINP_OBCTemp_C@ */ /end MEASUREMENT
/begin MEASUREMENT VINP_FrEDURealTMTq_Nm "" FLOAT32_IEEE SWC_INP_type_CM_single_Nm 0 0 -1022.0 5531.5 ECU_ADDRESS 0x0000 /* @ECU_Address@VINP_FrEDURealTMTq_Nm@ */ /end MEASUREMENT
/begin MEASUREMENT VINP_FrEDUTqReqFbk_Nm "" FLOAT32_IEEE SWC_INP_type_CM_single_Nm 0 0 -1022.0 1022.0 ECU_ADDRESS 0x0000 /* @ECU_Address@VINP_FrEDUTqReqFbk_Nm@ */ /end MEASUREMENT
/begin MEASUREMENT VINP_FrMCUBAT_V "" FLOAT32_IEEE SWC_INP_type_CM_single_V 0 0 0.0 25.4 ECU_ADDRESS 0x0000 /* @ECU_Address@VINP_FrMCUBAT_V@ */ /end MEASUREMENT
/begin MEASUREMENT VINP_FrMCUDCBusCurr_A "" FLOAT32_IEEE SWC_INP_type_CM_single_A 0 0 -1500.0 1500.0 ECU_ADDRESS 0x0000 /* @ECU_Address@VINP_FrMCUDCBusCurr_A@ */ /end MEASUREMENT
/begin MEASUREMENT VINP_FrMCUDCBusVolt_V "" FLOAT32_IEEE SWC_INP_type_CM_single_V 0 0 0.0 4000.0 ECU_ADDRESS 0x0000 /* @ECU_Address@VINP_FrMCUDCBusVolt_V@ */ /end MEASUREMENT
/begin MEASUREMENT VINP_FrMCUTemp_C "" FLOAT32_IEEE SWC_INP_type_CM_single_C 0 0 -40.0 254.0 ECU_ADDRESS 0x0000 /* @ECU_Address@VINP_FrMCUTemp_C@ */ /end MEASUREMENT
/begin MEASUREMENT VINP_FrMotorAvailTq_Nm "" FLOAT32_IEEE SWC_INP_type_CM_single_Nm 0 0 0.0 1022.0 ECU_ADDRESS 0x0000 /* @ECU_Address@VINP_FrMotorAvailTq_Nm@ */ /end MEASUREMENT
/begin MEASUREMENT VINP_FrRegenAvailTq_Nm "" FLOAT32_IEEE SWC_INP_type_CM_single_Nm 0 0 -1022.0 0.0 ECU_ADDRESS 0x0000 /* @ECU_Address@VINP_FrRegenAvailTq_Nm@ */ /end MEASUREMENT
/begin MEASUREMENT VINP_FrTMSpd_rpm "" FLOAT32_IEEE SWC_INP_type_CM_single_rpm 0 0 -18000.0 18000.0 ECU_ADDRESS 0x0000 /* @ECU_Address@VINP_FrTMSpd_rpm@ */ /end MEASUREMENT
/begin MEASUREMENT VINP_FrTMTemp_C "" FLOAT32_IEEE SWC_INP_type_CM_single_C 0 0 -40.0 254.0 ECU_ADDRESS 0x0000 /* @ECU_Address@VINP_FrTMTemp_C@ */ /end MEASUREMENT
/begin MEASUREMENT VINP_FrTMid_A "" FLOAT32_IEEE SWC_INP_type_CM_single_A 0 0 -1500.0 1500.0 ECU_ADDRESS 0x0000 /* @ECU_Address@VINP_FrTMid_A@ */ /end MEASUREMENT
/begin MEASUREMENT VINP_FrTMiq_A "" FLOAT32_IEEE SWC_INP_type_CM_single_A 0 0 -1500.0 1500.0 ECU_ADDRESS 0x0000 /* @ECU_Address@VINP_FrTMiq_A@ */ /end MEASUREMENT
/begin MEASUREMENT VINP_MCUBFRealPwrKwSta_kW "" FLOAT32_IEEE SWC_INP_type_CM_single_kW 0 0 -530.0 6023.4 ECU_ADDRESS 0x0000 /* @ECU_Address@VINP_MCUBFRealPwrKwSta_kW@ */ /end MEASUREMENT
/begin MEASUREMENT VINP_FrCoolanttempReq_C "" FLOAT32_IEEE SWC_INP_type_CM_single_C 0 0 -40.0 214.0 ECU_ADDRESS 0x0000 /* @ECU_Address@VINP_FrCoolanttempReq_C@ */ /end MEASUREMENT
/begin MEASUREMENT VINP_FrLLCTemp_C "" FLOAT32_IEEE SWC_INP_type_CM_single_C 0 0 -40.0 214.0 ECU_ADDRESS 0x0000 /* @ECU_Address@VINP_FrLLCTemp_C@ */ /end MEASUREMENT
/begin MEASUREMENT VINP_FrLLCflowReq_Lpmin "" FLOAT32_IEEE SWC_INP_type_CM_single_Lpmin 0 0 0.0 15.5 ECU_ADDRESS 0x0000 /* @ECU_Address@VINP_FrLLCflowReq_Lpmin@ */ /end MEASUREMENT
/begin MEASUREMENT VINP_MCUBRRealPwrKwSta_kW "" FLOAT32_IEEE SWC_INP_type_CM_single_kW 0 0 -530.0 6023.4 ECU_ADDRESS 0x0000 /* @ECU_Address@VINP_MCUBRRealPwrKwSta_kW@ */ /end MEASUREMENT
/begin MEASUREMENT VINP_RrEDURealTMTq_Nm "" FLOAT32_IEEE SWC_INP_type_CM_single_Nm 0 0 -1022.0 5531.5 ECU_ADDRESS 0x0000 /* @ECU_Address@VINP_RrEDURealTMTq_Nm@ */ /end MEASUREMENT
/begin MEASUREMENT VINP_RrEDUTqReqFbk_Nm "" FLOAT32_IEEE SWC_INP_type_CM_single_Nm 0 0 -1022.0 1022.0 ECU_ADDRESS 0x0000 /* @ECU_Address@VINP_RrEDUTqReqFbk_Nm@ */ /end MEASUREMENT
/begin MEASUREMENT VINP_RrMCUBAT_V "" FLOAT32_IEEE SWC_INP_type_CM_single_V 0 0 0.0 25.4 ECU_ADDRESS 0x0000 /* @ECU_Address@VINP_RrMCUBAT_V@ */ /end MEASUREMENT
/begin MEASUREMENT VINP_RrMCUDCBusCurr_A "" FLOAT32_IEEE SWC_INP_type_CM_single_A 0 0 -1500.0 1500.0 ECU_ADDRESS 0x0000 /* @ECU_Address@VINP_RrMCUDCBusCurr_A@ */ /end MEASUREMENT
/begin MEASUREMENT VINP_RrMCUDCBusVolt_V "" FLOAT32_IEEE SWC_INP_type_CM_single_V 0 0 0.0 4000.0 ECU_ADDRESS 0x0000 /* @ECU_Address@VINP_RrMCUDCBusVolt_V@ */ /end MEASUREMENT
/begin MEASUREMENT VINP_RrMCUTemp_C "" FLOAT32_IEEE SWC_INP_type_CM_single_C 0 0 -40.0 254.0 ECU_ADDRESS 0x0000 /* @ECU_Address@VINP_RrMCUTemp_C@ */ /end MEASUREMENT
/begin MEASUREMENT VINP_RrMotorAvailTq_Nm "" FLOAT32_IEEE SWC_INP_type_CM_single_Nm 0 0 0.0 1022.0 ECU_ADDRESS 0x0000 /* @ECU_Address@VINP_RrMotorAvailTq_Nm@ */ /end MEASUREMENT
/begin MEASUREMENT VINP_RrRegenAvailTq_Nm "" FLOAT32_IEEE SWC_INP_type_CM_single_Nm 0 0 -1022.0 0.0 ECU_ADDRESS 0x0000 /* @ECU_Address@VINP_RrRegenAvailTq_Nm@ */ /end MEASUREMENT
/begin MEASUREMENT VINP_RrTMSpd_rpm "" FLOAT32_IEEE SWC_INP_type_CM_single_rpm 0 0 -18000.0 18000.0 ECU_ADDRESS 0x0000 /* @ECU_Address@VINP_RrTMSpd_rpm@ */ /end MEASUREMENT
/begin MEASUREMENT VINP_RrTMTemp_C "" FLOAT32_IEEE SWC_INP_type_CM_single_C 0 0 -40.0 254.0 ECU_ADDRESS 0x0000 /* @ECU_Address@VINP_RrTMTemp_C@ */ /end MEASUREMENT
/begin MEASUREMENT VINP_RrTMid_A "" FLOAT32_IEEE SWC_INP_type_CM_single_A 0 0 -1500.0 1500.0 ECU_ADDRESS 0x0000 /* @ECU_Address@VINP_RrTMid_A@ */ /end MEASUREMENT
/begin MEASUREMENT VINP_RrTMiq_A "" FLOAT32_IEEE SWC_INP_type_CM_single_A 0 0 -1500.0 1500.0 ECU_ADDRESS 0x0000 /* @ECU_Address@VINP_RrTMiq_A@ */ /end MEASUREMENT
/begin MEASUREMENT VINP_RrCoolanttempReq_cnt "" FLOAT32_IEEE SWC_INP_type_CM_single_cnt 0 0 -40.0 214.0 ECU_ADDRESS 0x0000 /* @ECU_Address@VINP_RrCoolanttempReq_cnt@ */ /end MEASUREMENT
/begin MEASUREMENT VINP_RrLLCTemp_C "" FLOAT32_IEEE SWC_INP_type_CM_single_C 0 0 -40.0 214.0 ECU_ADDRESS 0x0000 /* @ECU_Address@VINP_RrLLCTemp_C@ */ /end MEASUREMENT
/begin MEASUREMENT VINP_RrLLCflowReq_Lpmin "" FLOAT32_IEEE SWC_INP_type_CM_single_Lpmin 0 0 0.0 15.5 ECU_ADDRESS 0x0000 /* @ECU_Address@VINP_RrLLCflowReq_Lpmin@ */ /end MEASUREMENT
/begin MEASUREMENT VINP_FrEDURealTMTqNidec_Nm "" FLOAT32_IEEE SWC_INP_type_CM_single_Nm 0 0 -1022.0 1022.0 ECU_ADDRESS 0x0000 /* @ECU_Address@VINP_FrEDURealTMTqNidec_Nm@ */ /end MEASUREMENT
/begin MEASUREMENT VINP_FrEDUTqReqFbkNidec_Nm "" FLOAT32_IEEE SWC_INP_type_CM_single_Nm 0 0 -1022.0 1022.0 ECU_ADDRESS 0x0000 /* @ECU_Address@VINP_FrEDUTqReqFbkNidec_Nm@ */ /end MEASUREMENT
/begin MEASUREMENT VINP_FrMCUBATNidec_V "" FLOAT32_IEEE SWC_INP_type_CM_single_V 0 0 0.0 25.4 ECU_ADDRESS 0x0000 /* @ECU_Address@VINP_FrMCUBATNidec_V@ */ /end MEASUREMENT
/begin MEASUREMENT VINP_FrMCUDCBusCurrNidec_A "" FLOAT32_IEEE SWC_INP_type_CM_single_A 0 0 -1500.0 1500.0 ECU_ADDRESS 0x0000 /* @ECU_Address@VINP_FrMCUDCBusCurrNidec_A@ */ /end MEASUREMENT
/begin MEASUREMENT VINP_FrMCUDCBusVoltNidec_V "" FLOAT32_IEEE SWC_INP_type_CM_single_V 0 0 0.0 4000.0 ECU_ADDRESS 0x0000 /* @ECU_Address@VINP_FrMCUDCBusVoltNidec_V@ */ /end MEASUREMENT
/begin MEASUREMENT VINP_FrMCUTempNidec_C "" FLOAT32_IEEE SWC_INP_type_CM_single_C 0 0 -40.0 254.0 ECU_ADDRESS 0x0000 /* @ECU_Address@VINP_FrMCUTempNidec_C@ */ /end MEASUREMENT
/begin MEASUREMENT VINP_FrMotorAvailTqNidec_Nm "" FLOAT32_IEEE SWC_INP_type_CM_single_Nm 0 0 0.0 1022.0 ECU_ADDRESS 0x0000 /* @ECU_Address@VINP_FrMotorAvailTqNidec_Nm@ */ /end MEASUREMENT
/begin MEASUREMENT VINP_FrRegenAvailTqNidec_Nm "" FLOAT32_IEEE SWC_INP_type_CM_single_Nm 0 0 -1022.0 0.0 ECU_ADDRESS 0x0000 /* @ECU_Address@VINP_FrRegenAvailTqNidec_Nm@ */ /end MEASUREMENT
/begin MEASUREMENT VINP_FrTMSpdNidec_rpm "" FLOAT32_IEEE SWC_INP_type_CM_single_rpm 0 0 -17000.0 17000.0 ECU_ADDRESS 0x0000 /* @ECU_Address@VINP_FrTMSpdNidec_rpm@ */ /end MEASUREMENT
/begin MEASUREMENT VINP_FrTMTempNidec_C "" FLOAT32_IEEE SWC_INP_type_CM_single_C 0 0 -40.0 254.0 ECU_ADDRESS 0x0000 /* @ECU_Address@VINP_FrTMTempNidec_C@ */ /end MEASUREMENT
/begin MEASUREMENT VINP_FrTMidNidec_A "" FLOAT32_IEEE SWC_INP_type_CM_single_A 0 0 -1500.0 1500.0 ECU_ADDRESS 0x0000 /* @ECU_Address@VINP_FrTMidNidec_A@ */ /end MEASUREMENT
/begin MEASUREMENT VINP_FrTMiqNidec_A "" FLOAT32_IEEE SWC_INP_type_CM_single_A 0 0 -1500.0 1500.0 ECU_ADDRESS 0x0000 /* @ECU_Address@VINP_FrTMiqNidec_A@ */ /end MEASUREMENT
/begin MEASUREMENT VINP_FrCoolanttempReqNidec_C "" FLOAT32_IEEE SWC_INP_type_CM_single_C 0 0 -40.0 214.0 ECU_ADDRESS 0x0000 /* @ECU_Address@VINP_FrCoolanttempReqNidec_C@ */ /end MEASUREMENT
/begin MEASUREMENT VINP_FrEOPSpdSetNidec_rpm "" FLOAT32_IEEE SWC_INP_type_CM_single_rpm 0 0 0.0 4000.0 ECU_ADDRESS 0x0000 /* @ECU_Address@VINP_FrEOPSpdSetNidec_rpm@ */ /end MEASUREMENT
/begin MEASUREMENT VINP_FrLLCTempNidec_C "" FLOAT32_IEEE SWC_INP_type_CM_single_C 0 0 -40.0 214.0 ECU_ADDRESS 0x0000 /* @ECU_Address@VINP_FrLLCTempNidec_C@ */ /end MEASUREMENT
/begin MEASUREMENT VINP_FrLLCflowReqNidec_Lpmin "" FLOAT32_IEEE SWC_INP_type_CM_single_Lpmin 0 0 0.0 15.5 ECU_ADDRESS 0x0000 /* @ECU_Address@VINP_FrLLCflowReqNidec_Lpmin@ */ /end MEASUREMENT
/begin MEASUREMENT VINP_RrEDURealTMTqNidec_Nm "" FLOAT32_IEEE SWC_INP_type_CM_single_Nm 0 0 -1022.0 1022.0 ECU_ADDRESS 0x0000 /* @ECU_Address@VINP_RrEDURealTMTqNidec_Nm@ */ /end MEASUREMENT
/begin MEASUREMENT VINP_RrEDUTqReqFbkNidec_Nm "" FLOAT32_IEEE SWC_INP_type_CM_single_Nm 0 0 -1022.0 1022.0 ECU_ADDRESS 0x0000 /* @ECU_Address@VINP_RrEDUTqReqFbkNidec_Nm@ */ /end MEASUREMENT
/begin MEASUREMENT VINP_RrMCUBATNidec_V "" FLOAT32_IEEE SWC_INP_type_CM_single_V 0 0 0.0 25.4 ECU_ADDRESS 0x0000 /* @ECU_Address@VINP_RrMCUBATNidec_V@ */ /end MEASUREMENT
/begin MEASUREMENT VINP_RrMCUDCBusCurrNidec_A "" FLOAT32_IEEE SWC_INP_type_CM_single_A 0 0 -1500.0 1500.0 ECU_ADDRESS 0x0000 /* @ECU_Address@VINP_RrMCUDCBusCurrNidec_A@ */ /end MEASUREMENT
/begin MEASUREMENT VINP_RrMCUDCBusVoltNidec_V "" FLOAT32_IEEE SWC_INP_type_CM_single_V 0 0 0.0 4000.0 ECU_ADDRESS 0x0000 /* @ECU_Address@VINP_RrMCUDCBusVoltNidec_V@ */ /end MEASUREMENT
/begin MEASUREMENT VINP_HVBPwrAvailChrg_kW "" FLOAT32_IEEE SWC_INP_type_CM_single_kW 0 0 0.0 819.0 ECU_ADDRESS 0x0000 /* @ECU_Address@VINP_HVBPwrAvailChrg_kW@ */ /end MEASUREMENT
/begin MEASUREMENT VINP_RrMCUTempNidec_C "" FLOAT32_IEEE SWC_INP_type_CM_single_C 0 0 -40.0 254.0 ECU_ADDRESS 0x0000 /* @ECU_Address@VINP_RrMCUTempNidec_C@ */ /end MEASUREMENT
/begin MEASUREMENT VINP_RrMotorAvailTqNidec_Nm "" FLOAT32_IEEE SWC_INP_type_CM_single_Nm 0 0 0.0 1022.0 ECU_ADDRESS 0x0000 /* @ECU_Address@VINP_RrMotorAvailTqNidec_Nm@ */ /end MEASUREMENT
/begin MEASUREMENT VINP_RrRegenAvailTqNidec_Nm "" FLOAT32_IEEE SWC_INP_type_CM_single_Nm 0 0 -1022.0 0.0 ECU_ADDRESS 0x0000 /* @ECU_Address@VINP_RrRegenAvailTqNidec_Nm@ */ /end MEASUREMENT
/begin MEASUREMENT VINP_RrTMSpdNidec_rpm "" FLOAT32_IEEE SWC_INP_type_CM_single_rpm 0 0 -17000.0 17000.0 ECU_ADDRESS 0x0000 /* @ECU_Address@VINP_RrTMSpdNidec_rpm@ */ /end MEASUREMENT
/begin MEASUREMENT VINP_HVBPwrAvailChrg30_kW "" FLOAT32_IEEE SWC_INP_type_CM_single_kW 0 0 0.0 819.0 ECU_ADDRESS 0x0000 /* @ECU_Address@VINP_HVBPwrAvailChrg30_kW@ */ /end MEASUREMENT
/begin MEASUREMENT VINP_RrTMTempNidec_C "" FLOAT32_IEEE SWC_INP_type_CM_single_C 0 0 -40.0 254.0 ECU_ADDRESS 0x0000 /* @ECU_Address@VINP_RrTMTempNidec_C@ */ /end MEASUREMENT
/begin MEASUREMENT VINP_RrTMidNidec_A "" FLOAT32_IEEE SWC_INP_type_CM_single_A 0 0 -1500.0 1500.0 ECU_ADDRESS 0x0000 /* @ECU_Address@VINP_RrTMidNidec_A@ */ /end MEASUREMENT
/begin MEASUREMENT VINP_RrTMiqNidec_A "" FLOAT32_IEEE SWC_INP_type_CM_single_A 0 0 -1500.0 1500.0 ECU_ADDRESS 0x0000 /* @ECU_Address@VINP_RrTMiqNidec_A@ */ /end MEASUREMENT
/begin MEASUREMENT VINP_RrCoolanttempReqNidec_cnt "" FLOAT32_IEEE SWC_INP_type_CM_single_cnt 0 0 -40.0 214.0 ECU_ADDRESS 0x0000 /* @ECU_Address@VINP_RrCoolanttempReqNidec_cnt@ */ /end MEASUREMENT
/begin MEASUREMENT VINP_RrEOPSpdSetNidec_rpm "" FLOAT32_IEEE SWC_INP_type_CM_single_rpm 0 0 0.0 4000.0 ECU_ADDRESS 0x0000 /* @ECU_Address@VINP_RrEOPSpdSetNidec_rpm@ */ /end MEASUREMENT
/begin MEASUREMENT VINP_RrLLCTempNidec_C "" FLOAT32_IEEE SWC_INP_type_CM_single_C 0 0 -40.0 214.0 ECU_ADDRESS 0x0000 /* @ECU_Address@VINP_RrLLCTempNidec_C@ */ /end MEASUREMENT
/begin MEASUREMENT VINP_HVBPwrAvailChrg60_kW "" FLOAT32_IEEE SWC_INP_type_CM_single_kW 0 0 0.0 819.0 ECU_ADDRESS 0x0000 /* @ECU_Address@VINP_HVBPwrAvailChrg60_kW@ */ /end MEASUREMENT
/begin MEASUREMENT VINP_RrLLCflowReqNidec_Lpmin "" FLOAT32_IEEE SWC_INP_type_CM_single_Lpmin 0 0 0.0 15.5 ECU_ADDRESS 0x0000 /* @ECU_Address@VINP_RrLLCflowReqNidec_Lpmin@ */ /end MEASUREMENT
/begin MEASUREMENT VINP_HVBPwrAvailDchrg_kW "" FLOAT32_IEEE SWC_INP_type_CM_single_kW 0 0 0.0 819.0 ECU_ADDRESS 0x0000 /* @ECU_Address@VINP_HVBPwrAvailDchrg_kW@ */ /end MEASUREMENT
/begin MEASUREMENT VINP_HVBPwrAvailDchrg30_kW "" FLOAT32_IEEE SWC_INP_type_CM_single_kW 0 0 0.0 819.0 ECU_ADDRESS 0x0000 /* @ECU_Address@VINP_HVBPwrAvailDchrg30_kW@ */ /end MEASUREMENT
/begin MEASUREMENT VINP_HVBPwrAvailDchrg60_kW "" FLOAT32_IEEE SWC_INP_type_CM_single_kW 0 0 0.0 819.0 ECU_ADDRESS 0x0000 /* @ECU_Address@VINP_HVBPwrAvailDchrg60_kW@ */ /end MEASUREMENT
/begin MEASUREMENT VINP_HVBattCurr_A "" FLOAT32_IEEE SWC_INP_type_CM_single_A 0 0 -1000.0 2276.5 ECU_ADDRESS 0x0000 /* @ECU_Address@VINP_HVBattCurr_A@ */ /end MEASUREMENT
/begin MEASUREMENT VINP_HVBattVolt_V "" FLOAT32_IEEE SWC_INP_type_CM_single_V 0 0 0.0 819.0 ECU_ADDRESS 0x0000 /* @ECU_Address@VINP_HVBattVolt_V@ */ /end MEASUREMENT
/begin MEASUREMENT VINP_ACChrgCurrDis_A "" FLOAT32_IEEE SWC_INP_type_CM_single_A 0 0 -1000.0 2276.5 ECU_ADDRESS 0x0000 /* @ECU_Address@VINP_ACChrgCurrDis_A@ */ /end MEASUREMENT
/begin MEASUREMENT VINP_HVBChrgPwr_kWh "" FLOAT32_IEEE SWC_INP_type_CM_single_kWh 0 0 0.0 102.2 ECU_ADDRESS 0x0000 /* @ECU_Address@VINP_HVBChrgPwr_kWh@ */ /end MEASUREMENT
/begin MEASUREMENT VINP_HVBChrgPwrTotal_kWh "" FLOAT32_IEEE SWC_INP_type_CM_single_kWh 0 0 0.0 262143.0 ECU_ADDRESS 0x0000 /* @ECU_Address@VINP_HVBChrgPwrTotal_kWh@ */ /end MEASUREMENT
/begin MEASUREMENT VINP_HVBDrvPwr_kWh "" FLOAT32_IEEE SWC_INP_type_CM_single_kWh 0 0 0.0 102.2 ECU_ADDRESS 0x0000 /* @ECU_Address@VINP_HVBDrvPwr_kWh@ */ /end MEASUREMENT
/begin MEASUREMENT VINP_HVBDrvPwrTotal_kWh "" FLOAT32_IEEE SWC_INP_type_CM_single_kWh 0 0 0.0 262143.0 ECU_ADDRESS 0x0000 /* @ECU_Address@VINP_HVBDrvPwrTotal_kWh@ */ /end MEASUREMENT
/begin MEASUREMENT VINP_HVBFullChrgPwr_kWh "" FLOAT32_IEEE SWC_INP_type_CM_single_kWh 0 0 0.0 102.2 ECU_ADDRESS 0x0000 /* @ECU_Address@VINP_HVBFullChrgPwr_kWh@ */ /end MEASUREMENT
/begin MEASUREMENT VINP_HVBIsoImpedenceN_Megaohm "" FLOAT32_IEEE SWC_INP_type_CM_single_Megaohm 0 0 0.0 327.66 ECU_ADDRESS 0x0000 /* @ECU_Address@VINP_HVBIsoImpedenceN_Megaohm@ */ /end MEASUREMENT
/begin MEASUREMENT VINP_HVBIsoImpedenceP_Megaohm "" FLOAT32_IEEE SWC_INP_type_CM_single_Megaohm 0 0 0.0 327.66 ECU_ADDRESS 0x0000 /* @ECU_Address@VINP_HVBIsoImpedenceP_Megaohm@ */ /end MEASUREMENT
/begin MEASUREMENT VINP_HVBSOH_pct "" FLOAT32_IEEE SWC_INP_type_CM_single_pct 0 0 0.0 100.0 ECU_ADDRESS 0x0000 /* @ECU_Address@VINP_HVBSOH_pct@ */ /end MEASUREMENT
/begin MEASUREMENT VINP_HVBattPackVolt_V "" FLOAT32_IEEE SWC_INP_type_CM_single_V 0 0 0.0 819.0 ECU_ADDRESS 0x0000 /* @ECU_Address@VINP_HVBattPackVolt_V@ */ /end MEASUREMENT
/begin MEASUREMENT VINP_HVBattSOC_pct "" FLOAT32_IEEE SWC_INP_type_CM_single_pct 0 0 0.0 100.0 ECU_ADDRESS 0x0000 /* @ECU_Address@VINP_HVBattSOC_pct@ */ /end MEASUREMENT
/begin MEASUREMENT VINP_HVBattSOCDis_pct "" FLOAT32_IEEE SWC_INP_type_CM_single_pct 0 0 0.0 100.0 ECU_ADDRESS 0x0000 /* @ECU_Address@VINP_HVBattSOCDis_pct@ */ /end MEASUREMENT
/begin MEASUREMENT VINP_RemainChrgTime_min "" FLOAT32_IEEE SWC_INP_type_CM_single_min 0 0 0.0 4094.0 ECU_ADDRESS 0x0000 /* @ECU_Address@VINP_RemainChrgTime_min@ */ /end MEASUREMENT
/begin MEASUREMENT VINP_CellTempAvg_C "" FLOAT32_IEEE SWC_INP_type_CM_single_C 0 0 -40.0 213.0 ECU_ADDRESS 0x0000 /* @ECU_Address@VINP_CellTempAvg_C@ */ /end MEASUREMENT
/begin MEASUREMENT VINP_HVBCellVoltMax_mV "" FLOAT32_IEEE SWC_INP_type_CM_single_mV 0 0 0.0 65533.0 ECU_ADDRESS 0x0000 /* @ECU_Address@VINP_HVBCellVoltMax_mV@ */ /end MEASUREMENT
/begin MEASUREMENT VINP_HVBCellVoltMin_mV "" FLOAT32_IEEE SWC_INP_type_CM_single_mV 0 0 0.0 65533.0 ECU_ADDRESS 0x0000 /* @ECU_Address@VINP_HVBCellVoltMin_mV@ */ /end MEASUREMENT
/begin MEASUREMENT VINP_HVBMTempMax_C "" FLOAT32_IEEE SWC_INP_type_CM_single_C 0 0 -40.0 213.0 ECU_ADDRESS 0x0000 /* @ECU_Address@VINP_HVBMTempMax_C@ */ /end MEASUREMENT
/begin MEASUREMENT VINP_HVBMTempMin_C "" FLOAT32_IEEE SWC_INP_type_CM_single_C 0 0 -40.0 213.0 ECU_ADDRESS 0x0000 /* @ECU_Address@VINP_HVBMTempMin_C@ */ /end MEASUREMENT
/begin MEASUREMENT VINP_HVInVolt_V "" FLOAT32_IEEE SWC_INP_type_CM_single_V 0 0 0.0 819.0 ECU_ADDRESS 0x0000 /* @ECU_Address@VINP_HVInVolt_V@ */ /end MEASUREMENT
/begin MEASUREMENT VINP_LVBattDet12V_V "" FLOAT32_IEEE SWC_INP_type_CM_single_V 0 0 0.0 25.4 ECU_ADDRESS 0x0000 /* @ECU_Address@VINP_LVBattDet12V_V@ */ /end MEASUREMENT
/begin MEASUREMENT VINP_OBCACCSLimit_A "" FLOAT32_IEEE SWC_INP_type_CM_single_A 0 0 0.0 80.0 ECU_ADDRESS 0x0000 /* @ECU_Address@VINP_OBCACCSLimit_A@ */ /end MEASUREMENT
/begin MEASUREMENT VINP_OBCDCCurLm_A "" FLOAT32_IEEE SWC_INP_type_CM_single_A 0 0 -25.5 76.7 ECU_ADDRESS 0x0000 /* @ECU_Address@VINP_OBCDCCurLm_A@ */ /end MEASUREMENT
/begin MEASUREMENT VINP_OBCDCVoltLm_V "" FLOAT32_IEEE SWC_INP_type_CM_single_V 0 0 0.0 819.0 ECU_ADDRESS 0x0000 /* @ECU_Address@VINP_OBCDCVoltLm_V@ */ /end MEASUREMENT
/begin MEASUREMENT VINP_DCDCAuxCur_A "" FLOAT32_IEEE SWC_INP_type_CM_single_A 0 0 0.0 409.5 ECU_ADDRESS 0x0000 /* @ECU_Address@VINP_DCDCAuxCur_A@ */ /end MEASUREMENT
/begin MEASUREMENT VINP_DCDCAuxVolt_V "" FLOAT32_IEEE SWC_INP_type_CM_single_V 0 0 8.0 19.938 ECU_ADDRESS 0x0000 /* @ECU_Address@VINP_DCDCAuxVolt_V@ */ /end MEASUREMENT
/begin MEASUREMENT VINP_DCDCHVCur_A "" FLOAT32_IEEE SWC_INP_type_CM_single_A 0 0 0.0 20.46 ECU_ADDRESS 0x0000 /* @ECU_Address@VINP_DCDCHVCur_A@ */ /end MEASUREMENT
/begin MEASUREMENT VINP_DCDCInVoltInf_V "" FLOAT32_IEEE SWC_INP_type_CM_single_V 0 0 0.0 1023.5 ECU_ADDRESS 0x0000 /* @ECU_Address@VINP_DCDCInVoltInf_V@ */ /end MEASUREMENT
/begin MEASUREMENT VINP_OBCDCCurrInf_A "" FLOAT32_IEEE SWC_INP_type_CM_single_A 0 0 -25.5 76.7 ECU_ADDRESS 0x0000 /* @ECU_Address@VINP_OBCDCCurrInf_A@ */ /end MEASUREMENT
/begin MEASUREMENT VINP_TFaceRr_C "" FLOAT32_IEEE SWC_INP_type_CM_single_C 0 0 -40.0 85.0 ECU_ADDRESS 0x0000 /* @ECU_Address@VINP_TFaceRr_C@ */ /end MEASUREMENT
/begin MEASUREMENT VINP_TFootL_C "" FLOAT32_IEEE SWC_INP_type_CM_single_C 0 0 -40.0 85.0 ECU_ADDRESS 0x0000 /* @ECU_Address@VINP_TFootL_C@ */ /end MEASUREMENT
/begin MEASUREMENT VINP_TFootR_C "" FLOAT32_IEEE SWC_INP_type_CM_single_C 0 0 -40.0 85.0 ECU_ADDRESS 0x0000 /* @ECU_Address@VINP_TFootR_C@ */ /end MEASUREMENT
/begin MEASUREMENT VINP_TFootRr_C "" FLOAT32_IEEE SWC_INP_type_CM_single_C 0 0 -40.0 85.0 ECU_ADDRESS 0x0000 /* @ECU_Address@VINP_TFootRr_C@ */ /end MEASUREMENT
/begin MEASUREMENT VINP_Tevap_C "" FLOAT32_IEEE SWC_INP_type_CM_single_C 0 0 -40.0 85.0 ECU_ADDRESS 0x0000 /* @ECU_Address@VINP_Tevap_C@ */ /end MEASUREMENT
/begin MEASUREMENT VINP_Tincar_C "" FLOAT32_IEEE SWC_INP_type_CM_single_C 0 0 -40.0 85.0 ECU_ADDRESS 0x0000 /* @ECU_Address@VINP_Tincar_C@ */ /end MEASUREMENT
/begin MEASUREMENT VINP_FLTurnLampC_mA "" FLOAT32_IEEE SWC_INP_type_CM_single_mA 0 0 0.0 2550.0 ECU_ADDRESS 0x0000 /* @ECU_Address@VINP_FLTurnLampC_mA@ */ /end MEASUREMENT
/begin MEASUREMENT VINP_FRTurnLampC_mA "" FLOAT32_IEEE SWC_INP_type_CM_single_mA 0 0 0.0 2550.0 ECU_ADDRESS 0x0000 /* @ECU_Address@VINP_FRTurnLampC_mA@ */ /end MEASUREMENT
/begin MEASUREMENT VINP_ZFRTHCMCLEVentActYSta_pct "" FLOAT32_IEEE SWC_INP_type_CM_single_pct 0 0 0.0 127.0 ECU_ADDRESS 0x0000 /* @ECU_Address@VINP_ZFRTHCMCLEVentActYSta_pct@ */ /end MEASUREMENT
/begin MEASUREMENT VINP_ZFRTHCMCREVentActYSta_pct "" FLOAT32_IEEE SWC_INP_type_CM_single_pct 0 0 0.0 127.0 ECU_ADDRESS 0x0000 /* @ECU_Address@VINP_ZFRTHCMCREVentActYSta_pct@ */ /end MEASUREMENT
/begin MEASUREMENT VINP_ZFRTHCMLEVentActYSta_pct "" FLOAT32_IEEE SWC_INP_type_CM_single_pct 0 0 0.0 127.0 ECU_ADDRESS 0x0000 /* @ECU_Address@VINP_ZFRTHCMLEVentActYSta_pct@ */ /end MEASUREMENT
/begin MEASUREMENT VINP_ZFRTHCMREVentActYSta_pct "" FLOAT32_IEEE SWC_INP_type_CM_single_pct 0 0 0.0 127.0 ECU_ADDRESS 0x0000 /* @ECU_Address@VINP_ZFRTHCMREVentActYSta_pct@ */ /end MEASUREMENT
/begin MEASUREMENT VINP_BatInTemp_C "" FLOAT32_IEEE SWC_INP_type_CM_single_C 0 0 -40.0 85.0 ECU_ADDRESS 0x0000 /* @ECU_Address@VINP_BatInTemp_C@ */ /end MEASUREMENT
/begin MEASUREMENT VINP_BatOutTemp_C "" FLOAT32_IEEE SWC_INP_type_CM_single_C 0 0 -40.0 85.0 ECU_ADDRESS 0x0000 /* @ECU_Address@VINP_BatOutTemp_C@ */ /end MEASUREMENT
/begin MEASUREMENT VINP_MotorInTemp_C "" FLOAT32_IEEE SWC_INP_type_CM_single_C 0 0 -40.0 85.0 ECU_ADDRESS 0x0000 /* @ECU_Address@VINP_MotorInTemp_C@ */ /end MEASUREMENT
/begin MEASUREMENT VINP_MotorOutTemp_C "" FLOAT32_IEEE SWC_INP_type_CM_single_C 0 0 -40.0 85.0 ECU_ADDRESS 0x0000 /* @ECU_Address@VINP_MotorOutTemp_C@ */ /end MEASUREMENT
/begin MEASUREMENT VINP_PTHighP_KPa "" FLOAT32_IEEE SWC_INP_type_CM_single_KPa 0 0 0.0 4000.0 ECU_ADDRESS 0x0000 /* @ECU_Address@VINP_PTHighP_KPa@ */ /end MEASUREMENT
/begin MEASUREMENT VINP_PTHighTact_C "" FLOAT32_IEEE SWC_INP_type_CM_single_C 0 0 -40.0 140.0 ECU_ADDRESS 0x0000 /* @ECU_Address@VINP_PTHighTact_C@ */ /end MEASUREMENT
/begin MEASUREMENT VINP_PTLowP1_KPa "" FLOAT32_IEEE SWC_INP_type_CM_single_KPa 0 0 0.0 4000.0 ECU_ADDRESS 0x0000 /* @ECU_Address@VINP_PTLowP1_KPa@ */ /end MEASUREMENT
/begin MEASUREMENT VINP_PTLowP2_KPa "" FLOAT32_IEEE SWC_INP_type_CM_single_KPa 0 0 0.0 4000.0 ECU_ADDRESS 0x0000 /* @ECU_Address@VINP_PTLowP2_KPa@ */ /end MEASUREMENT
/begin MEASUREMENT VINP_PTLowT1_C "" FLOAT32_IEEE SWC_INP_type_CM_single_C 0 0 -40.0 85.0 ECU_ADDRESS 0x0000 /* @ECU_Address@VINP_PTLowT1_C@ */ /end MEASUREMENT
/begin MEASUREMENT VINP_PTLowT2_C "" FLOAT32_IEEE SWC_INP_type_CM_single_C 0 0 -40.0 85.0 ECU_ADDRESS 0x0000 /* @ECU_Address@VINP_PTLowT2_C@ */ /end MEASUREMENT
/begin MEASUREMENT VINP_Tamb_C "" FLOAT32_IEEE SWC_INP_type_CM_single_C 0 0 -40.0 85.0 ECU_ADDRESS 0x0000 /* @ECU_Address@VINP_Tamb_C@ */ /end MEASUREMENT
/begin MEASUREMENT VINP_FrntPTCLeActHeatPwr_W "" FLOAT32_IEEE SWC_INP_type_CM_single_W 0 0 0.0 6375.0 ECU_ADDRESS 0x0000 /* @ECU_Address@VINP_FrntPTCLeActHeatPwr_W@ */ /end MEASUREMENT
/begin MEASUREMENT VINP_FrntPTCRearLeActHeatPwr_W "" FLOAT32_IEEE SWC_INP_type_CM_single_W 0 0 0.0 6375.0 ECU_ADDRESS 0x0000 /* @ECU_Address@VINP_FrntPTCRearLeActHeatPwr_W@ */ /end MEASUREMENT
/begin MEASUREMENT VINP_FrntPTCRearRiActHeatPwr_W "" FLOAT32_IEEE SWC_INP_type_CM_single_W 0 0 0.0 6375.0 ECU_ADDRESS 0x0000 /* @ECU_Address@VINP_FrntPTCRearRiActHeatPwr_W@ */ /end MEASUREMENT
/begin MEASUREMENT VINP_FrntPTCRiActHeatPwr_W "" FLOAT32_IEEE SWC_INP_type_CM_single_W 0 0 0.0 6375.0 ECU_ADDRESS 0x0000 /* @ECU_Address@VINP_FrntPTCRiActHeatPwr_W@ */ /end MEASUREMENT
/begin MEASUREMENT VINP_COMPActualPwr_W "" FLOAT32_IEEE SWC_INP_type_CM_single_W 0 0 0.0 6000.0 ECU_ADDRESS 0x0000 /* @ECU_Address@VINP_COMPActualPwr_W@ */ /end MEASUREMENT
/begin MEASUREMENT VINP_COMPConCur_A "" FLOAT32_IEEE SWC_INP_type_CM_single_A 0 0 0.0 1310.7 ECU_ADDRESS 0x0000 /* @ECU_Address@VINP_COMPConCur_A@ */ /end MEASUREMENT
/begin MEASUREMENT VINP_COMPConVolt_V "" FLOAT32_IEEE SWC_INP_type_CM_single_V 0 0 0.0 1310.7 ECU_ADDRESS 0x0000 /* @ECU_Address@VINP_COMPConVolt_V@ */ /end MEASUREMENT
/begin MEASUREMENT VINP_COMPStatorSpd_rpm "" FLOAT32_IEEE SWC_INP_type_CM_single_rpm 0 0 0.0 8500.0 ECU_ADDRESS 0x0000 /* @ECU_Address@VINP_COMPStatorSpd_rpm@ */ /end MEASUREMENT
/begin MEASUREMENT VINP_PTC1PowerConsumption_kW "" FLOAT32_IEEE SWC_INP_type_CM_single_kW 0 0 0.0 25.3 ECU_ADDRESS 0x0000 /* @ECU_Address@VINP_PTC1PowerConsumption_kW@ */ /end MEASUREMENT
/begin MEASUREMENT VINP_LDrvValWdwOpened_pct "" FLOAT32_IEEE SWC_INP_type_CM_single_pct 0 0 0.0 100.0 ECU_ADDRESS 0x0000 /* @ECU_Address@VINP_LDrvValWdwOpened_pct@ */ /end MEASUREMENT
/begin MEASUREMENT VINP_LPasValWdwOpened_pct "" FLOAT32_IEEE SWC_INP_type_CM_single_pct 0 0 0.0 100.0 ECU_ADDRESS 0x0000 /* @ECU_Address@VINP_LPasValWdwOpened_pct@ */ /end MEASUREMENT
/begin MEASUREMENT VINP_LRLDValWdwOpened_pct "" FLOAT32_IEEE SWC_INP_type_CM_single_pct 0 0 0.0 100.0 ECU_ADDRESS 0x0000 /* @ECU_Address@VINP_LRLDValWdwOpened_pct@ */ /end MEASUREMENT
/begin MEASUREMENT VINP_LRRDValWdwOpened_pct "" FLOAT32_IEEE SWC_INP_type_CM_single_pct 0 0 0.0 100.0 ECU_ADDRESS 0x0000 /* @ECU_Address@VINP_LRRDValWdwOpened_pct@ */ /end MEASUREMENT
/begin MEASUREMENT VINP_BDAPMWinFOpenedSta_pct "" FLOAT32_IEEE SWC_INP_type_CM_single_pct 0 0 0.0 127.0 ECU_ADDRESS 0x0000 /* @ECU_Address@VINP_BDAPMWinFOpenedSta_pct@ */ /end MEASUREMENT
/begin MEASUREMENT VINP_BDAPMWinROpenedSta_pct "" FLOAT32_IEEE SWC_INP_type_CM_single_pct 0 0 0.0 127.0 ECU_ADDRESS 0x0000 /* @ECU_Address@VINP_BDAPMWinROpenedSta_pct@ */ /end MEASUREMENT
/begin MEASUREMENT VINP_BPPTGOpenRatioSta_pct "" FLOAT32_IEEE SWC_INP_type_CM_single_pct 0 0 0.0 127.0 ECU_ADDRESS 0x0000 /* @ECU_Address@VINP_BPPTGOpenRatioSta_pct@ */ /end MEASUREMENT
/begin MEASUREMENT VINP_BPAPMWinFOpenedSta_pct "" FLOAT32_IEEE SWC_INP_type_CM_single_pct 0 0 0.0 127.0 ECU_ADDRESS 0x0000 /* @ECU_Address@VINP_BPAPMWinFOpenedSta_pct@ */ /end MEASUREMENT
/begin MEASUREMENT VINP_BPAPMWinROpenedSta_pct "" FLOAT32_IEEE SWC_INP_type_CM_single_pct 0 0 0.0 127.0 ECU_ADDRESS 0x0000 /* @ECU_Address@VINP_BPAPMWinROpenedSta_pct@ */ /end MEASUREMENT
/begin MEASUREMENT VINP_PTGOpenRatio_pct "" FLOAT32_IEEE SWC_INP_type_CM_single_pct 0 0 0.0 127.0 ECU_ADDRESS 0x0000 /* @ECU_Address@VINP_PTGOpenRatio_pct@ */ /end MEASUREMENT
/begin MEASUREMENT VINP_RLTurnLampC_mA "" FLOAT32_IEEE SWC_INP_type_CM_single_mA 0 0 0.0 2550.0 ECU_ADDRESS 0x0000 /* @ECU_Address@VINP_RLTurnLampC_mA@ */ /end MEASUREMENT
/begin MEASUREMENT VINP_RRTurnLampC_mA "" FLOAT32_IEEE SWC_INP_type_CM_single_mA 0 0 0.0 2550.0 ECU_ADDRESS 0x0000 /* @ECU_Address@VINP_RRTurnLampC_mA@ */ /end MEASUREMENT
/begin MEASUREMENT VINP_SolarL_W "" FLOAT32_IEEE SWC_INP_type_CM_single_W 0 0 0.0 1265.0 ECU_ADDRESS 0x0000 /* @ECU_Address@VINP_SolarL_W@ */ /end MEASUREMENT
/begin MEASUREMENT VINP_SolarR_W "" FLOAT32_IEEE SWC_INP_type_CM_single_W 0 0 0.0 1265.0 ECU_ADDRESS 0x0000 /* @ECU_Address@VINP_SolarR_W@ */ /end MEASUREMENT
/begin MEASUREMENT VINP_TFaceL_C "" FLOAT32_IEEE SWC_INP_type_CM_single_C 0 0 -40.0 85.0 ECU_ADDRESS 0x0000 /* @ECU_Address@VINP_TFaceL_C@ */ /end MEASUREMENT
/begin MEASUREMENT VINP_TFaceR_C "" FLOAT32_IEEE SWC_INP_type_CM_single_C 0 0 -40.0 85.0 ECU_ADDRESS 0x0000 /* @ECU_Address@VINP_TFaceR_C@ */ /end MEASUREMENT
/begin MEASUREMENT VINP_TimeSyncFromBSDay_DAY "" FLOAT32_IEEE SWC_INP_type_CM_single_DAY 0 0 0.0 31.0 ECU_ADDRESS 0x0000 /* @ECU_Address@VINP_TimeSyncFromBSDay_DAY@ */ /end MEASUREMENT
/begin MEASUREMENT VINP_ReserveChargeOFFDay_DAY "" FLOAT32_IEEE SWC_INP_type_CM_single_DAY 0 0 0.0 31.0 ECU_ADDRESS 0x0000 /* @ECU_Address@VINP_ReserveChargeOFFDay_DAY@ */ /end MEASUREMENT
/begin MEASUREMENT VINP_ReserveChargeOFFHour_hr "" FLOAT32_IEEE SWC_INP_type_CM_single_hr 0 0 0.0 23.0 ECU_ADDRESS 0x0000 /* @ECU_Address@VINP_ReserveChargeOFFHour_hr@ */ /end MEASUREMENT
/begin MEASUREMENT VINP_ReserveChargeOFFMinute_min "" FLOAT32_IEEE SWC_INP_type_CM_single_min 0 0 0.0 59.0 ECU_ADDRESS 0x0000 /* @ECU_Address@VINP_ReserveChargeOFFMinute_min@ */ /end MEASUREMENT
/begin MEASUREMENT VINP_ReserveChargeOFFMonth_MONTH "" FLOAT32_IEEE SWC_INP_type_CM_single_MONTH 0 0 0.0 12.0 ECU_ADDRESS 0x0000 /* @ECU_Address@VINP_ReserveChargeOFFMonth_MONTH@ */ /end MEASUREMENT
/begin MEASUREMENT VINP_ReserveChargeOFFYear_YEAR "" FLOAT32_IEEE SWC_INP_type_CM_single_YEAR 0 0 2000.0 2099.0 ECU_ADDRESS 0x0000 /* @ECU_Address@VINP_ReserveChargeOFFYear_YEAR@ */ /end MEASUREMENT
/begin MEASUREMENT VINP_ReserveChargeOnDay_DAY "" FLOAT32_IEEE SWC_INP_type_CM_single_DAY 0 0 0.0 31.0 ECU_ADDRESS 0x0000 /* @ECU_Address@VINP_ReserveChargeOnDay_DAY@ */ /end MEASUREMENT
/begin MEASUREMENT VINP_ReserveChargeOnHour_hr "" FLOAT32_IEEE SWC_INP_type_CM_single_hr 0 0 0.0 23.0 ECU_ADDRESS 0x0000 /* @ECU_Address@VINP_ReserveChargeOnHour_hr@ */ /end MEASUREMENT
/begin MEASUREMENT VINP_ReserveChargeOnMinute_min "" FLOAT32_IEEE SWC_INP_type_CM_single_min 0 0 0.0 59.0 ECU_ADDRESS 0x0000 /* @ECU_Address@VINP_ReserveChargeOnMinute_min@ */ /end MEASUREMENT
/begin MEASUREMENT VINP_ReserveChargeOnMonth_MONTH "" FLOAT32_IEEE SWC_INP_type_CM_single_MONTH 0 0 0.0 12.0 ECU_ADDRESS 0x0000 /* @ECU_Address@VINP_ReserveChargeOnMonth_MONTH@ */ /end MEASUREMENT
/begin MEASUREMENT VINP_ReserveChargeOnYear_YEAR "" FLOAT32_IEEE SWC_INP_type_CM_single_YEAR 0 0 2000.0 2099.0 ECU_ADDRESS 0x0000 /* @ECU_Address@VINP_ReserveChargeOnYear_YEAR@ */ /end MEASUREMENT
/begin MEASUREMENT VINP_TimeSyncFromBSHour_hr "" FLOAT32_IEEE SWC_INP_type_CM_single_hr 0 0 0.0 23.0 ECU_ADDRESS 0x0000 /* @ECU_Address@VINP_TimeSyncFromBSHour_hr@ */ /end MEASUREMENT
/begin MEASUREMENT VINP_TimeSyncFromBSMinute_min "" FLOAT32_IEEE SWC_INP_type_CM_single_min 0 0 0.0 59.0 ECU_ADDRESS 0x0000 /* @ECU_Address@VINP_TimeSyncFromBSMinute_min@ */ /end MEASUREMENT
/begin MEASUREMENT VINP_TimeSyncFromBSMonth_MONTH "" FLOAT32_IEEE SWC_INP_type_CM_single_MONTH 0 0 0.0 12.0 ECU_ADDRESS 0x0000 /* @ECU_Address@VINP_TimeSyncFromBSMonth_MONTH@ */ /end MEASUREMENT
/begin MEASUREMENT VINP_TimeSyncFromBSSecond_s "" FLOAT32_IEEE SWC_INP_type_CM_single_s 0 0 0.0 59.0 ECU_ADDRESS 0x0000 /* @ECU_Address@VINP_TimeSyncFromBSSecond_s@ */ /end MEASUREMENT
/begin MEASUREMENT VINP_TimeSyncFromBSYear_YEAR "" FLOAT32_IEEE SWC_INP_type_CM_single_YEAR 0 0 2000.0 2099.0 ECU_ADDRESS 0x0000 /* @ECU_Address@VINP_TimeSyncFromBSYear_YEAR@ */ /end MEASUREMENT
/begin MEASUREMENT VINP_ChargePercentSet_pct "" FLOAT32_IEEE SWC_INP_type_CM_single_pct 0 0 0.0 100.0 ECU_ADDRESS 0x0000 /* @ECU_Address@VINP_ChargePercentSet_pct@ */ /end MEASUREMENT
/begin MEASUREMENT VINP_ACCComfortBandLower_mps2 "" FLOAT32_IEEE SWC_INP_type_CM_single_mps2 0 0 -15.0 10.55 ECU_ADDRESS 0x0000 /* @ECU_Address@VINP_ACCComfortBandLower_mps2@ */ /end MEASUREMENT
/begin MEASUREMENT VINP_ACCObjDist_m "" FLOAT32_IEEE SWC_INP_type_CM_single_m 0 0 0.0 204.6 ECU_ADDRESS 0x0000 /* @ECU_Address@VINP_ACCObjDist_m@ */ /end MEASUREMENT
/begin MEASUREMENT VINP_ACCObjRelSpd_mps "" FLOAT32_IEEE SWC_INP_type_CM_single_mps 0 0 -100.0 104.6 ECU_ADDRESS 0x0000 /* @ECU_Address@VINP_ACCObjRelSpd_mps@ */ /end MEASUREMENT
/begin MEASUREMENT VINP_ACCRequiredAccel_mps2 "" FLOAT32_IEEE SWC_INP_type_CM_single_mps2 0 0 -15.0 10.55 ECU_ADDRESS 0x0000 /* @ECU_Address@VINP_ACCRequiredAccel_mps2@ */ /end MEASUREMENT
/begin MEASUREMENT VINP_ADASLanecurveL_raw32 "" FLOAT32_IEEE SWC_INP_type_CM_single_raw32 0 0 -0.03 0.03 ECU_ADDRESS 0x0000 /* @ECU_Address@VINP_ADASLanecurveL_raw32@ */ /end MEASUREMENT
/begin MEASUREMENT VINP_ADASLanecurveR_raw32 "" FLOAT32_IEEE SWC_INP_type_CM_single_raw32 0 0 -0.03 0.03 ECU_ADDRESS 0x0000 /* @ECU_Address@VINP_ADASLanecurveR_raw32@ */ /end MEASUREMENT
/begin MEASUREMENT VINP_FCMLKAStrToqReq_Nm "" FLOAT32_IEEE SWC_INP_type_CM_single_Nm 0 0 -8.0 8.0 ECU_ADDRESS 0x0000 /* @ECU_Address@VINP_FCMLKAStrToqReq_Nm@ */ /end MEASUREMENT
/begin MEASUREMENT VINP_ACCComfortBandUpper_mps2 "" FLOAT32_IEEE SWC_INP_type_CM_single_mps2 0 0 -15.0 10.55 ECU_ADDRESS 0x0000 /* @ECU_Address@VINP_ACCComfortBandUpper_mps2@ */ /end MEASUREMENT
/begin MEASUREMENT VINP_MELaneCurvDervLt_raw32 "" FLOAT32_IEEE SWC_INP_type_CM_single_raw32 0 0 -0.00013 0.00013214 ECU_ADDRESS 0x0000 /* @ECU_Address@VINP_MELaneCurvDervLt_raw32@ */ /end MEASUREMENT
/begin MEASUREMENT VINP_MELaneCurvDervLt2_raw32 "" FLOAT32_IEEE SWC_INP_type_CM_single_raw32 0 0 -0.00013 0.00013214 ECU_ADDRESS 0x0000 /* @ECU_Address@VINP_MELaneCurvDervLt2_raw32@ */ /end MEASUREMENT
/begin MEASUREMENT VINP_MELaneCurvDervRt_raw32 "" FLOAT32_IEEE SWC_INP_type_CM_single_raw32 0 0 -0.00013 0.00013214 ECU_ADDRESS 0x0000 /* @ECU_Address@VINP_MELaneCurvDervRt_raw32@ */ /end MEASUREMENT
/begin MEASUREMENT VINP_MELaneCurvDervRt2_raw32 "" FLOAT32_IEEE SWC_INP_type_CM_single_raw32 0 0 -0.00013 0.00013214 ECU_ADDRESS 0x0000 /* @ECU_Address@VINP_MELaneCurvDervRt2_raw32@ */ /end MEASUREMENT
/begin MEASUREMENT VINP_MELaneCurvLt_raw32 "" FLOAT32_IEEE SWC_INP_type_CM_single_raw32 0 0 -0.032 0.033535 ECU_ADDRESS 0x0000 /* @ECU_Address@VINP_MELaneCurvLt_raw32@ */ /end MEASUREMENT
/begin MEASUREMENT VINP_MELaneCurvLt2_raw32 "" FLOAT32_IEEE SWC_INP_type_CM_single_raw32 0 0 -0.032 0.033535 ECU_ADDRESS 0x0000 /* @ECU_Address@VINP_MELaneCurvLt2_raw32@ */ /end MEASUREMENT
/begin MEASUREMENT VINP_MELaneCurvRt_raw32 "" FLOAT32_IEEE SWC_INP_type_CM_single_raw32 0 0 -0.032 0.033535 ECU_ADDRESS 0x0000 /* @ECU_Address@VINP_MELaneCurvRt_raw32@ */ /end MEASUREMENT
/begin MEASUREMENT VINP_MELaneCurvRt2_raw32 "" FLOAT32_IEEE SWC_INP_type_CM_single_raw32 0 0 -0.032 0.033535 ECU_ADDRESS 0x0000 /* @ECU_Address@VINP_MELaneCurvRt2_raw32@ */ /end MEASUREMENT
/begin MEASUREMENT VINP_MELaneHeadAngLt_radians "" FLOAT32_IEEE SWC_INP_type_CM_single_radians 0 0 -0.5 0.523 ECU_ADDRESS 0x0000 /* @ECU_Address@VINP_MELaneHeadAngLt_radians@ */ /end MEASUREMENT
/begin MEASUREMENT VINP_MELaneHeadAngLt2_radians "" FLOAT32_IEEE SWC_INP_type_CM_single_radians 0 0 -0.5 0.523 ECU_ADDRESS 0x0000 /* @ECU_Address@VINP_MELaneHeadAngLt2_radians@ */ /end MEASUREMENT
/begin MEASUREMENT VINP_ACCJerkLowerLimit_mps3 "" FLOAT32_IEEE SWC_INP_type_CM_single_mps3 0 0 -6.0 6.7 ECU_ADDRESS 0x0000 /* @ECU_Address@VINP_ACCJerkLowerLimit_mps3@ */ /end MEASUREMENT
/begin MEASUREMENT VINP_MELaneHeadAngRt_radians "" FLOAT32_IEEE SWC_INP_type_CM_single_radians 0 0 -0.5 0.523 ECU_ADDRESS 0x0000 /* @ECU_Address@VINP_MELaneHeadAngRt_radians@ */ /end MEASUREMENT
/begin MEASUREMENT VINP_MELaneHeadAngRt2_radians "" FLOAT32_IEEE SWC_INP_type_CM_single_radians 0 0 -0.5 0.523 ECU_ADDRESS 0x0000 /* @ECU_Address@VINP_MELaneHeadAngRt2_radians@ */ /end MEASUREMENT
/begin MEASUREMENT VINP_MELanePosLt_m "" FLOAT32_IEEE SWC_INP_type_CM_single_m 0 0 -10.0 10.47 ECU_ADDRESS 0x0000 /* @ECU_Address@VINP_MELanePosLt_m@ */ /end MEASUREMENT
/begin MEASUREMENT VINP_MELanePosLt2_m "" FLOAT32_IEEE SWC_INP_type_CM_single_m 0 0 -10.0 10.47 ECU_ADDRESS 0x0000 /* @ECU_Address@VINP_MELanePosLt2_m@ */ /end MEASUREMENT
/begin MEASUREMENT VINP_MELanePosRt_m "" FLOAT32_IEEE SWC_INP_type_CM_single_m 0 0 -10.0 10.47 ECU_ADDRESS 0x0000 /* @ECU_Address@VINP_MELanePosRt_m@ */ /end MEASUREMENT
/begin MEASUREMENT VINP_MELanePosRt2_m "" FLOAT32_IEEE SWC_INP_type_CM_single_m 0 0 -10.0 10.47 ECU_ADDRESS 0x0000 /* @ECU_Address@VINP_MELanePosRt2_m@ */ /end MEASUREMENT
/begin MEASUREMENT VINP_ADASAngCtrlTqWeightGain_pct "" FLOAT32_IEEE SWC_INP_type_CM_single_pct 0 0 0.0 102.0 ECU_ADDRESS 0x0000 /* @ECU_Address@VINP_ADASAngCtrlTqWeightGain_pct@ */ /end MEASUREMENT
/begin MEASUREMENT VINP_ADASDesStrWhlAngCtrlCmd_Deg "" FLOAT32_IEEE SWC_INP_type_CM_single_Deg 0 0 -900.0 900.0 ECU_ADDRESS 0x0000 /* @ECU_Address@VINP_ADASDesStrWhlAngCtrlCmd_Deg@ */ /end MEASUREMENT
/begin MEASUREMENT VINP_ACCJerkUpperLimit_mps3 "" FLOAT32_IEEE SWC_INP_type_CM_single_mps3 0 0 -6.0 6.7 ECU_ADDRESS 0x0000 /* @ECU_Address@VINP_ACCJerkUpperLimit_mps3@ */ /end MEASUREMENT
/begin MEASUREMENT VINP_ADASDrvInputTqBoostGain_pct "" FLOAT32_IEEE SWC_INP_type_CM_single_pct 0 0 0.0 102.0 ECU_ADDRESS 0x0000 /* @ECU_Address@VINP_ADASDrvInputTqBoostGain_pct@ */ /end MEASUREMENT
/begin MEASUREMENT VINP_ADASMaxAngCtrlOutTqLimit_Nm "" FLOAT32_IEEE SWC_INP_type_CM_single_Nm 0 0 0.0 51.1 ECU_ADDRESS 0x0000 /* @ECU_Address@VINP_ADASMaxAngCtrlOutTqLimit_Nm@ */ /end MEASUREMENT
/begin MEASUREMENT VINP_AuxBattVolmV_mV "" UWORD SWC_INP_type_CM_uint16_mV 0 0 0.0 65535.0 ECU_ADDRESS 0x0000 /* @ECU_Address@VINP_AuxBattVolmV_mV@ */ /end MEASUREMENT
/begin MEASUREMENT VINP_ReDoorLock_enum "" UWORD SWC_INP_type_CM_uint16_enum 0 0 0.0 65535.0 ECU_ADDRESS 0x0000 /* @ECU_Address@VINP_ReDoorLock_enum@ */ /end MEASUREMENT
/begin MEASUREMENT VINP_FrMCUHWVer_enum "" UWORD SWC_INP_type_CM_uint16_enum 0 0 0.0 65535.0 ECU_ADDRESS 0x0000 /* @ECU_Address@VINP_FrMCUHWVer_enum@ */ /end MEASUREMENT
/begin MEASUREMENT VINP_FrMCUSWVer_enum "" UWORD SWC_INP_type_CM_uint16_enum 0 0 0.0 65535.0 ECU_ADDRESS 0x0000 /* @ECU_Address@VINP_FrMCUSWVer_enum@ */ /end MEASUREMENT
/begin MEASUREMENT VINP_RrMCU3HWVer_enum "" UWORD SWC_INP_type_CM_uint16_enum 0 0 0.0 65535.0 ECU_ADDRESS 0x0000 /* @ECU_Address@VINP_RrMCU3HWVer_enum@ */ /end MEASUREMENT
/begin MEASUREMENT VINP_RrMCU3SWVer_enum "" UWORD SWC_INP_type_CM_uint16_enum 0 0 0.0 65535.0 ECU_ADDRESS 0x0000 /* @ECU_Address@VINP_RrMCU3SWVer_enum@ */ /end MEASUREMENT
/begin MEASUREMENT VINP_FrMCUHWVerNidec_enum "" UWORD SWC_INP_type_CM_uint16_enum 0 0 0.0 65535.0 ECU_ADDRESS 0x0000 /* @ECU_Address@VINP_FrMCUHWVerNidec_enum@ */ /end MEASUREMENT
/begin MEASUREMENT VINP_FrMCUSWVerNidec_enum "" UWORD SWC_INP_type_CM_uint16_enum 0 0 0.0 65535.0 ECU_ADDRESS 0x0000 /* @ECU_Address@VINP_FrMCUSWVerNidec_enum@ */ /end MEASUREMENT
/begin MEASUREMENT VINP_RrMCU3HWVerNidec_enum "" UWORD SWC_INP_type_CM_uint16_enum 0 0 0.0 65535.0 ECU_ADDRESS 0x0000 /* @ECU_Address@VINP_RrMCU3HWVerNidec_enum@ */ /end MEASUREMENT
/begin MEASUREMENT VINP_RrMCU3SWVerNidec_enum "" UWORD SWC_INP_type_CM_uint16_enum 0 0 0.0 65535.0 ECU_ADDRESS 0x0000 /* @ECU_Address@VINP_RrMCU3SWVerNidec_enum@ */ /end MEASUREMENT
/begin MEASUREMENT VINP_DSEATHWVer_enum "" UWORD SWC_INP_type_CM_uint16_enum 0 0 0.0 65535.0 ECU_ADDRESS 0x0000 /* @ECU_Address@VINP_DSEATHWVer_enum@ */ /end MEASUREMENT
/begin MEASUREMENT VINP_DSEATSWVer_enum "" UWORD SWC_INP_type_CM_uint16_enum 0 0 0.0 65535.0 ECU_ADDRESS 0x0000 /* @ECU_Address@VINP_DSEATSWVer_enum@ */ /end MEASUREMENT
/begin MEASUREMENT VINP_PSEATHWVer_enum "" UWORD SWC_INP_type_CM_uint16_enum 0 0 0.0 65535.0 ECU_ADDRESS 0x0000 /* @ECU_Address@VINP_PSEATHWVer_enum@ */ /end MEASUREMENT
/begin MEASUREMENT VINP_PSEATSWVer_enum "" UWORD SWC_INP_type_CM_uint16_enum 0 0 0.0 65535.0 ECU_ADDRESS 0x0000 /* @ECU_Address@VINP_PSEATSWVer_enum@ */ /end MEASUREMENT
/begin MEASUREMENT VINP_BPPTGLeftHallPosnSta_enum "" UWORD SWC_INP_type_CM_uint16_enum 0 0 0.0 1023.0 ECU_ADDRESS 0x0000 /* @ECU_Address@VINP_BPPTGLeftHallPosnSta_enum@ */ /end MEASUREMENT
/begin MEASUREMENT VINP_LeftHallPos_enum "" UWORD SWC_INP_type_CM_uint16_enum 0 0 0.0 4095.0 ECU_ADDRESS 0x0000 /* @ECU_Address@VINP_LeftHallPos_enum@ */ /end MEASUREMENT
/begin MEASUREMENT VINP_KeyFobAreaU16_enum "" UWORD SWC_INP_type_CM_uint16_enum 0 0 0.0 65535.0 ECU_ADDRESS 0x0000 /* @ECU_Address@VINP_KeyFobAreaU16_enum@ */ /end MEASUREMENT
/begin MEASUREMENT VINP_UIDBatVoltx1000_V "" UWORD SWC_INP_type_CM_uint16_V 0 0 0.0 65535.0 ECU_ADDRESS 0x0000 /* @ECU_Address@VINP_UIDBatVoltx1000_V@ */ /end MEASUREMENT
/begin MEASUREMENT VINP_UWB1Distance_cm "" UWORD SWC_INP_type_CM_uint16_cm 0 0 0.0 65535.0 ECU_ADDRESS 0x0000 /* @ECU_Address@VINP_UWB1Distance_cm@ */ /end MEASUREMENT
/begin MEASUREMENT VINP_UWB2Distance_cm "" UWORD SWC_INP_type_CM_uint16_cm 0 0 0.0 65535.0 ECU_ADDRESS 0x0000 /* @ECU_Address@VINP_UWB2Distance_cm@ */ /end MEASUREMENT
/begin MEASUREMENT VINP_UWB3Distance_cm "" UWORD SWC_INP_type_CM_uint16_cm 0 0 0.0 65535.0 ECU_ADDRESS 0x0000 /* @ECU_Address@VINP_UWB3Distance_cm@ */ /end MEASUREMENT
/begin MEASUREMENT VINP_UWB4Distance_cm "" UWORD SWC_INP_type_CM_uint16_cm 0 0 0.0 65535.0 ECU_ADDRESS 0x0000 /* @ECU_Address@VINP_UWB4Distance_cm@ */ /end MEASUREMENT
/begin MEASUREMENT VINP_UWB5Distance_cm "" UWORD SWC_INP_type_CM_uint16_cm 0 0 0.0 65535.0 ECU_ADDRESS 0x0000 /* @ECU_Address@VINP_UWB5Distance_cm@ */ /end MEASUREMENT
/begin MEASUREMENT VINP_UWBpositionX_cm "" SWORD SWC_INP_type_CM_int16_cm 0 0 -32728.0 32767.0 ECU_ADDRESS 0x0000 /* @ECU_Address@VINP_UWBpositionX_cm@ */ /end MEASUREMENT
/begin MEASUREMENT VINP_UWBpositionY_cm "" SWORD SWC_INP_type_CM_int16_cm 0 0 -32728.0 32767.0 ECU_ADDRESS 0x0000 /* @ECU_Address@VINP_UWBpositionY_cm@ */ /end MEASUREMENT
/begin MEASUREMENT VINP_MemOffsetGyroX_raw16 "" SWORD SWC_INP_type_CM_int16_raw16 0 0 -32768.0 32767.0 ECU_ADDRESS 0x0000 /* @ECU_Address@VINP_MemOffsetGyroX_raw16@ */ /end MEASUREMENT
/begin MEASUREMENT VINP_MemOffsetGyroY_raw16 "" SWORD SWC_INP_type_CM_int16_raw16 0 0 -32768.0 32767.0 ECU_ADDRESS 0x0000 /* @ECU_Address@VINP_MemOffsetGyroY_raw16@ */ /end MEASUREMENT
/begin MEASUREMENT VINP_MemOffsetGyroZ_raw16 "" SWORD SWC_INP_type_CM_int16_raw16 0 0 -32768.0 32767.0 ECU_ADDRESS 0x0000 /* @ECU_Address@VINP_MemOffsetGyroZ_raw16@ */ /end MEASUREMENT
/begin MEASUREMENT VINP_MemOffsetAccX_raw16 "" SWORD SWC_INP_type_CM_int16_raw16 0 0 -32768.0 32767.0 ECU_ADDRESS 0x0000 /* @ECU_Address@VINP_MemOffsetAccX_raw16@ */ /end MEASUREMENT
/begin MEASUREMENT VINP_MemOffsetAccY_raw16 "" SWORD SWC_INP_type_CM_int16_raw16 0 0 -32768.0 32767.0 ECU_ADDRESS 0x0000 /* @ECU_Address@VINP_MemOffsetAccY_raw16@ */ /end MEASUREMENT
/begin MEASUREMENT VINP_MemOffsetAccZ_raw16 "" SWORD SWC_INP_type_CM_int16_raw16 0 0 -32768.0 32767.0 ECU_ADDRESS 0x0000 /* @ECU_Address@VINP_MemOffsetAccZ_raw16@ */ /end MEASUREMENT
/begin MEASUREMENT VINP_SensingGyroX_raw16 "" SWORD SWC_INP_type_CM_int16_raw16 0 0 -32768.0 32767.0 ECU_ADDRESS 0x0000 /* @ECU_Address@VINP_SensingGyroX_raw16@ */ /end MEASUREMENT
/begin MEASUREMENT VINP_SensingGyroY_raw16 "" SWORD SWC_INP_type_CM_int16_raw16 0 0 -32768.0 32767.0 ECU_ADDRESS 0x0000 /* @ECU_Address@VINP_SensingGyroY_raw16@ */ /end MEASUREMENT
/begin MEASUREMENT VINP_SensingGyroZ_raw16 "" SWORD SWC_INP_type_CM_int16_raw16 0 0 -32768.0 32767.0 ECU_ADDRESS 0x0000 /* @ECU_Address@VINP_SensingGyroZ_raw16@ */ /end MEASUREMENT
/begin MEASUREMENT VINP_SensingAccX_raw16 "" SWORD SWC_INP_type_CM_int16_raw16 0 0 -32768.0 32767.0 ECU_ADDRESS 0x0000 /* @ECU_Address@VINP_SensingAccX_raw16@ */ /end MEASUREMENT
/begin MEASUREMENT VINP_SensingAccY_raw16 "" SWORD SWC_INP_type_CM_int16_raw16 0 0 -32768.0 32767.0 ECU_ADDRESS 0x0000 /* @ECU_Address@VINP_SensingAccY_raw16@ */ /end MEASUREMENT
/begin MEASUREMENT VINP_SensingAccZ_raw16 "" SWORD SWC_INP_type_CM_int16_raw16 0 0 -32768.0 32767.0 ECU_ADDRESS 0x0000 /* @ECU_Address@VINP_SensingAccZ_raw16@ */ /end MEASUREMENT
/begin MEASUREMENT VINP_CbnPreACEnaReq_enum "" UBYTE SWC_INP_type_CM_uint8_enum 0 0 0.0 255.0 ECU_ADDRESS 0x0000 /* @ECU_Address@VINP_CbnPreACEnaReq_enum@ */ /end MEASUREMENT
/begin MEASUREMENT VINP_ReOutsideMirror_enum "" UBYTE SWC_INP_type_CM_uint8_enum 0 0 0.0 255.0 ECU_ADDRESS 0x0000 /* @ECU_Address@VINP_ReOutsideMirror_enum@ */ /end MEASUREMENT
/begin MEASUREMENT VINP_RePwrReqTbox_enum "" UBYTE SWC_INP_type_CM_uint8_enum 0 0 0.0 255.0 ECU_ADDRESS 0x0000 /* @ECU_Address@VINP_RePwrReqTbox_enum@ */ /end MEASUREMENT
/begin MEASUREMENT VINP_TBOXRemotePW_enum "" UBYTE SWC_INP_type_CM_uint8_enum 0 0 0.0 255.0 ECU_ADDRESS 0x0000 /* @ECU_Address@VINP_TBOXRemotePW_enum@ */ /end MEASUREMENT
/begin MEASUREMENT VINP_FDCConnDrvWdwCtrlCmd_pct "" UBYTE SWC_INP_type_CM_uint8_pct 0 0 0.0 255.0 ECU_ADDRESS 0x0000 /* @ECU_Address@VINP_FDCConnDrvWdwCtrlCmd_pct@ */ /end MEASUREMENT
/begin MEASUREMENT VINP_FDCConnPasWdwCtrlCmd_pct "" UBYTE SWC_INP_type_CM_uint8_pct 0 0 0.0 255.0 ECU_ADDRESS 0x0000 /* @ECU_Address@VINP_FDCConnPasWdwCtrlCmd_pct@ */ /end MEASUREMENT
/begin MEASUREMENT VINP_FDCConnRLDWdwCtrlCmd_pct "" UBYTE SWC_INP_type_CM_uint8_pct 0 0 0.0 255.0 ECU_ADDRESS 0x0000 /* @ECU_Address@VINP_FDCConnRLDWdwCtrlCmd_pct@ */ /end MEASUREMENT
/begin MEASUREMENT VINP_FDCConnRRDWdwCtrlCmd_pct "" UBYTE SWC_INP_type_CM_uint8_pct 0 0 0.0 255.0 ECU_ADDRESS 0x0000 /* @ECU_Address@VINP_FDCConnRRDWdwCtrlCmd_pct@ */ /end MEASUREMENT
/begin MEASUREMENT VINP_OBCPreCompleted_enum "" UBYTE SWC_INP_type_CM_uint8_enum 0 0 0.0 2.0 ECU_ADDRESS 0x0000 /* @ECU_Address@VINP_OBCPreCompleted_enum@ */ /end MEASUREMENT
/begin MEASUREMENT VINP_RCCCU1_enum "" UBYTE SWC_INP_type_CM_uint8_enum 0 0 0.0 14.0 ECU_ADDRESS 0x0000 /* @ECU_Address@VINP_RCCCU1_enum@ */ /end MEASUREMENT
/begin MEASUREMENT VINP_CSCCU2_enum "" UBYTE SWC_INP_type_CM_uint8_enum 0 0 0.0 255.0 ECU_ADDRESS 0x0000 /* @ECU_Address@VINP_CSCCU2_enum@ */ /end MEASUREMENT
/begin MEASUREMENT VINP_DCDCFaultSta_enum "" UBYTE SWC_INP_type_CM_uint8_enum 0 0 0.0 3.0 ECU_ADDRESS 0x0000 /* @ECU_Address@VINP_DCDCFaultSta_enum@ */ /end MEASUREMENT
/begin MEASUREMENT VINP_OBCFaultSta_enum "" UBYTE SWC_INP_type_CM_uint8_enum 0 0 0.0 3.0 ECU_ADDRESS 0x0000 /* @ECU_Address@VINP_OBCFaultSta_enum@ */ /end MEASUREMENT
/begin MEASUREMENT VINP_OBCV2LSta_enum "" UBYTE SWC_INP_type_CM_uint8_enum 0 0 0.0 2.0 ECU_ADDRESS 0x0000 /* @ECU_Address@VINP_OBCV2LSta_enum@ */ /end MEASUREMENT
/begin MEASUREMENT VINP_OBCACCurLim_enum "" UBYTE SWC_INP_type_CM_uint8_enum 0 0 0.0 3.0 ECU_ADDRESS 0x0000 /* @ECU_Address@VINP_OBCACCurLim_enum@ */ /end MEASUREMENT
/begin MEASUREMENT VINP_RCCCU2_enum "" UBYTE SWC_INP_type_CM_uint8_enum 0 0 0.0 14.0 ECU_ADDRESS 0x0000 /* @ECU_Address@VINP_RCCCU2_enum@ */ /end MEASUREMENT
/begin MEASUREMENT VINP_EBMErrSta_enum "" UBYTE SWC_INP_type_CM_uint8_enum 0 0 0.0 2.0 ECU_ADDRESS 0x0000 /* @ECU_Address@VINP_EBMErrSta_enum@ */ /end MEASUREMENT
/begin MEASUREMENT VINP_EBMRLampSta_enum "" UBYTE SWC_INP_type_CM_uint8_enum 0 0 0.0 2.0 ECU_ADDRESS 0x0000 /* @ECU_Address@VINP_EBMRLampSta_enum@ */ /end MEASUREMENT
/begin MEASUREMENT VINP_FrEDURotateDirction_enum "" UBYTE SWC_INP_type_CM_uint8_enum 0 0 0.0 2.0 ECU_ADDRESS 0x0000 /* @ECU_Address@VINP_FrEDURotateDirction_enum@ */ /end MEASUREMENT
/begin MEASUREMENT VINP_FrMCU1Chksum_enum "" UBYTE SWC_INP_type_CM_uint8_enum 0 0 0.0 255.0 ECU_ADDRESS 0x0000 /* @ECU_Address@VINP_FrMCU1Chksum_enum@ */ /end MEASUREMENT
/begin MEASUREMENT VINP_FrMCU1RolCnt_enum "" UBYTE SWC_INP_type_CM_uint8_enum 0 0 0.0 14.0 ECU_ADDRESS 0x0000 /* @ECU_Address@VINP_FrMCU1RolCnt_enum@ */ /end MEASUREMENT
/begin MEASUREMENT VINP_FrMCUErr_enum "" UBYTE SWC_INP_type_CM_uint8_enum 0 0 0.0 255.0 ECU_ADDRESS 0x0000 /* @ECU_Address@VINP_FrMCUErr_enum@ */ /end MEASUREMENT
/begin MEASUREMENT VINP_FrMCUSysSta_enum "" UBYTE SWC_INP_type_CM_uint8_enum 0 0 0.0 15.0 ECU_ADDRESS 0x0000 /* @ECU_Address@VINP_FrMCUSysSta_enum@ */ /end MEASUREMENT
/begin MEASUREMENT VINP_MCUWarnF_enum "" UBYTE SWC_INP_type_CM_uint8_enum 0 0 0.0 7.0 ECU_ADDRESS 0x0000 /* @ECU_Address@VINP_MCUWarnF_enum@ */ /end MEASUREMENT
/begin MEASUREMENT VINP_FrFailcode1_enum "" UBYTE SWC_INP_type_CM_uint8_enum 0 0 0.0 255.0 ECU_ADDRESS 0x0000 /* @ECU_Address@VINP_FrFailcode1_enum@ */ /end MEASUREMENT
/begin MEASUREMENT VINP_FrFailcode2_enum "" UBYTE SWC_INP_type_CM_uint8_enum 0 0 0.0 255.0 ECU_ADDRESS 0x0000 /* @ECU_Address@VINP_FrFailcode2_enum@ */ /end MEASUREMENT
/begin MEASUREMENT VINP_FrFailcodehistory1_enum "" UBYTE SWC_INP_type_CM_uint8_enum 0 0 0.0 2.0 ECU_ADDRESS 0x0000 /* @ECU_Address@VINP_FrFailcodehistory1_enum@ */ /end MEASUREMENT
/begin MEASUREMENT VINP_FrFailcodehistory2_enum "" UBYTE SWC_INP_type_CM_uint8_enum 0 0 0.0 2.0 ECU_ADDRESS 0x0000 /* @ECU_Address@VINP_FrFailcodehistory2_enum@ */ /end MEASUREMENT
/begin MEASUREMENT VINP_FrMCUTempWarn_enum "" UBYTE SWC_INP_type_CM_uint8_enum 0 0 0.0 3.0 ECU_ADDRESS 0x0000 /* @ECU_Address@VINP_FrMCUTempWarn_enum@ */ /end MEASUREMENT
/begin MEASUREMENT VINP_FrTMTempWarn_enum "" UBYTE SWC_INP_type_CM_uint8_enum 0 0 0.0 3.0 ECU_ADDRESS 0x0000 /* @ECU_Address@VINP_FrTMTempWarn_enum@ */ /end MEASUREMENT
/begin MEASUREMENT VINP_MCUBFLLCTempWarnSta_enum "" UBYTE SWC_INP_type_CM_uint8_enum 0 0 0.0 3.0 ECU_ADDRESS 0x0000 /* @ECU_Address@VINP_MCUBFLLCTempWarnSta_enum@ */ /end MEASUREMENT
/begin MEASUREMENT VINP_MCUWarnR_enum "" UBYTE SWC_INP_type_CM_uint8_enum 0 0 0.0 7.0 ECU_ADDRESS 0x0000 /* @ECU_Address@VINP_MCUWarnR_enum@ */ /end MEASUREMENT
/begin MEASUREMENT VINP_RrEDURotateDirction_enum "" UBYTE SWC_INP_type_CM_uint8_enum 0 0 0.0 2.0 ECU_ADDRESS 0x0000 /* @ECU_Address@VINP_RrEDURotateDirction_enum@ */ /end MEASUREMENT
/begin MEASUREMENT VINP_RrMCU1Chksum_enum "" UBYTE SWC_INP_type_CM_uint8_enum 0 0 0.0 255.0 ECU_ADDRESS 0x0000 /* @ECU_Address@VINP_RrMCU1Chksum_enum@ */ /end MEASUREMENT
/begin MEASUREMENT VINP_RrMCU1RolCnt_enum "" UBYTE SWC_INP_type_CM_uint8_enum 0 0 0.0 14.0 ECU_ADDRESS 0x0000 /* @ECU_Address@VINP_RrMCU1RolCnt_enum@ */ /end MEASUREMENT
/begin MEASUREMENT VINP_RrMCUErr_enum "" UBYTE SWC_INP_type_CM_uint8_enum 0 0 0.0 255.0 ECU_ADDRESS 0x0000 /* @ECU_Address@VINP_RrMCUErr_enum@ */ /end MEASUREMENT
/begin MEASUREMENT VINP_RrMCUSysSta_enum "" UBYTE SWC_INP_type_CM_uint8_enum 0 0 0.0 15.0 ECU_ADDRESS 0x0000 /* @ECU_Address@VINP_RrMCUSysSta_enum@ */ /end MEASUREMENT
/begin MEASUREMENT VINP_MCUBRLLCTempWarnSta_enum "" UBYTE SWC_INP_type_CM_uint8_enum 0 0 0.0 3.0 ECU_ADDRESS 0x0000 /* @ECU_Address@VINP_MCUBRLLCTempWarnSta_enum@ */ /end MEASUREMENT
/begin MEASUREMENT VINP_RrFailcode1_enum "" UBYTE SWC_INP_type_CM_uint8_enum 0 0 0.0 255.0 ECU_ADDRESS 0x0000 /* @ECU_Address@VINP_RrFailcode1_enum@ */ /end MEASUREMENT
/begin MEASUREMENT VINP_RrFailcode2_enum "" UBYTE SWC_INP_type_CM_uint8_enum 0 0 0.0 255.0 ECU_ADDRESS 0x0000 /* @ECU_Address@VINP_RrFailcode2_enum@ */ /end MEASUREMENT
/begin MEASUREMENT VINP_RrFailcodehistory1_enum "" UBYTE SWC_INP_type_CM_uint8_enum 0 0 0.0 2.0 ECU_ADDRESS 0x0000 /* @ECU_Address@VINP_RrFailcodehistory1_enum@ */ /end MEASUREMENT
/begin MEASUREMENT VINP_RrFailcodehistory2_enum "" UBYTE SWC_INP_type_CM_uint8_enum 0 0 0.0 2.0 ECU_ADDRESS 0x0000 /* @ECU_Address@VINP_RrFailcodehistory2_enum@ */ /end MEASUREMENT
/begin MEASUREMENT VINP_RrMCUTempWarn_enum "" UBYTE SWC_INP_type_CM_uint8_enum 0 0 0.0 3.0 ECU_ADDRESS 0x0000 /* @ECU_Address@VINP_RrMCUTempWarn_enum@ */ /end MEASUREMENT
/begin MEASUREMENT VINP_RrTMTempWarn_enum "" UBYTE SWC_INP_type_CM_uint8_enum 0 0 0.0 3.0 ECU_ADDRESS 0x0000 /* @ECU_Address@VINP_RrTMTempWarn_enum@ */ /end MEASUREMENT
/begin MEASUREMENT VINP_FrEDURotateDirctionNidec_enum "" UBYTE SWC_INP_type_CM_uint8_enum 0 0 0.0 2.0 ECU_ADDRESS 0x0000 /* @ECU_Address@VINP_FrEDURotateDirctionNidec_enum@ */ /end MEASUREMENT
/begin MEASUREMENT VINP_FrMCU1ChksumNidec_enum "" UBYTE SWC_INP_type_CM_uint8_enum 0 0 0.0 255.0 ECU_ADDRESS 0x0000 /* @ECU_Address@VINP_FrMCU1ChksumNidec_enum@ */ /end MEASUREMENT
/begin MEASUREMENT VINP_FrMCU1RolCntNidec_enum "" UBYTE SWC_INP_type_CM_uint8_enum 0 0 0.0 15.0 ECU_ADDRESS 0x0000 /* @ECU_Address@VINP_FrMCU1RolCntNidec_enum@ */ /end MEASUREMENT
/begin MEASUREMENT VINP_FrMCUErrNidec_enum "" UBYTE SWC_INP_type_CM_uint8_enum 0 0 0.0 255.0 ECU_ADDRESS 0x0000 /* @ECU_Address@VINP_FrMCUErrNidec_enum@ */ /end MEASUREMENT
/begin MEASUREMENT VINP_FrMCUSysStaNidec_enum "" UBYTE SWC_INP_type_CM_uint8_enum 0 0 0.0 15.0 ECU_ADDRESS 0x0000 /* @ECU_Address@VINP_FrMCUSysStaNidec_enum@ */ /end MEASUREMENT
/begin MEASUREMENT VINP_MCUWarnFNidec_enum "" UBYTE SWC_INP_type_CM_uint8_enum 0 0 0.0 7.0 ECU_ADDRESS 0x0000 /* @ECU_Address@VINP_MCUWarnFNidec_enum@ */ /end MEASUREMENT
/begin MEASUREMENT VINP_FrFailcode1Nidec_enum "" UBYTE SWC_INP_type_CM_uint8_enum 0 0 0.0 255.0 ECU_ADDRESS 0x0000 /* @ECU_Address@VINP_FrFailcode1Nidec_enum@ */ /end MEASUREMENT
/begin MEASUREMENT VINP_FrFailcode2Nidec_enum "" UBYTE SWC_INP_type_CM_uint8_enum 0 0 0.0 255.0 ECU_ADDRESS 0x0000 /* @ECU_Address@VINP_FrFailcode2Nidec_enum@ */ /end MEASUREMENT
/begin MEASUREMENT VINP_FrFailcodehistory1Nidec_enum "" UBYTE SWC_INP_type_CM_uint8_enum 0 0 0.0 2.0 ECU_ADDRESS 0x0000 /* @ECU_Address@VINP_FrFailcodehistory1Nidec_enum@ */ /end MEASUREMENT
/begin MEASUREMENT VINP_FrFailcodehistory2Nidec_enum "" UBYTE SWC_INP_type_CM_uint8_enum 0 0 0.0 2.0 ECU_ADDRESS 0x0000 /* @ECU_Address@VINP_FrFailcodehistory2Nidec_enum@ */ /end MEASUREMENT
/begin MEASUREMENT VINP_BMSChckSum1_enum "" UBYTE SWC_INP_type_CM_uint8_enum 0 0 0.0 255.0 ECU_ADDRESS 0x0000 /* @ECU_Address@VINP_BMSChckSum1_enum@ */ /end MEASUREMENT
/begin MEASUREMENT VINP_FrMCUTempWarnNidec_enum "" UBYTE SWC_INP_type_CM_uint8_enum 0 0 0.0 3.0 ECU_ADDRESS 0x0000 /* @ECU_Address@VINP_FrMCUTempWarnNidec_enum@ */ /end MEASUREMENT
/begin MEASUREMENT VINP_FrTMTempWarnNidec_enum "" UBYTE SWC_INP_type_CM_uint8_enum 0 0 0.0 3.0 ECU_ADDRESS 0x0000 /* @ECU_Address@VINP_FrTMTempWarnNidec_enum@ */ /end MEASUREMENT
/begin MEASUREMENT VINP_MCUWarnRNidec_enum "" UBYTE SWC_INP_type_CM_uint8_enum 0 0 0.0 7.0 ECU_ADDRESS 0x0000 /* @ECU_Address@VINP_MCUWarnRNidec_enum@ */ /end MEASUREMENT
/begin MEASUREMENT VINP_BMSRolCnct1_enum "" UBYTE SWC_INP_type_CM_uint8_enum 0 0 0.0 14.0 ECU_ADDRESS 0x0000 /* @ECU_Address@VINP_BMSRolCnct1_enum@ */ /end MEASUREMENT
/begin MEASUREMENT VINP_RrEDURotateDirctionNidec_enum "" UBYTE SWC_INP_type_CM_uint8_enum 0 0 0.0 2.0 ECU_ADDRESS 0x0000 /* @ECU_Address@VINP_RrEDURotateDirctionNidec_enum@ */ /end MEASUREMENT
/begin MEASUREMENT VINP_RrMCU1ChksumNidec_enum "" UBYTE SWC_INP_type_CM_uint8_enum 0 0 0.0 255.0 ECU_ADDRESS 0x0000 /* @ECU_Address@VINP_RrMCU1ChksumNidec_enum@ */ /end MEASUREMENT
/begin MEASUREMENT VINP_RrMCU1RolCntNidec_enum "" UBYTE SWC_INP_type_CM_uint8_enum 0 0 0.0 15.0 ECU_ADDRESS 0x0000 /* @ECU_Address@VINP_RrMCU1RolCntNidec_enum@ */ /end MEASUREMENT
/begin MEASUREMENT VINP_RrMCUErrNidec_enum "" UBYTE SWC_INP_type_CM_uint8_enum 0 0 0.0 255.0 ECU_ADDRESS 0x0000 /* @ECU_Address@VINP_RrMCUErrNidec_enum@ */ /end MEASUREMENT
/begin MEASUREMENT VINP_RrMCUSysStaNidec_enum "" UBYTE SWC_INP_type_CM_uint8_enum 0 0 0.0 15.0 ECU_ADDRESS 0x0000 /* @ECU_Address@VINP_RrMCUSysStaNidec_enum@ */ /end MEASUREMENT
/begin MEASUREMENT VINP_RrFailcode1Nidec_enum "" UBYTE SWC_INP_type_CM_uint8_enum 0 0 0.0 255.0 ECU_ADDRESS 0x0000 /* @ECU_Address@VINP_RrFailcode1Nidec_enum@ */ /end MEASUREMENT
/begin MEASUREMENT VINP_RrFailcode2Nidec_enum "" UBYTE SWC_INP_type_CM_uint8_enum 0 0 0.0 255.0 ECU_ADDRESS 0x0000 /* @ECU_Address@VINP_RrFailcode2Nidec_enum@ */ /end MEASUREMENT
/begin MEASUREMENT VINP_RrFailcodehistory1Nidec_enum "" UBYTE SWC_INP_type_CM_uint8_enum 0 0 0.0 2.0 ECU_ADDRESS 0x0000 /* @ECU_Address@VINP_RrFailcodehistory1Nidec_enum@ */ /end MEASUREMENT
/begin MEASUREMENT VINP_RrFailcodehistory2Nidec_enum "" UBYTE SWC_INP_type_CM_uint8_enum 0 0 0.0 2.0 ECU_ADDRESS 0x0000 /* @ECU_Address@VINP_RrFailcodehistory2Nidec_enum@ */ /end MEASUREMENT
/begin MEASUREMENT VINP_RrMCUTempWarnNidec_enum "" UBYTE SWC_INP_type_CM_uint8_enum 0 0 0.0 3.0 ECU_ADDRESS 0x0000 /* @ECU_Address@VINP_RrMCUTempWarnNidec_enum@ */ /end MEASUREMENT
/begin MEASUREMENT VINP_RrTMTempWarnNidec_enum "" UBYTE SWC_INP_type_CM_uint8_enum 0 0 0.0 3.0 ECU_ADDRESS 0x0000 /* @ECU_Address@VINP_RrTMTempWarnNidec_enum@ */ /end MEASUREMENT
/begin MEASUREMENT VINP_ShifterCRC8_enum "" UBYTE SWC_INP_type_CM_uint8_enum 0 0 0.0 255.0 ECU_ADDRESS 0x0000 /* @ECU_Address@VINP_ShifterCRC8_enum@ */ /end MEASUREMENT
/begin MEASUREMENT VINP_ShifterFailsta_enum "" UBYTE SWC_INP_type_CM_uint8_enum 0 0 0.0 7.0 ECU_ADDRESS 0x0000 /* @ECU_Address@VINP_ShifterFailsta_enum@ */ /end MEASUREMENT
/begin MEASUREMENT VINP_ShifterHandleCmd_enum "" UBYTE SWC_INP_type_CM_uint8_enum 0 0 0.0 255.0 ECU_ADDRESS 0x0000 /* @ECU_Address@VINP_ShifterHandleCmd_enum@ */ /end MEASUREMENT
/begin MEASUREMENT VINP_ShifterRC_enum "" UBYTE SWC_INP_type_CM_uint8_enum 0 0 0.0 14.0 ECU_ADDRESS 0x0000 /* @ECU_Address@VINP_ShifterRC_enum@ */ /end MEASUREMENT
/begin MEASUREMENT VINP_CSW2FWasSwSta_enum "" UBYTE SWC_INP_type_CM_uint8_enum 0 0 0.0 3.0 ECU_ADDRESS 0x0000 /* @ECU_Address@VINP_CSW2FWasSwSta_enum@ */ /end MEASUREMENT
/begin MEASUREMENT VINP_CSW2FWipSwSta_enum "" UBYTE SWC_INP_type_CM_uint8_enum 0 0 0.0 7.0 ECU_ADDRESS 0x0000 /* @ECU_Address@VINP_CSW2FWipSwSta_enum@ */ /end MEASUREMENT
/begin MEASUREMENT VINP_CSW2RWipWasSwSta_enum "" UBYTE SWC_INP_type_CM_uint8_enum 0 0 0.0 3.0 ECU_ADDRESS 0x0000 /* @ECU_Address@VINP_CSW2RWipWasSwSta_enum@ */ /end MEASUREMENT
/begin MEASUREMENT VINP_CSW2TurnSwSta_enum "" UBYTE SWC_INP_type_CM_uint8_enum 0 0 0.0 5.0 ECU_ADDRESS 0x0000 /* @ECU_Address@VINP_CSW2TurnSwSta_enum@ */ /end MEASUREMENT
/begin MEASUREMENT VINP_MaxCellTempNum_enum "" UBYTE SWC_INP_type_CM_uint8_enum 0 0 0.0 253.0 ECU_ADDRESS 0x0000 /* @ECU_Address@VINP_MaxCellTempNum_enum@ */ /end MEASUREMENT
/begin MEASUREMENT VINP_MaxCellVoltNum_enum "" UBYTE SWC_INP_type_CM_uint8_enum 0 0 0.0 253.0 ECU_ADDRESS 0x0000 /* @ECU_Address@VINP_MaxCellVoltNum_enum@ */ /end MEASUREMENT
/begin MEASUREMENT VINP_MinCellTempNum_enum "" UBYTE SWC_INP_type_CM_uint8_enum 0 0 0.0 253.0 ECU_ADDRESS 0x0000 /* @ECU_Address@VINP_MinCellTempNum_enum@ */ /end MEASUREMENT
/begin MEASUREMENT VINP_MinCellVoltNum_enum "" UBYTE SWC_INP_type_CM_uint8_enum 0 0 0.0 253.0 ECU_ADDRESS 0x0000 /* @ECU_Address@VINP_MinCellVoltNum_enum@ */ /end MEASUREMENT
/begin MEASUREMENT VINP_BMSChckSum_enum "" UBYTE SWC_INP_type_CM_uint8_enum 0 0 0.0 255.0 ECU_ADDRESS 0x0000 /* @ECU_Address@VINP_BMSChckSum_enum@ */ /end MEASUREMENT
/begin MEASUREMENT VINP_BMSRolCnct_enum "" UBYTE SWC_INP_type_CM_uint8_enum 0 0 0.0 14.0 ECU_ADDRESS 0x0000 /* @ECU_Address@VINP_BMSRolCnct_enum@ */ /end MEASUREMENT
/begin MEASUREMENT VINP_ChrgInLockReq_enum "" UBYTE SWC_INP_type_CM_uint8_enum 0 0 0.0 2.0 ECU_ADDRESS 0x0000 /* @ECU_Address@VINP_ChrgInLockReq_enum@ */ /end MEASUREMENT
/begin MEASUREMENT VINP_ChrgPlugSta_enum "" UBYTE SWC_INP_type_CM_uint8_enum 0 0 0.0 3.0 ECU_ADDRESS 0x0000 /* @ECU_Address@VINP_ChrgPlugSta_enum@ */ /end MEASUREMENT
/begin MEASUREMENT VINP_DisChrgPlugErr_enum "" UBYTE SWC_INP_type_CM_uint8_enum 0 0 0.0 3.0 ECU_ADDRESS 0x0000 /* @ECU_Address@VINP_DisChrgPlugErr_enum@ */ /end MEASUREMENT
/begin MEASUREMENT VINP_ExtChrgSta_enum "" UBYTE SWC_INP_type_CM_uint8_enum 0 0 0.0 3.0 ECU_ADDRESS 0x0000 /* @ECU_Address@VINP_ExtChrgSta_enum@ */ /end MEASUREMENT
/begin MEASUREMENT VINP_HVBChrgErr_enum "" UBYTE SWC_INP_type_CM_uint8_enum 0 0 0.0 255.0 ECU_ADDRESS 0x0000 /* @ECU_Address@VINP_HVBChrgErr_enum@ */ /end MEASUREMENT
/begin MEASUREMENT VINP_HVBOvrTempWarn_enum "" UBYTE SWC_INP_type_CM_uint8_enum 0 0 0.0 2.0 ECU_ADDRESS 0x0000 /* @ECU_Address@VINP_HVBOvrTempWarn_enum@ */ /end MEASUREMENT
/begin MEASUREMENT VINP_HVBPreheatPrecoolSta_enum "" UBYTE SWC_INP_type_CM_uint8_enum 0 0 0.0 2.0 ECU_ADDRESS 0x0000 /* @ECU_Address@VINP_HVBPreheatPrecoolSta_enum@ */ /end MEASUREMENT
/begin MEASUREMENT VINP_HVBattReady4Pre_enum "" UBYTE SWC_INP_type_CM_uint8_enum 0 0 0.0 2.0 ECU_ADDRESS 0x0000 /* @ECU_Address@VINP_HVBattReady4Pre_enum@ */ /end MEASUREMENT
/begin MEASUREMENT VINP_V2LSta_enum "" UBYTE SWC_INP_type_CM_uint8_enum 0 0 0.0 3.0 ECU_ADDRESS 0x0000 /* @ECU_Address@VINP_V2LSta_enum@ */ /end MEASUREMENT
/begin MEASUREMENT VINP_MainRlyNegSta_enum "" UBYTE SWC_INP_type_CM_uint8_enum 0 0 0.0 255.0 ECU_ADDRESS 0x0000 /* @ECU_Address@VINP_MainRlyNegSta_enum@ */ /end MEASUREMENT
/begin MEASUREMENT VINP_MainRlyPosSta_enum "" UBYTE SWC_INP_type_CM_uint8_enum 0 0 0.0 255.0 ECU_ADDRESS 0x0000 /* @ECU_Address@VINP_MainRlyPosSta_enum@ */ /end MEASUREMENT
/begin MEASUREMENT VINP_CSCCU1_enum "" UBYTE SWC_INP_type_CM_uint8_enum 0 0 0.0 255.0 ECU_ADDRESS 0x0000 /* @ECU_Address@VINP_CSCCU1_enum@ */ /end MEASUREMENT
/begin MEASUREMENT VINP_DCDCPreCompleted_enum "" UBYTE SWC_INP_type_CM_uint8_enum 0 0 0.0 2.0 ECU_ADDRESS 0x0000 /* @ECU_Address@VINP_DCDCPreCompleted_enum@ */ /end MEASUREMENT
/begin MEASUREMENT VINP_TFaceRErr_enum "" UBYTE SWC_INP_type_CM_uint8_enum 0 0 0.0 3.0 ECU_ADDRESS 0x0000 /* @ECU_Address@VINP_TFaceRErr_enum@ */ /end MEASUREMENT
/begin MEASUREMENT VINP_TFaceRrErr_enum "" UBYTE SWC_INP_type_CM_uint8_enum 0 0 0.0 3.0 ECU_ADDRESS 0x0000 /* @ECU_Address@VINP_TFaceRrErr_enum@ */ /end MEASUREMENT
/begin MEASUREMENT VINP_TFootLErr_enum "" UBYTE SWC_INP_type_CM_uint8_enum 0 0 0.0 3.0 ECU_ADDRESS 0x0000 /* @ECU_Address@VINP_TFootLErr_enum@ */ /end MEASUREMENT
/begin MEASUREMENT VINP_TFootRErr_enum "" UBYTE SWC_INP_type_CM_uint8_enum 0 0 0.0 3.0 ECU_ADDRESS 0x0000 /* @ECU_Address@VINP_TFootRErr_enum@ */ /end MEASUREMENT
/begin MEASUREMENT VINP_TFootRrErr_enum "" UBYTE SWC_INP_type_CM_uint8_enum 0 0 0.0 3.0 ECU_ADDRESS 0x0000 /* @ECU_Address@VINP_TFootRrErr_enum@ */ /end MEASUREMENT
/begin MEASUREMENT VINP_TevapErr_enum "" UBYTE SWC_INP_type_CM_uint8_enum 0 0 0.0 3.0 ECU_ADDRESS 0x0000 /* @ECU_Address@VINP_TevapErr_enum@ */ /end MEASUREMENT
/begin MEASUREMENT VINP_TincarErr_enum "" UBYTE SWC_INP_type_CM_uint8_enum 0 0 0.0 3.0 ECU_ADDRESS 0x0000 /* @ECU_Address@VINP_TincarErr_enum@ */ /end MEASUREMENT
/begin MEASUREMENT VINP_ZoneDrMalfunLevel_enum "" UBYTE SWC_INP_type_CM_uint8_enum 0 0 0.0 5.0 ECU_ADDRESS 0x0000 /* @ECU_Address@VINP_ZoneDrMalfunLevel_enum@ */ /end MEASUREMENT
/begin MEASUREMENT VINP_TrailerModeSta_enum "" UBYTE SWC_INP_type_CM_uint8_enum 0 0 0.0 3.0 ECU_ADDRESS 0x0000 /* @ECU_Address@VINP_TrailerModeSta_enum@ */ /end MEASUREMENT
/begin MEASUREMENT VINP_AGSErr_enum "" UBYTE SWC_INP_type_CM_uint8_enum 0 0 0.0 3.0 ECU_ADDRESS 0x0000 /* @ECU_Address@VINP_AGSErr_enum@ */ /end MEASUREMENT
/begin MEASUREMENT VINP_BatInTempErr_enum "" UBYTE SWC_INP_type_CM_uint8_enum 0 0 0.0 3.0 ECU_ADDRESS 0x0000 /* @ECU_Address@VINP_BatInTempErr_enum@ */ /end MEASUREMENT
/begin MEASUREMENT VINP_COMPErr_enum "" UBYTE SWC_INP_type_CM_uint8_enum 0 0 0.0 3.0 ECU_ADDRESS 0x0000 /* @ECU_Address@VINP_COMPErr_enum@ */ /end MEASUREMENT
/begin MEASUREMENT VINP_EACProtectEnable_enum "" UBYTE SWC_INP_type_CM_uint8_enum 0 0 0.0 2.0 ECU_ADDRESS 0x0000 /* @ECU_Address@VINP_EACProtectEnable_enum@ */ /end MEASUREMENT
/begin MEASUREMENT VINP_EWP3Err_enum "" UBYTE SWC_INP_type_CM_uint8_enum 0 0 0.0 3.0 ECU_ADDRESS 0x0000 /* @ECU_Address@VINP_EWP3Err_enum@ */ /end MEASUREMENT
/begin MEASUREMENT VINP_EXV1Err_enum "" UBYTE SWC_INP_type_CM_uint8_enum 0 0 0.0 3.0 ECU_ADDRESS 0x0000 /* @ECU_Address@VINP_EXV1Err_enum@ */ /end MEASUREMENT
/begin MEASUREMENT VINP_EXV2Err_enum "" UBYTE SWC_INP_type_CM_uint8_enum 0 0 0.0 3.0 ECU_ADDRESS 0x0000 /* @ECU_Address@VINP_EXV2Err_enum@ */ /end MEASUREMENT
/begin MEASUREMENT VINP_FanErr_enum "" UBYTE SWC_INP_type_CM_uint8_enum 0 0 0.0 3.0 ECU_ADDRESS 0x0000 /* @ECU_Address@VINP_FanErr_enum@ */ /end MEASUREMENT
/begin MEASUREMENT VINP_MotorInTempErr_enum "" UBYTE SWC_INP_type_CM_uint8_enum 0 0 0.0 3.0 ECU_ADDRESS 0x0000 /* @ECU_Address@VINP_MotorInTempErr_enum@ */ /end MEASUREMENT
/begin MEASUREMENT VINP_MotorOutTempErr_enum "" UBYTE SWC_INP_type_CM_uint8_enum 0 0 0.0 3.0 ECU_ADDRESS 0x0000 /* @ECU_Address@VINP_MotorOutTempErr_enum@ */ /end MEASUREMENT
/begin MEASUREMENT VINP_PTHighPErr_enum "" UBYTE SWC_INP_type_CM_uint8_enum 0 0 0.0 3.0 ECU_ADDRESS 0x0000 /* @ECU_Address@VINP_PTHighPErr_enum@ */ /end MEASUREMENT
/begin MEASUREMENT VINP_PTHighTactErr_enum "" UBYTE SWC_INP_type_CM_uint8_enum 0 0 0.0 3.0 ECU_ADDRESS 0x0000 /* @ECU_Address@VINP_PTHighTactErr_enum@ */ /end MEASUREMENT
/begin MEASUREMENT VINP_PTLowP1Err_enum "" UBYTE SWC_INP_type_CM_uint8_enum 0 0 0.0 3.0 ECU_ADDRESS 0x0000 /* @ECU_Address@VINP_PTLowP1Err_enum@ */ /end MEASUREMENT
/begin MEASUREMENT VINP_PTLowP2Err_enum "" UBYTE SWC_INP_type_CM_uint8_enum 0 0 0.0 3.0 ECU_ADDRESS 0x0000 /* @ECU_Address@VINP_PTLowP2Err_enum@ */ /end MEASUREMENT
/begin MEASUREMENT VINP_PTLowT1Err_enum "" UBYTE SWC_INP_type_CM_uint8_enum 0 0 0.0 3.0 ECU_ADDRESS 0x0000 /* @ECU_Address@VINP_PTLowT1Err_enum@ */ /end MEASUREMENT
/begin MEASUREMENT VINP_PTLowT2Err_enum "" UBYTE SWC_INP_type_CM_uint8_enum 0 0 0.0 3.0 ECU_ADDRESS 0x0000 /* @ECU_Address@VINP_PTLowT2Err_enum@ */ /end MEASUREMENT
/begin MEASUREMENT VINP_SOTXVErr_enum "" UBYTE SWC_INP_type_CM_uint8_enum 0 0 0.0 3.0 ECU_ADDRESS 0x0000 /* @ECU_Address@VINP_SOTXVErr_enum@ */ /end MEASUREMENT
/begin MEASUREMENT VINP_SOV1Err_enum "" UBYTE SWC_INP_type_CM_uint8_enum 0 0 0.0 3.0 ECU_ADDRESS 0x0000 /* @ECU_Address@VINP_SOV1Err_enum@ */ /end MEASUREMENT
/begin MEASUREMENT VINP_SOV2Err_enum "" UBYTE SWC_INP_type_CM_uint8_enum 0 0 0.0 3.0 ECU_ADDRESS 0x0000 /* @ECU_Address@VINP_SOV2Err_enum@ */ /end MEASUREMENT
/begin MEASUREMENT VINP_SOV3Err_enum "" UBYTE SWC_INP_type_CM_uint8_enum 0 0 0.0 3.0 ECU_ADDRESS 0x0000 /* @ECU_Address@VINP_SOV3Err_enum@ */ /end MEASUREMENT
/begin MEASUREMENT VINP_TambErr_enum "" UBYTE SWC_INP_type_CM_uint8_enum 0 0 0.0 3.0 ECU_ADDRESS 0x0000 /* @ECU_Address@VINP_TambErr_enum@ */ /end MEASUREMENT
/begin MEASUREMENT VINP_CSWFWasSwSta_enum "" UBYTE SWC_INP_type_CM_uint8_enum 0 0 0.0 3.0 ECU_ADDRESS 0x0000 /* @ECU_Address@VINP_CSWFWasSwSta_enum@ */ /end MEASUREMENT
/begin MEASUREMENT VINP_CSWFWipSwSta_enum "" UBYTE SWC_INP_type_CM_uint8_enum 0 0 0.0 7.0 ECU_ADDRESS 0x0000 /* @ECU_Address@VINP_CSWFWipSwSta_enum@ */ /end MEASUREMENT
/begin MEASUREMENT VINP_CSWRWasSWSta_enum "" UBYTE SWC_INP_type_CM_uint8_enum 0 0 0.0 3.0 ECU_ADDRESS 0x0000 /* @ECU_Address@VINP_CSWRWasSWSta_enum@ */ /end MEASUREMENT
/begin MEASUREMENT VINP_CSWRWipIntSwSta_enum "" UBYTE SWC_INP_type_CM_uint8_enum 0 0 0.0 3.0 ECU_ADDRESS 0x0000 /* @ECU_Address@VINP_CSWRWipIntSwSta_enum@ */ /end MEASUREMENT
/begin MEASUREMENT VINP_CSWTurnSwSta_enum "" UBYTE SWC_INP_type_CM_uint8_enum 0 0 0.0 3.0 ECU_ADDRESS 0x0000 /* @ECU_Address@VINP_CSWTurnSwSta_enum@ */ /end MEASUREMENT
/begin MEASUREMENT VINP_LDrvWdwPositionSts_enum "" UBYTE SWC_INP_type_CM_uint8_enum 0 0 0.0 3.0 ECU_ADDRESS 0x0000 /* @ECU_Address@VINP_LDrvWdwPositionSts_enum@ */ /end MEASUREMENT
/begin MEASUREMENT VINP_LPasWdwPositionSts_enum "" UBYTE SWC_INP_type_CM_uint8_enum 0 0 0.0 3.0 ECU_ADDRESS 0x0000 /* @ECU_Address@VINP_LPasWdwPositionSts_enum@ */ /end MEASUREMENT
/begin MEASUREMENT VINP_LRLDWdwPositionSts_enum "" UBYTE SWC_INP_type_CM_uint8_enum 0 0 0.0 3.0 ECU_ADDRESS 0x0000 /* @ECU_Address@VINP_LRLDWdwPositionSts_enum@ */ /end MEASUREMENT
/begin MEASUREMENT VINP_LRRDWdwPositionSts_enum "" UBYTE SWC_INP_type_CM_uint8_enum 0 0 0.0 3.0 ECU_ADDRESS 0x0000 /* @ECU_Address@VINP_LRRDWdwPositionSts_enum@ */ /end MEASUREMENT
/begin MEASUREMENT VINP_RLSRainSnrWiperCmd_enum "" UBYTE SWC_INP_type_CM_uint8_enum 0 0 0.0 7.0 ECU_ADDRESS 0x0000 /* @ECU_Address@VINP_RLSRainSnrWiperCmd_enum@ */ /end MEASUREMENT
/begin MEASUREMENT VINP_BDDSEATMemSetSta_enum "" UBYTE SWC_INP_type_CM_uint8_enum 0 0 0.0 3.0 ECU_ADDRESS 0x0000 /* @ECU_Address@VINP_BDDSEATMemSetSta_enum@ */ /end MEASUREMENT
/begin MEASUREMENT VINP_BDDSEATModeSta_enum "" UBYTE SWC_INP_type_CM_uint8_enum 0 0 0.0 7.0 ECU_ADDRESS 0x0000 /* @ECU_Address@VINP_BDDSEATModeSta_enum@ */ /end MEASUREMENT
/begin MEASUREMENT VINP_BDDSEATVentSta_enum "" UBYTE SWC_INP_type_CM_uint8_enum 0 0 0.0 4.0 ECU_ADDRESS 0x0000 /* @ECU_Address@VINP_BDDSEATVentSta_enum@ */ /end MEASUREMENT
/begin MEASUREMENT VINP_BDDSEATheaterSta_enum "" UBYTE SWC_INP_type_CM_uint8_enum 0 0 0.0 4.0 ECU_ADDRESS 0x0000 /* @ECU_Address@VINP_BDDSEATheaterSta_enum@ */ /end MEASUREMENT
/begin MEASUREMENT VINP_AGSActualPosition_enum "" UBYTE SWC_INP_type_CM_uint8_enum 0 0 0.0 240.0 ECU_ADDRESS 0x0000 /* @ECU_Address@VINP_AGSActualPosition_enum@ */ /end MEASUREMENT
/begin MEASUREMENT VINP_FGSIntenRspSta_enum "" UBYTE SWC_INP_type_CM_uint8_enum 0 0 0.0 15.0 ECU_ADDRESS 0x0000 /* @ECU_Address@VINP_FGSIntenRspSta_enum@ */ /end MEASUREMENT
/begin MEASUREMENT VINP_EWP1BlockError_enum "" UBYTE SWC_INP_type_CM_uint8_enum 0 0 0.0 3.0 ECU_ADDRESS 0x0000 /* @ECU_Address@VINP_EWP1BlockError_enum@ */ /end MEASUREMENT
/begin MEASUREMENT VINP_EWP1OverCurrError_enum "" UBYTE SWC_INP_type_CM_uint8_enum 0 0 0.0 3.0 ECU_ADDRESS 0x0000 /* @ECU_Address@VINP_EWP1OverCurrError_enum@ */ /end MEASUREMENT
/begin MEASUREMENT VINP_EWP2BlockError_enum "" UBYTE SWC_INP_type_CM_uint8_enum 0 0 0.0 3.0 ECU_ADDRESS 0x0000 /* @ECU_Address@VINP_EWP2BlockError_enum@ */ /end MEASUREMENT
/begin MEASUREMENT VINP_EWP2OverCurrError_enum "" UBYTE SWC_INP_type_CM_uint8_enum 0 0 0.0 3.0 ECU_ADDRESS 0x0000 /* @ECU_Address@VINP_EWP2OverCurrError_enum@ */ /end MEASUREMENT
/begin MEASUREMENT VINP_EWP3BlockError_enum "" UBYTE SWC_INP_type_CM_uint8_enum 0 0 0.0 3.0 ECU_ADDRESS 0x0000 /* @ECU_Address@VINP_EWP3BlockError_enum@ */ /end MEASUREMENT
/begin MEASUREMENT VINP_EWP3OverCurrError_enum "" UBYTE SWC_INP_type_CM_uint8_enum 0 0 0.0 3.0 ECU_ADDRESS 0x0000 /* @ECU_Address@VINP_EWP3OverCurrError_enum@ */ /end MEASUREMENT
/begin MEASUREMENT VINP_DSEATMode_enum "" UBYTE SWC_INP_type_CM_uint8_enum 0 0 0.0 7.0 ECU_ADDRESS 0x0000 /* @ECU_Address@VINP_DSEATMode_enum@ */ /end MEASUREMENT
/begin MEASUREMENT VINP_DSEATVentSta_enum "" UBYTE SWC_INP_type_CM_uint8_enum 0 0 0.0 4.0 ECU_ADDRESS 0x0000 /* @ECU_Address@VINP_DSEATVentSta_enum@ */ /end MEASUREMENT
/begin MEASUREMENT VINP_DSEATheatersta_enum "" UBYTE SWC_INP_type_CM_uint8_enum 0 0 0.0 4.0 ECU_ADDRESS 0x0000 /* @ECU_Address@VINP_DSEATheatersta_enum@ */ /end MEASUREMENT
/begin MEASUREMENT VINP_PSEATMode_enum "" UBYTE SWC_INP_type_CM_uint8_enum 0 0 0.0 7.0 ECU_ADDRESS 0x0000 /* @ECU_Address@VINP_PSEATMode_enum@ */ /end MEASUREMENT
/begin MEASUREMENT VINP_PSEATVentSta_enum "" UBYTE SWC_INP_type_CM_uint8_enum 0 0 0.0 4.0 ECU_ADDRESS 0x0000 /* @ECU_Address@VINP_PSEATVentSta_enum@ */ /end MEASUREMENT
/begin MEASUREMENT VINP_PSEATheatersta_enum "" UBYTE SWC_INP_type_CM_uint8_enum 0 0 0.0 4.0 ECU_ADDRESS 0x0000 /* @ECU_Address@VINP_PSEATheatersta_enum@ */ /end MEASUREMENT
/begin MEASUREMENT VINP_BPPSEATModeSta_enum "" UBYTE SWC_INP_type_CM_uint8_enum 0 0 0.0 7.0 ECU_ADDRESS 0x0000 /* @ECU_Address@VINP_BPPSEATModeSta_enum@ */ /end MEASUREMENT
/begin MEASUREMENT VINP_BPPSEATVentSta_enum "" UBYTE SWC_INP_type_CM_uint8_enum 0 0 0.0 4.0 ECU_ADDRESS 0x0000 /* @ECU_Address@VINP_BPPSEATVentSta_enum@ */ /end MEASUREMENT
/begin MEASUREMENT VINP_BPPSEATheaterSta_enum "" UBYTE SWC_INP_type_CM_uint8_enum 0 0 0.0 4.0 ECU_ADDRESS 0x0000 /* @ECU_Address@VINP_BPPSEATheaterSta_enum@ */ /end MEASUREMENT
/begin MEASUREMENT VINP_BPPTGActiveSta_enum "" UBYTE SWC_INP_type_CM_uint8_enum 0 0 0.0 7.0 ECU_ADDRESS 0x0000 /* @ECU_Address@VINP_BPPTGActiveSta_enum@ */ /end MEASUREMENT
/begin MEASUREMENT VINP_BPPTGInsideSW1Sta_enum "" UBYTE SWC_INP_type_CM_uint8_enum 0 0 0.0 3.0 ECU_ADDRESS 0x0000 /* @ECU_Address@VINP_BPPTGInsideSW1Sta_enum@ */ /end MEASUREMENT
/begin MEASUREMENT VINP_BPPTGInsideSW2Sta_enum "" UBYTE SWC_INP_type_CM_uint8_enum 0 0 0.0 3.0 ECU_ADDRESS 0x0000 /* @ECU_Address@VINP_BPPTGInsideSW2Sta_enum@ */ /end MEASUREMENT
/begin MEASUREMENT VINP_BPPTGRDILCmd_enum "" UBYTE SWC_INP_type_CM_uint8_enum 0 0 0.0 3.0 ECU_ADDRESS 0x0000 /* @ECU_Address@VINP_BPPTGRDILCmd_enum@ */ /end MEASUREMENT
/begin MEASUREMENT VINP_BPPTGSysSta_enum "" UBYTE SWC_INP_type_CM_uint8_enum 0 0 0.0 3.0 ECU_ADDRESS 0x0000 /* @ECU_Address@VINP_BPPTGSysSta_enum@ */ /end MEASUREMENT
/begin MEASUREMENT VINP_BPSEATLVentSta_enum "" UBYTE SWC_INP_type_CM_uint8_enum 0 0 0.0 7.0 ECU_ADDRESS 0x0000 /* @ECU_Address@VINP_BPSEATLVentSta_enum@ */ /end MEASUREMENT
/begin MEASUREMENT VINP_BPSEATMLVentSta_enum "" UBYTE SWC_INP_type_CM_uint8_enum 0 0 0.0 7.0 ECU_ADDRESS 0x0000 /* @ECU_Address@VINP_BPSEATMLVentSta_enum@ */ /end MEASUREMENT
/begin MEASUREMENT VINP_BPSEATMRVentSta_enum "" UBYTE SWC_INP_type_CM_uint8_enum 0 0 0.0 7.0 ECU_ADDRESS 0x0000 /* @ECU_Address@VINP_BPSEATMRVentSta_enum@ */ /end MEASUREMENT
/begin MEASUREMENT VINP_BPSEATRVentSta_enum "" UBYTE SWC_INP_type_CM_uint8_enum 0 0 0.0 7.0 ECU_ADDRESS 0x0000 /* @ECU_Address@VINP_BPSEATRVentSta_enum@ */ /end MEASUREMENT
/begin MEASUREMENT VINP_DKCKeyNumSta_enum "" UBYTE SWC_INP_type_CM_uint8_enum 0 0 0.0 15.0 ECU_ADDRESS 0x0000 /* @ECU_Address@VINP_DKCKeyNumSta_enum@ */ /end MEASUREMENT
/begin MEASUREMENT VINP_DKCKeyTypeSta_enum "" UBYTE SWC_INP_type_CM_uint8_enum 0 0 0.0 3.0 ECU_ADDRESS 0x0000 /* @ECU_Address@VINP_DKCKeyTypeSta_enum@ */ /end MEASUREMENT
/begin MEASUREMENT VINP_DKCPDkeyAreaRAPSSta_enum "" UBYTE SWC_INP_type_CM_uint8_enum 0 0 0.0 3.0 ECU_ADDRESS 0x0000 /* @ECU_Address@VINP_DKCPDkeyAreaRAPSSta_enum@ */ /end MEASUREMENT
/begin MEASUREMENT VINP_DKCParkingModeCmd_enum "" UBYTE SWC_INP_type_CM_uint8_enum 0 0 0.0 4.0 ECU_ADDRESS 0x0000 /* @ECU_Address@VINP_DKCParkingModeCmd_enum@ */ /end MEASUREMENT
/begin MEASUREMENT VINP_DKCReVehData_enum "" UBYTE SWC_INP_type_CM_uint8_enum 0 0 0.0 15.0 ECU_ADDRESS 0x0000 /* @ECU_Address@VINP_DKCReVehData_enum@ */ /end MEASUREMENT
/begin MEASUREMENT VINP_PCommandToBCM_enum "" UBYTE SWC_INP_type_CM_uint8_enum 0 0 0.0 15.0 ECU_ADDRESS 0x0000 /* @ECU_Address@VINP_PCommandToBCM_enum@ */ /end MEASUREMENT
/begin MEASUREMENT VINP_PCommandToPTG_enum "" UBYTE SWC_INP_type_CM_uint8_enum 0 0 0.0 5.0 ECU_ADDRESS 0x0000 /* @ECU_Address@VINP_PCommandToPTG_enum@ */ /end MEASUREMENT
/begin MEASUREMENT VINP_PDKeyAreaLockUnlock_enum "" UBYTE SWC_INP_type_CM_uint8_enum 0 0 0.0 3.0 ECU_ADDRESS 0x0000 /* @ECU_Address@VINP_PDKeyAreaLockUnlock_enum@ */ /end MEASUREMENT
/begin MEASUREMENT VINP_PDKeyAreaPS_enum "" UBYTE SWC_INP_type_CM_uint8_enum 0 0 0.0 3.0 ECU_ADDRESS 0x0000 /* @ECU_Address@VINP_PDKeyAreaPS_enum@ */ /end MEASUREMENT
/begin MEASUREMENT VINP_PDKeyAreaPTG_enum "" UBYTE SWC_INP_type_CM_uint8_enum 0 0 0.0 3.0 ECU_ADDRESS 0x0000 /* @ECU_Address@VINP_PDKeyAreaPTG_enum@ */ /end MEASUREMENT
/begin MEASUREMENT VINP_PDKeyWelcome_enum "" UBYTE SWC_INP_type_CM_uint8_enum 0 0 0.0 15.0 ECU_ADDRESS 0x0000 /* @ECU_Address@VINP_PDKeyWelcome_enum@ */ /end MEASUREMENT
/begin MEASUREMENT VINP_PDkeyShowIVI_enum "" UBYTE SWC_INP_type_CM_uint8_enum 0 0 0.0 15.0 ECU_ADDRESS 0x0000 /* @ECU_Address@VINP_PDkeyShowIVI_enum@ */ /end MEASUREMENT
/begin MEASUREMENT VINP_PKeyMode_enum "" UBYTE SWC_INP_type_CM_uint8_enum 0 0 0.0 15.0 ECU_ADDRESS 0x0000 /* @ECU_Address@VINP_PKeyMode_enum@ */ /end MEASUREMENT
/begin MEASUREMENT VINP_PTGActiveSta_enum "" UBYTE SWC_INP_type_CM_uint8_enum 0 0 0.0 7.0 ECU_ADDRESS 0x0000 /* @ECU_Address@VINP_PTGActiveSta_enum@ */ /end MEASUREMENT
/begin MEASUREMENT VINP_PTGHWVer_enum "" UBYTE SWC_INP_type_CM_uint8_enum 0 0 0.0 31.0 ECU_ADDRESS 0x0000 /* @ECU_Address@VINP_PTGHWVer_enum@ */ /end MEASUREMENT
/begin MEASUREMENT VINP_PTGInnerSW2_enum "" UBYTE SWC_INP_type_CM_uint8_enum 0 0 0.0 3.0 ECU_ADDRESS 0x0000 /* @ECU_Address@VINP_PTGInnerSW2_enum@ */ /end MEASUREMENT
/begin MEASUREMENT VINP_PTGRDILSta_enum "" UBYTE SWC_INP_type_CM_uint8_enum 0 0 0.0 3.0 ECU_ADDRESS 0x0000 /* @ECU_Address@VINP_PTGRDILSta_enum@ */ /end MEASUREMENT
/begin MEASUREMENT VINP_PTGSWVer_enum "" UBYTE SWC_INP_type_CM_uint8_enum 0 0 0.0 31.0 ECU_ADDRESS 0x0000 /* @ECU_Address@VINP_PTGSWVer_enum@ */ /end MEASUREMENT
/begin MEASUREMENT VINP_PTGSysSta_enum "" UBYTE SWC_INP_type_CM_uint8_enum 0 0 0.0 3.0 ECU_ADDRESS 0x0000 /* @ECU_Address@VINP_PTGSysSta_enum@ */ /end MEASUREMENT
/begin MEASUREMENT VINP_BlowerErr_enum "" UBYTE SWC_INP_type_CM_uint8_enum 0 0 0.0 3.0 ECU_ADDRESS 0x0000 /* @ECU_Address@VINP_BlowerErr_enum@ */ /end MEASUREMENT
/begin MEASUREMENT VINP_SolarLErr_enum "" UBYTE SWC_INP_type_CM_uint8_enum 0 0 0.0 3.0 ECU_ADDRESS 0x0000 /* @ECU_Address@VINP_SolarLErr_enum@ */ /end MEASUREMENT
/begin MEASUREMENT VINP_SolarRErr_enum "" UBYTE SWC_INP_type_CM_uint8_enum 0 0 0.0 3.0 ECU_ADDRESS 0x0000 /* @ECU_Address@VINP_SolarRErr_enum@ */ /end MEASUREMENT
/begin MEASUREMENT VINP_TFaceLErr_enum "" UBYTE SWC_INP_type_CM_uint8_enum 0 0 0.0 3.0 ECU_ADDRESS 0x0000 /* @ECU_Address@VINP_TFaceLErr_enum@ */ /end MEASUREMENT
/begin MEASUREMENT VINP_ACCObjDstLvl_enum "" UBYTE SWC_INP_type_CM_uint8_enum 0 0 0.0 7.0 ECU_ADDRESS 0x0000 /* @ECU_Address@VINP_ACCObjDstLvl_enum@ */ /end MEASUREMENT
/begin MEASUREMENT VINP_ADASACCSta_enum "" UBYTE SWC_INP_type_CM_uint8_enum 0 0 0.0 7.0 ECU_ADDRESS 0x0000 /* @ECU_Address@VINP_ADASACCSta_enum@ */ /end MEASUREMENT
/begin MEASUREMENT VINP_ADASAEBReq_enum "" UBYTE SWC_INP_type_CM_uint8_enum 0 0 0.0 7.0 ECU_ADDRESS 0x0000 /* @ECU_Address@VINP_ADASAEBReq_enum@ */ /end MEASUREMENT
/begin MEASUREMENT VINP_ADASAEBSta_enum "" UBYTE SWC_INP_type_CM_uint8_enum 0 0 0.0 7.0 ECU_ADDRESS 0x0000 /* @ECU_Address@VINP_ADASAEBSta_enum@ */ /end MEASUREMENT
/begin MEASUREMENT VINP_ADASCAMSpdLim_enum "" UBYTE SWC_INP_type_CM_uint8_enum 0 0 0.0 31.0 ECU_ADDRESS 0x0000 /* @ECU_Address@VINP_ADASCAMSpdLim_enum@ */ /end MEASUREMENT
/begin MEASUREMENT VINP_ADASDBSReq_enum "" UBYTE SWC_INP_type_CM_uint8_enum 0 0 0.0 3.0 ECU_ADDRESS 0x0000 /* @ECU_Address@VINP_ADASDBSReq_enum@ */ /end MEASUREMENT
/begin MEASUREMENT VINP_ADASFCWSta_enum "" UBYTE SWC_INP_type_CM_uint8_enum 0 0 0.0 7.0 ECU_ADDRESS 0x0000 /* @ECU_Address@VINP_ADASFCWSta_enum@ */ /end MEASUREMENT
/begin MEASUREMENT VINP_ADASISASta_enum "" UBYTE SWC_INP_type_CM_uint8_enum 0 0 0.0 6.0 ECU_ADDRESS 0x0000 /* @ECU_Address@VINP_ADASISASta_enum@ */ /end MEASUREMENT
/begin MEASUREMENT VINP_ADASLDWSta_enum "" UBYTE SWC_INP_type_CM_uint8_enum 0 0 0.0 7.0 ECU_ADDRESS 0x0000 /* @ECU_Address@VINP_ADASLDWSta_enum@ */ /end MEASUREMENT
/begin MEASUREMENT VINP_ADASLFCHandsOffWarning_enum "" UBYTE SWC_INP_type_CM_uint8_enum 0 0 0.0 3.0 ECU_ADDRESS 0x0000 /* @ECU_Address@VINP_ADASLFCHandsOffWarning_enum@ */ /end MEASUREMENT
/begin MEASUREMENT VINP_ADASLFCSta_enum "" UBYTE SWC_INP_type_CM_uint8_enum 0 0 0.0 7.0 ECU_ADDRESS 0x0000 /* @ECU_Address@VINP_ADASLFCSta_enum@ */ /end MEASUREMENT
/begin MEASUREMENT VINP_ADASLFCWarnSound_enum "" UBYTE SWC_INP_type_CM_uint8_enum 0 0 0.0 255.0 ECU_ADDRESS 0x0000 /* @ECU_Address@VINP_ADASLFCWarnSound_enum@ */ /end MEASUREMENT
/begin MEASUREMENT VINP_ADASLKASta_enum "" UBYTE SWC_INP_type_CM_uint8_enum 0 0 0.0 7.0 ECU_ADDRESS 0x0000 /* @ECU_Address@VINP_ADASLKASta_enum@ */ /end MEASUREMENT
/begin MEASUREMENT VINP_ADASLaneModeL_enum "" UBYTE SWC_INP_type_CM_uint8_enum 0 0 0.0 7.0 ECU_ADDRESS 0x0000 /* @ECU_Address@VINP_ADASLaneModeL_enum@ */ /end MEASUREMENT
/begin MEASUREMENT VINP_ADASLaneModeR_enum "" UBYTE SWC_INP_type_CM_uint8_enum 0 0 0.0 7.0 ECU_ADDRESS 0x0000 /* @ECU_Address@VINP_ADASLaneModeR_enum@ */ /end MEASUREMENT
/begin MEASUREMENT VINP_ADASLanetypeL_enum "" UBYTE SWC_INP_type_CM_uint8_enum 0 0 0.0 2.0 ECU_ADDRESS 0x0000 /* @ECU_Address@VINP_ADASLanetypeL_enum@ */ /end MEASUREMENT
/begin MEASUREMENT VINP_ADASLanetypeR_enum "" UBYTE SWC_INP_type_CM_uint8_enum 0 0 0.0 2.0 ECU_ADDRESS 0x0000 /* @ECU_Address@VINP_ADASLanetypeR_enum@ */ /end MEASUREMENT
/begin MEASUREMENT VINP_ADASSLIFSpdLim_enum "" UBYTE SWC_INP_type_CM_uint8_enum 0 0 0.0 31.0 ECU_ADDRESS 0x0000 /* @ECU_Address@VINP_ADASSLIFSpdLim_enum@ */ /end MEASUREMENT
/begin MEASUREMENT VINP_ADASSLIFSta_enum "" UBYTE SWC_INP_type_CM_uint8_enum 0 0 0.0 5.0 ECU_ADDRESS 0x0000 /* @ECU_Address@VINP_ADASSLIFSta_enum@ */ /end MEASUREMENT
/begin MEASUREMENT VINP_ADASShftPosnReq_enum "" UBYTE SWC_INP_type_CM_uint8_enum 0 0 0.0 7.0 ECU_ADDRESS 0x0000 /* @ECU_Address@VINP_ADASShftPosnReq_enum@ */ /end MEASUREMENT
/begin MEASUREMENT VINP_ADASVehSpdLim_enum "" UBYTE SWC_INP_type_CM_uint8_enum 0 0 0.0 254.0 ECU_ADDRESS 0x0000 /* @ECU_Address@VINP_ADASVehSpdLim_enum@ */ /end MEASUREMENT
/begin MEASUREMENT VINP_ADASWarningMsg_enum "" UBYTE SWC_INP_type_CM_uint8_enum 0 0 0.0 15.0 ECU_ADDRESS 0x0000 /* @ECU_Address@VINP_ADASWarningMsg_enum@ */ /end MEASUREMENT
/begin MEASUREMENT VINP_FCM1Checksum_enum "" UBYTE SWC_INP_type_CM_uint8_enum 0 0 0.0 255.0 ECU_ADDRESS 0x0000 /* @ECU_Address@VINP_FCM1Checksum_enum@ */ /end MEASUREMENT
/begin MEASUREMENT VINP_FCM1LifeCount_enum "" UBYTE SWC_INP_type_CM_uint8_enum 0 0 0.0 14.0 ECU_ADDRESS 0x0000 /* @ECU_Address@VINP_FCM1LifeCount_enum@ */ /end MEASUREMENT
/begin MEASUREMENT VINP_FCMACCmode_enum "" UBYTE SWC_INP_type_CM_uint8_enum 0 0 0.0 2.0 ECU_ADDRESS 0x0000 /* @ECU_Address@VINP_FCMACCmode_enum@ */ /end MEASUREMENT
/begin MEASUREMENT VINP_FCMLKATOIAct_enum "" UBYTE SWC_INP_type_CM_uint8_enum 0 0 0.0 255.0 ECU_ADDRESS 0x0000 /* @ECU_Address@VINP_FCMLKATOIAct_enum@ */ /end MEASUREMENT
/begin MEASUREMENT VINP_ForceLowBeam_enum "" UBYTE SWC_INP_type_CM_uint8_enum 0 0 0.0 2.0 ECU_ADDRESS 0x0000 /* @ECU_Address@VINP_ForceLowBeam_enum@ */ /end MEASUREMENT
/begin MEASUREMENT VINP_ISAWarningMsg_enum "" UBYTE SWC_INP_type_CM_uint8_enum 0 0 0.0 6.0 ECU_ADDRESS 0x0000 /* @ECU_Address@VINP_ISAWarningMsg_enum@ */ /end MEASUREMENT
/begin MEASUREMENT VINP_LVDAMuteSta_enum "" UBYTE SWC_INP_type_CM_uint8_enum 0 0 0.0 3.0 ECU_ADDRESS 0x0000 /* @ECU_Address@VINP_LVDAMuteSta_enum@ */ /end MEASUREMENT
/begin MEASUREMENT VINP_TargetType_enum "" UBYTE SWC_INP_type_CM_uint8_enum 0 0 0.0 15.0 ECU_ADDRESS 0x0000 /* @ECU_Address@VINP_TargetType_enum@ */ /end MEASUREMENT
/begin MEASUREMENT VINP_TimeGapLevel_enum "" UBYTE SWC_INP_type_CM_uint8_enum 0 0 0.0 7.0 ECU_ADDRESS 0x0000 /* @ECU_Address@VINP_TimeGapLevel_enum@ */ /end MEASUREMENT
/begin MEASUREMENT VINP_ADBVehDst1Val_enum "" UBYTE SWC_INP_type_CM_uint8_enum 0 0 0.0 15.0 ECU_ADDRESS 0x0000 /* @ECU_Address@VINP_ADBVehDst1Val_enum@ */ /end MEASUREMENT
/begin MEASUREMENT VINP_SRRBSDWarnL_enum "" UBYTE SWC_INP_type_CM_uint8_enum 0 0 0.0 3.0 ECU_ADDRESS 0x0000 /* @ECU_Address@VINP_SRRBSDWarnL_enum@ */ /end MEASUREMENT
/begin MEASUREMENT VINP_SRRBSDWarnR_enum "" UBYTE SWC_INP_type_CM_uint8_enum 0 0 0.0 3.0 ECU_ADDRESS 0x0000 /* @ECU_Address@VINP_SRRBSDWarnR_enum@ */ /end MEASUREMENT
/begin MEASUREMENT VINP_SRRODAWarnL_enum "" UBYTE SWC_INP_type_CM_uint8_enum 0 0 0.0 3.0 ECU_ADDRESS 0x0000 /* @ECU_Address@VINP_SRRODAWarnL_enum@ */ /end MEASUREMENT
/begin MEASUREMENT VINP_SRRODAWarnR_enum "" UBYTE SWC_INP_type_CM_uint8_enum 0 0 0.0 3.0 ECU_ADDRESS 0x0000 /* @ECU_Address@VINP_SRRODAWarnR_enum@ */ /end MEASUREMENT
/begin MEASUREMENT VINP_UIDButtonCmd_enum "" UBYTE SWC_INP_type_CM_uint8_enum 0 0 0.0 255.0 ECU_ADDRESS 0x0000 /* @ECU_Address@VINP_UIDButtonCmd_enum@ */ /end MEASUREMENT
/begin MEASUREMENT VINP_BTConnectSta_enum "" UBYTE SWC_INP_type_CM_uint8_enum 0 0 0.0 255.0 ECU_ADDRESS 0x0000 /* @ECU_Address@VINP_BTConnectSta_enum@ */ /end MEASUREMENT
/begin MEASUREMENT VINP_UWB1RangingSta_enum "" UBYTE SWC_INP_type_CM_uint8_enum 0 0 0.0 255.0 ECU_ADDRESS 0x0000 /* @ECU_Address@VINP_UWB1RangingSta_enum@ */ /end MEASUREMENT
/begin MEASUREMENT VINP_UWB2RangingSta_enum "" UBYTE SWC_INP_type_CM_uint8_enum 0 0 0.0 255.0 ECU_ADDRESS 0x0000 /* @ECU_Address@VINP_UWB2RangingSta_enum@ */ /end MEASUREMENT
/begin MEASUREMENT VINP_UWB3RangingSta_enum "" UBYTE SWC_INP_type_CM_uint8_enum 0 0 0.0 255.0 ECU_ADDRESS 0x0000 /* @ECU_Address@VINP_UWB3RangingSta_enum@ */ /end MEASUREMENT
/begin MEASUREMENT VINP_UWB4RangingSta_enum "" UBYTE SWC_INP_type_CM_uint8_enum 0 0 0.0 255.0 ECU_ADDRESS 0x0000 /* @ECU_Address@VINP_UWB4RangingSta_enum@ */ /end MEASUREMENT
/begin MEASUREMENT VINP_UWB5RangingSta_enum "" UBYTE SWC_INP_type_CM_uint8_enum 0 0 0.0 255.0 ECU_ADDRESS 0x0000 /* @ECU_Address@VINP_UWB5RangingSta_enum@ */ /end MEASUREMENT
/begin MEASUREMENT VINP_DKCBTRSSI_dB "" SBYTE SWC_INP_type_CM_int8_dB 0 0 -128.0 127.0 ECU_ADDRESS 0x0000 /* @ECU_Address@VINP_DKCBTRSSI_dB@ */ /end MEASUREMENT
/begin MEASUREMENT VINP_UWB1Power_dB "" SBYTE SWC_INP_type_CM_int8_dB 0 0 -128.0 127.0 ECU_ADDRESS 0x0000 /* @ECU_Address@VINP_UWB1Power_dB@ */ /end MEASUREMENT
/begin MEASUREMENT VINP_UWB2Power_dB "" SBYTE SWC_INP_type_CM_int8_dB 0 0 -128.0 127.0 ECU_ADDRESS 0x0000 /* @ECU_Address@VINP_UWB2Power_dB@ */ /end MEASUREMENT
/begin MEASUREMENT VINP_UWB3Power_dB "" SBYTE SWC_INP_type_CM_int8_dB 0 0 -128.0 127.0 ECU_ADDRESS 0x0000 /* @ECU_Address@VINP_UWB3Power_dB@ */ /end MEASUREMENT
/begin MEASUREMENT VINP_UWB4Power_dB "" SBYTE SWC_INP_type_CM_int8_dB 0 0 -128.0 127.0 ECU_ADDRESS 0x0000 /* @ECU_Address@VINP_UWB4Power_dB@ */ /end MEASUREMENT
/begin MEASUREMENT VINP_UWB5Power_dB "" SBYTE SWC_INP_type_CM_int8_dB 0 0 -128.0 127.0 ECU_ADDRESS 0x0000 /* @ECU_Address@VINP_UWB5Power_dB@ */ /end MEASUREMENT
/begin MEASUREMENT VINP_NetworkReqCalled_flg "" UBYTE SWC_INP_type_CM_boolean_flg 0 0 0.0 1.0 ECU_ADDRESS 0x0000 /* @ECU_Address@VINP_NetworkReqCalled_flg@ */ /end MEASUREMENT
/begin MEASUREMENT VINP_CAN3BusOff_flg "" UBYTE SWC_INP_type_CM_boolean_flg 0 0 0.0 1.0 ECU_ADDRESS 0x0000 /* @ECU_Address@VINP_CAN3BusOff_flg@ */ /end MEASUREMENT
/begin MEASUREMENT VINP_CAN4BusOff_flg "" UBYTE SWC_INP_type_CM_boolean_flg 0 0 0.0 1.0 ECU_ADDRESS 0x0000 /* @ECU_Address@VINP_CAN4BusOff_flg@ */ /end MEASUREMENT
/begin MEASUREMENT VINP_CAN5BusOff_flg "" UBYTE SWC_INP_type_CM_boolean_flg 0 0 0.0 1.0 ECU_ADDRESS 0x0000 /* @ECU_Address@VINP_CAN5BusOff_flg@ */ /end MEASUREMENT
/begin MEASUREMENT VINP_CAN6BusOff_flg "" UBYTE SWC_INP_type_CM_boolean_flg 0 0 0.0 1.0 ECU_ADDRESS 0x0000 /* @ECU_Address@VINP_CAN6BusOff_flg@ */ /end MEASUREMENT
/begin MEASUREMENT VINP_ReRadio_flg "" UBYTE SWC_INP_type_CM_boolean_flg 0 0 0.0 1.0 ECU_ADDRESS 0x0000 /* @ECU_Address@VINP_ReRadio_flg@ */ /end MEASUREMENT
/begin MEASUREMENT VINP_RemoteAutoReq_flg "" UBYTE SWC_INP_type_CM_boolean_flg 0 0 0.0 1.0 ECU_ADDRESS 0x0000 /* @ECU_Address@VINP_RemoteAutoReq_flg@ */ /end MEASUREMENT
/begin MEASUREMENT VINP_CANMsgValidBMS1_flg "" UBYTE SWC_INP_type_CM_boolean_flg 0 0 0.0 1.0 ECU_ADDRESS 0x0000 /* @ECU_Address@VINP_CANMsgValidBMS1_flg@ */ /end MEASUREMENT
/begin MEASUREMENT VINP_BMS1CSErr_flg "" UBYTE SWC_INP_type_CM_boolean_flg 0 0 0.0 1.0 ECU_ADDRESS 0x0000 /* @ECU_Address@VINP_BMS1CSErr_flg@ */ /end MEASUREMENT
/begin MEASUREMENT VINP_CANMsgValidMCUBF1_flg "" UBYTE SWC_INP_type_CM_boolean_flg 0 0 0.0 1.0 ECU_ADDRESS 0x0000 /* @ECU_Address@VINP_CANMsgValidMCUBF1_flg@ */ /end MEASUREMENT
/begin MEASUREMENT VINP_CANMsgValidMCUBF2_flg "" UBYTE SWC_INP_type_CM_boolean_flg 0 0 0.0 1.0 ECU_ADDRESS 0x0000 /* @ECU_Address@VINP_CANMsgValidMCUBF2_flg@ */ /end MEASUREMENT
/begin MEASUREMENT VINP_CANMsgValidMCUBR1_flg "" UBYTE SWC_INP_type_CM_boolean_flg 0 0 0.0 1.0 ECU_ADDRESS 0x0000 /* @ECU_Address@VINP_CANMsgValidMCUBR1_flg@ */ /end MEASUREMENT
/begin MEASUREMENT VINP_CANMsgValidMCUBR2_flg "" UBYTE SWC_INP_type_CM_boolean_flg 0 0 0.0 1.0 ECU_ADDRESS 0x0000 /* @ECU_Address@VINP_CANMsgValidMCUBR2_flg@ */ /end MEASUREMENT
/begin MEASUREMENT VINP_CANMsgValidMCUNF1_flg "" UBYTE SWC_INP_type_CM_boolean_flg 0 0 0.0 1.0 ECU_ADDRESS 0x0000 /* @ECU_Address@VINP_CANMsgValidMCUNF1_flg@ */ /end MEASUREMENT
/begin MEASUREMENT VINP_CANMsgValidMCUNF2_flg "" UBYTE SWC_INP_type_CM_boolean_flg 0 0 0.0 1.0 ECU_ADDRESS 0x0000 /* @ECU_Address@VINP_CANMsgValidMCUNF2_flg@ */ /end MEASUREMENT
/begin MEASUREMENT VINP_CANMsgValidMCUNF3_flg "" UBYTE SWC_INP_type_CM_boolean_flg 0 0 0.0 1.0 ECU_ADDRESS 0x0000 /* @ECU_Address@VINP_CANMsgValidMCUNF3_flg@ */ /end MEASUREMENT
/begin MEASUREMENT VINP_CANMsgValidMCUNR1_flg "" UBYTE SWC_INP_type_CM_boolean_flg 0 0 0.0 1.0 ECU_ADDRESS 0x0000 /* @ECU_Address@VINP_CANMsgValidMCUNR1_flg@ */ /end MEASUREMENT
/begin MEASUREMENT VINP_CANMsgValidMCUNR2_flg "" UBYTE SWC_INP_type_CM_boolean_flg 0 0 0.0 1.0 ECU_ADDRESS 0x0000 /* @ECU_Address@VINP_CANMsgValidMCUNR2_flg@ */ /end MEASUREMENT
/begin MEASUREMENT VINP_CANMsgValidMCUNR3_flg "" UBYTE SWC_INP_type_CM_boolean_flg 0 0 0.0 1.0 ECU_ADDRESS 0x0000 /* @ECU_Address@VINP_CANMsgValidMCUNR3_flg@ */ /end MEASUREMENT
/begin MEASUREMENT VINP_CANMsgValidBMS3_flg "" UBYTE SWC_INP_type_CM_boolean_flg 0 0 0.0 1.0 ECU_ADDRESS 0x0000 /* @ECU_Address@VINP_CANMsgValidBMS3_flg@ */ /end MEASUREMENT
/begin MEASUREMENT VINP_CANMsgValidShifter1_flg "" UBYTE SWC_INP_type_CM_boolean_flg 0 0 0.0 1.0 ECU_ADDRESS 0x0000 /* @ECU_Address@VINP_CANMsgValidShifter1_flg@ */ /end MEASUREMENT
/begin MEASUREMENT VINP_CANMsgValidShifter2_flg "" UBYTE SWC_INP_type_CM_boolean_flg 0 0 0.0 1.0 ECU_ADDRESS 0x0000 /* @ECU_Address@VINP_CANMsgValidShifter2_flg@ */ /end MEASUREMENT
/begin MEASUREMENT VINP_CANMsgValidBMS4_flg "" UBYTE SWC_INP_type_CM_boolean_flg 0 0 0.0 1.0 ECU_ADDRESS 0x0000 /* @ECU_Address@VINP_CANMsgValidBMS4_flg@ */ /end MEASUREMENT
/begin MEASUREMENT VINP_CANMsgValidBMS5_flg "" UBYTE SWC_INP_type_CM_boolean_flg 0 0 0.0 1.0 ECU_ADDRESS 0x0000 /* @ECU_Address@VINP_CANMsgValidBMS5_flg@ */ /end MEASUREMENT
/begin MEASUREMENT VINP_CANMsgValidBMS6_flg "" UBYTE SWC_INP_type_CM_boolean_flg 0 0 0.0 1.0 ECU_ADDRESS 0x0000 /* @ECU_Address@VINP_CANMsgValidBMS6_flg@ */ /end MEASUREMENT
/begin MEASUREMENT VINP_CANMsgValidBMS8_flg "" UBYTE SWC_INP_type_CM_boolean_flg 0 0 0.0 1.0 ECU_ADDRESS 0x0000 /* @ECU_Address@VINP_CANMsgValidBMS8_flg@ */ /end MEASUREMENT
/begin MEASUREMENT VINP_CANMsgValidCCU1_flg "" UBYTE SWC_INP_type_CM_boolean_flg 0 0 0.0 1.0 ECU_ADDRESS 0x0000 /* @ECU_Address@VINP_CANMsgValidCCU1_flg@ */ /end MEASUREMENT
/begin MEASUREMENT VINP_CANMsgValidCCU2_flg "" UBYTE SWC_INP_type_CM_boolean_flg 0 0 0.0 1.0 ECU_ADDRESS 0x0000 /* @ECU_Address@VINP_CANMsgValidCCU2_flg@ */ /end MEASUREMENT
/begin MEASUREMENT VINP_CANMsgValidEBM1_flg "" UBYTE SWC_INP_type_CM_boolean_flg 0 0 0.0 1.0 ECU_ADDRESS 0x0000 /* @ECU_Address@VINP_CANMsgValidEBM1_flg@ */ /end MEASUREMENT
/begin MEASUREMENT VINP_OBCWakeup4Plugin_flg "" UBYTE SWC_INP_type_CM_boolean_flg 0 0 0.0 1.0 ECU_ADDRESS 0x0000 /* @ECU_Address@VINP_OBCWakeup4Plugin_flg@ */ /end MEASUREMENT
/begin MEASUREMENT VINP_CCU2CSErr_flg "" UBYTE SWC_INP_type_CM_boolean_flg 0 0 0.0 1.0 ECU_ADDRESS 0x0000 /* @ECU_Address@VINP_CCU2CSErr_flg@ */ /end MEASUREMENT
/begin MEASUREMENT VINP_CCU2RCErr_flg "" UBYTE SWC_INP_type_CM_boolean_flg 0 0 0.0 1.0 ECU_ADDRESS 0x0000 /* @ECU_Address@VINP_CCU2RCErr_flg@ */ /end MEASUREMENT
/begin MEASUREMENT VINP_DCDCEnaSta_flg "" UBYTE SWC_INP_type_CM_boolean_flg 0 0 0.0 1.0 ECU_ADDRESS 0x0000 /* @ECU_Address@VINP_DCDCEnaSta_flg@ */ /end MEASUREMENT
/begin MEASUREMENT VINP_DCDCReady4Pre_flg "" UBYTE SWC_INP_type_CM_boolean_flg 0 0 0.0 1.0 ECU_ADDRESS 0x0000 /* @ECU_Address@VINP_DCDCReady4Pre_flg@ */ /end MEASUREMENT
/begin MEASUREMENT VINP_OBCEnaSta_flg "" UBYTE SWC_INP_type_CM_boolean_flg 0 0 0.0 1.0 ECU_ADDRESS 0x0000 /* @ECU_Address@VINP_OBCEnaSta_flg@ */ /end MEASUREMENT
/begin MEASUREMENT VINP_OBCPluginSta_flg "" UBYTE SWC_INP_type_CM_boolean_flg 0 0 0.0 1.0 ECU_ADDRESS 0x0000 /* @ECU_Address@VINP_OBCPluginSta_flg@ */ /end MEASUREMENT
/begin MEASUREMENT VINP_OBCReady4Pre_flg "" UBYTE SWC_INP_type_CM_boolean_flg 0 0 0.0 1.0 ECU_ADDRESS 0x0000 /* @ECU_Address@VINP_OBCReady4Pre_flg@ */ /end MEASUREMENT
/begin MEASUREMENT VINP_MCUBF1CSErr_flg "" UBYTE SWC_INP_type_CM_boolean_flg 0 0 0.0 1.0 ECU_ADDRESS 0x0000 /* @ECU_Address@VINP_MCUBF1CSErr_flg@ */ /end MEASUREMENT
/begin MEASUREMENT VINP_MCUBF1RCErr_flg "" UBYTE SWC_INP_type_CM_boolean_flg 0 0 0.0 1.0 ECU_ADDRESS 0x0000 /* @ECU_Address@VINP_MCUBF1RCErr_flg@ */ /end MEASUREMENT
/begin MEASUREMENT VINP_FrActvDmpDisabSta_flg "" UBYTE SWC_INP_type_CM_boolean_flg 0 0 0.0 1.0 ECU_ADDRESS 0x0000 /* @ECU_Address@VINP_FrActvDmpDisabSta_flg@ */ /end MEASUREMENT
/begin MEASUREMENT VINP_FrEDUDrtSta_flg "" UBYTE SWC_INP_type_CM_boolean_flg 0 0 0.0 1.0 ECU_ADDRESS 0x0000 /* @ECU_Address@VINP_FrEDUDrtSta_flg@ */ /end MEASUREMENT
/begin MEASUREMENT VINP_FrEDUOpratingSta_flg "" UBYTE SWC_INP_type_CM_boolean_flg 0 0 0.0 1.0 ECU_ADDRESS 0x0000 /* @ECU_Address@VINP_FrEDUOpratingSta_flg@ */ /end MEASUREMENT
/begin MEASUREMENT VINP_FrMCUDischrgSta_flg "" UBYTE SWC_INP_type_CM_boolean_flg 0 0 0.0 1.0 ECU_ADDRESS 0x0000 /* @ECU_Address@VINP_FrMCUDischrgSta_flg@ */ /end MEASUREMENT
/begin MEASUREMENT VINP_FrMCUEnaSta_flg "" UBYTE SWC_INP_type_CM_boolean_flg 0 0 0.0 1.0 ECU_ADDRESS 0x0000 /* @ECU_Address@VINP_FrMCUEnaSta_flg@ */ /end MEASUREMENT
/begin MEASUREMENT VINP_FrMCUIGNsta_flg "" UBYTE SWC_INP_type_CM_boolean_flg 0 0 0.0 1.0 ECU_ADDRESS 0x0000 /* @ECU_Address@VINP_FrMCUIGNsta_flg@ */ /end MEASUREMENT
/begin MEASUREMENT VINP_FrMCUReady_flg "" UBYTE SWC_INP_type_CM_boolean_flg 0 0 0.0 1.0 ECU_ADDRESS 0x0000 /* @ECU_Address@VINP_FrMCUReady_flg@ */ /end MEASUREMENT
/begin MEASUREMENT VINP_FrMCUReady4Pre_flg "" UBYTE SWC_INP_type_CM_boolean_flg 0 0 0.0 1.0 ECU_ADDRESS 0x0000 /* @ECU_Address@VINP_FrMCUReady4Pre_flg@ */ /end MEASUREMENT
/begin MEASUREMENT VINP_MCUBR1CSErr_flg "" UBYTE SWC_INP_type_CM_boolean_flg 0 0 0.0 1.0 ECU_ADDRESS 0x0000 /* @ECU_Address@VINP_MCUBR1CSErr_flg@ */ /end MEASUREMENT
/begin MEASUREMENT VINP_MCUBR1RCErr_flg "" UBYTE SWC_INP_type_CM_boolean_flg 0 0 0.0 1.0 ECU_ADDRESS 0x0000 /* @ECU_Address@VINP_MCUBR1RCErr_flg@ */ /end MEASUREMENT
/begin MEASUREMENT VINP_RrActvDmpDisabSta_flg "" UBYTE SWC_INP_type_CM_boolean_flg 0 0 0.0 1.0 ECU_ADDRESS 0x0000 /* @ECU_Address@VINP_RrActvDmpDisabSta_flg@ */ /end MEASUREMENT
/begin MEASUREMENT VINP_RrEDUDrtSta_flg "" UBYTE SWC_INP_type_CM_boolean_flg 0 0 0.0 1.0 ECU_ADDRESS 0x0000 /* @ECU_Address@VINP_RrEDUDrtSta_flg@ */ /end MEASUREMENT
/begin MEASUREMENT VINP_RrEDUOpratingSta_flg "" UBYTE SWC_INP_type_CM_boolean_flg 0 0 0.0 1.0 ECU_ADDRESS 0x0000 /* @ECU_Address@VINP_RrEDUOpratingSta_flg@ */ /end MEASUREMENT
/begin MEASUREMENT VINP_RrMCUDischrgSta_flg "" UBYTE SWC_INP_type_CM_boolean_flg 0 0 0.0 1.0 ECU_ADDRESS 0x0000 /* @ECU_Address@VINP_RrMCUDischrgSta_flg@ */ /end MEASUREMENT
/begin MEASUREMENT VINP_RrMCUEnaSta_flg "" UBYTE SWC_INP_type_CM_boolean_flg 0 0 0.0 1.0 ECU_ADDRESS 0x0000 /* @ECU_Address@VINP_RrMCUEnaSta_flg@ */ /end MEASUREMENT
/begin MEASUREMENT VINP_RrMCUIGNsta_flg "" UBYTE SWC_INP_type_CM_boolean_flg 0 0 0.0 1.0 ECU_ADDRESS 0x0000 /* @ECU_Address@VINP_RrMCUIGNsta_flg@ */ /end MEASUREMENT
/begin MEASUREMENT VINP_RrMCUReady_flg "" UBYTE SWC_INP_type_CM_boolean_flg 0 0 0.0 1.0 ECU_ADDRESS 0x0000 /* @ECU_Address@VINP_RrMCUReady_flg@ */ /end MEASUREMENT
/begin MEASUREMENT VINP_RrMCUReady4Pre_flg "" UBYTE SWC_INP_type_CM_boolean_flg 0 0 0.0 1.0 ECU_ADDRESS 0x0000 /* @ECU_Address@VINP_RrMCUReady4Pre_flg@ */ /end MEASUREMENT
/begin MEASUREMENT VINP_MCUNF1CSErr_flg "" UBYTE SWC_INP_type_CM_boolean_flg 0 0 0.0 1.0 ECU_ADDRESS 0x0000 /* @ECU_Address@VINP_MCUNF1CSErr_flg@ */ /end MEASUREMENT
/begin MEASUREMENT VINP_MCUNF1RCErr_flg "" UBYTE SWC_INP_type_CM_boolean_flg 0 0 0.0 1.0 ECU_ADDRESS 0x0000 /* @ECU_Address@VINP_MCUNF1RCErr_flg@ */ /end MEASUREMENT
/begin MEASUREMENT VINP_FrActvDmpDisabStaNidec_flg "" UBYTE SWC_INP_type_CM_boolean_flg 0 0 0.0 1.0 ECU_ADDRESS 0x0000 /* @ECU_Address@VINP_FrActvDmpDisabStaNidec_flg@ */ /end MEASUREMENT
/begin MEASUREMENT VINP_FrEDUDrtStaNidec_flg "" UBYTE SWC_INP_type_CM_boolean_flg 0 0 0.0 1.0 ECU_ADDRESS 0x0000 /* @ECU_Address@VINP_FrEDUDrtStaNidec_flg@ */ /end MEASUREMENT
/begin MEASUREMENT VINP_FrEDUOpratingStaNidec_flg "" UBYTE SWC_INP_type_CM_boolean_flg 0 0 0.0 1.0 ECU_ADDRESS 0x0000 /* @ECU_Address@VINP_FrEDUOpratingStaNidec_flg@ */ /end MEASUREMENT
/begin MEASUREMENT VINP_FrMCUDischrgStaNidec_flg "" UBYTE SWC_INP_type_CM_boolean_flg 0 0 0.0 1.0 ECU_ADDRESS 0x0000 /* @ECU_Address@VINP_FrMCUDischrgStaNidec_flg@ */ /end MEASUREMENT
/begin MEASUREMENT VINP_FrMCUEnaStaNidec_flg "" UBYTE SWC_INP_type_CM_boolean_flg 0 0 0.0 1.0 ECU_ADDRESS 0x0000 /* @ECU_Address@VINP_FrMCUEnaStaNidec_flg@ */ /end MEASUREMENT
/begin MEASUREMENT VINP_FrMCUIGNstaNidec_flg "" UBYTE SWC_INP_type_CM_boolean_flg 0 0 0.0 1.0 ECU_ADDRESS 0x0000 /* @ECU_Address@VINP_FrMCUIGNstaNidec_flg@ */ /end MEASUREMENT
/begin MEASUREMENT VINP_FrMCUReady4PreNidec_flg "" UBYTE SWC_INP_type_CM_boolean_flg 0 0 0.0 1.0 ECU_ADDRESS 0x0000 /* @ECU_Address@VINP_FrMCUReady4PreNidec_flg@ */ /end MEASUREMENT
/begin MEASUREMENT VINP_FrMCUReadyNidec_flg "" UBYTE SWC_INP_type_CM_boolean_flg 0 0 0.0 1.0 ECU_ADDRESS 0x0000 /* @ECU_Address@VINP_FrMCUReadyNidec_flg@ */ /end MEASUREMENT
/begin MEASUREMENT VINP_BMS1RCErr_flg "" UBYTE SWC_INP_type_CM_boolean_flg 0 0 0.0 1.0 ECU_ADDRESS 0x0000 /* @ECU_Address@VINP_BMS1RCErr_flg@ */ /end MEASUREMENT
/begin MEASUREMENT VINP_MCUNR1CSErr_flg "" UBYTE SWC_INP_type_CM_boolean_flg 0 0 0.0 1.0 ECU_ADDRESS 0x0000 /* @ECU_Address@VINP_MCUNR1CSErr_flg@ */ /end MEASUREMENT
/begin MEASUREMENT VINP_MCUNR1RCErr_flg "" UBYTE SWC_INP_type_CM_boolean_flg 0 0 0.0 1.0 ECU_ADDRESS 0x0000 /* @ECU_Address@VINP_MCUNR1RCErr_flg@ */ /end MEASUREMENT
/begin MEASUREMENT VINP_RrActvDmpDisabStaNidec_flg "" UBYTE SWC_INP_type_CM_boolean_flg 0 0 0.0 1.0 ECU_ADDRESS 0x0000 /* @ECU_Address@VINP_RrActvDmpDisabStaNidec_flg@ */ /end MEASUREMENT
/begin MEASUREMENT VINP_RrEDUDrtStaNidec_flg "" UBYTE SWC_INP_type_CM_boolean_flg 0 0 0.0 1.0 ECU_ADDRESS 0x0000 /* @ECU_Address@VINP_RrEDUDrtStaNidec_flg@ */ /end MEASUREMENT
/begin MEASUREMENT VINP_RrEDUOpratingStaNidec_flg "" UBYTE SWC_INP_type_CM_boolean_flg 0 0 0.0 1.0 ECU_ADDRESS 0x0000 /* @ECU_Address@VINP_RrEDUOpratingStaNidec_flg@ */ /end MEASUREMENT
/begin MEASUREMENT VINP_RrMCUDischrgStaNidec_flg "" UBYTE SWC_INP_type_CM_boolean_flg 0 0 0.0 1.0 ECU_ADDRESS 0x0000 /* @ECU_Address@VINP_RrMCUDischrgStaNidec_flg@ */ /end MEASUREMENT
/begin MEASUREMENT VINP_RrMCUEnaStaNidec_flg "" UBYTE SWC_INP_type_CM_boolean_flg 0 0 0.0 1.0 ECU_ADDRESS 0x0000 /* @ECU_Address@VINP_RrMCUEnaStaNidec_flg@ */ /end MEASUREMENT
/begin MEASUREMENT VINP_RrMCUIGNstaNidec_flg "" UBYTE SWC_INP_type_CM_boolean_flg 0 0 0.0 1.0 ECU_ADDRESS 0x0000 /* @ECU_Address@VINP_RrMCUIGNstaNidec_flg@ */ /end MEASUREMENT
/begin MEASUREMENT VINP_RrMCUReady4PreNidec_flg "" UBYTE SWC_INP_type_CM_boolean_flg 0 0 0.0 1.0 ECU_ADDRESS 0x0000 /* @ECU_Address@VINP_RrMCUReady4PreNidec_flg@ */ /end MEASUREMENT
/begin MEASUREMENT VINP_RrMCUReadyNidec_flg "" UBYTE SWC_INP_type_CM_boolean_flg 0 0 0.0 1.0 ECU_ADDRESS 0x0000 /* @ECU_Address@VINP_RrMCUReadyNidec_flg@ */ /end MEASUREMENT
/begin MEASUREMENT VINP_Shifter1CSErr_flg "" UBYTE SWC_INP_type_CM_boolean_flg 0 0 0.0 1.0 ECU_ADDRESS 0x0000 /* @ECU_Address@VINP_Shifter1CSErr_flg@ */ /end MEASUREMENT
/begin MEASUREMENT VINP_Shifter1RCErr_flg "" UBYTE SWC_INP_type_CM_boolean_flg 0 0 0.0 1.0 ECU_ADDRESS 0x0000 /* @ECU_Address@VINP_Shifter1RCErr_flg@ */ /end MEASUREMENT
/begin MEASUREMENT VINP_Shifter2CSErr_flg "" UBYTE SWC_INP_type_CM_boolean_flg 0 0 0.0 1.0 ECU_ADDRESS 0x0000 /* @ECU_Address@VINP_Shifter2CSErr_flg@ */ /end MEASUREMENT
/begin MEASUREMENT VINP_Shifter2RCErr_flg "" UBYTE SWC_INP_type_CM_boolean_flg 0 0 0.0 1.0 ECU_ADDRESS 0x0000 /* @ECU_Address@VINP_Shifter2RCErr_flg@ */ /end MEASUREMENT
/begin MEASUREMENT VINP_CSW2DimSwSta_flg "" UBYTE SWC_INP_type_CM_boolean_flg 0 0 0.0 1.0 ECU_ADDRESS 0x0000 /* @ECU_Address@VINP_CSW2DimSwSta_flg@ */ /end MEASUREMENT
/begin MEASUREMENT VINP_CSW2PassSWSta_flg "" UBYTE SWC_INP_type_CM_boolean_flg 0 0 0.0 1.0 ECU_ADDRESS 0x0000 /* @ECU_Address@VINP_CSW2PassSWSta_flg@ */ /end MEASUREMENT
/begin MEASUREMENT VINP_FireDetErr_flg "" UBYTE SWC_INP_type_CM_boolean_flg 0 0 0.0 1.0 ECU_ADDRESS 0x0000 /* @ECU_Address@VINP_FireDetErr_flg@ */ /end MEASUREMENT
/begin MEASUREMENT VINP_HVBattErr_flg "" UBYTE SWC_INP_type_CM_boolean_flg 0 0 0.0 1.0 ECU_ADDRESS 0x0000 /* @ECU_Address@VINP_HVBattErr_flg@ */ /end MEASUREMENT
/begin MEASUREMENT VINP_BMS6CSErr_flg "" UBYTE SWC_INP_type_CM_boolean_flg 0 0 0.0 1.0 ECU_ADDRESS 0x0000 /* @ECU_Address@VINP_BMS6CSErr_flg@ */ /end MEASUREMENT
/begin MEASUREMENT VINP_BMS6RCErr_flg "" UBYTE SWC_INP_type_CM_boolean_flg 0 0 0.0 1.0 ECU_ADDRESS 0x0000 /* @ECU_Address@VINP_BMS6RCErr_flg@ */ /end MEASUREMENT
/begin MEASUREMENT VINP_BMSREADY_flg "" UBYTE SWC_INP_type_CM_boolean_flg 0 0 0.0 1.0 ECU_ADDRESS 0x0000 /* @ECU_Address@VINP_BMSREADY_flg@ */ /end MEASUREMENT
/begin MEASUREMENT VINP_BMSWarn1_flg "" UBYTE SWC_INP_type_CM_boolean_flg 0 0 0.0 1.0 ECU_ADDRESS 0x0000 /* @ECU_Address@VINP_BMSWarn1_flg@ */ /end MEASUREMENT
/begin MEASUREMENT VINP_BMSWarn2_flg "" UBYTE SWC_INP_type_CM_boolean_flg 0 0 0.0 1.0 ECU_ADDRESS 0x0000 /* @ECU_Address@VINP_BMSWarn2_flg@ */ /end MEASUREMENT
/begin MEASUREMENT VINP_BMSWarn3_flg "" UBYTE SWC_INP_type_CM_boolean_flg 0 0 0.0 1.0 ECU_ADDRESS 0x0000 /* @ECU_Address@VINP_BMSWarn3_flg@ */ /end MEASUREMENT
/begin MEASUREMENT VINP_BMSWarn4_flg "" UBYTE SWC_INP_type_CM_boolean_flg 0 0 0.0 1.0 ECU_ADDRESS 0x0000 /* @ECU_Address@VINP_BMSWarn4_flg@ */ /end MEASUREMENT
/begin MEASUREMENT VINP_BMSWarn5_flg "" UBYTE SWC_INP_type_CM_boolean_flg 0 0 0.0 1.0 ECU_ADDRESS 0x0000 /* @ECU_Address@VINP_BMSWarn5_flg@ */ /end MEASUREMENT
/begin MEASUREMENT VINP_BMSWarn6_flg "" UBYTE SWC_INP_type_CM_boolean_flg 0 0 0.0 1.0 ECU_ADDRESS 0x0000 /* @ECU_Address@VINP_BMSWarn6_flg@ */ /end MEASUREMENT
/begin MEASUREMENT VINP_BMSWarn7_flg "" UBYTE SWC_INP_type_CM_boolean_flg 0 0 0.0 1.0 ECU_ADDRESS 0x0000 /* @ECU_Address@VINP_BMSWarn7_flg@ */ /end MEASUREMENT
/begin MEASUREMENT VINP_BMSWarn8_flg "" UBYTE SWC_INP_type_CM_boolean_flg 0 0 0.0 1.0 ECU_ADDRESS 0x0000 /* @ECU_Address@VINP_BMSWarn8_flg@ */ /end MEASUREMENT
/begin MEASUREMENT VINP_HVBContactorSta_flg "" UBYTE SWC_INP_type_CM_boolean_flg 0 0 0.0 1.0 ECU_ADDRESS 0x0000 /* @ECU_Address@VINP_HVBContactorSta_flg@ */ /end MEASUREMENT
/begin MEASUREMENT VINP_HVBHVILErr_flg "" UBYTE SWC_INP_type_CM_boolean_flg 0 0 0.0 1.0 ECU_ADDRESS 0x0000 /* @ECU_Address@VINP_HVBHVILErr_flg@ */ /end MEASUREMENT
/begin MEASUREMENT VINP_HVBOvrTempErr_flg "" UBYTE SWC_INP_type_CM_boolean_flg 0 0 0.0 1.0 ECU_ADDRESS 0x0000 /* @ECU_Address@VINP_HVBOvrTempErr_flg@ */ /end MEASUREMENT
/begin MEASUREMENT VINP_HVILSta_flg "" UBYTE SWC_INP_type_CM_boolean_flg 0 0 0.0 1.0 ECU_ADDRESS 0x0000 /* @ECU_Address@VINP_HVILSta_flg@ */ /end MEASUREMENT
/begin MEASUREMENT VINP_CCU1CSErr_flg "" UBYTE SWC_INP_type_CM_boolean_flg 0 0 0.0 1.0 ECU_ADDRESS 0x0000 /* @ECU_Address@VINP_CCU1CSErr_flg@ */ /end MEASUREMENT
/begin MEASUREMENT VINP_CCU1RCErr_flg "" UBYTE SWC_INP_type_CM_boolean_flg 0 0 0.0 1.0 ECU_ADDRESS 0x0000 /* @ECU_Address@VINP_CCU1RCErr_flg@ */ /end MEASUREMENT
/begin MEASUREMENT VINP_CANMsgValidBodyZoneDR1_flg "" UBYTE SWC_INP_type_CM_boolean_flg 0 0 0.0 1.0 ECU_ADDRESS 0x0000 /* @ECU_Address@VINP_CANMsgValidBodyZoneDR1_flg@ */ /end MEASUREMENT
/begin MEASUREMENT VINP_BDDSEATAntiSta_flg "" UBYTE SWC_INP_type_CM_boolean_flg 0 0 0.0 1.0 ECU_ADDRESS 0x0000 /* @ECU_Address@VINP_BDDSEATAntiSta_flg@ */ /end MEASUREMENT
/begin MEASUREMENT VINP_CANMsgValidZONEFR1_flg "" UBYTE SWC_INP_type_CM_boolean_flg 0 0 0.0 1.0 ECU_ADDRESS 0x0000 /* @ECU_Address@VINP_CANMsgValidZONEFR1_flg@ */ /end MEASUREMENT
/begin MEASUREMENT VINP_CANMsgValidZONEFRVCU_flg "" UBYTE SWC_INP_type_CM_boolean_flg 0 0 0.0 1.0 ECU_ADDRESS 0x0000 /* @ECU_Address@VINP_CANMsgValidZONEFRVCU_flg@ */ /end MEASUREMENT
/begin MEASUREMENT VINP_CANMsgValidzGWAPTC1_flg "" UBYTE SWC_INP_type_CM_boolean_flg 0 0 0.0 1.0 ECU_ADDRESS 0x0000 /* @ECU_Address@VINP_CANMsgValidzGWAPTC1_flg@ */ /end MEASUREMENT
/begin MEASUREMENT VINP_CANMsgValidzGWCANFr1_flg "" UBYTE SWC_INP_type_CM_boolean_flg 0 0 0.0 1.0 ECU_ADDRESS 0x0000 /* @ECU_Address@VINP_CANMsgValidzGWCANFr1_flg@ */ /end MEASUREMENT
/begin MEASUREMENT VINP_CANMsgValidzGWLINDr1_flg "" UBYTE SWC_INP_type_CM_boolean_flg 0 0 0.0 1.0 ECU_ADDRESS 0x0000 /* @ECU_Address@VINP_CANMsgValidzGWLINDr1_flg@ */ /end MEASUREMENT
/begin MEASUREMENT VINP_CANMsgValidzGWLINDr2_flg "" UBYTE SWC_INP_type_CM_boolean_flg 0 0 0.0 1.0 ECU_ADDRESS 0x0000 /* @ECU_Address@VINP_CANMsgValidzGWLINDr2_flg@ */ /end MEASUREMENT
/begin MEASUREMENT VINP_CANMsgValidzGWLINFr1_flg "" UBYTE SWC_INP_type_CM_boolean_flg 0 0 0.0 1.0 ECU_ADDRESS 0x0000 /* @ECU_Address@VINP_CANMsgValidzGWLINFr1_flg@ */ /end MEASUREMENT
/begin MEASUREMENT VINP_CANMsgValidzGWLINFr2_flg "" UBYTE SWC_INP_type_CM_boolean_flg 0 0 0.0 1.0 ECU_ADDRESS 0x0000 /* @ECU_Address@VINP_CANMsgValidzGWLINFr2_flg@ */ /end MEASUREMENT
/begin MEASUREMENT VINP_CANMsgValidzGWSEAT1_flg "" UBYTE SWC_INP_type_CM_boolean_flg 0 0 0.0 1.0 ECU_ADDRESS 0x0000 /* @ECU_Address@VINP_CANMsgValidzGWSEAT1_flg@ */ /end MEASUREMENT
/begin MEASUREMENT VINP_CANMsgValidBodyZoneDR2_flg "" UBYTE SWC_INP_type_CM_boolean_flg 0 0 0.0 1.0 ECU_ADDRESS 0x0000 /* @ECU_Address@VINP_CANMsgValidBodyZoneDR2_flg@ */ /end MEASUREMENT
/begin MEASUREMENT VINP_CANMsgValidBodyZonePS1_flg "" UBYTE SWC_INP_type_CM_boolean_flg 0 0 0.0 1.0 ECU_ADDRESS 0x0000 /* @ECU_Address@VINP_CANMsgValidBodyZonePS1_flg@ */ /end MEASUREMENT
/begin MEASUREMENT VINP_CANMsgValidBodyZonePS2_flg "" UBYTE SWC_INP_type_CM_boolean_flg 0 0 0.0 1.0 ECU_ADDRESS 0x0000 /* @ECU_Address@VINP_CANMsgValidBodyZonePS2_flg@ */ /end MEASUREMENT
/begin MEASUREMENT VINP_CANMsgValidDKC1_flg "" UBYTE SWC_INP_type_CM_boolean_flg 0 0 0.0 1.0 ECU_ADDRESS 0x0000 /* @ECU_Address@VINP_CANMsgValidDKC1_flg@ */ /end MEASUREMENT
/begin MEASUREMENT VINP_CANMsgValidDKC2_flg "" UBYTE SWC_INP_type_CM_boolean_flg 0 0 0.0 1.0 ECU_ADDRESS 0x0000 /* @ECU_Address@VINP_CANMsgValidDKC2_flg@ */ /end MEASUREMENT
/begin MEASUREMENT VINP_CANMsgValidPTG1_flg "" UBYTE SWC_INP_type_CM_boolean_flg 0 0 0.0 1.0 ECU_ADDRESS 0x0000 /* @ECU_Address@VINP_CANMsgValidPTG1_flg@ */ /end MEASUREMENT
/begin MEASUREMENT VINP_CANMsgValidZONEDR1_flg "" UBYTE SWC_INP_type_CM_boolean_flg 0 0 0.0 1.0 ECU_ADDRESS 0x0000 /* @ECU_Address@VINP_CANMsgValidZONEDR1_flg@ */ /end MEASUREMENT
/begin MEASUREMENT VINP_CANMsgValidZONEDRVCU_flg "" UBYTE SWC_INP_type_CM_boolean_flg 0 0 0.0 1.0 ECU_ADDRESS 0x0000 /* @ECU_Address@VINP_CANMsgValidZONEDRVCU_flg@ */ /end MEASUREMENT
/begin MEASUREMENT VINP_ChargeInletLockSta_flg "" UBYTE SWC_INP_type_CM_boolean_flg 0 0 0.0 1.0 ECU_ADDRESS 0x0000 /* @ECU_Address@VINP_ChargeInletLockSta_flg@ */ /end MEASUREMENT
/begin MEASUREMENT VINP_CompProEN_flg "" UBYTE SWC_INP_type_CM_boolean_flg 0 0 0.0 1.0 ECU_ADDRESS 0x0000 /* @ECU_Address@VINP_CompProEN_flg@ */ /end MEASUREMENT
/begin MEASUREMENT VINP_FLTurnLPErr_flg "" UBYTE SWC_INP_type_CM_boolean_flg 0 0 0.0 1.0 ECU_ADDRESS 0x0000 /* @ECU_Address@VINP_FLTurnLPErr_flg@ */ /end MEASUREMENT
/begin MEASUREMENT VINP_FLTurnLightWarning_flg "" UBYTE SWC_INP_type_CM_boolean_flg 0 0 0.0 1.0 ECU_ADDRESS 0x0000 /* @ECU_Address@VINP_FLTurnLightWarning_flg@ */ /end MEASUREMENT
/begin MEASUREMENT VINP_FRTurnLPErr_flg "" UBYTE SWC_INP_type_CM_boolean_flg 0 0 0.0 1.0 ECU_ADDRESS 0x0000 /* @ECU_Address@VINP_FRTurnLPErr_flg@ */ /end MEASUREMENT
/begin MEASUREMENT VINP_FRTurnLightWarning_flg "" UBYTE SWC_INP_type_CM_boolean_flg 0 0 0.0 1.0 ECU_ADDRESS 0x0000 /* @ECU_Address@VINP_FRTurnLightWarning_flg@ */ /end MEASUREMENT
/begin MEASUREMENT VINP_FWiperAS_flg "" UBYTE SWC_INP_type_CM_boolean_flg 0 0 0.0 1.0 ECU_ADDRESS 0x0000 /* @ECU_Address@VINP_FWiperAS_flg@ */ /end MEASUREMENT
/begin MEASUREMENT VINP_FWiperProtection_flg "" UBYTE SWC_INP_type_CM_boolean_flg 0 0 0.0 1.0 ECU_ADDRESS 0x0000 /* @ECU_Address@VINP_FWiperProtection_flg@ */ /end MEASUREMENT
/begin MEASUREMENT VINP_LADBHibeamIndication_flg "" UBYTE SWC_INP_type_CM_boolean_flg 0 0 0.0 1.0 ECU_ADDRESS 0x0000 /* @ECU_Address@VINP_LADBHibeamIndication_flg@ */ /end MEASUREMENT
/begin MEASUREMENT VINP_LADBOperationStatus_flg "" UBYTE SWC_INP_type_CM_boolean_flg 0 0 0.0 1.0 ECU_ADDRESS 0x0000 /* @ECU_Address@VINP_LADBOperationStatus_flg@ */ /end MEASUREMENT
/begin MEASUREMENT VINP_LADBWarning_flg "" UBYTE SWC_INP_type_CM_boolean_flg 0 0 0.0 1.0 ECU_ADDRESS 0x0000 /* @ECU_Address@VINP_LADBWarning_flg@ */ /end MEASUREMENT
/begin MEASUREMENT VINP_LAHBWarning_flg "" UBYTE SWC_INP_type_CM_boolean_flg 0 0 0.0 1.0 ECU_ADDRESS 0x0000 /* @ECU_Address@VINP_LAHBWarning_flg@ */ /end MEASUREMENT
/begin MEASUREMENT VINP_LDRLWarning_flg "" UBYTE SWC_INP_type_CM_boolean_flg 0 0 0.0 1.0 ECU_ADDRESS 0x0000 /* @ECU_Address@VINP_LDRLWarning_flg@ */ /end MEASUREMENT
/begin MEASUREMENT VINP_LLBWarning_flg "" UBYTE SWC_INP_type_CM_boolean_flg 0 0 0.0 1.0 ECU_ADDRESS 0x0000 /* @ECU_Address@VINP_LLBWarning_flg@ */ /end MEASUREMENT
/begin MEASUREMENT VINP_LpositionLampWarning_flg "" UBYTE SWC_INP_type_CM_boolean_flg 0 0 0.0 1.0 ECU_ADDRESS 0x0000 /* @ECU_Address@VINP_LpositionLampWarning_flg@ */ /end MEASUREMENT
/begin MEASUREMENT VINP_RADBHibeamIndication_flg "" UBYTE SWC_INP_type_CM_boolean_flg 0 0 0.0 1.0 ECU_ADDRESS 0x0000 /* @ECU_Address@VINP_RADBHibeamIndication_flg@ */ /end MEASUREMENT
/begin MEASUREMENT VINP_RADBOperationStatus_flg "" UBYTE SWC_INP_type_CM_boolean_flg 0 0 0.0 1.0 ECU_ADDRESS 0x0000 /* @ECU_Address@VINP_RADBOperationStatus_flg@ */ /end MEASUREMENT
/begin MEASUREMENT VINP_RADBWarning_flg "" UBYTE SWC_INP_type_CM_boolean_flg 0 0 0.0 1.0 ECU_ADDRESS 0x0000 /* @ECU_Address@VINP_RADBWarning_flg@ */ /end MEASUREMENT
/begin MEASUREMENT VINP_RAHBWarning_flg "" UBYTE SWC_INP_type_CM_boolean_flg 0 0 0.0 1.0 ECU_ADDRESS 0x0000 /* @ECU_Address@VINP_RAHBWarning_flg@ */ /end MEASUREMENT
/begin MEASUREMENT VINP_RDRLWarning_flg "" UBYTE SWC_INP_type_CM_boolean_flg 0 0 0.0 1.0 ECU_ADDRESS 0x0000 /* @ECU_Address@VINP_RDRLWarning_flg@ */ /end MEASUREMENT
/begin MEASUREMENT VINP_RLBWarning_flg "" UBYTE SWC_INP_type_CM_boolean_flg 0 0 0.0 1.0 ECU_ADDRESS 0x0000 /* @ECU_Address@VINP_RLBWarning_flg@ */ /end MEASUREMENT
/begin MEASUREMENT VINP_RpositionLampWarning_flg "" UBYTE SWC_INP_type_CM_boolean_flg 0 0 0.0 1.0 ECU_ADDRESS 0x0000 /* @ECU_Address@VINP_RpositionLampWarning_flg@ */ /end MEASUREMENT
/begin MEASUREMENT VINP_TrailerCheck_flg "" UBYTE SWC_INP_type_CM_boolean_flg 0 0 0.0 1.0 ECU_ADDRESS 0x0000 /* @ECU_Address@VINP_TrailerCheck_flg@ */ /end MEASUREMENT
/begin MEASUREMENT VINP_ZFRBCMChargerDoorSWSta_flg "" UBYTE SWC_INP_type_CM_boolean_flg 0 0 0.0 1.0 ECU_ADDRESS 0x0000 /* @ECU_Address@VINP_ZFRBCMChargerDoorSWSta_flg@ */ /end MEASUREMENT
/begin MEASUREMENT VINP_ZFRBCMHRLTurnLPNormalSta_flg "" UBYTE SWC_INP_type_CM_boolean_flg 0 0 0.0 1.0 ECU_ADDRESS 0x0000 /* @ECU_Address@VINP_ZFRBCMHRLTurnLPNormalSta_flg@ */ /end MEASUREMENT
/begin MEASUREMENT VINP_ZFRBCMHRRTurnLPHNormalSta_flg "" UBYTE SWC_INP_type_CM_boolean_flg 0 0 0.0 1.0 ECU_ADDRESS 0x0000 /* @ECU_Address@VINP_ZFRBCMHRRTurnLPHNormalSta_flg@ */ /end MEASUREMENT
/begin MEASUREMENT VINP_FrPMMLimpHomeActReq_flg "" UBYTE SWC_INP_type_CM_boolean_flg 0 0 0.0 1.0 ECU_ADDRESS 0x0000 /* @ECU_Address@VINP_FrPMMLimpHomeActReq_flg@ */ /end MEASUREMENT
/begin MEASUREMENT VINP_CSWDimSw_flg "" UBYTE SWC_INP_type_CM_boolean_flg 0 0 0.0 1.0 ECU_ADDRESS 0x0000 /* @ECU_Address@VINP_CSWDimSw_flg@ */ /end MEASUREMENT
/begin MEASUREMENT VINP_CSWPassSWSta_flg "" UBYTE SWC_INP_type_CM_boolean_flg 0 0 0.0 1.0 ECU_ADDRESS 0x0000 /* @ECU_Address@VINP_CSWPassSWSta_flg@ */ /end MEASUREMENT
/begin MEASUREMENT VINP_FAPWL01LINResponseError_flg "" UBYTE SWC_INP_type_CM_boolean_flg 0 0 0.0 1.0 ECU_ADDRESS 0x0000 /* @ECU_Address@VINP_FAPWL01LINResponseError_flg@ */ /end MEASUREMENT
/begin MEASUREMENT VINP_LDrvMotorRelayError_flg "" UBYTE SWC_INP_type_CM_boolean_flg 0 0 0.0 1.0 ECU_ADDRESS 0x0000 /* @ECU_Address@VINP_LDrvMotorRelayError_flg@ */ /end MEASUREMENT
/begin MEASUREMENT VINP_LDrvMotorRippleError_flg "" UBYTE SWC_INP_type_CM_boolean_flg 0 0 0.0 1.0 ECU_ADDRESS 0x0000 /* @ECU_Address@VINP_LDrvMotorRippleError_flg@ */ /end MEASUREMENT
/begin MEASUREMENT VINP_BDDSEATEntryFunSta_flg "" UBYTE SWC_INP_type_CM_boolean_flg 0 0 0.0 1.0 ECU_ADDRESS 0x0000 /* @ECU_Address@VINP_BDDSEATEntryFunSta_flg@ */ /end MEASUREMENT
/begin MEASUREMENT VINP_LPasMotorRelayError_flg "" UBYTE SWC_INP_type_CM_boolean_flg 0 0 0.0 1.0 ECU_ADDRESS 0x0000 /* @ECU_Address@VINP_LPasMotorRelayError_flg@ */ /end MEASUREMENT
/begin MEASUREMENT VINP_LPasMotorRippleError_flg "" UBYTE SWC_INP_type_CM_boolean_flg 0 0 0.0 1.0 ECU_ADDRESS 0x0000 /* @ECU_Address@VINP_LPasMotorRippleError_flg@ */ /end MEASUREMENT
/begin MEASUREMENT VINP_LRLDMotorRelayError_flg "" UBYTE SWC_INP_type_CM_boolean_flg 0 0 0.0 1.0 ECU_ADDRESS 0x0000 /* @ECU_Address@VINP_LRLDMotorRelayError_flg@ */ /end MEASUREMENT
/begin MEASUREMENT VINP_LRLDMotorRippleError_flg "" UBYTE SWC_INP_type_CM_boolean_flg 0 0 0.0 1.0 ECU_ADDRESS 0x0000 /* @ECU_Address@VINP_LRLDMotorRippleError_flg@ */ /end MEASUREMENT
/begin MEASUREMENT VINP_LRRDMotorRelayError_flg "" UBYTE SWC_INP_type_CM_boolean_flg 0 0 0.0 1.0 ECU_ADDRESS 0x0000 /* @ECU_Address@VINP_LRRDMotorRelayError_flg@ */ /end MEASUREMENT
/begin MEASUREMENT VINP_BDDSEATErrorSta_flg "" UBYTE SWC_INP_type_CM_boolean_flg 0 0 0.0 1.0 ECU_ADDRESS 0x0000 /* @ECU_Address@VINP_BDDSEATErrorSta_flg@ */ /end MEASUREMENT
/begin MEASUREMENT VINP_LRRDMotorRippleError_flg "" UBYTE SWC_INP_type_CM_boolean_flg 0 0 0.0 1.0 ECU_ADDRESS 0x0000 /* @ECU_Address@VINP_LRRDMotorRippleError_flg@ */ /end MEASUREMENT
/begin MEASUREMENT VINP_RAPWL01LINResponseError_flg "" UBYTE SWC_INP_type_CM_boolean_flg 0 0 0.0 1.0 ECU_ADDRESS 0x0000 /* @ECU_Address@VINP_RAPWL01LINResponseError_flg@ */ /end MEASUREMENT
/begin MEASUREMENT VINP_RLSLampSta_flg "" UBYTE SWC_INP_type_CM_boolean_flg 0 0 0.0 1.0 ECU_ADDRESS 0x0000 /* @ECU_Address@VINP_RLSLampSta_flg@ */ /end MEASUREMENT
/begin MEASUREMENT VINP_SWC2LADASSta_flg "" UBYTE SWC_INP_type_CM_boolean_flg 0 0 0.0 1.0 ECU_ADDRESS 0x0000 /* @ECU_Address@VINP_SWC2LADASSta_flg@ */ /end MEASUREMENT
/begin MEASUREMENT VINP_SWC2LDriveModeSta_flg "" UBYTE SWC_INP_type_CM_boolean_flg 0 0 0.0 1.0 ECU_ADDRESS 0x0000 /* @ECU_Address@VINP_SWC2LDriveModeSta_flg@ */ /end MEASUREMENT
/begin MEASUREMENT VINP_SWC2LHomeSta_flg "" UBYTE SWC_INP_type_CM_boolean_flg 0 0 0.0 1.0 ECU_ADDRESS 0x0000 /* @ECU_Address@VINP_SWC2LHomeSta_flg@ */ /end MEASUREMENT
/begin MEASUREMENT VINP_SWC2LLeftSta_flg "" UBYTE SWC_INP_type_CM_boolean_flg 0 0 0.0 1.0 ECU_ADDRESS 0x0000 /* @ECU_Address@VINP_SWC2LLeftSta_flg@ */ /end MEASUREMENT
/begin MEASUREMENT VINP_SWC2LRegenUpSta_flg "" UBYTE SWC_INP_type_CM_boolean_flg 0 0 0.0 1.0 ECU_ADDRESS 0x0000 /* @ECU_Address@VINP_SWC2LRegenUpSta_flg@ */ /end MEASUREMENT
/begin MEASUREMENT VINP_SWC2LRightSta_flg "" UBYTE SWC_INP_type_CM_boolean_flg 0 0 0.0 1.0 ECU_ADDRESS 0x0000 /* @ECU_Address@VINP_SWC2LRightSta_flg@ */ /end MEASUREMENT
/begin MEASUREMENT VINP_SWC2LScrollDownSta_flg "" UBYTE SWC_INP_type_CM_boolean_flg 0 0 0.0 1.0 ECU_ADDRESS 0x0000 /* @ECU_Address@VINP_SWC2LScrollDownSta_flg@ */ /end MEASUREMENT
/begin MEASUREMENT VINP_SWC2LScrollPressSta_flg "" UBYTE SWC_INP_type_CM_boolean_flg 0 0 0.0 1.0 ECU_ADDRESS 0x0000 /* @ECU_Address@VINP_SWC2LScrollPressSta_flg@ */ /end MEASUREMENT
/begin MEASUREMENT VINP_SWC2LScrollUpSta_flg "" UBYTE SWC_INP_type_CM_boolean_flg 0 0 0.0 1.0 ECU_ADDRESS 0x0000 /* @ECU_Address@VINP_SWC2LScrollUpSta_flg@ */ /end MEASUREMENT
/begin MEASUREMENT VINP_SWC2RCustomizeSta_flg "" UBYTE SWC_INP_type_CM_boolean_flg 0 0 0.0 1.0 ECU_ADDRESS 0x0000 /* @ECU_Address@VINP_SWC2RCustomizeSta_flg@ */ /end MEASUREMENT
/begin MEASUREMENT VINP_SWC2RLeftSta_flg "" UBYTE SWC_INP_type_CM_boolean_flg 0 0 0.0 1.0 ECU_ADDRESS 0x0000 /* @ECU_Address@VINP_SWC2RLeftSta_flg@ */ /end MEASUREMENT
/begin MEASUREMENT VINP_SWC2RPageSwitchSta_flg "" UBYTE SWC_INP_type_CM_boolean_flg 0 0 0.0 1.0 ECU_ADDRESS 0x0000 /* @ECU_Address@VINP_SWC2RPageSwitchSta_flg@ */ /end MEASUREMENT
/begin MEASUREMENT VINP_SWC2RRegenDownSta_flg "" UBYTE SWC_INP_type_CM_boolean_flg 0 0 0.0 1.0 ECU_ADDRESS 0x0000 /* @ECU_Address@VINP_SWC2RRegenDownSta_flg@ */ /end MEASUREMENT
/begin MEASUREMENT VINP_SWC2RRightSta_flg "" UBYTE SWC_INP_type_CM_boolean_flg 0 0 0.0 1.0 ECU_ADDRESS 0x0000 /* @ECU_Address@VINP_SWC2RRightSta_flg@ */ /end MEASUREMENT
/begin MEASUREMENT VINP_SWC2RScrollDownSta_flg "" UBYTE SWC_INP_type_CM_boolean_flg 0 0 0.0 1.0 ECU_ADDRESS 0x0000 /* @ECU_Address@VINP_SWC2RScrollDownSta_flg@ */ /end MEASUREMENT
/begin MEASUREMENT VINP_SWC2RScrollPressSta_flg "" UBYTE SWC_INP_type_CM_boolean_flg 0 0 0.0 1.0 ECU_ADDRESS 0x0000 /* @ECU_Address@VINP_SWC2RScrollPressSta_flg@ */ /end MEASUREMENT
/begin MEASUREMENT VINP_SWC2RScrollUpSta_flg "" UBYTE SWC_INP_type_CM_boolean_flg 0 0 0.0 1.0 ECU_ADDRESS 0x0000 /* @ECU_Address@VINP_SWC2RScrollUpSta_flg@ */ /end MEASUREMENT
/begin MEASUREMENT VINP_SWC2RVRSta_flg "" UBYTE SWC_INP_type_CM_boolean_flg 0 0 0.0 1.0 ECU_ADDRESS 0x0000 /* @ECU_Address@VINP_SWC2RVRSta_flg@ */ /end MEASUREMENT
/begin MEASUREMENT VINP_SWCACCSta_flg "" UBYTE SWC_INP_type_CM_boolean_flg 0 0 0.0 1.0 ECU_ADDRESS 0x0000 /* @ECU_Address@VINP_SWCACCSta_flg@ */ /end MEASUREMENT
/begin MEASUREMENT VINP_SWCCANCELSta_flg "" UBYTE SWC_INP_type_CM_boolean_flg 0 0 0.0 1.0 ECU_ADDRESS 0x0000 /* @ECU_Address@VINP_SWCCANCELSta_flg@ */ /end MEASUREMENT
/begin MEASUREMENT VINP_SWCDistanceSta_flg "" UBYTE SWC_INP_type_CM_boolean_flg 0 0 0.0 1.0 ECU_ADDRESS 0x0000 /* @ECU_Address@VINP_SWCDistanceSta_flg@ */ /end MEASUREMENT
/begin MEASUREMENT VINP_SWCDownSta_flg "" UBYTE SWC_INP_type_CM_boolean_flg 0 0 0.0 1.0 ECU_ADDRESS 0x0000 /* @ECU_Address@VINP_SWCDownSta_flg@ */ /end MEASUREMENT
/begin MEASUREMENT VINP_SWCLKASta_flg "" UBYTE SWC_INP_type_CM_boolean_flg 0 0 0.0 1.0 ECU_ADDRESS 0x0000 /* @ECU_Address@VINP_SWCLKASta_flg@ */ /end MEASUREMENT
/begin MEASUREMENT VINP_SWCLeftSta_flg "" UBYTE SWC_INP_type_CM_boolean_flg 0 0 0.0 1.0 ECU_ADDRESS 0x0000 /* @ECU_Address@VINP_SWCLeftSta_flg@ */ /end MEASUREMENT
/begin MEASUREMENT VINP_SWCRegenDown_flg "" UBYTE SWC_INP_type_CM_boolean_flg 0 0 0.0 1.0 ECU_ADDRESS 0x0000 /* @ECU_Address@VINP_SWCRegenDown_flg@ */ /end MEASUREMENT
/begin MEASUREMENT VINP_SWCRegenUp_flg "" UBYTE SWC_INP_type_CM_boolean_flg 0 0 0.0 1.0 ECU_ADDRESS 0x0000 /* @ECU_Address@VINP_SWCRegenUp_flg@ */ /end MEASUREMENT
/begin MEASUREMENT VINP_SWCResUpSta_flg "" UBYTE SWC_INP_type_CM_boolean_flg 0 0 0.0 1.0 ECU_ADDRESS 0x0000 /* @ECU_Address@VINP_SWCResUpSta_flg@ */ /end MEASUREMENT
/begin MEASUREMENT VINP_SWCRightSta_flg "" UBYTE SWC_INP_type_CM_boolean_flg 0 0 0.0 1.0 ECU_ADDRESS 0x0000 /* @ECU_Address@VINP_SWCRightSta_flg@ */ /end MEASUREMENT
/begin MEASUREMENT VINP_SWCSetdownSta_flg "" UBYTE SWC_INP_type_CM_boolean_flg 0 0 0.0 1.0 ECU_ADDRESS 0x0000 /* @ECU_Address@VINP_SWCSetdownSta_flg@ */ /end MEASUREMENT
/begin MEASUREMENT VINP_SWCTripSta_flg "" UBYTE SWC_INP_type_CM_boolean_flg 0 0 0.0 1.0 ECU_ADDRESS 0x0000 /* @ECU_Address@VINP_SWCTripSta_flg@ */ /end MEASUREMENT
/begin MEASUREMENT VINP_SWCUndefinedSta_flg "" UBYTE SWC_INP_type_CM_boolean_flg 0 0 0.0 1.0 ECU_ADDRESS 0x0000 /* @ECU_Address@VINP_SWCUndefinedSta_flg@ */ /end MEASUREMENT
/begin MEASUREMENT VINP_SWCUpSta_flg "" UBYTE SWC_INP_type_CM_boolean_flg 0 0 0.0 1.0 ECU_ADDRESS 0x0000 /* @ECU_Address@VINP_SWCUpSta_flg@ */ /end MEASUREMENT
/begin MEASUREMENT VINP_SWCVRSta_flg "" UBYTE SWC_INP_type_CM_boolean_flg 0 0 0.0 1.0 ECU_ADDRESS 0x0000 /* @ECU_Address@VINP_SWCVRSta_flg@ */ /end MEASUREMENT
/begin MEASUREMENT VINP_SWCmodeSta_flg "" UBYTE SWC_INP_type_CM_boolean_flg 0 0 0.0 1.0 ECU_ADDRESS 0x0000 /* @ECU_Address@VINP_SWCmodeSta_flg@ */ /end MEASUREMENT
/begin MEASUREMENT VINP_ACT1ResponseError_flg "" UBYTE SWC_INP_type_CM_boolean_flg 0 0 0.0 1.0 ECU_ADDRESS 0x0000 /* @ECU_Address@VINP_ACT1ResponseError_flg@ */ /end MEASUREMENT
/begin MEASUREMENT VINP_DSEATAntiSta_flg "" UBYTE SWC_INP_type_CM_boolean_flg 0 0 0.0 1.0 ECU_ADDRESS 0x0000 /* @ECU_Address@VINP_DSEATAntiSta_flg@ */ /end MEASUREMENT
/begin MEASUREMENT VINP_DSEATEntryFunSta_flg "" UBYTE SWC_INP_type_CM_boolean_flg 0 0 0.0 1.0 ECU_ADDRESS 0x0000 /* @ECU_Address@VINP_DSEATEntryFunSta_flg@ */ /end MEASUREMENT
/begin MEASUREMENT VINP_DSEATErrorSta_flg "" UBYTE SWC_INP_type_CM_boolean_flg 0 0 0.0 1.0 ECU_ADDRESS 0x0000 /* @ECU_Address@VINP_DSEATErrorSta_flg@ */ /end MEASUREMENT
/begin MEASUREMENT VINP_PSEATErrorSta_flg "" UBYTE SWC_INP_type_CM_boolean_flg 0 0 0.0 1.0 ECU_ADDRESS 0x0000 /* @ECU_Address@VINP_PSEATErrorSta_flg@ */ /end MEASUREMENT
/begin MEASUREMENT VINP_BDDoorFHandleCloseSta_flg "" UBYTE SWC_INP_type_CM_boolean_flg 0 0 0.0 1.0 ECU_ADDRESS 0x0000 /* @ECU_Address@VINP_BDDoorFHandleCloseSta_flg@ */ /end MEASUREMENT
/begin MEASUREMENT VINP_BDDoorRHandleCloseSta_flg "" UBYTE SWC_INP_type_CM_boolean_flg 0 0 0.0 1.0 ECU_ADDRESS 0x0000 /* @ECU_Address@VINP_BDDoorRHandleCloseSta_flg@ */ /end MEASUREMENT
/begin MEASUREMENT VINP_BPPSEATErrorSta_flg "" UBYTE SWC_INP_type_CM_boolean_flg 0 0 0.0 1.0 ECU_ADDRESS 0x0000 /* @ECU_Address@VINP_BPPSEATErrorSta_flg@ */ /end MEASUREMENT
/begin MEASUREMENT VINP_BPPTGExistSta_flg "" UBYTE SWC_INP_type_CM_boolean_flg 0 0 0.0 1.0 ECU_ADDRESS 0x0000 /* @ECU_Address@VINP_BPPTGExistSta_flg@ */ /end MEASUREMENT
/begin MEASUREMENT VINP_BPPTGIsSetHeightSta_flg "" UBYTE SWC_INP_type_CM_boolean_flg 0 0 0.0 1.0 ECU_ADDRESS 0x0000 /* @ECU_Address@VINP_BPPTGIsSetHeightSta_flg@ */ /end MEASUREMENT
/begin MEASUREMENT VINP_BPDoorFHandleCloseSta_flg "" UBYTE SWC_INP_type_CM_boolean_flg 0 0 0.0 1.0 ECU_ADDRESS 0x0000 /* @ECU_Address@VINP_BPDoorFHandleCloseSta_flg@ */ /end MEASUREMENT
/begin MEASUREMENT VINP_BPDoorRHandleCloseSta_flg "" UBYTE SWC_INP_type_CM_boolean_flg 0 0 0.0 1.0 ECU_ADDRESS 0x0000 /* @ECU_Address@VINP_BPDoorRHandleCloseSta_flg@ */ /end MEASUREMENT
/begin MEASUREMENT VINP_PKeyMiss_flg "" UBYTE SWC_INP_type_CM_boolean_flg 0 0 0.0 1.0 ECU_ADDRESS 0x0000 /* @ECU_Address@VINP_PKeyMiss_flg@ */ /end MEASUREMENT
/begin MEASUREMENT VINP_PUIDLowPower_flg "" UBYTE SWC_INP_type_CM_boolean_flg 0 0 0.0 1.0 ECU_ADDRESS 0x0000 /* @ECU_Address@VINP_PUIDLowPower_flg@ */ /end MEASUREMENT
/begin MEASUREMENT VINP_PTGAutoStaus_flg "" UBYTE SWC_INP_type_CM_boolean_flg 0 0 0.0 1.0 ECU_ADDRESS 0x0000 /* @ECU_Address@VINP_PTGAutoStaus_flg@ */ /end MEASUREMENT
/begin MEASUREMENT VINP_PTGExist_flg "" UBYTE SWC_INP_type_CM_boolean_flg 0 0 0.0 1.0 ECU_ADDRESS 0x0000 /* @ECU_Address@VINP_PTGExist_flg@ */ /end MEASUREMENT
/begin MEASUREMENT VINP_PTGIsSetHeight_flg "" UBYTE SWC_INP_type_CM_boolean_flg 0 0 0.0 1.0 ECU_ADDRESS 0x0000 /* @ECU_Address@VINP_PTGIsSetHeight_flg@ */ /end MEASUREMENT
/begin MEASUREMENT VINP_DrLockSta_flg "" UBYTE SWC_INP_type_CM_boolean_flg 0 0 0.0 1.0 ECU_ADDRESS 0x0000 /* @ECU_Address@VINP_DrLockSta_flg@ */ /end MEASUREMENT
/begin MEASUREMENT VINP_MIRRORFOLDSW_flg "" UBYTE SWC_INP_type_CM_boolean_flg 0 0 0.0 1.0 ECU_ADDRESS 0x0000 /* @ECU_Address@VINP_MIRRORFOLDSW_flg@ */ /end MEASUREMENT
/begin MEASUREMENT VINP_RLTurnLPErr_flg "" UBYTE SWC_INP_type_CM_boolean_flg 0 0 0.0 1.0 ECU_ADDRESS 0x0000 /* @ECU_Address@VINP_RLTurnLPErr_flg@ */ /end MEASUREMENT
/begin MEASUREMENT VINP_RRTurnLPErr_flg "" UBYTE SWC_INP_type_CM_boolean_flg 0 0 0.0 1.0 ECU_ADDRESS 0x0000 /* @ECU_Address@VINP_RRTurnLPErr_flg@ */ /end MEASUREMENT
/begin MEASUREMENT VINP_RWiperAS_flg "" UBYTE SWC_INP_type_CM_boolean_flg 0 0 0.0 1.0 ECU_ADDRESS 0x0000 /* @ECU_Address@VINP_RWiperAS_flg@ */ /end MEASUREMENT
/begin MEASUREMENT VINP_RWiperProtection_flg "" UBYTE SWC_INP_type_CM_boolean_flg 0 0 0.0 1.0 ECU_ADDRESS 0x0000 /* @ECU_Address@VINP_RWiperProtection_flg@ */ /end MEASUREMENT
/begin MEASUREMENT VINP_DrPMMLVOutPErrLmp_flg "" UBYTE SWC_INP_type_CM_boolean_flg 0 0 0.0 1.0 ECU_ADDRESS 0x0000 /* @ECU_Address@VINP_DrPMMLVOutPErrLmp_flg@ */ /end MEASUREMENT
/begin MEASUREMENT VINP_DrPMMSysErrLmp_flg "" UBYTE SWC_INP_type_CM_boolean_flg 0 0 0.0 1.0 ECU_ADDRESS 0x0000 /* @ECU_Address@VINP_DrPMMSysErrLmp_flg@ */ /end MEASUREMENT
/begin MEASUREMENT VINP_DrSCPSysErrLmp_flg "" UBYTE SWC_INP_type_CM_boolean_flg 0 0 0.0 1.0 ECU_ADDRESS 0x0000 /* @ECU_Address@VINP_DrSCPSysErrLmp_flg@ */ /end MEASUREMENT
/begin MEASUREMENT VINP_DrStdAErrSta_flg "" UBYTE SWC_INP_type_CM_boolean_flg 0 0 0.0 1.0 ECU_ADDRESS 0x0000 /* @ECU_Address@VINP_DrStdAErrSta_flg@ */ /end MEASUREMENT
/begin MEASUREMENT VINP_CANMsgValidTBOX2_flg "" UBYTE SWC_INP_type_CM_boolean_flg 0 0 0.0 1.0 ECU_ADDRESS 0x0000 /* @ECU_Address@VINP_CANMsgValidTBOX2_flg@ */ /end MEASUREMENT
/begin MEASUREMENT VINP_CANMsgValidTBOX3_flg "" UBYTE SWC_INP_type_CM_boolean_flg 0 0 0.0 1.0 ECU_ADDRESS 0x0000 /* @ECU_Address@VINP_CANMsgValidTBOX3_flg@ */ /end MEASUREMENT
/begin MEASUREMENT VINP_CANMsgValidFCM1_flg "" UBYTE SWC_INP_type_CM_boolean_flg 0 0 0.0 1.0 ECU_ADDRESS 0x0000 /* @ECU_Address@VINP_CANMsgValidFCM1_flg@ */ /end MEASUREMENT
/begin MEASUREMENT VINP_CANMsgValidFCM2_flg "" UBYTE SWC_INP_type_CM_boolean_flg 0 0 0.0 1.0 ECU_ADDRESS 0x0000 /* @ECU_Address@VINP_CANMsgValidFCM2_flg@ */ /end MEASUREMENT
/begin MEASUREMENT VINP_CANMsgValidFCM3_flg "" UBYTE SWC_INP_type_CM_boolean_flg 0 0 0.0 1.0 ECU_ADDRESS 0x0000 /* @ECU_Address@VINP_CANMsgValidFCM3_flg@ */ /end MEASUREMENT
/begin MEASUREMENT VINP_CANMsgValidFCM4_flg "" UBYTE SWC_INP_type_CM_boolean_flg 0 0 0.0 1.0 ECU_ADDRESS 0x0000 /* @ECU_Address@VINP_CANMsgValidFCM4_flg@ */ /end MEASUREMENT
/begin MEASUREMENT VINP_CANMsgValidSRR1_flg "" UBYTE SWC_INP_type_CM_boolean_flg 0 0 0.0 1.0 ECU_ADDRESS 0x0000 /* @ECU_Address@VINP_CANMsgValidSRR1_flg@ */ /end MEASUREMENT
/begin MEASUREMENT VINP_ACCTakeoverReq_flg "" UBYTE SWC_INP_type_CM_boolean_flg 0 0 0.0 1.0 ECU_ADDRESS 0x0000 /* @ECU_Address@VINP_ACCTakeoverReq_flg@ */ /end MEASUREMENT
/begin MEASUREMENT VINP_ACCVehHoldReq_flg "" UBYTE SWC_INP_type_CM_boolean_flg 0 0 0.0 1.0 ECU_ADDRESS 0x0000 /* @ECU_Address@VINP_ACCVehHoldReq_flg@ */ /end MEASUREMENT
/begin MEASUREMENT VINP_ADASFCWMute_flg "" UBYTE SWC_INP_type_CM_boolean_flg 0 0 0.0 1.0 ECU_ADDRESS 0x0000 /* @ECU_Address@VINP_ADASFCWMute_flg@ */ /end MEASUREMENT
/begin MEASUREMENT VINP_ADASFaultSta_flg "" UBYTE SWC_INP_type_CM_boolean_flg 0 0 0.0 1.0 ECU_ADDRESS 0x0000 /* @ECU_Address@VINP_ADASFaultSta_flg@ */ /end MEASUREMENT
/begin MEASUREMENT VINP_ADASFltWrnReq_flg "" UBYTE SWC_INP_type_CM_boolean_flg 0 0 0.0 1.0 ECU_ADDRESS 0x0000 /* @ECU_Address@VINP_ADASFltWrnReq_flg@ */ /end MEASUREMENT
/begin MEASUREMENT VINP_ADASForceIdle_flg "" UBYTE SWC_INP_type_CM_boolean_flg 0 0 0.0 1.0 ECU_ADDRESS 0x0000 /* @ECU_Address@VINP_ADASForceIdle_flg@ */ /end MEASUREMENT
/begin MEASUREMENT VINP_ADASLDWMute_flg "" UBYTE SWC_INP_type_CM_boolean_flg 0 0 0.0 1.0 ECU_ADDRESS 0x0000 /* @ECU_Address@VINP_ADASLDWMute_flg@ */ /end MEASUREMENT
/begin MEASUREMENT VINP_ADASShftPosnReqA_flg "" UBYTE SWC_INP_type_CM_boolean_flg 0 0 0.0 1.0 ECU_ADDRESS 0x0000 /* @ECU_Address@VINP_ADASShftPosnReqA_flg@ */ /end MEASUREMENT
/begin MEASUREMENT VINP_AEBVehHoldReq_flg "" UBYTE SWC_INP_type_CM_boolean_flg 0 0 0.0 1.0 ECU_ADDRESS 0x0000 /* @ECU_Address@VINP_AEBVehHoldReq_flg@ */ /end MEASUREMENT
/begin MEASUREMENT VINP_CameraBlockage_flg "" UBYTE SWC_INP_type_CM_boolean_flg 0 0 0.0 1.0 ECU_ADDRESS 0x0000 /* @ECU_Address@VINP_CameraBlockage_flg@ */ /end MEASUREMENT
/begin MEASUREMENT VINP_FCMLKATOIFault_flg "" UBYTE SWC_INP_type_CM_boolean_flg 0 0 0.0 1.0 ECU_ADDRESS 0x0000 /* @ECU_Address@VINP_FCMLKATOIFault_flg@ */ /end MEASUREMENT
/begin MEASUREMENT VINP_HazardWarningReq_flg "" UBYTE SWC_INP_type_CM_boolean_flg 0 0 0.0 1.0 ECU_ADDRESS 0x0000 /* @ECU_Address@VINP_HazardWarningReq_flg@ */ /end MEASUREMENT
/begin MEASUREMENT VINP_LKAHODDisplayWarning_flg "" UBYTE SWC_INP_type_CM_boolean_flg 0 0 0.0 1.0 ECU_ADDRESS 0x0000 /* @ECU_Address@VINP_LKAHODDisplayWarning_flg@ */ /end MEASUREMENT
/begin MEASUREMENT VINP_LKAHODSoundWarning_flg "" UBYTE SWC_INP_type_CM_boolean_flg 0 0 0.0 1.0 ECU_ADDRESS 0x0000 /* @ECU_Address@VINP_LKAHODSoundWarning_flg@ */ /end MEASUREMENT
/begin MEASUREMENT VINP_LVDAACCStatusInformation_flg "" UBYTE SWC_INP_type_CM_boolean_flg 0 0 0.0 1.0 ECU_ADDRESS 0x0000 /* @ECU_Address@VINP_LVDAACCStatusInformation_flg@ */ /end MEASUREMENT
/begin MEASUREMENT VINP_LVDADisabled_flg "" UBYTE SWC_INP_type_CM_boolean_flg 0 0 0.0 1.0 ECU_ADDRESS 0x0000 /* @ECU_Address@VINP_LVDADisabled_flg@ */ /end MEASUREMENT
/begin MEASUREMENT VINP_LVDAFailinfo_flg "" UBYTE SWC_INP_type_CM_boolean_flg 0 0 0.0 1.0 ECU_ADDRESS 0x0000 /* @ECU_Address@VINP_LVDAFailinfo_flg@ */ /end MEASUREMENT
/begin MEASUREMENT VINP_LVDAWarning_flg "" UBYTE SWC_INP_type_CM_boolean_flg 0 0 0.0 1.0 ECU_ADDRESS 0x0000 /* @ECU_Address@VINP_LVDAWarning_flg@ */ /end MEASUREMENT
/begin MEASUREMENT VINP_LeftTurnLightReq_flg "" UBYTE SWC_INP_type_CM_boolean_flg 0 0 0.0 1.0 ECU_ADDRESS 0x0000 /* @ECU_Address@VINP_LeftTurnLightReq_flg@ */ /end MEASUREMENT
/begin MEASUREMENT VINP_RightTurnLightReq_flg "" UBYTE SWC_INP_type_CM_boolean_flg 0 0 0.0 1.0 ECU_ADDRESS 0x0000 /* @ECU_Address@VINP_RightTurnLightReq_flg@ */ /end MEASUREMENT
/begin MEASUREMENT VINP_FCM2CSErr_flg "" UBYTE SWC_INP_type_CM_boolean_flg 0 0 0.0 1.0 ECU_ADDRESS 0x0000 /* @ECU_Address@VINP_FCM2CSErr_flg@ */ /end MEASUREMENT
/begin MEASUREMENT VINP_FCM2RCErr_flg "" UBYTE SWC_INP_type_CM_boolean_flg 0 0 0.0 1.0 ECU_ADDRESS 0x0000 /* @ECU_Address@VINP_FCM2RCErr_flg@ */ /end MEASUREMENT
/begin MEASUREMENT VINP_FCM4CSErr_flg "" UBYTE SWC_INP_type_CM_boolean_flg 0 0 0.0 1.0 ECU_ADDRESS 0x0000 /* @ECU_Address@VINP_FCM4CSErr_flg@ */ /end MEASUREMENT
/begin MEASUREMENT VINP_FCM4RCErr_flg "" UBYTE SWC_INP_type_CM_boolean_flg 0 0 0.0 1.0 ECU_ADDRESS 0x0000 /* @ECU_Address@VINP_FCM4RCErr_flg@ */ /end MEASUREMENT
/begin MEASUREMENT VINP_ADASDrvInputTqBoostAct_flg "" UBYTE SWC_INP_type_CM_boolean_flg 0 0 0.0 1.0 ECU_ADDRESS 0x0000 /* @ECU_Address@VINP_ADASDrvInputTqBoostAct_flg@ */ /end MEASUREMENT
/begin MEASUREMENT VINP_ADASStrWhlAngCtrlStatus_flg "" UBYTE SWC_INP_type_CM_boolean_flg 0 0 0.0 1.0 ECU_ADDRESS 0x0000 /* @ECU_Address@VINP_ADASStrWhlAngCtrlStatus_flg@ */ /end MEASUREMENT
/begin MEASUREMENT VINP_SRRODASoundL_flg "" UBYTE SWC_INP_type_CM_boolean_flg 0 0 0.0 1.0 ECU_ADDRESS 0x0000 /* @ECU_Address@VINP_SRRODASoundL_flg@ */ /end MEASUREMENT
/begin MEASUREMENT VINP_SRRODASoundR_flg "" UBYTE SWC_INP_type_CM_boolean_flg 0 0 0.0 1.0 ECU_ADDRESS 0x0000 /* @ECU_Address@VINP_SRRODASoundR_flg@ */ /end MEASUREMENT
/begin MEASUREMENT VINP_ClearDTCcmd_flg "" UBYTE SWC_INP_type_CM_boolean_flg 0 0 0.0 1.0 ECU_ADDRESS 0x0000 /* @ECU_Address@VINP_ClearDTCcmd_flg@ */ /end MEASUREMENT
/begin MEASUREMENT VINP_ClearZevDTCcmd_flg "" UBYTE SWC_INP_type_CM_boolean_flg 0 0 0.0 1.0 ECU_ADDRESS 0x0000 /* @ECU_Address@VINP_ClearZevDTCcmd_flg@ */ /end MEASUREMENT
/begin MEASUREMENT VINP_NFCDoorSta_flg "" UBYTE SWC_INP_type_CM_boolean_flg 0 0 0.0 1.0 ECU_ADDRESS 0x0000 /* @ECU_Address@VINP_NFCDoorSta_flg@ */ /end MEASUREMENT
/begin MEASUREMENT VINP_NFCLidASta_flg "" UBYTE SWC_INP_type_CM_boolean_flg 0 0 0.0 1.0 ECU_ADDRESS 0x0000 /* @ECU_Address@VINP_NFCLidASta_flg@ */ /end MEASUREMENT
/begin MEASUREMENT VINP_UWBRangingON_flg "" UBYTE SWC_INP_type_CM_boolean_flg 0 0 0.0 1.0 ECU_ADDRESS 0x0000 /* @ECU_Address@VINP_UWBRangingON_flg@ */ /end MEASUREMENT
/begin COMPU_METHOD SWC_INP_type_CM_single_mps2 "Q = V" RAT_FUNC "%8.6" "mps2" COEFFS 0 1 0 0 0 1 /end COMPU_METHOD
/begin COMPU_METHOD SWC_INP_type_CM_single_mps3 "Q = V" RAT_FUNC "%8.6" "mps3" COEFFS 0 1 0 0 0 1 /end COMPU_METHOD
/begin COMPU_METHOD SWC_INP_type_CM_single_m "Q = V" RAT_FUNC "%8.6" "m" COEFFS 0 1 0 0 0 1 /end COMPU_METHOD
/begin COMPU_METHOD SWC_INP_type_CM_single_mps "Q = V" RAT_FUNC "%8.6" "mps" COEFFS 0 1 0 0 0 1 /end COMPU_METHOD
/begin COMPU_METHOD SWC_INP_type_CM_single_A "Q = V" RAT_FUNC "%8.6" "A" COEFFS 0 1 0 0 0 1 /end COMPU_METHOD
/begin COMPU_METHOD SWC_INP_type_CM_single_pct "Q = V" RAT_FUNC "%8.6" "pct" COEFFS 0 1 0 0 0 1 /end COMPU_METHOD
/begin COMPU_METHOD SWC_INP_type_CM_single_Deg "Q = V" RAT_FUNC "%8.6" "Deg" COEFFS 0 1 0 0 0 1 /end COMPU_METHOD
/begin COMPU_METHOD SWC_INP_type_CM_single_raw32 "Q = V" RAT_FUNC "%8.6" "raw32" COEFFS 0 1 0 0 0 1 /end COMPU_METHOD
/begin COMPU_METHOD SWC_INP_type_CM_single_Nm "Q = V" RAT_FUNC "%8.6" "Nm" COEFFS 0 1 0 0 0 1 /end COMPU_METHOD
/begin COMPU_METHOD SWC_INP_type_CM_single_V "Q = V" RAT_FUNC "%8.6" "V" COEFFS 0 1 0 0 0 1 /end COMPU_METHOD
/begin COMPU_METHOD SWC_INP_type_CM_single_C "Q = V" RAT_FUNC "%8.6" "C" COEFFS 0 1 0 0 0 1 /end COMPU_METHOD
/begin COMPU_METHOD SWC_INP_type_CM_single_W "Q = V" RAT_FUNC "%8.6" "W" COEFFS 0 1 0 0 0 1 /end COMPU_METHOD
/begin COMPU_METHOD SWC_INP_type_CM_single_rpm "Q = V" RAT_FUNC "%8.6" "rpm" COEFFS 0 1 0 0 0 1 /end COMPU_METHOD
/begin COMPU_METHOD SWC_INP_type_CM_single_mA "Q = V" RAT_FUNC "%8.6" "mA" COEFFS 0 1 0 0 0 1 /end COMPU_METHOD
/begin COMPU_METHOD SWC_INP_type_CM_single_Lpmin "Q = V" RAT_FUNC "%8.6" "Lpmin" COEFFS 0 1 0 0 0 1 /end COMPU_METHOD
/begin COMPU_METHOD SWC_INP_type_CM_single_s "Q = V" RAT_FUNC "%8.6" "s" COEFFS 0 1 0 0 0 1 /end COMPU_METHOD
/begin COMPU_METHOD SWC_INP_type_CM_single_mV "Q = V" RAT_FUNC "%8.6" "mV" COEFFS 0 1 0 0 0 1 /end COMPU_METHOD
/begin COMPU_METHOD SWC_INP_type_CM_single_kWh "Q = V" RAT_FUNC "%8.6" "kWh" COEFFS 0 1 0 0 0 1 /end COMPU_METHOD
/begin COMPU_METHOD SWC_INP_type_CM_single_Megaohm "Q = V" RAT_FUNC "%8.6" "Megaohm" COEFFS 0 1 0 0 0 1 /end COMPU_METHOD
/begin COMPU_METHOD SWC_INP_type_CM_single_kW "Q = V" RAT_FUNC "%8.6" "kW" COEFFS 0 1 0 0 0 1 /end COMPU_METHOD
/begin COMPU_METHOD SWC_INP_type_CM_single_DAY "Q = V" RAT_FUNC "%8.6" "DAY" COEFFS 0 1 0 0 0 1 /end COMPU_METHOD
/begin COMPU_METHOD SWC_INP_type_CM_single_hr "Q = V" RAT_FUNC "%8.6" "hr" COEFFS 0 1 0 0 0 1 /end COMPU_METHOD
/begin COMPU_METHOD SWC_INP_type_CM_single_min "Q = V" RAT_FUNC "%8.6" "min" COEFFS 0 1 0 0 0 1 /end COMPU_METHOD
/begin COMPU_METHOD SWC_INP_type_CM_single_MONTH "Q = V" RAT_FUNC "%8.6" "MONTH" COEFFS 0 1 0 0 0 1 /end COMPU_METHOD
/begin COMPU_METHOD SWC_INP_type_CM_single_YEAR "Q = V" RAT_FUNC "%8.6" "YEAR" COEFFS 0 1 0 0 0 1 /end COMPU_METHOD
/begin COMPU_METHOD SWC_INP_type_CM_single_radians "Q = V" RAT_FUNC "%8.6" "radians" COEFFS 0 1 0 0 0 1 /end COMPU_METHOD
/begin COMPU_METHOD SWC_INP_type_CM_single_KPa "Q = V" RAT_FUNC "%8.6" "KPa" COEFFS 0 1 0 0 0 1 /end COMPU_METHOD
/begin COMPU_METHOD SWC_INP_type_CM_single_cnt "Q = V" RAT_FUNC "%8.6" "cnt" COEFFS 0 1 0 0 0 1 /end COMPU_METHOD
/begin COMPU_METHOD SWC_INP_type_CM_uint32_enum "Q = V" RAT_FUNC "%10.0" "enum" COEFFS 0 1 0 0 0 1 /end COMPU_METHOD
/begin COMPU_METHOD SWC_INP_type_CM_int16_raw16 "Q = V" RAT_FUNC "%5.0" "raw16" COEFFS 0 1 0 0 0 1 /end COMPU_METHOD
/begin COMPU_METHOD SWC_INP_type_CM_int16_cm "Q = V" RAT_FUNC "%5.0" "cm" COEFFS 0 1 0 0 0 1 /end COMPU_METHOD
/begin COMPU_METHOD SWC_INP_type_CM_uint16_cm "Q = V" RAT_FUNC "%5.0" "cm" COEFFS 0 1 0 0 0 1 /end COMPU_METHOD
/begin COMPU_METHOD SWC_INP_type_CM_uint16_mV "Q = V" RAT_FUNC "%5.0" "mV" COEFFS 0 1 0 0 0 1 /end COMPU_METHOD
/begin COMPU_METHOD SWC_INP_type_CM_uint16_enum "Q = V" RAT_FUNC "%5.0" "enum" COEFFS 0 1 0 0 0 1 /end COMPU_METHOD
/begin COMPU_METHOD SWC_INP_type_CM_uint16_V "Q = V" RAT_FUNC "%5.0" "V" COEFFS 0 1 0 0 0 1 /end COMPU_METHOD
/begin COMPU_METHOD SWC_INP_type_CM_boolean_flg "Q = V" RAT_FUNC "%1.0" "flg" COEFFS 0 1 0 0 0 1 /end COMPU_METHOD
/begin COMPU_METHOD SWC_INP_type_CM_int8_dB "Q = V" RAT_FUNC "%3.0" "dB" COEFFS 0 1 0 0 0 1 /end COMPU_METHOD
/begin COMPU_METHOD SWC_INP_type_CM_uint8_enum "Q = V" RAT_FUNC "%3.0" "enum" COEFFS 0 1 0 0 0 1 /end COMPU_METHOD
/begin COMPU_METHOD SWC_INP_type_CM_uint8_pct "Q = V" RAT_FUNC "%3.0" "pct" COEFFS 0 1 0 0 0 1 /end COMPU_METHOD
/begin GROUP S8_CommunicationCheck "SWC_INP_type/run_SWC_INP_5ms_sys/INP/CAN3/CommunicationCheck"
 /begin SUB_GROUP S1732_CANMsgInvalidBMS1 S1732_CANMsgInvalidBMS3 S1732_CANMsgInvalidBMS4 S1732_CANMsgInvalidBMS5 S1732_CANMsgInvalidBMS6 S1732_CANMsgInvalidBMS8 S1732_CANMsgInvalidCCU1 S1732_CANMsgInvalidCCU2 S1732_CANMsgInvalidEBM1 S1732_CANMsgInvalidMCUBF1 S1732_CANMsgInvalidMCUBF2 S1732_CANMsgInvalidMCUBR1 S1732_CANMsgInvalidMCUBR2 S1732_CANMsgInvalidMCUNF1 S1732_CANMsgInvalidMCUNF2 S1732_CANMsgInvalidMCUNF3 S1732_CANMsgInvalidMCUNR1 S1732_CANMsgInvalidMCUNR2 S1732_CANMsgInvalidMCUNR3 S1732_CANMsgInvalidShifter1 S1732_CANMsgInvalidShifter2 /end SUB_GROUP
 /begin REF_MEASUREMENT VINP_CANMsgValidBMS1_flg VINP_CANMsgValidBMS3_flg VINP_CANMsgValidBMS4_flg VINP_CANMsgValidBMS5_flg VINP_CANMsgValidBMS6_flg VINP_CANMsgValidBMS8_flg VINP_CANMsgValidCCU1_flg VINP_CANMsgValidCCU2_flg VINP_CANMsgValidEBM1_flg VINP_CANMsgValidMCUBF1_flg VINP_CANMsgValidMCUBF2_flg VINP_CANMsgValidMCUBR1_flg VINP_CANMsgValidMCUBR2_flg VINP_CANMsgValidMCUNF1_flg VINP_CANMsgValidMCUNF2_flg VINP_CANMsgValidMCUNF3_flg VINP_CANMsgValidMCUNR1_flg VINP_CANMsgValidMCUNR2_flg VINP_CANMsgValidMCUNR3_flg VINP_CANMsgValidShifter1_flg VINP_CANMsgValidShifter2_flg /end REF_MEASUREMENT
/end GROUP
/begin GROUP S8_CreateBus "SWC_INP_type/run_SWC_INP_5ms_sys/INP/CAN3/CreateBus"
 /begin REF_MEASUREMENT VINP_ACChrgCurrDis_A VINP_BMS1CSErr_flg VINP_BMS1RCErr_flg VINP_BMS6CSErr_flg VINP_BMS6RCErr_flg VINP_BMSChckSum1_enum VINP_BMSChckSum_enum VINP_BMSREADY_flg VINP_BMSRolCnct1_enum VINP_BMSRolCnct_enum VINP_BMSWarn1_flg VINP_BMSWarn2_flg VINP_BMSWarn3_flg VINP_BMSWarn4_flg VINP_BMSWarn5_flg VINP_BMSWarn6_flg VINP_BMSWarn7_flg VINP_BMSWarn8_flg VINP_CCU1CSErr_flg VINP_CCU1RCErr_flg VINP_CCU2CSErr_flg VINP_CCU2RCErr_flg VINP_CSCCU1_enum VINP_CSCCU2_enum VINP_CSW2DimSwSta_flg VINP_CSW2FWasSwSta_enum VINP_CSW2FWipSwSta_enum VINP_CSW2PassSWSta_flg VINP_CSW2RWipWasSwSta_enum VINP_CSW2TurnSwSta_enum VINP_CellTempAvg_C VINP_ChrgInLockReq_enum VINP_ChrgPlugSta_enum VINP_DCDCAuxCur_A VINP_DCDCAuxVolt_V VINP_DCDCEnaSta_flg VINP_DCDCFaultSta_enum VINP_DCDCHVCur_A VINP_DCDCInVoltInf_V VINP_DCDCPreCompleted_enum VINP_DCDCReady4Pre_flg VINP_DCDCTemp_C VINP_DisChrgPlugErr_enum VINP_EBMErrSta_enum VINP_EBMRLampSta_enum VINP_ExtChrgSta_enum VINP_FireDetErr_flg VINP_FrActvDmpDisabStaNidec_flg VINP_FrActvDmpDisabSta_flg VINP_FrCoolanttempReqNidec_C VINP_FrCoolanttempReq_C VINP_FrEDUDrtStaNidec_flg VINP_FrEDUDrtSta_flg VINP_FrEDUOpratingStaNidec_flg VINP_FrEDUOpratingSta_flg VINP_FrEDURealTMTqNidec_Nm VINP_FrEDURealTMTq_Nm VINP_FrEDURotateDirctionNidec_enum VINP_FrEDURotateDirction_enum VINP_FrEDUTqReqFbkNidec_Nm VINP_FrEDUTqReqFbk_Nm VINP_FrEOPSpdSetNidec_rpm VINP_FrFailcode1Nidec_enum VINP_FrFailcode1_enum VINP_FrFailcode2Nidec_enum VINP_FrFailcode2_enum VINP_FrFailcodehistory1Nidec_enum VINP_FrFailcodehistory1_enum VINP_FrFailcodehistory2Nidec_enum VINP_FrFailcodehistory2_enum VINP_FrLLCTempNidec_C VINP_FrLLCTemp_C VINP_FrLLCflowReqNidec_Lpmin VINP_FrLLCflowReq_Lpmin VINP_FrMCU1ChksumNidec_enum VINP_FrMCU1Chksum_enum VINP_FrMCU1RolCntNidec_enum VINP_FrMCU1RolCnt_enum VINP_FrMCUBATNidec_V VINP_FrMCUBAT_V VINP_FrMCUDCBusCurrNidec_A VINP_FrMCUDCBusCurr_A VINP_FrMCUDCBusVoltNidec_V VINP_FrMCUDCBusVolt_V VINP_FrMCUDischrgStaNidec_flg VINP_FrMCUDischrgSta_flg VINP_FrMCUEnaStaNidec_flg VINP_FrMCUEnaSta_flg VINP_FrMCUErrNidec_enum VINP_FrMCUErr_enum VINP_FrMCUHWVerNidec_enum VINP_FrMCUHWVer_enum VINP_FrMCUIGNstaNidec_flg VINP_FrMCUIGNsta_flg VINP_FrMCUReady4PreNidec_flg VINP_FrMCUReady4Pre_flg VINP_FrMCUReadyNidec_flg VINP_FrMCUReady_flg VINP_FrMCUSWVerNidec_enum VINP_FrMCUSWVer_enum VINP_FrMCUSysStaNidec_enum VINP_FrMCUSysSta_enum VINP_FrMCUTempNidec_C VINP_FrMCUTempWarnNidec_enum VINP_FrMCUTempWarn_enum VINP_FrMCUTemp_C VINP_FrMotorAvailTqNidec_Nm VINP_FrMotorAvailTq_Nm VINP_FrRegenAvailTqNidec_Nm VINP_FrRegenAvailTq_Nm VINP_FrTMSpdNidec_rpm VINP_FrTMSpd_rpm VINP_FrTMTempNidec_C VINP_FrTMTempWarnNidec_enum VINP_FrTMTempWarn_enum VINP_FrTMTemp_C VINP_FrTMidNidec_A VINP_FrTMid_A VINP_FrTMiqNidec_A VINP_FrTMiq_A VINP_HVBCellVoltMax_mV VINP_HVBCellVoltMin_mV VINP_HVBChrgErr_enum VINP_HVBChrgPwrTotal_kWh VINP_HVBChrgPwr_kWh VINP_HVBContactorSta_flg VINP_HVBDrvPwrTotal_kWh VINP_HVBDrvPwr_kWh VINP_HVBFullChrgPwr_kWh VINP_HVBHVILErr_flg VINP_HVBIsoImpedenceN_Megaohm VINP_HVBIsoImpedenceP_Megaohm VINP_HVBMTempMax_C VINP_HVBMTempMin_C VINP_HVBOvrTempErr_flg VINP_HVBOvrTempWarn_enum VINP_HVBPreheatPrecoolSta_enum VINP_HVBPwrAvailChrg30_kW VINP_HVBPwrAvailChrg60_kW VINP_HVBPwrAvailChrg_kW VINP_HVBPwrAvailDchrg30_kW VINP_HVBPwrAvailDchrg60_kW VINP_HVBPwrAvailDchrg_kW VINP_HVBSOH_pct VINP_HVBattCurr_A VINP_HVBattErr_flg VINP_HVBattPackVolt_V VINP_HVBattReady4Pre_enum VINP_HVBattSOCDis_pct VINP_HVBattSOC_pct VINP_HVBattVolt_V VINP_HVILSta_flg VINP_HVInVolt_V VINP_LVBattDet12V_V VINP_MCUBF1CSErr_flg VINP_MCUBF1RCErr_flg VINP_MCUBFLLCTempWarnSta_enum VINP_MCUBFRealPwrKwSta_kW VINP_MCUBR1CSErr_flg VINP_MCUBR1RCErr_flg VINP_MCUBRLLCTempWarnSta_enum VINP_MCUBRRealPwrKwSta_kW VINP_MCUNF1CSErr_flg VINP_MCUNF1RCErr_flg VINP_MCUNR1CSErr_flg VINP_MCUNR1RCErr_flg VINP_MCUWarnFNidec_enum VINP_MCUWarnF_enum VINP_MCUWarnRNidec_enum VINP_MCUWarnR_enum VINP_MainRlyNegSta_enum VINP_MainRlyPosSta_enum VINP_MaxCellTempNum_enum VINP_MaxCellVoltNum_enum VINP_MinCellTempNum_enum VINP_MinCellVoltNum_enum VINP_OBCACCSLimit_A VINP_OBCACCurLim_enum VINP_OBCACCurrInf_A VINP_OBCACVoltInf_V VINP_OBCDCCurLm_A VINP_OBCDCCurrInf_A VINP_OBCDCVoltInf_V VINP_OBCDCVoltLm_V VINP_OBCEnaSta_flg VINP_OBCFaultSta_enum VINP_OBCPluginSta_flg VINP_OBCPreCompleted_enum VINP_OBCReady4Pre_flg VINP_OBCTemp_C VINP_OBCV2LSta_enum VINP_OBCWakeup4Plugin_flg VINP_RCCCU1_enum VINP_RCCCU2_enum VINP_RemainChrgTime_min VINP_RrActvDmpDisabStaNidec_flg VINP_RrActvDmpDisabSta_flg VINP_RrCoolanttempReqNidec_cnt VINP_RrCoolanttempReq_cnt VINP_RrEDUDrtStaNidec_flg VINP_RrEDUDrtSta_flg VINP_RrEDUOpratingStaNidec_flg VINP_RrEDUOpratingSta_flg VINP_RrEDURealTMTqNidec_Nm VINP_RrEDURealTMTq_Nm VINP_RrEDURotateDirctionNidec_enum VINP_RrEDURotateDirction_enum VINP_RrEDUTqReqFbkNidec_Nm VINP_RrEDUTqReqFbk_Nm VINP_RrEOPSpdSetNidec_rpm VINP_RrFailcode1Nidec_enum VINP_RrFailcode1_enum VINP_RrFailcode2Nidec_enum VINP_RrFailcode2_enum VINP_RrFailcodehistory1Nidec_enum VINP_RrFailcodehistory1_enum VINP_RrFailcodehistory2Nidec_enum VINP_RrFailcodehistory2_enum VINP_RrLLCTempNidec_C VINP_RrLLCTemp_C VINP_RrLLCflowReqNidec_Lpmin VINP_RrLLCflowReq_Lpmin VINP_RrMCU1ChksumNidec_enum VINP_RrMCU1Chksum_enum VINP_RrMCU1RolCntNidec_enum VINP_RrMCU1RolCnt_enum VINP_RrMCU3HWVerNidec_enum VINP_RrMCU3HWVer_enum VINP_RrMCU3SWVerNidec_enum VINP_RrMCU3SWVer_enum VINP_RrMCUBATNidec_V VINP_RrMCUBAT_V VINP_RrMCUDCBusCurrNidec_A VINP_RrMCUDCBusCurr_A VINP_RrMCUDCBusVoltNidec_V VINP_RrMCUDCBusVolt_V VINP_RrMCUDischrgStaNidec_flg VINP_RrMCUDischrgSta_flg VINP_RrMCUEnaStaNidec_flg VINP_RrMCUEnaSta_flg VINP_RrMCUErrNidec_enum VINP_RrMCUErr_enum VINP_RrMCUIGNstaNidec_flg VINP_RrMCUIGNsta_flg VINP_RrMCUReady4PreNidec_flg VINP_RrMCUReady4Pre_flg VINP_RrMCUReadyNidec_flg VINP_RrMCUReady_flg VINP_RrMCUSysStaNidec_enum VINP_RrMCUSysSta_enum VINP_RrMCUTempNidec_C VINP_RrMCUTempWarnNidec_enum VINP_RrMCUTempWarn_enum VINP_RrMCUTemp_C VINP_RrMotorAvailTqNidec_Nm VINP_RrMotorAvailTq_Nm VINP_RrRegenAvailTqNidec_Nm VINP_RrRegenAvailTq_Nm VINP_RrTMSpdNidec_rpm VINP_RrTMSpd_rpm VINP_RrTMTempNidec_C VINP_RrTMTempWarnNidec_enum VINP_RrTMTempWarn_enum VINP_RrTMTemp_C VINP_RrTMidNidec_A VINP_RrTMid_A VINP_RrTMiqNidec_A VINP_RrTMiq_A VINP_Shifter1CSErr_flg VINP_Shifter1RCErr_flg VINP_Shifter2CSErr_flg VINP_Shifter2RCErr_flg VINP_ShifterCRC8_enum VINP_ShifterFailsta_enum VINP_ShifterHandleCmd_enum VINP_ShifterRC_enum VINP_V2LSta_enum /end REF_MEASUREMENT
/end GROUP
/begin GROUP S8_SignalCheck "SWC_INP_type/run_SWC_INP_5ms_sys/INP/CAN3/SignalCheck"
 /begin SUB_GROUP S1734_BMS1 S1734_BMS3 S1734_BMS4 S1734_BMS5 S1734_BMS6 S1734_BMS8 S1734_CCU1 S1734_CCU2 S1734_EBM1 S1734_MCU_B_F1 S1734_MCU_B_F2 S1734_MCU_B_R1 S1734_MCU_B_R2 S1734_MCU_N_F1 S1734_MCU_N_F2 S1734_MCU_N_F3 S1734_MCU_N_R1 S1734_MCU_N_R2 S1734_MCU_N_R3 S1734_Shifter1 S1734_Shifter2 /end SUB_GROUP
/end GROUP
/begin GROUP S9_CommunicationCheck "SWC_INP_type/run_SWC_INP_5ms_sys/INP/CAN4/CommunicationCheck"
 /begin SUB_GROUP S3225_CANMsgInvalidBodyZoneDR1 S3225_CANMsgInvalidBodyZoneDR2 S3225_CANMsgInvalidBodyZonePS1 S3225_CANMsgInvalidBodyZonePS2 S3225_CANMsgInvalidDKC1 S3225_CANMsgInvalidDKC2 S3225_CANMsgInvalidPTG1 S3225_CANMsgInvalidZONEDR1 S3225_CANMsgInvalidZONEDRVCU S3225_CANMsgInvalidZONEFR1 S3225_CANMsgInvalidZONEFRVCU S3225_CANMsgInvalidzGWAPTC1 S3225_CANMsgInvalidzGWCANFr1 S3225_CANMsgInvalidzGWLINDr1 S3225_CANMsgInvalidzGWLINDr2 S3225_CANMsgInvalidzGWLINFr1 S3225_CANMsgInvalidzGWLINFr2 S3225_CANMsgInvalidzGWSEAT1 /end SUB_GROUP
 /begin REF_MEASUREMENT VINP_CANMsgValidBodyZoneDR1_flg VINP_CANMsgValidBodyZoneDR2_flg VINP_CANMsgValidBodyZonePS1_flg VINP_CANMsgValidBodyZonePS2_flg VINP_CANMsgValidDKC1_flg VINP_CANMsgValidDKC2_flg VINP_CANMsgValidPTG1_flg VINP_CANMsgValidZONEDR1_flg VINP_CANMsgValidZONEDRVCU_flg VINP_CANMsgValidZONEFR1_flg VINP_CANMsgValidZONEFRVCU_flg VINP_CANMsgValidzGWAPTC1_flg VINP_CANMsgValidzGWCANFr1_flg VINP_CANMsgValidzGWLINDr1_flg VINP_CANMsgValidzGWLINDr2_flg VINP_CANMsgValidzGWLINFr1_flg VINP_CANMsgValidzGWLINFr2_flg VINP_CANMsgValidzGWSEAT1_flg /end REF_MEASUREMENT
/end GROUP
/begin GROUP S9_CreateBus "SWC_INP_type/run_SWC_INP_5ms_sys/INP/CAN4/CreateBus"
 /begin REF_MEASUREMENT VINP_ACT1ResponseError_flg VINP_AGSActualPosition_enum VINP_AGSErr_enum VINP_BDAPMWinFOpenedSta_pct VINP_BDAPMWinROpenedSta_pct VINP_BDDSEATAntiSta_flg VINP_BDDSEATEntryFunSta_flg VINP_BDDSEATErrorSta_flg VINP_BDDSEATMemSetSta_enum VINP_BDDSEATModeSta_enum VINP_BDDSEATVentSta_enum VINP_BDDSEATheaterSta_enum VINP_BDDoorFHandleCloseSta_flg VINP_BDDoorRHandleCloseSta_flg VINP_BPAPMWinFOpenedSta_pct VINP_BPAPMWinROpenedSta_pct VINP_BPDoorFHandleCloseSta_flg VINP_BPDoorRHandleCloseSta_flg VINP_BPPSEATErrorSta_flg VINP_BPPSEATModeSta_enum VINP_BPPSEATVentSta_enum VINP_BPPSEATheaterSta_enum VINP_BPPTGActiveSta_enum VINP_BPPTGExistSta_flg VINP_BPPTGInsideSW1Sta_enum VINP_BPPTGInsideSW2Sta_enum VINP_BPPTGIsSetHeightSta_flg VINP_BPPTGLeftHallPosnSta_enum VINP_BPPTGOpenRatioSta_pct VINP_BPPTGRDILCmd_enum VINP_BPPTGSysSta_enum VINP_BPSEATLVentSta_enum VINP_BPSEATMLVentSta_enum VINP_BPSEATMRVentSta_enum VINP_BPSEATRVentSta_enum VINP_BatInTempErr_enum VINP_BatInTemp_C VINP_BatOutTemp_C VINP_BlowerErr_enum VINP_COMPActualPwr_W VINP_COMPConCur_A VINP_COMPConVolt_V VINP_COMPErr_enum VINP_COMPStatorSpd_rpm VINP_CSWDimSw_flg VINP_CSWFWasSwSta_enum VINP_CSWFWipSwSta_enum VINP_CSWPassSWSta_flg VINP_CSWRWasSWSta_enum VINP_CSWRWipIntSwSta_enum VINP_CSWTurnSwSta_enum VINP_ChargeInletLockSta_flg VINP_CompProEN_flg VINP_DKCKeyNumSta_enum VINP_DKCKeyTypeSta_enum VINP_DKCPDkeyAreaRAPSSta_enum VINP_DKCParkingModeCmd_enum VINP_DKCReVehData_enum VINP_DSEATAntiSta_flg VINP_DSEATEntryFunSta_flg VINP_DSEATErrorSta_flg VINP_DSEATHWVer_enum VINP_DSEATMode_enum VINP_DSEATSWVer_enum VINP_DSEATVentSta_enum VINP_DSEATheatersta_enum VINP_DrLockSta_flg VINP_DrPMMLVOutPErrLmp_flg VINP_DrPMMSysErrLmp_flg VINP_DrSCPSysErrLmp_flg VINP_DrStdAErrSta_flg VINP_EACProtectEnable_enum VINP_EWP1BlockError_enum VINP_EWP1OverCurrError_enum VINP_EWP2BlockError_enum VINP_EWP2OverCurrError_enum VINP_EWP3BlockError_enum VINP_EWP3Err_enum VINP_EWP3OverCurrError_enum VINP_EXV1Err_enum VINP_EXV2Err_enum VINP_FAPWL01LINResponseError_flg VINP_FGSIntenRspSta_enum VINP_FLTurnLPErr_flg VINP_FLTurnLampC_mA VINP_FLTurnLightWarning_flg VINP_FRTurnLPErr_flg VINP_FRTurnLampC_mA VINP_FRTurnLightWarning_flg VINP_FWiperAS_flg VINP_FWiperProtection_flg VINP_FanErr_enum VINP_FrPMMLimpHomeActReq_flg VINP_FrntPTCLeActHeatPwr_W VINP_FrntPTCRearLeActHeatPwr_W VINP_FrntPTCRearRiActHeatPwr_W VINP_FrntPTCRiActHeatPwr_W VINP_LADBHibeamIndication_flg VINP_LADBOperationStatus_flg VINP_LADBWarning_flg VINP_LAHBWarning_flg VINP_LDRLWarning_flg VINP_LDrvMotorRelayError_flg VINP_LDrvMotorRippleError_flg VINP_LDrvValWdwOpened_pct VINP_LDrvWdwPositionSts_enum VINP_LLBWarning_flg VINP_LPasMotorRelayError_flg VINP_LPasMotorRippleError_flg VINP_LPasValWdwOpened_pct VINP_LPasWdwPositionSts_enum VINP_LRLDMotorRelayError_flg VINP_LRLDMotorRippleError_flg VINP_LRLDValWdwOpened_pct VINP_LRLDWdwPositionSts_enum VINP_LRRDMotorRelayError_flg VINP_LRRDMotorRippleError_flg VINP_LRRDValWdwOpened_pct VINP_LRRDWdwPositionSts_enum VINP_LeftHallPos_enum VINP_LpositionLampWarning_flg VINP_MIRRORFOLDSW_flg VINP_MotorInTempErr_enum VINP_MotorInTemp_C VINP_MotorOutTempErr_enum VINP_MotorOutTemp_C VINP_PCommandToBCM_enum VINP_PCommandToPTG_enum VINP_PDKeyAreaLockUnlock_enum VINP_PDKeyAreaPS_enum VINP_PDKeyAreaPTG_enum VINP_PDKeyWelcome_enum VINP_PDkeyShowIVI_enum VINP_PKeyMiss_flg VINP_PKeyMode_enum VINP_PSEATErrorSta_flg VINP_PSEATHWVer_enum VINP_PSEATMode_enum VINP_PSEATSWVer_enum VINP_PSEATVentSta_enum VINP_PSEATheatersta_enum VINP_PTC1PowerConsumption_kW VINP_PTGActiveSta_enum VINP_PTGAutoStaus_flg VINP_PTGExist_flg VINP_PTGHWVer_enum VINP_PTGInnerSW2_enum VINP_PTGIsSetHeight_flg VINP_PTGOpenRatio_pct VINP_PTGRDILSta_enum VINP_PTGSWVer_enum VINP_PTGSysSta_enum VINP_PTHighPErr_enum VINP_PTHighP_KPa VINP_PTHighTactErr_enum VINP_PTHighTact_C VINP_PTLowP1Err_enum VINP_PTLowP1_KPa VINP_PTLowP2Err_enum VINP_PTLowP2_KPa VINP_PTLowT1Err_enum VINP_PTLowT1_C VINP_PTLowT2Err_enum VINP_PTLowT2_C VINP_PUIDLowPower_flg VINP_RADBHibeamIndication_flg VINP_RADBOperationStatus_flg VINP_RADBWarning_flg VINP_RAHBWarning_flg VINP_RAPWL01LINResponseError_flg VINP_RDRLWarning_flg VINP_RLBWarning_flg VINP_RLSLampSta_flg VINP_RLSRainSnrWiperCmd_enum VINP_RLTurnLPErr_flg VINP_RLTurnLampC_mA VINP_RRTurnLPErr_flg VINP_RRTurnLampC_mA VINP_RWiperAS_flg VINP_RWiperProtection_flg VINP_RpositionLampWarning_flg VINP_SOTXVErr_enum VINP_SOV1Err_enum VINP_SOV2Err_enum VINP_SOV3Err_enum VINP_SWC2LADASSta_flg VINP_SWC2LDriveModeSta_flg VINP_SWC2LHomeSta_flg VINP_SWC2LLeftSta_flg VINP_SWC2LRegenUpSta_flg VINP_SWC2LRightSta_flg VINP_SWC2LScrollDownSta_flg VINP_SWC2LScrollPressSta_flg VINP_SWC2LScrollUpSta_flg VINP_SWC2RCustomizeSta_flg VINP_SWC2RLeftSta_flg VINP_SWC2RPageSwitchSta_flg VINP_SWC2RRegenDownSta_flg VINP_SWC2RRightSta_flg VINP_SWC2RScrollDownSta_flg VINP_SWC2RScrollPressSta_flg VINP_SWC2RScrollUpSta_flg VINP_SWC2RVRSta_flg VINP_SWCACCSta_flg VINP_SWCCANCELSta_flg VINP_SWCDistanceSta_flg VINP_SWCDownSta_flg VINP_SWCLKASta_flg VINP_SWCLeftSta_flg VINP_SWCRegenDown_flg VINP_SWCRegenUp_flg VINP_SWCResUpSta_flg VINP_SWCRightSta_flg VINP_SWCSetdownSta_flg VINP_SWCTripSta_flg VINP_SWCUndefinedSta_flg VINP_SWCUpSta_flg VINP_SWCVRSta_flg VINP_SWCmodeSta_flg VINP_SolarLErr_enum VINP_SolarL_W VINP_SolarRErr_enum VINP_SolarR_W VINP_TFaceLErr_enum VINP_TFaceL_C VINP_TFaceRErr_enum VINP_TFaceR_C VINP_TFaceRrErr_enum VINP_TFaceRr_C VINP_TFootLErr_enum VINP_TFootL_C VINP_TFootRErr_enum VINP_TFootR_C VINP_TFootRrErr_enum VINP_TFootRr_C VINP_TambErr_enum VINP_Tamb_C VINP_TevapErr_enum VINP_Tevap_C VINP_TincarErr_enum VINP_Tincar_C VINP_TrailerCheck_flg VINP_TrailerModeSta_enum VINP_ZFRBCMChargerDoorSWSta_flg VINP_ZFRBCMHRLTurnLPNormalSta_flg VINP_ZFRBCMHRRTurnLPHNormalSta_flg VINP_ZFRTHCMCLEVentActYSta_pct VINP_ZFRTHCMCREVentActYSta_pct VINP_ZFRTHCMLEVentActYSta_pct VINP_ZFRTHCMREVentActYSta_pct VINP_ZoneDrMalfunLevel_enum /end REF_MEASUREMENT
/end GROUP
/begin GROUP S9_SignalCheck "SWC_INP_type/run_SWC_INP_5ms_sys/INP/CAN4/SignalCheck"
 /begin SUB_GROUP S3227_BodyZone_DR1 S3227_BodyZone_DR2 S3227_BodyZone_PS1 S3227_BodyZone_PS2 S3227_DKC1 S3227_DKC2 S3227_PTG1 S3227_ZONE_DR1 S3227_ZONE_DR_VCU S3227_ZONE_FR1 S3227_ZONE_FR_VCU S3227_zGW_APTC1 S3227_zGW_CANFr1 S3227_zGW_LINDr1 S3227_zGW_LINDr2 S3227_zGW_LINFr1 S3227_zGW_LINFr2 S3227_zGW_SEAT1 /end SUB_GROUP
/end GROUP
/begin GROUP S10_CommunicationCheck "SWC_INP_type/run_SWC_INP_5ms_sys/INP/CAN5/CommunicationCheck" /begin SUB_GROUP S4588_CANMsgInvalidTBOX2 S4588_CANMsgInvalidTBOX3 /end SUB_GROUP /begin REF_MEASUREMENT VINP_CANMsgValidTBOX2_flg VINP_CANMsgValidTBOX3_flg /end REF_MEASUREMENT /end GROUP
/begin GROUP S10_CreateBus "SWC_INP_type/run_SWC_INP_5ms_sys/INP/CAN5/CreateBus"
 /begin REF_MEASUREMENT VINP_ChargePercentSet_pct VINP_ReserveChargeOFFDay_DAY VINP_ReserveChargeOFFHour_hr VINP_ReserveChargeOFFMinute_min VINP_ReserveChargeOFFMonth_MONTH VINP_ReserveChargeOFFYear_YEAR VINP_ReserveChargeOnDay_DAY VINP_ReserveChargeOnHour_hr VINP_ReserveChargeOnMinute_min VINP_ReserveChargeOnMonth_MONTH VINP_ReserveChargeOnYear_YEAR VINP_TBOXHWVER_enum VINP_TBOXSWVER_enum VINP_TimeSyncFromBSDay_DAY VINP_TimeSyncFromBSHour_hr VINP_TimeSyncFromBSMinute_min VINP_TimeSyncFromBSMonth_MONTH VINP_TimeSyncFromBSSecond_s VINP_TimeSyncFromBSYear_YEAR /end REF_MEASUREMENT
/end GROUP
/begin GROUP S10_SignalCheck "SWC_INP_type/run_SWC_INP_5ms_sys/INP/CAN5/SignalCheck" /begin SUB_GROUP S4590_TBOX2 S4590_TBOX3 /end SUB_GROUP /end GROUP
/begin GROUP S11_CommunicationCheck "SWC_INP_type/run_SWC_INP_5ms_sys/INP/CAN6/CommunicationCheck"
 /begin SUB_GROUP S4696_CANMsgInvalidFCM1 S4696_CANMsgInvalidFCM2 S4696_CANMsgInvalidFCM3 S4696_CANMsgInvalidFCM4 S4696_CANMsgInvalidSRR1 /end SUB_GROUP
 /begin REF_MEASUREMENT VINP_CANMsgValidFCM1_flg VINP_CANMsgValidFCM2_flg VINP_CANMsgValidFCM3_flg VINP_CANMsgValidFCM4_flg VINP_CANMsgValidSRR1_flg /end REF_MEASUREMENT
/end GROUP
/begin GROUP S11_CreateBus "SWC_INP_type/run_SWC_INP_5ms_sys/INP/CAN6/CreateBus"
 /begin REF_MEASUREMENT VINP_ACCComfortBandLower_mps2 VINP_ACCComfortBandUpper_mps2 VINP_ACCJerkLowerLimit_mps3 VINP_ACCJerkUpperLimit_mps3 VINP_ACCObjDist_m VINP_ACCObjDstLvl_enum VINP_ACCObjRelSpd_mps VINP_ACCRequiredAccel_mps2 VINP_ACCTakeoverReq_flg VINP_ACCVehHoldReq_flg VINP_ADASACCSta_enum VINP_ADASAEBReq_enum VINP_ADASAEBSta_enum VINP_ADASAngCtrlTqWeightGain_pct VINP_ADASCAMSpdLim_enum VINP_ADASDBSReq_enum VINP_ADASDesStrWhlAngCtrlCmd_Deg VINP_ADASDrvInputTqBoostAct_flg VINP_ADASDrvInputTqBoostGain_pct VINP_ADASFCWMute_flg VINP_ADASFCWSta_enum VINP_ADASFaultSta_flg VINP_ADASFltWrnReq_flg VINP_ADASForceIdle_flg VINP_ADASISASta_enum VINP_ADASLDWMute_flg VINP_ADASLDWSta_enum VINP_ADASLFCHandsOffWarning_enum VINP_ADASLFCSta_enum VINP_ADASLFCWarnSound_enum VINP_ADASLKASta_enum VINP_ADASLaneModeL_enum VINP_ADASLaneModeR_enum VINP_ADASLanecurveL_raw32 VINP_ADASLanecurveR_raw32 VINP_ADASLanetypeL_enum VINP_ADASLanetypeR_enum VINP_ADASMaxAngCtrlOutTqLimit_Nm VINP_ADASSLIFSpdLim_enum VINP_ADASSLIFSta_enum VINP_ADASShftPosnReqA_flg VINP_ADASShftPosnReq_enum VINP_ADASStrWhlAngCtrlStatus_flg VINP_ADASVehSpdLim_enum VINP_ADASWarningMsg_enum VINP_ADBVehDst1Val_enum VINP_AEBVehHoldReq_flg VINP_CameraBlockage_flg VINP_FCM1Checksum_enum VINP_FCM1LifeCount_enum VINP_FCM2CSErr_flg VINP_FCM2RCErr_flg VINP_FCM4CSErr_flg VINP_FCM4RCErr_flg VINP_FCMACCmode_enum VINP_FCMLKAStrToqReq_Nm VINP_FCMLKATOIAct_enum VINP_FCMLKATOIFault_flg VINP_ForceLowBeam_enum VINP_HazardWarningReq_flg VINP_ISAWarningMsg_enum VINP_LKAHODDisplayWarning_flg VINP_LKAHODSoundWarning_flg VINP_LVDAACCStatusInformation_flg VINP_LVDADisabled_flg VINP_LVDAFailinfo_flg VINP_LVDAMuteSta_enum VINP_LVDAWarning_flg VINP_LeftTurnLightReq_flg VINP_MELaneCurvDervLt2_raw32 VINP_MELaneCurvDervLt_raw32 VINP_MELaneCurvDervRt2_raw32 VINP_MELaneCurvDervRt_raw32 VINP_MELaneCurvLt2_raw32 VINP_MELaneCurvLt_raw32 VINP_MELaneCurvRt2_raw32 VINP_MELaneCurvRt_raw32 VINP_MELaneHeadAngLt2_radians VINP_MELaneHeadAngLt_radians VINP_MELaneHeadAngRt2_radians VINP_MELaneHeadAngRt_radians VINP_MELanePosLt2_m VINP_MELanePosLt_m VINP_MELanePosRt2_m VINP_MELanePosRt_m VINP_RightTurnLightReq_flg VINP_SRRBSDWarnL_enum VINP_SRRBSDWarnR_enum VINP_SRRODASoundL_flg VINP_SRRODASoundR_flg VINP_SRRODAWarnL_enum VINP_SRRODAWarnR_enum VINP_TargetType_enum VINP_TimeGapLevel_enum /end REF_MEASUREMENT
/end GROUP
/begin GROUP S11_SignalCheck "SWC_INP_type/run_SWC_INP_5ms_sys/INP/CAN6/SignalCheck" /begin SUB_GROUP S4698_FCM1 S4698_FCM2 S4698_FCM3 S4698_FCM4 S4698_SRR1 /end SUB_GROUP /end GROUP
/begin GROUP S12_Subsystem1 "SWC_INP_type/run_SWC_INP_5ms_sys/INP/DDM/Subsystem1"
 /begin REF_CHARACTERISTIC KINP_ClearZevDTCcmd_flg_ovrdflg KINP_ClearZevDTCcmd_flg_ovrdval /end REF_CHARACTERISTIC
 /begin REF_MEASUREMENT VINP_ClearZevDTCcmd_flg /end REF_MEASUREMENT
/end GROUP
/begin GROUP S12_Subsystem13 "SWC_INP_type/run_SWC_INP_5ms_sys/INP/DDM/Subsystem13" /begin REF_CHARACTERISTIC KINP_ClearDTCcmd_flg_ovrdflg KINP_ClearDTCcmd_flg_ovrdval /end REF_CHARACTERISTIC /begin REF_MEASUREMENT VINP_ClearDTCcmd_flg /end REF_MEASUREMENT /end GROUP
/begin GROUP S13_Subsystem1 "SWC_INP_type/run_SWC_INP_5ms_sys/INP/DKC/Subsystem1" /begin REF_CHARACTERISTIC KINP_NFCLidASta_flg_ovrdflg KINP_NFCLidASta_flg_ovrdval /end REF_CHARACTERISTIC /begin REF_MEASUREMENT VINP_NFCLidASta_flg /end REF_MEASUREMENT /end GROUP
/begin GROUP S13_Subsystem10 "SWC_INP_type/run_SWC_INP_5ms_sys/INP/DKC/Subsystem10" /begin REF_CHARACTERISTIC KINP_NFCDoorSta_flg_ovrdflg KINP_NFCDoorSta_flg_ovrdval /end REF_CHARACTERISTIC /begin REF_MEASUREMENT VINP_NFCDoorSta_flg /end REF_MEASUREMENT /end GROUP
/begin GROUP S13_Subsystem11 "SWC_INP_type/run_SWC_INP_5ms_sys/INP/DKC/Subsystem11" /begin REF_CHARACTERISTIC KINP_UWB4Distance_cm_ovrdflg KINP_UWB4Distance_cm_ovrdval /end REF_CHARACTERISTIC /begin REF_MEASUREMENT VINP_UWB4Distance_cm /end REF_MEASUREMENT /end GROUP
/begin GROUP S13_Subsystem12 "SWC_INP_type/run_SWC_INP_5ms_sys/INP/DKC/Subsystem12" /begin REF_CHARACTERISTIC KINP_UWB5Distance_cm_ovrdflg KINP_UWB5Distance_cm_ovrdval /end REF_CHARACTERISTIC /begin REF_MEASUREMENT VINP_UWB5Distance_cm /end REF_MEASUREMENT /end GROUP
/begin GROUP S13_Subsystem13 "SWC_INP_type/run_SWC_INP_5ms_sys/INP/DKC/Subsystem13" /begin REF_CHARACTERISTIC KINP_UWB1Power_dB_ovrdflg KINP_UWB1Power_dB_ovrdval /end REF_CHARACTERISTIC /begin REF_MEASUREMENT VINP_UWB1Power_dB /end REF_MEASUREMENT /end GROUP
/begin GROUP S13_Subsystem14 "SWC_INP_type/run_SWC_INP_5ms_sys/INP/DKC/Subsystem14" /begin REF_CHARACTERISTIC KINP_UWB2Power_dB_ovrdflg KINP_UWB2Power_dB_ovrdval /end REF_CHARACTERISTIC /begin REF_MEASUREMENT VINP_UWB2Power_dB /end REF_MEASUREMENT /end GROUP
/begin GROUP S13_Subsystem15 "SWC_INP_type/run_SWC_INP_5ms_sys/INP/DKC/Subsystem15" /begin REF_CHARACTERISTIC KINP_UWB3Power_dB_ovrdflg KINP_UWB3Power_dB_ovrdval /end REF_CHARACTERISTIC /begin REF_MEASUREMENT VINP_UWB3Power_dB /end REF_MEASUREMENT /end GROUP
/begin GROUP S13_Subsystem16 "SWC_INP_type/run_SWC_INP_5ms_sys/INP/DKC/Subsystem16" /begin REF_CHARACTERISTIC KINP_UWB4Power_dB_ovrdflg KINP_UWB4Power_dB_ovrdval /end REF_CHARACTERISTIC /begin REF_MEASUREMENT VINP_UWB4Power_dB /end REF_MEASUREMENT /end GROUP
/begin GROUP S13_Subsystem17 "SWC_INP_type/run_SWC_INP_5ms_sys/INP/DKC/Subsystem17" /begin REF_CHARACTERISTIC KINP_UWB5Power_dB_ovrdflg KINP_UWB5Power_dB_ovrdval /end REF_CHARACTERISTIC /begin REF_MEASUREMENT VINP_UWB5Power_dB /end REF_MEASUREMENT /end GROUP
/begin GROUP S13_Subsystem18 "SWC_INP_type/run_SWC_INP_5ms_sys/INP/DKC/Subsystem18" /begin REF_CHARACTERISTIC KINP_UWBpositionX_cm_ovrdflg KINP_UWBpositionX_cm_ovrdval /end REF_CHARACTERISTIC /begin REF_MEASUREMENT VINP_UWBpositionX_cm /end REF_MEASUREMENT /end GROUP
/begin GROUP S13_Subsystem19 "SWC_INP_type/run_SWC_INP_5ms_sys/INP/DKC/Subsystem19" /begin REF_CHARACTERISTIC KINP_UWBpositionY_cm_ovrdflg KINP_UWBpositionY_cm_ovrdval /end REF_CHARACTERISTIC /begin REF_MEASUREMENT VINP_UWBpositionY_cm /end REF_MEASUREMENT /end GROUP
/begin GROUP S13_Subsystem2 "SWC_INP_type/run_SWC_INP_5ms_sys/INP/DKC/Subsystem2"
 /begin REF_CHARACTERISTIC KINP_KeyFobAreaU16_enum_ovrdflg KINP_KeyFobAreaU16_enum_ovrdval /end REF_CHARACTERISTIC
 /begin REF_MEASUREMENT VINP_KeyFobAreaU16_enum /end REF_MEASUREMENT
/end GROUP
/begin GROUP S13_Subsystem20 "SWC_INP_type/run_SWC_INP_5ms_sys/INP/DKC/Subsystem20"
 /begin REF_CHARACTERISTIC KINP_UWB1RangingSta_enum_ovrdflg KINP_UWB1RangingSta_enum_ovrdval /end REF_CHARACTERISTIC
 /begin REF_MEASUREMENT VINP_UWB1RangingSta_enum /end REF_MEASUREMENT
/end GROUP
/begin GROUP S13_Subsystem21 "SWC_INP_type/run_SWC_INP_5ms_sys/INP/DKC/Subsystem21"
 /begin REF_CHARACTERISTIC KINP_UWB2RangingSta_enum_ovrdflg KINP_UWB2RangingSta_enum_ovrdval /end REF_CHARACTERISTIC
 /begin REF_MEASUREMENT VINP_UWB2RangingSta_enum /end REF_MEASUREMENT
/end GROUP
/begin GROUP S13_Subsystem22 "SWC_INP_type/run_SWC_INP_5ms_sys/INP/DKC/Subsystem22"
 /begin REF_CHARACTERISTIC KINP_UWB3RangingSta_enum_ovrdflg KINP_UWB3RangingSta_enum_ovrdval /end REF_CHARACTERISTIC
 /begin REF_MEASUREMENT VINP_UWB3RangingSta_enum /end REF_MEASUREMENT
/end GROUP
/begin GROUP S13_Subsystem23 "SWC_INP_type/run_SWC_INP_5ms_sys/INP/DKC/Subsystem23"
 /begin REF_CHARACTERISTIC KINP_UWB4RangingSta_enum_ovrdflg KINP_UWB4RangingSta_enum_ovrdval /end REF_CHARACTERISTIC
 /begin REF_MEASUREMENT VINP_UWB4RangingSta_enum /end REF_MEASUREMENT
/end GROUP
/begin GROUP S13_Subsystem24 "SWC_INP_type/run_SWC_INP_5ms_sys/INP/DKC/Subsystem24"
 /begin REF_CHARACTERISTIC KINP_UWB5RangingSta_enum_ovrdflg KINP_UWB5RangingSta_enum_ovrdval /end REF_CHARACTERISTIC
 /begin REF_MEASUREMENT VINP_UWB5RangingSta_enum /end REF_MEASUREMENT
/end GROUP
/begin GROUP S13_Subsystem25 "SWC_INP_type/run_SWC_INP_5ms_sys/INP/DKC/Subsystem25"
 /begin REF_CHARACTERISTIC KINP_UWBRangingON_flg_ovrdflg KINP_UWBRangingON_flg_ovrdval /end REF_CHARACTERISTIC
 /begin REF_MEASUREMENT VINP_UWBRangingON_flg /end REF_MEASUREMENT
/end GROUP
/begin GROUP S13_Subsystem3 "SWC_INP_type/run_SWC_INP_5ms_sys/INP/DKC/Subsystem3"
 /begin REF_CHARACTERISTIC KINP_UIDButtonCmd_enum_ovrdflg KINP_UIDButtonCmd_enum_ovrdval /end REF_CHARACTERISTIC
 /begin REF_MEASUREMENT VINP_UIDButtonCmd_enum /end REF_MEASUREMENT
/end GROUP
/begin GROUP S13_Subsystem4 "SWC_INP_type/run_SWC_INP_5ms_sys/INP/DKC/Subsystem4"
 /begin REF_CHARACTERISTIC KINP_BTConnectSta_enum_ovrdflg KINP_BTConnectSta_enum_ovrdval /end REF_CHARACTERISTIC
 /begin REF_MEASUREMENT VINP_BTConnectSta_enum /end REF_MEASUREMENT
/end GROUP
/begin GROUP S13_Subsystem5 "SWC_INP_type/run_SWC_INP_5ms_sys/INP/DKC/Subsystem5"
 /begin REF_CHARACTERISTIC KINP_UIDBatVoltx1000_V_ovrdflg KINP_UIDBatVoltx1000_V_ovrdval /end REF_CHARACTERISTIC
 /begin REF_MEASUREMENT VINP_UIDBatVoltx1000_V /end REF_MEASUREMENT
/end GROUP
/begin GROUP S13_Subsystem6 "SWC_INP_type/run_SWC_INP_5ms_sys/INP/DKC/Subsystem6" /begin REF_CHARACTERISTIC KINP_DKCBTRSSI_dB_ovrdflg KINP_DKCBTRSSI_dB_ovrdval /end REF_CHARACTERISTIC /begin REF_MEASUREMENT VINP_DKCBTRSSI_dB /end REF_MEASUREMENT /end GROUP
/begin GROUP S13_Subsystem7 "SWC_INP_type/run_SWC_INP_5ms_sys/INP/DKC/Subsystem7" /begin REF_CHARACTERISTIC KINP_UWB1Distance_cm_ovrdflg KINP_UWB1Distance_cm_ovrdval /end REF_CHARACTERISTIC /begin REF_MEASUREMENT VINP_UWB1Distance_cm /end REF_MEASUREMENT /end GROUP
/begin GROUP S13_Subsystem8 "SWC_INP_type/run_SWC_INP_5ms_sys/INP/DKC/Subsystem8" /begin REF_CHARACTERISTIC KINP_UWB2Distance_cm_ovrdflg KINP_UWB2Distance_cm_ovrdval /end REF_CHARACTERISTIC /begin REF_MEASUREMENT VINP_UWB2Distance_cm /end REF_MEASUREMENT /end GROUP
/begin GROUP S13_Subsystem9 "SWC_INP_type/run_SWC_INP_5ms_sys/INP/DKC/Subsystem9" /begin REF_CHARACTERISTIC KINP_UWB3Distance_cm_ovrdflg KINP_UWB3Distance_cm_ovrdval /end REF_CHARACTERISTIC /begin REF_MEASUREMENT VINP_UWB3Distance_cm /end REF_MEASUREMENT /end GROUP
/begin GROUP S14_Analog "SWC_INP_type/run_SWC_INP_5ms_sys/INP/GPIO/Analog" /begin SUB_GROUP S5221_AccelPedal1Vol_V S5221_AccelPedal2Vol_V /end SUB_GROUP /end GROUP
/begin GROUP S14_Digital "SWC_INP_type/run_SWC_INP_5ms_sys/INP/GPIO/Digital"
 /begin SUB_GROUP S5222_BrakeLampSW S5222_BrakeSWGPIO S5222_CentralDoorLockSW S5222_CrashSignalGPIO S5222_DrDoorSW S5222_HazardSW S5222_HoodSW S5222_PsDoorSW S5222_RLDoorSW S5222_RRDoorSW S5222_SeatSW S5222_TailgateSW S5222_TrunkHanSW /end SUB_GROUP
/end GROUP
/begin GROUP S15_Subsystem1 "SWC_INP_type/run_SWC_INP_5ms_sys/INP/IMU/Subsystem1"
 /begin REF_CHARACTERISTIC KINP_MemOffsetGyroY_raw16_ovrdflg KINP_MemOffsetGyroY_raw16_ovrdval /end REF_CHARACTERISTIC
 /begin REF_MEASUREMENT VINP_MemOffsetGyroY_raw16 /end REF_MEASUREMENT
/end GROUP
/begin GROUP S15_Subsystem10 "SWC_INP_type/run_SWC_INP_5ms_sys/INP/IMU/Subsystem10"
 /begin REF_CHARACTERISTIC KINP_SensingAccZ_raw16_ovrdflg KINP_SensingAccZ_raw16_ovrdval /end REF_CHARACTERISTIC
 /begin REF_MEASUREMENT VINP_SensingAccZ_raw16 /end REF_MEASUREMENT
/end GROUP
/begin GROUP S15_Subsystem11 "SWC_INP_type/run_SWC_INP_5ms_sys/INP/IMU/Subsystem11"
 /begin REF_CHARACTERISTIC KINP_SensingAccY_raw16_ovrdflg KINP_SensingAccY_raw16_ovrdval /end REF_CHARACTERISTIC
 /begin REF_MEASUREMENT VINP_SensingAccY_raw16 /end REF_MEASUREMENT
/end GROUP
/begin GROUP S15_Subsystem15 "SWC_INP_type/run_SWC_INP_5ms_sys/INP/IMU/Subsystem15"
 /begin REF_CHARACTERISTIC KINP_MemOffsetGyroX_raw16_ovrdflg KINP_MemOffsetGyroX_raw16_ovrdval /end REF_CHARACTERISTIC
 /begin REF_MEASUREMENT VINP_MemOffsetGyroX_raw16 /end REF_MEASUREMENT
/end GROUP
/begin GROUP S15_Subsystem2 "SWC_INP_type/run_SWC_INP_5ms_sys/INP/IMU/Subsystem2"
 /begin REF_CHARACTERISTIC KINP_MemOffsetAccX_raw16_ovrdflg KINP_MemOffsetAccX_raw16_ovrdval /end REF_CHARACTERISTIC
 /begin REF_MEASUREMENT VINP_MemOffsetAccX_raw16 /end REF_MEASUREMENT
/end GROUP
/begin GROUP S15_Subsystem3 "SWC_INP_type/run_SWC_INP_5ms_sys/INP/IMU/Subsystem3"
 /begin REF_CHARACTERISTIC KINP_MemOffsetGyroZ_raw16_ovrdflg KINP_MemOffsetGyroZ_raw16_ovrdval /end REF_CHARACTERISTIC
 /begin REF_MEASUREMENT VINP_MemOffsetGyroZ_raw16 /end REF_MEASUREMENT
/end GROUP
/begin GROUP S15_Subsystem4 "SWC_INP_type/run_SWC_INP_5ms_sys/INP/IMU/Subsystem4"
 /begin REF_CHARACTERISTIC KINP_MemOffsetAccZ_raw16_ovrdflg KINP_MemOffsetAccZ_raw16_ovrdval /end REF_CHARACTERISTIC
 /begin REF_MEASUREMENT VINP_MemOffsetAccZ_raw16 /end REF_MEASUREMENT
/end GROUP
/begin GROUP S15_Subsystem5 "SWC_INP_type/run_SWC_INP_5ms_sys/INP/IMU/Subsystem5"
 /begin REF_CHARACTERISTIC KINP_MemOffsetAccY_raw16_ovrdflg KINP_MemOffsetAccY_raw16_ovrdval /end REF_CHARACTERISTIC
 /begin REF_MEASUREMENT VINP_MemOffsetAccY_raw16 /end REF_MEASUREMENT
/end GROUP
/begin GROUP S15_Subsystem6 "SWC_INP_type/run_SWC_INP_5ms_sys/INP/IMU/Subsystem6"
 /begin REF_CHARACTERISTIC KINP_SensingGyroY_raw16_ovrdflg KINP_SensingGyroY_raw16_ovrdval /end REF_CHARACTERISTIC
 /begin REF_MEASUREMENT VINP_SensingGyroY_raw16 /end REF_MEASUREMENT
/end GROUP
/begin GROUP S15_Subsystem7 "SWC_INP_type/run_SWC_INP_5ms_sys/INP/IMU/Subsystem7"
 /begin REF_CHARACTERISTIC KINP_SensingGyroX_raw16_ovrdflg KINP_SensingGyroX_raw16_ovrdval /end REF_CHARACTERISTIC
 /begin REF_MEASUREMENT VINP_SensingGyroX_raw16 /end REF_MEASUREMENT
/end GROUP
/begin GROUP S15_Subsystem8 "SWC_INP_type/run_SWC_INP_5ms_sys/INP/IMU/Subsystem8"
 /begin REF_CHARACTERISTIC KINP_SensingAccX_raw16_ovrdflg KINP_SensingAccX_raw16_ovrdval /end REF_CHARACTERISTIC
 /begin REF_MEASUREMENT VINP_SensingAccX_raw16 /end REF_MEASUREMENT
/end GROUP
/begin GROUP S15_Subsystem9 "SWC_INP_type/run_SWC_INP_5ms_sys/INP/IMU/Subsystem9"
 /begin REF_CHARACTERISTIC KINP_SensingGyroZ_raw16_ovrdflg KINP_SensingGyroZ_raw16_ovrdval /end REF_CHARACTERISTIC
 /begin REF_MEASUREMENT VINP_SensingGyroZ_raw16 /end REF_MEASUREMENT
/end GROUP
/begin GROUP S16_Subsystem "SWC_INP_type/run_SWC_INP_5ms_sys/INP/SYS/Subsystem" /begin REF_CHARACTERISTIC KINP_AuxBattVolmV_mV_ovrdflg KINP_AuxBattVolmV_mV_ovrdval /end REF_CHARACTERISTIC /begin REF_MEASUREMENT VINP_AuxBattVolmV_mV /end REF_MEASUREMENT /end GROUP
/begin GROUP S16_Subsystem1 "SWC_INP_type/run_SWC_INP_5ms_sys/INP/SYS/Subsystem1"
 /begin REF_CHARACTERISTIC KINP_NetworkReqCalled_flg_ovrdflg KINP_NetworkReqCalled_flg_ovrdval /end REF_CHARACTERISTIC
 /begin REF_MEASUREMENT VINP_NetworkReqCalled_flg /end REF_MEASUREMENT
/end GROUP
/begin GROUP S16_Subsystem10 "SWC_INP_type/run_SWC_INP_5ms_sys/INP/SYS/Subsystem10" /begin REF_CHARACTERISTIC KINP_CAN3BusOff_flg_ovrdflg KINP_CAN3BusOff_flg_ovrdval /end REF_CHARACTERISTIC /begin REF_MEASUREMENT VINP_CAN3BusOff_flg /end REF_MEASUREMENT /end GROUP
/begin GROUP S16_Subsystem11 "SWC_INP_type/run_SWC_INP_5ms_sys/INP/SYS/Subsystem11" /begin REF_CHARACTERISTIC KINP_CAN6BusOff_flg_ovrdflg KINP_CAN6BusOff_flg_ovrdval /end REF_CHARACTERISTIC /begin REF_MEASUREMENT VINP_CAN6BusOff_flg /end REF_MEASUREMENT /end GROUP
/begin GROUP S16_Subsystem12 "SWC_INP_type/run_SWC_INP_5ms_sys/INP/SYS/Subsystem12" /begin REF_CHARACTERISTIC KINP_CAN4BusOff_flg_ovrdflg KINP_CAN4BusOff_flg_ovrdval /end REF_CHARACTERISTIC /begin REF_MEASUREMENT VINP_CAN4BusOff_flg /end REF_MEASUREMENT /end GROUP
/begin GROUP S16_Subsystem13 "SWC_INP_type/run_SWC_INP_5ms_sys/INP/SYS/Subsystem13" /begin REF_CHARACTERISTIC KINP_CAN5BusOff_flg_ovrdflg KINP_CAN5BusOff_flg_ovrdval /end REF_CHARACTERISTIC /begin REF_MEASUREMENT VINP_CAN5BusOff_flg /end REF_MEASUREMENT /end GROUP
/begin GROUP S16_Subsystem14 "SWC_INP_type/run_SWC_INP_5ms_sys/INP/SYS/Subsystem14"
 /begin REF_CHARACTERISTIC KINP_CbnPreACEnaReq_enum_ovrdflg KINP_CbnPreACEnaReq_enum_ovrdval /end REF_CHARACTERISTIC
 /begin REF_MEASUREMENT VINP_CbnPreACEnaReq_enum /end REF_MEASUREMENT
/end GROUP
/begin GROUP S16_Subsystem15 "SWC_INP_type/run_SWC_INP_5ms_sys/INP/SYS/Subsystem15"
 /begin REF_CHARACTERISTIC KINP_PowerOffTSet_cnt_ovrdflg KINP_PowerOffTSet_cnt_ovrdval /end REF_CHARACTERISTIC
 /begin REF_MEASUREMENT VINP_PowerOffTSet_cnt /end REF_MEASUREMENT
/end GROUP
/begin GROUP S16_Subsystem16 "SWC_INP_type/run_SWC_INP_5ms_sys/INP/SYS/Subsystem16"
 /begin REF_CHARACTERISTIC KINP_ReOutsideMirror_enum_ovrdflg KINP_ReOutsideMirror_enum_ovrdval /end REF_CHARACTERISTIC
 /begin REF_MEASUREMENT VINP_ReOutsideMirror_enum /end REF_MEASUREMENT
/end GROUP
/begin GROUP S16_Subsystem17 "SWC_INP_type/run_SWC_INP_5ms_sys/INP/SYS/Subsystem17" /begin REF_CHARACTERISTIC KINP_ReDoorLock_enum_ovrdflg KINP_ReDoorLock_enum_ovrdval /end REF_CHARACTERISTIC /begin REF_MEASUREMENT VINP_ReDoorLock_enum /end REF_MEASUREMENT /end GROUP
/begin GROUP S16_Subsystem18 "SWC_INP_type/run_SWC_INP_5ms_sys/INP/SYS/Subsystem18"
 /begin REF_CHARACTERISTIC KINP_RePwrReqTbox_enum_ovrdflg KINP_RePwrReqTbox_enum_ovrdval /end REF_CHARACTERISTIC
 /begin REF_MEASUREMENT VINP_RePwrReqTbox_enum /end REF_MEASUREMENT
/end GROUP
/begin GROUP S16_Subsystem19 "SWC_INP_type/run_SWC_INP_5ms_sys/INP/SYS/Subsystem19" /begin REF_CHARACTERISTIC KINP_ReRadio_flg_ovrdflg KINP_ReRadio_flg_ovrdval /end REF_CHARACTERISTIC /begin REF_MEASUREMENT VINP_ReRadio_flg /end REF_MEASUREMENT /end GROUP
/begin GROUP S16_Subsystem2 "SWC_INP_type/run_SWC_INP_5ms_sys/INP/SYS/Subsystem2" /begin REF_CHARACTERISTIC KINP_Pedal1Ref5V_V_ovrdflg KINP_Pedal1Ref5V_V_ovrdval /end REF_CHARACTERISTIC /begin REF_MEASUREMENT VINP_Pedal1Ref5V_V /end REF_MEASUREMENT /end GROUP
/begin GROUP S16_Subsystem20 "SWC_INP_type/run_SWC_INP_5ms_sys/INP/SYS/Subsystem20" /begin REF_CHARACTERISTIC KINP_RemoteACTemp_C_ovrdflg KINP_RemoteACTemp_C_ovrdval /end REF_CHARACTERISTIC /begin REF_MEASUREMENT VINP_RemoteACTemp_C /end REF_MEASUREMENT /end GROUP
/begin GROUP S16_Subsystem21 "SWC_INP_type/run_SWC_INP_5ms_sys/INP/SYS/Subsystem21"
 /begin REF_CHARACTERISTIC KINP_RemoteAutoReq_flg_ovrdflg KINP_RemoteAutoReq_flg_ovrdval /end REF_CHARACTERISTIC
 /begin REF_MEASUREMENT VINP_RemoteAutoReq_flg /end REF_MEASUREMENT
/end GROUP
/begin GROUP S16_Subsystem22 "SWC_INP_type/run_SWC_INP_5ms_sys/INP/SYS/Subsystem22"
 /begin REF_CHARACTERISTIC KINP_TBOXRemotePW_enum_ovrdflg KINP_TBOXRemotePW_enum_ovrdval /end REF_CHARACTERISTIC
 /begin REF_MEASUREMENT VINP_TBOXRemotePW_enum /end REF_MEASUREMENT
/end GROUP
/begin GROUP S16_Subsystem23 "SWC_INP_type/run_SWC_INP_5ms_sys/INP/SYS/Subsystem23"
 /begin REF_CHARACTERISTIC KINP_FDCConnDrvWdwCtrlCmd_pct_ovrdflg KINP_FDCConnDrvWdwCtrlCmd_pct_ovrdval /end REF_CHARACTERISTIC
 /begin REF_MEASUREMENT VINP_FDCConnDrvWdwCtrlCmd_pct /end REF_MEASUREMENT
/end GROUP
/begin GROUP S16_Subsystem24 "SWC_INP_type/run_SWC_INP_5ms_sys/INP/SYS/Subsystem24"
 /begin REF_CHARACTERISTIC KINP_FDCConnPasWdwCtrlCmd_pct_ovrdflg KINP_FDCConnPasWdwCtrlCmd_pct_ovrdval /end REF_CHARACTERISTIC
 /begin REF_MEASUREMENT VINP_FDCConnPasWdwCtrlCmd_pct /end REF_MEASUREMENT
/end GROUP
/begin GROUP S16_Subsystem25 "SWC_INP_type/run_SWC_INP_5ms_sys/INP/SYS/Subsystem25"
 /begin REF_CHARACTERISTIC KINP_FDCConnRLDWdwCtrlCmd_pct_ovrdflg KINP_FDCConnRLDWdwCtrlCmd_pct_ovrdval /end REF_CHARACTERISTIC
 /begin REF_MEASUREMENT VINP_FDCConnRLDWdwCtrlCmd_pct /end REF_MEASUREMENT
/end GROUP
/begin GROUP S16_Subsystem26 "SWC_INP_type/run_SWC_INP_5ms_sys/INP/SYS/Subsystem26"
 /begin REF_CHARACTERISTIC KINP_FDCConnRRDWdwCtrlCmd_pct_ovrdflg KINP_FDCConnRRDWdwCtrlCmd_pct_ovrdval /end REF_CHARACTERISTIC
 /begin REF_MEASUREMENT VINP_FDCConnRRDWdwCtrlCmd_pct /end REF_MEASUREMENT
/end GROUP
/begin GROUP S16_Subsystem3 "SWC_INP_type/run_SWC_INP_5ms_sys/INP/SYS/Subsystem3" /begin REF_CHARACTERISTIC KINP_Pedal2Ref5V_V_ovrdflg KINP_Pedal2Ref5V_V_ovrdval /end REF_CHARACTERISTIC /begin REF_MEASUREMENT VINP_Pedal2Ref5V_V /end REF_MEASUREMENT /end GROUP
/end MODULE
/end PROJECT
