ASAP2_VERSION 1 31
/begin PROJECT ProjectName "Project Comment Goes Here"
/begin HEADER "Header Comments go here" /end HEADER
/begin MODULE ModuleName "Module Comment Goes Here"
/begin MOD_COMMON "Mod Common Comment Here" BYTE_ORDER MSB_LAST /end MOD_COMMON
/begin RECORD_LAYOUT Scalar_BOOLEAN FNC_VALUES 1 UBYTE COLUMN_DIR DIRECT /end RECORD_LAYOUT
/begin RECORD_LAYOUT Scalar_UBYTE FNC_VALUES 1 UBYTE COLUMN_DIR DIRECT /end RECORD_LAYOUT
/begin RECORD_LAYOUT Scalar_FLOAT32_IEEE FNC_VALUES 1 FLOAT32_IEEE COLUMN_DIR DIRECT /end RECORD_LAYOUT
/begin RECORD_LAYOUT Lookup1D_FLOAT32_IEEE FNC_VALUES 1 FLOAT32_IEEE COLUMN_DIR DIRECT /end RECORD_LAYOUT
/begin RECORD_LAYOUT Lookup1D_X_FLOAT32_IEEE AXIS_PTS_X 1 FLOAT32_IEEE INDEX_INCR DIRECT /end RECORD_LAYOUT
/begin RECORD_LAYOUT Lookup2D_WORD FNC_VALUES 1 SWORD COLUMN_DIR DIRECT /end RECORD_LAYOUT
/begin RECORD_LAYOUT Lookup2D_X_WORD AXIS_PTS_X 1 SWORD INDEX_INCR DIRECT /end RECORD_LAYOUT
/begin RECORD_LAYOUT Lookup2D_ULONG FNC_VALUES 1 ULONG COLUMN_DIR DIRECT /end RECORD_LAYOUT
/begin RECORD_LAYOUT Lookup2D_X_ULONG AXIS_PTS_X 1 ULONG INDEX_INCR DIRECT /end RECORD_LAYOUT
/begin RECORD_LAYOUT Lookup2D_LONG FNC_VALUES 1 SLONG COLUMN_DIR DIRECT /end RECORD_LAYOUT
/begin RECORD_LAYOUT Lookup2D_X_LONG AXIS_PTS_X 1 SLONG INDEX_INCR DIRECT /end RECORD_LAYOUT
/begin RECORD_LAYOUT Lookup2D_FLOAT32_IEEE FNC_VALUES 1 FLOAT32_IEEE COLUMN_DIR DIRECT /end RECORD_LAYOUT
/begin RECORD_LAYOUT Lookup2D_X_FLOAT32_IEEE AXIS_PTS_X 1 FLOAT32_IEEE INDEX_INCR DIRECT /end RECORD_LAYOUT
/begin RECORD_LAYOUT Lookup2D_FLOAT64_IEEE FNC_VALUES 1 FLOAT64_IEEE COLUMN_DIR DIRECT /end RECORD_LAYOUT
/begin RECORD_LAYOUT Lookup2D_X_FLOAT64_IEEE AXIS_PTS_X 1 FLOAT64_IEEE INDEX_INCR DIRECT /end RECORD_LAYOUT
/begin AXIS_PTS ATQD_NL1TqMapD_Y_pct "" 0x0000 /* @ECU_Address@ATQD_NL1TqMapD_Y_pct@ */ VTQD_ActAPSPosn_pct Lookup2D_X_FLOAT32_IEEE 0 SWC_FDC_type_CM_single_pct 35 0.0 110.0 /end AXIS_PTS
/begin AXIS_PTS ATQD_NL1TqMapD_X_rpm "" 0x0000 /* @ECU_Address@ATQD_NL1TqMapD_X_rpm@ */ VTQD_TqTargetShaftSpd_rpm Lookup2D_X_FLOAT32_IEEE 0 SWC_FDC_type_CM_single_rpm 42 -100000.0 100000.0 /end AXIS_PTS
/begin AXIS_PTS ATQR_NL1FEDUTs_Y_Nm "" 0x0000 /* @ECU_Address@ATQR_NL1FEDUTs_Y_Nm@ */ VTQR_FEDUWhlTqReqSmoothDelay_Nm Lookup2D_X_FLOAT32_IEEE 0 SWC_FDC_type_CM_single_Nm 18 -10000.0 10000.0 /end AXIS_PTS
/begin AXIS_PTS ATQR_NL1FEDUTs_X_rpm "" 0x0000 /* @ECU_Address@ATQR_NL1FEDUTs_X_rpm@ */ NO_INPUT_QUANTITY Lookup2D_X_FLOAT32_IEEE 0 SWC_FDC_type_CM_single_rpm 24 -100000.0 100000.0 /end AXIS_PTS
/begin AXIS_PTS ATQR_NL1REDUTqDecSR_Y_Nm "" 0x0000 /* @ECU_Address@ATQR_NL1REDUTqDecSR_Y_Nm@ */ VTQR_FEDUWhlTqReqSmoothDelay_Nm Lookup2D_X_FLOAT32_IEEE 0 SWC_FDC_type_CM_single_Nm 18 -10000.0 10000.0 /end AXIS_PTS
/begin AXIS_PTS ATQR_NL1FEDUTqIncSR_X_rpm "" 0x0000 /* @ECU_Address@ATQR_NL1FEDUTqIncSR_X_rpm@ */ NO_INPUT_QUANTITY Lookup2D_X_FLOAT32_IEEE 0 SWC_FDC_type_CM_single_rpm 24 -100000.0 100000.0 /end AXIS_PTS
/begin AXIS_PTS ATQR_NL1FEDUTqIncSR_Y_pct "" 0x0000 /* @ECU_Address@ATQR_NL1FEDUTqIncSR_Y_pct@ */ NO_INPUT_QUANTITY Lookup2D_X_FLOAT32_IEEE 0 SWC_FDC_type_CM_single_Nm 17 0.0 120.0 /end AXIS_PTS
/begin AXIS_PTS ATQR_NL1FEDUTqDecSR_Y_Nm "" 0x0000 /* @ECU_Address@ATQR_NL1FEDUTqDecSR_Y_Nm@ */ VTQR_FEDUWhlTqReqSmoothDelay_Nm Lookup2D_X_FLOAT32_IEEE 0 SWC_FDC_type_CM_single_Nm 18 -10000.0 10000.0 /end AXIS_PTS
/begin AXIS_PTS ATQR_NL1REDUTs_Y_Nm "" 0x0000 /* @ECU_Address@ATQR_NL1REDUTs_Y_Nm@ */ VTQR_REDUWhlTqReqSmoothDelay_Nm Lookup2D_X_FLOAT32_IEEE 0 SWC_FDC_type_CM_single_Nm 18 -10000.0 10000.0 /end AXIS_PTS
/begin CHARACTERISTIC MTQR_ECO2TqRrIncGain_Z_c "" MAP 0x0000 /* @ECU_Address@MTQR_ECO2TqRrIncGain_Z_c@ */ Lookup2D_FLOAT32_IEEE 0 SWC_FDC_type_CM_single_c 0.0 300.0
 /begin AXIS_DESCR COM_AXIS VTQR_REDUWhlTqReqSmoothDelay_Nm SWC_FDC_type_CM_single_Nm 20 -100000.0 100000.0 AXIS_PTS_REF ATQR_ECO2TqRrIncGain_X_Nm /end AXIS_DESCR
 /begin AXIS_DESCR COM_AXIS NO_INPUT_QUANTITY SWC_FDC_type_CM_single_pct 17 -125.0 125.0 AXIS_PTS_REF ATQR_ECO2TqRrIncGain_Y_pct /end AXIS_DESCR
/end CHARACTERISTIC
/begin AXIS_PTS ATQR_ECO2TqRrIncGain_Y_pct "" 0x0000 /* @ECU_Address@ATQR_ECO2TqRrIncGain_Y_pct@ */ NO_INPUT_QUANTITY Lookup2D_X_FLOAT32_IEEE 0 SWC_FDC_type_CM_single_pct 17 -125.0 125.0 /end AXIS_PTS
/begin AXIS_PTS ATQR_ECO2TqRrIncGain_X_Nm "" 0x0000 /* @ECU_Address@ATQR_ECO2TqRrIncGain_X_Nm@ */ VTQR_REDUWhlTqReqSmoothDelay_Nm Lookup2D_X_FLOAT32_IEEE 0 SWC_FDC_type_CM_single_Nm 20 -100000.0 100000.0 /end AXIS_PTS
/begin CHARACTERISTIC MTQR_ECO3TqRrIncGain_Z_c "" MAP 0x0000 /* @ECU_Address@MTQR_ECO3TqRrIncGain_Z_c@ */ Lookup2D_FLOAT32_IEEE 0 SWC_FDC_type_CM_single_c 0.0 300.0
 /begin AXIS_DESCR COM_AXIS VTQR_REDUWhlTqReqSmoothDelay_Nm SWC_FDC_type_CM_single_Nm 20 -100000.0 100000.0 AXIS_PTS_REF ATQR_ECO2TqRrIncGain_X_Nm /end AXIS_DESCR
 /begin AXIS_DESCR COM_AXIS NO_INPUT_QUANTITY SWC_FDC_type_CM_single_pct 17 -125.0 125.0 AXIS_PTS_REF ATQR_ECO2TqRrIncGain_Y_pct /end AXIS_DESCR
/end CHARACTERISTIC
/begin CHARACTERISTIC MTQR_ECO4TqRrIncGain_Z_c "" MAP 0x0000 /* @ECU_Address@MTQR_ECO4TqRrIncGain_Z_c@ */ Lookup2D_FLOAT32_IEEE 0 SWC_FDC_type_CM_single_c 0.0 300.0
 /begin AXIS_DESCR COM_AXIS VTQR_REDUWhlTqReqSmoothDelay_Nm SWC_FDC_type_CM_single_Nm 20 -100000.0 100000.0 AXIS_PTS_REF ATQR_ECO2TqRrIncGain_X_Nm /end AXIS_DESCR
 /begin AXIS_DESCR COM_AXIS NO_INPUT_QUANTITY SWC_FDC_type_CM_single_pct 17 -125.0 125.0 AXIS_PTS_REF ATQR_ECO2TqRrIncGain_Y_pct /end AXIS_DESCR
/end CHARACTERISTIC
/begin CHARACTERISTIC MTQR_ECO5TqRrIncGain_Z_c "" MAP 0x0000 /* @ECU_Address@MTQR_ECO5TqRrIncGain_Z_c@ */ Lookup2D_FLOAT32_IEEE 0 SWC_FDC_type_CM_single_c 0.0 300.0
 /begin AXIS_DESCR COM_AXIS VTQR_REDUWhlTqReqSmoothDelay_Nm SWC_FDC_type_CM_single_Nm 20 -100000.0 100000.0 AXIS_PTS_REF ATQR_ECO2TqRrIncGain_X_Nm /end AXIS_DESCR
 /begin AXIS_DESCR COM_AXIS NO_INPUT_QUANTITY SWC_FDC_type_CM_single_pct 17 -125.0 125.0 AXIS_PTS_REF ATQR_ECO2TqRrIncGain_Y_pct /end AXIS_DESCR
/end CHARACTERISTIC
/begin CHARACTERISTIC MTQR_ECOOPDTqRrIncGain_Z_c "" MAP 0x0000 /* @ECU_Address@MTQR_ECOOPDTqRrIncGain_Z_c@ */ Lookup2D_FLOAT32_IEEE 0 SWC_FDC_type_CM_single_c 0.0 300.0
 /begin AXIS_DESCR COM_AXIS VTQR_REDUWhlTqReqSmoothDelay_Nm SWC_FDC_type_CM_single_Nm 20 -100000.0 100000.0 AXIS_PTS_REF ATQR_ECO2TqRrIncGain_X_Nm /end AXIS_DESCR
 /begin AXIS_DESCR COM_AXIS NO_INPUT_QUANTITY SWC_FDC_type_CM_single_pct 17 -125.0 125.0 AXIS_PTS_REF ATQR_ECO2TqRrIncGain_Y_pct /end AXIS_DESCR
/end CHARACTERISTIC
/begin CHARACTERISTIC MTQR_EcoTqRrIncGain_Z_c "" MAP 0x0000 /* @ECU_Address@MTQR_EcoTqRrIncGain_Z_c@ */ Lookup2D_FLOAT32_IEEE 0 SWC_FDC_type_CM_single_c 0.0 300.0
 /begin AXIS_DESCR COM_AXIS VTQR_REDUWhlTqReqSmoothDelay_Nm SWC_FDC_type_CM_single_Nm 24 -100000.0 100000.0 AXIS_PTS_REF ATQR_EcoTqRrIncGain_X_Nm /end AXIS_DESCR
 /begin AXIS_DESCR COM_AXIS NO_INPUT_QUANTITY SWC_FDC_type_CM_single_pct 17 -125.0 125.0 AXIS_PTS_REF ATQR_EcoTqRrIncGain_Y_pct /end AXIS_DESCR
/end CHARACTERISTIC
/begin AXIS_PTS ATQR_EcoTqRrIncGain_Y_pct "" 0x0000 /* @ECU_Address@ATQR_EcoTqRrIncGain_Y_pct@ */ NO_INPUT_QUANTITY Lookup2D_X_FLOAT32_IEEE 0 SWC_FDC_type_CM_single_pct 17 -125.0 125.0 /end AXIS_PTS
/begin AXIS_PTS ATQR_EcoTqRrIncGain_X_Nm "" 0x0000 /* @ECU_Address@ATQR_EcoTqRrIncGain_X_Nm@ */ VTQR_REDUWhlTqReqSmoothDelay_Nm Lookup2D_X_FLOAT32_IEEE 0 SWC_FDC_type_CM_single_Nm 24 -100000.0 100000.0 /end AXIS_PTS
/begin CHARACTERISTIC MTQR_ESCAPEREDUTqDecSR_Z_Nm "" MAP 0x0000 /* @ECU_Address@MTQR_ESCAPEREDUTqDecSR_Z_Nm@ */ Lookup2D_FLOAT32_IEEE 0 SWC_FDC_type_CM_single_Nm -100000.0 0.0
 /begin AXIS_DESCR COM_AXIS NO_INPUT_QUANTITY SWC_FDC_type_CM_single_rpm 24 -100000.0 100000.0 AXIS_PTS_REF ATQR_NL1FEDUTqIncSR_X_rpm /end AXIS_DESCR
 /begin AXIS_DESCR COM_AXIS VTQR_REDUWhlTqReqSmoothDelay_Nm SWC_FDC_type_CM_single_Nm 18 -10000.0 10000.0 AXIS_PTS_REF ATQR_NL1REDUTqDecSR_Y_Nm /end AXIS_DESCR
/end CHARACTERISTIC
/begin CHARACTERISTIC MTQR_ESCAPEREDUTqIncSR_Z_Nm "" MAP 0x0000 /* @ECU_Address@MTQR_ESCAPEREDUTqIncSR_Z_Nm@ */ Lookup2D_FLOAT32_IEEE 0 SWC_FDC_type_CM_single_Nm 0.0 100000.0
 /begin AXIS_DESCR COM_AXIS NO_INPUT_QUANTITY SWC_FDC_type_CM_single_rpm 24 -100000.0 100000.0 AXIS_PTS_REF ATQR_NL1FEDUTqIncSR_X_rpm /end AXIS_DESCR
 /begin AXIS_DESCR COM_AXIS NO_INPUT_QUANTITY SWC_FDC_type_CM_single_Nm 17 0.0 120.0 AXIS_PTS_REF ATQR_NL1FEDUTqIncSR_Y_pct /end AXIS_DESCR
/end CHARACTERISTIC
/begin CHARACTERISTIC MTQR_LHMREDUTqDecSR_Z_Nm "" MAP 0x0000 /* @ECU_Address@MTQR_LHMREDUTqDecSR_Z_Nm@ */ Lookup2D_FLOAT32_IEEE 0 SWC_FDC_type_CM_single_Nm -100000.0 0.0
 /begin AXIS_DESCR COM_AXIS NO_INPUT_QUANTITY SWC_FDC_type_CM_single_rpm 24 -100000.0 100000.0 AXIS_PTS_REF ATQR_NL1FEDUTqIncSR_X_rpm /end AXIS_DESCR
 /begin AXIS_DESCR COM_AXIS VTQR_REDUWhlTqReqSmoothDelay_Nm SWC_FDC_type_CM_single_Nm 18 -10000.0 10000.0 AXIS_PTS_REF ATQR_NL1REDUTqDecSR_Y_Nm /end AXIS_DESCR
/end CHARACTERISTIC
/begin CHARACTERISTIC MTQR_LHMREDUTqIncSR_Z_Nm "" MAP 0x0000 /* @ECU_Address@MTQR_LHMREDUTqIncSR_Z_Nm@ */ Lookup2D_FLOAT32_IEEE 0 SWC_FDC_type_CM_single_Nm 0.0 100000.0
 /begin AXIS_DESCR COM_AXIS NO_INPUT_QUANTITY SWC_FDC_type_CM_single_rpm 24 -100000.0 100000.0 AXIS_PTS_REF ATQR_NL1FEDUTqIncSR_X_rpm /end AXIS_DESCR
 /begin AXIS_DESCR COM_AXIS NO_INPUT_QUANTITY SWC_FDC_type_CM_single_Nm 17 0.0 120.0 AXIS_PTS_REF ATQR_NL1FEDUTqIncSR_Y_pct /end AXIS_DESCR
/end CHARACTERISTIC
/begin CHARACTERISTIC MTQR_NL2TqRrIncGain_Z_c "" MAP 0x0000 /* @ECU_Address@MTQR_NL2TqRrIncGain_Z_c@ */ Lookup2D_FLOAT32_IEEE 0 SWC_FDC_type_CM_single_c 0.0 300.0
 /begin AXIS_DESCR COM_AXIS VTQR_REDUWhlTqReqSmoothDelay_Nm SWC_FDC_type_CM_single_Nm 20 -100000.0 100000.0 AXIS_PTS_REF ATQR_NL2TqRrIncGain_X_Nm /end AXIS_DESCR
 /begin AXIS_DESCR COM_AXIS NO_INPUT_QUANTITY SWC_FDC_type_CM_single_pct 17 -125.0 125.0 AXIS_PTS_REF ATQR_NL2TqRrIncGain_Y_pct /end AXIS_DESCR
/end CHARACTERISTIC
/begin AXIS_PTS ATQR_NL2TqRrIncGain_Y_pct "" 0x0000 /* @ECU_Address@ATQR_NL2TqRrIncGain_Y_pct@ */ NO_INPUT_QUANTITY Lookup2D_X_FLOAT32_IEEE 0 SWC_FDC_type_CM_single_pct 17 -125.0 125.0 /end AXIS_PTS
/begin AXIS_PTS ATQR_NL2TqRrIncGain_X_Nm "" 0x0000 /* @ECU_Address@ATQR_NL2TqRrIncGain_X_Nm@ */ VTQR_REDUWhlTqReqSmoothDelay_Nm Lookup2D_X_FLOAT32_IEEE 0 SWC_FDC_type_CM_single_Nm 20 -100000.0 100000.0 /end AXIS_PTS
/begin CHARACTERISTIC MTQR_NL3TqRrIncGain_Z_c "" MAP 0x0000 /* @ECU_Address@MTQR_NL3TqRrIncGain_Z_c@ */ Lookup2D_FLOAT32_IEEE 0 SWC_FDC_type_CM_single_c 0.0 300.0
 /begin AXIS_DESCR COM_AXIS VTQR_REDUWhlTqReqSmoothDelay_Nm SWC_FDC_type_CM_single_Nm 20 -100000.0 100000.0 AXIS_PTS_REF ATQR_NL2TqRrIncGain_X_Nm /end AXIS_DESCR
 /begin AXIS_DESCR COM_AXIS NO_INPUT_QUANTITY SWC_FDC_type_CM_single_pct 17 -125.0 125.0 AXIS_PTS_REF ATQR_NL2TqRrIncGain_Y_pct /end AXIS_DESCR
/end CHARACTERISTIC
/begin CHARACTERISTIC MTQR_NL4TqRrIncGain_Z_c "" MAP 0x0000 /* @ECU_Address@MTQR_NL4TqRrIncGain_Z_c@ */ Lookup2D_FLOAT32_IEEE 0 SWC_FDC_type_CM_single_c 0.0 300.0
 /begin AXIS_DESCR COM_AXIS VTQR_REDUWhlTqReqSmoothDelay_Nm SWC_FDC_type_CM_single_Nm 20 -100000.0 100000.0 AXIS_PTS_REF ATQR_NL2TqRrIncGain_X_Nm /end AXIS_DESCR
 /begin AXIS_DESCR COM_AXIS NO_INPUT_QUANTITY SWC_FDC_type_CM_single_pct 17 -125.0 125.0 AXIS_PTS_REF ATQR_NL2TqRrIncGain_Y_pct /end AXIS_DESCR
/end CHARACTERISTIC
/begin CHARACTERISTIC MTQR_NL5TqRrIncGain_Z_c "" MAP 0x0000 /* @ECU_Address@MTQR_NL5TqRrIncGain_Z_c@ */ Lookup2D_FLOAT32_IEEE 0 SWC_FDC_type_CM_single_c 0.0 300.0
 /begin AXIS_DESCR COM_AXIS VTQR_REDUWhlTqReqSmoothDelay_Nm SWC_FDC_type_CM_single_Nm 20 -100000.0 100000.0 AXIS_PTS_REF ATQR_NL2TqRrIncGain_X_Nm /end AXIS_DESCR
 /begin AXIS_DESCR COM_AXIS NO_INPUT_QUANTITY SWC_FDC_type_CM_single_pct 17 -125.0 125.0 AXIS_PTS_REF ATQR_NL2TqRrIncGain_Y_pct /end AXIS_DESCR
/end CHARACTERISTIC
/begin CHARACTERISTIC MTQR_NLOPDTqRrIncGain_Z_c "" MAP 0x0000 /* @ECU_Address@MTQR_NLOPDTqRrIncGain_Z_c@ */ Lookup2D_FLOAT32_IEEE 0 SWC_FDC_type_CM_single_c 0.0 300.0
 /begin AXIS_DESCR COM_AXIS VTQR_REDUWhlTqReqSmoothDelay_Nm SWC_FDC_type_CM_single_Nm 20 -100000.0 100000.0 AXIS_PTS_REF ATQR_NL2TqRrIncGain_X_Nm /end AXIS_DESCR
 /begin AXIS_DESCR COM_AXIS NO_INPUT_QUANTITY SWC_FDC_type_CM_single_pct 17 -125.0 125.0 AXIS_PTS_REF ATQR_NL2TqRrIncGain_Y_pct /end AXIS_DESCR
/end CHARACTERISTIC
/begin CHARACTERISTIC MTQR_NormalTqRrIncGain_Z_c "" MAP 0x0000 /* @ECU_Address@MTQR_NormalTqRrIncGain_Z_c@ */ Lookup2D_FLOAT32_IEEE 0 SWC_FDC_type_CM_single_c 0.0 300.0
 /begin AXIS_DESCR COM_AXIS VTQR_REDUWhlTqReqSmoothDelay_Nm SWC_FDC_type_CM_single_Nm 24 -100000.0 100000.0 AXIS_PTS_REF ATQR_NormalTqRrIncGain_X_Nm /end AXIS_DESCR
 /begin AXIS_DESCR COM_AXIS NO_INPUT_QUANTITY SWC_FDC_type_CM_single_pct 17 -125.0 125.0 AXIS_PTS_REF ATQR_NormalTqRrIncGain_Y_pct /end AXIS_DESCR
/end CHARACTERISTIC
/begin AXIS_PTS ATQR_NormalTqRrIncGain_Y_pct "" 0x0000 /* @ECU_Address@ATQR_NormalTqRrIncGain_Y_pct@ */ NO_INPUT_QUANTITY Lookup2D_X_FLOAT32_IEEE 0 SWC_FDC_type_CM_single_pct 17 -125.0 125.0 /end AXIS_PTS
/begin AXIS_PTS ATQR_NormalTqRrIncGain_X_Nm "" 0x0000 /* @ECU_Address@ATQR_NormalTqRrIncGain_X_Nm@ */ VTQR_REDUWhlTqReqSmoothDelay_Nm Lookup2D_X_FLOAT32_IEEE 0 SWC_FDC_type_CM_single_Nm 24 -100000.0 100000.0 /end AXIS_PTS
/begin CHARACTERISTIC MTQR_SNOWREDUTqDecSR_Z_Nm "" MAP 0x0000 /* @ECU_Address@MTQR_SNOWREDUTqDecSR_Z_Nm@ */ Lookup2D_FLOAT32_IEEE 0 SWC_FDC_type_CM_single_Nm -100000.0 0.0
 /begin AXIS_DESCR COM_AXIS NO_INPUT_QUANTITY SWC_FDC_type_CM_single_rpm 24 -100000.0 100000.0 AXIS_PTS_REF ATQR_NL1FEDUTqIncSR_X_rpm /end AXIS_DESCR
 /begin AXIS_DESCR COM_AXIS VTQR_REDUWhlTqReqSmoothDelay_Nm SWC_FDC_type_CM_single_Nm 18 -10000.0 10000.0 AXIS_PTS_REF ATQR_NL1REDUTqDecSR_Y_Nm /end AXIS_DESCR
/end CHARACTERISTIC
/begin CHARACTERISTIC MTQR_SNOWREDUTqIncSR_Z_Nm "" MAP 0x0000 /* @ECU_Address@MTQR_SNOWREDUTqIncSR_Z_Nm@ */ Lookup2D_FLOAT32_IEEE 0 SWC_FDC_type_CM_single_Nm 0.0 100000.0
 /begin AXIS_DESCR COM_AXIS NO_INPUT_QUANTITY SWC_FDC_type_CM_single_rpm 24 -100000.0 100000.0 AXIS_PTS_REF ATQR_NL1FEDUTqIncSR_X_rpm /end AXIS_DESCR
 /begin AXIS_DESCR COM_AXIS NO_INPUT_QUANTITY SWC_FDC_type_CM_single_Nm 17 0.0 120.0 AXIS_PTS_REF ATQR_NL1FEDUTqIncSR_Y_pct /end AXIS_DESCR
/end CHARACTERISTIC
/begin CHARACTERISTIC MTQR_Sport2TqRrIncGain_Z_c "" MAP 0x0000 /* @ECU_Address@MTQR_Sport2TqRrIncGain_Z_c@ */ Lookup2D_FLOAT32_IEEE 0 SWC_FDC_type_CM_single_c 0.0 300.0
 /begin AXIS_DESCR COM_AXIS VTQR_REDUWhlTqReqSmoothDelay_Nm SWC_FDC_type_CM_single_Nm 20 -100000.0 100000.0 AXIS_PTS_REF ATQR_Sport2TqRrIncGain_X_Nm /end AXIS_DESCR
 /begin AXIS_DESCR COM_AXIS NO_INPUT_QUANTITY SWC_FDC_type_CM_single_pct 17 -125.0 125.0 AXIS_PTS_REF ATQR_Sport2TqRrIncGain_Y_pct /end AXIS_DESCR
/end CHARACTERISTIC
/begin AXIS_PTS ATQR_Sport2TqRrIncGain_Y_pct "" 0x0000 /* @ECU_Address@ATQR_Sport2TqRrIncGain_Y_pct@ */ NO_INPUT_QUANTITY Lookup2D_X_FLOAT32_IEEE 0 SWC_FDC_type_CM_single_pct 17 -125.0 125.0 /end AXIS_PTS
/begin AXIS_PTS ATQR_Sport2TqRrIncGain_X_Nm "" 0x0000 /* @ECU_Address@ATQR_Sport2TqRrIncGain_X_Nm@ */ VTQR_REDUWhlTqReqSmoothDelay_Nm Lookup2D_X_FLOAT32_IEEE 0 SWC_FDC_type_CM_single_Nm 20 -100000.0 100000.0 /end AXIS_PTS
/begin CHARACTERISTIC MTQR_Sport3TqRrIncGain_Z_c "" MAP 0x0000 /* @ECU_Address@MTQR_Sport3TqRrIncGain_Z_c@ */ Lookup2D_FLOAT32_IEEE 0 SWC_FDC_type_CM_single_c 0.0 300.0
 /begin AXIS_DESCR COM_AXIS VTQR_REDUWhlTqReqSmoothDelay_Nm SWC_FDC_type_CM_single_Nm 20 -100000.0 100000.0 AXIS_PTS_REF ATQR_Sport2TqRrIncGain_X_Nm /end AXIS_DESCR
 /begin AXIS_DESCR COM_AXIS NO_INPUT_QUANTITY SWC_FDC_type_CM_single_pct 17 -125.0 125.0 AXIS_PTS_REF ATQR_Sport2TqRrIncGain_Y_pct /end AXIS_DESCR
/end CHARACTERISTIC
/begin CHARACTERISTIC MTQR_Sport4TqRrIncGain_Z_c "" MAP 0x0000 /* @ECU_Address@MTQR_Sport4TqRrIncGain_Z_c@ */ Lookup2D_FLOAT32_IEEE 0 SWC_FDC_type_CM_single_c 0.0 300.0
 /begin AXIS_DESCR COM_AXIS VTQR_REDUWhlTqReqSmoothDelay_Nm SWC_FDC_type_CM_single_Nm 20 -100000.0 100000.0 AXIS_PTS_REF ATQR_Sport2TqRrIncGain_X_Nm /end AXIS_DESCR
 /begin AXIS_DESCR COM_AXIS NO_INPUT_QUANTITY SWC_FDC_type_CM_single_pct 17 -125.0 125.0 AXIS_PTS_REF ATQR_Sport2TqRrIncGain_Y_pct /end AXIS_DESCR
/end CHARACTERISTIC
/begin CHARACTERISTIC MTQR_Sport5TqRrIncGain_Z_c "" MAP 0x0000 /* @ECU_Address@MTQR_Sport5TqRrIncGain_Z_c@ */ Lookup2D_FLOAT32_IEEE 0 SWC_FDC_type_CM_single_c 0.0 300.0
 /begin AXIS_DESCR COM_AXIS VTQR_REDUWhlTqReqSmoothDelay_Nm SWC_FDC_type_CM_single_Nm 20 -100000.0 100000.0 AXIS_PTS_REF ATQR_Sport2TqRrIncGain_X_Nm /end AXIS_DESCR
 /begin AXIS_DESCR COM_AXIS NO_INPUT_QUANTITY SWC_FDC_type_CM_single_pct 17 -125.0 125.0 AXIS_PTS_REF ATQR_Sport2TqRrIncGain_Y_pct /end AXIS_DESCR
/end CHARACTERISTIC
/begin CHARACTERISTIC MTQR_SportOPDTqRrIncGain_Z_c "" MAP 0x0000 /* @ECU_Address@MTQR_SportOPDTqRrIncGain_Z_c@ */ Lookup2D_FLOAT32_IEEE 0 SWC_FDC_type_CM_single_c 0.0 300.0
 /begin AXIS_DESCR COM_AXIS VTQR_REDUWhlTqReqSmoothDelay_Nm SWC_FDC_type_CM_single_Nm 20 -100000.0 100000.0 AXIS_PTS_REF ATQR_Sport2TqRrIncGain_X_Nm /end AXIS_DESCR
 /begin AXIS_DESCR COM_AXIS NO_INPUT_QUANTITY SWC_FDC_type_CM_single_pct 17 -125.0 125.0 AXIS_PTS_REF ATQR_Sport2TqRrIncGain_Y_pct /end AXIS_DESCR
/end CHARACTERISTIC
/begin CHARACTERISTIC MTQR_SportTqRrIncGain_Z_c "" MAP 0x0000 /* @ECU_Address@MTQR_SportTqRrIncGain_Z_c@ */ Lookup2D_FLOAT32_IEEE 0 SWC_FDC_type_CM_single_c 0.0 300.0
 /begin AXIS_DESCR COM_AXIS VTQR_REDUWhlTqReqSmoothDelay_Nm SWC_FDC_type_CM_single_Nm 24 -100000.0 100000.0 AXIS_PTS_REF ATQR_SportTqRrIncGain_X_Nm /end AXIS_DESCR
 /begin AXIS_DESCR COM_AXIS NO_INPUT_QUANTITY SWC_FDC_type_CM_single_pct 17 -125.0 125.0 AXIS_PTS_REF ATQR_SportTqRrIncGain_Y_pct /end AXIS_DESCR
/end CHARACTERISTIC
/begin AXIS_PTS ATQR_SportTqRrIncGain_Y_pct "" 0x0000 /* @ECU_Address@ATQR_SportTqRrIncGain_Y_pct@ */ NO_INPUT_QUANTITY Lookup2D_X_FLOAT32_IEEE 0 SWC_FDC_type_CM_single_pct 17 -125.0 125.0 /end AXIS_PTS
/begin AXIS_PTS ATQR_SportTqRrIncGain_X_Nm "" 0x0000 /* @ECU_Address@ATQR_SportTqRrIncGain_X_Nm@ */ VTQR_REDUWhlTqReqSmoothDelay_Nm Lookup2D_X_FLOAT32_IEEE 0 SWC_FDC_type_CM_single_Nm 24 -100000.0 100000.0 /end AXIS_PTS
/begin CHARACTERISTIC MTQR_TCSREDUTqDecSR_Z_Nm "" MAP 0x0000 /* @ECU_Address@MTQR_TCSREDUTqDecSR_Z_Nm@ */ Lookup2D_FLOAT32_IEEE 0 SWC_FDC_type_CM_single_Nm -100000.0 0.0
 /begin AXIS_DESCR COM_AXIS NO_INPUT_QUANTITY SWC_FDC_type_CM_single_rpm 24 -100000.0 100000.0 AXIS_PTS_REF ATQR_NL1FEDUTqIncSR_X_rpm /end AXIS_DESCR
 /begin AXIS_DESCR COM_AXIS VTQR_REDUWhlTqReqSmoothDelay_Nm SWC_FDC_type_CM_single_Nm 18 -10000.0 10000.0 AXIS_PTS_REF ATQR_NL1REDUTqDecSR_Y_Nm /end AXIS_DESCR
/end CHARACTERISTIC
/begin CHARACTERISTIC MTQR_TCSREDUTqIncSR_Z_Nm "" MAP 0x0000 /* @ECU_Address@MTQR_TCSREDUTqIncSR_Z_Nm@ */ Lookup2D_FLOAT32_IEEE 0 SWC_FDC_type_CM_single_Nm 0.0 100000.0
 /begin AXIS_DESCR COM_AXIS NO_INPUT_QUANTITY SWC_FDC_type_CM_single_rpm 24 -100000.0 100000.0 AXIS_PTS_REF ATQR_NL1FEDUTqIncSR_X_rpm /end AXIS_DESCR
 /begin AXIS_DESCR COM_AXIS NO_INPUT_QUANTITY SWC_FDC_type_CM_single_Nm 17 0.0 120.0 AXIS_PTS_REF ATQR_NL1FEDUTqIncSR_Y_pct /end AXIS_DESCR
/end CHARACTERISTIC
/begin CHARACTERISTIC MTQD_RL1TqMapDComp_Z_Nm "" MAP 0x0000 /* @ECU_Address@MTQD_RL1TqMapDComp_Z_Nm@ */ Lookup2D_FLOAT32_IEEE 0 SWC_FDC_type_CM_single_Nm -100000.0 100000.0
 /begin AXIS_DESCR COM_AXIS VTQD_TqTargetShaftSpd_rpm SWC_FDC_type_CM_single_rpm 11 -100000.0 100000.0 AXIS_PTS_REF ATQD_RL1TqMapDComp_X_rpm /end AXIS_DESCR
 /begin AXIS_DESCR COM_AXIS NO_INPUT_QUANTITY SWC_FDC_type_CM_single_Deg 9 -180.0 180.0 AXIS_PTS_REF ATQD_RL1TqMapDComp_Y_Deg /end AXIS_DESCR
/end CHARACTERISTIC
/begin AXIS_PTS ATQD_RL1TqMapDComp_Y_Deg "" 0x0000 /* @ECU_Address@ATQD_RL1TqMapDComp_Y_Deg@ */ NO_INPUT_QUANTITY Lookup2D_X_FLOAT32_IEEE 0 SWC_FDC_type_CM_single_Deg 9 -180.0 180.0 /end AXIS_PTS
/begin AXIS_PTS ATQD_RL1TqMapDComp_X_rpm "" 0x0000 /* @ECU_Address@ATQD_RL1TqMapDComp_X_rpm@ */ VTQD_TqTargetShaftSpd_rpm Lookup2D_X_FLOAT32_IEEE 0 SWC_FDC_type_CM_single_rpm 11 -100000.0 100000.0 /end AXIS_PTS
/begin CHARACTERISTIC MTQD_RL2TqMapDComp_Z_Nm "" MAP 0x0000 /* @ECU_Address@MTQD_RL2TqMapDComp_Z_Nm@ */ Lookup2D_FLOAT32_IEEE 0 SWC_FDC_type_CM_single_Nm -100000.0 100000.0
 /begin AXIS_DESCR COM_AXIS VTQD_TqTargetShaftSpd_rpm SWC_FDC_type_CM_single_rpm 11 -100000.0 100000.0 AXIS_PTS_REF ATQD_RL1TqMapDComp_X_rpm /end AXIS_DESCR
 /begin AXIS_DESCR COM_AXIS NO_INPUT_QUANTITY SWC_FDC_type_CM_single_Deg 9 -180.0 180.0 AXIS_PTS_REF ATQD_RL1TqMapDComp_Y_Deg /end AXIS_DESCR
/end CHARACTERISTIC
/begin CHARACTERISTIC MTQD_RL3TqMapDComp_Z_Nm "" MAP 0x0000 /* @ECU_Address@MTQD_RL3TqMapDComp_Z_Nm@ */ Lookup2D_FLOAT32_IEEE 0 SWC_FDC_type_CM_single_Nm -100000.0 100000.0
 /begin AXIS_DESCR COM_AXIS VTQD_TqTargetShaftSpd_rpm SWC_FDC_type_CM_single_rpm 11 -100000.0 100000.0 AXIS_PTS_REF ATQD_RL1TqMapDComp_X_rpm /end AXIS_DESCR
 /begin AXIS_DESCR COM_AXIS NO_INPUT_QUANTITY SWC_FDC_type_CM_single_Deg 9 -180.0 180.0 AXIS_PTS_REF ATQD_RL1TqMapDComp_Y_Deg /end AXIS_DESCR
/end CHARACTERISTIC
/begin CHARACTERISTIC MTQD_RL4TqMapDComp_Z_Nm "" MAP 0x0000 /* @ECU_Address@MTQD_RL4TqMapDComp_Z_Nm@ */ Lookup2D_FLOAT32_IEEE 0 SWC_FDC_type_CM_single_Nm -100000.0 100000.0
 /begin AXIS_DESCR COM_AXIS VTQD_TqTargetShaftSpd_rpm SWC_FDC_type_CM_single_rpm 11 -100000.0 100000.0 AXIS_PTS_REF ATQD_RL1TqMapDComp_X_rpm /end AXIS_DESCR
 /begin AXIS_DESCR COM_AXIS NO_INPUT_QUANTITY SWC_FDC_type_CM_single_Deg 9 -180.0 180.0 AXIS_PTS_REF ATQD_RL1TqMapDComp_Y_Deg /end AXIS_DESCR
/end CHARACTERISTIC
/begin CHARACTERISTIC MTQD_RL5TqMapDComp_Z_Nm "" MAP 0x0000 /* @ECU_Address@MTQD_RL5TqMapDComp_Z_Nm@ */ Lookup2D_FLOAT32_IEEE 0 SWC_FDC_type_CM_single_Nm -100000.0 100000.0
 /begin AXIS_DESCR COM_AXIS VTQD_TqTargetShaftSpd_rpm SWC_FDC_type_CM_single_rpm 11 -100000.0 100000.0 AXIS_PTS_REF ATQD_RL1TqMapDComp_X_rpm /end AXIS_DESCR
 /begin AXIS_DESCR COM_AXIS NO_INPUT_QUANTITY SWC_FDC_type_CM_single_Deg 9 -180.0 180.0 AXIS_PTS_REF ATQD_RL1TqMapDComp_Y_Deg /end AXIS_DESCR
/end CHARACTERISTIC
/begin CHARACTERISTIC MTQD_NRMTqMapR_Z_Nm "" MAP 0x0000 /* @ECU_Address@MTQD_NRMTqMapR_Z_Nm@ */ Lookup2D_FLOAT32_IEEE 0 SWC_FDC_type_CM_single_Nm -100000.0 100000.0
 /begin AXIS_DESCR COM_AXIS VTQD_TqTargetShaftSpd_rpm SWC_FDC_type_CM_single_rpm 42 -100000.0 100000.0 AXIS_PTS_REF ATQD_NL1TqMapD_X_rpm /end AXIS_DESCR
 /begin AXIS_DESCR COM_AXIS VTQD_ActAPSPosn_pct SWC_FDC_type_CM_single_pct 35 0.0 110.0 AXIS_PTS_REF ATQD_NL1TqMapD_Y_pct /end AXIS_DESCR
/end CHARACTERISTIC
/begin CHARACTERISTIC MTQR_EL1FEDUTs_Z_c "" MAP 0x0000 /* @ECU_Address@MTQR_EL1FEDUTs_Z_c@ */ Lookup2D_FLOAT32_IEEE 0 SWC_FDC_type_CM_single_c 0.0 1.0
 /begin AXIS_DESCR COM_AXIS NO_INPUT_QUANTITY SWC_FDC_type_CM_single_rpm 24 -100000.0 100000.0 AXIS_PTS_REF ATQR_EL1FEDUTs_X_rpm /end AXIS_DESCR
 /begin AXIS_DESCR COM_AXIS VTQR_FEDUWhlTqReqSmoothDelay_Nm SWC_FDC_type_CM_single_Nm 18 -10000.0 10000.0 AXIS_PTS_REF ATQR_EL1FEDUTs_Y_Nm /end AXIS_DESCR
/end CHARACTERISTIC
/begin AXIS_PTS ATQR_EL1FEDUTs_Y_Nm "" 0x0000 /* @ECU_Address@ATQR_EL1FEDUTs_Y_Nm@ */ VTQR_FEDUWhlTqReqSmoothDelay_Nm Lookup2D_X_FLOAT32_IEEE 0 SWC_FDC_type_CM_single_Nm 18 -10000.0 10000.0 /end AXIS_PTS
/begin AXIS_PTS ATQR_EL1FEDUTs_X_rpm "" 0x0000 /* @ECU_Address@ATQR_EL1FEDUTs_X_rpm@ */ NO_INPUT_QUANTITY Lookup2D_X_FLOAT32_IEEE 0 SWC_FDC_type_CM_single_rpm 24 -100000.0 100000.0 /end AXIS_PTS
/begin CHARACTERISTIC MTQR_FEDUEL1RegenTs_Y_c "" CURVE 0x0000 /* @ECU_Address@MTQR_FEDUEL1RegenTs_Y_c@ */ Lookup1D_FLOAT32_IEEE 0 SWC_FDC_type_CM_single_c 0.0 1.0
 /begin AXIS_DESCR COM_AXIS NO_INPUT_QUANTITY SWC_FDC_type_CM_single_rpm 24 -100000.0 100000.0 AXIS_PTS_REF ATQR_FEDUEL1RegenTs_X_rpm /end AXIS_DESCR
/end CHARACTERISTIC
/begin AXIS_PTS ATQR_FEDUEL1RegenTs_X_rpm "" 0x0000 /* @ECU_Address@ATQR_FEDUEL1RegenTs_X_rpm@ */ NO_INPUT_QUANTITY Lookup1D_X_FLOAT32_IEEE 0 SWC_FDC_type_CM_single_rpm 24 -100000.0 100000.0 /end AXIS_PTS
/begin CHARACTERISTIC MTQR_EL2FEDUTs_Z_c "" MAP 0x0000 /* @ECU_Address@MTQR_EL2FEDUTs_Z_c@ */ Lookup2D_FLOAT32_IEEE 0 SWC_FDC_type_CM_single_c 0.0 1.0
 /begin AXIS_DESCR COM_AXIS NO_INPUT_QUANTITY SWC_FDC_type_CM_single_rpm 24 -100000.0 100000.0 AXIS_PTS_REF ATQR_EL1FEDUTs_X_rpm /end AXIS_DESCR
 /begin AXIS_DESCR COM_AXIS VTQR_FEDUWhlTqReqSmoothDelay_Nm SWC_FDC_type_CM_single_Nm 18 -10000.0 10000.0 AXIS_PTS_REF ATQR_EL1FEDUTs_Y_Nm /end AXIS_DESCR
/end CHARACTERISTIC
/begin CHARACTERISTIC MTQR_EL3FEDUTs_Z_c "" MAP 0x0000 /* @ECU_Address@MTQR_EL3FEDUTs_Z_c@ */ Lookup2D_FLOAT32_IEEE 0 SWC_FDC_type_CM_single_c 0.0 1.0
 /begin AXIS_DESCR COM_AXIS NO_INPUT_QUANTITY SWC_FDC_type_CM_single_rpm 24 -100000.0 100000.0 AXIS_PTS_REF ATQR_EL1FEDUTs_X_rpm /end AXIS_DESCR
 /begin AXIS_DESCR COM_AXIS VTQR_FEDUWhlTqReqSmoothDelay_Nm SWC_FDC_type_CM_single_Nm 18 -10000.0 10000.0 AXIS_PTS_REF ATQR_EL1FEDUTs_Y_Nm /end AXIS_DESCR
/end CHARACTERISTIC
/begin CHARACTERISTIC MTQR_EL4FEDUTs_Z_c "" MAP 0x0000 /* @ECU_Address@MTQR_EL4FEDUTs_Z_c@ */ Lookup2D_FLOAT32_IEEE 0 SWC_FDC_type_CM_single_c 0.0 1.0
 /begin AXIS_DESCR COM_AXIS NO_INPUT_QUANTITY SWC_FDC_type_CM_single_rpm 24 -100000.0 100000.0 AXIS_PTS_REF ATQR_EL1FEDUTs_X_rpm /end AXIS_DESCR
 /begin AXIS_DESCR COM_AXIS VTQR_FEDUWhlTqReqSmoothDelay_Nm SWC_FDC_type_CM_single_Nm 18 -10000.0 10000.0 AXIS_PTS_REF ATQR_EL1FEDUTs_Y_Nm /end AXIS_DESCR
/end CHARACTERISTIC
/begin CHARACTERISTIC MTQR_EL5FEDUTs_Z_c "" MAP 0x0000 /* @ECU_Address@MTQR_EL5FEDUTs_Z_c@ */ Lookup2D_FLOAT32_IEEE 0 SWC_FDC_type_CM_single_c 0.0 1.0
 /begin AXIS_DESCR COM_AXIS NO_INPUT_QUANTITY SWC_FDC_type_CM_single_rpm 24 -100000.0 100000.0 AXIS_PTS_REF ATQR_EL1FEDUTs_X_rpm /end AXIS_DESCR
 /begin AXIS_DESCR COM_AXIS VTQR_FEDUWhlTqReqSmoothDelay_Nm SWC_FDC_type_CM_single_Nm 18 -10000.0 10000.0 AXIS_PTS_REF ATQR_EL1FEDUTs_Y_Nm /end AXIS_DESCR
/end CHARACTERISTIC
/begin CHARACTERISTIC MTQR_EOPDFEDUTs_Z_c "" MAP 0x0000 /* @ECU_Address@MTQR_EOPDFEDUTs_Z_c@ */ Lookup2D_FLOAT32_IEEE 0 SWC_FDC_type_CM_single_c 0.0 1.0
 /begin AXIS_DESCR COM_AXIS NO_INPUT_QUANTITY SWC_FDC_type_CM_single_rpm 24 -100000.0 100000.0 AXIS_PTS_REF ATQR_EL1FEDUTs_X_rpm /end AXIS_DESCR
 /begin AXIS_DESCR COM_AXIS VTQR_FEDUWhlTqReqSmoothDelay_Nm SWC_FDC_type_CM_single_Nm 18 -10000.0 10000.0 AXIS_PTS_REF ATQR_EL1FEDUTs_Y_Nm /end AXIS_DESCR
/end CHARACTERISTIC
/begin CHARACTERISTIC MTQR_NL1FEDUTs_Z_c "" MAP 0x0000 /* @ECU_Address@MTQR_NL1FEDUTs_Z_c@ */ Lookup2D_FLOAT32_IEEE 0 SWC_FDC_type_CM_single_c 0.0 1.0
 /begin AXIS_DESCR COM_AXIS NO_INPUT_QUANTITY SWC_FDC_type_CM_single_rpm 24 -100000.0 100000.0 AXIS_PTS_REF ATQR_NL1FEDUTs_X_rpm /end AXIS_DESCR
 /begin AXIS_DESCR COM_AXIS VTQR_FEDUWhlTqReqSmoothDelay_Nm SWC_FDC_type_CM_single_Nm 18 -10000.0 10000.0 AXIS_PTS_REF ATQR_NL1FEDUTs_Y_Nm /end AXIS_DESCR
/end CHARACTERISTIC
/begin CHARACTERISTIC MTQR_NL2FEDUTs_Z_c "" MAP 0x0000 /* @ECU_Address@MTQR_NL2FEDUTs_Z_c@ */ Lookup2D_FLOAT32_IEEE 0 SWC_FDC_type_CM_single_c 0.0 1.0
 /begin AXIS_DESCR COM_AXIS NO_INPUT_QUANTITY SWC_FDC_type_CM_single_rpm 24 -100000.0 100000.0 AXIS_PTS_REF ATQR_NL1FEDUTs_X_rpm /end AXIS_DESCR
 /begin AXIS_DESCR COM_AXIS VTQR_FEDUWhlTqReqSmoothDelay_Nm SWC_FDC_type_CM_single_Nm 18 -10000.0 10000.0 AXIS_PTS_REF ATQR_NL1FEDUTs_Y_Nm /end AXIS_DESCR
/end CHARACTERISTIC
/begin CHARACTERISTIC MTQR_NL3FEDUTs_Z_c "" MAP 0x0000 /* @ECU_Address@MTQR_NL3FEDUTs_Z_c@ */ Lookup2D_FLOAT32_IEEE 0 SWC_FDC_type_CM_single_c 0.0 1.0
 /begin AXIS_DESCR COM_AXIS NO_INPUT_QUANTITY SWC_FDC_type_CM_single_rpm 24 -100000.0 100000.0 AXIS_PTS_REF ATQR_NL1FEDUTs_X_rpm /end AXIS_DESCR
 /begin AXIS_DESCR COM_AXIS VTQR_FEDUWhlTqReqSmoothDelay_Nm SWC_FDC_type_CM_single_Nm 18 -10000.0 10000.0 AXIS_PTS_REF ATQR_NL1FEDUTs_Y_Nm /end AXIS_DESCR
/end CHARACTERISTIC
/begin CHARACTERISTIC MTQR_NL4FEDUTs_Z_c "" MAP 0x0000 /* @ECU_Address@MTQR_NL4FEDUTs_Z_c@ */ Lookup2D_FLOAT32_IEEE 0 SWC_FDC_type_CM_single_c 0.0 1.0
 /begin AXIS_DESCR COM_AXIS NO_INPUT_QUANTITY SWC_FDC_type_CM_single_rpm 24 -100000.0 100000.0 AXIS_PTS_REF ATQR_NL1FEDUTs_X_rpm /end AXIS_DESCR
 /begin AXIS_DESCR COM_AXIS VTQR_FEDUWhlTqReqSmoothDelay_Nm SWC_FDC_type_CM_single_Nm 18 -10000.0 10000.0 AXIS_PTS_REF ATQR_NL1FEDUTs_Y_Nm /end AXIS_DESCR
/end CHARACTERISTIC
/begin CHARACTERISTIC MTQR_NL5FEDUTs_Z_c "" MAP 0x0000 /* @ECU_Address@MTQR_NL5FEDUTs_Z_c@ */ Lookup2D_FLOAT32_IEEE 0 SWC_FDC_type_CM_single_c 0.0 1.0
 /begin AXIS_DESCR COM_AXIS NO_INPUT_QUANTITY SWC_FDC_type_CM_single_rpm 24 -100000.0 100000.0 AXIS_PTS_REF ATQR_NL1FEDUTs_X_rpm /end AXIS_DESCR
 /begin AXIS_DESCR COM_AXIS VTQR_FEDUWhlTqReqSmoothDelay_Nm SWC_FDC_type_CM_single_Nm 18 -10000.0 10000.0 AXIS_PTS_REF ATQR_NL1FEDUTs_Y_Nm /end AXIS_DESCR
/end CHARACTERISTIC
/begin CHARACTERISTIC MTQR_NOPDFEDUTs_Z_c "" MAP 0x0000 /* @ECU_Address@MTQR_NOPDFEDUTs_Z_c@ */ Lookup2D_FLOAT32_IEEE 0 SWC_FDC_type_CM_single_c 0.0 1.0
 /begin AXIS_DESCR COM_AXIS NO_INPUT_QUANTITY SWC_FDC_type_CM_single_rpm 24 -100000.0 100000.0 AXIS_PTS_REF ATQR_NL1FEDUTs_X_rpm /end AXIS_DESCR
 /begin AXIS_DESCR COM_AXIS VTQR_FEDUWhlTqReqSmoothDelay_Nm SWC_FDC_type_CM_single_Nm 18 -10000.0 10000.0 AXIS_PTS_REF ATQR_NL1FEDUTs_Y_Nm /end AXIS_DESCR
/end CHARACTERISTIC
/begin CHARACTERISTIC MTQR_SL1FEDUTs_Z_c "" MAP 0x0000 /* @ECU_Address@MTQR_SL1FEDUTs_Z_c@ */ Lookup2D_FLOAT32_IEEE 0 SWC_FDC_type_CM_single_c 0.0 1.0
 /begin AXIS_DESCR COM_AXIS NO_INPUT_QUANTITY SWC_FDC_type_CM_single_rpm 24 -100000.0 100000.0 AXIS_PTS_REF ATQR_SL1FEDUTs_X_rpm /end AXIS_DESCR
 /begin AXIS_DESCR COM_AXIS VTQR_FEDUWhlTqReqSmoothDelay_Nm SWC_FDC_type_CM_single_Nm 18 -10000.0 10000.0 AXIS_PTS_REF ATQR_SL1FEDUTs_Y_Nm /end AXIS_DESCR
/end CHARACTERISTIC
/begin AXIS_PTS ATQR_SL1FEDUTs_Y_Nm "" 0x0000 /* @ECU_Address@ATQR_SL1FEDUTs_Y_Nm@ */ VTQR_FEDUWhlTqReqSmoothDelay_Nm Lookup2D_X_FLOAT32_IEEE 0 SWC_FDC_type_CM_single_Nm 18 -10000.0 10000.0 /end AXIS_PTS
/begin AXIS_PTS ATQR_SL1FEDUTs_X_rpm "" 0x0000 /* @ECU_Address@ATQR_SL1FEDUTs_X_rpm@ */ NO_INPUT_QUANTITY Lookup2D_X_FLOAT32_IEEE 0 SWC_FDC_type_CM_single_rpm 24 -100000.0 100000.0 /end AXIS_PTS
/begin CHARACTERISTIC MTQR_SL2FEDUTs_Z_c "" MAP 0x0000 /* @ECU_Address@MTQR_SL2FEDUTs_Z_c@ */ Lookup2D_FLOAT32_IEEE 0 SWC_FDC_type_CM_single_c 0.0 1.0
 /begin AXIS_DESCR COM_AXIS NO_INPUT_QUANTITY SWC_FDC_type_CM_single_rpm 24 -100000.0 100000.0 AXIS_PTS_REF ATQR_SL1FEDUTs_X_rpm /end AXIS_DESCR
 /begin AXIS_DESCR COM_AXIS VTQR_FEDUWhlTqReqSmoothDelay_Nm SWC_FDC_type_CM_single_Nm 18 -10000.0 10000.0 AXIS_PTS_REF ATQR_SL1FEDUTs_Y_Nm /end AXIS_DESCR
/end CHARACTERISTIC
/begin CHARACTERISTIC MTQR_SL3FEDUTs_Z_c "" MAP 0x0000 /* @ECU_Address@MTQR_SL3FEDUTs_Z_c@ */ Lookup2D_FLOAT32_IEEE 0 SWC_FDC_type_CM_single_c 0.0 1.0
 /begin AXIS_DESCR COM_AXIS NO_INPUT_QUANTITY SWC_FDC_type_CM_single_rpm 24 -100000.0 100000.0 AXIS_PTS_REF ATQR_SL1FEDUTs_X_rpm /end AXIS_DESCR
 /begin AXIS_DESCR COM_AXIS VTQR_FEDUWhlTqReqSmoothDelay_Nm SWC_FDC_type_CM_single_Nm 18 -10000.0 10000.0 AXIS_PTS_REF ATQR_SL1FEDUTs_Y_Nm /end AXIS_DESCR
/end CHARACTERISTIC
/begin CHARACTERISTIC MTQR_SL4FEDUTs_Z_c "" MAP 0x0000 /* @ECU_Address@MTQR_SL4FEDUTs_Z_c@ */ Lookup2D_FLOAT32_IEEE 0 SWC_FDC_type_CM_single_c 0.0 1.0
 /begin AXIS_DESCR COM_AXIS NO_INPUT_QUANTITY SWC_FDC_type_CM_single_rpm 24 -100000.0 100000.0 AXIS_PTS_REF ATQR_SL1FEDUTs_X_rpm /end AXIS_DESCR
 /begin AXIS_DESCR COM_AXIS VTQR_FEDUWhlTqReqSmoothDelay_Nm SWC_FDC_type_CM_single_Nm 18 -10000.0 10000.0 AXIS_PTS_REF ATQR_SL1FEDUTs_Y_Nm /end AXIS_DESCR
/end CHARACTERISTIC
/begin CHARACTERISTIC MTQR_SL5FEDUTs_Z_c "" MAP 0x0000 /* @ECU_Address@MTQR_SL5FEDUTs_Z_c@ */ Lookup2D_FLOAT32_IEEE 0 SWC_FDC_type_CM_single_c 0.0 1.0
 /begin AXIS_DESCR COM_AXIS NO_INPUT_QUANTITY SWC_FDC_type_CM_single_rpm 24 -100000.0 100000.0 AXIS_PTS_REF ATQR_SL1FEDUTs_X_rpm /end AXIS_DESCR
 /begin AXIS_DESCR COM_AXIS VTQR_FEDUWhlTqReqSmoothDelay_Nm SWC_FDC_type_CM_single_Nm 18 -10000.0 10000.0 AXIS_PTS_REF ATQR_SL1FEDUTs_Y_Nm /end AXIS_DESCR
/end CHARACTERISTIC
/begin CHARACTERISTIC MTQR_SOPDFEDUTs_Z_c "" MAP 0x0000 /* @ECU_Address@MTQR_SOPDFEDUTs_Z_c@ */ Lookup2D_FLOAT32_IEEE 0 SWC_FDC_type_CM_single_c 0.0 1.0
 /begin AXIS_DESCR COM_AXIS NO_INPUT_QUANTITY SWC_FDC_type_CM_single_rpm 24 -100000.0 100000.0 AXIS_PTS_REF ATQR_SL1FEDUTs_X_rpm /end AXIS_DESCR
 /begin AXIS_DESCR COM_AXIS VTQR_FEDUWhlTqReqSmoothDelay_Nm SWC_FDC_type_CM_single_Nm 18 -10000.0 10000.0 AXIS_PTS_REF ATQR_SL1FEDUTs_Y_Nm /end AXIS_DESCR
/end CHARACTERISTIC
/begin CHARACTERISTIC MTQR_FrNegRateLimitDecE_Z_Nm "" MAP 0x0000 /* @ECU_Address@MTQR_FrNegRateLimitDecE_Z_Nm@ */ Lookup2D_FLOAT32_IEEE 0 SWC_FDC_type_CM_single_Nm -10000.0 0.0
 /begin AXIS_DESCR COM_AXIS NO_INPUT_QUANTITY SWC_FDC_type_CM_single_Nm 16 -10000.0 10000.0 AXIS_PTS_REF ATQR_FrNegRateLimitIncN_X_rpm /end AXIS_DESCR
 /begin AXIS_DESCR COM_AXIS VTQR_FEDUWhlTqReqSmoothDelay_Nm SWC_FDC_type_CM_single_Nm 8 -10000.0 10000.0 AXIS_PTS_REF ATQR_FrNegRateLimitIncN_Y_Nm /end AXIS_DESCR
/end CHARACTERISTIC
/begin AXIS_PTS ATQR_FrNegRateLimitIncN_Y_Nm "" 0x0000 /* @ECU_Address@ATQR_FrNegRateLimitIncN_Y_Nm@ */ VTQR_FEDUWhlTqReqSmoothDelay_Nm Lookup2D_X_FLOAT32_IEEE 0 SWC_FDC_type_CM_single_Nm 8 -10000.0 10000.0 /end AXIS_PTS
/begin AXIS_PTS ATQR_FrNegRateLimitIncN_X_rpm "" 0x0000 /* @ECU_Address@ATQR_FrNegRateLimitIncN_X_rpm@ */ NO_INPUT_QUANTITY Lookup2D_X_FLOAT32_IEEE 0 SWC_FDC_type_CM_single_Nm 16 -10000.0 10000.0 /end AXIS_PTS
/begin CHARACTERISTIC MTQR_FrNegRateLimitDecN_Z_Nm "" MAP 0x0000 /* @ECU_Address@MTQR_FrNegRateLimitDecN_Z_Nm@ */ Lookup2D_FLOAT32_IEEE 0 SWC_FDC_type_CM_single_Nm -10000.0 0.0
 /begin AXIS_DESCR COM_AXIS NO_INPUT_QUANTITY SWC_FDC_type_CM_single_Nm 16 -10000.0 10000.0 AXIS_PTS_REF ATQR_FrNegRateLimitIncN_X_rpm /end AXIS_DESCR
 /begin AXIS_DESCR COM_AXIS VTQR_FEDUWhlTqReqSmoothDelay_Nm SWC_FDC_type_CM_single_Nm 8 -10000.0 10000.0 AXIS_PTS_REF ATQR_FrNegRateLimitIncN_Y_Nm /end AXIS_DESCR
/end CHARACTERISTIC
/begin CHARACTERISTIC MTQR_FrNegRateLimitDecS_Z_Nm "" MAP 0x0000 /* @ECU_Address@MTQR_FrNegRateLimitDecS_Z_Nm@ */ Lookup2D_FLOAT32_IEEE 0 SWC_FDC_type_CM_single_Nm -10000.0 0.0
 /begin AXIS_DESCR COM_AXIS NO_INPUT_QUANTITY SWC_FDC_type_CM_single_Nm 16 -10000.0 10000.0 AXIS_PTS_REF ATQR_FrNegRateLimitIncN_X_rpm /end AXIS_DESCR
 /begin AXIS_DESCR COM_AXIS VTQR_FEDUWhlTqReqSmoothDelay_Nm SWC_FDC_type_CM_single_Nm 8 -10000.0 10000.0 AXIS_PTS_REF ATQR_FrNegRateLimitIncN_Y_Nm /end AXIS_DESCR
/end CHARACTERISTIC
/begin CHARACTERISTIC MTQR_FrNegRateLimitIncE_Z_Nm "" MAP 0x0000 /* @ECU_Address@MTQR_FrNegRateLimitIncE_Z_Nm@ */ Lookup2D_FLOAT32_IEEE 0 SWC_FDC_type_CM_single_Nm 0.0 10000.0
 /begin AXIS_DESCR COM_AXIS NO_INPUT_QUANTITY SWC_FDC_type_CM_single_Nm 16 -10000.0 10000.0 AXIS_PTS_REF ATQR_FrNegRateLimitIncN_X_rpm /end AXIS_DESCR
 /begin AXIS_DESCR COM_AXIS VTQR_FEDUWhlTqReqSmoothDelay_Nm SWC_FDC_type_CM_single_Nm 8 -10000.0 10000.0 AXIS_PTS_REF ATQR_FrNegRateLimitIncN_Y_Nm /end AXIS_DESCR
/end CHARACTERISTIC
/begin CHARACTERISTIC MTQR_FrNegRateLimitIncN_Z_Nm "" MAP 0x0000 /* @ECU_Address@MTQR_FrNegRateLimitIncN_Z_Nm@ */ Lookup2D_FLOAT32_IEEE 0 SWC_FDC_type_CM_single_Nm 0.0 10000.0
 /begin AXIS_DESCR COM_AXIS NO_INPUT_QUANTITY SWC_FDC_type_CM_single_Nm 16 -10000.0 10000.0 AXIS_PTS_REF ATQR_FrNegRateLimitIncN_X_rpm /end AXIS_DESCR
 /begin AXIS_DESCR COM_AXIS VTQR_FEDUWhlTqReqSmoothDelay_Nm SWC_FDC_type_CM_single_Nm 8 -10000.0 10000.0 AXIS_PTS_REF ATQR_FrNegRateLimitIncN_Y_Nm /end AXIS_DESCR
/end CHARACTERISTIC
/begin CHARACTERISTIC MTQR_FrNegRateLimitIncS_Z_Nm "" MAP 0x0000 /* @ECU_Address@MTQR_FrNegRateLimitIncS_Z_Nm@ */ Lookup2D_FLOAT32_IEEE 0 SWC_FDC_type_CM_single_Nm 0.0 10000.0
 /begin AXIS_DESCR COM_AXIS NO_INPUT_QUANTITY SWC_FDC_type_CM_single_Nm 16 -10000.0 10000.0 AXIS_PTS_REF ATQR_FrNegRateLimitIncN_X_rpm /end AXIS_DESCR
 /begin AXIS_DESCR COM_AXIS VTQR_FEDUWhlTqReqSmoothDelay_Nm SWC_FDC_type_CM_single_Nm 8 -10000.0 10000.0 AXIS_PTS_REF ATQR_FrNegRateLimitIncN_Y_Nm /end AXIS_DESCR
/end CHARACTERISTIC
/begin CHARACTERISTIC MTQR_FrPosRateLimitDecE_Z_Nm "" MAP 0x0000 /* @ECU_Address@MTQR_FrPosRateLimitDecE_Z_Nm@ */ Lookup2D_FLOAT32_IEEE 0 SWC_FDC_type_CM_single_Nm -10000.0 0.0
 /begin AXIS_DESCR COM_AXIS NO_INPUT_QUANTITY SWC_FDC_type_CM_single_rpm 16 -100000.0 100000.0 AXIS_PTS_REF ATQR_FrPosRateLimitIncN_X_rpm /end AXIS_DESCR
 /begin AXIS_DESCR COM_AXIS VTQR_FEDUWhlTqReqSmoothDelay_Nm SWC_FDC_type_CM_single_Nm 8 -10000.0 10000.0 AXIS_PTS_REF ATQR_FrPosRateLimitIncN_Y_Nm /end AXIS_DESCR
/end CHARACTERISTIC
/begin AXIS_PTS ATQR_FrPosRateLimitIncN_Y_Nm "" 0x0000 /* @ECU_Address@ATQR_FrPosRateLimitIncN_Y_Nm@ */ VTQR_FEDUWhlTqReqSmoothDelay_Nm Lookup2D_X_FLOAT32_IEEE 0 SWC_FDC_type_CM_single_Nm 8 -10000.0 10000.0 /end AXIS_PTS
/begin AXIS_PTS ATQR_FrPosRateLimitIncN_X_rpm "" 0x0000 /* @ECU_Address@ATQR_FrPosRateLimitIncN_X_rpm@ */ NO_INPUT_QUANTITY Lookup2D_X_FLOAT32_IEEE 0 SWC_FDC_type_CM_single_rpm 16 -100000.0 100000.0 /end AXIS_PTS
/begin CHARACTERISTIC MTQR_FrPosRateLimitDecN_Z_Nm "" MAP 0x0000 /* @ECU_Address@MTQR_FrPosRateLimitDecN_Z_Nm@ */ Lookup2D_FLOAT32_IEEE 0 SWC_FDC_type_CM_single_Nm -10000.0 0.0
 /begin AXIS_DESCR COM_AXIS NO_INPUT_QUANTITY SWC_FDC_type_CM_single_rpm 16 -100000.0 100000.0 AXIS_PTS_REF ATQR_FrPosRateLimitIncN_X_rpm /end AXIS_DESCR
 /begin AXIS_DESCR COM_AXIS VTQR_FEDUWhlTqReqSmoothDelay_Nm SWC_FDC_type_CM_single_Nm 8 -10000.0 10000.0 AXIS_PTS_REF ATQR_FrPosRateLimitIncN_Y_Nm /end AXIS_DESCR
/end CHARACTERISTIC
/begin CHARACTERISTIC MTQR_FrPosRateLimitDecS_Z_Nm "" MAP 0x0000 /* @ECU_Address@MTQR_FrPosRateLimitDecS_Z_Nm@ */ Lookup2D_FLOAT32_IEEE 0 SWC_FDC_type_CM_single_Nm -10000.0 0.0
 /begin AXIS_DESCR COM_AXIS NO_INPUT_QUANTITY SWC_FDC_type_CM_single_rpm 16 -100000.0 100000.0 AXIS_PTS_REF ATQR_FrPosRateLimitIncN_X_rpm /end AXIS_DESCR
 /begin AXIS_DESCR COM_AXIS VTQR_FEDUWhlTqReqSmoothDelay_Nm SWC_FDC_type_CM_single_Nm 8 -10000.0 10000.0 AXIS_PTS_REF ATQR_FrPosRateLimitIncN_Y_Nm /end AXIS_DESCR
/end CHARACTERISTIC
/begin CHARACTERISTIC MTQR_FrPosRateLimitIncE_Z_Nm "" MAP 0x0000 /* @ECU_Address@MTQR_FrPosRateLimitIncE_Z_Nm@ */ Lookup2D_FLOAT32_IEEE 0 SWC_FDC_type_CM_single_Nm 0.0 10000.0
 /begin AXIS_DESCR COM_AXIS NO_INPUT_QUANTITY SWC_FDC_type_CM_single_rpm 16 -100000.0 100000.0 AXIS_PTS_REF ATQR_FrPosRateLimitIncN_X_rpm /end AXIS_DESCR
 /begin AXIS_DESCR COM_AXIS VTQR_FEDUWhlTqReqSmoothDelay_Nm SWC_FDC_type_CM_single_Nm 8 -10000.0 10000.0 AXIS_PTS_REF ATQR_FrPosRateLimitIncN_Y_Nm /end AXIS_DESCR
/end CHARACTERISTIC
/begin CHARACTERISTIC MTQR_FrPosRateLimitIncN_Z_Nm "" MAP 0x0000 /* @ECU_Address@MTQR_FrPosRateLimitIncN_Z_Nm@ */ Lookup2D_FLOAT32_IEEE 0 SWC_FDC_type_CM_single_Nm 0.0 10000.0
 /begin AXIS_DESCR COM_AXIS NO_INPUT_QUANTITY SWC_FDC_type_CM_single_rpm 16 -100000.0 100000.0 AXIS_PTS_REF ATQR_FrPosRateLimitIncN_X_rpm /end AXIS_DESCR
 /begin AXIS_DESCR COM_AXIS VTQR_FEDUWhlTqReqSmoothDelay_Nm SWC_FDC_type_CM_single_Nm 8 -10000.0 10000.0 AXIS_PTS_REF ATQR_FrPosRateLimitIncN_Y_Nm /end AXIS_DESCR
/end CHARACTERISTIC
/begin CHARACTERISTIC MTQR_FrPosRateLimitIncS_Z_Nm "" MAP 0x0000 /* @ECU_Address@MTQR_FrPosRateLimitIncS_Z_Nm@ */ Lookup2D_FLOAT32_IEEE 0 SWC_FDC_type_CM_single_Nm 0.0 10000.0
 /begin AXIS_DESCR COM_AXIS NO_INPUT_QUANTITY SWC_FDC_type_CM_single_rpm 16 -100000.0 100000.0 AXIS_PTS_REF ATQR_FrPosRateLimitIncN_X_rpm /end AXIS_DESCR
 /begin AXIS_DESCR COM_AXIS VTQR_FEDUWhlTqReqSmoothDelay_Nm SWC_FDC_type_CM_single_Nm 8 -10000.0 10000.0 AXIS_PTS_REF ATQR_FrPosRateLimitIncN_Y_Nm /end AXIS_DESCR
/end CHARACTERISTIC
/begin CHARACTERISTIC MTQR_EL1FEDUTqDecSR_Z_Nm "" MAP 0x0000 /* @ECU_Address@MTQR_EL1FEDUTqDecSR_Z_Nm@ */ Lookup2D_FLOAT32_IEEE 0 SWC_FDC_type_CM_single_Nm -100000.0 0.0
 /begin AXIS_DESCR COM_AXIS NO_INPUT_QUANTITY SWC_FDC_type_CM_single_rpm 24 -100000.0 100000.0 AXIS_PTS_REF ATQR_EL1FEDUTqIncSR_X_rpm /end AXIS_DESCR
 /begin AXIS_DESCR COM_AXIS VTQR_FEDUWhlTqReqSmoothDelay_Nm SWC_FDC_type_CM_single_Nm 18 -10000.0 10000.0 AXIS_PTS_REF ATQR_EL1FEDUTqDecSR_Y_Nm /end AXIS_DESCR
/end CHARACTERISTIC
/begin AXIS_PTS ATQR_EL1FEDUTqDecSR_Y_Nm "" 0x0000 /* @ECU_Address@ATQR_EL1FEDUTqDecSR_Y_Nm@ */ VTQR_FEDUWhlTqReqSmoothDelay_Nm Lookup2D_X_FLOAT32_IEEE 0 SWC_FDC_type_CM_single_Nm 18 -10000.0 10000.0 /end AXIS_PTS
/begin AXIS_PTS ATQR_EL1FEDUTqIncSR_X_rpm "" 0x0000 /* @ECU_Address@ATQR_EL1FEDUTqIncSR_X_rpm@ */ NO_INPUT_QUANTITY Lookup2D_X_FLOAT32_IEEE 0 SWC_FDC_type_CM_single_rpm 24 -100000.0 100000.0 /end AXIS_PTS
/begin CHARACTERISTIC MTQR_EL2FEDUTqDecSR_Z_Nm "" MAP 0x0000 /* @ECU_Address@MTQR_EL2FEDUTqDecSR_Z_Nm@ */ Lookup2D_FLOAT32_IEEE 0 SWC_FDC_type_CM_single_Nm -100000.0 0.0
 /begin AXIS_DESCR COM_AXIS NO_INPUT_QUANTITY SWC_FDC_type_CM_single_rpm 24 -100000.0 100000.0 AXIS_PTS_REF ATQR_EL1FEDUTqIncSR_X_rpm /end AXIS_DESCR
 /begin AXIS_DESCR COM_AXIS VTQR_FEDUWhlTqReqSmoothDelay_Nm SWC_FDC_type_CM_single_Nm 18 -10000.0 10000.0 AXIS_PTS_REF ATQR_EL1FEDUTqDecSR_Y_Nm /end AXIS_DESCR
/end CHARACTERISTIC
/begin CHARACTERISTIC MTQR_EL3FEDUTqDecSR_Z_Nm "" MAP 0x0000 /* @ECU_Address@MTQR_EL3FEDUTqDecSR_Z_Nm@ */ Lookup2D_FLOAT32_IEEE 0 SWC_FDC_type_CM_single_Nm -100000.0 0.0
 /begin AXIS_DESCR COM_AXIS NO_INPUT_QUANTITY SWC_FDC_type_CM_single_rpm 24 -100000.0 100000.0 AXIS_PTS_REF ATQR_EL1FEDUTqIncSR_X_rpm /end AXIS_DESCR
 /begin AXIS_DESCR COM_AXIS VTQR_FEDUWhlTqReqSmoothDelay_Nm SWC_FDC_type_CM_single_Nm 18 -10000.0 10000.0 AXIS_PTS_REF ATQR_EL1FEDUTqDecSR_Y_Nm /end AXIS_DESCR
/end CHARACTERISTIC
/begin CHARACTERISTIC MTQR_EL4FEDUTqDecSR_Z_Nm "" MAP 0x0000 /* @ECU_Address@MTQR_EL4FEDUTqDecSR_Z_Nm@ */ Lookup2D_FLOAT32_IEEE 0 SWC_FDC_type_CM_single_Nm -100000.0 0.0
 /begin AXIS_DESCR COM_AXIS NO_INPUT_QUANTITY SWC_FDC_type_CM_single_rpm 24 -100000.0 100000.0 AXIS_PTS_REF ATQR_EL1FEDUTqIncSR_X_rpm /end AXIS_DESCR
 /begin AXIS_DESCR COM_AXIS VTQR_FEDUWhlTqReqSmoothDelay_Nm SWC_FDC_type_CM_single_Nm 18 -10000.0 10000.0 AXIS_PTS_REF ATQR_EL1FEDUTqDecSR_Y_Nm /end AXIS_DESCR
/end CHARACTERISTIC
/begin CHARACTERISTIC MTQR_EL5FEDUTqDecSR_Z_Nm "" MAP 0x0000 /* @ECU_Address@MTQR_EL5FEDUTqDecSR_Z_Nm@ */ Lookup2D_FLOAT32_IEEE 0 SWC_FDC_type_CM_single_Nm -100000.0 0.0
 /begin AXIS_DESCR COM_AXIS NO_INPUT_QUANTITY SWC_FDC_type_CM_single_rpm 24 -100000.0 100000.0 AXIS_PTS_REF ATQR_EL1FEDUTqIncSR_X_rpm /end AXIS_DESCR
 /begin AXIS_DESCR COM_AXIS VTQR_FEDUWhlTqReqSmoothDelay_Nm SWC_FDC_type_CM_single_Nm 18 -10000.0 10000.0 AXIS_PTS_REF ATQR_EL1FEDUTqDecSR_Y_Nm /end AXIS_DESCR
/end CHARACTERISTIC
/begin CHARACTERISTIC MTQR_EOPDFEDUTqDecSR_Z_Nm "" MAP 0x0000 /* @ECU_Address@MTQR_EOPDFEDUTqDecSR_Z_Nm@ */ Lookup2D_FLOAT32_IEEE 0 SWC_FDC_type_CM_single_Nm -100000.0 0.0
 /begin AXIS_DESCR COM_AXIS NO_INPUT_QUANTITY SWC_FDC_type_CM_single_rpm 24 -100000.0 100000.0 AXIS_PTS_REF ATQR_EL1FEDUTqIncSR_X_rpm /end AXIS_DESCR
 /begin AXIS_DESCR COM_AXIS VTQR_FEDUWhlTqReqSmoothDelay_Nm SWC_FDC_type_CM_single_Nm 18 -10000.0 10000.0 AXIS_PTS_REF ATQR_EL1FEDUTqDecSR_Y_Nm /end AXIS_DESCR
/end CHARACTERISTIC
/begin CHARACTERISTIC MTQR_EL1FEDUTqIncSR_Z_Nm "" MAP 0x0000 /* @ECU_Address@MTQR_EL1FEDUTqIncSR_Z_Nm@ */ Lookup2D_FLOAT32_IEEE 0 SWC_FDC_type_CM_single_Nm 0.0 100000.0
 /begin AXIS_DESCR COM_AXIS NO_INPUT_QUANTITY SWC_FDC_type_CM_single_rpm 24 -100000.0 100000.0 AXIS_PTS_REF ATQR_EL1FEDUTqIncSR_X_rpm /end AXIS_DESCR
 /begin AXIS_DESCR COM_AXIS NO_INPUT_QUANTITY SWC_FDC_type_CM_single_Nm 17 0.0 120.0 AXIS_PTS_REF ATQR_EL1FEDUTqIncSR_Y_pct /end AXIS_DESCR
/end CHARACTERISTIC
/begin AXIS_PTS ATQR_EL1FEDUTqIncSR_Y_pct "" 0x0000 /* @ECU_Address@ATQR_EL1FEDUTqIncSR_Y_pct@ */ NO_INPUT_QUANTITY Lookup2D_X_FLOAT32_IEEE 0 SWC_FDC_type_CM_single_Nm 17 0.0 120.0 /end AXIS_PTS
/begin CHARACTERISTIC MTQR_EL2FEDUTqIncSR_Z_Nm "" MAP 0x0000 /* @ECU_Address@MTQR_EL2FEDUTqIncSR_Z_Nm@ */ Lookup2D_FLOAT32_IEEE 0 SWC_FDC_type_CM_single_Nm 0.0 100000.0
 /begin AXIS_DESCR COM_AXIS NO_INPUT_QUANTITY SWC_FDC_type_CM_single_rpm 24 -100000.0 100000.0 AXIS_PTS_REF ATQR_EL1FEDUTqIncSR_X_rpm /end AXIS_DESCR
 /begin AXIS_DESCR COM_AXIS NO_INPUT_QUANTITY SWC_FDC_type_CM_single_Nm 17 0.0 120.0 AXIS_PTS_REF ATQR_EL1FEDUTqIncSR_Y_pct /end AXIS_DESCR
/end CHARACTERISTIC
/begin CHARACTERISTIC MTQR_EL3FEDUTqIncSR_Z_Nm "" MAP 0x0000 /* @ECU_Address@MTQR_EL3FEDUTqIncSR_Z_Nm@ */ Lookup2D_FLOAT32_IEEE 0 SWC_FDC_type_CM_single_Nm 0.0 100000.0
 /begin AXIS_DESCR COM_AXIS NO_INPUT_QUANTITY SWC_FDC_type_CM_single_rpm 24 -100000.0 100000.0 AXIS_PTS_REF ATQR_EL1FEDUTqIncSR_X_rpm /end AXIS_DESCR
 /begin AXIS_DESCR COM_AXIS NO_INPUT_QUANTITY SWC_FDC_type_CM_single_Nm 17 0.0 120.0 AXIS_PTS_REF ATQR_EL1FEDUTqIncSR_Y_pct /end AXIS_DESCR
/end CHARACTERISTIC
/begin CHARACTERISTIC MTQR_EL4FEDUTqIncSR_Z_Nm "" MAP 0x0000 /* @ECU_Address@MTQR_EL4FEDUTqIncSR_Z_Nm@ */ Lookup2D_FLOAT32_IEEE 0 SWC_FDC_type_CM_single_Nm 0.0 100000.0
 /begin AXIS_DESCR COM_AXIS NO_INPUT_QUANTITY SWC_FDC_type_CM_single_rpm 24 -100000.0 100000.0 AXIS_PTS_REF ATQR_EL1FEDUTqIncSR_X_rpm /end AXIS_DESCR
 /begin AXIS_DESCR COM_AXIS NO_INPUT_QUANTITY SWC_FDC_type_CM_single_Nm 17 0.0 120.0 AXIS_PTS_REF ATQR_EL1FEDUTqIncSR_Y_pct /end AXIS_DESCR
/end CHARACTERISTIC
/begin CHARACTERISTIC MTQR_EL5FEDUTqIncSR_Z_Nm "" MAP 0x0000 /* @ECU_Address@MTQR_EL5FEDUTqIncSR_Z_Nm@ */ Lookup2D_FLOAT32_IEEE 0 SWC_FDC_type_CM_single_Nm 0.0 100000.0
 /begin AXIS_DESCR COM_AXIS NO_INPUT_QUANTITY SWC_FDC_type_CM_single_rpm 24 -100000.0 100000.0 AXIS_PTS_REF ATQR_EL1FEDUTqIncSR_X_rpm /end AXIS_DESCR
 /begin AXIS_DESCR COM_AXIS NO_INPUT_QUANTITY SWC_FDC_type_CM_single_Nm 17 0.0 120.0 AXIS_PTS_REF ATQR_EL1FEDUTqIncSR_Y_pct /end AXIS_DESCR
/end CHARACTERISTIC
/begin CHARACTERISTIC MTQR_EOPDFEDUTqIncSR_Z_Nm "" MAP 0x0000 /* @ECU_Address@MTQR_EOPDFEDUTqIncSR_Z_Nm@ */ Lookup2D_FLOAT32_IEEE 0 SWC_FDC_type_CM_single_Nm 0.0 100000.0
 /begin AXIS_DESCR COM_AXIS NO_INPUT_QUANTITY SWC_FDC_type_CM_single_rpm 24 -100000.0 100000.0 AXIS_PTS_REF ATQR_EL1FEDUTqIncSR_X_rpm /end AXIS_DESCR
 /begin AXIS_DESCR COM_AXIS NO_INPUT_QUANTITY SWC_FDC_type_CM_single_Nm 17 0.0 120.0 AXIS_PTS_REF ATQR_EL1FEDUTqIncSR_Y_pct /end AXIS_DESCR
/end CHARACTERISTIC
/begin CHARACTERISTIC MTQR_NL1FEDUTqDecSR_Z_Nm "" MAP 0x0000 /* @ECU_Address@MTQR_NL1FEDUTqDecSR_Z_Nm@ */ Lookup2D_FLOAT32_IEEE 0 SWC_FDC_type_CM_single_Nm -100000.0 0.0
 /begin AXIS_DESCR COM_AXIS NO_INPUT_QUANTITY SWC_FDC_type_CM_single_rpm 24 -100000.0 100000.0 AXIS_PTS_REF ATQR_NL1FEDUTqIncSR_X_rpm /end AXIS_DESCR
 /begin AXIS_DESCR COM_AXIS VTQR_FEDUWhlTqReqSmoothDelay_Nm SWC_FDC_type_CM_single_Nm 18 -10000.0 10000.0 AXIS_PTS_REF ATQR_NL1FEDUTqDecSR_Y_Nm /end AXIS_DESCR
/end CHARACTERISTIC
/begin CHARACTERISTIC MTQR_NL2FEDUTqDecSR_Z_Nm "" MAP 0x0000 /* @ECU_Address@MTQR_NL2FEDUTqDecSR_Z_Nm@ */ Lookup2D_FLOAT32_IEEE 0 SWC_FDC_type_CM_single_Nm -100000.0 0.0
 /begin AXIS_DESCR COM_AXIS NO_INPUT_QUANTITY SWC_FDC_type_CM_single_rpm 24 -100000.0 100000.0 AXIS_PTS_REF ATQR_NL1FEDUTqIncSR_X_rpm /end AXIS_DESCR
 /begin AXIS_DESCR COM_AXIS VTQR_FEDUWhlTqReqSmoothDelay_Nm SWC_FDC_type_CM_single_Nm 18 -10000.0 10000.0 AXIS_PTS_REF ATQR_NL1FEDUTqDecSR_Y_Nm /end AXIS_DESCR
/end CHARACTERISTIC
/begin CHARACTERISTIC MTQR_NL3FEDUTqDecSR_Z_Nm "" MAP 0x0000 /* @ECU_Address@MTQR_NL3FEDUTqDecSR_Z_Nm@ */ Lookup2D_FLOAT32_IEEE 0 SWC_FDC_type_CM_single_Nm -100000.0 0.0
 /begin AXIS_DESCR COM_AXIS NO_INPUT_QUANTITY SWC_FDC_type_CM_single_rpm 24 -100000.0 100000.0 AXIS_PTS_REF ATQR_NL1FEDUTqIncSR_X_rpm /end AXIS_DESCR
 /begin AXIS_DESCR COM_AXIS VTQR_FEDUWhlTqReqSmoothDelay_Nm SWC_FDC_type_CM_single_Nm 18 -10000.0 10000.0 AXIS_PTS_REF ATQR_NL1FEDUTqDecSR_Y_Nm /end AXIS_DESCR
/end CHARACTERISTIC
/begin CHARACTERISTIC MTQR_NL4FEDUTqDecSR_Z_Nm "" MAP 0x0000 /* @ECU_Address@MTQR_NL4FEDUTqDecSR_Z_Nm@ */ Lookup2D_FLOAT32_IEEE 0 SWC_FDC_type_CM_single_Nm -100000.0 0.0
 /begin AXIS_DESCR COM_AXIS NO_INPUT_QUANTITY SWC_FDC_type_CM_single_rpm 24 -100000.0 100000.0 AXIS_PTS_REF ATQR_NL1FEDUTqIncSR_X_rpm /end AXIS_DESCR
 /begin AXIS_DESCR COM_AXIS VTQR_FEDUWhlTqReqSmoothDelay_Nm SWC_FDC_type_CM_single_Nm 18 -10000.0 10000.0 AXIS_PTS_REF ATQR_NL1FEDUTqDecSR_Y_Nm /end AXIS_DESCR
/end CHARACTERISTIC
/begin CHARACTERISTIC MTQR_NL5FEDUTqDecSR_Z_Nm "" MAP 0x0000 /* @ECU_Address@MTQR_NL5FEDUTqDecSR_Z_Nm@ */ Lookup2D_FLOAT32_IEEE 0 SWC_FDC_type_CM_single_Nm -100000.0 0.0
 /begin AXIS_DESCR COM_AXIS NO_INPUT_QUANTITY SWC_FDC_type_CM_single_rpm 24 -100000.0 100000.0 AXIS_PTS_REF ATQR_NL1FEDUTqIncSR_X_rpm /end AXIS_DESCR
 /begin AXIS_DESCR COM_AXIS VTQR_FEDUWhlTqReqSmoothDelay_Nm SWC_FDC_type_CM_single_Nm 18 -10000.0 10000.0 AXIS_PTS_REF ATQR_NL1FEDUTqDecSR_Y_Nm /end AXIS_DESCR
/end CHARACTERISTIC
/begin CHARACTERISTIC MTQR_NOPDFEDUTqDecSR_Z_Nm "" MAP 0x0000 /* @ECU_Address@MTQR_NOPDFEDUTqDecSR_Z_Nm@ */ Lookup2D_FLOAT32_IEEE 0 SWC_FDC_type_CM_single_Nm -100000.0 0.0
 /begin AXIS_DESCR COM_AXIS NO_INPUT_QUANTITY SWC_FDC_type_CM_single_rpm 24 -100000.0 100000.0 AXIS_PTS_REF ATQR_NL1FEDUTqIncSR_X_rpm /end AXIS_DESCR
 /begin AXIS_DESCR COM_AXIS VTQR_FEDUWhlTqReqSmoothDelay_Nm SWC_FDC_type_CM_single_Nm 18 -10000.0 10000.0 AXIS_PTS_REF ATQR_NL1FEDUTqDecSR_Y_Nm /end AXIS_DESCR
/end CHARACTERISTIC
/begin CHARACTERISTIC MTQR_NL1FEDUTqIncSR_Z_Nm "" MAP 0x0000 /* @ECU_Address@MTQR_NL1FEDUTqIncSR_Z_Nm@ */ Lookup2D_FLOAT32_IEEE 0 SWC_FDC_type_CM_single_Nm 0.0 100000.0
 /begin AXIS_DESCR COM_AXIS NO_INPUT_QUANTITY SWC_FDC_type_CM_single_rpm 24 -100000.0 100000.0 AXIS_PTS_REF ATQR_NL1FEDUTqIncSR_X_rpm /end AXIS_DESCR
 /begin AXIS_DESCR COM_AXIS NO_INPUT_QUANTITY SWC_FDC_type_CM_single_Nm 17 0.0 120.0 AXIS_PTS_REF ATQR_NL1FEDUTqIncSR_Y_pct /end AXIS_DESCR
/end CHARACTERISTIC
/begin CHARACTERISTIC MTQR_NL2FEDUTqIncSR_Z_Nm "" MAP 0x0000 /* @ECU_Address@MTQR_NL2FEDUTqIncSR_Z_Nm@ */ Lookup2D_FLOAT32_IEEE 0 SWC_FDC_type_CM_single_Nm 0.0 100000.0
 /begin AXIS_DESCR COM_AXIS NO_INPUT_QUANTITY SWC_FDC_type_CM_single_rpm 24 -100000.0 100000.0 AXIS_PTS_REF ATQR_NL1FEDUTqIncSR_X_rpm /end AXIS_DESCR
 /begin AXIS_DESCR COM_AXIS NO_INPUT_QUANTITY SWC_FDC_type_CM_single_Nm 17 0.0 120.0 AXIS_PTS_REF ATQR_NL1FEDUTqIncSR_Y_pct /end AXIS_DESCR
/end CHARACTERISTIC
/begin CHARACTERISTIC MTQR_NL3FEDUTqIncSR_Z_Nm "" MAP 0x0000 /* @ECU_Address@MTQR_NL3FEDUTqIncSR_Z_Nm@ */ Lookup2D_FLOAT32_IEEE 0 SWC_FDC_type_CM_single_Nm 0.0 100000.0
 /begin AXIS_DESCR COM_AXIS NO_INPUT_QUANTITY SWC_FDC_type_CM_single_rpm 24 -100000.0 100000.0 AXIS_PTS_REF ATQR_NL1FEDUTqIncSR_X_rpm /end AXIS_DESCR
 /begin AXIS_DESCR COM_AXIS NO_INPUT_QUANTITY SWC_FDC_type_CM_single_Nm 17 0.0 120.0 AXIS_PTS_REF ATQR_NL1FEDUTqIncSR_Y_pct /end AXIS_DESCR
/end CHARACTERISTIC
/begin CHARACTERISTIC MTQR_NL4FEDUTqIncSR_Z_Nm "" MAP 0x0000 /* @ECU_Address@MTQR_NL4FEDUTqIncSR_Z_Nm@ */ Lookup2D_FLOAT32_IEEE 0 SWC_FDC_type_CM_single_Nm 0.0 100000.0
 /begin AXIS_DESCR COM_AXIS NO_INPUT_QUANTITY SWC_FDC_type_CM_single_rpm 24 -100000.0 100000.0 AXIS_PTS_REF ATQR_NL1FEDUTqIncSR_X_rpm /end AXIS_DESCR
 /begin AXIS_DESCR COM_AXIS NO_INPUT_QUANTITY SWC_FDC_type_CM_single_Nm 17 0.0 120.0 AXIS_PTS_REF ATQR_NL1FEDUTqIncSR_Y_pct /end AXIS_DESCR
/end CHARACTERISTIC
/begin CHARACTERISTIC MTQR_NL5FEDUTqIncSR_Z_Nm "" MAP 0x0000 /* @ECU_Address@MTQR_NL5FEDUTqIncSR_Z_Nm@ */ Lookup2D_FLOAT32_IEEE 0 SWC_FDC_type_CM_single_Nm 0.0 100000.0
 /begin AXIS_DESCR COM_AXIS NO_INPUT_QUANTITY SWC_FDC_type_CM_single_rpm 24 -100000.0 100000.0 AXIS_PTS_REF ATQR_NL1FEDUTqIncSR_X_rpm /end AXIS_DESCR
 /begin AXIS_DESCR COM_AXIS NO_INPUT_QUANTITY SWC_FDC_type_CM_single_Nm 17 0.0 120.0 AXIS_PTS_REF ATQR_NL1FEDUTqIncSR_Y_pct /end AXIS_DESCR
/end CHARACTERISTIC
/begin CHARACTERISTIC MTQR_NOPDFEDUTqIncSR_Z_Nm "" MAP 0x0000 /* @ECU_Address@MTQR_NOPDFEDUTqIncSR_Z_Nm@ */ Lookup2D_FLOAT32_IEEE 0 SWC_FDC_type_CM_single_Nm 0.0 100000.0
 /begin AXIS_DESCR COM_AXIS NO_INPUT_QUANTITY SWC_FDC_type_CM_single_rpm 24 -100000.0 100000.0 AXIS_PTS_REF ATQR_NL1FEDUTqIncSR_X_rpm /end AXIS_DESCR
 /begin AXIS_DESCR COM_AXIS NO_INPUT_QUANTITY SWC_FDC_type_CM_single_Nm 17 0.0 120.0 AXIS_PTS_REF ATQR_NL1FEDUTqIncSR_Y_pct /end AXIS_DESCR
/end CHARACTERISTIC
/begin CHARACTERISTIC MTQR_SL1FEDUTqDecSR_Z_Nm "" MAP 0x0000 /* @ECU_Address@MTQR_SL1FEDUTqDecSR_Z_Nm@ */ Lookup2D_FLOAT32_IEEE 0 SWC_FDC_type_CM_single_Nm -100000.0 0.0
 /begin AXIS_DESCR COM_AXIS NO_INPUT_QUANTITY SWC_FDC_type_CM_single_rpm 24 -100000.0 100000.0 AXIS_PTS_REF ATQR_SL1FEDUTqIncSR_X_rpm /end AXIS_DESCR
 /begin AXIS_DESCR COM_AXIS VTQR_FEDUWhlTqReqSmoothDelay_Nm SWC_FDC_type_CM_single_Nm 18 -10000.0 10000.0 AXIS_PTS_REF ATQR_SL1FEDUTqDecSR_Y_Nm /end AXIS_DESCR
/end CHARACTERISTIC
/begin AXIS_PTS ATQR_SL1FEDUTqDecSR_Y_Nm "" 0x0000 /* @ECU_Address@ATQR_SL1FEDUTqDecSR_Y_Nm@ */ VTQR_FEDUWhlTqReqSmoothDelay_Nm Lookup2D_X_FLOAT32_IEEE 0 SWC_FDC_type_CM_single_Nm 18 -10000.0 10000.0 /end AXIS_PTS
/begin AXIS_PTS ATQR_SL1FEDUTqIncSR_X_rpm "" 0x0000 /* @ECU_Address@ATQR_SL1FEDUTqIncSR_X_rpm@ */ NO_INPUT_QUANTITY Lookup2D_X_FLOAT32_IEEE 0 SWC_FDC_type_CM_single_rpm 24 -100000.0 100000.0 /end AXIS_PTS
/begin CHARACTERISTIC MTQR_SL2FEDUTqDecSR_Z_Nm "" MAP 0x0000 /* @ECU_Address@MTQR_SL2FEDUTqDecSR_Z_Nm@ */ Lookup2D_FLOAT32_IEEE 0 SWC_FDC_type_CM_single_Nm -100000.0 0.0
 /begin AXIS_DESCR COM_AXIS NO_INPUT_QUANTITY SWC_FDC_type_CM_single_rpm 24 -100000.0 100000.0 AXIS_PTS_REF ATQR_SL1FEDUTqIncSR_X_rpm /end AXIS_DESCR
 /begin AXIS_DESCR COM_AXIS VTQR_FEDUWhlTqReqSmoothDelay_Nm SWC_FDC_type_CM_single_Nm 18 -10000.0 10000.0 AXIS_PTS_REF ATQR_SL1FEDUTqDecSR_Y_Nm /end AXIS_DESCR
/end CHARACTERISTIC
/begin CHARACTERISTIC MTQR_SL3FEDUTqDecSR_Z_Nm "" MAP 0x0000 /* @ECU_Address@MTQR_SL3FEDUTqDecSR_Z_Nm@ */ Lookup2D_FLOAT32_IEEE 0 SWC_FDC_type_CM_single_Nm -100000.0 0.0
 /begin AXIS_DESCR COM_AXIS NO_INPUT_QUANTITY SWC_FDC_type_CM_single_rpm 24 -100000.0 100000.0 AXIS_PTS_REF ATQR_SL1FEDUTqIncSR_X_rpm /end AXIS_DESCR
 /begin AXIS_DESCR COM_AXIS VTQR_FEDUWhlTqReqSmoothDelay_Nm SWC_FDC_type_CM_single_Nm 18 -10000.0 10000.0 AXIS_PTS_REF ATQR_SL1FEDUTqDecSR_Y_Nm /end AXIS_DESCR
/end CHARACTERISTIC
/begin CHARACTERISTIC MTQR_SL4FEDUTqDecSR_Z_Nm "" MAP 0x0000 /* @ECU_Address@MTQR_SL4FEDUTqDecSR_Z_Nm@ */ Lookup2D_FLOAT32_IEEE 0 SWC_FDC_type_CM_single_Nm -100000.0 0.0
 /begin AXIS_DESCR COM_AXIS NO_INPUT_QUANTITY SWC_FDC_type_CM_single_rpm 24 -100000.0 100000.0 AXIS_PTS_REF ATQR_SL1FEDUTqIncSR_X_rpm /end AXIS_DESCR
 /begin AXIS_DESCR COM_AXIS VTQR_FEDUWhlTqReqSmoothDelay_Nm SWC_FDC_type_CM_single_Nm 18 -10000.0 10000.0 AXIS_PTS_REF ATQR_SL1FEDUTqDecSR_Y_Nm /end AXIS_DESCR
/end CHARACTERISTIC
/begin CHARACTERISTIC MTQR_SL5FEDUTqDecSR_Z_Nm "" MAP 0x0000 /* @ECU_Address@MTQR_SL5FEDUTqDecSR_Z_Nm@ */ Lookup2D_FLOAT32_IEEE 0 SWC_FDC_type_CM_single_Nm -100000.0 0.0
 /begin AXIS_DESCR COM_AXIS NO_INPUT_QUANTITY SWC_FDC_type_CM_single_rpm 24 -100000.0 100000.0 AXIS_PTS_REF ATQR_SL1FEDUTqIncSR_X_rpm /end AXIS_DESCR
 /begin AXIS_DESCR COM_AXIS VTQR_FEDUWhlTqReqSmoothDelay_Nm SWC_FDC_type_CM_single_Nm 18 -10000.0 10000.0 AXIS_PTS_REF ATQR_SL1FEDUTqDecSR_Y_Nm /end AXIS_DESCR
/end CHARACTERISTIC
/begin CHARACTERISTIC MTQR_SOPDFEDUTqDecSR_Z_Nm "" MAP 0x0000 /* @ECU_Address@MTQR_SOPDFEDUTqDecSR_Z_Nm@ */ Lookup2D_FLOAT32_IEEE 0 SWC_FDC_type_CM_single_Nm -100000.0 0.0
 /begin AXIS_DESCR COM_AXIS NO_INPUT_QUANTITY SWC_FDC_type_CM_single_rpm 24 -100000.0 100000.0 AXIS_PTS_REF ATQR_SL1FEDUTqIncSR_X_rpm /end AXIS_DESCR
 /begin AXIS_DESCR COM_AXIS VTQR_FEDUWhlTqReqSmoothDelay_Nm SWC_FDC_type_CM_single_Nm 18 -10000.0 10000.0 AXIS_PTS_REF ATQR_SL1FEDUTqDecSR_Y_Nm /end AXIS_DESCR
/end CHARACTERISTIC
/begin CHARACTERISTIC MTQR_SL1FEDUTqIncSR_Z_Nm "" MAP 0x0000 /* @ECU_Address@MTQR_SL1FEDUTqIncSR_Z_Nm@ */ Lookup2D_FLOAT32_IEEE 0 SWC_FDC_type_CM_single_Nm 0.0 100000.0
 /begin AXIS_DESCR COM_AXIS NO_INPUT_QUANTITY SWC_FDC_type_CM_single_rpm 24 -100000.0 100000.0 AXIS_PTS_REF ATQR_SL1FEDUTqIncSR_X_rpm /end AXIS_DESCR
 /begin AXIS_DESCR COM_AXIS NO_INPUT_QUANTITY SWC_FDC_type_CM_single_Nm 17 0.0 120.0 AXIS_PTS_REF ATQR_SL1FEDUTqIncSR_Y_pct /end AXIS_DESCR
/end CHARACTERISTIC
/begin AXIS_PTS ATQR_SL1FEDUTqIncSR_Y_pct "" 0x0000 /* @ECU_Address@ATQR_SL1FEDUTqIncSR_Y_pct@ */ NO_INPUT_QUANTITY Lookup2D_X_FLOAT32_IEEE 0 SWC_FDC_type_CM_single_Nm 17 0.0 120.0 /end AXIS_PTS
/begin CHARACTERISTIC MTQR_SL2FEDUTqIncSR_Z_Nm "" MAP 0x0000 /* @ECU_Address@MTQR_SL2FEDUTqIncSR_Z_Nm@ */ Lookup2D_FLOAT32_IEEE 0 SWC_FDC_type_CM_single_Nm 0.0 100000.0
 /begin AXIS_DESCR COM_AXIS NO_INPUT_QUANTITY SWC_FDC_type_CM_single_rpm 24 -100000.0 100000.0 AXIS_PTS_REF ATQR_SL1FEDUTqIncSR_X_rpm /end AXIS_DESCR
 /begin AXIS_DESCR COM_AXIS NO_INPUT_QUANTITY SWC_FDC_type_CM_single_Nm 17 0.0 120.0 AXIS_PTS_REF ATQR_SL1FEDUTqIncSR_Y_pct /end AXIS_DESCR
/end CHARACTERISTIC
/begin CHARACTERISTIC MTQR_SL3FEDUTqIncSR_Z_Nm "" MAP 0x0000 /* @ECU_Address@MTQR_SL3FEDUTqIncSR_Z_Nm@ */ Lookup2D_FLOAT32_IEEE 0 SWC_FDC_type_CM_single_Nm 0.0 100000.0
 /begin AXIS_DESCR COM_AXIS NO_INPUT_QUANTITY SWC_FDC_type_CM_single_rpm 24 -100000.0 100000.0 AXIS_PTS_REF ATQR_SL1FEDUTqIncSR_X_rpm /end AXIS_DESCR
 /begin AXIS_DESCR COM_AXIS NO_INPUT_QUANTITY SWC_FDC_type_CM_single_Nm 17 0.0 120.0 AXIS_PTS_REF ATQR_SL1FEDUTqIncSR_Y_pct /end AXIS_DESCR
/end CHARACTERISTIC
/begin CHARACTERISTIC MTQR_SL4FEDUTqIncSR_Z_Nm "" MAP 0x0000 /* @ECU_Address@MTQR_SL4FEDUTqIncSR_Z_Nm@ */ Lookup2D_FLOAT32_IEEE 0 SWC_FDC_type_CM_single_Nm 0.0 100000.0
 /begin AXIS_DESCR COM_AXIS NO_INPUT_QUANTITY SWC_FDC_type_CM_single_rpm 24 -100000.0 100000.0 AXIS_PTS_REF ATQR_SL1FEDUTqIncSR_X_rpm /end AXIS_DESCR
 /begin AXIS_DESCR COM_AXIS NO_INPUT_QUANTITY SWC_FDC_type_CM_single_Nm 17 0.0 120.0 AXIS_PTS_REF ATQR_SL1FEDUTqIncSR_Y_pct /end AXIS_DESCR
/end CHARACTERISTIC
/begin CHARACTERISTIC MTQR_SL5FEDUTqIncSR_Z_Nm "" MAP 0x0000 /* @ECU_Address@MTQR_SL5FEDUTqIncSR_Z_Nm@ */ Lookup2D_FLOAT32_IEEE 0 SWC_FDC_type_CM_single_Nm 0.0 100000.0
 /begin AXIS_DESCR COM_AXIS NO_INPUT_QUANTITY SWC_FDC_type_CM_single_rpm 24 -100000.0 100000.0 AXIS_PTS_REF ATQR_SL1FEDUTqIncSR_X_rpm /end AXIS_DESCR
 /begin AXIS_DESCR COM_AXIS NO_INPUT_QUANTITY SWC_FDC_type_CM_single_Nm 17 0.0 120.0 AXIS_PTS_REF ATQR_SL1FEDUTqIncSR_Y_pct /end AXIS_DESCR
/end CHARACTERISTIC
/begin CHARACTERISTIC MTQR_SOPDFEDUTqIncSR_Z_Nm "" MAP 0x0000 /* @ECU_Address@MTQR_SOPDFEDUTqIncSR_Z_Nm@ */ Lookup2D_FLOAT32_IEEE 0 SWC_FDC_type_CM_single_Nm 0.0 100000.0
 /begin AXIS_DESCR COM_AXIS NO_INPUT_QUANTITY SWC_FDC_type_CM_single_rpm 24 -100000.0 100000.0 AXIS_PTS_REF ATQR_SL1FEDUTqIncSR_X_rpm /end AXIS_DESCR
 /begin AXIS_DESCR COM_AXIS NO_INPUT_QUANTITY SWC_FDC_type_CM_single_Nm 17 0.0 120.0 AXIS_PTS_REF ATQR_SL1FEDUTqIncSR_Y_pct /end AXIS_DESCR
/end CHARACTERISTIC
/begin CHARACTERISTIC MTQR_EL1REDUTs_Z_c "" MAP 0x0000 /* @ECU_Address@MTQR_EL1REDUTs_Z_c@ */ Lookup2D_FLOAT32_IEEE 0 SWC_FDC_type_CM_single_c 0.0 1.0
 /begin AXIS_DESCR COM_AXIS NO_INPUT_QUANTITY SWC_FDC_type_CM_single_rpm 24 -100000.0 100000.0 AXIS_PTS_REF ATQR_EL1FEDUTs_X_rpm /end AXIS_DESCR
 /begin AXIS_DESCR COM_AXIS VTQR_REDUWhlTqReqSmoothDelay_Nm SWC_FDC_type_CM_single_Nm 18 -10000.0 10000.0 AXIS_PTS_REF ATQR_EL1REDUTs_Y_Nm /end AXIS_DESCR
/end CHARACTERISTIC
/begin AXIS_PTS ATQR_EL1REDUTs_Y_Nm "" 0x0000 /* @ECU_Address@ATQR_EL1REDUTs_Y_Nm@ */ VTQR_REDUWhlTqReqSmoothDelay_Nm Lookup2D_X_FLOAT32_IEEE 0 SWC_FDC_type_CM_single_Nm 18 -10000.0 10000.0 /end AXIS_PTS
/begin CHARACTERISTIC MTQR_REDUEL1RegenTs_Y_c "" CURVE 0x0000 /* @ECU_Address@MTQR_REDUEL1RegenTs_Y_c@ */ Lookup1D_FLOAT32_IEEE 0 SWC_FDC_type_CM_single_c 0.0 1.0
 /begin AXIS_DESCR COM_AXIS NO_INPUT_QUANTITY SWC_FDC_type_CM_single_rpm 24 -100000.0 100000.0 AXIS_PTS_REF ATQR_FEDUEL1RegenTs_X_rpm /end AXIS_DESCR
/end CHARACTERISTIC
/begin CHARACTERISTIC MTQR_EL2REDUTs_Z_c "" MAP 0x0000 /* @ECU_Address@MTQR_EL2REDUTs_Z_c@ */ Lookup2D_FLOAT32_IEEE 0 SWC_FDC_type_CM_single_c 0.0 1.0
 /begin AXIS_DESCR COM_AXIS NO_INPUT_QUANTITY SWC_FDC_type_CM_single_rpm 24 -100000.0 100000.0 AXIS_PTS_REF ATQR_EL1FEDUTs_X_rpm /end AXIS_DESCR
 /begin AXIS_DESCR COM_AXIS VTQR_REDUWhlTqReqSmoothDelay_Nm SWC_FDC_type_CM_single_Nm 18 -10000.0 10000.0 AXIS_PTS_REF ATQR_EL1REDUTs_Y_Nm /end AXIS_DESCR
/end CHARACTERISTIC
/begin CHARACTERISTIC MTQR_EL3REDUTs_Z_c "" MAP 0x0000 /* @ECU_Address@MTQR_EL3REDUTs_Z_c@ */ Lookup2D_FLOAT32_IEEE 0 SWC_FDC_type_CM_single_c 0.0 1.0
 /begin AXIS_DESCR COM_AXIS NO_INPUT_QUANTITY SWC_FDC_type_CM_single_rpm 24 -100000.0 100000.0 AXIS_PTS_REF ATQR_EL1FEDUTs_X_rpm /end AXIS_DESCR
 /begin AXIS_DESCR COM_AXIS VTQR_REDUWhlTqReqSmoothDelay_Nm SWC_FDC_type_CM_single_Nm 18 -10000.0 10000.0 AXIS_PTS_REF ATQR_EL1REDUTs_Y_Nm /end AXIS_DESCR
/end CHARACTERISTIC
/begin CHARACTERISTIC MTQR_EL4REDUTs_Z_c "" MAP 0x0000 /* @ECU_Address@MTQR_EL4REDUTs_Z_c@ */ Lookup2D_FLOAT32_IEEE 0 SWC_FDC_type_CM_single_c 0.0 1.0
 /begin AXIS_DESCR COM_AXIS NO_INPUT_QUANTITY SWC_FDC_type_CM_single_rpm 24 -100000.0 100000.0 AXIS_PTS_REF ATQR_EL1FEDUTs_X_rpm /end AXIS_DESCR
 /begin AXIS_DESCR COM_AXIS VTQR_REDUWhlTqReqSmoothDelay_Nm SWC_FDC_type_CM_single_Nm 18 -10000.0 10000.0 AXIS_PTS_REF ATQR_EL1REDUTs_Y_Nm /end AXIS_DESCR
/end CHARACTERISTIC
/begin CHARACTERISTIC MTQR_EL5REDUTs_Z_c "" MAP 0x0000 /* @ECU_Address@MTQR_EL5REDUTs_Z_c@ */ Lookup2D_FLOAT32_IEEE 0 SWC_FDC_type_CM_single_c 0.0 1.0
 /begin AXIS_DESCR COM_AXIS NO_INPUT_QUANTITY SWC_FDC_type_CM_single_rpm 24 -100000.0 100000.0 AXIS_PTS_REF ATQR_EL1FEDUTs_X_rpm /end AXIS_DESCR
 /begin AXIS_DESCR COM_AXIS VTQR_REDUWhlTqReqSmoothDelay_Nm SWC_FDC_type_CM_single_Nm 18 -10000.0 10000.0 AXIS_PTS_REF ATQR_EL1REDUTs_Y_Nm /end AXIS_DESCR
/end CHARACTERISTIC
/begin CHARACTERISTIC MTQR_EOPDREDUTs_Z_c "" MAP 0x0000 /* @ECU_Address@MTQR_EOPDREDUTs_Z_c@ */ Lookup2D_FLOAT32_IEEE 0 SWC_FDC_type_CM_single_c 0.0 1.0
 /begin AXIS_DESCR COM_AXIS NO_INPUT_QUANTITY SWC_FDC_type_CM_single_rpm 24 -100000.0 100000.0 AXIS_PTS_REF ATQR_EL1FEDUTs_X_rpm /end AXIS_DESCR
 /begin AXIS_DESCR COM_AXIS VTQR_REDUWhlTqReqSmoothDelay_Nm SWC_FDC_type_CM_single_Nm 18 -10000.0 10000.0 AXIS_PTS_REF ATQR_EL1REDUTs_Y_Nm /end AXIS_DESCR
/end CHARACTERISTIC
/begin CHARACTERISTIC MTQR_NL1REDUTs_Z_c "" MAP 0x0000 /* @ECU_Address@MTQR_NL1REDUTs_Z_c@ */ Lookup2D_FLOAT32_IEEE 0 SWC_FDC_type_CM_single_c 0.0 1.0
 /begin AXIS_DESCR COM_AXIS NO_INPUT_QUANTITY SWC_FDC_type_CM_single_rpm 24 -100000.0 100000.0 AXIS_PTS_REF ATQR_NL1FEDUTs_X_rpm /end AXIS_DESCR
 /begin AXIS_DESCR COM_AXIS VTQR_REDUWhlTqReqSmoothDelay_Nm SWC_FDC_type_CM_single_Nm 18 -10000.0 10000.0 AXIS_PTS_REF ATQR_NL1REDUTs_Y_Nm /end AXIS_DESCR
/end CHARACTERISTIC
/begin CHARACTERISTIC MTQR_NL2REDUTs_Z_c "" MAP 0x0000 /* @ECU_Address@MTQR_NL2REDUTs_Z_c@ */ Lookup2D_FLOAT32_IEEE 0 SWC_FDC_type_CM_single_c 0.0 1.0
 /begin AXIS_DESCR COM_AXIS NO_INPUT_QUANTITY SWC_FDC_type_CM_single_rpm 24 -100000.0 100000.0 AXIS_PTS_REF ATQR_NL1FEDUTs_X_rpm /end AXIS_DESCR
 /begin AXIS_DESCR COM_AXIS VTQR_REDUWhlTqReqSmoothDelay_Nm SWC_FDC_type_CM_single_Nm 18 -10000.0 10000.0 AXIS_PTS_REF ATQR_NL1REDUTs_Y_Nm /end AXIS_DESCR
/end CHARACTERISTIC
/begin CHARACTERISTIC MTQR_NL3REDUTs_Z_c "" MAP 0x0000 /* @ECU_Address@MTQR_NL3REDUTs_Z_c@ */ Lookup2D_FLOAT32_IEEE 0 SWC_FDC_type_CM_single_c 0.0 1.0
 /begin AXIS_DESCR COM_AXIS NO_INPUT_QUANTITY SWC_FDC_type_CM_single_rpm 24 -100000.0 100000.0 AXIS_PTS_REF ATQR_NL1FEDUTs_X_rpm /end AXIS_DESCR
 /begin AXIS_DESCR COM_AXIS VTQR_REDUWhlTqReqSmoothDelay_Nm SWC_FDC_type_CM_single_Nm 18 -10000.0 10000.0 AXIS_PTS_REF ATQR_NL1REDUTs_Y_Nm /end AXIS_DESCR
/end CHARACTERISTIC
/begin CHARACTERISTIC MTQR_NL4REDUTs_Z_c "" MAP 0x0000 /* @ECU_Address@MTQR_NL4REDUTs_Z_c@ */ Lookup2D_FLOAT32_IEEE 0 SWC_FDC_type_CM_single_c 0.0 1.0
 /begin AXIS_DESCR COM_AXIS NO_INPUT_QUANTITY SWC_FDC_type_CM_single_rpm 24 -100000.0 100000.0 AXIS_PTS_REF ATQR_NL1FEDUTs_X_rpm /end AXIS_DESCR
 /begin AXIS_DESCR COM_AXIS VTQR_REDUWhlTqReqSmoothDelay_Nm SWC_FDC_type_CM_single_Nm 18 -10000.0 10000.0 AXIS_PTS_REF ATQR_NL1REDUTs_Y_Nm /end AXIS_DESCR
/end CHARACTERISTIC
/begin CHARACTERISTIC MTQR_NL5REDUTs_Z_c "" MAP 0x0000 /* @ECU_Address@MTQR_NL5REDUTs_Z_c@ */ Lookup2D_FLOAT32_IEEE 0 SWC_FDC_type_CM_single_c 0.0 1.0
 /begin AXIS_DESCR COM_AXIS NO_INPUT_QUANTITY SWC_FDC_type_CM_single_rpm 24 -100000.0 100000.0 AXIS_PTS_REF ATQR_NL1FEDUTs_X_rpm /end AXIS_DESCR
 /begin AXIS_DESCR COM_AXIS VTQR_REDUWhlTqReqSmoothDelay_Nm SWC_FDC_type_CM_single_Nm 18 -10000.0 10000.0 AXIS_PTS_REF ATQR_NL1REDUTs_Y_Nm /end AXIS_DESCR
/end CHARACTERISTIC
/begin CHARACTERISTIC MTQR_NOPDREDUTs_Z_c "" MAP 0x0000 /* @ECU_Address@MTQR_NOPDREDUTs_Z_c@ */ Lookup2D_FLOAT32_IEEE 0 SWC_FDC_type_CM_single_c 0.0 1.0
 /begin AXIS_DESCR COM_AXIS NO_INPUT_QUANTITY SWC_FDC_type_CM_single_rpm 24 -100000.0 100000.0 AXIS_PTS_REF ATQR_NL1FEDUTs_X_rpm /end AXIS_DESCR
 /begin AXIS_DESCR COM_AXIS VTQR_REDUWhlTqReqSmoothDelay_Nm SWC_FDC_type_CM_single_Nm 18 -10000.0 10000.0 AXIS_PTS_REF ATQR_NL1REDUTs_Y_Nm /end AXIS_DESCR
/end CHARACTERISTIC
/begin CHARACTERISTIC MTQR_SL1REDUTs_Z_c "" MAP 0x0000 /* @ECU_Address@MTQR_SL1REDUTs_Z_c@ */ Lookup2D_FLOAT32_IEEE 0 SWC_FDC_type_CM_single_c 0.0 1.0
 /begin AXIS_DESCR COM_AXIS NO_INPUT_QUANTITY SWC_FDC_type_CM_single_rpm 24 -100000.0 100000.0 AXIS_PTS_REF ATQR_SL1FEDUTs_X_rpm /end AXIS_DESCR
 /begin AXIS_DESCR COM_AXIS VTQR_REDUWhlTqReqSmoothDelay_Nm SWC_FDC_type_CM_single_Nm 18 -10000.0 10000.0 AXIS_PTS_REF ATQR_SL1REDUTs_Y_Nm /end AXIS_DESCR
/end CHARACTERISTIC
/begin AXIS_PTS ATQR_SL1REDUTs_Y_Nm "" 0x0000 /* @ECU_Address@ATQR_SL1REDUTs_Y_Nm@ */ VTQR_REDUWhlTqReqSmoothDelay_Nm Lookup2D_X_FLOAT32_IEEE 0 SWC_FDC_type_CM_single_Nm 18 -10000.0 10000.0 /end AXIS_PTS
/begin CHARACTERISTIC MTQR_SL2REDUTs_Z_c "" MAP 0x0000 /* @ECU_Address@MTQR_SL2REDUTs_Z_c@ */ Lookup2D_FLOAT32_IEEE 0 SWC_FDC_type_CM_single_c 0.0 1.0
 /begin AXIS_DESCR COM_AXIS NO_INPUT_QUANTITY SWC_FDC_type_CM_single_rpm 24 -100000.0 100000.0 AXIS_PTS_REF ATQR_SL1FEDUTs_X_rpm /end AXIS_DESCR
 /begin AXIS_DESCR COM_AXIS VTQR_REDUWhlTqReqSmoothDelay_Nm SWC_FDC_type_CM_single_Nm 18 -10000.0 10000.0 AXIS_PTS_REF ATQR_SL1REDUTs_Y_Nm /end AXIS_DESCR
/end CHARACTERISTIC
/begin CHARACTERISTIC MTQR_SL3REDUTs_Z_c "" MAP 0x0000 /* @ECU_Address@MTQR_SL3REDUTs_Z_c@ */ Lookup2D_FLOAT32_IEEE 0 SWC_FDC_type_CM_single_c 0.0 1.0
 /begin AXIS_DESCR COM_AXIS NO_INPUT_QUANTITY SWC_FDC_type_CM_single_rpm 24 -100000.0 100000.0 AXIS_PTS_REF ATQR_SL1FEDUTs_X_rpm /end AXIS_DESCR
 /begin AXIS_DESCR COM_AXIS VTQR_REDUWhlTqReqSmoothDelay_Nm SWC_FDC_type_CM_single_Nm 18 -10000.0 10000.0 AXIS_PTS_REF ATQR_SL1REDUTs_Y_Nm /end AXIS_DESCR
/end CHARACTERISTIC
/begin CHARACTERISTIC MTQR_SL4REDUTs_Z_c "" MAP 0x0000 /* @ECU_Address@MTQR_SL4REDUTs_Z_c@ */ Lookup2D_FLOAT32_IEEE 0 SWC_FDC_type_CM_single_c 0.0 1.0
 /begin AXIS_DESCR COM_AXIS NO_INPUT_QUANTITY SWC_FDC_type_CM_single_rpm 24 -100000.0 100000.0 AXIS_PTS_REF ATQR_SL1FEDUTs_X_rpm /end AXIS_DESCR
 /begin AXIS_DESCR COM_AXIS VTQR_REDUWhlTqReqSmoothDelay_Nm SWC_FDC_type_CM_single_Nm 18 -10000.0 10000.0 AXIS_PTS_REF ATQR_SL1REDUTs_Y_Nm /end AXIS_DESCR
/end CHARACTERISTIC
/begin CHARACTERISTIC MTQR_SL5REDUTs_Z_c "" MAP 0x0000 /* @ECU_Address@MTQR_SL5REDUTs_Z_c@ */ Lookup2D_FLOAT32_IEEE 0 SWC_FDC_type_CM_single_c 0.0 1.0
 /begin AXIS_DESCR COM_AXIS NO_INPUT_QUANTITY SWC_FDC_type_CM_single_rpm 24 -100000.0 100000.0 AXIS_PTS_REF ATQR_SL1FEDUTs_X_rpm /end AXIS_DESCR
 /begin AXIS_DESCR COM_AXIS VTQR_REDUWhlTqReqSmoothDelay_Nm SWC_FDC_type_CM_single_Nm 18 -10000.0 10000.0 AXIS_PTS_REF ATQR_SL1REDUTs_Y_Nm /end AXIS_DESCR
/end CHARACTERISTIC
/begin CHARACTERISTIC MTQR_SOPDREDUTs_Z_c "" MAP 0x0000 /* @ECU_Address@MTQR_SOPDREDUTs_Z_c@ */ Lookup2D_FLOAT32_IEEE 0 SWC_FDC_type_CM_single_c 0.0 1.0
 /begin AXIS_DESCR COM_AXIS NO_INPUT_QUANTITY SWC_FDC_type_CM_single_rpm 24 -100000.0 100000.0 AXIS_PTS_REF ATQR_SL1FEDUTs_X_rpm /end AXIS_DESCR
 /begin AXIS_DESCR COM_AXIS VTQR_REDUWhlTqReqSmoothDelay_Nm SWC_FDC_type_CM_single_Nm 18 -10000.0 10000.0 AXIS_PTS_REF ATQR_SL1REDUTs_Y_Nm /end AXIS_DESCR
/end CHARACTERISTIC
/begin CHARACTERISTIC MTQR_RrNegRateLimitDecE_Z_Nm "" MAP 0x0000 /* @ECU_Address@MTQR_RrNegRateLimitDecE_Z_Nm@ */ Lookup2D_FLOAT32_IEEE 0 SWC_FDC_type_CM_single_Nm -10000.0 0.0
 /begin AXIS_DESCR COM_AXIS NO_INPUT_QUANTITY SWC_FDC_type_CM_single_Nm 16 -10000.0 10000.0 AXIS_PTS_REF ATQR_RrNegRateLimitIncN_X_rpm /end AXIS_DESCR
 /begin AXIS_DESCR COM_AXIS VTQR_REDUWhlTqReqSmoothDelay_Nm SWC_FDC_type_CM_single_Nm 8 -10000.0 10000.0 AXIS_PTS_REF ATQR_RrNegRateLimitIncN_Y_Nm /end AXIS_DESCR
/end CHARACTERISTIC
/begin AXIS_PTS ATQR_RrNegRateLimitIncN_Y_Nm "" 0x0000 /* @ECU_Address@ATQR_RrNegRateLimitIncN_Y_Nm@ */ VTQR_REDUWhlTqReqSmoothDelay_Nm Lookup2D_X_FLOAT32_IEEE 0 SWC_FDC_type_CM_single_Nm 8 -10000.0 10000.0 /end AXIS_PTS
/begin AXIS_PTS ATQR_RrNegRateLimitIncN_X_rpm "" 0x0000 /* @ECU_Address@ATQR_RrNegRateLimitIncN_X_rpm@ */ NO_INPUT_QUANTITY Lookup2D_X_FLOAT32_IEEE 0 SWC_FDC_type_CM_single_Nm 16 -10000.0 10000.0 /end AXIS_PTS
/begin CHARACTERISTIC MTQR_RrNegRateLimitDecN_Z_Nm "" MAP 0x0000 /* @ECU_Address@MTQR_RrNegRateLimitDecN_Z_Nm@ */ Lookup2D_FLOAT32_IEEE 0 SWC_FDC_type_CM_single_Nm -10000.0 0.0
 /begin AXIS_DESCR COM_AXIS NO_INPUT_QUANTITY SWC_FDC_type_CM_single_Nm 16 -10000.0 10000.0 AXIS_PTS_REF ATQR_RrNegRateLimitIncN_X_rpm /end AXIS_DESCR
 /begin AXIS_DESCR COM_AXIS VTQR_REDUWhlTqReqSmoothDelay_Nm SWC_FDC_type_CM_single_Nm 8 -10000.0 10000.0 AXIS_PTS_REF ATQR_RrNegRateLimitIncN_Y_Nm /end AXIS_DESCR
/end CHARACTERISTIC
/begin CHARACTERISTIC MTQR_RrNegRateLimitDecS_Z_Nm "" MAP 0x0000 /* @ECU_Address@MTQR_RrNegRateLimitDecS_Z_Nm@ */ Lookup2D_FLOAT32_IEEE 0 SWC_FDC_type_CM_single_Nm -10000.0 0.0
 /begin AXIS_DESCR COM_AXIS NO_INPUT_QUANTITY SWC_FDC_type_CM_single_Nm 16 -10000.0 10000.0 AXIS_PTS_REF ATQR_RrNegRateLimitIncN_X_rpm /end AXIS_DESCR
 /begin AXIS_DESCR COM_AXIS VTQR_REDUWhlTqReqSmoothDelay_Nm SWC_FDC_type_CM_single_Nm 8 -10000.0 10000.0 AXIS_PTS_REF ATQR_RrNegRateLimitIncN_Y_Nm /end AXIS_DESCR
/end CHARACTERISTIC
/begin CHARACTERISTIC MTQR_RrNegRateLimitIncE_Z_Nm "" MAP 0x0000 /* @ECU_Address@MTQR_RrNegRateLimitIncE_Z_Nm@ */ Lookup2D_FLOAT32_IEEE 0 SWC_FDC_type_CM_single_Nm 0.0 10000.0
 /begin AXIS_DESCR COM_AXIS NO_INPUT_QUANTITY SWC_FDC_type_CM_single_Nm 16 -10000.0 10000.0 AXIS_PTS_REF ATQR_RrNegRateLimitIncN_X_rpm /end AXIS_DESCR
 /begin AXIS_DESCR COM_AXIS VTQR_REDUWhlTqReqSmoothDelay_Nm SWC_FDC_type_CM_single_Nm 8 -10000.0 10000.0 AXIS_PTS_REF ATQR_RrNegRateLimitIncN_Y_Nm /end AXIS_DESCR
/end CHARACTERISTIC
/begin CHARACTERISTIC MTQR_RrNegRateLimitIncN_Z_Nm "" MAP 0x0000 /* @ECU_Address@MTQR_RrNegRateLimitIncN_Z_Nm@ */ Lookup2D_FLOAT32_IEEE 0 SWC_FDC_type_CM_single_Nm 0.0 10000.0
 /begin AXIS_DESCR COM_AXIS NO_INPUT_QUANTITY SWC_FDC_type_CM_single_Nm 16 -10000.0 10000.0 AXIS_PTS_REF ATQR_RrNegRateLimitIncN_X_rpm /end AXIS_DESCR
 /begin AXIS_DESCR COM_AXIS VTQR_REDUWhlTqReqSmoothDelay_Nm SWC_FDC_type_CM_single_Nm 8 -10000.0 10000.0 AXIS_PTS_REF ATQR_RrNegRateLimitIncN_Y_Nm /end AXIS_DESCR
/end CHARACTERISTIC
/begin CHARACTERISTIC MTQR_RrNegRateLimitIncS_Z_Nm "" MAP 0x0000 /* @ECU_Address@MTQR_RrNegRateLimitIncS_Z_Nm@ */ Lookup2D_FLOAT32_IEEE 0 SWC_FDC_type_CM_single_Nm 0.0 10000.0
 /begin AXIS_DESCR COM_AXIS NO_INPUT_QUANTITY SWC_FDC_type_CM_single_Nm 16 -10000.0 10000.0 AXIS_PTS_REF ATQR_RrNegRateLimitIncN_X_rpm /end AXIS_DESCR
 /begin AXIS_DESCR COM_AXIS VTQR_REDUWhlTqReqSmoothDelay_Nm SWC_FDC_type_CM_single_Nm 8 -10000.0 10000.0 AXIS_PTS_REF ATQR_RrNegRateLimitIncN_Y_Nm /end AXIS_DESCR
/end CHARACTERISTIC
/begin CHARACTERISTIC MTQR_RrPosRateLimitDecE_Z_Nm "" MAP 0x0000 /* @ECU_Address@MTQR_RrPosRateLimitDecE_Z_Nm@ */ Lookup2D_FLOAT32_IEEE 0 SWC_FDC_type_CM_single_Nm -10000.0 0.0
 /begin AXIS_DESCR COM_AXIS NO_INPUT_QUANTITY SWC_FDC_type_CM_single_rpm 16 -100000.0 100000.0 AXIS_PTS_REF ATQR_RrPosRateLimitIncN_X_rpm /end AXIS_DESCR
 /begin AXIS_DESCR COM_AXIS VTQR_REDUWhlTqReqSmoothDelay_Nm SWC_FDC_type_CM_single_Nm 8 -10000.0 10000.0 AXIS_PTS_REF ATQR_RrPosRateLimitIncN_Y_Nm /end AXIS_DESCR
/end CHARACTERISTIC
/begin AXIS_PTS ATQR_RrPosRateLimitIncN_Y_Nm "" 0x0000 /* @ECU_Address@ATQR_RrPosRateLimitIncN_Y_Nm@ */ VTQR_REDUWhlTqReqSmoothDelay_Nm Lookup2D_X_FLOAT32_IEEE 0 SWC_FDC_type_CM_single_Nm 8 -10000.0 10000.0 /end AXIS_PTS
/begin AXIS_PTS ATQR_RrPosRateLimitIncN_X_rpm "" 0x0000 /* @ECU_Address@ATQR_RrPosRateLimitIncN_X_rpm@ */ NO_INPUT_QUANTITY Lookup2D_X_FLOAT32_IEEE 0 SWC_FDC_type_CM_single_rpm 16 -100000.0 100000.0 /end AXIS_PTS
/begin CHARACTERISTIC MTQR_RrPosRateLimitDecN_Z_Nm "" MAP 0x0000 /* @ECU_Address@MTQR_RrPosRateLimitDecN_Z_Nm@ */ Lookup2D_FLOAT32_IEEE 0 SWC_FDC_type_CM_single_Nm -10000.0 0.0
 /begin AXIS_DESCR COM_AXIS NO_INPUT_QUANTITY SWC_FDC_type_CM_single_rpm 16 -100000.0 100000.0 AXIS_PTS_REF ATQR_RrPosRateLimitIncN_X_rpm /end AXIS_DESCR
 /begin AXIS_DESCR COM_AXIS VTQR_REDUWhlTqReqSmoothDelay_Nm SWC_FDC_type_CM_single_Nm 8 -10000.0 10000.0 AXIS_PTS_REF ATQR_RrPosRateLimitIncN_Y_Nm /end AXIS_DESCR
/end CHARACTERISTIC
/begin CHARACTERISTIC MTQR_RrPosRateLimitDecS_Z_Nm "" MAP 0x0000 /* @ECU_Address@MTQR_RrPosRateLimitDecS_Z_Nm@ */ Lookup2D_FLOAT32_IEEE 0 SWC_FDC_type_CM_single_Nm -10000.0 0.0
 /begin AXIS_DESCR COM_AXIS NO_INPUT_QUANTITY SWC_FDC_type_CM_single_rpm 16 -100000.0 100000.0 AXIS_PTS_REF ATQR_RrPosRateLimitIncN_X_rpm /end AXIS_DESCR
 /begin AXIS_DESCR COM_AXIS VTQR_REDUWhlTqReqSmoothDelay_Nm SWC_FDC_type_CM_single_Nm 8 -10000.0 10000.0 AXIS_PTS_REF ATQR_RrPosRateLimitIncN_Y_Nm /end AXIS_DESCR
/end CHARACTERISTIC
/begin CHARACTERISTIC MTQR_RrPosRateLimitIncE_Z_Nm "" MAP 0x0000 /* @ECU_Address@MTQR_RrPosRateLimitIncE_Z_Nm@ */ Lookup2D_FLOAT32_IEEE 0 SWC_FDC_type_CM_single_Nm 0.0 10000.0
 /begin AXIS_DESCR COM_AXIS NO_INPUT_QUANTITY SWC_FDC_type_CM_single_rpm 16 -100000.0 100000.0 AXIS_PTS_REF ATQR_RrPosRateLimitIncN_X_rpm /end AXIS_DESCR
 /begin AXIS_DESCR COM_AXIS VTQR_REDUWhlTqReqSmoothDelay_Nm SWC_FDC_type_CM_single_Nm 8 -10000.0 10000.0 AXIS_PTS_REF ATQR_RrPosRateLimitIncN_Y_Nm /end AXIS_DESCR
/end CHARACTERISTIC
/begin CHARACTERISTIC MTQR_RrPosRateLimitIncN_Z_Nm "" MAP 0x0000 /* @ECU_Address@MTQR_RrPosRateLimitIncN_Z_Nm@ */ Lookup2D_FLOAT32_IEEE 0 SWC_FDC_type_CM_single_Nm 0.0 10000.0
 /begin AXIS_DESCR COM_AXIS NO_INPUT_QUANTITY SWC_FDC_type_CM_single_rpm 16 -100000.0 100000.0 AXIS_PTS_REF ATQR_RrPosRateLimitIncN_X_rpm /end AXIS_DESCR
 /begin AXIS_DESCR COM_AXIS VTQR_REDUWhlTqReqSmoothDelay_Nm SWC_FDC_type_CM_single_Nm 8 -10000.0 10000.0 AXIS_PTS_REF ATQR_RrPosRateLimitIncN_Y_Nm /end AXIS_DESCR
/end CHARACTERISTIC
/begin CHARACTERISTIC MTQR_RrPosRateLimitIncS_Z_Nm "" MAP 0x0000 /* @ECU_Address@MTQR_RrPosRateLimitIncS_Z_Nm@ */ Lookup2D_FLOAT32_IEEE 0 SWC_FDC_type_CM_single_Nm 0.0 10000.0
 /begin AXIS_DESCR COM_AXIS NO_INPUT_QUANTITY SWC_FDC_type_CM_single_rpm 16 -100000.0 100000.0 AXIS_PTS_REF ATQR_RrPosRateLimitIncN_X_rpm /end AXIS_DESCR
 /begin AXIS_DESCR COM_AXIS VTQR_REDUWhlTqReqSmoothDelay_Nm SWC_FDC_type_CM_single_Nm 8 -10000.0 10000.0 AXIS_PTS_REF ATQR_RrPosRateLimitIncN_Y_Nm /end AXIS_DESCR
/end CHARACTERISTIC
/begin CHARACTERISTIC MTQR_EL1REDUTqDecSR_Z_Nm "" MAP 0x0000 /* @ECU_Address@MTQR_EL1REDUTqDecSR_Z_Nm@ */ Lookup2D_FLOAT32_IEEE 0 SWC_FDC_type_CM_single_Nm -100000.0 0.0
 /begin AXIS_DESCR COM_AXIS NO_INPUT_QUANTITY SWC_FDC_type_CM_single_rpm 24 -100000.0 100000.0 AXIS_PTS_REF ATQR_EL1FEDUTqIncSR_X_rpm /end AXIS_DESCR
 /begin AXIS_DESCR COM_AXIS VTQR_REDUWhlTqReqSmoothDelay_Nm SWC_FDC_type_CM_single_Nm 18 -10000.0 10000.0 AXIS_PTS_REF ATQR_EL1REDUTqDecSR_Y_Nm /end AXIS_DESCR
/end CHARACTERISTIC
/begin AXIS_PTS ATQR_EL1REDUTqDecSR_Y_Nm "" 0x0000 /* @ECU_Address@ATQR_EL1REDUTqDecSR_Y_Nm@ */ VTQR_REDUWhlTqReqSmoothDelay_Nm Lookup2D_X_FLOAT32_IEEE 0 SWC_FDC_type_CM_single_Nm 18 -10000.0 10000.0 /end AXIS_PTS
/begin CHARACTERISTIC MTQR_EL2REDUTqDecSR_Z_Nm "" MAP 0x0000 /* @ECU_Address@MTQR_EL2REDUTqDecSR_Z_Nm@ */ Lookup2D_FLOAT32_IEEE 0 SWC_FDC_type_CM_single_Nm -100000.0 0.0
 /begin AXIS_DESCR COM_AXIS NO_INPUT_QUANTITY SWC_FDC_type_CM_single_rpm 24 -100000.0 100000.0 AXIS_PTS_REF ATQR_EL1FEDUTqIncSR_X_rpm /end AXIS_DESCR
 /begin AXIS_DESCR COM_AXIS VTQR_REDUWhlTqReqSmoothDelay_Nm SWC_FDC_type_CM_single_Nm 18 -10000.0 10000.0 AXIS_PTS_REF ATQR_EL1REDUTqDecSR_Y_Nm /end AXIS_DESCR
/end CHARACTERISTIC
/begin CHARACTERISTIC MTQR_EL3REDUTqDecSR_Z_Nm "" MAP 0x0000 /* @ECU_Address@MTQR_EL3REDUTqDecSR_Z_Nm@ */ Lookup2D_FLOAT32_IEEE 0 SWC_FDC_type_CM_single_Nm -100000.0 0.0
 /begin AXIS_DESCR COM_AXIS NO_INPUT_QUANTITY SWC_FDC_type_CM_single_rpm 24 -100000.0 100000.0 AXIS_PTS_REF ATQR_EL1FEDUTqIncSR_X_rpm /end AXIS_DESCR
 /begin AXIS_DESCR COM_AXIS VTQR_REDUWhlTqReqSmoothDelay_Nm SWC_FDC_type_CM_single_Nm 18 -10000.0 10000.0 AXIS_PTS_REF ATQR_EL1REDUTqDecSR_Y_Nm /end AXIS_DESCR
/end CHARACTERISTIC
/begin CHARACTERISTIC MTQR_EL4REDUTqDecSR_Z_Nm "" MAP 0x0000 /* @ECU_Address@MTQR_EL4REDUTqDecSR_Z_Nm@ */ Lookup2D_FLOAT32_IEEE 0 SWC_FDC_type_CM_single_Nm -100000.0 0.0
 /begin AXIS_DESCR COM_AXIS NO_INPUT_QUANTITY SWC_FDC_type_CM_single_rpm 24 -100000.0 100000.0 AXIS_PTS_REF ATQR_EL1FEDUTqIncSR_X_rpm /end AXIS_DESCR
 /begin AXIS_DESCR COM_AXIS VTQR_REDUWhlTqReqSmoothDelay_Nm SWC_FDC_type_CM_single_Nm 18 -10000.0 10000.0 AXIS_PTS_REF ATQR_EL1REDUTqDecSR_Y_Nm /end AXIS_DESCR
/end CHARACTERISTIC
/begin CHARACTERISTIC MTQR_EL5REDUTqDecSR_Z_Nm "" MAP 0x0000 /* @ECU_Address@MTQR_EL5REDUTqDecSR_Z_Nm@ */ Lookup2D_FLOAT32_IEEE 0 SWC_FDC_type_CM_single_Nm -100000.0 0.0
 /begin AXIS_DESCR COM_AXIS NO_INPUT_QUANTITY SWC_FDC_type_CM_single_rpm 24 -100000.0 100000.0 AXIS_PTS_REF ATQR_EL1FEDUTqIncSR_X_rpm /end AXIS_DESCR
 /begin AXIS_DESCR COM_AXIS VTQR_REDUWhlTqReqSmoothDelay_Nm SWC_FDC_type_CM_single_Nm 18 -10000.0 10000.0 AXIS_PTS_REF ATQR_EL1REDUTqDecSR_Y_Nm /end AXIS_DESCR
/end CHARACTERISTIC
/begin CHARACTERISTIC MTQR_EOPDREDUTqDecSR_Z_Nm "" MAP 0x0000 /* @ECU_Address@MTQR_EOPDREDUTqDecSR_Z_Nm@ */ Lookup2D_FLOAT32_IEEE 0 SWC_FDC_type_CM_single_Nm -100000.0 0.0
 /begin AXIS_DESCR COM_AXIS NO_INPUT_QUANTITY SWC_FDC_type_CM_single_rpm 24 -100000.0 100000.0 AXIS_PTS_REF ATQR_EL1FEDUTqIncSR_X_rpm /end AXIS_DESCR
 /begin AXIS_DESCR COM_AXIS VTQR_REDUWhlTqReqSmoothDelay_Nm SWC_FDC_type_CM_single_Nm 18 -10000.0 10000.0 AXIS_PTS_REF ATQR_EL1REDUTqDecSR_Y_Nm /end AXIS_DESCR
/end CHARACTERISTIC
/begin CHARACTERISTIC MTQR_EL1REDUTqIncSR_Z_Nm "" MAP 0x0000 /* @ECU_Address@MTQR_EL1REDUTqIncSR_Z_Nm@ */ Lookup2D_FLOAT32_IEEE 0 SWC_FDC_type_CM_single_Nm 0.0 100000.0
 /begin AXIS_DESCR COM_AXIS NO_INPUT_QUANTITY SWC_FDC_type_CM_single_rpm 24 -100000.0 100000.0 AXIS_PTS_REF ATQR_EL1FEDUTqIncSR_X_rpm /end AXIS_DESCR
 /begin AXIS_DESCR COM_AXIS NO_INPUT_QUANTITY SWC_FDC_type_CM_single_Nm 17 0.0 120.0 AXIS_PTS_REF ATQR_EL1FEDUTqIncSR_Y_pct /end AXIS_DESCR
/end CHARACTERISTIC
/begin CHARACTERISTIC MTQR_EL2REDUTqIncSR_Z_Nm "" MAP 0x0000 /* @ECU_Address@MTQR_EL2REDUTqIncSR_Z_Nm@ */ Lookup2D_FLOAT32_IEEE 0 SWC_FDC_type_CM_single_Nm 0.0 100000.0
 /begin AXIS_DESCR COM_AXIS NO_INPUT_QUANTITY SWC_FDC_type_CM_single_rpm 24 -100000.0 100000.0 AXIS_PTS_REF ATQR_EL1FEDUTqIncSR_X_rpm /end AXIS_DESCR
 /begin AXIS_DESCR COM_AXIS NO_INPUT_QUANTITY SWC_FDC_type_CM_single_Nm 17 0.0 120.0 AXIS_PTS_REF ATQR_EL1FEDUTqIncSR_Y_pct /end AXIS_DESCR
/end CHARACTERISTIC
/begin CHARACTERISTIC MTQR_EL3REDUTqIncSR_Z_Nm "" MAP 0x0000 /* @ECU_Address@MTQR_EL3REDUTqIncSR_Z_Nm@ */ Lookup2D_FLOAT32_IEEE 0 SWC_FDC_type_CM_single_Nm 0.0 100000.0
 /begin AXIS_DESCR COM_AXIS NO_INPUT_QUANTITY SWC_FDC_type_CM_single_rpm 24 -100000.0 100000.0 AXIS_PTS_REF ATQR_EL1FEDUTqIncSR_X_rpm /end AXIS_DESCR
 /begin AXIS_DESCR COM_AXIS NO_INPUT_QUANTITY SWC_FDC_type_CM_single_Nm 17 0.0 120.0 AXIS_PTS_REF ATQR_EL1FEDUTqIncSR_Y_pct /end AXIS_DESCR
/end CHARACTERISTIC
/begin CHARACTERISTIC MTQR_EL4REDUTqIncSR_Z_Nm "" MAP 0x0000 /* @ECU_Address@MTQR_EL4REDUTqIncSR_Z_Nm@ */ Lookup2D_FLOAT32_IEEE 0 SWC_FDC_type_CM_single_Nm 0.0 100000.0
 /begin AXIS_DESCR COM_AXIS NO_INPUT_QUANTITY SWC_FDC_type_CM_single_rpm 24 -100000.0 100000.0 AXIS_PTS_REF ATQR_EL1FEDUTqIncSR_X_rpm /end AXIS_DESCR
 /begin AXIS_DESCR COM_AXIS NO_INPUT_QUANTITY SWC_FDC_type_CM_single_Nm 17 0.0 120.0 AXIS_PTS_REF ATQR_EL1FEDUTqIncSR_Y_pct /end AXIS_DESCR
/end CHARACTERISTIC
/begin CHARACTERISTIC MTQR_EL5REDUTqIncSR_Z_Nm "" MAP 0x0000 /* @ECU_Address@MTQR_EL5REDUTqIncSR_Z_Nm@ */ Lookup2D_FLOAT32_IEEE 0 SWC_FDC_type_CM_single_Nm 0.0 100000.0
 /begin AXIS_DESCR COM_AXIS NO_INPUT_QUANTITY SWC_FDC_type_CM_single_rpm 24 -100000.0 100000.0 AXIS_PTS_REF ATQR_EL1FEDUTqIncSR_X_rpm /end AXIS_DESCR
 /begin AXIS_DESCR COM_AXIS NO_INPUT_QUANTITY SWC_FDC_type_CM_single_Nm 17 0.0 120.0 AXIS_PTS_REF ATQR_EL1FEDUTqIncSR_Y_pct /end AXIS_DESCR
/end CHARACTERISTIC
/begin CHARACTERISTIC MTQR_EOPDREDUTqIncSR_Z_Nm "" MAP 0x0000 /* @ECU_Address@MTQR_EOPDREDUTqIncSR_Z_Nm@ */ Lookup2D_FLOAT32_IEEE 0 SWC_FDC_type_CM_single_Nm 0.0 100000.0
 /begin AXIS_DESCR COM_AXIS NO_INPUT_QUANTITY SWC_FDC_type_CM_single_rpm 24 -100000.0 100000.0 AXIS_PTS_REF ATQR_EL1FEDUTqIncSR_X_rpm /end AXIS_DESCR
 /begin AXIS_DESCR COM_AXIS NO_INPUT_QUANTITY SWC_FDC_type_CM_single_Nm 17 0.0 120.0 AXIS_PTS_REF ATQR_EL1FEDUTqIncSR_Y_pct /end AXIS_DESCR
/end CHARACTERISTIC
/begin CHARACTERISTIC MTQR_NL1REDUTqDecSR_Z_Nm "" MAP 0x0000 /* @ECU_Address@MTQR_NL1REDUTqDecSR_Z_Nm@ */ Lookup2D_FLOAT32_IEEE 0 SWC_FDC_type_CM_single_Nm -100000.0 0.0
 /begin AXIS_DESCR COM_AXIS NO_INPUT_QUANTITY SWC_FDC_type_CM_single_rpm 24 -100000.0 100000.0 AXIS_PTS_REF ATQR_NL1FEDUTqIncSR_X_rpm /end AXIS_DESCR
 /begin AXIS_DESCR COM_AXIS VTQR_REDUWhlTqReqSmoothDelay_Nm SWC_FDC_type_CM_single_Nm 18 -10000.0 10000.0 AXIS_PTS_REF ATQR_NL1REDUTqDecSR_Y_Nm /end AXIS_DESCR
/end CHARACTERISTIC
/begin CHARACTERISTIC MTQR_NL2REDUTqDecSR_Z_Nm "" MAP 0x0000 /* @ECU_Address@MTQR_NL2REDUTqDecSR_Z_Nm@ */ Lookup2D_FLOAT32_IEEE 0 SWC_FDC_type_CM_single_Nm -100000.0 0.0
 /begin AXIS_DESCR COM_AXIS NO_INPUT_QUANTITY SWC_FDC_type_CM_single_rpm 24 -100000.0 100000.0 AXIS_PTS_REF ATQR_NL1FEDUTqIncSR_X_rpm /end AXIS_DESCR
 /begin AXIS_DESCR COM_AXIS VTQR_REDUWhlTqReqSmoothDelay_Nm SWC_FDC_type_CM_single_Nm 18 -10000.0 10000.0 AXIS_PTS_REF ATQR_NL1REDUTqDecSR_Y_Nm /end AXIS_DESCR
/end CHARACTERISTIC
/begin CHARACTERISTIC MTQR_NL3REDUTqDecSR_Z_Nm "" MAP 0x0000 /* @ECU_Address@MTQR_NL3REDUTqDecSR_Z_Nm@ */ Lookup2D_FLOAT32_IEEE 0 SWC_FDC_type_CM_single_Nm -100000.0 0.0
 /begin AXIS_DESCR COM_AXIS NO_INPUT_QUANTITY SWC_FDC_type_CM_single_rpm 24 -100000.0 100000.0 AXIS_PTS_REF ATQR_NL1FEDUTqIncSR_X_rpm /end AXIS_DESCR
 /begin AXIS_DESCR COM_AXIS VTQR_REDUWhlTqReqSmoothDelay_Nm SWC_FDC_type_CM_single_Nm 18 -10000.0 10000.0 AXIS_PTS_REF ATQR_NL1REDUTqDecSR_Y_Nm /end AXIS_DESCR
/end CHARACTERISTIC
/begin CHARACTERISTIC MTQR_NL4REDUTqDecSR_Z_Nm "" MAP 0x0000 /* @ECU_Address@MTQR_NL4REDUTqDecSR_Z_Nm@ */ Lookup2D_FLOAT32_IEEE 0 SWC_FDC_type_CM_single_Nm -100000.0 0.0
 /begin AXIS_DESCR COM_AXIS NO_INPUT_QUANTITY SWC_FDC_type_CM_single_rpm 24 -100000.0 100000.0 AXIS_PTS_REF ATQR_NL1FEDUTqIncSR_X_rpm /end AXIS_DESCR
 /begin AXIS_DESCR COM_AXIS VTQR_REDUWhlTqReqSmoothDelay_Nm SWC_FDC_type_CM_single_Nm 18 -10000.0 10000.0 AXIS_PTS_REF ATQR_NL1REDUTqDecSR_Y_Nm /end AXIS_DESCR
/end CHARACTERISTIC
/begin CHARACTERISTIC MTQR_NL5REDUTqDecSR_Z_Nm "" MAP 0x0000 /* @ECU_Address@MTQR_NL5REDUTqDecSR_Z_Nm@ */ Lookup2D_FLOAT32_IEEE 0 SWC_FDC_type_CM_single_Nm -100000.0 0.0
 /begin AXIS_DESCR COM_AXIS NO_INPUT_QUANTITY SWC_FDC_type_CM_single_rpm 24 -100000.0 100000.0 AXIS_PTS_REF ATQR_NL1FEDUTqIncSR_X_rpm /end AXIS_DESCR
 /begin AXIS_DESCR COM_AXIS VTQR_REDUWhlTqReqSmoothDelay_Nm SWC_FDC_type_CM_single_Nm 18 -10000.0 10000.0 AXIS_PTS_REF ATQR_NL1REDUTqDecSR_Y_Nm /end AXIS_DESCR
/end CHARACTERISTIC
/begin CHARACTERISTIC MTQR_NOPDREDUTqDecSR_Z_Nm "" MAP 0x0000 /* @ECU_Address@MTQR_NOPDREDUTqDecSR_Z_Nm@ */ Lookup2D_FLOAT32_IEEE 0 SWC_FDC_type_CM_single_Nm -100000.0 0.0
 /begin AXIS_DESCR COM_AXIS NO_INPUT_QUANTITY SWC_FDC_type_CM_single_rpm 24 -100000.0 100000.0 AXIS_PTS_REF ATQR_NL1FEDUTqIncSR_X_rpm /end AXIS_DESCR
 /begin AXIS_DESCR COM_AXIS VTQR_REDUWhlTqReqSmoothDelay_Nm SWC_FDC_type_CM_single_Nm 18 -10000.0 10000.0 AXIS_PTS_REF ATQR_NL1REDUTqDecSR_Y_Nm /end AXIS_DESCR
/end CHARACTERISTIC
/begin CHARACTERISTIC MTQR_NL1REDUTqIncSR_Z_Nm "" MAP 0x0000 /* @ECU_Address@MTQR_NL1REDUTqIncSR_Z_Nm@ */ Lookup2D_FLOAT32_IEEE 0 SWC_FDC_type_CM_single_Nm 0.0 100000.0
 /begin AXIS_DESCR COM_AXIS NO_INPUT_QUANTITY SWC_FDC_type_CM_single_rpm 24 -100000.0 100000.0 AXIS_PTS_REF ATQR_NL1FEDUTqIncSR_X_rpm /end AXIS_DESCR
 /begin AXIS_DESCR COM_AXIS NO_INPUT_QUANTITY SWC_FDC_type_CM_single_Nm 17 0.0 120.0 AXIS_PTS_REF ATQR_NL1FEDUTqIncSR_Y_pct /end AXIS_DESCR
/end CHARACTERISTIC
/begin CHARACTERISTIC MTQR_NL2REDUTqIncSR_Z_Nm "" MAP 0x0000 /* @ECU_Address@MTQR_NL2REDUTqIncSR_Z_Nm@ */ Lookup2D_FLOAT32_IEEE 0 SWC_FDC_type_CM_single_Nm 0.0 100000.0
 /begin AXIS_DESCR COM_AXIS NO_INPUT_QUANTITY SWC_FDC_type_CM_single_rpm 24 -100000.0 100000.0 AXIS_PTS_REF ATQR_NL1FEDUTqIncSR_X_rpm /end AXIS_DESCR
 /begin AXIS_DESCR COM_AXIS NO_INPUT_QUANTITY SWC_FDC_type_CM_single_Nm 17 0.0 120.0 AXIS_PTS_REF ATQR_NL1FEDUTqIncSR_Y_pct /end AXIS_DESCR
/end CHARACTERISTIC
/begin CHARACTERISTIC MTQR_NL3REDUTqIncSR_Z_Nm "" MAP 0x0000 /* @ECU_Address@MTQR_NL3REDUTqIncSR_Z_Nm@ */ Lookup2D_FLOAT32_IEEE 0 SWC_FDC_type_CM_single_Nm 0.0 100000.0
 /begin AXIS_DESCR COM_AXIS NO_INPUT_QUANTITY SWC_FDC_type_CM_single_rpm 24 -100000.0 100000.0 AXIS_PTS_REF ATQR_NL1FEDUTqIncSR_X_rpm /end AXIS_DESCR
 /begin AXIS_DESCR COM_AXIS NO_INPUT_QUANTITY SWC_FDC_type_CM_single_Nm 17 0.0 120.0 AXIS_PTS_REF ATQR_NL1FEDUTqIncSR_Y_pct /end AXIS_DESCR
/end CHARACTERISTIC
/begin CHARACTERISTIC MTQR_NL4REDUTqIncSR_Z_Nm "" MAP 0x0000 /* @ECU_Address@MTQR_NL4REDUTqIncSR_Z_Nm@ */ Lookup2D_FLOAT32_IEEE 0 SWC_FDC_type_CM_single_Nm 0.0 100000.0
 /begin AXIS_DESCR COM_AXIS NO_INPUT_QUANTITY SWC_FDC_type_CM_single_rpm 24 -100000.0 100000.0 AXIS_PTS_REF ATQR_NL1FEDUTqIncSR_X_rpm /end AXIS_DESCR
 /begin AXIS_DESCR COM_AXIS NO_INPUT_QUANTITY SWC_FDC_type_CM_single_Nm 17 0.0 120.0 AXIS_PTS_REF ATQR_NL1FEDUTqIncSR_Y_pct /end AXIS_DESCR
/end CHARACTERISTIC
/begin CHARACTERISTIC MTQR_NL5REDUTqIncSR_Z_Nm "" MAP 0x0000 /* @ECU_Address@MTQR_NL5REDUTqIncSR_Z_Nm@ */ Lookup2D_FLOAT32_IEEE 0 SWC_FDC_type_CM_single_Nm 0.0 100000.0
 /begin AXIS_DESCR COM_AXIS NO_INPUT_QUANTITY SWC_FDC_type_CM_single_rpm 24 -100000.0 100000.0 AXIS_PTS_REF ATQR_NL1FEDUTqIncSR_X_rpm /end AXIS_DESCR
 /begin AXIS_DESCR COM_AXIS NO_INPUT_QUANTITY SWC_FDC_type_CM_single_Nm 17 0.0 120.0 AXIS_PTS_REF ATQR_NL1FEDUTqIncSR_Y_pct /end AXIS_DESCR
/end CHARACTERISTIC
/begin CHARACTERISTIC MTQR_NOPDREDUTqIncSR_Z_Nm "" MAP 0x0000 /* @ECU_Address@MTQR_NOPDREDUTqIncSR_Z_Nm@ */ Lookup2D_FLOAT32_IEEE 0 SWC_FDC_type_CM_single_Nm 0.0 100000.0
 /begin AXIS_DESCR COM_AXIS NO_INPUT_QUANTITY SWC_FDC_type_CM_single_rpm 24 -100000.0 100000.0 AXIS_PTS_REF ATQR_NL1FEDUTqIncSR_X_rpm /end AXIS_DESCR
 /begin AXIS_DESCR COM_AXIS NO_INPUT_QUANTITY SWC_FDC_type_CM_single_Nm 17 0.0 120.0 AXIS_PTS_REF ATQR_NL1FEDUTqIncSR_Y_pct /end AXIS_DESCR
/end CHARACTERISTIC
/begin CHARACTERISTIC MTQR_SL1REDUTqDecSR_Z_Nm "" MAP 0x0000 /* @ECU_Address@MTQR_SL1REDUTqDecSR_Z_Nm@ */ Lookup2D_FLOAT32_IEEE 0 SWC_FDC_type_CM_single_Nm -100000.0 0.0
 /begin AXIS_DESCR COM_AXIS NO_INPUT_QUANTITY SWC_FDC_type_CM_single_rpm 24 -100000.0 100000.0 AXIS_PTS_REF ATQR_SL1FEDUTqIncSR_X_rpm /end AXIS_DESCR
 /begin AXIS_DESCR COM_AXIS VTQR_REDUWhlTqReqSmoothDelay_Nm SWC_FDC_type_CM_single_Nm 18 -10000.0 10000.0 AXIS_PTS_REF ATQR_SL1REDUTqDecSR_Y_Nm /end AXIS_DESCR
/end CHARACTERISTIC
/begin AXIS_PTS ATQR_SL1REDUTqDecSR_Y_Nm "" 0x0000 /* @ECU_Address@ATQR_SL1REDUTqDecSR_Y_Nm@ */ VTQR_REDUWhlTqReqSmoothDelay_Nm Lookup2D_X_FLOAT32_IEEE 0 SWC_FDC_type_CM_single_Nm 18 -10000.0 10000.0 /end AXIS_PTS
/begin CHARACTERISTIC MTQR_SL2REDUTqDecSR_Z_Nm "" MAP 0x0000 /* @ECU_Address@MTQR_SL2REDUTqDecSR_Z_Nm@ */ Lookup2D_FLOAT32_IEEE 0 SWC_FDC_type_CM_single_Nm -100000.0 0.0
 /begin AXIS_DESCR COM_AXIS NO_INPUT_QUANTITY SWC_FDC_type_CM_single_rpm 24 -100000.0 100000.0 AXIS_PTS_REF ATQR_SL1FEDUTqIncSR_X_rpm /end AXIS_DESCR
 /begin AXIS_DESCR COM_AXIS VTQR_REDUWhlTqReqSmoothDelay_Nm SWC_FDC_type_CM_single_Nm 18 -10000.0 10000.0 AXIS_PTS_REF ATQR_SL1REDUTqDecSR_Y_Nm /end AXIS_DESCR
/end CHARACTERISTIC
/begin CHARACTERISTIC MTQR_SL3REDUTqDecSR_Z_Nm "" MAP 0x0000 /* @ECU_Address@MTQR_SL3REDUTqDecSR_Z_Nm@ */ Lookup2D_FLOAT32_IEEE 0 SWC_FDC_type_CM_single_Nm -100000.0 0.0
 /begin AXIS_DESCR COM_AXIS NO_INPUT_QUANTITY SWC_FDC_type_CM_single_rpm 24 -100000.0 100000.0 AXIS_PTS_REF ATQR_SL1FEDUTqIncSR_X_rpm /end AXIS_DESCR
 /begin AXIS_DESCR COM_AXIS VTQR_REDUWhlTqReqSmoothDelay_Nm SWC_FDC_type_CM_single_Nm 18 -10000.0 10000.0 AXIS_PTS_REF ATQR_SL1REDUTqDecSR_Y_Nm /end AXIS_DESCR
/end CHARACTERISTIC
/begin CHARACTERISTIC MTQR_SL4REDUTqDecSR_Z_Nm "" MAP 0x0000 /* @ECU_Address@MTQR_SL4REDUTqDecSR_Z_Nm@ */ Lookup2D_FLOAT32_IEEE 0 SWC_FDC_type_CM_single_Nm -100000.0 0.0
 /begin AXIS_DESCR COM_AXIS NO_INPUT_QUANTITY SWC_FDC_type_CM_single_rpm 24 -100000.0 100000.0 AXIS_PTS_REF ATQR_SL1FEDUTqIncSR_X_rpm /end AXIS_DESCR
 /begin AXIS_DESCR COM_AXIS VTQR_REDUWhlTqReqSmoothDelay_Nm SWC_FDC_type_CM_single_Nm 18 -10000.0 10000.0 AXIS_PTS_REF ATQR_SL1REDUTqDecSR_Y_Nm /end AXIS_DESCR
/end CHARACTERISTIC
/begin CHARACTERISTIC MTQR_SL5REDUTqDecSR_Z_Nm "" MAP 0x0000 /* @ECU_Address@MTQR_SL5REDUTqDecSR_Z_Nm@ */ Lookup2D_FLOAT32_IEEE 0 SWC_FDC_type_CM_single_Nm -100000.0 0.0
 /begin AXIS_DESCR COM_AXIS NO_INPUT_QUANTITY SWC_FDC_type_CM_single_rpm 24 -100000.0 100000.0 AXIS_PTS_REF ATQR_SL1FEDUTqIncSR_X_rpm /end AXIS_DESCR
 /begin AXIS_DESCR COM_AXIS VTQR_REDUWhlTqReqSmoothDelay_Nm SWC_FDC_type_CM_single_Nm 18 -10000.0 10000.0 AXIS_PTS_REF ATQR_SL1REDUTqDecSR_Y_Nm /end AXIS_DESCR
/end CHARACTERISTIC
/begin CHARACTERISTIC MTQR_SOPDREDUTqDecSR_Z_Nm "" MAP 0x0000 /* @ECU_Address@MTQR_SOPDREDUTqDecSR_Z_Nm@ */ Lookup2D_FLOAT32_IEEE 0 SWC_FDC_type_CM_single_Nm -100000.0 0.0
 /begin AXIS_DESCR COM_AXIS NO_INPUT_QUANTITY SWC_FDC_type_CM_single_rpm 24 -100000.0 100000.0 AXIS_PTS_REF ATQR_SL1FEDUTqIncSR_X_rpm /end AXIS_DESCR
 /begin AXIS_DESCR COM_AXIS VTQR_REDUWhlTqReqSmoothDelay_Nm SWC_FDC_type_CM_single_Nm 18 -10000.0 10000.0 AXIS_PTS_REF ATQR_SL1REDUTqDecSR_Y_Nm /end AXIS_DESCR
/end CHARACTERISTIC
/begin CHARACTERISTIC MTQR_SL1REDUTqIncSR_Z_Nm "" MAP 0x0000 /* @ECU_Address@MTQR_SL1REDUTqIncSR_Z_Nm@ */ Lookup2D_FLOAT32_IEEE 0 SWC_FDC_type_CM_single_Nm 0.0 100000.0
 /begin AXIS_DESCR COM_AXIS NO_INPUT_QUANTITY SWC_FDC_type_CM_single_rpm 24 -100000.0 100000.0 AXIS_PTS_REF ATQR_SL1FEDUTqIncSR_X_rpm /end AXIS_DESCR
 /begin AXIS_DESCR COM_AXIS NO_INPUT_QUANTITY SWC_FDC_type_CM_single_Nm 17 0.0 120.0 AXIS_PTS_REF ATQR_SL1FEDUTqIncSR_Y_pct /end AXIS_DESCR
/end CHARACTERISTIC
/begin CHARACTERISTIC MTQR_SL2REDUTqIncSR_Z_Nm "" MAP 0x0000 /* @ECU_Address@MTQR_SL2REDUTqIncSR_Z_Nm@ */ Lookup2D_FLOAT32_IEEE 0 SWC_FDC_type_CM_single_Nm 0.0 100000.0
 /begin AXIS_DESCR COM_AXIS NO_INPUT_QUANTITY SWC_FDC_type_CM_single_rpm 24 -100000.0 100000.0 AXIS_PTS_REF ATQR_SL1FEDUTqIncSR_X_rpm /end AXIS_DESCR
 /begin AXIS_DESCR COM_AXIS NO_INPUT_QUANTITY SWC_FDC_type_CM_single_Nm 17 0.0 120.0 AXIS_PTS_REF ATQR_SL1FEDUTqIncSR_Y_pct /end AXIS_DESCR
/end CHARACTERISTIC
/begin CHARACTERISTIC MTQR_SL3REDUTqIncSR_Z_Nm "" MAP 0x0000 /* @ECU_Address@MTQR_SL3REDUTqIncSR_Z_Nm@ */ Lookup2D_FLOAT32_IEEE 0 SWC_FDC_type_CM_single_Nm 0.0 100000.0
 /begin AXIS_DESCR COM_AXIS NO_INPUT_QUANTITY SWC_FDC_type_CM_single_rpm 24 -100000.0 100000.0 AXIS_PTS_REF ATQR_SL1FEDUTqIncSR_X_rpm /end AXIS_DESCR
 /begin AXIS_DESCR COM_AXIS NO_INPUT_QUANTITY SWC_FDC_type_CM_single_Nm 17 0.0 120.0 AXIS_PTS_REF ATQR_SL1FEDUTqIncSR_Y_pct /end AXIS_DESCR
/end CHARACTERISTIC
/begin CHARACTERISTIC MTQR_SL4REDUTqIncSR_Z_Nm "" MAP 0x0000 /* @ECU_Address@MTQR_SL4REDUTqIncSR_Z_Nm@ */ Lookup2D_FLOAT32_IEEE 0 SWC_FDC_type_CM_single_Nm 0.0 200000.0
 /begin AXIS_DESCR COM_AXIS NO_INPUT_QUANTITY SWC_FDC_type_CM_single_rpm 24 -100000.0 100000.0 AXIS_PTS_REF ATQR_SL1FEDUTqIncSR_X_rpm /end AXIS_DESCR
 /begin AXIS_DESCR COM_AXIS NO_INPUT_QUANTITY SWC_FDC_type_CM_single_Nm 17 0.0 120.0 AXIS_PTS_REF ATQR_SL1FEDUTqIncSR_Y_pct /end AXIS_DESCR
/end CHARACTERISTIC
/begin CHARACTERISTIC MTQR_SL5REDUTqIncSR_Z_Nm "" MAP 0x0000 /* @ECU_Address@MTQR_SL5REDUTqIncSR_Z_Nm@ */ Lookup2D_FLOAT32_IEEE 0 SWC_FDC_type_CM_single_Nm 0.0 200000.0
 /begin AXIS_DESCR COM_AXIS NO_INPUT_QUANTITY SWC_FDC_type_CM_single_rpm 24 -100000.0 100000.0 AXIS_PTS_REF ATQR_SL1FEDUTqIncSR_X_rpm /end AXIS_DESCR
 /begin AXIS_DESCR COM_AXIS NO_INPUT_QUANTITY SWC_FDC_type_CM_single_Nm 17 0.0 120.0 AXIS_PTS_REF ATQR_SL1FEDUTqIncSR_Y_pct /end AXIS_DESCR
/end CHARACTERISTIC
/begin CHARACTERISTIC MTQR_SOPDREDUTqIncSR_Z_Nm "" MAP 0x0000 /* @ECU_Address@MTQR_SOPDREDUTqIncSR_Z_Nm@ */ Lookup2D_FLOAT32_IEEE 0 SWC_FDC_type_CM_single_Nm 0.0 200000.0
 /begin AXIS_DESCR COM_AXIS NO_INPUT_QUANTITY SWC_FDC_type_CM_single_rpm 24 -100000.0 100000.0 AXIS_PTS_REF ATQR_SL1FEDUTqIncSR_X_rpm /end AXIS_DESCR
 /begin AXIS_DESCR COM_AXIS NO_INPUT_QUANTITY SWC_FDC_type_CM_single_Nm 17 0.0 120.0 AXIS_PTS_REF ATQR_SL1FEDUTqIncSR_Y_pct /end AXIS_DESCR
/end CHARACTERISTIC
/begin CHARACTERISTIC MTQD_ECOTqMapD_Z_Nm "" MAP 0x0000 /* @ECU_Address@MTQD_ECOTqMapD_Z_Nm@ */ Lookup2D_FLOAT32_IEEE 0 SWC_FDC_type_CM_single_Nm -100000.0 100000.0
 /begin AXIS_DESCR COM_AXIS VTQD_TqTargetShaftSpd_rpm SWC_FDC_type_CM_single_rpm 42 -100000.0 100000.0 AXIS_PTS_REF ATQD_ECOTqMapD_X_rpm /end AXIS_DESCR
 /begin AXIS_DESCR COM_AXIS VTQD_ActAPSPosn_pct SWC_FDC_type_CM_single_pct 35 0.0 110.0 AXIS_PTS_REF ATQD_ECOTqMapD_Y_pct /end AXIS_DESCR
/end CHARACTERISTIC
/begin AXIS_PTS ATQD_ECOTqMapD_Y_pct "" 0x0000 /* @ECU_Address@ATQD_ECOTqMapD_Y_pct@ */ VTQD_ActAPSPosn_pct Lookup2D_X_FLOAT32_IEEE 0 SWC_FDC_type_CM_single_pct 35 0.0 110.0 /end AXIS_PTS
/begin AXIS_PTS ATQD_ECOTqMapD_X_rpm "" 0x0000 /* @ECU_Address@ATQD_ECOTqMapD_X_rpm@ */ VTQD_TqTargetShaftSpd_rpm Lookup2D_X_FLOAT32_IEEE 0 SWC_FDC_type_CM_single_rpm 42 -100000.0 100000.0 /end AXIS_PTS
/begin CHARACTERISTIC MTQD_EL2TqMapD_Z_Nm "" MAP 0x0000 /* @ECU_Address@MTQD_EL2TqMapD_Z_Nm@ */ Lookup2D_FLOAT32_IEEE 0 SWC_FDC_type_CM_single_Nm -100000.0 100000.0
 /begin AXIS_DESCR COM_AXIS VTQD_TqTargetShaftSpd_rpm SWC_FDC_type_CM_single_rpm 42 -100000.0 100000.0 AXIS_PTS_REF ATQD_ECOTqMapD_X_rpm /end AXIS_DESCR
 /begin AXIS_DESCR COM_AXIS VTQD_ActAPSPosn_pct SWC_FDC_type_CM_single_pct 35 0.0 110.0 AXIS_PTS_REF ATQD_ECOTqMapD_Y_pct /end AXIS_DESCR
/end CHARACTERISTIC
/begin CHARACTERISTIC MTQD_EL3TqMapD_Z_Nm "" MAP 0x0000 /* @ECU_Address@MTQD_EL3TqMapD_Z_Nm@ */ Lookup2D_FLOAT32_IEEE 0 SWC_FDC_type_CM_single_Nm -100000.0 100000.0
 /begin AXIS_DESCR COM_AXIS VTQD_TqTargetShaftSpd_rpm SWC_FDC_type_CM_single_rpm 42 -100000.0 100000.0 AXIS_PTS_REF ATQD_ECOTqMapD_X_rpm /end AXIS_DESCR
 /begin AXIS_DESCR COM_AXIS VTQD_ActAPSPosn_pct SWC_FDC_type_CM_single_pct 35 0.0 110.0 AXIS_PTS_REF ATQD_ECOTqMapD_Y_pct /end AXIS_DESCR
/end CHARACTERISTIC
/begin CHARACTERISTIC MTQD_EL4TqMapD_Z_Nm "" MAP 0x0000 /* @ECU_Address@MTQD_EL4TqMapD_Z_Nm@ */ Lookup2D_FLOAT32_IEEE 0 SWC_FDC_type_CM_single_Nm -100000.0 100000.0
 /begin AXIS_DESCR COM_AXIS VTQD_TqTargetShaftSpd_rpm SWC_FDC_type_CM_single_rpm 42 -100000.0 100000.0 AXIS_PTS_REF ATQD_ECOTqMapD_X_rpm /end AXIS_DESCR
 /begin AXIS_DESCR COM_AXIS VTQD_ActAPSPosn_pct SWC_FDC_type_CM_single_pct 35 0.0 110.0 AXIS_PTS_REF ATQD_ECOTqMapD_Y_pct /end AXIS_DESCR
/end CHARACTERISTIC
/begin CHARACTERISTIC MTQD_EL5TqMapD_Z_Nm "" MAP 0x0000 /* @ECU_Address@MTQD_EL5TqMapD_Z_Nm@ */ Lookup2D_FLOAT32_IEEE 0 SWC_FDC_type_CM_single_Nm -100000.0 100000.0
 /begin AXIS_DESCR COM_AXIS VTQD_TqTargetShaftSpd_rpm SWC_FDC_type_CM_single_rpm 42 -100000.0 100000.0 AXIS_PTS_REF ATQD_ECOTqMapD_X_rpm /end AXIS_DESCR
 /begin AXIS_DESCR COM_AXIS VTQD_ActAPSPosn_pct SWC_FDC_type_CM_single_pct 35 0.0 110.0 AXIS_PTS_REF ATQD_ECOTqMapD_Y_pct /end AXIS_DESCR
/end CHARACTERISTIC
/begin CHARACTERISTIC MTQD_EOPDTqMapDCon_Z_Nm "" MAP 0x0000 /* @ECU_Address@MTQD_EOPDTqMapDCon_Z_Nm@ */ Lookup2D_FLOAT32_IEEE 0 SWC_FDC_type_CM_single_Nm -100000.0 100000.0
 /begin AXIS_DESCR COM_AXIS VTQD_TqTargetShaftSpd_rpm SWC_FDC_type_CM_single_rpm 42 -100000.0 100000.0 AXIS_PTS_REF ATQD_EOPDTqMapDCon_X_rpm /end AXIS_DESCR
 /begin AXIS_DESCR COM_AXIS NO_INPUT_QUANTITY SWC_FDC_type_CM_single_Deg 23 -180.0 180.0 AXIS_PTS_REF ATQD_EOPDTqMapDCon_Y_Deg /end AXIS_DESCR
/end CHARACTERISTIC
/begin AXIS_PTS ATQD_EOPDTqMapDCon_Y_Deg "" 0x0000 /* @ECU_Address@ATQD_EOPDTqMapDCon_Y_Deg@ */ NO_INPUT_QUANTITY Lookup2D_X_FLOAT32_IEEE 0 SWC_FDC_type_CM_single_Deg 23 -180.0 180.0 /end AXIS_PTS
/begin AXIS_PTS ATQD_EOPDTqMapDCon_X_rpm "" 0x0000 /* @ECU_Address@ATQD_EOPDTqMapDCon_X_rpm@ */ VTQD_TqTargetShaftSpd_rpm Lookup2D_X_FLOAT32_IEEE 0 SWC_FDC_type_CM_single_rpm 42 -100000.0 100000.0 /end AXIS_PTS
/begin CHARACTERISTIC MTQD_EOPDTqMapD_Z_Nm "" MAP 0x0000 /* @ECU_Address@MTQD_EOPDTqMapD_Z_Nm@ */ Lookup2D_FLOAT32_IEEE 0 SWC_FDC_type_CM_single_Nm -100000.0 100000.0
 /begin AXIS_DESCR COM_AXIS VTQD_TqTargetShaftSpd_rpm SWC_FDC_type_CM_single_rpm 42 -100000.0 100000.0 AXIS_PTS_REF ATQD_ECOTqMapD_X_rpm /end AXIS_DESCR
 /begin AXIS_DESCR COM_AXIS VTQD_ActAPSPosn_pct SWC_FDC_type_CM_single_pct 35 0.0 110.0 AXIS_PTS_REF ATQD_ECOTqMapD_Y_pct /end AXIS_DESCR
/end CHARACTERISTIC
/begin CHARACTERISTIC MTQD_RollGenMapEL1_Z_Nm "" MAP 0x0000 /* @ECU_Address@MTQD_RollGenMapEL1_Z_Nm@ */ Lookup2D_FLOAT32_IEEE 0 SWC_FDC_type_CM_single_Nm -100000.0 0.0
 /begin AXIS_DESCR COM_AXIS VTQD_TqTargetShaftSpd_rpm SWC_FDC_type_CM_single_rpm 24 -100000.0 100000.0 AXIS_PTS_REF ATQD_RollGenMapEL1_X_rpm /end AXIS_DESCR
 /begin AXIS_DESCR COM_AXIS VTQD_RollingShaftSpd_rpm SWC_FDC_type_CM_single_rpm 24 -100000.0 100000.0 AXIS_PTS_REF ATQD_RollGenMapEL1_Y_rpm /end AXIS_DESCR
/end CHARACTERISTIC
/begin AXIS_PTS ATQD_RollGenMapEL1_Y_rpm "" 0x0000 /* @ECU_Address@ATQD_RollGenMapEL1_Y_rpm@ */ VTQD_RollingShaftSpd_rpm Lookup2D_X_FLOAT32_IEEE 0 SWC_FDC_type_CM_single_rpm 24 -100000.0 100000.0 /end AXIS_PTS
/begin AXIS_PTS ATQD_RollGenMapEL1_X_rpm "" 0x0000 /* @ECU_Address@ATQD_RollGenMapEL1_X_rpm@ */ VTQD_TqTargetShaftSpd_rpm Lookup2D_X_FLOAT32_IEEE 0 SWC_FDC_type_CM_single_rpm 24 -100000.0 100000.0 /end AXIS_PTS
/begin CHARACTERISTIC MTQD_EMTqMapD_Z_Nm "" MAP 0x0000 /* @ECU_Address@MTQD_EMTqMapD_Z_Nm@ */ Lookup2D_FLOAT32_IEEE 0 SWC_FDC_type_CM_single_Nm -100000.0 100000.0
 /begin AXIS_DESCR COM_AXIS VTQD_TqTargetShaftSpd_rpm SWC_FDC_type_CM_single_rpm 42 -100000.0 100000.0 AXIS_PTS_REF ATQD_EMTqMapD_X_rpm /end AXIS_DESCR
 /begin AXIS_DESCR COM_AXIS VTQD_ActAPSPosn_pct SWC_FDC_type_CM_single_pct 35 0.0 110.0 AXIS_PTS_REF ATQD_EMTqMapD_Y_pct /end AXIS_DESCR
/end CHARACTERISTIC
/begin AXIS_PTS ATQD_EMTqMapD_Y_pct "" 0x0000 /* @ECU_Address@ATQD_EMTqMapD_Y_pct@ */ VTQD_ActAPSPosn_pct Lookup2D_X_FLOAT32_IEEE 0 SWC_FDC_type_CM_single_pct 35 0.0 110.0 /end AXIS_PTS
/begin AXIS_PTS ATQD_EMTqMapD_X_rpm "" 0x0000 /* @ECU_Address@ATQD_EMTqMapD_X_rpm@ */ VTQD_TqTargetShaftSpd_rpm Lookup2D_X_FLOAT32_IEEE 0 SWC_FDC_type_CM_single_rpm 42 -100000.0 100000.0 /end AXIS_PTS
/begin CHARACTERISTIC MTQD_NL1TqMapD_Z_Nm "" MAP 0x0000 /* @ECU_Address@MTQD_NL1TqMapD_Z_Nm@ */ Lookup2D_FLOAT32_IEEE 0 SWC_FDC_type_CM_single_Nm -100000.0 100000.0
 /begin AXIS_DESCR COM_AXIS VTQD_TqTargetShaftSpd_rpm SWC_FDC_type_CM_single_rpm 42 -100000.0 100000.0 AXIS_PTS_REF ATQD_NL1TqMapD_X_rpm /end AXIS_DESCR
 /begin AXIS_DESCR COM_AXIS VTQD_ActAPSPosn_pct SWC_FDC_type_CM_single_pct 35 0.0 110.0 AXIS_PTS_REF ATQD_NL1TqMapD_Y_pct /end AXIS_DESCR
/end CHARACTERISTIC
/begin CHARACTERISTIC MTQD_NL2TqMapD_Z_Nm "" MAP 0x0000 /* @ECU_Address@MTQD_NL2TqMapD_Z_Nm@ */ Lookup2D_FLOAT32_IEEE 0 SWC_FDC_type_CM_single_Nm -100000.0 100000.0
 /begin AXIS_DESCR COM_AXIS VTQD_TqTargetShaftSpd_rpm SWC_FDC_type_CM_single_rpm 42 -100000.0 100000.0 AXIS_PTS_REF ATQD_NL1TqMapD_X_rpm /end AXIS_DESCR
 /begin AXIS_DESCR COM_AXIS VTQD_ActAPSPosn_pct SWC_FDC_type_CM_single_pct 35 0.0 110.0 AXIS_PTS_REF ATQD_NL1TqMapD_Y_pct /end AXIS_DESCR
/end CHARACTERISTIC
/begin CHARACTERISTIC MTQD_NL3TqMapD_Z_Nm "" MAP 0x0000 /* @ECU_Address@MTQD_NL3TqMapD_Z_Nm@ */ Lookup2D_FLOAT32_IEEE 0 SWC_FDC_type_CM_single_Nm -100000.0 100000.0
 /begin AXIS_DESCR COM_AXIS VTQD_TqTargetShaftSpd_rpm SWC_FDC_type_CM_single_rpm 42 -100000.0 100000.0 AXIS_PTS_REF ATQD_NL1TqMapD_X_rpm /end AXIS_DESCR
 /begin AXIS_DESCR COM_AXIS VTQD_ActAPSPosn_pct SWC_FDC_type_CM_single_pct 35 0.0 110.0 AXIS_PTS_REF ATQD_NL1TqMapD_Y_pct /end AXIS_DESCR
/end CHARACTERISTIC
/begin CHARACTERISTIC MTQD_NL4TqMapD_Z_Nm "" MAP 0x0000 /* @ECU_Address@MTQD_NL4TqMapD_Z_Nm@ */ Lookup2D_FLOAT32_IEEE 0 SWC_FDC_type_CM_single_Nm -100000.0 100000.0
 /begin AXIS_DESCR COM_AXIS VTQD_TqTargetShaftSpd_rpm SWC_FDC_type_CM_single_rpm 42 -100000.0 100000.0 AXIS_PTS_REF ATQD_NL1TqMapD_X_rpm /end AXIS_DESCR
 /begin AXIS_DESCR COM_AXIS VTQD_ActAPSPosn_pct SWC_FDC_type_CM_single_pct 35 0.0 110.0 AXIS_PTS_REF ATQD_NL1TqMapD_Y_pct /end AXIS_DESCR
/end CHARACTERISTIC
/begin CHARACTERISTIC MTQD_NL5TqMapD_Z_Nm "" MAP 0x0000 /* @ECU_Address@MTQD_NL5TqMapD_Z_Nm@ */ Lookup2D_FLOAT32_IEEE 0 SWC_FDC_type_CM_single_Nm -100000.0 100000.0
 /begin AXIS_DESCR COM_AXIS VTQD_TqTargetShaftSpd_rpm SWC_FDC_type_CM_single_rpm 42 -100000.0 100000.0 AXIS_PTS_REF ATQD_NL1TqMapD_X_rpm /end AXIS_DESCR
 /begin AXIS_DESCR COM_AXIS VTQD_ActAPSPosn_pct SWC_FDC_type_CM_single_pct 35 0.0 110.0 AXIS_PTS_REF ATQD_NL1TqMapD_Y_pct /end AXIS_DESCR
/end CHARACTERISTIC
/begin CHARACTERISTIC MTQD_NOPDTqMapDCon_Z_Nm "" MAP 0x0000 /* @ECU_Address@MTQD_NOPDTqMapDCon_Z_Nm@ */ Lookup2D_FLOAT32_IEEE 0 SWC_FDC_type_CM_single_Nm -100000.0 100000.0
 /begin AXIS_DESCR COM_AXIS VTQD_TqTargetShaftSpd_rpm SWC_FDC_type_CM_single_rpm 42 -100000.0 100000.0 AXIS_PTS_REF ATQD_NOPDTqMapDCon_X_rpm /end AXIS_DESCR
 /begin AXIS_DESCR COM_AXIS NO_INPUT_QUANTITY SWC_FDC_type_CM_single_Deg 23 -180.0 180.0 AXIS_PTS_REF ATQD_NOPDTqMapDCon_Y_Deg /end AXIS_DESCR
/end CHARACTERISTIC
/begin AXIS_PTS ATQD_NOPDTqMapDCon_Y_Deg "" 0x0000 /* @ECU_Address@ATQD_NOPDTqMapDCon_Y_Deg@ */ NO_INPUT_QUANTITY Lookup2D_X_FLOAT32_IEEE 0 SWC_FDC_type_CM_single_Deg 23 -180.0 180.0 /end AXIS_PTS
/begin AXIS_PTS ATQD_NOPDTqMapDCon_X_rpm "" 0x0000 /* @ECU_Address@ATQD_NOPDTqMapDCon_X_rpm@ */ VTQD_TqTargetShaftSpd_rpm Lookup2D_X_FLOAT32_IEEE 0 SWC_FDC_type_CM_single_rpm 42 -100000.0 100000.0 /end AXIS_PTS
/begin CHARACTERISTIC MTQD_NOPDTqMapD_Z_Nm "" MAP 0x0000 /* @ECU_Address@MTQD_NOPDTqMapD_Z_Nm@ */ Lookup2D_FLOAT32_IEEE 0 SWC_FDC_type_CM_single_Nm -100000.0 100000.0
 /begin AXIS_DESCR COM_AXIS VTQD_TqTargetShaftSpd_rpm SWC_FDC_type_CM_single_rpm 42 -100000.0 100000.0 AXIS_PTS_REF ATQD_NL1TqMapD_X_rpm /end AXIS_DESCR
 /begin AXIS_DESCR COM_AXIS VTQD_ActAPSPosn_pct SWC_FDC_type_CM_single_pct 35 0.0 110.0 AXIS_PTS_REF ATQD_NL1TqMapD_Y_pct /end AXIS_DESCR
/end CHARACTERISTIC
/begin CHARACTERISTIC MTQD_SNTqMapD_Z_Nm "" MAP 0x0000 /* @ECU_Address@MTQD_SNTqMapD_Z_Nm@ */ Lookup2D_FLOAT32_IEEE 0 SWC_FDC_type_CM_single_Nm -100000.0 100000.0
 /begin AXIS_DESCR COM_AXIS VTQD_TqTargetShaftSpd_rpm SWC_FDC_type_CM_single_rpm 42 -100000.0 100000.0 AXIS_PTS_REF ATQD_SNTqMapD_X_rpm /end AXIS_DESCR
 /begin AXIS_DESCR COM_AXIS VTQD_ActAPSPosn_pct SWC_FDC_type_CM_single_pct 35 0.0 110.0 AXIS_PTS_REF ATQD_SNTqMapD_Y_pct /end AXIS_DESCR
/end CHARACTERISTIC
/begin AXIS_PTS ATQD_SNTqMapD_Y_pct "" 0x0000 /* @ECU_Address@ATQD_SNTqMapD_Y_pct@ */ VTQD_ActAPSPosn_pct Lookup2D_X_FLOAT32_IEEE 0 SWC_FDC_type_CM_single_pct 35 0.0 110.0 /end AXIS_PTS
/begin AXIS_PTS ATQD_SNTqMapD_X_rpm "" 0x0000 /* @ECU_Address@ATQD_SNTqMapD_X_rpm@ */ VTQD_TqTargetShaftSpd_rpm Lookup2D_X_FLOAT32_IEEE 0 SWC_FDC_type_CM_single_rpm 42 -100000.0 100000.0 /end AXIS_PTS
/begin CHARACTERISTIC MTQD_SL1TqMapD_Z_Nm "" MAP 0x0000 /* @ECU_Address@MTQD_SL1TqMapD_Z_Nm@ */ Lookup2D_FLOAT32_IEEE 0 SWC_FDC_type_CM_single_Nm -100000.0 100000.0
 /begin AXIS_DESCR COM_AXIS VTQD_TqTargetShaftSpd_rpm SWC_FDC_type_CM_single_rpm 42 -100000.0 100000.0 AXIS_PTS_REF ATQD_SL1TqMapD_X_rpm /end AXIS_DESCR
 /begin AXIS_DESCR COM_AXIS VTQD_ActAPSPosn_pct SWC_FDC_type_CM_single_pct 35 0.0 110.0 AXIS_PTS_REF ATQD_SL1TqMapD_Y_pct /end AXIS_DESCR
/end CHARACTERISTIC
/begin AXIS_PTS ATQD_SL1TqMapD_Y_pct "" 0x0000 /* @ECU_Address@ATQD_SL1TqMapD_Y_pct@ */ VTQD_ActAPSPosn_pct Lookup2D_X_FLOAT32_IEEE 0 SWC_FDC_type_CM_single_pct 35 0.0 110.0 /end AXIS_PTS
/begin AXIS_PTS ATQD_SL1TqMapD_X_rpm "" 0x0000 /* @ECU_Address@ATQD_SL1TqMapD_X_rpm@ */ VTQD_TqTargetShaftSpd_rpm Lookup2D_X_FLOAT32_IEEE 0 SWC_FDC_type_CM_single_rpm 42 -100000.0 100000.0 /end AXIS_PTS
/begin CHARACTERISTIC MTQD_SL2TqMapD_Z_Nm "" MAP 0x0000 /* @ECU_Address@MTQD_SL2TqMapD_Z_Nm@ */ Lookup2D_FLOAT32_IEEE 0 SWC_FDC_type_CM_single_Nm -100000.0 100000.0
 /begin AXIS_DESCR COM_AXIS VTQD_TqTargetShaftSpd_rpm SWC_FDC_type_CM_single_rpm 42 -100000.0 100000.0 AXIS_PTS_REF ATQD_SL1TqMapD_X_rpm /end AXIS_DESCR
 /begin AXIS_DESCR COM_AXIS VTQD_ActAPSPosn_pct SWC_FDC_type_CM_single_pct 35 0.0 110.0 AXIS_PTS_REF ATQD_SL1TqMapD_Y_pct /end AXIS_DESCR
/end CHARACTERISTIC
/begin CHARACTERISTIC MTQD_SL3TqMapD_Z_Nm "" MAP 0x0000 /* @ECU_Address@MTQD_SL3TqMapD_Z_Nm@ */ Lookup2D_FLOAT32_IEEE 0 SWC_FDC_type_CM_single_Nm -100000.0 100000.0
 /begin AXIS_DESCR COM_AXIS VTQD_TqTargetShaftSpd_rpm SWC_FDC_type_CM_single_rpm 42 -100000.0 100000.0 AXIS_PTS_REF ATQD_SL1TqMapD_X_rpm /end AXIS_DESCR
 /begin AXIS_DESCR COM_AXIS VTQD_ActAPSPosn_pct SWC_FDC_type_CM_single_pct 35 0.0 110.0 AXIS_PTS_REF ATQD_SL1TqMapD_Y_pct /end AXIS_DESCR
/end CHARACTERISTIC
/begin CHARACTERISTIC MTQD_SL4TqMapD_Z_Nm "" MAP 0x0000 /* @ECU_Address@MTQD_SL4TqMapD_Z_Nm@ */ Lookup2D_FLOAT32_IEEE 0 SWC_FDC_type_CM_single_Nm -100000.0 100000.0
 /begin AXIS_DESCR COM_AXIS VTQD_TqTargetShaftSpd_rpm SWC_FDC_type_CM_single_rpm 42 -100000.0 100000.0 AXIS_PTS_REF ATQD_SL1TqMapD_X_rpm /end AXIS_DESCR
 /begin AXIS_DESCR COM_AXIS VTQD_ActAPSPosn_pct SWC_FDC_type_CM_single_pct 35 0.0 110.0 AXIS_PTS_REF ATQD_SL1TqMapD_Y_pct /end AXIS_DESCR
/end CHARACTERISTIC
/begin CHARACTERISTIC MTQD_SL5TqMapD_Z_Nm "" MAP 0x0000 /* @ECU_Address@MTQD_SL5TqMapD_Z_Nm@ */ Lookup2D_FLOAT32_IEEE 0 SWC_FDC_type_CM_single_Nm -100000.0 100000.0
 /begin AXIS_DESCR COM_AXIS VTQD_TqTargetShaftSpd_rpm SWC_FDC_type_CM_single_rpm 42 -100000.0 100000.0 AXIS_PTS_REF ATQD_SL1TqMapD_X_rpm /end AXIS_DESCR
 /begin AXIS_DESCR COM_AXIS VTQD_ActAPSPosn_pct SWC_FDC_type_CM_single_pct 35 0.0 110.0 AXIS_PTS_REF ATQD_SL1TqMapD_Y_pct /end AXIS_DESCR
/end CHARACTERISTIC
/begin CHARACTERISTIC MTQD_SOPDTqMapDCon_Z_Nm "" MAP 0x0000 /* @ECU_Address@MTQD_SOPDTqMapDCon_Z_Nm@ */ Lookup2D_FLOAT32_IEEE 0 SWC_FDC_type_CM_single_Nm -100000.0 100000.0
 /begin AXIS_DESCR COM_AXIS VTQD_TqTargetShaftSpd_rpm SWC_FDC_type_CM_single_rpm 42 -100000.0 100000.0 AXIS_PTS_REF ATQD_SOPDTqMapDCon_X_rpm /end AXIS_DESCR
 /begin AXIS_DESCR COM_AXIS NO_INPUT_QUANTITY SWC_FDC_type_CM_single_Deg 23 -180.0 180.0 AXIS_PTS_REF ATQD_SOPDTqMapDCon_Y_Deg /end AXIS_DESCR
/end CHARACTERISTIC
/begin AXIS_PTS ATQD_SOPDTqMapDCon_Y_Deg "" 0x0000 /* @ECU_Address@ATQD_SOPDTqMapDCon_Y_Deg@ */ NO_INPUT_QUANTITY Lookup2D_X_FLOAT32_IEEE 0 SWC_FDC_type_CM_single_Deg 23 -180.0 180.0 /end AXIS_PTS
/begin AXIS_PTS ATQD_SOPDTqMapDCon_X_rpm "" 0x0000 /* @ECU_Address@ATQD_SOPDTqMapDCon_X_rpm@ */ VTQD_TqTargetShaftSpd_rpm Lookup2D_X_FLOAT32_IEEE 0 SWC_FDC_type_CM_single_rpm 42 -100000.0 100000.0 /end AXIS_PTS
/begin CHARACTERISTIC MTQD_SOPDTqMapD_Z_Nm "" MAP 0x0000 /* @ECU_Address@MTQD_SOPDTqMapD_Z_Nm@ */ Lookup2D_FLOAT32_IEEE 0 SWC_FDC_type_CM_single_Nm -100000.0 100000.0
 /begin AXIS_DESCR COM_AXIS VTQD_TqTargetShaftSpd_rpm SWC_FDC_type_CM_single_rpm 42 -100000.0 100000.0 AXIS_PTS_REF ATQD_SL1TqMapD_X_rpm /end AXIS_DESCR
 /begin AXIS_DESCR COM_AXIS VTQD_ActAPSPosn_pct SWC_FDC_type_CM_single_pct 35 0.0 110.0 AXIS_PTS_REF ATQD_SL1TqMapD_Y_pct /end AXIS_DESCR
/end CHARACTERISTIC
/begin CHARACTERISTIC KTQD_OPDHTqDisAPSPosn_pct "" VALUE 0x0000 /* @ECU_Address@KTQD_OPDHTqDisAPSPosn_pct@ */ Scalar_FLOAT32_IEEE 0 SWC_FDC_type_CM_single_pct 0.0 125.0 /end CHARACTERISTIC
/begin CHARACTERISTIC KTQD_OPDHTqDisComSpd_kph "" VALUE 0x0000 /* @ECU_Address@KTQD_OPDHTqDisComSpd_kph@ */ Scalar_FLOAT32_IEEE 0 SWC_FDC_type_CM_single_kph -300.0 300.0 /end CHARACTERISTIC
/begin CHARACTERISTIC KTQR_FrTqIncGainSW_flg "" VALUE 0x0000 /* @ECU_Address@KTQR_FrTqIncGainSW_flg@ */ Scalar_BOOLEAN 0 SWC_FDC_type_CM_boolean_flg 0.0 1.0 /end CHARACTERISTIC
/begin CHARACTERISTIC KTQR_RrTqIncGainSW_flg "" VALUE 0x0000 /* @ECU_Address@KTQR_RrTqIncGainSW_flg@ */ Scalar_BOOLEAN 0 SWC_FDC_type_CM_boolean_flg 0.0 1.0 /end CHARACTERISTIC
/begin CHARACTERISTIC KTPM_Delay_raw8 "" VALUE 0x0000 /* @ECU_Address@KTPM_Delay_raw8@ */ Scalar_UBYTE 0 SWC_FDC_type_CM_uint8_raw8 0.0 255.0 /end CHARACTERISTIC
/begin CHARACTERISTIC KTQR_EnEcoRrIncGain_enum "" VALUE 0x0000 /* @ECU_Address@KTQR_EnEcoRrIncGain_enum@ */ Scalar_UBYTE 0 SWC_FDC_type_CM_uint8_enum 0.0 15.0 /end CHARACTERISTIC
/begin CHARACTERISTIC KTQR_EnNormalRrIncGain_enum "" VALUE 0x0000 /* @ECU_Address@KTQR_EnNormalRrIncGain_enum@ */ Scalar_UBYTE 0 SWC_FDC_type_CM_uint8_enum 0.0 15.0 /end CHARACTERISTIC
/begin CHARACTERISTIC KTQR_EnSportRrIncGain_enum "" VALUE 0x0000 /* @ECU_Address@KTQR_EnSportRrIncGain_enum@ */ Scalar_UBYTE 0 SWC_FDC_type_CM_uint8_enum 0.0 15.0 /end CHARACTERISTIC
/begin MEASUREMENT VTPM_GS2_cnt "" ULONG SWC_FDC_type_CM_uint32_cnt 0 0 0.0 4.294967295E+9 ECU_ADDRESS 0x0000 /* @ECU_Address@VTPM_GS2_cnt@ */ /end MEASUREMENT
/begin MEASUREMENT VTPM_GS3_cnt "" ULONG SWC_FDC_type_CM_uint32_cnt 0 0 0.0 4.294967295E+9 ECU_ADDRESS 0x0000 /* @ECU_Address@VTPM_GS3_cnt@ */ /end MEASUREMENT
/begin MEASUREMENT VTPM_GS4_cnt "" ULONG SWC_FDC_type_CM_uint32_cnt 0 0 0.0 4.294967295E+9 ECU_ADDRESS 0x0000 /* @ECU_Address@VTPM_GS4_cnt@ */ /end MEASUREMENT
/begin MEASUREMENT VTPM_GS1_cnt "" ULONG SWC_FDC_type_CM_uint32_cnt 0 0 0.0 4.294967295E+9 ECU_ADDRESS 0x0000 /* @ECU_Address@VTPM_GS1_cnt@ */ /end MEASUREMENT
/begin MEASUREMENT VTPM_MSensor1ID_raw "" ULONG SWC_FDC_type_CM_uint32_raw 0 0 0.0 4.294967295E+9 ECU_ADDRESS 0x0000 /* @ECU_Address@VTPM_MSensor1ID_raw@ */ /end MEASUREMENT
/begin MEASUREMENT VTPM_MSensor2ID_raw "" ULONG SWC_FDC_type_CM_uint32_raw 0 0 0.0 4.294967295E+9 ECU_ADDRESS 0x0000 /* @ECU_Address@VTPM_MSensor2ID_raw@ */ /end MEASUREMENT
/begin MEASUREMENT VTPM_MSensor3ID_raw "" ULONG SWC_FDC_type_CM_uint32_raw 0 0 0.0 4.294967295E+9 ECU_ADDRESS 0x0000 /* @ECU_Address@VTPM_MSensor3ID_raw@ */ /end MEASUREMENT
/begin MEASUREMENT VTPM_MSensor4ID_raw "" ULONG SWC_FDC_type_CM_uint32_raw 0 0 0.0 4.294967295E+9 ECU_ADDRESS 0x0000 /* @ECU_Address@VTPM_MSensor4ID_raw@ */ /end MEASUREMENT
/begin MEASUREMENT VTPM_MLFID_raw "" ULONG SWC_FDC_type_CM_uint32_raw 0 0 0.0 4.294967295E+9 ECU_ADDRESS 0x0000 /* @ECU_Address@VTPM_MLFID_raw@ */ /end MEASUREMENT
/begin MEASUREMENT VTPM_MLRID_raw "" ULONG SWC_FDC_type_CM_uint32_raw 0 0 0.0 4.294967295E+9 ECU_ADDRESS 0x0000 /* @ECU_Address@VTPM_MLRID_raw@ */ /end MEASUREMENT
/begin MEASUREMENT VTPM_MRFID_raw "" ULONG SWC_FDC_type_CM_uint32_raw 0 0 0.0 4.294967295E+9 ECU_ADDRESS 0x0000 /* @ECU_Address@VTPM_MRFID_raw@ */ /end MEASUREMENT
/begin MEASUREMENT VTPM_MRRID_raw "" ULONG SWC_FDC_type_CM_uint32_raw 0 0 0.0 4.294967295E+9 ECU_ADDRESS 0x0000 /* @ECU_Address@VTPM_MRRID_raw@ */ /end MEASUREMENT
/begin MEASUREMENT VTPM_S1WheelDebugALTU_pct "" FLOAT32_IEEE SWC_FDC_type_CM_single_pct 0 0 0.0 100.0 ECU_ADDRESS 0x0000 /* @ECU_Address@VTPM_S1WheelDebugALTU_pct@ */ /end MEASUREMENT
/begin MEASUREMENT VTPM_S2WheelDebugALTU_pct "" FLOAT32_IEEE SWC_FDC_type_CM_single_pct 0 0 0.0 100.0 ECU_ADDRESS 0x0000 /* @ECU_Address@VTPM_S2WheelDebugALTU_pct@ */ /end MEASUREMENT
/begin MEASUREMENT VTPM_S3WheelDebugALTU_pct "" FLOAT32_IEEE SWC_FDC_type_CM_single_pct 0 0 0.0 100.0 ECU_ADDRESS 0x0000 /* @ECU_Address@VTPM_S3WheelDebugALTU_pct@ */ /end MEASUREMENT
/begin MEASUREMENT VTPM_S4WheelDebugALTU_pct "" FLOAT32_IEEE SWC_FDC_type_CM_single_pct 0 0 0.0 100.0 ECU_ADDRESS 0x0000 /* @ECU_Address@VTPM_S4WheelDebugALTU_pct@ */ /end MEASUREMENT
/begin MEASUREMENT VVMC_RRWhlCalAcc_Gps "" FLOAT32_IEEE SWC_FDC_type_CM_single_Gps 0 0 0.0 20.0 ECU_ADDRESS 0x0000 /* @ECU_Address@VVMC_RRWhlCalAcc_Gps@ */ /end MEASUREMENT
/begin MEASUREMENT VVMC_RFWhlCalAcc_Gps "" FLOAT32_IEEE SWC_FDC_type_CM_single_Gps 0 0 0.0 20.0 ECU_ADDRESS 0x0000 /* @ECU_Address@VVMC_RFWhlCalAcc_Gps@ */ /end MEASUREMENT
/begin MEASUREMENT VVMC_LRWhlCalAcc_Gps "" FLOAT32_IEEE SWC_FDC_type_CM_single_Gps 0 0 0.0 20.0 ECU_ADDRESS 0x0000 /* @ECU_Address@VVMC_LRWhlCalAcc_Gps@ */ /end MEASUREMENT
/begin MEASUREMENT VVMC_LFWhlCalAcc_Gps "" FLOAT32_IEEE SWC_FDC_type_CM_single_Gps 0 0 0.0 20.0 ECU_ADDRESS 0x0000 /* @ECU_Address@VVMC_LFWhlCalAcc_Gps@ */ /end MEASUREMENT
/begin MEASUREMENT VTQR_SportTqRrIncGain_c "" FLOAT32_IEEE SWC_FDC_type_CM_single_c 0 0 0.0 300.0 ECU_ADDRESS 0x0000 /* @ECU_Address@VTQR_SportTqRrIncGain_c@ */ /end MEASUREMENT
/begin MEASUREMENT VTQR_SportOPDTqRrIncGain_c "" FLOAT32_IEEE SWC_FDC_type_CM_single_c 0 0 0.0 1.0 ECU_ADDRESS 0x0000 /* @ECU_Address@VTQR_SportOPDTqRrIncGain_c@ */ /end MEASUREMENT
/begin MEASUREMENT VTQR_Sport5TqRrIncGain_c "" FLOAT32_IEEE SWC_FDC_type_CM_single_c 0 0 0.0 1.0 ECU_ADDRESS 0x0000 /* @ECU_Address@VTQR_Sport5TqRrIncGain_c@ */ /end MEASUREMENT
/begin MEASUREMENT VTQR_Sport4TqRrIncGain_c "" FLOAT32_IEEE SWC_FDC_type_CM_single_c 0 0 0.0 1.0 ECU_ADDRESS 0x0000 /* @ECU_Address@VTQR_Sport4TqRrIncGain_c@ */ /end MEASUREMENT
/begin MEASUREMENT VTQR_Sport3TqRrIncGain_c "" FLOAT32_IEEE SWC_FDC_type_CM_single_c 0 0 0.0 1.0 ECU_ADDRESS 0x0000 /* @ECU_Address@VTQR_Sport3TqRrIncGain_c@ */ /end MEASUREMENT
/begin MEASUREMENT VTQR_Sport2TqRrIncGain_c "" FLOAT32_IEEE SWC_FDC_type_CM_single_c 0 0 0.0 1.0 ECU_ADDRESS 0x0000 /* @ECU_Address@VTQR_Sport2TqRrIncGain_c@ */ /end MEASUREMENT
/begin MEASUREMENT VTQR_EcoTqRrIncGain_c "" FLOAT32_IEEE SWC_FDC_type_CM_single_c 0 0 0.0 300.0 ECU_ADDRESS 0x0000 /* @ECU_Address@VTQR_EcoTqRrIncGain_c@ */ /end MEASUREMENT
/begin MEASUREMENT VTQR_ECOOPDTqRrIncGain_c "" FLOAT32_IEEE SWC_FDC_type_CM_single_c 0 0 0.0 1.0 ECU_ADDRESS 0x0000 /* @ECU_Address@VTQR_ECOOPDTqRrIncGain_c@ */ /end MEASUREMENT
/begin MEASUREMENT VTQR_ECO5TqRrIncGain_c "" FLOAT32_IEEE SWC_FDC_type_CM_single_c 0 0 0.0 1.0 ECU_ADDRESS 0x0000 /* @ECU_Address@VTQR_ECO5TqRrIncGain_c@ */ /end MEASUREMENT
/begin MEASUREMENT VTQR_ECO4TqRrIncGain_c "" FLOAT32_IEEE SWC_FDC_type_CM_single_c 0 0 0.0 1.0 ECU_ADDRESS 0x0000 /* @ECU_Address@VTQR_ECO4TqRrIncGain_c@ */ /end MEASUREMENT
/begin MEASUREMENT VTQR_ECO3TqRrIncGain_c "" FLOAT32_IEEE SWC_FDC_type_CM_single_c 0 0 0.0 1.0 ECU_ADDRESS 0x0000 /* @ECU_Address@VTQR_ECO3TqRrIncGain_c@ */ /end MEASUREMENT
/begin MEASUREMENT VTQR_ECO2TqRrIncGain_c "" FLOAT32_IEEE SWC_FDC_type_CM_single_c 0 0 0.0 1.0 ECU_ADDRESS 0x0000 /* @ECU_Address@VTQR_ECO2TqRrIncGain_c@ */ /end MEASUREMENT
/begin MEASUREMENT VTQR_NormalTqRrIncGain_c "" FLOAT32_IEEE SWC_FDC_type_CM_single_c 0 0 0.0 300.0 ECU_ADDRESS 0x0000 /* @ECU_Address@VTQR_NormalTqRrIncGain_c@ */ /end MEASUREMENT
/begin MEASUREMENT VTQR_NLOPDTqRrIncGain_c "" FLOAT32_IEEE SWC_FDC_type_CM_single_c 0 0 0.0 1.0 ECU_ADDRESS 0x0000 /* @ECU_Address@VTQR_NLOPDTqRrIncGain_c@ */ /end MEASUREMENT
/begin MEASUREMENT VTQR_NL5TqRrIncGain_c "" FLOAT32_IEEE SWC_FDC_type_CM_single_c 0 0 0.0 1.0 ECU_ADDRESS 0x0000 /* @ECU_Address@VTQR_NL5TqRrIncGain_c@ */ /end MEASUREMENT
/begin MEASUREMENT VTQR_NL4TqRrIncGain_c "" FLOAT32_IEEE SWC_FDC_type_CM_single_c 0 0 0.0 1.0 ECU_ADDRESS 0x0000 /* @ECU_Address@VTQR_NL4TqRrIncGain_c@ */ /end MEASUREMENT
/begin MEASUREMENT VTQR_NL3TqRrIncGain_c "" FLOAT32_IEEE SWC_FDC_type_CM_single_c 0 0 0.0 1.0 ECU_ADDRESS 0x0000 /* @ECU_Address@VTQR_NL3TqRrIncGain_c@ */ /end MEASUREMENT
/begin MEASUREMENT VTQR_NL2TqRrIncGain_c "" FLOAT32_IEEE SWC_FDC_type_CM_single_c 0 0 0.0 1.0 ECU_ADDRESS 0x0000 /* @ECU_Address@VTQR_NL2TqRrIncGain_c@ */ /end MEASUREMENT
/begin MEASUREMENT VTQD_RL5TqMapDComp_Nm "" FLOAT32_IEEE SWC_FDC_type_CM_single_Nm 0 0 -100000.0 100000.0 ECU_ADDRESS 0x0000 /* @ECU_Address@VTQD_RL5TqMapDComp_Nm@ */ /end MEASUREMENT
/begin MEASUREMENT VTQD_RL4TqMapDComp_Nm "" FLOAT32_IEEE SWC_FDC_type_CM_single_Nm 0 0 -100000.0 100000.0 ECU_ADDRESS 0x0000 /* @ECU_Address@VTQD_RL4TqMapDComp_Nm@ */ /end MEASUREMENT
/begin MEASUREMENT VTQD_RL3TqMapDComp_Nm "" FLOAT32_IEEE SWC_FDC_type_CM_single_Nm 0 0 -100000.0 100000.0 ECU_ADDRESS 0x0000 /* @ECU_Address@VTQD_RL3TqMapDComp_Nm@ */ /end MEASUREMENT
/begin MEASUREMENT VTQD_RL2TqMapDComp_Nm "" FLOAT32_IEEE SWC_FDC_type_CM_single_Nm 0 0 -100000.0 100000.0 ECU_ADDRESS 0x0000 /* @ECU_Address@VTQD_RL2TqMapDComp_Nm@ */ /end MEASUREMENT
/begin MEASUREMENT VTQD_RL1TqMapDComp_Nm "" FLOAT32_IEEE SWC_FDC_type_CM_single_Nm 0 0 -100000.0 100000.0 ECU_ADDRESS 0x0000 /* @ECU_Address@VTQD_RL1TqMapDComp_Nm@ */ /end MEASUREMENT
/begin MEASUREMENT VTQD_SOPDActTqMapD_Nm "" FLOAT32_IEEE SWC_FDC_type_CM_single_Nm 0 0 -100000.0 100000.0 ECU_ADDRESS 0x0000 /* @ECU_Address@VTQD_SOPDActTqMapD_Nm@ */ /end MEASUREMENT
/begin MEASUREMENT VTQD_EOPDActTqMapD_Nm "" FLOAT32_IEEE SWC_FDC_type_CM_single_Nm 0 0 -100000.0 100000.0 ECU_ADDRESS 0x0000 /* @ECU_Address@VTQD_EOPDActTqMapD_Nm@ */ /end MEASUREMENT
/begin MEASUREMENT VTQD_NOPDActTqMapD_Nm "" FLOAT32_IEEE SWC_FDC_type_CM_single_Nm 0 0 -100000.0 100000.0 ECU_ADDRESS 0x0000 /* @ECU_Address@VTQD_NOPDActTqMapD_Nm@ */ /end MEASUREMENT
/begin MEASUREMENT VTPM_LRWP_raw16 "" SWORD SWC_FDC_type_CM_int16_raw16 0 0 -255.0 255.0 ECU_ADDRESS 0x0000 /* @ECU_Address@VTPM_LRWP_raw16@ */ /end MEASUREMENT
/begin MEASUREMENT VTPM_LFWP_raw16 "" SWORD SWC_FDC_type_CM_int16_raw16 0 0 -255.0 255.0 ECU_ADDRESS 0x0000 /* @ECU_Address@VTPM_LFWP_raw16@ */ /end MEASUREMENT
/begin MEASUREMENT VTPM_RRWP_raw16 "" SWORD SWC_FDC_type_CM_int16_raw16 0 0 -255.0 255.0 ECU_ADDRESS 0x0000 /* @ECU_Address@VTPM_RRWP_raw16@ */ /end MEASUREMENT
/begin MEASUREMENT VTPM_RFWP_raw16 "" SWORD SWC_FDC_type_CM_int16_raw16 0 0 -255.0 255.0 ECU_ADDRESS 0x0000 /* @ECU_Address@VTPM_RFWP_raw16@ */ /end MEASUREMENT
/begin MEASUREMENT VTPM_LFS1_cnt "" UBYTE SWC_FDC_type_CM_uint8_cnt 0 0 0.0 255.0 ECU_ADDRESS 0x0000 /* @ECU_Address@VTPM_LFS1_cnt@ */ /end MEASUREMENT
/begin MEASUREMENT VTPM_RRS1_cnt "" UBYTE SWC_FDC_type_CM_uint8_cnt 0 0 0.0 255.0 ECU_ADDRESS 0x0000 /* @ECU_Address@VTPM_RRS1_cnt@ */ /end MEASUREMENT
/begin MEASUREMENT VTPM_LRS1_cnt "" UBYTE SWC_FDC_type_CM_uint8_cnt 0 0 0.0 255.0 ECU_ADDRESS 0x0000 /* @ECU_Address@VTPM_LRS1_cnt@ */ /end MEASUREMENT
/begin MEASUREMENT VTPM_RFS1_cnt "" UBYTE SWC_FDC_type_CM_uint8_cnt 0 0 0.0 255.0 ECU_ADDRESS 0x0000 /* @ECU_Address@VTPM_RFS1_cnt@ */ /end MEASUREMENT
/begin MEASUREMENT VTPM_LFS4_cnt "" UBYTE SWC_FDC_type_CM_uint8_cnt 0 0 0.0 255.0 ECU_ADDRESS 0x0000 /* @ECU_Address@VTPM_LFS4_cnt@ */ /end MEASUREMENT
/begin MEASUREMENT VTPM_RRS4_cnt "" UBYTE SWC_FDC_type_CM_uint8_cnt 0 0 0.0 255.0 ECU_ADDRESS 0x0000 /* @ECU_Address@VTPM_RRS4_cnt@ */ /end MEASUREMENT
/begin MEASUREMENT VTPM_LRS4_cnt "" UBYTE SWC_FDC_type_CM_uint8_cnt 0 0 0.0 255.0 ECU_ADDRESS 0x0000 /* @ECU_Address@VTPM_LRS4_cnt@ */ /end MEASUREMENT
/begin MEASUREMENT VTPM_RFS4_cnt "" UBYTE SWC_FDC_type_CM_uint8_cnt 0 0 0.0 255.0 ECU_ADDRESS 0x0000 /* @ECU_Address@VTPM_RFS4_cnt@ */ /end MEASUREMENT
/begin MEASUREMENT VTPM_LFS3_cnt "" UBYTE SWC_FDC_type_CM_uint8_cnt 0 0 0.0 255.0 ECU_ADDRESS 0x0000 /* @ECU_Address@VTPM_LFS3_cnt@ */ /end MEASUREMENT
/begin MEASUREMENT VTPM_RRS3_cnt "" UBYTE SWC_FDC_type_CM_uint8_cnt 0 0 0.0 255.0 ECU_ADDRESS 0x0000 /* @ECU_Address@VTPM_RRS3_cnt@ */ /end MEASUREMENT
/begin MEASUREMENT VTPM_LRS3_cnt "" UBYTE SWC_FDC_type_CM_uint8_cnt 0 0 0.0 255.0 ECU_ADDRESS 0x0000 /* @ECU_Address@VTPM_LRS3_cnt@ */ /end MEASUREMENT
/begin MEASUREMENT VTPM_RFS3_cnt "" UBYTE SWC_FDC_type_CM_uint8_cnt 0 0 0.0 255.0 ECU_ADDRESS 0x0000 /* @ECU_Address@VTPM_RFS3_cnt@ */ /end MEASUREMENT
/begin MEASUREMENT VTPM_LFS2_cnt "" UBYTE SWC_FDC_type_CM_uint8_cnt 0 0 0.0 255.0 ECU_ADDRESS 0x0000 /* @ECU_Address@VTPM_LFS2_cnt@ */ /end MEASUREMENT
/begin MEASUREMENT VTPM_RRS2_cnt "" UBYTE SWC_FDC_type_CM_uint8_cnt 0 0 0.0 255.0 ECU_ADDRESS 0x0000 /* @ECU_Address@VTPM_RRS2_cnt@ */ /end MEASUREMENT
/begin MEASUREMENT VTPM_LRS2_cnt "" UBYTE SWC_FDC_type_CM_uint8_cnt 0 0 0.0 255.0 ECU_ADDRESS 0x0000 /* @ECU_Address@VTPM_LRS2_cnt@ */ /end MEASUREMENT
/begin MEASUREMENT VTPM_RFS2_cnt "" UBYTE SWC_FDC_type_CM_uint8_cnt 0 0 0.0 255.0 ECU_ADDRESS 0x0000 /* @ECU_Address@VTPM_RFS2_cnt@ */ /end MEASUREMENT
/begin MEASUREMENT VTPM_ID4messageALTU_raw8 "" UBYTE SWC_FDC_type_CM_uint8_raw8 0 0 0.0 255.0 ECU_ADDRESS 0x0000 /* @ECU_Address@VTPM_ID4messageALTU_raw8@ */ /end MEASUREMENT
/begin MEASUREMENT VTPM_ID3messageALTU_raw8 "" UBYTE SWC_FDC_type_CM_uint8_raw8 0 0 0.0 255.0 ECU_ADDRESS 0x0000 /* @ECU_Address@VTPM_ID3messageALTU_raw8@ */ /end MEASUREMENT
/begin MEASUREMENT VTPM_ID2messageALTU_raw8 "" UBYTE SWC_FDC_type_CM_uint8_raw8 0 0 0.0 255.0 ECU_ADDRESS 0x0000 /* @ECU_Address@VTPM_ID2messageALTU_raw8@ */ /end MEASUREMENT
/begin MEASUREMENT VTPM_ID1messageALTU_raw8 "" UBYTE SWC_FDC_type_CM_uint8_raw8 0 0 0.0 255.0 ECU_ADDRESS 0x0000 /* @ECU_Address@VTPM_ID1messageALTU_raw8@ */ /end MEASUREMENT
/begin MEASUREMENT VTPM_ManuTPMSStorge_flg "" UBYTE SWC_FDC_type_CM_boolean_flg 0 0 0.0 1.0 ECU_ADDRESS 0x0000 /* @ECU_Address@VTPM_ManuTPMSStorge_flg@ */ /end MEASUREMENT
/begin MEASUREMENT VVMC_LFWhlSkid_flg "" UBYTE SWC_FDC_type_CM_boolean_flg 0 0 0.0 1.0 ECU_ADDRESS 0x0000 /* @ECU_Address@VVMC_LFWhlSkid_flg@ */ /end MEASUREMENT
/begin MEASUREMENT VVMC_RFWhlSkid_flg "" UBYTE SWC_FDC_type_CM_boolean_flg 0 0 0.0 1.0 ECU_ADDRESS 0x0000 /* @ECU_Address@VVMC_RFWhlSkid_flg@ */ /end MEASUREMENT
/begin MEASUREMENT VVMC_LRWhlSkid_flg "" UBYTE SWC_FDC_type_CM_boolean_flg 0 0 0.0 1.0 ECU_ADDRESS 0x0000 /* @ECU_Address@VVMC_LRWhlSkid_flg@ */ /end MEASUREMENT
/begin MEASUREMENT VVMC_RRWhlSkid_flg "" UBYTE SWC_FDC_type_CM_boolean_flg 0 0 0.0 1.0 ECU_ADDRESS 0x0000 /* @ECU_Address@VVMC_RRWhlSkid_flg@ */ /end MEASUREMENT
/begin MEASUREMENT VTQD_OPDHoldRelPedTq_flg "" UBYTE SWC_FDC_type_CM_boolean_flg 0 0 0.0 1.0 ECU_ADDRESS 0x0000 /* @ECU_Address@VTQD_OPDHoldRelPedTq_flg@ */ /end MEASUREMENT
/begin COMPU_METHOD SWC_FDC_type_CM_uint8_enum "Q = V" RAT_FUNC "%3.0" "enum" COEFFS 0 1 0 0 0 1 /end COMPU_METHOD
/begin COMPU_METHOD SWC_FDC_type_CM_single_kph "Q = V" RAT_FUNC "%8.6" "kph" COEFFS 0 1 0 0 0 1 /end COMPU_METHOD
/begin COMPU_METHOD SWC_FDC_type_CM_single_Gps "Q = V" RAT_FUNC "%8.6" "Gps" COEFFS 0 1 0 0 0 1 /end COMPU_METHOD
/begin COMPU_METHOD SWC_FDC_type_CM_single_c "Q = V" RAT_FUNC "%8.6" "c" COEFFS 0 1 0 0 0 1 /end COMPU_METHOD
/begin COMPU_METHOD SWC_FDC_type_CM_single_pct "Q = V" RAT_FUNC "%8.6" "pct" COEFFS 0 1 0 0 0 1 /end COMPU_METHOD
/begin COMPU_METHOD SWC_FDC_type_CM_single_Deg "Q = V" RAT_FUNC "%8.6" "Deg" COEFFS 0 1 0 0 0 1 /end COMPU_METHOD
/begin COMPU_METHOD SWC_FDC_type_CM_single_rpm "Q = V" RAT_FUNC "%8.6" "rpm" COEFFS 0 1 0 0 0 1 /end COMPU_METHOD
/begin COMPU_METHOD SWC_FDC_type_CM_single_Nm "Q = V" RAT_FUNC "%8.6" "Nm" COEFFS 0 1 0 0 0 1 /end COMPU_METHOD
/begin COMPU_METHOD SWC_FDC_type_CM_boolean_flg "Q = V" RAT_FUNC "%1.0" "flg" COEFFS 0 1 0 0 0 1 /end COMPU_METHOD
/begin COMPU_METHOD SWC_FDC_type_CM_uint8_cnt "Q = V" RAT_FUNC "%3.0" "cnt" COEFFS 0 1 0 0 0 1 /end COMPU_METHOD
/begin COMPU_METHOD SWC_FDC_type_CM_uint8_raw8 "Q = V" RAT_FUNC "%3.0" "raw8" COEFFS 0 1 0 0 0 1 /end COMPU_METHOD
/begin COMPU_METHOD SWC_FDC_type_CM_uint32_cnt "Q = V" RAT_FUNC "%10.0" "cnt" COEFFS 0 1 0 0 0 1 /end COMPU_METHOD
/begin COMPU_METHOD SWC_FDC_type_CM_uint32_raw "Q = V" RAT_FUNC "%10.0" "raw" COEFFS 0 1 0 0 0 1 /end COMPU_METHOD
/begin COMPU_METHOD SWC_FDC_type_CM_int16_raw16 "Q = V" RAT_FUNC "%5.0" "raw16" COEFFS 0 1 0 0 0 1 /end COMPU_METHOD
/begin GROUP S1679_VTQR_ECOREDURateLimitInc_Nm "SWC_FDC_type/run_SWC_FDC_RxTx_5ms_sys/APP/TQR/Determine Torque Request/TorqueArbitrament/TorqueSmooth/Rear wheel rate limit determination/VTQR_ECOREDURateLimitInc_Nm"
 /begin SUB_GROUP S1843_Invalid S1843_LV1 S1843_LV2 S1843_LV3 S1843_LV4 S1843_LV5 S1843_OPD /end SUB_GROUP
 /begin REF_CHARACTERISTIC KTQR_EnEcoRrIncGain_enum MTQR_ECO2TqRrIncGain_Z_c MTQR_ECO3TqRrIncGain_Z_c MTQR_ECO4TqRrIncGain_Z_c MTQR_ECO5TqRrIncGain_Z_c MTQR_ECOOPDTqRrIncGain_Z_c MTQR_EcoTqRrIncGain_Z_c /end REF_CHARACTERISTIC
 /begin REF_MEASUREMENT VTQR_ECO2TqRrIncGain_c VTQR_ECO3TqRrIncGain_c VTQR_ECO4TqRrIncGain_c VTQR_ECO5TqRrIncGain_c VTQR_ECOOPDTqRrIncGain_c VTQR_EcoTqRrIncGain_c /end REF_MEASUREMENT
/end GROUP
/begin GROUP S1679_VTQR_ESCAPEREDURateLimitDec_Nm "SWC_FDC_type/run_SWC_FDC_RxTx_5ms_sys/APP/TQR/Determine Torque Request/TorqueArbitrament/TorqueSmooth/Rear wheel rate limit determination/VTQR_ESCAPEREDURateLimitDec_Nm" /begin REF_CHARACTERISTIC MTQR_ESCAPEREDUTqDecSR_Z_Nm /end REF_CHARACTERISTIC /end GROUP
/begin GROUP S1679_VTQR_ESCAPEREDURateLimitInc_Nm "SWC_FDC_type/run_SWC_FDC_RxTx_5ms_sys/APP/TQR/Determine Torque Request/TorqueArbitrament/TorqueSmooth/Rear wheel rate limit determination/VTQR_ESCAPEREDURateLimitInc_Nm" /begin REF_CHARACTERISTIC MTQR_ESCAPEREDUTqIncSR_Z_Nm /end REF_CHARACTERISTIC /end GROUP
/begin GROUP S1679_VTQR_LHMREDURateLimitDec_Nm "SWC_FDC_type/run_SWC_FDC_RxTx_5ms_sys/APP/TQR/Determine Torque Request/TorqueArbitrament/TorqueSmooth/Rear wheel rate limit determination/VTQR_LHMREDURateLimitDec_Nm" /begin REF_CHARACTERISTIC MTQR_LHMREDUTqDecSR_Z_Nm /end REF_CHARACTERISTIC /end GROUP
/begin GROUP S1679_VTQR_LHMREDURateLimitInc_Nm "SWC_FDC_type/run_SWC_FDC_RxTx_5ms_sys/APP/TQR/Determine Torque Request/TorqueArbitrament/TorqueSmooth/Rear wheel rate limit determination/VTQR_LHMREDURateLimitInc_Nm" /begin REF_CHARACTERISTIC MTQR_LHMREDUTqIncSR_Z_Nm /end REF_CHARACTERISTIC /end GROUP
/begin GROUP S1679_VTQR_NORMALREDURateLimitDec_Nm "SWC_FDC_type/run_SWC_FDC_RxTx_5ms_sys/APP/TQR/Determine Torque Request/TorqueArbitrament/TorqueSmooth/Rear wheel rate limit determination/VTQR_NORMALREDURateLimitDec_Nm"
 /begin SUB_GROUP S1848_Invalid S1848_LV1 S1848_LV2 S1848_LV3 S1848_LV4 S1848_LV5 S1848_OPD /end SUB_GROUP
/end GROUP
/begin GROUP S1679_VTQR_NORMALREDURateLimitInc_Nm "SWC_FDC_type/run_SWC_FDC_RxTx_5ms_sys/APP/TQR/Determine Torque Request/TorqueArbitrament/TorqueSmooth/Rear wheel rate limit determination/VTQR_NORMALREDURateLimitInc_Nm"
 /begin SUB_GROUP S1849_Invalid S1849_LV1 S1849_LV2 S1849_LV3 S1849_LV4 S1849_LV5 S1849_OPD /end SUB_GROUP
 /begin REF_CHARACTERISTIC KTQR_EnNormalRrIncGain_enum MTQR_NL2TqRrIncGain_Z_c MTQR_NL3TqRrIncGain_Z_c MTQR_NL4TqRrIncGain_Z_c MTQR_NL5TqRrIncGain_Z_c MTQR_NLOPDTqRrIncGain_Z_c MTQR_NormalTqRrIncGain_Z_c /end REF_CHARACTERISTIC
 /begin REF_MEASUREMENT VTQR_NL2TqRrIncGain_c VTQR_NL3TqRrIncGain_c VTQR_NL4TqRrIncGain_c VTQR_NL5TqRrIncGain_c VTQR_NLOPDTqRrIncGain_c VTQR_NormalTqRrIncGain_c /end REF_MEASUREMENT
/end GROUP
/begin GROUP S1679_VTQR_SNOWREDURateLimitDec_Nm "SWC_FDC_type/run_SWC_FDC_RxTx_5ms_sys/APP/TQR/Determine Torque Request/TorqueArbitrament/TorqueSmooth/Rear wheel rate limit determination/VTQR_SNOWREDURateLimitDec_Nm" /begin REF_CHARACTERISTIC MTQR_SNOWREDUTqDecSR_Z_Nm /end REF_CHARACTERISTIC /end GROUP
/begin GROUP S1679_VTQR_SNOWREDURateLimitInc_Nm "SWC_FDC_type/run_SWC_FDC_RxTx_5ms_sys/APP/TQR/Determine Torque Request/TorqueArbitrament/TorqueSmooth/Rear wheel rate limit determination/VTQR_SNOWREDURateLimitInc_Nm" /begin REF_CHARACTERISTIC MTQR_SNOWREDUTqIncSR_Z_Nm /end REF_CHARACTERISTIC /end GROUP
/begin GROUP S1679_VTQR_SPORTREDURateLimitDec_Nm "SWC_FDC_type/run_SWC_FDC_RxTx_5ms_sys/APP/TQR/Determine Torque Request/TorqueArbitrament/TorqueSmooth/Rear wheel rate limit determination/VTQR_SPORTREDURateLimitDec_Nm"
 /begin SUB_GROUP S1852_Invalid S1852_LV1 S1852_LV2 S1852_LV3 S1852_LV4 S1852_LV5 S1852_OPD /end SUB_GROUP
/end GROUP
/begin GROUP S1679_VTQR_SPORTREDURateLimitInc_Nm "SWC_FDC_type/run_SWC_FDC_RxTx_5ms_sys/APP/TQR/Determine Torque Request/TorqueArbitrament/TorqueSmooth/Rear wheel rate limit determination/VTQR_SPORTREDURateLimitInc_Nm"
 /begin SUB_GROUP S1853_Invalid S1853_LV1 S1853_LV2 S1853_LV3 S1853_LV4 S1853_LV5 S1853_OPD /end SUB_GROUP
 /begin REF_CHARACTERISTIC KTQR_EnSportRrIncGain_enum MTQR_Sport2TqRrIncGain_Z_c MTQR_Sport3TqRrIncGain_Z_c MTQR_Sport4TqRrIncGain_Z_c MTQR_Sport5TqRrIncGain_Z_c MTQR_SportOPDTqRrIncGain_Z_c MTQR_SportTqRrIncGain_Z_c /end REF_CHARACTERISTIC
 /begin REF_MEASUREMENT VTQR_Sport2TqRrIncGain_c VTQR_Sport3TqRrIncGain_c VTQR_Sport4TqRrIncGain_c VTQR_Sport5TqRrIncGain_c VTQR_SportOPDTqRrIncGain_c VTQR_SportTqRrIncGain_c /end REF_MEASUREMENT
/end GROUP
/begin GROUP S1679_VTQR_TCSREDURateLimitDec_Nm "SWC_FDC_type/run_SWC_FDC_RxTx_5ms_sys/APP/TQR/Determine Torque Request/TorqueArbitrament/TorqueSmooth/Rear wheel rate limit determination/VTQR_TCSREDURateLimitDec_Nm" /begin REF_CHARACTERISTIC MTQR_TCSREDUTqDecSR_Z_Nm /end REF_CHARACTERISTIC /end GROUP
/begin GROUP S1679_VTQR_TCSREDURateLimitInc_Nm "SWC_FDC_type/run_SWC_FDC_RxTx_5ms_sys/APP/TQR/Determine Torque Request/TorqueArbitrament/TorqueSmooth/Rear wheel rate limit determination/VTQR_TCSREDURateLimitInc_Nm" /begin REF_CHARACTERISTIC MTQR_TCSREDUTqIncSR_Z_Nm /end REF_CHARACTERISTIC /end GROUP
/begin GROUP S2152_FirstOrderFilter "SWC_FDC_type/run_SWC_FDC_RxTx_5ms_sys/APP/VMC/VMC/Slide Rate  Calculation/4Wheel Calculation/LF Wheel/FirstOrderFilter" /begin REF_MEASUREMENT VVMC_LFWhlCalAcc_Gps /end REF_MEASUREMENT /end GROUP
/begin GROUP S2152_SR_Latch "SWC_FDC_type/run_SWC_FDC_RxTx_5ms_sys/APP/VMC/VMC/Slide Rate  Calculation/4Wheel Calculation/LF Wheel/SR_Latch" /begin REF_MEASUREMENT VVMC_LFWhlSkid_flg /end REF_MEASUREMENT /end GROUP
/begin GROUP S2153_FirstOrderFilter2 "SWC_FDC_type/run_SWC_FDC_RxTx_5ms_sys/APP/VMC/VMC/Slide Rate  Calculation/4Wheel Calculation/LR Wheel/FirstOrderFilter2" /begin REF_MEASUREMENT VVMC_LRWhlCalAcc_Gps /end REF_MEASUREMENT /end GROUP
/begin GROUP S2153_SR_Latch2 "SWC_FDC_type/run_SWC_FDC_RxTx_5ms_sys/APP/VMC/VMC/Slide Rate  Calculation/4Wheel Calculation/LR Wheel/SR_Latch2" /begin REF_MEASUREMENT VVMC_LRWhlSkid_flg /end REF_MEASUREMENT /end GROUP
/begin GROUP S2154_FirstOrderFilter1 "SWC_FDC_type/run_SWC_FDC_RxTx_5ms_sys/APP/VMC/VMC/Slide Rate  Calculation/4Wheel Calculation/RF Wheel/FirstOrderFilter1" /begin REF_MEASUREMENT VVMC_RFWhlCalAcc_Gps /end REF_MEASUREMENT /end GROUP
/begin GROUP S2154_SR_Latch1 "SWC_FDC_type/run_SWC_FDC_RxTx_5ms_sys/APP/VMC/VMC/Slide Rate  Calculation/4Wheel Calculation/RF Wheel/SR_Latch1" /begin REF_MEASUREMENT VVMC_RFWhlSkid_flg /end REF_MEASUREMENT /end GROUP
/begin GROUP S2155_FirstOrderFilter3 "SWC_FDC_type/run_SWC_FDC_RxTx_5ms_sys/APP/VMC/VMC/Slide Rate  Calculation/4Wheel Calculation/RR Wheel/FirstOrderFilter3" /begin REF_MEASUREMENT VVMC_RRWhlCalAcc_Gps /end REF_MEASUREMENT /end GROUP
/begin GROUP S2155_SR_Latch3 "SWC_FDC_type/run_SWC_FDC_RxTx_5ms_sys/APP/VMC/VMC/Slide Rate  Calculation/4Wheel Calculation/RR Wheel/SR_Latch3" /begin REF_MEASUREMENT VVMC_RRWhlSkid_flg /end REF_MEASUREMENT /end GROUP
/begin GROUP S1066_Acceptancerate "SWC_FDC_type/run_SWC_FDC_RxTx_5ms_sys/APP/TPM/TPMS/TPMS/Learn/AutoLocation/IDIdentify/Acceptancerate"
 /begin REF_MEASUREMENT VTPM_ID1messageALTU_raw8 VTPM_ID2messageALTU_raw8 VTPM_ID3messageALTU_raw8 VTPM_ID4messageALTU_raw8 VTPM_S1WheelDebugALTU_pct VTPM_S2WheelDebugALTU_pct VTPM_S3WheelDebugALTU_pct VTPM_S4WheelDebugALTU_pct /end REF_MEASUREMENT
/end GROUP
/begin GROUP S1066_Subsystem1 "SWC_FDC_type/run_SWC_FDC_RxTx_5ms_sys/APP/TPM/TPMS/TPMS/Learn/AutoLocation/IDIdentify/Subsystem1"
 /begin SUB_GROUP S1086_Enabled_Subsystem1 S1086_Enabled_Subsystem2 S1086_Enabled_Subsystem3 S1086_Enabled_Subsystem5 /end SUB_GROUP
 /begin REF_MEASUREMENT VTPM_GS2_cnt /end REF_MEASUREMENT
/end GROUP
/begin GROUP S1066_Subsystem2 "SWC_FDC_type/run_SWC_FDC_RxTx_5ms_sys/APP/TPM/TPMS/TPMS/Learn/AutoLocation/IDIdentify/Subsystem2"
 /begin SUB_GROUP S1087_Enabled_Subsystem1 S1087_Enabled_Subsystem2 S1087_Enabled_Subsystem3 S1087_Enabled_Subsystem5 /end SUB_GROUP
 /begin REF_MEASUREMENT VTPM_GS3_cnt /end REF_MEASUREMENT
/end GROUP
/begin GROUP S1066_Subsystem3 "SWC_FDC_type/run_SWC_FDC_RxTx_5ms_sys/APP/TPM/TPMS/TPMS/Learn/AutoLocation/IDIdentify/Subsystem3"
 /begin SUB_GROUP S1088_Enabled_Subsystem1 S1088_Enabled_Subsystem2 S1088_Enabled_Subsystem3 S1088_Enabled_Subsystem5 /end SUB_GROUP
 /begin REF_MEASUREMENT VTPM_GS4_cnt /end REF_MEASUREMENT
/end GROUP
/begin GROUP S1066_Subsystem7 "SWC_FDC_type/run_SWC_FDC_RxTx_5ms_sys/APP/TPM/TPMS/TPMS/Learn/AutoLocation/IDIdentify/Subsystem7"
 /begin SUB_GROUP S1089_Enabled_Subsystem1 S1089_Enabled_Subsystem2 S1089_Enabled_Subsystem3 S1089_Enabled_Subsystem5 /end SUB_GROUP
 /begin REF_MEASUREMENT VTPM_GS1_cnt /end REF_MEASUREMENT
/end GROUP
/begin GROUP S1069_Subsystem "SWC_FDC_type/run_SWC_FDC_RxTx_5ms_sys/APP/TPM/TPMS/TPMS/Learn/AutoLocation/Subsystem1/Subsystem"
 /begin REF_MEASUREMENT VTPM_MLFID_raw VTPM_MLRID_raw VTPM_MRFID_raw VTPM_MRRID_raw VTPM_MSensor1ID_raw VTPM_MSensor2ID_raw VTPM_MSensor3ID_raw VTPM_MSensor4ID_raw VTPM_ManuTPMSStorge_flg /end REF_MEASUREMENT
/end GROUP
/begin GROUP S1070_Subsystem "SWC_FDC_type/run_SWC_FDC_RxTx_5ms_sys/APP/TPM/TPMS/TPMS/Learn/AutoLocation/WheelPosition/Subsystem" /begin REF_CHARACTERISTIC KTPM_Delay_raw8 /end REF_CHARACTERISTIC /begin REF_MEASUREMENT VTPM_LFWP_raw16 /end REF_MEASUREMENT /end GROUP
/begin GROUP S1070_Subsystem1 "SWC_FDC_type/run_SWC_FDC_RxTx_5ms_sys/APP/TPM/TPMS/TPMS/Learn/AutoLocation/WheelPosition/Subsystem1" /begin REF_CHARACTERISTIC KTPM_Delay_raw8 /end REF_CHARACTERISTIC /begin REF_MEASUREMENT VTPM_RFWP_raw16 /end REF_MEASUREMENT /end GROUP
/begin GROUP S1070_Subsystem2 "SWC_FDC_type/run_SWC_FDC_RxTx_5ms_sys/APP/TPM/TPMS/TPMS/Learn/AutoLocation/WheelPosition/Subsystem2" /begin REF_CHARACTERISTIC KTPM_Delay_raw8 /end REF_CHARACTERISTIC /begin REF_MEASUREMENT VTPM_LRWP_raw16 /end REF_MEASUREMENT /end GROUP
/begin GROUP S1070_Subsystem3 "SWC_FDC_type/run_SWC_FDC_RxTx_5ms_sys/APP/TPM/TPMS/TPMS/Learn/AutoLocation/WheelPosition/Subsystem3" /begin REF_CHARACTERISTIC KTPM_Delay_raw8 /end REF_CHARACTERISTIC /begin REF_MEASUREMENT VTPM_RRWP_raw16 /end REF_MEASUREMENT /end GROUP
/begin GROUP S1550_ShiftD "SWC_FDC_type/run_SWC_FDC_RxTx_5ms_sys/APP/TQD/TorqueDemand/TorqueModule/DriverWhlTqDem/PedalMapWhlTq/NoLHM/ShiftD"
 /begin SUB_GROUP S1562_LUT_D_ECO S1562_LUT_D_EscapeMode S1562_LUT_D_Normal S1562_LUT_D_SnowMode S1562_LUT_D_Sport /end SUB_GROUP
 /begin REF_CHARACTERISTIC MTQD_RL1TqMapDComp_Z_Nm MTQD_RL2TqMapDComp_Z_Nm MTQD_RL3TqMapDComp_Z_Nm MTQD_RL4TqMapDComp_Z_Nm MTQD_RL5TqMapDComp_Z_Nm /end REF_CHARACTERISTIC
 /begin REF_MEASUREMENT VTQD_RL1TqMapDComp_Nm VTQD_RL2TqMapDComp_Nm VTQD_RL3TqMapDComp_Nm VTQD_RL4TqMapDComp_Nm VTQD_RL5TqMapDComp_Nm /end REF_MEASUREMENT
/end GROUP
/begin GROUP S1550_ShiftR "SWC_FDC_type/run_SWC_FDC_RxTx_5ms_sys/APP/TQD/TorqueDemand/TorqueModule/DriverWhlTqDem/PedalMapWhlTq/NoLHM/ShiftR" /begin REF_CHARACTERISTIC MTQD_NRMTqMapR_Z_Nm /end REF_CHARACTERISTIC /end GROUP
/begin GROUP S1682_Invalid "SWC_FDC_type/run_SWC_FDC_RxTx_5ms_sys/APP/TQR/Determine Torque Request/TorqueArbitrament/TorqueSmooth/Front First order filter input tau map and determination/VTQR_ECOFEDUTs_c/Invalid" /begin REF_CHARACTERISTIC MTQR_EL1FEDUTs_Z_c MTQR_FEDUEL1RegenTs_Y_c /end REF_CHARACTERISTIC /end GROUP
/begin GROUP S1682_LV1 "SWC_FDC_type/run_SWC_FDC_RxTx_5ms_sys/APP/TQR/Determine Torque Request/TorqueArbitrament/TorqueSmooth/Front First order filter input tau map and determination/VTQR_ECOFEDUTs_c/LV1" /begin REF_CHARACTERISTIC MTQR_EL1FEDUTs_Z_c MTQR_FEDUEL1RegenTs_Y_c /end REF_CHARACTERISTIC /end GROUP
/begin GROUP S1682_LV2 "SWC_FDC_type/run_SWC_FDC_RxTx_5ms_sys/APP/TQR/Determine Torque Request/TorqueArbitrament/TorqueSmooth/Front First order filter input tau map and determination/VTQR_ECOFEDUTs_c/LV2" /begin REF_CHARACTERISTIC MTQR_EL2FEDUTs_Z_c /end REF_CHARACTERISTIC /end GROUP
/begin GROUP S1682_LV3 "SWC_FDC_type/run_SWC_FDC_RxTx_5ms_sys/APP/TQR/Determine Torque Request/TorqueArbitrament/TorqueSmooth/Front First order filter input tau map and determination/VTQR_ECOFEDUTs_c/LV3" /begin REF_CHARACTERISTIC MTQR_EL3FEDUTs_Z_c /end REF_CHARACTERISTIC /end GROUP
/begin GROUP S1682_LV4 "SWC_FDC_type/run_SWC_FDC_RxTx_5ms_sys/APP/TQR/Determine Torque Request/TorqueArbitrament/TorqueSmooth/Front First order filter input tau map and determination/VTQR_ECOFEDUTs_c/LV4" /begin REF_CHARACTERISTIC MTQR_EL4FEDUTs_Z_c /end REF_CHARACTERISTIC /end GROUP
/begin GROUP S1682_LV5 "SWC_FDC_type/run_SWC_FDC_RxTx_5ms_sys/APP/TQR/Determine Torque Request/TorqueArbitrament/TorqueSmooth/Front First order filter input tau map and determination/VTQR_ECOFEDUTs_c/LV5" /begin REF_CHARACTERISTIC MTQR_EL5FEDUTs_Z_c /end REF_CHARACTERISTIC /end GROUP
/begin GROUP S1682_OPD "SWC_FDC_type/run_SWC_FDC_RxTx_5ms_sys/APP/TQR/Determine Torque Request/TorqueArbitrament/TorqueSmooth/Front First order filter input tau map and determination/VTQR_ECOFEDUTs_c/OPD" /begin REF_CHARACTERISTIC MTQR_EOPDFEDUTs_Z_c /end REF_CHARACTERISTIC /end GROUP
/begin GROUP S1685_Invalid "SWC_FDC_type/run_SWC_FDC_RxTx_5ms_sys/APP/TQR/Determine Torque Request/TorqueArbitrament/TorqueSmooth/Front First order filter input tau map and determination/VTQR_NORMALFEDUTs_c/Invalid" /begin REF_CHARACTERISTIC MTQR_NL1FEDUTs_Z_c /end REF_CHARACTERISTIC /end GROUP
/begin GROUP S1685_LV1 "SWC_FDC_type/run_SWC_FDC_RxTx_5ms_sys/APP/TQR/Determine Torque Request/TorqueArbitrament/TorqueSmooth/Front First order filter input tau map and determination/VTQR_NORMALFEDUTs_c/LV1" /begin REF_CHARACTERISTIC MTQR_NL1FEDUTs_Z_c /end REF_CHARACTERISTIC /end GROUP
/begin GROUP S1685_LV2 "SWC_FDC_type/run_SWC_FDC_RxTx_5ms_sys/APP/TQR/Determine Torque Request/TorqueArbitrament/TorqueSmooth/Front First order filter input tau map and determination/VTQR_NORMALFEDUTs_c/LV2" /begin REF_CHARACTERISTIC MTQR_NL2FEDUTs_Z_c /end REF_CHARACTERISTIC /end GROUP
/begin GROUP S1685_LV3 "SWC_FDC_type/run_SWC_FDC_RxTx_5ms_sys/APP/TQR/Determine Torque Request/TorqueArbitrament/TorqueSmooth/Front First order filter input tau map and determination/VTQR_NORMALFEDUTs_c/LV3" /begin REF_CHARACTERISTIC MTQR_NL3FEDUTs_Z_c /end REF_CHARACTERISTIC /end GROUP
/begin GROUP S1685_LV4 "SWC_FDC_type/run_SWC_FDC_RxTx_5ms_sys/APP/TQR/Determine Torque Request/TorqueArbitrament/TorqueSmooth/Front First order filter input tau map and determination/VTQR_NORMALFEDUTs_c/LV4" /begin REF_CHARACTERISTIC MTQR_NL4FEDUTs_Z_c /end REF_CHARACTERISTIC /end GROUP
/begin GROUP S1685_LV5 "SWC_FDC_type/run_SWC_FDC_RxTx_5ms_sys/APP/TQR/Determine Torque Request/TorqueArbitrament/TorqueSmooth/Front First order filter input tau map and determination/VTQR_NORMALFEDUTs_c/LV5" /begin REF_CHARACTERISTIC MTQR_NL5FEDUTs_Z_c /end REF_CHARACTERISTIC /end GROUP
/begin GROUP S1685_OPD "SWC_FDC_type/run_SWC_FDC_RxTx_5ms_sys/APP/TQR/Determine Torque Request/TorqueArbitrament/TorqueSmooth/Front First order filter input tau map and determination/VTQR_NORMALFEDUTs_c/OPD" /begin REF_CHARACTERISTIC MTQR_NOPDFEDUTs_Z_c /end REF_CHARACTERISTIC /end GROUP
/begin GROUP S1687_Invalid "SWC_FDC_type/run_SWC_FDC_RxTx_5ms_sys/APP/TQR/Determine Torque Request/TorqueArbitrament/TorqueSmooth/Front First order filter input tau map and determination/VTQR_SPORTFEDUTs_c/Invalid" /begin REF_CHARACTERISTIC MTQR_SL1FEDUTs_Z_c /end REF_CHARACTERISTIC /end GROUP
/begin GROUP S1687_LV1 "SWC_FDC_type/run_SWC_FDC_RxTx_5ms_sys/APP/TQR/Determine Torque Request/TorqueArbitrament/TorqueSmooth/Front First order filter input tau map and determination/VTQR_SPORTFEDUTs_c/LV1" /begin REF_CHARACTERISTIC MTQR_SL1FEDUTs_Z_c /end REF_CHARACTERISTIC /end GROUP
/begin GROUP S1687_LV2 "SWC_FDC_type/run_SWC_FDC_RxTx_5ms_sys/APP/TQR/Determine Torque Request/TorqueArbitrament/TorqueSmooth/Front First order filter input tau map and determination/VTQR_SPORTFEDUTs_c/LV2" /begin REF_CHARACTERISTIC MTQR_SL2FEDUTs_Z_c /end REF_CHARACTERISTIC /end GROUP
/begin GROUP S1687_LV3 "SWC_FDC_type/run_SWC_FDC_RxTx_5ms_sys/APP/TQR/Determine Torque Request/TorqueArbitrament/TorqueSmooth/Front First order filter input tau map and determination/VTQR_SPORTFEDUTs_c/LV3" /begin REF_CHARACTERISTIC MTQR_SL3FEDUTs_Z_c /end REF_CHARACTERISTIC /end GROUP
/begin GROUP S1687_LV4 "SWC_FDC_type/run_SWC_FDC_RxTx_5ms_sys/APP/TQR/Determine Torque Request/TorqueArbitrament/TorqueSmooth/Front First order filter input tau map and determination/VTQR_SPORTFEDUTs_c/LV4" /begin REF_CHARACTERISTIC MTQR_SL4FEDUTs_Z_c /end REF_CHARACTERISTIC /end GROUP
/begin GROUP S1687_LV5 "SWC_FDC_type/run_SWC_FDC_RxTx_5ms_sys/APP/TQR/Determine Torque Request/TorqueArbitrament/TorqueSmooth/Front First order filter input tau map and determination/VTQR_SPORTFEDUTs_c/LV5" /begin REF_CHARACTERISTIC MTQR_SL5FEDUTs_Z_c /end REF_CHARACTERISTIC /end GROUP
/begin GROUP S1687_OPD "SWC_FDC_type/run_SWC_FDC_RxTx_5ms_sys/APP/TQR/Determine Torque Request/TorqueArbitrament/TorqueSmooth/Front First order filter input tau map and determination/VTQR_SPORTFEDUTs_c/OPD" /begin REF_CHARACTERISTIC MTQR_SOPDFEDUTs_Z_c /end REF_CHARACTERISTIC /end GROUP
/begin GROUP S1722_VTQR_FrNegRateLimitDecE_Nm "SWC_FDC_type/run_SWC_FDC_RxTx_5ms_sys/APP/TQR/Determine Torque Request/TorqueArbitrament/TorqueSmooth/Front wheel rate limit determination/Negative Rate limit Determination/VTQR_FrNegRateLimitDecE_Nm" /begin REF_CHARACTERISTIC MTQR_FrNegRateLimitDecE_Z_Nm /end REF_CHARACTERISTIC /end GROUP
/begin GROUP S1722_VTQR_FrNegRateLimitDecN_Nm "SWC_FDC_type/run_SWC_FDC_RxTx_5ms_sys/APP/TQR/Determine Torque Request/TorqueArbitrament/TorqueSmooth/Front wheel rate limit determination/Negative Rate limit Determination/VTQR_FrNegRateLimitDecN_Nm" /begin REF_CHARACTERISTIC MTQR_FrNegRateLimitDecN_Z_Nm /end REF_CHARACTERISTIC /end GROUP
/begin GROUP S1722_VTQR_FrNegRateLimitDecS_Nm "SWC_FDC_type/run_SWC_FDC_RxTx_5ms_sys/APP/TQR/Determine Torque Request/TorqueArbitrament/TorqueSmooth/Front wheel rate limit determination/Negative Rate limit Determination/VTQR_FrNegRateLimitDecS_Nm" /begin REF_CHARACTERISTIC MTQR_FrNegRateLimitDecS_Z_Nm /end REF_CHARACTERISTIC /end GROUP
/begin GROUP S1722_VTQR_FrNegRateLimitIncE_Nm "SWC_FDC_type/run_SWC_FDC_RxTx_5ms_sys/APP/TQR/Determine Torque Request/TorqueArbitrament/TorqueSmooth/Front wheel rate limit determination/Negative Rate limit Determination/VTQR_FrNegRateLimitIncE_Nm" /begin REF_CHARACTERISTIC MTQR_FrNegRateLimitIncE_Z_Nm /end REF_CHARACTERISTIC /end GROUP
/begin GROUP S1722_VTQR_FrNegRateLimitIncN_Nm "SWC_FDC_type/run_SWC_FDC_RxTx_5ms_sys/APP/TQR/Determine Torque Request/TorqueArbitrament/TorqueSmooth/Front wheel rate limit determination/Negative Rate limit Determination/VTQR_FrNegRateLimitIncN_Nm" /begin REF_CHARACTERISTIC MTQR_FrNegRateLimitIncN_Z_Nm /end REF_CHARACTERISTIC /end GROUP
/begin GROUP S1722_VTQR_FrNegRateLimitIncS_Nm "SWC_FDC_type/run_SWC_FDC_RxTx_5ms_sys/APP/TQR/Determine Torque Request/TorqueArbitrament/TorqueSmooth/Front wheel rate limit determination/Negative Rate limit Determination/VTQR_FrNegRateLimitIncS_Nm" /begin REF_CHARACTERISTIC MTQR_FrNegRateLimitIncS_Z_Nm /end REF_CHARACTERISTIC /end GROUP
/begin GROUP S1723_VTQR_FrPosRateLimitDecE_Nm "SWC_FDC_type/run_SWC_FDC_RxTx_5ms_sys/APP/TQR/Determine Torque Request/TorqueArbitrament/TorqueSmooth/Front wheel rate limit determination/Positive Rate limit Determination/VTQR_FrPosRateLimitDecE_Nm" /begin REF_CHARACTERISTIC MTQR_FrPosRateLimitDecE_Z_Nm /end REF_CHARACTERISTIC /end GROUP
/begin GROUP S1723_VTQR_FrPosRateLimitDecN_Nm "SWC_FDC_type/run_SWC_FDC_RxTx_5ms_sys/APP/TQR/Determine Torque Request/TorqueArbitrament/TorqueSmooth/Front wheel rate limit determination/Positive Rate limit Determination/VTQR_FrPosRateLimitDecN_Nm" /begin REF_CHARACTERISTIC MTQR_FrPosRateLimitDecN_Z_Nm /end REF_CHARACTERISTIC /end GROUP
/begin GROUP S1723_VTQR_FrPosRateLimitDecS_Nm "SWC_FDC_type/run_SWC_FDC_RxTx_5ms_sys/APP/TQR/Determine Torque Request/TorqueArbitrament/TorqueSmooth/Front wheel rate limit determination/Positive Rate limit Determination/VTQR_FrPosRateLimitDecS_Nm" /begin REF_CHARACTERISTIC MTQR_FrPosRateLimitDecS_Z_Nm /end REF_CHARACTERISTIC /end GROUP
/begin GROUP S1723_VTQR_FrPosRateLimitIncE_Nm "SWC_FDC_type/run_SWC_FDC_RxTx_5ms_sys/APP/TQR/Determine Torque Request/TorqueArbitrament/TorqueSmooth/Front wheel rate limit determination/Positive Rate limit Determination/VTQR_FrPosRateLimitIncE_Nm" /begin REF_CHARACTERISTIC MTQR_FrPosRateLimitIncE_Z_Nm /end REF_CHARACTERISTIC /end GROUP
/begin GROUP S1723_VTQR_FrPosRateLimitIncN_Nm "SWC_FDC_type/run_SWC_FDC_RxTx_5ms_sys/APP/TQR/Determine Torque Request/TorqueArbitrament/TorqueSmooth/Front wheel rate limit determination/Positive Rate limit Determination/VTQR_FrPosRateLimitIncN_Nm" /begin REF_CHARACTERISTIC MTQR_FrPosRateLimitIncN_Z_Nm /end REF_CHARACTERISTIC /end GROUP
/begin GROUP S1723_VTQR_FrPosRateLimitIncS_Nm "SWC_FDC_type/run_SWC_FDC_RxTx_5ms_sys/APP/TQR/Determine Torque Request/TorqueArbitrament/TorqueSmooth/Front wheel rate limit determination/Positive Rate limit Determination/VTQR_FrPosRateLimitIncS_Nm" /begin REF_CHARACTERISTIC MTQR_FrPosRateLimitIncS_Z_Nm /end REF_CHARACTERISTIC /end GROUP
/begin GROUP S1726_Invalid "SWC_FDC_type/run_SWC_FDC_RxTx_5ms_sys/APP/TQR/Determine Torque Request/TorqueArbitrament/TorqueSmooth/Front wheel rate limit determination/VTQR_ECOFEDURateLimitDec_Nm/Invalid" /begin REF_CHARACTERISTIC MTQR_EL1FEDUTqDecSR_Z_Nm /end REF_CHARACTERISTIC /end GROUP
/begin GROUP S1726_LV1 "SWC_FDC_type/run_SWC_FDC_RxTx_5ms_sys/APP/TQR/Determine Torque Request/TorqueArbitrament/TorqueSmooth/Front wheel rate limit determination/VTQR_ECOFEDURateLimitDec_Nm/LV1" /begin REF_CHARACTERISTIC MTQR_EL1FEDUTqDecSR_Z_Nm /end REF_CHARACTERISTIC /end GROUP
/begin GROUP S1726_LV2 "SWC_FDC_type/run_SWC_FDC_RxTx_5ms_sys/APP/TQR/Determine Torque Request/TorqueArbitrament/TorqueSmooth/Front wheel rate limit determination/VTQR_ECOFEDURateLimitDec_Nm/LV2" /begin REF_CHARACTERISTIC MTQR_EL2FEDUTqDecSR_Z_Nm /end REF_CHARACTERISTIC /end GROUP
/begin GROUP S1726_LV3 "SWC_FDC_type/run_SWC_FDC_RxTx_5ms_sys/APP/TQR/Determine Torque Request/TorqueArbitrament/TorqueSmooth/Front wheel rate limit determination/VTQR_ECOFEDURateLimitDec_Nm/LV3" /begin REF_CHARACTERISTIC MTQR_EL3FEDUTqDecSR_Z_Nm /end REF_CHARACTERISTIC /end GROUP
/begin GROUP S1726_LV4 "SWC_FDC_type/run_SWC_FDC_RxTx_5ms_sys/APP/TQR/Determine Torque Request/TorqueArbitrament/TorqueSmooth/Front wheel rate limit determination/VTQR_ECOFEDURateLimitDec_Nm/LV4" /begin REF_CHARACTERISTIC MTQR_EL4FEDUTqDecSR_Z_Nm /end REF_CHARACTERISTIC /end GROUP
/begin GROUP S1726_LV5 "SWC_FDC_type/run_SWC_FDC_RxTx_5ms_sys/APP/TQR/Determine Torque Request/TorqueArbitrament/TorqueSmooth/Front wheel rate limit determination/VTQR_ECOFEDURateLimitDec_Nm/LV5" /begin REF_CHARACTERISTIC MTQR_EL5FEDUTqDecSR_Z_Nm /end REF_CHARACTERISTIC /end GROUP
/begin GROUP S1726_OPD "SWC_FDC_type/run_SWC_FDC_RxTx_5ms_sys/APP/TQR/Determine Torque Request/TorqueArbitrament/TorqueSmooth/Front wheel rate limit determination/VTQR_ECOFEDURateLimitDec_Nm/OPD" /begin REF_CHARACTERISTIC MTQR_EOPDFEDUTqDecSR_Z_Nm /end REF_CHARACTERISTIC /end GROUP
/begin GROUP S1727_Invalid "SWC_FDC_type/run_SWC_FDC_RxTx_5ms_sys/APP/TQR/Determine Torque Request/TorqueArbitrament/TorqueSmooth/Front wheel rate limit determination/VTQR_ECOFEDURateLimitInc_Nm/Invalid" /begin REF_CHARACTERISTIC MTQR_EL1FEDUTqIncSR_Z_Nm /end REF_CHARACTERISTIC /end GROUP
/begin GROUP S1727_LV1 "SWC_FDC_type/run_SWC_FDC_RxTx_5ms_sys/APP/TQR/Determine Torque Request/TorqueArbitrament/TorqueSmooth/Front wheel rate limit determination/VTQR_ECOFEDURateLimitInc_Nm/LV1" /begin REF_CHARACTERISTIC MTQR_EL1FEDUTqIncSR_Z_Nm /end REF_CHARACTERISTIC /end GROUP
/begin GROUP S1727_LV2 "SWC_FDC_type/run_SWC_FDC_RxTx_5ms_sys/APP/TQR/Determine Torque Request/TorqueArbitrament/TorqueSmooth/Front wheel rate limit determination/VTQR_ECOFEDURateLimitInc_Nm/LV2" /begin REF_CHARACTERISTIC KTQR_FrTqIncGainSW_flg MTQR_EL2FEDUTqIncSR_Z_Nm /end REF_CHARACTERISTIC /end GROUP
/begin GROUP S1727_LV3 "SWC_FDC_type/run_SWC_FDC_RxTx_5ms_sys/APP/TQR/Determine Torque Request/TorqueArbitrament/TorqueSmooth/Front wheel rate limit determination/VTQR_ECOFEDURateLimitInc_Nm/LV3" /begin REF_CHARACTERISTIC KTQR_FrTqIncGainSW_flg MTQR_EL3FEDUTqIncSR_Z_Nm /end REF_CHARACTERISTIC /end GROUP
/begin GROUP S1727_LV4 "SWC_FDC_type/run_SWC_FDC_RxTx_5ms_sys/APP/TQR/Determine Torque Request/TorqueArbitrament/TorqueSmooth/Front wheel rate limit determination/VTQR_ECOFEDURateLimitInc_Nm/LV4" /begin REF_CHARACTERISTIC KTQR_FrTqIncGainSW_flg MTQR_EL4FEDUTqIncSR_Z_Nm /end REF_CHARACTERISTIC /end GROUP
/begin GROUP S1727_LV5 "SWC_FDC_type/run_SWC_FDC_RxTx_5ms_sys/APP/TQR/Determine Torque Request/TorqueArbitrament/TorqueSmooth/Front wheel rate limit determination/VTQR_ECOFEDURateLimitInc_Nm/LV5" /begin REF_CHARACTERISTIC KTQR_FrTqIncGainSW_flg MTQR_EL5FEDUTqIncSR_Z_Nm /end REF_CHARACTERISTIC /end GROUP
/begin GROUP S1727_OPD "SWC_FDC_type/run_SWC_FDC_RxTx_5ms_sys/APP/TQR/Determine Torque Request/TorqueArbitrament/TorqueSmooth/Front wheel rate limit determination/VTQR_ECOFEDURateLimitInc_Nm/OPD" /begin REF_CHARACTERISTIC KTQR_FrTqIncGainSW_flg MTQR_EOPDFEDUTqIncSR_Z_Nm /end REF_CHARACTERISTIC /end GROUP
/begin GROUP S1732_Invalid "SWC_FDC_type/run_SWC_FDC_RxTx_5ms_sys/APP/TQR/Determine Torque Request/TorqueArbitrament/TorqueSmooth/Front wheel rate limit determination/VTQR_NORMALFEDURateLimitDec_Nm/Invalid" /begin REF_CHARACTERISTIC MTQR_NL1FEDUTqDecSR_Z_Nm /end REF_CHARACTERISTIC /end GROUP
/begin GROUP S1732_LV1 "SWC_FDC_type/run_SWC_FDC_RxTx_5ms_sys/APP/TQR/Determine Torque Request/TorqueArbitrament/TorqueSmooth/Front wheel rate limit determination/VTQR_NORMALFEDURateLimitDec_Nm/LV1" /begin REF_CHARACTERISTIC MTQR_NL1FEDUTqDecSR_Z_Nm /end REF_CHARACTERISTIC /end GROUP
/begin GROUP S1732_LV2 "SWC_FDC_type/run_SWC_FDC_RxTx_5ms_sys/APP/TQR/Determine Torque Request/TorqueArbitrament/TorqueSmooth/Front wheel rate limit determination/VTQR_NORMALFEDURateLimitDec_Nm/LV2" /begin REF_CHARACTERISTIC MTQR_NL2FEDUTqDecSR_Z_Nm /end REF_CHARACTERISTIC /end GROUP
/begin GROUP S1732_LV3 "SWC_FDC_type/run_SWC_FDC_RxTx_5ms_sys/APP/TQR/Determine Torque Request/TorqueArbitrament/TorqueSmooth/Front wheel rate limit determination/VTQR_NORMALFEDURateLimitDec_Nm/LV3" /begin REF_CHARACTERISTIC MTQR_NL3FEDUTqDecSR_Z_Nm /end REF_CHARACTERISTIC /end GROUP
/begin GROUP S1732_LV4 "SWC_FDC_type/run_SWC_FDC_RxTx_5ms_sys/APP/TQR/Determine Torque Request/TorqueArbitrament/TorqueSmooth/Front wheel rate limit determination/VTQR_NORMALFEDURateLimitDec_Nm/LV4" /begin REF_CHARACTERISTIC MTQR_NL4FEDUTqDecSR_Z_Nm /end REF_CHARACTERISTIC /end GROUP
/begin GROUP S1732_LV5 "SWC_FDC_type/run_SWC_FDC_RxTx_5ms_sys/APP/TQR/Determine Torque Request/TorqueArbitrament/TorqueSmooth/Front wheel rate limit determination/VTQR_NORMALFEDURateLimitDec_Nm/LV5" /begin REF_CHARACTERISTIC MTQR_NL5FEDUTqDecSR_Z_Nm /end REF_CHARACTERISTIC /end GROUP
/begin GROUP S1732_OPD "SWC_FDC_type/run_SWC_FDC_RxTx_5ms_sys/APP/TQR/Determine Torque Request/TorqueArbitrament/TorqueSmooth/Front wheel rate limit determination/VTQR_NORMALFEDURateLimitDec_Nm/OPD" /begin REF_CHARACTERISTIC MTQR_NOPDFEDUTqDecSR_Z_Nm /end REF_CHARACTERISTIC /end GROUP
/begin GROUP S1733_Invalid "SWC_FDC_type/run_SWC_FDC_RxTx_5ms_sys/APP/TQR/Determine Torque Request/TorqueArbitrament/TorqueSmooth/Front wheel rate limit determination/VTQR_NORMALFEDURateLimitInc_Nm/Invalid" /begin REF_CHARACTERISTIC MTQR_NL1FEDUTqIncSR_Z_Nm /end REF_CHARACTERISTIC /end GROUP
/begin GROUP S1733_LV1 "SWC_FDC_type/run_SWC_FDC_RxTx_5ms_sys/APP/TQR/Determine Torque Request/TorqueArbitrament/TorqueSmooth/Front wheel rate limit determination/VTQR_NORMALFEDURateLimitInc_Nm/LV1" /begin REF_CHARACTERISTIC MTQR_NL1FEDUTqIncSR_Z_Nm /end REF_CHARACTERISTIC /end GROUP
/begin GROUP S1733_LV2 "SWC_FDC_type/run_SWC_FDC_RxTx_5ms_sys/APP/TQR/Determine Torque Request/TorqueArbitrament/TorqueSmooth/Front wheel rate limit determination/VTQR_NORMALFEDURateLimitInc_Nm/LV2" /begin REF_CHARACTERISTIC KTQR_FrTqIncGainSW_flg MTQR_NL2FEDUTqIncSR_Z_Nm /end REF_CHARACTERISTIC /end GROUP
/begin GROUP S1733_LV3 "SWC_FDC_type/run_SWC_FDC_RxTx_5ms_sys/APP/TQR/Determine Torque Request/TorqueArbitrament/TorqueSmooth/Front wheel rate limit determination/VTQR_NORMALFEDURateLimitInc_Nm/LV3" /begin REF_CHARACTERISTIC KTQR_FrTqIncGainSW_flg MTQR_NL3FEDUTqIncSR_Z_Nm /end REF_CHARACTERISTIC /end GROUP
/begin GROUP S1733_LV4 "SWC_FDC_type/run_SWC_FDC_RxTx_5ms_sys/APP/TQR/Determine Torque Request/TorqueArbitrament/TorqueSmooth/Front wheel rate limit determination/VTQR_NORMALFEDURateLimitInc_Nm/LV4" /begin REF_CHARACTERISTIC KTQR_FrTqIncGainSW_flg MTQR_NL4FEDUTqIncSR_Z_Nm /end REF_CHARACTERISTIC /end GROUP
/begin GROUP S1733_LV5 "SWC_FDC_type/run_SWC_FDC_RxTx_5ms_sys/APP/TQR/Determine Torque Request/TorqueArbitrament/TorqueSmooth/Front wheel rate limit determination/VTQR_NORMALFEDURateLimitInc_Nm/LV5" /begin REF_CHARACTERISTIC KTQR_FrTqIncGainSW_flg MTQR_NL5FEDUTqIncSR_Z_Nm /end REF_CHARACTERISTIC /end GROUP
/begin GROUP S1733_OPD "SWC_FDC_type/run_SWC_FDC_RxTx_5ms_sys/APP/TQR/Determine Torque Request/TorqueArbitrament/TorqueSmooth/Front wheel rate limit determination/VTQR_NORMALFEDURateLimitInc_Nm/OPD" /begin REF_CHARACTERISTIC KTQR_FrTqIncGainSW_flg MTQR_NOPDFEDUTqIncSR_Z_Nm /end REF_CHARACTERISTIC /end GROUP
/begin GROUP S1736_Invalid "SWC_FDC_type/run_SWC_FDC_RxTx_5ms_sys/APP/TQR/Determine Torque Request/TorqueArbitrament/TorqueSmooth/Front wheel rate limit determination/VTQR_SPORTFEDURateLimitDec_Nm/Invalid" /begin REF_CHARACTERISTIC MTQR_SL1FEDUTqDecSR_Z_Nm /end REF_CHARACTERISTIC /end GROUP
/begin GROUP S1736_LV1 "SWC_FDC_type/run_SWC_FDC_RxTx_5ms_sys/APP/TQR/Determine Torque Request/TorqueArbitrament/TorqueSmooth/Front wheel rate limit determination/VTQR_SPORTFEDURateLimitDec_Nm/LV1" /begin REF_CHARACTERISTIC MTQR_SL1FEDUTqDecSR_Z_Nm /end REF_CHARACTERISTIC /end GROUP
/begin GROUP S1736_LV2 "SWC_FDC_type/run_SWC_FDC_RxTx_5ms_sys/APP/TQR/Determine Torque Request/TorqueArbitrament/TorqueSmooth/Front wheel rate limit determination/VTQR_SPORTFEDURateLimitDec_Nm/LV2" /begin REF_CHARACTERISTIC MTQR_SL2FEDUTqDecSR_Z_Nm /end REF_CHARACTERISTIC /end GROUP
/begin GROUP S1736_LV3 "SWC_FDC_type/run_SWC_FDC_RxTx_5ms_sys/APP/TQR/Determine Torque Request/TorqueArbitrament/TorqueSmooth/Front wheel rate limit determination/VTQR_SPORTFEDURateLimitDec_Nm/LV3" /begin REF_CHARACTERISTIC MTQR_SL3FEDUTqDecSR_Z_Nm /end REF_CHARACTERISTIC /end GROUP
/begin GROUP S1736_LV4 "SWC_FDC_type/run_SWC_FDC_RxTx_5ms_sys/APP/TQR/Determine Torque Request/TorqueArbitrament/TorqueSmooth/Front wheel rate limit determination/VTQR_SPORTFEDURateLimitDec_Nm/LV4" /begin REF_CHARACTERISTIC MTQR_SL4FEDUTqDecSR_Z_Nm /end REF_CHARACTERISTIC /end GROUP
/begin GROUP S1736_LV5 "SWC_FDC_type/run_SWC_FDC_RxTx_5ms_sys/APP/TQR/Determine Torque Request/TorqueArbitrament/TorqueSmooth/Front wheel rate limit determination/VTQR_SPORTFEDURateLimitDec_Nm/LV5" /begin REF_CHARACTERISTIC MTQR_SL5FEDUTqDecSR_Z_Nm /end REF_CHARACTERISTIC /end GROUP
/begin GROUP S1736_OPD "SWC_FDC_type/run_SWC_FDC_RxTx_5ms_sys/APP/TQR/Determine Torque Request/TorqueArbitrament/TorqueSmooth/Front wheel rate limit determination/VTQR_SPORTFEDURateLimitDec_Nm/OPD" /begin REF_CHARACTERISTIC MTQR_SOPDFEDUTqDecSR_Z_Nm /end REF_CHARACTERISTIC /end GROUP
/begin GROUP S1737_Invalid "SWC_FDC_type/run_SWC_FDC_RxTx_5ms_sys/APP/TQR/Determine Torque Request/TorqueArbitrament/TorqueSmooth/Front wheel rate limit determination/VTQR_SPORTFEDURateLimitInc_Nm/Invalid" /begin REF_CHARACTERISTIC MTQR_SL1FEDUTqIncSR_Z_Nm /end REF_CHARACTERISTIC /end GROUP
/begin GROUP S1737_LV1 "SWC_FDC_type/run_SWC_FDC_RxTx_5ms_sys/APP/TQR/Determine Torque Request/TorqueArbitrament/TorqueSmooth/Front wheel rate limit determination/VTQR_SPORTFEDURateLimitInc_Nm/LV1" /begin REF_CHARACTERISTIC MTQR_SL1FEDUTqIncSR_Z_Nm /end REF_CHARACTERISTIC /end GROUP
/begin GROUP S1737_LV2 "SWC_FDC_type/run_SWC_FDC_RxTx_5ms_sys/APP/TQR/Determine Torque Request/TorqueArbitrament/TorqueSmooth/Front wheel rate limit determination/VTQR_SPORTFEDURateLimitInc_Nm/LV2" /begin REF_CHARACTERISTIC KTQR_FrTqIncGainSW_flg MTQR_SL2FEDUTqIncSR_Z_Nm /end REF_CHARACTERISTIC /end GROUP
/begin GROUP S1737_LV3 "SWC_FDC_type/run_SWC_FDC_RxTx_5ms_sys/APP/TQR/Determine Torque Request/TorqueArbitrament/TorqueSmooth/Front wheel rate limit determination/VTQR_SPORTFEDURateLimitInc_Nm/LV3" /begin REF_CHARACTERISTIC KTQR_FrTqIncGainSW_flg MTQR_SL3FEDUTqIncSR_Z_Nm /end REF_CHARACTERISTIC /end GROUP
/begin GROUP S1737_LV4 "SWC_FDC_type/run_SWC_FDC_RxTx_5ms_sys/APP/TQR/Determine Torque Request/TorqueArbitrament/TorqueSmooth/Front wheel rate limit determination/VTQR_SPORTFEDURateLimitInc_Nm/LV4" /begin REF_CHARACTERISTIC KTQR_FrTqIncGainSW_flg MTQR_SL4FEDUTqIncSR_Z_Nm /end REF_CHARACTERISTIC /end GROUP
/begin GROUP S1737_LV5 "SWC_FDC_type/run_SWC_FDC_RxTx_5ms_sys/APP/TQR/Determine Torque Request/TorqueArbitrament/TorqueSmooth/Front wheel rate limit determination/VTQR_SPORTFEDURateLimitInc_Nm/LV5" /begin REF_CHARACTERISTIC KTQR_FrTqIncGainSW_flg MTQR_SL5FEDUTqIncSR_Z_Nm /end REF_CHARACTERISTIC /end GROUP
/begin GROUP S1737_OPD "SWC_FDC_type/run_SWC_FDC_RxTx_5ms_sys/APP/TQR/Determine Torque Request/TorqueArbitrament/TorqueSmooth/Front wheel rate limit determination/VTQR_SPORTFEDURateLimitInc_Nm/OPD" /begin REF_CHARACTERISTIC KTQR_FrTqIncGainSW_flg MTQR_SOPDFEDUTqIncSR_Z_Nm /end REF_CHARACTERISTIC /end GROUP
/begin GROUP S1796_Invalid "SWC_FDC_type/run_SWC_FDC_RxTx_5ms_sys/APP/TQR/Determine Torque Request/TorqueArbitrament/TorqueSmooth/Rear First order filter input tau map and determination/VTQR_ECOREDUTs_c/Invalid" /begin REF_CHARACTERISTIC MTQR_EL1REDUTs_Z_c MTQR_REDUEL1RegenTs_Y_c /end REF_CHARACTERISTIC /end GROUP
/begin GROUP S1796_LV1 "SWC_FDC_type/run_SWC_FDC_RxTx_5ms_sys/APP/TQR/Determine Torque Request/TorqueArbitrament/TorqueSmooth/Rear First order filter input tau map and determination/VTQR_ECOREDUTs_c/LV1" /begin REF_CHARACTERISTIC MTQR_EL1REDUTs_Z_c MTQR_REDUEL1RegenTs_Y_c /end REF_CHARACTERISTIC /end GROUP
/begin GROUP S1796_LV2 "SWC_FDC_type/run_SWC_FDC_RxTx_5ms_sys/APP/TQR/Determine Torque Request/TorqueArbitrament/TorqueSmooth/Rear First order filter input tau map and determination/VTQR_ECOREDUTs_c/LV2" /begin REF_CHARACTERISTIC MTQR_EL2REDUTs_Z_c /end REF_CHARACTERISTIC /end GROUP
/begin GROUP S1796_LV3 "SWC_FDC_type/run_SWC_FDC_RxTx_5ms_sys/APP/TQR/Determine Torque Request/TorqueArbitrament/TorqueSmooth/Rear First order filter input tau map and determination/VTQR_ECOREDUTs_c/LV3" /begin REF_CHARACTERISTIC MTQR_EL3REDUTs_Z_c /end REF_CHARACTERISTIC /end GROUP
/begin GROUP S1796_LV4 "SWC_FDC_type/run_SWC_FDC_RxTx_5ms_sys/APP/TQR/Determine Torque Request/TorqueArbitrament/TorqueSmooth/Rear First order filter input tau map and determination/VTQR_ECOREDUTs_c/LV4" /begin REF_CHARACTERISTIC MTQR_EL4REDUTs_Z_c /end REF_CHARACTERISTIC /end GROUP
/begin GROUP S1796_LV5 "SWC_FDC_type/run_SWC_FDC_RxTx_5ms_sys/APP/TQR/Determine Torque Request/TorqueArbitrament/TorqueSmooth/Rear First order filter input tau map and determination/VTQR_ECOREDUTs_c/LV5" /begin REF_CHARACTERISTIC MTQR_EL5REDUTs_Z_c /end REF_CHARACTERISTIC /end GROUP
/begin GROUP S1796_OPD "SWC_FDC_type/run_SWC_FDC_RxTx_5ms_sys/APP/TQR/Determine Torque Request/TorqueArbitrament/TorqueSmooth/Rear First order filter input tau map and determination/VTQR_ECOREDUTs_c/OPD" /begin REF_CHARACTERISTIC MTQR_EOPDREDUTs_Z_c /end REF_CHARACTERISTIC /end GROUP
/begin GROUP S1799_Invalid "SWC_FDC_type/run_SWC_FDC_RxTx_5ms_sys/APP/TQR/Determine Torque Request/TorqueArbitrament/TorqueSmooth/Rear First order filter input tau map and determination/VTQR_NORMALREDUTs_c/Invalid" /begin REF_CHARACTERISTIC MTQR_NL1REDUTs_Z_c /end REF_CHARACTERISTIC /end GROUP
/begin GROUP S1799_LV1 "SWC_FDC_type/run_SWC_FDC_RxTx_5ms_sys/APP/TQR/Determine Torque Request/TorqueArbitrament/TorqueSmooth/Rear First order filter input tau map and determination/VTQR_NORMALREDUTs_c/LV1" /begin REF_CHARACTERISTIC MTQR_NL1REDUTs_Z_c /end REF_CHARACTERISTIC /end GROUP
/begin GROUP S1799_LV2 "SWC_FDC_type/run_SWC_FDC_RxTx_5ms_sys/APP/TQR/Determine Torque Request/TorqueArbitrament/TorqueSmooth/Rear First order filter input tau map and determination/VTQR_NORMALREDUTs_c/LV2" /begin REF_CHARACTERISTIC MTQR_NL2REDUTs_Z_c /end REF_CHARACTERISTIC /end GROUP
/begin GROUP S1799_LV3 "SWC_FDC_type/run_SWC_FDC_RxTx_5ms_sys/APP/TQR/Determine Torque Request/TorqueArbitrament/TorqueSmooth/Rear First order filter input tau map and determination/VTQR_NORMALREDUTs_c/LV3" /begin REF_CHARACTERISTIC MTQR_NL3REDUTs_Z_c /end REF_CHARACTERISTIC /end GROUP
/begin GROUP S1799_LV4 "SWC_FDC_type/run_SWC_FDC_RxTx_5ms_sys/APP/TQR/Determine Torque Request/TorqueArbitrament/TorqueSmooth/Rear First order filter input tau map and determination/VTQR_NORMALREDUTs_c/LV4" /begin REF_CHARACTERISTIC MTQR_NL4REDUTs_Z_c /end REF_CHARACTERISTIC /end GROUP
/begin GROUP S1799_LV5 "SWC_FDC_type/run_SWC_FDC_RxTx_5ms_sys/APP/TQR/Determine Torque Request/TorqueArbitrament/TorqueSmooth/Rear First order filter input tau map and determination/VTQR_NORMALREDUTs_c/LV5" /begin REF_CHARACTERISTIC MTQR_NL5REDUTs_Z_c /end REF_CHARACTERISTIC /end GROUP
/begin GROUP S1799_OPD "SWC_FDC_type/run_SWC_FDC_RxTx_5ms_sys/APP/TQR/Determine Torque Request/TorqueArbitrament/TorqueSmooth/Rear First order filter input tau map and determination/VTQR_NORMALREDUTs_c/OPD" /begin REF_CHARACTERISTIC MTQR_NOPDREDUTs_Z_c /end REF_CHARACTERISTIC /end GROUP
/begin GROUP S1801_Invalid "SWC_FDC_type/run_SWC_FDC_RxTx_5ms_sys/APP/TQR/Determine Torque Request/TorqueArbitrament/TorqueSmooth/Rear First order filter input tau map and determination/VTQR_SPORTREDUTs_c/Invalid" /begin REF_CHARACTERISTIC MTQR_SL1REDUTs_Z_c /end REF_CHARACTERISTIC /end GROUP
/begin GROUP S1801_LV1 "SWC_FDC_type/run_SWC_FDC_RxTx_5ms_sys/APP/TQR/Determine Torque Request/TorqueArbitrament/TorqueSmooth/Rear First order filter input tau map and determination/VTQR_SPORTREDUTs_c/LV1" /begin REF_CHARACTERISTIC MTQR_SL1REDUTs_Z_c /end REF_CHARACTERISTIC /end GROUP
/begin GROUP S1801_LV2 "SWC_FDC_type/run_SWC_FDC_RxTx_5ms_sys/APP/TQR/Determine Torque Request/TorqueArbitrament/TorqueSmooth/Rear First order filter input tau map and determination/VTQR_SPORTREDUTs_c/LV2" /begin REF_CHARACTERISTIC MTQR_SL2REDUTs_Z_c /end REF_CHARACTERISTIC /end GROUP
/begin GROUP S1801_LV3 "SWC_FDC_type/run_SWC_FDC_RxTx_5ms_sys/APP/TQR/Determine Torque Request/TorqueArbitrament/TorqueSmooth/Rear First order filter input tau map and determination/VTQR_SPORTREDUTs_c/LV3" /begin REF_CHARACTERISTIC MTQR_SL3REDUTs_Z_c /end REF_CHARACTERISTIC /end GROUP
/begin GROUP S1801_LV4 "SWC_FDC_type/run_SWC_FDC_RxTx_5ms_sys/APP/TQR/Determine Torque Request/TorqueArbitrament/TorqueSmooth/Rear First order filter input tau map and determination/VTQR_SPORTREDUTs_c/LV4" /begin REF_CHARACTERISTIC MTQR_SL4REDUTs_Z_c /end REF_CHARACTERISTIC /end GROUP
/begin GROUP S1801_LV5 "SWC_FDC_type/run_SWC_FDC_RxTx_5ms_sys/APP/TQR/Determine Torque Request/TorqueArbitrament/TorqueSmooth/Rear First order filter input tau map and determination/VTQR_SPORTREDUTs_c/LV5" /begin REF_CHARACTERISTIC MTQR_SL5REDUTs_Z_c /end REF_CHARACTERISTIC /end GROUP
/begin GROUP S1801_OPD "SWC_FDC_type/run_SWC_FDC_RxTx_5ms_sys/APP/TQR/Determine Torque Request/TorqueArbitrament/TorqueSmooth/Rear First order filter input tau map and determination/VTQR_SPORTREDUTs_c/OPD" /begin REF_CHARACTERISTIC MTQR_SOPDREDUTs_Z_c /end REF_CHARACTERISTIC /end GROUP
/begin GROUP S1837_VTQR_RrNegRateLimitDecE_Nm "SWC_FDC_type/run_SWC_FDC_RxTx_5ms_sys/APP/TQR/Determine Torque Request/TorqueArbitrament/TorqueSmooth/Rear wheel rate limit determination/Negative Rate limit Determination/VTQR_RrNegRateLimitDecE_Nm" /begin REF_CHARACTERISTIC MTQR_RrNegRateLimitDecE_Z_Nm /end REF_CHARACTERISTIC /end GROUP
/begin GROUP S1837_VTQR_RrNegRateLimitDecN_Nm "SWC_FDC_type/run_SWC_FDC_RxTx_5ms_sys/APP/TQR/Determine Torque Request/TorqueArbitrament/TorqueSmooth/Rear wheel rate limit determination/Negative Rate limit Determination/VTQR_RrNegRateLimitDecN_Nm" /begin REF_CHARACTERISTIC MTQR_RrNegRateLimitDecN_Z_Nm /end REF_CHARACTERISTIC /end GROUP
/begin GROUP S1837_VTQR_RrNegRateLimitDecS_Nm "SWC_FDC_type/run_SWC_FDC_RxTx_5ms_sys/APP/TQR/Determine Torque Request/TorqueArbitrament/TorqueSmooth/Rear wheel rate limit determination/Negative Rate limit Determination/VTQR_RrNegRateLimitDecS_Nm" /begin REF_CHARACTERISTIC MTQR_RrNegRateLimitDecS_Z_Nm /end REF_CHARACTERISTIC /end GROUP
/begin GROUP S1837_VTQR_RrNegRateLimitIncE_Nm "SWC_FDC_type/run_SWC_FDC_RxTx_5ms_sys/APP/TQR/Determine Torque Request/TorqueArbitrament/TorqueSmooth/Rear wheel rate limit determination/Negative Rate limit Determination/VTQR_RrNegRateLimitIncE_Nm" /begin REF_CHARACTERISTIC MTQR_RrNegRateLimitIncE_Z_Nm /end REF_CHARACTERISTIC /end GROUP
/begin GROUP S1837_VTQR_RrNegRateLimitIncN_Nm "SWC_FDC_type/run_SWC_FDC_RxTx_5ms_sys/APP/TQR/Determine Torque Request/TorqueArbitrament/TorqueSmooth/Rear wheel rate limit determination/Negative Rate limit Determination/VTQR_RrNegRateLimitIncN_Nm" /begin REF_CHARACTERISTIC MTQR_RrNegRateLimitIncN_Z_Nm /end REF_CHARACTERISTIC /end GROUP
/begin GROUP S1837_VTQR_RrNegRateLimitIncS_Nm "SWC_FDC_type/run_SWC_FDC_RxTx_5ms_sys/APP/TQR/Determine Torque Request/TorqueArbitrament/TorqueSmooth/Rear wheel rate limit determination/Negative Rate limit Determination/VTQR_RrNegRateLimitIncS_Nm" /begin REF_CHARACTERISTIC MTQR_RrNegRateLimitIncS_Z_Nm /end REF_CHARACTERISTIC /end GROUP
/begin GROUP S1838_VTQR_RrPosRateLimitDecE_Nm "SWC_FDC_type/run_SWC_FDC_RxTx_5ms_sys/APP/TQR/Determine Torque Request/TorqueArbitrament/TorqueSmooth/Rear wheel rate limit determination/Positive Rate limit Determination/VTQR_RrPosRateLimitDecE_Nm" /begin REF_CHARACTERISTIC MTQR_RrPosRateLimitDecE_Z_Nm /end REF_CHARACTERISTIC /end GROUP
/begin GROUP S1838_VTQR_RrPosRateLimitDecN_Nm "SWC_FDC_type/run_SWC_FDC_RxTx_5ms_sys/APP/TQR/Determine Torque Request/TorqueArbitrament/TorqueSmooth/Rear wheel rate limit determination/Positive Rate limit Determination/VTQR_RrPosRateLimitDecN_Nm" /begin REF_CHARACTERISTIC MTQR_RrPosRateLimitDecN_Z_Nm /end REF_CHARACTERISTIC /end GROUP
/begin GROUP S1838_VTQR_RrPosRateLimitDecS_Nm "SWC_FDC_type/run_SWC_FDC_RxTx_5ms_sys/APP/TQR/Determine Torque Request/TorqueArbitrament/TorqueSmooth/Rear wheel rate limit determination/Positive Rate limit Determination/VTQR_RrPosRateLimitDecS_Nm" /begin REF_CHARACTERISTIC MTQR_RrPosRateLimitDecS_Z_Nm /end REF_CHARACTERISTIC /end GROUP
/begin GROUP S1838_VTQR_RrPosRateLimitIncE_Nm "SWC_FDC_type/run_SWC_FDC_RxTx_5ms_sys/APP/TQR/Determine Torque Request/TorqueArbitrament/TorqueSmooth/Rear wheel rate limit determination/Positive Rate limit Determination/VTQR_RrPosRateLimitIncE_Nm" /begin REF_CHARACTERISTIC MTQR_RrPosRateLimitIncE_Z_Nm /end REF_CHARACTERISTIC /end GROUP
/begin GROUP S1838_VTQR_RrPosRateLimitIncN_Nm "SWC_FDC_type/run_SWC_FDC_RxTx_5ms_sys/APP/TQR/Determine Torque Request/TorqueArbitrament/TorqueSmooth/Rear wheel rate limit determination/Positive Rate limit Determination/VTQR_RrPosRateLimitIncN_Nm" /begin REF_CHARACTERISTIC MTQR_RrPosRateLimitIncN_Z_Nm /end REF_CHARACTERISTIC /end GROUP
/begin GROUP S1838_VTQR_RrPosRateLimitIncS_Nm "SWC_FDC_type/run_SWC_FDC_RxTx_5ms_sys/APP/TQR/Determine Torque Request/TorqueArbitrament/TorqueSmooth/Rear wheel rate limit determination/Positive Rate limit Determination/VTQR_RrPosRateLimitIncS_Nm" /begin REF_CHARACTERISTIC MTQR_RrPosRateLimitIncS_Z_Nm /end REF_CHARACTERISTIC /end GROUP
/begin GROUP S1842_Invalid "SWC_FDC_type/run_SWC_FDC_RxTx_5ms_sys/APP/TQR/Determine Torque Request/TorqueArbitrament/TorqueSmooth/Rear wheel rate limit determination/VTQR_ECOREDURateLimitDec_Nm/Invalid" /begin REF_CHARACTERISTIC MTQR_EL1REDUTqDecSR_Z_Nm /end REF_CHARACTERISTIC /end GROUP
/begin GROUP S1842_LV1 "SWC_FDC_type/run_SWC_FDC_RxTx_5ms_sys/APP/TQR/Determine Torque Request/TorqueArbitrament/TorqueSmooth/Rear wheel rate limit determination/VTQR_ECOREDURateLimitDec_Nm/LV1" /begin REF_CHARACTERISTIC MTQR_EL1REDUTqDecSR_Z_Nm /end REF_CHARACTERISTIC /end GROUP
/begin GROUP S1842_LV2 "SWC_FDC_type/run_SWC_FDC_RxTx_5ms_sys/APP/TQR/Determine Torque Request/TorqueArbitrament/TorqueSmooth/Rear wheel rate limit determination/VTQR_ECOREDURateLimitDec_Nm/LV2" /begin REF_CHARACTERISTIC MTQR_EL2REDUTqDecSR_Z_Nm /end REF_CHARACTERISTIC /end GROUP
/begin GROUP S1842_LV3 "SWC_FDC_type/run_SWC_FDC_RxTx_5ms_sys/APP/TQR/Determine Torque Request/TorqueArbitrament/TorqueSmooth/Rear wheel rate limit determination/VTQR_ECOREDURateLimitDec_Nm/LV3" /begin REF_CHARACTERISTIC MTQR_EL3REDUTqDecSR_Z_Nm /end REF_CHARACTERISTIC /end GROUP
/begin GROUP S1842_LV4 "SWC_FDC_type/run_SWC_FDC_RxTx_5ms_sys/APP/TQR/Determine Torque Request/TorqueArbitrament/TorqueSmooth/Rear wheel rate limit determination/VTQR_ECOREDURateLimitDec_Nm/LV4" /begin REF_CHARACTERISTIC MTQR_EL4REDUTqDecSR_Z_Nm /end REF_CHARACTERISTIC /end GROUP
/begin GROUP S1842_LV5 "SWC_FDC_type/run_SWC_FDC_RxTx_5ms_sys/APP/TQR/Determine Torque Request/TorqueArbitrament/TorqueSmooth/Rear wheel rate limit determination/VTQR_ECOREDURateLimitDec_Nm/LV5" /begin REF_CHARACTERISTIC MTQR_EL5REDUTqDecSR_Z_Nm /end REF_CHARACTERISTIC /end GROUP
/begin GROUP S1842_OPD "SWC_FDC_type/run_SWC_FDC_RxTx_5ms_sys/APP/TQR/Determine Torque Request/TorqueArbitrament/TorqueSmooth/Rear wheel rate limit determination/VTQR_ECOREDURateLimitDec_Nm/OPD" /begin REF_CHARACTERISTIC MTQR_EOPDREDUTqDecSR_Z_Nm /end REF_CHARACTERISTIC /end GROUP
/begin GROUP S1843_Invalid "SWC_FDC_type/run_SWC_FDC_RxTx_5ms_sys/APP/TQR/Determine Torque Request/TorqueArbitrament/TorqueSmooth/Rear wheel rate limit determination/VTQR_ECOREDURateLimitInc_Nm/Invalid" /begin REF_CHARACTERISTIC MTQR_EL1REDUTqIncSR_Z_Nm /end REF_CHARACTERISTIC /end GROUP
/begin GROUP S1843_LV1 "SWC_FDC_type/run_SWC_FDC_RxTx_5ms_sys/APP/TQR/Determine Torque Request/TorqueArbitrament/TorqueSmooth/Rear wheel rate limit determination/VTQR_ECOREDURateLimitInc_Nm/LV1" /begin REF_CHARACTERISTIC MTQR_EL1REDUTqIncSR_Z_Nm /end REF_CHARACTERISTIC /end GROUP
/begin GROUP S1843_LV2 "SWC_FDC_type/run_SWC_FDC_RxTx_5ms_sys/APP/TQR/Determine Torque Request/TorqueArbitrament/TorqueSmooth/Rear wheel rate limit determination/VTQR_ECOREDURateLimitInc_Nm/LV2" /begin REF_CHARACTERISTIC KTQR_RrTqIncGainSW_flg MTQR_EL2REDUTqIncSR_Z_Nm /end REF_CHARACTERISTIC /end GROUP
/begin GROUP S1843_LV3 "SWC_FDC_type/run_SWC_FDC_RxTx_5ms_sys/APP/TQR/Determine Torque Request/TorqueArbitrament/TorqueSmooth/Rear wheel rate limit determination/VTQR_ECOREDURateLimitInc_Nm/LV3" /begin REF_CHARACTERISTIC KTQR_RrTqIncGainSW_flg MTQR_EL3REDUTqIncSR_Z_Nm /end REF_CHARACTERISTIC /end GROUP
/begin GROUP S1843_LV4 "SWC_FDC_type/run_SWC_FDC_RxTx_5ms_sys/APP/TQR/Determine Torque Request/TorqueArbitrament/TorqueSmooth/Rear wheel rate limit determination/VTQR_ECOREDURateLimitInc_Nm/LV4" /begin REF_CHARACTERISTIC KTQR_RrTqIncGainSW_flg MTQR_EL4REDUTqIncSR_Z_Nm /end REF_CHARACTERISTIC /end GROUP
/begin GROUP S1843_LV5 "SWC_FDC_type/run_SWC_FDC_RxTx_5ms_sys/APP/TQR/Determine Torque Request/TorqueArbitrament/TorqueSmooth/Rear wheel rate limit determination/VTQR_ECOREDURateLimitInc_Nm/LV5" /begin REF_CHARACTERISTIC KTQR_RrTqIncGainSW_flg MTQR_EL5REDUTqIncSR_Z_Nm /end REF_CHARACTERISTIC /end GROUP
/begin GROUP S1843_OPD "SWC_FDC_type/run_SWC_FDC_RxTx_5ms_sys/APP/TQR/Determine Torque Request/TorqueArbitrament/TorqueSmooth/Rear wheel rate limit determination/VTQR_ECOREDURateLimitInc_Nm/OPD" /begin REF_CHARACTERISTIC KTQR_RrTqIncGainSW_flg MTQR_EOPDREDUTqIncSR_Z_Nm /end REF_CHARACTERISTIC /end GROUP
/begin GROUP S1848_Invalid "SWC_FDC_type/run_SWC_FDC_RxTx_5ms_sys/APP/TQR/Determine Torque Request/TorqueArbitrament/TorqueSmooth/Rear wheel rate limit determination/VTQR_NORMALREDURateLimitDec_Nm/Invalid" /begin REF_CHARACTERISTIC MTQR_NL1REDUTqDecSR_Z_Nm /end REF_CHARACTERISTIC /end GROUP
/begin GROUP S1848_LV1 "SWC_FDC_type/run_SWC_FDC_RxTx_5ms_sys/APP/TQR/Determine Torque Request/TorqueArbitrament/TorqueSmooth/Rear wheel rate limit determination/VTQR_NORMALREDURateLimitDec_Nm/LV1" /begin REF_CHARACTERISTIC MTQR_NL1REDUTqDecSR_Z_Nm /end REF_CHARACTERISTIC /end GROUP
/begin GROUP S1848_LV2 "SWC_FDC_type/run_SWC_FDC_RxTx_5ms_sys/APP/TQR/Determine Torque Request/TorqueArbitrament/TorqueSmooth/Rear wheel rate limit determination/VTQR_NORMALREDURateLimitDec_Nm/LV2" /begin REF_CHARACTERISTIC MTQR_NL2REDUTqDecSR_Z_Nm /end REF_CHARACTERISTIC /end GROUP
/begin GROUP S1848_LV3 "SWC_FDC_type/run_SWC_FDC_RxTx_5ms_sys/APP/TQR/Determine Torque Request/TorqueArbitrament/TorqueSmooth/Rear wheel rate limit determination/VTQR_NORMALREDURateLimitDec_Nm/LV3" /begin REF_CHARACTERISTIC MTQR_NL3REDUTqDecSR_Z_Nm /end REF_CHARACTERISTIC /end GROUP
/begin GROUP S1848_LV4 "SWC_FDC_type/run_SWC_FDC_RxTx_5ms_sys/APP/TQR/Determine Torque Request/TorqueArbitrament/TorqueSmooth/Rear wheel rate limit determination/VTQR_NORMALREDURateLimitDec_Nm/LV4" /begin REF_CHARACTERISTIC MTQR_NL4REDUTqDecSR_Z_Nm /end REF_CHARACTERISTIC /end GROUP
/begin GROUP S1848_LV5 "SWC_FDC_type/run_SWC_FDC_RxTx_5ms_sys/APP/TQR/Determine Torque Request/TorqueArbitrament/TorqueSmooth/Rear wheel rate limit determination/VTQR_NORMALREDURateLimitDec_Nm/LV5" /begin REF_CHARACTERISTIC MTQR_NL5REDUTqDecSR_Z_Nm /end REF_CHARACTERISTIC /end GROUP
/begin GROUP S1848_OPD "SWC_FDC_type/run_SWC_FDC_RxTx_5ms_sys/APP/TQR/Determine Torque Request/TorqueArbitrament/TorqueSmooth/Rear wheel rate limit determination/VTQR_NORMALREDURateLimitDec_Nm/OPD" /begin REF_CHARACTERISTIC MTQR_NOPDREDUTqDecSR_Z_Nm /end REF_CHARACTERISTIC /end GROUP
/begin GROUP S1849_Invalid "SWC_FDC_type/run_SWC_FDC_RxTx_5ms_sys/APP/TQR/Determine Torque Request/TorqueArbitrament/TorqueSmooth/Rear wheel rate limit determination/VTQR_NORMALREDURateLimitInc_Nm/Invalid" /begin REF_CHARACTERISTIC MTQR_NL1REDUTqIncSR_Z_Nm /end REF_CHARACTERISTIC /end GROUP
/begin GROUP S1849_LV1 "SWC_FDC_type/run_SWC_FDC_RxTx_5ms_sys/APP/TQR/Determine Torque Request/TorqueArbitrament/TorqueSmooth/Rear wheel rate limit determination/VTQR_NORMALREDURateLimitInc_Nm/LV1" /begin REF_CHARACTERISTIC MTQR_NL1REDUTqIncSR_Z_Nm /end REF_CHARACTERISTIC /end GROUP
/begin GROUP S1849_LV2 "SWC_FDC_type/run_SWC_FDC_RxTx_5ms_sys/APP/TQR/Determine Torque Request/TorqueArbitrament/TorqueSmooth/Rear wheel rate limit determination/VTQR_NORMALREDURateLimitInc_Nm/LV2" /begin REF_CHARACTERISTIC KTQR_RrTqIncGainSW_flg MTQR_NL2REDUTqIncSR_Z_Nm /end REF_CHARACTERISTIC /end GROUP
/begin GROUP S1849_LV3 "SWC_FDC_type/run_SWC_FDC_RxTx_5ms_sys/APP/TQR/Determine Torque Request/TorqueArbitrament/TorqueSmooth/Rear wheel rate limit determination/VTQR_NORMALREDURateLimitInc_Nm/LV3" /begin REF_CHARACTERISTIC KTQR_RrTqIncGainSW_flg MTQR_NL3REDUTqIncSR_Z_Nm /end REF_CHARACTERISTIC /end GROUP
/begin GROUP S1849_LV4 "SWC_FDC_type/run_SWC_FDC_RxTx_5ms_sys/APP/TQR/Determine Torque Request/TorqueArbitrament/TorqueSmooth/Rear wheel rate limit determination/VTQR_NORMALREDURateLimitInc_Nm/LV4" /begin REF_CHARACTERISTIC KTQR_RrTqIncGainSW_flg MTQR_NL4REDUTqIncSR_Z_Nm /end REF_CHARACTERISTIC /end GROUP
/begin GROUP S1849_LV5 "SWC_FDC_type/run_SWC_FDC_RxTx_5ms_sys/APP/TQR/Determine Torque Request/TorqueArbitrament/TorqueSmooth/Rear wheel rate limit determination/VTQR_NORMALREDURateLimitInc_Nm/LV5" /begin REF_CHARACTERISTIC KTQR_RrTqIncGainSW_flg MTQR_NL5REDUTqIncSR_Z_Nm /end REF_CHARACTERISTIC /end GROUP
/begin GROUP S1849_OPD "SWC_FDC_type/run_SWC_FDC_RxTx_5ms_sys/APP/TQR/Determine Torque Request/TorqueArbitrament/TorqueSmooth/Rear wheel rate limit determination/VTQR_NORMALREDURateLimitInc_Nm/OPD" /begin REF_CHARACTERISTIC KTQR_RrTqIncGainSW_flg MTQR_NOPDREDUTqIncSR_Z_Nm /end REF_CHARACTERISTIC /end GROUP
/begin GROUP S1852_Invalid "SWC_FDC_type/run_SWC_FDC_RxTx_5ms_sys/APP/TQR/Determine Torque Request/TorqueArbitrament/TorqueSmooth/Rear wheel rate limit determination/VTQR_SPORTREDURateLimitDec_Nm/Invalid" /begin REF_CHARACTERISTIC MTQR_SL1REDUTqDecSR_Z_Nm /end REF_CHARACTERISTIC /end GROUP
/begin GROUP S1852_LV1 "SWC_FDC_type/run_SWC_FDC_RxTx_5ms_sys/APP/TQR/Determine Torque Request/TorqueArbitrament/TorqueSmooth/Rear wheel rate limit determination/VTQR_SPORTREDURateLimitDec_Nm/LV1" /begin REF_CHARACTERISTIC MTQR_SL1REDUTqDecSR_Z_Nm /end REF_CHARACTERISTIC /end GROUP
/begin GROUP S1852_LV2 "SWC_FDC_type/run_SWC_FDC_RxTx_5ms_sys/APP/TQR/Determine Torque Request/TorqueArbitrament/TorqueSmooth/Rear wheel rate limit determination/VTQR_SPORTREDURateLimitDec_Nm/LV2" /begin REF_CHARACTERISTIC MTQR_SL2REDUTqDecSR_Z_Nm /end REF_CHARACTERISTIC /end GROUP
/begin GROUP S1852_LV3 "SWC_FDC_type/run_SWC_FDC_RxTx_5ms_sys/APP/TQR/Determine Torque Request/TorqueArbitrament/TorqueSmooth/Rear wheel rate limit determination/VTQR_SPORTREDURateLimitDec_Nm/LV3" /begin REF_CHARACTERISTIC MTQR_SL3REDUTqDecSR_Z_Nm /end REF_CHARACTERISTIC /end GROUP
/begin GROUP S1852_LV4 "SWC_FDC_type/run_SWC_FDC_RxTx_5ms_sys/APP/TQR/Determine Torque Request/TorqueArbitrament/TorqueSmooth/Rear wheel rate limit determination/VTQR_SPORTREDURateLimitDec_Nm/LV4" /begin REF_CHARACTERISTIC MTQR_SL4REDUTqDecSR_Z_Nm /end REF_CHARACTERISTIC /end GROUP
/begin GROUP S1852_LV5 "SWC_FDC_type/run_SWC_FDC_RxTx_5ms_sys/APP/TQR/Determine Torque Request/TorqueArbitrament/TorqueSmooth/Rear wheel rate limit determination/VTQR_SPORTREDURateLimitDec_Nm/LV5" /begin REF_CHARACTERISTIC MTQR_SL5REDUTqDecSR_Z_Nm /end REF_CHARACTERISTIC /end GROUP
/begin GROUP S1852_OPD "SWC_FDC_type/run_SWC_FDC_RxTx_5ms_sys/APP/TQR/Determine Torque Request/TorqueArbitrament/TorqueSmooth/Rear wheel rate limit determination/VTQR_SPORTREDURateLimitDec_Nm/OPD" /begin REF_CHARACTERISTIC MTQR_SOPDREDUTqDecSR_Z_Nm /end REF_CHARACTERISTIC /end GROUP
/begin GROUP S1853_Invalid "SWC_FDC_type/run_SWC_FDC_RxTx_5ms_sys/APP/TQR/Determine Torque Request/TorqueArbitrament/TorqueSmooth/Rear wheel rate limit determination/VTQR_SPORTREDURateLimitInc_Nm/Invalid" /begin REF_CHARACTERISTIC MTQR_SL1REDUTqIncSR_Z_Nm /end REF_CHARACTERISTIC /end GROUP
/begin GROUP S1853_LV1 "SWC_FDC_type/run_SWC_FDC_RxTx_5ms_sys/APP/TQR/Determine Torque Request/TorqueArbitrament/TorqueSmooth/Rear wheel rate limit determination/VTQR_SPORTREDURateLimitInc_Nm/LV1" /begin REF_CHARACTERISTIC MTQR_SL1REDUTqIncSR_Z_Nm /end REF_CHARACTERISTIC /end GROUP
/begin GROUP S1853_LV2 "SWC_FDC_type/run_SWC_FDC_RxTx_5ms_sys/APP/TQR/Determine Torque Request/TorqueArbitrament/TorqueSmooth/Rear wheel rate limit determination/VTQR_SPORTREDURateLimitInc_Nm/LV2" /begin REF_CHARACTERISTIC KTQR_RrTqIncGainSW_flg MTQR_SL2REDUTqIncSR_Z_Nm /end REF_CHARACTERISTIC /end GROUP
/begin GROUP S1853_LV3 "SWC_FDC_type/run_SWC_FDC_RxTx_5ms_sys/APP/TQR/Determine Torque Request/TorqueArbitrament/TorqueSmooth/Rear wheel rate limit determination/VTQR_SPORTREDURateLimitInc_Nm/LV3" /begin REF_CHARACTERISTIC KTQR_RrTqIncGainSW_flg MTQR_SL3REDUTqIncSR_Z_Nm /end REF_CHARACTERISTIC /end GROUP
/begin GROUP S1853_LV4 "SWC_FDC_type/run_SWC_FDC_RxTx_5ms_sys/APP/TQR/Determine Torque Request/TorqueArbitrament/TorqueSmooth/Rear wheel rate limit determination/VTQR_SPORTREDURateLimitInc_Nm/LV4" /begin REF_CHARACTERISTIC KTQR_RrTqIncGainSW_flg MTQR_SL4REDUTqIncSR_Z_Nm /end REF_CHARACTERISTIC /end GROUP
/begin GROUP S1853_LV5 "SWC_FDC_type/run_SWC_FDC_RxTx_5ms_sys/APP/TQR/Determine Torque Request/TorqueArbitrament/TorqueSmooth/Rear wheel rate limit determination/VTQR_SPORTREDURateLimitInc_Nm/LV5" /begin REF_CHARACTERISTIC KTQR_RrTqIncGainSW_flg MTQR_SL5REDUTqIncSR_Z_Nm /end REF_CHARACTERISTIC /end GROUP
/begin GROUP S1853_OPD "SWC_FDC_type/run_SWC_FDC_RxTx_5ms_sys/APP/TQR/Determine Torque Request/TorqueArbitrament/TorqueSmooth/Rear wheel rate limit determination/VTQR_SPORTREDURateLimitInc_Nm/OPD" /begin REF_CHARACTERISTIC KTQR_RrTqIncGainSW_flg MTQR_SOPDREDUTqIncSR_Z_Nm /end REF_CHARACTERISTIC /end GROUP
/begin GROUP S1086_Enabled_Subsystem1 "SWC_FDC_type/run_SWC_FDC_RxTx_5ms_sys/APP/TPM/TPMS/TPMS/Learn/AutoLocation/IDIdentify/Subsystem1/Enabled Subsystem1" /begin REF_MEASUREMENT VTPM_RFS2_cnt /end REF_MEASUREMENT /end GROUP
/begin GROUP S1086_Enabled_Subsystem2 "SWC_FDC_type/run_SWC_FDC_RxTx_5ms_sys/APP/TPM/TPMS/TPMS/Learn/AutoLocation/IDIdentify/Subsystem1/Enabled Subsystem2" /begin REF_MEASUREMENT VTPM_LRS2_cnt /end REF_MEASUREMENT /end GROUP
/begin GROUP S1086_Enabled_Subsystem3 "SWC_FDC_type/run_SWC_FDC_RxTx_5ms_sys/APP/TPM/TPMS/TPMS/Learn/AutoLocation/IDIdentify/Subsystem1/Enabled Subsystem3" /begin REF_MEASUREMENT VTPM_RRS2_cnt /end REF_MEASUREMENT /end GROUP
/begin GROUP S1086_Enabled_Subsystem5 "SWC_FDC_type/run_SWC_FDC_RxTx_5ms_sys/APP/TPM/TPMS/TPMS/Learn/AutoLocation/IDIdentify/Subsystem1/Enabled Subsystem5" /begin REF_MEASUREMENT VTPM_LFS2_cnt /end REF_MEASUREMENT /end GROUP
/begin GROUP S1087_Enabled_Subsystem1 "SWC_FDC_type/run_SWC_FDC_RxTx_5ms_sys/APP/TPM/TPMS/TPMS/Learn/AutoLocation/IDIdentify/Subsystem2/Enabled Subsystem1" /begin REF_MEASUREMENT VTPM_RFS3_cnt /end REF_MEASUREMENT /end GROUP
/begin GROUP S1087_Enabled_Subsystem2 "SWC_FDC_type/run_SWC_FDC_RxTx_5ms_sys/APP/TPM/TPMS/TPMS/Learn/AutoLocation/IDIdentify/Subsystem2/Enabled Subsystem2" /begin REF_MEASUREMENT VTPM_LRS3_cnt /end REF_MEASUREMENT /end GROUP
/begin GROUP S1087_Enabled_Subsystem3 "SWC_FDC_type/run_SWC_FDC_RxTx_5ms_sys/APP/TPM/TPMS/TPMS/Learn/AutoLocation/IDIdentify/Subsystem2/Enabled Subsystem3" /begin REF_MEASUREMENT VTPM_RRS3_cnt /end REF_MEASUREMENT /end GROUP
/begin GROUP S1087_Enabled_Subsystem5 "SWC_FDC_type/run_SWC_FDC_RxTx_5ms_sys/APP/TPM/TPMS/TPMS/Learn/AutoLocation/IDIdentify/Subsystem2/Enabled Subsystem5" /begin REF_MEASUREMENT VTPM_LFS3_cnt /end REF_MEASUREMENT /end GROUP
/begin GROUP S1088_Enabled_Subsystem1 "SWC_FDC_type/run_SWC_FDC_RxTx_5ms_sys/APP/TPM/TPMS/TPMS/Learn/AutoLocation/IDIdentify/Subsystem3/Enabled Subsystem1" /begin REF_MEASUREMENT VTPM_RFS4_cnt /end REF_MEASUREMENT /end GROUP
/begin GROUP S1088_Enabled_Subsystem2 "SWC_FDC_type/run_SWC_FDC_RxTx_5ms_sys/APP/TPM/TPMS/TPMS/Learn/AutoLocation/IDIdentify/Subsystem3/Enabled Subsystem2" /begin REF_MEASUREMENT VTPM_LRS4_cnt /end REF_MEASUREMENT /end GROUP
/begin GROUP S1088_Enabled_Subsystem3 "SWC_FDC_type/run_SWC_FDC_RxTx_5ms_sys/APP/TPM/TPMS/TPMS/Learn/AutoLocation/IDIdentify/Subsystem3/Enabled Subsystem3" /begin REF_MEASUREMENT VTPM_RRS4_cnt /end REF_MEASUREMENT /end GROUP
/begin GROUP S1088_Enabled_Subsystem5 "SWC_FDC_type/run_SWC_FDC_RxTx_5ms_sys/APP/TPM/TPMS/TPMS/Learn/AutoLocation/IDIdentify/Subsystem3/Enabled Subsystem5" /begin REF_MEASUREMENT VTPM_LFS4_cnt /end REF_MEASUREMENT /end GROUP
/begin GROUP S1089_Enabled_Subsystem1 "SWC_FDC_type/run_SWC_FDC_RxTx_5ms_sys/APP/TPM/TPMS/TPMS/Learn/AutoLocation/IDIdentify/Subsystem7/Enabled Subsystem1" /begin REF_MEASUREMENT VTPM_RFS1_cnt /end REF_MEASUREMENT /end GROUP
/begin GROUP S1089_Enabled_Subsystem2 "SWC_FDC_type/run_SWC_FDC_RxTx_5ms_sys/APP/TPM/TPMS/TPMS/Learn/AutoLocation/IDIdentify/Subsystem7/Enabled Subsystem2" /begin REF_MEASUREMENT VTPM_LRS1_cnt /end REF_MEASUREMENT /end GROUP
/begin GROUP S1089_Enabled_Subsystem3 "SWC_FDC_type/run_SWC_FDC_RxTx_5ms_sys/APP/TPM/TPMS/TPMS/Learn/AutoLocation/IDIdentify/Subsystem7/Enabled Subsystem3" /begin REF_MEASUREMENT VTPM_RRS1_cnt /end REF_MEASUREMENT /end GROUP
/begin GROUP S1089_Enabled_Subsystem5 "SWC_FDC_type/run_SWC_FDC_RxTx_5ms_sys/APP/TPM/TPMS/TPMS/Learn/AutoLocation/IDIdentify/Subsystem7/Enabled Subsystem5" /begin REF_MEASUREMENT VTPM_LFS1_cnt /end REF_MEASUREMENT /end GROUP
/begin GROUP S1562_LUT_D_ECO "SWC_FDC_type/run_SWC_FDC_RxTx_5ms_sys/APP/TQD/TorqueDemand/TorqueModule/DriverWhlTqDem/PedalMapWhlTq/NoLHM/ShiftD/LUT_D_ECO" /begin SUB_GROUP S1565_ECO_OnePedal_TqMap /end SUB_GROUP
 /begin REF_CHARACTERISTIC MTQD_ECOTqMapD_Z_Nm MTQD_EL2TqMapD_Z_Nm MTQD_EL3TqMapD_Z_Nm MTQD_EL4TqMapD_Z_Nm MTQD_EL5TqMapD_Z_Nm MTQD_EOPDTqMapDCon_Z_Nm MTQD_EOPDTqMapD_Z_Nm MTQD_RollGenMapEL1_Z_Nm /end REF_CHARACTERISTIC
/end GROUP
/begin GROUP S1562_LUT_D_EscapeMode "SWC_FDC_type/run_SWC_FDC_RxTx_5ms_sys/APP/TQD/TorqueDemand/TorqueModule/DriverWhlTqDem/PedalMapWhlTq/NoLHM/ShiftD/LUT_D_EscapeMode" /begin REF_CHARACTERISTIC MTQD_EMTqMapD_Z_Nm /end REF_CHARACTERISTIC /end GROUP
/begin GROUP S1562_LUT_D_Normal "SWC_FDC_type/run_SWC_FDC_RxTx_5ms_sys/APP/TQD/TorqueDemand/TorqueModule/DriverWhlTqDem/PedalMapWhlTq/NoLHM/ShiftD/LUT_D_Normal" /begin SUB_GROUP S1567_NRM_OnePedal_TqMap /end SUB_GROUP
 /begin REF_CHARACTERISTIC MTQD_NL1TqMapD_Z_Nm MTQD_NL2TqMapD_Z_Nm MTQD_NL3TqMapD_Z_Nm MTQD_NL4TqMapD_Z_Nm MTQD_NL5TqMapD_Z_Nm MTQD_NOPDTqMapDCon_Z_Nm MTQD_NOPDTqMapD_Z_Nm /end REF_CHARACTERISTIC
/end GROUP
/begin GROUP S1562_LUT_D_SnowMode "SWC_FDC_type/run_SWC_FDC_RxTx_5ms_sys/APP/TQD/TorqueDemand/TorqueModule/DriverWhlTqDem/PedalMapWhlTq/NoLHM/ShiftD/LUT_D_SnowMode" /begin REF_CHARACTERISTIC MTQD_SNTqMapD_Z_Nm /end REF_CHARACTERISTIC /end GROUP
/begin GROUP S1562_LUT_D_Sport "SWC_FDC_type/run_SWC_FDC_RxTx_5ms_sys/APP/TQD/TorqueDemand/TorqueModule/DriverWhlTqDem/PedalMapWhlTq/NoLHM/ShiftD/LUT_D_Sport" /begin SUB_GROUP S1569_Sport_OnePedal_TqMap /end SUB_GROUP
 /begin REF_CHARACTERISTIC MTQD_SL1TqMapD_Z_Nm MTQD_SL2TqMapD_Z_Nm MTQD_SL3TqMapD_Z_Nm MTQD_SL4TqMapD_Z_Nm MTQD_SL5TqMapD_Z_Nm MTQD_SOPDTqMapDCon_Z_Nm MTQD_SOPDTqMapD_Z_Nm /end REF_CHARACTERISTIC
/end GROUP
/begin GROUP S1565_ECO_OnePedal_TqMap "SWC_FDC_type/run_SWC_FDC_RxTx_5ms_sys/APP/TQD/TorqueDemand/TorqueModule/DriverWhlTqDem/PedalMapWhlTq/NoLHM/ShiftD/LUT_D_ECO/ECO_OnePedal_TqMap" /begin REF_CHARACTERISTIC KTQD_OPDHTqDisAPSPosn_pct KTQD_OPDHTqDisComSpd_kph /end REF_CHARACTERISTIC /begin REF_MEASUREMENT VTQD_EOPDActTqMapD_Nm /end REF_MEASUREMENT /end GROUP
/begin GROUP S1567_NRM_OnePedal_TqMap "SWC_FDC_type/run_SWC_FDC_RxTx_5ms_sys/APP/TQD/TorqueDemand/TorqueModule/DriverWhlTqDem/PedalMapWhlTq/NoLHM/ShiftD/LUT_D_Normal/NRM_OnePedal_TqMap" /begin SUB_GROUP S1585_SR_Latch /end SUB_GROUP /begin REF_CHARACTERISTIC KTQD_OPDHTqDisAPSPosn_pct KTQD_OPDHTqDisComSpd_kph /end REF_CHARACTERISTIC /begin REF_MEASUREMENT VTQD_NOPDActTqMapD_Nm /end REF_MEASUREMENT /end GROUP
/begin GROUP S1569_Sport_OnePedal_TqMap "SWC_FDC_type/run_SWC_FDC_RxTx_5ms_sys/APP/TQD/TorqueDemand/TorqueModule/DriverWhlTqDem/PedalMapWhlTq/NoLHM/ShiftD/LUT_D_Sport/Sport_OnePedal_TqMap" /begin REF_CHARACTERISTIC KTQD_OPDHTqDisAPSPosn_pct KTQD_OPDHTqDisComSpd_kph /end REF_CHARACTERISTIC /begin REF_MEASUREMENT VTQD_SOPDActTqMapD_Nm /end REF_MEASUREMENT /end GROUP
/begin GROUP S1585_SR_Latch "SWC_FDC_type/run_SWC_FDC_RxTx_5ms_sys/APP/TQD/TorqueDemand/TorqueModule/DriverWhlTqDem/PedalMapWhlTq/NoLHM/ShiftD/LUT_D_Normal/NRM_OnePedal_TqMap/SR_Latch" /begin REF_MEASUREMENT VTQD_OPDHoldRelPedTq_flg /end REF_MEASUREMENT /end GROUP
/end MODULE
/end PROJECT
