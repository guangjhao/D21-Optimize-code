ASAP2_VERSION 1 51
/begin PROJECT ProjectName "Project Comment Goes Here"
/begin HEADER "Header Comments go here" /end HEADER
/begin MODULE ModuleName "Module Comment Goes Here"
/begin MOD_COMMON "Mod Common Comment Here" BYTE_ORDER MSB_LAST ALIGNMENT_BYTE 1 ALIGNMENT_WORD 1 ALIGNMENT_LONG 1 ALIGNMENT_FLOAT32_IEEE 1 ALIGNMENT_FLOAT64_IEEE 1 /end MOD_COMMON
/begin FUNCTION Constant47 "" /begin DEF_CHARACTERISTIC DTC_D00234 /end DEF_CHARACTERISTIC /begin IN_MEASUREMENT /end IN_MEASUREMENT /begin OUT_MEASUREMENT /end OUT_MEASUREMENT /end FUNCTION
/begin FUNCTION Constant48 "" /begin DEF_CHARACTERISTIC DTC_D00235 /end DEF_CHARACTERISTIC /begin IN_MEASUREMENT /end IN_MEASUREMENT /begin OUT_MEASUREMENT /end OUT_MEASUREMENT /end FUNCTION
/begin FUNCTION Constant49 "" /begin DEF_CHARACTERISTIC DTC_D00236 /end DEF_CHARACTERISTIC /begin IN_MEASUREMENT /end IN_MEASUREMENT /begin OUT_MEASUREMENT /end OUT_MEASUREMENT /end FUNCTION
/begin FUNCTION Constant5 "" /begin DEF_CHARACTERISTIC DTC_D00206 /end DEF_CHARACTERISTIC /begin IN_MEASUREMENT /end IN_MEASUREMENT /begin OUT_MEASUREMENT /end OUT_MEASUREMENT /end FUNCTION
/begin FUNCTION Constant50 "" /begin DEF_CHARACTERISTIC DTC_D00237 /end DEF_CHARACTERISTIC /begin IN_MEASUREMENT /end IN_MEASUREMENT /begin OUT_MEASUREMENT /end OUT_MEASUREMENT /end FUNCTION
/begin FUNCTION Constant51 "" /begin DEF_CHARACTERISTIC DTC_D00238 /end DEF_CHARACTERISTIC /begin IN_MEASUREMENT /end IN_MEASUREMENT /begin OUT_MEASUREMENT /end OUT_MEASUREMENT /end FUNCTION
/begin FUNCTION Constant52 "" /begin DEF_CHARACTERISTIC DTC_D0023A /end DEF_CHARACTERISTIC /begin IN_MEASUREMENT /end IN_MEASUREMENT /begin OUT_MEASUREMENT /end OUT_MEASUREMENT /end FUNCTION
/begin FUNCTION Constant53 "" /begin DEF_CHARACTERISTIC DTC_D0023B /end DEF_CHARACTERISTIC /begin IN_MEASUREMENT /end IN_MEASUREMENT /begin OUT_MEASUREMENT /end OUT_MEASUREMENT /end FUNCTION
/begin FUNCTION Constant54 "" /begin DEF_CHARACTERISTIC DTC_D0023C /end DEF_CHARACTERISTIC /begin IN_MEASUREMENT /end IN_MEASUREMENT /begin OUT_MEASUREMENT /end OUT_MEASUREMENT /end FUNCTION
/begin FUNCTION Constant55 "" /begin DEF_CHARACTERISTIC DTC_D0023D /end DEF_CHARACTERISTIC /begin IN_MEASUREMENT /end IN_MEASUREMENT /begin OUT_MEASUREMENT /end OUT_MEASUREMENT /end FUNCTION
/begin FUNCTION Constant56 "" /begin DEF_CHARACTERISTIC DTC_D0023E /end DEF_CHARACTERISTIC /begin IN_MEASUREMENT /end IN_MEASUREMENT /begin OUT_MEASUREMENT /end OUT_MEASUREMENT /end FUNCTION
/begin FUNCTION Constant57 "" /begin DEF_CHARACTERISTIC DTC_D00240 /end DEF_CHARACTERISTIC /begin IN_MEASUREMENT /end IN_MEASUREMENT /begin OUT_MEASUREMENT /end OUT_MEASUREMENT /end FUNCTION
/begin FUNCTION Constant58 "" /begin DEF_CHARACTERISTIC DTC_D00241 /end DEF_CHARACTERISTIC /begin IN_MEASUREMENT /end IN_MEASUREMENT /begin OUT_MEASUREMENT /end OUT_MEASUREMENT /end FUNCTION
/begin FUNCTION Constant59 "" /begin DEF_CHARACTERISTIC DTC_100242 /end DEF_CHARACTERISTIC /begin IN_MEASUREMENT /end IN_MEASUREMENT /begin OUT_MEASUREMENT /end OUT_MEASUREMENT /end FUNCTION
/begin FUNCTION Constant6 "" /begin DEF_CHARACTERISTIC DTC_D00207 /end DEF_CHARACTERISTIC /begin IN_MEASUREMENT /end IN_MEASUREMENT /begin OUT_MEASUREMENT /end OUT_MEASUREMENT /end FUNCTION
/begin FUNCTION Constant60 "" /begin DEF_CHARACTERISTIC DTC_100243 /end DEF_CHARACTERISTIC /begin IN_MEASUREMENT /end IN_MEASUREMENT /begin OUT_MEASUREMENT /end OUT_MEASUREMENT /end FUNCTION
/begin FUNCTION Constant61 "" /begin DEF_CHARACTERISTIC DTC_100244 /end DEF_CHARACTERISTIC /begin IN_MEASUREMENT /end IN_MEASUREMENT /begin OUT_MEASUREMENT /end OUT_MEASUREMENT /end FUNCTION
/begin FUNCTION Constant62 "" /begin DEF_CHARACTERISTIC DTC_100247 /end DEF_CHARACTERISTIC /begin IN_MEASUREMENT /end IN_MEASUREMENT /begin OUT_MEASUREMENT /end OUT_MEASUREMENT /end FUNCTION
/begin FUNCTION Constant63 "" /begin DEF_CHARACTERISTIC DTC_100248 /end DEF_CHARACTERISTIC /begin IN_MEASUREMENT /end IN_MEASUREMENT /begin OUT_MEASUREMENT /end OUT_MEASUREMENT /end FUNCTION
/begin FUNCTION Constant64 "" /begin DEF_CHARACTERISTIC DTC_100249 /end DEF_CHARACTERISTIC /begin IN_MEASUREMENT /end IN_MEASUREMENT /begin OUT_MEASUREMENT /end OUT_MEASUREMENT /end FUNCTION
/begin FUNCTION Constant65 "" /begin DEF_CHARACTERISTIC DTC_100250 /end DEF_CHARACTERISTIC /begin IN_MEASUREMENT /end IN_MEASUREMENT /begin OUT_MEASUREMENT /end OUT_MEASUREMENT /end FUNCTION
/begin FUNCTION Constant66 "" /begin DEF_CHARACTERISTIC DTC_100251 /end DEF_CHARACTERISTIC /begin IN_MEASUREMENT /end IN_MEASUREMENT /begin OUT_MEASUREMENT /end OUT_MEASUREMENT /end FUNCTION
/begin FUNCTION Constant67 "" /begin DEF_CHARACTERISTIC DTC_100252 /end DEF_CHARACTERISTIC /begin IN_MEASUREMENT /end IN_MEASUREMENT /begin OUT_MEASUREMENT /end OUT_MEASUREMENT /end FUNCTION
/begin FUNCTION Constant68 "" /begin DEF_CHARACTERISTIC DTC_900909 /end DEF_CHARACTERISTIC /begin IN_MEASUREMENT /end IN_MEASUREMENT /begin OUT_MEASUREMENT /end OUT_MEASUREMENT /end FUNCTION
/begin FUNCTION Constant69 "" /begin DEF_CHARACTERISTIC DTC_90090A /end DEF_CHARACTERISTIC /begin IN_MEASUREMENT /end IN_MEASUREMENT /begin OUT_MEASUREMENT /end OUT_MEASUREMENT /end FUNCTION
/begin FUNCTION Constant7 "" /begin DEF_CHARACTERISTIC DTC_D00208 /end DEF_CHARACTERISTIC /begin IN_MEASUREMENT /end IN_MEASUREMENT /begin OUT_MEASUREMENT /end OUT_MEASUREMENT /end FUNCTION
/begin FUNCTION Constant70 "" /begin DEF_CHARACTERISTIC DTC_90090B /end DEF_CHARACTERISTIC /begin IN_MEASUREMENT /end IN_MEASUREMENT /begin OUT_MEASUREMENT /end OUT_MEASUREMENT /end FUNCTION
/begin FUNCTION Constant71 "" /begin DEF_CHARACTERISTIC DTC_90090C /end DEF_CHARACTERISTIC /begin IN_MEASUREMENT /end IN_MEASUREMENT /begin OUT_MEASUREMENT /end OUT_MEASUREMENT /end FUNCTION
/begin FUNCTION Constant72 "" /begin DEF_CHARACTERISTIC DTC_90090D /end DEF_CHARACTERISTIC /begin IN_MEASUREMENT /end IN_MEASUREMENT /begin OUT_MEASUREMENT /end OUT_MEASUREMENT /end FUNCTION
/begin FUNCTION Constant73 "" /begin DEF_CHARACTERISTIC DTC_90090E /end DEF_CHARACTERISTIC /begin IN_MEASUREMENT /end IN_MEASUREMENT /begin OUT_MEASUREMENT /end OUT_MEASUREMENT /end FUNCTION
/begin FUNCTION Constant74 "" /begin DEF_CHARACTERISTIC DTC_90090F /end DEF_CHARACTERISTIC /begin IN_MEASUREMENT /end IN_MEASUREMENT /begin OUT_MEASUREMENT /end OUT_MEASUREMENT /end FUNCTION
/begin FUNCTION Constant75 "" /begin DEF_CHARACTERISTIC DTC_900910 /end DEF_CHARACTERISTIC /begin IN_MEASUREMENT /end IN_MEASUREMENT /begin OUT_MEASUREMENT /end OUT_MEASUREMENT /end FUNCTION
/begin FUNCTION Constant76 "" /begin DEF_CHARACTERISTIC DTC_900911 /end DEF_CHARACTERISTIC /begin IN_MEASUREMENT /end IN_MEASUREMENT /begin OUT_MEASUREMENT /end OUT_MEASUREMENT /end FUNCTION
/begin FUNCTION Constant77 "" /begin DEF_CHARACTERISTIC DTC_900912 /end DEF_CHARACTERISTIC /begin IN_MEASUREMENT /end IN_MEASUREMENT /begin OUT_MEASUREMENT /end OUT_MEASUREMENT /end FUNCTION
/begin FUNCTION Constant78 "" /begin DEF_CHARACTERISTIC DTC_900913 /end DEF_CHARACTERISTIC /begin IN_MEASUREMENT /end IN_MEASUREMENT /begin OUT_MEASUREMENT /end OUT_MEASUREMENT /end FUNCTION
/begin FUNCTION Constant79 "" /begin DEF_CHARACTERISTIC DTC_900914 /end DEF_CHARACTERISTIC /begin IN_MEASUREMENT /end IN_MEASUREMENT /begin OUT_MEASUREMENT /end OUT_MEASUREMENT /end FUNCTION
/begin FUNCTION Constant8 "" /begin DEF_CHARACTERISTIC DTC_D00209 /end DEF_CHARACTERISTIC /begin IN_MEASUREMENT /end IN_MEASUREMENT /begin OUT_MEASUREMENT /end OUT_MEASUREMENT /end FUNCTION
/begin FUNCTION Constant80 "" /begin DEF_CHARACTERISTIC DTC_500B01 /end DEF_CHARACTERISTIC /begin IN_MEASUREMENT /end IN_MEASUREMENT /begin OUT_MEASUREMENT /end OUT_MEASUREMENT /end FUNCTION
/begin FUNCTION Constant81 "" /begin DEF_CHARACTERISTIC DTC_500B02 /end DEF_CHARACTERISTIC /begin IN_MEASUREMENT /end IN_MEASUREMENT /begin OUT_MEASUREMENT /end OUT_MEASUREMENT /end FUNCTION
/begin FUNCTION Constant82 "" /begin DEF_CHARACTERISTIC DTC_500B03 /end DEF_CHARACTERISTIC /begin IN_MEASUREMENT /end IN_MEASUREMENT /begin OUT_MEASUREMENT /end OUT_MEASUREMENT /end FUNCTION
/begin FUNCTION Constant83 "" /begin DEF_CHARACTERISTIC DTC_500B04 /end DEF_CHARACTERISTIC /begin IN_MEASUREMENT /end IN_MEASUREMENT /begin OUT_MEASUREMENT /end OUT_MEASUREMENT /end FUNCTION
/begin FUNCTION Constant84 "" /begin DEF_CHARACTERISTIC DTC_500B05 /end DEF_CHARACTERISTIC /begin IN_MEASUREMENT /end IN_MEASUREMENT /begin OUT_MEASUREMENT /end OUT_MEASUREMENT /end FUNCTION
/begin FUNCTION Constant85 "" /begin DEF_CHARACTERISTIC DTC_500B06 /end DEF_CHARACTERISTIC /begin IN_MEASUREMENT /end IN_MEASUREMENT /begin OUT_MEASUREMENT /end OUT_MEASUREMENT /end FUNCTION
/begin FUNCTION Constant86 "" /begin DEF_CHARACTERISTIC DTC_500B07 /end DEF_CHARACTERISTIC /begin IN_MEASUREMENT /end IN_MEASUREMENT /begin OUT_MEASUREMENT /end OUT_MEASUREMENT /end FUNCTION
/begin FUNCTION Constant87 "" /begin DEF_CHARACTERISTIC DTC_500B08 /end DEF_CHARACTERISTIC /begin IN_MEASUREMENT /end IN_MEASUREMENT /begin OUT_MEASUREMENT /end OUT_MEASUREMENT /end FUNCTION
/begin FUNCTION Constant88 "" /begin DEF_CHARACTERISTIC DTC_500B09 /end DEF_CHARACTERISTIC /begin IN_MEASUREMENT /end IN_MEASUREMENT /begin OUT_MEASUREMENT /end OUT_MEASUREMENT /end FUNCTION
/begin FUNCTION Constant89 "" /begin DEF_CHARACTERISTIC DTC_500B0A /end DEF_CHARACTERISTIC /begin IN_MEASUREMENT /end IN_MEASUREMENT /begin OUT_MEASUREMENT /end OUT_MEASUREMENT /end FUNCTION
/begin FUNCTION Constant9 "" /begin DEF_CHARACTERISTIC DTC_D0020A /end DEF_CHARACTERISTIC /begin IN_MEASUREMENT /end IN_MEASUREMENT /begin OUT_MEASUREMENT /end OUT_MEASUREMENT /end FUNCTION
/begin FUNCTION Constant90 "" /begin DEF_CHARACTERISTIC DTC_500B0B /end DEF_CHARACTERISTIC /begin IN_MEASUREMENT /end IN_MEASUREMENT /begin OUT_MEASUREMENT /end OUT_MEASUREMENT /end FUNCTION
/begin FUNCTION Constant91 "" /begin DEF_CHARACTERISTIC DTC_500B0C /end DEF_CHARACTERISTIC /begin IN_MEASUREMENT /end IN_MEASUREMENT /begin OUT_MEASUREMENT /end OUT_MEASUREMENT /end FUNCTION
/begin FUNCTION Constant92 "" /begin DEF_CHARACTERISTIC DTC_500B0D /end DEF_CHARACTERISTIC /begin IN_MEASUREMENT /end IN_MEASUREMENT /begin OUT_MEASUREMENT /end OUT_MEASUREMENT /end FUNCTION
/begin FUNCTION Constant93 "" /begin DEF_CHARACTERISTIC DTC_500B0E /end DEF_CHARACTERISTIC /begin IN_MEASUREMENT /end IN_MEASUREMENT /begin OUT_MEASUREMENT /end OUT_MEASUREMENT /end FUNCTION
/begin FUNCTION Constant94 "" /begin DEF_CHARACTERISTIC DTC_500B0F /end DEF_CHARACTERISTIC /begin IN_MEASUREMENT /end IN_MEASUREMENT /begin OUT_MEASUREMENT /end OUT_MEASUREMENT /end FUNCTION
/begin FUNCTION Constant95 "" /begin DEF_CHARACTERISTIC DTC_500B10 /end DEF_CHARACTERISTIC /begin IN_MEASUREMENT /end IN_MEASUREMENT /begin OUT_MEASUREMENT /end OUT_MEASUREMENT /end FUNCTION
/begin FUNCTION Constant96 "" /begin DEF_CHARACTERISTIC DTC_900301 /end DEF_CHARACTERISTIC /begin IN_MEASUREMENT /end IN_MEASUREMENT /begin OUT_MEASUREMENT /end OUT_MEASUREMENT /end FUNCTION
/begin FUNCTION Constant97 "" /begin DEF_CHARACTERISTIC DTC_900302 /end DEF_CHARACTERISTIC /begin IN_MEASUREMENT /end IN_MEASUREMENT /begin OUT_MEASUREMENT /end OUT_MEASUREMENT /end FUNCTION
/begin FUNCTION Constant98 "" /begin DEF_CHARACTERISTIC DTC_900303 /end DEF_CHARACTERISTIC /begin IN_MEASUREMENT /end IN_MEASUREMENT /begin OUT_MEASUREMENT /end OUT_MEASUREMENT /end FUNCTION
/begin FUNCTION Constant99 "" /begin DEF_CHARACTERISTIC DTC_900304 /end DEF_CHARACTERISTIC /begin IN_MEASUREMENT /end IN_MEASUREMENT /begin OUT_MEASUREMENT /end OUT_MEASUREMENT /end FUNCTION
/begin FUNCTION DTCID "" /begin DEF_CHARACTERISTIC /end DEF_CHARACTERISTIC /begin IN_MEASUREMENT /end IN_MEASUREMENT /begin OUT_MEASUREMENT /end OUT_MEASUREMENT /end FUNCTION
/begin FUNCTION DTCID1 "" /begin DEF_CHARACTERISTIC /end DEF_CHARACTERISTIC /begin IN_MEASUREMENT /end IN_MEASUREMENT /begin OUT_MEASUREMENT /end OUT_MEASUREMENT /end FUNCTION
/begin FUNCTION DTCID10 "" /begin DEF_CHARACTERISTIC /end DEF_CHARACTERISTIC /begin IN_MEASUREMENT /end IN_MEASUREMENT /begin OUT_MEASUREMENT /end OUT_MEASUREMENT /end FUNCTION
/begin FUNCTION DTCID100 "" /begin DEF_CHARACTERISTIC /end DEF_CHARACTERISTIC /begin IN_MEASUREMENT /end IN_MEASUREMENT /begin OUT_MEASUREMENT /end OUT_MEASUREMENT /end FUNCTION
/begin FUNCTION DTCID101 "" /begin DEF_CHARACTERISTIC /end DEF_CHARACTERISTIC /begin IN_MEASUREMENT /end IN_MEASUREMENT /begin OUT_MEASUREMENT /end OUT_MEASUREMENT /end FUNCTION
/begin FUNCTION DTCID102 "" /begin DEF_CHARACTERISTIC /end DEF_CHARACTERISTIC /begin IN_MEASUREMENT /end IN_MEASUREMENT /begin OUT_MEASUREMENT /end OUT_MEASUREMENT /end FUNCTION
/begin FUNCTION DTCID103 "" /begin DEF_CHARACTERISTIC /end DEF_CHARACTERISTIC /begin IN_MEASUREMENT /end IN_MEASUREMENT /begin OUT_MEASUREMENT /end OUT_MEASUREMENT /end FUNCTION
/begin FUNCTION DTCID104 "" /begin DEF_CHARACTERISTIC /end DEF_CHARACTERISTIC /begin IN_MEASUREMENT /end IN_MEASUREMENT /begin OUT_MEASUREMENT /end OUT_MEASUREMENT /end FUNCTION
/begin FUNCTION DTCID105 "" /begin DEF_CHARACTERISTIC /end DEF_CHARACTERISTIC /begin IN_MEASUREMENT /end IN_MEASUREMENT /begin OUT_MEASUREMENT /end OUT_MEASUREMENT /end FUNCTION
/begin FUNCTION DTCID106 "" /begin DEF_CHARACTERISTIC /end DEF_CHARACTERISTIC /begin IN_MEASUREMENT /end IN_MEASUREMENT /begin OUT_MEASUREMENT /end OUT_MEASUREMENT /end FUNCTION
/begin FUNCTION DTCID107 "" /begin DEF_CHARACTERISTIC /end DEF_CHARACTERISTIC /begin IN_MEASUREMENT /end IN_MEASUREMENT /begin OUT_MEASUREMENT /end OUT_MEASUREMENT /end FUNCTION
/begin FUNCTION DTCID108 "" /begin DEF_CHARACTERISTIC /end DEF_CHARACTERISTIC /begin IN_MEASUREMENT /end IN_MEASUREMENT /begin OUT_MEASUREMENT /end OUT_MEASUREMENT /end FUNCTION
/begin FUNCTION DTCID109 "" /begin DEF_CHARACTERISTIC /end DEF_CHARACTERISTIC /begin IN_MEASUREMENT /end IN_MEASUREMENT /begin OUT_MEASUREMENT /end OUT_MEASUREMENT /end FUNCTION
/begin FUNCTION DTCID11 "" /begin DEF_CHARACTERISTIC /end DEF_CHARACTERISTIC /begin IN_MEASUREMENT /end IN_MEASUREMENT /begin OUT_MEASUREMENT /end OUT_MEASUREMENT /end FUNCTION
/begin FUNCTION DTCID110 "" /begin DEF_CHARACTERISTIC /end DEF_CHARACTERISTIC /begin IN_MEASUREMENT /end IN_MEASUREMENT /begin OUT_MEASUREMENT /end OUT_MEASUREMENT /end FUNCTION
/begin FUNCTION DTCID111 "" /begin DEF_CHARACTERISTIC /end DEF_CHARACTERISTIC /begin IN_MEASUREMENT /end IN_MEASUREMENT /begin OUT_MEASUREMENT /end OUT_MEASUREMENT /end FUNCTION
/begin FUNCTION DTCID112 "" /begin DEF_CHARACTERISTIC /end DEF_CHARACTERISTIC /begin IN_MEASUREMENT /end IN_MEASUREMENT /begin OUT_MEASUREMENT /end OUT_MEASUREMENT /end FUNCTION
/begin FUNCTION DTCID113 "" /begin DEF_CHARACTERISTIC /end DEF_CHARACTERISTIC /begin IN_MEASUREMENT /end IN_MEASUREMENT /begin OUT_MEASUREMENT /end OUT_MEASUREMENT /end FUNCTION
/begin FUNCTION DTCID114 "" /begin DEF_CHARACTERISTIC /end DEF_CHARACTERISTIC /begin IN_MEASUREMENT /end IN_MEASUREMENT /begin OUT_MEASUREMENT /end OUT_MEASUREMENT /end FUNCTION
/begin FUNCTION DTCID115 "" /begin DEF_CHARACTERISTIC /end DEF_CHARACTERISTIC /begin IN_MEASUREMENT /end IN_MEASUREMENT /begin OUT_MEASUREMENT /end OUT_MEASUREMENT /end FUNCTION
/begin FUNCTION DTCID116 "" /begin DEF_CHARACTERISTIC /end DEF_CHARACTERISTIC /begin IN_MEASUREMENT /end IN_MEASUREMENT /begin OUT_MEASUREMENT /end OUT_MEASUREMENT /end FUNCTION
/begin FUNCTION DTCID117 "" /begin DEF_CHARACTERISTIC /end DEF_CHARACTERISTIC /begin IN_MEASUREMENT /end IN_MEASUREMENT /begin OUT_MEASUREMENT /end OUT_MEASUREMENT /end FUNCTION
/begin FUNCTION DTCID118 "" /begin DEF_CHARACTERISTIC /end DEF_CHARACTERISTIC /begin IN_MEASUREMENT /end IN_MEASUREMENT /begin OUT_MEASUREMENT /end OUT_MEASUREMENT /end FUNCTION
/begin FUNCTION DTCID119 "" /begin DEF_CHARACTERISTIC /end DEF_CHARACTERISTIC /begin IN_MEASUREMENT /end IN_MEASUREMENT /begin OUT_MEASUREMENT /end OUT_MEASUREMENT /end FUNCTION
/begin FUNCTION DTCID12 "" /begin DEF_CHARACTERISTIC /end DEF_CHARACTERISTIC /begin IN_MEASUREMENT /end IN_MEASUREMENT /begin OUT_MEASUREMENT /end OUT_MEASUREMENT /end FUNCTION
/begin FUNCTION DTCID120 "" /begin DEF_CHARACTERISTIC /end DEF_CHARACTERISTIC /begin IN_MEASUREMENT /end IN_MEASUREMENT /begin OUT_MEASUREMENT /end OUT_MEASUREMENT /end FUNCTION
/begin FUNCTION DTCID121 "" /begin DEF_CHARACTERISTIC /end DEF_CHARACTERISTIC /begin IN_MEASUREMENT /end IN_MEASUREMENT /begin OUT_MEASUREMENT /end OUT_MEASUREMENT /end FUNCTION
/begin FUNCTION DTCID122 "" /begin DEF_CHARACTERISTIC /end DEF_CHARACTERISTIC /begin IN_MEASUREMENT /end IN_MEASUREMENT /begin OUT_MEASUREMENT /end OUT_MEASUREMENT /end FUNCTION
/begin FUNCTION DTCID123 "" /begin DEF_CHARACTERISTIC /end DEF_CHARACTERISTIC /begin IN_MEASUREMENT /end IN_MEASUREMENT /begin OUT_MEASUREMENT /end OUT_MEASUREMENT /end FUNCTION
/begin FUNCTION DTCID124 "" /begin DEF_CHARACTERISTIC /end DEF_CHARACTERISTIC /begin IN_MEASUREMENT /end IN_MEASUREMENT /begin OUT_MEASUREMENT /end OUT_MEASUREMENT /end FUNCTION
/begin FUNCTION DTCID125 "" /begin DEF_CHARACTERISTIC /end DEF_CHARACTERISTIC /begin IN_MEASUREMENT /end IN_MEASUREMENT /begin OUT_MEASUREMENT /end OUT_MEASUREMENT /end FUNCTION
/begin FUNCTION DTCID126 "" /begin DEF_CHARACTERISTIC /end DEF_CHARACTERISTIC /begin IN_MEASUREMENT /end IN_MEASUREMENT /begin OUT_MEASUREMENT /end OUT_MEASUREMENT /end FUNCTION
/begin FUNCTION DTCID127 "" /begin DEF_CHARACTERISTIC /end DEF_CHARACTERISTIC /begin IN_MEASUREMENT /end IN_MEASUREMENT /begin OUT_MEASUREMENT /end OUT_MEASUREMENT /end FUNCTION
/begin FUNCTION DTCID128 "" /begin DEF_CHARACTERISTIC /end DEF_CHARACTERISTIC /begin IN_MEASUREMENT /end IN_MEASUREMENT /begin OUT_MEASUREMENT /end OUT_MEASUREMENT /end FUNCTION
/begin FUNCTION DTCID129 "" /begin DEF_CHARACTERISTIC /end DEF_CHARACTERISTIC /begin IN_MEASUREMENT /end IN_MEASUREMENT /begin OUT_MEASUREMENT /end OUT_MEASUREMENT /end FUNCTION
/begin FUNCTION DTCID13 "" /begin DEF_CHARACTERISTIC /end DEF_CHARACTERISTIC /begin IN_MEASUREMENT /end IN_MEASUREMENT /begin OUT_MEASUREMENT /end OUT_MEASUREMENT /end FUNCTION
/begin FUNCTION DTCID130 "" /begin DEF_CHARACTERISTIC /end DEF_CHARACTERISTIC /begin IN_MEASUREMENT /end IN_MEASUREMENT /begin OUT_MEASUREMENT /end OUT_MEASUREMENT /end FUNCTION
/begin FUNCTION DTCID131 "" /begin DEF_CHARACTERISTIC /end DEF_CHARACTERISTIC /begin IN_MEASUREMENT /end IN_MEASUREMENT /begin OUT_MEASUREMENT /end OUT_MEASUREMENT /end FUNCTION
/begin FUNCTION DTCID132 "" /begin DEF_CHARACTERISTIC /end DEF_CHARACTERISTIC /begin IN_MEASUREMENT /end IN_MEASUREMENT /begin OUT_MEASUREMENT /end OUT_MEASUREMENT /end FUNCTION
/begin FUNCTION DTCID133 "" /begin DEF_CHARACTERISTIC /end DEF_CHARACTERISTIC /begin IN_MEASUREMENT /end IN_MEASUREMENT /begin OUT_MEASUREMENT /end OUT_MEASUREMENT /end FUNCTION
/begin FUNCTION DTCID134 "" /begin DEF_CHARACTERISTIC /end DEF_CHARACTERISTIC /begin IN_MEASUREMENT /end IN_MEASUREMENT /begin OUT_MEASUREMENT /end OUT_MEASUREMENT /end FUNCTION
/begin FUNCTION DTCID135 "" /begin DEF_CHARACTERISTIC /end DEF_CHARACTERISTIC /begin IN_MEASUREMENT /end IN_MEASUREMENT /begin OUT_MEASUREMENT /end OUT_MEASUREMENT /end FUNCTION
/begin FUNCTION DTCID136 "" /begin DEF_CHARACTERISTIC /end DEF_CHARACTERISTIC /begin IN_MEASUREMENT /end IN_MEASUREMENT /begin OUT_MEASUREMENT /end OUT_MEASUREMENT /end FUNCTION
/begin FUNCTION DTCID137 "" /begin DEF_CHARACTERISTIC /end DEF_CHARACTERISTIC /begin IN_MEASUREMENT /end IN_MEASUREMENT /begin OUT_MEASUREMENT /end OUT_MEASUREMENT /end FUNCTION
/begin FUNCTION DTCID138 "" /begin DEF_CHARACTERISTIC /end DEF_CHARACTERISTIC /begin IN_MEASUREMENT /end IN_MEASUREMENT /begin OUT_MEASUREMENT /end OUT_MEASUREMENT /end FUNCTION
/begin FUNCTION DTCID139 "" /begin DEF_CHARACTERISTIC /end DEF_CHARACTERISTIC /begin IN_MEASUREMENT /end IN_MEASUREMENT /begin OUT_MEASUREMENT /end OUT_MEASUREMENT /end FUNCTION
/begin FUNCTION DTCID14 "" /begin DEF_CHARACTERISTIC /end DEF_CHARACTERISTIC /begin IN_MEASUREMENT /end IN_MEASUREMENT /begin OUT_MEASUREMENT /end OUT_MEASUREMENT /end FUNCTION
/begin FUNCTION DTCID140 "" /begin DEF_CHARACTERISTIC /end DEF_CHARACTERISTIC /begin IN_MEASUREMENT /end IN_MEASUREMENT /begin OUT_MEASUREMENT /end OUT_MEASUREMENT /end FUNCTION
/begin FUNCTION DTCID141 "" /begin DEF_CHARACTERISTIC /end DEF_CHARACTERISTIC /begin IN_MEASUREMENT /end IN_MEASUREMENT /begin OUT_MEASUREMENT /end OUT_MEASUREMENT /end FUNCTION
/begin FUNCTION DTCID142 "" /begin DEF_CHARACTERISTIC /end DEF_CHARACTERISTIC /begin IN_MEASUREMENT /end IN_MEASUREMENT /begin OUT_MEASUREMENT /end OUT_MEASUREMENT /end FUNCTION
/begin FUNCTION DTCID143 "" /begin DEF_CHARACTERISTIC /end DEF_CHARACTERISTIC /begin IN_MEASUREMENT /end IN_MEASUREMENT /begin OUT_MEASUREMENT /end OUT_MEASUREMENT /end FUNCTION
/begin FUNCTION DTCID144 "" /begin DEF_CHARACTERISTIC /end DEF_CHARACTERISTIC /begin IN_MEASUREMENT /end IN_MEASUREMENT /begin OUT_MEASUREMENT /end OUT_MEASUREMENT /end FUNCTION
/begin FUNCTION DTCID145 "" /begin DEF_CHARACTERISTIC /end DEF_CHARACTERISTIC /begin IN_MEASUREMENT /end IN_MEASUREMENT /begin OUT_MEASUREMENT /end OUT_MEASUREMENT /end FUNCTION
/begin FUNCTION DTCID146 "" /begin DEF_CHARACTERISTIC /end DEF_CHARACTERISTIC /begin IN_MEASUREMENT /end IN_MEASUREMENT /begin OUT_MEASUREMENT /end OUT_MEASUREMENT /end FUNCTION
/begin FUNCTION DTCID147 "" /begin DEF_CHARACTERISTIC /end DEF_CHARACTERISTIC /begin IN_MEASUREMENT /end IN_MEASUREMENT /begin OUT_MEASUREMENT /end OUT_MEASUREMENT /end FUNCTION
/begin FUNCTION DTCID148 "" /begin DEF_CHARACTERISTIC /end DEF_CHARACTERISTIC /begin IN_MEASUREMENT /end IN_MEASUREMENT /begin OUT_MEASUREMENT /end OUT_MEASUREMENT /end FUNCTION
/begin FUNCTION DTCID149 "" /begin DEF_CHARACTERISTIC /end DEF_CHARACTERISTIC /begin IN_MEASUREMENT /end IN_MEASUREMENT /begin OUT_MEASUREMENT /end OUT_MEASUREMENT /end FUNCTION
/begin FUNCTION DTCID15 "" /begin DEF_CHARACTERISTIC /end DEF_CHARACTERISTIC /begin IN_MEASUREMENT /end IN_MEASUREMENT /begin OUT_MEASUREMENT /end OUT_MEASUREMENT /end FUNCTION
/begin FUNCTION DTCID150 "" /begin DEF_CHARACTERISTIC /end DEF_CHARACTERISTIC /begin IN_MEASUREMENT /end IN_MEASUREMENT /begin OUT_MEASUREMENT /end OUT_MEASUREMENT /end FUNCTION
/begin FUNCTION DTCID151 "" /begin DEF_CHARACTERISTIC /end DEF_CHARACTERISTIC /begin IN_MEASUREMENT /end IN_MEASUREMENT /begin OUT_MEASUREMENT /end OUT_MEASUREMENT /end FUNCTION
/begin FUNCTION DTCID152 "" /begin DEF_CHARACTERISTIC /end DEF_CHARACTERISTIC /begin IN_MEASUREMENT /end IN_MEASUREMENT /begin OUT_MEASUREMENT /end OUT_MEASUREMENT /end FUNCTION
/begin FUNCTION DTCID153 "" /begin DEF_CHARACTERISTIC /end DEF_CHARACTERISTIC /begin IN_MEASUREMENT /end IN_MEASUREMENT /begin OUT_MEASUREMENT /end OUT_MEASUREMENT /end FUNCTION
/begin FUNCTION DTCID154 "" /begin DEF_CHARACTERISTIC /end DEF_CHARACTERISTIC /begin IN_MEASUREMENT /end IN_MEASUREMENT /begin OUT_MEASUREMENT /end OUT_MEASUREMENT /end FUNCTION
/begin FUNCTION DTCID155 "" /begin DEF_CHARACTERISTIC /end DEF_CHARACTERISTIC /begin IN_MEASUREMENT /end IN_MEASUREMENT /begin OUT_MEASUREMENT /end OUT_MEASUREMENT /end FUNCTION
/begin FUNCTION DTCID156 "" /begin DEF_CHARACTERISTIC /end DEF_CHARACTERISTIC /begin IN_MEASUREMENT /end IN_MEASUREMENT /begin OUT_MEASUREMENT /end OUT_MEASUREMENT /end FUNCTION
/begin FUNCTION DTCID157 "" /begin DEF_CHARACTERISTIC /end DEF_CHARACTERISTIC /begin IN_MEASUREMENT /end IN_MEASUREMENT /begin OUT_MEASUREMENT /end OUT_MEASUREMENT /end FUNCTION
/begin FUNCTION DTCID158 "" /begin DEF_CHARACTERISTIC /end DEF_CHARACTERISTIC /begin IN_MEASUREMENT /end IN_MEASUREMENT /begin OUT_MEASUREMENT /end OUT_MEASUREMENT /end FUNCTION
/begin FUNCTION DTCID159 "" /begin DEF_CHARACTERISTIC /end DEF_CHARACTERISTIC /begin IN_MEASUREMENT /end IN_MEASUREMENT /begin OUT_MEASUREMENT /end OUT_MEASUREMENT /end FUNCTION
/begin FUNCTION DTCID16 "" /begin DEF_CHARACTERISTIC /end DEF_CHARACTERISTIC /begin IN_MEASUREMENT /end IN_MEASUREMENT /begin OUT_MEASUREMENT /end OUT_MEASUREMENT /end FUNCTION
/begin FUNCTION DTCID160 "" /begin DEF_CHARACTERISTIC /end DEF_CHARACTERISTIC /begin IN_MEASUREMENT /end IN_MEASUREMENT /begin OUT_MEASUREMENT /end OUT_MEASUREMENT /end FUNCTION
/begin FUNCTION DTCID161 "" /begin DEF_CHARACTERISTIC /end DEF_CHARACTERISTIC /begin IN_MEASUREMENT /end IN_MEASUREMENT /begin OUT_MEASUREMENT /end OUT_MEASUREMENT /end FUNCTION
/begin FUNCTION DTCID162 "" /begin DEF_CHARACTERISTIC /end DEF_CHARACTERISTIC /begin IN_MEASUREMENT /end IN_MEASUREMENT /begin OUT_MEASUREMENT /end OUT_MEASUREMENT /end FUNCTION
/begin FUNCTION DTCID163 "" /begin DEF_CHARACTERISTIC /end DEF_CHARACTERISTIC /begin IN_MEASUREMENT /end IN_MEASUREMENT /begin OUT_MEASUREMENT /end OUT_MEASUREMENT /end FUNCTION
/begin FUNCTION DTCID164 "" /begin DEF_CHARACTERISTIC /end DEF_CHARACTERISTIC /begin IN_MEASUREMENT /end IN_MEASUREMENT /begin OUT_MEASUREMENT /end OUT_MEASUREMENT /end FUNCTION
/begin FUNCTION DTCID165 "" /begin DEF_CHARACTERISTIC /end DEF_CHARACTERISTIC /begin IN_MEASUREMENT /end IN_MEASUREMENT /begin OUT_MEASUREMENT /end OUT_MEASUREMENT /end FUNCTION
/begin FUNCTION DTCID166 "" /begin DEF_CHARACTERISTIC /end DEF_CHARACTERISTIC /begin IN_MEASUREMENT /end IN_MEASUREMENT /begin OUT_MEASUREMENT /end OUT_MEASUREMENT /end FUNCTION
/begin FUNCTION DTCID167 "" /begin DEF_CHARACTERISTIC /end DEF_CHARACTERISTIC /begin IN_MEASUREMENT /end IN_MEASUREMENT /begin OUT_MEASUREMENT /end OUT_MEASUREMENT /end FUNCTION
/begin FUNCTION DTCID168 "" /begin DEF_CHARACTERISTIC /end DEF_CHARACTERISTIC /begin IN_MEASUREMENT /end IN_MEASUREMENT /begin OUT_MEASUREMENT /end OUT_MEASUREMENT /end FUNCTION
/begin FUNCTION DTCID169 "" /begin DEF_CHARACTERISTIC /end DEF_CHARACTERISTIC /begin IN_MEASUREMENT /end IN_MEASUREMENT /begin OUT_MEASUREMENT /end OUT_MEASUREMENT /end FUNCTION
/begin FUNCTION DTCID17 "" /begin DEF_CHARACTERISTIC /end DEF_CHARACTERISTIC /begin IN_MEASUREMENT /end IN_MEASUREMENT /begin OUT_MEASUREMENT /end OUT_MEASUREMENT /end FUNCTION
/begin FUNCTION DTCID170 "" /begin DEF_CHARACTERISTIC /end DEF_CHARACTERISTIC /begin IN_MEASUREMENT /end IN_MEASUREMENT /begin OUT_MEASUREMENT /end OUT_MEASUREMENT /end FUNCTION
/begin FUNCTION DTCID171 "" /begin DEF_CHARACTERISTIC /end DEF_CHARACTERISTIC /begin IN_MEASUREMENT /end IN_MEASUREMENT /begin OUT_MEASUREMENT /end OUT_MEASUREMENT /end FUNCTION
/begin FUNCTION DTCID172 "" /begin DEF_CHARACTERISTIC /end DEF_CHARACTERISTIC /begin IN_MEASUREMENT /end IN_MEASUREMENT /begin OUT_MEASUREMENT /end OUT_MEASUREMENT /end FUNCTION
/begin FUNCTION DTCID173 "" /begin DEF_CHARACTERISTIC /end DEF_CHARACTERISTIC /begin IN_MEASUREMENT /end IN_MEASUREMENT /begin OUT_MEASUREMENT /end OUT_MEASUREMENT /end FUNCTION
/begin FUNCTION DTCID174 "" /begin DEF_CHARACTERISTIC /end DEF_CHARACTERISTIC /begin IN_MEASUREMENT /end IN_MEASUREMENT /begin OUT_MEASUREMENT /end OUT_MEASUREMENT /end FUNCTION
/begin FUNCTION DTCID175 "" /begin DEF_CHARACTERISTIC /end DEF_CHARACTERISTIC /begin IN_MEASUREMENT /end IN_MEASUREMENT /begin OUT_MEASUREMENT /end OUT_MEASUREMENT /end FUNCTION
/begin FUNCTION DTCID176 "" /begin DEF_CHARACTERISTIC /end DEF_CHARACTERISTIC /begin IN_MEASUREMENT /end IN_MEASUREMENT /begin OUT_MEASUREMENT /end OUT_MEASUREMENT /end FUNCTION
/begin FUNCTION DTCID18 "" /begin DEF_CHARACTERISTIC /end DEF_CHARACTERISTIC /begin IN_MEASUREMENT /end IN_MEASUREMENT /begin OUT_MEASUREMENT /end OUT_MEASUREMENT /end FUNCTION
/begin FUNCTION DTCID19 "" /begin DEF_CHARACTERISTIC /end DEF_CHARACTERISTIC /begin IN_MEASUREMENT /end IN_MEASUREMENT /begin OUT_MEASUREMENT /end OUT_MEASUREMENT /end FUNCTION
/begin FUNCTION DTCID2 "" /begin DEF_CHARACTERISTIC /end DEF_CHARACTERISTIC /begin IN_MEASUREMENT /end IN_MEASUREMENT /begin OUT_MEASUREMENT /end OUT_MEASUREMENT /end FUNCTION
/begin FUNCTION DTCID20 "" /begin DEF_CHARACTERISTIC /end DEF_CHARACTERISTIC /begin IN_MEASUREMENT /end IN_MEASUREMENT /begin OUT_MEASUREMENT /end OUT_MEASUREMENT /end FUNCTION
/begin FUNCTION DTCID21 "" /begin DEF_CHARACTERISTIC /end DEF_CHARACTERISTIC /begin IN_MEASUREMENT /end IN_MEASUREMENT /begin OUT_MEASUREMENT /end OUT_MEASUREMENT /end FUNCTION
/begin FUNCTION DTCID22 "" /begin DEF_CHARACTERISTIC /end DEF_CHARACTERISTIC /begin IN_MEASUREMENT /end IN_MEASUREMENT /begin OUT_MEASUREMENT /end OUT_MEASUREMENT /end FUNCTION
/begin FUNCTION DTCID23 "" /begin DEF_CHARACTERISTIC /end DEF_CHARACTERISTIC /begin IN_MEASUREMENT /end IN_MEASUREMENT /begin OUT_MEASUREMENT /end OUT_MEASUREMENT /end FUNCTION
/begin FUNCTION DTCID24 "" /begin DEF_CHARACTERISTIC /end DEF_CHARACTERISTIC /begin IN_MEASUREMENT /end IN_MEASUREMENT /begin OUT_MEASUREMENT /end OUT_MEASUREMENT /end FUNCTION
/begin FUNCTION DTCID25 "" /begin DEF_CHARACTERISTIC /end DEF_CHARACTERISTIC /begin IN_MEASUREMENT /end IN_MEASUREMENT /begin OUT_MEASUREMENT /end OUT_MEASUREMENT /end FUNCTION
/begin FUNCTION DTCID26 "" /begin DEF_CHARACTERISTIC /end DEF_CHARACTERISTIC /begin IN_MEASUREMENT /end IN_MEASUREMENT /begin OUT_MEASUREMENT /end OUT_MEASUREMENT /end FUNCTION
/begin FUNCTION DTCID27 "" /begin DEF_CHARACTERISTIC /end DEF_CHARACTERISTIC /begin IN_MEASUREMENT /end IN_MEASUREMENT /begin OUT_MEASUREMENT /end OUT_MEASUREMENT /end FUNCTION
/begin FUNCTION DTCID28 "" /begin DEF_CHARACTERISTIC /end DEF_CHARACTERISTIC /begin IN_MEASUREMENT /end IN_MEASUREMENT /begin OUT_MEASUREMENT /end OUT_MEASUREMENT /end FUNCTION
/begin FUNCTION DTCID29 "" /begin DEF_CHARACTERISTIC /end DEF_CHARACTERISTIC /begin IN_MEASUREMENT /end IN_MEASUREMENT /begin OUT_MEASUREMENT /end OUT_MEASUREMENT /end FUNCTION
/begin FUNCTION DTCID3 "" /begin DEF_CHARACTERISTIC /end DEF_CHARACTERISTIC /begin IN_MEASUREMENT /end IN_MEASUREMENT /begin OUT_MEASUREMENT /end OUT_MEASUREMENT /end FUNCTION
/begin FUNCTION DTCID30 "" /begin DEF_CHARACTERISTIC /end DEF_CHARACTERISTIC /begin IN_MEASUREMENT /end IN_MEASUREMENT /begin OUT_MEASUREMENT /end OUT_MEASUREMENT /end FUNCTION
/begin FUNCTION DTCID31 "" /begin DEF_CHARACTERISTIC /end DEF_CHARACTERISTIC /begin IN_MEASUREMENT /end IN_MEASUREMENT /begin OUT_MEASUREMENT /end OUT_MEASUREMENT /end FUNCTION
/begin FUNCTION DTCID32 "" /begin DEF_CHARACTERISTIC /end DEF_CHARACTERISTIC /begin IN_MEASUREMENT /end IN_MEASUREMENT /begin OUT_MEASUREMENT /end OUT_MEASUREMENT /end FUNCTION
/begin FUNCTION DTCID33 "" /begin DEF_CHARACTERISTIC /end DEF_CHARACTERISTIC /begin IN_MEASUREMENT /end IN_MEASUREMENT /begin OUT_MEASUREMENT /end OUT_MEASUREMENT /end FUNCTION
/begin FUNCTION DTCID34 "" /begin DEF_CHARACTERISTIC /end DEF_CHARACTERISTIC /begin IN_MEASUREMENT /end IN_MEASUREMENT /begin OUT_MEASUREMENT /end OUT_MEASUREMENT /end FUNCTION
/begin FUNCTION DTCID35 "" /begin DEF_CHARACTERISTIC /end DEF_CHARACTERISTIC /begin IN_MEASUREMENT /end IN_MEASUREMENT /begin OUT_MEASUREMENT /end OUT_MEASUREMENT /end FUNCTION
/begin FUNCTION DTCID36 "" /begin DEF_CHARACTERISTIC /end DEF_CHARACTERISTIC /begin IN_MEASUREMENT /end IN_MEASUREMENT /begin OUT_MEASUREMENT /end OUT_MEASUREMENT /end FUNCTION
/begin FUNCTION DTCID37 "" /begin DEF_CHARACTERISTIC /end DEF_CHARACTERISTIC /begin IN_MEASUREMENT /end IN_MEASUREMENT /begin OUT_MEASUREMENT /end OUT_MEASUREMENT /end FUNCTION
/begin FUNCTION DTCID38 "" /begin DEF_CHARACTERISTIC /end DEF_CHARACTERISTIC /begin IN_MEASUREMENT /end IN_MEASUREMENT /begin OUT_MEASUREMENT /end OUT_MEASUREMENT /end FUNCTION
/begin FUNCTION DTCID39 "" /begin DEF_CHARACTERISTIC /end DEF_CHARACTERISTIC /begin IN_MEASUREMENT /end IN_MEASUREMENT /begin OUT_MEASUREMENT /end OUT_MEASUREMENT /end FUNCTION
/begin FUNCTION DTCID4 "" /begin DEF_CHARACTERISTIC /end DEF_CHARACTERISTIC /begin IN_MEASUREMENT /end IN_MEASUREMENT /begin OUT_MEASUREMENT /end OUT_MEASUREMENT /end FUNCTION
/begin FUNCTION DTCID40 "" /begin DEF_CHARACTERISTIC /end DEF_CHARACTERISTIC /begin IN_MEASUREMENT /end IN_MEASUREMENT /begin OUT_MEASUREMENT /end OUT_MEASUREMENT /end FUNCTION
/begin FUNCTION DTCID41 "" /begin DEF_CHARACTERISTIC /end DEF_CHARACTERISTIC /begin IN_MEASUREMENT /end IN_MEASUREMENT /begin OUT_MEASUREMENT /end OUT_MEASUREMENT /end FUNCTION
/begin FUNCTION DTCID42 "" /begin DEF_CHARACTERISTIC /end DEF_CHARACTERISTIC /begin IN_MEASUREMENT /end IN_MEASUREMENT /begin OUT_MEASUREMENT /end OUT_MEASUREMENT /end FUNCTION
/begin FUNCTION DTCID43 "" /begin DEF_CHARACTERISTIC /end DEF_CHARACTERISTIC /begin IN_MEASUREMENT /end IN_MEASUREMENT /begin OUT_MEASUREMENT /end OUT_MEASUREMENT /end FUNCTION
/begin FUNCTION DTCID44 "" /begin DEF_CHARACTERISTIC /end DEF_CHARACTERISTIC /begin IN_MEASUREMENT /end IN_MEASUREMENT /begin OUT_MEASUREMENT /end OUT_MEASUREMENT /end FUNCTION
/begin FUNCTION DTCID45 "" /begin DEF_CHARACTERISTIC /end DEF_CHARACTERISTIC /begin IN_MEASUREMENT /end IN_MEASUREMENT /begin OUT_MEASUREMENT /end OUT_MEASUREMENT /end FUNCTION
/begin FUNCTION DTCID46 "" /begin DEF_CHARACTERISTIC /end DEF_CHARACTERISTIC /begin IN_MEASUREMENT /end IN_MEASUREMENT /begin OUT_MEASUREMENT /end OUT_MEASUREMENT /end FUNCTION
/begin FUNCTION DTCID47 "" /begin DEF_CHARACTERISTIC /end DEF_CHARACTERISTIC /begin IN_MEASUREMENT /end IN_MEASUREMENT /begin OUT_MEASUREMENT /end OUT_MEASUREMENT /end FUNCTION
/begin FUNCTION DTCID48 "" /begin DEF_CHARACTERISTIC /end DEF_CHARACTERISTIC /begin IN_MEASUREMENT /end IN_MEASUREMENT /begin OUT_MEASUREMENT /end OUT_MEASUREMENT /end FUNCTION
/begin FUNCTION DTCID49 "" /begin DEF_CHARACTERISTIC /end DEF_CHARACTERISTIC /begin IN_MEASUREMENT /end IN_MEASUREMENT /begin OUT_MEASUREMENT /end OUT_MEASUREMENT /end FUNCTION
/begin FUNCTION DTCID5 "" /begin DEF_CHARACTERISTIC /end DEF_CHARACTERISTIC /begin IN_MEASUREMENT /end IN_MEASUREMENT /begin OUT_MEASUREMENT /end OUT_MEASUREMENT /end FUNCTION
/begin FUNCTION DTCID50 "" /begin DEF_CHARACTERISTIC /end DEF_CHARACTERISTIC /begin IN_MEASUREMENT /end IN_MEASUREMENT /begin OUT_MEASUREMENT /end OUT_MEASUREMENT /end FUNCTION
/begin FUNCTION DTCID51 "" /begin DEF_CHARACTERISTIC /end DEF_CHARACTERISTIC /begin IN_MEASUREMENT /end IN_MEASUREMENT /begin OUT_MEASUREMENT /end OUT_MEASUREMENT /end FUNCTION
/begin FUNCTION DTCID52 "" /begin DEF_CHARACTERISTIC /end DEF_CHARACTERISTIC /begin IN_MEASUREMENT /end IN_MEASUREMENT /begin OUT_MEASUREMENT /end OUT_MEASUREMENT /end FUNCTION
/begin FUNCTION DTCID53 "" /begin DEF_CHARACTERISTIC /end DEF_CHARACTERISTIC /begin IN_MEASUREMENT /end IN_MEASUREMENT /begin OUT_MEASUREMENT /end OUT_MEASUREMENT /end FUNCTION
/begin FUNCTION DTCID54 "" /begin DEF_CHARACTERISTIC /end DEF_CHARACTERISTIC /begin IN_MEASUREMENT /end IN_MEASUREMENT /begin OUT_MEASUREMENT /end OUT_MEASUREMENT /end FUNCTION
/begin FUNCTION DTCID55 "" /begin DEF_CHARACTERISTIC /end DEF_CHARACTERISTIC /begin IN_MEASUREMENT /end IN_MEASUREMENT /begin OUT_MEASUREMENT /end OUT_MEASUREMENT /end FUNCTION
/begin FUNCTION DTCID56 "" /begin DEF_CHARACTERISTIC /end DEF_CHARACTERISTIC /begin IN_MEASUREMENT /end IN_MEASUREMENT /begin OUT_MEASUREMENT /end OUT_MEASUREMENT /end FUNCTION
/begin FUNCTION DTCID57 "" /begin DEF_CHARACTERISTIC /end DEF_CHARACTERISTIC /begin IN_MEASUREMENT /end IN_MEASUREMENT /begin OUT_MEASUREMENT /end OUT_MEASUREMENT /end FUNCTION
/begin FUNCTION DTCID58 "" /begin DEF_CHARACTERISTIC /end DEF_CHARACTERISTIC /begin IN_MEASUREMENT /end IN_MEASUREMENT /begin OUT_MEASUREMENT /end OUT_MEASUREMENT /end FUNCTION
/begin FUNCTION DTCID59 "" /begin DEF_CHARACTERISTIC /end DEF_CHARACTERISTIC /begin IN_MEASUREMENT /end IN_MEASUREMENT /begin OUT_MEASUREMENT /end OUT_MEASUREMENT /end FUNCTION
/begin FUNCTION DTCID6 "" /begin DEF_CHARACTERISTIC /end DEF_CHARACTERISTIC /begin IN_MEASUREMENT /end IN_MEASUREMENT /begin OUT_MEASUREMENT /end OUT_MEASUREMENT /end FUNCTION
/begin FUNCTION DTCID60 "" /begin DEF_CHARACTERISTIC /end DEF_CHARACTERISTIC /begin IN_MEASUREMENT /end IN_MEASUREMENT /begin OUT_MEASUREMENT /end OUT_MEASUREMENT /end FUNCTION
/begin FUNCTION DTCID61 "" /begin DEF_CHARACTERISTIC /end DEF_CHARACTERISTIC /begin IN_MEASUREMENT /end IN_MEASUREMENT /begin OUT_MEASUREMENT /end OUT_MEASUREMENT /end FUNCTION
/begin FUNCTION DTCID62 "" /begin DEF_CHARACTERISTIC /end DEF_CHARACTERISTIC /begin IN_MEASUREMENT /end IN_MEASUREMENT /begin OUT_MEASUREMENT /end OUT_MEASUREMENT /end FUNCTION
/begin FUNCTION DTCID63 "" /begin DEF_CHARACTERISTIC /end DEF_CHARACTERISTIC /begin IN_MEASUREMENT /end IN_MEASUREMENT /begin OUT_MEASUREMENT /end OUT_MEASUREMENT /end FUNCTION
/begin FUNCTION DTCID64 "" /begin DEF_CHARACTERISTIC /end DEF_CHARACTERISTIC /begin IN_MEASUREMENT /end IN_MEASUREMENT /begin OUT_MEASUREMENT /end OUT_MEASUREMENT /end FUNCTION
/begin FUNCTION DTCID65 "" /begin DEF_CHARACTERISTIC /end DEF_CHARACTERISTIC /begin IN_MEASUREMENT /end IN_MEASUREMENT /begin OUT_MEASUREMENT /end OUT_MEASUREMENT /end FUNCTION
/begin FUNCTION DTCID66 "" /begin DEF_CHARACTERISTIC /end DEF_CHARACTERISTIC /begin IN_MEASUREMENT /end IN_MEASUREMENT /begin OUT_MEASUREMENT /end OUT_MEASUREMENT /end FUNCTION
/begin FUNCTION DTCID67 "" /begin DEF_CHARACTERISTIC /end DEF_CHARACTERISTIC /begin IN_MEASUREMENT /end IN_MEASUREMENT /begin OUT_MEASUREMENT /end OUT_MEASUREMENT /end FUNCTION
/begin FUNCTION DTCID68 "" /begin DEF_CHARACTERISTIC /end DEF_CHARACTERISTIC /begin IN_MEASUREMENT /end IN_MEASUREMENT /begin OUT_MEASUREMENT /end OUT_MEASUREMENT /end FUNCTION
/begin FUNCTION DTCID69 "" /begin DEF_CHARACTERISTIC /end DEF_CHARACTERISTIC /begin IN_MEASUREMENT /end IN_MEASUREMENT /begin OUT_MEASUREMENT /end OUT_MEASUREMENT /end FUNCTION
/begin FUNCTION DTCID7 "" /begin DEF_CHARACTERISTIC /end DEF_CHARACTERISTIC /begin IN_MEASUREMENT /end IN_MEASUREMENT /begin OUT_MEASUREMENT /end OUT_MEASUREMENT /end FUNCTION
/begin FUNCTION DTCID70 "" /begin DEF_CHARACTERISTIC /end DEF_CHARACTERISTIC /begin IN_MEASUREMENT /end IN_MEASUREMENT /begin OUT_MEASUREMENT /end OUT_MEASUREMENT /end FUNCTION
/begin FUNCTION DTCID71 "" /begin DEF_CHARACTERISTIC /end DEF_CHARACTERISTIC /begin IN_MEASUREMENT /end IN_MEASUREMENT /begin OUT_MEASUREMENT /end OUT_MEASUREMENT /end FUNCTION
/begin FUNCTION DTCID72 "" /begin DEF_CHARACTERISTIC /end DEF_CHARACTERISTIC /begin IN_MEASUREMENT /end IN_MEASUREMENT /begin OUT_MEASUREMENT /end OUT_MEASUREMENT /end FUNCTION
/begin FUNCTION DTCID73 "" /begin DEF_CHARACTERISTIC /end DEF_CHARACTERISTIC /begin IN_MEASUREMENT /end IN_MEASUREMENT /begin OUT_MEASUREMENT /end OUT_MEASUREMENT /end FUNCTION
/begin FUNCTION DTCID74 "" /begin DEF_CHARACTERISTIC /end DEF_CHARACTERISTIC /begin IN_MEASUREMENT /end IN_MEASUREMENT /begin OUT_MEASUREMENT /end OUT_MEASUREMENT /end FUNCTION
/begin FUNCTION DTCID75 "" /begin DEF_CHARACTERISTIC /end DEF_CHARACTERISTIC /begin IN_MEASUREMENT /end IN_MEASUREMENT /begin OUT_MEASUREMENT /end OUT_MEASUREMENT /end FUNCTION
/begin FUNCTION DTCID76 "" /begin DEF_CHARACTERISTIC /end DEF_CHARACTERISTIC /begin IN_MEASUREMENT /end IN_MEASUREMENT /begin OUT_MEASUREMENT /end OUT_MEASUREMENT /end FUNCTION
/begin FUNCTION DTCID77 "" /begin DEF_CHARACTERISTIC /end DEF_CHARACTERISTIC /begin IN_MEASUREMENT /end IN_MEASUREMENT /begin OUT_MEASUREMENT /end OUT_MEASUREMENT /end FUNCTION
/begin FUNCTION DTCID78 "" /begin DEF_CHARACTERISTIC /end DEF_CHARACTERISTIC /begin IN_MEASUREMENT /end IN_MEASUREMENT /begin OUT_MEASUREMENT /end OUT_MEASUREMENT /end FUNCTION
/begin FUNCTION DTCID79 "" /begin DEF_CHARACTERISTIC /end DEF_CHARACTERISTIC /begin IN_MEASUREMENT /end IN_MEASUREMENT /begin OUT_MEASUREMENT /end OUT_MEASUREMENT /end FUNCTION
/begin FUNCTION DTCID8 "" /begin DEF_CHARACTERISTIC /end DEF_CHARACTERISTIC /begin IN_MEASUREMENT /end IN_MEASUREMENT /begin OUT_MEASUREMENT /end OUT_MEASUREMENT /end FUNCTION
/begin FUNCTION DTCID80 "" /begin DEF_CHARACTERISTIC /end DEF_CHARACTERISTIC /begin IN_MEASUREMENT /end IN_MEASUREMENT /begin OUT_MEASUREMENT /end OUT_MEASUREMENT /end FUNCTION
/begin FUNCTION DTCID81 "" /begin DEF_CHARACTERISTIC /end DEF_CHARACTERISTIC /begin IN_MEASUREMENT /end IN_MEASUREMENT /begin OUT_MEASUREMENT /end OUT_MEASUREMENT /end FUNCTION
/begin FUNCTION DTCID82 "" /begin DEF_CHARACTERISTIC /end DEF_CHARACTERISTIC /begin IN_MEASUREMENT /end IN_MEASUREMENT /begin OUT_MEASUREMENT /end OUT_MEASUREMENT /end FUNCTION
/begin FUNCTION DTCID83 "" /begin DEF_CHARACTERISTIC /end DEF_CHARACTERISTIC /begin IN_MEASUREMENT /end IN_MEASUREMENT /begin OUT_MEASUREMENT /end OUT_MEASUREMENT /end FUNCTION
/begin FUNCTION DTCID84 "" /begin DEF_CHARACTERISTIC /end DEF_CHARACTERISTIC /begin IN_MEASUREMENT /end IN_MEASUREMENT /begin OUT_MEASUREMENT /end OUT_MEASUREMENT /end FUNCTION
/begin FUNCTION DTCID85 "" /begin DEF_CHARACTERISTIC /end DEF_CHARACTERISTIC /begin IN_MEASUREMENT /end IN_MEASUREMENT /begin OUT_MEASUREMENT /end OUT_MEASUREMENT /end FUNCTION
/begin FUNCTION DTCID86 "" /begin DEF_CHARACTERISTIC /end DEF_CHARACTERISTIC /begin IN_MEASUREMENT /end IN_MEASUREMENT /begin OUT_MEASUREMENT /end OUT_MEASUREMENT /end FUNCTION
/begin FUNCTION DTCID87 "" /begin DEF_CHARACTERISTIC /end DEF_CHARACTERISTIC /begin IN_MEASUREMENT /end IN_MEASUREMENT /begin OUT_MEASUREMENT /end OUT_MEASUREMENT /end FUNCTION
/begin FUNCTION DTCID88 "" /begin DEF_CHARACTERISTIC /end DEF_CHARACTERISTIC /begin IN_MEASUREMENT /end IN_MEASUREMENT /begin OUT_MEASUREMENT /end OUT_MEASUREMENT /end FUNCTION
/begin FUNCTION DTCID89 "" /begin DEF_CHARACTERISTIC /end DEF_CHARACTERISTIC /begin IN_MEASUREMENT /end IN_MEASUREMENT /begin OUT_MEASUREMENT /end OUT_MEASUREMENT /end FUNCTION
/begin FUNCTION DTCID9 "" /begin DEF_CHARACTERISTIC /end DEF_CHARACTERISTIC /begin IN_MEASUREMENT /end IN_MEASUREMENT /begin OUT_MEASUREMENT /end OUT_MEASUREMENT /end FUNCTION
/begin FUNCTION DTCID90 "" /begin DEF_CHARACTERISTIC /end DEF_CHARACTERISTIC /begin IN_MEASUREMENT /end IN_MEASUREMENT /begin OUT_MEASUREMENT /end OUT_MEASUREMENT /end FUNCTION
/begin FUNCTION DTCID91 "" /begin DEF_CHARACTERISTIC /end DEF_CHARACTERISTIC /begin IN_MEASUREMENT /end IN_MEASUREMENT /begin OUT_MEASUREMENT /end OUT_MEASUREMENT /end FUNCTION
/begin FUNCTION DTCID92 "" /begin DEF_CHARACTERISTIC /end DEF_CHARACTERISTIC /begin IN_MEASUREMENT /end IN_MEASUREMENT /begin OUT_MEASUREMENT /end OUT_MEASUREMENT /end FUNCTION
/begin FUNCTION DTCID93 "" /begin DEF_CHARACTERISTIC /end DEF_CHARACTERISTIC /begin IN_MEASUREMENT /end IN_MEASUREMENT /begin OUT_MEASUREMENT /end OUT_MEASUREMENT /end FUNCTION
/begin FUNCTION DTCID94 "" /begin DEF_CHARACTERISTIC /end DEF_CHARACTERISTIC /begin IN_MEASUREMENT /end IN_MEASUREMENT /begin OUT_MEASUREMENT /end OUT_MEASUREMENT /end FUNCTION
/begin FUNCTION DTCID95 "" /begin DEF_CHARACTERISTIC /end DEF_CHARACTERISTIC /begin IN_MEASUREMENT /end IN_MEASUREMENT /begin OUT_MEASUREMENT /end OUT_MEASUREMENT /end FUNCTION
/begin FUNCTION DTCID96 "" /begin DEF_CHARACTERISTIC /end DEF_CHARACTERISTIC /begin IN_MEASUREMENT /end IN_MEASUREMENT /begin OUT_MEASUREMENT /end OUT_MEASUREMENT /end FUNCTION
/begin FUNCTION DTCID97 "" /begin DEF_CHARACTERISTIC /end DEF_CHARACTERISTIC /begin IN_MEASUREMENT /end IN_MEASUREMENT /begin OUT_MEASUREMENT /end OUT_MEASUREMENT /end FUNCTION
/begin FUNCTION DTCID98 "" /begin DEF_CHARACTERISTIC /end DEF_CHARACTERISTIC /begin IN_MEASUREMENT /end IN_MEASUREMENT /begin OUT_MEASUREMENT /end OUT_MEASUREMENT /end FUNCTION
/begin FUNCTION DTCID99 "" /begin DEF_CHARACTERISTIC /end DEF_CHARACTERISTIC /begin IN_MEASUREMENT /end IN_MEASUREMENT /begin OUT_MEASUREMENT /end OUT_MEASUREMENT /end FUNCTION
/begin FUNCTION Constant222 "" /begin DEF_CHARACTERISTIC /end DEF_CHARACTERISTIC /begin IN_MEASUREMENT /end IN_MEASUREMENT /begin OUT_MEASUREMENT VDTC_DTCArray_raw32 /end OUT_MEASUREMENT /end FUNCTION
/begin FUNCTION UnitConverter "" /begin DEF_CHARACTERISTIC /end DEF_CHARACTERISTIC /begin IN_MEASUREMENT /end IN_MEASUREMENT /begin OUT_MEASUREMENT VDTC_HeaderArray_raw32 /end OUT_MEASUREMENT /end FUNCTION
/begin FUNCTION OR "" /begin DEF_CHARACTERISTIC /end DEF_CHARACTERISTIC /begin IN_MEASUREMENT /end IN_MEASUREMENT /begin OUT_MEASUREMENT /end OUT_MEASUREMENT /end FUNCTION
/begin FUNCTION OR1 "" /begin DEF_CHARACTERISTIC /end DEF_CHARACTERISTIC /begin IN_MEASUREMENT /end IN_MEASUREMENT /begin OUT_MEASUREMENT /end OUT_MEASUREMENT /end FUNCTION
/begin FUNCTION OR10 "" /begin DEF_CHARACTERISTIC /end DEF_CHARACTERISTIC /begin IN_MEASUREMENT /end IN_MEASUREMENT /begin OUT_MEASUREMENT /end OUT_MEASUREMENT /end FUNCTION
/begin FUNCTION OR11 "" /begin DEF_CHARACTERISTIC /end DEF_CHARACTERISTIC /begin IN_MEASUREMENT /end IN_MEASUREMENT /begin OUT_MEASUREMENT /end OUT_MEASUREMENT /end FUNCTION
/begin FUNCTION OR12 "" /begin DEF_CHARACTERISTIC /end DEF_CHARACTERISTIC /begin IN_MEASUREMENT /end IN_MEASUREMENT /begin OUT_MEASUREMENT /end OUT_MEASUREMENT /end FUNCTION
/begin FUNCTION OR13 "" /begin DEF_CHARACTERISTIC /end DEF_CHARACTERISTIC /begin IN_MEASUREMENT /end IN_MEASUREMENT /begin OUT_MEASUREMENT /end OUT_MEASUREMENT /end FUNCTION
/begin FUNCTION OR14 "" /begin DEF_CHARACTERISTIC /end DEF_CHARACTERISTIC /begin IN_MEASUREMENT /end IN_MEASUREMENT /begin OUT_MEASUREMENT /end OUT_MEASUREMENT /end FUNCTION
/begin FUNCTION OR15 "" /begin DEF_CHARACTERISTIC /end DEF_CHARACTERISTIC /begin IN_MEASUREMENT /end IN_MEASUREMENT /begin OUT_MEASUREMENT /end OUT_MEASUREMENT /end FUNCTION
/begin FUNCTION OR16 "" /begin DEF_CHARACTERISTIC /end DEF_CHARACTERISTIC /begin IN_MEASUREMENT /end IN_MEASUREMENT /begin OUT_MEASUREMENT /end OUT_MEASUREMENT /end FUNCTION
/begin FUNCTION OR17 "" /begin DEF_CHARACTERISTIC /end DEF_CHARACTERISTIC /begin IN_MEASUREMENT /end IN_MEASUREMENT /begin OUT_MEASUREMENT /end OUT_MEASUREMENT /end FUNCTION
/begin FUNCTION OR18 "" /begin DEF_CHARACTERISTIC /end DEF_CHARACTERISTIC /begin IN_MEASUREMENT /end IN_MEASUREMENT /begin OUT_MEASUREMENT /end OUT_MEASUREMENT /end FUNCTION
/begin FUNCTION OR19 "" /begin DEF_CHARACTERISTIC /end DEF_CHARACTERISTIC /begin IN_MEASUREMENT /end IN_MEASUREMENT /begin OUT_MEASUREMENT /end OUT_MEASUREMENT /end FUNCTION
/begin FUNCTION OR2 "" /begin DEF_CHARACTERISTIC /end DEF_CHARACTERISTIC /begin IN_MEASUREMENT /end IN_MEASUREMENT /begin OUT_MEASUREMENT /end OUT_MEASUREMENT /end FUNCTION
/begin FUNCTION OR20 "" /begin DEF_CHARACTERISTIC /end DEF_CHARACTERISTIC /begin IN_MEASUREMENT /end IN_MEASUREMENT /begin OUT_MEASUREMENT VHAL_TriggerDTC_flg /end OUT_MEASUREMENT /end FUNCTION
/begin FUNCTION OR3 "" /begin DEF_CHARACTERISTIC /end DEF_CHARACTERISTIC /begin IN_MEASUREMENT /end IN_MEASUREMENT /begin OUT_MEASUREMENT /end OUT_MEASUREMENT /end FUNCTION
/begin FUNCTION OR4 "" /begin DEF_CHARACTERISTIC /end DEF_CHARACTERISTIC /begin IN_MEASUREMENT /end IN_MEASUREMENT /begin OUT_MEASUREMENT /end OUT_MEASUREMENT /end FUNCTION
/begin FUNCTION OR5 "" /begin DEF_CHARACTERISTIC /end DEF_CHARACTERISTIC /begin IN_MEASUREMENT /end IN_MEASUREMENT /begin OUT_MEASUREMENT /end OUT_MEASUREMENT /end FUNCTION
/begin FUNCTION OR6 "" /begin DEF_CHARACTERISTIC /end DEF_CHARACTERISTIC /begin IN_MEASUREMENT /end IN_MEASUREMENT /begin OUT_MEASUREMENT /end OUT_MEASUREMENT /end FUNCTION
/begin FUNCTION OR7 "" /begin DEF_CHARACTERISTIC /end DEF_CHARACTERISTIC /begin IN_MEASUREMENT /end IN_MEASUREMENT /begin OUT_MEASUREMENT /end OUT_MEASUREMENT /end FUNCTION
/begin FUNCTION OR8 "" /begin DEF_CHARACTERISTIC /end DEF_CHARACTERISTIC /begin IN_MEASUREMENT /end IN_MEASUREMENT /begin OUT_MEASUREMENT /end OUT_MEASUREMENT /end FUNCTION
/begin FUNCTION OR9 "" /begin DEF_CHARACTERISTIC /end DEF_CHARACTERISTIC /begin IN_MEASUREMENT /end IN_MEASUREMENT /begin OUT_MEASUREMENT /end OUT_MEASUREMENT /end FUNCTION
/begin FUNCTION Enabled_Subsystem ""
 /begin SUB_FUNCTION VOUTP_FlashIDvalid_enum NVM1 Subsystem convert_in convert_in1 convert_in10 convert_in11 convert_in12 convert_in13 convert_in14 convert_in15 convert_in16 convert_in17 convert_in18 convert_in19 convert_in2 convert_in20 convert_in21 convert_in22 convert_in23 convert_in24 convert_in25 convert_in26 convert_in3 convert_in4 convert_in5 convert_in6 convert_in7 convert_in8 convert_in9 Shift_Arithmetic Shift_Arithmetic1 Shift_Arithmetic10 Shift_Arithmetic100 Shift_Arithmetic101 Shift_Arithmetic102 Shift_Arithmetic103 Shift_Arithmetic104 Shift_Arithmetic105 Shift_Arithmetic106 Shift_Arithmetic107 Shift_Arithmetic108 Shift_Arithmetic109 Shift_Arithmetic11 Shift_Arithmetic110 Shift_Arithmetic111 Shift_Arithmetic112 Shift_Arithmetic113 Shift_Arithmetic114 Shift_Arithmetic115 Shift_Arithmetic116 Shift_Arithmetic117 Shift_Arithmetic118 Shift_Arithmetic119 Shift_Arithmetic12 Shift_Arithmetic120 Shift_Arithmetic121 Shift_Arithmetic122 Shift_Arithmetic123 Shift_Arithmetic124 Shift_Arithmetic125 Shift_Arithmetic126 Shift_Arithmetic127 Shift_Arithmetic128 Shift_Arithmetic129 Shift_Arithmetic13 Shift_Arithmetic130 Shift_Arithmetic131 Shift_Arithmetic132 Shift_Arithmetic133 Shift_Arithmetic134 Shift_Arithmetic135 Shift_Arithmetic136 Shift_Arithmetic137 Shift_Arithmetic138 Shift_Arithmetic139 Shift_Arithmetic14 Shift_Arithmetic140 Shift_Arithmetic141 Shift_Arithmetic142 Shift_Arithmetic143 Shift_Arithmetic144 Shift_Arithmetic145 Shift_Arithmetic146 Shift_Arithmetic147 Shift_Arithmetic148 Shift_Arithmetic149 Shift_Arithmetic15 Shift_Arithmetic150 Shift_Arithmetic151 Shift_Arithmetic152 Shift_Arithmetic153 Shift_Arithmetic154 Shift_Arithmetic155 Shift_Arithmetic156 Shift_Arithmetic157 Shift_Arithmetic158 Shift_Arithmetic159 Shift_Arithmetic16 Shift_Arithmetic160 Shift_Arithmetic161 Shift_Arithmetic162 Shift_Arithmetic163 Shift_Arithmetic164 Shift_Arithmetic165 Shift_Arithmetic166 Shift_Arithmetic167 Shift_Arithmetic168 Shift_Arithmetic169 Shift_Arithmetic17 Shift_Arithmetic170 Shift_Arithmetic171 Shift_Arithmetic172 Shift_Arithmetic173 Shift_Arithmetic174 Shift_Arithmetic175 Shift_Arithmetic176 Shift_Arithmetic177 Shift_Arithmetic178 Shift_Arithmetic179 Shift_Arithmetic18 Shift_Arithmetic180 Shift_Arithmetic181 Shift_Arithmetic182 Shift_Arithmetic183 Shift_Arithmetic184 Shift_Arithmetic185 Shift_Arithmetic186 Shift_Arithmetic187 Shift_Arithmetic188 Shift_Arithmetic189 Shift_Arithmetic19 Shift_Arithmetic190 Shift_Arithmetic191 Shift_Arithmetic192 Shift_Arithmetic193 Shift_Arithmetic194 Shift_Arithmetic195 Shift_Arithmetic196 Shift_Arithmetic197 Shift_Arithmetic198 Shift_Arithmetic199 Shift_Arithmetic2 Shift_Arithmetic20 Shift_Arithmetic200 Shift_Arithmetic201 Shift_Arithmetic202 Shift_Arithmetic203 Shift_Arithmetic204 Shift_Arithmetic205 Shift_Arithmetic206 Shift_Arithmetic207 Shift_Arithmetic208 Shift_Arithmetic209 Shift_Arithmetic21 Shift_Arithmetic210 Shift_Arithmetic211 Shift_Arithmetic212 Shift_Arithmetic213 Shift_Arithmetic214 Shift_Arithmetic215 Shift_Arithmetic216 Shift_Arithmetic217 Shift_Arithmetic218 Shift_Arithmetic219 Shift_Arithmetic22 Shift_Arithmetic220 Shift_Arithmetic221 Shift_Arithmetic222 Shift_Arithmetic223 Shift_Arithmetic224 Shift_Arithmetic225 Shift_Arithmetic226 Shift_Arithmetic227 Shift_Arithmetic228 Shift_Arithmetic229 Shift_Arithmetic23 Shift_Arithmetic230 Shift_Arithmetic231 Shift_Arithmetic232 Shift_Arithmetic233 Shift_Arithmetic234 Shift_Arithmetic235 Shift_Arithmetic236 Shift_Arithmetic237 Shift_Arithmetic238 Shift_Arithmetic239 Shift_Arithmetic24 Shift_Arithmetic240 Shift_Arithmetic241 Shift_Arithmetic242 Shift_Arithmetic243 Shift_Arithmetic244 Shift_Arithmetic245 Shift_Arithmetic246 Shift_Arithmetic247 Shift_Arithmetic248 Shift_Arithmetic249 Shift_Arithmetic25 Shift_Arithmetic250 Shift_Arithmetic251 Shift_Arithmetic252 Shift_Arithmetic253 Shift_Arithmetic254 Shift_Arithmetic255 Shift_Arithmetic256 Shift_Arithmetic257 Shift_Arithmetic258 Shift_Arithmetic259 Shift_Arithmetic26 Shift_Arithmetic260 Shift_Arithmetic261 Shift_Arithmetic262 Shift_Arithmetic263 Shift_Arithmetic264 Shift_Arithmetic265 Shift_Arithmetic266 Shift_Arithmetic267 Shift_Arithmetic268 Shift_Arithmetic269 Shift_Arithmetic27 Shift_Arithmetic270 Shift_Arithmetic271 Shift_Arithmetic272 Shift_Arithmetic273 Shift_Arithmetic274 Shift_Arithmetic275 Shift_Arithmetic276 Shift_Arithmetic277 Shift_Arithmetic278 Shift_Arithmetic279 Shift_Arithmetic28 Shift_Arithmetic280 Shift_Arithmetic281 Shift_Arithmetic282 Shift_Arithmetic283 Shift_Arithmetic284 Shift_Arithmetic285 Shift_Arithmetic286 Shift_Arithmetic287 Shift_Arithmetic288 Shift_Arithmetic289 Shift_Arithmetic29 Shift_Arithmetic290 Shift_Arithmetic291 Shift_Arithmetic292 Shift_Arithmetic293 Shift_Arithmetic294 Shift_Arithmetic295 Shift_Arithmetic296 Shift_Arithmetic297 Shift_Arithmetic298 Shift_Arithmetic299 Shift_Arithmetic3 Shift_Arithmetic30 Shift_Arithmetic300 Shift_Arithmetic301 Shift_Arithmetic302 Shift_Arithmetic303 Shift_Arithmetic304 Shift_Arithmetic305 Shift_Arithmetic306 Shift_Arithmetic307 Shift_Arithmetic308 Shift_Arithmetic309 Shift_Arithmetic31 Shift_Arithmetic310 Shift_Arithmetic311 Shift_Arithmetic312 Shift_Arithmetic313 Shift_Arithmetic314 Shift_Arithmetic315 Shift_Arithmetic316 Shift_Arithmetic317 Shift_Arithmetic318 Shift_Arithmetic319 Shift_Arithmetic32 Shift_Arithmetic320 Shift_Arithmetic321 Shift_Arithmetic322 Shift_Arithmetic323 Shift_Arithmetic324 Shift_Arithmetic325 Shift_Arithmetic326 Shift_Arithmetic327 Shift_Arithmetic328 Shift_Arithmetic329 Shift_Arithmetic33 Shift_Arithmetic330 Shift_Arithmetic34 Shift_Arithmetic35 Shift_Arithmetic36 Shift_Arithmetic37 Shift_Arithmetic38 Shift_Arithmetic39 Shift_Arithmetic4 Shift_Arithmetic40 Shift_Arithmetic41 Shift_Arithmetic42 Shift_Arithmetic43 Shift_Arithmetic44 Shift_Arithmetic45 Shift_Arithmetic46 Shift_Arithmetic47 Shift_Arithmetic48 Shift_Arithmetic49 Shift_Arithmetic5 Shift_Arithmetic50 Shift_Arithmetic51 Shift_Arithmetic52 Shift_Arithmetic53 Shift_Arithmetic54 Shift_Arithmetic55 Shift_Arithmetic56 Shift_Arithmetic57 Shift_Arithmetic58 Shift_Arithmetic59 Shift_Arithmetic6 Shift_Arithmetic60 Shift_Arithmetic61 Shift_Arithmetic62 Shift_Arithmetic63 Shift_Arithmetic64 Shift_Arithmetic65 Shift_Arithmetic66 Shift_Arithmetic67 Shift_Arithmetic68 Shift_Arithmetic69 Shift_Arithmetic7 Shift_Arithmetic70 Shift_Arithmetic71 Shift_Arithmetic72 Shift_Arithmetic73 Shift_Arithmetic74 Shift_Arithmetic75 Shift_Arithmetic76 Shift_Arithmetic77 Shift_Arithmetic78 Shift_Arithmetic79 Shift_Arithmetic8 Shift_Arithmetic80 Shift_Arithmetic81 Shift_Arithmetic82 Shift_Arithmetic83 Shift_Arithmetic84 Shift_Arithmetic85 Shift_Arithmetic86 Shift_Arithmetic87 Shift_Arithmetic88 Shift_Arithmetic89 Shift_Arithmetic9 Shift_Arithmetic90 Shift_Arithmetic91 Shift_Arithmetic92 Shift_Arithmetic93 Shift_Arithmetic94 Shift_Arithmetic95 Shift_Arithmetic96 Shift_Arithmetic97 Shift_Arithmetic98 Shift_Arithmetic99 Constant Data_Type_Conversion10 Data_Type_Conversion104 Data_Type_Conversion105 Data_Type_Conversion106 Data_Type_Conversion108 Data_Type_Conversion109 Data_Type_Conversion11 Data_Type_Conversion110 Data_Type_Conversion111 Data_Type_Conversion113 Data_Type_Conversion114 Data_Type_Conversion115 Data_Type_Conversion116 Data_Type_Conversion118 Data_Type_Conversion119 Data_Type_Conversion12 Data_Type_Conversion120 Data_Type_Conversion121 Data_Type_Conversion123 Data_Type_Conversion124 Data_Type_Conversion125 Data_Type_Conversion126 Data_Type_Conversion127 Data_Type_Conversion128 Data_Type_Conversion129 Data_Type_Conversion13 Data_Type_Conversion130 Data_Type_Conversion131 Data_Type_Conversion132 Data_Type_Conversion133 Data_Type_Conversion134 Data_Type_Conversion135 Data_Type_Conversion136 Data_Type_Conversion137 Data_Type_Conversion138 Data_Type_Conversion139 Data_Type_Conversion140 Data_Type_Conversion141 Data_Type_Conversion142 Data_Type_Conversion143 Data_Type_Conversion144 Data_Type_Conversion145 Data_Type_Conversion15 Data_Type_Conversion16 Data_Type_Conversion17 Data_Type_Conversion18 Data_Type_Conversion194 Data_Type_Conversion20 Data_Type_Conversion21 Data_Type_Conversion22 Data_Type_Conversion223 Data_Type_Conversion225 Data_Type_Conversion227 Data_Type_Conversion229 Data_Type_Conversion23 Data_Type_Conversion233 Data_Type_Conversion238 Data_Type_Conversion239 Data_Type_Conversion241 Data_Type_Conversion242 Data_Type_Conversion244 Data_Type_Conversion245 Data_Type_Conversion247 Data_Type_Conversion248 Data_Type_Conversion25 Data_Type_Conversion250 Data_Type_Conversion251 Data_Type_Conversion253 Data_Type_Conversion254 Data_Type_Conversion26 Data_Type_Conversion266 Data_Type_Conversion267 Data_Type_Conversion268 Data_Type_Conversion27 Data_Type_Conversion270 Data_Type_Conversion271 Data_Type_Conversion272 Data_Type_Conversion274 Data_Type_Conversion275 Data_Type_Conversion277 Data_Type_Conversion278 Data_Type_Conversion279 Data_Type_Conversion280 Data_Type_Conversion281 Data_Type_Conversion282 Data_Type_Conversion283 Data_Type_Conversion285 Data_Type_Conversion286 Data_Type_Conversion288 Data_Type_Conversion289 Data_Type_Conversion29 Data_Type_Conversion290 Data_Type_Conversion291 Data_Type_Conversion293 Data_Type_Conversion294 Data_Type_Conversion295 Data_Type_Conversion296 Data_Type_Conversion298 Data_Type_Conversion299 Data_Type_Conversion30 Data_Type_Conversion300 Data_Type_Conversion301 Data_Type_Conversion303 Data_Type_Conversion304 Data_Type_Conversion305 Data_Type_Conversion306 Data_Type_Conversion308 Data_Type_Conversion309 Data_Type_Conversion31 Data_Type_Conversion310 Data_Type_Conversion311 Data_Type_Conversion313 Data_Type_Conversion314 Data_Type_Conversion315 Data_Type_Conversion316 Data_Type_Conversion317 Data_Type_Conversion318 Data_Type_Conversion319 Data_Type_Conversion32 Data_Type_Conversion320 Data_Type_Conversion321 Data_Type_Conversion322 Data_Type_Conversion323 Data_Type_Conversion324 Data_Type_Conversion325 Data_Type_Conversion326 Data_Type_Conversion328 Data_Type_Conversion329 Data_Type_Conversion330 Data_Type_Conversion331 Data_Type_Conversion332 Data_Type_Conversion333 Data_Type_Conversion334 Data_Type_Conversion335 Data_Type_Conversion336 Data_Type_Conversion337 Data_Type_Conversion338 Data_Type_Conversion339 Data_Type_Conversion34 Data_Type_Conversion340 Data_Type_Conversion341 Data_Type_Conversion342 Data_Type_Conversion343 Data_Type_Conversion344 Data_Type_Conversion345 Data_Type_Conversion346 Data_Type_Conversion347 Data_Type_Conversion348 Data_Type_Conversion349 Data_Type_Conversion35 Data_Type_Conversion350 Data_Type_Conversion351 Data_Type_Conversion352 Data_Type_Conversion353 Data_Type_Conversion354 Data_Type_Conversion355 Data_Type_Conversion356 Data_Type_Conversion357 Data_Type_Conversion358 Data_Type_Conversion359 Data_Type_Conversion36 Data_Type_Conversion360 Data_Type_Conversion361 Data_Type_Conversion362 Data_Type_Conversion363 Data_Type_Conversion364 Data_Type_Conversion365 Data_Type_Conversion366 Data_Type_Conversion367 Data_Type_Conversion368 Data_Type_Conversion369 Data_Type_Conversion37 Data_Type_Conversion370 Data_Type_Conversion371 Data_Type_Conversion372 Data_Type_Conversion373 Data_Type_Conversion374 Data_Type_Conversion375 Data_Type_Conversion376 Data_Type_Conversion377 Data_Type_Conversion378 Data_Type_Conversion379 Data_Type_Conversion380 Data_Type_Conversion381 Data_Type_Conversion382 Data_Type_Conversion383 Data_Type_Conversion384 Data_Type_Conversion385 Data_Type_Conversion386 Data_Type_Conversion387 Data_Type_Conversion388 Data_Type_Conversion389 Data_Type_Conversion39 Data_Type_Conversion390 Data_Type_Conversion391 Data_Type_Conversion392 Data_Type_Conversion393 Data_Type_Conversion394 Data_Type_Conversion395 Data_Type_Conversion396 Data_Type_Conversion397 Data_Type_Conversion398 Data_Type_Conversion399 Data_Type_Conversion40 Data_Type_Conversion400 Data_Type_Conversion401 Data_Type_Conversion402 Data_Type_Conversion403 Data_Type_Conversion404 Data_Type_Conversion405 Data_Type_Conversion406 Data_Type_Conversion407 Data_Type_Conversion408 Data_Type_Conversion409 Data_Type_Conversion410 Data_Type_Conversion411 Data_Type_Conversion412 Data_Type_Conversion413 Data_Type_Conversion414 Data_Type_Conversion415 Data_Type_Conversion416 Data_Type_Conversion417 Data_Type_Conversion418 Data_Type_Conversion419 Data_Type_Conversion42 Data_Type_Conversion420 Data_Type_Conversion422 Data_Type_Conversion423 Data_Type_Conversion424 Data_Type_Conversion425 Data_Type_Conversion427 Data_Type_Conversion428 Data_Type_Conversion429 Data_Type_Conversion43 Data_Type_Conversion430 Data_Type_Conversion432 Data_Type_Conversion433 Data_Type_Conversion435 Data_Type_Conversion436 Data_Type_Conversion438 Data_Type_Conversion439 Data_Type_Conversion44 Data_Type_Conversion441 Data_Type_Conversion442 Data_Type_Conversion444 Data_Type_Conversion445 Data_Type_Conversion447 Data_Type_Conversion448 Data_Type_Conversion45 Data_Type_Conversion450 Data_Type_Conversion451 Data_Type_Conversion453 Data_Type_Conversion454 Data_Type_Conversion456 Data_Type_Conversion457 Data_Type_Conversion459 Data_Type_Conversion46 Data_Type_Conversion460 Data_Type_Conversion462 Data_Type_Conversion463 Data_Type_Conversion465 Data_Type_Conversion466 Data_Type_Conversion468 Data_Type_Conversion469 Data_Type_Conversion47 Data_Type_Conversion471 Data_Type_Conversion472 Data_Type_Conversion474 Data_Type_Conversion475 Data_Type_Conversion477 Data_Type_Conversion478 Data_Type_Conversion48 Data_Type_Conversion480 Data_Type_Conversion481 Data_Type_Conversion482 Data_Type_Conversion483 Data_Type_Conversion485 Data_Type_Conversion486 Data_Type_Conversion487 Data_Type_Conversion488 Data_Type_Conversion490 Data_Type_Conversion491 Data_Type_Conversion492 Data_Type_Conversion493 Data_Type_Conversion495 Data_Type_Conversion496 Data_Type_Conversion497 Data_Type_Conversion498 Data_Type_Conversion5 Data_Type_Conversion500 Data_Type_Conversion501 Data_Type_Conversion502 Data_Type_Conversion503 Data_Type_Conversion505 Data_Type_Conversion506 Data_Type_Conversion507 Data_Type_Conversion508 Data_Type_Conversion510 Data_Type_Conversion511 Data_Type_Conversion512 Data_Type_Conversion513 Data_Type_Conversion515 Data_Type_Conversion516 Data_Type_Conversion517 Data_Type_Conversion518 Data_Type_Conversion520 Data_Type_Conversion521 Data_Type_Conversion522 Data_Type_Conversion523 Data_Type_Conversion525 Data_Type_Conversion526 Data_Type_Conversion527 Data_Type_Conversion528 Data_Type_Conversion530 Data_Type_Conversion531 Data_Type_Conversion532 Data_Type_Conversion533 Data_Type_Conversion535 Data_Type_Conversion536 Data_Type_Conversion537 Data_Type_Conversion538 Data_Type_Conversion540 Data_Type_Conversion541 Data_Type_Conversion542 Data_Type_Conversion543 Data_Type_Conversion545 Data_Type_Conversion546 Data_Type_Conversion547 Data_Type_Conversion548 Data_Type_Conversion550 Data_Type_Conversion551 Data_Type_Conversion552 Data_Type_Conversion553 Data_Type_Conversion555 Data_Type_Conversion556 Data_Type_Conversion557 Data_Type_Conversion558 Data_Type_Conversion560 Data_Type_Conversion561 Data_Type_Conversion562 Data_Type_Conversion563 Data_Type_Conversion565 Data_Type_Conversion566 Data_Type_Conversion567 Data_Type_Conversion568 Data_Type_Conversion570 Data_Type_Conversion571 Data_Type_Conversion572 Data_Type_Conversion573 Data_Type_Conversion575 Data_Type_Conversion576 Data_Type_Conversion577 Data_Type_Conversion578 Data_Type_Conversion580 Data_Type_Conversion581 Data_Type_Conversion582 Data_Type_Conversion583 Data_Type_Conversion585 Data_Type_Conversion586 Data_Type_Conversion587 Data_Type_Conversion588 Data_Type_Conversion590 Data_Type_Conversion591 Data_Type_Conversion592 Data_Type_Conversion593 Data_Type_Conversion595 Data_Type_Conversion596 Data_Type_Conversion597 Data_Type_Conversion598 Data_Type_Conversion6 Data_Type_Conversion600 Data_Type_Conversion601 Data_Type_Conversion602 Data_Type_Conversion603 Data_Type_Conversion605 Data_Type_Conversion606 Data_Type_Conversion607 Data_Type_Conversion608 Data_Type_Conversion610 Data_Type_Conversion611 Data_Type_Conversion612 Data_Type_Conversion613 Data_Type_Conversion615 Data_Type_Conversion616 Data_Type_Conversion617 Data_Type_Conversion618 Data_Type_Conversion620 Data_Type_Conversion621 Data_Type_Conversion622 Data_Type_Conversion623 Data_Type_Conversion625 Data_Type_Conversion626 Data_Type_Conversion627 Data_Type_Conversion628 Data_Type_Conversion630 Data_Type_Conversion631 Data_Type_Conversion632 Data_Type_Conversion633 Data_Type_Conversion635 Data_Type_Conversion636 Data_Type_Conversion637 Data_Type_Conversion638 Data_Type_Conversion640 Data_Type_Conversion641 Data_Type_Conversion642 Data_Type_Conversion643 Data_Type_Conversion645 Data_Type_Conversion646 Data_Type_Conversion647 Data_Type_Conversion648 Data_Type_Conversion65 Data_Type_Conversion650 Data_Type_Conversion651 Data_Type_Conversion652 Data_Type_Conversion653 Data_Type_Conversion655 Data_Type_Conversion656 Data_Type_Conversion657 Data_Type_Conversion658 Data_Type_Conversion66 Data_Type_Conversion660 Data_Type_Conversion661 Data_Type_Conversion662 Data_Type_Conversion663 Data_Type_Conversion665 Data_Type_Conversion666 Data_Type_Conversion667 Data_Type_Conversion668 Data_Type_Conversion67 Data_Type_Conversion670 Data_Type_Conversion671 Data_Type_Conversion672 Data_Type_Conversion673 Data_Type_Conversion675 Data_Type_Conversion676 Data_Type_Conversion677 Data_Type_Conversion678 Data_Type_Conversion68 Data_Type_Conversion680 Data_Type_Conversion681 Data_Type_Conversion682 Data_Type_Conversion683 Data_Type_Conversion685 Data_Type_Conversion686 Data_Type_Conversion687 Data_Type_Conversion688 Data_Type_Conversion690 Data_Type_Conversion691 Data_Type_Conversion692 Data_Type_Conversion693 Data_Type_Conversion695 Data_Type_Conversion696 Data_Type_Conversion697 Data_Type_Conversion698 Data_Type_Conversion7 Data_Type_Conversion700 Data_Type_Conversion701 Data_Type_Conversion702 Data_Type_Conversion703 Data_Type_Conversion705 Data_Type_Conversion706 Data_Type_Conversion707 Data_Type_Conversion708 Data_Type_Conversion71 Data_Type_Conversion710 Data_Type_Conversion711 Data_Type_Conversion712 Data_Type_Conversion713 Data_Type_Conversion715 Data_Type_Conversion716 Data_Type_Conversion717 Data_Type_Conversion718 Data_Type_Conversion720 Data_Type_Conversion721 Data_Type_Conversion722 Data_Type_Conversion723 Data_Type_Conversion725 Data_Type_Conversion726 Data_Type_Conversion727 Data_Type_Conversion728 Data_Type_Conversion730 Data_Type_Conversion731 Data_Type_Conversion732 Data_Type_Conversion733 Data_Type_Conversion735 Data_Type_Conversion736 Data_Type_Conversion737 Data_Type_Conversion738 Data_Type_Conversion739 Data_Type_Conversion740 Data_Type_Conversion742 Data_Type_Conversion743 Data_Type_Conversion744 Data_Type_Conversion745 Data_Type_Conversion746 Data_Type_Conversion748 Data_Type_Conversion749 Data_Type_Conversion750 Data_Type_Conversion751 Data_Type_Conversion753 Data_Type_Conversion754 Data_Type_Conversion755 Data_Type_Conversion756 Data_Type_Conversion758 Data_Type_Conversion759 Data_Type_Conversion760 Data_Type_Conversion761 Data_Type_Conversion763 Data_Type_Conversion764 Data_Type_Conversion765 Data_Type_Conversion766 Data_Type_Conversion768 Data_Type_Conversion769 Data_Type_Conversion770 Data_Type_Conversion771 Data_Type_Conversion773 Data_Type_Conversion774 Data_Type_Conversion775 Data_Type_Conversion776 Data_Type_Conversion787 Data_Type_Conversion8 Data_Type_Conversion82 Data_Type_Conversion83 Data_Type_Conversion84 Data_Type_Conversion85 Data_Type_Conversion86 Data_Type_Conversion87 Data_Type_Conversion88 Data_Type_Conversion89 Data_Type_Conversion9 Data_Type_Conversion90 Data_Type_Conversion92 Data_Type_Conversion94 Data_Type_Conversion95 Data_Type_Conversion96 Data_Type_Conversion97 Data_Type_Conversion98 Gain Gain1 Gain2 Gain3 Multiply Multiply1 /end SUB_FUNCTION
 /begin DEF_CHARACTERISTIC /end DEF_CHARACTERISTIC
 /begin IN_MEASUREMENT /end IN_MEASUREMENT
 /begin OUT_MEASUREMENT /end OUT_MEASUREMENT
/end FUNCTION
/begin FUNCTION APSDFLL "" /begin SUB_FUNCTION /end SUB_FUNCTION /begin DEF_CHARACTERISTIC /end DEF_CHARACTERISTIC /begin IN_MEASUREMENT /end IN_MEASUREMENT /begin OUT_MEASUREMENT /end OUT_MEASUREMENT /end FUNCTION
/begin FUNCTION APSDFLR "" /begin SUB_FUNCTION /end SUB_FUNCTION /begin DEF_CHARACTERISTIC /end DEF_CHARACTERISTIC /begin IN_MEASUREMENT /end IN_MEASUREMENT /begin OUT_MEASUREMENT /end OUT_MEASUREMENT /end FUNCTION
/begin FUNCTION APSDRLL "" /begin SUB_FUNCTION /end SUB_FUNCTION /begin DEF_CHARACTERISTIC /end DEF_CHARACTERISTIC /begin IN_MEASUREMENT /end IN_MEASUREMENT /begin OUT_MEASUREMENT /end OUT_MEASUREMENT /end FUNCTION
/begin FUNCTION APSDRLR "" /begin SUB_FUNCTION /end SUB_FUNCTION /begin DEF_CHARACTERISTIC /end DEF_CHARACTERISTIC /begin IN_MEASUREMENT /end IN_MEASUREMENT /begin OUT_MEASUREMENT /end OUT_MEASUREMENT /end FUNCTION
/begin FUNCTION APSExitCondition "" /begin SUB_FUNCTION /end SUB_FUNCTION /begin DEF_CHARACTERISTIC /end DEF_CHARACTERISTIC /begin IN_MEASUREMENT /end IN_MEASUREMENT /begin OUT_MEASUREMENT /end OUT_MEASUREMENT /end FUNCTION
/begin FUNCTION APSHWVer "" /begin SUB_FUNCTION /end SUB_FUNCTION /begin DEF_CHARACTERISTIC /end DEF_CHARACTERISTIC /begin IN_MEASUREMENT /end IN_MEASUREMENT /begin OUT_MEASUREMENT /end OUT_MEASUREMENT /end FUNCTION
/begin FUNCTION APSProgressPCT "" /begin SUB_FUNCTION Data_Type_Conversion /end SUB_FUNCTION /begin DEF_CHARACTERISTIC /end DEF_CHARACTERISTIC /begin IN_MEASUREMENT /end IN_MEASUREMENT /begin OUT_MEASUREMENT /end OUT_MEASUREMENT /end FUNCTION
/begin FUNCTION APSRQDisplay "" /begin SUB_FUNCTION /end SUB_FUNCTION /begin DEF_CHARACTERISTIC /end DEF_CHARACTERISTIC /begin IN_MEASUREMENT /end IN_MEASUREMENT /begin OUT_MEASUREMENT /end OUT_MEASUREMENT /end FUNCTION
/begin FUNCTION APSSWVer "" /begin SUB_FUNCTION /end SUB_FUNCTION /begin DEF_CHARACTERISTIC /end DEF_CHARACTERISTIC /begin IN_MEASUREMENT /end IN_MEASUREMENT /begin OUT_MEASUREMENT /end OUT_MEASUREMENT /end FUNCTION
/begin FUNCTION PASAFCL "" /begin SUB_FUNCTION /end SUB_FUNCTION /begin DEF_CHARACTERISTIC /end DEF_CHARACTERISTIC /begin IN_MEASUREMENT /end IN_MEASUREMENT /begin OUT_MEASUREMENT /end OUT_MEASUREMENT /end FUNCTION
/begin FUNCTION PASAFCR "" /begin SUB_FUNCTION /end SUB_FUNCTION /begin DEF_CHARACTERISTIC /end DEF_CHARACTERISTIC /begin IN_MEASUREMENT /end IN_MEASUREMENT /begin OUT_MEASUREMENT /end OUT_MEASUREMENT /end FUNCTION
/begin FUNCTION PASAFML "" /begin SUB_FUNCTION /end SUB_FUNCTION /begin DEF_CHARACTERISTIC /end DEF_CHARACTERISTIC /begin IN_MEASUREMENT /end IN_MEASUREMENT /begin OUT_MEASUREMENT /end OUT_MEASUREMENT /end FUNCTION
/begin FUNCTION PASAFMR "" /begin SUB_FUNCTION /end SUB_FUNCTION /begin DEF_CHARACTERISTIC /end DEF_CHARACTERISTIC /begin IN_MEASUREMENT /end IN_MEASUREMENT /begin OUT_MEASUREMENT /end OUT_MEASUREMENT /end FUNCTION
/begin FUNCTION PASARCL "" /begin SUB_FUNCTION /end SUB_FUNCTION /begin DEF_CHARACTERISTIC /end DEF_CHARACTERISTIC /begin IN_MEASUREMENT /end IN_MEASUREMENT /begin OUT_MEASUREMENT /end OUT_MEASUREMENT /end FUNCTION
/begin FUNCTION PASARCR "" /begin SUB_FUNCTION /end SUB_FUNCTION /begin DEF_CHARACTERISTIC /end DEF_CHARACTERISTIC /begin IN_MEASUREMENT /end IN_MEASUREMENT /begin OUT_MEASUREMENT /end OUT_MEASUREMENT /end FUNCTION
/begin FUNCTION PASARML "" /begin SUB_FUNCTION /end SUB_FUNCTION /begin DEF_CHARACTERISTIC /end DEF_CHARACTERISTIC /begin IN_MEASUREMENT /end IN_MEASUREMENT /begin OUT_MEASUREMENT /end OUT_MEASUREMENT /end FUNCTION
/begin FUNCTION PASARMR "" /begin SUB_FUNCTION /end SUB_FUNCTION /begin DEF_CHARACTERISTIC /end DEF_CHARACTERISTIC /begin IN_MEASUREMENT /end IN_MEASUREMENT /begin OUT_MEASUREMENT /end OUT_MEASUREMENT /end FUNCTION
/begin FUNCTION PASChime "" /begin SUB_FUNCTION /end SUB_FUNCTION /begin DEF_CHARACTERISTIC /end DEF_CHARACTERISTIC /begin IN_MEASUREMENT /end IN_MEASUREMENT /begin OUT_MEASUREMENT /end OUT_MEASUREMENT /end FUNCTION
/begin FUNCTION PASDFCL "" /begin SUB_FUNCTION /end SUB_FUNCTION /begin DEF_CHARACTERISTIC /end DEF_CHARACTERISTIC /begin IN_MEASUREMENT /end IN_MEASUREMENT /begin OUT_MEASUREMENT /end OUT_MEASUREMENT /end FUNCTION
/begin FUNCTION PASDFCR "" /begin SUB_FUNCTION /end SUB_FUNCTION /begin DEF_CHARACTERISTIC /end DEF_CHARACTERISTIC /begin IN_MEASUREMENT /end IN_MEASUREMENT /begin OUT_MEASUREMENT /end OUT_MEASUREMENT /end FUNCTION
/begin FUNCTION PASDFML "" /begin SUB_FUNCTION /end SUB_FUNCTION /begin DEF_CHARACTERISTIC /end DEF_CHARACTERISTIC /begin IN_MEASUREMENT /end IN_MEASUREMENT /begin OUT_MEASUREMENT /end OUT_MEASUREMENT /end FUNCTION
/begin FUNCTION PASDFMR "" /begin SUB_FUNCTION /end SUB_FUNCTION /begin DEF_CHARACTERISTIC /end DEF_CHARACTERISTIC /begin IN_MEASUREMENT /end IN_MEASUREMENT /begin OUT_MEASUREMENT /end OUT_MEASUREMENT /end FUNCTION
/begin FUNCTION PASDRCL "" /begin SUB_FUNCTION /end SUB_FUNCTION /begin DEF_CHARACTERISTIC /end DEF_CHARACTERISTIC /begin IN_MEASUREMENT /end IN_MEASUREMENT /begin OUT_MEASUREMENT /end OUT_MEASUREMENT /end FUNCTION
/begin FUNCTION PASDRCR "" /begin SUB_FUNCTION /end SUB_FUNCTION /begin DEF_CHARACTERISTIC /end DEF_CHARACTERISTIC /begin IN_MEASUREMENT /end IN_MEASUREMENT /begin OUT_MEASUREMENT /end OUT_MEASUREMENT /end FUNCTION
/begin FUNCTION PASDRML "" /begin SUB_FUNCTION /end SUB_FUNCTION /begin DEF_CHARACTERISTIC /end DEF_CHARACTERISTIC /begin IN_MEASUREMENT /end IN_MEASUREMENT /begin OUT_MEASUREMENT /end OUT_MEASUREMENT /end FUNCTION
/begin FUNCTION PASDRMR "" /begin SUB_FUNCTION /end SUB_FUNCTION /begin DEF_CHARACTERISTIC /end DEF_CHARACTERISTIC /begin IN_MEASUREMENT /end IN_MEASUREMENT /begin OUT_MEASUREMENT /end OUT_MEASUREMENT /end FUNCTION
/begin FUNCTION PASModOperation "" /begin SUB_FUNCTION /end SUB_FUNCTION /begin DEF_CHARACTERISTIC /end DEF_CHARACTERISTIC /begin IN_MEASUREMENT /end IN_MEASUREMENT /begin OUT_MEASUREMENT /end OUT_MEASUREMENT /end FUNCTION
/begin FUNCTION PASSNSRLayout "" /begin SUB_FUNCTION /end SUB_FUNCTION /begin DEF_CHARACTERISTIC /end DEF_CHARACTERISTIC /begin IN_MEASUREMENT /end IN_MEASUREMENT /begin OUT_MEASUREMENT /end OUT_MEASUREMENT /end FUNCTION
/begin FUNCTION PASStaFSys "" /begin SUB_FUNCTION Data_Type_Conversion /end SUB_FUNCTION /begin DEF_CHARACTERISTIC /end DEF_CHARACTERISTIC /begin IN_MEASUREMENT /end IN_MEASUREMENT /begin OUT_MEASUREMENT /end OUT_MEASUREMENT /end FUNCTION
/begin FUNCTION USSStaFCL "" /begin SUB_FUNCTION Data_Type_Conversion /end SUB_FUNCTION /begin DEF_CHARACTERISTIC /end DEF_CHARACTERISTIC /begin IN_MEASUREMENT /end IN_MEASUREMENT /begin OUT_MEASUREMENT /end OUT_MEASUREMENT /end FUNCTION
/begin FUNCTION USSStaFCR "" /begin SUB_FUNCTION Data_Type_Conversion /end SUB_FUNCTION /begin DEF_CHARACTERISTIC /end DEF_CHARACTERISTIC /begin IN_MEASUREMENT /end IN_MEASUREMENT /begin OUT_MEASUREMENT /end OUT_MEASUREMENT /end FUNCTION
/begin FUNCTION USSStaFLL "" /begin SUB_FUNCTION Data_Type_Conversion /end SUB_FUNCTION /begin DEF_CHARACTERISTIC /end DEF_CHARACTERISTIC /begin IN_MEASUREMENT /end IN_MEASUREMENT /begin OUT_MEASUREMENT /end OUT_MEASUREMENT /end FUNCTION
/begin FUNCTION USSStaFLR "" /begin SUB_FUNCTION Data_Type_Conversion /end SUB_FUNCTION /begin DEF_CHARACTERISTIC /end DEF_CHARACTERISTIC /begin IN_MEASUREMENT /end IN_MEASUREMENT /begin OUT_MEASUREMENT /end OUT_MEASUREMENT /end FUNCTION
/begin FUNCTION USSStaFML "" /begin SUB_FUNCTION Data_Type_Conversion /end SUB_FUNCTION /begin DEF_CHARACTERISTIC /end DEF_CHARACTERISTIC /begin IN_MEASUREMENT /end IN_MEASUREMENT /begin OUT_MEASUREMENT /end OUT_MEASUREMENT /end FUNCTION
/begin FUNCTION USSStaFMR "" /begin SUB_FUNCTION Data_Type_Conversion /end SUB_FUNCTION /begin DEF_CHARACTERISTIC /end DEF_CHARACTERISTIC /begin IN_MEASUREMENT /end IN_MEASUREMENT /begin OUT_MEASUREMENT /end OUT_MEASUREMENT /end FUNCTION
/begin FUNCTION USSStaRCL "" /begin SUB_FUNCTION Data_Type_Conversion /end SUB_FUNCTION /begin DEF_CHARACTERISTIC /end DEF_CHARACTERISTIC /begin IN_MEASUREMENT /end IN_MEASUREMENT /begin OUT_MEASUREMENT /end OUT_MEASUREMENT /end FUNCTION
/begin FUNCTION USSStaRCR "" /begin SUB_FUNCTION Data_Type_Conversion /end SUB_FUNCTION /begin DEF_CHARACTERISTIC /end DEF_CHARACTERISTIC /begin IN_MEASUREMENT /end IN_MEASUREMENT /begin OUT_MEASUREMENT /end OUT_MEASUREMENT /end FUNCTION
/begin FUNCTION USSStaRLL "" /begin SUB_FUNCTION Data_Type_Conversion /end SUB_FUNCTION /begin DEF_CHARACTERISTIC /end DEF_CHARACTERISTIC /begin IN_MEASUREMENT /end IN_MEASUREMENT /begin OUT_MEASUREMENT /end OUT_MEASUREMENT /end FUNCTION
/begin FUNCTION USSStaRLR "" /begin SUB_FUNCTION Data_Type_Conversion /end SUB_FUNCTION /begin DEF_CHARACTERISTIC /end DEF_CHARACTERISTIC /begin IN_MEASUREMENT /end IN_MEASUREMENT /begin OUT_MEASUREMENT /end OUT_MEASUREMENT /end FUNCTION
/begin FUNCTION USSStaRML "" /begin SUB_FUNCTION Data_Type_Conversion /end SUB_FUNCTION /begin DEF_CHARACTERISTIC /end DEF_CHARACTERISTIC /begin IN_MEASUREMENT /end IN_MEASUREMENT /begin OUT_MEASUREMENT /end OUT_MEASUREMENT /end FUNCTION
/begin FUNCTION USSStaRMR "" /begin SUB_FUNCTION Data_Type_Conversion /end SUB_FUNCTION /begin DEF_CHARACTERISTIC /end DEF_CHARACTERISTIC /begin IN_MEASUREMENT /end IN_MEASUREMENT /begin OUT_MEASUREMENT /end OUT_MEASUREMENT /end FUNCTION
/begin FUNCTION bus_creator "" /begin DEF_CHARACTERISTIC /end DEF_CHARACTERISTIC /begin IN_MEASUREMENT /end IN_MEASUREMENT /begin OUT_MEASUREMENT /end OUT_MEASUREMENT /end FUNCTION
/begin FUNCTION FD1_APS3 "" /begin DEF_CHARACTERISTIC /end DEF_CHARACTERISTIC /begin IN_MEASUREMENT /end IN_MEASUREMENT /begin OUT_MEASUREMENT /end OUT_MEASUREMENT /end FUNCTION
/begin FUNCTION APS3LifeCount "" /begin SUB_FUNCTION /end SUB_FUNCTION /begin DEF_CHARACTERISTIC /end DEF_CHARACTERISTIC /begin IN_MEASUREMENT /end IN_MEASUREMENT /begin OUT_MEASUREMENT /end OUT_MEASUREMENT /end FUNCTION
/begin FUNCTION APS3checksum "" /begin SUB_FUNCTION /end SUB_FUNCTION /begin DEF_CHARACTERISTIC /end DEF_CHARACTERISTIC /begin IN_MEASUREMENT /end IN_MEASUREMENT /begin OUT_MEASUREMENT /end OUT_MEASUREMENT /end FUNCTION
/begin FUNCTION APSDecReq "" /begin SUB_FUNCTION convert_out Data_Type_Conversion /end SUB_FUNCTION /begin DEF_CHARACTERISTIC /end DEF_CHARACTERISTIC /begin IN_MEASUREMENT /end IN_MEASUREMENT /begin OUT_MEASUREMENT /end OUT_MEASUREMENT /end FUNCTION
/begin FUNCTION APSDecReqA "" /begin SUB_FUNCTION Data_Type_Conversion /end SUB_FUNCTION /begin DEF_CHARACTERISTIC /end DEF_CHARACTERISTIC /begin IN_MEASUREMENT /end IN_MEASUREMENT /begin OUT_MEASUREMENT /end OUT_MEASUREMENT /end FUNCTION
/begin FUNCTION APSOpenPTG "" /begin SUB_FUNCTION Data_Type_Conversion /end SUB_FUNCTION /begin DEF_CHARACTERISTIC /end DEF_CHARACTERISTIC /begin IN_MEASUREMENT /end IN_MEASUREMENT /begin OUT_MEASUREMENT /end OUT_MEASUREMENT /end FUNCTION
/begin FUNCTION APSReq "" /begin SUB_FUNCTION /end SUB_FUNCTION /begin DEF_CHARACTERISTIC /end DEF_CHARACTERISTIC /begin IN_MEASUREMENT /end IN_MEASUREMENT /begin OUT_MEASUREMENT /end OUT_MEASUREMENT /end FUNCTION
/begin FUNCTION APSStaSystem "" /begin SUB_FUNCTION /end SUB_FUNCTION /begin DEF_CHARACTERISTIC /end DEF_CHARACTERISTIC /begin IN_MEASUREMENT /end IN_MEASUREMENT /begin OUT_MEASUREMENT /end OUT_MEASUREMENT /end FUNCTION
/begin FUNCTION Byte_0 "" /begin SUB_FUNCTION SignalPack /end SUB_FUNCTION /begin DEF_CHARACTERISTIC /end DEF_CHARACTERISTIC /begin IN_MEASUREMENT /end IN_MEASUREMENT /begin OUT_MEASUREMENT /end OUT_MEASUREMENT /end FUNCTION
/begin FUNCTION Byte_1 "" /begin SUB_FUNCTION SignalPack /end SUB_FUNCTION /begin DEF_CHARACTERISTIC /end DEF_CHARACTERISTIC /begin IN_MEASUREMENT /end IN_MEASUREMENT /begin OUT_MEASUREMENT /end OUT_MEASUREMENT /end FUNCTION
/begin FUNCTION Byte_10 "" /begin SUB_FUNCTION SignalPack convert_out UnitConverter UnitConverter1 /end SUB_FUNCTION /begin DEF_CHARACTERISTIC /end DEF_CHARACTERISTIC /begin IN_MEASUREMENT /end IN_MEASUREMENT /begin OUT_MEASUREMENT /end OUT_MEASUREMENT /end FUNCTION
/begin FUNCTION Byte_11 "" /begin SUB_FUNCTION SignalPack UnitConverter1 /end SUB_FUNCTION /begin DEF_CHARACTERISTIC /end DEF_CHARACTERISTIC /begin IN_MEASUREMENT /end IN_MEASUREMENT /begin OUT_MEASUREMENT /end OUT_MEASUREMENT /end FUNCTION
/begin FUNCTION Byte_2 ""
 /begin SUB_FUNCTION SignalPack SignalPack1 SignalPack2 SignalPack3 UnitConverter1 UnitConverter3 /end SUB_FUNCTION
 /begin DEF_CHARACTERISTIC /end DEF_CHARACTERISTIC
 /begin IN_MEASUREMENT /end IN_MEASUREMENT
 /begin OUT_MEASUREMENT /end OUT_MEASUREMENT
/end FUNCTION
/begin FUNCTION Byte_3 "" /begin SUB_FUNCTION SignalPack convert_out UnitConverter1 /end SUB_FUNCTION /begin DEF_CHARACTERISTIC /end DEF_CHARACTERISTIC /begin IN_MEASUREMENT /end IN_MEASUREMENT /begin OUT_MEASUREMENT /end OUT_MEASUREMENT /end FUNCTION
/begin FUNCTION Byte_4 "" /begin SUB_FUNCTION SignalPack convert_out UnitConverter UnitConverter1 /end SUB_FUNCTION /begin DEF_CHARACTERISTIC /end DEF_CHARACTERISTIC /begin IN_MEASUREMENT /end IN_MEASUREMENT /begin OUT_MEASUREMENT /end OUT_MEASUREMENT /end FUNCTION
/begin FUNCTION Byte_5 "" /begin SUB_FUNCTION SignalPack convert_out UnitConverter UnitConverter1 /end SUB_FUNCTION /begin DEF_CHARACTERISTIC /end DEF_CHARACTERISTIC /begin IN_MEASUREMENT /end IN_MEASUREMENT /begin OUT_MEASUREMENT /end OUT_MEASUREMENT /end FUNCTION
/begin FUNCTION Byte_6 ""
 /begin SUB_FUNCTION SignalPack SignalPack1 SignalPack2 SignalPack3 UnitConverter3 UnitConverter5 /end SUB_FUNCTION
 /begin DEF_CHARACTERISTIC /end DEF_CHARACTERISTIC
 /begin IN_MEASUREMENT /end IN_MEASUREMENT
 /begin OUT_MEASUREMENT /end OUT_MEASUREMENT
/end FUNCTION
/begin FUNCTION Byte_7 ""
 /begin SUB_FUNCTION SignalPack SignalPack1 SignalPack2 SignalPack3 SignalPack4 SignalPack5 UnitConverter1 UnitConverter11 UnitConverter3 UnitConverter5 UnitConverter7 /end SUB_FUNCTION
 /begin DEF_CHARACTERISTIC /end DEF_CHARACTERISTIC
 /begin IN_MEASUREMENT /end IN_MEASUREMENT
 /begin OUT_MEASUREMENT /end OUT_MEASUREMENT
/end FUNCTION
/begin FUNCTION Byte_8 ""
 /begin SUB_FUNCTION SignalPack SignalPack1 SignalPack2 SignalPack3 UnitConverter3 UnitConverter5 /end SUB_FUNCTION
 /begin DEF_CHARACTERISTIC /end DEF_CHARACTERISTIC
 /begin IN_MEASUREMENT /end IN_MEASUREMENT
 /begin OUT_MEASUREMENT /end OUT_MEASUREMENT
/end FUNCTION
/begin FUNCTION Byte_9 ""
 /begin SUB_FUNCTION SignalPack SignalPack1 SignalPack2 SignalPack3 SignalPack4 convert_out UnitConverter1 UnitConverter2 UnitConverter3 UnitConverter5 UnitConverter7 UnitConverter9 /end SUB_FUNCTION
 /begin DEF_CHARACTERISTIC /end DEF_CHARACTERISTIC
 /begin IN_MEASUREMENT /end IN_MEASUREMENT
 /begin OUT_MEASUREMENT /end OUT_MEASUREMENT
/end FUNCTION
/begin FUNCTION CAASSta "" /begin SUB_FUNCTION /end SUB_FUNCTION /begin DEF_CHARACTERISTIC /end DEF_CHARACTERISTIC /begin IN_MEASUREMENT /end IN_MEASUREMENT /begin OUT_MEASUREMENT /end OUT_MEASUREMENT /end FUNCTION
/begin FUNCTION CRC8_IfAction_Tx ""
 /begin SUB_FUNCTION If_Action_Subsystem If_Action_Subsystem1 Data_Type_Conversion If Merge /end SUB_FUNCTION
 /begin DEF_CHARACTERISTIC /end DEF_CHARACTERISTIC
 /begin IN_MEASUREMENT /end IN_MEASUREMENT
 /begin OUT_MEASUREMENT /end OUT_MEASUREMENT
/end FUNCTION
/begin FUNCTION FDCAPSActiveSta "" /begin SUB_FUNCTION Data_Type_Conversion /end SUB_FUNCTION /begin DEF_CHARACTERISTIC /end DEF_CHARACTERISTIC /begin IN_MEASUREMENT /end IN_MEASUREMENT /begin OUT_MEASUREMENT /end OUT_MEASUREMENT /end FUNCTION
/begin FUNCTION FDCAPSCaasActiveSta "" /begin SUB_FUNCTION Data_Type_Conversion /end SUB_FUNCTION /begin DEF_CHARACTERISTIC /end DEF_CHARACTERISTIC /begin IN_MEASUREMENT /end IN_MEASUREMENT /begin OUT_MEASUREMENT /end OUT_MEASUREMENT /end FUNCTION
/begin FUNCTION FDCAPSCaasCtrlAvailSta "" /begin SUB_FUNCTION Data_Type_Conversion /end SUB_FUNCTION /begin DEF_CHARACTERISTIC /end DEF_CHARACTERISTIC /begin IN_MEASUREMENT /end IN_MEASUREMENT /begin OUT_MEASUREMENT /end OUT_MEASUREMENT /end FUNCTION
/begin FUNCTION FDCAPSCaasVMCReqACmd "" /begin SUB_FUNCTION Data_Type_Conversion /end SUB_FUNCTION /begin DEF_CHARACTERISTIC /end DEF_CHARACTERISTIC /begin IN_MEASUREMENT /end IN_MEASUREMENT /begin OUT_MEASUREMENT /end OUT_MEASUREMENT /end FUNCTION
/begin FUNCTION FDCAPSCtrlAvailSta "" /begin SUB_FUNCTION Data_Type_Conversion /end SUB_FUNCTION /begin DEF_CHARACTERISTIC /end DEF_CHARACTERISTIC /begin IN_MEASUREMENT /end IN_MEASUREMENT /begin OUT_MEASUREMENT /end OUT_MEASUREMENT /end FUNCTION
/begin FUNCTION FDCAPSShftPosnReqCmd "" /begin SUB_FUNCTION /end SUB_FUNCTION /begin DEF_CHARACTERISTIC /end DEF_CHARACTERISTIC /begin IN_MEASUREMENT /end IN_MEASUREMENT /begin OUT_MEASUREMENT /end OUT_MEASUREMENT /end FUNCTION
/begin FUNCTION FDCAPSSpeedReqCmd "" /begin SUB_FUNCTION convert_out Data_Type_Conversion /end SUB_FUNCTION /begin DEF_CHARACTERISTIC /end DEF_CHARACTERISTIC /begin IN_MEASUREMENT /end IN_MEASUREMENT /begin OUT_MEASUREMENT /end OUT_MEASUREMENT /end FUNCTION
/begin FUNCTION FDCAPSVMCReqACmd "" /begin SUB_FUNCTION Data_Type_Conversion /end SUB_FUNCTION /begin DEF_CHARACTERISTIC /end DEF_CHARACTERISTIC /begin IN_MEASUREMENT /end IN_MEASUREMENT /begin OUT_MEASUREMENT /end OUT_MEASUREMENT /end FUNCTION
/begin FUNCTION FDCRAPSBCMLampCmd "" /begin SUB_FUNCTION /end SUB_FUNCTION /begin DEF_CHARACTERISTIC /end DEF_CHARACTERISTIC /begin IN_MEASUREMENT /end IN_MEASUREMENT /begin OUT_MEASUREMENT /end OUT_MEASUREMENT /end FUNCTION
/begin FUNCTION FDCRAPSBCMLockReqCmd "" /begin SUB_FUNCTION Data_Type_Conversion /end SUB_FUNCTION /begin DEF_CHARACTERISTIC /end DEF_CHARACTERISTIC /begin IN_MEASUREMENT /end IN_MEASUREMENT /begin OUT_MEASUREMENT /end OUT_MEASUREMENT /end FUNCTION
/begin FUNCTION FDCRAPSErrLv1Flg "" /begin SUB_FUNCTION Data_Type_Conversion /end SUB_FUNCTION /begin DEF_CHARACTERISTIC /end DEF_CHARACTERISTIC /begin IN_MEASUREMENT /end IN_MEASUREMENT /begin OUT_MEASUREMENT /end OUT_MEASUREMENT /end FUNCTION
/begin FUNCTION FDCRAPSPwrReqAvailSta "" /begin SUB_FUNCTION Data_Type_Conversion /end SUB_FUNCTION /begin DEF_CHARACTERISTIC /end DEF_CHARACTERISTIC /begin IN_MEASUREMENT /end IN_MEASUREMENT /begin OUT_MEASUREMENT /end OUT_MEASUREMENT /end FUNCTION
/begin FUNCTION FDCRAPSPwrReqCmd "" /begin SUB_FUNCTION /end SUB_FUNCTION /begin DEF_CHARACTERISTIC /end DEF_CHARACTERISTIC /begin IN_MEASUREMENT /end IN_MEASUREMENT /begin OUT_MEASUREMENT /end OUT_MEASUREMENT /end FUNCTION
/begin FUNCTION FDCVCURAPSErrLv2Flg "" /begin SUB_FUNCTION Data_Type_Conversion /end SUB_FUNCTION /begin DEF_CHARACTERISTIC /end DEF_CHARACTERISTIC /begin IN_MEASUREMENT /end IN_MEASUREMENT /begin OUT_MEASUREMENT /end OUT_MEASUREMENT /end FUNCTION
/begin FUNCTION FDCVCURAPSErrLv3Flg "" /begin SUB_FUNCTION Data_Type_Conversion /end SUB_FUNCTION /begin DEF_CHARACTERISTIC /end DEF_CHARACTERISTIC /begin IN_MEASUREMENT /end IN_MEASUREMENT /begin OUT_MEASUREMENT /end OUT_MEASUREMENT /end FUNCTION
/begin FUNCTION FDCVMCAPSAngleTarget "" /begin SUB_FUNCTION convert_out Data_Type_Conversion /end SUB_FUNCTION /begin DEF_CHARACTERISTIC /end DEF_CHARACTERISTIC /begin IN_MEASUREMENT /end IN_MEASUREMENT /begin OUT_MEASUREMENT /end OUT_MEASUREMENT /end FUNCTION
/begin FUNCTION FDCVMCAPSRqEPSCtrl "" /begin SUB_FUNCTION Data_Type_Conversion /end SUB_FUNCTION /begin DEF_CHARACTERISTIC /end DEF_CHARACTERISTIC /begin IN_MEASUREMENT /end IN_MEASUREMENT /begin OUT_MEASUREMENT /end OUT_MEASUREMENT /end FUNCTION
/begin FUNCTION FDCVMCAPSVRqEPSCtrl "" /begin SUB_FUNCTION Data_Type_Conversion /end SUB_FUNCTION /begin DEF_CHARACTERISTIC /end DEF_CHARACTERISTIC /begin IN_MEASUREMENT /end IN_MEASUREMENT /begin OUT_MEASUREMENT /end OUT_MEASUREMENT /end FUNCTION
/begin FUNCTION RollingCounter_IfAction ""
 /begin SUB_FUNCTION Constant1 Constant65 Constant66 Constant67 Equal34 Add2 Switch Switch5 Unit_Delay5 /end SUB_FUNCTION
 /begin DEF_CHARACTERISTIC /end DEF_CHARACTERISTIC
 /begin IN_MEASUREMENT /end IN_MEASUREMENT
 /begin OUT_MEASUREMENT /end OUT_MEASUREMENT
/end FUNCTION
/begin FUNCTION RollingCounter_IfAction1 ""
 /begin SUB_FUNCTION Constant1 Constant65 Constant66 Constant67 Equal34 Add2 Switch Switch5 Unit_Delay5 /end SUB_FUNCTION
 /begin DEF_CHARACTERISTIC /end DEF_CHARACTERISTIC
 /begin IN_MEASUREMENT /end IN_MEASUREMENT
 /begin OUT_MEASUREMENT /end OUT_MEASUREMENT
/end FUNCTION
/begin FUNCTION SPTGDet "" /begin SUB_FUNCTION Data_Type_Conversion /end SUB_FUNCTION /begin DEF_CHARACTERISTIC /end DEF_CHARACTERISTIC /begin IN_MEASUREMENT /end IN_MEASUREMENT /begin OUT_MEASUREMENT /end OUT_MEASUREMENT /end FUNCTION
/begin FUNCTION SPTGSta "" /begin SUB_FUNCTION /end SUB_FUNCTION /begin DEF_CHARACTERISTIC /end DEF_CHARACTERISTIC /begin IN_MEASUREMENT /end IN_MEASUREMENT /begin OUT_MEASUREMENT /end OUT_MEASUREMENT /end FUNCTION
/begin FUNCTION bus_creator "" /begin DEF_CHARACTERISTIC /end DEF_CHARACTERISTIC /begin IN_MEASUREMENT /end IN_MEASUREMENT /begin OUT_MEASUREMENT /end OUT_MEASUREMENT /end FUNCTION
/begin FUNCTION Byte_12 "" /begin DEF_CHARACTERISTIC /end DEF_CHARACTERISTIC /begin IN_MEASUREMENT /end IN_MEASUREMENT /begin OUT_MEASUREMENT /end OUT_MEASUREMENT /end FUNCTION
/begin FUNCTION Byte_13 "" /begin DEF_CHARACTERISTIC /end DEF_CHARACTERISTIC /begin IN_MEASUREMENT /end IN_MEASUREMENT /begin OUT_MEASUREMENT /end OUT_MEASUREMENT /end FUNCTION
/begin FUNCTION Byte_14 "" /begin DEF_CHARACTERISTIC /end DEF_CHARACTERISTIC /begin IN_MEASUREMENT /end IN_MEASUREMENT /begin OUT_MEASUREMENT /end OUT_MEASUREMENT /end FUNCTION
/begin FUNCTION Byte_15 "" /begin DEF_CHARACTERISTIC /end DEF_CHARACTERISTIC /begin IN_MEASUREMENT /end IN_MEASUREMENT /begin OUT_MEASUREMENT /end OUT_MEASUREMENT /end FUNCTION
/begin FUNCTION Constant "" /begin DEF_CHARACTERISTIC KHAL_CAN1FD1APS3E2E_flg /end DEF_CHARACTERISTIC /begin IN_MEASUREMENT /end IN_MEASUREMENT /begin OUT_MEASUREMENT /end OUT_MEASUREMENT /end FUNCTION
/begin FUNCTION Constant1 "" /begin DEF_CHARACTERISTIC /end DEF_CHARACTERISTIC /begin IN_MEASUREMENT /end IN_MEASUREMENT /begin OUT_MEASUREMENT /end OUT_MEASUREMENT /end FUNCTION
/begin FUNCTION Constant2 "" /begin DEF_CHARACTERISTIC /end DEF_CHARACTERISTIC /begin IN_MEASUREMENT /end IN_MEASUREMENT /begin OUT_MEASUREMENT /end OUT_MEASUREMENT /end FUNCTION
/begin FUNCTION Constant3 "" /begin DEF_CHARACTERISTIC KHAL_CAN1FD1APS3E2E_flg /end DEF_CHARACTERISTIC /begin IN_MEASUREMENT /end IN_MEASUREMENT /begin OUT_MEASUREMENT /end OUT_MEASUREMENT /end FUNCTION
/begin FUNCTION Constant4 "" /begin DEF_CHARACTERISTIC KHAL_CAN1FD1APS3E2E_flg /end DEF_CHARACTERISTIC /begin IN_MEASUREMENT /end IN_MEASUREMENT /begin OUT_MEASUREMENT /end OUT_MEASUREMENT /end FUNCTION
/begin FUNCTION Chart "" /begin DEF_CHARACTERISTIC /end DEF_CHARACTERISTIC /begin IN_MEASUREMENT /end IN_MEASUREMENT /begin OUT_MEASUREMENT /end OUT_MEASUREMENT /end FUNCTION
/begin FUNCTION Constant "" /begin DEF_CHARACTERISTIC /end DEF_CHARACTERISTIC /begin IN_MEASUREMENT /end IN_MEASUREMENT /begin OUT_MEASUREMENT /end OUT_MEASUREMENT /end FUNCTION
/begin FUNCTION Constant3 "" /begin DEF_CHARACTERISTIC /end DEF_CHARACTERISTIC /begin IN_MEASUREMENT /end IN_MEASUREMENT /begin OUT_MEASUREMENT /end OUT_MEASUREMENT /end FUNCTION
/begin FUNCTION Data_Type_Conversion "" /begin DEF_CHARACTERISTIC /end DEF_CHARACTERISTIC /begin IN_MEASUREMENT /end IN_MEASUREMENT /begin OUT_MEASUREMENT /end OUT_MEASUREMENT /end FUNCTION
/begin FUNCTION Gain "" /begin DEF_CHARACTERISTIC /end DEF_CHARACTERISTIC /begin IN_MEASUREMENT /end IN_MEASUREMENT /begin OUT_MEASUREMENT /end OUT_MEASUREMENT /end FUNCTION
/begin FUNCTION Divide "" /begin DEF_CHARACTERISTIC /end DEF_CHARACTERISTIC /begin IN_MEASUREMENT /end IN_MEASUREMENT /begin OUT_MEASUREMENT /end OUT_MEASUREMENT /end FUNCTION
/begin FUNCTION AllDoorSW "" /begin SUB_FUNCTION Data_Type_Conversion /end SUB_FUNCTION /begin DEF_CHARACTERISTIC /end DEF_CHARACTERISTIC /begin IN_MEASUREMENT /end IN_MEASUREMENT /begin OUT_MEASUREMENT /end OUT_MEASUREMENT /end FUNCTION
/begin FUNCTION AntiTheftSeatFold "" /begin SUB_FUNCTION Data_Type_Conversion /end SUB_FUNCTION /begin DEF_CHARACTERISTIC /end DEF_CHARACTERISTIC /begin IN_MEASUREMENT /end IN_MEASUREMENT /begin OUT_MEASUREMENT /end OUT_MEASUREMENT /end FUNCTION
/begin FUNCTION AntitheftSta "" /begin SUB_FUNCTION /end SUB_FUNCTION /begin DEF_CHARACTERISTIC /end DEF_CHARACTERISTIC /begin IN_MEASUREMENT /end IN_MEASUREMENT /begin OUT_MEASUREMENT /end OUT_MEASUREMENT /end FUNCTION
/begin FUNCTION BCMBuzzerReq "" /begin SUB_FUNCTION Data_Type_Conversion /end SUB_FUNCTION /begin DEF_CHARACTERISTIC /end DEF_CHARACTERISTIC /begin IN_MEASUREMENT /end IN_MEASUREMENT /begin OUT_MEASUREMENT /end OUT_MEASUREMENT /end FUNCTION
/begin FUNCTION BCMDoorLockSta "" /begin SUB_FUNCTION Data_Type_Conversion /end SUB_FUNCTION /begin DEF_CHARACTERISTIC /end DEF_CHARACTERISTIC /begin IN_MEASUREMENT /end IN_MEASUREMENT /begin OUT_MEASUREMENT /end OUT_MEASUREMENT /end FUNCTION
/begin FUNCTION BrakeLamp "" /begin SUB_FUNCTION Data_Type_Conversion /end SUB_FUNCTION /begin DEF_CHARACTERISTIC /end DEF_CHARACTERISTIC /begin IN_MEASUREMENT /end IN_MEASUREMENT /begin OUT_MEASUREMENT /end OUT_MEASUREMENT /end FUNCTION
/begin FUNCTION CTDCtrl "" /begin SUB_FUNCTION /end SUB_FUNCTION /begin DEF_CHARACTERISTIC /end DEF_CHARACTERISTIC /begin IN_MEASUREMENT /end IN_MEASUREMENT /begin OUT_MEASUREMENT /end OUT_MEASUREMENT /end FUNCTION
/begin FUNCTION CTDLockSW "" /begin SUB_FUNCTION Data_Type_Conversion /end SUB_FUNCTION /begin DEF_CHARACTERISTIC /end DEF_CHARACTERISTIC /begin IN_MEASUREMENT /end IN_MEASUREMENT /begin OUT_MEASUREMENT /end OUT_MEASUREMENT /end FUNCTION
/begin FUNCTION CTDUnlockSW "" /begin SUB_FUNCTION /end SUB_FUNCTION /begin DEF_CHARACTERISTIC /end DEF_CHARACTERISTIC /begin IN_MEASUREMENT /end IN_MEASUREMENT /begin OUT_MEASUREMENT /end OUT_MEASUREMENT /end FUNCTION
/begin FUNCTION CrashDetd "" /begin SUB_FUNCTION Data_Type_Conversion /end SUB_FUNCTION /begin DEF_CHARACTERISTIC /end DEF_CHARACTERISTIC /begin IN_MEASUREMENT /end IN_MEASUREMENT /begin OUT_MEASUREMENT /end OUT_MEASUREMENT /end FUNCTION
/begin FUNCTION Dimmer "" /begin SUB_FUNCTION Data_Type_Conversion /end SUB_FUNCTION /begin DEF_CHARACTERISTIC /end DEF_CHARACTERISTIC /begin IN_MEASUREMENT /end IN_MEASUREMENT /begin OUT_MEASUREMENT /end OUT_MEASUREMENT /end FUNCTION
/begin FUNCTION DimmerEN "" /begin SUB_FUNCTION Data_Type_Conversion /end SUB_FUNCTION /begin DEF_CHARACTERISTIC /end DEF_CHARACTERISTIC /begin IN_MEASUREMENT /end IN_MEASUREMENT /begin OUT_MEASUREMENT /end OUT_MEASUREMENT /end FUNCTION
/begin FUNCTION DoorLockIND "" /begin SUB_FUNCTION Data_Type_Conversion /end SUB_FUNCTION /begin DEF_CHARACTERISTIC /end DEF_CHARACTERISTIC /begin IN_MEASUREMENT /end IN_MEASUREMENT /begin OUT_MEASUREMENT /end OUT_MEASUREMENT /end FUNCTION
/begin FUNCTION DrDoorSW "" /begin SUB_FUNCTION Data_Type_Conversion /end SUB_FUNCTION /begin DEF_CHARACTERISTIC /end DEF_CHARACTERISTIC /begin IN_MEASUREMENT /end IN_MEASUREMENT /begin OUT_MEASUREMENT /end OUT_MEASUREMENT /end FUNCTION
/begin FUNCTION FrChargingDoorCtrl "" /begin SUB_FUNCTION /end SUB_FUNCTION /begin DEF_CHARACTERISTIC /end DEF_CHARACTERISTIC /begin IN_MEASUREMENT /end IN_MEASUREMENT /begin OUT_MEASUREMENT /end OUT_MEASUREMENT /end FUNCTION
/begin FUNCTION FrFogLamp "" /begin SUB_FUNCTION /end SUB_FUNCTION /begin DEF_CHARACTERISTIC /end DEF_CHARACTERISTIC /begin IN_MEASUREMENT /end IN_MEASUREMENT /begin OUT_MEASUREMENT /end OUT_MEASUREMENT /end FUNCTION
/begin FUNCTION FrWiperH "" /begin SUB_FUNCTION Data_Type_Conversion /end SUB_FUNCTION /begin DEF_CHARACTERISTIC /end DEF_CHARACTERISTIC /begin IN_MEASUREMENT /end IN_MEASUREMENT /begin OUT_MEASUREMENT /end OUT_MEASUREMENT /end FUNCTION
/begin FUNCTION FrWiperL "" /begin SUB_FUNCTION Data_Type_Conversion /end SUB_FUNCTION /begin DEF_CHARACTERISTIC /end DEF_CHARACTERISTIC /begin IN_MEASUREMENT /end IN_MEASUREMENT /begin OUT_MEASUREMENT /end OUT_MEASUREMENT /end FUNCTION
/begin FUNCTION HBeam "" /begin SUB_FUNCTION Data_Type_Conversion /end SUB_FUNCTION /begin DEF_CHARACTERISTIC /end DEF_CHARACTERISTIC /begin IN_MEASUREMENT /end IN_MEASUREMENT /begin OUT_MEASUREMENT /end OUT_MEASUREMENT /end FUNCTION
/begin FUNCTION HazardSW "" /begin SUB_FUNCTION Data_Type_Conversion /end SUB_FUNCTION /begin DEF_CHARACTERISTIC /end DEF_CHARACTERISTIC /begin IN_MEASUREMENT /end IN_MEASUREMENT /begin OUT_MEASUREMENT /end OUT_MEASUREMENT /end FUNCTION
/begin FUNCTION HoodSW "" /begin SUB_FUNCTION Data_Type_Conversion /end SUB_FUNCTION /begin DEF_CHARACTERISTIC /end DEF_CHARACTERISTIC /begin IN_MEASUREMENT /end IN_MEASUREMENT /begin OUT_MEASUREMENT /end OUT_MEASUREMENT /end FUNCTION
/begin FUNCTION HornCtrl "" /begin SUB_FUNCTION Data_Type_Conversion /end SUB_FUNCTION /begin DEF_CHARACTERISTIC /end DEF_CHARACTERISTIC /begin IN_MEASUREMENT /end IN_MEASUREMENT /begin OUT_MEASUREMENT /end OUT_MEASUREMENT /end FUNCTION
/begin FUNCTION LAPMWdwEnable "" /begin SUB_FUNCTION /end SUB_FUNCTION /begin DEF_CHARACTERISTIC /end DEF_CHARACTERISTIC /begin IN_MEASUREMENT /end IN_MEASUREMENT /begin OUT_MEASUREMENT /end OUT_MEASUREMENT /end FUNCTION
/begin FUNCTION LBSD "" /begin SUB_FUNCTION Data_Type_Conversion /end SUB_FUNCTION /begin DEF_CHARACTERISTIC /end DEF_CHARACTERISTIC /begin IN_MEASUREMENT /end IN_MEASUREMENT /begin OUT_MEASUREMENT /end OUT_MEASUREMENT /end FUNCTION
/begin FUNCTION LBeam "" /begin SUB_FUNCTION Data_Type_Conversion /end SUB_FUNCTION /begin DEF_CHARACTERISTIC /end DEF_CHARACTERISTIC /begin IN_MEASUREMENT /end IN_MEASUREMENT /begin OUT_MEASUREMENT /end OUT_MEASUREMENT /end FUNCTION
/begin FUNCTION LDRL "" /begin SUB_FUNCTION Data_Type_Conversion /end SUB_FUNCTION /begin DEF_CHARACTERISTIC /end DEF_CHARACTERISTIC /begin IN_MEASUREMENT /end IN_MEASUREMENT /begin OUT_MEASUREMENT /end OUT_MEASUREMENT /end FUNCTION
/begin FUNCTION LTurnLP "" /begin SUB_FUNCTION Data_Type_Conversion /end SUB_FUNCTION /begin DEF_CHARACTERISTIC /end DEF_CHARACTERISTIC /begin IN_MEASUREMENT /end IN_MEASUREMENT /begin OUT_MEASUREMENT /end OUT_MEASUREMENT /end FUNCTION
/begin FUNCTION LockSetting "" /begin SUB_FUNCTION Data_Type_Conversion /end SUB_FUNCTION /begin DEF_CHARACTERISTIC /end DEF_CHARACTERISTIC /begin IN_MEASUREMENT /end IN_MEASUREMENT /begin OUT_MEASUREMENT /end OUT_MEASUREMENT /end FUNCTION
/begin FUNCTION MirrorCtrl "" /begin SUB_FUNCTION /end SUB_FUNCTION /begin DEF_CHARACTERISTIC /end DEF_CHARACTERISTIC /begin IN_MEASUREMENT /end IN_MEASUREMENT /begin OUT_MEASUREMENT /end OUT_MEASUREMENT /end FUNCTION
/begin FUNCTION MirrorDefog "" /begin SUB_FUNCTION Data_Type_Conversion /end SUB_FUNCTION /begin DEF_CHARACTERISTIC /end DEF_CHARACTERISTIC /begin IN_MEASUREMENT /end IN_MEASUREMENT /begin OUT_MEASUREMENT /end OUT_MEASUREMENT /end FUNCTION
/begin FUNCTION PosLamp "" /begin SUB_FUNCTION Data_Type_Conversion /end SUB_FUNCTION /begin DEF_CHARACTERISTIC /end DEF_CHARACTERISTIC /begin IN_MEASUREMENT /end IN_MEASUREMENT /begin OUT_MEASUREMENT /end OUT_MEASUREMENT /end FUNCTION
/begin FUNCTION PsDoorSW "" /begin SUB_FUNCTION Data_Type_Conversion /end SUB_FUNCTION /begin DEF_CHARACTERISTIC /end DEF_CHARACTERISTIC /begin IN_MEASUREMENT /end IN_MEASUREMENT /begin OUT_MEASUREMENT /end OUT_MEASUREMENT /end FUNCTION
/begin FUNCTION RBSD "" /begin SUB_FUNCTION Data_Type_Conversion /end SUB_FUNCTION /begin DEF_CHARACTERISTIC /end DEF_CHARACTERISTIC /begin IN_MEASUREMENT /end IN_MEASUREMENT /begin OUT_MEASUREMENT /end OUT_MEASUREMENT /end FUNCTION
/begin FUNCTION RDRL "" /begin SUB_FUNCTION Data_Type_Conversion /end SUB_FUNCTION /begin DEF_CHARACTERISTIC /end DEF_CHARACTERISTIC /begin IN_MEASUREMENT /end IN_MEASUREMENT /begin OUT_MEASUREMENT /end OUT_MEASUREMENT /end FUNCTION
/begin FUNCTION RLDoorSW "" /begin SUB_FUNCTION Data_Type_Conversion /end SUB_FUNCTION /begin DEF_CHARACTERISTIC /end DEF_CHARACTERISTIC /begin IN_MEASUREMENT /end IN_MEASUREMENT /begin OUT_MEASUREMENT /end OUT_MEASUREMENT /end FUNCTION
/begin FUNCTION RRDoorSW "" /begin SUB_FUNCTION Data_Type_Conversion /end SUB_FUNCTION /begin DEF_CHARACTERISTIC /end DEF_CHARACTERISTIC /begin IN_MEASUREMENT /end IN_MEASUREMENT /begin OUT_MEASUREMENT /end OUT_MEASUREMENT /end FUNCTION
/begin FUNCTION RTurnLP "" /begin SUB_FUNCTION Data_Type_Conversion /end SUB_FUNCTION /begin DEF_CHARACTERISTIC /end DEF_CHARACTERISTIC /begin IN_MEASUREMENT /end IN_MEASUREMENT /begin OUT_MEASUREMENT /end OUT_MEASUREMENT /end FUNCTION
/begin FUNCTION ReverseLamp "" /begin SUB_FUNCTION Data_Type_Conversion /end SUB_FUNCTION /begin DEF_CHARACTERISTIC /end DEF_CHARACTERISTIC /begin IN_MEASUREMENT /end IN_MEASUREMENT /begin OUT_MEASUREMENT /end OUT_MEASUREMENT /end FUNCTION
/begin FUNCTION RoomLampH "" /begin SUB_FUNCTION Data_Type_Conversion /end SUB_FUNCTION /begin DEF_CHARACTERISTIC /end DEF_CHARACTERISTIC /begin IN_MEASUREMENT /end IN_MEASUREMENT /begin OUT_MEASUREMENT /end OUT_MEASUREMENT /end FUNCTION
/begin FUNCTION RoomLampL "" /begin SUB_FUNCTION Data_Type_Conversion /end SUB_FUNCTION /begin DEF_CHARACTERISTIC /end DEF_CHARACTERISTIC /begin IN_MEASUREMENT /end IN_MEASUREMENT /begin OUT_MEASUREMENT /end OUT_MEASUREMENT /end FUNCTION
/begin FUNCTION RrChargingDoorCtrl "" /begin SUB_FUNCTION /end SUB_FUNCTION /begin DEF_CHARACTERISTIC /end DEF_CHARACTERISTIC /begin IN_MEASUREMENT /end IN_MEASUREMENT /begin OUT_MEASUREMENT /end OUT_MEASUREMENT /end FUNCTION
/begin FUNCTION RrDefog "" /begin SUB_FUNCTION Data_Type_Conversion /end SUB_FUNCTION /begin DEF_CHARACTERISTIC /end DEF_CHARACTERISTIC /begin IN_MEASUREMENT /end IN_MEASUREMENT /begin OUT_MEASUREMENT /end OUT_MEASUREMENT /end FUNCTION
/begin FUNCTION RrFogLamp "" /begin SUB_FUNCTION Data_Type_Conversion /end SUB_FUNCTION /begin DEF_CHARACTERISTIC /end DEF_CHARACTERISTIC /begin IN_MEASUREMENT /end IN_MEASUREMENT /begin OUT_MEASUREMENT /end OUT_MEASUREMENT /end FUNCTION
/begin FUNCTION RrWiper "" /begin SUB_FUNCTION Data_Type_Conversion /end SUB_FUNCTION /begin DEF_CHARACTERISTIC /end DEF_CHARACTERISTIC /begin IN_MEASUREMENT /end IN_MEASUREMENT /begin OUT_MEASUREMENT /end OUT_MEASUREMENT /end FUNCTION
/begin FUNCTION TailgateHDSW "" /begin SUB_FUNCTION Data_Type_Conversion /end SUB_FUNCTION /begin DEF_CHARACTERISTIC /end DEF_CHARACTERISTIC /begin IN_MEASUREMENT /end IN_MEASUREMENT /begin OUT_MEASUREMENT /end OUT_MEASUREMENT /end FUNCTION
/begin FUNCTION TailgateRemote "" /begin SUB_FUNCTION /end SUB_FUNCTION /begin DEF_CHARACTERISTIC /end DEF_CHARACTERISTIC /begin IN_MEASUREMENT /end IN_MEASUREMENT /begin OUT_MEASUREMENT /end OUT_MEASUREMENT /end FUNCTION
/begin FUNCTION TailgateSW "" /begin SUB_FUNCTION Data_Type_Conversion /end SUB_FUNCTION /begin DEF_CHARACTERISTIC /end DEF_CHARACTERISTIC /begin IN_MEASUREMENT /end IN_MEASUREMENT /begin OUT_MEASUREMENT /end OUT_MEASUREMENT /end FUNCTION
/begin FUNCTION TrunkRel "" /begin SUB_FUNCTION Data_Type_Conversion /end SUB_FUNCTION /begin DEF_CHARACTERISTIC /end DEF_CHARACTERISTIC /begin IN_MEASUREMENT /end IN_MEASUREMENT /begin OUT_MEASUREMENT /end OUT_MEASUREMENT /end FUNCTION
/begin FUNCTION WasherCtrl "" /begin SUB_FUNCTION /end SUB_FUNCTION /begin DEF_CHARACTERISTIC /end DEF_CHARACTERISTIC /begin IN_MEASUREMENT /end IN_MEASUREMENT /begin OUT_MEASUREMENT /end OUT_MEASUREMENT /end FUNCTION
/begin FUNCTION WiperFixMode "" /begin SUB_FUNCTION Data_Type_Conversion /end SUB_FUNCTION /begin DEF_CHARACTERISTIC /end DEF_CHARACTERISTIC /begin IN_MEASUREMENT /end IN_MEASUREMENT /begin OUT_MEASUREMENT /end OUT_MEASUREMENT /end FUNCTION
/begin FUNCTION bus_creator "" /begin DEF_CHARACTERISTIC /end DEF_CHARACTERISTIC /begin IN_MEASUREMENT /end IN_MEASUREMENT /begin OUT_MEASUREMENT /end OUT_MEASUREMENT /end FUNCTION
/begin FUNCTION BatteryMode "" /begin SUB_FUNCTION /end SUB_FUNCTION /begin DEF_CHARACTERISTIC /end DEF_CHARACTERISTIC /begin IN_MEASUREMENT /end IN_MEASUREMENT /begin OUT_MEASUREMENT /end OUT_MEASUREMENT /end FUNCTION
/begin FUNCTION CCUACLampSts "" /begin SUB_FUNCTION Data_Type_Conversion /end SUB_FUNCTION /begin DEF_CHARACTERISTIC /end DEF_CHARACTERISTIC /begin IN_MEASUREMENT /end IN_MEASUREMENT /begin OUT_MEASUREMENT /end OUT_MEASUREMENT /end FUNCTION
/begin FUNCTION CCUACMaxLampSts "" /begin SUB_FUNCTION Data_Type_Conversion /end SUB_FUNCTION /begin DEF_CHARACTERISTIC /end DEF_CHARACTERISTIC /begin IN_MEASUREMENT /end IN_MEASUREMENT /begin OUT_MEASUREMENT /end OUT_MEASUREMENT /end FUNCTION
/begin FUNCTION CCUAutoLampSts "" /begin SUB_FUNCTION Data_Type_Conversion /end SUB_FUNCTION /begin DEF_CHARACTERISTIC /end DEF_CHARACTERISTIC /begin IN_MEASUREMENT /end IN_MEASUREMENT /begin OUT_MEASUREMENT /end OUT_MEASUREMENT /end FUNCTION
/begin FUNCTION CCUAutoMidLampSts "" /begin SUB_FUNCTION /end SUB_FUNCTION /begin DEF_CHARACTERISTIC /end DEF_CHARACTERISTIC /begin IN_MEASUREMENT /end IN_MEASUREMENT /begin OUT_MEASUREMENT /end OUT_MEASUREMENT /end FUNCTION
/begin FUNCTION CCUDispalyRequest "" /begin SUB_FUNCTION /end SUB_FUNCTION /begin DEF_CHARACTERISTIC /end DEF_CHARACTERISTIC /begin IN_MEASUREMENT /end IN_MEASUREMENT /begin OUT_MEASUREMENT /end OUT_MEASUREMENT /end FUNCTION
/begin FUNCTION CCUEcoSts "" /begin SUB_FUNCTION /end SUB_FUNCTION /begin DEF_CHARACTERISTIC /end DEF_CHARACTERISTIC /begin IN_MEASUREMENT /end IN_MEASUREMENT /begin OUT_MEASUREMENT /end OUT_MEASUREMENT /end FUNCTION
/begin FUNCTION CCUFrtOnOffLampSts "" /begin SUB_FUNCTION /end SUB_FUNCTION /begin DEF_CHARACTERISTIC /end DEF_CHARACTERISTIC /begin IN_MEASUREMENT /end IN_MEASUREMENT /begin OUT_MEASUREMENT /end OUT_MEASUREMENT /end FUNCTION
/begin FUNCTION CCUHEATMaxLampSts "" /begin SUB_FUNCTION /end SUB_FUNCTION /begin DEF_CHARACTERISTIC /end DEF_CHARACTERISTIC /begin IN_MEASUREMENT /end IN_MEASUREMENT /begin OUT_MEASUREMENT /end OUT_MEASUREMENT /end FUNCTION
/begin FUNCTION CCURrOnOffLampSts "" /begin SUB_FUNCTION /end SUB_FUNCTION /begin DEF_CHARACTERISTIC /end DEF_CHARACTERISTIC /begin IN_MEASUREMENT /end IN_MEASUREMENT /begin OUT_MEASUREMENT /end OUT_MEASUREMENT /end FUNCTION
/begin FUNCTION CCUSyncLampSts "" /begin SUB_FUNCTION Data_Type_Conversion /end SUB_FUNCTION /begin DEF_CHARACTERISTIC /end DEF_CHARACTERISTIC /begin IN_MEASUREMENT /end IN_MEASUREMENT /begin OUT_MEASUREMENT /end OUT_MEASUREMENT /end FUNCTION
/begin FUNCTION CabinMode "" /begin SUB_FUNCTION /end SUB_FUNCTION /begin DEF_CHARACTERISTIC /end DEF_CHARACTERISTIC /begin IN_MEASUREMENT /end IN_MEASUREMENT /begin OUT_MEASUREMENT /end OUT_MEASUREMENT /end FUNCTION
/begin FUNCTION EDriveMode "" /begin SUB_FUNCTION /end SUB_FUNCTION /begin DEF_CHARACTERISTIC /end DEF_CHARACTERISTIC /begin IN_MEASUREMENT /end IN_MEASUREMENT /begin OUT_MEASUREMENT /end OUT_MEASUREMENT /end FUNCTION
/begin FUNCTION FDAGSCmd "" /begin SUB_FUNCTION /end SUB_FUNCTION /begin DEF_CHARACTERISTIC /end DEF_CHARACTERISTIC /begin IN_MEASUREMENT /end IN_MEASUREMENT /begin OUT_MEASUREMENT /end OUT_MEASUREMENT /end FUNCTION
/begin FUNCTION FDRecyAutoCmd "" /begin SUB_FUNCTION /end SUB_FUNCTION /begin DEF_CHARACTERISTIC /end DEF_CHARACTERISTIC /begin IN_MEASUREMENT /end IN_MEASUREMENT /begin OUT_MEASUREMENT /end OUT_MEASUREMENT /end FUNCTION
/begin FUNCTION FrCoolantflow "" /begin SUB_FUNCTION convert_out Data_Type_Conversion /end SUB_FUNCTION /begin DEF_CHARACTERISTIC /end DEF_CHARACTERISTIC /begin IN_MEASUREMENT /end IN_MEASUREMENT /begin OUT_MEASUREMENT /end OUT_MEASUREMENT /end FUNCTION
/begin FUNCTION FrCoolanttemp "" /begin SUB_FUNCTION convert_out Data_Type_Conversion /end SUB_FUNCTION /begin DEF_CHARACTERISTIC /end DEF_CHARACTERISTIC /begin IN_MEASUREMENT /end IN_MEASUREMENT /begin OUT_MEASUREMENT /end OUT_MEASUREMENT /end FUNCTION
/begin FUNCTION HPThermalRecoveryReq "" /begin SUB_FUNCTION /end SUB_FUNCTION /begin DEF_CHARACTERISTIC /end DEF_CHARACTERISTIC /begin IN_MEASUREMENT /end IN_MEASUREMENT /begin OUT_MEASUREMENT /end OUT_MEASUREMENT /end FUNCTION
/begin FUNCTION RrCoolantflow "" /begin SUB_FUNCTION convert_out Data_Type_Conversion /end SUB_FUNCTION /begin DEF_CHARACTERISTIC /end DEF_CHARACTERISTIC /begin IN_MEASUREMENT /end IN_MEASUREMENT /begin OUT_MEASUREMENT /end OUT_MEASUREMENT /end FUNCTION
/begin FUNCTION RrCoolanttemp "" /begin SUB_FUNCTION convert_out Data_Type_Conversion /end SUB_FUNCTION /begin DEF_CHARACTERISTIC /end DEF_CHARACTERISTIC /begin IN_MEASUREMENT /end IN_MEASUREMENT /begin OUT_MEASUREMENT /end OUT_MEASUREMENT /end FUNCTION
/begin FUNCTION sigAirIntenZon1St "" /begin SUB_FUNCTION /end SUB_FUNCTION /begin DEF_CHARACTERISTIC /end DEF_CHARACTERISTIC /begin IN_MEASUREMENT /end IN_MEASUREMENT /begin OUT_MEASUREMENT /end OUT_MEASUREMENT /end FUNCTION
/begin FUNCTION sigAirIntenZon3St "" /begin SUB_FUNCTION /end SUB_FUNCTION /begin DEF_CHARACTERISTIC /end DEF_CHARACTERISTIC /begin IN_MEASUREMENT /end IN_MEASUREMENT /begin OUT_MEASUREMENT /end OUT_MEASUREMENT /end FUNCTION
/begin FUNCTION sigAmbAirT "" /begin SUB_FUNCTION convert_out Data_Type_Conversion /end SUB_FUNCTION /begin DEF_CHARACTERISTIC /end DEF_CHARACTERISTIC /begin IN_MEASUREMENT /end IN_MEASUREMENT /begin OUT_MEASUREMENT /end OUT_MEASUREMENT /end FUNCTION
/begin FUNCTION sigCbnAirT "" /begin SUB_FUNCTION convert_out Data_Type_Conversion /end SUB_FUNCTION /begin DEF_CHARACTERISTIC /end DEF_CHARACTERISTIC /begin IN_MEASUREMENT /end IN_MEASUREMENT /begin OUT_MEASUREMENT /end OUT_MEASUREMENT /end FUNCTION
/begin FUNCTION sigCbnPTCPwrAct "" /begin SUB_FUNCTION convert_out Data_Type_Conversion /end SUB_FUNCTION /begin DEF_CHARACTERISTIC /end DEF_CHARACTERISTIC /begin IN_MEASUREMENT /end IN_MEASUREMENT /begin OUT_MEASUREMENT /end OUT_MEASUREMENT /end FUNCTION
/begin FUNCTION sigCbnSolarLeft "" /begin SUB_FUNCTION convert_out Data_Type_Conversion /end SUB_FUNCTION /begin DEF_CHARACTERISTIC /end DEF_CHARACTERISTIC /begin IN_MEASUREMENT /end IN_MEASUREMENT /begin OUT_MEASUREMENT /end OUT_MEASUREMENT /end FUNCTION
/begin FUNCTION sigCbnSolarRight "" /begin SUB_FUNCTION convert_out Data_Type_Conversion /end SUB_FUNCTION /begin DEF_CHARACTERISTIC /end DEF_CHARACTERISTIC /begin IN_MEASUREMENT /end IN_MEASUREMENT /begin OUT_MEASUREMENT /end OUT_MEASUREMENT /end FUNCTION
/begin FUNCTION sigClmtCmprPwrAct "" /begin SUB_FUNCTION convert_out Data_Type_Conversion /end SUB_FUNCTION /begin DEF_CHARACTERISTIC /end DEF_CHARACTERISTIC /begin IN_MEASUREMENT /end IN_MEASUREMENT /begin OUT_MEASUREMENT /end OUT_MEASUREMENT /end FUNCTION
/begin FUNCTION sigClntTHvBattOut "" /begin SUB_FUNCTION convert_out Data_Type_Conversion /end SUB_FUNCTION /begin DEF_CHARACTERISTIC /end DEF_CHARACTERISTIC /begin IN_MEASUREMENT /end IN_MEASUREMENT /begin OUT_MEASUREMENT /end OUT_MEASUREMENT /end FUNCTION
/begin FUNCTION sigDfrstSt "" /begin SUB_FUNCTION Data_Type_Conversion /end SUB_FUNCTION /begin DEF_CHARACTERISTIC /end DEF_CHARACTERISTIC /begin IN_MEASUREMENT /end IN_MEASUREMENT /begin OUT_MEASUREMENT /end OUT_MEASUREMENT /end FUNCTION
/begin FUNCTION sigHvacSt "" /begin SUB_FUNCTION /end SUB_FUNCTION /begin DEF_CHARACTERISTIC /end DEF_CHARACTERISTIC /begin IN_MEASUREMENT /end IN_MEASUREMENT /begin OUT_MEASUREMENT /end OUT_MEASUREMENT /end FUNCTION
/begin FUNCTION sigRecircSt "" /begin SUB_FUNCTION Data_Type_Conversion /end SUB_FUNCTION /begin DEF_CHARACTERISTIC /end DEF_CHARACTERISTIC /begin IN_MEASUREMENT /end IN_MEASUREMENT /begin OUT_MEASUREMENT /end OUT_MEASUREMENT /end FUNCTION
/begin FUNCTION sigSetTempZon1St "" /begin SUB_FUNCTION convert_out Data_Type_Conversion /end SUB_FUNCTION /begin DEF_CHARACTERISTIC /end DEF_CHARACTERISTIC /begin IN_MEASUREMENT /end IN_MEASUREMENT /begin OUT_MEASUREMENT /end OUT_MEASUREMENT /end FUNCTION
/begin FUNCTION sigSetTempZon2St "" /begin SUB_FUNCTION convert_out Data_Type_Conversion /end SUB_FUNCTION /begin DEF_CHARACTERISTIC /end DEF_CHARACTERISTIC /begin IN_MEASUREMENT /end IN_MEASUREMENT /begin OUT_MEASUREMENT /end OUT_MEASUREMENT /end FUNCTION
/begin FUNCTION sigSetTempZon3St "" /begin SUB_FUNCTION convert_out Data_Type_Conversion /end SUB_FUNCTION /begin DEF_CHARACTERISTIC /end DEF_CHARACTERISTIC /begin IN_MEASUREMENT /end IN_MEASUREMENT /begin OUT_MEASUREMENT /end OUT_MEASUREMENT /end FUNCTION
/begin FUNCTION sigWindDirZon1St "" /begin SUB_FUNCTION /end SUB_FUNCTION /begin DEF_CHARACTERISTIC /end DEF_CHARACTERISTIC /begin IN_MEASUREMENT /end IN_MEASUREMENT /begin OUT_MEASUREMENT /end OUT_MEASUREMENT /end FUNCTION
/begin FUNCTION sigWindDirZon3St "" /begin SUB_FUNCTION /end SUB_FUNCTION /begin DEF_CHARACTERISTIC /end DEF_CHARACTERISTIC /begin IN_MEASUREMENT /end IN_MEASUREMENT /begin OUT_MEASUREMENT /end OUT_MEASUREMENT /end FUNCTION
/begin FUNCTION bus_creator "" /begin DEF_CHARACTERISTIC /end DEF_CHARACTERISTIC /begin IN_MEASUREMENT /end IN_MEASUREMENT /begin OUT_MEASUREMENT /end OUT_MEASUREMENT /end FUNCTION
/begin FUNCTION CCCrlSta "" /begin SUB_FUNCTION /end SUB_FUNCTION /begin DEF_CHARACTERISTIC /end DEF_CHARACTERISTIC /begin IN_MEASUREMENT /end IN_MEASUREMENT /begin OUT_MEASUREMENT /end OUT_MEASUREMENT /end FUNCTION
/begin FUNCTION EngAGSCloseSta "" /begin SUB_FUNCTION /end SUB_FUNCTION /begin DEF_CHARACTERISTIC /end DEF_CHARACTERISTIC /begin IN_MEASUREMENT /end IN_MEASUREMENT /begin OUT_MEASUREMENT /end OUT_MEASUREMENT /end FUNCTION
/begin FUNCTION EngActvDmpDisabSta "" /begin SUB_FUNCTION /end SUB_FUNCTION /begin DEF_CHARACTERISTIC /end DEF_CHARACTERISTIC /begin IN_MEASUREMENT /end IN_MEASUREMENT /begin OUT_MEASUREMENT /end OUT_MEASUREMENT /end FUNCTION
/begin FUNCTION EngCoastDwSta "" /begin SUB_FUNCTION /end SUB_FUNCTION /begin DEF_CHARACTERISTIC /end DEF_CHARACTERISTIC /begin IN_MEASUREMENT /end IN_MEASUREMENT /begin OUT_MEASUREMENT /end OUT_MEASUREMENT /end FUNCTION
/begin FUNCTION EngPwrLockSta "" /begin SUB_FUNCTION /end SUB_FUNCTION /begin DEF_CHARACTERISTIC /end DEF_CHARACTERISTIC /begin IN_MEASUREMENT /end IN_MEASUREMENT /begin OUT_MEASUREMENT /end OUT_MEASUREMENT /end FUNCTION
/begin FUNCTION HVPwrSta "" /begin SUB_FUNCTION Data_Type_Conversion /end SUB_FUNCTION /begin DEF_CHARACTERISTIC /end DEF_CHARACTERISTIC /begin IN_MEASUREMENT /end IN_MEASUREMENT /begin OUT_MEASUREMENT /end OUT_MEASUREMENT /end FUNCTION
/begin FUNCTION LVPwrSta "" /begin SUB_FUNCTION Data_Type_Conversion /end SUB_FUNCTION /begin DEF_CHARACTERISTIC /end DEF_CHARACTERISTIC /begin IN_MEASUREMENT /end IN_MEASUREMENT /begin OUT_MEASUREMENT /end OUT_MEASUREMENT /end FUNCTION
/begin FUNCTION MSACrlSta "" /begin SUB_FUNCTION /end SUB_FUNCTION /begin DEF_CHARACTERISTIC /end DEF_CHARACTERISTIC /begin IN_MEASUREMENT /end IN_MEASUREMENT /begin OUT_MEASUREMENT /end OUT_MEASUREMENT /end FUNCTION
/begin FUNCTION PButtonSta "" /begin SUB_FUNCTION /end SUB_FUNCTION /begin DEF_CHARACTERISTIC /end DEF_CHARACTERISTIC /begin IN_MEASUREMENT /end IN_MEASUREMENT /begin OUT_MEASUREMENT /end OUT_MEASUREMENT /end FUNCTION
/begin FUNCTION PrkReq "" /begin SUB_FUNCTION Data_Type_Conversion /end SUB_FUNCTION /begin DEF_CHARACTERISTIC /end DEF_CHARACTERISTIC /begin IN_MEASUREMENT /end IN_MEASUREMENT /begin OUT_MEASUREMENT /end OUT_MEASUREMENT /end FUNCTION
/begin FUNCTION PrkReqValid "" /begin SUB_FUNCTION /end SUB_FUNCTION /begin DEF_CHARACTERISTIC /end DEF_CHARACTERISTIC /begin IN_MEASUREMENT /end IN_MEASUREMENT /begin OUT_MEASUREMENT /end OUT_MEASUREMENT /end FUNCTION
/begin FUNCTION PwrSta "" /begin SUB_FUNCTION /end SUB_FUNCTION /begin DEF_CHARACTERISTIC /end DEF_CHARACTERISTIC /begin IN_MEASUREMENT /end IN_MEASUREMENT /begin OUT_MEASUREMENT /end OUT_MEASUREMENT /end FUNCTION
/begin FUNCTION ShiftGearPosn "" /begin SUB_FUNCTION /end SUB_FUNCTION /begin DEF_CHARACTERISTIC /end DEF_CHARACTERISTIC /begin IN_MEASUREMENT /end IN_MEASUREMENT /begin OUT_MEASUREMENT /end OUT_MEASUREMENT /end FUNCTION
/begin FUNCTION VehMalfunLevel "" /begin SUB_FUNCTION /end SUB_FUNCTION /begin DEF_CHARACTERISTIC /end DEF_CHARACTERISTIC /begin IN_MEASUREMENT /end IN_MEASUREMENT /begin OUT_MEASUREMENT /end OUT_MEASUREMENT /end FUNCTION
/begin FUNCTION XWDMode "" /begin SUB_FUNCTION /end SUB_FUNCTION /begin DEF_CHARACTERISTIC /end DEF_CHARACTERISTIC /begin IN_MEASUREMENT /end IN_MEASUREMENT /begin OUT_MEASUREMENT /end OUT_MEASUREMENT /end FUNCTION
/begin FUNCTION bus_creator "" /begin DEF_CHARACTERISTIC /end DEF_CHARACTERISTIC /begin IN_MEASUREMENT /end IN_MEASUREMENT /begin OUT_MEASUREMENT /end OUT_MEASUREMENT /end FUNCTION
/begin FUNCTION FD1_VCU2 "" /begin DEF_CHARACTERISTIC /end DEF_CHARACTERISTIC /begin IN_MEASUREMENT /end IN_MEASUREMENT /begin OUT_MEASUREMENT /end OUT_MEASUREMENT /end FUNCTION
/begin FUNCTION ACCCtrlAvail "" /begin SUB_FUNCTION Data_Type_Conversion /end SUB_FUNCTION /begin DEF_CHARACTERISTIC /end DEF_CHARACTERISTIC /begin IN_MEASUREMENT /end IN_MEASUREMENT /begin OUT_MEASUREMENT /end OUT_MEASUREMENT /end FUNCTION
/begin FUNCTION AccPedalOverride "" /begin SUB_FUNCTION Data_Type_Conversion /end SUB_FUNCTION /begin DEF_CHARACTERISTIC /end DEF_CHARACTERISTIC /begin IN_MEASUREMENT /end IN_MEASUREMENT /begin OUT_MEASUREMENT /end OUT_MEASUREMENT /end FUNCTION
/begin FUNCTION ActAPSPosn "" /begin SUB_FUNCTION convert_out Data_Type_Conversion /end SUB_FUNCTION /begin DEF_CHARACTERISTIC /end DEF_CHARACTERISTIC /begin IN_MEASUREMENT /end IN_MEASUREMENT /begin OUT_MEASUREMENT /end OUT_MEASUREMENT /end FUNCTION
/begin FUNCTION Byte_0 "" /begin SUB_FUNCTION SignalPack /end SUB_FUNCTION /begin DEF_CHARACTERISTIC /end DEF_CHARACTERISTIC /begin IN_MEASUREMENT /end IN_MEASUREMENT /begin OUT_MEASUREMENT /end OUT_MEASUREMENT /end FUNCTION
/begin FUNCTION Byte_1 "" /begin SUB_FUNCTION SignalPack /end SUB_FUNCTION /begin DEF_CHARACTERISTIC /end DEF_CHARACTERISTIC /begin IN_MEASUREMENT /end IN_MEASUREMENT /begin OUT_MEASUREMENT /end OUT_MEASUREMENT /end FUNCTION
/begin FUNCTION Byte_10 "" /begin SUB_FUNCTION SignalPack convert_out UnitConverter UnitConverter1 /end SUB_FUNCTION /begin DEF_CHARACTERISTIC /end DEF_CHARACTERISTIC /begin IN_MEASUREMENT /end IN_MEASUREMENT /begin OUT_MEASUREMENT /end OUT_MEASUREMENT /end FUNCTION
/begin FUNCTION Byte_11 "" /begin SUB_FUNCTION SignalPack convert_out UnitConverter UnitConverter1 /end SUB_FUNCTION /begin DEF_CHARACTERISTIC /end DEF_CHARACTERISTIC /begin IN_MEASUREMENT /end IN_MEASUREMENT /begin OUT_MEASUREMENT /end OUT_MEASUREMENT /end FUNCTION
/begin FUNCTION Byte_12 "" /begin SUB_FUNCTION SignalPack convert_out UnitConverter UnitConverter1 /end SUB_FUNCTION /begin DEF_CHARACTERISTIC /end DEF_CHARACTERISTIC /begin IN_MEASUREMENT /end IN_MEASUREMENT /begin OUT_MEASUREMENT /end OUT_MEASUREMENT /end FUNCTION
/begin FUNCTION Byte_13 "" /begin SUB_FUNCTION SignalPack convert_out UnitConverter UnitConverter1 /end SUB_FUNCTION /begin DEF_CHARACTERISTIC /end DEF_CHARACTERISTIC /begin IN_MEASUREMENT /end IN_MEASUREMENT /begin OUT_MEASUREMENT /end OUT_MEASUREMENT /end FUNCTION
/begin FUNCTION Byte_14 "" /begin SUB_FUNCTION SignalPack convert_out UnitConverter UnitConverter1 /end SUB_FUNCTION /begin DEF_CHARACTERISTIC /end DEF_CHARACTERISTIC /begin IN_MEASUREMENT /end IN_MEASUREMENT /begin OUT_MEASUREMENT /end OUT_MEASUREMENT /end FUNCTION
/begin FUNCTION Byte_15 "" /begin SUB_FUNCTION SignalPack convert_out UnitConverter1 /end SUB_FUNCTION /begin DEF_CHARACTERISTIC /end DEF_CHARACTERISTIC /begin IN_MEASUREMENT /end IN_MEASUREMENT /begin OUT_MEASUREMENT /end OUT_MEASUREMENT /end FUNCTION
/begin FUNCTION Byte_2 "" /begin SUB_FUNCTION SignalPack convert_out UnitConverter UnitConverter1 /end SUB_FUNCTION /begin DEF_CHARACTERISTIC /end DEF_CHARACTERISTIC /begin IN_MEASUREMENT /end IN_MEASUREMENT /begin OUT_MEASUREMENT /end OUT_MEASUREMENT /end FUNCTION
/begin FUNCTION Byte_3 "" /begin SUB_FUNCTION SignalPack convert_out UnitConverter UnitConverter1 /end SUB_FUNCTION /begin DEF_CHARACTERISTIC /end DEF_CHARACTERISTIC /begin IN_MEASUREMENT /end IN_MEASUREMENT /begin OUT_MEASUREMENT /end OUT_MEASUREMENT /end FUNCTION
/begin FUNCTION Byte_4 "" /begin SUB_FUNCTION SignalPack convert_out UnitConverter UnitConverter1 /end SUB_FUNCTION /begin DEF_CHARACTERISTIC /end DEF_CHARACTERISTIC /begin IN_MEASUREMENT /end IN_MEASUREMENT /begin OUT_MEASUREMENT /end OUT_MEASUREMENT /end FUNCTION
/begin FUNCTION Byte_5 "" /begin SUB_FUNCTION SignalPack convert_out UnitConverter UnitConverter1 /end SUB_FUNCTION /begin DEF_CHARACTERISTIC /end DEF_CHARACTERISTIC /begin IN_MEASUREMENT /end IN_MEASUREMENT /begin OUT_MEASUREMENT /end OUT_MEASUREMENT /end FUNCTION
/begin FUNCTION Byte_6 "" /begin SUB_FUNCTION SignalPack SignalPack1 UnitConverter1 UnitConverter3 /end SUB_FUNCTION /begin DEF_CHARACTERISTIC /end DEF_CHARACTERISTIC /begin IN_MEASUREMENT /end IN_MEASUREMENT /begin OUT_MEASUREMENT /end OUT_MEASUREMENT /end FUNCTION
/begin FUNCTION CRC8_IfAction_Tx ""
 /begin SUB_FUNCTION If_Action_Subsystem If_Action_Subsystem1 Data_Type_Conversion If Merge /end SUB_FUNCTION
 /begin DEF_CHARACTERISTIC /end DEF_CHARACTERISTIC
 /begin IN_MEASUREMENT /end IN_MEASUREMENT
 /begin OUT_MEASUREMENT /end OUT_MEASUREMENT
/end FUNCTION
/begin FUNCTION CSVCU2CAN1 "" /begin SUB_FUNCTION /end SUB_FUNCTION /begin DEF_CHARACTERISTIC /end DEF_CHARACTERISTIC /begin IN_MEASUREMENT /end IN_MEASUREMENT /begin OUT_MEASUREMENT /end OUT_MEASUREMENT /end FUNCTION
/begin FUNCTION DriverTq "" /begin SUB_FUNCTION convert_out Data_Type_Conversion /end SUB_FUNCTION /begin DEF_CHARACTERISTIC /end DEF_CHARACTERISTIC /begin IN_MEASUREMENT /end IN_MEASUREMENT /begin OUT_MEASUREMENT /end OUT_MEASUREMENT /end FUNCTION
/begin FUNCTION FrDriverTq "" /begin SUB_FUNCTION convert_out Data_Type_Conversion /end SUB_FUNCTION /begin DEF_CHARACTERISTIC /end DEF_CHARACTERISTIC /begin IN_MEASUREMENT /end IN_MEASUREMENT /begin OUT_MEASUREMENT /end OUT_MEASUREMENT /end FUNCTION
/begin FUNCTION RCVCU2CAN1 "" /begin SUB_FUNCTION /end SUB_FUNCTION /begin DEF_CHARACTERISTIC /end DEF_CHARACTERISTIC /begin IN_MEASUREMENT /end IN_MEASUREMENT /begin OUT_MEASUREMENT /end OUT_MEASUREMENT /end FUNCTION
/begin FUNCTION RollingCounter_IfAction ""
 /begin SUB_FUNCTION Constant1 Constant65 Constant66 Constant67 Equal34 Add2 Switch Switch5 Unit_Delay5 /end SUB_FUNCTION
 /begin DEF_CHARACTERISTIC /end DEF_CHARACTERISTIC
 /begin IN_MEASUREMENT /end IN_MEASUREMENT
 /begin OUT_MEASUREMENT /end OUT_MEASUREMENT
/end FUNCTION
/begin FUNCTION RollingCounter_IfAction1 ""
 /begin SUB_FUNCTION Constant1 Constant65 Constant66 Constant67 Equal34 Add2 Switch Switch5 Unit_Delay5 /end SUB_FUNCTION
 /begin DEF_CHARACTERISTIC /end DEF_CHARACTERISTIC
 /begin IN_MEASUREMENT /end IN_MEASUREMENT
 /begin OUT_MEASUREMENT /end OUT_MEASUREMENT
/end FUNCTION
/begin FUNCTION RrDriverTq "" /begin SUB_FUNCTION convert_out Data_Type_Conversion /end SUB_FUNCTION /begin DEF_CHARACTERISTIC /end DEF_CHARACTERISTIC /begin IN_MEASUREMENT /end IN_MEASUREMENT /begin OUT_MEASUREMENT /end OUT_MEASUREMENT /end FUNCTION
/begin FUNCTION VehActPwr "" /begin SUB_FUNCTION convert_out Data_Type_Conversion /end SUB_FUNCTION /begin DEF_CHARACTERISTIC /end DEF_CHARACTERISTIC /begin IN_MEASUREMENT /end IN_MEASUREMENT /begin OUT_MEASUREMENT /end OUT_MEASUREMENT /end FUNCTION
/begin FUNCTION bus_creator "" /begin DEF_CHARACTERISTIC /end DEF_CHARACTERISTIC /begin IN_MEASUREMENT /end IN_MEASUREMENT /begin OUT_MEASUREMENT /end OUT_MEASUREMENT /end FUNCTION
/begin FUNCTION Byte_7 "" /begin DEF_CHARACTERISTIC /end DEF_CHARACTERISTIC /begin IN_MEASUREMENT /end IN_MEASUREMENT /begin OUT_MEASUREMENT /end OUT_MEASUREMENT /end FUNCTION
/begin FUNCTION Byte_8 "" /begin DEF_CHARACTERISTIC /end DEF_CHARACTERISTIC /begin IN_MEASUREMENT /end IN_MEASUREMENT /begin OUT_MEASUREMENT /end OUT_MEASUREMENT /end FUNCTION
/begin FUNCTION Byte_9 "" /begin DEF_CHARACTERISTIC /end DEF_CHARACTERISTIC /begin IN_MEASUREMENT /end IN_MEASUREMENT /begin OUT_MEASUREMENT /end OUT_MEASUREMENT /end FUNCTION
/begin FUNCTION Constant "" /begin DEF_CHARACTERISTIC KHAL_CAN1FD1VCU2E2E_flg /end DEF_CHARACTERISTIC /begin IN_MEASUREMENT /end IN_MEASUREMENT /begin OUT_MEASUREMENT /end OUT_MEASUREMENT /end FUNCTION
/begin FUNCTION Constant1 "" /begin DEF_CHARACTERISTIC /end DEF_CHARACTERISTIC /begin IN_MEASUREMENT /end IN_MEASUREMENT /begin OUT_MEASUREMENT /end OUT_MEASUREMENT /end FUNCTION
/begin FUNCTION Constant2 "" /begin DEF_CHARACTERISTIC /end DEF_CHARACTERISTIC /begin IN_MEASUREMENT /end IN_MEASUREMENT /begin OUT_MEASUREMENT /end OUT_MEASUREMENT /end FUNCTION
/begin FUNCTION Constant3 "" /begin DEF_CHARACTERISTIC KHAL_CAN1FD1VCU2E2E_flg /end DEF_CHARACTERISTIC /begin IN_MEASUREMENT /end IN_MEASUREMENT /begin OUT_MEASUREMENT /end OUT_MEASUREMENT /end FUNCTION
/begin FUNCTION Constant4 "" /begin DEF_CHARACTERISTIC KHAL_CAN1FD1VCU2E2E_flg /end DEF_CHARACTERISTIC /begin IN_MEASUREMENT /end IN_MEASUREMENT /begin OUT_MEASUREMENT /end OUT_MEASUREMENT /end FUNCTION
/begin FUNCTION Chart "" /begin DEF_CHARACTERISTIC /end DEF_CHARACTERISTIC /begin IN_MEASUREMENT /end IN_MEASUREMENT /begin OUT_MEASUREMENT /end OUT_MEASUREMENT /end FUNCTION
/begin FUNCTION Constant "" /begin DEF_CHARACTERISTIC /end DEF_CHARACTERISTIC /begin IN_MEASUREMENT /end IN_MEASUREMENT /begin OUT_MEASUREMENT /end OUT_MEASUREMENT /end FUNCTION
/begin FUNCTION Constant3 "" /begin DEF_CHARACTERISTIC /end DEF_CHARACTERISTIC /begin IN_MEASUREMENT /end IN_MEASUREMENT /begin OUT_MEASUREMENT /end OUT_MEASUREMENT /end FUNCTION
/begin FUNCTION Data_Type_Conversion "" /begin DEF_CHARACTERISTIC /end DEF_CHARACTERISTIC /begin IN_MEASUREMENT /end IN_MEASUREMENT /begin OUT_MEASUREMENT /end OUT_MEASUREMENT /end FUNCTION
/begin FUNCTION Gain "" /begin DEF_CHARACTERISTIC /end DEF_CHARACTERISTIC /begin IN_MEASUREMENT /end IN_MEASUREMENT /begin OUT_MEASUREMENT /end OUT_MEASUREMENT /end FUNCTION
/begin FUNCTION Divide "" /begin DEF_CHARACTERISTIC /end DEF_CHARACTERISTIC /begin IN_MEASUREMENT /end IN_MEASUREMENT /begin OUT_MEASUREMENT /end OUT_MEASUREMENT /end FUNCTION
/begin FUNCTION FD1_VCU3 "" /begin DEF_CHARACTERISTIC /end DEF_CHARACTERISTIC /begin IN_MEASUREMENT /end IN_MEASUREMENT /begin OUT_MEASUREMENT /end OUT_MEASUREMENT /end FUNCTION
/begin FUNCTION Byte_0 "" /begin SUB_FUNCTION SignalPack /end SUB_FUNCTION /begin DEF_CHARACTERISTIC /end DEF_CHARACTERISTIC /begin IN_MEASUREMENT /end IN_MEASUREMENT /begin OUT_MEASUREMENT /end OUT_MEASUREMENT /end FUNCTION
/begin FUNCTION Byte_1 "" /begin SUB_FUNCTION SignalPack /end SUB_FUNCTION /begin DEF_CHARACTERISTIC /end DEF_CHARACTERISTIC /begin IN_MEASUREMENT /end IN_MEASUREMENT /begin OUT_MEASUREMENT /end OUT_MEASUREMENT /end FUNCTION
/begin FUNCTION Byte_10 "" /begin SUB_FUNCTION SignalPack convert_out UnitConverter UnitConverter1 /end SUB_FUNCTION /begin DEF_CHARACTERISTIC /end DEF_CHARACTERISTIC /begin IN_MEASUREMENT /end IN_MEASUREMENT /begin OUT_MEASUREMENT /end OUT_MEASUREMENT /end FUNCTION
/begin FUNCTION Byte_11 "" /begin SUB_FUNCTION SignalPack convert_out UnitConverter UnitConverter1 /end SUB_FUNCTION /begin DEF_CHARACTERISTIC /end DEF_CHARACTERISTIC /begin IN_MEASUREMENT /end IN_MEASUREMENT /begin OUT_MEASUREMENT /end OUT_MEASUREMENT /end FUNCTION
/begin FUNCTION Byte_12 ""
 /begin SUB_FUNCTION SignalPack SignalPack1 SignalPack2 convert_out UnitConverter1 UnitConverter2 UnitConverter3 UnitConverter5 /end SUB_FUNCTION
 /begin DEF_CHARACTERISTIC /end DEF_CHARACTERISTIC
 /begin IN_MEASUREMENT /end IN_MEASUREMENT
 /begin OUT_MEASUREMENT /end OUT_MEASUREMENT
/end FUNCTION
/begin FUNCTION Byte_13 "" /begin SUB_FUNCTION SignalPack convert_out UnitConverter UnitConverter1 /end SUB_FUNCTION /begin DEF_CHARACTERISTIC /end DEF_CHARACTERISTIC /begin IN_MEASUREMENT /end IN_MEASUREMENT /begin OUT_MEASUREMENT /end OUT_MEASUREMENT /end FUNCTION
/begin FUNCTION Byte_14 "" /begin SUB_FUNCTION SignalPack convert_out UnitConverter UnitConverter1 /end SUB_FUNCTION /begin DEF_CHARACTERISTIC /end DEF_CHARACTERISTIC /begin IN_MEASUREMENT /end IN_MEASUREMENT /begin OUT_MEASUREMENT /end OUT_MEASUREMENT /end FUNCTION
/begin FUNCTION Byte_15 "" /begin SUB_FUNCTION SignalPack convert_out UnitConverter UnitConverter1 /end SUB_FUNCTION /begin DEF_CHARACTERISTIC /end DEF_CHARACTERISTIC /begin IN_MEASUREMENT /end IN_MEASUREMENT /begin OUT_MEASUREMENT /end OUT_MEASUREMENT /end FUNCTION
/begin FUNCTION Byte_16 "" /begin SUB_FUNCTION SignalPack convert_out UnitConverter UnitConverter1 /end SUB_FUNCTION /begin DEF_CHARACTERISTIC /end DEF_CHARACTERISTIC /begin IN_MEASUREMENT /end IN_MEASUREMENT /begin OUT_MEASUREMENT /end OUT_MEASUREMENT /end FUNCTION
/begin FUNCTION Byte_17 "" /begin SUB_FUNCTION SignalPack convert_out UnitConverter UnitConverter1 /end SUB_FUNCTION /begin DEF_CHARACTERISTIC /end DEF_CHARACTERISTIC /begin IN_MEASUREMENT /end IN_MEASUREMENT /begin OUT_MEASUREMENT /end OUT_MEASUREMENT /end FUNCTION
/begin FUNCTION Byte_18 "" /begin SUB_FUNCTION SignalPack convert_out UnitConverter UnitConverter1 /end SUB_FUNCTION /begin DEF_CHARACTERISTIC /end DEF_CHARACTERISTIC /begin IN_MEASUREMENT /end IN_MEASUREMENT /begin OUT_MEASUREMENT /end OUT_MEASUREMENT /end FUNCTION
/begin FUNCTION Byte_19 "" /begin SUB_FUNCTION SignalPack convert_out UnitConverter UnitConverter1 /end SUB_FUNCTION /begin DEF_CHARACTERISTIC /end DEF_CHARACTERISTIC /begin IN_MEASUREMENT /end IN_MEASUREMENT /begin OUT_MEASUREMENT /end OUT_MEASUREMENT /end FUNCTION
/begin FUNCTION Byte_3 ""
 /begin SUB_FUNCTION SignalPack SignalPack1 SignalPack2 SignalPack3 SignalPack4 SignalPack5 SignalPack6 UnitConverter1 UnitConverter11 UnitConverter13 UnitConverter3 UnitConverter5 UnitConverter7 UnitConverter9 /end SUB_FUNCTION
 /begin DEF_CHARACTERISTIC /end DEF_CHARACTERISTIC
 /begin IN_MEASUREMENT /end IN_MEASUREMENT
 /begin OUT_MEASUREMENT /end OUT_MEASUREMENT
/end FUNCTION
/begin FUNCTION Byte_4 ""
 /begin SUB_FUNCTION SignalPack SignalPack1 SignalPack2 convert_out UnitConverter1 UnitConverter3 UnitConverter4 UnitConverter5 /end SUB_FUNCTION
 /begin DEF_CHARACTERISTIC /end DEF_CHARACTERISTIC
 /begin IN_MEASUREMENT /end IN_MEASUREMENT
 /begin OUT_MEASUREMENT /end OUT_MEASUREMENT
/end FUNCTION
/begin FUNCTION Byte_5 "" /begin SUB_FUNCTION SignalPack convert_out UnitConverter UnitConverter1 /end SUB_FUNCTION /begin DEF_CHARACTERISTIC /end DEF_CHARACTERISTIC /begin IN_MEASUREMENT /end IN_MEASUREMENT /begin OUT_MEASUREMENT /end OUT_MEASUREMENT /end FUNCTION
/begin FUNCTION Byte_6 "" /begin SUB_FUNCTION SignalPack convert_out UnitConverter UnitConverter1 /end SUB_FUNCTION /begin DEF_CHARACTERISTIC /end DEF_CHARACTERISTIC /begin IN_MEASUREMENT /end IN_MEASUREMENT /begin OUT_MEASUREMENT /end OUT_MEASUREMENT /end FUNCTION
/begin FUNCTION Byte_7 "" /begin SUB_FUNCTION SignalPack convert_out UnitConverter UnitConverter1 /end SUB_FUNCTION /begin DEF_CHARACTERISTIC /end DEF_CHARACTERISTIC /begin IN_MEASUREMENT /end IN_MEASUREMENT /begin OUT_MEASUREMENT /end OUT_MEASUREMENT /end FUNCTION
/begin FUNCTION Byte_8 "" /begin SUB_FUNCTION SignalPack convert_out UnitConverter UnitConverter1 /end SUB_FUNCTION /begin DEF_CHARACTERISTIC /end DEF_CHARACTERISTIC /begin IN_MEASUREMENT /end IN_MEASUREMENT /begin OUT_MEASUREMENT /end OUT_MEASUREMENT /end FUNCTION
/begin FUNCTION Byte_9 "" /begin SUB_FUNCTION SignalPack convert_out UnitConverter UnitConverter1 /end SUB_FUNCTION /begin DEF_CHARACTERISTIC /end DEF_CHARACTERISTIC /begin IN_MEASUREMENT /end IN_MEASUREMENT /begin OUT_MEASUREMENT /end OUT_MEASUREMENT /end FUNCTION
/begin FUNCTION CRC8_IfAction_Tx ""
 /begin SUB_FUNCTION If_Action_Subsystem If_Action_Subsystem1 Data_Type_Conversion If Merge /end SUB_FUNCTION
 /begin DEF_CHARACTERISTIC /end DEF_CHARACTERISTIC
 /begin IN_MEASUREMENT /end IN_MEASUREMENT
 /begin OUT_MEASUREMENT /end OUT_MEASUREMENT
/end FUNCTION
/begin FUNCTION CSVCU3CAN1 "" /begin SUB_FUNCTION /end SUB_FUNCTION /begin DEF_CHARACTERISTIC /end DEF_CHARACTERISTIC /begin IN_MEASUREMENT /end IN_MEASUREMENT /begin OUT_MEASUREMENT /end OUT_MEASUREMENT /end FUNCTION
/begin FUNCTION EquivAccPedalSWSta "" /begin SUB_FUNCTION Data_Type_Conversion /end SUB_FUNCTION /begin DEF_CHARACTERISTIC /end DEF_CHARACTERISTIC /begin IN_MEASUREMENT /end IN_MEASUREMENT /begin OUT_MEASUREMENT /end OUT_MEASUREMENT /end FUNCTION
/begin FUNCTION FrEDUAvailBrkRgnTq "" /begin SUB_FUNCTION convert_out Data_Type_Conversion /end SUB_FUNCTION /begin DEF_CHARACTERISTIC /end DEF_CHARACTERISTIC /begin IN_MEASUREMENT /end IN_MEASUREMENT /begin OUT_MEASUREMENT /end OUT_MEASUREMENT /end FUNCTION
/begin FUNCTION FrEDUAvailBrkRgnTqValid "" /begin SUB_FUNCTION Data_Type_Conversion /end SUB_FUNCTION /begin DEF_CHARACTERISTIC /end DEF_CHARACTERISTIC /begin IN_MEASUREMENT /end IN_MEASUREMENT /begin OUT_MEASUREMENT /end OUT_MEASUREMENT /end FUNCTION
/begin FUNCTION FrEDURealARgnTq "" /begin SUB_FUNCTION convert_out Data_Type_Conversion /end SUB_FUNCTION /begin DEF_CHARACTERISTIC /end DEF_CHARACTERISTIC /begin IN_MEASUREMENT /end IN_MEASUREMENT /begin OUT_MEASUREMENT /end OUT_MEASUREMENT /end FUNCTION
/begin FUNCTION FrEDURealDrvOrBRgnTq "" /begin SUB_FUNCTION convert_out Data_Type_Conversion /end SUB_FUNCTION /begin DEF_CHARACTERISTIC /end DEF_CHARACTERISTIC /begin IN_MEASUREMENT /end IN_MEASUREMENT /begin OUT_MEASUREMENT /end OUT_MEASUREMENT /end FUNCTION
/begin FUNCTION FrEDUSpd "" /begin SUB_FUNCTION convert_out Data_Type_Conversion /end SUB_FUNCTION /begin DEF_CHARACTERISTIC /end DEF_CHARACTERISTIC /begin IN_MEASUREMENT /end IN_MEASUREMENT /begin OUT_MEASUREMENT /end OUT_MEASUREMENT /end FUNCTION
/begin FUNCTION FrEDUSpdValid "" /begin SUB_FUNCTION Data_Type_Conversion /end SUB_FUNCTION /begin DEF_CHARACTERISTIC /end DEF_CHARACTERISTIC /begin IN_MEASUREMENT /end IN_MEASUREMENT /begin OUT_MEASUREMENT /end OUT_MEASUREMENT /end FUNCTION
/begin FUNCTION FrRgnDecrSta "" /begin SUB_FUNCTION Data_Type_Conversion /end SUB_FUNCTION /begin DEF_CHARACTERISTIC /end DEF_CHARACTERISTIC /begin IN_MEASUREMENT /end IN_MEASUREMENT /begin OUT_MEASUREMENT /end OUT_MEASUREMENT /end FUNCTION
/begin FUNCTION FrRgnPermSta "" /begin SUB_FUNCTION Data_Type_Conversion /end SUB_FUNCTION /begin DEF_CHARACTERISTIC /end DEF_CHARACTERISTIC /begin IN_MEASUREMENT /end IN_MEASUREMENT /begin OUT_MEASUREMENT /end OUT_MEASUREMENT /end FUNCTION
/begin FUNCTION PTCSPermSta "" /begin SUB_FUNCTION Data_Type_Conversion /end SUB_FUNCTION /begin DEF_CHARACTERISTIC /end DEF_CHARACTERISTIC /begin IN_MEASUREMENT /end IN_MEASUREMENT /begin OUT_MEASUREMENT /end OUT_MEASUREMENT /end FUNCTION
/begin FUNCTION RCVCU3CAN1 "" /begin SUB_FUNCTION /end SUB_FUNCTION /begin DEF_CHARACTERISTIC /end DEF_CHARACTERISTIC /begin IN_MEASUREMENT /end IN_MEASUREMENT /begin OUT_MEASUREMENT /end OUT_MEASUREMENT /end FUNCTION
/begin FUNCTION RgnAbnorSta "" /begin SUB_FUNCTION Data_Type_Conversion /end SUB_FUNCTION /begin DEF_CHARACTERISTIC /end DEF_CHARACTERISTIC /begin IN_MEASUREMENT /end IN_MEASUREMENT /begin OUT_MEASUREMENT /end OUT_MEASUREMENT /end FUNCTION
/begin FUNCTION RollingCounter_IfAction ""
 /begin SUB_FUNCTION Constant1 Constant65 Constant66 Constant67 Equal34 Add2 Switch Switch5 Unit_Delay5 /end SUB_FUNCTION
 /begin DEF_CHARACTERISTIC /end DEF_CHARACTERISTIC
 /begin IN_MEASUREMENT /end IN_MEASUREMENT
 /begin OUT_MEASUREMENT /end OUT_MEASUREMENT
/end FUNCTION
/begin FUNCTION RollingCounter_IfAction1 ""
 /begin SUB_FUNCTION Constant1 Constant65 Constant66 Constant67 Equal34 Add2 Switch Switch5 Unit_Delay5 /end SUB_FUNCTION
 /begin DEF_CHARACTERISTIC /end DEF_CHARACTERISTIC
 /begin IN_MEASUREMENT /end IN_MEASUREMENT
 /begin OUT_MEASUREMENT /end OUT_MEASUREMENT
/end FUNCTION
/begin FUNCTION RrEDUAvailBrkRgnTq "" /begin SUB_FUNCTION convert_out Data_Type_Conversion /end SUB_FUNCTION /begin DEF_CHARACTERISTIC /end DEF_CHARACTERISTIC /begin IN_MEASUREMENT /end IN_MEASUREMENT /begin OUT_MEASUREMENT /end OUT_MEASUREMENT /end FUNCTION
/begin FUNCTION RrEDUAvailBrkRgnTqValid "" /begin SUB_FUNCTION Data_Type_Conversion /end SUB_FUNCTION /begin DEF_CHARACTERISTIC /end DEF_CHARACTERISTIC /begin IN_MEASUREMENT /end IN_MEASUREMENT /begin OUT_MEASUREMENT /end OUT_MEASUREMENT /end FUNCTION
/begin FUNCTION RrEDURealARgnTq "" /begin SUB_FUNCTION convert_out Data_Type_Conversion /end SUB_FUNCTION /begin DEF_CHARACTERISTIC /end DEF_CHARACTERISTIC /begin IN_MEASUREMENT /end IN_MEASUREMENT /begin OUT_MEASUREMENT /end OUT_MEASUREMENT /end FUNCTION
/begin FUNCTION RrEDURealDrvOrBRgnTq "" /begin SUB_FUNCTION convert_out Data_Type_Conversion /end SUB_FUNCTION /begin DEF_CHARACTERISTIC /end DEF_CHARACTERISTIC /begin IN_MEASUREMENT /end IN_MEASUREMENT /begin OUT_MEASUREMENT /end OUT_MEASUREMENT /end FUNCTION
/begin FUNCTION RrEDUSpd "" /begin SUB_FUNCTION convert_out Data_Type_Conversion /end SUB_FUNCTION /begin DEF_CHARACTERISTIC /end DEF_CHARACTERISTIC /begin IN_MEASUREMENT /end IN_MEASUREMENT /begin OUT_MEASUREMENT /end OUT_MEASUREMENT /end FUNCTION
/begin FUNCTION RrEDUSpdValid "" /begin SUB_FUNCTION Data_Type_Conversion /end SUB_FUNCTION /begin DEF_CHARACTERISTIC /end DEF_CHARACTERISTIC /begin IN_MEASUREMENT /end IN_MEASUREMENT /begin OUT_MEASUREMENT /end OUT_MEASUREMENT /end FUNCTION
/begin FUNCTION RrRgnDecrSta "" /begin SUB_FUNCTION Data_Type_Conversion /end SUB_FUNCTION /begin DEF_CHARACTERISTIC /end DEF_CHARACTERISTIC /begin IN_MEASUREMENT /end IN_MEASUREMENT /begin OUT_MEASUREMENT /end OUT_MEASUREMENT /end FUNCTION
/begin FUNCTION RrRgnPermSta "" /begin SUB_FUNCTION Data_Type_Conversion /end SUB_FUNCTION /begin DEF_CHARACTERISTIC /end DEF_CHARACTERISTIC /begin IN_MEASUREMENT /end IN_MEASUREMENT /begin OUT_MEASUREMENT /end OUT_MEASUREMENT /end FUNCTION
/begin FUNCTION bus_creator "" /begin DEF_CHARACTERISTIC /end DEF_CHARACTERISTIC /begin IN_MEASUREMENT /end IN_MEASUREMENT /begin OUT_MEASUREMENT /end OUT_MEASUREMENT /end FUNCTION
/begin FUNCTION Byte_2 "" /begin DEF_CHARACTERISTIC /end DEF_CHARACTERISTIC /begin IN_MEASUREMENT /end IN_MEASUREMENT /begin OUT_MEASUREMENT /end OUT_MEASUREMENT /end FUNCTION
/begin FUNCTION Constant "" /begin DEF_CHARACTERISTIC KHAL_CAN1FD1VCU3E2E_flg /end DEF_CHARACTERISTIC /begin IN_MEASUREMENT /end IN_MEASUREMENT /begin OUT_MEASUREMENT /end OUT_MEASUREMENT /end FUNCTION
/begin FUNCTION Constant1 "" /begin DEF_CHARACTERISTIC /end DEF_CHARACTERISTIC /begin IN_MEASUREMENT /end IN_MEASUREMENT /begin OUT_MEASUREMENT /end OUT_MEASUREMENT /end FUNCTION
/begin FUNCTION Constant2 "" /begin DEF_CHARACTERISTIC /end DEF_CHARACTERISTIC /begin IN_MEASUREMENT /end IN_MEASUREMENT /begin OUT_MEASUREMENT /end OUT_MEASUREMENT /end FUNCTION
/begin FUNCTION Constant3 "" /begin DEF_CHARACTERISTIC KHAL_CAN1FD1VCU3E2E_flg /end DEF_CHARACTERISTIC /begin IN_MEASUREMENT /end IN_MEASUREMENT /begin OUT_MEASUREMENT /end OUT_MEASUREMENT /end FUNCTION
/begin FUNCTION Constant4 "" /begin DEF_CHARACTERISTIC KHAL_CAN1FD1VCU3E2E_flg /end DEF_CHARACTERISTIC /begin IN_MEASUREMENT /end IN_MEASUREMENT /begin OUT_MEASUREMENT /end OUT_MEASUREMENT /end FUNCTION
/begin FUNCTION Chart "" /begin DEF_CHARACTERISTIC /end DEF_CHARACTERISTIC /begin IN_MEASUREMENT /end IN_MEASUREMENT /begin OUT_MEASUREMENT /end OUT_MEASUREMENT /end FUNCTION
/begin FUNCTION Constant "" /begin DEF_CHARACTERISTIC /end DEF_CHARACTERISTIC /begin IN_MEASUREMENT /end IN_MEASUREMENT /begin OUT_MEASUREMENT /end OUT_MEASUREMENT /end FUNCTION
/begin FUNCTION Constant3 "" /begin DEF_CHARACTERISTIC /end DEF_CHARACTERISTIC /begin IN_MEASUREMENT /end IN_MEASUREMENT /begin OUT_MEASUREMENT /end OUT_MEASUREMENT /end FUNCTION
/begin FUNCTION Data_Type_Conversion "" /begin DEF_CHARACTERISTIC /end DEF_CHARACTERISTIC /begin IN_MEASUREMENT /end IN_MEASUREMENT /begin OUT_MEASUREMENT /end OUT_MEASUREMENT /end FUNCTION
/begin FUNCTION Gain "" /begin DEF_CHARACTERISTIC /end DEF_CHARACTERISTIC /begin IN_MEASUREMENT /end IN_MEASUREMENT /begin OUT_MEASUREMENT /end OUT_MEASUREMENT /end FUNCTION
/begin FUNCTION Divide "" /begin DEF_CHARACTERISTIC /end DEF_CHARACTERISTIC /begin IN_MEASUREMENT /end IN_MEASUREMENT /begin OUT_MEASUREMENT /end OUT_MEASUREMENT /end FUNCTION
/begin FUNCTION AccCalcuPID "" /begin SUB_FUNCTION convert_out Data_Type_Conversion /end SUB_FUNCTION /begin DEF_CHARACTERISTIC /end DEF_CHARACTERISTIC /begin IN_MEASUREMENT /end IN_MEASUREMENT /begin OUT_MEASUREMENT /end OUT_MEASUREMENT /end FUNCTION
/begin FUNCTION CCMSASpdWar "" /begin SUB_FUNCTION Data_Type_Conversion /end SUB_FUNCTION /begin DEF_CHARACTERISTIC /end DEF_CHARACTERISTIC /begin IN_MEASUREMENT /end IN_MEASUREMENT /begin OUT_MEASUREMENT /end OUT_MEASUREMENT /end FUNCTION
/begin FUNCTION DISCButtSta "" /begin SUB_FUNCTION Data_Type_Conversion /end SUB_FUNCTION /begin DEF_CHARACTERISTIC /end DEF_CHARACTERISTIC /begin IN_MEASUREMENT /end IN_MEASUREMENT /begin OUT_MEASUREMENT /end OUT_MEASUREMENT /end FUNCTION
/begin FUNCTION DISCDISCTargetSpd "" /begin SUB_FUNCTION convert_out Data_Type_Conversion /end SUB_FUNCTION /begin DEF_CHARACTERISTIC /end DEF_CHARACTERISTIC /begin IN_MEASUREMENT /end IN_MEASUREMENT /begin OUT_MEASUREMENT /end OUT_MEASUREMENT /end FUNCTION
/begin FUNCTION DISCDISCTurn "" /begin SUB_FUNCTION Data_Type_Conversion /end SUB_FUNCTION /begin DEF_CHARACTERISTIC /end DEF_CHARACTERISTIC /begin IN_MEASUREMENT /end IN_MEASUREMENT /begin OUT_MEASUREMENT /end OUT_MEASUREMENT /end FUNCTION
/begin FUNCTION DISCReqAcc "" /begin SUB_FUNCTION convert_out Data_Type_Conversion /end SUB_FUNCTION /begin DEF_CHARACTERISTIC /end DEF_CHARACTERISTIC /begin IN_MEASUREMENT /end IN_MEASUREMENT /begin OUT_MEASUREMENT /end OUT_MEASUREMENT /end FUNCTION
/begin FUNCTION DISCSta "" /begin SUB_FUNCTION /end SUB_FUNCTION /begin DEF_CHARACTERISTIC /end DEF_CHARACTERISTIC /begin IN_MEASUREMENT /end IN_MEASUREMENT /begin OUT_MEASUREMENT /end OUT_MEASUREMENT /end FUNCTION
/begin FUNCTION FeatArbitrFinal "" /begin SUB_FUNCTION /end SUB_FUNCTION /begin DEF_CHARACTERISTIC /end DEF_CHARACTERISTIC /begin IN_MEASUREMENT /end IN_MEASUREMENT /begin OUT_MEASUREMENT /end OUT_MEASUREMENT /end FUNCTION
/begin FUNCTION FeatArbitrSta "" /begin SUB_FUNCTION /end SUB_FUNCTION /begin DEF_CHARACTERISTIC /end DEF_CHARACTERISTIC /begin IN_MEASUREMENT /end IN_MEASUREMENT /begin OUT_MEASUREMENT /end OUT_MEASUREMENT /end FUNCTION
/begin FUNCTION FeatReqSpd "" /begin SUB_FUNCTION convert_out Data_Type_Conversion /end SUB_FUNCTION /begin DEF_CHARACTERISTIC /end DEF_CHARACTERISTIC /begin IN_MEASUREMENT /end IN_MEASUREMENT /begin OUT_MEASUREMENT /end OUT_MEASUREMENT /end FUNCTION
/begin FUNCTION FeatSetSpdFinalraw32 "" /begin SUB_FUNCTION Data_Type_Conversion /end SUB_FUNCTION /begin DEF_CHARACTERISTIC /end DEF_CHARACTERISTIC /begin IN_MEASUREMENT /end IN_MEASUREMENT /begin OUT_MEASUREMENT /end OUT_MEASUREMENT /end FUNCTION
/begin FUNCTION FrontRearSlipRatioCtrl "" /begin SUB_FUNCTION Data_Type_Conversion /end SUB_FUNCTION /begin DEF_CHARACTERISTIC /end DEF_CHARACTERISTIC /begin IN_MEASUREMENT /end IN_MEASUREMENT /begin OUT_MEASUREMENT /end OUT_MEASUREMENT /end FUNCTION
/begin FUNCTION JerkPCT "" /begin SUB_FUNCTION Data_Type_Conversion /end SUB_FUNCTION /begin DEF_CHARACTERISTIC /end DEF_CHARACTERISTIC /begin IN_MEASUREMENT /end IN_MEASUREMENT /begin OUT_MEASUREMENT /end OUT_MEASUREMENT /end FUNCTION
/begin FUNCTION LatAccCtrl "" /begin SUB_FUNCTION Data_Type_Conversion /end SUB_FUNCTION /begin DEF_CHARACTERISTIC /end DEF_CHARACTERISTIC /begin IN_MEASUREMENT /end IN_MEASUREMENT /begin OUT_MEASUREMENT /end OUT_MEASUREMENT /end FUNCTION
/begin FUNCTION LateralCtrl "" /begin SUB_FUNCTION Data_Type_Conversion /end SUB_FUNCTION /begin DEF_CHARACTERISTIC /end DEF_CHARACTERISTIC /begin IN_MEASUREMENT /end IN_MEASUREMENT /begin OUT_MEASUREMENT /end OUT_MEASUREMENT /end FUNCTION
/begin FUNCTION LimitPCT "" /begin SUB_FUNCTION Data_Type_Conversion /end SUB_FUNCTION /begin DEF_CHARACTERISTIC /end DEF_CHARACTERISTIC /begin IN_MEASUREMENT /end IN_MEASUREMENT /begin OUT_MEASUREMENT /end OUT_MEASUREMENT /end FUNCTION
/begin FUNCTION MeterIndSpeedraw32 "" /begin SUB_FUNCTION Data_Type_Conversion /end SUB_FUNCTION /begin DEF_CHARACTERISTIC /end DEF_CHARACTERISTIC /begin IN_MEASUREMENT /end IN_MEASUREMENT /begin OUT_MEASUREMENT /end OUT_MEASUREMENT /end FUNCTION
/begin FUNCTION RearWhlSlipRatioCtrl "" /begin SUB_FUNCTION Data_Type_Conversion /end SUB_FUNCTION /begin DEF_CHARACTERISTIC /end DEF_CHARACTERISTIC /begin IN_MEASUREMENT /end IN_MEASUREMENT /begin OUT_MEASUREMENT /end OUT_MEASUREMENT /end FUNCTION
/begin FUNCTION SPD2ACCAct "" /begin SUB_FUNCTION Data_Type_Conversion /end SUB_FUNCTION /begin DEF_CHARACTERISTIC /end DEF_CHARACTERISTIC /begin IN_MEASUREMENT /end IN_MEASUREMENT /begin OUT_MEASUREMENT /end OUT_MEASUREMENT /end FUNCTION
/begin FUNCTION SafetyCtrl "" /begin SUB_FUNCTION Data_Type_Conversion /end SUB_FUNCTION /begin DEF_CHARACTERISTIC /end DEF_CHARACTERISTIC /begin IN_MEASUREMENT /end IN_MEASUREMENT /begin OUT_MEASUREMENT /end OUT_MEASUREMENT /end FUNCTION
/begin FUNCTION SingleWhlSlipRatioCtrl "" /begin SUB_FUNCTION Data_Type_Conversion /end SUB_FUNCTION /begin DEF_CHARACTERISTIC /end DEF_CHARACTERISTIC /begin IN_MEASUREMENT /end IN_MEASUREMENT /begin OUT_MEASUREMENT /end OUT_MEASUREMENT /end FUNCTION
/begin FUNCTION TimeGapCalcu "" /begin SUB_FUNCTION convert_out Data_Type_Conversion /end SUB_FUNCTION /begin DEF_CHARACTERISTIC /end DEF_CHARACTERISTIC /begin IN_MEASUREMENT /end IN_MEASUREMENT /begin OUT_MEASUREMENT /end OUT_MEASUREMENT /end FUNCTION
/begin FUNCTION VMCACCCtrlAvail "" /begin SUB_FUNCTION Data_Type_Conversion /end SUB_FUNCTION /begin DEF_CHARACTERISTIC /end DEF_CHARACTERISTIC /begin IN_MEASUREMENT /end IN_MEASUREMENT /begin OUT_MEASUREMENT /end OUT_MEASUREMENT /end FUNCTION
/begin FUNCTION VMCAEBCtrlAvail "" /begin SUB_FUNCTION Data_Type_Conversion /end SUB_FUNCTION /begin DEF_CHARACTERISTIC /end DEF_CHARACTERISTIC /begin IN_MEASUREMENT /end IN_MEASUREMENT /begin OUT_MEASUREMENT /end OUT_MEASUREMENT /end FUNCTION
/begin FUNCTION VMCCCCtrlAvail "" /begin SUB_FUNCTION Data_Type_Conversion /end SUB_FUNCTION /begin DEF_CHARACTERISTIC /end DEF_CHARACTERISTIC /begin IN_MEASUREMENT /end IN_MEASUREMENT /begin OUT_MEASUREMENT /end OUT_MEASUREMENT /end FUNCTION
/begin FUNCTION VMCMSACtrlAvail "" /begin SUB_FUNCTION Data_Type_Conversion /end SUB_FUNCTION /begin DEF_CHARACTERISTIC /end DEF_CHARACTERISTIC /begin IN_MEASUREMENT /end IN_MEASUREMENT /begin OUT_MEASUREMENT /end OUT_MEASUREMENT /end FUNCTION
/begin FUNCTION VMCVCUACCCtrlAvail "" /begin SUB_FUNCTION Data_Type_Conversion /end SUB_FUNCTION /begin DEF_CHARACTERISTIC /end DEF_CHARACTERISTIC /begin IN_MEASUREMENT /end IN_MEASUREMENT /begin OUT_MEASUREMENT /end OUT_MEASUREMENT /end FUNCTION
/begin FUNCTION VMCVCUAPSCtrlAvailflg "" /begin SUB_FUNCTION Data_Type_Conversion /end SUB_FUNCTION /begin DEF_CHARACTERISTIC /end DEF_CHARACTERISTIC /begin IN_MEASUREMENT /end IN_MEASUREMENT /begin OUT_MEASUREMENT /end OUT_MEASUREMENT /end FUNCTION
/begin FUNCTION VMCVCUAccPedalOverride "" /begin SUB_FUNCTION Data_Type_Conversion /end SUB_FUNCTION /begin DEF_CHARACTERISTIC /end DEF_CHARACTERISTIC /begin IN_MEASUREMENT /end IN_MEASUREMENT /begin OUT_MEASUREMENT /end OUT_MEASUREMENT /end FUNCTION
/begin FUNCTION VMCVCUCCCrlSta "" /begin SUB_FUNCTION /end SUB_FUNCTION /begin DEF_CHARACTERISTIC /end DEF_CHARACTERISTIC /begin IN_MEASUREMENT /end IN_MEASUREMENT /begin OUT_MEASUREMENT /end OUT_MEASUREMENT /end FUNCTION
/begin FUNCTION VMCVCUMSACrlSta "" /begin SUB_FUNCTION /end SUB_FUNCTION /begin DEF_CHARACTERISTIC /end DEF_CHARACTERISTIC /begin IN_MEASUREMENT /end IN_MEASUREMENT /begin OUT_MEASUREMENT /end OUT_MEASUREMENT /end FUNCTION
/begin FUNCTION VehicleSpeedkph "" /begin SUB_FUNCTION convert_out Data_Type_Conversion /end SUB_FUNCTION /begin DEF_CHARACTERISTIC /end DEF_CHARACTERISTIC /begin IN_MEASUREMENT /end IN_MEASUREMENT /begin OUT_MEASUREMENT /end OUT_MEASUREMENT /end FUNCTION
/begin FUNCTION VehicleSpeedmph "" /begin SUB_FUNCTION convert_out Data_Type_Conversion /end SUB_FUNCTION /begin DEF_CHARACTERISTIC /end DEF_CHARACTERISTIC /begin IN_MEASUREMENT /end IN_MEASUREMENT /begin OUT_MEASUREMENT /end OUT_MEASUREMENT /end FUNCTION
/begin FUNCTION bus_creator "" /begin DEF_CHARACTERISTIC /end DEF_CHARACTERISTIC /begin IN_MEASUREMENT /end IN_MEASUREMENT /begin OUT_MEASUREMENT /end OUT_MEASUREMENT /end FUNCTION
/begin FUNCTION FDCVMCRWSActvSta "" /begin SUB_FUNCTION /end SUB_FUNCTION /begin DEF_CHARACTERISTIC /end DEF_CHARACTERISTIC /begin IN_MEASUREMENT /end IN_MEASUREMENT /begin OUT_MEASUREMENT /end OUT_MEASUREMENT /end FUNCTION
/begin FUNCTION FDCVMCRWSDfctvSta "" /begin SUB_FUNCTION /end SUB_FUNCTION /begin DEF_CHARACTERISTIC /end DEF_CHARACTERISTIC /begin IN_MEASUREMENT /end IN_MEASUREMENT /begin OUT_MEASUREMENT /end OUT_MEASUREMENT /end FUNCTION
/begin FUNCTION FDCVMCRWSPositionReqCmd "" /begin SUB_FUNCTION convert_out Data_Type_Conversion /end SUB_FUNCTION /begin DEF_CHARACTERISTIC /end DEF_CHARACTERISTIC /begin IN_MEASUREMENT /end IN_MEASUREMENT /begin OUT_MEASUREMENT /end OUT_MEASUREMENT /end FUNCTION
/begin FUNCTION FDCVMCSteerFaultReqCmd "" /begin SUB_FUNCTION /end SUB_FUNCTION /begin DEF_CHARACTERISTIC /end DEF_CHARACTERISTIC /begin IN_MEASUREMENT /end IN_MEASUREMENT /begin OUT_MEASUREMENT /end OUT_MEASUREMENT /end FUNCTION
/begin FUNCTION bus_creator "" /begin DEF_CHARACTERISTIC /end DEF_CHARACTERISTIC /begin IN_MEASUREMENT /end IN_MEASUREMENT /begin OUT_MEASUREMENT /end OUT_MEASUREMENT /end FUNCTION
/begin FUNCTION VMC_FCM1 "" /begin DEF_CHARACTERISTIC /end DEF_CHARACTERISTIC /begin IN_MEASUREMENT /end IN_MEASUREMENT /begin OUT_MEASUREMENT /end OUT_MEASUREMENT /end FUNCTION
/begin FUNCTION Byte_0 "" /begin SUB_FUNCTION SignalPack /end SUB_FUNCTION /begin DEF_CHARACTERISTIC /end DEF_CHARACTERISTIC /begin IN_MEASUREMENT /end IN_MEASUREMENT /begin OUT_MEASUREMENT /end OUT_MEASUREMENT /end FUNCTION
/begin FUNCTION Byte_1 "" /begin SUB_FUNCTION SignalPack /end SUB_FUNCTION /begin DEF_CHARACTERISTIC /end DEF_CHARACTERISTIC /begin IN_MEASUREMENT /end IN_MEASUREMENT /begin OUT_MEASUREMENT /end OUT_MEASUREMENT /end FUNCTION
/begin FUNCTION Byte_10 "" /begin SUB_FUNCTION SignalPack convert_out UnitConverter UnitConverter1 /end SUB_FUNCTION /begin DEF_CHARACTERISTIC /end DEF_CHARACTERISTIC /begin IN_MEASUREMENT /end IN_MEASUREMENT /begin OUT_MEASUREMENT /end OUT_MEASUREMENT /end FUNCTION
/begin FUNCTION Byte_11 ""
 /begin SUB_FUNCTION SignalPack SignalPack1 SignalPack2 SignalPack3 convert_out UnitConverter1 UnitConverter2 UnitConverter3 /end SUB_FUNCTION
 /begin DEF_CHARACTERISTIC /end DEF_CHARACTERISTIC
 /begin IN_MEASUREMENT /end IN_MEASUREMENT
 /begin OUT_MEASUREMENT /end OUT_MEASUREMENT
/end FUNCTION
/begin FUNCTION Byte_12 "" /begin SUB_FUNCTION SignalPack convert_out UnitConverter UnitConverter1 /end SUB_FUNCTION /begin DEF_CHARACTERISTIC /end DEF_CHARACTERISTIC /begin IN_MEASUREMENT /end IN_MEASUREMENT /begin OUT_MEASUREMENT /end OUT_MEASUREMENT /end FUNCTION
/begin FUNCTION Byte_13 "" /begin SUB_FUNCTION SignalPack convert_out UnitConverter1 /end SUB_FUNCTION /begin DEF_CHARACTERISTIC /end DEF_CHARACTERISTIC /begin IN_MEASUREMENT /end IN_MEASUREMENT /begin OUT_MEASUREMENT /end OUT_MEASUREMENT /end FUNCTION
/begin FUNCTION Byte_14 "" /begin SUB_FUNCTION SignalPack convert_out UnitConverter1 /end SUB_FUNCTION /begin DEF_CHARACTERISTIC /end DEF_CHARACTERISTIC /begin IN_MEASUREMENT /end IN_MEASUREMENT /begin OUT_MEASUREMENT /end OUT_MEASUREMENT /end FUNCTION
/begin FUNCTION Byte_15 "" /begin SUB_FUNCTION SignalPack /end SUB_FUNCTION /begin DEF_CHARACTERISTIC /end DEF_CHARACTERISTIC /begin IN_MEASUREMENT /end IN_MEASUREMENT /begin OUT_MEASUREMENT /end OUT_MEASUREMENT /end FUNCTION
/begin FUNCTION Byte_2 "" /begin SUB_FUNCTION SignalPack /end SUB_FUNCTION /begin DEF_CHARACTERISTIC /end DEF_CHARACTERISTIC /begin IN_MEASUREMENT /end IN_MEASUREMENT /begin OUT_MEASUREMENT /end OUT_MEASUREMENT /end FUNCTION
/begin FUNCTION Byte_3 ""
 /begin SUB_FUNCTION SignalPack SignalPack1 SignalPack2 SignalPack3 SignalPack4 convert_out UnitConverter1 UnitConverter3 UnitConverter6 UnitConverter7 UnitConverter9 /end SUB_FUNCTION
 /begin DEF_CHARACTERISTIC /end DEF_CHARACTERISTIC
 /begin IN_MEASUREMENT /end IN_MEASUREMENT
 /begin OUT_MEASUREMENT /end OUT_MEASUREMENT
/end FUNCTION
/begin FUNCTION Byte_4 "" /begin SUB_FUNCTION SignalPack convert_out UnitConverter UnitConverter1 /end SUB_FUNCTION /begin DEF_CHARACTERISTIC /end DEF_CHARACTERISTIC /begin IN_MEASUREMENT /end IN_MEASUREMENT /begin OUT_MEASUREMENT /end OUT_MEASUREMENT /end FUNCTION
/begin FUNCTION Byte_5 ""
 /begin SUB_FUNCTION SignalPack SignalPack1 SignalPack2 SignalPack3 SignalPack4 convert_out UnitConverter UnitConverter1 UnitConverter3 UnitConverter9 /end SUB_FUNCTION
 /begin DEF_CHARACTERISTIC /end DEF_CHARACTERISTIC
 /begin IN_MEASUREMENT /end IN_MEASUREMENT
 /begin OUT_MEASUREMENT /end OUT_MEASUREMENT
/end FUNCTION
/begin FUNCTION Byte_6 "" /begin SUB_FUNCTION SignalPack convert_out UnitConverter UnitConverter1 /end SUB_FUNCTION /begin DEF_CHARACTERISTIC /end DEF_CHARACTERISTIC /begin IN_MEASUREMENT /end IN_MEASUREMENT /begin OUT_MEASUREMENT /end OUT_MEASUREMENT /end FUNCTION
/begin FUNCTION Byte_7 ""
 /begin SUB_FUNCTION SignalPack SignalPack1 convert_out convert_out1 UnitConverter UnitConverter1 UnitConverter3 /end SUB_FUNCTION
 /begin DEF_CHARACTERISTIC /end DEF_CHARACTERISTIC
 /begin IN_MEASUREMENT /end IN_MEASUREMENT
 /begin OUT_MEASUREMENT /end OUT_MEASUREMENT
/end FUNCTION
/begin FUNCTION Byte_8 "" /begin SUB_FUNCTION SignalPack convert_out UnitConverter UnitConverter1 /end SUB_FUNCTION /begin DEF_CHARACTERISTIC /end DEF_CHARACTERISTIC /begin IN_MEASUREMENT /end IN_MEASUREMENT /begin OUT_MEASUREMENT /end OUT_MEASUREMENT /end FUNCTION
/begin FUNCTION Byte_9 ""
 /begin SUB_FUNCTION SignalPack SignalPack1 convert_out convert_out1 UnitConverter UnitConverter1 UnitConverter3 /end SUB_FUNCTION
 /begin DEF_CHARACTERISTIC /end DEF_CHARACTERISTIC
 /begin IN_MEASUREMENT /end IN_MEASUREMENT
 /begin OUT_MEASUREMENT /end OUT_MEASUREMENT
/end FUNCTION
/begin FUNCTION CRC8_IfAction_Tx ""
 /begin SUB_FUNCTION If_Action_Subsystem If_Action_Subsystem1 Data_Type_Conversion If Merge /end SUB_FUNCTION
 /begin DEF_CHARACTERISTIC /end DEF_CHARACTERISTIC
 /begin IN_MEASUREMENT /end IN_MEASUREMENT
 /begin OUT_MEASUREMENT /end OUT_MEASUREMENT
/end FUNCTION
/begin FUNCTION FDCVMCAngCtrlTqWtGn "" /begin SUB_FUNCTION convert_out Data_Type_Conversion /end SUB_FUNCTION /begin DEF_CHARACTERISTIC /end DEF_CHARACTERISTIC /begin IN_MEASUREMENT /end IN_MEASUREMENT /begin OUT_MEASUREMENT /end OUT_MEASUREMENT /end FUNCTION
/begin FUNCTION FDCVMCDMSModeCmd "" /begin SUB_FUNCTION /end SUB_FUNCTION /begin DEF_CHARACTERISTIC /end DEF_CHARACTERISTIC /begin IN_MEASUREMENT /end IN_MEASUREMENT /begin OUT_MEASUREMENT /end OUT_MEASUREMENT /end FUNCTION
/begin FUNCTION FDCVMCDrInpTqBstAct "" /begin SUB_FUNCTION Data_Type_Conversion /end SUB_FUNCTION /begin DEF_CHARACTERISTIC /end DEF_CHARACTERISTIC /begin IN_MEASUREMENT /end IN_MEASUREMENT /begin OUT_MEASUREMENT /end OUT_MEASUREMENT /end FUNCTION
/begin FUNCTION FDCVMCDrInpTqBstGn "" /begin SUB_FUNCTION convert_out Data_Type_Conversion /end SUB_FUNCTION /begin DEF_CHARACTERISTIC /end DEF_CHARACTERISTIC /begin IN_MEASUREMENT /end IN_MEASUREMENT /begin OUT_MEASUREMENT /end OUT_MEASUREMENT /end FUNCTION
/begin FUNCTION FDCVMCMaxAngCtrlOutTqLim "" /begin SUB_FUNCTION convert_out Data_Type_Conversion /end SUB_FUNCTION /begin DEF_CHARACTERISTIC /end DEF_CHARACTERISTIC /begin IN_MEASUREMENT /end IN_MEASUREMENT /begin OUT_MEASUREMENT /end OUT_MEASUREMENT /end FUNCTION
/begin FUNCTION RollingCounter_IfAction ""
 /begin SUB_FUNCTION Constant1 Constant65 Constant66 Constant67 Equal34 Add2 Switch Switch5 Unit_Delay5 /end SUB_FUNCTION
 /begin DEF_CHARACTERISTIC /end DEF_CHARACTERISTIC
 /begin IN_MEASUREMENT /end IN_MEASUREMENT
 /begin OUT_MEASUREMENT /end OUT_MEASUREMENT
/end FUNCTION
/begin FUNCTION RollingCounter_IfAction1 ""
 /begin SUB_FUNCTION Constant1 Constant65 Constant66 Constant67 Equal34 Add2 Switch Switch5 Unit_Delay5 /end SUB_FUNCTION
 /begin DEF_CHARACTERISTIC /end DEF_CHARACTERISTIC
 /begin IN_MEASUREMENT /end IN_MEASUREMENT
 /begin OUT_MEASUREMENT /end OUT_MEASUREMENT
/end FUNCTION
/begin FUNCTION VMCACCComfortBandLower "" /begin SUB_FUNCTION convert_out Data_Type_Conversion /end SUB_FUNCTION /begin DEF_CHARACTERISTIC /end DEF_CHARACTERISTIC /begin IN_MEASUREMENT /end IN_MEASUREMENT /begin OUT_MEASUREMENT /end OUT_MEASUREMENT /end FUNCTION
/begin FUNCTION VMCACCComfortBandUpper "" /begin SUB_FUNCTION convert_out Data_Type_Conversion /end SUB_FUNCTION /begin DEF_CHARACTERISTIC /end DEF_CHARACTERISTIC /begin IN_MEASUREMENT /end IN_MEASUREMENT /begin OUT_MEASUREMENT /end OUT_MEASUREMENT /end FUNCTION
/begin FUNCTION VMCACCJerkLowerLInit "" /begin SUB_FUNCTION convert_out Data_Type_Conversion /end SUB_FUNCTION /begin DEF_CHARACTERISTIC /end DEF_CHARACTERISTIC /begin IN_MEASUREMENT /end IN_MEASUREMENT /begin OUT_MEASUREMENT /end OUT_MEASUREMENT /end FUNCTION
/begin FUNCTION VMCACCJerkUpperLInit "" /begin SUB_FUNCTION convert_out Data_Type_Conversion /end SUB_FUNCTION /begin DEF_CHARACTERISTIC /end DEF_CHARACTERISTIC /begin IN_MEASUREMENT /end IN_MEASUREMENT /begin OUT_MEASUREMENT /end OUT_MEASUREMENT /end FUNCTION
/begin FUNCTION VMCACCRequiredAccel "" /begin SUB_FUNCTION convert_out Data_Type_Conversion /end SUB_FUNCTION /begin DEF_CHARACTERISTIC /end DEF_CHARACTERISTIC /begin IN_MEASUREMENT /end IN_MEASUREMENT /begin OUT_MEASUREMENT /end OUT_MEASUREMENT /end FUNCTION
/begin RECORD_LAYOUT Scalar_BOOLEAN FNC_VALUES 1 UBYTE COLUMN_DIR DIRECT /end RECORD_LAYOUT
/begin RECORD_LAYOUT Scalar_UWORD FNC_VALUES 1 UWORD COLUMN_DIR DIRECT /end RECORD_LAYOUT
/begin RECORD_LAYOUT Scalar_FLOAT32_IEEE FNC_VALUES 1 FLOAT32_IEEE COLUMN_DIR DIRECT /end RECORD_LAYOUT
/begin RECORD_LAYOUT Scalar_FLOAT64_IEEE FNC_VALUES 1 FLOAT64_IEEE COLUMN_DIR DIRECT /end RECORD_LAYOUT
/begin RECORD_LAYOUT Lookup1D_BOOLEAN FNC_VALUES 1 UBYTE COLUMN_DIR DIRECT /end RECORD_LAYOUT
/begin CHARACTERISTIC DTC_100242 "" VALUE 0 Scalar_UWORD 0 SWC_HALOUT_type_CM_uint16 0 65535 /end CHARACTERISTIC
/begin CHARACTERISTIC DTC_100243 "" VALUE 0 Scalar_UWORD 0 SWC_HALOUT_type_CM_uint16 0 65535 /end CHARACTERISTIC
/begin CHARACTERISTIC DTC_100244 "" VALUE 0 Scalar_UWORD 0 SWC_HALOUT_type_CM_uint16 0 65535 /end CHARACTERISTIC
/begin CHARACTERISTIC DTC_100247 "" VALUE 0 Scalar_UWORD 0 SWC_HALOUT_type_CM_uint16 0 65535 /end CHARACTERISTIC
/begin CHARACTERISTIC DTC_100248 "" VALUE 0 Scalar_UWORD 0 SWC_HALOUT_type_CM_uint16 0 65535 /end CHARACTERISTIC
/begin CHARACTERISTIC DTC_100249 "" VALUE 0 Scalar_UWORD 0 SWC_HALOUT_type_CM_uint16 0 65535 /end CHARACTERISTIC
/begin CHARACTERISTIC DTC_100250 "" VALUE 0 Scalar_UWORD 0 SWC_HALOUT_type_CM_uint16 0 65535 /end CHARACTERISTIC
/begin CHARACTERISTIC DTC_100251 "" VALUE 0 Scalar_UWORD 0 SWC_HALOUT_type_CM_uint16 0 65535 /end CHARACTERISTIC
/begin CHARACTERISTIC DTC_100252 "" VALUE 0 Scalar_UWORD 0 SWC_HALOUT_type_CM_uint16 0 65535 /end CHARACTERISTIC
/begin CHARACTERISTIC DTC_500B01 "" VALUE 0 Scalar_UWORD 0 SWC_HALOUT_type_CM_uint16 0 65535 /end CHARACTERISTIC
/begin CHARACTERISTIC DTC_500B02 "" VALUE 0 Scalar_UWORD 0 SWC_HALOUT_type_CM_uint16 0 65535 /end CHARACTERISTIC
/begin CHARACTERISTIC DTC_500B03 "" VALUE 0 Scalar_UWORD 0 SWC_HALOUT_type_CM_uint16 0 65535 /end CHARACTERISTIC
/begin CHARACTERISTIC DTC_500B04 "" VALUE 0 Scalar_UWORD 0 SWC_HALOUT_type_CM_uint16 0 65535 /end CHARACTERISTIC
/begin CHARACTERISTIC DTC_500B05 "" VALUE 0 Scalar_UWORD 0 SWC_HALOUT_type_CM_uint16 0 65535 /end CHARACTERISTIC
/begin CHARACTERISTIC DTC_500B06 "" VALUE 0 Scalar_UWORD 0 SWC_HALOUT_type_CM_uint16 0 65535 /end CHARACTERISTIC
/begin CHARACTERISTIC DTC_500B07 "" VALUE 0 Scalar_UWORD 0 SWC_HALOUT_type_CM_uint16 0 65535 /end CHARACTERISTIC
/begin CHARACTERISTIC DTC_500B08 "" VALUE 0 Scalar_UWORD 0 SWC_HALOUT_type_CM_uint16 0 65535 /end CHARACTERISTIC
/begin CHARACTERISTIC DTC_500B09 "" VALUE 0 Scalar_UWORD 0 SWC_HALOUT_type_CM_uint16 0 65535 /end CHARACTERISTIC
/begin CHARACTERISTIC DTC_500B0A "" VALUE 0 Scalar_UWORD 0 SWC_HALOUT_type_CM_uint16 0 65535 /end CHARACTERISTIC
/begin CHARACTERISTIC DTC_500B0B "" VALUE 0 Scalar_UWORD 0 SWC_HALOUT_type_CM_uint16 0 65535 /end CHARACTERISTIC
/begin CHARACTERISTIC DTC_500B0C "" VALUE 0 Scalar_UWORD 0 SWC_HALOUT_type_CM_uint16 0 65535 /end CHARACTERISTIC
/begin CHARACTERISTIC DTC_500B0D "" VALUE 0 Scalar_UWORD 0 SWC_HALOUT_type_CM_uint16 0 65535 /end CHARACTERISTIC
/begin CHARACTERISTIC DTC_500B0E "" VALUE 0 Scalar_UWORD 0 SWC_HALOUT_type_CM_uint16 0 65535 /end CHARACTERISTIC
/begin CHARACTERISTIC DTC_500B0F "" VALUE 0 Scalar_UWORD 0 SWC_HALOUT_type_CM_uint16 0 65535 /end CHARACTERISTIC
/begin CHARACTERISTIC DTC_500B10 "" VALUE 0 Scalar_UWORD 0 SWC_HALOUT_type_CM_uint16 0 65535 /end CHARACTERISTIC
/begin CHARACTERISTIC DTC_900301 "" VALUE 0 Scalar_UWORD 0 SWC_HALOUT_type_CM_uint16 0 65535 /end CHARACTERISTIC
/begin CHARACTERISTIC DTC_900302 "" VALUE 0 Scalar_UWORD 0 SWC_HALOUT_type_CM_uint16 0 65535 /end CHARACTERISTIC
/begin CHARACTERISTIC DTC_900303 "" VALUE 0 Scalar_UWORD 0 SWC_HALOUT_type_CM_uint16 0 65535 /end CHARACTERISTIC
/begin CHARACTERISTIC DTC_900304 "" VALUE 0 Scalar_UWORD 0 SWC_HALOUT_type_CM_uint16 0 65535 /end CHARACTERISTIC
/begin CHARACTERISTIC DTC_900909 "" VALUE 0 Scalar_UWORD 0 SWC_HALOUT_type_CM_uint16 0 65535 /end CHARACTERISTIC
/begin CHARACTERISTIC DTC_90090A "" VALUE 0 Scalar_UWORD 0 SWC_HALOUT_type_CM_uint16 0 65535 /end CHARACTERISTIC
/begin CHARACTERISTIC DTC_90090B "" VALUE 0 Scalar_UWORD 0 SWC_HALOUT_type_CM_uint16 0 65535 /end CHARACTERISTIC
/begin CHARACTERISTIC DTC_90090C "" VALUE 0 Scalar_UWORD 0 SWC_HALOUT_type_CM_uint16 0 65535 /end CHARACTERISTIC
/begin CHARACTERISTIC DTC_90090D "" VALUE 0 Scalar_UWORD 0 SWC_HALOUT_type_CM_uint16 0 65535 /end CHARACTERISTIC
/begin CHARACTERISTIC DTC_90090E "" VALUE 0 Scalar_UWORD 0 SWC_HALOUT_type_CM_uint16 0 65535 /end CHARACTERISTIC
/begin CHARACTERISTIC DTC_90090F "" VALUE 0 Scalar_UWORD 0 SWC_HALOUT_type_CM_uint16 0 65535 /end CHARACTERISTIC
/begin CHARACTERISTIC DTC_900910 "" VALUE 0 Scalar_UWORD 0 SWC_HALOUT_type_CM_uint16 0 65535 /end CHARACTERISTIC
/begin CHARACTERISTIC DTC_900911 "" VALUE 0 Scalar_UWORD 0 SWC_HALOUT_type_CM_uint16 0 65535 /end CHARACTERISTIC
/begin CHARACTERISTIC DTC_900912 "" VALUE 0 Scalar_UWORD 0 SWC_HALOUT_type_CM_uint16 0 65535 /end CHARACTERISTIC
/begin CHARACTERISTIC DTC_900913 "" VALUE 0 Scalar_UWORD 0 SWC_HALOUT_type_CM_uint16 0 65535 /end CHARACTERISTIC
/begin CHARACTERISTIC DTC_900914 "" VALUE 0 Scalar_UWORD 0 SWC_HALOUT_type_CM_uint16 0 65535 /end CHARACTERISTIC
/begin CHARACTERISTIC DTC_D00206 "" VALUE 0 Scalar_UWORD 0 SWC_HALOUT_type_CM_uint16 0 65535 /end CHARACTERISTIC
/begin CHARACTERISTIC DTC_D00207 "" VALUE 0 Scalar_UWORD 0 SWC_HALOUT_type_CM_uint16 0 65535 /end CHARACTERISTIC
/begin CHARACTERISTIC DTC_D00208 "" VALUE 0 Scalar_UWORD 0 SWC_HALOUT_type_CM_uint16 0 65535 /end CHARACTERISTIC
/begin CHARACTERISTIC DTC_D00209 "" VALUE 0 Scalar_UWORD 0 SWC_HALOUT_type_CM_uint16 0 65535 /end CHARACTERISTIC
/begin CHARACTERISTIC DTC_D0020A "" VALUE 0 Scalar_UWORD 0 SWC_HALOUT_type_CM_uint16 0 65535 /end CHARACTERISTIC
/begin CHARACTERISTIC DTC_D00234 "" VALUE 0 Scalar_UWORD 0 SWC_HALOUT_type_CM_uint16 0 65535 /end CHARACTERISTIC
/begin CHARACTERISTIC DTC_D00235 "" VALUE 0 Scalar_UWORD 0 SWC_HALOUT_type_CM_uint16 0 65535 /end CHARACTERISTIC
/begin CHARACTERISTIC DTC_D00236 "" VALUE 0 Scalar_UWORD 0 SWC_HALOUT_type_CM_uint16 0 65535 /end CHARACTERISTIC
/begin CHARACTERISTIC DTC_D00237 "" VALUE 0 Scalar_UWORD 0 SWC_HALOUT_type_CM_uint16 0 65535 /end CHARACTERISTIC
/begin CHARACTERISTIC DTC_D00238 "" VALUE 0 Scalar_UWORD 0 SWC_HALOUT_type_CM_uint16 0 65535 /end CHARACTERISTIC
/begin CHARACTERISTIC DTC_D0023A "" VALUE 0 Scalar_UWORD 0 SWC_HALOUT_type_CM_uint16 0 65535 /end CHARACTERISTIC
/begin CHARACTERISTIC DTC_D0023B "" VALUE 0 Scalar_UWORD 0 SWC_HALOUT_type_CM_uint16 0 65535 /end CHARACTERISTIC
/begin CHARACTERISTIC DTC_D0023C "" VALUE 0 Scalar_UWORD 0 SWC_HALOUT_type_CM_uint16 0 65535 /end CHARACTERISTIC
/begin CHARACTERISTIC DTC_D0023D "" VALUE 0 Scalar_UWORD 0 SWC_HALOUT_type_CM_uint16 0 65535 /end CHARACTERISTIC
/begin CHARACTERISTIC DTC_D0023E "" VALUE 0 Scalar_UWORD 0 SWC_HALOUT_type_CM_uint16 0 65535 /end CHARACTERISTIC
/begin CHARACTERISTIC DTC_D00240 "" VALUE 0 Scalar_UWORD 0 SWC_HALOUT_type_CM_uint16 0 65535 /end CHARACTERISTIC
/begin CHARACTERISTIC DTC_D00241 "" VALUE 0 Scalar_UWORD 0 SWC_HALOUT_type_CM_uint16 0 65535 /end CHARACTERISTIC
/begin CHARACTERISTIC KHAL_CAN1FD1APS3E2E_flg "" VALUE 0 Scalar_BOOLEAN 0 SWC_HALOUT_type_CM_boolean_flg 0.0 1.0 /end CHARACTERISTIC
/begin CHARACTERISTIC KHAL_CAN1FD1VCU2E2E_flg "" VALUE 0 Scalar_BOOLEAN 0 SWC_HALOUT_type_CM_boolean_flg 0.0 1.0 /end CHARACTERISTIC
/begin CHARACTERISTIC KHAL_CAN1FD1VCU3E2E_flg "" VALUE 0 Scalar_BOOLEAN 0 SWC_HALOUT_type_CM_boolean_flg 0.0 1.0 /end CHARACTERISTIC
/begin MEASUREMENT VDTC_DTCArray_raw32 "" ULONG SWC_HALOUT_type_CM_uint32 0 0 0 4.294967295E+9 ECU_ADDRESS 0 /* Dimension */ MATRIX_DIM 1 320 1
 /begin IF_DATA XCP
  /begin DAQ_EVENT FIXED_EVENT_LIST EVENT 0x0 EVENT 0x1 EVENT 0x2 EVENT 0x3 /end DAQ_EVENT
 /end IF_DATA
/end MEASUREMENT
/begin MEASUREMENT VDTC_HeaderArray_raw32 "" ULONG SWC_HALOUT_type_CM_uint32 0 0 0 4.294967295E+9 ECU_ADDRESS 0 /* Dimension */ MATRIX_DIM 1 10 1
 /begin IF_DATA XCP
  /begin DAQ_EVENT FIXED_EVENT_LIST EVENT 0x0 EVENT 0x1 EVENT 0x2 EVENT 0x3 /end DAQ_EVENT
 /end IF_DATA
/end MEASUREMENT
/begin MEASUREMENT VHAL_TriggerDTC_flg "" UBYTE SWC_HALOUT_type_CM_boolean_flg 0 0 0.0 1.0 ECU_ADDRESS 0
 /begin IF_DATA XCP
  /begin DAQ_EVENT FIXED_EVENT_LIST EVENT 0x0 EVENT 0x1 EVENT 0x2 EVENT 0x3 /end DAQ_EVENT
 /end IF_DATA
/end MEASUREMENT
/begin COMPU_METHOD SWC_HALOUT_type_CM_uint16 "Q = V" RAT_FUNC "%5.0" "" COEFFS 0 1 0 0 0 1 /end COMPU_METHOD
/begin COMPU_METHOD SWC_HALOUT_type_CM_boolean_flg "Q = V" RAT_FUNC "%1.0" "flg" COEFFS 0 1 0 0 0 1 /end COMPU_METHOD
/begin COMPU_METHOD SWC_HALOUT_type_CM_uint32 "Q = V" RAT_FUNC "%10.0" "" COEFFS 0 1 0 0 0 1 /end COMPU_METHOD
/begin GROUP S20_DTC_list "SWC_HALOUT_type/run_SWC_HALOUT_Tx_5ms_sys/OUTP_AFTER/DTC_list"
 /begin REF_CHARACTERISTIC DTC_100242 DTC_100243 DTC_100244 DTC_100247 DTC_100248 DTC_100249 DTC_100250 DTC_100251 DTC_100252 DTC_500B01 DTC_500B02 DTC_500B03 DTC_500B04 DTC_500B05 DTC_500B06 DTC_500B07 DTC_500B08 DTC_500B09 DTC_500B0A DTC_500B0B DTC_500B0C DTC_500B0D DTC_500B0E DTC_500B0F DTC_500B10 DTC_900301 DTC_900302 DTC_900303 DTC_900304 DTC_900909 DTC_90090A DTC_90090B DTC_90090C DTC_90090D DTC_90090E DTC_90090F DTC_900910 DTC_900911 DTC_900912 DTC_900913 DTC_900914 DTC_D00206 DTC_D00207 DTC_D00208 DTC_D00209 DTC_D0020A DTC_D00234 DTC_D00235 DTC_D00236 DTC_D00237 DTC_D00238 DTC_D0023A DTC_D0023B DTC_D0023C DTC_D0023D DTC_D0023E DTC_D00240 DTC_D00241 /end REF_CHARACTERISTIC
/end GROUP
/begin GROUP S39_FD1_APS3_0x238 "SWC_HALOUT_type/run_SWC_HALOUT_Tx_5ms_sys/HAL_OUT/CAN1/FD1_APS3_0x238" /begin REF_CHARACTERISTIC KHAL_CAN1FD1APS3E2E_flg /end REF_CHARACTERISTIC /end GROUP
/begin GROUP S39_FD1_VCU2_0x154 "SWC_HALOUT_type/run_SWC_HALOUT_Tx_5ms_sys/HAL_OUT/CAN1/FD1_VCU2_0x154" /begin REF_CHARACTERISTIC KHAL_CAN1FD1VCU2E2E_flg /end REF_CHARACTERISTIC /end GROUP
/begin GROUP S39_FD1_VCU3_0x159 "SWC_HALOUT_type/run_SWC_HALOUT_Tx_5ms_sys/HAL_OUT/CAN1/FD1_VCU3_0x159" /begin REF_CHARACTERISTIC KHAL_CAN1FD1VCU3E2E_flg /end REF_CHARACTERISTIC /end GROUP
/end MODULE
/end PROJECT
