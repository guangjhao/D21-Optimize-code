AUTOSAR XML (schema 4-3-0)
package /CAN7/ISignalGroup
  i signal group CAN7_SG_GW7_C100_0: i-signal=CAN7_VehSpeed, system-signal-group=CAN7_SG_GW7_C100_0
package /CAN7/Cluster
  can cluster CAN7: baudrate=500, can-fd-baudrate=2000
    can physical channel CAN7: comm-connectors=ConnCAN7
      frame CAN7_GW7_C100_0: id 0x1C5, frame-length=32, can-addressing-mode=STANDARD, can-fd-frame-support=true, can-frame-rx-behavior=CAN-FD, can-frame-tx-behavior=CAN-FD
        pdu CAN7_GW7_C100_0: length=32, minimum-delay=0.0, transmission-mode-true-timing=cyclic-timing=time-period=0.1, unused-bit-pattern=0
          mapping CAN7_SG_GW7_C100_0: i-signal-group=CAN7_SG_GW7_C100_0, start-position=0, transfer-property=PENDING
          signal CAN7_VehSpeed: start 19, 12 bit, big-endian, i-signal-type=PRIMITIVE, init-value=constant-reference=Init_CAN7_VehSpeed, base-type=uint16, implementation-data-type=uint16, transfer-property=PENDING
package /CAN7/ConstantSpecification
  constant specification Init_CAN7_VehSpeed: value-spec=0
  constant specification Init_CAN7_SG_GW7_C100_0: value-spec=fields=constant-reference=Init_CAN7_VehSpeed
package /CAN7/ImplementationDataTypes
  impl type DT_CAN7_SG_GW7_C100_0: category=STRUCTURE
    element CAN7_VehSpeed: implementation-data-type=uint16
