ASAP2_VERSION 1 31
/begin PROJECT ProjectName "Project Comment Goes Here"
/begin HEADER "Header Comments go here" /end HEADER
/begin MODULE ModuleName "Module Comment Goes Here"
/begin MOD_COMMON "Mod Common Comment Here" BYTE_ORDER MSB_LAST /end MOD_COMMON
/begin RECORD_LAYOUT Scalar_BOOLEAN FNC_VALUES 1 UBYTE COLUMN_DIR DIRECT /end RECORD_LAYOUT
/begin RECORD_LAYOUT Scalar_UBYTE FNC_VALUES 1 UBYTE COLUMN_DIR DIRECT /end RECORD_LAYOUT
/begin RECORD_LAYOUT Scalar_FLOAT32_IEEE FNC_VALUES 1 FLOAT32_IEEE COLUMN_DIR DIRECT /end RECORD_LAYOUT
/begin RECORD_LAYOUT Lookup2D_FLOAT32_IEEE FNC_VALUES 1 FLOAT32_IEEE COLUMN_DIR DIRECT /end RECORD_LAYOUT
/begin RECORD_LAYOUT Lookup2D_X_FLOAT32_IEEE AXIS_PTS_X 1 FLOAT32_IEEE INDEX_INCR DIRECT /end RECORD_LAYOUT
/begin RECORD_LAYOUT Lookup2D_FLOAT64_IEEE FNC_VALUES 1 FLOAT64_IEEE COLUMN_DIR DIRECT /end RECORD_LAYOUT
/begin RECORD_LAYOUT Lookup2D_X_FLOAT64_IEEE AXIS_PTS_X 1 FLOAT64_IEEE INDEX_INCR DIRECT /end RECORD_LAYOUT
/begin CHARACTERISTIC KOUTP_ACCComfortBandLower_mps2_maxval "" VALUE 0x0000 /* @ECU_Address@KOUTP_ACCComfortBandLower_mps2_maxval@ */ Scalar_FLOAT32_IEEE 0 SWC_OUTP_type_CM_single_mps2 -65535.0 65535.0 /end CHARACTERISTIC
/begin CHARACTERISTIC KOUTP_ACCComfortBandLower_mps2_minval "" VALUE 0x0000 /* @ECU_Address@KOUTP_ACCComfortBandLower_mps2_minval@ */ Scalar_FLOAT32_IEEE 0 SWC_OUTP_type_CM_single_mps2 -65535.0 65535.0 /end CHARACTERISTIC
/begin CHARACTERISTIC KOUTP_ACCComfortBandLower_mps2_ovrdval "" VALUE 0x0000 /* @ECU_Address@KOUTP_ACCComfortBandLower_mps2_ovrdval@ */ Scalar_FLOAT32_IEEE 0 SWC_OUTP_type_CM_single_mps2 -65535.0 65535.0 /end CHARACTERISTIC
/begin CHARACTERISTIC KOUTP_ACCComfortBandUpper_mps2_maxval "" VALUE 0x0000 /* @ECU_Address@KOUTP_ACCComfortBandUpper_mps2_maxval@ */ Scalar_FLOAT32_IEEE 0 SWC_OUTP_type_CM_single_mps2 -65535.0 65535.0 /end CHARACTERISTIC
/begin CHARACTERISTIC KOUTP_ACCComfortBandUpper_mps2_minval "" VALUE 0x0000 /* @ECU_Address@KOUTP_ACCComfortBandUpper_mps2_minval@ */ Scalar_FLOAT32_IEEE 0 SWC_OUTP_type_CM_single_mps2 -65535.0 65535.0 /end CHARACTERISTIC
/begin CHARACTERISTIC KOUTP_ACCComfortBandUpper_mps2_ovrdval "" VALUE 0x0000 /* @ECU_Address@KOUTP_ACCComfortBandUpper_mps2_ovrdval@ */ Scalar_FLOAT32_IEEE 0 SWC_OUTP_type_CM_single_mps2 -65535.0 65535.0 /end CHARACTERISTIC
/begin CHARACTERISTIC KOUTP_ACCJerkLowerLimit_mps3_maxval "" VALUE 0x0000 /* @ECU_Address@KOUTP_ACCJerkLowerLimit_mps3_maxval@ */ Scalar_FLOAT32_IEEE 0 SWC_OUTP_type_CM_single_mps3 -65535.0 65535.0 /end CHARACTERISTIC
/begin CHARACTERISTIC KOUTP_ACCJerkLowerLimit_mps3_minval "" VALUE 0x0000 /* @ECU_Address@KOUTP_ACCJerkLowerLimit_mps3_minval@ */ Scalar_FLOAT32_IEEE 0 SWC_OUTP_type_CM_single_mps3 -65535.0 65535.0 /end CHARACTERISTIC
/begin CHARACTERISTIC KOUTP_ACCJerkLowerLimit_mps3_ovrdval "" VALUE 0x0000 /* @ECU_Address@KOUTP_ACCJerkLowerLimit_mps3_ovrdval@ */ Scalar_FLOAT32_IEEE 0 SWC_OUTP_type_CM_single_mps3 -65535.0 65535.0 /end CHARACTERISTIC
/begin CHARACTERISTIC KOUTP_ACCJerkUpperLimit_mps3_maxval "" VALUE 0x0000 /* @ECU_Address@KOUTP_ACCJerkUpperLimit_mps3_maxval@ */ Scalar_FLOAT32_IEEE 0 SWC_OUTP_type_CM_single_mps3 -65535.0 65535.0 /end CHARACTERISTIC
/begin CHARACTERISTIC KOUTP_ACCJerkUpperLimit_mps3_minval "" VALUE 0x0000 /* @ECU_Address@KOUTP_ACCJerkUpperLimit_mps3_minval@ */ Scalar_FLOAT32_IEEE 0 SWC_OUTP_type_CM_single_mps3 -65535.0 65535.0 /end CHARACTERISTIC
/begin CHARACTERISTIC KOUTP_ACCJerkUpperLimit_mps3_ovrdval "" VALUE 0x0000 /* @ECU_Address@KOUTP_ACCJerkUpperLimit_mps3_ovrdval@ */ Scalar_FLOAT32_IEEE 0 SWC_OUTP_type_CM_single_mps3 -65535.0 65535.0 /end CHARACTERISTIC
/begin CHARACTERISTIC KOUTP_ACCObjDist_m_maxval "" VALUE 0x0000 /* @ECU_Address@KOUTP_ACCObjDist_m_maxval@ */ Scalar_FLOAT32_IEEE 0 SWC_OUTP_type_CM_single_m -65535.0 65535.0 /end CHARACTERISTIC
/begin CHARACTERISTIC KOUTP_ACCObjDist_m_minval "" VALUE 0x0000 /* @ECU_Address@KOUTP_ACCObjDist_m_minval@ */ Scalar_FLOAT32_IEEE 0 SWC_OUTP_type_CM_single_m -65535.0 65535.0 /end CHARACTERISTIC
/begin CHARACTERISTIC KOUTP_ACCObjDist_m_ovrdval "" VALUE 0x0000 /* @ECU_Address@KOUTP_ACCObjDist_m_ovrdval@ */ Scalar_FLOAT32_IEEE 0 SWC_OUTP_type_CM_single_m -65535.0 65535.0 /end CHARACTERISTIC
/begin CHARACTERISTIC KOUTP_ACCObjRelSpd_mps_maxval "" VALUE 0x0000 /* @ECU_Address@KOUTP_ACCObjRelSpd_mps_maxval@ */ Scalar_FLOAT32_IEEE 0 SWC_OUTP_type_CM_single_mps -65535.0 65535.0 /end CHARACTERISTIC
/begin CHARACTERISTIC KOUTP_ACCObjRelSpd_mps_minval "" VALUE 0x0000 /* @ECU_Address@KOUTP_ACCObjRelSpd_mps_minval@ */ Scalar_FLOAT32_IEEE 0 SWC_OUTP_type_CM_single_mps -65535.0 65535.0 /end CHARACTERISTIC
/begin CHARACTERISTIC KOUTP_ACCObjRelSpd_mps_ovrdval "" VALUE 0x0000 /* @ECU_Address@KOUTP_ACCObjRelSpd_mps_ovrdval@ */ Scalar_FLOAT32_IEEE 0 SWC_OUTP_type_CM_single_mps -65535.0 65535.0 /end CHARACTERISTIC
/begin CHARACTERISTIC KOUTP_ACCRequiredAccel_mps2_maxval "" VALUE 0x0000 /* @ECU_Address@KOUTP_ACCRequiredAccel_mps2_maxval@ */ Scalar_FLOAT32_IEEE 0 SWC_OUTP_type_CM_single_mps2 -65535.0 65535.0 /end CHARACTERISTIC
/begin CHARACTERISTIC KOUTP_ACCRequiredAccel_mps2_minval "" VALUE 0x0000 /* @ECU_Address@KOUTP_ACCRequiredAccel_mps2_minval@ */ Scalar_FLOAT32_IEEE 0 SWC_OUTP_type_CM_single_mps2 -65535.0 65535.0 /end CHARACTERISTIC
/begin CHARACTERISTIC KOUTP_ACCRequiredAccel_mps2_ovrdval "" VALUE 0x0000 /* @ECU_Address@KOUTP_ACCRequiredAccel_mps2_ovrdval@ */ Scalar_FLOAT32_IEEE 0 SWC_OUTP_type_CM_single_mps2 -65535.0 65535.0 /end CHARACTERISTIC
/begin CHARACTERISTIC KOUTP_ADASLanecurveL_raw32_maxval "" VALUE 0x0000 /* @ECU_Address@KOUTP_ADASLanecurveL_raw32_maxval@ */ Scalar_FLOAT32_IEEE 0 SWC_OUTP_type_CM_single_raw32 -65535.0 65535.0 /end CHARACTERISTIC
/begin CHARACTERISTIC KOUTP_ADASLanecurveL_raw32_minval "" VALUE 0x0000 /* @ECU_Address@KOUTP_ADASLanecurveL_raw32_minval@ */ Scalar_FLOAT32_IEEE 0 SWC_OUTP_type_CM_single_raw32 -65535.0 65535.0 /end CHARACTERISTIC
/begin CHARACTERISTIC KOUTP_ADASLanecurveL_raw32_ovrdval "" VALUE 0x0000 /* @ECU_Address@KOUTP_ADASLanecurveL_raw32_ovrdval@ */ Scalar_FLOAT32_IEEE 0 SWC_OUTP_type_CM_single_raw32 -65535.0 65535.0 /end CHARACTERISTIC
/begin CHARACTERISTIC KOUTP_ADASLanecurveR_raw32_maxval "" VALUE 0x0000 /* @ECU_Address@KOUTP_ADASLanecurveR_raw32_maxval@ */ Scalar_FLOAT32_IEEE 0 SWC_OUTP_type_CM_single_raw32 -65535.0 65535.0 /end CHARACTERISTIC
/begin CHARACTERISTIC KOUTP_ADASLanecurveR_raw32_minval "" VALUE 0x0000 /* @ECU_Address@KOUTP_ADASLanecurveR_raw32_minval@ */ Scalar_FLOAT32_IEEE 0 SWC_OUTP_type_CM_single_raw32 -65535.0 65535.0 /end CHARACTERISTIC
/begin CHARACTERISTIC KOUTP_ADASLanecurveR_raw32_ovrdval "" VALUE 0x0000 /* @ECU_Address@KOUTP_ADASLanecurveR_raw32_ovrdval@ */ Scalar_FLOAT32_IEEE 0 SWC_OUTP_type_CM_single_raw32 -65535.0 65535.0 /end CHARACTERISTIC
/begin CHARACTERISTIC KOUTP_ADASVehSpdLim_raw32_maxval "" VALUE 0x0000 /* @ECU_Address@KOUTP_ADASVehSpdLim_raw32_maxval@ */ Scalar_FLOAT32_IEEE 0 SWC_OUTP_type_CM_single_raw32 -65535.0 65535.0 /end CHARACTERISTIC
/begin CHARACTERISTIC KOUTP_ADASVehSpdLim_raw32_minval "" VALUE 0x0000 /* @ECU_Address@KOUTP_ADASVehSpdLim_raw32_minval@ */ Scalar_FLOAT32_IEEE 0 SWC_OUTP_type_CM_single_raw32 -65535.0 65535.0 /end CHARACTERISTIC
/begin CHARACTERISTIC KOUTP_ADASVehSpdLim_raw32_ovrdval "" VALUE 0x0000 /* @ECU_Address@KOUTP_ADASVehSpdLim_raw32_ovrdval@ */ Scalar_FLOAT32_IEEE 0 SWC_OUTP_type_CM_single_raw32 -65535.0 65535.0 /end CHARACTERISTIC
/begin CHARACTERISTIC KOUTP_APSDecReq_mps2_maxval "" VALUE 0x0000 /* @ECU_Address@KOUTP_APSDecReq_mps2_maxval@ */ Scalar_FLOAT32_IEEE 0 SWC_OUTP_type_CM_single_mps2 -65535.0 65535.0 /end CHARACTERISTIC
/begin CHARACTERISTIC KOUTP_APSDecReq_mps2_minval "" VALUE 0x0000 /* @ECU_Address@KOUTP_APSDecReq_mps2_minval@ */ Scalar_FLOAT32_IEEE 0 SWC_OUTP_type_CM_single_mps2 -65535.0 65535.0 /end CHARACTERISTIC
/begin CHARACTERISTIC KOUTP_APSDecReq_mps2_ovrdval "" VALUE 0x0000 /* @ECU_Address@KOUTP_APSDecReq_mps2_ovrdval@ */ Scalar_FLOAT32_IEEE 0 SWC_OUTP_type_CM_single_mps2 -65535.0 65535.0 /end CHARACTERISTIC
/begin CHARACTERISTIC KOUTP_AccCalcuPID_mps2_maxval "" VALUE 0x0000 /* @ECU_Address@KOUTP_AccCalcuPID_mps2_maxval@ */ Scalar_FLOAT32_IEEE 0 SWC_OUTP_type_CM_single_mps2 -65535.0 65535.0 /end CHARACTERISTIC
/begin CHARACTERISTIC KOUTP_AccCalcuPID_mps2_minval "" VALUE 0x0000 /* @ECU_Address@KOUTP_AccCalcuPID_mps2_minval@ */ Scalar_FLOAT32_IEEE 0 SWC_OUTP_type_CM_single_mps2 -65535.0 65535.0 /end CHARACTERISTIC
/begin CHARACTERISTIC KOUTP_AccCalcuPID_mps2_ovrdval "" VALUE 0x0000 /* @ECU_Address@KOUTP_AccCalcuPID_mps2_ovrdval@ */ Scalar_FLOAT32_IEEE 0 SWC_OUTP_type_CM_single_mps2 -65535.0 65535.0 /end CHARACTERISTIC
/begin CHARACTERISTIC KOUTP_ActACCRequiredAccel_mps2_maxval "" VALUE 0x0000 /* @ECU_Address@KOUTP_ActACCRequiredAccel_mps2_maxval@ */ Scalar_FLOAT32_IEEE 0 SWC_OUTP_type_CM_single_mps2 -65535.0 65535.0 /end CHARACTERISTIC
/begin CHARACTERISTIC KOUTP_ActACCRequiredAccel_mps2_minval "" VALUE 0x0000 /* @ECU_Address@KOUTP_ActACCRequiredAccel_mps2_minval@ */ Scalar_FLOAT32_IEEE 0 SWC_OUTP_type_CM_single_mps2 -65535.0 65535.0 /end CHARACTERISTIC
/begin CHARACTERISTIC KOUTP_ActACCRequiredAccel_mps2_ovrdval "" VALUE 0x0000 /* @ECU_Address@KOUTP_ActACCRequiredAccel_mps2_ovrdval@ */ Scalar_FLOAT32_IEEE 0 SWC_OUTP_type_CM_single_mps2 -65535.0 65535.0 /end CHARACTERISTIC
/begin CHARACTERISTIC KOUTP_CalibratedAccX_G_maxval "" VALUE 0x0000 /* @ECU_Address@KOUTP_CalibratedAccX_G_maxval@ */ Scalar_FLOAT32_IEEE 0 SWC_OUTP_type_CM_single_Gps -65535.0 65535.0 /end CHARACTERISTIC
/begin CHARACTERISTIC KOUTP_CalibratedAccX_G_minval "" VALUE 0x0000 /* @ECU_Address@KOUTP_CalibratedAccX_G_minval@ */ Scalar_FLOAT32_IEEE 0 SWC_OUTP_type_CM_single_Gps -65535.0 65535.0 /end CHARACTERISTIC
/begin CHARACTERISTIC KOUTP_CalibratedAccX_G_ovrdval "" VALUE 0x0000 /* @ECU_Address@KOUTP_CalibratedAccX_G_ovrdval@ */ Scalar_FLOAT32_IEEE 0 SWC_OUTP_type_CM_single_G -65535.0 65535.0 /end CHARACTERISTIC
/begin CHARACTERISTIC KOUTP_CalibratedAccY_G_maxval "" VALUE 0x0000 /* @ECU_Address@KOUTP_CalibratedAccY_G_maxval@ */ Scalar_FLOAT32_IEEE 0 SWC_OUTP_type_CM_single_Gps -65535.0 65535.0 /end CHARACTERISTIC
/begin CHARACTERISTIC KOUTP_CalibratedAccY_G_minval "" VALUE 0x0000 /* @ECU_Address@KOUTP_CalibratedAccY_G_minval@ */ Scalar_FLOAT32_IEEE 0 SWC_OUTP_type_CM_single_Gps -65535.0 65535.0 /end CHARACTERISTIC
/begin CHARACTERISTIC KOUTP_CalibratedAccY_G_ovrdval "" VALUE 0x0000 /* @ECU_Address@KOUTP_CalibratedAccY_G_ovrdval@ */ Scalar_FLOAT32_IEEE 0 SWC_OUTP_type_CM_single_G -65535.0 65535.0 /end CHARACTERISTIC
/begin CHARACTERISTIC KOUTP_CalibratedAccZ_G_maxval "" VALUE 0x0000 /* @ECU_Address@KOUTP_CalibratedAccZ_G_maxval@ */ Scalar_FLOAT32_IEEE 0 SWC_OUTP_type_CM_single_Gps -65535.0 65535.0 /end CHARACTERISTIC
/begin CHARACTERISTIC KOUTP_CalibratedAccZ_G_minval "" VALUE 0x0000 /* @ECU_Address@KOUTP_CalibratedAccZ_G_minval@ */ Scalar_FLOAT32_IEEE 0 SWC_OUTP_type_CM_single_Gps -65535.0 65535.0 /end CHARACTERISTIC
/begin CHARACTERISTIC KOUTP_CalibratedAccZ_G_ovrdval "" VALUE 0x0000 /* @ECU_Address@KOUTP_CalibratedAccZ_G_ovrdval@ */ Scalar_FLOAT32_IEEE 0 SWC_OUTP_type_CM_single_G -65535.0 65535.0 /end CHARACTERISTIC
/begin CHARACTERISTIC KOUTP_CalibratedGyroX_Dps_maxval "" VALUE 0x0000 /* @ECU_Address@KOUTP_CalibratedGyroX_Dps_maxval@ */ Scalar_FLOAT32_IEEE 0 SWC_OUTP_type_CM_single_dps -65535.0 65535.0 /end CHARACTERISTIC
/begin CHARACTERISTIC KOUTP_CalibratedGyroX_Dps_minval "" VALUE 0x0000 /* @ECU_Address@KOUTP_CalibratedGyroX_Dps_minval@ */ Scalar_FLOAT32_IEEE 0 SWC_OUTP_type_CM_single_dps -65535.0 65535.0 /end CHARACTERISTIC
/begin CHARACTERISTIC KOUTP_CalibratedGyroX_Dps_ovrdval "" VALUE 0x0000 /* @ECU_Address@KOUTP_CalibratedGyroX_Dps_ovrdval@ */ Scalar_FLOAT32_IEEE 0 SWC_OUTP_type_CM_single_Dps -65535.0 65535.0 /end CHARACTERISTIC
/begin CHARACTERISTIC KOUTP_CalibratedGyroY_Dps_maxval "" VALUE 0x0000 /* @ECU_Address@KOUTP_CalibratedGyroY_Dps_maxval@ */ Scalar_FLOAT32_IEEE 0 SWC_OUTP_type_CM_single_dps -65535.0 65535.0 /end CHARACTERISTIC
/begin CHARACTERISTIC KOUTP_CalibratedGyroY_Dps_minval "" VALUE 0x0000 /* @ECU_Address@KOUTP_CalibratedGyroY_Dps_minval@ */ Scalar_FLOAT32_IEEE 0 SWC_OUTP_type_CM_single_dps -65535.0 65535.0 /end CHARACTERISTIC
/begin CHARACTERISTIC KOUTP_CalibratedGyroY_Dps_ovrdval "" VALUE 0x0000 /* @ECU_Address@KOUTP_CalibratedGyroY_Dps_ovrdval@ */ Scalar_FLOAT32_IEEE 0 SWC_OUTP_type_CM_single_Dps -65535.0 65535.0 /end CHARACTERISTIC
/begin CHARACTERISTIC KOUTP_CalibratedGyroZ_Dps_maxval "" VALUE 0x0000 /* @ECU_Address@KOUTP_CalibratedGyroZ_Dps_maxval@ */ Scalar_FLOAT32_IEEE 0 SWC_OUTP_type_CM_single_dps -65535.0 65535.0 /end CHARACTERISTIC
/begin CHARACTERISTIC KOUTP_CalibratedGyroZ_Dps_minval "" VALUE 0x0000 /* @ECU_Address@KOUTP_CalibratedGyroZ_Dps_minval@ */ Scalar_FLOAT32_IEEE 0 SWC_OUTP_type_CM_single_dps -65535.0 65535.0 /end CHARACTERISTIC
/begin CHARACTERISTIC KOUTP_CalibratedGyroZ_Dps_ovrdval "" VALUE 0x0000 /* @ECU_Address@KOUTP_CalibratedGyroZ_Dps_ovrdval@ */ Scalar_FLOAT32_IEEE 0 SWC_OUTP_type_CM_single_Dps -65535.0 65535.0 /end CHARACTERISTIC
/begin CHARACTERISTIC KOUTP_DISCReqAcc_mps2_maxval "" VALUE 0x0000 /* @ECU_Address@KOUTP_DISCReqAcc_mps2_maxval@ */ Scalar_FLOAT32_IEEE 0 SWC_OUTP_type_CM_single_mps2 -65535.0 65535.0 /end CHARACTERISTIC
/begin CHARACTERISTIC KOUTP_DISCReqAcc_mps2_minval "" VALUE 0x0000 /* @ECU_Address@KOUTP_DISCReqAcc_mps2_minval@ */ Scalar_FLOAT32_IEEE 0 SWC_OUTP_type_CM_single_mps2 -65535.0 65535.0 /end CHARACTERISTIC
/begin CHARACTERISTIC KOUTP_DISCReqAcc_mps2_ovrdval "" VALUE 0x0000 /* @ECU_Address@KOUTP_DISCReqAcc_mps2_ovrdval@ */ Scalar_FLOAT32_IEEE 0 SWC_OUTP_type_CM_single_mps2 -65535.0 65535.0 /end CHARACTERISTIC
/begin CHARACTERISTIC KOUTP_FDCVMCAPSAngleTarget_deg_maxval "" VALUE 0x0000 /* @ECU_Address@KOUTP_FDCVMCAPSAngleTarget_deg_maxval@ */ Scalar_FLOAT32_IEEE 0 SWC_OUTP_type_CM_single_deg -65535.0 65535.0 /end CHARACTERISTIC
/begin CHARACTERISTIC KOUTP_FDCVMCAPSAngleTarget_deg_minval "" VALUE 0x0000 /* @ECU_Address@KOUTP_FDCVMCAPSAngleTarget_deg_minval@ */ Scalar_FLOAT32_IEEE 0 SWC_OUTP_type_CM_single_deg -65535.0 65535.0 /end CHARACTERISTIC
/begin CHARACTERISTIC KOUTP_FDCVMCAPSAngleTarget_deg_ovrdval "" VALUE 0x0000 /* @ECU_Address@KOUTP_FDCVMCAPSAngleTarget_deg_ovrdval@ */ Scalar_FLOAT32_IEEE 0 SWC_OUTP_type_CM_single_deg -65535.0 65535.0 /end CHARACTERISTIC
/begin CHARACTERISTIC KOUTP_FDCVMCAngCtrlTqWtGn_pct_maxval "" VALUE 0x0000 /* @ECU_Address@KOUTP_FDCVMCAngCtrlTqWtGn_pct_maxval@ */ Scalar_FLOAT32_IEEE 0 SWC_OUTP_type_CM_single_pct -65535.0 65535.0 /end CHARACTERISTIC
/begin CHARACTERISTIC KOUTP_FDCVMCAngCtrlTqWtGn_pct_minval "" VALUE 0x0000 /* @ECU_Address@KOUTP_FDCVMCAngCtrlTqWtGn_pct_minval@ */ Scalar_FLOAT32_IEEE 0 SWC_OUTP_type_CM_single_pct -65535.0 65535.0 /end CHARACTERISTIC
/begin CHARACTERISTIC KOUTP_FDCVMCAngCtrlTqWtGn_pct_ovrdval "" VALUE 0x0000 /* @ECU_Address@KOUTP_FDCVMCAngCtrlTqWtGn_pct_ovrdval@ */ Scalar_FLOAT32_IEEE 0 SWC_OUTP_type_CM_single_pct -65535.0 65535.0 /end CHARACTERISTIC
/begin CHARACTERISTIC KOUTP_FDCVMCDrInpTqBstGn_pct_maxval "" VALUE 0x0000 /* @ECU_Address@KOUTP_FDCVMCDrInpTqBstGn_pct_maxval@ */ Scalar_FLOAT32_IEEE 0 SWC_OUTP_type_CM_single_pct -65535.0 65535.0 /end CHARACTERISTIC
/begin CHARACTERISTIC KOUTP_FDCVMCDrInpTqBstGn_pct_minval "" VALUE 0x0000 /* @ECU_Address@KOUTP_FDCVMCDrInpTqBstGn_pct_minval@ */ Scalar_FLOAT32_IEEE 0 SWC_OUTP_type_CM_single_pct -65535.0 65535.0 /end CHARACTERISTIC
/begin CHARACTERISTIC KOUTP_FDCVMCDrInpTqBstGn_pct_ovrdval "" VALUE 0x0000 /* @ECU_Address@KOUTP_FDCVMCDrInpTqBstGn_pct_ovrdval@ */ Scalar_FLOAT32_IEEE 0 SWC_OUTP_type_CM_single_pct -65535.0 65535.0 /end CHARACTERISTIC
/begin CHARACTERISTIC KOUTP_FDCVMCMaxAngCtrlOutTqLim_Nm_maxval "" VALUE 0x0000 /* @ECU_Address@KOUTP_FDCVMCMaxAngCtrlOutTqLim_Nm_maxval@ */ Scalar_FLOAT32_IEEE 0 SWC_OUTP_type_CM_single_Nm -65535.0 65535.0 /end CHARACTERISTIC
/begin CHARACTERISTIC KOUTP_FDCVMCMaxAngCtrlOutTqLim_Nm_minval "" VALUE 0x0000 /* @ECU_Address@KOUTP_FDCVMCMaxAngCtrlOutTqLim_Nm_minval@ */ Scalar_FLOAT32_IEEE 0 SWC_OUTP_type_CM_single_Nm -65535.0 65535.0 /end CHARACTERISTIC
/begin CHARACTERISTIC KOUTP_FDCVMCMaxAngCtrlOutTqLim_Nm_ovrdval "" VALUE 0x0000 /* @ECU_Address@KOUTP_FDCVMCMaxAngCtrlOutTqLim_Nm_ovrdval@ */ Scalar_FLOAT32_IEEE 0 SWC_OUTP_type_CM_single_Nm -65535.0 65535.0 /end CHARACTERISTIC
/begin CHARACTERISTIC KOUTP_FeatReqSpd_kph_maxval "" VALUE 0x0000 /* @ECU_Address@KOUTP_FeatReqSpd_kph_maxval@ */ Scalar_FLOAT32_IEEE 0 SWC_OUTP_type_CM_single_kph -65535.0 65535.0 /end CHARACTERISTIC
/begin CHARACTERISTIC KOUTP_FeatReqSpd_kph_minval "" VALUE 0x0000 /* @ECU_Address@KOUTP_FeatReqSpd_kph_minval@ */ Scalar_FLOAT32_IEEE 0 SWC_OUTP_type_CM_single_kph -65535.0 65535.0 /end CHARACTERISTIC
/begin CHARACTERISTIC KOUTP_FeatReqSpd_kph_ovrdval "" VALUE 0x0000 /* @ECU_Address@KOUTP_FeatReqSpd_kph_ovrdval@ */ Scalar_FLOAT32_IEEE 0 SWC_OUTP_type_CM_single_kph -65535.0 65535.0 /end CHARACTERISTIC
/begin CHARACTERISTIC KOUTP_FeatSetSpdFinal_raw32_maxval "" VALUE 0x0000 /* @ECU_Address@KOUTP_FeatSetSpdFinal_raw32_maxval@ */ Scalar_FLOAT32_IEEE 0 SWC_OUTP_type_CM_single_raw32 -65535.0 65535.0 /end CHARACTERISTIC
/begin CHARACTERISTIC KOUTP_FeatSetSpdFinal_raw32_minval "" VALUE 0x0000 /* @ECU_Address@KOUTP_FeatSetSpdFinal_raw32_minval@ */ Scalar_FLOAT32_IEEE 0 SWC_OUTP_type_CM_single_raw32 -65535.0 65535.0 /end CHARACTERISTIC
/begin CHARACTERISTIC KOUTP_FeatSetSpdFinal_raw32_ovrdval "" VALUE 0x0000 /* @ECU_Address@KOUTP_FeatSetSpdFinal_raw32_ovrdval@ */ Scalar_FLOAT32_IEEE 0 SWC_OUTP_type_CM_single_raw32 -65535.0 65535.0 /end CHARACTERISTIC
/begin CHARACTERISTIC KOUTP_ISOAccLimit_mps2_maxval "" VALUE 0x0000 /* @ECU_Address@KOUTP_ISOAccLimit_mps2_maxval@ */ Scalar_FLOAT32_IEEE 0 SWC_OUTP_type_CM_single_mps2 -65535.0 65535.0 /end CHARACTERISTIC
/begin CHARACTERISTIC KOUTP_ISOAccLimit_mps2_minval "" VALUE 0x0000 /* @ECU_Address@KOUTP_ISOAccLimit_mps2_minval@ */ Scalar_FLOAT32_IEEE 0 SWC_OUTP_type_CM_single_mps2 -65535.0 65535.0 /end CHARACTERISTIC
/begin CHARACTERISTIC KOUTP_ISOAccLimit_mps2_ovrdval "" VALUE 0x0000 /* @ECU_Address@KOUTP_ISOAccLimit_mps2_ovrdval@ */ Scalar_FLOAT32_IEEE 0 SWC_OUTP_type_CM_single_mps2 -65535.0 65535.0 /end CHARACTERISTIC
/begin CHARACTERISTIC KOUTP_ISODecLimit_mps2_maxval "" VALUE 0x0000 /* @ECU_Address@KOUTP_ISODecLimit_mps2_maxval@ */ Scalar_FLOAT32_IEEE 0 SWC_OUTP_type_CM_single_mps2 -65535.0 65535.0 /end CHARACTERISTIC
/begin CHARACTERISTIC KOUTP_ISODecLimit_mps2_minval "" VALUE 0x0000 /* @ECU_Address@KOUTP_ISODecLimit_mps2_minval@ */ Scalar_FLOAT32_IEEE 0 SWC_OUTP_type_CM_single_mps2 -65535.0 65535.0 /end CHARACTERISTIC
/begin CHARACTERISTIC KOUTP_ISODecLimit_mps2_ovrdval "" VALUE 0x0000 /* @ECU_Address@KOUTP_ISODecLimit_mps2_ovrdval@ */ Scalar_FLOAT32_IEEE 0 SWC_OUTP_type_CM_single_mps2 -65535.0 65535.0 /end CHARACTERISTIC
/begin CHARACTERISTIC KOUTP_ISOJerkLimit_mps3_maxval "" VALUE 0x0000 /* @ECU_Address@KOUTP_ISOJerkLimit_mps3_maxval@ */ Scalar_FLOAT32_IEEE 0 SWC_OUTP_type_CM_single_mps3 -65535.0 65535.0 /end CHARACTERISTIC
/begin CHARACTERISTIC KOUTP_ISOJerkLimit_mps3_minval "" VALUE 0x0000 /* @ECU_Address@KOUTP_ISOJerkLimit_mps3_minval@ */ Scalar_FLOAT32_IEEE 0 SWC_OUTP_type_CM_single_mps3 -65535.0 65535.0 /end CHARACTERISTIC
/begin CHARACTERISTIC KOUTP_ISOJerkLimit_mps3_ovrdval "" VALUE 0x0000 /* @ECU_Address@KOUTP_ISOJerkLimit_mps3_ovrdval@ */ Scalar_FLOAT32_IEEE 0 SWC_OUTP_type_CM_single_mps3 -65535.0 65535.0 /end CHARACTERISTIC
/begin CHARACTERISTIC KOUTP_JerkPCT_pct_maxval "" VALUE 0x0000 /* @ECU_Address@KOUTP_JerkPCT_pct_maxval@ */ Scalar_FLOAT32_IEEE 0 SWC_OUTP_type_CM_single_pct -65535.0 65535.0 /end CHARACTERISTIC
/begin CHARACTERISTIC KOUTP_JerkPCT_pct_minval "" VALUE 0x0000 /* @ECU_Address@KOUTP_JerkPCT_pct_minval@ */ Scalar_FLOAT32_IEEE 0 SWC_OUTP_type_CM_single_pct -65535.0 65535.0 /end CHARACTERISTIC
/begin CHARACTERISTIC KOUTP_JerkPCT_pct_ovrdval "" VALUE 0x0000 /* @ECU_Address@KOUTP_JerkPCT_pct_ovrdval@ */ Scalar_FLOAT32_IEEE 0 SWC_OUTP_type_CM_single_pct -65535.0 65535.0 /end CHARACTERISTIC
/begin CHARACTERISTIC KOUTP_LKAStrToqReq_Nm_maxval "" VALUE 0x0000 /* @ECU_Address@KOUTP_LKAStrToqReq_Nm_maxval@ */ Scalar_FLOAT32_IEEE 0 SWC_OUTP_type_CM_single_Nm -65535.0 65535.0 /end CHARACTERISTIC
/begin CHARACTERISTIC KOUTP_LKAStrToqReq_Nm_minval "" VALUE 0x0000 /* @ECU_Address@KOUTP_LKAStrToqReq_Nm_minval@ */ Scalar_FLOAT32_IEEE 0 SWC_OUTP_type_CM_single_Nm -65535.0 65535.0 /end CHARACTERISTIC
/begin CHARACTERISTIC KOUTP_LKAStrToqReq_Nm_ovrdval "" VALUE 0x0000 /* @ECU_Address@KOUTP_LKAStrToqReq_Nm_ovrdval@ */ Scalar_FLOAT32_IEEE 0 SWC_OUTP_type_CM_single_Nm -65535.0 65535.0 /end CHARACTERISTIC
/begin CHARACTERISTIC KOUTP_LimitPCT_pct_maxval "" VALUE 0x0000 /* @ECU_Address@KOUTP_LimitPCT_pct_maxval@ */ Scalar_FLOAT32_IEEE 0 SWC_OUTP_type_CM_single_pct -65535.0 65535.0 /end CHARACTERISTIC
/begin CHARACTERISTIC KOUTP_LimitPCT_pct_minval "" VALUE 0x0000 /* @ECU_Address@KOUTP_LimitPCT_pct_minval@ */ Scalar_FLOAT32_IEEE 0 SWC_OUTP_type_CM_single_pct -65535.0 65535.0 /end CHARACTERISTIC
/begin CHARACTERISTIC KOUTP_LimitPCT_pct_ovrdval "" VALUE 0x0000 /* @ECU_Address@KOUTP_LimitPCT_pct_ovrdval@ */ Scalar_FLOAT32_IEEE 0 SWC_OUTP_type_CM_single_pct -65535.0 65535.0 /end CHARACTERISTIC
/begin CHARACTERISTIC KOUTP_LongAcc_Gps_maxval "" VALUE 0x0000 /* @ECU_Address@KOUTP_LongAcc_Gps_maxval@ */ Scalar_FLOAT32_IEEE 0 SWC_OUTP_type_CM_single_Gps -65535.0 65535.0 /end CHARACTERISTIC
/begin CHARACTERISTIC KOUTP_LongAcc_Gps_minval "" VALUE 0x0000 /* @ECU_Address@KOUTP_LongAcc_Gps_minval@ */ Scalar_FLOAT32_IEEE 0 SWC_OUTP_type_CM_single_Gps -65535.0 65535.0 /end CHARACTERISTIC
/begin CHARACTERISTIC KOUTP_LongAcc_Gps_ovrdval "" VALUE 0x0000 /* @ECU_Address@KOUTP_LongAcc_Gps_ovrdval@ */ Scalar_FLOAT32_IEEE 0 SWC_OUTP_type_CM_single_Gps -65535.0 65535.0 /end CHARACTERISTIC
/begin CHARACTERISTIC KOUTP_MeterIndSpeed_raw32_maxval "" VALUE 0x0000 /* @ECU_Address@KOUTP_MeterIndSpeed_raw32_maxval@ */ Scalar_FLOAT32_IEEE 0 SWC_OUTP_type_CM_single_raw32 -65535.0 65535.0 /end CHARACTERISTIC
/begin CHARACTERISTIC KOUTP_MeterIndSpeed_raw32_minval "" VALUE 0x0000 /* @ECU_Address@KOUTP_MeterIndSpeed_raw32_minval@ */ Scalar_FLOAT32_IEEE 0 SWC_OUTP_type_CM_single_raw32 -65535.0 65535.0 /end CHARACTERISTIC
/begin CHARACTERISTIC KOUTP_MeterIndSpeed_raw32_ovrdval "" VALUE 0x0000 /* @ECU_Address@KOUTP_MeterIndSpeed_raw32_ovrdval@ */ Scalar_FLOAT32_IEEE 0 SWC_OUTP_type_CM_single_raw32 -65535.0 65535.0 /end CHARACTERISTIC
/begin CHARACTERISTIC KOUTP_TimeGapCalcu_s_maxval "" VALUE 0x0000 /* @ECU_Address@KOUTP_TimeGapCalcu_s_maxval@ */ Scalar_FLOAT32_IEEE 0 SWC_OUTP_type_CM_single_s -65535.0 65535.0 /end CHARACTERISTIC
/begin CHARACTERISTIC KOUTP_TimeGapCalcu_s_minval "" VALUE 0x0000 /* @ECU_Address@KOUTP_TimeGapCalcu_s_minval@ */ Scalar_FLOAT32_IEEE 0 SWC_OUTP_type_CM_single_s -65535.0 65535.0 /end CHARACTERISTIC
/begin CHARACTERISTIC KOUTP_TimeGapCalcu_s_ovrdval "" VALUE 0x0000 /* @ECU_Address@KOUTP_TimeGapCalcu_s_ovrdval@ */ Scalar_FLOAT32_IEEE 0 SWC_OUTP_type_CM_single_s -65535.0 65535.0 /end CHARACTERISTIC
/begin CHARACTERISTIC KOUTP_VehicleSpeed_kph_maxval "" VALUE 0x0000 /* @ECU_Address@KOUTP_VehicleSpeed_kph_maxval@ */ Scalar_FLOAT32_IEEE 0 SWC_OUTP_type_CM_single_kph -65535.0 65535.0 /end CHARACTERISTIC
/begin CHARACTERISTIC KOUTP_VehicleSpeed_kph_minval "" VALUE 0x0000 /* @ECU_Address@KOUTP_VehicleSpeed_kph_minval@ */ Scalar_FLOAT32_IEEE 0 SWC_OUTP_type_CM_single_kph -65535.0 65535.0 /end CHARACTERISTIC
/begin CHARACTERISTIC KOUTP_VehicleSpeed_kph_ovrdval "" VALUE 0x0000 /* @ECU_Address@KOUTP_VehicleSpeed_kph_ovrdval@ */ Scalar_FLOAT32_IEEE 0 SWC_OUTP_type_CM_single_kph -65535.0 65535.0 /end CHARACTERISTIC
/begin CHARACTERISTIC KOUTP_VehicleSpeed_mph_maxval "" VALUE 0x0000 /* @ECU_Address@KOUTP_VehicleSpeed_mph_maxval@ */ Scalar_FLOAT32_IEEE 0 SWC_OUTP_type_CM_single_mph -65535.0 65535.0 /end CHARACTERISTIC
/begin CHARACTERISTIC KOUTP_VehicleSpeed_mph_minval "" VALUE 0x0000 /* @ECU_Address@KOUTP_VehicleSpeed_mph_minval@ */ Scalar_FLOAT32_IEEE 0 SWC_OUTP_type_CM_single_mph -65535.0 65535.0 /end CHARACTERISTIC
/begin CHARACTERISTIC KOUTP_VehicleSpeed_mph_ovrdval "" VALUE 0x0000 /* @ECU_Address@KOUTP_VehicleSpeed_mph_ovrdval@ */ Scalar_FLOAT32_IEEE 0 SWC_OUTP_type_CM_single_mph -65535.0 65535.0 /end CHARACTERISTIC
/begin CHARACTERISTIC KOUTP_ACCComfortBandLower_mps2_ovrdflg "" VALUE 0x0000 /* @ECU_Address@KOUTP_ACCComfortBandLower_mps2_ovrdflg@ */ Scalar_BOOLEAN 0 SWC_OUTP_type_CM_boolean_flg 0.0 1.0 /end CHARACTERISTIC
/begin CHARACTERISTIC KOUTP_ACCComfortBandUpper_mps2_ovrdflg "" VALUE 0x0000 /* @ECU_Address@KOUTP_ACCComfortBandUpper_mps2_ovrdflg@ */ Scalar_BOOLEAN 0 SWC_OUTP_type_CM_boolean_flg 0.0 1.0 /end CHARACTERISTIC
/begin CHARACTERISTIC KOUTP_ACCCtrlAvail_flg_maxval "" VALUE 0x0000 /* @ECU_Address@KOUTP_ACCCtrlAvail_flg_maxval@ */ Scalar_BOOLEAN 0 SWC_OUTP_type_CM_boolean_flg 0.0 1.0 /end CHARACTERISTIC
/begin CHARACTERISTIC KOUTP_ACCCtrlAvail_flg_minval "" VALUE 0x0000 /* @ECU_Address@KOUTP_ACCCtrlAvail_flg_minval@ */ Scalar_BOOLEAN 0 SWC_OUTP_type_CM_boolean_flg 0.0 1.0 /end CHARACTERISTIC
/begin CHARACTERISTIC KOUTP_ACCCtrlAvail_flg_ovrdflg "" VALUE 0x0000 /* @ECU_Address@KOUTP_ACCCtrlAvail_flg_ovrdflg@ */ Scalar_BOOLEAN 0 SWC_OUTP_type_CM_boolean_flg 0.0 1.0 /end CHARACTERISTIC
/begin CHARACTERISTIC KOUTP_ACCCtrlAvail_flg_ovrdval "" VALUE 0x0000 /* @ECU_Address@KOUTP_ACCCtrlAvail_flg_ovrdval@ */ Scalar_BOOLEAN 0 SWC_OUTP_type_CM_boolean_flg 0.0 1.0 /end CHARACTERISTIC
/begin CHARACTERISTIC KOUTP_ACCJerkLowerLimit_mps3_ovrdflg "" VALUE 0x0000 /* @ECU_Address@KOUTP_ACCJerkLowerLimit_mps3_ovrdflg@ */ Scalar_BOOLEAN 0 SWC_OUTP_type_CM_boolean_flg 0.0 1.0 /end CHARACTERISTIC
/begin CHARACTERISTIC KOUTP_ACCJerkUpperLimit_mps3_ovrdflg "" VALUE 0x0000 /* @ECU_Address@KOUTP_ACCJerkUpperLimit_mps3_ovrdflg@ */ Scalar_BOOLEAN 0 SWC_OUTP_type_CM_boolean_flg 0.0 1.0 /end CHARACTERISTIC
/begin CHARACTERISTIC KOUTP_ACCObjDist_m_ovrdflg "" VALUE 0x0000 /* @ECU_Address@KOUTP_ACCObjDist_m_ovrdflg@ */ Scalar_BOOLEAN 0 SWC_OUTP_type_CM_boolean_flg 0.0 1.0 /end CHARACTERISTIC
/begin CHARACTERISTIC KOUTP_ACCObjDstLvl_enum_ovrdflg "" VALUE 0x0000 /* @ECU_Address@KOUTP_ACCObjDstLvl_enum_ovrdflg@ */ Scalar_BOOLEAN 0 SWC_OUTP_type_CM_boolean_flg 0.0 1.0 /end CHARACTERISTIC
/begin CHARACTERISTIC KOUTP_ACCObjRelSpd_mps_ovrdflg "" VALUE 0x0000 /* @ECU_Address@KOUTP_ACCObjRelSpd_mps_ovrdflg@ */ Scalar_BOOLEAN 0 SWC_OUTP_type_CM_boolean_flg 0.0 1.0 /end CHARACTERISTIC
/begin CHARACTERISTIC KOUTP_ACCPedalOvrd_flg_maxval "" VALUE 0x0000 /* @ECU_Address@KOUTP_ACCPedalOvrd_flg_maxval@ */ Scalar_BOOLEAN 0 SWC_OUTP_type_CM_boolean_flg 0.0 1.0 /end CHARACTERISTIC
/begin CHARACTERISTIC KOUTP_ACCPedalOvrd_flg_minval "" VALUE 0x0000 /* @ECU_Address@KOUTP_ACCPedalOvrd_flg_minval@ */ Scalar_BOOLEAN 0 SWC_OUTP_type_CM_boolean_flg 0.0 1.0 /end CHARACTERISTIC
/begin CHARACTERISTIC KOUTP_ACCPedalOvrd_flg_ovrdflg "" VALUE 0x0000 /* @ECU_Address@KOUTP_ACCPedalOvrd_flg_ovrdflg@ */ Scalar_BOOLEAN 0 SWC_OUTP_type_CM_boolean_flg 0.0 1.0 /end CHARACTERISTIC
/begin CHARACTERISTIC KOUTP_ACCPedalOvrd_flg_ovrdval "" VALUE 0x0000 /* @ECU_Address@KOUTP_ACCPedalOvrd_flg_ovrdval@ */ Scalar_BOOLEAN 0 SWC_OUTP_type_CM_boolean_flg 0.0 1.0 /end CHARACTERISTIC
/begin CHARACTERISTIC KOUTP_ACCRequiredAccel_mps2_ovrdflg "" VALUE 0x0000 /* @ECU_Address@KOUTP_ACCRequiredAccel_mps2_ovrdflg@ */ Scalar_BOOLEAN 0 SWC_OUTP_type_CM_boolean_flg 0.0 1.0 /end CHARACTERISTIC
/begin CHARACTERISTIC KOUTP_ACCTakeoverReq_flg_maxval "" VALUE 0x0000 /* @ECU_Address@KOUTP_ACCTakeoverReq_flg_maxval@ */ Scalar_BOOLEAN 0 SWC_OUTP_type_CM_boolean_flg 0.0 1.0 /end CHARACTERISTIC
/begin CHARACTERISTIC KOUTP_ACCTakeoverReq_flg_minval "" VALUE 0x0000 /* @ECU_Address@KOUTP_ACCTakeoverReq_flg_minval@ */ Scalar_BOOLEAN 0 SWC_OUTP_type_CM_boolean_flg 0.0 1.0 /end CHARACTERISTIC
/begin CHARACTERISTIC KOUTP_ACCTakeoverReq_flg_ovrdflg "" VALUE 0x0000 /* @ECU_Address@KOUTP_ACCTakeoverReq_flg_ovrdflg@ */ Scalar_BOOLEAN 0 SWC_OUTP_type_CM_boolean_flg 0.0 1.0 /end CHARACTERISTIC
/begin CHARACTERISTIC KOUTP_ACCTakeoverReq_flg_ovrdval "" VALUE 0x0000 /* @ECU_Address@KOUTP_ACCTakeoverReq_flg_ovrdval@ */ Scalar_BOOLEAN 0 SWC_OUTP_type_CM_boolean_flg 0.0 1.0 /end CHARACTERISTIC
/begin CHARACTERISTIC KOUTP_ACCVehHoldReq_flg_maxval "" VALUE 0x0000 /* @ECU_Address@KOUTP_ACCVehHoldReq_flg_maxval@ */ Scalar_BOOLEAN 0 SWC_OUTP_type_CM_boolean_flg 0.0 1.0 /end CHARACTERISTIC
/begin CHARACTERISTIC KOUTP_ACCVehHoldReq_flg_minval "" VALUE 0x0000 /* @ECU_Address@KOUTP_ACCVehHoldReq_flg_minval@ */ Scalar_BOOLEAN 0 SWC_OUTP_type_CM_boolean_flg 0.0 1.0 /end CHARACTERISTIC
/begin CHARACTERISTIC KOUTP_ACCVehHoldReq_flg_ovrdflg "" VALUE 0x0000 /* @ECU_Address@KOUTP_ACCVehHoldReq_flg_ovrdflg@ */ Scalar_BOOLEAN 0 SWC_OUTP_type_CM_boolean_flg 0.0 1.0 /end CHARACTERISTIC
/begin CHARACTERISTIC KOUTP_ACCVehHoldReq_flg_ovrdval "" VALUE 0x0000 /* @ECU_Address@KOUTP_ACCVehHoldReq_flg_ovrdval@ */ Scalar_BOOLEAN 0 SWC_OUTP_type_CM_boolean_flg 0.0 1.0 /end CHARACTERISTIC
/begin CHARACTERISTIC KOUTP_ADASACCSta_enum_ovrdflg "" VALUE 0x0000 /* @ECU_Address@KOUTP_ADASACCSta_enum_ovrdflg@ */ Scalar_BOOLEAN 0 SWC_OUTP_type_CM_boolean_flg 0.0 1.0 /end CHARACTERISTIC
/begin CHARACTERISTIC KOUTP_ADASAEBReq_enum_ovrdflg "" VALUE 0x0000 /* @ECU_Address@KOUTP_ADASAEBReq_enum_ovrdflg@ */ Scalar_BOOLEAN 0 SWC_OUTP_type_CM_boolean_flg 0.0 1.0 /end CHARACTERISTIC
/begin CHARACTERISTIC KOUTP_ADASAEBSta_enum_ovrdflg "" VALUE 0x0000 /* @ECU_Address@KOUTP_ADASAEBSta_enum_ovrdflg@ */ Scalar_BOOLEAN 0 SWC_OUTP_type_CM_boolean_flg 0.0 1.0 /end CHARACTERISTIC
/begin CHARACTERISTIC KOUTP_ADASCAMSpdLim_enum_ovrdflg "" VALUE 0x0000 /* @ECU_Address@KOUTP_ADASCAMSpdLim_enum_ovrdflg@ */ Scalar_BOOLEAN 0 SWC_OUTP_type_CM_boolean_flg 0.0 1.0 /end CHARACTERISTIC
/begin CHARACTERISTIC KOUTP_ADASDBSReq_enum_ovrdflg "" VALUE 0x0000 /* @ECU_Address@KOUTP_ADASDBSReq_enum_ovrdflg@ */ Scalar_BOOLEAN 0 SWC_OUTP_type_CM_boolean_flg 0.0 1.0 /end CHARACTERISTIC
/begin CHARACTERISTIC KOUTP_ADASFCWMute_flg_maxval "" VALUE 0x0000 /* @ECU_Address@KOUTP_ADASFCWMute_flg_maxval@ */ Scalar_BOOLEAN 0 SWC_OUTP_type_CM_boolean_flg 0.0 1.0 /end CHARACTERISTIC
/begin CHARACTERISTIC KOUTP_ADASFCWMute_flg_minval "" VALUE 0x0000 /* @ECU_Address@KOUTP_ADASFCWMute_flg_minval@ */ Scalar_BOOLEAN 0 SWC_OUTP_type_CM_boolean_flg 0.0 1.0 /end CHARACTERISTIC
/begin CHARACTERISTIC KOUTP_ADASFCWMute_flg_ovrdflg "" VALUE 0x0000 /* @ECU_Address@KOUTP_ADASFCWMute_flg_ovrdflg@ */ Scalar_BOOLEAN 0 SWC_OUTP_type_CM_boolean_flg 0.0 1.0 /end CHARACTERISTIC
/begin CHARACTERISTIC KOUTP_ADASFCWMute_flg_ovrdval "" VALUE 0x0000 /* @ECU_Address@KOUTP_ADASFCWMute_flg_ovrdval@ */ Scalar_BOOLEAN 0 SWC_OUTP_type_CM_boolean_flg 0.0 1.0 /end CHARACTERISTIC
/begin CHARACTERISTIC KOUTP_ADASFCWSta_enum_ovrdflg "" VALUE 0x0000 /* @ECU_Address@KOUTP_ADASFCWSta_enum_ovrdflg@ */ Scalar_BOOLEAN 0 SWC_OUTP_type_CM_boolean_flg 0.0 1.0 /end CHARACTERISTIC
/begin CHARACTERISTIC KOUTP_ADASFaultSta_flg_maxval "" VALUE 0x0000 /* @ECU_Address@KOUTP_ADASFaultSta_flg_maxval@ */ Scalar_BOOLEAN 0 SWC_OUTP_type_CM_boolean_flg 0.0 1.0 /end CHARACTERISTIC
/begin CHARACTERISTIC KOUTP_ADASFaultSta_flg_minval "" VALUE 0x0000 /* @ECU_Address@KOUTP_ADASFaultSta_flg_minval@ */ Scalar_BOOLEAN 0 SWC_OUTP_type_CM_boolean_flg 0.0 1.0 /end CHARACTERISTIC
/begin CHARACTERISTIC KOUTP_ADASFaultSta_flg_ovrdflg "" VALUE 0x0000 /* @ECU_Address@KOUTP_ADASFaultSta_flg_ovrdflg@ */ Scalar_BOOLEAN 0 SWC_OUTP_type_CM_boolean_flg 0.0 1.0 /end CHARACTERISTIC
/begin CHARACTERISTIC KOUTP_ADASFaultSta_flg_ovrdval "" VALUE 0x0000 /* @ECU_Address@KOUTP_ADASFaultSta_flg_ovrdval@ */ Scalar_BOOLEAN 0 SWC_OUTP_type_CM_boolean_flg 0.0 1.0 /end CHARACTERISTIC
/begin CHARACTERISTIC KOUTP_ADASFltWrnReq_flg_maxval "" VALUE 0x0000 /* @ECU_Address@KOUTP_ADASFltWrnReq_flg_maxval@ */ Scalar_BOOLEAN 0 SWC_OUTP_type_CM_boolean_flg 0.0 1.0 /end CHARACTERISTIC
/begin CHARACTERISTIC KOUTP_ADASFltWrnReq_flg_minval "" VALUE 0x0000 /* @ECU_Address@KOUTP_ADASFltWrnReq_flg_minval@ */ Scalar_BOOLEAN 0 SWC_OUTP_type_CM_boolean_flg 0.0 1.0 /end CHARACTERISTIC
/begin CHARACTERISTIC KOUTP_ADASFltWrnReq_flg_ovrdflg "" VALUE 0x0000 /* @ECU_Address@KOUTP_ADASFltWrnReq_flg_ovrdflg@ */ Scalar_BOOLEAN 0 SWC_OUTP_type_CM_boolean_flg 0.0 1.0 /end CHARACTERISTIC
/begin CHARACTERISTIC KOUTP_ADASFltWrnReq_flg_ovrdval "" VALUE 0x0000 /* @ECU_Address@KOUTP_ADASFltWrnReq_flg_ovrdval@ */ Scalar_BOOLEAN 0 SWC_OUTP_type_CM_boolean_flg 0.0 1.0 /end CHARACTERISTIC
/begin CHARACTERISTIC KOUTP_ADASForceIdle_flg_maxval "" VALUE 0x0000 /* @ECU_Address@KOUTP_ADASForceIdle_flg_maxval@ */ Scalar_BOOLEAN 0 SWC_OUTP_type_CM_boolean_flg 0.0 1.0 /end CHARACTERISTIC
/begin CHARACTERISTIC KOUTP_ADASForceIdle_flg_minval "" VALUE 0x0000 /* @ECU_Address@KOUTP_ADASForceIdle_flg_minval@ */ Scalar_BOOLEAN 0 SWC_OUTP_type_CM_boolean_flg 0.0 1.0 /end CHARACTERISTIC
/begin CHARACTERISTIC KOUTP_ADASForceIdle_flg_ovrdflg "" VALUE 0x0000 /* @ECU_Address@KOUTP_ADASForceIdle_flg_ovrdflg@ */ Scalar_BOOLEAN 0 SWC_OUTP_type_CM_boolean_flg 0.0 1.0 /end CHARACTERISTIC
/begin CHARACTERISTIC KOUTP_ADASForceIdle_flg_ovrdval "" VALUE 0x0000 /* @ECU_Address@KOUTP_ADASForceIdle_flg_ovrdval@ */ Scalar_BOOLEAN 0 SWC_OUTP_type_CM_boolean_flg 0.0 1.0 /end CHARACTERISTIC
/begin CHARACTERISTIC KOUTP_ADASISASta_enum_ovrdflg "" VALUE 0x0000 /* @ECU_Address@KOUTP_ADASISASta_enum_ovrdflg@ */ Scalar_BOOLEAN 0 SWC_OUTP_type_CM_boolean_flg 0.0 1.0 /end CHARACTERISTIC
/begin CHARACTERISTIC KOUTP_ADASLDWMute_flg_maxval "" VALUE 0x0000 /* @ECU_Address@KOUTP_ADASLDWMute_flg_maxval@ */ Scalar_BOOLEAN 0 SWC_OUTP_type_CM_boolean_flg 0.0 1.0 /end CHARACTERISTIC
/begin CHARACTERISTIC KOUTP_ADASLDWMute_flg_minval "" VALUE 0x0000 /* @ECU_Address@KOUTP_ADASLDWMute_flg_minval@ */ Scalar_BOOLEAN 0 SWC_OUTP_type_CM_boolean_flg 0.0 1.0 /end CHARACTERISTIC
/begin CHARACTERISTIC KOUTP_ADASLDWMute_flg_ovrdflg "" VALUE 0x0000 /* @ECU_Address@KOUTP_ADASLDWMute_flg_ovrdflg@ */ Scalar_BOOLEAN 0 SWC_OUTP_type_CM_boolean_flg 0.0 1.0 /end CHARACTERISTIC
/begin CHARACTERISTIC KOUTP_ADASLDWMute_flg_ovrdval "" VALUE 0x0000 /* @ECU_Address@KOUTP_ADASLDWMute_flg_ovrdval@ */ Scalar_BOOLEAN 0 SWC_OUTP_type_CM_boolean_flg 0.0 1.0 /end CHARACTERISTIC
/begin CHARACTERISTIC KOUTP_ADASLDWSta_enum_ovrdflg "" VALUE 0x0000 /* @ECU_Address@KOUTP_ADASLDWSta_enum_ovrdflg@ */ Scalar_BOOLEAN 0 SWC_OUTP_type_CM_boolean_flg 0.0 1.0 /end CHARACTERISTIC
/begin CHARACTERISTIC KOUTP_ADASLFCHandsOffWarning_enum_ovrdflg "" VALUE 0x0000 /* @ECU_Address@KOUTP_ADASLFCHandsOffWarning_enum_ovrdflg@ */ Scalar_BOOLEAN 0 SWC_OUTP_type_CM_boolean_flg 0.0 1.0 /end CHARACTERISTIC
/begin CHARACTERISTIC KOUTP_ADASLFCSta_enum_ovrdflg "" VALUE 0x0000 /* @ECU_Address@KOUTP_ADASLFCSta_enum_ovrdflg@ */ Scalar_BOOLEAN 0 SWC_OUTP_type_CM_boolean_flg 0.0 1.0 /end CHARACTERISTIC
/begin CHARACTERISTIC KOUTP_ADASLFCWarnSound_enum_ovrdflg "" VALUE 0x0000 /* @ECU_Address@KOUTP_ADASLFCWarnSound_enum_ovrdflg@ */ Scalar_BOOLEAN 0 SWC_OUTP_type_CM_boolean_flg 0.0 1.0 /end CHARACTERISTIC
/begin CHARACTERISTIC KOUTP_ADASLKASta_enum_ovrdflg "" VALUE 0x0000 /* @ECU_Address@KOUTP_ADASLKASta_enum_ovrdflg@ */ Scalar_BOOLEAN 0 SWC_OUTP_type_CM_boolean_flg 0.0 1.0 /end CHARACTERISTIC
/begin CHARACTERISTIC KOUTP_ADASLaneModeL_enum_ovrdflg "" VALUE 0x0000 /* @ECU_Address@KOUTP_ADASLaneModeL_enum_ovrdflg@ */ Scalar_BOOLEAN 0 SWC_OUTP_type_CM_boolean_flg 0.0 1.0 /end CHARACTERISTIC
/begin CHARACTERISTIC KOUTP_ADASLaneModeR_enum_ovrdflg "" VALUE 0x0000 /* @ECU_Address@KOUTP_ADASLaneModeR_enum_ovrdflg@ */ Scalar_BOOLEAN 0 SWC_OUTP_type_CM_boolean_flg 0.0 1.0 /end CHARACTERISTIC
/begin CHARACTERISTIC KOUTP_ADASLanecurveL_raw32_ovrdflg "" VALUE 0x0000 /* @ECU_Address@KOUTP_ADASLanecurveL_raw32_ovrdflg@ */ Scalar_BOOLEAN 0 SWC_OUTP_type_CM_boolean_flg 0.0 1.0 /end CHARACTERISTIC
/begin CHARACTERISTIC KOUTP_ADASLanecurveR_raw32_ovrdflg "" VALUE 0x0000 /* @ECU_Address@KOUTP_ADASLanecurveR_raw32_ovrdflg@ */ Scalar_BOOLEAN 0 SWC_OUTP_type_CM_boolean_flg 0.0 1.0 /end CHARACTERISTIC
/begin CHARACTERISTIC KOUTP_ADASLanetypeL_enum_ovrdflg "" VALUE 0x0000 /* @ECU_Address@KOUTP_ADASLanetypeL_enum_ovrdflg@ */ Scalar_BOOLEAN 0 SWC_OUTP_type_CM_boolean_flg 0.0 1.0 /end CHARACTERISTIC
/begin CHARACTERISTIC KOUTP_ADASLanetypeR_enum_ovrdflg "" VALUE 0x0000 /* @ECU_Address@KOUTP_ADASLanetypeR_enum_ovrdflg@ */ Scalar_BOOLEAN 0 SWC_OUTP_type_CM_boolean_flg 0.0 1.0 /end CHARACTERISTIC
/begin CHARACTERISTIC KOUTP_ADASSLIFSpdLim_enum_ovrdflg "" VALUE 0x0000 /* @ECU_Address@KOUTP_ADASSLIFSpdLim_enum_ovrdflg@ */ Scalar_BOOLEAN 0 SWC_OUTP_type_CM_boolean_flg 0.0 1.0 /end CHARACTERISTIC
/begin CHARACTERISTIC KOUTP_ADASSLIFSta_enum_ovrdflg "" VALUE 0x0000 /* @ECU_Address@KOUTP_ADASSLIFSta_enum_ovrdflg@ */ Scalar_BOOLEAN 0 SWC_OUTP_type_CM_boolean_flg 0.0 1.0 /end CHARACTERISTIC
/begin CHARACTERISTIC KOUTP_ADASShftPosnReqA_flg_maxval "" VALUE 0x0000 /* @ECU_Address@KOUTP_ADASShftPosnReqA_flg_maxval@ */ Scalar_BOOLEAN 0 SWC_OUTP_type_CM_boolean_flg 0.0 1.0 /end CHARACTERISTIC
/begin CHARACTERISTIC KOUTP_ADASShftPosnReqA_flg_minval "" VALUE 0x0000 /* @ECU_Address@KOUTP_ADASShftPosnReqA_flg_minval@ */ Scalar_BOOLEAN 0 SWC_OUTP_type_CM_boolean_flg 0.0 1.0 /end CHARACTERISTIC
/begin CHARACTERISTIC KOUTP_ADASShftPosnReqA_flg_ovrdflg "" VALUE 0x0000 /* @ECU_Address@KOUTP_ADASShftPosnReqA_flg_ovrdflg@ */ Scalar_BOOLEAN 0 SWC_OUTP_type_CM_boolean_flg 0.0 1.0 /end CHARACTERISTIC
/begin CHARACTERISTIC KOUTP_ADASShftPosnReqA_flg_ovrdval "" VALUE 0x0000 /* @ECU_Address@KOUTP_ADASShftPosnReqA_flg_ovrdval@ */ Scalar_BOOLEAN 0 SWC_OUTP_type_CM_boolean_flg 0.0 1.0 /end CHARACTERISTIC
/begin CHARACTERISTIC KOUTP_ADASShftPosnReq_enum_ovrdflg "" VALUE 0x0000 /* @ECU_Address@KOUTP_ADASShftPosnReq_enum_ovrdflg@ */ Scalar_BOOLEAN 0 SWC_OUTP_type_CM_boolean_flg 0.0 1.0 /end CHARACTERISTIC
/begin CHARACTERISTIC KOUTP_ADASVehSpdLim_raw32_ovrdflg "" VALUE 0x0000 /* @ECU_Address@KOUTP_ADASVehSpdLim_raw32_ovrdflg@ */ Scalar_BOOLEAN 0 SWC_OUTP_type_CM_boolean_flg 0.0 1.0 /end CHARACTERISTIC
/begin CHARACTERISTIC KOUTP_ADASWarningMsg_enum_ovrdflg "" VALUE 0x0000 /* @ECU_Address@KOUTP_ADASWarningMsg_enum_ovrdflg@ */ Scalar_BOOLEAN 0 SWC_OUTP_type_CM_boolean_flg 0.0 1.0 /end CHARACTERISTIC
/begin CHARACTERISTIC KOUTP_AEBVehHoldReq_flg_maxval "" VALUE 0x0000 /* @ECU_Address@KOUTP_AEBVehHoldReq_flg_maxval@ */ Scalar_BOOLEAN 0 SWC_OUTP_type_CM_boolean_flg 0.0 1.0 /end CHARACTERISTIC
/begin CHARACTERISTIC KOUTP_AEBVehHoldReq_flg_minval "" VALUE 0x0000 /* @ECU_Address@KOUTP_AEBVehHoldReq_flg_minval@ */ Scalar_BOOLEAN 0 SWC_OUTP_type_CM_boolean_flg 0.0 1.0 /end CHARACTERISTIC
/begin CHARACTERISTIC KOUTP_AEBVehHoldReq_flg_ovrdflg "" VALUE 0x0000 /* @ECU_Address@KOUTP_AEBVehHoldReq_flg_ovrdflg@ */ Scalar_BOOLEAN 0 SWC_OUTP_type_CM_boolean_flg 0.0 1.0 /end CHARACTERISTIC
/begin CHARACTERISTIC KOUTP_AEBVehHoldReq_flg_ovrdval "" VALUE 0x0000 /* @ECU_Address@KOUTP_AEBVehHoldReq_flg_ovrdval@ */ Scalar_BOOLEAN 0 SWC_OUTP_type_CM_boolean_flg 0.0 1.0 /end CHARACTERISTIC
/begin CHARACTERISTIC KOUTP_APSActive_flg_maxval "" VALUE 0x0000 /* @ECU_Address@KOUTP_APSActive_flg_maxval@ */ Scalar_BOOLEAN 0 SWC_OUTP_type_CM_boolean_flg 0.0 1.0 /end CHARACTERISTIC
/begin CHARACTERISTIC KOUTP_APSActive_flg_minval "" VALUE 0x0000 /* @ECU_Address@KOUTP_APSActive_flg_minval@ */ Scalar_BOOLEAN 0 SWC_OUTP_type_CM_boolean_flg 0.0 1.0 /end CHARACTERISTIC
/begin CHARACTERISTIC KOUTP_APSActive_flg_ovrdflg "" VALUE 0x0000 /* @ECU_Address@KOUTP_APSActive_flg_ovrdflg@ */ Scalar_BOOLEAN 0 SWC_OUTP_type_CM_boolean_flg 0.0 1.0 /end CHARACTERISTIC
/begin CHARACTERISTIC KOUTP_APSActive_flg_ovrdval "" VALUE 0x0000 /* @ECU_Address@KOUTP_APSActive_flg_ovrdval@ */ Scalar_BOOLEAN 0 SWC_OUTP_type_CM_boolean_flg 0.0 1.0 /end CHARACTERISTIC
/begin CHARACTERISTIC KOUTP_APSCtrlAvail_flg_maxval "" VALUE 0x0000 /* @ECU_Address@KOUTP_APSCtrlAvail_flg_maxval@ */ Scalar_BOOLEAN 0 SWC_OUTP_type_CM_boolean_flg 0.0 1.0 /end CHARACTERISTIC
/begin CHARACTERISTIC KOUTP_APSCtrlAvail_flg_minval "" VALUE 0x0000 /* @ECU_Address@KOUTP_APSCtrlAvail_flg_minval@ */ Scalar_BOOLEAN 0 SWC_OUTP_type_CM_boolean_flg 0.0 1.0 /end CHARACTERISTIC
/begin CHARACTERISTIC KOUTP_APSCtrlAvail_flg_ovrdflg "" VALUE 0x0000 /* @ECU_Address@KOUTP_APSCtrlAvail_flg_ovrdflg@ */ Scalar_BOOLEAN 0 SWC_OUTP_type_CM_boolean_flg 0.0 1.0 /end CHARACTERISTIC
/begin CHARACTERISTIC KOUTP_APSCtrlAvail_flg_ovrdval "" VALUE 0x0000 /* @ECU_Address@KOUTP_APSCtrlAvail_flg_ovrdval@ */ Scalar_BOOLEAN 0 SWC_OUTP_type_CM_boolean_flg 0.0 1.0 /end CHARACTERISTIC
/begin CHARACTERISTIC KOUTP_APSDecReqA_flg_maxval "" VALUE 0x0000 /* @ECU_Address@KOUTP_APSDecReqA_flg_maxval@ */ Scalar_BOOLEAN 0 SWC_OUTP_type_CM_boolean_flg 0.0 1.0 /end CHARACTERISTIC
/begin CHARACTERISTIC KOUTP_APSDecReqA_flg_minval "" VALUE 0x0000 /* @ECU_Address@KOUTP_APSDecReqA_flg_minval@ */ Scalar_BOOLEAN 0 SWC_OUTP_type_CM_boolean_flg 0.0 1.0 /end CHARACTERISTIC
/begin CHARACTERISTIC KOUTP_APSDecReqA_flg_ovrdflg "" VALUE 0x0000 /* @ECU_Address@KOUTP_APSDecReqA_flg_ovrdflg@ */ Scalar_BOOLEAN 0 SWC_OUTP_type_CM_boolean_flg 0.0 1.0 /end CHARACTERISTIC
/begin CHARACTERISTIC KOUTP_APSDecReqA_flg_ovrdval "" VALUE 0x0000 /* @ECU_Address@KOUTP_APSDecReqA_flg_ovrdval@ */ Scalar_BOOLEAN 0 SWC_OUTP_type_CM_boolean_flg 0.0 1.0 /end CHARACTERISTIC
/begin CHARACTERISTIC KOUTP_APSDecReq_mps2_ovrdflg "" VALUE 0x0000 /* @ECU_Address@KOUTP_APSDecReq_mps2_ovrdflg@ */ Scalar_BOOLEAN 0 SWC_OUTP_type_CM_boolean_flg 0.0 1.0 /end CHARACTERISTIC
/begin CHARACTERISTIC KOUTP_APSReq_enum_ovrdflg "" VALUE 0x0000 /* @ECU_Address@KOUTP_APSReq_enum_ovrdflg@ */ Scalar_BOOLEAN 0 SWC_OUTP_type_CM_boolean_flg 0.0 1.0 /end CHARACTERISTIC
/begin CHARACTERISTIC KOUTP_APSStaSys_enum_ovrdflg "" VALUE 0x0000 /* @ECU_Address@KOUTP_APSStaSys_enum_ovrdflg@ */ Scalar_BOOLEAN 0 SWC_OUTP_type_CM_boolean_flg 0.0 1.0 /end CHARACTERISTIC
/begin CHARACTERISTIC KOUTP_AccCalcuPID_mps2_ovrdflg "" VALUE 0x0000 /* @ECU_Address@KOUTP_AccCalcuPID_mps2_ovrdflg@ */ Scalar_BOOLEAN 0 SWC_OUTP_type_CM_boolean_flg 0.0 1.0 /end CHARACTERISTIC
/begin CHARACTERISTIC KOUTP_ActACCRequiredAccel_mps2_ovrdflg "" VALUE 0x0000 /* @ECU_Address@KOUTP_ActACCRequiredAccel_mps2_ovrdflg@ */ Scalar_BOOLEAN 0 SWC_OUTP_type_CM_boolean_flg 0.0 1.0 /end CHARACTERISTIC
/begin CHARACTERISTIC KOUTP_CAASActive_flg_maxval "" VALUE 0x0000 /* @ECU_Address@KOUTP_CAASActive_flg_maxval@ */ Scalar_BOOLEAN 0 SWC_OUTP_type_CM_boolean_flg 0.0 1.0 /end CHARACTERISTIC
/begin CHARACTERISTIC KOUTP_CAASActive_flg_minval "" VALUE 0x0000 /* @ECU_Address@KOUTP_CAASActive_flg_minval@ */ Scalar_BOOLEAN 0 SWC_OUTP_type_CM_boolean_flg 0.0 1.0 /end CHARACTERISTIC
/begin CHARACTERISTIC KOUTP_CAASActive_flg_ovrdflg "" VALUE 0x0000 /* @ECU_Address@KOUTP_CAASActive_flg_ovrdflg@ */ Scalar_BOOLEAN 0 SWC_OUTP_type_CM_boolean_flg 0.0 1.0 /end CHARACTERISTIC
/begin CHARACTERISTIC KOUTP_CAASActive_flg_ovrdval "" VALUE 0x0000 /* @ECU_Address@KOUTP_CAASActive_flg_ovrdval@ */ Scalar_BOOLEAN 0 SWC_OUTP_type_CM_boolean_flg 0.0 1.0 /end CHARACTERISTIC
/begin CHARACTERISTIC KOUTP_CAASCtrlAvail_flg_maxval "" VALUE 0x0000 /* @ECU_Address@KOUTP_CAASCtrlAvail_flg_maxval@ */ Scalar_BOOLEAN 0 SWC_OUTP_type_CM_boolean_flg 0.0 1.0 /end CHARACTERISTIC
/begin CHARACTERISTIC KOUTP_CAASCtrlAvail_flg_minval "" VALUE 0x0000 /* @ECU_Address@KOUTP_CAASCtrlAvail_flg_minval@ */ Scalar_BOOLEAN 0 SWC_OUTP_type_CM_boolean_flg 0.0 1.0 /end CHARACTERISTIC
/begin CHARACTERISTIC KOUTP_CAASCtrlAvail_flg_ovrdflg "" VALUE 0x0000 /* @ECU_Address@KOUTP_CAASCtrlAvail_flg_ovrdflg@ */ Scalar_BOOLEAN 0 SWC_OUTP_type_CM_boolean_flg 0.0 1.0 /end CHARACTERISTIC
/begin CHARACTERISTIC KOUTP_CAASCtrlAvail_flg_ovrdval "" VALUE 0x0000 /* @ECU_Address@KOUTP_CAASCtrlAvail_flg_ovrdval@ */ Scalar_BOOLEAN 0 SWC_OUTP_type_CM_boolean_flg 0.0 1.0 /end CHARACTERISTIC
/begin CHARACTERISTIC KOUTP_CCCtrlSta_enum_ovrdflg "" VALUE 0x0000 /* @ECU_Address@KOUTP_CCCtrlSta_enum_ovrdflg@ */ Scalar_BOOLEAN 0 SWC_OUTP_type_CM_boolean_flg 0.0 1.0 /end CHARACTERISTIC
/begin CHARACTERISTIC KOUTP_CCMSASpdWar_flg_maxval "" VALUE 0x0000 /* @ECU_Address@KOUTP_CCMSASpdWar_flg_maxval@ */ Scalar_BOOLEAN 0 SWC_OUTP_type_CM_boolean_flg 0.0 1.0 /end CHARACTERISTIC
/begin CHARACTERISTIC KOUTP_CCMSASpdWar_flg_minval "" VALUE 0x0000 /* @ECU_Address@KOUTP_CCMSASpdWar_flg_minval@ */ Scalar_BOOLEAN 0 SWC_OUTP_type_CM_boolean_flg 0.0 1.0 /end CHARACTERISTIC
/begin CHARACTERISTIC KOUTP_CCMSASpdWar_flg_ovrdflg "" VALUE 0x0000 /* @ECU_Address@KOUTP_CCMSASpdWar_flg_ovrdflg@ */ Scalar_BOOLEAN 0 SWC_OUTP_type_CM_boolean_flg 0.0 1.0 /end CHARACTERISTIC
/begin CHARACTERISTIC KOUTP_CCMSASpdWar_flg_ovrdval "" VALUE 0x0000 /* @ECU_Address@KOUTP_CCMSASpdWar_flg_ovrdval@ */ Scalar_BOOLEAN 0 SWC_OUTP_type_CM_boolean_flg 0.0 1.0 /end CHARACTERISTIC
/begin CHARACTERISTIC KOUTP_CalibratedAccX_G_ovrdflg "" VALUE 0x0000 /* @ECU_Address@KOUTP_CalibratedAccX_G_ovrdflg@ */ Scalar_BOOLEAN 0 SWC_OUTP_type_CM_boolean_flg 0.0 1.0 /end CHARACTERISTIC
/begin CHARACTERISTIC KOUTP_CalibratedAccY_G_ovrdflg "" VALUE 0x0000 /* @ECU_Address@KOUTP_CalibratedAccY_G_ovrdflg@ */ Scalar_BOOLEAN 0 SWC_OUTP_type_CM_boolean_flg 0.0 1.0 /end CHARACTERISTIC
/begin CHARACTERISTIC KOUTP_CalibratedAccZ_G_ovrdflg "" VALUE 0x0000 /* @ECU_Address@KOUTP_CalibratedAccZ_G_ovrdflg@ */ Scalar_BOOLEAN 0 SWC_OUTP_type_CM_boolean_flg 0.0 1.0 /end CHARACTERISTIC
/begin CHARACTERISTIC KOUTP_CalibratedGyroX_Dps_ovrdflg "" VALUE 0x0000 /* @ECU_Address@KOUTP_CalibratedGyroX_Dps_ovrdflg@ */ Scalar_BOOLEAN 0 SWC_OUTP_type_CM_boolean_flg 0.0 1.0 /end CHARACTERISTIC
/begin CHARACTERISTIC KOUTP_CalibratedGyroY_Dps_ovrdflg "" VALUE 0x0000 /* @ECU_Address@KOUTP_CalibratedGyroY_Dps_ovrdflg@ */ Scalar_BOOLEAN 0 SWC_OUTP_type_CM_boolean_flg 0.0 1.0 /end CHARACTERISTIC
/begin CHARACTERISTIC KOUTP_CalibratedGyroZ_Dps_ovrdflg "" VALUE 0x0000 /* @ECU_Address@KOUTP_CalibratedGyroZ_Dps_ovrdflg@ */ Scalar_BOOLEAN 0 SWC_OUTP_type_CM_boolean_flg 0.0 1.0 /end CHARACTERISTIC
/begin CHARACTERISTIC KOUTP_DISCReqAcc_mps2_ovrdflg "" VALUE 0x0000 /* @ECU_Address@KOUTP_DISCReqAcc_mps2_ovrdflg@ */ Scalar_BOOLEAN 0 SWC_OUTP_type_CM_boolean_flg 0.0 1.0 /end CHARACTERISTIC
/begin CHARACTERISTIC KOUTP_ExtraMSACtrlSta_enum_ovrdflg "" VALUE 0x0000 /* @ECU_Address@KOUTP_ExtraMSACtrlSta_enum_ovrdflg@ */ Scalar_BOOLEAN 0 SWC_OUTP_type_CM_boolean_flg 0.0 1.0 /end CHARACTERISTIC
/begin CHARACTERISTIC KOUTP_FCMACCmode_enum_ovrdflg "" VALUE 0x0000 /* @ECU_Address@KOUTP_FCMACCmode_enum_ovrdflg@ */ Scalar_BOOLEAN 0 SWC_OUTP_type_CM_boolean_flg 0.0 1.0 /end CHARACTERISTIC
/begin CHARACTERISTIC KOUTP_FCMLDWFault_flg_maxval "" VALUE 0x0000 /* @ECU_Address@KOUTP_FCMLDWFault_flg_maxval@ */ Scalar_BOOLEAN 0 SWC_OUTP_type_CM_boolean_flg 0.0 1.0 /end CHARACTERISTIC
/begin CHARACTERISTIC KOUTP_FCMLDWFault_flg_minval "" VALUE 0x0000 /* @ECU_Address@KOUTP_FCMLDWFault_flg_minval@ */ Scalar_BOOLEAN 0 SWC_OUTP_type_CM_boolean_flg 0.0 1.0 /end CHARACTERISTIC
/begin CHARACTERISTIC KOUTP_FCMLDWFault_flg_ovrdflg "" VALUE 0x0000 /* @ECU_Address@KOUTP_FCMLDWFault_flg_ovrdflg@ */ Scalar_BOOLEAN 0 SWC_OUTP_type_CM_boolean_flg 0.0 1.0 /end CHARACTERISTIC
/begin CHARACTERISTIC KOUTP_FCMLDWFault_flg_ovrdval "" VALUE 0x0000 /* @ECU_Address@KOUTP_FCMLDWFault_flg_ovrdval@ */ Scalar_BOOLEAN 0 SWC_OUTP_type_CM_boolean_flg 0.0 1.0 /end CHARACTERISTIC
/begin CHARACTERISTIC KOUTP_FCMLDWRequest_enum_ovrdflg "" VALUE 0x0000 /* @ECU_Address@KOUTP_FCMLDWRequest_enum_ovrdflg@ */ Scalar_BOOLEAN 0 SWC_OUTP_type_CM_boolean_flg 0.0 1.0 /end CHARACTERISTIC
/begin CHARACTERISTIC KOUTP_FDCVMCAPSAngleTarget_deg_ovrdflg "" VALUE 0x0000 /* @ECU_Address@KOUTP_FDCVMCAPSAngleTarget_deg_ovrdflg@ */ Scalar_BOOLEAN 0 SWC_OUTP_type_CM_boolean_flg 0.0 1.0 /end CHARACTERISTIC
/begin CHARACTERISTIC KOUTP_FDCVMCAPSRqEPSCtrl_flg_maxval "" VALUE 0x0000 /* @ECU_Address@KOUTP_FDCVMCAPSRqEPSCtrl_flg_maxval@ */ Scalar_BOOLEAN 0 SWC_OUTP_type_CM_boolean_flg 0.0 1.0 /end CHARACTERISTIC
/begin CHARACTERISTIC KOUTP_FDCVMCAPSRqEPSCtrl_flg_minval "" VALUE 0x0000 /* @ECU_Address@KOUTP_FDCVMCAPSRqEPSCtrl_flg_minval@ */ Scalar_BOOLEAN 0 SWC_OUTP_type_CM_boolean_flg 0.0 1.0 /end CHARACTERISTIC
/begin CHARACTERISTIC KOUTP_FDCVMCAPSRqEPSCtrl_flg_ovrdflg "" VALUE 0x0000 /* @ECU_Address@KOUTP_FDCVMCAPSRqEPSCtrl_flg_ovrdflg@ */ Scalar_BOOLEAN 0 SWC_OUTP_type_CM_boolean_flg 0.0 1.0 /end CHARACTERISTIC
/begin CHARACTERISTIC KOUTP_FDCVMCAPSRqEPSCtrl_flg_ovrdval "" VALUE 0x0000 /* @ECU_Address@KOUTP_FDCVMCAPSRqEPSCtrl_flg_ovrdval@ */ Scalar_BOOLEAN 0 SWC_OUTP_type_CM_boolean_flg 0.0 1.0 /end CHARACTERISTIC
/begin CHARACTERISTIC KOUTP_FDCVMCAPSVRqEPSCtrl_flg_maxval "" VALUE 0x0000 /* @ECU_Address@KOUTP_FDCVMCAPSVRqEPSCtrl_flg_maxval@ */ Scalar_BOOLEAN 0 SWC_OUTP_type_CM_boolean_flg 0.0 1.0 /end CHARACTERISTIC
/begin CHARACTERISTIC KOUTP_FDCVMCAPSVRqEPSCtrl_flg_minval "" VALUE 0x0000 /* @ECU_Address@KOUTP_FDCVMCAPSVRqEPSCtrl_flg_minval@ */ Scalar_BOOLEAN 0 SWC_OUTP_type_CM_boolean_flg 0.0 1.0 /end CHARACTERISTIC
/begin CHARACTERISTIC KOUTP_FDCVMCAPSVRqEPSCtrl_flg_ovrdflg "" VALUE 0x0000 /* @ECU_Address@KOUTP_FDCVMCAPSVRqEPSCtrl_flg_ovrdflg@ */ Scalar_BOOLEAN 0 SWC_OUTP_type_CM_boolean_flg 0.0 1.0 /end CHARACTERISTIC
/begin CHARACTERISTIC KOUTP_FDCVMCAPSVRqEPSCtrl_flg_ovrdval "" VALUE 0x0000 /* @ECU_Address@KOUTP_FDCVMCAPSVRqEPSCtrl_flg_ovrdval@ */ Scalar_BOOLEAN 0 SWC_OUTP_type_CM_boolean_flg 0.0 1.0 /end CHARACTERISTIC
/begin CHARACTERISTIC KOUTP_FDCVMCAngCtrlTqWtGn_pct_ovrdflg "" VALUE 0x0000 /* @ECU_Address@KOUTP_FDCVMCAngCtrlTqWtGn_pct_ovrdflg@ */ Scalar_BOOLEAN 0 SWC_OUTP_type_CM_boolean_flg 0.0 1.0 /end CHARACTERISTIC
/begin CHARACTERISTIC KOUTP_FDCVMCDrInpTqBstAct_flg_maxval "" VALUE 0x0000 /* @ECU_Address@KOUTP_FDCVMCDrInpTqBstAct_flg_maxval@ */ Scalar_BOOLEAN 0 SWC_OUTP_type_CM_boolean_flg 0.0 1.0 /end CHARACTERISTIC
/begin CHARACTERISTIC KOUTP_FDCVMCDrInpTqBstAct_flg_minval "" VALUE 0x0000 /* @ECU_Address@KOUTP_FDCVMCDrInpTqBstAct_flg_minval@ */ Scalar_BOOLEAN 0 SWC_OUTP_type_CM_boolean_flg 0.0 1.0 /end CHARACTERISTIC
/begin CHARACTERISTIC KOUTP_FDCVMCDrInpTqBstAct_flg_ovrdflg "" VALUE 0x0000 /* @ECU_Address@KOUTP_FDCVMCDrInpTqBstAct_flg_ovrdflg@ */ Scalar_BOOLEAN 0 SWC_OUTP_type_CM_boolean_flg 0.0 1.0 /end CHARACTERISTIC
/begin CHARACTERISTIC KOUTP_FDCVMCDrInpTqBstAct_flg_ovrdval "" VALUE 0x0000 /* @ECU_Address@KOUTP_FDCVMCDrInpTqBstAct_flg_ovrdval@ */ Scalar_BOOLEAN 0 SWC_OUTP_type_CM_boolean_flg 0.0 1.0 /end CHARACTERISTIC
/begin CHARACTERISTIC KOUTP_FDCVMCDrInpTqBstGn_pct_ovrdflg "" VALUE 0x0000 /* @ECU_Address@KOUTP_FDCVMCDrInpTqBstGn_pct_ovrdflg@ */ Scalar_BOOLEAN 0 SWC_OUTP_type_CM_boolean_flg 0.0 1.0 /end CHARACTERISTIC
/begin CHARACTERISTIC KOUTP_FDCVMCMaxAngCtrlOutTqLim_Nm_ovrdflg "" VALUE 0x0000 /* @ECU_Address@KOUTP_FDCVMCMaxAngCtrlOutTqLim_Nm_ovrdflg@ */ Scalar_BOOLEAN 0 SWC_OUTP_type_CM_boolean_flg 0.0 1.0 /end CHARACTERISTIC
/begin CHARACTERISTIC KOUTP_FeatArbitrFinal_enum_ovrdflg "" VALUE 0x0000 /* @ECU_Address@KOUTP_FeatArbitrFinal_enum_ovrdflg@ */ Scalar_BOOLEAN 0 SWC_OUTP_type_CM_boolean_flg 0.0 1.0 /end CHARACTERISTIC
/begin CHARACTERISTIC KOUTP_FeatArbitrSta_enum_ovrdflg "" VALUE 0x0000 /* @ECU_Address@KOUTP_FeatArbitrSta_enum_ovrdflg@ */ Scalar_BOOLEAN 0 SWC_OUTP_type_CM_boolean_flg 0.0 1.0 /end CHARACTERISTIC
/begin CHARACTERISTIC KOUTP_FeatReqSpd_kph_ovrdflg "" VALUE 0x0000 /* @ECU_Address@KOUTP_FeatReqSpd_kph_ovrdflg@ */ Scalar_BOOLEAN 0 SWC_OUTP_type_CM_boolean_flg 0.0 1.0 /end CHARACTERISTIC
/begin CHARACTERISTIC KOUTP_FeatSetSpdFinal_raw32_ovrdflg "" VALUE 0x0000 /* @ECU_Address@KOUTP_FeatSetSpdFinal_raw32_ovrdflg@ */ Scalar_BOOLEAN 0 SWC_OUTP_type_CM_boolean_flg 0.0 1.0 /end CHARACTERISTIC
/begin CHARACTERISTIC KOUTP_ForceLowBeam_enum_ovrdflg "" VALUE 0x0000 /* @ECU_Address@KOUTP_ForceLowBeam_enum_ovrdflg@ */ Scalar_BOOLEAN 0 SWC_OUTP_type_CM_boolean_flg 0.0 1.0 /end CHARACTERISTIC
/begin CHARACTERISTIC KOUTP_FrontRearSlipRatioCtrl_flg_maxval "" VALUE 0x0000 /* @ECU_Address@KOUTP_FrontRearSlipRatioCtrl_flg_maxval@ */ Scalar_BOOLEAN 0 SWC_OUTP_type_CM_boolean_flg 0.0 1.0 /end CHARACTERISTIC
/begin CHARACTERISTIC KOUTP_FrontRearSlipRatioCtrl_flg_minval "" VALUE 0x0000 /* @ECU_Address@KOUTP_FrontRearSlipRatioCtrl_flg_minval@ */ Scalar_BOOLEAN 0 SWC_OUTP_type_CM_boolean_flg 0.0 1.0 /end CHARACTERISTIC
/begin CHARACTERISTIC KOUTP_FrontRearSlipRatioCtrl_flg_ovrdflg "" VALUE 0x0000 /* @ECU_Address@KOUTP_FrontRearSlipRatioCtrl_flg_ovrdflg@ */ Scalar_BOOLEAN 0 SWC_OUTP_type_CM_boolean_flg 0.0 1.0 /end CHARACTERISTIC
/begin CHARACTERISTIC KOUTP_FrontRearSlipRatioCtrl_flg_ovrdval "" VALUE 0x0000 /* @ECU_Address@KOUTP_FrontRearSlipRatioCtrl_flg_ovrdval@ */ Scalar_BOOLEAN 0 SWC_OUTP_type_CM_boolean_flg 0.0 1.0 /end CHARACTERISTIC
/begin CHARACTERISTIC KOUTP_HazardWarningReq_flg_maxval "" VALUE 0x0000 /* @ECU_Address@KOUTP_HazardWarningReq_flg_maxval@ */ Scalar_BOOLEAN 0 SWC_OUTP_type_CM_boolean_flg 0.0 1.0 /end CHARACTERISTIC
/begin CHARACTERISTIC KOUTP_HazardWarningReq_flg_minval "" VALUE 0x0000 /* @ECU_Address@KOUTP_HazardWarningReq_flg_minval@ */ Scalar_BOOLEAN 0 SWC_OUTP_type_CM_boolean_flg 0.0 1.0 /end CHARACTERISTIC
/begin CHARACTERISTIC KOUTP_HazardWarningReq_flg_ovrdflg "" VALUE 0x0000 /* @ECU_Address@KOUTP_HazardWarningReq_flg_ovrdflg@ */ Scalar_BOOLEAN 0 SWC_OUTP_type_CM_boolean_flg 0.0 1.0 /end CHARACTERISTIC
/begin CHARACTERISTIC KOUTP_HazardWarningReq_flg_ovrdval "" VALUE 0x0000 /* @ECU_Address@KOUTP_HazardWarningReq_flg_ovrdval@ */ Scalar_BOOLEAN 0 SWC_OUTP_type_CM_boolean_flg 0.0 1.0 /end CHARACTERISTIC
/begin CHARACTERISTIC KOUTP_IMUEnaCmd_flg_maxval "" VALUE 0x0000 /* @ECU_Address@KOUTP_IMUEnaCmd_flg_maxval@ */ Scalar_BOOLEAN 0 SWC_OUTP_type_CM_boolean_flg 0.0 1.0 /end CHARACTERISTIC
/begin CHARACTERISTIC KOUTP_IMUEnaCmd_flg_minval "" VALUE 0x0000 /* @ECU_Address@KOUTP_IMUEnaCmd_flg_minval@ */ Scalar_BOOLEAN 0 SWC_OUTP_type_CM_boolean_flg 0.0 1.0 /end CHARACTERISTIC
/begin CHARACTERISTIC KOUTP_IMUEnaCmd_flg_ovrdflg "" VALUE 0x0000 /* @ECU_Address@KOUTP_IMUEnaCmd_flg_ovrdflg@ */ Scalar_BOOLEAN 0 SWC_OUTP_type_CM_boolean_flg 0.0 1.0 /end CHARACTERISTIC
/begin CHARACTERISTIC KOUTP_IMUEnaCmd_flg_ovrdval "" VALUE 0x0000 /* @ECU_Address@KOUTP_IMUEnaCmd_flg_ovrdval@ */ Scalar_BOOLEAN 0 SWC_OUTP_type_CM_boolean_flg 0.0 1.0 /end CHARACTERISTIC
/begin CHARACTERISTIC KOUTP_ISOAccLimit_mps2_ovrdflg "" VALUE 0x0000 /* @ECU_Address@KOUTP_ISOAccLimit_mps2_ovrdflg@ */ Scalar_BOOLEAN 0 SWC_OUTP_type_CM_boolean_flg 0.0 1.0 /end CHARACTERISTIC
/begin CHARACTERISTIC KOUTP_ISODecLimit_mps2_ovrdflg "" VALUE 0x0000 /* @ECU_Address@KOUTP_ISODecLimit_mps2_ovrdflg@ */ Scalar_BOOLEAN 0 SWC_OUTP_type_CM_boolean_flg 0.0 1.0 /end CHARACTERISTIC
/begin CHARACTERISTIC KOUTP_ISOJerkLimit_mps3_ovrdflg "" VALUE 0x0000 /* @ECU_Address@KOUTP_ISOJerkLimit_mps3_ovrdflg@ */ Scalar_BOOLEAN 0 SWC_OUTP_type_CM_boolean_flg 0.0 1.0 /end CHARACTERISTIC
/begin CHARACTERISTIC KOUTP_JerkPCT_pct_ovrdflg "" VALUE 0x0000 /* @ECU_Address@KOUTP_JerkPCT_pct_ovrdflg@ */ Scalar_BOOLEAN 0 SWC_OUTP_type_CM_boolean_flg 0.0 1.0 /end CHARACTERISTIC
/begin CHARACTERISTIC KOUTP_LKAHODDisplayWarning_flg_maxval "" VALUE 0x0000 /* @ECU_Address@KOUTP_LKAHODDisplayWarning_flg_maxval@ */ Scalar_BOOLEAN 0 SWC_OUTP_type_CM_boolean_flg 0.0 1.0 /end CHARACTERISTIC
/begin CHARACTERISTIC KOUTP_LKAHODDisplayWarning_flg_minval "" VALUE 0x0000 /* @ECU_Address@KOUTP_LKAHODDisplayWarning_flg_minval@ */ Scalar_BOOLEAN 0 SWC_OUTP_type_CM_boolean_flg 0.0 1.0 /end CHARACTERISTIC
/begin CHARACTERISTIC KOUTP_LKAHODDisplayWarning_flg_ovrdflg "" VALUE 0x0000 /* @ECU_Address@KOUTP_LKAHODDisplayWarning_flg_ovrdflg@ */ Scalar_BOOLEAN 0 SWC_OUTP_type_CM_boolean_flg 0.0 1.0 /end CHARACTERISTIC
/begin CHARACTERISTIC KOUTP_LKAHODDisplayWarning_flg_ovrdval "" VALUE 0x0000 /* @ECU_Address@KOUTP_LKAHODDisplayWarning_flg_ovrdval@ */ Scalar_BOOLEAN 0 SWC_OUTP_type_CM_boolean_flg 0.0 1.0 /end CHARACTERISTIC
/begin CHARACTERISTIC KOUTP_LKAHODSoundWarning_flg_maxval "" VALUE 0x0000 /* @ECU_Address@KOUTP_LKAHODSoundWarning_flg_maxval@ */ Scalar_BOOLEAN 0 SWC_OUTP_type_CM_boolean_flg 0.0 1.0 /end CHARACTERISTIC
/begin CHARACTERISTIC KOUTP_LKAHODSoundWarning_flg_minval "" VALUE 0x0000 /* @ECU_Address@KOUTP_LKAHODSoundWarning_flg_minval@ */ Scalar_BOOLEAN 0 SWC_OUTP_type_CM_boolean_flg 0.0 1.0 /end CHARACTERISTIC
/begin CHARACTERISTIC KOUTP_LKAHODSoundWarning_flg_ovrdflg "" VALUE 0x0000 /* @ECU_Address@KOUTP_LKAHODSoundWarning_flg_ovrdflg@ */ Scalar_BOOLEAN 0 SWC_OUTP_type_CM_boolean_flg 0.0 1.0 /end CHARACTERISTIC
/begin CHARACTERISTIC KOUTP_LKAHODSoundWarning_flg_ovrdval "" VALUE 0x0000 /* @ECU_Address@KOUTP_LKAHODSoundWarning_flg_ovrdval@ */ Scalar_BOOLEAN 0 SWC_OUTP_type_CM_boolean_flg 0.0 1.0 /end CHARACTERISTIC
/begin CHARACTERISTIC KOUTP_LKAStrToqReq_Nm_ovrdflg "" VALUE 0x0000 /* @ECU_Address@KOUTP_LKAStrToqReq_Nm_ovrdflg@ */ Scalar_BOOLEAN 0 SWC_OUTP_type_CM_boolean_flg 0.0 1.0 /end CHARACTERISTIC
/begin CHARACTERISTIC KOUTP_LKATOIAct_enum_ovrdflg "" VALUE 0x0000 /* @ECU_Address@KOUTP_LKATOIAct_enum_ovrdflg@ */ Scalar_BOOLEAN 0 SWC_OUTP_type_CM_boolean_flg 0.0 1.0 /end CHARACTERISTIC
/begin CHARACTERISTIC KOUTP_LKATOIFault_flg_maxval "" VALUE 0x0000 /* @ECU_Address@KOUTP_LKATOIFault_flg_maxval@ */ Scalar_BOOLEAN 0 SWC_OUTP_type_CM_boolean_flg 0.0 1.0 /end CHARACTERISTIC
/begin CHARACTERISTIC KOUTP_LKATOIFault_flg_minval "" VALUE 0x0000 /* @ECU_Address@KOUTP_LKATOIFault_flg_minval@ */ Scalar_BOOLEAN 0 SWC_OUTP_type_CM_boolean_flg 0.0 1.0 /end CHARACTERISTIC
/begin CHARACTERISTIC KOUTP_LKATOIFault_flg_ovrdflg "" VALUE 0x0000 /* @ECU_Address@KOUTP_LKATOIFault_flg_ovrdflg@ */ Scalar_BOOLEAN 0 SWC_OUTP_type_CM_boolean_flg 0.0 1.0 /end CHARACTERISTIC
/begin CHARACTERISTIC KOUTP_LKATOIFault_flg_ovrdval "" VALUE 0x0000 /* @ECU_Address@KOUTP_LKATOIFault_flg_ovrdval@ */ Scalar_BOOLEAN 0 SWC_OUTP_type_CM_boolean_flg 0.0 1.0 /end CHARACTERISTIC
/begin CHARACTERISTIC KOUTP_LVDAACCStatusInformation_flg_maxval "" VALUE 0x0000 /* @ECU_Address@KOUTP_LVDAACCStatusInformation_flg_maxval@ */ Scalar_BOOLEAN 0 SWC_OUTP_type_CM_boolean_flg 0.0 1.0 /end CHARACTERISTIC
/begin CHARACTERISTIC KOUTP_LVDAACCStatusInformation_flg_minval "" VALUE 0x0000 /* @ECU_Address@KOUTP_LVDAACCStatusInformation_flg_minval@ */ Scalar_BOOLEAN 0 SWC_OUTP_type_CM_boolean_flg 0.0 1.0 /end CHARACTERISTIC
/begin CHARACTERISTIC KOUTP_LVDAACCStatusInformation_flg_ovrdflg "" VALUE 0x0000 /* @ECU_Address@KOUTP_LVDAACCStatusInformation_flg_ovrdflg@ */ Scalar_BOOLEAN 0 SWC_OUTP_type_CM_boolean_flg 0.0 1.0 /end CHARACTERISTIC
/begin CHARACTERISTIC KOUTP_LVDAACCStatusInformation_flg_ovrdval "" VALUE 0x0000 /* @ECU_Address@KOUTP_LVDAACCStatusInformation_flg_ovrdval@ */ Scalar_BOOLEAN 0 SWC_OUTP_type_CM_boolean_flg 0.0 1.0 /end CHARACTERISTIC
/begin CHARACTERISTIC KOUTP_LVDADisabled_flg_maxval "" VALUE 0x0000 /* @ECU_Address@KOUTP_LVDADisabled_flg_maxval@ */ Scalar_BOOLEAN 0 SWC_OUTP_type_CM_boolean_flg 0.0 1.0 /end CHARACTERISTIC
/begin CHARACTERISTIC KOUTP_LVDADisabled_flg_minval "" VALUE 0x0000 /* @ECU_Address@KOUTP_LVDADisabled_flg_minval@ */ Scalar_BOOLEAN 0 SWC_OUTP_type_CM_boolean_flg 0.0 1.0 /end CHARACTERISTIC
/begin CHARACTERISTIC KOUTP_LVDADisabled_flg_ovrdflg "" VALUE 0x0000 /* @ECU_Address@KOUTP_LVDADisabled_flg_ovrdflg@ */ Scalar_BOOLEAN 0 SWC_OUTP_type_CM_boolean_flg 0.0 1.0 /end CHARACTERISTIC
/begin CHARACTERISTIC KOUTP_LVDADisabled_flg_ovrdval "" VALUE 0x0000 /* @ECU_Address@KOUTP_LVDADisabled_flg_ovrdval@ */ Scalar_BOOLEAN 0 SWC_OUTP_type_CM_boolean_flg 0.0 1.0 /end CHARACTERISTIC
/begin CHARACTERISTIC KOUTP_LVDAFailinfo_flg_maxval "" VALUE 0x0000 /* @ECU_Address@KOUTP_LVDAFailinfo_flg_maxval@ */ Scalar_BOOLEAN 0 SWC_OUTP_type_CM_boolean_flg 0.0 1.0 /end CHARACTERISTIC
/begin CHARACTERISTIC KOUTP_LVDAFailinfo_flg_minval "" VALUE 0x0000 /* @ECU_Address@KOUTP_LVDAFailinfo_flg_minval@ */ Scalar_BOOLEAN 0 SWC_OUTP_type_CM_boolean_flg 0.0 1.0 /end CHARACTERISTIC
/begin CHARACTERISTIC KOUTP_LVDAFailinfo_flg_ovrdflg "" VALUE 0x0000 /* @ECU_Address@KOUTP_LVDAFailinfo_flg_ovrdflg@ */ Scalar_BOOLEAN 0 SWC_OUTP_type_CM_boolean_flg 0.0 1.0 /end CHARACTERISTIC
/begin CHARACTERISTIC KOUTP_LVDAFailinfo_flg_ovrdval "" VALUE 0x0000 /* @ECU_Address@KOUTP_LVDAFailinfo_flg_ovrdval@ */ Scalar_BOOLEAN 0 SWC_OUTP_type_CM_boolean_flg 0.0 1.0 /end CHARACTERISTIC
/begin CHARACTERISTIC KOUTP_LVDAMuteSta_enum_ovrdflg "" VALUE 0x0000 /* @ECU_Address@KOUTP_LVDAMuteSta_enum_ovrdflg@ */ Scalar_BOOLEAN 0 SWC_OUTP_type_CM_boolean_flg 0.0 1.0 /end CHARACTERISTIC
/begin CHARACTERISTIC KOUTP_LVDAWarning_flg_maxval "" VALUE 0x0000 /* @ECU_Address@KOUTP_LVDAWarning_flg_maxval@ */ Scalar_BOOLEAN 0 SWC_OUTP_type_CM_boolean_flg 0.0 1.0 /end CHARACTERISTIC
/begin CHARACTERISTIC KOUTP_LVDAWarning_flg_minval "" VALUE 0x0000 /* @ECU_Address@KOUTP_LVDAWarning_flg_minval@ */ Scalar_BOOLEAN 0 SWC_OUTP_type_CM_boolean_flg 0.0 1.0 /end CHARACTERISTIC
/begin CHARACTERISTIC KOUTP_LVDAWarning_flg_ovrdflg "" VALUE 0x0000 /* @ECU_Address@KOUTP_LVDAWarning_flg_ovrdflg@ */ Scalar_BOOLEAN 0 SWC_OUTP_type_CM_boolean_flg 0.0 1.0 /end CHARACTERISTIC
/begin CHARACTERISTIC KOUTP_LVDAWarning_flg_ovrdval "" VALUE 0x0000 /* @ECU_Address@KOUTP_LVDAWarning_flg_ovrdval@ */ Scalar_BOOLEAN 0 SWC_OUTP_type_CM_boolean_flg 0.0 1.0 /end CHARACTERISTIC
/begin CHARACTERISTIC KOUTP_LatAccCtrl_flg_maxval "" VALUE 0x0000 /* @ECU_Address@KOUTP_LatAccCtrl_flg_maxval@ */ Scalar_BOOLEAN 0 SWC_OUTP_type_CM_boolean_flg 0.0 1.0 /end CHARACTERISTIC
/begin CHARACTERISTIC KOUTP_LatAccCtrl_flg_minval "" VALUE 0x0000 /* @ECU_Address@KOUTP_LatAccCtrl_flg_minval@ */ Scalar_BOOLEAN 0 SWC_OUTP_type_CM_boolean_flg 0.0 1.0 /end CHARACTERISTIC
/begin CHARACTERISTIC KOUTP_LatAccCtrl_flg_ovrdflg "" VALUE 0x0000 /* @ECU_Address@KOUTP_LatAccCtrl_flg_ovrdflg@ */ Scalar_BOOLEAN 0 SWC_OUTP_type_CM_boolean_flg 0.0 1.0 /end CHARACTERISTIC
/begin CHARACTERISTIC KOUTP_LatAccCtrl_flg_ovrdval "" VALUE 0x0000 /* @ECU_Address@KOUTP_LatAccCtrl_flg_ovrdval@ */ Scalar_BOOLEAN 0 SWC_OUTP_type_CM_boolean_flg 0.0 1.0 /end CHARACTERISTIC
/begin CHARACTERISTIC KOUTP_LateralCtrl_flg_maxval "" VALUE 0x0000 /* @ECU_Address@KOUTP_LateralCtrl_flg_maxval@ */ Scalar_BOOLEAN 0 SWC_OUTP_type_CM_boolean_flg 0.0 1.0 /end CHARACTERISTIC
/begin CHARACTERISTIC KOUTP_LateralCtrl_flg_minval "" VALUE 0x0000 /* @ECU_Address@KOUTP_LateralCtrl_flg_minval@ */ Scalar_BOOLEAN 0 SWC_OUTP_type_CM_boolean_flg 0.0 1.0 /end CHARACTERISTIC
/begin CHARACTERISTIC KOUTP_LateralCtrl_flg_ovrdflg "" VALUE 0x0000 /* @ECU_Address@KOUTP_LateralCtrl_flg_ovrdflg@ */ Scalar_BOOLEAN 0 SWC_OUTP_type_CM_boolean_flg 0.0 1.0 /end CHARACTERISTIC
/begin CHARACTERISTIC KOUTP_LateralCtrl_flg_ovrdval "" VALUE 0x0000 /* @ECU_Address@KOUTP_LateralCtrl_flg_ovrdval@ */ Scalar_BOOLEAN 0 SWC_OUTP_type_CM_boolean_flg 0.0 1.0 /end CHARACTERISTIC
/begin CHARACTERISTIC KOUTP_LeftTurnLightReq_flg_maxval "" VALUE 0x0000 /* @ECU_Address@KOUTP_LeftTurnLightReq_flg_maxval@ */ Scalar_BOOLEAN 0 SWC_OUTP_type_CM_boolean_flg 0.0 1.0 /end CHARACTERISTIC
/begin CHARACTERISTIC KOUTP_LeftTurnLightReq_flg_minval "" VALUE 0x0000 /* @ECU_Address@KOUTP_LeftTurnLightReq_flg_minval@ */ Scalar_BOOLEAN 0 SWC_OUTP_type_CM_boolean_flg 0.0 1.0 /end CHARACTERISTIC
/begin CHARACTERISTIC KOUTP_LeftTurnLightReq_flg_ovrdflg "" VALUE 0x0000 /* @ECU_Address@KOUTP_LeftTurnLightReq_flg_ovrdflg@ */ Scalar_BOOLEAN 0 SWC_OUTP_type_CM_boolean_flg 0.0 1.0 /end CHARACTERISTIC
/begin CHARACTERISTIC KOUTP_LeftTurnLightReq_flg_ovrdval "" VALUE 0x0000 /* @ECU_Address@KOUTP_LeftTurnLightReq_flg_ovrdval@ */ Scalar_BOOLEAN 0 SWC_OUTP_type_CM_boolean_flg 0.0 1.0 /end CHARACTERISTIC
/begin CHARACTERISTIC KOUTP_LimitPCT_pct_ovrdflg "" VALUE 0x0000 /* @ECU_Address@KOUTP_LimitPCT_pct_ovrdflg@ */ Scalar_BOOLEAN 0 SWC_OUTP_type_CM_boolean_flg 0.0 1.0 /end CHARACTERISTIC
/begin CHARACTERISTIC KOUTP_LongAcc_Gps_ovrdflg "" VALUE 0x0000 /* @ECU_Address@KOUTP_LongAcc_Gps_ovrdflg@ */ Scalar_BOOLEAN 0 SWC_OUTP_type_CM_boolean_flg 0.0 1.0 /end CHARACTERISTIC
/begin CHARACTERISTIC KOUTP_MSACtrlSta_enum_ovrdflg "" VALUE 0x0000 /* @ECU_Address@KOUTP_MSACtrlSta_enum_ovrdflg@ */ Scalar_BOOLEAN 0 SWC_OUTP_type_CM_boolean_flg 0.0 1.0 /end CHARACTERISTIC
/begin CHARACTERISTIC KOUTP_MeterIndSpeed_raw32_ovrdflg "" VALUE 0x0000 /* @ECU_Address@KOUTP_MeterIndSpeed_raw32_ovrdflg@ */ Scalar_BOOLEAN 0 SWC_OUTP_type_CM_boolean_flg 0.0 1.0 /end CHARACTERISTIC
/begin CHARACTERISTIC KOUTP_RearWhlSlipRatioCtrl_flg_maxval "" VALUE 0x0000 /* @ECU_Address@KOUTP_RearWhlSlipRatioCtrl_flg_maxval@ */ Scalar_BOOLEAN 0 SWC_OUTP_type_CM_boolean_flg 0.0 1.0 /end CHARACTERISTIC
/begin CHARACTERISTIC KOUTP_RearWhlSlipRatioCtrl_flg_minval "" VALUE 0x0000 /* @ECU_Address@KOUTP_RearWhlSlipRatioCtrl_flg_minval@ */ Scalar_BOOLEAN 0 SWC_OUTP_type_CM_boolean_flg 0.0 1.0 /end CHARACTERISTIC
/begin CHARACTERISTIC KOUTP_RearWhlSlipRatioCtrl_flg_ovrdflg "" VALUE 0x0000 /* @ECU_Address@KOUTP_RearWhlSlipRatioCtrl_flg_ovrdflg@ */ Scalar_BOOLEAN 0 SWC_OUTP_type_CM_boolean_flg 0.0 1.0 /end CHARACTERISTIC
/begin CHARACTERISTIC KOUTP_RearWhlSlipRatioCtrl_flg_ovrdval "" VALUE 0x0000 /* @ECU_Address@KOUTP_RearWhlSlipRatioCtrl_flg_ovrdval@ */ Scalar_BOOLEAN 0 SWC_OUTP_type_CM_boolean_flg 0.0 1.0 /end CHARACTERISTIC
/begin CHARACTERISTIC KOUTP_ReqOBCExtrV2LEna_enum_ovrdflg "" VALUE 0x0000 /* @ECU_Address@KOUTP_ReqOBCExtrV2LEna_enum_ovrdflg@ */ Scalar_BOOLEAN 0 SWC_OUTP_type_CM_boolean_flg 0.0 1.0 /end CHARACTERISTIC
/begin CHARACTERISTIC KOUTP_ReqOBCIntrV2LEna_enum_ovrdflg "" VALUE 0x0000 /* @ECU_Address@KOUTP_ReqOBCIntrV2LEna_enum_ovrdflg@ */ Scalar_BOOLEAN 0 SWC_OUTP_type_CM_boolean_flg 0.0 1.0 /end CHARACTERISTIC
/begin CHARACTERISTIC KOUTP_ReqOBCV2LEna_enum_ovrdflg "" VALUE 0x0000 /* @ECU_Address@KOUTP_ReqOBCV2LEna_enum_ovrdflg@ */ Scalar_BOOLEAN 0 SWC_OUTP_type_CM_boolean_flg 0.0 1.0 /end CHARACTERISTIC
/begin CHARACTERISTIC KOUTP_ReqV2LIVIDisChrg_enum_ovrdflg "" VALUE 0x0000 /* @ECU_Address@KOUTP_ReqV2LIVIDisChrg_enum_ovrdflg@ */ Scalar_BOOLEAN 0 SWC_OUTP_type_CM_boolean_flg 0.0 1.0 /end CHARACTERISTIC
/begin CHARACTERISTIC KOUTP_ReqV2LIVIPopup_enum_ovrdflg "" VALUE 0x0000 /* @ECU_Address@KOUTP_ReqV2LIVIPopup_enum_ovrdflg@ */ Scalar_BOOLEAN 0 SWC_OUTP_type_CM_boolean_flg 0.0 1.0 /end CHARACTERISTIC
/begin CHARACTERISTIC KOUTP_RightTurnLightReq_flg_maxval "" VALUE 0x0000 /* @ECU_Address@KOUTP_RightTurnLightReq_flg_maxval@ */ Scalar_BOOLEAN 0 SWC_OUTP_type_CM_boolean_flg 0.0 1.0 /end CHARACTERISTIC
/begin CHARACTERISTIC KOUTP_RightTurnLightReq_flg_minval "" VALUE 0x0000 /* @ECU_Address@KOUTP_RightTurnLightReq_flg_minval@ */ Scalar_BOOLEAN 0 SWC_OUTP_type_CM_boolean_flg 0.0 1.0 /end CHARACTERISTIC
/begin CHARACTERISTIC KOUTP_RightTurnLightReq_flg_ovrdflg "" VALUE 0x0000 /* @ECU_Address@KOUTP_RightTurnLightReq_flg_ovrdflg@ */ Scalar_BOOLEAN 0 SWC_OUTP_type_CM_boolean_flg 0.0 1.0 /end CHARACTERISTIC
/begin CHARACTERISTIC KOUTP_RightTurnLightReq_flg_ovrdval "" VALUE 0x0000 /* @ECU_Address@KOUTP_RightTurnLightReq_flg_ovrdval@ */ Scalar_BOOLEAN 0 SWC_OUTP_type_CM_boolean_flg 0.0 1.0 /end CHARACTERISTIC
/begin CHARACTERISTIC KOUTP_SPD2ACCAct_flg_maxval "" VALUE 0x0000 /* @ECU_Address@KOUTP_SPD2ACCAct_flg_maxval@ */ Scalar_BOOLEAN 0 SWC_OUTP_type_CM_boolean_flg 0.0 1.0 /end CHARACTERISTIC
/begin CHARACTERISTIC KOUTP_SPD2ACCAct_flg_minval "" VALUE 0x0000 /* @ECU_Address@KOUTP_SPD2ACCAct_flg_minval@ */ Scalar_BOOLEAN 0 SWC_OUTP_type_CM_boolean_flg 0.0 1.0 /end CHARACTERISTIC
/begin CHARACTERISTIC KOUTP_SPD2ACCAct_flg_ovrdflg "" VALUE 0x0000 /* @ECU_Address@KOUTP_SPD2ACCAct_flg_ovrdflg@ */ Scalar_BOOLEAN 0 SWC_OUTP_type_CM_boolean_flg 0.0 1.0 /end CHARACTERISTIC
/begin CHARACTERISTIC KOUTP_SPD2ACCAct_flg_ovrdval "" VALUE 0x0000 /* @ECU_Address@KOUTP_SPD2ACCAct_flg_ovrdval@ */ Scalar_BOOLEAN 0 SWC_OUTP_type_CM_boolean_flg 0.0 1.0 /end CHARACTERISTIC
/begin CHARACTERISTIC KOUTP_SafetyCtrl_flg_maxval "" VALUE 0x0000 /* @ECU_Address@KOUTP_SafetyCtrl_flg_maxval@ */ Scalar_BOOLEAN 0 SWC_OUTP_type_CM_boolean_flg 0.0 1.0 /end CHARACTERISTIC
/begin CHARACTERISTIC KOUTP_SafetyCtrl_flg_minval "" VALUE 0x0000 /* @ECU_Address@KOUTP_SafetyCtrl_flg_minval@ */ Scalar_BOOLEAN 0 SWC_OUTP_type_CM_boolean_flg 0.0 1.0 /end CHARACTERISTIC
/begin CHARACTERISTIC KOUTP_SafetyCtrl_flg_ovrdflg "" VALUE 0x0000 /* @ECU_Address@KOUTP_SafetyCtrl_flg_ovrdflg@ */ Scalar_BOOLEAN 0 SWC_OUTP_type_CM_boolean_flg 0.0 1.0 /end CHARACTERISTIC
/begin CHARACTERISTIC KOUTP_SafetyCtrl_flg_ovrdval "" VALUE 0x0000 /* @ECU_Address@KOUTP_SafetyCtrl_flg_ovrdval@ */ Scalar_BOOLEAN 0 SWC_OUTP_type_CM_boolean_flg 0.0 1.0 /end CHARACTERISTIC
/begin CHARACTERISTIC KOUTP_SingleWhlSlipRatioCtrl_flg_maxval "" VALUE 0x0000 /* @ECU_Address@KOUTP_SingleWhlSlipRatioCtrl_flg_maxval@ */ Scalar_BOOLEAN 0 SWC_OUTP_type_CM_boolean_flg 0.0 1.0 /end CHARACTERISTIC
/begin CHARACTERISTIC KOUTP_SingleWhlSlipRatioCtrl_flg_minval "" VALUE 0x0000 /* @ECU_Address@KOUTP_SingleWhlSlipRatioCtrl_flg_minval@ */ Scalar_BOOLEAN 0 SWC_OUTP_type_CM_boolean_flg 0.0 1.0 /end CHARACTERISTIC
/begin CHARACTERISTIC KOUTP_SingleWhlSlipRatioCtrl_flg_ovrdflg "" VALUE 0x0000 /* @ECU_Address@KOUTP_SingleWhlSlipRatioCtrl_flg_ovrdflg@ */ Scalar_BOOLEAN 0 SWC_OUTP_type_CM_boolean_flg 0.0 1.0 /end CHARACTERISTIC
/begin CHARACTERISTIC KOUTP_SingleWhlSlipRatioCtrl_flg_ovrdval "" VALUE 0x0000 /* @ECU_Address@KOUTP_SingleWhlSlipRatioCtrl_flg_ovrdval@ */ Scalar_BOOLEAN 0 SWC_OUTP_type_CM_boolean_flg 0.0 1.0 /end CHARACTERISTIC
/begin CHARACTERISTIC KOUTP_TargetType_enum_ovrdflg "" VALUE 0x0000 /* @ECU_Address@KOUTP_TargetType_enum_ovrdflg@ */ Scalar_BOOLEAN 0 SWC_OUTP_type_CM_boolean_flg 0.0 1.0 /end CHARACTERISTIC
/begin CHARACTERISTIC KOUTP_TimeGapCalcu_s_ovrdflg "" VALUE 0x0000 /* @ECU_Address@KOUTP_TimeGapCalcu_s_ovrdflg@ */ Scalar_BOOLEAN 0 SWC_OUTP_type_CM_boolean_flg 0.0 1.0 /end CHARACTERISTIC
/begin CHARACTERISTIC KOUTP_TimeGapLevel_enum_ovrdflg "" VALUE 0x0000 /* @ECU_Address@KOUTP_TimeGapLevel_enum_ovrdflg@ */ Scalar_BOOLEAN 0 SWC_OUTP_type_CM_boolean_flg 0.0 1.0 /end CHARACTERISTIC
/begin CHARACTERISTIC KOUTP_VMCACCCtrlAvail_flg_maxval "" VALUE 0x0000 /* @ECU_Address@KOUTP_VMCACCCtrlAvail_flg_maxval@ */ Scalar_BOOLEAN 0 SWC_OUTP_type_CM_boolean_flg 0.0 1.0 /end CHARACTERISTIC
/begin CHARACTERISTIC KOUTP_VMCACCCtrlAvail_flg_minval "" VALUE 0x0000 /* @ECU_Address@KOUTP_VMCACCCtrlAvail_flg_minval@ */ Scalar_BOOLEAN 0 SWC_OUTP_type_CM_boolean_flg 0.0 1.0 /end CHARACTERISTIC
/begin CHARACTERISTIC KOUTP_VMCACCCtrlAvail_flg_ovrdflg "" VALUE 0x0000 /* @ECU_Address@KOUTP_VMCACCCtrlAvail_flg_ovrdflg@ */ Scalar_BOOLEAN 0 SWC_OUTP_type_CM_boolean_flg 0.0 1.0 /end CHARACTERISTIC
/begin CHARACTERISTIC KOUTP_VMCACCCtrlAvail_flg_ovrdval "" VALUE 0x0000 /* @ECU_Address@KOUTP_VMCACCCtrlAvail_flg_ovrdval@ */ Scalar_BOOLEAN 0 SWC_OUTP_type_CM_boolean_flg 0.0 1.0 /end CHARACTERISTIC
/begin CHARACTERISTIC KOUTP_VMCAEBCtrlAvail_flg_maxval "" VALUE 0x0000 /* @ECU_Address@KOUTP_VMCAEBCtrlAvail_flg_maxval@ */ Scalar_BOOLEAN 0 SWC_OUTP_type_CM_boolean_flg 0.0 1.0 /end CHARACTERISTIC
/begin CHARACTERISTIC KOUTP_VMCAEBCtrlAvail_flg_minval "" VALUE 0x0000 /* @ECU_Address@KOUTP_VMCAEBCtrlAvail_flg_minval@ */ Scalar_BOOLEAN 0 SWC_OUTP_type_CM_boolean_flg 0.0 1.0 /end CHARACTERISTIC
/begin CHARACTERISTIC KOUTP_VMCAEBCtrlAvail_flg_ovrdflg "" VALUE 0x0000 /* @ECU_Address@KOUTP_VMCAEBCtrlAvail_flg_ovrdflg@ */ Scalar_BOOLEAN 0 SWC_OUTP_type_CM_boolean_flg 0.0 1.0 /end CHARACTERISTIC
/begin CHARACTERISTIC KOUTP_VMCAEBCtrlAvail_flg_ovrdval "" VALUE 0x0000 /* @ECU_Address@KOUTP_VMCAEBCtrlAvail_flg_ovrdval@ */ Scalar_BOOLEAN 0 SWC_OUTP_type_CM_boolean_flg 0.0 1.0 /end CHARACTERISTIC
/begin CHARACTERISTIC KOUTP_VMCCCCtrlAvail_flg_maxval "" VALUE 0x0000 /* @ECU_Address@KOUTP_VMCCCCtrlAvail_flg_maxval@ */ Scalar_BOOLEAN 0 SWC_OUTP_type_CM_boolean_flg 0.0 1.0 /end CHARACTERISTIC
/begin CHARACTERISTIC KOUTP_VMCCCCtrlAvail_flg_minval "" VALUE 0x0000 /* @ECU_Address@KOUTP_VMCCCCtrlAvail_flg_minval@ */ Scalar_BOOLEAN 0 SWC_OUTP_type_CM_boolean_flg 0.0 1.0 /end CHARACTERISTIC
/begin CHARACTERISTIC KOUTP_VMCCCCtrlAvail_flg_ovrdflg "" VALUE 0x0000 /* @ECU_Address@KOUTP_VMCCCCtrlAvail_flg_ovrdflg@ */ Scalar_BOOLEAN 0 SWC_OUTP_type_CM_boolean_flg 0.0 1.0 /end CHARACTERISTIC
/begin CHARACTERISTIC KOUTP_VMCCCCtrlAvail_flg_ovrdval "" VALUE 0x0000 /* @ECU_Address@KOUTP_VMCCCCtrlAvail_flg_ovrdval@ */ Scalar_BOOLEAN 0 SWC_OUTP_type_CM_boolean_flg 0.0 1.0 /end CHARACTERISTIC
/begin CHARACTERISTIC KOUTP_VMCMSACtrlAvail_flg_maxval "" VALUE 0x0000 /* @ECU_Address@KOUTP_VMCMSACtrlAvail_flg_maxval@ */ Scalar_BOOLEAN 0 SWC_OUTP_type_CM_boolean_flg 0.0 1.0 /end CHARACTERISTIC
/begin CHARACTERISTIC KOUTP_VMCMSACtrlAvail_flg_minval "" VALUE 0x0000 /* @ECU_Address@KOUTP_VMCMSACtrlAvail_flg_minval@ */ Scalar_BOOLEAN 0 SWC_OUTP_type_CM_boolean_flg 0.0 1.0 /end CHARACTERISTIC
/begin CHARACTERISTIC KOUTP_VMCMSACtrlAvail_flg_ovrdflg "" VALUE 0x0000 /* @ECU_Address@KOUTP_VMCMSACtrlAvail_flg_ovrdflg@ */ Scalar_BOOLEAN 0 SWC_OUTP_type_CM_boolean_flg 0.0 1.0 /end CHARACTERISTIC
/begin CHARACTERISTIC KOUTP_VMCMSACtrlAvail_flg_ovrdval "" VALUE 0x0000 /* @ECU_Address@KOUTP_VMCMSACtrlAvail_flg_ovrdval@ */ Scalar_BOOLEAN 0 SWC_OUTP_type_CM_boolean_flg 0.0 1.0 /end CHARACTERISTIC
/begin CHARACTERISTIC KOUTP_VehicleSpeed_kph_ovrdflg "" VALUE 0x0000 /* @ECU_Address@KOUTP_VehicleSpeed_kph_ovrdflg@ */ Scalar_BOOLEAN 0 SWC_OUTP_type_CM_boolean_flg 0.0 1.0 /end CHARACTERISTIC
/begin CHARACTERISTIC KOUTP_VehicleSpeed_mph_ovrdflg "" VALUE 0x0000 /* @ECU_Address@KOUTP_VehicleSpeed_mph_ovrdflg@ */ Scalar_BOOLEAN 0 SWC_OUTP_type_CM_boolean_flg 0.0 1.0 /end CHARACTERISTIC
/begin CHARACTERISTIC KOUTP_ACCObjDstLvl_enum_maxval "" VALUE 0x0000 /* @ECU_Address@KOUTP_ACCObjDstLvl_enum_maxval@ */ Scalar_UBYTE 0 SWC_OUTP_type_CM_uint8_enum 0.0 255.0 /end CHARACTERISTIC
/begin CHARACTERISTIC KOUTP_ACCObjDstLvl_enum_minval "" VALUE 0x0000 /* @ECU_Address@KOUTP_ACCObjDstLvl_enum_minval@ */ Scalar_UBYTE 0 SWC_OUTP_type_CM_uint8_enum 0.0 255.0 /end CHARACTERISTIC
/begin CHARACTERISTIC KOUTP_ACCObjDstLvl_enum_ovrdval "" VALUE 0x0000 /* @ECU_Address@KOUTP_ACCObjDstLvl_enum_ovrdval@ */ Scalar_UBYTE 0 SWC_OUTP_type_CM_uint8_enum 0.0 255.0 /end CHARACTERISTIC
/begin CHARACTERISTIC KOUTP_ADASACCSta_enum_maxval "" VALUE 0x0000 /* @ECU_Address@KOUTP_ADASACCSta_enum_maxval@ */ Scalar_UBYTE 0 SWC_OUTP_type_CM_uint8_enum 0.0 255.0 /end CHARACTERISTIC
/begin CHARACTERISTIC KOUTP_ADASACCSta_enum_minval "" VALUE 0x0000 /* @ECU_Address@KOUTP_ADASACCSta_enum_minval@ */ Scalar_UBYTE 0 SWC_OUTP_type_CM_uint8_enum 0.0 255.0 /end CHARACTERISTIC
/begin CHARACTERISTIC KOUTP_ADASACCSta_enum_ovrdval "" VALUE 0x0000 /* @ECU_Address@KOUTP_ADASACCSta_enum_ovrdval@ */ Scalar_UBYTE 0 SWC_OUTP_type_CM_uint8_enum 0.0 255.0 /end CHARACTERISTIC
/begin CHARACTERISTIC KOUTP_ADASAEBReq_enum_maxval "" VALUE 0x0000 /* @ECU_Address@KOUTP_ADASAEBReq_enum_maxval@ */ Scalar_UBYTE 0 SWC_OUTP_type_CM_uint8_enum 0.0 255.0 /end CHARACTERISTIC
/begin CHARACTERISTIC KOUTP_ADASAEBReq_enum_minval "" VALUE 0x0000 /* @ECU_Address@KOUTP_ADASAEBReq_enum_minval@ */ Scalar_UBYTE 0 SWC_OUTP_type_CM_uint8_enum 0.0 255.0 /end CHARACTERISTIC
/begin CHARACTERISTIC KOUTP_ADASAEBReq_enum_ovrdval "" VALUE 0x0000 /* @ECU_Address@KOUTP_ADASAEBReq_enum_ovrdval@ */ Scalar_UBYTE 0 SWC_OUTP_type_CM_uint8_enum 0.0 255.0 /end CHARACTERISTIC
/begin CHARACTERISTIC KOUTP_ADASAEBSta_enum_maxval "" VALUE 0x0000 /* @ECU_Address@KOUTP_ADASAEBSta_enum_maxval@ */ Scalar_UBYTE 0 SWC_OUTP_type_CM_uint8_enum 0.0 255.0 /end CHARACTERISTIC
/begin CHARACTERISTIC KOUTP_ADASAEBSta_enum_minval "" VALUE 0x0000 /* @ECU_Address@KOUTP_ADASAEBSta_enum_minval@ */ Scalar_UBYTE 0 SWC_OUTP_type_CM_uint8_enum 0.0 255.0 /end CHARACTERISTIC
/begin CHARACTERISTIC KOUTP_ADASAEBSta_enum_ovrdval "" VALUE 0x0000 /* @ECU_Address@KOUTP_ADASAEBSta_enum_ovrdval@ */ Scalar_UBYTE 0 SWC_OUTP_type_CM_uint8_enum 0.0 255.0 /end CHARACTERISTIC
/begin CHARACTERISTIC KOUTP_ADASCAMSpdLim_enum_maxval "" VALUE 0x0000 /* @ECU_Address@KOUTP_ADASCAMSpdLim_enum_maxval@ */ Scalar_UBYTE 0 SWC_OUTP_type_CM_uint8_enum 0.0 255.0 /end CHARACTERISTIC
/begin CHARACTERISTIC KOUTP_ADASCAMSpdLim_enum_minval "" VALUE 0x0000 /* @ECU_Address@KOUTP_ADASCAMSpdLim_enum_minval@ */ Scalar_UBYTE 0 SWC_OUTP_type_CM_uint8_enum 0.0 255.0 /end CHARACTERISTIC
/begin CHARACTERISTIC KOUTP_ADASCAMSpdLim_enum_ovrdval "" VALUE 0x0000 /* @ECU_Address@KOUTP_ADASCAMSpdLim_enum_ovrdval@ */ Scalar_UBYTE 0 SWC_OUTP_type_CM_uint8_enum 0.0 255.0 /end CHARACTERISTIC
/begin CHARACTERISTIC KOUTP_ADASDBSReq_enum_maxval "" VALUE 0x0000 /* @ECU_Address@KOUTP_ADASDBSReq_enum_maxval@ */ Scalar_UBYTE 0 SWC_OUTP_type_CM_uint8_enum 0.0 255.0 /end CHARACTERISTIC
/begin CHARACTERISTIC KOUTP_ADASDBSReq_enum_minval "" VALUE 0x0000 /* @ECU_Address@KOUTP_ADASDBSReq_enum_minval@ */ Scalar_UBYTE 0 SWC_OUTP_type_CM_uint8_enum 0.0 255.0 /end CHARACTERISTIC
/begin CHARACTERISTIC KOUTP_ADASDBSReq_enum_ovrdval "" VALUE 0x0000 /* @ECU_Address@KOUTP_ADASDBSReq_enum_ovrdval@ */ Scalar_UBYTE 0 SWC_OUTP_type_CM_uint8_enum 0.0 255.0 /end CHARACTERISTIC
/begin CHARACTERISTIC KOUTP_ADASFCWSta_enum_maxval "" VALUE 0x0000 /* @ECU_Address@KOUTP_ADASFCWSta_enum_maxval@ */ Scalar_UBYTE 0 SWC_OUTP_type_CM_uint8_enum 0.0 255.0 /end CHARACTERISTIC
/begin CHARACTERISTIC KOUTP_ADASFCWSta_enum_minval "" VALUE 0x0000 /* @ECU_Address@KOUTP_ADASFCWSta_enum_minval@ */ Scalar_UBYTE 0 SWC_OUTP_type_CM_uint8_enum 0.0 255.0 /end CHARACTERISTIC
/begin CHARACTERISTIC KOUTP_ADASFCWSta_enum_ovrdval "" VALUE 0x0000 /* @ECU_Address@KOUTP_ADASFCWSta_enum_ovrdval@ */ Scalar_UBYTE 0 SWC_OUTP_type_CM_uint8_enum 0.0 255.0 /end CHARACTERISTIC
/begin CHARACTERISTIC KOUTP_ADASISASta_enum_maxval "" VALUE 0x0000 /* @ECU_Address@KOUTP_ADASISASta_enum_maxval@ */ Scalar_UBYTE 0 SWC_OUTP_type_CM_uint8_enum 0.0 255.0 /end CHARACTERISTIC
/begin CHARACTERISTIC KOUTP_ADASISASta_enum_minval "" VALUE 0x0000 /* @ECU_Address@KOUTP_ADASISASta_enum_minval@ */ Scalar_UBYTE 0 SWC_OUTP_type_CM_uint8_enum 0.0 255.0 /end CHARACTERISTIC
/begin CHARACTERISTIC KOUTP_ADASISASta_enum_ovrdval "" VALUE 0x0000 /* @ECU_Address@KOUTP_ADASISASta_enum_ovrdval@ */ Scalar_UBYTE 0 SWC_OUTP_type_CM_uint8_enum 0.0 255.0 /end CHARACTERISTIC
/begin CHARACTERISTIC KOUTP_ADASLDWSta_enum_maxval "" VALUE 0x0000 /* @ECU_Address@KOUTP_ADASLDWSta_enum_maxval@ */ Scalar_UBYTE 0 SWC_OUTP_type_CM_uint8_enum 0.0 255.0 /end CHARACTERISTIC
/begin CHARACTERISTIC KOUTP_ADASLDWSta_enum_minval "" VALUE 0x0000 /* @ECU_Address@KOUTP_ADASLDWSta_enum_minval@ */ Scalar_UBYTE 0 SWC_OUTP_type_CM_uint8_enum 0.0 255.0 /end CHARACTERISTIC
/begin CHARACTERISTIC KOUTP_ADASLDWSta_enum_ovrdval "" VALUE 0x0000 /* @ECU_Address@KOUTP_ADASLDWSta_enum_ovrdval@ */ Scalar_UBYTE 0 SWC_OUTP_type_CM_uint8_enum 0.0 255.0 /end CHARACTERISTIC
/begin CHARACTERISTIC KOUTP_ADASLFCHandsOffWarning_enum_maxval "" VALUE 0x0000 /* @ECU_Address@KOUTP_ADASLFCHandsOffWarning_enum_maxval@ */ Scalar_UBYTE 0 SWC_OUTP_type_CM_uint8_enum 0.0 255.0 /end CHARACTERISTIC
/begin CHARACTERISTIC KOUTP_ADASLFCHandsOffWarning_enum_minval "" VALUE 0x0000 /* @ECU_Address@KOUTP_ADASLFCHandsOffWarning_enum_minval@ */ Scalar_UBYTE 0 SWC_OUTP_type_CM_uint8_enum 0.0 255.0 /end CHARACTERISTIC
/begin CHARACTERISTIC KOUTP_ADASLFCHandsOffWarning_enum_ovrdval "" VALUE 0x0000 /* @ECU_Address@KOUTP_ADASLFCHandsOffWarning_enum_ovrdval@ */ Scalar_UBYTE 0 SWC_OUTP_type_CM_uint8_enum 0.0 255.0 /end CHARACTERISTIC
/begin CHARACTERISTIC KOUTP_ADASLFCSta_enum_maxval "" VALUE 0x0000 /* @ECU_Address@KOUTP_ADASLFCSta_enum_maxval@ */ Scalar_UBYTE 0 SWC_OUTP_type_CM_uint8_enum 0.0 255.0 /end CHARACTERISTIC
/begin CHARACTERISTIC KOUTP_ADASLFCSta_enum_minval "" VALUE 0x0000 /* @ECU_Address@KOUTP_ADASLFCSta_enum_minval@ */ Scalar_UBYTE 0 SWC_OUTP_type_CM_uint8_enum 0.0 255.0 /end CHARACTERISTIC
/begin CHARACTERISTIC KOUTP_ADASLFCSta_enum_ovrdval "" VALUE 0x0000 /* @ECU_Address@KOUTP_ADASLFCSta_enum_ovrdval@ */ Scalar_UBYTE 0 SWC_OUTP_type_CM_uint8_enum 0.0 255.0 /end CHARACTERISTIC
/begin CHARACTERISTIC KOUTP_ADASLFCWarnSound_enum_maxval "" VALUE 0x0000 /* @ECU_Address@KOUTP_ADASLFCWarnSound_enum_maxval@ */ Scalar_UBYTE 0 SWC_OUTP_type_CM_uint8_enum 0.0 255.0 /end CHARACTERISTIC
/begin CHARACTERISTIC KOUTP_ADASLFCWarnSound_enum_minval "" VALUE 0x0000 /* @ECU_Address@KOUTP_ADASLFCWarnSound_enum_minval@ */ Scalar_UBYTE 0 SWC_OUTP_type_CM_uint8_enum 0.0 255.0 /end CHARACTERISTIC
/begin CHARACTERISTIC KOUTP_ADASLFCWarnSound_enum_ovrdval "" VALUE 0x0000 /* @ECU_Address@KOUTP_ADASLFCWarnSound_enum_ovrdval@ */ Scalar_UBYTE 0 SWC_OUTP_type_CM_uint8_enum 0.0 255.0 /end CHARACTERISTIC
/begin CHARACTERISTIC KOUTP_ADASLKASta_enum_maxval "" VALUE 0x0000 /* @ECU_Address@KOUTP_ADASLKASta_enum_maxval@ */ Scalar_UBYTE 0 SWC_OUTP_type_CM_uint8_enum 0.0 255.0 /end CHARACTERISTIC
/begin CHARACTERISTIC KOUTP_ADASLKASta_enum_minval "" VALUE 0x0000 /* @ECU_Address@KOUTP_ADASLKASta_enum_minval@ */ Scalar_UBYTE 0 SWC_OUTP_type_CM_uint8_enum 0.0 255.0 /end CHARACTERISTIC
/begin CHARACTERISTIC KOUTP_ADASLKASta_enum_ovrdval "" VALUE 0x0000 /* @ECU_Address@KOUTP_ADASLKASta_enum_ovrdval@ */ Scalar_UBYTE 0 SWC_OUTP_type_CM_uint8_enum 0.0 255.0 /end CHARACTERISTIC
/begin CHARACTERISTIC KOUTP_ADASLaneModeL_enum_maxval "" VALUE 0x0000 /* @ECU_Address@KOUTP_ADASLaneModeL_enum_maxval@ */ Scalar_UBYTE 0 SWC_OUTP_type_CM_uint8_enum 0.0 255.0 /end CHARACTERISTIC
/begin CHARACTERISTIC KOUTP_ADASLaneModeL_enum_minval "" VALUE 0x0000 /* @ECU_Address@KOUTP_ADASLaneModeL_enum_minval@ */ Scalar_UBYTE 0 SWC_OUTP_type_CM_uint8_enum 0.0 255.0 /end CHARACTERISTIC
/begin CHARACTERISTIC KOUTP_ADASLaneModeL_enum_ovrdval "" VALUE 0x0000 /* @ECU_Address@KOUTP_ADASLaneModeL_enum_ovrdval@ */ Scalar_UBYTE 0 SWC_OUTP_type_CM_uint8_enum 0.0 255.0 /end CHARACTERISTIC
/begin CHARACTERISTIC KOUTP_ADASLaneModeR_enum_maxval "" VALUE 0x0000 /* @ECU_Address@KOUTP_ADASLaneModeR_enum_maxval@ */ Scalar_UBYTE 0 SWC_OUTP_type_CM_uint8_enum 0.0 255.0 /end CHARACTERISTIC
/begin CHARACTERISTIC KOUTP_ADASLaneModeR_enum_minval "" VALUE 0x0000 /* @ECU_Address@KOUTP_ADASLaneModeR_enum_minval@ */ Scalar_UBYTE 0 SWC_OUTP_type_CM_uint8_enum 0.0 255.0 /end CHARACTERISTIC
/begin CHARACTERISTIC KOUTP_ADASLaneModeR_enum_ovrdval "" VALUE 0x0000 /* @ECU_Address@KOUTP_ADASLaneModeR_enum_ovrdval@ */ Scalar_UBYTE 0 SWC_OUTP_type_CM_uint8_enum 0.0 255.0 /end CHARACTERISTIC
/begin CHARACTERISTIC KOUTP_ADASLanetypeL_enum_maxval "" VALUE 0x0000 /* @ECU_Address@KOUTP_ADASLanetypeL_enum_maxval@ */ Scalar_UBYTE 0 SWC_OUTP_type_CM_uint8_enum 0.0 255.0 /end CHARACTERISTIC
/begin CHARACTERISTIC KOUTP_ADASLanetypeL_enum_minval "" VALUE 0x0000 /* @ECU_Address@KOUTP_ADASLanetypeL_enum_minval@ */ Scalar_UBYTE 0 SWC_OUTP_type_CM_uint8_enum 0.0 255.0 /end CHARACTERISTIC
/begin CHARACTERISTIC KOUTP_ADASLanetypeL_enum_ovrdval "" VALUE 0x0000 /* @ECU_Address@KOUTP_ADASLanetypeL_enum_ovrdval@ */ Scalar_UBYTE 0 SWC_OUTP_type_CM_uint8_enum 0.0 255.0 /end CHARACTERISTIC
/begin CHARACTERISTIC KOUTP_ADASLanetypeR_enum_maxval "" VALUE 0x0000 /* @ECU_Address@KOUTP_ADASLanetypeR_enum_maxval@ */ Scalar_UBYTE 0 SWC_OUTP_type_CM_uint8_enum 0.0 255.0 /end CHARACTERISTIC
/begin CHARACTERISTIC KOUTP_ADASLanetypeR_enum_minval "" VALUE 0x0000 /* @ECU_Address@KOUTP_ADASLanetypeR_enum_minval@ */ Scalar_UBYTE 0 SWC_OUTP_type_CM_uint8_enum 0.0 255.0 /end CHARACTERISTIC
/begin CHARACTERISTIC KOUTP_ADASLanetypeR_enum_ovrdval "" VALUE 0x0000 /* @ECU_Address@KOUTP_ADASLanetypeR_enum_ovrdval@ */ Scalar_UBYTE 0 SWC_OUTP_type_CM_uint8_enum 0.0 255.0 /end CHARACTERISTIC
/begin CHARACTERISTIC KOUTP_ADASSLIFSpdLim_enum_maxval "" VALUE 0x0000 /* @ECU_Address@KOUTP_ADASSLIFSpdLim_enum_maxval@ */ Scalar_UBYTE 0 SWC_OUTP_type_CM_uint8_enum 0.0 255.0 /end CHARACTERISTIC
/begin CHARACTERISTIC KOUTP_ADASSLIFSpdLim_enum_minval "" VALUE 0x0000 /* @ECU_Address@KOUTP_ADASSLIFSpdLim_enum_minval@ */ Scalar_UBYTE 0 SWC_OUTP_type_CM_uint8_enum 0.0 255.0 /end CHARACTERISTIC
/begin CHARACTERISTIC KOUTP_ADASSLIFSpdLim_enum_ovrdval "" VALUE 0x0000 /* @ECU_Address@KOUTP_ADASSLIFSpdLim_enum_ovrdval@ */ Scalar_UBYTE 0 SWC_OUTP_type_CM_uint8_enum 0.0 255.0 /end CHARACTERISTIC
/begin CHARACTERISTIC KOUTP_ADASSLIFSta_enum_maxval "" VALUE 0x0000 /* @ECU_Address@KOUTP_ADASSLIFSta_enum_maxval@ */ Scalar_UBYTE 0 SWC_OUTP_type_CM_uint8_enum 0.0 255.0 /end CHARACTERISTIC
/begin CHARACTERISTIC KOUTP_ADASSLIFSta_enum_minval "" VALUE 0x0000 /* @ECU_Address@KOUTP_ADASSLIFSta_enum_minval@ */ Scalar_UBYTE 0 SWC_OUTP_type_CM_uint8_enum 0.0 255.0 /end CHARACTERISTIC
/begin CHARACTERISTIC KOUTP_ADASSLIFSta_enum_ovrdval "" VALUE 0x0000 /* @ECU_Address@KOUTP_ADASSLIFSta_enum_ovrdval@ */ Scalar_UBYTE 0 SWC_OUTP_type_CM_uint8_enum 0.0 255.0 /end CHARACTERISTIC
/begin CHARACTERISTIC KOUTP_ADASShftPosnReq_enum_maxval "" VALUE 0x0000 /* @ECU_Address@KOUTP_ADASShftPosnReq_enum_maxval@ */ Scalar_UBYTE 0 SWC_OUTP_type_CM_uint8_enum 0.0 255.0 /end CHARACTERISTIC
/begin CHARACTERISTIC KOUTP_ADASShftPosnReq_enum_minval "" VALUE 0x0000 /* @ECU_Address@KOUTP_ADASShftPosnReq_enum_minval@ */ Scalar_UBYTE 0 SWC_OUTP_type_CM_uint8_enum 0.0 255.0 /end CHARACTERISTIC
/begin CHARACTERISTIC KOUTP_ADASShftPosnReq_enum_ovrdval "" VALUE 0x0000 /* @ECU_Address@KOUTP_ADASShftPosnReq_enum_ovrdval@ */ Scalar_UBYTE 0 SWC_OUTP_type_CM_uint8_enum 0.0 255.0 /end CHARACTERISTIC
/begin CHARACTERISTIC KOUTP_ADASWarningMsg_enum_maxval "" VALUE 0x0000 /* @ECU_Address@KOUTP_ADASWarningMsg_enum_maxval@ */ Scalar_UBYTE 0 SWC_OUTP_type_CM_uint8_enum 0.0 255.0 /end CHARACTERISTIC
/begin CHARACTERISTIC KOUTP_ADASWarningMsg_enum_minval "" VALUE 0x0000 /* @ECU_Address@KOUTP_ADASWarningMsg_enum_minval@ */ Scalar_UBYTE 0 SWC_OUTP_type_CM_uint8_enum 0.0 255.0 /end CHARACTERISTIC
/begin CHARACTERISTIC KOUTP_ADASWarningMsg_enum_ovrdval "" VALUE 0x0000 /* @ECU_Address@KOUTP_ADASWarningMsg_enum_ovrdval@ */ Scalar_UBYTE 0 SWC_OUTP_type_CM_uint8_enum 0.0 255.0 /end CHARACTERISTIC
/begin CHARACTERISTIC KOUTP_APSReq_enum_maxval "" VALUE 0x0000 /* @ECU_Address@KOUTP_APSReq_enum_maxval@ */ Scalar_UBYTE 0 SWC_OUTP_type_CM_uint8_enum 0.0 255.0 /end CHARACTERISTIC
/begin CHARACTERISTIC KOUTP_APSReq_enum_minval "" VALUE 0x0000 /* @ECU_Address@KOUTP_APSReq_enum_minval@ */ Scalar_UBYTE 0 SWC_OUTP_type_CM_uint8_enum 0.0 255.0 /end CHARACTERISTIC
/begin CHARACTERISTIC KOUTP_APSReq_enum_ovrdval "" VALUE 0x0000 /* @ECU_Address@KOUTP_APSReq_enum_ovrdval@ */ Scalar_UBYTE 0 SWC_OUTP_type_CM_uint8_enum 0.0 255.0 /end CHARACTERISTIC
/begin CHARACTERISTIC KOUTP_APSStaSys_enum_maxval "" VALUE 0x0000 /* @ECU_Address@KOUTP_APSStaSys_enum_maxval@ */ Scalar_UBYTE 0 SWC_OUTP_type_CM_uint8_enum 0.0 255.0 /end CHARACTERISTIC
/begin CHARACTERISTIC KOUTP_APSStaSys_enum_minval "" VALUE 0x0000 /* @ECU_Address@KOUTP_APSStaSys_enum_minval@ */ Scalar_UBYTE 0 SWC_OUTP_type_CM_uint8_enum 0.0 255.0 /end CHARACTERISTIC
/begin CHARACTERISTIC KOUTP_APSStaSys_enum_ovrdval "" VALUE 0x0000 /* @ECU_Address@KOUTP_APSStaSys_enum_ovrdval@ */ Scalar_UBYTE 0 SWC_OUTP_type_CM_uint8_enum 0.0 255.0 /end CHARACTERISTIC
/begin CHARACTERISTIC KOUTP_CCCtrlSta_enum_maxval "" VALUE 0x0000 /* @ECU_Address@KOUTP_CCCtrlSta_enum_maxval@ */ Scalar_UBYTE 0 SWC_OUTP_type_CM_uint8_enum 0.0 255.0 /end CHARACTERISTIC
/begin CHARACTERISTIC KOUTP_CCCtrlSta_enum_minval "" VALUE 0x0000 /* @ECU_Address@KOUTP_CCCtrlSta_enum_minval@ */ Scalar_UBYTE 0 SWC_OUTP_type_CM_uint8_enum 0.0 255.0 /end CHARACTERISTIC
/begin CHARACTERISTIC KOUTP_CCCtrlSta_enum_ovrdval "" VALUE 0x0000 /* @ECU_Address@KOUTP_CCCtrlSta_enum_ovrdval@ */ Scalar_UBYTE 0 SWC_OUTP_type_CM_uint8_enum 0.0 255.0 /end CHARACTERISTIC
/begin CHARACTERISTIC KOUTP_ExtraMSACtrlSta_enum_maxval "" VALUE 0x0000 /* @ECU_Address@KOUTP_ExtraMSACtrlSta_enum_maxval@ */ Scalar_UBYTE 0 SWC_OUTP_type_CM_uint8_enum 0.0 255.0 /end CHARACTERISTIC
/begin CHARACTERISTIC KOUTP_ExtraMSACtrlSta_enum_minval "" VALUE 0x0000 /* @ECU_Address@KOUTP_ExtraMSACtrlSta_enum_minval@ */ Scalar_UBYTE 0 SWC_OUTP_type_CM_uint8_enum 0.0 255.0 /end CHARACTERISTIC
/begin CHARACTERISTIC KOUTP_ExtraMSACtrlSta_enum_ovrdval "" VALUE 0x0000 /* @ECU_Address@KOUTP_ExtraMSACtrlSta_enum_ovrdval@ */ Scalar_UBYTE 0 SWC_OUTP_type_CM_uint8_enum 0.0 255.0 /end CHARACTERISTIC
/begin CHARACTERISTIC KOUTP_FCMACCmode_enum_maxval "" VALUE 0x0000 /* @ECU_Address@KOUTP_FCMACCmode_enum_maxval@ */ Scalar_UBYTE 0 SWC_OUTP_type_CM_uint8_enum 0.0 255.0 /end CHARACTERISTIC
/begin CHARACTERISTIC KOUTP_FCMACCmode_enum_minval "" VALUE 0x0000 /* @ECU_Address@KOUTP_FCMACCmode_enum_minval@ */ Scalar_UBYTE 0 SWC_OUTP_type_CM_uint8_enum 0.0 255.0 /end CHARACTERISTIC
/begin CHARACTERISTIC KOUTP_FCMACCmode_enum_ovrdval "" VALUE 0x0000 /* @ECU_Address@KOUTP_FCMACCmode_enum_ovrdval@ */ Scalar_UBYTE 0 SWC_OUTP_type_CM_uint8_enum 0.0 255.0 /end CHARACTERISTIC
/begin CHARACTERISTIC KOUTP_FCMLDWRequest_enum_maxval "" VALUE 0x0000 /* @ECU_Address@KOUTP_FCMLDWRequest_enum_maxval@ */ Scalar_UBYTE 0 SWC_OUTP_type_CM_uint8_enum 0.0 255.0 /end CHARACTERISTIC
/begin CHARACTERISTIC KOUTP_FCMLDWRequest_enum_minval "" VALUE 0x0000 /* @ECU_Address@KOUTP_FCMLDWRequest_enum_minval@ */ Scalar_UBYTE 0 SWC_OUTP_type_CM_uint8_enum 0.0 255.0 /end CHARACTERISTIC
/begin CHARACTERISTIC KOUTP_FCMLDWRequest_enum_ovrdval "" VALUE 0x0000 /* @ECU_Address@KOUTP_FCMLDWRequest_enum_ovrdval@ */ Scalar_UBYTE 0 SWC_OUTP_type_CM_uint8_enum 0.0 255.0 /end CHARACTERISTIC
/begin CHARACTERISTIC KOUTP_FeatArbitrFinal_enum_maxval "" VALUE 0x0000 /* @ECU_Address@KOUTP_FeatArbitrFinal_enum_maxval@ */ Scalar_UBYTE 0 SWC_OUTP_type_CM_uint8_enum 0.0 255.0 /end CHARACTERISTIC
/begin CHARACTERISTIC KOUTP_FeatArbitrFinal_enum_minval "" VALUE 0x0000 /* @ECU_Address@KOUTP_FeatArbitrFinal_enum_minval@ */ Scalar_UBYTE 0 SWC_OUTP_type_CM_uint8_enum 0.0 255.0 /end CHARACTERISTIC
/begin CHARACTERISTIC KOUTP_FeatArbitrFinal_enum_ovrdval "" VALUE 0x0000 /* @ECU_Address@KOUTP_FeatArbitrFinal_enum_ovrdval@ */ Scalar_UBYTE 0 SWC_OUTP_type_CM_uint8_enum 0.0 255.0 /end CHARACTERISTIC
/begin CHARACTERISTIC KOUTP_FeatArbitrSta_enum_maxval "" VALUE 0x0000 /* @ECU_Address@KOUTP_FeatArbitrSta_enum_maxval@ */ Scalar_UBYTE 0 SWC_OUTP_type_CM_uint8_enum 0.0 255.0 /end CHARACTERISTIC
/begin CHARACTERISTIC KOUTP_FeatArbitrSta_enum_minval "" VALUE 0x0000 /* @ECU_Address@KOUTP_FeatArbitrSta_enum_minval@ */ Scalar_UBYTE 0 SWC_OUTP_type_CM_uint8_enum 0.0 255.0 /end CHARACTERISTIC
/begin CHARACTERISTIC KOUTP_FeatArbitrSta_enum_ovrdval "" VALUE 0x0000 /* @ECU_Address@KOUTP_FeatArbitrSta_enum_ovrdval@ */ Scalar_UBYTE 0 SWC_OUTP_type_CM_uint8_enum 0.0 255.0 /end CHARACTERISTIC
/begin CHARACTERISTIC KOUTP_ForceLowBeam_enum_maxval "" VALUE 0x0000 /* @ECU_Address@KOUTP_ForceLowBeam_enum_maxval@ */ Scalar_UBYTE 0 SWC_OUTP_type_CM_uint8_enum 0.0 255.0 /end CHARACTERISTIC
/begin CHARACTERISTIC KOUTP_ForceLowBeam_enum_minval "" VALUE 0x0000 /* @ECU_Address@KOUTP_ForceLowBeam_enum_minval@ */ Scalar_UBYTE 0 SWC_OUTP_type_CM_uint8_enum 0.0 255.0 /end CHARACTERISTIC
/begin CHARACTERISTIC KOUTP_ForceLowBeam_enum_ovrdval "" VALUE 0x0000 /* @ECU_Address@KOUTP_ForceLowBeam_enum_ovrdval@ */ Scalar_UBYTE 0 SWC_OUTP_type_CM_uint8_enum 0.0 255.0 /end CHARACTERISTIC
/begin CHARACTERISTIC KOUTP_LKATOIAct_enum_maxval "" VALUE 0x0000 /* @ECU_Address@KOUTP_LKATOIAct_enum_maxval@ */ Scalar_UBYTE 0 SWC_OUTP_type_CM_uint8_enum 0.0 255.0 /end CHARACTERISTIC
/begin CHARACTERISTIC KOUTP_LKATOIAct_enum_minval "" VALUE 0x0000 /* @ECU_Address@KOUTP_LKATOIAct_enum_minval@ */ Scalar_UBYTE 0 SWC_OUTP_type_CM_uint8_enum 0.0 255.0 /end CHARACTERISTIC
/begin CHARACTERISTIC KOUTP_LKATOIAct_enum_ovrdval "" VALUE 0x0000 /* @ECU_Address@KOUTP_LKATOIAct_enum_ovrdval@ */ Scalar_UBYTE 0 SWC_OUTP_type_CM_uint8_enum 0.0 255.0 /end CHARACTERISTIC
/begin CHARACTERISTIC KOUTP_LVDAMuteSta_enum_maxval "" VALUE 0x0000 /* @ECU_Address@KOUTP_LVDAMuteSta_enum_maxval@ */ Scalar_UBYTE 0 SWC_OUTP_type_CM_uint8_enum 0.0 255.0 /end CHARACTERISTIC
/begin CHARACTERISTIC KOUTP_LVDAMuteSta_enum_minval "" VALUE 0x0000 /* @ECU_Address@KOUTP_LVDAMuteSta_enum_minval@ */ Scalar_UBYTE 0 SWC_OUTP_type_CM_uint8_enum 0.0 255.0 /end CHARACTERISTIC
/begin CHARACTERISTIC KOUTP_LVDAMuteSta_enum_ovrdval "" VALUE 0x0000 /* @ECU_Address@KOUTP_LVDAMuteSta_enum_ovrdval@ */ Scalar_UBYTE 0 SWC_OUTP_type_CM_uint8_enum 0.0 255.0 /end CHARACTERISTIC
/begin CHARACTERISTIC KOUTP_MSACtrlSta_enum_maxval "" VALUE 0x0000 /* @ECU_Address@KOUTP_MSACtrlSta_enum_maxval@ */ Scalar_UBYTE 0 SWC_OUTP_type_CM_uint8_enum 0.0 255.0 /end CHARACTERISTIC
/begin CHARACTERISTIC KOUTP_MSACtrlSta_enum_minval "" VALUE 0x0000 /* @ECU_Address@KOUTP_MSACtrlSta_enum_minval@ */ Scalar_UBYTE 0 SWC_OUTP_type_CM_uint8_enum 0.0 255.0 /end CHARACTERISTIC
/begin CHARACTERISTIC KOUTP_MSACtrlSta_enum_ovrdval "" VALUE 0x0000 /* @ECU_Address@KOUTP_MSACtrlSta_enum_ovrdval@ */ Scalar_UBYTE 0 SWC_OUTP_type_CM_uint8_enum 0.0 255.0 /end CHARACTERISTIC
/begin CHARACTERISTIC KOUTP_ReqOBCExtrV2LEna_enum_ovrdval "" VALUE 0x0000 /* @ECU_Address@KOUTP_ReqOBCExtrV2LEna_enum_ovrdval@ */ Scalar_UBYTE 0 SWC_OUTP_type_CM_uint8_enum 0.0 255.0 /end CHARACTERISTIC
/begin CHARACTERISTIC KOUTP_ReqOBCIntrV2LEna_enum_maxval "" VALUE 0x0000 /* @ECU_Address@KOUTP_ReqOBCIntrV2LEna_enum_maxval@ */ Scalar_UBYTE 0 SWC_OUTP_type_CM_uint8_enum 0.0 255.0 /end CHARACTERISTIC
/begin CHARACTERISTIC KOUTP_ReqOBCIntrV2LEna_enum_minval "" VALUE 0x0000 /* @ECU_Address@KOUTP_ReqOBCIntrV2LEna_enum_minval@ */ Scalar_UBYTE 0 SWC_OUTP_type_CM_uint8_enum 0.0 255.0 /end CHARACTERISTIC
/begin CHARACTERISTIC KOUTP_ReqOBCIntrV2LEna_enum_ovrdval "" VALUE 0x0000 /* @ECU_Address@KOUTP_ReqOBCIntrV2LEna_enum_ovrdval@ */ Scalar_UBYTE 0 SWC_OUTP_type_CM_uint8_enum 0.0 255.0 /end CHARACTERISTIC
/begin CHARACTERISTIC KOUTP_ReqOBCV2LEna_enum_maxval "" VALUE 0x0000 /* @ECU_Address@KOUTP_ReqOBCV2LEna_enum_maxval@ */ Scalar_UBYTE 0 SWC_OUTP_type_CM_uint8_enum 0.0 255.0 /end CHARACTERISTIC
/begin CHARACTERISTIC KOUTP_ReqOBCV2LEna_enum_minval "" VALUE 0x0000 /* @ECU_Address@KOUTP_ReqOBCV2LEna_enum_minval@ */ Scalar_UBYTE 0 SWC_OUTP_type_CM_uint8_enum 0.0 255.0 /end CHARACTERISTIC
/begin CHARACTERISTIC KOUTP_ReqOBCV2LEna_enum_ovrdval "" VALUE 0x0000 /* @ECU_Address@KOUTP_ReqOBCV2LEna_enum_ovrdval@ */ Scalar_UBYTE 0 SWC_OUTP_type_CM_uint8_enum 0.0 255.0 /end CHARACTERISTIC
/begin CHARACTERISTIC KOUTP_ReqV2LIVIDisChrg_enum_maxval "" VALUE 0x0000 /* @ECU_Address@KOUTP_ReqV2LIVIDisChrg_enum_maxval@ */ Scalar_UBYTE 0 SWC_OUTP_type_CM_uint8_enum 0.0 255.0 /end CHARACTERISTIC
/begin CHARACTERISTIC KOUTP_ReqV2LIVIDisChrg_enum_minval "" VALUE 0x0000 /* @ECU_Address@KOUTP_ReqV2LIVIDisChrg_enum_minval@ */ Scalar_UBYTE 0 SWC_OUTP_type_CM_uint8_enum 0.0 255.0 /end CHARACTERISTIC
/begin CHARACTERISTIC KOUTP_ReqV2LIVIDisChrg_enum_ovrdval "" VALUE 0x0000 /* @ECU_Address@KOUTP_ReqV2LIVIDisChrg_enum_ovrdval@ */ Scalar_UBYTE 0 SWC_OUTP_type_CM_uint8_enum 0.0 255.0 /end CHARACTERISTIC
/begin CHARACTERISTIC KOUTP_ReqV2LIVIPopup_enum_maxval "" VALUE 0x0000 /* @ECU_Address@KOUTP_ReqV2LIVIPopup_enum_maxval@ */ Scalar_UBYTE 0 SWC_OUTP_type_CM_uint8_enum 0.0 255.0 /end CHARACTERISTIC
/begin CHARACTERISTIC KOUTP_ReqV2LIVIPopup_enum_minval "" VALUE 0x0000 /* @ECU_Address@KOUTP_ReqV2LIVIPopup_enum_minval@ */ Scalar_UBYTE 0 SWC_OUTP_type_CM_uint8_enum 0.0 255.0 /end CHARACTERISTIC
/begin CHARACTERISTIC KOUTP_ReqV2LIVIPopup_enum_ovrdval "" VALUE 0x0000 /* @ECU_Address@KOUTP_ReqV2LIVIPopup_enum_ovrdval@ */ Scalar_UBYTE 0 SWC_OUTP_type_CM_uint8_enum 0.0 255.0 /end CHARACTERISTIC
/begin CHARACTERISTIC KOUTP_TargetType_enum_maxval "" VALUE 0x0000 /* @ECU_Address@KOUTP_TargetType_enum_maxval@ */ Scalar_UBYTE 0 SWC_OUTP_type_CM_uint8_enum 0.0 255.0 /end CHARACTERISTIC
/begin CHARACTERISTIC KOUTP_TargetType_enum_minval "" VALUE 0x0000 /* @ECU_Address@KOUTP_TargetType_enum_minval@ */ Scalar_UBYTE 0 SWC_OUTP_type_CM_uint8_enum 0.0 255.0 /end CHARACTERISTIC
/begin CHARACTERISTIC KOUTP_TargetType_enum_ovrdval "" VALUE 0x0000 /* @ECU_Address@KOUTP_TargetType_enum_ovrdval@ */ Scalar_UBYTE 0 SWC_OUTP_type_CM_uint8_enum 0.0 255.0 /end CHARACTERISTIC
/begin CHARACTERISTIC KOUTP_TimeGapLevel_enum_maxval "" VALUE 0x0000 /* @ECU_Address@KOUTP_TimeGapLevel_enum_maxval@ */ Scalar_UBYTE 0 SWC_OUTP_type_CM_uint8_enum 0.0 255.0 /end CHARACTERISTIC
/begin CHARACTERISTIC KOUTP_TimeGapLevel_enum_minval "" VALUE 0x0000 /* @ECU_Address@KOUTP_TimeGapLevel_enum_minval@ */ Scalar_UBYTE 0 SWC_OUTP_type_CM_uint8_enum 0.0 255.0 /end CHARACTERISTIC
/begin CHARACTERISTIC KOUTP_TimeGapLevel_enum_ovrdval "" VALUE 0x0000 /* @ECU_Address@KOUTP_TimeGapLevel_enum_ovrdval@ */ Scalar_UBYTE 0 SWC_OUTP_type_CM_uint8_enum 0.0 255.0 /end CHARACTERISTIC
/begin COMPU_METHOD SWC_OUTP_type_CM_single_mps2 "Q = V" RAT_FUNC "%8.6" "mps2" COEFFS 0 1 0 0 0 1 /end COMPU_METHOD
/begin COMPU_METHOD SWC_OUTP_type_CM_single_mps3 "Q = V" RAT_FUNC "%8.6" "mps3" COEFFS 0 1 0 0 0 1 /end COMPU_METHOD
/begin COMPU_METHOD SWC_OUTP_type_CM_single_m "Q = V" RAT_FUNC "%8.6" "m" COEFFS 0 1 0 0 0 1 /end COMPU_METHOD
/begin COMPU_METHOD SWC_OUTP_type_CM_single_mps "Q = V" RAT_FUNC "%8.6" "mps" COEFFS 0 1 0 0 0 1 /end COMPU_METHOD
/begin COMPU_METHOD SWC_OUTP_type_CM_single_raw32 "Q = V" RAT_FUNC "%8.6" "raw32" COEFFS 0 1 0 0 0 1 /end COMPU_METHOD
/begin COMPU_METHOD SWC_OUTP_type_CM_single_pct "Q = V" RAT_FUNC "%8.6" "pct" COEFFS 0 1 0 0 0 1 /end COMPU_METHOD
/begin COMPU_METHOD SWC_OUTP_type_CM_single_kph "Q = V" RAT_FUNC "%8.6" "kph" COEFFS 0 1 0 0 0 1 /end COMPU_METHOD
/begin COMPU_METHOD SWC_OUTP_type_CM_single_Gps "Q = V" RAT_FUNC "%8.6" "Gps" COEFFS 0 1 0 0 0 1 /end COMPU_METHOD
/begin COMPU_METHOD SWC_OUTP_type_CM_single_G "Q = V" RAT_FUNC "%8.6" "G" COEFFS 0 1 0 0 0 1 /end COMPU_METHOD
/begin COMPU_METHOD SWC_OUTP_type_CM_single_dps "Q = V" RAT_FUNC "%8.6" "dps" COEFFS 0 1 0 0 0 1 /end COMPU_METHOD
/begin COMPU_METHOD SWC_OUTP_type_CM_single_Dps "Q = V" RAT_FUNC "%8.6" "Dps" COEFFS 0 1 0 0 0 1 /end COMPU_METHOD
/begin COMPU_METHOD SWC_OUTP_type_CM_single_s "Q = V" RAT_FUNC "%8.6" "s" COEFFS 0 1 0 0 0 1 /end COMPU_METHOD
/begin COMPU_METHOD SWC_OUTP_type_CM_single_Nm "Q = V" RAT_FUNC "%8.6" "Nm" COEFFS 0 1 0 0 0 1 /end COMPU_METHOD
/begin COMPU_METHOD SWC_OUTP_type_CM_single_deg "Q = V" RAT_FUNC "%8.6" "deg" COEFFS 0 1 0 0 0 1 /end COMPU_METHOD
/begin COMPU_METHOD SWC_OUTP_type_CM_single_mph "Q = V" RAT_FUNC "%8.6" "mph" COEFFS 0 1 0 0 0 1 /end COMPU_METHOD
/begin COMPU_METHOD SWC_OUTP_type_CM_boolean_flg "Q = V" RAT_FUNC "%1.0" "flg" COEFFS 0 1 0 0 0 1 /end COMPU_METHOD
/begin COMPU_METHOD SWC_OUTP_type_CM_uint8_enum "Q = V" RAT_FUNC "%3.0" "enum" COEFFS 0 1 0 0 0 1 /end COMPU_METHOD
/begin GROUP S842_Signal_Override "SWC_OUTP_type/run_SWC_OUTP_5ms_sys/OUTP/outpmodule/VV2L_ReqOBCExtrV2LEna_enum_Inproc/Signal_Override"
 /begin REF_CHARACTERISTIC KOUTP_ReqOBCExtrV2LEna_enum_ovrdflg KOUTP_ReqOBCExtrV2LEna_enum_ovrdval /end REF_CHARACTERISTIC
/end GROUP
/begin GROUP S843_Signal_Limit "SWC_OUTP_type/run_SWC_OUTP_5ms_sys/OUTP/outpmodule/VV2L_ReqOBCIntrV2LEna_enum_Inproc/Signal_Limit"
 /begin REF_CHARACTERISTIC KOUTP_ReqOBCIntrV2LEna_enum_maxval KOUTP_ReqOBCIntrV2LEna_enum_minval /end REF_CHARACTERISTIC
/end GROUP
/begin GROUP S843_Signal_Override "SWC_OUTP_type/run_SWC_OUTP_5ms_sys/OUTP/outpmodule/VV2L_ReqOBCIntrV2LEna_enum_Inproc/Signal_Override"
 /begin REF_CHARACTERISTIC KOUTP_ReqOBCIntrV2LEna_enum_ovrdflg KOUTP_ReqOBCIntrV2LEna_enum_ovrdval /end REF_CHARACTERISTIC
/end GROUP
/begin GROUP S844_Signal_Limit "SWC_OUTP_type/run_SWC_OUTP_5ms_sys/OUTP/outpmodule/VV2L_ReqOBCV2LEna_enum_Inproc/Signal_Limit"
 /begin REF_CHARACTERISTIC KOUTP_ReqOBCV2LEna_enum_maxval KOUTP_ReqOBCV2LEna_enum_minval /end REF_CHARACTERISTIC
/end GROUP
/begin GROUP S844_Signal_Override "SWC_OUTP_type/run_SWC_OUTP_5ms_sys/OUTP/outpmodule/VV2L_ReqOBCV2LEna_enum_Inproc/Signal_Override"
 /begin REF_CHARACTERISTIC KOUTP_ReqOBCV2LEna_enum_ovrdflg KOUTP_ReqOBCV2LEna_enum_ovrdval /end REF_CHARACTERISTIC
/end GROUP
/begin GROUP S845_Signal_Limit "SWC_OUTP_type/run_SWC_OUTP_5ms_sys/OUTP/outpmodule/VV2L_ReqV2LIVIDisChrg_enum_Inproc/Signal_Limit"
 /begin REF_CHARACTERISTIC KOUTP_ReqV2LIVIDisChrg_enum_maxval KOUTP_ReqV2LIVIDisChrg_enum_minval /end REF_CHARACTERISTIC
/end GROUP
/begin GROUP S845_Signal_Override "SWC_OUTP_type/run_SWC_OUTP_5ms_sys/OUTP/outpmodule/VV2L_ReqV2LIVIDisChrg_enum_Inproc/Signal_Override"
 /begin REF_CHARACTERISTIC KOUTP_ReqV2LIVIDisChrg_enum_ovrdflg KOUTP_ReqV2LIVIDisChrg_enum_ovrdval /end REF_CHARACTERISTIC
/end GROUP
/begin GROUP S846_Signal_Limit "SWC_OUTP_type/run_SWC_OUTP_5ms_sys/OUTP/outpmodule/VV2L_ReqV2LIVIPopup_enum_Inproc/Signal_Limit"
 /begin REF_CHARACTERISTIC KOUTP_ReqV2LIVIPopup_enum_maxval KOUTP_ReqV2LIVIPopup_enum_minval /end REF_CHARACTERISTIC
/end GROUP
/begin GROUP S846_Signal_Override "SWC_OUTP_type/run_SWC_OUTP_5ms_sys/OUTP/outpmodule/VV2L_ReqV2LIVIPopup_enum_Inproc/Signal_Override"
 /begin REF_CHARACTERISTIC KOUTP_ReqV2LIVIPopup_enum_ovrdflg KOUTP_ReqV2LIVIPopup_enum_ovrdval /end REF_CHARACTERISTIC
/end GROUP
/begin GROUP S847_Signal_Limit "SWC_OUTP_type/run_SWC_OUTP_5ms_sys/OUTP/outpmodule/VVMC_ACCComfortBandLower_mps2_Inproc/Signal_Limit"
 /begin REF_CHARACTERISTIC KOUTP_ACCComfortBandLower_mps2_maxval KOUTP_ACCComfortBandLower_mps2_minval /end REF_CHARACTERISTIC
/end GROUP
/begin GROUP S847_Signal_Override "SWC_OUTP_type/run_SWC_OUTP_5ms_sys/OUTP/outpmodule/VVMC_ACCComfortBandLower_mps2_Inproc/Signal_Override"
 /begin REF_CHARACTERISTIC KOUTP_ACCComfortBandLower_mps2_ovrdflg KOUTP_ACCComfortBandLower_mps2_ovrdval /end REF_CHARACTERISTIC
/end GROUP
/begin GROUP S848_Signal_Limit "SWC_OUTP_type/run_SWC_OUTP_5ms_sys/OUTP/outpmodule/VVMC_ACCComfortBandUpper_mps2_Inproc/Signal_Limit"
 /begin REF_CHARACTERISTIC KOUTP_ACCComfortBandUpper_mps2_maxval KOUTP_ACCComfortBandUpper_mps2_minval /end REF_CHARACTERISTIC
/end GROUP
/begin GROUP S848_Signal_Override "SWC_OUTP_type/run_SWC_OUTP_5ms_sys/OUTP/outpmodule/VVMC_ACCComfortBandUpper_mps2_Inproc/Signal_Override"
 /begin REF_CHARACTERISTIC KOUTP_ACCComfortBandUpper_mps2_ovrdflg KOUTP_ACCComfortBandUpper_mps2_ovrdval /end REF_CHARACTERISTIC
/end GROUP
/begin GROUP S849_Signal_Limit "SWC_OUTP_type/run_SWC_OUTP_5ms_sys/OUTP/outpmodule/VVMC_ACCCtrlAvail_flg_Inproc/Signal_Limit"
 /begin REF_CHARACTERISTIC KOUTP_ACCCtrlAvail_flg_maxval KOUTP_ACCCtrlAvail_flg_minval /end REF_CHARACTERISTIC
/end GROUP
/begin GROUP S849_Signal_Override "SWC_OUTP_type/run_SWC_OUTP_5ms_sys/OUTP/outpmodule/VVMC_ACCCtrlAvail_flg_Inproc/Signal_Override"
 /begin REF_CHARACTERISTIC KOUTP_ACCCtrlAvail_flg_ovrdflg KOUTP_ACCCtrlAvail_flg_ovrdval /end REF_CHARACTERISTIC
/end GROUP
/begin GROUP S850_Signal_Limit "SWC_OUTP_type/run_SWC_OUTP_5ms_sys/OUTP/outpmodule/VVMC_ACCJerkLowerLimit_mps3_Inproc/Signal_Limit"
 /begin REF_CHARACTERISTIC KOUTP_ACCJerkLowerLimit_mps3_maxval KOUTP_ACCJerkLowerLimit_mps3_minval /end REF_CHARACTERISTIC
/end GROUP
/begin GROUP S850_Signal_Override "SWC_OUTP_type/run_SWC_OUTP_5ms_sys/OUTP/outpmodule/VVMC_ACCJerkLowerLimit_mps3_Inproc/Signal_Override"
 /begin REF_CHARACTERISTIC KOUTP_ACCJerkLowerLimit_mps3_ovrdflg KOUTP_ACCJerkLowerLimit_mps3_ovrdval /end REF_CHARACTERISTIC
/end GROUP
/begin GROUP S851_Signal_Limit "SWC_OUTP_type/run_SWC_OUTP_5ms_sys/OUTP/outpmodule/VVMC_ACCJerkUpperLimit_mps3_Inproc/Signal_Limit"
 /begin REF_CHARACTERISTIC KOUTP_ACCJerkUpperLimit_mps3_maxval KOUTP_ACCJerkUpperLimit_mps3_minval /end REF_CHARACTERISTIC
/end GROUP
/begin GROUP S851_Signal_Override "SWC_OUTP_type/run_SWC_OUTP_5ms_sys/OUTP/outpmodule/VVMC_ACCJerkUpperLimit_mps3_Inproc/Signal_Override"
 /begin REF_CHARACTERISTIC KOUTP_ACCJerkUpperLimit_mps3_ovrdflg KOUTP_ACCJerkUpperLimit_mps3_ovrdval /end REF_CHARACTERISTIC
/end GROUP
/begin GROUP S852_Signal_Limit "SWC_OUTP_type/run_SWC_OUTP_5ms_sys/OUTP/outpmodule/VVMC_ACCObjDist_m_Inproc/Signal_Limit" /begin REF_CHARACTERISTIC KOUTP_ACCObjDist_m_maxval KOUTP_ACCObjDist_m_minval /end REF_CHARACTERISTIC /end GROUP
/begin GROUP S852_Signal_Override "SWC_OUTP_type/run_SWC_OUTP_5ms_sys/OUTP/outpmodule/VVMC_ACCObjDist_m_Inproc/Signal_Override" /begin REF_CHARACTERISTIC KOUTP_ACCObjDist_m_ovrdflg KOUTP_ACCObjDist_m_ovrdval /end REF_CHARACTERISTIC /end GROUP
/begin GROUP S853_Signal_Limit "SWC_OUTP_type/run_SWC_OUTP_5ms_sys/OUTP/outpmodule/VVMC_ACCObjDstLvl_enum_Inproc/Signal_Limit"
 /begin REF_CHARACTERISTIC KOUTP_ACCObjDstLvl_enum_maxval KOUTP_ACCObjDstLvl_enum_minval /end REF_CHARACTERISTIC
/end GROUP
/begin GROUP S853_Signal_Override "SWC_OUTP_type/run_SWC_OUTP_5ms_sys/OUTP/outpmodule/VVMC_ACCObjDstLvl_enum_Inproc/Signal_Override"
 /begin REF_CHARACTERISTIC KOUTP_ACCObjDstLvl_enum_ovrdflg KOUTP_ACCObjDstLvl_enum_ovrdval /end REF_CHARACTERISTIC
/end GROUP
/begin GROUP S854_Signal_Limit "SWC_OUTP_type/run_SWC_OUTP_5ms_sys/OUTP/outpmodule/VVMC_ACCObjRelSpd_mps_Inproc/Signal_Limit"
 /begin REF_CHARACTERISTIC KOUTP_ACCObjRelSpd_mps_maxval KOUTP_ACCObjRelSpd_mps_minval /end REF_CHARACTERISTIC
/end GROUP
/begin GROUP S854_Signal_Override "SWC_OUTP_type/run_SWC_OUTP_5ms_sys/OUTP/outpmodule/VVMC_ACCObjRelSpd_mps_Inproc/Signal_Override"
 /begin REF_CHARACTERISTIC KOUTP_ACCObjRelSpd_mps_ovrdflg KOUTP_ACCObjRelSpd_mps_ovrdval /end REF_CHARACTERISTIC
/end GROUP
/begin GROUP S855_Signal_Limit "SWC_OUTP_type/run_SWC_OUTP_5ms_sys/OUTP/outpmodule/VVMC_ACCPedalOvrd_flg_Inproc/Signal_Limit"
 /begin REF_CHARACTERISTIC KOUTP_ACCPedalOvrd_flg_maxval KOUTP_ACCPedalOvrd_flg_minval /end REF_CHARACTERISTIC
/end GROUP
/begin GROUP S855_Signal_Override "SWC_OUTP_type/run_SWC_OUTP_5ms_sys/OUTP/outpmodule/VVMC_ACCPedalOvrd_flg_Inproc/Signal_Override"
 /begin REF_CHARACTERISTIC KOUTP_ACCPedalOvrd_flg_ovrdflg KOUTP_ACCPedalOvrd_flg_ovrdval /end REF_CHARACTERISTIC
/end GROUP
/begin GROUP S856_Signal_Limit "SWC_OUTP_type/run_SWC_OUTP_5ms_sys/OUTP/outpmodule/VVMC_ACCRequiredAccel_mps2_Inproc/Signal_Limit"
 /begin REF_CHARACTERISTIC KOUTP_ACCRequiredAccel_mps2_maxval KOUTP_ACCRequiredAccel_mps2_minval /end REF_CHARACTERISTIC
/end GROUP
/begin GROUP S856_Signal_Override "SWC_OUTP_type/run_SWC_OUTP_5ms_sys/OUTP/outpmodule/VVMC_ACCRequiredAccel_mps2_Inproc/Signal_Override"
 /begin REF_CHARACTERISTIC KOUTP_ACCRequiredAccel_mps2_ovrdflg KOUTP_ACCRequiredAccel_mps2_ovrdval /end REF_CHARACTERISTIC
/end GROUP
/begin GROUP S857_Signal_Limit "SWC_OUTP_type/run_SWC_OUTP_5ms_sys/OUTP/outpmodule/VVMC_ACCTakeoverReq_flg_Inproc/Signal_Limit"
 /begin REF_CHARACTERISTIC KOUTP_ACCTakeoverReq_flg_maxval KOUTP_ACCTakeoverReq_flg_minval /end REF_CHARACTERISTIC
/end GROUP
/begin GROUP S857_Signal_Override "SWC_OUTP_type/run_SWC_OUTP_5ms_sys/OUTP/outpmodule/VVMC_ACCTakeoverReq_flg_Inproc/Signal_Override"
 /begin REF_CHARACTERISTIC KOUTP_ACCTakeoverReq_flg_ovrdflg KOUTP_ACCTakeoverReq_flg_ovrdval /end REF_CHARACTERISTIC
/end GROUP
/begin GROUP S858_Signal_Limit "SWC_OUTP_type/run_SWC_OUTP_5ms_sys/OUTP/outpmodule/VVMC_ACCVehHoldReq_flg_Inproc/Signal_Limit"
 /begin REF_CHARACTERISTIC KOUTP_ACCVehHoldReq_flg_maxval KOUTP_ACCVehHoldReq_flg_minval /end REF_CHARACTERISTIC
/end GROUP
/begin GROUP S858_Signal_Override "SWC_OUTP_type/run_SWC_OUTP_5ms_sys/OUTP/outpmodule/VVMC_ACCVehHoldReq_flg_Inproc/Signal_Override"
 /begin REF_CHARACTERISTIC KOUTP_ACCVehHoldReq_flg_ovrdflg KOUTP_ACCVehHoldReq_flg_ovrdval /end REF_CHARACTERISTIC
/end GROUP
/begin GROUP S859_Signal_Limit "SWC_OUTP_type/run_SWC_OUTP_5ms_sys/OUTP/outpmodule/VVMC_ADASACCSta_enum_Inproc/Signal_Limit" /begin REF_CHARACTERISTIC KOUTP_ADASACCSta_enum_maxval KOUTP_ADASACCSta_enum_minval /end REF_CHARACTERISTIC /end GROUP
/begin GROUP S859_Signal_Override "SWC_OUTP_type/run_SWC_OUTP_5ms_sys/OUTP/outpmodule/VVMC_ADASACCSta_enum_Inproc/Signal_Override"
 /begin REF_CHARACTERISTIC KOUTP_ADASACCSta_enum_ovrdflg KOUTP_ADASACCSta_enum_ovrdval /end REF_CHARACTERISTIC
/end GROUP
/begin GROUP S860_Signal_Limit "SWC_OUTP_type/run_SWC_OUTP_5ms_sys/OUTP/outpmodule/VVMC_ADASAEBReq_enum_Inproc/Signal_Limit" /begin REF_CHARACTERISTIC KOUTP_ADASAEBReq_enum_maxval KOUTP_ADASAEBReq_enum_minval /end REF_CHARACTERISTIC /end GROUP
/begin GROUP S860_Signal_Override "SWC_OUTP_type/run_SWC_OUTP_5ms_sys/OUTP/outpmodule/VVMC_ADASAEBReq_enum_Inproc/Signal_Override"
 /begin REF_CHARACTERISTIC KOUTP_ADASAEBReq_enum_ovrdflg KOUTP_ADASAEBReq_enum_ovrdval /end REF_CHARACTERISTIC
/end GROUP
/begin GROUP S861_Signal_Limit "SWC_OUTP_type/run_SWC_OUTP_5ms_sys/OUTP/outpmodule/VVMC_ADASAEBSta_enum_Inproc/Signal_Limit" /begin REF_CHARACTERISTIC KOUTP_ADASAEBSta_enum_maxval KOUTP_ADASAEBSta_enum_minval /end REF_CHARACTERISTIC /end GROUP
/begin GROUP S861_Signal_Override "SWC_OUTP_type/run_SWC_OUTP_5ms_sys/OUTP/outpmodule/VVMC_ADASAEBSta_enum_Inproc/Signal_Override"
 /begin REF_CHARACTERISTIC KOUTP_ADASAEBSta_enum_ovrdflg KOUTP_ADASAEBSta_enum_ovrdval /end REF_CHARACTERISTIC
/end GROUP
/begin GROUP S862_Signal_Limit "SWC_OUTP_type/run_SWC_OUTP_5ms_sys/OUTP/outpmodule/VVMC_ADASCAMSpdLim_enum_Inproc/Signal_Limit"
 /begin REF_CHARACTERISTIC KOUTP_ADASCAMSpdLim_enum_maxval KOUTP_ADASCAMSpdLim_enum_minval /end REF_CHARACTERISTIC
/end GROUP
/begin GROUP S862_Signal_Override "SWC_OUTP_type/run_SWC_OUTP_5ms_sys/OUTP/outpmodule/VVMC_ADASCAMSpdLim_enum_Inproc/Signal_Override"
 /begin REF_CHARACTERISTIC KOUTP_ADASCAMSpdLim_enum_ovrdflg KOUTP_ADASCAMSpdLim_enum_ovrdval /end REF_CHARACTERISTIC
/end GROUP
/begin GROUP S863_Signal_Limit "SWC_OUTP_type/run_SWC_OUTP_5ms_sys/OUTP/outpmodule/VVMC_ADASDBSReq_enum_Inproc/Signal_Limit" /begin REF_CHARACTERISTIC KOUTP_ADASDBSReq_enum_maxval KOUTP_ADASDBSReq_enum_minval /end REF_CHARACTERISTIC /end GROUP
/begin GROUP S863_Signal_Override "SWC_OUTP_type/run_SWC_OUTP_5ms_sys/OUTP/outpmodule/VVMC_ADASDBSReq_enum_Inproc/Signal_Override"
 /begin REF_CHARACTERISTIC KOUTP_ADASDBSReq_enum_ovrdflg KOUTP_ADASDBSReq_enum_ovrdval /end REF_CHARACTERISTIC
/end GROUP
/begin GROUP S864_Signal_Limit "SWC_OUTP_type/run_SWC_OUTP_5ms_sys/OUTP/outpmodule/VVMC_ADASFCWMute_flg_Inproc/Signal_Limit" /begin REF_CHARACTERISTIC KOUTP_ADASFCWMute_flg_maxval KOUTP_ADASFCWMute_flg_minval /end REF_CHARACTERISTIC /end GROUP
/begin GROUP S864_Signal_Override "SWC_OUTP_type/run_SWC_OUTP_5ms_sys/OUTP/outpmodule/VVMC_ADASFCWMute_flg_Inproc/Signal_Override"
 /begin REF_CHARACTERISTIC KOUTP_ADASFCWMute_flg_ovrdflg KOUTP_ADASFCWMute_flg_ovrdval /end REF_CHARACTERISTIC
/end GROUP
/begin GROUP S865_Signal_Limit "SWC_OUTP_type/run_SWC_OUTP_5ms_sys/OUTP/outpmodule/VVMC_ADASFCWSta_enum_Inproc/Signal_Limit" /begin REF_CHARACTERISTIC KOUTP_ADASFCWSta_enum_maxval KOUTP_ADASFCWSta_enum_minval /end REF_CHARACTERISTIC /end GROUP
/begin GROUP S865_Signal_Override "SWC_OUTP_type/run_SWC_OUTP_5ms_sys/OUTP/outpmodule/VVMC_ADASFCWSta_enum_Inproc/Signal_Override"
 /begin REF_CHARACTERISTIC KOUTP_ADASFCWSta_enum_ovrdflg KOUTP_ADASFCWSta_enum_ovrdval /end REF_CHARACTERISTIC
/end GROUP
/begin GROUP S866_Signal_Limit "SWC_OUTP_type/run_SWC_OUTP_5ms_sys/OUTP/outpmodule/VVMC_ADASFaultSta_flg_Inproc/Signal_Limit"
 /begin REF_CHARACTERISTIC KOUTP_ADASFaultSta_flg_maxval KOUTP_ADASFaultSta_flg_minval /end REF_CHARACTERISTIC
/end GROUP
/begin GROUP S866_Signal_Override "SWC_OUTP_type/run_SWC_OUTP_5ms_sys/OUTP/outpmodule/VVMC_ADASFaultSta_flg_Inproc/Signal_Override"
 /begin REF_CHARACTERISTIC KOUTP_ADASFaultSta_flg_ovrdflg KOUTP_ADASFaultSta_flg_ovrdval /end REF_CHARACTERISTIC
/end GROUP
/begin GROUP S867_Signal_Limit "SWC_OUTP_type/run_SWC_OUTP_5ms_sys/OUTP/outpmodule/VVMC_ADASFltWrnReq_flg_Inproc/Signal_Limit"
 /begin REF_CHARACTERISTIC KOUTP_ADASFltWrnReq_flg_maxval KOUTP_ADASFltWrnReq_flg_minval /end REF_CHARACTERISTIC
/end GROUP
/begin GROUP S867_Signal_Override "SWC_OUTP_type/run_SWC_OUTP_5ms_sys/OUTP/outpmodule/VVMC_ADASFltWrnReq_flg_Inproc/Signal_Override"
 /begin REF_CHARACTERISTIC KOUTP_ADASFltWrnReq_flg_ovrdflg KOUTP_ADASFltWrnReq_flg_ovrdval /end REF_CHARACTERISTIC
/end GROUP
/begin GROUP S868_Signal_Limit "SWC_OUTP_type/run_SWC_OUTP_5ms_sys/OUTP/outpmodule/VVMC_ADASForceIdle_flg_Inproc/Signal_Limit"
 /begin REF_CHARACTERISTIC KOUTP_ADASForceIdle_flg_maxval KOUTP_ADASForceIdle_flg_minval /end REF_CHARACTERISTIC
/end GROUP
/begin GROUP S868_Signal_Override "SWC_OUTP_type/run_SWC_OUTP_5ms_sys/OUTP/outpmodule/VVMC_ADASForceIdle_flg_Inproc/Signal_Override"
 /begin REF_CHARACTERISTIC KOUTP_ADASForceIdle_flg_ovrdflg KOUTP_ADASForceIdle_flg_ovrdval /end REF_CHARACTERISTIC
/end GROUP
/begin GROUP S869_Signal_Limit "SWC_OUTP_type/run_SWC_OUTP_5ms_sys/OUTP/outpmodule/VVMC_ADASISASta_enum_Inproc/Signal_Limit" /begin REF_CHARACTERISTIC KOUTP_ADASISASta_enum_maxval KOUTP_ADASISASta_enum_minval /end REF_CHARACTERISTIC /end GROUP
/begin GROUP S869_Signal_Override "SWC_OUTP_type/run_SWC_OUTP_5ms_sys/OUTP/outpmodule/VVMC_ADASISASta_enum_Inproc/Signal_Override"
 /begin REF_CHARACTERISTIC KOUTP_ADASISASta_enum_ovrdflg KOUTP_ADASISASta_enum_ovrdval /end REF_CHARACTERISTIC
/end GROUP
/begin GROUP S870_Signal_Limit "SWC_OUTP_type/run_SWC_OUTP_5ms_sys/OUTP/outpmodule/VVMC_ADASLDWMute_flg_Inproc/Signal_Limit" /begin REF_CHARACTERISTIC KOUTP_ADASLDWMute_flg_maxval KOUTP_ADASLDWMute_flg_minval /end REF_CHARACTERISTIC /end GROUP
/begin GROUP S870_Signal_Override "SWC_OUTP_type/run_SWC_OUTP_5ms_sys/OUTP/outpmodule/VVMC_ADASLDWMute_flg_Inproc/Signal_Override"
 /begin REF_CHARACTERISTIC KOUTP_ADASLDWMute_flg_ovrdflg KOUTP_ADASLDWMute_flg_ovrdval /end REF_CHARACTERISTIC
/end GROUP
/begin GROUP S871_Signal_Limit "SWC_OUTP_type/run_SWC_OUTP_5ms_sys/OUTP/outpmodule/VVMC_ADASLDWSta_enum_Inproc/Signal_Limit" /begin REF_CHARACTERISTIC KOUTP_ADASLDWSta_enum_maxval KOUTP_ADASLDWSta_enum_minval /end REF_CHARACTERISTIC /end GROUP
/begin GROUP S871_Signal_Override "SWC_OUTP_type/run_SWC_OUTP_5ms_sys/OUTP/outpmodule/VVMC_ADASLDWSta_enum_Inproc/Signal_Override"
 /begin REF_CHARACTERISTIC KOUTP_ADASLDWSta_enum_ovrdflg KOUTP_ADASLDWSta_enum_ovrdval /end REF_CHARACTERISTIC
/end GROUP
/begin GROUP S872_Signal_Limit "SWC_OUTP_type/run_SWC_OUTP_5ms_sys/OUTP/outpmodule/VVMC_ADASLFCHandsOffWarning_enum_Inproc/Signal_Limit"
 /begin REF_CHARACTERISTIC KOUTP_ADASLFCHandsOffWarning_enum_maxval KOUTP_ADASLFCHandsOffWarning_enum_minval /end REF_CHARACTERISTIC
/end GROUP
/begin GROUP S872_Signal_Override "SWC_OUTP_type/run_SWC_OUTP_5ms_sys/OUTP/outpmodule/VVMC_ADASLFCHandsOffWarning_enum_Inproc/Signal_Override"
 /begin REF_CHARACTERISTIC KOUTP_ADASLFCHandsOffWarning_enum_ovrdflg KOUTP_ADASLFCHandsOffWarning_enum_ovrdval /end REF_CHARACTERISTIC
/end GROUP
/begin GROUP S873_Signal_Limit "SWC_OUTP_type/run_SWC_OUTP_5ms_sys/OUTP/outpmodule/VVMC_ADASLFCSta_enum_Inproc/Signal_Limit" /begin REF_CHARACTERISTIC KOUTP_ADASLFCSta_enum_maxval KOUTP_ADASLFCSta_enum_minval /end REF_CHARACTERISTIC /end GROUP
/begin GROUP S873_Signal_Override "SWC_OUTP_type/run_SWC_OUTP_5ms_sys/OUTP/outpmodule/VVMC_ADASLFCSta_enum_Inproc/Signal_Override"
 /begin REF_CHARACTERISTIC KOUTP_ADASLFCSta_enum_ovrdflg KOUTP_ADASLFCSta_enum_ovrdval /end REF_CHARACTERISTIC
/end GROUP
/begin GROUP S874_Signal_Limit "SWC_OUTP_type/run_SWC_OUTP_5ms_sys/OUTP/outpmodule/VVMC_ADASLFCWarnSound_enum_Inproc/Signal_Limit"
 /begin REF_CHARACTERISTIC KOUTP_ADASLFCWarnSound_enum_maxval KOUTP_ADASLFCWarnSound_enum_minval /end REF_CHARACTERISTIC
/end GROUP
/begin GROUP S874_Signal_Override "SWC_OUTP_type/run_SWC_OUTP_5ms_sys/OUTP/outpmodule/VVMC_ADASLFCWarnSound_enum_Inproc/Signal_Override"
 /begin REF_CHARACTERISTIC KOUTP_ADASLFCWarnSound_enum_ovrdflg KOUTP_ADASLFCWarnSound_enum_ovrdval /end REF_CHARACTERISTIC
/end GROUP
/begin GROUP S875_Signal_Limit "SWC_OUTP_type/run_SWC_OUTP_5ms_sys/OUTP/outpmodule/VVMC_ADASLKASta_enum_Inproc/Signal_Limit" /begin REF_CHARACTERISTIC KOUTP_ADASLKASta_enum_maxval KOUTP_ADASLKASta_enum_minval /end REF_CHARACTERISTIC /end GROUP
/begin GROUP S875_Signal_Override "SWC_OUTP_type/run_SWC_OUTP_5ms_sys/OUTP/outpmodule/VVMC_ADASLKASta_enum_Inproc/Signal_Override"
 /begin REF_CHARACTERISTIC KOUTP_ADASLKASta_enum_ovrdflg KOUTP_ADASLKASta_enum_ovrdval /end REF_CHARACTERISTIC
/end GROUP
/begin GROUP S876_Signal_Limit "SWC_OUTP_type/run_SWC_OUTP_5ms_sys/OUTP/outpmodule/VVMC_ADASLaneModeL_enum_Inproc/Signal_Limit"
 /begin REF_CHARACTERISTIC KOUTP_ADASLaneModeL_enum_maxval KOUTP_ADASLaneModeL_enum_minval /end REF_CHARACTERISTIC
/end GROUP
/begin GROUP S876_Signal_Override "SWC_OUTP_type/run_SWC_OUTP_5ms_sys/OUTP/outpmodule/VVMC_ADASLaneModeL_enum_Inproc/Signal_Override"
 /begin REF_CHARACTERISTIC KOUTP_ADASLaneModeL_enum_ovrdflg KOUTP_ADASLaneModeL_enum_ovrdval /end REF_CHARACTERISTIC
/end GROUP
/begin GROUP S877_Signal_Limit "SWC_OUTP_type/run_SWC_OUTP_5ms_sys/OUTP/outpmodule/VVMC_ADASLaneModeR_enum_Inproc/Signal_Limit"
 /begin REF_CHARACTERISTIC KOUTP_ADASLaneModeR_enum_maxval KOUTP_ADASLaneModeR_enum_minval /end REF_CHARACTERISTIC
/end GROUP
/begin GROUP S877_Signal_Override "SWC_OUTP_type/run_SWC_OUTP_5ms_sys/OUTP/outpmodule/VVMC_ADASLaneModeR_enum_Inproc/Signal_Override"
 /begin REF_CHARACTERISTIC KOUTP_ADASLaneModeR_enum_ovrdflg KOUTP_ADASLaneModeR_enum_ovrdval /end REF_CHARACTERISTIC
/end GROUP
/begin GROUP S878_Signal_Limit "SWC_OUTP_type/run_SWC_OUTP_5ms_sys/OUTP/outpmodule/VVMC_ADASLanecurveL_raw32_Inproc/Signal_Limit"
 /begin REF_CHARACTERISTIC KOUTP_ADASLanecurveL_raw32_maxval KOUTP_ADASLanecurveL_raw32_minval /end REF_CHARACTERISTIC
/end GROUP
/begin GROUP S878_Signal_Override "SWC_OUTP_type/run_SWC_OUTP_5ms_sys/OUTP/outpmodule/VVMC_ADASLanecurveL_raw32_Inproc/Signal_Override"
 /begin REF_CHARACTERISTIC KOUTP_ADASLanecurveL_raw32_ovrdflg KOUTP_ADASLanecurveL_raw32_ovrdval /end REF_CHARACTERISTIC
/end GROUP
/begin GROUP S879_Signal_Limit "SWC_OUTP_type/run_SWC_OUTP_5ms_sys/OUTP/outpmodule/VVMC_ADASLanecurveR_raw32_Inproc/Signal_Limit"
 /begin REF_CHARACTERISTIC KOUTP_ADASLanecurveR_raw32_maxval KOUTP_ADASLanecurveR_raw32_minval /end REF_CHARACTERISTIC
/end GROUP
/begin GROUP S879_Signal_Override "SWC_OUTP_type/run_SWC_OUTP_5ms_sys/OUTP/outpmodule/VVMC_ADASLanecurveR_raw32_Inproc/Signal_Override"
 /begin REF_CHARACTERISTIC KOUTP_ADASLanecurveR_raw32_ovrdflg KOUTP_ADASLanecurveR_raw32_ovrdval /end REF_CHARACTERISTIC
/end GROUP
/begin GROUP S880_Signal_Limit "SWC_OUTP_type/run_SWC_OUTP_5ms_sys/OUTP/outpmodule/VVMC_ADASLanetypeL_enum_Inproc/Signal_Limit"
 /begin REF_CHARACTERISTIC KOUTP_ADASLanetypeL_enum_maxval KOUTP_ADASLanetypeL_enum_minval /end REF_CHARACTERISTIC
/end GROUP
/begin GROUP S880_Signal_Override "SWC_OUTP_type/run_SWC_OUTP_5ms_sys/OUTP/outpmodule/VVMC_ADASLanetypeL_enum_Inproc/Signal_Override"
 /begin REF_CHARACTERISTIC KOUTP_ADASLanetypeL_enum_ovrdflg KOUTP_ADASLanetypeL_enum_ovrdval /end REF_CHARACTERISTIC
/end GROUP
/begin GROUP S881_Signal_Limit "SWC_OUTP_type/run_SWC_OUTP_5ms_sys/OUTP/outpmodule/VVMC_ADASLanetypeR_enum_Inproc/Signal_Limit"
 /begin REF_CHARACTERISTIC KOUTP_ADASLanetypeR_enum_maxval KOUTP_ADASLanetypeR_enum_minval /end REF_CHARACTERISTIC
/end GROUP
/begin GROUP S881_Signal_Override "SWC_OUTP_type/run_SWC_OUTP_5ms_sys/OUTP/outpmodule/VVMC_ADASLanetypeR_enum_Inproc/Signal_Override"
 /begin REF_CHARACTERISTIC KOUTP_ADASLanetypeR_enum_ovrdflg KOUTP_ADASLanetypeR_enum_ovrdval /end REF_CHARACTERISTIC
/end GROUP
/begin GROUP S882_Signal_Limit "SWC_OUTP_type/run_SWC_OUTP_5ms_sys/OUTP/outpmodule/VVMC_ADASSLIFSpdLim_enum_Inproc/Signal_Limit"
 /begin REF_CHARACTERISTIC KOUTP_ADASSLIFSpdLim_enum_maxval KOUTP_ADASSLIFSpdLim_enum_minval /end REF_CHARACTERISTIC
/end GROUP
/begin GROUP S882_Signal_Override "SWC_OUTP_type/run_SWC_OUTP_5ms_sys/OUTP/outpmodule/VVMC_ADASSLIFSpdLim_enum_Inproc/Signal_Override"
 /begin REF_CHARACTERISTIC KOUTP_ADASSLIFSpdLim_enum_ovrdflg KOUTP_ADASSLIFSpdLim_enum_ovrdval /end REF_CHARACTERISTIC
/end GROUP
/begin GROUP S883_Signal_Limit "SWC_OUTP_type/run_SWC_OUTP_5ms_sys/OUTP/outpmodule/VVMC_ADASSLIFSta_enum_Inproc/Signal_Limit"
 /begin REF_CHARACTERISTIC KOUTP_ADASSLIFSta_enum_maxval KOUTP_ADASSLIFSta_enum_minval /end REF_CHARACTERISTIC
/end GROUP
/begin GROUP S883_Signal_Override "SWC_OUTP_type/run_SWC_OUTP_5ms_sys/OUTP/outpmodule/VVMC_ADASSLIFSta_enum_Inproc/Signal_Override"
 /begin REF_CHARACTERISTIC KOUTP_ADASSLIFSta_enum_ovrdflg KOUTP_ADASSLIFSta_enum_ovrdval /end REF_CHARACTERISTIC
/end GROUP
/begin GROUP S884_Signal_Limit "SWC_OUTP_type/run_SWC_OUTP_5ms_sys/OUTP/outpmodule/VVMC_ADASShftPosnReqA_flg_Inproc/Signal_Limit"
 /begin REF_CHARACTERISTIC KOUTP_ADASShftPosnReqA_flg_maxval KOUTP_ADASShftPosnReqA_flg_minval /end REF_CHARACTERISTIC
/end GROUP
/begin GROUP S884_Signal_Override "SWC_OUTP_type/run_SWC_OUTP_5ms_sys/OUTP/outpmodule/VVMC_ADASShftPosnReqA_flg_Inproc/Signal_Override"
 /begin REF_CHARACTERISTIC KOUTP_ADASShftPosnReqA_flg_ovrdflg KOUTP_ADASShftPosnReqA_flg_ovrdval /end REF_CHARACTERISTIC
/end GROUP
/begin GROUP S885_Signal_Limit "SWC_OUTP_type/run_SWC_OUTP_5ms_sys/OUTP/outpmodule/VVMC_ADASShftPosnReq_enum_Inproc/Signal_Limit"
 /begin REF_CHARACTERISTIC KOUTP_ADASShftPosnReq_enum_maxval KOUTP_ADASShftPosnReq_enum_minval /end REF_CHARACTERISTIC
/end GROUP
/begin GROUP S885_Signal_Override "SWC_OUTP_type/run_SWC_OUTP_5ms_sys/OUTP/outpmodule/VVMC_ADASShftPosnReq_enum_Inproc/Signal_Override"
 /begin REF_CHARACTERISTIC KOUTP_ADASShftPosnReq_enum_ovrdflg KOUTP_ADASShftPosnReq_enum_ovrdval /end REF_CHARACTERISTIC
/end GROUP
/begin GROUP S886_Signal_Limit "SWC_OUTP_type/run_SWC_OUTP_5ms_sys/OUTP/outpmodule/VVMC_ADASVehSpdLim_raw32_Inproc/Signal_Limit"
 /begin REF_CHARACTERISTIC KOUTP_ADASVehSpdLim_raw32_maxval KOUTP_ADASVehSpdLim_raw32_minval /end REF_CHARACTERISTIC
/end GROUP
/begin GROUP S886_Signal_Override "SWC_OUTP_type/run_SWC_OUTP_5ms_sys/OUTP/outpmodule/VVMC_ADASVehSpdLim_raw32_Inproc/Signal_Override"
 /begin REF_CHARACTERISTIC KOUTP_ADASVehSpdLim_raw32_ovrdflg KOUTP_ADASVehSpdLim_raw32_ovrdval /end REF_CHARACTERISTIC
/end GROUP
/begin GROUP S887_Signal_Limit "SWC_OUTP_type/run_SWC_OUTP_5ms_sys/OUTP/outpmodule/VVMC_ADASWarningMsg_enum_Inproc/Signal_Limit"
 /begin REF_CHARACTERISTIC KOUTP_ADASWarningMsg_enum_maxval KOUTP_ADASWarningMsg_enum_minval /end REF_CHARACTERISTIC
/end GROUP
/begin GROUP S887_Signal_Override "SWC_OUTP_type/run_SWC_OUTP_5ms_sys/OUTP/outpmodule/VVMC_ADASWarningMsg_enum_Inproc/Signal_Override"
 /begin REF_CHARACTERISTIC KOUTP_ADASWarningMsg_enum_ovrdflg KOUTP_ADASWarningMsg_enum_ovrdval /end REF_CHARACTERISTIC
/end GROUP
/begin GROUP S888_Signal_Limit "SWC_OUTP_type/run_SWC_OUTP_5ms_sys/OUTP/outpmodule/VVMC_AEBVehHoldReq_flg_Inproc/Signal_Limit"
 /begin REF_CHARACTERISTIC KOUTP_AEBVehHoldReq_flg_maxval KOUTP_AEBVehHoldReq_flg_minval /end REF_CHARACTERISTIC
/end GROUP
/begin GROUP S888_Signal_Override "SWC_OUTP_type/run_SWC_OUTP_5ms_sys/OUTP/outpmodule/VVMC_AEBVehHoldReq_flg_Inproc/Signal_Override"
 /begin REF_CHARACTERISTIC KOUTP_AEBVehHoldReq_flg_ovrdflg KOUTP_AEBVehHoldReq_flg_ovrdval /end REF_CHARACTERISTIC
/end GROUP
/begin GROUP S889_Signal_Limit "SWC_OUTP_type/run_SWC_OUTP_5ms_sys/OUTP/outpmodule/VVMC_APSActive_flg_Inproc/Signal_Limit" /begin REF_CHARACTERISTIC KOUTP_APSActive_flg_maxval KOUTP_APSActive_flg_minval /end REF_CHARACTERISTIC /end GROUP
/begin GROUP S889_Signal_Override "SWC_OUTP_type/run_SWC_OUTP_5ms_sys/OUTP/outpmodule/VVMC_APSActive_flg_Inproc/Signal_Override" /begin REF_CHARACTERISTIC KOUTP_APSActive_flg_ovrdflg KOUTP_APSActive_flg_ovrdval /end REF_CHARACTERISTIC /end GROUP
/begin GROUP S890_Signal_Limit "SWC_OUTP_type/run_SWC_OUTP_5ms_sys/OUTP/outpmodule/VVMC_APSCtrlAvail_flg_Inproc/Signal_Limit"
 /begin REF_CHARACTERISTIC KOUTP_APSCtrlAvail_flg_maxval KOUTP_APSCtrlAvail_flg_minval /end REF_CHARACTERISTIC
/end GROUP
/begin GROUP S890_Signal_Override "SWC_OUTP_type/run_SWC_OUTP_5ms_sys/OUTP/outpmodule/VVMC_APSCtrlAvail_flg_Inproc/Signal_Override"
 /begin REF_CHARACTERISTIC KOUTP_APSCtrlAvail_flg_ovrdflg KOUTP_APSCtrlAvail_flg_ovrdval /end REF_CHARACTERISTIC
/end GROUP
/begin GROUP S891_Signal_Limit "SWC_OUTP_type/run_SWC_OUTP_5ms_sys/OUTP/outpmodule/VVMC_APSDecReqA_flg_Inproc/Signal_Limit" /begin REF_CHARACTERISTIC KOUTP_APSDecReqA_flg_maxval KOUTP_APSDecReqA_flg_minval /end REF_CHARACTERISTIC /end GROUP
/begin GROUP S891_Signal_Override "SWC_OUTP_type/run_SWC_OUTP_5ms_sys/OUTP/outpmodule/VVMC_APSDecReqA_flg_Inproc/Signal_Override" /begin REF_CHARACTERISTIC KOUTP_APSDecReqA_flg_ovrdflg KOUTP_APSDecReqA_flg_ovrdval /end REF_CHARACTERISTIC /end GROUP
/begin GROUP S892_Signal_Limit "SWC_OUTP_type/run_SWC_OUTP_5ms_sys/OUTP/outpmodule/VVMC_APSDecReq_mps2_Inproc/Signal_Limit" /begin REF_CHARACTERISTIC KOUTP_APSDecReq_mps2_maxval KOUTP_APSDecReq_mps2_minval /end REF_CHARACTERISTIC /end GROUP
/begin GROUP S892_Signal_Override "SWC_OUTP_type/run_SWC_OUTP_5ms_sys/OUTP/outpmodule/VVMC_APSDecReq_mps2_Inproc/Signal_Override" /begin REF_CHARACTERISTIC KOUTP_APSDecReq_mps2_ovrdflg KOUTP_APSDecReq_mps2_ovrdval /end REF_CHARACTERISTIC /end GROUP
/begin GROUP S893_Signal_Limit "SWC_OUTP_type/run_SWC_OUTP_5ms_sys/OUTP/outpmodule/VVMC_APSReq_enum_Inproc/Signal_Limit" /begin REF_CHARACTERISTIC KOUTP_APSReq_enum_maxval KOUTP_APSReq_enum_minval /end REF_CHARACTERISTIC /end GROUP
/begin GROUP S893_Signal_Override "SWC_OUTP_type/run_SWC_OUTP_5ms_sys/OUTP/outpmodule/VVMC_APSReq_enum_Inproc/Signal_Override" /begin REF_CHARACTERISTIC KOUTP_APSReq_enum_ovrdflg KOUTP_APSReq_enum_ovrdval /end REF_CHARACTERISTIC /end GROUP
/begin GROUP S894_Signal_Limit "SWC_OUTP_type/run_SWC_OUTP_5ms_sys/OUTP/outpmodule/VVMC_APSStaSys_enum_Inproc/Signal_Limit" /begin REF_CHARACTERISTIC KOUTP_APSStaSys_enum_maxval KOUTP_APSStaSys_enum_minval /end REF_CHARACTERISTIC /end GROUP
/begin GROUP S894_Signal_Override "SWC_OUTP_type/run_SWC_OUTP_5ms_sys/OUTP/outpmodule/VVMC_APSStaSys_enum_Inproc/Signal_Override" /begin REF_CHARACTERISTIC KOUTP_APSStaSys_enum_ovrdflg KOUTP_APSStaSys_enum_ovrdval /end REF_CHARACTERISTIC /end GROUP
/begin GROUP S895_Signal_Limit "SWC_OUTP_type/run_SWC_OUTP_5ms_sys/OUTP/outpmodule/VVMC_AccCalcuPID_mps2_Inproc/Signal_Limit"
 /begin REF_CHARACTERISTIC KOUTP_AccCalcuPID_mps2_maxval KOUTP_AccCalcuPID_mps2_minval /end REF_CHARACTERISTIC
/end GROUP
/begin GROUP S895_Signal_Override "SWC_OUTP_type/run_SWC_OUTP_5ms_sys/OUTP/outpmodule/VVMC_AccCalcuPID_mps2_Inproc/Signal_Override"
 /begin REF_CHARACTERISTIC KOUTP_AccCalcuPID_mps2_ovrdflg KOUTP_AccCalcuPID_mps2_ovrdval /end REF_CHARACTERISTIC
/end GROUP
/begin GROUP S896_Signal_Limit "SWC_OUTP_type/run_SWC_OUTP_5ms_sys/OUTP/outpmodule/VVMC_ActACCRequiredAccel_mps2_Inproc/Signal_Limit"
 /begin REF_CHARACTERISTIC KOUTP_ActACCRequiredAccel_mps2_maxval KOUTP_ActACCRequiredAccel_mps2_minval /end REF_CHARACTERISTIC
/end GROUP
/begin GROUP S896_Signal_Override "SWC_OUTP_type/run_SWC_OUTP_5ms_sys/OUTP/outpmodule/VVMC_ActACCRequiredAccel_mps2_Inproc/Signal_Override"
 /begin REF_CHARACTERISTIC KOUTP_ActACCRequiredAccel_mps2_ovrdflg KOUTP_ActACCRequiredAccel_mps2_ovrdval /end REF_CHARACTERISTIC
/end GROUP
/begin GROUP S897_Signal_Limit "SWC_OUTP_type/run_SWC_OUTP_5ms_sys/OUTP/outpmodule/VVMC_CAASActive_flg_Inproc/Signal_Limit" /begin REF_CHARACTERISTIC KOUTP_CAASActive_flg_maxval KOUTP_CAASActive_flg_minval /end REF_CHARACTERISTIC /end GROUP
/begin GROUP S897_Signal_Override "SWC_OUTP_type/run_SWC_OUTP_5ms_sys/OUTP/outpmodule/VVMC_CAASActive_flg_Inproc/Signal_Override" /begin REF_CHARACTERISTIC KOUTP_CAASActive_flg_ovrdflg KOUTP_CAASActive_flg_ovrdval /end REF_CHARACTERISTIC /end GROUP
/begin GROUP S898_Signal_Limit "SWC_OUTP_type/run_SWC_OUTP_5ms_sys/OUTP/outpmodule/VVMC_CAASCtrlAvail_flg_Inproc/Signal_Limit"
 /begin REF_CHARACTERISTIC KOUTP_CAASCtrlAvail_flg_maxval KOUTP_CAASCtrlAvail_flg_minval /end REF_CHARACTERISTIC
/end GROUP
/begin GROUP S898_Signal_Override "SWC_OUTP_type/run_SWC_OUTP_5ms_sys/OUTP/outpmodule/VVMC_CAASCtrlAvail_flg_Inproc/Signal_Override"
 /begin REF_CHARACTERISTIC KOUTP_CAASCtrlAvail_flg_ovrdflg KOUTP_CAASCtrlAvail_flg_ovrdval /end REF_CHARACTERISTIC
/end GROUP
/begin GROUP S899_Signal_Limit "SWC_OUTP_type/run_SWC_OUTP_5ms_sys/OUTP/outpmodule/VVMC_CCCtrlSta_enum_Inproc/Signal_Limit" /begin REF_CHARACTERISTIC KOUTP_CCCtrlSta_enum_maxval KOUTP_CCCtrlSta_enum_minval /end REF_CHARACTERISTIC /end GROUP
/begin GROUP S899_Signal_Override "SWC_OUTP_type/run_SWC_OUTP_5ms_sys/OUTP/outpmodule/VVMC_CCCtrlSta_enum_Inproc/Signal_Override" /begin REF_CHARACTERISTIC KOUTP_CCCtrlSta_enum_ovrdflg KOUTP_CCCtrlSta_enum_ovrdval /end REF_CHARACTERISTIC /end GROUP
/begin GROUP S900_Signal_Limit "SWC_OUTP_type/run_SWC_OUTP_5ms_sys/OUTP/outpmodule/VVMC_CCMSASpdWar_flg_Inproc/Signal_Limit" /begin REF_CHARACTERISTIC KOUTP_CCMSASpdWar_flg_maxval KOUTP_CCMSASpdWar_flg_minval /end REF_CHARACTERISTIC /end GROUP
/begin GROUP S900_Signal_Override "SWC_OUTP_type/run_SWC_OUTP_5ms_sys/OUTP/outpmodule/VVMC_CCMSASpdWar_flg_Inproc/Signal_Override"
 /begin REF_CHARACTERISTIC KOUTP_CCMSASpdWar_flg_ovrdflg KOUTP_CCMSASpdWar_flg_ovrdval /end REF_CHARACTERISTIC
/end GROUP
/begin GROUP S901_Signal_Limit "SWC_OUTP_type/run_SWC_OUTP_5ms_sys/OUTP/outpmodule/VVMC_CalibratedAccX_G_Inproc/Signal_Limit"
 /begin REF_CHARACTERISTIC KOUTP_CalibratedAccX_G_maxval KOUTP_CalibratedAccX_G_minval /end REF_CHARACTERISTIC
/end GROUP
/begin GROUP S901_Signal_Override "SWC_OUTP_type/run_SWC_OUTP_5ms_sys/OUTP/outpmodule/VVMC_CalibratedAccX_G_Inproc/Signal_Override"
 /begin REF_CHARACTERISTIC KOUTP_CalibratedAccX_G_ovrdflg KOUTP_CalibratedAccX_G_ovrdval /end REF_CHARACTERISTIC
/end GROUP
/begin GROUP S902_Signal_Limit "SWC_OUTP_type/run_SWC_OUTP_5ms_sys/OUTP/outpmodule/VVMC_CalibratedAccY_G_Inproc/Signal_Limit"
 /begin REF_CHARACTERISTIC KOUTP_CalibratedAccY_G_maxval KOUTP_CalibratedAccY_G_minval /end REF_CHARACTERISTIC
/end GROUP
/begin GROUP S902_Signal_Override "SWC_OUTP_type/run_SWC_OUTP_5ms_sys/OUTP/outpmodule/VVMC_CalibratedAccY_G_Inproc/Signal_Override"
 /begin REF_CHARACTERISTIC KOUTP_CalibratedAccY_G_ovrdflg KOUTP_CalibratedAccY_G_ovrdval /end REF_CHARACTERISTIC
/end GROUP
/begin GROUP S903_Signal_Limit "SWC_OUTP_type/run_SWC_OUTP_5ms_sys/OUTP/outpmodule/VVMC_CalibratedAccZ_G_Inproc/Signal_Limit"
 /begin REF_CHARACTERISTIC KOUTP_CalibratedAccZ_G_maxval KOUTP_CalibratedAccZ_G_minval /end REF_CHARACTERISTIC
/end GROUP
/begin GROUP S903_Signal_Override "SWC_OUTP_type/run_SWC_OUTP_5ms_sys/OUTP/outpmodule/VVMC_CalibratedAccZ_G_Inproc/Signal_Override"
 /begin REF_CHARACTERISTIC KOUTP_CalibratedAccZ_G_ovrdflg KOUTP_CalibratedAccZ_G_ovrdval /end REF_CHARACTERISTIC
/end GROUP
/begin GROUP S904_Signal_Limit "SWC_OUTP_type/run_SWC_OUTP_5ms_sys/OUTP/outpmodule/VVMC_CalibratedGyroX_Dps_Inproc/Signal_Limit"
 /begin REF_CHARACTERISTIC KOUTP_CalibratedGyroX_Dps_maxval KOUTP_CalibratedGyroX_Dps_minval /end REF_CHARACTERISTIC
/end GROUP
/begin GROUP S904_Signal_Override "SWC_OUTP_type/run_SWC_OUTP_5ms_sys/OUTP/outpmodule/VVMC_CalibratedGyroX_Dps_Inproc/Signal_Override"
 /begin REF_CHARACTERISTIC KOUTP_CalibratedGyroX_Dps_ovrdflg KOUTP_CalibratedGyroX_Dps_ovrdval /end REF_CHARACTERISTIC
/end GROUP
/begin GROUP S905_Signal_Limit "SWC_OUTP_type/run_SWC_OUTP_5ms_sys/OUTP/outpmodule/VVMC_CalibratedGyroY_Dps_Inproc/Signal_Limit"
 /begin REF_CHARACTERISTIC KOUTP_CalibratedGyroY_Dps_maxval KOUTP_CalibratedGyroY_Dps_minval /end REF_CHARACTERISTIC
/end GROUP
/begin GROUP S905_Signal_Override "SWC_OUTP_type/run_SWC_OUTP_5ms_sys/OUTP/outpmodule/VVMC_CalibratedGyroY_Dps_Inproc/Signal_Override"
 /begin REF_CHARACTERISTIC KOUTP_CalibratedGyroY_Dps_ovrdflg KOUTP_CalibratedGyroY_Dps_ovrdval /end REF_CHARACTERISTIC
/end GROUP
/begin GROUP S906_Signal_Limit "SWC_OUTP_type/run_SWC_OUTP_5ms_sys/OUTP/outpmodule/VVMC_CalibratedGyroZ_Dps_Inproc/Signal_Limit"
 /begin REF_CHARACTERISTIC KOUTP_CalibratedGyroZ_Dps_maxval KOUTP_CalibratedGyroZ_Dps_minval /end REF_CHARACTERISTIC
/end GROUP
/begin GROUP S906_Signal_Override "SWC_OUTP_type/run_SWC_OUTP_5ms_sys/OUTP/outpmodule/VVMC_CalibratedGyroZ_Dps_Inproc/Signal_Override"
 /begin REF_CHARACTERISTIC KOUTP_CalibratedGyroZ_Dps_ovrdflg KOUTP_CalibratedGyroZ_Dps_ovrdval /end REF_CHARACTERISTIC
/end GROUP
/begin GROUP S907_Signal_Limit "SWC_OUTP_type/run_SWC_OUTP_5ms_sys/OUTP/outpmodule/VVMC_DISCReqAcc_mps2_Inproc/Signal_Limit" /begin REF_CHARACTERISTIC KOUTP_DISCReqAcc_mps2_maxval KOUTP_DISCReqAcc_mps2_minval /end REF_CHARACTERISTIC /end GROUP
/begin GROUP S907_Signal_Override "SWC_OUTP_type/run_SWC_OUTP_5ms_sys/OUTP/outpmodule/VVMC_DISCReqAcc_mps2_Inproc/Signal_Override"
 /begin REF_CHARACTERISTIC KOUTP_DISCReqAcc_mps2_ovrdflg KOUTP_DISCReqAcc_mps2_ovrdval /end REF_CHARACTERISTIC
/end GROUP
/begin GROUP S908_Signal_Limit "SWC_OUTP_type/run_SWC_OUTP_5ms_sys/OUTP/outpmodule/VVMC_ExtraMSACtrlSta_enum_Inproc/Signal_Limit"
 /begin REF_CHARACTERISTIC KOUTP_ExtraMSACtrlSta_enum_maxval KOUTP_ExtraMSACtrlSta_enum_minval /end REF_CHARACTERISTIC
/end GROUP
/begin GROUP S908_Signal_Override "SWC_OUTP_type/run_SWC_OUTP_5ms_sys/OUTP/outpmodule/VVMC_ExtraMSACtrlSta_enum_Inproc/Signal_Override"
 /begin REF_CHARACTERISTIC KOUTP_ExtraMSACtrlSta_enum_ovrdflg KOUTP_ExtraMSACtrlSta_enum_ovrdval /end REF_CHARACTERISTIC
/end GROUP
/begin GROUP S909_Signal_Limit "SWC_OUTP_type/run_SWC_OUTP_5ms_sys/OUTP/outpmodule/VVMC_FCMACCmode_enum_Inproc/Signal_Limit" /begin REF_CHARACTERISTIC KOUTP_FCMACCmode_enum_maxval KOUTP_FCMACCmode_enum_minval /end REF_CHARACTERISTIC /end GROUP
/begin GROUP S909_Signal_Override "SWC_OUTP_type/run_SWC_OUTP_5ms_sys/OUTP/outpmodule/VVMC_FCMACCmode_enum_Inproc/Signal_Override"
 /begin REF_CHARACTERISTIC KOUTP_FCMACCmode_enum_ovrdflg KOUTP_FCMACCmode_enum_ovrdval /end REF_CHARACTERISTIC
/end GROUP
/begin GROUP S910_Signal_Limit "SWC_OUTP_type/run_SWC_OUTP_5ms_sys/OUTP/outpmodule/VVMC_FCMLDWFault_flg_Inproc/Signal_Limit" /begin REF_CHARACTERISTIC KOUTP_FCMLDWFault_flg_maxval KOUTP_FCMLDWFault_flg_minval /end REF_CHARACTERISTIC /end GROUP
/begin GROUP S910_Signal_Override "SWC_OUTP_type/run_SWC_OUTP_5ms_sys/OUTP/outpmodule/VVMC_FCMLDWFault_flg_Inproc/Signal_Override"
 /begin REF_CHARACTERISTIC KOUTP_FCMLDWFault_flg_ovrdflg KOUTP_FCMLDWFault_flg_ovrdval /end REF_CHARACTERISTIC
/end GROUP
/begin GROUP S911_Signal_Limit "SWC_OUTP_type/run_SWC_OUTP_5ms_sys/OUTP/outpmodule/VVMC_FCMLDWRequest_enum_Inproc/Signal_Limit"
 /begin REF_CHARACTERISTIC KOUTP_FCMLDWRequest_enum_maxval KOUTP_FCMLDWRequest_enum_minval /end REF_CHARACTERISTIC
/end GROUP
/begin GROUP S911_Signal_Override "SWC_OUTP_type/run_SWC_OUTP_5ms_sys/OUTP/outpmodule/VVMC_FCMLDWRequest_enum_Inproc/Signal_Override"
 /begin REF_CHARACTERISTIC KOUTP_FCMLDWRequest_enum_ovrdflg KOUTP_FCMLDWRequest_enum_ovrdval /end REF_CHARACTERISTIC
/end GROUP
/begin GROUP S912_Signal_Limit "SWC_OUTP_type/run_SWC_OUTP_5ms_sys/OUTP/outpmodule/VVMC_FDCVMCAPSAngleTarget_deg_Inproc/Signal_Limit"
 /begin REF_CHARACTERISTIC KOUTP_FDCVMCAPSAngleTarget_deg_maxval KOUTP_FDCVMCAPSAngleTarget_deg_minval /end REF_CHARACTERISTIC
/end GROUP
/begin GROUP S912_Signal_Override "SWC_OUTP_type/run_SWC_OUTP_5ms_sys/OUTP/outpmodule/VVMC_FDCVMCAPSAngleTarget_deg_Inproc/Signal_Override"
 /begin REF_CHARACTERISTIC KOUTP_FDCVMCAPSAngleTarget_deg_ovrdflg KOUTP_FDCVMCAPSAngleTarget_deg_ovrdval /end REF_CHARACTERISTIC
/end GROUP
/begin GROUP S913_Signal_Limit "SWC_OUTP_type/run_SWC_OUTP_5ms_sys/OUTP/outpmodule/VVMC_FDCVMCAPSRqEPSCtrl_flg_Inproc/Signal_Limit"
 /begin REF_CHARACTERISTIC KOUTP_FDCVMCAPSRqEPSCtrl_flg_maxval KOUTP_FDCVMCAPSRqEPSCtrl_flg_minval /end REF_CHARACTERISTIC
/end GROUP
/begin GROUP S913_Signal_Override "SWC_OUTP_type/run_SWC_OUTP_5ms_sys/OUTP/outpmodule/VVMC_FDCVMCAPSRqEPSCtrl_flg_Inproc/Signal_Override"
 /begin REF_CHARACTERISTIC KOUTP_FDCVMCAPSRqEPSCtrl_flg_ovrdflg KOUTP_FDCVMCAPSRqEPSCtrl_flg_ovrdval /end REF_CHARACTERISTIC
/end GROUP
/begin GROUP S914_Signal_Limit "SWC_OUTP_type/run_SWC_OUTP_5ms_sys/OUTP/outpmodule/VVMC_FDCVMCAPSVRqEPSCtrl_flg_Inproc/Signal_Limit"
 /begin REF_CHARACTERISTIC KOUTP_FDCVMCAPSVRqEPSCtrl_flg_maxval KOUTP_FDCVMCAPSVRqEPSCtrl_flg_minval /end REF_CHARACTERISTIC
/end GROUP
/begin GROUP S914_Signal_Override "SWC_OUTP_type/run_SWC_OUTP_5ms_sys/OUTP/outpmodule/VVMC_FDCVMCAPSVRqEPSCtrl_flg_Inproc/Signal_Override"
 /begin REF_CHARACTERISTIC KOUTP_FDCVMCAPSVRqEPSCtrl_flg_ovrdflg KOUTP_FDCVMCAPSVRqEPSCtrl_flg_ovrdval /end REF_CHARACTERISTIC
/end GROUP
/begin GROUP S915_Signal_Limit "SWC_OUTP_type/run_SWC_OUTP_5ms_sys/OUTP/outpmodule/VVMC_FDCVMCAngCtrlTqWtGn_pct_Inproc/Signal_Limit"
 /begin REF_CHARACTERISTIC KOUTP_FDCVMCAngCtrlTqWtGn_pct_maxval KOUTP_FDCVMCAngCtrlTqWtGn_pct_minval /end REF_CHARACTERISTIC
/end GROUP
/begin GROUP S915_Signal_Override "SWC_OUTP_type/run_SWC_OUTP_5ms_sys/OUTP/outpmodule/VVMC_FDCVMCAngCtrlTqWtGn_pct_Inproc/Signal_Override"
 /begin REF_CHARACTERISTIC KOUTP_FDCVMCAngCtrlTqWtGn_pct_ovrdflg KOUTP_FDCVMCAngCtrlTqWtGn_pct_ovrdval /end REF_CHARACTERISTIC
/end GROUP
/begin GROUP S916_Signal_Limit "SWC_OUTP_type/run_SWC_OUTP_5ms_sys/OUTP/outpmodule/VVMC_FDCVMCDrInpTqBstAct_flg_Inproc/Signal_Limit"
 /begin REF_CHARACTERISTIC KOUTP_FDCVMCDrInpTqBstAct_flg_maxval KOUTP_FDCVMCDrInpTqBstAct_flg_minval /end REF_CHARACTERISTIC
/end GROUP
/begin GROUP S916_Signal_Override "SWC_OUTP_type/run_SWC_OUTP_5ms_sys/OUTP/outpmodule/VVMC_FDCVMCDrInpTqBstAct_flg_Inproc/Signal_Override"
 /begin REF_CHARACTERISTIC KOUTP_FDCVMCDrInpTqBstAct_flg_ovrdflg KOUTP_FDCVMCDrInpTqBstAct_flg_ovrdval /end REF_CHARACTERISTIC
/end GROUP
/begin GROUP S917_Signal_Limit "SWC_OUTP_type/run_SWC_OUTP_5ms_sys/OUTP/outpmodule/VVMC_FDCVMCDrInpTqBstGn_pct_Inproc/Signal_Limit"
 /begin REF_CHARACTERISTIC KOUTP_FDCVMCDrInpTqBstGn_pct_maxval KOUTP_FDCVMCDrInpTqBstGn_pct_minval /end REF_CHARACTERISTIC
/end GROUP
/begin GROUP S917_Signal_Override "SWC_OUTP_type/run_SWC_OUTP_5ms_sys/OUTP/outpmodule/VVMC_FDCVMCDrInpTqBstGn_pct_Inproc/Signal_Override"
 /begin REF_CHARACTERISTIC KOUTP_FDCVMCDrInpTqBstGn_pct_ovrdflg KOUTP_FDCVMCDrInpTqBstGn_pct_ovrdval /end REF_CHARACTERISTIC
/end GROUP
/begin GROUP S918_Signal_Limit "SWC_OUTP_type/run_SWC_OUTP_5ms_sys/OUTP/outpmodule/VVMC_FDCVMCMaxAngCtrlOutTqLim_Nm_Inproc/Signal_Limit"
 /begin REF_CHARACTERISTIC KOUTP_FDCVMCMaxAngCtrlOutTqLim_Nm_maxval KOUTP_FDCVMCMaxAngCtrlOutTqLim_Nm_minval /end REF_CHARACTERISTIC
/end GROUP
/begin GROUP S918_Signal_Override "SWC_OUTP_type/run_SWC_OUTP_5ms_sys/OUTP/outpmodule/VVMC_FDCVMCMaxAngCtrlOutTqLim_Nm_Inproc/Signal_Override"
 /begin REF_CHARACTERISTIC KOUTP_FDCVMCMaxAngCtrlOutTqLim_Nm_ovrdflg KOUTP_FDCVMCMaxAngCtrlOutTqLim_Nm_ovrdval /end REF_CHARACTERISTIC
/end GROUP
/begin GROUP S919_Signal_Limit "SWC_OUTP_type/run_SWC_OUTP_5ms_sys/OUTP/outpmodule/VVMC_FeatArbitrFinal_enum_Inproc/Signal_Limit"
 /begin REF_CHARACTERISTIC KOUTP_FeatArbitrFinal_enum_maxval KOUTP_FeatArbitrFinal_enum_minval /end REF_CHARACTERISTIC
/end GROUP
/begin GROUP S919_Signal_Override "SWC_OUTP_type/run_SWC_OUTP_5ms_sys/OUTP/outpmodule/VVMC_FeatArbitrFinal_enum_Inproc/Signal_Override"
 /begin REF_CHARACTERISTIC KOUTP_FeatArbitrFinal_enum_ovrdflg KOUTP_FeatArbitrFinal_enum_ovrdval /end REF_CHARACTERISTIC
/end GROUP
/begin GROUP S920_Signal_Limit "SWC_OUTP_type/run_SWC_OUTP_5ms_sys/OUTP/outpmodule/VVMC_FeatArbitrSta_enum_Inproc/Signal_Limit"
 /begin REF_CHARACTERISTIC KOUTP_FeatArbitrSta_enum_maxval KOUTP_FeatArbitrSta_enum_minval /end REF_CHARACTERISTIC
/end GROUP
/begin GROUP S920_Signal_Override "SWC_OUTP_type/run_SWC_OUTP_5ms_sys/OUTP/outpmodule/VVMC_FeatArbitrSta_enum_Inproc/Signal_Override"
 /begin REF_CHARACTERISTIC KOUTP_FeatArbitrSta_enum_ovrdflg KOUTP_FeatArbitrSta_enum_ovrdval /end REF_CHARACTERISTIC
/end GROUP
/begin GROUP S921_Signal_Limit "SWC_OUTP_type/run_SWC_OUTP_5ms_sys/OUTP/outpmodule/VVMC_FeatReqSpd_kph_Inproc/Signal_Limit" /begin REF_CHARACTERISTIC KOUTP_FeatReqSpd_kph_maxval KOUTP_FeatReqSpd_kph_minval /end REF_CHARACTERISTIC /end GROUP
/begin GROUP S921_Signal_Override "SWC_OUTP_type/run_SWC_OUTP_5ms_sys/OUTP/outpmodule/VVMC_FeatReqSpd_kph_Inproc/Signal_Override" /begin REF_CHARACTERISTIC KOUTP_FeatReqSpd_kph_ovrdflg KOUTP_FeatReqSpd_kph_ovrdval /end REF_CHARACTERISTIC /end GROUP
/begin GROUP S922_Signal_Limit "SWC_OUTP_type/run_SWC_OUTP_5ms_sys/OUTP/outpmodule/VVMC_FeatSetSpdFinal_raw32_Inproc/Signal_Limit"
 /begin REF_CHARACTERISTIC KOUTP_FeatSetSpdFinal_raw32_maxval KOUTP_FeatSetSpdFinal_raw32_minval /end REF_CHARACTERISTIC
/end GROUP
/begin GROUP S922_Signal_Override "SWC_OUTP_type/run_SWC_OUTP_5ms_sys/OUTP/outpmodule/VVMC_FeatSetSpdFinal_raw32_Inproc/Signal_Override"
 /begin REF_CHARACTERISTIC KOUTP_FeatSetSpdFinal_raw32_ovrdflg KOUTP_FeatSetSpdFinal_raw32_ovrdval /end REF_CHARACTERISTIC
/end GROUP
/begin GROUP S923_Signal_Limit "SWC_OUTP_type/run_SWC_OUTP_5ms_sys/OUTP/outpmodule/VVMC_ForceLowBeam_enum_Inproc/Signal_Limit"
 /begin REF_CHARACTERISTIC KOUTP_ForceLowBeam_enum_maxval KOUTP_ForceLowBeam_enum_minval /end REF_CHARACTERISTIC
/end GROUP
/begin GROUP S923_Signal_Override "SWC_OUTP_type/run_SWC_OUTP_5ms_sys/OUTP/outpmodule/VVMC_ForceLowBeam_enum_Inproc/Signal_Override"
 /begin REF_CHARACTERISTIC KOUTP_ForceLowBeam_enum_ovrdflg KOUTP_ForceLowBeam_enum_ovrdval /end REF_CHARACTERISTIC
/end GROUP
/begin GROUP S924_Signal_Limit "SWC_OUTP_type/run_SWC_OUTP_5ms_sys/OUTP/outpmodule/VVMC_FrontRearSlipRatioCtrl_flg_Inproc/Signal_Limit"
 /begin REF_CHARACTERISTIC KOUTP_FrontRearSlipRatioCtrl_flg_maxval KOUTP_FrontRearSlipRatioCtrl_flg_minval /end REF_CHARACTERISTIC
/end GROUP
/begin GROUP S924_Signal_Override "SWC_OUTP_type/run_SWC_OUTP_5ms_sys/OUTP/outpmodule/VVMC_FrontRearSlipRatioCtrl_flg_Inproc/Signal_Override"
 /begin REF_CHARACTERISTIC KOUTP_FrontRearSlipRatioCtrl_flg_ovrdflg KOUTP_FrontRearSlipRatioCtrl_flg_ovrdval /end REF_CHARACTERISTIC
/end GROUP
/begin GROUP S925_Signal_Limit "SWC_OUTP_type/run_SWC_OUTP_5ms_sys/OUTP/outpmodule/VVMC_HazardWarningReq_flg_Inproc/Signal_Limit"
 /begin REF_CHARACTERISTIC KOUTP_HazardWarningReq_flg_maxval KOUTP_HazardWarningReq_flg_minval /end REF_CHARACTERISTIC
/end GROUP
/begin GROUP S925_Signal_Override "SWC_OUTP_type/run_SWC_OUTP_5ms_sys/OUTP/outpmodule/VVMC_HazardWarningReq_flg_Inproc/Signal_Override"
 /begin REF_CHARACTERISTIC KOUTP_HazardWarningReq_flg_ovrdflg KOUTP_HazardWarningReq_flg_ovrdval /end REF_CHARACTERISTIC
/end GROUP
/begin GROUP S926_Signal_Limit "SWC_OUTP_type/run_SWC_OUTP_5ms_sys/OUTP/outpmodule/VVMC_IMUEnaCmd_flg_Inproc/Signal_Limit" /begin REF_CHARACTERISTIC KOUTP_IMUEnaCmd_flg_maxval KOUTP_IMUEnaCmd_flg_minval /end REF_CHARACTERISTIC /end GROUP
/begin GROUP S926_Signal_Override "SWC_OUTP_type/run_SWC_OUTP_5ms_sys/OUTP/outpmodule/VVMC_IMUEnaCmd_flg_Inproc/Signal_Override" /begin REF_CHARACTERISTIC KOUTP_IMUEnaCmd_flg_ovrdflg KOUTP_IMUEnaCmd_flg_ovrdval /end REF_CHARACTERISTIC /end GROUP
/begin GROUP S927_Signal_Limit "SWC_OUTP_type/run_SWC_OUTP_5ms_sys/OUTP/outpmodule/VVMC_ISOAccLimit_mps2_Inproc/Signal_Limit"
 /begin REF_CHARACTERISTIC KOUTP_ISOAccLimit_mps2_maxval KOUTP_ISOAccLimit_mps2_minval /end REF_CHARACTERISTIC
/end GROUP
/begin GROUP S927_Signal_Override "SWC_OUTP_type/run_SWC_OUTP_5ms_sys/OUTP/outpmodule/VVMC_ISOAccLimit_mps2_Inproc/Signal_Override"
 /begin REF_CHARACTERISTIC KOUTP_ISOAccLimit_mps2_ovrdflg KOUTP_ISOAccLimit_mps2_ovrdval /end REF_CHARACTERISTIC
/end GROUP
/begin GROUP S928_Signal_Limit "SWC_OUTP_type/run_SWC_OUTP_5ms_sys/OUTP/outpmodule/VVMC_ISODecLimit_mps2_Inproc/Signal_Limit"
 /begin REF_CHARACTERISTIC KOUTP_ISODecLimit_mps2_maxval KOUTP_ISODecLimit_mps2_minval /end REF_CHARACTERISTIC
/end GROUP
/begin GROUP S928_Signal_Override "SWC_OUTP_type/run_SWC_OUTP_5ms_sys/OUTP/outpmodule/VVMC_ISODecLimit_mps2_Inproc/Signal_Override"
 /begin REF_CHARACTERISTIC KOUTP_ISODecLimit_mps2_ovrdflg KOUTP_ISODecLimit_mps2_ovrdval /end REF_CHARACTERISTIC
/end GROUP
/begin GROUP S929_Signal_Limit "SWC_OUTP_type/run_SWC_OUTP_5ms_sys/OUTP/outpmodule/VVMC_ISOJerkLimit_mps3_Inproc/Signal_Limit"
 /begin REF_CHARACTERISTIC KOUTP_ISOJerkLimit_mps3_maxval KOUTP_ISOJerkLimit_mps3_minval /end REF_CHARACTERISTIC
/end GROUP
/begin GROUP S929_Signal_Override "SWC_OUTP_type/run_SWC_OUTP_5ms_sys/OUTP/outpmodule/VVMC_ISOJerkLimit_mps3_Inproc/Signal_Override"
 /begin REF_CHARACTERISTIC KOUTP_ISOJerkLimit_mps3_ovrdflg KOUTP_ISOJerkLimit_mps3_ovrdval /end REF_CHARACTERISTIC
/end GROUP
/begin GROUP S930_Signal_Limit "SWC_OUTP_type/run_SWC_OUTP_5ms_sys/OUTP/outpmodule/VVMC_JerkPCT_pct_Inproc/Signal_Limit" /begin REF_CHARACTERISTIC KOUTP_JerkPCT_pct_maxval KOUTP_JerkPCT_pct_minval /end REF_CHARACTERISTIC /end GROUP
/begin GROUP S930_Signal_Override "SWC_OUTP_type/run_SWC_OUTP_5ms_sys/OUTP/outpmodule/VVMC_JerkPCT_pct_Inproc/Signal_Override" /begin REF_CHARACTERISTIC KOUTP_JerkPCT_pct_ovrdflg KOUTP_JerkPCT_pct_ovrdval /end REF_CHARACTERISTIC /end GROUP
/begin GROUP S931_Signal_Limit "SWC_OUTP_type/run_SWC_OUTP_5ms_sys/OUTP/outpmodule/VVMC_LKAHODDisplayWarning_flg_Inproc/Signal_Limit"
 /begin REF_CHARACTERISTIC KOUTP_LKAHODDisplayWarning_flg_maxval KOUTP_LKAHODDisplayWarning_flg_minval /end REF_CHARACTERISTIC
/end GROUP
/begin GROUP S931_Signal_Override "SWC_OUTP_type/run_SWC_OUTP_5ms_sys/OUTP/outpmodule/VVMC_LKAHODDisplayWarning_flg_Inproc/Signal_Override"
 /begin REF_CHARACTERISTIC KOUTP_LKAHODDisplayWarning_flg_ovrdflg KOUTP_LKAHODDisplayWarning_flg_ovrdval /end REF_CHARACTERISTIC
/end GROUP
/begin GROUP S932_Signal_Limit "SWC_OUTP_type/run_SWC_OUTP_5ms_sys/OUTP/outpmodule/VVMC_LKAHODSoundWarning_flg_Inproc/Signal_Limit"
 /begin REF_CHARACTERISTIC KOUTP_LKAHODSoundWarning_flg_maxval KOUTP_LKAHODSoundWarning_flg_minval /end REF_CHARACTERISTIC
/end GROUP
/begin GROUP S932_Signal_Override "SWC_OUTP_type/run_SWC_OUTP_5ms_sys/OUTP/outpmodule/VVMC_LKAHODSoundWarning_flg_Inproc/Signal_Override"
 /begin REF_CHARACTERISTIC KOUTP_LKAHODSoundWarning_flg_ovrdflg KOUTP_LKAHODSoundWarning_flg_ovrdval /end REF_CHARACTERISTIC
/end GROUP
/begin GROUP S933_Signal_Limit "SWC_OUTP_type/run_SWC_OUTP_5ms_sys/OUTP/outpmodule/VVMC_LKAStrToqReq_Nm_Inproc/Signal_Limit" /begin REF_CHARACTERISTIC KOUTP_LKAStrToqReq_Nm_maxval KOUTP_LKAStrToqReq_Nm_minval /end REF_CHARACTERISTIC /end GROUP
/begin GROUP S933_Signal_Override "SWC_OUTP_type/run_SWC_OUTP_5ms_sys/OUTP/outpmodule/VVMC_LKAStrToqReq_Nm_Inproc/Signal_Override"
 /begin REF_CHARACTERISTIC KOUTP_LKAStrToqReq_Nm_ovrdflg KOUTP_LKAStrToqReq_Nm_ovrdval /end REF_CHARACTERISTIC
/end GROUP
/begin GROUP S934_Signal_Limit "SWC_OUTP_type/run_SWC_OUTP_5ms_sys/OUTP/outpmodule/VVMC_LKATOIAct_enum_Inproc/Signal_Limit" /begin REF_CHARACTERISTIC KOUTP_LKATOIAct_enum_maxval KOUTP_LKATOIAct_enum_minval /end REF_CHARACTERISTIC /end GROUP
/begin GROUP S934_Signal_Override "SWC_OUTP_type/run_SWC_OUTP_5ms_sys/OUTP/outpmodule/VVMC_LKATOIAct_enum_Inproc/Signal_Override" /begin REF_CHARACTERISTIC KOUTP_LKATOIAct_enum_ovrdflg KOUTP_LKATOIAct_enum_ovrdval /end REF_CHARACTERISTIC /end GROUP
/begin GROUP S935_Signal_Limit "SWC_OUTP_type/run_SWC_OUTP_5ms_sys/OUTP/outpmodule/VVMC_LKATOIFault_flg_Inproc/Signal_Limit" /begin REF_CHARACTERISTIC KOUTP_LKATOIFault_flg_maxval KOUTP_LKATOIFault_flg_minval /end REF_CHARACTERISTIC /end GROUP
/begin GROUP S935_Signal_Override "SWC_OUTP_type/run_SWC_OUTP_5ms_sys/OUTP/outpmodule/VVMC_LKATOIFault_flg_Inproc/Signal_Override"
 /begin REF_CHARACTERISTIC KOUTP_LKATOIFault_flg_ovrdflg KOUTP_LKATOIFault_flg_ovrdval /end REF_CHARACTERISTIC
/end GROUP
/begin GROUP S936_Signal_Limit "SWC_OUTP_type/run_SWC_OUTP_5ms_sys/OUTP/outpmodule/VVMC_LVDAACCStatusInformation_flg_Inproc/Signal_Limit"
 /begin REF_CHARACTERISTIC KOUTP_LVDAACCStatusInformation_flg_maxval KOUTP_LVDAACCStatusInformation_flg_minval /end REF_CHARACTERISTIC
/end GROUP
/begin GROUP S936_Signal_Override "SWC_OUTP_type/run_SWC_OUTP_5ms_sys/OUTP/outpmodule/VVMC_LVDAACCStatusInformation_flg_Inproc/Signal_Override"
 /begin REF_CHARACTERISTIC KOUTP_LVDAACCStatusInformation_flg_ovrdflg KOUTP_LVDAACCStatusInformation_flg_ovrdval /end REF_CHARACTERISTIC
/end GROUP
/begin GROUP S937_Signal_Limit "SWC_OUTP_type/run_SWC_OUTP_5ms_sys/OUTP/outpmodule/VVMC_LVDADisabled_flg_Inproc/Signal_Limit"
 /begin REF_CHARACTERISTIC KOUTP_LVDADisabled_flg_maxval KOUTP_LVDADisabled_flg_minval /end REF_CHARACTERISTIC
/end GROUP
/begin GROUP S937_Signal_Override "SWC_OUTP_type/run_SWC_OUTP_5ms_sys/OUTP/outpmodule/VVMC_LVDADisabled_flg_Inproc/Signal_Override"
 /begin REF_CHARACTERISTIC KOUTP_LVDADisabled_flg_ovrdflg KOUTP_LVDADisabled_flg_ovrdval /end REF_CHARACTERISTIC
/end GROUP
/begin GROUP S938_Signal_Limit "SWC_OUTP_type/run_SWC_OUTP_5ms_sys/OUTP/outpmodule/VVMC_LVDAFailinfo_flg_Inproc/Signal_Limit"
 /begin REF_CHARACTERISTIC KOUTP_LVDAFailinfo_flg_maxval KOUTP_LVDAFailinfo_flg_minval /end REF_CHARACTERISTIC
/end GROUP
/begin GROUP S938_Signal_Override "SWC_OUTP_type/run_SWC_OUTP_5ms_sys/OUTP/outpmodule/VVMC_LVDAFailinfo_flg_Inproc/Signal_Override"
 /begin REF_CHARACTERISTIC KOUTP_LVDAFailinfo_flg_ovrdflg KOUTP_LVDAFailinfo_flg_ovrdval /end REF_CHARACTERISTIC
/end GROUP
/begin GROUP S939_Signal_Limit "SWC_OUTP_type/run_SWC_OUTP_5ms_sys/OUTP/outpmodule/VVMC_LVDAMuteSta_enum_Inproc/Signal_Limit"
 /begin REF_CHARACTERISTIC KOUTP_LVDAMuteSta_enum_maxval KOUTP_LVDAMuteSta_enum_minval /end REF_CHARACTERISTIC
/end GROUP
/begin GROUP S939_Signal_Override "SWC_OUTP_type/run_SWC_OUTP_5ms_sys/OUTP/outpmodule/VVMC_LVDAMuteSta_enum_Inproc/Signal_Override"
 /begin REF_CHARACTERISTIC KOUTP_LVDAMuteSta_enum_ovrdflg KOUTP_LVDAMuteSta_enum_ovrdval /end REF_CHARACTERISTIC
/end GROUP
/begin GROUP S940_Signal_Limit "SWC_OUTP_type/run_SWC_OUTP_5ms_sys/OUTP/outpmodule/VVMC_LVDAWarning_flg_Inproc/Signal_Limit" /begin REF_CHARACTERISTIC KOUTP_LVDAWarning_flg_maxval KOUTP_LVDAWarning_flg_minval /end REF_CHARACTERISTIC /end GROUP
/begin GROUP S940_Signal_Override "SWC_OUTP_type/run_SWC_OUTP_5ms_sys/OUTP/outpmodule/VVMC_LVDAWarning_flg_Inproc/Signal_Override"
 /begin REF_CHARACTERISTIC KOUTP_LVDAWarning_flg_ovrdflg KOUTP_LVDAWarning_flg_ovrdval /end REF_CHARACTERISTIC
/end GROUP
/begin GROUP S941_Signal_Limit "SWC_OUTP_type/run_SWC_OUTP_5ms_sys/OUTP/outpmodule/VVMC_LatAccCtrl_flg_Inproc/Signal_Limit" /begin REF_CHARACTERISTIC KOUTP_LatAccCtrl_flg_maxval KOUTP_LatAccCtrl_flg_minval /end REF_CHARACTERISTIC /end GROUP
/begin GROUP S941_Signal_Override "SWC_OUTP_type/run_SWC_OUTP_5ms_sys/OUTP/outpmodule/VVMC_LatAccCtrl_flg_Inproc/Signal_Override" /begin REF_CHARACTERISTIC KOUTP_LatAccCtrl_flg_ovrdflg KOUTP_LatAccCtrl_flg_ovrdval /end REF_CHARACTERISTIC /end GROUP
/begin GROUP S942_Signal_Limit "SWC_OUTP_type/run_SWC_OUTP_5ms_sys/OUTP/outpmodule/VVMC_LateralCtrl_flg_Inproc/Signal_Limit" /begin REF_CHARACTERISTIC KOUTP_LateralCtrl_flg_maxval KOUTP_LateralCtrl_flg_minval /end REF_CHARACTERISTIC /end GROUP
/begin GROUP S942_Signal_Override "SWC_OUTP_type/run_SWC_OUTP_5ms_sys/OUTP/outpmodule/VVMC_LateralCtrl_flg_Inproc/Signal_Override"
 /begin REF_CHARACTERISTIC KOUTP_LateralCtrl_flg_ovrdflg KOUTP_LateralCtrl_flg_ovrdval /end REF_CHARACTERISTIC
/end GROUP
/begin GROUP S943_Signal_Limit "SWC_OUTP_type/run_SWC_OUTP_5ms_sys/OUTP/outpmodule/VVMC_LeftTurnLightReq_flg_Inproc/Signal_Limit"
 /begin REF_CHARACTERISTIC KOUTP_LeftTurnLightReq_flg_maxval KOUTP_LeftTurnLightReq_flg_minval /end REF_CHARACTERISTIC
/end GROUP
/begin GROUP S943_Signal_Override "SWC_OUTP_type/run_SWC_OUTP_5ms_sys/OUTP/outpmodule/VVMC_LeftTurnLightReq_flg_Inproc/Signal_Override"
 /begin REF_CHARACTERISTIC KOUTP_LeftTurnLightReq_flg_ovrdflg KOUTP_LeftTurnLightReq_flg_ovrdval /end REF_CHARACTERISTIC
/end GROUP
/begin GROUP S944_Signal_Limit "SWC_OUTP_type/run_SWC_OUTP_5ms_sys/OUTP/outpmodule/VVMC_LimitPCT_pct_Inproc/Signal_Limit" /begin REF_CHARACTERISTIC KOUTP_LimitPCT_pct_maxval KOUTP_LimitPCT_pct_minval /end REF_CHARACTERISTIC /end GROUP
/begin GROUP S944_Signal_Override "SWC_OUTP_type/run_SWC_OUTP_5ms_sys/OUTP/outpmodule/VVMC_LimitPCT_pct_Inproc/Signal_Override" /begin REF_CHARACTERISTIC KOUTP_LimitPCT_pct_ovrdflg KOUTP_LimitPCT_pct_ovrdval /end REF_CHARACTERISTIC /end GROUP
/begin GROUP S945_Signal_Limit "SWC_OUTP_type/run_SWC_OUTP_5ms_sys/OUTP/outpmodule/VVMC_LongAcc_Gps_Inproc/Signal_Limit" /begin REF_CHARACTERISTIC KOUTP_LongAcc_Gps_maxval KOUTP_LongAcc_Gps_minval /end REF_CHARACTERISTIC /end GROUP
/begin GROUP S945_Signal_Override "SWC_OUTP_type/run_SWC_OUTP_5ms_sys/OUTP/outpmodule/VVMC_LongAcc_Gps_Inproc/Signal_Override" /begin REF_CHARACTERISTIC KOUTP_LongAcc_Gps_ovrdflg KOUTP_LongAcc_Gps_ovrdval /end REF_CHARACTERISTIC /end GROUP
/begin GROUP S946_Signal_Limit "SWC_OUTP_type/run_SWC_OUTP_5ms_sys/OUTP/outpmodule/VVMC_MSACtrlSta_enum_Inproc/Signal_Limit" /begin REF_CHARACTERISTIC KOUTP_MSACtrlSta_enum_maxval KOUTP_MSACtrlSta_enum_minval /end REF_CHARACTERISTIC /end GROUP
/begin GROUP S946_Signal_Override "SWC_OUTP_type/run_SWC_OUTP_5ms_sys/OUTP/outpmodule/VVMC_MSACtrlSta_enum_Inproc/Signal_Override"
 /begin REF_CHARACTERISTIC KOUTP_MSACtrlSta_enum_ovrdflg KOUTP_MSACtrlSta_enum_ovrdval /end REF_CHARACTERISTIC
/end GROUP
/begin GROUP S947_Signal_Limit "SWC_OUTP_type/run_SWC_OUTP_5ms_sys/OUTP/outpmodule/VVMC_MeterIndSpeed_raw32_Inproc/Signal_Limit"
 /begin REF_CHARACTERISTIC KOUTP_MeterIndSpeed_raw32_maxval KOUTP_MeterIndSpeed_raw32_minval /end REF_CHARACTERISTIC
/end GROUP
/begin GROUP S947_Signal_Override "SWC_OUTP_type/run_SWC_OUTP_5ms_sys/OUTP/outpmodule/VVMC_MeterIndSpeed_raw32_Inproc/Signal_Override"
 /begin REF_CHARACTERISTIC KOUTP_MeterIndSpeed_raw32_ovrdflg KOUTP_MeterIndSpeed_raw32_ovrdval /end REF_CHARACTERISTIC
/end GROUP
/begin GROUP S948_Signal_Limit "SWC_OUTP_type/run_SWC_OUTP_5ms_sys/OUTP/outpmodule/VVMC_RearWhlSlipRatioCtrl_flg_Inproc/Signal_Limit"
 /begin REF_CHARACTERISTIC KOUTP_RearWhlSlipRatioCtrl_flg_maxval KOUTP_RearWhlSlipRatioCtrl_flg_minval /end REF_CHARACTERISTIC
/end GROUP
/begin GROUP S948_Signal_Override "SWC_OUTP_type/run_SWC_OUTP_5ms_sys/OUTP/outpmodule/VVMC_RearWhlSlipRatioCtrl_flg_Inproc/Signal_Override"
 /begin REF_CHARACTERISTIC KOUTP_RearWhlSlipRatioCtrl_flg_ovrdflg KOUTP_RearWhlSlipRatioCtrl_flg_ovrdval /end REF_CHARACTERISTIC
/end GROUP
/begin GROUP S949_Signal_Limit "SWC_OUTP_type/run_SWC_OUTP_5ms_sys/OUTP/outpmodule/VVMC_RightTurnLightReq_flg_Inproc/Signal_Limit"
 /begin REF_CHARACTERISTIC KOUTP_RightTurnLightReq_flg_maxval KOUTP_RightTurnLightReq_flg_minval /end REF_CHARACTERISTIC
/end GROUP
/begin GROUP S949_Signal_Override "SWC_OUTP_type/run_SWC_OUTP_5ms_sys/OUTP/outpmodule/VVMC_RightTurnLightReq_flg_Inproc/Signal_Override"
 /begin REF_CHARACTERISTIC KOUTP_RightTurnLightReq_flg_ovrdflg KOUTP_RightTurnLightReq_flg_ovrdval /end REF_CHARACTERISTIC
/end GROUP
/begin GROUP S950_Signal_Limit "SWC_OUTP_type/run_SWC_OUTP_5ms_sys/OUTP/outpmodule/VVMC_SPD2ACCAct_flg_Inproc/Signal_Limit" /begin REF_CHARACTERISTIC KOUTP_SPD2ACCAct_flg_maxval KOUTP_SPD2ACCAct_flg_minval /end REF_CHARACTERISTIC /end GROUP
/begin GROUP S950_Signal_Override "SWC_OUTP_type/run_SWC_OUTP_5ms_sys/OUTP/outpmodule/VVMC_SPD2ACCAct_flg_Inproc/Signal_Override" /begin REF_CHARACTERISTIC KOUTP_SPD2ACCAct_flg_ovrdflg KOUTP_SPD2ACCAct_flg_ovrdval /end REF_CHARACTERISTIC /end GROUP
/begin GROUP S951_Signal_Limit "SWC_OUTP_type/run_SWC_OUTP_5ms_sys/OUTP/outpmodule/VVMC_SafetyCtrl_flg_Inproc/Signal_Limit" /begin REF_CHARACTERISTIC KOUTP_SafetyCtrl_flg_maxval KOUTP_SafetyCtrl_flg_minval /end REF_CHARACTERISTIC /end GROUP
/begin GROUP S951_Signal_Override "SWC_OUTP_type/run_SWC_OUTP_5ms_sys/OUTP/outpmodule/VVMC_SafetyCtrl_flg_Inproc/Signal_Override" /begin REF_CHARACTERISTIC KOUTP_SafetyCtrl_flg_ovrdflg KOUTP_SafetyCtrl_flg_ovrdval /end REF_CHARACTERISTIC /end GROUP
/begin GROUP S952_Signal_Limit "SWC_OUTP_type/run_SWC_OUTP_5ms_sys/OUTP/outpmodule/VVMC_SingleWhlSlipRatioCtrl_flg_Inproc/Signal_Limit"
 /begin REF_CHARACTERISTIC KOUTP_SingleWhlSlipRatioCtrl_flg_maxval KOUTP_SingleWhlSlipRatioCtrl_flg_minval /end REF_CHARACTERISTIC
/end GROUP
/begin GROUP S952_Signal_Override "SWC_OUTP_type/run_SWC_OUTP_5ms_sys/OUTP/outpmodule/VVMC_SingleWhlSlipRatioCtrl_flg_Inproc/Signal_Override"
 /begin REF_CHARACTERISTIC KOUTP_SingleWhlSlipRatioCtrl_flg_ovrdflg KOUTP_SingleWhlSlipRatioCtrl_flg_ovrdval /end REF_CHARACTERISTIC
/end GROUP
/begin GROUP S953_Signal_Limit "SWC_OUTP_type/run_SWC_OUTP_5ms_sys/OUTP/outpmodule/VVMC_TargetType_enum_Inproc/Signal_Limit" /begin REF_CHARACTERISTIC KOUTP_TargetType_enum_maxval KOUTP_TargetType_enum_minval /end REF_CHARACTERISTIC /end GROUP
/begin GROUP S953_Signal_Override "SWC_OUTP_type/run_SWC_OUTP_5ms_sys/OUTP/outpmodule/VVMC_TargetType_enum_Inproc/Signal_Override"
 /begin REF_CHARACTERISTIC KOUTP_TargetType_enum_ovrdflg KOUTP_TargetType_enum_ovrdval /end REF_CHARACTERISTIC
/end GROUP
/begin GROUP S954_Signal_Limit "SWC_OUTP_type/run_SWC_OUTP_5ms_sys/OUTP/outpmodule/VVMC_TimeGapCalcu_s_Inproc/Signal_Limit" /begin REF_CHARACTERISTIC KOUTP_TimeGapCalcu_s_maxval KOUTP_TimeGapCalcu_s_minval /end REF_CHARACTERISTIC /end GROUP
/begin GROUP S954_Signal_Override "SWC_OUTP_type/run_SWC_OUTP_5ms_sys/OUTP/outpmodule/VVMC_TimeGapCalcu_s_Inproc/Signal_Override" /begin REF_CHARACTERISTIC KOUTP_TimeGapCalcu_s_ovrdflg KOUTP_TimeGapCalcu_s_ovrdval /end REF_CHARACTERISTIC /end GROUP
/begin GROUP S955_Signal_Limit "SWC_OUTP_type/run_SWC_OUTP_5ms_sys/OUTP/outpmodule/VVMC_TimeGapLevel_enum_Inproc/Signal_Limit"
 /begin REF_CHARACTERISTIC KOUTP_TimeGapLevel_enum_maxval KOUTP_TimeGapLevel_enum_minval /end REF_CHARACTERISTIC
/end GROUP
/begin GROUP S955_Signal_Override "SWC_OUTP_type/run_SWC_OUTP_5ms_sys/OUTP/outpmodule/VVMC_TimeGapLevel_enum_Inproc/Signal_Override"
 /begin REF_CHARACTERISTIC KOUTP_TimeGapLevel_enum_ovrdflg KOUTP_TimeGapLevel_enum_ovrdval /end REF_CHARACTERISTIC
/end GROUP
/begin GROUP S956_Signal_Limit "SWC_OUTP_type/run_SWC_OUTP_5ms_sys/OUTP/outpmodule/VVMC_VMCACCCtrlAvail_flg_Inproc/Signal_Limit"
 /begin REF_CHARACTERISTIC KOUTP_VMCACCCtrlAvail_flg_maxval KOUTP_VMCACCCtrlAvail_flg_minval /end REF_CHARACTERISTIC
/end GROUP
/begin GROUP S956_Signal_Override "SWC_OUTP_type/run_SWC_OUTP_5ms_sys/OUTP/outpmodule/VVMC_VMCACCCtrlAvail_flg_Inproc/Signal_Override"
 /begin REF_CHARACTERISTIC KOUTP_VMCACCCtrlAvail_flg_ovrdflg KOUTP_VMCACCCtrlAvail_flg_ovrdval /end REF_CHARACTERISTIC
/end GROUP
/begin GROUP S957_Signal_Limit "SWC_OUTP_type/run_SWC_OUTP_5ms_sys/OUTP/outpmodule/VVMC_VMCAEBCtrlAvail_flg_Inproc/Signal_Limit"
 /begin REF_CHARACTERISTIC KOUTP_VMCAEBCtrlAvail_flg_maxval KOUTP_VMCAEBCtrlAvail_flg_minval /end REF_CHARACTERISTIC
/end GROUP
/begin GROUP S957_Signal_Override "SWC_OUTP_type/run_SWC_OUTP_5ms_sys/OUTP/outpmodule/VVMC_VMCAEBCtrlAvail_flg_Inproc/Signal_Override"
 /begin REF_CHARACTERISTIC KOUTP_VMCAEBCtrlAvail_flg_ovrdflg KOUTP_VMCAEBCtrlAvail_flg_ovrdval /end REF_CHARACTERISTIC
/end GROUP
/begin GROUP S958_Signal_Limit "SWC_OUTP_type/run_SWC_OUTP_5ms_sys/OUTP/outpmodule/VVMC_VMCCCCtrlAvail_flg_Inproc/Signal_Limit"
 /begin REF_CHARACTERISTIC KOUTP_VMCCCCtrlAvail_flg_maxval KOUTP_VMCCCCtrlAvail_flg_minval /end REF_CHARACTERISTIC
/end GROUP
/begin GROUP S958_Signal_Override "SWC_OUTP_type/run_SWC_OUTP_5ms_sys/OUTP/outpmodule/VVMC_VMCCCCtrlAvail_flg_Inproc/Signal_Override"
 /begin REF_CHARACTERISTIC KOUTP_VMCCCCtrlAvail_flg_ovrdflg KOUTP_VMCCCCtrlAvail_flg_ovrdval /end REF_CHARACTERISTIC
/end GROUP
/begin GROUP S959_Signal_Limit "SWC_OUTP_type/run_SWC_OUTP_5ms_sys/OUTP/outpmodule/VVMC_VMCMSACtrlAvail_flg_Inproc/Signal_Limit"
 /begin REF_CHARACTERISTIC KOUTP_VMCMSACtrlAvail_flg_maxval KOUTP_VMCMSACtrlAvail_flg_minval /end REF_CHARACTERISTIC
/end GROUP
/begin GROUP S959_Signal_Override "SWC_OUTP_type/run_SWC_OUTP_5ms_sys/OUTP/outpmodule/VVMC_VMCMSACtrlAvail_flg_Inproc/Signal_Override"
 /begin REF_CHARACTERISTIC KOUTP_VMCMSACtrlAvail_flg_ovrdflg KOUTP_VMCMSACtrlAvail_flg_ovrdval /end REF_CHARACTERISTIC
/end GROUP
/begin GROUP S960_Signal_Limit "SWC_OUTP_type/run_SWC_OUTP_5ms_sys/OUTP/outpmodule/VVMC_VehicleSpeed_kph_Inproc/Signal_Limit"
 /begin REF_CHARACTERISTIC KOUTP_VehicleSpeed_kph_maxval KOUTP_VehicleSpeed_kph_minval /end REF_CHARACTERISTIC
/end GROUP
/begin GROUP S960_Signal_Override "SWC_OUTP_type/run_SWC_OUTP_5ms_sys/OUTP/outpmodule/VVMC_VehicleSpeed_kph_Inproc/Signal_Override"
 /begin REF_CHARACTERISTIC KOUTP_VehicleSpeed_kph_ovrdflg KOUTP_VehicleSpeed_kph_ovrdval /end REF_CHARACTERISTIC
/end GROUP
/begin GROUP S961_Signal_Limit "SWC_OUTP_type/run_SWC_OUTP_5ms_sys/OUTP/outpmodule/VVMC_VehicleSpeed_mph_Inproc/Signal_Limit"
 /begin REF_CHARACTERISTIC KOUTP_VehicleSpeed_mph_maxval KOUTP_VehicleSpeed_mph_minval /end REF_CHARACTERISTIC
/end GROUP
/begin GROUP S961_Signal_Override "SWC_OUTP_type/run_SWC_OUTP_5ms_sys/OUTP/outpmodule/VVMC_VehicleSpeed_mph_Inproc/Signal_Override"
 /begin REF_CHARACTERISTIC KOUTP_VehicleSpeed_mph_ovrdflg KOUTP_VehicleSpeed_mph_ovrdval /end REF_CHARACTERISTIC
/end GROUP
/end MODULE
/end PROJECT
