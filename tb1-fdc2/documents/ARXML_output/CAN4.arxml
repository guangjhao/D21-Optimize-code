[part 2 of 2: packages /CAN4/Cluster to /CAN4/ImplementationDataTypes]
AUTOSAR XML (schema 4-3-0)
package /CAN4/Cluster  (continued)
  can cluster CAN4: baudrate=500, can-fd-baudrate=2000  (continued)
    can physical channel CAN4: comm-connectors=ConnCAN4  (continued)
      frame CAN4_ZONE_FR_VCU: id 0x1F2, frame-length=48, can-addressing-mode=STANDARD, can-fd-frame-support=true, can-frame-rx-behavior=CAN-FD, can-frame-tx-behavior=CAN-FD
        pdu CAN4_ZONE_FR_VCU: length=48, minimum-delay=0.0, transmission-mode-true-timing={cyclic-timing=time-period=0.02, event-controlled-timing={number-of-repetitions=0, repetition-period=0}}, unused-bit-pattern=0
          mapping CAN4_SG_ZONE_FR_VCU: i-signal-group=CAN4_SG_ZONE_FR_VCU, start-position=0, transfer-property=TRIGGERED-ON-CHANGE
          signal CAN4_Bat_In_Temp: start 263, 8 bit, big-endian, i-signal-type=PRIMITIVE, init-value=constant-reference=Init_CAN4_Bat_In_Temp, base-type=uint8, implementation-data-type=uint8, transfer-property=PENDING
          signal CAN4_Bat_In_Temp_Err: start 335, 2 bit, big-endian, i-signal-type=PRIMITIVE, init-value=constant-reference=Init_CAN4_Bat_In_Temp_Err, base-type=uint8, implementation-data-type=uint8, transfer-property=TRIGGERED-ON-CHANGE
          signal CAN4_Bat_Out_Temp: start 255, 8 bit, big-endian, i-signal-type=PRIMITIVE, init-value=constant-reference=Init_CAN4_Bat_Out_Temp, base-type=uint8, implementation-data-type=uint8, transfer-property=PENDING
          signal CAN4_Bat_Out_Temp_Err: start 323, 2 bit, big-endian, i-signal-type=PRIMITIVE, init-value=constant-reference=Init_CAN4_Bat_Out_Temp_Err, base-type=uint8, implementation-data-type=uint8, transfer-property=TRIGGERED-ON-CHANGE
          signal CAN4_COMP_Err: start 297, 2 bit, big-endian, i-signal-type=PRIMITIVE, init-value=constant-reference=Init_CAN4_COMP_Err, base-type=uint8, implementation-data-type=uint8, transfer-property=TRIGGERED-ON-CHANGE
          signal CAN4_EACProtectEnable: start 183, 2 bit, big-endian, i-signal-type=PRIMITIVE, init-value=constant-reference=Init_CAN4_EACProtectEnable, base-type=uint8, implementation-data-type=uint8, transfer-property=TRIGGERED-ON-CHANGE
          signal CAN4_EWP1_Err: start 295, 2 bit, big-endian, i-signal-type=PRIMITIVE, init-value=constant-reference=Init_CAN4_EWP1_Err, base-type=uint8, implementation-data-type=uint8, transfer-property=TRIGGERED-ON-CHANGE
          signal CAN4_EWP2_Err: start 283, 2 bit, big-endian, i-signal-type=PRIMITIVE, init-value=constant-reference=Init_CAN4_EWP2_Err, base-type=uint8, implementation-data-type=uint8, transfer-property=TRIGGERED-ON-CHANGE
          signal CAN4_EWP3_Err: start 285, 2 bit, big-endian, i-signal-type=PRIMITIVE, init-value=constant-reference=Init_CAN4_EWP3_Err, base-type=uint8, implementation-data-type=uint8, transfer-property=TRIGGERED-ON-CHANGE
          signal CAN4_EXV1_Err: start 301, 2 bit, big-endian, i-signal-type=PRIMITIVE, init-value=constant-reference=Init_CAN4_EXV1_Err, base-type=uint8, implementation-data-type=uint8, transfer-property=TRIGGERED-ON-CHANGE
          signal CAN4_EXV2_Err: start 303, 2 bit, big-endian, i-signal-type=PRIMITIVE, init-value=constant-reference=Init_CAN4_EXV2_Err, base-type=uint8, implementation-data-type=uint8, transfer-property=TRIGGERED-ON-CHANGE
          signal CAN4_FWV_Err: start 281, 2 bit, big-endian, i-signal-type=PRIMITIVE, init-value=constant-reference=Init_CAN4_FWV_Err, base-type=uint8, implementation-data-type=uint8, transfer-property=TRIGGERED-ON-CHANGE
          signal CAN4_Fan_Err: start 289, 2 bit, big-endian, i-signal-type=PRIMITIVE, init-value=constant-reference=Init_CAN4_Fan_Err, base-type=uint8, implementation-data-type=uint8, transfer-property=TRIGGERED-ON-CHANGE
          signal CAN4_FrBMSCCUCErr: start 84, 1 bit, big-endian, i-signal-type=PRIMITIVE, init-value=constant-reference=Init_CAN4_FrBMSCCUCErr, base-type=uint8, implementation-data-type=uint8, transfer-property=TRIGGERED-ON-CHANGE
          signal CAN4_FrBMS_CCU_CIRCurr: start 15, 8 bit, big-endian, i-signal-type=PRIMITIVE, init-value=constant-reference=Init_CAN4_FrBMS_CCU_CIRCurr, base-type=uint8, implementation-data-type=uint8, transfer-property=PENDING
          signal CAN4_FrBMS_CCU_CIRFault: start 39, 3 bit, big-endian, i-signal-type=PRIMITIVE, init-value=constant-reference=Init_CAN4_FrBMS_CCU_CIRFault, base-type=uint8, implementation-data-type=uint8, transfer-property=PENDING
          signal CAN4_FrCtrlBDVolt: start 107, 12 bit, big-endian, i-signal-type=PRIMITIVE, init-value=constant-reference=Init_CAN4_FrCtrlBDVolt, base-type=uint16, implementation-data-type=uint16, transfer-property=PENDING
          signal CAN4_FrCtrlTemp: start 127, 16 bit, big-endian, i-signal-type=PRIMITIVE, init-value=constant-reference=Init_CAN4_FrCtrlTemp, base-type=uint16, implementation-data-type=uint16, transfer-property=PENDING
          signal CAN4_FrEDUErr: start 83, 1 bit, big-endian, i-signal-type=PRIMITIVE, init-value=constant-reference=Init_CAN4_FrEDUErr, base-type=uint8, implementation-data-type=uint8, transfer-property=TRIGGERED-ON-CHANGE
          signal CAN4_FrEDU_INVERTERCurr: start 23, 8 bit, big-endian, i-signal-type=PRIMITIVE, init-value=constant-reference=Init_CAN4_FrEDU_INVERTERCurr, base-type=uint8, implementation-data-type=uint8, transfer-property=PENDING
          signal CAN4_FrEDU_INVERTERFault: start 36, 3 bit, big-endian, i-signal-type=PRIMITIVE, init-value=constant-reference=Init_CAN4_FrEDU_INVERTERFault, base-type=uint8, implementation-data-type=uint8, transfer-property=PENDING
          signal CAN4_FrIRC_1Curr: start 41, 10 bit, big-endian, i-signal-type=PRIMITIVE, init-value=constant-reference=Init_CAN4_FrIRC_1Curr, base-type=uint16, implementation-data-type=uint16, transfer-property=PENDING
          signal CAN4_FrIRC_2Curr: start 81, 10 bit, big-endian, i-signal-type=PRIMITIVE, init-value=constant-reference=Init_CAN4_FrIRC_2Curr, base-type=uint16, implementation-data-type=uint16, transfer-property=PENDING
          signal CAN4_FrPMMLVOutPErrLmp: start 46, 1 bit, big-endian, i-signal-type=PRIMITIVE, init-value=constant-reference=Init_CAN4_FrPMMLVOutPErrLmp, base-type=uint8, implementation-data-type=uint8, transfer-property=TRIGGERED-ON-CHANGE
          signal CAN4_FrPMMLimpHomeActReq: start 45, 1 bit, big-endian, i-signal-type=PRIMITIVE, init-value=constant-reference=Init_CAN4_FrPMMLimpHomeActReq, base-type=uint8, implementation-data-type=uint8, transfer-property=TRIGGERED-ON-CHANGE
          signal CAN4_FrPMMSysErrLmp: start 47, 1 bit, big-endian, i-signal-type=PRIMITIVE, init-value=constant-reference=Init_CAN4_FrPMMSysErrLmp, base-type=uint8, implementation-data-type=uint8, transfer-property=TRIGGERED-ON-CHANGE
          signal CAN4_FrPowerTemp1: start 159, 16 bit, big-endian, i-signal-type=PRIMITIVE, init-value=constant-reference=Init_CAN4_FrPowerTemp1, base-type=uint16, implementation-data-type=uint16, transfer-property=PENDING
          signal CAN4_FrPowerTemp2: start 143, 16 bit, big-endian, i-signal-type=PRIMITIVE, init-value=constant-reference=Init_CAN4_FrPowerTemp2, base-type=uint16, implementation-data-type=uint16, transfer-property=PENDING
          signal CAN4_FrPwrONA1Fault: start 25, 2 bit, big-endian, i-signal-type=PRIMITIVE, init-value=constant-reference=Init_CAN4_FrPwrONA1Fault, base-type=uint8, implementation-data-type=uint8, transfer-property=PENDING
          signal CAN4_FrPwrONA2Curr: start 79, 8 bit, big-endian, i-signal-type=PRIMITIVE, init-value=constant-reference=Init_CAN4_FrPwrONA2Curr, base-type=uint8, implementation-data-type=uint8, transfer-property=PENDING
          signal CAN4_FrPwrONA3Curr: start 71, 8 bit, big-endian, i-signal-type=PRIMITIVE, init-value=constant-reference=Init_CAN4_FrPwrONA3Curr, base-type=uint8, implementation-data-type=uint8, transfer-property=PENDING
          signal CAN4_FrPwrSta: start 111, 3 bit, big-endian, i-signal-type=PRIMITIVE, init-value=constant-reference=Init_CAN4_FrPwrSta, base-type=uint8, implementation-data-type=uint8, transfer-property=TRIGGERED-ON-CHANGE
          signal CAN4_FrPwrStdbyA1Fault: start 33, 2 bit, big-endian, i-signal-type=PRIMITIVE, init-value=constant-reference=Init_CAN4_FrPwrStdbyA1Fault, base-type=uint8, implementation-data-type=uint8, transfer-property=PENDING
          signal CAN4_FrPwrStdbyA1PlusCurr: start 103, 8 bit, big-endian, i-signal-type=PRIMITIVE, init-value=constant-reference=Init_CAN4_FrPwrStdbyA1PlusCurr, base-type=uint8, implementation-data-type=uint8, transfer-property=PENDING
          signal CAN4_FrPwrStdbyA1PlusFault: start 31, 3 bit, big-endian, i-signal-type=PRIMITIVE, init-value=constant-reference=Init_CAN4_FrPwrStdbyA1PlusFault, base-type=uint8, implementation-data-type=uint8, transfer-property=PENDING
          signal CAN4_FrPwrStdbyA2Curr: start 63, 8 bit, big-endian, i-signal-type=PRIMITIVE, init-value=constant-reference=Init_CAN4_FrPwrStdbyA2Curr, base-type=uint8, implementation-data-type=uint8, transfer-property=PENDING
          signal CAN4_FrPwrStdbyA2PlusCurr: start 7, 8 bit, big-endian, i-signal-type=PRIMITIVE, init-value=constant-reference=Init_CAN4_FrPwrStdbyA2PlusCurr, base-type=uint8, implementation-data-type=uint8, transfer-property=PENDING
          signal CAN4_FrPwrStdbyA2PlusFault: start 28, 3 bit, big-endian, i-signal-type=PRIMITIVE, init-value=constant-reference=Init_CAN4_FrPwrStdbyA2PlusFault, base-type=uint8, implementation-data-type=uint8, transfer-property=PENDING
          signal CAN4_FrStdA1PCErr: start 87, 1 bit, big-endian, i-signal-type=PRIMITIVE, init-value=constant-reference=Init_CAN4_FrStdA1PCErr, base-type=uint8, implementation-data-type=uint8, transfer-property=TRIGGERED-ON-CHANGE
          signal CAN4_FrStdA2PCErr: start 85, 1 bit, big-endian, i-signal-type=PRIMITIVE, init-value=constant-reference=Init_CAN4_FrStdA2PCErr, base-type=uint8, implementation-data-type=uint8, transfer-property=TRIGGERED-ON-CHANGE
          signal CAN4_FrStdA2PErr: start 86, 1 bit, big-endian, i-signal-type=PRIMITIVE, init-value=constant-reference=Init_CAN4_FrStdA2PErr, base-type=uint8, implementation-data-type=uint8, transfer-property=TRIGGERED-ON-CHANGE
          signal CAN4_Motor_In_Temp: start 279, 8 bit, big-endian, i-signal-type=PRIMITIVE, init-value=constant-reference=Init_CAN4_Motor_In_Temp, base-type=uint8, implementation-data-type=uint8, transfer-property=PENDING
          signal CAN4_Motor_In_Temp_Err: start 321, 2 bit, big-endian, i-signal-type=PRIMITIVE, init-value=constant-reference=Init_CAN4_Motor_In_Temp_Err, base-type=uint8, implementation-data-type=uint8, transfer-property=TRIGGERED-ON-CHANGE
          signal CAN4_Motor_Out_Temp: start 271, 8 bit, big-endian, i-signal-type=PRIMITIVE, init-value=constant-reference=Init_CAN4_Motor_Out_Temp, base-type=uint8, implementation-data-type=uint8, transfer-property=PENDING
          signal CAN4_Motor_Out_Temp_Err: start 325, 2 bit, big-endian, i-signal-type=PRIMITIVE, init-value=constant-reference=Init_CAN4_Motor_Out_Temp_Err, base-type=uint8, implementation-data-type=uint8, transfer-property=TRIGGERED-ON-CHANGE
          signal CAN4_PT_High_P: start 179, 12 bit, big-endian, i-signal-type=PRIMITIVE, init-value=constant-reference=Init_CAN4_PT_High_P, base-type=uint16, implementation-data-type=uint16, transfer-property=PENDING
          signal CAN4_PT_High_P_Err: start 319, 2 bit, big-endian, i-signal-type=PRIMITIVE, init-value=constant-reference=Init_CAN4_PT_High_P_Err, base-type=uint8, implementation-data-type=uint8, transfer-property=TRIGGERED-ON-CHANGE
          signal CAN4_PT_High_T: start 199, 8 bit, big-endian, i-signal-type=PRIMITIVE, init-value=constant-reference=Init_CAN4_PT_High_T, base-type=uint8, implementation-data-type=uint8, transfer-property=PENDING
          signal CAN4_PT_High_Tact: start 175, 8 bit, big-endian, i-signal-type=PRIMITIVE, init-value=constant-reference=Init_CAN4_PT_High_Tact, base-type=uint8, implementation-data-type=uint8, transfer-property=PENDING
          signal CAN4_PT_High_Tact_Err: start 305, 2 bit, big-endian, i-signal-type=PRIMITIVE, init-value=constant-reference=Init_CAN4_PT_High_Tact_Err, base-type=uint8, implementation-data-type=uint8, transfer-property=TRIGGERED-ON-CHANGE
          signal CAN4_PT_Low_P1: start 219, 12 bit, big-endian, i-signal-type=PRIMITIVE, init-value=constant-reference=Init_CAN4_PT_Low_P1, base-type=uint16, implementation-data-type=uint16, transfer-property=PENDING
          signal CAN4_PT_Low_P1_Err: start 327, 2 bit, big-endian, i-signal-type=PRIMITIVE, init-value=constant-reference=Init_CAN4_PT_Low_P1_Err, base-type=uint8, implementation-data-type=uint8, transfer-property=TRIGGERED-ON-CHANGE
          signal CAN4_PT_Low_P2: start 215, 12 bit, big-endian, i-signal-type=PRIMITIVE, init-value=constant-reference=Init_CAN4_PT_Low_P2, base-type=uint16, implementation-data-type=uint16, transfer-property=PENDING
          signal CAN4_PT_Low_P2_Err: start 315, 2 bit, big-endian, i-signal-type=PRIMITIVE, init-value=constant-reference=Init_CAN4_PT_Low_P2_Err, base-type=uint8, implementation-data-type=uint8, transfer-property=TRIGGERED-ON-CHANGE
          signal CAN4_PT_Low_T1: start 239, 8 bit, big-endian, i-signal-type=PRIMITIVE, init-value=constant-reference=Init_CAN4_PT_Low_T1, base-type=uint8, implementation-data-type=uint8, transfer-property=PENDING
          signal CAN4_PT_Low_T1_Err: start 313, 2 bit, big-endian, i-signal-type=PRIMITIVE, init-value=constant-reference=Init_CAN4_PT_Low_T1_Err, base-type=uint8, implementation-data-type=uint8, transfer-property=TRIGGERED-ON-CHANGE
          signal CAN4_PT_Low_T2: start 207, 8 bit, big-endian, i-signal-type=PRIMITIVE, init-value=constant-reference=Init_CAN4_PT_Low_T2, base-type=uint8, implementation-data-type=uint8, transfer-property=PENDING
          signal CAN4_PT_Low_T2_Err: start 317, 2 bit, big-endian, i-signal-type=PRIMITIVE, init-value=constant-reference=Init_CAN4_PT_Low_T2_Err, base-type=uint8, implementation-data-type=uint8, transfer-property=TRIGGERED-ON-CHANGE
          signal CAN4_SOTXV_Err: start 299, 2 bit, big-endian, i-signal-type=PRIMITIVE, init-value=constant-reference=Init_CAN4_SOTXV_Err, base-type=uint8, implementation-data-type=uint8, transfer-property=TRIGGERED-ON-CHANGE
          signal CAN4_SOV1_Err: start 307, 2 bit, big-endian, i-signal-type=PRIMITIVE, init-value=constant-reference=Init_CAN4_SOV1_Err, base-type=uint8, implementation-data-type=uint8, transfer-property=TRIGGERED-ON-CHANGE
          signal CAN4_SOV2_Err: start 309, 2 bit, big-endian, i-signal-type=PRIMITIVE, init-value=constant-reference=Init_CAN4_SOV2_Err, base-type=uint8, implementation-data-type=uint8, transfer-property=TRIGGERED-ON-CHANGE
          signal CAN4_SOV3_Err: start 311, 2 bit, big-endian, i-signal-type=PRIMITIVE, init-value=constant-reference=Init_CAN4_SOV3_Err, base-type=uint8, implementation-data-type=uint8, transfer-property=TRIGGERED-ON-CHANGE
          signal CAN4_TWV_Err: start 287, 2 bit, big-endian, i-signal-type=PRIMITIVE, init-value=constant-reference=Init_CAN4_TWV_Err, base-type=uint8, implementation-data-type=uint8, transfer-property=TRIGGERED-ON-CHANGE
          signal CAN4_Tamb: start 247, 8 bit, big-endian, i-signal-type=PRIMITIVE, init-value=constant-reference=Init_CAN4_Tamb, base-type=uint8, implementation-data-type=uint8, transfer-property=PENDING
          signal CAN4_Tamb_Err: start 333, 2 bit, big-endian, i-signal-type=PRIMITIVE, init-value=constant-reference=Init_CAN4_Tamb_Err, base-type=uint8, implementation-data-type=uint8, transfer-property=TRIGGERED-ON-CHANGE
          signal CAN4_WPTC_Err: start 293, 2 bit, big-endian, i-signal-type=PRIMITIVE, init-value=constant-reference=Init_CAN4_WPTC_Err, base-type=uint8, implementation-data-type=uint8, transfer-property=TRIGGERED-ON-CHANGE
          signal CAN4_ZFR_SYS_BMSCCURetryCnt_Sta: start 351, 8 bit, big-endian, i-signal-type=PRIMITIVE, init-value=constant-reference=Init_CAN4_ZFR_SYS_BMSCCURetryCnt_Sta, base-type=uint8, implementation-data-type=uint8, transfer-property=TRIGGERED-ON-CHANGE
          signal CAN4_ZFR_SYS_BSWSleepReq_Sta: start 82, 1 bit, big-endian, i-signal-type=PRIMITIVE, init-value=constant-reference=Init_CAN4_ZFR_SYS_BSWSleepReq_Sta, base-type=uint8, implementation-data-type=uint8, transfer-property=TRIGGERED-ON-CHANGE
          signal CAN4_ZFR_SYS_MCURetryCnt_Sta: start 343, 8 bit, big-endian, i-signal-type=PRIMITIVE, init-value=constant-reference=Init_CAN4_ZFR_SYS_MCURetryCnt_Sta, base-type=uint8, implementation-data-type=uint8, transfer-property=TRIGGERED-ON-CHANGE
          signal CAN4_ZFR_VCU_HWReset_Sta: start 356, 5 bit, big-endian, i-signal-type=PRIMITIVE, init-value=constant-reference=Init_CAN4_ZFR_VCU_HWReset_Sta, base-type=uint8, implementation-data-type=uint8, transfer-property=TRIGGERED-ON-CHANGE
          signal CAN4_ZFR_VCU_PwrSupply_Sta: start 108, 1 bit, big-endian, i-signal-type=PRIMITIVE, init-value=constant-reference=Init_CAN4_ZFR_VCU_PwrSupply_Sta, base-type=uint8, implementation-data-type=uint8, transfer-property=TRIGGERED-ON-CHANGE
          signal CAN4_ZoneFrMalfunLevel: start 44, 3 bit, big-endian, i-signal-type=PRIMITIVE, init-value=constant-reference=Init_CAN4_ZoneFrMalfunLevel, base-type=uint8, implementation-data-type=uint8, transfer-property=TRIGGERED-ON-CHANGE
      frame CAN4_zGW_APTC1: id 0x223, frame-length=24, can-addressing-mode=STANDARD, can-fd-frame-support=true, can-frame-rx-behavior=CAN-FD, can-frame-tx-behavior=CAN-FD
        pdu CAN4_zGW_APTC1: length=24, minimum-delay=0.0, transmission-mode-true-timing=cyclic-timing=time-period=0.1, unused-bit-pattern=0
          mapping CAN4_SG_zGW_APTC1: i-signal-group=CAN4_SG_zGW_APTC1, start-position=0, transfer-property=PENDING
          signal CAN4_FrntPTCBusLineHiV: start 177, 10 bit, big-endian, i-signal-type=PRIMITIVE, init-value=constant-reference=Init_CAN4_FrntPTCBusLineHiV, base-type=uint16, implementation-data-type=uint16, transfer-property=PENDING
          signal CAN4_FrntPTCComFlt: start 20, 1 bit, big-endian, i-signal-type=PRIMITIVE, init-value=constant-reference=Init_CAN4_FrntPTCComFlt, base-type=uint8, implementation-data-type=uint8, transfer-property=PENDING
          signal CAN4_FrntPTCFltSt: start 6, 2 bit, big-endian, i-signal-type=PRIMITIVE, init-value=constant-reference=Init_CAN4_FrntPTCFltSt, base-type=uint8, implementation-data-type=uint8, transfer-property=PENDING
          signal CAN4_FrntPTCHVOverUFlt: start 1, 1 bit, big-endian, i-signal-type=PRIMITIVE, init-value=constant-reference=Init_CAN4_FrntPTCHVOverUFlt, base-type=uint8, implementation-data-type=uint8, transfer-property=PENDING
          signal CAN4_FrntPTCHVUnderUFlt: start 2, 1 bit, big-endian, i-signal-type=PRIMITIVE, init-value=constant-reference=Init_CAN4_FrntPTCHVUnderUFlt, base-type=uint8, implementation-data-type=uint8, transfer-property=PENDING
          signal CAN4_FrntPTCHWVers: start 39, 8 bit, big-endian, i-signal-type=PRIMITIVE, init-value=constant-reference=Init_CAN4_FrntPTCHWVers, base-type=uint8, implementation-data-type=uint8, transfer-property=PENDING
          signal CAN4_FrntPTCLVOverUFlt: start 3, 1 bit, big-endian, i-signal-type=PRIMITIVE, init-value=constant-reference=Init_CAN4_FrntPTCLVOverUFlt, base-type=uint8, implementation-data-type=uint8, transfer-property=PENDING
          signal CAN4_FrntPTCLVUnderUFlt: start 4, 1 bit, big-endian, i-signal-type=PRIMITIVE, init-value=constant-reference=Init_CAN4_FrntPTCLVUnderUFlt, base-type=uint8, implementation-data-type=uint8, transfer-property=PENDING
          signal CAN4_FrntPTCLeActHeatPwr: start 87, 8 bit, big-endian, i-signal-type=PRIMITIVE, init-value=constant-reference=Init_CAN4_FrntPTCLeActHeatPwr, base-type=uint8, implementation-data-type=uint8, transfer-property=PENDING
          signal CAN4_FrntPTCLeBusLineC: start 167, 8 bit, big-endian, i-signal-type=PRIMITIVE, init-value=constant-reference=Init_CAN4_FrntPTCLeBusLineC, base-type=uint8, implementation-data-type=uint8, transfer-property=PENDING
          signal CAN4_FrntPTCLeCoreOverTFlt: start 12, 1 bit, big-endian, i-signal-type=PRIMITIVE, init-value=constant-reference=Init_CAN4_FrntPTCLeCoreOverTFlt, base-type=uint8, implementation-data-type=uint8, transfer-property=PENDING
          signal CAN4_FrntPTCLeCoreT: start 71, 8 bit, big-endian, i-signal-type=PRIMITIVE, init-value=constant-reference=Init_CAN4_FrntPTCLeCoreT, base-type=uint8, implementation-data-type=uint8, transfer-property=PENDING
          signal CAN4_FrntPTCLeCoreTSnsrFlt: start 14, 1 bit, big-endian, i-signal-type=PRIMITIVE, init-value=constant-reference=Init_CAN4_FrntPTCLeCoreTSnsrFlt, base-type=uint8, implementation-data-type=uint8, transfer-property=PENDING
          signal CAN4_FrntPTCLeIGBTOverTFlt: start 17, 1 bit, big-endian, i-signal-type=PRIMITIVE, init-value=constant-reference=Init_CAN4_FrntPTCLeIGBTOverTFlt, base-type=uint8, implementation-data-type=uint8, transfer-property=PENDING
          signal CAN4_FrntPTCLeIGBTShoCircFlt: start 10, 1 bit, big-endian, i-signal-type=PRIMITIVE, init-value=constant-reference=Init_CAN4_FrntPTCLeIGBTShoCircFlt, base-type=uint8, implementation-data-type=uint8, transfer-property=PENDING
          signal CAN4_FrntPTCLeIGBTT: start 103, 8 bit, big-endian, i-signal-type=PRIMITIVE, init-value=constant-reference=Init_CAN4_FrntPTCLeIGBTT, base-type=uint8, implementation-data-type=uint8, transfer-property=PENDING
          signal CAN4_FrntPTCLeIGBTTSnsrFlt: start 19, 1 bit, big-endian, i-signal-type=PRIMITIVE, init-value=constant-reference=Init_CAN4_FrntPTCLeIGBTTSnsrFlt, base-type=uint8, implementation-data-type=uint8, transfer-property=PENDING
          signal CAN4_FrntPTCLeOpentCircFlt: start 8, 1 bit, big-endian, i-signal-type=PRIMITIVE, init-value=constant-reference=Init_CAN4_FrntPTCLeOpentCircFlt, base-type=uint8, implementation-data-type=uint8, transfer-property=PENDING
          signal CAN4_FrntPTCLeOverAFlt: start 0, 1 bit, big-endian, i-signal-type=PRIMITIVE, init-value=constant-reference=Init_CAN4_FrntPTCLeOverAFlt, base-type=uint8, implementation-data-type=uint8, transfer-property=PENDING
          signal CAN4_FrntPTCPCBOverTFlt: start 21, 1 bit, big-endian, i-signal-type=PRIMITIVE, init-value=constant-reference=Init_CAN4_FrntPTCPCBOverTFlt, base-type=uint8, implementation-data-type=uint8, transfer-property=PENDING
          signal CAN4_FrntPTCPCBT: start 119, 8 bit, big-endian, i-signal-type=PRIMITIVE, init-value=constant-reference=Init_CAN4_FrntPTCPCBT, base-type=uint8, implementation-data-type=uint8, transfer-property=PENDING
          signal CAN4_FrntPTCPCBTSnsrFlt: start 22, 1 bit, big-endian, i-signal-type=PRIMITIVE, init-value=constant-reference=Init_CAN4_FrntPTCPCBTSnsrFlt, base-type=uint8, implementation-data-type=uint8, transfer-property=PENDING
          signal CAN4_FrntPTCRearLeActHeatPwr: start 135, 8 bit, big-endian, i-signal-type=PRIMITIVE, init-value=constant-reference=Init_CAN4_FrntPTCRearLeActHeatPwr, base-type=uint8, implementation-data-type=uint8, transfer-property=PENDING
          signal CAN4_FrntPTCRearLeBusLineC: start 63, 8 bit, big-endian, i-signal-type=PRIMITIVE, init-value=constant-reference=Init_CAN4_FrntPTCRearLeBusLineC, base-type=uint8, implementation-data-type=uint8, transfer-property=PENDING
          signal CAN4_FrntPTCRearLeCoreOverTFlt: start 40, 1 bit, big-endian, i-signal-type=PRIMITIVE, init-value=constant-reference=Init_CAN4_FrntPTCRearLeCoreOverTFlt, base-type=uint8, implementation-data-type=uint8, transfer-property=PENDING
          signal CAN4_FrntPTCRearLeCoreT: start 143, 8 bit, big-endian, i-signal-type=PRIMITIVE, init-value=constant-reference=Init_CAN4_FrntPTCRearLeCoreT, base-type=uint8, implementation-data-type=uint8, transfer-property=PENDING
          signal CAN4_FrntPTCRearLeCoreTSnsrFlt: start 54, 1 bit, big-endian, i-signal-type=PRIMITIVE, init-value=constant-reference=Init_CAN4_FrntPTCRearLeCoreTSnsrFlt, base-type=uint8, implementation-data-type=uint8, transfer-property=PENDING
          signal CAN4_FrntPTCRearLeIGBTShoCFlt: start 50, 1 bit, big-endian, i-signal-type=PRIMITIVE, init-value=constant-reference=Init_CAN4_FrntPTCRearLeIGBTShoCFlt, base-type=uint8, implementation-data-type=uint8, transfer-property=PENDING
          signal CAN4_FrntPTCRearLeOpentCircFlt: start 42, 1 bit, big-endian, i-signal-type=PRIMITIVE, init-value=constant-reference=Init_CAN4_FrntPTCRearLeOpentCircFlt, base-type=uint8, implementation-data-type=uint8, transfer-property=PENDING
          signal CAN4_FrntPTCRearLeOverAFlt: start 43, 1 bit, big-endian, i-signal-type=PRIMITIVE, init-value=constant-reference=Init_CAN4_FrntPTCRearLeOverAFlt, base-type=uint8, implementation-data-type=uint8, transfer-property=PENDING
          signal CAN4_FrntPTCRearRiActHeatPwr: start 151, 8 bit, big-endian, i-signal-type=PRIMITIVE, init-value=constant-reference=Init_CAN4_FrntPTCRearRiActHeatPwr, base-type=uint8, implementation-data-type=uint8, transfer-property=PENDING
          signal CAN4_FrntPTCRearRiBusLineC: start 127, 8 bit, big-endian, i-signal-type=PRIMITIVE, init-value=constant-reference=Init_CAN4_FrntPTCRearRiBusLineC, base-type=uint8, implementation-data-type=uint8, transfer-property=PENDING
          signal CAN4_FrntPTCRearRiCoreOverTFlt: start 41, 1 bit, big-endian, i-signal-type=PRIMITIVE, init-value=constant-reference=Init_CAN4_FrntPTCRearRiCoreOverTFlt, base-type=uint8, implementation-data-type=uint8, transfer-property=PENDING
          signal CAN4_FrntPTCRearRiCoreT: start 159, 8 bit, big-endian, i-signal-type=PRIMITIVE, init-value=constant-reference=Init_CAN4_FrntPTCRearRiCoreT, base-type=uint8, implementation-data-type=uint8, transfer-property=PENDING
          signal CAN4_FrntPTCRearRiCoreTSnsrFlt: start 55, 1 bit, big-endian, i-signal-type=PRIMITIVE, init-value=constant-reference=Init_CAN4_FrntPTCRearRiCoreTSnsrFlt, base-type=uint8, implementation-data-type=uint8, transfer-property=PENDING
          signal CAN4_FrntPTCRearRiIGBTShoCFlt: start 51, 1 bit, big-endian, i-signal-type=PRIMITIVE, init-value=constant-reference=Init_CAN4_FrntPTCRearRiIGBTShoCFlt, base-type=uint8, implementation-data-type=uint8, transfer-property=PENDING
          signal CAN4_FrntPTCRearRiOpentCircFlt: start 52, 1 bit, big-endian, i-signal-type=PRIMITIVE, init-value=constant-reference=Init_CAN4_FrntPTCRearRiOpentCircFlt, base-type=uint8, implementation-data-type=uint8, transfer-property=PENDING
          signal CAN4_FrntPTCRearRiOverAFlt: start 53, 1 bit, big-endian, i-signal-type=PRIMITIVE, init-value=constant-reference=Init_CAN4_FrntPTCRearRiOverAFlt, base-type=uint8, implementation-data-type=uint8, transfer-property=PENDING
          signal CAN4_FrntPTCRiActHeatPwr: start 95, 8 bit, big-endian, i-signal-type=PRIMITIVE, init-value=constant-reference=Init_CAN4_FrntPTCRiActHeatPwr, base-type=uint8, implementation-data-type=uint8, transfer-property=PENDING
          signal CAN4_FrntPTCRiBusLineC: start 175, 8 bit, big-endian, i-signal-type=PRIMITIVE, init-value=constant-reference=Init_CAN4_FrntPTCRiBusLineC, base-type=uint8, implementation-data-type=uint8, transfer-property=PENDING
          signal CAN4_FrntPTCRiCoreOverTFlt: start 11, 1 bit, big-endian, i-signal-type=PRIMITIVE, init-value=constant-reference=Init_CAN4_FrntPTCRiCoreOverTFlt, base-type=uint8, implementation-data-type=uint8, transfer-property=PENDING
          signal CAN4_FrntPTCRiCoreT: start 79, 8 bit, big-endian, i-signal-type=PRIMITIVE, init-value=constant-reference=Init_CAN4_FrntPTCRiCoreT, base-type=uint8, implementation-data-type=uint8, transfer-property=PENDING
          signal CAN4_FrntPTCRiCoreTSnsrFlt: start 13, 1 bit, big-endian, i-signal-type=PRIMITIVE, init-value=constant-reference=Init_CAN4_FrntPTCRiCoreTSnsrFlt, base-type=uint8, implementation-data-type=uint8, transfer-property=PENDING
          signal CAN4_FrntPTCRiIGBTOverTFlt: start 16, 1 bit, big-endian, i-signal-type=PRIMITIVE, init-value=constant-reference=Init_CAN4_FrntPTCRiIGBTOverTFlt, base-type=uint8, implementation-data-type=uint8, transfer-property=PENDING
          signal CAN4_FrntPTCRiIGBTShoCircFlt: start 9, 1 bit, big-endian, i-signal-type=PRIMITIVE, init-value=constant-reference=Init_CAN4_FrntPTCRiIGBTShoCircFlt, base-type=uint8, implementation-data-type=uint8, transfer-property=PENDING
          signal CAN4_FrntPTCRiIGBTT: start 111, 8 bit, big-endian, i-signal-type=PRIMITIVE, init-value=constant-reference=Init_CAN4_FrntPTCRiIGBTT, base-type=uint8, implementation-data-type=uint8, transfer-property=PENDING
          signal CAN4_FrntPTCRiIGBTTSnsrFlt: start 18, 1 bit, big-endian, i-signal-type=PRIMITIVE, init-value=constant-reference=Init_CAN4_FrntPTCRiIGBTTSnsrFlt, base-type=uint8, implementation-data-type=uint8, transfer-property=PENDING
          signal CAN4_FrntPTCRiOpentCircFlt: start 23, 1 bit, big-endian, i-signal-type=PRIMITIVE, init-value=constant-reference=Init_CAN4_FrntPTCRiOpentCircFlt, base-type=uint8, implementation-data-type=uint8, transfer-property=PENDING
          signal CAN4_FrntPTCRiOverAFlt: start 15, 1 bit, big-endian, i-signal-type=PRIMITIVE, init-value=constant-reference=Init_CAN4_FrntPTCRiOverAFlt, base-type=uint8, implementation-data-type=uint8, transfer-property=PENDING
          signal CAN4_FrntPTCSWVers: start 31, 8 bit, big-endian, i-signal-type=PRIMITIVE, init-value=constant-reference=Init_CAN4_FrntPTCSWVers, base-type=uint8, implementation-data-type=uint8, transfer-property=PENDING
          signal CAN4_FrntPTCSts: start 7, 1 bit, big-endian, i-signal-type=PRIMITIVE, init-value=constant-reference=Init_CAN4_FrntPTCSts, base-type=uint8, implementation-data-type=uint8, transfer-property=PENDING
          signal CAN4_FrntPTCSupplierCod: start 47, 4 bit, big-endian, i-signal-type=PRIMITIVE, init-value=constant-reference=Init_CAN4_FrntPTCSupplierCod, base-type=uint8, implementation-data-type=uint8, transfer-property=PENDING
      frame CAN4_zGW_CANFr1: id 0x30A, frame-length=32, can-addressing-mode=STANDARD, can-fd-frame-support=true, can-frame-rx-behavior=CAN-FD, can-frame-tx-behavior=CAN-FD
        pdu CAN4_zGW_CANFr1: length=32, minimum-delay=0.0, transmission-mode-true-timing=cyclic-timing=time-period=0.1, unused-bit-pattern=0
          mapping CAN4_SG_zGW_CANFr1: i-signal-group=CAN4_SG_zGW_CANFr1, start-position=0, transfer-property=PENDING
          signal CAN4_COMP_ActualPwr: start 228, 13 bit, big-endian, i-signal-type=PRIMITIVE, init-value=constant-reference=Init_CAN4_COMP_ActualPwr, base-type=uint16, implementation-data-type=uint16, transfer-property=PENDING
          signal CAN4_COMP_ComLost: start 58, 1 bit, big-endian, i-signal-type=PRIMITIVE, init-value=constant-reference=Init_CAN4_COMP_ComLost, base-type=uint8, implementation-data-type=uint8, transfer-property=PENDING
          signal CAN4_COMP_ConCur: start 103, 16 bit, big-endian, i-signal-type=PRIMITIVE, init-value=constant-reference=Init_CAN4_COMP_ConCur, base-type=uint16, implementation-data-type=uint16, transfer-property=PENDING
          signal CAN4_COMP_ConVolt: start 119, 16 bit, big-endian, i-signal-type=PRIMITIVE, init-value=constant-reference=Init_CAN4_COMP_ConVolt, base-type=uint16, implementation-data-type=uint16, transfer-property=PENDING
          signal CAN4_COMP_CtrlCircFlt: start 68, 1 bit, big-endian, i-signal-type=PRIMITIVE, init-value=constant-reference=Init_CAN4_COMP_CtrlCircFlt, base-type=uint8, implementation-data-type=uint8, transfer-property=PENDING
          signal CAN4_COMP_CurOverProtect: start 71, 1 bit, big-endian, i-signal-type=PRIMITIVE, init-value=constant-reference=Init_CAN4_COMP_CurOverProtect, base-type=uint8, implementation-data-type=uint8, transfer-property=PENDING
          signal CAN4_COMP_CurVaild: start 87, 1 bit, big-endian, i-signal-type=PRIMITIVE, init-value=constant-reference=Init_CAN4_COMP_CurVaild, base-type=uint8, implementation-data-type=uint8, transfer-property=PENDING
          signal CAN4_COMP_IPM_HWFLt: start 57, 1 bit, big-endian, i-signal-type=PRIMITIVE, init-value=constant-reference=Init_CAN4_COMP_IPM_HWFLt, base-type=uint8, implementation-data-type=uint8, transfer-property=PENDING
          signal CAN4_COMP_IPM_TempOverFlt: start 56, 1 bit, big-endian, i-signal-type=PRIMITIVE, init-value=constant-reference=Init_CAN4_COMP_IPM_TempOverFlt, base-type=uint8, implementation-data-type=uint8, transfer-property=PENDING
          signal CAN4_COMP_Init: start 65, 1 bit, big-endian, i-signal-type=PRIMITIVE, init-value=constant-reference=Init_CAN4_COMP_Init, base-type=uint8, implementation-data-type=uint8, transfer-property=PENDING
          signal CAN4_COMP_SpdVaild: start 64, 1 bit, big-endian, i-signal-type=PRIMITIVE, init-value=constant-reference=Init_CAN4_COMP_SpdVaild, base-type=uint8, implementation-data-type=uint8, transfer-property=PENDING
          signal CAN4_COMP_Sta: start 67, 2 bit, big-endian, i-signal-type=PRIMITIVE, init-value=constant-reference=Init_CAN4_COMP_Sta, base-type=uint8, implementation-data-type=uint8, transfer-property=PENDING
          signal CAN4_COMP_StatorSpd: start 85, 14 bit, big-endian, i-signal-type=PRIMITIVE, init-value=constant-reference=Init_CAN4_COMP_StatorSpd, base-type=uint16, implementation-data-type=uint16, transfer-property=PENDING
          signal CAN4_COMP_VoltLessErr: start 69, 1 bit, big-endian, i-signal-type=PRIMITIVE, init-value=constant-reference=Init_CAN4_COMP_VoltLessErr, base-type=uint8, implementation-data-type=uint8, transfer-property=PENDING
          signal CAN4_COMP_VoltOverErr: start 70, 1 bit, big-endian, i-signal-type=PRIMITIVE, init-value=constant-reference=Init_CAN4_COMP_VoltOverErr, base-type=uint8, implementation-data-type=uint8, transfer-property=PENDING
          signal CAN4_COMP_VoltVaild: start 86, 1 bit, big-endian, i-signal-type=PRIMITIVE, init-value=constant-reference=Init_CAN4_COMP_VoltVaild, base-type=uint8, implementation-data-type=uint8, transfer-property=PENDING
          signal CAN4_EAC_DrvVoltFalt: start 63, 1 bit, big-endian, i-signal-type=PRIMITIVE, init-value=constant-reference=Init_CAN4_EAC_DrvVoltFalt, base-type=uint8, implementation-data-type=uint8, transfer-property=PENDING
          signal CAN4_EAC_MotCrt: start 79, 8 bit, big-endian, i-signal-type=PRIMITIVE, init-value=constant-reference=Init_CAN4_EAC_MotCrt, base-type=uint8, implementation-data-type=uint8, transfer-property=PENDING
          signal CAN4_EAC_MotorLackFalt: start 62, 1 bit, big-endian, i-signal-type=PRIMITIVE, init-value=constant-reference=Init_CAN4_EAC_MotorLackFalt, base-type=uint8, implementation-data-type=uint8, transfer-property=PENDING
          signal CAN4_EAC_OvLoadFalt: start 61, 1 bit, big-endian, i-signal-type=PRIMITIVE, init-value=constant-reference=Init_CAN4_EAC_OvLoadFalt, base-type=uint8, implementation-data-type=uint8, transfer-property=PENDING
          signal CAN4_EAC_Temp: start 39, 8 bit, big-endian, i-signal-type=PRIMITIVE, init-value=constant-reference=Init_CAN4_EAC_Temp, base-type=uint8, implementation-data-type=uint8, transfer-property=PENDING
          signal CAN4_EAC_TempSnsrFalt: start 60, 1 bit, big-endian, i-signal-type=PRIMITIVE, init-value=constant-reference=Init_CAN4_EAC_TempSnsrFalt, base-type=uint8, implementation-data-type=uint8, transfer-property=PENDING
          signal CAN4_PTC1_PowerConsumption: start 31, 8 bit, big-endian, i-signal-type=PRIMITIVE, init-value=constant-reference=Init_CAN4_PTC1_PowerConsumption, base-type=uint8, implementation-data-type=uint8, transfer-property=PENDING
          signal CAN4_PTCActuCrntHSC6: start 161, 10 bit, big-endian, i-signal-type=PRIMITIVE, init-value=constant-reference=Init_CAN4_PTCActuCrntHSC6, base-type=uint16, implementation-data-type=uint16, transfer-property=PENDING
          signal CAN4_PTCActuPWMDutyHSC6: start 7, 8 bit, big-endian, i-signal-type=PRIMITIVE, init-value=constant-reference=Init_CAN4_PTCActuPWMDutyHSC6, base-type=uint8, implementation-data-type=uint8, transfer-property=PENDING
          signal CAN4_PTCActuPwrHSC6: start 47, 16 bit, big-endian, i-signal-type=PRIMITIVE, init-value=constant-reference=Init_CAN4_PTCActuPwrHSC6, base-type=uint16, implementation-data-type=uint16, transfer-property=PENDING
          signal CAN4_PTCActuVolHSC6: start 193, 10 bit, big-endian, i-signal-type=PRIMITIVE, init-value=constant-reference=Init_CAN4_PTCActuVolHSC6, base-type=uint16, implementation-data-type=uint16, transfer-property=PENDING
          signal CAN4_PTCChksmHSC6: start 183, 8 bit, big-endian, i-signal-type=PRIMITIVE, init-value=constant-reference=Init_CAN4_PTCChksmHSC6, base-type=uint8, implementation-data-type=uint8, transfer-property=PENDING
          signal CAN4_PTCFltLvlHSC6: start 199, 4 bit, big-endian, i-signal-type=PRIMITIVE, init-value=constant-reference=Init_CAN4_PTCFltLvlHSC6, base-type=uint8, implementation-data-type=uint8, transfer-property=PENDING
          signal CAN4_PTCHVLckStsHSC6: start 146, 1 bit, big-endian, i-signal-type=PRIMITIVE, init-value=constant-reference=Init_CAN4_PTCHVLckStsHSC6, base-type=uint8, implementation-data-type=uint8, transfer-property=PENDING
          signal CAN4_PTCIGBTOverHeatHSC6: start 145, 1 bit, big-endian, i-signal-type=PRIMITIVE, init-value=constant-reference=Init_CAN4_PTCIGBTOverHeatHSC6, base-type=uint8, implementation-data-type=uint8, transfer-property=PENDING
          signal CAN4_PTCIGBTStsHSC6: start 147, 1 bit, big-endian, i-signal-type=PRIMITIVE, init-value=constant-reference=Init_CAN4_PTCIGBTStsHSC6, base-type=uint8, implementation-data-type=uint8, transfer-property=PENDING
          signal CAN4_PTCIGBTTemHSC6: start 15, 9 bit, big-endian, i-signal-type=PRIMITIVE, init-value=constant-reference=Init_CAN4_PTCIGBTTemHSC6, base-type=uint16, implementation-data-type=uint16, transfer-property=PENDING
          signal CAN4_PTCNTCStsHSC6: start 164, 3 bit, big-endian, i-signal-type=PRIMITIVE, init-value=constant-reference=Init_CAN4_PTCNTCStsHSC6, base-type=uint8, implementation-data-type=uint8, transfer-property=PENDING
          signal CAN4_PTCOtptTemHSC6: start 128, 9 bit, big-endian, i-signal-type=PRIMITIVE, init-value=constant-reference=Init_CAN4_PTCOtptTemHSC6, base-type=uint16, implementation-data-type=uint16, transfer-property=PENDING
          signal CAN4_PTCOverCrntHSC6: start 130, 1 bit, big-endian, i-signal-type=PRIMITIVE, init-value=constant-reference=Init_CAN4_PTCOverCrntHSC6, base-type=uint8, implementation-data-type=uint8, transfer-property=PENDING
          signal CAN4_PTCOverHeatHSC6: start 129, 1 bit, big-endian, i-signal-type=PRIMITIVE, init-value=constant-reference=Init_CAN4_PTCOverHeatHSC6, base-type=uint8, implementation-data-type=uint8, transfer-property=PENDING
          signal CAN4_PTCOverVolHSC6: start 131, 1 bit, big-endian, i-signal-type=PRIMITIVE, init-value=constant-reference=Init_CAN4_PTCOverVolHSC6, base-type=uint8, implementation-data-type=uint8, transfer-property=PENDING
          signal CAN4_PTCPCBTemHSC6: start 144, 9 bit, big-endian, i-signal-type=PRIMITIVE, init-value=constant-reference=Init_CAN4_PTCPCBTemHSC6, base-type=uint16, implementation-data-type=uint16, transfer-property=PENDING
          signal CAN4_PTCRlngCtrHSC6: start 151, 4 bit, big-endian, i-signal-type=PRIMITIVE, init-value=constant-reference=Init_CAN4_PTCRlngCtrHSC6, base-type=uint8, implementation-data-type=uint8, transfer-property=PENDING
          signal CAN4_PTCSecChksmHSC6: start 191, 8 bit, big-endian, i-signal-type=PRIMITIVE, init-value=constant-reference=Init_CAN4_PTCSecChksmHSC6, base-type=uint8, implementation-data-type=uint8, transfer-property=PENDING
          signal CAN4_PTCSecRlngCtrHSC6: start 135, 4 bit, big-endian, i-signal-type=PRIMITIVE, init-value=constant-reference=Init_CAN4_PTCSecRlngCtrHSC6, base-type=uint8, implementation-data-type=uint8, transfer-property=PENDING
          signal CAN4_PTCStsHSC6: start 166, 2 bit, big-endian, i-signal-type=PRIMITIVE, init-value=constant-reference=Init_CAN4_PTCStsHSC6, base-type=uint8, implementation-data-type=uint8, transfer-property=PENDING
          signal CAN4_PTCUnderVolHSC6: start 167, 1 bit, big-endian, i-signal-type=PRIMITIVE, init-value=constant-reference=Init_CAN4_PTCUnderVolHSC6, base-type=uint8, implementation-data-type=uint8, transfer-property=PENDING
      frame CAN4_zGW_LINDr1: id 0x226, frame-length=32, can-addressing-mode=STANDARD, can-fd-frame-support=true, can-frame-rx-behavior=CAN-FD, can-frame-tx-behavior=CAN-FD
        pdu CAN4_zGW_LINDr1: length=32, minimum-delay=0.0, transmission-mode-true-timing={cyclic-timing=time-period=0.2, event-controlled-timing={number-of-repetitions=0, repetition-period=0}}, unused-bit-pattern=0
          mapping CAN4_SG_zGW_LINDr1: i-signal-group=CAN4_SG_zGW_LINDr1, start-position=0, transfer-property=TRIGGERED-ON-CHANGE
          signal CAN4_CSW_DimSw: start 251, 1 bit, big-endian, i-signal-type=PRIMITIVE, init-value=constant-reference=Init_CAN4_CSW_DimSw, base-type=uint8, implementation-data-type=uint8, transfer-property=TRIGGERED-ON-CHANGE
          signal CAN4_CSW_FWasSw_Sta: start 59, 2 bit, big-endian, i-signal-type=PRIMITIVE, init-value=constant-reference=Init_CAN4_CSW_FWasSw_Sta, base-type=uint8, implementation-data-type=uint8, transfer-property=TRIGGERED-ON-CHANGE
          signal CAN4_CSW_FWipSw_Sta: start 165, 3 bit, big-endian, i-signal-type=PRIMITIVE, init-value=constant-reference=Init_CAN4_CSW_FWipSw_Sta, base-type=uint8, implementation-data-type=uint8, transfer-property=TRIGGERED-ON-CHANGE
          signal CAN4_CSW_HW_version: start 71, 16 bit, big-endian, i-signal-type=PRIMITIVE, init-value=constant-reference=Init_CAN4_CSW_HW_version, base-type=uint16, implementation-data-type=uint16, transfer-property=PENDING
          signal CAN4_CSW_PassSW_Sta: start 252, 1 bit, big-endian, i-signal-type=PRIMITIVE, init-value=constant-reference=Init_CAN4_CSW_PassSW_Sta, base-type=uint8, implementation-data-type=uint8, transfer-property=TRIGGERED-ON-CHANGE
          signal CAN4_CSW_RWasSW_Sta: start 61, 2 bit, big-endian, i-signal-type=PRIMITIVE, init-value=constant-reference=Init_CAN4_CSW_RWasSW_Sta, base-type=uint8, implementation-data-type=uint8, transfer-property=TRIGGERED-ON-CHANGE
          signal CAN4_CSW_RWipIntSw_Sta: start 57, 2 bit, big-endian, i-signal-type=PRIMITIVE, init-value=constant-reference=Init_CAN4_CSW_RWipIntSw_Sta, base-type=uint8, implementation-data-type=uint8, transfer-property=TRIGGERED-ON-CHANGE
          signal CAN4_CSW_SW_version: start 87, 16 bit, big-endian, i-signal-type=PRIMITIVE, init-value=constant-reference=Init_CAN4_CSW_SW_version, base-type=uint16, implementation-data-type=uint16, transfer-property=PENDING
          signal CAN4_CSW_TurnSw_Sta: start 63, 2 bit, big-endian, i-signal-type=PRIMITIVE, init-value=constant-reference=Init_CAN4_CSW_TurnSw_Sta, base-type=uint8, implementation-data-type=uint8, transfer-property=TRIGGERED-ON-CHANGE
          signal CAN4_CSW_resp_error: start 253, 1 bit, big-endian, i-signal-type=PRIMITIVE, init-value=constant-reference=Init_CAN4_CSW_resp_error, base-type=uint8, implementation-data-type=uint8, transfer-property=TRIGGERED-ON-CHANGE
          signal CAN4_FAPWL_01_LIN_Response_Error: start 189, 1 bit, big-endian, i-signal-type=PRIMITIVE, init-value=constant-reference=Init_CAN4_FAPWL_01_LIN_Response_Error, base-type=uint8, implementation-data-type=uint8, transfer-property=TRIGGERED-ON-CHANGE
          signal CAN4_L_Drv_Motor_Relay_Error: start 184, 1 bit, big-endian, i-signal-type=PRIMITIVE, init-value=constant-reference=Init_CAN4_L_Drv_Motor_Relay_Error, base-type=uint8, implementation-data-type=uint8, transfer-property=TRIGGERED-ON-CHANGE
          signal CAN4_L_Drv_Motor_Ripple_Error: start 199, 1 bit, big-endian, i-signal-type=PRIMITIVE, init-value=constant-reference=Init_CAN4_L_Drv_Motor_Ripple_Error, base-type=uint8, implementation-data-type=uint8, transfer-property=TRIGGERED-ON-CHANGE
          signal CAN4_L_Drv_OverHeat_Protect: start 185, 1 bit, big-endian, i-signal-type=PRIMITIVE, init-value=constant-reference=Init_CAN4_L_Drv_OverHeat_Protect, base-type=uint8, implementation-data-type=uint8, transfer-property=TRIGGERED-ON-CHANGE
          signal CAN4_L_Drv_Val_Wdw_Opened: start 198, 7 bit, big-endian, i-signal-type=PRIMITIVE, init-value=constant-reference=Init_CAN4_L_Drv_Val_Wdw_Opened, base-type=uint8, implementation-data-type=uint8, transfer-property=PENDING
          signal CAN4_L_Drv_Wdw_Init: start 186, 1 bit, big-endian, i-signal-type=PRIMITIVE, init-value=constant-reference=Init_CAN4_L_Drv_Wdw_Init, base-type=uint8, implementation-data-type=uint8, transfer-property=TRIGGERED-ON-CHANGE
          signal CAN4_L_Drv_Wdw_LocalSwitch: start 205, 3 bit, big-endian, i-signal-type=PRIMITIVE, init-value=constant-reference=Init_CAN4_L_Drv_Wdw_LocalSwitch, base-type=uint8, implementation-data-type=uint8, transfer-property=TRIGGERED-ON-CHANGE
          signal CAN4_L_Drv_Wdw_OD_Sts: start 187, 1 bit, big-endian, i-signal-type=PRIMITIVE, init-value=constant-reference=Init_CAN4_L_Drv_Wdw_OD_Sts, base-type=uint8, implementation-data-type=uint8, transfer-property=TRIGGERED-ON-CHANGE
          signal CAN4_L_Drv_Wdw_Obs_InhibitSts: start 188, 1 bit, big-endian, i-signal-type=PRIMITIVE, init-value=constant-reference=Init_CAN4_L_Drv_Wdw_Obs_InhibitSts, base-type=uint8, implementation-data-type=uint8, transfer-property=TRIGGERED-ON-CHANGE
          signal CAN4_L_Drv_Wdw_Pas_Switch: start 162, 3 bit, big-endian, i-signal-type=PRIMITIVE, init-value=constant-reference=Init_CAN4_L_Drv_Wdw_Pas_Switch, base-type=uint8, implementation-data-type=uint8, transfer-property=TRIGGERED-ON-CHANGE
          signal CAN4_L_Drv_Wdw_PositionSts: start 207, 2 bit, big-endian, i-signal-type=PRIMITIVE, init-value=constant-reference=Init_CAN4_L_Drv_Wdw_PositionSts, base-type=uint8, implementation-data-type=uint8, transfer-property=TRIGGERED-ON-CHANGE
          signal CAN4_L_Drv_Wdw_RLD_Switch: start 154, 3 bit, big-endian, i-signal-type=PRIMITIVE, init-value=constant-reference=Init_CAN4_L_Drv_Wdw_RLD_Switch, base-type=uint8, implementation-data-type=uint8, transfer-property=TRIGGERED-ON-CHANGE
          signal CAN4_L_Drv_Wdw_RRD_Switch: start 157, 3 bit, big-endian, i-signal-type=PRIMITIVE, init-value=constant-reference=Init_CAN4_L_Drv_Wdw_RRD_Switch, base-type=uint8, implementation-data-type=uint8, transfer-property=TRIGGERED-ON-CHANGE
          signal CAN4_L_Drv_Wdw_Running_Sts: start 202, 3 bit, big-endian, i-signal-type=PRIMITIVE, init-value=constant-reference=Init_CAN4_L_Drv_Wdw_Running_Sts, base-type=uint8, implementation-data-type=uint8, transfer-property=TRIGGERED-ON-CHANGE
          signal CAN4_L_Pas_Motor_Relay_Error: start 54, 1 bit, big-endian, i-signal-type=PRIMITIVE, init-value=constant-reference=Init_CAN4_L_Pas_Motor_Relay_Error, base-type=uint8, implementation-data-type=uint8, transfer-property=TRIGGERED-ON-CHANGE
          signal CAN4_L_Pas_Motor_Ripple_Error: start 55, 1 bit, big-endian, i-signal-type=PRIMITIVE, init-value=constant-reference=Init_CAN4_L_Pas_Motor_Ripple_Error, base-type=uint8, implementation-data-type=uint8, transfer-property=TRIGGERED-ON-CHANGE
          signal CAN4_L_Pas_OverHeat_Protect: start 158, 1 bit, big-endian, i-signal-type=PRIMITIVE, init-value=constant-reference=Init_CAN4_L_Pas_OverHeat_Protect, base-type=uint8, implementation-data-type=uint8, transfer-property=TRIGGERED-ON-CHANGE
          signal CAN4_L_Pas_Val_Wdw_Opened: start 174, 7 bit, big-endian, i-signal-type=PRIMITIVE, init-value=constant-reference=Init_CAN4_L_Pas_Val_Wdw_Opened, base-type=uint8, implementation-data-type=uint8, transfer-property=PENDING
          signal CAN4_L_Pas_Wdw_Init: start 166, 1 bit, big-endian, i-signal-type=PRIMITIVE, init-value=constant-reference=Init_CAN4_L_Pas_Wdw_Init, base-type=uint8, implementation-data-type=uint8, transfer-property=TRIGGERED-ON-CHANGE
          signal CAN4_L_Pas_Wdw_LocalSwitch: start 181, 3 bit, big-endian, i-signal-type=PRIMITIVE, init-value=constant-reference=Init_CAN4_L_Pas_Wdw_LocalSwitch, base-type=uint8, implementation-data-type=uint8, transfer-property=TRIGGERED-ON-CHANGE
          signal CAN4_L_Pas_Wdw_OD_Sts: start 167, 1 bit, big-endian, i-signal-type=PRIMITIVE, init-value=constant-reference=Init_CAN4_L_Pas_Wdw_OD_Sts, base-type=uint8, implementation-data-type=uint8, transfer-property=TRIGGERED-ON-CHANGE
          signal CAN4_L_Pas_Wdw_Obs_InhibitSts: start 159, 1 bit, big-endian, i-signal-type=PRIMITIVE, init-value=constant-reference=Init_CAN4_L_Pas_Wdw_Obs_InhibitSts, base-type=uint8, implementation-data-type=uint8, transfer-property=TRIGGERED-ON-CHANGE
          signal CAN4_L_Pas_Wdw_PositionSts: start 183, 2 bit, big-endian, i-signal-type=PRIMITIVE, init-value=constant-reference=Init_CAN4_L_Pas_Wdw_PositionSts, base-type=uint8, implementation-data-type=uint8, transfer-property=TRIGGERED-ON-CHANGE
          signal CAN4_L_Pas_Wdw_Running_Sts: start 178, 3 bit, big-endian, i-signal-type=PRIMITIVE, init-value=constant-reference=Init_CAN4_L_Pas_Wdw_Running_Sts, base-type=uint8, implementation-data-type=uint8, transfer-property=TRIGGERED-ON-CHANGE
          signal CAN4_L_Power_Status: start 191, 2 bit, big-endian, i-signal-type=PRIMITIVE, init-value=constant-reference=Init_CAN4_L_Power_Status, base-type=uint8, implementation-data-type=uint8, transfer-property=TRIGGERED-ON-CHANGE
          signal CAN4_L_RLD_Motor_Relay_Error: start 246, 1 bit, big-endian, i-signal-type=PRIMITIVE, init-value=constant-reference=Init_CAN4_L_RLD_Motor_Relay_Error, base-type=uint8, implementation-data-type=uint8, transfer-property=TRIGGERED-ON-CHANGE
          signal CAN4_L_RLD_Motor_Ripple_Error: start 245, 1 bit, big-endian, i-signal-type=PRIMITIVE, init-value=constant-reference=Init_CAN4_L_RLD_Motor_Ripple_Error, base-type=uint8, implementation-data-type=uint8, transfer-property=TRIGGERED-ON-CHANGE
          signal CAN4_L_RLD_OverHeat_Protect: start 247, 1 bit, big-endian, i-signal-type=PRIMITIVE, init-value=constant-reference=Init_CAN4_L_RLD_OverHeat_Protect, base-type=uint8, implementation-data-type=uint8, transfer-property=TRIGGERED-ON-CHANGE
          signal CAN4_L_RLD_Val_Wdw_Opened: start 238, 7 bit, big-endian, i-signal-type=PRIMITIVE, init-value=constant-reference=Init_CAN4_L_RLD_Val_Wdw_Opened, base-type=uint8, implementation-data-type=uint8, transfer-property=PENDING
          signal CAN4_L_RLD_Wdw_Init: start 215, 1 bit, big-endian, i-signal-type=PRIMITIVE, init-value=constant-reference=Init_CAN4_L_RLD_Wdw_Init, base-type=uint8, implementation-data-type=uint8, transfer-property=TRIGGERED-ON-CHANGE
          signal CAN4_L_RLD_Wdw_LocalSwitch: start 242, 3 bit, big-endian, i-signal-type=PRIMITIVE, init-value=constant-reference=Init_CAN4_L_RLD_Wdw_LocalSwitch, base-type=uint8, implementation-data-type=uint8, transfer-property=TRIGGERED-ON-CHANGE
          signal CAN4_L_RLD_Wdw_OD_Sts: start 239, 1 bit, big-endian, i-signal-type=PRIMITIVE, init-value=constant-reference=Init_CAN4_L_RLD_Wdw_OD_Sts, base-type=uint8, implementation-data-type=uint8, transfer-property=TRIGGERED-ON-CHANGE
          signal CAN4_L_RLD_Wdw_Obs_InhibitSts: start 224, 1 bit, big-endian, i-signal-type=PRIMITIVE, init-value=constant-reference=Init_CAN4_L_RLD_Wdw_Obs_InhibitSts, base-type=uint8, implementation-data-type=uint8, transfer-property=TRIGGERED-ON-CHANGE
          signal CAN4_L_RLD_Wdw_PositionSts: start 244, 2 bit, big-endian, i-signal-type=PRIMITIVE, init-value=constant-reference=Init_CAN4_L_RLD_Wdw_PositionSts, base-type=uint8, implementation-data-type=uint8, transfer-property=TRIGGERED-ON-CHANGE
          signal CAN4_L_RLD_Wdw_Running_Sts: start 250, 3 bit, big-endian, i-signal-type=PRIMITIVE, init-value=constant-reference=Init_CAN4_L_RLD_Wdw_Running_Sts, base-type=uint8, implementation-data-type=uint8, transfer-property=TRIGGERED-ON-CHANGE
          signal CAN4_L_RRD_Motor_Relay_Error: start 217, 1 bit, big-endian, i-signal-type=PRIMITIVE, init-value=constant-reference=Init_CAN4_L_RRD_Motor_Relay_Error, base-type=uint8, implementation-data-type=uint8, transfer-property=TRIGGERED-ON-CHANGE
          signal CAN4_L_RRD_Motor_Ripple_Error: start 216, 1 bit, big-endian, i-signal-type=PRIMITIVE, init-value=constant-reference=Init_CAN4_L_RRD_Motor_Ripple_Error, base-type=uint8, implementation-data-type=uint8, transfer-property=TRIGGERED-ON-CHANGE
          signal CAN4_L_RRD_OverHeat_Protect: start 218, 1 bit, big-endian, i-signal-type=PRIMITIVE, init-value=constant-reference=Init_CAN4_L_RRD_OverHeat_Protect, base-type=uint8, implementation-data-type=uint8, transfer-property=TRIGGERED-ON-CHANGE
          signal CAN4_L_RRD_Val_Wdw_Opened: start 214, 7 bit, big-endian, i-signal-type=PRIMITIVE, init-value=constant-reference=Init_CAN4_L_RRD_Val_Wdw_Opened, base-type=uint8, implementation-data-type=uint8, transfer-property=PENDING
          signal CAN4_L_RRD_Wdw_Init: start 219, 1 bit, big-endian, i-signal-type=PRIMITIVE, init-value=constant-reference=Init_CAN4_L_RRD_Wdw_Init, base-type=uint8, implementation-data-type=uint8, transfer-property=TRIGGERED-ON-CHANGE
          signal CAN4_L_RRD_Wdw_LocalSwitch: start 231, 3 bit, big-endian, i-signal-type=PRIMITIVE, init-value=constant-reference=Init_CAN4_L_RRD_Wdw_LocalSwitch, base-type=uint8, implementation-data-type=uint8, transfer-property=TRIGGERED-ON-CHANGE
          signal CAN4_L_RRD_Wdw_OD_Sts: start 220, 1 bit, big-endian, i-signal-type=PRIMITIVE, init-value=constant-reference=Init_CAN4_L_RRD_Wdw_OD_Sts, base-type=uint8, implementation-data-type=uint8, transfer-property=TRIGGERED-ON-CHANGE
          signal CAN4_L_RRD_Wdw_Obs_InhibitSts: start 221, 1 bit, big-endian, i-signal-type=PRIMITIVE, init-value=constant-reference=Init_CAN4_L_RRD_Wdw_Obs_InhibitSts, base-type=uint8, implementation-data-type=uint8, transfer-property=TRIGGERED-ON-CHANGE
          signal CAN4_L_RRD_Wdw_PositionSts: start 223, 2 bit, big-endian, i-signal-type=PRIMITIVE, init-value=constant-reference=Init_CAN4_L_RRD_Wdw_PositionSts, base-type=uint8, implementation-data-type=uint8, transfer-property=TRIGGERED-ON-CHANGE
          signal CAN4_L_RRD_Wdw_Running_Sts: start 228, 3 bit, big-endian, i-signal-type=PRIMITIVE, init-value=constant-reference=Init_CAN4_L_RRD_Wdw_Running_Sts, base-type=uint8, implementation-data-type=uint8, transfer-property=TRIGGERED-ON-CHANGE
          signal CAN4_RAPWL_01_LIN_Response_Error: start 225, 1 bit, big-endian, i-signal-type=PRIMITIVE, init-value=constant-reference=Init_CAN4_RAPWL_01_LIN_Response_Error, base-type=uint8, implementation-data-type=uint8, transfer-property=TRIGGERED-ON-CHANGE
          signal CAN4_RLS_LIN_Resp_Err: start 175, 1 bit, big-endian, i-signal-type=PRIMITIVE, init-value=constant-reference=Init_CAN4_RLS_LIN_Resp_Err, base-type=uint8, implementation-data-type=uint8, transfer-property=TRIGGERED-ON-CHANGE
          signal CAN4_RLS_Lamp_Sta: start 147, 1 bit, big-endian, i-signal-type=PRIMITIVE, init-value=constant-reference=Init_CAN4_RLS_Lamp_Sta, base-type=uint8, implementation-data-type=uint8, transfer-property=TRIGGERED-ON-CHANGE
          signal CAN4_RLS_LightSnrErr: start 255, 1 bit, big-endian, i-signal-type=PRIMITIVE, init-value=constant-reference=Init_CAN4_RLS_LightSnrErr, base-type=uint8, implementation-data-type=uint8, transfer-property=TRIGGERED-ON-CHANGE
          signal CAN4_RLS_RainSnrErr: start 254, 1 bit, big-endian, i-signal-type=PRIMITIVE, init-value=constant-reference=Init_CAN4_RLS_RainSnrErr, base-type=uint8, implementation-data-type=uint8, transfer-property=TRIGGERED-ON-CHANGE
          signal CAN4_RLS_RainSnrWiperCmd: start 146, 3 bit, big-endian, i-signal-type=PRIMITIVE, init-value=constant-reference=Init_CAN4_RLS_RainSnrWiperCmd, base-type=uint8, implementation-data-type=uint8, transfer-property=TRIGGERED-ON-CHANGE
          signal CAN4_SWC2_HW_Version: start 7, 16 bit, big-endian, i-signal-type=PRIMITIVE, init-value=constant-reference=Init_CAN4_SWC2_HW_Version, base-type=uint16, implementation-data-type=uint16, transfer-property=PENDING
          signal CAN4_SWC2_L_ADAS_Sta: start 41, 1 bit, big-endian, i-signal-type=PRIMITIVE, init-value=constant-reference=Init_CAN4_SWC2_L_ADAS_Sta, base-type=uint8, implementation-data-type=uint8, transfer-property=TRIGGERED-ON-CHANGE
          signal CAN4_SWC2_L_DriveMode_Sta: start 51, 1 bit, big-endian, i-signal-type=PRIMITIVE, init-value=constant-reference=Init_CAN4_SWC2_L_DriveMode_Sta, base-type=uint8, implementation-data-type=uint8, transfer-property=TRIGGERED-ON-CHANGE
          signal CAN4_SWC2_L_Home_Sta: start 40, 1 bit, big-endian, i-signal-type=PRIMITIVE, init-value=constant-reference=Init_CAN4_SWC2_L_Home_Sta, base-type=uint8, implementation-data-type=uint8, transfer-property=TRIGGERED-ON-CHANGE
          signal CAN4_SWC2_L_Left_Sta: start 47, 1 bit, big-endian, i-signal-type=PRIMITIVE, init-value=constant-reference=Init_CAN4_SWC2_L_Left_Sta, base-type=uint8, implementation-data-type=uint8, transfer-property=TRIGGERED-ON-CHANGE
          signal CAN4_SWC2_L_RegenUp_Sta: start 42, 1 bit, big-endian, i-signal-type=PRIMITIVE, init-value=constant-reference=Init_CAN4_SWC2_L_RegenUp_Sta, base-type=uint8, implementation-data-type=uint8, transfer-property=TRIGGERED-ON-CHANGE
          signal CAN4_SWC2_L_Right_Sta: start 43, 1 bit, big-endian, i-signal-type=PRIMITIVE, init-value=constant-reference=Init_CAN4_SWC2_L_Right_Sta, base-type=uint8, implementation-data-type=uint8, transfer-property=TRIGGERED-ON-CHANGE
          signal CAN4_SWC2_L_ScrollDown_Sta: start 44, 1 bit, big-endian, i-signal-type=PRIMITIVE, init-value=constant-reference=Init_CAN4_SWC2_L_ScrollDown_Sta, base-type=uint8, implementation-data-type=uint8, transfer-property=TRIGGERED-ON-CHANGE
          signal CAN4_SWC2_L_ScrollPress_Sta: start 45, 1 bit, big-endian, i-signal-type=PRIMITIVE, init-value=constant-reference=Init_CAN4_SWC2_L_ScrollPress_Sta, base-type=uint8, implementation-data-type=uint8, transfer-property=TRIGGERED-ON-CHANGE
          signal CAN4_SWC2_L_ScrollUp_Sta: start 46, 1 bit, big-endian, i-signal-type=PRIMITIVE, init-value=constant-reference=Init_CAN4_SWC2_L_ScrollUp_Sta, base-type=uint8, implementation-data-type=uint8, transfer-property=TRIGGERED-ON-CHANGE
          signal CAN4_SWC2_R_Customize_Sta: start 32, 1 bit, big-endian, i-signal-type=PRIMITIVE, init-value=constant-reference=Init_CAN4_SWC2_R_Customize_Sta, base-type=uint8, implementation-data-type=uint8, transfer-property=TRIGGERED-ON-CHANGE
          signal CAN4_SWC2_R_Left_Sta: start 35, 1 bit, big-endian, i-signal-type=PRIMITIVE, init-value=constant-reference=Init_CAN4_SWC2_R_Left_Sta, base-type=uint8, implementation-data-type=uint8, transfer-property=TRIGGERED-ON-CHANGE
          signal CAN4_SWC2_R_PageSwitch_Sta: start 33, 1 bit, big-endian, i-signal-type=PRIMITIVE, init-value=constant-reference=Init_CAN4_SWC2_R_PageSwitch_Sta, base-type=uint8, implementation-data-type=uint8, transfer-property=TRIGGERED-ON-CHANGE
          signal CAN4_SWC2_R_RegenDown_Sta: start 52, 1 bit, big-endian, i-signal-type=PRIMITIVE, init-value=constant-reference=Init_CAN4_SWC2_R_RegenDown_Sta, base-type=uint8, implementation-data-type=uint8, transfer-property=TRIGGERED-ON-CHANGE
          signal CAN4_SWC2_R_Right_Sta: start 39, 1 bit, big-endian, i-signal-type=PRIMITIVE, init-value=constant-reference=Init_CAN4_SWC2_R_Right_Sta, base-type=uint8, implementation-data-type=uint8, transfer-property=TRIGGERED-ON-CHANGE
          signal CAN4_SWC2_R_ScrollDown_Sta: start 36, 1 bit, big-endian, i-signal-type=PRIMITIVE, init-value=constant-reference=Init_CAN4_SWC2_R_ScrollDown_Sta, base-type=uint8, implementation-data-type=uint8, transfer-property=TRIGGERED-ON-CHANGE
          signal CAN4_SWC2_R_ScrollPress_Sta: start 37, 1 bit, big-endian, i-signal-type=PRIMITIVE, init-value=constant-reference=Init_CAN4_SWC2_R_ScrollPress_Sta, base-type=uint8, implementation-data-type=uint8, transfer-property=TRIGGERED-ON-CHANGE
          signal CAN4_SWC2_R_ScrollUp_Sta: start 38, 1 bit, big-endian, i-signal-type=PRIMITIVE, init-value=constant-reference=Init_CAN4_SWC2_R_ScrollUp_Sta, base-type=uint8, implementation-data-type=uint8, transfer-property=TRIGGERED-ON-CHANGE
          signal CAN4_SWC2_R_VR_Sta: start 34, 1 bit, big-endian, i-signal-type=PRIMITIVE, init-value=constant-reference=Init_CAN4_SWC2_R_VR_Sta, base-type=uint8, implementation-data-type=uint8, transfer-property=TRIGGERED-ON-CHANGE
          signal CAN4_SWC2_ResponseError: start 53, 1 bit, big-endian, i-signal-type=PRIMITIVE, init-value=constant-reference=Init_CAN4_SWC2_ResponseError, base-type=uint8, implementation-data-type=uint8, transfer-property=TRIGGERED-ON-CHANGE
          signal CAN4_SWC2_SW_Version: start 23, 16 bit, big-endian, i-signal-type=PRIMITIVE, init-value=constant-reference=Init_CAN4_SWC2_SW_Version, base-type=uint16, implementation-data-type=uint16, transfer-property=PENDING
          signal CAN4_SWC_ACC_Sta: start 132, 1 bit, big-endian, i-signal-type=PRIMITIVE, init-value=constant-reference=Init_CAN4_SWC_ACC_Sta, base-type=uint8, implementation-data-type=uint8, transfer-property=TRIGGERED-ON-CHANGE
          signal CAN4_SWC_A_HW_version: start 119, 16 bit, big-endian, i-signal-type=PRIMITIVE, init-value=constant-reference=Init_CAN4_SWC_A_HW_version, base-type=uint16, implementation-data-type=uint16, transfer-property=PENDING
          signal CAN4_SWC_A_Resp_Err: start 131, 1 bit, big-endian, i-signal-type=PRIMITIVE, init-value=constant-reference=Init_CAN4_SWC_A_Resp_Err, base-type=uint8, implementation-data-type=uint8, transfer-property=TRIGGERED-ON-CHANGE
          signal CAN4_SWC_A_SW_version: start 103, 16 bit, big-endian, i-signal-type=PRIMITIVE, init-value=constant-reference=Init_CAN4_SWC_A_SW_version, base-type=uint16, implementation-data-type=uint16, transfer-property=PENDING
          signal CAN4_SWC_CANCEL_Sta: start 133, 1 bit, big-endian, i-signal-type=PRIMITIVE, init-value=constant-reference=Init_CAN4_SWC_CANCEL_Sta, base-type=uint8, implementation-data-type=uint8, transfer-property=TRIGGERED-ON-CHANGE
          signal CAN4_SWC_Distance_Sta: start 130, 1 bit, big-endian, i-signal-type=PRIMITIVE, init-value=constant-reference=Init_CAN4_SWC_Distance_Sta, base-type=uint8, implementation-data-type=uint8, transfer-property=TRIGGERED-ON-CHANGE
          signal CAN4_SWC_Down_Sta: start 129, 1 bit, big-endian, i-signal-type=PRIMITIVE, init-value=constant-reference=Init_CAN4_SWC_Down_Sta, base-type=uint8, implementation-data-type=uint8, transfer-property=TRIGGERED-ON-CHANGE
          signal CAN4_SWC_Drivemode_Sta: start 135, 2 bit, big-endian, i-signal-type=PRIMITIVE, init-value=constant-reference=Init_CAN4_SWC_Drivemode_Sta, base-type=uint8, implementation-data-type=uint8, transfer-property=TRIGGERED-ON-CHANGE
          signal CAN4_SWC_LKA_Sta: start 148, 1 bit, big-endian, i-signal-type=PRIMITIVE, init-value=constant-reference=Init_CAN4_SWC_LKA_Sta, base-type=uint8, implementation-data-type=uint8, transfer-property=TRIGGERED-ON-CHANGE
          signal CAN4_SWC_Left_Sta: start 143, 1 bit, big-endian, i-signal-type=PRIMITIVE, init-value=constant-reference=Init_CAN4_SWC_Left_Sta, base-type=uint8, implementation-data-type=uint8, transfer-property=TRIGGERED-ON-CHANGE
          signal CAN4_SWC_RegenDown: start 139, 1 bit, big-endian, i-signal-type=PRIMITIVE, init-value=constant-reference=Init_CAN4_SWC_RegenDown, base-type=uint8, implementation-data-type=uint8, transfer-property=TRIGGERED-ON-CHANGE
          signal CAN4_SWC_RegenUp: start 128, 1 bit, big-endian, i-signal-type=PRIMITIVE, init-value=constant-reference=Init_CAN4_SWC_RegenUp, base-type=uint8, implementation-data-type=uint8, transfer-property=TRIGGERED-ON-CHANGE
          signal CAN4_SWC_Res_Up_Sta: start 140, 1 bit, big-endian, i-signal-type=PRIMITIVE, init-value=constant-reference=Init_CAN4_SWC_Res_Up_Sta, base-type=uint8, implementation-data-type=uint8, transfer-property=TRIGGERED-ON-CHANGE
          signal CAN4_SWC_Right_Sta: start 138, 1 bit, big-endian, i-signal-type=PRIMITIVE, init-value=constant-reference=Init_CAN4_SWC_Right_Sta, base-type=uint8, implementation-data-type=uint8, transfer-property=TRIGGERED-ON-CHANGE
          signal CAN4_SWC_Set_down_Sta: start 137, 1 bit, big-endian, i-signal-type=PRIMITIVE, init-value=constant-reference=Init_CAN4_SWC_Set_down_Sta, base-type=uint8, implementation-data-type=uint8, transfer-property=TRIGGERED-ON-CHANGE
          signal CAN4_SWC_Trip_Sta: start 136, 1 bit, big-endian, i-signal-type=PRIMITIVE, init-value=constant-reference=Init_CAN4_SWC_Trip_Sta, base-type=uint8, implementation-data-type=uint8, transfer-property=TRIGGERED-ON-CHANGE
          signal CAN4_SWC_Undefined_Sta: start 149, 1 bit, big-endian, i-signal-type=PRIMITIVE, init-value=constant-reference=Init_CAN4_SWC_Undefined_Sta, base-type=uint8, implementation-data-type=uint8, transfer-property=TRIGGERED-ON-CHANGE
          signal CAN4_SWC_Up_Sta: start 151, 1 bit, big-endian, i-signal-type=PRIMITIVE, init-value=constant-reference=Init_CAN4_SWC_Up_Sta, base-type=uint8, implementation-data-type=uint8, transfer-property=TRIGGERED-ON-CHANGE
          signal CAN4_SWC_VR_Sta: start 150, 1 bit, big-endian, i-signal-type=PRIMITIVE, init-value=constant-reference=Init_CAN4_SWC_VR_Sta, base-type=uint8, implementation-data-type=uint8, transfer-property=TRIGGERED-ON-CHANGE
          signal CAN4_SWC_mode_Sta: start 142, 1 bit, big-endian, i-signal-type=PRIMITIVE, init-value=constant-reference=Init_CAN4_SWC_mode_Sta, base-type=uint8, implementation-data-type=uint8, transfer-property=TRIGGERED-ON-CHANGE
          signal CAN4_SWC_resp_error: start 141, 1 bit, big-endian, i-signal-type=PRIMITIVE, init-value=constant-reference=Init_CAN4_SWC_resp_error, base-type=uint8, implementation-data-type=uint8, transfer-property=TRIGGERED-ON-CHANGE
      frame CAN4_NMm_FUSION_TX: id 0x500, frame-length=8, can-addressing-mode=STANDARD, can-fd-frame-support=false, can-frame-rx-behavior=CAN-20, can-frame-tx-behavior=CAN-20
        nm pdu CAN4_NMm_FUSION_TX: length=8, unused-bit-pattern=0
      frame CAN4_NMm_FUSION_RX: id 0x500, frame-length=8, can-addressing-mode=STANDARD, can-fd-frame-support=false, can-frame-rx-behavior=CAN-20, can-frame-tx-behavior=CAN-20
        nm pdu CAN4_NMm_FUSION_RX: length=8, unused-bit-pattern=0
package /CAN4/ConstantSpecification
  855 x constant specification:
    Init_CAN4_DKC_KeyNum_Sta: value-spec=0
    Init_CAN4_DKC_KeyType_Sta: value-spec=0
    Init_CAN4_DKC_PDkeyAreaRAPS_Sta: value-spec=0
    Init_CAN4_DKC_ParkingMode_Cmd: value-spec=0
    Init_CAN4_DKC_Re_VehData: value-spec=0
    Init_CAN4_P_CommandToBCM: value-spec=0
    Init_CAN4_P_CommandToPTG: value-spec=0
    Init_CAN4_P_DKey_Area_LockUnlock: value-spec=0
    Init_CAN4_P_DKey_Area_PS: value-spec=0
    Init_CAN4_P_DKey_Area_PTG: value-spec=0
    Init_CAN4_P_DKey_Welcome: value-spec=0
    Init_CAN4_P_Dkey_Show_IVI: value-spec=0
    Init_CAN4_P_KeyMiss: value-spec=0
    Init_CAN4_P_KeyMode: value-spec=0
    Init_CAN4_P_UID_LowPower: value-spec=0
    Init_CAN4_EncryptionDATA_0_63: value-spec=0
    Init_CAN4_EncryptionDATA_64_127: value-spec=0
    Init_CAN4_Random_Number_X: value-spec=0
    Init_CAN4_FDC_CHA_EACEnDemand_Cmd: value-spec=0
    Init_CAN4_APS_Sta_System: value-spec=0
    Init_CAN4_AllDoorSW: value-spec=0
    Init_CAN4_AntiTheftSeatFold: value-spec=0
    Init_CAN4_AntitheftSta: value-spec=0
    Init_CAN4_BCM_DoorLock_Sta: value-spec=0
    Init_CAN4_BrakeLamp: value-spec=0
    Init_CAN4_CC_Crl_Sta: value-spec=0
    Init_CAN4_CS_VCU1_CAN4: value-spec=0
    Init_CAN4_CTDCtrl: value-spec=0
    Init_CAN4_CTDLockSW: value-spec=0
    Init_CAN4_CTDUnlockSW: value-spec=0
    Init_CAN4_CrashDetd: value-spec=0
    Init_CAN4_CtrlDrPwrStbA2: value-spec=0
    Init_CAN4_CtrlFrBMSCCUCIR: value-spec=0
    Init_CAN4_CtrlFrEDUINVERTER: value-spec=0
    Init_CAN4_CtrlFrIRC1: value-spec=0
    Init_CAN4_CtrlFrPwrStbA1P: value-spec=0
    Init_CAN4_DKCAuthSta: value-spec=0
    Init_CAN4_DKCTimeSN: value-spec=0
    Init_CAN4_Dimmer: value-spec=0
    Init_CAN4_DimmerEN: value-spec=0
    Init_CAN4_DoorLockIND: value-spec=0
    Init_CAN4_DrDoorSW: value-spec=0
    Init_CAN4_Dr_SeatSta: value-spec=2
    Init_CAN4_EquivAccPedalSWSta: value-spec=0
    Init_CAN4_FD_DKC_VehData_Err: value-spec=0
    Init_CAN4_FD_DKC_VehData_Sta: value-spec=0
    Init_CAN4_FD_TBOX_DTCData_Err: value-spec=0
    Init_CAN4_FD_TBOX_DTCData_Sta: value-spec=0
    Init_CAN4_FD_TBOX_VehData_Err: value-spec=0
    Init_CAN4_FD_TBOX_VehData_Sta: value-spec=0
    Init_CAN4_Fr_ChargingDoorCtrl: value-spec=0
    Init_CAN4_Fr_FogLamp: value-spec=0
    Init_CAN4_Fr_Wiper_H: value-spec=0
    Init_CAN4_Fr_Wiper_L: value-spec=0
    Init_CAN4_HWResetSta: value-spec=0
    Init_CAN4_H_Beam: value-spec=0
    Init_CAN4_H_Beam_ADB: value-spec=0
    Init_CAN4_HazardSW: value-spec=0
    Init_CAN4_HoodSW: value-spec=0
    Init_CAN4_HornCtrl: value-spec=0
    Init_CAN4_LBSD: value-spec=0
    Init_CAN4_LDRL: value-spec=0
    Init_CAN4_LTurnLP: value-spec=0
    Init_CAN4_L_APM_WdwEnable: value-spec=0
    Init_CAN4_L_Beam: value-spec=0
    Init_CAN4_LampPwr: value-spec=0
    Init_CAN4_LockSetting: value-spec=0
    Init_CAN4_MSA_Crl_Sta: value-spec=0
    Init_CAN4_MirrorCtrl: value-spec=0
    Init_CAN4_MirrorDefog: value-spec=0
    Init_CAN4_PosLamp: value-spec=0
    Init_CAN4_PsDoorSW: value-spec=0
    Init_CAN4_PwrSta: value-spec=7
    Init_CAN4_RBSD: value-spec=0
    Init_CAN4_RC_VCU1_CAN4: value-spec=0
    Init_CAN4_RDRL: value-spec=0
    Init_CAN4_RLDoorSW: value-spec=0
    Init_CAN4_RRDoorSW: value-spec=0
    Init_CAN4_RTurnLP: value-spec=0
    Init_CAN4_ReBrakeLPReq: value-spec=0
    Init_CAN4_ReverseLamp: value-spec=0
    Init_CAN4_RoomLampH: value-spec=0
    Init_CAN4_RoomLampL: value-spec=0
    Init_CAN4_Rr_ChargingDoorCtrl: value-spec=0
    Init_CAN4_Rr_Defog: value-spec=0
    Init_CAN4_Rr_FogLamp: value-spec=0
    Init_CAN4_Rr_Wiper: value-spec=0
    Init_CAN4_ShiftGearPosn: value-spec=1
    Init_CAN4_TailgateHDSW: value-spec=0
    Init_CAN4_TailgateRemote: value-spec=0
    Init_CAN4_Tailgate_SW: value-spec=0
    Init_CAN4_TimeSNDKCFbk: value-spec=0
    Init_CAN4_TrunkRel: value-spec=0
    Init_CAN4_WasherCtrl: value-spec=0
    Init_CAN4_WiperFixMode: value-spec=0
    Init_CAN4_ACSubMode: value-spec=0
    Init_CAN4_APTC_ActFrRiPwr: value-spec=0
    Init_CAN4_BatLoopActWtFlw: value-spec=0
    Init_CAN4_BatteryMode: value-spec=0
    Init_CAN4_CCU_ACLampSts: value-spec=0
    Init_CAN4_CCU_ACMaxLampSts: value-spec=0
    Init_CAN4_CCU_AutoLampSts: value-spec=0
    Init_CAN4_CCU_AutoMidLampSts: value-spec=0
    Init_CAN4_CCU_CbnPreACWkSts: value-spec=0
    Init_CAN4_CCU_CbnPreEstimdTi: value-spec=0
    Init_CAN4_CCU_CbnPreSts: value-spec=0
    Init_CAN4_CCU_Dispaly_Request: value-spec=0
    Init_CAN4_CCU_EcoSts: value-spec=0
    Init_CAN4_CCU_FrtOnOffLampSts: value-spec=0
    Init_CAN4_CCU_HEATMaxLampSts: value-spec=0
    Init_CAN4_CCU_HiVoltageReq: value-spec=0
    Init_CAN4_CCU_RrOnOffLampSts: value-spec=0
    Init_CAN4_CCU_SyncLampSts: value-spec=0
    Init_CAN4_CabinMode: value-spec=15
    Init_CAN4_CoolgFanActDuty: value-spec=0
    Init_CAN4_DeiceModReq: value-spec=0
    Init_CAN4_EDriveMode: value-spec=0
    Init_CAN4_FDC_THCM_CLEVentY_Sta: value-spec=0
    Init_CAN4_FDC_THCM_CLEVentZ_Sta: value-spec=0
    Init_CAN4_FDC_THCM_CLVent_Sta: value-spec=0
    Init_CAN4_FDC_THCM_CREVentY_Sta: value-spec=0
    Init_CAN4_FDC_THCM_CREVentZ_Sta: value-spec=0
    Init_CAN4_FDC_THCM_CRVent_Sta: value-spec=0
    Init_CAN4_FDC_THCM_DrEVentMode_Sta: value-spec=0
    Init_CAN4_FDC_THCM_DrEVentY_Sta: value-spec=0
    Init_CAN4_FDC_THCM_DrEVentZ_Sta: value-spec=0
    Init_CAN4_FDC_THCM_DrVent_Sta: value-spec=0
    Init_CAN4_FDC_THCM_PsEVentMode_Sta: value-spec=0
    Init_CAN4_FDC_THCM_PsEVentY_Sta: value-spec=0
    Init_CAN4_FDC_THCM_PsEVentZ_Sta: value-spec=0
    Init_CAN4_FDC_THCM_PsVent_Sta: value-spec=0
    Init_CAN4_FD_Blower_Cmd: value-spec=0
    Init_CAN4_FD_Comp_Cmd: value-spec=0
    Init_CAN4_FD_EWP{1..3}_Cmd: value-spec=0
    Init_CAN4_FD_EXV1_Cmd: value-spec=0
    Init_CAN4_FD_EXV2_Cmd: value-spec=0
    Init_CAN4_FD_FWV_Cmd: value-spec=0
    Init_CAN4_FD_FrLeAPTCHeatPwr_Cmd: value-spec=0
    Init_CAN4_FD_FrRiAPTCHeatPwr_Cmd: value-spec=0
    Init_CAN4_FD_FrWPTCHeatPwr_Cmd: value-spec=0
    Init_CAN4_FD_RecyAuto_Cmd: value-spec=7
    Init_CAN4_FD_RrAPTCHeatPwr_Cmd: value-spec=0
    Init_CAN4_FD_SOTXV_Cmd: value-spec=0
    Init_CAN4_FD_SOV{1..3}_Cmd: value-spec=0
    Init_CAN4_FD_TWV_Cmd: value-spec=0
    Init_CAN4_Fr_Coolantflow: value-spec=0
    Init_CAN4_Fr_Coolanttemp: value-spec=40
    Init_CAN4_HPThermalRecoveryReq: value-spec=0
    Init_CAN4_Rr_Coolantflow: value-spec=0
    Init_CAN4_Rr_Coolanttemp: value-spec=40
    Init_CAN4_sigAirIntenZon1St: value-spec=0
    Init_CAN4_sigAirIntenZon3St: value-spec=0
    Init_CAN4_sigAmbAirT: value-spec=0
    Init_CAN4_sigCbnAirT: value-spec=0
    Init_CAN4_sigCbnPTCPwrAct: value-spec=0
    Init_CAN4_sigCbnSolarLeft: value-spec=253
    Init_CAN4_sigCbnSolarRight: value-spec=253
    Init_CAN4_sigClmtCmprPwrAct: value-spec=0
    Init_CAN4_sigClntTHvBattOut: value-spec=120
    Init_CAN4_sigDfrstSt: value-spec=0
    Init_CAN4_sigHvacSt: value-spec=0
    Init_CAN4_sigRecircSt: value-spec=0
    Init_CAN4_sigSetTempZon{1..3}St: value-spec=0
    Init_CAN4_sigWindDirZon1St: value-spec=7
    Init_CAN4_sigWindDirZon3St: value-spec=7
    Init_CAN4_FD4_CE100_2_CS: value-spec=0
    Init_CAN4_FD4_CE100_2_RC: value-spec=0
    Init_CAN4_FDC_VCU_ReqHWReset_Cmd: value-spec=0
    Init_CAN4_FDC_BCM_BBuzzer_Cmd: value-spec=0
    Init_CAN4_FDC_BCM_BBuzzerout_Cmd: value-spec=0
    Init_CAN4_FDC_BCM_EmExitLight_Cmd: value-spec=0
    Init_CAN4_FDC_BCM_FrAtmoLamp_Cmd: value-spec=0
    Init_CAN4_FDC_BCM_FrRmLampBright_Cmd: value-spec=0
    Init_CAN4_FDC_BCM_FrRoomlamp_Cmd: value-spec=0
    Init_CAN4_FDC_BCM_IBuzzerReq_Sta: value-spec=0
    Init_CAN4_FDC_BCM_LSMLP_Cmd: value-spec=0
    Init_CAN4_FDC_BCM_LTgateRel_Cmd: value-spec=0
    Init_CAN4_FDC_BCM_RSMLP_Cmd: value-spec=0
    Init_CAN4_FDC_BCM_RTgateRel_Cmd: value-spec=0
    Init_CAN4_FDC_BCM_RevBuzzerout_Cmd: value-spec=0
    Init_CAN4_FDC_BCM_RrAtmoLamp_Cmd: value-spec=0
    Init_CAN4_FDC_BCM_RrRmLampBright_Cmd: value-spec=0
    Init_CAN4_FDC_BCM_RrRoomlamp_Cmd: value-spec=0
    Init_CAN4_FDC_BCM_STurnLpLeft_Cmd: value-spec=0
    Init_CAN4_FDC_BCM_STurnLpRight_Cmd: value-spec=0
    Init_CAN4_FDC_BCM_TgateHDSWL_Sta: value-spec=0
    Init_CAN4_FDC_BCM_TgateHDSWR_Sta: value-spec=0
    Init_CAN4_FDC_BCM_TgateSWL_Sta: value-spec=0
    Init_CAN4_FDC_BCM_TgateSWR_Sta: value-spec=0
    Init_CAN4_FDC_BCM_TurnLpLActive_Cmd: value-spec=0
    Init_CAN4_FDC_BCM_TurnLpRActive_Cmd: value-spec=0
    Init_CAN4_FDC_BCM_innerBuzzer_Cmd: value-spec=0
    Init_CAN4_AmbLightBreath{1..6}: value-spec=0
    Init_CAN4_AmbLightBrightness{1..6}: value-spec=0
    Init_CAN4_AmbLightColor{1..6}: value-spec=0
    Init_CAN4_BCM_Buzzer_Req: value-spec=0
    Init_CAN4_FDC_BCM_ATCtrl_Cmd: value-spec=0
    Init_CAN4_FDC_BCM_DimSw: value-spec=0
    Init_CAN4_FDC_BCM_FWasSw_Sta: value-spec=3
    Init_CAN4_FDC_BCM_FWipSw_Sta: value-spec=7
    Init_CAN4_FDC_BCM_HazardIND_Cmd: value-spec=0
    Init_CAN4_FDC_BCM_LockAlarm_Cmd: value-spec=0
    Init_CAN4_FDC_BCM_OutMode_Cmd: value-spec=0
    Init_CAN4_FDC_BCM_PTGOpenHeight_Sta: value-spec=7
    Init_CAN4_FDC_BCM_PassSW_Sta: value-spec=0
    Init_CAN4_FDC_BCM_TurnSwTSetSta_Sta: value-spec=3
    Init_CAN4_FDC_BCM_TurnSw_Sta: value-spec=3
    Init_CAN4_FDC_BCM_UserHeightSet_Sta: value-spec=1023
    Init_CAN4_FDC_BCM_UserNow_Sta: value-spec=0
    Init_CAN4_FDC_DKC_CommandToBCM_Cmd: value-spec=15
    Init_CAN4_FDC_DKC_DKeyAreaPE_Sta: value-spec=0
    Init_CAN4_FDC_DKC_SPTGDet_Cmd: value-spec=0
    Init_CAN4_FDC_DKC_SPTGOpen_Cmd: value-spec=0
    Init_CAN4_FDC_EChrg_SW_Sta: value-spec=0
    Init_CAN4_FDC_THCM_ACTInitial_Cmd: value-spec=0
    Init_CAN4_FDC_THCM_AirIntZ3_Sta: value-spec=0
    Init_CAN4_FDHandleCmd: value-spec=0
    Init_CAN4_FDLHandleLampCmd: value-spec=0
    Init_CAN4_FDRHandleLampCmd: value-spec=0
    Init_CAN4_WelcomeLight: value-spec=0
    Init_CAN4_OTA_DL_Available: value-spec=0
    Init_CAN4_OTA_DL_Speed: value-spec=0
    Init_CAN4_OTA_Debug_Code: value-spec=0
    Init_CAN4_OTA_Emergency_Sta: value-spec=0
    Init_CAN4_OTA_InVehicle_FW: value-spec=0
    Init_CAN4_OTA_Lock_Req: value-spec=0
    Init_CAN4_OTA_MDA_Status: value-spec=0
    Init_CAN4_OTA_Mode: value-spec=0
    Init_CAN4_OTA_Network_Type: value-spec=0
    Init_CAN4_OTA_Permit_Agreed: value-spec=0
    Init_CAN4_OTA_Progress_Rate: value-spec=0
    Init_CAN4_OTA_Remained_Time: value-spec=0
    Init_CAN4_OTA_TBOXResetReq: value-spec=0
    Init_CAN4_OTA_Update_Available: value-spec=0
    Init_CAN4_OTA_Updating_ECU_8bit: value-spec=0
    Init_CAN4_AVM_parking_excute: value-spec=0
    Init_CAN4_Approach_Unlock_SW: value-spec=0
    Init_CAN4_BrkPedalPos: value-spec=0
    Init_CAN4_BrkPedalPos_Sta: value-spec=0
    Init_CAN4_BrkSw_Sta: value-spec=0
    Init_CAN4_BrkSw_V: value-spec=0
    Init_CAN4_ChrgInLockReq: value-spec=0
    Init_CAN4_ChrgPlugSta: value-spec=0
    Init_CAN4_DSEAT_anti_set: value-spec=0
    Init_CAN4_DSEAT_entryfun_set: value-spec=0
    Init_CAN4_DSEAT_vent_req: value-spec=0
    Init_CAN4_Distance_unit: value-spec=0
    Init_CAN4_ExtChrgSta: value-spec=0
    Init_CAN4_FDC_PTG_inner_SW_2: value-spec=0
    Init_CAN4_HeadLampSW: value-spec=0
    Init_CAN4_Hood_Latch_SW: value-spec=0
    Init_CAN4_IVI_ChargePortSW_Sta: value-spec=0
    Init_CAN4_IVI_DSEATHeater_Cmd: value-spec=0
    Init_CAN4_IVI_ISA_OffsetSpd: value-spec=15
    Init_CAN4_IVI_Located_STA: value-spec=3
    Init_CAN4_IVI_PSEATHeater_Cmd: value-spec=0
    Init_CAN4_IVI_PTG_Mode_SW: value-spec=0
    Init_CAN4_IVI_PTG_Open_Height: value-spec=5
    Init_CAN4_IVI_PTG_Sta_SW: value-spec=0
    Init_CAN4_IVI_Time_Check: value-spec=0
    Init_CAN4_IVI_Time_Day: value-spec=0
    Init_CAN4_IVI_Time_Hour: value-spec=0
    Init_CAN4_IVI_Time_Minute: value-spec=0
    Init_CAN4_IVI_Time_Month: value-spec=0
    Init_CAN4_IVI_Time_Second: value-spec=0
    Init_CAN4_IVI_Time_Year: value-spec=0
    Init_CAN4_IVI_TrailerCheckReq_Sta: value-spec=0
    Init_CAN4_IVI_TrailerModeSW_Sta: value-spec=0
    Init_CAN4_L_Drv_CtrlCmd: value-spec=127
    Init_CAN4_L_Pas_CtrlCmd: value-spec=127
    Init_CAN4_L_RLD_CtrlCmd: value-spec=127
    Init_CAN4_L_RRD_CtrlCmd: value-spec=127
    Init_CAN4_Light_ShowStart_Req: value-spec=0
    Init_CAN4_Light_ShowStop_Req: value-spec=0
    Init_CAN4_MCPressure: value-spec=97
    Init_CAN4_MCPressure_V: value-spec=0
    Init_CAN4_METER_KPH_Calcu: value-spec=0
    Init_CAN4_OBCV2LSta: value-spec=0
    Init_CAN4_OFF_AC_MODE: value-spec=0
    Init_CAN4_PSEAT_vent_req: value-spec=0
    Init_CAN4_SenstivityPosition: value-spec=0
    Init_CAN4_TBOX_Remote_PW: value-spec=0
    Init_CAN4_V2LSta: value-spec=0
    Init_CAN4_VehSpeed: value-spec=0
    Init_CAN4_Walkaway_Lock_SW: value-spec=1
    Init_CAN4_WlcmLight_Mode: value-spec=0
    Init_CAN4_IVI_LSEATvent_Cmd: value-spec=0
    Init_CAN4_IVI_MLFMost_Cmd: value-spec=0
    Init_CAN4_IVI_MLFootLift_Cmd: value-spec=0
    Init_CAN4_IVI_MLNapMode_Cmd: value-spec=0
    Init_CAN4_IVI_MLRecliner_Cmd: value-spec=0
    Init_CAN4_IVI_MLRestore_Cmd: value-spec=0
    Init_CAN4_IVI_MLSEATvent_Cmd: value-spec=0
    Init_CAN4_IVI_MLSeatLift_Cmd: value-spec=0
    Init_CAN4_IVI_MLSldRestore_Cmd: value-spec=0
    Init_CAN4_IVI_MLSlider_Cmd: value-spec=0
    Init_CAN4_IVI_MLZeroGravity_Cmd: value-spec=0
    Init_CAN4_IVI_MRFMost_Cmd: value-spec=0
    Init_CAN4_IVI_MRFootLift_Cmd: value-spec=0
    Init_CAN4_IVI_MRNapMode_Cmd: value-spec=0
    Init_CAN4_IVI_MRRecliner_Cmd: value-spec=0
    Init_CAN4_IVI_MRRestore_Cmd: value-spec=0
    Init_CAN4_IVI_MRSEATvent_Cmd: value-spec=0
    Init_CAN4_IVI_MRSeatLift_Cmd: value-spec=0
    Init_CAN4_IVI_MRSldRestore_Cmd: value-spec=0
    Init_CAN4_IVI_MRSlider_Cmd: value-spec=0
    Init_CAN4_IVI_MRZeroGravity_Cmd: value-spec=0
    Init_CAN4_IVI_RSEATvent_Cmd: value-spec=0
    Init_CAN4_Z24_CHA_AirPressureFC2_Sta: value-spec=0
    Init_CAN4_Z24_CHA_AirPressurePC3_Sta: value-spec=0
    Init_CAN4_Z24_CHA_AirPressureRC1_Sta: value-spec=0
    Init_CAN4_Z24_BCM_EmExitOP_Sta: value-spec=0
    Init_CAN4_Z24_BCM_FLTurnLampC_Sta: value-spec=0
    Init_CAN4_Z24_BCM_FRTurnLampC_Sta: value-spec=0
    Init_CAN4_Z24_BCM_FWiperAS_Sta: value-spec=0
    Init_CAN4_Z24_BCM_FWiperProtection_Sta: value-spec=0
    Init_CAN4_Z24_BCM_RLTurnLampC_Sta: value-spec=0
    Init_CAN4_Z24_BCM_RRTurnLampC_Sta: value-spec=0
    Init_CAN4_Z24_BCM_SeatBeltSW_Sta: value-spec=0
    Init_CAN4_Z24_BCM_innerBuzzer_Sta: value-spec=0
    Init_CAN4_ACT1_Actuator_address: value-spec=0
    Init_CAN4_ACT1_Actuator_set_position: value-spec=0
    Init_CAN4_ACT1_Actuator_start_position: value-spec=0
    Init_CAN4_ACT1_Applied_holding_current: value-spec=0
    Init_CAN4_ACT1_Clear_Event_Flags: value-spec=0
    Init_CAN4_ACT1_Emergency_run_position: value-spec=0
    Init_CAN4_ACT1_Emergency_run_release: value-spec=0
    Init_CAN4_ACT1_Rotation_direction: value-spec=0
    Init_CAN4_ACT1_Save_programming_data: value-spec=0
    Init_CAN4_ACT1_Select_position_specification: value-spec=0
    Init_CAN4_ACT1_Speed_specification: value-spec=0
    Init_CAN4_ACT1_Stall_detection_release: value-spec=0
    Init_CAN4_ACT1_Stop_mode: value-spec=0
    Init_CAN4_ACT2_Actuator_address: value-spec=0
    Init_CAN4_ACT2_Actuator_set_position: value-spec=0
    Init_CAN4_ACT2_Actuator_start_position: value-spec=0
    Init_CAN4_ACT2_Applied_holding_current: value-spec=0
    Init_CAN4_ACT2_Clear_Event_Flags: value-spec=0
    Init_CAN4_ACT2_Emergency_run_position: value-spec=0
    Init_CAN4_ACT2_Emergency_run_release: value-spec=0
    Init_CAN4_ACT2_Rotation_direction: value-spec=0
    Init_CAN4_ACT2_Save_programming_data: value-spec=0
    Init_CAN4_ACT2_Select_position_specification: value-spec=0
    Init_CAN4_ACT2_Speed_specification: value-spec=0
    Init_CAN4_ACT2_Stall_detection_release: value-spec=0
    Init_CAN4_ACT2_Stop_mode: value-spec=0
    Init_CAN4_ACT3_Actuator_address: value-spec=0
    Init_CAN4_ACT3_Actuator_set_position: value-spec=0
    Init_CAN4_ACT3_Actuator_start_position: value-spec=0
    Init_CAN4_ACT3_Applied_holding_current: value-spec=0
    Init_CAN4_ACT3_Clear_Event_Flags: value-spec=0
    Init_CAN4_ACT3_Emergency_run_position: value-spec=0
    Init_CAN4_ACT3_Emergency_run_release: value-spec=0
    Init_CAN4_ACT3_Rotation_direction: value-spec=0
    Init_CAN4_ACT3_Save_programming_data: value-spec=0
    Init_CAN4_ACT3_Select_position_specification: value-spec=0
    Init_CAN4_ACT3_Speed_specification: value-spec=0
    Init_CAN4_ACT3_Stall_detection_release: value-spec=0
    Init_CAN4_ACT3_Stop_mode: value-spec=0
    Init_CAN4_ACT4_Actuator_address: value-spec=0
    Init_CAN4_ACT4_Actuator_set_position: value-spec=0
    Init_CAN4_ACT4_Actuator_start_position: value-spec=0
    Init_CAN4_ACT4_Applied_holding_current: value-spec=0
    Init_CAN4_ACT4_Clear_Event_Flags: value-spec=0
    Init_CAN4_ACT4_Emergency_run_position: value-spec=0
    Init_CAN4_ACT4_Emergency_run_release: value-spec=0
    Init_CAN4_ACT4_Rotation_direction: value-spec=0
    Init_CAN4_ACT4_Save_programming_data: value-spec=0
    Init_CAN4_ACT4_Select_position_specification: value-spec=0
    Init_CAN4_ACT4_Speed_specification: value-spec=0
    Init_CAN4_ACT4_Stall_detection_release: value-spec=0
    Init_CAN4_ACT4_Stop_mode: value-spec=0
    Init_CAN4_ACT5_Actuator_address: value-spec=0
    Init_CAN4_ACT5_Actuator_set_position: value-spec=0
    Init_CAN4_ACT5_Actuator_start_position: value-spec=0
    Init_CAN4_ACT5_Applied_holding_current: value-spec=0
    Init_CAN4_ACT5_Clear_Event_Flags: value-spec=0
    Init_CAN4_ACT5_Emergency_run_position: value-spec=0
    Init_CAN4_ACT5_Emergency_run_release: value-spec=0
    Init_CAN4_ACT5_Rotation_direction: value-spec=0
    Init_CAN4_ACT5_Save_programming_data: value-spec=0
    Init_CAN4_ACT5_Select_position_specification: value-spec=0
    Init_CAN4_ACT5_Speed_specification: value-spec=0
    Init_CAN4_ACT5_Stall_detection_release: value-spec=0
    Init_CAN4_ACT5_Stop_mode: value-spec=0
    Init_CAN4_AllLockSta: value-spec=0
    Init_CAN4_AutoLightSW: value-spec=0
    Init_CAN4_BrakeLampFail: value-spec=0
    Init_CAN4_DrLockSta: value-spec=0
    Init_CAN4_HornSW: value-spec=0
    Init_CAN4_MIRROR_FOLD_SW: value-spec=0
    Init_CAN4_PsLockSta: value-spec=0
    Init_CAN4_RLLockSta: value-spec=0
    Init_CAN4_RLS_Exist: value-spec=0
    Init_CAN4_RLTurnLPErr: value-spec=0
    Init_CAN4_RLTurnLampC: value-spec=255
    Init_CAN4_RRLockSta: value-spec=0
    Init_CAN4_RRTurnLPErr: value-spec=0
    Init_CAN4_RRTurnLampC: value-spec=255
    Init_CAN4_RWiperAS: value-spec=0
    Init_CAN4_RWiperProtection: value-spec=0
    Init_CAN4_Wip_Speed: value-spec=0
    Init_CAN4_WiperSWPos: value-spec=255
    Init_CAN4_WiperZeroPosSW: value-spec=0
    Init_CAN4_ZDR_THCM_IntakeFail_Sta: value-spec=0
    Init_CAN4_ZDR_THCM_LINACT{1..5}_Sta: value-spec=0
    Init_CAN4_ZDR_THCM_ModeFail_Sta: value-spec=0
    Init_CAN4_APTC_Err: value-spec=3
    Init_CAN4_Blower_Err: value-spec=3
    Init_CAN4_Blower_FB: value-spec=15
    Init_CAN4_DrADASCurr: value-spec=0
    Init_CAN4_DrAPWLINErr: value-spec=0
    Init_CAN4_DrAPWStaErr: value-spec=0
    Init_CAN4_DrAuBoxPwrN1Curr: value-spec=0
    Init_CAN4_DrAuBoxPwrN2Curr: value-spec=0
    Init_CAN4_DrColumnSWFault: value-spec=0
    Init_CAN4_DrCtrlBDVolt: value-spec=0
    Init_CAN4_DrCtrlTemp: value-spec=0
    Init_CAN4_DrEOBDFault: value-spec=0
    Init_CAN4_DrIVIFault: value-spec=0
    Init_CAN4_DrInfoErrSta: value-spec=0
    Init_CAN4_DrInfoFault: value-spec=0
    Init_CAN4_DrONA1ErrSta: value-spec=0
    Init_CAN4_DrPMMLVOutPErrLmp: value-spec=0
    Init_CAN4_DrPMMLimpHomeActReq: value-spec=0
    Init_CAN4_DrPMMSysErrLmp: value-spec=0
    Init_CAN4_DrPowerTemp1: value-spec=0
    Init_CAN4_DrPowerTemp2: value-spec=0
    Init_CAN4_DrPwrInformationSta: value-spec=0
    Init_CAN4_DrPwrONA1Curr: value-spec=0
    Init_CAN4_DrPwrONA2Curr: value-spec=0
    Init_CAN4_DrPwrSta: value-spec=7
    Init_CAN4_DrPwrStdbyACurr: value-spec=0
    Init_CAN4_DrPwrWinErrSta: value-spec=0
    Init_CAN4_DrPwrWindowECUFault: value-spec=0
    Init_CAN4_DrSCPSysErrLmp: value-spec=0
    Init_CAN4_DrStdAErrSta: value-spec=0
    Init_CAN4_DrTHCMFault: value-spec=0
    Init_CAN4_RegenSW_Err: value-spec=0
    Init_CAN4_SolarL: value-spec=253
    Init_CAN4_SolarL_Err: value-spec=3
    Init_CAN4_SolarR: value-spec=253
    Init_CAN4_SolarR_Err: value-spec=3
    Init_CAN4_T_Face_L: value-spec=0
    Init_CAN4_T_Face_L_Err: value-spec=3
    Init_CAN4_T_Face_R: value-spec=0
    Init_CAN4_T_Face_R_Err: value-spec=3
    Init_CAN4_T_Face_Rr: value-spec=0
    Init_CAN4_T_Face_Rr_Err: value-spec=3
    Init_CAN4_T_Foot_L: value-spec=0
    Init_CAN4_T_Foot_L_Err: value-spec=3
    Init_CAN4_T_Foot_R: value-spec=0
    Init_CAN4_T_Foot_R_Err: value-spec=3
    Init_CAN4_T_Foot_Rr: value-spec=0
    Init_CAN4_T_Foot_Rr_Err: value-spec=3
    Init_CAN4_Tevap: value-spec=0
    Init_CAN4_Tevap_Err: value-spec=3
    Init_CAN4_Tincar: value-spec=0
    Init_CAN4_Tincar_Err: value-spec=3
    Init_CAN4_ZDR_SYS_APMRetryCnt_Sta: value-spec=0
    Init_CAN4_ZDR_SYS_BSWSleepReq_Sta: value-spec=0
    Init_CAN4_ZDR_SYS_CSWRetryCnt_Sta: value-spec=0
    Init_CAN4_ZDR_VCU_HWReset_Sta: value-spec=0
    Init_CAN4_ZDR_VCU_PwrSupply_Sta: value-spec=0
    Init_CAN4_ZoneDrMalfunLevel: value-spec=5
    Init_CAN4_BDC_1_MoveEnable: value-spec=0
    Init_CAN4_BDC_1_ReqMovePos: value-spec=0
    Init_CAN4_BMSChksmHSC6: value-spec=0
    Init_CAN4_BMSEnbPTCHSC6: value-spec=0
    Init_CAN4_BMSInptClntTemHSC6: value-spec=0
    Init_CAN4_BMSPackVol_h6HSC6: value-spec=4095
    Init_CAN4_BMSReqMdHSC6: value-spec=0
    Init_CAN4_BMSReqPWMHSC6: value-spec=0
    Init_CAN4_BMSReqPwrHSC6: value-spec=0
    Init_CAN4_BMSReqRlngCtrHSC6: value-spec=0
    Init_CAN4_BMSReqTapPosHSC6: value-spec=0
    Init_CAN4_CCM_SpdCmd: value-spec=0
    Init_CAN4_CCV4_MoveEnable: value-spec=0
    Init_CAN4_CCV4_ReqMovePos: value-spec=0
    Init_CAN4_ChargeInletLockSta: value-spec=0
    Init_CAN4_CompProEN: value-spec=0
    Init_CAN4_EWP1_Default_Operation_EWP_Rq: value-spec=0
    Init_CAN4_EWP1_RPM_Target_EWP_Rq: value-spec=0
    Init_CAN4_EWP2_Default_Operation_EWP_Rq: value-spec=0
    Init_CAN4_EWP2_RPM_Target_EWP_Rq: value-spec=0
    Init_CAN4_EWP3_Default_Operation_EWP_Rq: value-spec=0
    Init_CAN4_EWP3_RPM_Target_EWP_Rq: value-spec=0
    Init_CAN4_EXV2_Cmd_Init_Rq: value-spec=7
    Init_CAN4_EXV2_Cmd_Move_Enbl: value-spec=0
    Init_CAN4_EXV2_Cmd_Set_Rq: value-spec=65535
    Init_CAN4_EXV_Cmd_Init_Rq: value-spec=7
    Init_CAN4_EXV_Cmd_Move_Enbl: value-spec=0
    Init_CAN4_EXV_Cmd_Set_Rq: value-spec=65535
    Init_CAN4_FLPosLPErr: value-spec=0
    Init_CAN4_FLTurnLPErr: value-spec=0
    Init_CAN4_FLTurnLampC: value-spec=255
    Init_CAN4_FLTurn_Light_Warning: value-spec=0
    Init_CAN4_FRPosLPErr: value-spec=0
    Init_CAN4_FRTurnLPErr: value-spec=0
    Init_CAN4_FRTurnLampC: value-spec=255
    Init_CAN4_FRTurn_Light_Warning: value-spec=0
    Init_CAN4_FWiperAS: value-spec=0
    Init_CAN4_FWiperProtection: value-spec=0
    Init_CAN4_LADBErr: value-spec=0
    Init_CAN4_LADB_Hibeam_Indication: value-spec=0
    Init_CAN4_LADB_Operation_Status: value-spec=0
    Init_CAN4_LADB_Warning: value-spec=0
    Init_CAN4_LAHB_Warning: value-spec=0
    Init_CAN4_LDRLErr: value-spec=0
    Init_CAN4_LDRL_Warning: value-spec=0
    Init_CAN4_LH_BeamErr: value-spec=0
    Init_CAN4_LLB_Warning: value-spec=0
    Init_CAN4_LL_BeamErr: value-spec=0
    Init_CAN4_Lposition_Lamp_Warning: value-spec=0
    Init_CAN4_RADBErr: value-spec=0
    Init_CAN4_RADB_Hibeam_Indication: value-spec=0
    Init_CAN4_RADB_Operation_Status: value-spec=0
    Init_CAN4_RADB_Warning: value-spec=0
    Init_CAN4_RAHB_Warning: value-spec=0
    Init_CAN4_RDRLErr: value-spec=0
    Init_CAN4_RDRL_Warning: value-spec=0
    Init_CAN4_RH_BeamErr: value-spec=0
    Init_CAN4_RLB_Warning: value-spec=0
    Init_CAN4_RL_BeamErr: value-spec=0
    Init_CAN4_Rposition_Lamp_Warning: value-spec=0
    Init_CAN4_TrailerCheck: value-spec=0
    Init_CAN4_TrailerModeSta: value-spec=0
    Init_CAN4_ZFR_BCM_ChargerDoorSW_Sta: value-spec=0
    Init_CAN4_ZFR_EChrg_Active_Sta: value-spec=0
    Init_CAN4_ZFR_EChrg_Sys_Sta: value-spec=0
    Init_CAN4_ZFR_THCM_CLEVentActY_Sta: value-spec=0
    Init_CAN4_ZFR_THCM_CLEVentActZ_Sta: value-spec=0
    Init_CAN4_ZFR_THCM_CREVentActY_Sta: value-spec=0
    Init_CAN4_ZFR_THCM_CREVentActZ_Sta: value-spec=0
    Init_CAN4_ZFR_THCM_DrEVentActY_Sta: value-spec=0
    Init_CAN4_ZFR_THCM_DrEVentActZ_Sta: value-spec=0
    Init_CAN4_ZFR_THCM_PsEVentActY_Sta: value-spec=0
    Init_CAN4_ZFR_THCM_PsEVentActZ_Sta: value-spec=0
    Init_CAN4_Bat_In_Temp: value-spec=0
    Init_CAN4_Bat_In_Temp_Err: value-spec=3
    Init_CAN4_Bat_Out_Temp: value-spec=0
    Init_CAN4_Bat_Out_Temp_Err: value-spec=3
    Init_CAN4_COMP_Err: value-spec=3
    Init_CAN4_EACProtectEnable: value-spec=0
    Init_CAN4_EWP{1..3}_Err: value-spec=3
    Init_CAN4_EXV1_Err: value-spec=3
    Init_CAN4_EXV2_Err: value-spec=3
    Init_CAN4_FWV_Err: value-spec=3
    Init_CAN4_Fan_Err: value-spec=3
    Init_CAN4_FrBMSCCUCErr: value-spec=0
    Init_CAN4_FrBMS_CCU_CIRCurr: value-spec=0
    Init_CAN4_FrBMS_CCU_CIRFault: value-spec=0
    Init_CAN4_FrCtrlBDVolt: value-spec=0
    Init_CAN4_FrCtrlTemp: value-spec=0
    Init_CAN4_FrEDUErr: value-spec=0
    Init_CAN4_FrEDU_INVERTERCurr: value-spec=0
    Init_CAN4_FrEDU_INVERTERFault: value-spec=0
    Init_CAN4_FrIRC_1Curr: value-spec=0
    Init_CAN4_FrIRC_2Curr: value-spec=0
    Init_CAN4_FrPMMLVOutPErrLmp: value-spec=0
    Init_CAN4_FrPMMLimpHomeActReq: value-spec=0
    Init_CAN4_FrPMMSysErrLmp: value-spec=0
    Init_CAN4_FrPowerTemp1: value-spec=0
    Init_CAN4_FrPowerTemp2: value-spec=0
    Init_CAN4_FrPwrONA1Fault: value-spec=0
    Init_CAN4_FrPwrONA2Curr: value-spec=0
    Init_CAN4_FrPwrONA3Curr: value-spec=0
    Init_CAN4_FrPwrSta: value-spec=7
    Init_CAN4_FrPwrStdbyA1Fault: value-spec=0
    Init_CAN4_FrPwrStdbyA1PlusCurr: value-spec=0
    Init_CAN4_FrPwrStdbyA1PlusFault: value-spec=0
    Init_CAN4_FrPwrStdbyA2Curr: value-spec=0
    Init_CAN4_FrPwrStdbyA2PlusCurr: value-spec=0
    Init_CAN4_FrPwrStdbyA2PlusFault: value-spec=0
    Init_CAN4_FrStdA1PCErr: value-spec=0
    Init_CAN4_FrStdA2PCErr: value-spec=0
    Init_CAN4_FrStdA2PErr: value-spec=0
    Init_CAN4_Motor_In_Temp: value-spec=0
    Init_CAN4_Motor_In_Temp_Err: value-spec=3
    Init_CAN4_Motor_Out_Temp: value-spec=0
    Init_CAN4_Motor_Out_Temp_Err: value-spec=3
    Init_CAN4_PT_High_P: value-spec=2700
    Init_CAN4_PT_High_P_Err: value-spec=3
    Init_CAN4_PT_High_T: value-spec=0
    Init_CAN4_PT_High_Tact: value-spec=0
    Init_CAN4_PT_High_Tact_Err: value-spec=3
    Init_CAN4_PT_Low_P1: value-spec=0
    Init_CAN4_PT_Low_P1_Err: value-spec=3
    Init_CAN4_PT_Low_P2: value-spec=0
    Init_CAN4_PT_Low_P2_Err: value-spec=3
    Init_CAN4_PT_Low_T1: value-spec=0
    Init_CAN4_PT_Low_T1_Err: value-spec=3
    Init_CAN4_PT_Low_T2: value-spec=0
    Init_CAN4_PT_Low_T2_Err: value-spec=3
    Init_CAN4_SOTXV_Err: value-spec=3
    Init_CAN4_SOV{1..3}_Err: value-spec=3
    Init_CAN4_TWV_Err: value-spec=3
    Init_CAN4_Tamb: value-spec=0
    Init_CAN4_Tamb_Err: value-spec=3
    Init_CAN4_WPTC_Err: value-spec=3
    Init_CAN4_ZFR_SYS_BMSCCURetryCnt_Sta: value-spec=0
    Init_CAN4_ZFR_SYS_BSWSleepReq_Sta: value-spec=0
    Init_CAN4_ZFR_SYS_MCURetryCnt_Sta: value-spec=0
    Init_CAN4_ZFR_VCU_HWReset_Sta: value-spec=0
    Init_CAN4_ZFR_VCU_PwrSupply_Sta: value-spec=0
    Init_CAN4_ZoneFrMalfunLevel: value-spec=5
    Init_CAN4_FrntPTCBusLineHiV: value-spec=1023
    Init_CAN4_FrntPTCComFlt: value-spec=0
    Init_CAN4_FrntPTCFltSt: value-spec=0
    Init_CAN4_FrntPTCHVOverUFlt: value-spec=0
    Init_CAN4_FrntPTCHVUnderUFlt: value-spec=0
    Init_CAN4_FrntPTCHWVers: value-spec=0
    Init_CAN4_FrntPTCLVOverUFlt: value-spec=0
    Init_CAN4_FrntPTCLVUnderUFlt: value-spec=0
    Init_CAN4_FrntPTCLeActHeatPwr: value-spec=255
    Init_CAN4_FrntPTCLeBusLineC: value-spec=255
    Init_CAN4_FrntPTCLeCoreOverTFlt: value-spec=0
    Init_CAN4_FrntPTCLeCoreT: value-spec=255
    Init_CAN4_FrntPTCLeCoreTSnsrFlt: value-spec=0
    Init_CAN4_FrntPTCLeIGBTOverTFlt: value-spec=0
    Init_CAN4_FrntPTCLeIGBTShoCircFlt: value-spec=0
    Init_CAN4_FrntPTCLeIGBTT: value-spec=255
    Init_CAN4_FrntPTCLeIGBTTSnsrFlt: value-spec=0
    Init_CAN4_FrntPTCLeOpentCircFlt: value-spec=0
    Init_CAN4_FrntPTCLeOverAFlt: value-spec=0
    Init_CAN4_FrntPTCPCBOverTFlt: value-spec=0
    Init_CAN4_FrntPTCPCBT: value-spec=255
    Init_CAN4_FrntPTCPCBTSnsrFlt: value-spec=0
    Init_CAN4_FrntPTCRearLeActHeatPwr: value-spec=255
    Init_CAN4_FrntPTCRearLeBusLineC: value-spec=255
    Init_CAN4_FrntPTCRearLeCoreOverTFlt: value-spec=0
    Init_CAN4_FrntPTCRearLeCoreT: value-spec=255
    Init_CAN4_FrntPTCRearLeCoreTSnsrFlt: value-spec=0
    Init_CAN4_FrntPTCRearLeIGBTShoCFlt: value-spec=0
    Init_CAN4_FrntPTCRearLeOpentCircFlt: value-spec=0
    Init_CAN4_FrntPTCRearLeOverAFlt: value-spec=0
    Init_CAN4_FrntPTCRearRiActHeatPwr: value-spec=255
    Init_CAN4_FrntPTCRearRiBusLineC: value-spec=255
    Init_CAN4_FrntPTCRearRiCoreOverTFlt: value-spec=0
    Init_CAN4_FrntPTCRearRiCoreT: value-spec=255
    Init_CAN4_FrntPTCRearRiCoreTSnsrFlt: value-spec=0
    Init_CAN4_FrntPTCRearRiIGBTShoCFlt: value-spec=0
    Init_CAN4_FrntPTCRearRiOpentCircFlt: value-spec=0
    Init_CAN4_FrntPTCRearRiOverAFlt: value-spec=0
    Init_CAN4_FrntPTCRiActHeatPwr: value-spec=255
    Init_CAN4_FrntPTCRiBusLineC: value-spec=255
    Init_CAN4_FrntPTCRiCoreOverTFlt: value-spec=0
    Init_CAN4_FrntPTCRiCoreT: value-spec=255
    Init_CAN4_FrntPTCRiCoreTSnsrFlt: value-spec=0
    Init_CAN4_FrntPTCRiIGBTOverTFlt: value-spec=0
    Init_CAN4_FrntPTCRiIGBTShoCircFlt: value-spec=0
    Init_CAN4_FrntPTCRiIGBTT: value-spec=255
    Init_CAN4_FrntPTCRiIGBTTSnsrFlt: value-spec=0
    Init_CAN4_FrntPTCRiOpentCircFlt: value-spec=0
    Init_CAN4_FrntPTCRiOverAFlt: value-spec=0
    Init_CAN4_FrntPTCSWVers: value-spec=0
    Init_CAN4_FrntPTCSts: value-spec=0
    Init_CAN4_FrntPTCSupplierCod: value-spec=0
    Init_CAN4_COMP_ActualPwr: value-spec=8191
    Init_CAN4_COMP_ComLost: value-spec=0
    Init_CAN4_COMP_ConCur: value-spec=0
    Init_CAN4_COMP_ConVolt: value-spec=0
    Init_CAN4_COMP_CtrlCircFlt: value-spec=0
    Init_CAN4_COMP_CurOverProtect: value-spec=0
    Init_CAN4_COMP_CurVaild: value-spec=0
    Init_CAN4_COMP_IPM_HWFLt: value-spec=0
    Init_CAN4_COMP_IPM_TempOverFlt: value-spec=0
    Init_CAN4_COMP_Init: value-spec=0
    Init_CAN4_COMP_SpdVaild: value-spec=0
    Init_CAN4_COMP_Sta: value-spec=0
    Init_CAN4_COMP_StatorSpd: value-spec=16383
    Init_CAN4_COMP_VoltLessErr: value-spec=0
    Init_CAN4_COMP_VoltOverErr: value-spec=0
    Init_CAN4_COMP_VoltVaild: value-spec=0
    Init_CAN4_EAC_DrvVoltFalt: value-spec=0
    Init_CAN4_EAC_MotCrt: value-spec=0
    Init_CAN4_EAC_MotorLackFalt: value-spec=0
    Init_CAN4_EAC_OvLoadFalt: value-spec=0
    Init_CAN4_EAC_Temp: value-spec=101
    Init_CAN4_EAC_TempSnsrFalt: value-spec=0
    Init_CAN4_PTC1_PowerConsumption: value-spec=0
    Init_CAN4_PTCActuCrntHSC6: value-spec=0
    Init_CAN4_PTCActuPWMDutyHSC6: value-spec=0
    Init_CAN4_PTCActuPwrHSC6: value-spec=0
    Init_CAN4_PTCActuVolHSC6: value-spec=0
    Init_CAN4_PTCChksmHSC6: value-spec=0
    Init_CAN4_PTCFltLvlHSC6: value-spec=0
    Init_CAN4_PTCHVLckStsHSC6: value-spec=0
    Init_CAN4_PTCIGBTOverHeatHSC6: value-spec=0
    Init_CAN4_PTCIGBTStsHSC6: value-spec=0
    Init_CAN4_PTCIGBTTemHSC6: value-spec=0
    Init_CAN4_PTCNTCStsHSC6: value-spec=0
    Init_CAN4_PTCOtptTemHSC6: value-spec=0
    Init_CAN4_PTCOverCrntHSC6: value-spec=0
    Init_CAN4_PTCOverHeatHSC6: value-spec=0
    Init_CAN4_PTCOverVolHSC6: value-spec=0
    Init_CAN4_PTCPCBTemHSC6: value-spec=0
    Init_CAN4_PTCRlngCtrHSC6: value-spec=0
    Init_CAN4_PTCSecChksmHSC6: value-spec=0
    Init_CAN4_PTCSecRlngCtrHSC6: value-spec=0
    Init_CAN4_PTCStsHSC6: value-spec=0
    Init_CAN4_PTCUnderVolHSC6: value-spec=0
    Init_CAN4_CSW_DimSw: value-spec=0
    Init_CAN4_CSW_FWasSw_Sta: value-spec=0
    Init_CAN4_CSW_FWipSw_Sta: value-spec=0
    Init_CAN4_CSW_HW_version: value-spec=0
    Init_CAN4_CSW_PassSW_Sta: value-spec=0
    Init_CAN4_CSW_RWasSW_Sta: value-spec=0
    Init_CAN4_CSW_RWipIntSw_Sta: value-spec=0
    Init_CAN4_CSW_SW_version: value-spec=0
    Init_CAN4_CSW_TurnSw_Sta: value-spec=0
    Init_CAN4_CSW_resp_error: value-spec=0
    Init_CAN4_FAPWL_01_LIN_Response_Error: value-spec=0
    Init_CAN4_L_Drv_Motor_Relay_Error: value-spec=0
    Init_CAN4_L_Drv_Motor_Ripple_Error: value-spec=0
    Init_CAN4_L_Drv_OverHeat_Protect: value-spec=0
    Init_CAN4_L_Drv_Val_Wdw_Opened: value-spec=127
    Init_CAN4_L_Drv_Wdw_Init: value-spec=0
    Init_CAN4_L_Drv_Wdw_LocalSwitch: value-spec=0
    Init_CAN4_L_Drv_Wdw_OD_Sts: value-spec=0
    Init_CAN4_L_Drv_Wdw_Obs_InhibitSts: value-spec=0
    Init_CAN4_L_Drv_Wdw_Pas_Switch: value-spec=0
    Init_CAN4_L_Drv_Wdw_PositionSts: value-spec=3
    Init_CAN4_L_Drv_Wdw_RLD_Switch: value-spec=0
    Init_CAN4_L_Drv_Wdw_RRD_Switch: value-spec=0
    Init_CAN4_L_Drv_Wdw_Running_Sts: value-spec=0
    Init_CAN4_L_Pas_Motor_Relay_Error: value-spec=0
    Init_CAN4_L_Pas_Motor_Ripple_Error: value-spec=0
    Init_CAN4_L_Pas_OverHeat_Protect: value-spec=0
    Init_CAN4_L_Pas_Val_Wdw_Opened: value-spec=127
    Init_CAN4_L_Pas_Wdw_Init: value-spec=0
    Init_CAN4_L_Pas_Wdw_LocalSwitch: value-spec=0
    Init_CAN4_L_Pas_Wdw_OD_Sts: value-spec=0
    Init_CAN4_L_Pas_Wdw_Obs_InhibitSts: value-spec=0
    Init_CAN4_L_Pas_Wdw_PositionSts: value-spec=3
    Init_CAN4_L_Pas_Wdw_Running_Sts: value-spec=0
    Init_CAN4_L_Power_Status: value-spec=0
    Init_CAN4_L_RLD_Motor_Relay_Error: value-spec=0
    Init_CAN4_L_RLD_Motor_Ripple_Error: value-spec=0
    Init_CAN4_L_RLD_OverHeat_Protect: value-spec=0
    Init_CAN4_L_RLD_Val_Wdw_Opened: value-spec=127
    Init_CAN4_L_RLD_Wdw_Init: value-spec=0
    Init_CAN4_L_RLD_Wdw_LocalSwitch: value-spec=0
    Init_CAN4_L_RLD_Wdw_OD_Sts: value-spec=0
    Init_CAN4_L_RLD_Wdw_Obs_InhibitSts: value-spec=0
    Init_CAN4_L_RLD_Wdw_PositionSts: value-spec=3
    Init_CAN4_L_RLD_Wdw_Running_Sts: value-spec=0
    Init_CAN4_L_RRD_Motor_Relay_Error: value-spec=0
    Init_CAN4_L_RRD_Motor_Ripple_Error: value-spec=0
    Init_CAN4_L_RRD_OverHeat_Protect: value-spec=0
    Init_CAN4_L_RRD_Val_Wdw_Opened: value-spec=127
    Init_CAN4_L_RRD_Wdw_Init: value-spec=0
    Init_CAN4_L_RRD_Wdw_LocalSwitch: value-spec=0
    Init_CAN4_L_RRD_Wdw_OD_Sts: value-spec=0
    Init_CAN4_L_RRD_Wdw_Obs_InhibitSts: value-spec=0
    Init_CAN4_L_RRD_Wdw_PositionSts: value-spec=3
    Init_CAN4_L_RRD_Wdw_Running_Sts: value-spec=0
    Init_CAN4_RAPWL_01_LIN_Response_Error: value-spec=0
    Init_CAN4_RLS_LIN_Resp_Err: value-spec=0
    Init_CAN4_RLS_Lamp_Sta: value-spec=0
    Init_CAN4_RLS_LightSnrErr: value-spec=0
    Init_CAN4_RLS_RainSnrErr: value-spec=0
    Init_CAN4_RLS_RainSnrWiperCmd: value-spec=0
    Init_CAN4_SWC2_HW_Version: value-spec=0
    Init_CAN4_SWC2_L_ADAS_Sta: value-spec=0
    Init_CAN4_SWC2_L_DriveMode_Sta: value-spec=0
    Init_CAN4_SWC2_L_Home_Sta: value-spec=0
    Init_CAN4_SWC2_L_Left_Sta: value-spec=0
    Init_CAN4_SWC2_L_RegenUp_Sta: value-spec=0
    Init_CAN4_SWC2_L_Right_Sta: value-spec=0
    Init_CAN4_SWC2_L_ScrollDown_Sta: value-spec=0
    Init_CAN4_SWC2_L_ScrollPress_Sta: value-spec=0
    Init_CAN4_SWC2_L_ScrollUp_Sta: value-spec=0
    Init_CAN4_SWC2_R_Customize_Sta: value-spec=0
    Init_CAN4_SWC2_R_Left_Sta: value-spec=0
    Init_CAN4_SWC2_R_PageSwitch_Sta: value-spec=0
    Init_CAN4_SWC2_R_RegenDown_Sta: value-spec=0
    Init_CAN4_SWC2_R_Right_Sta: value-spec=0
    Init_CAN4_SWC2_R_ScrollDown_Sta: value-spec=0
    Init_CAN4_SWC2_R_ScrollPress_Sta: value-spec=0
    Init_CAN4_SWC2_R_ScrollUp_Sta: value-spec=0
    Init_CAN4_SWC2_R_VR_Sta: value-spec=0
    Init_CAN4_SWC2_ResponseError: value-spec=0
    Init_CAN4_SWC2_SW_Version: value-spec=0
    Init_CAN4_SWC_ACC_Sta: value-spec=0
    Init_CAN4_SWC_A_HW_version: value-spec=0
    Init_CAN4_SWC_A_Resp_Err: value-spec=0
    Init_CAN4_SWC_A_SW_version: value-spec=0
    Init_CAN4_SWC_CANCEL_Sta: value-spec=0
    Init_CAN4_SWC_Distance_Sta: value-spec=0
    Init_CAN4_SWC_Down_Sta: value-spec=0
    Init_CAN4_SWC_Drivemode_Sta: value-spec=0
    Init_CAN4_SWC_LKA_Sta: value-spec=0
    Init_CAN4_SWC_Left_Sta: value-spec=0
    Init_CAN4_SWC_RegenDown: value-spec=0
    Init_CAN4_SWC_RegenUp: value-spec=0
    Init_CAN4_SWC_Res_Up_Sta: value-spec=0
    Init_CAN4_SWC_Right_Sta: value-spec=0
    Init_CAN4_SWC_Set_down_Sta: value-spec=0
    Init_CAN4_SWC_Trip_Sta: value-spec=0
    Init_CAN4_SWC_Undefined_Sta: value-spec=0
    Init_CAN4_SWC_Up_Sta: value-spec=0
    Init_CAN4_SWC_VR_Sta: value-spec=0
    Init_CAN4_SWC_mode_Sta: value-spec=0
    Init_CAN4_SWC_resp_error: value-spec=0
    Init_CAN4_SG_DKC1: value-spec=fields=[Init_CAN4_DKC_KeyNum_Sta, Init_CAN4_DKC_KeyType_Sta, Init_CAN4_DKC_PDkeyAreaRAPS_Sta, Init_CAN4_DKC_ParkingMode_Cmd, Init_CAN4_DKC_Re_VehData, Init_CAN4_P_CommandToBCM, Init_CAN4_P_CommandToPTG, Init_CAN4_P_DKey_Area_LockUnlock, Init_CAN4_P_DKey_Area_PS, Init_CAN4_P_DKey_Area_PTG, Init_CAN4_P_DKey_Welcome, Init_CAN4_P_Dkey_Show_IVI, Init_CAN4_P_KeyMiss, Init_CAN4_P_KeyMode, Init_CAN4_P_UID_LowPower]
    Init_CAN4_SG_DKC2: value-spec=fields=[Init_CAN4_EncryptionDATA_0_63, Init_CAN4_EncryptionDATA_64_127, Init_CAN4_Random_Number_X]
    Init_CAN4_SG_FD4_C100_0: value-spec=fields=constant-reference=Init_CAN4_FDC_CHA_EACEnDemand_Cmd
    Init_CAN4_SG_FD4_CE100_0: value-spec=fields=[Init_CAN4_APS_Sta_System, Init_CAN4_AllDoorSW, Init_CAN4_AntiTheftSeatFold, Init_CAN4_AntitheftSta, Init_CAN4_BCM_DoorLock_Sta, Init_CAN4_BrakeLamp, Init_CAN4_CC_Crl_Sta, Init_CAN4_CS_VCU1_CAN4, Init_CAN4_CTDCtrl, Init_CAN4_CTDLockSW, Init_CAN4_CTDUnlockSW, Init_CAN4_CrashDetd, Init_CAN4_CtrlDrPwrStbA2, Init_CAN4_CtrlFrBMSCCUCIR, Init_CAN4_CtrlFrEDUINVERTER, Init_CAN4_CtrlFrIRC1, Init_CAN4_CtrlFrPwrStbA1P, Init_CAN4_DKCAuthSta, Init_CAN4_DKCTimeSN, Init_CAN4_Dimmer, Init_CAN4_DimmerEN, Init_CAN4_DoorLockIND, Init_CAN4_DrDoorSW, Init_CAN4_Dr_SeatSta, Init_CAN4_EquivAccPedalSWSta, Init_CAN4_FD_DKC_VehData_Err, Init_CAN4_FD_DKC_VehData_Sta, Init_CAN4_FD_TBOX_DTCData_Err, Init_CAN4_FD_TBOX_DTCData_Sta, Init_CAN4_FD_TBOX_VehData_Err, Init_CAN4_FD_TBOX_VehData_Sta, Init_CAN4_Fr_ChargingDoorCtrl, Init_CAN4_Fr_FogLamp, Init_CAN4_Fr_Wiper_H, Init_CAN4_Fr_Wiper_L, Init_CAN4_HWResetSta, Init_CAN4_H_Beam, Init_CAN4_H_Beam_ADB, Init_CAN4_HazardSW, Init_CAN4_HoodSW, Init_CAN4_HornCtrl, Init_CAN4_LBSD, Init_CAN4_LDRL, Init_CAN4_LTurnLP, Init_CAN4_L_APM_WdwEnable, Init_CAN4_L_Beam, Init_CAN4_LampPwr, Init_CAN4_LockSetting, Init_CAN4_MSA_Crl_Sta, Init_CAN4_MirrorCtrl, Init_CAN4_MirrorDefog, Init_CAN4_PosLamp, Init_CAN4_PsDoorSW, Init_CAN4_PwrSta, Init_CAN4_RBSD, Init_CAN4_RC_VCU1_CAN4, Init_CAN4_RDRL, Init_CAN4_RLDoorSW, Init_CAN4_RRDoorSW, Init_CAN4_RTurnLP, Init_CAN4_ReBrakeLPReq, Init_CAN4_ReverseLamp, Init_CAN4_RoomLampH, Init_CAN4_RoomLampL, Init_CAN4_Rr_ChargingDoorCtrl, Init_CAN4_Rr_Defog, Init_CAN4_Rr_FogLamp, Init_CAN4_Rr_Wiper, Init_CAN4_ShiftGearPosn, Init_CAN4_TailgateHDSW, Init_CAN4_TailgateRemote, Init_CAN4_Tailgate_SW, Init_CAN4_TimeSNDKCFbk, Init_CAN4_TrunkRel, Init_CAN4_WasherCtrl, Init_CAN4_WiperFixMode]
    Init_CAN4_SG_FD4_CE100_1: value-spec=fields=[Init_CAN4_ACSubMode, Init_CAN4_APTC_ActFrRiPwr, Init_CAN4_BatLoopActWtFlw, Init_CAN4_BatteryMode, Init_CAN4_CCU_ACLampSts, Init_CAN4_CCU_ACMaxLampSts, Init_CAN4_CCU_AutoLampSts, Init_CAN4_CCU_AutoMidLampSts, Init_CAN4_CCU_CbnPreACWkSts, Init_CAN4_CCU_CbnPreEstimdTi, Init_CAN4_CCU_CbnPreSts, Init_CAN4_CCU_Dispaly_Request, Init_CAN4_CCU_EcoSts, Init_CAN4_CCU_FrtOnOffLampSts, Init_CAN4_CCU_HEATMaxLampSts, Init_CAN4_CCU_HiVoltageReq, Init_CAN4_CCU_RrOnOffLampSts, Init_CAN4_CCU_SyncLampSts, Init_CAN4_CabinMode, Init_CAN4_CoolgFanActDuty, Init_CAN4_DeiceModReq, Init_CAN4_EDriveMode, Init_CAN4_FDC_THCM_CLEVentY_Sta, Init_CAN4_FDC_THCM_CLEVentZ_Sta, Init_CAN4_FDC_THCM_CLVent_Sta, Init_CAN4_FDC_THCM_CREVentY_Sta, Init_CAN4_FDC_THCM_CREVentZ_Sta, Init_CAN4_FDC_THCM_CRVent_Sta, Init_CAN4_FDC_THCM_DrEVentMode_Sta, Init_CAN4_FDC_THCM_DrEVentY_Sta, Init_CAN4_FDC_THCM_DrEVentZ_Sta, Init_CAN4_FDC_THCM_DrVent_Sta, Init_CAN4_FDC_THCM_PsEVentMode_Sta, Init_CAN4_FDC_THCM_PsEVentY_Sta, Init_CAN4_FDC_THCM_PsEVentZ_Sta, Init_CAN4_FDC_THCM_PsVent_Sta, Init_CAN4_FD_Blower_Cmd, Init_CAN4_FD_Comp_Cmd, Init_CAN4_FD_EWP1_Cmd, Init_CAN4_FD_EWP2_Cmd, Init_CAN4_FD_EWP3_Cmd, Init_CAN4_FD_EXV1_Cmd, Init_CAN4_FD_EXV2_Cmd, Init_CAN4_FD_FWV_Cmd, Init_CAN4_FD_FrLeAPTCHeatPwr_Cmd, Init_CAN4_FD_FrRiAPTCHeatPwr_Cmd, Init_CAN4_FD_FrWPTCHeatPwr_Cmd, Init_CAN4_FD_RecyAuto_Cmd, Init_CAN4_FD_RrAPTCHeatPwr_Cmd, Init_CAN4_FD_SOTXV_Cmd, Init_CAN4_FD_SOV1_Cmd, Init_CAN4_FD_SOV2_Cmd, Init_CAN4_FD_SOV3_Cmd, Init_CAN4_FD_TWV_Cmd, Init_CAN4_Fr_Coolantflow, Init_CAN4_Fr_Coolanttemp, Init_CAN4_HPThermalRecoveryReq, Init_CAN4_Rr_Coolantflow, Init_CAN4_Rr_Coolanttemp, Init_CAN4_sigAirIntenZon1St, Init_CAN4_sigAirIntenZon3St, Init_CAN4_sigAmbAirT, Init_CAN4_sigCbnAirT, Init_CAN4_sigCbnPTCPwrAct, Init_CAN4_sigCbnSolarLeft, Init_CAN4_sigCbnSolarRight, Init_CAN4_sigClmtCmprPwrAct, Init_CAN4_sigClntTHvBattOut, Init_CAN4_sigDfrstSt, Init_CAN4_sigHvacSt, Init_CAN4_sigRecircSt, Init_CAN4_sigSetTempZon1St, Init_CAN4_sigSetTempZon2St, Init_CAN4_sigSetTempZon3St, Init_CAN4_sigWindDirZon1St, Init_CAN4_sigWindDirZon3St]
    Init_CAN4_SG_FD4_CE100_2: value-spec=fields=[Init_CAN4_FD4_CE100_2_CS, Init_CAN4_FD4_CE100_2_RC, Init_CAN4_FDC_VCU_ReqHWReset_Cmd]
    Init_CAN4_SG_FD4_CE100_3: value-spec=fields=[Init_CAN4_FDC_BCM_BBuzzer_Cmd, Init_CAN4_FDC_BCM_BBuzzerout_Cmd, Init_CAN4_FDC_BCM_EmExitLight_Cmd, Init_CAN4_FDC_BCM_FrAtmoLamp_Cmd, Init_CAN4_FDC_BCM_FrRmLampBright_Cmd, Init_CAN4_FDC_BCM_FrRoomlamp_Cmd, Init_CAN4_FDC_BCM_IBuzzerReq_Sta, Init_CAN4_FDC_BCM_LSMLP_Cmd, Init_CAN4_FDC_BCM_LTgateRel_Cmd, Init_CAN4_FDC_BCM_RSMLP_Cmd, Init_CAN4_FDC_BCM_RTgateRel_Cmd, Init_CAN4_FDC_BCM_RevBuzzerout_Cmd, Init_CAN4_FDC_BCM_RrAtmoLamp_Cmd, Init_CAN4_FDC_BCM_RrRmLampBright_Cmd, Init_CAN4_FDC_BCM_RrRoomlamp_Cmd, Init_CAN4_FDC_BCM_STurnLpLeft_Cmd, Init_CAN4_FDC_BCM_STurnLpRight_Cmd, Init_CAN4_FDC_BCM_TgateHDSWL_Sta, Init_CAN4_FDC_BCM_TgateHDSWR_Sta, Init_CAN4_FDC_BCM_TgateSWL_Sta, Init_CAN4_FDC_BCM_TgateSWR_Sta, Init_CAN4_FDC_BCM_TurnLpLActive_Cmd, Init_CAN4_FDC_BCM_TurnLpRActive_Cmd, Init_CAN4_FDC_BCM_innerBuzzer_Cmd]
    Init_CAN4_SG_FD4_CE200_0: value-spec=fields=[Init_CAN4_AmbLightBreath1, Init_CAN4_AmbLightBreath2, Init_CAN4_AmbLightBreath3, Init_CAN4_AmbLightBreath4, Init_CAN4_AmbLightBreath5, Init_CAN4_AmbLightBreath6, Init_CAN4_AmbLightBrightness1, Init_CAN4_AmbLightBrightness2, Init_CAN4_AmbLightBrightness3, Init_CAN4_AmbLightBrightness4, Init_CAN4_AmbLightBrightness5, Init_CAN4_AmbLightBrightness6, Init_CAN4_AmbLightColor1, Init_CAN4_AmbLightColor2, Init_CAN4_AmbLightColor3, Init_CAN4_AmbLightColor4, Init_CAN4_AmbLightColor5, Init_CAN4_AmbLightColor6, Init_CAN4_BCM_Buzzer_Req, Init_CAN4_FDC_BCM_ATCtrl_Cmd, Init_CAN4_FDC_BCM_DimSw, Init_CAN4_FDC_BCM_FWasSw_Sta, Init_CAN4_FDC_BCM_FWipSw_Sta, Init_CAN4_FDC_BCM_HazardIND_Cmd, Init_CAN4_FDC_BCM_LockAlarm_Cmd, Init_CAN4_FDC_BCM_OutMode_Cmd, Init_CAN4_FDC_BCM_PTGOpenHeight_Sta, Init_CAN4_FDC_BCM_PassSW_Sta, Init_CAN4_FDC_BCM_TurnSwTSetSta_Sta, Init_CAN4_FDC_BCM_TurnSw_Sta, Init_CAN4_FDC_BCM_UserHeightSet_Sta, Init_CAN4_FDC_BCM_UserNow_Sta, Init_CAN4_FDC_DKC_CommandToBCM_Cmd, Init_CAN4_FDC_DKC_DKeyAreaPE_Sta, Init_CAN4_FDC_DKC_SPTGDet_Cmd, Init_CAN4_FDC_DKC_SPTGOpen_Cmd, Init_CAN4_FDC_EChrg_SW_Sta, Init_CAN4_FDC_THCM_ACTInitial_Cmd, Init_CAN4_FDC_THCM_AirIntZ3_Sta, Init_CAN4_FDHandleCmd, Init_CAN4_FDLHandleLampCmd, Init_CAN4_FDRHandleLampCmd, Init_CAN4_WelcomeLight]
    Init_CAN4_SG_FD4_OTA1: value-spec=fields=[Init_CAN4_OTA_DL_Available, Init_CAN4_OTA_DL_Speed, Init_CAN4_OTA_Debug_Code, Init_CAN4_OTA_Emergency_Sta, Init_CAN4_OTA_InVehicle_FW, Init_CAN4_OTA_Lock_Req, Init_CAN4_OTA_MDA_Status, Init_CAN4_OTA_Mode, Init_CAN4_OTA_Network_Type, Init_CAN4_OTA_Permit_Agreed, Init_CAN4_OTA_Progress_Rate, Init_CAN4_OTA_Remained_Time, Init_CAN4_OTA_TBOXResetReq, Init_CAN4_OTA_Update_Available, Init_CAN4_OTA_Updating_ECU_8bit]
    Init_CAN4_SG_GW4_CE100_0: value-spec=fields=[Init_CAN4_BrkPedalPos, Init_CAN4_BrkPedalPos_Sta, Init_CAN4_BrkSw_Sta, Init_CAN4_BrkSw_V, Init_CAN4_FDC_PTG_inner_SW_2, Init_CAN4_L_Drv_CtrlCmd, Init_CAN4_L_Pas_CtrlCmd, Init_CAN4_L_RLD_CtrlCmd, Init_CAN4_L_RRD_CtrlCmd, Init_CAN4_MCPressure, Init_CAN4_MCPressure_V, Init_CAN4_VehSpeed]
    Init_CAN4_SG_CGW_GW4_CE100_0: value-spec=fields=[Init_CAN4_AVM_parking_excute, Init_CAN4_Approach_Unlock_SW, Init_CAN4_ChrgInLockReq, Init_CAN4_ChrgPlugSta, Init_CAN4_DSEAT_anti_set, Init_CAN4_DSEAT_entryfun_set, Init_CAN4_DSEAT_vent_req, Init_CAN4_Distance_unit, Init_CAN4_ExtChrgSta, Init_CAN4_HeadLampSW, Init_CAN4_Hood_Latch_SW, Init_CAN4_IVI_ChargePortSW_Sta, Init_CAN4_IVI_DSEATHeater_Cmd, Init_CAN4_IVI_ISA_OffsetSpd, Init_CAN4_IVI_Located_STA, Init_CAN4_IVI_PSEATHeater_Cmd, Init_CAN4_IVI_PTG_Mode_SW, Init_CAN4_IVI_PTG_Open_Height, Init_CAN4_IVI_PTG_Sta_SW, Init_CAN4_IVI_Time_Check, Init_CAN4_IVI_Time_Day, Init_CAN4_IVI_Time_Hour, Init_CAN4_IVI_Time_Minute, Init_CAN4_IVI_Time_Month, Init_CAN4_IVI_Time_Second, Init_CAN4_IVI_Time_Year, Init_CAN4_IVI_TrailerCheckReq_Sta, Init_CAN4_IVI_TrailerModeSW_Sta, Init_CAN4_Light_ShowStart_Req, Init_CAN4_Light_ShowStop_Req, Init_CAN4_METER_KPH_Calcu, Init_CAN4_OBCV2LSta, Init_CAN4_OFF_AC_MODE, Init_CAN4_PSEAT_vent_req, Init_CAN4_SenstivityPosition, Init_CAN4_TBOX_Remote_PW, Init_CAN4_V2LSta, Init_CAN4_Walkaway_Lock_SW, Init_CAN4_WlcmLight_Mode]
    Init_CAN4_SG_GW4_CE200_0: value-spec=fields=[Init_CAN4_IVI_LSEATvent_Cmd, Init_CAN4_IVI_MLFMost_Cmd, Init_CAN4_IVI_MLFootLift_Cmd, Init_CAN4_IVI_MLNapMode_Cmd, Init_CAN4_IVI_MLRecliner_Cmd, Init_CAN4_IVI_MLRestore_Cmd, Init_CAN4_IVI_MLSEATvent_Cmd, Init_CAN4_IVI_MLSeatLift_Cmd, Init_CAN4_IVI_MLSldRestore_Cmd, Init_CAN4_IVI_MLSlider_Cmd, Init_CAN4_IVI_MLZeroGravity_Cmd, Init_CAN4_IVI_MRFMost_Cmd, Init_CAN4_IVI_MRFootLift_Cmd, Init_CAN4_IVI_MRNapMode_Cmd, Init_CAN4_IVI_MRRecliner_Cmd, Init_CAN4_IVI_MRRestore_Cmd, Init_CAN4_IVI_MRSEATvent_Cmd, Init_CAN4_IVI_MRSeatLift_Cmd, Init_CAN4_IVI_MRSldRestore_Cmd, Init_CAN4_IVI_MRSlider_Cmd, Init_CAN4_IVI_MRZeroGravity_Cmd, Init_CAN4_IVI_RSEATvent_Cmd]
    Init_CAN4_SG_Z24_C1000_0: value-spec=fields=[Init_CAN4_Z24_CHA_AirPressureFC2_Sta, Init_CAN4_Z24_CHA_AirPressurePC3_Sta, Init_CAN4_Z24_CHA_AirPressureRC1_Sta]
    Init_CAN4_SG_Z24_CE100_0: value-spec=fields=[Init_CAN4_Z24_BCM_EmExitOP_Sta, Init_CAN4_Z24_BCM_FLTurnLampC_Sta, Init_CAN4_Z24_BCM_FRTurnLampC_Sta, Init_CAN4_Z24_BCM_FWiperAS_Sta, Init_CAN4_Z24_BCM_FWiperProtection_Sta, Init_CAN4_Z24_BCM_RLTurnLampC_Sta, Init_CAN4_Z24_BCM_RRTurnLampC_Sta, Init_CAN4_Z24_BCM_SeatBeltSW_Sta, Init_CAN4_Z24_BCM_innerBuzzer_Sta]
    Init_CAN4_SG_ZONE_DR1: value-spec=fields=[Init_CAN4_ACT1_Actuator_address, Init_CAN4_ACT1_Actuator_set_position, Init_CAN4_ACT1_Actuator_start_position, Init_CAN4_ACT1_Applied_holding_current, Init_CAN4_ACT1_Clear_Event_Flags, Init_CAN4_ACT1_Emergency_run_position, Init_CAN4_ACT1_Emergency_run_release, Init_CAN4_ACT1_Rotation_direction, Init_CAN4_ACT1_Save_programming_data, Init_CAN4_ACT1_Select_position_specification, Init_CAN4_ACT1_Speed_specification, Init_CAN4_ACT1_Stall_detection_release, Init_CAN4_ACT1_Stop_mode, Init_CAN4_ACT2_Actuator_address, Init_CAN4_ACT2_Actuator_set_position, Init_CAN4_ACT2_Actuator_start_position, Init_CAN4_ACT2_Applied_holding_current, Init_CAN4_ACT2_Clear_Event_Flags, Init_CAN4_ACT2_Emergency_run_position, Init_CAN4_ACT2_Emergency_run_release, Init_CAN4_ACT2_Rotation_direction, Init_CAN4_ACT2_Save_programming_data, Init_CAN4_ACT2_Select_position_specification, Init_CAN4_ACT2_Speed_specification, Init_CAN4_ACT2_Stall_detection_release, Init_CAN4_ACT2_Stop_mode, Init_CAN4_ACT3_Actuator_address, Init_CAN4_ACT3_Actuator_set_position, Init_CAN4_ACT3_Actuator_start_position, Init_CAN4_ACT3_Applied_holding_current, Init_CAN4_ACT3_Clear_Event_Flags, Init_CAN4_ACT3_Emergency_run_position, Init_CAN4_ACT3_Emergency_run_release, Init_CAN4_ACT3_Rotation_direction, Init_CAN4_ACT3_Save_programming_data, Init_CAN4_ACT3_Select_position_specification, Init_CAN4_ACT3_Speed_specification, Init_CAN4_ACT3_Stall_detection_release, Init_CAN4_ACT3_Stop_mode, Init_CAN4_ACT4_Actuator_address, Init_CAN4_ACT4_Actuator_set_position, Init_CAN4_ACT4_Actuator_start_position, Init_CAN4_ACT4_Applied_holding_current, Init_CAN4_ACT4_Clear_Event_Flags, Init_CAN4_ACT4_Emergency_run_position, Init_CAN4_ACT4_Emergency_run_release, Init_CAN4_ACT4_Rotation_direction, Init_CAN4_ACT4_Save_programming_data, Init_CAN4_ACT4_Select_position_specification, Init_CAN4_ACT4_Speed_specification, Init_CAN4_ACT4_Stall_detection_release, Init_CAN4_ACT4_Stop_mode, Init_CAN4_ACT5_Actuator_address, Init_CAN4_ACT5_Actuator_set_position, Init_CAN4_ACT5_Actuator_start_position, Init_CAN4_ACT5_Applied_holding_current, Init_CAN4_ACT5_Clear_Event_Flags, Init_CAN4_ACT5_Emergency_run_position, Init_CAN4_ACT5_Emergency_run_release, Init_CAN4_ACT5_Rotation_direction, Init_CAN4_ACT5_Save_programming_data, Init_CAN4_ACT5_Select_position_specification, Init_CAN4_ACT5_Speed_specification, Init_CAN4_ACT5_Stall_detection_release, Init_CAN4_ACT5_Stop_mode, Init_CAN4_AllLockSta, Init_CAN4_AutoLightSW, Init_CAN4_BrakeLampFail, Init_CAN4_DrLockSta, Init_CAN4_HornSW, Init_CAN4_MIRROR_FOLD_SW, Init_CAN4_PsLockSta, Init_CAN4_RLLockSta, Init_CAN4_RLS_Exist, Init_CAN4_RLTurnLPErr, Init_CAN4_RLTurnLampC, Init_CAN4_RRLockSta, Init_CAN4_RRTurnLPErr, Init_CAN4_RRTurnLampC, Init_CAN4_RWiperAS, Init_CAN4_RWiperProtection, Init_CAN4_Wip_Speed, Init_CAN4_WiperSWPos, Init_CAN4_WiperZeroPosSW, Init_CAN4_ZDR_THCM_IntakeFail_Sta, Init_CAN4_ZDR_THCM_LINACT1_Sta, Init_CAN4_ZDR_THCM_LINACT2_Sta, Init_CAN4_ZDR_THCM_LINACT3_Sta, Init_CAN4_ZDR_THCM_LINACT4_Sta, Init_CAN4_ZDR_THCM_LINACT5_Sta, Init_CAN4_ZDR_THCM_ModeFail_Sta]
    Init_CAN4_SG_ZONE_DR_VCU: value-spec=fields=[Init_CAN4_APTC_Err, Init_CAN4_Blower_Err, Init_CAN4_Blower_FB, Init_CAN4_DrADASCurr, Init_CAN4_DrAPWLINErr, Init_CAN4_DrAPWStaErr, Init_CAN4_DrAuBoxPwrN1Curr, Init_CAN4_DrAuBoxPwrN2Curr, Init_CAN4_DrColumnSWFault, Init_CAN4_DrCtrlBDVolt, Init_CAN4_DrCtrlTemp, Init_CAN4_DrEOBDFault, Init_CAN4_DrIVIFault, Init_CAN4_DrInfoErrSta, Init_CAN4_DrInfoFault, Init_CAN4_DrONA1ErrSta, Init_CAN4_DrPMMLVOutPErrLmp, Init_CAN4_DrPMMLimpHomeActReq, Init_CAN4_DrPMMSysErrLmp, Init_CAN4_DrPowerTemp1, Init_CAN4_DrPowerTemp2, Init_CAN4_DrPwrInformationSta, Init_CAN4_DrPwrONA1Curr, Init_CAN4_DrPwrONA2Curr, Init_CAN4_DrPwrSta, Init_CAN4_DrPwrStdbyACurr, Init_CAN4_DrPwrWinErrSta, Init_CAN4_DrPwrWindowECUFault, Init_CAN4_DrSCPSysErrLmp, Init_CAN4_DrStdAErrSta, Init_CAN4_DrTHCMFault, Init_CAN4_RegenSW_Err, Init_CAN4_SolarL, Init_CAN4_SolarL_Err, Init_CAN4_SolarR, Init_CAN4_SolarR_Err, Init_CAN4_T_Face_L, Init_CAN4_T_Face_L_Err, Init_CAN4_T_Face_R, Init_CAN4_T_Face_R_Err, Init_CAN4_T_Face_Rr, Init_CAN4_T_Face_Rr_Err, Init_CAN4_T_Foot_L, Init_CAN4_T_Foot_L_Err, Init_CAN4_T_Foot_R, Init_CAN4_T_Foot_R_Err, Init_CAN4_T_Foot_Rr, Init_CAN4_T_Foot_Rr_Err, Init_CAN4_Tevap, Init_CAN4_Tevap_Err, Init_CAN4_Tincar, Init_CAN4_Tincar_Err, Init_CAN4_ZDR_SYS_APMRetryCnt_Sta, Init_CAN4_ZDR_SYS_BSWSleepReq_Sta, Init_CAN4_ZDR_SYS_CSWRetryCnt_Sta, Init_CAN4_ZDR_VCU_HWReset_Sta, Init_CAN4_ZDR_VCU_PwrSupply_Sta, Init_CAN4_ZoneDrMalfunLevel]
    Init_CAN4_SG_ZONE_FR1: value-spec=fields=[Init_CAN4_BDC_1_MoveEnable, Init_CAN4_BDC_1_ReqMovePos, Init_CAN4_BMSChksmHSC6, Init_CAN4_BMSEnbPTCHSC6, Init_CAN4_BMSInptClntTemHSC6, Init_CAN4_BMSPackVol_h6HSC6, Init_CAN4_BMSReqMdHSC6, Init_CAN4_BMSReqPWMHSC6, Init_CAN4_BMSReqPwrHSC6, Init_CAN4_BMSReqRlngCtrHSC6, Init_CAN4_BMSReqTapPosHSC6, Init_CAN4_CCM_SpdCmd, Init_CAN4_CCV4_MoveEnable, Init_CAN4_CCV4_ReqMovePos, Init_CAN4_ChargeInletLockSta, Init_CAN4_CompProEN, Init_CAN4_EWP1_Default_Operation_EWP_Rq, Init_CAN4_EWP1_RPM_Target_EWP_Rq, Init_CAN4_EWP2_Default_Operation_EWP_Rq, Init_CAN4_EWP2_RPM_Target_EWP_Rq, Init_CAN4_EWP3_Default_Operation_EWP_Rq, Init_CAN4_EWP3_RPM_Target_EWP_Rq, Init_CAN4_EXV2_Cmd_Init_Rq, Init_CAN4_EXV2_Cmd_Move_Enbl, Init_CAN4_EXV2_Cmd_Set_Rq, Init_CAN4_EXV_Cmd_Init_Rq, Init_CAN4_EXV_Cmd_Move_Enbl, Init_CAN4_EXV_Cmd_Set_Rq, Init_CAN4_FLPosLPErr, Init_CAN4_FLTurnLPErr, Init_CAN4_FLTurnLampC, Init_CAN4_FLTurn_Light_Warning, Init_CAN4_FRPosLPErr, Init_CAN4_FRTurnLPErr, Init_CAN4_FRTurnLampC, Init_CAN4_FRTurn_Light_Warning, Init_CAN4_FWiperAS, Init_CAN4_FWiperProtection, Init_CAN4_LADBErr, Init_CAN4_LADB_Hibeam_Indication, Init_CAN4_LADB_Operation_Status, Init_CAN4_LADB_Warning, Init_CAN4_LAHB_Warning, Init_CAN4_LDRLErr, Init_CAN4_LDRL_Warning, Init_CAN4_LH_BeamErr, Init_CAN4_LLB_Warning, Init_CAN4_LL_BeamErr, Init_CAN4_Lposition_Lamp_Warning, Init_CAN4_RADBErr, Init_CAN4_RADB_Hibeam_Indication, Init_CAN4_RADB_Operation_Status, Init_CAN4_RADB_Warning, Init_CAN4_RAHB_Warning, Init_CAN4_RDRLErr, Init_CAN4_RDRL_Warning, Init_CAN4_RH_BeamErr, Init_CAN4_RLB_Warning, Init_CAN4_RL_BeamErr, Init_CAN4_Rposition_Lamp_Warning, Init_CAN4_TrailerCheck, Init_CAN4_TrailerModeSta, Init_CAN4_ZFR_BCM_ChargerDoorSW_Sta, Init_CAN4_ZFR_EChrg_Active_Sta, Init_CAN4_ZFR_EChrg_Sys_Sta, Init_CAN4_ZFR_THCM_CLEVentActY_Sta, Init_CAN4_ZFR_THCM_CLEVentActZ_Sta, Init_CAN4_ZFR_THCM_CREVentActY_Sta, Init_CAN4_ZFR_THCM_CREVentActZ_Sta, Init_CAN4_ZFR_THCM_DrEVentActY_Sta, Init_CAN4_ZFR_THCM_DrEVentActZ_Sta, Init_CAN4_ZFR_THCM_PsEVentActY_Sta, Init_CAN4_ZFR_THCM_PsEVentActZ_Sta]
    Init_CAN4_SG_ZONE_FR_VCU: value-spec=fields=[Init_CAN4_Bat_In_Temp, Init_CAN4_Bat_In_Temp_Err, Init_CAN4_Bat_Out_Temp, Init_CAN4_Bat_Out_Temp_Err, Init_CAN4_COMP_Err, Init_CAN4_EACProtectEnable, Init_CAN4_EWP1_Err, Init_CAN4_EWP2_Err, Init_CAN4_EWP3_Err, Init_CAN4_EXV1_Err, Init_CAN4_EXV2_Err, Init_CAN4_FWV_Err, Init_CAN4_Fan_Err, Init_CAN4_FrBMSCCUCErr, Init_CAN4_FrBMS_CCU_CIRCurr, Init_CAN4_FrBMS_CCU_CIRFault, Init_CAN4_FrCtrlBDVolt, Init_CAN4_FrCtrlTemp, Init_CAN4_FrEDUErr, Init_CAN4_FrEDU_INVERTERCurr, Init_CAN4_FrEDU_INVERTERFault, Init_CAN4_FrIRC_1Curr, Init_CAN4_FrIRC_2Curr, Init_CAN4_FrPMMLVOutPErrLmp, Init_CAN4_FrPMMLimpHomeActReq, Init_CAN4_FrPMMSysErrLmp, Init_CAN4_FrPowerTemp1, Init_CAN4_FrPowerTemp2, Init_CAN4_FrPwrONA1Fault, Init_CAN4_FrPwrONA2Curr, Init_CAN4_FrPwrONA3Curr, Init_CAN4_FrPwrSta, Init_CAN4_FrPwrStdbyA1Fault, Init_CAN4_FrPwrStdbyA1PlusCurr, Init_CAN4_FrPwrStdbyA1PlusFault, Init_CAN4_FrPwrStdbyA2Curr, Init_CAN4_FrPwrStdbyA2PlusCurr, Init_CAN4_FrPwrStdbyA2PlusFault, Init_CAN4_FrStdA1PCErr, Init_CAN4_FrStdA2PCErr, Init_CAN4_FrStdA2PErr, Init_CAN4_Motor_In_Temp, Init_CAN4_Motor_In_Temp_Err, Init_CAN4_Motor_Out_Temp, Init_CAN4_Motor_Out_Temp_Err, Init_CAN4_PT_High_P, Init_CAN4_PT_High_P_Err, Init_CAN4_PT_High_T, Init_CAN4_PT_High_Tact, Init_CAN4_PT_High_Tact_Err, Init_CAN4_PT_Low_P1, Init_CAN4_PT_Low_P1_Err, Init_CAN4_PT_Low_P2, Init_CAN4_PT_Low_P2_Err, Init_CAN4_PT_Low_T1, Init_CAN4_PT_Low_T1_Err, Init_CAN4_PT_Low_T2, Init_CAN4_PT_Low_T2_Err, Init_CAN4_SOTXV_Err, Init_CAN4_SOV1_Err, Init_CAN4_SOV2_Err, Init_CAN4_SOV3_Err, Init_CAN4_TWV_Err, Init_CAN4_Tamb, Init_CAN4_Tamb_Err, Init_CAN4_WPTC_Err, Init_CAN4_ZFR_SYS_BMSCCURetryCnt_Sta, Init_CAN4_ZFR_SYS_BSWSleepReq_Sta, Init_CAN4_ZFR_SYS_MCURetryCnt_Sta, Init_CAN4_ZFR_VCU_HWReset_Sta, Init_CAN4_ZFR_VCU_PwrSupply_Sta, Init_CAN4_ZoneFrMalfunLevel]
    Init_CAN4_SG_zGW_APTC1: value-spec=fields=[Init_CAN4_FrntPTCBusLineHiV, Init_CAN4_FrntPTCComFlt, Init_CAN4_FrntPTCFltSt, Init_CAN4_FrntPTCHVOverUFlt, Init_CAN4_FrntPTCHVUnderUFlt, Init_CAN4_FrntPTCHWVers, Init_CAN4_FrntPTCLVOverUFlt, Init_CAN4_FrntPTCLVUnderUFlt, Init_CAN4_FrntPTCLeActHeatPwr, Init_CAN4_FrntPTCLeBusLineC, Init_CAN4_FrntPTCLeCoreOverTFlt, Init_CAN4_FrntPTCLeCoreT, Init_CAN4_FrntPTCLeCoreTSnsrFlt, Init_CAN4_FrntPTCLeIGBTOverTFlt, Init_CAN4_FrntPTCLeIGBTShoCircFlt, Init_CAN4_FrntPTCLeIGBTT, Init_CAN4_FrntPTCLeIGBTTSnsrFlt, Init_CAN4_FrntPTCLeOpentCircFlt, Init_CAN4_FrntPTCLeOverAFlt, Init_CAN4_FrntPTCPCBOverTFlt, Init_CAN4_FrntPTCPCBT, Init_CAN4_FrntPTCPCBTSnsrFlt, Init_CAN4_FrntPTCRearLeActHeatPwr, Init_CAN4_FrntPTCRearLeBusLineC, Init_CAN4_FrntPTCRearLeCoreOverTFlt, Init_CAN4_FrntPTCRearLeCoreT, Init_CAN4_FrntPTCRearLeCoreTSnsrFlt, Init_CAN4_FrntPTCRearLeIGBTShoCFlt, Init_CAN4_FrntPTCRearLeOpentCircFlt, Init_CAN4_FrntPTCRearLeOverAFlt, Init_CAN4_FrntPTCRearRiActHeatPwr, Init_CAN4_FrntPTCRearRiBusLineC, Init_CAN4_FrntPTCRearRiCoreOverTFlt, Init_CAN4_FrntPTCRearRiCoreT, Init_CAN4_FrntPTCRearRiCoreTSnsrFlt, Init_CAN4_FrntPTCRearRiIGBTShoCFlt, Init_CAN4_FrntPTCRearRiOpentCircFlt, Init_CAN4_FrntPTCRearRiOverAFlt, Init_CAN4_FrntPTCRiActHeatPwr, Init_CAN4_FrntPTCRiBusLineC, Init_CAN4_FrntPTCRiCoreOverTFlt, Init_CAN4_FrntPTCRiCoreT, Init_CAN4_FrntPTCRiCoreTSnsrFlt, Init_CAN4_FrntPTCRiIGBTOverTFlt, Init_CAN4_FrntPTCRiIGBTShoCircFlt, Init_CAN4_FrntPTCRiIGBTT, Init_CAN4_FrntPTCRiIGBTTSnsrFlt, Init_CAN4_FrntPTCRiOpentCircFlt, Init_CAN4_FrntPTCRiOverAFlt, Init_CAN4_FrntPTCSWVers, Init_CAN4_FrntPTCSts, Init_CAN4_FrntPTCSupplierCod]
    Init_CAN4_SG_zGW_CANFr1: value-spec=fields=[Init_CAN4_COMP_ActualPwr, Init_CAN4_COMP_ComLost, Init_CAN4_COMP_ConCur, Init_CAN4_COMP_ConVolt, Init_CAN4_COMP_CtrlCircFlt, Init_CAN4_COMP_CurOverProtect, Init_CAN4_COMP_CurVaild, Init_CAN4_COMP_IPM_HWFLt, Init_CAN4_COMP_IPM_TempOverFlt, Init_CAN4_COMP_Init, Init_CAN4_COMP_SpdVaild, Init_CAN4_COMP_Sta, Init_CAN4_COMP_StatorSpd, Init_CAN4_COMP_VoltLessErr, Init_CAN4_COMP_VoltOverErr, Init_CAN4_COMP_VoltVaild, Init_CAN4_EAC_DrvVoltFalt, Init_CAN4_EAC_MotCrt, Init_CAN4_EAC_MotorLackFalt, Init_CAN4_EAC_OvLoadFalt, Init_CAN4_EAC_Temp, Init_CAN4_EAC_TempSnsrFalt, Init_CAN4_PTC1_PowerConsumption, Init_CAN4_PTCActuCrntHSC6, Init_CAN4_PTCActuPWMDutyHSC6, Init_CAN4_PTCActuPwrHSC6, Init_CAN4_PTCActuVolHSC6, Init_CAN4_PTCChksmHSC6, Init_CAN4_PTCFltLvlHSC6, Init_CAN4_PTCHVLckStsHSC6, Init_CAN4_PTCIGBTOverHeatHSC6, Init_CAN4_PTCIGBTStsHSC6, Init_CAN4_PTCIGBTTemHSC6, Init_CAN4_PTCNTCStsHSC6, Init_CAN4_PTCOtptTemHSC6, Init_CAN4_PTCOverCrntHSC6, Init_CAN4_PTCOverHeatHSC6, Init_CAN4_PTCOverVolHSC6, Init_CAN4_PTCPCBTemHSC6, Init_CAN4_PTCRlngCtrHSC6, Init_CAN4_PTCSecChksmHSC6, Init_CAN4_PTCSecRlngCtrHSC6, Init_CAN4_PTCStsHSC6, Init_CAN4_PTCUnderVolHSC6]
    Init_CAN4_SG_zGW_LINDr1: value-spec=fields=[Init_CAN4_CSW_DimSw, Init_CAN4_CSW_FWasSw_Sta, Init_CAN4_CSW_FWipSw_Sta, Init_CAN4_CSW_HW_version, Init_CAN4_CSW_PassSW_Sta, Init_CAN4_CSW_RWasSW_Sta, Init_CAN4_CSW_RWipIntSw_Sta, Init_CAN4_CSW_SW_version, Init_CAN4_CSW_TurnSw_Sta, Init_CAN4_CSW_resp_error, Init_CAN4_FAPWL_01_LIN_Response_Error, Init_CAN4_L_Drv_Motor_Relay_Error, Init_CAN4_L_Drv_Motor_Ripple_Error, Init_CAN4_L_Drv_OverHeat_Protect, Init_CAN4_L_Drv_Val_Wdw_Opened, Init_CAN4_L_Drv_Wdw_Init, Init_CAN4_L_Drv_Wdw_LocalSwitch, Init_CAN4_L_Drv_Wdw_OD_Sts, Init_CAN4_L_Drv_Wdw_Obs_InhibitSts, Init_CAN4_L_Drv_Wdw_Pas_Switch, Init_CAN4_L_Drv_Wdw_PositionSts, Init_CAN4_L_Drv_Wdw_RLD_Switch, Init_CAN4_L_Drv_Wdw_RRD_Switch, Init_CAN4_L_Drv_Wdw_Running_Sts, Init_CAN4_L_Pas_Motor_Relay_Error, Init_CAN4_L_Pas_Motor_Ripple_Error, Init_CAN4_L_Pas_OverHeat_Protect, Init_CAN4_L_Pas_Val_Wdw_Opened, Init_CAN4_L_Pas_Wdw_Init, Init_CAN4_L_Pas_Wdw_LocalSwitch, Init_CAN4_L_Pas_Wdw_OD_Sts, Init_CAN4_L_Pas_Wdw_Obs_InhibitSts, Init_CAN4_L_Pas_Wdw_PositionSts, Init_CAN4_L_Pas_Wdw_Running_Sts, Init_CAN4_L_Power_Status, Init_CAN4_L_RLD_Motor_Relay_Error, Init_CAN4_L_RLD_Motor_Ripple_Error, Init_CAN4_L_RLD_OverHeat_Protect, Init_CAN4_L_RLD_Val_Wdw_Opened, Init_CAN4_L_RLD_Wdw_Init, Init_CAN4_L_RLD_Wdw_LocalSwitch, Init_CAN4_L_RLD_Wdw_OD_Sts, Init_CAN4_L_RLD_Wdw_Obs_InhibitSts, Init_CAN4_L_RLD_Wdw_PositionSts, Init_CAN4_L_RLD_Wdw_Running_Sts, Init_CAN4_L_RRD_Motor_Relay_Error, Init_CAN4_L_RRD_Motor_Ripple_Error, Init_CAN4_L_RRD_OverHeat_Protect, Init_CAN4_L_RRD_Val_Wdw_Opened, Init_CAN4_L_RRD_Wdw_Init, Init_CAN4_L_RRD_Wdw_LocalSwitch, Init_CAN4_L_RRD_Wdw_OD_Sts, Init_CAN4_L_RRD_Wdw_Obs_InhibitSts, Init_CAN4_L_RRD_Wdw_PositionSts, Init_CAN4_L_RRD_Wdw_Running_Sts, Init_CAN4_RAPWL_01_LIN_Response_Error, Init_CAN4_RLS_LIN_Resp_Err, Init_CAN4_RLS_Lamp_Sta, Init_CAN4_RLS_LightSnrErr, Init_CAN4_RLS_RainSnrErr, Init_CAN4_RLS_RainSnrWiperCmd, Init_CAN4_SWC2_HW_Version, Init_CAN4_SWC2_L_ADAS_Sta, Init_CAN4_SWC2_L_DriveMode_Sta, Init_CAN4_SWC2_L_Home_Sta, Init_CAN4_SWC2_L_Left_Sta, Init_CAN4_SWC2_L_RegenUp_Sta, Init_CAN4_SWC2_L_Right_Sta, Init_CAN4_SWC2_L_ScrollDown_Sta, Init_CAN4_SWC2_L_ScrollPress_Sta, Init_CAN4_SWC2_L_ScrollUp_Sta, Init_CAN4_SWC2_R_Customize_Sta, Init_CAN4_SWC2_R_Left_Sta, Init_CAN4_SWC2_R_PageSwitch_Sta, Init_CAN4_SWC2_R_RegenDown_Sta, Init_CAN4_SWC2_R_Right_Sta, Init_CAN4_SWC2_R_ScrollDown_Sta, Init_CAN4_SWC2_R_ScrollPress_Sta, Init_CAN4_SWC2_R_ScrollUp_Sta, Init_CAN4_SWC2_R_VR_Sta, Init_CAN4_SWC2_ResponseError, Init_CAN4_SWC2_SW_Version, Init_CAN4_SWC_ACC_Sta, Init_CAN4_SWC_A_HW_version, Init_CAN4_SWC_A_Resp_Err, Init_CAN4_SWC_A_SW_version, Init_CAN4_SWC_CANCEL_Sta, Init_CAN4_SWC_Distance_Sta, Init_CAN4_SWC_Down_Sta, Init_CAN4_SWC_Drivemode_Sta, Init_CAN4_SWC_LKA_Sta, Init_CAN4_SWC_Left_Sta, Init_CAN4_SWC_RegenDown, Init_CAN4_SWC_RegenUp, Init_CAN4_SWC_Res_Up_Sta, Init_CAN4_SWC_Right_Sta, Init_CAN4_SWC_Set_down_Sta, Init_CAN4_SWC_Trip_Sta, Init_CAN4_SWC_Undefined_Sta, Init_CAN4_SWC_Up_Sta, Init_CAN4_SWC_VR_Sta, Init_CAN4_SWC_mode_Sta, Init_CAN4_SWC_resp_error]
package /CAN4/ImplementationDataTypes
  21 x impl type, all with category=STRUCTURE:
    DT_CAN4_SG_DKC1
      15 x element, all with category=TYPE_REFERENCE, implementation-data-type=uint8:
        CAN4_DKC_KeyNum_Sta
        CAN4_DKC_KeyType_Sta
        CAN4_DKC_PDkeyAreaRAPS_Sta
        CAN4_DKC_ParkingMode_Cmd
        CAN4_DKC_Re_VehData
        CAN4_P_CommandToBCM
        CAN4_P_CommandToPTG
        CAN4_P_DKey_Area_LockUnlock
        CAN4_P_DKey_Area_PS
        CAN4_P_DKey_Area_PTG
        CAN4_P_DKey_Welcome
        CAN4_P_Dkey_Show_IVI
        CAN4_P_KeyMiss
        CAN4_P_KeyMode
        CAN4_P_UID_LowPower
    DT_CAN4_SG_DKC2
      element CAN4_EncryptionDATA_0_63: implementation-data-type=uint64
      element CAN4_EncryptionDATA_64_127: implementation-data-type=uint64
      element CAN4_Random_Number_X: implementation-data-type=uint64
    DT_CAN4_SG_FD4_C100_0
      element CAN4_FDC_CHA_EACEnDemand_Cmd: implementation-data-type=uint8
    DT_CAN4_SG_FD4_CE100_0
      76 x element, all with category=TYPE_REFERENCE:
        CAN4_APS_Sta_System: implementation-data-type=uint8
        CAN4_AllDoorSW: implementation-data-type=uint8
        CAN4_AntiTheftSeatFold: implementation-data-type=uint8
        CAN4_AntitheftSta: implementation-data-type=uint8
        CAN4_BCM_DoorLock_Sta: implementation-data-type=uint8
        CAN4_BrakeLamp: implementation-data-type=uint8
        CAN4_CC_Crl_Sta: implementation-data-type=uint8
        CAN4_CS_VCU1_CAN4: implementation-data-type=uint8
        CAN4_CTDCtrl: implementation-data-type=uint8
        CAN4_CTDLockSW: implementation-data-type=uint8
        CAN4_CTDUnlockSW: implementation-data-type=uint8
        CAN4_CrashDetd: implementation-data-type=uint8
        CAN4_CtrlDrPwrStbA2: implementation-data-type=uint8
        CAN4_CtrlFrBMSCCUCIR: implementation-data-type=uint8
        CAN4_CtrlFrEDUINVERTER: implementation-data-type=uint8
        CAN4_CtrlFrIRC1: implementation-data-type=uint8
        CAN4_CtrlFrPwrStbA1P: implementation-data-type=uint8
        CAN4_DKCAuthSta: implementation-data-type=uint8
        CAN4_DKCTimeSN: implementation-data-type=uint32
        CAN4_Dimmer: implementation-data-type=uint8
        CAN4_DimmerEN: implementation-data-type=uint8
        CAN4_DoorLockIND: implementation-data-type=uint8
        CAN4_DrDoorSW: implementation-data-type=uint8
        CAN4_Dr_SeatSta: implementation-data-type=uint8
        CAN4_EquivAccPedalSWSta: implementation-data-type=uint8
        CAN4_FD_DKC_VehData_Err: implementation-data-type=uint8
        CAN4_FD_DKC_VehData_Sta: implementation-data-type=uint8
        CAN4_FD_TBOX_DTCData_Err: implementation-data-type=uint8
        CAN4_FD_TBOX_DTCData_Sta: implementation-data-type=uint8
        CAN4_FD_TBOX_VehData_Err: implementation-data-type=uint8
        CAN4_FD_TBOX_VehData_Sta: implementation-data-type=uint8
        CAN4_Fr_ChargingDoorCtrl: implementation-data-type=uint8
        CAN4_Fr_FogLamp: implementation-data-type=uint8
        CAN4_Fr_Wiper_H: implementation-data-type=uint8
        CAN4_Fr_Wiper_L: implementation-data-type=uint8
        CAN4_HWResetSta: implementation-data-type=uint8
        CAN4_H_Beam: implementation-data-type=uint8
        CAN4_H_Beam_ADB: implementation-data-type=uint8
        CAN4_HazardSW: implementation-data-type=uint8
        CAN4_HoodSW: implementation-data-type=uint8
        CAN4_HornCtrl: implementation-data-type=uint8
        CAN4_LBSD: implementation-data-type=uint8
        CAN4_LDRL: implementation-data-type=uint8
        CAN4_LTurnLP: implementation-data-type=uint8
        CAN4_L_APM_WdwEnable: implementation-data-type=uint8
        CAN4_L_Beam: implementation-data-type=uint8
        CAN4_LampPwr: implementation-data-type=uint8
        CAN4_LockSetting: implementation-data-type=uint8
        CAN4_MSA_Crl_Sta: implementation-data-type=uint8
        CAN4_MirrorCtrl: implementation-data-type=uint8
        CAN4_MirrorDefog: implementation-data-type=uint8
        CAN4_PosLamp: implementation-data-type=uint8
        CAN4_PsDoorSW: implementation-data-type=uint8
        CAN4_PwrSta: implementation-data-type=uint8
        CAN4_RBSD: implementation-data-type=uint8
        CAN4_RC_VCU1_CAN4: implementation-data-type=uint8
        CAN4_RDRL: implementation-data-type=uint8
        CAN4_RLDoorSW: implementation-data-type=uint8
        CAN4_RRDoorSW: implementation-data-type=uint8
        CAN4_RTurnLP: implementation-data-type=uint8
        CAN4_ReBrakeLPReq: implementation-data-type=uint8
        CAN4_ReverseLamp: implementation-data-type=uint8
        CAN4_RoomLampH: implementation-data-type=uint8
        CAN4_RoomLampL: implementation-data-type=uint8
        CAN4_Rr_ChargingDoorCtrl: implementation-data-type=uint8
        CAN4_Rr_Defog: implementation-data-type=uint8
        CAN4_Rr_FogLamp: implementation-data-type=uint8
        CAN4_Rr_Wiper: implementation-data-type=uint8
        CAN4_ShiftGearPosn: implementation-data-type=uint8
        CAN4_TailgateHDSW: implementation-data-type=uint8
        CAN4_TailgateRemote: implementation-data-type=uint8
        CAN4_Tailgate_SW: implementation-data-type=uint8
        CAN4_TimeSNDKCFbk: implementation-data-type=uint32
        CAN4_TrunkRel: implementation-data-type=uint8
        CAN4_WasherCtrl: implementation-data-type=uint8
        CAN4_WiperFixMode: implementation-data-type=uint8
    DT_CAN4_SG_FD4_CE100_1
      76 x element, all with category=TYPE_REFERENCE:
        CAN4_ACSubMode: implementation-data-type=uint8
        CAN4_APTC_ActFrRiPwr: implementation-data-type=uint8
        CAN4_BatLoopActWtFlw: implementation-data-type=uint8
        CAN4_BatteryMode: implementation-data-type=uint8
        CAN4_CCU_ACLampSts: implementation-data-type=uint8
        CAN4_CCU_ACMaxLampSts: implementation-data-type=uint8
        CAN4_CCU_AutoLampSts: implementation-data-type=uint8
        CAN4_CCU_AutoMidLampSts: implementation-data-type=uint8
        CAN4_CCU_CbnPreACWkSts: implementation-data-type=uint8
        CAN4_CCU_CbnPreEstimdTi: implementation-data-type=uint8
        CAN4_CCU_CbnPreSts: implementation-data-type=uint8
        CAN4_CCU_Dispaly_Request: implementation-data-type=uint8
        CAN4_CCU_EcoSts: implementation-data-type=uint8
        CAN4_CCU_FrtOnOffLampSts: implementation-data-type=uint8
        CAN4_CCU_HEATMaxLampSts: implementation-data-type=uint8
        CAN4_CCU_HiVoltageReq: implementation-data-type=uint8
        CAN4_CCU_RrOnOffLampSts: implementation-data-type=uint8
        CAN4_CCU_SyncLampSts: implementation-data-type=uint8
        CAN4_CabinMode: implementation-data-type=uint8
        CAN4_CoolgFanActDuty: implementation-data-type=uint8
        CAN4_DeiceModReq: implementation-data-type=uint8
        CAN4_EDriveMode: implementation-data-type=uint8
        CAN4_FDC_THCM_CLEVentY_Sta: implementation-data-type=uint8
        CAN4_FDC_THCM_CLEVentZ_Sta: implementation-data-type=uint8
        CAN4_FDC_THCM_CLVent_Sta: implementation-data-type=uint8
        CAN4_FDC_THCM_CREVentY_Sta: implementation-data-type=uint8
        CAN4_FDC_THCM_CREVentZ_Sta: implementation-data-type=uint8
        CAN4_FDC_THCM_CRVent_Sta: implementation-data-type=uint8
        CAN4_FDC_THCM_DrEVentMode_Sta: implementation-data-type=uint8
        CAN4_FDC_THCM_DrEVentY_Sta: implementation-data-type=uint8
        CAN4_FDC_THCM_DrEVentZ_Sta: implementation-data-type=uint8
        CAN4_FDC_THCM_DrVent_Sta: implementation-data-type=uint8
        CAN4_FDC_THCM_PsEVentMode_Sta: implementation-data-type=uint8
        CAN4_FDC_THCM_PsEVentY_Sta: implementation-data-type=uint8
        CAN4_FDC_THCM_PsEVentZ_Sta: implementation-data-type=uint8
        CAN4_FDC_THCM_PsVent_Sta: implementation-data-type=uint8
        CAN4_FD_Blower_Cmd: implementation-data-type=uint8
        CAN4_FD_Comp_Cmd: implementation-data-type=uint16
        CAN4_FD_EWP{1..3}_Cmd: implementation-data-type=uint8
        CAN4_FD_EXV1_Cmd: implementation-data-type=uint16
        CAN4_FD_EXV2_Cmd: implementation-data-type=uint16
        CAN4_FD_FWV_Cmd: implementation-data-type=uint8
        CAN4_FD_FrLeAPTCHeatPwr_Cmd: implementation-data-type=uint8
        CAN4_FD_FrRiAPTCHeatPwr_Cmd: implementation-data-type=uint8
        CAN4_FD_FrWPTCHeatPwr_Cmd: implementation-data-type=uint16
        CAN4_FD_RecyAuto_Cmd: implementation-data-type=uint8
        CAN4_FD_RrAPTCHeatPwr_Cmd: implementation-data-type=uint8
        CAN4_FD_SOTXV_Cmd: implementation-data-type=uint8
        CAN4_FD_SOV{1..3}_Cmd: implementation-data-type=uint8
        CAN4_FD_TWV_Cmd: implementation-data-type=uint8
        CAN4_Fr_Coolantflow: implementation-data-type=uint8
        CAN4_Fr_Coolanttemp: implementation-data-type=uint16
        CAN4_HPThermalRecoveryReq: implementation-data-type=uint8
        CAN4_Rr_Coolantflow: implementation-data-type=uint8
        CAN4_Rr_Coolanttemp: implementation-data-type=uint16
        CAN4_sigAirIntenZon1St: implementation-data-type=uint8
        CAN4_sigAirIntenZon3St: implementation-data-type=uint8
        CAN4_sigAmbAirT: implementation-data-type=uint8
        CAN4_sigCbnAirT: implementation-data-type=uint8
        CAN4_sigCbnPTCPwrAct: implementation-data-type=uint8
        CAN4_sigCbnSolarLeft: implementation-data-type=uint8
        CAN4_sigCbnSolarRight: implementation-data-type=uint8
        CAN4_sigClmtCmprPwrAct: implementation-data-type=uint8
        CAN4_sigClntTHvBattOut: implementation-data-type=uint8
        CAN4_sigDfrstSt: implementation-data-type=uint8
        CAN4_sigHvacSt: implementation-data-type=uint8
        CAN4_sigRecircSt: implementation-data-type=uint8
        CAN4_sigSetTempZon{1..3}St: implementation-data-type=uint8
        CAN4_sigWindDirZon1St: implementation-data-type=uint8
        CAN4_sigWindDirZon3St: implementation-data-type=uint8
    DT_CAN4_SG_FD4_CE100_2
      element CAN4_FD4_CE100_2_CS: implementation-data-type=uint8
      element CAN4_FD4_CE100_2_RC: implementation-data-type=uint8
      element CAN4_FDC_VCU_ReqHWReset_Cmd: implementation-data-type=uint8
    DT_CAN4_SG_FD4_CE100_3
      24 x element, all with category=TYPE_REFERENCE, implementation-data-type=uint8:
        CAN4_FDC_BCM_BBuzzer_Cmd
        CAN4_FDC_BCM_BBuzzerout_Cmd
        CAN4_FDC_BCM_EmExitLight_Cmd
        CAN4_FDC_BCM_FrAtmoLamp_Cmd
        CAN4_FDC_BCM_FrRmLampBright_Cmd
        CAN4_FDC_BCM_FrRoomlamp_Cmd
        CAN4_FDC_BCM_IBuzzerReq_Sta
        CAN4_FDC_BCM_LSMLP_Cmd
        CAN4_FDC_BCM_LTgateRel_Cmd
        CAN4_FDC_BCM_RSMLP_Cmd
        CAN4_FDC_BCM_RTgateRel_Cmd
        CAN4_FDC_BCM_RevBuzzerout_Cmd
        CAN4_FDC_BCM_RrAtmoLamp_Cmd
        CAN4_FDC_BCM_RrRmLampBright_Cmd
        CAN4_FDC_BCM_RrRoomlamp_Cmd
        CAN4_FDC_BCM_STurnLpLeft_Cmd
        CAN4_FDC_BCM_STurnLpRight_Cmd
        CAN4_FDC_BCM_TgateHDSWL_Sta
        CAN4_FDC_BCM_TgateHDSWR_Sta
        CAN4_FDC_BCM_TgateSWL_Sta
        CAN4_FDC_BCM_TgateSWR_Sta
        CAN4_FDC_BCM_TurnLpLActive_Cmd
        CAN4_FDC_BCM_TurnLpRActive_Cmd
        CAN4_FDC_BCM_innerBuzzer_Cmd
    DT_CAN4_SG_FD4_CE200_0
      43 x element, all with category=TYPE_REFERENCE:
        CAN4_AmbLightBreath{1..6}: implementation-data-type=uint8
        CAN4_AmbLightBrightness{1..6}: implementation-data-type=uint8
        CAN4_AmbLightColor{1..6}: implementation-data-type=uint8
        CAN4_BCM_Buzzer_Req: implementation-data-type=uint8
        CAN4_FDC_BCM_ATCtrl_Cmd: implementation-data-type=uint8
        CAN4_FDC_BCM_DimSw: implementation-data-type=uint8
        CAN4_FDC_BCM_FWasSw_Sta: implementation-data-type=uint8
        CAN4_FDC_BCM_FWipSw_Sta: implementation-data-type=uint8
        CAN4_FDC_BCM_HazardIND_Cmd: implementation-data-type=uint8
        CAN4_FDC_BCM_LockAlarm_Cmd: implementation-data-type=uint8
        CAN4_FDC_BCM_OutMode_Cmd: implementation-data-type=uint8
        CAN4_FDC_BCM_PTGOpenHeight_Sta: implementation-data-type=uint8
        CAN4_FDC_BCM_PassSW_Sta: implementation-data-type=uint8
        CAN4_FDC_BCM_TurnSwTSetSta_Sta: implementation-data-type=uint8
        CAN4_FDC_BCM_TurnSw_Sta: implementation-data-type=uint8
        CAN4_FDC_BCM_UserHeightSet_Sta: implementation-data-type=uint16
        CAN4_FDC_BCM_UserNow_Sta: implementation-data-type=uint8
        CAN4_FDC_DKC_CommandToBCM_Cmd: implementation-data-type=uint8
        CAN4_FDC_DKC_DKeyAreaPE_Sta: implementation-data-type=uint8
        CAN4_FDC_DKC_SPTGDet_Cmd: implementation-data-type=uint8
        CAN4_FDC_DKC_SPTGOpen_Cmd: implementation-data-type=uint8
        CAN4_FDC_EChrg_SW_Sta: implementation-data-type=uint8
        CAN4_FDC_THCM_ACTInitial_Cmd: implementation-data-type=uint8
        CAN4_FDC_THCM_AirIntZ3_Sta: implementation-data-type=uint8
        CAN4_FDHandleCmd: implementation-data-type=uint8
        CAN4_FDLHandleLampCmd: implementation-data-type=uint8
        CAN4_FDRHandleLampCmd: implementation-data-type=uint8
        CAN4_WelcomeLight: implementation-data-type=uint8
    DT_CAN4_SG_FD4_OTA1
      15 x element, all with category=TYPE_REFERENCE:
        CAN4_OTA_DL_Available: implementation-data-type=uint8
        CAN4_OTA_DL_Speed: implementation-data-type=uint32
        CAN4_OTA_Debug_Code: implementation-data-type=uint8
        CAN4_OTA_Emergency_Sta: implementation-data-type=uint8
        CAN4_OTA_InVehicle_FW: implementation-data-type=uint8
        CAN4_OTA_Lock_Req: implementation-data-type=uint8
        CAN4_OTA_MDA_Status: implementation-data-type=uint8
        CAN4_OTA_Mode: implementation-data-type=uint8
        CAN4_OTA_Network_Type: implementation-data-type=uint8
        CAN4_OTA_Permit_Agreed: implementation-data-type=uint8
        CAN4_OTA_Progress_Rate: implementation-data-type=uint8
        CAN4_OTA_Remained_Time: implementation-data-type=uint16
        CAN4_OTA_TBOXResetReq: implementation-data-type=uint8
        CAN4_OTA_Update_Available: implementation-data-type=uint8
        CAN4_OTA_Updating_ECU_8bit: implementation-data-type=uint8
    DT_CAN4_SG_GW4_CE100_0
      12 x element, all with category=TYPE_REFERENCE:
        CAN4_BrkPedalPos: implementation-data-type=uint8
        CAN4_BrkPedalPos_Sta: implementation-data-type=uint8
        CAN4_BrkSw_Sta: implementation-data-type=uint8
        CAN4_BrkSw_V: implementation-data-type=uint8
        CAN4_FDC_PTG_inner_SW_2: implementation-data-type=uint8
        CAN4_L_Drv_CtrlCmd: implementation-data-type=uint8
        CAN4_L_Pas_CtrlCmd: implementation-data-type=uint8
        CAN4_L_RLD_CtrlCmd: implementation-data-type=uint8
        CAN4_L_RRD_CtrlCmd: implementation-data-type=uint8
        CAN4_MCPressure: implementation-data-type=uint16
        CAN4_MCPressure_V: implementation-data-type=uint8
        CAN4_VehSpeed: implementation-data-type=uint16
    DT_CAN4_SG_CGW_GW4_CE100_0
      39 x element, all with category=TYPE_REFERENCE, implementation-data-type=uint8:
        CAN4_AVM_parking_excute
        CAN4_Approach_Unlock_SW
        CAN4_ChrgInLockReq
        CAN4_ChrgPlugSta
        CAN4_DSEAT_anti_set
        CAN4_DSEAT_entryfun_set
        CAN4_DSEAT_vent_req
        CAN4_Distance_unit
        CAN4_ExtChrgSta
        CAN4_HeadLampSW
        CAN4_Hood_Latch_SW
        CAN4_IVI_ChargePortSW_Sta
        CAN4_IVI_DSEATHeater_Cmd
        CAN4_IVI_ISA_OffsetSpd
        CAN4_IVI_Located_STA
        CAN4_IVI_PSEATHeater_Cmd
        CAN4_IVI_PTG_Mode_SW
        CAN4_IVI_PTG_Open_Height
        CAN4_IVI_PTG_Sta_SW
        CAN4_IVI_Time_Check
        CAN4_IVI_Time_Day
        CAN4_IVI_Time_Hour
        CAN4_IVI_Time_Minute
        CAN4_IVI_Time_Month
        CAN4_IVI_Time_Second
        CAN4_IVI_Time_Year
        CAN4_IVI_TrailerCheckReq_Sta
        CAN4_IVI_TrailerModeSW_Sta
        CAN4_Light_ShowStart_Req
        CAN4_Light_ShowStop_Req
        CAN4_METER_KPH_Calcu
        CAN4_OBCV2LSta
        CAN4_OFF_AC_MODE
        CAN4_PSEAT_vent_req
        CAN4_SenstivityPosition
        CAN4_TBOX_Remote_PW
        CAN4_V2LSta
        CAN4_Walkaway_Lock_SW
        CAN4_WlcmLight_Mode
    DT_CAN4_SG_GW4_CE200_0
      22 x element, all with category=TYPE_REFERENCE, implementation-data-type=uint8:
        CAN4_IVI_LSEATvent_Cmd
        CAN4_IVI_MLFMost_Cmd
        CAN4_IVI_MLFootLift_Cmd
        CAN4_IVI_MLNapMode_Cmd
        CAN4_IVI_MLRecliner_Cmd
        CAN4_IVI_MLRestore_Cmd
        CAN4_IVI_MLSEATvent_Cmd
        CAN4_IVI_MLSeatLift_Cmd
        CAN4_IVI_MLSldRestore_Cmd
        CAN4_IVI_MLSlider_Cmd
        CAN4_IVI_MLZeroGravity_Cmd
        CAN4_IVI_MRFMost_Cmd
        CAN4_IVI_MRFootLift_Cmd
        CAN4_IVI_MRNapMode_Cmd
        CAN4_IVI_MRRecliner_Cmd
        CAN4_IVI_MRRestore_Cmd
        CAN4_IVI_MRSEATvent_Cmd
        CAN4_IVI_MRSeatLift_Cmd
        CAN4_IVI_MRSldRestore_Cmd
        CAN4_IVI_MRSlider_Cmd
        CAN4_IVI_MRZeroGravity_Cmd
        CAN4_IVI_RSEATvent_Cmd
    DT_CAN4_SG_Z24_C1000_0
      element CAN4_Z24_CHA_AirPressureFC2_Sta: implementation-data-type=uint8
      element CAN4_Z24_CHA_AirPressurePC3_Sta: implementation-data-type=uint8
      element CAN4_Z24_CHA_AirPressureRC1_Sta: implementation-data-type=uint8
    DT_CAN4_SG_Z24_CE100_0
      9 x element, all with category=TYPE_REFERENCE, implementation-data-type=uint8:
        CAN4_Z24_BCM_EmExitOP_Sta
        CAN4_Z24_BCM_FLTurnLampC_Sta
        CAN4_Z24_BCM_FRTurnLampC_Sta
        CAN4_Z24_BCM_FWiperAS_Sta
        CAN4_Z24_BCM_FWiperProtection_Sta
        CAN4_Z24_BCM_RLTurnLampC_Sta
        CAN4_Z24_BCM_RRTurnLampC_Sta
        CAN4_Z24_BCM_SeatBeltSW_Sta
        CAN4_Z24_BCM_innerBuzzer_Sta
    DT_CAN4_SG_ZONE_DR1
      91 x element, all with category=TYPE_REFERENCE:
        CAN4_ACT1_Actuator_address: implementation-data-type=uint8
        CAN4_ACT1_Actuator_set_position: implementation-data-type=uint16
        CAN4_ACT1_Actuator_start_position: implementation-data-type=uint16
        CAN4_ACT1_Applied_holding_current: implementation-data-type=uint8
        CAN4_ACT1_Clear_Event_Flags: implementation-data-type=uint8
        CAN4_ACT1_Emergency_run_position: implementation-data-type=uint8
        CAN4_ACT1_Emergency_run_release: implementation-data-type=uint8
        CAN4_ACT1_Rotation_direction: implementation-data-type=uint8
        CAN4_ACT1_Save_programming_data: implementation-data-type=uint8
        CAN4_ACT1_Select_position_specification: implementation-data-type=uint8
        CAN4_ACT1_Speed_specification: implementation-data-type=uint8
        CAN4_ACT1_Stall_detection_release: implementation-data-type=uint8
        CAN4_ACT1_Stop_mode: implementation-data-type=uint8
        CAN4_ACT2_Actuator_address: implementation-data-type=uint8
        CAN4_ACT2_Actuator_set_position: implementation-data-type=uint16
        CAN4_ACT2_Actuator_start_position: implementation-data-type=uint16
        CAN4_ACT2_Applied_holding_current: implementation-data-type=uint8
        CAN4_ACT2_Clear_Event_Flags: implementation-data-type=uint8
        CAN4_ACT2_Emergency_run_position: implementation-data-type=uint8
        CAN4_ACT2_Emergency_run_release: implementation-data-type=uint8
        CAN4_ACT2_Rotation_direction: implementation-data-type=uint8
        CAN4_ACT2_Save_programming_data: implementation-data-type=uint8
        CAN4_ACT2_Select_position_specification: implementation-data-type=uint8
        CAN4_ACT2_Speed_specification: implementation-data-type=uint8
        CAN4_ACT2_Stall_detection_release: implementation-data-type=uint8
        CAN4_ACT2_Stop_mode: implementation-data-type=uint8
        CAN4_ACT3_Actuator_address: implementation-data-type=uint8
        CAN4_ACT3_Actuator_set_position: implementation-data-type=uint16
        CAN4_ACT3_Actuator_start_position: implementation-data-type=uint16
        CAN4_ACT3_Applied_holding_current: implementation-data-type=uint8
        CAN4_ACT3_Clear_Event_Flags: implementation-data-type=uint8
        CAN4_ACT3_Emergency_run_position: implementation-data-type=uint8
        CAN4_ACT3_Emergency_run_release: implementation-data-type=uint8
        CAN4_ACT3_Rotation_direction: implementation-data-type=uint8
        CAN4_ACT3_Save_programming_data: implementation-data-type=uint8
        CAN4_ACT3_Select_position_specification: implementation-data-type=uint8
        CAN4_ACT3_Speed_specification: implementation-data-type=uint8
        CAN4_ACT3_Stall_detection_release: implementation-data-type=uint8
        CAN4_ACT3_Stop_mode: implementation-data-type=uint8
        CAN4_ACT4_Actuator_address: implementation-data-type=uint8
        CAN4_ACT4_Actuator_set_position: implementation-data-type=uint16
        CAN4_ACT4_Actuator_start_position: implementation-data-type=uint16
        CAN4_ACT4_Applied_holding_current: implementation-data-type=uint8
        CAN4_ACT4_Clear_Event_Flags: implementation-data-type=uint8
        CAN4_ACT4_Emergency_run_position: implementation-data-type=uint8
        CAN4_ACT4_Emergency_run_release: implementation-data-type=uint8
        CAN4_ACT4_Rotation_direction: implementation-data-type=uint8
        CAN4_ACT4_Save_programming_data: implementation-data-type=uint8
        CAN4_ACT4_Select_position_specification: implementation-data-type=uint8
        CAN4_ACT4_Speed_specification: implementation-data-type=uint8
        CAN4_ACT4_Stall_detection_release: implementation-data-type=uint8
        CAN4_ACT4_Stop_mode: implementation-data-type=uint8
        CAN4_ACT5_Actuator_address: implementation-data-type=uint8
        CAN4_ACT5_Actuator_set_position: implementation-data-type=uint16
        CAN4_ACT5_Actuator_start_position: implementation-data-type=uint16
        CAN4_ACT5_Applied_holding_current: implementation-data-type=uint8
        CAN4_ACT5_Clear_Event_Flags: implementation-data-type=uint8
        CAN4_ACT5_Emergency_run_position: implementation-data-type=uint8
        CAN4_ACT5_Emergency_run_release: implementation-data-type=uint8
        CAN4_ACT5_Rotation_direction: implementation-data-type=uint8
        CAN4_ACT5_Save_programming_data: implementation-data-type=uint8
        CAN4_ACT5_Select_position_specification: implementation-data-type=uint8
        CAN4_ACT5_Speed_specification: implementation-data-type=uint8
        CAN4_ACT5_Stall_detection_release: implementation-data-type=uint8
        CAN4_ACT5_Stop_mode: implementation-data-type=uint8
        CAN4_AllLockSta: implementation-data-type=uint8
        CAN4_AutoLightSW: implementation-data-type=uint8
        CAN4_BrakeLampFail: implementation-data-type=uint8
        CAN4_DrLockSta: implementation-data-type=uint8
        CAN4_HornSW: implementation-data-type=uint8
        CAN4_MIRROR_FOLD_SW: implementation-data-type=uint8
        CAN4_PsLockSta: implementation-data-type=uint8
        CAN4_RLLockSta: implementation-data-type=uint8
        CAN4_RLS_Exist: implementation-data-type=uint8
        CAN4_RLTurnLPErr: implementation-data-type=uint8
        CAN4_RLTurnLampC: implementation-data-type=uint8
        CAN4_RRLockSta: implementation-data-type=uint8
        CAN4_RRTurnLPErr: implementation-data-type=uint8
        CAN4_RRTurnLampC: implementation-data-type=uint8
        CAN4_RWiperAS: implementation-data-type=uint8
        CAN4_RWiperProtection: implementation-data-type=uint8
        CAN4_Wip_Speed: implementation-data-type=uint8
        CAN4_WiperSWPos: implementation-data-type=uint8
        CAN4_WiperZeroPosSW: implementation-data-type=uint8
        CAN4_ZDR_THCM_IntakeFail_Sta: implementation-data-type=uint8
        CAN4_ZDR_THCM_LINACT{1..5}_Sta: implementation-data-type=uint8
        CAN4_ZDR_THCM_ModeFail_Sta: implementation-data-type=uint8
    DT_CAN4_SG_ZONE_DR_VCU
      58 x element, all with category=TYPE_REFERENCE:
        CAN4_APTC_Err: implementation-data-type=uint8
        CAN4_Blower_Err: implementation-data-type=uint8
        CAN4_Blower_FB: implementation-data-type=uint8
        CAN4_DrADASCurr: implementation-data-type=uint8
        CAN4_DrAPWLINErr: implementation-data-type=uint8
        CAN4_DrAPWStaErr: implementation-data-type=uint8
        CAN4_DrAuBoxPwrN1Curr: implementation-data-type=uint8
        CAN4_DrAuBoxPwrN2Curr: implementation-data-type=uint8
        CAN4_DrColumnSWFault: implementation-data-type=uint8
        CAN4_DrCtrlBDVolt: implementation-data-type=uint16
        CAN4_DrCtrlTemp: implementation-data-type=uint16
        CAN4_DrEOBDFault: implementation-data-type=uint8
        CAN4_DrIVIFault: implementation-data-type=uint8
        CAN4_DrInfoErrSta: implementation-data-type=uint8
        CAN4_DrInfoFault: implementation-data-type=uint8
        CAN4_DrONA1ErrSta: implementation-data-type=uint8
        CAN4_DrPMMLVOutPErrLmp: implementation-data-type=uint8
        CAN4_DrPMMLimpHomeActReq: implementation-data-type=uint8
        CAN4_DrPMMSysErrLmp: implementation-data-type=uint8
        CAN4_DrPowerTemp1: implementation-data-type=uint16
        CAN4_DrPowerTemp2: implementation-data-type=uint16
        CAN4_DrPwrInformationSta: implementation-data-type=uint8
        CAN4_DrPwrONA1Curr: implementation-data-type=uint8
        CAN4_DrPwrONA2Curr: implementation-data-type=uint8
        CAN4_DrPwrSta: implementation-data-type=uint8
        CAN4_DrPwrStdbyACurr: implementation-data-type=uint8
        CAN4_DrPwrWinErrSta: implementation-data-type=uint8
        CAN4_DrPwrWindowECUFault: implementation-data-type=uint8
        CAN4_DrSCPSysErrLmp: implementation-data-type=uint8
        CAN4_DrStdAErrSta: implementation-data-type=uint8
        CAN4_DrTHCMFault: implementation-data-type=uint8
        CAN4_RegenSW_Err: implementation-data-type=uint8
        CAN4_SolarL: implementation-data-type=uint8
        CAN4_SolarL_Err: implementation-data-type=uint8
        CAN4_SolarR: implementation-data-type=uint8
        CAN4_SolarR_Err: implementation-data-type=uint8
        CAN4_T_Face_L: implementation-data-type=uint8
        CAN4_T_Face_L_Err: implementation-data-type=uint8
        CAN4_T_Face_R: implementation-data-type=uint8
        CAN4_T_Face_R_Err: implementation-data-type=uint8
        CAN4_T_Face_Rr: implementation-data-type=uint8
        CAN4_T_Face_Rr_Err: implementation-data-type=uint8
        CAN4_T_Foot_L: implementation-data-type=uint8
        CAN4_T_Foot_L_Err: implementation-data-type=uint8
        CAN4_T_Foot_R: implementation-data-type=uint8
        CAN4_T_Foot_R_Err: implementation-data-type=uint8
        CAN4_T_Foot_Rr: implementation-data-type=uint8
        CAN4_T_Foot_Rr_Err: implementation-data-type=uint8
        CAN4_Tevap: implementation-data-type=uint8
        CAN4_Tevap_Err: implementation-data-type=uint8
        CAN4_Tincar: implementation-data-type=uint8
        CAN4_Tincar_Err: implementation-data-type=uint8
        CAN4_ZDR_SYS_APMRetryCnt_Sta: implementation-data-type=uint8
        CAN4_ZDR_SYS_BSWSleepReq_Sta: implementation-data-type=uint8
        CAN4_ZDR_SYS_CSWRetryCnt_Sta: implementation-data-type=uint8
        CAN4_ZDR_VCU_HWReset_Sta: implementation-data-type=uint8
        CAN4_ZDR_VCU_PwrSupply_Sta: implementation-data-type=uint8
        CAN4_ZoneDrMalfunLevel: implementation-data-type=uint8
    DT_CAN4_SG_ZONE_FR1
      73 x element, all with category=TYPE_REFERENCE:
        CAN4_BDC_1_MoveEnable: implementation-data-type=uint8
        CAN4_BDC_1_ReqMovePos: implementation-data-type=uint8
        CAN4_BMSChksmHSC6: implementation-data-type=uint8
        CAN4_BMSEnbPTCHSC6: implementation-data-type=uint8
        CAN4_BMSInptClntTemHSC6: implementation-data-type=uint16
        CAN4_BMSPackVol_h6HSC6: implementation-data-type=uint16
        CAN4_BMSReqMdHSC6: implementation-data-type=uint8
        CAN4_BMSReqPWMHSC6: implementation-data-type=uint8
        CAN4_BMSReqPwrHSC6: implementation-data-type=uint16
        CAN4_BMSReqRlngCtrHSC6: implementation-data-type=uint8
        CAN4_BMSReqTapPosHSC6: implementation-data-type=uint8
        CAN4_CCM_SpdCmd: implementation-data-type=uint16
        CAN4_CCV4_MoveEnable: implementation-data-type=uint8
        CAN4_CCV4_ReqMovePos: implementation-data-type=uint8
        CAN4_ChargeInletLockSta: implementation-data-type=uint8
        CAN4_CompProEN: implementation-data-type=uint8
        CAN4_EWP1_Default_Operation_EWP_Rq: implementation-data-type=uint8
        CAN4_EWP1_RPM_Target_EWP_Rq: implementation-data-type=uint8
        CAN4_EWP2_Default_Operation_EWP_Rq: implementation-data-type=uint8
        CAN4_EWP2_RPM_Target_EWP_Rq: implementation-data-type=uint8
        CAN4_EWP3_Default_Operation_EWP_Rq: implementation-data-type=uint8
        CAN4_EWP3_RPM_Target_EWP_Rq: implementation-data-type=uint8
        CAN4_EXV2_Cmd_Init_Rq: implementation-data-type=uint8
        CAN4_EXV2_Cmd_Move_Enbl: implementation-data-type=uint8
        CAN4_EXV2_Cmd_Set_Rq: implementation-data-type=uint16
        CAN4_EXV_Cmd_Init_Rq: implementation-data-type=uint8
        CAN4_EXV_Cmd_Move_Enbl: implementation-data-type=uint8
        CAN4_EXV_Cmd_Set_Rq: implementation-data-type=uint16
        CAN4_FLPosLPErr: implementation-data-type=uint8
        CAN4_FLTurnLPErr: implementation-data-type=uint8
        CAN4_FLTurnLampC: implementation-data-type=uint8
        CAN4_FLTurn_Light_Warning: implementation-data-type=uint8
        CAN4_FRPosLPErr: implementation-data-type=uint8
        CAN4_FRTurnLPErr: implementation-data-type=uint8
        CAN4_FRTurnLampC: implementation-data-type=uint8
        CAN4_FRTurn_Light_Warning: implementation-data-type=uint8
        CAN4_FWiperAS: implementation-data-type=uint8
        CAN4_FWiperProtection: implementation-data-type=uint8
        CAN4_LADBErr: implementation-data-type=uint8
        CAN4_LADB_Hibeam_Indication: implementation-data-type=uint8
        CAN4_LADB_Operation_Status: implementation-data-type=uint8
        CAN4_LADB_Warning: implementation-data-type=uint8
        CAN4_LAHB_Warning: implementation-data-type=uint8
        CAN4_LDRLErr: implementation-data-type=uint8
        CAN4_LDRL_Warning: implementation-data-type=uint8
        CAN4_LH_BeamErr: implementation-data-type=uint8
        CAN4_LLB_Warning: implementation-data-type=uint8
        CAN4_LL_BeamErr: implementation-data-type=uint8
        CAN4_Lposition_Lamp_Warning: implementation-data-type=uint8
        CAN4_RADBErr: implementation-data-type=uint8
        CAN4_RADB_Hibeam_Indication: implementation-data-type=uint8
        CAN4_RADB_Operation_Status: implementation-data-type=uint8
        CAN4_RADB_Warning: implementation-data-type=uint8
        CAN4_RAHB_Warning: implementation-data-type=uint8
        CAN4_RDRLErr: implementation-data-type=uint8
        CAN4_RDRL_Warning: implementation-data-type=uint8
        CAN4_RH_BeamErr: implementation-data-type=uint8
        CAN4_RLB_Warning: implementation-data-type=uint8
        CAN4_RL_BeamErr: implementation-data-type=uint8
        CAN4_Rposition_Lamp_Warning: implementation-data-type=uint8
        CAN4_TrailerCheck: implementation-data-type=uint8
        CAN4_TrailerModeSta: implementation-data-type=uint8
        CAN4_ZFR_BCM_ChargerDoorSW_Sta: implementation-data-type=uint8
        CAN4_ZFR_EChrg_Active_Sta: implementation-data-type=uint8
        CAN4_ZFR_EChrg_Sys_Sta: implementation-data-type=uint8
        CAN4_ZFR_THCM_CLEVentActY_Sta: implementation-data-type=uint8
        CAN4_ZFR_THCM_CLEVentActZ_Sta: implementation-data-type=uint8
        CAN4_ZFR_THCM_CREVentActY_Sta: implementation-data-type=uint8
        CAN4_ZFR_THCM_CREVentActZ_Sta: implementation-data-type=uint8
        CAN4_ZFR_THCM_DrEVentActY_Sta: implementation-data-type=uint8
        CAN4_ZFR_THCM_DrEVentActZ_Sta: implementation-data-type=uint8
        CAN4_ZFR_THCM_PsEVentActY_Sta: implementation-data-type=uint8
        CAN4_ZFR_THCM_PsEVentActZ_Sta: implementation-data-type=uint8
    DT_CAN4_SG_ZONE_FR_VCU
      72 x element, all with category=TYPE_REFERENCE:
        CAN4_Bat_In_Temp: implementation-data-type=uint8
        CAN4_Bat_In_Temp_Err: implementation-data-type=uint8
        CAN4_Bat_Out_Temp: implementation-data-type=uint8
        CAN4_Bat_Out_Temp_Err: implementation-data-type=uint8
        CAN4_COMP_Err: implementation-data-type=uint8
        CAN4_EACProtectEnable: implementation-data-type=uint8
        CAN4_EWP{1..3}_Err: implementation-data-type=uint8
        CAN4_EXV1_Err: implementation-data-type=uint8
        CAN4_EXV2_Err: implementation-data-type=uint8
        CAN4_FWV_Err: implementation-data-type=uint8
        CAN4_Fan_Err: implementation-data-type=uint8
        CAN4_FrBMSCCUCErr: implementation-data-type=uint8
        CAN4_FrBMS_CCU_CIRCurr: implementation-data-type=uint8
        CAN4_FrBMS_CCU_CIRFault: implementation-data-type=uint8
        CAN4_FrCtrlBDVolt: implementation-data-type=uint16
        CAN4_FrCtrlTemp: implementation-data-type=uint16
        CAN4_FrEDUErr: implementation-data-type=uint8
        CAN4_FrEDU_INVERTERCurr: implementation-data-type=uint8
        CAN4_FrEDU_INVERTERFault: implementation-data-type=uint8
        CAN4_FrIRC_1Curr: implementation-data-type=uint16
        CAN4_FrIRC_2Curr: implementation-data-type=uint16
        CAN4_FrPMMLVOutPErrLmp: implementation-data-type=uint8
        CAN4_FrPMMLimpHomeActReq: implementation-data-type=uint8
        CAN4_FrPMMSysErrLmp: implementation-data-type=uint8
        CAN4_FrPowerTemp1: implementation-data-type=uint16
        CAN4_FrPowerTemp2: implementation-data-type=uint16
        CAN4_FrPwrONA1Fault: implementation-data-type=uint8
        CAN4_FrPwrONA2Curr: implementation-data-type=uint8
        CAN4_FrPwrONA3Curr: implementation-data-type=uint8
        CAN4_FrPwrSta: implementation-data-type=uint8
        CAN4_FrPwrStdbyA1Fault: implementation-data-type=uint8
        CAN4_FrPwrStdbyA1PlusCurr: implementation-data-type=uint8
        CAN4_FrPwrStdbyA1PlusFault: implementation-data-type=uint8
        CAN4_FrPwrStdbyA2Curr: implementation-data-type=uint8
        CAN4_FrPwrStdbyA2PlusCurr: implementation-data-type=uint8
        CAN4_FrPwrStdbyA2PlusFault: implementation-data-type=uint8
        CAN4_FrStdA1PCErr: implementation-data-type=uint8
        CAN4_FrStdA2PCErr: implementation-data-type=uint8
        CAN4_FrStdA2PErr: implementation-data-type=uint8
        CAN4_Motor_In_Temp: implementation-data-type=uint8
        CAN4_Motor_In_Temp_Err: implementation-data-type=uint8
        CAN4_Motor_Out_Temp: implementation-data-type=uint8
        CAN4_Motor_Out_Temp_Err: implementation-data-type=uint8
        CAN4_PT_High_P: implementation-data-type=uint16
        CAN4_PT_High_P_Err: implementation-data-type=uint8
        CAN4_PT_High_T: implementation-data-type=uint8
        CAN4_PT_High_Tact: implementation-data-type=uint8
        CAN4_PT_High_Tact_Err: implementation-data-type=uint8
        CAN4_PT_Low_P1: implementation-data-type=uint16
        CAN4_PT_Low_P1_Err: implementation-data-type=uint8
        CAN4_PT_Low_P2: implementation-data-type=uint16
        CAN4_PT_Low_P2_Err: implementation-data-type=uint8
        CAN4_PT_Low_T1: implementation-data-type=uint8
        CAN4_PT_Low_T1_Err: implementation-data-type=uint8
        CAN4_PT_Low_T2: implementation-data-type=uint8
        CAN4_PT_Low_T2_Err: implementation-data-type=uint8
        CAN4_SOTXV_Err: implementation-data-type=uint8
        CAN4_SOV{1..3}_Err: implementation-data-type=uint8
        CAN4_TWV_Err: implementation-data-type=uint8
        CAN4_Tamb: implementation-data-type=uint8
        CAN4_Tamb_Err: implementation-data-type=uint8
        CAN4_WPTC_Err: implementation-data-type=uint8
        CAN4_ZFR_SYS_BMSCCURetryCnt_Sta: implementation-data-type=uint8
        CAN4_ZFR_SYS_BSWSleepReq_Sta: implementation-data-type=uint8
        CAN4_ZFR_SYS_MCURetryCnt_Sta: implementation-data-type=uint8
        CAN4_ZFR_VCU_HWReset_Sta: implementation-data-type=uint8
        CAN4_ZFR_VCU_PwrSupply_Sta: implementation-data-type=uint8
        CAN4_ZoneFrMalfunLevel: implementation-data-type=uint8
    DT_CAN4_SG_zGW_APTC1
      52 x element, all with category=TYPE_REFERENCE:
        CAN4_FrntPTCBusLineHiV: implementation-data-type=uint16
        CAN4_FrntPTCComFlt: implementation-data-type=uint8
        CAN4_FrntPTCFltSt: implementation-data-type=uint8
        CAN4_FrntPTCHVOverUFlt: implementation-data-type=uint8
        CAN4_FrntPTCHVUnderUFlt: implementation-data-type=uint8
        CAN4_FrntPTCHWVers: implementation-data-type=uint8
        CAN4_FrntPTCLVOverUFlt: implementation-data-type=uint8
        CAN4_FrntPTCLVUnderUFlt: implementation-data-type=uint8
        CAN4_FrntPTCLeActHeatPwr: implementation-data-type=uint8
        CAN4_FrntPTCLeBusLineC: implementation-data-type=uint8
        CAN4_FrntPTCLeCoreOverTFlt: implementation-data-type=uint8
        CAN4_FrntPTCLeCoreT: implementation-data-type=uint8
        CAN4_FrntPTCLeCoreTSnsrFlt: implementation-data-type=uint8
        CAN4_FrntPTCLeIGBTOverTFlt: implementation-data-type=uint8
        CAN4_FrntPTCLeIGBTShoCircFlt: implementation-data-type=uint8
        CAN4_FrntPTCLeIGBTT: implementation-data-type=uint8
        CAN4_FrntPTCLeIGBTTSnsrFlt: implementation-data-type=uint8
        CAN4_FrntPTCLeOpentCircFlt: implementation-data-type=uint8
        CAN4_FrntPTCLeOverAFlt: implementation-data-type=uint8
        CAN4_FrntPTCPCBOverTFlt: implementation-data-type=uint8
        CAN4_FrntPTCPCBT: implementation-data-type=uint8
        CAN4_FrntPTCPCBTSnsrFlt: implementation-data-type=uint8
        CAN4_FrntPTCRearLeActHeatPwr: implementation-data-type=uint8
        CAN4_FrntPTCRearLeBusLineC: implementation-data-type=uint8
        CAN4_FrntPTCRearLeCoreOverTFlt: implementation-data-type=uint8
        CAN4_FrntPTCRearLeCoreT: implementation-data-type=uint8
        CAN4_FrntPTCRearLeCoreTSnsrFlt: implementation-data-type=uint8
        CAN4_FrntPTCRearLeIGBTShoCFlt: implementation-data-type=uint8
        CAN4_FrntPTCRearLeOpentCircFlt: implementation-data-type=uint8
        CAN4_FrntPTCRearLeOverAFlt: implementation-data-type=uint8
        CAN4_FrntPTCRearRiActHeatPwr: implementation-data-type=uint8
        CAN4_FrntPTCRearRiBusLineC: implementation-data-type=uint8
        CAN4_FrntPTCRearRiCoreOverTFlt: implementation-data-type=uint8
        CAN4_FrntPTCRearRiCoreT: implementation-data-type=uint8
        CAN4_FrntPTCRearRiCoreTSnsrFlt: implementation-data-type=uint8
        CAN4_FrntPTCRearRiIGBTShoCFlt: implementation-data-type=uint8
        CAN4_FrntPTCRearRiOpentCircFlt: implementation-data-type=uint8
        CAN4_FrntPTCRearRiOverAFlt: implementation-data-type=uint8
        CAN4_FrntPTCRiActHeatPwr: implementation-data-type=uint8
        CAN4_FrntPTCRiBusLineC: implementation-data-type=uint8
        CAN4_FrntPTCRiCoreOverTFlt: implementation-data-type=uint8
        CAN4_FrntPTCRiCoreT: implementation-data-type=uint8
        CAN4_FrntPTCRiCoreTSnsrFlt: implementation-data-type=uint8
        CAN4_FrntPTCRiIGBTOverTFlt: implementation-data-type=uint8
        CAN4_FrntPTCRiIGBTShoCircFlt: implementation-data-type=uint8
        CAN4_FrntPTCRiIGBTT: implementation-data-type=uint8
        CAN4_FrntPTCRiIGBTTSnsrFlt: implementation-data-type=uint8
        CAN4_FrntPTCRiOpentCircFlt: implementation-data-type=uint8
        CAN4_FrntPTCRiOverAFlt: implementation-data-type=uint8
        CAN4_FrntPTCSWVers: implementation-data-type=uint8
        CAN4_FrntPTCSts: implementation-data-type=uint8
        CAN4_FrntPTCSupplierCod: implementation-data-type=uint8
    DT_CAN4_SG_zGW_CANFr1
      44 x element, all with category=TYPE_REFERENCE:
        CAN4_COMP_ActualPwr: implementation-data-type=uint16
        CAN4_COMP_ComLost: implementation-data-type=uint8
        CAN4_COMP_ConCur: implementation-data-type=uint16
        CAN4_COMP_ConVolt: implementation-data-type=uint16
        CAN4_COMP_CtrlCircFlt: implementation-data-type=uint8
        CAN4_COMP_CurOverProtect: implementation-data-type=uint8
        CAN4_COMP_CurVaild: implementation-data-type=uint8
        CAN4_COMP_IPM_HWFLt: implementation-data-type=uint8
        CAN4_COMP_IPM_TempOverFlt: implementation-data-type=uint8
        CAN4_COMP_Init: implementation-data-type=uint8
        CAN4_COMP_SpdVaild: implementation-data-type=uint8
        CAN4_COMP_Sta: implementation-data-type=uint8
        CAN4_COMP_StatorSpd: implementation-data-type=uint16
        CAN4_COMP_VoltLessErr: implementation-data-type=uint8
        CAN4_COMP_VoltOverErr: implementation-data-type=uint8
        CAN4_COMP_VoltVaild: implementation-data-type=uint8
        CAN4_EAC_DrvVoltFalt: implementation-data-type=uint8
        CAN4_EAC_MotCrt: implementation-data-type=uint8
        CAN4_EAC_MotorLackFalt: implementation-data-type=uint8
        CAN4_EAC_OvLoadFalt: implementation-data-type=uint8
        CAN4_EAC_Temp: implementation-data-type=uint8
        CAN4_EAC_TempSnsrFalt: implementation-data-type=uint8
        CAN4_PTC1_PowerConsumption: implementation-data-type=uint8
        CAN4_PTCActuCrntHSC6: implementation-data-type=uint16
        CAN4_PTCActuPWMDutyHSC6: implementation-data-type=uint8
        CAN4_PTCActuPwrHSC6: implementation-data-type=uint16
        CAN4_PTCActuVolHSC6: implementation-data-type=uint16
        CAN4_PTCChksmHSC6: implementation-data-type=uint8
        CAN4_PTCFltLvlHSC6: implementation-data-type=uint8
        CAN4_PTCHVLckStsHSC6: implementation-data-type=uint8
        CAN4_PTCIGBTOverHeatHSC6: implementation-data-type=uint8
        CAN4_PTCIGBTStsHSC6: implementation-data-type=uint8
        CAN4_PTCIGBTTemHSC6: implementation-data-type=uint16
        CAN4_PTCNTCStsHSC6: implementation-data-type=uint8
        CAN4_PTCOtptTemHSC6: implementation-data-type=uint16
        CAN4_PTCOverCrntHSC6: implementation-data-type=uint8
        CAN4_PTCOverHeatHSC6: implementation-data-type=uint8
        CAN4_PTCOverVolHSC6: implementation-data-type=uint8
        CAN4_PTCPCBTemHSC6: implementation-data-type=uint16
        CAN4_PTCRlngCtrHSC6: implementation-data-type=uint8
        CAN4_PTCSecChksmHSC6: implementation-data-type=uint8
        CAN4_PTCSecRlngCtrHSC6: implementation-data-type=uint8
        CAN4_PTCStsHSC6: implementation-data-type=uint8
        CAN4_PTCUnderVolHSC6: implementation-data-type=uint8
    DT_CAN4_SG_zGW_LINDr1
      103 x element, all with category=TYPE_REFERENCE:
        CAN4_CSW_DimSw: implementation-data-type=uint8
        CAN4_CSW_FWasSw_Sta: implementation-data-type=uint8
        CAN4_CSW_FWipSw_Sta: implementation-data-type=uint8
        CAN4_CSW_HW_version: implementation-data-type=uint16
        CAN4_CSW_PassSW_Sta: implementation-data-type=uint8
        CAN4_CSW_RWasSW_Sta: implementation-data-type=uint8
        CAN4_CSW_RWipIntSw_Sta: implementation-data-type=uint8
        CAN4_CSW_SW_version: implementation-data-type=uint16
        CAN4_CSW_TurnSw_Sta: implementation-data-type=uint8
        CAN4_CSW_resp_error: implementation-data-type=uint8
        CAN4_FAPWL_01_LIN_Response_Error: implementation-data-type=uint8
        CAN4_L_Drv_Motor_Relay_Error: implementation-data-type=uint8
        CAN4_L_Drv_Motor_Ripple_Error: implementation-data-type=uint8
        CAN4_L_Drv_OverHeat_Protect: implementation-data-type=uint8
        CAN4_L_Drv_Val_Wdw_Opened: implementation-data-type=uint8
        CAN4_L_Drv_Wdw_Init: implementation-data-type=uint8
        CAN4_L_Drv_Wdw_LocalSwitch: implementation-data-type=uint8
        CAN4_L_Drv_Wdw_OD_Sts: implementation-data-type=uint8
        CAN4_L_Drv_Wdw_Obs_InhibitSts: implementation-data-type=uint8
        CAN4_L_Drv_Wdw_Pas_Switch: implementation-data-type=uint8
        CAN4_L_Drv_Wdw_PositionSts: implementation-data-type=uint8
        CAN4_L_Drv_Wdw_RLD_Switch: implementation-data-type=uint8
        CAN4_L_Drv_Wdw_RRD_Switch: implementation-data-type=uint8
        CAN4_L_Drv_Wdw_Running_Sts: implementation-data-type=uint8
        CAN4_L_Pas_Motor_Relay_Error: implementation-data-type=uint8
        CAN4_L_Pas_Motor_Ripple_Error: implementation-data-type=uint8
        CAN4_L_Pas_OverHeat_Protect: implementation-data-type=uint8
        CAN4_L_Pas_Val_Wdw_Opened: implementation-data-type=uint8
        CAN4_L_Pas_Wdw_Init: implementation-data-type=uint8
        CAN4_L_Pas_Wdw_LocalSwitch: implementation-data-type=uint8
        CAN4_L_Pas_Wdw_OD_Sts: implementation-data-type=uint8
        CAN4_L_Pas_Wdw_Obs_InhibitSts: implementation-data-type=uint8
        CAN4_L_Pas_Wdw_PositionSts: implementation-data-type=uint8
        CAN4_L_Pas_Wdw_Running_Sts: implementation-data-type=uint8
        CAN4_L_Power_Status: implementation-data-type=uint8
        CAN4_L_RLD_Motor_Relay_Error: implementation-data-type=uint8
        CAN4_L_RLD_Motor_Ripple_Error: implementation-data-type=uint8
        CAN4_L_RLD_OverHeat_Protect: implementation-data-type=uint8
        CAN4_L_RLD_Val_Wdw_Opened: implementation-data-type=uint8
        CAN4_L_RLD_Wdw_Init: implementation-data-type=uint8
        CAN4_L_RLD_Wdw_LocalSwitch: implementation-data-type=uint8
        CAN4_L_RLD_Wdw_OD_Sts: implementation-data-type=uint8
        CAN4_L_RLD_Wdw_Obs_InhibitSts: implementation-data-type=uint8
        CAN4_L_RLD_Wdw_PositionSts: implementation-data-type=uint8
        CAN4_L_RLD_Wdw_Running_Sts: implementation-data-type=uint8
        CAN4_L_RRD_Motor_Relay_Error: implementation-data-type=uint8
        CAN4_L_RRD_Motor_Ripple_Error: implementation-data-type=uint8
        CAN4_L_RRD_OverHeat_Protect: implementation-data-type=uint8
        CAN4_L_RRD_Val_Wdw_Opened: implementation-data-type=uint8
        CAN4_L_RRD_Wdw_Init: implementation-data-type=uint8
        CAN4_L_RRD_Wdw_LocalSwitch: implementation-data-type=uint8
        CAN4_L_RRD_Wdw_OD_Sts: implementation-data-type=uint8
        CAN4_L_RRD_Wdw_Obs_InhibitSts: implementation-data-type=uint8
        CAN4_L_RRD_Wdw_PositionSts: implementation-data-type=uint8
        CAN4_L_RRD_Wdw_Running_Sts: implementation-data-type=uint8
        CAN4_RAPWL_01_LIN_Response_Error: implementation-data-type=uint8
        CAN4_RLS_LIN_Resp_Err: implementation-data-type=uint8
        CAN4_RLS_Lamp_Sta: implementation-data-type=uint8
        CAN4_RLS_LightSnrErr: implementation-data-type=uint8
        CAN4_RLS_RainSnrErr: implementation-data-type=uint8
        CAN4_RLS_RainSnrWiperCmd: implementation-data-type=uint8
        CAN4_SWC2_HW_Version: implementation-data-type=uint16
        CAN4_SWC2_L_ADAS_Sta: implementation-data-type=uint8
        CAN4_SWC2_L_DriveMode_Sta: implementation-data-type=uint8
        CAN4_SWC2_L_Home_Sta: implementation-data-type=uint8
        CAN4_SWC2_L_Left_Sta: implementation-data-type=uint8
        CAN4_SWC2_L_RegenUp_Sta: implementation-data-type=uint8
        CAN4_SWC2_L_Right_Sta: implementation-data-type=uint8
        CAN4_SWC2_L_ScrollDown_Sta: implementation-data-type=uint8
        CAN4_SWC2_L_ScrollPress_Sta: implementation-data-type=uint8
        CAN4_SWC2_L_ScrollUp_Sta: implementation-data-type=uint8
        CAN4_SWC2_R_Customize_Sta: implementation-data-type=uint8
        CAN4_SWC2_R_Left_Sta: implementation-data-type=uint8
        CAN4_SWC2_R_PageSwitch_Sta: implementation-data-type=uint8
        CAN4_SWC2_R_RegenDown_Sta: implementation-data-type=uint8
        CAN4_SWC2_R_Right_Sta: implementation-data-type=uint8
        CAN4_SWC2_R_ScrollDown_Sta: implementation-data-type=uint8
        CAN4_SWC2_R_ScrollPress_Sta: implementation-data-type=uint8
        CAN4_SWC2_R_ScrollUp_Sta: implementation-data-type=uint8
        CAN4_SWC2_R_VR_Sta: implementation-data-type=uint8
        CAN4_SWC2_ResponseError: implementation-data-type=uint8
        CAN4_SWC2_SW_Version: implementation-data-type=uint16
        CAN4_SWC_ACC_Sta: implementation-data-type=uint8
        CAN4_SWC_A_HW_version: implementation-data-type=uint16
        CAN4_SWC_A_Resp_Err: implementation-data-type=uint8
        CAN4_SWC_A_SW_version: implementation-data-type=uint16
        CAN4_SWC_CANCEL_Sta: implementation-data-type=uint8
        CAN4_SWC_Distance_Sta: implementation-data-type=uint8
        CAN4_SWC_Down_Sta: implementation-data-type=uint8
        CAN4_SWC_Drivemode_Sta: implementation-data-type=uint8
        CAN4_SWC_LKA_Sta: implementation-data-type=uint8
        CAN4_SWC_Left_Sta: implementation-data-type=uint8
        CAN4_SWC_RegenDown: implementation-data-type=uint8
        CAN4_SWC_RegenUp: implementation-data-type=uint8
        CAN4_SWC_Res_Up_Sta: implementation-data-type=uint8
        CAN4_SWC_Right_Sta: implementation-data-type=uint8
        CAN4_SWC_Set_down_Sta: implementation-data-type=uint8
        CAN4_SWC_Trip_Sta: implementation-data-type=uint8
        CAN4_SWC_Undefined_Sta: implementation-data-type=uint8
        CAN4_SWC_Up_Sta: implementation-data-type=uint8
        CAN4_SWC_VR_Sta: implementation-data-type=uint8
        CAN4_SWC_mode_Sta: implementation-data-type=uint8
        CAN4_SWC_resp_error: implementation-data-type=uint8
