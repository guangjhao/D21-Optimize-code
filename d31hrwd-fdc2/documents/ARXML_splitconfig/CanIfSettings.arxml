AUTOSAR XML (schema 4-0-3)
package /CanIf
  module config CanIf: implementation-config-variant=VARIANT-POST-BUILD
    CanIfCtrlDrvCfg: CanIfCtrlDrvTxCancellation=0, CanIfCtrlDrvInitHohConfigRef=CanIfInitHohCfg, CanIfCtrlDrvNameRef=CanGeneral
      8 x CanIfCtrlCfg, all with CanIfCtrlMaxRxNotifyPdus=64, CanIfCtrlMaxTxNotifyPdus=64, CanIfCtrlWakeupSupport=0:
        CAN1: CanIfCtrlCanCtrlRef=CAN1
        CAN2: CanIfCtrlCanCtrlRef=CAN2
        CAN3: CanIfCtrlId=2, CanIfCtrlCanCtrlRef=CAN3
        CAN4: CanIfCtrlId=3, CanIfCtrlCanCtrlRef=CAN4
        CAN5: CanIfCtrlId=4, CanIfCtrlCanCtrlRef=CAN5
        CAN6: CanIfCtrlCanCtrlRef=CAN6
        CAN7: CanIfCtrlCanCtrlRef=CAN7
        Can8_Xcp: CanIfCtrlCanCtrlRef=CAN_XCP
    CanIfDecoupledMeasurementSupport:
      CanIfNumberOfEnqueuedRxPdusApiName = 
      CanIfNumberOfEnqueuedTxPdusApiName = 
      CanIfNumberOfRxPdusExceedingQueueApiName = 
      CanIfNumberOfTxPdusExceedingQueueApiName = 
      CanIfRxDecoupledMeasurementSupport = 0
      CanIfTxDecoupledMeasurementSupport = 0
    CanIfDefensiveProgramming:
      CanIfDefProgEnabled = 0
      CanIfInvariantAssertEnabled = 0
      CanIfPostcondAssertEnabled = 0
      CanIfPrecondAssertEnabled = 0
      CanIfStaticAssertEnabled = 0
      CanIfUnreachAssertEnabled = 0
    CanIfDispatchCfg:
      CanIfDispatchUserConfirmPnAvailabilityName = (unset)
      CanIfDispatchUserConfirmPnAvailabilityUL = CAN_SM
      CanIfDispatchUserCtrlBusOffName = (unset)
      CanIfDispatchUserCtrlBusOffUL = CAN_SM
      CanIfDispatchUserCtrlModeIndicationName = (unset)
      CanIfDispatchUserCtrlModeIndicationUL = CAN_SM
      CanIfDispatchUserSetWakeupEventName = (unset)
      CanIfDispatchUserSetWakeupEventUL = ECUM
      CanIfDispatchUserTrcvModeIndicationName = (unset)
      CanIfDispatchUserTrcvModeIndicationUL = CAN_SM
      CanIfDispatchUserValidateWakeupEventName = (unset)
      CanIfDispatchUserValidateWakeupEventUL = (unset)
    CanIfHookOnRxSupport: CanIfHookOnReceptionFunctionName=(unset), CanIfHookOnReceptionHeader=(unset)
    CanIfInitCfg: CanIfInitCfgSet=
      8 x CanIfBufferCfg, all with CanIfBufferSize=0:
        HOH_0_Can8_Xcp: CanIfBufferHthRef=CanIfInitHohCfg/HOH_0_Can8_Xcp
        HOH_TX_0_CAN{1..7}: CanIfBufferHthRef=CanIfInitHohCfg/HOH_TX_0_CAN{1..7}
      CanIfInitHohCfg: CanIfInitRefCfgSet=CanConfigSet
        131 x CanIfHrhCfg, all with CanIfHrhSoftwareFilter=0:
          HOH_{1..13}_CAN1: CanIfHrhCanCtrlIdRef=CAN1, CanIfHrhIdSymRef=HOH_{1..13}_CAN1
          HOH_{1..11}_CAN2: CanIfHrhCanCtrlIdRef=CAN2, CanIfHrhIdSymRef=HOH_{1..11}_CAN2
          HOH_{1..46}_CAN3: CanIfHrhCanCtrlIdRef=CAN3, CanIfHrhIdSymRef=HOH_{1..46}_CAN3
          HOH_{1..46}_CAN4: CanIfHrhCanCtrlIdRef=CAN4, CanIfHrhIdSymRef=HOH_{1..46}_CAN4
          HOH_{1..6}_CAN5: CanIfHrhCanCtrlIdRef=CAN5, CanIfHrhIdSymRef=HOH_{1..6}_CAN5
          HOH_{1..9}_CAN6: CanIfHrhCanCtrlIdRef=CAN6, CanIfHrhIdSymRef=HOH_{1..9}_CAN6
        HOH_0_Can8_Xcp (CanIfHthCfg): CanIfHthCanCtrlIdRef=Can8_Xcp, CanIfHthIdSymRef=HOH_0_Can8_Xcp
        HOH_1_Can8_Xcp (CanIfHrhCfg): CanIfHrhSoftwareFilter=0, CanIfHrhCanCtrlIdRef=Can8_Xcp, CanIfHrhIdSymRef=HOH_1_Can8_Xcp
        7 x CanIfHthCfg:
          HOH_TX_0_CAN{1..7}: CanIfHthCanCtrlIdRef=CAN{1..7}, CanIfHthIdSymRef=HOH_TX_0_CAN{1..7}
        7 x CanIfHrhCfg, all with CanIfHrhSoftwareFilter=0:
          HOH_TX_LOGGING_CAN{1..7}: CanIfHrhCanCtrlIdRef=CAN{1..7}, CanIfHrhIdSymRef=HOH_TX_LOGGING_CAN{1..7}
      65 x CanIfRxPduCfg, all with CanIfRxPduCanIdMask=536870911, CanIfRxPduReadData=0, CanIfRxPduReadNotifyStatus=0, CanIfRxPduUserRxIndicationName=, CanIfRxPduBswSchExclAreaIdRef=(unset):
        CAN1_ABM1_515R: CanIfRxPduCanId=515, CanIfRxPduCanIdType=STANDARD_FD_CAN, CanIfRxPduDlc=8, CanIfRxPduTargetPduID=(unset), CanIfRxPduUserRxIndicationUL=PDUR, CanIfRxPduId=0, CanIfRxPduHrhIdRef=HOH_7_CAN1, CanIfRxPduRef=CAN1_ABM1_515R, CanIfRxPduUpperLayerRef=(unset)
          CanIfTTRxFrameTriggering: CanIfTTRxHwObjectTriggerIdRef=(unset)
        CAN1_EPB1_427R: CanIfRxPduCanId=427, CanIfRxPduCanIdType=STANDARD_FD_CAN, CanIfRxPduDlc=8, CanIfRxPduTargetPduID=(unset), CanIfRxPduUserRxIndicationUL=PDUR, CanIfRxPduId=1, CanIfRxPduHrhIdRef=HOH_6_CAN1, CanIfRxPduRef=CAN1_EPB1_427R, CanIfRxPduUpperLayerRef=(unset)
          CanIfTTRxFrameTriggering: CanIfTTRxHwObjectTriggerIdRef=(unset)
        CAN1_EPS1_391R: CanIfRxPduCanId=391, CanIfRxPduCanIdType=STANDARD_FD_CAN, CanIfRxPduDlc=16, CanIfRxPduTargetPduID=(unset), CanIfRxPduUserRxIndicationUL=PDUR, CanIfRxPduId=2, CanIfRxPduHrhIdRef=HOH_4_CAN1, CanIfRxPduRef=CAN1_EPS1_391R, CanIfRxPduUpperLayerRef=(unset)
          CanIfTTRxFrameTriggering: CanIfTTRxHwObjectTriggerIdRef=(unset)
        CAN1_ESC1_338R: CanIfRxPduCanId=338, CanIfRxPduCanIdType=STANDARD_FD_CAN, CanIfRxPduDlc=32, CanIfRxPduTargetPduID=(unset), CanIfRxPduUserRxIndicationUL=PDUR, CanIfRxPduId=3, CanIfRxPduHrhIdRef=HOH_2_CAN1, CanIfRxPduRef=CAN1_ESC1_338R, CanIfRxPduUpperLayerRef=(unset)
          CanIfTTRxFrameTriggering: CanIfTTRxHwObjectTriggerIdRef=(unset)
        CAN1_ESC5_421R: CanIfRxPduCanId=421, CanIfRxPduCanIdType=STANDARD_FD_CAN, CanIfRxPduDlc=20, CanIfRxPduTargetPduID=(unset), CanIfRxPduUserRxIndicationUL=PDUR, CanIfRxPduId=4, CanIfRxPduHrhIdRef=HOH_5_CAN1, CanIfRxPduRef=CAN1_ESC5_421R, CanIfRxPduUpperLayerRef=(unset)
          CanIfTTRxFrameTriggering: CanIfTTRxHwObjectTriggerIdRef=(unset)
        CAN1_eBST1_360R: CanIfRxPduCanId=360, CanIfRxPduCanIdType=STANDARD_FD_CAN, CanIfRxPduDlc=8, CanIfRxPduTargetPduID=(unset), CanIfRxPduUserRxIndicationUL=PDUR, CanIfRxPduId=5, CanIfRxPduHrhIdRef=HOH_3_CAN1, CanIfRxPduRef=CAN1_eBST1_360R, CanIfRxPduUpperLayerRef=(unset)
          CanIfTTRxFrameTriggering: CanIfTTRxHwObjectTriggerIdRef=(unset)
        CAN2_HMI1_1169R: CanIfRxPduCanId=1169, CanIfRxPduCanIdType=STANDARD_FD_CAN, CanIfRxPduDlc=8, CanIfRxPduTargetPduID=(unset), CanIfRxPduUserRxIndicationUL=PDUR, CanIfRxPduId=6, CanIfRxPduHrhIdRef=HOH_4_CAN2, CanIfRxPduRef=CAN2_HMI1_1169R, CanIfRxPduUpperLayerRef=(unset)
          CanIfTTRxFrameTriggering: CanIfTTRxHwObjectTriggerIdRef=(unset)
        CAN2_IVI1_1168R: CanIfRxPduCanId=1168, CanIfRxPduCanIdType=STANDARD_FD_CAN, CanIfRxPduDlc=20, CanIfRxPduTargetPduID=(unset), CanIfRxPduUserRxIndicationUL=PDUR, CanIfRxPduId=7, CanIfRxPduHrhIdRef=HOH_3_CAN2, CanIfRxPduRef=CAN2_IVI1_1168R, CanIfRxPduUpperLayerRef=(unset)
          CanIfTTRxFrameTriggering: CanIfTTRxHwObjectTriggerIdRef=(unset)
        CAN2_IVI2_1173R: CanIfRxPduCanId=1173, CanIfRxPduCanIdType=STANDARD_FD_CAN, CanIfRxPduDlc=64, CanIfRxPduTargetPduID=(unset), CanIfRxPduUserRxIndicationUL=PDUR, CanIfRxPduId=8, CanIfRxPduHrhIdRef=HOH_5_CAN2, CanIfRxPduRef=CAN2_IVI2_1173R, CanIfRxPduUpperLayerRef=(unset)
          CanIfTTRxFrameTriggering: CanIfTTRxHwObjectTriggerIdRef=(unset)
        CAN2_IVI3_1175R: CanIfRxPduCanId=1175, CanIfRxPduCanIdType=STANDARD_FD_CAN, CanIfRxPduDlc=32, CanIfRxPduTargetPduID=(unset), CanIfRxPduUserRxIndicationUL=PDUR, CanIfRxPduId=9, CanIfRxPduHrhIdRef=HOH_6_CAN2, CanIfRxPduRef=CAN2_IVI3_1175R, CanIfRxPduUpperLayerRef=(unset)
          CanIfTTRxFrameTriggering: CanIfTTRxHwObjectTriggerIdRef=(unset)
        CAN2_METER1_602R: CanIfRxPduCanId=602, CanIfRxPduCanIdType=STANDARD_FD_CAN, CanIfRxPduDlc=24, CanIfRxPduTargetPduID=(unset), CanIfRxPduUserRxIndicationUL=PDUR, CanIfRxPduId=10, CanIfRxPduHrhIdRef=HOH_2_CAN2, CanIfRxPduRef=CAN2_METER1_602R, CanIfRxPduUpperLayerRef=(unset)
          CanIfTTRxFrameTriggering: CanIfTTRxHwObjectTriggerIdRef=(unset)
        CAN3_BMS1_369R: CanIfRxPduCanId=369, CanIfRxPduCanIdType=STANDARD_FD_CAN, CanIfRxPduDlc=16, CanIfRxPduTargetPduID=(unset), CanIfRxPduUserRxIndicationUL=PDUR, CanIfRxPduId=11, CanIfRxPduHrhIdRef=HOH_3_CAN3, CanIfRxPduRef=CAN3_BMS1_369R, CanIfRxPduUpperLayerRef=(unset)
          CanIfTTRxFrameTriggering: CanIfTTRxHwObjectTriggerIdRef=(unset)
        CAN3_BMS3_809R: CanIfRxPduCanId=809, CanIfRxPduCanIdType=STANDARD_FD_CAN, CanIfRxPduDlc=32, CanIfRxPduTargetPduID=(unset), CanIfRxPduUserRxIndicationUL=PDUR, CanIfRxPduId=12, CanIfRxPduHrhIdRef=HOH_28_CAN3, CanIfRxPduRef=CAN3_BMS3_809R, CanIfRxPduUpperLayerRef=(unset)
          CanIfTTRxFrameTriggering: CanIfTTRxHwObjectTriggerIdRef=(unset)
        CAN3_BMS4_992R: CanIfRxPduCanId=992, CanIfRxPduCanIdType=STANDARD_FD_CAN, CanIfRxPduDlc=48, CanIfRxPduTargetPduID=(unset), CanIfRxPduUserRxIndicationUL=PDUR, CanIfRxPduId=13, CanIfRxPduHrhIdRef=HOH_33_CAN3, CanIfRxPduRef=CAN3_BMS4_992R, CanIfRxPduUpperLayerRef=(unset)
          CanIfTTRxFrameTriggering: CanIfTTRxHwObjectTriggerIdRef=(unset)
        CAN3_BMS5_630R: CanIfRxPduCanId=630, CanIfRxPduCanIdType=STANDARD_FD_CAN, CanIfRxPduDlc=12, CanIfRxPduTargetPduID=(unset), CanIfRxPduUserRxIndicationUL=PDUR, CanIfRxPduId=14, CanIfRxPduHrhIdRef=HOH_26_CAN3, CanIfRxPduRef=CAN3_BMS5_630R, CanIfRxPduUpperLayerRef=(unset)
          CanIfTTRxFrameTriggering: CanIfTTRxHwObjectTriggerIdRef=(unset)
        CAN3_BMS6_378R: CanIfRxPduCanId=378, CanIfRxPduCanIdType=STANDARD_FD_CAN, CanIfRxPduDlc=12, CanIfRxPduTargetPduID=(unset), CanIfRxPduUserRxIndicationUL=PDUR, CanIfRxPduId=15, CanIfRxPduHrhIdRef=HOH_4_CAN3, CanIfRxPduRef=CAN3_BMS6_378R, CanIfRxPduUpperLayerRef=(unset)
          CanIfTTRxFrameTriggering: CanIfTTRxHwObjectTriggerIdRef=(unset)
        CAN3_BMS8_820R: CanIfRxPduCanId=820, CanIfRxPduCanIdType=STANDARD_FD_CAN, CanIfRxPduDlc=48, CanIfRxPduTargetPduID=(unset), CanIfRxPduUserRxIndicationUL=PDUR, CanIfRxPduId=16, CanIfRxPduHrhIdRef=HOH_29_CAN3, CanIfRxPduRef=CAN3_BMS8_820R, CanIfRxPduUpperLayerRef=(unset)
          CanIfTTRxFrameTriggering: CanIfTTRxHwObjectTriggerIdRef=(unset)
        CAN3_CCU1_389R: CanIfRxPduCanId=389, CanIfRxPduCanIdType=STANDARD_FD_CAN, CanIfRxPduDlc=12, CanIfRxPduTargetPduID=(unset), CanIfRxPduUserRxIndicationUL=PDUR, CanIfRxPduId=17, CanIfRxPduHrhIdRef=HOH_6_CAN3, CanIfRxPduRef=CAN3_CCU1_389R, CanIfRxPduUpperLayerRef=(unset)
          CanIfTTRxFrameTriggering: CanIfTTRxHwObjectTriggerIdRef=(unset)
        CAN3_CCU2_470R: CanIfRxPduCanId=470, CanIfRxPduCanIdType=STANDARD_FD_CAN, CanIfRxPduDlc=12, CanIfRxPduTargetPduID=(unset), CanIfRxPduUserRxIndicationUL=PDUR, CanIfRxPduId=18, CanIfRxPduHrhIdRef=HOH_17_CAN3, CanIfRxPduRef=CAN3_CCU2_470R, CanIfRxPduUpperLayerRef=(unset)
          CanIfTTRxFrameTriggering: CanIfTTRxHwObjectTriggerIdRef=(unset)
        CAN3_EBM1_634R: CanIfRxPduCanId=634, CanIfRxPduCanIdType=STANDARD_FD_CAN, CanIfRxPduDlc=8, CanIfRxPduTargetPduID=(unset), CanIfRxPduUserRxIndicationUL=PDUR, CanIfRxPduId=19, CanIfRxPduHrhIdRef=HOH_27_CAN3, CanIfRxPduRef=CAN3_EBM1_634R, CanIfRxPduUpperLayerRef=(unset)
          CanIfTTRxFrameTriggering: CanIfTTRxHwObjectTriggerIdRef=(unset)
        CAN3_MCU_B_F1_401R: CanIfRxPduCanId=401, CanIfRxPduCanIdType=STANDARD_FD_CAN, CanIfRxPduDlc=32, CanIfRxPduTargetPduID=(unset), CanIfRxPduUserRxIndicationUL=PDUR, CanIfRxPduId=20, CanIfRxPduHrhIdRef=HOH_8_CAN3, CanIfRxPduRef=CAN3_MCU_B_F1_401R, CanIfRxPduUpperLayerRef=(unset)
          CanIfTTRxFrameTriggering: CanIfTTRxHwObjectTriggerIdRef=(unset)
        CAN3_MCU_B_F2_404R: CanIfRxPduCanId=404, CanIfRxPduCanIdType=STANDARD_FD_CAN, CanIfRxPduDlc=16, CanIfRxPduTargetPduID=(unset), CanIfRxPduUserRxIndicationUL=PDUR, CanIfRxPduId=21, CanIfRxPduHrhIdRef=HOH_11_CAN3, CanIfRxPduRef=CAN3_MCU_B_F2_404R, CanIfRxPduUpperLayerRef=(unset)
          CanIfTTRxFrameTriggering: CanIfTTRxHwObjectTriggerIdRef=(unset)
        CAN3_MCU_B_R1_400R: CanIfRxPduCanId=400, CanIfRxPduCanIdType=STANDARD_FD_CAN, CanIfRxPduDlc=32, CanIfRxPduTargetPduID=(unset), CanIfRxPduUserRxIndicationUL=PDUR, CanIfRxPduId=22, CanIfRxPduHrhIdRef=HOH_7_CAN3, CanIfRxPduRef=CAN3_MCU_B_R1_400R, CanIfRxPduUpperLayerRef=(unset)
          CanIfTTRxFrameTriggering: CanIfTTRxHwObjectTriggerIdRef=(unset)
        CAN3_MCU_B_R2_403R: CanIfRxPduCanId=403, CanIfRxPduCanIdType=STANDARD_FD_CAN, CanIfRxPduDlc=16, CanIfRxPduTargetPduID=(unset), CanIfRxPduUserRxIndicationUL=PDUR, CanIfRxPduId=23, CanIfRxPduHrhIdRef=HOH_10_CAN3, CanIfRxPduRef=CAN3_MCU_B_R2_403R, CanIfRxPduUpperLayerRef=(unset)
          CanIfTTRxFrameTriggering: CanIfTTRxHwObjectTriggerIdRef=(unset)
        CAN3_MCU_N_F1_406R: CanIfRxPduCanId=406, CanIfRxPduCanIdType=STANDARD_FD_CAN, CanIfRxPduDlc=32, CanIfRxPduTargetPduID=(unset), CanIfRxPduUserRxIndicationUL=PDUR, CanIfRxPduId=24, CanIfRxPduHrhIdRef=HOH_12_CAN3, CanIfRxPduRef=CAN3_MCU_N_F1_406R, CanIfRxPduUpperLayerRef=(unset)
          CanIfTTRxFrameTriggering: CanIfTTRxHwObjectTriggerIdRef=(unset)
        CAN3_MCU_N_F2_408R: CanIfRxPduCanId=408, CanIfRxPduCanIdType=STANDARD_FD_CAN, CanIfRxPduDlc=12, CanIfRxPduTargetPduID=(unset), CanIfRxPduUserRxIndicationUL=PDUR, CanIfRxPduId=25, CanIfRxPduHrhIdRef=HOH_13_CAN3, CanIfRxPduRef=CAN3_MCU_N_F2_408R, CanIfRxPduUpperLayerRef=(unset)
          CanIfTTRxFrameTriggering: CanIfTTRxHwObjectTriggerIdRef=(unset)
        CAN3_MCU_N_F3_921R: CanIfRxPduCanId=921, CanIfRxPduCanIdType=STANDARD_FD_CAN, CanIfRxPduDlc=8, CanIfRxPduTargetPduID=(unset), CanIfRxPduUserRxIndicationUL=PDUR, CanIfRxPduId=26, CanIfRxPduHrhIdRef=HOH_31_CAN3, CanIfRxPduRef=CAN3_MCU_N_F3_921R, CanIfRxPduUpperLayerRef=(unset)
          CanIfTTRxFrameTriggering: CanIfTTRxHwObjectTriggerIdRef=(unset)
        CAN3_MCU_N_R1_402R: CanIfRxPduCanId=402, CanIfRxPduCanIdType=STANDARD_FD_CAN, CanIfRxPduDlc=32, CanIfRxPduTargetPduID=(unset), CanIfRxPduUserRxIndicationUL=PDUR, CanIfRxPduId=27, CanIfRxPduHrhIdRef=HOH_9_CAN3, CanIfRxPduRef=CAN3_MCU_N_R1_402R, CanIfRxPduUpperLayerRef=(unset)
          CanIfTTRxFrameTriggering: CanIfTTRxHwObjectTriggerIdRef=(unset)
        CAN3_MCU_N_R2_412R: CanIfRxPduCanId=412, CanIfRxPduCanIdType=STANDARD_FD_CAN, CanIfRxPduDlc=12, CanIfRxPduTargetPduID=(unset), CanIfRxPduUserRxIndicationUL=PDUR, CanIfRxPduId=28, CanIfRxPduHrhIdRef=HOH_16_CAN3, CanIfRxPduRef=CAN3_MCU_N_R2_412R, CanIfRxPduUpperLayerRef=(unset)
          CanIfTTRxFrameTriggering: CanIfTTRxHwObjectTriggerIdRef=(unset)
        CAN3_MCU_N_R3_925R: CanIfRxPduCanId=925, CanIfRxPduCanIdType=STANDARD_FD_CAN, CanIfRxPduDlc=8, CanIfRxPduTargetPduID=(unset), CanIfRxPduUserRxIndicationUL=PDUR, CanIfRxPduId=29, CanIfRxPduHrhIdRef=HOH_32_CAN3, CanIfRxPduRef=CAN3_MCU_N_R3_925R, CanIfRxPduUpperLayerRef=(unset)
          CanIfTTRxFrameTriggering: CanIfTTRxHwObjectTriggerIdRef=(unset)
        CAN3_Shifter1_385R: CanIfRxPduCanId=385, CanIfRxPduCanIdType=STANDARD_FD_CAN, CanIfRxPduDlc=8, CanIfRxPduTargetPduID=(unset), CanIfRxPduUserRxIndicationUL=PDUR, CanIfRxPduId=30, CanIfRxPduHrhIdRef=HOH_5_CAN3, CanIfRxPduRef=CAN3_Shifter1_385R, CanIfRxPduUpperLayerRef=(unset)
          CanIfTTRxFrameTriggering: CanIfTTRxHwObjectTriggerIdRef=(unset)
        CAN3_Shifter2_368R: CanIfRxPduCanId=368, CanIfRxPduCanIdType=STANDARD_FD_CAN, CanIfRxPduDlc=8, CanIfRxPduTargetPduID=(unset), CanIfRxPduUserRxIndicationUL=PDUR, CanIfRxPduId=31, CanIfRxPduHrhIdRef=HOH_2_CAN3, CanIfRxPduRef=CAN3_Shifter2_368R, CanIfRxPduUpperLayerRef=(unset)
          CanIfTTRxFrameTriggering: CanIfTTRxHwObjectTriggerIdRef=(unset)
        CAN4_BodyZone_DR1_858R: CanIfRxPduCanId=858, CanIfRxPduCanIdType=STANDARD_FD_CAN, CanIfRxPduDlc=12, CanIfRxPduTargetPduID=(unset), CanIfRxPduUserRxIndicationUL=PDUR, CanIfRxPduId=32, CanIfRxPduHrhIdRef=HOH_17_CAN4, CanIfRxPduRef=CAN4_BodyZone_DR1_858R, CanIfRxPduUpperLayerRef=(unset)
          CanIfTTRxFrameTriggering: CanIfTTRxHwObjectTriggerIdRef=(unset)
        CAN4_BodyZone_DR2_794R: CanIfRxPduCanId=794, CanIfRxPduCanIdType=STANDARD_FD_CAN, CanIfRxPduDlc=8, CanIfRxPduTargetPduID=(unset), CanIfRxPduUserRxIndicationUL=PDUR, CanIfRxPduId=33, CanIfRxPduHrhIdRef=HOH_11_CAN4, CanIfRxPduRef=CAN4_BodyZone_DR2_794R, CanIfRxPduUpperLayerRef=(unset)
          CanIfTTRxFrameTriggering: CanIfTTRxHwObjectTriggerIdRef=(unset)
        CAN4_BodyZone_PS1_859R: CanIfRxPduCanId=859, CanIfRxPduCanIdType=STANDARD_FD_CAN, CanIfRxPduDlc=32, CanIfRxPduTargetPduID=(unset), CanIfRxPduUserRxIndicationUL=PDUR, CanIfRxPduId=34, CanIfRxPduHrhIdRef=HOH_18_CAN4, CanIfRxPduRef=CAN4_BodyZone_PS1_859R, CanIfRxPduUpperLayerRef=(unset)
          CanIfTTRxFrameTriggering: CanIfTTRxHwObjectTriggerIdRef=(unset)
        CAN4_BodyZone_PS2_795R: CanIfRxPduCanId=795, CanIfRxPduCanIdType=STANDARD_FD_CAN, CanIfRxPduDlc=8, CanIfRxPduTargetPduID=(unset), CanIfRxPduUserRxIndicationUL=PDUR, CanIfRxPduId=35, CanIfRxPduHrhIdRef=HOH_12_CAN4, CanIfRxPduRef=CAN4_BodyZone_PS2_795R, CanIfRxPduUpperLayerRef=(unset)
          CanIfTTRxFrameTriggering: CanIfTTRxHwObjectTriggerIdRef=(unset)
        CAN4_DKC1_593R: CanIfRxPduCanId=593, CanIfRxPduCanIdType=STANDARD_FD_CAN, CanIfRxPduDlc=8, CanIfRxPduTargetPduID=(unset), CanIfRxPduUserRxIndicationUL=PDUR, CanIfRxPduId=36, CanIfRxPduHrhIdRef=HOH_7_CAN4, CanIfRxPduRef=CAN4_DKC1_593R, CanIfRxPduUpperLayerRef=(unset)
          CanIfTTRxFrameTriggering: CanIfTTRxHwObjectTriggerIdRef=(unset)
        CAN4_DKC2_594R: CanIfRxPduCanId=594, CanIfRxPduCanIdType=STANDARD_FD_CAN, CanIfRxPduDlc=24, CanIfRxPduTargetPduID=(unset), CanIfRxPduUserRxIndicationUL=PDUR, CanIfRxPduId=37, CanIfRxPduHrhIdRef=HOH_8_CAN4, CanIfRxPduRef=CAN4_DKC2_594R, CanIfRxPduUpperLayerRef=(unset)
          CanIfTTRxFrameTriggering: CanIfTTRxHwObjectTriggerIdRef=(unset)
        CAN4_PTG1_881R: CanIfRxPduCanId=881, CanIfRxPduCanIdType=STANDARD_NO_FD_CAN, CanIfRxPduDlc=8, CanIfRxPduTargetPduID=(unset), CanIfRxPduUserRxIndicationUL=PDUR, CanIfRxPduId=38, CanIfRxPduHrhIdRef=HOH_19_CAN4, CanIfRxPduRef=CAN4_PTG1_881R, CanIfRxPduUpperLayerRef=(unset)
          CanIfTTRxFrameTriggering: CanIfTTRxHwObjectTriggerIdRef=(unset)
        CAN4_ZONE_DR1_805R: CanIfRxPduCanId=805, CanIfRxPduCanIdType=STANDARD_FD_CAN, CanIfRxPduDlc=48, CanIfRxPduTargetPduID=(unset), CanIfRxPduUserRxIndicationUL=PDUR, CanIfRxPduId=39, CanIfRxPduHrhIdRef=HOH_15_CAN4, CanIfRxPduRef=CAN4_ZONE_DR1_805R, CanIfRxPduUpperLayerRef=(unset)
          CanIfTTRxFrameTriggering: CanIfTTRxHwObjectTriggerIdRef=(unset)
        CAN4_ZONE_DR_VCU_497R: CanIfRxPduCanId=497, CanIfRxPduCanIdType=STANDARD_FD_CAN, CanIfRxPduDlc=48, CanIfRxPduTargetPduID=(unset), CanIfRxPduUserRxIndicationUL=PDUR, CanIfRxPduId=40, CanIfRxPduHrhIdRef=HOH_2_CAN4, CanIfRxPduRef=CAN4_ZONE_DR_VCU_497R, CanIfRxPduUpperLayerRef=(unset)
          CanIfTTRxFrameTriggering: CanIfTTRxHwObjectTriggerIdRef=(unset)
        CAN4_ZONE_FR1_796R: CanIfRxPduCanId=796, CanIfRxPduCanIdType=STANDARD_FD_CAN, CanIfRxPduDlc=64, CanIfRxPduTargetPduID=(unset), CanIfRxPduUserRxIndicationUL=PDUR, CanIfRxPduId=41, CanIfRxPduHrhIdRef=HOH_13_CAN4, CanIfRxPduRef=CAN4_ZONE_FR1_796R, CanIfRxPduUpperLayerRef=(unset)
          CanIfTTRxFrameTriggering: CanIfTTRxHwObjectTriggerIdRef=(unset)
        CAN4_ZONE_FR_VCU_498R: CanIfRxPduCanId=498, CanIfRxPduCanIdType=STANDARD_FD_CAN, CanIfRxPduDlc=48, CanIfRxPduTargetPduID=(unset), CanIfRxPduUserRxIndicationUL=PDUR, CanIfRxPduId=42, CanIfRxPduHrhIdRef=HOH_3_CAN4, CanIfRxPduRef=CAN4_ZONE_FR_VCU_498R, CanIfRxPduUpperLayerRef=(unset)
          CanIfTTRxFrameTriggering: CanIfTTRxHwObjectTriggerIdRef=(unset)
        CAN4_zGW_APTC1_547R: CanIfRxPduCanId=547, CanIfRxPduCanIdType=STANDARD_FD_CAN, CanIfRxPduDlc=24, CanIfRxPduTargetPduID=(unset), CanIfRxPduUserRxIndicationUL=PDUR, CanIfRxPduId=43, CanIfRxPduHrhIdRef=HOH_4_CAN4, CanIfRxPduRef=CAN4_zGW_APTC1_547R, CanIfRxPduUpperLayerRef=(unset)
          CanIfTTRxFrameTriggering: CanIfTTRxHwObjectTriggerIdRef=(unset)
        CAN4_zGW_CANFr1_778R: CanIfRxPduCanId=778, CanIfRxPduCanIdType=STANDARD_FD_CAN, CanIfRxPduDlc=32, CanIfRxPduTargetPduID=(unset), CanIfRxPduUserRxIndicationUL=PDUR, CanIfRxPduId=44, CanIfRxPduHrhIdRef=HOH_10_CAN4, CanIfRxPduRef=CAN4_zGW_CANFr1_778R, CanIfRxPduUpperLayerRef=(unset)
          CanIfTTRxFrameTriggering: CanIfTTRxHwObjectTriggerIdRef=(unset)
        CAN4_zGW_LINDr1_550R: CanIfRxPduCanId=550, CanIfRxPduCanIdType=STANDARD_FD_CAN, CanIfRxPduDlc=32, CanIfRxPduTargetPduID=(unset), CanIfRxPduUserRxIndicationUL=PDUR, CanIfRxPduId=45, CanIfRxPduHrhIdRef=HOH_5_CAN4, CanIfRxPduRef=CAN4_zGW_LINDr1_550R, CanIfRxPduUpperLayerRef=(unset)
          CanIfTTRxFrameTriggering: CanIfTTRxHwObjectTriggerIdRef=(unset)
        CAN4_zGW_LINDr2_804R: CanIfRxPduCanId=804, CanIfRxPduCanIdType=STANDARD_FD_CAN, CanIfRxPduDlc=48, CanIfRxPduTargetPduID=(unset), CanIfRxPduUserRxIndicationUL=PDUR, CanIfRxPduId=46, CanIfRxPduHrhIdRef=HOH_14_CAN4, CanIfRxPduRef=CAN4_zGW_LINDr2_804R, CanIfRxPduUpperLayerRef=(unset)
          CanIfTTRxFrameTriggering: CanIfTTRxHwObjectTriggerIdRef=(unset)
        CAN4_zGW_LINFr1_552R: CanIfRxPduCanId=552, CanIfRxPduCanIdType=STANDARD_FD_CAN, CanIfRxPduDlc=32, CanIfRxPduTargetPduID=(unset), CanIfRxPduUserRxIndicationUL=PDUR, CanIfRxPduId=47, CanIfRxPduHrhIdRef=HOH_6_CAN4, CanIfRxPduRef=CAN4_zGW_LINFr1_552R, CanIfRxPduUpperLayerRef=(unset)
          CanIfTTRxFrameTriggering: CanIfTTRxHwObjectTriggerIdRef=(unset)
        CAN4_zGW_LINFr2_596R: CanIfRxPduCanId=596, CanIfRxPduCanIdType=STANDARD_FD_CAN, CanIfRxPduDlc=32, CanIfRxPduTargetPduID=(unset), CanIfRxPduUserRxIndicationUL=PDUR, CanIfRxPduId=48, CanIfRxPduHrhIdRef=HOH_9_CAN4, CanIfRxPduRef=CAN4_zGW_LINFr2_596R, CanIfRxPduUpperLayerRef=(unset)
          CanIfTTRxFrameTriggering: CanIfTTRxHwObjectTriggerIdRef=(unset)
        CAN4_zGW_SEAT1_854R: CanIfRxPduCanId=854, CanIfRxPduCanIdType=STANDARD_FD_CAN, CanIfRxPduDlc=16, CanIfRxPduTargetPduID=(unset), CanIfRxPduUserRxIndicationUL=PDUR, CanIfRxPduId=49, CanIfRxPduHrhIdRef=HOH_16_CAN4, CanIfRxPduRef=CAN4_zGW_SEAT1_854R, CanIfRxPduUpperLayerRef=(unset)
          CanIfTTRxFrameTriggering: CanIfTTRxHwObjectTriggerIdRef=(unset)
        CAN5_TBOX1_1090R: CanIfRxPduCanId=1090, CanIfRxPduCanIdType=STANDARD_FD_CAN, CanIfRxPduDlc=12, CanIfRxPduTargetPduID=(unset), CanIfRxPduUserRxIndicationUL=PDUR, CanIfRxPduId=50, CanIfRxPduHrhIdRef=HOH_2_CAN5, CanIfRxPduRef=CAN5_TBOX1_1090R, CanIfRxPduUpperLayerRef=(unset)
          CanIfTTRxFrameTriggering: CanIfTTRxHwObjectTriggerIdRef=(unset)
        CAN5_TBOX2_1174R: CanIfRxPduCanId=1174, CanIfRxPduCanIdType=STANDARD_FD_CAN, CanIfRxPduDlc=8, CanIfRxPduTargetPduID=(unset), CanIfRxPduUserRxIndicationUL=PDUR, CanIfRxPduId=51, CanIfRxPduHrhIdRef=HOH_3_CAN5, CanIfRxPduRef=CAN5_TBOX2_1174R, CanIfRxPduUpperLayerRef=(unset)
          CanIfTTRxFrameTriggering: CanIfTTRxHwObjectTriggerIdRef=(unset)
        CAN5_TBOX3_1249R: CanIfRxPduCanId=1249, CanIfRxPduCanIdType=STANDARD_FD_CAN, CanIfRxPduDlc=24, CanIfRxPduTargetPduID=(unset), CanIfRxPduUserRxIndicationUL=PDUR, CanIfRxPduId=52, CanIfRxPduHrhIdRef=HOH_5_CAN5, CanIfRxPduRef=CAN5_TBOX3_1249R, CanIfRxPduUpperLayerRef=(unset)
          CanIfTTRxFrameTriggering: CanIfTTRxHwObjectTriggerIdRef=(unset)
        CAN6_FCM1_371R: CanIfRxPduCanId=371, CanIfRxPduCanIdType=STANDARD_FD_CAN, CanIfRxPduDlc=32, CanIfRxPduTargetPduID=(unset), CanIfRxPduUserRxIndicationUL=PDUR, CanIfRxPduId=53, CanIfRxPduHrhIdRef=HOH_2_CAN6, CanIfRxPduRef=CAN6_FCM1_371R, CanIfRxPduUpperLayerRef=(unset)
          CanIfTTRxFrameTriggering: CanIfTTRxHwObjectTriggerIdRef=(unset)
        CAN6_FCM2_376R: CanIfRxPduCanId=376, CanIfRxPduCanIdType=STANDARD_FD_CAN, CanIfRxPduDlc=32, CanIfRxPduTargetPduID=(unset), CanIfRxPduUserRxIndicationUL=PDUR, CanIfRxPduId=54, CanIfRxPduHrhIdRef=HOH_4_CAN6, CanIfRxPduRef=CAN6_FCM2_376R, CanIfRxPduUpperLayerRef=(unset)
          CanIfTTRxFrameTriggering: CanIfTTRxHwObjectTriggerIdRef=(unset)
        CAN6_FCM3_377R: CanIfRxPduCanId=377, CanIfRxPduCanIdType=STANDARD_FD_CAN, CanIfRxPduDlc=32, CanIfRxPduTargetPduID=(unset), CanIfRxPduUserRxIndicationUL=PDUR, CanIfRxPduId=55, CanIfRxPduHrhIdRef=HOH_5_CAN6, CanIfRxPduRef=CAN6_FCM3_377R, CanIfRxPduUpperLayerRef=(unset)
          CanIfTTRxFrameTriggering: CanIfTTRxHwObjectTriggerIdRef=(unset)
        CAN6_FCM4_375R: CanIfRxPduCanId=375, CanIfRxPduCanIdType=STANDARD_FD_CAN, CanIfRxPduDlc=32, CanIfRxPduTargetPduID=(unset), CanIfRxPduUserRxIndicationUL=PDUR, CanIfRxPduId=56, CanIfRxPduHrhIdRef=HOH_3_CAN6, CanIfRxPduRef=CAN6_FCM4_375R, CanIfRxPduUpperLayerRef=(unset)
          CanIfTTRxFrameTriggering: CanIfTTRxHwObjectTriggerIdRef=(unset)
        CAN6_SRR1_517R: CanIfRxPduCanId=517, CanIfRxPduCanIdType=STANDARD_FD_CAN, CanIfRxPduDlc=8, CanIfRxPduTargetPduID=(unset), CanIfRxPduUserRxIndicationUL=PDUR, CanIfRxPduId=57, CanIfRxPduHrhIdRef=HOH_6_CAN6, CanIfRxPduRef=CAN6_SRR1_517R, CanIfRxPduUpperLayerRef=(unset)
          CanIfTTRxFrameTriggering: CanIfTTRxHwObjectTriggerIdRef=(unset)
        CAN1_NMm_FUSION_RX_1280R: CanIfRxPduCanId=0, CanIfRxPduCanIdType=STANDARD_NO_FD_CAN, CanIfRxPduDlc=8, CanIfRxPduTargetPduID=(unset), CanIfRxPduUserRxIndicationUL=CAN_NM, CanIfRxPduId=58, CanIfRxPduHrhIdRef=HOH_1_CAN1, CanIfRxPduRef=CAN1_NMm_FUSION_RX_1280R, CanIfRxPduUpperLayerRef=(unset)
          CanIfRxPduCanIdRange: CanIfRxPduCanIdRangeLowerCanId=1280, CanIfRxPduCanIdRangeUpperCanId=1408
          CanIfTTRxFrameTriggering: CanIfTTRxHwObjectTriggerIdRef=(unset)
        CAN2_NMm_FUSION_RX_1280R: CanIfRxPduCanId=0, CanIfRxPduCanIdType=STANDARD_NO_FD_CAN, CanIfRxPduDlc=8, CanIfRxPduTargetPduID=(unset), CanIfRxPduUserRxIndicationUL=CAN_NM, CanIfRxPduId=59, CanIfRxPduHrhIdRef=HOH_1_CAN2, CanIfRxPduRef=CAN2_NMm_FUSION_RX_1280R, CanIfRxPduUpperLayerRef=(unset)
          CanIfRxPduCanIdRange: CanIfRxPduCanIdRangeLowerCanId=1280, CanIfRxPduCanIdRangeUpperCanId=1408
          CanIfTTRxFrameTriggering: CanIfTTRxHwObjectTriggerIdRef=(unset)
        CAN3_NMm_FUSION_RX_1280R: CanIfRxPduCanId=0, CanIfRxPduCanIdType=STANDARD_NO_FD_CAN, CanIfRxPduDlc=8, CanIfRxPduTargetPduID=(unset), CanIfRxPduUserRxIndicationUL=CAN_NM, CanIfRxPduId=60, CanIfRxPduHrhIdRef=HOH_1_CAN3, CanIfRxPduRef=CAN3_NMm_FUSION_RX_1280R, CanIfRxPduUpperLayerRef=(unset)
          CanIfRxPduCanIdRange: CanIfRxPduCanIdRangeLowerCanId=1280, CanIfRxPduCanIdRangeUpperCanId=1408
          CanIfTTRxFrameTriggering: CanIfTTRxHwObjectTriggerIdRef=(unset)
        CAN4_NMm_FUSION_RX_1280R: CanIfRxPduCanId=0, CanIfRxPduCanIdType=STANDARD_NO_FD_CAN, CanIfRxPduDlc=8, CanIfRxPduTargetPduID=(unset), CanIfRxPduUserRxIndicationUL=CAN_NM, CanIfRxPduId=61, CanIfRxPduHrhIdRef=HOH_1_CAN4, CanIfRxPduRef=CAN4_NMm_FUSION_RX_1280R, CanIfRxPduUpperLayerRef=(unset)
          CanIfRxPduCanIdRange: CanIfRxPduCanIdRangeLowerCanId=1280, CanIfRxPduCanIdRangeUpperCanId=1408
          CanIfTTRxFrameTriggering: CanIfTTRxHwObjectTriggerIdRef=(unset)
        CAN5_NMm_FUSION_RX_1280R: CanIfRxPduCanId=0, CanIfRxPduCanIdType=STANDARD_NO_FD_CAN, CanIfRxPduDlc=8, CanIfRxPduTargetPduID=(unset), CanIfRxPduUserRxIndicationUL=CAN_NM, CanIfRxPduId=62, CanIfRxPduHrhIdRef=HOH_1_CAN5, CanIfRxPduRef=CAN5_NMm_FUSION_RX_1280R, CanIfRxPduUpperLayerRef=(unset)
          CanIfRxPduCanIdRange: CanIfRxPduCanIdRangeLowerCanId=1280, CanIfRxPduCanIdRangeUpperCanId=1408
          CanIfTTRxFrameTriggering: CanIfTTRxHwObjectTriggerIdRef=(unset)
        CAN6_NMm_FUSION_RX_1280R: CanIfRxPduCanId=0, CanIfRxPduCanIdType=STANDARD_NO_FD_CAN, CanIfRxPduDlc=8, CanIfRxPduTargetPduID=(unset), CanIfRxPduUserRxIndicationUL=CAN_NM, CanIfRxPduId=63, CanIfRxPduHrhIdRef=HOH_1_CAN6, CanIfRxPduRef=CAN6_NMm_FUSION_RX_1280R, CanIfRxPduUpperLayerRef=(unset)
          CanIfRxPduCanIdRange: CanIfRxPduCanIdRangeLowerCanId=1280, CanIfRxPduCanIdRangeUpperCanId=1408
          CanIfTTRxFrameTriggering: CanIfTTRxHwObjectTriggerIdRef=(unset)
        XCP_1639R: CanIfRxPduCanId=1639, CanIfRxPduCanIdType=STANDARD_CAN, CanIfRxPduDlc=0, CanIfRxPduTargetPduID=0, CanIfRxPduUserRxIndicationUL=CDD, CanIfRxPduId=64, CanIfRxPduHrhIdRef=HOH_1_Can8_Xcp, CanIfRxPduRef=XCP_1639R, CanIfRxPduUpperLayerRef=XCP
          CanIfTTRxFrameTriggering: CanIfTTRxHwObjectTriggerIdRef=(unset)
      122 x CanIfTxPduCfg, all with CanIfTxPduCanIdMask=536870911, CanIfTxPduPnFilterPdu=0, CanIfTxPduReadNotifyStatus=0, CanIfTxPduTruncateToFrame=1, CanIfTxPduTruncation=1, CanIfTxPduType=STATIC, CanIfTxPduUserTxConfirmationName=, CanIfTxPduBswSchExclAreaIdRef=(unset):
        CAN1_DiagFuncReqFT_2000T: CanIfTxPduCanId=2000, CanIfTxPduCanIdType=STANDARD_CAN, CanIfTxPduDlc=8, CanIfTxPduSourcePduID=0, CanIfTxPduUserTxConfirmationUL=CDD, CanIfTxPduBufferRef=CanIfInitCfg/HOH_TX_0_CAN1, CanIfTxPduRef=CAN1_DiagFuncReqFT_2000T, CanIfTxPduUpperLayerRef=CAN_PASS
          CanIfTTTxFrameTriggering: CanIfTTTxHwObjectTriggerIdRef=(unset)
        CAN1_DiagFuncReqOBD_2015T: CanIfTxPduCanId=2015, CanIfTxPduCanIdType=STANDARD_FD_CAN, CanIfTxPduDlc=8, CanIfTxPduSourcePduID=1, CanIfTxPduUserTxConfirmationUL=CDD, CanIfTxPduBufferRef=CanIfInitCfg/HOH_TX_0_CAN1, CanIfTxPduRef=CAN1_DiagFuncReqOBD_2015T, CanIfTxPduUpperLayerRef=CAN_PASS
          CanIfTTTxFrameTriggering: CanIfTTTxHwObjectTriggerIdRef=(unset)
        CAN1_DiagPhysReqToABM_1713T: CanIfTxPduCanId=1713, CanIfTxPduCanIdType=STANDARD_FD_CAN, CanIfTxPduDlc=8, CanIfTxPduSourcePduID=2, CanIfTxPduUserTxConfirmationUL=CDD, CanIfTxPduBufferRef=CanIfInitCfg/HOH_TX_0_CAN1, CanIfTxPduRef=CAN1_DiagPhysReqToABM_1713T, CanIfTxPduUpperLayerRef=CAN_PASS
          CanIfTTTxFrameTriggering: CanIfTTTxHwObjectTriggerIdRef=(unset)
        CAN1_DiagPhysReqToEPS_1697T: CanIfTxPduCanId=1697, CanIfTxPduCanIdType=STANDARD_FD_CAN, CanIfTxPduDlc=8, CanIfTxPduSourcePduID=3, CanIfTxPduUserTxConfirmationUL=CDD, CanIfTxPduBufferRef=CanIfInitCfg/HOH_TX_0_CAN1, CanIfTxPduRef=CAN1_DiagPhysReqToEPS_1697T, CanIfTxPduUpperLayerRef=CAN_PASS
          CanIfTTTxFrameTriggering: CanIfTTTxHwObjectTriggerIdRef=(unset)
        CAN1_DiagPhysReqToESC_1665T: CanIfTxPduCanId=1665, CanIfTxPduCanIdType=STANDARD_CAN, CanIfTxPduDlc=8, CanIfTxPduSourcePduID=4, CanIfTxPduUserTxConfirmationUL=CDD, CanIfTxPduBufferRef=CanIfInitCfg/HOH_TX_0_CAN1, CanIfTxPduRef=CAN1_DiagPhysReqToESC_1665T, CanIfTxPduUpperLayerRef=CAN_PASS
          CanIfTTTxFrameTriggering: CanIfTTTxHwObjectTriggerIdRef=(unset)
        CAN1_DiagPhysReqToOCS_1698T: CanIfTxPduCanId=1698, CanIfTxPduCanIdType=STANDARD_FD_CAN, CanIfTxPduDlc=64, CanIfTxPduSourcePduID=5, CanIfTxPduUserTxConfirmationUL=CDD, CanIfTxPduBufferRef=CanIfInitCfg/HOH_TX_0_CAN1, CanIfTxPduRef=CAN1_DiagPhysReqToOCS_1698T, CanIfTxPduUpperLayerRef=CAN_PASS
          CanIfTTTxFrameTriggering: CanIfTTTxHwObjectTriggerIdRef=(unset)
        CAN1_DiagPhysReqToScrap_2033T: CanIfTxPduCanId=2033, CanIfTxPduCanIdType=STANDARD_FD_CAN, CanIfTxPduDlc=8, CanIfTxPduSourcePduID=6, CanIfTxPduUserTxConfirmationUL=CDD, CanIfTxPduBufferRef=CanIfInitCfg/HOH_TX_0_CAN1, CanIfTxPduRef=CAN1_DiagPhysReqToScrap_2033T, CanIfTxPduUpperLayerRef=CAN_PASS
          CanIfTTTxFrameTriggering: CanIfTTTxHwObjectTriggerIdRef=(unset)
        CAN1_DiagPhysReqToeBST_1681T: CanIfTxPduCanId=1681, CanIfTxPduCanIdType=STANDARD_CAN, CanIfTxPduDlc=8, CanIfTxPduSourcePduID=7, CanIfTxPduUserTxConfirmationUL=CDD, CanIfTxPduBufferRef=CanIfInitCfg/HOH_TX_0_CAN1, CanIfTxPduRef=CAN1_DiagPhysReqToeBST_1681T, CanIfTxPduUpperLayerRef=CAN_PASS
          CanIfTTTxFrameTriggering: CanIfTTTxHwObjectTriggerIdRef=(unset)
        CAN1_FD1_APS2_528T: CanIfTxPduCanId=528, CanIfTxPduCanIdType=STANDARD_FD_CAN, CanIfTxPduDlc=32, CanIfTxPduSourcePduID=(unset), CanIfTxPduUserTxConfirmationUL=PDUR, CanIfTxPduBufferRef=CanIfInitCfg/HOH_TX_0_CAN1, CanIfTxPduRef=CAN1_FD1_APS2_528T, CanIfTxPduUpperLayerRef=(unset)
          CanIfTTTxFrameTriggering: CanIfTTTxHwObjectTriggerIdRef=(unset)
        CAN1_FD1_APS3_568T: CanIfTxPduCanId=568, CanIfTxPduCanIdType=STANDARD_FD_CAN, CanIfTxPduDlc=16, CanIfTxPduSourcePduID=(unset), CanIfTxPduUserTxConfirmationUL=PDUR, CanIfTxPduBufferRef=CanIfInitCfg/HOH_TX_0_CAN1, CanIfTxPduRef=CAN1_FD1_APS3_568T, CanIfTxPduUpperLayerRef=(unset)
          CanIfTTTxFrameTriggering: CanIfTTTxHwObjectTriggerIdRef=(unset)
        CAN1_FD1_BCM1_534T: CanIfTxPduCanId=534, CanIfTxPduCanIdType=STANDARD_FD_CAN, CanIfTxPduDlc=16, CanIfTxPduSourcePduID=(unset), CanIfTxPduUserTxConfirmationUL=PDUR, CanIfTxPduBufferRef=CanIfInitCfg/HOH_TX_0_CAN1, CanIfTxPduRef=CAN1_FD1_BCM1_534T, CanIfTxPduUpperLayerRef=(unset)
          CanIfTTTxFrameTriggering: CanIfTTTxHwObjectTriggerIdRef=(unset)
        CAN1_FD1_THCM1_386T: CanIfTxPduCanId=386, CanIfTxPduCanIdType=STANDARD_FD_CAN, CanIfTxPduDlc=20, CanIfTxPduSourcePduID=(unset), CanIfTxPduUserTxConfirmationUL=PDUR, CanIfTxPduBufferRef=CanIfInitCfg/HOH_TX_0_CAN1, CanIfTxPduRef=CAN1_FD1_THCM1_386T, CanIfTxPduUpperLayerRef=(unset)
          CanIfTTTxFrameTriggering: CanIfTTTxHwObjectTriggerIdRef=(unset)
        CAN1_FD1_VCU1_278T: CanIfTxPduCanId=278, CanIfTxPduCanIdType=STANDARD_FD_CAN, CanIfTxPduDlc=12, CanIfTxPduSourcePduID=(unset), CanIfTxPduUserTxConfirmationUL=PDUR, CanIfTxPduBufferRef=CanIfInitCfg/HOH_TX_0_CAN1, CanIfTxPduRef=CAN1_FD1_VCU1_278T, CanIfTxPduUpperLayerRef=(unset)
          CanIfTTTxFrameTriggering: CanIfTTTxHwObjectTriggerIdRef=(unset)
        CAN1_FD1_VCU2_340T: CanIfTxPduCanId=340, CanIfTxPduCanIdType=STANDARD_FD_CAN, CanIfTxPduDlc=16, CanIfTxPduSourcePduID=(unset), CanIfTxPduUserTxConfirmationUL=PDUR, CanIfTxPduBufferRef=CanIfInitCfg/HOH_TX_0_CAN1, CanIfTxPduRef=CAN1_FD1_VCU2_340T, CanIfTxPduUpperLayerRef=(unset)
          CanIfTTTxFrameTriggering: CanIfTTTxHwObjectTriggerIdRef=(unset)
        CAN1_FD1_VCU3_345T: CanIfTxPduCanId=345, CanIfTxPduCanIdType=STANDARD_FD_CAN, CanIfTxPduDlc=20, CanIfTxPduSourcePduID=(unset), CanIfTxPduUserTxConfirmationUL=PDUR, CanIfTxPduBufferRef=CanIfInitCfg/HOH_TX_0_CAN1, CanIfTxPduRef=CAN1_FD1_VCU3_345T, CanIfTxPduUpperLayerRef=(unset)
          CanIfTTTxFrameTriggering: CanIfTTTxHwObjectTriggerIdRef=(unset)
        CAN1_FD1_VMC1_383T: CanIfTxPduCanId=383, CanIfTxPduCanIdType=STANDARD_FD_CAN, CanIfTxPduDlc=24, CanIfTxPduSourcePduID=(unset), CanIfTxPduUserTxConfirmationUL=PDUR, CanIfTxPduBufferRef=CanIfInitCfg/HOH_TX_0_CAN1, CanIfTxPduRef=CAN1_FD1_VMC1_383T, CanIfTxPduUpperLayerRef=(unset)
          CanIfTTTxFrameTriggering: CanIfTTTxHwObjectTriggerIdRef=(unset)
        CAN1_FD1_VMC2_119T: CanIfTxPduCanId=119, CanIfTxPduCanIdType=STANDARD_FD_CAN, CanIfTxPduDlc=32, CanIfTxPduSourcePduID=(unset), CanIfTxPduUserTxConfirmationUL=PDUR, CanIfTxPduBufferRef=CanIfInitCfg/HOH_TX_0_CAN1, CanIfTxPduRef=CAN1_FD1_VMC2_119T, CanIfTxPduUpperLayerRef=(unset)
          CanIfTTTxFrameTriggering: CanIfTTTxHwObjectTriggerIdRef=(unset)
        CAN1_GW1_CE100_0_575T: CanIfTxPduCanId=575, CanIfTxPduCanIdType=STANDARD_FD_CAN, CanIfTxPduDlc=32, CanIfTxPduSourcePduID=(unset), CanIfTxPduUserTxConfirmationUL=PDUR, CanIfTxPduBufferRef=CanIfInitCfg/HOH_TX_0_CAN1, CanIfTxPduRef=CAN1_GW1_CE100_0_575T, CanIfTxPduUpperLayerRef=(unset)
          CanIfTTTxFrameTriggering: CanIfTTTxHwObjectTriggerIdRef=(unset)
        CAN1_GW1_CE200_0_1173T: CanIfTxPduCanId=1173, CanIfTxPduCanIdType=STANDARD_FD_CAN, CanIfTxPduDlc=64, CanIfTxPduSourcePduID=(unset), CanIfTxPduUserTxConfirmationUL=PDUR, CanIfTxPduBufferRef=CanIfInitCfg/HOH_TX_0_CAN1, CanIfTxPduRef=CAN1_GW1_CE200_0_1173T, CanIfTxPduUpperLayerRef=(unset)
          CanIfTTTxFrameTriggering: CanIfTTTxHwObjectTriggerIdRef=(unset)
        CAN1_NMm_FUSION_TX_1280T: CanIfTxPduCanId=1280, CanIfTxPduCanIdType=STANDARD_CAN, CanIfTxPduDlc=8, CanIfTxPduSourcePduID=(unset), CanIfTxPduUserTxConfirmationUL=CAN_NM, CanIfTxPduBufferRef=CanIfInitCfg/HOH_TX_0_CAN1, CanIfTxPduRef=CAN1_NMm_FUSION_TX_1280T, CanIfTxPduUpperLayerRef=(unset)
          CanIfTTTxFrameTriggering: CanIfTTTxHwObjectTriggerIdRef=(unset)
        CAN1_VMC_FCM1_370T: CanIfTxPduCanId=370, CanIfTxPduCanIdType=STANDARD_FD_CAN, CanIfTxPduDlc=32, CanIfTxPduSourcePduID=(unset), CanIfTxPduUserTxConfirmationUL=PDUR, CanIfTxPduBufferRef=CanIfInitCfg/HOH_TX_0_CAN1, CanIfTxPduRef=CAN1_VMC_FCM1_370T, CanIfTxPduUpperLayerRef=(unset)
          CanIfTTTxFrameTriggering: CanIfTTTxHwObjectTriggerIdRef=(unset)
        CAN2_DiagFuncReqFT_2000T: CanIfTxPduCanId=2000, CanIfTxPduCanIdType=STANDARD_FD_CAN, CanIfTxPduDlc=8, CanIfTxPduSourcePduID=8, CanIfTxPduUserTxConfirmationUL=CDD, CanIfTxPduBufferRef=CanIfInitCfg/HOH_TX_0_CAN2, CanIfTxPduRef=CAN2_DiagFuncReqFT_2000T, CanIfTxPduUpperLayerRef=CAN_PASS
          CanIfTTTxFrameTriggering: CanIfTTTxHwObjectTriggerIdRef=(unset)
        CAN2_DiagFuncReqOBD_2015T: CanIfTxPduCanId=2015, CanIfTxPduCanIdType=STANDARD_FD_CAN, CanIfTxPduDlc=8, CanIfTxPduSourcePduID=9, CanIfTxPduUserTxConfirmationUL=CDD, CanIfTxPduBufferRef=CanIfInitCfg/HOH_TX_0_CAN2, CanIfTxPduRef=CAN2_DiagFuncReqOBD_2015T, CanIfTxPduUpperLayerRef=CAN_PASS
          CanIfTTTxFrameTriggering: CanIfTTTxHwObjectTriggerIdRef=(unset)
        CAN2_DiagPhysReqToHMI_1714T: CanIfTxPduCanId=1714, CanIfTxPduCanIdType=STANDARD_FD_CAN, CanIfTxPduDlc=64, CanIfTxPduSourcePduID=10, CanIfTxPduUserTxConfirmationUL=CDD, CanIfTxPduBufferRef=CanIfInitCfg/HOH_TX_0_CAN2, CanIfTxPduRef=CAN2_DiagPhysReqToHMI_1714T, CanIfTxPduUpperLayerRef=CAN_PASS
          CanIfTTTxFrameTriggering: CanIfTTTxHwObjectTriggerIdRef=(unset)
        CAN2_DiagPhysReqToIVI_1696T: CanIfTxPduCanId=1696, CanIfTxPduCanIdType=STANDARD_FD_CAN, CanIfTxPduDlc=8, CanIfTxPduSourcePduID=11, CanIfTxPduUserTxConfirmationUL=CDD, CanIfTxPduBufferRef=CanIfInitCfg/HOH_TX_0_CAN2, CanIfTxPduRef=CAN2_DiagPhysReqToIVI_1696T, CanIfTxPduUpperLayerRef=CAN_PASS
          CanIfTTTxFrameTriggering: CanIfTTTxHwObjectTriggerIdRef=(unset)
        CAN2_DiagPhysReqToMeter_1666T: CanIfTxPduCanId=1666, CanIfTxPduCanIdType=STANDARD_FD_CAN, CanIfTxPduDlc=8, CanIfTxPduSourcePduID=12, CanIfTxPduUserTxConfirmationUL=CDD, CanIfTxPduBufferRef=CanIfInitCfg/HOH_TX_0_CAN2, CanIfTxPduRef=CAN2_DiagPhysReqToMeter_1666T, CanIfTxPduUpperLayerRef=CAN_PASS
          CanIfTTTxFrameTriggering: CanIfTTTxHwObjectTriggerIdRef=(unset)
        CAN2_DiagPhysReqToWCM_1687T: CanIfTxPduCanId=1687, CanIfTxPduCanIdType=STANDARD_FD_CAN, CanIfTxPduDlc=64, CanIfTxPduSourcePduID=13, CanIfTxPduUserTxConfirmationUL=CDD, CanIfTxPduBufferRef=CanIfInitCfg/HOH_TX_0_CAN2, CanIfTxPduRef=CAN2_DiagPhysReqToWCM_1687T, CanIfTxPduUpperLayerRef=CAN_PASS
          CanIfTTTxFrameTriggering: CanIfTTTxHwObjectTriggerIdRef=(unset)
        CAN2_FD2_C20_0_528T: CanIfTxPduCanId=528, CanIfTxPduCanIdType=STANDARD_FD_CAN, CanIfTxPduDlc=32, CanIfTxPduSourcePduID=(unset), CanIfTxPduUserTxConfirmationUL=PDUR, CanIfTxPduBufferRef=CanIfInitCfg/HOH_TX_0_CAN2, CanIfTxPduRef=CAN2_FD2_C20_0_528T, CanIfTxPduUpperLayerRef=(unset)
          CanIfTTTxFrameTriggering: CanIfTTTxHwObjectTriggerIdRef=(unset)
        CAN2_FD2_CE100_0_279T: CanIfTxPduCanId=279, CanIfTxPduCanIdType=STANDARD_FD_CAN, CanIfTxPduDlc=64, CanIfTxPduSourcePduID=(unset), CanIfTxPduUserTxConfirmationUL=PDUR, CanIfTxPduBufferRef=CanIfInitCfg/HOH_TX_0_CAN2, CanIfTxPduRef=CAN2_FD2_CE100_0_279T, CanIfTxPduUpperLayerRef=(unset)
          CanIfTTTxFrameTriggering: CanIfTTTxHwObjectTriggerIdRef=(unset)
        CAN2_FD2_CE200_1_1077T: CanIfTxPduCanId=1077, CanIfTxPduCanIdType=STANDARD_FD_CAN, CanIfTxPduDlc=32, CanIfTxPduSourcePduID=(unset), CanIfTxPduUserTxConfirmationUL=PDUR, CanIfTxPduBufferRef=CanIfInitCfg/HOH_TX_0_CAN2, CanIfTxPduRef=CAN2_FD2_CE200_1_1077T, CanIfTxPduUpperLayerRef=(unset)
          CanIfTTTxFrameTriggering: CanIfTTTxHwObjectTriggerIdRef=(unset)
        CAN2_FD2_OTA1_1080T: CanIfTxPduCanId=1080, CanIfTxPduCanIdType=STANDARD_FD_CAN, CanIfTxPduDlc=12, CanIfTxPduSourcePduID=(unset), CanIfTxPduUserTxConfirmationUL=PDUR, CanIfTxPduBufferRef=CanIfInitCfg/HOH_TX_0_CAN2, CanIfTxPduRef=CAN2_FD2_OTA1_1080T, CanIfTxPduUpperLayerRef=(unset)
          CanIfTTTxFrameTriggering: CanIfTTTxHwObjectTriggerIdRef=(unset)
        CAN2_FD2_Version_963T: CanIfTxPduCanId=963, CanIfTxPduCanIdType=STANDARD_FD_CAN, CanIfTxPduDlc=48, CanIfTxPduSourcePduID=(unset), CanIfTxPduUserTxConfirmationUL=PDUR, CanIfTxPduBufferRef=CanIfInitCfg/HOH_TX_0_CAN2, CanIfTxPduRef=CAN2_FD2_Version_963T, CanIfTxPduUpperLayerRef=(unset)
          CanIfTTTxFrameTriggering: CanIfTTTxHwObjectTriggerIdRef=(unset)
        CAN2_GW2_C10_0_435T: CanIfTxPduCanId=435, CanIfTxPduCanIdType=STANDARD_FD_CAN, CanIfTxPduDlc=32, CanIfTxPduSourcePduID=(unset), CanIfTxPduUserTxConfirmationUL=PDUR, CanIfTxPduBufferRef=CanIfInitCfg/HOH_TX_0_CAN2, CanIfTxPduRef=CAN2_GW2_C10_0_435T, CanIfTxPduUpperLayerRef=(unset)
          CanIfTTTxFrameTriggering: CanIfTTTxHwObjectTriggerIdRef=(unset)
        CAN2_GW2_CE1000_0_823T: CanIfTxPduCanId=823, CanIfTxPduCanIdType=STANDARD_FD_CAN, CanIfTxPduDlc=48, CanIfTxPduSourcePduID=(unset), CanIfTxPduUserTxConfirmationUL=PDUR, CanIfTxPduBufferRef=CanIfInitCfg/HOH_TX_0_CAN2, CanIfTxPduRef=CAN2_GW2_CE1000_0_823T, CanIfTxPduUpperLayerRef=(unset)
          CanIfTTTxFrameTriggering: CanIfTTTxHwObjectTriggerIdRef=(unset)
        CAN2_GW2_CE100_0_450T: CanIfTxPduCanId=450, CanIfTxPduCanIdType=STANDARD_FD_CAN, CanIfTxPduDlc=32, CanIfTxPduSourcePduID=(unset), CanIfTxPduUserTxConfirmationUL=PDUR, CanIfTxPduBufferRef=CanIfInitCfg/HOH_TX_0_CAN2, CanIfTxPduRef=CAN2_GW2_CE100_0_450T, CanIfTxPduUpperLayerRef=(unset)
          CanIfTTTxFrameTriggering: CanIfTTTxHwObjectTriggerIdRef=(unset)
        CAN2_GW2_CE100_1_855T: CanIfTxPduCanId=855, CanIfTxPduCanIdType=STANDARD_FD_CAN, CanIfTxPduDlc=32, CanIfTxPduSourcePduID=(unset), CanIfTxPduUserTxConfirmationUL=PDUR, CanIfTxPduBufferRef=CanIfInitCfg/HOH_TX_0_CAN2, CanIfTxPduRef=CAN2_GW2_CE100_1_855T, CanIfTxPduUpperLayerRef=(unset)
          CanIfTTTxFrameTriggering: CanIfTTTxHwObjectTriggerIdRef=(unset)
        CAN2_GW2_CE100_2_857T: CanIfTxPduCanId=857, CanIfTxPduCanIdType=STANDARD_FD_CAN, CanIfTxPduDlc=32, CanIfTxPduSourcePduID=(unset), CanIfTxPduUserTxConfirmationUL=PDUR, CanIfTxPduBufferRef=CanIfInitCfg/HOH_TX_0_CAN2, CanIfTxPduRef=CAN2_GW2_CE100_2_857T, CanIfTxPduUpperLayerRef=(unset)
          CanIfTTTxFrameTriggering: CanIfTTTxHwObjectTriggerIdRef=(unset)
        CAN2_GW2_CE200_0_372T: CanIfTxPduCanId=372, CanIfTxPduCanIdType=STANDARD_FD_CAN, CanIfTxPduDlc=32, CanIfTxPduSourcePduID=(unset), CanIfTxPduUserTxConfirmationUL=PDUR, CanIfTxPduBufferRef=CanIfInitCfg/HOH_TX_0_CAN2, CanIfTxPduRef=CAN2_GW2_CE200_0_372T, CanIfTxPduUpperLayerRef=(unset)
          CanIfTTTxFrameTriggering: CanIfTTTxHwObjectTriggerIdRef=(unset)
        CAN2_NMm_FUSION_TX_1280T: CanIfTxPduCanId=1280, CanIfTxPduCanIdType=STANDARD_CAN, CanIfTxPduDlc=8, CanIfTxPduSourcePduID=(unset), CanIfTxPduUserTxConfirmationUL=CAN_NM, CanIfTxPduBufferRef=CanIfInitCfg/HOH_TX_0_CAN2, CanIfTxPduRef=CAN2_NMm_FUSION_TX_1280T, CanIfTxPduUpperLayerRef=(unset)
          CanIfTTTxFrameTriggering: CanIfTTTxHwObjectTriggerIdRef=(unset)
        CAN3_DiagFuncReqFT_2000T: CanIfTxPduCanId=2000, CanIfTxPduCanIdType=STANDARD_FD_CAN, CanIfTxPduDlc=8, CanIfTxPduSourcePduID=14, CanIfTxPduUserTxConfirmationUL=CDD, CanIfTxPduBufferRef=CanIfInitCfg/HOH_TX_0_CAN3, CanIfTxPduRef=CAN3_DiagFuncReqFT_2000T, CanIfTxPduUpperLayerRef=CAN_PASS
          CanIfTTTxFrameTriggering: CanIfTTTxHwObjectTriggerIdRef=(unset)
        CAN3_DiagFuncReqOBD_2015T: CanIfTxPduCanId=2015, CanIfTxPduCanIdType=STANDARD_FD_CAN, CanIfTxPduDlc=8, CanIfTxPduSourcePduID=15, CanIfTxPduUserTxConfirmationUL=CDD, CanIfTxPduBufferRef=CanIfInitCfg/HOH_TX_0_CAN3, CanIfTxPduRef=CAN3_DiagFuncReqOBD_2015T, CanIfTxPduUpperLayerRef=CAN_PASS
          CanIfTTTxFrameTriggering: CanIfTTTxHwObjectTriggerIdRef=(unset)
        CAN3_DiagPhysReqToBMS_1712T: CanIfTxPduCanId=1712, CanIfTxPduCanIdType=STANDARD_FD_CAN, CanIfTxPduDlc=8, CanIfTxPduSourcePduID=16, CanIfTxPduUserTxConfirmationUL=CDD, CanIfTxPduBufferRef=CanIfInitCfg/HOH_TX_0_CAN3, CanIfTxPduRef=CAN3_DiagPhysReqToBMS_1712T, CanIfTxPduUpperLayerRef=CAN_PASS
          CanIfTTTxFrameTriggering: CanIfTTTxHwObjectTriggerIdRef=(unset)
        CAN3_DiagPhysReqToCCU_1715T: CanIfTxPduCanId=1715, CanIfTxPduCanIdType=STANDARD_FD_CAN, CanIfTxPduDlc=8, CanIfTxPduSourcePduID=17, CanIfTxPduUserTxConfirmationUL=CDD, CanIfTxPduBufferRef=CanIfInitCfg/HOH_TX_0_CAN3, CanIfTxPduRef=CAN3_DiagPhysReqToCCU_1715T, CanIfTxPduUpperLayerRef=CAN_PASS
          CanIfTTTxFrameTriggering: CanIfTTTxHwObjectTriggerIdRef=(unset)
        CAN3_DiagPhysReqToEBM_1699T: CanIfTxPduCanId=1699, CanIfTxPduCanIdType=STANDARD_FD_CAN, CanIfTxPduDlc=64, CanIfTxPduSourcePduID=18, CanIfTxPduUserTxConfirmationUL=CDD, CanIfTxPduBufferRef=CanIfInitCfg/HOH_TX_0_CAN3, CanIfTxPduRef=CAN3_DiagPhysReqToEBM_1699T, CanIfTxPduUpperLayerRef=CAN_PASS
          CanIfTTTxFrameTriggering: CanIfTTTxHwObjectTriggerIdRef=(unset)
        CAN3_DiagPhysReqToEOP_F_1688T: CanIfTxPduCanId=1688, CanIfTxPduCanIdType=STANDARD_FD_CAN, CanIfTxPduDlc=64, CanIfTxPduSourcePduID=19, CanIfTxPduUserTxConfirmationUL=CDD, CanIfTxPduBufferRef=CanIfInitCfg/HOH_TX_0_CAN3, CanIfTxPduRef=CAN3_DiagPhysReqToEOP_F_1688T, CanIfTxPduUpperLayerRef=CAN_PASS
          CanIfTTTxFrameTriggering: CanIfTTTxHwObjectTriggerIdRef=(unset)
        CAN3_DiagPhysReqToEOP_FVT_F_1732T: CanIfTxPduCanId=1732, CanIfTxPduCanIdType=STANDARD_FD_CAN, CanIfTxPduDlc=8, CanIfTxPduSourcePduID=20, CanIfTxPduUserTxConfirmationUL=CDD, CanIfTxPduBufferRef=CanIfInitCfg/HOH_TX_0_CAN3, CanIfTxPduRef=CAN3_DiagPhysReqToEOP_FVT_F_1732T, CanIfTxPduUpperLayerRef=CAN_PASS
          CanIfTTTxFrameTriggering: CanIfTTTxHwObjectTriggerIdRef=(unset)
        CAN3_DiagPhysReqToEOP_FVT_R_1731T: CanIfTxPduCanId=1731, CanIfTxPduCanIdType=STANDARD_FD_CAN, CanIfTxPduDlc=8, CanIfTxPduSourcePduID=21, CanIfTxPduUserTxConfirmationUL=CDD, CanIfTxPduBufferRef=CanIfInitCfg/HOH_TX_0_CAN3, CanIfTxPduRef=CAN3_DiagPhysReqToEOP_FVT_R_1731T, CanIfTxPduUpperLayerRef=CAN_PASS
          CanIfTTTxFrameTriggering: CanIfTTTxHwObjectTriggerIdRef=(unset)
        CAN3_DiagPhysReqToEOP_R_1683T: CanIfTxPduCanId=1683, CanIfTxPduCanIdType=STANDARD_FD_CAN, CanIfTxPduDlc=64, CanIfTxPduSourcePduID=22, CanIfTxPduUserTxConfirmationUL=CDD, CanIfTxPduBufferRef=CanIfInitCfg/HOH_TX_0_CAN3, CanIfTxPduRef=CAN3_DiagPhysReqToEOP_R_1683T, CanIfTxPduUpperLayerRef=CAN_PASS
          CanIfTTTxFrameTriggering: CanIfTTTxHwObjectTriggerIdRef=(unset)
        CAN3_DiagPhysReqToMCU_B_F_1674T: CanIfTxPduCanId=1674, CanIfTxPduCanIdType=STANDARD_FD_CAN, CanIfTxPduDlc=64, CanIfTxPduSourcePduID=23, CanIfTxPduUserTxConfirmationUL=CDD, CanIfTxPduBufferRef=CanIfInitCfg/HOH_TX_0_CAN3, CanIfTxPduRef=CAN3_DiagPhysReqToMCU_B_F_1674T, CanIfTxPduUpperLayerRef=CAN_PASS
          CanIfTTTxFrameTriggering: CanIfTTTxHwObjectTriggerIdRef=(unset)
        CAN3_DiagPhysReqToMCU_B_R_1673T: CanIfTxPduCanId=1673, CanIfTxPduCanIdType=STANDARD_FD_CAN, CanIfTxPduDlc=64, CanIfTxPduSourcePduID=24, CanIfTxPduUserTxConfirmationUL=CDD, CanIfTxPduBufferRef=CanIfInitCfg/HOH_TX_0_CAN3, CanIfTxPduRef=CAN3_DiagPhysReqToMCU_B_R_1673T, CanIfTxPduUpperLayerRef=CAN_PASS
          CanIfTTTxFrameTriggering: CanIfTTTxHwObjectTriggerIdRef=(unset)
        CAN3_DiagPhysReqToMCU_N_F_1672T: CanIfTxPduCanId=1672, CanIfTxPduCanIdType=STANDARD_FD_CAN, CanIfTxPduDlc=8, CanIfTxPduSourcePduID=25, CanIfTxPduUserTxConfirmationUL=CDD, CanIfTxPduBufferRef=CanIfInitCfg/HOH_TX_0_CAN3, CanIfTxPduRef=CAN3_DiagPhysReqToMCU_N_F_1672T, CanIfTxPduUpperLayerRef=CAN_PASS
          CanIfTTTxFrameTriggering: CanIfTTTxHwObjectTriggerIdRef=(unset)
        CAN3_DiagPhysReqToMCU_N_R_1667T: CanIfTxPduCanId=1667, CanIfTxPduCanIdType=STANDARD_FD_CAN, CanIfTxPduDlc=8, CanIfTxPduSourcePduID=26, CanIfTxPduUserTxConfirmationUL=CDD, CanIfTxPduBufferRef=CanIfInitCfg/HOH_TX_0_CAN3, CanIfTxPduRef=CAN3_DiagPhysReqToMCU_N_R_1667T, CanIfTxPduUpperLayerRef=CAN_PASS
          CanIfTTTxFrameTriggering: CanIfTTTxHwObjectTriggerIdRef=(unset)
        CAN3_DiagPhysReqToShifter_1720T: CanIfTxPduCanId=1720, CanIfTxPduCanIdType=STANDARD_FD_CAN, CanIfTxPduDlc=8, CanIfTxPduSourcePduID=27, CanIfTxPduUserTxConfirmationUL=CDD, CanIfTxPduBufferRef=CanIfInitCfg/HOH_TX_0_CAN3, CanIfTxPduRef=CAN3_DiagPhysReqToShifter_1720T, CanIfTxPduUpperLayerRef=CAN_PASS
          CanIfTTTxFrameTriggering: CanIfTTTxHwObjectTriggerIdRef=(unset)
        CAN3_FD3_BCM1_534T: CanIfTxPduCanId=534, CanIfTxPduCanIdType=STANDARD_FD_CAN, CanIfTxPduDlc=16, CanIfTxPduSourcePduID=(unset), CanIfTxPduUserTxConfirmationUL=PDUR, CanIfTxPduBufferRef=CanIfInitCfg/HOH_TX_0_CAN3, CanIfTxPduRef=CAN3_FD3_BCM1_534T, CanIfTxPduUpperLayerRef=(unset)
          CanIfTTTxFrameTriggering: CanIfTTTxHwObjectTriggerIdRef=(unset)
        CAN3_FD3_C100_0_386T: CanIfTxPduCanId=386, CanIfTxPduCanIdType=STANDARD_FD_CAN, CanIfTxPduDlc=20, CanIfTxPduSourcePduID=(unset), CanIfTxPduUserTxConfirmationUL=PDUR, CanIfTxPduBufferRef=CanIfInitCfg/HOH_TX_0_CAN3, CanIfTxPduRef=CAN3_FD3_C100_0_386T, CanIfTxPduUpperLayerRef=(unset)
          CanIfTTTxFrameTriggering: CanIfTTTxHwObjectTriggerIdRef=(unset)
        CAN3_FD3_OTA1_1080T: CanIfTxPduCanId=1080, CanIfTxPduCanIdType=STANDARD_FD_CAN, CanIfTxPduDlc=12, CanIfTxPduSourcePduID=(unset), CanIfTxPduUserTxConfirmationUL=PDUR, CanIfTxPduBufferRef=CanIfInitCfg/HOH_TX_0_CAN3, CanIfTxPduRef=CAN3_FD3_OTA1_1080T, CanIfTxPduUpperLayerRef=(unset)
          CanIfTTTxFrameTriggering: CanIfTTTxHwObjectTriggerIdRef=(unset)
        CAN3_FD3_V2L1_884T: CanIfTxPduCanId=884, CanIfTxPduCanIdType=STANDARD_FD_CAN, CanIfTxPduDlc=8, CanIfTxPduSourcePduID=(unset), CanIfTxPduUserTxConfirmationUL=PDUR, CanIfTxPduBufferRef=CanIfInitCfg/HOH_TX_0_CAN3, CanIfTxPduRef=CAN3_FD3_V2L1_884T, CanIfTxPduUpperLayerRef=(unset)
          CanIfTTTxFrameTriggering: CanIfTTTxHwObjectTriggerIdRef=(unset)
        CAN3_FD3_VCU0_496T: CanIfTxPduCanId=496, CanIfTxPduCanIdType=STANDARD_FD_CAN, CanIfTxPduDlc=64, CanIfTxPduSourcePduID=(unset), CanIfTxPduUserTxConfirmationUL=PDUR, CanIfTxPduBufferRef=CanIfInitCfg/HOH_TX_0_CAN3, CanIfTxPduRef=CAN3_FD3_VCU0_496T, CanIfTxPduUpperLayerRef=(unset)
          CanIfTTTxFrameTriggering: CanIfTTTxHwObjectTriggerIdRef=(unset)
        CAN3_FD3_VCU1_277T: CanIfTxPduCanId=277, CanIfTxPduCanIdType=STANDARD_FD_CAN, CanIfTxPduDlc=8, CanIfTxPduSourcePduID=(unset), CanIfTxPduUserTxConfirmationUL=PDUR, CanIfTxPduBufferRef=CanIfInitCfg/HOH_TX_0_CAN3, CanIfTxPduRef=CAN3_FD3_VCU1_277T, CanIfTxPduUpperLayerRef=(unset)
          CanIfTTTxFrameTriggering: CanIfTTTxHwObjectTriggerIdRef=(unset)
        CAN3_FD3_VCU1_toNIDEC_278T: CanIfTxPduCanId=278, CanIfTxPduCanIdType=STANDARD_FD_CAN, CanIfTxPduDlc=8, CanIfTxPduSourcePduID=(unset), CanIfTxPduUserTxConfirmationUL=PDUR, CanIfTxPduBufferRef=CanIfInitCfg/HOH_TX_0_CAN3, CanIfTxPduRef=CAN3_FD3_VCU1_toNIDEC_278T, CanIfTxPduUpperLayerRef=(unset)
          CanIfTTTxFrameTriggering: CanIfTTTxHwObjectTriggerIdRef=(unset)
        CAN3_FD3_VCU2_339T: CanIfTxPduCanId=339, CanIfTxPduCanIdType=STANDARD_FD_CAN, CanIfTxPduDlc=32, CanIfTxPduSourcePduID=(unset), CanIfTxPduUserTxConfirmationUL=PDUR, CanIfTxPduBufferRef=CanIfInitCfg/HOH_TX_0_CAN3, CanIfTxPduRef=CAN3_FD3_VCU2_339T, CanIfTxPduUpperLayerRef=(unset)
          CanIfTTTxFrameTriggering: CanIfTTTxHwObjectTriggerIdRef=(unset)
        CAN3_FD3_VCU2_toNIDEC_340T: CanIfTxPduCanId=340, CanIfTxPduCanIdType=STANDARD_FD_CAN, CanIfTxPduDlc=24, CanIfTxPduSourcePduID=(unset), CanIfTxPduUserTxConfirmationUL=PDUR, CanIfTxPduBufferRef=CanIfInitCfg/HOH_TX_0_CAN3, CanIfTxPduRef=CAN3_FD3_VCU2_toNIDEC_340T, CanIfTxPduUpperLayerRef=(unset)
          CanIfTTTxFrameTriggering: CanIfTTTxHwObjectTriggerIdRef=(unset)
        CAN3_FD3_VCU4_346T: CanIfTxPduCanId=346, CanIfTxPduCanIdType=STANDARD_FD_CAN, CanIfTxPduDlc=32, CanIfTxPduSourcePduID=(unset), CanIfTxPduUserTxConfirmationUL=PDUR, CanIfTxPduBufferRef=CanIfInitCfg/HOH_TX_0_CAN3, CanIfTxPduRef=CAN3_FD3_VCU4_346T, CanIfTxPduUpperLayerRef=(unset)
          CanIfTTTxFrameTriggering: CanIfTTTxHwObjectTriggerIdRef=(unset)
        CAN3_FD3_VCU5_341T: CanIfTxPduCanId=341, CanIfTxPduCanIdType=STANDARD_FD_CAN, CanIfTxPduDlc=32, CanIfTxPduSourcePduID=(unset), CanIfTxPduUserTxConfirmationUL=PDUR, CanIfTxPduBufferRef=CanIfInitCfg/HOH_TX_0_CAN3, CanIfTxPduRef=CAN3_FD3_VCU5_341T, CanIfTxPduUpperLayerRef=(unset)
          CanIfTTTxFrameTriggering: CanIfTTTxHwObjectTriggerIdRef=(unset)
        CAN3_GW3_CE100_0_451T: CanIfTxPduCanId=451, CanIfTxPduCanIdType=STANDARD_FD_CAN, CanIfTxPduDlc=32, CanIfTxPduSourcePduID=(unset), CanIfTxPduUserTxConfirmationUL=PDUR, CanIfTxPduBufferRef=CanIfInitCfg/HOH_TX_0_CAN3, CanIfTxPduRef=CAN3_GW3_CE100_0_451T, CanIfTxPduUpperLayerRef=(unset)
          CanIfTTTxFrameTriggering: CanIfTTTxHwObjectTriggerIdRef=(unset)
        CAN3_GW_ESC1_toNIDEC_338T: CanIfTxPduCanId=338, CanIfTxPduCanIdType=STANDARD_FD_CAN, CanIfTxPduDlc=8, CanIfTxPduSourcePduID=(unset), CanIfTxPduUserTxConfirmationUL=PDUR, CanIfTxPduBufferRef=CanIfInitCfg/HOH_TX_0_CAN3, CanIfTxPduRef=CAN3_GW_ESC1_toNIDEC_338T, CanIfTxPduUpperLayerRef=(unset)
          CanIfTTTxFrameTriggering: CanIfTTTxHwObjectTriggerIdRef=(unset)
        CAN3_GW_IVI6_toNIDEC_1183T: CanIfTxPduCanId=1183, CanIfTxPduCanIdType=STANDARD_FD_CAN, CanIfTxPduDlc=8, CanIfTxPduSourcePduID=(unset), CanIfTxPduUserTxConfirmationUL=PDUR, CanIfTxPduBufferRef=CanIfInitCfg/HOH_TX_0_CAN3, CanIfTxPduRef=CAN3_GW_IVI6_toNIDEC_1183T, CanIfTxPduUpperLayerRef=(unset)
          CanIfTTTxFrameTriggering: CanIfTTTxHwObjectTriggerIdRef=(unset)
        CAN3_NMm_FUSION_TX_1280T: CanIfTxPduCanId=1280, CanIfTxPduCanIdType=STANDARD_CAN, CanIfTxPduDlc=8, CanIfTxPduSourcePduID=(unset), CanIfTxPduUserTxConfirmationUL=CAN_NM, CanIfTxPduBufferRef=CanIfInitCfg/HOH_TX_0_CAN3, CanIfTxPduRef=CAN3_NMm_FUSION_TX_1280T, CanIfTxPduUpperLayerRef=(unset)
          CanIfTTTxFrameTriggering: CanIfTTTxHwObjectTriggerIdRef=(unset)
        CAN4_DiagFuncReqFT_2000T: CanIfTxPduCanId=2000, CanIfTxPduCanIdType=STANDARD_FD_CAN, CanIfTxPduDlc=8, CanIfTxPduSourcePduID=28, CanIfTxPduUserTxConfirmationUL=CDD, CanIfTxPduBufferRef=CanIfInitCfg/HOH_TX_0_CAN4, CanIfTxPduRef=CAN4_DiagFuncReqFT_2000T, CanIfTxPduUpperLayerRef=CAN_PASS
          CanIfTTTxFrameTriggering: CanIfTTTxHwObjectTriggerIdRef=(unset)
        CAN4_DiagFuncReqOBD_2015T: CanIfTxPduCanId=2015, CanIfTxPduCanIdType=STANDARD_FD_CAN, CanIfTxPduDlc=8, CanIfTxPduSourcePduID=29, CanIfTxPduUserTxConfirmationUL=CDD, CanIfTxPduBufferRef=CanIfInitCfg/HOH_TX_0_CAN4, CanIfTxPduRef=CAN4_DiagFuncReqOBD_2015T, CanIfTxPduUpperLayerRef=CAN_PASS
          CanIfTTTxFrameTriggering: CanIfTTTxHwObjectTriggerIdRef=(unset)
        CAN4_DiagPhysReqToAirPTC_1701T: CanIfTxPduCanId=1701, CanIfTxPduCanIdType=STANDARD_FD_CAN, CanIfTxPduDlc=8, CanIfTxPduSourcePduID=30, CanIfTxPduUserTxConfirmationUL=CDD, CanIfTxPduBufferRef=CanIfInitCfg/HOH_TX_0_CAN4, CanIfTxPduRef=CAN4_DiagPhysReqToAirPTC_1701T, CanIfTxPduUpperLayerRef=CAN_PASS
          CanIfTTTxFrameTriggering: CanIfTTTxHwObjectTriggerIdRef=(unset)
        CAN4_DiagPhysReqToBodyZone_DR_1671T: CanIfTxPduCanId=1671, CanIfTxPduCanIdType=STANDARD_FD_CAN, CanIfTxPduDlc=64, CanIfTxPduSourcePduID=31, CanIfTxPduUserTxConfirmationUL=CDD, CanIfTxPduBufferRef=CanIfInitCfg/HOH_TX_0_CAN4, CanIfTxPduRef=CAN4_DiagPhysReqToBodyZone_DR_1671T, CanIfTxPduUpperLayerRef=CAN_PASS
          CanIfTTTxFrameTriggering: CanIfTTTxHwObjectTriggerIdRef=(unset)
        CAN4_DiagPhysReqToBodyZone_PS_1670T: CanIfTxPduCanId=1670, CanIfTxPduCanIdType=STANDARD_FD_CAN, CanIfTxPduDlc=64, CanIfTxPduSourcePduID=32, CanIfTxPduUserTxConfirmationUL=CDD, CanIfTxPduBufferRef=CanIfInitCfg/HOH_TX_0_CAN4, CanIfTxPduRef=CAN4_DiagPhysReqToBodyZone_PS_1670T, CanIfTxPduUpperLayerRef=CAN_PASS
          CanIfTTTxFrameTriggering: CanIfTTTxHwObjectTriggerIdRef=(unset)
        CAN4_DiagPhysReqToCompressor_1733T: CanIfTxPduCanId=1733, CanIfTxPduCanIdType=STANDARD_FD_CAN, CanIfTxPduDlc=8, CanIfTxPduSourcePduID=33, CanIfTxPduUserTxConfirmationUL=CDD, CanIfTxPduBufferRef=CanIfInitCfg/HOH_TX_0_CAN4, CanIfTxPduRef=CAN4_DiagPhysReqToCompressor_1733T, CanIfTxPduUpperLayerRef=CAN_PASS
          CanIfTTTxFrameTriggering: CanIfTTTxHwObjectTriggerIdRef=(unset)
        CAN4_DiagPhysReqToDKC_1669T: CanIfTxPduCanId=1669, CanIfTxPduCanIdType=STANDARD_FD_CAN, CanIfTxPduDlc=32, CanIfTxPduSourcePduID=34, CanIfTxPduUserTxConfirmationUL=CDD, CanIfTxPduBufferRef=CanIfInitCfg/HOH_TX_0_CAN4, CanIfTxPduRef=CAN4_DiagPhysReqToDKC_1669T, CanIfTxPduUpperLayerRef=CAN_PASS
          CanIfTTTxFrameTriggering: CanIfTTTxHwObjectTriggerIdRef=(unset)
        CAN4_DiagPhysReqToDSEAT_1684T: CanIfTxPduCanId=1684, CanIfTxPduCanIdType=STANDARD_FD_CAN, CanIfTxPduDlc=8, CanIfTxPduSourcePduID=35, CanIfTxPduUserTxConfirmationUL=CDD, CanIfTxPduBufferRef=CanIfInitCfg/HOH_TX_0_CAN4, CanIfTxPduRef=CAN4_DiagPhysReqToDSEAT_1684T, CanIfTxPduUpperLayerRef=CAN_PASS
          CanIfTTTxFrameTriggering: CanIfTTTxHwObjectTriggerIdRef=(unset)
        CAN4_DiagPhysReqToLDM_FL_1702T: CanIfTxPduCanId=1702, CanIfTxPduCanIdType=STANDARD_FD_CAN, CanIfTxPduDlc=64, CanIfTxPduSourcePduID=36, CanIfTxPduUserTxConfirmationUL=CDD, CanIfTxPduBufferRef=CanIfInitCfg/HOH_TX_0_CAN4, CanIfTxPduRef=CAN4_DiagPhysReqToLDM_FL_1702T, CanIfTxPduUpperLayerRef=CAN_PASS
          CanIfTTTxFrameTriggering: CanIfTTTxHwObjectTriggerIdRef=(unset)
        CAN4_DiagPhysReqToLDM_FR_1686T: CanIfTxPduCanId=1686, CanIfTxPduCanIdType=STANDARD_FD_CAN, CanIfTxPduDlc=64, CanIfTxPduSourcePduID=37, CanIfTxPduUserTxConfirmationUL=CDD, CanIfTxPduBufferRef=CanIfInitCfg/HOH_TX_0_CAN4, CanIfTxPduRef=CAN4_DiagPhysReqToLDM_FR_1686T, CanIfTxPduUpperLayerRef=CAN_PASS
          CanIfTTTxFrameTriggering: CanIfTTTxHwObjectTriggerIdRef=(unset)
        CAN4_DiagPhysReqToLDM_RL_1734T: CanIfTxPduCanId=1734, CanIfTxPduCanIdType=STANDARD_FD_CAN, CanIfTxPduDlc=64, CanIfTxPduSourcePduID=38, CanIfTxPduUserTxConfirmationUL=CDD, CanIfTxPduBufferRef=CanIfInitCfg/HOH_TX_0_CAN4, CanIfTxPduRef=CAN4_DiagPhysReqToLDM_RL_1734T, CanIfTxPduUpperLayerRef=CAN_PASS
          CanIfTTTxFrameTriggering: CanIfTTTxHwObjectTriggerIdRef=(unset)
        CAN4_DiagPhysReqToLDM_RR_1718T: CanIfTxPduCanId=1718, CanIfTxPduCanIdType=STANDARD_FD_CAN, CanIfTxPduDlc=64, CanIfTxPduSourcePduID=39, CanIfTxPduUserTxConfirmationUL=CDD, CanIfTxPduBufferRef=CanIfInitCfg/HOH_TX_0_CAN4, CanIfTxPduRef=CAN4_DiagPhysReqToLDM_RR_1718T, CanIfTxPduUpperLayerRef=CAN_PASS
          CanIfTTTxFrameTriggering: CanIfTTTxHwObjectTriggerIdRef=(unset)
        CAN4_DiagPhysReqToPSD_L_1703T: CanIfTxPduCanId=1703, CanIfTxPduCanIdType=STANDARD_FD_CAN, CanIfTxPduDlc=64, CanIfTxPduSourcePduID=40, CanIfTxPduUserTxConfirmationUL=CDD, CanIfTxPduBufferRef=CanIfInitCfg/HOH_TX_0_CAN4, CanIfTxPduRef=CAN4_DiagPhysReqToPSD_L_1703T, CanIfTxPduUpperLayerRef=CAN_PASS
          CanIfTTTxFrameTriggering: CanIfTTTxHwObjectTriggerIdRef=(unset)
        CAN4_DiagPhysReqToPSD_R_1704T: CanIfTxPduCanId=1704, CanIfTxPduCanIdType=STANDARD_FD_CAN, CanIfTxPduDlc=64, CanIfTxPduSourcePduID=41, CanIfTxPduUserTxConfirmationUL=CDD, CanIfTxPduBufferRef=CanIfInitCfg/HOH_TX_0_CAN4, CanIfTxPduRef=CAN4_DiagPhysReqToPSD_R_1704T, CanIfTxPduUpperLayerRef=CAN_PASS
          CanIfTTTxFrameTriggering: CanIfTTTxHwObjectTriggerIdRef=(unset)
        CAN4_DiagPhysReqToPSEAT_1700T: CanIfTxPduCanId=1700, CanIfTxPduCanIdType=STANDARD_FD_CAN, CanIfTxPduDlc=8, CanIfTxPduSourcePduID=42, CanIfTxPduUserTxConfirmationUL=CDD, CanIfTxPduBufferRef=CanIfInitCfg/HOH_TX_0_CAN4, CanIfTxPduRef=CAN4_DiagPhysReqToPSEAT_1700T, CanIfTxPduUpperLayerRef=CAN_PASS
          CanIfTTTxFrameTriggering: CanIfTTTxHwObjectTriggerIdRef=(unset)
        CAN4_DiagPhysReqToPTG_1716T: CanIfTxPduCanId=1716, CanIfTxPduCanIdType=STANDARD_FD_CAN, CanIfTxPduDlc=8, CanIfTxPduSourcePduID=43, CanIfTxPduUserTxConfirmationUL=CDD, CanIfTxPduBufferRef=CanIfInitCfg/HOH_TX_0_CAN4, CanIfTxPduRef=CAN4_DiagPhysReqToPTG_1716T, CanIfTxPduUpperLayerRef=CAN_PASS
          CanIfTTTxFrameTriggering: CanIfTTTxHwObjectTriggerIdRef=(unset)
        CAN4_DiagPhysReqToWPTC_1717T: CanIfTxPduCanId=1717, CanIfTxPduCanIdType=STANDARD_FD_CAN, CanIfTxPduDlc=8, CanIfTxPduSourcePduID=44, CanIfTxPduUserTxConfirmationUL=CDD, CanIfTxPduBufferRef=CanIfInitCfg/HOH_TX_0_CAN4, CanIfTxPduRef=CAN4_DiagPhysReqToWPTC_1717T, CanIfTxPduUpperLayerRef=CAN_PASS
          CanIfTTTxFrameTriggering: CanIfTTTxHwObjectTriggerIdRef=(unset)
        CAN4_DiagPhysReqToZONE_DR_1728T: CanIfTxPduCanId=1728, CanIfTxPduCanIdType=STANDARD_FD_CAN, CanIfTxPduDlc=64, CanIfTxPduSourcePduID=45, CanIfTxPduUserTxConfirmationUL=CDD, CanIfTxPduBufferRef=CanIfInitCfg/HOH_TX_0_CAN4, CanIfTxPduRef=CAN4_DiagPhysReqToZONE_DR_1728T, CanIfTxPduUpperLayerRef=CAN_PASS
          CanIfTTTxFrameTriggering: CanIfTTTxHwObjectTriggerIdRef=(unset)
        CAN4_DiagPhysReqToZONE_FR_1668T: CanIfTxPduCanId=1668, CanIfTxPduCanIdType=STANDARD_FD_CAN, CanIfTxPduDlc=64, CanIfTxPduSourcePduID=46, CanIfTxPduUserTxConfirmationUL=CDD, CanIfTxPduBufferRef=CanIfInitCfg/HOH_TX_0_CAN4, CanIfTxPduRef=CAN4_DiagPhysReqToZONE_FR_1668T, CanIfTxPduUpperLayerRef=CAN_PASS
          CanIfTTTxFrameTriggering: CanIfTTTxHwObjectTriggerIdRef=(unset)
        CAN4_DiagPhysReqToZONE_ML_1729T: CanIfTxPduCanId=1729, CanIfTxPduCanIdType=STANDARD_FD_CAN, CanIfTxPduDlc=64, CanIfTxPduSourcePduID=47, CanIfTxPduUserTxConfirmationUL=CDD, CanIfTxPduBufferRef=CanIfInitCfg/HOH_TX_0_CAN4, CanIfTxPduRef=CAN4_DiagPhysReqToZONE_ML_1729T, CanIfTxPduUpperLayerRef=CAN_PASS
          CanIfTTTxFrameTriggering: CanIfTTTxHwObjectTriggerIdRef=(unset)
        CAN4_DiagPhysReqToZONE_MR_1730T: CanIfTxPduCanId=1730, CanIfTxPduCanIdType=STANDARD_FD_CAN, CanIfTxPduDlc=64, CanIfTxPduSourcePduID=48, CanIfTxPduUserTxConfirmationUL=CDD, CanIfTxPduBufferRef=CanIfInitCfg/HOH_TX_0_CAN4, CanIfTxPduRef=CAN4_DiagPhysReqToZONE_MR_1730T, CanIfTxPduUpperLayerRef=CAN_PASS
          CanIfTTTxFrameTriggering: CanIfTTTxHwObjectTriggerIdRef=(unset)
        CAN4_FD4_CE100_0_278T: CanIfTxPduCanId=278, CanIfTxPduCanIdType=STANDARD_FD_CAN, CanIfTxPduDlc=32, CanIfTxPduSourcePduID=(unset), CanIfTxPduUserTxConfirmationUL=PDUR, CanIfTxPduBufferRef=CanIfInitCfg/HOH_TX_0_CAN4, CanIfTxPduRef=CAN4_FD4_CE100_0_278T, CanIfTxPduUpperLayerRef=(unset)
          CanIfTTTxFrameTriggering: CanIfTTTxHwObjectTriggerIdRef=(unset)
        CAN4_FD4_CE100_1_386T: CanIfTxPduCanId=386, CanIfTxPduCanIdType=STANDARD_FD_CAN, CanIfTxPduDlc=64, CanIfTxPduSourcePduID=(unset), CanIfTxPduUserTxConfirmationUL=PDUR, CanIfTxPduBufferRef=CanIfInitCfg/HOH_TX_0_CAN4, CanIfTxPduRef=CAN4_FD4_CE100_1_386T, CanIfTxPduUpperLayerRef=(unset)
          CanIfTTTxFrameTriggering: CanIfTTTxHwObjectTriggerIdRef=(unset)
        CAN4_FD4_CE100_2_928T: CanIfTxPduCanId=928, CanIfTxPduCanIdType=STANDARD_FD_CAN, CanIfTxPduDlc=32, CanIfTxPduSourcePduID=(unset), CanIfTxPduUserTxConfirmationUL=PDUR, CanIfTxPduBufferRef=CanIfInitCfg/HOH_TX_0_CAN4, CanIfTxPduRef=CAN4_FD4_CE100_2_928T, CanIfTxPduUpperLayerRef=(unset)
          CanIfTTTxFrameTriggering: CanIfTTTxHwObjectTriggerIdRef=(unset)
        CAN4_FD4_CE200_0_535T: CanIfTxPduCanId=535, CanIfTxPduCanIdType=STANDARD_FD_CAN, CanIfTxPduDlc=32, CanIfTxPduSourcePduID=(unset), CanIfTxPduUserTxConfirmationUL=PDUR, CanIfTxPduBufferRef=CanIfInitCfg/HOH_TX_0_CAN4, CanIfTxPduRef=CAN4_FD4_CE200_0_535T, CanIfTxPduUpperLayerRef=(unset)
          CanIfTTTxFrameTriggering: CanIfTTTxHwObjectTriggerIdRef=(unset)
        CAN4_FD4_OTA1_1080T: CanIfTxPduCanId=1080, CanIfTxPduCanIdType=STANDARD_FD_CAN, CanIfTxPduDlc=12, CanIfTxPduSourcePduID=(unset), CanIfTxPduUserTxConfirmationUL=PDUR, CanIfTxPduBufferRef=CanIfInitCfg/HOH_TX_0_CAN4, CanIfTxPduRef=CAN4_FD4_OTA1_1080T, CanIfTxPduUpperLayerRef=(unset)
          CanIfTTTxFrameTriggering: CanIfTTTxHwObjectTriggerIdRef=(unset)
        CAN4_GW4_CE100_0_595T: CanIfTxPduCanId=595, CanIfTxPduCanIdType=STANDARD_FD_CAN, CanIfTxPduDlc=32, CanIfTxPduSourcePduID=(unset), CanIfTxPduUserTxConfirmationUL=PDUR, CanIfTxPduBufferRef=CanIfInitCfg/HOH_TX_0_CAN4, CanIfTxPduRef=CAN4_GW4_CE100_0_595T, CanIfTxPduUpperLayerRef=(unset)
          CanIfTTTxFrameTriggering: CanIfTTTxHwObjectTriggerIdRef=(unset)
        CAN4_GW4_CE200_0_597T: CanIfTxPduCanId=597, CanIfTxPduCanIdType=STANDARD_FD_CAN, CanIfTxPduDlc=32, CanIfTxPduSourcePduID=(unset), CanIfTxPduUserTxConfirmationUL=PDUR, CanIfTxPduBufferRef=CanIfInitCfg/HOH_TX_0_CAN4, CanIfTxPduRef=CAN4_GW4_CE200_0_597T, CanIfTxPduUpperLayerRef=(unset)
          CanIfTTTxFrameTriggering: CanIfTTTxHwObjectTriggerIdRef=(unset)
        CAN4_NMm_FUSION_TX_1280T: CanIfTxPduCanId=1280, CanIfTxPduCanIdType=STANDARD_CAN, CanIfTxPduDlc=8, CanIfTxPduSourcePduID=(unset), CanIfTxPduUserTxConfirmationUL=CAN_NM, CanIfTxPduBufferRef=CanIfInitCfg/HOH_TX_0_CAN4, CanIfTxPduRef=CAN4_NMm_FUSION_TX_1280T, CanIfTxPduUpperLayerRef=(unset)
          CanIfTTTxFrameTriggering: CanIfTTTxHwObjectTriggerIdRef=(unset)
        CAN5_DiagFuncReqFT_2000T: CanIfTxPduCanId=2000, CanIfTxPduCanIdType=STANDARD_FD_CAN, CanIfTxPduDlc=8, CanIfTxPduSourcePduID=49, CanIfTxPduUserTxConfirmationUL=CDD, CanIfTxPduBufferRef=CanIfInitCfg/HOH_TX_0_CAN5, CanIfTxPduRef=CAN5_DiagFuncReqFT_2000T, CanIfTxPduUpperLayerRef=CAN_PASS
          CanIfTTTxFrameTriggering: CanIfTTTxHwObjectTriggerIdRef=(unset)
        CAN5_DiagFuncReqOBD_2015T: CanIfTxPduCanId=2015, CanIfTxPduCanIdType=STANDARD_FD_CAN, CanIfTxPduDlc=8, CanIfTxPduSourcePduID=50, CanIfTxPduUserTxConfirmationUL=CDD, CanIfTxPduBufferRef=CanIfInitCfg/HOH_TX_0_CAN5, CanIfTxPduRef=CAN5_DiagFuncReqOBD_2015T, CanIfTxPduUpperLayerRef=CAN_PASS
          CanIfTTTxFrameTriggering: CanIfTTTxHwObjectTriggerIdRef=(unset)
        CAN5_DiagPhysReqToTBOX_1744T: CanIfTxPduCanId=1744, CanIfTxPduCanIdType=STANDARD_FD_CAN, CanIfTxPduDlc=64, CanIfTxPduSourcePduID=51, CanIfTxPduUserTxConfirmationUL=CDD, CanIfTxPduBufferRef=CanIfInitCfg/HOH_TX_0_CAN5, CanIfTxPduRef=CAN5_DiagPhysReqToTBOX_1744T, CanIfTxPduUpperLayerRef=CAN_PASS
          CanIfTTTxFrameTriggering: CanIfTTTxHwObjectTriggerIdRef=(unset)
        CAN5_FD5_CE100_0_280T: CanIfTxPduCanId=280, CanIfTxPduCanIdType=STANDARD_FD_CAN, CanIfTxPduDlc=16, CanIfTxPduSourcePduID=(unset), CanIfTxPduUserTxConfirmationUL=PDUR, CanIfTxPduBufferRef=CanIfInitCfg/HOH_TX_0_CAN5, CanIfTxPduRef=CAN5_FD5_CE100_0_280T, CanIfTxPduUpperLayerRef=(unset)
          CanIfTTTxFrameTriggering: CanIfTTTxHwObjectTriggerIdRef=(unset)
        CAN5_FD5_CONN1_1110T: CanIfTxPduCanId=1110, CanIfTxPduCanIdType=STANDARD_FD_CAN, CanIfTxPduDlc=12, CanIfTxPduSourcePduID=(unset), CanIfTxPduUserTxConfirmationUL=PDUR, CanIfTxPduBufferRef=CanIfInitCfg/HOH_TX_0_CAN5, CanIfTxPduRef=CAN5_FD5_CONN1_1110T, CanIfTxPduUpperLayerRef=(unset)
          CanIfTTTxFrameTriggering: CanIfTTTxHwObjectTriggerIdRef=(unset)
        CAN5_FD5_Debug1_1232T: CanIfTxPduCanId=1232, CanIfTxPduCanIdType=STANDARD_FD_CAN, CanIfTxPduDlc=32, CanIfTxPduSourcePduID=(unset), CanIfTxPduUserTxConfirmationUL=PDUR, CanIfTxPduBufferRef=CanIfInitCfg/HOH_TX_0_CAN5, CanIfTxPduRef=CAN5_FD5_Debug1_1232T, CanIfTxPduUpperLayerRef=(unset)
          CanIfTTTxFrameTriggering: CanIfTTTxHwObjectTriggerIdRef=(unset)
        CAN5_FD5_Debug2_1271T: CanIfTxPduCanId=1271, CanIfTxPduCanIdType=STANDARD_FD_CAN, CanIfTxPduDlc=32, CanIfTxPduSourcePduID=(unset), CanIfTxPduUserTxConfirmationUL=PDUR, CanIfTxPduBufferRef=CanIfInitCfg/HOH_TX_0_CAN5, CanIfTxPduRef=CAN5_FD5_Debug2_1271T, CanIfTxPduUpperLayerRef=(unset)
          CanIfTTTxFrameTriggering: CanIfTTTxHwObjectTriggerIdRef=(unset)
        CAN5_FD5_Debug3_1267T: CanIfTxPduCanId=1267, CanIfTxPduCanIdType=STANDARD_FD_CAN, CanIfTxPduDlc=12, CanIfTxPduSourcePduID=(unset), CanIfTxPduUserTxConfirmationUL=PDUR, CanIfTxPduBufferRef=CanIfInitCfg/HOH_TX_0_CAN5, CanIfTxPduRef=CAN5_FD5_Debug3_1267T, CanIfTxPduUpperLayerRef=(unset)
          CanIfTTTxFrameTriggering: CanIfTTTxHwObjectTriggerIdRef=(unset)
        CAN5_FD5_OTA1_1080T: CanIfTxPduCanId=1080, CanIfTxPduCanIdType=STANDARD_FD_CAN, CanIfTxPduDlc=12, CanIfTxPduSourcePduID=(unset), CanIfTxPduUserTxConfirmationUL=PDUR, CanIfTxPduBufferRef=CanIfInitCfg/HOH_TX_0_CAN5, CanIfTxPduRef=CAN5_FD5_OTA1_1080T, CanIfTxPduUpperLayerRef=(unset)
          CanIfTTTxFrameTriggering: CanIfTTTxHwObjectTriggerIdRef=(unset)
        CAN5_GW5_CE100_0_453T: CanIfTxPduCanId=453, CanIfTxPduCanIdType=STANDARD_FD_CAN, CanIfTxPduDlc=32, CanIfTxPduSourcePduID=(unset), CanIfTxPduUserTxConfirmationUL=PDUR, CanIfTxPduBufferRef=CanIfInitCfg/HOH_TX_0_CAN5, CanIfTxPduRef=CAN5_GW5_CE100_0_453T, CanIfTxPduUpperLayerRef=(unset)
          CanIfTTTxFrameTriggering: CanIfTTTxHwObjectTriggerIdRef=(unset)
        CAN5_NMm_FUSION_TX_1280T: CanIfTxPduCanId=1280, CanIfTxPduCanIdType=STANDARD_CAN, CanIfTxPduDlc=8, CanIfTxPduSourcePduID=(unset), CanIfTxPduUserTxConfirmationUL=CAN_NM, CanIfTxPduBufferRef=CanIfInitCfg/HOH_TX_0_CAN5, CanIfTxPduRef=CAN5_NMm_FUSION_TX_1280T, CanIfTxPduUpperLayerRef=(unset)
          CanIfTTTxFrameTriggering: CanIfTTTxHwObjectTriggerIdRef=(unset)
        CAN6_DiagFuncReqFT_2000T: CanIfTxPduCanId=2000, CanIfTxPduCanIdType=STANDARD_FD_CAN, CanIfTxPduDlc=8, CanIfTxPduSourcePduID=52, CanIfTxPduUserTxConfirmationUL=CDD, CanIfTxPduBufferRef=CanIfInitCfg/HOH_TX_0_CAN6, CanIfTxPduRef=CAN6_DiagFuncReqFT_2000T, CanIfTxPduUpperLayerRef=CAN_PASS
          CanIfTTTxFrameTriggering: CanIfTTTxHwObjectTriggerIdRef=(unset)
        CAN6_DiagFuncReqOBD_2015T: CanIfTxPduCanId=2015, CanIfTxPduCanIdType=STANDARD_FD_CAN, CanIfTxPduDlc=8, CanIfTxPduSourcePduID=53, CanIfTxPduUserTxConfirmationUL=CDD, CanIfTxPduBufferRef=CanIfInitCfg/HOH_TX_0_CAN6, CanIfTxPduRef=CAN6_DiagFuncReqOBD_2015T, CanIfTxPduUpperLayerRef=CAN_PASS
          CanIfTTTxFrameTriggering: CanIfTTTxHwObjectTriggerIdRef=(unset)
        CAN6_DiagPhysReqToFCM_1680T: CanIfTxPduCanId=1680, CanIfTxPduCanIdType=STANDARD_FD_CAN, CanIfTxPduDlc=8, CanIfTxPduSourcePduID=54, CanIfTxPduUserTxConfirmationUL=CDD, CanIfTxPduBufferRef=CanIfInitCfg/HOH_TX_0_CAN6, CanIfTxPduRef=CAN6_DiagPhysReqToFCM_1680T, CanIfTxPduUpperLayerRef=CAN_PASS
          CanIfTTTxFrameTriggering: CanIfTTTxHwObjectTriggerIdRef=(unset)
        CAN6_DiagPhysReqToMRR_1685T: CanIfTxPduCanId=1685, CanIfTxPduCanIdType=STANDARD_FD_CAN, CanIfTxPduDlc=8, CanIfTxPduSourcePduID=55, CanIfTxPduUserTxConfirmationUL=CDD, CanIfTxPduBufferRef=CanIfInitCfg/HOH_TX_0_CAN6, CanIfTxPduRef=CAN6_DiagPhysReqToMRR_1685T, CanIfTxPduUpperLayerRef=CAN_PASS
          CanIfTTTxFrameTriggering: CanIfTTTxHwObjectTriggerIdRef=(unset)
        CAN6_DiagPhysReqToSRR_M_1682T: CanIfTxPduCanId=1682, CanIfTxPduCanIdType=STANDARD_FD_CAN, CanIfTxPduDlc=8, CanIfTxPduSourcePduID=56, CanIfTxPduUserTxConfirmationUL=CDD, CanIfTxPduBufferRef=CanIfInitCfg/HOH_TX_0_CAN6, CanIfTxPduRef=CAN6_DiagPhysReqToSRR_M_1682T, CanIfTxPduUpperLayerRef=CAN_PASS
          CanIfTTTxFrameTriggering: CanIfTTTxHwObjectTriggerIdRef=(unset)
        CAN6_FD6_APS3_568T: CanIfTxPduCanId=568, CanIfTxPduCanIdType=STANDARD_FD_CAN, CanIfTxPduDlc=16, CanIfTxPduSourcePduID=(unset), CanIfTxPduUserTxConfirmationUL=PDUR, CanIfTxPduBufferRef=CanIfInitCfg/HOH_TX_0_CAN6, CanIfTxPduRef=CAN6_FD6_APS3_568T, CanIfTxPduUpperLayerRef=(unset)
          CanIfTTTxFrameTriggering: CanIfTTTxHwObjectTriggerIdRef=(unset)
        CAN6_FD6_BCM1_534T: CanIfTxPduCanId=534, CanIfTxPduCanIdType=STANDARD_FD_CAN, CanIfTxPduDlc=16, CanIfTxPduSourcePduID=(unset), CanIfTxPduUserTxConfirmationUL=PDUR, CanIfTxPduBufferRef=CanIfInitCfg/HOH_TX_0_CAN6, CanIfTxPduRef=CAN6_FD6_BCM1_534T, CanIfTxPduUpperLayerRef=(unset)
          CanIfTTTxFrameTriggering: CanIfTTTxHwObjectTriggerIdRef=(unset)
        CAN6_FD6_VCU1_278T: CanIfTxPduCanId=278, CanIfTxPduCanIdType=STANDARD_FD_CAN, CanIfTxPduDlc=12, CanIfTxPduSourcePduID=(unset), CanIfTxPduUserTxConfirmationUL=PDUR, CanIfTxPduBufferRef=CanIfInitCfg/HOH_TX_0_CAN6, CanIfTxPduRef=CAN6_FD6_VCU1_278T, CanIfTxPduUpperLayerRef=(unset)
          CanIfTTTxFrameTriggering: CanIfTTTxHwObjectTriggerIdRef=(unset)
        CAN6_FD6_VCU2_340T: CanIfTxPduCanId=340, CanIfTxPduCanIdType=STANDARD_FD_CAN, CanIfTxPduDlc=16, CanIfTxPduSourcePduID=(unset), CanIfTxPduUserTxConfirmationUL=PDUR, CanIfTxPduBufferRef=CanIfInitCfg/HOH_TX_0_CAN6, CanIfTxPduRef=CAN6_FD6_VCU2_340T, CanIfTxPduUpperLayerRef=(unset)
          CanIfTTTxFrameTriggering: CanIfTTTxHwObjectTriggerIdRef=(unset)
        CAN6_FD6_VMC1_383T: CanIfTxPduCanId=383, CanIfTxPduCanIdType=STANDARD_FD_CAN, CanIfTxPduDlc=24, CanIfTxPduSourcePduID=(unset), CanIfTxPduUserTxConfirmationUL=PDUR, CanIfTxPduBufferRef=CanIfInitCfg/HOH_TX_0_CAN6, CanIfTxPduRef=CAN6_FD6_VMC1_383T, CanIfTxPduUpperLayerRef=(unset)
          CanIfTTTxFrameTriggering: CanIfTTTxHwObjectTriggerIdRef=(unset)
        CAN6_GW6_CE100_0_454T: CanIfTxPduCanId=454, CanIfTxPduCanIdType=STANDARD_FD_CAN, CanIfTxPduDlc=32, CanIfTxPduSourcePduID=(unset), CanIfTxPduUserTxConfirmationUL=PDUR, CanIfTxPduBufferRef=CanIfInitCfg/HOH_TX_0_CAN6, CanIfTxPduRef=CAN6_GW6_CE100_0_454T, CanIfTxPduUpperLayerRef=(unset)
          CanIfTTTxFrameTriggering: CanIfTTTxHwObjectTriggerIdRef=(unset)
        CAN6_NMm_FUSION_TX_1280T: CanIfTxPduCanId=1280, CanIfTxPduCanIdType=STANDARD_CAN, CanIfTxPduDlc=8, CanIfTxPduSourcePduID=(unset), CanIfTxPduUserTxConfirmationUL=CAN_NM, CanIfTxPduBufferRef=CanIfInitCfg/HOH_TX_0_CAN6, CanIfTxPduRef=CAN6_NMm_FUSION_TX_1280T, CanIfTxPduUpperLayerRef=(unset)
          CanIfTTTxFrameTriggering: CanIfTTTxHwObjectTriggerIdRef=(unset)
        CAN7_GW7_C100_0_453T: CanIfTxPduCanId=453, CanIfTxPduCanIdType=STANDARD_FD_CAN, CanIfTxPduDlc=32, CanIfTxPduSourcePduID=(unset), CanIfTxPduUserTxConfirmationUL=PDUR, CanIfTxPduBufferRef=CanIfInitCfg/HOH_TX_0_CAN7, CanIfTxPduRef=CAN7_GW7_C100_0_453T, CanIfTxPduUpperLayerRef=(unset)
          CanIfTTTxFrameTriggering: CanIfTTTxHwObjectTriggerIdRef=(unset)
        XCP_1569T: CanIfTxPduCanId=1569, CanIfTxPduCanIdType=STANDARD_FD_CAN, CanIfTxPduDlc=8, CanIfTxPduSourcePduID=0, CanIfTxPduUserTxConfirmationUL=CDD, CanIfTxPduBufferRef=CanIfInitCfg/HOH_0_Can8_Xcp, CanIfTxPduRef=XCP_1569T, CanIfTxPduUpperLayerRef=XCP
          CanIfTTTxFrameTriggering: CanIfTTTxHwObjectTriggerIdRef=(unset)
    CanIfMirroringSupport:
      CanIfCanControllerErrorStateSupported = 0
      CanIfCanTxErrorCounterSupported = 0
      CanIfErrorStateValue = CAN_ERRORSTATE_ACTIVE
      CanIfMirrorToCDDReportingEnable = 0
      CanIfMirrorToCDDReportingFunctionName = (unset)
      CanIfMirrorToCDDReportingHeader = (unset)
      CanIfTxErrorCounterValue = 0
      TxMirrorBufferSize = (unset)
      TxMirrorNumTxPdus = (unset)
    CanIfPrivateCfg: CanIfPrivateDlcCheck=1, CanIfPrivateSoftwareFilterType=BINARY, CanIfSupportTTCAN=0
      CanIfTTGeneral: CanIfTTJoblist=0, CanIfTTMaxIsrDelay=(unset)
    CanIfPublicCfg:
      CanIfBusMirroringSupport = 0
      CanIfCanDriverCompatibility = ASR440
      CanIfDecoupledProcessingSupport = 0
      CanIfDetReportRuntimeError = 0
      CanIfEnableSecurityEventReporting = 0
      CanIfHookOnReceptionSupport = 0
      CanIfMetaDataSupport = 0
      CanIfMultiCoreSupport = 0
      CanIfPublicCanIdTypeEnum = UINT32
      CanIfPublicCancelTransmitSupport = 0
      CanIfPublicCddHeaderFile = Xcp_Cbk.h
      CanIfPublicCddHeaderFile = can_passthrough_handler.h
      CanIfPublicChangeBaudrateSupport = 0
      CanIfPublicCtrlWakeupSupport = 0
      CanIfPublicDevErrorDetect = 0
      CanIfPublicHandleTypeEnum = UINT8
      CanIfPublicHohTranslationOpt = 0
      CanIfPublicMaxDynTxPdus = 8
      CanIfPublicMaxHths = 150
      CanIfPublicMaxRxBuffer = 72
      CanIfPublicMaxRxNotifyPdus = 64
      CanIfPublicMaxTxBufferSize = 8192
      CanIfPublicMaxTxBuffers = 128
      CanIfPublicMaxTxNotifyPdus = 64
      CanIfPublicMultipleDrvSupport = 1
      CanIfPublicNumberOfCanHwUnits = 1
      CanIfPublicPnSupport = 0
      CanIfPublicRangeReceptionSupport = 1
      CanIfPublicReadRxPduDataApi = 0
      CanIfPublicReadRxPduNotifyStatusApi = 1
      CanIfPublicReadTxPduNotifyStatusApi = 0
      CanIfPublicSetDynamicTxIdApi = 0
      CanIfPublicSingleCtrlOpt = 0
      CanIfPublicTrcvWakeupSupport = 1
      CanIfPublicTxBuffering = 1
      CanIfPublicTxConfirmPollingSupport = 1
      CanIfPublicVersionInfoApi = 0
      CanIfPublicWakeupCheckValidByNM = 0
      CanIfPublicWakeupCheckValidSupport = 0
      CanIfRelocatablePbcfgEnable = 1
      CanIfSetBaudrateApi = 0
      CanIfSingleCanTrcvAPIInfixEnable = 1
      CanIfSoftwareFilteringSupport = 1
      CanIfTxOfflineActiveSupport = 0
      CanIfValidateWakeupOnStartedCtrlOnly = 0
      CanIfSecurityEventRefs
    4 x CanIfUpperLayerConfig, all with CanIfPublicTxConfResultSupport=0, CanIfUpperLayerUseCanId=0, CanIfUseCddHandleIds=0:
      CAN_NM: CanIfRxPduUserRxIndicationName=CanNm_RxIndication, CanIfTxPduUserTxConfirmationName=CanNm_TxConfirmation
      CAN_PASS: CanIfTxPduUserTxConfirmationName=CanPass_TxConfirmation
      PDUR: CanIfRxPduUserRxIndicationName=PduR_CanIfRxIndication, CanIfTxPduUserTxConfirmationName=PduR_CanIfTxConfirmation
      XCP: CanIfRxPduUserRxIndicationName=Xcp_CanIfRxIndication, CanIfTxPduUserTxConfirmationName=Xcp_CanIfTxConfirmation
