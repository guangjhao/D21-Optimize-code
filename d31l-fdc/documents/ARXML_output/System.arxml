[part 2 of 2: package /SysEnv_ARPkg]
AUTOSAR XML (schema 4-3-0)
package /SysEnv_ARPkg  (continued)
  system System_FDC: category=SYSTEM_DESCRIPTION, ecu-extract-version=1.0.0, system-version=1.0.0  (continued)
    96 x system mapping:  (continued)
      MAP_CAN3_FD_BCM1: sender-receiver-to-signal-group-mapping{communication-direction=OUT, data-element=SWC_FDC.root_FDC.P_CAN3_FD_BCM1.CAN3_SG_FD_BCM1, signal-group=CAN3_SG_FD_BCM1, type-mapping=sender-rec-record-type-mapping=record-element-mappings=[{implementation-record-element=CAN3_AllDoorSW, system-signal=CAN3_AllDoorSW}, {implementation-record-element=CAN3_WisrBootReason, system-signal=CAN3_WisrBootReason}, {implementation-record-element=CAN3_WiperFixMode, system-signal=CAN3_WiperFixMode}, {implementation-record-element=CAN3_WasherCtrl, system-signal=CAN3_WasherCtrl}, {implementation-record-element=CAN3_TrunkRel, system-signal=CAN3_TrunkRel}, {implementation-record-element=CAN3_Tailgate_SW, system-signal=CAN3_Tailgate_SW}, {implementation-record-element=CAN3_TailgateRemote, system-signal=CAN3_TailgateRemote}, {implementation-record-element=CAN3_TailgateHDSW, system-signal=CAN3_TailgateHDSW}, {implementation-record-element=CAN3_Rr_Wiper, system-signal=CAN3_Rr_Wiper}, {implementation-record-element=CAN3_Rr_FogLamp, system-signal=CAN3_Rr_FogLamp}, {implementation-record-element=CAN3_Rr_Defog, system-signal=CAN3_Rr_Defog}, {implementation-record-element=CAN3_Rr_ChargingDoorCtrl, system-signal=CAN3_Rr_ChargingDoorCtrl}, {implementation-record-element=CAN3_RoomLampL, system-signal=CAN3_RoomLampL}, {implementation-record-element=CAN3_RoomLampH, system-signal=CAN3_RoomLampH}, {implementation-record-element=CAN3_ReverseLamp, system-signal=CAN3_ReverseLamp}, {implementation-record-element=CAN3_RTurnLP, system-signal=CAN3_RTurnLP}, {implementation-record-element=CAN3_RRDoorSW, system-signal=CAN3_RRDoorSW}, {implementation-record-element=CAN3_RLDoorSW, system-signal=CAN3_RLDoorSW}, {implementation-record-element=CAN3_RDRL, system-signal=CAN3_RDRL}, {implementation-record-element=CAN3_RBSD, system-signal=CAN3_RBSD}, {implementation-record-element=CAN3_PsDoorSW, system-signal=CAN3_PsDoorSW}, {implementation-record-element=CAN3_PosLamp, system-signal=CAN3_PosLamp}, {implementation-record-element=CAN3_PmicBootReason, system-signal=CAN3_PmicBootReason}, {implementation-record-element=CAN3_MirrorDefog, system-signal=CAN3_MirrorDefog}, {implementation-record-element=CAN3_MirrorCtrl, system-signal=CAN3_MirrorCtrl}, {implementation-record-element=CAN3_LockSetting, system-signal=CAN3_LockSetting}, {implementation-record-element=CAN3_L_Beam, system-signal=CAN3_L_Beam}, {implementation-record-element=CAN3_L_APM_WdwEnable, system-signal=CAN3_L_APM_WdwEnable}, {implementation-record-element=CAN3_LTurnLP, system-signal=CAN3_LTurnLP}, {implementation-record-element=CAN3_LDRL, system-signal=CAN3_LDRL}, {implementation-record-element=CAN3_LBSD, system-signal=CAN3_LBSD}, {implementation-record-element=CAN3_HornCtrl, system-signal=CAN3_HornCtrl}, {implementation-record-element=CAN3_HoodSW, system-signal=CAN3_HoodSW}, {implementation-record-element=CAN3_HazardSW, system-signal=CAN3_HazardSW}, {implementation-record-element=CAN3_H_Beam, system-signal=CAN3_H_Beam}, {implementation-record-element=CAN3_Fr_Wiper_L, system-signal=CAN3_Fr_Wiper_L}, {implementation-record-element=CAN3_Fr_Wiper_H, system-signal=CAN3_Fr_Wiper_H}, {implementation-record-element=CAN3_Fr_FogLamp, system-signal=CAN3_Fr_FogLamp}, {implementation-record-element=CAN3_Fr_ChargingDoorCtrl, system-signal=CAN3_Fr_ChargingDoorCtrl}, {implementation-record-element=CAN3_DrDoorSW, system-signal=CAN3_DrDoorSW}, {implementation-record-element=CAN3_DoorLockIND, system-signal=CAN3_DoorLockIND}, {implementation-record-element=CAN3_DimmerEN, system-signal=CAN3_DimmerEN}, {implementation-record-element=CAN3_Dimmer, system-signal=CAN3_Dimmer}, {implementation-record-element=CAN3_CrashDetd, system-signal=CAN3_CrashDetd}, {implementation-record-element=CAN3_CTDUnlockSW, system-signal=CAN3_CTDUnlockSW}, {implementation-record-element=CAN3_CTDLockSW, system-signal=CAN3_CTDLockSW}, {implementation-record-element=CAN3_CTDCtrl, system-signal=CAN3_CTDCtrl}, {implementation-record-element=CAN3_BrakeLamp, system-signal=CAN3_BrakeLamp}, {implementation-record-element=CAN3_BCM_DoorLock_Sta, system-signal=CAN3_BCM_DoorLock_Sta}, {implementation-record-element=CAN3_BCM_Buzzer_Req, system-signal=CAN3_BCM_Buzzer_Req}, {implementation-record-element=CAN3_AntitheftSta, system-signal=CAN3_AntitheftSta}, {implementation-record-element=CAN3_AntiTheftSeatFold, system-signal=CAN3_AntiTheftSeatFold}]}
      MAP_CAN3_FD_OTA1: sender-receiver-to-signal-group-mapping{communication-direction=OUT, data-element=SWC_VES.root_FDC.P_CAN3_FD_OTA1.CAN3_SG_FD_OTA1, signal-group=CAN3_SG_FD_OTA1, type-mapping=sender-rec-record-type-mapping=record-element-mappings=[{implementation-record-element=CAN3_OTA_DL_Available, system-signal=CAN3_OTA_DL_Available}, {implementation-record-element=CAN3_OTA_Updating_ECU, system-signal=CAN3_OTA_Updating_ECU}, {implementation-record-element=CAN3_OTA_Update_Available, system-signal=CAN3_OTA_Update_Available}, {implementation-record-element=CAN3_OTA_Up_Backcount, system-signal=CAN3_OTA_Up_Backcount}, {implementation-record-element=CAN3_OTA_TBOXResetReq, system-signal=CAN3_OTA_TBOXResetReq}, {implementation-record-element=CAN3_OTA_Progress_Rate, system-signal=CAN3_OTA_Progress_Rate}, {implementation-record-element=CAN3_OTA_Network_Type, system-signal=CAN3_OTA_Network_Type}, {implementation-record-element=CAN3_OTA_Mode, system-signal=CAN3_OTA_Mode}, {implementation-record-element=CAN3_OTA_MDA_Status, system-signal=CAN3_OTA_MDA_Status}, {implementation-record-element=CAN3_OTA_Lock_Req, system-signal=CAN3_OTA_Lock_Req}, {implementation-record-element=CAN3_OTA_InVehicle_FW, system-signal=CAN3_OTA_InVehicle_FW}, {implementation-record-element=CAN3_OTA_DL_Speed, system-signal=CAN3_OTA_DL_Speed}]}
      MAP_CAN3_FD_THCM1: sender-receiver-to-signal-group-mapping{communication-direction=OUT, data-element=SWC_FDC.root_FDC.P_CAN3_FD_THCM1.CAN3_SG_FD_THCM1, signal-group=CAN3_SG_FD_THCM1, type-mapping=sender-rec-record-type-mapping=record-element-mappings=[{implementation-record-element=CAN3_BatteryMode, system-signal=CAN3_BatteryMode}, {implementation-record-element=CAN3_sigWindDirZon3St, system-signal=CAN3_sigWindDirZon3St}, {implementation-record-element=CAN3_sigWindDirZon1St, system-signal=CAN3_sigWindDirZon1St}, {implementation-record-element=CAN3_sigSetTempZon3St, system-signal=CAN3_sigSetTempZon3St}, {implementation-record-element=CAN3_sigSetTempZon2St, system-signal=CAN3_sigSetTempZon2St}, {implementation-record-element=CAN3_sigSetTempZon1St, system-signal=CAN3_sigSetTempZon1St}, {implementation-record-element=CAN3_sigRecircSt, system-signal=CAN3_sigRecircSt}, {implementation-record-element=CAN3_sigHvacSt, system-signal=CAN3_sigHvacSt}, {implementation-record-element=CAN3_sigDfrstSt, system-signal=CAN3_sigDfrstSt}, {implementation-record-element=CAN3_sigClntTHvBattOut, system-signal=CAN3_sigClntTHvBattOut}, {implementation-record-element=CAN3_sigClmtCmprPwrAct, system-signal=CAN3_sigClmtCmprPwrAct}, {implementation-record-element=CAN3_sigCbnSolarRight, system-signal=CAN3_sigCbnSolarRight}, {implementation-record-element=CAN3_sigCbnSolarLeft, system-signal=CAN3_sigCbnSolarLeft}, {implementation-record-element=CAN3_sigCbnPTCPwrAct, system-signal=CAN3_sigCbnPTCPwrAct}, {implementation-record-element=CAN3_sigCbnAirT, system-signal=CAN3_sigCbnAirT}, {implementation-record-element=CAN3_sigAmbAirT, system-signal=CAN3_sigAmbAirT}, {implementation-record-element=CAN3_sigAirIntenZon3St, system-signal=CAN3_sigAirIntenZon3St}, {implementation-record-element=CAN3_sigAirIntenZon1St, system-signal=CAN3_sigAirIntenZon1St}, {implementation-record-element=CAN3_Rr_Coolanttemp, system-signal=CAN3_Rr_Coolanttemp}, {implementation-record-element=CAN3_Rr_Coolantflow, system-signal=CAN3_Rr_Coolantflow}, {implementation-record-element=CAN3_HPThermalRecoveryReq, system-signal=CAN3_HPThermalRecoveryReq}, {implementation-record-element=CAN3_Fr_Coolanttemp, system-signal=CAN3_Fr_Coolanttemp}, {implementation-record-element=CAN3_Fr_Coolantflow, system-signal=CAN3_Fr_Coolantflow}, {implementation-record-element=CAN3_FD_RecyAuto_Cmd, system-signal=CAN3_FD_RecyAuto_Cmd}, {implementation-record-element=CAN3_FD_AGS_Cmd, system-signal=CAN3_FD_AGS_Cmd}, {implementation-record-element=CAN3_EDriveMode, system-signal=CAN3_EDriveMode}, {implementation-record-element=CAN3_CabinMode, system-signal=CAN3_CabinMode}, {implementation-record-element=CAN3_CCU_SyncLampSts, system-signal=CAN3_CCU_SyncLampSts}, {implementation-record-element=CAN3_CCU_RrOnOffLampSts, system-signal=CAN3_CCU_RrOnOffLampSts}, {implementation-record-element=CAN3_CCU_HEATMaxLampSts, system-signal=CAN3_CCU_HEATMaxLampSts}, {implementation-record-element=CAN3_CCU_FrtOnOffLampSts, system-signal=CAN3_CCU_FrtOnOffLampSts}, {implementation-record-element=CAN3_CCU_EcoSts, system-signal=CAN3_CCU_EcoSts}, {implementation-record-element=CAN3_CCU_Dispaly_Request, system-signal=CAN3_CCU_Dispaly_Request}, {implementation-record-element=CAN3_CCU_AutoMidLampSts, system-signal=CAN3_CCU_AutoMidLampSts}, {implementation-record-element=CAN3_CCU_AutoLampSts, system-signal=CAN3_CCU_AutoLampSts}, {implementation-record-element=CAN3_CCU_ACMaxLampSts, system-signal=CAN3_CCU_ACMaxLampSts}, {implementation-record-element=CAN3_CCU_ACLampSts, system-signal=CAN3_CCU_ACLampSts}]}
      MAP_CAN3_FD_THCM2: sender-receiver-to-signal-group-mapping{communication-direction=OUT, data-element=SWC_FDC.root_FDC.P_CAN3_FD_THCM2.CAN3_SG_FD_THCM2, signal-group=CAN3_SG_FD_THCM2, type-mapping=sender-rec-record-type-mapping=record-element-mappings=[{implementation-record-element=CAN3_ACSubMode, system-signal=CAN3_ACSubMode}, {implementation-record-element=CAN3_FD_TWV_Cmd, system-signal=CAN3_FD_TWV_Cmd}, {implementation-record-element=CAN3_FD_SOV3_Cmd, system-signal=CAN3_FD_SOV3_Cmd}, {implementation-record-element=CAN3_FD_SOV2_Cmd, system-signal=CAN3_FD_SOV2_Cmd}, {implementation-record-element=CAN3_FD_SOV1_Cmd, system-signal=CAN3_FD_SOV1_Cmd}, {implementation-record-element=CAN3_FD_SOTXV_Cmd, system-signal=CAN3_FD_SOTXV_Cmd}, {implementation-record-element=CAN3_FD_RrAPTCHeatPwr_Cmd, system-signal=CAN3_FD_RrAPTCHeatPwr_Cmd}, {implementation-record-element=CAN3_FD_FrWPTCHeatPwr_Cmd, system-signal=CAN3_FD_FrWPTCHeatPwr_Cmd}, {implementation-record-element=CAN3_FD_FrRiAPTCHeatPwr_Cmd, system-signal=CAN3_FD_FrRiAPTCHeatPwr_Cmd}, {implementation-record-element=CAN3_FD_FrLeAPTCHeatPwr_Cmd, system-signal=CAN3_FD_FrLeAPTCHeatPwr_Cmd}, {implementation-record-element=CAN3_FD_FWV_Cmd, system-signal=CAN3_FD_FWV_Cmd}, {implementation-record-element=CAN3_FD_EXV2_Cmd, system-signal=CAN3_FD_EXV2_Cmd}, {implementation-record-element=CAN3_FD_EXV1_Cmd, system-signal=CAN3_FD_EXV1_Cmd}, {implementation-record-element=CAN3_FD_EWP3_Cmd, system-signal=CAN3_FD_EWP3_Cmd}, {implementation-record-element=CAN3_FD_EWP2_Cmd, system-signal=CAN3_FD_EWP2_Cmd}, {implementation-record-element=CAN3_FD_EWP1_Cmd, system-signal=CAN3_FD_EWP1_Cmd}, {implementation-record-element=CAN3_FD_Comp_Cmd, system-signal=CAN3_FD_Comp_Cmd}, {implementation-record-element=CAN3_FD_Blower_Cmd, system-signal=CAN3_FD_Blower_Cmd}, {implementation-record-element=CAN3_DeiceModReq, system-signal=CAN3_DeiceModReq}, {implementation-record-element=CAN3_CoolgFanActDuty, system-signal=CAN3_CoolgFanActDuty}, {implementation-record-element=CAN3_CCU_HiVoltageReq, system-signal=CAN3_CCU_HiVoltageReq}, {implementation-record-element=CAN3_CCU_CbnPreSts, system-signal=CAN3_CCU_CbnPreSts}, {implementation-record-element=CAN3_CCU_CbnPreEstimdTi, system-signal=CAN3_CCU_CbnPreEstimdTi}, {implementation-record-element=CAN3_CCU_CbnPreACWkSts, system-signal=CAN3_CCU_CbnPreACWkSts}, {implementation-record-element=CAN3_BatLoopActWtFlw, system-signal=CAN3_BatLoopActWtFlw}, {implementation-record-element=CAN3_APTC_ActFrRiPwr, system-signal=CAN3_APTC_ActFrRiPwr}]}
      MAP_CAN3_FD_V2L1: sender-receiver-to-signal-group-mapping{communication-direction=OUT, data-element=SWC_FDC.root_FDC.P_CAN3_FD_V2L1.CAN3_SG_FD_V2L1, signal-group=CAN3_SG_FD_V2L1, type-mapping=sender-rec-record-type-mapping=record-element-mappings=[{implementation-record-element=CAN3_Req_OBCV2LEna, system-signal=CAN3_Req_OBCV2LEna}, {implementation-record-element=CAN3_Req_V2L_IVI_Popup, system-signal=CAN3_Req_V2L_IVI_Popup}, {implementation-record-element=CAN3_Req_V2LSwOn, system-signal=CAN3_Req_V2LSwOn}]}
      MAP_CAN3_FD_VCU0: sender-receiver-to-signal-group-mapping{communication-direction=OUT, data-element=SWC_FDC.root_FDC.P_CAN3_FD_VCU0.CAN3_SG_FD_VCU0, signal-group=CAN3_SG_FD_VCU0, type-mapping=sender-rec-record-type-mapping=record-element-mappings=[{implementation-record-element=CAN3_EVCCAplusPwrUpReq, system-signal=CAN3_EVCCAplusPwrUpReq}, {implementation-record-element=CAN3_VehHVPwrAvail4THCM, system-signal=CAN3_VehHVPwrAvail4THCM}, {implementation-record-element=CAN3_VCURRDoorSta, system-signal=CAN3_VCURRDoorSta}, {implementation-record-element=CAN3_VCURLDoorSta, system-signal=CAN3_VCURLDoorSta}, {implementation-record-element=CAN3_VCUFRDoorSta, system-signal=CAN3_VCUFRDoorSta}, {implementation-record-element=CAN3_VCUFLDoorSta, system-signal=CAN3_VCUFLDoorSta}, {implementation-record-element=CAN3_VCUBrkSWSta, system-signal=CAN3_VCUBrkSWSta}, {implementation-record-element=CAN3_TimerAllowSleep, system-signal=CAN3_TimerAllowSleep}, {implementation-record-element=CAN3_TCountSta, system-signal=CAN3_TCountSta}, {implementation-record-element=CAN3_SysPwrSta, system-signal=CAN3_SysPwrSta}, {implementation-record-element=CAN3_SysAllowReadySta, system-signal=CAN3_SysAllowReadySta}, {implementation-record-element=CAN3_SilentChkAllowSleep, system-signal=CAN3_SilentChkAllowSleep}, {implementation-record-element=CAN3_SchedChgTOSta, system-signal=CAN3_SchedChgTOSta}, {implementation-record-element=CAN3_Rr_TqSource, system-signal=CAN3_Rr_TqSource}, {implementation-record-element=CAN3_PwrUpReq, system-signal=CAN3_PwrUpReq}, {implementation-record-element=CAN3_PwrStaTOSta, system-signal=CAN3_PwrStaTOSta}, {implementation-record-element=CAN3_PwrStaSelect, system-signal=CAN3_PwrStaSelect}, {implementation-record-element=CAN3_PwrStaONTOIVIPopT, system-signal=CAN3_PwrStaONTOIVIPopT}, {implementation-record-element=CAN3_PwrStaONTOIVIPopReq, system-signal=CAN3_PwrStaONTOIVIPopReq}, {implementation-record-element=CAN3_PwrStaConstraint, system-signal=CAN3_PwrStaConstraint}, {implementation-record-element=CAN3_PwrDownReq, system-signal=CAN3_PwrDownReq}, {implementation-record-element=CAN3_PowerUpState, system-signal=CAN3_PowerUpState}, {implementation-record-element=CAN3_PowerUpFault, system-signal=CAN3_PowerUpFault}, {implementation-record-element=CAN3_PowerDownState, system-signal=CAN3_PowerDownState}, {implementation-record-element=CAN3_PowerDownFault, system-signal=CAN3_PowerDownFault}, {implementation-record-element=CAN3_PMMAllowECUSleep, system-signal=CAN3_PMMAllowECUSleep}, {implementation-record-element=CAN3_MCUActDisFail, system-signal=CAN3_MCUActDisFail}, {implementation-record-element=CAN3_LVSilentChrgSta, system-signal=CAN3_LVSilentChrgSta}, {implementation-record-element=CAN3_LVSilentChrgReq, system-signal=CAN3_LVSilentChrgReq}, {implementation-record-element=CAN3_LVSilentChrgLv, system-signal=CAN3_LVSilentChrgLv}, {implementation-record-element=CAN3_LVChrgHoldTAct, system-signal=CAN3_LVChrgHoldTAct}, {implementation-record-element=CAN3_LVBattVoltSta, system-signal=CAN3_LVBattVoltSta}, {implementation-record-element=CAN3_LVBattChrgtimeAct, system-signal=CAN3_LVBattChrgtimeAct}, {implementation-record-element=CAN3_HVTHCMSysAvail, system-signal=CAN3_HVTHCMSysAvail}, {implementation-record-element=CAN3_HVRlyOpFail, system-signal=CAN3_HVRlyOpFail}, {implementation-record-element=CAN3_Fr_TqSource, system-signal=CAN3_Fr_TqSource}, {implementation-record-element=CAN3_FDC_VMC_LongAcc_Sta, system-signal=CAN3_FDC_VMC_LongAcc_Sta}, {implementation-record-element=CAN3_FDC_VMC_AntiSpdLimEn_Sta, system-signal=CAN3_FDC_VMC_AntiSpdLimEn_Sta}, {implementation-record-element=CAN3_FDC_VMC_ActStESCYaw_Sta, system-signal=CAN3_FDC_VMC_ActStESCYaw_Sta}, {implementation-record-element=CAN3_FDC_VCU_VehMalfunLevel_Sta, system-signal=CAN3_FDC_VCU_VehMalfunLevel_Sta}, {implementation-record-element=CAN3_FDC_VCU_VehActSpd_Sta, system-signal=CAN3_FDC_VCU_VehActSpd_Sta}, {implementation-record-element=CAN3_FDC_VCU_SlideRegenLimTq_Sta, system-signal=CAN3_FDC_VCU_SlideRegenLimTq_Sta}, {implementation-record-element=CAN3_FDC_VCU_RegenTqLimitEn_Sta, system-signal=CAN3_FDC_VCU_RegenTqLimitEn_Sta}, {implementation-record-element=CAN3_FDC_VCU_RWDRDCActive_Sta, system-signal=CAN3_FDC_VCU_RWDRDCActive_Sta}, {implementation-record-element=CAN3_FDC_VCU_PwrReq_OTA_Sta, system-signal=CAN3_FDC_VCU_PwrReq_OTA_Sta}, {implementation-record-element=CAN3_FDC_VCU_ForceP_Cmd, system-signal=CAN3_FDC_VCU_ForceP_Cmd}, {implementation-record-element=CAN3_FDC_VCU_DTCCarousel_Sta, system-signal=CAN3_FDC_VCU_DTCCarousel_Sta}, {implementation-record-element=CAN3_FDC_VCU_AllowMovThd_OTA_Sta, system-signal=CAN3_FDC_VCU_AllowMovThd_OTA_Sta}, {implementation-record-element=CAN3_FDC_VCU_ActMaxSlideRate_Sta, system-signal=CAN3_FDC_VCU_ActMaxSlideRate_Sta}, {implementation-record-element=CAN3_FDADC12VDetAvg, system-signal=CAN3_FDADC12VDetAvg}, {implementation-record-element=CAN3_FDADC12VDet, system-signal=CAN3_FDADC12VDet}]}
      MAP_CAN3_FD_VCU1: sender-receiver-to-signal-group-mapping{communication-direction=OUT, data-element=SWC_FDC.root_FDC.P_CAN3_FD_VCU1.CAN3_SG_FD_VCU1, signal-group=CAN3_SG_FD_VCU1, type-mapping=sender-rec-record-type-mapping=record-element-mappings=[{implementation-record-element=CAN3_ActiveDischReq, system-signal=CAN3_ActiveDischReq}, {implementation-record-element=CAN3_ShiftGearPosn, system-signal=CAN3_ShiftGearPosn}, {implementation-record-element=CAN3_Rr_MCUEnaReq, system-signal=CAN3_Rr_MCUEnaReq}, {implementation-record-element=CAN3_Rr_ActvDmpDisabReq, system-signal=CAN3_Rr_ActvDmpDisabReq}, {implementation-record-element=CAN3_RC_VCU1, system-signal=CAN3_RC_VCU1}, {implementation-record-element=CAN3_PwrSta, system-signal=CAN3_PwrSta}, {implementation-record-element=CAN3_PrkReq, system-signal=CAN3_PrkReq}, {implementation-record-element=CAN3_MSA_Crl_Sta, system-signal=CAN3_MSA_Crl_Sta}, {implementation-record-element=CAN3_LVChrgFuncStaChk, system-signal=CAN3_LVChrgFuncStaChk}, {implementation-record-element=CAN3_HVSysReadyToCharge, system-signal=CAN3_HVSysReadyToCharge}, {implementation-record-element=CAN3_HVBatCnctReq, system-signal=CAN3_HVBatCnctReq}, {implementation-record-element=CAN3_Fr_MCUEnaReq, system-signal=CAN3_Fr_MCUEnaReq}, {implementation-record-element=CAN3_Fr_ActvDmpDisabReq, system-signal=CAN3_Fr_ActvDmpDisabReq}, {implementation-record-element=CAN3_DynoModeStaChk, system-signal=CAN3_DynoModeStaChk}, {implementation-record-element=CAN3_Dr_SeatSta, system-signal=CAN3_Dr_SeatSta}, {implementation-record-element=CAN3_DemoModeStaChk, system-signal=CAN3_DemoModeStaChk}, {implementation-record-element=CAN3_DCDCVoltSetpoint, system-signal=CAN3_DCDCVoltSetpoint}, {implementation-record-element=CAN3_DCDCEnaReq, system-signal=CAN3_DCDCEnaReq}, {implementation-record-element=CAN3_CoastDwModeStaChk, system-signal=CAN3_CoastDwModeStaChk}, {implementation-record-element=CAN3_CS_VCU1, system-signal=CAN3_CS_VCU1}]}
      MAP_CAN3_FD_VCU2: sender-receiver-to-signal-group-mapping{communication-direction=OUT, data-element=SWC_FDC.root_FDC.P_CAN3_FD_VCU2.CAN3_SG_FD_VCU2, signal-group=CAN3_SG_FD_VCU2, type-mapping=sender-rec-record-type-mapping=record-element-mappings=[{implementation-record-element=CAN3_CS_VCU2_CAN1, system-signal=CAN3_CS_VCU2_CAN1}, {implementation-record-element=CAN3_Rr_UdcMin, system-signal=CAN3_Rr_UdcMin}, {implementation-record-element=CAN3_Rr_UdcMax, system-signal=CAN3_Rr_UdcMax}, {implementation-record-element=CAN3_Rr_TorqMin, system-signal=CAN3_Rr_TorqMin}, {implementation-record-element=CAN3_Rr_TorqMax, system-signal=CAN3_Rr_TorqMax}, {implementation-record-element=CAN3_Rr_TMTqReq, system-signal=CAN3_Rr_TMTqReq}, {implementation-record-element=CAN3_Rr_IdcMin, system-signal=CAN3_Rr_IdcMin}, {implementation-record-element=CAN3_Rr_IdcMax, system-signal=CAN3_Rr_IdcMax}, {implementation-record-element=CAN3_RC_VCU2_CAN1, system-signal=CAN3_RC_VCU2_CAN1}, {implementation-record-element=CAN3_Fr_UdcMin, system-signal=CAN3_Fr_UdcMin}, {implementation-record-element=CAN3_Fr_UdcMax, system-signal=CAN3_Fr_UdcMax}, {implementation-record-element=CAN3_Fr_TorqMin, system-signal=CAN3_Fr_TorqMin}, {implementation-record-element=CAN3_Fr_TorqMax, system-signal=CAN3_Fr_TorqMax}, {implementation-record-element=CAN3_Fr_TMTqReq, system-signal=CAN3_Fr_TMTqReq}, {implementation-record-element=CAN3_Fr_IdcMin, system-signal=CAN3_Fr_IdcMin}, {implementation-record-element=CAN3_Fr_IdcMax, system-signal=CAN3_Fr_IdcMax}]}
      MAP_CAN3_MCU_F1: sender-receiver-to-signal-group-mapping{communication-direction=IN, data-element=SWC_FDC.root_FDC.R_CAN3_MCU_F1.CAN3_SG_MCU_F1, signal-group=CAN3_SG_MCU_F1, type-mapping=sender-rec-record-type-mapping=record-element-mappings=[{implementation-record-element=CAN3_Fr_ActvDmpDisabSta, system-signal=CAN3_Fr_ActvDmpDisabSta}, {implementation-record-element=CAN3_MCUWarn_F, system-signal=CAN3_MCUWarn_F}, {implementation-record-element=CAN3_Fr_TMiq, system-signal=CAN3_Fr_TMiq}, {implementation-record-element=CAN3_Fr_TMid, system-signal=CAN3_Fr_TMid}, {implementation-record-element=CAN3_Fr_TMTemp, system-signal=CAN3_Fr_TMTemp}, {implementation-record-element=CAN3_Fr_TMSpd, system-signal=CAN3_Fr_TMSpd}, {implementation-record-element=CAN3_Fr_Reserved_bits, system-signal=CAN3_Fr_Reserved_bits}, {implementation-record-element=CAN3_Fr_RegenAvailTq, system-signal=CAN3_Fr_RegenAvailTq}, {implementation-record-element=CAN3_Fr_MotorAvailTq, system-signal=CAN3_Fr_MotorAvailTq}, {implementation-record-element=CAN3_Fr_MCUTemp, system-signal=CAN3_Fr_MCUTemp}, {implementation-record-element=CAN3_Fr_MCUSysSta, system-signal=CAN3_Fr_MCUSysSta}, {implementation-record-element=CAN3_Fr_MCUReady4Pre, system-signal=CAN3_Fr_MCUReady4Pre}, {implementation-record-element=CAN3_Fr_MCUReady, system-signal=CAN3_Fr_MCUReady}, {implementation-record-element=CAN3_Fr_MCUIGN_sta, system-signal=CAN3_Fr_MCUIGN_sta}, {implementation-record-element=CAN3_Fr_MCUErr, system-signal=CAN3_Fr_MCUErr}, {implementation-record-element=CAN3_Fr_MCUEnaSta, system-signal=CAN3_Fr_MCUEnaSta}, {implementation-record-element=CAN3_Fr_MCUDischrgSta, system-signal=CAN3_Fr_MCUDischrgSta}, {implementation-record-element=CAN3_Fr_MCUDCBusVolt, system-signal=CAN3_Fr_MCUDCBusVolt}, {implementation-record-element=CAN3_Fr_MCUDCBusCurr, system-signal=CAN3_Fr_MCUDCBusCurr}, {implementation-record-element=CAN3_Fr_MCUBAT, system-signal=CAN3_Fr_MCUBAT}, {implementation-record-element=CAN3_Fr_MCU1RolCnt, system-signal=CAN3_Fr_MCU1RolCnt}, {implementation-record-element=CAN3_Fr_MCU1Chksum, system-signal=CAN3_Fr_MCU1Chksum}, {implementation-record-element=CAN3_Fr_EDUTqReqFbk, system-signal=CAN3_Fr_EDUTqReqFbk}, {implementation-record-element=CAN3_Fr_EDURotateDirction, system-signal=CAN3_Fr_EDURotateDirction}, {implementation-record-element=CAN3_Fr_EDURealTMTq, system-signal=CAN3_Fr_EDURealTMTq}, {implementation-record-element=CAN3_Fr_EDUOpratingSta, system-signal=CAN3_Fr_EDUOpratingSta}, {implementation-record-element=CAN3_Fr_EDUDrtSta, system-signal=CAN3_Fr_EDUDrtSta}]}
      MAP_CAN3_MCU_F2: sender-receiver-to-signal-group-mapping{communication-direction=IN, data-element=SWC_FDC.root_FDC.R_CAN3_MCU_F2.CAN3_SG_MCU_F2, signal-group=CAN3_SG_MCU_F2, type-mapping=sender-rec-record-type-mapping=record-element-mappings=[{implementation-record-element=CAN3_Fr_CoolanttempReq, system-signal=CAN3_Fr_CoolanttempReq}, {implementation-record-element=CAN3_MCU_F_ResetCnt_Sta, system-signal=CAN3_MCU_F_ResetCnt_Sta}, {implementation-record-element=CAN3_Fr_TMTempWarn, system-signal=CAN3_Fr_TMTempWarn}, {implementation-record-element=CAN3_Fr_MCUTempWarn, system-signal=CAN3_Fr_MCUTempWarn}, {implementation-record-element=CAN3_Fr_MCU2RolCnt, system-signal=CAN3_Fr_MCU2RolCnt}, {implementation-record-element=CAN3_Fr_MCU2Chksum, system-signal=CAN3_Fr_MCU2Chksum}, {implementation-record-element=CAN3_Fr_LLCflowReq, system-signal=CAN3_Fr_LLCflowReq}, {implementation-record-element=CAN3_Fr_LLCTemp, system-signal=CAN3_Fr_LLCTemp}, {implementation-record-element=CAN3_Fr_Failcodehistory2, system-signal=CAN3_Fr_Failcodehistory2}, {implementation-record-element=CAN3_Fr_Failcodehistory1, system-signal=CAN3_Fr_Failcodehistory1}, {implementation-record-element=CAN3_Fr_Failcode2, system-signal=CAN3_Fr_Failcode2}, {implementation-record-element=CAN3_Fr_Failcode1, system-signal=CAN3_Fr_Failcode1}, {implementation-record-element=CAN3_Fr_EOP_SpdSet, system-signal=CAN3_Fr_EOP_SpdSet}]}
      MAP_CAN3_MCU_R1: sender-receiver-to-signal-group-mapping{communication-direction=IN, data-element=SWC_FDC.root_FDC.R_CAN3_MCU_R1.CAN3_SG_MCU_R1, signal-group=CAN3_SG_MCU_R1, type-mapping=sender-rec-record-type-mapping=record-element-mappings=[{implementation-record-element=CAN3_MCUWarn_R, system-signal=CAN3_MCUWarn_R}, {implementation-record-element=CAN3_Rr_TMiq, system-signal=CAN3_Rr_TMiq}, {implementation-record-element=CAN3_Rr_TMid, system-signal=CAN3_Rr_TMid}, {implementation-record-element=CAN3_Rr_TMTemp, system-signal=CAN3_Rr_TMTemp}, {implementation-record-element=CAN3_Rr_TMSpd, system-signal=CAN3_Rr_TMSpd}, {implementation-record-element=CAN3_Rr_Reserved_bits, system-signal=CAN3_Rr_Reserved_bits}, {implementation-record-element=CAN3_Rr_RegenAvailTq, system-signal=CAN3_Rr_RegenAvailTq}, {implementation-record-element=CAN3_Rr_MotorAvailTq, system-signal=CAN3_Rr_MotorAvailTq}, {implementation-record-element=CAN3_Rr_MCUTemp, system-signal=CAN3_Rr_MCUTemp}, {implementation-record-element=CAN3_Rr_MCUSysSta, system-signal=CAN3_Rr_MCUSysSta}, {implementation-record-element=CAN3_Rr_MCUReady4Pre, system-signal=CAN3_Rr_MCUReady4Pre}, {implementation-record-element=CAN3_Rr_MCUReady, system-signal=CAN3_Rr_MCUReady}, {implementation-record-element=CAN3_Rr_MCUIGN_sta, system-signal=CAN3_Rr_MCUIGN_sta}, {implementation-record-element=CAN3_Rr_MCUErr, system-signal=CAN3_Rr_MCUErr}, {implementation-record-element=CAN3_Rr_MCUEnaSta, system-signal=CAN3_Rr_MCUEnaSta}, {implementation-record-element=CAN3_Rr_MCUDischrgSta, system-signal=CAN3_Rr_MCUDischrgSta}, {implementation-record-element=CAN3_Rr_MCUDCBusVolt, system-signal=CAN3_Rr_MCUDCBusVolt}, {implementation-record-element=CAN3_Rr_MCUDCBusCurr, system-signal=CAN3_Rr_MCUDCBusCurr}, {implementation-record-element=CAN3_Rr_MCUBAT, system-signal=CAN3_Rr_MCUBAT}, {implementation-record-element=CAN3_Rr_MCU1RolCnt, system-signal=CAN3_Rr_MCU1RolCnt}, {implementation-record-element=CAN3_Rr_MCU1Chksum, system-signal=CAN3_Rr_MCU1Chksum}, {implementation-record-element=CAN3_Rr_EDUTqReqFbk, system-signal=CAN3_Rr_EDUTqReqFbk}, {implementation-record-element=CAN3_Rr_EDURotateDirction, system-signal=CAN3_Rr_EDURotateDirction}, {implementation-record-element=CAN3_Rr_EDURealTMTq, system-signal=CAN3_Rr_EDURealTMTq}, {implementation-record-element=CAN3_Rr_EDUOpratingSta, system-signal=CAN3_Rr_EDUOpratingSta}, {implementation-record-element=CAN3_Rr_EDUDrtSta, system-signal=CAN3_Rr_EDUDrtSta}, {implementation-record-element=CAN3_Rr_ActvDmpDisabSta, system-signal=CAN3_Rr_ActvDmpDisabSta}]}
      MAP_CAN3_MCU_R2: sender-receiver-to-signal-group-mapping{communication-direction=IN, data-element=SWC_FDC.root_FDC.R_CAN3_MCU_R2.CAN3_SG_MCU_R2, signal-group=CAN3_SG_MCU_R2, type-mapping=sender-rec-record-type-mapping=record-element-mappings=[{implementation-record-element=CAN3_MCU_R_ResetCnt_Sta, system-signal=CAN3_MCU_R_ResetCnt_Sta}, {implementation-record-element=CAN3_Rr_TMTempWarn, system-signal=CAN3_Rr_TMTempWarn}, {implementation-record-element=CAN3_Rr_MCUTempWarn, system-signal=CAN3_Rr_MCUTempWarn}, {implementation-record-element=CAN3_Rr_MCU2RolCnt, system-signal=CAN3_Rr_MCU2RolCnt}, {implementation-record-element=CAN3_Rr_MCU2Chksum, system-signal=CAN3_Rr_MCU2Chksum}, {implementation-record-element=CAN3_Rr_LLCflowReq, system-signal=CAN3_Rr_LLCflowReq}, {implementation-record-element=CAN3_Rr_LLCTemp, system-signal=CAN3_Rr_LLCTemp}, {implementation-record-element=CAN3_Rr_Failcodehistory2, system-signal=CAN3_Rr_Failcodehistory2}, {implementation-record-element=CAN3_Rr_Failcodehistory1, system-signal=CAN3_Rr_Failcodehistory1}, {implementation-record-element=CAN3_Rr_Failcode2, system-signal=CAN3_Rr_Failcode2}, {implementation-record-element=CAN3_Rr_Failcode1, system-signal=CAN3_Rr_Failcode1}, {implementation-record-element=CAN3_Rr_EOP_SpdSet, system-signal=CAN3_Rr_EOP_SpdSet}, {implementation-record-element=CAN3_Rr_CoolanttempReq, system-signal=CAN3_Rr_CoolanttempReq}]}
      MAP_CAN3_Shifter1: sender-receiver-to-signal-group-mapping{communication-direction=IN, data-element=SWC_FDC.root_FDC.R_CAN3_Shifter1.CAN3_SG_Shifter1, signal-group=CAN3_SG_Shifter1, type-mapping=sender-rec-record-type-mapping=record-element-mappings=[{implementation-record-element=CAN3_Shifter_CRC8, system-signal=CAN3_Shifter_CRC8}, {implementation-record-element=CAN3_Shifter_RC, system-signal=CAN3_Shifter_RC}, {implementation-record-element=CAN3_Shifter_Handle_Cmd, system-signal=CAN3_Shifter_Handle_Cmd}, {implementation-record-element=CAN3_Shifter_Fail_sta, system-signal=CAN3_Shifter_Fail_sta}]}
      MAP_CAN4_DKC1: sender-receiver-to-signal-group-mapping{communication-direction=IN, data-element=SWC_FDC.root_FDC.R_CAN4_DKC1.CAN4_SG_DKC1, signal-group=CAN4_SG_DKC1, type-mapping=sender-rec-record-type-mapping=record-element-mappings=[{implementation-record-element=CAN4_DKC_P_BLE_RSSI, system-signal=CAN4_DKC_P_BLE_RSSI}, {implementation-record-element=CAN4_P_UID_LowPower, system-signal=CAN4_P_UID_LowPower}, {implementation-record-element=CAN4_P_KeyMode, system-signal=CAN4_P_KeyMode}, {implementation-record-element=CAN4_P_KeyMiss, system-signal=CAN4_P_KeyMiss}, {implementation-record-element=CAN4_P_Dkey_Show_IVI, system-signal=CAN4_P_Dkey_Show_IVI}, {implementation-record-element=CAN4_P_DKey_Welcome, system-signal=CAN4_P_DKey_Welcome}, {implementation-record-element=CAN4_P_DKey_Area_PTG, system-signal=CAN4_P_DKey_Area_PTG}, {implementation-record-element=CAN4_P_DKey_Area_PS, system-signal=CAN4_P_DKey_Area_PS}, {implementation-record-element=CAN4_P_DKey_Area_LockUnlock, system-signal=CAN4_P_DKey_Area_LockUnlock}, {implementation-record-element=CAN4_P_CommandToPTG, system-signal=CAN4_P_CommandToPTG}, {implementation-record-element=CAN4_P_CommandToBCM, system-signal=CAN4_P_CommandToBCM}, {implementation-record-element=CAN4_DKC_Remote_PW, system-signal=CAN4_DKC_Remote_PW}, {implementation-record-element=CAN4_DKC_Re_VehData, system-signal=CAN4_DKC_Re_VehData}, {implementation-record-element=CAN4_DKC_P_UID_BatVolt, system-signal=CAN4_DKC_P_UID_BatVolt}]}
      MAP_CAN4_DKC2: sender-receiver-to-signal-group-mapping{communication-direction=IN, data-element=SWC_FDC.root_FDC.R_CAN4_DKC2.CAN4_SG_DKC2, signal-group=CAN4_SG_DKC2, type-mapping=sender-rec-record-type-mapping=record-element-mappings=[{implementation-record-element=CAN4_EncryptionDATA_0_63, system-signal=CAN4_EncryptionDATA_0_63}, {implementation-record-element=CAN4_Random_Number_X, system-signal=CAN4_Random_Number_X}, {implementation-record-element=CAN4_EncryptionDATA_64_127, system-signal=CAN4_EncryptionDATA_64_127}]}
      MAP_CAN4_FD_DKC1: sender-receiver-to-signal-group-mapping{communication-direction=OUT, data-element=SWC_FDC.root_FDC.P_CAN4_FD_DKC1.CAN4_SG_FD_DKC1, signal-group=CAN4_SG_FD_DKC1, type-mapping=sender-rec-record-type-mapping=record-element-mappings=[{implementation-record-element=CAN4_Approach_Unlock_SW, system-signal=CAN4_Approach_Unlock_SW}, {implementation-record-element=CAN4_Walkaway_Lock_SW, system-signal=CAN4_Walkaway_Lock_SW}, {implementation-record-element=CAN4_TurnSwTimeSet, system-signal=CAN4_TurnSwTimeSet}, {implementation-record-element=CAN4_SenstivityPosition, system-signal=CAN4_SenstivityPosition}, {implementation-record-element=CAN4_PTG_Inner_SW2, system-signal=CAN4_PTG_Inner_SW2}, {implementation-record-element=CAN4_PSEAT_vent_req, system-signal=CAN4_PSEAT_vent_req}, {implementation-record-element=CAN4_OFF_AC_MODE, system-signal=CAN4_OFF_AC_MODE}, {implementation-record-element=CAN4_MCPressure_V, system-signal=CAN4_MCPressure_V}, {implementation-record-element=CAN4_MCPressure, system-signal=CAN4_MCPressure}, {implementation-record-element=CAN4_L_RRD_CtrlCmd, system-signal=CAN4_L_RRD_CtrlCmd}, {implementation-record-element=CAN4_L_RLD_CtrlCmd, system-signal=CAN4_L_RLD_CtrlCmd}, {implementation-record-element=CAN4_L_Pas_CtrlCmd, system-signal=CAN4_L_Pas_CtrlCmd}, {implementation-record-element=CAN4_L_Drv_CtrlCmd, system-signal=CAN4_L_Drv_CtrlCmd}, {implementation-record-element=CAN4_IVI_Time_Year, system-signal=CAN4_IVI_Time_Year}, {implementation-record-element=CAN4_IVI_Time_Second, system-signal=CAN4_IVI_Time_Second}, {implementation-record-element=CAN4_IVI_Time_Month, system-signal=CAN4_IVI_Time_Month}, {implementation-record-element=CAN4_IVI_Time_Minute, system-signal=CAN4_IVI_Time_Minute}, {implementation-record-element=CAN4_IVI_Time_Hour, system-signal=CAN4_IVI_Time_Hour}, {implementation-record-element=CAN4_IVI_Time_Day, system-signal=CAN4_IVI_Time_Day}, {implementation-record-element=CAN4_IVI_Time_Check, system-signal=CAN4_IVI_Time_Check}, {implementation-record-element=CAN4_IVI_PTG_USSta_SW, system-signal=CAN4_IVI_PTG_USSta_SW}, {implementation-record-element=CAN4_IVI_PTG_Sta_SW, system-signal=CAN4_IVI_PTG_Sta_SW}, {implementation-record-element=CAN4_IVI_PTG_Open_Height, system-signal=CAN4_IVI_PTG_Open_Height}, {implementation-record-element=CAN4_IVI_PTG_Mode_SW, system-signal=CAN4_IVI_PTG_Mode_SW}, {implementation-record-element=CAN4_IVI_Located_STA, system-signal=CAN4_IVI_Located_STA}, {implementation-record-element=CAN4_IVI_ISA_OffsetSpd, system-signal=CAN4_IVI_ISA_OffsetSpd}, {implementation-record-element=CAN4_Hood_Latch_SW, system-signal=CAN4_Hood_Latch_SW}, {implementation-record-element=CAN4_HeadLampSW, system-signal=CAN4_HeadLampSW}, {implementation-record-element=CAN4_FDC_THCM_ACTInitial_Cmd, system-signal=CAN4_FDC_THCM_ACTInitial_Cmd}, {implementation-record-element=CAN4_FDC_BCM_OutMode_Cmd, system-signal=CAN4_FDC_BCM_OutMode_Cmd}, {implementation-record-element=CAN4_FDC_BCM_LockAlarm_Cmd, system-signal=CAN4_FDC_BCM_LockAlarm_Cmd}, {implementation-record-element=CAN4_FDC_BCM_ATCtrl_Cmd, system-signal=CAN4_FDC_BCM_ATCtrl_Cmd}, {implementation-record-element=CAN4_DSEAT_vent_req, system-signal=CAN4_DSEAT_vent_req}, {implementation-record-element=CAN4_DSEAT_entryfun_set, system-signal=CAN4_DSEAT_entryfun_set}, {implementation-record-element=CAN4_DSEAT_anti_set, system-signal=CAN4_DSEAT_anti_set}, {implementation-record-element=CAN4_BrkSw_V, system-signal=CAN4_BrkSw_V}, {implementation-record-element=CAN4_BrkSw_Sta, system-signal=CAN4_BrkSw_Sta}, {implementation-record-element=CAN4_BrkPedalPos_Sta, system-signal=CAN4_BrkPedalPos_Sta}, {implementation-record-element=CAN4_BrkPedalPos, system-signal=CAN4_BrkPedalPos}]}
      MAP_CAN4_FD_OTA1: sender-receiver-to-signal-group-mapping{communication-direction=OUT, data-element=SWC_VES.root_FDC.P_CAN4_FD_OTA1.CAN4_SG_FD_OTA1, signal-group=CAN4_SG_FD_OTA1, type-mapping=sender-rec-record-type-mapping=record-element-mappings=[{implementation-record-element=CAN4_OTA_DL_Available, system-signal=CAN4_OTA_DL_Available}, {implementation-record-element=CAN4_OTA_Updating_ECU, system-signal=CAN4_OTA_Updating_ECU}, {implementation-record-element=CAN4_OTA_Update_Available, system-signal=CAN4_OTA_Update_Available}, {implementation-record-element=CAN4_OTA_Up_Backcount, system-signal=CAN4_OTA_Up_Backcount}, {implementation-record-element=CAN4_OTA_TBOXResetReq, system-signal=CAN4_OTA_TBOXResetReq}, {implementation-record-element=CAN4_OTA_Progress_Rate, system-signal=CAN4_OTA_Progress_Rate}, {implementation-record-element=CAN4_OTA_Network_Type, system-signal=CAN4_OTA_Network_Type}, {implementation-record-element=CAN4_OTA_Mode, system-signal=CAN4_OTA_Mode}, {implementation-record-element=CAN4_OTA_MDA_Status, system-signal=CAN4_OTA_MDA_Status}, {implementation-record-element=CAN4_OTA_Lock_Req, system-signal=CAN4_OTA_Lock_Req}, {implementation-record-element=CAN4_OTA_InVehicle_FW, system-signal=CAN4_OTA_InVehicle_FW}, {implementation-record-element=CAN4_OTA_DL_Speed, system-signal=CAN4_OTA_DL_Speed}]}
      MAP_CAN4_FD_THCM1: sender-receiver-to-signal-group-mapping{communication-direction=OUT, data-element=SWC_FDC.root_FDC.P_CAN4_FD_THCM1.CAN4_SG_FD_THCM1, signal-group=CAN4_SG_FD_THCM1, type-mapping=sender-rec-record-type-mapping=record-element-mappings=[{implementation-record-element=CAN4_BatteryMode, system-signal=CAN4_BatteryMode}, {implementation-record-element=CAN4_sigWindDirZon3St, system-signal=CAN4_sigWindDirZon3St}, {implementation-record-element=CAN4_sigWindDirZon1St, system-signal=CAN4_sigWindDirZon1St}, {implementation-record-element=CAN4_sigSetTempZon3St, system-signal=CAN4_sigSetTempZon3St}, {implementation-record-element=CAN4_sigSetTempZon2St, system-signal=CAN4_sigSetTempZon2St}, {implementation-record-element=CAN4_sigSetTempZon1St, system-signal=CAN4_sigSetTempZon1St}, {implementation-record-element=CAN4_sigRecircSt, system-signal=CAN4_sigRecircSt}, {implementation-record-element=CAN4_sigHvacSt, system-signal=CAN4_sigHvacSt}, {implementation-record-element=CAN4_sigDfrstSt, system-signal=CAN4_sigDfrstSt}, {implementation-record-element=CAN4_sigClntTHvBattOut, system-signal=CAN4_sigClntTHvBattOut}, {implementation-record-element=CAN4_sigClmtCmprPwrAct, system-signal=CAN4_sigClmtCmprPwrAct}, {implementation-record-element=CAN4_sigCbnSolarRight, system-signal=CAN4_sigCbnSolarRight}, {implementation-record-element=CAN4_sigCbnSolarLeft, system-signal=CAN4_sigCbnSolarLeft}, {implementation-record-element=CAN4_sigCbnPTCPwrAct, system-signal=CAN4_sigCbnPTCPwrAct}, {implementation-record-element=CAN4_sigCbnAirT, system-signal=CAN4_sigCbnAirT}, {implementation-record-element=CAN4_sigAmbAirT, system-signal=CAN4_sigAmbAirT}, {implementation-record-element=CAN4_sigAirIntenZon3St, system-signal=CAN4_sigAirIntenZon3St}, {implementation-record-element=CAN4_sigAirIntenZon1St, system-signal=CAN4_sigAirIntenZon1St}, {implementation-record-element=CAN4_Rr_Coolanttemp, system-signal=CAN4_Rr_Coolanttemp}, {implementation-record-element=CAN4_Rr_Coolantflow, system-signal=CAN4_Rr_Coolantflow}, {implementation-record-element=CAN4_HPThermalRecoveryReq, system-signal=CAN4_HPThermalRecoveryReq}, {implementation-record-element=CAN4_Fr_Coolanttemp, system-signal=CAN4_Fr_Coolanttemp}, {implementation-record-element=CAN4_Fr_Coolantflow, system-signal=CAN4_Fr_Coolantflow}, {implementation-record-element=CAN4_FD_RecyAuto_Cmd, system-signal=CAN4_FD_RecyAuto_Cmd}, {implementation-record-element=CAN4_FD_AGS_Cmd, system-signal=CAN4_FD_AGS_Cmd}, {implementation-record-element=CAN4_EDriveMode, system-signal=CAN4_EDriveMode}, {implementation-record-element=CAN4_CabinMode, system-signal=CAN4_CabinMode}, {implementation-record-element=CAN4_CCU_SyncLampSts, system-signal=CAN4_CCU_SyncLampSts}, {implementation-record-element=CAN4_CCU_RrOnOffLampSts, system-signal=CAN4_CCU_RrOnOffLampSts}, {implementation-record-element=CAN4_CCU_HEATMaxLampSts, system-signal=CAN4_CCU_HEATMaxLampSts}, {implementation-record-element=CAN4_CCU_FrtOnOffLampSts, system-signal=CAN4_CCU_FrtOnOffLampSts}, {implementation-record-element=CAN4_CCU_EcoSts, system-signal=CAN4_CCU_EcoSts}, {implementation-record-element=CAN4_CCU_Dispaly_Request, system-signal=CAN4_CCU_Dispaly_Request}, {implementation-record-element=CAN4_CCU_AutoMidLampSts, system-signal=CAN4_CCU_AutoMidLampSts}, {implementation-record-element=CAN4_CCU_AutoLampSts, system-signal=CAN4_CCU_AutoLampSts}, {implementation-record-element=CAN4_CCU_ACMaxLampSts, system-signal=CAN4_CCU_ACMaxLampSts}, {implementation-record-element=CAN4_CCU_ACLampSts, system-signal=CAN4_CCU_ACLampSts}]}
      MAP_CAN4_FD_THCM2: sender-receiver-to-signal-group-mapping{communication-direction=OUT, data-element=SWC_FDC.root_FDC.P_CAN4_FD_THCM2.CAN4_SG_FD_THCM2, signal-group=CAN4_SG_FD_THCM2, type-mapping=sender-rec-record-type-mapping=record-element-mappings=[{implementation-record-element=CAN4_ACSubMode, system-signal=CAN4_ACSubMode}, {implementation-record-element=CAN4_FD_TWV_Cmd, system-signal=CAN4_FD_TWV_Cmd}, {implementation-record-element=CAN4_FD_SOV3_Cmd, system-signal=CAN4_FD_SOV3_Cmd}, {implementation-record-element=CAN4_FD_SOV2_Cmd, system-signal=CAN4_FD_SOV2_Cmd}, {implementation-record-element=CAN4_FD_SOV1_Cmd, system-signal=CAN4_FD_SOV1_Cmd}, {implementation-record-element=CAN4_FD_SOTXV_Cmd, system-signal=CAN4_FD_SOTXV_Cmd}, {implementation-record-element=CAN4_FD_RrAPTCHeatPwr_Cmd, system-signal=CAN4_FD_RrAPTCHeatPwr_Cmd}, {implementation-record-element=CAN4_FD_FrWPTCHeatPwr_Cmd, system-signal=CAN4_FD_FrWPTCHeatPwr_Cmd}, {implementation-record-element=CAN4_FD_FrRiAPTCHeatPwr_Cmd, system-signal=CAN4_FD_FrRiAPTCHeatPwr_Cmd}, {implementation-record-element=CAN4_FD_FrLeAPTCHeatPwr_Cmd, system-signal=CAN4_FD_FrLeAPTCHeatPwr_Cmd}, {implementation-record-element=CAN4_FD_FWV_Cmd, system-signal=CAN4_FD_FWV_Cmd}, {implementation-record-element=CAN4_FD_EXV2_Cmd, system-signal=CAN4_FD_EXV2_Cmd}, {implementation-record-element=CAN4_FD_EXV1_Cmd, system-signal=CAN4_FD_EXV1_Cmd}, {implementation-record-element=CAN4_FD_EWP3_Cmd, system-signal=CAN4_FD_EWP3_Cmd}, {implementation-record-element=CAN4_FD_EWP2_Cmd, system-signal=CAN4_FD_EWP2_Cmd}, {implementation-record-element=CAN4_FD_EWP1_Cmd, system-signal=CAN4_FD_EWP1_Cmd}, {implementation-record-element=CAN4_FD_Comp_Cmd, system-signal=CAN4_FD_Comp_Cmd}, {implementation-record-element=CAN4_FD_Blower_Cmd, system-signal=CAN4_FD_Blower_Cmd}, {implementation-record-element=CAN4_DeiceModReq, system-signal=CAN4_DeiceModReq}, {implementation-record-element=CAN4_CoolgFanActDuty, system-signal=CAN4_CoolgFanActDuty}, {implementation-record-element=CAN4_CCU_HiVoltageReq, system-signal=CAN4_CCU_HiVoltageReq}, {implementation-record-element=CAN4_CCU_CbnPreSts, system-signal=CAN4_CCU_CbnPreSts}, {implementation-record-element=CAN4_CCU_CbnPreEstimdTi, system-signal=CAN4_CCU_CbnPreEstimdTi}, {implementation-record-element=CAN4_CCU_CbnPreACWkSts, system-signal=CAN4_CCU_CbnPreACWkSts}, {implementation-record-element=CAN4_BatLoopActWtFlw, system-signal=CAN4_BatLoopActWtFlw}, {implementation-record-element=CAN4_APTC_ActFrRiPwr, system-signal=CAN4_APTC_ActFrRiPwr}]}
      MAP_CAN4_FD_VCU1: sender-receiver-to-signal-group-mapping{communication-direction=OUT, data-element=SWC_FDC.root_FDC.P_CAN4_FD_VCU1.CAN4_SG_FD_VCU1, signal-group=CAN4_SG_FD_VCU1, type-mapping=sender-rec-record-type-mapping=record-element-mappings=[{implementation-record-element=CAN4_AllDoorSW, system-signal=CAN4_AllDoorSW}, {implementation-record-element=CAN4_WiperFixMode, system-signal=CAN4_WiperFixMode}, {implementation-record-element=CAN4_WasherCtrl, system-signal=CAN4_WasherCtrl}, {implementation-record-element=CAN4_VehSpeed, system-signal=CAN4_VehSpeed}, {implementation-record-element=CAN4_TrunkRel, system-signal=CAN4_TrunkRel}, {implementation-record-element=CAN4_TimeSNDKCFbk, system-signal=CAN4_TimeSNDKCFbk}, {implementation-record-element=CAN4_Tailgate_SW, system-signal=CAN4_Tailgate_SW}, {implementation-record-element=CAN4_TailgateRemote, system-signal=CAN4_TailgateRemote}, {implementation-record-element=CAN4_TailgateHDSW, system-signal=CAN4_TailgateHDSW}, {implementation-record-element=CAN4_ShiftGearPosn, system-signal=CAN4_ShiftGearPosn}, {implementation-record-element=CAN4_Rr_Wiper, system-signal=CAN4_Rr_Wiper}, {implementation-record-element=CAN4_Rr_FogLamp, system-signal=CAN4_Rr_FogLamp}, {implementation-record-element=CAN4_Rr_Defog, system-signal=CAN4_Rr_Defog}, {implementation-record-element=CAN4_Rr_ChargingDoorCtrl, system-signal=CAN4_Rr_ChargingDoorCtrl}, {implementation-record-element=CAN4_RoomLampL, system-signal=CAN4_RoomLampL}, {implementation-record-element=CAN4_RoomLampH, system-signal=CAN4_RoomLampH}, {implementation-record-element=CAN4_ReverseLamp, system-signal=CAN4_ReverseLamp}, {implementation-record-element=CAN4_ReBrakeLPReq, system-signal=CAN4_ReBrakeLPReq}, {implementation-record-element=CAN4_RTurnLP, system-signal=CAN4_RTurnLP}, {implementation-record-element=CAN4_RRDoorSW, system-signal=CAN4_RRDoorSW}, {implementation-record-element=CAN4_RLDoorSW, system-signal=CAN4_RLDoorSW}, {implementation-record-element=CAN4_RDRL, system-signal=CAN4_RDRL}, {implementation-record-element=CAN4_RC_VCU1_CAN4, system-signal=CAN4_RC_VCU1_CAN4}, {implementation-record-element=CAN4_RBSD, system-signal=CAN4_RBSD}, {implementation-record-element=CAN4_PwrSta, system-signal=CAN4_PwrSta}, {implementation-record-element=CAN4_PsDoorSW, system-signal=CAN4_PsDoorSW}, {implementation-record-element=CAN4_PosLamp, system-signal=CAN4_PosLamp}, {implementation-record-element=CAN4_MirrorDefog, system-signal=CAN4_MirrorDefog}, {implementation-record-element=CAN4_MirrorCtrl, system-signal=CAN4_MirrorCtrl}, {implementation-record-element=CAN4_MSA_Crl_Sta, system-signal=CAN4_MSA_Crl_Sta}, {implementation-record-element=CAN4_LockSetting, system-signal=CAN4_LockSetting}, {implementation-record-element=CAN4_LampPwr, system-signal=CAN4_LampPwr}, {implementation-record-element=CAN4_L_Beam, system-signal=CAN4_L_Beam}, {implementation-record-element=CAN4_L_APM_WdwEnable, system-signal=CAN4_L_APM_WdwEnable}, {implementation-record-element=CAN4_LTurnLP, system-signal=CAN4_LTurnLP}, {implementation-record-element=CAN4_LDRL, system-signal=CAN4_LDRL}, {implementation-record-element=CAN4_LBSD, system-signal=CAN4_LBSD}, {implementation-record-element=CAN4_HornCtrl, system-signal=CAN4_HornCtrl}, {implementation-record-element=CAN4_HoodSW, system-signal=CAN4_HoodSW}, {implementation-record-element=CAN4_HazardSW, system-signal=CAN4_HazardSW}, {implementation-record-element=CAN4_H_Beam, system-signal=CAN4_H_Beam}, {implementation-record-element=CAN4_HWResetSta, system-signal=CAN4_HWResetSta}, {implementation-record-element=CAN4_Fr_Wiper_L, system-signal=CAN4_Fr_Wiper_L}, {implementation-record-element=CAN4_Fr_Wiper_H, system-signal=CAN4_Fr_Wiper_H}, {implementation-record-element=CAN4_Fr_FogLamp, system-signal=CAN4_Fr_FogLamp}, {implementation-record-element=CAN4_Fr_ChargingDoorCtrl, system-signal=CAN4_Fr_ChargingDoorCtrl}, {implementation-record-element=CAN4_FD_TBOX_VehData_Sta, system-signal=CAN4_FD_TBOX_VehData_Sta}, {implementation-record-element=CAN4_FD_TBOX_VehData_Err, system-signal=CAN4_FD_TBOX_VehData_Err}, {implementation-record-element=CAN4_FD_TBOX_DTCData_Sta, system-signal=CAN4_FD_TBOX_DTCData_Sta}, {implementation-record-element=CAN4_FD_TBOX_DTCData_Err, system-signal=CAN4_FD_TBOX_DTCData_Err}, {implementation-record-element=CAN4_FD_DKC_VehData_Sta, system-signal=CAN4_FD_DKC_VehData_Sta}, {implementation-record-element=CAN4_FD_DKC_VehData_Err, system-signal=CAN4_FD_DKC_VehData_Err}, {implementation-record-element=CAN4_EquivAccPedalSWSta, system-signal=CAN4_EquivAccPedalSWSta}, {implementation-record-element=CAN4_Dr_SeatSta, system-signal=CAN4_Dr_SeatSta}, {implementation-record-element=CAN4_DrDoorSW, system-signal=CAN4_DrDoorSW}, {implementation-record-element=CAN4_DoorLockIND, system-signal=CAN4_DoorLockIND}, {implementation-record-element=CAN4_DimmerEN, system-signal=CAN4_DimmerEN}, {implementation-record-element=CAN4_Dimmer, system-signal=CAN4_Dimmer}, {implementation-record-element=CAN4_DKCTimeSN, system-signal=CAN4_DKCTimeSN}, {implementation-record-element=CAN4_DKCAuthSta, system-signal=CAN4_DKCAuthSta}, {implementation-record-element=CAN4_CtrlFrPwrStbA1P, system-signal=CAN4_CtrlFrPwrStbA1P}, {implementation-record-element=CAN4_CtrlFrIRC1, system-signal=CAN4_CtrlFrIRC1}, {implementation-record-element=CAN4_CtrlFrEDUINVERTER, system-signal=CAN4_CtrlFrEDUINVERTER}, {implementation-record-element=CAN4_CtrlFrBMSCCUCIR, system-signal=CAN4_CtrlFrBMSCCUCIR}, {implementation-record-element=CAN4_CtrlDrPwrStbA2, system-signal=CAN4_CtrlDrPwrStbA2}, {implementation-record-element=CAN4_CrashDetd, system-signal=CAN4_CrashDetd}, {implementation-record-element=CAN4_CTDUnlockSW, system-signal=CAN4_CTDUnlockSW}, {implementation-record-element=CAN4_CTDLockSW, system-signal=CAN4_CTDLockSW}, {implementation-record-element=CAN4_CTDCtrl, system-signal=CAN4_CTDCtrl}, {implementation-record-element=CAN4_CS_VCU1_CAN4, system-signal=CAN4_CS_VCU1_CAN4}, {implementation-record-element=CAN4_CC_Crl_Sta, system-signal=CAN4_CC_Crl_Sta}, {implementation-record-element=CAN4_BrakeLamp, system-signal=CAN4_BrakeLamp}, {implementation-record-element=CAN4_BCM_DoorLock_Sta, system-signal=CAN4_BCM_DoorLock_Sta}, {implementation-record-element=CAN4_BCM_Buzzer_Req, system-signal=CAN4_BCM_Buzzer_Req}, {implementation-record-element=CAN4_AntitheftSta, system-signal=CAN4_AntitheftSta}, {implementation-record-element=CAN4_AntiTheftSeatFold, system-signal=CAN4_AntiTheftSeatFold}, {implementation-record-element=CAN4_AmbLightColor3, system-signal=CAN4_AmbLightColor3}, {implementation-record-element=CAN4_AmbLightColor2, system-signal=CAN4_AmbLightColor2}, {implementation-record-element=CAN4_AmbLightColor1, system-signal=CAN4_AmbLightColor1}, {implementation-record-element=CAN4_AmbLightBrightness3, system-signal=CAN4_AmbLightBrightness3}, {implementation-record-element=CAN4_AmbLightBrightness2, system-signal=CAN4_AmbLightBrightness2}, {implementation-record-element=CAN4_AmbLightBrightness1, system-signal=CAN4_AmbLightBrightness1}, {implementation-record-element=CAN4_AmbLightBreath3, system-signal=CAN4_AmbLightBreath3}, {implementation-record-element=CAN4_AmbLightBreath2, system-signal=CAN4_AmbLightBreath2}, {implementation-record-element=CAN4_AmbLightBreath1, system-signal=CAN4_AmbLightBreath1}]}
      MAP_CAN4_GW_ZDR_PTG1: sender-receiver-to-signal-group-mapping{communication-direction=IN, data-element=SWC_FDC.root_FDC.R_CAN4_GW_ZDR_PTG1.CAN4_SG_GW_ZDR_PTG1, signal-group=CAN4_SG_GW_ZDR_PTG1, type-mapping=sender-rec-record-type-mapping=record-element-mappings=[{implementation-record-element=CAN4_PTG_Active_Sta, system-signal=CAN4_PTG_Active_Sta}, {implementation-record-element=CAN4_PTG_Warning_Sta, system-signal=CAN4_PTG_Warning_Sta}, {implementation-record-element=CAN4_PTG_Sys_Sta, system-signal=CAN4_PTG_Sys_Sta}, {implementation-record-element=CAN4_PTG_Strut_Current, system-signal=CAN4_PTG_Strut_Current}, {implementation-record-element=CAN4_PTG_SW_Ver, system-signal=CAN4_PTG_SW_Ver}, {implementation-record-element=CAN4_PTG_RDIL_Sta, system-signal=CAN4_PTG_RDIL_Sta}, {implementation-record-element=CAN4_PTG_Open_Ratio, system-signal=CAN4_PTG_Open_Ratio}, {implementation-record-element=CAN4_PTG_Is_Set_Height, system-signal=CAN4_PTG_Is_Set_Height}, {implementation-record-element=CAN4_PTG_Inner_SW_1, system-signal=CAN4_PTG_Inner_SW_1}, {implementation-record-element=CAN4_PTG_Half_Lock, system-signal=CAN4_PTG_Half_Lock}, {implementation-record-element=CAN4_PTG_HW_Ver, system-signal=CAN4_PTG_HW_Ver}, {implementation-record-element=CAN4_PTG_Full_Lock, system-signal=CAN4_PTG_Full_Lock}, {implementation-record-element=CAN4_PTG_Exist, system-signal=CAN4_PTG_Exist}, {implementation-record-element=CAN4_PTG_Cinch_Current, system-signal=CAN4_PTG_Cinch_Current}, {implementation-record-element=CAN4_PTG_AutoStaus, system-signal=CAN4_PTG_AutoStaus}]}
      MAP_CAN4_GW_ZoneDR1: sender-receiver-to-signal-group-mapping{communication-direction=IN, data-element=SWC_FDC.root_FDC.R_CAN4_GW_ZoneDR1.CAN4_SG_GW_ZoneDR1, signal-group=CAN4_SG_GW_ZoneDR1, type-mapping=sender-rec-record-type-mapping=record-element-mappings=[{implementation-record-element=CAN4_AllLockSta, system-signal=CAN4_AllLockSta}, {implementation-record-element=CAN4_WiperZeroPosSW, system-signal=CAN4_WiperZeroPosSW}, {implementation-record-element=CAN4_WiperSWPos, system-signal=CAN4_WiperSWPos}, {implementation-record-element=CAN4_Wip_Speed, system-signal=CAN4_Wip_Speed}, {implementation-record-element=CAN4_RWiperProtection, system-signal=CAN4_RWiperProtection}, {implementation-record-element=CAN4_RWiperAS, system-signal=CAN4_RWiperAS}, {implementation-record-element=CAN4_RRTurnLampC, system-signal=CAN4_RRTurnLampC}, {implementation-record-element=CAN4_RRLockSta, system-signal=CAN4_RRLockSta}, {implementation-record-element=CAN4_RLTurnLampC, system-signal=CAN4_RLTurnLampC}, {implementation-record-element=CAN4_RLS_RainSnrWiperCmd, system-signal=CAN4_RLS_RainSnrWiperCmd}, {implementation-record-element=CAN4_RLS_RainSnrErr, system-signal=CAN4_RLS_RainSnrErr}, {implementation-record-element=CAN4_RLS_LightSnrErr, system-signal=CAN4_RLS_LightSnrErr}, {implementation-record-element=CAN4_RLS_Lamp_Sta, system-signal=CAN4_RLS_Lamp_Sta}, {implementation-record-element=CAN4_RLS_LIN_Resp_Err, system-signal=CAN4_RLS_LIN_Resp_Err}, {implementation-record-element=CAN4_RLS_Exist, system-signal=CAN4_RLS_Exist}, {implementation-record-element=CAN4_RLLockSta, system-signal=CAN4_RLLockSta}, {implementation-record-element=CAN4_PsLockSta, system-signal=CAN4_PsLockSta}, {implementation-record-element=CAN4_MIRROR_FOLD_SW, system-signal=CAN4_MIRROR_FOLD_SW}, {implementation-record-element=CAN4_HornSW, system-signal=CAN4_HornSW}, {implementation-record-element=CAN4_DrLockSta, system-signal=CAN4_DrLockSta}, {implementation-record-element=CAN4_CSW_resp_error, system-signal=CAN4_CSW_resp_error}, {implementation-record-element=CAN4_CSW_TurnSw_Sta, system-signal=CAN4_CSW_TurnSw_Sta}, {implementation-record-element=CAN4_CSW_SW_version, system-signal=CAN4_CSW_SW_version}, {implementation-record-element=CAN4_CSW_RWipIntSw_Sta, system-signal=CAN4_CSW_RWipIntSw_Sta}, {implementation-record-element=CAN4_CSW_RWasSW_Sta, system-signal=CAN4_CSW_RWasSW_Sta}, {implementation-record-element=CAN4_CSW_PassSW_Sta, system-signal=CAN4_CSW_PassSW_Sta}, {implementation-record-element=CAN4_CSW_HW_version, system-signal=CAN4_CSW_HW_version}, {implementation-record-element=CAN4_CSW_FWipSw_Sta, system-signal=CAN4_CSW_FWipSw_Sta}, {implementation-record-element=CAN4_CSW_FWasSw_Sta, system-signal=CAN4_CSW_FWasSw_Sta}, {implementation-record-element=CAN4_CSW_DimSw, system-signal=CAN4_CSW_DimSw}, {implementation-record-element=CAN4_BrakeLampFail, system-signal=CAN4_BrakeLampFail}, {implementation-record-element=CAN4_AutoLightSW, system-signal=CAN4_AutoLightSW}]}
      MAP_CAN4_GW_ZoneDR2: sender-receiver-to-signal-group-mapping{communication-direction=IN, data-element=SWC_FDC.root_FDC.R_CAN4_GW_ZoneDR2.CAN4_SG_GW_ZoneDR2, signal-group=CAN4_SG_GW_ZoneDR2, type-mapping=sender-rec-record-type-mapping=record-element-mappings=[{implementation-record-element=CAN4_SWC_ACC_Sta, system-signal=CAN4_SWC_ACC_Sta}, {implementation-record-element=CAN4_SWC_resp_error, system-signal=CAN4_SWC_resp_error}, {implementation-record-element=CAN4_SWC_mode_Sta, system-signal=CAN4_SWC_mode_Sta}, {implementation-record-element=CAN4_SWC_VR_Sta, system-signal=CAN4_SWC_VR_Sta}, {implementation-record-element=CAN4_SWC_Up_Sta, system-signal=CAN4_SWC_Up_Sta}, {implementation-record-element=CAN4_SWC_Undefined_Sta, system-signal=CAN4_SWC_Undefined_Sta}, {implementation-record-element=CAN4_SWC_Trip_Sta, system-signal=CAN4_SWC_Trip_Sta}, {implementation-record-element=CAN4_SWC_Set_down_Sta, system-signal=CAN4_SWC_Set_down_Sta}, {implementation-record-element=CAN4_SWC_Right_Sta, system-signal=CAN4_SWC_Right_Sta}, {implementation-record-element=CAN4_SWC_Res_Up_Sta, system-signal=CAN4_SWC_Res_Up_Sta}, {implementation-record-element=CAN4_SWC_RegenUp, system-signal=CAN4_SWC_RegenUp}, {implementation-record-element=CAN4_SWC_RegenDown, system-signal=CAN4_SWC_RegenDown}, {implementation-record-element=CAN4_SWC_Left_Sta, system-signal=CAN4_SWC_Left_Sta}, {implementation-record-element=CAN4_SWC_LKA_Sta, system-signal=CAN4_SWC_LKA_Sta}, {implementation-record-element=CAN4_SWC_Drivemode_Sta, system-signal=CAN4_SWC_Drivemode_Sta}, {implementation-record-element=CAN4_SWC_Down_Sta, system-signal=CAN4_SWC_Down_Sta}, {implementation-record-element=CAN4_SWC_Distance_Sta, system-signal=CAN4_SWC_Distance_Sta}, {implementation-record-element=CAN4_SWC_CANCEL_Sta, system-signal=CAN4_SWC_CANCEL_Sta}, {implementation-record-element=CAN4_SWC_A_SW_version, system-signal=CAN4_SWC_A_SW_version}, {implementation-record-element=CAN4_SWC_A_Resp_Err, system-signal=CAN4_SWC_A_Resp_Err}, {implementation-record-element=CAN4_SWC_A_HW_version, system-signal=CAN4_SWC_A_HW_version}]}
      MAP_CAN4_GW_ZoneDR3: sender-receiver-to-signal-group-mapping{communication-direction=IN, data-element=SWC_FDC.root_FDC.R_CAN4_GW_ZoneDR3.CAN4_SG_GW_ZoneDR3, signal-group=CAN4_SG_GW_ZoneDR3, type-mapping=sender-rec-record-type-mapping=record-element-mappings=[{implementation-record-element=CAN4_FAPWL_01_LIN_Response_Error, system-signal=CAN4_FAPWL_01_LIN_Response_Error}, {implementation-record-element=CAN4_L_Power_Status, system-signal=CAN4_L_Power_Status}, {implementation-record-element=CAN4_L_Pas_Wdw_Running_Sts, system-signal=CAN4_L_Pas_Wdw_Running_Sts}, {implementation-record-element=CAN4_L_Pas_Wdw_PositionSts, system-signal=CAN4_L_Pas_Wdw_PositionSts}, {implementation-record-element=CAN4_L_Pas_Wdw_Obs_InhibitSts, system-signal=CAN4_L_Pas_Wdw_Obs_InhibitSts}, {implementation-record-element=CAN4_L_Pas_Wdw_OD_Sts, system-signal=CAN4_L_Pas_Wdw_OD_Sts}, {implementation-record-element=CAN4_L_Pas_Wdw_LocalSwitch, system-signal=CAN4_L_Pas_Wdw_LocalSwitch}, {implementation-record-element=CAN4_L_Pas_Wdw_Init, system-signal=CAN4_L_Pas_Wdw_Init}, {implementation-record-element=CAN4_L_Pas_Val_Wdw_Opened, system-signal=CAN4_L_Pas_Val_Wdw_Opened}, {implementation-record-element=CAN4_L_Pas_OverHeat_Protect, system-signal=CAN4_L_Pas_OverHeat_Protect}, {implementation-record-element=CAN4_L_Pas_Motor_Ripple_Error, system-signal=CAN4_L_Pas_Motor_Ripple_Error}, {implementation-record-element=CAN4_L_Pas_Motor_Relay_Error, system-signal=CAN4_L_Pas_Motor_Relay_Error}, {implementation-record-element=CAN4_L_Drv_Wdw_Running_Sts, system-signal=CAN4_L_Drv_Wdw_Running_Sts}, {implementation-record-element=CAN4_L_Drv_Wdw_RRD_Switch, system-signal=CAN4_L_Drv_Wdw_RRD_Switch}, {implementation-record-element=CAN4_L_Drv_Wdw_RLD_Switch, system-signal=CAN4_L_Drv_Wdw_RLD_Switch}, {implementation-record-element=CAN4_L_Drv_Wdw_PositionSts, system-signal=CAN4_L_Drv_Wdw_PositionSts}, {implementation-record-element=CAN4_L_Drv_Wdw_Pas_Switch, system-signal=CAN4_L_Drv_Wdw_Pas_Switch}, {implementation-record-element=CAN4_L_Drv_Wdw_Obs_InhibitSts, system-signal=CAN4_L_Drv_Wdw_Obs_InhibitSts}, {implementation-record-element=CAN4_L_Drv_Wdw_OD_Sts, system-signal=CAN4_L_Drv_Wdw_OD_Sts}, {implementation-record-element=CAN4_L_Drv_Wdw_LocalSwitch, system-signal=CAN4_L_Drv_Wdw_LocalSwitch}, {implementation-record-element=CAN4_L_Drv_Wdw_Init, system-signal=CAN4_L_Drv_Wdw_Init}, {implementation-record-element=CAN4_L_Drv_Val_Wdw_Opened, system-signal=CAN4_L_Drv_Val_Wdw_Opened}, {implementation-record-element=CAN4_L_Drv_OverHeat_Protect, system-signal=CAN4_L_Drv_OverHeat_Protect}, {implementation-record-element=CAN4_L_Drv_Motor_Ripple_Error, system-signal=CAN4_L_Drv_Motor_Ripple_Error}, {implementation-record-element=CAN4_L_Drv_Motor_Relay_Error, system-signal=CAN4_L_Drv_Motor_Relay_Error}, {implementation-record-element=CAN4_L_APM_IntellectClose, system-signal=CAN4_L_APM_IntellectClose}]}
      MAP_CAN4_GW_ZoneDR4: sender-receiver-to-signal-group-mapping{communication-direction=IN, data-element=SWC_FDC.root_FDC.R_CAN4_GW_ZoneDR4.CAN4_SG_GW_ZoneDR4, signal-group=CAN4_SG_GW_ZoneDR4, type-mapping=sender-rec-record-type-mapping=record-element-mappings=[{implementation-record-element=CAN4_L_RLD_Motor_Relay_Error, system-signal=CAN4_L_RLD_Motor_Relay_Error}, {implementation-record-element=CAN4_RAPWL_01_LIN_Response_Error, system-signal=CAN4_RAPWL_01_LIN_Response_Error}, {implementation-record-element=CAN4_PTG_Inner_SW_2, system-signal=CAN4_PTG_Inner_SW_2}, {implementation-record-element=CAN4_L_RRD_Wdw_Running_Sts, system-signal=CAN4_L_RRD_Wdw_Running_Sts}, {implementation-record-element=CAN4_L_RRD_Wdw_PositionSts, system-signal=CAN4_L_RRD_Wdw_PositionSts}, {implementation-record-element=CAN4_L_RRD_Wdw_Obs_InhibitSts, system-signal=CAN4_L_RRD_Wdw_Obs_InhibitSts}, {implementation-record-element=CAN4_L_RRD_Wdw_OD_Sts, system-signal=CAN4_L_RRD_Wdw_OD_Sts}, {implementation-record-element=CAN4_L_RRD_Wdw_LocalSwitch, system-signal=CAN4_L_RRD_Wdw_LocalSwitch}, {implementation-record-element=CAN4_L_RRD_Wdw_Init, system-signal=CAN4_L_RRD_Wdw_Init}, {implementation-record-element=CAN4_L_RRD_Val_Wdw_Opened, system-signal=CAN4_L_RRD_Val_Wdw_Opened}, {implementation-record-element=CAN4_L_RRD_OverHeat_Protect, system-signal=CAN4_L_RRD_OverHeat_Protect}, {implementation-record-element=CAN4_L_RRD_Motor_Ripple_Error, system-signal=CAN4_L_RRD_Motor_Ripple_Error}, {implementation-record-element=CAN4_L_RRD_Motor_Relay_Error, system-signal=CAN4_L_RRD_Motor_Relay_Error}, {implementation-record-element=CAN4_L_RLD_Wdw_Running_Sts, system-signal=CAN4_L_RLD_Wdw_Running_Sts}, {implementation-record-element=CAN4_L_RLD_Wdw_PositionSts, system-signal=CAN4_L_RLD_Wdw_PositionSts}, {implementation-record-element=CAN4_L_RLD_Wdw_Obs_InhibitSts, system-signal=CAN4_L_RLD_Wdw_Obs_InhibitSts}, {implementation-record-element=CAN4_L_RLD_Wdw_OD_Sts, system-signal=CAN4_L_RLD_Wdw_OD_Sts}, {implementation-record-element=CAN4_L_RLD_Wdw_LocalSwitch, system-signal=CAN4_L_RLD_Wdw_LocalSwitch}, {implementation-record-element=CAN4_L_RLD_Wdw_Init, system-signal=CAN4_L_RLD_Wdw_Init}, {implementation-record-element=CAN4_L_RLD_Val_Wdw_Opened, system-signal=CAN4_L_RLD_Val_Wdw_Opened}, {implementation-record-element=CAN4_L_RLD_OverHeat_Protect, system-signal=CAN4_L_RLD_OverHeat_Protect}, {implementation-record-element=CAN4_L_RLD_Motor_Ripple_Error, system-signal=CAN4_L_RLD_Motor_Ripple_Error}]}
      MAP_CAN4_GW_ZoneDR6: sender-receiver-to-signal-group-mapping{communication-direction=IN, data-element=SWC_FDC.root_FDC.R_CAN4_GW_ZoneDR6.CAN4_SG_GW_ZoneDR6, signal-group=CAN4_SG_GW_ZoneDR6, type-mapping=sender-rec-record-type-mapping=record-element-mappings=[{implementation-record-element=CAN4_FrntPTCBusLineHiV, system-signal=CAN4_FrntPTCBusLineHiV}, {implementation-record-element=CAN4_FrntPTCSupplierCod, system-signal=CAN4_FrntPTCSupplierCod}, {implementation-record-element=CAN4_FrntPTCSts, system-signal=CAN4_FrntPTCSts}, {implementation-record-element=CAN4_FrntPTCSWVers, system-signal=CAN4_FrntPTCSWVers}, {implementation-record-element=CAN4_FrntPTCRiOverAFlt, system-signal=CAN4_FrntPTCRiOverAFlt}, {implementation-record-element=CAN4_FrntPTCRiOpentCircFlt, system-signal=CAN4_FrntPTCRiOpentCircFlt}, {implementation-record-element=CAN4_FrntPTCRiIGBTTSnsrFlt, system-signal=CAN4_FrntPTCRiIGBTTSnsrFlt}, {implementation-record-element=CAN4_FrntPTCRiIGBTT, system-signal=CAN4_FrntPTCRiIGBTT}, {implementation-record-element=CAN4_FrntPTCRiIGBTShoCircFlt, system-signal=CAN4_FrntPTCRiIGBTShoCircFlt}, {implementation-record-element=CAN4_FrntPTCRiIGBTOverTFlt, system-signal=CAN4_FrntPTCRiIGBTOverTFlt}, {implementation-record-element=CAN4_FrntPTCRiCoreTSnsrFlt, system-signal=CAN4_FrntPTCRiCoreTSnsrFlt}, {implementation-record-element=CAN4_FrntPTCRiCoreT, system-signal=CAN4_FrntPTCRiCoreT}, {implementation-record-element=CAN4_FrntPTCRiCoreOverTFlt, system-signal=CAN4_FrntPTCRiCoreOverTFlt}, {implementation-record-element=CAN4_FrntPTCRiBusLineC, system-signal=CAN4_FrntPTCRiBusLineC}, {implementation-record-element=CAN4_FrntPTCRiActHeatPwr, system-signal=CAN4_FrntPTCRiActHeatPwr}, {implementation-record-element=CAN4_FrntPTCRearRiOverAFlt, system-signal=CAN4_FrntPTCRearRiOverAFlt}, {implementation-record-element=CAN4_FrntPTCRearRiOpentCircFlt, system-signal=CAN4_FrntPTCRearRiOpentCircFlt}, {implementation-record-element=CAN4_FrntPTCRearRiIGBTShoCFlt, system-signal=CAN4_FrntPTCRearRiIGBTShoCFlt}, {implementation-record-element=CAN4_FrntPTCRearRiCoreTSnsrFlt, system-signal=CAN4_FrntPTCRearRiCoreTSnsrFlt}, {implementation-record-element=CAN4_FrntPTCRearRiCoreT, system-signal=CAN4_FrntPTCRearRiCoreT}, {implementation-record-element=CAN4_FrntPTCRearRiCoreOverTFlt, system-signal=CAN4_FrntPTCRearRiCoreOverTFlt}, {implementation-record-element=CAN4_FrntPTCRearRiBusLineC, system-signal=CAN4_FrntPTCRearRiBusLineC}, {implementation-record-element=CAN4_FrntPTCRearRiActHeatPwr, system-signal=CAN4_FrntPTCRearRiActHeatPwr}, {implementation-record-element=CAN4_FrntPTCRearLeOverAFlt, system-signal=CAN4_FrntPTCRearLeOverAFlt}, {implementation-record-element=CAN4_FrntPTCRearLeOpentCircFlt, system-signal=CAN4_FrntPTCRearLeOpentCircFlt}, {implementation-record-element=CAN4_FrntPTCRearLeIGBTShoCFlt, system-signal=CAN4_FrntPTCRearLeIGBTShoCFlt}, {implementation-record-element=CAN4_FrntPTCRearLeCoreTSnsrFlt, system-signal=CAN4_FrntPTCRearLeCoreTSnsrFlt}, {implementation-record-element=CAN4_FrntPTCRearLeCoreT, system-signal=CAN4_FrntPTCRearLeCoreT}, {implementation-record-element=CAN4_FrntPTCRearLeCoreOverTFlt, system-signal=CAN4_FrntPTCRearLeCoreOverTFlt}, {implementation-record-element=CAN4_FrntPTCRearLeBusLineC, system-signal=CAN4_FrntPTCRearLeBusLineC}, {implementation-record-element=CAN4_FrntPTCRearLeActHeatPwr, system-signal=CAN4_FrntPTCRearLeActHeatPwr}, {implementation-record-element=CAN4_FrntPTCPCBTSnsrFlt, system-signal=CAN4_FrntPTCPCBTSnsrFlt}, {implementation-record-element=CAN4_FrntPTCPCBT, system-signal=CAN4_FrntPTCPCBT}, {implementation-record-element=CAN4_FrntPTCPCBOverTFlt, system-signal=CAN4_FrntPTCPCBOverTFlt}, {implementation-record-element=CAN4_FrntPTCLeOverAFlt, system-signal=CAN4_FrntPTCLeOverAFlt}, {implementation-record-element=CAN4_FrntPTCLeOpentCircFlt, system-signal=CAN4_FrntPTCLeOpentCircFlt}, {implementation-record-element=CAN4_FrntPTCLeIGBTTSnsrFlt, system-signal=CAN4_FrntPTCLeIGBTTSnsrFlt}, {implementation-record-element=CAN4_FrntPTCLeIGBTT, system-signal=CAN4_FrntPTCLeIGBTT}, {implementation-record-element=CAN4_FrntPTCLeIGBTShoCircFlt, system-signal=CAN4_FrntPTCLeIGBTShoCircFlt}, {implementation-record-element=CAN4_FrntPTCLeIGBTOverTFlt, system-signal=CAN4_FrntPTCLeIGBTOverTFlt}, {implementation-record-element=CAN4_FrntPTCLeCoreTSnsrFlt, system-signal=CAN4_FrntPTCLeCoreTSnsrFlt}, {implementation-record-element=CAN4_FrntPTCLeCoreT, system-signal=CAN4_FrntPTCLeCoreT}, {implementation-record-element=CAN4_FrntPTCLeCoreOverTFlt, system-signal=CAN4_FrntPTCLeCoreOverTFlt}, {implementation-record-element=CAN4_FrntPTCLeBusLineC, system-signal=CAN4_FrntPTCLeBusLineC}, {implementation-record-element=CAN4_FrntPTCLeActHeatPwr, system-signal=CAN4_FrntPTCLeActHeatPwr}, {implementation-record-element=CAN4_FrntPTCLVUnderUFlt, system-signal=CAN4_FrntPTCLVUnderUFlt}, {implementation-record-element=CAN4_FrntPTCLVOverUFlt, system-signal=CAN4_FrntPTCLVOverUFlt}, {implementation-record-element=CAN4_FrntPTCHWVers, system-signal=CAN4_FrntPTCHWVers}, {implementation-record-element=CAN4_FrntPTCHVUnderUFlt, system-signal=CAN4_FrntPTCHVUnderUFlt}, {implementation-record-element=CAN4_FrntPTCHVOverUFlt, system-signal=CAN4_FrntPTCHVOverUFlt}, {implementation-record-element=CAN4_FrntPTCFltSt, system-signal=CAN4_FrntPTCFltSt}, {implementation-record-element=CAN4_FrntPTCComFlt, system-signal=CAN4_FrntPTCComFlt}]}
      MAP_CAN4_GW_ZoneFR1: sender-receiver-to-signal-group-mapping{communication-direction=IN, data-element=SWC_FDC.root_FDC.R_CAN4_GW_ZoneFR1.CAN4_SG_GW_ZoneFR1, signal-group=CAN4_SG_GW_ZoneFR1, type-mapping=sender-rec-record-type-mapping=record-element-mappings=[{implementation-record-element=CAN4_AGS_Actual_Position, system-signal=CAN4_AGS_Actual_Position}, {implementation-record-element=CAN4_FWiperProtection, system-signal=CAN4_FWiperProtection}, {implementation-record-element=CAN4_FWiperAS, system-signal=CAN4_FWiperAS}, {implementation-record-element=CAN4_FRTurnLampC, system-signal=CAN4_FRTurnLampC}, {implementation-record-element=CAN4_FLTurnLampC, system-signal=CAN4_FLTurnLampC}, {implementation-record-element=CAN4_EXV_Cmd_Set_Rq, system-signal=CAN4_EXV_Cmd_Set_Rq}, {implementation-record-element=CAN4_EXV_Cmd_Move_Enbl, system-signal=CAN4_EXV_Cmd_Move_Enbl}, {implementation-record-element=CAN4_EXV_Cmd_Init_Rq, system-signal=CAN4_EXV_Cmd_Init_Rq}, {implementation-record-element=CAN4_EXV2_Cmd_Set_Rq, system-signal=CAN4_EXV2_Cmd_Set_Rq}, {implementation-record-element=CAN4_EXV2_Cmd_Move_Enbl, system-signal=CAN4_EXV2_Cmd_Move_Enbl}, {implementation-record-element=CAN4_EXV2_Cmd_Init_Rq, system-signal=CAN4_EXV2_Cmd_Init_Rq}, {implementation-record-element=CAN4_EWP3_RPM_Target_EWP_Rq, system-signal=CAN4_EWP3_RPM_Target_EWP_Rq}, {implementation-record-element=CAN4_EWP3_Default_Operation_EWP_Rq, system-signal=CAN4_EWP3_Default_Operation_EWP_Rq}, {implementation-record-element=CAN4_EWP2_RPM_Target_EWP_Rq, system-signal=CAN4_EWP2_RPM_Target_EWP_Rq}, {implementation-record-element=CAN4_EWP2_Default_Operation_EWP_Rq, system-signal=CAN4_EWP2_Default_Operation_EWP_Rq}, {implementation-record-element=CAN4_EWP1_RPM_Target_EWP_Rq, system-signal=CAN4_EWP1_RPM_Target_EWP_Rq}, {implementation-record-element=CAN4_EWP1_Default_Operation_EWP_Rq, system-signal=CAN4_EWP1_Default_Operation_EWP_Rq}, {implementation-record-element=CAN4_ChargeInletLockSta, system-signal=CAN4_ChargeInletLockSta}, {implementation-record-element=CAN4_CCV4_ReqMovePos, system-signal=CAN4_CCV4_ReqMovePos}, {implementation-record-element=CAN4_CCV4_MoveEnable, system-signal=CAN4_CCV4_MoveEnable}, {implementation-record-element=CAN4_BDC_1_ReqMovePos, system-signal=CAN4_BDC_1_ReqMovePos}, {implementation-record-element=CAN4_BDC_1_MoveEnable, system-signal=CAN4_BDC_1_MoveEnable}, {implementation-record-element=CAN4_AGS_Temperature_Error, system-signal=CAN4_AGS_Temperature_Error}, {implementation-record-element=CAN4_AGS_Sensor_Error, system-signal=CAN4_AGS_Sensor_Error}, {implementation-record-element=CAN4_AGS_Position_Request, system-signal=CAN4_AGS_Position_Request}, {implementation-record-element=CAN4_AGS_Low_Voltage_Error, system-signal=CAN4_AGS_Low_Voltage_Error}, {implementation-record-element=CAN4_AGS_LINResponse_Error, system-signal=CAN4_AGS_LINResponse_Error}, {implementation-record-element=CAN4_AGS_Electrical_Error, system-signal=CAN4_AGS_Electrical_Error}, {implementation-record-element=CAN4_AGS_Calibration_Indicated, system-signal=CAN4_AGS_Calibration_Indicated}, {implementation-record-element=CAN4_AGS_Calibration_Enabled, system-signal=CAN4_AGS_Calibration_Enabled}, {implementation-record-element=CAN4_AGS_Calibration_Active, system-signal=CAN4_AGS_Calibration_Active}, {implementation-record-element=CAN4_AGS_Actuator_Fault, system-signal=CAN4_AGS_Actuator_Fault}, {implementation-record-element=CAN4_AGS_Actuator_Blocked, system-signal=CAN4_AGS_Actuator_Blocked}]}
      MAP_CAN4_GW_ZoneFR2: sender-receiver-to-signal-group-mapping{communication-direction=IN, data-element=SWC_FDC.root_FDC.R_CAN4_GW_ZoneFR2.CAN4_SG_GW_ZoneFR2, signal-group=CAN4_SG_GW_ZoneFR2, type-mapping=sender-rec-record-type-mapping=record-element-mappings=[{implementation-record-element=CAN4_BMSPackVol_h6HSC6, system-signal=CAN4_BMSPackVol_h6HSC6}, {implementation-record-element=CAN4_PTCUnderVolHSC6, system-signal=CAN4_PTCUnderVolHSC6}, {implementation-record-element=CAN4_PTCStsHSC6, system-signal=CAN4_PTCStsHSC6}, {implementation-record-element=CAN4_PTCSecRlngCtrHSC6, system-signal=CAN4_PTCSecRlngCtrHSC6}, {implementation-record-element=CAN4_PTCSecChksmHSC6, system-signal=CAN4_PTCSecChksmHSC6}, {implementation-record-element=CAN4_PTCRlngCtrHSC6, system-signal=CAN4_PTCRlngCtrHSC6}, {implementation-record-element=CAN4_PTCPCBTemHSC6, system-signal=CAN4_PTCPCBTemHSC6}, {implementation-record-element=CAN4_PTCOverVolHSC6, system-signal=CAN4_PTCOverVolHSC6}, {implementation-record-element=CAN4_PTCOverHeatHSC6, system-signal=CAN4_PTCOverHeatHSC6}, {implementation-record-element=CAN4_PTCOverCrntHSC6, system-signal=CAN4_PTCOverCrntHSC6}, {implementation-record-element=CAN4_PTCOtptTemHSC6, system-signal=CAN4_PTCOtptTemHSC6}, {implementation-record-element=CAN4_PTCNTCStsHSC6, system-signal=CAN4_PTCNTCStsHSC6}, {implementation-record-element=CAN4_PTCIGBTTemHSC6, system-signal=CAN4_PTCIGBTTemHSC6}, {implementation-record-element=CAN4_PTCIGBTStsHSC6, system-signal=CAN4_PTCIGBTStsHSC6}, {implementation-record-element=CAN4_PTCIGBTOverHeatHSC6, system-signal=CAN4_PTCIGBTOverHeatHSC6}, {implementation-record-element=CAN4_PTCHVLckStsHSC6, system-signal=CAN4_PTCHVLckStsHSC6}, {implementation-record-element=CAN4_PTCFltLvlHSC6, system-signal=CAN4_PTCFltLvlHSC6}, {implementation-record-element=CAN4_PTCChksmHSC6, system-signal=CAN4_PTCChksmHSC6}, {implementation-record-element=CAN4_PTCActuVolHSC6, system-signal=CAN4_PTCActuVolHSC6}, {implementation-record-element=CAN4_PTCActuPWMDutyHSC6, system-signal=CAN4_PTCActuPWMDutyHSC6}, {implementation-record-element=CAN4_PTCActuCrntHSC6, system-signal=CAN4_PTCActuCrntHSC6}, {implementation-record-element=CAN4_EAC_TempSnsrFalt, system-signal=CAN4_EAC_TempSnsrFalt}, {implementation-record-element=CAN4_EAC_Temp, system-signal=CAN4_EAC_Temp}, {implementation-record-element=CAN4_EAC_OvLoadFalt, system-signal=CAN4_EAC_OvLoadFalt}, {implementation-record-element=CAN4_EAC_MotorLackFalt, system-signal=CAN4_EAC_MotorLackFalt}, {implementation-record-element=CAN4_EAC_MotCrt, system-signal=CAN4_EAC_MotCrt}, {implementation-record-element=CAN4_EAC_DrvVoltFalt, system-signal=CAN4_EAC_DrvVoltFalt}, {implementation-record-element=CAN4_CompProEN, system-signal=CAN4_CompProEN}, {implementation-record-element=CAN4_COMP_VoltVaild, system-signal=CAN4_COMP_VoltVaild}, {implementation-record-element=CAN4_COMP_VoltOverErr, system-signal=CAN4_COMP_VoltOverErr}, {implementation-record-element=CAN4_COMP_VoltLessErr, system-signal=CAN4_COMP_VoltLessErr}, {implementation-record-element=CAN4_COMP_StatorSpd, system-signal=CAN4_COMP_StatorSpd}, {implementation-record-element=CAN4_COMP_Sta, system-signal=CAN4_COMP_Sta}, {implementation-record-element=CAN4_COMP_SpdVaild, system-signal=CAN4_COMP_SpdVaild}, {implementation-record-element=CAN4_COMP_Init, system-signal=CAN4_COMP_Init}, {implementation-record-element=CAN4_COMP_IPM_TempOverFlt, system-signal=CAN4_COMP_IPM_TempOverFlt}, {implementation-record-element=CAN4_COMP_IPM_HWFLt, system-signal=CAN4_COMP_IPM_HWFLt}, {implementation-record-element=CAN4_COMP_CurVaild, system-signal=CAN4_COMP_CurVaild}, {implementation-record-element=CAN4_COMP_CurOverProtect, system-signal=CAN4_COMP_CurOverProtect}, {implementation-record-element=CAN4_COMP_CtrlCircFlt, system-signal=CAN4_COMP_CtrlCircFlt}, {implementation-record-element=CAN4_COMP_ConVolt, system-signal=CAN4_COMP_ConVolt}, {implementation-record-element=CAN4_COMP_ConCur, system-signal=CAN4_COMP_ConCur}, {implementation-record-element=CAN4_COMP_ComLost, system-signal=CAN4_COMP_ComLost}, {implementation-record-element=CAN4_CCM_SpdCmd, system-signal=CAN4_CCM_SpdCmd}]}
      MAP_CAN4_Zone_Dr_SCP: sender-receiver-to-signal-group-mapping{communication-direction=IN, data-element=SWC_FDC.root_FDC.R_CAN4_Zone_Dr_SCP.CAN4_SG_Zone_Dr_SCP, signal-group=CAN4_SG_Zone_Dr_SCP, type-mapping=sender-rec-record-type-mapping=record-element-mappings=[{implementation-record-element=CAN4_DrSCPSysErrLmp, system-signal=CAN4_DrSCPSysErrLmp}, {implementation-record-element=CAN4_Zone_Spd_Ctrl_Sta, system-signal=CAN4_Zone_Spd_Ctrl_Sta}, {implementation-record-element=CAN4_Zone_Spd_Ctrl_Mode, system-signal=CAN4_Zone_Spd_Ctrl_Mode}, {implementation-record-element=CAN4_Set_Spd, system-signal=CAN4_Set_Spd}, {implementation-record-element=CAN4_RegenMode, system-signal=CAN4_RegenMode}]}
      MAP_CAN4_Zone_Dr_THCM: sender-receiver-to-signal-group-mapping{communication-direction=IN, data-element=SWC_FDC.root_FDC.R_CAN4_Zone_Dr_THCM.CAN4_SG_Zone_Dr_THCM, signal-group=CAN4_SG_Zone_Dr_THCM, type-mapping=sender-rec-record-type-mapping=record-element-mappings=[{implementation-record-element=CAN4_APTC_Err, system-signal=CAN4_APTC_Err}, {implementation-record-element=CAN4_ZDR_THCM_ModeFail_Sta, system-signal=CAN4_ZDR_THCM_ModeFail_Sta}, {implementation-record-element=CAN4_ZDR_THCM_LINACT5_Sta, system-signal=CAN4_ZDR_THCM_LINACT5_Sta}, {implementation-record-element=CAN4_ZDR_THCM_LINACT4_Sta, system-signal=CAN4_ZDR_THCM_LINACT4_Sta}, {implementation-record-element=CAN4_ZDR_THCM_LINACT3_Sta, system-signal=CAN4_ZDR_THCM_LINACT3_Sta}, {implementation-record-element=CAN4_ZDR_THCM_LINACT2_Sta, system-signal=CAN4_ZDR_THCM_LINACT2_Sta}, {implementation-record-element=CAN4_ZDR_THCM_LINACT1_Sta, system-signal=CAN4_ZDR_THCM_LINACT1_Sta}, {implementation-record-element=CAN4_ZDR_THCM_IntakeFail_Sta, system-signal=CAN4_ZDR_THCM_IntakeFail_Sta}, {implementation-record-element=CAN4_Tincar_Err, system-signal=CAN4_Tincar_Err}, {implementation-record-element=CAN4_Tincar, system-signal=CAN4_Tincar}, {implementation-record-element=CAN4_Tevap_Err, system-signal=CAN4_Tevap_Err}, {implementation-record-element=CAN4_Tevap, system-signal=CAN4_Tevap}, {implementation-record-element=CAN4_T_Foot_Rr_Err, system-signal=CAN4_T_Foot_Rr_Err}, {implementation-record-element=CAN4_T_Foot_Rr, system-signal=CAN4_T_Foot_Rr}, {implementation-record-element=CAN4_T_Foot_R_Err, system-signal=CAN4_T_Foot_R_Err}, {implementation-record-element=CAN4_T_Foot_R, system-signal=CAN4_T_Foot_R}, {implementation-record-element=CAN4_T_Foot_L_Err, system-signal=CAN4_T_Foot_L_Err}, {implementation-record-element=CAN4_T_Foot_L, system-signal=CAN4_T_Foot_L}, {implementation-record-element=CAN4_T_Face_Rr_Err, system-signal=CAN4_T_Face_Rr_Err}, {implementation-record-element=CAN4_T_Face_Rr, system-signal=CAN4_T_Face_Rr}, {implementation-record-element=CAN4_T_Face_R_Err, system-signal=CAN4_T_Face_R_Err}, {implementation-record-element=CAN4_T_Face_R, system-signal=CAN4_T_Face_R}, {implementation-record-element=CAN4_T_Face_L_Err, system-signal=CAN4_T_Face_L_Err}, {implementation-record-element=CAN4_T_Face_L, system-signal=CAN4_T_Face_L}, {implementation-record-element=CAN4_SolarR_Err, system-signal=CAN4_SolarR_Err}, {implementation-record-element=CAN4_SolarR, system-signal=CAN4_SolarR}, {implementation-record-element=CAN4_SolarL_Err, system-signal=CAN4_SolarL_Err}, {implementation-record-element=CAN4_SolarL, system-signal=CAN4_SolarL}, {implementation-record-element=CAN4_Blower_FB, system-signal=CAN4_Blower_FB}, {implementation-record-element=CAN4_Blower_Err, system-signal=CAN4_Blower_Err}]}
      MAP_CAN4_Zone_Dr_VCU: sender-receiver-to-signal-group-mapping{communication-direction=IN, data-element=SWC_FDC.root_FDC.R_CAN4_Zone_Dr_VCU.CAN4_SG_Zone_Dr_VCU, signal-group=CAN4_SG_Zone_Dr_VCU, type-mapping=sender-rec-record-type-mapping=record-element-mappings=[{implementation-record-element=CAN4_DrAPWLINErr, system-signal=CAN4_DrAPWLINErr}, {implementation-record-element=CAN4_ZoneDrMalfunLevel, system-signal=CAN4_ZoneDrMalfunLevel}, {implementation-record-element=CAN4_ZDR_VCU_PwrSupply_Sta, system-signal=CAN4_ZDR_VCU_PwrSupply_Sta}, {implementation-record-element=CAN4_ZDR_VCU_HWReset_Sta, system-signal=CAN4_ZDR_VCU_HWReset_Sta}, {implementation-record-element=CAN4_ZDR_SYS_CSWRetryCnt_Sta, system-signal=CAN4_ZDR_SYS_CSWRetryCnt_Sta}, {implementation-record-element=CAN4_ZDR_SYS_BSWSleepReq_Sta, system-signal=CAN4_ZDR_SYS_BSWSleepReq_Sta}, {implementation-record-element=CAN4_ZDR_SYS_APMRetryCnt_Sta, system-signal=CAN4_ZDR_SYS_APMRetryCnt_Sta}, {implementation-record-element=CAN4_DrTHCMFault, system-signal=CAN4_DrTHCMFault}, {implementation-record-element=CAN4_DrStdAErrSta, system-signal=CAN4_DrStdAErrSta}, {implementation-record-element=CAN4_DrPwrWindowECUFault, system-signal=CAN4_DrPwrWindowECUFault}, {implementation-record-element=CAN4_DrPwrWinErrSta, system-signal=CAN4_DrPwrWinErrSta}, {implementation-record-element=CAN4_DrPwrStdbyACurr, system-signal=CAN4_DrPwrStdbyACurr}, {implementation-record-element=CAN4_DrPwrSta, system-signal=CAN4_DrPwrSta}, {implementation-record-element=CAN4_DrPwrONA2Curr, system-signal=CAN4_DrPwrONA2Curr}, {implementation-record-element=CAN4_DrPwrONA1Curr, system-signal=CAN4_DrPwrONA1Curr}, {implementation-record-element=CAN4_DrPwrInformationSta, system-signal=CAN4_DrPwrInformationSta}, {implementation-record-element=CAN4_DrPowerTemp2, system-signal=CAN4_DrPowerTemp2}, {implementation-record-element=CAN4_DrPowerTemp1, system-signal=CAN4_DrPowerTemp1}, {implementation-record-element=CAN4_DrPMMSysErrLmp, system-signal=CAN4_DrPMMSysErrLmp}, {implementation-record-element=CAN4_DrPMMLimpHomeActReq, system-signal=CAN4_DrPMMLimpHomeActReq}, {implementation-record-element=CAN4_DrPMMLVOutPErrLmp, system-signal=CAN4_DrPMMLVOutPErrLmp}, {implementation-record-element=CAN4_DrONA1ErrSta, system-signal=CAN4_DrONA1ErrSta}, {implementation-record-element=CAN4_DrInfoFault, system-signal=CAN4_DrInfoFault}, {implementation-record-element=CAN4_DrInfoErrSta, system-signal=CAN4_DrInfoErrSta}, {implementation-record-element=CAN4_DrIVIFault, system-signal=CAN4_DrIVIFault}, {implementation-record-element=CAN4_DrEOBDFault, system-signal=CAN4_DrEOBDFault}, {implementation-record-element=CAN4_DrCtrlTemp, system-signal=CAN4_DrCtrlTemp}, {implementation-record-element=CAN4_DrCtrlBDVolt, system-signal=CAN4_DrCtrlBDVolt}, {implementation-record-element=CAN4_DrColumnSWFault, system-signal=CAN4_DrColumnSWFault}, {implementation-record-element=CAN4_DrAuBoxPwrN2Curr, system-signal=CAN4_DrAuBoxPwrN2Curr}, {implementation-record-element=CAN4_DrAuBoxPwrN1Curr, system-signal=CAN4_DrAuBoxPwrN1Curr}, {implementation-record-element=CAN4_DrAPWStaErr, system-signal=CAN4_DrAPWStaErr}]}
      MAP_CAN4_Zone_Fr_THCM: sender-receiver-to-signal-group-mapping{communication-direction=IN, data-element=SWC_FDC.root_FDC.R_CAN4_Zone_Fr_THCM.CAN4_SG_Zone_Fr_THCM, signal-group=CAN4_SG_Zone_Fr_THCM, type-mapping=sender-rec-record-type-mapping=record-element-mappings=[{implementation-record-element=CAN4_AGS_Err, system-signal=CAN4_AGS_Err}, {implementation-record-element=CAN4_WPTC_Err, system-signal=CAN4_WPTC_Err}, {implementation-record-element=CAN4_Tamb_Err, system-signal=CAN4_Tamb_Err}, {implementation-record-element=CAN4_Tamb, system-signal=CAN4_Tamb}, {implementation-record-element=CAN4_TWV_Err, system-signal=CAN4_TWV_Err}, {implementation-record-element=CAN4_SOV3_Err, system-signal=CAN4_SOV3_Err}, {implementation-record-element=CAN4_SOV2_Err, system-signal=CAN4_SOV2_Err}, {implementation-record-element=CAN4_SOV1_Err, system-signal=CAN4_SOV1_Err}, {implementation-record-element=CAN4_SOTXV_Err, system-signal=CAN4_SOTXV_Err}, {implementation-record-element=CAN4_PT_Low_T2_Err, system-signal=CAN4_PT_Low_T2_Err}, {implementation-record-element=CAN4_PT_Low_T2, system-signal=CAN4_PT_Low_T2}, {implementation-record-element=CAN4_PT_Low_T1_Err, system-signal=CAN4_PT_Low_T1_Err}, {implementation-record-element=CAN4_PT_Low_T1, system-signal=CAN4_PT_Low_T1}, {implementation-record-element=CAN4_PT_Low_P2_Err, system-signal=CAN4_PT_Low_P2_Err}, {implementation-record-element=CAN4_PT_Low_P2, system-signal=CAN4_PT_Low_P2}, {implementation-record-element=CAN4_PT_Low_P1_Err, system-signal=CAN4_PT_Low_P1_Err}, {implementation-record-element=CAN4_PT_Low_P1, system-signal=CAN4_PT_Low_P1}, {implementation-record-element=CAN4_PT_High_Tact_Err, system-signal=CAN4_PT_High_Tact_Err}, {implementation-record-element=CAN4_PT_High_Tact, system-signal=CAN4_PT_High_Tact}, {implementation-record-element=CAN4_PT_High_T, system-signal=CAN4_PT_High_T}, {implementation-record-element=CAN4_PT_High_P_Err, system-signal=CAN4_PT_High_P_Err}, {implementation-record-element=CAN4_PT_High_P, system-signal=CAN4_PT_High_P}, {implementation-record-element=CAN4_Motor_Out_Temp_Err, system-signal=CAN4_Motor_Out_Temp_Err}, {implementation-record-element=CAN4_Motor_Out_Temp, system-signal=CAN4_Motor_Out_Temp}, {implementation-record-element=CAN4_Motor_In_Temp_Err, system-signal=CAN4_Motor_In_Temp_Err}, {implementation-record-element=CAN4_Motor_In_Temp, system-signal=CAN4_Motor_In_Temp}, {implementation-record-element=CAN4_Fan_Err, system-signal=CAN4_Fan_Err}, {implementation-record-element=CAN4_FWV_Err, system-signal=CAN4_FWV_Err}, {implementation-record-element=CAN4_EXV2_Err, system-signal=CAN4_EXV2_Err}, {implementation-record-element=CAN4_EXV1_Err, system-signal=CAN4_EXV1_Err}, {implementation-record-element=CAN4_EWP3_Err, system-signal=CAN4_EWP3_Err}, {implementation-record-element=CAN4_EWP2_Err, system-signal=CAN4_EWP2_Err}, {implementation-record-element=CAN4_EWP1_Err, system-signal=CAN4_EWP1_Err}, {implementation-record-element=CAN4_EACProtectEnable, system-signal=CAN4_EACProtectEnable}, {implementation-record-element=CAN4_COMP_Err, system-signal=CAN4_COMP_Err}, {implementation-record-element=CAN4_Bat_Out_Temp_Err, system-signal=CAN4_Bat_Out_Temp_Err}, {implementation-record-element=CAN4_Bat_Out_Temp, system-signal=CAN4_Bat_Out_Temp}, {implementation-record-element=CAN4_Bat_In_Temp_Err, system-signal=CAN4_Bat_In_Temp_Err}, {implementation-record-element=CAN4_Bat_In_Temp, system-signal=CAN4_Bat_In_Temp}]}
      MAP_CAN5_FD_BCM1: sender-receiver-to-signal-group-mapping{communication-direction=OUT, data-element=SWC_FDC.root_FDC.P_CAN5_FD_BCM1.CAN5_SG_FD_BCM1, signal-group=CAN5_SG_FD_BCM1, type-mapping=sender-rec-record-type-mapping=record-element-mappings=[{implementation-record-element=CAN5_AllDoorSW, system-signal=CAN5_AllDoorSW}, {implementation-record-element=CAN5_WiperFixMode, system-signal=CAN5_WiperFixMode}, {implementation-record-element=CAN5_WasherCtrl, system-signal=CAN5_WasherCtrl}, {implementation-record-element=CAN5_TrunkRel, system-signal=CAN5_TrunkRel}, {implementation-record-element=CAN5_Tailgate_SW, system-signal=CAN5_Tailgate_SW}, {implementation-record-element=CAN5_TailgateRemote, system-signal=CAN5_TailgateRemote}, {implementation-record-element=CAN5_TailgateHDSW, system-signal=CAN5_TailgateHDSW}, {implementation-record-element=CAN5_Rr_Wiper, system-signal=CAN5_Rr_Wiper}, {implementation-record-element=CAN5_Rr_FogLamp, system-signal=CAN5_Rr_FogLamp}, {implementation-record-element=CAN5_Rr_Defog, system-signal=CAN5_Rr_Defog}, {implementation-record-element=CAN5_Rr_ChargingDoorCtrl, system-signal=CAN5_Rr_ChargingDoorCtrl}, {implementation-record-element=CAN5_RoomLampL, system-signal=CAN5_RoomLampL}, {implementation-record-element=CAN5_RoomLampH, system-signal=CAN5_RoomLampH}, {implementation-record-element=CAN5_ReverseLamp, system-signal=CAN5_ReverseLamp}, {implementation-record-element=CAN5_RTurnLP, system-signal=CAN5_RTurnLP}, {implementation-record-element=CAN5_RRDoorSW, system-signal=CAN5_RRDoorSW}, {implementation-record-element=CAN5_RLDoorSW, system-signal=CAN5_RLDoorSW}, {implementation-record-element=CAN5_RDRL, system-signal=CAN5_RDRL}, {implementation-record-element=CAN5_RBSD, system-signal=CAN5_RBSD}, {implementation-record-element=CAN5_PsDoorSW, system-signal=CAN5_PsDoorSW}, {implementation-record-element=CAN5_PosLamp, system-signal=CAN5_PosLamp}, {implementation-record-element=CAN5_MirrorDefog, system-signal=CAN5_MirrorDefog}, {implementation-record-element=CAN5_MirrorCtrl, system-signal=CAN5_MirrorCtrl}, {implementation-record-element=CAN5_LockSetting, system-signal=CAN5_LockSetting}, {implementation-record-element=CAN5_L_Beam, system-signal=CAN5_L_Beam}, {implementation-record-element=CAN5_L_APM_WdwEnable, system-signal=CAN5_L_APM_WdwEnable}, {implementation-record-element=CAN5_LTurnLP, system-signal=CAN5_LTurnLP}, {implementation-record-element=CAN5_LDRL, system-signal=CAN5_LDRL}, {implementation-record-element=CAN5_LBSD, system-signal=CAN5_LBSD}, {implementation-record-element=CAN5_HornCtrl, system-signal=CAN5_HornCtrl}, {implementation-record-element=CAN5_HoodSW, system-signal=CAN5_HoodSW}, {implementation-record-element=CAN5_HazardSW, system-signal=CAN5_HazardSW}, {implementation-record-element=CAN5_H_Beam, system-signal=CAN5_H_Beam}, {implementation-record-element=CAN5_Fr_Wiper_L, system-signal=CAN5_Fr_Wiper_L}, {implementation-record-element=CAN5_Fr_Wiper_H, system-signal=CAN5_Fr_Wiper_H}, {implementation-record-element=CAN5_Fr_FogLamp, system-signal=CAN5_Fr_FogLamp}, {implementation-record-element=CAN5_Fr_ChargingDoorCtrl, system-signal=CAN5_Fr_ChargingDoorCtrl}, {implementation-record-element=CAN5_DrDoorSW, system-signal=CAN5_DrDoorSW}, {implementation-record-element=CAN5_DoorLockIND, system-signal=CAN5_DoorLockIND}, {implementation-record-element=CAN5_DimmerEN, system-signal=CAN5_DimmerEN}, {implementation-record-element=CAN5_Dimmer, system-signal=CAN5_Dimmer}, {implementation-record-element=CAN5_CrashDetd, system-signal=CAN5_CrashDetd}, {implementation-record-element=CAN5_CTDUnlockSW, system-signal=CAN5_CTDUnlockSW}, {implementation-record-element=CAN5_CTDLockSW, system-signal=CAN5_CTDLockSW}, {implementation-record-element=CAN5_CTDCtrl, system-signal=CAN5_CTDCtrl}, {implementation-record-element=CAN5_BrakeLamp, system-signal=CAN5_BrakeLamp}, {implementation-record-element=CAN5_BCM_DoorLock_Sta, system-signal=CAN5_BCM_DoorLock_Sta}, {implementation-record-element=CAN5_BCM_Buzzer_Req, system-signal=CAN5_BCM_Buzzer_Req}, {implementation-record-element=CAN5_AntitheftSta, system-signal=CAN5_AntitheftSta}, {implementation-record-element=CAN5_AntiTheftSeatFold, system-signal=CAN5_AntiTheftSeatFold}]}
      MAP_CAN5_FD_CONN1: sender-receiver-to-signal-group-mapping{communication-direction=OUT, data-element=SWC_FDC.root_FDC.P_CAN5_FD_CONN1.CAN5_SG_FD_CONN1, signal-group=CAN5_SG_FD_CONN1, type-mapping=sender-rec-record-type-mapping=record-element-mappings=[{implementation-record-element=CAN5_CCU_AutoLampSts, system-signal=CAN5_CCU_AutoLampSts}, {implementation-record-element=CAN5_SWC_mode_Sta, system-signal=CAN5_SWC_mode_Sta}, {implementation-record-element=CAN5_FD_TBOX_VehData_Sta, system-signal=CAN5_FD_TBOX_VehData_Sta}, {implementation-record-element=CAN5_FD_TBOX_VehData_Err, system-signal=CAN5_FD_TBOX_VehData_Err}, {implementation-record-element=CAN5_FD_TBOX_DTCData_Sta, system-signal=CAN5_FD_TBOX_DTCData_Sta}, {implementation-record-element=CAN5_FD_TBOX_DTCData_Err, system-signal=CAN5_FD_TBOX_DTCData_Err}, {implementation-record-element=CAN5_FD_DKC_VehData_Sta, system-signal=CAN5_FD_DKC_VehData_Sta}, {implementation-record-element=CAN5_FD_DKC_VehData_Err, system-signal=CAN5_FD_DKC_VehData_Err}]}
      MAP_CAN5_FD_THCM2: sender-receiver-to-signal-group-mapping{communication-direction=OUT, data-element=SWC_FDC.root_FDC.P_CAN5_FD_THCM2.CAN5_SG_FD_THCM2, signal-group=CAN5_SG_FD_THCM2, type-mapping=sender-rec-record-type-mapping=record-element-mappings=[{implementation-record-element=CAN5_ACSubMode, system-signal=CAN5_ACSubMode}, {implementation-record-element=CAN5_FD_TWV_Cmd, system-signal=CAN5_FD_TWV_Cmd}, {implementation-record-element=CAN5_FD_SOV3_Cmd, system-signal=CAN5_FD_SOV3_Cmd}, {implementation-record-element=CAN5_FD_SOV2_Cmd, system-signal=CAN5_FD_SOV2_Cmd}, {implementation-record-element=CAN5_FD_SOV1_Cmd, system-signal=CAN5_FD_SOV1_Cmd}, {implementation-record-element=CAN5_FD_SOTXV_Cmd, system-signal=CAN5_FD_SOTXV_Cmd}, {implementation-record-element=CAN5_FD_RrAPTCHeatPwr_Cmd, system-signal=CAN5_FD_RrAPTCHeatPwr_Cmd}, {implementation-record-element=CAN5_FD_FrWPTCHeatPwr_Cmd, system-signal=CAN5_FD_FrWPTCHeatPwr_Cmd}, {implementation-record-element=CAN5_FD_FrRiAPTCHeatPwr_Cmd, system-signal=CAN5_FD_FrRiAPTCHeatPwr_Cmd}, {implementation-record-element=CAN5_FD_FrLeAPTCHeatPwr_Cmd, system-signal=CAN5_FD_FrLeAPTCHeatPwr_Cmd}, {implementation-record-element=CAN5_FD_FWV_Cmd, system-signal=CAN5_FD_FWV_Cmd}, {implementation-record-element=CAN5_FD_EXV2_Cmd, system-signal=CAN5_FD_EXV2_Cmd}, {implementation-record-element=CAN5_FD_EXV1_Cmd, system-signal=CAN5_FD_EXV1_Cmd}, {implementation-record-element=CAN5_FD_EWP3_Cmd, system-signal=CAN5_FD_EWP3_Cmd}, {implementation-record-element=CAN5_FD_EWP2_Cmd, system-signal=CAN5_FD_EWP2_Cmd}, {implementation-record-element=CAN5_FD_EWP1_Cmd, system-signal=CAN5_FD_EWP1_Cmd}, {implementation-record-element=CAN5_FD_Comp_Cmd, system-signal=CAN5_FD_Comp_Cmd}, {implementation-record-element=CAN5_FD_Blower_Cmd, system-signal=CAN5_FD_Blower_Cmd}, {implementation-record-element=CAN5_DeiceModReq, system-signal=CAN5_DeiceModReq}, {implementation-record-element=CAN5_CoolgFanActDuty, system-signal=CAN5_CoolgFanActDuty}, {implementation-record-element=CAN5_CCU_HiVoltageReq, system-signal=CAN5_CCU_HiVoltageReq}, {implementation-record-element=CAN5_CCU_CbnPreSts, system-signal=CAN5_CCU_CbnPreSts}, {implementation-record-element=CAN5_CCU_CbnPreEstimdTi, system-signal=CAN5_CCU_CbnPreEstimdTi}, {implementation-record-element=CAN5_CCU_CbnPreACWkSts, system-signal=CAN5_CCU_CbnPreACWkSts}, {implementation-record-element=CAN5_BatLoopActWtFlw, system-signal=CAN5_BatLoopActWtFlw}, {implementation-record-element=CAN5_APTC_ActFrRiPwr, system-signal=CAN5_APTC_ActFrRiPwr}]}
      MAP_CAN5_FD_VCU0: sender-receiver-to-signal-group-mapping{communication-direction=OUT, data-element=SWC_FDC.root_FDC.P_CAN5_FD_VCU0.CAN5_SG_FD_VCU0, signal-group=CAN5_SG_FD_VCU0, type-mapping=sender-rec-record-type-mapping=record-element-mappings=[{implementation-record-element=CAN5_EVCCAplusPwrUpReq, system-signal=CAN5_EVCCAplusPwrUpReq}, {implementation-record-element=CAN5_VehHVPwrAvail4THCM, system-signal=CAN5_VehHVPwrAvail4THCM}, {implementation-record-element=CAN5_VCURRDoorSta, system-signal=CAN5_VCURRDoorSta}, {implementation-record-element=CAN5_VCURLDoorSta, system-signal=CAN5_VCURLDoorSta}, {implementation-record-element=CAN5_VCUFRDoorSta, system-signal=CAN5_VCUFRDoorSta}, {implementation-record-element=CAN5_VCUFLDoorSta, system-signal=CAN5_VCUFLDoorSta}, {implementation-record-element=CAN5_VCUBrkSWSta, system-signal=CAN5_VCUBrkSWSta}, {implementation-record-element=CAN5_TimerAllowSleep, system-signal=CAN5_TimerAllowSleep}, {implementation-record-element=CAN5_TCountSta, system-signal=CAN5_TCountSta}, {implementation-record-element=CAN5_SysPwrSta, system-signal=CAN5_SysPwrSta}, {implementation-record-element=CAN5_SysAllowReadySta, system-signal=CAN5_SysAllowReadySta}, {implementation-record-element=CAN5_SilentChkAllowSleep, system-signal=CAN5_SilentChkAllowSleep}, {implementation-record-element=CAN5_SchedChgTOSta, system-signal=CAN5_SchedChgTOSta}, {implementation-record-element=CAN5_Rr_TqSource, system-signal=CAN5_Rr_TqSource}, {implementation-record-element=CAN5_PwrUpReq, system-signal=CAN5_PwrUpReq}, {implementation-record-element=CAN5_PwrStaTOSta, system-signal=CAN5_PwrStaTOSta}, {implementation-record-element=CAN5_PwrStaSelect, system-signal=CAN5_PwrStaSelect}, {implementation-record-element=CAN5_PwrStaONTOIVIPopT, system-signal=CAN5_PwrStaONTOIVIPopT}, {implementation-record-element=CAN5_PwrStaONTOIVIPopReq, system-signal=CAN5_PwrStaONTOIVIPopReq}, {implementation-record-element=CAN5_PwrStaConstraint, system-signal=CAN5_PwrStaConstraint}, {implementation-record-element=CAN5_PwrDownReq, system-signal=CAN5_PwrDownReq}, {implementation-record-element=CAN5_PowerUpState, system-signal=CAN5_PowerUpState}, {implementation-record-element=CAN5_PowerUpFault, system-signal=CAN5_PowerUpFault}, {implementation-record-element=CAN5_PowerDownState, system-signal=CAN5_PowerDownState}, {implementation-record-element=CAN5_PowerDownFault, system-signal=CAN5_PowerDownFault}, {implementation-record-element=CAN5_PMMAllowECUSleep, system-signal=CAN5_PMMAllowECUSleep}, {implementation-record-element=CAN5_MCUActDisFail, system-signal=CAN5_MCUActDisFail}, {implementation-record-element=CAN5_LVSilentChrgSta, system-signal=CAN5_LVSilentChrgSta}, {implementation-record-element=CAN5_LVSilentChrgReq, system-signal=CAN5_LVSilentChrgReq}, {implementation-record-element=CAN5_LVSilentChrgLv, system-signal=CAN5_LVSilentChrgLv}, {implementation-record-element=CAN5_LVChrgHoldTAct, system-signal=CAN5_LVChrgHoldTAct}, {implementation-record-element=CAN5_LVBattVoltSta, system-signal=CAN5_LVBattVoltSta}, {implementation-record-element=CAN5_LVBattChrgtimeAct, system-signal=CAN5_LVBattChrgtimeAct}, {implementation-record-element=CAN5_HVTHCMSysAvail, system-signal=CAN5_HVTHCMSysAvail}, {implementation-record-element=CAN5_HVRlyOpFail, system-signal=CAN5_HVRlyOpFail}, {implementation-record-element=CAN5_Fr_TqSource, system-signal=CAN5_Fr_TqSource}, {implementation-record-element=CAN5_FDADC12VDetAvg, system-signal=CAN5_FDADC12VDetAvg}]}
      MAP_CAN5_FD_VCU1: sender-receiver-to-signal-group-mapping{communication-direction=OUT, data-element=SWC_FDC.root_FDC.P_CAN5_FD_VCU1.CAN5_SG_FD_VCU1, signal-group=CAN5_SG_FD_VCU1, type-mapping=sender-rec-record-type-mapping=record-element-mappings=[{implementation-record-element=CAN5_MSA_Crl_Sta, system-signal=CAN5_MSA_Crl_Sta}, {implementation-record-element=CAN5_ShiftGearPosn, system-signal=CAN5_ShiftGearPosn}, {implementation-record-element=CAN5_PwrSta, system-signal=CAN5_PwrSta}]}
      MAP_CAN5_FD_VCU3: sender-receiver-to-signal-group-mapping{communication-direction=OUT, data-element=SWC_FDC.root_FDC.P_CAN5_FD_VCU3.CAN5_SG_FD_VCU3, signal-group=CAN5_SG_FD_VCU3, type-mapping=sender-rec-record-type-mapping=record-element-mappings=[{implementation-record-element=CAN5_CS_VCU3_CAN1, system-signal=CAN5_CS_VCU3_CAN1}, {implementation-record-element=CAN5_Rr_RgnPermSta, system-signal=CAN5_Rr_RgnPermSta}, {implementation-record-element=CAN5_Rr_RgnDecrSta, system-signal=CAN5_Rr_RgnDecrSta}, {implementation-record-element=CAN5_Rr_EDUSpdValid, system-signal=CAN5_Rr_EDUSpdValid}, {implementation-record-element=CAN5_Rr_EDUSpd, system-signal=CAN5_Rr_EDUSpd}, {implementation-record-element=CAN5_Rr_EDURolRgnTqValid, system-signal=CAN5_Rr_EDURolRgnTqValid}, {implementation-record-element=CAN5_Rr_EDURealDrvOrBRgnTq, system-signal=CAN5_Rr_EDURealDrvOrBRgnTq}, {implementation-record-element=CAN5_Rr_EDURealARgnTq, system-signal=CAN5_Rr_EDURealARgnTq}, {implementation-record-element=CAN5_Rr_EDUAvailBrkRgnTqValid, system-signal=CAN5_Rr_EDUAvailBrkRgnTqValid}, {implementation-record-element=CAN5_Rr_EDUAvailBrkRgnTq, system-signal=CAN5_Rr_EDUAvailBrkRgnTq}, {implementation-record-element=CAN5_Rr_EDUActTqValid, system-signal=CAN5_Rr_EDUActTqValid}, {implementation-record-element=CAN5_RgnAbnorSta, system-signal=CAN5_RgnAbnorSta}, {implementation-record-element=CAN5_RC_VCU3_CAN1, system-signal=CAN5_RC_VCU3_CAN1}, {implementation-record-element=CAN5_PTCS_PermSta, system-signal=CAN5_PTCS_PermSta}, {implementation-record-element=CAN5_Fr_RgnPermSta, system-signal=CAN5_Fr_RgnPermSta}, {implementation-record-element=CAN5_Fr_RgnDecrSta, system-signal=CAN5_Fr_RgnDecrSta}, {implementation-record-element=CAN5_Fr_EDUSpdValid, system-signal=CAN5_Fr_EDUSpdValid}, {implementation-record-element=CAN5_Fr_EDUSpd, system-signal=CAN5_Fr_EDUSpd}, {implementation-record-element=CAN5_Fr_EDURolRgnTqValid, system-signal=CAN5_Fr_EDURolRgnTqValid}, {implementation-record-element=CAN5_Fr_EDURealDrvOrBRgnTq, system-signal=CAN5_Fr_EDURealDrvOrBRgnTq}, {implementation-record-element=CAN5_Fr_EDURealARgnTq, system-signal=CAN5_Fr_EDURealARgnTq}, {implementation-record-element=CAN5_Fr_EDUAvailBrkRgnTqValid, system-signal=CAN5_Fr_EDUAvailBrkRgnTqValid}, {implementation-record-element=CAN5_Fr_EDUAvailBrkRgnTq, system-signal=CAN5_Fr_EDUAvailBrkRgnTq}, {implementation-record-element=CAN5_Fr_EDUActTqValid, system-signal=CAN5_Fr_EDUActTqValid}, {implementation-record-element=CAN5_EquivAccPedalSWSta, system-signal=CAN5_EquivAccPedalSWSta}]}
      MAP_CAN5_FD_VCU4: sender-receiver-to-signal-group-mapping{communication-direction=OUT, data-element=SWC_FDC.root_FDC.P_CAN5_FD_VCU4.CAN5_SG_FD_VCU4, signal-group=CAN5_SG_FD_VCU4, type-mapping=sender-rec-record-type-mapping=record-element-mappings=[{implementation-record-element=CAN5_Eng_AGSCloseSta, system-signal=CAN5_Eng_AGSCloseSta}, {implementation-record-element=CAN5_VehMalfunLevel, system-signal=CAN5_VehMalfunLevel}, {implementation-record-element=CAN5_Eng_PwrLockSta, system-signal=CAN5_Eng_PwrLockSta}, {implementation-record-element=CAN5_Eng_CoastDwSta, system-signal=CAN5_Eng_CoastDwSta}, {implementation-record-element=CAN5_Eng_ActvDmpDisabSta, system-signal=CAN5_Eng_ActvDmpDisabSta}]}
      MAP_CAN5_FD_VCU5: sender-receiver-to-signal-group-mapping{communication-direction=OUT, data-element=SWC_FDC.root_FDC.P_CAN5_FD_VCU5.CAN5_SG_FD_VCU5, signal-group=CAN5_SG_FD_VCU5, type-mapping=sender-rec-record-type-mapping=record-element-mappings=[{implementation-record-element=CAN5_EDriveSysErr_AccPedalErr, system-signal=CAN5_EDriveSysErr_AccPedalErr}, {implementation-record-element=CAN5_Re_VehThdChkSta, system-signal=CAN5_Re_VehThdChkSta}, {implementation-record-element=CAN5_PwrStaErr, system-signal=CAN5_PwrStaErr}, {implementation-record-element=CAN5_LowSOCWarn, system-signal=CAN5_LowSOCWarn}, {implementation-record-element=CAN5_LimphomeAct, system-signal=CAN5_LimphomeAct}, {implementation-record-element=CAN5_LVSysErr_PwrOutpErr, system-signal=CAN5_LVSysErr_PwrOutpErr}, {implementation-record-element=CAN5_HVSysErr_RelayErr, system-signal=CAN5_HVSysErr_RelayErr}, {implementation-record-element=CAN5_HVSysErr_PackErr, system-signal=CAN5_HVSysErr_PackErr}, {implementation-record-element=CAN5_HVSysErr_IsolationErr, system-signal=CAN5_HVSysErr_IsolationErr}, {implementation-record-element=CAN5_EDriveSysErr_VCUErr, system-signal=CAN5_EDriveSysErr_VCUErr}, {implementation-record-element=CAN5_EDriveSysErr_ShifterErr, system-signal=CAN5_EDriveSysErr_ShifterErr}, {implementation-record-element=CAN5_EDriveSysErr_MCUErr, system-signal=CAN5_EDriveSysErr_MCUErr}]}
      MAP_CAN5_TBOX1: sender-receiver-to-signal-group-mapping{communication-direction=IN, data-element=SWC_FDC.root_FDC.R_CAN5_TBOX1.CAN5_SG_TBOX1, signal-group=CAN5_SG_TBOX1, type-mapping=sender-rec-record-type-mapping=record-element-mappings=[{implementation-record-element=CAN5_Antitheft_Zero, system-signal=CAN5_Antitheft_Zero}, {implementation-record-element=CAN5_Uncounting_Req, system-signal=CAN5_Uncounting_Req}, {implementation-record-element=CAN5_TBOX_TEST_STATUS, system-signal=CAN5_TBOX_TEST_STATUS}, {implementation-record-element=CAN5_TBOX_Remote_PW, system-signal=CAN5_TBOX_Remote_PW}, {implementation-record-element=CAN5_TBOX_RemoteOn, system-signal=CAN5_TBOX_RemoteOn}, {implementation-record-element=CAN5_TBOX_Re_VehData, system-signal=CAN5_TBOX_Re_VehData}, {implementation-record-element=CAN5_TBOX_Re_DTCData, system-signal=CAN5_TBOX_Re_DTCData}, {implementation-record-element=CAN5_TBOX_NET_SIG_STR, system-signal=CAN5_TBOX_NET_SIG_STR}, {implementation-record-element=CAN5_Remote_MidAutoReq, system-signal=CAN5_Remote_MidAutoReq}, {implementation-record-element=CAN5_Remote_AutoReq, system-signal=CAN5_Remote_AutoReq}, {implementation-record-element=CAN5_Remote_ACTemp, system-signal=CAN5_Remote_ACTemp}, {implementation-record-element=CAN5_Re_Radio, system-signal=CAN5_Re_Radio}, {implementation-record-element=CAN5_Re_PwrReqTbox, system-signal=CAN5_Re_PwrReqTbox}, {implementation-record-element=CAN5_Re_DoorLock, system-signal=CAN5_Re_DoorLock}, {implementation-record-element=CAN5_ReOutsideMirror, system-signal=CAN5_ReOutsideMirror}, {implementation-record-element=CAN5_PowerOff_T_Set, system-signal=CAN5_PowerOff_T_Set}, {implementation-record-element=CAN5_CbnPreTarT, system-signal=CAN5_CbnPreTarT}, {implementation-record-element=CAN5_CbnPreReq, system-signal=CAN5_CbnPreReq}, {implementation-record-element=CAN5_CbnPreACEnaReq, system-signal=CAN5_CbnPreACEnaReq}]}
      SystemMapping
        sw-impl-mappings:
          12 x swc to impl mapping:
            BswMTest_ImplMapping: component-implementation=Impl_BswMTest_type, component=root_FDC.BswMTest
            SWC_APS_ImplMapping: component-implementation=Impl_SWC_APS_type, component=root_FDC.SWC_APS
            SWC_CDD_ImplMapping: component-implementation=Impl_SWC_CDD_type, component=root_FDC.SWC_CDD
            SWC_DID_ImplMapping: component-implementation=Impl_SWC_DID_type, component=root_FDC.SWC_DID
            SWC_DID_ImplMapping: component-implementation=Impl_SWC_DID_type, component=root_FDC.SWC_DID
            SWC_FDC_ImplMapping: component-implementation=Impl_SWC_FDC_type, component=root_FDC.SWC_FDC
            SWC_IMU_ImplMapping: component-implementation=Impl_SWC_IMU_type, component=root_FDC.SWC_IMU
            SWC_LOG_ImplMapping: component-implementation=Impl_SWC_LOG_type, component=root_FDC.SWC_LOG
            SWC_NVM_ImplMapping: component-implementation=Impl_SWC_NVM_type, component=root_FDC.SWC_NVM
            SWC_UART_ImplMapping: component-implementation=Impl_SWC_UART_type, component=root_FDC.SWC_UART
            SWC_UDS_ImplMapping: component-implementation=Impl_SWC_UDS_type, component=root_FDC.SWC_UDS
            SWC_VES_ImplMapping: component-implementation=Impl_SWC_VES_type, component=root_FDC.SWC_VES
        sw-mappings:
          swc to ecu mapping SWC_ECUMapping: ecu-instance=FUSION
            component:
              root_FDC.SWC_FDC
              root_FDC.SWC_CDD
              root_FDC.SWC_VES
              root_FDC.BswMTest
              root_FDC.SWC_NVM
              root_FDC.SWC_UDS
              root_FDC.SWC_IMU
              root_FDC.SWC_UART
              root_FDC.SWC_DID
              root_FDC.SWC_APS
              root_FDC.SWC_LOG
    root-software-compositions:
      root sw composition prototype root_FDC: flat-map=root_FDC_FlatMap, software-composition=Comp_FDC_main
  flat map root_FDC_FlatMap
    flat instance descriptor FlatIns_FDC: upstream-reference=root_FDC.SWC_FDC, ecu-extract-reference=root_FDC.SWC_FDC
