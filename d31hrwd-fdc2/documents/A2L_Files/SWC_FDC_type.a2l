ASAP2_VERSION 1 31
/begin PROJECT ProjectName "Project Comment Goes Here"
/begin HEADER "Header Comments go here" /end HEADER
/begin MODULE ModuleName "Module Comment Goes Here"
/begin MOD_COMMON "Mod Common Comment Here" BYTE_ORDER MSB_LAST /end MOD_COMMON
/begin RECORD_LAYOUT Scalar_BOOLEAN FNC_VALUES 1 UBYTE COLUMN_DIR DIRECT /end RECORD_LAYOUT
/begin RECORD_LAYOUT Scalar_UBYTE FNC_VALUES 1 UBYTE COLUMN_DIR DIRECT /end RECORD_LAYOUT
/begin RECORD_LAYOUT Scalar_FLOAT32_IEEE FNC_VALUES 1 FLOAT32_IEEE COLUMN_DIR DIRECT /end RECORD_LAYOUT
/begin RECORD_LAYOUT Lookup1D_FLOAT32_IEEE FNC_VALUES 1 FLOAT32_IEEE COLUMN_DIR DIRECT /end RECORD_LAYOUT
/begin RECORD_LAYOUT Lookup1D_X_FLOAT32_IEEE AXIS_PTS_X 1 FLOAT32_IEEE INDEX_INCR DIRECT /end RECORD_LAYOUT
/begin RECORD_LAYOUT Lookup1D_FLOAT64_IEEE FNC_VALUES 1 FLOAT64_IEEE COLUMN_DIR DIRECT /end RECORD_LAYOUT
/begin RECORD_LAYOUT Lookup1D_X_FLOAT64_IEEE AXIS_PTS_X 1 FLOAT64_IEEE INDEX_INCR DIRECT /end RECORD_LAYOUT
/begin RECORD_LAYOUT Lookup2D_BOOLEAN FNC_VALUES 1 UBYTE COLUMN_DIR DIRECT /end RECORD_LAYOUT
/begin RECORD_LAYOUT Lookup2D_X_BOOLEAN AXIS_PTS_X 1 UBYTE INDEX_INCR DIRECT /end RECORD_LAYOUT
/begin RECORD_LAYOUT Lookup2D_BYTE FNC_VALUES 1 SBYTE COLUMN_DIR DIRECT /end RECORD_LAYOUT
/begin RECORD_LAYOUT Lookup2D_X_BYTE AXIS_PTS_X 1 SBYTE INDEX_INCR DIRECT /end RECORD_LAYOUT
/begin RECORD_LAYOUT Lookup2D_UWORD FNC_VALUES 1 UWORD COLUMN_DIR DIRECT /end RECORD_LAYOUT
/begin RECORD_LAYOUT Lookup2D_X_UWORD AXIS_PTS_X 1 UWORD INDEX_INCR DIRECT /end RECORD_LAYOUT
/begin RECORD_LAYOUT Lookup2D_FLOAT32_IEEE FNC_VALUES 1 FLOAT32_IEEE COLUMN_DIR DIRECT /end RECORD_LAYOUT
/begin RECORD_LAYOUT Lookup2D_X_FLOAT32_IEEE AXIS_PTS_X 1 FLOAT32_IEEE INDEX_INCR DIRECT /end RECORD_LAYOUT
/begin AXIS_PTS ATQR_CreepFEDUTs_Y_Nm "" 0x0000 /* @ECU_Address@ATQR_CreepFEDUTs_Y_Nm@ */ VTQR_FEDUWhlTqReqSmoothDelay_Nm Lookup2D_X_FLOAT32_IEEE 0 SWC_FDC_type_CM_single_Nm 10 -10000.0 10000.0 /end AXIS_PTS
/begin AXIS_PTS ATQR_CreepFEDUTs_X_rpm "" 0x0000 /* @ECU_Address@ATQR_CreepFEDUTs_X_rpm@ */ NO_INPUT_QUANTITY Lookup2D_X_FLOAT32_IEEE 0 SWC_FDC_type_CM_single_rpm 9 -100000.0 100000.0 /end AXIS_PTS
/begin AXIS_PTS ATQR_FEDUTIPOutTs_X_rpm "" 0x0000 /* @ECU_Address@ATQR_FEDUTIPOutTs_X_rpm@ */ NO_INPUT_QUANTITY Lookup1D_X_FLOAT32_IEEE 0 SWC_FDC_type_CM_single_rpm 24 -100000.0 100000.0 /end AXIS_PTS
/begin AXIS_PTS ATQR_VMCFEDUTs_X_rpm "" 0x0000 /* @ECU_Address@ATQR_VMCFEDUTs_X_rpm@ */ NO_INPUT_QUANTITY Lookup2D_X_FLOAT32_IEEE 0 SWC_FDC_type_CM_single_rpm 24 -100000.0 100000.0 /end AXIS_PTS
/begin CHARACTERISTIC MTQR_FShaftSpdTqLimCoe_Y_c "" CURVE 0x0000 /* @ECU_Address@MTQR_FShaftSpdTqLimCoe_Y_c@ */ Lookup1D_FLOAT32_IEEE 0 SWC_FDC_type_CM_single_c 0.0 1.0
 /begin AXIS_DESCR COM_AXIS VTQR_ActFShaftSpdDev_rpm SWC_FDC_type_CM_single_rpm 16 0.0 100000.0 AXIS_PTS_REF ATQR_FShaftSpdTqLimCoe_X_rpm /end AXIS_DESCR
/end CHARACTERISTIC
/begin AXIS_PTS ATQR_FShaftSpdTqLimCoe_X_rpm "" 0x0000 /* @ECU_Address@ATQR_FShaftSpdTqLimCoe_X_rpm@ */ VTQR_ActFShaftSpdDev_rpm Lookup1D_X_FLOAT32_IEEE 0 SWC_FDC_type_CM_single_rpm 16 0.0 100000.0 /end AXIS_PTS
/begin CHARACTERISTIC MTQR_FTimerTqLimCoe_Y_c "" CURVE 0x0000 /* @ECU_Address@MTQR_FTimerTqLimCoe_Y_c@ */ Lookup1D_FLOAT32_IEEE 0 SWC_FDC_type_CM_single_c 0.0 1.0
 /begin AXIS_DESCR COM_AXIS VTQR_FShaftSpdDevTime_s SWC_FDC_type_CM_single_s 12 0.0 3600.0 AXIS_PTS_REF ATQR_FTimerTqLimCoe_X_s /end AXIS_DESCR
/end CHARACTERISTIC
/begin AXIS_PTS ATQR_FTimerTqLimCoe_X_s "" 0x0000 /* @ECU_Address@ATQR_FTimerTqLimCoe_X_s@ */ VTQR_FShaftSpdDevTime_s Lookup1D_X_FLOAT32_IEEE 0 SWC_FDC_type_CM_single_s 12 0.0 3600.0 /end AXIS_PTS
/begin CHARACTERISTIC MTQR_AltRDCActiveFEDUInc_Z_Nm "" MAP 0x0000 /* @ECU_Address@MTQR_AltRDCActiveFEDUInc_Z_Nm@ */ Lookup2D_FLOAT32_IEEE 0 SWC_FDC_type_CM_single_Nm -100000.0 100000.0
 /begin AXIS_DESCR COM_AXIS NO_INPUT_QUANTITY SWC_FDC_type_CM_single_pct 23 -125.0 125.0 AXIS_PTS_REF ATQR_AltRDCActiveFEDUInc_X_pct /end AXIS_DESCR
 /begin AXIS_DESCR COM_AXIS NO_INPUT_QUANTITY SWC_FDC_type_CM_single_enum 9 0.0 15.0 AXIS_PTS_REF ATQR_AltRDCActiveFEDUInc_Y_enum /end AXIS_DESCR
/end CHARACTERISTIC
/begin AXIS_PTS ATQR_AltRDCActiveFEDUInc_Y_enum "" 0x0000 /* @ECU_Address@ATQR_AltRDCActiveFEDUInc_Y_enum@ */ NO_INPUT_QUANTITY Lookup2D_X_FLOAT32_IEEE 0 SWC_FDC_type_CM_single_enum 9 0.0 15.0 /end AXIS_PTS
/begin AXIS_PTS ATQR_AltRDCActiveFEDUInc_X_pct "" 0x0000 /* @ECU_Address@ATQR_AltRDCActiveFEDUInc_X_pct@ */ NO_INPUT_QUANTITY Lookup2D_X_FLOAT32_IEEE 0 SWC_FDC_type_CM_single_pct 23 -125.0 125.0 /end AXIS_PTS
/begin CHARACTERISTIC MTQR_CreepFEDUTqDecSR_Z_Nm "" MAP 0x0000 /* @ECU_Address@MTQR_CreepFEDUTqDecSR_Z_Nm@ */ Lookup2D_FLOAT32_IEEE 0 SWC_FDC_type_CM_single_Nm -10000.0 0.0
 /begin AXIS_DESCR COM_AXIS NO_INPUT_QUANTITY SWC_FDC_type_CM_single_rpm 9 -100000.0 100000.0 AXIS_PTS_REF ATQR_CreepFEDUTqIncSR_X_rpm /end AXIS_DESCR
 /begin AXIS_DESCR COM_AXIS VTQR_FEDUWhlTqReqSmoothDelay_Nm SWC_FDC_type_CM_single_Nm 10 -10000.0 10000.0 AXIS_PTS_REF ATQR_CreepFEDUTqIncSR_Y_Nm /end AXIS_DESCR
/end CHARACTERISTIC
/begin AXIS_PTS ATQR_CreepFEDUTqIncSR_Y_Nm "" 0x0000 /* @ECU_Address@ATQR_CreepFEDUTqIncSR_Y_Nm@ */ VTQR_FEDUWhlTqReqSmoothDelay_Nm Lookup2D_X_FLOAT32_IEEE 0 SWC_FDC_type_CM_single_Nm 10 -10000.0 10000.0 /end AXIS_PTS
/begin AXIS_PTS ATQR_CreepFEDUTqIncSR_X_rpm "" 0x0000 /* @ECU_Address@ATQR_CreepFEDUTqIncSR_X_rpm@ */ NO_INPUT_QUANTITY Lookup2D_X_FLOAT32_IEEE 0 SWC_FDC_type_CM_single_rpm 9 -100000.0 100000.0 /end AXIS_PTS
/begin CHARACTERISTIC MTQR_CreepFEDUTqIncSR_Z_Nm "" MAP 0x0000 /* @ECU_Address@MTQR_CreepFEDUTqIncSR_Z_Nm@ */ Lookup2D_FLOAT32_IEEE 0 SWC_FDC_type_CM_single_Nm 0.0 100000.0
 /begin AXIS_DESCR COM_AXIS NO_INPUT_QUANTITY SWC_FDC_type_CM_single_rpm 9 -100000.0 100000.0 AXIS_PTS_REF ATQR_CreepFEDUTqIncSR_X_rpm /end AXIS_DESCR
 /begin AXIS_DESCR COM_AXIS VTQR_FEDUWhlTqReqSmoothDelay_Nm SWC_FDC_type_CM_single_Nm 10 -10000.0 10000.0 AXIS_PTS_REF ATQR_CreepFEDUTqIncSR_Y_Nm /end AXIS_DESCR
/end CHARACTERISTIC
/begin CHARACTERISTIC MTQR_FrPreLoadTqDecSR_Z_Nm "" MAP 0x0000 /* @ECU_Address@MTQR_FrPreLoadTqDecSR_Z_Nm@ */ Lookup2D_FLOAT32_IEEE 0 SWC_FDC_type_CM_single_Nm -100000.0 0.0
 /begin AXIS_DESCR COM_AXIS NO_INPUT_QUANTITY SWC_FDC_type_CM_single_rpm 9 -100000.0 100000.0 AXIS_PTS_REF ATQR_FrPreLoadTqIncSR_X_rpm /end AXIS_DESCR
 /begin AXIS_DESCR COM_AXIS VTQR_FEDUWhlTqReqSmoothDelay_Nm SWC_FDC_type_CM_single_Nm 10 -100000.0 100000.0 AXIS_PTS_REF ATQR_FrPreLoadTqIncSR_Y_Nm /end AXIS_DESCR
/end CHARACTERISTIC
/begin AXIS_PTS ATQR_FrPreLoadTqIncSR_Y_Nm "" 0x0000 /* @ECU_Address@ATQR_FrPreLoadTqIncSR_Y_Nm@ */ VTQR_FEDUWhlTqReqSmoothDelay_Nm Lookup2D_X_FLOAT32_IEEE 0 SWC_FDC_type_CM_single_Nm 10 -100000.0 100000.0 /end AXIS_PTS
/begin AXIS_PTS ATQR_FrPreLoadTqIncSR_X_rpm "" 0x0000 /* @ECU_Address@ATQR_FrPreLoadTqIncSR_X_rpm@ */ NO_INPUT_QUANTITY Lookup2D_X_FLOAT32_IEEE 0 SWC_FDC_type_CM_single_rpm 9 -100000.0 100000.0 /end AXIS_PTS
/begin CHARACTERISTIC MTQR_FrPreLoadTqIncSR_Z_Nm "" MAP 0x0000 /* @ECU_Address@MTQR_FrPreLoadTqIncSR_Z_Nm@ */ Lookup2D_FLOAT32_IEEE 0 SWC_FDC_type_CM_single_Nm 0.0 100000.0
 /begin AXIS_DESCR COM_AXIS NO_INPUT_QUANTITY SWC_FDC_type_CM_single_rpm 9 -100000.0 100000.0 AXIS_PTS_REF ATQR_FrPreLoadTqIncSR_X_rpm /end AXIS_DESCR
 /begin AXIS_DESCR COM_AXIS VTQR_FEDUWhlTqReqSmoothDelay_Nm SWC_FDC_type_CM_single_Nm 10 -100000.0 100000.0 AXIS_PTS_REF ATQR_FrPreLoadTqIncSR_Y_Nm /end AXIS_DESCR
/end CHARACTERISTIC
/begin CHARACTERISTIC MTQR_VMCFEDUTqDecSR_Z_Nm "" MAP 0x0000 /* @ECU_Address@MTQR_VMCFEDUTqDecSR_Z_Nm@ */ Lookup2D_FLOAT32_IEEE 0 SWC_FDC_type_CM_single_Nm -100000.0 100000.0
 /begin AXIS_DESCR COM_AXIS NO_INPUT_QUANTITY SWC_FDC_type_CM_single_rpm 24 -100000.0 100000.0 AXIS_PTS_REF ATQR_VMCFEDUTqIncSR_X_rpm /end AXIS_DESCR
 /begin AXIS_DESCR COM_AXIS VTQR_FEDUWhlTqReqSmoothDelay_Nm SWC_FDC_type_CM_single_Nm 18 -10000.0 10000.0 AXIS_PTS_REF ATQR_VMCFEDUTqIncSR_Y_Nm /end AXIS_DESCR
/end CHARACTERISTIC
/begin AXIS_PTS ATQR_VMCFEDUTqIncSR_Y_Nm "" 0x0000 /* @ECU_Address@ATQR_VMCFEDUTqIncSR_Y_Nm@ */ VTQR_FEDUWhlTqReqSmoothDelay_Nm Lookup2D_X_FLOAT32_IEEE 0 SWC_FDC_type_CM_single_Nm 18 -10000.0 10000.0 /end AXIS_PTS
/begin AXIS_PTS ATQR_VMCFEDUTqIncSR_X_rpm "" 0x0000 /* @ECU_Address@ATQR_VMCFEDUTqIncSR_X_rpm@ */ NO_INPUT_QUANTITY Lookup2D_X_FLOAT32_IEEE 0 SWC_FDC_type_CM_single_rpm 24 -100000.0 100000.0 /end AXIS_PTS
/begin CHARACTERISTIC MTQR_VMCFEDUTqIncSR_Z_Nm "" MAP 0x0000 /* @ECU_Address@MTQR_VMCFEDUTqIncSR_Z_Nm@ */ Lookup2D_FLOAT32_IEEE 0 SWC_FDC_type_CM_single_Nm -100000.0 100000.0
 /begin AXIS_DESCR COM_AXIS NO_INPUT_QUANTITY SWC_FDC_type_CM_single_rpm 24 -100000.0 100000.0 AXIS_PTS_REF ATQR_VMCFEDUTqIncSR_X_rpm /end AXIS_DESCR
 /begin AXIS_DESCR COM_AXIS VTQR_FEDUWhlTqReqSmoothDelay_Nm SWC_FDC_type_CM_single_Nm 18 -10000.0 10000.0 AXIS_PTS_REF ATQR_VMCFEDUTqIncSR_Y_Nm /end AXIS_DESCR
/end CHARACTERISTIC
/begin CHARACTERISTIC MTQR_AltRDCActiveREDUTs_Z_c "" MAP 0x0000 /* @ECU_Address@MTQR_AltRDCActiveREDUTs_Z_c@ */ Lookup2D_FLOAT32_IEEE 0 SWC_FDC_type_CM_single_c 0.0 1.0
 /begin AXIS_DESCR COM_AXIS NO_INPUT_QUANTITY SWC_FDC_type_CM_single_pct 23 -125.0 125.0 AXIS_PTS_REF ATQR_AltRDCActiveREDUTs_X_pct /end AXIS_DESCR
 /begin AXIS_DESCR COM_AXIS NO_INPUT_QUANTITY SWC_FDC_type_CM_single_enum 9 0.0 15.0 AXIS_PTS_REF ATQR_AltRDCActiveREDUTs_Y_enum /end AXIS_DESCR
/end CHARACTERISTIC
/begin AXIS_PTS ATQR_AltRDCActiveREDUTs_Y_enum "" 0x0000 /* @ECU_Address@ATQR_AltRDCActiveREDUTs_Y_enum@ */ NO_INPUT_QUANTITY Lookup2D_X_FLOAT32_IEEE 0 SWC_FDC_type_CM_single_enum 9 0.0 15.0 /end AXIS_PTS
/begin AXIS_PTS ATQR_AltRDCActiveREDUTs_X_pct "" 0x0000 /* @ECU_Address@ATQR_AltRDCActiveREDUTs_X_pct@ */ NO_INPUT_QUANTITY Lookup2D_X_FLOAT32_IEEE 0 SWC_FDC_type_CM_single_pct 23 -125.0 125.0 /end AXIS_PTS
/begin CHARACTERISTIC MTQR_CreepREDUTs_Z_c "" MAP 0x0000 /* @ECU_Address@MTQR_CreepREDUTs_Z_c@ */ Lookup2D_FLOAT32_IEEE 0 SWC_FDC_type_CM_single_c 0.0 1.0
 /begin AXIS_DESCR COM_AXIS NO_INPUT_QUANTITY SWC_FDC_type_CM_single_rpm 9 -100000.0 100000.0 AXIS_PTS_REF ATQR_CreepFEDUTs_X_rpm /end AXIS_DESCR
 /begin AXIS_DESCR COM_AXIS VTQR_REDUWhlTqReqSmoothDelay_Nm SWC_FDC_type_CM_single_Nm 10 -10000.0 10000.0 AXIS_PTS_REF ATQR_CreepFEDUTs_Y_Nm /end AXIS_DESCR
/end CHARACTERISTIC
/begin CHARACTERISTIC MTQR_REDUTIPOutTs_Y_c "" CURVE 0x0000 /* @ECU_Address@MTQR_REDUTIPOutTs_Y_c@ */ Lookup1D_FLOAT32_IEEE 0 SWC_FDC_type_CM_single_c 0.0 1.0
 /begin AXIS_DESCR COM_AXIS NO_INPUT_QUANTITY SWC_FDC_type_CM_single_rpm 24 -100000.0 100000.0 AXIS_PTS_REF ATQR_FEDUTIPOutTs_X_rpm /end AXIS_DESCR
/end CHARACTERISTIC
/begin CHARACTERISTIC MTQR_VMCREDUTs_Z_c "" MAP 0x0000 /* @ECU_Address@MTQR_VMCREDUTs_Z_c@ */ Lookup2D_FLOAT32_IEEE 0 SWC_FDC_type_CM_single_c 0.0 1.0
 /begin AXIS_DESCR COM_AXIS NO_INPUT_QUANTITY SWC_FDC_type_CM_single_rpm 24 -100000.0 100000.0 AXIS_PTS_REF ATQR_VMCFEDUTs_X_rpm /end AXIS_DESCR
 /begin AXIS_DESCR COM_AXIS VTQR_REDUWhlTqReqSmoothDelay_Nm SWC_FDC_type_CM_single_Nm 18 -10000.0 10000.0 AXIS_PTS_REF ATQR_VMCREDUTs_Y_Nm /end AXIS_DESCR
/end CHARACTERISTIC
/begin AXIS_PTS ATQR_VMCREDUTs_Y_Nm "" 0x0000 /* @ECU_Address@ATQR_VMCREDUTs_Y_Nm@ */ VTQR_REDUWhlTqReqSmoothDelay_Nm Lookup2D_X_FLOAT32_IEEE 0 SWC_FDC_type_CM_single_Nm 18 -10000.0 10000.0 /end AXIS_PTS
/begin CHARACTERISTIC MTQR_RShaftSpdTqLimCoe_Y_c "" CURVE 0x0000 /* @ECU_Address@MTQR_RShaftSpdTqLimCoe_Y_c@ */ Lookup1D_FLOAT32_IEEE 0 SWC_FDC_type_CM_single_c 0.0 1.0
 /begin AXIS_DESCR COM_AXIS VTQR_ActRShaftSpdDev_rpm SWC_FDC_type_CM_single_rpm 16 0.0 100000.0 AXIS_PTS_REF ATQR_RShaftSpdTqLimCoe_X_rpm /end AXIS_DESCR
/end CHARACTERISTIC
/begin AXIS_PTS ATQR_RShaftSpdTqLimCoe_X_rpm "" 0x0000 /* @ECU_Address@ATQR_RShaftSpdTqLimCoe_X_rpm@ */ VTQR_ActRShaftSpdDev_rpm Lookup1D_X_FLOAT32_IEEE 0 SWC_FDC_type_CM_single_rpm 16 0.0 100000.0 /end AXIS_PTS
/begin CHARACTERISTIC MTQR_RTimerTqLimCoe_Y_c "" CURVE 0x0000 /* @ECU_Address@MTQR_RTimerTqLimCoe_Y_c@ */ Lookup1D_FLOAT32_IEEE 0 SWC_FDC_type_CM_single_c 0.0 1.0
 /begin AXIS_DESCR COM_AXIS VTQR_RShaftSpdDevTime_s SWC_FDC_type_CM_single_s 12 0.0 3600.0 AXIS_PTS_REF ATQR_RTimerTqLimCoe_X_s /end AXIS_DESCR
/end CHARACTERISTIC
/begin AXIS_PTS ATQR_RTimerTqLimCoe_X_s "" 0x0000 /* @ECU_Address@ATQR_RTimerTqLimCoe_X_s@ */ VTQR_RShaftSpdDevTime_s Lookup1D_X_FLOAT32_IEEE 0 SWC_FDC_type_CM_single_s 12 0.0 3600.0 /end AXIS_PTS
/begin CHARACTERISTIC MTQR_AltRDCActiveREDUInc_Z_Nm "" MAP 0x0000 /* @ECU_Address@MTQR_AltRDCActiveREDUInc_Z_Nm@ */ Lookup2D_FLOAT32_IEEE 0 SWC_FDC_type_CM_single_Nm -100000.0 100000.0
 /begin AXIS_DESCR COM_AXIS NO_INPUT_QUANTITY SWC_FDC_type_CM_single_pct 23 -125.0 125.0 AXIS_PTS_REF ATQR_AltRDCActiveREDUInc_X_pct /end AXIS_DESCR
 /begin AXIS_DESCR COM_AXIS NO_INPUT_QUANTITY SWC_FDC_type_CM_single_enum 9 0.0 15.0 AXIS_PTS_REF ATQR_AltRDCActiveREDUInc_Y_enum /end AXIS_DESCR
/end CHARACTERISTIC
/begin AXIS_PTS ATQR_AltRDCActiveREDUInc_Y_enum "" 0x0000 /* @ECU_Address@ATQR_AltRDCActiveREDUInc_Y_enum@ */ NO_INPUT_QUANTITY Lookup2D_X_FLOAT32_IEEE 0 SWC_FDC_type_CM_single_enum 9 0.0 15.0 /end AXIS_PTS
/begin AXIS_PTS ATQR_AltRDCActiveREDUInc_X_pct "" 0x0000 /* @ECU_Address@ATQR_AltRDCActiveREDUInc_X_pct@ */ NO_INPUT_QUANTITY Lookup2D_X_FLOAT32_IEEE 0 SWC_FDC_type_CM_single_pct 23 -125.0 125.0 /end AXIS_PTS
/begin CHARACTERISTIC MTQR_CreepREDUTqDecSR_Z_Nm "" MAP 0x0000 /* @ECU_Address@MTQR_CreepREDUTqDecSR_Z_Nm@ */ Lookup2D_FLOAT32_IEEE 0 SWC_FDC_type_CM_single_Nm -10000.0 0.0
 /begin AXIS_DESCR COM_AXIS NO_INPUT_QUANTITY SWC_FDC_type_CM_single_rpm 9 -100000.0 100000.0 AXIS_PTS_REF ATQR_CreepFEDUTqIncSR_X_rpm /end AXIS_DESCR
 /begin AXIS_DESCR COM_AXIS VTQR_REDUWhlTqReqSmoothDelay_Nm SWC_FDC_type_CM_single_Nm 10 -10000.0 10000.0 AXIS_PTS_REF ATQR_CreepFEDUTqIncSR_Y_Nm /end AXIS_DESCR
/end CHARACTERISTIC
/begin CHARACTERISTIC MTQR_CreepREDUTqIncSR_Z_Nm "" MAP 0x0000 /* @ECU_Address@MTQR_CreepREDUTqIncSR_Z_Nm@ */ Lookup2D_FLOAT32_IEEE 0 SWC_FDC_type_CM_single_Nm 0.0 100000.0
 /begin AXIS_DESCR COM_AXIS NO_INPUT_QUANTITY SWC_FDC_type_CM_single_rpm 9 -100000.0 100000.0 AXIS_PTS_REF ATQR_CreepFEDUTqIncSR_X_rpm /end AXIS_DESCR
 /begin AXIS_DESCR COM_AXIS VTQR_REDUWhlTqReqSmoothDelay_Nm SWC_FDC_type_CM_single_Nm 10 -10000.0 10000.0 AXIS_PTS_REF ATQR_CreepFEDUTqIncSR_Y_Nm /end AXIS_DESCR
/end CHARACTERISTIC
/begin CHARACTERISTIC MTQR_RrPreLoadTqDecSR_Z_Nm "" MAP 0x0000 /* @ECU_Address@MTQR_RrPreLoadTqDecSR_Z_Nm@ */ Lookup2D_FLOAT32_IEEE 0 SWC_FDC_type_CM_single_Nm -100000.0 0.0
 /begin AXIS_DESCR COM_AXIS NO_INPUT_QUANTITY SWC_FDC_type_CM_single_rpm 9 -100000.0 100000.0 AXIS_PTS_REF ATQR_RrPreLoadTqIncSR_X_rpm /end AXIS_DESCR
 /begin AXIS_DESCR COM_AXIS VTQR_REDUWhlTqReqSmoothDelay_Nm SWC_FDC_type_CM_single_Nm 10 -100000.0 100000.0 AXIS_PTS_REF ATQR_RrPreLoadTqIncSR_Y_Nm /end AXIS_DESCR
/end CHARACTERISTIC
/begin AXIS_PTS ATQR_RrPreLoadTqIncSR_Y_Nm "" 0x0000 /* @ECU_Address@ATQR_RrPreLoadTqIncSR_Y_Nm@ */ VTQR_REDUWhlTqReqSmoothDelay_Nm Lookup2D_X_FLOAT32_IEEE 0 SWC_FDC_type_CM_single_Nm 10 -100000.0 100000.0 /end AXIS_PTS
/begin AXIS_PTS ATQR_RrPreLoadTqIncSR_X_rpm "" 0x0000 /* @ECU_Address@ATQR_RrPreLoadTqIncSR_X_rpm@ */ NO_INPUT_QUANTITY Lookup2D_X_FLOAT32_IEEE 0 SWC_FDC_type_CM_single_rpm 9 -100000.0 100000.0 /end AXIS_PTS
/begin CHARACTERISTIC MTQR_RrPreLoadTqIncSR_Z_Nm "" MAP 0x0000 /* @ECU_Address@MTQR_RrPreLoadTqIncSR_Z_Nm@ */ Lookup2D_FLOAT32_IEEE 0 SWC_FDC_type_CM_single_Nm 0.0 100000.0
 /begin AXIS_DESCR COM_AXIS NO_INPUT_QUANTITY SWC_FDC_type_CM_single_rpm 9 -100000.0 100000.0 AXIS_PTS_REF ATQR_RrPreLoadTqIncSR_X_rpm /end AXIS_DESCR
 /begin AXIS_DESCR COM_AXIS VTQR_REDUWhlTqReqSmoothDelay_Nm SWC_FDC_type_CM_single_Nm 10 -100000.0 100000.0 AXIS_PTS_REF ATQR_RrPreLoadTqIncSR_Y_Nm /end AXIS_DESCR
/end CHARACTERISTIC
/begin CHARACTERISTIC MTQR_VMCREDUTqDecSR_Z_Nm "" MAP 0x0000 /* @ECU_Address@MTQR_VMCREDUTqDecSR_Z_Nm@ */ Lookup2D_FLOAT32_IEEE 0 SWC_FDC_type_CM_single_Nm -100000.0 100000.0
 /begin AXIS_DESCR COM_AXIS NO_INPUT_QUANTITY SWC_FDC_type_CM_single_rpm 24 -100000.0 100000.0 AXIS_PTS_REF ATQR_VMCFEDUTqIncSR_X_rpm /end AXIS_DESCR
 /begin AXIS_DESCR COM_AXIS VTQR_REDUWhlTqReqSmoothDelay_Nm SWC_FDC_type_CM_single_Nm 18 -10000.0 10000.0 AXIS_PTS_REF ATQR_VMCREDUTqIncSR_Y_Nm /end AXIS_DESCR
/end CHARACTERISTIC
/begin AXIS_PTS ATQR_VMCREDUTqIncSR_Y_Nm "" 0x0000 /* @ECU_Address@ATQR_VMCREDUTqIncSR_Y_Nm@ */ VTQR_REDUWhlTqReqSmoothDelay_Nm Lookup2D_X_FLOAT32_IEEE 0 SWC_FDC_type_CM_single_Nm 18 -10000.0 10000.0 /end AXIS_PTS
/begin CHARACTERISTIC MTQR_VMCREDUTqIncSR_Z_Nm "" MAP 0x0000 /* @ECU_Address@MTQR_VMCREDUTqIncSR_Z_Nm@ */ Lookup2D_FLOAT32_IEEE 0 SWC_FDC_type_CM_single_Nm -100000.0 100000.0
 /begin AXIS_DESCR COM_AXIS NO_INPUT_QUANTITY SWC_FDC_type_CM_single_rpm 24 -100000.0 100000.0 AXIS_PTS_REF ATQR_VMCFEDUTqIncSR_X_rpm /end AXIS_DESCR
 /begin AXIS_DESCR COM_AXIS VTQR_REDUWhlTqReqSmoothDelay_Nm SWC_FDC_type_CM_single_Nm 18 -10000.0 10000.0 AXIS_PTS_REF ATQR_VMCREDUTqIncSR_Y_Nm /end AXIS_DESCR
/end CHARACTERISTIC
/begin CHARACTERISTIC MTQD_FrLossMAPHighV_Z_kW "" MAP 0x0000 /* @ECU_Address@MTQD_FrLossMAPHighV_Z_kW@ */ Lookup2D_FLOAT32_IEEE 0 SWC_FDC_type_CM_single_kw -200.0 200.0
 /begin AXIS_DESCR COM_AXIS NO_INPUT_QUANTITY SWC_FDC_type_CM_single_rpm 28 -100000.0 100000.0 AXIS_PTS_REF ATQD_FrLossMAPLowV_X_rpm /end AXIS_DESCR
 /begin AXIS_DESCR COM_AXIS VTQD_CoordWhlTqDemFr_Nm SWC_FDC_type_CM_single_Nm 29 -100000.0 100000.0 AXIS_PTS_REF ATQD_FrLossMAPLowV_Y_Nm /end AXIS_DESCR
/end CHARACTERISTIC
/begin AXIS_PTS ATQD_FrLossMAPLowV_Y_Nm "" 0x0000 /* @ECU_Address@ATQD_FrLossMAPLowV_Y_Nm@ */ VTQD_CoordWhlTqDemFr_Nm Lookup2D_X_FLOAT32_IEEE 0 SWC_FDC_type_CM_single_Nm 29 -100000.0 100000.0 /end AXIS_PTS
/begin AXIS_PTS ATQD_FrLossMAPLowV_X_rpm "" 0x0000 /* @ECU_Address@ATQD_FrLossMAPLowV_X_rpm@ */ NO_INPUT_QUANTITY Lookup2D_X_FLOAT32_IEEE 0 SWC_FDC_type_CM_single_rpm 28 -100000.0 100000.0 /end AXIS_PTS
/begin CHARACTERISTIC MTQD_FrLossMAPLowV_Z_kW "" MAP 0x0000 /* @ECU_Address@MTQD_FrLossMAPLowV_Z_kW@ */ Lookup2D_FLOAT32_IEEE 0 SWC_FDC_type_CM_single_kw -200.0 200.0
 /begin AXIS_DESCR COM_AXIS NO_INPUT_QUANTITY SWC_FDC_type_CM_single_rpm 28 -100000.0 100000.0 AXIS_PTS_REF ATQD_FrLossMAPLowV_X_rpm /end AXIS_DESCR
 /begin AXIS_DESCR COM_AXIS VTQD_CoordWhlTqDemFr_Nm SWC_FDC_type_CM_single_Nm 29 -100000.0 100000.0 AXIS_PTS_REF ATQD_FrLossMAPLowV_Y_Nm /end AXIS_DESCR
/end CHARACTERISTIC
/begin CHARACTERISTIC MTQD_RrLossMAPHighV_Z_kW "" MAP 0x0000 /* @ECU_Address@MTQD_RrLossMAPHighV_Z_kW@ */ Lookup2D_FLOAT32_IEEE 0 SWC_FDC_type_CM_single_kw -200.0 200.0
 /begin AXIS_DESCR COM_AXIS NO_INPUT_QUANTITY SWC_FDC_type_CM_single_rpm 28 -100000.0 100000.0 AXIS_PTS_REF ATQD_RrLossMAPLowV_X_rpm /end AXIS_DESCR
 /begin AXIS_DESCR COM_AXIS VTQD_CoordWhlTqDemRr_Nm SWC_FDC_type_CM_single_Nm 29 -100000.0 100000.0 AXIS_PTS_REF ATQD_RrLossMAPLowV_Y_Nm /end AXIS_DESCR
/end CHARACTERISTIC
/begin AXIS_PTS ATQD_RrLossMAPLowV_Y_Nm "" 0x0000 /* @ECU_Address@ATQD_RrLossMAPLowV_Y_Nm@ */ VTQD_CoordWhlTqDemRr_Nm Lookup2D_X_FLOAT32_IEEE 0 SWC_FDC_type_CM_single_Nm 29 -100000.0 100000.0 /end AXIS_PTS
/begin AXIS_PTS ATQD_RrLossMAPLowV_X_rpm "" 0x0000 /* @ECU_Address@ATQD_RrLossMAPLowV_X_rpm@ */ NO_INPUT_QUANTITY Lookup2D_X_FLOAT32_IEEE 0 SWC_FDC_type_CM_single_rpm 28 -100000.0 100000.0 /end AXIS_PTS
/begin CHARACTERISTIC MTQD_RrLossMAPLowV_Z_kW "" MAP 0x0000 /* @ECU_Address@MTQD_RrLossMAPLowV_Z_kW@ */ Lookup2D_FLOAT32_IEEE 0 SWC_FDC_type_CM_single_kw -200.0 200.0
 /begin AXIS_DESCR COM_AXIS NO_INPUT_QUANTITY SWC_FDC_type_CM_single_rpm 28 -100000.0 100000.0 AXIS_PTS_REF ATQD_RrLossMAPLowV_X_rpm /end AXIS_DESCR
 /begin AXIS_DESCR COM_AXIS VTQD_CoordWhlTqDemRr_Nm SWC_FDC_type_CM_single_Nm 29 -100000.0 100000.0 AXIS_PTS_REF ATQD_RrLossMAPLowV_Y_Nm /end AXIS_DESCR
/end CHARACTERISTIC
/begin CHARACTERISTIC MTQD_CreepItermMaxLimit_Y_Nm "" CURVE 0x0000 /* @ECU_Address@MTQD_CreepItermMaxLimit_Y_Nm@ */ Lookup1D_FLOAT32_IEEE 0 SWC_FDC_type_CM_single_s -100000.0 100000.0
 /begin AXIS_DESCR COM_AXIS VTQD_ActBPSPosn_pct SWC_FDC_type_CM_single_pct 17 0.0 125.0 AXIS_PTS_REF ATQD_CreepItermMaxLimit_X_pct /end AXIS_DESCR
/end CHARACTERISTIC
/begin AXIS_PTS ATQD_CreepItermMaxLimit_X_pct "" 0x0000 /* @ECU_Address@ATQD_CreepItermMaxLimit_X_pct@ */ VTQD_ActBPSPosn_pct Lookup1D_X_FLOAT32_IEEE 0 SWC_FDC_type_CM_single_pct 17 0.0 125.0 /end AXIS_PTS
/begin CHARACTERISTIC MTQD_LHMTqMapD_Z_Nm "" MAP 0x0000 /* @ECU_Address@MTQD_LHMTqMapD_Z_Nm@ */ Lookup2D_FLOAT32_IEEE 0 SWC_FDC_type_CM_single_Nm -100000.0 100000.0
 /begin AXIS_DESCR COM_AXIS VTQD_TqTargetShaftSpd_rpm SWC_FDC_type_CM_single_rpm 42 -100000.0 100000.0 AXIS_PTS_REF ATQD_NL1TqMapD_X_rpm /end AXIS_DESCR
 /begin AXIS_DESCR COM_AXIS VTQD_ActAPSPosn_pct SWC_FDC_type_CM_single_pct 35 0.0 110.0 AXIS_PTS_REF ATQD_NL1TqMapD_Y_pct /end AXIS_DESCR
/end CHARACTERISTIC
/begin AXIS_PTS ATQD_NL1TqMapD_Y_pct "" 0x0000 /* @ECU_Address@ATQD_NL1TqMapD_Y_pct@ */ VTQD_ActAPSPosn_pct Lookup2D_X_FLOAT32_IEEE 0 SWC_FDC_type_CM_single_pct 35 0.0 110.0 /end AXIS_PTS
/begin AXIS_PTS ATQD_NL1TqMapD_X_rpm "" 0x0000 /* @ECU_Address@ATQD_NL1TqMapD_X_rpm@ */ VTQD_TqTargetShaftSpd_rpm Lookup2D_X_FLOAT32_IEEE 0 SWC_FDC_type_CM_single_rpm 42 -100000.0 100000.0 /end AXIS_PTS
/begin CHARACTERISTIC MTQD_LHMTqMapR_Z_Nm "" MAP 0x0000 /* @ECU_Address@MTQD_LHMTqMapR_Z_Nm@ */ Lookup2D_FLOAT32_IEEE 0 SWC_FDC_type_CM_single_Nm -100000.0 100000.0
 /begin AXIS_DESCR COM_AXIS VTQD_TqTargetShaftSpd_rpm SWC_FDC_type_CM_single_rpm 42 -100000.0 100000.0 AXIS_PTS_REF ATQD_NL1TqMapD_X_rpm /end AXIS_DESCR
 /begin AXIS_DESCR COM_AXIS VTQD_ActAPSPosn_pct SWC_FDC_type_CM_single_pct 35 0.0 110.0 AXIS_PTS_REF ATQD_NL1TqMapD_Y_pct /end AXIS_DESCR
/end CHARACTERISTIC
/begin CHARACTERISTIC MTQR_ESCAPEFEDUTs_Z_c "" MAP 0x0000 /* @ECU_Address@MTQR_ESCAPEFEDUTs_Z_c@ */ Lookup2D_FLOAT32_IEEE 0 SWC_FDC_type_CM_single_c 0.0 1.0
 /begin AXIS_DESCR COM_AXIS NO_INPUT_QUANTITY SWC_FDC_type_CM_single_rpm 24 -100000.0 100000.0 AXIS_PTS_REF ATQR_NL1FEDUTs_X_rpm /end AXIS_DESCR
 /begin AXIS_DESCR COM_AXIS VTQR_FEDUWhlTqReqSmoothDelay_Nm SWC_FDC_type_CM_single_Nm 18 -10000.0 10000.0 AXIS_PTS_REF ATQR_NL1FEDUTs_Y_Nm /end AXIS_DESCR
/end CHARACTERISTIC
/begin AXIS_PTS ATQR_NL1FEDUTs_Y_Nm "" 0x0000 /* @ECU_Address@ATQR_NL1FEDUTs_Y_Nm@ */ VTQR_FEDUWhlTqReqSmoothDelay_Nm Lookup2D_X_FLOAT32_IEEE 0 SWC_FDC_type_CM_single_Nm 18 -10000.0 10000.0 /end AXIS_PTS
/begin AXIS_PTS ATQR_NL1FEDUTs_X_rpm "" 0x0000 /* @ECU_Address@ATQR_NL1FEDUTs_X_rpm@ */ NO_INPUT_QUANTITY Lookup2D_X_FLOAT32_IEEE 0 SWC_FDC_type_CM_single_rpm 24 -100000.0 100000.0 /end AXIS_PTS
/begin CHARACTERISTIC MTQR_LHMFEDUTs_Z_c "" MAP 0x0000 /* @ECU_Address@MTQR_LHMFEDUTs_Z_c@ */ Lookup2D_FLOAT32_IEEE 0 SWC_FDC_type_CM_single_c 0.0 1.0
 /begin AXIS_DESCR COM_AXIS NO_INPUT_QUANTITY SWC_FDC_type_CM_single_rpm 24 -100000.0 100000.0 AXIS_PTS_REF ATQR_NL1FEDUTs_X_rpm /end AXIS_DESCR
 /begin AXIS_DESCR COM_AXIS VTQR_FEDUWhlTqReqSmoothDelay_Nm SWC_FDC_type_CM_single_Nm 18 -10000.0 10000.0 AXIS_PTS_REF ATQR_NL1FEDUTs_Y_Nm /end AXIS_DESCR
/end CHARACTERISTIC
/begin CHARACTERISTIC MTQR_SNOWFEDUTs_Z_c "" MAP 0x0000 /* @ECU_Address@MTQR_SNOWFEDUTs_Z_c@ */ Lookup2D_FLOAT32_IEEE 0 SWC_FDC_type_CM_single_c 0.0 1.0
 /begin AXIS_DESCR COM_AXIS NO_INPUT_QUANTITY SWC_FDC_type_CM_single_rpm 24 -100000.0 100000.0 AXIS_PTS_REF ATQR_NL1FEDUTs_X_rpm /end AXIS_DESCR
 /begin AXIS_DESCR COM_AXIS VTQR_FEDUWhlTqReqSmoothDelay_Nm SWC_FDC_type_CM_single_Nm 18 -10000.0 10000.0 AXIS_PTS_REF ATQR_NL1FEDUTs_Y_Nm /end AXIS_DESCR
/end CHARACTERISTIC
/begin CHARACTERISTIC MTQR_TCSFEDUTs_Z_c "" MAP 0x0000 /* @ECU_Address@MTQR_TCSFEDUTs_Z_c@ */ Lookup2D_FLOAT32_IEEE 0 SWC_FDC_type_CM_single_c 0.0 1.0
 /begin AXIS_DESCR COM_AXIS NO_INPUT_QUANTITY SWC_FDC_type_CM_single_rpm 24 -100000.0 100000.0 AXIS_PTS_REF ATQR_NL1FEDUTs_X_rpm /end AXIS_DESCR
 /begin AXIS_DESCR COM_AXIS VTQR_FEDUWhlTqReqSmoothDelay_Nm SWC_FDC_type_CM_single_Nm 18 -10000.0 10000.0 AXIS_PTS_REF ATQR_NL1FEDUTs_Y_Nm /end AXIS_DESCR
/end CHARACTERISTIC
/begin CHARACTERISTIC MTQR_FTqZeroTransLowBoundE_Y_Nm "" CURVE 0x0000 /* @ECU_Address@MTQR_FTqZeroTransLowBoundE_Y_Nm@ */ Lookup1D_FLOAT32_IEEE 0 SWC_FDC_type_CM_single_Nm -150.0 0.0
 /begin AXIS_DESCR COM_AXIS NO_INPUT_QUANTITY SWC_FDC_type_CM_single_rpm 16 -100000.0 100000.0 AXIS_PTS_REF ATQR_FTqZeroTransUpBoundN_X_rpm /end AXIS_DESCR
/end CHARACTERISTIC
/begin AXIS_PTS ATQR_FTqZeroTransUpBoundN_X_rpm "" 0x0000 /* @ECU_Address@ATQR_FTqZeroTransUpBoundN_X_rpm@ */ NO_INPUT_QUANTITY Lookup1D_X_FLOAT32_IEEE 0 SWC_FDC_type_CM_single_rpm 16 -100000.0 100000.0 /end AXIS_PTS
/begin CHARACTERISTIC MTQR_FTqZeroTransUpBoundE_Y_Nm "" CURVE 0x0000 /* @ECU_Address@MTQR_FTqZeroTransUpBoundE_Y_Nm@ */ Lookup1D_FLOAT32_IEEE 0 SWC_FDC_type_CM_single_Nm 0.0 150.0
 /begin AXIS_DESCR COM_AXIS NO_INPUT_QUANTITY SWC_FDC_type_CM_single_rpm 16 -100000.0 100000.0 AXIS_PTS_REF ATQR_FTqZeroTransUpBoundN_X_rpm /end AXIS_DESCR
/end CHARACTERISTIC
/begin CHARACTERISTIC MTQR_FTqZeroTransLowBoundN_Y_Nm "" CURVE 0x0000 /* @ECU_Address@MTQR_FTqZeroTransLowBoundN_Y_Nm@ */ Lookup1D_FLOAT32_IEEE 0 SWC_FDC_type_CM_single_Nm -150.0 0.0
 /begin AXIS_DESCR COM_AXIS NO_INPUT_QUANTITY SWC_FDC_type_CM_single_rpm 16 -100000.0 100000.0 AXIS_PTS_REF ATQR_FTqZeroTransUpBoundN_X_rpm /end AXIS_DESCR
/end CHARACTERISTIC
/begin CHARACTERISTIC MTQR_FTqZeroTransUpBoundN_Y_Nm "" CURVE 0x0000 /* @ECU_Address@MTQR_FTqZeroTransUpBoundN_Y_Nm@ */ Lookup1D_FLOAT32_IEEE 0 SWC_FDC_type_CM_single_Nm 0.0 150.0
 /begin AXIS_DESCR COM_AXIS NO_INPUT_QUANTITY SWC_FDC_type_CM_single_rpm 16 -100000.0 100000.0 AXIS_PTS_REF ATQR_FTqZeroTransUpBoundN_X_rpm /end AXIS_DESCR
/end CHARACTERISTIC
/begin CHARACTERISTIC MTQR_FTqZeroTransLowBoundS_Y_Nm "" CURVE 0x0000 /* @ECU_Address@MTQR_FTqZeroTransLowBoundS_Y_Nm@ */ Lookup1D_FLOAT32_IEEE 0 SWC_FDC_type_CM_single_Nm -150.0 0.0
 /begin AXIS_DESCR COM_AXIS NO_INPUT_QUANTITY SWC_FDC_type_CM_single_rpm 16 -100000.0 100000.0 AXIS_PTS_REF ATQR_FTqZeroTransUpBoundN_X_rpm /end AXIS_DESCR
/end CHARACTERISTIC
/begin CHARACTERISTIC MTQR_FTqZeroTransUpBoundS_Y_Nm "" CURVE 0x0000 /* @ECU_Address@MTQR_FTqZeroTransUpBoundS_Y_Nm@ */ Lookup1D_FLOAT32_IEEE 0 SWC_FDC_type_CM_single_Nm 0.0 150.0
 /begin AXIS_DESCR COM_AXIS NO_INPUT_QUANTITY SWC_FDC_type_CM_single_rpm 16 -100000.0 100000.0 AXIS_PTS_REF ATQR_FTqZeroTransUpBoundN_X_rpm /end AXIS_DESCR
/end CHARACTERISTIC
/begin CHARACTERISTIC MTQR_ECO2TqFrIncGain_Z_c "" MAP 0x0000 /* @ECU_Address@MTQR_ECO2TqFrIncGain_Z_c@ */ Lookup2D_FLOAT32_IEEE 0 SWC_FDC_type_CM_single_c 0.0 300.0
 /begin AXIS_DESCR COM_AXIS VTQR_FEDUWhlTqReqSmoothDelay_Nm SWC_FDC_type_CM_single_Nm 20 -100000.0 100000.0 AXIS_PTS_REF ATQR_ECO2TqFrIncGain_X_Nm /end AXIS_DESCR
 /begin AXIS_DESCR COM_AXIS NO_INPUT_QUANTITY SWC_FDC_type_CM_single_pct 17 -125.0 125.0 AXIS_PTS_REF ATQR_ECO2TqFrIncGain_Y_pct /end AXIS_DESCR
/end CHARACTERISTIC
/begin AXIS_PTS ATQR_ECO2TqFrIncGain_Y_pct "" 0x0000 /* @ECU_Address@ATQR_ECO2TqFrIncGain_Y_pct@ */ NO_INPUT_QUANTITY Lookup2D_X_FLOAT32_IEEE 0 SWC_FDC_type_CM_single_pct 17 -125.0 125.0 /end AXIS_PTS
/begin AXIS_PTS ATQR_ECO2TqFrIncGain_X_Nm "" 0x0000 /* @ECU_Address@ATQR_ECO2TqFrIncGain_X_Nm@ */ VTQR_FEDUWhlTqReqSmoothDelay_Nm Lookup2D_X_FLOAT32_IEEE 0 SWC_FDC_type_CM_single_Nm 20 -100000.0 100000.0 /end AXIS_PTS
/begin CHARACTERISTIC MTQR_ECO3TqFrIncGain_Z_c "" MAP 0x0000 /* @ECU_Address@MTQR_ECO3TqFrIncGain_Z_c@ */ Lookup2D_FLOAT32_IEEE 0 SWC_FDC_type_CM_single_c 0.0 300.0
 /begin AXIS_DESCR COM_AXIS VTQR_FEDUWhlTqReqSmoothDelay_Nm SWC_FDC_type_CM_single_Nm 20 -100000.0 100000.0 AXIS_PTS_REF ATQR_ECO2TqFrIncGain_X_Nm /end AXIS_DESCR
 /begin AXIS_DESCR COM_AXIS NO_INPUT_QUANTITY SWC_FDC_type_CM_single_pct 17 -125.0 125.0 AXIS_PTS_REF ATQR_ECO2TqFrIncGain_Y_pct /end AXIS_DESCR
/end CHARACTERISTIC
/begin CHARACTERISTIC MTQR_ECO4TqFrIncGain_Z_c "" MAP 0x0000 /* @ECU_Address@MTQR_ECO4TqFrIncGain_Z_c@ */ Lookup2D_FLOAT32_IEEE 0 SWC_FDC_type_CM_single_c 0.0 300.0
 /begin AXIS_DESCR COM_AXIS VTQR_FEDUWhlTqReqSmoothDelay_Nm SWC_FDC_type_CM_single_Nm 20 -100000.0 100000.0 AXIS_PTS_REF ATQR_ECO2TqFrIncGain_X_Nm /end AXIS_DESCR
 /begin AXIS_DESCR COM_AXIS NO_INPUT_QUANTITY SWC_FDC_type_CM_single_pct 17 -125.0 125.0 AXIS_PTS_REF ATQR_ECO2TqFrIncGain_Y_pct /end AXIS_DESCR
/end CHARACTERISTIC
/begin CHARACTERISTIC MTQR_ECO5TqFrIncGain_Z_c "" MAP 0x0000 /* @ECU_Address@MTQR_ECO5TqFrIncGain_Z_c@ */ Lookup2D_FLOAT32_IEEE 0 SWC_FDC_type_CM_single_c 0.0 300.0
 /begin AXIS_DESCR COM_AXIS VTQR_FEDUWhlTqReqSmoothDelay_Nm SWC_FDC_type_CM_single_Nm 20 -100000.0 100000.0 AXIS_PTS_REF ATQR_ECO2TqFrIncGain_X_Nm /end AXIS_DESCR
 /begin AXIS_DESCR COM_AXIS NO_INPUT_QUANTITY SWC_FDC_type_CM_single_pct 17 -125.0 125.0 AXIS_PTS_REF ATQR_ECO2TqFrIncGain_Y_pct /end AXIS_DESCR
/end CHARACTERISTIC
/begin CHARACTERISTIC MTQR_ECOOPDTqFrIncGain_Z_c "" MAP 0x0000 /* @ECU_Address@MTQR_ECOOPDTqFrIncGain_Z_c@ */ Lookup2D_FLOAT32_IEEE 0 SWC_FDC_type_CM_single_c 0.0 300.0
 /begin AXIS_DESCR COM_AXIS VTQR_FEDUWhlTqReqSmoothDelay_Nm SWC_FDC_type_CM_single_Nm 20 -100000.0 100000.0 AXIS_PTS_REF ATQR_ECO2TqFrIncGain_X_Nm /end AXIS_DESCR
 /begin AXIS_DESCR COM_AXIS NO_INPUT_QUANTITY SWC_FDC_type_CM_single_pct 17 -125.0 125.0 AXIS_PTS_REF ATQR_ECO2TqFrIncGain_Y_pct /end AXIS_DESCR
/end CHARACTERISTIC
/begin CHARACTERISTIC MTQR_EcoTqFrIncGain_Z_c "" MAP 0x0000 /* @ECU_Address@MTQR_EcoTqFrIncGain_Z_c@ */ Lookup2D_FLOAT32_IEEE 0 SWC_FDC_type_CM_single_c 0.0 300.0
 /begin AXIS_DESCR COM_AXIS VTQR_FEDUWhlTqReqSmoothDelay_Nm SWC_FDC_type_CM_single_Nm 24 -100000.0 100000.0 AXIS_PTS_REF ATQR_EcoTqFrIncGain_X_Nm /end AXIS_DESCR
 /begin AXIS_DESCR COM_AXIS NO_INPUT_QUANTITY SWC_FDC_type_CM_single_pct 17 -125.0 125.0 AXIS_PTS_REF ATQR_EcoTqFrIncGain_Y_pct /end AXIS_DESCR
/end CHARACTERISTIC
/begin AXIS_PTS ATQR_EcoTqFrIncGain_Y_pct "" 0x0000 /* @ECU_Address@ATQR_EcoTqFrIncGain_Y_pct@ */ NO_INPUT_QUANTITY Lookup2D_X_FLOAT32_IEEE 0 SWC_FDC_type_CM_single_pct 17 -125.0 125.0 /end AXIS_PTS
/begin AXIS_PTS ATQR_EcoTqFrIncGain_X_Nm "" 0x0000 /* @ECU_Address@ATQR_EcoTqFrIncGain_X_Nm@ */ VTQR_FEDUWhlTqReqSmoothDelay_Nm Lookup2D_X_FLOAT32_IEEE 0 SWC_FDC_type_CM_single_Nm 24 -100000.0 100000.0 /end AXIS_PTS
/begin CHARACTERISTIC MTQR_ESCAPEFEDUTqDecSR_Z_Nm "" MAP 0x0000 /* @ECU_Address@MTQR_ESCAPEFEDUTqDecSR_Z_Nm@ */ Lookup2D_FLOAT32_IEEE 0 SWC_FDC_type_CM_single_Nm -100000.0 0.0
 /begin AXIS_DESCR COM_AXIS NO_INPUT_QUANTITY SWC_FDC_type_CM_single_rpm 24 -100000.0 100000.0 AXIS_PTS_REF ATQR_NL1FEDUTqIncSR_X_rpm /end AXIS_DESCR
 /begin AXIS_DESCR COM_AXIS VTQR_FEDUWhlTqReqSmoothDelay_Nm SWC_FDC_type_CM_single_Nm 18 -10000.0 10000.0 AXIS_PTS_REF ATQR_NL1REDUTqDecSR_Y_Nm /end AXIS_DESCR
/end CHARACTERISTIC
/begin AXIS_PTS ATQR_NL1REDUTqDecSR_Y_Nm "" 0x0000 /* @ECU_Address@ATQR_NL1REDUTqDecSR_Y_Nm@ */ VTQR_FEDUWhlTqReqSmoothDelay_Nm Lookup2D_X_FLOAT32_IEEE 0 SWC_FDC_type_CM_single_Nm 18 -10000.0 10000.0 /end AXIS_PTS
/begin AXIS_PTS ATQR_NL1FEDUTqIncSR_X_rpm "" 0x0000 /* @ECU_Address@ATQR_NL1FEDUTqIncSR_X_rpm@ */ NO_INPUT_QUANTITY Lookup2D_X_FLOAT32_IEEE 0 SWC_FDC_type_CM_single_rpm 24 -100000.0 100000.0 /end AXIS_PTS
/begin CHARACTERISTIC MTQR_ESCAPEFEDUTqIncSR_Z_Nm "" MAP 0x0000 /* @ECU_Address@MTQR_ESCAPEFEDUTqIncSR_Z_Nm@ */ Lookup2D_FLOAT32_IEEE 0 SWC_FDC_type_CM_single_Nm 0.0 100000.0
 /begin AXIS_DESCR COM_AXIS NO_INPUT_QUANTITY SWC_FDC_type_CM_single_rpm 24 -100000.0 100000.0 AXIS_PTS_REF ATQR_NL1FEDUTqIncSR_X_rpm /end AXIS_DESCR
 /begin AXIS_DESCR COM_AXIS NO_INPUT_QUANTITY SWC_FDC_type_CM_single_Nm 17 0.0 120.0 AXIS_PTS_REF ATQR_NL1FEDUTqIncSR_Y_pct /end AXIS_DESCR
/end CHARACTERISTIC
/begin AXIS_PTS ATQR_NL1FEDUTqIncSR_Y_pct "" 0x0000 /* @ECU_Address@ATQR_NL1FEDUTqIncSR_Y_pct@ */ NO_INPUT_QUANTITY Lookup2D_X_FLOAT32_IEEE 0 SWC_FDC_type_CM_single_Nm 17 0.0 120.0 /end AXIS_PTS
/begin CHARACTERISTIC MTQR_LHMFEDUTqDecSR_Z_Nm "" MAP 0x0000 /* @ECU_Address@MTQR_LHMFEDUTqDecSR_Z_Nm@ */ Lookup2D_FLOAT32_IEEE 0 SWC_FDC_type_CM_single_Nm -100000.0 0.0
 /begin AXIS_DESCR COM_AXIS NO_INPUT_QUANTITY SWC_FDC_type_CM_single_rpm 24 -100000.0 100000.0 AXIS_PTS_REF ATQR_NL1FEDUTqIncSR_X_rpm /end AXIS_DESCR
 /begin AXIS_DESCR COM_AXIS VTQR_FEDUWhlTqReqSmoothDelay_Nm SWC_FDC_type_CM_single_Nm 18 -10000.0 10000.0 AXIS_PTS_REF ATQR_NL1FEDUTqDecSR_Y_Nm /end AXIS_DESCR
/end CHARACTERISTIC
/begin AXIS_PTS ATQR_NL1FEDUTqDecSR_Y_Nm "" 0x0000 /* @ECU_Address@ATQR_NL1FEDUTqDecSR_Y_Nm@ */ VTQR_FEDUWhlTqReqSmoothDelay_Nm Lookup2D_X_FLOAT32_IEEE 0 SWC_FDC_type_CM_single_Nm 18 -10000.0 10000.0 /end AXIS_PTS
/begin CHARACTERISTIC MTQR_LHMFEDUTqIncSR_Z_Nm "" MAP 0x0000 /* @ECU_Address@MTQR_LHMFEDUTqIncSR_Z_Nm@ */ Lookup2D_FLOAT32_IEEE 0 SWC_FDC_type_CM_single_Nm 0.0 100000.0
 /begin AXIS_DESCR COM_AXIS NO_INPUT_QUANTITY SWC_FDC_type_CM_single_rpm 24 -100000.0 100000.0 AXIS_PTS_REF ATQR_NL1FEDUTqIncSR_X_rpm /end AXIS_DESCR
 /begin AXIS_DESCR COM_AXIS NO_INPUT_QUANTITY SWC_FDC_type_CM_single_Nm 17 0.0 120.0 AXIS_PTS_REF ATQR_NL1FEDUTqIncSR_Y_pct /end AXIS_DESCR
/end CHARACTERISTIC
/begin CHARACTERISTIC MTQR_NL2TqFrIncGain_Z_c "" MAP 0x0000 /* @ECU_Address@MTQR_NL2TqFrIncGain_Z_c@ */ Lookup2D_FLOAT32_IEEE 0 SWC_FDC_type_CM_single_c 0.0 300.0
 /begin AXIS_DESCR COM_AXIS VTQR_FEDUWhlTqReqSmoothDelay_Nm SWC_FDC_type_CM_single_Nm 20 -100000.0 100000.0 AXIS_PTS_REF ATQR_NL2TqFrIncGain_X_Nm /end AXIS_DESCR
 /begin AXIS_DESCR COM_AXIS NO_INPUT_QUANTITY SWC_FDC_type_CM_single_pct 17 -125.0 125.0 AXIS_PTS_REF ATQR_NL2TqFrIncGain_Y_pct /end AXIS_DESCR
/end CHARACTERISTIC
/begin AXIS_PTS ATQR_NL2TqFrIncGain_Y_pct "" 0x0000 /* @ECU_Address@ATQR_NL2TqFrIncGain_Y_pct@ */ NO_INPUT_QUANTITY Lookup2D_X_FLOAT32_IEEE 0 SWC_FDC_type_CM_single_pct 17 -125.0 125.0 /end AXIS_PTS
/begin AXIS_PTS ATQR_NL2TqFrIncGain_X_Nm "" 0x0000 /* @ECU_Address@ATQR_NL2TqFrIncGain_X_Nm@ */ VTQR_FEDUWhlTqReqSmoothDelay_Nm Lookup2D_X_FLOAT32_IEEE 0 SWC_FDC_type_CM_single_Nm 20 -100000.0 100000.0 /end AXIS_PTS
/begin CHARACTERISTIC MTQR_NL3TqFrIncGain_Z_c "" MAP 0x0000 /* @ECU_Address@MTQR_NL3TqFrIncGain_Z_c@ */ Lookup2D_FLOAT32_IEEE 0 SWC_FDC_type_CM_single_c 0.0 300.0
 /begin AXIS_DESCR COM_AXIS VTQR_FEDUWhlTqReqSmoothDelay_Nm SWC_FDC_type_CM_single_Nm 20 -100000.0 100000.0 AXIS_PTS_REF ATQR_NL2TqFrIncGain_X_Nm /end AXIS_DESCR
 /begin AXIS_DESCR COM_AXIS NO_INPUT_QUANTITY SWC_FDC_type_CM_single_pct 17 -125.0 125.0 AXIS_PTS_REF ATQR_NL2TqFrIncGain_Y_pct /end AXIS_DESCR
/end CHARACTERISTIC
/begin CHARACTERISTIC MTQR_NL4TqFrIncGain_Z_c "" MAP 0x0000 /* @ECU_Address@MTQR_NL4TqFrIncGain_Z_c@ */ Lookup2D_FLOAT32_IEEE 0 SWC_FDC_type_CM_single_c 0.0 300.0
 /begin AXIS_DESCR COM_AXIS VTQR_FEDUWhlTqReqSmoothDelay_Nm SWC_FDC_type_CM_single_Nm 20 -100000.0 100000.0 AXIS_PTS_REF ATQR_NL2TqFrIncGain_X_Nm /end AXIS_DESCR
 /begin AXIS_DESCR COM_AXIS NO_INPUT_QUANTITY SWC_FDC_type_CM_single_pct 17 -125.0 125.0 AXIS_PTS_REF ATQR_NL2TqFrIncGain_Y_pct /end AXIS_DESCR
/end CHARACTERISTIC
/begin CHARACTERISTIC MTQR_NL5TqFrIncGain_Z_c "" MAP 0x0000 /* @ECU_Address@MTQR_NL5TqFrIncGain_Z_c@ */ Lookup2D_FLOAT32_IEEE 0 SWC_FDC_type_CM_single_c 0.0 300.0
 /begin AXIS_DESCR COM_AXIS VTQR_FEDUWhlTqReqSmoothDelay_Nm SWC_FDC_type_CM_single_Nm 20 -100000.0 100000.0 AXIS_PTS_REF ATQR_NL2TqFrIncGain_X_Nm /end AXIS_DESCR
 /begin AXIS_DESCR COM_AXIS NO_INPUT_QUANTITY SWC_FDC_type_CM_single_pct 17 -125.0 125.0 AXIS_PTS_REF ATQR_NL2TqFrIncGain_Y_pct /end AXIS_DESCR
/end CHARACTERISTIC
/begin CHARACTERISTIC MTQR_NLOPDTqFrIncGain_Z_c "" MAP 0x0000 /* @ECU_Address@MTQR_NLOPDTqFrIncGain_Z_c@ */ Lookup2D_FLOAT32_IEEE 0 SWC_FDC_type_CM_single_c 0.0 300.0
 /begin AXIS_DESCR COM_AXIS VTQR_FEDUWhlTqReqSmoothDelay_Nm SWC_FDC_type_CM_single_Nm 20 -100000.0 100000.0 AXIS_PTS_REF ATQR_NL2TqFrIncGain_X_Nm /end AXIS_DESCR
 /begin AXIS_DESCR COM_AXIS NO_INPUT_QUANTITY SWC_FDC_type_CM_single_pct 17 -125.0 125.0 AXIS_PTS_REF ATQR_NL2TqFrIncGain_Y_pct /end AXIS_DESCR
/end CHARACTERISTIC
/begin CHARACTERISTIC MTQR_NormalTqFrIncGain_Z_c "" MAP 0x0000 /* @ECU_Address@MTQR_NormalTqFrIncGain_Z_c@ */ Lookup2D_FLOAT32_IEEE 0 SWC_FDC_type_CM_single_c 0.0 300.0
 /begin AXIS_DESCR COM_AXIS VTQR_FEDUWhlTqReqSmoothDelay_Nm SWC_FDC_type_CM_single_Nm 24 -100000.0 100000.0 AXIS_PTS_REF ATQR_NormalTqFrIncGain_X_Nm /end AXIS_DESCR
 /begin AXIS_DESCR COM_AXIS NO_INPUT_QUANTITY SWC_FDC_type_CM_single_pct 17 -125.0 125.0 AXIS_PTS_REF ATQR_NormalTqFrIncGain_Y_pct /end AXIS_DESCR
/end CHARACTERISTIC
/begin AXIS_PTS ATQR_NormalTqFrIncGain_Y_pct "" 0x0000 /* @ECU_Address@ATQR_NormalTqFrIncGain_Y_pct@ */ NO_INPUT_QUANTITY Lookup2D_X_FLOAT32_IEEE 0 SWC_FDC_type_CM_single_pct 17 -125.0 125.0 /end AXIS_PTS
/begin AXIS_PTS ATQR_NormalTqFrIncGain_X_Nm "" 0x0000 /* @ECU_Address@ATQR_NormalTqFrIncGain_X_Nm@ */ VTQR_FEDUWhlTqReqSmoothDelay_Nm Lookup2D_X_FLOAT32_IEEE 0 SWC_FDC_type_CM_single_Nm 24 -100000.0 100000.0 /end AXIS_PTS
/begin CHARACTERISTIC MTQR_SNOWFEDUTqDecSR_Z_Nm "" MAP 0x0000 /* @ECU_Address@MTQR_SNOWFEDUTqDecSR_Z_Nm@ */ Lookup2D_FLOAT32_IEEE 0 SWC_FDC_type_CM_single_Nm -20000.0 100000.0
 /begin AXIS_DESCR COM_AXIS NO_INPUT_QUANTITY SWC_FDC_type_CM_single_rpm 24 -100000.0 100000.0 AXIS_PTS_REF ATQR_NL1FEDUTqIncSR_X_rpm /end AXIS_DESCR
 /begin AXIS_DESCR COM_AXIS VTQR_FEDUWhlTqReqSmoothDelay_Nm SWC_FDC_type_CM_single_Nm 18 -10000.0 10000.0 AXIS_PTS_REF ATQR_NL1REDUTqDecSR_Y_Nm /end AXIS_DESCR
/end CHARACTERISTIC
/begin CHARACTERISTIC MTQR_SNOWFEDUTqIncSR_Z_Nm "" MAP 0x0000 /* @ECU_Address@MTQR_SNOWFEDUTqIncSR_Z_Nm@ */ Lookup2D_FLOAT32_IEEE 0 SWC_FDC_type_CM_single_Nm 0.0 100000.0
 /begin AXIS_DESCR COM_AXIS NO_INPUT_QUANTITY SWC_FDC_type_CM_single_rpm 24 -100000.0 100000.0 AXIS_PTS_REF ATQR_NL1FEDUTqIncSR_X_rpm /end AXIS_DESCR
 /begin AXIS_DESCR COM_AXIS NO_INPUT_QUANTITY SWC_FDC_type_CM_single_Nm 17 0.0 120.0 AXIS_PTS_REF ATQR_NL1FEDUTqIncSR_Y_pct /end AXIS_DESCR
/end CHARACTERISTIC
/begin CHARACTERISTIC MTQR_Sport2TqFrIncGain_Z_c "" MAP 0x0000 /* @ECU_Address@MTQR_Sport2TqFrIncGain_Z_c@ */ Lookup2D_FLOAT32_IEEE 0 SWC_FDC_type_CM_single_c 0.0 300.0
 /begin AXIS_DESCR COM_AXIS VTQR_FEDUWhlTqReqSmoothDelay_Nm SWC_FDC_type_CM_single_Nm 20 -100000.0 100000.0 AXIS_PTS_REF ATQR_Sport2TqFrIncGain_X_Nm /end AXIS_DESCR
 /begin AXIS_DESCR COM_AXIS NO_INPUT_QUANTITY SWC_FDC_type_CM_single_pct 17 -125.0 125.0 AXIS_PTS_REF ATQR_Sport2TqFrIncGain_Y_pct /end AXIS_DESCR
/end CHARACTERISTIC
/begin AXIS_PTS ATQR_Sport2TqFrIncGain_Y_pct "" 0x0000 /* @ECU_Address@ATQR_Sport2TqFrIncGain_Y_pct@ */ NO_INPUT_QUANTITY Lookup2D_X_FLOAT32_IEEE 0 SWC_FDC_type_CM_single_pct 17 -125.0 125.0 /end AXIS_PTS
/begin AXIS_PTS ATQR_Sport2TqFrIncGain_X_Nm "" 0x0000 /* @ECU_Address@ATQR_Sport2TqFrIncGain_X_Nm@ */ VTQR_FEDUWhlTqReqSmoothDelay_Nm Lookup2D_X_FLOAT32_IEEE 0 SWC_FDC_type_CM_single_Nm 20 -100000.0 100000.0 /end AXIS_PTS
/begin CHARACTERISTIC MTQR_Sport3TqFrIncGain_Z_c "" MAP 0x0000 /* @ECU_Address@MTQR_Sport3TqFrIncGain_Z_c@ */ Lookup2D_FLOAT32_IEEE 0 SWC_FDC_type_CM_single_c 0.0 300.0
 /begin AXIS_DESCR COM_AXIS VTQR_FEDUWhlTqReqSmoothDelay_Nm SWC_FDC_type_CM_single_Nm 20 -100000.0 100000.0 AXIS_PTS_REF ATQR_Sport2TqFrIncGain_X_Nm /end AXIS_DESCR
 /begin AXIS_DESCR COM_AXIS NO_INPUT_QUANTITY SWC_FDC_type_CM_single_pct 17 -125.0 125.0 AXIS_PTS_REF ATQR_Sport2TqFrIncGain_Y_pct /end AXIS_DESCR
/end CHARACTERISTIC
/begin CHARACTERISTIC MTQR_Sport4TqFrIncGain_Z_c "" MAP 0x0000 /* @ECU_Address@MTQR_Sport4TqFrIncGain_Z_c@ */ Lookup2D_FLOAT32_IEEE 0 SWC_FDC_type_CM_single_c 0.0 300.0
 /begin AXIS_DESCR COM_AXIS VTQR_FEDUWhlTqReqSmoothDelay_Nm SWC_FDC_type_CM_single_Nm 20 -100000.0 100000.0 AXIS_PTS_REF ATQR_Sport2TqFrIncGain_X_Nm /end AXIS_DESCR
 /begin AXIS_DESCR COM_AXIS NO_INPUT_QUANTITY SWC_FDC_type_CM_single_pct 17 -125.0 125.0 AXIS_PTS_REF ATQR_Sport2TqFrIncGain_Y_pct /end AXIS_DESCR
/end CHARACTERISTIC
/begin CHARACTERISTIC MTQR_Sport5TqFrIncGain_Z_c "" MAP 0x0000 /* @ECU_Address@MTQR_Sport5TqFrIncGain_Z_c@ */ Lookup2D_FLOAT32_IEEE 0 SWC_FDC_type_CM_single_c 0.0 300.0
 /begin AXIS_DESCR COM_AXIS VTQR_FEDUWhlTqReqSmoothDelay_Nm SWC_FDC_type_CM_single_Nm 20 -100000.0 100000.0 AXIS_PTS_REF ATQR_Sport2TqFrIncGain_X_Nm /end AXIS_DESCR
 /begin AXIS_DESCR COM_AXIS NO_INPUT_QUANTITY SWC_FDC_type_CM_single_pct 17 -125.0 125.0 AXIS_PTS_REF ATQR_Sport2TqFrIncGain_Y_pct /end AXIS_DESCR
/end CHARACTERISTIC
/begin CHARACTERISTIC MTQR_SportOPDTqFrIncGain_Z_c "" MAP 0x0000 /* @ECU_Address@MTQR_SportOPDTqFrIncGain_Z_c@ */ Lookup2D_FLOAT32_IEEE 0 SWC_FDC_type_CM_single_c 0.0 300.0
 /begin AXIS_DESCR COM_AXIS VTQR_FEDUWhlTqReqSmoothDelay_Nm SWC_FDC_type_CM_single_Nm 20 -100000.0 100000.0 AXIS_PTS_REF ATQR_Sport2TqFrIncGain_X_Nm /end AXIS_DESCR
 /begin AXIS_DESCR COM_AXIS NO_INPUT_QUANTITY SWC_FDC_type_CM_single_pct 17 -125.0 125.0 AXIS_PTS_REF ATQR_Sport2TqFrIncGain_Y_pct /end AXIS_DESCR
/end CHARACTERISTIC
/begin CHARACTERISTIC MTQR_SportTqFrIncGain_Z_c "" MAP 0x0000 /* @ECU_Address@MTQR_SportTqFrIncGain_Z_c@ */ Lookup2D_FLOAT32_IEEE 0 SWC_FDC_type_CM_single_c 0.0 300.0
 /begin AXIS_DESCR COM_AXIS VTQR_FEDUWhlTqReqSmoothDelay_Nm SWC_FDC_type_CM_single_Nm 24 -100000.0 100000.0 AXIS_PTS_REF ATQR_SportTqFrIncGain_X_Nm /end AXIS_DESCR
 /begin AXIS_DESCR COM_AXIS NO_INPUT_QUANTITY SWC_FDC_type_CM_single_pct 17 -125.0 125.0 AXIS_PTS_REF ATQR_SportTqFrIncGain_Y_pct /end AXIS_DESCR
/end CHARACTERISTIC
/begin AXIS_PTS ATQR_SportTqFrIncGain_Y_pct "" 0x0000 /* @ECU_Address@ATQR_SportTqFrIncGain_Y_pct@ */ NO_INPUT_QUANTITY Lookup2D_X_FLOAT32_IEEE 0 SWC_FDC_type_CM_single_pct 17 -125.0 125.0 /end AXIS_PTS
/begin AXIS_PTS ATQR_SportTqFrIncGain_X_Nm "" 0x0000 /* @ECU_Address@ATQR_SportTqFrIncGain_X_Nm@ */ VTQR_FEDUWhlTqReqSmoothDelay_Nm Lookup2D_X_FLOAT32_IEEE 0 SWC_FDC_type_CM_single_Nm 24 -100000.0 100000.0 /end AXIS_PTS
/begin CHARACTERISTIC MTQR_TCSFEDUTqDecSR_Z_Nm "" MAP 0x0000 /* @ECU_Address@MTQR_TCSFEDUTqDecSR_Z_Nm@ */ Lookup2D_FLOAT32_IEEE 0 SWC_FDC_type_CM_single_Nm -100000.0 0.0
 /begin AXIS_DESCR COM_AXIS NO_INPUT_QUANTITY SWC_FDC_type_CM_single_rpm 24 -100000.0 100000.0 AXIS_PTS_REF ATQR_NL1FEDUTqIncSR_X_rpm /end AXIS_DESCR
 /begin AXIS_DESCR COM_AXIS VTQR_FEDUWhlTqReqSmoothDelay_Nm SWC_FDC_type_CM_single_Nm 18 -10000.0 10000.0 AXIS_PTS_REF ATQR_NL1REDUTqDecSR_Y_Nm /end AXIS_DESCR
/end CHARACTERISTIC
/begin CHARACTERISTIC MTQR_TCSFEDUTqIncSR_Z_Nm "" MAP 0x0000 /* @ECU_Address@MTQR_TCSFEDUTqIncSR_Z_Nm@ */ Lookup2D_FLOAT32_IEEE 0 SWC_FDC_type_CM_single_Nm 0.0 100000.0
 /begin AXIS_DESCR COM_AXIS NO_INPUT_QUANTITY SWC_FDC_type_CM_single_rpm 24 -100000.0 100000.0 AXIS_PTS_REF ATQR_NL1FEDUTqIncSR_X_rpm /end AXIS_DESCR
 /begin AXIS_DESCR COM_AXIS NO_INPUT_QUANTITY SWC_FDC_type_CM_single_Nm 17 0.0 120.0 AXIS_PTS_REF ATQR_NL1FEDUTqIncSR_Y_pct /end AXIS_DESCR
/end CHARACTERISTIC
/begin CHARACTERISTIC MTQR_ESCAPEREDUTs_Z_c "" MAP 0x0000 /* @ECU_Address@MTQR_ESCAPEREDUTs_Z_c@ */ Lookup2D_FLOAT32_IEEE 0 SWC_FDC_type_CM_single_c 0.0 1.0
 /begin AXIS_DESCR COM_AXIS NO_INPUT_QUANTITY SWC_FDC_type_CM_single_rpm 24 -100000.0 100000.0 AXIS_PTS_REF ATQR_NL1FEDUTs_X_rpm /end AXIS_DESCR
 /begin AXIS_DESCR COM_AXIS VTQR_REDUWhlTqReqSmoothDelay_Nm SWC_FDC_type_CM_single_Nm 18 -10000.0 10000.0 AXIS_PTS_REF ATQR_NL1REDUTs_Y_Nm /end AXIS_DESCR
/end CHARACTERISTIC
/begin AXIS_PTS ATQR_NL1REDUTs_Y_Nm "" 0x0000 /* @ECU_Address@ATQR_NL1REDUTs_Y_Nm@ */ VTQR_REDUWhlTqReqSmoothDelay_Nm Lookup2D_X_FLOAT32_IEEE 0 SWC_FDC_type_CM_single_Nm 18 -10000.0 10000.0 /end AXIS_PTS
/begin CHARACTERISTIC MTQR_LHMREDUTs_Z_c "" MAP 0x0000 /* @ECU_Address@MTQR_LHMREDUTs_Z_c@ */ Lookup2D_FLOAT32_IEEE 0 SWC_FDC_type_CM_single_c 0.0 1.0
 /begin AXIS_DESCR COM_AXIS NO_INPUT_QUANTITY SWC_FDC_type_CM_single_rpm 24 -100000.0 100000.0 AXIS_PTS_REF ATQR_NL1FEDUTs_X_rpm /end AXIS_DESCR
 /begin AXIS_DESCR COM_AXIS VTQR_REDUWhlTqReqSmoothDelay_Nm SWC_FDC_type_CM_single_Nm 18 -10000.0 10000.0 AXIS_PTS_REF ATQR_NL1REDUTs_Y_Nm /end AXIS_DESCR
/end CHARACTERISTIC
/begin CHARACTERISTIC MTQR_SNOWREDUTs_Z_c "" MAP 0x0000 /* @ECU_Address@MTQR_SNOWREDUTs_Z_c@ */ Lookup2D_FLOAT32_IEEE 0 SWC_FDC_type_CM_single_c 0.0 1.0
 /begin AXIS_DESCR COM_AXIS NO_INPUT_QUANTITY SWC_FDC_type_CM_single_rpm 24 -100000.0 100000.0 AXIS_PTS_REF ATQR_NL1FEDUTs_X_rpm /end AXIS_DESCR
 /begin AXIS_DESCR COM_AXIS VTQR_REDUWhlTqReqSmoothDelay_Nm SWC_FDC_type_CM_single_Nm 18 -10000.0 10000.0 AXIS_PTS_REF ATQR_NL1REDUTs_Y_Nm /end AXIS_DESCR
/end CHARACTERISTIC
/begin CHARACTERISTIC MTQR_TCSREDUTs_Z_c "" MAP 0x0000 /* @ECU_Address@MTQR_TCSREDUTs_Z_c@ */ Lookup2D_FLOAT32_IEEE 0 SWC_FDC_type_CM_single_c 0.0 1.0
 /begin AXIS_DESCR COM_AXIS NO_INPUT_QUANTITY SWC_FDC_type_CM_single_rpm 24 -100000.0 100000.0 AXIS_PTS_REF ATQR_NL1FEDUTs_X_rpm /end AXIS_DESCR
 /begin AXIS_DESCR COM_AXIS VTQR_REDUWhlTqReqSmoothDelay_Nm SWC_FDC_type_CM_single_Nm 18 -10000.0 10000.0 AXIS_PTS_REF ATQR_NL1REDUTs_Y_Nm /end AXIS_DESCR
/end CHARACTERISTIC
/begin CHARACTERISTIC MTQR_RTqZeroTransLowBoundE_Y_Nm "" CURVE 0x0000 /* @ECU_Address@MTQR_RTqZeroTransLowBoundE_Y_Nm@ */ Lookup1D_FLOAT32_IEEE 0 SWC_FDC_type_CM_single_Nm -150.0 0.0
 /begin AXIS_DESCR COM_AXIS NO_INPUT_QUANTITY SWC_FDC_type_CM_single_rpm 16 -100000.0 100000.0 AXIS_PTS_REF ATQR_FTqZeroTransUpBoundN_X_rpm /end AXIS_DESCR
/end CHARACTERISTIC
/begin CHARACTERISTIC MTQR_RTqZeroTransUpBoundE_Y_Nm "" CURVE 0x0000 /* @ECU_Address@MTQR_RTqZeroTransUpBoundE_Y_Nm@ */ Lookup1D_FLOAT32_IEEE 0 SWC_FDC_type_CM_single_Nm 0.0 150.0
 /begin AXIS_DESCR COM_AXIS NO_INPUT_QUANTITY SWC_FDC_type_CM_single_rpm 16 -100000.0 100000.0 AXIS_PTS_REF ATQR_FTqZeroTransUpBoundN_X_rpm /end AXIS_DESCR
/end CHARACTERISTIC
/begin CHARACTERISTIC MTQR_RTqZeroTransLowBoundN_Y_Nm "" CURVE 0x0000 /* @ECU_Address@MTQR_RTqZeroTransLowBoundN_Y_Nm@ */ Lookup1D_FLOAT32_IEEE 0 SWC_FDC_type_CM_single_Nm -150.0 0.0
 /begin AXIS_DESCR COM_AXIS NO_INPUT_QUANTITY SWC_FDC_type_CM_single_rpm 16 -100000.0 100000.0 AXIS_PTS_REF ATQR_FTqZeroTransUpBoundN_X_rpm /end AXIS_DESCR
/end CHARACTERISTIC
/begin CHARACTERISTIC MTQR_RTqZeroTransUpBoundN_Y_Nm "" CURVE 0x0000 /* @ECU_Address@MTQR_RTqZeroTransUpBoundN_Y_Nm@ */ Lookup1D_FLOAT32_IEEE 0 SWC_FDC_type_CM_single_Nm 0.0 150.0
 /begin AXIS_DESCR COM_AXIS NO_INPUT_QUANTITY SWC_FDC_type_CM_single_rpm 16 -100000.0 100000.0 AXIS_PTS_REF ATQR_FTqZeroTransUpBoundN_X_rpm /end AXIS_DESCR
/end CHARACTERISTIC
/begin CHARACTERISTIC MTQR_RTqZeroTransLowBoundS_Y_Nm "" CURVE 0x0000 /* @ECU_Address@MTQR_RTqZeroTransLowBoundS_Y_Nm@ */ Lookup1D_FLOAT32_IEEE 0 SWC_FDC_type_CM_single_Nm -150.0 0.0
 /begin AXIS_DESCR COM_AXIS NO_INPUT_QUANTITY SWC_FDC_type_CM_single_rpm 16 -100000.0 100000.0 AXIS_PTS_REF ATQR_FTqZeroTransUpBoundN_X_rpm /end AXIS_DESCR
/end CHARACTERISTIC
/begin CHARACTERISTIC MTQR_RTqZeroTransUpBoundS_Y_Nm "" CURVE 0x0000 /* @ECU_Address@MTQR_RTqZeroTransUpBoundS_Y_Nm@ */ Lookup1D_FLOAT32_IEEE 0 SWC_FDC_type_CM_single_Nm 0.0 150.0
 /begin AXIS_DESCR COM_AXIS NO_INPUT_QUANTITY SWC_FDC_type_CM_single_rpm 16 -100000.0 100000.0 AXIS_PTS_REF ATQR_FTqZeroTransUpBoundN_X_rpm /end AXIS_DESCR
/end CHARACTERISTIC
/begin CHARACTERISTIC KTQD_AllowSetSpdSpd_kph "" VALUE 0x0000 /* @ECU_Address@KTQD_AllowSetSpdSpd_kph@ */ Scalar_FLOAT32_IEEE 0 SWC_FDC_type_CM_single_kph 0.0 50.0 /end CHARACTERISTIC
/begin CHARACTERISTIC KTQD_CreepItermMinLimit_Nm "" VALUE 0x0000 /* @ECU_Address@KTQD_CreepItermMinLimit_Nm@ */ Scalar_FLOAT32_IEEE 0 SWC_FDC_type_CM_single_Nm -100000.0 100000.0 /end CHARACTERISTIC
/begin CHARACTERISTIC KTQD_DCDCCalPwrAvailRsv_kW "" VALUE 0x0000 /* @ECU_Address@KTQD_DCDCCalPwrAvailRsv_kW@ */ Scalar_FLOAT32_IEEE 0 SWC_FDC_type_CM_single_kW 0.0 100000.0 /end CHARACTERISTIC
/begin CHARACTERISTIC KTQD_EstFrWhlTqDev_Nm "" VALUE 0x0000 /* @ECU_Address@KTQD_EstFrWhlTqDev_Nm@ */ Scalar_FLOAT32_IEEE 0 SWC_FDC_type_CM_single_Nm 0.0 500.0 /end CHARACTERISTIC
/begin CHARACTERISTIC KTQD_EstLongAccDev_Gps "" VALUE 0x0000 /* @ECU_Address@KTQD_EstLongAccDev_Gps@ */ Scalar_FLOAT32_IEEE 0 SWC_FDC_type_CM_single_Gps 0.0 1.0 /end CHARACTERISTIC
/begin CHARACTERISTIC KTQD_EstRollCoeffA_c "" VALUE 0x0000 /* @ECU_Address@KTQD_EstRollCoeffA_c@ */ Scalar_FLOAT32_IEEE 0 SWC_FDC_type_CM_single_c 0.0 1000.0 /end CHARACTERISTIC
/begin CHARACTERISTIC KTQD_EstRollCoeffB_c "" VALUE 0x0000 /* @ECU_Address@KTQD_EstRollCoeffB_c@ */ Scalar_FLOAT32_IEEE 0 SWC_FDC_type_CM_single_c -100.0 100.0 /end CHARACTERISTIC
/begin CHARACTERISTIC KTQD_EstRollCoeffC_c "" VALUE 0x0000 /* @ECU_Address@KTQD_EstRollCoeffC_c@ */ Scalar_FLOAT32_IEEE 0 SWC_FDC_type_CM_single_c -10.0 10.0 /end CHARACTERISTIC
/begin CHARACTERISTIC KTQD_EstRrWhlTqDev_Nm "" VALUE 0x0000 /* @ECU_Address@KTQD_EstRrWhlTqDev_Nm@ */ Scalar_FLOAT32_IEEE 0 SWC_FDC_type_CM_single_Nm 0.0 500.0 /end CHARACTERISTIC
/begin CHARACTERISTIC KTQD_FrLossMAPHighV_V "" VALUE 0x0000 /* @ECU_Address@KTQD_FrLossMAPHighV_V@ */ Scalar_FLOAT32_IEEE 0 SWC_FDC_type_CM_single_v 0.0 1000.0 /end CHARACTERISTIC
/begin CHARACTERISTIC KTQD_FrLossMAPLowV_V "" VALUE 0x0000 /* @ECU_Address@KTQD_FrLossMAPLowV_V@ */ Scalar_FLOAT32_IEEE 0 SWC_FDC_type_CM_single_v 0.0 1000.0 /end CHARACTERISTIC
/begin CHARACTERISTIC KTQD_FrLowTheldTrq_Nm "" VALUE 0x0000 /* @ECU_Address@KTQD_FrLowTheldTrq_Nm@ */ Scalar_FLOAT32_IEEE 0 SWC_FDC_type_CM_single_Nm -100000.0 100000.0 /end CHARACTERISTIC
/begin CHARACTERISTIC KTQD_FrTMSpdMin_rpm "" VALUE 0x0000 /* @ECU_Address@KTQD_FrTMSpdMin_rpm@ */ Scalar_FLOAT32_IEEE 0 SWC_FDC_type_CM_single_rpm -100000.0 100000.0 /end CHARACTERISTIC
/begin CHARACTERISTIC KTQD_FrTireRadius_m "" VALUE 0x0000 /* @ECU_Address@KTQD_FrTireRadius_m@ */ Scalar_FLOAT32_IEEE 0 SWC_FDC_type_CM_single_m 0.0 5.0 /end CHARACTERISTIC
/begin CHARACTERISTIC KTQD_GravityValue_mps2 "" VALUE 0x0000 /* @ECU_Address@KTQD_GravityValue_mps2@ */ Scalar_FLOAT32_IEEE 0 SWC_FDC_type_CM_single_mps2 0.0 20.0 /end CHARACTERISTIC
/begin CHARACTERISTIC KTQD_RrLossMAPHighV_V "" VALUE 0x0000 /* @ECU_Address@KTQD_RrLossMAPHighV_V@ */ Scalar_FLOAT32_IEEE 0 SWC_FDC_type_CM_single_v 0.0 1000.0 /end CHARACTERISTIC
/begin CHARACTERISTIC KTQD_RrLossMAPLowV_V "" VALUE 0x0000 /* @ECU_Address@KTQD_RrLossMAPLowV_V@ */ Scalar_FLOAT32_IEEE 0 SWC_FDC_type_CM_single_v 0.0 1000.0 /end CHARACTERISTIC
/begin CHARACTERISTIC KTQD_RrLowTheldTrq_Nm "" VALUE 0x0000 /* @ECU_Address@KTQD_RrLowTheldTrq_Nm@ */ Scalar_FLOAT32_IEEE 0 SWC_FDC_type_CM_single_Nm -100000.0 100000.0 /end CHARACTERISTIC
/begin CHARACTERISTIC KTQD_RrTMSpdMin_rpm "" VALUE 0x0000 /* @ECU_Address@KTQD_RrTMSpdMin_rpm@ */ Scalar_FLOAT32_IEEE 0 SWC_FDC_type_CM_single_rpm -100000.0 100000.0 /end CHARACTERISTIC
/begin CHARACTERISTIC KTQD_RrTireRadius_m "" VALUE 0x0000 /* @ECU_Address@KTQD_RrTireRadius_m@ */ Scalar_FLOAT32_IEEE 0 SWC_FDC_type_CM_single_m 0.0 5.0 /end CHARACTERISTIC
/begin CHARACTERISTIC KTQD_ScrollDownLongPLim_s "" VALUE 0x0000 /* @ECU_Address@KTQD_ScrollDownLongPLim_s@ */ Scalar_FLOAT32_IEEE 0 SWC_FDC_type_CM_single_s 0.0 10.0 /end CHARACTERISTIC
/begin CHARACTERISTIC KTQD_ScrollDownShortPLim_s "" VALUE 0x0000 /* @ECU_Address@KTQD_ScrollDownShortPLim_s@ */ Scalar_FLOAT32_IEEE 0 SWC_FDC_type_CM_single_s 0.0 10.0 /end CHARACTERISTIC
/begin CHARACTERISTIC KTQD_ScrollUpLongPLim_s "" VALUE 0x0000 /* @ECU_Address@KTQD_ScrollUpLongPLim_s@ */ Scalar_FLOAT32_IEEE 0 SWC_FDC_type_CM_single_s 0.0 10.0 /end CHARACTERISTIC
/begin CHARACTERISTIC KTQD_ScrollUpShortPLim_s "" VALUE 0x0000 /* @ECU_Address@KTQD_ScrollUpShortPLim_s@ */ Scalar_FLOAT32_IEEE 0 SWC_FDC_type_CM_single_s 0.0 10.0 /end CHARACTERISTIC
/begin CHARACTERISTIC KTQD_SetSpdLongPLim_s "" VALUE 0x0000 /* @ECU_Address@KTQD_SetSpdLongPLim_s@ */ Scalar_FLOAT32_IEEE 0 SWC_FDC_type_CM_single_s 0.0 10.0 /end CHARACTERISTIC
/begin CHARACTERISTIC KTQD_SetSpdShortPLim_s "" VALUE 0x0000 /* @ECU_Address@KTQD_SetSpdShortPLim_s@ */ Scalar_FLOAT32_IEEE 0 SWC_FDC_type_CM_single_s 0.0 10.0 /end CHARACTERISTIC
/begin CHARACTERISTIC KTQD_THCMCalPwrAvailRsv_kW "" VALUE 0x0000 /* @ECU_Address@KTQD_THCMCalPwrAvailRsv_kW@ */ Scalar_FLOAT32_IEEE 0 SWC_FDC_type_CM_single_kW 0.0 100000.0 /end CHARACTERISTIC
/begin CHARACTERISTIC KTQD_VehWeighEstIntAcc_Gps "" VALUE 0x0000 /* @ECU_Address@KTQD_VehWeighEstIntAcc_Gps@ */ Scalar_FLOAT32_IEEE 0 SWC_FDC_type_CM_single_Gps -10.0 10.0 /end CHARACTERISTIC
/begin CHARACTERISTIC KTQD_VehWeighEstTimeTune_cnt "" VALUE 0x0000 /* @ECU_Address@KTQD_VehWeighEstTimeTune_cnt@ */ Scalar_FLOAT32_IEEE 0 SWC_FDC_type_CM_single_cnt -15.0 15.0 /end CHARACTERISTIC
/begin CHARACTERISTIC KTQD_WhlTqCapGenFr_Nm_ovrdval "" VALUE 0x0000 /* @ECU_Address@KTQD_WhlTqCapGenFr_Nm_ovrdval@ */ Scalar_FLOAT32_IEEE 0 SWC_FDC_type_CM_single_Nm -100000.0 100000.0 /end CHARACTERISTIC
/begin CHARACTERISTIC KTQD_WhlTqCapGenRr_Nm_ovrdval "" VALUE 0x0000 /* @ECU_Address@KTQD_WhlTqCapGenRr_Nm_ovrdval@ */ Scalar_FLOAT32_IEEE 0 SWC_FDC_type_CM_single_Nm -100000.0 100000.0 /end CHARACTERISTIC
/begin CHARACTERISTIC KTQD_WhlTqCapMotFr_Nm_ovrdval "" VALUE 0x0000 /* @ECU_Address@KTQD_WhlTqCapMotFr_Nm_ovrdval@ */ Scalar_FLOAT32_IEEE 0 SWC_FDC_type_CM_single_Nm -100000.0 100000.0 /end CHARACTERISTIC
/begin CHARACTERISTIC KTQD_WhlTqCapMotRr_Nm_ovrdval "" VALUE 0x0000 /* @ECU_Address@KTQD_WhlTqCapMotRr_Nm_ovrdval@ */ Scalar_FLOAT32_IEEE 0 SWC_FDC_type_CM_single_Nm -100000.0 100000.0 /end CHARACTERISTIC
/begin CHARACTERISTIC KTQR_ACCHoldPdovrdGrade_Deg "" VALUE 0x0000 /* @ECU_Address@KTQR_ACCHoldPdovrdGrade_Deg@ */ Scalar_FLOAT32_IEEE 0 SWC_FDC_type_CM_single_deg -100.0 100.0 /end CHARACTERISTIC
/begin CHARACTERISTIC KTQR_ACCHoldPdovrdInc_Nm "" VALUE 0x0000 /* @ECU_Address@KTQR_ACCHoldPdovrdInc_Nm@ */ Scalar_FLOAT32_IEEE 0 SWC_FDC_type_CM_single_Nm -10000.0 10000.0 /end CHARACTERISTIC
/begin CHARACTERISTIC KTQR_ACCHoldPdovrdVeh_kph "" VALUE 0x0000 /* @ECU_Address@KTQR_ACCHoldPdovrdVeh_kph@ */ Scalar_FLOAT32_IEEE 0 SWC_FDC_type_CM_single_kph -50.0 255.0 /end CHARACTERISTIC
/begin CHARACTERISTIC KTQR_FShaftSpdDevTs_c "" VALUE 0x0000 /* @ECU_Address@KTQR_FShaftSpdDevTs_c@ */ Scalar_FLOAT32_IEEE 0 SWC_FDC_type_CM_single_c 0.0 1.0 /end CHARACTERISTIC
/begin CHARACTERISTIC KTQR_FShaftSpdTqCoeLimLow_c "" VALUE 0x0000 /* @ECU_Address@KTQR_FShaftSpdTqCoeLimLow_c@ */ Scalar_FLOAT32_IEEE 0 SWC_FDC_type_CM_single_c -0.1 1.0 /end CHARACTERISTIC
/begin CHARACTERISTIC KTQR_FTimerTqCoeLimLow_c "" VALUE 0x0000 /* @ECU_Address@KTQR_FTimerTqCoeLimLow_c@ */ Scalar_FLOAT32_IEEE 0 SWC_FDC_type_CM_single_c -0.1 1.0 /end CHARACTERISTIC
/begin CHARACTERISTIC KTQR_RShaftSpdDevTs_c "" VALUE 0x0000 /* @ECU_Address@KTQR_RShaftSpdDevTs_c@ */ Scalar_FLOAT32_IEEE 0 SWC_FDC_type_CM_single_c 0.0 1.0 /end CHARACTERISTIC
/begin CHARACTERISTIC KTQR_RShaftSpdTqCoeLimLow_c "" VALUE 0x0000 /* @ECU_Address@KTQR_RShaftSpdTqCoeLimLow_c@ */ Scalar_FLOAT32_IEEE 0 SWC_FDC_type_CM_single_c -0.1 1.0 /end CHARACTERISTIC
/begin CHARACTERISTIC KTQR_RTimerTqCoeLimLow_c "" VALUE 0x0000 /* @ECU_Address@KTQR_RTimerTqCoeLimLow_c@ */ Scalar_FLOAT32_IEEE 0 SWC_FDC_type_CM_single_c -0.1 1.0 /end CHARACTERISTIC
/begin CHARACTERISTIC KTQR_ShaftSpdDevTime_s "" VALUE 0x0000 /* @ECU_Address@KTQR_ShaftSpdDevTime_s@ */ Scalar_FLOAT32_IEEE 0 SWC_FDC_type_CM_single_s 0.0 3600.0 /end CHARACTERISTIC
/begin CHARACTERISTIC KTQR_StartTimerShaftDev_rpm "" VALUE 0x0000 /* @ECU_Address@KTQR_StartTimerShaftDev_rpm@ */ Scalar_FLOAT32_IEEE 0 SWC_FDC_type_CM_single_rpm 0.0 100000.0 /end CHARACTERISTIC
/begin CHARACTERISTIC KVMC_4WheelEnSkidDetSpd_kph "" VALUE 0x0000 /* @ECU_Address@KVMC_4WheelEnSkidDetSpd_kph@ */ Scalar_FLOAT32_IEEE 0 SWC_FDC_type_CM_single_kph -10.0 300.0 /end CHARACTERISTIC
/begin CHARACTERISTIC KVMC_FrontRearSlipRatioTHR_kph "" VALUE 0x0000 /* @ECU_Address@KVMC_FrontRearSlipRatioTHR_kph@ */ Scalar_FLOAT32_IEEE 0 SWC_FDC_type_CM_single_kph 0.0 20.0 /end CHARACTERISTIC
/begin CHARACTERISTIC KVMC_LatAccCtrlTHR_Gps "" VALUE 0x0000 /* @ECU_Address@KVMC_LatAccCtrlTHR_Gps@ */ Scalar_FLOAT32_IEEE 0 SWC_FDC_type_CM_single_Gps 0.0 1.0 /end CHARACTERISTIC
/begin CHARACTERISTIC KVMC_PreVehSpdNum_c "" VALUE 0x0000 /* @ECU_Address@KVMC_PreVehSpdNum_c@ */ Scalar_FLOAT32_IEEE 0 SWC_FDC_type_CM_single_kph 1.0 20.0 /end CHARACTERISTIC
/begin CHARACTERISTIC KVMC_PredVehSpdLimit_mps "" VALUE 0x0000 /* @ECU_Address@KVMC_PredVehSpdLimit_mps@ */ Scalar_FLOAT32_IEEE 0 SWC_FDC_type_CM_single_mps 0.0 300.0 /end CHARACTERISTIC
/begin CHARACTERISTIC KVMC_RearWhlSlipRatioTHR_kph "" VALUE 0x0000 /* @ECU_Address@KVMC_RearWhlSlipRatioTHR_kph@ */ Scalar_FLOAT32_IEEE 0 SWC_FDC_type_CM_single_kph 0.0 20.0 /end CHARACTERISTIC
/begin CHARACTERISTIC KVMC_SingleWhlSlipRatioTHR_kph "" VALUE 0x0000 /* @ECU_Address@KVMC_SingleWhlSlipRatioTHR_kph@ */ Scalar_FLOAT32_IEEE 0 SWC_FDC_type_CM_single_kph 0.0 20.0 /end CHARACTERISTIC
/begin CHARACTERISTIC KVMC_SkidRecVehSpdDev_kph "" VALUE 0x0000 /* @ECU_Address@KVMC_SkidRecVehSpdDev_kph@ */ Scalar_FLOAT32_IEEE 0 SWC_FDC_type_CM_single_kph 0.0 300.0 /end CHARACTERISTIC
/begin CHARACTERISTIC KVMC_WheelSkidAccDev_Gps "" VALUE 0x0000 /* @ECU_Address@KVMC_WheelSkidAccDev_Gps@ */ Scalar_FLOAT32_IEEE 0 SWC_FDC_type_CM_single_Gps 0.0 5.0 /end CHARACTERISTIC
/begin CHARACTERISTIC KVMC_WhlSpdCalAccTs_c "" VALUE 0x0000 /* @ECU_Address@KVMC_WhlSpdCalAccTs_c@ */ Scalar_FLOAT32_IEEE 0 SWC_FDC_type_CM_single_c 0.0 1.0 /end CHARACTERISTIC
/begin CHARACTERISTIC KTQD_ACCOVRDSpdAdj_flg "" VALUE 0x0000 /* @ECU_Address@KTQD_ACCOVRDSpdAdj_flg@ */ Scalar_BOOLEAN 0 SWC_FDC_type_CM_boolean_flg 0.0 1.0 /end CHARACTERISTIC
/begin CHARACTERISTIC KTQD_ACCSetSpdSource_flg "" VALUE 0x0000 /* @ECU_Address@KTQD_ACCSetSpdSource_flg@ */ Scalar_BOOLEAN 0 SWC_FDC_type_CM_boolean_flg 0.0 1.0 /end CHARACTERISTIC
/begin CHARACTERISTIC KTQD_AllowSetSpdOvrdVal_flg "" VALUE 0x0000 /* @ECU_Address@KTQD_AllowSetSpdOvrdVal_flg@ */ Scalar_BOOLEAN 0 SWC_FDC_type_CM_boolean_flg 0.0 1.0 /end CHARACTERISTIC
/begin CHARACTERISTIC KTQD_AllowSetSpdOvrd_flg "" VALUE 0x0000 /* @ECU_Address@KTQD_AllowSetSpdOvrd_flg@ */ Scalar_BOOLEAN 0 SWC_FDC_type_CM_boolean_flg 0.0 1.0 /end CHARACTERISTIC
/begin CHARACTERISTIC KTQD_ISATestSW_flg "" VALUE 0x0000 /* @ECU_Address@KTQD_ISATestSW_flg@ */ Scalar_BOOLEAN 0 SWC_FDC_type_CM_boolean_flg 0.0 1.0 /end CHARACTERISTIC
/begin CHARACTERISTIC KTQD_MSASetSpdSource_flg "" VALUE 0x0000 /* @ECU_Address@KTQD_MSASetSpdSource_flg@ */ Scalar_BOOLEAN 0 SWC_FDC_type_CM_boolean_flg 0.0 1.0 /end CHARACTERISTIC
/begin CHARACTERISTIC KTQD_TMPwrAvailDchrg_kW_ovrdflg "" VALUE 0x0000 /* @ECU_Address@KTQD_TMPwrAvailDchrg_kW_ovrdflg@ */ Scalar_BOOLEAN 0 SWC_FDC_type_CM_boolean_flg 0.0 1.0 /end CHARACTERISTIC
/begin CHARACTERISTIC KTQD_WhlTqCapGenFr_Nm_ovrdflg "" VALUE 0x0000 /* @ECU_Address@KTQD_WhlTqCapGenFr_Nm_ovrdflg@ */ Scalar_BOOLEAN 0 SWC_FDC_type_CM_boolean_flg 0.0 1.0 /end CHARACTERISTIC
/begin CHARACTERISTIC KTQD_WhlTqCapGenRr_Nm_ovrdflg "" VALUE 0x0000 /* @ECU_Address@KTQD_WhlTqCapGenRr_Nm_ovrdflg@ */ Scalar_BOOLEAN 0 SWC_FDC_type_CM_boolean_flg 0.0 1.0 /end CHARACTERISTIC
/begin CHARACTERISTIC KTQD_WhlTqCapMotFr_Nm_ovrdflg "" VALUE 0x0000 /* @ECU_Address@KTQD_WhlTqCapMotFr_Nm_ovrdflg@ */ Scalar_BOOLEAN 0 SWC_FDC_type_CM_boolean_flg 0.0 1.0 /end CHARACTERISTIC
/begin CHARACTERISTIC KTQD_WhlTqCapMotRr_Nm_ovrdflg "" VALUE 0x0000 /* @ECU_Address@KTQD_WhlTqCapMotRr_Nm_ovrdflg@ */ Scalar_BOOLEAN 0 SWC_FDC_type_CM_boolean_flg 0.0 1.0 /end CHARACTERISTIC
/begin CHARACTERISTIC KTQR_ACCHoldPdovrdSW_flg "" VALUE 0x0000 /* @ECU_Address@KTQR_ACCHoldPdovrdSW_flg@ */ Scalar_BOOLEAN 0 SWC_FDC_type_CM_boolean_flg 0.0 1.0 /end CHARACTERISTIC
/begin CHARACTERISTIC KTQR_FEDUTrqUpLimSW_flg "" VALUE 0x0000 /* @ECU_Address@KTQR_FEDUTrqUpLimSW_flg@ */ Scalar_BOOLEAN 0 SWC_FDC_type_CM_boolean_flg 0.0 1.0 /end CHARACTERISTIC
/begin CHARACTERISTIC KTQR_REDUTrqUpLimSW_flg "" VALUE 0x0000 /* @ECU_Address@KTQR_REDUTrqUpLimSW_flg@ */ Scalar_BOOLEAN 0 SWC_FDC_type_CM_boolean_flg 0.0 1.0 /end CHARACTERISTIC
/begin CHARACTERISTIC KTQR_RegenTqLimitDecSW_flg "" VALUE 0x0000 /* @ECU_Address@KTQR_RegenTqLimitDecSW_flg@ */ Scalar_BOOLEAN 0 SWC_FDC_type_CM_boolean_flg 0.0 1.0 /end CHARACTERISTIC
/begin CHARACTERISTIC KTQR_RgnShaftSpdProtSW_flg "" VALUE 0x0000 /* @ECU_Address@KTQR_RgnShaftSpdProtSW_flg@ */ Scalar_BOOLEAN 0 SWC_FDC_type_CM_boolean_flg 0.0 1.0 /end CHARACTERISTIC
/begin CHARACTERISTIC KVMC_APSDevelopeSW_flg "" VALUE 0x0000 /* @ECU_Address@KVMC_APSDevelopeSW_flg@ */ Scalar_BOOLEAN 0 SWC_FDC_type_CM_boolean_flg 0.0 1.0 /end CHARACTERISTIC
/begin CHARACTERISTIC KVMC_APSStaSystemOvrd_flg "" VALUE 0x0000 /* @ECU_Address@KVMC_APSStaSystemOvrd_flg@ */ Scalar_BOOLEAN 0 SWC_FDC_type_CM_boolean_flg 0.0 1.0 /end CHARACTERISTIC
/begin CHARACTERISTIC KVMC_LFWhlSkidReset_flg "" VALUE 0x0000 /* @ECU_Address@KVMC_LFWhlSkidReset_flg@ */ Scalar_BOOLEAN 0 SWC_FDC_type_CM_boolean_flg 0.0 1.0 /end CHARACTERISTIC
/begin CHARACTERISTIC KVMC_LRWhlSkidReset_flg "" VALUE 0x0000 /* @ECU_Address@KVMC_LRWhlSkidReset_flg@ */ Scalar_BOOLEAN 0 SWC_FDC_type_CM_boolean_flg 0.0 1.0 /end CHARACTERISTIC
/begin CHARACTERISTIC KVMC_PreVehSpdCalSW_flg "" VALUE 0x0000 /* @ECU_Address@KVMC_PreVehSpdCalSW_flg@ */ Scalar_BOOLEAN 0 SWC_FDC_type_CM_boolean_flg 0.0 1.0 /end CHARACTERISTIC
/begin CHARACTERISTIC KVMC_RFWhlSkidReset_flg "" VALUE 0x0000 /* @ECU_Address@KVMC_RFWhlSkidReset_flg@ */ Scalar_BOOLEAN 0 SWC_FDC_type_CM_boolean_flg 0.0 1.0 /end CHARACTERISTIC
/begin CHARACTERISTIC KVMC_RRWhlSkidReset_flg "" VALUE 0x0000 /* @ECU_Address@KVMC_RRWhlSkidReset_flg@ */ Scalar_BOOLEAN 0 SWC_FDC_type_CM_boolean_flg 0.0 1.0 /end CHARACTERISTIC
/begin CHARACTERISTIC KVMC_SafetyCtrlForACCSW_flg "" VALUE 0x0000 /* @ECU_Address@KVMC_SafetyCtrlForACCSW_flg@ */ Scalar_BOOLEAN 0 SWC_FDC_type_CM_boolean_flg 0.0 1.0 /end CHARACTERISTIC
/begin CHARACTERISTIC KTQD_ACCActiveMetSpdHiMPH_mph "" VALUE 0x0000 /* @ECU_Address@KTQD_ACCActiveMetSpdHiMPH_mph@ */ Scalar_UBYTE 0 SWC_FDC_type_CM_uint8_kph 0.0 250.0 /end CHARACTERISTIC
/begin CHARACTERISTIC KTQD_ACCActiveMetSpdHi_kph "" VALUE 0x0000 /* @ECU_Address@KTQD_ACCActiveMetSpdHi_kph@ */ Scalar_UBYTE 0 SWC_FDC_type_CM_uint8_kph 0.0 250.0 /end CHARACTERISTIC
/begin CHARACTERISTIC KTQD_SetSpdDeltaLongMPH_mph "" VALUE 0x0000 /* @ECU_Address@KTQD_SetSpdDeltaLongMPH_mph@ */ Scalar_UBYTE 0 SWC_FDC_type_CM_uint8_kph 0.0 250.0 /end CHARACTERISTIC
/begin CHARACTERISTIC KTQD_SetSpdDeltaLong_kph "" VALUE 0x0000 /* @ECU_Address@KTQD_SetSpdDeltaLong_kph@ */ Scalar_UBYTE 0 SWC_FDC_type_CM_uint8_kph 0.0 250.0 /end CHARACTERISTIC
/begin CHARACTERISTIC KTQD_SetSpdDeltaShort_kph "" VALUE 0x0000 /* @ECU_Address@KTQD_SetSpdDeltaShort_kph@ */ Scalar_UBYTE 0 SWC_FDC_type_CM_uint8_kph 0.0 250.0 /end CHARACTERISTIC
/begin CHARACTERISTIC KTQR_EnEcoFrIncGain_enum "" VALUE 0x0000 /* @ECU_Address@KTQR_EnEcoFrIncGain_enum@ */ Scalar_UBYTE 0 SWC_FDC_type_CM_uint8_enum 0.0 15.0 /end CHARACTERISTIC
/begin CHARACTERISTIC KTQR_EnNormalFrIncGain_enum "" VALUE 0x0000 /* @ECU_Address@KTQR_EnNormalFrIncGain_enum@ */ Scalar_UBYTE 0 SWC_FDC_type_CM_uint8_enum 0.0 15.0 /end CHARACTERISTIC
/begin CHARACTERISTIC KTQR_EnSportFrIncGain_enum "" VALUE 0x0000 /* @ECU_Address@KTQR_EnSportFrIncGain_enum@ */ Scalar_UBYTE 0 SWC_FDC_type_CM_uint8_enum 0.0 15.0 /end CHARACTERISTIC
/begin CHARACTERISTIC KVMC_PreVehSpdSource_enum "" VALUE 0x0000 /* @ECU_Address@KVMC_PreVehSpdSource_enum@ */ Scalar_UBYTE 0 SWC_FDC_type_CM_uint8_enum 0.0 15.0 /end CHARACTERISTIC
/begin MEASUREMENT VTPM_S1ID_raw32 "" ULONG SWC_FDC_type_CM_uint32_raw32 0 0 0.0 4.294967295E+9 ECU_ADDRESS 0x0000 /* @ECU_Address@VTPM_S1ID_raw32@ */ /end MEASUREMENT
/begin MEASUREMENT VTPM_S2ID_raw32 "" ULONG SWC_FDC_type_CM_uint32_raw32 0 0 0.0 4.294967295E+9 ECU_ADDRESS 0x0000 /* @ECU_Address@VTPM_S2ID_raw32@ */ /end MEASUREMENT
/begin MEASUREMENT VTPM_S3ID_raw32 "" ULONG SWC_FDC_type_CM_uint32_raw32 0 0 0.0 4.294967295E+9 ECU_ADDRESS 0x0000 /* @ECU_Address@VTPM_S3ID_raw32@ */ /end MEASUREMENT
/begin MEASUREMENT VTPM_S4ID_raw32 "" ULONG SWC_FDC_type_CM_uint32_raw32 0 0 0.0 4.294967295E+9 ECU_ADDRESS 0x0000 /* @ECU_Address@VTPM_S4ID_raw32@ */ /end MEASUREMENT
/begin MEASUREMENT VTPM_ManualID1_raw "" ULONG SWC_FDC_type_CM_uint32_raw 0 0 0.0 4.294967295E+9 ECU_ADDRESS 0x0000 /* @ECU_Address@VTPM_ManualID1_raw@ */ /end MEASUREMENT
/begin MEASUREMENT VTPM_ManualID2_raw "" ULONG SWC_FDC_type_CM_uint32_raw 0 0 0.0 4.294967295E+9 ECU_ADDRESS 0x0000 /* @ECU_Address@VTPM_ManualID2_raw@ */ /end MEASUREMENT
/begin MEASUREMENT VTPM_ManualID3_raw "" ULONG SWC_FDC_type_CM_uint32_raw 0 0 0.0 4.294967295E+9 ECU_ADDRESS 0x0000 /* @ECU_Address@VTPM_ManualID3_raw@ */ /end MEASUREMENT
/begin MEASUREMENT VTPM_ManualID4_raw "" ULONG SWC_FDC_type_CM_uint32_raw 0 0 0.0 4.294967295E+9 ECU_ADDRESS 0x0000 /* @ECU_Address@VTPM_ManualID4_raw@ */ /end MEASUREMENT
/begin MEASUREMENT VTPM_FlashS1ID_raw "" ULONG SWC_FDC_type_CM_uint32_raw 0 0 0.0 4.294967295E+9 ECU_ADDRESS 0x0000 /* @ECU_Address@VTPM_FlashS1ID_raw@ */ /end MEASUREMENT
/begin MEASUREMENT VTPM_FlashS2ID_raw "" ULONG SWC_FDC_type_CM_uint32_raw 0 0 0.0 4.294967295E+9 ECU_ADDRESS 0x0000 /* @ECU_Address@VTPM_FlashS2ID_raw@ */ /end MEASUREMENT
/begin MEASUREMENT VTPM_FlashS3ID_raw "" ULONG SWC_FDC_type_CM_uint32_raw 0 0 0.0 4.294967295E+9 ECU_ADDRESS 0x0000 /* @ECU_Address@VTPM_FlashS3ID_raw@ */ /end MEASUREMENT
/begin MEASUREMENT VTPM_FlashS4ID_raw "" ULONG SWC_FDC_type_CM_uint32_raw 0 0 0.0 4.294967295E+9 ECU_ADDRESS 0x0000 /* @ECU_Address@VTPM_FlashS4ID_raw@ */ /end MEASUREMENT
/begin MEASUREMENT VTPM_LFID_raw "" ULONG SWC_FDC_type_CM_uint32_raw 0 0 0.0 4.294967295E+9 ECU_ADDRESS 0x0000 /* @ECU_Address@VTPM_LFID_raw@ */ /end MEASUREMENT
/begin MEASUREMENT VTPM_RFID_raw "" ULONG SWC_FDC_type_CM_uint32_raw 0 0 0.0 4.294967295E+9 ECU_ADDRESS 0x0000 /* @ECU_Address@VTPM_RFID_raw@ */ /end MEASUREMENT
/begin MEASUREMENT VTPM_LRID_raw "" ULONG SWC_FDC_type_CM_uint32_raw 0 0 0.0 4.294967295E+9 ECU_ADDRESS 0x0000 /* @ECU_Address@VTPM_LRID_raw@ */ /end MEASUREMENT
/begin MEASUREMENT VTPM_RRID_raw "" ULONG SWC_FDC_type_CM_uint32_raw 0 0 0.0 4.294967295E+9 ECU_ADDRESS 0x0000 /* @ECU_Address@VTPM_RRID_raw@ */ /end MEASUREMENT
/begin MEASUREMENT VTPM_ManualID1Temp_C "" FLOAT32_IEEE SWC_FDC_type_CM_single_C 0 0 -40.0 215.0 ECU_ADDRESS 0x0000 /* @ECU_Address@VTPM_ManualID1Temp_C@ */ /end MEASUREMENT
/begin MEASUREMENT VTPM_ManualID2Temp_C "" FLOAT32_IEEE SWC_FDC_type_CM_single_C 0 0 -40.0 215.0 ECU_ADDRESS 0x0000 /* @ECU_Address@VTPM_ManualID2Temp_C@ */ /end MEASUREMENT
/begin MEASUREMENT VTPM_ManualID3Temp_C "" FLOAT32_IEEE SWC_FDC_type_CM_single_C 0 0 -40.0 215.0 ECU_ADDRESS 0x0000 /* @ECU_Address@VTPM_ManualID3Temp_C@ */ /end MEASUREMENT
/begin MEASUREMENT VTPM_ManualID4Temp_C "" FLOAT32_IEEE SWC_FDC_type_CM_single_C 0 0 -40.0 215.0 ECU_ADDRESS 0x0000 /* @ECU_Address@VTPM_ManualID4Temp_C@ */ /end MEASUREMENT
/begin MEASUREMENT VVMC_APSDecReq_mps2 "" FLOAT32_IEEE SWC_FDC_type_CM_single_mps2 0 0 0.0 25.4 ECU_ADDRESS 0x0000 /* @ECU_Address@VVMC_APSDecReq_mps2@ */ /end MEASUREMENT
/begin MEASUREMENT VVMC_LFDeltaVehSpd_mps "" FLOAT32_IEEE SWC_FDC_type_CM_single_mps 0 0 0.0 300.0 ECU_ADDRESS 0x0000 /* @ECU_Address@VVMC_LFDeltaVehSpd_mps@ */ /end MEASUREMENT
/begin MEASUREMENT VVMC_LFLastPreVehSpd_mps "" FLOAT32_IEEE SWC_FDC_type_CM_single_mps 0 0 0.0 300.0 ECU_ADDRESS 0x0000 /* @ECU_Address@VVMC_LFLastPreVehSpd_mps@ */ /end MEASUREMENT
/begin MEASUREMENT VVMC_LFCalPreVehSpd_mps "" FLOAT32_IEEE SWC_FDC_type_CM_single_mps 0 0 0.0 300.0 ECU_ADDRESS 0x0000 /* @ECU_Address@VVMC_LFCalPreVehSpd_mps@ */ /end MEASUREMENT
/begin MEASUREMENT VVMC_LFPreVehSpd_kph "" FLOAT32_IEEE SWC_FDC_type_CM_single_kph 0 0 0.0 300.0 ECU_ADDRESS 0x0000 /* @ECU_Address@VVMC_LFPreVehSpd_kph@ */ /end MEASUREMENT
/begin MEASUREMENT VVMC_RFDeltaVehSpd_mps "" FLOAT32_IEEE SWC_FDC_type_CM_single_mps 0 0 0.0 300.0 ECU_ADDRESS 0x0000 /* @ECU_Address@VVMC_RFDeltaVehSpd_mps@ */ /end MEASUREMENT
/begin MEASUREMENT VVMC_RFLastPreVehSpd_mps "" FLOAT32_IEEE SWC_FDC_type_CM_single_mps 0 0 0.0 300.0 ECU_ADDRESS 0x0000 /* @ECU_Address@VVMC_RFLastPreVehSpd_mps@ */ /end MEASUREMENT
/begin MEASUREMENT VVMC_RFCalPreVehSpd_mps "" FLOAT32_IEEE SWC_FDC_type_CM_single_mps 0 0 0.0 300.0 ECU_ADDRESS 0x0000 /* @ECU_Address@VVMC_RFCalPreVehSpd_mps@ */ /end MEASUREMENT
/begin MEASUREMENT VVMC_RFPreVehSpd_kph "" FLOAT32_IEEE SWC_FDC_type_CM_single_kph 0 0 0.0 300.0 ECU_ADDRESS 0x0000 /* @ECU_Address@VVMC_RFPreVehSpd_kph@ */ /end MEASUREMENT
/begin MEASUREMENT VVMC_LRDeltaVehSpd_mps "" FLOAT32_IEEE SWC_FDC_type_CM_single_mps 0 0 0.0 300.0 ECU_ADDRESS 0x0000 /* @ECU_Address@VVMC_LRDeltaVehSpd_mps@ */ /end MEASUREMENT
/begin MEASUREMENT VVMC_LRLastPreVehSpd_mps "" FLOAT32_IEEE SWC_FDC_type_CM_single_mps 0 0 0.0 300.0 ECU_ADDRESS 0x0000 /* @ECU_Address@VVMC_LRLastPreVehSpd_mps@ */ /end MEASUREMENT
/begin MEASUREMENT VVMC_LRCalPreVehSpd_mps "" FLOAT32_IEEE SWC_FDC_type_CM_single_mps 0 0 0.0 300.0 ECU_ADDRESS 0x0000 /* @ECU_Address@VVMC_LRCalPreVehSpd_mps@ */ /end MEASUREMENT
/begin MEASUREMENT VVMC_LRPreVehSpd_kph "" FLOAT32_IEEE SWC_FDC_type_CM_single_kph 0 0 0.0 300.0 ECU_ADDRESS 0x0000 /* @ECU_Address@VVMC_LRPreVehSpd_kph@ */ /end MEASUREMENT
/begin MEASUREMENT VVMC_RRDeltaVehSpd_mps "" FLOAT32_IEEE SWC_FDC_type_CM_single_mps 0 0 0.0 300.0 ECU_ADDRESS 0x0000 /* @ECU_Address@VVMC_RRDeltaVehSpd_mps@ */ /end MEASUREMENT
/begin MEASUREMENT VVMC_RRLastPreVehSpd_mps "" FLOAT32_IEEE SWC_FDC_type_CM_single_mps 0 0 0.0 300.0 ECU_ADDRESS 0x0000 /* @ECU_Address@VVMC_RRLastPreVehSpd_mps@ */ /end MEASUREMENT
/begin MEASUREMENT VVMC_RRCalPreVehSpd_mps "" FLOAT32_IEEE SWC_FDC_type_CM_single_mps 0 0 0.0 300.0 ECU_ADDRESS 0x0000 /* @ECU_Address@VVMC_RRCalPreVehSpd_mps@ */ /end MEASUREMENT
/begin MEASUREMENT VVMC_RRPreVehSpd_kph "" FLOAT32_IEEE SWC_FDC_type_CM_single_kph 0 0 0.0 300.0 ECU_ADDRESS 0x0000 /* @ECU_Address@VVMC_RRPreVehSpd_kph@ */ /end MEASUREMENT
/begin MEASUREMENT VVMC_Max4WhlPreVehSpd_kph "" FLOAT32_IEEE SWC_FDC_type_CM_single_kph 0 0 0.0 300.0 ECU_ADDRESS 0x0000 /* @ECU_Address@VVMC_Max4WhlPreVehSpd_kph@ */ /end MEASUREMENT
/begin MEASUREMENT VVMC_Min4WhlPreVehSpd_kph "" FLOAT32_IEEE SWC_FDC_type_CM_single_kph 0 0 0.0 300.0 ECU_ADDRESS 0x0000 /* @ECU_Address@VVMC_Min4WhlPreVehSpd_kph@ */ /end MEASUREMENT
/begin MEASUREMENT VVMC_PredictVehSpd3_kph "" FLOAT32_IEEE SWC_FDC_type_CM_single_kph 0 0 0.0 300.0 ECU_ADDRESS 0x0000 /* @ECU_Address@VVMC_PredictVehSpd3_kph@ */ /end MEASUREMENT
/begin MEASUREMENT VVMC_PredictVehSpd2_kph "" FLOAT32_IEEE SWC_FDC_type_CM_single_kph 0 0 0.0 300.0 ECU_ADDRESS 0x0000 /* @ECU_Address@VVMC_PredictVehSpd2_kph@ */ /end MEASUREMENT
/begin MEASUREMENT VVMC_DeltaVehSpd_mps "" FLOAT32_IEEE SWC_FDC_type_CM_single_mps 0 0 0.0 300.0 ECU_ADDRESS 0x0000 /* @ECU_Address@VVMC_DeltaVehSpd_mps@ */ /end MEASUREMENT
/begin MEASUREMENT VVMC_LastPredictVehSpd_mps "" FLOAT32_IEEE SWC_FDC_type_CM_single_mps 0 0 0.0 300.0 ECU_ADDRESS 0x0000 /* @ECU_Address@VVMC_LastPredictVehSpd_mps@ */ /end MEASUREMENT
/begin MEASUREMENT VVMC_CalPredictVehSpd_mps "" FLOAT32_IEEE SWC_FDC_type_CM_single_mps 0 0 0.0 300.0 ECU_ADDRESS 0x0000 /* @ECU_Address@VVMC_CalPredictVehSpd_mps@ */ /end MEASUREMENT
/begin MEASUREMENT VVMC_PredictVehSpd1_kph "" FLOAT32_IEEE SWC_FDC_type_CM_single_kph 0 0 0.0 300.0 ECU_ADDRESS 0x0000 /* @ECU_Address@VVMC_PredictVehSpd1_kph@ */ /end MEASUREMENT
/begin MEASUREMENT VVMC_PredictVehSpd_kph "" FLOAT32_IEEE SWC_FDC_type_CM_single_kph 0 0 0.0 300.0 ECU_ADDRESS 0x0000 /* @ECU_Address@VVMC_PredictVehSpd_kph@ */ /end MEASUREMENT
/begin MEASUREMENT VVMC_LFCal4WhlSpdSlideRate_pct "" FLOAT32_IEEE SWC_FDC_type_CM_single_pct 0 0 0.0 125.0 ECU_ADDRESS 0x0000 /* @ECU_Address@VVMC_LFCal4WhlSpdSlideRate_pct@ */ /end MEASUREMENT
/begin MEASUREMENT VVMC_LF4WhlSpdSlideRate_pct "" FLOAT32_IEEE SWC_FDC_type_CM_single_pct 0 0 0.0 125.0 ECU_ADDRESS 0x0000 /* @ECU_Address@VVMC_LF4WhlSpdSlideRate_pct@ */ /end MEASUREMENT
/begin MEASUREMENT VVMC_RFCal4WhlSpdSlideRate_pct "" FLOAT32_IEEE SWC_FDC_type_CM_single_pct 0 0 0.0 125.0 ECU_ADDRESS 0x0000 /* @ECU_Address@VVMC_RFCal4WhlSpdSlideRate_pct@ */ /end MEASUREMENT
/begin MEASUREMENT VVMC_RF4WhlSpdSlideRate_pct "" FLOAT32_IEEE SWC_FDC_type_CM_single_pct 0 0 0.0 125.0 ECU_ADDRESS 0x0000 /* @ECU_Address@VVMC_RF4WhlSpdSlideRate_pct@ */ /end MEASUREMENT
/begin MEASUREMENT VVMC_LRCal4WhlSpdSlideRate_pct "" FLOAT32_IEEE SWC_FDC_type_CM_single_pct 0 0 0.0 125.0 ECU_ADDRESS 0x0000 /* @ECU_Address@VVMC_LRCal4WhlSpdSlideRate_pct@ */ /end MEASUREMENT
/begin MEASUREMENT VVMC_LR4WhlSpdSlideRate_pct "" FLOAT32_IEEE SWC_FDC_type_CM_single_pct 0 0 0.0 125.0 ECU_ADDRESS 0x0000 /* @ECU_Address@VVMC_LR4WhlSpdSlideRate_pct@ */ /end MEASUREMENT
/begin MEASUREMENT VVMC_RRCal4WhlSpdSlideRate_pct "" FLOAT32_IEEE SWC_FDC_type_CM_single_pct 0 0 0.0 125.0 ECU_ADDRESS 0x0000 /* @ECU_Address@VVMC_RRCal4WhlSpdSlideRate_pct@ */ /end MEASUREMENT
/begin MEASUREMENT VVMC_RR4WhlSpdSlideRate_pct "" FLOAT32_IEEE SWC_FDC_type_CM_single_pct 0 0 0.0 125.0 ECU_ADDRESS 0x0000 /* @ECU_Address@VVMC_RR4WhlSpdSlideRate_pct@ */ /end MEASUREMENT
/begin MEASUREMENT VVMC_Min4WhlSpdSlideRate_pct "" FLOAT32_IEEE SWC_FDC_type_CM_single_pct 0 0 0.0 125.0 ECU_ADDRESS 0x0000 /* @ECU_Address@VVMC_Min4WhlSpdSlideRate_pct@ */ /end MEASUREMENT
/begin MEASUREMENT VVMC_Max4WhlSpdSlideRate_pct "" FLOAT32_IEEE SWC_FDC_type_CM_single_pct 0 0 0.0 125.0 ECU_ADDRESS 0x0000 /* @ECU_Address@VVMC_Max4WhlSpdSlideRate_pct@ */ /end MEASUREMENT
/begin MEASUREMENT VVMC_4WhlSpdSlideRate_pct "" FLOAT32_IEEE SWC_FDC_type_CM_single_pct 0 0 0.0 125.0 ECU_ADDRESS 0x0000 /* @ECU_Address@VVMC_4WhlSpdSlideRate_pct@ */ /end MEASUREMENT
/begin MEASUREMENT VVMC_ActRRSlideRate_pct "" FLOAT32_IEEE SWC_FDC_type_CM_single_pct 0 0 0.0 125.0 ECU_ADDRESS 0x0000 /* @ECU_Address@VVMC_ActRRSlideRate_pct@ */ /end MEASUREMENT
/begin MEASUREMENT VVMC_ActLRSlideRate_pct "" FLOAT32_IEEE SWC_FDC_type_CM_single_pct 0 0 0.0 125.0 ECU_ADDRESS 0x0000 /* @ECU_Address@VVMC_ActLRSlideRate_pct@ */ /end MEASUREMENT
/begin MEASUREMENT VVMC_ActRFSlideRate_pct "" FLOAT32_IEEE SWC_FDC_type_CM_single_pct 0 0 0.0 125.0 ECU_ADDRESS 0x0000 /* @ECU_Address@VVMC_ActRFSlideRate_pct@ */ /end MEASUREMENT
/begin MEASUREMENT VVMC_ActLFSlideRate_pct "" FLOAT32_IEEE SWC_FDC_type_CM_single_pct 0 0 0.0 125.0 ECU_ADDRESS 0x0000 /* @ECU_Address@VVMC_ActLFSlideRate_pct@ */ /end MEASUREMENT
/begin MEASUREMENT VVMC_IntMaxSlideRate_pct "" FLOAT32_IEEE SWC_FDC_type_CM_single_pct 0 0 0.0 125.0 ECU_ADDRESS 0x0000 /* @ECU_Address@VVMC_IntMaxSlideRate_pct@ */ /end MEASUREMENT
/begin MEASUREMENT VVMC_VehHoldEnSpd_kph "" FLOAT32_IEEE SWC_FDC_type_CM_single_kph 0 0 0.0 255.0 ECU_ADDRESS 0x0000 /* @ECU_Address@VVMC_VehHoldEnSpd_kph@ */ /end MEASUREMENT
/begin MEASUREMENT VVMC_VehHoldEnActAccel_mps2 "" FLOAT32_IEEE SWC_FDC_type_CM_single_mps2 0 0 -15.0 10.55 ECU_ADDRESS 0x0000 /* @ECU_Address@VVMC_VehHoldEnActAccel_mps2@ */ /end MEASUREMENT
/begin MEASUREMENT VVMC_ACCReqSpdMemory_kph "" FLOAT32_IEEE SWC_FDC_type_CM_single_kph 0 0 0.0 300.0 ECU_ADDRESS 0x0000 /* @ECU_Address@VVMC_ACCReqSpdMemory_kph@ */ /end MEASUREMENT
/begin MEASUREMENT VVMC_MSAOvrdEnTq_Nm "" FLOAT32_IEEE SWC_FDC_type_CM_single_Nm 0 0 -100000.0 100000.0 ECU_ADDRESS 0x0000 /* @ECU_Address@VVMC_MSAOvrdEnTq_Nm@ */ /end MEASUREMENT
/begin MEASUREMENT VVMC_MSATqDownEnTq_Nm "" FLOAT32_IEEE SWC_FDC_type_CM_single_Nm 0 0 -10000.0 10000.0 ECU_ADDRESS 0x0000 /* @ECU_Address@VVMC_MSATqDownEnTq_Nm@ */ /end MEASUREMENT
/begin MEASUREMENT VVMC_CalibratedAccX_G "" FLOAT32_IEEE SWC_FDC_type_CM_single_G 0 0 -65.536 65.536 ECU_ADDRESS 0x0000 /* @ECU_Address@VVMC_CalibratedAccX_G@ */ /end MEASUREMENT
/begin MEASUREMENT VVMC_CalibratedGyroY_Dps "" FLOAT32_IEEE SWC_FDC_type_CM_single_Dps 0 0 -1966.0 1966.0 ECU_ADDRESS 0x0000 /* @ECU_Address@VVMC_CalibratedGyroY_Dps@ */ /end MEASUREMENT
/begin MEASUREMENT VVMC_CalibratedAccY_G "" FLOAT32_IEEE SWC_FDC_type_CM_single_G 0 0 -65.536 65.536 ECU_ADDRESS 0x0000 /* @ECU_Address@VVMC_CalibratedAccY_G@ */ /end MEASUREMENT
/begin MEASUREMENT VVMC_CalibratedAccZ_G "" FLOAT32_IEEE SWC_FDC_type_CM_single_G 0 0 -65.536 65.536 ECU_ADDRESS 0x0000 /* @ECU_Address@VVMC_CalibratedAccZ_G@ */ /end MEASUREMENT
/begin MEASUREMENT VVMC_CalibratedGyroZ_Dps "" FLOAT32_IEEE SWC_FDC_type_CM_single_Dps 0 0 -1966.0 1966.0 ECU_ADDRESS 0x0000 /* @ECU_Address@VVMC_CalibratedGyroZ_Dps@ */ /end MEASUREMENT
/begin MEASUREMENT VVMC_CalibratedGyroX_Dps "" FLOAT32_IEEE SWC_FDC_type_CM_single_Dps 0 0 -1966.0 1966.0 ECU_ADDRESS 0x0000 /* @ECU_Address@VVMC_CalibratedGyroX_Dps@ */ /end MEASUREMENT
/begin MEASUREMENT VVMC_ZeroRgnTqSpdCtrlTq_Nm "" FLOAT32_IEEE SWC_FDC_type_CM_single_Nm 0 0 -10000.0 10000.0 ECU_ADDRESS 0x0000 /* @ECU_Address@VVMC_ZeroRgnTqSpdCtrlTq_Nm@ */ /end MEASUREMENT
/begin MEASUREMENT VVMC_ACCLowSpdTqLimit_Nm "" FLOAT32_IEEE SWC_FDC_type_CM_single_Nm 0 0 -100000.0 100000.0 ECU_ADDRESS 0x0000 /* @ECU_Address@VVMC_ACCLowSpdTqLimit_Nm@ */ /end MEASUREMENT
/begin MEASUREMENT VVMC_ACCLowSpdCtrlEnSpd_kph "" FLOAT32_IEEE SWC_FDC_type_CM_single_kph 0 0 0.0 255.0 ECU_ADDRESS 0x0000 /* @ECU_Address@VVMC_ACCLowSpdCtrlEnSpd_kph@ */ /end MEASUREMENT
/begin MEASUREMENT VVMC_ACCOvrdMemTq_Nm "" FLOAT32_IEEE SWC_FDC_type_CM_single_Nm 0 0 0.0 10000.0 ECU_ADDRESS 0x0000 /* @ECU_Address@VVMC_ACCOvrdMemTq_Nm@ */ /end MEASUREMENT
/begin MEASUREMENT VVMC_ESCLongAccelFilt_Gps "" FLOAT32_IEEE SWC_FDC_type_CM_single_Gps 0 0 -2.0 2.0 ECU_ADDRESS 0x0000 /* @ECU_Address@VVMC_ESCLongAccelFilt_Gps@ */ /end MEASUREMENT
/begin MEASUREMENT VTQR_CalFEDUTrqUpLim_Nm "" FLOAT32_IEEE SWC_FDC_type_CM_single_Nm 0 0 -100000.0 100000.0 ECU_ADDRESS 0x0000 /* @ECU_Address@VTQR_CalFEDUTrqUpLim_Nm@ */ /end MEASUREMENT
/begin MEASUREMENT VTQR_CoorFEDUTrqUpLim_Nm "" FLOAT32_IEEE SWC_FDC_type_CM_single_Nm 0 0 -100000.0 100000.0 ECU_ADDRESS 0x0000 /* @ECU_Address@VTQR_CoorFEDUTrqUpLim_Nm@ */ /end MEASUREMENT
/begin MEASUREMENT VTQR_LFWheelShaftSpd_rpm "" FLOAT32_IEEE SWC_FDC_type_CM_single_rpm 0 0 0.0 100000.0 ECU_ADDRESS 0x0000 /* @ECU_Address@VTQR_LFWheelShaftSpd_rpm@ */ /end MEASUREMENT
/begin MEASUREMENT VTQR_RFWheelShaftSpd_rpm "" FLOAT32_IEEE SWC_FDC_type_CM_single_rpm 0 0 0.0 100000.0 ECU_ADDRESS 0x0000 /* @ECU_Address@VTQR_RFWheelShaftSpd_rpm@ */ /end MEASUREMENT
/begin MEASUREMENT VTQR_FWheelShaftSpdDev_rpm "" FLOAT32_IEEE SWC_FDC_type_CM_single_rpm 0 0 -100000.0 100000.0 ECU_ADDRESS 0x0000 /* @ECU_Address@VTQR_FWheelShaftSpdDev_rpm@ */ /end MEASUREMENT
/begin MEASUREMENT VTQR_ActFShaftSpdDev_rpm "" FLOAT32_IEEE SWC_FDC_type_CM_single_rpm 0 0 0.0 100000.0 ECU_ADDRESS 0x0000 /* @ECU_Address@VTQR_ActFShaftSpdDev_rpm@ */ /end MEASUREMENT
/begin MEASUREMENT VTQR_InitFShaftSpdTqLimCoe_c "" FLOAT32_IEEE SWC_FDC_type_CM_single_c 0 0 -0.1 1.0 ECU_ADDRESS 0x0000 /* @ECU_Address@VTQR_InitFShaftSpdTqLimCoe_c@ */ /end MEASUREMENT
/begin MEASUREMENT VTQR_FShaftSpdTqLimCoe_c "" FLOAT32_IEEE SWC_FDC_type_CM_single_c 0 0 0.0 1.0 ECU_ADDRESS 0x0000 /* @ECU_Address@VTQR_FShaftSpdTqLimCoe_c@ */ /end MEASUREMENT
/begin MEASUREMENT VTQR_FShaftSpdDevTime_s "" FLOAT32_IEEE SWC_FDC_type_CM_single_s 0 0 0.0 3600.0 ECU_ADDRESS 0x0000 /* @ECU_Address@VTQR_FShaftSpdDevTime_s@ */ /end MEASUREMENT
/begin MEASUREMENT VTQR_InitFTimerTqLimCoe_c "" FLOAT32_IEEE SWC_FDC_type_CM_single_c 0 0 -0.1 1.0 ECU_ADDRESS 0x0000 /* @ECU_Address@VTQR_InitFTimerTqLimCoe_c@ */ /end MEASUREMENT
/begin MEASUREMENT VTQR_FTimerTqLimCoe_c "" FLOAT32_IEEE SWC_FDC_type_CM_single_c 0 0 0.0 1.0 ECU_ADDRESS 0x0000 /* @ECU_Address@VTQR_FTimerTqLimCoe_c@ */ /end MEASUREMENT
/begin MEASUREMENT VTQR_ActFEDUTrqUpLim_Nm "" FLOAT32_IEEE SWC_FDC_type_CM_single_Nm 0 0 -100000.0 100000.0 ECU_ADDRESS 0x0000 /* @ECU_Address@VTQR_ActFEDUTrqUpLim_Nm@ */ /end MEASUREMENT
/begin MEASUREMENT VTQR_ActFEDUTrqLowLim_Nm "" FLOAT32_IEEE SWC_FDC_type_CM_single_Nm 0 0 -100000.0 100000.0 ECU_ADDRESS 0x0000 /* @ECU_Address@VTQR_ActFEDUTrqLowLim_Nm@ */ /end MEASUREMENT
/begin MEASUREMENT VTQR_RampFEDUWhlTqReq_Nm "" FLOAT32_IEEE SWC_FDC_type_CM_single_Nm 0 0 -100000.0 100000.0 ECU_ADDRESS 0x0000 /* @ECU_Address@VTQR_RampFEDUWhlTqReq_Nm@ */ /end MEASUREMENT
/begin MEASUREMENT VTQR_CalREDUTrqUpLim_Nm "" FLOAT32_IEEE SWC_FDC_type_CM_single_Nm 0 0 -100000.0 100000.0 ECU_ADDRESS 0x0000 /* @ECU_Address@VTQR_CalREDUTrqUpLim_Nm@ */ /end MEASUREMENT
/begin MEASUREMENT VTQR_CoorREDUTrqUpLim_Nm "" FLOAT32_IEEE SWC_FDC_type_CM_single_Nm 0 0 -100000.0 100000.0 ECU_ADDRESS 0x0000 /* @ECU_Address@VTQR_CoorREDUTrqUpLim_Nm@ */ /end MEASUREMENT
/begin MEASUREMENT VTQR_LRWheelShaftSpd_rpm "" FLOAT32_IEEE SWC_FDC_type_CM_single_rpm 0 0 0.0 100000.0 ECU_ADDRESS 0x0000 /* @ECU_Address@VTQR_LRWheelShaftSpd_rpm@ */ /end MEASUREMENT
/begin MEASUREMENT VTQR_RRWheelShaftSpd_rpm "" FLOAT32_IEEE SWC_FDC_type_CM_single_rpm 0 0 0.0 100000.0 ECU_ADDRESS 0x0000 /* @ECU_Address@VTQR_RRWheelShaftSpd_rpm@ */ /end MEASUREMENT
/begin MEASUREMENT VTQR_RWheelShaftSpdDev_rpm "" FLOAT32_IEEE SWC_FDC_type_CM_single_rpm 0 0 -100000.0 100000.0 ECU_ADDRESS 0x0000 /* @ECU_Address@VTQR_RWheelShaftSpdDev_rpm@ */ /end MEASUREMENT
/begin MEASUREMENT VTQR_ActRShaftSpdDev_rpm "" FLOAT32_IEEE SWC_FDC_type_CM_single_rpm 0 0 0.0 100000.0 ECU_ADDRESS 0x0000 /* @ECU_Address@VTQR_ActRShaftSpdDev_rpm@ */ /end MEASUREMENT
/begin MEASUREMENT VTQR_InitRShaftSpdTqLimCoe_c "" FLOAT32_IEEE SWC_FDC_type_CM_single_c 0 0 -0.1 1.0 ECU_ADDRESS 0x0000 /* @ECU_Address@VTQR_InitRShaftSpdTqLimCoe_c@ */ /end MEASUREMENT
/begin MEASUREMENT VTQR_RShaftSpdTqLimCoe_c "" FLOAT32_IEEE SWC_FDC_type_CM_single_c 0 0 0.0 1.0 ECU_ADDRESS 0x0000 /* @ECU_Address@VTQR_RShaftSpdTqLimCoe_c@ */ /end MEASUREMENT
/begin MEASUREMENT VTQR_RShaftSpdDevTime_s "" FLOAT32_IEEE SWC_FDC_type_CM_single_s 0 0 0.0 3600.0 ECU_ADDRESS 0x0000 /* @ECU_Address@VTQR_RShaftSpdDevTime_s@ */ /end MEASUREMENT
/begin MEASUREMENT VTQR_InitRTimerTqLimCoe_c "" FLOAT32_IEEE SWC_FDC_type_CM_single_c 0 0 -0.1 1.0 ECU_ADDRESS 0x0000 /* @ECU_Address@VTQR_InitRTimerTqLimCoe_c@ */ /end MEASUREMENT
/begin MEASUREMENT VTQR_RTimerTqLimCoe_c "" FLOAT32_IEEE SWC_FDC_type_CM_single_c 0 0 0.0 1.0 ECU_ADDRESS 0x0000 /* @ECU_Address@VTQR_RTimerTqLimCoe_c@ */ /end MEASUREMENT
/begin MEASUREMENT VTQR_ActREDUTrqUpLim_Nm "" FLOAT32_IEEE SWC_FDC_type_CM_single_Nm 0 0 -100000.0 100000.0 ECU_ADDRESS 0x0000 /* @ECU_Address@VTQR_ActREDUTrqUpLim_Nm@ */ /end MEASUREMENT
/begin MEASUREMENT VTQR_ActREDUTrqLowLim_Nm "" FLOAT32_IEEE SWC_FDC_type_CM_single_Nm 0 0 -100000.0 100000.0 ECU_ADDRESS 0x0000 /* @ECU_Address@VTQR_ActREDUTrqLowLim_Nm@ */ /end MEASUREMENT
/begin MEASUREMENT VTQR_RampREDUWhlTqReq_Nm "" FLOAT32_IEEE SWC_FDC_type_CM_single_Nm 0 0 -100000.0 100000.0 ECU_ADDRESS 0x0000 /* @ECU_Address@VTQR_RampREDUWhlTqReq_Nm@ */ /end MEASUREMENT
/begin MEASUREMENT VTQR_FrActRampTqDem_Nm "" FLOAT32_IEEE SWC_FDC_type_CM_single_Nm 0 0 -100000.0 100000.0 ECU_ADDRESS 0x0000 /* @ECU_Address@VTQR_FrActRampTqDem_Nm@ */ /end MEASUREMENT
/begin MEASUREMENT VTQR_FrFirstOrderInpTq_Nm "" FLOAT32_IEEE SWC_FDC_type_CM_single_Nm 0 0 -100000.0 100000.0 ECU_ADDRESS 0x0000 /* @ECU_Address@VTQR_FrFirstOrderInpTq_Nm@ */ /end MEASUREMENT
/begin MEASUREMENT VTQR_RDCActiveREDUTs_c "" FLOAT32_IEEE SWC_FDC_type_CM_single_c 0 0 0.0 1.0 ECU_ADDRESS 0x0000 /* @ECU_Address@VTQR_RDCActiveREDUTs_c@ */ /end MEASUREMENT
/begin MEASUREMENT VTQR_CreepREDUTs_c "" FLOAT32_IEEE SWC_FDC_type_CM_single_c 0 0 0.0 1.0 ECU_ADDRESS 0x0000 /* @ECU_Address@VTQR_CreepREDUTs_c@ */ /end MEASUREMENT
/begin MEASUREMENT VTQR_VMCREDUTs_c "" FLOAT32_IEEE SWC_FDC_type_CM_single_c 0 0 0.0 1.0 ECU_ADDRESS 0x0000 /* @ECU_Address@VTQR_VMCREDUTs_c@ */ /end MEASUREMENT
/begin MEASUREMENT VTQR_REDUTIPOutTs_c "" FLOAT32_IEEE SWC_FDC_type_CM_single_c 0 0 0.0 1.0 ECU_ADDRESS 0x0000 /* @ECU_Address@VTQR_REDUTIPOutTs_c@ */ /end MEASUREMENT
/begin MEASUREMENT VTQR_RrActRampTqDem_Nm "" FLOAT32_IEEE SWC_FDC_type_CM_single_Nm 0 0 -100000.0 100000.0 ECU_ADDRESS 0x0000 /* @ECU_Address@VTQR_RrActRampTqDem_Nm@ */ /end MEASUREMENT
/begin MEASUREMENT VTQR_RrTqZeroTransUpBound_Nm "" FLOAT32_IEEE SWC_FDC_type_CM_single_Nm 0 0 -100000.0 100000.0 ECU_ADDRESS 0x0000 /* @ECU_Address@VTQR_RrTqZeroTransUpBound_Nm@ */ /end MEASUREMENT
/begin MEASUREMENT VTQR_RrTqZeroTransLowBound_Nm "" FLOAT32_IEEE SWC_FDC_type_CM_single_Nm 0 0 -100000.0 100000.0 ECU_ADDRESS 0x0000 /* @ECU_Address@VTQR_RrTqZeroTransLowBound_Nm@ */ /end MEASUREMENT
/begin MEASUREMENT VTQR_RrFirstOrderInpTq_Nm "" FLOAT32_IEEE SWC_FDC_type_CM_single_Nm 0 0 -100000.0 100000.0 ECU_ADDRESS 0x0000 /* @ECU_Address@VTQR_RrFirstOrderInpTq_Nm@ */ /end MEASUREMENT
/begin MEASUREMENT VTQR_REDUTs_c "" FLOAT32_IEEE SWC_FDC_type_CM_single_c 0 0 0.0 1.0 ECU_ADDRESS 0x0000 /* @ECU_Address@VTQR_REDUTs_c@ */ /end MEASUREMENT
/begin MEASUREMENT VTQR_RrFirstOrderInpTs_c "" FLOAT32_IEEE SWC_FDC_type_CM_single_c 0 0 0.0 1.0 ECU_ADDRESS 0x0000 /* @ECU_Address@VTQR_RrFirstOrderInpTs_c@ */ /end MEASUREMENT
/begin MEASUREMENT VTQR_RDCActiveFEDUInc_Nm "" FLOAT32_IEEE SWC_FDC_type_CM_single_Nm 0 0 0.0 100000.0 ECU_ADDRESS 0x0000 /* @ECU_Address@VTQR_RDCActiveFEDUInc_Nm@ */ /end MEASUREMENT
/begin MEASUREMENT VTQR_CreepFEDUTqIncSR_Nm "" FLOAT32_IEEE SWC_FDC_type_CM_single_Nm 0 0 -100000.0 100000.0 ECU_ADDRESS 0x0000 /* @ECU_Address@VTQR_CreepFEDUTqIncSR_Nm@ */ /end MEASUREMENT
/begin MEASUREMENT VTQR_CreepFEDUTqDecSR_Nm "" FLOAT32_IEEE SWC_FDC_type_CM_single_Nm 0 0 -100000.0 100000.0 ECU_ADDRESS 0x0000 /* @ECU_Address@VTQR_CreepFEDUTqDecSR_Nm@ */ /end MEASUREMENT
/begin MEASUREMENT VTQR_FrPreLoadTqIncSR_Nm "" FLOAT32_IEEE SWC_FDC_type_CM_single_Nm 0 0 0.0 100000.0 ECU_ADDRESS 0x0000 /* @ECU_Address@VTQR_FrPreLoadTqIncSR_Nm@ */ /end MEASUREMENT
/begin MEASUREMENT VTQR_FrPreLoadTqDecSR_Nm "" FLOAT32_IEEE SWC_FDC_type_CM_single_Nm 0 0 -100000.0 0.0 ECU_ADDRESS 0x0000 /* @ECU_Address@VTQR_FrPreLoadTqDecSR_Nm@ */ /end MEASUREMENT
/begin MEASUREMENT VTQR_VMCFEDUTqIncSR_Nm "" FLOAT32_IEEE SWC_FDC_type_CM_single_Nm 0 0 -100000.0 100000.0 ECU_ADDRESS 0x0000 /* @ECU_Address@VTQR_VMCFEDUTqIncSR_Nm@ */ /end MEASUREMENT
/begin MEASUREMENT VTQR_VMCFEDUTqDecSR_Nm "" FLOAT32_IEEE SWC_FDC_type_CM_single_Nm 0 0 -100000.0 100000.0 ECU_ADDRESS 0x0000 /* @ECU_Address@VTQR_VMCFEDUTqDecSR_Nm@ */ /end MEASUREMENT
/begin MEASUREMENT VTQR_FEDURateLimitInc_Nm "" FLOAT32_IEEE SWC_FDC_type_CM_single_Nm 0 0 -100000.0 100000.0 ECU_ADDRESS 0x0000 /* @ECU_Address@VTQR_FEDURateLimitInc_Nm@ */ /end MEASUREMENT
/begin MEASUREMENT VTQR_FEDURateLimitDec_Nm "" FLOAT32_IEEE SWC_FDC_type_CM_single_Nm 0 0 -100000.0 100000.0 ECU_ADDRESS 0x0000 /* @ECU_Address@VTQR_FEDURateLimitDec_Nm@ */ /end MEASUREMENT
/begin MEASUREMENT VTQR_FrRateLimitInc_Nm "" FLOAT32_IEEE SWC_FDC_type_CM_single_Nm 0 0 -100000.0 100000.0 ECU_ADDRESS 0x0000 /* @ECU_Address@VTQR_FrRateLimitInc_Nm@ */ /end MEASUREMENT
/begin MEASUREMENT VTQR_FrRateLimitDec_Nm "" FLOAT32_IEEE SWC_FDC_type_CM_single_Nm 0 0 -100000.0 100000.0 ECU_ADDRESS 0x0000 /* @ECU_Address@VTQR_FrRateLimitDec_Nm@ */ /end MEASUREMENT
/begin MEASUREMENT VTQR_RDCActiveREDUInc_Nm "" FLOAT32_IEEE SWC_FDC_type_CM_single_Nm 0 0 0.0 100000.0 ECU_ADDRESS 0x0000 /* @ECU_Address@VTQR_RDCActiveREDUInc_Nm@ */ /end MEASUREMENT
/begin MEASUREMENT VTQR_CreepREDUTqIncSR_Nm "" FLOAT32_IEEE SWC_FDC_type_CM_single_Nm 0 0 -100000.0 100000.0 ECU_ADDRESS 0x0000 /* @ECU_Address@VTQR_CreepREDUTqIncSR_Nm@ */ /end MEASUREMENT
/begin MEASUREMENT VTQR_CreepREDUTqDecSR_Nm "" FLOAT32_IEEE SWC_FDC_type_CM_single_Nm 0 0 -100000.0 100000.0 ECU_ADDRESS 0x0000 /* @ECU_Address@VTQR_CreepREDUTqDecSR_Nm@ */ /end MEASUREMENT
/begin MEASUREMENT VTQR_RrPreLoadTqIncSR_Nm "" FLOAT32_IEEE SWC_FDC_type_CM_single_Nm 0 0 0.0 100000.0 ECU_ADDRESS 0x0000 /* @ECU_Address@VTQR_RrPreLoadTqIncSR_Nm@ */ /end MEASUREMENT
/begin MEASUREMENT VTQR_RrPreLoadTqDecSR_Nm "" FLOAT32_IEEE SWC_FDC_type_CM_single_Nm 0 0 -100000.0 0.0 ECU_ADDRESS 0x0000 /* @ECU_Address@VTQR_RrPreLoadTqDecSR_Nm@ */ /end MEASUREMENT
/begin MEASUREMENT VTQR_VMCREDUTqIncSR_Nm "" FLOAT32_IEEE SWC_FDC_type_CM_single_Nm 0 0 -100000.0 100000.0 ECU_ADDRESS 0x0000 /* @ECU_Address@VTQR_VMCREDUTqIncSR_Nm@ */ /end MEASUREMENT
/begin MEASUREMENT VTQR_VMCREDUTqDecSR_Nm "" FLOAT32_IEEE SWC_FDC_type_CM_single_Nm 0 0 -100000.0 100000.0 ECU_ADDRESS 0x0000 /* @ECU_Address@VTQR_VMCREDUTqDecSR_Nm@ */ /end MEASUREMENT
/begin MEASUREMENT VTQR_OriREDURateLimitInc_Nm "" FLOAT32_IEEE SWC_FDC_type_CM_single_Nm 0 0 -100000.0 100000.0 ECU_ADDRESS 0x0000 /* @ECU_Address@VTQR_OriREDURateLimitInc_Nm@ */ /end MEASUREMENT
/begin MEASUREMENT VTQR_REDURateLimitInc_Nm "" FLOAT32_IEEE SWC_FDC_type_CM_single_Nm 0 0 -100000.0 100000.0 ECU_ADDRESS 0x0000 /* @ECU_Address@VTQR_REDURateLimitInc_Nm@ */ /end MEASUREMENT
/begin MEASUREMENT VTQR_REDURateLimitDec_Nm "" FLOAT32_IEEE SWC_FDC_type_CM_single_Nm 0 0 -100000.0 100000.0 ECU_ADDRESS 0x0000 /* @ECU_Address@VTQR_REDURateLimitDec_Nm@ */ /end MEASUREMENT
/begin MEASUREMENT VTQR_RrRateLimitInc_Nm "" FLOAT32_IEEE SWC_FDC_type_CM_single_Nm 0 0 -100000.0 100000.0 ECU_ADDRESS 0x0000 /* @ECU_Address@VTQR_RrRateLimitInc_Nm@ */ /end MEASUREMENT
/begin MEASUREMENT VTQR_RrRateLimitDec_Nm "" FLOAT32_IEEE SWC_FDC_type_CM_single_Nm 0 0 -100000.0 100000.0 ECU_ADDRESS 0x0000 /* @ECU_Address@VTQR_RrRateLimitDec_Nm@ */ /end MEASUREMENT
/begin MEASUREMENT VTQR_FEDUWhlTqReqSmooth_Nm "" FLOAT32_IEEE SWC_FDC_type_CM_single_Nm 0 0 -100000.0 100000.0 ECU_ADDRESS 0x0000 /* @ECU_Address@VTQR_FEDUWhlTqReqSmooth_Nm@ */ /end MEASUREMENT
/begin MEASUREMENT VTQR_REDUWhlTqReqSmooth_Nm "" FLOAT32_IEEE SWC_FDC_type_CM_single_Nm 0 0 -100000.0 100000.0 ECU_ADDRESS 0x0000 /* @ECU_Address@VTQR_REDUWhlTqReqSmooth_Nm@ */ /end MEASUREMENT
/begin MEASUREMENT VTQR_SportTqFrIncGain_c "" FLOAT32_IEEE SWC_FDC_type_CM_single_c 0 0 0.0 300.0 ECU_ADDRESS 0x0000 /* @ECU_Address@VTQR_SportTqFrIncGain_c@ */ /end MEASUREMENT
/begin MEASUREMENT VTQR_SportOPDTqFrIncGain_c "" FLOAT32_IEEE SWC_FDC_type_CM_single_c 0 0 0.0 1.0 ECU_ADDRESS 0x0000 /* @ECU_Address@VTQR_SportOPDTqFrIncGain_c@ */ /end MEASUREMENT
/begin MEASUREMENT VTQR_Sport5TqFrIncGain_c "" FLOAT32_IEEE SWC_FDC_type_CM_single_c 0 0 0.0 1.0 ECU_ADDRESS 0x0000 /* @ECU_Address@VTQR_Sport5TqFrIncGain_c@ */ /end MEASUREMENT
/begin MEASUREMENT VTQR_Sport4TqFrIncGain_c "" FLOAT32_IEEE SWC_FDC_type_CM_single_c 0 0 0.0 1.0 ECU_ADDRESS 0x0000 /* @ECU_Address@VTQR_Sport4TqFrIncGain_c@ */ /end MEASUREMENT
/begin MEASUREMENT VTQR_Sport3TqFrIncGain_c "" FLOAT32_IEEE SWC_FDC_type_CM_single_c 0 0 0.0 1.0 ECU_ADDRESS 0x0000 /* @ECU_Address@VTQR_Sport3TqFrIncGain_c@ */ /end MEASUREMENT
/begin MEASUREMENT VTQR_Sport2TqFrIncGain_c "" FLOAT32_IEEE SWC_FDC_type_CM_single_c 0 0 0.0 1.0 ECU_ADDRESS 0x0000 /* @ECU_Address@VTQR_Sport2TqFrIncGain_c@ */ /end MEASUREMENT
/begin MEASUREMENT VTQR_EcoTqFrIncGain_c "" FLOAT32_IEEE SWC_FDC_type_CM_single_c 0 0 0.0 300.0 ECU_ADDRESS 0x0000 /* @ECU_Address@VTQR_EcoTqFrIncGain_c@ */ /end MEASUREMENT
/begin MEASUREMENT VTQR_ECOOPDTqFrIncGain_c "" FLOAT32_IEEE SWC_FDC_type_CM_single_c 0 0 0.0 1.0 ECU_ADDRESS 0x0000 /* @ECU_Address@VTQR_ECOOPDTqFrIncGain_c@ */ /end MEASUREMENT
/begin MEASUREMENT VTQR_ECO5TqFrIncGain_c "" FLOAT32_IEEE SWC_FDC_type_CM_single_c 0 0 0.0 1.0 ECU_ADDRESS 0x0000 /* @ECU_Address@VTQR_ECO5TqFrIncGain_c@ */ /end MEASUREMENT
/begin MEASUREMENT VTQR_ECO4TqFrIncGain_c "" FLOAT32_IEEE SWC_FDC_type_CM_single_c 0 0 0.0 1.0 ECU_ADDRESS 0x0000 /* @ECU_Address@VTQR_ECO4TqFrIncGain_c@ */ /end MEASUREMENT
/begin MEASUREMENT VTQR_ECO3TqFrIncGain_c "" FLOAT32_IEEE SWC_FDC_type_CM_single_c 0 0 0.0 1.0 ECU_ADDRESS 0x0000 /* @ECU_Address@VTQR_ECO3TqFrIncGain_c@ */ /end MEASUREMENT
/begin MEASUREMENT VTQR_ECO2TqFrIncGain_c "" FLOAT32_IEEE SWC_FDC_type_CM_single_c 0 0 0.0 1.0 ECU_ADDRESS 0x0000 /* @ECU_Address@VTQR_ECO2TqFrIncGain_c@ */ /end MEASUREMENT
/begin MEASUREMENT VTQR_NormalTqFrIncGain_c "" FLOAT32_IEEE SWC_FDC_type_CM_single_c 0 0 0.0 300.0 ECU_ADDRESS 0x0000 /* @ECU_Address@VTQR_NormalTqFrIncGain_c@ */ /end MEASUREMENT
/begin MEASUREMENT VTQR_NLOPDTqFrIncGain_c "" FLOAT32_IEEE SWC_FDC_type_CM_single_c 0 0 0.0 1.0 ECU_ADDRESS 0x0000 /* @ECU_Address@VTQR_NLOPDTqFrIncGain_c@ */ /end MEASUREMENT
/begin MEASUREMENT VTQR_NL5TqFrIncGain_c "" FLOAT32_IEEE SWC_FDC_type_CM_single_c 0 0 0.0 1.0 ECU_ADDRESS 0x0000 /* @ECU_Address@VTQR_NL5TqFrIncGain_c@ */ /end MEASUREMENT
/begin MEASUREMENT VTQR_NL4TqFrIncGain_c "" FLOAT32_IEEE SWC_FDC_type_CM_single_c 0 0 0.0 1.0 ECU_ADDRESS 0x0000 /* @ECU_Address@VTQR_NL4TqFrIncGain_c@ */ /end MEASUREMENT
/begin MEASUREMENT VTQR_NL3TqFrIncGain_c "" FLOAT32_IEEE SWC_FDC_type_CM_single_c 0 0 0.0 1.0 ECU_ADDRESS 0x0000 /* @ECU_Address@VTQR_NL3TqFrIncGain_c@ */ /end MEASUREMENT
/begin MEASUREMENT VTQR_NL2TqFrIncGain_c "" FLOAT32_IEEE SWC_FDC_type_CM_single_c 0 0 0.0 1.0 ECU_ADDRESS 0x0000 /* @ECU_Address@VTQR_NL2TqFrIncGain_c@ */ /end MEASUREMENT
/begin MEASUREMENT VTQD_APSReqTimer_s "" FLOAT32_IEEE SWC_FDC_type_CM_single_s 0 0 0.0 100000.0 ECU_ADDRESS 0x0000 /* @ECU_Address@VTQD_APSReqTimer_s@ */ /end MEASUREMENT
/begin MEASUREMENT VTQD_PreLoadHoldtime_s "" FLOAT32_IEEE SWC_FDC_type_CM_single_s 0 0 0.0 3600.0 ECU_ADDRESS 0x0000 /* @ECU_Address@VTQD_PreLoadHoldtime_s@ */ /end MEASUREMENT
/begin MEASUREMENT VTQD_CreepPreloadTime_s "" FLOAT32_IEEE SWC_FDC_type_CM_single_s 0 0 0.0 300.0 ECU_ADDRESS 0x0000 /* @ECU_Address@VTQD_CreepPreloadTime_s@ */ /end MEASUREMENT
/begin MEASUREMENT VTQD_EstFrRealTqSum_Nm "" FLOAT32_IEEE SWC_FDC_type_CM_single_Nm 0 0 -1.0E+6 1.0E+6 ECU_ADDRESS 0x0000 /* @ECU_Address@VTQD_EstFrRealTqSum_Nm@ */ /end MEASUREMENT
/begin MEASUREMENT VTQD_EstFrRealTqAvg_Nm "" FLOAT32_IEEE SWC_FDC_type_CM_single_Nm 0 0 -100000.0 100000.0 ECU_ADDRESS 0x0000 /* @ECU_Address@VTQD_EstFrRealTqAvg_Nm@ */ /end MEASUREMENT
/begin MEASUREMENT VTQD_EstFrWhlTqAvg_Nm "" FLOAT32_IEEE SWC_FDC_type_CM_single_Nm 0 0 -100000.0 100000.0 ECU_ADDRESS 0x0000 /* @ECU_Address@VTQD_EstFrWhlTqAvg_Nm@ */ /end MEASUREMENT
/begin MEASUREMENT VTQD_EstFrForce_N "" FLOAT32_IEEE SWC_FDC_type_CM_single_N 0 0 -100000.0 100000.0 ECU_ADDRESS 0x0000 /* @ECU_Address@VTQD_EstFrForce_N@ */ /end MEASUREMENT
/begin MEASUREMENT VTQD_EstRollForce_N "" FLOAT32_IEEE SWC_FDC_type_CM_single_N 0 0 -100000.0 100000.0 ECU_ADDRESS 0x0000 /* @ECU_Address@VTQD_EstRollForce_N@ */ /end MEASUREMENT
/begin MEASUREMENT VTQD_EstFrActForce_N "" FLOAT32_IEEE SWC_FDC_type_CM_single_N 0 0 -100000.0 100000.0 ECU_ADDRESS 0x0000 /* @ECU_Address@VTQD_EstFrActForce_N@ */ /end MEASUREMENT
/begin MEASUREMENT VTQD_EstRrRealTqSum_Nm "" FLOAT32_IEEE SWC_FDC_type_CM_single_Nm 0 0 -1.0E+6 1.0E+6 ECU_ADDRESS 0x0000 /* @ECU_Address@VTQD_EstRrRealTqSum_Nm@ */ /end MEASUREMENT
/begin MEASUREMENT VTQD_EstRrRealTqAvg_Nm "" FLOAT32_IEEE SWC_FDC_type_CM_single_Nm 0 0 -100000.0 100000.0 ECU_ADDRESS 0x0000 /* @ECU_Address@VTQD_EstRrRealTqAvg_Nm@ */ /end MEASUREMENT
/begin MEASUREMENT VTQD_EstRrWhlTqAvg_Nm "" FLOAT32_IEEE SWC_FDC_type_CM_single_Nm 0 0 -100000.0 100000.0 ECU_ADDRESS 0x0000 /* @ECU_Address@VTQD_EstRrWhlTqAvg_Nm@ */ /end MEASUREMENT
/begin MEASUREMENT VTQD_EstRrForce_N "" FLOAT32_IEEE SWC_FDC_type_CM_single_N 0 0 -100000.0 100000.0 ECU_ADDRESS 0x0000 /* @ECU_Address@VTQD_EstRrForce_N@ */ /end MEASUREMENT
/begin MEASUREMENT VTQD_EstRrActForce_N "" FLOAT32_IEEE SWC_FDC_type_CM_single_N 0 0 -100000.0 100000.0 ECU_ADDRESS 0x0000 /* @ECU_Address@VTQD_EstRrActForce_N@ */ /end MEASUREMENT
/begin MEASUREMENT VTQD_EstActTotalForce_N "" FLOAT32_IEEE SWC_FDC_type_CM_single_N 0 0 -100000.0 100000.0 ECU_ADDRESS 0x0000 /* @ECU_Address@VTQD_EstActTotalForce_N@ */ /end MEASUREMENT
/begin MEASUREMENT VTQD_EstLongAccSum_Gps "" FLOAT32_IEEE SWC_FDC_type_CM_single_Gps 0 0 -100000.0 100000.0 ECU_ADDRESS 0x0000 /* @ECU_Address@VTQD_EstLongAccSum_Gps@ */ /end MEASUREMENT
/begin MEASUREMENT VTQD_EstCycleCount_cnt "" FLOAT32_IEEE SWC_FDC_type_CM_single_cnt 0 0 0.0 100.0 ECU_ADDRESS 0x0000 /* @ECU_Address@VTQD_EstCycleCount_cnt@ */ /end MEASUREMENT
/begin MEASUREMENT VTQD_EstLongAccAvg_Gps "" FLOAT32_IEEE SWC_FDC_type_CM_single_Gps 0 0 -1.0 1.0 ECU_ADDRESS 0x0000 /* @ECU_Address@VTQD_EstLongAccAvg_Gps@ */ /end MEASUREMENT
/begin MEASUREMENT VTQD_EstVehWeight_kg "" FLOAT32_IEEE SWC_FDC_type_CM_single_kg 0 0 0.0 10000.0 ECU_ADDRESS 0x0000 /* @ECU_Address@VTQD_EstVehWeight_kg@ */ /end MEASUREMENT
/begin MEASUREMENT VTQD_EstLongAccMin_Gps "" FLOAT32_IEEE SWC_FDC_type_CM_single_Gps 0 0 -1.0 1.0 ECU_ADDRESS 0x0000 /* @ECU_Address@VTQD_EstLongAccMin_Gps@ */ /end MEASUREMENT
/begin MEASUREMENT VTQD_EstFrRealTqMin_Nm "" FLOAT32_IEEE SWC_FDC_type_CM_single_Nm 0 0 -100000.0 100000.0 ECU_ADDRESS 0x0000 /* @ECU_Address@VTQD_EstFrRealTqMin_Nm@ */ /end MEASUREMENT
/begin MEASUREMENT VTQD_EstRrRealTqMin_Nm "" FLOAT32_IEEE SWC_FDC_type_CM_single_Nm 0 0 -100000.0 100000.0 ECU_ADDRESS 0x0000 /* @ECU_Address@VTQD_EstRrRealTqMin_Nm@ */ /end MEASUREMENT
/begin MEASUREMENT VTQD_TMPwrAvailDchrg_kW "" FLOAT32_IEEE SWC_FDC_type_CM_single_kW 0 0 -100000.0 100000.0 ECU_ADDRESS 0x0000 /* @ECU_Address@VTQD_TMPwrAvailDchrg_kW@ */ /end MEASUREMENT
/begin MEASUREMENT VTQD_FrLossMAPLowV_V "" FLOAT32_IEEE SWC_FDC_type_CM_single_V 0 0 0.0 1000.0 ECU_ADDRESS 0x0000 /* @ECU_Address@VTQD_FrLossMAPLowV_V@ */ /end MEASUREMENT
/begin MEASUREMENT VTQD_FrLossMAPHighV_V "" FLOAT32_IEEE SWC_FDC_type_CM_single_V 0 0 0.0 1000.0 ECU_ADDRESS 0x0000 /* @ECU_Address@VTQD_FrLossMAPHighV_V@ */ /end MEASUREMENT
/begin MEASUREMENT VTQD_FrLossMAPHighV_kW "" FLOAT32_IEEE SWC_FDC_type_CM_single_kW 0 0 -200.0 200.0 ECU_ADDRESS 0x0000 /* @ECU_Address@VTQD_FrLossMAPHighV_kW@ */ /end MEASUREMENT
/begin MEASUREMENT VTQD_FrLossMAPLowV_kW "" FLOAT32_IEEE SWC_FDC_type_CM_single_kW 0 0 -200.0 200.0 ECU_ADDRESS 0x0000 /* @ECU_Address@VTQD_FrLossMAPLowV_kW@ */ /end MEASUREMENT
/begin MEASUREMENT VTQD_FrLossMAPFinal_kW "" FLOAT32_IEEE SWC_FDC_type_CM_single_kW 0 0 -200.0 200.0 ECU_ADDRESS 0x0000 /* @ECU_Address@VTQD_FrLossMAPFinal_kW@ */ /end MEASUREMENT
/begin MEASUREMENT VTQD_RrLossMAPLowV_V "" FLOAT32_IEEE SWC_FDC_type_CM_single_V 0 0 0.0 1000.0 ECU_ADDRESS 0x0000 /* @ECU_Address@VTQD_RrLossMAPLowV_V@ */ /end MEASUREMENT
/begin MEASUREMENT VTQD_RrLossMAPHighV_V "" FLOAT32_IEEE SWC_FDC_type_CM_single_V 0 0 0.0 1000.0 ECU_ADDRESS 0x0000 /* @ECU_Address@VTQD_RrLossMAPHighV_V@ */ /end MEASUREMENT
/begin MEASUREMENT VTQD_RrLossMAPHighV_kW "" FLOAT32_IEEE SWC_FDC_type_CM_single_kW 0 0 -200.0 200.0 ECU_ADDRESS 0x0000 /* @ECU_Address@VTQD_RrLossMAPHighV_kW@ */ /end MEASUREMENT
/begin MEASUREMENT VTQD_RrLossMAPLowV_kW "" FLOAT32_IEEE SWC_FDC_type_CM_single_kW 0 0 -200.0 200.0 ECU_ADDRESS 0x0000 /* @ECU_Address@VTQD_RrLossMAPLowV_kW@ */ /end MEASUREMENT
/begin MEASUREMENT VTQD_RrLossMAPFinal_kW "" FLOAT32_IEEE SWC_FDC_type_CM_single_kW 0 0 -200.0 200.0 ECU_ADDRESS 0x0000 /* @ECU_Address@VTQD_RrLossMAPFinal_kW@ */ /end MEASUREMENT
/begin MEASUREMENT VTQD_MotorLossTotal_kW "" FLOAT32_IEEE SWC_FDC_type_CM_single_kW 0 0 -200.0 200.0 ECU_ADDRESS 0x0000 /* @ECU_Address@VTQD_MotorLossTotal_kW@ */ /end MEASUREMENT
/begin MEASUREMENT VTQD_FrHVBPwrAvailDchrg_kW "" FLOAT32_IEEE SWC_FDC_type_CM_single_kW 0 0 -100000.0 100000.0 ECU_ADDRESS 0x0000 /* @ECU_Address@VTQD_FrHVBPwrAvailDchrg_kW@ */ /end MEASUREMENT
/begin MEASUREMENT VTQD_WhlTqCapMotFr_Nm "" FLOAT32_IEEE SWC_FDC_type_CM_single_Nm 0 0 -100000.0 100000.0 ECU_ADDRESS 0x0000 /* @ECU_Address@VTQD_WhlTqCapMotFr_Nm@ */ /end MEASUREMENT
/begin MEASUREMENT VTQD_WhlTqCapGenFr_Nm "" FLOAT32_IEEE SWC_FDC_type_CM_single_Nm 0 0 -100000.0 100000.0 ECU_ADDRESS 0x0000 /* @ECU_Address@VTQD_WhlTqCapGenFr_Nm@ */ /end MEASUREMENT
/begin MEASUREMENT VTQD_RrHVBPwrAvailDchrg_kW "" FLOAT32_IEEE SWC_FDC_type_CM_single_kW 0 0 -100000.0 100000.0 ECU_ADDRESS 0x0000 /* @ECU_Address@VTQD_RrHVBPwrAvailDchrg_kW@ */ /end MEASUREMENT
/begin MEASUREMENT VTQD_WhlTqCapMotRr_Nm "" FLOAT32_IEEE SWC_FDC_type_CM_single_Nm 0 0 -100000.0 100000.0 ECU_ADDRESS 0x0000 /* @ECU_Address@VTQD_WhlTqCapMotRr_Nm@ */ /end MEASUREMENT
/begin MEASUREMENT VTQD_WhlTqCapGenRr_Nm "" FLOAT32_IEEE SWC_FDC_type_CM_single_Nm 0 0 -100000.0 100000.0 ECU_ADDRESS 0x0000 /* @ECU_Address@VTQD_WhlTqCapGenRr_Nm@ */ /end MEASUREMENT
/begin MEASUREMENT VTQD_EstVehWeightResetTime_s "" FLOAT32_IEEE SWC_FDC_type_CM_single_s 0 0 0.0 100000.0 ECU_ADDRESS 0x0000 /* @ECU_Address@VTQD_EstVehWeightResetTime_s@ */ /end MEASUREMENT
/begin MEASUREMENT VTQD_ACCCancelMemTq_Nm "" FLOAT32_IEEE SWC_FDC_type_CM_single_Nm 0 0 -100000.0 100000.0 ECU_ADDRESS 0x0000 /* @ECU_Address@VTQD_ACCCancelMemTq_Nm@ */ /end MEASUREMENT
/begin MEASUREMENT VTQD_ACCCancelMemPosn_pct "" FLOAT32_IEEE SWC_FDC_type_CM_single_pct 0 0 0.0 100.0 ECU_ADDRESS 0x0000 /* @ECU_Address@VTQD_ACCCancelMemPosn_pct@ */ /end MEASUREMENT
/begin MEASUREMENT VTQD_CreepPtermTq_Nm "" FLOAT32_IEEE SWC_FDC_type_CM_single_Nm 0 0 -100000.0 100000.0 ECU_ADDRESS 0x0000 /* @ECU_Address@VTQD_CreepPtermTq_Nm@ */ /end MEASUREMENT
/begin MEASUREMENT VTQD_CreepItermMaxLimit_Nm "" FLOAT32_IEEE SWC_FDC_type_CM_single_Nm 0 0 -100000.0 100000.0 ECU_ADDRESS 0x0000 /* @ECU_Address@VTQD_CreepItermMaxLimit_Nm@ */ /end MEASUREMENT
/begin MEASUREMENT VTQD_CreepItermTq_Nm "" FLOAT32_IEEE SWC_FDC_type_CM_single_Nm 0 0 -100000.0 100000.0 ECU_ADDRESS 0x0000 /* @ECU_Address@VTQD_CreepItermTq_Nm@ */ /end MEASUREMENT
/begin MEASUREMENT VTQD_CreepOffsetTq_Nm "" FLOAT32_IEEE SWC_FDC_type_CM_single_Nm 0 0 -100000.0 100000.0 ECU_ADDRESS 0x0000 /* @ECU_Address@VTQD_CreepOffsetTq_Nm@ */ /end MEASUREMENT
/begin MEASUREMENT VTQD_CreepTotalOfstTq_Nm "" FLOAT32_IEEE SWC_FDC_type_CM_single_Nm 0 0 -100000.0 100000.0 ECU_ADDRESS 0x0000 /* @ECU_Address@VTQD_CreepTotalOfstTq_Nm@ */ /end MEASUREMENT
/begin MEASUREMENT VTQD_RPM2VehSpd_kph "" FLOAT32_IEEE SWC_FDC_type_CM_single_kph 0 0 0.0 300.0 ECU_ADDRESS 0x0000 /* @ECU_Address@VTQD_RPM2VehSpd_kph@ */ /end MEASUREMENT
/begin MEASUREMENT VTPM_C1_cnt "" UBYTE SWC_FDC_type_CM_uint8_cnt 0 0 0.0 255.0 ECU_ADDRESS 0x0000 /* @ECU_Address@VTPM_C1_cnt@ */ /end MEASUREMENT
/begin MEASUREMENT VTPM_C2_cnt "" UBYTE SWC_FDC_type_CM_uint8_cnt 0 0 0.0 255.0 ECU_ADDRESS 0x0000 /* @ECU_Address@VTPM_C2_cnt@ */ /end MEASUREMENT
/begin MEASUREMENT VTPM_C3_cnt "" UBYTE SWC_FDC_type_CM_uint8_cnt 0 0 0.0 255.0 ECU_ADDRESS 0x0000 /* @ECU_Address@VTPM_C3_cnt@ */ /end MEASUREMENT
/begin MEASUREMENT VTPM_C4_cnt "" UBYTE SWC_FDC_type_CM_uint8_cnt 0 0 0.0 255.0 ECU_ADDRESS 0x0000 /* @ECU_Address@VTPM_C4_cnt@ */ /end MEASUREMENT
/begin MEASUREMENT VTPM_Locdonetimes_cnt "" UBYTE SWC_FDC_type_CM_uint8_cnt 0 0 0.0 255.0 ECU_ADDRESS 0x0000 /* @ECU_Address@VTPM_Locdonetimes_cnt@ */ /end MEASUREMENT
/begin MEASUREMENT VTPM_S1L_enum "" UBYTE SWC_FDC_type_CM_uint8_enum 0 0 0.0 5.0 ECU_ADDRESS 0x0000 /* @ECU_Address@VTPM_S1L_enum@ */ /end MEASUREMENT
/begin MEASUREMENT VTPM_S2L_enum "" UBYTE SWC_FDC_type_CM_uint8_enum 0 0 0.0 5.0 ECU_ADDRESS 0x0000 /* @ECU_Address@VTPM_S2L_enum@ */ /end MEASUREMENT
/begin MEASUREMENT VTPM_S3L_enum "" UBYTE SWC_FDC_type_CM_uint8_enum 0 0 0.0 5.0 ECU_ADDRESS 0x0000 /* @ECU_Address@VTPM_S3L_enum@ */ /end MEASUREMENT
/begin MEASUREMENT VTPM_S4L_enum "" UBYTE SWC_FDC_type_CM_uint8_enum 0 0 0.0 5.0 ECU_ADDRESS 0x0000 /* @ECU_Address@VTPM_S4L_enum@ */ /end MEASUREMENT
/begin MEASUREMENT VTPM_unlearnSfailvalid_enum "" UBYTE SWC_FDC_type_CM_uint8_enum 0 0 0.0 255.0 ECU_ADDRESS 0x0000 /* @ECU_Address@VTPM_unlearnSfailvalid_enum@ */ /end MEASUREMENT
/begin MEASUREMENT VTPM_ManualID1pressure_raw "" UBYTE SWC_FDC_type_CM_uint8_raw 0 0 0.0 255.0 ECU_ADDRESS 0x0000 /* @ECU_Address@VTPM_ManualID1pressure_raw@ */ /end MEASUREMENT
/begin MEASUREMENT VTPM_ManualID2pressure_raw "" UBYTE SWC_FDC_type_CM_uint8_raw 0 0 0.0 255.0 ECU_ADDRESS 0x0000 /* @ECU_Address@VTPM_ManualID2pressure_raw@ */ /end MEASUREMENT
/begin MEASUREMENT VTPM_ManualID3pressure_raw "" UBYTE SWC_FDC_type_CM_uint8_raw 0 0 0.0 255.0 ECU_ADDRESS 0x0000 /* @ECU_Address@VTPM_ManualID3pressure_raw@ */ /end MEASUREMENT
/begin MEASUREMENT VTPM_ManualID4pressure_raw "" UBYTE SWC_FDC_type_CM_uint8_raw 0 0 0.0 255.0 ECU_ADDRESS 0x0000 /* @ECU_Address@VTPM_ManualID4pressure_raw@ */ /end MEASUREMENT
/begin MEASUREMENT VTPM_WritingCnt_enum "" UBYTE SWC_FDC_type_CM_uint8_enum 0 0 0.0 255.0 ECU_ADDRESS 0x0000 /* @ECU_Address@VTPM_WritingCnt_enum@ */ /end MEASUREMENT
/begin MEASUREMENT VTPM_LProgress_enum "" UBYTE SWC_FDC_type_CM_uint8_enum 0 0 0.0 255.0 ECU_ADDRESS 0x0000 /* @ECU_Address@VTPM_LProgress_enum@ */ /end MEASUREMENT
/begin MEASUREMENT VTPM_FlashIDvalid_enum "" UBYTE SWC_FDC_type_CM_uint8_enum 0 0 0.0 255.0 ECU_ADDRESS 0x0000 /* @ECU_Address@VTPM_FlashIDvalid_enum@ */ /end MEASUREMENT
/begin MEASUREMENT VVMC_APSStaSys_enum "" UBYTE SWC_FDC_type_CM_uint8_enum 0 0 0.0 7.0 ECU_ADDRESS 0x0000 /* @ECU_Address@VVMC_APSStaSys_enum@ */ /end MEASUREMENT
/begin MEASUREMENT VVMC_APSReq_enum "" UBYTE SWC_FDC_type_CM_uint8_enum 0 0 0.0 7.0 ECU_ADDRESS 0x0000 /* @ECU_Address@VVMC_APSReq_enum@ */ /end MEASUREMENT
/begin MEASUREMENT VTQR_RrTqZeroTrans_enum "" UBYTE SWC_FDC_type_CM_uint8_enum 0 0 0.0 2.0 ECU_ADDRESS 0x0000 /* @ECU_Address@VTQR_RrTqZeroTrans_enum@ */ /end MEASUREMENT
/begin MEASUREMENT VTQD_SWCResUpPress_enum "" UBYTE SWC_FDC_type_CM_uint8_enum 0 0 0.0 1.0 ECU_ADDRESS 0x0000 /* @ECU_Address@VTQD_SWCResUpPress_enum@ */ /end MEASUREMENT
/begin MEASUREMENT VTQD_SWCSetDownPress_enum "" UBYTE SWC_FDC_type_CM_uint8_enum 0 0 0.0 1.0 ECU_ADDRESS 0x0000 /* @ECU_Address@VTQD_SWCSetDownPress_enum@ */ /end MEASUREMENT
/begin MEASUREMENT VTQD_SWC2ScrollUpSta_enum "" UBYTE SWC_FDC_type_CM_uint8_enum 0 0 0.0 15.0 ECU_ADDRESS 0x0000 /* @ECU_Address@VTQD_SWC2ScrollUpSta_enum@ */ /end MEASUREMENT
/begin MEASUREMENT VTQD_SWC2ScrollDownSta_enum "" UBYTE SWC_FDC_type_CM_uint8_enum 0 0 0.0 15.0 ECU_ADDRESS 0x0000 /* @ECU_Address@VTQD_SWC2ScrollDownSta_enum@ */ /end MEASUREMENT
/begin MEASUREMENT VTPM_SetIDLoc_flg "" UBYTE SWC_FDC_type_CM_boolean_flg 0 0 0.0 1.0 ECU_ADDRESS 0x0000 /* @ECU_Address@VTPM_SetIDLoc_flg@ */ /end MEASUREMENT
/begin MEASUREMENT VTPM_ALFin_flg "" UBYTE SWC_FDC_type_CM_boolean_flg 0 0 0.0 1.0 ECU_ADDRESS 0x0000 /* @ECU_Address@VTPM_ALFin_flg@ */ /end MEASUREMENT
/begin MEASUREMENT VTPM_IDLock_flg "" UBYTE SWC_FDC_type_CM_boolean_flg 0 0 0.0 1.0 ECU_ADDRESS 0x0000 /* @ECU_Address@VTPM_IDLock_flg@ */ /end MEASUREMENT
/begin MEASUREMENT VTPM_unlearnSfali_flg "" UBYTE SWC_FDC_type_CM_boolean_flg 0 0 0.0 1.0 ECU_ADDRESS 0x0000 /* @ECU_Address@VTPM_unlearnSfali_flg@ */ /end MEASUREMENT
/begin MEASUREMENT VTPM_LFWheelTmpIndi_flg "" UBYTE SWC_FDC_type_CM_boolean_flg 0 0 0.0 1.0 ECU_ADDRESS 0x0000 /* @ECU_Address@VTPM_LFWheelTmpIndi_flg@ */ /end MEASUREMENT
/begin MEASUREMENT VTPM_RFWheelTmpIndi_flg "" UBYTE SWC_FDC_type_CM_boolean_flg 0 0 0.0 1.0 ECU_ADDRESS 0x0000 /* @ECU_Address@VTPM_RFWheelTmpIndi_flg@ */ /end MEASUREMENT
/begin MEASUREMENT VTPM_LRWheelTmpIndi_flg "" UBYTE SWC_FDC_type_CM_boolean_flg 0 0 0.0 1.0 ECU_ADDRESS 0x0000 /* @ECU_Address@VTPM_LRWheelTmpIndi_flg@ */ /end MEASUREMENT
/begin MEASUREMENT VTPM_RRWheelTmpIndi_flg "" UBYTE SWC_FDC_type_CM_boolean_flg 0 0 0.0 1.0 ECU_ADDRESS 0x0000 /* @ECU_Address@VTPM_RRWheelTmpIndi_flg@ */ /end MEASUREMENT
/begin MEASUREMENT VTPM_FAT_flg "" UBYTE SWC_FDC_type_CM_boolean_flg 0 0 0.0 1.0 ECU_ADDRESS 0x0000 /* @ECU_Address@VTPM_FAT_flg@ */ /end MEASUREMENT
/begin MEASUREMENT VTPM_TPMSTLCmd_flg "" UBYTE SWC_FDC_type_CM_boolean_flg 0 0 0.0 1.0 ECU_ADDRESS 0x0000 /* @ECU_Address@VTPM_TPMSTLCmd_flg@ */ /end MEASUREMENT
/begin MEASUREMENT VTPM_TPMSmanualDone_flg "" UBYTE SWC_FDC_type_CM_boolean_flg 0 0 0.0 1.0 ECU_ADDRESS 0x0000 /* @ECU_Address@VTPM_TPMSmanualDone_flg@ */ /end MEASUREMENT
/begin MEASUREMENT VTPM_Chkfin_flg "" UBYTE SWC_FDC_type_CM_boolean_flg 0 0 0.0 1.0 ECU_ADDRESS 0x0000 /* @ECU_Address@VTPM_Chkfin_flg@ */ /end MEASUREMENT
/begin MEASUREMENT VVMC_APSTqCtrlAllow_flg "" UBYTE SWC_FDC_type_CM_boolean_flg 0 0 0.0 1.0 ECU_ADDRESS 0x0000 /* @ECU_Address@VVMC_APSTqCtrlAllow_flg@ */ /end MEASUREMENT
/begin MEASUREMENT VVMC_APSShiftCtrlAllow_flg "" UBYTE SWC_FDC_type_CM_boolean_flg 0 0 0.0 1.0 ECU_ADDRESS 0x0000 /* @ECU_Address@VVMC_APSShiftCtrlAllow_flg@ */ /end MEASUREMENT
/begin MEASUREMENT VVMC_APSDoorCtrlAllow_flg "" UBYTE SWC_FDC_type_CM_boolean_flg 0 0 0.0 1.0 ECU_ADDRESS 0x0000 /* @ECU_Address@VVMC_APSDoorCtrlAllow_flg@ */ /end MEASUREMENT
/begin MEASUREMENT VVMC_ACCSpdCtrl_flg "" UBYTE SWC_FDC_type_CM_boolean_flg 0 0 0.0 1.0 ECU_ADDRESS 0x0000 /* @ECU_Address@VVMC_ACCSpdCtrl_flg@ */ /end MEASUREMENT
/begin MEASUREMENT VVMC_OVRD2ActRampActive_flg "" UBYTE SWC_FDC_type_CM_boolean_flg 0 0 0.0 1.0 ECU_ADDRESS 0x0000 /* @ECU_Address@VVMC_OVRD2ActRampActive_flg@ */ /end MEASUREMENT
/begin MEASUREMENT VVMC_ZeroSpdHoldAllow_flg "" UBYTE SWC_FDC_type_CM_boolean_flg 0 0 0.0 1.0 ECU_ADDRESS 0x0000 /* @ECU_Address@VVMC_ZeroSpdHoldAllow_flg@ */ /end MEASUREMENT
/begin MEASUREMENT VVMC_VehHoldDecCtrlCalSW2_flg "" UBYTE SWC_FDC_type_CM_boolean_flg 0 0 0.0 1.0 ECU_ADDRESS 0x0000 /* @ECU_Address@VVMC_VehHoldDecCtrlCalSW2_flg@ */ /end MEASUREMENT
/begin MEASUREMENT VVMC_AccelTurnHold_flg "" UBYTE SWC_FDC_type_CM_boolean_flg 0 0 0.0 1.0 ECU_ADDRESS 0x0000 /* @ECU_Address@VVMC_AccelTurnHold_flg@ */ /end MEASUREMENT
/begin MEASUREMENT VVMC_VehHoldMCPPass_flg "" UBYTE SWC_FDC_type_CM_boolean_flg 0 0 0.0 1.0 ECU_ADDRESS 0x0000 /* @ECU_Address@VVMC_VehHoldMCPPass_flg@ */ /end MEASUREMENT
/begin MEASUREMENT VVMC_VehHoldDecCtrlBEnd_flg "" UBYTE SWC_FDC_type_CM_boolean_flg 0 0 0.0 1.0 ECU_ADDRESS 0x0000 /* @ECU_Address@VVMC_VehHoldDecCtrlBEnd_flg@ */ /end MEASUREMENT
/begin MEASUREMENT VVMC_VehHoldHTimeNoMCPDet_flg "" UBYTE SWC_FDC_type_CM_boolean_flg 0 0 0.0 1.0 ECU_ADDRESS 0x0000 /* @ECU_Address@VVMC_VehHoldHTimeNoMCPDet_flg@ */ /end MEASUREMENT
/begin MEASUREMENT VVMC_VehHoldDecCtrlHEnd_flg "" UBYTE SWC_FDC_type_CM_boolean_flg 0 0 0.0 1.0 ECU_ADDRESS 0x0000 /* @ECU_Address@VVMC_VehHoldDecCtrlHEnd_flg@ */ /end MEASUREMENT
/begin MEASUREMENT VVMC_HoldDelayAllow_flg "" UBYTE SWC_FDC_type_CM_boolean_flg 0 0 0.0 1.0 ECU_ADDRESS 0x0000 /* @ECU_Address@VVMC_HoldDelayAllow_flg@ */ /end MEASUREMENT
/begin MEASUREMENT VVMC_ACCShutOffHold_flg "" UBYTE SWC_FDC_type_CM_boolean_flg 0 0 0.0 1.0 ECU_ADDRESS 0x0000 /* @ECU_Address@VVMC_ACCShutOffHold_flg@ */ /end MEASUREMENT
/begin MEASUREMENT VVMC_HillUpHoldReqEn_flg "" UBYTE SWC_FDC_type_CM_boolean_flg 0 0 0.0 1.0 ECU_ADDRESS 0x0000 /* @ECU_Address@VVMC_HillUpHoldReqEn_flg@ */ /end MEASUREMENT
/begin MEASUREMENT VVMC_HillUpESCStaEn_flg "" UBYTE SWC_FDC_type_CM_boolean_flg 0 0 0.0 1.0 ECU_ADDRESS 0x0000 /* @ECU_Address@VVMC_HillUpESCStaEn_flg@ */ /end MEASUREMENT
/begin MEASUREMENT VVMC_ACCLowSpdTqCtrl_flg "" UBYTE SWC_FDC_type_CM_boolean_flg 0 0 0.0 1.0 ECU_ADDRESS 0x0000 /* @ECU_Address@VVMC_ACCLowSpdTqCtrl_flg@ */ /end MEASUREMENT
/begin MEASUREMENT VVMC_ReqBrkJoin_flg "" UBYTE SWC_FDC_type_CM_boolean_flg 0 0 0.0 1.0 ECU_ADDRESS 0x0000 /* @ECU_Address@VVMC_ReqBrkJoin_flg@ */ /end MEASUREMENT
/begin MEASUREMENT VVMC_ReqBrkJoinSRActive_flg "" UBYTE SWC_FDC_type_CM_boolean_flg 0 0 0.0 1.0 ECU_ADDRESS 0x0000 /* @ECU_Address@VVMC_ReqBrkJoinSRActive_flg@ */ /end MEASUREMENT
/begin MEASUREMENT VVMC_ACCPedalTqEnOvrd_flg "" UBYTE SWC_FDC_type_CM_boolean_flg 0 0 0.0 1.0 ECU_ADDRESS 0x0000 /* @ECU_Address@VVMC_ACCPedalTqEnOvrd_flg@ */ /end MEASUREMENT
/begin MEASUREMENT VVMC_ACCActivePedalOn_flg "" UBYTE SWC_FDC_type_CM_boolean_flg 0 0 0.0 1.0 ECU_ADDRESS 0x0000 /* @ECU_Address@VVMC_ACCActivePedalOn_flg@ */ /end MEASUREMENT
/begin MEASUREMENT VVMC_ACCOvrdBackDrTq_flg "" UBYTE SWC_FDC_type_CM_boolean_flg 0 0 0.0 1.0 ECU_ADDRESS 0x0000 /* @ECU_Address@VVMC_ACCOvrdBackDrTq_flg@ */ /end MEASUREMENT
/begin MEASUREMENT VVMC_ZeroRgnTqSpdCtrl_flg "" UBYTE SWC_FDC_type_CM_boolean_flg 0 0 0.0 1.0 ECU_ADDRESS 0x0000 /* @ECU_Address@VVMC_ZeroRgnTqSpdCtrl_flg@ */ /end MEASUREMENT
/begin MEASUREMENT VVMC_ACCLowSpdFollowESCTq_flg "" UBYTE SWC_FDC_type_CM_boolean_flg 0 0 0.0 1.0 ECU_ADDRESS 0x0000 /* @ECU_Address@VVMC_ACCLowSpdFollowESCTq_flg@ */ /end MEASUREMENT
/begin MEASUREMENT VVMC_RgnProhibited_flg "" UBYTE SWC_FDC_type_CM_boolean_flg 0 0 0.0 1.0 ECU_ADDRESS 0x0000 /* @ECU_Address@VVMC_RgnProhibited_flg@ */ /end MEASUREMENT
/begin MEASUREMENT VVMC_HoldNoMCP_flg "" UBYTE SWC_FDC_type_CM_boolean_flg 0 0 0.0 1.0 ECU_ADDRESS 0x0000 /* @ECU_Address@VVMC_HoldNoMCP_flg@ */ /end MEASUREMENT
/begin MEASUREMENT VVMC_CCPedalTqEnOvrd_flg "" UBYTE SWC_FDC_type_CM_boolean_flg 0 0 0.0 1.0 ECU_ADDRESS 0x0000 /* @ECU_Address@VVMC_CCPedalTqEnOvrd_flg@ */ /end MEASUREMENT
/begin MEASUREMENT VVMC_MSAOvrdAllow_flg "" UBYTE SWC_FDC_type_CM_boolean_flg 0 0 0.0 1.0 ECU_ADDRESS 0x0000 /* @ECU_Address@VVMC_MSAOvrdAllow_flg@ */ /end MEASUREMENT
/begin MEASUREMENT VVMC_MSATqDown_flg "" UBYTE SWC_FDC_type_CM_boolean_flg 0 0 0.0 1.0 ECU_ADDRESS 0x0000 /* @ECU_Address@VVMC_MSATqDown_flg@ */ /end MEASUREMENT
/begin MEASUREMENT VVMC_CAASCtrlAvail_flg "" UBYTE SWC_FDC_type_CM_boolean_flg 0 0 0.0 1.0 ECU_ADDRESS 0x0000 /* @ECU_Address@VVMC_CAASCtrlAvail_flg@ */ /end MEASUREMENT
/begin MEASUREMENT VVMC_APSDecReqA_flg "" UBYTE SWC_FDC_type_CM_boolean_flg 0 0 0.0 1.0 ECU_ADDRESS 0x0000 /* @ECU_Address@VVMC_APSDecReqA_flg@ */ /end MEASUREMENT
/begin MEASUREMENT VVMC_LFWhlSkidReset_flg "" UBYTE SWC_FDC_type_CM_boolean_flg 0 0 0.0 1.0 ECU_ADDRESS 0x0000 /* @ECU_Address@VVMC_LFWhlSkidReset_flg@ */ /end MEASUREMENT
/begin MEASUREMENT VVMC_RFWhlSkidReset_flg "" UBYTE SWC_FDC_type_CM_boolean_flg 0 0 0.0 1.0 ECU_ADDRESS 0x0000 /* @ECU_Address@VVMC_RFWhlSkidReset_flg@ */ /end MEASUREMENT
/begin MEASUREMENT VVMC_LRWhlSkidReset_flg "" UBYTE SWC_FDC_type_CM_boolean_flg 0 0 0.0 1.0 ECU_ADDRESS 0x0000 /* @ECU_Address@VVMC_LRWhlSkidReset_flg@ */ /end MEASUREMENT
/begin MEASUREMENT VVMC_RRWhlSkidReset_flg "" UBYTE SWC_FDC_type_CM_boolean_flg 0 0 0.0 1.0 ECU_ADDRESS 0x0000 /* @ECU_Address@VVMC_RRWhlSkidReset_flg@ */ /end MEASUREMENT
/begin MEASUREMENT VVMC_AllWhlSkid_flg "" UBYTE SWC_FDC_type_CM_boolean_flg 0 0 0.0 1.0 ECU_ADDRESS 0x0000 /* @ECU_Address@VVMC_AllWhlSkid_flg@ */ /end MEASUREMENT
/begin MEASUREMENT VVMC_VehSpdPredSkid_flg "" UBYTE SWC_FDC_type_CM_boolean_flg 0 0 0.0 1.0 ECU_ADDRESS 0x0000 /* @ECU_Address@VVMC_VehSpdPredSkid_flg@ */ /end MEASUREMENT
/begin MEASUREMENT VVMC_ESCActive_flg "" UBYTE SWC_FDC_type_CM_boolean_flg 0 0 0.0 1.0 ECU_ADDRESS 0x0000 /* @ECU_Address@VVMC_ESCActive_flg@ */ /end MEASUREMENT
/begin MEASUREMENT VVMC_RDCDetectEn_flg "" UBYTE SWC_FDC_type_CM_boolean_flg 0 0 0.0 1.0 ECU_ADDRESS 0x0000 /* @ECU_Address@VVMC_RDCDetectEn_flg@ */ /end MEASUREMENT
/begin MEASUREMENT VVMC_AltRDCRec_flg "" UBYTE SWC_FDC_type_CM_boolean_flg 0 0 0.0 1.0 ECU_ADDRESS 0x0000 /* @ECU_Address@VVMC_AltRDCRec_flg@ */ /end MEASUREMENT
/begin MEASUREMENT VTQR_FShaftSpdTqLimLow_flg "" UBYTE SWC_FDC_type_CM_boolean_flg 0 0 0.0 1.0 ECU_ADDRESS 0x0000 /* @ECU_Address@VTQR_FShaftSpdTqLimLow_flg@ */ /end MEASUREMENT
/begin MEASUREMENT VTQR_FTimerTqLimLow_flg "" UBYTE SWC_FDC_type_CM_boolean_flg 0 0 0.0 1.0 ECU_ADDRESS 0x0000 /* @ECU_Address@VTQR_FTimerTqLimLow_flg@ */ /end MEASUREMENT
/begin MEASUREMENT VTQR_RShaftSpdTqLimLow_flg "" UBYTE SWC_FDC_type_CM_boolean_flg 0 0 0.0 1.0 ECU_ADDRESS 0x0000 /* @ECU_Address@VTQR_RShaftSpdTqLimLow_flg@ */ /end MEASUREMENT
/begin MEASUREMENT VTQR_RTimerTqLimLow_flg "" UBYTE SWC_FDC_type_CM_boolean_flg 0 0 0.0 1.0 ECU_ADDRESS 0x0000 /* @ECU_Address@VTQR_RTimerTqLimLow_flg@ */ /end MEASUREMENT
/begin MEASUREMENT VTQR_FrDrModLatch_flg "" UBYTE SWC_FDC_type_CM_boolean_flg 0 0 0.0 1.0 ECU_ADDRESS 0x0000 /* @ECU_Address@VTQR_FrDrModLatch_flg@ */ /end MEASUREMENT
/begin MEASUREMENT VTQR_RrRDCActiveTs_flg "" UBYTE SWC_FDC_type_CM_boolean_flg 0 0 0.0 1.0 ECU_ADDRESS 0x0000 /* @ECU_Address@VTQR_RrRDCActiveTs_flg@ */ /end MEASUREMENT
/begin MEASUREMENT VTQR_RrDrModLatch_flg "" UBYTE SWC_FDC_type_CM_boolean_flg 0 0 0.0 1.0 ECU_ADDRESS 0x0000 /* @ECU_Address@VTQR_RrDrModLatch_flg@ */ /end MEASUREMENT
/begin MEASUREMENT VTQR_FrRDCActRateLimitInc_flg "" UBYTE SWC_FDC_type_CM_boolean_flg 0 0 0.0 1.0 ECU_ADDRESS 0x0000 /* @ECU_Address@VTQR_FrRDCActRateLimitInc_flg@ */ /end MEASUREMENT
/begin MEASUREMENT VTQR_FrDrModChangeReset_flg "" UBYTE SWC_FDC_type_CM_boolean_flg 0 0 0.0 1.0 ECU_ADDRESS 0x0000 /* @ECU_Address@VTQR_FrDrModChangeReset_flg@ */ /end MEASUREMENT
/begin MEASUREMENT VTQR_RrRDCActRateLimitInc_flg "" UBYTE SWC_FDC_type_CM_boolean_flg 0 0 0.0 1.0 ECU_ADDRESS 0x0000 /* @ECU_Address@VTQR_RrRDCActRateLimitInc_flg@ */ /end MEASUREMENT
/begin MEASUREMENT VTQR_RrDrModChangeReset_flg "" UBYTE SWC_FDC_type_CM_boolean_flg 0 0 0.0 1.0 ECU_ADDRESS 0x0000 /* @ECU_Address@VTQR_RrDrModChangeReset_flg@ */ /end MEASUREMENT
/begin MEASUREMENT VTQR_ACCHoldPdovrdInc_flg "" UBYTE SWC_FDC_type_CM_boolean_flg 0 0 0.0 1.0 ECU_ADDRESS 0x0000 /* @ECU_Address@VTQR_ACCHoldPdovrdInc_flg@ */ /end MEASUREMENT
/begin MEASUREMENT VTQD_DriveProtRemove_flg "" UBYTE SWC_FDC_type_CM_boolean_flg 0 0 0.0 1.0 ECU_ADDRESS 0x0000 /* @ECU_Address@VTQD_DriveProtRemove_flg@ */ /end MEASUREMENT
/begin MEASUREMENT VTQD_OPDHoldRelReverse_flg "" UBYTE SWC_FDC_type_CM_boolean_flg 0 0 0.0 1.0 ECU_ADDRESS 0x0000 /* @ECU_Address@VTQD_OPDHoldRelReverse_flg@ */ /end MEASUREMENT
/begin MEASUREMENT VTQD_OPDHoldEnRelLatch_flg "" UBYTE SWC_FDC_type_CM_boolean_flg 0 0 0.0 1.0 ECU_ADDRESS 0x0000 /* @ECU_Address@VTQD_OPDHoldEnRelLatch_flg@ */ /end MEASUREMENT
/begin MEASUREMENT VTQD_OPDHoldEnRel_flg "" UBYTE SWC_FDC_type_CM_boolean_flg 0 0 0.0 1.0 ECU_ADDRESS 0x0000 /* @ECU_Address@VTQD_OPDHoldEnRel_flg@ */ /end MEASUREMENT
/begin MEASUREMENT VTQD_OPDHoldRgnOn2Off_flg "" UBYTE SWC_FDC_type_CM_boolean_flg 0 0 0.0 1.0 ECU_ADDRESS 0x0000 /* @ECU_Address@VTQD_OPDHoldRgnOn2Off_flg@ */ /end MEASUREMENT
/begin MEASUREMENT VTQD_R2DEnOPDHold_flg "" UBYTE SWC_FDC_type_CM_boolean_flg 0 0 0.0 1.0 ECU_ADDRESS 0x0000 /* @ECU_Address@VTQD_R2DEnOPDHold_flg@ */ /end MEASUREMENT
/begin MEASUREMENT VTQD_OPDHoldR2D_flg "" UBYTE SWC_FDC_type_CM_boolean_flg 0 0 0.0 1.0 ECU_ADDRESS 0x0000 /* @ECU_Address@VTQD_OPDHoldR2D_flg@ */ /end MEASUREMENT
/begin MEASUREMENT VTQD_SkipDisOPDHoldReset_flg "" UBYTE SWC_FDC_type_CM_boolean_flg 0 0 0.0 1.0 ECU_ADDRESS 0x0000 /* @ECU_Address@VTQD_SkipDisOPDHoldReset_flg@ */ /end MEASUREMENT
/begin MEASUREMENT VTQD_WhlSkipDisOPDHold_flg "" UBYTE SWC_FDC_type_CM_boolean_flg 0 0 0.0 1.0 ECU_ADDRESS 0x0000 /* @ECU_Address@VTQD_WhlSkipDisOPDHold_flg@ */ /end MEASUREMENT
/begin MEASUREMENT VTQD_ADASShutOff_flg "" UBYTE SWC_FDC_type_CM_boolean_flg 0 0 0.0 1.0 ECU_ADDRESS 0x0000 /* @ECU_Address@VTQD_ADASShutOff_flg@ */ /end MEASUREMENT
/begin MEASUREMENT VTQD_RegenTqLimitEn_flg "" UBYTE SWC_FDC_type_CM_boolean_flg 0 0 0.0 1.0 ECU_ADDRESS 0x0000 /* @ECU_Address@VTQD_RegenTqLimitEn_flg@ */ /end MEASUREMENT
/begin MEASUREMENT VTQD_BrkRgnLatchEn_flg "" UBYTE SWC_FDC_type_CM_boolean_flg 0 0 0.0 1.0 ECU_ADDRESS 0x0000 /* @ECU_Address@VTQD_BrkRgnLatchEn_flg@ */ /end MEASUREMENT
/begin MEASUREMENT VTQD_ACCCancelDet_flg "" UBYTE SWC_FDC_type_CM_boolean_flg 0 0 0.0 1.0 ECU_ADDRESS 0x0000 /* @ECU_Address@VTQD_ACCCancelDet_flg@ */ /end MEASUREMENT
/begin MEASUREMENT VTQD_BOSEnable_flg "" UBYTE SWC_FDC_type_CM_boolean_flg 0 0 0.0 1.0 ECU_ADDRESS 0x0000 /* @ECU_Address@VTQD_BOSEnable_flg@ */ /end MEASUREMENT
/begin MEASUREMENT VTQD_LoSpdBrkCtrl_flg "" UBYTE SWC_FDC_type_CM_boolean_flg 0 0 0.0 1.0 ECU_ADDRESS 0x0000 /* @ECU_Address@VTQD_LoSpdBrkCtrl_flg@ */ /end MEASUREMENT
/begin MEASUREMENT VTQD_EscapModeTqLim_flg "" UBYTE SWC_FDC_type_CM_boolean_flg 0 0 0.0 1.0 ECU_ADDRESS 0x0000 /* @ECU_Address@VTQD_EscapModeTqLim_flg@ */ /end MEASUREMENT
/begin MEASUREMENT VTQD_PreLoadHoldtimeEnd_flg "" UBYTE SWC_FDC_type_CM_boolean_flg 0 0 0.0 1.0 ECU_ADDRESS 0x0000 /* @ECU_Address@VTQD_PreLoadHoldtimeEnd_flg@ */ /end MEASUREMENT
/begin MEASUREMENT VTQD_PreLoadHold_flg "" UBYTE SWC_FDC_type_CM_boolean_flg 0 0 0.0 1.0 ECU_ADDRESS 0x0000 /* @ECU_Address@VTQD_PreLoadHold_flg@ */ /end MEASUREMENT
/begin MEASUREMENT VTQD_RBCActive_flg "" UBYTE SWC_FDC_type_CM_boolean_flg 0 0 0.0 1.0 ECU_ADDRESS 0x0000 /* @ECU_Address@VTQD_RBCActive_flg@ */ /end MEASUREMENT
/begin MEASUREMENT VTQD_MediumSkipDisCreep_flg "" UBYTE SWC_FDC_type_CM_boolean_flg 0 0 0.0 1.0 ECU_ADDRESS 0x0000 /* @ECU_Address@VTQD_MediumSkipDisCreep_flg@ */ /end MEASUREMENT
/begin MEASUREMENT VTQD_HighSkipDisCreep_flg "" UBYTE SWC_FDC_type_CM_boolean_flg 0 0 0.0 1.0 ECU_ADDRESS 0x0000 /* @ECU_Address@VTQD_HighSkipDisCreep_flg@ */ /end MEASUREMENT
/begin MEASUREMENT VTQD_CreepPrLoadEnable_flg "" UBYTE SWC_FDC_type_CM_boolean_flg 0 0 0.0 1.0 ECU_ADDRESS 0x0000 /* @ECU_Address@VTQD_CreepPrLoadEnable_flg@ */ /end MEASUREMENT
/begin MEASUREMENT VTQD_LowSkipDisCreep_flg "" UBYTE SWC_FDC_type_CM_boolean_flg 0 0 0.0 1.0 ECU_ADDRESS 0x0000 /* @ECU_Address@VTQD_LowSkipDisCreep_flg@ */ /end MEASUREMENT
/begin MEASUREMENT VTQD_VehWeightEstEn_flg "" UBYTE SWC_FDC_type_CM_boolean_flg 0 0 0.0 1.0 ECU_ADDRESS 0x0000 /* @ECU_Address@VTQD_VehWeightEstEn_flg@ */ /end MEASUREMENT
/begin MEASUREMENT VTQD_EstLongAccCheckPass_flg "" UBYTE SWC_FDC_type_CM_boolean_flg 0 0 0.0 1.0 ECU_ADDRESS 0x0000 /* @ECU_Address@VTQD_EstLongAccCheckPass_flg@ */ /end MEASUREMENT
/begin MEASUREMENT VTQD_EstFrRealTqCheckPass_flg "" UBYTE SWC_FDC_type_CM_boolean_flg 0 0 0.0 1.0 ECU_ADDRESS 0x0000 /* @ECU_Address@VTQD_EstFrRealTqCheckPass_flg@ */ /end MEASUREMENT
/begin MEASUREMENT VTQD_EstRrRealTqCheckPass_flg "" UBYTE SWC_FDC_type_CM_boolean_flg 0 0 0.0 1.0 ECU_ADDRESS 0x0000 /* @ECU_Address@VTQD_EstRrRealTqCheckPass_flg@ */ /end MEASUREMENT
/begin MEASUREMENT VTQD_OPDHoldAllowPark_flg "" UBYTE SWC_FDC_type_CM_boolean_flg 0 0 0.0 1.0 ECU_ADDRESS 0x0000 /* @ECU_Address@VTQD_OPDHoldAllowPark_flg@ */ /end MEASUREMENT
/begin MEASUREMENT VTQD_OPDHoldSpdEnLamp_flg "" UBYTE SWC_FDC_type_CM_boolean_flg 0 0 0.0 1.0 ECU_ADDRESS 0x0000 /* @ECU_Address@VTQD_OPDHoldSpdEnLamp_flg@ */ /end MEASUREMENT
/begin MEASUREMENT VTQD_VehWeightEstEnd_flg "" UBYTE SWC_FDC_type_CM_boolean_flg 0 0 0.0 1.0 ECU_ADDRESS 0x0000 /* @ECU_Address@VTQD_VehWeightEstEnd_flg@ */ /end MEASUREMENT
/begin MEASUREMENT VTQD_CreepPICtrlReset_flg "" UBYTE SWC_FDC_type_CM_boolean_flg 0 0 0.0 1.0 ECU_ADDRESS 0x0000 /* @ECU_Address@VTQD_CreepPICtrlReset_flg@ */ /end MEASUREMENT
/begin MEASUREMENT VTQD_SWCCancelP_flg "" UBYTE SWC_FDC_type_CM_boolean_flg 0 0 0.0 1.0 ECU_ADDRESS 0x0000 /* @ECU_Address@VTQD_SWCCancelP_flg@ */ /end MEASUREMENT
/begin MEASUREMENT VTQD_ChangeToOFF_flg "" UBYTE SWC_FDC_type_CM_boolean_flg 0 0 0.0 1.0 ECU_ADDRESS 0x0000 /* @ECU_Address@VTQD_ChangeToOFF_flg@ */ /end MEASUREMENT
/begin MEASUREMENT VTQD_CCChangeToSTANDBY_flg "" UBYTE SWC_FDC_type_CM_boolean_flg 0 0 0.0 1.0 ECU_ADDRESS 0x0000 /* @ECU_Address@VTQD_CCChangeToSTANDBY_flg@ */ /end MEASUREMENT
/begin MEASUREMENT VTQD_MSASavedSetSpd_raw32 "" FLOAT32_IEEE SWC_FDC_type_CM_single_raw32 0 0 0.0 300.0 ECU_ADDRESS 0x0000 /* @ECU_Address@VTQD_MSASavedSetSpd_raw32@ */ /end MEASUREMENT
/begin MEASUREMENT VTQD_ACCSavedSetSpd_raw32 "" FLOAT32_IEEE SWC_FDC_type_CM_single_raw32 0 0 0.0 300.0 ECU_ADDRESS 0x0000 /* @ECU_Address@VTQD_ACCSavedSetSpd_raw32@ */ /end MEASUREMENT
/begin MEASUREMENT VTQD_DistanceUnit_flg "" UBYTE SWC_FDC_type_CM_boolean_flg 0 0 0.0 1.0 ECU_ADDRESS 0x0000 /* @ECU_Address@VTQD_DistanceUnit_flg@ */ /end MEASUREMENT
/begin MEASUREMENT VTQD_RoadSpdActive2Standby_flg "" UBYTE SWC_FDC_type_CM_boolean_flg 0 0 0.0 1.0 ECU_ADDRESS 0x0000 /* @ECU_Address@VTQD_RoadSpdActive2Standby_flg@ */ /end MEASUREMENT
/begin MEASUREMENT VTQD_StandbyDisRoadSpd_flg "" UBYTE SWC_FDC_type_CM_boolean_flg 0 0 0.0 1.0 ECU_ADDRESS 0x0000 /* @ECU_Address@VTQD_StandbyDisRoadSpd_flg@ */ /end MEASUREMENT
/begin COMPU_METHOD SWC_FDC_type_CM_single_C "Q = V" RAT_FUNC "%8.6" "C" COEFFS 0 1 0 0 0 1 /end COMPU_METHOD
/begin COMPU_METHOD SWC_FDC_type_CM_uint8_enum "Q = V" RAT_FUNC "%3.0" "enum" COEFFS 0 1 0 0 0 1 /end COMPU_METHOD
/begin COMPU_METHOD SWC_FDC_type_CM_single_kph "Q = V" RAT_FUNC "%8.6" "kph" COEFFS 0 1 0 0 0 1 /end COMPU_METHOD
/begin COMPU_METHOD SWC_FDC_type_CM_single_Gps "Q = V" RAT_FUNC "%8.6" "Gps" COEFFS 0 1 0 0 0 1 /end COMPU_METHOD
/begin COMPU_METHOD SWC_FDC_type_CM_single_c "Q = V" RAT_FUNC "%8.6" "c" COEFFS 0 1 0 0 0 1 /end COMPU_METHOD
/begin COMPU_METHOD SWC_FDC_type_CM_single_deg "Q = V" RAT_FUNC "%8.6" "deg" COEFFS 0 1 0 0 0 1 /end COMPU_METHOD
/begin COMPU_METHOD SWC_FDC_type_CM_single_pct "Q = V" RAT_FUNC "%8.6" "pct" COEFFS 0 1 0 0 0 1 /end COMPU_METHOD
/begin COMPU_METHOD SWC_FDC_type_CM_single_s "Q = V" RAT_FUNC "%8.6" "s" COEFFS 0 1 0 0 0 1 /end COMPU_METHOD
/begin COMPU_METHOD SWC_FDC_type_CM_single_enum "Q = V" RAT_FUNC "%8.6" "enum" COEFFS 0 1 0 0 0 1 /end COMPU_METHOD
/begin COMPU_METHOD SWC_FDC_type_CM_single_rpm "Q = V" RAT_FUNC "%8.6" "rpm" COEFFS 0 1 0 0 0 1 /end COMPU_METHOD
/begin COMPU_METHOD SWC_FDC_type_CM_single_kg "Q = V" RAT_FUNC "%8.6" "kg" COEFFS 0 1 0 0 0 1 /end COMPU_METHOD
/begin COMPU_METHOD SWC_FDC_type_CM_single_Nm "Q = V" RAT_FUNC "%8.6" "Nm" COEFFS 0 1 0 0 0 1 /end COMPU_METHOD
/begin COMPU_METHOD SWC_FDC_type_CM_single_mps2 "Q = V" RAT_FUNC "%8.6" "mps2" COEFFS 0 1 0 0 0 1 /end COMPU_METHOD
/begin COMPU_METHOD SWC_FDC_type_CM_single_Dps "Q = V" RAT_FUNC "%8.6" "Dps" COEFFS 0 1 0 0 0 1 /end COMPU_METHOD
/begin COMPU_METHOD SWC_FDC_type_CM_single_mps "Q = V" RAT_FUNC "%8.6" "mps" COEFFS 0 1 0 0 0 1 /end COMPU_METHOD
/begin COMPU_METHOD SWC_FDC_type_CM_single_kw "Q = V" RAT_FUNC "%8.6" "kw" COEFFS 0 1 0 0 0 1 /end COMPU_METHOD
/begin COMPU_METHOD SWC_FDC_type_CM_single_kW "Q = V" RAT_FUNC "%8.6" "kW" COEFFS 0 1 0 0 0 1 /end COMPU_METHOD
/begin COMPU_METHOD SWC_FDC_type_CM_single_V "Q = V" RAT_FUNC "%8.6" "V" COEFFS 0 1 0 0 0 1 /end COMPU_METHOD
/begin COMPU_METHOD SWC_FDC_type_CM_single_m "Q = V" RAT_FUNC "%8.6" "m" COEFFS 0 1 0 0 0 1 /end COMPU_METHOD
/begin COMPU_METHOD SWC_FDC_type_CM_single_v "Q = V" RAT_FUNC "%8.6" "v" COEFFS 0 1 0 0 0 1 /end COMPU_METHOD
/begin COMPU_METHOD SWC_FDC_type_CM_single_cnt "Q = V" RAT_FUNC "%8.6" "cnt" COEFFS 0 1 0 0 0 1 /end COMPU_METHOD
/begin COMPU_METHOD SWC_FDC_type_CM_single_raw32 "Q = V" RAT_FUNC "%8.6" "raw32" COEFFS 0 1 0 0 0 1 /end COMPU_METHOD
/begin COMPU_METHOD SWC_FDC_type_CM_boolean_flg "Q = V" RAT_FUNC "%1.0" "flg" COEFFS 0 1 0 0 0 1 /end COMPU_METHOD
/begin COMPU_METHOD SWC_FDC_type_CM_uint8_cnt "Q = V" RAT_FUNC "%3.0" "cnt" COEFFS 0 1 0 0 0 1 /end COMPU_METHOD
/begin COMPU_METHOD SWC_FDC_type_CM_uint8_kph "Q = V" RAT_FUNC "%3.0" "kph" COEFFS 0 1 0 0 0 1 /end COMPU_METHOD
/begin COMPU_METHOD SWC_FDC_type_CM_uint32_raw32 "Q = V" RAT_FUNC "%10.0" "raw32" COEFFS 0 1 0 0 0 1 /end COMPU_METHOD
/begin COMPU_METHOD SWC_FDC_type_CM_uint32_raw "Q = V" RAT_FUNC "%10.0" "raw" COEFFS 0 1 0 0 0 1 /end COMPU_METHOD
/begin COMPU_METHOD SWC_FDC_type_CM_single_G "Q = V" RAT_FUNC "%8.6" "G" COEFFS 0 1 0 0 0 1 /end COMPU_METHOD
/begin COMPU_METHOD SWC_FDC_type_CM_single_N "Q = V" RAT_FUNC "%8.6" "N" COEFFS 0 1 0 0 0 1 /end COMPU_METHOD
/begin COMPU_METHOD SWC_FDC_type_CM_uint8_raw "Q = V" RAT_FUNC "%3.0" "raw" COEFFS 0 1 0 0 0 1 /end COMPU_METHOD
/begin GROUP S1647_Front_torque_ramp_limtation_and_determination "SWC_FDC_type/run_SWC_FDC_RxTx_5ms_sys/APP/TQR/Determine Torque Request/TorqueArbitrament/TorqueSmooth/Front torque ramp limtation and determination" /begin SUB_GROUP S1667_SR_Latch S1667_SR_Latch1 S1667_Timer /end SUB_GROUP
 /begin REF_CHARACTERISTIC KTQR_FEDUTrqUpLimSW_flg KTQR_FShaftSpdDevTs_c KTQR_FShaftSpdTqCoeLimLow_c KTQR_FTimerTqCoeLimLow_c KTQR_RgnShaftSpdProtSW_flg KTQR_ShaftSpdDevTime_s KTQR_StartTimerShaftDev_rpm MTQR_FShaftSpdTqLimCoe_Y_c MTQR_FTimerTqLimCoe_Y_c /end REF_CHARACTERISTIC
 /begin REF_MEASUREMENT VTQR_ActFEDUTrqLowLim_Nm VTQR_ActFEDUTrqUpLim_Nm VTQR_ActFShaftSpdDev_rpm VTQR_CalFEDUTrqUpLim_Nm VTQR_CoorFEDUTrqUpLim_Nm VTQR_FShaftSpdTqLimCoe_c VTQR_FTimerTqLimCoe_c VTQR_FWheelShaftSpdDev_rpm VTQR_InitFShaftSpdTqLimCoe_c VTQR_InitFTimerTqLimCoe_c VTQR_LFWheelShaftSpd_rpm VTQR_RFWheelShaftSpd_rpm /end REF_MEASUREMENT
/end GROUP
/begin GROUP S1647_Front_wheel_first_order_filter_input_torque_command_determination "SWC_FDC_type/run_SWC_FDC_RxTx_5ms_sys/APP/TQR/Determine Torque Request/TorqueArbitrament/TorqueSmooth/Front wheel first order filter input torque command determination" /begin REF_MEASUREMENT VTQR_FrActRampTqDem_Nm VTQR_FrFirstOrderInpTq_Nm /end REF_MEASUREMENT /end GROUP
/begin GROUP S1647_Front_wheel_rate_limit_determination "SWC_FDC_type/run_SWC_FDC_RxTx_5ms_sys/APP/TQR/Determine Torque Request/TorqueArbitrament/TorqueSmooth/Front wheel rate limit determination"
 /begin SUB_GROUP S1669_Negative_Rate_limit_Determination S1669_Positive_Rate_limit_Determination S1669_VTQR_ECOFEDURateLimitDec_Nm S1669_VTQR_ECOFEDURateLimitInc_Nm S1669_VTQR_ESCAPEFEDURateLimitDec_Nm S1669_VTQR_ESCAPEFEDURateLimitInc_Nm S1669_VTQR_LHMFEDURateLimitDec_Nm S1669_VTQR_LHMFEDURateLimitInc_Nm S1669_VTQR_NORMALFEDURateLimitDec_Nm S1669_VTQR_NORMALFEDURateLimitInc_Nm S1669_VTQR_SNOWFEDURateLimitDec_Nm S1669_VTQR_SNOWFEDURateLimitInc_Nm S1669_VTQR_SPORTFEDURateLimitDec_Nm S1669_VTQR_SPORTFEDURateLimitInc_Nm S1669_VTQR_TCSFEDURateLimitDec_Nm S1669_VTQR_TCSFEDURateLimitInc_Nm /end SUB_GROUP
 /begin REF_CHARACTERISTIC KTQR_RegenTqLimitDecSW_flg MTQR_AltRDCActiveFEDUInc_Z_Nm MTQR_CreepFEDUTqDecSR_Z_Nm MTQR_CreepFEDUTqIncSR_Z_Nm MTQR_FrPreLoadTqDecSR_Z_Nm MTQR_FrPreLoadTqIncSR_Z_Nm MTQR_VMCFEDUTqDecSR_Z_Nm MTQR_VMCFEDUTqIncSR_Z_Nm /end REF_CHARACTERISTIC
 /begin REF_MEASUREMENT VTQR_CreepFEDUTqDecSR_Nm VTQR_CreepFEDUTqIncSR_Nm VTQR_FEDURateLimitDec_Nm VTQR_FEDURateLimitInc_Nm VTQR_FrDrModChangeReset_flg VTQR_FrPreLoadTqDecSR_Nm VTQR_FrPreLoadTqIncSR_Nm VTQR_FrRDCActRateLimitInc_flg VTQR_FrRateLimitDec_Nm VTQR_FrRateLimitInc_Nm VTQR_RDCActiveFEDUInc_Nm VTQR_VMCFEDUTqDecSR_Nm VTQR_VMCFEDUTqIncSR_Nm /end REF_MEASUREMENT
/end GROUP
/begin GROUP S1647_Limit "SWC_FDC_type/run_SWC_FDC_RxTx_5ms_sys/APP/TQR/Determine Torque Request/TorqueArbitrament/TorqueSmooth/Limit" /begin REF_MEASUREMENT VTQR_RampFEDUWhlTqReq_Nm /end REF_MEASUREMENT /end GROUP
/begin GROUP S1647_Limit2 "SWC_FDC_type/run_SWC_FDC_RxTx_5ms_sys/APP/TQR/Determine Torque Request/TorqueArbitrament/TorqueSmooth/Limit2" /begin REF_MEASUREMENT VTQR_RampREDUWhlTqReq_Nm /end REF_MEASUREMENT /end GROUP
/begin GROUP S1647_RateLimit "SWC_FDC_type/run_SWC_FDC_RxTx_5ms_sys/APP/TQR/Determine Torque Request/TorqueArbitrament/TorqueSmooth/RateLimit" /begin REF_MEASUREMENT VTQR_FEDUWhlTqReqSmooth_Nm /end REF_MEASUREMENT /end GROUP
/begin GROUP S1647_RateLimit1 "SWC_FDC_type/run_SWC_FDC_RxTx_5ms_sys/APP/TQR/Determine Torque Request/TorqueArbitrament/TorqueSmooth/RateLimit1" /begin REF_MEASUREMENT VTQR_REDUWhlTqReqSmooth_Nm /end REF_MEASUREMENT /end GROUP
/begin GROUP S1647_Rear_First_order_filter_input_tau_map_and_determination "SWC_FDC_type/run_SWC_FDC_RxTx_5ms_sys/APP/TQR/Determine Torque Request/TorqueArbitrament/TorqueSmooth/Rear First order filter input tau map and determination"
 /begin SUB_GROUP S1674_SR_Latch1 S1674_VTQR_ECOREDUTs_c S1674_VTQR_ESCAPEREDUTs_c S1674_VTQR_LHMREDUTs_c S1674_VTQR_NORMALREDUTs_c S1674_VTQR_SNOWREDUTs_c S1674_VTQR_SPORTREDUTs_c S1674_VTQR_TCSREDUTs_c /end SUB_GROUP
 /begin REF_CHARACTERISTIC MTQR_AltRDCActiveREDUTs_Z_c MTQR_CreepREDUTs_Z_c MTQR_REDUTIPOutTs_Y_c MTQR_VMCREDUTs_Z_c /end REF_CHARACTERISTIC
 /begin REF_MEASUREMENT VTQR_CreepREDUTs_c VTQR_RDCActiveREDUTs_c VTQR_REDUTIPOutTs_c VTQR_REDUTs_c VTQR_RrFirstOrderInpTs_c VTQR_RrRDCActiveTs_flg VTQR_VMCREDUTs_c /end REF_MEASUREMENT
/end GROUP
/begin GROUP S1647_Rear_Torque_zero_point_transfer_boundary_map "SWC_FDC_type/run_SWC_FDC_RxTx_5ms_sys/APP/TQR/Determine Torque Request/TorqueArbitrament/TorqueSmooth/Rear Torque zero point transfer boundary map"
 /begin SUB_GROUP S1675_EcoLow S1675_EcoUP S1675_NormalLow S1675_NormalUP S1675_SportLow S1675_SportUP /end SUB_GROUP
 /begin REF_MEASUREMENT VTQR_RrTqZeroTransLowBound_Nm VTQR_RrTqZeroTransUpBound_Nm /end REF_MEASUREMENT
/end GROUP
/begin GROUP S1647_Rear_Torque_zero_point_transfer_status_determination_ "SWC_FDC_type/run_SWC_FDC_RxTx_5ms_sys/APP/TQR/Determine Torque Request/TorqueArbitrament/TorqueSmooth/Rear Torque zero point transfer status determination " /begin REF_MEASUREMENT VTQR_RrTqZeroTrans_enum /end REF_MEASUREMENT /end GROUP
/begin GROUP S1647_Rear_torque_ramp_limtation_and_determination "SWC_FDC_type/run_SWC_FDC_RxTx_5ms_sys/APP/TQR/Determine Torque Request/TorqueArbitrament/TorqueSmooth/Rear torque ramp limtation and determination" /begin SUB_GROUP S1677_SR_Latch S1677_SR_Latch1 S1677_Timer /end SUB_GROUP
 /begin REF_CHARACTERISTIC KTQR_REDUTrqUpLimSW_flg KTQR_RShaftSpdDevTs_c KTQR_RShaftSpdTqCoeLimLow_c KTQR_RTimerTqCoeLimLow_c KTQR_RgnShaftSpdProtSW_flg KTQR_ShaftSpdDevTime_s KTQR_StartTimerShaftDev_rpm MTQR_RShaftSpdTqLimCoe_Y_c MTQR_RTimerTqLimCoe_Y_c /end REF_CHARACTERISTIC
 /begin REF_MEASUREMENT VTQR_ActREDUTrqLowLim_Nm VTQR_ActREDUTrqUpLim_Nm VTQR_ActRShaftSpdDev_rpm VTQR_CalREDUTrqUpLim_Nm VTQR_CoorREDUTrqUpLim_Nm VTQR_InitRShaftSpdTqLimCoe_c VTQR_InitRTimerTqLimCoe_c VTQR_LRWheelShaftSpd_rpm VTQR_RRWheelShaftSpd_rpm VTQR_RShaftSpdTqLimCoe_c VTQR_RTimerTqLimCoe_c VTQR_RWheelShaftSpdDev_rpm /end REF_MEASUREMENT
/end GROUP
/begin GROUP S1647_Rear_wheel_first_order_filter_input_torque_command_determination "SWC_FDC_type/run_SWC_FDC_RxTx_5ms_sys/APP/TQR/Determine Torque Request/TorqueArbitrament/TorqueSmooth/Rear wheel first order filter input torque command determination" /begin REF_MEASUREMENT VTQR_RrActRampTqDem_Nm VTQR_RrFirstOrderInpTq_Nm /end REF_MEASUREMENT /end GROUP
/begin GROUP S1647_Rear_wheel_rate_limit_determination "SWC_FDC_type/run_SWC_FDC_RxTx_5ms_sys/APP/TQR/Determine Torque Request/TorqueArbitrament/TorqueSmooth/Rear wheel rate limit determination"
 /begin SUB_GROUP S1679_Negative_Rate_limit_Determination S1679_Positive_Rate_limit_Determination S1679_VTQR_ECOREDURateLimitDec_Nm S1679_VTQR_ECOREDURateLimitInc_Nm S1679_VTQR_ESCAPEREDURateLimitDec_Nm S1679_VTQR_ESCAPEREDURateLimitInc_Nm S1679_VTQR_LHMREDURateLimitDec_Nm S1679_VTQR_LHMREDURateLimitInc_Nm S1679_VTQR_NORMALREDURateLimitDec_Nm S1679_VTQR_NORMALREDURateLimitInc_Nm S1679_VTQR_SNOWREDURateLimitDec_Nm S1679_VTQR_SNOWREDURateLimitInc_Nm S1679_VTQR_SPORTREDURateLimitDec_Nm S1679_VTQR_SPORTREDURateLimitInc_Nm S1679_VTQR_TCSREDURateLimitDec_Nm S1679_VTQR_TCSREDURateLimitInc_Nm /end SUB_GROUP
 /begin REF_CHARACTERISTIC KTQR_ACCHoldPdovrdGrade_Deg KTQR_ACCHoldPdovrdInc_Nm KTQR_ACCHoldPdovrdSW_flg KTQR_ACCHoldPdovrdVeh_kph KTQR_RegenTqLimitDecSW_flg MTQR_AltRDCActiveREDUInc_Z_Nm MTQR_CreepREDUTqDecSR_Z_Nm MTQR_CreepREDUTqIncSR_Z_Nm MTQR_RrPreLoadTqDecSR_Z_Nm MTQR_RrPreLoadTqIncSR_Z_Nm MTQR_VMCREDUTqDecSR_Z_Nm MTQR_VMCREDUTqIncSR_Z_Nm /end REF_CHARACTERISTIC
 /begin REF_MEASUREMENT VTQR_ACCHoldPdovrdInc_flg VTQR_CreepREDUTqDecSR_Nm VTQR_CreepREDUTqIncSR_Nm VTQR_OriREDURateLimitInc_Nm VTQR_RDCActiveREDUInc_Nm VTQR_REDURateLimitDec_Nm VTQR_REDURateLimitInc_Nm VTQR_RrDrModChangeReset_flg VTQR_RrPreLoadTqDecSR_Nm VTQR_RrPreLoadTqIncSR_Nm VTQR_RrRDCActRateLimitInc_flg VTQR_RrRateLimitDec_Nm VTQR_RrRateLimitInc_Nm VTQR_VMCREDUTqDecSR_Nm VTQR_VMCREDUTqIncSR_Nm /end REF_MEASUREMENT
/end GROUP
/begin GROUP S1930_FirstOrderFilter6 "SWC_FDC_type/run_SWC_FDC_RxTx_5ms_sys/APP/VMC/VMC/ACC_Function/ACC Torque Source Determination/FirstOrderFilter6" /begin REF_MEASUREMENT VVMC_ESCLongAccelFilt_Gps /end REF_MEASUREMENT /end GROUP
/begin GROUP S1930_SR_Latch "SWC_FDC_type/run_SWC_FDC_RxTx_5ms_sys/APP/VMC/VMC/ACC_Function/ACC Torque Source Determination/SR_Latch" /begin REF_MEASUREMENT VVMC_ACCPedalTqEnOvrd_flg /end REF_MEASUREMENT /end GROUP
/begin GROUP S1930_SR_Latch1 "SWC_FDC_type/run_SWC_FDC_RxTx_5ms_sys/APP/VMC/VMC/ACC_Function/ACC Torque Source Determination/SR_Latch1" /begin REF_MEASUREMENT VVMC_ACCOvrdBackDrTq_flg /end REF_MEASUREMENT /end GROUP
/begin GROUP S1930_SR_Latch2 "SWC_FDC_type/run_SWC_FDC_RxTx_5ms_sys/APP/VMC/VMC/ACC_Function/ACC Torque Source Determination/SR_Latch2" /begin REF_MEASUREMENT VVMC_ACCActivePedalOn_flg /end REF_MEASUREMENT /end GROUP
/begin GROUP S1930_Triggered_Subsystem2 "SWC_FDC_type/run_SWC_FDC_RxTx_5ms_sys/APP/VMC/VMC/ACC_Function/ACC Torque Source Determination/Triggered Subsystem2" /begin REF_MEASUREMENT VVMC_ACCOvrdMemTq_Nm /end REF_MEASUREMENT /end GROUP
/begin GROUP S1932_SR_Latch "SWC_FDC_type/run_SWC_FDC_RxTx_5ms_sys/APP/VMC/VMC/ACC_Function/VVMC_ADASWhlTqCalVehHoldStandstill_Nm/SR_Latch" /begin REF_MEASUREMENT VVMC_HillUpHoldReqEn_flg /end REF_MEASUREMENT /end GROUP
/begin GROUP S1932_SR_Latch1 "SWC_FDC_type/run_SWC_FDC_RxTx_5ms_sys/APP/VMC/VMC/ACC_Function/VVMC_ADASWhlTqCalVehHoldStandstill_Nm/SR_Latch1" /begin REF_MEASUREMENT VVMC_HillUpESCStaEn_flg /end REF_MEASUREMENT /end GROUP
/begin GROUP S1932_SR_Latch2 "SWC_FDC_type/run_SWC_FDC_RxTx_5ms_sys/APP/VMC/VMC/ACC_Function/VVMC_ADASWhlTqCalVehHoldStandstill_Nm/SR_Latch2" /begin REF_MEASUREMENT VVMC_HoldNoMCP_flg /end REF_MEASUREMENT /end GROUP
/begin GROUP S1932_SR_Latch3 "SWC_FDC_type/run_SWC_FDC_RxTx_5ms_sys/APP/VMC/VMC/ACC_Function/VVMC_ADASWhlTqCalVehHoldStandstill_Nm/SR_Latch3" /begin REF_MEASUREMENT VVMC_RgnProhibited_flg /end REF_MEASUREMENT /end GROUP
/begin GROUP S1932_SR_Latch4 "SWC_FDC_type/run_SWC_FDC_RxTx_5ms_sys/APP/VMC/VMC/ACC_Function/VVMC_ADASWhlTqCalVehHoldStandstill_Nm/SR_Latch4" /begin REF_MEASUREMENT VVMC_ZeroRgnTqSpdCtrl_flg /end REF_MEASUREMENT /end GROUP
/begin GROUP S1932_SR_Latch5 "SWC_FDC_type/run_SWC_FDC_RxTx_5ms_sys/APP/VMC/VMC/ACC_Function/VVMC_ADASWhlTqCalVehHoldStandstill_Nm/SR_Latch5" /begin REF_MEASUREMENT VVMC_ACCLowSpdFollowESCTq_flg /end REF_MEASUREMENT /end GROUP
/begin GROUP S1932_SR_Latch6 "SWC_FDC_type/run_SWC_FDC_RxTx_5ms_sys/APP/VMC/VMC/ACC_Function/VVMC_ADASWhlTqCalVehHoldStandstill_Nm/SR_Latch6" /begin REF_MEASUREMENT VVMC_ACCLowSpdTqCtrl_flg /end REF_MEASUREMENT /end GROUP
/begin GROUP S1932_Triggered_Subsystem1 "SWC_FDC_type/run_SWC_FDC_RxTx_5ms_sys/APP/VMC/VMC/ACC_Function/VVMC_ADASWhlTqCalVehHoldStandstill_Nm/Triggered Subsystem1" /begin REF_MEASUREMENT VVMC_ACCLowSpdCtrlEnSpd_kph VVMC_ACCLowSpdTqLimit_Nm /end REF_MEASUREMENT /end GROUP
/begin GROUP S1932_Triggered_Subsystem4 "SWC_FDC_type/run_SWC_FDC_RxTx_5ms_sys/APP/VMC/VMC/ACC_Function/VVMC_ADASWhlTqCalVehHoldStandstill_Nm/Triggered Subsystem4" /begin REF_MEASUREMENT VVMC_ZeroRgnTqSpdCtrlTq_Nm /end REF_MEASUREMENT /end GROUP
/begin GROUP S1973_DelayEnable "SWC_FDC_type/run_SWC_FDC_RxTx_5ms_sys/APP/VMC/VMC/APS function/CAAS HandShake/DelayEnable" /begin REF_MEASUREMENT VVMC_CAASCtrlAvail_flg /end REF_MEASUREMENT /end GROUP
/begin GROUP S1975_DelayEnable "SWC_FDC_type/run_SWC_FDC_RxTx_5ms_sys/APP/VMC/VMC/APS function/Hand Shake/DelayEnable" /begin REF_MEASUREMENT VVMC_APSTqCtrlAllow_flg /end REF_MEASUREMENT /end GROUP
/begin GROUP S1975_DelayEnable1 "SWC_FDC_type/run_SWC_FDC_RxTx_5ms_sys/APP/VMC/VMC/APS function/Hand Shake/DelayEnable1" /begin REF_MEASUREMENT VVMC_APSShiftCtrlAllow_flg /end REF_MEASUREMENT /end GROUP
/begin GROUP S1975_DelayEnable2 "SWC_FDC_type/run_SWC_FDC_RxTx_5ms_sys/APP/VMC/VMC/APS function/Hand Shake/DelayEnable2" /begin REF_MEASUREMENT VVMC_APSDoorCtrlAllow_flg /end REF_MEASUREMENT /end GROUP
/begin GROUP S1976_Signal_Determination_VINP_APSDecReqAtest_flg "SWC_FDC_type/run_SWC_FDC_RxTx_5ms_sys/APP/VMC/VMC/APS function/Signal Rounting1/Signal Determination VINP_APSDecReqAtest_flg" /begin REF_CHARACTERISTIC KVMC_APSDevelopeSW_flg /end REF_CHARACTERISTIC /begin REF_MEASUREMENT VVMC_APSDecReqA_flg /end REF_MEASUREMENT /end GROUP
/begin GROUP S1976_Signal_Determination_VINP_APSDecReqtest_mps2 "SWC_FDC_type/run_SWC_FDC_RxTx_5ms_sys/APP/VMC/VMC/APS function/Signal Rounting1/Signal Determination VINP_APSDecReqtest_mps2" /begin REF_CHARACTERISTIC KVMC_APSDevelopeSW_flg /end REF_CHARACTERISTIC /begin REF_MEASUREMENT VVMC_APSDecReq_mps2 /end REF_MEASUREMENT /end GROUP
/begin GROUP S1976_Signal_Determination_VINP_APSReqtest_enum "SWC_FDC_type/run_SWC_FDC_RxTx_5ms_sys/APP/VMC/VMC/APS function/Signal Rounting1/Signal Determination VINP_APSReqtest_enum" /begin REF_CHARACTERISTIC KVMC_APSDevelopeSW_flg /end REF_CHARACTERISTIC /begin REF_MEASUREMENT VVMC_APSReq_enum /end REF_MEASUREMENT /end GROUP
/begin GROUP S1976_Signal_Determination_VINP_APSStaSystemtest_enum "SWC_FDC_type/run_SWC_FDC_RxTx_5ms_sys/APP/VMC/VMC/APS function/Signal Rounting1/Signal Determination VINP_APSStaSystemtest_enum" /begin REF_CHARACTERISTIC KVMC_APSDevelopeSW_flg KVMC_APSStaSystemOvrd_flg /end REF_CHARACTERISTIC /begin REF_MEASUREMENT VVMC_APSStaSys_enum /end REF_MEASUREMENT /end GROUP
/begin GROUP S1991_SR_Latch "SWC_FDC_type/run_SWC_FDC_RxTx_5ms_sys/APP/VMC/VMC/CruiseControlFunction/CCTorqueSourceDetermination/SR_Latch" /begin REF_MEASUREMENT VVMC_CCPedalTqEnOvrd_flg /end REF_MEASUREMENT /end GROUP
/begin GROUP S2006_FirstOrderFilter1 "SWC_FDC_type/run_SWC_FDC_RxTx_5ms_sys/APP/VMC/VMC/IMU/IMU sensing result /FirstOrderFilter1" /begin REF_MEASUREMENT VVMC_CalibratedGyroX_Dps /end REF_MEASUREMENT /end GROUP
/begin GROUP S2006_FirstOrderFilter2 "SWC_FDC_type/run_SWC_FDC_RxTx_5ms_sys/APP/VMC/VMC/IMU/IMU sensing result /FirstOrderFilter2" /begin REF_MEASUREMENT VVMC_CalibratedGyroZ_Dps /end REF_MEASUREMENT /end GROUP
/begin GROUP S2006_FirstOrderFilter3 "SWC_FDC_type/run_SWC_FDC_RxTx_5ms_sys/APP/VMC/VMC/IMU/IMU sensing result /FirstOrderFilter3" /begin REF_MEASUREMENT VVMC_CalibratedAccZ_G /end REF_MEASUREMENT /end GROUP
/begin GROUP S2006_FirstOrderFilter4 "SWC_FDC_type/run_SWC_FDC_RxTx_5ms_sys/APP/VMC/VMC/IMU/IMU sensing result /FirstOrderFilter4" /begin REF_MEASUREMENT VVMC_CalibratedAccY_G /end REF_MEASUREMENT /end GROUP
/begin GROUP S2006_FirstOrderFilter5 "SWC_FDC_type/run_SWC_FDC_RxTx_5ms_sys/APP/VMC/VMC/IMU/IMU sensing result /FirstOrderFilter5" /begin REF_MEASUREMENT VVMC_CalibratedGyroY_Dps /end REF_MEASUREMENT /end GROUP
/begin GROUP S2006_FirstOrderFilter6 "SWC_FDC_type/run_SWC_FDC_RxTx_5ms_sys/APP/VMC/VMC/IMU/IMU sensing result /FirstOrderFilter6" /begin REF_MEASUREMENT VVMC_CalibratedAccX_G /end REF_MEASUREMENT /end GROUP
/begin GROUP S2026_SR_Latch5 "SWC_FDC_type/run_SWC_FDC_RxTx_5ms_sys/APP/VMC/VMC/MSA function/MSADemandTorqueCalculation/SR_Latch5" /begin REF_MEASUREMENT VVMC_MSATqDown_flg /end REF_MEASUREMENT /end GROUP
/begin GROUP S2026_Triggered_Subsystem "SWC_FDC_type/run_SWC_FDC_RxTx_5ms_sys/APP/VMC/VMC/MSA function/MSADemandTorqueCalculation/Triggered Subsystem" /begin REF_MEASUREMENT VVMC_MSATqDownEnTq_Nm /end REF_MEASUREMENT /end GROUP
/begin GROUP S2027_SR_Latch1 "SWC_FDC_type/run_SWC_FDC_RxTx_5ms_sys/APP/VMC/VMC/MSA function/MSATorqueSourceDetermination/SR_Latch1" /begin REF_MEASUREMENT VVMC_MSAOvrdAllow_flg /end REF_MEASUREMENT /end GROUP
/begin GROUP S2027_Triggered_Subsystem2 "SWC_FDC_type/run_SWC_FDC_RxTx_5ms_sys/APP/VMC/VMC/MSA function/MSATorqueSourceDetermination/Triggered Subsystem2" /begin REF_MEASUREMENT VVMC_MSAOvrdEnTq_Nm /end REF_MEASUREMENT /end GROUP
/begin GROUP S2060_DelayEnable1 "SWC_FDC_type/run_SWC_FDC_RxTx_5ms_sys/APP/VMC/VMC/RDC Determination/RWD/DelayEnable1" /begin REF_MEASUREMENT VVMC_RDCDetectEn_flg /end REF_MEASUREMENT /end GROUP
/begin GROUP S2060_DelayEnable2 "SWC_FDC_type/run_SWC_FDC_RxTx_5ms_sys/APP/VMC/VMC/RDC Determination/RWD/DelayEnable2" /begin REF_MEASUREMENT VVMC_AltRDCRec_flg /end REF_MEASUREMENT /end GROUP
/begin GROUP S2060_SR_Latch5 "SWC_FDC_type/run_SWC_FDC_RxTx_5ms_sys/APP/VMC/VMC/RDC Determination/RWD/SR_Latch5" /begin REF_MEASUREMENT VVMC_ESCActive_flg /end REF_MEASUREMENT /end GROUP
/begin GROUP S2069_SR_Latch1 "SWC_FDC_type/run_SWC_FDC_RxTx_5ms_sys/APP/VMC/VMC/SPD2ACC/VVMC_DISReqAcc_mps2/SR_Latch1" /begin REF_MEASUREMENT VVMC_VehHoldDecCtrlCalSW2_flg /end REF_MEASUREMENT /end GROUP
/begin GROUP S2069_SR_Latch10 "SWC_FDC_type/run_SWC_FDC_RxTx_5ms_sys/APP/VMC/VMC/SPD2ACC/VVMC_DISReqAcc_mps2/SR_Latch10" /begin REF_MEASUREMENT VVMC_HoldDelayAllow_flg /end REF_MEASUREMENT /end GROUP
/begin GROUP S2069_SR_Latch11 "SWC_FDC_type/run_SWC_FDC_RxTx_5ms_sys/APP/VMC/VMC/SPD2ACC/VVMC_DISReqAcc_mps2/SR_Latch11" /begin REF_MEASUREMENT VVMC_ACCShutOffHold_flg /end REF_MEASUREMENT /end GROUP
/begin GROUP S2069_SR_Latch12 "SWC_FDC_type/run_SWC_FDC_RxTx_5ms_sys/APP/VMC/VMC/SPD2ACC/VVMC_DISReqAcc_mps2/SR_Latch12" /begin REF_MEASUREMENT VVMC_VehHoldDecCtrlHEnd_flg /end REF_MEASUREMENT /end GROUP
/begin GROUP S2069_SR_Latch13 "SWC_FDC_type/run_SWC_FDC_RxTx_5ms_sys/APP/VMC/VMC/SPD2ACC/VVMC_DISReqAcc_mps2/SR_Latch13" /begin REF_MEASUREMENT VVMC_AccelTurnHold_flg /end REF_MEASUREMENT /end GROUP
/begin GROUP S2069_SR_Latch14 "SWC_FDC_type/run_SWC_FDC_RxTx_5ms_sys/APP/VMC/VMC/SPD2ACC/VVMC_DISReqAcc_mps2/SR_Latch14" /begin REF_MEASUREMENT VVMC_OVRD2ActRampActive_flg /end REF_MEASUREMENT /end GROUP
/begin GROUP S2069_SR_Latch15 "SWC_FDC_type/run_SWC_FDC_RxTx_5ms_sys/APP/VMC/VMC/SPD2ACC/VVMC_DISReqAcc_mps2/SR_Latch15" /begin REF_MEASUREMENT VVMC_VehHoldHTimeNoMCPDet_flg /end REF_MEASUREMENT /end GROUP
/begin GROUP S2069_SR_Latch17 "SWC_FDC_type/run_SWC_FDC_RxTx_5ms_sys/APP/VMC/VMC/SPD2ACC/VVMC_DISReqAcc_mps2/SR_Latch17" /begin REF_MEASUREMENT VVMC_VehHoldDecCtrlBEnd_flg /end REF_MEASUREMENT /end GROUP
/begin GROUP S2069_SR_Latch2 "SWC_FDC_type/run_SWC_FDC_RxTx_5ms_sys/APP/VMC/VMC/SPD2ACC/VVMC_DISReqAcc_mps2/SR_Latch2" /begin REF_MEASUREMENT VVMC_VehHoldMCPPass_flg /end REF_MEASUREMENT /end GROUP
/begin GROUP S2069_SR_Latch3 "SWC_FDC_type/run_SWC_FDC_RxTx_5ms_sys/APP/VMC/VMC/SPD2ACC/VVMC_DISReqAcc_mps2/SR_Latch3" /begin REF_MEASUREMENT VVMC_ReqBrkJoin_flg /end REF_MEASUREMENT /end GROUP
/begin GROUP S2069_SR_Latch4 "SWC_FDC_type/run_SWC_FDC_RxTx_5ms_sys/APP/VMC/VMC/SPD2ACC/VVMC_DISReqAcc_mps2/SR_Latch4" /begin REF_MEASUREMENT VVMC_ACCSpdCtrl_flg /end REF_MEASUREMENT /end GROUP
/begin GROUP S2069_SR_Latch5 "SWC_FDC_type/run_SWC_FDC_RxTx_5ms_sys/APP/VMC/VMC/SPD2ACC/VVMC_DISReqAcc_mps2/SR_Latch5" /begin REF_MEASUREMENT VVMC_ZeroSpdHoldAllow_flg /end REF_MEASUREMENT /end GROUP
/begin GROUP S2069_SR_Latch9 "SWC_FDC_type/run_SWC_FDC_RxTx_5ms_sys/APP/VMC/VMC/SPD2ACC/VVMC_DISReqAcc_mps2/SR_Latch9" /begin REF_MEASUREMENT VVMC_ReqBrkJoinSRActive_flg /end REF_MEASUREMENT /end GROUP
/begin GROUP S2069_Triggered_Subsystem4 "SWC_FDC_type/run_SWC_FDC_RxTx_5ms_sys/APP/VMC/VMC/SPD2ACC/VVMC_DISReqAcc_mps2/Triggered Subsystem4" /begin REF_MEASUREMENT VVMC_ACCReqSpdMemory_kph /end REF_MEASUREMENT /end GROUP
/begin GROUP S2069_Triggered_Subsystem6 "SWC_FDC_type/run_SWC_FDC_RxTx_5ms_sys/APP/VMC/VMC/SPD2ACC/VVMC_DISReqAcc_mps2/Triggered Subsystem6" /begin REF_MEASUREMENT VVMC_VehHoldEnActAccel_mps2 VVMC_VehHoldEnSpd_kph /end REF_MEASUREMENT /end GROUP
/begin GROUP S2124_FrontRearSlipRatio "SWC_FDC_type/run_SWC_FDC_RxTx_5ms_sys/APP/VMC/VMC/SafetyControl/SafetyControlJudgement/FrontRearSlipRatio" /begin REF_CHARACTERISTIC KVMC_FrontRearSlipRatioTHR_kph /end REF_CHARACTERISTIC /end GROUP
/begin GROUP S2124_LateralAccelerationControl "SWC_FDC_type/run_SWC_FDC_RxTx_5ms_sys/APP/VMC/VMC/SafetyControl/SafetyControlJudgement/LateralAccelerationControl" /begin REF_CHARACTERISTIC KVMC_LatAccCtrlTHR_Gps /end REF_CHARACTERISTIC /end GROUP
/begin GROUP S2124_RearWheelSlipRatio "SWC_FDC_type/run_SWC_FDC_RxTx_5ms_sys/APP/VMC/VMC/SafetyControl/SafetyControlJudgement/RearWheelSlipRatio" /begin REF_CHARACTERISTIC KVMC_RearWhlSlipRatioTHR_kph /end REF_CHARACTERISTIC /end GROUP
/begin GROUP S2124_SafetyControlJudgement "SWC_FDC_type/run_SWC_FDC_RxTx_5ms_sys/APP/VMC/VMC/SafetyControl/SafetyControlJudgement/SafetyControlJudgement" /begin REF_CHARACTERISTIC KVMC_SafetyCtrlForACCSW_flg /end REF_CHARACTERISTIC /end GROUP
/begin GROUP S2124_SingleWheelSlipRatio "SWC_FDC_type/run_SWC_FDC_RxTx_5ms_sys/APP/VMC/VMC/SafetyControl/SafetyControlJudgement/SingleWheelSlipRatio" /begin REF_CHARACTERISTIC KVMC_SingleWhlSlipRatioTHR_kph /end REF_CHARACTERISTIC /end GROUP
/begin GROUP S2147_Determination "SWC_FDC_type/run_SWC_FDC_RxTx_5ms_sys/APP/VMC/VMC/Slide Rate  Calculation/4Wheel Calculation/Determination"
 /begin REF_CHARACTERISTIC KVMC_PreVehSpdCalSW_flg KVMC_PreVehSpdNum_c KVMC_PreVehSpdSource_enum KVMC_PredVehSpdLimit_mps /end REF_CHARACTERISTIC
 /begin REF_MEASUREMENT VVMC_4WhlSpdSlideRate_pct VVMC_AllWhlSkid_flg VVMC_CalPredictVehSpd_mps VVMC_DeltaVehSpd_mps VVMC_LastPredictVehSpd_mps VVMC_Max4WhlPreVehSpd_kph VVMC_Max4WhlSpdSlideRate_pct VVMC_Min4WhlPreVehSpd_kph VVMC_Min4WhlSpdSlideRate_pct VVMC_PredictVehSpd1_kph VVMC_PredictVehSpd2_kph VVMC_PredictVehSpd3_kph VVMC_PredictVehSpd_kph /end REF_MEASUREMENT
/end GROUP
/begin GROUP S2147_LF_Wheel "SWC_FDC_type/run_SWC_FDC_RxTx_5ms_sys/APP/VMC/VMC/Slide Rate  Calculation/4Wheel Calculation/LF Wheel" /begin SUB_GROUP S2152_FirstOrderFilter S2152_SR_Latch /end SUB_GROUP
 /begin REF_CHARACTERISTIC KVMC_4WheelEnSkidDetSpd_kph KVMC_LFWhlSkidReset_flg KVMC_PreVehSpdCalSW_flg KVMC_PredVehSpdLimit_mps KVMC_SkidRecVehSpdDev_kph KVMC_WheelSkidAccDev_Gps KVMC_WhlSpdCalAccTs_c /end REF_CHARACTERISTIC
 /begin REF_MEASUREMENT VVMC_LF4WhlSpdSlideRate_pct VVMC_LFCal4WhlSpdSlideRate_pct VVMC_LFCalPreVehSpd_mps VVMC_LFDeltaVehSpd_mps VVMC_LFLastPreVehSpd_mps VVMC_LFPreVehSpd_kph VVMC_LFWhlSkidReset_flg /end REF_MEASUREMENT
/end GROUP
/begin GROUP S2147_LR_Wheel "SWC_FDC_type/run_SWC_FDC_RxTx_5ms_sys/APP/VMC/VMC/Slide Rate  Calculation/4Wheel Calculation/LR Wheel" /begin SUB_GROUP S2153_FirstOrderFilter2 S2153_SR_Latch2 /end SUB_GROUP
 /begin REF_CHARACTERISTIC KVMC_4WheelEnSkidDetSpd_kph KVMC_LRWhlSkidReset_flg KVMC_PreVehSpdCalSW_flg KVMC_PredVehSpdLimit_mps KVMC_SkidRecVehSpdDev_kph KVMC_WheelSkidAccDev_Gps KVMC_WhlSpdCalAccTs_c /end REF_CHARACTERISTIC
 /begin REF_MEASUREMENT VVMC_LR4WhlSpdSlideRate_pct VVMC_LRCal4WhlSpdSlideRate_pct VVMC_LRCalPreVehSpd_mps VVMC_LRDeltaVehSpd_mps VVMC_LRLastPreVehSpd_mps VVMC_LRPreVehSpd_kph VVMC_LRWhlSkidReset_flg /end REF_MEASUREMENT
/end GROUP
/begin GROUP S2147_RF_Wheel "SWC_FDC_type/run_SWC_FDC_RxTx_5ms_sys/APP/VMC/VMC/Slide Rate  Calculation/4Wheel Calculation/RF Wheel" /begin SUB_GROUP S2154_FirstOrderFilter1 S2154_SR_Latch1 /end SUB_GROUP
 /begin REF_CHARACTERISTIC KVMC_4WheelEnSkidDetSpd_kph KVMC_PreVehSpdCalSW_flg KVMC_PredVehSpdLimit_mps KVMC_RFWhlSkidReset_flg KVMC_SkidRecVehSpdDev_kph KVMC_WheelSkidAccDev_Gps KVMC_WhlSpdCalAccTs_c /end REF_CHARACTERISTIC
 /begin REF_MEASUREMENT VVMC_RF4WhlSpdSlideRate_pct VVMC_RFCal4WhlSpdSlideRate_pct VVMC_RFCalPreVehSpd_mps VVMC_RFDeltaVehSpd_mps VVMC_RFLastPreVehSpd_mps VVMC_RFPreVehSpd_kph VVMC_RFWhlSkidReset_flg /end REF_MEASUREMENT
/end GROUP
/begin GROUP S2147_RR_Wheel "SWC_FDC_type/run_SWC_FDC_RxTx_5ms_sys/APP/VMC/VMC/Slide Rate  Calculation/4Wheel Calculation/RR Wheel" /begin SUB_GROUP S2155_FirstOrderFilter3 S2155_SR_Latch3 /end SUB_GROUP
 /begin REF_CHARACTERISTIC KVMC_4WheelEnSkidDetSpd_kph KVMC_PreVehSpdCalSW_flg KVMC_PredVehSpdLimit_mps KVMC_RRWhlSkidReset_flg KVMC_SkidRecVehSpdDev_kph KVMC_WheelSkidAccDev_Gps KVMC_WhlSpdCalAccTs_c /end REF_CHARACTERISTIC
 /begin REF_MEASUREMENT VVMC_RR4WhlSpdSlideRate_pct VVMC_RRCal4WhlSpdSlideRate_pct VVMC_RRCalPreVehSpd_mps VVMC_RRDeltaVehSpd_mps VVMC_RRLastPreVehSpd_mps VVMC_RRPreVehSpd_kph VVMC_RRWhlSkidReset_flg /end REF_MEASUREMENT
/end GROUP
/begin GROUP S2149_DelayEnable "SWC_FDC_type/run_SWC_FDC_RxTx_5ms_sys/APP/VMC/VMC/Slide Rate  Calculation/Coordination/DelayEnable" /begin REF_MEASUREMENT VVMC_VehSpdPredSkid_flg /end REF_MEASUREMENT /end GROUP
/begin GROUP S2149_FirstOrderFilter "SWC_FDC_type/run_SWC_FDC_RxTx_5ms_sys/APP/VMC/VMC/Slide Rate  Calculation/Coordination/FirstOrderFilter" /begin REF_MEASUREMENT VVMC_IntMaxSlideRate_pct /end REF_MEASUREMENT /end GROUP
/begin GROUP S2149_FirstOrderFilter1 "SWC_FDC_type/run_SWC_FDC_RxTx_5ms_sys/APP/VMC/VMC/Slide Rate  Calculation/Coordination/FirstOrderFilter1" /begin REF_MEASUREMENT VVMC_ActLFSlideRate_pct /end REF_MEASUREMENT /end GROUP
/begin GROUP S2149_FirstOrderFilter2 "SWC_FDC_type/run_SWC_FDC_RxTx_5ms_sys/APP/VMC/VMC/Slide Rate  Calculation/Coordination/FirstOrderFilter2" /begin REF_MEASUREMENT VVMC_ActRFSlideRate_pct /end REF_MEASUREMENT /end GROUP
/begin GROUP S2149_FirstOrderFilter3 "SWC_FDC_type/run_SWC_FDC_RxTx_5ms_sys/APP/VMC/VMC/Slide Rate  Calculation/Coordination/FirstOrderFilter3" /begin REF_MEASUREMENT VVMC_ActLRSlideRate_pct /end REF_MEASUREMENT /end GROUP
/begin GROUP S2149_FirstOrderFilter4 "SWC_FDC_type/run_SWC_FDC_RxTx_5ms_sys/APP/VMC/VMC/Slide Rate  Calculation/Coordination/FirstOrderFilter4" /begin REF_MEASUREMENT VVMC_ActRRSlideRate_pct /end REF_MEASUREMENT /end GROUP
/begin GROUP S1057_Doublecheck "SWC_FDC_type/run_SWC_FDC_RxTx_5ms_sys/APP/TPM/TPMS/TPMS/Learn/AutoLocation/Doublecheck"
 /begin REF_MEASUREMENT VTPM_Chkfin_flg VTPM_LFID_raw VTPM_LRID_raw VTPM_RFID_raw VTPM_RRID_raw /end REF_MEASUREMENT
/end GROUP
/begin GROUP S1057_IDIdentify "SWC_FDC_type/run_SWC_FDC_RxTx_5ms_sys/APP/TPM/TPMS/TPMS/Learn/AutoLocation/IDIdentify"
 /begin SUB_GROUP S1066_Acceptancerate S1066_Subsystem1 S1066_Subsystem2 S1066_Subsystem3 S1066_Subsystem7 /end SUB_GROUP
 /begin REF_MEASUREMENT VTPM_ALFin_flg VTPM_C1_cnt VTPM_C2_cnt VTPM_C3_cnt VTPM_C4_cnt VTPM_FAT_flg VTPM_IDLock_flg VTPM_Locdonetimes_cnt VTPM_SetIDLoc_flg VTPM_unlearnSfailvalid_enum VTPM_unlearnSfali_flg /end REF_MEASUREMENT
/end GROUP
/begin GROUP S1057_IDtrans "SWC_FDC_type/run_SWC_FDC_RxTx_5ms_sys/APP/TPM/TPMS/TPMS/Learn/AutoLocation/IDtrans"
 /begin REF_MEASUREMENT VTPM_S1ID_raw32 VTPM_S1L_enum VTPM_S2ID_raw32 VTPM_S2L_enum VTPM_S3ID_raw32 VTPM_S3L_enum VTPM_S4ID_raw32 VTPM_S4L_enum /end REF_MEASUREMENT
/end GROUP
/begin GROUP S1057_Subsystem "SWC_FDC_type/run_SWC_FDC_RxTx_5ms_sys/APP/TPM/TPMS/TPMS/Learn/AutoLocation/Subsystem"
 /begin REF_MEASUREMENT VTPM_FlashIDvalid_enum VTPM_FlashS1ID_raw VTPM_FlashS2ID_raw VTPM_FlashS3ID_raw VTPM_FlashS4ID_raw /end REF_MEASUREMENT
/end GROUP
/begin GROUP S1057_Subsystem1 "SWC_FDC_type/run_SWC_FDC_RxTx_5ms_sys/APP/TPM/TPMS/TPMS/Learn/AutoLocation/Subsystem1" /begin SUB_GROUP S1069_Subsystem /end SUB_GROUP
 /begin REF_MEASUREMENT VTPM_LProgress_enum VTPM_ManualID1Temp_C VTPM_ManualID1_raw VTPM_ManualID1pressure_raw VTPM_ManualID2Temp_C VTPM_ManualID2_raw VTPM_ManualID2pressure_raw VTPM_ManualID3Temp_C VTPM_ManualID3_raw VTPM_ManualID3pressure_raw VTPM_ManualID4Temp_C VTPM_ManualID4_raw VTPM_ManualID4pressure_raw VTPM_TPMSTLCmd_flg VTPM_TPMSmanualDone_flg VTPM_WritingCnt_enum /end REF_MEASUREMENT
/end GROUP
/begin GROUP S1057_WheelPosition "SWC_FDC_type/run_SWC_FDC_RxTx_5ms_sys/APP/TPM/TPMS/TPMS/Learn/AutoLocation/WheelPosition"
 /begin SUB_GROUP S1070_Subsystem S1070_Subsystem1 S1070_Subsystem2 S1070_Subsystem3 /end SUB_GROUP
/end GROUP
/begin GROUP S1204_LFTHighWarn "SWC_FDC_type/run_SWC_FDC_RxTx_5ms_sys/APP/TPM/TPMS/TPMS/Send/Alarm/LFTHighWarn" /begin REF_MEASUREMENT VTPM_LFWheelTmpIndi_flg /end REF_MEASUREMENT /end GROUP
/begin GROUP S1204_LRTHighWarn "SWC_FDC_type/run_SWC_FDC_RxTx_5ms_sys/APP/TPM/TPMS/TPMS/Send/Alarm/LRTHighWarn" /begin REF_MEASUREMENT VTPM_LRWheelTmpIndi_flg /end REF_MEASUREMENT /end GROUP
/begin GROUP S1204_RFTHighWarn "SWC_FDC_type/run_SWC_FDC_RxTx_5ms_sys/APP/TPM/TPMS/TPMS/Send/Alarm/RFTHighWarn" /begin REF_MEASUREMENT VTPM_RFWheelTmpIndi_flg /end REF_MEASUREMENT /end GROUP
/begin GROUP S1204_RRTHighWarn "SWC_FDC_type/run_SWC_FDC_RxTx_5ms_sys/APP/TPM/TPMS/TPMS/Send/Alarm/RRTHighWarn" /begin REF_MEASUREMENT VTPM_RRWheelTmpIndi_flg /end REF_MEASUREMENT /end GROUP
/begin GROUP S1298_DelayEnable "SWC_FDC_type/run_SWC_FDC_RxTx_5ms_sys/APP/TQD/TorqueDemand/ShiftModule/GearShiftPosn/Drive Protection/DelayEnable" /begin REF_MEASUREMENT VTQD_DriveProtRemove_flg /end REF_MEASUREMENT /end GROUP
/begin GROUP S1355_ACC_Speed_Setting_ON "SWC_FDC_type/run_SWC_FDC_RxTx_5ms_sys/APP/TQD/TorqueDemand/Signal_convert/SWC2_Subsystem/Speed Setting Mode/ACC Speed Setting ON"
 /begin REF_CHARACTERISTIC KTQD_ACCActiveMetSpdHiMPH_mph KTQD_ACCActiveMetSpdHi_kph KTQD_ACCOVRDSpdAdj_flg KTQD_ACCSetSpdSource_flg KTQD_AllowSetSpdOvrdVal_flg KTQD_AllowSetSpdOvrd_flg KTQD_AllowSetSpdSpd_kph KTQD_SetSpdDeltaLongMPH_mph KTQD_SetSpdDeltaLong_kph /end REF_CHARACTERISTIC
 /begin REF_MEASUREMENT VTQD_ACCSavedSetSpd_raw32 VTQD_DistanceUnit_flg VTQD_RoadSpdActive2Standby_flg VTQD_StandbyDisRoadSpd_flg /end REF_MEASUREMENT
/end GROUP
/begin GROUP S1355_CC_Speed_Setting_ON "SWC_FDC_type/run_SWC_FDC_RxTx_5ms_sys/APP/TQD/TorqueDemand/Signal_convert/SWC2_Subsystem/Speed Setting Mode/CC Speed Setting ON"
 /begin REF_CHARACTERISTIC KTQD_SetSpdDeltaLongMPH_mph KTQD_SetSpdDeltaLong_kph KTQD_SetSpdDeltaShort_kph /end REF_CHARACTERISTIC
/end GROUP
/begin GROUP S1355_MSA_Speed_Setting_ON "SWC_FDC_type/run_SWC_FDC_RxTx_5ms_sys/APP/TQD/TorqueDemand/Signal_convert/SWC2_Subsystem/Speed Setting Mode/MSA Speed Setting ON"
 /begin REF_CHARACTERISTIC KTQD_ACCOVRDSpdAdj_flg KTQD_ISATestSW_flg KTQD_MSASetSpdSource_flg KTQD_SetSpdDeltaLongMPH_mph KTQD_SetSpdDeltaLong_kph KTQD_SetSpdDeltaShort_kph /end REF_CHARACTERISTIC
 /begin REF_MEASUREMENT VTQD_MSASavedSetSpd_raw32 /end REF_MEASUREMENT
/end GROUP
/begin GROUP S1355_SWC2ScrollDownSta "SWC_FDC_type/run_SWC_FDC_RxTx_5ms_sys/APP/TQD/TorqueDemand/Signal_convert/SWC2_Subsystem/Speed Setting Mode/SWC2ScrollDownSta" /begin REF_CHARACTERISTIC KTQD_ScrollDownLongPLim_s KTQD_ScrollDownShortPLim_s /end REF_CHARACTERISTIC /begin REF_MEASUREMENT VTQD_SWC2ScrollDownSta_enum /end REF_MEASUREMENT /end GROUP
/begin GROUP S1355_SWC2ScrollUpSta "SWC_FDC_type/run_SWC_FDC_RxTx_5ms_sys/APP/TQD/TorqueDemand/Signal_convert/SWC2_Subsystem/Speed Setting Mode/SWC2ScrollUpSta" /begin REF_CHARACTERISTIC KTQD_ScrollUpLongPLim_s KTQD_ScrollUpShortPLim_s /end REF_CHARACTERISTIC /begin REF_MEASUREMENT VTQD_SWC2ScrollUpSta_enum /end REF_MEASUREMENT /end GROUP
/begin GROUP S1394_ACC_Speed_Setting_ON "SWC_FDC_type/run_SWC_FDC_RxTx_5ms_sys/APP/TQD/TorqueDemand/Signal_convert/SWC_Subsystem/Speed Setting Mode/ACC Speed Setting ON"
 /begin REF_CHARACTERISTIC KTQD_ACCActiveMetSpdHiMPH_mph KTQD_ACCActiveMetSpdHi_kph KTQD_AllowSetSpdOvrdVal_flg KTQD_AllowSetSpdOvrd_flg KTQD_AllowSetSpdSpd_kph KTQD_SetSpdDeltaLongMPH_mph KTQD_SetSpdDeltaLong_kph KTQD_SetSpdLongPLim_s /end REF_CHARACTERISTIC
/end GROUP
/begin GROUP S1394_CC_Speed_Setting_ON "SWC_FDC_type/run_SWC_FDC_RxTx_5ms_sys/APP/TQD/TorqueDemand/Signal_convert/SWC_Subsystem/Speed Setting Mode/CC Speed Setting ON"
 /begin REF_CHARACTERISTIC KTQD_SetSpdDeltaLongMPH_mph KTQD_SetSpdDeltaLong_kph KTQD_SetSpdDeltaShort_kph /end REF_CHARACTERISTIC
 /begin REF_MEASUREMENT VTQD_CCChangeToSTANDBY_flg /end REF_MEASUREMENT
/end GROUP
/begin GROUP S1394_MSA_Speed_Setting_ON "SWC_FDC_type/run_SWC_FDC_RxTx_5ms_sys/APP/TQD/TorqueDemand/Signal_convert/SWC_Subsystem/Speed Setting Mode/MSA Speed Setting ON"
 /begin REF_CHARACTERISTIC KTQD_SetSpdDeltaLongMPH_mph KTQD_SetSpdDeltaLong_kph KTQD_SetSpdDeltaShort_kph /end REF_CHARACTERISTIC
 /begin REF_MEASUREMENT VTQD_ChangeToOFF_flg /end REF_MEASUREMENT
/end GROUP
/begin GROUP S1394_VTQD_SWCCancelP_flg "SWC_FDC_type/run_SWC_FDC_RxTx_5ms_sys/APP/TQD/TorqueDemand/Signal_convert/SWC_Subsystem/Speed Setting Mode/VTQD_SWCCancelP_flg" /begin REF_MEASUREMENT VTQD_SWCCancelP_flg /end REF_MEASUREMENT /end GROUP
/begin GROUP S1394_VTQD_SWCResUpPress_enum "SWC_FDC_type/run_SWC_FDC_RxTx_5ms_sys/APP/TQD/TorqueDemand/Signal_convert/SWC_Subsystem/Speed Setting Mode/VTQD_SWCResUpPress_enum" /begin REF_CHARACTERISTIC KTQD_SetSpdLongPLim_s KTQD_SetSpdShortPLim_s /end REF_CHARACTERISTIC /begin REF_MEASUREMENT VTQD_SWCResUpPress_enum /end REF_MEASUREMENT /end GROUP
/begin GROUP S1394_VTQD_SWCSetDownPress_enum "SWC_FDC_type/run_SWC_FDC_RxTx_5ms_sys/APP/TQD/TorqueDemand/Signal_convert/SWC_Subsystem/Speed Setting Mode/VTQD_SWCSetDownPress_enum" /begin REF_CHARACTERISTIC KTQD_SetSpdLongPLim_s KTQD_SetSpdShortPLim_s /end REF_CHARACTERISTIC /begin REF_MEASUREMENT VTQD_SWCSetDownPress_enum /end REF_MEASUREMENT /end GROUP
/begin GROUP S1427_Front_Wheel_Torque "SWC_FDC_type/run_SWC_FDC_RxTx_5ms_sys/APP/TQD/TorqueDemand/Signal_convert/VehWeightEst/Calaulation/Front Wheel Torque" /begin REF_CHARACTERISTIC KTQD_EstFrWhlTqDev_Nm KTQD_VehWeighEstTimeTune_cnt /end REF_CHARACTERISTIC
 /begin REF_MEASUREMENT VTQD_EstFrRealTqAvg_Nm VTQD_EstFrRealTqCheckPass_flg VTQD_EstFrRealTqMin_Nm VTQD_EstFrRealTqSum_Nm /end REF_MEASUREMENT
/end GROUP
/begin GROUP S1427_Long_Acc "SWC_FDC_type/run_SWC_FDC_RxTx_5ms_sys/APP/TQD/TorqueDemand/Signal_convert/VehWeightEst/Calaulation/Long Acc"
 /begin REF_CHARACTERISTIC KTQD_EstLongAccDev_Gps KTQD_VehWeighEstIntAcc_Gps KTQD_VehWeighEstTimeTune_cnt /end REF_CHARACTERISTIC
 /begin REF_MEASUREMENT VTQD_EstCycleCount_cnt VTQD_EstLongAccAvg_Gps VTQD_EstLongAccCheckPass_flg VTQD_EstLongAccMin_Gps VTQD_EstLongAccSum_Gps /end REF_MEASUREMENT
/end GROUP
/begin GROUP S1427_Rear_Wheel_Torque "SWC_FDC_type/run_SWC_FDC_RxTx_5ms_sys/APP/TQD/TorqueDemand/Signal_convert/VehWeightEst/Calaulation/Rear Wheel Torque" /begin REF_CHARACTERISTIC KTQD_EstRrWhlTqDev_Nm KTQD_VehWeighEstTimeTune_cnt /end REF_CHARACTERISTIC
 /begin REF_MEASUREMENT VTQD_EstRrRealTqAvg_Nm VTQD_EstRrRealTqCheckPass_flg VTQD_EstRrRealTqMin_Nm VTQD_EstRrRealTqSum_Nm /end REF_MEASUREMENT
/end GROUP
/begin GROUP S1427_Vehicle_Weight "SWC_FDC_type/run_SWC_FDC_RxTx_5ms_sys/APP/TQD/TorqueDemand/Signal_convert/VehWeightEst/Calaulation/Vehicle Weight"
 /begin REF_CHARACTERISTIC KTQD_EstRollCoeffA_c KTQD_EstRollCoeffB_c KTQD_EstRollCoeffC_c KTQD_FrTireRadius_m KTQD_GravityValue_mps2 KTQD_RrTireRadius_m /end REF_CHARACTERISTIC
 /begin REF_MEASUREMENT VTQD_EstActTotalForce_N VTQD_EstFrActForce_N VTQD_EstFrForce_N VTQD_EstFrWhlTqAvg_Nm VTQD_EstRollForce_N VTQD_EstRrActForce_N VTQD_EstRrForce_N VTQD_EstRrWhlTqAvg_Nm VTQD_EstVehWeight_kg /end REF_MEASUREMENT
/end GROUP
/begin GROUP S1428_DelayEnable "SWC_FDC_type/run_SWC_FDC_RxTx_5ms_sys/APP/TQD/TorqueDemand/Signal_convert/VehWeightEst/Condition/DelayEnable" /begin REF_MEASUREMENT VTQD_VehWeightEstEn_flg /end REF_MEASUREMENT /end GROUP
/begin GROUP S1428_Timer1 "SWC_FDC_type/run_SWC_FDC_RxTx_5ms_sys/APP/TQD/TorqueDemand/Signal_convert/VehWeightEst/Condition/Timer1" /begin REF_MEASUREMENT VTQD_EstVehWeightResetTime_s /end REF_MEASUREMENT /end GROUP
/begin GROUP S1429_DelayEnable "SWC_FDC_type/run_SWC_FDC_RxTx_5ms_sys/APP/TQD/TorqueDemand/Signal_convert/VehWeightEst/Desicion/DelayEnable" /begin REF_MEASUREMENT VTQD_VehWeightEstEnd_flg /end REF_MEASUREMENT /end GROUP
/begin GROUP S1499_CapacityDistribution "SWC_FDC_type/run_SWC_FDC_RxTx_5ms_sys/APP/TQD/TorqueDemand/TorqueModule/AvaliableTqLimit/TorqueCapacityCalcalation/CapacityDistribution" /begin REF_MEASUREMENT VTQD_FrHVBPwrAvailDchrg_kW VTQD_RrHVBPwrAvailDchrg_kW /end REF_MEASUREMENT /end GROUP
/begin GROUP S1499_Generation "SWC_FDC_type/run_SWC_FDC_RxTx_5ms_sys/APP/TQD/TorqueDemand/TorqueModule/AvaliableTqLimit/TorqueCapacityCalcalation/Generation"
 /begin REF_CHARACTERISTIC KTQD_FrLowTheldTrq_Nm KTQD_FrTMSpdMin_rpm KTQD_RrLowTheldTrq_Nm KTQD_RrTMSpdMin_rpm KTQD_WhlTqCapGenFr_Nm_ovrdflg KTQD_WhlTqCapGenFr_Nm_ovrdval KTQD_WhlTqCapGenRr_Nm_ovrdflg KTQD_WhlTqCapGenRr_Nm_ovrdval /end REF_CHARACTERISTIC
 /begin REF_MEASUREMENT VTQD_WhlTqCapGenFr_Nm VTQD_WhlTqCapGenRr_Nm /end REF_MEASUREMENT
/end GROUP
/begin GROUP S1499_MOTOR_Loss_MAP_ "SWC_FDC_type/run_SWC_FDC_RxTx_5ms_sys/APP/TQD/TorqueDemand/TorqueModule/AvaliableTqLimit/TorqueCapacityCalcalation/MOTOR Loss MAP "
 /begin REF_CHARACTERISTIC KTQD_FrLossMAPHighV_V KTQD_FrLossMAPLowV_V KTQD_RrLossMAPHighV_V KTQD_RrLossMAPLowV_V MTQD_FrLossMAPHighV_Z_kW MTQD_FrLossMAPLowV_Z_kW MTQD_RrLossMAPHighV_Z_kW MTQD_RrLossMAPLowV_Z_kW /end REF_CHARACTERISTIC
 /begin REF_MEASUREMENT VTQD_FrLossMAPFinal_kW VTQD_FrLossMAPHighV_V VTQD_FrLossMAPHighV_kW VTQD_FrLossMAPLowV_V VTQD_FrLossMAPLowV_kW VTQD_MotorLossTotal_kW VTQD_RrLossMAPFinal_kW VTQD_RrLossMAPHighV_V VTQD_RrLossMAPHighV_kW VTQD_RrLossMAPLowV_V VTQD_RrLossMAPLowV_kW /end REF_MEASUREMENT
/end GROUP
/begin GROUP S1499_Motoring "SWC_FDC_type/run_SWC_FDC_RxTx_5ms_sys/APP/TQD/TorqueDemand/TorqueModule/AvaliableTqLimit/TorqueCapacityCalcalation/Motoring"
 /begin REF_CHARACTERISTIC KTQD_FrTMSpdMin_rpm KTQD_RrTMSpdMin_rpm KTQD_WhlTqCapMotFr_Nm_ovrdflg KTQD_WhlTqCapMotFr_Nm_ovrdval KTQD_WhlTqCapMotRr_Nm_ovrdflg KTQD_WhlTqCapMotRr_Nm_ovrdval /end REF_CHARACTERISTIC
 /begin REF_MEASUREMENT VTQD_WhlTqCapMotFr_Nm VTQD_WhlTqCapMotRr_Nm /end REF_MEASUREMENT
/end GROUP
/begin GROUP S1499_TMAvailablePwr_Calculation "SWC_FDC_type/run_SWC_FDC_RxTx_5ms_sys/APP/TQD/TorqueDemand/TorqueModule/AvaliableTqLimit/TorqueCapacityCalcalation/TMAvailablePwr_Calculation"
 /begin REF_CHARACTERISTIC KTQD_DCDCCalPwrAvailRsv_kW KTQD_THCMCalPwrAvailRsv_kW KTQD_TMPwrAvailDchrg_kW_ovrdflg /end REF_CHARACTERISTIC
 /begin REF_MEASUREMENT VTQD_TMPwrAvailDchrg_kW /end REF_MEASUREMENT
/end GROUP
/begin GROUP S1505_SR_Latch "SWC_FDC_type/run_SWC_FDC_RxTx_5ms_sys/APP/TQD/TorqueDemand/TorqueModule/DriverWhlTqDem/BOS/SR_Latch" /begin REF_MEASUREMENT VTQD_BOSEnable_flg /end REF_MEASUREMENT /end GROUP
/begin GROUP S1506_FirstOrderFilter "SWC_FDC_type/run_SWC_FDC_RxTx_5ms_sys/APP/TQD/TorqueDemand/TorqueModule/DriverWhlTqDem/Creep/FirstOrderFilter" /begin REF_MEASUREMENT VTQD_RPM2VehSpd_kph /end REF_MEASUREMENT /end GROUP
/begin GROUP S1506_If_Action_Subsystem1 "SWC_FDC_type/run_SWC_FDC_RxTx_5ms_sys/APP/TQD/TorqueDemand/TorqueModule/DriverWhlTqDem/Creep/If Action Subsystem1" /begin REF_CHARACTERISTIC KTQD_CreepItermMinLimit_Nm MTQD_CreepItermMaxLimit_Y_Nm /end REF_CHARACTERISTIC
 /begin REF_MEASUREMENT VTQD_CreepItermMaxLimit_Nm VTQD_CreepItermTq_Nm VTQD_CreepOffsetTq_Nm VTQD_CreepPICtrlReset_flg VTQD_CreepPtermTq_Nm VTQD_CreepTotalOfstTq_Nm /end REF_MEASUREMENT
/end GROUP
/begin GROUP S1506_SR_Latch "SWC_FDC_type/run_SWC_FDC_RxTx_5ms_sys/APP/TQD/TorqueDemand/TorqueModule/DriverWhlTqDem/Creep/SR_Latch" /begin REF_MEASUREMENT VTQD_CreepPrLoadEnable_flg /end REF_MEASUREMENT /end GROUP
/begin GROUP S1506_SR_Latch1 "SWC_FDC_type/run_SWC_FDC_RxTx_5ms_sys/APP/TQD/TorqueDemand/TorqueModule/DriverWhlTqDem/Creep/SR_Latch1" /begin REF_MEASUREMENT VTQD_RBCActive_flg /end REF_MEASUREMENT /end GROUP
/begin GROUP S1506_SR_Latch2 "SWC_FDC_type/run_SWC_FDC_RxTx_5ms_sys/APP/TQD/TorqueDemand/TorqueModule/DriverWhlTqDem/Creep/SR_Latch2" /begin REF_MEASUREMENT VTQD_LowSkipDisCreep_flg /end REF_MEASUREMENT /end GROUP
/begin GROUP S1506_SR_Latch5 "SWC_FDC_type/run_SWC_FDC_RxTx_5ms_sys/APP/TQD/TorqueDemand/TorqueModule/DriverWhlTqDem/Creep/SR_Latch5" /begin REF_MEASUREMENT VTQD_MediumSkipDisCreep_flg /end REF_MEASUREMENT /end GROUP
/begin GROUP S1506_SR_Latch6 "SWC_FDC_type/run_SWC_FDC_RxTx_5ms_sys/APP/TQD/TorqueDemand/TorqueModule/DriverWhlTqDem/Creep/SR_Latch6" /begin REF_MEASUREMENT VTQD_HighSkipDisCreep_flg /end REF_MEASUREMENT /end GROUP
/begin GROUP S1506_Timer "SWC_FDC_type/run_SWC_FDC_RxTx_5ms_sys/APP/TQD/TorqueDemand/TorqueModule/DriverWhlTqDem/Creep/Timer" /begin REF_MEASUREMENT VTQD_CreepPreloadTime_s /end REF_MEASUREMENT /end GROUP
/begin GROUP S1507_SR_Latch "SWC_FDC_type/run_SWC_FDC_RxTx_5ms_sys/APP/TQD/TorqueDemand/TorqueModule/DriverWhlTqDem/DriverTqCoordination/SR_Latch" /begin REF_MEASUREMENT VTQD_LoSpdBrkCtrl_flg /end REF_MEASUREMENT /end GROUP
/begin GROUP S1507_SR_Latch2 "SWC_FDC_type/run_SWC_FDC_RxTx_5ms_sys/APP/TQD/TorqueDemand/TorqueModule/DriverWhlTqDem/DriverTqCoordination/SR_Latch2" /begin REF_MEASUREMENT VTQD_PreLoadHold_flg /end REF_MEASUREMENT /end GROUP
/begin GROUP S1507_SR_Latch6 "SWC_FDC_type/run_SWC_FDC_RxTx_5ms_sys/APP/TQD/TorqueDemand/TorqueModule/DriverWhlTqDem/DriverTqCoordination/SR_Latch6" /begin REF_MEASUREMENT VTQD_PreLoadHoldtimeEnd_flg /end REF_MEASUREMENT /end GROUP
/begin GROUP S1507_SR_Latch7 "SWC_FDC_type/run_SWC_FDC_RxTx_5ms_sys/APP/TQD/TorqueDemand/TorqueModule/DriverWhlTqDem/DriverTqCoordination/SR_Latch7" /begin REF_MEASUREMENT VTQD_EscapModeTqLim_flg /end REF_MEASUREMENT /end GROUP
/begin GROUP S1507_Timer1 "SWC_FDC_type/run_SWC_FDC_RxTx_5ms_sys/APP/TQD/TorqueDemand/TorqueModule/DriverWhlTqDem/DriverTqCoordination/Timer1" /begin REF_MEASUREMENT VTQD_PreLoadHoldtime_s /end REF_MEASUREMENT /end GROUP
/begin GROUP S1508_LHM "SWC_FDC_type/run_SWC_FDC_RxTx_5ms_sys/APP/TQD/TorqueDemand/TorqueModule/DriverWhlTqDem/PedalMapWhlTq/LHM" /begin REF_CHARACTERISTIC MTQD_LHMTqMapD_Z_Nm MTQD_LHMTqMapR_Z_Nm /end REF_CHARACTERISTIC /end GROUP
/begin GROUP S1508_NoLHM "SWC_FDC_type/run_SWC_FDC_RxTx_5ms_sys/APP/TQD/TorqueDemand/TorqueModule/DriverWhlTqDem/PedalMapWhlTq/NoLHM" /begin SUB_GROUP S1550_ShiftD S1550_ShiftR /end SUB_GROUP /end GROUP
/begin GROUP S1508_SR_Latch1 "SWC_FDC_type/run_SWC_FDC_RxTx_5ms_sys/APP/TQD/TorqueDemand/TorqueModule/DriverWhlTqDem/PedalMapWhlTq/SR_Latch1" /begin REF_MEASUREMENT VTQD_RegenTqLimitEn_flg /end REF_MEASUREMENT /end GROUP
/begin GROUP S1508_SR_Latch2 "SWC_FDC_type/run_SWC_FDC_RxTx_5ms_sys/APP/TQD/TorqueDemand/TorqueModule/DriverWhlTqDem/PedalMapWhlTq/SR_Latch2" /begin REF_MEASUREMENT VTQD_BrkRgnLatchEn_flg /end REF_MEASUREMENT /end GROUP
/begin GROUP S1508_SR_Latch3 "SWC_FDC_type/run_SWC_FDC_RxTx_5ms_sys/APP/TQD/TorqueDemand/TorqueModule/DriverWhlTqDem/PedalMapWhlTq/SR_Latch3" /begin REF_MEASUREMENT VTQD_ADASShutOff_flg /end REF_MEASUREMENT /end GROUP
/begin GROUP S1508_SR_Latch4 "SWC_FDC_type/run_SWC_FDC_RxTx_5ms_sys/APP/TQD/TorqueDemand/TorqueModule/DriverWhlTqDem/PedalMapWhlTq/SR_Latch4" /begin REF_MEASUREMENT VTQD_ACCCancelDet_flg /end REF_MEASUREMENT /end GROUP
/begin GROUP S1508_Triggered_Subsystem "SWC_FDC_type/run_SWC_FDC_RxTx_5ms_sys/APP/TQD/TorqueDemand/TorqueModule/DriverWhlTqDem/PedalMapWhlTq/Triggered Subsystem" /begin REF_MEASUREMENT VTQD_ACCCancelMemPosn_pct VTQD_ACCCancelMemTq_Nm /end REF_MEASUREMENT /end GROUP
/begin GROUP S1600_SR_Latch1 "SWC_FDC_type/run_SWC_FDC_RxTx_5ms_sys/APP/TQD/TorqueDemand/TorqueModule/OPD Hold/OPDHold Request /SR_Latch1" /begin REF_MEASUREMENT VTQD_OPDHoldSpdEnLamp_flg /end REF_MEASUREMENT /end GROUP
/begin GROUP S1600_Timer "SWC_FDC_type/run_SWC_FDC_RxTx_5ms_sys/APP/TQD/TorqueDemand/TorqueModule/OPD Hold/OPDHold Request /Timer" /begin REF_MEASUREMENT VTQD_APSReqTimer_s /end REF_MEASUREMENT /end GROUP
/begin GROUP S1601_SR_Latch "SWC_FDC_type/run_SWC_FDC_RxTx_5ms_sys/APP/TQD/TorqueDemand/TorqueModule/OPD Hold/Parking Requeest Backup/SR_Latch" /begin REF_MEASUREMENT VTQD_OPDHoldAllowPark_flg /end REF_MEASUREMENT /end GROUP
/begin GROUP S1602_DelayEnable "SWC_FDC_type/run_SWC_FDC_RxTx_5ms_sys/APP/TQD/TorqueDemand/TorqueModule/OPD Hold/Release Condition/DelayEnable" /begin REF_MEASUREMENT VTQD_OPDHoldEnRel_flg /end REF_MEASUREMENT /end GROUP
/begin GROUP S1602_SR_Latch "SWC_FDC_type/run_SWC_FDC_RxTx_5ms_sys/APP/TQD/TorqueDemand/TorqueModule/OPD Hold/Release Condition/SR_Latch" /begin REF_MEASUREMENT VTQD_OPDHoldEnRelLatch_flg /end REF_MEASUREMENT /end GROUP
/begin GROUP S1602_SR_Latch1 "SWC_FDC_type/run_SWC_FDC_RxTx_5ms_sys/APP/TQD/TorqueDemand/TorqueModule/OPD Hold/Release Condition/SR_Latch1" /begin REF_MEASUREMENT VTQD_OPDHoldRelReverse_flg /end REF_MEASUREMENT /end GROUP
/begin GROUP S1603_DelayEnable "SWC_FDC_type/run_SWC_FDC_RxTx_5ms_sys/APP/TQD/TorqueDemand/TorqueModule/OPD Hold/System Status/DelayEnable" /begin REF_MEASUREMENT VTQD_R2DEnOPDHold_flg /end REF_MEASUREMENT /end GROUP
/begin GROUP S1603_DelayEnable1 "SWC_FDC_type/run_SWC_FDC_RxTx_5ms_sys/APP/TQD/TorqueDemand/TorqueModule/OPD Hold/System Status/DelayEnable1" /begin REF_MEASUREMENT VTQD_SkipDisOPDHoldReset_flg /end REF_MEASUREMENT /end GROUP
/begin GROUP S1603_SR_Latch "SWC_FDC_type/run_SWC_FDC_RxTx_5ms_sys/APP/TQD/TorqueDemand/TorqueModule/OPD Hold/System Status/SR_Latch" /begin REF_MEASUREMENT VTQD_WhlSkipDisOPDHold_flg /end REF_MEASUREMENT /end GROUP
/begin GROUP S1603_SR_Latch3 "SWC_FDC_type/run_SWC_FDC_RxTx_5ms_sys/APP/TQD/TorqueDemand/TorqueModule/OPD Hold/System Status/SR_Latch3" /begin REF_MEASUREMENT VTQD_OPDHoldRgnOn2Off_flg /end REF_MEASUREMENT /end GROUP
/begin GROUP S1603_SR_Latch4 "SWC_FDC_type/run_SWC_FDC_RxTx_5ms_sys/APP/TQD/TorqueDemand/TorqueModule/OPD Hold/System Status/SR_Latch4" /begin REF_MEASUREMENT VTQD_OPDHoldR2D_flg /end REF_MEASUREMENT /end GROUP
/begin GROUP S1664_SR_Latch1 "SWC_FDC_type/run_SWC_FDC_RxTx_5ms_sys/APP/TQR/Determine Torque Request/TorqueArbitrament/TorqueSmooth/Front First order filter input tau map and determination/SR_Latch1" /begin REF_MEASUREMENT VTQR_FrDrModLatch_flg /end REF_MEASUREMENT /end GROUP
/begin GROUP S1664_VTQR_ECOFEDUTs_c "SWC_FDC_type/run_SWC_FDC_RxTx_5ms_sys/APP/TQR/Determine Torque Request/TorqueArbitrament/TorqueSmooth/Front First order filter input tau map and determination/VTQR_ECOFEDUTs_c"
 /begin SUB_GROUP S1682_Invalid S1682_LV1 S1682_LV2 S1682_LV3 S1682_LV4 S1682_LV5 S1682_OPD /end SUB_GROUP
/end GROUP
/begin GROUP S1664_VTQR_ESCAPEFEDUTs_c "SWC_FDC_type/run_SWC_FDC_RxTx_5ms_sys/APP/TQR/Determine Torque Request/TorqueArbitrament/TorqueSmooth/Front First order filter input tau map and determination/VTQR_ESCAPEFEDUTs_c" /begin REF_CHARACTERISTIC MTQR_ESCAPEFEDUTs_Z_c /end REF_CHARACTERISTIC /end GROUP
/begin GROUP S1664_VTQR_LHMFEDUTs_c "SWC_FDC_type/run_SWC_FDC_RxTx_5ms_sys/APP/TQR/Determine Torque Request/TorqueArbitrament/TorqueSmooth/Front First order filter input tau map and determination/VTQR_LHMFEDUTs_c" /begin REF_CHARACTERISTIC MTQR_LHMFEDUTs_Z_c /end REF_CHARACTERISTIC /end GROUP
/begin GROUP S1664_VTQR_NORMALFEDUTs_c "SWC_FDC_type/run_SWC_FDC_RxTx_5ms_sys/APP/TQR/Determine Torque Request/TorqueArbitrament/TorqueSmooth/Front First order filter input tau map and determination/VTQR_NORMALFEDUTs_c"
 /begin SUB_GROUP S1685_Invalid S1685_LV1 S1685_LV2 S1685_LV3 S1685_LV4 S1685_LV5 S1685_OPD /end SUB_GROUP
/end GROUP
/begin GROUP S1664_VTQR_SNOWFEDUTs_c "SWC_FDC_type/run_SWC_FDC_RxTx_5ms_sys/APP/TQR/Determine Torque Request/TorqueArbitrament/TorqueSmooth/Front First order filter input tau map and determination/VTQR_SNOWFEDUTs_c" /begin REF_CHARACTERISTIC MTQR_SNOWFEDUTs_Z_c /end REF_CHARACTERISTIC /end GROUP
/begin GROUP S1664_VTQR_SPORTFEDUTs_c "SWC_FDC_type/run_SWC_FDC_RxTx_5ms_sys/APP/TQR/Determine Torque Request/TorqueArbitrament/TorqueSmooth/Front First order filter input tau map and determination/VTQR_SPORTFEDUTs_c"
 /begin SUB_GROUP S1687_Invalid S1687_LV1 S1687_LV2 S1687_LV3 S1687_LV4 S1687_LV5 S1687_OPD /end SUB_GROUP
/end GROUP
/begin GROUP S1664_VTQR_TCSFEDUTs_c "SWC_FDC_type/run_SWC_FDC_RxTx_5ms_sys/APP/TQR/Determine Torque Request/TorqueArbitrament/TorqueSmooth/Front First order filter input tau map and determination/VTQR_TCSFEDUTs_c" /begin REF_CHARACTERISTIC MTQR_TCSFEDUTs_Z_c /end REF_CHARACTERISTIC /end GROUP
/begin GROUP S1665_EcoLow "SWC_FDC_type/run_SWC_FDC_RxTx_5ms_sys/APP/TQR/Determine Torque Request/TorqueArbitrament/TorqueSmooth/Front Torque zero point transfer boundary map/EcoLow" /begin REF_CHARACTERISTIC MTQR_FTqZeroTransLowBoundE_Y_Nm /end REF_CHARACTERISTIC /end GROUP
/begin GROUP S1665_EcoUP "SWC_FDC_type/run_SWC_FDC_RxTx_5ms_sys/APP/TQR/Determine Torque Request/TorqueArbitrament/TorqueSmooth/Front Torque zero point transfer boundary map/EcoUP" /begin REF_CHARACTERISTIC MTQR_FTqZeroTransUpBoundE_Y_Nm /end REF_CHARACTERISTIC /end GROUP
/begin GROUP S1665_NormalLow "SWC_FDC_type/run_SWC_FDC_RxTx_5ms_sys/APP/TQR/Determine Torque Request/TorqueArbitrament/TorqueSmooth/Front Torque zero point transfer boundary map/NormalLow" /begin REF_CHARACTERISTIC MTQR_FTqZeroTransLowBoundN_Y_Nm /end REF_CHARACTERISTIC /end GROUP
/begin GROUP S1665_NormalUP "SWC_FDC_type/run_SWC_FDC_RxTx_5ms_sys/APP/TQR/Determine Torque Request/TorqueArbitrament/TorqueSmooth/Front Torque zero point transfer boundary map/NormalUP" /begin REF_CHARACTERISTIC MTQR_FTqZeroTransUpBoundN_Y_Nm /end REF_CHARACTERISTIC /end GROUP
/begin GROUP S1665_SportLow "SWC_FDC_type/run_SWC_FDC_RxTx_5ms_sys/APP/TQR/Determine Torque Request/TorqueArbitrament/TorqueSmooth/Front Torque zero point transfer boundary map/SportLow" /begin REF_CHARACTERISTIC MTQR_FTqZeroTransLowBoundS_Y_Nm /end REF_CHARACTERISTIC /end GROUP
/begin GROUP S1665_SportUP "SWC_FDC_type/run_SWC_FDC_RxTx_5ms_sys/APP/TQR/Determine Torque Request/TorqueArbitrament/TorqueSmooth/Front Torque zero point transfer boundary map/SportUP" /begin REF_CHARACTERISTIC MTQR_FTqZeroTransUpBoundS_Y_Nm /end REF_CHARACTERISTIC /end GROUP
/begin GROUP S1667_SR_Latch "SWC_FDC_type/run_SWC_FDC_RxTx_5ms_sys/APP/TQR/Determine Torque Request/TorqueArbitrament/TorqueSmooth/Front torque ramp limtation and determination/SR_Latch" /begin REF_MEASUREMENT VTQR_FShaftSpdTqLimLow_flg /end REF_MEASUREMENT /end GROUP
/begin GROUP S1667_SR_Latch1 "SWC_FDC_type/run_SWC_FDC_RxTx_5ms_sys/APP/TQR/Determine Torque Request/TorqueArbitrament/TorqueSmooth/Front torque ramp limtation and determination/SR_Latch1" /begin REF_MEASUREMENT VTQR_FTimerTqLimLow_flg /end REF_MEASUREMENT /end GROUP
/begin GROUP S1667_Timer "SWC_FDC_type/run_SWC_FDC_RxTx_5ms_sys/APP/TQR/Determine Torque Request/TorqueArbitrament/TorqueSmooth/Front torque ramp limtation and determination/Timer" /begin REF_MEASUREMENT VTQR_FShaftSpdDevTime_s /end REF_MEASUREMENT /end GROUP
/begin GROUP S1669_Negative_Rate_limit_Determination "SWC_FDC_type/run_SWC_FDC_RxTx_5ms_sys/APP/TQR/Determine Torque Request/TorqueArbitrament/TorqueSmooth/Front wheel rate limit determination/Negative Rate limit Determination"
 /begin SUB_GROUP S1722_VTQR_FrNegRateLimitDecE_Nm S1722_VTQR_FrNegRateLimitDecN_Nm S1722_VTQR_FrNegRateLimitDecS_Nm S1722_VTQR_FrNegRateLimitIncE_Nm S1722_VTQR_FrNegRateLimitIncN_Nm S1722_VTQR_FrNegRateLimitIncS_Nm /end SUB_GROUP
/end GROUP
/begin GROUP S1669_Positive_Rate_limit_Determination "SWC_FDC_type/run_SWC_FDC_RxTx_5ms_sys/APP/TQR/Determine Torque Request/TorqueArbitrament/TorqueSmooth/Front wheel rate limit determination/Positive Rate limit Determination"
 /begin SUB_GROUP S1723_VTQR_FrPosRateLimitDecE_Nm S1723_VTQR_FrPosRateLimitDecN_Nm S1723_VTQR_FrPosRateLimitDecS_Nm S1723_VTQR_FrPosRateLimitIncE_Nm S1723_VTQR_FrPosRateLimitIncN_Nm S1723_VTQR_FrPosRateLimitIncS_Nm /end SUB_GROUP
/end GROUP
/begin GROUP S1669_VTQR_ECOFEDURateLimitDec_Nm "SWC_FDC_type/run_SWC_FDC_RxTx_5ms_sys/APP/TQR/Determine Torque Request/TorqueArbitrament/TorqueSmooth/Front wheel rate limit determination/VTQR_ECOFEDURateLimitDec_Nm"
 /begin SUB_GROUP S1726_Invalid S1726_LV1 S1726_LV2 S1726_LV3 S1726_LV4 S1726_LV5 S1726_OPD /end SUB_GROUP
/end GROUP
/begin GROUP S1669_VTQR_ECOFEDURateLimitInc_Nm "SWC_FDC_type/run_SWC_FDC_RxTx_5ms_sys/APP/TQR/Determine Torque Request/TorqueArbitrament/TorqueSmooth/Front wheel rate limit determination/VTQR_ECOFEDURateLimitInc_Nm"
 /begin SUB_GROUP S1727_Invalid S1727_LV1 S1727_LV2 S1727_LV3 S1727_LV4 S1727_LV5 S1727_OPD /end SUB_GROUP
 /begin REF_CHARACTERISTIC KTQR_EnEcoFrIncGain_enum MTQR_ECO2TqFrIncGain_Z_c MTQR_ECO3TqFrIncGain_Z_c MTQR_ECO4TqFrIncGain_Z_c MTQR_ECO5TqFrIncGain_Z_c MTQR_ECOOPDTqFrIncGain_Z_c MTQR_EcoTqFrIncGain_Z_c /end REF_CHARACTERISTIC
 /begin REF_MEASUREMENT VTQR_ECO2TqFrIncGain_c VTQR_ECO3TqFrIncGain_c VTQR_ECO4TqFrIncGain_c VTQR_ECO5TqFrIncGain_c VTQR_ECOOPDTqFrIncGain_c VTQR_EcoTqFrIncGain_c /end REF_MEASUREMENT
/end GROUP
/begin GROUP S1669_VTQR_ESCAPEFEDURateLimitDec_Nm "SWC_FDC_type/run_SWC_FDC_RxTx_5ms_sys/APP/TQR/Determine Torque Request/TorqueArbitrament/TorqueSmooth/Front wheel rate limit determination/VTQR_ESCAPEFEDURateLimitDec_Nm" /begin REF_CHARACTERISTIC MTQR_ESCAPEFEDUTqDecSR_Z_Nm /end REF_CHARACTERISTIC /end GROUP
/begin GROUP S1669_VTQR_ESCAPEFEDURateLimitInc_Nm "SWC_FDC_type/run_SWC_FDC_RxTx_5ms_sys/APP/TQR/Determine Torque Request/TorqueArbitrament/TorqueSmooth/Front wheel rate limit determination/VTQR_ESCAPEFEDURateLimitInc_Nm" /begin REF_CHARACTERISTIC MTQR_ESCAPEFEDUTqIncSR_Z_Nm /end REF_CHARACTERISTIC /end GROUP
/begin GROUP S1669_VTQR_LHMFEDURateLimitDec_Nm "SWC_FDC_type/run_SWC_FDC_RxTx_5ms_sys/APP/TQR/Determine Torque Request/TorqueArbitrament/TorqueSmooth/Front wheel rate limit determination/VTQR_LHMFEDURateLimitDec_Nm" /begin REF_CHARACTERISTIC MTQR_LHMFEDUTqDecSR_Z_Nm /end REF_CHARACTERISTIC /end GROUP
/begin GROUP S1669_VTQR_LHMFEDURateLimitInc_Nm "SWC_FDC_type/run_SWC_FDC_RxTx_5ms_sys/APP/TQR/Determine Torque Request/TorqueArbitrament/TorqueSmooth/Front wheel rate limit determination/VTQR_LHMFEDURateLimitInc_Nm" /begin REF_CHARACTERISTIC MTQR_LHMFEDUTqIncSR_Z_Nm /end REF_CHARACTERISTIC /end GROUP
/begin GROUP S1669_VTQR_NORMALFEDURateLimitDec_Nm "SWC_FDC_type/run_SWC_FDC_RxTx_5ms_sys/APP/TQR/Determine Torque Request/TorqueArbitrament/TorqueSmooth/Front wheel rate limit determination/VTQR_NORMALFEDURateLimitDec_Nm"
 /begin SUB_GROUP S1732_Invalid S1732_LV1 S1732_LV2 S1732_LV3 S1732_LV4 S1732_LV5 S1732_OPD /end SUB_GROUP
/end GROUP
/begin GROUP S1669_VTQR_NORMALFEDURateLimitInc_Nm "SWC_FDC_type/run_SWC_FDC_RxTx_5ms_sys/APP/TQR/Determine Torque Request/TorqueArbitrament/TorqueSmooth/Front wheel rate limit determination/VTQR_NORMALFEDURateLimitInc_Nm"
 /begin SUB_GROUP S1733_Invalid S1733_LV1 S1733_LV2 S1733_LV3 S1733_LV4 S1733_LV5 S1733_OPD /end SUB_GROUP
 /begin REF_CHARACTERISTIC KTQR_EnNormalFrIncGain_enum MTQR_NL2TqFrIncGain_Z_c MTQR_NL3TqFrIncGain_Z_c MTQR_NL4TqFrIncGain_Z_c MTQR_NL5TqFrIncGain_Z_c MTQR_NLOPDTqFrIncGain_Z_c MTQR_NormalTqFrIncGain_Z_c /end REF_CHARACTERISTIC
 /begin REF_MEASUREMENT VTQR_NL2TqFrIncGain_c VTQR_NL3TqFrIncGain_c VTQR_NL4TqFrIncGain_c VTQR_NL5TqFrIncGain_c VTQR_NLOPDTqFrIncGain_c VTQR_NormalTqFrIncGain_c /end REF_MEASUREMENT
/end GROUP
/begin GROUP S1669_VTQR_SNOWFEDURateLimitDec_Nm "SWC_FDC_type/run_SWC_FDC_RxTx_5ms_sys/APP/TQR/Determine Torque Request/TorqueArbitrament/TorqueSmooth/Front wheel rate limit determination/VTQR_SNOWFEDURateLimitDec_Nm" /begin REF_CHARACTERISTIC MTQR_SNOWFEDUTqDecSR_Z_Nm /end REF_CHARACTERISTIC /end GROUP
/begin GROUP S1669_VTQR_SNOWFEDURateLimitInc_Nm "SWC_FDC_type/run_SWC_FDC_RxTx_5ms_sys/APP/TQR/Determine Torque Request/TorqueArbitrament/TorqueSmooth/Front wheel rate limit determination/VTQR_SNOWFEDURateLimitInc_Nm" /begin REF_CHARACTERISTIC MTQR_SNOWFEDUTqIncSR_Z_Nm /end REF_CHARACTERISTIC /end GROUP
/begin GROUP S1669_VTQR_SPORTFEDURateLimitDec_Nm "SWC_FDC_type/run_SWC_FDC_RxTx_5ms_sys/APP/TQR/Determine Torque Request/TorqueArbitrament/TorqueSmooth/Front wheel rate limit determination/VTQR_SPORTFEDURateLimitDec_Nm"
 /begin SUB_GROUP S1736_Invalid S1736_LV1 S1736_LV2 S1736_LV3 S1736_LV4 S1736_LV5 S1736_OPD /end SUB_GROUP
/end GROUP
/begin GROUP S1669_VTQR_SPORTFEDURateLimitInc_Nm "SWC_FDC_type/run_SWC_FDC_RxTx_5ms_sys/APP/TQR/Determine Torque Request/TorqueArbitrament/TorqueSmooth/Front wheel rate limit determination/VTQR_SPORTFEDURateLimitInc_Nm"
 /begin SUB_GROUP S1737_Invalid S1737_LV1 S1737_LV2 S1737_LV3 S1737_LV4 S1737_LV5 S1737_OPD /end SUB_GROUP
 /begin REF_CHARACTERISTIC KTQR_EnSportFrIncGain_enum MTQR_Sport2TqFrIncGain_Z_c MTQR_Sport3TqFrIncGain_Z_c MTQR_Sport4TqFrIncGain_Z_c MTQR_Sport5TqFrIncGain_Z_c MTQR_SportOPDTqFrIncGain_Z_c MTQR_SportTqFrIncGain_Z_c /end REF_CHARACTERISTIC
 /begin REF_MEASUREMENT VTQR_Sport2TqFrIncGain_c VTQR_Sport3TqFrIncGain_c VTQR_Sport4TqFrIncGain_c VTQR_Sport5TqFrIncGain_c VTQR_SportOPDTqFrIncGain_c VTQR_SportTqFrIncGain_c /end REF_MEASUREMENT
/end GROUP
/begin GROUP S1669_VTQR_TCSFEDURateLimitDec_Nm "SWC_FDC_type/run_SWC_FDC_RxTx_5ms_sys/APP/TQR/Determine Torque Request/TorqueArbitrament/TorqueSmooth/Front wheel rate limit determination/VTQR_TCSFEDURateLimitDec_Nm" /begin REF_CHARACTERISTIC MTQR_TCSFEDUTqDecSR_Z_Nm /end REF_CHARACTERISTIC /end GROUP
/begin GROUP S1669_VTQR_TCSFEDURateLimitInc_Nm "SWC_FDC_type/run_SWC_FDC_RxTx_5ms_sys/APP/TQR/Determine Torque Request/TorqueArbitrament/TorqueSmooth/Front wheel rate limit determination/VTQR_TCSFEDURateLimitInc_Nm" /begin REF_CHARACTERISTIC MTQR_TCSFEDUTqIncSR_Z_Nm /end REF_CHARACTERISTIC /end GROUP
/begin GROUP S1674_SR_Latch1 "SWC_FDC_type/run_SWC_FDC_RxTx_5ms_sys/APP/TQR/Determine Torque Request/TorqueArbitrament/TorqueSmooth/Rear First order filter input tau map and determination/SR_Latch1" /begin REF_MEASUREMENT VTQR_RrDrModLatch_flg /end REF_MEASUREMENT /end GROUP
/begin GROUP S1674_VTQR_ECOREDUTs_c "SWC_FDC_type/run_SWC_FDC_RxTx_5ms_sys/APP/TQR/Determine Torque Request/TorqueArbitrament/TorqueSmooth/Rear First order filter input tau map and determination/VTQR_ECOREDUTs_c"
 /begin SUB_GROUP S1796_Invalid S1796_LV1 S1796_LV2 S1796_LV3 S1796_LV4 S1796_LV5 S1796_OPD /end SUB_GROUP
/end GROUP
/begin GROUP S1674_VTQR_ESCAPEREDUTs_c "SWC_FDC_type/run_SWC_FDC_RxTx_5ms_sys/APP/TQR/Determine Torque Request/TorqueArbitrament/TorqueSmooth/Rear First order filter input tau map and determination/VTQR_ESCAPEREDUTs_c" /begin REF_CHARACTERISTIC MTQR_ESCAPEREDUTs_Z_c /end REF_CHARACTERISTIC /end GROUP
/begin GROUP S1674_VTQR_LHMREDUTs_c "SWC_FDC_type/run_SWC_FDC_RxTx_5ms_sys/APP/TQR/Determine Torque Request/TorqueArbitrament/TorqueSmooth/Rear First order filter input tau map and determination/VTQR_LHMREDUTs_c" /begin REF_CHARACTERISTIC MTQR_LHMREDUTs_Z_c /end REF_CHARACTERISTIC /end GROUP
/begin GROUP S1674_VTQR_NORMALREDUTs_c "SWC_FDC_type/run_SWC_FDC_RxTx_5ms_sys/APP/TQR/Determine Torque Request/TorqueArbitrament/TorqueSmooth/Rear First order filter input tau map and determination/VTQR_NORMALREDUTs_c"
 /begin SUB_GROUP S1799_Invalid S1799_LV1 S1799_LV2 S1799_LV3 S1799_LV4 S1799_LV5 S1799_OPD /end SUB_GROUP
/end GROUP
/begin GROUP S1674_VTQR_SNOWREDUTs_c "SWC_FDC_type/run_SWC_FDC_RxTx_5ms_sys/APP/TQR/Determine Torque Request/TorqueArbitrament/TorqueSmooth/Rear First order filter input tau map and determination/VTQR_SNOWREDUTs_c" /begin REF_CHARACTERISTIC MTQR_SNOWREDUTs_Z_c /end REF_CHARACTERISTIC /end GROUP
/begin GROUP S1674_VTQR_SPORTREDUTs_c "SWC_FDC_type/run_SWC_FDC_RxTx_5ms_sys/APP/TQR/Determine Torque Request/TorqueArbitrament/TorqueSmooth/Rear First order filter input tau map and determination/VTQR_SPORTREDUTs_c"
 /begin SUB_GROUP S1801_Invalid S1801_LV1 S1801_LV2 S1801_LV3 S1801_LV4 S1801_LV5 S1801_OPD /end SUB_GROUP
/end GROUP
/begin GROUP S1674_VTQR_TCSREDUTs_c "SWC_FDC_type/run_SWC_FDC_RxTx_5ms_sys/APP/TQR/Determine Torque Request/TorqueArbitrament/TorqueSmooth/Rear First order filter input tau map and determination/VTQR_TCSREDUTs_c" /begin REF_CHARACTERISTIC MTQR_TCSREDUTs_Z_c /end REF_CHARACTERISTIC /end GROUP
/begin GROUP S1675_EcoLow "SWC_FDC_type/run_SWC_FDC_RxTx_5ms_sys/APP/TQR/Determine Torque Request/TorqueArbitrament/TorqueSmooth/Rear Torque zero point transfer boundary map/EcoLow" /begin REF_CHARACTERISTIC MTQR_RTqZeroTransLowBoundE_Y_Nm /end REF_CHARACTERISTIC /end GROUP
/begin GROUP S1675_EcoUP "SWC_FDC_type/run_SWC_FDC_RxTx_5ms_sys/APP/TQR/Determine Torque Request/TorqueArbitrament/TorqueSmooth/Rear Torque zero point transfer boundary map/EcoUP" /begin REF_CHARACTERISTIC MTQR_RTqZeroTransUpBoundE_Y_Nm /end REF_CHARACTERISTIC /end GROUP
/begin GROUP S1675_NormalLow "SWC_FDC_type/run_SWC_FDC_RxTx_5ms_sys/APP/TQR/Determine Torque Request/TorqueArbitrament/TorqueSmooth/Rear Torque zero point transfer boundary map/NormalLow" /begin REF_CHARACTERISTIC MTQR_RTqZeroTransLowBoundN_Y_Nm /end REF_CHARACTERISTIC /end GROUP
/begin GROUP S1675_NormalUP "SWC_FDC_type/run_SWC_FDC_RxTx_5ms_sys/APP/TQR/Determine Torque Request/TorqueArbitrament/TorqueSmooth/Rear Torque zero point transfer boundary map/NormalUP" /begin REF_CHARACTERISTIC MTQR_RTqZeroTransUpBoundN_Y_Nm /end REF_CHARACTERISTIC /end GROUP
/begin GROUP S1675_SportLow "SWC_FDC_type/run_SWC_FDC_RxTx_5ms_sys/APP/TQR/Determine Torque Request/TorqueArbitrament/TorqueSmooth/Rear Torque zero point transfer boundary map/SportLow" /begin REF_CHARACTERISTIC MTQR_RTqZeroTransLowBoundS_Y_Nm /end REF_CHARACTERISTIC /end GROUP
/begin GROUP S1675_SportUP "SWC_FDC_type/run_SWC_FDC_RxTx_5ms_sys/APP/TQR/Determine Torque Request/TorqueArbitrament/TorqueSmooth/Rear Torque zero point transfer boundary map/SportUP" /begin REF_CHARACTERISTIC MTQR_RTqZeroTransUpBoundS_Y_Nm /end REF_CHARACTERISTIC /end GROUP
/begin GROUP S1677_SR_Latch "SWC_FDC_type/run_SWC_FDC_RxTx_5ms_sys/APP/TQR/Determine Torque Request/TorqueArbitrament/TorqueSmooth/Rear torque ramp limtation and determination/SR_Latch" /begin REF_MEASUREMENT VTQR_RShaftSpdTqLimLow_flg /end REF_MEASUREMENT /end GROUP
/begin GROUP S1677_SR_Latch1 "SWC_FDC_type/run_SWC_FDC_RxTx_5ms_sys/APP/TQR/Determine Torque Request/TorqueArbitrament/TorqueSmooth/Rear torque ramp limtation and determination/SR_Latch1" /begin REF_MEASUREMENT VTQR_RTimerTqLimLow_flg /end REF_MEASUREMENT /end GROUP
/begin GROUP S1677_Timer "SWC_FDC_type/run_SWC_FDC_RxTx_5ms_sys/APP/TQR/Determine Torque Request/TorqueArbitrament/TorqueSmooth/Rear torque ramp limtation and determination/Timer" /begin REF_MEASUREMENT VTQR_RShaftSpdDevTime_s /end REF_MEASUREMENT /end GROUP
/begin GROUP S1679_Negative_Rate_limit_Determination "SWC_FDC_type/run_SWC_FDC_RxTx_5ms_sys/APP/TQR/Determine Torque Request/TorqueArbitrament/TorqueSmooth/Rear wheel rate limit determination/Negative Rate limit Determination"
 /begin SUB_GROUP S1837_VTQR_RrNegRateLimitDecE_Nm S1837_VTQR_RrNegRateLimitDecN_Nm S1837_VTQR_RrNegRateLimitDecS_Nm S1837_VTQR_RrNegRateLimitIncE_Nm S1837_VTQR_RrNegRateLimitIncN_Nm S1837_VTQR_RrNegRateLimitIncS_Nm /end SUB_GROUP
/end GROUP
/begin GROUP S1679_Positive_Rate_limit_Determination "SWC_FDC_type/run_SWC_FDC_RxTx_5ms_sys/APP/TQR/Determine Torque Request/TorqueArbitrament/TorqueSmooth/Rear wheel rate limit determination/Positive Rate limit Determination"
 /begin SUB_GROUP S1838_VTQR_RrPosRateLimitDecE_Nm S1838_VTQR_RrPosRateLimitDecN_Nm S1838_VTQR_RrPosRateLimitDecS_Nm S1838_VTQR_RrPosRateLimitIncE_Nm S1838_VTQR_RrPosRateLimitIncN_Nm S1838_VTQR_RrPosRateLimitIncS_Nm /end SUB_GROUP
/end GROUP
/begin GROUP S1679_VTQR_ECOREDURateLimitDec_Nm "SWC_FDC_type/run_SWC_FDC_RxTx_5ms_sys/APP/TQR/Determine Torque Request/TorqueArbitrament/TorqueSmooth/Rear wheel rate limit determination/VTQR_ECOREDURateLimitDec_Nm"
 /begin SUB_GROUP S1842_Invalid S1842_LV1 S1842_LV2 S1842_LV3 S1842_LV4 S1842_LV5 S1842_OPD /end SUB_GROUP
/end GROUP
/end MODULE
/end PROJECT
