AUTOSAR XML (schema 4-1-1)
standard types defined: VOID, boolean, float32, float64, sint16, sint32, sint64, sint8, uint16, uint32, uint64, uint8
