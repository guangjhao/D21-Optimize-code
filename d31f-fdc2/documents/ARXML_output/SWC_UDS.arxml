AUTOSAR XML (schema 4-3-0)
package /Impl_SWC_UDS_ARPkg
  swc implementation Impl_SWC_UDS_type: programming-language=C, sw-version=1.0.0, vendor-id=0, behavior=SWC_UDS_type_IB
    code-descriptors:
      code SRC: artifact-descriptors=autosar-engineering-object={short-label=EngObject, category=SWSRC}
    resource consumption ResourceConsumption
      memory section Mem_SWC_UDS_CODE: size=0, sw-addrmethod=CODE, symbol=CODE
package /SWC_UDS_ARPkg
  application sw component type SWC_UDS_type
    provide port P_UDSCDD: provided-interface=IF_UDSCDD
    behavior SWC_UDS_type_IB: handle-termination-and-restart=NO-SUPPORT, port-api-option{enable-take-address=false, indirect-api=false, port=P_UDSCDD}
      4 x operation invoked event:
        oie_P_UDSCDD_CSOP_DdmClearDTCNotification: start-on-event=run_GetClearDTCNotification, operation=P_UDSCDD.CSOP_DdmClearDTCNotification
        oie_P_UDSCDD_CSOP_DdmClearZevDTCNotification: start-on-event=run_GetClearZevDTCNotification, operation=P_UDSCDD.CSOP_DdmClearZevDTCNotification
        oie_P_UDSCDD_CSOP_DdmRestartOperationCycle: start-on-event=run_SetRestartOpCycle, operation=P_UDSCDD.CSOP_DdmRestartOperationCycle
        oie_P_UDSCDD_CSOP_SetDTCStatus: start-on-event=run_SetDTCStatus, operation=P_UDSCDD.CSOP_SetDTCStatus
      4 x runnable:
        run_GetClearDTCNotification
        run_GetClearZevDTCNotification
        run_SetDTCStatus
        run_SetRestartOpCycle
