AUTOSAR XML (schema 4-3-0)
package /Impl_SWC_LOG_ARPkg
  swc implementation Impl_SWC_LOG_type: programming-language=C, sw-version=1.0.0, vendor-id=0, behavior=SWC_LOG_type_IB
    code-descriptors:
      code SRC: artifact-descriptors=autosar-engineering-object={short-label=EngObject, category=SWSRC}
    resource consumption ResourceConsumption
      memory section Mem_SWC_LOG_CODE: size=0, sw-addrmethod=CODE, symbol=CODE
package /SWC_LOG_ARPkg
  application sw component type SWC_LOG_type
    behavior SWC_LOG_type_IB: handle-termination-and-restart=NO-SUPPORT
      timing event TE_100ms_SWC_LOG: start-on-event=run_SWC_LOG_100ms, period=0.1
      runnable run_SWC_LOG_100ms
