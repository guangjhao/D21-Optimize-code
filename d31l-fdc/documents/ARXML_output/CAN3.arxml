[part 2 of 2: packages /CAN3/ConstantSpecification to /CAN3/ImplementationDataTypes]
AUTOSAR XML (schema 4-3-0)
package /CAN3/ConstantSpecification
  527 x constant specification:
    Init_CAN3_BMSChckSum_1: value-spec=0
    Init_CAN3_BMSRolCnct_1: value-spec=0
    Init_CAN3_HVBPwrAvailChrg: value-spec=1500
    Init_CAN3_HVBPwrAvailChrg30: value-spec=0
    Init_CAN3_HVBPwrAvailChrg60: value-spec=1500
    Init_CAN3_HVBPwrAvailDchrg: value-spec=1500
    Init_CAN3_HVBPwrAvailDchrg30: value-spec=1500
    Init_CAN3_HVBPwrAvailDchrg60: value-spec=1500
    Init_CAN3_HVBattCurr: value-spec=10000
    Init_CAN3_HVBattVolt: value-spec=0
    Init_CAN3_SG_BMS1: value-spec=fields=[Init_CAN3_BMSChckSum_1, Init_CAN3_BMSRolCnct_1, Init_CAN3_HVBPwrAvailChrg, Init_CAN3_HVBPwrAvailChrg30, Init_CAN3_HVBPwrAvailChrg60, Init_CAN3_HVBPwrAvailDchrg, Init_CAN3_HVBPwrAvailDchrg30, Init_CAN3_HVBPwrAvailDchrg60, Init_CAN3_HVBattCurr, Init_CAN3_HVBattVolt]
    Init_CAN3_HVInVolt: value-spec=0
    Init_CAN3_LVBattDet12V: value-spec=0
    Init_CAN3_OBCDCCurLm: value-spec=255
    Init_CAN3_OBCDCVoltLm: value-spec=0
    Init_CAN3_ReChargerStaFromEvcc: value-spec=0
    Init_CAN3_SG_BMS2: value-spec=fields=[Init_CAN3_HVInVolt, Init_CAN3_LVBattDet12V, Init_CAN3_OBCDCCurLm, Init_CAN3_OBCDCVoltLm, Init_CAN3_ReChargerStaFromEvcc]
    Init_CAN3_ACChrgCurrDis: value-spec=10000
    Init_CAN3_BMS_HVBattCellBalance_Sta: value-spec=0
    Init_CAN3_Battsystfail_Num: value-spec=0
    Init_CAN3_CellType: value-spec=0
    Init_CAN3_HVBChrgPwr: value-spec=0
    Init_CAN3_HVBChrgPwrTotal: value-spec=0
    Init_CAN3_HVBDrvPwr: value-spec=0
    Init_CAN3_HVBDrvPwrTotal: value-spec=0
    Init_CAN3_HVBFullChrgPwr: value-spec=0
    Init_CAN3_HVBIsoImpedenceN: value-spec=0
    Init_CAN3_HVBIsoImpedenceP: value-spec=0
    Init_CAN3_HVBSOH: value-spec=0
    Init_CAN3_HVBattPackVolt: value-spec=0
    Init_CAN3_HVBattSOC: value-spec=0
    Init_CAN3_HVBattSOCDiff: value-spec=0
    Init_CAN3_HVBattSOCDis: value-spec=0
    Init_CAN3_RechrgCyc: value-spec=0
    Init_CAN3_RemainChrgTime: value-spec=0
    Init_CAN3_SOC_UseLimit: value-spec=0
    Init_CAN3_SG_BMS3: value-spec=fields=[Init_CAN3_ACChrgCurrDis, Init_CAN3_BMS_HVBattCellBalance_Sta, Init_CAN3_Battsystfail_Num, Init_CAN3_CellType, Init_CAN3_HVBChrgPwr, Init_CAN3_HVBChrgPwrTotal, Init_CAN3_HVBDrvPwr, Init_CAN3_HVBDrvPwrTotal, Init_CAN3_HVBFullChrgPwr, Init_CAN3_HVBIsoImpedenceN, Init_CAN3_HVBIsoImpedenceP, Init_CAN3_HVBSOH, Init_CAN3_HVBattPackVolt, Init_CAN3_HVBattSOC, Init_CAN3_HVBattSOCDiff, Init_CAN3_HVBattSOCDis, Init_CAN3_RechrgCyc, Init_CAN3_RemainChrgTime, Init_CAN3_SOC_UseLimit]
    Init_CAN3_CellTempAvg: value-spec=40
    Init_CAN3_HVBCellVoltMax: value-spec=0
    Init_CAN3_HVBCellVoltMin: value-spec=0
    Init_CAN3_HVBMTempMax: value-spec=40
    Init_CAN3_HVBMTempMin: value-spec=40
    Init_CAN3_MaxCellTemp_Num: value-spec=0
    Init_CAN3_MaxCellVolt_Num: value-spec=0
    Init_CAN3_MinCellTemp_Num: value-spec=0
    Init_CAN3_MinCellVolt_Num: value-spec=0
    Init_CAN3_Mtemp{01..20}: value-spec=0
    Init_CAN3_SG_BMS4: value-spec=fields=[Init_CAN3_CellTempAvg, Init_CAN3_HVBCellVoltMax, Init_CAN3_HVBCellVoltMin, Init_CAN3_HVBMTempMax, Init_CAN3_HVBMTempMin, Init_CAN3_MaxCellTemp_Num, Init_CAN3_MaxCellVolt_Num, Init_CAN3_MinCellTemp_Num, Init_CAN3_MinCellVolt_Num, Init_CAN3_Mtemp01, Init_CAN3_Mtemp02, Init_CAN3_Mtemp03, Init_CAN3_Mtemp04, Init_CAN3_Mtemp05, Init_CAN3_Mtemp06, Init_CAN3_Mtemp07, Init_CAN3_Mtemp08, Init_CAN3_Mtemp09, Init_CAN3_Mtemp10, Init_CAN3_Mtemp11, Init_CAN3_Mtemp12, Init_CAN3_Mtemp13, Init_CAN3_Mtemp14, Init_CAN3_Mtemp15, Init_CAN3_Mtemp16, Init_CAN3_Mtemp17, Init_CAN3_Mtemp18, Init_CAN3_Mtemp19, Init_CAN3_Mtemp20]
    Init_CAN3_BMSChckSum: value-spec=0
    Init_CAN3_BMSRolCnct: value-spec=0
    Init_CAN3_BMS_READY: value-spec=0
    Init_CAN3_BMS_Warn_{1..8}: value-spec=0
    Init_CAN3_CellUnconsistErr: value-spec=0
    Init_CAN3_ChrgInLockReq: value-spec=0
    Init_CAN3_ChrgPlugSta: value-spec=0
    Init_CAN3_DCChrgSysShockErr: value-spec=0
    Init_CAN3_DisChrgPlugErr: value-spec=0
    Init_CAN3_ExtChrgSta: value-spec=0
    Init_CAN3_HVBCellOvrVoltErr: value-spec=0
    Init_CAN3_HVBCellOvrVoltWarn: value-spec=0
    Init_CAN3_HVBCellUdrVoltWarn: value-spec=0
    Init_CAN3_HVBCellUnbalanErr: value-spec=0
    Init_CAN3_HVBCellUndrVoltErr: value-spec=0
    Init_CAN3_HVBChrgErr: value-spec=0
    Init_CAN3_HVBContactorSta: value-spec=0
    Init_CAN3_HVBHVILErr: value-spec=0
    Init_CAN3_HVBOvrChrgCurrErr: value-spec=0
    Init_CAN3_HVBOvrDchrgCurErr: value-spec=0
    Init_CAN3_HVBOvrSOCErr: value-spec=0
    Init_CAN3_HVBOvrTempErr: value-spec=0
    Init_CAN3_HVBOvrTempWarn: value-spec=0
    Init_CAN3_HVBOvrVoltErr: value-spec=0
    Init_CAN3_HVBPrechrgSta: value-spec=0
    Init_CAN3_HVBPreheatPrecoolSta: value-spec=0
    Init_CAN3_HVBSOCJumpError: value-spec=0
    Init_CAN3_HVBShrtChrgCurrErr: value-spec=0
    Init_CAN3_HVBShrtDischrgCurrErr: value-spec=0
    Init_CAN3_HVBTempDiffErr: value-spec=0
    Init_CAN3_HVBUndrSOCErr: value-spec=0
    Init_CAN3_HVBUndrTempErr: value-spec=0
    Init_CAN3_HVBUndrTempWarn: value-spec=0
    Init_CAN3_HVBUndrVoltErr: value-spec=0
    Init_CAN3_HVBattReady4Pre: value-spec=0
    Init_CAN3_HVILSta: value-spec=0
    Init_CAN3_IsoDetSta: value-spec=0
    Init_CAN3_SystemUncomErr: value-spec=0
    Init_CAN3_V2LSta: value-spec=0
    Init_CAN3_SG_BMS6: value-spec=fields=[Init_CAN3_BMSChckSum, Init_CAN3_BMSRolCnct, Init_CAN3_BMS_READY, Init_CAN3_BMS_Warn_1, Init_CAN3_BMS_Warn_2, Init_CAN3_BMS_Warn_3, Init_CAN3_BMS_Warn_4, Init_CAN3_BMS_Warn_5, Init_CAN3_BMS_Warn_6, Init_CAN3_BMS_Warn_7, Init_CAN3_BMS_Warn_8, Init_CAN3_CellUnconsistErr, Init_CAN3_ChrgInLockReq, Init_CAN3_ChrgPlugSta, Init_CAN3_DCChrgSysShockErr, Init_CAN3_DisChrgPlugErr, Init_CAN3_ExtChrgSta, Init_CAN3_HVBCellOvrVoltErr, Init_CAN3_HVBCellOvrVoltWarn, Init_CAN3_HVBCellUdrVoltWarn, Init_CAN3_HVBCellUnbalanErr, Init_CAN3_HVBCellUndrVoltErr, Init_CAN3_HVBChrgErr, Init_CAN3_HVBContactorSta, Init_CAN3_HVBHVILErr, Init_CAN3_HVBOvrChrgCurrErr, Init_CAN3_HVBOvrDchrgCurErr, Init_CAN3_HVBOvrSOCErr, Init_CAN3_HVBOvrTempErr, Init_CAN3_HVBOvrTempWarn, Init_CAN3_HVBOvrVoltErr, Init_CAN3_HVBPrechrgSta, Init_CAN3_HVBPreheatPrecoolSta, Init_CAN3_HVBSOCJumpError, Init_CAN3_HVBShrtChrgCurrErr, Init_CAN3_HVBShrtDischrgCurrErr, Init_CAN3_HVBTempDiffErr, Init_CAN3_HVBUndrSOCErr, Init_CAN3_HVBUndrTempErr, Init_CAN3_HVBUndrTempWarn, Init_CAN3_HVBUndrVoltErr, Init_CAN3_HVBattReady4Pre, Init_CAN3_HVILSta, Init_CAN3_IsoDetSta, Init_CAN3_SystemUncomErr, Init_CAN3_V2LSta]
    Init_CAN3_ChrgCurType: value-spec=0
    Init_CAN3_ChrgLampSta: value-spec=0
    Init_CAN3_FireDetErr: value-spec=0
    Init_CAN3_HVBattErr: value-spec=0
    Init_CAN3_SG_BMS7: value-spec=fields=[Init_CAN3_ChrgCurType, Init_CAN3_ChrgLampSta, Init_CAN3_FireDetErr, Init_CAN3_HVBattErr]
    Init_CAN3_CS_CCU1: value-spec=0
    Init_CAN3_DCDCAuxVolt: value-spec=0
    Init_CAN3_DCDCInVoltInf: value-spec=0
    Init_CAN3_DCDCPreCompleted: value-spec=0
    Init_CAN3_OBCDCCurrInf: value-spec=255
    Init_CAN3_OBCDCVoltInf: value-spec=0
    Init_CAN3_OBCPreCompleted: value-spec=0
    Init_CAN3_OBCWakeup4Plugin: value-spec=0
    Init_CAN3_RC_CCU1: value-spec=0
    Init_CAN3_SG_CCU1: value-spec=fields=[Init_CAN3_CS_CCU1, Init_CAN3_DCDCAuxVolt, Init_CAN3_DCDCInVoltInf, Init_CAN3_DCDCPreCompleted, Init_CAN3_OBCDCCurrInf, Init_CAN3_OBCDCVoltInf, Init_CAN3_OBCPreCompleted, Init_CAN3_OBCWakeup4Plugin, Init_CAN3_RC_CCU1]
    Init_CAN3_CS_CCU2: value-spec=0
    Init_CAN3_DCDCEnaSta: value-spec=0
    Init_CAN3_DCDCFaultSta: value-spec=0
    Init_CAN3_DCDCReady4Pre: value-spec=0
    Init_CAN3_DCDCTemp: value-spec=64
    Init_CAN3_OBCACCurrInf: value-spec=40
    Init_CAN3_OBCACVoltInf: value-spec=0
    Init_CAN3_OBCDCP: value-spec=350
    Init_CAN3_OBCEnaSta: value-spec=0
    Init_CAN3_OBCFaultSta: value-spec=0
    Init_CAN3_OBCPluginSta: value-spec=0
    Init_CAN3_OBCReady4Pre: value-spec=0
    Init_CAN3_OBCTemp: value-spec=160
    Init_CAN3_OBCV2LSta: value-spec=0
    Init_CAN3_OBC_AC_Cur_Lim: value-spec=0
    Init_CAN3_RC_CCU2: value-spec=0
    Init_CAN3_ReqOBCV2LEna: value-spec=0
    Init_CAN3_SG_CCU2: value-spec=fields=[Init_CAN3_CS_CCU2, Init_CAN3_DCDCEnaSta, Init_CAN3_DCDCFaultSta, Init_CAN3_DCDCReady4Pre, Init_CAN3_DCDCTemp, Init_CAN3_OBCACCurrInf, Init_CAN3_OBCACVoltInf, Init_CAN3_OBCDCP, Init_CAN3_OBCEnaSta, Init_CAN3_OBCFaultSta, Init_CAN3_OBCPluginSta, Init_CAN3_OBCReady4Pre, Init_CAN3_OBCTemp, Init_CAN3_OBCV2LSta, Init_CAN3_OBC_AC_Cur_Lim, Init_CAN3_RC_CCU2, Init_CAN3_ReqOBCV2LEna]
    Init_CAN3_DCDCAuxCur: value-spec=0
    Init_CAN3_DCDCHVCur: value-spec=0
    Init_CAN3_OBCV2LINVOTP: value-spec=0
    Init_CAN3_OBCV2LInsuFault: value-spec=0
    Init_CAN3_OBCV2LVinOVP: value-spec=0
    Init_CAN3_OBCV2LVinUVP: value-spec=0
    Init_CAN3_OBCV2LVoutOCP: value-spec=0
    Init_CAN3_OBCV2LVoutOVP: value-spec=0
    Init_CAN3_OBCV2LVoutUVP: value-spec=0
    Init_CAN3_SG_CCU4: value-spec=fields=[Init_CAN3_DCDCAuxCur, Init_CAN3_DCDCHVCur, Init_CAN3_OBCV2LINVOTP, Init_CAN3_OBCV2LInsuFault, Init_CAN3_OBCV2LVinOVP, Init_CAN3_OBCV2LVinUVP, Init_CAN3_OBCV2LVoutOCP, Init_CAN3_OBCV2LVoutOVP, Init_CAN3_OBCV2LVoutUVP]
    Init_CAN3_AllDoorSW: value-spec=0
    Init_CAN3_AntiTheftSeatFold: value-spec=0
    Init_CAN3_AntitheftSta: value-spec=0
    Init_CAN3_BCM_Buzzer_Req: value-spec=0
    Init_CAN3_BCM_DoorLock_Sta: value-spec=0
    Init_CAN3_BrakeLamp: value-spec=0
    Init_CAN3_CTDCtrl: value-spec=0
    Init_CAN3_CTDLockSW: value-spec=0
    Init_CAN3_CTDUnlockSW: value-spec=0
    Init_CAN3_CrashDetd: value-spec=0
    Init_CAN3_Dimmer: value-spec=0
    Init_CAN3_DimmerEN: value-spec=0
    Init_CAN3_DoorLockIND: value-spec=0
    Init_CAN3_DrDoorSW: value-spec=0
    Init_CAN3_Fr_ChargingDoorCtrl: value-spec=0
    Init_CAN3_Fr_FogLamp: value-spec=0
    Init_CAN3_Fr_Wiper_H: value-spec=0
    Init_CAN3_Fr_Wiper_L: value-spec=0
    Init_CAN3_H_Beam: value-spec=0
    Init_CAN3_HazardSW: value-spec=0
    Init_CAN3_HoodSW: value-spec=0
    Init_CAN3_HornCtrl: value-spec=0
    Init_CAN3_LBSD: value-spec=0
    Init_CAN3_LDRL: value-spec=0
    Init_CAN3_LTurnLP: value-spec=0
    Init_CAN3_L_APM_WdwEnable: value-spec=0
    Init_CAN3_L_Beam: value-spec=0
    Init_CAN3_LockSetting: value-spec=0
    Init_CAN3_MirrorCtrl: value-spec=0
    Init_CAN3_MirrorDefog: value-spec=0
    Init_CAN3_PmicBootReason: value-spec=0
    Init_CAN3_PosLamp: value-spec=0
    Init_CAN3_PsDoorSW: value-spec=0
    Init_CAN3_RBSD: value-spec=0
    Init_CAN3_RDRL: value-spec=0
    Init_CAN3_RLDoorSW: value-spec=0
    Init_CAN3_RRDoorSW: value-spec=0
    Init_CAN3_RTurnLP: value-spec=0
    Init_CAN3_ReverseLamp: value-spec=0
    Init_CAN3_RoomLampH: value-spec=0
    Init_CAN3_RoomLampL: value-spec=0
    Init_CAN3_Rr_ChargingDoorCtrl: value-spec=0
    Init_CAN3_Rr_Defog: value-spec=0
    Init_CAN3_Rr_FogLamp: value-spec=0
    Init_CAN3_Rr_Wiper: value-spec=0
    Init_CAN3_TailgateHDSW: value-spec=0
    Init_CAN3_TailgateRemote: value-spec=0
    Init_CAN3_Tailgate_SW: value-spec=0
    Init_CAN3_TrunkRel: value-spec=0
    Init_CAN3_WasherCtrl: value-spec=0
    Init_CAN3_WiperFixMode: value-spec=0
    Init_CAN3_WisrBootReason: value-spec=0
    Init_CAN3_SG_FD_BCM1: value-spec=fields=[Init_CAN3_AllDoorSW, Init_CAN3_AntiTheftSeatFold, Init_CAN3_AntitheftSta, Init_CAN3_BCM_Buzzer_Req, Init_CAN3_BCM_DoorLock_Sta, Init_CAN3_BrakeLamp, Init_CAN3_CTDCtrl, Init_CAN3_CTDLockSW, Init_CAN3_CTDUnlockSW, Init_CAN3_CrashDetd, Init_CAN3_Dimmer, Init_CAN3_DimmerEN, Init_CAN3_DoorLockIND, Init_CAN3_DrDoorSW, Init_CAN3_Fr_ChargingDoorCtrl, Init_CAN3_Fr_FogLamp, Init_CAN3_Fr_Wiper_H, Init_CAN3_Fr_Wiper_L, Init_CAN3_H_Beam, Init_CAN3_HazardSW, Init_CAN3_HoodSW, Init_CAN3_HornCtrl, Init_CAN3_LBSD, Init_CAN3_LDRL, Init_CAN3_LTurnLP, Init_CAN3_L_APM_WdwEnable, Init_CAN3_L_Beam, Init_CAN3_LockSetting, Init_CAN3_MirrorCtrl, Init_CAN3_MirrorDefog, Init_CAN3_PmicBootReason, Init_CAN3_PosLamp, Init_CAN3_PsDoorSW, Init_CAN3_RBSD, Init_CAN3_RDRL, Init_CAN3_RLDoorSW, Init_CAN3_RRDoorSW, Init_CAN3_RTurnLP, Init_CAN3_ReverseLamp, Init_CAN3_RoomLampH, Init_CAN3_RoomLampL, Init_CAN3_Rr_ChargingDoorCtrl, Init_CAN3_Rr_Defog, Init_CAN3_Rr_FogLamp, Init_CAN3_Rr_Wiper, Init_CAN3_TailgateHDSW, Init_CAN3_TailgateRemote, Init_CAN3_Tailgate_SW, Init_CAN3_TrunkRel, Init_CAN3_WasherCtrl, Init_CAN3_WiperFixMode, Init_CAN3_WisrBootReason]
    Init_CAN3_OTA_DL_Available: value-spec=0
    Init_CAN3_OTA_DL_Speed: value-spec=0
    Init_CAN3_OTA_InVehicle_FW: value-spec=0
    Init_CAN3_OTA_Lock_Req: value-spec=0
    Init_CAN3_OTA_MDA_Status: value-spec=0
    Init_CAN3_OTA_Mode: value-spec=0
    Init_CAN3_OTA_Network_Type: value-spec=0
    Init_CAN3_OTA_Progress_Rate: value-spec=0
    Init_CAN3_OTA_TBOXResetReq: value-spec=0
    Init_CAN3_OTA_Up_Backcount: value-spec=0
    Init_CAN3_OTA_Update_Available: value-spec=0
    Init_CAN3_OTA_Updating_ECU: value-spec=0
    Init_CAN3_SG_FD_OTA1: value-spec=fields=[Init_CAN3_OTA_DL_Available, Init_CAN3_OTA_DL_Speed, Init_CAN3_OTA_InVehicle_FW, Init_CAN3_OTA_Lock_Req, Init_CAN3_OTA_MDA_Status, Init_CAN3_OTA_Mode, Init_CAN3_OTA_Network_Type, Init_CAN3_OTA_Progress_Rate, Init_CAN3_OTA_TBOXResetReq, Init_CAN3_OTA_Up_Backcount, Init_CAN3_OTA_Update_Available, Init_CAN3_OTA_Updating_ECU]
    Init_CAN3_BatteryMode: value-spec=0
    Init_CAN3_CCU_ACLampSts: value-spec=0
    Init_CAN3_CCU_ACMaxLampSts: value-spec=0
    Init_CAN3_CCU_AutoLampSts: value-spec=0
    Init_CAN3_CCU_AutoMidLampSts: value-spec=0
    Init_CAN3_CCU_Dispaly_Request: value-spec=0
    Init_CAN3_CCU_EcoSts: value-spec=0
    Init_CAN3_CCU_FrtOnOffLampSts: value-spec=0
    Init_CAN3_CCU_HEATMaxLampSts: value-spec=0
    Init_CAN3_CCU_RrOnOffLampSts: value-spec=0
    Init_CAN3_CCU_SyncLampSts: value-spec=0
    Init_CAN3_CabinMode: value-spec=0
    Init_CAN3_EDriveMode: value-spec=0
    Init_CAN3_FD_AGS_Cmd: value-spec=0
    Init_CAN3_FD_RecyAuto_Cmd: value-spec=0
    Init_CAN3_Fr_Coolantflow: value-spec=0
    Init_CAN3_Fr_Coolanttemp: value-spec=40
    Init_CAN3_HPThermalRecoveryReq: value-spec=0
    Init_CAN3_Rr_Coolantflow: value-spec=0
    Init_CAN3_Rr_Coolanttemp: value-spec=40
    Init_CAN3_sigAirIntenZon1St: value-spec=0
    Init_CAN3_sigAirIntenZon3St: value-spec=0
    Init_CAN3_sigAmbAirT: value-spec=0
    Init_CAN3_sigCbnAirT: value-spec=0
    Init_CAN3_sigCbnPTCPwrAct: value-spec=0
    Init_CAN3_sigCbnSolarLeft: value-spec=253
    Init_CAN3_sigCbnSolarRight: value-spec=253
    Init_CAN3_sigClmtCmprPwrAct: value-spec=0
    Init_CAN3_sigClntTHvBattOut: value-spec=120
    Init_CAN3_sigDfrstSt: value-spec=0
    Init_CAN3_sigHvacSt: value-spec=0
    Init_CAN3_sigRecircSt: value-spec=0
    Init_CAN3_sigSetTempZon{1..3}St: value-spec=0
    Init_CAN3_sigWindDirZon1St: value-spec=0
    Init_CAN3_sigWindDirZon3St: value-spec=0
    Init_CAN3_SG_FD_THCM1: value-spec=fields=[Init_CAN3_BatteryMode, Init_CAN3_CCU_ACLampSts, Init_CAN3_CCU_ACMaxLampSts, Init_CAN3_CCU_AutoLampSts, Init_CAN3_CCU_AutoMidLampSts, Init_CAN3_CCU_Dispaly_Request, Init_CAN3_CCU_EcoSts, Init_CAN3_CCU_FrtOnOffLampSts, Init_CAN3_CCU_HEATMaxLampSts, Init_CAN3_CCU_RrOnOffLampSts, Init_CAN3_CCU_SyncLampSts, Init_CAN3_CabinMode, Init_CAN3_EDriveMode, Init_CAN3_FD_AGS_Cmd, Init_CAN3_FD_RecyAuto_Cmd, Init_CAN3_Fr_Coolantflow, Init_CAN3_Fr_Coolanttemp, Init_CAN3_HPThermalRecoveryReq, Init_CAN3_Rr_Coolantflow, Init_CAN3_Rr_Coolanttemp, Init_CAN3_sigAirIntenZon1St, Init_CAN3_sigAirIntenZon3St, Init_CAN3_sigAmbAirT, Init_CAN3_sigCbnAirT, Init_CAN3_sigCbnPTCPwrAct, Init_CAN3_sigCbnSolarLeft, Init_CAN3_sigCbnSolarRight, Init_CAN3_sigClmtCmprPwrAct, Init_CAN3_sigClntTHvBattOut, Init_CAN3_sigDfrstSt, Init_CAN3_sigHvacSt, Init_CAN3_sigRecircSt, Init_CAN3_sigSetTempZon1St, Init_CAN3_sigSetTempZon2St, Init_CAN3_sigSetTempZon3St, Init_CAN3_sigWindDirZon1St, Init_CAN3_sigWindDirZon3St]
    Init_CAN3_ACSubMode: value-spec=0
    Init_CAN3_APTC_ActFrRiPwr: value-spec=0
    Init_CAN3_BatLoopActWtFlw: value-spec=0
    Init_CAN3_CCU_CbnPreACWkSts: value-spec=0
    Init_CAN3_CCU_CbnPreEstimdTi: value-spec=0
    Init_CAN3_CCU_CbnPreSts: value-spec=0
    Init_CAN3_CCU_HiVoltageReq: value-spec=0
    Init_CAN3_CoolgFanActDuty: value-spec=0
    Init_CAN3_DeiceModReq: value-spec=0
    Init_CAN3_FD_Blower_Cmd: value-spec=0
    Init_CAN3_FD_Comp_Cmd: value-spec=0
    Init_CAN3_FD_EWP{1..3}_Cmd: value-spec=0
    Init_CAN3_FD_EXV1_Cmd: value-spec=0
    Init_CAN3_FD_EXV2_Cmd: value-spec=0
    Init_CAN3_FD_FWV_Cmd: value-spec=0
    Init_CAN3_FD_FrLeAPTCHeatPwr_Cmd: value-spec=0
    Init_CAN3_FD_FrRiAPTCHeatPwr_Cmd: value-spec=0
    Init_CAN3_FD_FrWPTCHeatPwr_Cmd: value-spec=0
    Init_CAN3_FD_RrAPTCHeatPwr_Cmd: value-spec=0
    Init_CAN3_FD_SOTXV_Cmd: value-spec=0
    Init_CAN3_FD_SOV{1..3}_Cmd: value-spec=0
    Init_CAN3_FD_TWV_Cmd: value-spec=0
    Init_CAN3_SG_FD_THCM2: value-spec=fields=[Init_CAN3_ACSubMode, Init_CAN3_APTC_ActFrRiPwr, Init_CAN3_BatLoopActWtFlw, Init_CAN3_CCU_CbnPreACWkSts, Init_CAN3_CCU_CbnPreEstimdTi, Init_CAN3_CCU_CbnPreSts, Init_CAN3_CCU_HiVoltageReq, Init_CAN3_CoolgFanActDuty, Init_CAN3_DeiceModReq, Init_CAN3_FD_Blower_Cmd, Init_CAN3_FD_Comp_Cmd, Init_CAN3_FD_EWP1_Cmd, Init_CAN3_FD_EWP2_Cmd, Init_CAN3_FD_EWP3_Cmd, Init_CAN3_FD_EXV1_Cmd, Init_CAN3_FD_EXV2_Cmd, Init_CAN3_FD_FWV_Cmd, Init_CAN3_FD_FrLeAPTCHeatPwr_Cmd, Init_CAN3_FD_FrRiAPTCHeatPwr_Cmd, Init_CAN3_FD_FrWPTCHeatPwr_Cmd, Init_CAN3_FD_RrAPTCHeatPwr_Cmd, Init_CAN3_FD_SOTXV_Cmd, Init_CAN3_FD_SOV1_Cmd, Init_CAN3_FD_SOV2_Cmd, Init_CAN3_FD_SOV3_Cmd, Init_CAN3_FD_TWV_Cmd]
    Init_CAN3_Req_OBCV2LEna: value-spec=0
    Init_CAN3_Req_V2LSwOn: value-spec=0
    Init_CAN3_Req_V2L_IVI_Popup: value-spec=0
    Init_CAN3_SG_FD_V2L1: value-spec=fields=[Init_CAN3_Req_OBCV2LEna, Init_CAN3_Req_V2LSwOn, Init_CAN3_Req_V2L_IVI_Popup]
    Init_CAN3_EVCCAplusPwrUpReq: value-spec=0
    Init_CAN3_FDADC12VDet: value-spec=0
    Init_CAN3_FDADC12VDetAvg: value-spec=0
    Init_CAN3_FDC_VCU_ActMaxSlideRate_Sta: value-spec=15000
    Init_CAN3_FDC_VCU_AllowMovThd_OTA_Sta: value-spec=0
    Init_CAN3_FDC_VCU_DTCCarousel_Sta: value-spec=0
    Init_CAN3_FDC_VCU_ForceP_Cmd: value-spec=0
    Init_CAN3_FDC_VCU_PwrReq_OTA_Sta: value-spec=0
    Init_CAN3_FDC_VCU_RWDRDCActive_Sta: value-spec=0
    Init_CAN3_FDC_VCU_RegenTqLimitEn_Sta: value-spec=0
    Init_CAN3_FDC_VCU_SlideRegenLimTq_Sta: value-spec=10600
    Init_CAN3_FDC_VCU_VehActSpd_Sta: value-spec=30000
    Init_CAN3_FDC_VCU_VehMalfunLevel_Sta: value-spec=0
    Init_CAN3_FDC_VMC_ActStESCYaw_Sta: value-spec=30000
    Init_CAN3_FDC_VMC_AntiSpdLimEn_Sta: value-spec=0
    Init_CAN3_FDC_VMC_LongAcc_Sta: value-spec=20000
    Init_CAN3_Fr_TqSource: value-spec=0
    Init_CAN3_HVRlyOpFail: value-spec=0
    Init_CAN3_HVTHCMSysAvail: value-spec=0
    Init_CAN3_LVBattChrgtimeAct: value-spec=0
    Init_CAN3_LVBattVoltSta: value-spec=0
    Init_CAN3_LVChrgHoldTAct: value-spec=0
    Init_CAN3_LVSilentChrgLv: value-spec=0
    Init_CAN3_LVSilentChrgReq: value-spec=0
    Init_CAN3_LVSilentChrgSta: value-spec=0
    Init_CAN3_MCUActDisFail: value-spec=0
    Init_CAN3_PMMAllowECUSleep: value-spec=0
    Init_CAN3_PowerDownFault: value-spec=0
    Init_CAN3_PowerDownState: value-spec=0
    Init_CAN3_PowerUpFault: value-spec=0
    Init_CAN3_PowerUpState: value-spec=0
    Init_CAN3_PwrDownReq: value-spec=0
    Init_CAN3_PwrStaConstraint: value-spec=0
    Init_CAN3_PwrStaONTOIVIPopReq: value-spec=0
    Init_CAN3_PwrStaONTOIVIPopT: value-spec=0
    Init_CAN3_PwrStaSelect: value-spec=0
    Init_CAN3_PwrStaTOSta: value-spec=0
    Init_CAN3_PwrUpReq: value-spec=0
    Init_CAN3_Rr_TqSource: value-spec=0
    Init_CAN3_SchedChgTOSta: value-spec=0
    Init_CAN3_SilentChkAllowSleep: value-spec=0
    Init_CAN3_SysAllowReadySta: value-spec=0
    Init_CAN3_SysPwrSta: value-spec=0
    Init_CAN3_TCountSta: value-spec=0
    Init_CAN3_TimerAllowSleep: value-spec=0
    Init_CAN3_VCUBrkSWSta: value-spec=0
    Init_CAN3_VCUFLDoorSta: value-spec=0
    Init_CAN3_VCUFRDoorSta: value-spec=0
    Init_CAN3_VCURLDoorSta: value-spec=0
    Init_CAN3_VCURRDoorSta: value-spec=0
    Init_CAN3_VehHVPwrAvail4THCM: value-spec=0
    Init_CAN3_SG_FD_VCU0: value-spec=fields=[Init_CAN3_EVCCAplusPwrUpReq, Init_CAN3_FDADC12VDet, Init_CAN3_FDADC12VDetAvg, Init_CAN3_FDC_VCU_ActMaxSlideRate_Sta, Init_CAN3_FDC_VCU_AllowMovThd_OTA_Sta, Init_CAN3_FDC_VCU_DTCCarousel_Sta, Init_CAN3_FDC_VCU_ForceP_Cmd, Init_CAN3_FDC_VCU_PwrReq_OTA_Sta, Init_CAN3_FDC_VCU_RWDRDCActive_Sta, Init_CAN3_FDC_VCU_RegenTqLimitEn_Sta, Init_CAN3_FDC_VCU_SlideRegenLimTq_Sta, Init_CAN3_FDC_VCU_VehActSpd_Sta, Init_CAN3_FDC_VCU_VehMalfunLevel_Sta, Init_CAN3_FDC_VMC_ActStESCYaw_Sta, Init_CAN3_FDC_VMC_AntiSpdLimEn_Sta, Init_CAN3_FDC_VMC_LongAcc_Sta, Init_CAN3_Fr_TqSource, Init_CAN3_HVRlyOpFail, Init_CAN3_HVTHCMSysAvail, Init_CAN3_LVBattChrgtimeAct, Init_CAN3_LVBattVoltSta, Init_CAN3_LVChrgHoldTAct, Init_CAN3_LVSilentChrgLv, Init_CAN3_LVSilentChrgReq, Init_CAN3_LVSilentChrgSta, Init_CAN3_MCUActDisFail, Init_CAN3_PMMAllowECUSleep, Init_CAN3_PowerDownFault, Init_CAN3_PowerDownState, Init_CAN3_PowerUpFault, Init_CAN3_PowerUpState, Init_CAN3_PwrDownReq, Init_CAN3_PwrStaConstraint, Init_CAN3_PwrStaONTOIVIPopReq, Init_CAN3_PwrStaONTOIVIPopT, Init_CAN3_PwrStaSelect, Init_CAN3_PwrStaTOSta, Init_CAN3_PwrUpReq, Init_CAN3_Rr_TqSource, Init_CAN3_SchedChgTOSta, Init_CAN3_SilentChkAllowSleep, Init_CAN3_SysAllowReadySta, Init_CAN3_SysPwrSta, Init_CAN3_TCountSta, Init_CAN3_TimerAllowSleep, Init_CAN3_VCUBrkSWSta, Init_CAN3_VCUFLDoorSta, Init_CAN3_VCUFRDoorSta, Init_CAN3_VCURLDoorSta, Init_CAN3_VCURRDoorSta, Init_CAN3_VehHVPwrAvail4THCM]
    Init_CAN3_ActiveDischReq: value-spec=0
    Init_CAN3_CS_VCU1: value-spec=0
    Init_CAN3_CoastDwModeStaChk: value-spec=0
    Init_CAN3_DCDCEnaReq: value-spec=0
    Init_CAN3_DCDCVoltSetpoint: value-spec=0
    Init_CAN3_DemoModeStaChk: value-spec=0
    Init_CAN3_Dr_SeatSta: value-spec=0
    Init_CAN3_DynoModeStaChk: value-spec=0
    Init_CAN3_Fr_ActvDmpDisabReq: value-spec=0
    Init_CAN3_Fr_MCUEnaReq: value-spec=0
    Init_CAN3_HVBatCnctReq: value-spec=0
    Init_CAN3_HVSysReadyToCharge: value-spec=0
    Init_CAN3_LVChrgFuncStaChk: value-spec=0
    Init_CAN3_MSA_Crl_Sta: value-spec=0
    Init_CAN3_PrkReq: value-spec=0
    Init_CAN3_PwrSta: value-spec=0
    Init_CAN3_RC_VCU1: value-spec=0
    Init_CAN3_Rr_ActvDmpDisabReq: value-spec=0
    Init_CAN3_Rr_MCUEnaReq: value-spec=0
    Init_CAN3_ShiftGearPosn: value-spec=0
    Init_CAN3_SG_FD_VCU1: value-spec=fields=[Init_CAN3_ActiveDischReq, Init_CAN3_CS_VCU1, Init_CAN3_CoastDwModeStaChk, Init_CAN3_DCDCEnaReq, Init_CAN3_DCDCVoltSetpoint, Init_CAN3_DemoModeStaChk, Init_CAN3_Dr_SeatSta, Init_CAN3_DynoModeStaChk, Init_CAN3_Fr_ActvDmpDisabReq, Init_CAN3_Fr_MCUEnaReq, Init_CAN3_HVBatCnctReq, Init_CAN3_HVSysReadyToCharge, Init_CAN3_LVChrgFuncStaChk, Init_CAN3_MSA_Crl_Sta, Init_CAN3_PrkReq, Init_CAN3_PwrSta, Init_CAN3_RC_VCU1, Init_CAN3_Rr_ActvDmpDisabReq, Init_CAN3_Rr_MCUEnaReq, Init_CAN3_ShiftGearPosn]
    Init_CAN3_CS_VCU2_CAN1: value-spec=0
    Init_CAN3_Fr_IdcMax: value-spec=0
    Init_CAN3_Fr_IdcMin: value-spec=0
    Init_CAN3_Fr_TMTqReq: value-spec=530
    Init_CAN3_Fr_TorqMax: value-spec=0
    Init_CAN3_Fr_TorqMin: value-spec=0
    Init_CAN3_Fr_UdcMax: value-spec=0
    Init_CAN3_Fr_UdcMin: value-spec=0
    Init_CAN3_RC_VCU2_CAN1: value-spec=0
    Init_CAN3_Rr_IdcMax: value-spec=0
    Init_CAN3_Rr_IdcMin: value-spec=0
    Init_CAN3_Rr_TMTqReq: value-spec=530
    Init_CAN3_Rr_TorqMax: value-spec=0
    Init_CAN3_Rr_TorqMin: value-spec=0
    Init_CAN3_Rr_UdcMax: value-spec=0
    Init_CAN3_Rr_UdcMin: value-spec=0
    Init_CAN3_SG_FD_VCU2: value-spec=fields=[Init_CAN3_CS_VCU2_CAN1, Init_CAN3_Fr_IdcMax, Init_CAN3_Fr_IdcMin, Init_CAN3_Fr_TMTqReq, Init_CAN3_Fr_TorqMax, Init_CAN3_Fr_TorqMin, Init_CAN3_Fr_UdcMax, Init_CAN3_Fr_UdcMin, Init_CAN3_RC_VCU2_CAN1, Init_CAN3_Rr_IdcMax, Init_CAN3_Rr_IdcMin, Init_CAN3_Rr_TMTqReq, Init_CAN3_Rr_TorqMax, Init_CAN3_Rr_TorqMin, Init_CAN3_Rr_UdcMax, Init_CAN3_Rr_UdcMin]
    Init_CAN3_Fr_ActvDmpDisabSta: value-spec=0
    Init_CAN3_Fr_EDUDrtSta: value-spec=0
    Init_CAN3_Fr_EDUOpratingSta: value-spec=0
    Init_CAN3_Fr_EDURealTMTq: value-spec=0
    Init_CAN3_Fr_EDURotateDirction: value-spec=0
    Init_CAN3_Fr_EDUTqReqFbk: value-spec=1022
    Init_CAN3_Fr_MCU1Chksum: value-spec=0
    Init_CAN3_Fr_MCU1RolCnt: value-spec=0
    Init_CAN3_Fr_MCUBAT: value-spec=0
    Init_CAN3_Fr_MCUDCBusCurr: value-spec=0
    Init_CAN3_Fr_MCUDCBusVolt: value-spec=0
    Init_CAN3_Fr_MCUDischrgSta: value-spec=0
    Init_CAN3_Fr_MCUEnaSta: value-spec=0
    Init_CAN3_Fr_MCUErr: value-spec=0
    Init_CAN3_Fr_MCUIGN_sta: value-spec=0
    Init_CAN3_Fr_MCUReady: value-spec=0
    Init_CAN3_Fr_MCUReady4Pre: value-spec=0
    Init_CAN3_Fr_MCUSysSta: value-spec=0
    Init_CAN3_Fr_MCUTemp: value-spec=0
    Init_CAN3_Fr_MotorAvailTq: value-spec=0
    Init_CAN3_Fr_RegenAvailTq: value-spec=0
    Init_CAN3_Fr_Reserved_bits: value-spec=0
    Init_CAN3_Fr_TMSpd: value-spec=17000
    Init_CAN3_Fr_TMTemp: value-spec=0
    Init_CAN3_Fr_TMid: value-spec=0
    Init_CAN3_Fr_TMiq: value-spec=0
    Init_CAN3_MCUWarn_F: value-spec=7
    Init_CAN3_SG_MCU_F1: value-spec=fields=[Init_CAN3_Fr_ActvDmpDisabSta, Init_CAN3_Fr_EDUDrtSta, Init_CAN3_Fr_EDUOpratingSta, Init_CAN3_Fr_EDURealTMTq, Init_CAN3_Fr_EDURotateDirction, Init_CAN3_Fr_EDUTqReqFbk, Init_CAN3_Fr_MCU1Chksum, Init_CAN3_Fr_MCU1RolCnt, Init_CAN3_Fr_MCUBAT, Init_CAN3_Fr_MCUDCBusCurr, Init_CAN3_Fr_MCUDCBusVolt, Init_CAN3_Fr_MCUDischrgSta, Init_CAN3_Fr_MCUEnaSta, Init_CAN3_Fr_MCUErr, Init_CAN3_Fr_MCUIGN_sta, Init_CAN3_Fr_MCUReady, Init_CAN3_Fr_MCUReady4Pre, Init_CAN3_Fr_MCUSysSta, Init_CAN3_Fr_MCUTemp, Init_CAN3_Fr_MotorAvailTq, Init_CAN3_Fr_RegenAvailTq, Init_CAN3_Fr_Reserved_bits, Init_CAN3_Fr_TMSpd, Init_CAN3_Fr_TMTemp, Init_CAN3_Fr_TMid, Init_CAN3_Fr_TMiq, Init_CAN3_MCUWarn_F]
    Init_CAN3_Fr_CoolanttempReq: value-spec=40
    Init_CAN3_Fr_EOP_SpdSet: value-spec=0
    Init_CAN3_Fr_Failcode1: value-spec=0
    Init_CAN3_Fr_Failcode2: value-spec=0
    Init_CAN3_Fr_Failcodehistory1: value-spec=0
    Init_CAN3_Fr_Failcodehistory2: value-spec=0
    Init_CAN3_Fr_LLCTemp: value-spec=0
    Init_CAN3_Fr_LLCflowReq: value-spec=0
    Init_CAN3_Fr_MCU2Chksum: value-spec=0
    Init_CAN3_Fr_MCU2RolCnt: value-spec=0
    Init_CAN3_Fr_MCUTempWarn: value-spec=0
    Init_CAN3_Fr_TMTempWarn: value-spec=0
    Init_CAN3_MCU_F_ResetCnt_Sta: value-spec=0
    Init_CAN3_SG_MCU_F2: value-spec=fields=[Init_CAN3_Fr_CoolanttempReq, Init_CAN3_Fr_EOP_SpdSet, Init_CAN3_Fr_Failcode1, Init_CAN3_Fr_Failcode2, Init_CAN3_Fr_Failcodehistory1, Init_CAN3_Fr_Failcodehistory2, Init_CAN3_Fr_LLCTemp, Init_CAN3_Fr_LLCflowReq, Init_CAN3_Fr_MCU2Chksum, Init_CAN3_Fr_MCU2RolCnt, Init_CAN3_Fr_MCUTempWarn, Init_CAN3_Fr_TMTempWarn, Init_CAN3_MCU_F_ResetCnt_Sta]
    Init_CAN3_MCUWarn_R: value-spec=7
    Init_CAN3_Rr_ActvDmpDisabSta: value-spec=0
    Init_CAN3_Rr_EDUDrtSta: value-spec=0
    Init_CAN3_Rr_EDUOpratingSta: value-spec=0
    Init_CAN3_Rr_EDURealTMTq: value-spec=1022
    Init_CAN3_Rr_EDURotateDirction: value-spec=0
    Init_CAN3_Rr_EDUTqReqFbk: value-spec=1022
    Init_CAN3_Rr_MCU1Chksum: value-spec=0
    Init_CAN3_Rr_MCU1RolCnt: value-spec=0
    Init_CAN3_Rr_MCUBAT: value-spec=0
    Init_CAN3_Rr_MCUDCBusCurr: value-spec=15000
    Init_CAN3_Rr_MCUDCBusVolt: value-spec=0
    Init_CAN3_Rr_MCUDischrgSta: value-spec=0
    Init_CAN3_Rr_MCUEnaSta: value-spec=0
    Init_CAN3_Rr_MCUErr: value-spec=0
    Init_CAN3_Rr_MCUIGN_sta: value-spec=0
    Init_CAN3_Rr_MCUReady: value-spec=0
    Init_CAN3_Rr_MCUReady4Pre: value-spec=0
    Init_CAN3_Rr_MCUSysSta: value-spec=0
    Init_CAN3_Rr_MCUTemp: value-spec=0
    Init_CAN3_Rr_MotorAvailTq: value-spec=0
    Init_CAN3_Rr_RegenAvailTq: value-spec=0
    Init_CAN3_Rr_Reserved_bits: value-spec=0
    Init_CAN3_Rr_TMSpd: value-spec=17000
    Init_CAN3_Rr_TMTemp: value-spec=0
    Init_CAN3_Rr_TMid: value-spec=15000
    Init_CAN3_Rr_TMiq: value-spec=15000
    Init_CAN3_SG_MCU_R1: value-spec=fields=[Init_CAN3_MCUWarn_R, Init_CAN3_Rr_ActvDmpDisabSta, Init_CAN3_Rr_EDUDrtSta, Init_CAN3_Rr_EDUOpratingSta, Init_CAN3_Rr_EDURealTMTq, Init_CAN3_Rr_EDURotateDirction, Init_CAN3_Rr_EDUTqReqFbk, Init_CAN3_Rr_MCU1Chksum, Init_CAN3_Rr_MCU1RolCnt, Init_CAN3_Rr_MCUBAT, Init_CAN3_Rr_MCUDCBusCurr, Init_CAN3_Rr_MCUDCBusVolt, Init_CAN3_Rr_MCUDischrgSta, Init_CAN3_Rr_MCUEnaSta, Init_CAN3_Rr_MCUErr, Init_CAN3_Rr_MCUIGN_sta, Init_CAN3_Rr_MCUReady, Init_CAN3_Rr_MCUReady4Pre, Init_CAN3_Rr_MCUSysSta, Init_CAN3_Rr_MCUTemp, Init_CAN3_Rr_MotorAvailTq, Init_CAN3_Rr_RegenAvailTq, Init_CAN3_Rr_Reserved_bits, Init_CAN3_Rr_TMSpd, Init_CAN3_Rr_TMTemp, Init_CAN3_Rr_TMid, Init_CAN3_Rr_TMiq]
    Init_CAN3_MCU_R_ResetCnt_Sta: value-spec=0
    Init_CAN3_Rr_CoolanttempReq: value-spec=40
    Init_CAN3_Rr_EOP_SpdSet: value-spec=0
    Init_CAN3_Rr_Failcode1: value-spec=0
    Init_CAN3_Rr_Failcode2: value-spec=0
    Init_CAN3_Rr_Failcodehistory1: value-spec=0
    Init_CAN3_Rr_Failcodehistory2: value-spec=0
    Init_CAN3_Rr_LLCTemp: value-spec=40
    Init_CAN3_Rr_LLCflowReq: value-spec=0
    Init_CAN3_Rr_MCU2Chksum: value-spec=0
    Init_CAN3_Rr_MCU2RolCnt: value-spec=0
    Init_CAN3_Rr_MCUTempWarn: value-spec=0
    Init_CAN3_Rr_TMTempWarn: value-spec=0
    Init_CAN3_SG_MCU_R2: value-spec=fields=[Init_CAN3_MCU_R_ResetCnt_Sta, Init_CAN3_Rr_CoolanttempReq, Init_CAN3_Rr_EOP_SpdSet, Init_CAN3_Rr_Failcode1, Init_CAN3_Rr_Failcode2, Init_CAN3_Rr_Failcodehistory1, Init_CAN3_Rr_Failcodehistory2, Init_CAN3_Rr_LLCTemp, Init_CAN3_Rr_LLCflowReq, Init_CAN3_Rr_MCU2Chksum, Init_CAN3_Rr_MCU2RolCnt, Init_CAN3_Rr_MCUTempWarn, Init_CAN3_Rr_TMTempWarn]
    Init_CAN3_Shifter_CRC8: value-spec=0
    Init_CAN3_Shifter_Fail_sta: value-spec=0
    Init_CAN3_Shifter_Handle_Cmd: value-spec=0
    Init_CAN3_Shifter_RC: value-spec=0
    Init_CAN3_SG_Shifter1: value-spec=fields=[Init_CAN3_Shifter_CRC8, Init_CAN3_Shifter_Fail_sta, Init_CAN3_Shifter_Handle_Cmd, Init_CAN3_Shifter_RC]
    Init_CAN3_NM_BMS_Active_WU: value-spec=0
    Init_CAN3_NM_BMS_CSB: value-spec=0
    Init_CAN3_NM_BMS_ERROR_State: value-spec=0
    Init_CAN3_NM_BMS_Node_ID: value-spec=0
    Init_CAN3_NM_BMS_PNI: value-spec=0
    Init_CAN3_NM_BMS_Rpt_Msg_Req: value-spec=0
    Init_CAN3_SG_XNMm_BMS: value-spec=fields=[Init_CAN3_NM_BMS_Active_WU, Init_CAN3_NM_BMS_CSB, Init_CAN3_NM_BMS_ERROR_State, Init_CAN3_NM_BMS_Node_ID, Init_CAN3_NM_BMS_PNI, Init_CAN3_NM_BMS_Rpt_Msg_Req]
    Init_CAN3_NM_CCU_Active_WU: value-spec=0
    Init_CAN3_NM_CCU_CSB: value-spec=0
    Init_CAN3_NM_CCU_ERROR_State: value-spec=0
    Init_CAN3_NM_CCU_Node_ID: value-spec=0
    Init_CAN3_NM_CCU_PNI: value-spec=0
    Init_CAN3_NM_CCU_Rpt_Msg_Req: value-spec=0
    Init_CAN3_SG_XNMm_CCU: value-spec=fields=[Init_CAN3_NM_CCU_Active_WU, Init_CAN3_NM_CCU_CSB, Init_CAN3_NM_CCU_ERROR_State, Init_CAN3_NM_CCU_Node_ID, Init_CAN3_NM_CCU_PNI, Init_CAN3_NM_CCU_Rpt_Msg_Req]
    Init_CAN3_NM_EOP_F_Active_WU: value-spec=0
    Init_CAN3_NM_EOP_F_CSB: value-spec=0
    Init_CAN3_NM_EOP_F_ERROR_State: value-spec=0
    Init_CAN3_NM_EOP_F_Node_ID: value-spec=0
    Init_CAN3_NM_EOP_F_PNI: value-spec=0
    Init_CAN3_NM_EOP_F_Rpt_Msg_Req: value-spec=0
    Init_CAN3_SG_XNMm_EOP_F: value-spec=fields=[Init_CAN3_NM_EOP_F_Active_WU, Init_CAN3_NM_EOP_F_CSB, Init_CAN3_NM_EOP_F_ERROR_State, Init_CAN3_NM_EOP_F_Node_ID, Init_CAN3_NM_EOP_F_PNI, Init_CAN3_NM_EOP_F_Rpt_Msg_Req]
    Init_CAN3_NM_EOP_R_Active_WU: value-spec=0
    Init_CAN3_NM_EOP_R_CSB: value-spec=0
    Init_CAN3_NM_EOP_R_ERROR_State: value-spec=0
    Init_CAN3_NM_EOP_R_Node_ID: value-spec=0
    Init_CAN3_NM_EOP_R_PNI: value-spec=0
    Init_CAN3_NM_EOP_R_Rpt_Msg_Req: value-spec=0
    Init_CAN3_SG_XNMm_EOP_R: value-spec=fields=[Init_CAN3_NM_EOP_R_Active_WU, Init_CAN3_NM_EOP_R_CSB, Init_CAN3_NM_EOP_R_ERROR_State, Init_CAN3_NM_EOP_R_Node_ID, Init_CAN3_NM_EOP_R_PNI, Init_CAN3_NM_EOP_R_Rpt_Msg_Req]
    Init_CAN3_NM_FUSION_Active_WU: value-spec=0
    Init_CAN3_NM_FUSION_CSB: value-spec=0
    Init_CAN3_NM_FUSION_ERROR_State: value-spec=0
    Init_CAN3_NM_FUSION_Node_ID: value-spec=0
    Init_CAN3_NM_FUSION_PNI: value-spec=0
    Init_CAN3_NM_FUSION_Rpt_Msg_Req: value-spec=0
    Init_CAN3_SG_XNMm_FUSION: value-spec=fields=[Init_CAN3_NM_FUSION_Active_WU, Init_CAN3_NM_FUSION_CSB, Init_CAN3_NM_FUSION_ERROR_State, Init_CAN3_NM_FUSION_Node_ID, Init_CAN3_NM_FUSION_PNI, Init_CAN3_NM_FUSION_Rpt_Msg_Req]
    Init_CAN3_NM_MCU_F_Active_WU: value-spec=0
    Init_CAN3_NM_MCU_F_CSB: value-spec=0
    Init_CAN3_NM_MCU_F_ERROR_State: value-spec=0
    Init_CAN3_NM_MCU_F_Node_ID: value-spec=0
    Init_CAN3_NM_MCU_F_PNI: value-spec=0
    Init_CAN3_NM_MCU_F_Rpt_Msg_Req: value-spec=0
    Init_CAN3_SG_XNMm_MCU_F: value-spec=fields=[Init_CAN3_NM_MCU_F_Active_WU, Init_CAN3_NM_MCU_F_CSB, Init_CAN3_NM_MCU_F_ERROR_State, Init_CAN3_NM_MCU_F_Node_ID, Init_CAN3_NM_MCU_F_PNI, Init_CAN3_NM_MCU_F_Rpt_Msg_Req]
    Init_CAN3_NM_MCU_R_Active_WU: value-spec=0
    Init_CAN3_NM_MCU_R_CSB: value-spec=0
    Init_CAN3_NM_MCU_R_ERROR_State: value-spec=0
    Init_CAN3_NM_MCU_R_Node_ID: value-spec=0
    Init_CAN3_NM_MCU_R_PNI: value-spec=0
    Init_CAN3_NM_MCU_R_Rpt_Msg_Req: value-spec=0
    Init_CAN3_SG_XNMm_MCU_R: value-spec=fields=[Init_CAN3_NM_MCU_R_Active_WU, Init_CAN3_NM_MCU_R_CSB, Init_CAN3_NM_MCU_R_ERROR_State, Init_CAN3_NM_MCU_R_Node_ID, Init_CAN3_NM_MCU_R_PNI, Init_CAN3_NM_MCU_R_Rpt_Msg_Req]
    Init_CAN3_NM_Shifter_Active_WU: value-spec=0
    Init_CAN3_NM_Shifter_CSB: value-spec=0
    Init_CAN3_NM_Shifter_ERROR_State: value-spec=0
    Init_CAN3_NM_Shifter_Node_ID: value-spec=0
    Init_CAN3_NM_Shifter_PNI: value-spec=0
    Init_CAN3_NM_Shifter_Rpt_Msg_Req: value-spec=0
    Init_CAN3_SG_XNMm_Shifter: value-spec=fields=[Init_CAN3_NM_Shifter_Active_WU, Init_CAN3_NM_Shifter_CSB, Init_CAN3_NM_Shifter_ERROR_State, Init_CAN3_NM_Shifter_Node_ID, Init_CAN3_NM_Shifter_PNI, Init_CAN3_NM_Shifter_Rpt_Msg_Req]
package /CAN3/ImplementationDataTypes
  30 x impl type, all with category=STRUCTURE:
    DT_CAN3_SG_BMS1
      10 x element, all with category=TYPE_REFERENCE:
        CAN3_BMSChckSum_1: implementation-data-type=uint8
        CAN3_BMSRolCnct_1: implementation-data-type=uint8
        CAN3_HVBPwrAvailChrg: implementation-data-type=uint16
        CAN3_HVBPwrAvailChrg30: implementation-data-type=uint16
        CAN3_HVBPwrAvailChrg60: implementation-data-type=uint16
        CAN3_HVBPwrAvailDchrg: implementation-data-type=uint16
        CAN3_HVBPwrAvailDchrg30: implementation-data-type=uint16
        CAN3_HVBPwrAvailDchrg60: implementation-data-type=uint16
        CAN3_HVBattCurr: implementation-data-type=uint16
        CAN3_HVBattVolt: implementation-data-type=uint16
    DT_CAN3_SG_BMS2
      5 x element, all with category=TYPE_REFERENCE:
        CAN3_HVInVolt: implementation-data-type=uint16
        CAN3_LVBattDet12V: implementation-data-type=uint8
        CAN3_OBCDCCurLm: implementation-data-type=uint16
        CAN3_OBCDCVoltLm: implementation-data-type=uint16
        CAN3_ReChargerStaFromEvcc: implementation-data-type=uint8
    DT_CAN3_SG_BMS3
      19 x element, all with category=TYPE_REFERENCE:
        CAN3_ACChrgCurrDis: implementation-data-type=uint16
        CAN3_BMS_HVBattCellBalance_Sta: implementation-data-type=uint8
        CAN3_Battsystfail_Num: implementation-data-type=uint8
        CAN3_CellType: implementation-data-type=uint8
        CAN3_HVBChrgPwr: implementation-data-type=uint16
        CAN3_HVBChrgPwrTotal: implementation-data-type=uint32
        CAN3_HVBDrvPwr: implementation-data-type=uint16
        CAN3_HVBDrvPwrTotal: implementation-data-type=uint32
        CAN3_HVBFullChrgPwr: implementation-data-type=uint16
        CAN3_HVBIsoImpedenceN: implementation-data-type=uint16
        CAN3_HVBIsoImpedenceP: implementation-data-type=uint16
        CAN3_HVBSOH: implementation-data-type=uint8
        CAN3_HVBattPackVolt: implementation-data-type=uint16
        CAN3_HVBattSOC: implementation-data-type=uint8
        CAN3_HVBattSOCDiff: implementation-data-type=uint8
        CAN3_HVBattSOCDis: implementation-data-type=uint8
        CAN3_RechrgCyc: implementation-data-type=uint32
        CAN3_RemainChrgTime: implementation-data-type=uint16
        CAN3_SOC_UseLimit: implementation-data-type=uint8
    DT_CAN3_SG_BMS4
      29 x element, all with category=TYPE_REFERENCE:
        CAN3_CellTempAvg: implementation-data-type=uint8
        CAN3_HVBCellVoltMax: implementation-data-type=uint16
        CAN3_HVBCellVoltMin: implementation-data-type=uint16
        CAN3_HVBMTempMax: implementation-data-type=uint8
        CAN3_HVBMTempMin: implementation-data-type=uint8
        CAN3_MaxCellTemp_Num: implementation-data-type=uint8
        CAN3_MaxCellVolt_Num: implementation-data-type=uint8
        CAN3_MinCellTemp_Num: implementation-data-type=uint8
        CAN3_MinCellVolt_Num: implementation-data-type=uint8
        CAN3_Mtemp{01..20}: implementation-data-type=uint8
    DT_CAN3_SG_BMS6
      46 x element, all with category=TYPE_REFERENCE, implementation-data-type=uint8:
        CAN3_BMSChckSum
        CAN3_BMSRolCnct
        CAN3_BMS_READY
        CAN3_BMS_Warn_{1..8}
        CAN3_CellUnconsistErr
        CAN3_ChrgInLockReq
        CAN3_ChrgPlugSta
        CAN3_DCChrgSysShockErr
        CAN3_DisChrgPlugErr
        CAN3_ExtChrgSta
        CAN3_HVBCellOvrVoltErr
        CAN3_HVBCellOvrVoltWarn
        CAN3_HVBCellUdrVoltWarn
        CAN3_HVBCellUnbalanErr
        CAN3_HVBCellUndrVoltErr
        CAN3_HVBChrgErr
        CAN3_HVBContactorSta
        CAN3_HVBHVILErr
        CAN3_HVBOvrChrgCurrErr
        CAN3_HVBOvrDchrgCurErr
        CAN3_HVBOvrSOCErr
        CAN3_HVBOvrTempErr
        CAN3_HVBOvrTempWarn
        CAN3_HVBOvrVoltErr
        CAN3_HVBPrechrgSta
        CAN3_HVBPreheatPrecoolSta
        CAN3_HVBSOCJumpError
        CAN3_HVBShrtChrgCurrErr
        CAN3_HVBShrtDischrgCurrErr
        CAN3_HVBTempDiffErr
        CAN3_HVBUndrSOCErr
        CAN3_HVBUndrTempErr
        CAN3_HVBUndrTempWarn
        CAN3_HVBUndrVoltErr
        CAN3_HVBattReady4Pre
        CAN3_HVILSta
        CAN3_IsoDetSta
        CAN3_SystemUncomErr
        CAN3_V2LSta
    DT_CAN3_SG_BMS7
      4 x element, all with category=TYPE_REFERENCE, implementation-data-type=uint8:
        CAN3_ChrgCurType
        CAN3_ChrgLampSta
        CAN3_FireDetErr
        CAN3_HVBattErr
    DT_CAN3_SG_CCU1
      9 x element, all with category=TYPE_REFERENCE:
        CAN3_CS_CCU1: implementation-data-type=uint8
        CAN3_DCDCAuxVolt: implementation-data-type=uint8
        CAN3_DCDCInVoltInf: implementation-data-type=uint16
        CAN3_DCDCPreCompleted: implementation-data-type=uint8
        CAN3_OBCDCCurrInf: implementation-data-type=uint16
        CAN3_OBCDCVoltInf: implementation-data-type=uint16
        CAN3_OBCPreCompleted: implementation-data-type=uint8
        CAN3_OBCWakeup4Plugin: implementation-data-type=uint8
        CAN3_RC_CCU1: implementation-data-type=uint8
    DT_CAN3_SG_CCU2
      17 x element, all with category=TYPE_REFERENCE:
        CAN3_CS_CCU2: implementation-data-type=uint8
        CAN3_DCDCEnaSta: implementation-data-type=uint8
        CAN3_DCDCFaultSta: implementation-data-type=uint8
        CAN3_DCDCReady4Pre: implementation-data-type=uint8
        CAN3_DCDCTemp: implementation-data-type=uint8
        CAN3_OBCACCurrInf: implementation-data-type=uint16
        CAN3_OBCACVoltInf: implementation-data-type=uint16
        CAN3_OBCDCP: implementation-data-type=uint16
        CAN3_OBCEnaSta: implementation-data-type=uint8
        CAN3_OBCFaultSta: implementation-data-type=uint8
        CAN3_OBCPluginSta: implementation-data-type=uint8
        CAN3_OBCReady4Pre: implementation-data-type=uint8
        CAN3_OBCTemp: implementation-data-type=uint16
        CAN3_OBCV2LSta: implementation-data-type=uint8
        CAN3_OBC_AC_Cur_Lim: implementation-data-type=uint8
        CAN3_RC_CCU2: implementation-data-type=uint8
        CAN3_ReqOBCV2LEna: implementation-data-type=uint8
    DT_CAN3_SG_CCU4
      9 x element, all with category=TYPE_REFERENCE:
        CAN3_DCDCAuxCur: implementation-data-type=uint16
        CAN3_DCDCHVCur: implementation-data-type=uint16
        CAN3_OBCV2LINVOTP: implementation-data-type=uint8
        CAN3_OBCV2LInsuFault: implementation-data-type=uint8
        CAN3_OBCV2LVinOVP: implementation-data-type=uint8
        CAN3_OBCV2LVinUVP: implementation-data-type=uint8
        CAN3_OBCV2LVoutOCP: implementation-data-type=uint8
        CAN3_OBCV2LVoutOVP: implementation-data-type=uint8
        CAN3_OBCV2LVoutUVP: implementation-data-type=uint8
    DT_CAN3_SG_FD_BCM1
      52 x element, all with category=TYPE_REFERENCE:
        CAN3_AllDoorSW: implementation-data-type=uint8
        CAN3_AntiTheftSeatFold: implementation-data-type=uint8
        CAN3_AntitheftSta: implementation-data-type=uint8
        CAN3_BCM_Buzzer_Req: implementation-data-type=uint8
        CAN3_BCM_DoorLock_Sta: implementation-data-type=uint8
        CAN3_BrakeLamp: implementation-data-type=uint8
        CAN3_CTDCtrl: implementation-data-type=uint8
        CAN3_CTDLockSW: implementation-data-type=uint8
        CAN3_CTDUnlockSW: implementation-data-type=uint8
        CAN3_CrashDetd: implementation-data-type=uint8
        CAN3_Dimmer: implementation-data-type=uint8
        CAN3_DimmerEN: implementation-data-type=uint8
        CAN3_DoorLockIND: implementation-data-type=uint8
        CAN3_DrDoorSW: implementation-data-type=uint8
        CAN3_Fr_ChargingDoorCtrl: implementation-data-type=uint8
        CAN3_Fr_FogLamp: implementation-data-type=uint8
        CAN3_Fr_Wiper_H: implementation-data-type=uint8
        CAN3_Fr_Wiper_L: implementation-data-type=uint8
        CAN3_H_Beam: implementation-data-type=uint8
        CAN3_HazardSW: implementation-data-type=uint8
        CAN3_HoodSW: implementation-data-type=uint8
        CAN3_HornCtrl: implementation-data-type=uint8
        CAN3_LBSD: implementation-data-type=uint8
        CAN3_LDRL: implementation-data-type=uint8
        CAN3_LTurnLP: implementation-data-type=uint8
        CAN3_L_APM_WdwEnable: implementation-data-type=uint8
        CAN3_L_Beam: implementation-data-type=uint8
        CAN3_LockSetting: implementation-data-type=uint8
        CAN3_MirrorCtrl: implementation-data-type=uint8
        CAN3_MirrorDefog: implementation-data-type=uint8
        CAN3_PmicBootReason: implementation-data-type=uint8
        CAN3_PosLamp: implementation-data-type=uint8
        CAN3_PsDoorSW: implementation-data-type=uint8
        CAN3_RBSD: implementation-data-type=uint8
        CAN3_RDRL: implementation-data-type=uint8
        CAN3_RLDoorSW: implementation-data-type=uint8
        CAN3_RRDoorSW: implementation-data-type=uint8
        CAN3_RTurnLP: implementation-data-type=uint8
        CAN3_ReverseLamp: implementation-data-type=uint8
        CAN3_RoomLampH: implementation-data-type=uint8
        CAN3_RoomLampL: implementation-data-type=uint8
        CAN3_Rr_ChargingDoorCtrl: implementation-data-type=uint8
        CAN3_Rr_Defog: implementation-data-type=uint8
        CAN3_Rr_FogLamp: implementation-data-type=uint8
        CAN3_Rr_Wiper: implementation-data-type=uint8
        CAN3_TailgateHDSW: implementation-data-type=uint8
        CAN3_TailgateRemote: implementation-data-type=uint8
        CAN3_Tailgate_SW: implementation-data-type=uint8
        CAN3_TrunkRel: implementation-data-type=uint8
        CAN3_WasherCtrl: implementation-data-type=uint8
        CAN3_WiperFixMode: implementation-data-type=uint8
        CAN3_WisrBootReason: implementation-data-type=uint32
    DT_CAN3_SG_FD_OTA1
      12 x element, all with category=TYPE_REFERENCE:
        CAN3_OTA_DL_Available: implementation-data-type=uint8
        CAN3_OTA_DL_Speed: implementation-data-type=uint32
        CAN3_OTA_InVehicle_FW: implementation-data-type=uint8
        CAN3_OTA_Lock_Req: implementation-data-type=uint8
        CAN3_OTA_MDA_Status: implementation-data-type=uint8
        CAN3_OTA_Mode: implementation-data-type=uint8
        CAN3_OTA_Network_Type: implementation-data-type=uint8
        CAN3_OTA_Progress_Rate: implementation-data-type=uint8
        CAN3_OTA_TBOXResetReq: implementation-data-type=uint8
        CAN3_OTA_Up_Backcount: implementation-data-type=uint8
        CAN3_OTA_Update_Available: implementation-data-type=uint8
        CAN3_OTA_Updating_ECU: implementation-data-type=uint8
    DT_CAN3_SG_FD_THCM1
      37 x element, all with category=TYPE_REFERENCE:
        CAN3_BatteryMode: implementation-data-type=uint8
        CAN3_CCU_ACLampSts: implementation-data-type=uint8
        CAN3_CCU_ACMaxLampSts: implementation-data-type=uint8
        CAN3_CCU_AutoLampSts: implementation-data-type=uint8
        CAN3_CCU_AutoMidLampSts: implementation-data-type=uint8
        CAN3_CCU_Dispaly_Request: implementation-data-type=uint8
        CAN3_CCU_EcoSts: implementation-data-type=uint8
        CAN3_CCU_FrtOnOffLampSts: implementation-data-type=uint8
        CAN3_CCU_HEATMaxLampSts: implementation-data-type=uint8
        CAN3_CCU_RrOnOffLampSts: implementation-data-type=uint8
        CAN3_CCU_SyncLampSts: implementation-data-type=uint8
        CAN3_CabinMode: implementation-data-type=uint8
        CAN3_EDriveMode: implementation-data-type=uint8
        CAN3_FD_AGS_Cmd: implementation-data-type=uint8
        CAN3_FD_RecyAuto_Cmd: implementation-data-type=uint8
        CAN3_Fr_Coolantflow: implementation-data-type=uint8
        CAN3_Fr_Coolanttemp: implementation-data-type=uint16
        CAN3_HPThermalRecoveryReq: implementation-data-type=uint8
        CAN3_Rr_Coolantflow: implementation-data-type=uint8
        CAN3_Rr_Coolanttemp: implementation-data-type=uint16
        CAN3_sigAirIntenZon1St: implementation-data-type=uint8
        CAN3_sigAirIntenZon3St: implementation-data-type=uint8
        CAN3_sigAmbAirT: implementation-data-type=uint8
        CAN3_sigCbnAirT: implementation-data-type=uint8
        CAN3_sigCbnPTCPwrAct: implementation-data-type=uint8
        CAN3_sigCbnSolarLeft: implementation-data-type=uint8
        CAN3_sigCbnSolarRight: implementation-data-type=uint8
        CAN3_sigClmtCmprPwrAct: implementation-data-type=uint8
        CAN3_sigClntTHvBattOut: implementation-data-type=uint8
        CAN3_sigDfrstSt: implementation-data-type=uint8
        CAN3_sigHvacSt: implementation-data-type=uint8
        CAN3_sigRecircSt: implementation-data-type=uint8
        CAN3_sigSetTempZon{1..3}St: implementation-data-type=uint8
        CAN3_sigWindDirZon1St: implementation-data-type=uint8
        CAN3_sigWindDirZon3St: implementation-data-type=uint8
    DT_CAN3_SG_FD_THCM2
      26 x element, all with category=TYPE_REFERENCE:
        CAN3_ACSubMode: implementation-data-type=uint8
        CAN3_APTC_ActFrRiPwr: implementation-data-type=uint8
        CAN3_BatLoopActWtFlw: implementation-data-type=uint8
        CAN3_CCU_CbnPreACWkSts: implementation-data-type=uint8
        CAN3_CCU_CbnPreEstimdTi: implementation-data-type=uint8
        CAN3_CCU_CbnPreSts: implementation-data-type=uint8
        CAN3_CCU_HiVoltageReq: implementation-data-type=uint8
        CAN3_CoolgFanActDuty: implementation-data-type=uint8
        CAN3_DeiceModReq: implementation-data-type=uint8
        CAN3_FD_Blower_Cmd: implementation-data-type=uint8
        CAN3_FD_Comp_Cmd: implementation-data-type=uint16
        CAN3_FD_EWP{1..3}_Cmd: implementation-data-type=uint8
        CAN3_FD_EXV1_Cmd: implementation-data-type=uint16
        CAN3_FD_EXV2_Cmd: implementation-data-type=uint16
        CAN3_FD_FWV_Cmd: implementation-data-type=uint8
        CAN3_FD_FrLeAPTCHeatPwr_Cmd: implementation-data-type=uint8
        CAN3_FD_FrRiAPTCHeatPwr_Cmd: implementation-data-type=uint8
        CAN3_FD_FrWPTCHeatPwr_Cmd: implementation-data-type=uint16
        CAN3_FD_RrAPTCHeatPwr_Cmd: implementation-data-type=uint8
        CAN3_FD_SOTXV_Cmd: implementation-data-type=uint8
        CAN3_FD_SOV{1..3}_Cmd: implementation-data-type=uint8
        CAN3_FD_TWV_Cmd: implementation-data-type=uint8
    DT_CAN3_SG_FD_V2L1
      element CAN3_Req_OBCV2LEna: implementation-data-type=uint8
      element CAN3_Req_V2LSwOn: implementation-data-type=uint8
      element CAN3_Req_V2L_IVI_Popup: implementation-data-type=uint8
    DT_CAN3_SG_FD_VCU0
      51 x element, all with category=TYPE_REFERENCE:
        CAN3_EVCCAplusPwrUpReq: implementation-data-type=uint8
        CAN3_FDADC12VDet: implementation-data-type=uint8
        CAN3_FDADC12VDetAvg: implementation-data-type=uint8
        CAN3_FDC_VCU_ActMaxSlideRate_Sta: implementation-data-type=uint16
        CAN3_FDC_VCU_AllowMovThd_OTA_Sta: implementation-data-type=uint8
        CAN3_FDC_VCU_DTCCarousel_Sta: implementation-data-type=uint8
        CAN3_FDC_VCU_ForceP_Cmd: implementation-data-type=uint8
        CAN3_FDC_VCU_PwrReq_OTA_Sta: implementation-data-type=uint8
        CAN3_FDC_VCU_RWDRDCActive_Sta: implementation-data-type=uint8
        CAN3_FDC_VCU_RegenTqLimitEn_Sta: implementation-data-type=uint8
        CAN3_FDC_VCU_SlideRegenLimTq_Sta: implementation-data-type=uint16
        CAN3_FDC_VCU_VehActSpd_Sta: implementation-data-type=uint16
        CAN3_FDC_VCU_VehMalfunLevel_Sta: implementation-data-type=uint8
        CAN3_FDC_VMC_ActStESCYaw_Sta: implementation-data-type=uint16
        CAN3_FDC_VMC_AntiSpdLimEn_Sta: implementation-data-type=uint8
        CAN3_FDC_VMC_LongAcc_Sta: implementation-data-type=uint16
        CAN3_Fr_TqSource: implementation-data-type=uint8
        CAN3_HVRlyOpFail: implementation-data-type=uint8
        CAN3_HVTHCMSysAvail: implementation-data-type=uint8
        CAN3_LVBattChrgtimeAct: implementation-data-type=uint16
        CAN3_LVBattVoltSta: implementation-data-type=uint8
        CAN3_LVChrgHoldTAct: implementation-data-type=uint16
        CAN3_LVSilentChrgLv: implementation-data-type=uint8
        CAN3_LVSilentChrgReq: implementation-data-type=uint8
        CAN3_LVSilentChrgSta: implementation-data-type=uint8
        CAN3_MCUActDisFail: implementation-data-type=uint8
        CAN3_PMMAllowECUSleep: implementation-data-type=uint8
        CAN3_PowerDownFault: implementation-data-type=uint8
        CAN3_PowerDownState: implementation-data-type=uint8
        CAN3_PowerUpFault: implementation-data-type=uint8
        CAN3_PowerUpState: implementation-data-type=uint8
        CAN3_PwrDownReq: implementation-data-type=uint8
        CAN3_PwrStaConstraint: implementation-data-type=uint8
        CAN3_PwrStaONTOIVIPopReq: implementation-data-type=uint8
        CAN3_PwrStaONTOIVIPopT: implementation-data-type=uint16
        CAN3_PwrStaSelect: implementation-data-type=uint8
        CAN3_PwrStaTOSta: implementation-data-type=uint8
        CAN3_PwrUpReq: implementation-data-type=uint8
        CAN3_Rr_TqSource: implementation-data-type=uint8
        CAN3_SchedChgTOSta: implementation-data-type=uint8
        CAN3_SilentChkAllowSleep: implementation-data-type=uint8
        CAN3_SysAllowReadySta: implementation-data-type=uint8
        CAN3_SysPwrSta: implementation-data-type=uint8
        CAN3_TCountSta: implementation-data-type=uint8
        CAN3_TimerAllowSleep: implementation-data-type=uint8
        CAN3_VCUBrkSWSta: implementation-data-type=uint8
        CAN3_VCUFLDoorSta: implementation-data-type=uint8
        CAN3_VCUFRDoorSta: implementation-data-type=uint8
        CAN3_VCURLDoorSta: implementation-data-type=uint8
        CAN3_VCURRDoorSta: implementation-data-type=uint8
        CAN3_VehHVPwrAvail4THCM: implementation-data-type=uint8
    DT_CAN3_SG_FD_VCU1
      20 x element, all with category=TYPE_REFERENCE, implementation-data-type=uint8:
        CAN3_ActiveDischReq
        CAN3_CS_VCU1
        CAN3_CoastDwModeStaChk
        CAN3_DCDCEnaReq
        CAN3_DCDCVoltSetpoint
        CAN3_DemoModeStaChk
        CAN3_Dr_SeatSta
        CAN3_DynoModeStaChk
        CAN3_Fr_ActvDmpDisabReq
        CAN3_Fr_MCUEnaReq
        CAN3_HVBatCnctReq
        CAN3_HVSysReadyToCharge
        CAN3_LVChrgFuncStaChk
        CAN3_MSA_Crl_Sta
        CAN3_PrkReq
        CAN3_PwrSta
        CAN3_RC_VCU1
        CAN3_Rr_ActvDmpDisabReq
        CAN3_Rr_MCUEnaReq
        CAN3_ShiftGearPosn
    DT_CAN3_SG_FD_VCU2
      16 x element, all with category=TYPE_REFERENCE:
        CAN3_CS_VCU2_CAN1: implementation-data-type=uint8
        CAN3_Fr_IdcMax: implementation-data-type=uint16
        CAN3_Fr_IdcMin: implementation-data-type=uint16
        CAN3_Fr_TMTqReq: implementation-data-type=uint16
        CAN3_Fr_TorqMax: implementation-data-type=uint16
        CAN3_Fr_TorqMin: implementation-data-type=uint16
        CAN3_Fr_UdcMax: implementation-data-type=uint16
        CAN3_Fr_UdcMin: implementation-data-type=uint16
        CAN3_RC_VCU2_CAN1: implementation-data-type=uint8
        CAN3_Rr_IdcMax: implementation-data-type=uint16
        CAN3_Rr_IdcMin: implementation-data-type=uint16
        CAN3_Rr_TMTqReq: implementation-data-type=uint16
        CAN3_Rr_TorqMax: implementation-data-type=uint16
        CAN3_Rr_TorqMin: implementation-data-type=uint16
        CAN3_Rr_UdcMax: implementation-data-type=uint16
        CAN3_Rr_UdcMin: implementation-data-type=uint16
    DT_CAN3_SG_MCU_F1
      27 x element, all with category=TYPE_REFERENCE:
        CAN3_Fr_ActvDmpDisabSta: implementation-data-type=uint8
        CAN3_Fr_EDUDrtSta: implementation-data-type=uint8
        CAN3_Fr_EDUOpratingSta: implementation-data-type=uint8
        CAN3_Fr_EDURealTMTq: implementation-data-type=uint16
        CAN3_Fr_EDURotateDirction: implementation-data-type=uint8
        CAN3_Fr_EDUTqReqFbk: implementation-data-type=uint16
        CAN3_Fr_MCU1Chksum: implementation-data-type=uint8
        CAN3_Fr_MCU1RolCnt: implementation-data-type=uint8
        CAN3_Fr_MCUBAT: implementation-data-type=uint8
        CAN3_Fr_MCUDCBusCurr: implementation-data-type=uint16
        CAN3_Fr_MCUDCBusVolt: implementation-data-type=uint16
        CAN3_Fr_MCUDischrgSta: implementation-data-type=uint8
        CAN3_Fr_MCUEnaSta: implementation-data-type=uint8
        CAN3_Fr_MCUErr: implementation-data-type=uint8
        CAN3_Fr_MCUIGN_sta: implementation-data-type=uint8
        CAN3_Fr_MCUReady: implementation-data-type=uint8
        CAN3_Fr_MCUReady4Pre: implementation-data-type=uint8
        CAN3_Fr_MCUSysSta: implementation-data-type=uint8
        CAN3_Fr_MCUTemp: implementation-data-type=uint16
        CAN3_Fr_MotorAvailTq: implementation-data-type=uint16
        CAN3_Fr_RegenAvailTq: implementation-data-type=uint16
        CAN3_Fr_Reserved_bits: implementation-data-type=uint8
        CAN3_Fr_TMSpd: implementation-data-type=uint16
        CAN3_Fr_TMTemp: implementation-data-type=uint16
        CAN3_Fr_TMid: implementation-data-type=uint16
        CAN3_Fr_TMiq: implementation-data-type=uint16
        CAN3_MCUWarn_F: implementation-data-type=uint8
    DT_CAN3_SG_MCU_F2
      13 x element, all with category=TYPE_REFERENCE:
        CAN3_Fr_CoolanttempReq: implementation-data-type=uint16
        CAN3_Fr_EOP_SpdSet: implementation-data-type=uint16
        CAN3_Fr_Failcode1: implementation-data-type=uint8
        CAN3_Fr_Failcode2: implementation-data-type=uint8
        CAN3_Fr_Failcodehistory1: implementation-data-type=uint8
        CAN3_Fr_Failcodehistory2: implementation-data-type=uint8
        CAN3_Fr_LLCTemp: implementation-data-type=uint16
        CAN3_Fr_LLCflowReq: implementation-data-type=uint8
        CAN3_Fr_MCU2Chksum: implementation-data-type=uint8
        CAN3_Fr_MCU2RolCnt: implementation-data-type=uint8
        CAN3_Fr_MCUTempWarn: implementation-data-type=uint8
        CAN3_Fr_TMTempWarn: implementation-data-type=uint8
        CAN3_MCU_F_ResetCnt_Sta: implementation-data-type=uint8
    DT_CAN3_SG_MCU_R1
      27 x element, all with category=TYPE_REFERENCE:
        CAN3_MCUWarn_R: implementation-data-type=uint8
        CAN3_Rr_ActvDmpDisabSta: implementation-data-type=uint8
        CAN3_Rr_EDUDrtSta: implementation-data-type=uint8
        CAN3_Rr_EDUOpratingSta: implementation-data-type=uint8
        CAN3_Rr_EDURealTMTq: implementation-data-type=uint16
        CAN3_Rr_EDURotateDirction: implementation-data-type=uint8
        CAN3_Rr_EDUTqReqFbk: implementation-data-type=uint16
        CAN3_Rr_MCU1Chksum: implementation-data-type=uint8
        CAN3_Rr_MCU1RolCnt: implementation-data-type=uint8
        CAN3_Rr_MCUBAT: implementation-data-type=uint8
        CAN3_Rr_MCUDCBusCurr: implementation-data-type=uint16
        CAN3_Rr_MCUDCBusVolt: implementation-data-type=uint16
        CAN3_Rr_MCUDischrgSta: implementation-data-type=uint8
        CAN3_Rr_MCUEnaSta: implementation-data-type=uint8
        CAN3_Rr_MCUErr: implementation-data-type=uint8
        CAN3_Rr_MCUIGN_sta: implementation-data-type=uint8
        CAN3_Rr_MCUReady: implementation-data-type=uint8
        CAN3_Rr_MCUReady4Pre: implementation-data-type=uint8
        CAN3_Rr_MCUSysSta: implementation-data-type=uint8
        CAN3_Rr_MCUTemp: implementation-data-type=uint16
        CAN3_Rr_MotorAvailTq: implementation-data-type=uint16
        CAN3_Rr_RegenAvailTq: implementation-data-type=uint16
        CAN3_Rr_Reserved_bits: implementation-data-type=uint8
        CAN3_Rr_TMSpd: implementation-data-type=uint16
        CAN3_Rr_TMTemp: implementation-data-type=uint16
        CAN3_Rr_TMid: implementation-data-type=uint16
        CAN3_Rr_TMiq: implementation-data-type=uint16
    DT_CAN3_SG_MCU_R2
      13 x element, all with category=TYPE_REFERENCE:
        CAN3_MCU_R_ResetCnt_Sta: implementation-data-type=uint8
        CAN3_Rr_CoolanttempReq: implementation-data-type=uint16
        CAN3_Rr_EOP_SpdSet: implementation-data-type=uint16
        CAN3_Rr_Failcode1: implementation-data-type=uint8
        CAN3_Rr_Failcode2: implementation-data-type=uint8
        CAN3_Rr_Failcodehistory1: implementation-data-type=uint8
        CAN3_Rr_Failcodehistory2: implementation-data-type=uint8
        CAN3_Rr_LLCTemp: implementation-data-type=uint16
        CAN3_Rr_LLCflowReq: implementation-data-type=uint8
        CAN3_Rr_MCU2Chksum: implementation-data-type=uint8
        CAN3_Rr_MCU2RolCnt: implementation-data-type=uint8
        CAN3_Rr_MCUTempWarn: implementation-data-type=uint8
        CAN3_Rr_TMTempWarn: implementation-data-type=uint8
    DT_CAN3_SG_Shifter1
      4 x element, all with category=TYPE_REFERENCE, implementation-data-type=uint8:
        CAN3_Shifter_CRC8
        CAN3_Shifter_Fail_sta
        CAN3_Shifter_Handle_Cmd
        CAN3_Shifter_RC
    DT_CAN3_SG_XNMm_BMS
      6 x element, all with category=TYPE_REFERENCE, implementation-data-type=uint8:
        CAN3_NM_BMS_Active_WU
        CAN3_NM_BMS_CSB
        CAN3_NM_BMS_ERROR_State
        CAN3_NM_BMS_Node_ID
        CAN3_NM_BMS_PNI
        CAN3_NM_BMS_Rpt_Msg_Req
    DT_CAN3_SG_XNMm_CCU
      6 x element, all with category=TYPE_REFERENCE, implementation-data-type=uint8:
        CAN3_NM_CCU_Active_WU
        CAN3_NM_CCU_CSB
        CAN3_NM_CCU_ERROR_State
        CAN3_NM_CCU_Node_ID
        CAN3_NM_CCU_PNI
        CAN3_NM_CCU_Rpt_Msg_Req
    DT_CAN3_SG_XNMm_EOP_F
      6 x element, all with category=TYPE_REFERENCE, implementation-data-type=uint8:
        CAN3_NM_EOP_F_Active_WU
        CAN3_NM_EOP_F_CSB
        CAN3_NM_EOP_F_ERROR_State
        CAN3_NM_EOP_F_Node_ID
        CAN3_NM_EOP_F_PNI
        CAN3_NM_EOP_F_Rpt_Msg_Req
    DT_CAN3_SG_XNMm_EOP_R
      6 x element, all with category=TYPE_REFERENCE, implementation-data-type=uint8:
        CAN3_NM_EOP_R_Active_WU
        CAN3_NM_EOP_R_CSB
        CAN3_NM_EOP_R_ERROR_State
        CAN3_NM_EOP_R_Node_ID
        CAN3_NM_EOP_R_PNI
        CAN3_NM_EOP_R_Rpt_Msg_Req
    DT_CAN3_SG_XNMm_FUSION
      6 x element, all with category=TYPE_REFERENCE, implementation-data-type=uint8:
        CAN3_NM_FUSION_Active_WU
        CAN3_NM_FUSION_CSB
        CAN3_NM_FUSION_ERROR_State
        CAN3_NM_FUSION_Node_ID
        CAN3_NM_FUSION_PNI
        CAN3_NM_FUSION_Rpt_Msg_Req
    DT_CAN3_SG_XNMm_MCU_F
      6 x element, all with category=TYPE_REFERENCE, implementation-data-type=uint8:
        CAN3_NM_MCU_F_Active_WU
        CAN3_NM_MCU_F_CSB
        CAN3_NM_MCU_F_ERROR_State
        CAN3_NM_MCU_F_Node_ID
        CAN3_NM_MCU_F_PNI
        CAN3_NM_MCU_F_Rpt_Msg_Req
    DT_CAN3_SG_XNMm_MCU_R
      6 x element, all with category=TYPE_REFERENCE, implementation-data-type=uint8:
        CAN3_NM_MCU_R_Active_WU
        CAN3_NM_MCU_R_CSB
        CAN3_NM_MCU_R_ERROR_State
        CAN3_NM_MCU_R_Node_ID
        CAN3_NM_MCU_R_PNI
        CAN3_NM_MCU_R_Rpt_Msg_Req
    DT_CAN3_SG_XNMm_Shifter
      6 x element, all with category=TYPE_REFERENCE, implementation-data-type=uint8:
        CAN3_NM_Shifter_Active_WU
        CAN3_NM_Shifter_CSB
        CAN3_NM_Shifter_ERROR_State
        CAN3_NM_Shifter_Node_ID
        CAN3_NM_Shifter_PNI
        CAN3_NM_Shifter_Rpt_Msg_Req
