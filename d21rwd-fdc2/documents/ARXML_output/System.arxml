[part 2 of 3: package /SysEnv_ARPkg]
AUTOSAR XML (schema 4-3-0)
package /SysEnv_ARPkg  (continued)
  system System_FDC: category=SYSTEM_DESCRIPTION, ecu-extract-version=1.0.0, system-version=1.0.0  (continued)
    168 x system mapping:  (continued)
      MAP_HALIN_R_CAN2_IVI3: sender-receiver-to-signal-group-mapping{communication-direction=IN, data-element=SWC_HALIN.root_FDC.R_CAN2_IVI3.CAN2_SG_IVI3, signal-group=CAN2_SG_IVI3, type-mapping=sender-rec-record-type-mapping=record-element-mappings=[{implementation-record-element=CAN2_IVI_CLBlower_Y_Sta, system-signal=CAN2_IVI_CLBlower_Y_Sta}, {implementation-record-element=CAN2_IVI_Zon1WindDirSWReq_Sta, system-signal=CAN2_IVI_Zon1WindDirSWReq_Sta}, {implementation-record-element=CAN2_IVI_XWDMode_Cmd, system-signal=CAN2_IVI_XWDMode_Cmd}, {implementation-record-element=CAN2_IVI_UserTakeOver_APS_Sta, system-signal=CAN2_IVI_UserTakeOver_APS_Sta}, {implementation-record-element=CAN2_IVI_SnowMode_Cmd, system-signal=CAN2_IVI_SnowMode_Cmd}, {implementation-record-element=CAN2_IVI_SOS_Call_Sta, system-signal=CAN2_IVI_SOS_Call_Sta}, {implementation-record-element=CAN2_IVI_RollMod_atCarWash_Sta, system-signal=CAN2_IVI_RollMod_atCarWash_Sta}, {implementation-record-element=CAN2_IVI_RightPSDOpenClose_Cmd, system-signal=CAN2_IVI_RightPSDOpenClose_Cmd}, {implementation-record-element=CAN2_IVI_RSEATvent_Cmd, system-signal=CAN2_IVI_RSEATvent_Cmd}, {implementation-record-element=CAN2_IVI_RBlower_Z_Sta, system-signal=CAN2_IVI_RBlower_Z_Sta}, {implementation-record-element=CAN2_IVI_RBlower_Y_Sta, system-signal=CAN2_IVI_RBlower_Y_Sta}, {implementation-record-element=CAN2_IVI_RBlower_Mode_Sta, system-signal=CAN2_IVI_RBlower_Mode_Sta}, {implementation-record-element=CAN2_IVI_PSDManualPower_Sta, system-signal=CAN2_IVI_PSDManualPower_Sta}, {implementation-record-element=CAN2_IVI_MRZeroGravity_Cmd, system-signal=CAN2_IVI_MRZeroGravity_Cmd}, {implementation-record-element=CAN2_IVI_MRSlider_Cmd, system-signal=CAN2_IVI_MRSlider_Cmd}, {implementation-record-element=CAN2_IVI_MRSldRestore_Cmd, system-signal=CAN2_IVI_MRSldRestore_Cmd}, {implementation-record-element=CAN2_IVI_MRSeatLift_Cmd, system-signal=CAN2_IVI_MRSeatLift_Cmd}, {implementation-record-element=CAN2_IVI_MRSEATvent_Cmd, system-signal=CAN2_IVI_MRSEATvent_Cmd}, {implementation-record-element=CAN2_IVI_MRRestore_Cmd, system-signal=CAN2_IVI_MRRestore_Cmd}, {implementation-record-element=CAN2_IVI_MRRecliner_Cmd, system-signal=CAN2_IVI_MRRecliner_Cmd}, {implementation-record-element=CAN2_IVI_MRNapMode_Cmd, system-signal=CAN2_IVI_MRNapMode_Cmd}, {implementation-record-element=CAN2_IVI_MRFootLift_Cmd, system-signal=CAN2_IVI_MRFootLift_Cmd}, {implementation-record-element=CAN2_IVI_MRFMost_Cmd, system-signal=CAN2_IVI_MRFMost_Cmd}, {implementation-record-element=CAN2_IVI_MLZeroGravity_Cmd, system-signal=CAN2_IVI_MLZeroGravity_Cmd}, {implementation-record-element=CAN2_IVI_MLSlider_Cmd, system-signal=CAN2_IVI_MLSlider_Cmd}, {implementation-record-element=CAN2_IVI_MLSldRestore_Cmd, system-signal=CAN2_IVI_MLSldRestore_Cmd}, {implementation-record-element=CAN2_IVI_MLSeatLift_Cmd, system-signal=CAN2_IVI_MLSeatLift_Cmd}, {implementation-record-element=CAN2_IVI_MLSEATvent_Cmd, system-signal=CAN2_IVI_MLSEATvent_Cmd}, {implementation-record-element=CAN2_IVI_MLRestore_Cmd, system-signal=CAN2_IVI_MLRestore_Cmd}, {implementation-record-element=CAN2_IVI_MLRecliner_Cmd, system-signal=CAN2_IVI_MLRecliner_Cmd}, {implementation-record-element=CAN2_IVI_MLNapMode_Cmd, system-signal=CAN2_IVI_MLNapMode_Cmd}, {implementation-record-element=CAN2_IVI_MLFootLift_Cmd, system-signal=CAN2_IVI_MLFootLift_Cmd}, {implementation-record-element=CAN2_IVI_MLFMost_Cmd, system-signal=CAN2_IVI_MLFMost_Cmd}, {implementation-record-element=CAN2_IVI_LeftPSDOpenClose_Cmd, system-signal=CAN2_IVI_LeftPSDOpenClose_Cmd}, {implementation-record-element=CAN2_IVI_LSEATvent_Cmd, system-signal=CAN2_IVI_LSEATvent_Cmd}, {implementation-record-element=CAN2_IVI_LBlower_Z_Sta, system-signal=CAN2_IVI_LBlower_Z_Sta}, {implementation-record-element=CAN2_IVI_LBlower_Y_Sta, system-signal=CAN2_IVI_LBlower_Y_Sta}, {implementation-record-element=CAN2_IVI_LBlower_Mode_Sta, system-signal=CAN2_IVI_LBlower_Mode_Sta}, {implementation-record-element=CAN2_IVI_HMI_CustmiKEY_Sta, system-signal=CAN2_IVI_HMI_CustmiKEY_Sta}, {implementation-record-element=CAN2_IVI_HMI_CustmiFun_Sta, system-signal=CAN2_IVI_HMI_CustmiFun_Sta}, {implementation-record-element=CAN2_IVI_CRBlower_Z_Sta, system-signal=CAN2_IVI_CRBlower_Z_Sta}, {implementation-record-element=CAN2_IVI_CRBlower_Y_Sta, system-signal=CAN2_IVI_CRBlower_Y_Sta}, {implementation-record-element=CAN2_IVI_CLBlower_Z_Sta, system-signal=CAN2_IVI_CLBlower_Z_Sta}]}
      MAP_HALIN_R_CAN2_METER1: sender-receiver-to-signal-group-mapping{communication-direction=IN, data-element=SWC_HALIN.root_FDC.R_CAN2_METER1.CAN2_SG_METER1, signal-group=CAN2_SG_METER1, type-mapping=sender-rec-record-type-mapping=record-element-mappings=[{implementation-record-element=CAN2_APCforDTE, system-signal=CAN2_APCforDTE}, {implementation-record-element=CAN2_Trip_B, system-signal=CAN2_Trip_B}, {implementation-record-element=CAN2_Trip_A, system-signal=CAN2_Trip_A}, {implementation-record-element=CAN2_Spd_Crl_Sta, system-signal=CAN2_Spd_Crl_Sta}, {implementation-record-element=CAN2_Spd_Crl_Mode, system-signal=CAN2_Spd_Crl_Mode}, {implementation-record-element=CAN2_ParkBrake, system-signal=CAN2_ParkBrake}, {implementation-record-element=CAN2_ODOMETER, system-signal=CAN2_ODOMETER}, {implementation-record-element=CAN2_METER_MPH_Real, system-signal=CAN2_METER_MPH_Real}, {implementation-record-element=CAN2_METER_MPH_Calcu, system-signal=CAN2_METER_MPH_Calcu}, {implementation-record-element=CAN2_METER_KPH_Real, system-signal=CAN2_METER_KPH_Real}, {implementation-record-element=CAN2_METER_KPH_Calcu, system-signal=CAN2_METER_KPH_Calcu}, {implementation-record-element=CAN2_LEDlitWarnReq, system-signal=CAN2_LEDlitWarnReq}, {implementation-record-element=CAN2_Charge, system-signal=CAN2_Charge}, {implementation-record-element=CAN2_Averaged_vehspeed, system-signal=CAN2_Averaged_vehspeed}, {implementation-record-element=CAN2_AvailableTrip, system-signal=CAN2_AvailableTrip}, {implementation-record-element=CAN2_AVGPwrConsumption, system-signal=CAN2_AVGPwrConsumption}]}
      MAP_HALIN_R_CAN3_BMS1: sender-receiver-to-signal-group-mapping{communication-direction=IN, data-element=SWC_HALIN.root_FDC.R_CAN3_BMS1.CAN3_SG_BMS1, signal-group=CAN3_SG_BMS1, type-mapping=sender-rec-record-type-mapping=record-element-mappings=[{implementation-record-element=CAN3_BMSChckSum_1, system-signal=CAN3_BMSChckSum_1}, {implementation-record-element=CAN3_HVBattVolt, system-signal=CAN3_HVBattVolt}, {implementation-record-element=CAN3_HVBattCurr, system-signal=CAN3_HVBattCurr}, {implementation-record-element=CAN3_HVBPwrAvailDchrg60, system-signal=CAN3_HVBPwrAvailDchrg60}, {implementation-record-element=CAN3_HVBPwrAvailDchrg30, system-signal=CAN3_HVBPwrAvailDchrg30}, {implementation-record-element=CAN3_HVBPwrAvailDchrg, system-signal=CAN3_HVBPwrAvailDchrg}, {implementation-record-element=CAN3_HVBPwrAvailChrg60, system-signal=CAN3_HVBPwrAvailChrg60}, {implementation-record-element=CAN3_HVBPwrAvailChrg30, system-signal=CAN3_HVBPwrAvailChrg30}, {implementation-record-element=CAN3_HVBPwrAvailChrg, system-signal=CAN3_HVBPwrAvailChrg}, {implementation-record-element=CAN3_BMSRolCnct_1, system-signal=CAN3_BMSRolCnct_1}]}
      MAP_HALIN_R_CAN3_BMS3: sender-receiver-to-signal-group-mapping{communication-direction=IN, data-element=SWC_HALIN.root_FDC.R_CAN3_BMS3.CAN3_SG_BMS3, signal-group=CAN3_SG_BMS3, type-mapping=sender-rec-record-type-mapping=record-element-mappings=[{implementation-record-element=CAN3_ACChrgCurrDis, system-signal=CAN3_ACChrgCurrDis}, {implementation-record-element=CAN3_RemainChrgTime, system-signal=CAN3_RemainChrgTime}, {implementation-record-element=CAN3_RechrgCyc, system-signal=CAN3_RechrgCyc}, {implementation-record-element=CAN3_HVBattSOCDis, system-signal=CAN3_HVBattSOCDis}, {implementation-record-element=CAN3_HVBattSOC, system-signal=CAN3_HVBattSOC}, {implementation-record-element=CAN3_HVBattPackVolt, system-signal=CAN3_HVBattPackVolt}, {implementation-record-element=CAN3_HVBattErr, system-signal=CAN3_HVBattErr}, {implementation-record-element=CAN3_HVBSOH, system-signal=CAN3_HVBSOH}, {implementation-record-element=CAN3_HVBIsoImpedenceP, system-signal=CAN3_HVBIsoImpedenceP}, {implementation-record-element=CAN3_HVBIsoImpedenceN, system-signal=CAN3_HVBIsoImpedenceN}, {implementation-record-element=CAN3_HVBFullChrgPwr, system-signal=CAN3_HVBFullChrgPwr}, {implementation-record-element=CAN3_HVBDrvPwrTotal, system-signal=CAN3_HVBDrvPwrTotal}, {implementation-record-element=CAN3_HVBDrvPwr, system-signal=CAN3_HVBDrvPwr}, {implementation-record-element=CAN3_HVBChrgPwrTotal, system-signal=CAN3_HVBChrgPwrTotal}, {implementation-record-element=CAN3_HVBChrgPwr, system-signal=CAN3_HVBChrgPwr}, {implementation-record-element=CAN3_FireDetErr, system-signal=CAN3_FireDetErr}, {implementation-record-element=CAN3_ChrgLampSta, system-signal=CAN3_ChrgLampSta}, {implementation-record-element=CAN3_ChrgCurType, system-signal=CAN3_ChrgCurType}, {implementation-record-element=CAN3_CellType, system-signal=CAN3_CellType}, {implementation-record-element=CAN3_Battsystfail_Num, system-signal=CAN3_Battsystfail_Num}, {implementation-record-element=CAN3_BMS_SOC_UseLimit_Sta, system-signal=CAN3_BMS_SOC_UseLimit_Sta}, {implementation-record-element=CAN3_BMS_HVBattSOCDiff_Sta, system-signal=CAN3_BMS_HVBattSOCDiff_Sta}, {implementation-record-element=CAN3_BMS_HVBattCellBalance_Sta, system-signal=CAN3_BMS_HVBattCellBalance_Sta}]}
      MAP_HALIN_R_CAN3_BMS4: sender-receiver-to-signal-group-mapping{communication-direction=IN, data-element=SWC_HALIN.root_FDC.R_CAN3_BMS4.CAN3_SG_BMS4, signal-group=CAN3_SG_BMS4, type-mapping=sender-rec-record-type-mapping=record-element-mappings=[{implementation-record-element=CAN3_CellTempAvg, system-signal=CAN3_CellTempAvg}, {implementation-record-element=CAN3_Mtemp24, system-signal=CAN3_Mtemp24}, {implementation-record-element=CAN3_Mtemp23, system-signal=CAN3_Mtemp23}, {implementation-record-element=CAN3_Mtemp22, system-signal=CAN3_Mtemp22}, {implementation-record-element=CAN3_Mtemp21, system-signal=CAN3_Mtemp21}, {implementation-record-element=CAN3_Mtemp20, system-signal=CAN3_Mtemp20}, {implementation-record-element=CAN3_Mtemp19, system-signal=CAN3_Mtemp19}, {implementation-record-element=CAN3_Mtemp18, system-signal=CAN3_Mtemp18}, {implementation-record-element=CAN3_Mtemp17, system-signal=CAN3_Mtemp17}, {implementation-record-element=CAN3_Mtemp16, system-signal=CAN3_Mtemp16}, {implementation-record-element=CAN3_Mtemp15, system-signal=CAN3_Mtemp15}, {implementation-record-element=CAN3_Mtemp14, system-signal=CAN3_Mtemp14}, {implementation-record-element=CAN3_Mtemp13, system-signal=CAN3_Mtemp13}, {implementation-record-element=CAN3_Mtemp12, system-signal=CAN3_Mtemp12}, {implementation-record-element=CAN3_Mtemp11, system-signal=CAN3_Mtemp11}, {implementation-record-element=CAN3_Mtemp10, system-signal=CAN3_Mtemp10}, {implementation-record-element=CAN3_Mtemp09, system-signal=CAN3_Mtemp09}, {implementation-record-element=CAN3_Mtemp08, system-signal=CAN3_Mtemp08}, {implementation-record-element=CAN3_Mtemp07, system-signal=CAN3_Mtemp07}, {implementation-record-element=CAN3_Mtemp06, system-signal=CAN3_Mtemp06}, {implementation-record-element=CAN3_Mtemp05, system-signal=CAN3_Mtemp05}, {implementation-record-element=CAN3_Mtemp04, system-signal=CAN3_Mtemp04}, {implementation-record-element=CAN3_Mtemp03, system-signal=CAN3_Mtemp03}, {implementation-record-element=CAN3_Mtemp02, system-signal=CAN3_Mtemp02}, {implementation-record-element=CAN3_Mtemp01, system-signal=CAN3_Mtemp01}, {implementation-record-element=CAN3_MinCellVolt_Num, system-signal=CAN3_MinCellVolt_Num}, {implementation-record-element=CAN3_MinCellTemp_Num, system-signal=CAN3_MinCellTemp_Num}, {implementation-record-element=CAN3_MaxCellVolt_Num, system-signal=CAN3_MaxCellVolt_Num}, {implementation-record-element=CAN3_MaxCellTemp_Num, system-signal=CAN3_MaxCellTemp_Num}, {implementation-record-element=CAN3_HVBMTempMin, system-signal=CAN3_HVBMTempMin}, {implementation-record-element=CAN3_HVBMTempMax, system-signal=CAN3_HVBMTempMax}, {implementation-record-element=CAN3_HVBCellVoltMin, system-signal=CAN3_HVBCellVoltMin}, {implementation-record-element=CAN3_HVBCellVoltMax, system-signal=CAN3_HVBCellVoltMax}]}
      MAP_HALIN_R_CAN3_BMS5: sender-receiver-to-signal-group-mapping{communication-direction=IN, data-element=SWC_HALIN.root_FDC.R_CAN3_BMS5.CAN3_SG_BMS5, signal-group=CAN3_SG_BMS5, type-mapping=sender-rec-record-type-mapping=record-element-mappings=[{implementation-record-element=CAN3_DCPortNeg_Temp, system-signal=CAN3_DCPortNeg_Temp}, {implementation-record-element=CAN3_ReChargerStaFromEvcc, system-signal=CAN3_ReChargerStaFromEvcc}, {implementation-record-element=CAN3_OBCEna, system-signal=CAN3_OBCEna}, {implementation-record-element=CAN3_OBCDCVoltLm, system-signal=CAN3_OBCDCVoltLm}, {implementation-record-element=CAN3_OBCDCCurLm, system-signal=CAN3_OBCDCCurLm}, {implementation-record-element=CAN3_OBCACCSLimit, system-signal=CAN3_OBCACCSLimit}, {implementation-record-element=CAN3_LVBattDet12V, system-signal=CAN3_LVBattDet12V}, {implementation-record-element=CAN3_HVInVolt, system-signal=CAN3_HVInVolt}, {implementation-record-element=CAN3_DCPortPos_Temp, system-signal=CAN3_DCPortPos_Temp}]}
      MAP_HALIN_R_CAN3_BMS6: sender-receiver-to-signal-group-mapping{communication-direction=IN, data-element=SWC_HALIN.root_FDC.R_CAN3_BMS6.CAN3_SG_BMS6, signal-group=CAN3_SG_BMS6, type-mapping=sender-rec-record-type-mapping=record-element-mappings=[{implementation-record-element=CAN3_BMSChckSum, system-signal=CAN3_BMSChckSum}, {implementation-record-element=CAN3_V2LSta, system-signal=CAN3_V2LSta}, {implementation-record-element=CAN3_SystemUncomErr, system-signal=CAN3_SystemUncomErr}, {implementation-record-element=CAN3_IsoDetSta, system-signal=CAN3_IsoDetSta}, {implementation-record-element=CAN3_HVILSta, system-signal=CAN3_HVILSta}, {implementation-record-element=CAN3_HVBattReady4Pre, system-signal=CAN3_HVBattReady4Pre}, {implementation-record-element=CAN3_HVBUndrVoltErr, system-signal=CAN3_HVBUndrVoltErr}, {implementation-record-element=CAN3_HVBUndrTempWarn, system-signal=CAN3_HVBUndrTempWarn}, {implementation-record-element=CAN3_HVBUndrTempErr, system-signal=CAN3_HVBUndrTempErr}, {implementation-record-element=CAN3_HVBUndrSOCErr, system-signal=CAN3_HVBUndrSOCErr}, {implementation-record-element=CAN3_HVBTempDiffErr, system-signal=CAN3_HVBTempDiffErr}, {implementation-record-element=CAN3_HVBShrtDischrgCurrErr, system-signal=CAN3_HVBShrtDischrgCurrErr}, {implementation-record-element=CAN3_HVBShrtChrgCurrErr, system-signal=CAN3_HVBShrtChrgCurrErr}, {implementation-record-element=CAN3_HVBSOCJumpError, system-signal=CAN3_HVBSOCJumpError}, {implementation-record-element=CAN3_HVBPreheatPrecoolSta, system-signal=CAN3_HVBPreheatPrecoolSta}, {implementation-record-element=CAN3_HVBPrechrgSta, system-signal=CAN3_HVBPrechrgSta}, {implementation-record-element=CAN3_HVBOvrVoltErr, system-signal=CAN3_HVBOvrVoltErr}, {implementation-record-element=CAN3_HVBOvrTempWarn, system-signal=CAN3_HVBOvrTempWarn}, {implementation-record-element=CAN3_HVBOvrTempErr, system-signal=CAN3_HVBOvrTempErr}, {implementation-record-element=CAN3_HVBOvrSOCErr, system-signal=CAN3_HVBOvrSOCErr}, {implementation-record-element=CAN3_HVBOvrDchrgCurErr, system-signal=CAN3_HVBOvrDchrgCurErr}, {implementation-record-element=CAN3_HVBOvrChrgCurrErr, system-signal=CAN3_HVBOvrChrgCurrErr}, {implementation-record-element=CAN3_HVBHVILErr, system-signal=CAN3_HVBHVILErr}, {implementation-record-element=CAN3_HVBContactorSta, system-signal=CAN3_HVBContactorSta}, {implementation-record-element=CAN3_HVBChrgErr, system-signal=CAN3_HVBChrgErr}, {implementation-record-element=CAN3_HVBCellUndrVoltErr, system-signal=CAN3_HVBCellUndrVoltErr}, {implementation-record-element=CAN3_HVBCellUnbalanErr, system-signal=CAN3_HVBCellUnbalanErr}, {implementation-record-element=CAN3_HVBCellUdrVoltWarn, system-signal=CAN3_HVBCellUdrVoltWarn}, {implementation-record-element=CAN3_HVBCellOvrVoltWarn, system-signal=CAN3_HVBCellOvrVoltWarn}, {implementation-record-element=CAN3_HVBCellOvrVoltErr, system-signal=CAN3_HVBCellOvrVoltErr}, {implementation-record-element=CAN3_ExtChrgSta, system-signal=CAN3_ExtChrgSta}, {implementation-record-element=CAN3_DisChrgPlugErr, system-signal=CAN3_DisChrgPlugErr}, {implementation-record-element=CAN3_DCChrgSysShockErr, system-signal=CAN3_DCChrgSysShockErr}, {implementation-record-element=CAN3_ChrgPlugSta, system-signal=CAN3_ChrgPlugSta}, {implementation-record-element=CAN3_ChrgInLockReq, system-signal=CAN3_ChrgInLockReq}, {implementation-record-element=CAN3_CellUnconsistErr, system-signal=CAN3_CellUnconsistErr}, {implementation-record-element=CAN3_BMS_Warn_8, system-signal=CAN3_BMS_Warn_8}, {implementation-record-element=CAN3_BMS_Warn_7, system-signal=CAN3_BMS_Warn_7}, {implementation-record-element=CAN3_BMS_Warn_6, system-signal=CAN3_BMS_Warn_6}, {implementation-record-element=CAN3_BMS_Warn_5, system-signal=CAN3_BMS_Warn_5}, {implementation-record-element=CAN3_BMS_Warn_4, system-signal=CAN3_BMS_Warn_4}, {implementation-record-element=CAN3_BMS_Warn_3, system-signal=CAN3_BMS_Warn_3}, {implementation-record-element=CAN3_BMS_Warn_2, system-signal=CAN3_BMS_Warn_2}, {implementation-record-element=CAN3_BMS_Warn_1, system-signal=CAN3_BMS_Warn_1}, {implementation-record-element=CAN3_BMS_READY, system-signal=CAN3_BMS_READY}, {implementation-record-element=CAN3_BMSRolCnct, system-signal=CAN3_BMSRolCnct}]}
      MAP_HALIN_R_CAN3_BMS8: sender-receiver-to-signal-group-mapping{communication-direction=IN, data-element=SWC_HALIN.root_FDC.R_CAN3_BMS8.CAN3_SG_BMS8, signal-group=CAN3_SG_BMS8, type-mapping=sender-rec-record-type-mapping=record-element-mappings=[{implementation-record-element=CAN3_ACChrgStop, system-signal=CAN3_ACChrgStop}, {implementation-record-element=CAN3_TherRunawayErrMask, system-signal=CAN3_TherRunawayErrMask}, {implementation-record-element=CAN3_MainRlyPosSta, system-signal=CAN3_MainRlyPosSta}, {implementation-record-element=CAN3_MainRlyPosOutterVoltage, system-signal=CAN3_MainRlyPosOutterVoltage}, {implementation-record-element=CAN3_MainRlyPosInnerVoltage, system-signal=CAN3_MainRlyPosInnerVoltage}, {implementation-record-element=CAN3_MainRlyPosDriReq, system-signal=CAN3_MainRlyPosDriReq}, {implementation-record-element=CAN3_MainRlyNegSta, system-signal=CAN3_MainRlyNegSta}, {implementation-record-element=CAN3_MainRlyNegOutterVoltage, system-signal=CAN3_MainRlyNegOutterVoltage}, {implementation-record-element=CAN3_MainRlyNegDriReq, system-signal=CAN3_MainRlyNegDriReq}, {implementation-record-element=CAN3_MainPosstandard, system-signal=CAN3_MainPosstandard}, {implementation-record-element=CAN3_MainChrgRlyPosSta, system-signal=CAN3_MainChrgRlyPosSta}, {implementation-record-element=CAN3_MainChrgRlyPosOutterVoltage, system-signal=CAN3_MainChrgRlyPosOutterVoltage}, {implementation-record-element=CAN3_MainChrgRlyPosDriReq, system-signal=CAN3_MainChrgRlyPosDriReq}, {implementation-record-element=CAN3_MainChrgRlyNegSta, system-signal=CAN3_MainChrgRlyNegSta}, {implementation-record-element=CAN3_MainChrgRlyNegOutterVoltage, system-signal=CAN3_MainChrgRlyNegOutterVoltage}, {implementation-record-element=CAN3_MainChrgRlyNegDriReq, system-signal=CAN3_MainChrgRlyNegDriReq}, {implementation-record-element=CAN3_G0standard, system-signal=CAN3_G0standard}, {implementation-record-element=CAN3_DCChrgVoltage, system-signal=CAN3_DCChrgVoltage}, {implementation-record-element=CAN3_DCChrgStop, system-signal=CAN3_DCChrgStop}, {implementation-record-element=CAN3_DCChrgCurrent, system-signal=CAN3_DCChrgCurrent}, {implementation-record-element=CAN3_CurrentErrorID, system-signal=CAN3_CurrentErrorID}, {implementation-record-element=CAN3_BMS_HVBDchrgCap_Sta, system-signal=CAN3_BMS_HVBDchrgCap_Sta}, {implementation-record-element=CAN3_BMS_HVBChrgCap_Sta, system-signal=CAN3_BMS_HVBChrgCap_Sta}]}
      MAP_HALIN_R_CAN3_CCU1: sender-receiver-to-signal-group-mapping{communication-direction=IN, data-element=SWC_HALIN.root_FDC.R_CAN3_CCU1.CAN3_SG_CCU1, signal-group=CAN3_SG_CCU1, type-mapping=sender-rec-record-type-mapping=record-element-mappings=[{implementation-record-element=CAN3_CS_CCU1, system-signal=CAN3_CS_CCU1}, {implementation-record-element=CAN3_RC_CCU1, system-signal=CAN3_RC_CCU1}, {implementation-record-element=CAN3_OBCWakeup4Plugin, system-signal=CAN3_OBCWakeup4Plugin}, {implementation-record-element=CAN3_OBCV2LVoutUVP, system-signal=CAN3_OBCV2LVoutUVP}, {implementation-record-element=CAN3_OBCV2LVoutOVP, system-signal=CAN3_OBCV2LVoutOVP}, {implementation-record-element=CAN3_OBCV2LVoutOCP, system-signal=CAN3_OBCV2LVoutOCP}, {implementation-record-element=CAN3_OBCV2LVinUVP, system-signal=CAN3_OBCV2LVinUVP}, {implementation-record-element=CAN3_OBCV2LVinOVP, system-signal=CAN3_OBCV2LVinOVP}, {implementation-record-element=CAN3_OBCV2LInsuFault, system-signal=CAN3_OBCV2LInsuFault}, {implementation-record-element=CAN3_OBCV2LINVOTP, system-signal=CAN3_OBCV2LINVOTP}, {implementation-record-element=CAN3_OBCPreCompleted, system-signal=CAN3_OBCPreCompleted}, {implementation-record-element=CAN3_OBCDCVoltInf, system-signal=CAN3_OBCDCVoltInf}, {implementation-record-element=CAN3_OBCDCCurrInf, system-signal=CAN3_OBCDCCurrInf}, {implementation-record-element=CAN3_DCDCPreCompleted, system-signal=CAN3_DCDCPreCompleted}, {implementation-record-element=CAN3_DCDCInVoltInf, system-signal=CAN3_DCDCInVoltInf}, {implementation-record-element=CAN3_DCDCHVCur, system-signal=CAN3_DCDCHVCur}, {implementation-record-element=CAN3_DCDCAuxVolt, system-signal=CAN3_DCDCAuxVolt}, {implementation-record-element=CAN3_DCDCAuxCur, system-signal=CAN3_DCDCAuxCur}]}
      MAP_HALIN_R_CAN3_CCU2: sender-receiver-to-signal-group-mapping{communication-direction=IN, data-element=SWC_HALIN.root_FDC.R_CAN3_CCU2.CAN3_SG_CCU2, signal-group=CAN3_SG_CCU2, type-mapping=sender-rec-record-type-mapping=record-element-mappings=[{implementation-record-element=CAN3_CS_CCU2, system-signal=CAN3_CS_CCU2}, {implementation-record-element=CAN3_RC_CCU2, system-signal=CAN3_RC_CCU2}, {implementation-record-element=CAN3_OBC_AC_Cur_Lim, system-signal=CAN3_OBC_AC_Cur_Lim}, {implementation-record-element=CAN3_OBCV2LSta, system-signal=CAN3_OBCV2LSta}, {implementation-record-element=CAN3_OBCTemp, system-signal=CAN3_OBCTemp}, {implementation-record-element=CAN3_OBCRlySta, system-signal=CAN3_OBCRlySta}, {implementation-record-element=CAN3_OBCReady4Pre, system-signal=CAN3_OBCReady4Pre}, {implementation-record-element=CAN3_OBCPluginSta, system-signal=CAN3_OBCPluginSta}, {implementation-record-element=CAN3_OBCFaultSta, system-signal=CAN3_OBCFaultSta}, {implementation-record-element=CAN3_OBCEnaSta, system-signal=CAN3_OBCEnaSta}, {implementation-record-element=CAN3_OBCDCP, system-signal=CAN3_OBCDCP}, {implementation-record-element=CAN3_OBCACVoltInf, system-signal=CAN3_OBCACVoltInf}, {implementation-record-element=CAN3_OBCACCurrInf, system-signal=CAN3_OBCACCurrInf}, {implementation-record-element=CAN3_DCDCTemp, system-signal=CAN3_DCDCTemp}, {implementation-record-element=CAN3_DCDCReady4Pre, system-signal=CAN3_DCDCReady4Pre}, {implementation-record-element=CAN3_DCDCFaultSta, system-signal=CAN3_DCDCFaultSta}, {implementation-record-element=CAN3_DCDCEnaSta, system-signal=CAN3_DCDCEnaSta}]}
      MAP_HALIN_R_CAN3_EBM1: sender-receiver-to-signal-group-mapping{communication-direction=IN, data-element=SWC_HALIN.root_FDC.R_CAN3_EBM1.CAN3_SG_EBM1, signal-group=CAN3_SG_EBM1, type-mapping=sender-rec-record-type-mapping=record-element-mappings=[{implementation-record-element=CAN3_EBM1_CS, system-signal=CAN3_EBM1_CS}, {implementation-record-element=CAN3_EBMSta, system-signal=CAN3_EBMSta}, {implementation-record-element=CAN3_EBMRLampSta, system-signal=CAN3_EBMRLampSta}, {implementation-record-element=CAN3_EBMErrSta, system-signal=CAN3_EBMErrSta}, {implementation-record-element=CAN3_EBM1_RC, system-signal=CAN3_EBM1_RC}]}
      MAP_HALIN_R_CAN3_MCU_B_F1: sender-receiver-to-signal-group-mapping{communication-direction=IN, data-element=SWC_HALIN.root_FDC.R_CAN3_MCU_B_F1.CAN3_SG_MCU_B_F1, signal-group=CAN3_SG_MCU_B_F1, type-mapping=sender-rec-record-type-mapping=record-element-mappings=[{implementation-record-element=CAN3_Fr_ActvDmpDisabSta, system-signal=CAN3_Fr_ActvDmpDisabSta}, {implementation-record-element=CAN3_MCU_B_F_RealPwrKw_Sta, system-signal=CAN3_MCU_B_F_RealPwrKw_Sta}, {implementation-record-element=CAN3_MCU_B_F_IGBTDdeTemp_Sta, system-signal=CAN3_MCU_B_F_IGBTDdeTemp_Sta}, {implementation-record-element=CAN3_MCUWarn_F, system-signal=CAN3_MCUWarn_F}, {implementation-record-element=CAN3_Fr_TMiq, system-signal=CAN3_Fr_TMiq}, {implementation-record-element=CAN3_Fr_TMid, system-signal=CAN3_Fr_TMid}, {implementation-record-element=CAN3_Fr_TMTemp, system-signal=CAN3_Fr_TMTemp}, {implementation-record-element=CAN3_Fr_TMSpd, system-signal=CAN3_Fr_TMSpd}, {implementation-record-element=CAN3_Fr_Reserved_bits, system-signal=CAN3_Fr_Reserved_bits}, {implementation-record-element=CAN3_Fr_RegenAvailTq, system-signal=CAN3_Fr_RegenAvailTq}, {implementation-record-element=CAN3_Fr_MotorAvailTq, system-signal=CAN3_Fr_MotorAvailTq}, {implementation-record-element=CAN3_Fr_MCUTemp, system-signal=CAN3_Fr_MCUTemp}, {implementation-record-element=CAN3_Fr_MCUSysSta, system-signal=CAN3_Fr_MCUSysSta}, {implementation-record-element=CAN3_Fr_MCUReady4Pre, system-signal=CAN3_Fr_MCUReady4Pre}, {implementation-record-element=CAN3_Fr_MCUReady, system-signal=CAN3_Fr_MCUReady}, {implementation-record-element=CAN3_Fr_MCUIGN_sta, system-signal=CAN3_Fr_MCUIGN_sta}, {implementation-record-element=CAN3_Fr_MCUErr, system-signal=CAN3_Fr_MCUErr}, {implementation-record-element=CAN3_Fr_MCUEnaSta, system-signal=CAN3_Fr_MCUEnaSta}, {implementation-record-element=CAN3_Fr_MCUDischrgSta, system-signal=CAN3_Fr_MCUDischrgSta}, {implementation-record-element=CAN3_Fr_MCUDCBusVolt, system-signal=CAN3_Fr_MCUDCBusVolt}, {implementation-record-element=CAN3_Fr_MCUDCBusCurr, system-signal=CAN3_Fr_MCUDCBusCurr}, {implementation-record-element=CAN3_Fr_MCUBAT, system-signal=CAN3_Fr_MCUBAT}, {implementation-record-element=CAN3_Fr_MCU1RolCnt, system-signal=CAN3_Fr_MCU1RolCnt}, {implementation-record-element=CAN3_Fr_MCU1Chksum, system-signal=CAN3_Fr_MCU1Chksum}, {implementation-record-element=CAN3_Fr_EDUTqReqFbk, system-signal=CAN3_Fr_EDUTqReqFbk}, {implementation-record-element=CAN3_Fr_EDURotateDirction, system-signal=CAN3_Fr_EDURotateDirction}, {implementation-record-element=CAN3_Fr_EDURealTMTq, system-signal=CAN3_Fr_EDURealTMTq}, {implementation-record-element=CAN3_Fr_EDUOpratingSta, system-signal=CAN3_Fr_EDUOpratingSta}, {implementation-record-element=CAN3_Fr_EDUDrtSta, system-signal=CAN3_Fr_EDUDrtSta}]}
      MAP_HALIN_R_CAN3_MCU_B_F2: sender-receiver-to-signal-group-mapping{communication-direction=IN, data-element=SWC_HALIN.root_FDC.R_CAN3_MCU_B_F2.CAN3_SG_MCU_B_F2, signal-group=CAN3_SG_MCU_B_F2, type-mapping=sender-rec-record-type-mapping=record-element-mappings=[{implementation-record-element=CAN3_Fr_CoolanttempReq, system-signal=CAN3_Fr_CoolanttempReq}, {implementation-record-element=CAN3_MCU_B_F_LLCTempWarn_Sta, system-signal=CAN3_MCU_B_F_LLCTempWarn_Sta}, {implementation-record-element=CAN3_MCU_B_F_KL302TqCnt_Sta, system-signal=CAN3_MCU_B_F_KL302TqCnt_Sta}, {implementation-record-element=CAN3_MCU_B_F_FailLv_Sta, system-signal=CAN3_MCU_B_F_FailLv_Sta}, {implementation-record-element=CAN3_Fr_TMTempWarn, system-signal=CAN3_Fr_TMTempWarn}, {implementation-record-element=CAN3_Fr_MCU_SW_Ver, system-signal=CAN3_Fr_MCU_SW_Ver}, {implementation-record-element=CAN3_Fr_MCU_HW_Ver, system-signal=CAN3_Fr_MCU_HW_Ver}, {implementation-record-element=CAN3_Fr_MCUTempWarn, system-signal=CAN3_Fr_MCUTempWarn}, {implementation-record-element=CAN3_Fr_MCU2RolCnt, system-signal=CAN3_Fr_MCU2RolCnt}, {implementation-record-element=CAN3_Fr_MCU2Chksum, system-signal=CAN3_Fr_MCU2Chksum}, {implementation-record-element=CAN3_Fr_LLCflowReq, system-signal=CAN3_Fr_LLCflowReq}, {implementation-record-element=CAN3_Fr_LLCTemp, system-signal=CAN3_Fr_LLCTemp}, {implementation-record-element=CAN3_Fr_Failcodehistory2, system-signal=CAN3_Fr_Failcodehistory2}, {implementation-record-element=CAN3_Fr_Failcodehistory1, system-signal=CAN3_Fr_Failcodehistory1}, {implementation-record-element=CAN3_Fr_Failcode2, system-signal=CAN3_Fr_Failcode2}, {implementation-record-element=CAN3_Fr_Failcode1, system-signal=CAN3_Fr_Failcode1}]}
      MAP_HALIN_R_CAN3_MCU_B_R1: sender-receiver-to-signal-group-mapping{communication-direction=IN, data-element=SWC_HALIN.root_FDC.R_CAN3_MCU_B_R1.CAN3_SG_MCU_B_R1, signal-group=CAN3_SG_MCU_B_R1, type-mapping=sender-rec-record-type-mapping=record-element-mappings=[{implementation-record-element=CAN3_MCUWarn_R, system-signal=CAN3_MCUWarn_R}, {implementation-record-element=CAN3_Rr_TMiq, system-signal=CAN3_Rr_TMiq}, {implementation-record-element=CAN3_Rr_TMid, system-signal=CAN3_Rr_TMid}, {implementation-record-element=CAN3_Rr_TMTemp, system-signal=CAN3_Rr_TMTemp}, {implementation-record-element=CAN3_Rr_TMSpd, system-signal=CAN3_Rr_TMSpd}, {implementation-record-element=CAN3_Rr_Reserved_bits, system-signal=CAN3_Rr_Reserved_bits}, {implementation-record-element=CAN3_Rr_RegenAvailTq, system-signal=CAN3_Rr_RegenAvailTq}, {implementation-record-element=CAN3_Rr_MotorAvailTq, system-signal=CAN3_Rr_MotorAvailTq}, {implementation-record-element=CAN3_Rr_MCUTemp, system-signal=CAN3_Rr_MCUTemp}, {implementation-record-element=CAN3_Rr_MCUSysSta, system-signal=CAN3_Rr_MCUSysSta}, {implementation-record-element=CAN3_Rr_MCUReady4Pre, system-signal=CAN3_Rr_MCUReady4Pre}, {implementation-record-element=CAN3_Rr_MCUReady, system-signal=CAN3_Rr_MCUReady}, {implementation-record-element=CAN3_Rr_MCUIGN_sta, system-signal=CAN3_Rr_MCUIGN_sta}, {implementation-record-element=CAN3_Rr_MCUErr, system-signal=CAN3_Rr_MCUErr}, {implementation-record-element=CAN3_Rr_MCUEnaSta, system-signal=CAN3_Rr_MCUEnaSta}, {implementation-record-element=CAN3_Rr_MCUDischrgSta, system-signal=CAN3_Rr_MCUDischrgSta}, {implementation-record-element=CAN3_Rr_MCUDCBusVolt, system-signal=CAN3_Rr_MCUDCBusVolt}, {implementation-record-element=CAN3_Rr_MCUDCBusCurr, system-signal=CAN3_Rr_MCUDCBusCurr}, {implementation-record-element=CAN3_Rr_MCUBAT, system-signal=CAN3_Rr_MCUBAT}, {implementation-record-element=CAN3_Rr_MCU1RolCnt, system-signal=CAN3_Rr_MCU1RolCnt}, {implementation-record-element=CAN3_Rr_MCU1Chksum, system-signal=CAN3_Rr_MCU1Chksum}, {implementation-record-element=CAN3_Rr_EDUTqReqFbk, system-signal=CAN3_Rr_EDUTqReqFbk}, {implementation-record-element=CAN3_Rr_EDURotateDirction, system-signal=CAN3_Rr_EDURotateDirction}, {implementation-record-element=CAN3_Rr_EDURealTMTq, system-signal=CAN3_Rr_EDURealTMTq}, {implementation-record-element=CAN3_Rr_EDUOpratingSta, system-signal=CAN3_Rr_EDUOpratingSta}, {implementation-record-element=CAN3_Rr_EDUDrtSta, system-signal=CAN3_Rr_EDUDrtSta}, {implementation-record-element=CAN3_Rr_ActvDmpDisabSta, system-signal=CAN3_Rr_ActvDmpDisabSta}, {implementation-record-element=CAN3_MCU_B_R_RealPwrKw_Sta, system-signal=CAN3_MCU_B_R_RealPwrKw_Sta}, {implementation-record-element=CAN3_MCU_B_R_IGBTDdeTemp_Sta, system-signal=CAN3_MCU_B_R_IGBTDdeTemp_Sta}]}
      MAP_HALIN_R_CAN3_MCU_B_R2: sender-receiver-to-signal-group-mapping{communication-direction=IN, data-element=SWC_HALIN.root_FDC.R_CAN3_MCU_B_R2.CAN3_SG_MCU_B_R2, signal-group=CAN3_SG_MCU_B_R2, type-mapping=sender-rec-record-type-mapping=record-element-mappings=[{implementation-record-element=CAN3_MCU_B_R_FailLv_Sta, system-signal=CAN3_MCU_B_R_FailLv_Sta}, {implementation-record-element=CAN3_Rr_TMTempWarn, system-signal=CAN3_Rr_TMTempWarn}, {implementation-record-element=CAN3_Rr_MCUTempWarn, system-signal=CAN3_Rr_MCUTempWarn}, {implementation-record-element=CAN3_Rr_MCU3_SW_Ver, system-signal=CAN3_Rr_MCU3_SW_Ver}, {implementation-record-element=CAN3_Rr_MCU3_HW_Ver, system-signal=CAN3_Rr_MCU3_HW_Ver}, {implementation-record-element=CAN3_Rr_MCU2RolCnt, system-signal=CAN3_Rr_MCU2RolCnt}, {implementation-record-element=CAN3_Rr_MCU2Chksum, system-signal=CAN3_Rr_MCU2Chksum}, {implementation-record-element=CAN3_Rr_LLCflowReq, system-signal=CAN3_Rr_LLCflowReq}, {implementation-record-element=CAN3_Rr_LLCTemp, system-signal=CAN3_Rr_LLCTemp}, {implementation-record-element=CAN3_Rr_Failcodehistory2, system-signal=CAN3_Rr_Failcodehistory2}, {implementation-record-element=CAN3_Rr_Failcodehistory1, system-signal=CAN3_Rr_Failcodehistory1}, {implementation-record-element=CAN3_Rr_Failcode2, system-signal=CAN3_Rr_Failcode2}, {implementation-record-element=CAN3_Rr_Failcode1, system-signal=CAN3_Rr_Failcode1}, {implementation-record-element=CAN3_Rr_CoolanttempReq, system-signal=CAN3_Rr_CoolanttempReq}, {implementation-record-element=CAN3_MCU_B_R_LLCTempWarn_Sta, system-signal=CAN3_MCU_B_R_LLCTempWarn_Sta}, {implementation-record-element=CAN3_MCU_B_R_KL302TqCnt_Sta, system-signal=CAN3_MCU_B_R_KL302TqCnt_Sta}]}
      MAP_HALIN_R_CAN3_MCU_N_F1: sender-receiver-to-signal-group-mapping{communication-direction=IN, data-element=SWC_HALIN.root_FDC.R_CAN3_MCU_N_F1.CAN3_SG_MCU_N_F1, signal-group=CAN3_SG_MCU_N_F1, type-mapping=sender-rec-record-type-mapping=record-element-mappings=[{implementation-record-element=CAN3_Fr_ActvDmpDisabSta_Nidec, system-signal=CAN3_Fr_ActvDmpDisabSta_Nidec}, {implementation-record-element=CAN3_MCUWarn_F_Nidec, system-signal=CAN3_MCUWarn_F_Nidec}, {implementation-record-element=CAN3_Fr_TMiq_Nidec, system-signal=CAN3_Fr_TMiq_Nidec}, {implementation-record-element=CAN3_Fr_TMid_Nidec, system-signal=CAN3_Fr_TMid_Nidec}, {implementation-record-element=CAN3_Fr_TMTemp_Nidec, system-signal=CAN3_Fr_TMTemp_Nidec}, {implementation-record-element=CAN3_Fr_TMSpd_Nidec, system-signal=CAN3_Fr_TMSpd_Nidec}, {implementation-record-element=CAN3_Fr_Reserved_bits_Nidec, system-signal=CAN3_Fr_Reserved_bits_Nidec}, {implementation-record-element=CAN3_Fr_RegenAvailTq_Nidec, system-signal=CAN3_Fr_RegenAvailTq_Nidec}, {implementation-record-element=CAN3_Fr_MotorAvailTq_Nidec, system-signal=CAN3_Fr_MotorAvailTq_Nidec}, {implementation-record-element=CAN3_Fr_MCUTemp_Nidec, system-signal=CAN3_Fr_MCUTemp_Nidec}, {implementation-record-element=CAN3_Fr_MCUSysSta_Nidec, system-signal=CAN3_Fr_MCUSysSta_Nidec}, {implementation-record-element=CAN3_Fr_MCUReady_Nidec, system-signal=CAN3_Fr_MCUReady_Nidec}, {implementation-record-element=CAN3_Fr_MCUReady4Pre_Nidec, system-signal=CAN3_Fr_MCUReady4Pre_Nidec}, {implementation-record-element=CAN3_Fr_MCUIGN_sta_Nidec, system-signal=CAN3_Fr_MCUIGN_sta_Nidec}, {implementation-record-element=CAN3_Fr_MCUErr_Nidec, system-signal=CAN3_Fr_MCUErr_Nidec}, {implementation-record-element=CAN3_Fr_MCUEnaSta_Nidec, system-signal=CAN3_Fr_MCUEnaSta_Nidec}, {implementation-record-element=CAN3_Fr_MCUDischrgSta_Nidec, system-signal=CAN3_Fr_MCUDischrgSta_Nidec}, {implementation-record-element=CAN3_Fr_MCUDCBusVolt_Nidec, system-signal=CAN3_Fr_MCUDCBusVolt_Nidec}, {implementation-record-element=CAN3_Fr_MCUDCBusCurr_Nidec, system-signal=CAN3_Fr_MCUDCBusCurr_Nidec}, {implementation-record-element=CAN3_Fr_MCUBAT_Nidec, system-signal=CAN3_Fr_MCUBAT_Nidec}, {implementation-record-element=CAN3_Fr_MCU1RolCnt_Nidec, system-signal=CAN3_Fr_MCU1RolCnt_Nidec}, {implementation-record-element=CAN3_Fr_MCU1Chksum_Nidec, system-signal=CAN3_Fr_MCU1Chksum_Nidec}, {implementation-record-element=CAN3_Fr_EDUTqReqFbk_Nidec, system-signal=CAN3_Fr_EDUTqReqFbk_Nidec}, {implementation-record-element=CAN3_Fr_EDURotateDirction_Nidec, system-signal=CAN3_Fr_EDURotateDirction_Nidec}, {implementation-record-element=CAN3_Fr_EDURealTMTq_Nidec, system-signal=CAN3_Fr_EDURealTMTq_Nidec}, {implementation-record-element=CAN3_Fr_EDUOpratingSta_Nidec, system-signal=CAN3_Fr_EDUOpratingSta_Nidec}, {implementation-record-element=CAN3_Fr_EDUDrtSta_Nidec, system-signal=CAN3_Fr_EDUDrtSta_Nidec}]}
      MAP_HALIN_R_CAN3_MCU_N_F2: sender-receiver-to-signal-group-mapping{communication-direction=IN, data-element=SWC_HALIN.root_FDC.R_CAN3_MCU_N_F2.CAN3_SG_MCU_N_F2, signal-group=CAN3_SG_MCU_N_F2, type-mapping=sender-rec-record-type-mapping=record-element-mappings=[{implementation-record-element=CAN3_Fr_CoolanttempReq_Nidec, system-signal=CAN3_Fr_CoolanttempReq_Nidec}, {implementation-record-element=CAN3_MCU_F_ResetCnt_Sta, system-signal=CAN3_MCU_F_ResetCnt_Sta}, {implementation-record-element=CAN3_Fr_TMTempWarn_Nidec, system-signal=CAN3_Fr_TMTempWarn_Nidec}, {implementation-record-element=CAN3_Fr_MCUTempWarn_Nidec, system-signal=CAN3_Fr_MCUTempWarn_Nidec}, {implementation-record-element=CAN3_Fr_MCU2RolCnt_Nidec, system-signal=CAN3_Fr_MCU2RolCnt_Nidec}, {implementation-record-element=CAN3_Fr_MCU2Chksum_Nidec, system-signal=CAN3_Fr_MCU2Chksum_Nidec}, {implementation-record-element=CAN3_Fr_LLCflowReq_Nidec, system-signal=CAN3_Fr_LLCflowReq_Nidec}, {implementation-record-element=CAN3_Fr_LLCTemp_Nidec, system-signal=CAN3_Fr_LLCTemp_Nidec}, {implementation-record-element=CAN3_Fr_Failcodehistory2_Nidec, system-signal=CAN3_Fr_Failcodehistory2_Nidec}, {implementation-record-element=CAN3_Fr_Failcodehistory1_Nidec, system-signal=CAN3_Fr_Failcodehistory1_Nidec}, {implementation-record-element=CAN3_Fr_Failcode2_Nidec, system-signal=CAN3_Fr_Failcode2_Nidec}, {implementation-record-element=CAN3_Fr_Failcode1_Nidec, system-signal=CAN3_Fr_Failcode1_Nidec}, {implementation-record-element=CAN3_Fr_EOP_SpdSet_Nidec, system-signal=CAN3_Fr_EOP_SpdSet_Nidec}]}
      MAP_HALIN_R_CAN3_MCU_N_F3: sender-receiver-to-signal-group-mapping{communication-direction=IN, data-element=SWC_HALIN.root_FDC.R_CAN3_MCU_N_F3.CAN3_SG_MCU_N_F3, signal-group=CAN3_SG_MCU_N_F3, type-mapping=sender-rec-record-type-mapping=record-element-mappings=[{implementation-record-element=CAN3_Fr_MCU_HW_Ver_Nidec, system-signal=CAN3_Fr_MCU_HW_Ver_Nidec}, {implementation-record-element=CAN3_Fr_MCU_SW_Ver_Nidec, system-signal=CAN3_Fr_MCU_SW_Ver_Nidec}]}
      MAP_HALIN_R_CAN3_MCU_N_R1: sender-receiver-to-signal-group-mapping{communication-direction=IN, data-element=SWC_HALIN.root_FDC.R_CAN3_MCU_N_R1.CAN3_SG_MCU_N_R1, signal-group=CAN3_SG_MCU_N_R1, type-mapping=sender-rec-record-type-mapping=record-element-mappings=[{implementation-record-element=CAN3_MCUWarn_R_Nidec, system-signal=CAN3_MCUWarn_R_Nidec}, {implementation-record-element=CAN3_Rr_TMiq_Nidec, system-signal=CAN3_Rr_TMiq_Nidec}, {implementation-record-element=CAN3_Rr_TMid_Nidec, system-signal=CAN3_Rr_TMid_Nidec}, {implementation-record-element=CAN3_Rr_TMTemp_Nidec, system-signal=CAN3_Rr_TMTemp_Nidec}, {implementation-record-element=CAN3_Rr_TMSpd_Nidec, system-signal=CAN3_Rr_TMSpd_Nidec}, {implementation-record-element=CAN3_Rr_Reserved_bits_Nidec, system-signal=CAN3_Rr_Reserved_bits_Nidec}, {implementation-record-element=CAN3_Rr_RegenAvailTq_Nidec, system-signal=CAN3_Rr_RegenAvailTq_Nidec}, {implementation-record-element=CAN3_Rr_MotorAvailTq_Nidec, system-signal=CAN3_Rr_MotorAvailTq_Nidec}, {implementation-record-element=CAN3_Rr_MCUTemp_Nidec, system-signal=CAN3_Rr_MCUTemp_Nidec}, {implementation-record-element=CAN3_Rr_MCUSysSta_Nidec, system-signal=CAN3_Rr_MCUSysSta_Nidec}, {implementation-record-element=CAN3_Rr_MCUReady_Nidec, system-signal=CAN3_Rr_MCUReady_Nidec}, {implementation-record-element=CAN3_Rr_MCUReady4Pre_Nidec, system-signal=CAN3_Rr_MCUReady4Pre_Nidec}, {implementation-record-element=CAN3_Rr_MCUIGN_sta_Nidec, system-signal=CAN3_Rr_MCUIGN_sta_Nidec}, {implementation-record-element=CAN3_Rr_MCUErr_Nidec, system-signal=CAN3_Rr_MCUErr_Nidec}, {implementation-record-element=CAN3_Rr_MCUEnaSta_Nidec, system-signal=CAN3_Rr_MCUEnaSta_Nidec}, {implementation-record-element=CAN3_Rr_MCUDischrgSta_Nidec, system-signal=CAN3_Rr_MCUDischrgSta_Nidec}, {implementation-record-element=CAN3_Rr_MCUDCBusVolt_Nidec, system-signal=CAN3_Rr_MCUDCBusVolt_Nidec}, {implementation-record-element=CAN3_Rr_MCUDCBusCurr_Nidec, system-signal=CAN3_Rr_MCUDCBusCurr_Nidec}, {implementation-record-element=CAN3_Rr_MCUBAT_Nidec, system-signal=CAN3_Rr_MCUBAT_Nidec}, {implementation-record-element=CAN3_Rr_MCU1RolCnt_Nidec, system-signal=CAN3_Rr_MCU1RolCnt_Nidec}, {implementation-record-element=CAN3_Rr_MCU1Chksum_Nidec, system-signal=CAN3_Rr_MCU1Chksum_Nidec}, {implementation-record-element=CAN3_Rr_EDUTqReqFbk_Nidec, system-signal=CAN3_Rr_EDUTqReqFbk_Nidec}, {implementation-record-element=CAN3_Rr_EDURotateDirction_Nidec, system-signal=CAN3_Rr_EDURotateDirction_Nidec}, {implementation-record-element=CAN3_Rr_EDURealTMTq_Nidec, system-signal=CAN3_Rr_EDURealTMTq_Nidec}, {implementation-record-element=CAN3_Rr_EDUOpratingSta_Nidec, system-signal=CAN3_Rr_EDUOpratingSta_Nidec}, {implementation-record-element=CAN3_Rr_EDUDrtSta_Nidec, system-signal=CAN3_Rr_EDUDrtSta_Nidec}, {implementation-record-element=CAN3_Rr_ActvDmpDisabSta_Nidec, system-signal=CAN3_Rr_ActvDmpDisabSta_Nidec}]}
      MAP_HALIN_R_CAN3_MCU_N_R2: sender-receiver-to-signal-group-mapping{communication-direction=IN, data-element=SWC_HALIN.root_FDC.R_CAN3_MCU_N_R2.CAN3_SG_MCU_N_R2, signal-group=CAN3_SG_MCU_N_R2, type-mapping=sender-rec-record-type-mapping=record-element-mappings=[{implementation-record-element=CAN3_MCU_R_ResetCnt_Sta, system-signal=CAN3_MCU_R_ResetCnt_Sta}, {implementation-record-element=CAN3_Rr_TMTempWarn_Nidec, system-signal=CAN3_Rr_TMTempWarn_Nidec}, {implementation-record-element=CAN3_Rr_MCUTempWarn_Nidec, system-signal=CAN3_Rr_MCUTempWarn_Nidec}, {implementation-record-element=CAN3_Rr_MCU2RolCnt_Nidec, system-signal=CAN3_Rr_MCU2RolCnt_Nidec}, {implementation-record-element=CAN3_Rr_MCU2Chksum_Nidec, system-signal=CAN3_Rr_MCU2Chksum_Nidec}, {implementation-record-element=CAN3_Rr_LLCflowReq_Nidec, system-signal=CAN3_Rr_LLCflowReq_Nidec}, {implementation-record-element=CAN3_Rr_LLCTemp_Nidec, system-signal=CAN3_Rr_LLCTemp_Nidec}, {implementation-record-element=CAN3_Rr_Failcodehistory2_Nidec, system-signal=CAN3_Rr_Failcodehistory2_Nidec}, {implementation-record-element=CAN3_Rr_Failcodehistory1_Nidec, system-signal=CAN3_Rr_Failcodehistory1_Nidec}, {implementation-record-element=CAN3_Rr_Failcode2_Nidec, system-signal=CAN3_Rr_Failcode2_Nidec}, {implementation-record-element=CAN3_Rr_Failcode1_Nidec, system-signal=CAN3_Rr_Failcode1_Nidec}, {implementation-record-element=CAN3_Rr_EOP_SpdSet_Nidec, system-signal=CAN3_Rr_EOP_SpdSet_Nidec}, {implementation-record-element=CAN3_Rr_CoolanttempReq_Nidec, system-signal=CAN3_Rr_CoolanttempReq_Nidec}]}
      MAP_HALIN_R_CAN3_MCU_N_R3: sender-receiver-to-signal-group-mapping{communication-direction=IN, data-element=SWC_HALIN.root_FDC.R_CAN3_MCU_N_R3.CAN3_SG_MCU_N_R3, signal-group=CAN3_SG_MCU_N_R3, type-mapping=sender-rec-record-type-mapping=record-element-mappings=[{implementation-record-element=CAN3_Rr_MCU3_HW_Ver_Nidec, system-signal=CAN3_Rr_MCU3_HW_Ver_Nidec}, {implementation-record-element=CAN3_Rr_MCU3_SW_Ver_Nidec, system-signal=CAN3_Rr_MCU3_SW_Ver_Nidec}]}
      MAP_HALIN_R_CAN3_Shifter1: sender-receiver-to-signal-group-mapping{communication-direction=IN, data-element=SWC_HALIN.root_FDC.R_CAN3_Shifter1.CAN3_SG_Shifter1, signal-group=CAN3_SG_Shifter1, type-mapping=sender-rec-record-type-mapping=record-element-mappings=[{implementation-record-element=CAN3_Shifter_CRC8, system-signal=CAN3_Shifter_CRC8}, {implementation-record-element=CAN3_Shifter_RC, system-signal=CAN3_Shifter_RC}, {implementation-record-element=CAN3_Shifter_Handle_Cmd, system-signal=CAN3_Shifter_Handle_Cmd}, {implementation-record-element=CAN3_Shifter_Fail_sta, system-signal=CAN3_Shifter_Fail_sta}]}
      MAP_HALIN_R_CAN3_Shifter2: sender-receiver-to-signal-group-mapping{communication-direction=IN, data-element=SWC_HALIN.root_FDC.R_CAN3_Shifter2.CAN3_SG_Shifter2, signal-group=CAN3_SG_Shifter2, type-mapping=sender-rec-record-type-mapping=record-element-mappings=[{implementation-record-element=CAN3_CSW2_DimSw_Sta, system-signal=CAN3_CSW2_DimSw_Sta}, {implementation-record-element=CAN3_CSW2_TurnSw_Sta, system-signal=CAN3_CSW2_TurnSw_Sta}, {implementation-record-element=CAN3_CSW2_RWipWasSw_Sta, system-signal=CAN3_CSW2_RWipWasSw_Sta}, {implementation-record-element=CAN3_CSW2_PassSW_Sta, system-signal=CAN3_CSW2_PassSW_Sta}, {implementation-record-element=CAN3_CSW2_FWipSw_Sta, system-signal=CAN3_CSW2_FWipSw_Sta}, {implementation-record-element=CAN3_CSW2_FWasSw_Sta, system-signal=CAN3_CSW2_FWasSw_Sta}]}
      MAP_HALIN_R_CAN4_BodyZone_DR1: sender-receiver-to-signal-group-mapping{communication-direction=IN, data-element=SWC_HALIN.root_FDC.R_CAN4_BodyZone_DR1.CAN4_SG_BodyZone_DR1, signal-group=CAN4_SG_BodyZone_DR1, type-mapping=sender-rec-record-type-mapping=record-element-mappings=[{implementation-record-element=CAN4_BD_DSEAT_AntiAct_Sta, system-signal=CAN4_BD_DSEAT_AntiAct_Sta}, {implementation-record-element=CAN4_BD_DSEAT_heater_Sta, system-signal=CAN4_BD_DSEAT_heater_Sta}, {implementation-record-element=CAN4_BD_DSEAT_Vent_Sta, system-signal=CAN4_BD_DSEAT_Vent_Sta}, {implementation-record-element=CAN4_BD_DSEAT_StopKeepMove_Sta, system-signal=CAN4_BD_DSEAT_StopKeepMove_Sta}, {implementation-record-element=CAN4_BD_DSEAT_SlidPos_Sta, system-signal=CAN4_BD_DSEAT_SlidPos_Sta}, {implementation-record-element=CAN4_BD_DSEAT_RecPos_Sta, system-signal=CAN4_BD_DSEAT_RecPos_Sta}, {implementation-record-element=CAN4_BD_DSEAT_RLPos_Sta, system-signal=CAN4_BD_DSEAT_RLPos_Sta}, {implementation-record-element=CAN4_BD_DSEAT_Mode_Sta, system-signal=CAN4_BD_DSEAT_Mode_Sta}, {implementation-record-element=CAN4_BD_DSEAT_MemSet_Sta, system-signal=CAN4_BD_DSEAT_MemSet_Sta}, {implementation-record-element=CAN4_BD_DSEAT_FLPos_Sta, system-signal=CAN4_BD_DSEAT_FLPos_Sta}, {implementation-record-element=CAN4_BD_DSEAT_Error_Sta, system-signal=CAN4_BD_DSEAT_Error_Sta}, {implementation-record-element=CAN4_BD_DSEAT_EntryFun_Sta, system-signal=CAN4_BD_DSEAT_EntryFun_Sta}, {implementation-record-element=CAN4_BD_DSEAT_EntryAct_Sta, system-signal=CAN4_BD_DSEAT_EntryAct_Sta}, {implementation-record-element=CAN4_BD_DSEAT_Anti_Sta, system-signal=CAN4_BD_DSEAT_Anti_Sta}]}
      MAP_HALIN_R_CAN4_BodyZone_DR2: sender-receiver-to-signal-group-mapping{communication-direction=IN, data-element=SWC_HALIN.root_FDC.R_CAN4_BodyZone_DR2.CAN4_SG_BodyZone_DR2, signal-group=CAN4_SG_BodyZone_DR2, type-mapping=sender-rec-record-type-mapping=record-element-mappings=[{implementation-record-element=CAN4_BD_APM_WinFOpened_Sta, system-signal=CAN4_BD_APM_WinFOpened_Sta}, {implementation-record-element=CAN4_BD_Door_RHandleHalf_Sta, system-signal=CAN4_BD_Door_RHandleHalf_Sta}, {implementation-record-element=CAN4_BD_Door_RHandleClose_Sta, system-signal=CAN4_BD_Door_RHandleClose_Sta}, {implementation-record-element=CAN4_BD_Door_FHandleHalf_Sta, system-signal=CAN4_BD_Door_FHandleHalf_Sta}, {implementation-record-element=CAN4_BD_Door_FHandleClose_Sta, system-signal=CAN4_BD_Door_FHandleClose_Sta}, {implementation-record-element=CAN4_BD_APM_WinROpened_Sta, system-signal=CAN4_BD_APM_WinROpened_Sta}]}
      MAP_HALIN_R_CAN4_BodyZone_PS1: sender-receiver-to-signal-group-mapping{communication-direction=IN, data-element=SWC_HALIN.root_FDC.R_CAN4_BodyZone_PS1.CAN4_SG_BodyZone_PS1, signal-group=CAN4_SG_BodyZone_PS1, type-mapping=sender-rec-record-type-mapping=record-element-mappings=[{implementation-record-element=CAN4_BP_PSEAT_Error_Sta, system-signal=CAN4_BP_PSEAT_Error_Sta}, {implementation-record-element=CAN4_BP_PTG_Sys_Sta, system-signal=CAN4_BP_PTG_Sys_Sta}, {implementation-record-element=CAN4_BP_PTG_StrutThermal_Sta, system-signal=CAN4_BP_PTG_StrutThermal_Sta}, {implementation-record-element=CAN4_BP_PTG_StrutStall_Sta, system-signal=CAN4_BP_PTG_StrutStall_Sta}, {implementation-record-element=CAN4_BP_PTG_StrutAntiPinch_Sta, system-signal=CAN4_BP_PTG_StrutAntiPinch_Sta}, {implementation-record-element=CAN4_BP_PTG_RightHallPosn_Sta, system-signal=CAN4_BP_PTG_RightHallPosn_Sta}, {implementation-record-element=CAN4_BP_PTG_RightDuty_Sta, system-signal=CAN4_BP_PTG_RightDuty_Sta}, {implementation-record-element=CAN4_BP_PTG_RightCur_Sta, system-signal=CAN4_BP_PTG_RightCur_Sta}, {implementation-record-element=CAN4_BP_PTG_ReleaseCur_Sta, system-signal=CAN4_BP_PTG_ReleaseCur_Sta}, {implementation-record-element=CAN4_BP_PTG_RDIL_Cmd, system-signal=CAN4_BP_PTG_RDIL_Cmd}, {implementation-record-element=CAN4_BP_PTG_PowerLatch_Sta, system-signal=CAN4_BP_PTG_PowerLatch_Sta}, {implementation-record-element=CAN4_BP_PTG_OpenRatio_Sta, system-signal=CAN4_BP_PTG_OpenRatio_Sta}, {implementation-record-element=CAN4_BP_PTG_NtlSW_Sta, system-signal=CAN4_BP_PTG_NtlSW_Sta}, {implementation-record-element=CAN4_BP_PTG_LeftHallPosn_Sta, system-signal=CAN4_BP_PTG_LeftHallPosn_Sta}, {implementation-record-element=CAN4_BP_PTG_LeftDuty_Sta, system-signal=CAN4_BP_PTG_LeftDuty_Sta}, {implementation-record-element=CAN4_BP_PTG_LeftCur_Sta, system-signal=CAN4_BP_PTG_LeftCur_Sta}, {implementation-record-element=CAN4_BP_PTG_LatchThermal_Sta, system-signal=CAN4_BP_PTG_LatchThermal_Sta}, {implementation-record-element=CAN4_BP_PTG_LatchSeg_Sta, system-signal=CAN4_BP_PTG_LatchSeg_Sta}, {implementation-record-element=CAN4_BP_PTG_IsSetHeight_Sta, system-signal=CAN4_BP_PTG_IsSetHeight_Sta}, {implementation-record-element=CAN4_BP_PTG_InsideSW2_Sta, system-signal=CAN4_BP_PTG_InsideSW2_Sta}, {implementation-record-element=CAN4_BP_PTG_InsideSW1_Sta, system-signal=CAN4_BP_PTG_InsideSW1_Sta}, {implementation-record-element=CAN4_BP_PTG_HalfSW_Sta, system-signal=CAN4_BP_PTG_HalfSW_Sta}, {implementation-record-element=CAN4_BP_PTG_FullSW_Sta, system-signal=CAN4_BP_PTG_FullSW_Sta}, {implementation-record-element=CAN4_BP_PTG_Exist_Sta, system-signal=CAN4_BP_PTG_Exist_Sta}, {implementation-record-element=CAN4_BP_PTG_ErrVoltage_Sta, system-signal=CAN4_BP_PTG_ErrVoltage_Sta}, {implementation-record-element=CAN4_BP_PTG_ErrRightStrut_Sta, system-signal=CAN4_BP_PTG_ErrRightStrut_Sta}, {implementation-record-element=CAN4_BP_PTG_ErrLeftStrut_Sta, system-signal=CAN4_BP_PTG_ErrLeftStrut_Sta}, {implementation-record-element=CAN4_BP_PTG_ErrLatch_Sta, system-signal=CAN4_BP_PTG_ErrLatch_Sta}, {implementation-record-element=CAN4_BP_PTG_ErrHall_Sta, system-signal=CAN4_BP_PTG_ErrHall_Sta}, {implementation-record-element=CAN4_BP_PTG_DebugMode_Sta, system-signal=CAN4_BP_PTG_DebugMode_Sta}, {implementation-record-element=CAN4_BP_PTG_CinchDuty_Sta, system-signal=CAN4_BP_PTG_CinchDuty_Sta}, {implementation-record-element=CAN4_BP_PTG_CinchCur_Sta, system-signal=CAN4_BP_PTG_CinchCur_Sta}, {implementation-record-element=CAN4_BP_PTG_Active_Sta, system-signal=CAN4_BP_PTG_Active_Sta}, {implementation-record-element=CAN4_BP_PTG_AbuseProtection_Sta, system-signal=CAN4_BP_PTG_AbuseProtection_Sta}, {implementation-record-element=CAN4_BP_PSEAT_heater_Sta, system-signal=CAN4_BP_PSEAT_heater_Sta}, {implementation-record-element=CAN4_BP_PSEAT_Vent_Sta, system-signal=CAN4_BP_PSEAT_Vent_Sta}, {implementation-record-element=CAN4_BP_PSEAT_Mode_Sta, system-signal=CAN4_BP_PSEAT_Mode_Sta}]}
      MAP_HALIN_R_CAN4_BodyZone_PS2: sender-receiver-to-signal-group-mapping{communication-direction=IN, data-element=SWC_HALIN.root_FDC.R_CAN4_BodyZone_PS2.CAN4_SG_BodyZone_PS2, signal-group=CAN4_SG_BodyZone_PS2, type-mapping=sender-rec-record-type-mapping=record-element-mappings=[{implementation-record-element=CAN4_BP_APM_WinFOpened_Sta, system-signal=CAN4_BP_APM_WinFOpened_Sta}, {implementation-record-element=CAN4_BP_SYS_LampPwrSTS_Sta, system-signal=CAN4_BP_SYS_LampPwrSTS_Sta}, {implementation-record-element=CAN4_BP_SEAT_RVent_Sta, system-signal=CAN4_BP_SEAT_RVent_Sta}, {implementation-record-element=CAN4_BP_SEAT_MRVent_Sta, system-signal=CAN4_BP_SEAT_MRVent_Sta}, {implementation-record-element=CAN4_BP_SEAT_MLVent_Sta, system-signal=CAN4_BP_SEAT_MLVent_Sta}, {implementation-record-element=CAN4_BP_SEAT_LVent_Sta, system-signal=CAN4_BP_SEAT_LVent_Sta}, {implementation-record-element=CAN4_BP_Door_RHandleHalf_Sta, system-signal=CAN4_BP_Door_RHandleHalf_Sta}, {implementation-record-element=CAN4_BP_Door_RHandleClose_Sta, system-signal=CAN4_BP_Door_RHandleClose_Sta}, {implementation-record-element=CAN4_BP_Door_FHandleHalf_Sta, system-signal=CAN4_BP_Door_FHandleHalf_Sta}, {implementation-record-element=CAN4_BP_Door_FHandleClose_Sta, system-signal=CAN4_BP_Door_FHandleClose_Sta}, {implementation-record-element=CAN4_BP_APM_WinROpened_Sta, system-signal=CAN4_BP_APM_WinROpened_Sta}]}
      MAP_HALIN_R_CAN4_DKC1: sender-receiver-to-signal-group-mapping{communication-direction=IN, data-element=SWC_HALIN.root_FDC.R_CAN4_DKC1.CAN4_SG_DKC1, signal-group=CAN4_SG_DKC1, type-mapping=sender-rec-record-type-mapping=record-element-mappings=[{implementation-record-element=CAN4_DKC_KeyNum_Sta, system-signal=CAN4_DKC_KeyNum_Sta}, {implementation-record-element=CAN4_P_UID_LowPower, system-signal=CAN4_P_UID_LowPower}, {implementation-record-element=CAN4_P_KeyMode, system-signal=CAN4_P_KeyMode}, {implementation-record-element=CAN4_P_KeyMiss, system-signal=CAN4_P_KeyMiss}, {implementation-record-element=CAN4_P_Dkey_Show_IVI, system-signal=CAN4_P_Dkey_Show_IVI}, {implementation-record-element=CAN4_P_DKey_Welcome, system-signal=CAN4_P_DKey_Welcome}, {implementation-record-element=CAN4_P_DKey_Area_PTG, system-signal=CAN4_P_DKey_Area_PTG}, {implementation-record-element=CAN4_P_DKey_Area_PS, system-signal=CAN4_P_DKey_Area_PS}, {implementation-record-element=CAN4_P_DKey_Area_LockUnlock, system-signal=CAN4_P_DKey_Area_LockUnlock}, {implementation-record-element=CAN4_P_CommandToPTG, system-signal=CAN4_P_CommandToPTG}, {implementation-record-element=CAN4_P_CommandToBCM, system-signal=CAN4_P_CommandToBCM}, {implementation-record-element=CAN4_DKC_Re_VehData, system-signal=CAN4_DKC_Re_VehData}, {implementation-record-element=CAN4_DKC_ParkingMode_Cmd, system-signal=CAN4_DKC_ParkingMode_Cmd}, {implementation-record-element=CAN4_DKC_P_UID_BatVolt, system-signal=CAN4_DKC_P_UID_BatVolt}, {implementation-record-element=CAN4_DKC_P_BLE_RSSI, system-signal=CAN4_DKC_P_BLE_RSSI}, {implementation-record-element=CAN4_DKC_PDkeyAreaRAPS_Sta, system-signal=CAN4_DKC_PDkeyAreaRAPS_Sta}, {implementation-record-element=CAN4_DKC_KeyType_Sta, system-signal=CAN4_DKC_KeyType_Sta}]}
      MAP_HALIN_R_CAN4_DKC2: sender-receiver-to-signal-group-mapping{communication-direction=IN, data-element=SWC_HALIN.root_FDC.R_CAN4_DKC2.CAN4_SG_DKC2, signal-group=CAN4_SG_DKC2, type-mapping=sender-rec-record-type-mapping=record-element-mappings=[{implementation-record-element=CAN4_EncryptionDATA_0_63, system-signal=CAN4_EncryptionDATA_0_63}, {implementation-record-element=CAN4_Random_Number_X, system-signal=CAN4_Random_Number_X}, {implementation-record-element=CAN4_EncryptionDATA_64_127, system-signal=CAN4_EncryptionDATA_64_127}]}
      MAP_HALIN_R_CAN4_PTG1: sender-receiver-to-signal-group-mapping{communication-direction=IN, data-element=SWC_HALIN.root_FDC.R_CAN4_PTG1.CAN4_SG_PTG1, signal-group=CAN4_SG_PTG1, type-mapping=sender-rec-record-type-mapping=record-element-mappings=[{implementation-record-element=CAN4_PTG_Active_Sta, system-signal=CAN4_PTG_Active_Sta}, {implementation-record-element=CAN4_PTG_Warning_Sta, system-signal=CAN4_PTG_Warning_Sta}, {implementation-record-element=CAN4_PTG_Sys_Sta, system-signal=CAN4_PTG_Sys_Sta}, {implementation-record-element=CAN4_PTG_Strut_Current, system-signal=CAN4_PTG_Strut_Current}, {implementation-record-element=CAN4_PTG_SW_Ver, system-signal=CAN4_PTG_SW_Ver}, {implementation-record-element=CAN4_PTG_RDIL_Sta, system-signal=CAN4_PTG_RDIL_Sta}, {implementation-record-element=CAN4_PTG_Open_Ratio, system-signal=CAN4_PTG_Open_Ratio}, {implementation-record-element=CAN4_PTG_Is_Set_Height, system-signal=CAN4_PTG_Is_Set_Height}, {implementation-record-element=CAN4_PTG_Inner_SW_2, system-signal=CAN4_PTG_Inner_SW_2}, {implementation-record-element=CAN4_PTG_Inner_SW_1, system-signal=CAN4_PTG_Inner_SW_1}, {implementation-record-element=CAN4_PTG_Half_Lock, system-signal=CAN4_PTG_Half_Lock}, {implementation-record-element=CAN4_PTG_HW_Ver, system-signal=CAN4_PTG_HW_Ver}, {implementation-record-element=CAN4_PTG_Full_Lock, system-signal=CAN4_PTG_Full_Lock}, {implementation-record-element=CAN4_PTG_Exist, system-signal=CAN4_PTG_Exist}, {implementation-record-element=CAN4_PTG_Cinch_Current, system-signal=CAN4_PTG_Cinch_Current}, {implementation-record-element=CAN4_PTG_AutoStaus, system-signal=CAN4_PTG_AutoStaus}]}
      MAP_HALIN_R_CAN4_ZONE_DR1: sender-receiver-to-signal-group-mapping{communication-direction=IN, data-element=SWC_HALIN.root_FDC.R_CAN4_ZONE_DR1.CAN4_SG_ZONE_DR1, signal-group=CAN4_SG_ZONE_DR1, type-mapping=sender-rec-record-type-mapping=record-element-mappings=[{implementation-record-element=CAN4_ACT1_Actuator_address, system-signal=CAN4_ACT1_Actuator_address}, {implementation-record-element=CAN4_ZDR_THCM_ModeFail_Sta, system-signal=CAN4_ZDR_THCM_ModeFail_Sta}, {implementation-record-element=CAN4_ZDR_THCM_LINACT5_Sta, system-signal=CAN4_ZDR_THCM_LINACT5_Sta}, {implementation-record-element=CAN4_ZDR_THCM_LINACT4_Sta, system-signal=CAN4_ZDR_THCM_LINACT4_Sta}, {implementation-record-element=CAN4_ZDR_THCM_LINACT3_Sta, system-signal=CAN4_ZDR_THCM_LINACT3_Sta}, {implementation-record-element=CAN4_ZDR_THCM_LINACT2_Sta, system-signal=CAN4_ZDR_THCM_LINACT2_Sta}, {implementation-record-element=CAN4_ZDR_THCM_LINACT1_Sta, system-signal=CAN4_ZDR_THCM_LINACT1_Sta}, {implementation-record-element=CAN4_ZDR_THCM_IntakeFail_Sta, system-signal=CAN4_ZDR_THCM_IntakeFail_Sta}, {implementation-record-element=CAN4_WiperZeroPosSW, system-signal=CAN4_WiperZeroPosSW}, {implementation-record-element=CAN4_WiperSWPos, system-signal=CAN4_WiperSWPos}, {implementation-record-element=CAN4_Wip_Speed, system-signal=CAN4_Wip_Speed}, {implementation-record-element=CAN4_RWiperProtection, system-signal=CAN4_RWiperProtection}, {implementation-record-element=CAN4_RWiperAS, system-signal=CAN4_RWiperAS}, {implementation-record-element=CAN4_RRTurnLampC, system-signal=CAN4_RRTurnLampC}, {implementation-record-element=CAN4_RRTurnLPErr, system-signal=CAN4_RRTurnLPErr}, {implementation-record-element=CAN4_RRLockSta, system-signal=CAN4_RRLockSta}, {implementation-record-element=CAN4_RLTurnLampC, system-signal=CAN4_RLTurnLampC}, {implementation-record-element=CAN4_RLTurnLPErr, system-signal=CAN4_RLTurnLPErr}, {implementation-record-element=CAN4_RLS_Exist, system-signal=CAN4_RLS_Exist}, {implementation-record-element=CAN4_RLLockSta, system-signal=CAN4_RLLockSta}, {implementation-record-element=CAN4_PsLockSta, system-signal=CAN4_PsLockSta}, {implementation-record-element=CAN4_MIRROR_FOLD_SW, system-signal=CAN4_MIRROR_FOLD_SW}, {implementation-record-element=CAN4_HornSW, system-signal=CAN4_HornSW}, {implementation-record-element=CAN4_DrLockSta, system-signal=CAN4_DrLockSta}, {implementation-record-element=CAN4_BrakeLampFail, system-signal=CAN4_BrakeLampFail}, {implementation-record-element=CAN4_AutoLightSW, system-signal=CAN4_AutoLightSW}, {implementation-record-element=CAN4_AllLockSta, system-signal=CAN4_AllLockSta}, {implementation-record-element=CAN4_ACT5_Stop_mode, system-signal=CAN4_ACT5_Stop_mode}, {implementation-record-element=CAN4_ACT5_Stall_detection_release, system-signal=CAN4_ACT5_Stall_detection_release}, {implementation-record-element=CAN4_ACT5_Speed_specification, system-signal=CAN4_ACT5_Speed_specification}, {implementation-record-element=CAN4_ACT5_Select_position_specification, system-signal=CAN4_ACT5_Select_position_specification}, {implementation-record-element=CAN4_ACT5_Save_programming_data, system-signal=CAN4_ACT5_Save_programming_data}, {implementation-record-element=CAN4_ACT5_Rotation_direction, system-signal=CAN4_ACT5_Rotation_direction}, {implementation-record-element=CAN4_ACT5_Emergency_run_release, system-signal=CAN4_ACT5_Emergency_run_release}, {implementation-record-element=CAN4_ACT5_Emergency_run_position, system-signal=CAN4_ACT5_Emergency_run_position}, {implementation-record-element=CAN4_ACT5_Clear_Event_Flags, system-signal=CAN4_ACT5_Clear_Event_Flags}, {implementation-record-element=CAN4_ACT5_Applied_holding_current, system-signal=CAN4_ACT5_Applied_holding_current}, {implementation-record-element=CAN4_ACT5_Actuator_start_position, system-signal=CAN4_ACT5_Actuator_start_position}, {implementation-record-element=CAN4_ACT5_Actuator_set_position, system-signal=CAN4_ACT5_Actuator_set_position}, {implementation-record-element=CAN4_ACT5_Actuator_address, system-signal=CAN4_ACT5_Actuator_address}, {implementation-record-element=CAN4_ACT4_Stop_mode, system-signal=CAN4_ACT4_Stop_mode}, {implementation-record-element=CAN4_ACT4_Stall_detection_release, system-signal=CAN4_ACT4_Stall_detection_release}, {implementation-record-element=CAN4_ACT4_Speed_specification, system-signal=CAN4_ACT4_Speed_specification}, {implementation-record-element=CAN4_ACT4_Select_position_specification, system-signal=CAN4_ACT4_Select_position_specification}, {implementation-record-element=CAN4_ACT4_Save_programming_data, system-signal=CAN4_ACT4_Save_programming_data}, {implementation-record-element=CAN4_ACT4_Rotation_direction, system-signal=CAN4_ACT4_Rotation_direction}, {implementation-record-element=CAN4_ACT4_Emergency_run_release, system-signal=CAN4_ACT4_Emergency_run_release}, {implementation-record-element=CAN4_ACT4_Emergency_run_position, system-signal=CAN4_ACT4_Emergency_run_position}, {implementation-record-element=CAN4_ACT4_Clear_Event_Flags, system-signal=CAN4_ACT4_Clear_Event_Flags}, {implementation-record-element=CAN4_ACT4_Applied_holding_current, system-signal=CAN4_ACT4_Applied_holding_current}, {implementation-record-element=CAN4_ACT4_Actuator_start_position, system-signal=CAN4_ACT4_Actuator_start_position}, {implementation-record-element=CAN4_ACT4_Actuator_set_position, system-signal=CAN4_ACT4_Actuator_set_position}, {implementation-record-element=CAN4_ACT4_Actuator_address, system-signal=CAN4_ACT4_Actuator_address}, {implementation-record-element=CAN4_ACT3_Stop_mode, system-signal=CAN4_ACT3_Stop_mode}, {implementation-record-element=CAN4_ACT3_Stall_detection_release, system-signal=CAN4_ACT3_Stall_detection_release}, {implementation-record-element=CAN4_ACT3_Speed_specification, system-signal=CAN4_ACT3_Speed_specification}, {implementation-record-element=CAN4_ACT3_Select_position_specification, system-signal=CAN4_ACT3_Select_position_specification}, {implementation-record-element=CAN4_ACT3_Save_programming_data, system-signal=CAN4_ACT3_Save_programming_data}, {implementation-record-element=CAN4_ACT3_Rotation_direction, system-signal=CAN4_ACT3_Rotation_direction}, {implementation-record-element=CAN4_ACT3_Emergency_run_release, system-signal=CAN4_ACT3_Emergency_run_release}, {implementation-record-element=CAN4_ACT3_Emergency_run_position, system-signal=CAN4_ACT3_Emergency_run_position}, {implementation-record-element=CAN4_ACT3_Clear_Event_Flags, system-signal=CAN4_ACT3_Clear_Event_Flags}, {implementation-record-element=CAN4_ACT3_Applied_holding_current, system-signal=CAN4_ACT3_Applied_holding_current}, {implementation-record-element=CAN4_ACT3_Actuator_start_position, system-signal=CAN4_ACT3_Actuator_start_position}, {implementation-record-element=CAN4_ACT3_Actuator_set_position, system-signal=CAN4_ACT3_Actuator_set_position}, {implementation-record-element=CAN4_ACT3_Actuator_address, system-signal=CAN4_ACT3_Actuator_address}, {implementation-record-element=CAN4_ACT2_Stop_mode, system-signal=CAN4_ACT2_Stop_mode}, {implementation-record-element=CAN4_ACT2_Stall_detection_release, system-signal=CAN4_ACT2_Stall_detection_release}, {implementation-record-element=CAN4_ACT2_Speed_specification, system-signal=CAN4_ACT2_Speed_specification}, {implementation-record-element=CAN4_ACT2_Select_position_specification, system-signal=CAN4_ACT2_Select_position_specification}, {implementation-record-element=CAN4_ACT2_Save_programming_data, system-signal=CAN4_ACT2_Save_programming_data}, {implementation-record-element=CAN4_ACT2_Rotation_direction, system-signal=CAN4_ACT2_Rotation_direction}, {implementation-record-element=CAN4_ACT2_Emergency_run_release, system-signal=CAN4_ACT2_Emergency_run_release}, {implementation-record-element=CAN4_ACT2_Emergency_run_position, system-signal=CAN4_ACT2_Emergency_run_position}, {implementation-record-element=CAN4_ACT2_Clear_Event_Flags, system-signal=CAN4_ACT2_Clear_Event_Flags}, {implementation-record-element=CAN4_ACT2_Applied_holding_current, system-signal=CAN4_ACT2_Applied_holding_current}, {implementation-record-element=CAN4_ACT2_Actuator_start_position, system-signal=CAN4_ACT2_Actuator_start_position}, {implementation-record-element=CAN4_ACT2_Actuator_set_position, system-signal=CAN4_ACT2_Actuator_set_position}, {implementation-record-element=CAN4_ACT2_Actuator_address, system-signal=CAN4_ACT2_Actuator_address}, {implementation-record-element=CAN4_ACT1_Stop_mode, system-signal=CAN4_ACT1_Stop_mode}, {implementation-record-element=CAN4_ACT1_Stall_detection_release, system-signal=CAN4_ACT1_Stall_detection_release}, {implementation-record-element=CAN4_ACT1_Speed_specification, system-signal=CAN4_ACT1_Speed_specification}, {implementation-record-element=CAN4_ACT1_Select_position_specification, system-signal=CAN4_ACT1_Select_position_specification}, {implementation-record-element=CAN4_ACT1_Save_programming_data, system-signal=CAN4_ACT1_Save_programming_data}, {implementation-record-element=CAN4_ACT1_Rotation_direction, system-signal=CAN4_ACT1_Rotation_direction}, {implementation-record-element=CAN4_ACT1_Emergency_run_release, system-signal=CAN4_ACT1_Emergency_run_release}, {implementation-record-element=CAN4_ACT1_Emergency_run_position, system-signal=CAN4_ACT1_Emergency_run_position}, {implementation-record-element=CAN4_ACT1_Clear_Event_Flags, system-signal=CAN4_ACT1_Clear_Event_Flags}, {implementation-record-element=CAN4_ACT1_Applied_holding_current, system-signal=CAN4_ACT1_Applied_holding_current}, {implementation-record-element=CAN4_ACT1_Actuator_start_position, system-signal=CAN4_ACT1_Actuator_start_position}, {implementation-record-element=CAN4_ACT1_Actuator_set_position, system-signal=CAN4_ACT1_Actuator_set_position}]}
      MAP_HALIN_R_CAN4_ZONE_DR_VCU: sender-receiver-to-signal-group-mapping{communication-direction=IN, data-element=SWC_HALIN.root_FDC.R_CAN4_ZONE_DR_VCU.CAN4_SG_ZONE_DR_VCU, signal-group=CAN4_SG_ZONE_DR_VCU, type-mapping=sender-rec-record-type-mapping=record-element-mappings=[{implementation-record-element=CAN4_APTC_Err, system-signal=CAN4_APTC_Err}, {implementation-record-element=CAN4_ZoneDrMalfunLevel, system-signal=CAN4_ZoneDrMalfunLevel}, {implementation-record-element=CAN4_ZDR_VCU_PwrSupply_Sta, system-signal=CAN4_ZDR_VCU_PwrSupply_Sta}, {implementation-record-element=CAN4_ZDR_VCU_HWReset_Sta, system-signal=CAN4_ZDR_VCU_HWReset_Sta}, {implementation-record-element=CAN4_ZDR_VCU_AlcoDet_Sta, system-signal=CAN4_ZDR_VCU_AlcoDet_Sta}, {implementation-record-element=CAN4_ZDR_SYS_HWMismatchFW_Sta, system-signal=CAN4_ZDR_SYS_HWMismatchFW_Sta}, {implementation-record-element=CAN4_ZDR_SYS_CSWRetryCnt_Sta, system-signal=CAN4_ZDR_SYS_CSWRetryCnt_Sta}, {implementation-record-element=CAN4_ZDR_SYS_BSWSleepReq_Sta, system-signal=CAN4_ZDR_SYS_BSWSleepReq_Sta}, {implementation-record-element=CAN4_ZDR_SYS_APMRetryCnt_Sta, system-signal=CAN4_ZDR_SYS_APMRetryCnt_Sta}, {implementation-record-element=CAN4_Tincar_Err, system-signal=CAN4_Tincar_Err}, {implementation-record-element=CAN4_Tincar, system-signal=CAN4_Tincar}, {implementation-record-element=CAN4_Tevap_Err, system-signal=CAN4_Tevap_Err}, {implementation-record-element=CAN4_Tevap, system-signal=CAN4_Tevap}, {implementation-record-element=CAN4_T_Foot_Rr_Err, system-signal=CAN4_T_Foot_Rr_Err}, {implementation-record-element=CAN4_T_Foot_Rr, system-signal=CAN4_T_Foot_Rr}, {implementation-record-element=CAN4_T_Foot_R_Err, system-signal=CAN4_T_Foot_R_Err}, {implementation-record-element=CAN4_T_Foot_R, system-signal=CAN4_T_Foot_R}, {implementation-record-element=CAN4_T_Foot_L_Err, system-signal=CAN4_T_Foot_L_Err}, {implementation-record-element=CAN4_T_Foot_L, system-signal=CAN4_T_Foot_L}, {implementation-record-element=CAN4_T_Face_Rr_Err, system-signal=CAN4_T_Face_Rr_Err}, {implementation-record-element=CAN4_T_Face_Rr, system-signal=CAN4_T_Face_Rr}, {implementation-record-element=CAN4_T_Face_R_Err, system-signal=CAN4_T_Face_R_Err}, {implementation-record-element=CAN4_T_Face_R, system-signal=CAN4_T_Face_R}, {implementation-record-element=CAN4_T_Face_L_Err, system-signal=CAN4_T_Face_L_Err}, {implementation-record-element=CAN4_T_Face_L, system-signal=CAN4_T_Face_L}, {implementation-record-element=CAN4_SolarR_Err, system-signal=CAN4_SolarR_Err}, {implementation-record-element=CAN4_SolarR, system-signal=CAN4_SolarR}, {implementation-record-element=CAN4_SolarL_Err, system-signal=CAN4_SolarL_Err}, {implementation-record-element=CAN4_SolarL, system-signal=CAN4_SolarL}, {implementation-record-element=CAN4_RegenSW_Err, system-signal=CAN4_RegenSW_Err}, {implementation-record-element=CAN4_LeftHall_Pos, system-signal=CAN4_LeftHall_Pos}, {implementation-record-element=CAN4_DrTHCMFault, system-signal=CAN4_DrTHCMFault}, {implementation-record-element=CAN4_DrStdAErrSta, system-signal=CAN4_DrStdAErrSta}, {implementation-record-element=CAN4_DrSCPSysErrLmp, system-signal=CAN4_DrSCPSysErrLmp}, {implementation-record-element=CAN4_DrPwrWindowECUFault, system-signal=CAN4_DrPwrWindowECUFault}, {implementation-record-element=CAN4_DrPwrWinErrSta, system-signal=CAN4_DrPwrWinErrSta}, {implementation-record-element=CAN4_DrPwrSta, system-signal=CAN4_DrPwrSta}, {implementation-record-element=CAN4_DrPwrInformationSta, system-signal=CAN4_DrPwrInformationSta}, {implementation-record-element=CAN4_DrPMMSysErrLmp, system-signal=CAN4_DrPMMSysErrLmp}, {implementation-record-element=CAN4_DrPMMLimpHomeActReq, system-signal=CAN4_DrPMMLimpHomeActReq}, {implementation-record-element=CAN4_DrPMMLVOutPErrLmp, system-signal=CAN4_DrPMMLVOutPErrLmp}, {implementation-record-element=CAN4_DrONA1ErrSta, system-signal=CAN4_DrONA1ErrSta}, {implementation-record-element=CAN4_DrInfoFault, system-signal=CAN4_DrInfoFault}, {implementation-record-element=CAN4_DrInfoErrSta, system-signal=CAN4_DrInfoErrSta}, {implementation-record-element=CAN4_DrIVIFault, system-signal=CAN4_DrIVIFault}, {implementation-record-element=CAN4_DrEOBDFault, system-signal=CAN4_DrEOBDFault}, {implementation-record-element=CAN4_DrColumnSWFault, system-signal=CAN4_DrColumnSWFault}, {implementation-record-element=CAN4_DrAPWStaErr, system-signal=CAN4_DrAPWStaErr}, {implementation-record-element=CAN4_DrAPWLINErr, system-signal=CAN4_DrAPWLINErr}, {implementation-record-element=CAN4_Blower_FB, system-signal=CAN4_Blower_FB}, {implementation-record-element=CAN4_Blower_Err, system-signal=CAN4_Blower_Err}]}
      MAP_HALIN_R_CAN4_ZONE_FR1: sender-receiver-to-signal-group-mapping{communication-direction=IN, data-element=SWC_HALIN.root_FDC.R_CAN4_ZONE_FR1.CAN4_SG_ZONE_FR1, signal-group=CAN4_SG_ZONE_FR1, type-mapping=sender-rec-record-type-mapping=record-element-mappings=[{implementation-record-element=CAN4_AGS_Calibration_Enabled, system-signal=CAN4_AGS_Calibration_Enabled}, {implementation-record-element=CAN4_ZFR_THCM_REVentActZ_Sta, system-signal=CAN4_ZFR_THCM_REVentActZ_Sta}, {implementation-record-element=CAN4_ZFR_THCM_REVentActY_Sta, system-signal=CAN4_ZFR_THCM_REVentActY_Sta}, {implementation-record-element=CAN4_ZFR_THCM_LEVentActZ_Sta, system-signal=CAN4_ZFR_THCM_LEVentActZ_Sta}, {implementation-record-element=CAN4_ZFR_THCM_LEVentActY_Sta, system-signal=CAN4_ZFR_THCM_LEVentActY_Sta}, {implementation-record-element=CAN4_ZFR_THCM_EACV8Stallpos_Sta, system-signal=CAN4_ZFR_THCM_EACV8Stallpos_Sta}, {implementation-record-element=CAN4_ZFR_THCM_EACV7Stallpos_Sta, system-signal=CAN4_ZFR_THCM_EACV7Stallpos_Sta}, {implementation-record-element=CAN4_ZFR_THCM_EACV6Stallpos_Sta, system-signal=CAN4_ZFR_THCM_EACV6Stallpos_Sta}, {implementation-record-element=CAN4_ZFR_THCM_EACV5Stallpos_Sta, system-signal=CAN4_ZFR_THCM_EACV5Stallpos_Sta}, {implementation-record-element=CAN4_ZFR_THCM_EACV4Stallpos_Sta, system-signal=CAN4_ZFR_THCM_EACV4Stallpos_Sta}, {implementation-record-element=CAN4_ZFR_THCM_EACV3Stallpos_Sta, system-signal=CAN4_ZFR_THCM_EACV3Stallpos_Sta}, {implementation-record-element=CAN4_ZFR_THCM_EACV2Stallpos_Sta, system-signal=CAN4_ZFR_THCM_EACV2Stallpos_Sta}, {implementation-record-element=CAN4_ZFR_THCM_EACV1Stallpos_Sta, system-signal=CAN4_ZFR_THCM_EACV1Stallpos_Sta}, {implementation-record-element=CAN4_ZFR_THCM_CREVentActZ_Sta, system-signal=CAN4_ZFR_THCM_CREVentActZ_Sta}, {implementation-record-element=CAN4_ZFR_THCM_CREVentActY_Sta, system-signal=CAN4_ZFR_THCM_CREVentActY_Sta}, {implementation-record-element=CAN4_ZFR_THCM_CLEVentActZ_Sta, system-signal=CAN4_ZFR_THCM_CLEVentActZ_Sta}, {implementation-record-element=CAN4_ZFR_THCM_CLEVentActY_Sta, system-signal=CAN4_ZFR_THCM_CLEVentActY_Sta}, {implementation-record-element=CAN4_ZFR_SYS_HWMismatchFW_Sta, system-signal=CAN4_ZFR_SYS_HWMismatchFW_Sta}, {implementation-record-element=CAN4_ZFR_EChrg_WashMode_Sta, system-signal=CAN4_ZFR_EChrg_WashMode_Sta}, {implementation-record-element=CAN4_ZFR_EChrg_Sys_Sta, system-signal=CAN4_ZFR_EChrg_Sys_Sta}, {implementation-record-element=CAN4_ZFR_EChrg_OperationDeny_Cmd, system-signal=CAN4_ZFR_EChrg_OperationDeny_Cmd}, {implementation-record-element=CAN4_ZFR_EChrg_Active_Sta, system-signal=CAN4_ZFR_EChrg_Active_Sta}, {implementation-record-element=CAN4_ZFR_BCM_HRRTurnLPHNormal_Sta, system-signal=CAN4_ZFR_BCM_HRRTurnLPHNormal_Sta}, {implementation-record-element=CAN4_ZFR_BCM_HRLTurnLPNormal_Sta, system-signal=CAN4_ZFR_BCM_HRLTurnLPNormal_Sta}, {implementation-record-element=CAN4_ZFR_BCM_ChargerDoorSW_Sta, system-signal=CAN4_ZFR_BCM_ChargerDoorSW_Sta}, {implementation-record-element=CAN4_TrailerModeSta, system-signal=CAN4_TrailerModeSta}, {implementation-record-element=CAN4_TrailerCheck, system-signal=CAN4_TrailerCheck}, {implementation-record-element=CAN4_Rposition_Lamp_Warning, system-signal=CAN4_Rposition_Lamp_Warning}, {implementation-record-element=CAN4_RL_BeamErr, system-signal=CAN4_RL_BeamErr}, {implementation-record-element=CAN4_RLB_Warning, system-signal=CAN4_RLB_Warning}, {implementation-record-element=CAN4_RH_BeamErr, system-signal=CAN4_RH_BeamErr}, {implementation-record-element=CAN4_RDRL_Warning, system-signal=CAN4_RDRL_Warning}, {implementation-record-element=CAN4_RDRLErr, system-signal=CAN4_RDRLErr}, {implementation-record-element=CAN4_RAHB_Warning, system-signal=CAN4_RAHB_Warning}, {implementation-record-element=CAN4_RADB_Warning, system-signal=CAN4_RADB_Warning}, {implementation-record-element=CAN4_RADB_Operation_Status, system-signal=CAN4_RADB_Operation_Status}, {implementation-record-element=CAN4_RADB_Hibeam_Indication, system-signal=CAN4_RADB_Hibeam_Indication}, {implementation-record-element=CAN4_RADBErr, system-signal=CAN4_RADBErr}, {implementation-record-element=CAN4_Lposition_Lamp_Warning, system-signal=CAN4_Lposition_Lamp_Warning}, {implementation-record-element=CAN4_LL_BeamErr, system-signal=CAN4_LL_BeamErr}, {implementation-record-element=CAN4_LLB_Warning, system-signal=CAN4_LLB_Warning}, {implementation-record-element=CAN4_LH_BeamErr, system-signal=CAN4_LH_BeamErr}, {implementation-record-element=CAN4_LDRL_Warning, system-signal=CAN4_LDRL_Warning}, {implementation-record-element=CAN4_LDRLErr, system-signal=CAN4_LDRLErr}, {implementation-record-element=CAN4_LAHB_Warning, system-signal=CAN4_LAHB_Warning}, {implementation-record-element=CAN4_LADB_Warning, system-signal=CAN4_LADB_Warning}, {implementation-record-element=CAN4_LADB_Operation_Status, system-signal=CAN4_LADB_Operation_Status}, {implementation-record-element=CAN4_LADB_Hibeam_Indication, system-signal=CAN4_LADB_Hibeam_Indication}, {implementation-record-element=CAN4_LADBErr, system-signal=CAN4_LADBErr}, {implementation-record-element=CAN4_FWiperProtection, system-signal=CAN4_FWiperProtection}, {implementation-record-element=CAN4_FWiperAS, system-signal=CAN4_FWiperAS}, {implementation-record-element=CAN4_FRTurn_Light_Warning, system-signal=CAN4_FRTurn_Light_Warning}, {implementation-record-element=CAN4_FRTurnLampC, system-signal=CAN4_FRTurnLampC}, {implementation-record-element=CAN4_FRTurnLPErr, system-signal=CAN4_FRTurnLPErr}, {implementation-record-element=CAN4_FRPosLPErr, system-signal=CAN4_FRPosLPErr}, {implementation-record-element=CAN4_FLTurn_Light_Warning, system-signal=CAN4_FLTurn_Light_Warning}, {implementation-record-element=CAN4_FLTurnLampC, system-signal=CAN4_FLTurnLampC}, {implementation-record-element=CAN4_FLTurnLPErr, system-signal=CAN4_FLTurnLPErr}, {implementation-record-element=CAN4_FLPosLPErr, system-signal=CAN4_FLPosLPErr}, {implementation-record-element=CAN4_EXV_Cmd_Set_Rq, system-signal=CAN4_EXV_Cmd_Set_Rq}, {implementation-record-element=CAN4_EXV_Cmd_Move_Enbl, system-signal=CAN4_EXV_Cmd_Move_Enbl}, {implementation-record-element=CAN4_EXV_Cmd_Init_Rq, system-signal=CAN4_EXV_Cmd_Init_Rq}, {implementation-record-element=CAN4_EXV2_Cmd_Set_Rq, system-signal=CAN4_EXV2_Cmd_Set_Rq}, {implementation-record-element=CAN4_EXV2_Cmd_Move_Enbl, system-signal=CAN4_EXV2_Cmd_Move_Enbl}, {implementation-record-element=CAN4_EXV2_Cmd_Init_Rq, system-signal=CAN4_EXV2_Cmd_Init_Rq}, {implementation-record-element=CAN4_EWP3_RPM_Target_EWP_Rq, system-signal=CAN4_EWP3_RPM_Target_EWP_Rq}, {implementation-record-element=CAN4_EWP3_Default_Operation_EWP_Rq, system-signal=CAN4_EWP3_Default_Operation_EWP_Rq}, {implementation-record-element=CAN4_EWP2_RPM_Target_EWP_Rq, system-signal=CAN4_EWP2_RPM_Target_EWP_Rq}, {implementation-record-element=CAN4_EWP2_Default_Operation_EWP_Rq, system-signal=CAN4_EWP2_Default_Operation_EWP_Rq}, {implementation-record-element=CAN4_EWP1_RPM_Target_EWP_Rq, system-signal=CAN4_EWP1_RPM_Target_EWP_Rq}, {implementation-record-element=CAN4_EWP1_Default_Operation_EWP_Rq, system-signal=CAN4_EWP1_Default_Operation_EWP_Rq}, {implementation-record-element=CAN4_CompProEN, system-signal=CAN4_CompProEN}, {implementation-record-element=CAN4_ChargeInletLockSta, system-signal=CAN4_ChargeInletLockSta}, {implementation-record-element=CAN4_CCV4_ReqMovePos, system-signal=CAN4_CCV4_ReqMovePos}, {implementation-record-element=CAN4_CCV4_MoveEnable, system-signal=CAN4_CCV4_MoveEnable}, {implementation-record-element=CAN4_CCM_SpdCmd, system-signal=CAN4_CCM_SpdCmd}, {implementation-record-element=CAN4_BMSReqTapPosHSC6, system-signal=CAN4_BMSReqTapPosHSC6}, {implementation-record-element=CAN4_BMSReqRlngCtrHSC6, system-signal=CAN4_BMSReqRlngCtrHSC6}, {implementation-record-element=CAN4_BMSReqPwrHSC6, system-signal=CAN4_BMSReqPwrHSC6}, {implementation-record-element=CAN4_BMSReqPWMHSC6, system-signal=CAN4_BMSReqPWMHSC6}, {implementation-record-element=CAN4_BMSReqMdHSC6, system-signal=CAN4_BMSReqMdHSC6}, {implementation-record-element=CAN4_BMSPackVol_h6HSC6, system-signal=CAN4_BMSPackVol_h6HSC6}, {implementation-record-element=CAN4_BMSInptClntTemHSC6, system-signal=CAN4_BMSInptClntTemHSC6}, {implementation-record-element=CAN4_BMSEnbPTCHSC6, system-signal=CAN4_BMSEnbPTCHSC6}, {implementation-record-element=CAN4_BMSChksmHSC6, system-signal=CAN4_BMSChksmHSC6}, {implementation-record-element=CAN4_BDC_1_ReqMovePos, system-signal=CAN4_BDC_1_ReqMovePos}, {implementation-record-element=CAN4_BDC_1_MoveEnable, system-signal=CAN4_BDC_1_MoveEnable}, {implementation-record-element=CAN4_AGS_Position_Request, system-signal=CAN4_AGS_Position_Request}]}
      MAP_HALIN_R_CAN4_ZONE_FR_VCU: sender-receiver-to-signal-group-mapping{communication-direction=IN, data-element=SWC_HALIN.root_FDC.R_CAN4_ZONE_FR_VCU.CAN4_SG_ZONE_FR_VCU, signal-group=CAN4_SG_ZONE_FR_VCU, type-mapping=sender-rec-record-type-mapping=record-element-mappings=[{implementation-record-element=CAN4_AGS_Err, system-signal=CAN4_AGS_Err}, {implementation-record-element=CAN4_ZoneFrMalfunLevel, system-signal=CAN4_ZoneFrMalfunLevel}, {implementation-record-element=CAN4_ZFR_VCU_PwrSupply_Sta, system-signal=CAN4_ZFR_VCU_PwrSupply_Sta}, {implementation-record-element=CAN4_ZFR_VCU_HWReset_Sta, system-signal=CAN4_ZFR_VCU_HWReset_Sta}, {implementation-record-element=CAN4_ZFR_SYS_MCURetryCnt_Sta, system-signal=CAN4_ZFR_SYS_MCURetryCnt_Sta}, {implementation-record-element=CAN4_ZFR_SYS_BSWSleepReq_Sta, system-signal=CAN4_ZFR_SYS_BSWSleepReq_Sta}, {implementation-record-element=CAN4_ZFR_SYS_BMSCCURetryCnt_Sta, system-signal=CAN4_ZFR_SYS_BMSCCURetryCnt_Sta}, {implementation-record-element=CAN4_WPTC_Err, system-signal=CAN4_WPTC_Err}, {implementation-record-element=CAN4_Tamb_Err, system-signal=CAN4_Tamb_Err}, {implementation-record-element=CAN4_Tamb, system-signal=CAN4_Tamb}, {implementation-record-element=CAN4_TWV_Err, system-signal=CAN4_TWV_Err}, {implementation-record-element=CAN4_SOV3_Err, system-signal=CAN4_SOV3_Err}, {implementation-record-element=CAN4_SOV2_Err, system-signal=CAN4_SOV2_Err}, {implementation-record-element=CAN4_SOV1_Err, system-signal=CAN4_SOV1_Err}, {implementation-record-element=CAN4_SOTXV_Err, system-signal=CAN4_SOTXV_Err}, {implementation-record-element=CAN4_PT_Low_T2_Err, system-signal=CAN4_PT_Low_T2_Err}, {implementation-record-element=CAN4_PT_Low_T2, system-signal=CAN4_PT_Low_T2}, {implementation-record-element=CAN4_PT_Low_T1_Err, system-signal=CAN4_PT_Low_T1_Err}, {implementation-record-element=CAN4_PT_Low_T1, system-signal=CAN4_PT_Low_T1}, {implementation-record-element=CAN4_PT_Low_P2_Err, system-signal=CAN4_PT_Low_P2_Err}, {implementation-record-element=CAN4_PT_Low_P2, system-signal=CAN4_PT_Low_P2}, {implementation-record-element=CAN4_PT_Low_P1_Err, system-signal=CAN4_PT_Low_P1_Err}, {implementation-record-element=CAN4_PT_Low_P1, system-signal=CAN4_PT_Low_P1}, {implementation-record-element=CAN4_PT_High_Tact_Err, system-signal=CAN4_PT_High_Tact_Err}, {implementation-record-element=CAN4_PT_High_Tact, system-signal=CAN4_PT_High_Tact}, {implementation-record-element=CAN4_PT_High_T, system-signal=CAN4_PT_High_T}, {implementation-record-element=CAN4_PT_High_P_Err, system-signal=CAN4_PT_High_P_Err}, {implementation-record-element=CAN4_PT_High_P, system-signal=CAN4_PT_High_P}, {implementation-record-element=CAN4_Motor_Out_Temp_Err, system-signal=CAN4_Motor_Out_Temp_Err}, {implementation-record-element=CAN4_Motor_Out_Temp, system-signal=CAN4_Motor_Out_Temp}, {implementation-record-element=CAN4_Motor_In_Temp_Err, system-signal=CAN4_Motor_In_Temp_Err}, {implementation-record-element=CAN4_Motor_In_Temp, system-signal=CAN4_Motor_In_Temp}, {implementation-record-element=CAN4_FrStdA2PErr, system-signal=CAN4_FrStdA2PErr}, {implementation-record-element=CAN4_FrStdA2PCErr, system-signal=CAN4_FrStdA2PCErr}, {implementation-record-element=CAN4_FrStdA1PCErr, system-signal=CAN4_FrStdA1PCErr}, {implementation-record-element=CAN4_FrPwrStdbyA2PlusFault, system-signal=CAN4_FrPwrStdbyA2PlusFault}, {implementation-record-element=CAN4_FrPwrStdbyA1PlusFault, system-signal=CAN4_FrPwrStdbyA1PlusFault}, {implementation-record-element=CAN4_FrPwrStdbyA1Fault, system-signal=CAN4_FrPwrStdbyA1Fault}, {implementation-record-element=CAN4_FrPwrSta, system-signal=CAN4_FrPwrSta}, {implementation-record-element=CAN4_FrPwrONA1Fault, system-signal=CAN4_FrPwrONA1Fault}, {implementation-record-element=CAN4_FrPMMSysErrLmp, system-signal=CAN4_FrPMMSysErrLmp}, {implementation-record-element=CAN4_FrPMMLimpHomeActReq, system-signal=CAN4_FrPMMLimpHomeActReq}, {implementation-record-element=CAN4_FrPMMLVOutPErrLmp, system-signal=CAN4_FrPMMLVOutPErrLmp}, {implementation-record-element=CAN4_FrEDU_INVERTERFault, system-signal=CAN4_FrEDU_INVERTERFault}, {implementation-record-element=CAN4_FrEDUErr, system-signal=CAN4_FrEDUErr}, {implementation-record-element=CAN4_FrBMS_CCU_CIRFault, system-signal=CAN4_FrBMS_CCU_CIRFault}, {implementation-record-element=CAN4_FrBMSCCUCErr, system-signal=CAN4_FrBMSCCUCErr}, {implementation-record-element=CAN4_Fan_Err, system-signal=CAN4_Fan_Err}, {implementation-record-element=CAN4_FWV_Err, system-signal=CAN4_FWV_Err}, {implementation-record-element=CAN4_EXV2_Err, system-signal=CAN4_EXV2_Err}, {implementation-record-element=CAN4_EXV1_Err, system-signal=CAN4_EXV1_Err}, {implementation-record-element=CAN4_EWP3_Err, system-signal=CAN4_EWP3_Err}, {implementation-record-element=CAN4_EWP2_Err, system-signal=CAN4_EWP2_Err}, {implementation-record-element=CAN4_EWP1_Err, system-signal=CAN4_EWP1_Err}, {implementation-record-element=CAN4_EACProtectEnable, system-signal=CAN4_EACProtectEnable}, {implementation-record-element=CAN4_COMP_Err, system-signal=CAN4_COMP_Err}, {implementation-record-element=CAN4_Bat_Out_Temp_Err, system-signal=CAN4_Bat_Out_Temp_Err}, {implementation-record-element=CAN4_Bat_Out_Temp, system-signal=CAN4_Bat_Out_Temp}, {implementation-record-element=CAN4_Bat_In_Temp_Err, system-signal=CAN4_Bat_In_Temp_Err}, {implementation-record-element=CAN4_Bat_In_Temp, system-signal=CAN4_Bat_In_Temp}]}
      MAP_HALIN_R_CAN4_zGW_APTC1: sender-receiver-to-signal-group-mapping{communication-direction=IN, data-element=SWC_HALIN.root_FDC.R_CAN4_zGW_APTC1.CAN4_SG_zGW_APTC1, signal-group=CAN4_SG_zGW_APTC1, type-mapping=sender-rec-record-type-mapping=record-element-mappings=[{implementation-record-element=CAN4_FrntPTCBusLineHiV, system-signal=CAN4_FrntPTCBusLineHiV}, {implementation-record-element=CAN4_FrntPTCSupplierCod, system-signal=CAN4_FrntPTCSupplierCod}, {implementation-record-element=CAN4_FrntPTCSts, system-signal=CAN4_FrntPTCSts}, {implementation-record-element=CAN4_FrntPTCSWVers, system-signal=CAN4_FrntPTCSWVers}, {implementation-record-element=CAN4_FrntPTCRiOverAFlt, system-signal=CAN4_FrntPTCRiOverAFlt}, {implementation-record-element=CAN4_FrntPTCRiOpentCircFlt, system-signal=CAN4_FrntPTCRiOpentCircFlt}, {implementation-record-element=CAN4_FrntPTCRiIGBTTSnsrFlt, system-signal=CAN4_FrntPTCRiIGBTTSnsrFlt}, {implementation-record-element=CAN4_FrntPTCRiIGBTT, system-signal=CAN4_FrntPTCRiIGBTT}, {implementation-record-element=CAN4_FrntPTCRiIGBTShoCircFlt, system-signal=CAN4_FrntPTCRiIGBTShoCircFlt}, {implementation-record-element=CAN4_FrntPTCRiIGBTOverTFlt, system-signal=CAN4_FrntPTCRiIGBTOverTFlt}, {implementation-record-element=CAN4_FrntPTCRiCoreTSnsrFlt, system-signal=CAN4_FrntPTCRiCoreTSnsrFlt}, {implementation-record-element=CAN4_FrntPTCRiCoreT, system-signal=CAN4_FrntPTCRiCoreT}, {implementation-record-element=CAN4_FrntPTCRiCoreOverTFlt, system-signal=CAN4_FrntPTCRiCoreOverTFlt}, {implementation-record-element=CAN4_FrntPTCRiBusLineC, system-signal=CAN4_FrntPTCRiBusLineC}, {implementation-record-element=CAN4_FrntPTCRiActHeatPwr, system-signal=CAN4_FrntPTCRiActHeatPwr}, {implementation-record-element=CAN4_FrntPTCRearRiOverAFlt, system-signal=CAN4_FrntPTCRearRiOverAFlt}, {implementation-record-element=CAN4_FrntPTCRearRiOpentCircFlt, system-signal=CAN4_FrntPTCRearRiOpentCircFlt}, {implementation-record-element=CAN4_FrntPTCRearRiIGBTShoCFlt, system-signal=CAN4_FrntPTCRearRiIGBTShoCFlt}, {implementation-record-element=CAN4_FrntPTCRearRiCoreTSnsrFlt, system-signal=CAN4_FrntPTCRearRiCoreTSnsrFlt}, {implementation-record-element=CAN4_FrntPTCRearRiCoreT, system-signal=CAN4_FrntPTCRearRiCoreT}, {implementation-record-element=CAN4_FrntPTCRearRiCoreOverTFlt, system-signal=CAN4_FrntPTCRearRiCoreOverTFlt}, {implementation-record-element=CAN4_FrntPTCRearRiBusLineC, system-signal=CAN4_FrntPTCRearRiBusLineC}, {implementation-record-element=CAN4_FrntPTCRearRiActHeatPwr, system-signal=CAN4_FrntPTCRearRiActHeatPwr}, {implementation-record-element=CAN4_FrntPTCRearLeOverAFlt, system-signal=CAN4_FrntPTCRearLeOverAFlt}, {implementation-record-element=CAN4_FrntPTCRearLeOpentCircFlt, system-signal=CAN4_FrntPTCRearLeOpentCircFlt}, {implementation-record-element=CAN4_FrntPTCRearLeIGBTShoCFlt, system-signal=CAN4_FrntPTCRearLeIGBTShoCFlt}, {implementation-record-element=CAN4_FrntPTCRearLeCoreTSnsrFlt, system-signal=CAN4_FrntPTCRearLeCoreTSnsrFlt}, {implementation-record-element=CAN4_FrntPTCRearLeCoreT, system-signal=CAN4_FrntPTCRearLeCoreT}, {implementation-record-element=CAN4_FrntPTCRearLeCoreOverTFlt, system-signal=CAN4_FrntPTCRearLeCoreOverTFlt}, {implementation-record-element=CAN4_FrntPTCRearLeBusLineC, system-signal=CAN4_FrntPTCRearLeBusLineC}, {implementation-record-element=CAN4_FrntPTCRearLeActHeatPwr, system-signal=CAN4_FrntPTCRearLeActHeatPwr}, {implementation-record-element=CAN4_FrntPTCPCBTSnsrFlt, system-signal=CAN4_FrntPTCPCBTSnsrFlt}, {implementation-record-element=CAN4_FrntPTCPCBT, system-signal=CAN4_FrntPTCPCBT}, {implementation-record-element=CAN4_FrntPTCPCBOverTFlt, system-signal=CAN4_FrntPTCPCBOverTFlt}, {implementation-record-element=CAN4_FrntPTCLeOverAFlt, system-signal=CAN4_FrntPTCLeOverAFlt}, {implementation-record-element=CAN4_FrntPTCLeOpentCircFlt, system-signal=CAN4_FrntPTCLeOpentCircFlt}, {implementation-record-element=CAN4_FrntPTCLeIGBTTSnsrFlt, system-signal=CAN4_FrntPTCLeIGBTTSnsrFlt}, {implementation-record-element=CAN4_FrntPTCLeIGBTT, system-signal=CAN4_FrntPTCLeIGBTT}, {implementation-record-element=CAN4_FrntPTCLeIGBTShoCircFlt, system-signal=CAN4_FrntPTCLeIGBTShoCircFlt}, {implementation-record-element=CAN4_FrntPTCLeIGBTOverTFlt, system-signal=CAN4_FrntPTCLeIGBTOverTFlt}, {implementation-record-element=CAN4_FrntPTCLeCoreTSnsrFlt, system-signal=CAN4_FrntPTCLeCoreTSnsrFlt}, {implementation-record-element=CAN4_FrntPTCLeCoreT, system-signal=CAN4_FrntPTCLeCoreT}, {implementation-record-element=CAN4_FrntPTCLeCoreOverTFlt, system-signal=CAN4_FrntPTCLeCoreOverTFlt}, {implementation-record-element=CAN4_FrntPTCLeBusLineC, system-signal=CAN4_FrntPTCLeBusLineC}, {implementation-record-element=CAN4_FrntPTCLeActHeatPwr, system-signal=CAN4_FrntPTCLeActHeatPwr}, {implementation-record-element=CAN4_FrntPTCLVUnderUFlt, system-signal=CAN4_FrntPTCLVUnderUFlt}, {implementation-record-element=CAN4_FrntPTCLVOverUFlt, system-signal=CAN4_FrntPTCLVOverUFlt}, {implementation-record-element=CAN4_FrntPTCHWVers, system-signal=CAN4_FrntPTCHWVers}, {implementation-record-element=CAN4_FrntPTCHVUnderUFlt, system-signal=CAN4_FrntPTCHVUnderUFlt}, {implementation-record-element=CAN4_FrntPTCHVOverUFlt, system-signal=CAN4_FrntPTCHVOverUFlt}, {implementation-record-element=CAN4_FrntPTCFltSt, system-signal=CAN4_FrntPTCFltSt}, {implementation-record-element=CAN4_FrntPTCComFlt, system-signal=CAN4_FrntPTCComFlt}]}
      MAP_HALIN_R_CAN4_zGW_CANFr1: sender-receiver-to-signal-group-mapping{communication-direction=IN, data-element=SWC_HALIN.root_FDC.R_CAN4_zGW_CANFr1.CAN4_SG_zGW_CANFr1, signal-group=CAN4_SG_zGW_CANFr1, type-mapping=sender-rec-record-type-mapping=record-element-mappings=[{implementation-record-element=CAN4_COMP_ActualPwr, system-signal=CAN4_COMP_ActualPwr}, {implementation-record-element=CAN4_PTC1_WrkngSts, system-signal=CAN4_PTC1_WrkngSts}, {implementation-record-element=CAN4_PTC1_VbatVtgUnstable, system-signal=CAN4_PTC1_VbatVtgUnstable}, {implementation-record-element=CAN4_PTC1_VbatVtgSnsrFlt, system-signal=CAN4_PTC1_VbatVtgSnsrFlt}, {implementation-record-element=CAN4_PTC1_VbatVtgProtn, system-signal=CAN4_PTC1_VbatVtgProtn}, {implementation-record-element=CAN4_PTC1_PowerConsumption, system-signal=CAN4_PTC1_PowerConsumption}, {implementation-record-element=CAN4_PTC1_PCBTempSnsrFlt, system-signal=CAN4_PTC1_PCBTempSnsrFlt}, {implementation-record-element=CAN4_PTC1_PCBOverTempProtn, system-signal=CAN4_PTC1_PCBOverTempProtn}, {implementation-record-element=CAN4_PTC1_MmryFlt, system-signal=CAN4_PTC1_MmryFlt}, {implementation-record-element=CAN4_PTC1_IGBTTemSnsrFlt, system-signal=CAN4_PTC1_IGBTTemSnsrFlt}, {implementation-record-element=CAN4_PTC1_IGBTTem, system-signal=CAN4_PTC1_IGBTTem}, {implementation-record-element=CAN4_PTC1_IGBTShrtErr, system-signal=CAN4_PTC1_IGBTShrtErr}, {implementation-record-element=CAN4_PTC1_IGBTOverTemProtn, system-signal=CAN4_PTC1_IGBTOverTemProtn}, {implementation-record-element=CAN4_PTC1_HiCrntSnsrFlt, system-signal=CAN4_PTC1_HiCrntSnsrFlt}, {implementation-record-element=CAN4_PTC1_HVOverCrntProtn, system-signal=CAN4_PTC1_HVOverCrntProtn}, {implementation-record-element=CAN4_PTC1_HVDisconnectProtn, system-signal=CAN4_PTC1_HVDisconnectProtn}, {implementation-record-element=CAN4_PTC1_CoreOrIGBTOpenErr, system-signal=CAN4_PTC1_CoreOrIGBTOpenErr}, {implementation-record-element=CAN4_PTC1_CommError, system-signal=CAN4_PTC1_CommError}, {implementation-record-element=CAN4_PTC1_ClntTempOtlt, system-signal=CAN4_PTC1_ClntTempOtlt}, {implementation-record-element=CAN4_PTC1_ClntTempInlt, system-signal=CAN4_PTC1_ClntTempInlt}, {implementation-record-element=CAN4_PTC1_ClntOtltTemSnsrFlt, system-signal=CAN4_PTC1_ClntOtltTemSnsrFlt}, {implementation-record-element=CAN4_PTC1_ClntOtltOverTemProtn, system-signal=CAN4_PTC1_ClntOtltOverTemProtn}, {implementation-record-element=CAN4_PTC1_ClntInltTemSnsrFlt, system-signal=CAN4_PTC1_ClntInltTemSnsrFlt}, {implementation-record-element=CAN4_PTC1_ClntInltOverTemProtn, system-signal=CAN4_PTC1_ClntInltOverTemProtn}, {implementation-record-element=CAN4_PTC1_ActuHiCrnt, system-signal=CAN4_PTC1_ActuHiCrnt}, {implementation-record-element=CAN4_EAC_TempSnsrFalt, system-signal=CAN4_EAC_TempSnsrFalt}, {implementation-record-element=CAN4_EAC_Temp, system-signal=CAN4_EAC_Temp}, {implementation-record-element=CAN4_EAC_OvLoadFalt, system-signal=CAN4_EAC_OvLoadFalt}, {implementation-record-element=CAN4_EAC_MotorLackFalt, system-signal=CAN4_EAC_MotorLackFalt}, {implementation-record-element=CAN4_EAC_MotCrt, system-signal=CAN4_EAC_MotCrt}, {implementation-record-element=CAN4_EAC_DrvVoltFalt, system-signal=CAN4_EAC_DrvVoltFalt}, {implementation-record-element=CAN4_COMP_VoltVaild, system-signal=CAN4_COMP_VoltVaild}, {implementation-record-element=CAN4_COMP_VoltOverErr, system-signal=CAN4_COMP_VoltOverErr}, {implementation-record-element=CAN4_COMP_VoltLessErr, system-signal=CAN4_COMP_VoltLessErr}, {implementation-record-element=CAN4_COMP_StatorSpd, system-signal=CAN4_COMP_StatorSpd}, {implementation-record-element=CAN4_COMP_Sta, system-signal=CAN4_COMP_Sta}, {implementation-record-element=CAN4_COMP_SpdVaild, system-signal=CAN4_COMP_SpdVaild}, {implementation-record-element=CAN4_COMP_Init, system-signal=CAN4_COMP_Init}, {implementation-record-element=CAN4_COMP_IPM_TempOverFlt, system-signal=CAN4_COMP_IPM_TempOverFlt}, {implementation-record-element=CAN4_COMP_IPM_HWFLt, system-signal=CAN4_COMP_IPM_HWFLt}, {implementation-record-element=CAN4_COMP_CurVaild, system-signal=CAN4_COMP_CurVaild}, {implementation-record-element=CAN4_COMP_CurOverProtect, system-signal=CAN4_COMP_CurOverProtect}, {implementation-record-element=CAN4_COMP_CtrlCircFlt, system-signal=CAN4_COMP_CtrlCircFlt}, {implementation-record-element=CAN4_COMP_ConVolt, system-signal=CAN4_COMP_ConVolt}, {implementation-record-element=CAN4_COMP_ConCur, system-signal=CAN4_COMP_ConCur}, {implementation-record-element=CAN4_COMP_ComLost, system-signal=CAN4_COMP_ComLost}]}
      MAP_HALIN_R_CAN4_zGW_LINDr1: sender-receiver-to-signal-group-mapping{communication-direction=IN, data-element=SWC_HALIN.root_FDC.R_CAN4_zGW_LINDr1.CAN4_SG_zGW_LINDr1, signal-group=CAN4_SG_zGW_LINDr1, type-mapping=sender-rec-record-type-mapping=record-element-mappings=[{implementation-record-element=CAN4_CSW_DimSw, system-signal=CAN4_CSW_DimSw}, {implementation-record-element=CAN4_SWC_resp_error, system-signal=CAN4_SWC_resp_error}, {implementation-record-element=CAN4_SWC_mode_Sta, system-signal=CAN4_SWC_mode_Sta}, {implementation-record-element=CAN4_SWC_VR_Sta, system-signal=CAN4_SWC_VR_Sta}, {implementation-record-element=CAN4_SWC_Up_Sta, system-signal=CAN4_SWC_Up_Sta}, {implementation-record-element=CAN4_SWC_Undefined_Sta, system-signal=CAN4_SWC_Undefined_Sta}, {implementation-record-element=CAN4_SWC_Trip_Sta, system-signal=CAN4_SWC_Trip_Sta}, {implementation-record-element=CAN4_SWC_Set_down_Sta, system-signal=CAN4_SWC_Set_down_Sta}, {implementation-record-element=CAN4_SWC_Right_Sta, system-signal=CAN4_SWC_Right_Sta}, {implementation-record-element=CAN4_SWC_Res_Up_Sta, system-signal=CAN4_SWC_Res_Up_Sta}, {implementation-record-element=CAN4_SWC_RegenUp, system-signal=CAN4_SWC_RegenUp}, {implementation-record-element=CAN4_SWC_RegenDown, system-signal=CAN4_SWC_RegenDown}, {implementation-record-element=CAN4_SWC_Left_Sta, system-signal=CAN4_SWC_Left_Sta}, {implementation-record-element=CAN4_SWC_LKA_Sta, system-signal=CAN4_SWC_LKA_Sta}, {implementation-record-element=CAN4_SWC_Drivemode_Sta, system-signal=CAN4_SWC_Drivemode_Sta}, {implementation-record-element=CAN4_SWC_Down_Sta, system-signal=CAN4_SWC_Down_Sta}, {implementation-record-element=CAN4_SWC_Distance_Sta, system-signal=CAN4_SWC_Distance_Sta}, {implementation-record-element=CAN4_SWC_CANCEL_Sta, system-signal=CAN4_SWC_CANCEL_Sta}, {implementation-record-element=CAN4_SWC_A_Resp_Err, system-signal=CAN4_SWC_A_Resp_Err}, {implementation-record-element=CAN4_SWC_ACC_Sta, system-signal=CAN4_SWC_ACC_Sta}, {implementation-record-element=CAN4_SWC2_ResponseError, system-signal=CAN4_SWC2_ResponseError}, {implementation-record-element=CAN4_SWC2_R_VR_Sta, system-signal=CAN4_SWC2_R_VR_Sta}, {implementation-record-element=CAN4_SWC2_R_ScrollUp_Sta, system-signal=CAN4_SWC2_R_ScrollUp_Sta}, {implementation-record-element=CAN4_SWC2_R_ScrollPress_Sta, system-signal=CAN4_SWC2_R_ScrollPress_Sta}, {implementation-record-element=CAN4_SWC2_R_ScrollDown_Sta, system-signal=CAN4_SWC2_R_ScrollDown_Sta}, {implementation-record-element=CAN4_SWC2_R_Right_Sta, system-signal=CAN4_SWC2_R_Right_Sta}, {implementation-record-element=CAN4_SWC2_R_RegenDown_Sta, system-signal=CAN4_SWC2_R_RegenDown_Sta}, {implementation-record-element=CAN4_SWC2_R_PageSwitch_Sta, system-signal=CAN4_SWC2_R_PageSwitch_Sta}, {implementation-record-element=CAN4_SWC2_R_Left_Sta, system-signal=CAN4_SWC2_R_Left_Sta}, {implementation-record-element=CAN4_SWC2_R_Customize_Sta, system-signal=CAN4_SWC2_R_Customize_Sta}, {implementation-record-element=CAN4_SWC2_L_ScrollUp_Sta, system-signal=CAN4_SWC2_L_ScrollUp_Sta}, {implementation-record-element=CAN4_SWC2_L_ScrollPress_Sta, system-signal=CAN4_SWC2_L_ScrollPress_Sta}, {implementation-record-element=CAN4_SWC2_L_ScrollDown_Sta, system-signal=CAN4_SWC2_L_ScrollDown_Sta}, {implementation-record-element=CAN4_SWC2_L_Right_Sta, system-signal=CAN4_SWC2_L_Right_Sta}, {implementation-record-element=CAN4_SWC2_L_RegenUp_Sta, system-signal=CAN4_SWC2_L_RegenUp_Sta}, {implementation-record-element=CAN4_SWC2_L_Left_Sta, system-signal=CAN4_SWC2_L_Left_Sta}, {implementation-record-element=CAN4_SWC2_L_Home_Sta, system-signal=CAN4_SWC2_L_Home_Sta}, {implementation-record-element=CAN4_SWC2_L_DriveMode_Sta, system-signal=CAN4_SWC2_L_DriveMode_Sta}, {implementation-record-element=CAN4_SWC2_L_ADAS_Sta, system-signal=CAN4_SWC2_L_ADAS_Sta}, {implementation-record-element=CAN4_RLS_RainSnrWiperCmd, system-signal=CAN4_RLS_RainSnrWiperCmd}, {implementation-record-element=CAN4_RLS_RainSnrErr, system-signal=CAN4_RLS_RainSnrErr}, {implementation-record-element=CAN4_RLS_LightSnrErr, system-signal=CAN4_RLS_LightSnrErr}, {implementation-record-element=CAN4_RLS_Lamp_Sta, system-signal=CAN4_RLS_Lamp_Sta}, {implementation-record-element=CAN4_RLS_LIN_Resp_Err, system-signal=CAN4_RLS_LIN_Resp_Err}, {implementation-record-element=CAN4_RAPWL_01_LIN_Response_Error, system-signal=CAN4_RAPWL_01_LIN_Response_Error}, {implementation-record-element=CAN4_L_RRD_Wdw_Running_Sts, system-signal=CAN4_L_RRD_Wdw_Running_Sts}, {implementation-record-element=CAN4_L_RRD_Wdw_PositionSts, system-signal=CAN4_L_RRD_Wdw_PositionSts}, {implementation-record-element=CAN4_L_RRD_Wdw_Obs_InhibitSts, system-signal=CAN4_L_RRD_Wdw_Obs_InhibitSts}, {implementation-record-element=CAN4_L_RRD_Wdw_OD_Sts, system-signal=CAN4_L_RRD_Wdw_OD_Sts}, {implementation-record-element=CAN4_L_RRD_Wdw_LocalSwitch, system-signal=CAN4_L_RRD_Wdw_LocalSwitch}, {implementation-record-element=CAN4_L_RRD_Wdw_Init, system-signal=CAN4_L_RRD_Wdw_Init}, {implementation-record-element=CAN4_L_RRD_Val_Wdw_Opened, system-signal=CAN4_L_RRD_Val_Wdw_Opened}, {implementation-record-element=CAN4_L_RRD_OverHeat_Protect, system-signal=CAN4_L_RRD_OverHeat_Protect}, {implementation-record-element=CAN4_L_RRD_Motor_Ripple_Error, system-signal=CAN4_L_RRD_Motor_Ripple_Error}, {implementation-record-element=CAN4_L_RRD_Motor_Relay_Error, system-signal=CAN4_L_RRD_Motor_Relay_Error}, {implementation-record-element=CAN4_L_RLD_Wdw_Running_Sts, system-signal=CAN4_L_RLD_Wdw_Running_Sts}, {implementation-record-element=CAN4_L_RLD_Wdw_PositionSts, system-signal=CAN4_L_RLD_Wdw_PositionSts}, {implementation-record-element=CAN4_L_RLD_Wdw_Obs_InhibitSts, system-signal=CAN4_L_RLD_Wdw_Obs_InhibitSts}, {implementation-record-element=CAN4_L_RLD_Wdw_OD_Sts, system-signal=CAN4_L_RLD_Wdw_OD_Sts}, {implementation-record-element=CAN4_L_RLD_Wdw_LocalSwitch, system-signal=CAN4_L_RLD_Wdw_LocalSwitch}, {implementation-record-element=CAN4_L_RLD_Wdw_Init, system-signal=CAN4_L_RLD_Wdw_Init}, {implementation-record-element=CAN4_L_RLD_Val_Wdw_Opened, system-signal=CAN4_L_RLD_Val_Wdw_Opened}, {implementation-record-element=CAN4_L_RLD_OverHeat_Protect, system-signal=CAN4_L_RLD_OverHeat_Protect}, {implementation-record-element=CAN4_L_RLD_Motor_Ripple_Error, system-signal=CAN4_L_RLD_Motor_Ripple_Error}, {implementation-record-element=CAN4_L_RLD_Motor_Relay_Error, system-signal=CAN4_L_RLD_Motor_Relay_Error}, {implementation-record-element=CAN4_L_Power_Status, system-signal=CAN4_L_Power_Status}, {implementation-record-element=CAN4_L_Pas_Wdw_Running_Sts, system-signal=CAN4_L_Pas_Wdw_Running_Sts}, {implementation-record-element=CAN4_L_Pas_Wdw_PositionSts, system-signal=CAN4_L_Pas_Wdw_PositionSts}, {implementation-record-element=CAN4_L_Pas_Wdw_Obs_InhibitSts, system-signal=CAN4_L_Pas_Wdw_Obs_InhibitSts}, {implementation-record-element=CAN4_L_Pas_Wdw_OD_Sts, system-signal=CAN4_L_Pas_Wdw_OD_Sts}, {implementation-record-element=CAN4_L_Pas_Wdw_LocalSwitch, system-signal=CAN4_L_Pas_Wdw_LocalSwitch}, {implementation-record-element=CAN4_L_Pas_Wdw_Init, system-signal=CAN4_L_Pas_Wdw_Init}, {implementation-record-element=CAN4_L_Pas_Val_Wdw_Opened, system-signal=CAN4_L_Pas_Val_Wdw_Opened}, {implementation-record-element=CAN4_L_Pas_OverHeat_Protect, system-signal=CAN4_L_Pas_OverHeat_Protect}, {implementation-record-element=CAN4_L_Pas_Motor_Ripple_Error, system-signal=CAN4_L_Pas_Motor_Ripple_Error}, {implementation-record-element=CAN4_L_Pas_Motor_Relay_Error, system-signal=CAN4_L_Pas_Motor_Relay_Error}, {implementation-record-element=CAN4_L_Drv_Wdw_Running_Sts, system-signal=CAN4_L_Drv_Wdw_Running_Sts}, {implementation-record-element=CAN4_L_Drv_Wdw_RRD_Switch, system-signal=CAN4_L_Drv_Wdw_RRD_Switch}, {implementation-record-element=CAN4_L_Drv_Wdw_RLD_Switch, system-signal=CAN4_L_Drv_Wdw_RLD_Switch}, {implementation-record-element=CAN4_L_Drv_Wdw_PositionSts, system-signal=CAN4_L_Drv_Wdw_PositionSts}, {implementation-record-element=CAN4_L_Drv_Wdw_Pas_Switch, system-signal=CAN4_L_Drv_Wdw_Pas_Switch}, {implementation-record-element=CAN4_L_Drv_Wdw_Obs_InhibitSts, system-signal=CAN4_L_Drv_Wdw_Obs_InhibitSts}, {implementation-record-element=CAN4_L_Drv_Wdw_OD_Sts, system-signal=CAN4_L_Drv_Wdw_OD_Sts}, {implementation-record-element=CAN4_L_Drv_Wdw_LocalSwitch, system-signal=CAN4_L_Drv_Wdw_LocalSwitch}, {implementation-record-element=CAN4_L_Drv_Wdw_Init, system-signal=CAN4_L_Drv_Wdw_Init}, {implementation-record-element=CAN4_L_Drv_Val_Wdw_Opened, system-signal=CAN4_L_Drv_Val_Wdw_Opened}, {implementation-record-element=CAN4_L_Drv_OverHeat_Protect, system-signal=CAN4_L_Drv_OverHeat_Protect}, {implementation-record-element=CAN4_L_Drv_Motor_Ripple_Error, system-signal=CAN4_L_Drv_Motor_Ripple_Error}, {implementation-record-element=CAN4_L_Drv_Motor_Relay_Error, system-signal=CAN4_L_Drv_Motor_Relay_Error}, {implementation-record-element=CAN4_HVPO_OtltCvrStsRw_Sta, system-signal=CAN4_HVPO_OtltCvrStsRw_Sta}, {implementation-record-element=CAN4_FAPWL_01_LIN_Response_Error, system-signal=CAN4_FAPWL_01_LIN_Response_Error}, {implementation-record-element=CAN4_CSW_resp_error, system-signal=CAN4_CSW_resp_error}, {implementation-record-element=CAN4_CSW_TurnSw_Sta, system-signal=CAN4_CSW_TurnSw_Sta}, {implementation-record-element=CAN4_CSW_RWipIntSw_Sta, system-signal=CAN4_CSW_RWipIntSw_Sta}, {implementation-record-element=CAN4_CSW_RWasSW_Sta, system-signal=CAN4_CSW_RWasSW_Sta}, {implementation-record-element=CAN4_CSW_PassSW_Sta, system-signal=CAN4_CSW_PassSW_Sta}, {implementation-record-element=CAN4_CSW_FWipSw_Sta, system-signal=CAN4_CSW_FWipSw_Sta}, {implementation-record-element=CAN4_CSW_FWasSw_Sta, system-signal=CAN4_CSW_FWasSw_Sta}]}
      MAP_HALIN_R_CAN4_zGW_LINDr2: sender-receiver-to-signal-group-mapping{communication-direction=IN, data-element=SWC_HALIN.root_FDC.R_CAN4_zGW_LINDr2.CAN4_SG_zGW_LINDr2, signal-group=CAN4_SG_zGW_LINDr2, type-mapping=sender-rec-record-type-mapping=record-element-mappings=[{implementation-record-element=CAN4_ACT1_Actual_position_of_actuator, system-signal=CAN4_ACT1_Actual_position_of_actuator}, {implementation-record-element=CAN4_ACT5_Supply_voltage, system-signal=CAN4_ACT5_Supply_voltage}, {implementation-record-element=CAN4_ACT5_Stop_mode_status, system-signal=CAN4_ACT5_Stop_mode_status}, {implementation-record-element=CAN4_ACT5_Stall_occurred, system-signal=CAN4_ACT5_Stall_occurred}, {implementation-record-element=CAN4_ACT5_Stall_detection_release_status, system-signal=CAN4_ACT5_Stall_detection_release_status}, {implementation-record-element=CAN4_ACT5_Speed_status, system-signal=CAN4_ACT5_Speed_status}, {implementation-record-element=CAN4_ACT5_Special_functions, system-signal=CAN4_ACT5_Special_functions}, {implementation-record-element=CAN4_ACT5_Self_holding_torque, system-signal=CAN4_ACT5_Self_holding_torque}, {implementation-record-element=CAN4_ACT5_Rotation_direction_status, system-signal=CAN4_ACT5_Rotation_direction_status}, {implementation-record-element=CAN4_ACT5_Response_Error, system-signal=CAN4_ACT5_Response_Error}, {implementation-record-element=CAN4_ACT5_Reset, system-signal=CAN4_ACT5_Reset}, {implementation-record-element=CAN4_ACT5_Position_specification_status, system-signal=CAN4_ACT5_Position_specification_status}, {implementation-record-element=CAN4_ACT5_Over_temperature, system-signal=CAN4_ACT5_Over_temperature}, {implementation-record-element=CAN4_ACT5_Movement_direction, system-signal=CAN4_ACT5_Movement_direction}, {implementation-record-element=CAN4_ACT5_Emergency_run_release_status, system-signal=CAN4_ACT5_Emergency_run_release_status}, {implementation-record-element=CAN4_ACT5_Emergency_run_position_status, system-signal=CAN4_ACT5_Emergency_run_position_status}, {implementation-record-element=CAN4_ACT5_Emergency_run_occurred, system-signal=CAN4_ACT5_Emergency_run_occurred}, {implementation-record-element=CAN4_ACT5_Electrical_defect, system-signal=CAN4_ACT5_Electrical_defect}, {implementation-record-element=CAN4_ACT5_Applied_holding_current_status, system-signal=CAN4_ACT5_Applied_holding_current_status}, {implementation-record-element=CAN4_ACT5_Actuator_address_status, system-signal=CAN4_ACT5_Actuator_address_status}, {implementation-record-element=CAN4_ACT5_Actual_position_of_actuator, system-signal=CAN4_ACT5_Actual_position_of_actuator}, {implementation-record-element=CAN4_ACT4_Supply_voltage, system-signal=CAN4_ACT4_Supply_voltage}, {implementation-record-element=CAN4_ACT4_Stop_mode_status, system-signal=CAN4_ACT4_Stop_mode_status}, {implementation-record-element=CAN4_ACT4_Stall_occurred, system-signal=CAN4_ACT4_Stall_occurred}, {implementation-record-element=CAN4_ACT4_Stall_detection_release_status, system-signal=CAN4_ACT4_Stall_detection_release_status}, {implementation-record-element=CAN4_ACT4_Speed_status, system-signal=CAN4_ACT4_Speed_status}, {implementation-record-element=CAN4_ACT4_Special_functions, system-signal=CAN4_ACT4_Special_functions}, {implementation-record-element=CAN4_ACT4_Self_holding_torque, system-signal=CAN4_ACT4_Self_holding_torque}, {implementation-record-element=CAN4_ACT4_Rotation_direction_status, system-signal=CAN4_ACT4_Rotation_direction_status}, {implementation-record-element=CAN4_ACT4_Response_Error, system-signal=CAN4_ACT4_Response_Error}, {implementation-record-element=CAN4_ACT4_Reset, system-signal=CAN4_ACT4_Reset}, {implementation-record-element=CAN4_ACT4_Position_specification_status, system-signal=CAN4_ACT4_Position_specification_status}, {implementation-record-element=CAN4_ACT4_Over_temperature, system-signal=CAN4_ACT4_Over_temperature}, {implementation-record-element=CAN4_ACT4_Movement_direction, system-signal=CAN4_ACT4_Movement_direction}, {implementation-record-element=CAN4_ACT4_Emergency_run_release_status, system-signal=CAN4_ACT4_Emergency_run_release_status}, {implementation-record-element=CAN4_ACT4_Emergency_run_position_status, system-signal=CAN4_ACT4_Emergency_run_position_status}, {implementation-record-element=CAN4_ACT4_Emergency_run_occurred, system-signal=CAN4_ACT4_Emergency_run_occurred}, {implementation-record-element=CAN4_ACT4_Electrical_defect, system-signal=CAN4_ACT4_Electrical_defect}, {implementation-record-element=CAN4_ACT4_Applied_holding_current_status, system-signal=CAN4_ACT4_Applied_holding_current_status}, {implementation-record-element=CAN4_ACT4_Actuator_address_status, system-signal=CAN4_ACT4_Actuator_address_status}, {implementation-record-element=CAN4_ACT4_Actual_position_of_actuator, system-signal=CAN4_ACT4_Actual_position_of_actuator}, {implementation-record-element=CAN4_ACT3_Supply_voltage, system-signal=CAN4_ACT3_Supply_voltage}, {implementation-record-element=CAN4_ACT3_Stop_mode_status, system-signal=CAN4_ACT3_Stop_mode_status}, {implementation-record-element=CAN4_ACT3_Stall_occurred, system-signal=CAN4_ACT3_Stall_occurred}, {implementation-record-element=CAN4_ACT3_Stall_detection_release_status, system-signal=CAN4_ACT3_Stall_detection_release_status}, {implementation-record-element=CAN4_ACT3_Speed_status, system-signal=CAN4_ACT3_Speed_status}, {implementation-record-element=CAN4_ACT3_Special_functions, system-signal=CAN4_ACT3_Special_functions}, {implementation-record-element=CAN4_ACT3_Self_holding_torque, system-signal=CAN4_ACT3_Self_holding_torque}, {implementation-record-element=CAN4_ACT3_Rotation_direction_status, system-signal=CAN4_ACT3_Rotation_direction_status}, {implementation-record-element=CAN4_ACT3_Response_Error, system-signal=CAN4_ACT3_Response_Error}, {implementation-record-element=CAN4_ACT3_Reset, system-signal=CAN4_ACT3_Reset}, {implementation-record-element=CAN4_ACT3_Position_specification_status, system-signal=CAN4_ACT3_Position_specification_status}, {implementation-record-element=CAN4_ACT3_Over_temperature, system-signal=CAN4_ACT3_Over_temperature}, {implementation-record-element=CAN4_ACT3_Movement_direction, system-signal=CAN4_ACT3_Movement_direction}, {implementation-record-element=CAN4_ACT3_Emergency_run_release_status, system-signal=CAN4_ACT3_Emergency_run_release_status}, {implementation-record-element=CAN4_ACT3_Emergency_run_position_status, system-signal=CAN4_ACT3_Emergency_run_position_status}, {implementation-record-element=CAN4_ACT3_Emergency_run_occurred, system-signal=CAN4_ACT3_Emergency_run_occurred}, {implementation-record-element=CAN4_ACT3_Electrical_defect, system-signal=CAN4_ACT3_Electrical_defect}, {implementation-record-element=CAN4_ACT3_Applied_holding_current_status, system-signal=CAN4_ACT3_Applied_holding_current_status}, {implementation-record-element=CAN4_ACT3_Actuator_address_status, system-signal=CAN4_ACT3_Actuator_address_status}, {implementation-record-element=CAN4_ACT3_Actual_position_of_actuator, system-signal=CAN4_ACT3_Actual_position_of_actuator}, {implementation-record-element=CAN4_ACT2_Supply_voltage, system-signal=CAN4_ACT2_Supply_voltage}, {implementation-record-element=CAN4_ACT2_Stop_mode_status, system-signal=CAN4_ACT2_Stop_mode_status}, {implementation-record-element=CAN4_ACT2_Stall_occurred, system-signal=CAN4_ACT2_Stall_occurred}, {implementation-record-element=CAN4_ACT2_Stall_detection_release_status, system-signal=CAN4_ACT2_Stall_detection_release_status}, {implementation-record-element=CAN4_ACT2_Speed_status, system-signal=CAN4_ACT2_Speed_status}, {implementation-record-element=CAN4_ACT2_Special_functions, system-signal=CAN4_ACT2_Special_functions}, {implementation-record-element=CAN4_ACT2_Self_holding_torque, system-signal=CAN4_ACT2_Self_holding_torque}, {implementation-record-element=CAN4_ACT2_Rotation_direction_status, system-signal=CAN4_ACT2_Rotation_direction_status}, {implementation-record-element=CAN4_ACT2_Response_Error, system-signal=CAN4_ACT2_Response_Error}, {implementation-record-element=CAN4_ACT2_Reset, system-signal=CAN4_ACT2_Reset}, {implementation-record-element=CAN4_ACT2_Position_specification_status, system-signal=CAN4_ACT2_Position_specification_status}, {implementation-record-element=CAN4_ACT2_Over_temperature, system-signal=CAN4_ACT2_Over_temperature}, {implementation-record-element=CAN4_ACT2_Movement_direction, system-signal=CAN4_ACT2_Movement_direction}, {implementation-record-element=CAN4_ACT2_Emergency_run_release_status, system-signal=CAN4_ACT2_Emergency_run_release_status}, {implementation-record-element=CAN4_ACT2_Emergency_run_position_status, system-signal=CAN4_ACT2_Emergency_run_position_status}, {implementation-record-element=CAN4_ACT2_Emergency_run_occurred, system-signal=CAN4_ACT2_Emergency_run_occurred}, {implementation-record-element=CAN4_ACT2_Electrical_defect, system-signal=CAN4_ACT2_Electrical_defect}, {implementation-record-element=CAN4_ACT2_Applied_holding_current_status, system-signal=CAN4_ACT2_Applied_holding_current_status}, {implementation-record-element=CAN4_ACT2_Actuator_address_status, system-signal=CAN4_ACT2_Actuator_address_status}, {implementation-record-element=CAN4_ACT2_Actual_position_of_actuator, system-signal=CAN4_ACT2_Actual_position_of_actuator}, {implementation-record-element=CAN4_ACT1_Supply_voltage, system-signal=CAN4_ACT1_Supply_voltage}, {implementation-record-element=CAN4_ACT1_Stop_mode_status, system-signal=CAN4_ACT1_Stop_mode_status}, {implementation-record-element=CAN4_ACT1_Stall_occurred, system-signal=CAN4_ACT1_Stall_occurred}, {implementation-record-element=CAN4_ACT1_Stall_detection_release_status, system-signal=CAN4_ACT1_Stall_detection_release_status}, {implementation-record-element=CAN4_ACT1_Speed_status, system-signal=CAN4_ACT1_Speed_status}, {implementation-record-element=CAN4_ACT1_Special_functions, system-signal=CAN4_ACT1_Special_functions}, {implementation-record-element=CAN4_ACT1_Self_holding_torque, system-signal=CAN4_ACT1_Self_holding_torque}, {implementation-record-element=CAN4_ACT1_Rotation_direction_status, system-signal=CAN4_ACT1_Rotation_direction_status}, {implementation-record-element=CAN4_ACT1_Response_Error, system-signal=CAN4_ACT1_Response_Error}, {implementation-record-element=CAN4_ACT1_Reset, system-signal=CAN4_ACT1_Reset}, {implementation-record-element=CAN4_ACT1_Position_specification_status, system-signal=CAN4_ACT1_Position_specification_status}, {implementation-record-element=CAN4_ACT1_Over_temperature, system-signal=CAN4_ACT1_Over_temperature}, {implementation-record-element=CAN4_ACT1_Movement_direction, system-signal=CAN4_ACT1_Movement_direction}, {implementation-record-element=CAN4_ACT1_Emergency_run_release_status, system-signal=CAN4_ACT1_Emergency_run_release_status}, {implementation-record-element=CAN4_ACT1_Emergency_run_position_status, system-signal=CAN4_ACT1_Emergency_run_position_status}, {implementation-record-element=CAN4_ACT1_Emergency_run_occurred, system-signal=CAN4_ACT1_Emergency_run_occurred}, {implementation-record-element=CAN4_ACT1_Electrical_defect, system-signal=CAN4_ACT1_Electrical_defect}, {implementation-record-element=CAN4_ACT1_Applied_holding_current_status, system-signal=CAN4_ACT1_Applied_holding_current_status}, {implementation-record-element=CAN4_ACT1_Actuator_address_status, system-signal=CAN4_ACT1_Actuator_address_status}]}
      MAP_HALIN_R_CAN4_zGW_LINFr1: sender-receiver-to-signal-group-mapping{communication-direction=IN, data-element=SWC_HALIN.root_FDC.R_CAN4_zGW_LINFr1.CAN4_SG_zGW_LINFr1, signal-group=CAN4_SG_zGW_LINFr1, type-mapping=sender-rec-record-type-mapping=record-element-mappings=[{implementation-record-element=CAN4_AGS_Actual_Position, system-signal=CAN4_AGS_Actual_Position}, {implementation-record-element=CAN4_ION_ION_Sta, system-signal=CAN4_ION_ION_Sta}, {implementation-record-element=CAN4_ION_IONRespErr_Sta, system-signal=CAN4_ION_IONRespErr_Sta}, {implementation-record-element=CAN4_ION_IONErr_Sta, system-signal=CAN4_ION_IONErr_Sta}, {implementation-record-element=CAN4_FGS_TypRsp_Sta, system-signal=CAN4_FGS_TypRsp_Sta}, {implementation-record-element=CAN4_FGS_StsRsp_Sta, system-signal=CAN4_FGS_StsRsp_Sta}, {implementation-record-element=CAN4_FGS_MotorErr_Sta, system-signal=CAN4_FGS_MotorErr_Sta}, {implementation-record-element=CAN4_FGS_LifeHole3_Sta, system-signal=CAN4_FGS_LifeHole3_Sta}, {implementation-record-element=CAN4_FGS_LifeHole2_Sta, system-signal=CAN4_FGS_LifeHole2_Sta}, {implementation-record-element=CAN4_FGS_LifeHole1_Sta, system-signal=CAN4_FGS_LifeHole1_Sta}, {implementation-record-element=CAN4_FGS_LINResponseErr_Sta, system-signal=CAN4_FGS_LINResponseErr_Sta}, {implementation-record-element=CAN4_FGS_IntenRsp_Sta, system-signal=CAN4_FGS_IntenRsp_Sta}, {implementation-record-element=CAN4_FGS_Channel_Type_Sta, system-signal=CAN4_FGS_Channel_Type_Sta}, {implementation-record-element=CAN4_FGS_Channel_Index_Sta, system-signal=CAN4_FGS_Channel_Index_Sta}, {implementation-record-element=CAN4_FGS_Channel3TypeRsp_Sta, system-signal=CAN4_FGS_Channel3TypeRsp_Sta}, {implementation-record-element=CAN4_FGS_Channel2TypeRsp_Sta, system-signal=CAN4_FGS_Channel2TypeRsp_Sta}, {implementation-record-element=CAN4_FGS_Channel1TypeRsp_Sta, system-signal=CAN4_FGS_Channel1TypeRsp_Sta}, {implementation-record-element=CAN4_FGS_BlowerErr_Sta, system-signal=CAN4_FGS_BlowerErr_Sta}, {implementation-record-element=CAN4_AGS_Temperature_Error, system-signal=CAN4_AGS_Temperature_Error}, {implementation-record-element=CAN4_AGS_Sensor_Error, system-signal=CAN4_AGS_Sensor_Error}, {implementation-record-element=CAN4_AGS_Low_Voltage_Error, system-signal=CAN4_AGS_Low_Voltage_Error}, {implementation-record-element=CAN4_AGS_LINResponse_Error, system-signal=CAN4_AGS_LINResponse_Error}, {implementation-record-element=CAN4_AGS_Electrical_Error, system-signal=CAN4_AGS_Electrical_Error}, {implementation-record-element=CAN4_AGS_Calibration_Indicated, system-signal=CAN4_AGS_Calibration_Indicated}, {implementation-record-element=CAN4_AGS_Calibration_Active, system-signal=CAN4_AGS_Calibration_Active}, {implementation-record-element=CAN4_AGS_Actuator_Fault, system-signal=CAN4_AGS_Actuator_Fault}, {implementation-record-element=CAN4_AGS_Actuator_Blocked, system-signal=CAN4_AGS_Actuator_Blocked}]}
      MAP_HALIN_R_CAN4_zGW_LINFr2: sender-receiver-to-signal-group-mapping{communication-direction=IN, data-element=SWC_HALIN.root_FDC.R_CAN4_zGW_LINFr2.CAN4_SG_zGW_LINFr2, signal-group=CAN4_SG_zGW_LINFr2, type-mapping=sender-rec-record-type-mapping=record-element-mappings=[{implementation-record-element=CAN4_BDC_1_Fault_Signal, system-signal=CAN4_BDC_1_Fault_Signal}, {implementation-record-element=CAN4_EXV_Rsp_Volt_Stat, system-signal=CAN4_EXV_Rsp_Volt_Stat}, {implementation-record-element=CAN4_EXV_Rsp_Run_Stat, system-signal=CAN4_EXV_Rsp_Run_Stat}, {implementation-record-element=CAN4_EXV_Rsp_Pos, system-signal=CAN4_EXV_Rsp_Pos}, {implementation-record-element=CAN4_EXV_Rsp_OvrTemp_Warn, system-signal=CAN4_EXV_Rsp_OvrTemp_Warn}, {implementation-record-element=CAN4_EXV_Rsp_Fault_Stat, system-signal=CAN4_EXV_Rsp_Fault_Stat}, {implementation-record-element=CAN4_EXV_Rsp_CurInit_Stat, system-signal=CAN4_EXV_Rsp_CurInit_Stat}, {implementation-record-element=CAN4_EXV_RsErr_EXV, system-signal=CAN4_EXV_RsErr_EXV}, {implementation-record-element=CAN4_EXV2_Rsp_Volt_Stat, system-signal=CAN4_EXV2_Rsp_Volt_Stat}, {implementation-record-element=CAN4_EXV2_Rsp_Run_Stat, system-signal=CAN4_EXV2_Rsp_Run_Stat}, {implementation-record-element=CAN4_EXV2_Rsp_Pos, system-signal=CAN4_EXV2_Rsp_Pos}, {implementation-record-element=CAN4_EXV2_Rsp_OvrTemp_Warn, system-signal=CAN4_EXV2_Rsp_OvrTemp_Warn}, {implementation-record-element=CAN4_EXV2_Rsp_Fault_Stat, system-signal=CAN4_EXV2_Rsp_Fault_Stat}, {implementation-record-element=CAN4_EXV2_Rsp_CurInit_Stat, system-signal=CAN4_EXV2_Rsp_CurInit_Stat}, {implementation-record-element=CAN4_EXV2_RsErr_EXV, system-signal=CAN4_EXV2_RsErr_EXV}, {implementation-record-element=CAN4_EWP3_Volt_Stat, system-signal=CAN4_EWP3_Volt_Stat}, {implementation-record-element=CAN4_EWP3_Temp_Stat, system-signal=CAN4_EWP3_Temp_Stat}, {implementation-record-element=CAN4_EWP3_SupVolt_Error, system-signal=CAN4_EWP3_SupVolt_Error}, {implementation-record-element=CAN4_EWP3_RsErr_EWP, system-signal=CAN4_EWP3_RsErr_EWP}, {implementation-record-element=CAN4_EWP3_RPM_Target_Stat, system-signal=CAN4_EWP3_RPM_Target_Stat}, {implementation-record-element=CAN4_EWP3_RPM_ActlVal_Stat, system-signal=CAN4_EWP3_RPM_ActlVal_Stat}, {implementation-record-element=CAN4_EWP3_OverTemp_Error, system-signal=CAN4_EWP3_OverTemp_Error}, {implementation-record-element=CAN4_EWP3_OverCurr_Error, system-signal=CAN4_EWP3_OverCurr_Error}, {implementation-record-element=CAN4_EWP3_DryRun_Error, system-signal=CAN4_EWP3_DryRun_Error}, {implementation-record-element=CAN4_EWP3_Curr_Stat, system-signal=CAN4_EWP3_Curr_Stat}, {implementation-record-element=CAN4_EWP3_Block_Error, system-signal=CAN4_EWP3_Block_Error}, {implementation-record-element=CAN4_EWP2_Volt_Stat, system-signal=CAN4_EWP2_Volt_Stat}, {implementation-record-element=CAN4_EWP2_Temp_Stat, system-signal=CAN4_EWP2_Temp_Stat}, {implementation-record-element=CAN4_EWP2_SupVolt_Error, system-signal=CAN4_EWP2_SupVolt_Error}, {implementation-record-element=CAN4_EWP2_RsErr_EWP, system-signal=CAN4_EWP2_RsErr_EWP}, {implementation-record-element=CAN4_EWP2_RPM_Target_Stat, system-signal=CAN4_EWP2_RPM_Target_Stat}, {implementation-record-element=CAN4_EWP2_RPM_ActlVal_Stat, system-signal=CAN4_EWP2_RPM_ActlVal_Stat}, {implementation-record-element=CAN4_EWP2_OverTemp_Error, system-signal=CAN4_EWP2_OverTemp_Error}, {implementation-record-element=CAN4_EWP2_OverCurr_Error, system-signal=CAN4_EWP2_OverCurr_Error}, {implementation-record-element=CAN4_EWP2_DryRun_Error, system-signal=CAN4_EWP2_DryRun_Error}, {implementation-record-element=CAN4_EWP2_Curr_Stat, system-signal=CAN4_EWP2_Curr_Stat}, {implementation-record-element=CAN4_EWP2_Block_Error, system-signal=CAN4_EWP2_Block_Error}, {implementation-record-element=CAN4_EWP1_Volt_Stat, system-signal=CAN4_EWP1_Volt_Stat}, {implementation-record-element=CAN4_EWP1_Temp_Stat, system-signal=CAN4_EWP1_Temp_Stat}, {implementation-record-element=CAN4_EWP1_SupVolt_Error, system-signal=CAN4_EWP1_SupVolt_Error}, {implementation-record-element=CAN4_EWP1_RsErr_EWP, system-signal=CAN4_EWP1_RsErr_EWP}, {implementation-record-element=CAN4_EWP1_RPM_Target_Stat, system-signal=CAN4_EWP1_RPM_Target_Stat}, {implementation-record-element=CAN4_EWP1_RPM_ActlVal_Stat, system-signal=CAN4_EWP1_RPM_ActlVal_Stat}, {implementation-record-element=CAN4_EWP1_OverTemp_Error, system-signal=CAN4_EWP1_OverTemp_Error}, {implementation-record-element=CAN4_EWP1_OverCurr_Error, system-signal=CAN4_EWP1_OverCurr_Error}, {implementation-record-element=CAN4_EWP1_DryRun_Error, system-signal=CAN4_EWP1_DryRun_Error}, {implementation-record-element=CAN4_EWP1_Curr_Stat, system-signal=CAN4_EWP1_Curr_Stat}, {implementation-record-element=CAN4_EWP1_Block_Error, system-signal=CAN4_EWP1_Block_Error}, {implementation-record-element=CAN4_CCV4_voltageErr, system-signal=CAN4_CCV4_voltageErr}, {implementation-record-element=CAN4_CCV4_TempWarn, system-signal=CAN4_CCV4_TempWarn}, {implementation-record-element=CAN4_CCV4_Rsp_Comm_Err, system-signal=CAN4_CCV4_Rsp_Comm_Err}, {implementation-record-element=CAN4_CCV4_RespPos, system-signal=CAN4_CCV4_RespPos}, {implementation-record-element=CAN4_CCV4_MotorStatus, system-signal=CAN4_CCV4_MotorStatus}, {implementation-record-element=CAN4_CCV4_Fault_Signal, system-signal=CAN4_CCV4_Fault_Signal}, {implementation-record-element=CAN4_BDC_1_voltageErr, system-signal=CAN4_BDC_1_voltageErr}, {implementation-record-element=CAN4_BDC_1_TempWarn, system-signal=CAN4_BDC_1_TempWarn}, {implementation-record-element=CAN4_BDC_1_Rsp_Comm_Err, system-signal=CAN4_BDC_1_Rsp_Comm_Err}, {implementation-record-element=CAN4_BDC_1_RespPos, system-signal=CAN4_BDC_1_RespPos}, {implementation-record-element=CAN4_BDC_1_MotorStatus, system-signal=CAN4_BDC_1_MotorStatus}]}
      MAP_HALIN_R_CAN4_zGW_SEAT1: sender-receiver-to-signal-group-mapping{communication-direction=IN, data-element=SWC_HALIN.root_FDC.R_CAN4_zGW_SEAT1.CAN4_SG_zGW_SEAT1, signal-group=CAN4_SG_zGW_SEAT1, type-mapping=sender-rec-record-type-mapping=record-element-mappings=[{implementation-record-element=CAN4_DSEAT_AntiAct_Sta, system-signal=CAN4_DSEAT_AntiAct_Sta}, {implementation-record-element=CAN4_PSEAT_heater_sta, system-signal=CAN4_PSEAT_heater_sta}, {implementation-record-element=CAN4_PSEAT_Vent_Sta, system-signal=CAN4_PSEAT_Vent_Sta}, {implementation-record-element=CAN4_PSEAT_SW_Ver, system-signal=CAN4_PSEAT_SW_Ver}, {implementation-record-element=CAN4_PSEAT_Mode, system-signal=CAN4_PSEAT_Mode}, {implementation-record-element=CAN4_PSEAT_HW_Ver, system-signal=CAN4_PSEAT_HW_Ver}, {implementation-record-element=CAN4_PSEAT_Error_Sta, system-signal=CAN4_PSEAT_Error_Sta}, {implementation-record-element=CAN4_DSEAT_heater_sta, system-signal=CAN4_DSEAT_heater_sta}, {implementation-record-element=CAN4_DSEAT_Vent_Sta, system-signal=CAN4_DSEAT_Vent_Sta}, {implementation-record-element=CAN4_DSEAT_Slid_Pos, system-signal=CAN4_DSEAT_Slid_Pos}, {implementation-record-element=CAN4_DSEAT_SW_Ver, system-signal=CAN4_DSEAT_SW_Ver}, {implementation-record-element=CAN4_DSEAT_Rec_Pos, system-signal=CAN4_DSEAT_Rec_Pos}, {implementation-record-element=CAN4_DSEAT_RL_Pos, system-signal=CAN4_DSEAT_RL_Pos}, {implementation-record-element=CAN4_DSEAT_Mode, system-signal=CAN4_DSEAT_Mode}, {implementation-record-element=CAN4_DSEAT_HW_Ver, system-signal=CAN4_DSEAT_HW_Ver}, {implementation-record-element=CAN4_DSEAT_FL_Pos, system-signal=CAN4_DSEAT_FL_Pos}, {implementation-record-element=CAN4_DSEAT_Error_Sta, system-signal=CAN4_DSEAT_Error_Sta}, {implementation-record-element=CAN4_DSEAT_EntryFun_Sta, system-signal=CAN4_DSEAT_EntryFun_Sta}, {implementation-record-element=CAN4_DSEAT_EntryAct_Sta, system-signal=CAN4_DSEAT_EntryAct_Sta}, {implementation-record-element=CAN4_DSEAT_Anti_Sta, system-signal=CAN4_DSEAT_Anti_Sta}]}
      MAP_HALIN_R_CAN5_TBOX2: sender-receiver-to-signal-group-mapping{communication-direction=IN, data-element=SWC_HALIN.root_FDC.R_CAN5_TBOX2.CAN5_SG_TBOX2, signal-group=CAN5_SG_TBOX2, type-mapping=sender-rec-record-type-mapping=record-element-mappings=[{implementation-record-element=CAN5_TimeSyncFromBS_Day, system-signal=CAN5_TimeSyncFromBS_Day}, {implementation-record-element=CAN5_TimeSyncFromBS_Year, system-signal=CAN5_TimeSyncFromBS_Year}, {implementation-record-element=CAN5_TimeSyncFromBS_Second, system-signal=CAN5_TimeSyncFromBS_Second}, {implementation-record-element=CAN5_TimeSyncFromBS_Month, system-signal=CAN5_TimeSyncFromBS_Month}, {implementation-record-element=CAN5_TimeSyncFromBS_Minute, system-signal=CAN5_TimeSyncFromBS_Minute}, {implementation-record-element=CAN5_TimeSyncFromBS_Hour, system-signal=CAN5_TimeSyncFromBS_Hour}]}
      MAP_HALIN_R_CAN5_TBOX3: sender-receiver-to-signal-group-mapping{communication-direction=IN, data-element=SWC_HALIN.root_FDC.R_CAN5_TBOX3.CAN5_SG_TBOX3, signal-group=CAN5_SG_TBOX3, type-mapping=sender-rec-record-type-mapping=record-element-mappings=[{implementation-record-element=CAN5_Charge_Percent_Set, system-signal=CAN5_Charge_Percent_Set}, {implementation-record-element=CAN5_TBOX_SW_VER, system-signal=CAN5_TBOX_SW_VER}, {implementation-record-element=CAN5_TBOX_HW_VER, system-signal=CAN5_TBOX_HW_VER}, {implementation-record-element=CAN5_ReserveChargeOn_Year, system-signal=CAN5_ReserveChargeOn_Year}, {implementation-record-element=CAN5_ReserveChargeOn_Month, system-signal=CAN5_ReserveChargeOn_Month}, {implementation-record-element=CAN5_ReserveChargeOn_Minute, system-signal=CAN5_ReserveChargeOn_Minute}, {implementation-record-element=CAN5_ReserveChargeOn_Hour, system-signal=CAN5_ReserveChargeOn_Hour}, {implementation-record-element=CAN5_ReserveChargeOn_Day, system-signal=CAN5_ReserveChargeOn_Day}, {implementation-record-element=CAN5_ReserveChargeOFF_Year, system-signal=CAN5_ReserveChargeOFF_Year}, {implementation-record-element=CAN5_ReserveChargeOFF_Month, system-signal=CAN5_ReserveChargeOFF_Month}, {implementation-record-element=CAN5_ReserveChargeOFF_Minute, system-signal=CAN5_ReserveChargeOFF_Minute}, {implementation-record-element=CAN5_ReserveChargeOFF_Hour, system-signal=CAN5_ReserveChargeOFF_Hour}, {implementation-record-element=CAN5_ReserveChargeOFF_Day, system-signal=CAN5_ReserveChargeOFF_Day}]}
      MAP_HALIN_R_CAN6_FCM1: sender-receiver-to-signal-group-mapping{communication-direction=IN, data-element=SWC_HALIN.root_FDC.R_CAN6_FCM1.CAN6_SG_FCM1, signal-group=CAN6_SG_FCM1, type-mapping=sender-rec-record-type-mapping=record-element-mappings=[{implementation-record-element=CAN6_ACC_ComfortBandLower, system-signal=CAN6_ACC_ComfortBandLower}, {implementation-record-element=CAN6_TimeGapLevel, system-signal=CAN6_TimeGapLevel}, {implementation-record-element=CAN6_Target_Type, system-signal=CAN6_Target_Type}, {implementation-record-element=CAN6_RightTurnLightReq, system-signal=CAN6_RightTurnLightReq}, {implementation-record-element=CAN6_LeftTurnLightReq, system-signal=CAN6_LeftTurnLightReq}, {implementation-record-element=CAN6_LVDA_Warning, system-signal=CAN6_LVDA_Warning}, {implementation-record-element=CAN6_LVDA_Mute_Sta, system-signal=CAN6_LVDA_Mute_Sta}, {implementation-record-element=CAN6_LVDA_Failinfo, system-signal=CAN6_LVDA_Failinfo}, {implementation-record-element=CAN6_LVDA_Disabled, system-signal=CAN6_LVDA_Disabled}, {implementation-record-element=CAN6_LVDA_ACCStatusInformation, system-signal=CAN6_LVDA_ACCStatusInformation}, {implementation-record-element=CAN6_LKA_HOD_Sound_Warning, system-signal=CAN6_LKA_HOD_Sound_Warning}, {implementation-record-element=CAN6_LKA_HOD_Display_Warning, system-signal=CAN6_LKA_HOD_Display_Warning}, {implementation-record-element=CAN6_ISA_WarningMsg, system-signal=CAN6_ISA_WarningMsg}, {implementation-record-element=CAN6_HazardWarningReq, system-signal=CAN6_HazardWarningReq}, {implementation-record-element=CAN6_ForceLowBeam, system-signal=CAN6_ForceLowBeam}, {implementation-record-element=CAN6_FCM_LKA_TOIFault, system-signal=CAN6_FCM_LKA_TOIFault}, {implementation-record-element=CAN6_FCM_LKA_TOIAct, system-signal=CAN6_FCM_LKA_TOIAct}, {implementation-record-element=CAN6_FCM_LKA_StrToqReq, system-signal=CAN6_FCM_LKA_StrToqReq}, {implementation-record-element=CAN6_FCM_ACCmode, system-signal=CAN6_FCM_ACCmode}, {implementation-record-element=CAN6_FCM1_LifeCount, system-signal=CAN6_FCM1_LifeCount}, {implementation-record-element=CAN6_FCM1_Checksum, system-signal=CAN6_FCM1_Checksum}, {implementation-record-element=CAN6_CameraBlockage, system-signal=CAN6_CameraBlockage}, {implementation-record-element=CAN6_AEB_VehHoldReq, system-signal=CAN6_AEB_VehHoldReq}, {implementation-record-element=CAN6_ADAS_WarningMsg, system-signal=CAN6_ADAS_WarningMsg}, {implementation-record-element=CAN6_ADAS_VehSpdLim, system-signal=CAN6_ADAS_VehSpdLim}, {implementation-record-element=CAN6_ADAS_ShftPosnReq_A, system-signal=CAN6_ADAS_ShftPosnReq_A}, {implementation-record-element=CAN6_ADAS_ShftPosnReq, system-signal=CAN6_ADAS_ShftPosnReq}, {implementation-record-element=CAN6_ADAS_SLIF_Sta, system-signal=CAN6_ADAS_SLIF_Sta}, {implementation-record-element=CAN6_ADAS_SLIF_SpdLim, system-signal=CAN6_ADAS_SLIF_SpdLim}, {implementation-record-element=CAN6_ADAS_LanetypeR, system-signal=CAN6_ADAS_LanetypeR}, {implementation-record-element=CAN6_ADAS_LanetypeL, system-signal=CAN6_ADAS_LanetypeL}, {implementation-record-element=CAN6_ADAS_Lane_curveR, system-signal=CAN6_ADAS_Lane_curveR}, {implementation-record-element=CAN6_ADAS_Lane_curveL, system-signal=CAN6_ADAS_Lane_curveL}, {implementation-record-element=CAN6_ADAS_LaneModeR, system-signal=CAN6_ADAS_LaneModeR}, {implementation-record-element=CAN6_ADAS_LaneModeL, system-signal=CAN6_ADAS_LaneModeL}, {implementation-record-element=CAN6_ADAS_LKA_Sta, system-signal=CAN6_ADAS_LKA_Sta}, {implementation-record-element=CAN6_ADAS_LFC_Warn_Sound, system-signal=CAN6_ADAS_LFC_Warn_Sound}, {implementation-record-element=CAN6_ADAS_LFC_Sta, system-signal=CAN6_ADAS_LFC_Sta}, {implementation-record-element=CAN6_ADAS_LFC_Hands_Off_Warning, system-signal=CAN6_ADAS_LFC_Hands_Off_Warning}, {implementation-record-element=CAN6_ADAS_LDW_Sta, system-signal=CAN6_ADAS_LDW_Sta}, {implementation-record-element=CAN6_ADAS_LDW_Sensitivity, system-signal=CAN6_ADAS_LDW_Sensitivity}, {implementation-record-element=CAN6_ADAS_LDW_Mute, system-signal=CAN6_ADAS_LDW_Mute}, {implementation-record-element=CAN6_ADAS_ISA_Sta, system-signal=CAN6_ADAS_ISA_Sta}, {implementation-record-element=CAN6_ADAS_ForceIdle, system-signal=CAN6_ADAS_ForceIdle}, {implementation-record-element=CAN6_ADAS_FltWrnReq, system-signal=CAN6_ADAS_FltWrnReq}, {implementation-record-element=CAN6_ADAS_FaultSta, system-signal=CAN6_ADAS_FaultSta}, {implementation-record-element=CAN6_ADAS_FCW_Sta, system-signal=CAN6_ADAS_FCW_Sta}, {implementation-record-element=CAN6_ADAS_FCW_Sensitivity, system-signal=CAN6_ADAS_FCW_Sensitivity}, {implementation-record-element=CAN6_ADAS_FCW_Mute, system-signal=CAN6_ADAS_FCW_Mute}, {implementation-record-element=CAN6_ADAS_DBSReq, system-signal=CAN6_ADAS_DBSReq}, {implementation-record-element=CAN6_ADAS_CAM_SpdLim, system-signal=CAN6_ADAS_CAM_SpdLim}, {implementation-record-element=CAN6_ADAS_AEB_Sta, system-signal=CAN6_ADAS_AEB_Sta}, {implementation-record-element=CAN6_ADAS_AEBReq, system-signal=CAN6_ADAS_AEBReq}, {implementation-record-element=CAN6_ADAS_ACC_Sta, system-signal=CAN6_ADAS_ACC_Sta}, {implementation-record-element=CAN6_ACC_VehHoldReq, system-signal=CAN6_ACC_VehHoldReq}, {implementation-record-element=CAN6_ACC_TakeoverReq, system-signal=CAN6_ACC_TakeoverReq}, {implementation-record-element=CAN6_ACC_RequiredAccel, system-signal=CAN6_ACC_RequiredAccel}, {implementation-record-element=CAN6_ACC_ObjRelSpd, system-signal=CAN6_ACC_ObjRelSpd}, {implementation-record-element=CAN6_ACC_ObjDstLvl, system-signal=CAN6_ACC_ObjDstLvl}, {implementation-record-element=CAN6_ACC_ObjDist, system-signal=CAN6_ACC_ObjDist}, {implementation-record-element=CAN6_ACC_JerkUpperLimit, system-signal=CAN6_ACC_JerkUpperLimit}, {implementation-record-element=CAN6_ACC_JerkLowerLimit, system-signal=CAN6_ACC_JerkLowerLimit}, {implementation-record-element=CAN6_ACC_ComfortBandUpper, system-signal=CAN6_ACC_ComfortBandUpper}]}
      MAP_HALIN_R_CAN6_FCM2: sender-receiver-to-signal-group-mapping{communication-direction=IN, data-element=SWC_HALIN.root_FDC.R_CAN6_FCM2.CAN6_SG_FCM2, signal-group=CAN6_SG_FCM2, type-mapping=sender-rec-record-type-mapping=record-element-mappings=[{implementation-record-element=CAN6_ADB_FR_CMR_Sta, system-signal=CAN6_ADB_FR_CMR_Sta}, {implementation-record-element=CAN6_FCM2_LifeCount, system-signal=CAN6_FCM2_LifeCount}, {implementation-record-element=CAN6_FCM2_Checksum, system-signal=CAN6_FCM2_Checksum}, {implementation-record-element=CAN6_ADB_VehRtAngl9Val, system-signal=CAN6_ADB_VehRtAngl9Val}, {implementation-record-element=CAN6_ADB_VehRtAngl8Val, system-signal=CAN6_ADB_VehRtAngl8Val}, {implementation-record-element=CAN6_ADB_VehRtAngl7Val, system-signal=CAN6_ADB_VehRtAngl7Val}, {implementation-record-element=CAN6_ADB_VehRtAngl6Val, system-signal=CAN6_ADB_VehRtAngl6Val}, {implementation-record-element=CAN6_ADB_VehRtAngl5Val, system-signal=CAN6_ADB_VehRtAngl5Val}, {implementation-record-element=CAN6_ADB_VehRtAngl4Val, system-signal=CAN6_ADB_VehRtAngl4Val}, {implementation-record-element=CAN6_ADB_VehRtAngl3Val, system-signal=CAN6_ADB_VehRtAngl3Val}, {implementation-record-element=CAN6_ADB_VehRtAngl2Val, system-signal=CAN6_ADB_VehRtAngl2Val}, {implementation-record-element=CAN6_ADB_VehRtAngl1Val, system-signal=CAN6_ADB_VehRtAngl1Val}, {implementation-record-element=CAN6_ADB_VehRtAngl10Val, system-signal=CAN6_ADB_VehRtAngl10Val}, {implementation-record-element=CAN6_ADB_VehNumVal, system-signal=CAN6_ADB_VehNumVal}, {implementation-record-element=CAN6_ADB_VehLtAngl9Val, system-signal=CAN6_ADB_VehLtAngl9Val}, {implementation-record-element=CAN6_ADB_VehLtAngl8Val, system-signal=CAN6_ADB_VehLtAngl8Val}, {implementation-record-element=CAN6_ADB_VehLtAngl7Val, system-signal=CAN6_ADB_VehLtAngl7Val}, {implementation-record-element=CAN6_ADB_VehLtAngl6Val, system-signal=CAN6_ADB_VehLtAngl6Val}, {implementation-record-element=CAN6_ADB_VehLtAngl5Val, system-signal=CAN6_ADB_VehLtAngl5Val}, {implementation-record-element=CAN6_ADB_VehLtAngl4Val, system-signal=CAN6_ADB_VehLtAngl4Val}, {implementation-record-element=CAN6_ADB_VehLtAngl3Val, system-signal=CAN6_ADB_VehLtAngl3Val}, {implementation-record-element=CAN6_ADB_VehLtAngl2Val, system-signal=CAN6_ADB_VehLtAngl2Val}, {implementation-record-element=CAN6_ADB_VehLtAngl1Val, system-signal=CAN6_ADB_VehLtAngl1Val}, {implementation-record-element=CAN6_ADB_VehLtAngl10Val, system-signal=CAN6_ADB_VehLtAngl10Val}, {implementation-record-element=CAN6_ADB_VehDst9Val, system-signal=CAN6_ADB_VehDst9Val}, {implementation-record-element=CAN6_ADB_VehDst8Val, system-signal=CAN6_ADB_VehDst8Val}, {implementation-record-element=CAN6_ADB_VehDst7Val, system-signal=CAN6_ADB_VehDst7Val}, {implementation-record-element=CAN6_ADB_VehDst6Val, system-signal=CAN6_ADB_VehDst6Val}, {implementation-record-element=CAN6_ADB_VehDst5Val, system-signal=CAN6_ADB_VehDst5Val}, {implementation-record-element=CAN6_ADB_VehDst4Val, system-signal=CAN6_ADB_VehDst4Val}, {implementation-record-element=CAN6_ADB_VehDst3Val, system-signal=CAN6_ADB_VehDst3Val}, {implementation-record-element=CAN6_ADB_VehDst2Val, system-signal=CAN6_ADB_VehDst2Val}, {implementation-record-element=CAN6_ADB_VehDst1Val, system-signal=CAN6_ADB_VehDst1Val}, {implementation-record-element=CAN6_ADB_VehDst10Val, system-signal=CAN6_ADB_VehDst10Val}, {implementation-record-element=CAN6_ADB_ILLAmbtSta, system-signal=CAN6_ADB_ILLAmbtSta}]}
      MAP_HALIN_R_CAN6_FCM3: sender-receiver-to-signal-group-mapping{communication-direction=IN, data-element=SWC_HALIN.root_FDC.R_CAN6_FCM3.CAN6_SG_FCM3, signal-group=CAN6_SG_FCM3, type-mapping=sender-rec-record-type-mapping=record-element-mappings=[{implementation-record-element=CAN6_ME_Lane_CurvDervLt, system-signal=CAN6_ME_Lane_CurvDervLt}, {implementation-record-element=CAN6_ME_Lane_PosRt2, system-signal=CAN6_ME_Lane_PosRt2}, {implementation-record-element=CAN6_ME_Lane_PosRt, system-signal=CAN6_ME_Lane_PosRt}, {implementation-record-element=CAN6_ME_Lane_PosLt2, system-signal=CAN6_ME_Lane_PosLt2}, {implementation-record-element=CAN6_ME_Lane_PosLt, system-signal=CAN6_ME_Lane_PosLt}, {implementation-record-element=CAN6_ME_Lane_HeadAngRt2, system-signal=CAN6_ME_Lane_HeadAngRt2}, {implementation-record-element=CAN6_ME_Lane_HeadAngRt, system-signal=CAN6_ME_Lane_HeadAngRt}, {implementation-record-element=CAN6_ME_Lane_HeadAngLt2, system-signal=CAN6_ME_Lane_HeadAngLt2}, {implementation-record-element=CAN6_ME_Lane_HeadAngLt, system-signal=CAN6_ME_Lane_HeadAngLt}, {implementation-record-element=CAN6_ME_Lane_CurvRt2, system-signal=CAN6_ME_Lane_CurvRt2}, {implementation-record-element=CAN6_ME_Lane_CurvRt, system-signal=CAN6_ME_Lane_CurvRt}, {implementation-record-element=CAN6_ME_Lane_CurvLt2, system-signal=CAN6_ME_Lane_CurvLt2}, {implementation-record-element=CAN6_ME_Lane_CurvLt, system-signal=CAN6_ME_Lane_CurvLt}, {implementation-record-element=CAN6_ME_Lane_CurvDervRt2, system-signal=CAN6_ME_Lane_CurvDervRt2}, {implementation-record-element=CAN6_ME_Lane_CurvDervRt, system-signal=CAN6_ME_Lane_CurvDervRt}, {implementation-record-element=CAN6_ME_Lane_CurvDervLt2, system-signal=CAN6_ME_Lane_CurvDervLt2}]}
      MAP_HALIN_R_CAN6_FCM4: sender-receiver-to-signal-group-mapping{communication-direction=IN, data-element=SWC_HALIN.root_FDC.R_CAN6_FCM4.CAN6_SG_FCM4, signal-group=CAN6_SG_FCM4, type-mapping=sender-rec-record-type-mapping=record-element-mappings=[{implementation-record-element=CAN6_ADAS_AngCtrlTqWeightGain, system-signal=CAN6_ADAS_AngCtrlTqWeightGain}, {implementation-record-element=CAN6_FCM4_LifeCount, system-signal=CAN6_FCM4_LifeCount}, {implementation-record-element=CAN6_FCM4_Checksum, system-signal=CAN6_FCM4_Checksum}, {implementation-record-element=CAN6_ADAS_StrWhlAngCtrlStatus, system-signal=CAN6_ADAS_StrWhlAngCtrlStatus}, {implementation-record-element=CAN6_ADAS_MaxAngCtrlOutTqLimit, system-signal=CAN6_ADAS_MaxAngCtrlOutTqLimit}, {implementation-record-element=CAN6_ADAS_DrvInputTqBoostGain, system-signal=CAN6_ADAS_DrvInputTqBoostGain}, {implementation-record-element=CAN6_ADAS_DrvInputTqBoostAct, system-signal=CAN6_ADAS_DrvInputTqBoostAct}, {implementation-record-element=CAN6_ADAS_DesStrWhlAngCtrlCmd, system-signal=CAN6_ADAS_DesStrWhlAngCtrlCmd}]}
      MAP_HALIN_R_CAN6_SRR1: sender-receiver-to-signal-group-mapping{communication-direction=IN, data-element=SWC_HALIN.root_FDC.R_CAN6_SRR1.CAN6_SG_SRR1, signal-group=CAN6_SG_SRR1, type-mapping=sender-rec-record-type-mapping=record-element-mappings=[{implementation-record-element=CAN6_SRR1_Chksum, system-signal=CAN6_SRR1_Chksum}, {implementation-record-element=CAN6_SRR_RCTA_WarnR, system-signal=CAN6_SRR_RCTA_WarnR}, {implementation-record-element=CAN6_SRR_RCTA_WarnL, system-signal=CAN6_SRR_RCTA_WarnL}, {implementation-record-element=CAN6_SRR_RCTA_Sta, system-signal=CAN6_SRR_RCTA_Sta}, {implementation-record-element=CAN6_SRR_ODA_WarnR, system-signal=CAN6_SRR_ODA_WarnR}, {implementation-record-element=CAN6_SRR_ODA_WarnL, system-signal=CAN6_SRR_ODA_WarnL}, {implementation-record-element=CAN6_SRR_ODA_Sta, system-signal=CAN6_SRR_ODA_Sta}, {implementation-record-element=CAN6_SRR_ODA_SoundR, system-signal=CAN6_SRR_ODA_SoundR}, {implementation-record-element=CAN6_SRR_ODA_SoundL, system-signal=CAN6_SRR_ODA_SoundL}, {implementation-record-element=CAN6_SRR_ODA_Mute, system-signal=CAN6_SRR_ODA_Mute}, {implementation-record-element=CAN6_SRR_BSD_WarnR, system-signal=CAN6_SRR_BSD_WarnR}, {implementation-record-element=CAN6_SRR_BSD_WarnL, system-signal=CAN6_SRR_BSD_WarnL}, {implementation-record-element=CAN6_SRR_BSD_Sta, system-signal=CAN6_SRR_BSD_Sta}, {implementation-record-element=CAN6_SRR_BSD_SoundR, system-signal=CAN6_SRR_BSD_SoundR}, {implementation-record-element=CAN6_SRR_BSD_SoundL, system-signal=CAN6_SRR_BSD_SoundL}, {implementation-record-element=CAN6_SRR_BSD_Mute, system-signal=CAN6_SRR_BSD_Mute}, {implementation-record-element=CAN6_SRR1_LifeCount, system-signal=CAN6_SRR1_LifeCount}]}
      MAP_CGW_P_CAN1_GW1_CE100_0: sender-receiver-to-signal-group-mapping{communication-direction=OUT, data-element=SWC_CGW.root_FDC.P_CAN1_GW1_CE100_0.CAN1_SG_GW1_CE100_0, signal-group=CAN1_SG_GW1_CE100_0, type-mapping=sender-rec-record-type-mapping=record-element-mappings=[{implementation-record-element=CAN1_BMS_READY, system-signal=CAN1_BMS_READY}, {implementation-record-element=CAN1_Rr_TMSpd, system-signal=CAN1_Rr_TMSpd}, {implementation-record-element=CAN1_Fr_TMSpd, system-signal=CAN1_Fr_TMSpd}]}
      MAP_CGW_P_CAN1_GW1_CE200_0: sender-receiver-to-signal-group-mapping{communication-direction=OUT, data-element=SWC_CGW.root_FDC.P_CAN1_GW1_CE200_0.CAN1_SG_GW1_CE200_0, signal-group=CAN1_SG_GW1_CE200_0, type-mapping=sender-rec-record-type-mapping=record-element-mappings=[{implementation-record-element=CAN1_ESC_SW_Cmd, system-signal=CAN1_ESC_SW_Cmd}, {implementation-record-element=CAN1_TCS_SW_Cmd, system-signal=CAN1_TCS_SW_Cmd}, {implementation-record-element=CAN1_Roll_Mode_SW_Cmd, system-signal=CAN1_Roll_Mode_SW_Cmd}, {implementation-record-element=CAN1_Roll_Eng_Mode, system-signal=CAN1_Roll_Eng_Mode}]}
      MAP_CGW_P_CAN2_GW2_C10_0: sender-receiver-to-signal-group-mapping{communication-direction=OUT, data-element=SWC_CGW.root_FDC.P_CAN2_GW2_C10_0.CAN2_SG_GW2_C10_0, signal-group=CAN2_SG_GW2_C10_0, type-mapping=sender-rec-record-type-mapping=record-element-mappings=[{implementation-record-element=CAN2_ABM_Passenger_ODS_Sta, system-signal=CAN2_ABM_Passenger_ODS_Sta}, {implementation-record-element=CAN2_eBST_RedWnlmpSta, system-signal=CAN2_eBST_RedWnlmpSta}, {implementation-record-element=CAN2_eBST_BeepReq, system-signal=CAN2_eBST_BeepReq}, {implementation-record-element=CAN2_eBST_AmberWnlmpSta, system-signal=CAN2_eBST_AmberWnlmpSta}, {implementation-record-element=CAN2_VehSpeed, system-signal=CAN2_VehSpeed}, {implementation-record-element=CAN2_TRHPsngrSeatBeltCmd, system-signal=CAN2_TRHPsngrSeatBeltCmd}, {implementation-record-element=CAN2_TLHPsngrSeatBeltCmd, system-signal=CAN2_TLHPsngrSeatBeltCmd}, {implementation-record-element=CAN2_TCS_Failed, system-signal=CAN2_TCS_Failed}, {implementation-record-element=CAN2_SAS_V, system-signal=CAN2_SAS_V}, {implementation-record-element=CAN2_SAS_Angle, system-signal=CAN2_SAS_Angle}, {implementation-record-element=CAN2_Rposition_Lamp_Warning, system-signal=CAN2_Rposition_Lamp_Warning}, {implementation-record-element=CAN2_Red_WnlmpSta, system-signal=CAN2_Red_WnlmpSta}, {implementation-record-element=CAN2_RR_WhlRotDir, system-signal=CAN2_RR_WhlRotDir}, {implementation-record-element=CAN2_RR_PulseCount_V, system-signal=CAN2_RR_PulseCount_V}, {implementation-record-element=CAN2_RR_PulseCount, system-signal=CAN2_RR_PulseCount}, {implementation-record-element=CAN2_RRTurnLPErr, system-signal=CAN2_RRTurnLPErr}, {implementation-record-element=CAN2_RPsngrSeatBeltCmd, system-signal=CAN2_RPsngrSeatBeltCmd}, {implementation-record-element=CAN2_RL_BeamErr, system-signal=CAN2_RL_BeamErr}, {implementation-record-element=CAN2_RLTurnLPErr, system-signal=CAN2_RLTurnLPErr}, {implementation-record-element=CAN2_RLB_Warning, system-signal=CAN2_RLB_Warning}, {implementation-record-element=CAN2_RH_BeamErr, system-signal=CAN2_RH_BeamErr}, {implementation-record-element=CAN2_RF_WhlRotDir, system-signal=CAN2_RF_WhlRotDir}, {implementation-record-element=CAN2_RF_PulseCount_V, system-signal=CAN2_RF_PulseCount_V}, {implementation-record-element=CAN2_RF_PulseCount, system-signal=CAN2_RF_PulseCount}, {implementation-record-element=CAN2_RDriverSeatBeltCmd, system-signal=CAN2_RDriverSeatBeltCmd}, {implementation-record-element=CAN2_RDRL_Warning, system-signal=CAN2_RDRL_Warning}, {implementation-record-element=CAN2_RCenterSeatBeltCmd, system-signal=CAN2_RCenterSeatBeltCmd}, {implementation-record-element=CAN2_RAHB_Warning, system-signal=CAN2_RAHB_Warning}, {implementation-record-element=CAN2_RADB_Warning, system-signal=CAN2_RADB_Warning}, {implementation-record-element=CAN2_RADB_Operation_Status, system-signal=CAN2_RADB_Operation_Status}, {implementation-record-element=CAN2_RADB_Hibeam_Indication, system-signal=CAN2_RADB_Hibeam_Indication}, {implementation-record-element=CAN2_RADBErr, system-signal=CAN2_RADBErr}, {implementation-record-element=CAN2_PsngrSeatBeltCmd, system-signal=CAN2_PsngrSeatBeltCmd}, {implementation-record-element=CAN2_PBA_Failed, system-signal=CAN2_PBA_Failed}, {implementation-record-element=CAN2_PBA_Active, system-signal=CAN2_PBA_Active}, {implementation-record-element=CAN2_PABSwitchCmd, system-signal=CAN2_PABSwitchCmd}, {implementation-record-element=CAN2_Meter_Ind_VehSpeed, system-signal=CAN2_Meter_Ind_VehSpeed}, {implementation-record-element=CAN2_Lposition_Lamp_Warning, system-signal=CAN2_Lposition_Lamp_Warning}, {implementation-record-element=CAN2_LowBrakeFluid_Sta, system-signal=CAN2_LowBrakeFluid_Sta}, {implementation-record-element=CAN2_LR_WhlRotDir, system-signal=CAN2_LR_WhlRotDir}, {implementation-record-element=CAN2_LR_PulseCount_V, system-signal=CAN2_LR_PulseCount_V}, {implementation-record-element=CAN2_LR_PulseCount, system-signal=CAN2_LR_PulseCount}, {implementation-record-element=CAN2_LL_BeamErr, system-signal=CAN2_LL_BeamErr}, {implementation-record-element=CAN2_LLB_Warning, system-signal=CAN2_LLB_Warning}, {implementation-record-element=CAN2_LH_BeamErr, system-signal=CAN2_LH_BeamErr}, {implementation-record-element=CAN2_LF_WhlRotDir, system-signal=CAN2_LF_WhlRotDir}, {implementation-record-element=CAN2_LF_PulseCount_V, system-signal=CAN2_LF_PulseCount_V}, {implementation-record-element=CAN2_LF_PulseCount, system-signal=CAN2_LF_PulseCount}, {implementation-record-element=CAN2_LDRL_Warning, system-signal=CAN2_LDRL_Warning}, {implementation-record-element=CAN2_LAHB_Warning, system-signal=CAN2_LAHB_Warning}, {implementation-record-element=CAN2_LADB_Warning, system-signal=CAN2_LADB_Warning}, {implementation-record-element=CAN2_LADB_Operation_Status, system-signal=CAN2_LADB_Operation_Status}, {implementation-record-element=CAN2_LADB_Hibeam_Indication, system-signal=CAN2_LADB_Hibeam_Indication}, {implementation-record-element=CAN2_LADBErr, system-signal=CAN2_LADBErr}, {implementation-record-element=CAN2_HVBattVolt, system-signal=CAN2_HVBattVolt}, {implementation-record-element=CAN2_HVBattErr, system-signal=CAN2_HVBattErr}, {implementation-record-element=CAN2_HVBattCurr, system-signal=CAN2_HVBattCurr}, {implementation-record-element=CAN2_HSA_Failed, system-signal=CAN2_HSA_Failed}, {implementation-record-element=CAN2_HSA_Active, system-signal=CAN2_HSA_Active}, {implementation-record-element=CAN2_HDD_Failed, system-signal=CAN2_HDD_Failed}, {implementation-record-element=CAN2_HDD_Active, system-signal=CAN2_HDD_Active}, {implementation-record-element=CAN2_HBB_Failed, system-signal=CAN2_HBB_Failed}, {implementation-record-element=CAN2_HBB_Active, system-signal=CAN2_HBB_Active}, {implementation-record-element=CAN2_FrPMMLimpHomeActReq, system-signal=CAN2_FrPMMLimpHomeActReq}, {implementation-record-element=CAN2_FireDetErr, system-signal=CAN2_FireDetErr}, {implementation-record-element=CAN2_FRTurn_Light_Warning, system-signal=CAN2_FRTurn_Light_Warning}, {implementation-record-element=CAN2_FRTurnLPErr, system-signal=CAN2_FRTurnLPErr}, {implementation-record-element=CAN2_FLTurn_Light_Warning, system-signal=CAN2_FLTurn_Light_Warning}, {implementation-record-element=CAN2_FLTurnLPErr, system-signal=CAN2_FLTurnLPErr}, {implementation-record-element=CAN2_EpasFailed, system-signal=CAN2_EpasFailed}, {implementation-record-element=CAN2_ESS_Active, system-signal=CAN2_ESS_Active}, {implementation-record-element=CAN2_ESC_WnlmpSta, system-signal=CAN2_ESC_WnlmpSta}, {implementation-record-element=CAN2_ESC_Off_lmpSta, system-signal=CAN2_ESC_Off_lmpSta}, {implementation-record-element=CAN2_ESC_OFF_Status, system-signal=CAN2_ESC_OFF_Status}, {implementation-record-element=CAN2_ESC_Failed, system-signal=CAN2_ESC_Failed}, {implementation-record-element=CAN2_ESC_BeepReq, system-signal=CAN2_ESC_BeepReq}, {implementation-record-element=CAN2_ESC_ADAS_Sta, system-signal=CAN2_ESC_ADAS_Sta}, {implementation-record-element=CAN2_EBMRLampSta, system-signal=CAN2_EBMRLampSta}, {implementation-record-element=CAN2_EBMErrSta, system-signal=CAN2_EBMErrSta}, {implementation-record-element=CAN2_EBD_Failed, system-signal=CAN2_EBD_Failed}, {implementation-record-element=CAN2_DriverSeatBeltCmd, system-signal=CAN2_DriverSeatBeltCmd}, {implementation-record-element=CAN2_DrSCPSysErrLmp, system-signal=CAN2_DrSCPSysErrLmp}, {implementation-record-element=CAN2_DrPMMSysErrLmp, system-signal=CAN2_DrPMMSysErrLmp}, {implementation-record-element=CAN2_DrPMMLVOutPErrLmp, system-signal=CAN2_DrPMMLVOutPErrLmp}, {implementation-record-element=CAN2_DCDCAuxVolt, system-signal=CAN2_DCDCAuxVolt}, {implementation-record-element=CAN2_DCDCAuxCur, system-signal=CAN2_DCDCAuxCur}, {implementation-record-element=CAN2_CrashOutputSts, system-signal=CAN2_CrashOutputSts}, {implementation-record-element=CAN2_BrkSw_V, system-signal=CAN2_BrkSw_V}, {implementation-record-element=CAN2_BrkSw_Sta, system-signal=CAN2_BrkSw_Sta}, {implementation-record-element=CAN2_BrkDiscTempSta, system-signal=CAN2_BrkDiscTempSta}, {implementation-record-element=CAN2_BTCS_Active, system-signal=CAN2_BTCS_Active}, {implementation-record-element=CAN2_Amber_WnlmpSta, system-signal=CAN2_Amber_WnlmpSta}, {implementation-record-element=CAN2_AirBagFailCmd, system-signal=CAN2_AirBagFailCmd}, {implementation-record-element=CAN2_AVH_Failed, system-signal=CAN2_AVH_Failed}, {implementation-record-element=CAN2_AVH_Active, system-signal=CAN2_AVH_Active}, {implementation-record-element=CAN2_AEBAvail, system-signal=CAN2_AEBAvail}, {implementation-record-element=CAN2_ABS_WnlmpSta, system-signal=CAN2_ABS_WnlmpSta}, {implementation-record-element=CAN2_ABS_Failed, system-signal=CAN2_ABS_Failed}, {implementation-record-element=CAN2_ABS_Active, system-signal=CAN2_ABS_Active}, {implementation-record-element=CAN2_ABM_RearPassengerRH_ODS_Sta, system-signal=CAN2_ABM_RearPassengerRH_ODS_Sta}, {implementation-record-element=CAN2_ABM_RearPassengerLH_ODS_Sta, system-signal=CAN2_ABM_RearPassengerLH_ODS_Sta}, {implementation-record-element=CAN2_ABM_RearPassengerCTR_ODS_Sta, system-signal=CAN2_ABM_RearPassengerCTR_ODS_Sta}]}
      MAP_CGW_P_CAN2_GW2_CE1000_0: sender-receiver-to-signal-group-mapping{communication-direction=OUT, data-element=SWC_CGW.root_FDC.P_CAN2_GW2_CE1000_0.CAN2_SG_GW2_CE1000_0, signal-group=CAN2_SG_GW2_CE1000_0, type-mapping=sender-rec-record-type-mapping=record-element-mappings=[{implementation-record-element=CAN2_ACChrgCurrDis, system-signal=CAN2_ACChrgCurrDis}, {implementation-record-element=CAN2_TBOX_SW_VER, system-signal=CAN2_TBOX_SW_VER}, {implementation-record-element=CAN2_TBOX_HW_VER, system-signal=CAN2_TBOX_HW_VER}, {implementation-record-element=CAN2_Rr_MCU3_SW_Ver_Nidec, system-signal=CAN2_Rr_MCU3_SW_Ver_Nidec}, {implementation-record-element=CAN2_Rr_MCU3_SW_Ver, system-signal=CAN2_Rr_MCU3_SW_Ver}, {implementation-record-element=CAN2_Rr_MCU3_HW_Ver_Nidec, system-signal=CAN2_Rr_MCU3_HW_Ver_Nidec}, {implementation-record-element=CAN2_Rr_MCU3_HW_Ver, system-signal=CAN2_Rr_MCU3_HW_Ver}, {implementation-record-element=CAN2_RemainChrgTime, system-signal=CAN2_RemainChrgTime}, {implementation-record-element=CAN2_PTG_SW_Ver, system-signal=CAN2_PTG_SW_Ver}, {implementation-record-element=CAN2_PTG_HW_Ver, system-signal=CAN2_PTG_HW_Ver}, {implementation-record-element=CAN2_PSEAT_SW_Ver, system-signal=CAN2_PSEAT_SW_Ver}, {implementation-record-element=CAN2_PSEAT_HW_Ver, system-signal=CAN2_PSEAT_HW_Ver}, {implementation-record-element=CAN2_HVBattSOCDis, system-signal=CAN2_HVBattSOCDis}, {implementation-record-element=CAN2_HVBattSOC, system-signal=CAN2_HVBattSOC}, {implementation-record-element=CAN2_HVBDrvPwrTotal, system-signal=CAN2_HVBDrvPwrTotal}, {implementation-record-element=CAN2_HVBDrvPwr, system-signal=CAN2_HVBDrvPwr}, {implementation-record-element=CAN2_HVBChrgPwrTotal, system-signal=CAN2_HVBChrgPwrTotal}, {implementation-record-element=CAN2_HVBChrgPwr, system-signal=CAN2_HVBChrgPwr}, {implementation-record-element=CAN2_Fr_MCU_SW_Ver_Nidec, system-signal=CAN2_Fr_MCU_SW_Ver_Nidec}, {implementation-record-element=CAN2_Fr_MCU_SW_Ver, system-signal=CAN2_Fr_MCU_SW_Ver}, {implementation-record-element=CAN2_Fr_MCU_HW_Ver_Nidec, system-signal=CAN2_Fr_MCU_HW_Ver_Nidec}, {implementation-record-element=CAN2_Fr_MCU_HW_Ver, system-signal=CAN2_Fr_MCU_HW_Ver}, {implementation-record-element=CAN2_DSEAT_SW_Ver, system-signal=CAN2_DSEAT_SW_Ver}, {implementation-record-element=CAN2_DSEAT_HW_Ver, system-signal=CAN2_DSEAT_HW_Ver}, {implementation-record-element=CAN2_Charge_Percent_Set, system-signal=CAN2_Charge_Percent_Set}]}
      MAP_CGW_P_CAN2_CGW_GW2_CE100_0: sender-receiver-to-signal-group-mapping{communication-direction=OUT, data-element=SWC_CGW.root_FDC.P_CAN2_CGW_GW2_CE100_0.CAN2_SG_CGW_GW2_CE100_0, signal-group=CAN2_SG_CGW_GW2_CE100_0, type-mapping=sender-rec-record-type-mapping=record-element-mappings=[{implementation-record-element=CAN2_COMP_ActualPwr, system-signal=CAN2_COMP_ActualPwr}, {implementation-record-element=CAN2_ZFR_EChrg_WashMode_Sta, system-signal=CAN2_ZFR_EChrg_WashMode_Sta}, {implementation-record-element=CAN2_ZFR_EChrg_Sys_Sta, system-signal=CAN2_ZFR_EChrg_Sys_Sta}, {implementation-record-element=CAN2_ZFR_EChrg_OperationDeny_Cmd, system-signal=CAN2_ZFR_EChrg_OperationDeny_Cmd}, {implementation-record-element=CAN2_ZFR_EChrg_Active_Sta, system-signal=CAN2_ZFR_EChrg_Active_Sta}, {implementation-record-element=CAN2_ZFR_BCM_ChargerDoorSW_Sta, system-signal=CAN2_ZFR_BCM_ChargerDoorSW_Sta}, {implementation-record-element=CAN2_V2LSta, system-signal=CAN2_V2LSta}, {implementation-record-element=CAN2_TrailerModeSta, system-signal=CAN2_TrailerModeSta}, {implementation-record-element=CAN2_TrailerCheck, system-signal=CAN2_TrailerCheck}, {implementation-record-element=CAN2_TBOX_TEST_STATUS, system-signal=CAN2_TBOX_TEST_STATUS}, {implementation-record-element=CAN2_TBOX_NET_SIG_STR, system-signal=CAN2_TBOX_NET_SIG_STR}, {implementation-record-element=CAN2_Shifter_Handle_Cmd, system-signal=CAN2_Shifter_Handle_Cmd}, {implementation-record-element=CAN2_Shifter_Fail_sta, system-signal=CAN2_Shifter_Fail_sta}, {implementation-record-element=CAN2_SWC_mode_Sta, system-signal=CAN2_SWC_mode_Sta}, {implementation-record-element=CAN2_SWC_VR_Sta, system-signal=CAN2_SWC_VR_Sta}, {implementation-record-element=CAN2_SWC_Up_Sta, system-signal=CAN2_SWC_Up_Sta}, {implementation-record-element=CAN2_SWC_Undefined_Sta, system-signal=CAN2_SWC_Undefined_Sta}, {implementation-record-element=CAN2_SWC_Trip_Sta, system-signal=CAN2_SWC_Trip_Sta}, {implementation-record-element=CAN2_SWC_Right_Sta, system-signal=CAN2_SWC_Right_Sta}, {implementation-record-element=CAN2_SWC_RegenUp, system-signal=CAN2_SWC_RegenUp}, {implementation-record-element=CAN2_SWC_RegenDown, system-signal=CAN2_SWC_RegenDown}, {implementation-record-element=CAN2_SWC_Left_Sta, system-signal=CAN2_SWC_Left_Sta}, {implementation-record-element=CAN2_SWC_LKA_Sta, system-signal=CAN2_SWC_LKA_Sta}, {implementation-record-element=CAN2_SWC_Down_Sta, system-signal=CAN2_SWC_Down_Sta}, {implementation-record-element=CAN2_SWC_ACC_Sta, system-signal=CAN2_SWC_ACC_Sta}, {implementation-record-element=CAN2_Re_Radio, system-signal=CAN2_Re_Radio}, {implementation-record-element=CAN2_RLS_Lamp_Sta, system-signal=CAN2_RLS_Lamp_Sta}, {implementation-record-element=CAN2_P_UID_LowPower, system-signal=CAN2_P_UID_LowPower}, {implementation-record-element=CAN2_P_KeyMiss, system-signal=CAN2_P_KeyMiss}, {implementation-record-element=CAN2_P_Dkey_Show_IVI, system-signal=CAN2_P_Dkey_Show_IVI}, {implementation-record-element=CAN2_OBC_AC_Cur_Lim, system-signal=CAN2_OBC_AC_Cur_Lim}, {implementation-record-element=CAN2_OBCFaultSta, system-signal=CAN2_OBCFaultSta}, {implementation-record-element=CAN2_OBCACVoltInf, system-signal=CAN2_OBCACVoltInf}, {implementation-record-element=CAN2_OBCACCurrInf, system-signal=CAN2_OBCACCurrInf}, {implementation-record-element=CAN2_OBCACCSLimit, system-signal=CAN2_OBCACCSLimit}, {implementation-record-element=CAN2_MainRlyPosSta, system-signal=CAN2_MainRlyPosSta}, {implementation-record-element=CAN2_MainRlyNegSta, system-signal=CAN2_MainRlyNegSta}, {implementation-record-element=CAN2_HVBOvrTempWarn, system-signal=CAN2_HVBOvrTempWarn}, {implementation-record-element=CAN2_HVBOvrTempErr, system-signal=CAN2_HVBOvrTempErr}, {implementation-record-element=CAN2_HVBMTempMax, system-signal=CAN2_HVBMTempMax}, {implementation-record-element=CAN2_HVBContactorSta, system-signal=CAN2_HVBContactorSta}, {implementation-record-element=CAN2_HVBChrgErr, system-signal=CAN2_HVBChrgErr}, {implementation-record-element=CAN2_FrntPTCRiActHeatPwr, system-signal=CAN2_FrntPTCRiActHeatPwr}, {implementation-record-element=CAN2_FrntPTCRearRiActHeatPwr, system-signal=CAN2_FrntPTCRearRiActHeatPwr}, {implementation-record-element=CAN2_FrntPTCRearLeActHeatPwr, system-signal=CAN2_FrntPTCRearLeActHeatPwr}, {implementation-record-element=CAN2_FrntPTCLeActHeatPwr, system-signal=CAN2_FrntPTCLeActHeatPwr}, {implementation-record-element=CAN2_ExtChrgSta, system-signal=CAN2_ExtChrgSta}, {implementation-record-element=CAN2_EBMSta, system-signal=CAN2_EBMSta}, {implementation-record-element=CAN2_DisChrgPlugErr, system-signal=CAN2_DisChrgPlugErr}, {implementation-record-element=CAN2_DKC_KeyType_Sta, system-signal=CAN2_DKC_KeyType_Sta}, {implementation-record-element=CAN2_DKC_KeyNum_Sta, system-signal=CAN2_DKC_KeyNum_Sta}, {implementation-record-element=CAN2_ChrgPlugSta, system-signal=CAN2_ChrgPlugSta}, {implementation-record-element=CAN2_ChargeInletLockSta, system-signal=CAN2_ChargeInletLockSta}, {implementation-record-element=CAN2_CbnPreACEnaReq, system-signal=CAN2_CbnPreACEnaReq}]}
      MAP_CGW_P_CAN2_CGW_GW2_CE100_1: sender-receiver-to-signal-group-mapping{communication-direction=OUT, data-element=SWC_CGW.root_FDC.P_CAN2_CGW_GW2_CE100_1.CAN2_SG_CGW_GW2_CE100_1, signal-group=CAN2_SG_CGW_GW2_CE100_1, type-mapping=sender-rec-record-type-mapping=record-element-mappings=[{implementation-record-element=CAN2_BD_DSEAT_Anti_Sta, system-signal=CAN2_BD_DSEAT_Anti_Sta}, {implementation-record-element=CAN2_SWC2_R_VR_Sta, system-signal=CAN2_SWC2_R_VR_Sta}, {implementation-record-element=CAN2_SWC2_R_ScrollUp_Sta, system-signal=CAN2_SWC2_R_ScrollUp_Sta}, {implementation-record-element=CAN2_SWC2_R_ScrollPress_Sta, system-signal=CAN2_SWC2_R_ScrollPress_Sta}, {implementation-record-element=CAN2_SWC2_R_ScrollDown_Sta, system-signal=CAN2_SWC2_R_ScrollDown_Sta}, {implementation-record-element=CAN2_SWC2_R_Right_Sta, system-signal=CAN2_SWC2_R_Right_Sta}, {implementation-record-element=CAN2_SWC2_R_PageSwitch_Sta, system-signal=CAN2_SWC2_R_PageSwitch_Sta}, {implementation-record-element=CAN2_SWC2_R_Left_Sta, system-signal=CAN2_SWC2_R_Left_Sta}, {implementation-record-element=CAN2_SWC2_R_Customize_Sta, system-signal=CAN2_SWC2_R_Customize_Sta}, {implementation-record-element=CAN2_SWC2_L_Home_Sta, system-signal=CAN2_SWC2_L_Home_Sta}, {implementation-record-element=CAN2_SWC2_L_DriveMode_Sta, system-signal=CAN2_SWC2_L_DriveMode_Sta}, {implementation-record-element=CAN2_Rr_TMTempWarn, system-signal=CAN2_Rr_TMTempWarn}, {implementation-record-element=CAN2_Rr_TMTemp, system-signal=CAN2_Rr_TMTemp}, {implementation-record-element=CAN2_Rr_TMSpd, system-signal=CAN2_Rr_TMSpd}, {implementation-record-element=CAN2_Rr_MotorAvailTq, system-signal=CAN2_Rr_MotorAvailTq}, {implementation-record-element=CAN2_Rr_MCUTempWarn, system-signal=CAN2_Rr_MCUTempWarn}, {implementation-record-element=CAN2_Rr_MCUTemp, system-signal=CAN2_Rr_MCUTemp}, {implementation-record-element=CAN2_Rr_EDURealTMTq, system-signal=CAN2_Rr_EDURealTMTq}, {implementation-record-element=CAN2_Rr_EDUDrtSta, system-signal=CAN2_Rr_EDUDrtSta}, {implementation-record-element=CAN2_MCU_B_R_LLCTempWarn_Sta, system-signal=CAN2_MCU_B_R_LLCTempWarn_Sta}, {implementation-record-element=CAN2_MCU_B_F_LLCTempWarn_Sta, system-signal=CAN2_MCU_B_F_LLCTempWarn_Sta}, {implementation-record-element=CAN2_Fr_TMTempWarn, system-signal=CAN2_Fr_TMTempWarn}, {implementation-record-element=CAN2_Fr_TMTemp, system-signal=CAN2_Fr_TMTemp}, {implementation-record-element=CAN2_Fr_TMSpd, system-signal=CAN2_Fr_TMSpd}, {implementation-record-element=CAN2_Fr_MotorAvailTq, system-signal=CAN2_Fr_MotorAvailTq}, {implementation-record-element=CAN2_Fr_MCUTempWarn, system-signal=CAN2_Fr_MCUTempWarn}, {implementation-record-element=CAN2_Fr_MCUTemp, system-signal=CAN2_Fr_MCUTemp}, {implementation-record-element=CAN2_Fr_EDURealTMTq, system-signal=CAN2_Fr_EDURealTMTq}, {implementation-record-element=CAN2_Fr_EDUDrtSta, system-signal=CAN2_Fr_EDUDrtSta}, {implementation-record-element=CAN2_BP_SEAT_RVent_Sta, system-signal=CAN2_BP_SEAT_RVent_Sta}, {implementation-record-element=CAN2_BP_SEAT_MRVent_Sta, system-signal=CAN2_BP_SEAT_MRVent_Sta}, {implementation-record-element=CAN2_BP_SEAT_MLVent_Sta, system-signal=CAN2_BP_SEAT_MLVent_Sta}, {implementation-record-element=CAN2_BP_SEAT_LVent_Sta, system-signal=CAN2_BP_SEAT_LVent_Sta}, {implementation-record-element=CAN2_BP_PTG_Sys_Sta, system-signal=CAN2_BP_PTG_Sys_Sta}, {implementation-record-element=CAN2_BP_PTG_IsSetHeight_Sta, system-signal=CAN2_BP_PTG_IsSetHeight_Sta}, {implementation-record-element=CAN2_BP_PTG_Exist_Sta, system-signal=CAN2_BP_PTG_Exist_Sta}, {implementation-record-element=CAN2_BP_PTG_Active_Sta, system-signal=CAN2_BP_PTG_Active_Sta}, {implementation-record-element=CAN2_BP_PSEAT_heater_Sta, system-signal=CAN2_BP_PSEAT_heater_Sta}, {implementation-record-element=CAN2_BP_PSEAT_Vent_Sta, system-signal=CAN2_BP_PSEAT_Vent_Sta}, {implementation-record-element=CAN2_BP_PSEAT_Mode_Sta, system-signal=CAN2_BP_PSEAT_Mode_Sta}, {implementation-record-element=CAN2_BP_PSEAT_Error_Sta, system-signal=CAN2_BP_PSEAT_Error_Sta}, {implementation-record-element=CAN2_BP_Door_RHandleClose_Sta, system-signal=CAN2_BP_Door_RHandleClose_Sta}, {implementation-record-element=CAN2_BP_Door_FHandleClose_Sta, system-signal=CAN2_BP_Door_FHandleClose_Sta}, {implementation-record-element=CAN2_BD_Door_RHandleClose_Sta, system-signal=CAN2_BD_Door_RHandleClose_Sta}, {implementation-record-element=CAN2_BD_Door_FHandleClose_Sta, system-signal=CAN2_BD_Door_FHandleClose_Sta}, {implementation-record-element=CAN2_BD_DSEAT_heater_Sta, system-signal=CAN2_BD_DSEAT_heater_Sta}, {implementation-record-element=CAN2_BD_DSEAT_Vent_Sta, system-signal=CAN2_BD_DSEAT_Vent_Sta}, {implementation-record-element=CAN2_BD_DSEAT_StopKeepMove_Sta, system-signal=CAN2_BD_DSEAT_StopKeepMove_Sta}, {implementation-record-element=CAN2_BD_DSEAT_Mode_Sta, system-signal=CAN2_BD_DSEAT_Mode_Sta}, {implementation-record-element=CAN2_BD_DSEAT_MemSet_Sta, system-signal=CAN2_BD_DSEAT_MemSet_Sta}, {implementation-record-element=CAN2_BD_DSEAT_Error_Sta, system-signal=CAN2_BD_DSEAT_Error_Sta}, {implementation-record-element=CAN2_BD_DSEAT_EntryFun_Sta, system-signal=CAN2_BD_DSEAT_EntryFun_Sta}]}
      MAP_CGW_P_CAN2_GW2_CE100_2: sender-receiver-to-signal-group-mapping{communication-direction=OUT, data-element=SWC_CGW.root_FDC.P_CAN2_GW2_CE100_2.CAN2_SG_GW2_CE100_2, signal-group=CAN2_SG_GW2_CE100_2, type-mapping=sender-rec-record-type-mapping=record-element-mappings=[{implementation-record-element=CAN2_DSEAT_Anti_Sta, system-signal=CAN2_DSEAT_Anti_Sta}, {implementation-record-element=CAN2_Rr_TMTemp_Nidec, system-signal=CAN2_Rr_TMTemp_Nidec}, {implementation-record-element=CAN2_Rr_TMTempWarn_Nidec, system-signal=CAN2_Rr_TMTempWarn_Nidec}, {implementation-record-element=CAN2_Rr_TMSpd_Nidec, system-signal=CAN2_Rr_TMSpd_Nidec}, {implementation-record-element=CAN2_Rr_MotorAvailTq_Nidec, system-signal=CAN2_Rr_MotorAvailTq_Nidec}, {implementation-record-element=CAN2_Rr_MCUTemp_Nidec, system-signal=CAN2_Rr_MCUTemp_Nidec}, {implementation-record-element=CAN2_Rr_MCUTempWarn_Nidec, system-signal=CAN2_Rr_MCUTempWarn_Nidec}, {implementation-record-element=CAN2_Rr_EDURealTMTq_Nidec, system-signal=CAN2_Rr_EDURealTMTq_Nidec}, {implementation-record-element=CAN2_Rr_EDUDrtSta_Nidec, system-signal=CAN2_Rr_EDUDrtSta_Nidec}, {implementation-record-element=CAN2_RAPWL_01_LIN_Response_Error, system-signal=CAN2_RAPWL_01_LIN_Response_Error}, {implementation-record-element=CAN2_PTG_Sys_Sta, system-signal=CAN2_PTG_Sys_Sta}, {implementation-record-element=CAN2_PTG_Is_Set_Height, system-signal=CAN2_PTG_Is_Set_Height}, {implementation-record-element=CAN2_PTG_Exist, system-signal=CAN2_PTG_Exist}, {implementation-record-element=CAN2_PTG_AutoStaus, system-signal=CAN2_PTG_AutoStaus}, {implementation-record-element=CAN2_PTG_Active_Sta, system-signal=CAN2_PTG_Active_Sta}, {implementation-record-element=CAN2_PSEAT_heater_sta, system-signal=CAN2_PSEAT_heater_sta}, {implementation-record-element=CAN2_PSEAT_Vent_Sta, system-signal=CAN2_PSEAT_Vent_Sta}, {implementation-record-element=CAN2_PSEAT_Mode, system-signal=CAN2_PSEAT_Mode}, {implementation-record-element=CAN2_PSEAT_Error_Sta, system-signal=CAN2_PSEAT_Error_Sta}, {implementation-record-element=CAN2_L_RRD_Val_Wdw_Opened, system-signal=CAN2_L_RRD_Val_Wdw_Opened}, {implementation-record-element=CAN2_L_RRD_Motor_Ripple_Error, system-signal=CAN2_L_RRD_Motor_Ripple_Error}, {implementation-record-element=CAN2_L_RRD_Motor_Relay_Error, system-signal=CAN2_L_RRD_Motor_Relay_Error}, {implementation-record-element=CAN2_L_RLD_Val_Wdw_Opened, system-signal=CAN2_L_RLD_Val_Wdw_Opened}, {implementation-record-element=CAN2_L_RLD_Motor_Ripple_Error, system-signal=CAN2_L_RLD_Motor_Ripple_Error}, {implementation-record-element=CAN2_L_RLD_Motor_Relay_Error, system-signal=CAN2_L_RLD_Motor_Relay_Error}, {implementation-record-element=CAN2_L_Pas_Val_Wdw_Opened, system-signal=CAN2_L_Pas_Val_Wdw_Opened}, {implementation-record-element=CAN2_L_Pas_Motor_Ripple_Error, system-signal=CAN2_L_Pas_Motor_Ripple_Error}, {implementation-record-element=CAN2_L_Pas_Motor_Relay_Error, system-signal=CAN2_L_Pas_Motor_Relay_Error}, {implementation-record-element=CAN2_L_Drv_Val_Wdw_Opened, system-signal=CAN2_L_Drv_Val_Wdw_Opened}, {implementation-record-element=CAN2_L_Drv_Motor_Ripple_Error, system-signal=CAN2_L_Drv_Motor_Ripple_Error}, {implementation-record-element=CAN2_L_Drv_Motor_Relay_Error, system-signal=CAN2_L_Drv_Motor_Relay_Error}, {implementation-record-element=CAN2_Fr_TMTemp_Nidec, system-signal=CAN2_Fr_TMTemp_Nidec}, {implementation-record-element=CAN2_Fr_TMTempWarn_Nidec, system-signal=CAN2_Fr_TMTempWarn_Nidec}, {implementation-record-element=CAN2_Fr_TMSpd_Nidec, system-signal=CAN2_Fr_TMSpd_Nidec}, {implementation-record-element=CAN2_Fr_MotorAvailTq_Nidec, system-signal=CAN2_Fr_MotorAvailTq_Nidec}, {implementation-record-element=CAN2_Fr_MCUTemp_Nidec, system-signal=CAN2_Fr_MCUTemp_Nidec}, {implementation-record-element=CAN2_Fr_MCUTempWarn_Nidec, system-signal=CAN2_Fr_MCUTempWarn_Nidec}, {implementation-record-element=CAN2_Fr_EDURealTMTq_Nidec, system-signal=CAN2_Fr_EDURealTMTq_Nidec}, {implementation-record-element=CAN2_Fr_EDUDrtSta_Nidec, system-signal=CAN2_Fr_EDUDrtSta_Nidec}, {implementation-record-element=CAN2_FAPWL_01_LIN_Response_Error, system-signal=CAN2_FAPWL_01_LIN_Response_Error}, {implementation-record-element=CAN2_DSEAT_heater_sta, system-signal=CAN2_DSEAT_heater_sta}, {implementation-record-element=CAN2_DSEAT_Vent_Sta, system-signal=CAN2_DSEAT_Vent_Sta}, {implementation-record-element=CAN2_DSEAT_Mode, system-signal=CAN2_DSEAT_Mode}, {implementation-record-element=CAN2_DSEAT_Error_Sta, system-signal=CAN2_DSEAT_Error_Sta}, {implementation-record-element=CAN2_DSEAT_EntryFun_Sta, system-signal=CAN2_DSEAT_EntryFun_Sta}]}
      MAP_CGW_P_CAN2_CGW_GW2_CE200_0: sender-receiver-to-signal-group-mapping{communication-direction=OUT, data-element=SWC_CGW.root_FDC.P_CAN2_CGW_GW2_CE200_0.CAN2_SG_CGW_GW2_CE200_0, signal-group=CAN2_SG_CGW_GW2_CE200_0, type-mapping=sender-rec-record-type-mapping=record-element-mappings=[{implementation-record-element=CAN2_ACC_ObjDist, system-signal=CAN2_ACC_ObjDist}, {implementation-record-element=CAN2_Target_Type, system-signal=CAN2_Target_Type}, {implementation-record-element=CAN2_RightTurnLightReq, system-signal=CAN2_RightTurnLightReq}, {implementation-record-element=CAN2_MCU_B_R_RealPwrKw_Sta, system-signal=CAN2_MCU_B_R_RealPwrKw_Sta}, {implementation-record-element=CAN2_MCU_B_F_RealPwrKw_Sta, system-signal=CAN2_MCU_B_F_RealPwrKw_Sta}, {implementation-record-element=CAN2_LeftTurnLightReq, system-signal=CAN2_LeftTurnLightReq}, {implementation-record-element=CAN2_LVDA_Warning, system-signal=CAN2_LVDA_Warning}, {implementation-record-element=CAN2_LVDA_Mute_Sta, system-signal=CAN2_LVDA_Mute_Sta}, {implementation-record-element=CAN2_LVDA_Failinfo, system-signal=CAN2_LVDA_Failinfo}, {implementation-record-element=CAN2_LVDA_Disabled, system-signal=CAN2_LVDA_Disabled}, {implementation-record-element=CAN2_LVDA_ACCStatusInformation, system-signal=CAN2_LVDA_ACCStatusInformation}, {implementation-record-element=CAN2_LKA_HOD_Sound_Warning, system-signal=CAN2_LKA_HOD_Sound_Warning}, {implementation-record-element=CAN2_LKA_HOD_Display_Warning, system-signal=CAN2_LKA_HOD_Display_Warning}, {implementation-record-element=CAN2_ISA_WarningMsg, system-signal=CAN2_ISA_WarningMsg}, {implementation-record-element=CAN2_HazardWarningReq, system-signal=CAN2_HazardWarningReq}, {implementation-record-element=CAN2_HVBSOH, system-signal=CAN2_HVBSOH}, {implementation-record-element=CAN2_HVBPwrAvailChrg60, system-signal=CAN2_HVBPwrAvailChrg60}, {implementation-record-element=CAN2_HVBPwrAvailChrg30, system-signal=CAN2_HVBPwrAvailChrg30}, {implementation-record-element=CAN2_HVBPwrAvailChrg, system-signal=CAN2_HVBPwrAvailChrg}, {implementation-record-element=CAN2_HVBFullChrgPwr, system-signal=CAN2_HVBFullChrgPwr}, {implementation-record-element=CAN2_ForceLowBeam, system-signal=CAN2_ForceLowBeam}, {implementation-record-element=CAN2_CameraBlockage, system-signal=CAN2_CameraBlockage}, {implementation-record-element=CAN2_ActBrkLamp_Sta, system-signal=CAN2_ActBrkLamp_Sta}, {implementation-record-element=CAN2_ADAS_WarningMsg, system-signal=CAN2_ADAS_WarningMsg}, {implementation-record-element=CAN2_ADAS_VehSpdLim, system-signal=CAN2_ADAS_VehSpdLim}, {implementation-record-element=CAN2_ADAS_SLIF_Sta, system-signal=CAN2_ADAS_SLIF_Sta}, {implementation-record-element=CAN2_ADAS_SLIF_SpdLim, system-signal=CAN2_ADAS_SLIF_SpdLim}, {implementation-record-element=CAN2_ADAS_LaneModeR, system-signal=CAN2_ADAS_LaneModeR}, {implementation-record-element=CAN2_ADAS_LaneModeL, system-signal=CAN2_ADAS_LaneModeL}, {implementation-record-element=CAN2_ADAS_LKA_Sta, system-signal=CAN2_ADAS_LKA_Sta}, {implementation-record-element=CAN2_ADAS_LFC_Warn_Sound, system-signal=CAN2_ADAS_LFC_Warn_Sound}, {implementation-record-element=CAN2_ADAS_LFC_Sta, system-signal=CAN2_ADAS_LFC_Sta}, {implementation-record-element=CAN2_ADAS_LFC_Hands_Off_Warning, system-signal=CAN2_ADAS_LFC_Hands_Off_Warning}, {implementation-record-element=CAN2_ADAS_LDW_Sta, system-signal=CAN2_ADAS_LDW_Sta}, {implementation-record-element=CAN2_ADAS_LDW_Sensitivity, system-signal=CAN2_ADAS_LDW_Sensitivity}, {implementation-record-element=CAN2_ADAS_LDW_Mute, system-signal=CAN2_ADAS_LDW_Mute}, {implementation-record-element=CAN2_ADAS_ISA_Sta, system-signal=CAN2_ADAS_ISA_Sta}, {implementation-record-element=CAN2_ADAS_FltWrnReq, system-signal=CAN2_ADAS_FltWrnReq}, {implementation-record-element=CAN2_ADAS_FCW_Sta, system-signal=CAN2_ADAS_FCW_Sta}, {implementation-record-element=CAN2_ADAS_FCW_Sensitivity, system-signal=CAN2_ADAS_FCW_Sensitivity}, {implementation-record-element=CAN2_ADAS_FCW_Mute, system-signal=CAN2_ADAS_FCW_Mute}, {implementation-record-element=CAN2_ADAS_CAM_SpdLim, system-signal=CAN2_ADAS_CAM_SpdLim}, {implementation-record-element=CAN2_ADAS_AEB_Sta, system-signal=CAN2_ADAS_AEB_Sta}, {implementation-record-element=CAN2_ADAS_AEBReq, system-signal=CAN2_ADAS_AEBReq}, {implementation-record-element=CAN2_ADAS_ACC_Sta, system-signal=CAN2_ADAS_ACC_Sta}, {implementation-record-element=CAN2_ACC_TakeoverReq, system-signal=CAN2_ACC_TakeoverReq}, {implementation-record-element=CAN2_ACC_ObjRelSpd, system-signal=CAN2_ACC_ObjRelSpd}, {implementation-record-element=CAN2_ACC_ObjDstLvl, system-signal=CAN2_ACC_ObjDstLvl}]}
