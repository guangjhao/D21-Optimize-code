ASAP2_VERSION 1 31
/begin PROJECT ProjectName "Project Comment Goes Here"
/begin HEADER "Header Comments go here" /end HEADER
/begin MODULE ModuleName "Module Comment Goes Here"
/begin MOD_COMMON "Mod Common Comment Here" BYTE_ORDER MSB_LAST /end MOD_COMMON
/begin RECORD_LAYOUT Scalar_BOOLEAN FNC_VALUES 1 UBYTE COLUMN_DIR DIRECT /end RECORD_LAYOUT
/begin RECORD_LAYOUT Scalar_UBYTE FNC_VALUES 1 UBYTE COLUMN_DIR DIRECT /end RECORD_LAYOUT
/begin RECORD_LAYOUT Scalar_UWORD FNC_VALUES 1 UWORD COLUMN_DIR DIRECT /end RECORD_LAYOUT
/begin RECORD_LAYOUT Scalar_FLOAT32_IEEE FNC_VALUES 1 FLOAT32_IEEE COLUMN_DIR DIRECT /end RECORD_LAYOUT
/begin RECORD_LAYOUT Lookup2D_X_BYTE AXIS_PTS_X 1 SBYTE INDEX_INCR DIRECT /end RECORD_LAYOUT
/begin RECORD_LAYOUT Lookup2D_UWORD FNC_VALUES 1 UWORD COLUMN_DIR DIRECT /end RECORD_LAYOUT
/begin RECORD_LAYOUT Lookup2D_X_UWORD AXIS_PTS_X 1 UWORD INDEX_INCR DIRECT /end RECORD_LAYOUT
/begin RECORD_LAYOUT Lookup2D_WORD FNC_VALUES 1 SWORD COLUMN_DIR DIRECT /end RECORD_LAYOUT
/begin RECORD_LAYOUT Lookup2D_X_WORD AXIS_PTS_X 1 SWORD INDEX_INCR DIRECT /end RECORD_LAYOUT
/begin RECORD_LAYOUT Lookup2D_ULONG FNC_VALUES 1 ULONG COLUMN_DIR DIRECT /end RECORD_LAYOUT
/begin CHARACTERISTIC KINP_BDAPMWinFOpenedSta_pct_defval "" VALUE 0x0000 /* @ECU_Address@KINP_BDAPMWinFOpenedSta_pct_defval@ */ Scalar_FLOAT32_IEEE 0 SWC_INP_type_CM_single_pct 0.0 127.0 /end CHARACTERISTIC
/begin CHARACTERISTIC KINP_BDAPMWinFOpenedSta_pct_ovrdval "" VALUE 0x0000 /* @ECU_Address@KINP_BDAPMWinFOpenedSta_pct_ovrdval@ */ Scalar_FLOAT32_IEEE 0 SWC_INP_type_CM_single_pct 0.0 127.0 /end CHARACTERISTIC
/begin CHARACTERISTIC KINP_BDAPMWinROpenedSta_pct_defval "" VALUE 0x0000 /* @ECU_Address@KINP_BDAPMWinROpenedSta_pct_defval@ */ Scalar_FLOAT32_IEEE 0 SWC_INP_type_CM_single_pct 0.0 127.0 /end CHARACTERISTIC
/begin CHARACTERISTIC KINP_BDAPMWinROpenedSta_pct_ovrdval "" VALUE 0x0000 /* @ECU_Address@KINP_BDAPMWinROpenedSta_pct_ovrdval@ */ Scalar_FLOAT32_IEEE 0 SWC_INP_type_CM_single_pct 0.0 127.0 /end CHARACTERISTIC
/begin CHARACTERISTIC KINP_BPAPMWinFOpenedSta_pct_defval "" VALUE 0x0000 /* @ECU_Address@KINP_BPAPMWinFOpenedSta_pct_defval@ */ Scalar_FLOAT32_IEEE 0 SWC_INP_type_CM_single_pct 0.0 127.0 /end CHARACTERISTIC
/begin CHARACTERISTIC KINP_BPAPMWinFOpenedSta_pct_ovrdval "" VALUE 0x0000 /* @ECU_Address@KINP_BPAPMWinFOpenedSta_pct_ovrdval@ */ Scalar_FLOAT32_IEEE 0 SWC_INP_type_CM_single_pct 0.0 127.0 /end CHARACTERISTIC
/begin CHARACTERISTIC KINP_BPAPMWinROpenedSta_pct_defval "" VALUE 0x0000 /* @ECU_Address@KINP_BPAPMWinROpenedSta_pct_defval@ */ Scalar_FLOAT32_IEEE 0 SWC_INP_type_CM_single_pct 0.0 127.0 /end CHARACTERISTIC
/begin CHARACTERISTIC KINP_BPAPMWinROpenedSta_pct_ovrdval "" VALUE 0x0000 /* @ECU_Address@KINP_BPAPMWinROpenedSta_pct_ovrdval@ */ Scalar_FLOAT32_IEEE 0 SWC_INP_type_CM_single_pct 0.0 127.0 /end CHARACTERISTIC
/begin CHARACTERISTIC KINP_BPPTGOpenRatioSta_pct_defval "" VALUE 0x0000 /* @ECU_Address@KINP_BPPTGOpenRatioSta_pct_defval@ */ Scalar_FLOAT32_IEEE 0 SWC_INP_type_CM_single_pct 0.0 127.0 /end CHARACTERISTIC
/begin CHARACTERISTIC KINP_BPPTGOpenRatioSta_pct_ovrdval "" VALUE 0x0000 /* @ECU_Address@KINP_BPPTGOpenRatioSta_pct_ovrdval@ */ Scalar_FLOAT32_IEEE 0 SWC_INP_type_CM_single_pct 0.0 127.0 /end CHARACTERISTIC
/begin CHARACTERISTIC KINP_BatInTemp_C_defval "" VALUE 0x0000 /* @ECU_Address@KINP_BatInTemp_C_defval@ */ Scalar_FLOAT32_IEEE 0 SWC_INP_type_CM_single_C -40.0 85.0 /end CHARACTERISTIC
/begin CHARACTERISTIC KINP_BatInTemp_C_ovrdval "" VALUE 0x0000 /* @ECU_Address@KINP_BatInTemp_C_ovrdval@ */ Scalar_FLOAT32_IEEE 0 SWC_INP_type_CM_single_C -40.0 85.0 /end CHARACTERISTIC
/begin CHARACTERISTIC KINP_BatOutTemp_C_defval "" VALUE 0x0000 /* @ECU_Address@KINP_BatOutTemp_C_defval@ */ Scalar_FLOAT32_IEEE 0 SWC_INP_type_CM_single_C -40.0 85.0 /end CHARACTERISTIC
/begin CHARACTERISTIC KINP_BatOutTemp_C_ovrdval "" VALUE 0x0000 /* @ECU_Address@KINP_BatOutTemp_C_ovrdval@ */ Scalar_FLOAT32_IEEE 0 SWC_INP_type_CM_single_C -40.0 85.0 /end CHARACTERISTIC
/begin CHARACTERISTIC KINP_FLTurnLampC_mA_defval "" VALUE 0x0000 /* @ECU_Address@KINP_FLTurnLampC_mA_defval@ */ Scalar_FLOAT32_IEEE 0 SWC_INP_type_CM_single_mA 0.0 2550.0 /end CHARACTERISTIC
/begin CHARACTERISTIC KINP_FLTurnLampC_mA_ovrdval "" VALUE 0x0000 /* @ECU_Address@KINP_FLTurnLampC_mA_ovrdval@ */ Scalar_FLOAT32_IEEE 0 SWC_INP_type_CM_single_mA 0.0 2550.0 /end CHARACTERISTIC
/begin CHARACTERISTIC KINP_FRTurnLampC_mA_defval "" VALUE 0x0000 /* @ECU_Address@KINP_FRTurnLampC_mA_defval@ */ Scalar_FLOAT32_IEEE 0 SWC_INP_type_CM_single_mA 0.0 2550.0 /end CHARACTERISTIC
/begin CHARACTERISTIC KINP_FRTurnLampC_mA_ovrdval "" VALUE 0x0000 /* @ECU_Address@KINP_FRTurnLampC_mA_ovrdval@ */ Scalar_FLOAT32_IEEE 0 SWC_INP_type_CM_single_mA 0.0 2550.0 /end CHARACTERISTIC
/begin CHARACTERISTIC KINP_FrLLCTempNidec_C_defval "" VALUE 0x0000 /* @ECU_Address@KINP_FrLLCTempNidec_C_defval@ */ Scalar_FLOAT32_IEEE 0 SWC_INP_type_CM_single_C -40.0 214.0 /end CHARACTERISTIC
/begin CHARACTERISTIC KINP_FrLLCTempNidec_C_ovrdval "" VALUE 0x0000 /* @ECU_Address@KINP_FrLLCTempNidec_C_ovrdval@ */ Scalar_FLOAT32_IEEE 0 SWC_INP_type_CM_single_C -40.0 214.0 /end CHARACTERISTIC
/begin CHARACTERISTIC KINP_FrLLCflowReqNidec_Lpmin_defval "" VALUE 0x0000 /* @ECU_Address@KINP_FrLLCflowReqNidec_Lpmin_defval@ */ Scalar_FLOAT32_IEEE 0 SWC_INP_type_CM_single_Lpmin 0.0 15.5 /end CHARACTERISTIC
/begin CHARACTERISTIC KINP_FrLLCflowReqNidec_Lpmin_ovrdval "" VALUE 0x0000 /* @ECU_Address@KINP_FrLLCflowReqNidec_Lpmin_ovrdval@ */ Scalar_FLOAT32_IEEE 0 SWC_INP_type_CM_single_Lpmin 0.0 15.5 /end CHARACTERISTIC
/begin CHARACTERISTIC KINP_MotorInTemp_C_defval "" VALUE 0x0000 /* @ECU_Address@KINP_MotorInTemp_C_defval@ */ Scalar_FLOAT32_IEEE 0 SWC_INP_type_CM_single_C -40.0 85.0 /end CHARACTERISTIC
/begin CHARACTERISTIC KINP_MotorInTemp_C_ovrdval "" VALUE 0x0000 /* @ECU_Address@KINP_MotorInTemp_C_ovrdval@ */ Scalar_FLOAT32_IEEE 0 SWC_INP_type_CM_single_C -40.0 85.0 /end CHARACTERISTIC
/begin CHARACTERISTIC KINP_MotorOutTemp_C_defval "" VALUE 0x0000 /* @ECU_Address@KINP_MotorOutTemp_C_defval@ */ Scalar_FLOAT32_IEEE 0 SWC_INP_type_CM_single_C -40.0 85.0 /end CHARACTERISTIC
/begin CHARACTERISTIC KINP_MotorOutTemp_C_ovrdval "" VALUE 0x0000 /* @ECU_Address@KINP_MotorOutTemp_C_ovrdval@ */ Scalar_FLOAT32_IEEE 0 SWC_INP_type_CM_single_C -40.0 85.0 /end CHARACTERISTIC
/begin CHARACTERISTIC KINP_PTGOpenRatio_pct_defval "" VALUE 0x0000 /* @ECU_Address@KINP_PTGOpenRatio_pct_defval@ */ Scalar_FLOAT32_IEEE 0 SWC_INP_type_CM_single_pct 0.0 127.0 /end CHARACTERISTIC
/begin CHARACTERISTIC KINP_PTGOpenRatio_pct_ovrdval "" VALUE 0x0000 /* @ECU_Address@KINP_PTGOpenRatio_pct_ovrdval@ */ Scalar_FLOAT32_IEEE 0 SWC_INP_type_CM_single_pct 0.0 127.0 /end CHARACTERISTIC
/begin CHARACTERISTIC KINP_PTHighP_KPa_defval "" VALUE 0x0000 /* @ECU_Address@KINP_PTHighP_KPa_defval@ */ Scalar_FLOAT32_IEEE 0 SWC_INP_type_CM_single_KPa 0.0 4000.0 /end CHARACTERISTIC
/begin CHARACTERISTIC KINP_PTHighP_KPa_ovrdval "" VALUE 0x0000 /* @ECU_Address@KINP_PTHighP_KPa_ovrdval@ */ Scalar_FLOAT32_IEEE 0 SWC_INP_type_CM_single_KPa 0.0 4000.0 /end CHARACTERISTIC
/begin CHARACTERISTIC KINP_PTHighTact_C_defval "" VALUE 0x0000 /* @ECU_Address@KINP_PTHighTact_C_defval@ */ Scalar_FLOAT32_IEEE 0 SWC_INP_type_CM_single_C -40.0 140.0 /end CHARACTERISTIC
/begin CHARACTERISTIC KINP_PTHighTact_C_ovrdval "" VALUE 0x0000 /* @ECU_Address@KINP_PTHighTact_C_ovrdval@ */ Scalar_FLOAT32_IEEE 0 SWC_INP_type_CM_single_C -40.0 140.0 /end CHARACTERISTIC
/begin CHARACTERISTIC KINP_PTLowP1_KPa_defval "" VALUE 0x0000 /* @ECU_Address@KINP_PTLowP1_KPa_defval@ */ Scalar_FLOAT32_IEEE 0 SWC_INP_type_CM_single_KPa 0.0 4000.0 /end CHARACTERISTIC
/begin CHARACTERISTIC KINP_PTLowP1_KPa_ovrdval "" VALUE 0x0000 /* @ECU_Address@KINP_PTLowP1_KPa_ovrdval@ */ Scalar_FLOAT32_IEEE 0 SWC_INP_type_CM_single_KPa 0.0 4000.0 /end CHARACTERISTIC
/begin CHARACTERISTIC KINP_PTLowP2_KPa_defval "" VALUE 0x0000 /* @ECU_Address@KINP_PTLowP2_KPa_defval@ */ Scalar_FLOAT32_IEEE 0 SWC_INP_type_CM_single_KPa 0.0 4000.0 /end CHARACTERISTIC
/begin CHARACTERISTIC KINP_PTLowP2_KPa_ovrdval "" VALUE 0x0000 /* @ECU_Address@KINP_PTLowP2_KPa_ovrdval@ */ Scalar_FLOAT32_IEEE 0 SWC_INP_type_CM_single_KPa 0.0 4000.0 /end CHARACTERISTIC
/begin CHARACTERISTIC KINP_PTLowT1_C_defval "" VALUE 0x0000 /* @ECU_Address@KINP_PTLowT1_C_defval@ */ Scalar_FLOAT32_IEEE 0 SWC_INP_type_CM_single_C -40.0 85.0 /end CHARACTERISTIC
/begin CHARACTERISTIC KINP_PTLowT1_C_ovrdval "" VALUE 0x0000 /* @ECU_Address@KINP_PTLowT1_C_ovrdval@ */ Scalar_FLOAT32_IEEE 0 SWC_INP_type_CM_single_C -40.0 85.0 /end CHARACTERISTIC
/begin CHARACTERISTIC KINP_PTLowT2_C_defval "" VALUE 0x0000 /* @ECU_Address@KINP_PTLowT2_C_defval@ */ Scalar_FLOAT32_IEEE 0 SWC_INP_type_CM_single_C -40.0 85.0 /end CHARACTERISTIC
/begin CHARACTERISTIC KINP_PTLowT2_C_ovrdval "" VALUE 0x0000 /* @ECU_Address@KINP_PTLowT2_C_ovrdval@ */ Scalar_FLOAT32_IEEE 0 SWC_INP_type_CM_single_C -40.0 85.0 /end CHARACTERISTIC
/begin CHARACTERISTIC KINP_RLTurnLampC_mA_defval "" VALUE 0x0000 /* @ECU_Address@KINP_RLTurnLampC_mA_defval@ */ Scalar_FLOAT32_IEEE 0 SWC_INP_type_CM_single_mA 0.0 2550.0 /end CHARACTERISTIC
/begin CHARACTERISTIC KINP_RLTurnLampC_mA_ovrdval "" VALUE 0x0000 /* @ECU_Address@KINP_RLTurnLampC_mA_ovrdval@ */ Scalar_FLOAT32_IEEE 0 SWC_INP_type_CM_single_mA 0.0 2550.0 /end CHARACTERISTIC
/begin CHARACTERISTIC KINP_RRTurnLampC_mA_defval "" VALUE 0x0000 /* @ECU_Address@KINP_RRTurnLampC_mA_defval@ */ Scalar_FLOAT32_IEEE 0 SWC_INP_type_CM_single_mA 0.0 2550.0 /end CHARACTERISTIC
/begin CHARACTERISTIC KINP_RRTurnLampC_mA_ovrdval "" VALUE 0x0000 /* @ECU_Address@KINP_RRTurnLampC_mA_ovrdval@ */ Scalar_FLOAT32_IEEE 0 SWC_INP_type_CM_single_mA 0.0 2550.0 /end CHARACTERISTIC
/begin CHARACTERISTIC KINP_RrCoolanttempReqNidec_cnt_defval "" VALUE 0x0000 /* @ECU_Address@KINP_RrCoolanttempReqNidec_cnt_defval@ */ Scalar_FLOAT32_IEEE 0 SWC_INP_type_CM_single_cnt -40.0 214.0 /end CHARACTERISTIC
/begin CHARACTERISTIC KINP_RrCoolanttempReqNidec_cnt_ovrdval "" VALUE 0x0000 /* @ECU_Address@KINP_RrCoolanttempReqNidec_cnt_ovrdval@ */ Scalar_FLOAT32_IEEE 0 SWC_INP_type_CM_single_cnt -40.0 214.0 /end CHARACTERISTIC
/begin CHARACTERISTIC KINP_RrEDURealTMTqNidec_Nm_defval "" VALUE 0x0000 /* @ECU_Address@KINP_RrEDURealTMTqNidec_Nm_defval@ */ Scalar_FLOAT32_IEEE 0 SWC_INP_type_CM_single_Nm -1022.0 1022.0 /end CHARACTERISTIC
/begin CHARACTERISTIC KINP_RrEDURealTMTqNidec_Nm_ovrdval "" VALUE 0x0000 /* @ECU_Address@KINP_RrEDURealTMTqNidec_Nm_ovrdval@ */ Scalar_FLOAT32_IEEE 0 SWC_INP_type_CM_single_Nm -1022.0 1022.0 /end CHARACTERISTIC
/begin CHARACTERISTIC KINP_RrEDUTqReqFbkNidec_Nm_defval "" VALUE 0x0000 /* @ECU_Address@KINP_RrEDUTqReqFbkNidec_Nm_defval@ */ Scalar_FLOAT32_IEEE 0 SWC_INP_type_CM_single_Nm -1022.0 1022.0 /end CHARACTERISTIC
/begin CHARACTERISTIC KINP_RrEDUTqReqFbkNidec_Nm_ovrdval "" VALUE 0x0000 /* @ECU_Address@KINP_RrEDUTqReqFbkNidec_Nm_ovrdval@ */ Scalar_FLOAT32_IEEE 0 SWC_INP_type_CM_single_Nm -1022.0 1022.0 /end CHARACTERISTIC
/begin CHARACTERISTIC KINP_RrEOPSpdSetNidec_rpm_defval "" VALUE 0x0000 /* @ECU_Address@KINP_RrEOPSpdSetNidec_rpm_defval@ */ Scalar_FLOAT32_IEEE 0 SWC_INP_type_CM_single_rpm 0.0 4000.0 /end CHARACTERISTIC
/begin CHARACTERISTIC KINP_RrEOPSpdSetNidec_rpm_ovrdval "" VALUE 0x0000 /* @ECU_Address@KINP_RrEOPSpdSetNidec_rpm_ovrdval@ */ Scalar_FLOAT32_IEEE 0 SWC_INP_type_CM_single_rpm 0.0 4000.0 /end CHARACTERISTIC
/begin CHARACTERISTIC KINP_RrLLCTempNidec_C_defval "" VALUE 0x0000 /* @ECU_Address@KINP_RrLLCTempNidec_C_defval@ */ Scalar_FLOAT32_IEEE 0 SWC_INP_type_CM_single_C -40.0 214.0 /end CHARACTERISTIC
/begin CHARACTERISTIC KINP_RrLLCTempNidec_C_ovrdval "" VALUE 0x0000 /* @ECU_Address@KINP_RrLLCTempNidec_C_ovrdval@ */ Scalar_FLOAT32_IEEE 0 SWC_INP_type_CM_single_C -40.0 214.0 /end CHARACTERISTIC
/begin CHARACTERISTIC KINP_RrLLCflowReqNidec_Lpmin_defval "" VALUE 0x0000 /* @ECU_Address@KINP_RrLLCflowReqNidec_Lpmin_defval@ */ Scalar_FLOAT32_IEEE 0 SWC_INP_type_CM_single_Lpmin 0.0 15.5 /end CHARACTERISTIC
/begin CHARACTERISTIC KINP_RrLLCflowReqNidec_Lpmin_ovrdval "" VALUE 0x0000 /* @ECU_Address@KINP_RrLLCflowReqNidec_Lpmin_ovrdval@ */ Scalar_FLOAT32_IEEE 0 SWC_INP_type_CM_single_Lpmin 0.0 15.5 /end CHARACTERISTIC
/begin CHARACTERISTIC KINP_RrMCUBATNidec_V_defval "" VALUE 0x0000 /* @ECU_Address@KINP_RrMCUBATNidec_V_defval@ */ Scalar_FLOAT32_IEEE 0 SWC_INP_type_CM_single_V 0.0 25.4 /end CHARACTERISTIC
/begin CHARACTERISTIC KINP_RrMCUBATNidec_V_ovrdval "" VALUE 0x0000 /* @ECU_Address@KINP_RrMCUBATNidec_V_ovrdval@ */ Scalar_FLOAT32_IEEE 0 SWC_INP_type_CM_single_V 0.0 25.4 /end CHARACTERISTIC
/begin CHARACTERISTIC KINP_RrMCUDCBusCurrNidec_A_defval "" VALUE 0x0000 /* @ECU_Address@KINP_RrMCUDCBusCurrNidec_A_defval@ */ Scalar_FLOAT32_IEEE 0 SWC_INP_type_CM_single_A -1500.0 1500.0 /end CHARACTERISTIC
/begin CHARACTERISTIC KINP_RrMCUDCBusCurrNidec_A_ovrdval "" VALUE 0x0000 /* @ECU_Address@KINP_RrMCUDCBusCurrNidec_A_ovrdval@ */ Scalar_FLOAT32_IEEE 0 SWC_INP_type_CM_single_A -1500.0 1500.0 /end CHARACTERISTIC
/begin CHARACTERISTIC KINP_RrMCUDCBusVoltNidec_V_defval "" VALUE 0x0000 /* @ECU_Address@KINP_RrMCUDCBusVoltNidec_V_defval@ */ Scalar_FLOAT32_IEEE 0 SWC_INP_type_CM_single_V 0.0 4000.0 /end CHARACTERISTIC
/begin CHARACTERISTIC KINP_RrMCUDCBusVoltNidec_V_ovrdval "" VALUE 0x0000 /* @ECU_Address@KINP_RrMCUDCBusVoltNidec_V_ovrdval@ */ Scalar_FLOAT32_IEEE 0 SWC_INP_type_CM_single_V 0.0 4000.0 /end CHARACTERISTIC
/begin CHARACTERISTIC KINP_RrMCUTempNidec_C_defval "" VALUE 0x0000 /* @ECU_Address@KINP_RrMCUTempNidec_C_defval@ */ Scalar_FLOAT32_IEEE 0 SWC_INP_type_CM_single_C -40.0 254.0 /end CHARACTERISTIC
/begin CHARACTERISTIC KINP_RrMCUTempNidec_C_ovrdval "" VALUE 0x0000 /* @ECU_Address@KINP_RrMCUTempNidec_C_ovrdval@ */ Scalar_FLOAT32_IEEE 0 SWC_INP_type_CM_single_C -40.0 254.0 /end CHARACTERISTIC
/begin CHARACTERISTIC KINP_RrMotorAvailTqNidec_Nm_defval "" VALUE 0x0000 /* @ECU_Address@KINP_RrMotorAvailTqNidec_Nm_defval@ */ Scalar_FLOAT32_IEEE 0 SWC_INP_type_CM_single_Nm 0.0 1022.0 /end CHARACTERISTIC
/begin CHARACTERISTIC KINP_RrMotorAvailTqNidec_Nm_ovrdval "" VALUE 0x0000 /* @ECU_Address@KINP_RrMotorAvailTqNidec_Nm_ovrdval@ */ Scalar_FLOAT32_IEEE 0 SWC_INP_type_CM_single_Nm 0.0 1022.0 /end CHARACTERISTIC
/begin CHARACTERISTIC KINP_RrRegenAvailTqNidec_Nm_defval "" VALUE 0x0000 /* @ECU_Address@KINP_RrRegenAvailTqNidec_Nm_defval@ */ Scalar_FLOAT32_IEEE 0 SWC_INP_type_CM_single_Nm -1022.0 0.0 /end CHARACTERISTIC
/begin CHARACTERISTIC KINP_RrRegenAvailTqNidec_Nm_ovrdval "" VALUE 0x0000 /* @ECU_Address@KINP_RrRegenAvailTqNidec_Nm_ovrdval@ */ Scalar_FLOAT32_IEEE 0 SWC_INP_type_CM_single_Nm -1022.0 0.0 /end CHARACTERISTIC
/begin CHARACTERISTIC KINP_RrTMSpdNidec_rpm_defval "" VALUE 0x0000 /* @ECU_Address@KINP_RrTMSpdNidec_rpm_defval@ */ Scalar_FLOAT32_IEEE 0 SWC_INP_type_CM_single_rpm -17000.0 17000.0 /end CHARACTERISTIC
/begin CHARACTERISTIC KINP_RrTMSpdNidec_rpm_ovrdval "" VALUE 0x0000 /* @ECU_Address@KINP_RrTMSpdNidec_rpm_ovrdval@ */ Scalar_FLOAT32_IEEE 0 SWC_INP_type_CM_single_rpm -17000.0 17000.0 /end CHARACTERISTIC
/begin CHARACTERISTIC KINP_RrTMTempNidec_C_defval "" VALUE 0x0000 /* @ECU_Address@KINP_RrTMTempNidec_C_defval@ */ Scalar_FLOAT32_IEEE 0 SWC_INP_type_CM_single_C -40.0 254.0 /end CHARACTERISTIC
/begin CHARACTERISTIC KINP_RrTMTempNidec_C_ovrdval "" VALUE 0x0000 /* @ECU_Address@KINP_RrTMTempNidec_C_ovrdval@ */ Scalar_FLOAT32_IEEE 0 SWC_INP_type_CM_single_C -40.0 254.0 /end CHARACTERISTIC
/begin CHARACTERISTIC KINP_RrTMidNidec_A_defval "" VALUE 0x0000 /* @ECU_Address@KINP_RrTMidNidec_A_defval@ */ Scalar_FLOAT32_IEEE 0 SWC_INP_type_CM_single_A -1500.0 1500.0 /end CHARACTERISTIC
/begin CHARACTERISTIC KINP_RrTMidNidec_A_ovrdval "" VALUE 0x0000 /* @ECU_Address@KINP_RrTMidNidec_A_ovrdval@ */ Scalar_FLOAT32_IEEE 0 SWC_INP_type_CM_single_A -1500.0 1500.0 /end CHARACTERISTIC
/begin CHARACTERISTIC KINP_RrTMiqNidec_A_defval "" VALUE 0x0000 /* @ECU_Address@KINP_RrTMiqNidec_A_defval@ */ Scalar_FLOAT32_IEEE 0 SWC_INP_type_CM_single_A -1500.0 1500.0 /end CHARACTERISTIC
/begin CHARACTERISTIC KINP_RrTMiqNidec_A_ovrdval "" VALUE 0x0000 /* @ECU_Address@KINP_RrTMiqNidec_A_ovrdval@ */ Scalar_FLOAT32_IEEE 0 SWC_INP_type_CM_single_A -1500.0 1500.0 /end CHARACTERISTIC
/begin CHARACTERISTIC KINP_SolarL_W_defval "" VALUE 0x0000 /* @ECU_Address@KINP_SolarL_W_defval@ */ Scalar_FLOAT32_IEEE 0 SWC_INP_type_CM_single_W 0.0 1265.0 /end CHARACTERISTIC
/begin CHARACTERISTIC KINP_SolarL_W_ovrdval "" VALUE 0x0000 /* @ECU_Address@KINP_SolarL_W_ovrdval@ */ Scalar_FLOAT32_IEEE 0 SWC_INP_type_CM_single_W 0.0 1265.0 /end CHARACTERISTIC
/begin CHARACTERISTIC KINP_SolarR_W_defval "" VALUE 0x0000 /* @ECU_Address@KINP_SolarR_W_defval@ */ Scalar_FLOAT32_IEEE 0 SWC_INP_type_CM_single_W 0.0 1265.0 /end CHARACTERISTIC
/begin CHARACTERISTIC KINP_SolarR_W_ovrdval "" VALUE 0x0000 /* @ECU_Address@KINP_SolarR_W_ovrdval@ */ Scalar_FLOAT32_IEEE 0 SWC_INP_type_CM_single_W 0.0 1265.0 /end CHARACTERISTIC
/begin CHARACTERISTIC KINP_TFaceL_C_defval "" VALUE 0x0000 /* @ECU_Address@KINP_TFaceL_C_defval@ */ Scalar_FLOAT32_IEEE 0 SWC_INP_type_CM_single_C -40.0 85.0 /end CHARACTERISTIC
/begin CHARACTERISTIC KINP_TFaceL_C_ovrdval "" VALUE 0x0000 /* @ECU_Address@KINP_TFaceL_C_ovrdval@ */ Scalar_FLOAT32_IEEE 0 SWC_INP_type_CM_single_C -40.0 85.0 /end CHARACTERISTIC
/begin CHARACTERISTIC KINP_TFaceR_C_defval "" VALUE 0x0000 /* @ECU_Address@KINP_TFaceR_C_defval@ */ Scalar_FLOAT32_IEEE 0 SWC_INP_type_CM_single_C -40.0 85.0 /end CHARACTERISTIC
/begin CHARACTERISTIC KINP_TFaceR_C_ovrdval "" VALUE 0x0000 /* @ECU_Address@KINP_TFaceR_C_ovrdval@ */ Scalar_FLOAT32_IEEE 0 SWC_INP_type_CM_single_C -40.0 85.0 /end CHARACTERISTIC
/begin CHARACTERISTIC KINP_TFaceRr_C_defval "" VALUE 0x0000 /* @ECU_Address@KINP_TFaceRr_C_defval@ */ Scalar_FLOAT32_IEEE 0 SWC_INP_type_CM_single_C -40.0 85.0 /end CHARACTERISTIC
/begin CHARACTERISTIC KINP_TFaceRr_C_ovrdval "" VALUE 0x0000 /* @ECU_Address@KINP_TFaceRr_C_ovrdval@ */ Scalar_FLOAT32_IEEE 0 SWC_INP_type_CM_single_C -40.0 85.0 /end CHARACTERISTIC
/begin CHARACTERISTIC KINP_TFootL_C_defval "" VALUE 0x0000 /* @ECU_Address@KINP_TFootL_C_defval@ */ Scalar_FLOAT32_IEEE 0 SWC_INP_type_CM_single_C -40.0 85.0 /end CHARACTERISTIC
/begin CHARACTERISTIC KINP_TFootL_C_ovrdval "" VALUE 0x0000 /* @ECU_Address@KINP_TFootL_C_ovrdval@ */ Scalar_FLOAT32_IEEE 0 SWC_INP_type_CM_single_C -40.0 85.0 /end CHARACTERISTIC
/begin CHARACTERISTIC KINP_TFootR_C_defval "" VALUE 0x0000 /* @ECU_Address@KINP_TFootR_C_defval@ */ Scalar_FLOAT32_IEEE 0 SWC_INP_type_CM_single_C -40.0 85.0 /end CHARACTERISTIC
/begin CHARACTERISTIC KINP_TFootR_C_ovrdval "" VALUE 0x0000 /* @ECU_Address@KINP_TFootR_C_ovrdval@ */ Scalar_FLOAT32_IEEE 0 SWC_INP_type_CM_single_C -40.0 85.0 /end CHARACTERISTIC
/begin CHARACTERISTIC KINP_TFootRr_C_defval "" VALUE 0x0000 /* @ECU_Address@KINP_TFootRr_C_defval@ */ Scalar_FLOAT32_IEEE 0 SWC_INP_type_CM_single_C -40.0 85.0 /end CHARACTERISTIC
/begin CHARACTERISTIC KINP_TFootRr_C_ovrdval "" VALUE 0x0000 /* @ECU_Address@KINP_TFootRr_C_ovrdval@ */ Scalar_FLOAT32_IEEE 0 SWC_INP_type_CM_single_C -40.0 85.0 /end CHARACTERISTIC
/begin CHARACTERISTIC KINP_Tamb_C_defval "" VALUE 0x0000 /* @ECU_Address@KINP_Tamb_C_defval@ */ Scalar_FLOAT32_IEEE 0 SWC_INP_type_CM_single_C -40.0 85.0 /end CHARACTERISTIC
/begin CHARACTERISTIC KINP_Tamb_C_ovrdval "" VALUE 0x0000 /* @ECU_Address@KINP_Tamb_C_ovrdval@ */ Scalar_FLOAT32_IEEE 0 SWC_INP_type_CM_single_C -40.0 85.0 /end CHARACTERISTIC
/begin CHARACTERISTIC KINP_Tevap_C_defval "" VALUE 0x0000 /* @ECU_Address@KINP_Tevap_C_defval@ */ Scalar_FLOAT32_IEEE 0 SWC_INP_type_CM_single_C -40.0 85.0 /end CHARACTERISTIC
/begin CHARACTERISTIC KINP_Tevap_C_ovrdval "" VALUE 0x0000 /* @ECU_Address@KINP_Tevap_C_ovrdval@ */ Scalar_FLOAT32_IEEE 0 SWC_INP_type_CM_single_C -40.0 85.0 /end CHARACTERISTIC
/begin CHARACTERISTIC KINP_Tincar_C_defval "" VALUE 0x0000 /* @ECU_Address@KINP_Tincar_C_defval@ */ Scalar_FLOAT32_IEEE 0 SWC_INP_type_CM_single_C -40.0 85.0 /end CHARACTERISTIC
/begin CHARACTERISTIC KINP_Tincar_C_ovrdval "" VALUE 0x0000 /* @ECU_Address@KINP_Tincar_C_ovrdval@ */ Scalar_FLOAT32_IEEE 0 SWC_INP_type_CM_single_C -40.0 85.0 /end CHARACTERISTIC
/begin CHARACTERISTIC KINP_ZFRTHCMCLEVentActYSta_pct_defval "" VALUE 0x0000 /* @ECU_Address@KINP_ZFRTHCMCLEVentActYSta_pct_defval@ */ Scalar_FLOAT32_IEEE 0 SWC_INP_type_CM_single_pct 0.0 127.0 /end CHARACTERISTIC
/begin CHARACTERISTIC KINP_ZFRTHCMCLEVentActYSta_pct_ovrdval "" VALUE 0x0000 /* @ECU_Address@KINP_ZFRTHCMCLEVentActYSta_pct_ovrdval@ */ Scalar_FLOAT32_IEEE 0 SWC_INP_type_CM_single_pct 0.0 127.0 /end CHARACTERISTIC
/begin CHARACTERISTIC KINP_ZFRTHCMCREVentActYSta_pct_defval "" VALUE 0x0000 /* @ECU_Address@KINP_ZFRTHCMCREVentActYSta_pct_defval@ */ Scalar_FLOAT32_IEEE 0 SWC_INP_type_CM_single_pct 0.0 127.0 /end CHARACTERISTIC
/begin CHARACTERISTIC KINP_ZFRTHCMCREVentActYSta_pct_ovrdval "" VALUE 0x0000 /* @ECU_Address@KINP_ZFRTHCMCREVentActYSta_pct_ovrdval@ */ Scalar_FLOAT32_IEEE 0 SWC_INP_type_CM_single_pct 0.0 127.0 /end CHARACTERISTIC
/begin CHARACTERISTIC KINP_ZFRTHCMLEVentActYSta_pct_defval "" VALUE 0x0000 /* @ECU_Address@KINP_ZFRTHCMLEVentActYSta_pct_defval@ */ Scalar_FLOAT32_IEEE 0 SWC_INP_type_CM_single_pct 0.0 127.0 /end CHARACTERISTIC
/begin CHARACTERISTIC KINP_ZFRTHCMLEVentActYSta_pct_ovrdval "" VALUE 0x0000 /* @ECU_Address@KINP_ZFRTHCMLEVentActYSta_pct_ovrdval@ */ Scalar_FLOAT32_IEEE 0 SWC_INP_type_CM_single_pct 0.0 127.0 /end CHARACTERISTIC
/begin CHARACTERISTIC KINP_ZFRTHCMREVentActYSta_pct_defval "" VALUE 0x0000 /* @ECU_Address@KINP_ZFRTHCMREVentActYSta_pct_defval@ */ Scalar_FLOAT32_IEEE 0 SWC_INP_type_CM_single_pct 0.0 127.0 /end CHARACTERISTIC
/begin CHARACTERISTIC KINP_ZFRTHCMREVentActYSta_pct_ovrdval "" VALUE 0x0000 /* @ECU_Address@KINP_ZFRTHCMREVentActYSta_pct_ovrdval@ */ Scalar_FLOAT32_IEEE 0 SWC_INP_type_CM_single_pct 0.0 127.0 /end CHARACTERISTIC
/begin CHARACTERISTIC KINP_BPPTGLeftHallPosnSta_enum_defval "" VALUE 0x0000 /* @ECU_Address@KINP_BPPTGLeftHallPosnSta_enum_defval@ */ Scalar_UWORD 0 SWC_INP_type_CM_uint16_enum 0.0 1023.0 /end CHARACTERISTIC
/begin CHARACTERISTIC KINP_BPPTGLeftHallPosnSta_enum_ovrdval "" VALUE 0x0000 /* @ECU_Address@KINP_BPPTGLeftHallPosnSta_enum_ovrdval@ */ Scalar_UWORD 0 SWC_INP_type_CM_uint16_enum 0.0 1023.0 /end CHARACTERISTIC
/begin CHARACTERISTIC KINP_FrMCUHWVerNidec_enum_defval "" VALUE 0x0000 /* @ECU_Address@KINP_FrMCUHWVerNidec_enum_defval@ */ Scalar_UWORD 0 SWC_INP_type_CM_uint16_enum 0.0 65535.0 /end CHARACTERISTIC
/begin CHARACTERISTIC KINP_FrMCUHWVerNidec_enum_ovrdval "" VALUE 0x0000 /* @ECU_Address@KINP_FrMCUHWVerNidec_enum_ovrdval@ */ Scalar_UWORD 0 SWC_INP_type_CM_uint16_enum 0.0 65535.0 /end CHARACTERISTIC
/begin CHARACTERISTIC KINP_FrMCUSWVerNidec_enum_defval "" VALUE 0x0000 /* @ECU_Address@KINP_FrMCUSWVerNidec_enum_defval@ */ Scalar_UWORD 0 SWC_INP_type_CM_uint16_enum 0.0 65535.0 /end CHARACTERISTIC
/begin CHARACTERISTIC KINP_FrMCUSWVerNidec_enum_ovrdval "" VALUE 0x0000 /* @ECU_Address@KINP_FrMCUSWVerNidec_enum_ovrdval@ */ Scalar_UWORD 0 SWC_INP_type_CM_uint16_enum 0.0 65535.0 /end CHARACTERISTIC
/begin CHARACTERISTIC KINP_LeftHallPos_enum_defval "" VALUE 0x0000 /* @ECU_Address@KINP_LeftHallPos_enum_defval@ */ Scalar_UWORD 0 SWC_INP_type_CM_uint16_enum 0.0 4095.0 /end CHARACTERISTIC
/begin CHARACTERISTIC KINP_LeftHallPos_enum_ovrdval "" VALUE 0x0000 /* @ECU_Address@KINP_LeftHallPos_enum_ovrdval@ */ Scalar_UWORD 0 SWC_INP_type_CM_uint16_enum 0.0 4095.0 /end CHARACTERISTIC
/begin CHARACTERISTIC KINP_RrMCU3HWVerNidec_enum_defval "" VALUE 0x0000 /* @ECU_Address@KINP_RrMCU3HWVerNidec_enum_defval@ */ Scalar_UWORD 0 SWC_INP_type_CM_uint16_enum 0.0 65535.0 /end CHARACTERISTIC
/begin CHARACTERISTIC KINP_RrMCU3HWVerNidec_enum_ovrdval "" VALUE 0x0000 /* @ECU_Address@KINP_RrMCU3HWVerNidec_enum_ovrdval@ */ Scalar_UWORD 0 SWC_INP_type_CM_uint16_enum 0.0 65535.0 /end CHARACTERISTIC
/begin CHARACTERISTIC KINP_RrMCU3SWVerNidec_enum_defval "" VALUE 0x0000 /* @ECU_Address@KINP_RrMCU3SWVerNidec_enum_defval@ */ Scalar_UWORD 0 SWC_INP_type_CM_uint16_enum 0.0 65535.0 /end CHARACTERISTIC
/begin CHARACTERISTIC KINP_RrMCU3SWVerNidec_enum_ovrdval "" VALUE 0x0000 /* @ECU_Address@KINP_RrMCU3SWVerNidec_enum_ovrdval@ */ Scalar_UWORD 0 SWC_INP_type_CM_uint16_enum 0.0 65535.0 /end CHARACTERISTIC
/begin CHARACTERISTIC KINP_AGSErr_enum_ovrdflg "" VALUE 0x0000 /* @ECU_Address@KINP_AGSErr_enum_ovrdflg@ */ Scalar_BOOLEAN 0 SWC_INP_type_CM_boolean_flg 0.0 1.0 /end CHARACTERISTIC
/begin CHARACTERISTIC KINP_BDAPMWinFOpenedSta_pct_ovrdflg "" VALUE 0x0000 /* @ECU_Address@KINP_BDAPMWinFOpenedSta_pct_ovrdflg@ */ Scalar_BOOLEAN 0 SWC_INP_type_CM_boolean_flg 0.0 1.0 /end CHARACTERISTIC
/begin CHARACTERISTIC KINP_BDAPMWinROpenedSta_pct_ovrdflg "" VALUE 0x0000 /* @ECU_Address@KINP_BDAPMWinROpenedSta_pct_ovrdflg@ */ Scalar_BOOLEAN 0 SWC_INP_type_CM_boolean_flg 0.0 1.0 /end CHARACTERISTIC
/begin CHARACTERISTIC KINP_BDDSEATAntiSta_flg_defval "" VALUE 0x0000 /* @ECU_Address@KINP_BDDSEATAntiSta_flg_defval@ */ Scalar_BOOLEAN 0 SWC_INP_type_CM_boolean_flg 0.0 1.0 /end CHARACTERISTIC
/begin CHARACTERISTIC KINP_BDDSEATAntiSta_flg_ovrdflg "" VALUE 0x0000 /* @ECU_Address@KINP_BDDSEATAntiSta_flg_ovrdflg@ */ Scalar_BOOLEAN 0 SWC_INP_type_CM_boolean_flg 0.0 1.0 /end CHARACTERISTIC
/begin CHARACTERISTIC KINP_BDDSEATAntiSta_flg_ovrdval "" VALUE 0x0000 /* @ECU_Address@KINP_BDDSEATAntiSta_flg_ovrdval@ */ Scalar_BOOLEAN 0 SWC_INP_type_CM_boolean_flg 0.0 1.0 /end CHARACTERISTIC
/begin CHARACTERISTIC KINP_BDDSEATEntryFunSta_flg_defval "" VALUE 0x0000 /* @ECU_Address@KINP_BDDSEATEntryFunSta_flg_defval@ */ Scalar_BOOLEAN 0 SWC_INP_type_CM_boolean_flg 0.0 1.0 /end CHARACTERISTIC
/begin CHARACTERISTIC KINP_BDDSEATEntryFunSta_flg_ovrdflg "" VALUE 0x0000 /* @ECU_Address@KINP_BDDSEATEntryFunSta_flg_ovrdflg@ */ Scalar_BOOLEAN 0 SWC_INP_type_CM_boolean_flg 0.0 1.0 /end CHARACTERISTIC
/begin CHARACTERISTIC KINP_BDDSEATEntryFunSta_flg_ovrdval "" VALUE 0x0000 /* @ECU_Address@KINP_BDDSEATEntryFunSta_flg_ovrdval@ */ Scalar_BOOLEAN 0 SWC_INP_type_CM_boolean_flg 0.0 1.0 /end CHARACTERISTIC
/begin CHARACTERISTIC KINP_BDDSEATErrorSta_flg_defval "" VALUE 0x0000 /* @ECU_Address@KINP_BDDSEATErrorSta_flg_defval@ */ Scalar_BOOLEAN 0 SWC_INP_type_CM_boolean_flg 0.0 1.0 /end CHARACTERISTIC
/begin CHARACTERISTIC KINP_BDDSEATErrorSta_flg_ovrdflg "" VALUE 0x0000 /* @ECU_Address@KINP_BDDSEATErrorSta_flg_ovrdflg@ */ Scalar_BOOLEAN 0 SWC_INP_type_CM_boolean_flg 0.0 1.0 /end CHARACTERISTIC
/begin CHARACTERISTIC KINP_BDDSEATErrorSta_flg_ovrdval "" VALUE 0x0000 /* @ECU_Address@KINP_BDDSEATErrorSta_flg_ovrdval@ */ Scalar_BOOLEAN 0 SWC_INP_type_CM_boolean_flg 0.0 1.0 /end CHARACTERISTIC
/begin CHARACTERISTIC KINP_BDDSEATMemSetSta_enum_ovrdflg "" VALUE 0x0000 /* @ECU_Address@KINP_BDDSEATMemSetSta_enum_ovrdflg@ */ Scalar_BOOLEAN 0 SWC_INP_type_CM_boolean_flg 0.0 1.0 /end CHARACTERISTIC
/begin CHARACTERISTIC KINP_BDDSEATModeSta_enum_ovrdflg "" VALUE 0x0000 /* @ECU_Address@KINP_BDDSEATModeSta_enum_ovrdflg@ */ Scalar_BOOLEAN 0 SWC_INP_type_CM_boolean_flg 0.0 1.0 /end CHARACTERISTIC
/begin CHARACTERISTIC KINP_BDDSEATVentSta_enum_ovrdflg "" VALUE 0x0000 /* @ECU_Address@KINP_BDDSEATVentSta_enum_ovrdflg@ */ Scalar_BOOLEAN 0 SWC_INP_type_CM_boolean_flg 0.0 1.0 /end CHARACTERISTIC
/begin CHARACTERISTIC KINP_BDDSEATheaterSta_enum_ovrdflg "" VALUE 0x0000 /* @ECU_Address@KINP_BDDSEATheaterSta_enum_ovrdflg@ */ Scalar_BOOLEAN 0 SWC_INP_type_CM_boolean_flg 0.0 1.0 /end CHARACTERISTIC
/begin CHARACTERISTIC KINP_BDDoorFHandleCloseSta_flg_defval "" VALUE 0x0000 /* @ECU_Address@KINP_BDDoorFHandleCloseSta_flg_defval@ */ Scalar_BOOLEAN 0 SWC_INP_type_CM_boolean_flg 0.0 1.0 /end CHARACTERISTIC
/begin CHARACTERISTIC KINP_BDDoorFHandleCloseSta_flg_ovrdflg "" VALUE 0x0000 /* @ECU_Address@KINP_BDDoorFHandleCloseSta_flg_ovrdflg@ */ Scalar_BOOLEAN 0 SWC_INP_type_CM_boolean_flg 0.0 1.0 /end CHARACTERISTIC
/begin CHARACTERISTIC KINP_BDDoorFHandleCloseSta_flg_ovrdval "" VALUE 0x0000 /* @ECU_Address@KINP_BDDoorFHandleCloseSta_flg_ovrdval@ */ Scalar_BOOLEAN 0 SWC_INP_type_CM_boolean_flg 0.0 1.0 /end CHARACTERISTIC
/begin CHARACTERISTIC KINP_BDDoorRHandleCloseSta_flg_defval "" VALUE 0x0000 /* @ECU_Address@KINP_BDDoorRHandleCloseSta_flg_defval@ */ Scalar_BOOLEAN 0 SWC_INP_type_CM_boolean_flg 0.0 1.0 /end CHARACTERISTIC
/begin CHARACTERISTIC KINP_BDDoorRHandleCloseSta_flg_ovrdflg "" VALUE 0x0000 /* @ECU_Address@KINP_BDDoorRHandleCloseSta_flg_ovrdflg@ */ Scalar_BOOLEAN 0 SWC_INP_type_CM_boolean_flg 0.0 1.0 /end CHARACTERISTIC
/begin CHARACTERISTIC KINP_BDDoorRHandleCloseSta_flg_ovrdval "" VALUE 0x0000 /* @ECU_Address@KINP_BDDoorRHandleCloseSta_flg_ovrdval@ */ Scalar_BOOLEAN 0 SWC_INP_type_CM_boolean_flg 0.0 1.0 /end CHARACTERISTIC
/begin CHARACTERISTIC KINP_BPAPMWinFOpenedSta_pct_ovrdflg "" VALUE 0x0000 /* @ECU_Address@KINP_BPAPMWinFOpenedSta_pct_ovrdflg@ */ Scalar_BOOLEAN 0 SWC_INP_type_CM_boolean_flg 0.0 1.0 /end CHARACTERISTIC
/begin CHARACTERISTIC KINP_BPAPMWinROpenedSta_pct_ovrdflg "" VALUE 0x0000 /* @ECU_Address@KINP_BPAPMWinROpenedSta_pct_ovrdflg@ */ Scalar_BOOLEAN 0 SWC_INP_type_CM_boolean_flg 0.0 1.0 /end CHARACTERISTIC
/begin CHARACTERISTIC KINP_BPDoorFHandleCloseSta_flg_defval "" VALUE 0x0000 /* @ECU_Address@KINP_BPDoorFHandleCloseSta_flg_defval@ */ Scalar_BOOLEAN 0 SWC_INP_type_CM_boolean_flg 0.0 1.0 /end CHARACTERISTIC
/begin CHARACTERISTIC KINP_BPDoorFHandleCloseSta_flg_ovrdflg "" VALUE 0x0000 /* @ECU_Address@KINP_BPDoorFHandleCloseSta_flg_ovrdflg@ */ Scalar_BOOLEAN 0 SWC_INP_type_CM_boolean_flg 0.0 1.0 /end CHARACTERISTIC
/begin CHARACTERISTIC KINP_BPDoorFHandleCloseSta_flg_ovrdval "" VALUE 0x0000 /* @ECU_Address@KINP_BPDoorFHandleCloseSta_flg_ovrdval@ */ Scalar_BOOLEAN 0 SWC_INP_type_CM_boolean_flg 0.0 1.0 /end CHARACTERISTIC
/begin CHARACTERISTIC KINP_BPDoorRHandleCloseSta_flg_defval "" VALUE 0x0000 /* @ECU_Address@KINP_BPDoorRHandleCloseSta_flg_defval@ */ Scalar_BOOLEAN 0 SWC_INP_type_CM_boolean_flg 0.0 1.0 /end CHARACTERISTIC
/begin CHARACTERISTIC KINP_BPDoorRHandleCloseSta_flg_ovrdflg "" VALUE 0x0000 /* @ECU_Address@KINP_BPDoorRHandleCloseSta_flg_ovrdflg@ */ Scalar_BOOLEAN 0 SWC_INP_type_CM_boolean_flg 0.0 1.0 /end CHARACTERISTIC
/begin CHARACTERISTIC KINP_BPDoorRHandleCloseSta_flg_ovrdval "" VALUE 0x0000 /* @ECU_Address@KINP_BPDoorRHandleCloseSta_flg_ovrdval@ */ Scalar_BOOLEAN 0 SWC_INP_type_CM_boolean_flg 0.0 1.0 /end CHARACTERISTIC
/begin CHARACTERISTIC KINP_BPPSEATErrorSta_flg_defval "" VALUE 0x0000 /* @ECU_Address@KINP_BPPSEATErrorSta_flg_defval@ */ Scalar_BOOLEAN 0 SWC_INP_type_CM_boolean_flg 0.0 1.0 /end CHARACTERISTIC
/begin CHARACTERISTIC KINP_BPPSEATErrorSta_flg_ovrdflg "" VALUE 0x0000 /* @ECU_Address@KINP_BPPSEATErrorSta_flg_ovrdflg@ */ Scalar_BOOLEAN 0 SWC_INP_type_CM_boolean_flg 0.0 1.0 /end CHARACTERISTIC
/begin CHARACTERISTIC KINP_BPPSEATErrorSta_flg_ovrdval "" VALUE 0x0000 /* @ECU_Address@KINP_BPPSEATErrorSta_flg_ovrdval@ */ Scalar_BOOLEAN 0 SWC_INP_type_CM_boolean_flg 0.0 1.0 /end CHARACTERISTIC
/begin CHARACTERISTIC KINP_BPPSEATModeSta_enum_ovrdflg "" VALUE 0x0000 /* @ECU_Address@KINP_BPPSEATModeSta_enum_ovrdflg@ */ Scalar_BOOLEAN 0 SWC_INP_type_CM_boolean_flg 0.0 1.0 /end CHARACTERISTIC
/begin CHARACTERISTIC KINP_BPPSEATVentSta_enum_ovrdflg "" VALUE 0x0000 /* @ECU_Address@KINP_BPPSEATVentSta_enum_ovrdflg@ */ Scalar_BOOLEAN 0 SWC_INP_type_CM_boolean_flg 0.0 1.0 /end CHARACTERISTIC
/begin CHARACTERISTIC KINP_BPPSEATheaterSta_enum_ovrdflg "" VALUE 0x0000 /* @ECU_Address@KINP_BPPSEATheaterSta_enum_ovrdflg@ */ Scalar_BOOLEAN 0 SWC_INP_type_CM_boolean_flg 0.0 1.0 /end CHARACTERISTIC
/begin CHARACTERISTIC KINP_BPPTGActiveSta_enum_ovrdflg "" VALUE 0x0000 /* @ECU_Address@KINP_BPPTGActiveSta_enum_ovrdflg@ */ Scalar_BOOLEAN 0 SWC_INP_type_CM_boolean_flg 0.0 1.0 /end CHARACTERISTIC
/begin CHARACTERISTIC KINP_BPPTGExistSta_flg_defval "" VALUE 0x0000 /* @ECU_Address@KINP_BPPTGExistSta_flg_defval@ */ Scalar_BOOLEAN 0 SWC_INP_type_CM_boolean_flg 0.0 1.0 /end CHARACTERISTIC
/begin CHARACTERISTIC KINP_BPPTGExistSta_flg_ovrdflg "" VALUE 0x0000 /* @ECU_Address@KINP_BPPTGExistSta_flg_ovrdflg@ */ Scalar_BOOLEAN 0 SWC_INP_type_CM_boolean_flg 0.0 1.0 /end CHARACTERISTIC
/begin CHARACTERISTIC KINP_BPPTGExistSta_flg_ovrdval "" VALUE 0x0000 /* @ECU_Address@KINP_BPPTGExistSta_flg_ovrdval@ */ Scalar_BOOLEAN 0 SWC_INP_type_CM_boolean_flg 0.0 1.0 /end CHARACTERISTIC
/begin CHARACTERISTIC KINP_BPPTGInsideSW1Sta_enum_ovrdflg "" VALUE 0x0000 /* @ECU_Address@KINP_BPPTGInsideSW1Sta_enum_ovrdflg@ */ Scalar_BOOLEAN 0 SWC_INP_type_CM_boolean_flg 0.0 1.0 /end CHARACTERISTIC
/begin CHARACTERISTIC KINP_BPPTGInsideSW2Sta_enum_ovrdflg "" VALUE 0x0000 /* @ECU_Address@KINP_BPPTGInsideSW2Sta_enum_ovrdflg@ */ Scalar_BOOLEAN 0 SWC_INP_type_CM_boolean_flg 0.0 1.0 /end CHARACTERISTIC
/begin CHARACTERISTIC KINP_BPPTGIsSetHeightSta_flg_defval "" VALUE 0x0000 /* @ECU_Address@KINP_BPPTGIsSetHeightSta_flg_defval@ */ Scalar_BOOLEAN 0 SWC_INP_type_CM_boolean_flg 0.0 1.0 /end CHARACTERISTIC
/begin CHARACTERISTIC KINP_BPPTGIsSetHeightSta_flg_ovrdflg "" VALUE 0x0000 /* @ECU_Address@KINP_BPPTGIsSetHeightSta_flg_ovrdflg@ */ Scalar_BOOLEAN 0 SWC_INP_type_CM_boolean_flg 0.0 1.0 /end CHARACTERISTIC
/begin CHARACTERISTIC KINP_BPPTGIsSetHeightSta_flg_ovrdval "" VALUE 0x0000 /* @ECU_Address@KINP_BPPTGIsSetHeightSta_flg_ovrdval@ */ Scalar_BOOLEAN 0 SWC_INP_type_CM_boolean_flg 0.0 1.0 /end CHARACTERISTIC
/begin CHARACTERISTIC KINP_BPPTGLeftHallPosnSta_enum_ovrdflg "" VALUE 0x0000 /* @ECU_Address@KINP_BPPTGLeftHallPosnSta_enum_ovrdflg@ */ Scalar_BOOLEAN 0 SWC_INP_type_CM_boolean_flg 0.0 1.0 /end CHARACTERISTIC
/begin CHARACTERISTIC KINP_BPPTGOpenRatioSta_pct_ovrdflg "" VALUE 0x0000 /* @ECU_Address@KINP_BPPTGOpenRatioSta_pct_ovrdflg@ */ Scalar_BOOLEAN 0 SWC_INP_type_CM_boolean_flg 0.0 1.0 /end CHARACTERISTIC
/begin CHARACTERISTIC KINP_BPPTGRDILCmd_enum_ovrdflg "" VALUE 0x0000 /* @ECU_Address@KINP_BPPTGRDILCmd_enum_ovrdflg@ */ Scalar_BOOLEAN 0 SWC_INP_type_CM_boolean_flg 0.0 1.0 /end CHARACTERISTIC
/begin CHARACTERISTIC KINP_BPPTGSysSta_enum_ovrdflg "" VALUE 0x0000 /* @ECU_Address@KINP_BPPTGSysSta_enum_ovrdflg@ */ Scalar_BOOLEAN 0 SWC_INP_type_CM_boolean_flg 0.0 1.0 /end CHARACTERISTIC
/begin CHARACTERISTIC KINP_BPSEATLVentSta_enum_ovrdflg "" VALUE 0x0000 /* @ECU_Address@KINP_BPSEATLVentSta_enum_ovrdflg@ */ Scalar_BOOLEAN 0 SWC_INP_type_CM_boolean_flg 0.0 1.0 /end CHARACTERISTIC
/begin CHARACTERISTIC KINP_BPSEATMLVentSta_enum_ovrdflg "" VALUE 0x0000 /* @ECU_Address@KINP_BPSEATMLVentSta_enum_ovrdflg@ */ Scalar_BOOLEAN 0 SWC_INP_type_CM_boolean_flg 0.0 1.0 /end CHARACTERISTIC
/begin CHARACTERISTIC KINP_BPSEATMRVentSta_enum_ovrdflg "" VALUE 0x0000 /* @ECU_Address@KINP_BPSEATMRVentSta_enum_ovrdflg@ */ Scalar_BOOLEAN 0 SWC_INP_type_CM_boolean_flg 0.0 1.0 /end CHARACTERISTIC
/begin CHARACTERISTIC KINP_BPSEATRVentSta_enum_ovrdflg "" VALUE 0x0000 /* @ECU_Address@KINP_BPSEATRVentSta_enum_ovrdflg@ */ Scalar_BOOLEAN 0 SWC_INP_type_CM_boolean_flg 0.0 1.0 /end CHARACTERISTIC
/begin CHARACTERISTIC KINP_BatInTempErr_enum_ovrdflg "" VALUE 0x0000 /* @ECU_Address@KINP_BatInTempErr_enum_ovrdflg@ */ Scalar_BOOLEAN 0 SWC_INP_type_CM_boolean_flg 0.0 1.0 /end CHARACTERISTIC
/begin CHARACTERISTIC KINP_BatInTemp_C_ovrdflg "" VALUE 0x0000 /* @ECU_Address@KINP_BatInTemp_C_ovrdflg@ */ Scalar_BOOLEAN 0 SWC_INP_type_CM_boolean_flg 0.0 1.0 /end CHARACTERISTIC
/begin CHARACTERISTIC KINP_BatOutTemp_C_ovrdflg "" VALUE 0x0000 /* @ECU_Address@KINP_BatOutTemp_C_ovrdflg@ */ Scalar_BOOLEAN 0 SWC_INP_type_CM_boolean_flg 0.0 1.0 /end CHARACTERISTIC
/begin CHARACTERISTIC KINP_BlowerErr_enum_ovrdflg "" VALUE 0x0000 /* @ECU_Address@KINP_BlowerErr_enum_ovrdflg@ */ Scalar_BOOLEAN 0 SWC_INP_type_CM_boolean_flg 0.0 1.0 /end CHARACTERISTIC
/begin CHARACTERISTIC KINP_COMPErr_enum_ovrdflg "" VALUE 0x0000 /* @ECU_Address@KINP_COMPErr_enum_ovrdflg@ */ Scalar_BOOLEAN 0 SWC_INP_type_CM_boolean_flg 0.0 1.0 /end CHARACTERISTIC
/begin CHARACTERISTIC KINP_CSW2DimSwSta_flg_defval "" VALUE 0x0000 /* @ECU_Address@KINP_CSW2DimSwSta_flg_defval@ */ Scalar_BOOLEAN 0 SWC_INP_type_CM_boolean_flg 0.0 1.0 /end CHARACTERISTIC
/begin CHARACTERISTIC KINP_CSW2DimSwSta_flg_ovrdflg "" VALUE 0x0000 /* @ECU_Address@KINP_CSW2DimSwSta_flg_ovrdflg@ */ Scalar_BOOLEAN 0 SWC_INP_type_CM_boolean_flg 0.0 1.0 /end CHARACTERISTIC
/begin CHARACTERISTIC KINP_CSW2DimSwSta_flg_ovrdval "" VALUE 0x0000 /* @ECU_Address@KINP_CSW2DimSwSta_flg_ovrdval@ */ Scalar_BOOLEAN 0 SWC_INP_type_CM_boolean_flg 0.0 1.0 /end CHARACTERISTIC
/begin CHARACTERISTIC KINP_CSW2FWasSwSta_enum_ovrdflg "" VALUE 0x0000 /* @ECU_Address@KINP_CSW2FWasSwSta_enum_ovrdflg@ */ Scalar_BOOLEAN 0 SWC_INP_type_CM_boolean_flg 0.0 1.0 /end CHARACTERISTIC
/begin CHARACTERISTIC KINP_CSW2FWipSwSta_enum_ovrdflg "" VALUE 0x0000 /* @ECU_Address@KINP_CSW2FWipSwSta_enum_ovrdflg@ */ Scalar_BOOLEAN 0 SWC_INP_type_CM_boolean_flg 0.0 1.0 /end CHARACTERISTIC
/begin CHARACTERISTIC KINP_CSW2PassSWSta_flg_defval "" VALUE 0x0000 /* @ECU_Address@KINP_CSW2PassSWSta_flg_defval@ */ Scalar_BOOLEAN 0 SWC_INP_type_CM_boolean_flg 0.0 1.0 /end CHARACTERISTIC
/begin CHARACTERISTIC KINP_CSW2PassSWSta_flg_ovrdflg "" VALUE 0x0000 /* @ECU_Address@KINP_CSW2PassSWSta_flg_ovrdflg@ */ Scalar_BOOLEAN 0 SWC_INP_type_CM_boolean_flg 0.0 1.0 /end CHARACTERISTIC
/begin CHARACTERISTIC KINP_CSW2PassSWSta_flg_ovrdval "" VALUE 0x0000 /* @ECU_Address@KINP_CSW2PassSWSta_flg_ovrdval@ */ Scalar_BOOLEAN 0 SWC_INP_type_CM_boolean_flg 0.0 1.0 /end CHARACTERISTIC
/begin CHARACTERISTIC KINP_CSW2RWipWasSwSta_enum_ovrdflg "" VALUE 0x0000 /* @ECU_Address@KINP_CSW2RWipWasSwSta_enum_ovrdflg@ */ Scalar_BOOLEAN 0 SWC_INP_type_CM_boolean_flg 0.0 1.0 /end CHARACTERISTIC
/begin CHARACTERISTIC KINP_CSW2TurnSwSta_enum_ovrdflg "" VALUE 0x0000 /* @ECU_Address@KINP_CSW2TurnSwSta_enum_ovrdflg@ */ Scalar_BOOLEAN 0 SWC_INP_type_CM_boolean_flg 0.0 1.0 /end CHARACTERISTIC
/begin CHARACTERISTIC KINP_ChargeInletLockSta_flg_defval "" VALUE 0x0000 /* @ECU_Address@KINP_ChargeInletLockSta_flg_defval@ */ Scalar_BOOLEAN 0 SWC_INP_type_CM_boolean_flg 0.0 1.0 /end CHARACTERISTIC
/begin CHARACTERISTIC KINP_ChargeInletLockSta_flg_ovrdflg "" VALUE 0x0000 /* @ECU_Address@KINP_ChargeInletLockSta_flg_ovrdflg@ */ Scalar_BOOLEAN 0 SWC_INP_type_CM_boolean_flg 0.0 1.0 /end CHARACTERISTIC
/begin CHARACTERISTIC KINP_ChargeInletLockSta_flg_ovrdval "" VALUE 0x0000 /* @ECU_Address@KINP_ChargeInletLockSta_flg_ovrdval@ */ Scalar_BOOLEAN 0 SWC_INP_type_CM_boolean_flg 0.0 1.0 /end CHARACTERISTIC
/begin CHARACTERISTIC KINP_CompProEN_flg_defval "" VALUE 0x0000 /* @ECU_Address@KINP_CompProEN_flg_defval@ */ Scalar_BOOLEAN 0 SWC_INP_type_CM_boolean_flg 0.0 1.0 /end CHARACTERISTIC
/begin CHARACTERISTIC KINP_CompProEN_flg_ovrdflg "" VALUE 0x0000 /* @ECU_Address@KINP_CompProEN_flg_ovrdflg@ */ Scalar_BOOLEAN 0 SWC_INP_type_CM_boolean_flg 0.0 1.0 /end CHARACTERISTIC
/begin CHARACTERISTIC KINP_CompProEN_flg_ovrdval "" VALUE 0x0000 /* @ECU_Address@KINP_CompProEN_flg_ovrdval@ */ Scalar_BOOLEAN 0 SWC_INP_type_CM_boolean_flg 0.0 1.0 /end CHARACTERISTIC
/begin CHARACTERISTIC KINP_DKCKeyNumSta_enum_ovrdflg "" VALUE 0x0000 /* @ECU_Address@KINP_DKCKeyNumSta_enum_ovrdflg@ */ Scalar_BOOLEAN 0 SWC_INP_type_CM_boolean_flg 0.0 1.0 /end CHARACTERISTIC
/begin CHARACTERISTIC KINP_DKCKeyTypeSta_enum_ovrdflg "" VALUE 0x0000 /* @ECU_Address@KINP_DKCKeyTypeSta_enum_ovrdflg@ */ Scalar_BOOLEAN 0 SWC_INP_type_CM_boolean_flg 0.0 1.0 /end CHARACTERISTIC
/begin CHARACTERISTIC KINP_DKCPDkeyAreaRAPSSta_enum_ovrdflg "" VALUE 0x0000 /* @ECU_Address@KINP_DKCPDkeyAreaRAPSSta_enum_ovrdflg@ */ Scalar_BOOLEAN 0 SWC_INP_type_CM_boolean_flg 0.0 1.0 /end CHARACTERISTIC
/begin CHARACTERISTIC KINP_DKCParkingModeCmd_enum_ovrdflg "" VALUE 0x0000 /* @ECU_Address@KINP_DKCParkingModeCmd_enum_ovrdflg@ */ Scalar_BOOLEAN 0 SWC_INP_type_CM_boolean_flg 0.0 1.0 /end CHARACTERISTIC
/begin CHARACTERISTIC KINP_DKCReVehData_enum_ovrdflg "" VALUE 0x0000 /* @ECU_Address@KINP_DKCReVehData_enum_ovrdflg@ */ Scalar_BOOLEAN 0 SWC_INP_type_CM_boolean_flg 0.0 1.0 /end CHARACTERISTIC
/begin CHARACTERISTIC KINP_DrLockSta_flg_defval "" VALUE 0x0000 /* @ECU_Address@KINP_DrLockSta_flg_defval@ */ Scalar_BOOLEAN 0 SWC_INP_type_CM_boolean_flg 0.0 1.0 /end CHARACTERISTIC
/begin CHARACTERISTIC KINP_DrLockSta_flg_ovrdflg "" VALUE 0x0000 /* @ECU_Address@KINP_DrLockSta_flg_ovrdflg@ */ Scalar_BOOLEAN 0 SWC_INP_type_CM_boolean_flg 0.0 1.0 /end CHARACTERISTIC
/begin CHARACTERISTIC KINP_DrLockSta_flg_ovrdval "" VALUE 0x0000 /* @ECU_Address@KINP_DrLockSta_flg_ovrdval@ */ Scalar_BOOLEAN 0 SWC_INP_type_CM_boolean_flg 0.0 1.0 /end CHARACTERISTIC
/begin CHARACTERISTIC KINP_DrPMMLVOutPErrLmp_flg_defval "" VALUE 0x0000 /* @ECU_Address@KINP_DrPMMLVOutPErrLmp_flg_defval@ */ Scalar_BOOLEAN 0 SWC_INP_type_CM_boolean_flg 0.0 1.0 /end CHARACTERISTIC
/begin CHARACTERISTIC KINP_DrPMMLVOutPErrLmp_flg_ovrdflg "" VALUE 0x0000 /* @ECU_Address@KINP_DrPMMLVOutPErrLmp_flg_ovrdflg@ */ Scalar_BOOLEAN 0 SWC_INP_type_CM_boolean_flg 0.0 1.0 /end CHARACTERISTIC
/begin CHARACTERISTIC KINP_DrPMMLVOutPErrLmp_flg_ovrdval "" VALUE 0x0000 /* @ECU_Address@KINP_DrPMMLVOutPErrLmp_flg_ovrdval@ */ Scalar_BOOLEAN 0 SWC_INP_type_CM_boolean_flg 0.0 1.0 /end CHARACTERISTIC
/begin CHARACTERISTIC KINP_DrPMMSysErrLmp_flg_defval "" VALUE 0x0000 /* @ECU_Address@KINP_DrPMMSysErrLmp_flg_defval@ */ Scalar_BOOLEAN 0 SWC_INP_type_CM_boolean_flg 0.0 1.0 /end CHARACTERISTIC
/begin CHARACTERISTIC KINP_DrPMMSysErrLmp_flg_ovrdflg "" VALUE 0x0000 /* @ECU_Address@KINP_DrPMMSysErrLmp_flg_ovrdflg@ */ Scalar_BOOLEAN 0 SWC_INP_type_CM_boolean_flg 0.0 1.0 /end CHARACTERISTIC
/begin CHARACTERISTIC KINP_DrPMMSysErrLmp_flg_ovrdval "" VALUE 0x0000 /* @ECU_Address@KINP_DrPMMSysErrLmp_flg_ovrdval@ */ Scalar_BOOLEAN 0 SWC_INP_type_CM_boolean_flg 0.0 1.0 /end CHARACTERISTIC
/begin CHARACTERISTIC KINP_DrSCPSysErrLmp_flg_defval "" VALUE 0x0000 /* @ECU_Address@KINP_DrSCPSysErrLmp_flg_defval@ */ Scalar_BOOLEAN 0 SWC_INP_type_CM_boolean_flg 0.0 1.0 /end CHARACTERISTIC
/begin CHARACTERISTIC KINP_DrSCPSysErrLmp_flg_ovrdflg "" VALUE 0x0000 /* @ECU_Address@KINP_DrSCPSysErrLmp_flg_ovrdflg@ */ Scalar_BOOLEAN 0 SWC_INP_type_CM_boolean_flg 0.0 1.0 /end CHARACTERISTIC
/begin CHARACTERISTIC KINP_DrSCPSysErrLmp_flg_ovrdval "" VALUE 0x0000 /* @ECU_Address@KINP_DrSCPSysErrLmp_flg_ovrdval@ */ Scalar_BOOLEAN 0 SWC_INP_type_CM_boolean_flg 0.0 1.0 /end CHARACTERISTIC
/begin CHARACTERISTIC KINP_DrStdAErrSta_flg_defval "" VALUE 0x0000 /* @ECU_Address@KINP_DrStdAErrSta_flg_defval@ */ Scalar_BOOLEAN 0 SWC_INP_type_CM_boolean_flg 0.0 1.0 /end CHARACTERISTIC
/begin CHARACTERISTIC KINP_DrStdAErrSta_flg_ovrdflg "" VALUE 0x0000 /* @ECU_Address@KINP_DrStdAErrSta_flg_ovrdflg@ */ Scalar_BOOLEAN 0 SWC_INP_type_CM_boolean_flg 0.0 1.0 /end CHARACTERISTIC
/begin CHARACTERISTIC KINP_DrStdAErrSta_flg_ovrdval "" VALUE 0x0000 /* @ECU_Address@KINP_DrStdAErrSta_flg_ovrdval@ */ Scalar_BOOLEAN 0 SWC_INP_type_CM_boolean_flg 0.0 1.0 /end CHARACTERISTIC
/begin CHARACTERISTIC KINP_EACProtectEnable_enum_ovrdflg "" VALUE 0x0000 /* @ECU_Address@KINP_EACProtectEnable_enum_ovrdflg@ */ Scalar_BOOLEAN 0 SWC_INP_type_CM_boolean_flg 0.0 1.0 /end CHARACTERISTIC
/begin CHARACTERISTIC KINP_EWP3Err_enum_ovrdflg "" VALUE 0x0000 /* @ECU_Address@KINP_EWP3Err_enum_ovrdflg@ */ Scalar_BOOLEAN 0 SWC_INP_type_CM_boolean_flg 0.0 1.0 /end CHARACTERISTIC
/begin CHARACTERISTIC KINP_EXV1Err_enum_ovrdflg "" VALUE 0x0000 /* @ECU_Address@KINP_EXV1Err_enum_ovrdflg@ */ Scalar_BOOLEAN 0 SWC_INP_type_CM_boolean_flg 0.0 1.0 /end CHARACTERISTIC
/begin CHARACTERISTIC KINP_EXV2Err_enum_ovrdflg "" VALUE 0x0000 /* @ECU_Address@KINP_EXV2Err_enum_ovrdflg@ */ Scalar_BOOLEAN 0 SWC_INP_type_CM_boolean_flg 0.0 1.0 /end CHARACTERISTIC
/begin CHARACTERISTIC KINP_EncryptionDATA063_enum_ovrdflg "" VALUE 0x0000 /* @ECU_Address@KINP_EncryptionDATA063_enum_ovrdflg@ */ Scalar_BOOLEAN 0 SWC_INP_type_CM_boolean_flg 0.0 1.0 /end CHARACTERISTIC
/begin CHARACTERISTIC KINP_EncryptionDATA64127_enum_ovrdflg "" VALUE 0x0000 /* @ECU_Address@KINP_EncryptionDATA64127_enum_ovrdflg@ */ Scalar_BOOLEAN 0 SWC_INP_type_CM_boolean_flg 0.0 1.0 /end CHARACTERISTIC
/begin CHARACTERISTIC KINP_FLTurnLPErr_flg_defval "" VALUE 0x0000 /* @ECU_Address@KINP_FLTurnLPErr_flg_defval@ */ Scalar_BOOLEAN 0 SWC_INP_type_CM_boolean_flg 0.0 1.0 /end CHARACTERISTIC
/begin CHARACTERISTIC KINP_FLTurnLPErr_flg_ovrdflg "" VALUE 0x0000 /* @ECU_Address@KINP_FLTurnLPErr_flg_ovrdflg@ */ Scalar_BOOLEAN 0 SWC_INP_type_CM_boolean_flg 0.0 1.0 /end CHARACTERISTIC
/begin CHARACTERISTIC KINP_FLTurnLPErr_flg_ovrdval "" VALUE 0x0000 /* @ECU_Address@KINP_FLTurnLPErr_flg_ovrdval@ */ Scalar_BOOLEAN 0 SWC_INP_type_CM_boolean_flg 0.0 1.0 /end CHARACTERISTIC
/begin CHARACTERISTIC KINP_FLTurnLampC_mA_ovrdflg "" VALUE 0x0000 /* @ECU_Address@KINP_FLTurnLampC_mA_ovrdflg@ */ Scalar_BOOLEAN 0 SWC_INP_type_CM_boolean_flg 0.0 1.0 /end CHARACTERISTIC
/begin CHARACTERISTIC KINP_FLTurnLightWarning_flg_defval "" VALUE 0x0000 /* @ECU_Address@KINP_FLTurnLightWarning_flg_defval@ */ Scalar_BOOLEAN 0 SWC_INP_type_CM_boolean_flg 0.0 1.0 /end CHARACTERISTIC
/begin CHARACTERISTIC KINP_FLTurnLightWarning_flg_ovrdflg "" VALUE 0x0000 /* @ECU_Address@KINP_FLTurnLightWarning_flg_ovrdflg@ */ Scalar_BOOLEAN 0 SWC_INP_type_CM_boolean_flg 0.0 1.0 /end CHARACTERISTIC
/begin CHARACTERISTIC KINP_FLTurnLightWarning_flg_ovrdval "" VALUE 0x0000 /* @ECU_Address@KINP_FLTurnLightWarning_flg_ovrdval@ */ Scalar_BOOLEAN 0 SWC_INP_type_CM_boolean_flg 0.0 1.0 /end CHARACTERISTIC
/begin CHARACTERISTIC KINP_FRTurnLPErr_flg_defval "" VALUE 0x0000 /* @ECU_Address@KINP_FRTurnLPErr_flg_defval@ */ Scalar_BOOLEAN 0 SWC_INP_type_CM_boolean_flg 0.0 1.0 /end CHARACTERISTIC
/begin CHARACTERISTIC KINP_FRTurnLPErr_flg_ovrdflg "" VALUE 0x0000 /* @ECU_Address@KINP_FRTurnLPErr_flg_ovrdflg@ */ Scalar_BOOLEAN 0 SWC_INP_type_CM_boolean_flg 0.0 1.0 /end CHARACTERISTIC
/begin CHARACTERISTIC KINP_FRTurnLPErr_flg_ovrdval "" VALUE 0x0000 /* @ECU_Address@KINP_FRTurnLPErr_flg_ovrdval@ */ Scalar_BOOLEAN 0 SWC_INP_type_CM_boolean_flg 0.0 1.0 /end CHARACTERISTIC
/begin CHARACTERISTIC KINP_FRTurnLampC_mA_ovrdflg "" VALUE 0x0000 /* @ECU_Address@KINP_FRTurnLampC_mA_ovrdflg@ */ Scalar_BOOLEAN 0 SWC_INP_type_CM_boolean_flg 0.0 1.0 /end CHARACTERISTIC
/begin CHARACTERISTIC KINP_FRTurnLightWarning_flg_defval "" VALUE 0x0000 /* @ECU_Address@KINP_FRTurnLightWarning_flg_defval@ */ Scalar_BOOLEAN 0 SWC_INP_type_CM_boolean_flg 0.0 1.0 /end CHARACTERISTIC
/begin CHARACTERISTIC KINP_FRTurnLightWarning_flg_ovrdflg "" VALUE 0x0000 /* @ECU_Address@KINP_FRTurnLightWarning_flg_ovrdflg@ */ Scalar_BOOLEAN 0 SWC_INP_type_CM_boolean_flg 0.0 1.0 /end CHARACTERISTIC
/begin CHARACTERISTIC KINP_FRTurnLightWarning_flg_ovrdval "" VALUE 0x0000 /* @ECU_Address@KINP_FRTurnLightWarning_flg_ovrdval@ */ Scalar_BOOLEAN 0 SWC_INP_type_CM_boolean_flg 0.0 1.0 /end CHARACTERISTIC
/begin CHARACTERISTIC KINP_FWiperAS_flg_defval "" VALUE 0x0000 /* @ECU_Address@KINP_FWiperAS_flg_defval@ */ Scalar_BOOLEAN 0 SWC_INP_type_CM_boolean_flg 0.0 1.0 /end CHARACTERISTIC
/begin CHARACTERISTIC KINP_FWiperAS_flg_ovrdflg "" VALUE 0x0000 /* @ECU_Address@KINP_FWiperAS_flg_ovrdflg@ */ Scalar_BOOLEAN 0 SWC_INP_type_CM_boolean_flg 0.0 1.0 /end CHARACTERISTIC
/begin CHARACTERISTIC KINP_FWiperAS_flg_ovrdval "" VALUE 0x0000 /* @ECU_Address@KINP_FWiperAS_flg_ovrdval@ */ Scalar_BOOLEAN 0 SWC_INP_type_CM_boolean_flg 0.0 1.0 /end CHARACTERISTIC
/begin CHARACTERISTIC KINP_FWiperProtection_flg_defval "" VALUE 0x0000 /* @ECU_Address@KINP_FWiperProtection_flg_defval@ */ Scalar_BOOLEAN 0 SWC_INP_type_CM_boolean_flg 0.0 1.0 /end CHARACTERISTIC
/begin CHARACTERISTIC KINP_FWiperProtection_flg_ovrdflg "" VALUE 0x0000 /* @ECU_Address@KINP_FWiperProtection_flg_ovrdflg@ */ Scalar_BOOLEAN 0 SWC_INP_type_CM_boolean_flg 0.0 1.0 /end CHARACTERISTIC
/begin CHARACTERISTIC KINP_FWiperProtection_flg_ovrdval "" VALUE 0x0000 /* @ECU_Address@KINP_FWiperProtection_flg_ovrdval@ */ Scalar_BOOLEAN 0 SWC_INP_type_CM_boolean_flg 0.0 1.0 /end CHARACTERISTIC
/begin CHARACTERISTIC KINP_FanErr_enum_ovrdflg "" VALUE 0x0000 /* @ECU_Address@KINP_FanErr_enum_ovrdflg@ */ Scalar_BOOLEAN 0 SWC_INP_type_CM_boolean_flg 0.0 1.0 /end CHARACTERISTIC
/begin CHARACTERISTIC KINP_FrFailcodehistory2Nidec_enum_ovrdflg "" VALUE 0x0000 /* @ECU_Address@KINP_FrFailcodehistory2Nidec_enum_ovrdflg@ */ Scalar_BOOLEAN 0 SWC_INP_type_CM_boolean_flg 0.0 1.0 /end CHARACTERISTIC
/begin CHARACTERISTIC KINP_FrLLCTempNidec_C_ovrdflg "" VALUE 0x0000 /* @ECU_Address@KINP_FrLLCTempNidec_C_ovrdflg@ */ Scalar_BOOLEAN 0 SWC_INP_type_CM_boolean_flg 0.0 1.0 /end CHARACTERISTIC
/begin CHARACTERISTIC KINP_FrLLCflowReqNidec_Lpmin_ovrdflg "" VALUE 0x0000 /* @ECU_Address@KINP_FrLLCflowReqNidec_Lpmin_ovrdflg@ */ Scalar_BOOLEAN 0 SWC_INP_type_CM_boolean_flg 0.0 1.0 /end CHARACTERISTIC
/begin CHARACTERISTIC KINP_FrMCUHWVerNidec_enum_ovrdflg "" VALUE 0x0000 /* @ECU_Address@KINP_FrMCUHWVerNidec_enum_ovrdflg@ */ Scalar_BOOLEAN 0 SWC_INP_type_CM_boolean_flg 0.0 1.0 /end CHARACTERISTIC
/begin CHARACTERISTIC KINP_FrMCUSWVerNidec_enum_ovrdflg "" VALUE 0x0000 /* @ECU_Address@KINP_FrMCUSWVerNidec_enum_ovrdflg@ */ Scalar_BOOLEAN 0 SWC_INP_type_CM_boolean_flg 0.0 1.0 /end CHARACTERISTIC
/begin CHARACTERISTIC KINP_FrMCUTempWarnNidec_enum_ovrdflg "" VALUE 0x0000 /* @ECU_Address@KINP_FrMCUTempWarnNidec_enum_ovrdflg@ */ Scalar_BOOLEAN 0 SWC_INP_type_CM_boolean_flg 0.0 1.0 /end CHARACTERISTIC
/begin CHARACTERISTIC KINP_FrPMMLimpHomeActReq_flg_defval "" VALUE 0x0000 /* @ECU_Address@KINP_FrPMMLimpHomeActReq_flg_defval@ */ Scalar_BOOLEAN 0 SWC_INP_type_CM_boolean_flg 0.0 1.0 /end CHARACTERISTIC
/begin CHARACTERISTIC KINP_FrPMMLimpHomeActReq_flg_ovrdflg "" VALUE 0x0000 /* @ECU_Address@KINP_FrPMMLimpHomeActReq_flg_ovrdflg@ */ Scalar_BOOLEAN 0 SWC_INP_type_CM_boolean_flg 0.0 1.0 /end CHARACTERISTIC
/begin CHARACTERISTIC KINP_FrPMMLimpHomeActReq_flg_ovrdval "" VALUE 0x0000 /* @ECU_Address@KINP_FrPMMLimpHomeActReq_flg_ovrdval@ */ Scalar_BOOLEAN 0 SWC_INP_type_CM_boolean_flg 0.0 1.0 /end CHARACTERISTIC
/begin CHARACTERISTIC KINP_FrTMTempWarnNidec_enum_ovrdflg "" VALUE 0x0000 /* @ECU_Address@KINP_FrTMTempWarnNidec_enum_ovrdflg@ */ Scalar_BOOLEAN 0 SWC_INP_type_CM_boolean_flg 0.0 1.0 /end CHARACTERISTIC
/begin CHARACTERISTIC KINP_LADBHibeamIndication_flg_defval "" VALUE 0x0000 /* @ECU_Address@KINP_LADBHibeamIndication_flg_defval@ */ Scalar_BOOLEAN 0 SWC_INP_type_CM_boolean_flg 0.0 1.0 /end CHARACTERISTIC
/begin CHARACTERISTIC KINP_LADBHibeamIndication_flg_ovrdflg "" VALUE 0x0000 /* @ECU_Address@KINP_LADBHibeamIndication_flg_ovrdflg@ */ Scalar_BOOLEAN 0 SWC_INP_type_CM_boolean_flg 0.0 1.0 /end CHARACTERISTIC
/begin CHARACTERISTIC KINP_LADBHibeamIndication_flg_ovrdval "" VALUE 0x0000 /* @ECU_Address@KINP_LADBHibeamIndication_flg_ovrdval@ */ Scalar_BOOLEAN 0 SWC_INP_type_CM_boolean_flg 0.0 1.0 /end CHARACTERISTIC
/begin CHARACTERISTIC KINP_LADBOperationStatus_flg_defval "" VALUE 0x0000 /* @ECU_Address@KINP_LADBOperationStatus_flg_defval@ */ Scalar_BOOLEAN 0 SWC_INP_type_CM_boolean_flg 0.0 1.0 /end CHARACTERISTIC
/begin CHARACTERISTIC KINP_LADBOperationStatus_flg_ovrdflg "" VALUE 0x0000 /* @ECU_Address@KINP_LADBOperationStatus_flg_ovrdflg@ */ Scalar_BOOLEAN 0 SWC_INP_type_CM_boolean_flg 0.0 1.0 /end CHARACTERISTIC
/begin CHARACTERISTIC KINP_LADBOperationStatus_flg_ovrdval "" VALUE 0x0000 /* @ECU_Address@KINP_LADBOperationStatus_flg_ovrdval@ */ Scalar_BOOLEAN 0 SWC_INP_type_CM_boolean_flg 0.0 1.0 /end CHARACTERISTIC
/begin CHARACTERISTIC KINP_LADBWarning_flg_defval "" VALUE 0x0000 /* @ECU_Address@KINP_LADBWarning_flg_defval@ */ Scalar_BOOLEAN 0 SWC_INP_type_CM_boolean_flg 0.0 1.0 /end CHARACTERISTIC
/begin CHARACTERISTIC KINP_LADBWarning_flg_ovrdflg "" VALUE 0x0000 /* @ECU_Address@KINP_LADBWarning_flg_ovrdflg@ */ Scalar_BOOLEAN 0 SWC_INP_type_CM_boolean_flg 0.0 1.0 /end CHARACTERISTIC
/begin CHARACTERISTIC KINP_LADBWarning_flg_ovrdval "" VALUE 0x0000 /* @ECU_Address@KINP_LADBWarning_flg_ovrdval@ */ Scalar_BOOLEAN 0 SWC_INP_type_CM_boolean_flg 0.0 1.0 /end CHARACTERISTIC
/begin CHARACTERISTIC KINP_LAHBWarning_flg_defval "" VALUE 0x0000 /* @ECU_Address@KINP_LAHBWarning_flg_defval@ */ Scalar_BOOLEAN 0 SWC_INP_type_CM_boolean_flg 0.0 1.0 /end CHARACTERISTIC
/begin CHARACTERISTIC KINP_LAHBWarning_flg_ovrdflg "" VALUE 0x0000 /* @ECU_Address@KINP_LAHBWarning_flg_ovrdflg@ */ Scalar_BOOLEAN 0 SWC_INP_type_CM_boolean_flg 0.0 1.0 /end CHARACTERISTIC
/begin CHARACTERISTIC KINP_LAHBWarning_flg_ovrdval "" VALUE 0x0000 /* @ECU_Address@KINP_LAHBWarning_flg_ovrdval@ */ Scalar_BOOLEAN 0 SWC_INP_type_CM_boolean_flg 0.0 1.0 /end CHARACTERISTIC
/begin CHARACTERISTIC KINP_LDRLWarning_flg_defval "" VALUE 0x0000 /* @ECU_Address@KINP_LDRLWarning_flg_defval@ */ Scalar_BOOLEAN 0 SWC_INP_type_CM_boolean_flg 0.0 1.0 /end CHARACTERISTIC
/begin CHARACTERISTIC KINP_LDRLWarning_flg_ovrdflg "" VALUE 0x0000 /* @ECU_Address@KINP_LDRLWarning_flg_ovrdflg@ */ Scalar_BOOLEAN 0 SWC_INP_type_CM_boolean_flg 0.0 1.0 /end CHARACTERISTIC
/begin CHARACTERISTIC KINP_LDRLWarning_flg_ovrdval "" VALUE 0x0000 /* @ECU_Address@KINP_LDRLWarning_flg_ovrdval@ */ Scalar_BOOLEAN 0 SWC_INP_type_CM_boolean_flg 0.0 1.0 /end CHARACTERISTIC
/begin CHARACTERISTIC KINP_LLBWarning_flg_defval "" VALUE 0x0000 /* @ECU_Address@KINP_LLBWarning_flg_defval@ */ Scalar_BOOLEAN 0 SWC_INP_type_CM_boolean_flg 0.0 1.0 /end CHARACTERISTIC
/begin CHARACTERISTIC KINP_LLBWarning_flg_ovrdflg "" VALUE 0x0000 /* @ECU_Address@KINP_LLBWarning_flg_ovrdflg@ */ Scalar_BOOLEAN 0 SWC_INP_type_CM_boolean_flg 0.0 1.0 /end CHARACTERISTIC
/begin CHARACTERISTIC KINP_LLBWarning_flg_ovrdval "" VALUE 0x0000 /* @ECU_Address@KINP_LLBWarning_flg_ovrdval@ */ Scalar_BOOLEAN 0 SWC_INP_type_CM_boolean_flg 0.0 1.0 /end CHARACTERISTIC
/begin CHARACTERISTIC KINP_LeftHallPos_enum_ovrdflg "" VALUE 0x0000 /* @ECU_Address@KINP_LeftHallPos_enum_ovrdflg@ */ Scalar_BOOLEAN 0 SWC_INP_type_CM_boolean_flg 0.0 1.0 /end CHARACTERISTIC
/begin CHARACTERISTIC KINP_LpositionLampWarning_flg_defval "" VALUE 0x0000 /* @ECU_Address@KINP_LpositionLampWarning_flg_defval@ */ Scalar_BOOLEAN 0 SWC_INP_type_CM_boolean_flg 0.0 1.0 /end CHARACTERISTIC
/begin CHARACTERISTIC KINP_LpositionLampWarning_flg_ovrdflg "" VALUE 0x0000 /* @ECU_Address@KINP_LpositionLampWarning_flg_ovrdflg@ */ Scalar_BOOLEAN 0 SWC_INP_type_CM_boolean_flg 0.0 1.0 /end CHARACTERISTIC
/begin CHARACTERISTIC KINP_LpositionLampWarning_flg_ovrdval "" VALUE 0x0000 /* @ECU_Address@KINP_LpositionLampWarning_flg_ovrdval@ */ Scalar_BOOLEAN 0 SWC_INP_type_CM_boolean_flg 0.0 1.0 /end CHARACTERISTIC
/begin CHARACTERISTIC KINP_MCUNR1CSErr_flg_defval "" VALUE 0x0000 /* @ECU_Address@KINP_MCUNR1CSErr_flg_defval@ */ Scalar_BOOLEAN 0 SWC_INP_type_CM_boolean_flg 0.0 1.0 /end CHARACTERISTIC
/begin CHARACTERISTIC KINP_MCUNR1CSErr_flg_ovrdflg "" VALUE 0x0000 /* @ECU_Address@KINP_MCUNR1CSErr_flg_ovrdflg@ */ Scalar_BOOLEAN 0 SWC_INP_type_CM_boolean_flg 0.0 1.0 /end CHARACTERISTIC
/begin CHARACTERISTIC KINP_MCUNR1CSErr_flg_ovrdval "" VALUE 0x0000 /* @ECU_Address@KINP_MCUNR1CSErr_flg_ovrdval@ */ Scalar_BOOLEAN 0 SWC_INP_type_CM_boolean_flg 0.0 1.0 /end CHARACTERISTIC
/begin CHARACTERISTIC KINP_MCUNR1RCErr_flg_defval "" VALUE 0x0000 /* @ECU_Address@KINP_MCUNR1RCErr_flg_defval@ */ Scalar_BOOLEAN 0 SWC_INP_type_CM_boolean_flg 0.0 1.0 /end CHARACTERISTIC
/begin CHARACTERISTIC KINP_MCUNR1RCErr_flg_ovrdflg "" VALUE 0x0000 /* @ECU_Address@KINP_MCUNR1RCErr_flg_ovrdflg@ */ Scalar_BOOLEAN 0 SWC_INP_type_CM_boolean_flg 0.0 1.0 /end CHARACTERISTIC
/begin CHARACTERISTIC KINP_MCUNR1RCErr_flg_ovrdval "" VALUE 0x0000 /* @ECU_Address@KINP_MCUNR1RCErr_flg_ovrdval@ */ Scalar_BOOLEAN 0 SWC_INP_type_CM_boolean_flg 0.0 1.0 /end CHARACTERISTIC
/begin CHARACTERISTIC KINP_MCUWarnRNidec_enum_ovrdflg "" VALUE 0x0000 /* @ECU_Address@KINP_MCUWarnRNidec_enum_ovrdflg@ */ Scalar_BOOLEAN 0 SWC_INP_type_CM_boolean_flg 0.0 1.0 /end CHARACTERISTIC
/begin CHARACTERISTIC KINP_MIRRORFOLDSW_flg_defval "" VALUE 0x0000 /* @ECU_Address@KINP_MIRRORFOLDSW_flg_defval@ */ Scalar_BOOLEAN 0 SWC_INP_type_CM_boolean_flg 0.0 1.0 /end CHARACTERISTIC
/begin CHARACTERISTIC KINP_MIRRORFOLDSW_flg_ovrdflg "" VALUE 0x0000 /* @ECU_Address@KINP_MIRRORFOLDSW_flg_ovrdflg@ */ Scalar_BOOLEAN 0 SWC_INP_type_CM_boolean_flg 0.0 1.0 /end CHARACTERISTIC
/begin CHARACTERISTIC KINP_MIRRORFOLDSW_flg_ovrdval "" VALUE 0x0000 /* @ECU_Address@KINP_MIRRORFOLDSW_flg_ovrdval@ */ Scalar_BOOLEAN 0 SWC_INP_type_CM_boolean_flg 0.0 1.0 /end CHARACTERISTIC
/begin CHARACTERISTIC KINP_MotorInTempErr_enum_ovrdflg "" VALUE 0x0000 /* @ECU_Address@KINP_MotorInTempErr_enum_ovrdflg@ */ Scalar_BOOLEAN 0 SWC_INP_type_CM_boolean_flg 0.0 1.0 /end CHARACTERISTIC
/begin CHARACTERISTIC KINP_MotorInTemp_C_ovrdflg "" VALUE 0x0000 /* @ECU_Address@KINP_MotorInTemp_C_ovrdflg@ */ Scalar_BOOLEAN 0 SWC_INP_type_CM_boolean_flg 0.0 1.0 /end CHARACTERISTIC
/begin CHARACTERISTIC KINP_MotorOutTempErr_enum_ovrdflg "" VALUE 0x0000 /* @ECU_Address@KINP_MotorOutTempErr_enum_ovrdflg@ */ Scalar_BOOLEAN 0 SWC_INP_type_CM_boolean_flg 0.0 1.0 /end CHARACTERISTIC
/begin CHARACTERISTIC KINP_MotorOutTemp_C_ovrdflg "" VALUE 0x0000 /* @ECU_Address@KINP_MotorOutTemp_C_ovrdflg@ */ Scalar_BOOLEAN 0 SWC_INP_type_CM_boolean_flg 0.0 1.0 /end CHARACTERISTIC
/begin CHARACTERISTIC KINP_PCommandToBCM_enum_ovrdflg "" VALUE 0x0000 /* @ECU_Address@KINP_PCommandToBCM_enum_ovrdflg@ */ Scalar_BOOLEAN 0 SWC_INP_type_CM_boolean_flg 0.0 1.0 /end CHARACTERISTIC
/begin CHARACTERISTIC KINP_PCommandToPTG_enum_ovrdflg "" VALUE 0x0000 /* @ECU_Address@KINP_PCommandToPTG_enum_ovrdflg@ */ Scalar_BOOLEAN 0 SWC_INP_type_CM_boolean_flg 0.0 1.0 /end CHARACTERISTIC
/begin CHARACTERISTIC KINP_PDKeyAreaLockUnlock_enum_ovrdflg "" VALUE 0x0000 /* @ECU_Address@KINP_PDKeyAreaLockUnlock_enum_ovrdflg@ */ Scalar_BOOLEAN 0 SWC_INP_type_CM_boolean_flg 0.0 1.0 /end CHARACTERISTIC
/begin CHARACTERISTIC KINP_PDKeyAreaPS_enum_ovrdflg "" VALUE 0x0000 /* @ECU_Address@KINP_PDKeyAreaPS_enum_ovrdflg@ */ Scalar_BOOLEAN 0 SWC_INP_type_CM_boolean_flg 0.0 1.0 /end CHARACTERISTIC
/begin CHARACTERISTIC KINP_PDKeyAreaPTG_enum_ovrdflg "" VALUE 0x0000 /* @ECU_Address@KINP_PDKeyAreaPTG_enum_ovrdflg@ */ Scalar_BOOLEAN 0 SWC_INP_type_CM_boolean_flg 0.0 1.0 /end CHARACTERISTIC
/begin CHARACTERISTIC KINP_PDKeyWelcome_enum_ovrdflg "" VALUE 0x0000 /* @ECU_Address@KINP_PDKeyWelcome_enum_ovrdflg@ */ Scalar_BOOLEAN 0 SWC_INP_type_CM_boolean_flg 0.0 1.0 /end CHARACTERISTIC
/begin CHARACTERISTIC KINP_PDkeyShowIVI_enum_ovrdflg "" VALUE 0x0000 /* @ECU_Address@KINP_PDkeyShowIVI_enum_ovrdflg@ */ Scalar_BOOLEAN 0 SWC_INP_type_CM_boolean_flg 0.0 1.0 /end CHARACTERISTIC
/begin CHARACTERISTIC KINP_PKeyMiss_flg_defval "" VALUE 0x0000 /* @ECU_Address@KINP_PKeyMiss_flg_defval@ */ Scalar_BOOLEAN 0 SWC_INP_type_CM_boolean_flg 0.0 1.0 /end CHARACTERISTIC
/begin CHARACTERISTIC KINP_PKeyMiss_flg_ovrdflg "" VALUE 0x0000 /* @ECU_Address@KINP_PKeyMiss_flg_ovrdflg@ */ Scalar_BOOLEAN 0 SWC_INP_type_CM_boolean_flg 0.0 1.0 /end CHARACTERISTIC
/begin CHARACTERISTIC KINP_PKeyMiss_flg_ovrdval "" VALUE 0x0000 /* @ECU_Address@KINP_PKeyMiss_flg_ovrdval@ */ Scalar_BOOLEAN 0 SWC_INP_type_CM_boolean_flg 0.0 1.0 /end CHARACTERISTIC
/begin CHARACTERISTIC KINP_PKeyMode_enum_ovrdflg "" VALUE 0x0000 /* @ECU_Address@KINP_PKeyMode_enum_ovrdflg@ */ Scalar_BOOLEAN 0 SWC_INP_type_CM_boolean_flg 0.0 1.0 /end CHARACTERISTIC
/begin CHARACTERISTIC KINP_PTGActiveSta_enum_ovrdflg "" VALUE 0x0000 /* @ECU_Address@KINP_PTGActiveSta_enum_ovrdflg@ */ Scalar_BOOLEAN 0 SWC_INP_type_CM_boolean_flg 0.0 1.0 /end CHARACTERISTIC
/begin CHARACTERISTIC KINP_PTGAutoStaus_flg_defval "" VALUE 0x0000 /* @ECU_Address@KINP_PTGAutoStaus_flg_defval@ */ Scalar_BOOLEAN 0 SWC_INP_type_CM_boolean_flg 0.0 1.0 /end CHARACTERISTIC
/begin CHARACTERISTIC KINP_PTGAutoStaus_flg_ovrdflg "" VALUE 0x0000 /* @ECU_Address@KINP_PTGAutoStaus_flg_ovrdflg@ */ Scalar_BOOLEAN 0 SWC_INP_type_CM_boolean_flg 0.0 1.0 /end CHARACTERISTIC
/begin CHARACTERISTIC KINP_PTGAutoStaus_flg_ovrdval "" VALUE 0x0000 /* @ECU_Address@KINP_PTGAutoStaus_flg_ovrdval@ */ Scalar_BOOLEAN 0 SWC_INP_type_CM_boolean_flg 0.0 1.0 /end CHARACTERISTIC
/begin CHARACTERISTIC KINP_PTGExist_flg_defval "" VALUE 0x0000 /* @ECU_Address@KINP_PTGExist_flg_defval@ */ Scalar_BOOLEAN 0 SWC_INP_type_CM_boolean_flg 0.0 1.0 /end CHARACTERISTIC
/begin CHARACTERISTIC KINP_PTGExist_flg_ovrdflg "" VALUE 0x0000 /* @ECU_Address@KINP_PTGExist_flg_ovrdflg@ */ Scalar_BOOLEAN 0 SWC_INP_type_CM_boolean_flg 0.0 1.0 /end CHARACTERISTIC
/begin CHARACTERISTIC KINP_PTGExist_flg_ovrdval "" VALUE 0x0000 /* @ECU_Address@KINP_PTGExist_flg_ovrdval@ */ Scalar_BOOLEAN 0 SWC_INP_type_CM_boolean_flg 0.0 1.0 /end CHARACTERISTIC
/begin CHARACTERISTIC KINP_PTGHWVer_enum_ovrdflg "" VALUE 0x0000 /* @ECU_Address@KINP_PTGHWVer_enum_ovrdflg@ */ Scalar_BOOLEAN 0 SWC_INP_type_CM_boolean_flg 0.0 1.0 /end CHARACTERISTIC
/begin CHARACTERISTIC KINP_PTGInnerSW2_enum_ovrdflg "" VALUE 0x0000 /* @ECU_Address@KINP_PTGInnerSW2_enum_ovrdflg@ */ Scalar_BOOLEAN 0 SWC_INP_type_CM_boolean_flg 0.0 1.0 /end CHARACTERISTIC
/begin CHARACTERISTIC KINP_PTGIsSetHeight_flg_defval "" VALUE 0x0000 /* @ECU_Address@KINP_PTGIsSetHeight_flg_defval@ */ Scalar_BOOLEAN 0 SWC_INP_type_CM_boolean_flg 0.0 1.0 /end CHARACTERISTIC
/begin CHARACTERISTIC KINP_PTGIsSetHeight_flg_ovrdflg "" VALUE 0x0000 /* @ECU_Address@KINP_PTGIsSetHeight_flg_ovrdflg@ */ Scalar_BOOLEAN 0 SWC_INP_type_CM_boolean_flg 0.0 1.0 /end CHARACTERISTIC
/begin CHARACTERISTIC KINP_PTGIsSetHeight_flg_ovrdval "" VALUE 0x0000 /* @ECU_Address@KINP_PTGIsSetHeight_flg_ovrdval@ */ Scalar_BOOLEAN 0 SWC_INP_type_CM_boolean_flg 0.0 1.0 /end CHARACTERISTIC
/begin CHARACTERISTIC KINP_PTGOpenRatio_pct_ovrdflg "" VALUE 0x0000 /* @ECU_Address@KINP_PTGOpenRatio_pct_ovrdflg@ */ Scalar_BOOLEAN 0 SWC_INP_type_CM_boolean_flg 0.0 1.0 /end CHARACTERISTIC
/begin CHARACTERISTIC KINP_PTGRDILSta_enum_ovrdflg "" VALUE 0x0000 /* @ECU_Address@KINP_PTGRDILSta_enum_ovrdflg@ */ Scalar_BOOLEAN 0 SWC_INP_type_CM_boolean_flg 0.0 1.0 /end CHARACTERISTIC
/begin CHARACTERISTIC KINP_PTGSWVer_enum_ovrdflg "" VALUE 0x0000 /* @ECU_Address@KINP_PTGSWVer_enum_ovrdflg@ */ Scalar_BOOLEAN 0 SWC_INP_type_CM_boolean_flg 0.0 1.0 /end CHARACTERISTIC
/begin CHARACTERISTIC KINP_PTGSysSta_enum_ovrdflg "" VALUE 0x0000 /* @ECU_Address@KINP_PTGSysSta_enum_ovrdflg@ */ Scalar_BOOLEAN 0 SWC_INP_type_CM_boolean_flg 0.0 1.0 /end CHARACTERISTIC
/begin CHARACTERISTIC KINP_PTHighPErr_enum_ovrdflg "" VALUE 0x0000 /* @ECU_Address@KINP_PTHighPErr_enum_ovrdflg@ */ Scalar_BOOLEAN 0 SWC_INP_type_CM_boolean_flg 0.0 1.0 /end CHARACTERISTIC
/begin CHARACTERISTIC KINP_PTHighP_KPa_ovrdflg "" VALUE 0x0000 /* @ECU_Address@KINP_PTHighP_KPa_ovrdflg@ */ Scalar_BOOLEAN 0 SWC_INP_type_CM_boolean_flg 0.0 1.0 /end CHARACTERISTIC
/begin CHARACTERISTIC KINP_PTHighTactErr_enum_ovrdflg "" VALUE 0x0000 /* @ECU_Address@KINP_PTHighTactErr_enum_ovrdflg@ */ Scalar_BOOLEAN 0 SWC_INP_type_CM_boolean_flg 0.0 1.0 /end CHARACTERISTIC
/begin CHARACTERISTIC KINP_PTHighTact_C_ovrdflg "" VALUE 0x0000 /* @ECU_Address@KINP_PTHighTact_C_ovrdflg@ */ Scalar_BOOLEAN 0 SWC_INP_type_CM_boolean_flg 0.0 1.0 /end CHARACTERISTIC
/begin CHARACTERISTIC KINP_PTLowP1Err_enum_ovrdflg "" VALUE 0x0000 /* @ECU_Address@KINP_PTLowP1Err_enum_ovrdflg@ */ Scalar_BOOLEAN 0 SWC_INP_type_CM_boolean_flg 0.0 1.0 /end CHARACTERISTIC
/begin CHARACTERISTIC KINP_PTLowP1_KPa_ovrdflg "" VALUE 0x0000 /* @ECU_Address@KINP_PTLowP1_KPa_ovrdflg@ */ Scalar_BOOLEAN 0 SWC_INP_type_CM_boolean_flg 0.0 1.0 /end CHARACTERISTIC
/begin CHARACTERISTIC KINP_PTLowP2Err_enum_ovrdflg "" VALUE 0x0000 /* @ECU_Address@KINP_PTLowP2Err_enum_ovrdflg@ */ Scalar_BOOLEAN 0 SWC_INP_type_CM_boolean_flg 0.0 1.0 /end CHARACTERISTIC
/begin CHARACTERISTIC KINP_PTLowP2_KPa_ovrdflg "" VALUE 0x0000 /* @ECU_Address@KINP_PTLowP2_KPa_ovrdflg@ */ Scalar_BOOLEAN 0 SWC_INP_type_CM_boolean_flg 0.0 1.0 /end CHARACTERISTIC
/begin CHARACTERISTIC KINP_PTLowT1Err_enum_ovrdflg "" VALUE 0x0000 /* @ECU_Address@KINP_PTLowT1Err_enum_ovrdflg@ */ Scalar_BOOLEAN 0 SWC_INP_type_CM_boolean_flg 0.0 1.0 /end CHARACTERISTIC
/begin CHARACTERISTIC KINP_PTLowT1_C_ovrdflg "" VALUE 0x0000 /* @ECU_Address@KINP_PTLowT1_C_ovrdflg@ */ Scalar_BOOLEAN 0 SWC_INP_type_CM_boolean_flg 0.0 1.0 /end CHARACTERISTIC
/begin CHARACTERISTIC KINP_PTLowT2Err_enum_ovrdflg "" VALUE 0x0000 /* @ECU_Address@KINP_PTLowT2Err_enum_ovrdflg@ */ Scalar_BOOLEAN 0 SWC_INP_type_CM_boolean_flg 0.0 1.0 /end CHARACTERISTIC
/begin CHARACTERISTIC KINP_PTLowT2_C_ovrdflg "" VALUE 0x0000 /* @ECU_Address@KINP_PTLowT2_C_ovrdflg@ */ Scalar_BOOLEAN 0 SWC_INP_type_CM_boolean_flg 0.0 1.0 /end CHARACTERISTIC
/begin CHARACTERISTIC KINP_PUIDLowPower_flg_defval "" VALUE 0x0000 /* @ECU_Address@KINP_PUIDLowPower_flg_defval@ */ Scalar_BOOLEAN 0 SWC_INP_type_CM_boolean_flg 0.0 1.0 /end CHARACTERISTIC
/begin CHARACTERISTIC KINP_PUIDLowPower_flg_ovrdflg "" VALUE 0x0000 /* @ECU_Address@KINP_PUIDLowPower_flg_ovrdflg@ */ Scalar_BOOLEAN 0 SWC_INP_type_CM_boolean_flg 0.0 1.0 /end CHARACTERISTIC
/begin CHARACTERISTIC KINP_PUIDLowPower_flg_ovrdval "" VALUE 0x0000 /* @ECU_Address@KINP_PUIDLowPower_flg_ovrdval@ */ Scalar_BOOLEAN 0 SWC_INP_type_CM_boolean_flg 0.0 1.0 /end CHARACTERISTIC
/begin CHARACTERISTIC KINP_RADBHibeamIndication_flg_defval "" VALUE 0x0000 /* @ECU_Address@KINP_RADBHibeamIndication_flg_defval@ */ Scalar_BOOLEAN 0 SWC_INP_type_CM_boolean_flg 0.0 1.0 /end CHARACTERISTIC
/begin CHARACTERISTIC KINP_RADBHibeamIndication_flg_ovrdflg "" VALUE 0x0000 /* @ECU_Address@KINP_RADBHibeamIndication_flg_ovrdflg@ */ Scalar_BOOLEAN 0 SWC_INP_type_CM_boolean_flg 0.0 1.0 /end CHARACTERISTIC
/begin CHARACTERISTIC KINP_RADBHibeamIndication_flg_ovrdval "" VALUE 0x0000 /* @ECU_Address@KINP_RADBHibeamIndication_flg_ovrdval@ */ Scalar_BOOLEAN 0 SWC_INP_type_CM_boolean_flg 0.0 1.0 /end CHARACTERISTIC
/begin CHARACTERISTIC KINP_RADBOperationStatus_flg_defval "" VALUE 0x0000 /* @ECU_Address@KINP_RADBOperationStatus_flg_defval@ */ Scalar_BOOLEAN 0 SWC_INP_type_CM_boolean_flg 0.0 1.0 /end CHARACTERISTIC
/begin CHARACTERISTIC KINP_RADBOperationStatus_flg_ovrdflg "" VALUE 0x0000 /* @ECU_Address@KINP_RADBOperationStatus_flg_ovrdflg@ */ Scalar_BOOLEAN 0 SWC_INP_type_CM_boolean_flg 0.0 1.0 /end CHARACTERISTIC
/begin CHARACTERISTIC KINP_RADBOperationStatus_flg_ovrdval "" VALUE 0x0000 /* @ECU_Address@KINP_RADBOperationStatus_flg_ovrdval@ */ Scalar_BOOLEAN 0 SWC_INP_type_CM_boolean_flg 0.0 1.0 /end CHARACTERISTIC
/begin CHARACTERISTIC KINP_RADBWarning_flg_defval "" VALUE 0x0000 /* @ECU_Address@KINP_RADBWarning_flg_defval@ */ Scalar_BOOLEAN 0 SWC_INP_type_CM_boolean_flg 0.0 1.0 /end CHARACTERISTIC
/begin CHARACTERISTIC KINP_RADBWarning_flg_ovrdflg "" VALUE 0x0000 /* @ECU_Address@KINP_RADBWarning_flg_ovrdflg@ */ Scalar_BOOLEAN 0 SWC_INP_type_CM_boolean_flg 0.0 1.0 /end CHARACTERISTIC
/begin CHARACTERISTIC KINP_RADBWarning_flg_ovrdval "" VALUE 0x0000 /* @ECU_Address@KINP_RADBWarning_flg_ovrdval@ */ Scalar_BOOLEAN 0 SWC_INP_type_CM_boolean_flg 0.0 1.0 /end CHARACTERISTIC
/begin CHARACTERISTIC KINP_RAHBWarning_flg_defval "" VALUE 0x0000 /* @ECU_Address@KINP_RAHBWarning_flg_defval@ */ Scalar_BOOLEAN 0 SWC_INP_type_CM_boolean_flg 0.0 1.0 /end CHARACTERISTIC
/begin CHARACTERISTIC KINP_RAHBWarning_flg_ovrdflg "" VALUE 0x0000 /* @ECU_Address@KINP_RAHBWarning_flg_ovrdflg@ */ Scalar_BOOLEAN 0 SWC_INP_type_CM_boolean_flg 0.0 1.0 /end CHARACTERISTIC
/begin CHARACTERISTIC KINP_RAHBWarning_flg_ovrdval "" VALUE 0x0000 /* @ECU_Address@KINP_RAHBWarning_flg_ovrdval@ */ Scalar_BOOLEAN 0 SWC_INP_type_CM_boolean_flg 0.0 1.0 /end CHARACTERISTIC
/begin CHARACTERISTIC KINP_RDRLWarning_flg_defval "" VALUE 0x0000 /* @ECU_Address@KINP_RDRLWarning_flg_defval@ */ Scalar_BOOLEAN 0 SWC_INP_type_CM_boolean_flg 0.0 1.0 /end CHARACTERISTIC
/begin CHARACTERISTIC KINP_RDRLWarning_flg_ovrdflg "" VALUE 0x0000 /* @ECU_Address@KINP_RDRLWarning_flg_ovrdflg@ */ Scalar_BOOLEAN 0 SWC_INP_type_CM_boolean_flg 0.0 1.0 /end CHARACTERISTIC
/begin CHARACTERISTIC KINP_RDRLWarning_flg_ovrdval "" VALUE 0x0000 /* @ECU_Address@KINP_RDRLWarning_flg_ovrdval@ */ Scalar_BOOLEAN 0 SWC_INP_type_CM_boolean_flg 0.0 1.0 /end CHARACTERISTIC
/begin CHARACTERISTIC KINP_RLBWarning_flg_defval "" VALUE 0x0000 /* @ECU_Address@KINP_RLBWarning_flg_defval@ */ Scalar_BOOLEAN 0 SWC_INP_type_CM_boolean_flg 0.0 1.0 /end CHARACTERISTIC
/begin CHARACTERISTIC KINP_RLBWarning_flg_ovrdflg "" VALUE 0x0000 /* @ECU_Address@KINP_RLBWarning_flg_ovrdflg@ */ Scalar_BOOLEAN 0 SWC_INP_type_CM_boolean_flg 0.0 1.0 /end CHARACTERISTIC
/begin CHARACTERISTIC KINP_RLBWarning_flg_ovrdval "" VALUE 0x0000 /* @ECU_Address@KINP_RLBWarning_flg_ovrdval@ */ Scalar_BOOLEAN 0 SWC_INP_type_CM_boolean_flg 0.0 1.0 /end CHARACTERISTIC
/begin CHARACTERISTIC KINP_RLTurnLPErr_flg_defval "" VALUE 0x0000 /* @ECU_Address@KINP_RLTurnLPErr_flg_defval@ */ Scalar_BOOLEAN 0 SWC_INP_type_CM_boolean_flg 0.0 1.0 /end CHARACTERISTIC
/begin CHARACTERISTIC KINP_RLTurnLPErr_flg_ovrdflg "" VALUE 0x0000 /* @ECU_Address@KINP_RLTurnLPErr_flg_ovrdflg@ */ Scalar_BOOLEAN 0 SWC_INP_type_CM_boolean_flg 0.0 1.0 /end CHARACTERISTIC
/begin CHARACTERISTIC KINP_RLTurnLPErr_flg_ovrdval "" VALUE 0x0000 /* @ECU_Address@KINP_RLTurnLPErr_flg_ovrdval@ */ Scalar_BOOLEAN 0 SWC_INP_type_CM_boolean_flg 0.0 1.0 /end CHARACTERISTIC
/begin CHARACTERISTIC KINP_RLTurnLampC_mA_ovrdflg "" VALUE 0x0000 /* @ECU_Address@KINP_RLTurnLampC_mA_ovrdflg@ */ Scalar_BOOLEAN 0 SWC_INP_type_CM_boolean_flg 0.0 1.0 /end CHARACTERISTIC
/begin CHARACTERISTIC KINP_RRTurnLPErr_flg_defval "" VALUE 0x0000 /* @ECU_Address@KINP_RRTurnLPErr_flg_defval@ */ Scalar_BOOLEAN 0 SWC_INP_type_CM_boolean_flg 0.0 1.0 /end CHARACTERISTIC
/begin CHARACTERISTIC KINP_RRTurnLPErr_flg_ovrdflg "" VALUE 0x0000 /* @ECU_Address@KINP_RRTurnLPErr_flg_ovrdflg@ */ Scalar_BOOLEAN 0 SWC_INP_type_CM_boolean_flg 0.0 1.0 /end CHARACTERISTIC
/begin CHARACTERISTIC KINP_RRTurnLPErr_flg_ovrdval "" VALUE 0x0000 /* @ECU_Address@KINP_RRTurnLPErr_flg_ovrdval@ */ Scalar_BOOLEAN 0 SWC_INP_type_CM_boolean_flg 0.0 1.0 /end CHARACTERISTIC
/begin CHARACTERISTIC KINP_RRTurnLampC_mA_ovrdflg "" VALUE 0x0000 /* @ECU_Address@KINP_RRTurnLampC_mA_ovrdflg@ */ Scalar_BOOLEAN 0 SWC_INP_type_CM_boolean_flg 0.0 1.0 /end CHARACTERISTIC
/begin CHARACTERISTIC KINP_RWiperAS_flg_defval "" VALUE 0x0000 /* @ECU_Address@KINP_RWiperAS_flg_defval@ */ Scalar_BOOLEAN 0 SWC_INP_type_CM_boolean_flg 0.0 1.0 /end CHARACTERISTIC
/begin CHARACTERISTIC KINP_RWiperAS_flg_ovrdflg "" VALUE 0x0000 /* @ECU_Address@KINP_RWiperAS_flg_ovrdflg@ */ Scalar_BOOLEAN 0 SWC_INP_type_CM_boolean_flg 0.0 1.0 /end CHARACTERISTIC
/begin CHARACTERISTIC KINP_RWiperAS_flg_ovrdval "" VALUE 0x0000 /* @ECU_Address@KINP_RWiperAS_flg_ovrdval@ */ Scalar_BOOLEAN 0 SWC_INP_type_CM_boolean_flg 0.0 1.0 /end CHARACTERISTIC
/begin CHARACTERISTIC KINP_RWiperProtection_flg_defval "" VALUE 0x0000 /* @ECU_Address@KINP_RWiperProtection_flg_defval@ */ Scalar_BOOLEAN 0 SWC_INP_type_CM_boolean_flg 0.0 1.0 /end CHARACTERISTIC
/begin CHARACTERISTIC KINP_RWiperProtection_flg_ovrdflg "" VALUE 0x0000 /* @ECU_Address@KINP_RWiperProtection_flg_ovrdflg@ */ Scalar_BOOLEAN 0 SWC_INP_type_CM_boolean_flg 0.0 1.0 /end CHARACTERISTIC
/begin CHARACTERISTIC KINP_RWiperProtection_flg_ovrdval "" VALUE 0x0000 /* @ECU_Address@KINP_RWiperProtection_flg_ovrdval@ */ Scalar_BOOLEAN 0 SWC_INP_type_CM_boolean_flg 0.0 1.0 /end CHARACTERISTIC
/begin CHARACTERISTIC KINP_RandomNumberX_enum_ovrdflg "" VALUE 0x0000 /* @ECU_Address@KINP_RandomNumberX_enum_ovrdflg@ */ Scalar_BOOLEAN 0 SWC_INP_type_CM_boolean_flg 0.0 1.0 /end CHARACTERISTIC
/begin CHARACTERISTIC KINP_RpositionLampWarning_flg_defval "" VALUE 0x0000 /* @ECU_Address@KINP_RpositionLampWarning_flg_defval@ */ Scalar_BOOLEAN 0 SWC_INP_type_CM_boolean_flg 0.0 1.0 /end CHARACTERISTIC
/begin CHARACTERISTIC KINP_RpositionLampWarning_flg_ovrdflg "" VALUE 0x0000 /* @ECU_Address@KINP_RpositionLampWarning_flg_ovrdflg@ */ Scalar_BOOLEAN 0 SWC_INP_type_CM_boolean_flg 0.0 1.0 /end CHARACTERISTIC
/begin CHARACTERISTIC KINP_RpositionLampWarning_flg_ovrdval "" VALUE 0x0000 /* @ECU_Address@KINP_RpositionLampWarning_flg_ovrdval@ */ Scalar_BOOLEAN 0 SWC_INP_type_CM_boolean_flg 0.0 1.0 /end CHARACTERISTIC
/begin CHARACTERISTIC KINP_RrActvDmpDisabStaNidec_flg_defval "" VALUE 0x0000 /* @ECU_Address@KINP_RrActvDmpDisabStaNidec_flg_defval@ */ Scalar_BOOLEAN 0 SWC_INP_type_CM_boolean_flg 0.0 1.0 /end CHARACTERISTIC
/begin CHARACTERISTIC KINP_RrActvDmpDisabStaNidec_flg_ovrdflg "" VALUE 0x0000 /* @ECU_Address@KINP_RrActvDmpDisabStaNidec_flg_ovrdflg@ */ Scalar_BOOLEAN 0 SWC_INP_type_CM_boolean_flg 0.0 1.0 /end CHARACTERISTIC
/begin CHARACTERISTIC KINP_RrActvDmpDisabStaNidec_flg_ovrdval "" VALUE 0x0000 /* @ECU_Address@KINP_RrActvDmpDisabStaNidec_flg_ovrdval@ */ Scalar_BOOLEAN 0 SWC_INP_type_CM_boolean_flg 0.0 1.0 /end CHARACTERISTIC
/begin CHARACTERISTIC KINP_RrCoolanttempReqNidec_cnt_ovrdflg "" VALUE 0x0000 /* @ECU_Address@KINP_RrCoolanttempReqNidec_cnt_ovrdflg@ */ Scalar_BOOLEAN 0 SWC_INP_type_CM_boolean_flg 0.0 1.0 /end CHARACTERISTIC
/begin CHARACTERISTIC KINP_RrEDUDrtStaNidec_flg_defval "" VALUE 0x0000 /* @ECU_Address@KINP_RrEDUDrtStaNidec_flg_defval@ */ Scalar_BOOLEAN 0 SWC_INP_type_CM_boolean_flg 0.0 1.0 /end CHARACTERISTIC
/begin CHARACTERISTIC KINP_RrEDUDrtStaNidec_flg_ovrdflg "" VALUE 0x0000 /* @ECU_Address@KINP_RrEDUDrtStaNidec_flg_ovrdflg@ */ Scalar_BOOLEAN 0 SWC_INP_type_CM_boolean_flg 0.0 1.0 /end CHARACTERISTIC
/begin CHARACTERISTIC KINP_RrEDUDrtStaNidec_flg_ovrdval "" VALUE 0x0000 /* @ECU_Address@KINP_RrEDUDrtStaNidec_flg_ovrdval@ */ Scalar_BOOLEAN 0 SWC_INP_type_CM_boolean_flg 0.0 1.0 /end CHARACTERISTIC
/begin CHARACTERISTIC KINP_RrEDUOpratingStaNidec_flg_defval "" VALUE 0x0000 /* @ECU_Address@KINP_RrEDUOpratingStaNidec_flg_defval@ */ Scalar_BOOLEAN 0 SWC_INP_type_CM_boolean_flg 0.0 1.0 /end CHARACTERISTIC
/begin CHARACTERISTIC KINP_RrEDUOpratingStaNidec_flg_ovrdflg "" VALUE 0x0000 /* @ECU_Address@KINP_RrEDUOpratingStaNidec_flg_ovrdflg@ */ Scalar_BOOLEAN 0 SWC_INP_type_CM_boolean_flg 0.0 1.0 /end CHARACTERISTIC
/begin CHARACTERISTIC KINP_RrEDUOpratingStaNidec_flg_ovrdval "" VALUE 0x0000 /* @ECU_Address@KINP_RrEDUOpratingStaNidec_flg_ovrdval@ */ Scalar_BOOLEAN 0 SWC_INP_type_CM_boolean_flg 0.0 1.0 /end CHARACTERISTIC
/begin CHARACTERISTIC KINP_RrEDURealTMTqNidec_Nm_ovrdflg "" VALUE 0x0000 /* @ECU_Address@KINP_RrEDURealTMTqNidec_Nm_ovrdflg@ */ Scalar_BOOLEAN 0 SWC_INP_type_CM_boolean_flg 0.0 1.0 /end CHARACTERISTIC
/begin CHARACTERISTIC KINP_RrEDURotateDirctionNidec_enum_ovrdflg "" VALUE 0x0000 /* @ECU_Address@KINP_RrEDURotateDirctionNidec_enum_ovrdflg@ */ Scalar_BOOLEAN 0 SWC_INP_type_CM_boolean_flg 0.0 1.0 /end CHARACTERISTIC
/begin CHARACTERISTIC KINP_RrEDUTqReqFbkNidec_Nm_ovrdflg "" VALUE 0x0000 /* @ECU_Address@KINP_RrEDUTqReqFbkNidec_Nm_ovrdflg@ */ Scalar_BOOLEAN 0 SWC_INP_type_CM_boolean_flg 0.0 1.0 /end CHARACTERISTIC
/begin CHARACTERISTIC KINP_RrEOPSpdSetNidec_rpm_ovrdflg "" VALUE 0x0000 /* @ECU_Address@KINP_RrEOPSpdSetNidec_rpm_ovrdflg@ */ Scalar_BOOLEAN 0 SWC_INP_type_CM_boolean_flg 0.0 1.0 /end CHARACTERISTIC
/begin CHARACTERISTIC KINP_RrFailcode1Nidec_enum_ovrdflg "" VALUE 0x0000 /* @ECU_Address@KINP_RrFailcode1Nidec_enum_ovrdflg@ */ Scalar_BOOLEAN 0 SWC_INP_type_CM_boolean_flg 0.0 1.0 /end CHARACTERISTIC
/begin CHARACTERISTIC KINP_RrFailcode2Nidec_enum_ovrdflg "" VALUE 0x0000 /* @ECU_Address@KINP_RrFailcode2Nidec_enum_ovrdflg@ */ Scalar_BOOLEAN 0 SWC_INP_type_CM_boolean_flg 0.0 1.0 /end CHARACTERISTIC
/begin CHARACTERISTIC KINP_RrFailcodehistory1Nidec_enum_ovrdflg "" VALUE 0x0000 /* @ECU_Address@KINP_RrFailcodehistory1Nidec_enum_ovrdflg@ */ Scalar_BOOLEAN 0 SWC_INP_type_CM_boolean_flg 0.0 1.0 /end CHARACTERISTIC
/begin CHARACTERISTIC KINP_RrFailcodehistory2Nidec_enum_ovrdflg "" VALUE 0x0000 /* @ECU_Address@KINP_RrFailcodehistory2Nidec_enum_ovrdflg@ */ Scalar_BOOLEAN 0 SWC_INP_type_CM_boolean_flg 0.0 1.0 /end CHARACTERISTIC
/begin CHARACTERISTIC KINP_RrLLCTempNidec_C_ovrdflg "" VALUE 0x0000 /* @ECU_Address@KINP_RrLLCTempNidec_C_ovrdflg@ */ Scalar_BOOLEAN 0 SWC_INP_type_CM_boolean_flg 0.0 1.0 /end CHARACTERISTIC
/begin CHARACTERISTIC KINP_RrLLCflowReqNidec_Lpmin_ovrdflg "" VALUE 0x0000 /* @ECU_Address@KINP_RrLLCflowReqNidec_Lpmin_ovrdflg@ */ Scalar_BOOLEAN 0 SWC_INP_type_CM_boolean_flg 0.0 1.0 /end CHARACTERISTIC
/begin CHARACTERISTIC KINP_RrMCU1ChksumNidec_enum_ovrdflg "" VALUE 0x0000 /* @ECU_Address@KINP_RrMCU1ChksumNidec_enum_ovrdflg@ */ Scalar_BOOLEAN 0 SWC_INP_type_CM_boolean_flg 0.0 1.0 /end CHARACTERISTIC
/begin CHARACTERISTIC KINP_RrMCU1RolCntNidec_enum_ovrdflg "" VALUE 0x0000 /* @ECU_Address@KINP_RrMCU1RolCntNidec_enum_ovrdflg@ */ Scalar_BOOLEAN 0 SWC_INP_type_CM_boolean_flg 0.0 1.0 /end CHARACTERISTIC
/begin CHARACTERISTIC KINP_RrMCU3HWVerNidec_enum_ovrdflg "" VALUE 0x0000 /* @ECU_Address@KINP_RrMCU3HWVerNidec_enum_ovrdflg@ */ Scalar_BOOLEAN 0 SWC_INP_type_CM_boolean_flg 0.0 1.0 /end CHARACTERISTIC
/begin CHARACTERISTIC KINP_RrMCU3SWVerNidec_enum_ovrdflg "" VALUE 0x0000 /* @ECU_Address@KINP_RrMCU3SWVerNidec_enum_ovrdflg@ */ Scalar_BOOLEAN 0 SWC_INP_type_CM_boolean_flg 0.0 1.0 /end CHARACTERISTIC
/begin CHARACTERISTIC KINP_RrMCUBATNidec_V_ovrdflg "" VALUE 0x0000 /* @ECU_Address@KINP_RrMCUBATNidec_V_ovrdflg@ */ Scalar_BOOLEAN 0 SWC_INP_type_CM_boolean_flg 0.0 1.0 /end CHARACTERISTIC
/begin CHARACTERISTIC KINP_RrMCUDCBusCurrNidec_A_ovrdflg "" VALUE 0x0000 /* @ECU_Address@KINP_RrMCUDCBusCurrNidec_A_ovrdflg@ */ Scalar_BOOLEAN 0 SWC_INP_type_CM_boolean_flg 0.0 1.0 /end CHARACTERISTIC
/begin CHARACTERISTIC KINP_RrMCUDCBusVoltNidec_V_ovrdflg "" VALUE 0x0000 /* @ECU_Address@KINP_RrMCUDCBusVoltNidec_V_ovrdflg@ */ Scalar_BOOLEAN 0 SWC_INP_type_CM_boolean_flg 0.0 1.0 /end CHARACTERISTIC
/begin CHARACTERISTIC KINP_RrMCUDischrgStaNidec_flg_defval "" VALUE 0x0000 /* @ECU_Address@KINP_RrMCUDischrgStaNidec_flg_defval@ */ Scalar_BOOLEAN 0 SWC_INP_type_CM_boolean_flg 0.0 1.0 /end CHARACTERISTIC
/begin CHARACTERISTIC KINP_RrMCUDischrgStaNidec_flg_ovrdflg "" VALUE 0x0000 /* @ECU_Address@KINP_RrMCUDischrgStaNidec_flg_ovrdflg@ */ Scalar_BOOLEAN 0 SWC_INP_type_CM_boolean_flg 0.0 1.0 /end CHARACTERISTIC
/begin CHARACTERISTIC KINP_RrMCUDischrgStaNidec_flg_ovrdval "" VALUE 0x0000 /* @ECU_Address@KINP_RrMCUDischrgStaNidec_flg_ovrdval@ */ Scalar_BOOLEAN 0 SWC_INP_type_CM_boolean_flg 0.0 1.0 /end CHARACTERISTIC
/begin CHARACTERISTIC KINP_RrMCUEnaStaNidec_flg_defval "" VALUE 0x0000 /* @ECU_Address@KINP_RrMCUEnaStaNidec_flg_defval@ */ Scalar_BOOLEAN 0 SWC_INP_type_CM_boolean_flg 0.0 1.0 /end CHARACTERISTIC
/begin CHARACTERISTIC KINP_RrMCUEnaStaNidec_flg_ovrdflg "" VALUE 0x0000 /* @ECU_Address@KINP_RrMCUEnaStaNidec_flg_ovrdflg@ */ Scalar_BOOLEAN 0 SWC_INP_type_CM_boolean_flg 0.0 1.0 /end CHARACTERISTIC
/begin CHARACTERISTIC KINP_RrMCUEnaStaNidec_flg_ovrdval "" VALUE 0x0000 /* @ECU_Address@KINP_RrMCUEnaStaNidec_flg_ovrdval@ */ Scalar_BOOLEAN 0 SWC_INP_type_CM_boolean_flg 0.0 1.0 /end CHARACTERISTIC
/begin CHARACTERISTIC KINP_RrMCUErrNidec_enum_ovrdflg "" VALUE 0x0000 /* @ECU_Address@KINP_RrMCUErrNidec_enum_ovrdflg@ */ Scalar_BOOLEAN 0 SWC_INP_type_CM_boolean_flg 0.0 1.0 /end CHARACTERISTIC
/begin CHARACTERISTIC KINP_RrMCUIGNstaNidec_flg_defval "" VALUE 0x0000 /* @ECU_Address@KINP_RrMCUIGNstaNidec_flg_defval@ */ Scalar_BOOLEAN 0 SWC_INP_type_CM_boolean_flg 0.0 1.0 /end CHARACTERISTIC
/begin CHARACTERISTIC KINP_RrMCUIGNstaNidec_flg_ovrdflg "" VALUE 0x0000 /* @ECU_Address@KINP_RrMCUIGNstaNidec_flg_ovrdflg@ */ Scalar_BOOLEAN 0 SWC_INP_type_CM_boolean_flg 0.0 1.0 /end CHARACTERISTIC
/begin CHARACTERISTIC KINP_RrMCUIGNstaNidec_flg_ovrdval "" VALUE 0x0000 /* @ECU_Address@KINP_RrMCUIGNstaNidec_flg_ovrdval@ */ Scalar_BOOLEAN 0 SWC_INP_type_CM_boolean_flg 0.0 1.0 /end CHARACTERISTIC
/begin CHARACTERISTIC KINP_RrMCUReady4PreNidec_flg_defval "" VALUE 0x0000 /* @ECU_Address@KINP_RrMCUReady4PreNidec_flg_defval@ */ Scalar_BOOLEAN 0 SWC_INP_type_CM_boolean_flg 0.0 1.0 /end CHARACTERISTIC
/begin CHARACTERISTIC KINP_RrMCUReady4PreNidec_flg_ovrdflg "" VALUE 0x0000 /* @ECU_Address@KINP_RrMCUReady4PreNidec_flg_ovrdflg@ */ Scalar_BOOLEAN 0 SWC_INP_type_CM_boolean_flg 0.0 1.0 /end CHARACTERISTIC
/begin CHARACTERISTIC KINP_RrMCUReady4PreNidec_flg_ovrdval "" VALUE 0x0000 /* @ECU_Address@KINP_RrMCUReady4PreNidec_flg_ovrdval@ */ Scalar_BOOLEAN 0 SWC_INP_type_CM_boolean_flg 0.0 1.0 /end CHARACTERISTIC
/begin CHARACTERISTIC KINP_RrMCUReadyNidec_flg_defval "" VALUE 0x0000 /* @ECU_Address@KINP_RrMCUReadyNidec_flg_defval@ */ Scalar_BOOLEAN 0 SWC_INP_type_CM_boolean_flg 0.0 1.0 /end CHARACTERISTIC
/begin CHARACTERISTIC KINP_RrMCUReadyNidec_flg_ovrdflg "" VALUE 0x0000 /* @ECU_Address@KINP_RrMCUReadyNidec_flg_ovrdflg@ */ Scalar_BOOLEAN 0 SWC_INP_type_CM_boolean_flg 0.0 1.0 /end CHARACTERISTIC
/begin CHARACTERISTIC KINP_RrMCUReadyNidec_flg_ovrdval "" VALUE 0x0000 /* @ECU_Address@KINP_RrMCUReadyNidec_flg_ovrdval@ */ Scalar_BOOLEAN 0 SWC_INP_type_CM_boolean_flg 0.0 1.0 /end CHARACTERISTIC
/begin CHARACTERISTIC KINP_RrMCUSysStaNidec_enum_ovrdflg "" VALUE 0x0000 /* @ECU_Address@KINP_RrMCUSysStaNidec_enum_ovrdflg@ */ Scalar_BOOLEAN 0 SWC_INP_type_CM_boolean_flg 0.0 1.0 /end CHARACTERISTIC
/begin CHARACTERISTIC KINP_RrMCUTempNidec_C_ovrdflg "" VALUE 0x0000 /* @ECU_Address@KINP_RrMCUTempNidec_C_ovrdflg@ */ Scalar_BOOLEAN 0 SWC_INP_type_CM_boolean_flg 0.0 1.0 /end CHARACTERISTIC
/begin CHARACTERISTIC KINP_RrMCUTempWarnNidec_enum_ovrdflg "" VALUE 0x0000 /* @ECU_Address@KINP_RrMCUTempWarnNidec_enum_ovrdflg@ */ Scalar_BOOLEAN 0 SWC_INP_type_CM_boolean_flg 0.0 1.0 /end CHARACTERISTIC
/begin CHARACTERISTIC KINP_RrMotorAvailTqNidec_Nm_ovrdflg "" VALUE 0x0000 /* @ECU_Address@KINP_RrMotorAvailTqNidec_Nm_ovrdflg@ */ Scalar_BOOLEAN 0 SWC_INP_type_CM_boolean_flg 0.0 1.0 /end CHARACTERISTIC
/begin CHARACTERISTIC KINP_RrRegenAvailTqNidec_Nm_ovrdflg "" VALUE 0x0000 /* @ECU_Address@KINP_RrRegenAvailTqNidec_Nm_ovrdflg@ */ Scalar_BOOLEAN 0 SWC_INP_type_CM_boolean_flg 0.0 1.0 /end CHARACTERISTIC
/begin CHARACTERISTIC KINP_RrTMSpdNidec_rpm_ovrdflg "" VALUE 0x0000 /* @ECU_Address@KINP_RrTMSpdNidec_rpm_ovrdflg@ */ Scalar_BOOLEAN 0 SWC_INP_type_CM_boolean_flg 0.0 1.0 /end CHARACTERISTIC
/begin CHARACTERISTIC KINP_RrTMTempNidec_C_ovrdflg "" VALUE 0x0000 /* @ECU_Address@KINP_RrTMTempNidec_C_ovrdflg@ */ Scalar_BOOLEAN 0 SWC_INP_type_CM_boolean_flg 0.0 1.0 /end CHARACTERISTIC
/begin CHARACTERISTIC KINP_RrTMTempWarnNidec_enum_ovrdflg "" VALUE 0x0000 /* @ECU_Address@KINP_RrTMTempWarnNidec_enum_ovrdflg@ */ Scalar_BOOLEAN 0 SWC_INP_type_CM_boolean_flg 0.0 1.0 /end CHARACTERISTIC
/begin CHARACTERISTIC KINP_RrTMidNidec_A_ovrdflg "" VALUE 0x0000 /* @ECU_Address@KINP_RrTMidNidec_A_ovrdflg@ */ Scalar_BOOLEAN 0 SWC_INP_type_CM_boolean_flg 0.0 1.0 /end CHARACTERISTIC
/begin CHARACTERISTIC KINP_RrTMiqNidec_A_ovrdflg "" VALUE 0x0000 /* @ECU_Address@KINP_RrTMiqNidec_A_ovrdflg@ */ Scalar_BOOLEAN 0 SWC_INP_type_CM_boolean_flg 0.0 1.0 /end CHARACTERISTIC
/begin CHARACTERISTIC KINP_SOTXVErr_enum_ovrdflg "" VALUE 0x0000 /* @ECU_Address@KINP_SOTXVErr_enum_ovrdflg@ */ Scalar_BOOLEAN 0 SWC_INP_type_CM_boolean_flg 0.0 1.0 /end CHARACTERISTIC
/begin CHARACTERISTIC KINP_SOV1Err_enum_ovrdflg "" VALUE 0x0000 /* @ECU_Address@KINP_SOV1Err_enum_ovrdflg@ */ Scalar_BOOLEAN 0 SWC_INP_type_CM_boolean_flg 0.0 1.0 /end CHARACTERISTIC
/begin CHARACTERISTIC KINP_SOV2Err_enum_ovrdflg "" VALUE 0x0000 /* @ECU_Address@KINP_SOV2Err_enum_ovrdflg@ */ Scalar_BOOLEAN 0 SWC_INP_type_CM_boolean_flg 0.0 1.0 /end CHARACTERISTIC
/begin CHARACTERISTIC KINP_SOV3Err_enum_ovrdflg "" VALUE 0x0000 /* @ECU_Address@KINP_SOV3Err_enum_ovrdflg@ */ Scalar_BOOLEAN 0 SWC_INP_type_CM_boolean_flg 0.0 1.0 /end CHARACTERISTIC
/begin CHARACTERISTIC KINP_Shifter1CSErr_flg_defval "" VALUE 0x0000 /* @ECU_Address@KINP_Shifter1CSErr_flg_defval@ */ Scalar_BOOLEAN 0 SWC_INP_type_CM_boolean_flg 0.0 1.0 /end CHARACTERISTIC
/begin CHARACTERISTIC KINP_Shifter1CSErr_flg_ovrdflg "" VALUE 0x0000 /* @ECU_Address@KINP_Shifter1CSErr_flg_ovrdflg@ */ Scalar_BOOLEAN 0 SWC_INP_type_CM_boolean_flg 0.0 1.0 /end CHARACTERISTIC
/begin CHARACTERISTIC KINP_Shifter1CSErr_flg_ovrdval "" VALUE 0x0000 /* @ECU_Address@KINP_Shifter1CSErr_flg_ovrdval@ */ Scalar_BOOLEAN 0 SWC_INP_type_CM_boolean_flg 0.0 1.0 /end CHARACTERISTIC
/begin CHARACTERISTIC KINP_Shifter1RCErr_flg_defval "" VALUE 0x0000 /* @ECU_Address@KINP_Shifter1RCErr_flg_defval@ */ Scalar_BOOLEAN 0 SWC_INP_type_CM_boolean_flg 0.0 1.0 /end CHARACTERISTIC
/begin CHARACTERISTIC KINP_Shifter1RCErr_flg_ovrdflg "" VALUE 0x0000 /* @ECU_Address@KINP_Shifter1RCErr_flg_ovrdflg@ */ Scalar_BOOLEAN 0 SWC_INP_type_CM_boolean_flg 0.0 1.0 /end CHARACTERISTIC
/begin CHARACTERISTIC KINP_Shifter1RCErr_flg_ovrdval "" VALUE 0x0000 /* @ECU_Address@KINP_Shifter1RCErr_flg_ovrdval@ */ Scalar_BOOLEAN 0 SWC_INP_type_CM_boolean_flg 0.0 1.0 /end CHARACTERISTIC
/begin CHARACTERISTIC KINP_Shifter2CSErr_flg_defval "" VALUE 0x0000 /* @ECU_Address@KINP_Shifter2CSErr_flg_defval@ */ Scalar_BOOLEAN 0 SWC_INP_type_CM_boolean_flg 0.0 1.0 /end CHARACTERISTIC
/begin CHARACTERISTIC KINP_Shifter2CSErr_flg_ovrdflg "" VALUE 0x0000 /* @ECU_Address@KINP_Shifter2CSErr_flg_ovrdflg@ */ Scalar_BOOLEAN 0 SWC_INP_type_CM_boolean_flg 0.0 1.0 /end CHARACTERISTIC
/begin CHARACTERISTIC KINP_Shifter2CSErr_flg_ovrdval "" VALUE 0x0000 /* @ECU_Address@KINP_Shifter2CSErr_flg_ovrdval@ */ Scalar_BOOLEAN 0 SWC_INP_type_CM_boolean_flg 0.0 1.0 /end CHARACTERISTIC
/begin CHARACTERISTIC KINP_Shifter2RCErr_flg_defval "" VALUE 0x0000 /* @ECU_Address@KINP_Shifter2RCErr_flg_defval@ */ Scalar_BOOLEAN 0 SWC_INP_type_CM_boolean_flg 0.0 1.0 /end CHARACTERISTIC
/begin CHARACTERISTIC KINP_Shifter2RCErr_flg_ovrdflg "" VALUE 0x0000 /* @ECU_Address@KINP_Shifter2RCErr_flg_ovrdflg@ */ Scalar_BOOLEAN 0 SWC_INP_type_CM_boolean_flg 0.0 1.0 /end CHARACTERISTIC
/begin CHARACTERISTIC KINP_Shifter2RCErr_flg_ovrdval "" VALUE 0x0000 /* @ECU_Address@KINP_Shifter2RCErr_flg_ovrdval@ */ Scalar_BOOLEAN 0 SWC_INP_type_CM_boolean_flg 0.0 1.0 /end CHARACTERISTIC
/begin CHARACTERISTIC KINP_ShifterCRC8_enum_ovrdflg "" VALUE 0x0000 /* @ECU_Address@KINP_ShifterCRC8_enum_ovrdflg@ */ Scalar_BOOLEAN 0 SWC_INP_type_CM_boolean_flg 0.0 1.0 /end CHARACTERISTIC
/begin CHARACTERISTIC KINP_ShifterFailsta_enum_ovrdflg "" VALUE 0x0000 /* @ECU_Address@KINP_ShifterFailsta_enum_ovrdflg@ */ Scalar_BOOLEAN 0 SWC_INP_type_CM_boolean_flg 0.0 1.0 /end CHARACTERISTIC
/begin CHARACTERISTIC KINP_ShifterHandleCmd_enum_ovrdflg "" VALUE 0x0000 /* @ECU_Address@KINP_ShifterHandleCmd_enum_ovrdflg@ */ Scalar_BOOLEAN 0 SWC_INP_type_CM_boolean_flg 0.0 1.0 /end CHARACTERISTIC
/begin CHARACTERISTIC KINP_ShifterRC_enum_ovrdflg "" VALUE 0x0000 /* @ECU_Address@KINP_ShifterRC_enum_ovrdflg@ */ Scalar_BOOLEAN 0 SWC_INP_type_CM_boolean_flg 0.0 1.0 /end CHARACTERISTIC
/begin CHARACTERISTIC KINP_SolarLErr_enum_ovrdflg "" VALUE 0x0000 /* @ECU_Address@KINP_SolarLErr_enum_ovrdflg@ */ Scalar_BOOLEAN 0 SWC_INP_type_CM_boolean_flg 0.0 1.0 /end CHARACTERISTIC
/begin CHARACTERISTIC KINP_SolarL_W_ovrdflg "" VALUE 0x0000 /* @ECU_Address@KINP_SolarL_W_ovrdflg@ */ Scalar_BOOLEAN 0 SWC_INP_type_CM_boolean_flg 0.0 1.0 /end CHARACTERISTIC
/begin CHARACTERISTIC KINP_SolarRErr_enum_ovrdflg "" VALUE 0x0000 /* @ECU_Address@KINP_SolarRErr_enum_ovrdflg@ */ Scalar_BOOLEAN 0 SWC_INP_type_CM_boolean_flg 0.0 1.0 /end CHARACTERISTIC
/begin CHARACTERISTIC KINP_SolarR_W_ovrdflg "" VALUE 0x0000 /* @ECU_Address@KINP_SolarR_W_ovrdflg@ */ Scalar_BOOLEAN 0 SWC_INP_type_CM_boolean_flg 0.0 1.0 /end CHARACTERISTIC
/begin CHARACTERISTIC KINP_TFaceLErr_enum_ovrdflg "" VALUE 0x0000 /* @ECU_Address@KINP_TFaceLErr_enum_ovrdflg@ */ Scalar_BOOLEAN 0 SWC_INP_type_CM_boolean_flg 0.0 1.0 /end CHARACTERISTIC
/begin CHARACTERISTIC KINP_TFaceL_C_ovrdflg "" VALUE 0x0000 /* @ECU_Address@KINP_TFaceL_C_ovrdflg@ */ Scalar_BOOLEAN 0 SWC_INP_type_CM_boolean_flg 0.0 1.0 /end CHARACTERISTIC
/begin CHARACTERISTIC KINP_TFaceRErr_enum_ovrdflg "" VALUE 0x0000 /* @ECU_Address@KINP_TFaceRErr_enum_ovrdflg@ */ Scalar_BOOLEAN 0 SWC_INP_type_CM_boolean_flg 0.0 1.0 /end CHARACTERISTIC
/begin CHARACTERISTIC KINP_TFaceR_C_ovrdflg "" VALUE 0x0000 /* @ECU_Address@KINP_TFaceR_C_ovrdflg@ */ Scalar_BOOLEAN 0 SWC_INP_type_CM_boolean_flg 0.0 1.0 /end CHARACTERISTIC
/begin CHARACTERISTIC KINP_TFaceRrErr_enum_ovrdflg "" VALUE 0x0000 /* @ECU_Address@KINP_TFaceRrErr_enum_ovrdflg@ */ Scalar_BOOLEAN 0 SWC_INP_type_CM_boolean_flg 0.0 1.0 /end CHARACTERISTIC
/begin CHARACTERISTIC KINP_TFaceRr_C_ovrdflg "" VALUE 0x0000 /* @ECU_Address@KINP_TFaceRr_C_ovrdflg@ */ Scalar_BOOLEAN 0 SWC_INP_type_CM_boolean_flg 0.0 1.0 /end CHARACTERISTIC
/begin CHARACTERISTIC KINP_TFootLErr_enum_ovrdflg "" VALUE 0x0000 /* @ECU_Address@KINP_TFootLErr_enum_ovrdflg@ */ Scalar_BOOLEAN 0 SWC_INP_type_CM_boolean_flg 0.0 1.0 /end CHARACTERISTIC
/begin CHARACTERISTIC KINP_TFootL_C_ovrdflg "" VALUE 0x0000 /* @ECU_Address@KINP_TFootL_C_ovrdflg@ */ Scalar_BOOLEAN 0 SWC_INP_type_CM_boolean_flg 0.0 1.0 /end CHARACTERISTIC
/begin CHARACTERISTIC KINP_TFootRErr_enum_ovrdflg "" VALUE 0x0000 /* @ECU_Address@KINP_TFootRErr_enum_ovrdflg@ */ Scalar_BOOLEAN 0 SWC_INP_type_CM_boolean_flg 0.0 1.0 /end CHARACTERISTIC
/begin CHARACTERISTIC KINP_TFootR_C_ovrdflg "" VALUE 0x0000 /* @ECU_Address@KINP_TFootR_C_ovrdflg@ */ Scalar_BOOLEAN 0 SWC_INP_type_CM_boolean_flg 0.0 1.0 /end CHARACTERISTIC
/begin CHARACTERISTIC KINP_TFootRrErr_enum_ovrdflg "" VALUE 0x0000 /* @ECU_Address@KINP_TFootRrErr_enum_ovrdflg@ */ Scalar_BOOLEAN 0 SWC_INP_type_CM_boolean_flg 0.0 1.0 /end CHARACTERISTIC
/begin CHARACTERISTIC KINP_TFootRr_C_ovrdflg "" VALUE 0x0000 /* @ECU_Address@KINP_TFootRr_C_ovrdflg@ */ Scalar_BOOLEAN 0 SWC_INP_type_CM_boolean_flg 0.0 1.0 /end CHARACTERISTIC
/begin CHARACTERISTIC KINP_TambErr_enum_ovrdflg "" VALUE 0x0000 /* @ECU_Address@KINP_TambErr_enum_ovrdflg@ */ Scalar_BOOLEAN 0 SWC_INP_type_CM_boolean_flg 0.0 1.0 /end CHARACTERISTIC
/begin CHARACTERISTIC KINP_Tamb_C_ovrdflg "" VALUE 0x0000 /* @ECU_Address@KINP_Tamb_C_ovrdflg@ */ Scalar_BOOLEAN 0 SWC_INP_type_CM_boolean_flg 0.0 1.0 /end CHARACTERISTIC
/begin CHARACTERISTIC KINP_TevapErr_enum_ovrdflg "" VALUE 0x0000 /* @ECU_Address@KINP_TevapErr_enum_ovrdflg@ */ Scalar_BOOLEAN 0 SWC_INP_type_CM_boolean_flg 0.0 1.0 /end CHARACTERISTIC
/begin CHARACTERISTIC KINP_Tevap_C_ovrdflg "" VALUE 0x0000 /* @ECU_Address@KINP_Tevap_C_ovrdflg@ */ Scalar_BOOLEAN 0 SWC_INP_type_CM_boolean_flg 0.0 1.0 /end CHARACTERISTIC
/begin CHARACTERISTIC KINP_TincarErr_enum_ovrdflg "" VALUE 0x0000 /* @ECU_Address@KINP_TincarErr_enum_ovrdflg@ */ Scalar_BOOLEAN 0 SWC_INP_type_CM_boolean_flg 0.0 1.0 /end CHARACTERISTIC
/begin CHARACTERISTIC KINP_Tincar_C_ovrdflg "" VALUE 0x0000 /* @ECU_Address@KINP_Tincar_C_ovrdflg@ */ Scalar_BOOLEAN 0 SWC_INP_type_CM_boolean_flg 0.0 1.0 /end CHARACTERISTIC
/begin CHARACTERISTIC KINP_TrailerCheck_flg_defval "" VALUE 0x0000 /* @ECU_Address@KINP_TrailerCheck_flg_defval@ */ Scalar_BOOLEAN 0 SWC_INP_type_CM_boolean_flg 0.0 1.0 /end CHARACTERISTIC
/begin CHARACTERISTIC KINP_TrailerCheck_flg_ovrdflg "" VALUE 0x0000 /* @ECU_Address@KINP_TrailerCheck_flg_ovrdflg@ */ Scalar_BOOLEAN 0 SWC_INP_type_CM_boolean_flg 0.0 1.0 /end CHARACTERISTIC
/begin CHARACTERISTIC KINP_TrailerCheck_flg_ovrdval "" VALUE 0x0000 /* @ECU_Address@KINP_TrailerCheck_flg_ovrdval@ */ Scalar_BOOLEAN 0 SWC_INP_type_CM_boolean_flg 0.0 1.0 /end CHARACTERISTIC
/begin CHARACTERISTIC KINP_TrailerModeSta_enum_ovrdflg "" VALUE 0x0000 /* @ECU_Address@KINP_TrailerModeSta_enum_ovrdflg@ */ Scalar_BOOLEAN 0 SWC_INP_type_CM_boolean_flg 0.0 1.0 /end CHARACTERISTIC
/begin CHARACTERISTIC KINP_ZFRBCMChargerDoorSWSta_flg_defval "" VALUE 0x0000 /* @ECU_Address@KINP_ZFRBCMChargerDoorSWSta_flg_defval@ */ Scalar_BOOLEAN 0 SWC_INP_type_CM_boolean_flg 0.0 1.0 /end CHARACTERISTIC
/begin CHARACTERISTIC KINP_ZFRBCMChargerDoorSWSta_flg_ovrdflg "" VALUE 0x0000 /* @ECU_Address@KINP_ZFRBCMChargerDoorSWSta_flg_ovrdflg@ */ Scalar_BOOLEAN 0 SWC_INP_type_CM_boolean_flg 0.0 1.0 /end CHARACTERISTIC
/begin CHARACTERISTIC KINP_ZFRBCMChargerDoorSWSta_flg_ovrdval "" VALUE 0x0000 /* @ECU_Address@KINP_ZFRBCMChargerDoorSWSta_flg_ovrdval@ */ Scalar_BOOLEAN 0 SWC_INP_type_CM_boolean_flg 0.0 1.0 /end CHARACTERISTIC
/begin CHARACTERISTIC KINP_ZFRBCMHRLTurnLPNormalSta_flg_defval "" VALUE 0x0000 /* @ECU_Address@KINP_ZFRBCMHRLTurnLPNormalSta_flg_defval@ */ Scalar_BOOLEAN 0 SWC_INP_type_CM_boolean_flg 0.0 1.0 /end CHARACTERISTIC
/begin CHARACTERISTIC KINP_ZFRBCMHRLTurnLPNormalSta_flg_ovrdflg "" VALUE 0x0000 /* @ECU_Address@KINP_ZFRBCMHRLTurnLPNormalSta_flg_ovrdflg@ */ Scalar_BOOLEAN 0 SWC_INP_type_CM_boolean_flg 0.0 1.0 /end CHARACTERISTIC
/begin CHARACTERISTIC KINP_ZFRBCMHRLTurnLPNormalSta_flg_ovrdval "" VALUE 0x0000 /* @ECU_Address@KINP_ZFRBCMHRLTurnLPNormalSta_flg_ovrdval@ */ Scalar_BOOLEAN 0 SWC_INP_type_CM_boolean_flg 0.0 1.0 /end CHARACTERISTIC
/begin CHARACTERISTIC KINP_ZFRBCMHRRTurnLPHNormalSta_flg_defval "" VALUE 0x0000 /* @ECU_Address@KINP_ZFRBCMHRRTurnLPHNormalSta_flg_defval@ */ Scalar_BOOLEAN 0 SWC_INP_type_CM_boolean_flg 0.0 1.0 /end CHARACTERISTIC
/begin CHARACTERISTIC KINP_ZFRBCMHRRTurnLPHNormalSta_flg_ovrdflg "" VALUE 0x0000 /* @ECU_Address@KINP_ZFRBCMHRRTurnLPHNormalSta_flg_ovrdflg@ */ Scalar_BOOLEAN 0 SWC_INP_type_CM_boolean_flg 0.0 1.0 /end CHARACTERISTIC
/begin CHARACTERISTIC KINP_ZFRBCMHRRTurnLPHNormalSta_flg_ovrdval "" VALUE 0x0000 /* @ECU_Address@KINP_ZFRBCMHRRTurnLPHNormalSta_flg_ovrdval@ */ Scalar_BOOLEAN 0 SWC_INP_type_CM_boolean_flg 0.0 1.0 /end CHARACTERISTIC
/begin CHARACTERISTIC KINP_ZFRTHCMCLEVentActYSta_pct_ovrdflg "" VALUE 0x0000 /* @ECU_Address@KINP_ZFRTHCMCLEVentActYSta_pct_ovrdflg@ */ Scalar_BOOLEAN 0 SWC_INP_type_CM_boolean_flg 0.0 1.0 /end CHARACTERISTIC
/begin CHARACTERISTIC KINP_ZFRTHCMCREVentActYSta_pct_ovrdflg "" VALUE 0x0000 /* @ECU_Address@KINP_ZFRTHCMCREVentActYSta_pct_ovrdflg@ */ Scalar_BOOLEAN 0 SWC_INP_type_CM_boolean_flg 0.0 1.0 /end CHARACTERISTIC
/begin CHARACTERISTIC KINP_ZFRTHCMLEVentActYSta_pct_ovrdflg "" VALUE 0x0000 /* @ECU_Address@KINP_ZFRTHCMLEVentActYSta_pct_ovrdflg@ */ Scalar_BOOLEAN 0 SWC_INP_type_CM_boolean_flg 0.0 1.0 /end CHARACTERISTIC
/begin CHARACTERISTIC KINP_ZFRTHCMREVentActYSta_pct_ovrdflg "" VALUE 0x0000 /* @ECU_Address@KINP_ZFRTHCMREVentActYSta_pct_ovrdflg@ */ Scalar_BOOLEAN 0 SWC_INP_type_CM_boolean_flg 0.0 1.0 /end CHARACTERISTIC
/begin CHARACTERISTIC KINP_ZoneDrMalfunLevel_enum_ovrdflg "" VALUE 0x0000 /* @ECU_Address@KINP_ZoneDrMalfunLevel_enum_ovrdflg@ */ Scalar_BOOLEAN 0 SWC_INP_type_CM_boolean_flg 0.0 1.0 /end CHARACTERISTIC
/begin CHARACTERISTIC KINP_AGSErr_enum_defval "" VALUE 0x0000 /* @ECU_Address@KINP_AGSErr_enum_defval@ */ Scalar_UBYTE 0 SWC_INP_type_CM_uint8_enum 0.0 3.0 /end CHARACTERISTIC
/begin CHARACTERISTIC KINP_AGSErr_enum_ovrdval "" VALUE 0x0000 /* @ECU_Address@KINP_AGSErr_enum_ovrdval@ */ Scalar_UBYTE 0 SWC_INP_type_CM_uint8_enum 0.0 3.0 /end CHARACTERISTIC
/begin CHARACTERISTIC KINP_BDDSEATMemSetSta_enum_defval "" VALUE 0x0000 /* @ECU_Address@KINP_BDDSEATMemSetSta_enum_defval@ */ Scalar_UBYTE 0 SWC_INP_type_CM_uint8_enum 0.0 3.0 /end CHARACTERISTIC
/begin CHARACTERISTIC KINP_BDDSEATMemSetSta_enum_ovrdval "" VALUE 0x0000 /* @ECU_Address@KINP_BDDSEATMemSetSta_enum_ovrdval@ */ Scalar_UBYTE 0 SWC_INP_type_CM_uint8_enum 0.0 3.0 /end CHARACTERISTIC
/begin CHARACTERISTIC KINP_BDDSEATModeSta_enum_defval "" VALUE 0x0000 /* @ECU_Address@KINP_BDDSEATModeSta_enum_defval@ */ Scalar_UBYTE 0 SWC_INP_type_CM_uint8_enum 0.0 7.0 /end CHARACTERISTIC
/begin CHARACTERISTIC KINP_BDDSEATModeSta_enum_ovrdval "" VALUE 0x0000 /* @ECU_Address@KINP_BDDSEATModeSta_enum_ovrdval@ */ Scalar_UBYTE 0 SWC_INP_type_CM_uint8_enum 0.0 7.0 /end CHARACTERISTIC
/begin CHARACTERISTIC KINP_BDDSEATVentSta_enum_defval "" VALUE 0x0000 /* @ECU_Address@KINP_BDDSEATVentSta_enum_defval@ */ Scalar_UBYTE 0 SWC_INP_type_CM_uint8_enum 0.0 4.0 /end CHARACTERISTIC
/begin CHARACTERISTIC KINP_BDDSEATVentSta_enum_ovrdval "" VALUE 0x0000 /* @ECU_Address@KINP_BDDSEATVentSta_enum_ovrdval@ */ Scalar_UBYTE 0 SWC_INP_type_CM_uint8_enum 0.0 4.0 /end CHARACTERISTIC
/begin CHARACTERISTIC KINP_BDDSEATheaterSta_enum_defval "" VALUE 0x0000 /* @ECU_Address@KINP_BDDSEATheaterSta_enum_defval@ */ Scalar_UBYTE 0 SWC_INP_type_CM_uint8_enum 0.0 4.0 /end CHARACTERISTIC
/begin CHARACTERISTIC KINP_BDDSEATheaterSta_enum_ovrdval "" VALUE 0x0000 /* @ECU_Address@KINP_BDDSEATheaterSta_enum_ovrdval@ */ Scalar_UBYTE 0 SWC_INP_type_CM_uint8_enum 0.0 4.0 /end CHARACTERISTIC
/begin CHARACTERISTIC KINP_BPPSEATModeSta_enum_defval "" VALUE 0x0000 /* @ECU_Address@KINP_BPPSEATModeSta_enum_defval@ */ Scalar_UBYTE 0 SWC_INP_type_CM_uint8_enum 0.0 7.0 /end CHARACTERISTIC
/begin CHARACTERISTIC KINP_BPPSEATModeSta_enum_ovrdval "" VALUE 0x0000 /* @ECU_Address@KINP_BPPSEATModeSta_enum_ovrdval@ */ Scalar_UBYTE 0 SWC_INP_type_CM_uint8_enum 0.0 7.0 /end CHARACTERISTIC
/begin CHARACTERISTIC KINP_BPPSEATVentSta_enum_defval "" VALUE 0x0000 /* @ECU_Address@KINP_BPPSEATVentSta_enum_defval@ */ Scalar_UBYTE 0 SWC_INP_type_CM_uint8_enum 0.0 4.0 /end CHARACTERISTIC
/begin CHARACTERISTIC KINP_BPPSEATVentSta_enum_ovrdval "" VALUE 0x0000 /* @ECU_Address@KINP_BPPSEATVentSta_enum_ovrdval@ */ Scalar_UBYTE 0 SWC_INP_type_CM_uint8_enum 0.0 4.0 /end CHARACTERISTIC
/begin CHARACTERISTIC KINP_BPPSEATheaterSta_enum_defval "" VALUE 0x0000 /* @ECU_Address@KINP_BPPSEATheaterSta_enum_defval@ */ Scalar_UBYTE 0 SWC_INP_type_CM_uint8_enum 0.0 4.0 /end CHARACTERISTIC
/begin CHARACTERISTIC KINP_BPPSEATheaterSta_enum_ovrdval "" VALUE 0x0000 /* @ECU_Address@KINP_BPPSEATheaterSta_enum_ovrdval@ */ Scalar_UBYTE 0 SWC_INP_type_CM_uint8_enum 0.0 4.0 /end CHARACTERISTIC
/begin CHARACTERISTIC KINP_BPPTGActiveSta_enum_defval "" VALUE 0x0000 /* @ECU_Address@KINP_BPPTGActiveSta_enum_defval@ */ Scalar_UBYTE 0 SWC_INP_type_CM_uint8_enum 0.0 7.0 /end CHARACTERISTIC
/begin CHARACTERISTIC KINP_BPPTGActiveSta_enum_ovrdval "" VALUE 0x0000 /* @ECU_Address@KINP_BPPTGActiveSta_enum_ovrdval@ */ Scalar_UBYTE 0 SWC_INP_type_CM_uint8_enum 0.0 7.0 /end CHARACTERISTIC
/begin CHARACTERISTIC KINP_BPPTGInsideSW1Sta_enum_defval "" VALUE 0x0000 /* @ECU_Address@KINP_BPPTGInsideSW1Sta_enum_defval@ */ Scalar_UBYTE 0 SWC_INP_type_CM_uint8_enum 0.0 3.0 /end CHARACTERISTIC
/begin CHARACTERISTIC KINP_BPPTGInsideSW1Sta_enum_ovrdval "" VALUE 0x0000 /* @ECU_Address@KINP_BPPTGInsideSW1Sta_enum_ovrdval@ */ Scalar_UBYTE 0 SWC_INP_type_CM_uint8_enum 0.0 3.0 /end CHARACTERISTIC
/begin CHARACTERISTIC KINP_BPPTGInsideSW2Sta_enum_defval "" VALUE 0x0000 /* @ECU_Address@KINP_BPPTGInsideSW2Sta_enum_defval@ */ Scalar_UBYTE 0 SWC_INP_type_CM_uint8_enum 0.0 3.0 /end CHARACTERISTIC
/begin CHARACTERISTIC KINP_BPPTGInsideSW2Sta_enum_ovrdval "" VALUE 0x0000 /* @ECU_Address@KINP_BPPTGInsideSW2Sta_enum_ovrdval@ */ Scalar_UBYTE 0 SWC_INP_type_CM_uint8_enum 0.0 3.0 /end CHARACTERISTIC
/begin CHARACTERISTIC KINP_BPPTGRDILCmd_enum_defval "" VALUE 0x0000 /* @ECU_Address@KINP_BPPTGRDILCmd_enum_defval@ */ Scalar_UBYTE 0 SWC_INP_type_CM_uint8_enum 0.0 3.0 /end CHARACTERISTIC
/begin CHARACTERISTIC KINP_BPPTGRDILCmd_enum_ovrdval "" VALUE 0x0000 /* @ECU_Address@KINP_BPPTGRDILCmd_enum_ovrdval@ */ Scalar_UBYTE 0 SWC_INP_type_CM_uint8_enum 0.0 3.0 /end CHARACTERISTIC
/begin CHARACTERISTIC KINP_BPPTGSysSta_enum_defval "" VALUE 0x0000 /* @ECU_Address@KINP_BPPTGSysSta_enum_defval@ */ Scalar_UBYTE 0 SWC_INP_type_CM_uint8_enum 0.0 3.0 /end CHARACTERISTIC
/begin CHARACTERISTIC KINP_BPPTGSysSta_enum_ovrdval "" VALUE 0x0000 /* @ECU_Address@KINP_BPPTGSysSta_enum_ovrdval@ */ Scalar_UBYTE 0 SWC_INP_type_CM_uint8_enum 0.0 3.0 /end CHARACTERISTIC
/begin CHARACTERISTIC KINP_BPSEATLVentSta_enum_defval "" VALUE 0x0000 /* @ECU_Address@KINP_BPSEATLVentSta_enum_defval@ */ Scalar_UBYTE 0 SWC_INP_type_CM_uint8_enum 0.0 7.0 /end CHARACTERISTIC
/begin CHARACTERISTIC KINP_BPSEATLVentSta_enum_ovrdval "" VALUE 0x0000 /* @ECU_Address@KINP_BPSEATLVentSta_enum_ovrdval@ */ Scalar_UBYTE 0 SWC_INP_type_CM_uint8_enum 0.0 7.0 /end CHARACTERISTIC
/begin CHARACTERISTIC KINP_BPSEATMLVentSta_enum_defval "" VALUE 0x0000 /* @ECU_Address@KINP_BPSEATMLVentSta_enum_defval@ */ Scalar_UBYTE 0 SWC_INP_type_CM_uint8_enum 0.0 7.0 /end CHARACTERISTIC
/begin CHARACTERISTIC KINP_BPSEATMLVentSta_enum_ovrdval "" VALUE 0x0000 /* @ECU_Address@KINP_BPSEATMLVentSta_enum_ovrdval@ */ Scalar_UBYTE 0 SWC_INP_type_CM_uint8_enum 0.0 7.0 /end CHARACTERISTIC
/begin CHARACTERISTIC KINP_BPSEATMRVentSta_enum_defval "" VALUE 0x0000 /* @ECU_Address@KINP_BPSEATMRVentSta_enum_defval@ */ Scalar_UBYTE 0 SWC_INP_type_CM_uint8_enum 0.0 7.0 /end CHARACTERISTIC
/begin CHARACTERISTIC KINP_BPSEATMRVentSta_enum_ovrdval "" VALUE 0x0000 /* @ECU_Address@KINP_BPSEATMRVentSta_enum_ovrdval@ */ Scalar_UBYTE 0 SWC_INP_type_CM_uint8_enum 0.0 7.0 /end CHARACTERISTIC
/begin CHARACTERISTIC KINP_BPSEATRVentSta_enum_defval "" VALUE 0x0000 /* @ECU_Address@KINP_BPSEATRVentSta_enum_defval@ */ Scalar_UBYTE 0 SWC_INP_type_CM_uint8_enum 0.0 7.0 /end CHARACTERISTIC
/begin CHARACTERISTIC KINP_BPSEATRVentSta_enum_ovrdval "" VALUE 0x0000 /* @ECU_Address@KINP_BPSEATRVentSta_enum_ovrdval@ */ Scalar_UBYTE 0 SWC_INP_type_CM_uint8_enum 0.0 7.0 /end CHARACTERISTIC
/begin CHARACTERISTIC KINP_BatInTempErr_enum_defval "" VALUE 0x0000 /* @ECU_Address@KINP_BatInTempErr_enum_defval@ */ Scalar_UBYTE 0 SWC_INP_type_CM_uint8_enum 0.0 3.0 /end CHARACTERISTIC
/begin CHARACTERISTIC KINP_BatInTempErr_enum_ovrdval "" VALUE 0x0000 /* @ECU_Address@KINP_BatInTempErr_enum_ovrdval@ */ Scalar_UBYTE 0 SWC_INP_type_CM_uint8_enum 0.0 3.0 /end CHARACTERISTIC
/begin CHARACTERISTIC KINP_BlowerErr_enum_defval "" VALUE 0x0000 /* @ECU_Address@KINP_BlowerErr_enum_defval@ */ Scalar_UBYTE 0 SWC_INP_type_CM_uint8_enum 0.0 3.0 /end CHARACTERISTIC
/begin CHARACTERISTIC KINP_BlowerErr_enum_ovrdval "" VALUE 0x0000 /* @ECU_Address@KINP_BlowerErr_enum_ovrdval@ */ Scalar_UBYTE 0 SWC_INP_type_CM_uint8_enum 0.0 3.0 /end CHARACTERISTIC
/begin CHARACTERISTIC KINP_COMPErr_enum_defval "" VALUE 0x0000 /* @ECU_Address@KINP_COMPErr_enum_defval@ */ Scalar_UBYTE 0 SWC_INP_type_CM_uint8_enum 0.0 3.0 /end CHARACTERISTIC
/begin CHARACTERISTIC KINP_COMPErr_enum_ovrdval "" VALUE 0x0000 /* @ECU_Address@KINP_COMPErr_enum_ovrdval@ */ Scalar_UBYTE 0 SWC_INP_type_CM_uint8_enum 0.0 3.0 /end CHARACTERISTIC
/begin CHARACTERISTIC KINP_CSW2FWasSwSta_enum_defval "" VALUE 0x0000 /* @ECU_Address@KINP_CSW2FWasSwSta_enum_defval@ */ Scalar_UBYTE 0 SWC_INP_type_CM_uint8_enum 0.0 3.0 /end CHARACTERISTIC
/begin CHARACTERISTIC KINP_CSW2FWasSwSta_enum_ovrdval "" VALUE 0x0000 /* @ECU_Address@KINP_CSW2FWasSwSta_enum_ovrdval@ */ Scalar_UBYTE 0 SWC_INP_type_CM_uint8_enum 0.0 3.0 /end CHARACTERISTIC
/begin CHARACTERISTIC KINP_CSW2FWipSwSta_enum_defval "" VALUE 0x0000 /* @ECU_Address@KINP_CSW2FWipSwSta_enum_defval@ */ Scalar_UBYTE 0 SWC_INP_type_CM_uint8_enum 0.0 7.0 /end CHARACTERISTIC
/begin CHARACTERISTIC KINP_CSW2FWipSwSta_enum_ovrdval "" VALUE 0x0000 /* @ECU_Address@KINP_CSW2FWipSwSta_enum_ovrdval@ */ Scalar_UBYTE 0 SWC_INP_type_CM_uint8_enum 0.0 7.0 /end CHARACTERISTIC
/begin CHARACTERISTIC KINP_CSW2RWipWasSwSta_enum_defval "" VALUE 0x0000 /* @ECU_Address@KINP_CSW2RWipWasSwSta_enum_defval@ */ Scalar_UBYTE 0 SWC_INP_type_CM_uint8_enum 0.0 3.0 /end CHARACTERISTIC
/begin CHARACTERISTIC KINP_CSW2RWipWasSwSta_enum_ovrdval "" VALUE 0x0000 /* @ECU_Address@KINP_CSW2RWipWasSwSta_enum_ovrdval@ */ Scalar_UBYTE 0 SWC_INP_type_CM_uint8_enum 0.0 3.0 /end CHARACTERISTIC
/begin CHARACTERISTIC KINP_CSW2TurnSwSta_enum_defval "" VALUE 0x0000 /* @ECU_Address@KINP_CSW2TurnSwSta_enum_defval@ */ Scalar_UBYTE 0 SWC_INP_type_CM_uint8_enum 0.0 5.0 /end CHARACTERISTIC
/begin CHARACTERISTIC KINP_CSW2TurnSwSta_enum_ovrdval "" VALUE 0x0000 /* @ECU_Address@KINP_CSW2TurnSwSta_enum_ovrdval@ */ Scalar_UBYTE 0 SWC_INP_type_CM_uint8_enum 0.0 5.0 /end CHARACTERISTIC
/begin CHARACTERISTIC KINP_DKCKeyNumSta_enum_defval "" VALUE 0x0000 /* @ECU_Address@KINP_DKCKeyNumSta_enum_defval@ */ Scalar_UBYTE 0 SWC_INP_type_CM_uint8_enum 0.0 15.0 /end CHARACTERISTIC
/begin CHARACTERISTIC KINP_DKCKeyNumSta_enum_ovrdval "" VALUE 0x0000 /* @ECU_Address@KINP_DKCKeyNumSta_enum_ovrdval@ */ Scalar_UBYTE 0 SWC_INP_type_CM_uint8_enum 0.0 15.0 /end CHARACTERISTIC
/begin CHARACTERISTIC KINP_DKCKeyTypeSta_enum_defval "" VALUE 0x0000 /* @ECU_Address@KINP_DKCKeyTypeSta_enum_defval@ */ Scalar_UBYTE 0 SWC_INP_type_CM_uint8_enum 0.0 3.0 /end CHARACTERISTIC
/begin CHARACTERISTIC KINP_DKCKeyTypeSta_enum_ovrdval "" VALUE 0x0000 /* @ECU_Address@KINP_DKCKeyTypeSta_enum_ovrdval@ */ Scalar_UBYTE 0 SWC_INP_type_CM_uint8_enum 0.0 3.0 /end CHARACTERISTIC
/begin CHARACTERISTIC KINP_DKCPDkeyAreaRAPSSta_enum_defval "" VALUE 0x0000 /* @ECU_Address@KINP_DKCPDkeyAreaRAPSSta_enum_defval@ */ Scalar_UBYTE 0 SWC_INP_type_CM_uint8_enum 0.0 3.0 /end CHARACTERISTIC
/begin CHARACTERISTIC KINP_DKCPDkeyAreaRAPSSta_enum_ovrdval "" VALUE 0x0000 /* @ECU_Address@KINP_DKCPDkeyAreaRAPSSta_enum_ovrdval@ */ Scalar_UBYTE 0 SWC_INP_type_CM_uint8_enum 0.0 3.0 /end CHARACTERISTIC
/begin CHARACTERISTIC KINP_DKCParkingModeCmd_enum_defval "" VALUE 0x0000 /* @ECU_Address@KINP_DKCParkingModeCmd_enum_defval@ */ Scalar_UBYTE 0 SWC_INP_type_CM_uint8_enum 0.0 4.0 /end CHARACTERISTIC
/begin CHARACTERISTIC KINP_DKCParkingModeCmd_enum_ovrdval "" VALUE 0x0000 /* @ECU_Address@KINP_DKCParkingModeCmd_enum_ovrdval@ */ Scalar_UBYTE 0 SWC_INP_type_CM_uint8_enum 0.0 4.0 /end CHARACTERISTIC
/begin CHARACTERISTIC KINP_DKCReVehData_enum_defval "" VALUE 0x0000 /* @ECU_Address@KINP_DKCReVehData_enum_defval@ */ Scalar_UBYTE 0 SWC_INP_type_CM_uint8_enum 0.0 15.0 /end CHARACTERISTIC
/begin CHARACTERISTIC KINP_DKCReVehData_enum_ovrdval "" VALUE 0x0000 /* @ECU_Address@KINP_DKCReVehData_enum_ovrdval@ */ Scalar_UBYTE 0 SWC_INP_type_CM_uint8_enum 0.0 15.0 /end CHARACTERISTIC
/begin CHARACTERISTIC KINP_EACProtectEnable_enum_defval "" VALUE 0x0000 /* @ECU_Address@KINP_EACProtectEnable_enum_defval@ */ Scalar_UBYTE 0 SWC_INP_type_CM_uint8_enum 0.0 2.0 /end CHARACTERISTIC
/begin CHARACTERISTIC KINP_EACProtectEnable_enum_ovrdval "" VALUE 0x0000 /* @ECU_Address@KINP_EACProtectEnable_enum_ovrdval@ */ Scalar_UBYTE 0 SWC_INP_type_CM_uint8_enum 0.0 2.0 /end CHARACTERISTIC
/begin CHARACTERISTIC KINP_EWP3Err_enum_defval "" VALUE 0x0000 /* @ECU_Address@KINP_EWP3Err_enum_defval@ */ Scalar_UBYTE 0 SWC_INP_type_CM_uint8_enum 0.0 3.0 /end CHARACTERISTIC
/begin CHARACTERISTIC KINP_EWP3Err_enum_ovrdval "" VALUE 0x0000 /* @ECU_Address@KINP_EWP3Err_enum_ovrdval@ */ Scalar_UBYTE 0 SWC_INP_type_CM_uint8_enum 0.0 3.0 /end CHARACTERISTIC
/begin CHARACTERISTIC KINP_EXV1Err_enum_defval "" VALUE 0x0000 /* @ECU_Address@KINP_EXV1Err_enum_defval@ */ Scalar_UBYTE 0 SWC_INP_type_CM_uint8_enum 0.0 3.0 /end CHARACTERISTIC
/begin CHARACTERISTIC KINP_EXV1Err_enum_ovrdval "" VALUE 0x0000 /* @ECU_Address@KINP_EXV1Err_enum_ovrdval@ */ Scalar_UBYTE 0 SWC_INP_type_CM_uint8_enum 0.0 3.0 /end CHARACTERISTIC
/begin CHARACTERISTIC KINP_EXV2Err_enum_defval "" VALUE 0x0000 /* @ECU_Address@KINP_EXV2Err_enum_defval@ */ Scalar_UBYTE 0 SWC_INP_type_CM_uint8_enum 0.0 3.0 /end CHARACTERISTIC
/begin CHARACTERISTIC KINP_EXV2Err_enum_ovrdval "" VALUE 0x0000 /* @ECU_Address@KINP_EXV2Err_enum_ovrdval@ */ Scalar_UBYTE 0 SWC_INP_type_CM_uint8_enum 0.0 3.0 /end CHARACTERISTIC
/begin CHARACTERISTIC KINP_FanErr_enum_defval "" VALUE 0x0000 /* @ECU_Address@KINP_FanErr_enum_defval@ */ Scalar_UBYTE 0 SWC_INP_type_CM_uint8_enum 0.0 3.0 /end CHARACTERISTIC
/begin CHARACTERISTIC KINP_FanErr_enum_ovrdval "" VALUE 0x0000 /* @ECU_Address@KINP_FanErr_enum_ovrdval@ */ Scalar_UBYTE 0 SWC_INP_type_CM_uint8_enum 0.0 3.0 /end CHARACTERISTIC
/begin CHARACTERISTIC KINP_FrFailcodehistory2Nidec_enum_defval "" VALUE 0x0000 /* @ECU_Address@KINP_FrFailcodehistory2Nidec_enum_defval@ */ Scalar_UBYTE 0 SWC_INP_type_CM_uint8_enum 0.0 2.0 /end CHARACTERISTIC
/begin CHARACTERISTIC KINP_FrFailcodehistory2Nidec_enum_ovrdval "" VALUE 0x0000 /* @ECU_Address@KINP_FrFailcodehistory2Nidec_enum_ovrdval@ */ Scalar_UBYTE 0 SWC_INP_type_CM_uint8_enum 0.0 2.0 /end CHARACTERISTIC
/begin CHARACTERISTIC KINP_FrMCUTempWarnNidec_enum_defval "" VALUE 0x0000 /* @ECU_Address@KINP_FrMCUTempWarnNidec_enum_defval@ */ Scalar_UBYTE 0 SWC_INP_type_CM_uint8_enum 0.0 3.0 /end CHARACTERISTIC
/begin CHARACTERISTIC KINP_FrMCUTempWarnNidec_enum_ovrdval "" VALUE 0x0000 /* @ECU_Address@KINP_FrMCUTempWarnNidec_enum_ovrdval@ */ Scalar_UBYTE 0 SWC_INP_type_CM_uint8_enum 0.0 3.0 /end CHARACTERISTIC
/begin CHARACTERISTIC KINP_FrTMTempWarnNidec_enum_defval "" VALUE 0x0000 /* @ECU_Address@KINP_FrTMTempWarnNidec_enum_defval@ */ Scalar_UBYTE 0 SWC_INP_type_CM_uint8_enum 0.0 3.0 /end CHARACTERISTIC
/begin CHARACTERISTIC KINP_FrTMTempWarnNidec_enum_ovrdval "" VALUE 0x0000 /* @ECU_Address@KINP_FrTMTempWarnNidec_enum_ovrdval@ */ Scalar_UBYTE 0 SWC_INP_type_CM_uint8_enum 0.0 3.0 /end CHARACTERISTIC
/begin CHARACTERISTIC KINP_MCUWarnRNidec_enum_defval "" VALUE 0x0000 /* @ECU_Address@KINP_MCUWarnRNidec_enum_defval@ */ Scalar_UBYTE 0 SWC_INP_type_CM_uint8_enum 0.0 7.0 /end CHARACTERISTIC
/begin CHARACTERISTIC KINP_MCUWarnRNidec_enum_ovrdval "" VALUE 0x0000 /* @ECU_Address@KINP_MCUWarnRNidec_enum_ovrdval@ */ Scalar_UBYTE 0 SWC_INP_type_CM_uint8_enum 0.0 7.0 /end CHARACTERISTIC
/begin CHARACTERISTIC KINP_MotorInTempErr_enum_defval "" VALUE 0x0000 /* @ECU_Address@KINP_MotorInTempErr_enum_defval@ */ Scalar_UBYTE 0 SWC_INP_type_CM_uint8_enum 0.0 3.0 /end CHARACTERISTIC
/begin CHARACTERISTIC KINP_MotorInTempErr_enum_ovrdval "" VALUE 0x0000 /* @ECU_Address@KINP_MotorInTempErr_enum_ovrdval@ */ Scalar_UBYTE 0 SWC_INP_type_CM_uint8_enum 0.0 3.0 /end CHARACTERISTIC
/begin CHARACTERISTIC KINP_MotorOutTempErr_enum_defval "" VALUE 0x0000 /* @ECU_Address@KINP_MotorOutTempErr_enum_defval@ */ Scalar_UBYTE 0 SWC_INP_type_CM_uint8_enum 0.0 3.0 /end CHARACTERISTIC
/begin CHARACTERISTIC KINP_MotorOutTempErr_enum_ovrdval "" VALUE 0x0000 /* @ECU_Address@KINP_MotorOutTempErr_enum_ovrdval@ */ Scalar_UBYTE 0 SWC_INP_type_CM_uint8_enum 0.0 3.0 /end CHARACTERISTIC
/begin CHARACTERISTIC KINP_PCommandToBCM_enum_defval "" VALUE 0x0000 /* @ECU_Address@KINP_PCommandToBCM_enum_defval@ */ Scalar_UBYTE 0 SWC_INP_type_CM_uint8_enum 0.0 15.0 /end CHARACTERISTIC
/begin CHARACTERISTIC KINP_PCommandToBCM_enum_ovrdval "" VALUE 0x0000 /* @ECU_Address@KINP_PCommandToBCM_enum_ovrdval@ */ Scalar_UBYTE 0 SWC_INP_type_CM_uint8_enum 0.0 15.0 /end CHARACTERISTIC
/begin CHARACTERISTIC KINP_PCommandToPTG_enum_defval "" VALUE 0x0000 /* @ECU_Address@KINP_PCommandToPTG_enum_defval@ */ Scalar_UBYTE 0 SWC_INP_type_CM_uint8_enum 0.0 5.0 /end CHARACTERISTIC
/begin CHARACTERISTIC KINP_PCommandToPTG_enum_ovrdval "" VALUE 0x0000 /* @ECU_Address@KINP_PCommandToPTG_enum_ovrdval@ */ Scalar_UBYTE 0 SWC_INP_type_CM_uint8_enum 0.0 5.0 /end CHARACTERISTIC
/begin CHARACTERISTIC KINP_PDKeyAreaLockUnlock_enum_defval "" VALUE 0x0000 /* @ECU_Address@KINP_PDKeyAreaLockUnlock_enum_defval@ */ Scalar_UBYTE 0 SWC_INP_type_CM_uint8_enum 0.0 3.0 /end CHARACTERISTIC
/begin CHARACTERISTIC KINP_PDKeyAreaLockUnlock_enum_ovrdval "" VALUE 0x0000 /* @ECU_Address@KINP_PDKeyAreaLockUnlock_enum_ovrdval@ */ Scalar_UBYTE 0 SWC_INP_type_CM_uint8_enum 0.0 3.0 /end CHARACTERISTIC
/begin CHARACTERISTIC KINP_PDKeyAreaPS_enum_defval "" VALUE 0x0000 /* @ECU_Address@KINP_PDKeyAreaPS_enum_defval@ */ Scalar_UBYTE 0 SWC_INP_type_CM_uint8_enum 0.0 3.0 /end CHARACTERISTIC
/begin CHARACTERISTIC KINP_PDKeyAreaPS_enum_ovrdval "" VALUE 0x0000 /* @ECU_Address@KINP_PDKeyAreaPS_enum_ovrdval@ */ Scalar_UBYTE 0 SWC_INP_type_CM_uint8_enum 0.0 3.0 /end CHARACTERISTIC
/begin CHARACTERISTIC KINP_PDKeyAreaPTG_enum_defval "" VALUE 0x0000 /* @ECU_Address@KINP_PDKeyAreaPTG_enum_defval@ */ Scalar_UBYTE 0 SWC_INP_type_CM_uint8_enum 0.0 3.0 /end CHARACTERISTIC
/begin CHARACTERISTIC KINP_PDKeyAreaPTG_enum_ovrdval "" VALUE 0x0000 /* @ECU_Address@KINP_PDKeyAreaPTG_enum_ovrdval@ */ Scalar_UBYTE 0 SWC_INP_type_CM_uint8_enum 0.0 3.0 /end CHARACTERISTIC
/begin CHARACTERISTIC KINP_PDKeyWelcome_enum_defval "" VALUE 0x0000 /* @ECU_Address@KINP_PDKeyWelcome_enum_defval@ */ Scalar_UBYTE 0 SWC_INP_type_CM_uint8_enum 0.0 15.0 /end CHARACTERISTIC
/begin CHARACTERISTIC KINP_PDKeyWelcome_enum_ovrdval "" VALUE 0x0000 /* @ECU_Address@KINP_PDKeyWelcome_enum_ovrdval@ */ Scalar_UBYTE 0 SWC_INP_type_CM_uint8_enum 0.0 15.0 /end CHARACTERISTIC
/begin CHARACTERISTIC KINP_PDkeyShowIVI_enum_defval "" VALUE 0x0000 /* @ECU_Address@KINP_PDkeyShowIVI_enum_defval@ */ Scalar_UBYTE 0 SWC_INP_type_CM_uint8_enum 0.0 15.0 /end CHARACTERISTIC
/begin CHARACTERISTIC KINP_PDkeyShowIVI_enum_ovrdval "" VALUE 0x0000 /* @ECU_Address@KINP_PDkeyShowIVI_enum_ovrdval@ */ Scalar_UBYTE 0 SWC_INP_type_CM_uint8_enum 0.0 15.0 /end CHARACTERISTIC
/begin CHARACTERISTIC KINP_PKeyMode_enum_defval "" VALUE 0x0000 /* @ECU_Address@KINP_PKeyMode_enum_defval@ */ Scalar_UBYTE 0 SWC_INP_type_CM_uint8_enum 0.0 15.0 /end CHARACTERISTIC
/begin CHARACTERISTIC KINP_PKeyMode_enum_ovrdval "" VALUE 0x0000 /* @ECU_Address@KINP_PKeyMode_enum_ovrdval@ */ Scalar_UBYTE 0 SWC_INP_type_CM_uint8_enum 0.0 15.0 /end CHARACTERISTIC
/begin CHARACTERISTIC KINP_PTGActiveSta_enum_defval "" VALUE 0x0000 /* @ECU_Address@KINP_PTGActiveSta_enum_defval@ */ Scalar_UBYTE 0 SWC_INP_type_CM_uint8_enum 0.0 7.0 /end CHARACTERISTIC
/begin CHARACTERISTIC KINP_PTGActiveSta_enum_ovrdval "" VALUE 0x0000 /* @ECU_Address@KINP_PTGActiveSta_enum_ovrdval@ */ Scalar_UBYTE 0 SWC_INP_type_CM_uint8_enum 0.0 7.0 /end CHARACTERISTIC
/begin CHARACTERISTIC KINP_PTGHWVer_enum_defval "" VALUE 0x0000 /* @ECU_Address@KINP_PTGHWVer_enum_defval@ */ Scalar_UBYTE 0 SWC_INP_type_CM_uint8_enum 0.0 31.0 /end CHARACTERISTIC
/begin CHARACTERISTIC KINP_PTGHWVer_enum_ovrdval "" VALUE 0x0000 /* @ECU_Address@KINP_PTGHWVer_enum_ovrdval@ */ Scalar_UBYTE 0 SWC_INP_type_CM_uint8_enum 0.0 31.0 /end CHARACTERISTIC
/begin CHARACTERISTIC KINP_PTGInnerSW2_enum_defval "" VALUE 0x0000 /* @ECU_Address@KINP_PTGInnerSW2_enum_defval@ */ Scalar_UBYTE 0 SWC_INP_type_CM_uint8_enum 0.0 3.0 /end CHARACTERISTIC
/begin CHARACTERISTIC KINP_PTGInnerSW2_enum_ovrdval "" VALUE 0x0000 /* @ECU_Address@KINP_PTGInnerSW2_enum_ovrdval@ */ Scalar_UBYTE 0 SWC_INP_type_CM_uint8_enum 0.0 3.0 /end CHARACTERISTIC
/begin CHARACTERISTIC KINP_PTGRDILSta_enum_defval "" VALUE 0x0000 /* @ECU_Address@KINP_PTGRDILSta_enum_defval@ */ Scalar_UBYTE 0 SWC_INP_type_CM_uint8_enum 0.0 3.0 /end CHARACTERISTIC
/begin CHARACTERISTIC KINP_PTGRDILSta_enum_ovrdval "" VALUE 0x0000 /* @ECU_Address@KINP_PTGRDILSta_enum_ovrdval@ */ Scalar_UBYTE 0 SWC_INP_type_CM_uint8_enum 0.0 3.0 /end CHARACTERISTIC
/begin CHARACTERISTIC KINP_PTGSWVer_enum_defval "" VALUE 0x0000 /* @ECU_Address@KINP_PTGSWVer_enum_defval@ */ Scalar_UBYTE 0 SWC_INP_type_CM_uint8_enum 0.0 31.0 /end CHARACTERISTIC
/begin CHARACTERISTIC KINP_PTGSWVer_enum_ovrdval "" VALUE 0x0000 /* @ECU_Address@KINP_PTGSWVer_enum_ovrdval@ */ Scalar_UBYTE 0 SWC_INP_type_CM_uint8_enum 0.0 31.0 /end CHARACTERISTIC
/begin CHARACTERISTIC KINP_PTGSysSta_enum_defval "" VALUE 0x0000 /* @ECU_Address@KINP_PTGSysSta_enum_defval@ */ Scalar_UBYTE 0 SWC_INP_type_CM_uint8_enum 0.0 3.0 /end CHARACTERISTIC
/begin CHARACTERISTIC KINP_PTGSysSta_enum_ovrdval "" VALUE 0x0000 /* @ECU_Address@KINP_PTGSysSta_enum_ovrdval@ */ Scalar_UBYTE 0 SWC_INP_type_CM_uint8_enum 0.0 3.0 /end CHARACTERISTIC
/begin CHARACTERISTIC KINP_PTHighPErr_enum_defval "" VALUE 0x0000 /* @ECU_Address@KINP_PTHighPErr_enum_defval@ */ Scalar_UBYTE 0 SWC_INP_type_CM_uint8_enum 0.0 3.0 /end CHARACTERISTIC
/begin CHARACTERISTIC KINP_PTHighPErr_enum_ovrdval "" VALUE 0x0000 /* @ECU_Address@KINP_PTHighPErr_enum_ovrdval@ */ Scalar_UBYTE 0 SWC_INP_type_CM_uint8_enum 0.0 3.0 /end CHARACTERISTIC
/begin CHARACTERISTIC KINP_PTHighTactErr_enum_defval "" VALUE 0x0000 /* @ECU_Address@KINP_PTHighTactErr_enum_defval@ */ Scalar_UBYTE 0 SWC_INP_type_CM_uint8_enum 0.0 3.0 /end CHARACTERISTIC
/begin CHARACTERISTIC KINP_PTHighTactErr_enum_ovrdval "" VALUE 0x0000 /* @ECU_Address@KINP_PTHighTactErr_enum_ovrdval@ */ Scalar_UBYTE 0 SWC_INP_type_CM_uint8_enum 0.0 3.0 /end CHARACTERISTIC
/begin CHARACTERISTIC KINP_PTLowP1Err_enum_defval "" VALUE 0x0000 /* @ECU_Address@KINP_PTLowP1Err_enum_defval@ */ Scalar_UBYTE 0 SWC_INP_type_CM_uint8_enum 0.0 3.0 /end CHARACTERISTIC
/begin CHARACTERISTIC KINP_PTLowP1Err_enum_ovrdval "" VALUE 0x0000 /* @ECU_Address@KINP_PTLowP1Err_enum_ovrdval@ */ Scalar_UBYTE 0 SWC_INP_type_CM_uint8_enum 0.0 3.0 /end CHARACTERISTIC
/begin CHARACTERISTIC KINP_PTLowP2Err_enum_defval "" VALUE 0x0000 /* @ECU_Address@KINP_PTLowP2Err_enum_defval@ */ Scalar_UBYTE 0 SWC_INP_type_CM_uint8_enum 0.0 3.0 /end CHARACTERISTIC
/begin CHARACTERISTIC KINP_PTLowP2Err_enum_ovrdval "" VALUE 0x0000 /* @ECU_Address@KINP_PTLowP2Err_enum_ovrdval@ */ Scalar_UBYTE 0 SWC_INP_type_CM_uint8_enum 0.0 3.0 /end CHARACTERISTIC
/begin CHARACTERISTIC KINP_PTLowT1Err_enum_defval "" VALUE 0x0000 /* @ECU_Address@KINP_PTLowT1Err_enum_defval@ */ Scalar_UBYTE 0 SWC_INP_type_CM_uint8_enum 0.0 3.0 /end CHARACTERISTIC
/begin CHARACTERISTIC KINP_PTLowT1Err_enum_ovrdval "" VALUE 0x0000 /* @ECU_Address@KINP_PTLowT1Err_enum_ovrdval@ */ Scalar_UBYTE 0 SWC_INP_type_CM_uint8_enum 0.0 3.0 /end CHARACTERISTIC
/begin CHARACTERISTIC KINP_PTLowT2Err_enum_defval "" VALUE 0x0000 /* @ECU_Address@KINP_PTLowT2Err_enum_defval@ */ Scalar_UBYTE 0 SWC_INP_type_CM_uint8_enum 0.0 3.0 /end CHARACTERISTIC
/begin CHARACTERISTIC KINP_PTLowT2Err_enum_ovrdval "" VALUE 0x0000 /* @ECU_Address@KINP_PTLowT2Err_enum_ovrdval@ */ Scalar_UBYTE 0 SWC_INP_type_CM_uint8_enum 0.0 3.0 /end CHARACTERISTIC
/begin CHARACTERISTIC KINP_RrEDURotateDirctionNidec_enum_defval "" VALUE 0x0000 /* @ECU_Address@KINP_RrEDURotateDirctionNidec_enum_defval@ */ Scalar_UBYTE 0 SWC_INP_type_CM_uint8_enum 0.0 2.0 /end CHARACTERISTIC
/begin CHARACTERISTIC KINP_RrEDURotateDirctionNidec_enum_ovrdval "" VALUE 0x0000 /* @ECU_Address@KINP_RrEDURotateDirctionNidec_enum_ovrdval@ */ Scalar_UBYTE 0 SWC_INP_type_CM_uint8_enum 0.0 2.0 /end CHARACTERISTIC
/begin CHARACTERISTIC KINP_RrFailcode1Nidec_enum_defval "" VALUE 0x0000 /* @ECU_Address@KINP_RrFailcode1Nidec_enum_defval@ */ Scalar_UBYTE 0 SWC_INP_type_CM_uint8_enum 0.0 255.0 /end CHARACTERISTIC
/begin CHARACTERISTIC KINP_RrFailcode1Nidec_enum_ovrdval "" VALUE 0x0000 /* @ECU_Address@KINP_RrFailcode1Nidec_enum_ovrdval@ */ Scalar_UBYTE 0 SWC_INP_type_CM_uint8_enum 0.0 255.0 /end CHARACTERISTIC
/begin CHARACTERISTIC KINP_RrFailcode2Nidec_enum_defval "" VALUE 0x0000 /* @ECU_Address@KINP_RrFailcode2Nidec_enum_defval@ */ Scalar_UBYTE 0 SWC_INP_type_CM_uint8_enum 0.0 255.0 /end CHARACTERISTIC
/begin CHARACTERISTIC KINP_RrFailcode2Nidec_enum_ovrdval "" VALUE 0x0000 /* @ECU_Address@KINP_RrFailcode2Nidec_enum_ovrdval@ */ Scalar_UBYTE 0 SWC_INP_type_CM_uint8_enum 0.0 255.0 /end CHARACTERISTIC
/begin CHARACTERISTIC KINP_RrFailcodehistory1Nidec_enum_defval "" VALUE 0x0000 /* @ECU_Address@KINP_RrFailcodehistory1Nidec_enum_defval@ */ Scalar_UBYTE 0 SWC_INP_type_CM_uint8_enum 0.0 2.0 /end CHARACTERISTIC
/begin CHARACTERISTIC KINP_RrFailcodehistory1Nidec_enum_ovrdval "" VALUE 0x0000 /* @ECU_Address@KINP_RrFailcodehistory1Nidec_enum_ovrdval@ */ Scalar_UBYTE 0 SWC_INP_type_CM_uint8_enum 0.0 2.0 /end CHARACTERISTIC
/begin CHARACTERISTIC KINP_RrFailcodehistory2Nidec_enum_defval "" VALUE 0x0000 /* @ECU_Address@KINP_RrFailcodehistory2Nidec_enum_defval@ */ Scalar_UBYTE 0 SWC_INP_type_CM_uint8_enum 0.0 2.0 /end CHARACTERISTIC
/begin CHARACTERISTIC KINP_RrFailcodehistory2Nidec_enum_ovrdval "" VALUE 0x0000 /* @ECU_Address@KINP_RrFailcodehistory2Nidec_enum_ovrdval@ */ Scalar_UBYTE 0 SWC_INP_type_CM_uint8_enum 0.0 2.0 /end CHARACTERISTIC
/begin CHARACTERISTIC KINP_RrMCU1ChksumNidec_enum_defval "" VALUE 0x0000 /* @ECU_Address@KINP_RrMCU1ChksumNidec_enum_defval@ */ Scalar_UBYTE 0 SWC_INP_type_CM_uint8_enum 0.0 255.0 /end CHARACTERISTIC
/begin CHARACTERISTIC KINP_RrMCU1ChksumNidec_enum_ovrdval "" VALUE 0x0000 /* @ECU_Address@KINP_RrMCU1ChksumNidec_enum_ovrdval@ */ Scalar_UBYTE 0 SWC_INP_type_CM_uint8_enum 0.0 255.0 /end CHARACTERISTIC
/begin CHARACTERISTIC KINP_RrMCU1RolCntNidec_enum_defval "" VALUE 0x0000 /* @ECU_Address@KINP_RrMCU1RolCntNidec_enum_defval@ */ Scalar_UBYTE 0 SWC_INP_type_CM_uint8_enum 0.0 15.0 /end CHARACTERISTIC
/begin CHARACTERISTIC KINP_RrMCU1RolCntNidec_enum_ovrdval "" VALUE 0x0000 /* @ECU_Address@KINP_RrMCU1RolCntNidec_enum_ovrdval@ */ Scalar_UBYTE 0 SWC_INP_type_CM_uint8_enum 0.0 15.0 /end CHARACTERISTIC
/begin CHARACTERISTIC KINP_RrMCUErrNidec_enum_defval "" VALUE 0x0000 /* @ECU_Address@KINP_RrMCUErrNidec_enum_defval@ */ Scalar_UBYTE 0 SWC_INP_type_CM_uint8_enum 0.0 255.0 /end CHARACTERISTIC
/begin CHARACTERISTIC KINP_RrMCUErrNidec_enum_ovrdval "" VALUE 0x0000 /* @ECU_Address@KINP_RrMCUErrNidec_enum_ovrdval@ */ Scalar_UBYTE 0 SWC_INP_type_CM_uint8_enum 0.0 255.0 /end CHARACTERISTIC
/begin CHARACTERISTIC KINP_RrMCUSysStaNidec_enum_defval "" VALUE 0x0000 /* @ECU_Address@KINP_RrMCUSysStaNidec_enum_defval@ */ Scalar_UBYTE 0 SWC_INP_type_CM_uint8_enum 0.0 15.0 /end CHARACTERISTIC
/begin CHARACTERISTIC KINP_RrMCUSysStaNidec_enum_ovrdval "" VALUE 0x0000 /* @ECU_Address@KINP_RrMCUSysStaNidec_enum_ovrdval@ */ Scalar_UBYTE 0 SWC_INP_type_CM_uint8_enum 0.0 15.0 /end CHARACTERISTIC
/begin CHARACTERISTIC KINP_RrMCUTempWarnNidec_enum_defval "" VALUE 0x0000 /* @ECU_Address@KINP_RrMCUTempWarnNidec_enum_defval@ */ Scalar_UBYTE 0 SWC_INP_type_CM_uint8_enum 0.0 3.0 /end CHARACTERISTIC
/begin CHARACTERISTIC KINP_RrMCUTempWarnNidec_enum_ovrdval "" VALUE 0x0000 /* @ECU_Address@KINP_RrMCUTempWarnNidec_enum_ovrdval@ */ Scalar_UBYTE 0 SWC_INP_type_CM_uint8_enum 0.0 3.0 /end CHARACTERISTIC
/begin CHARACTERISTIC KINP_RrTMTempWarnNidec_enum_defval "" VALUE 0x0000 /* @ECU_Address@KINP_RrTMTempWarnNidec_enum_defval@ */ Scalar_UBYTE 0 SWC_INP_type_CM_uint8_enum 0.0 3.0 /end CHARACTERISTIC
/begin CHARACTERISTIC KINP_RrTMTempWarnNidec_enum_ovrdval "" VALUE 0x0000 /* @ECU_Address@KINP_RrTMTempWarnNidec_enum_ovrdval@ */ Scalar_UBYTE 0 SWC_INP_type_CM_uint8_enum 0.0 3.0 /end CHARACTERISTIC
/begin CHARACTERISTIC KINP_SOTXVErr_enum_defval "" VALUE 0x0000 /* @ECU_Address@KINP_SOTXVErr_enum_defval@ */ Scalar_UBYTE 0 SWC_INP_type_CM_uint8_enum 0.0 3.0 /end CHARACTERISTIC
/begin CHARACTERISTIC KINP_SOTXVErr_enum_ovrdval "" VALUE 0x0000 /* @ECU_Address@KINP_SOTXVErr_enum_ovrdval@ */ Scalar_UBYTE 0 SWC_INP_type_CM_uint8_enum 0.0 3.0 /end CHARACTERISTIC
/begin CHARACTERISTIC KINP_SOV1Err_enum_defval "" VALUE 0x0000 /* @ECU_Address@KINP_SOV1Err_enum_defval@ */ Scalar_UBYTE 0 SWC_INP_type_CM_uint8_enum 0.0 3.0 /end CHARACTERISTIC
/begin CHARACTERISTIC KINP_SOV1Err_enum_ovrdval "" VALUE 0x0000 /* @ECU_Address@KINP_SOV1Err_enum_ovrdval@ */ Scalar_UBYTE 0 SWC_INP_type_CM_uint8_enum 0.0 3.0 /end CHARACTERISTIC
/begin CHARACTERISTIC KINP_SOV2Err_enum_defval "" VALUE 0x0000 /* @ECU_Address@KINP_SOV2Err_enum_defval@ */ Scalar_UBYTE 0 SWC_INP_type_CM_uint8_enum 0.0 3.0 /end CHARACTERISTIC
/begin CHARACTERISTIC KINP_SOV2Err_enum_ovrdval "" VALUE 0x0000 /* @ECU_Address@KINP_SOV2Err_enum_ovrdval@ */ Scalar_UBYTE 0 SWC_INP_type_CM_uint8_enum 0.0 3.0 /end CHARACTERISTIC
/begin CHARACTERISTIC KINP_SOV3Err_enum_defval "" VALUE 0x0000 /* @ECU_Address@KINP_SOV3Err_enum_defval@ */ Scalar_UBYTE 0 SWC_INP_type_CM_uint8_enum 0.0 3.0 /end CHARACTERISTIC
/begin CHARACTERISTIC KINP_SOV3Err_enum_ovrdval "" VALUE 0x0000 /* @ECU_Address@KINP_SOV3Err_enum_ovrdval@ */ Scalar_UBYTE 0 SWC_INP_type_CM_uint8_enum 0.0 3.0 /end CHARACTERISTIC
/begin CHARACTERISTIC KINP_ShifterCRC8_enum_defval "" VALUE 0x0000 /* @ECU_Address@KINP_ShifterCRC8_enum_defval@ */ Scalar_UBYTE 0 SWC_INP_type_CM_uint8_enum 0.0 255.0 /end CHARACTERISTIC
/begin CHARACTERISTIC KINP_ShifterCRC8_enum_ovrdval "" VALUE 0x0000 /* @ECU_Address@KINP_ShifterCRC8_enum_ovrdval@ */ Scalar_UBYTE 0 SWC_INP_type_CM_uint8_enum 0.0 255.0 /end CHARACTERISTIC
/begin CHARACTERISTIC KINP_ShifterFailsta_enum_defval "" VALUE 0x0000 /* @ECU_Address@KINP_ShifterFailsta_enum_defval@ */ Scalar_UBYTE 0 SWC_INP_type_CM_uint8_enum 0.0 7.0 /end CHARACTERISTIC
/begin CHARACTERISTIC KINP_ShifterFailsta_enum_ovrdval "" VALUE 0x0000 /* @ECU_Address@KINP_ShifterFailsta_enum_ovrdval@ */ Scalar_UBYTE 0 SWC_INP_type_CM_uint8_enum 0.0 7.0 /end CHARACTERISTIC
/begin CHARACTERISTIC KINP_ShifterHandleCmd_enum_defval "" VALUE 0x0000 /* @ECU_Address@KINP_ShifterHandleCmd_enum_defval@ */ Scalar_UBYTE 0 SWC_INP_type_CM_uint8_enum 0.0 255.0 /end CHARACTERISTIC
/begin CHARACTERISTIC KINP_ShifterHandleCmd_enum_ovrdval "" VALUE 0x0000 /* @ECU_Address@KINP_ShifterHandleCmd_enum_ovrdval@ */ Scalar_UBYTE 0 SWC_INP_type_CM_uint8_enum 0.0 255.0 /end CHARACTERISTIC
/begin CHARACTERISTIC KINP_ShifterRC_enum_defval "" VALUE 0x0000 /* @ECU_Address@KINP_ShifterRC_enum_defval@ */ Scalar_UBYTE 0 SWC_INP_type_CM_uint8_enum 0.0 14.0 /end CHARACTERISTIC
/begin CHARACTERISTIC KINP_ShifterRC_enum_ovrdval "" VALUE 0x0000 /* @ECU_Address@KINP_ShifterRC_enum_ovrdval@ */ Scalar_UBYTE 0 SWC_INP_type_CM_uint8_enum 0.0 14.0 /end CHARACTERISTIC
/begin CHARACTERISTIC KINP_SolarLErr_enum_defval "" VALUE 0x0000 /* @ECU_Address@KINP_SolarLErr_enum_defval@ */ Scalar_UBYTE 0 SWC_INP_type_CM_uint8_enum 0.0 3.0 /end CHARACTERISTIC
/begin CHARACTERISTIC KINP_SolarLErr_enum_ovrdval "" VALUE 0x0000 /* @ECU_Address@KINP_SolarLErr_enum_ovrdval@ */ Scalar_UBYTE 0 SWC_INP_type_CM_uint8_enum 0.0 3.0 /end CHARACTERISTIC
/begin CHARACTERISTIC KINP_SolarRErr_enum_defval "" VALUE 0x0000 /* @ECU_Address@KINP_SolarRErr_enum_defval@ */ Scalar_UBYTE 0 SWC_INP_type_CM_uint8_enum 0.0 3.0 /end CHARACTERISTIC
/begin CHARACTERISTIC KINP_SolarRErr_enum_ovrdval "" VALUE 0x0000 /* @ECU_Address@KINP_SolarRErr_enum_ovrdval@ */ Scalar_UBYTE 0 SWC_INP_type_CM_uint8_enum 0.0 3.0 /end CHARACTERISTIC
/begin CHARACTERISTIC KINP_TFaceLErr_enum_defval "" VALUE 0x0000 /* @ECU_Address@KINP_TFaceLErr_enum_defval@ */ Scalar_UBYTE 0 SWC_INP_type_CM_uint8_enum 0.0 3.0 /end CHARACTERISTIC
/begin CHARACTERISTIC KINP_TFaceLErr_enum_ovrdval "" VALUE 0x0000 /* @ECU_Address@KINP_TFaceLErr_enum_ovrdval@ */ Scalar_UBYTE 0 SWC_INP_type_CM_uint8_enum 0.0 3.0 /end CHARACTERISTIC
/begin CHARACTERISTIC KINP_TFaceRErr_enum_defval "" VALUE 0x0000 /* @ECU_Address@KINP_TFaceRErr_enum_defval@ */ Scalar_UBYTE 0 SWC_INP_type_CM_uint8_enum 0.0 3.0 /end CHARACTERISTIC
/begin CHARACTERISTIC KINP_TFaceRErr_enum_ovrdval "" VALUE 0x0000 /* @ECU_Address@KINP_TFaceRErr_enum_ovrdval@ */ Scalar_UBYTE 0 SWC_INP_type_CM_uint8_enum 0.0 3.0 /end CHARACTERISTIC
/begin CHARACTERISTIC KINP_TFaceRrErr_enum_defval "" VALUE 0x0000 /* @ECU_Address@KINP_TFaceRrErr_enum_defval@ */ Scalar_UBYTE 0 SWC_INP_type_CM_uint8_enum 0.0 3.0 /end CHARACTERISTIC
/begin CHARACTERISTIC KINP_TFaceRrErr_enum_ovrdval "" VALUE 0x0000 /* @ECU_Address@KINP_TFaceRrErr_enum_ovrdval@ */ Scalar_UBYTE 0 SWC_INP_type_CM_uint8_enum 0.0 3.0 /end CHARACTERISTIC
/begin CHARACTERISTIC KINP_TFootLErr_enum_defval "" VALUE 0x0000 /* @ECU_Address@KINP_TFootLErr_enum_defval@ */ Scalar_UBYTE 0 SWC_INP_type_CM_uint8_enum 0.0 3.0 /end CHARACTERISTIC
/begin CHARACTERISTIC KINP_TFootLErr_enum_ovrdval "" VALUE 0x0000 /* @ECU_Address@KINP_TFootLErr_enum_ovrdval@ */ Scalar_UBYTE 0 SWC_INP_type_CM_uint8_enum 0.0 3.0 /end CHARACTERISTIC
/begin CHARACTERISTIC KINP_TFootRErr_enum_defval "" VALUE 0x0000 /* @ECU_Address@KINP_TFootRErr_enum_defval@ */ Scalar_UBYTE 0 SWC_INP_type_CM_uint8_enum 0.0 3.0 /end CHARACTERISTIC
/begin CHARACTERISTIC KINP_TFootRErr_enum_ovrdval "" VALUE 0x0000 /* @ECU_Address@KINP_TFootRErr_enum_ovrdval@ */ Scalar_UBYTE 0 SWC_INP_type_CM_uint8_enum 0.0 3.0 /end CHARACTERISTIC
/begin CHARACTERISTIC KINP_TFootRrErr_enum_defval "" VALUE 0x0000 /* @ECU_Address@KINP_TFootRrErr_enum_defval@ */ Scalar_UBYTE 0 SWC_INP_type_CM_uint8_enum 0.0 3.0 /end CHARACTERISTIC
/begin CHARACTERISTIC KINP_TFootRrErr_enum_ovrdval "" VALUE 0x0000 /* @ECU_Address@KINP_TFootRrErr_enum_ovrdval@ */ Scalar_UBYTE 0 SWC_INP_type_CM_uint8_enum 0.0 3.0 /end CHARACTERISTIC
/begin CHARACTERISTIC KINP_TambErr_enum_defval "" VALUE 0x0000 /* @ECU_Address@KINP_TambErr_enum_defval@ */ Scalar_UBYTE 0 SWC_INP_type_CM_uint8_enum 0.0 3.0 /end CHARACTERISTIC
/begin CHARACTERISTIC KINP_TambErr_enum_ovrdval "" VALUE 0x0000 /* @ECU_Address@KINP_TambErr_enum_ovrdval@ */ Scalar_UBYTE 0 SWC_INP_type_CM_uint8_enum 0.0 3.0 /end CHARACTERISTIC
/begin CHARACTERISTIC KINP_TevapErr_enum_defval "" VALUE 0x0000 /* @ECU_Address@KINP_TevapErr_enum_defval@ */ Scalar_UBYTE 0 SWC_INP_type_CM_uint8_enum 0.0 3.0 /end CHARACTERISTIC
/begin CHARACTERISTIC KINP_TevapErr_enum_ovrdval "" VALUE 0x0000 /* @ECU_Address@KINP_TevapErr_enum_ovrdval@ */ Scalar_UBYTE 0 SWC_INP_type_CM_uint8_enum 0.0 3.0 /end CHARACTERISTIC
/begin CHARACTERISTIC KINP_TincarErr_enum_defval "" VALUE 0x0000 /* @ECU_Address@KINP_TincarErr_enum_defval@ */ Scalar_UBYTE 0 SWC_INP_type_CM_uint8_enum 0.0 3.0 /end CHARACTERISTIC
/begin CHARACTERISTIC KINP_TincarErr_enum_ovrdval "" VALUE 0x0000 /* @ECU_Address@KINP_TincarErr_enum_ovrdval@ */ Scalar_UBYTE 0 SWC_INP_type_CM_uint8_enum 0.0 3.0 /end CHARACTERISTIC
/begin CHARACTERISTIC KINP_TrailerModeSta_enum_defval "" VALUE 0x0000 /* @ECU_Address@KINP_TrailerModeSta_enum_defval@ */ Scalar_UBYTE 0 SWC_INP_type_CM_uint8_enum 0.0 3.0 /end CHARACTERISTIC
/begin CHARACTERISTIC KINP_TrailerModeSta_enum_ovrdval "" VALUE 0x0000 /* @ECU_Address@KINP_TrailerModeSta_enum_ovrdval@ */ Scalar_UBYTE 0 SWC_INP_type_CM_uint8_enum 0.0 3.0 /end CHARACTERISTIC
/begin CHARACTERISTIC KINP_ZoneDrMalfunLevel_enum_defval "" VALUE 0x0000 /* @ECU_Address@KINP_ZoneDrMalfunLevel_enum_defval@ */ Scalar_UBYTE 0 SWC_INP_type_CM_uint8_enum 0.0 5.0 /end CHARACTERISTIC
/begin CHARACTERISTIC KINP_ZoneDrMalfunLevel_enum_ovrdval "" VALUE 0x0000 /* @ECU_Address@KINP_ZoneDrMalfunLevel_enum_ovrdval@ */ Scalar_UBYTE 0 SWC_INP_type_CM_uint8_enum 0.0 5.0 /end CHARACTERISTIC
/begin COMPU_METHOD SWC_INP_type_CM_single_A "Q = V" RAT_FUNC "%8.6" "A" COEFFS 0 1 0 0 0 1 /end COMPU_METHOD
/begin COMPU_METHOD SWC_INP_type_CM_single_pct "Q = V" RAT_FUNC "%8.6" "pct" COEFFS 0 1 0 0 0 1 /end COMPU_METHOD
/begin COMPU_METHOD SWC_INP_type_CM_single_Nm "Q = V" RAT_FUNC "%8.6" "Nm" COEFFS 0 1 0 0 0 1 /end COMPU_METHOD
/begin COMPU_METHOD SWC_INP_type_CM_single_V "Q = V" RAT_FUNC "%8.6" "V" COEFFS 0 1 0 0 0 1 /end COMPU_METHOD
/begin COMPU_METHOD SWC_INP_type_CM_single_C "Q = V" RAT_FUNC "%8.6" "C" COEFFS 0 1 0 0 0 1 /end COMPU_METHOD
/begin COMPU_METHOD SWC_INP_type_CM_single_W "Q = V" RAT_FUNC "%8.6" "W" COEFFS 0 1 0 0 0 1 /end COMPU_METHOD
/begin COMPU_METHOD SWC_INP_type_CM_single_rpm "Q = V" RAT_FUNC "%8.6" "rpm" COEFFS 0 1 0 0 0 1 /end COMPU_METHOD
/begin COMPU_METHOD SWC_INP_type_CM_single_mA "Q = V" RAT_FUNC "%8.6" "mA" COEFFS 0 1 0 0 0 1 /end COMPU_METHOD
/begin COMPU_METHOD SWC_INP_type_CM_single_Lpmin "Q = V" RAT_FUNC "%8.6" "Lpmin" COEFFS 0 1 0 0 0 1 /end COMPU_METHOD
/begin COMPU_METHOD SWC_INP_type_CM_single_KPa "Q = V" RAT_FUNC "%8.6" "KPa" COEFFS 0 1 0 0 0 1 /end COMPU_METHOD
/begin COMPU_METHOD SWC_INP_type_CM_single_cnt "Q = V" RAT_FUNC "%8.6" "cnt" COEFFS 0 1 0 0 0 1 /end COMPU_METHOD
/begin COMPU_METHOD SWC_INP_type_CM_uint16_enum "Q = V" RAT_FUNC "%5.0" "enum" COEFFS 0 1 0 0 0 1 /end COMPU_METHOD
/begin COMPU_METHOD SWC_INP_type_CM_boolean_flg "Q = V" RAT_FUNC "%1.0" "flg" COEFFS 0 1 0 0 0 1 /end COMPU_METHOD
/begin COMPU_METHOD SWC_INP_type_CM_uint8_enum "Q = V" RAT_FUNC "%3.0" "enum" COEFFS 0 1 0 0 0 1 /end COMPU_METHOD
/begin GROUP S1833_FrFailcodehistory2Nidec "SWC_INP_type/run_SWC_INP_5ms_sys/INP/CAN3/SignalCheck/MCU_N_F2/FrFailcodehistory2Nidec"
 /begin REF_CHARACTERISTIC KINP_FrFailcodehistory2Nidec_enum_defval KINP_FrFailcodehistory2Nidec_enum_ovrdflg KINP_FrFailcodehistory2Nidec_enum_ovrdval /end REF_CHARACTERISTIC
/end GROUP
/begin GROUP S1833_FrLLCTempNidec "SWC_INP_type/run_SWC_INP_5ms_sys/INP/CAN3/SignalCheck/MCU_N_F2/FrLLCTempNidec"
 /begin REF_CHARACTERISTIC KINP_FrLLCTempNidec_C_defval KINP_FrLLCTempNidec_C_ovrdflg KINP_FrLLCTempNidec_C_ovrdval /end REF_CHARACTERISTIC
/end GROUP
/begin GROUP S1833_FrLLCflowReqNidec "SWC_INP_type/run_SWC_INP_5ms_sys/INP/CAN3/SignalCheck/MCU_N_F2/FrLLCflowReqNidec"
 /begin REF_CHARACTERISTIC KINP_FrLLCflowReqNidec_Lpmin_defval KINP_FrLLCflowReqNidec_Lpmin_ovrdflg KINP_FrLLCflowReqNidec_Lpmin_ovrdval /end REF_CHARACTERISTIC
/end GROUP
/begin GROUP S1833_FrMCUTempWarnNidec "SWC_INP_type/run_SWC_INP_5ms_sys/INP/CAN3/SignalCheck/MCU_N_F2/FrMCUTempWarnNidec"
 /begin REF_CHARACTERISTIC KINP_FrMCUTempWarnNidec_enum_defval KINP_FrMCUTempWarnNidec_enum_ovrdflg KINP_FrMCUTempWarnNidec_enum_ovrdval /end REF_CHARACTERISTIC
/end GROUP
/begin GROUP S1833_FrTMTempWarnNidec "SWC_INP_type/run_SWC_INP_5ms_sys/INP/CAN3/SignalCheck/MCU_N_F2/FrTMTempWarnNidec"
 /begin REF_CHARACTERISTIC KINP_FrTMTempWarnNidec_enum_defval KINP_FrTMTempWarnNidec_enum_ovrdflg KINP_FrTMTempWarnNidec_enum_ovrdval /end REF_CHARACTERISTIC
/end GROUP
/begin GROUP S1834_FrMCUHWVerNidec "SWC_INP_type/run_SWC_INP_5ms_sys/INP/CAN3/SignalCheck/MCU_N_F3/FrMCUHWVerNidec"
 /begin REF_CHARACTERISTIC KINP_FrMCUHWVerNidec_enum_defval KINP_FrMCUHWVerNidec_enum_ovrdflg KINP_FrMCUHWVerNidec_enum_ovrdval /end REF_CHARACTERISTIC
/end GROUP
/begin GROUP S1834_FrMCUSWVerNidec "SWC_INP_type/run_SWC_INP_5ms_sys/INP/CAN3/SignalCheck/MCU_N_F3/FrMCUSWVerNidec"
 /begin REF_CHARACTERISTIC KINP_FrMCUSWVerNidec_enum_defval KINP_FrMCUSWVerNidec_enum_ovrdflg KINP_FrMCUSWVerNidec_enum_ovrdval /end REF_CHARACTERISTIC
/end GROUP
/begin GROUP S1835_MCUNR1CSErr "SWC_INP_type/run_SWC_INP_5ms_sys/INP/CAN3/SignalCheck/MCU_N_R1/MCUNR1CSErr"
 /begin REF_CHARACTERISTIC KINP_MCUNR1CSErr_flg_defval KINP_MCUNR1CSErr_flg_ovrdflg KINP_MCUNR1CSErr_flg_ovrdval /end REF_CHARACTERISTIC
/end GROUP
/begin GROUP S1835_MCUNR1RCErr "SWC_INP_type/run_SWC_INP_5ms_sys/INP/CAN3/SignalCheck/MCU_N_R1/MCUNR1RCErr"
 /begin REF_CHARACTERISTIC KINP_MCUNR1RCErr_flg_defval KINP_MCUNR1RCErr_flg_ovrdflg KINP_MCUNR1RCErr_flg_ovrdval /end REF_CHARACTERISTIC
/end GROUP
/begin GROUP S1835_MCUWarnRNidec "SWC_INP_type/run_SWC_INP_5ms_sys/INP/CAN3/SignalCheck/MCU_N_R1/MCUWarnRNidec"
 /begin REF_CHARACTERISTIC KINP_MCUWarnRNidec_enum_defval KINP_MCUWarnRNidec_enum_ovrdflg KINP_MCUWarnRNidec_enum_ovrdval /end REF_CHARACTERISTIC
/end GROUP
/begin GROUP S1835_RrActvDmpDisabStaNidec "SWC_INP_type/run_SWC_INP_5ms_sys/INP/CAN3/SignalCheck/MCU_N_R1/RrActvDmpDisabStaNidec"
 /begin REF_CHARACTERISTIC KINP_RrActvDmpDisabStaNidec_flg_defval KINP_RrActvDmpDisabStaNidec_flg_ovrdflg KINP_RrActvDmpDisabStaNidec_flg_ovrdval /end REF_CHARACTERISTIC
/end GROUP
/begin GROUP S1835_RrEDUDrtStaNidec "SWC_INP_type/run_SWC_INP_5ms_sys/INP/CAN3/SignalCheck/MCU_N_R1/RrEDUDrtStaNidec"
 /begin REF_CHARACTERISTIC KINP_RrEDUDrtStaNidec_flg_defval KINP_RrEDUDrtStaNidec_flg_ovrdflg KINP_RrEDUDrtStaNidec_flg_ovrdval /end REF_CHARACTERISTIC
/end GROUP
/begin GROUP S1835_RrEDUOpratingStaNidec "SWC_INP_type/run_SWC_INP_5ms_sys/INP/CAN3/SignalCheck/MCU_N_R1/RrEDUOpratingStaNidec"
 /begin REF_CHARACTERISTIC KINP_RrEDUOpratingStaNidec_flg_defval KINP_RrEDUOpratingStaNidec_flg_ovrdflg KINP_RrEDUOpratingStaNidec_flg_ovrdval /end REF_CHARACTERISTIC
/end GROUP
/begin GROUP S1835_RrEDURealTMTqNidec "SWC_INP_type/run_SWC_INP_5ms_sys/INP/CAN3/SignalCheck/MCU_N_R1/RrEDURealTMTqNidec"
 /begin REF_CHARACTERISTIC KINP_RrEDURealTMTqNidec_Nm_defval KINP_RrEDURealTMTqNidec_Nm_ovrdflg KINP_RrEDURealTMTqNidec_Nm_ovrdval /end REF_CHARACTERISTIC
/end GROUP
/begin GROUP S1835_RrEDURotateDirctionNidec "SWC_INP_type/run_SWC_INP_5ms_sys/INP/CAN3/SignalCheck/MCU_N_R1/RrEDURotateDirctionNidec"
 /begin REF_CHARACTERISTIC KINP_RrEDURotateDirctionNidec_enum_defval KINP_RrEDURotateDirctionNidec_enum_ovrdflg KINP_RrEDURotateDirctionNidec_enum_ovrdval /end REF_CHARACTERISTIC
/end GROUP
/begin GROUP S1835_RrEDUTqReqFbkNidec "SWC_INP_type/run_SWC_INP_5ms_sys/INP/CAN3/SignalCheck/MCU_N_R1/RrEDUTqReqFbkNidec"
 /begin REF_CHARACTERISTIC KINP_RrEDUTqReqFbkNidec_Nm_defval KINP_RrEDUTqReqFbkNidec_Nm_ovrdflg KINP_RrEDUTqReqFbkNidec_Nm_ovrdval /end REF_CHARACTERISTIC
/end GROUP
/begin GROUP S1835_RrMCU1ChksumNidec "SWC_INP_type/run_SWC_INP_5ms_sys/INP/CAN3/SignalCheck/MCU_N_R1/RrMCU1ChksumNidec"
 /begin REF_CHARACTERISTIC KINP_RrMCU1ChksumNidec_enum_defval KINP_RrMCU1ChksumNidec_enum_ovrdflg KINP_RrMCU1ChksumNidec_enum_ovrdval /end REF_CHARACTERISTIC
/end GROUP
/begin GROUP S1835_RrMCU1RolCntNidec "SWC_INP_type/run_SWC_INP_5ms_sys/INP/CAN3/SignalCheck/MCU_N_R1/RrMCU1RolCntNidec"
 /begin REF_CHARACTERISTIC KINP_RrMCU1RolCntNidec_enum_defval KINP_RrMCU1RolCntNidec_enum_ovrdflg KINP_RrMCU1RolCntNidec_enum_ovrdval /end REF_CHARACTERISTIC
/end GROUP
/begin GROUP S1835_RrMCUBATNidec "SWC_INP_type/run_SWC_INP_5ms_sys/INP/CAN3/SignalCheck/MCU_N_R1/RrMCUBATNidec"
 /begin REF_CHARACTERISTIC KINP_RrMCUBATNidec_V_defval KINP_RrMCUBATNidec_V_ovrdflg KINP_RrMCUBATNidec_V_ovrdval /end REF_CHARACTERISTIC
/end GROUP
/begin GROUP S1835_RrMCUDCBusCurrNidec "SWC_INP_type/run_SWC_INP_5ms_sys/INP/CAN3/SignalCheck/MCU_N_R1/RrMCUDCBusCurrNidec"
 /begin REF_CHARACTERISTIC KINP_RrMCUDCBusCurrNidec_A_defval KINP_RrMCUDCBusCurrNidec_A_ovrdflg KINP_RrMCUDCBusCurrNidec_A_ovrdval /end REF_CHARACTERISTIC
/end GROUP
/begin GROUP S1835_RrMCUDCBusVoltNidec "SWC_INP_type/run_SWC_INP_5ms_sys/INP/CAN3/SignalCheck/MCU_N_R1/RrMCUDCBusVoltNidec"
 /begin REF_CHARACTERISTIC KINP_RrMCUDCBusVoltNidec_V_defval KINP_RrMCUDCBusVoltNidec_V_ovrdflg KINP_RrMCUDCBusVoltNidec_V_ovrdval /end REF_CHARACTERISTIC
/end GROUP
/begin GROUP S1835_RrMCUDischrgStaNidec "SWC_INP_type/run_SWC_INP_5ms_sys/INP/CAN3/SignalCheck/MCU_N_R1/RrMCUDischrgStaNidec"
 /begin REF_CHARACTERISTIC KINP_RrMCUDischrgStaNidec_flg_defval KINP_RrMCUDischrgStaNidec_flg_ovrdflg KINP_RrMCUDischrgStaNidec_flg_ovrdval /end REF_CHARACTERISTIC
/end GROUP
/begin GROUP S1835_RrMCUEnaStaNidec "SWC_INP_type/run_SWC_INP_5ms_sys/INP/CAN3/SignalCheck/MCU_N_R1/RrMCUEnaStaNidec"
 /begin REF_CHARACTERISTIC KINP_RrMCUEnaStaNidec_flg_defval KINP_RrMCUEnaStaNidec_flg_ovrdflg KINP_RrMCUEnaStaNidec_flg_ovrdval /end REF_CHARACTERISTIC
/end GROUP
/begin GROUP S1835_RrMCUErrNidec "SWC_INP_type/run_SWC_INP_5ms_sys/INP/CAN3/SignalCheck/MCU_N_R1/RrMCUErrNidec"
 /begin REF_CHARACTERISTIC KINP_RrMCUErrNidec_enum_defval KINP_RrMCUErrNidec_enum_ovrdflg KINP_RrMCUErrNidec_enum_ovrdval /end REF_CHARACTERISTIC
/end GROUP
/begin GROUP S1835_RrMCUIGNstaNidec "SWC_INP_type/run_SWC_INP_5ms_sys/INP/CAN3/SignalCheck/MCU_N_R1/RrMCUIGNstaNidec"
 /begin REF_CHARACTERISTIC KINP_RrMCUIGNstaNidec_flg_defval KINP_RrMCUIGNstaNidec_flg_ovrdflg KINP_RrMCUIGNstaNidec_flg_ovrdval /end REF_CHARACTERISTIC
/end GROUP
/begin GROUP S1835_RrMCUReady4PreNidec "SWC_INP_type/run_SWC_INP_5ms_sys/INP/CAN3/SignalCheck/MCU_N_R1/RrMCUReady4PreNidec"
 /begin REF_CHARACTERISTIC KINP_RrMCUReady4PreNidec_flg_defval KINP_RrMCUReady4PreNidec_flg_ovrdflg KINP_RrMCUReady4PreNidec_flg_ovrdval /end REF_CHARACTERISTIC
/end GROUP
/begin GROUP S1835_RrMCUReadyNidec "SWC_INP_type/run_SWC_INP_5ms_sys/INP/CAN3/SignalCheck/MCU_N_R1/RrMCUReadyNidec"
 /begin REF_CHARACTERISTIC KINP_RrMCUReadyNidec_flg_defval KINP_RrMCUReadyNidec_flg_ovrdflg KINP_RrMCUReadyNidec_flg_ovrdval /end REF_CHARACTERISTIC
/end GROUP
/begin GROUP S1835_RrMCUSysStaNidec "SWC_INP_type/run_SWC_INP_5ms_sys/INP/CAN3/SignalCheck/MCU_N_R1/RrMCUSysStaNidec"
 /begin REF_CHARACTERISTIC KINP_RrMCUSysStaNidec_enum_defval KINP_RrMCUSysStaNidec_enum_ovrdflg KINP_RrMCUSysStaNidec_enum_ovrdval /end REF_CHARACTERISTIC
/end GROUP
/begin GROUP S1835_RrMCUTempNidec "SWC_INP_type/run_SWC_INP_5ms_sys/INP/CAN3/SignalCheck/MCU_N_R1/RrMCUTempNidec"
 /begin REF_CHARACTERISTIC KINP_RrMCUTempNidec_C_defval KINP_RrMCUTempNidec_C_ovrdflg KINP_RrMCUTempNidec_C_ovrdval /end REF_CHARACTERISTIC
/end GROUP
/begin GROUP S1835_RrMotorAvailTqNidec "SWC_INP_type/run_SWC_INP_5ms_sys/INP/CAN3/SignalCheck/MCU_N_R1/RrMotorAvailTqNidec"
 /begin REF_CHARACTERISTIC KINP_RrMotorAvailTqNidec_Nm_defval KINP_RrMotorAvailTqNidec_Nm_ovrdflg KINP_RrMotorAvailTqNidec_Nm_ovrdval /end REF_CHARACTERISTIC
/end GROUP
/begin GROUP S1835_RrRegenAvailTqNidec "SWC_INP_type/run_SWC_INP_5ms_sys/INP/CAN3/SignalCheck/MCU_N_R1/RrRegenAvailTqNidec"
 /begin REF_CHARACTERISTIC KINP_RrRegenAvailTqNidec_Nm_defval KINP_RrRegenAvailTqNidec_Nm_ovrdflg KINP_RrRegenAvailTqNidec_Nm_ovrdval /end REF_CHARACTERISTIC
/end GROUP
/begin GROUP S1835_RrTMSpdNidec "SWC_INP_type/run_SWC_INP_5ms_sys/INP/CAN3/SignalCheck/MCU_N_R1/RrTMSpdNidec"
 /begin REF_CHARACTERISTIC KINP_RrTMSpdNidec_rpm_defval KINP_RrTMSpdNidec_rpm_ovrdflg KINP_RrTMSpdNidec_rpm_ovrdval /end REF_CHARACTERISTIC
/end GROUP
/begin GROUP S1835_RrTMTempNidec "SWC_INP_type/run_SWC_INP_5ms_sys/INP/CAN3/SignalCheck/MCU_N_R1/RrTMTempNidec"
 /begin REF_CHARACTERISTIC KINP_RrTMTempNidec_C_defval KINP_RrTMTempNidec_C_ovrdflg KINP_RrTMTempNidec_C_ovrdval /end REF_CHARACTERISTIC
/end GROUP
/begin GROUP S1835_RrTMidNidec "SWC_INP_type/run_SWC_INP_5ms_sys/INP/CAN3/SignalCheck/MCU_N_R1/RrTMidNidec"
 /begin REF_CHARACTERISTIC KINP_RrTMidNidec_A_defval KINP_RrTMidNidec_A_ovrdflg KINP_RrTMidNidec_A_ovrdval /end REF_CHARACTERISTIC
/end GROUP
/begin GROUP S1835_RrTMiqNidec "SWC_INP_type/run_SWC_INP_5ms_sys/INP/CAN3/SignalCheck/MCU_N_R1/RrTMiqNidec"
 /begin REF_CHARACTERISTIC KINP_RrTMiqNidec_A_defval KINP_RrTMiqNidec_A_ovrdflg KINP_RrTMiqNidec_A_ovrdval /end REF_CHARACTERISTIC
/end GROUP
/begin GROUP S1836_RrCoolanttempReqNidec "SWC_INP_type/run_SWC_INP_5ms_sys/INP/CAN3/SignalCheck/MCU_N_R2/RrCoolanttempReqNidec"
 /begin REF_CHARACTERISTIC KINP_RrCoolanttempReqNidec_cnt_defval KINP_RrCoolanttempReqNidec_cnt_ovrdflg KINP_RrCoolanttempReqNidec_cnt_ovrdval /end REF_CHARACTERISTIC
/end GROUP
/begin GROUP S1836_RrEOPSpdSetNidec "SWC_INP_type/run_SWC_INP_5ms_sys/INP/CAN3/SignalCheck/MCU_N_R2/RrEOPSpdSetNidec"
 /begin REF_CHARACTERISTIC KINP_RrEOPSpdSetNidec_rpm_defval KINP_RrEOPSpdSetNidec_rpm_ovrdflg KINP_RrEOPSpdSetNidec_rpm_ovrdval /end REF_CHARACTERISTIC
/end GROUP
/begin GROUP S1836_RrFailcode1Nidec "SWC_INP_type/run_SWC_INP_5ms_sys/INP/CAN3/SignalCheck/MCU_N_R2/RrFailcode1Nidec"
 /begin REF_CHARACTERISTIC KINP_RrFailcode1Nidec_enum_defval KINP_RrFailcode1Nidec_enum_ovrdflg KINP_RrFailcode1Nidec_enum_ovrdval /end REF_CHARACTERISTIC
/end GROUP
/begin GROUP S1836_RrFailcode2Nidec "SWC_INP_type/run_SWC_INP_5ms_sys/INP/CAN3/SignalCheck/MCU_N_R2/RrFailcode2Nidec"
 /begin REF_CHARACTERISTIC KINP_RrFailcode2Nidec_enum_defval KINP_RrFailcode2Nidec_enum_ovrdflg KINP_RrFailcode2Nidec_enum_ovrdval /end REF_CHARACTERISTIC
/end GROUP
/begin GROUP S1836_RrFailcodehistory1Nidec "SWC_INP_type/run_SWC_INP_5ms_sys/INP/CAN3/SignalCheck/MCU_N_R2/RrFailcodehistory1Nidec"
 /begin REF_CHARACTERISTIC KINP_RrFailcodehistory1Nidec_enum_defval KINP_RrFailcodehistory1Nidec_enum_ovrdflg KINP_RrFailcodehistory1Nidec_enum_ovrdval /end REF_CHARACTERISTIC
/end GROUP
/begin GROUP S1836_RrFailcodehistory2Nidec "SWC_INP_type/run_SWC_INP_5ms_sys/INP/CAN3/SignalCheck/MCU_N_R2/RrFailcodehistory2Nidec"
 /begin REF_CHARACTERISTIC KINP_RrFailcodehistory2Nidec_enum_defval KINP_RrFailcodehistory2Nidec_enum_ovrdflg KINP_RrFailcodehistory2Nidec_enum_ovrdval /end REF_CHARACTERISTIC
/end GROUP
/begin GROUP S1836_RrLLCTempNidec "SWC_INP_type/run_SWC_INP_5ms_sys/INP/CAN3/SignalCheck/MCU_N_R2/RrLLCTempNidec"
 /begin REF_CHARACTERISTIC KINP_RrLLCTempNidec_C_defval KINP_RrLLCTempNidec_C_ovrdflg KINP_RrLLCTempNidec_C_ovrdval /end REF_CHARACTERISTIC
/end GROUP
/begin GROUP S1836_RrLLCflowReqNidec "SWC_INP_type/run_SWC_INP_5ms_sys/INP/CAN3/SignalCheck/MCU_N_R2/RrLLCflowReqNidec"
 /begin REF_CHARACTERISTIC KINP_RrLLCflowReqNidec_Lpmin_defval KINP_RrLLCflowReqNidec_Lpmin_ovrdflg KINP_RrLLCflowReqNidec_Lpmin_ovrdval /end REF_CHARACTERISTIC
/end GROUP
/begin GROUP S1836_RrMCUTempWarnNidec "SWC_INP_type/run_SWC_INP_5ms_sys/INP/CAN3/SignalCheck/MCU_N_R2/RrMCUTempWarnNidec"
 /begin REF_CHARACTERISTIC KINP_RrMCUTempWarnNidec_enum_defval KINP_RrMCUTempWarnNidec_enum_ovrdflg KINP_RrMCUTempWarnNidec_enum_ovrdval /end REF_CHARACTERISTIC
/end GROUP
/begin GROUP S1836_RrTMTempWarnNidec "SWC_INP_type/run_SWC_INP_5ms_sys/INP/CAN3/SignalCheck/MCU_N_R2/RrTMTempWarnNidec"
 /begin REF_CHARACTERISTIC KINP_RrTMTempWarnNidec_enum_defval KINP_RrTMTempWarnNidec_enum_ovrdflg KINP_RrTMTempWarnNidec_enum_ovrdval /end REF_CHARACTERISTIC
/end GROUP
/begin GROUP S1837_RrMCU3HWVerNidec "SWC_INP_type/run_SWC_INP_5ms_sys/INP/CAN3/SignalCheck/MCU_N_R3/RrMCU3HWVerNidec"
 /begin REF_CHARACTERISTIC KINP_RrMCU3HWVerNidec_enum_defval KINP_RrMCU3HWVerNidec_enum_ovrdflg KINP_RrMCU3HWVerNidec_enum_ovrdval /end REF_CHARACTERISTIC
/end GROUP
/begin GROUP S1837_RrMCU3SWVerNidec "SWC_INP_type/run_SWC_INP_5ms_sys/INP/CAN3/SignalCheck/MCU_N_R3/RrMCU3SWVerNidec"
 /begin REF_CHARACTERISTIC KINP_RrMCU3SWVerNidec_enum_defval KINP_RrMCU3SWVerNidec_enum_ovrdflg KINP_RrMCU3SWVerNidec_enum_ovrdval /end REF_CHARACTERISTIC
/end GROUP
/begin GROUP S1838_Shifter1CSErr "SWC_INP_type/run_SWC_INP_5ms_sys/INP/CAN3/SignalCheck/Shifter1/Shifter1CSErr"
 /begin REF_CHARACTERISTIC KINP_Shifter1CSErr_flg_defval KINP_Shifter1CSErr_flg_ovrdflg KINP_Shifter1CSErr_flg_ovrdval /end REF_CHARACTERISTIC
/end GROUP
/begin GROUP S1838_Shifter1RCErr "SWC_INP_type/run_SWC_INP_5ms_sys/INP/CAN3/SignalCheck/Shifter1/Shifter1RCErr"
 /begin REF_CHARACTERISTIC KINP_Shifter1RCErr_flg_defval KINP_Shifter1RCErr_flg_ovrdflg KINP_Shifter1RCErr_flg_ovrdval /end REF_CHARACTERISTIC
/end GROUP
/begin GROUP S1838_ShifterCRC8 "SWC_INP_type/run_SWC_INP_5ms_sys/INP/CAN3/SignalCheck/Shifter1/ShifterCRC8"
 /begin REF_CHARACTERISTIC KINP_ShifterCRC8_enum_defval KINP_ShifterCRC8_enum_ovrdflg KINP_ShifterCRC8_enum_ovrdval /end REF_CHARACTERISTIC
/end GROUP
/begin GROUP S1838_ShifterFailsta "SWC_INP_type/run_SWC_INP_5ms_sys/INP/CAN3/SignalCheck/Shifter1/ShifterFailsta"
 /begin REF_CHARACTERISTIC KINP_ShifterFailsta_enum_defval KINP_ShifterFailsta_enum_ovrdflg KINP_ShifterFailsta_enum_ovrdval /end REF_CHARACTERISTIC
/end GROUP
/begin GROUP S1838_ShifterHandleCmd "SWC_INP_type/run_SWC_INP_5ms_sys/INP/CAN3/SignalCheck/Shifter1/ShifterHandleCmd"
 /begin REF_CHARACTERISTIC KINP_ShifterHandleCmd_enum_defval KINP_ShifterHandleCmd_enum_ovrdflg KINP_ShifterHandleCmd_enum_ovrdval /end REF_CHARACTERISTIC
/end GROUP
/begin GROUP S1838_ShifterRC "SWC_INP_type/run_SWC_INP_5ms_sys/INP/CAN3/SignalCheck/Shifter1/ShifterRC"
 /begin REF_CHARACTERISTIC KINP_ShifterRC_enum_defval KINP_ShifterRC_enum_ovrdflg KINP_ShifterRC_enum_ovrdval /end REF_CHARACTERISTIC
/end GROUP
/begin GROUP S1839_CSW2DimSwSta "SWC_INP_type/run_SWC_INP_5ms_sys/INP/CAN3/SignalCheck/Shifter2/CSW2DimSwSta"
 /begin REF_CHARACTERISTIC KINP_CSW2DimSwSta_flg_defval KINP_CSW2DimSwSta_flg_ovrdflg KINP_CSW2DimSwSta_flg_ovrdval /end REF_CHARACTERISTIC
/end GROUP
/begin GROUP S1839_CSW2FWasSwSta "SWC_INP_type/run_SWC_INP_5ms_sys/INP/CAN3/SignalCheck/Shifter2/CSW2FWasSwSta"
 /begin REF_CHARACTERISTIC KINP_CSW2FWasSwSta_enum_defval KINP_CSW2FWasSwSta_enum_ovrdflg KINP_CSW2FWasSwSta_enum_ovrdval /end REF_CHARACTERISTIC
/end GROUP
/begin GROUP S1839_CSW2FWipSwSta "SWC_INP_type/run_SWC_INP_5ms_sys/INP/CAN3/SignalCheck/Shifter2/CSW2FWipSwSta"
 /begin REF_CHARACTERISTIC KINP_CSW2FWipSwSta_enum_defval KINP_CSW2FWipSwSta_enum_ovrdflg KINP_CSW2FWipSwSta_enum_ovrdval /end REF_CHARACTERISTIC
/end GROUP
/begin GROUP S1839_CSW2PassSWSta "SWC_INP_type/run_SWC_INP_5ms_sys/INP/CAN3/SignalCheck/Shifter2/CSW2PassSWSta"
 /begin REF_CHARACTERISTIC KINP_CSW2PassSWSta_flg_defval KINP_CSW2PassSWSta_flg_ovrdflg KINP_CSW2PassSWSta_flg_ovrdval /end REF_CHARACTERISTIC
/end GROUP
/begin GROUP S1839_CSW2RWipWasSwSta "SWC_INP_type/run_SWC_INP_5ms_sys/INP/CAN3/SignalCheck/Shifter2/CSW2RWipWasSwSta"
 /begin REF_CHARACTERISTIC KINP_CSW2RWipWasSwSta_enum_defval KINP_CSW2RWipWasSwSta_enum_ovrdflg KINP_CSW2RWipWasSwSta_enum_ovrdval /end REF_CHARACTERISTIC
/end GROUP
/begin GROUP S1839_CSW2TurnSwSta "SWC_INP_type/run_SWC_INP_5ms_sys/INP/CAN3/SignalCheck/Shifter2/CSW2TurnSwSta"
 /begin REF_CHARACTERISTIC KINP_CSW2TurnSwSta_enum_defval KINP_CSW2TurnSwSta_enum_ovrdflg KINP_CSW2TurnSwSta_enum_ovrdval /end REF_CHARACTERISTIC
/end GROUP
/begin GROUP S1839_Shifter2CSErr "SWC_INP_type/run_SWC_INP_5ms_sys/INP/CAN3/SignalCheck/Shifter2/Shifter2CSErr"
 /begin REF_CHARACTERISTIC KINP_Shifter2CSErr_flg_defval KINP_Shifter2CSErr_flg_ovrdflg KINP_Shifter2CSErr_flg_ovrdval /end REF_CHARACTERISTIC
/end GROUP
/begin GROUP S1839_Shifter2RCErr "SWC_INP_type/run_SWC_INP_5ms_sys/INP/CAN3/SignalCheck/Shifter2/Shifter2RCErr"
 /begin REF_CHARACTERISTIC KINP_Shifter2RCErr_flg_defval KINP_Shifter2RCErr_flg_ovrdflg KINP_Shifter2RCErr_flg_ovrdval /end REF_CHARACTERISTIC
/end GROUP
/begin GROUP S3300_BDDSEATAntiSta "SWC_INP_type/run_SWC_INP_5ms_sys/INP/CAN4/SignalCheck/BodyZone_DR1/BDDSEATAntiSta"
 /begin REF_CHARACTERISTIC KINP_BDDSEATAntiSta_flg_defval KINP_BDDSEATAntiSta_flg_ovrdflg KINP_BDDSEATAntiSta_flg_ovrdval /end REF_CHARACTERISTIC
/end GROUP
/begin GROUP S3300_BDDSEATEntryFunSta "SWC_INP_type/run_SWC_INP_5ms_sys/INP/CAN4/SignalCheck/BodyZone_DR1/BDDSEATEntryFunSta"
 /begin REF_CHARACTERISTIC KINP_BDDSEATEntryFunSta_flg_defval KINP_BDDSEATEntryFunSta_flg_ovrdflg KINP_BDDSEATEntryFunSta_flg_ovrdval /end REF_CHARACTERISTIC
/end GROUP
/begin GROUP S3300_BDDSEATErrorSta "SWC_INP_type/run_SWC_INP_5ms_sys/INP/CAN4/SignalCheck/BodyZone_DR1/BDDSEATErrorSta"
 /begin REF_CHARACTERISTIC KINP_BDDSEATErrorSta_flg_defval KINP_BDDSEATErrorSta_flg_ovrdflg KINP_BDDSEATErrorSta_flg_ovrdval /end REF_CHARACTERISTIC
/end GROUP
/begin GROUP S3300_BDDSEATMemSetSta "SWC_INP_type/run_SWC_INP_5ms_sys/INP/CAN4/SignalCheck/BodyZone_DR1/BDDSEATMemSetSta"
 /begin REF_CHARACTERISTIC KINP_BDDSEATMemSetSta_enum_defval KINP_BDDSEATMemSetSta_enum_ovrdflg KINP_BDDSEATMemSetSta_enum_ovrdval /end REF_CHARACTERISTIC
/end GROUP
/begin GROUP S3300_BDDSEATModeSta "SWC_INP_type/run_SWC_INP_5ms_sys/INP/CAN4/SignalCheck/BodyZone_DR1/BDDSEATModeSta"
 /begin REF_CHARACTERISTIC KINP_BDDSEATModeSta_enum_defval KINP_BDDSEATModeSta_enum_ovrdflg KINP_BDDSEATModeSta_enum_ovrdval /end REF_CHARACTERISTIC
/end GROUP
/begin GROUP S3300_BDDSEATVentSta "SWC_INP_type/run_SWC_INP_5ms_sys/INP/CAN4/SignalCheck/BodyZone_DR1/BDDSEATVentSta"
 /begin REF_CHARACTERISTIC KINP_BDDSEATVentSta_enum_defval KINP_BDDSEATVentSta_enum_ovrdflg KINP_BDDSEATVentSta_enum_ovrdval /end REF_CHARACTERISTIC
/end GROUP
/begin GROUP S3300_BDDSEATheaterSta "SWC_INP_type/run_SWC_INP_5ms_sys/INP/CAN4/SignalCheck/BodyZone_DR1/BDDSEATheaterSta"
 /begin REF_CHARACTERISTIC KINP_BDDSEATheaterSta_enum_defval KINP_BDDSEATheaterSta_enum_ovrdflg KINP_BDDSEATheaterSta_enum_ovrdval /end REF_CHARACTERISTIC
/end GROUP
/begin GROUP S3301_BDAPMWinFOpenedSta "SWC_INP_type/run_SWC_INP_5ms_sys/INP/CAN4/SignalCheck/BodyZone_DR2/BDAPMWinFOpenedSta"
 /begin REF_CHARACTERISTIC KINP_BDAPMWinFOpenedSta_pct_defval KINP_BDAPMWinFOpenedSta_pct_ovrdflg KINP_BDAPMWinFOpenedSta_pct_ovrdval /end REF_CHARACTERISTIC
/end GROUP
/begin GROUP S3301_BDAPMWinROpenedSta "SWC_INP_type/run_SWC_INP_5ms_sys/INP/CAN4/SignalCheck/BodyZone_DR2/BDAPMWinROpenedSta"
 /begin REF_CHARACTERISTIC KINP_BDAPMWinROpenedSta_pct_defval KINP_BDAPMWinROpenedSta_pct_ovrdflg KINP_BDAPMWinROpenedSta_pct_ovrdval /end REF_CHARACTERISTIC
/end GROUP
/begin GROUP S3301_BDDoorFHandleCloseSta "SWC_INP_type/run_SWC_INP_5ms_sys/INP/CAN4/SignalCheck/BodyZone_DR2/BDDoorFHandleCloseSta"
 /begin REF_CHARACTERISTIC KINP_BDDoorFHandleCloseSta_flg_defval KINP_BDDoorFHandleCloseSta_flg_ovrdflg KINP_BDDoorFHandleCloseSta_flg_ovrdval /end REF_CHARACTERISTIC
/end GROUP
/begin GROUP S3301_BDDoorRHandleCloseSta "SWC_INP_type/run_SWC_INP_5ms_sys/INP/CAN4/SignalCheck/BodyZone_DR2/BDDoorRHandleCloseSta"
 /begin REF_CHARACTERISTIC KINP_BDDoorRHandleCloseSta_flg_defval KINP_BDDoorRHandleCloseSta_flg_ovrdflg KINP_BDDoorRHandleCloseSta_flg_ovrdval /end REF_CHARACTERISTIC
/end GROUP
/begin GROUP S3302_BPPSEATErrorSta "SWC_INP_type/run_SWC_INP_5ms_sys/INP/CAN4/SignalCheck/BodyZone_PS1/BPPSEATErrorSta"
 /begin REF_CHARACTERISTIC KINP_BPPSEATErrorSta_flg_defval KINP_BPPSEATErrorSta_flg_ovrdflg KINP_BPPSEATErrorSta_flg_ovrdval /end REF_CHARACTERISTIC
/end GROUP
/begin GROUP S3302_BPPSEATModeSta "SWC_INP_type/run_SWC_INP_5ms_sys/INP/CAN4/SignalCheck/BodyZone_PS1/BPPSEATModeSta"
 /begin REF_CHARACTERISTIC KINP_BPPSEATModeSta_enum_defval KINP_BPPSEATModeSta_enum_ovrdflg KINP_BPPSEATModeSta_enum_ovrdval /end REF_CHARACTERISTIC
/end GROUP
/begin GROUP S3302_BPPSEATVentSta "SWC_INP_type/run_SWC_INP_5ms_sys/INP/CAN4/SignalCheck/BodyZone_PS1/BPPSEATVentSta"
 /begin REF_CHARACTERISTIC KINP_BPPSEATVentSta_enum_defval KINP_BPPSEATVentSta_enum_ovrdflg KINP_BPPSEATVentSta_enum_ovrdval /end REF_CHARACTERISTIC
/end GROUP
/begin GROUP S3302_BPPSEATheaterSta "SWC_INP_type/run_SWC_INP_5ms_sys/INP/CAN4/SignalCheck/BodyZone_PS1/BPPSEATheaterSta"
 /begin REF_CHARACTERISTIC KINP_BPPSEATheaterSta_enum_defval KINP_BPPSEATheaterSta_enum_ovrdflg KINP_BPPSEATheaterSta_enum_ovrdval /end REF_CHARACTERISTIC
/end GROUP
/begin GROUP S3302_BPPTGActiveSta "SWC_INP_type/run_SWC_INP_5ms_sys/INP/CAN4/SignalCheck/BodyZone_PS1/BPPTGActiveSta"
 /begin REF_CHARACTERISTIC KINP_BPPTGActiveSta_enum_defval KINP_BPPTGActiveSta_enum_ovrdflg KINP_BPPTGActiveSta_enum_ovrdval /end REF_CHARACTERISTIC
/end GROUP
/begin GROUP S3302_BPPTGExistSta "SWC_INP_type/run_SWC_INP_5ms_sys/INP/CAN4/SignalCheck/BodyZone_PS1/BPPTGExistSta"
 /begin REF_CHARACTERISTIC KINP_BPPTGExistSta_flg_defval KINP_BPPTGExistSta_flg_ovrdflg KINP_BPPTGExistSta_flg_ovrdval /end REF_CHARACTERISTIC
/end GROUP
/begin GROUP S3302_BPPTGInsideSW1Sta "SWC_INP_type/run_SWC_INP_5ms_sys/INP/CAN4/SignalCheck/BodyZone_PS1/BPPTGInsideSW1Sta"
 /begin REF_CHARACTERISTIC KINP_BPPTGInsideSW1Sta_enum_defval KINP_BPPTGInsideSW1Sta_enum_ovrdflg KINP_BPPTGInsideSW1Sta_enum_ovrdval /end REF_CHARACTERISTIC
/end GROUP
/begin GROUP S3302_BPPTGInsideSW2Sta "SWC_INP_type/run_SWC_INP_5ms_sys/INP/CAN4/SignalCheck/BodyZone_PS1/BPPTGInsideSW2Sta"
 /begin REF_CHARACTERISTIC KINP_BPPTGInsideSW2Sta_enum_defval KINP_BPPTGInsideSW2Sta_enum_ovrdflg KINP_BPPTGInsideSW2Sta_enum_ovrdval /end REF_CHARACTERISTIC
/end GROUP
/begin GROUP S3302_BPPTGIsSetHeightSta "SWC_INP_type/run_SWC_INP_5ms_sys/INP/CAN4/SignalCheck/BodyZone_PS1/BPPTGIsSetHeightSta"
 /begin REF_CHARACTERISTIC KINP_BPPTGIsSetHeightSta_flg_defval KINP_BPPTGIsSetHeightSta_flg_ovrdflg KINP_BPPTGIsSetHeightSta_flg_ovrdval /end REF_CHARACTERISTIC
/end GROUP
/begin GROUP S3302_BPPTGLeftHallPosnSta "SWC_INP_type/run_SWC_INP_5ms_sys/INP/CAN4/SignalCheck/BodyZone_PS1/BPPTGLeftHallPosnSta"
 /begin REF_CHARACTERISTIC KINP_BPPTGLeftHallPosnSta_enum_defval KINP_BPPTGLeftHallPosnSta_enum_ovrdflg KINP_BPPTGLeftHallPosnSta_enum_ovrdval /end REF_CHARACTERISTIC
/end GROUP
/begin GROUP S3302_BPPTGOpenRatioSta "SWC_INP_type/run_SWC_INP_5ms_sys/INP/CAN4/SignalCheck/BodyZone_PS1/BPPTGOpenRatioSta"
 /begin REF_CHARACTERISTIC KINP_BPPTGOpenRatioSta_pct_defval KINP_BPPTGOpenRatioSta_pct_ovrdflg KINP_BPPTGOpenRatioSta_pct_ovrdval /end REF_CHARACTERISTIC
/end GROUP
/begin GROUP S3302_BPPTGRDILCmd "SWC_INP_type/run_SWC_INP_5ms_sys/INP/CAN4/SignalCheck/BodyZone_PS1/BPPTGRDILCmd"
 /begin REF_CHARACTERISTIC KINP_BPPTGRDILCmd_enum_defval KINP_BPPTGRDILCmd_enum_ovrdflg KINP_BPPTGRDILCmd_enum_ovrdval /end REF_CHARACTERISTIC
/end GROUP
/begin GROUP S3302_BPPTGSysSta "SWC_INP_type/run_SWC_INP_5ms_sys/INP/CAN4/SignalCheck/BodyZone_PS1/BPPTGSysSta"
 /begin REF_CHARACTERISTIC KINP_BPPTGSysSta_enum_defval KINP_BPPTGSysSta_enum_ovrdflg KINP_BPPTGSysSta_enum_ovrdval /end REF_CHARACTERISTIC
/end GROUP
/begin GROUP S3303_BPAPMWinFOpenedSta "SWC_INP_type/run_SWC_INP_5ms_sys/INP/CAN4/SignalCheck/BodyZone_PS2/BPAPMWinFOpenedSta"
 /begin REF_CHARACTERISTIC KINP_BPAPMWinFOpenedSta_pct_defval KINP_BPAPMWinFOpenedSta_pct_ovrdflg KINP_BPAPMWinFOpenedSta_pct_ovrdval /end REF_CHARACTERISTIC
/end GROUP
/begin GROUP S3303_BPAPMWinROpenedSta "SWC_INP_type/run_SWC_INP_5ms_sys/INP/CAN4/SignalCheck/BodyZone_PS2/BPAPMWinROpenedSta"
 /begin REF_CHARACTERISTIC KINP_BPAPMWinROpenedSta_pct_defval KINP_BPAPMWinROpenedSta_pct_ovrdflg KINP_BPAPMWinROpenedSta_pct_ovrdval /end REF_CHARACTERISTIC
/end GROUP
/begin GROUP S3303_BPDoorFHandleCloseSta "SWC_INP_type/run_SWC_INP_5ms_sys/INP/CAN4/SignalCheck/BodyZone_PS2/BPDoorFHandleCloseSta"
 /begin REF_CHARACTERISTIC KINP_BPDoorFHandleCloseSta_flg_defval KINP_BPDoorFHandleCloseSta_flg_ovrdflg KINP_BPDoorFHandleCloseSta_flg_ovrdval /end REF_CHARACTERISTIC
/end GROUP
/begin GROUP S3303_BPDoorRHandleCloseSta "SWC_INP_type/run_SWC_INP_5ms_sys/INP/CAN4/SignalCheck/BodyZone_PS2/BPDoorRHandleCloseSta"
 /begin REF_CHARACTERISTIC KINP_BPDoorRHandleCloseSta_flg_defval KINP_BPDoorRHandleCloseSta_flg_ovrdflg KINP_BPDoorRHandleCloseSta_flg_ovrdval /end REF_CHARACTERISTIC
/end GROUP
/begin GROUP S3303_BPSEATLVentSta "SWC_INP_type/run_SWC_INP_5ms_sys/INP/CAN4/SignalCheck/BodyZone_PS2/BPSEATLVentSta"
 /begin REF_CHARACTERISTIC KINP_BPSEATLVentSta_enum_defval KINP_BPSEATLVentSta_enum_ovrdflg KINP_BPSEATLVentSta_enum_ovrdval /end REF_CHARACTERISTIC
/end GROUP
/begin GROUP S3303_BPSEATMLVentSta "SWC_INP_type/run_SWC_INP_5ms_sys/INP/CAN4/SignalCheck/BodyZone_PS2/BPSEATMLVentSta"
 /begin REF_CHARACTERISTIC KINP_BPSEATMLVentSta_enum_defval KINP_BPSEATMLVentSta_enum_ovrdflg KINP_BPSEATMLVentSta_enum_ovrdval /end REF_CHARACTERISTIC
/end GROUP
/begin GROUP S3303_BPSEATMRVentSta "SWC_INP_type/run_SWC_INP_5ms_sys/INP/CAN4/SignalCheck/BodyZone_PS2/BPSEATMRVentSta"
 /begin REF_CHARACTERISTIC KINP_BPSEATMRVentSta_enum_defval KINP_BPSEATMRVentSta_enum_ovrdflg KINP_BPSEATMRVentSta_enum_ovrdval /end REF_CHARACTERISTIC
/end GROUP
/begin GROUP S3303_BPSEATRVentSta "SWC_INP_type/run_SWC_INP_5ms_sys/INP/CAN4/SignalCheck/BodyZone_PS2/BPSEATRVentSta"
 /begin REF_CHARACTERISTIC KINP_BPSEATRVentSta_enum_defval KINP_BPSEATRVentSta_enum_ovrdflg KINP_BPSEATRVentSta_enum_ovrdval /end REF_CHARACTERISTIC
/end GROUP
/begin GROUP S3304_DKCKeyNumSta "SWC_INP_type/run_SWC_INP_5ms_sys/INP/CAN4/SignalCheck/DKC1/DKCKeyNumSta"
 /begin REF_CHARACTERISTIC KINP_DKCKeyNumSta_enum_defval KINP_DKCKeyNumSta_enum_ovrdflg KINP_DKCKeyNumSta_enum_ovrdval /end REF_CHARACTERISTIC
/end GROUP
/begin GROUP S3304_DKCKeyTypeSta "SWC_INP_type/run_SWC_INP_5ms_sys/INP/CAN4/SignalCheck/DKC1/DKCKeyTypeSta"
 /begin REF_CHARACTERISTIC KINP_DKCKeyTypeSta_enum_defval KINP_DKCKeyTypeSta_enum_ovrdflg KINP_DKCKeyTypeSta_enum_ovrdval /end REF_CHARACTERISTIC
/end GROUP
/begin GROUP S3304_DKCPDkeyAreaRAPSSta "SWC_INP_type/run_SWC_INP_5ms_sys/INP/CAN4/SignalCheck/DKC1/DKCPDkeyAreaRAPSSta"
 /begin REF_CHARACTERISTIC KINP_DKCPDkeyAreaRAPSSta_enum_defval KINP_DKCPDkeyAreaRAPSSta_enum_ovrdflg KINP_DKCPDkeyAreaRAPSSta_enum_ovrdval /end REF_CHARACTERISTIC
/end GROUP
/begin GROUP S3304_DKCParkingModeCmd "SWC_INP_type/run_SWC_INP_5ms_sys/INP/CAN4/SignalCheck/DKC1/DKCParkingModeCmd"
 /begin REF_CHARACTERISTIC KINP_DKCParkingModeCmd_enum_defval KINP_DKCParkingModeCmd_enum_ovrdflg KINP_DKCParkingModeCmd_enum_ovrdval /end REF_CHARACTERISTIC
/end GROUP
/begin GROUP S3304_DKCReVehData "SWC_INP_type/run_SWC_INP_5ms_sys/INP/CAN4/SignalCheck/DKC1/DKCReVehData"
 /begin REF_CHARACTERISTIC KINP_DKCReVehData_enum_defval KINP_DKCReVehData_enum_ovrdflg KINP_DKCReVehData_enum_ovrdval /end REF_CHARACTERISTIC
/end GROUP
/begin GROUP S3304_PCommandToBCM "SWC_INP_type/run_SWC_INP_5ms_sys/INP/CAN4/SignalCheck/DKC1/PCommandToBCM"
 /begin REF_CHARACTERISTIC KINP_PCommandToBCM_enum_defval KINP_PCommandToBCM_enum_ovrdflg KINP_PCommandToBCM_enum_ovrdval /end REF_CHARACTERISTIC
/end GROUP
/begin GROUP S3304_PCommandToPTG "SWC_INP_type/run_SWC_INP_5ms_sys/INP/CAN4/SignalCheck/DKC1/PCommandToPTG"
 /begin REF_CHARACTERISTIC KINP_PCommandToPTG_enum_defval KINP_PCommandToPTG_enum_ovrdflg KINP_PCommandToPTG_enum_ovrdval /end REF_CHARACTERISTIC
/end GROUP
/begin GROUP S3304_PDKeyAreaLockUnlock "SWC_INP_type/run_SWC_INP_5ms_sys/INP/CAN4/SignalCheck/DKC1/PDKeyAreaLockUnlock"
 /begin REF_CHARACTERISTIC KINP_PDKeyAreaLockUnlock_enum_defval KINP_PDKeyAreaLockUnlock_enum_ovrdflg KINP_PDKeyAreaLockUnlock_enum_ovrdval /end REF_CHARACTERISTIC
/end GROUP
/begin GROUP S3304_PDKeyAreaPS "SWC_INP_type/run_SWC_INP_5ms_sys/INP/CAN4/SignalCheck/DKC1/PDKeyAreaPS"
 /begin REF_CHARACTERISTIC KINP_PDKeyAreaPS_enum_defval KINP_PDKeyAreaPS_enum_ovrdflg KINP_PDKeyAreaPS_enum_ovrdval /end REF_CHARACTERISTIC
/end GROUP
/begin GROUP S3304_PDKeyAreaPTG "SWC_INP_type/run_SWC_INP_5ms_sys/INP/CAN4/SignalCheck/DKC1/PDKeyAreaPTG"
 /begin REF_CHARACTERISTIC KINP_PDKeyAreaPTG_enum_defval KINP_PDKeyAreaPTG_enum_ovrdflg KINP_PDKeyAreaPTG_enum_ovrdval /end REF_CHARACTERISTIC
/end GROUP
/begin GROUP S3304_PDKeyWelcome "SWC_INP_type/run_SWC_INP_5ms_sys/INP/CAN4/SignalCheck/DKC1/PDKeyWelcome"
 /begin REF_CHARACTERISTIC KINP_PDKeyWelcome_enum_defval KINP_PDKeyWelcome_enum_ovrdflg KINP_PDKeyWelcome_enum_ovrdval /end REF_CHARACTERISTIC
/end GROUP
/begin GROUP S3304_PDkeyShowIVI "SWC_INP_type/run_SWC_INP_5ms_sys/INP/CAN4/SignalCheck/DKC1/PDkeyShowIVI"
 /begin REF_CHARACTERISTIC KINP_PDkeyShowIVI_enum_defval KINP_PDkeyShowIVI_enum_ovrdflg KINP_PDkeyShowIVI_enum_ovrdval /end REF_CHARACTERISTIC
/end GROUP
/begin GROUP S3304_PKeyMiss "SWC_INP_type/run_SWC_INP_5ms_sys/INP/CAN4/SignalCheck/DKC1/PKeyMiss"
 /begin REF_CHARACTERISTIC KINP_PKeyMiss_flg_defval KINP_PKeyMiss_flg_ovrdflg KINP_PKeyMiss_flg_ovrdval /end REF_CHARACTERISTIC
/end GROUP
/begin GROUP S3304_PKeyMode "SWC_INP_type/run_SWC_INP_5ms_sys/INP/CAN4/SignalCheck/DKC1/PKeyMode"
 /begin REF_CHARACTERISTIC KINP_PKeyMode_enum_defval KINP_PKeyMode_enum_ovrdflg KINP_PKeyMode_enum_ovrdval /end REF_CHARACTERISTIC
/end GROUP
/begin GROUP S3304_PUIDLowPower "SWC_INP_type/run_SWC_INP_5ms_sys/INP/CAN4/SignalCheck/DKC1/PUIDLowPower"
 /begin REF_CHARACTERISTIC KINP_PUIDLowPower_flg_defval KINP_PUIDLowPower_flg_ovrdflg KINP_PUIDLowPower_flg_ovrdval /end REF_CHARACTERISTIC
/end GROUP
/begin GROUP S3305_EncryptionDATA063 "SWC_INP_type/run_SWC_INP_5ms_sys/INP/CAN4/SignalCheck/DKC2/EncryptionDATA063" /begin REF_CHARACTERISTIC KINP_EncryptionDATA063_enum_ovrdflg /end REF_CHARACTERISTIC /end GROUP
/begin GROUP S3305_EncryptionDATA64127 "SWC_INP_type/run_SWC_INP_5ms_sys/INP/CAN4/SignalCheck/DKC2/EncryptionDATA64127" /begin REF_CHARACTERISTIC KINP_EncryptionDATA64127_enum_ovrdflg /end REF_CHARACTERISTIC /end GROUP
/begin GROUP S3305_RandomNumberX "SWC_INP_type/run_SWC_INP_5ms_sys/INP/CAN4/SignalCheck/DKC2/RandomNumberX" /begin REF_CHARACTERISTIC KINP_RandomNumberX_enum_ovrdflg /end REF_CHARACTERISTIC /end GROUP
/begin GROUP S3306_PTGActiveSta "SWC_INP_type/run_SWC_INP_5ms_sys/INP/CAN4/SignalCheck/PTG1/PTGActiveSta"
 /begin REF_CHARACTERISTIC KINP_PTGActiveSta_enum_defval KINP_PTGActiveSta_enum_ovrdflg KINP_PTGActiveSta_enum_ovrdval /end REF_CHARACTERISTIC
/end GROUP
/begin GROUP S3306_PTGAutoStaus "SWC_INP_type/run_SWC_INP_5ms_sys/INP/CAN4/SignalCheck/PTG1/PTGAutoStaus"
 /begin REF_CHARACTERISTIC KINP_PTGAutoStaus_flg_defval KINP_PTGAutoStaus_flg_ovrdflg KINP_PTGAutoStaus_flg_ovrdval /end REF_CHARACTERISTIC
/end GROUP
/begin GROUP S3306_PTGExist "SWC_INP_type/run_SWC_INP_5ms_sys/INP/CAN4/SignalCheck/PTG1/PTGExist"
 /begin REF_CHARACTERISTIC KINP_PTGExist_flg_defval KINP_PTGExist_flg_ovrdflg KINP_PTGExist_flg_ovrdval /end REF_CHARACTERISTIC
/end GROUP
/begin GROUP S3306_PTGHWVer "SWC_INP_type/run_SWC_INP_5ms_sys/INP/CAN4/SignalCheck/PTG1/PTGHWVer"
 /begin REF_CHARACTERISTIC KINP_PTGHWVer_enum_defval KINP_PTGHWVer_enum_ovrdflg KINP_PTGHWVer_enum_ovrdval /end REF_CHARACTERISTIC
/end GROUP
/begin GROUP S3306_PTGInnerSW2 "SWC_INP_type/run_SWC_INP_5ms_sys/INP/CAN4/SignalCheck/PTG1/PTGInnerSW2"
 /begin REF_CHARACTERISTIC KINP_PTGInnerSW2_enum_defval KINP_PTGInnerSW2_enum_ovrdflg KINP_PTGInnerSW2_enum_ovrdval /end REF_CHARACTERISTIC
/end GROUP
/begin GROUP S3306_PTGIsSetHeight "SWC_INP_type/run_SWC_INP_5ms_sys/INP/CAN4/SignalCheck/PTG1/PTGIsSetHeight"
 /begin REF_CHARACTERISTIC KINP_PTGIsSetHeight_flg_defval KINP_PTGIsSetHeight_flg_ovrdflg KINP_PTGIsSetHeight_flg_ovrdval /end REF_CHARACTERISTIC
/end GROUP
/begin GROUP S3306_PTGOpenRatio "SWC_INP_type/run_SWC_INP_5ms_sys/INP/CAN4/SignalCheck/PTG1/PTGOpenRatio"
 /begin REF_CHARACTERISTIC KINP_PTGOpenRatio_pct_defval KINP_PTGOpenRatio_pct_ovrdflg KINP_PTGOpenRatio_pct_ovrdval /end REF_CHARACTERISTIC
/end GROUP
/begin GROUP S3306_PTGRDILSta "SWC_INP_type/run_SWC_INP_5ms_sys/INP/CAN4/SignalCheck/PTG1/PTGRDILSta"
 /begin REF_CHARACTERISTIC KINP_PTGRDILSta_enum_defval KINP_PTGRDILSta_enum_ovrdflg KINP_PTGRDILSta_enum_ovrdval /end REF_CHARACTERISTIC
/end GROUP
/begin GROUP S3306_PTGSWVer "SWC_INP_type/run_SWC_INP_5ms_sys/INP/CAN4/SignalCheck/PTG1/PTGSWVer"
 /begin REF_CHARACTERISTIC KINP_PTGSWVer_enum_defval KINP_PTGSWVer_enum_ovrdflg KINP_PTGSWVer_enum_ovrdval /end REF_CHARACTERISTIC
/end GROUP
/begin GROUP S3306_PTGSysSta "SWC_INP_type/run_SWC_INP_5ms_sys/INP/CAN4/SignalCheck/PTG1/PTGSysSta"
 /begin REF_CHARACTERISTIC KINP_PTGSysSta_enum_defval KINP_PTGSysSta_enum_ovrdflg KINP_PTGSysSta_enum_ovrdval /end REF_CHARACTERISTIC
/end GROUP
/begin GROUP S3307_DrLockSta "SWC_INP_type/run_SWC_INP_5ms_sys/INP/CAN4/SignalCheck/ZONE_DR1/DrLockSta"
 /begin REF_CHARACTERISTIC KINP_DrLockSta_flg_defval KINP_DrLockSta_flg_ovrdflg KINP_DrLockSta_flg_ovrdval /end REF_CHARACTERISTIC
/end GROUP
/begin GROUP S3307_MIRRORFOLDSW "SWC_INP_type/run_SWC_INP_5ms_sys/INP/CAN4/SignalCheck/ZONE_DR1/MIRRORFOLDSW"
 /begin REF_CHARACTERISTIC KINP_MIRRORFOLDSW_flg_defval KINP_MIRRORFOLDSW_flg_ovrdflg KINP_MIRRORFOLDSW_flg_ovrdval /end REF_CHARACTERISTIC
/end GROUP
/begin GROUP S3307_RLTurnLPErr "SWC_INP_type/run_SWC_INP_5ms_sys/INP/CAN4/SignalCheck/ZONE_DR1/RLTurnLPErr"
 /begin REF_CHARACTERISTIC KINP_RLTurnLPErr_flg_defval KINP_RLTurnLPErr_flg_ovrdflg KINP_RLTurnLPErr_flg_ovrdval /end REF_CHARACTERISTIC
/end GROUP
/begin GROUP S3307_RLTurnLampC "SWC_INP_type/run_SWC_INP_5ms_sys/INP/CAN4/SignalCheck/ZONE_DR1/RLTurnLampC"
 /begin REF_CHARACTERISTIC KINP_RLTurnLampC_mA_defval KINP_RLTurnLampC_mA_ovrdflg KINP_RLTurnLampC_mA_ovrdval /end REF_CHARACTERISTIC
/end GROUP
/begin GROUP S3307_RRTurnLPErr "SWC_INP_type/run_SWC_INP_5ms_sys/INP/CAN4/SignalCheck/ZONE_DR1/RRTurnLPErr"
 /begin REF_CHARACTERISTIC KINP_RRTurnLPErr_flg_defval KINP_RRTurnLPErr_flg_ovrdflg KINP_RRTurnLPErr_flg_ovrdval /end REF_CHARACTERISTIC
/end GROUP
/begin GROUP S3307_RRTurnLampC "SWC_INP_type/run_SWC_INP_5ms_sys/INP/CAN4/SignalCheck/ZONE_DR1/RRTurnLampC"
 /begin REF_CHARACTERISTIC KINP_RRTurnLampC_mA_defval KINP_RRTurnLampC_mA_ovrdflg KINP_RRTurnLampC_mA_ovrdval /end REF_CHARACTERISTIC
/end GROUP
/begin GROUP S3307_RWiperAS "SWC_INP_type/run_SWC_INP_5ms_sys/INP/CAN4/SignalCheck/ZONE_DR1/RWiperAS"
 /begin REF_CHARACTERISTIC KINP_RWiperAS_flg_defval KINP_RWiperAS_flg_ovrdflg KINP_RWiperAS_flg_ovrdval /end REF_CHARACTERISTIC
/end GROUP
/begin GROUP S3307_RWiperProtection "SWC_INP_type/run_SWC_INP_5ms_sys/INP/CAN4/SignalCheck/ZONE_DR1/RWiperProtection"
 /begin REF_CHARACTERISTIC KINP_RWiperProtection_flg_defval KINP_RWiperProtection_flg_ovrdflg KINP_RWiperProtection_flg_ovrdval /end REF_CHARACTERISTIC
/end GROUP
/begin GROUP S3308_BlowerErr "SWC_INP_type/run_SWC_INP_5ms_sys/INP/CAN4/SignalCheck/ZONE_DR_VCU/BlowerErr"
 /begin REF_CHARACTERISTIC KINP_BlowerErr_enum_defval KINP_BlowerErr_enum_ovrdflg KINP_BlowerErr_enum_ovrdval /end REF_CHARACTERISTIC
/end GROUP
/begin GROUP S3308_DrPMMLVOutPErrLmp "SWC_INP_type/run_SWC_INP_5ms_sys/INP/CAN4/SignalCheck/ZONE_DR_VCU/DrPMMLVOutPErrLmp"
 /begin REF_CHARACTERISTIC KINP_DrPMMLVOutPErrLmp_flg_defval KINP_DrPMMLVOutPErrLmp_flg_ovrdflg KINP_DrPMMLVOutPErrLmp_flg_ovrdval /end REF_CHARACTERISTIC
/end GROUP
/begin GROUP S3308_DrPMMSysErrLmp "SWC_INP_type/run_SWC_INP_5ms_sys/INP/CAN4/SignalCheck/ZONE_DR_VCU/DrPMMSysErrLmp"
 /begin REF_CHARACTERISTIC KINP_DrPMMSysErrLmp_flg_defval KINP_DrPMMSysErrLmp_flg_ovrdflg KINP_DrPMMSysErrLmp_flg_ovrdval /end REF_CHARACTERISTIC
/end GROUP
/begin GROUP S3308_DrSCPSysErrLmp "SWC_INP_type/run_SWC_INP_5ms_sys/INP/CAN4/SignalCheck/ZONE_DR_VCU/DrSCPSysErrLmp"
 /begin REF_CHARACTERISTIC KINP_DrSCPSysErrLmp_flg_defval KINP_DrSCPSysErrLmp_flg_ovrdflg KINP_DrSCPSysErrLmp_flg_ovrdval /end REF_CHARACTERISTIC
/end GROUP
/begin GROUP S3308_DrStdAErrSta "SWC_INP_type/run_SWC_INP_5ms_sys/INP/CAN4/SignalCheck/ZONE_DR_VCU/DrStdAErrSta"
 /begin REF_CHARACTERISTIC KINP_DrStdAErrSta_flg_defval KINP_DrStdAErrSta_flg_ovrdflg KINP_DrStdAErrSta_flg_ovrdval /end REF_CHARACTERISTIC
/end GROUP
/begin GROUP S3308_LeftHallPos "SWC_INP_type/run_SWC_INP_5ms_sys/INP/CAN4/SignalCheck/ZONE_DR_VCU/LeftHallPos"
 /begin REF_CHARACTERISTIC KINP_LeftHallPos_enum_defval KINP_LeftHallPos_enum_ovrdflg KINP_LeftHallPos_enum_ovrdval /end REF_CHARACTERISTIC
/end GROUP
/begin GROUP S3308_SolarL "SWC_INP_type/run_SWC_INP_5ms_sys/INP/CAN4/SignalCheck/ZONE_DR_VCU/SolarL"
 /begin REF_CHARACTERISTIC KINP_SolarL_W_defval KINP_SolarL_W_ovrdflg KINP_SolarL_W_ovrdval /end REF_CHARACTERISTIC
/end GROUP
/begin GROUP S3308_SolarLErr "SWC_INP_type/run_SWC_INP_5ms_sys/INP/CAN4/SignalCheck/ZONE_DR_VCU/SolarLErr"
 /begin REF_CHARACTERISTIC KINP_SolarLErr_enum_defval KINP_SolarLErr_enum_ovrdflg KINP_SolarLErr_enum_ovrdval /end REF_CHARACTERISTIC
/end GROUP
/begin GROUP S3308_SolarR "SWC_INP_type/run_SWC_INP_5ms_sys/INP/CAN4/SignalCheck/ZONE_DR_VCU/SolarR"
 /begin REF_CHARACTERISTIC KINP_SolarR_W_defval KINP_SolarR_W_ovrdflg KINP_SolarR_W_ovrdval /end REF_CHARACTERISTIC
/end GROUP
/begin GROUP S3308_SolarRErr "SWC_INP_type/run_SWC_INP_5ms_sys/INP/CAN4/SignalCheck/ZONE_DR_VCU/SolarRErr"
 /begin REF_CHARACTERISTIC KINP_SolarRErr_enum_defval KINP_SolarRErr_enum_ovrdflg KINP_SolarRErr_enum_ovrdval /end REF_CHARACTERISTIC
/end GROUP
/begin GROUP S3308_TFaceL "SWC_INP_type/run_SWC_INP_5ms_sys/INP/CAN4/SignalCheck/ZONE_DR_VCU/TFaceL"
 /begin REF_CHARACTERISTIC KINP_TFaceL_C_defval KINP_TFaceL_C_ovrdflg KINP_TFaceL_C_ovrdval /end REF_CHARACTERISTIC
/end GROUP
/begin GROUP S3308_TFaceLErr "SWC_INP_type/run_SWC_INP_5ms_sys/INP/CAN4/SignalCheck/ZONE_DR_VCU/TFaceLErr"
 /begin REF_CHARACTERISTIC KINP_TFaceLErr_enum_defval KINP_TFaceLErr_enum_ovrdflg KINP_TFaceLErr_enum_ovrdval /end REF_CHARACTERISTIC
/end GROUP
/begin GROUP S3308_TFaceR "SWC_INP_type/run_SWC_INP_5ms_sys/INP/CAN4/SignalCheck/ZONE_DR_VCU/TFaceR"
 /begin REF_CHARACTERISTIC KINP_TFaceR_C_defval KINP_TFaceR_C_ovrdflg KINP_TFaceR_C_ovrdval /end REF_CHARACTERISTIC
/end GROUP
/begin GROUP S3308_TFaceRErr "SWC_INP_type/run_SWC_INP_5ms_sys/INP/CAN4/SignalCheck/ZONE_DR_VCU/TFaceRErr"
 /begin REF_CHARACTERISTIC KINP_TFaceRErr_enum_defval KINP_TFaceRErr_enum_ovrdflg KINP_TFaceRErr_enum_ovrdval /end REF_CHARACTERISTIC
/end GROUP
/begin GROUP S3308_TFaceRr "SWC_INP_type/run_SWC_INP_5ms_sys/INP/CAN4/SignalCheck/ZONE_DR_VCU/TFaceRr"
 /begin REF_CHARACTERISTIC KINP_TFaceRr_C_defval KINP_TFaceRr_C_ovrdflg KINP_TFaceRr_C_ovrdval /end REF_CHARACTERISTIC
/end GROUP
/begin GROUP S3308_TFaceRrErr "SWC_INP_type/run_SWC_INP_5ms_sys/INP/CAN4/SignalCheck/ZONE_DR_VCU/TFaceRrErr"
 /begin REF_CHARACTERISTIC KINP_TFaceRrErr_enum_defval KINP_TFaceRrErr_enum_ovrdflg KINP_TFaceRrErr_enum_ovrdval /end REF_CHARACTERISTIC
/end GROUP
/begin GROUP S3308_TFootL "SWC_INP_type/run_SWC_INP_5ms_sys/INP/CAN4/SignalCheck/ZONE_DR_VCU/TFootL"
 /begin REF_CHARACTERISTIC KINP_TFootL_C_defval KINP_TFootL_C_ovrdflg KINP_TFootL_C_ovrdval /end REF_CHARACTERISTIC
/end GROUP
/begin GROUP S3308_TFootLErr "SWC_INP_type/run_SWC_INP_5ms_sys/INP/CAN4/SignalCheck/ZONE_DR_VCU/TFootLErr"
 /begin REF_CHARACTERISTIC KINP_TFootLErr_enum_defval KINP_TFootLErr_enum_ovrdflg KINP_TFootLErr_enum_ovrdval /end REF_CHARACTERISTIC
/end GROUP
/begin GROUP S3308_TFootR "SWC_INP_type/run_SWC_INP_5ms_sys/INP/CAN4/SignalCheck/ZONE_DR_VCU/TFootR"
 /begin REF_CHARACTERISTIC KINP_TFootR_C_defval KINP_TFootR_C_ovrdflg KINP_TFootR_C_ovrdval /end REF_CHARACTERISTIC
/end GROUP
/begin GROUP S3308_TFootRErr "SWC_INP_type/run_SWC_INP_5ms_sys/INP/CAN4/SignalCheck/ZONE_DR_VCU/TFootRErr"
 /begin REF_CHARACTERISTIC KINP_TFootRErr_enum_defval KINP_TFootRErr_enum_ovrdflg KINP_TFootRErr_enum_ovrdval /end REF_CHARACTERISTIC
/end GROUP
/begin GROUP S3308_TFootRr "SWC_INP_type/run_SWC_INP_5ms_sys/INP/CAN4/SignalCheck/ZONE_DR_VCU/TFootRr"
 /begin REF_CHARACTERISTIC KINP_TFootRr_C_defval KINP_TFootRr_C_ovrdflg KINP_TFootRr_C_ovrdval /end REF_CHARACTERISTIC
/end GROUP
/begin GROUP S3308_TFootRrErr "SWC_INP_type/run_SWC_INP_5ms_sys/INP/CAN4/SignalCheck/ZONE_DR_VCU/TFootRrErr"
 /begin REF_CHARACTERISTIC KINP_TFootRrErr_enum_defval KINP_TFootRrErr_enum_ovrdflg KINP_TFootRrErr_enum_ovrdval /end REF_CHARACTERISTIC
/end GROUP
/begin GROUP S3308_Tevap "SWC_INP_type/run_SWC_INP_5ms_sys/INP/CAN4/SignalCheck/ZONE_DR_VCU/Tevap"
 /begin REF_CHARACTERISTIC KINP_Tevap_C_defval KINP_Tevap_C_ovrdflg KINP_Tevap_C_ovrdval /end REF_CHARACTERISTIC
/end GROUP
/begin GROUP S3308_TevapErr "SWC_INP_type/run_SWC_INP_5ms_sys/INP/CAN4/SignalCheck/ZONE_DR_VCU/TevapErr"
 /begin REF_CHARACTERISTIC KINP_TevapErr_enum_defval KINP_TevapErr_enum_ovrdflg KINP_TevapErr_enum_ovrdval /end REF_CHARACTERISTIC
/end GROUP
/begin GROUP S3308_Tincar "SWC_INP_type/run_SWC_INP_5ms_sys/INP/CAN4/SignalCheck/ZONE_DR_VCU/Tincar"
 /begin REF_CHARACTERISTIC KINP_Tincar_C_defval KINP_Tincar_C_ovrdflg KINP_Tincar_C_ovrdval /end REF_CHARACTERISTIC
/end GROUP
/begin GROUP S3308_TincarErr "SWC_INP_type/run_SWC_INP_5ms_sys/INP/CAN4/SignalCheck/ZONE_DR_VCU/TincarErr"
 /begin REF_CHARACTERISTIC KINP_TincarErr_enum_defval KINP_TincarErr_enum_ovrdflg KINP_TincarErr_enum_ovrdval /end REF_CHARACTERISTIC
/end GROUP
/begin GROUP S3308_ZoneDrMalfunLevel "SWC_INP_type/run_SWC_INP_5ms_sys/INP/CAN4/SignalCheck/ZONE_DR_VCU/ZoneDrMalfunLevel"
 /begin REF_CHARACTERISTIC KINP_ZoneDrMalfunLevel_enum_defval KINP_ZoneDrMalfunLevel_enum_ovrdflg KINP_ZoneDrMalfunLevel_enum_ovrdval /end REF_CHARACTERISTIC
/end GROUP
/begin GROUP S3309_ChargeInletLockSta "SWC_INP_type/run_SWC_INP_5ms_sys/INP/CAN4/SignalCheck/ZONE_FR1/ChargeInletLockSta"
 /begin REF_CHARACTERISTIC KINP_ChargeInletLockSta_flg_defval KINP_ChargeInletLockSta_flg_ovrdflg KINP_ChargeInletLockSta_flg_ovrdval /end REF_CHARACTERISTIC
/end GROUP
/begin GROUP S3309_CompProEN "SWC_INP_type/run_SWC_INP_5ms_sys/INP/CAN4/SignalCheck/ZONE_FR1/CompProEN"
 /begin REF_CHARACTERISTIC KINP_CompProEN_flg_defval KINP_CompProEN_flg_ovrdflg KINP_CompProEN_flg_ovrdval /end REF_CHARACTERISTIC
/end GROUP
/begin GROUP S3309_FLTurnLPErr "SWC_INP_type/run_SWC_INP_5ms_sys/INP/CAN4/SignalCheck/ZONE_FR1/FLTurnLPErr"
 /begin REF_CHARACTERISTIC KINP_FLTurnLPErr_flg_defval KINP_FLTurnLPErr_flg_ovrdflg KINP_FLTurnLPErr_flg_ovrdval /end REF_CHARACTERISTIC
/end GROUP
/begin GROUP S3309_FLTurnLampC "SWC_INP_type/run_SWC_INP_5ms_sys/INP/CAN4/SignalCheck/ZONE_FR1/FLTurnLampC"
 /begin REF_CHARACTERISTIC KINP_FLTurnLampC_mA_defval KINP_FLTurnLampC_mA_ovrdflg KINP_FLTurnLampC_mA_ovrdval /end REF_CHARACTERISTIC
/end GROUP
/begin GROUP S3309_FLTurnLightWarning "SWC_INP_type/run_SWC_INP_5ms_sys/INP/CAN4/SignalCheck/ZONE_FR1/FLTurnLightWarning"
 /begin REF_CHARACTERISTIC KINP_FLTurnLightWarning_flg_defval KINP_FLTurnLightWarning_flg_ovrdflg KINP_FLTurnLightWarning_flg_ovrdval /end REF_CHARACTERISTIC
/end GROUP
/begin GROUP S3309_FRTurnLPErr "SWC_INP_type/run_SWC_INP_5ms_sys/INP/CAN4/SignalCheck/ZONE_FR1/FRTurnLPErr"
 /begin REF_CHARACTERISTIC KINP_FRTurnLPErr_flg_defval KINP_FRTurnLPErr_flg_ovrdflg KINP_FRTurnLPErr_flg_ovrdval /end REF_CHARACTERISTIC
/end GROUP
/begin GROUP S3309_FRTurnLampC "SWC_INP_type/run_SWC_INP_5ms_sys/INP/CAN4/SignalCheck/ZONE_FR1/FRTurnLampC"
 /begin REF_CHARACTERISTIC KINP_FRTurnLampC_mA_defval KINP_FRTurnLampC_mA_ovrdflg KINP_FRTurnLampC_mA_ovrdval /end REF_CHARACTERISTIC
/end GROUP
/begin GROUP S3309_FRTurnLightWarning "SWC_INP_type/run_SWC_INP_5ms_sys/INP/CAN4/SignalCheck/ZONE_FR1/FRTurnLightWarning"
 /begin REF_CHARACTERISTIC KINP_FRTurnLightWarning_flg_defval KINP_FRTurnLightWarning_flg_ovrdflg KINP_FRTurnLightWarning_flg_ovrdval /end REF_CHARACTERISTIC
/end GROUP
/begin GROUP S3309_FWiperAS "SWC_INP_type/run_SWC_INP_5ms_sys/INP/CAN4/SignalCheck/ZONE_FR1/FWiperAS"
 /begin REF_CHARACTERISTIC KINP_FWiperAS_flg_defval KINP_FWiperAS_flg_ovrdflg KINP_FWiperAS_flg_ovrdval /end REF_CHARACTERISTIC
/end GROUP
/begin GROUP S3309_FWiperProtection "SWC_INP_type/run_SWC_INP_5ms_sys/INP/CAN4/SignalCheck/ZONE_FR1/FWiperProtection"
 /begin REF_CHARACTERISTIC KINP_FWiperProtection_flg_defval KINP_FWiperProtection_flg_ovrdflg KINP_FWiperProtection_flg_ovrdval /end REF_CHARACTERISTIC
/end GROUP
/begin GROUP S3309_LADBHibeamIndication "SWC_INP_type/run_SWC_INP_5ms_sys/INP/CAN4/SignalCheck/ZONE_FR1/LADBHibeamIndication"
 /begin REF_CHARACTERISTIC KINP_LADBHibeamIndication_flg_defval KINP_LADBHibeamIndication_flg_ovrdflg KINP_LADBHibeamIndication_flg_ovrdval /end REF_CHARACTERISTIC
/end GROUP
/begin GROUP S3309_LADBOperationStatus "SWC_INP_type/run_SWC_INP_5ms_sys/INP/CAN4/SignalCheck/ZONE_FR1/LADBOperationStatus"
 /begin REF_CHARACTERISTIC KINP_LADBOperationStatus_flg_defval KINP_LADBOperationStatus_flg_ovrdflg KINP_LADBOperationStatus_flg_ovrdval /end REF_CHARACTERISTIC
/end GROUP
/begin GROUP S3309_LADBWarning "SWC_INP_type/run_SWC_INP_5ms_sys/INP/CAN4/SignalCheck/ZONE_FR1/LADBWarning"
 /begin REF_CHARACTERISTIC KINP_LADBWarning_flg_defval KINP_LADBWarning_flg_ovrdflg KINP_LADBWarning_flg_ovrdval /end REF_CHARACTERISTIC
/end GROUP
/begin GROUP S3309_LAHBWarning "SWC_INP_type/run_SWC_INP_5ms_sys/INP/CAN4/SignalCheck/ZONE_FR1/LAHBWarning"
 /begin REF_CHARACTERISTIC KINP_LAHBWarning_flg_defval KINP_LAHBWarning_flg_ovrdflg KINP_LAHBWarning_flg_ovrdval /end REF_CHARACTERISTIC
/end GROUP
/begin GROUP S3309_LDRLWarning "SWC_INP_type/run_SWC_INP_5ms_sys/INP/CAN4/SignalCheck/ZONE_FR1/LDRLWarning"
 /begin REF_CHARACTERISTIC KINP_LDRLWarning_flg_defval KINP_LDRLWarning_flg_ovrdflg KINP_LDRLWarning_flg_ovrdval /end REF_CHARACTERISTIC
/end GROUP
/begin GROUP S3309_LLBWarning "SWC_INP_type/run_SWC_INP_5ms_sys/INP/CAN4/SignalCheck/ZONE_FR1/LLBWarning"
 /begin REF_CHARACTERISTIC KINP_LLBWarning_flg_defval KINP_LLBWarning_flg_ovrdflg KINP_LLBWarning_flg_ovrdval /end REF_CHARACTERISTIC
/end GROUP
/begin GROUP S3309_LpositionLampWarning "SWC_INP_type/run_SWC_INP_5ms_sys/INP/CAN4/SignalCheck/ZONE_FR1/LpositionLampWarning"
 /begin REF_CHARACTERISTIC KINP_LpositionLampWarning_flg_defval KINP_LpositionLampWarning_flg_ovrdflg KINP_LpositionLampWarning_flg_ovrdval /end REF_CHARACTERISTIC
/end GROUP
/begin GROUP S3309_RADBHibeamIndication "SWC_INP_type/run_SWC_INP_5ms_sys/INP/CAN4/SignalCheck/ZONE_FR1/RADBHibeamIndication"
 /begin REF_CHARACTERISTIC KINP_RADBHibeamIndication_flg_defval KINP_RADBHibeamIndication_flg_ovrdflg KINP_RADBHibeamIndication_flg_ovrdval /end REF_CHARACTERISTIC
/end GROUP
/begin GROUP S3309_RADBOperationStatus "SWC_INP_type/run_SWC_INP_5ms_sys/INP/CAN4/SignalCheck/ZONE_FR1/RADBOperationStatus"
 /begin REF_CHARACTERISTIC KINP_RADBOperationStatus_flg_defval KINP_RADBOperationStatus_flg_ovrdflg KINP_RADBOperationStatus_flg_ovrdval /end REF_CHARACTERISTIC
/end GROUP
/begin GROUP S3309_RADBWarning "SWC_INP_type/run_SWC_INP_5ms_sys/INP/CAN4/SignalCheck/ZONE_FR1/RADBWarning"
 /begin REF_CHARACTERISTIC KINP_RADBWarning_flg_defval KINP_RADBWarning_flg_ovrdflg KINP_RADBWarning_flg_ovrdval /end REF_CHARACTERISTIC
/end GROUP
/begin GROUP S3309_RAHBWarning "SWC_INP_type/run_SWC_INP_5ms_sys/INP/CAN4/SignalCheck/ZONE_FR1/RAHBWarning"
 /begin REF_CHARACTERISTIC KINP_RAHBWarning_flg_defval KINP_RAHBWarning_flg_ovrdflg KINP_RAHBWarning_flg_ovrdval /end REF_CHARACTERISTIC
/end GROUP
/begin GROUP S3309_RDRLWarning "SWC_INP_type/run_SWC_INP_5ms_sys/INP/CAN4/SignalCheck/ZONE_FR1/RDRLWarning"
 /begin REF_CHARACTERISTIC KINP_RDRLWarning_flg_defval KINP_RDRLWarning_flg_ovrdflg KINP_RDRLWarning_flg_ovrdval /end REF_CHARACTERISTIC
/end GROUP
/begin GROUP S3309_RLBWarning "SWC_INP_type/run_SWC_INP_5ms_sys/INP/CAN4/SignalCheck/ZONE_FR1/RLBWarning"
 /begin REF_CHARACTERISTIC KINP_RLBWarning_flg_defval KINP_RLBWarning_flg_ovrdflg KINP_RLBWarning_flg_ovrdval /end REF_CHARACTERISTIC
/end GROUP
/begin GROUP S3309_RpositionLampWarning "SWC_INP_type/run_SWC_INP_5ms_sys/INP/CAN4/SignalCheck/ZONE_FR1/RpositionLampWarning"
 /begin REF_CHARACTERISTIC KINP_RpositionLampWarning_flg_defval KINP_RpositionLampWarning_flg_ovrdflg KINP_RpositionLampWarning_flg_ovrdval /end REF_CHARACTERISTIC
/end GROUP
/begin GROUP S3309_TrailerCheck "SWC_INP_type/run_SWC_INP_5ms_sys/INP/CAN4/SignalCheck/ZONE_FR1/TrailerCheck"
 /begin REF_CHARACTERISTIC KINP_TrailerCheck_flg_defval KINP_TrailerCheck_flg_ovrdflg KINP_TrailerCheck_flg_ovrdval /end REF_CHARACTERISTIC
/end GROUP
/begin GROUP S3309_TrailerModeSta "SWC_INP_type/run_SWC_INP_5ms_sys/INP/CAN4/SignalCheck/ZONE_FR1/TrailerModeSta"
 /begin REF_CHARACTERISTIC KINP_TrailerModeSta_enum_defval KINP_TrailerModeSta_enum_ovrdflg KINP_TrailerModeSta_enum_ovrdval /end REF_CHARACTERISTIC
/end GROUP
/begin GROUP S3309_ZFRBCMChargerDoorSWSta "SWC_INP_type/run_SWC_INP_5ms_sys/INP/CAN4/SignalCheck/ZONE_FR1/ZFRBCMChargerDoorSWSta"
 /begin REF_CHARACTERISTIC KINP_ZFRBCMChargerDoorSWSta_flg_defval KINP_ZFRBCMChargerDoorSWSta_flg_ovrdflg KINP_ZFRBCMChargerDoorSWSta_flg_ovrdval /end REF_CHARACTERISTIC
/end GROUP
/begin GROUP S3309_ZFRBCMHRLTurnLPNormalSta "SWC_INP_type/run_SWC_INP_5ms_sys/INP/CAN4/SignalCheck/ZONE_FR1/ZFRBCMHRLTurnLPNormalSta"
 /begin REF_CHARACTERISTIC KINP_ZFRBCMHRLTurnLPNormalSta_flg_defval KINP_ZFRBCMHRLTurnLPNormalSta_flg_ovrdflg KINP_ZFRBCMHRLTurnLPNormalSta_flg_ovrdval /end REF_CHARACTERISTIC
/end GROUP
/begin GROUP S3309_ZFRBCMHRRTurnLPHNormalSta "SWC_INP_type/run_SWC_INP_5ms_sys/INP/CAN4/SignalCheck/ZONE_FR1/ZFRBCMHRRTurnLPHNormalSta"
 /begin REF_CHARACTERISTIC KINP_ZFRBCMHRRTurnLPHNormalSta_flg_defval KINP_ZFRBCMHRRTurnLPHNormalSta_flg_ovrdflg KINP_ZFRBCMHRRTurnLPHNormalSta_flg_ovrdval /end REF_CHARACTERISTIC
/end GROUP
/begin GROUP S3309_ZFRTHCMCLEVentActYSta "SWC_INP_type/run_SWC_INP_5ms_sys/INP/CAN4/SignalCheck/ZONE_FR1/ZFRTHCMCLEVentActYSta"
 /begin REF_CHARACTERISTIC KINP_ZFRTHCMCLEVentActYSta_pct_defval KINP_ZFRTHCMCLEVentActYSta_pct_ovrdflg KINP_ZFRTHCMCLEVentActYSta_pct_ovrdval /end REF_CHARACTERISTIC
/end GROUP
/begin GROUP S3309_ZFRTHCMCREVentActYSta "SWC_INP_type/run_SWC_INP_5ms_sys/INP/CAN4/SignalCheck/ZONE_FR1/ZFRTHCMCREVentActYSta"
 /begin REF_CHARACTERISTIC KINP_ZFRTHCMCREVentActYSta_pct_defval KINP_ZFRTHCMCREVentActYSta_pct_ovrdflg KINP_ZFRTHCMCREVentActYSta_pct_ovrdval /end REF_CHARACTERISTIC
/end GROUP
/begin GROUP S3309_ZFRTHCMLEVentActYSta "SWC_INP_type/run_SWC_INP_5ms_sys/INP/CAN4/SignalCheck/ZONE_FR1/ZFRTHCMLEVentActYSta"
 /begin REF_CHARACTERISTIC KINP_ZFRTHCMLEVentActYSta_pct_defval KINP_ZFRTHCMLEVentActYSta_pct_ovrdflg KINP_ZFRTHCMLEVentActYSta_pct_ovrdval /end REF_CHARACTERISTIC
/end GROUP
/begin GROUP S3309_ZFRTHCMREVentActYSta "SWC_INP_type/run_SWC_INP_5ms_sys/INP/CAN4/SignalCheck/ZONE_FR1/ZFRTHCMREVentActYSta"
 /begin REF_CHARACTERISTIC KINP_ZFRTHCMREVentActYSta_pct_defval KINP_ZFRTHCMREVentActYSta_pct_ovrdflg KINP_ZFRTHCMREVentActYSta_pct_ovrdval /end REF_CHARACTERISTIC
/end GROUP
/begin GROUP S3310_AGSErr "SWC_INP_type/run_SWC_INP_5ms_sys/INP/CAN4/SignalCheck/ZONE_FR_VCU/AGSErr"
 /begin REF_CHARACTERISTIC KINP_AGSErr_enum_defval KINP_AGSErr_enum_ovrdflg KINP_AGSErr_enum_ovrdval /end REF_CHARACTERISTIC
/end GROUP
/begin GROUP S3310_BatInTemp "SWC_INP_type/run_SWC_INP_5ms_sys/INP/CAN4/SignalCheck/ZONE_FR_VCU/BatInTemp"
 /begin REF_CHARACTERISTIC KINP_BatInTemp_C_defval KINP_BatInTemp_C_ovrdflg KINP_BatInTemp_C_ovrdval /end REF_CHARACTERISTIC
/end GROUP
/begin GROUP S3310_BatInTempErr "SWC_INP_type/run_SWC_INP_5ms_sys/INP/CAN4/SignalCheck/ZONE_FR_VCU/BatInTempErr"
 /begin REF_CHARACTERISTIC KINP_BatInTempErr_enum_defval KINP_BatInTempErr_enum_ovrdflg KINP_BatInTempErr_enum_ovrdval /end REF_CHARACTERISTIC
/end GROUP
/begin GROUP S3310_BatOutTemp "SWC_INP_type/run_SWC_INP_5ms_sys/INP/CAN4/SignalCheck/ZONE_FR_VCU/BatOutTemp"
 /begin REF_CHARACTERISTIC KINP_BatOutTemp_C_defval KINP_BatOutTemp_C_ovrdflg KINP_BatOutTemp_C_ovrdval /end REF_CHARACTERISTIC
/end GROUP
/begin GROUP S3310_COMPErr "SWC_INP_type/run_SWC_INP_5ms_sys/INP/CAN4/SignalCheck/ZONE_FR_VCU/COMPErr"
 /begin REF_CHARACTERISTIC KINP_COMPErr_enum_defval KINP_COMPErr_enum_ovrdflg KINP_COMPErr_enum_ovrdval /end REF_CHARACTERISTIC
/end GROUP
/begin GROUP S3310_EACProtectEnable "SWC_INP_type/run_SWC_INP_5ms_sys/INP/CAN4/SignalCheck/ZONE_FR_VCU/EACProtectEnable"
 /begin REF_CHARACTERISTIC KINP_EACProtectEnable_enum_defval KINP_EACProtectEnable_enum_ovrdflg KINP_EACProtectEnable_enum_ovrdval /end REF_CHARACTERISTIC
/end GROUP
/begin GROUP S3310_EWP3Err "SWC_INP_type/run_SWC_INP_5ms_sys/INP/CAN4/SignalCheck/ZONE_FR_VCU/EWP3Err"
 /begin REF_CHARACTERISTIC KINP_EWP3Err_enum_defval KINP_EWP3Err_enum_ovrdflg KINP_EWP3Err_enum_ovrdval /end REF_CHARACTERISTIC
/end GROUP
/begin GROUP S3310_EXV1Err "SWC_INP_type/run_SWC_INP_5ms_sys/INP/CAN4/SignalCheck/ZONE_FR_VCU/EXV1Err"
 /begin REF_CHARACTERISTIC KINP_EXV1Err_enum_defval KINP_EXV1Err_enum_ovrdflg KINP_EXV1Err_enum_ovrdval /end REF_CHARACTERISTIC
/end GROUP
/begin GROUP S3310_EXV2Err "SWC_INP_type/run_SWC_INP_5ms_sys/INP/CAN4/SignalCheck/ZONE_FR_VCU/EXV2Err"
 /begin REF_CHARACTERISTIC KINP_EXV2Err_enum_defval KINP_EXV2Err_enum_ovrdflg KINP_EXV2Err_enum_ovrdval /end REF_CHARACTERISTIC
/end GROUP
/begin GROUP S3310_FanErr "SWC_INP_type/run_SWC_INP_5ms_sys/INP/CAN4/SignalCheck/ZONE_FR_VCU/FanErr"
 /begin REF_CHARACTERISTIC KINP_FanErr_enum_defval KINP_FanErr_enum_ovrdflg KINP_FanErr_enum_ovrdval /end REF_CHARACTERISTIC
/end GROUP
/begin GROUP S3310_FrPMMLimpHomeActReq "SWC_INP_type/run_SWC_INP_5ms_sys/INP/CAN4/SignalCheck/ZONE_FR_VCU/FrPMMLimpHomeActReq"
 /begin REF_CHARACTERISTIC KINP_FrPMMLimpHomeActReq_flg_defval KINP_FrPMMLimpHomeActReq_flg_ovrdflg KINP_FrPMMLimpHomeActReq_flg_ovrdval /end REF_CHARACTERISTIC
/end GROUP
/begin GROUP S3310_MotorInTemp "SWC_INP_type/run_SWC_INP_5ms_sys/INP/CAN4/SignalCheck/ZONE_FR_VCU/MotorInTemp"
 /begin REF_CHARACTERISTIC KINP_MotorInTemp_C_defval KINP_MotorInTemp_C_ovrdflg KINP_MotorInTemp_C_ovrdval /end REF_CHARACTERISTIC
/end GROUP
/begin GROUP S3310_MotorInTempErr "SWC_INP_type/run_SWC_INP_5ms_sys/INP/CAN4/SignalCheck/ZONE_FR_VCU/MotorInTempErr"
 /begin REF_CHARACTERISTIC KINP_MotorInTempErr_enum_defval KINP_MotorInTempErr_enum_ovrdflg KINP_MotorInTempErr_enum_ovrdval /end REF_CHARACTERISTIC
/end GROUP
/begin GROUP S3310_MotorOutTemp "SWC_INP_type/run_SWC_INP_5ms_sys/INP/CAN4/SignalCheck/ZONE_FR_VCU/MotorOutTemp"
 /begin REF_CHARACTERISTIC KINP_MotorOutTemp_C_defval KINP_MotorOutTemp_C_ovrdflg KINP_MotorOutTemp_C_ovrdval /end REF_CHARACTERISTIC
/end GROUP
/begin GROUP S3310_MotorOutTempErr "SWC_INP_type/run_SWC_INP_5ms_sys/INP/CAN4/SignalCheck/ZONE_FR_VCU/MotorOutTempErr"
 /begin REF_CHARACTERISTIC KINP_MotorOutTempErr_enum_defval KINP_MotorOutTempErr_enum_ovrdflg KINP_MotorOutTempErr_enum_ovrdval /end REF_CHARACTERISTIC
/end GROUP
/begin GROUP S3310_PTHighP "SWC_INP_type/run_SWC_INP_5ms_sys/INP/CAN4/SignalCheck/ZONE_FR_VCU/PTHighP"
 /begin REF_CHARACTERISTIC KINP_PTHighP_KPa_defval KINP_PTHighP_KPa_ovrdflg KINP_PTHighP_KPa_ovrdval /end REF_CHARACTERISTIC
/end GROUP
/begin GROUP S3310_PTHighPErr "SWC_INP_type/run_SWC_INP_5ms_sys/INP/CAN4/SignalCheck/ZONE_FR_VCU/PTHighPErr"
 /begin REF_CHARACTERISTIC KINP_PTHighPErr_enum_defval KINP_PTHighPErr_enum_ovrdflg KINP_PTHighPErr_enum_ovrdval /end REF_CHARACTERISTIC
/end GROUP
/begin GROUP S3310_PTHighTact "SWC_INP_type/run_SWC_INP_5ms_sys/INP/CAN4/SignalCheck/ZONE_FR_VCU/PTHighTact"
 /begin REF_CHARACTERISTIC KINP_PTHighTact_C_defval KINP_PTHighTact_C_ovrdflg KINP_PTHighTact_C_ovrdval /end REF_CHARACTERISTIC
/end GROUP
/begin GROUP S3310_PTHighTactErr "SWC_INP_type/run_SWC_INP_5ms_sys/INP/CAN4/SignalCheck/ZONE_FR_VCU/PTHighTactErr"
 /begin REF_CHARACTERISTIC KINP_PTHighTactErr_enum_defval KINP_PTHighTactErr_enum_ovrdflg KINP_PTHighTactErr_enum_ovrdval /end REF_CHARACTERISTIC
/end GROUP
/begin GROUP S3310_PTLowP1 "SWC_INP_type/run_SWC_INP_5ms_sys/INP/CAN4/SignalCheck/ZONE_FR_VCU/PTLowP1"
 /begin REF_CHARACTERISTIC KINP_PTLowP1_KPa_defval KINP_PTLowP1_KPa_ovrdflg KINP_PTLowP1_KPa_ovrdval /end REF_CHARACTERISTIC
/end GROUP
/begin GROUP S3310_PTLowP1Err "SWC_INP_type/run_SWC_INP_5ms_sys/INP/CAN4/SignalCheck/ZONE_FR_VCU/PTLowP1Err"
 /begin REF_CHARACTERISTIC KINP_PTLowP1Err_enum_defval KINP_PTLowP1Err_enum_ovrdflg KINP_PTLowP1Err_enum_ovrdval /end REF_CHARACTERISTIC
/end GROUP
/begin GROUP S3310_PTLowP2 "SWC_INP_type/run_SWC_INP_5ms_sys/INP/CAN4/SignalCheck/ZONE_FR_VCU/PTLowP2"
 /begin REF_CHARACTERISTIC KINP_PTLowP2_KPa_defval KINP_PTLowP2_KPa_ovrdflg KINP_PTLowP2_KPa_ovrdval /end REF_CHARACTERISTIC
/end GROUP
/begin GROUP S3310_PTLowP2Err "SWC_INP_type/run_SWC_INP_5ms_sys/INP/CAN4/SignalCheck/ZONE_FR_VCU/PTLowP2Err"
 /begin REF_CHARACTERISTIC KINP_PTLowP2Err_enum_defval KINP_PTLowP2Err_enum_ovrdflg KINP_PTLowP2Err_enum_ovrdval /end REF_CHARACTERISTIC
/end GROUP
/begin GROUP S3310_PTLowT1 "SWC_INP_type/run_SWC_INP_5ms_sys/INP/CAN4/SignalCheck/ZONE_FR_VCU/PTLowT1"
 /begin REF_CHARACTERISTIC KINP_PTLowT1_C_defval KINP_PTLowT1_C_ovrdflg KINP_PTLowT1_C_ovrdval /end REF_CHARACTERISTIC
/end GROUP
/begin GROUP S3310_PTLowT1Err "SWC_INP_type/run_SWC_INP_5ms_sys/INP/CAN4/SignalCheck/ZONE_FR_VCU/PTLowT1Err"
 /begin REF_CHARACTERISTIC KINP_PTLowT1Err_enum_defval KINP_PTLowT1Err_enum_ovrdflg KINP_PTLowT1Err_enum_ovrdval /end REF_CHARACTERISTIC
/end GROUP
/begin GROUP S3310_PTLowT2 "SWC_INP_type/run_SWC_INP_5ms_sys/INP/CAN4/SignalCheck/ZONE_FR_VCU/PTLowT2"
 /begin REF_CHARACTERISTIC KINP_PTLowT2_C_defval KINP_PTLowT2_C_ovrdflg KINP_PTLowT2_C_ovrdval /end REF_CHARACTERISTIC
/end GROUP
/begin GROUP S3310_PTLowT2Err "SWC_INP_type/run_SWC_INP_5ms_sys/INP/CAN4/SignalCheck/ZONE_FR_VCU/PTLowT2Err"
 /begin REF_CHARACTERISTIC KINP_PTLowT2Err_enum_defval KINP_PTLowT2Err_enum_ovrdflg KINP_PTLowT2Err_enum_ovrdval /end REF_CHARACTERISTIC
/end GROUP
/begin GROUP S3310_SOTXVErr "SWC_INP_type/run_SWC_INP_5ms_sys/INP/CAN4/SignalCheck/ZONE_FR_VCU/SOTXVErr"
 /begin REF_CHARACTERISTIC KINP_SOTXVErr_enum_defval KINP_SOTXVErr_enum_ovrdflg KINP_SOTXVErr_enum_ovrdval /end REF_CHARACTERISTIC
/end GROUP
/begin GROUP S3310_SOV1Err "SWC_INP_type/run_SWC_INP_5ms_sys/INP/CAN4/SignalCheck/ZONE_FR_VCU/SOV1Err"
 /begin REF_CHARACTERISTIC KINP_SOV1Err_enum_defval KINP_SOV1Err_enum_ovrdflg KINP_SOV1Err_enum_ovrdval /end REF_CHARACTERISTIC
/end GROUP
/begin GROUP S3310_SOV2Err "SWC_INP_type/run_SWC_INP_5ms_sys/INP/CAN4/SignalCheck/ZONE_FR_VCU/SOV2Err"
 /begin REF_CHARACTERISTIC KINP_SOV2Err_enum_defval KINP_SOV2Err_enum_ovrdflg KINP_SOV2Err_enum_ovrdval /end REF_CHARACTERISTIC
/end GROUP
/begin GROUP S3310_SOV3Err "SWC_INP_type/run_SWC_INP_5ms_sys/INP/CAN4/SignalCheck/ZONE_FR_VCU/SOV3Err"
 /begin REF_CHARACTERISTIC KINP_SOV3Err_enum_defval KINP_SOV3Err_enum_ovrdflg KINP_SOV3Err_enum_ovrdval /end REF_CHARACTERISTIC
/end GROUP
/begin GROUP S3310_Tamb "SWC_INP_type/run_SWC_INP_5ms_sys/INP/CAN4/SignalCheck/ZONE_FR_VCU/Tamb" /begin REF_CHARACTERISTIC KINP_Tamb_C_defval KINP_Tamb_C_ovrdflg KINP_Tamb_C_ovrdval /end REF_CHARACTERISTIC /end GROUP
/begin GROUP S3310_TambErr "SWC_INP_type/run_SWC_INP_5ms_sys/INP/CAN4/SignalCheck/ZONE_FR_VCU/TambErr"
 /begin REF_CHARACTERISTIC KINP_TambErr_enum_defval KINP_TambErr_enum_ovrdflg KINP_TambErr_enum_ovrdval /end REF_CHARACTERISTIC
/end GROUP
/end MODULE
/end PROJECT
