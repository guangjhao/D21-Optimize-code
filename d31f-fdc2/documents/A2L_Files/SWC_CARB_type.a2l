/******************************************************************************
* ASAP2 file: SWC_CARB_type.a2l
* Code generation for model "SWC_CARB_type".
* Model version : 1.9
* Simulink Coder version : 9.6 (R2021b) 14-May-2021
* C source code generated on : Tue May 20 15:39:00 2025
* Target selection: autosar.tlc
* Embedded hardware selection: ARM Compatible->ARM Cortex-M
* Code generation objectives: Unspecified
* Validation result: Not run
* (add additional file header information here)
******************************************************************************/ ASAP2_VERSION 1 31
/* Version 1.31 */
/begin PROJECT ProjectName "Project Comment Goes Here"
/begin HEADER "Header Comments go here" /end HEADER
/begin MODULE ModuleName "Module Comment Goes Here"
/begin MOD_PAR "MOD PAR Comment Goes Here" /end MOD_PAR
/begin MOD_COMMON "Mod Common Comment Here" BYTE_ORDER MSB_LAST /end MOD_COMMON
/begin RECORD_LAYOUT Scalar_BOOLEAN FNC_VALUES 1 UBYTE COLUMN_DIR DIRECT /end RECORD_LAYOUT
/begin RECORD_LAYOUT Scalar_UBYTE FNC_VALUES 1 UBYTE COLUMN_DIR DIRECT /end RECORD_LAYOUT
/begin RECORD_LAYOUT Scalar_BYTE FNC_VALUES 1 SBYTE COLUMN_DIR DIRECT /end RECORD_LAYOUT
/begin RECORD_LAYOUT Scalar_UWORD FNC_VALUES 1 UWORD COLUMN_DIR DIRECT /end RECORD_LAYOUT
/begin RECORD_LAYOUT Scalar_SWORD FNC_VALUES 1 SWORD COLUMN_DIR DIRECT /end RECORD_LAYOUT
/begin RECORD_LAYOUT Scalar_ULONG FNC_VALUES 1 ULONG COLUMN_DIR DIRECT /end RECORD_LAYOUT
/begin RECORD_LAYOUT Scalar_LONG FNC_VALUES 1 SLONG COLUMN_DIR DIRECT /end RECORD_LAYOUT
/begin RECORD_LAYOUT Scalar_FLOAT32_IEEE FNC_VALUES 1 FLOAT32_IEEE COLUMN_DIR DIRECT /end RECORD_LAYOUT
/begin RECORD_LAYOUT Scalar_FLOAT64_IEEE FNC_VALUES 1 FLOAT64_IEEE COLUMN_DIR DIRECT /end RECORD_LAYOUT
/begin RECORD_LAYOUT Lookup1D_BOOLEAN FNC_VALUES 1 UBYTE COLUMN_DIR DIRECT /end RECORD_LAYOUT
/begin RECORD_LAYOUT Lookup1D_X_BOOLEAN AXIS_PTS_X 1 UBYTE INDEX_INCR DIRECT /end RECORD_LAYOUT
/begin RECORD_LAYOUT Lookup1D_BYTE FNC_VALUES 1 SBYTE COLUMN_DIR DIRECT /end RECORD_LAYOUT
/begin RECORD_LAYOUT Lookup1D_X_BYTE AXIS_PTS_X 1 SBYTE INDEX_INCR DIRECT /end RECORD_LAYOUT
/begin RECORD_LAYOUT Lookup1D_UBYTE FNC_VALUES 1 UBYTE COLUMN_DIR DIRECT /end RECORD_LAYOUT
/begin RECORD_LAYOUT Lookup1D_X_UBYTE AXIS_PTS_X 1 UBYTE INDEX_INCR DIRECT /end RECORD_LAYOUT
/begin RECORD_LAYOUT Lookup1D_UWORD FNC_VALUES 1 UWORD COLUMN_DIR DIRECT /end RECORD_LAYOUT
/begin RECORD_LAYOUT Lookup1D_X_UWORD AXIS_PTS_X 1 UWORD INDEX_INCR DIRECT /end RECORD_LAYOUT
/begin RECORD_LAYOUT Lookup1D_WORD FNC_VALUES 1 SWORD COLUMN_DIR DIRECT /end RECORD_LAYOUT
/begin RECORD_LAYOUT Lookup1D_X_WORD AXIS_PTS_X 1 SWORD INDEX_INCR DIRECT /end RECORD_LAYOUT
/begin RECORD_LAYOUT Lookup1D_ULONG FNC_VALUES 1 ULONG COLUMN_DIR DIRECT /end RECORD_LAYOUT
/begin RECORD_LAYOUT Lookup1D_X_ULONG AXIS_PTS_X 1 ULONG INDEX_INCR DIRECT /end RECORD_LAYOUT
/begin RECORD_LAYOUT Lookup1D_SLONG FNC_VALUES 1 SLONG COLUMN_DIR DIRECT /end RECORD_LAYOUT
/begin RECORD_LAYOUT Lookup1D_X_LONG AXIS_PTS_X 1 SLONG INDEX_INCR DIRECT /end RECORD_LAYOUT
/begin RECORD_LAYOUT Lookup1D_FLOAT32_IEEE FNC_VALUES 1 FLOAT32_IEEE COLUMN_DIR DIRECT /end RECORD_LAYOUT
/begin RECORD_LAYOUT Lookup1D_X_FLOAT32_IEEE AXIS_PTS_X 1 FLOAT32_IEEE INDEX_INCR DIRECT /end RECORD_LAYOUT
/begin RECORD_LAYOUT Lookup1D_FLOAT64_IEEE FNC_VALUES 1 FLOAT64_IEEE COLUMN_DIR DIRECT /end RECORD_LAYOUT
/begin RECORD_LAYOUT Lookup1D_X_FLOAT64_IEEE AXIS_PTS_X 1 FLOAT64_IEEE INDEX_INCR DIRECT /end RECORD_LAYOUT
/begin RECORD_LAYOUT Lookup2D_BOOLEAN FNC_VALUES 1 UBYTE COLUMN_DIR DIRECT /end RECORD_LAYOUT
/begin RECORD_LAYOUT Lookup2D_X_BOOLEAN AXIS_PTS_X 1 UBYTE INDEX_INCR DIRECT /end RECORD_LAYOUT
/begin RECORD_LAYOUT Lookup2D_UBYTE FNC_VALUES 1 UBYTE COLUMN_DIR DIRECT /end RECORD_LAYOUT
/begin RECORD_LAYOUT Lookup2D_X_UBYTE AXIS_PTS_X 1 UBYTE INDEX_INCR DIRECT /end RECORD_LAYOUT
/begin RECORD_LAYOUT Lookup2D_BYTE FNC_VALUES 1 SBYTE COLUMN_DIR DIRECT /end RECORD_LAYOUT
/begin RECORD_LAYOUT Lookup2D_X_BYTE AXIS_PTS_X 1 SBYTE INDEX_INCR DIRECT /end RECORD_LAYOUT
/begin RECORD_LAYOUT Lookup2D_UWORD FNC_VALUES 1 UWORD COLUMN_DIR DIRECT /end RECORD_LAYOUT
/begin RECORD_LAYOUT Lookup2D_X_UWORD AXIS_PTS_X 1 UWORD INDEX_INCR DIRECT /end RECORD_LAYOUT
/begin RECORD_LAYOUT Lookup2D_WORD FNC_VALUES 1 SWORD COLUMN_DIR DIRECT /end RECORD_LAYOUT
/begin RECORD_LAYOUT Lookup2D_X_WORD AXIS_PTS_X 1 SWORD INDEX_INCR DIRECT /end RECORD_LAYOUT
/begin RECORD_LAYOUT Lookup2D_ULONG FNC_VALUES 1 ULONG COLUMN_DIR DIRECT /end RECORD_LAYOUT
/begin RECORD_LAYOUT Lookup2D_X_ULONG AXIS_PTS_X 1 ULONG INDEX_INCR DIRECT /end RECORD_LAYOUT
/begin RECORD_LAYOUT Lookup2D_LONG FNC_VALUES 1 SLONG COLUMN_DIR DIRECT /end RECORD_LAYOUT
/begin RECORD_LAYOUT Lookup2D_X_LONG AXIS_PTS_X 1 SLONG INDEX_INCR DIRECT /end RECORD_LAYOUT
/begin RECORD_LAYOUT Lookup2D_FLOAT32_IEEE FNC_VALUES 1 FLOAT32_IEEE COLUMN_DIR DIRECT /end RECORD_LAYOUT
/begin RECORD_LAYOUT Lookup2D_X_FLOAT32_IEEE AXIS_PTS_X 1 FLOAT32_IEEE INDEX_INCR DIRECT /end RECORD_LAYOUT
/begin RECORD_LAYOUT Lookup2D_FLOAT64_IEEE FNC_VALUES 1 FLOAT64_IEEE COLUMN_DIR DIRECT /end RECORD_LAYOUT
/begin RECORD_LAYOUT Lookup2D_X_FLOAT64_IEEE AXIS_PTS_X 1 FLOAT64_IEEE INDEX_INCR DIRECT /end RECORD_LAYOUT
/begin CHARACTERISTIC ADID_DODRange_pct "" VAL_BLK 0x0000 /* @ECU_Address@ADID_DODRange_pct@ */ Scalar_FLOAT32_IEEE 0 SWC_CARB_type_CM_single_pct 0.0 100.0 NUMBER 7 /end CHARACTERISTIC
/begin CHARACTERISTIC ADID_SOCRange_pct "" VAL_BLK 0x0000 /* @ECU_Address@ADID_SOCRange_pct@ */ Scalar_FLOAT32_IEEE 0 SWC_CARB_type_CM_single_pct 0.0 100.0 NUMBER 7 /end CHARACTERISTIC
/begin CHARACTERISTIC ADID_TempRange_C "" VAL_BLK 0x0000 /* @ECU_Address@ADID_TempRange_C@ */ Scalar_FLOAT32_IEEE 0 SWC_CARB_type_CM_single_pct 0.0 100.0 NUMBER 5 /end CHARACTERISTIC
/begin CHARACTERISTIC KDID_CPSAVehSpdThres_kph "" VALUE 0x0000 /* @ECU_Address@KDID_CPSAVehSpdThres_kph@ */ Scalar_FLOAT32_IEEE 0 SWC_CARB_type_CM_single_sec 0.0 100.0 /end CHARACTERISTIC
/begin CHARACTERISTIC KDID_DoDChrgCycle_s "" VALUE 0x0000 /* @ECU_Address@KDID_DoDChrgCycle_s@ */ Scalar_FLOAT32_IEEE 0 SWC_CARB_type_CM_single_sec 0.0 10.0 /end CHARACTERISTIC
/begin CHARACTERISTIC KDID_FiveKmEquivEnergy_Wh "" VALUE 0x0000 /* @ECU_Address@KDID_FiveKmEquivEnergy_Wh@ */ Scalar_FLOAT32_IEEE 0 SWC_CARB_type_CM_single_Wh 0.0 4.294967295E+9 /end CHARACTERISTIC
/begin CHARACTERISTIC KDID_IPSAVehSpdThres_kph "" VALUE 0x0000 /* @ECU_Address@KDID_IPSAVehSpdThres_kph@ */ Scalar_FLOAT32_IEEE 0 SWC_CARB_type_CM_single_sec 0.0 2.0 /end CHARACTERISTIC
/begin CHARACTERISTIC KDID_PropActiveTripThres_s "" VALUE 0x0000 /* @ECU_Address@KDID_PropActiveTripThres_s@ */ Scalar_FLOAT32_IEEE 0 SWC_CARB_type_CM_single_sec 0.0 10.0 /end CHARACTERISTIC
/begin CHARACTERISTIC KDID_WarnUpVehOperIdleThres_mph "" VALUE 0x0000 /* @ECU_Address@KDID_WarnUpVehOperIdleThres_mph@ */ Scalar_FLOAT32_IEEE 0 SWC_CARB_type_CM_single_mph 0.0 250.0 /end CHARACTERISTIC
/begin CHARACTERISTIC KDID_WarnUpVehOperIdleThres_s "" VALUE 0x0000 /* @ECU_Address@KDID_WarnUpVehOperIdleThres_s@ */ Scalar_FLOAT32_IEEE 0 SWC_CARB_type_CM_single_sec 0.0 250.0 /end CHARACTERISTIC
/begin CHARACTERISTIC KDID_WarnUpVehOperThres_mph "" VALUE 0x0000 /* @ECU_Address@KDID_WarnUpVehOperThres_mph@ */ Scalar_FLOAT32_IEEE 0 SWC_CARB_type_CM_single_mph 0.0 250.0 /end CHARACTERISTIC
/begin CHARACTERISTIC KDID_WarnUpVehOperThres_s "" VALUE 0x0000 /* @ECU_Address@KDID_WarnUpVehOperThres_s@ */ Scalar_FLOAT32_IEEE 0 SWC_CARB_type_CM_single_sec 0.0 1000.0 /end CHARACTERISTIC
/begin CHARACTERISTIC KDID_PSARResetThres_sec "" VALUE 0x0000 /* @ECU_Address@KDID_PSARResetThres_sec@ */ Scalar_ULONG 0 SWC_CARB_type_CM_uint32_sec 0.0 4.294967295E+9 /end CHARACTERISTIC
/begin CHARACTERISTIC KDID_WarnUpPropActiveThres_s "" VALUE 0x0000 /* @ECU_Address@KDID_WarnUpPropActiveThres_s@ */ Scalar_UWORD 0 SWC_CARB_type_CM_uint16_sec 0.0 65535.0 /end CHARACTERISTIC
/begin CHARACTERISTIC KDID_DIDModelVersion_raw "" VALUE 0x0000 /* @ECU_Address@KDID_DIDModelVersion_raw@ */ Scalar_UBYTE 0 SWC_CARB_type_CM_uint8_enum 0.0 255.0 /end CHARACTERISTIC
/begin CHARACTERISTIC KDID_FlashInitDIDModelVersion_raw "" VALUE 0x0000 /* @ECU_Address@KDID_FlashInitDIDModelVersion_raw@ */ Scalar_UBYTE 0 SWC_CARB_type_CM_uint8_enum 0.0 255.0 /end CHARACTERISTIC
/begin CHARACTERISTIC KDID_RESSCNTSDODRNGAXIS_enum "" VALUE 0x0000 /* @ECU_Address@KDID_RESSCNTSDODRNGAXIS_enum@ */ Scalar_UBYTE 0 SWC_CARB_type_CM_uint8_enum 0.0 1.0 /end CHARACTERISTIC
/begin CHARACTERISTIC KDID_RESSTIMESOCRNGAXIS_enum "" VALUE 0x0000 /* @ECU_Address@KDID_RESSTIMESOCRNGAXIS_enum@ */ Scalar_UBYTE 0 SWC_CARB_type_CM_uint8_enum 0.0 1.0 /end CHARACTERISTIC
/begin CHARACTERISTIC KDID_RESSTTEMPRNGAXIS_enum "" VALUE 0x0000 /* @ECU_Address@KDID_RESSTTEMPRNGAXIS_enum@ */ Scalar_UBYTE 0 SWC_CARB_type_CM_uint8_enum 0.0 1.0 /end CHARACTERISTIC
/begin MEASUREMENT VDID_PSAR_sec "" ULONG SWC_CARB_type_CM_uint32_sec 0 0 0.0 4.294967295E+9 ECU_ADDRESS 0x0000 /* @ECU_Address@VDID_PSAR_sec@ */ /end MEASUREMENT
/begin MEASUREMENT VDID_PSAL_sec "" ULONG SWC_CARB_type_CM_uint32_sec 0 0 0.0 4.294967295E+9 ECU_ADDRESS 0x0000 /* @ECU_Address@VDID_PSAL_sec@ */ /end MEASUREMENT
/begin MEASUREMENT VDID_IPSAR_sec "" ULONG SWC_CARB_type_CM_uint32_sec 0 0 0.0 4.294967295E+9 ECU_ADDRESS 0x0000 /* @ECU_Address@VDID_IPSAR_sec@ */ /end MEASUREMENT
/begin MEASUREMENT VDID_IPSAL_sec "" ULONG SWC_CARB_type_CM_uint32_sec 0 0 0.0 4.294967295E+9 ECU_ADDRESS 0x0000 /* @ECU_Address@VDID_IPSAL_sec@ */ /end MEASUREMENT
/begin MEASUREMENT VDID_CPSAR_sec "" ULONG SWC_CARB_type_CM_uint32_sec 0 0 0.0 4.294967295E+9 ECU_ADDRESS 0x0000 /* @ECU_Address@VDID_CPSAR_sec@ */ /end MEASUREMENT
/begin MEASUREMENT VDID_CPSAL_sec "" ULONG SWC_CARB_type_CM_uint32_sec 0 0 0.0 4.294967295E+9 ECU_ADDRESS 0x0000 /* @ECU_Address@VDID_CPSAL_sec@ */ /end MEASUREMENT
/begin MEASUREMENT VDID_BattTempPSAR_sec "" ULONG SWC_CARB_type_CM_uint32_sec 0 0 0.0 4.294967295E+9 ECU_ADDRESS 0x0000 /* @ECU_Address@VDID_BattTempPSAR_sec@ */ /end MEASUREMENT
/begin MEASUREMENT VDID_BattTempPSAL_sec "" ULONG SWC_CARB_type_CM_uint32_sec 0 0 0.0 4.294967295E+9 ECU_ADDRESS 0x0000 /* @ECU_Address@VDID_BattTempPSAL_sec@ */ /end MEASUREMENT
/begin MEASUREMENT VDID_OVCR_sec "" ULONG SWC_CARB_type_CM_uint32_sec 0 0 0.0 4.294967295E+9 ECU_ADDRESS 0x0000 /* @ECU_Address@VDID_OVCR_sec@ */ /end MEASUREMENT
/begin MEASUREMENT VDID_OVCL_sec "" ULONG SWC_CARB_type_CM_uint32_sec 0 0 0.0 4.294967295E+9 ECU_ADDRESS 0x0000 /* @ECU_Address@VDID_OVCL_sec@ */ /end MEASUREMENT
/begin MEASUREMENT VDID_OFFR_sec "" ULONG SWC_CARB_type_CM_uint32_sec 0 0 0.0 4.294967295E+9 ECU_ADDRESS 0x0000 /* @ECU_Address@VDID_OFFR_sec@ */ /end MEASUREMENT
/begin MEASUREMENT VDID_OFFL_sec "" ULONG SWC_CARB_type_CM_uint32_sec 0 0 0.0 4.294967295E+9 ECU_ADDRESS 0x0000 /* @ECU_Address@VDID_OFFL_sec@ */ /end MEASUREMENT
/begin MEASUREMENT VDID_AVGBATTEMPL_sec "" ULONG SWC_CARB_type_CM_uint32_sec 0 0 0.0 4.294967295E+9 ECU_ADDRESS 0x0000 /* @ECU_Address@VDID_AVGBATTEMPL_sec@ */ /end MEASUREMENT
/begin MEASUREMENT VDID_RESSTIMESOCPSARNGL_s "" ULONG SWC_CARB_type_CM_uint32 0 0 0 4294967295 ARRAY_SIZE 8 ECU_ADDRESS 0x0000 /* @ECU_Address@VDID_RESSTIMESOCPSARNGL_s@ */ /end MEASUREMENT
/begin MEASUREMENT VDID_RESSTIMESOCPSARNGR_s "" ULONG SWC_CARB_type_CM_uint32 0 0 0 4294967295 ARRAY_SIZE 8 ECU_ADDRESS 0x0000 /* @ECU_Address@VDID_RESSTIMESOCPSARNGR_s@ */ /end MEASUREMENT
/begin MEASUREMENT VDID_RESSTIMESOCCHGRNGL_s "" ULONG SWC_CARB_type_CM_uint32 0 0 0 4294967295 ARRAY_SIZE 8 ECU_ADDRESS 0x0000 /* @ECU_Address@VDID_RESSTIMESOCCHGRNGL_s@ */ /end MEASUREMENT
/begin MEASUREMENT VDID_RESSTIMESOCCHGRNGR_s "" ULONG SWC_CARB_type_CM_uint32 0 0 0 4294967295 ARRAY_SIZE 8 ECU_ADDRESS 0x0000 /* @ECU_Address@VDID_RESSTIMESOCCHGRNGR_s@ */ /end MEASUREMENT
/begin MEASUREMENT VDID_RESSTIMESOCOFFRNGL_s "" ULONG SWC_CARB_type_CM_uint32 0 0 0 4294967295 ARRAY_SIZE 8 ECU_ADDRESS 0x0000 /* @ECU_Address@VDID_RESSTIMESOCOFFRNGL_s@ */ /end MEASUREMENT
/begin MEASUREMENT VDID_RESSTIMESOCOFFRNGR_s "" ULONG SWC_CARB_type_CM_uint32 0 0 0 4294967295 ARRAY_SIZE 8 ECU_ADDRESS 0x0000 /* @ECU_Address@VDID_RESSTIMESOCOFFRNGR_s@ */ /end MEASUREMENT
/begin MEASUREMENT VDID_QTYPSATRIPSR_cnt "" ULONG SWC_CARB_type_CM_uint32_cnt 0 0 0.0 4.294967295E+9 ECU_ADDRESS 0x0000 /* @ECU_Address@VDID_QTYPSATRIPSR_cnt@ */ /end MEASUREMENT
/begin MEASUREMENT VDID_QTYPSATRIPSL_cnt "" ULONG SWC_CARB_type_CM_uint32_cnt 0 0 0.0 4.294967295E+9 ECU_ADDRESS 0x0000 /* @ECU_Address@VDID_QTYPSATRIPSL_cnt@ */ /end MEASUREMENT
/begin MEASUREMENT VDID_TNECPSAR_kWh "" FLOAT32_IEEE SWC_CARB_type_CM_single_kWh 0 0 0.0 4.294967295E+8 ECU_ADDRESS 0x0000 /* @ECU_Address@VDID_TNECPSAR_kWh@ */ /end MEASUREMENT
/begin MEASUREMENT VDID_TNBCPSAR_Ahr "" FLOAT32_IEEE SWC_CARB_type_CM_single_Ahr 0 0 0.0 4.294967295E+6 ECU_ADDRESS 0x0000 /* @ECU_Address@VDID_TNBCPSAR_Ahr@ */ /end MEASUREMENT
/begin MEASUREMENT VDID_TNBCPSAL_Ahr "" FLOAT32_IEEE SWC_CARB_type_CM_single_Ahr 0 0 0.0 4.294967295E+8 ECU_ADDRESS 0x0000 /* @ECU_Address@VDID_TNBCPSAL_Ahr@ */ /end MEASUREMENT
/begin MEASUREMENT VDID_TNECPSAL_kWh "" FLOAT32_IEEE SWC_CARB_type_CM_single_kWh 0 0 0.0 4.294967295E+8 ECU_ADDRESS 0x0000 /* @ECU_Address@VDID_TNECPSAL_kWh@ */ /end MEASUREMENT
/begin MEASUREMENT VDID_TGEOVCR_kWh "" FLOAT32_IEEE SWC_CARB_type_CM_single_kWh 0 0 0.0 4.294967295E+8 ECU_ADDRESS 0x0000 /* @ECU_Address@VDID_TGEOVCR_kWh@ */ /end MEASUREMENT
/begin MEASUREMENT VDID_TEBPSAR_kWh "" FLOAT32_IEEE SWC_CARB_type_CM_single_kWh 0 0 0.0 4.294967295E+8 ECU_ADDRESS 0x0000 /* @ECU_Address@VDID_TEBPSAR_kWh@ */ /end MEASUREMENT
/begin MEASUREMENT VDID_TEBPSAL_kWh "" FLOAT32_IEEE SWC_CARB_type_CM_single_kWh 0 0 0.0 4.294967295E+8 ECU_ADDRESS 0x0000 /* @ECU_Address@VDID_TEBPSAL_kWh@ */ /end MEASUREMENT
/begin MEASUREMENT VDID_TGEOVCL_kWh "" FLOAT32_IEEE SWC_CARB_type_CM_single_kWh 0 0 0.0 4.294967295E+8 ECU_ADDRESS 0x0000 /* @ECU_Address@VDID_TGEOVCL_kWh@ */ /end MEASUREMENT
/begin MEASUREMENT VDID_GECHGOVCDCR_kWh "" FLOAT32_IEEE SWC_CARB_type_CM_single_kWh 0 0 0.0 4.294967295E+8 ECU_ADDRESS 0x0000 /* @ECU_Address@VDID_GECHGOVCDCR_kWh@ */ /end MEASUREMENT
/begin MEASUREMENT VDID_GECHGOVCACL_kWh "" FLOAT32_IEEE SWC_CARB_type_CM_single_kWh 0 0 0.0 4.294967295E+8 ECU_ADDRESS 0x0000 /* @ECU_Address@VDID_GECHGOVCACL_kWh@ */ /end MEASUREMENT
/begin MEASUREMENT VDID_RESSV2XENNONPSAR_kWh "" FLOAT32_IEEE SWC_CARB_type_CM_single_kWh 0 0 0.0 4.294967295E+8 ECU_ADDRESS 0x0000 /* @ECU_Address@VDID_RESSV2XENNONPSAR_kWh@ */ /end MEASUREMENT
/begin MEASUREMENT VDID_RESSV2XENNONPSAL_kWh "" FLOAT32_IEEE SWC_CARB_type_CM_single_kWh 0 0 0.0 4.294967295E+8 ECU_ADDRESS 0x0000 /* @ECU_Address@VDID_RESSV2XENNONPSAL_kWh@ */ /end MEASUREMENT
/begin MEASUREMENT VDID_GECHGOVCACR_kWh "" FLOAT32_IEEE SWC_CARB_type_CM_single_kWh 0 0 0.0 4.294967295E+8 ECU_ADDRESS 0x0000 /* @ECU_Address@VDID_GECHGOVCACR_kWh@ */ /end MEASUREMENT
/begin MEASUREMENT VDID_GECHGOVCDCL_kWh "" FLOAT32_IEEE SWC_CARB_type_CM_single_kWh 0 0 0.0 4.294967295E+8 ECU_ADDRESS 0x0000 /* @ECU_Address@VDID_GECHGOVCDCL_kWh@ */ /end MEASUREMENT
/begin MEASUREMENT VDID_AvgBattTempPSAR_C "" FLOAT32_IEEE SWC_CARB_type_CM_single_C 0 0 -40.0 215.0 ECU_ADDRESS 0x0000 /* @ECU_Address@VDID_AvgBattTempPSAR_C@ */ /end MEASUREMENT
/begin MEASUREMENT VDID_AvgBattTempPSAL_C "" FLOAT32_IEEE SWC_CARB_type_CM_single_C 0 0 -40.0 215.0 ECU_ADDRESS 0x0000 /* @ECU_Address@VDID_AvgBattTempPSAL_C@ */ /end MEASUREMENT
/begin MEASUREMENT VDID_AvgBattTempOVCR_C "" FLOAT32_IEEE SWC_CARB_type_CM_single_C 0 0 -40.0 215.0 ECU_ADDRESS 0x0000 /* @ECU_Address@VDID_AvgBattTempOVCR_C@ */ /end MEASUREMENT
/begin MEASUREMENT VDID_AvgBattTempOVCL_C "" FLOAT32_IEEE SWC_CARB_type_CM_single_C 0 0 -40.0 215.0 ECU_ADDRESS 0x0000 /* @ECU_Address@VDID_AvgBattTempOVCL_C@ */ /end MEASUREMENT
/begin MEASUREMENT VDID_AvgBattTempOFFR_C "" FLOAT32_IEEE SWC_CARB_type_CM_single_C 0 0 -40.0 215.0 ECU_ADDRESS 0x0000 /* @ECU_Address@VDID_AvgBattTempOFFR_C@ */ /end MEASUREMENT
/begin MEASUREMENT VDID_AvgBattTempOFFL_C "" FLOAT32_IEEE SWC_CARB_type_CM_single_C 0 0 -40.0 215.0 ECU_ADDRESS 0x0000 /* @ECU_Address@VDID_AvgBattTempOFFL_C@ */ /end MEASUREMENT
/begin MEASUREMENT VDID_AVGBATTEMPL_C "" FLOAT32_IEEE SWC_CARB_type_CM_single_C 0 0 -40.0 215.0 ECU_ADDRESS 0x0000 /* @ECU_Address@VDID_AVGBATTEMPL_C@ */ /end MEASUREMENT
/begin MEASUREMENT VDID_MINBATTEMPL_C "" FLOAT32_IEEE SWC_CARB_type_CM_single_C 0 0 -40.0 215.0 ECU_ADDRESS 0x0000 /* @ECU_Address@VDID_MINBATTEMPL_C@ */ /end MEASUREMENT
/begin MEASUREMENT VDID_MAXBATTEMPL_C "" FLOAT32_IEEE SWC_CARB_type_CM_single_C 0 0 -40.0 215.0 ECU_ADDRESS 0x0000 /* @ECU_Address@VDID_MAXBATTEMPL_C@ */ /end MEASUREMENT
/begin MEASUREMENT VDID_ETMBTOER_kWh "" FLOAT32_IEEE SWC_CARB_type_CM_single_kWh 0 0 0.0 4.294967295E+9 ECU_ADDRESS 0x0000 /* @ECU_Address@VDID_ETMBTOER_kWh@ */ /end MEASUREMENT
/begin MEASUREMENT VDID_ETMATOER_kWh "" FLOAT32_IEEE SWC_CARB_type_CM_single_kWh 0 0 0.0 4.294967295E+9 ECU_ADDRESS 0x0000 /* @ECU_Address@VDID_ETMATOER_kWh@ */ /end MEASUREMENT
/begin MEASUREMENT VDID_ETMATOEL_kWh "" FLOAT32_IEEE SWC_CARB_type_CM_single_kWh 0 0 0.0 4.294967295E+9 ECU_ADDRESS 0x0000 /* @ECU_Address@VDID_ETMATOEL_kWh@ */ /end MEASUREMENT
/begin MEASUREMENT VDID_ETMBTOEL_kWh "" FLOAT32_IEEE SWC_CARB_type_CM_single_kWh 0 0 0.0 4.294967295E+9 ECU_ADDRESS 0x0000 /* @ECU_Address@VDID_ETMBTOEL_kWh@ */ /end MEASUREMENT
/begin MEASUREMENT VDID_ODOMETER_km "" FLOAT32_IEEE SWC_CARB_type_CM_single_km 0 0 0.0 4.294967295E+8 ECU_ADDRESS 0x0000 /* @ECU_Address@VDID_ODOMETER_km@ */ /end MEASUREMENT
/begin MEASUREMENT VDID_VSS_kph "" FLOAT32_IEEE SWC_CARB_type_CM_single_kph 0 0 0.0 255.0 ECU_ADDRESS 0x0000 /* @ECU_Address@VDID_VSS_kph@ */ /end MEASUREMENT
/begin MEASUREMENT VDID_HVESSCHARGEACT_kW "" FLOAT32_IEEE SWC_CARB_type_CM_single_kW 0 0 0.0 3272.75 ECU_ADDRESS 0x0000 /* @ECU_Address@VDID_HVESSCHARGEACT_kW@ */ /end MEASUREMENT
/begin MEASUREMENT VDID_CDEODTL_km "" FLOAT32_IEEE SWC_CARB_type_CM_single_km 0 0 -40.0 215.0 ECU_ADDRESS 0x0000 /* @ECU_Address@VDID_CDEODTL_km@ */ /end MEASUREMENT
/begin MEASUREMENT VDID_HVBATT_A "" FLOAT32_IEEE SWC_CARB_type_CM_single_A 0 0 -3276.8 3276.7 ECU_ADDRESS 0x0000 /* @ECU_Address@VDID_HVBATT_A@ */ /end MEASUREMENT
/begin MEASUREMENT VDID_BATSOC_pct "" FLOAT32_IEEE SWC_CARB_type_CM_single_pct 0 0 0.0 100.0 ECU_ADDRESS 0x0000 /* @ECU_Address@VDID_BATSOC_pct@ */ /end MEASUREMENT
/begin MEASUREMENT VDID_HEVBATT_V "" FLOAT32_IEEE SWC_CARB_type_CM_single_V 0 0 0.0 1023.98 ECU_ADDRESS 0x0000 /* @ECU_Address@VDID_HEVBATT_V@ */ /end MEASUREMENT
/begin MEASUREMENT VDID_PKERNumerator_kphsqr "" FLOAT32_IEEE SWC_CARB_type_CM_single_kphsqr 0 0 0.0 3.4028E+38 ECU_ADDRESS 0x0000 /* @ECU_Address@VDID_PKERNumerator_kphsqr@ */ /end MEASUREMENT
/begin MEASUREMENT VDID_ResetCDEODTR_km "" FLOAT32_IEEE SWC_CARB_type_CM_single_km 0 0 0.0 4.294967295E+8 ECU_ADDRESS 0x0000 /* @ECU_Address@VDID_ResetCDEODTR_km@ */ /end MEASUREMENT
/begin MEASUREMENT VDID_CDEODTR_km "" FLOAT32_IEEE SWC_CARB_type_CM_single_km 0 0 0.0 4.294967295E+8 ECU_ADDRESS 0x0000 /* @ECU_Address@VDID_CDEODTR_km@ */ /end MEASUREMENT
/begin MEASUREMENT VDID_PKELNumerator_kphsqr "" FLOAT32_IEEE SWC_CARB_type_CM_single_kphsqr 0 0 0.0 3.4028E+38 ECU_ADDRESS 0x0000 /* @ECU_Address@VDID_PKELNumerator_kphsqr@ */ /end MEASUREMENT
/begin MEASUREMENT VDID_HVBNE_kWh "" FLOAT32_IEEE SWC_CARB_type_CM_single_kWh 0 0 -2.147483648E+6 2.147483647E+6 ECU_ADDRESS 0x0000 /* @ECU_Address@VDID_HVBNE_kWh@ */ /end MEASUREMENT
/begin MEASUREMENT VDID_HVBattCurr_Ahps "" FLOAT32_IEEE SWC_CARB_type_CM_single_Ahps 0 0 -2147.4836 2147.4836 ECU_ADDRESS 0x0000 /* @ECU_Address@VDID_HVBattCurr_Ahps@ */ /end MEASUREMENT
/begin MEASUREMENT VDID_HVBNAH_Ahr "" FLOAT32_IEEE SWC_CARB_type_CM_single_Ahr 0 0 -2.147483648E+6 2.147483647E+6 ECU_ADDRESS 0x0000 /* @ECU_Address@VDID_HVBNAH_Ahr@ */ /end MEASUREMENT
/begin MEASUREMENT VDID_MILDIST_km "" FLOAT32_IEEE SWC_CARB_type_CM_single_km 0 0 0.0 65535.0 ECU_ADDRESS 0x0000 /* @ECU_Address@VDID_MILDIST_km@ */ /end MEASUREMENT
/begin MEASUREMENT VDID_CLRDIST_km "" FLOAT32_IEEE SWC_CARB_type_CM_single_km 0 0 0.0 65535.0 ECU_ADDRESS 0x0000 /* @ECU_Address@VDID_CLRDIST_km@ */ /end MEASUREMENT
/begin MEASUREMENT VDID_HVESSENER_Whps "" FLOAT32_IEEE SWC_CARB_type_CM_single_Whps 0 0 -2147.4836 2147.4836 ECU_ADDRESS 0x0000 /* @ECU_Address@VDID_HVESSENER_Whps@ */ /end MEASUREMENT
/begin MEASUREMENT VDID_PKER_kphsqr "" FLOAT32_IEEE SWC_CARB_type_CM_single_kphsqr 0 0 0.0 4.294967295E+9 ECU_ADDRESS 0x0000 /* @ECU_Address@VDID_PKER_kphsqr@ */ /end MEASUREMENT
/begin MEASUREMENT VDID_PKEL_kphsqr "" FLOAT32_IEEE SWC_CARB_type_CM_single_kphsqr 0 0 0.0 4.294967295E+9 ECU_ADDRESS 0x0000 /* @ECU_Address@VDID_PKEL_kphsqr@ */ /end MEASUREMENT
/begin MEASUREMENT VDID_HVESSCHARGELIM_kW "" FLOAT32_IEEE SWC_CARB_type_CM_single_kW 0 0 0.0 3272.75 ECU_ADDRESS 0x0000 /* @ECU_Address@VDID_HVESSCHARGELIM_kW@ */ /end MEASUREMENT
/begin MEASUREMENT VDID_APPD_pct "" FLOAT32_IEEE SWC_CARB_type_CM_single_pct 0 0 0.0 100.0 ECU_ADDRESS 0x0000 /* @ECU_Address@VDID_APPD_pct@ */ /end MEASUREMENT
/begin MEASUREMENT VDID_APPE_pct "" FLOAT32_IEEE SWC_CARB_type_CM_single_pct 0 0 0.0 100.0 ECU_ADDRESS 0x0000 /* @ECU_Address@VDID_APPE_pct@ */ /end MEASUREMENT
/begin MEASUREMENT VDID_BATSOH_pct "" FLOAT32_IEEE SWC_CARB_type_CM_single_pct 0 0 0.0 100.0 ECU_ADDRESS 0x0000 /* @ECU_Address@VDID_BATSOH_pct@ */ /end MEASUREMENT
/begin MEASUREMENT VDID_HVBCellVoltMin_V "" FLOAT32_IEEE SWC_CARB_type_CM_single_V 0 0 0.0 65.535 ECU_ADDRESS 0x0000 /* @ECU_Address@VDID_HVBCellVoltMin_V@ */ /end MEASUREMENT
/begin MEASUREMENT VDID_HVBCellVoltMax_V "" FLOAT32_IEEE SWC_CARB_type_CM_single_V 0 0 0.0 65.535 ECU_ADDRESS 0x0000 /* @ECU_Address@VDID_HVBCellVoltMax_V@ */ /end MEASUREMENT
/begin MEASUREMENT VDID_RESSCNTDODRNGL_cnt "" UWORD SWC_CARB_type_CM_uint16 0 0 0 65535 ARRAY_SIZE 8 ECU_ADDRESS 0x0000 /* @ECU_Address@VDID_RESSCNTDODRNGL_cnt@ */ /end MEASUREMENT
/begin MEASUREMENT VDID_RESSCNTDODRNGR_cnt "" UWORD SWC_CARB_type_CM_uint16 0 0 0 65535 ARRAY_SIZE 8 ECU_ADDRESS 0x0000 /* @ECU_Address@VDID_RESSCNTDODRNGR_cnt@ */ /end MEASUREMENT
/begin MEASUREMENT VDID_RUNTM_s "" UWORD SWC_CARB_type_CM_uint16_s 0 0 0.0 65535.0 ECU_ADDRESS 0x0000 /* @ECU_Address@VDID_RUNTM_s@ */ /end MEASUREMENT
/begin MEASUREMENT VDID_CLRTIME_min "" UWORD SWC_CARB_type_CM_uint16_min 0 0 0.0 65535.0 ECU_ADDRESS 0x0000 /* @ECU_Address@VDID_CLRTIME_min@ */ /end MEASUREMENT
/begin MEASUREMENT VDID_IGNCNTR_cnt "" UWORD SWC_CARB_type_CM_uint16_cnt 0 0 0.0 65535.0 ECU_ADDRESS 0x0000 /* @ECU_Address@VDID_IGNCNTR_cnt@ */ /end MEASUREMENT
/begin MEASUREMENT VDID_MILTIME_min "" UWORD SWC_CARB_type_CM_uint16_min 0 0 0.0 65535.0 ECU_ADDRESS 0x0000 /* @ECU_Address@VDID_MILTIME_min@ */ /end MEASUREMENT
/begin MEASUREMENT VDID_NUMPSATRIPSFLTMEMCLR_cnt "" UWORD SWC_CARB_type_CM_uint16_cnt 0 0 0.0 65535.0 ECU_ADDRESS 0x0000 /* @ECU_Address@VDID_NUMPSATRIPSFLTMEMCLR_cnt@ */ /end MEASUREMENT
/begin MEASUREMENT VDID_RESSTIMESOCRNGAXIS_enum "" UBYTE SWC_CARB_type_CM_uint8_enum 0 0 0.0 255.0 ECU_ADDRESS 0x0000 /* @ECU_Address@VDID_RESSTIMESOCRNGAXIS_enum@ */ /end MEASUREMENT
/begin MEASUREMENT VDID_RESSCNTSDODRNGAXIS_enum "" UBYTE SWC_CARB_type_CM_uint8_enum 0 0 0.0 255.0 ECU_ADDRESS 0x0000 /* @ECU_Address@VDID_RESSCNTSDODRNGAXIS_enum@ */ /end MEASUREMENT
/begin MEASUREMENT VDID_RESSTTEMPRNGAXIS_enum "" UBYTE SWC_CARB_type_CM_uint8_enum 0 0 0.0 255.0 ECU_ADDRESS 0x0000 /* @ECU_Address@VDID_RESSTTEMPRNGAXIS_enum@ */ /end MEASUREMENT
/begin MEASUREMENT VDID_WARMUPS_cnt "" UBYTE SWC_CARB_type_CM_uint8_cnt 0 0 0.0 255.0 ECU_ADDRESS 0x0000 /* @ECU_Address@VDID_WARMUPS_cnt@ */ /end MEASUREMENT
/begin MEASUREMENT VDID_PROTOCOLID_enum "" UBYTE SWC_CARB_type_CM_uint8_enum 0 0 0.0 2.0 ECU_ADDRESS 0x0000 /* @ECU_Address@VDID_PROTOCOLID_enum@ */ /end MEASUREMENT
/begin MEASUREMENT VDID_CALID_cnt "" UBYTE SWC_CARB_type_CM_uint8 0 0 0 255 ARRAY_SIZE 16 ECU_ADDRESS 0x0000 /* @ECU_Address@VDID_CALID_cnt@ */ /end MEASUREMENT
/begin MEASUREMENT VDID_ECUNAME_cnt "" UBYTE SWC_CARB_type_CM_uint8 0 0 0 255 ARRAY_SIZE 20 ECU_ADDRESS 0x0000 /* @ECU_Address@VDID_ECUNAME_cnt@ */ /end MEASUREMENT
/begin MEASUREMENT VDID_VinCode_cnt "" UBYTE SWC_CARB_type_CM_uint8 0 0 0 255 ARRAY_SIZE 17 ECU_ADDRESS 0x0000 /* @ECU_Address@VDID_VinCode_cnt@ */ /end MEASUREMENT
/begin MEASUREMENT VDID_STASUP_enum "" UBYTE SWC_CARB_type_CM_uint8_enum 0 0 0.0 255.0 ECU_ADDRESS 0x0000 /* @ECU_Address@VDID_STASUP_enum@ */ /end MEASUREMENT
/begin MEASUREMENT VDID_HEVMODE_enum "" UBYTE SWC_CARB_type_CM_uint8_enum 0 0 0.0 255.0 ECU_ADDRESS 0x0000 /* @ECU_Address@VDID_HEVMODE_enum@ */ /end MEASUREMENT
/begin MEASUREMENT VDID_DIDModelVersion_raw "" UBYTE SWC_CARB_type_CM_uint8_raw 0 0 0.0 255.0 ECU_ADDRESS 0x0000 /* @ECU_Address@VDID_DIDModelVersion_raw@ */ /end MEASUREMENT
/begin MEASUREMENT VDID_DIDModelVersionChksum_raw "" UBYTE SWC_CARB_type_CM_uint8_raw 0 0 0.0 255.0 ECU_ADDRESS 0x0000 /* @ECU_Address@VDID_DIDModelVersionChksum_raw@ */ /end MEASUREMENT
/begin COMPU_METHOD SWC_CARB_type_CM_single_pct "Q = V" RAT_FUNC "%8.6" "pct" COEFFS 0 1 0 0 0 1 /end COMPU_METHOD
/begin COMPU_METHOD SWC_CARB_type_CM_single_sec "Q = V" RAT_FUNC "%8.6" "sec" COEFFS 0 1 0 0 0 1 /end COMPU_METHOD
/begin COMPU_METHOD SWC_CARB_type_CM_single_Wh "Q = V" RAT_FUNC "%8.6" "Wh" COEFFS 0 1 0 0 0 1 /end COMPU_METHOD
/begin COMPU_METHOD SWC_CARB_type_CM_single_mph "Q = V" RAT_FUNC "%8.6" "mph" COEFFS 0 1 0 0 0 1 /end COMPU_METHOD
/begin COMPU_METHOD SWC_CARB_type_CM_uint32_sec "Q = V" RAT_FUNC "%10.0" "sec" COEFFS 0 1 0 0 0 1 /end COMPU_METHOD
/begin COMPU_METHOD SWC_CARB_type_CM_uint16_sec "Q = V" RAT_FUNC "%5.0" "sec" COEFFS 0 1 0 0 0 1 /end COMPU_METHOD
/begin COMPU_METHOD SWC_CARB_type_CM_uint8_enum "Q = V" RAT_FUNC "%3.0" "enum" COEFFS 0 1 0 0 0 1 /end COMPU_METHOD
/begin COMPU_METHOD SWC_CARB_type_CM_uint32 "Q = V" RAT_FUNC "%10.0" "" COEFFS 0 1 0 0 0 1 /end COMPU_METHOD
/begin COMPU_METHOD SWC_CARB_type_CM_uint32_cnt "Q = V" RAT_FUNC "%10.0" "cnt" COEFFS 0 1 0 0 0 1 /end COMPU_METHOD
/begin COMPU_METHOD SWC_CARB_type_CM_single_kWh "Q = V" RAT_FUNC "%8.6" "kWh" COEFFS 0 1 0 0 0 1 /end COMPU_METHOD
/begin COMPU_METHOD SWC_CARB_type_CM_single_Ahr "Q = V" RAT_FUNC "%8.6" "Ahr" COEFFS 0 1 0 0 0 1 /end COMPU_METHOD
/begin COMPU_METHOD SWC_CARB_type_CM_single_C "Q = V" RAT_FUNC "%8.6" "C" COEFFS 0 1 0 0 0 1 /end COMPU_METHOD
/begin COMPU_METHOD SWC_CARB_type_CM_single_km "Q = V" RAT_FUNC "%8.6" "km" COEFFS 0 1 0 0 0 1 /end COMPU_METHOD
/begin COMPU_METHOD SWC_CARB_type_CM_single_kph "Q = V" RAT_FUNC "%8.6" "kph" COEFFS 0 1 0 0 0 1 /end COMPU_METHOD
/begin COMPU_METHOD SWC_CARB_type_CM_single_kW "Q = V" RAT_FUNC "%8.6" "kW" COEFFS 0 1 0 0 0 1 /end COMPU_METHOD
/begin COMPU_METHOD SWC_CARB_type_CM_single_A "Q = V" RAT_FUNC "%8.6" "A" COEFFS 0 1 0 0 0 1 /end COMPU_METHOD
/begin COMPU_METHOD SWC_CARB_type_CM_single_V "Q = V" RAT_FUNC "%8.6" "V" COEFFS 0 1 0 0 0 1 /end COMPU_METHOD
/begin COMPU_METHOD SWC_CARB_type_CM_single_kphsqr "Q = V" RAT_FUNC "%8.6" "kphsqr" COEFFS 0 1 0 0 0 1 /end COMPU_METHOD
/begin COMPU_METHOD SWC_CARB_type_CM_single_Ahps "Q = V" RAT_FUNC "%8.6" "Ahps" COEFFS 0 1 0 0 0 1 /end COMPU_METHOD
/begin COMPU_METHOD SWC_CARB_type_CM_single_Whps "Q = V" RAT_FUNC "%8.6" "Whps" COEFFS 0 1 0 0 0 1 /end COMPU_METHOD
/begin COMPU_METHOD SWC_CARB_type_CM_uint16 "Q = V" RAT_FUNC "%5.0" "" COEFFS 0 1 0 0 0 1 /end COMPU_METHOD
/begin COMPU_METHOD SWC_CARB_type_CM_uint16_s "Q = V" RAT_FUNC "%5.0" "s" COEFFS 0 1 0 0 0 1 /end COMPU_METHOD
/begin COMPU_METHOD SWC_CARB_type_CM_uint16_min "Q = V" RAT_FUNC "%5.0" "min" COEFFS 0 1 0 0 0 1 /end COMPU_METHOD
/begin COMPU_METHOD SWC_CARB_type_CM_uint16_cnt "Q = V" RAT_FUNC "%5.0" "cnt" COEFFS 0 1 0 0 0 1 /end COMPU_METHOD
/begin COMPU_METHOD SWC_CARB_type_CM_uint8_cnt "Q = V" RAT_FUNC "%3.0" "cnt" COEFFS 0 1 0 0 0 1 /end COMPU_METHOD
/begin COMPU_METHOD SWC_CARB_type_CM_uint8 "Q = V" RAT_FUNC "%3.0" "" COEFFS 0 1 0 0 0 1 /end COMPU_METHOD
/begin COMPU_METHOD SWC_CARB_type_CM_uint8_raw "Q = V" RAT_FUNC "%3.0" "raw" COEFFS 0 1 0 0 0 1 /end COMPU_METHOD
/begin GROUP SWC_CARB_type "SWC_CARB_type" /* Root */ ROOT /begin SUB_GROUP Root_run_SWC_CARB_5ms_sys /end SUB_GROUP /end GROUP
/begin GROUP Root_run_SWC_CARB_5ms_sys "SWC_CARB_type/run_SWC_CARB_5ms_sys" /begin SUB_GROUP S2_DID /end SUB_GROUP /end GROUP
/begin GROUP S2_DID "SWC_CARB_type/run_SWC_CARB_5ms_sys/DID" /begin SUB_GROUP S3_Subsystem /end SUB_GROUP /end GROUP
/begin GROUP S3_Subsystem "SWC_CARB_type/run_SWC_CARB_5ms_sys/DID/Subsystem"
 /begin SUB_GROUP S5_0xF819__Total_Propulsion_System_Active_Time S5_0xF885___0xF88B S5_0xF88E___0xF890 S5_0xF898_0xF8 S5_Initializable_U32counter S5_Initializable_U32counter1 S5_Riemann_Integral1 S5_Subsystem /end SUB_GROUP
 /begin REF_CHARACTERISTIC KDID_FlashInitDIDModelVersion_raw KDID_PropActiveTripThres_s KDID_WarnUpPropActiveThres_s KDID_WarnUpVehOperIdleThres_mph KDID_WarnUpVehOperIdleThres_s KDID_WarnUpVehOperThres_mph KDID_WarnUpVehOperThres_s /end REF_CHARACTERISTIC
 /begin REF_MEASUREMENT VDID_APPD_pct VDID_APPE_pct VDID_BATSOC_pct VDID_BATSOH_pct VDID_CALID_cnt VDID_CDEODTL_km VDID_CDEODTR_km VDID_CLRDIST_km VDID_CLRTIME_min VDID_ECUNAME_cnt VDID_HEVBATT_V VDID_HEVMODE_enum VDID_HVBATT_A VDID_HVBCellVoltMax_V VDID_HVBCellVoltMin_V VDID_HVBNAH_Ahr VDID_HVBNE_kWh VDID_HVBattCurr_Ahps VDID_HVESSCHARGEACT_kW VDID_HVESSCHARGELIM_kW VDID_IGNCNTR_cnt VDID_MILDIST_km VDID_MILTIME_min VDID_NUMPSATRIPSFLTMEMCLR_cnt VDID_ODOMETER_km VDID_PKELNumerator_kphsqr VDID_PKEL_kphsqr VDID_PKERNumerator_kphsqr VDID_PKER_kphsqr VDID_PROTOCOLID_enum VDID_RUNTM_s VDID_ResetCDEODTR_km VDID_STASUP_enum VDID_VSS_kph VDID_VinCode_cnt VDID_WARMUPS_cnt /end REF_MEASUREMENT
/end GROUP
/begin GROUP S5_0xF819__Total_Propulsion_System_Active_Time "SWC_CARB_type/run_SWC_CARB_5ms_sys/DID/Subsystem/0xF819: Total Propulsion System Active Time"
 /begin SUB_GROUP S6_Seconds_Counter S6_Seconds_Counter1 S6_Seconds_Counter2 S6_Seconds_Counter3 S6_Seconds_Counter4 S6_Seconds_Counter5 /end SUB_GROUP
 /begin REF_CHARACTERISTIC KDID_CPSAVehSpdThres_kph KDID_IPSAVehSpdThres_kph KDID_PSARResetThres_sec /end REF_CHARACTERISTIC
/end GROUP
/begin GROUP S5_0xF885___0xF88B "SWC_CARB_type/run_SWC_CARB_5ms_sys/DID/Subsystem/0xF885 - 0xF88B"
 /begin REF_MEASUREMENT VDID_GECHGOVCACL_kWh VDID_GECHGOVCACR_kWh VDID_GECHGOVCDCL_kWh VDID_GECHGOVCDCR_kWh VDID_RESSV2XENNONPSAL_kWh VDID_RESSV2XENNONPSAR_kWh VDID_TEBPSAL_kWh VDID_TEBPSAR_kWh VDID_TGEOVCL_kWh VDID_TGEOVCR_kWh VDID_TNBCPSAL_Ahr VDID_TNBCPSAR_Ahr VDID_TNECPSAL_kWh VDID_TNECPSAR_kWh /end REF_MEASUREMENT
/end GROUP
/begin GROUP S5_0xF88E___0xF890 "SWC_CARB_type/run_SWC_CARB_5ms_sys/DID/Subsystem/0xF88E - 0xF890"
 /begin SUB_GROUP S8_Seconds_Counter10 S8_Seconds_Counter11 S8_Seconds_Counter6 S8_Seconds_Counter7 S8_Seconds_Counter8 S8_Seconds_Counter9 /end SUB_GROUP
 /begin REF_MEASUREMENT VDID_AvgBattTempOFFL_C VDID_AvgBattTempOFFR_C VDID_AvgBattTempOVCL_C VDID_AvgBattTempOVCR_C VDID_AvgBattTempPSAL_C VDID_AvgBattTempPSAR_C /end REF_MEASUREMENT
/end GROUP
/begin GROUP S5_0xF898_0xF8 "SWC_CARB_type/run_SWC_CARB_5ms_sys/DID/Subsystem/0xF898-0xF8"
 /begin SUB_GROUP S9_Initial_Value11 S9_Initial_Value4 S9_RangeCnt S9_RangeTimer S9_RangeTimer1 S9_RangeTimer2 S9_Seconds_Counter11 /end SUB_GROUP
 /begin REF_CHARACTERISTIC ADID_DODRange_pct ADID_SOCRange_pct ADID_TempRange_C KDID_DoDChrgCycle_s KDID_FiveKmEquivEnergy_Wh KDID_RESSCNTSDODRNGAXIS_enum KDID_RESSTIMESOCRNGAXIS_enum KDID_RESSTTEMPRNGAXIS_enum /end REF_CHARACTERISTIC
 /begin REF_MEASUREMENT VDID_AVGBATTEMPL_C VDID_ETMATOEL_kWh VDID_ETMATOER_kWh VDID_ETMBTOEL_kWh VDID_ETMBTOER_kWh VDID_RESSCNTSDODRNGAXIS_enum VDID_RESSTIMESOCRNGAXIS_enum VDID_RESSTTEMPRNGAXIS_enum /end REF_MEASUREMENT
/end GROUP
/begin GROUP S5_Initializable_U32counter "SWC_CARB_type/run_SWC_CARB_5ms_sys/DID/Subsystem/Initializable_U32counter" /begin REF_MEASUREMENT VDID_QTYPSATRIPSR_cnt /end REF_MEASUREMENT /end GROUP
/begin GROUP S5_Initializable_U32counter1 "SWC_CARB_type/run_SWC_CARB_5ms_sys/DID/Subsystem/Initializable_U32counter1" /begin REF_MEASUREMENT VDID_QTYPSATRIPSL_cnt /end REF_MEASUREMENT /end GROUP
/begin GROUP S5_Riemann_Integral1 "SWC_CARB_type/run_SWC_CARB_5ms_sys/DID/Subsystem/Riemann Integral1" /begin REF_MEASUREMENT VDID_HVESSENER_Whps /end REF_MEASUREMENT /end GROUP
/begin GROUP S5_Subsystem "SWC_CARB_type/run_SWC_CARB_5ms_sys/DID/Subsystem/Subsystem" /begin SUB_GROUP S41_Checksum /end SUB_GROUP /begin REF_CHARACTERISTIC KDID_DIDModelVersion_raw /end REF_CHARACTERISTIC /begin REF_MEASUREMENT VDID_DIDModelVersion_raw /end REF_MEASUREMENT /end GROUP
/begin GROUP S6_Seconds_Counter "SWC_CARB_type/run_SWC_CARB_5ms_sys/DID/Subsystem/0xF819: Total Propulsion System Active Time/Seconds_Counter" /begin REF_MEASUREMENT VDID_PSAR_sec /end REF_MEASUREMENT /end GROUP
/begin GROUP S6_Seconds_Counter1 "SWC_CARB_type/run_SWC_CARB_5ms_sys/DID/Subsystem/0xF819: Total Propulsion System Active Time/Seconds_Counter1" /begin REF_MEASUREMENT VDID_PSAL_sec /end REF_MEASUREMENT /end GROUP
/begin GROUP S6_Seconds_Counter2 "SWC_CARB_type/run_SWC_CARB_5ms_sys/DID/Subsystem/0xF819: Total Propulsion System Active Time/Seconds_Counter2" /begin REF_MEASUREMENT VDID_IPSAR_sec /end REF_MEASUREMENT /end GROUP
/begin GROUP S6_Seconds_Counter3 "SWC_CARB_type/run_SWC_CARB_5ms_sys/DID/Subsystem/0xF819: Total Propulsion System Active Time/Seconds_Counter3" /begin REF_MEASUREMENT VDID_IPSAL_sec /end REF_MEASUREMENT /end GROUP
/begin GROUP S6_Seconds_Counter4 "SWC_CARB_type/run_SWC_CARB_5ms_sys/DID/Subsystem/0xF819: Total Propulsion System Active Time/Seconds_Counter4" /begin REF_MEASUREMENT VDID_CPSAR_sec /end REF_MEASUREMENT /end GROUP
/begin GROUP S6_Seconds_Counter5 "SWC_CARB_type/run_SWC_CARB_5ms_sys/DID/Subsystem/0xF819: Total Propulsion System Active Time/Seconds_Counter5" /begin REF_MEASUREMENT VDID_CPSAL_sec /end REF_MEASUREMENT /end GROUP
/begin GROUP S8_Seconds_Counter10 "SWC_CARB_type/run_SWC_CARB_5ms_sys/DID/Subsystem/0xF88E - 0xF890/Seconds_Counter10" /begin REF_MEASUREMENT VDID_BattTempPSAR_sec /end REF_MEASUREMENT /end GROUP
/begin GROUP S8_Seconds_Counter11 "SWC_CARB_type/run_SWC_CARB_5ms_sys/DID/Subsystem/0xF88E - 0xF890/Seconds_Counter11" /begin REF_MEASUREMENT VDID_BattTempPSAL_sec /end REF_MEASUREMENT /end GROUP
/begin GROUP S8_Seconds_Counter6 "SWC_CARB_type/run_SWC_CARB_5ms_sys/DID/Subsystem/0xF88E - 0xF890/Seconds_Counter6" /begin REF_MEASUREMENT VDID_OVCR_sec /end REF_MEASUREMENT /end GROUP
/begin GROUP S8_Seconds_Counter7 "SWC_CARB_type/run_SWC_CARB_5ms_sys/DID/Subsystem/0xF88E - 0xF890/Seconds_Counter7" /begin REF_MEASUREMENT VDID_OVCL_sec /end REF_MEASUREMENT /end GROUP
/begin GROUP S8_Seconds_Counter8 "SWC_CARB_type/run_SWC_CARB_5ms_sys/DID/Subsystem/0xF88E - 0xF890/Seconds_Counter8" /begin REF_MEASUREMENT VDID_OFFR_sec /end REF_MEASUREMENT /end GROUP
/begin GROUP S8_Seconds_Counter9 "SWC_CARB_type/run_SWC_CARB_5ms_sys/DID/Subsystem/0xF88E - 0xF890/Seconds_Counter9" /begin REF_MEASUREMENT VDID_OFFL_sec /end REF_MEASUREMENT /end GROUP
/begin GROUP S9_Initial_Value11 "SWC_CARB_type/run_SWC_CARB_5ms_sys/DID/Subsystem/0xF898-0xF8/Initial Value11" /begin REF_MEASUREMENT VDID_MINBATTEMPL_C /end REF_MEASUREMENT /end GROUP
/begin GROUP S9_Initial_Value4 "SWC_CARB_type/run_SWC_CARB_5ms_sys/DID/Subsystem/0xF898-0xF8/Initial Value4" /begin REF_MEASUREMENT VDID_MAXBATTEMPL_C /end REF_MEASUREMENT /end GROUP
/begin GROUP S9_RangeCnt "SWC_CARB_type/run_SWC_CARB_5ms_sys/DID/Subsystem/0xF898-0xF8/RangeCnt" /begin REF_MEASUREMENT VDID_RESSCNTDODRNGL_cnt VDID_RESSCNTDODRNGR_cnt /end REF_MEASUREMENT /end GROUP
/begin GROUP S9_RangeTimer "SWC_CARB_type/run_SWC_CARB_5ms_sys/DID/Subsystem/0xF898-0xF8/RangeTimer" /begin REF_MEASUREMENT VDID_RESSTIMESOCPSARNGL_s VDID_RESSTIMESOCPSARNGR_s /end REF_MEASUREMENT /end GROUP
/begin GROUP S9_RangeTimer1 "SWC_CARB_type/run_SWC_CARB_5ms_sys/DID/Subsystem/0xF898-0xF8/RangeTimer1" /begin REF_MEASUREMENT VDID_RESSTIMESOCCHGRNGL_s VDID_RESSTIMESOCCHGRNGR_s /end REF_MEASUREMENT /end GROUP
/begin GROUP S9_RangeTimer2 "SWC_CARB_type/run_SWC_CARB_5ms_sys/DID/Subsystem/0xF898-0xF8/RangeTimer2" /begin REF_MEASUREMENT VDID_RESSTIMESOCOFFRNGL_s VDID_RESSTIMESOCOFFRNGR_s /end REF_MEASUREMENT /end GROUP
/begin GROUP S9_Seconds_Counter11 "SWC_CARB_type/run_SWC_CARB_5ms_sys/DID/Subsystem/0xF898-0xF8/Seconds_Counter11" /begin REF_MEASUREMENT VDID_AVGBATTEMPL_sec /end REF_MEASUREMENT /end GROUP
/begin GROUP S41_Checksum "SWC_CARB_type/run_SWC_CARB_5ms_sys/DID/Subsystem/Subsystem/Checksum" /begin REF_MEASUREMENT VDID_DIDModelVersionChksum_raw /end REF_MEASUREMENT /end GROUP
/end MODULE
/end PROJECT
/* (add any file trailer comments here) */
/* EOF SWC_CARB_type.a2l */
