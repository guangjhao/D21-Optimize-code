ASAP2_VERSION 1 31
/begin PROJECT ProjectName "Project Comment Goes Here"
/begin HEADER "Header Comments go here" /end HEADER
/begin MODULE ModuleName "Module Comment Goes Here"
/begin MOD_COMMON "Mod Common Comment Here" BYTE_ORDER MSB_LAST /end MOD_COMMON
/begin RECORD_LAYOUT Scalar_BOOLEAN FNC_VALUES 1 UBYTE COLUMN_DIR DIRECT /end RECORD_LAYOUT
/begin RECORD_LAYOUT Scalar_UBYTE FNC_VALUES 1 UBYTE COLUMN_DIR DIRECT /end RECORD_LAYOUT
/begin RECORD_LAYOUT Scalar_UWORD FNC_VALUES 1 UWORD COLUMN_DIR DIRECT /end RECORD_LAYOUT
/begin RECORD_LAYOUT Scalar_ULONG FNC_VALUES 1 ULONG COLUMN_DIR DIRECT /end RECORD_LAYOUT
/begin RECORD_LAYOUT Scalar_FLOAT32_IEEE FNC_VALUES 1 FLOAT32_IEEE COLUMN_DIR DIRECT /end RECORD_LAYOUT
/begin RECORD_LAYOUT Lookup2D_BOOLEAN FNC_VALUES 1 UBYTE COLUMN_DIR DIRECT /end RECORD_LAYOUT
/begin RECORD_LAYOUT Lookup2D_X_BOOLEAN AXIS_PTS_X 1 UBYTE INDEX_INCR DIRECT /end RECORD_LAYOUT
/begin RECORD_LAYOUT Lookup2D_UBYTE FNC_VALUES 1 UBYTE COLUMN_DIR DIRECT /end RECORD_LAYOUT
/begin CHARACTERISTIC KOUTP_APPD_pct_maxval "" VALUE 0x0000 /* @ECU_Address@KOUTP_APPD_pct_maxval@ */ Scalar_FLOAT32_IEEE 0 SWC_OUTP_type_CM_single_pct -65535.0 65535.0 /end CHARACTERISTIC
/begin CHARACTERISTIC KOUTP_APPD_pct_minval "" VALUE 0x0000 /* @ECU_Address@KOUTP_APPD_pct_minval@ */ Scalar_FLOAT32_IEEE 0 SWC_OUTP_type_CM_single_pct -65535.0 65535.0 /end CHARACTERISTIC
/begin CHARACTERISTIC KOUTP_APPD_pct_ovrdval "" VALUE 0x0000 /* @ECU_Address@KOUTP_APPD_pct_ovrdval@ */ Scalar_FLOAT32_IEEE 0 SWC_OUTP_type_CM_single_pct -65535.0 65535.0 /end CHARACTERISTIC
/begin CHARACTERISTIC KOUTP_APPE_pct_maxval "" VALUE 0x0000 /* @ECU_Address@KOUTP_APPE_pct_maxval@ */ Scalar_FLOAT32_IEEE 0 SWC_OUTP_type_CM_single_pct -65535.0 65535.0 /end CHARACTERISTIC
/begin CHARACTERISTIC KOUTP_APPE_pct_minval "" VALUE 0x0000 /* @ECU_Address@KOUTP_APPE_pct_minval@ */ Scalar_FLOAT32_IEEE 0 SWC_OUTP_type_CM_single_pct -65535.0 65535.0 /end CHARACTERISTIC
/begin CHARACTERISTIC KOUTP_APPE_pct_ovrdval "" VALUE 0x0000 /* @ECU_Address@KOUTP_APPE_pct_ovrdval@ */ Scalar_FLOAT32_IEEE 0 SWC_OUTP_type_CM_single_pct -65535.0 65535.0 /end CHARACTERISTIC
/begin CHARACTERISTIC KOUTP_AVGBATTEMPL_C_maxval "" VALUE 0x0000 /* @ECU_Address@KOUTP_AVGBATTEMPL_C_maxval@ */ Scalar_FLOAT32_IEEE 0 SWC_OUTP_type_CM_single_C -65535.0 65535.0 /end CHARACTERISTIC
/begin CHARACTERISTIC KOUTP_AVGBATTEMPL_C_minval "" VALUE 0x0000 /* @ECU_Address@KOUTP_AVGBATTEMPL_C_minval@ */ Scalar_FLOAT32_IEEE 0 SWC_OUTP_type_CM_single_C -65535.0 65535.0 /end CHARACTERISTIC
/begin CHARACTERISTIC KOUTP_AVGBATTEMPL_C_ovrdval "" VALUE 0x0000 /* @ECU_Address@KOUTP_AVGBATTEMPL_C_ovrdval@ */ Scalar_FLOAT32_IEEE 0 SWC_OUTP_type_CM_single_C -65535.0 65535.0 /end CHARACTERISTIC
/begin CHARACTERISTIC KOUTP_ActAPSPosn_pct_maxval "" VALUE 0x0000 /* @ECU_Address@KOUTP_ActAPSPosn_pct_maxval@ */ Scalar_FLOAT32_IEEE 0 SWC_OUTP_type_CM_single_pct -65535.0 65535.0 /end CHARACTERISTIC
/begin CHARACTERISTIC KOUTP_ActAPSPosn_pct_minval "" VALUE 0x0000 /* @ECU_Address@KOUTP_ActAPSPosn_pct_minval@ */ Scalar_FLOAT32_IEEE 0 SWC_OUTP_type_CM_single_pct -65535.0 65535.0 /end CHARACTERISTIC
/begin CHARACTERISTIC KOUTP_ActAPSPosn_pct_ovrdval "" VALUE 0x0000 /* @ECU_Address@KOUTP_ActAPSPosn_pct_ovrdval@ */ Scalar_FLOAT32_IEEE 0 SWC_OUTP_type_CM_single_pct -65535.0 65535.0 /end CHARACTERISTIC
/begin CHARACTERISTIC KOUTP_AvgBattTempOFFL_C_maxval "" VALUE 0x0000 /* @ECU_Address@KOUTP_AvgBattTempOFFL_C_maxval@ */ Scalar_FLOAT32_IEEE 0 SWC_OUTP_type_CM_single_C -65535.0 65535.0 /end CHARACTERISTIC
/begin CHARACTERISTIC KOUTP_AvgBattTempOFFL_C_minval "" VALUE 0x0000 /* @ECU_Address@KOUTP_AvgBattTempOFFL_C_minval@ */ Scalar_FLOAT32_IEEE 0 SWC_OUTP_type_CM_single_C -65535.0 65535.0 /end CHARACTERISTIC
/begin CHARACTERISTIC KOUTP_AvgBattTempOFFL_C_ovrdval "" VALUE 0x0000 /* @ECU_Address@KOUTP_AvgBattTempOFFL_C_ovrdval@ */ Scalar_FLOAT32_IEEE 0 SWC_OUTP_type_CM_single_C -65535.0 65535.0 /end CHARACTERISTIC
/begin CHARACTERISTIC KOUTP_AvgBattTempOFFR_C_maxval "" VALUE 0x0000 /* @ECU_Address@KOUTP_AvgBattTempOFFR_C_maxval@ */ Scalar_FLOAT32_IEEE 0 SWC_OUTP_type_CM_single_C -65535.0 65535.0 /end CHARACTERISTIC
/begin CHARACTERISTIC KOUTP_AvgBattTempOFFR_C_minval "" VALUE 0x0000 /* @ECU_Address@KOUTP_AvgBattTempOFFR_C_minval@ */ Scalar_FLOAT32_IEEE 0 SWC_OUTP_type_CM_single_C -65535.0 65535.0 /end CHARACTERISTIC
/begin CHARACTERISTIC KOUTP_AvgBattTempOFFR_C_ovrdval "" VALUE 0x0000 /* @ECU_Address@KOUTP_AvgBattTempOFFR_C_ovrdval@ */ Scalar_FLOAT32_IEEE 0 SWC_OUTP_type_CM_single_C -65535.0 65535.0 /end CHARACTERISTIC
/begin CHARACTERISTIC KOUTP_AvgBattTempOVCL_C_maxval "" VALUE 0x0000 /* @ECU_Address@KOUTP_AvgBattTempOVCL_C_maxval@ */ Scalar_FLOAT32_IEEE 0 SWC_OUTP_type_CM_single_C -65535.0 65535.0 /end CHARACTERISTIC
/begin CHARACTERISTIC KOUTP_AvgBattTempOVCL_C_minval "" VALUE 0x0000 /* @ECU_Address@KOUTP_AvgBattTempOVCL_C_minval@ */ Scalar_FLOAT32_IEEE 0 SWC_OUTP_type_CM_single_C -65535.0 65535.0 /end CHARACTERISTIC
/begin CHARACTERISTIC KOUTP_AvgBattTempOVCL_C_ovrdval "" VALUE 0x0000 /* @ECU_Address@KOUTP_AvgBattTempOVCL_C_ovrdval@ */ Scalar_FLOAT32_IEEE 0 SWC_OUTP_type_CM_single_C -65535.0 65535.0 /end CHARACTERISTIC
/begin CHARACTERISTIC KOUTP_AvgBattTempOVCR_C_maxval "" VALUE 0x0000 /* @ECU_Address@KOUTP_AvgBattTempOVCR_C_maxval@ */ Scalar_FLOAT32_IEEE 0 SWC_OUTP_type_CM_single_C -65535.0 65535.0 /end CHARACTERISTIC
/begin CHARACTERISTIC KOUTP_AvgBattTempOVCR_C_minval "" VALUE 0x0000 /* @ECU_Address@KOUTP_AvgBattTempOVCR_C_minval@ */ Scalar_FLOAT32_IEEE 0 SWC_OUTP_type_CM_single_C -65535.0 65535.0 /end CHARACTERISTIC
/begin CHARACTERISTIC KOUTP_AvgBattTempOVCR_C_ovrdval "" VALUE 0x0000 /* @ECU_Address@KOUTP_AvgBattTempOVCR_C_ovrdval@ */ Scalar_FLOAT32_IEEE 0 SWC_OUTP_type_CM_single_C -65535.0 65535.0 /end CHARACTERISTIC
/begin CHARACTERISTIC KOUTP_AvgBattTempPSAL_C_maxval "" VALUE 0x0000 /* @ECU_Address@KOUTP_AvgBattTempPSAL_C_maxval@ */ Scalar_FLOAT32_IEEE 0 SWC_OUTP_type_CM_single_C -65535.0 65535.0 /end CHARACTERISTIC
/begin CHARACTERISTIC KOUTP_AvgBattTempPSAL_C_minval "" VALUE 0x0000 /* @ECU_Address@KOUTP_AvgBattTempPSAL_C_minval@ */ Scalar_FLOAT32_IEEE 0 SWC_OUTP_type_CM_single_C -65535.0 65535.0 /end CHARACTERISTIC
/begin CHARACTERISTIC KOUTP_AvgBattTempPSAL_C_ovrdval "" VALUE 0x0000 /* @ECU_Address@KOUTP_AvgBattTempPSAL_C_ovrdval@ */ Scalar_FLOAT32_IEEE 0 SWC_OUTP_type_CM_single_C -65535.0 65535.0 /end CHARACTERISTIC
/begin CHARACTERISTIC KOUTP_AvgBattTempPSAR_C_maxval "" VALUE 0x0000 /* @ECU_Address@KOUTP_AvgBattTempPSAR_C_maxval@ */ Scalar_FLOAT32_IEEE 0 SWC_OUTP_type_CM_single_C -65535.0 65535.0 /end CHARACTERISTIC
/begin CHARACTERISTIC KOUTP_AvgBattTempPSAR_C_minval "" VALUE 0x0000 /* @ECU_Address@KOUTP_AvgBattTempPSAR_C_minval@ */ Scalar_FLOAT32_IEEE 0 SWC_OUTP_type_CM_single_C -65535.0 65535.0 /end CHARACTERISTIC
/begin CHARACTERISTIC KOUTP_AvgBattTempPSAR_C_ovrdval "" VALUE 0x0000 /* @ECU_Address@KOUTP_AvgBattTempPSAR_C_ovrdval@ */ Scalar_FLOAT32_IEEE 0 SWC_OUTP_type_CM_single_C -65535.0 65535.0 /end CHARACTERISTIC
/begin CHARACTERISTIC KOUTP_BATSOC_pct_maxval "" VALUE 0x0000 /* @ECU_Address@KOUTP_BATSOC_pct_maxval@ */ Scalar_FLOAT32_IEEE 0 SWC_OUTP_type_CM_single_pct -65535.0 65535.0 /end CHARACTERISTIC
/begin CHARACTERISTIC KOUTP_BATSOC_pct_minval "" VALUE 0x0000 /* @ECU_Address@KOUTP_BATSOC_pct_minval@ */ Scalar_FLOAT32_IEEE 0 SWC_OUTP_type_CM_single_pct -65535.0 65535.0 /end CHARACTERISTIC
/begin CHARACTERISTIC KOUTP_BATSOC_pct_ovrdval "" VALUE 0x0000 /* @ECU_Address@KOUTP_BATSOC_pct_ovrdval@ */ Scalar_FLOAT32_IEEE 0 SWC_OUTP_type_CM_single_pct -65535.0 65535.0 /end CHARACTERISTIC
/begin CHARACTERISTIC KOUTP_BATSOH_pct_maxval "" VALUE 0x0000 /* @ECU_Address@KOUTP_BATSOH_pct_maxval@ */ Scalar_FLOAT32_IEEE 0 SWC_OUTP_type_CM_single_pct -65535.0 65535.0 /end CHARACTERISTIC
/begin CHARACTERISTIC KOUTP_BATSOH_pct_minval "" VALUE 0x0000 /* @ECU_Address@KOUTP_BATSOH_pct_minval@ */ Scalar_FLOAT32_IEEE 0 SWC_OUTP_type_CM_single_pct -65535.0 65535.0 /end CHARACTERISTIC
/begin CHARACTERISTIC KOUTP_BATSOH_pct_ovrdval "" VALUE 0x0000 /* @ECU_Address@KOUTP_BATSOH_pct_ovrdval@ */ Scalar_FLOAT32_IEEE 0 SWC_OUTP_type_CM_single_pct -65535.0 65535.0 /end CHARACTERISTIC
/begin CHARACTERISTIC KOUTP_CDEODTL_km_maxval "" VALUE 0x0000 /* @ECU_Address@KOUTP_CDEODTL_km_maxval@ */ Scalar_FLOAT32_IEEE 0 SWC_OUTP_type_CM_single_km -65535.0 65535.0 /end CHARACTERISTIC
/begin CHARACTERISTIC KOUTP_CDEODTL_km_minval "" VALUE 0x0000 /* @ECU_Address@KOUTP_CDEODTL_km_minval@ */ Scalar_FLOAT32_IEEE 0 SWC_OUTP_type_CM_single_km -65535.0 65535.0 /end CHARACTERISTIC
/begin CHARACTERISTIC KOUTP_CDEODTL_km_ovrdval "" VALUE 0x0000 /* @ECU_Address@KOUTP_CDEODTL_km_ovrdval@ */ Scalar_FLOAT32_IEEE 0 SWC_OUTP_type_CM_single_km -65535.0 65535.0 /end CHARACTERISTIC
/begin CHARACTERISTIC KOUTP_CDEODTR_km_maxval "" VALUE 0x0000 /* @ECU_Address@KOUTP_CDEODTR_km_maxval@ */ Scalar_FLOAT32_IEEE 0 SWC_OUTP_type_CM_single_km -65535.0 4.294967295E+8 /end CHARACTERISTIC
/begin CHARACTERISTIC KOUTP_CDEODTR_km_minval "" VALUE 0x0000 /* @ECU_Address@KOUTP_CDEODTR_km_minval@ */ Scalar_FLOAT32_IEEE 0 SWC_OUTP_type_CM_single_km -65535.0 4.294967295E+8 /end CHARACTERISTIC
/begin CHARACTERISTIC KOUTP_CDEODTR_km_ovrdval "" VALUE 0x0000 /* @ECU_Address@KOUTP_CDEODTR_km_ovrdval@ */ Scalar_FLOAT32_IEEE 0 SWC_OUTP_type_CM_single_km -65535.0 4.294967295E+8 /end CHARACTERISTIC
/begin CHARACTERISTIC KOUTP_CLRDIST_km_maxval "" VALUE 0x0000 /* @ECU_Address@KOUTP_CLRDIST_km_maxval@ */ Scalar_FLOAT32_IEEE 0 SWC_OUTP_type_CM_single_km -65535.0 65535.0 /end CHARACTERISTIC
/begin CHARACTERISTIC KOUTP_CLRDIST_km_minval "" VALUE 0x0000 /* @ECU_Address@KOUTP_CLRDIST_km_minval@ */ Scalar_FLOAT32_IEEE 0 SWC_OUTP_type_CM_single_km -65535.0 65535.0 /end CHARACTERISTIC
/begin CHARACTERISTIC KOUTP_CLRDIST_km_ovrdval "" VALUE 0x0000 /* @ECU_Address@KOUTP_CLRDIST_km_ovrdval@ */ Scalar_FLOAT32_IEEE 0 SWC_OUTP_type_CM_single_km -65535.0 65535.0 /end CHARACTERISTIC
/begin CHARACTERISTIC KOUTP_EAPS1MIN_pct_maxval "" VALUE 0x0000 /* @ECU_Address@KOUTP_EAPS1MIN_pct_maxval@ */ Scalar_FLOAT32_IEEE 0 SWC_OUTP_type_CM_single_pct -65535.0 65535.0 /end CHARACTERISTIC
/begin CHARACTERISTIC KOUTP_EAPS1MIN_pct_minval "" VALUE 0x0000 /* @ECU_Address@KOUTP_EAPS1MIN_pct_minval@ */ Scalar_FLOAT32_IEEE 0 SWC_OUTP_type_CM_single_pct -65535.0 65535.0 /end CHARACTERISTIC
/begin CHARACTERISTIC KOUTP_EAPS1MIN_pct_ovrdval "" VALUE 0x0000 /* @ECU_Address@KOUTP_EAPS1MIN_pct_ovrdval@ */ Scalar_FLOAT32_IEEE 0 SWC_OUTP_type_CM_single_pct -65535.0 65535.0 /end CHARACTERISTIC
/begin CHARACTERISTIC KOUTP_EAPS1NRM_pct_maxval "" VALUE 0x0000 /* @ECU_Address@KOUTP_EAPS1NRM_pct_maxval@ */ Scalar_FLOAT32_IEEE 0 SWC_OUTP_type_CM_single_pct -65535.0 65535.0 /end CHARACTERISTIC
/begin CHARACTERISTIC KOUTP_EAPS1NRM_pct_minval "" VALUE 0x0000 /* @ECU_Address@KOUTP_EAPS1NRM_pct_minval@ */ Scalar_FLOAT32_IEEE 0 SWC_OUTP_type_CM_single_pct -65535.0 65535.0 /end CHARACTERISTIC
/begin CHARACTERISTIC KOUTP_EAPS1NRM_pct_ovrdval "" VALUE 0x0000 /* @ECU_Address@KOUTP_EAPS1NRM_pct_ovrdval@ */ Scalar_FLOAT32_IEEE 0 SWC_OUTP_type_CM_single_pct -65535.0 65535.0 /end CHARACTERISTIC
/begin CHARACTERISTIC KOUTP_EAPS2MIN_pct_maxval "" VALUE 0x0000 /* @ECU_Address@KOUTP_EAPS2MIN_pct_maxval@ */ Scalar_FLOAT32_IEEE 0 SWC_OUTP_type_CM_single_pct -65535.0 65535.0 /end CHARACTERISTIC
/begin CHARACTERISTIC KOUTP_EAPS2MIN_pct_minval "" VALUE 0x0000 /* @ECU_Address@KOUTP_EAPS2MIN_pct_minval@ */ Scalar_FLOAT32_IEEE 0 SWC_OUTP_type_CM_single_pct -65535.0 65535.0 /end CHARACTERISTIC
/begin CHARACTERISTIC KOUTP_EAPS2MIN_pct_ovrdval "" VALUE 0x0000 /* @ECU_Address@KOUTP_EAPS2MIN_pct_ovrdval@ */ Scalar_FLOAT32_IEEE 0 SWC_OUTP_type_CM_single_pct -65535.0 65535.0 /end CHARACTERISTIC
/begin CHARACTERISTIC KOUTP_EAPS2NRM_pct_maxval "" VALUE 0x0000 /* @ECU_Address@KOUTP_EAPS2NRM_pct_maxval@ */ Scalar_FLOAT32_IEEE 0 SWC_OUTP_type_CM_single_pct -65535.0 65535.0 /end CHARACTERISTIC
/begin CHARACTERISTIC KOUTP_EAPS2NRM_pct_minval "" VALUE 0x0000 /* @ECU_Address@KOUTP_EAPS2NRM_pct_minval@ */ Scalar_FLOAT32_IEEE 0 SWC_OUTP_type_CM_single_pct -65535.0 65535.0 /end CHARACTERISTIC
/begin CHARACTERISTIC KOUTP_EAPS2NRM_pct_ovrdval "" VALUE 0x0000 /* @ECU_Address@KOUTP_EAPS2NRM_pct_ovrdval@ */ Scalar_FLOAT32_IEEE 0 SWC_OUTP_type_CM_single_pct -65535.0 65535.0 /end CHARACTERISTIC
/begin CHARACTERISTIC KOUTP_ETMATOEL_kWh_maxval "" VALUE 0x0000 /* @ECU_Address@KOUTP_ETMATOEL_kWh_maxval@ */ Scalar_FLOAT32_IEEE 0 SWC_OUTP_type_CM_single_kWh -65535.0 4.294967295E+9 /end CHARACTERISTIC
/begin CHARACTERISTIC KOUTP_ETMATOEL_kWh_minval "" VALUE 0x0000 /* @ECU_Address@KOUTP_ETMATOEL_kWh_minval@ */ Scalar_FLOAT32_IEEE 0 SWC_OUTP_type_CM_single_kWh -65535.0 4.294967295E+9 /end CHARACTERISTIC
/begin CHARACTERISTIC KOUTP_ETMATOEL_kWh_ovrdval "" VALUE 0x0000 /* @ECU_Address@KOUTP_ETMATOEL_kWh_ovrdval@ */ Scalar_FLOAT32_IEEE 0 SWC_OUTP_type_CM_single_kWh -65535.0 4.294967295E+9 /end CHARACTERISTIC
/begin CHARACTERISTIC KOUTP_ETMATOER_kWh_maxval "" VALUE 0x0000 /* @ECU_Address@KOUTP_ETMATOER_kWh_maxval@ */ Scalar_FLOAT32_IEEE 0 SWC_OUTP_type_CM_single_kWh -65535.0 4.294967295E+9 /end CHARACTERISTIC
/begin CHARACTERISTIC KOUTP_ETMATOER_kWh_minval "" VALUE 0x0000 /* @ECU_Address@KOUTP_ETMATOER_kWh_minval@ */ Scalar_FLOAT32_IEEE 0 SWC_OUTP_type_CM_single_kWh -65535.0 4.294967295E+9 /end CHARACTERISTIC
/begin CHARACTERISTIC KOUTP_ETMATOER_kWh_ovrdval "" VALUE 0x0000 /* @ECU_Address@KOUTP_ETMATOER_kWh_ovrdval@ */ Scalar_FLOAT32_IEEE 0 SWC_OUTP_type_CM_single_kWh -65535.0 4.294967295E+9 /end CHARACTERISTIC
/begin CHARACTERISTIC KOUTP_ETMBTOEL_kWh_maxval "" VALUE 0x0000 /* @ECU_Address@KOUTP_ETMBTOEL_kWh_maxval@ */ Scalar_FLOAT32_IEEE 0 SWC_OUTP_type_CM_single_kWh -65535.0 4.294967295E+9 /end CHARACTERISTIC
/begin CHARACTERISTIC KOUTP_ETMBTOEL_kWh_minval "" VALUE 0x0000 /* @ECU_Address@KOUTP_ETMBTOEL_kWh_minval@ */ Scalar_FLOAT32_IEEE 0 SWC_OUTP_type_CM_single_kWh -65535.0 4.294967295E+9 /end CHARACTERISTIC
/begin CHARACTERISTIC KOUTP_ETMBTOEL_kWh_ovrdval "" VALUE 0x0000 /* @ECU_Address@KOUTP_ETMBTOEL_kWh_ovrdval@ */ Scalar_FLOAT32_IEEE 0 SWC_OUTP_type_CM_single_kWh -65535.0 4.294967295E+9 /end CHARACTERISTIC
/begin CHARACTERISTIC KOUTP_ETMBTOER_kWh_maxval "" VALUE 0x0000 /* @ECU_Address@KOUTP_ETMBTOER_kWh_maxval@ */ Scalar_FLOAT32_IEEE 0 SWC_OUTP_type_CM_single_kWh -65535.0 4.294967295E+9 /end CHARACTERISTIC
/begin CHARACTERISTIC KOUTP_ETMBTOER_kWh_minval "" VALUE 0x0000 /* @ECU_Address@KOUTP_ETMBTOER_kWh_minval@ */ Scalar_FLOAT32_IEEE 0 SWC_OUTP_type_CM_single_kWh -65535.0 4.294967295E+9 /end CHARACTERISTIC
/begin CHARACTERISTIC KOUTP_ETMBTOER_kWh_ovrdval "" VALUE 0x0000 /* @ECU_Address@KOUTP_ETMBTOER_kWh_ovrdval@ */ Scalar_FLOAT32_IEEE 0 SWC_OUTP_type_CM_single_kWh -65535.0 4.294967295E+9 /end CHARACTERISTIC
/begin CHARACTERISTIC KOUTP_GECHGOVCACL_kWh_maxval "" VALUE 0x0000 /* @ECU_Address@KOUTP_GECHGOVCACL_kWh_maxval@ */ Scalar_FLOAT32_IEEE 0 SWC_OUTP_type_CM_single_kWh -65535.0 4.294967295E+8 /end CHARACTERISTIC
/begin CHARACTERISTIC KOUTP_GECHGOVCACL_kWh_minval "" VALUE 0x0000 /* @ECU_Address@KOUTP_GECHGOVCACL_kWh_minval@ */ Scalar_FLOAT32_IEEE 0 SWC_OUTP_type_CM_single_kWh -65535.0 4.294967295E+8 /end CHARACTERISTIC
/begin CHARACTERISTIC KOUTP_GECHGOVCACL_kWh_ovrdval "" VALUE 0x0000 /* @ECU_Address@KOUTP_GECHGOVCACL_kWh_ovrdval@ */ Scalar_FLOAT32_IEEE 0 SWC_OUTP_type_CM_single_kWh -65535.0 4.294967295E+8 /end CHARACTERISTIC
/begin CHARACTERISTIC KOUTP_GECHGOVCACR_kWh_maxval "" VALUE 0x0000 /* @ECU_Address@KOUTP_GECHGOVCACR_kWh_maxval@ */ Scalar_FLOAT32_IEEE 0 SWC_OUTP_type_CM_single_kWh -65535.0 4.294967295E+8 /end CHARACTERISTIC
/begin CHARACTERISTIC KOUTP_GECHGOVCACR_kWh_minval "" VALUE 0x0000 /* @ECU_Address@KOUTP_GECHGOVCACR_kWh_minval@ */ Scalar_FLOAT32_IEEE 0 SWC_OUTP_type_CM_single_kWh -65535.0 4.294967295E+8 /end CHARACTERISTIC
/begin CHARACTERISTIC KOUTP_GECHGOVCACR_kWh_ovrdval "" VALUE 0x0000 /* @ECU_Address@KOUTP_GECHGOVCACR_kWh_ovrdval@ */ Scalar_FLOAT32_IEEE 0 SWC_OUTP_type_CM_single_kWh -65535.0 4.294967295E+8 /end CHARACTERISTIC
/begin CHARACTERISTIC KOUTP_GECHGOVCDCL_kWh_maxval "" VALUE 0x0000 /* @ECU_Address@KOUTP_GECHGOVCDCL_kWh_maxval@ */ Scalar_FLOAT32_IEEE 0 SWC_OUTP_type_CM_single_kWh -65535.0 4.294967295E+8 /end CHARACTERISTIC
/begin CHARACTERISTIC KOUTP_GECHGOVCDCL_kWh_minval "" VALUE 0x0000 /* @ECU_Address@KOUTP_GECHGOVCDCL_kWh_minval@ */ Scalar_FLOAT32_IEEE 0 SWC_OUTP_type_CM_single_kWh -65535.0 4.294967295E+8 /end CHARACTERISTIC
/begin CHARACTERISTIC KOUTP_GECHGOVCDCL_kWh_ovrdval "" VALUE 0x0000 /* @ECU_Address@KOUTP_GECHGOVCDCL_kWh_ovrdval@ */ Scalar_FLOAT32_IEEE 0 SWC_OUTP_type_CM_single_kWh -65535.0 4.294967295E+8 /end CHARACTERISTIC
/begin CHARACTERISTIC KOUTP_GECHGOVCDCR_kWh_maxval "" VALUE 0x0000 /* @ECU_Address@KOUTP_GECHGOVCDCR_kWh_maxval@ */ Scalar_FLOAT32_IEEE 0 SWC_OUTP_type_CM_single_kWh -65535.0 4.294967295E+8 /end CHARACTERISTIC
/begin CHARACTERISTIC KOUTP_GECHGOVCDCR_kWh_minval "" VALUE 0x0000 /* @ECU_Address@KOUTP_GECHGOVCDCR_kWh_minval@ */ Scalar_FLOAT32_IEEE 0 SWC_OUTP_type_CM_single_kWh -65535.0 4.294967295E+8 /end CHARACTERISTIC
/begin CHARACTERISTIC KOUTP_GECHGOVCDCR_kWh_ovrdval "" VALUE 0x0000 /* @ECU_Address@KOUTP_GECHGOVCDCR_kWh_ovrdval@ */ Scalar_FLOAT32_IEEE 0 SWC_OUTP_type_CM_single_kWh -65535.0 4.294967295E+8 /end CHARACTERISTIC
/begin CHARACTERISTIC KOUTP_HEVBATT_V_maxval "" VALUE 0x0000 /* @ECU_Address@KOUTP_HEVBATT_V_maxval@ */ Scalar_FLOAT32_IEEE 0 SWC_OUTP_type_CM_single_V -65535.0 65535.0 /end CHARACTERISTIC
/begin CHARACTERISTIC KOUTP_HEVBATT_V_minval "" VALUE 0x0000 /* @ECU_Address@KOUTP_HEVBATT_V_minval@ */ Scalar_FLOAT32_IEEE 0 SWC_OUTP_type_CM_single_V -65535.0 65535.0 /end CHARACTERISTIC
/begin CHARACTERISTIC KOUTP_HEVBATT_V_ovrdval "" VALUE 0x0000 /* @ECU_Address@KOUTP_HEVBATT_V_ovrdval@ */ Scalar_FLOAT32_IEEE 0 SWC_OUTP_type_CM_single_V -65535.0 65535.0 /end CHARACTERISTIC
/begin CHARACTERISTIC KOUTP_HVBATT_A_maxval "" VALUE 0x0000 /* @ECU_Address@KOUTP_HVBATT_A_maxval@ */ Scalar_FLOAT32_IEEE 0 SWC_OUTP_type_CM_single_A -65535.0 65535.0 /end CHARACTERISTIC
/begin CHARACTERISTIC KOUTP_HVBATT_A_minval "" VALUE 0x0000 /* @ECU_Address@KOUTP_HVBATT_A_minval@ */ Scalar_FLOAT32_IEEE 0 SWC_OUTP_type_CM_single_A -65535.0 65535.0 /end CHARACTERISTIC
/begin CHARACTERISTIC KOUTP_HVBATT_A_ovrdval "" VALUE 0x0000 /* @ECU_Address@KOUTP_HVBATT_A_ovrdval@ */ Scalar_FLOAT32_IEEE 0 SWC_OUTP_type_CM_single_A -65535.0 65535.0 /end CHARACTERISTIC
/begin CHARACTERISTIC KOUTP_HVBCellVoltMax_V_maxval "" VALUE 0x0000 /* @ECU_Address@KOUTP_HVBCellVoltMax_V_maxval@ */ Scalar_FLOAT32_IEEE 0 SWC_OUTP_type_CM_single_V -65535.0 65535.0 /end CHARACTERISTIC
/begin CHARACTERISTIC KOUTP_HVBCellVoltMax_V_minval "" VALUE 0x0000 /* @ECU_Address@KOUTP_HVBCellVoltMax_V_minval@ */ Scalar_FLOAT32_IEEE 0 SWC_OUTP_type_CM_single_V -65535.0 65535.0 /end CHARACTERISTIC
/begin CHARACTERISTIC KOUTP_HVBCellVoltMax_V_ovrdval "" VALUE 0x0000 /* @ECU_Address@KOUTP_HVBCellVoltMax_V_ovrdval@ */ Scalar_FLOAT32_IEEE 0 SWC_OUTP_type_CM_single_V -65535.0 65535.0 /end CHARACTERISTIC
/begin CHARACTERISTIC KOUTP_HVBCellVoltMin_V_maxval "" VALUE 0x0000 /* @ECU_Address@KOUTP_HVBCellVoltMin_V_maxval@ */ Scalar_FLOAT32_IEEE 0 SWC_OUTP_type_CM_single_V -65535.0 65535.0 /end CHARACTERISTIC
/begin CHARACTERISTIC KOUTP_HVBCellVoltMin_V_minval "" VALUE 0x0000 /* @ECU_Address@KOUTP_HVBCellVoltMin_V_minval@ */ Scalar_FLOAT32_IEEE 0 SWC_OUTP_type_CM_single_V -65535.0 65535.0 /end CHARACTERISTIC
/begin CHARACTERISTIC KOUTP_HVBCellVoltMin_V_ovrdval "" VALUE 0x0000 /* @ECU_Address@KOUTP_HVBCellVoltMin_V_ovrdval@ */ Scalar_FLOAT32_IEEE 0 SWC_OUTP_type_CM_single_V -65535.0 65535.0 /end CHARACTERISTIC
/begin CHARACTERISTIC KOUTP_HVBNAH_Ahr_maxval "" VALUE 0x0000 /* @ECU_Address@KOUTP_HVBNAH_Ahr_maxval@ */ Scalar_FLOAT32_IEEE 0 SWC_OUTP_type_CM_single_Ahr -2.147483648E+6 2.147483647E+6 /end CHARACTERISTIC
/begin CHARACTERISTIC KOUTP_HVBNAH_Ahr_minval "" VALUE 0x0000 /* @ECU_Address@KOUTP_HVBNAH_Ahr_minval@ */ Scalar_FLOAT32_IEEE 0 SWC_OUTP_type_CM_single_Ahr -2.147483648E+6 2.147483647E+6 /end CHARACTERISTIC
/begin CHARACTERISTIC KOUTP_HVBNAH_Ahr_ovrdval "" VALUE 0x0000 /* @ECU_Address@KOUTP_HVBNAH_Ahr_ovrdval@ */ Scalar_FLOAT32_IEEE 0 SWC_OUTP_type_CM_single_Ahr -2.147483648E+6 2.147483647E+6 /end CHARACTERISTIC
/begin CHARACTERISTIC KOUTP_HVBNE_kWh_maxval "" VALUE 0x0000 /* @ECU_Address@KOUTP_HVBNE_kWh_maxval@ */ Scalar_FLOAT32_IEEE 0 SWC_OUTP_type_CM_single_kWh -2.147483648E+6 2.147483647E+6 /end CHARACTERISTIC
/begin CHARACTERISTIC KOUTP_HVBNE_kWh_minval "" VALUE 0x0000 /* @ECU_Address@KOUTP_HVBNE_kWh_minval@ */ Scalar_FLOAT32_IEEE 0 SWC_OUTP_type_CM_single_kWh -2.147483648E+6 2.147483647E+6 /end CHARACTERISTIC
/begin CHARACTERISTIC KOUTP_HVBNE_kWh_ovrdval "" VALUE 0x0000 /* @ECU_Address@KOUTP_HVBNE_kWh_ovrdval@ */ Scalar_FLOAT32_IEEE 0 SWC_OUTP_type_CM_single_kWh -2.147483648E+6 2.147483647E+6 /end CHARACTERISTIC
/begin CHARACTERISTIC KOUTP_HVBattCurr_Ahps_maxval "" VALUE 0x0000 /* @ECU_Address@KOUTP_HVBattCurr_Ahps_maxval@ */ Scalar_FLOAT32_IEEE 0 SWC_OUTP_type_CM_single_Ahps -65535.0 65535.0 /end CHARACTERISTIC
/begin CHARACTERISTIC KOUTP_HVBattCurr_Ahps_minval "" VALUE 0x0000 /* @ECU_Address@KOUTP_HVBattCurr_Ahps_minval@ */ Scalar_FLOAT32_IEEE 0 SWC_OUTP_type_CM_single_Ahps -65535.0 65535.0 /end CHARACTERISTIC
/begin CHARACTERISTIC KOUTP_HVBattCurr_Ahps_ovrdval "" VALUE 0x0000 /* @ECU_Address@KOUTP_HVBattCurr_Ahps_ovrdval@ */ Scalar_FLOAT32_IEEE 0 SWC_OUTP_type_CM_single_Ahps -65535.0 65535.0 /end CHARACTERISTIC
/begin CHARACTERISTIC KOUTP_HVESSCHARGEACT_kW_maxval "" VALUE 0x0000 /* @ECU_Address@KOUTP_HVESSCHARGEACT_kW_maxval@ */ Scalar_FLOAT32_IEEE 0 SWC_OUTP_type_CM_single_kW -65535.0 65535.0 /end CHARACTERISTIC
/begin CHARACTERISTIC KOUTP_HVESSCHARGEACT_kW_minval "" VALUE 0x0000 /* @ECU_Address@KOUTP_HVESSCHARGEACT_kW_minval@ */ Scalar_FLOAT32_IEEE 0 SWC_OUTP_type_CM_single_kW -65535.0 65535.0 /end CHARACTERISTIC
/begin CHARACTERISTIC KOUTP_AVGBATTEMPL_sec_maxval "" VALUE 0x0000 /* @ECU_Address@KOUTP_AVGBATTEMPL_sec_maxval@ */ Scalar_ULONG 0 SWC_OUTP_type_CM_uint32_sec 0.0 4.294967295E+9 /end CHARACTERISTIC
/begin CHARACTERISTIC KOUTP_AVGBATTEMPL_sec_minval "" VALUE 0x0000 /* @ECU_Address@KOUTP_AVGBATTEMPL_sec_minval@ */ Scalar_ULONG 0 SWC_OUTP_type_CM_uint32_sec 0.0 4.294967295E+9 /end CHARACTERISTIC
/begin CHARACTERISTIC KOUTP_AVGBATTEMPL_sec_ovrdval "" VALUE 0x0000 /* @ECU_Address@KOUTP_AVGBATTEMPL_sec_ovrdval@ */ Scalar_ULONG 0 SWC_OUTP_type_CM_uint32_sec 0.0 4.294967295E+9 /end CHARACTERISTIC
/begin CHARACTERISTIC KOUTP_BattTempPSAL_sec_maxval "" VALUE 0x0000 /* @ECU_Address@KOUTP_BattTempPSAL_sec_maxval@ */ Scalar_ULONG 0 SWC_OUTP_type_CM_uint32_sec 0.0 4.294967295E+9 /end CHARACTERISTIC
/begin CHARACTERISTIC KOUTP_BattTempPSAL_sec_minval "" VALUE 0x0000 /* @ECU_Address@KOUTP_BattTempPSAL_sec_minval@ */ Scalar_ULONG 0 SWC_OUTP_type_CM_uint32_sec 0.0 4.294967295E+9 /end CHARACTERISTIC
/begin CHARACTERISTIC KOUTP_BattTempPSAL_sec_ovrdval "" VALUE 0x0000 /* @ECU_Address@KOUTP_BattTempPSAL_sec_ovrdval@ */ Scalar_ULONG 0 SWC_OUTP_type_CM_uint32_sec 0.0 4.294967295E+9 /end CHARACTERISTIC
/begin CHARACTERISTIC KOUTP_BattTempPSAR_sec_maxval "" VALUE 0x0000 /* @ECU_Address@KOUTP_BattTempPSAR_sec_maxval@ */ Scalar_ULONG 0 SWC_OUTP_type_CM_uint32_sec 0.0 4.294967295E+9 /end CHARACTERISTIC
/begin CHARACTERISTIC KOUTP_BattTempPSAR_sec_minval "" VALUE 0x0000 /* @ECU_Address@KOUTP_BattTempPSAR_sec_minval@ */ Scalar_ULONG 0 SWC_OUTP_type_CM_uint32_sec 0.0 4.294967295E+9 /end CHARACTERISTIC
/begin CHARACTERISTIC KOUTP_BattTempPSAR_sec_ovrdval "" VALUE 0x0000 /* @ECU_Address@KOUTP_BattTempPSAR_sec_ovrdval@ */ Scalar_ULONG 0 SWC_OUTP_type_CM_uint32_sec 0.0 4.294967295E+9 /end CHARACTERISTIC
/begin CHARACTERISTIC KOUTP_CPSAL_sec_maxval "" VALUE 0x0000 /* @ECU_Address@KOUTP_CPSAL_sec_maxval@ */ Scalar_ULONG 0 SWC_OUTP_type_CM_uint32_sec 0.0 4.294967295E+9 /end CHARACTERISTIC
/begin CHARACTERISTIC KOUTP_CPSAL_sec_minval "" VALUE 0x0000 /* @ECU_Address@KOUTP_CPSAL_sec_minval@ */ Scalar_ULONG 0 SWC_OUTP_type_CM_uint32_sec 0.0 4.294967295E+9 /end CHARACTERISTIC
/begin CHARACTERISTIC KOUTP_CPSAL_sec_ovrdval "" VALUE 0x0000 /* @ECU_Address@KOUTP_CPSAL_sec_ovrdval@ */ Scalar_ULONG 0 SWC_OUTP_type_CM_uint32_sec 0.0 4.294967295E+9 /end CHARACTERISTIC
/begin CHARACTERISTIC KOUTP_CPSAR_sec_maxval "" VALUE 0x0000 /* @ECU_Address@KOUTP_CPSAR_sec_maxval@ */ Scalar_ULONG 0 SWC_OUTP_type_CM_uint32_sec 0.0 4.294967295E+9 /end CHARACTERISTIC
/begin CHARACTERISTIC KOUTP_CPSAR_sec_minval "" VALUE 0x0000 /* @ECU_Address@KOUTP_CPSAR_sec_minval@ */ Scalar_ULONG 0 SWC_OUTP_type_CM_uint32_sec 0.0 4.294967295E+9 /end CHARACTERISTIC
/begin CHARACTERISTIC KOUTP_CPSAR_sec_ovrdval "" VALUE 0x0000 /* @ECU_Address@KOUTP_CPSAR_sec_ovrdval@ */ Scalar_ULONG 0 SWC_OUTP_type_CM_uint32_sec 0.0 4.294967295E+9 /end CHARACTERISTIC
/begin CHARACTERISTIC KOUTP_FCMACCSigErrDetDTC_raw32_maxval "" VALUE 0x0000 /* @ECU_Address@KOUTP_FCMACCSigErrDetDTC_raw32_maxval@ */ Scalar_ULONG 0 SWC_OUTP_type_CM_uint32_raw32 0.0 4.294967295E+9 /end CHARACTERISTIC
/begin CHARACTERISTIC KOUTP_FCMACCSigErrDetDTC_raw32_minval "" VALUE 0x0000 /* @ECU_Address@KOUTP_FCMACCSigErrDetDTC_raw32_minval@ */ Scalar_ULONG 0 SWC_OUTP_type_CM_uint32_raw32 0.0 4.294967295E+9 /end CHARACTERISTIC
/begin CHARACTERISTIC KOUTP_FCMACCSigErrDetDTC_raw32_ovrdval "" VALUE 0x0000 /* @ECU_Address@KOUTP_FCMACCSigErrDetDTC_raw32_ovrdval@ */ Scalar_ULONG 0 SWC_OUTP_type_CM_uint32_raw32 0.0 4.294967295E+9 /end CHARACTERISTIC
/begin CHARACTERISTIC KOUTP_FCRUSSDTC_raw32_maxval "" VALUE 0x0000 /* @ECU_Address@KOUTP_FCRUSSDTC_raw32_maxval@ */ Scalar_ULONG 0 SWC_OUTP_type_CM_uint32_raw32 0.0 4.294967295E+9 /end CHARACTERISTIC
/begin CHARACTERISTIC KOUTP_FCRUSSDTC_raw32_minval "" VALUE 0x0000 /* @ECU_Address@KOUTP_FCRUSSDTC_raw32_minval@ */ Scalar_ULONG 0 SWC_OUTP_type_CM_uint32_raw32 0.0 4.294967295E+9 /end CHARACTERISTIC
/begin CHARACTERISTIC KOUTP_FCRUSSDTC_raw32_ovrdval "" VALUE 0x0000 /* @ECU_Address@KOUTP_FCRUSSDTC_raw32_ovrdval@ */ Scalar_ULONG 0 SWC_OUTP_type_CM_uint32_raw32 0.0 4.294967295E+9 /end CHARACTERISTIC
/begin CHARACTERISTIC KOUTP_FLDoorSWDTC_raw32_maxval "" VALUE 0x0000 /* @ECU_Address@KOUTP_FLDoorSWDTC_raw32_maxval@ */ Scalar_ULONG 0 SWC_OUTP_type_CM_uint32_raw32 0.0 4.294967295E+9 /end CHARACTERISTIC
/begin CHARACTERISTIC KOUTP_FLDoorSWDTC_raw32_minval "" VALUE 0x0000 /* @ECU_Address@KOUTP_FLDoorSWDTC_raw32_minval@ */ Scalar_ULONG 0 SWC_OUTP_type_CM_uint32_raw32 0.0 4.294967295E+9 /end CHARACTERISTIC
/begin CHARACTERISTIC KOUTP_FLDoorSWDTC_raw32_ovrdval "" VALUE 0x0000 /* @ECU_Address@KOUTP_FLDoorSWDTC_raw32_ovrdval@ */ Scalar_ULONG 0 SWC_OUTP_type_CM_uint32_raw32 0.0 4.294967295E+9 /end CHARACTERISTIC
/begin CHARACTERISTIC KOUTP_FLLUSSDTC_raw32_maxval "" VALUE 0x0000 /* @ECU_Address@KOUTP_FLLUSSDTC_raw32_maxval@ */ Scalar_ULONG 0 SWC_OUTP_type_CM_uint32_raw32 0.0 4.294967295E+9 /end CHARACTERISTIC
/begin CHARACTERISTIC KOUTP_FLLUSSDTC_raw32_minval "" VALUE 0x0000 /* @ECU_Address@KOUTP_FLLUSSDTC_raw32_minval@ */ Scalar_ULONG 0 SWC_OUTP_type_CM_uint32_raw32 0.0 4.294967295E+9 /end CHARACTERISTIC
/begin CHARACTERISTIC KOUTP_FLLUSSDTC_raw32_ovrdval "" VALUE 0x0000 /* @ECU_Address@KOUTP_FLLUSSDTC_raw32_ovrdval@ */ Scalar_ULONG 0 SWC_OUTP_type_CM_uint32_raw32 0.0 4.294967295E+9 /end CHARACTERISTIC
/begin CHARACTERISTIC KOUTP_FLRUSSDTC_raw32_maxval "" VALUE 0x0000 /* @ECU_Address@KOUTP_FLRUSSDTC_raw32_maxval@ */ Scalar_ULONG 0 SWC_OUTP_type_CM_uint32_raw32 0.0 4.294967295E+9 /end CHARACTERISTIC
/begin CHARACTERISTIC KOUTP_FLRUSSDTC_raw32_minval "" VALUE 0x0000 /* @ECU_Address@KOUTP_FLRUSSDTC_raw32_minval@ */ Scalar_ULONG 0 SWC_OUTP_type_CM_uint32_raw32 0.0 4.294967295E+9 /end CHARACTERISTIC
/begin CHARACTERISTIC KOUTP_FLRUSSDTC_raw32_ovrdval "" VALUE 0x0000 /* @ECU_Address@KOUTP_FLRUSSDTC_raw32_ovrdval@ */ Scalar_ULONG 0 SWC_OUTP_type_CM_uint32_raw32 0.0 4.294967295E+9 /end CHARACTERISTIC
/begin CHARACTERISTIC KOUTP_FMLUSSDTC_raw32_maxval "" VALUE 0x0000 /* @ECU_Address@KOUTP_FMLUSSDTC_raw32_maxval@ */ Scalar_ULONG 0 SWC_OUTP_type_CM_uint32_raw32 0.0 4.294967295E+9 /end CHARACTERISTIC
/begin CHARACTERISTIC KOUTP_FMLUSSDTC_raw32_minval "" VALUE 0x0000 /* @ECU_Address@KOUTP_FMLUSSDTC_raw32_minval@ */ Scalar_ULONG 0 SWC_OUTP_type_CM_uint32_raw32 0.0 4.294967295E+9 /end CHARACTERISTIC
/begin CHARACTERISTIC KOUTP_FMLUSSDTC_raw32_ovrdval "" VALUE 0x0000 /* @ECU_Address@KOUTP_FMLUSSDTC_raw32_ovrdval@ */ Scalar_ULONG 0 SWC_OUTP_type_CM_uint32_raw32 0.0 4.294967295E+9 /end CHARACTERISTIC
/begin CHARACTERISTIC KOUTP_FMRUSSDTC_raw32_maxval "" VALUE 0x0000 /* @ECU_Address@KOUTP_FMRUSSDTC_raw32_maxval@ */ Scalar_ULONG 0 SWC_OUTP_type_CM_uint32_raw32 0.0 4.294967295E+9 /end CHARACTERISTIC
/begin CHARACTERISTIC KOUTP_FMRUSSDTC_raw32_minval "" VALUE 0x0000 /* @ECU_Address@KOUTP_FMRUSSDTC_raw32_minval@ */ Scalar_ULONG 0 SWC_OUTP_type_CM_uint32_raw32 0.0 4.294967295E+9 /end CHARACTERISTIC
/begin CHARACTERISTIC KOUTP_FMRUSSDTC_raw32_ovrdval "" VALUE 0x0000 /* @ECU_Address@KOUTP_FMRUSSDTC_raw32_ovrdval@ */ Scalar_ULONG 0 SWC_OUTP_type_CM_uint32_raw32 0.0 4.294967295E+9 /end CHARACTERISTIC
/begin CHARACTERISTIC KOUTP_FRDoorSWDTC_raw32_maxval "" VALUE 0x0000 /* @ECU_Address@KOUTP_FRDoorSWDTC_raw32_maxval@ */ Scalar_ULONG 0 SWC_OUTP_type_CM_uint32_raw32 0.0 4.294967295E+9 /end CHARACTERISTIC
/begin CHARACTERISTIC KOUTP_FRDoorSWDTC_raw32_minval "" VALUE 0x0000 /* @ECU_Address@KOUTP_FRDoorSWDTC_raw32_minval@ */ Scalar_ULONG 0 SWC_OUTP_type_CM_uint32_raw32 0.0 4.294967295E+9 /end CHARACTERISTIC
/begin CHARACTERISTIC KOUTP_FRDoorSWDTC_raw32_ovrdval "" VALUE 0x0000 /* @ECU_Address@KOUTP_FRDoorSWDTC_raw32_ovrdval@ */ Scalar_ULONG 0 SWC_OUTP_type_CM_uint32_raw32 0.0 4.294967295E+9 /end CHARACTERISTIC
/begin CHARACTERISTIC KOUTP_FrMCUSigErrDetDTC_raw32_maxval "" VALUE 0x0000 /* @ECU_Address@KOUTP_FrMCUSigErrDetDTC_raw32_maxval@ */ Scalar_ULONG 0 SWC_OUTP_type_CM_uint32_raw32 0.0 4.294967295E+9 /end CHARACTERISTIC
/begin CHARACTERISTIC KOUTP_FrMCUSigErrDetDTC_raw32_minval "" VALUE 0x0000 /* @ECU_Address@KOUTP_FrMCUSigErrDetDTC_raw32_minval@ */ Scalar_ULONG 0 SWC_OUTP_type_CM_uint32_raw32 0.0 4.294967295E+9 /end CHARACTERISTIC
/begin CHARACTERISTIC KOUTP_FrMCUSigErrDetDTC_raw32_ovrdval "" VALUE 0x0000 /* @ECU_Address@KOUTP_FrMCUSigErrDetDTC_raw32_ovrdval@ */ Scalar_ULONG 0 SWC_OUTP_type_CM_uint32_raw32 0.0 4.294967295E+9 /end CHARACTERISTIC
/begin CHARACTERISTIC KOUTP_FrMCUTqErrDTC_raw32_maxval "" VALUE 0x0000 /* @ECU_Address@KOUTP_FrMCUTqErrDTC_raw32_maxval@ */ Scalar_ULONG 0 SWC_OUTP_type_CM_uint32_raw32 0.0 4.294967295E+9 /end CHARACTERISTIC
/begin CHARACTERISTIC KOUTP_FrMCUTqErrDTC_raw32_minval "" VALUE 0x0000 /* @ECU_Address@KOUTP_FrMCUTqErrDTC_raw32_minval@ */ Scalar_ULONG 0 SWC_OUTP_type_CM_uint32_raw32 0.0 4.294967295E+9 /end CHARACTERISTIC
/begin CHARACTERISTIC KOUTP_FrMCUTqErrDTC_raw32_ovrdval "" VALUE 0x0000 /* @ECU_Address@KOUTP_FrMCUTqErrDTC_raw32_ovrdval@ */ Scalar_ULONG 0 SWC_OUTP_type_CM_uint32_raw32 0.0 4.294967295E+9 /end CHARACTERISTIC
/begin CHARACTERISTIC KOUTP_HVB4PreDTC_raw32_maxval "" VALUE 0x0000 /* @ECU_Address@KOUTP_HVB4PreDTC_raw32_maxval@ */ Scalar_ULONG 0 SWC_OUTP_type_CM_uint32_raw32 0.0 4.294967295E+9 /end CHARACTERISTIC
/begin CHARACTERISTIC KOUTP_HVB4PreDTC_raw32_minval "" VALUE 0x0000 /* @ECU_Address@KOUTP_HVB4PreDTC_raw32_minval@ */ Scalar_ULONG 0 SWC_OUTP_type_CM_uint32_raw32 0.0 4.294967295E+9 /end CHARACTERISTIC
/begin CHARACTERISTIC KOUTP_HVB4PreDTC_raw32_ovrdval "" VALUE 0x0000 /* @ECU_Address@KOUTP_HVB4PreDTC_raw32_ovrdval@ */ Scalar_ULONG 0 SWC_OUTP_type_CM_uint32_raw32 0.0 4.294967295E+9 /end CHARACTERISTIC
/begin CHARACTERISTIC KOUTP_HVRlyCloDTC_raw32_maxval "" VALUE 0x0000 /* @ECU_Address@KOUTP_HVRlyCloDTC_raw32_maxval@ */ Scalar_ULONG 0 SWC_OUTP_type_CM_uint32_raw32 0.0 4.294967295E+9 /end CHARACTERISTIC
/begin CHARACTERISTIC KOUTP_HVRlyCloDTC_raw32_minval "" VALUE 0x0000 /* @ECU_Address@KOUTP_HVRlyCloDTC_raw32_minval@ */ Scalar_ULONG 0 SWC_OUTP_type_CM_uint32_raw32 0.0 4.294967295E+9 /end CHARACTERISTIC
/begin CHARACTERISTIC KOUTP_HVRlyCloDTC_raw32_ovrdval "" VALUE 0x0000 /* @ECU_Address@KOUTP_HVRlyCloDTC_raw32_ovrdval@ */ Scalar_ULONG 0 SWC_OUTP_type_CM_uint32_raw32 0.0 4.294967295E+9 /end CHARACTERISTIC
/begin CHARACTERISTIC KOUTP_HVRlyOpDTC_raw32_maxval "" VALUE 0x0000 /* @ECU_Address@KOUTP_HVRlyOpDTC_raw32_maxval@ */ Scalar_ULONG 0 SWC_OUTP_type_CM_uint32_raw32 0.0 4.294967295E+9 /end CHARACTERISTIC
/begin CHARACTERISTIC KOUTP_HVRlyOpDTC_raw32_minval "" VALUE 0x0000 /* @ECU_Address@KOUTP_HVRlyOpDTC_raw32_minval@ */ Scalar_ULONG 0 SWC_OUTP_type_CM_uint32_raw32 0.0 4.294967295E+9 /end CHARACTERISTIC
/begin CHARACTERISTIC KOUTP_HVRlyOpDTC_raw32_ovrdval "" VALUE 0x0000 /* @ECU_Address@KOUTP_HVRlyOpDTC_raw32_ovrdval@ */ Scalar_ULONG 0 SWC_OUTP_type_CM_uint32_raw32 0.0 4.294967295E+9 /end CHARACTERISTIC
/begin CHARACTERISTIC KOUTP_HiLvSaChkDTC_raw32_maxval "" VALUE 0x0000 /* @ECU_Address@KOUTP_HiLvSaChkDTC_raw32_maxval@ */ Scalar_ULONG 0 SWC_OUTP_type_CM_uint32_raw32 0.0 4.294967295E+9 /end CHARACTERISTIC
/begin CHARACTERISTIC KOUTP_HiLvSaChkDTC_raw32_minval "" VALUE 0x0000 /* @ECU_Address@KOUTP_HiLvSaChkDTC_raw32_minval@ */ Scalar_ULONG 0 SWC_OUTP_type_CM_uint32_raw32 0.0 4.294967295E+9 /end CHARACTERISTIC
/begin CHARACTERISTIC KOUTP_HiLvSaChkDTC_raw32_ovrdval "" VALUE 0x0000 /* @ECU_Address@KOUTP_HiLvSaChkDTC_raw32_ovrdval@ */ Scalar_ULONG 0 SWC_OUTP_type_CM_uint32_raw32 0.0 4.294967295E+9 /end CHARACTERISTIC
/begin CHARACTERISTIC KOUTP_HoodSWDTC_raw32_maxval "" VALUE 0x0000 /* @ECU_Address@KOUTP_HoodSWDTC_raw32_maxval@ */ Scalar_ULONG 0 SWC_OUTP_type_CM_uint32_raw32 0.0 4.294967295E+9 /end CHARACTERISTIC
/begin CHARACTERISTIC KOUTP_HoodSWDTC_raw32_minval "" VALUE 0x0000 /* @ECU_Address@KOUTP_HoodSWDTC_raw32_minval@ */ Scalar_ULONG 0 SWC_OUTP_type_CM_uint32_raw32 0.0 4.294967295E+9 /end CHARACTERISTIC
/begin CHARACTERISTIC KOUTP_HoodSWDTC_raw32_ovrdval "" VALUE 0x0000 /* @ECU_Address@KOUTP_HoodSWDTC_raw32_ovrdval@ */ Scalar_ULONG 0 SWC_OUTP_type_CM_uint32_raw32 0.0 4.294967295E+9 /end CHARACTERISTIC
/begin CHARACTERISTIC KOUTP_ISAMalfuncDetDTC_raw32_maxval "" VALUE 0x0000 /* @ECU_Address@KOUTP_ISAMalfuncDetDTC_raw32_maxval@ */ Scalar_ULONG 0 SWC_OUTP_type_CM_uint32_raw32 0.0 4.294967295E+9 /end CHARACTERISTIC
/begin CHARACTERISTIC KOUTP_ISAMalfuncDetDTC_raw32_minval "" VALUE 0x0000 /* @ECU_Address@KOUTP_ISAMalfuncDetDTC_raw32_minval@ */ Scalar_ULONG 0 SWC_OUTP_type_CM_uint32_raw32 0.0 4.294967295E+9 /end CHARACTERISTIC
/begin CHARACTERISTIC KOUTP_ISAMalfuncDetDTC_raw32_ovrdval "" VALUE 0x0000 /* @ECU_Address@KOUTP_ISAMalfuncDetDTC_raw32_ovrdval@ */ Scalar_ULONG 0 SWC_OUTP_type_CM_uint32_raw32 0.0 4.294967295E+9 /end CHARACTERISTIC
/begin CHARACTERISTIC KOUTP_IniLVLoDTC_raw32_maxval "" VALUE 0x0000 /* @ECU_Address@KOUTP_IniLVLoDTC_raw32_maxval@ */ Scalar_ULONG 0 SWC_OUTP_type_CM_uint32_raw32 0.0 4.294967295E+9 /end CHARACTERISTIC
/begin CHARACTERISTIC KOUTP_IniLVLoDTC_raw32_minval "" VALUE 0x0000 /* @ECU_Address@KOUTP_IniLVLoDTC_raw32_minval@ */ Scalar_ULONG 0 SWC_OUTP_type_CM_uint32_raw32 0.0 4.294967295E+9 /end CHARACTERISTIC
/begin CHARACTERISTIC KOUTP_IniLVLoDTC_raw32_ovrdval "" VALUE 0x0000 /* @ECU_Address@KOUTP_IniLVLoDTC_raw32_ovrdval@ */ Scalar_ULONG 0 SWC_OUTP_type_CM_uint32_raw32 0.0 4.294967295E+9 /end CHARACTERISTIC
/begin CHARACTERISTIC KOUTP_KeyAuthDTC_raw32_maxval "" VALUE 0x0000 /* @ECU_Address@KOUTP_KeyAuthDTC_raw32_maxval@ */ Scalar_ULONG 0 SWC_OUTP_type_CM_uint32_raw32 0.0 4.294967295E+9 /end CHARACTERISTIC
/begin CHARACTERISTIC KOUTP_KeyAuthDTC_raw32_minval "" VALUE 0x0000 /* @ECU_Address@KOUTP_KeyAuthDTC_raw32_minval@ */ Scalar_ULONG 0 SWC_OUTP_type_CM_uint32_raw32 0.0 4.294967295E+9 /end CHARACTERISTIC
/begin CHARACTERISTIC KOUTP_KeyAuthDTC_raw32_ovrdval "" VALUE 0x0000 /* @ECU_Address@KOUTP_KeyAuthDTC_raw32_ovrdval@ */ Scalar_ULONG 0 SWC_OUTP_type_CM_uint32_raw32 0.0 4.294967295E+9 /end CHARACTERISTIC
/begin CHARACTERISTIC KOUTP_LFBatwarnDTC_raw32_maxval "" VALUE 0x0000 /* @ECU_Address@KOUTP_LFBatwarnDTC_raw32_maxval@ */ Scalar_ULONG 0 SWC_OUTP_type_CM_uint32_raw32 0.0 4.294967295E+9 /end CHARACTERISTIC
/begin CHARACTERISTIC KOUTP_LFBatwarnDTC_raw32_minval "" VALUE 0x0000 /* @ECU_Address@KOUTP_LFBatwarnDTC_raw32_minval@ */ Scalar_ULONG 0 SWC_OUTP_type_CM_uint32_raw32 0.0 4.294967295E+9 /end CHARACTERISTIC
/begin CHARACTERISTIC KOUTP_LFBatwarnDTC_raw32_ovrdval "" VALUE 0x0000 /* @ECU_Address@KOUTP_LFBatwarnDTC_raw32_ovrdval@ */ Scalar_ULONG 0 SWC_OUTP_type_CM_uint32_raw32 0.0 4.294967295E+9 /end CHARACTERISTIC
/begin CHARACTERISTIC KOUTP_LFPressIndiDTC_raw32_maxval "" VALUE 0x0000 /* @ECU_Address@KOUTP_LFPressIndiDTC_raw32_maxval@ */ Scalar_ULONG 0 SWC_OUTP_type_CM_uint32_raw32 0.0 4.294967295E+9 /end CHARACTERISTIC
/begin CHARACTERISTIC KOUTP_LFPressIndiDTC_raw32_minval "" VALUE 0x0000 /* @ECU_Address@KOUTP_LFPressIndiDTC_raw32_minval@ */ Scalar_ULONG 0 SWC_OUTP_type_CM_uint32_raw32 0.0 4.294967295E+9 /end CHARACTERISTIC
/begin CHARACTERISTIC KOUTP_LFPressIndiDTC_raw32_ovrdval "" VALUE 0x0000 /* @ECU_Address@KOUTP_LFPressIndiDTC_raw32_ovrdval@ */ Scalar_ULONG 0 SWC_OUTP_type_CM_uint32_raw32 0.0 4.294967295E+9 /end CHARACTERISTIC
/begin CHARACTERISTIC KOUTP_LFSensorFailDTC_raw32_maxval "" VALUE 0x0000 /* @ECU_Address@KOUTP_LFSensorFailDTC_raw32_maxval@ */ Scalar_ULONG 0 SWC_OUTP_type_CM_uint32_raw32 0.0 4.294967295E+9 /end CHARACTERISTIC
/begin CHARACTERISTIC KOUTP_LFSensorFailDTC_raw32_minval "" VALUE 0x0000 /* @ECU_Address@KOUTP_LFSensorFailDTC_raw32_minval@ */ Scalar_ULONG 0 SWC_OUTP_type_CM_uint32_raw32 0.0 4.294967295E+9 /end CHARACTERISTIC
/begin CHARACTERISTIC KOUTP_LFSensorFailDTC_raw32_ovrdval "" VALUE 0x0000 /* @ECU_Address@KOUTP_LFSensorFailDTC_raw32_ovrdval@ */ Scalar_ULONG 0 SWC_OUTP_type_CM_uint32_raw32 0.0 4.294967295E+9 /end CHARACTERISTIC
/begin CHARACTERISTIC KOUTP_LFWheelTmpHighDTC_raw32_maxval "" VALUE 0x0000 /* @ECU_Address@KOUTP_LFWheelTmpHighDTC_raw32_maxval@ */ Scalar_ULONG 0 SWC_OUTP_type_CM_uint32_raw32 0.0 4.294967295E+9 /end CHARACTERISTIC
/begin CHARACTERISTIC KOUTP_LFWheelTmpHighDTC_raw32_minval "" VALUE 0x0000 /* @ECU_Address@KOUTP_LFWheelTmpHighDTC_raw32_minval@ */ Scalar_ULONG 0 SWC_OUTP_type_CM_uint32_raw32 0.0 4.294967295E+9 /end CHARACTERISTIC
/begin CHARACTERISTIC KOUTP_LFWheelTmpHighDTC_raw32_ovrdval "" VALUE 0x0000 /* @ECU_Address@KOUTP_LFWheelTmpHighDTC_raw32_ovrdval@ */ Scalar_ULONG 0 SWC_OUTP_type_CM_uint32_raw32 0.0 4.294967295E+9 /end CHARACTERISTIC
/begin CHARACTERISTIC KOUTP_LRBatwarnDTC_raw32_maxval "" VALUE 0x0000 /* @ECU_Address@KOUTP_LRBatwarnDTC_raw32_maxval@ */ Scalar_ULONG 0 SWC_OUTP_type_CM_uint32_raw32 0.0 4.294967295E+9 /end CHARACTERISTIC
/begin CHARACTERISTIC KOUTP_LRBatwarnDTC_raw32_minval "" VALUE 0x0000 /* @ECU_Address@KOUTP_LRBatwarnDTC_raw32_minval@ */ Scalar_ULONG 0 SWC_OUTP_type_CM_uint32_raw32 0.0 4.294967295E+9 /end CHARACTERISTIC
/begin CHARACTERISTIC KOUTP_LRBatwarnDTC_raw32_ovrdval "" VALUE 0x0000 /* @ECU_Address@KOUTP_LRBatwarnDTC_raw32_ovrdval@ */ Scalar_ULONG 0 SWC_OUTP_type_CM_uint32_raw32 0.0 4.294967295E+9 /end CHARACTERISTIC
/begin CHARACTERISTIC KOUTP_LRPressIndiDTC_raw32_maxval "" VALUE 0x0000 /* @ECU_Address@KOUTP_LRPressIndiDTC_raw32_maxval@ */ Scalar_ULONG 0 SWC_OUTP_type_CM_uint32_raw32 0.0 4.294967295E+9 /end CHARACTERISTIC
/begin CHARACTERISTIC KOUTP_LRPressIndiDTC_raw32_minval "" VALUE 0x0000 /* @ECU_Address@KOUTP_LRPressIndiDTC_raw32_minval@ */ Scalar_ULONG 0 SWC_OUTP_type_CM_uint32_raw32 0.0 4.294967295E+9 /end CHARACTERISTIC
/begin CHARACTERISTIC KOUTP_LRPressIndiDTC_raw32_ovrdval "" VALUE 0x0000 /* @ECU_Address@KOUTP_LRPressIndiDTC_raw32_ovrdval@ */ Scalar_ULONG 0 SWC_OUTP_type_CM_uint32_raw32 0.0 4.294967295E+9 /end CHARACTERISTIC
/begin CHARACTERISTIC KOUTP_LRSensorFailDTC_raw32_maxval "" VALUE 0x0000 /* @ECU_Address@KOUTP_LRSensorFailDTC_raw32_maxval@ */ Scalar_ULONG 0 SWC_OUTP_type_CM_uint32_raw32 0.0 4.294967295E+9 /end CHARACTERISTIC
/begin CHARACTERISTIC KOUTP_LRSensorFailDTC_raw32_minval "" VALUE 0x0000 /* @ECU_Address@KOUTP_LRSensorFailDTC_raw32_minval@ */ Scalar_ULONG 0 SWC_OUTP_type_CM_uint32_raw32 0.0 4.294967295E+9 /end CHARACTERISTIC
/begin CHARACTERISTIC KOUTP_LRSensorFailDTC_raw32_ovrdval "" VALUE 0x0000 /* @ECU_Address@KOUTP_LRSensorFailDTC_raw32_ovrdval@ */ Scalar_ULONG 0 SWC_OUTP_type_CM_uint32_raw32 0.0 4.294967295E+9 /end CHARACTERISTIC
/begin CHARACTERISTIC KOUTP_LRWheelTmpHighDTC_raw32_maxval "" VALUE 0x0000 /* @ECU_Address@KOUTP_LRWheelTmpHighDTC_raw32_maxval@ */ Scalar_ULONG 0 SWC_OUTP_type_CM_uint32_raw32 0.0 4.294967295E+9 /end CHARACTERISTIC
/begin CHARACTERISTIC KOUTP_LRWheelTmpHighDTC_raw32_minval "" VALUE 0x0000 /* @ECU_Address@KOUTP_LRWheelTmpHighDTC_raw32_minval@ */ Scalar_ULONG 0 SWC_OUTP_type_CM_uint32_raw32 0.0 4.294967295E+9 /end CHARACTERISTIC
/begin CHARACTERISTIC KOUTP_LRWheelTmpHighDTC_raw32_ovrdval "" VALUE 0x0000 /* @ECU_Address@KOUTP_LRWheelTmpHighDTC_raw32_ovrdval@ */ Scalar_ULONG 0 SWC_OUTP_type_CM_uint32_raw32 0.0 4.294967295E+9 /end CHARACTERISTIC
/begin CHARACTERISTIC KOUTP_LVSupHiDTC_raw32_maxval "" VALUE 0x0000 /* @ECU_Address@KOUTP_LVSupHiDTC_raw32_maxval@ */ Scalar_ULONG 0 SWC_OUTP_type_CM_uint32_raw32 0.0 4.294967295E+9 /end CHARACTERISTIC
/begin CHARACTERISTIC KOUTP_LVSupHiDTC_raw32_minval "" VALUE 0x0000 /* @ECU_Address@KOUTP_LVSupHiDTC_raw32_minval@ */ Scalar_ULONG 0 SWC_OUTP_type_CM_uint32_raw32 0.0 4.294967295E+9 /end CHARACTERISTIC
/begin CHARACTERISTIC KOUTP_LVSupHiDTC_raw32_ovrdval "" VALUE 0x0000 /* @ECU_Address@KOUTP_LVSupHiDTC_raw32_ovrdval@ */ Scalar_ULONG 0 SWC_OUTP_type_CM_uint32_raw32 0.0 4.294967295E+9 /end CHARACTERISTIC
/begin CHARACTERISTIC KOUTP_LVSupLoDTC_raw32_maxval "" VALUE 0x0000 /* @ECU_Address@KOUTP_LVSupLoDTC_raw32_maxval@ */ Scalar_ULONG 0 SWC_OUTP_type_CM_uint32_raw32 0.0 4.294967295E+9 /end CHARACTERISTIC
/begin CHARACTERISTIC KOUTP_LVSupLoDTC_raw32_minval "" VALUE 0x0000 /* @ECU_Address@KOUTP_LVSupLoDTC_raw32_minval@ */ Scalar_ULONG 0 SWC_OUTP_type_CM_uint32_raw32 0.0 4.294967295E+9 /end CHARACTERISTIC
/begin CHARACTERISTIC KOUTP_LVSupLoDTC_raw32_ovrdval "" VALUE 0x0000 /* @ECU_Address@KOUTP_LVSupLoDTC_raw32_ovrdval@ */ Scalar_ULONG 0 SWC_OUTP_type_CM_uint32_raw32 0.0 4.294967295E+9 /end CHARACTERISTIC
/begin CHARACTERISTIC KOUTP_Lv1ErrDTC_raw32_maxval "" VALUE 0x0000 /* @ECU_Address@KOUTP_Lv1ErrDTC_raw32_maxval@ */ Scalar_ULONG 0 SWC_OUTP_type_CM_uint32_raw32 0.0 4.294967295E+9 /end CHARACTERISTIC
/begin CHARACTERISTIC KOUTP_Lv1ErrDTC_raw32_minval "" VALUE 0x0000 /* @ECU_Address@KOUTP_Lv1ErrDTC_raw32_minval@ */ Scalar_ULONG 0 SWC_OUTP_type_CM_uint32_raw32 0.0 4.294967295E+9 /end CHARACTERISTIC
/begin CHARACTERISTIC KOUTP_Lv1ErrDTC_raw32_ovrdval "" VALUE 0x0000 /* @ECU_Address@KOUTP_Lv1ErrDTC_raw32_ovrdval@ */ Scalar_ULONG 0 SWC_OUTP_type_CM_uint32_raw32 0.0 4.294967295E+9 /end CHARACTERISTIC
/begin CHARACTERISTIC KOUTP_Lv2ErrDTC_raw32_maxval "" VALUE 0x0000 /* @ECU_Address@KOUTP_Lv2ErrDTC_raw32_maxval@ */ Scalar_ULONG 0 SWC_OUTP_type_CM_uint32_raw32 0.0 4.294967295E+9 /end CHARACTERISTIC
/begin CHARACTERISTIC KOUTP_Lv2ErrDTC_raw32_minval "" VALUE 0x0000 /* @ECU_Address@KOUTP_Lv2ErrDTC_raw32_minval@ */ Scalar_ULONG 0 SWC_OUTP_type_CM_uint32_raw32 0.0 4.294967295E+9 /end CHARACTERISTIC
/begin CHARACTERISTIC KOUTP_Lv2ErrDTC_raw32_ovrdval "" VALUE 0x0000 /* @ECU_Address@KOUTP_Lv2ErrDTC_raw32_ovrdval@ */ Scalar_ULONG 0 SWC_OUTP_type_CM_uint32_raw32 0.0 4.294967295E+9 /end CHARACTERISTIC
/begin CHARACTERISTIC KOUTP_Lv3ErrDTC_raw32_maxval "" VALUE 0x0000 /* @ECU_Address@KOUTP_Lv3ErrDTC_raw32_maxval@ */ Scalar_ULONG 0 SWC_OUTP_type_CM_uint32_raw32 0.0 4.294967295E+9 /end CHARACTERISTIC
/begin CHARACTERISTIC KOUTP_Lv3ErrDTC_raw32_minval "" VALUE 0x0000 /* @ECU_Address@KOUTP_Lv3ErrDTC_raw32_minval@ */ Scalar_ULONG 0 SWC_OUTP_type_CM_uint32_raw32 0.0 4.294967295E+9 /end CHARACTERISTIC
/begin CHARACTERISTIC KOUTP_Lv3ErrDTC_raw32_ovrdval "" VALUE 0x0000 /* @ECU_Address@KOUTP_Lv3ErrDTC_raw32_ovrdval@ */ Scalar_ULONG 0 SWC_OUTP_type_CM_uint32_raw32 0.0 4.294967295E+9 /end CHARACTERISTIC
/begin CHARACTERISTIC KOUTP_Lv4ErrDTC_raw32_maxval "" VALUE 0x0000 /* @ECU_Address@KOUTP_Lv4ErrDTC_raw32_maxval@ */ Scalar_ULONG 0 SWC_OUTP_type_CM_uint32_raw32 0.0 4.294967295E+9 /end CHARACTERISTIC
/begin CHARACTERISTIC KOUTP_Lv4ErrDTC_raw32_minval "" VALUE 0x0000 /* @ECU_Address@KOUTP_Lv4ErrDTC_raw32_minval@ */ Scalar_ULONG 0 SWC_OUTP_type_CM_uint32_raw32 0.0 4.294967295E+9 /end CHARACTERISTIC
/begin CHARACTERISTIC KOUTP_Lv4ErrDTC_raw32_ovrdval "" VALUE 0x0000 /* @ECU_Address@KOUTP_Lv4ErrDTC_raw32_ovrdval@ */ Scalar_ULONG 0 SWC_OUTP_type_CM_uint32_raw32 0.0 4.294967295E+9 /end CHARACTERISTIC
/begin CHARACTERISTIC KOUTP_MCU4PreDTC_raw32_maxval "" VALUE 0x0000 /* @ECU_Address@KOUTP_MCU4PreDTC_raw32_maxval@ */ Scalar_ULONG 0 SWC_OUTP_type_CM_uint32_raw32 0.0 4.294967295E+9 /end CHARACTERISTIC
/begin CHARACTERISTIC KOUTP_MCU4PreDTC_raw32_minval "" VALUE 0x0000 /* @ECU_Address@KOUTP_MCU4PreDTC_raw32_minval@ */ Scalar_ULONG 0 SWC_OUTP_type_CM_uint32_raw32 0.0 4.294967295E+9 /end CHARACTERISTIC
/begin CHARACTERISTIC KOUTP_MCU4PreDTC_raw32_ovrdval "" VALUE 0x0000 /* @ECU_Address@KOUTP_MCU4PreDTC_raw32_ovrdval@ */ Scalar_ULONG 0 SWC_OUTP_type_CM_uint32_raw32 0.0 4.294967295E+9 /end CHARACTERISTIC
/begin CHARACTERISTIC KOUTP_MCUActDTC_raw32_maxval "" VALUE 0x0000 /* @ECU_Address@KOUTP_MCUActDTC_raw32_maxval@ */ Scalar_ULONG 0 SWC_OUTP_type_CM_uint32_raw32 0.0 4.294967295E+9 /end CHARACTERISTIC
/begin CHARACTERISTIC KOUTP_MCUActDTC_raw32_minval "" VALUE 0x0000 /* @ECU_Address@KOUTP_MCUActDTC_raw32_minval@ */ Scalar_ULONG 0 SWC_OUTP_type_CM_uint32_raw32 0.0 4.294967295E+9 /end CHARACTERISTIC
/begin CHARACTERISTIC KOUTP_MCUActDTC_raw32_ovrdval "" VALUE 0x0000 /* @ECU_Address@KOUTP_MCUActDTC_raw32_ovrdval@ */ Scalar_ULONG 0 SWC_OUTP_type_CM_uint32_raw32 0.0 4.294967295E+9 /end CHARACTERISTIC
/begin CHARACTERISTIC KOUTP_MCUDisDTC_raw32_maxval "" VALUE 0x0000 /* @ECU_Address@KOUTP_MCUDisDTC_raw32_maxval@ */ Scalar_ULONG 0 SWC_OUTP_type_CM_uint32_raw32 0.0 4.294967295E+9 /end CHARACTERISTIC
/begin CHARACTERISTIC KOUTP_MCUDisDTC_raw32_minval "" VALUE 0x0000 /* @ECU_Address@KOUTP_MCUDisDTC_raw32_minval@ */ Scalar_ULONG 0 SWC_OUTP_type_CM_uint32_raw32 0.0 4.294967295E+9 /end CHARACTERISTIC
/begin CHARACTERISTIC KOUTP_MCUDisDTC_raw32_ovrdval "" VALUE 0x0000 /* @ECU_Address@KOUTP_MCUDisDTC_raw32_ovrdval@ */ Scalar_ULONG 0 SWC_OUTP_type_CM_uint32_raw32 0.0 4.294967295E+9 /end CHARACTERISTIC
/begin CHARACTERISTIC KOUTP_MCUF1CSErrDTC_raw32_maxval "" VALUE 0x0000 /* @ECU_Address@KOUTP_MCUF1CSErrDTC_raw32_maxval@ */ Scalar_ULONG 0 SWC_OUTP_type_CM_uint32_raw32 0.0 4.294967295E+9 /end CHARACTERISTIC
/begin CHARACTERISTIC KOUTP_MCUF1CSErrDTC_raw32_minval "" VALUE 0x0000 /* @ECU_Address@KOUTP_MCUF1CSErrDTC_raw32_minval@ */ Scalar_ULONG 0 SWC_OUTP_type_CM_uint32_raw32 0.0 4.294967295E+9 /end CHARACTERISTIC
/begin CHARACTERISTIC KOUTP_MCUF1CSErrDTC_raw32_ovrdval "" VALUE 0x0000 /* @ECU_Address@KOUTP_MCUF1CSErrDTC_raw32_ovrdval@ */ Scalar_ULONG 0 SWC_OUTP_type_CM_uint32_raw32 0.0 4.294967295E+9 /end CHARACTERISTIC
/begin CHARACTERISTIC KOUTP_MCUF1NoComDTC_raw32_maxval "" VALUE 0x0000 /* @ECU_Address@KOUTP_MCUF1NoComDTC_raw32_maxval@ */ Scalar_ULONG 0 SWC_OUTP_type_CM_uint32_raw32 0.0 4.294967295E+9 /end CHARACTERISTIC
/begin CHARACTERISTIC KOUTP_MCUF1NoComDTC_raw32_minval "" VALUE 0x0000 /* @ECU_Address@KOUTP_MCUF1NoComDTC_raw32_minval@ */ Scalar_ULONG 0 SWC_OUTP_type_CM_uint32_raw32 0.0 4.294967295E+9 /end CHARACTERISTIC
/begin CHARACTERISTIC KOUTP_MCUF1NoComDTC_raw32_ovrdval "" VALUE 0x0000 /* @ECU_Address@KOUTP_MCUF1NoComDTC_raw32_ovrdval@ */ Scalar_ULONG 0 SWC_OUTP_type_CM_uint32_raw32 0.0 4.294967295E+9 /end CHARACTERISTIC
/begin CHARACTERISTIC KOUTP_MCUF1RCErrDTC_raw32_maxval "" VALUE 0x0000 /* @ECU_Address@KOUTP_MCUF1RCErrDTC_raw32_maxval@ */ Scalar_ULONG 0 SWC_OUTP_type_CM_uint32_raw32 0.0 4.294967295E+9 /end CHARACTERISTIC
/begin CHARACTERISTIC KOUTP_MCUF1RCErrDTC_raw32_minval "" VALUE 0x0000 /* @ECU_Address@KOUTP_MCUF1RCErrDTC_raw32_minval@ */ Scalar_ULONG 0 SWC_OUTP_type_CM_uint32_raw32 0.0 4.294967295E+9 /end CHARACTERISTIC
/begin CHARACTERISTIC KOUTP_MCUF1RCErrDTC_raw32_ovrdval "" VALUE 0x0000 /* @ECU_Address@KOUTP_MCUF1RCErrDTC_raw32_ovrdval@ */ Scalar_ULONG 0 SWC_OUTP_type_CM_uint32_raw32 0.0 4.294967295E+9 /end CHARACTERISTIC
/begin CHARACTERISTIC KOUTP_MCUR1CSErrDTC_raw32_maxval "" VALUE 0x0000 /* @ECU_Address@KOUTP_MCUR1CSErrDTC_raw32_maxval@ */ Scalar_ULONG 0 SWC_OUTP_type_CM_uint32_raw32 0.0 4.294967295E+9 /end CHARACTERISTIC
/begin CHARACTERISTIC KOUTP_MCUR1CSErrDTC_raw32_minval "" VALUE 0x0000 /* @ECU_Address@KOUTP_MCUR1CSErrDTC_raw32_minval@ */ Scalar_ULONG 0 SWC_OUTP_type_CM_uint32_raw32 0.0 4.294967295E+9 /end CHARACTERISTIC
/begin CHARACTERISTIC KOUTP_MCUR1CSErrDTC_raw32_ovrdval "" VALUE 0x0000 /* @ECU_Address@KOUTP_MCUR1CSErrDTC_raw32_ovrdval@ */ Scalar_ULONG 0 SWC_OUTP_type_CM_uint32_raw32 0.0 4.294967295E+9 /end CHARACTERISTIC
/begin CHARACTERISTIC KOUTP_MCUR1NoComDTC_raw32_maxval "" VALUE 0x0000 /* @ECU_Address@KOUTP_MCUR1NoComDTC_raw32_maxval@ */ Scalar_ULONG 0 SWC_OUTP_type_CM_uint32_raw32 0.0 4.294967295E+9 /end CHARACTERISTIC
/begin CHARACTERISTIC KOUTP_MCUR1NoComDTC_raw32_minval "" VALUE 0x0000 /* @ECU_Address@KOUTP_MCUR1NoComDTC_raw32_minval@ */ Scalar_ULONG 0 SWC_OUTP_type_CM_uint32_raw32 0.0 4.294967295E+9 /end CHARACTERISTIC
/begin CHARACTERISTIC KOUTP_MCUR1NoComDTC_raw32_ovrdval "" VALUE 0x0000 /* @ECU_Address@KOUTP_MCUR1NoComDTC_raw32_ovrdval@ */ Scalar_ULONG 0 SWC_OUTP_type_CM_uint32_raw32 0.0 4.294967295E+9 /end CHARACTERISTIC
/begin CHARACTERISTIC KOUTP_MCUR1RCErrDTC_raw32_maxval "" VALUE 0x0000 /* @ECU_Address@KOUTP_MCUR1RCErrDTC_raw32_maxval@ */ Scalar_ULONG 0 SWC_OUTP_type_CM_uint32_raw32 0.0 4.294967295E+9 /end CHARACTERISTIC
/begin CHARACTERISTIC KOUTP_MCUR1RCErrDTC_raw32_minval "" VALUE 0x0000 /* @ECU_Address@KOUTP_MCUR1RCErrDTC_raw32_minval@ */ Scalar_ULONG 0 SWC_OUTP_type_CM_uint32_raw32 0.0 4.294967295E+9 /end CHARACTERISTIC
/begin CHARACTERISTIC KOUTP_MCUR1RCErrDTC_raw32_ovrdval "" VALUE 0x0000 /* @ECU_Address@KOUTP_MCUR1RCErrDTC_raw32_ovrdval@ */ Scalar_ULONG 0 SWC_OUTP_type_CM_uint32_raw32 0.0 4.294967295E+9 /end CHARACTERISTIC
/begin CHARACTERISTIC KOUTP_MSAMalfuncDetDTC_raw32_maxval "" VALUE 0x0000 /* @ECU_Address@KOUTP_MSAMalfuncDetDTC_raw32_maxval@ */ Scalar_ULONG 0 SWC_OUTP_type_CM_uint32_raw32 0.0 4.294967295E+9 /end CHARACTERISTIC
/begin CHARACTERISTIC KOUTP_MSAMalfuncDetDTC_raw32_minval "" VALUE 0x0000 /* @ECU_Address@KOUTP_MSAMalfuncDetDTC_raw32_minval@ */ Scalar_ULONG 0 SWC_OUTP_type_CM_uint32_raw32 0.0 4.294967295E+9 /end CHARACTERISTIC
/begin CHARACTERISTIC KOUTP_MSAMalfuncDetDTC_raw32_ovrdval "" VALUE 0x0000 /* @ECU_Address@KOUTP_MSAMalfuncDetDTC_raw32_ovrdval@ */ Scalar_ULONG 0 SWC_OUTP_type_CM_uint32_raw32 0.0 4.294967295E+9 /end CHARACTERISTIC
/begin CHARACTERISTIC KOUTP_MidLvSaChkDTC_raw32_maxval "" VALUE 0x0000 /* @ECU_Address@KOUTP_MidLvSaChkDTC_raw32_maxval@ */ Scalar_ULONG 0 SWC_OUTP_type_CM_uint32_raw32 0.0 4.294967295E+9 /end CHARACTERISTIC
/begin CHARACTERISTIC KOUTP_MidLvSaChkDTC_raw32_minval "" VALUE 0x0000 /* @ECU_Address@KOUTP_MidLvSaChkDTC_raw32_minval@ */ Scalar_ULONG 0 SWC_OUTP_type_CM_uint32_raw32 0.0 4.294967295E+9 /end CHARACTERISTIC
/begin CHARACTERISTIC KOUTP_MidLvSaChkDTC_raw32_ovrdval "" VALUE 0x0000 /* @ECU_Address@KOUTP_MidLvSaChkDTC_raw32_ovrdval@ */ Scalar_ULONG 0 SWC_OUTP_type_CM_uint32_raw32 0.0 4.294967295E+9 /end CHARACTERISTIC
/begin CHARACTERISTIC KOUTP_OBC4PreDTC_raw32_maxval "" VALUE 0x0000 /* @ECU_Address@KOUTP_OBC4PreDTC_raw32_maxval@ */ Scalar_ULONG 0 SWC_OUTP_type_CM_uint32_raw32 0.0 4.294967295E+9 /end CHARACTERISTIC
/begin CHARACTERISTIC KOUTP_OBC4PreDTC_raw32_minval "" VALUE 0x0000 /* @ECU_Address@KOUTP_OBC4PreDTC_raw32_minval@ */ Scalar_ULONG 0 SWC_OUTP_type_CM_uint32_raw32 0.0 4.294967295E+9 /end CHARACTERISTIC
/begin CHARACTERISTIC KOUTP_OBC4PreDTC_raw32_ovrdval "" VALUE 0x0000 /* @ECU_Address@KOUTP_OBC4PreDTC_raw32_ovrdval@ */ Scalar_ULONG 0 SWC_OUTP_type_CM_uint32_raw32 0.0 4.294967295E+9 /end CHARACTERISTIC
/begin CHARACTERISTIC KOUTP_ONtoRdyDTC_raw32_maxval "" VALUE 0x0000 /* @ECU_Address@KOUTP_ONtoRdyDTC_raw32_maxval@ */ Scalar_ULONG 0 SWC_OUTP_type_CM_uint32_raw32 0.0 4.294967295E+9 /end CHARACTERISTIC
/begin CHARACTERISTIC KOUTP_ONtoRdyDTC_raw32_minval "" VALUE 0x0000 /* @ECU_Address@KOUTP_ONtoRdyDTC_raw32_minval@ */ Scalar_ULONG 0 SWC_OUTP_type_CM_uint32_raw32 0.0 4.294967295E+9 /end CHARACTERISTIC
/begin CHARACTERISTIC KOUTP_ONtoRdyDTC_raw32_ovrdval "" VALUE 0x0000 /* @ECU_Address@KOUTP_ONtoRdyDTC_raw32_ovrdval@ */ Scalar_ULONG 0 SWC_OUTP_type_CM_uint32_raw32 0.0 4.294967295E+9 /end CHARACTERISTIC
/begin CHARACTERISTIC KOUTP_RCLUSSDTC_raw32_maxval "" VALUE 0x0000 /* @ECU_Address@KOUTP_RCLUSSDTC_raw32_maxval@ */ Scalar_ULONG 0 SWC_OUTP_type_CM_uint32_raw32 0.0 4.294967295E+9 /end CHARACTERISTIC
/begin CHARACTERISTIC KOUTP_RCLUSSDTC_raw32_minval "" VALUE 0x0000 /* @ECU_Address@KOUTP_RCLUSSDTC_raw32_minval@ */ Scalar_ULONG 0 SWC_OUTP_type_CM_uint32_raw32 0.0 4.294967295E+9 /end CHARACTERISTIC
/begin CHARACTERISTIC KOUTP_RCLUSSDTC_raw32_ovrdval "" VALUE 0x0000 /* @ECU_Address@KOUTP_RCLUSSDTC_raw32_ovrdval@ */ Scalar_ULONG 0 SWC_OUTP_type_CM_uint32_raw32 0.0 4.294967295E+9 /end CHARACTERISTIC
/begin CHARACTERISTIC KOUTP_RCRUSSDTC_raw32_maxval "" VALUE 0x0000 /* @ECU_Address@KOUTP_RCRUSSDTC_raw32_maxval@ */ Scalar_ULONG 0 SWC_OUTP_type_CM_uint32_raw32 0.0 4.294967295E+9 /end CHARACTERISTIC
/begin CHARACTERISTIC KOUTP_RCRUSSDTC_raw32_minval "" VALUE 0x0000 /* @ECU_Address@KOUTP_RCRUSSDTC_raw32_minval@ */ Scalar_ULONG 0 SWC_OUTP_type_CM_uint32_raw32 0.0 4.294967295E+9 /end CHARACTERISTIC
/begin CHARACTERISTIC KOUTP_RCRUSSDTC_raw32_ovrdval "" VALUE 0x0000 /* @ECU_Address@KOUTP_RCRUSSDTC_raw32_ovrdval@ */ Scalar_ULONG 0 SWC_OUTP_type_CM_uint32_raw32 0.0 4.294967295E+9 /end CHARACTERISTIC
/begin CHARACTERISTIC KOUTP_RFBatwarnDTC_raw32_maxval "" VALUE 0x0000 /* @ECU_Address@KOUTP_RFBatwarnDTC_raw32_maxval@ */ Scalar_ULONG 0 SWC_OUTP_type_CM_uint32_raw32 0.0 4.294967295E+9 /end CHARACTERISTIC
/begin CHARACTERISTIC KOUTP_RFBatwarnDTC_raw32_minval "" VALUE 0x0000 /* @ECU_Address@KOUTP_RFBatwarnDTC_raw32_minval@ */ Scalar_ULONG 0 SWC_OUTP_type_CM_uint32_raw32 0.0 4.294967295E+9 /end CHARACTERISTIC
/begin CHARACTERISTIC KOUTP_RFBatwarnDTC_raw32_ovrdval "" VALUE 0x0000 /* @ECU_Address@KOUTP_RFBatwarnDTC_raw32_ovrdval@ */ Scalar_ULONG 0 SWC_OUTP_type_CM_uint32_raw32 0.0 4.294967295E+9 /end CHARACTERISTIC
/begin CHARACTERISTIC KOUTP_RFPressIndiDTC_raw32_maxval "" VALUE 0x0000 /* @ECU_Address@KOUTP_RFPressIndiDTC_raw32_maxval@ */ Scalar_ULONG 0 SWC_OUTP_type_CM_uint32_raw32 0.0 4.294967295E+9 /end CHARACTERISTIC
/begin CHARACTERISTIC KOUTP_RFPressIndiDTC_raw32_minval "" VALUE 0x0000 /* @ECU_Address@KOUTP_RFPressIndiDTC_raw32_minval@ */ Scalar_ULONG 0 SWC_OUTP_type_CM_uint32_raw32 0.0 4.294967295E+9 /end CHARACTERISTIC
/begin CHARACTERISTIC KOUTP_RFPressIndiDTC_raw32_ovrdval "" VALUE 0x0000 /* @ECU_Address@KOUTP_RFPressIndiDTC_raw32_ovrdval@ */ Scalar_ULONG 0 SWC_OUTP_type_CM_uint32_raw32 0.0 4.294967295E+9 /end CHARACTERISTIC
/begin CHARACTERISTIC KOUTP_RFSensorFailDTC_raw32_maxval "" VALUE 0x0000 /* @ECU_Address@KOUTP_RFSensorFailDTC_raw32_maxval@ */ Scalar_ULONG 0 SWC_OUTP_type_CM_uint32_raw32 0.0 4.294967295E+9 /end CHARACTERISTIC
/begin CHARACTERISTIC KOUTP_RFSensorFailDTC_raw32_minval "" VALUE 0x0000 /* @ECU_Address@KOUTP_RFSensorFailDTC_raw32_minval@ */ Scalar_ULONG 0 SWC_OUTP_type_CM_uint32_raw32 0.0 4.294967295E+9 /end CHARACTERISTIC
/begin CHARACTERISTIC KOUTP_RFSensorFailDTC_raw32_ovrdval "" VALUE 0x0000 /* @ECU_Address@KOUTP_RFSensorFailDTC_raw32_ovrdval@ */ Scalar_ULONG 0 SWC_OUTP_type_CM_uint32_raw32 0.0 4.294967295E+9 /end CHARACTERISTIC
/begin CHARACTERISTIC KOUTP_RFWheelTmpHighDTC_raw32_maxval "" VALUE 0x0000 /* @ECU_Address@KOUTP_RFWheelTmpHighDTC_raw32_maxval@ */ Scalar_ULONG 0 SWC_OUTP_type_CM_uint32_raw32 0.0 4.294967295E+9 /end CHARACTERISTIC
/begin CHARACTERISTIC KOUTP_RFWheelTmpHighDTC_raw32_minval "" VALUE 0x0000 /* @ECU_Address@KOUTP_RFWheelTmpHighDTC_raw32_minval@ */ Scalar_ULONG 0 SWC_OUTP_type_CM_uint32_raw32 0.0 4.294967295E+9 /end CHARACTERISTIC
/begin CHARACTERISTIC KOUTP_RFWheelTmpHighDTC_raw32_ovrdval "" VALUE 0x0000 /* @ECU_Address@KOUTP_RFWheelTmpHighDTC_raw32_ovrdval@ */ Scalar_ULONG 0 SWC_OUTP_type_CM_uint32_raw32 0.0 4.294967295E+9 /end CHARACTERISTIC
/begin CHARACTERISTIC KOUTP_RLDoorSWDTC_raw32_maxval "" VALUE 0x0000 /* @ECU_Address@KOUTP_RLDoorSWDTC_raw32_maxval@ */ Scalar_ULONG 0 SWC_OUTP_type_CM_uint32_raw32 0.0 4.294967295E+9 /end CHARACTERISTIC
/begin CHARACTERISTIC KOUTP_RLDoorSWDTC_raw32_minval "" VALUE 0x0000 /* @ECU_Address@KOUTP_RLDoorSWDTC_raw32_minval@ */ Scalar_ULONG 0 SWC_OUTP_type_CM_uint32_raw32 0.0 4.294967295E+9 /end CHARACTERISTIC
/begin CHARACTERISTIC KOUTP_RLDoorSWDTC_raw32_ovrdval "" VALUE 0x0000 /* @ECU_Address@KOUTP_RLDoorSWDTC_raw32_ovrdval@ */ Scalar_ULONG 0 SWC_OUTP_type_CM_uint32_raw32 0.0 4.294967295E+9 /end CHARACTERISTIC
/begin CHARACTERISTIC KOUTP_RLLUSSDTC_raw32_maxval "" VALUE 0x0000 /* @ECU_Address@KOUTP_RLLUSSDTC_raw32_maxval@ */ Scalar_ULONG 0 SWC_OUTP_type_CM_uint32_raw32 0.0 4.294967295E+9 /end CHARACTERISTIC
/begin CHARACTERISTIC KOUTP_RLLUSSDTC_raw32_minval "" VALUE 0x0000 /* @ECU_Address@KOUTP_RLLUSSDTC_raw32_minval@ */ Scalar_ULONG 0 SWC_OUTP_type_CM_uint32_raw32 0.0 4.294967295E+9 /end CHARACTERISTIC
/begin CHARACTERISTIC KOUTP_RLLUSSDTC_raw32_ovrdval "" VALUE 0x0000 /* @ECU_Address@KOUTP_RLLUSSDTC_raw32_ovrdval@ */ Scalar_ULONG 0 SWC_OUTP_type_CM_uint32_raw32 0.0 4.294967295E+9 /end CHARACTERISTIC
/begin CHARACTERISTIC KOUTP_RLRUSSDTC_raw32_maxval "" VALUE 0x0000 /* @ECU_Address@KOUTP_RLRUSSDTC_raw32_maxval@ */ Scalar_ULONG 0 SWC_OUTP_type_CM_uint32_raw32 0.0 4.294967295E+9 /end CHARACTERISTIC
/begin CHARACTERISTIC KOUTP_RLRUSSDTC_raw32_minval "" VALUE 0x0000 /* @ECU_Address@KOUTP_RLRUSSDTC_raw32_minval@ */ Scalar_ULONG 0 SWC_OUTP_type_CM_uint32_raw32 0.0 4.294967295E+9 /end CHARACTERISTIC
/begin CHARACTERISTIC KOUTP_RLRUSSDTC_raw32_ovrdval "" VALUE 0x0000 /* @ECU_Address@KOUTP_RLRUSSDTC_raw32_ovrdval@ */ Scalar_ULONG 0 SWC_OUTP_type_CM_uint32_raw32 0.0 4.294967295E+9 /end CHARACTERISTIC
/begin CHARACTERISTIC KOUTP_RMLUSSDTC_raw32_maxval "" VALUE 0x0000 /* @ECU_Address@KOUTP_RMLUSSDTC_raw32_maxval@ */ Scalar_ULONG 0 SWC_OUTP_type_CM_uint32_raw32 0.0 4.294967295E+9 /end CHARACTERISTIC
/begin CHARACTERISTIC KOUTP_RMLUSSDTC_raw32_minval "" VALUE 0x0000 /* @ECU_Address@KOUTP_RMLUSSDTC_raw32_minval@ */ Scalar_ULONG 0 SWC_OUTP_type_CM_uint32_raw32 0.0 4.294967295E+9 /end CHARACTERISTIC
/begin CHARACTERISTIC KOUTP_RMLUSSDTC_raw32_ovrdval "" VALUE 0x0000 /* @ECU_Address@KOUTP_RMLUSSDTC_raw32_ovrdval@ */ Scalar_ULONG 0 SWC_OUTP_type_CM_uint32_raw32 0.0 4.294967295E+9 /end CHARACTERISTIC
/begin CHARACTERISTIC KOUTP_RMRUSSDTC_raw32_maxval "" VALUE 0x0000 /* @ECU_Address@KOUTP_RMRUSSDTC_raw32_maxval@ */ Scalar_ULONG 0 SWC_OUTP_type_CM_uint32_raw32 0.0 4.294967295E+9 /end CHARACTERISTIC
/begin CHARACTERISTIC KOUTP_RMRUSSDTC_raw32_minval "" VALUE 0x0000 /* @ECU_Address@KOUTP_RMRUSSDTC_raw32_minval@ */ Scalar_ULONG 0 SWC_OUTP_type_CM_uint32_raw32 0.0 4.294967295E+9 /end CHARACTERISTIC
/begin CHARACTERISTIC KOUTP_RMRUSSDTC_raw32_ovrdval "" VALUE 0x0000 /* @ECU_Address@KOUTP_RMRUSSDTC_raw32_ovrdval@ */ Scalar_ULONG 0 SWC_OUTP_type_CM_uint32_raw32 0.0 4.294967295E+9 /end CHARACTERISTIC
/begin CHARACTERISTIC KOUTP_RRBatwarnDTC_raw32_maxval "" VALUE 0x0000 /* @ECU_Address@KOUTP_RRBatwarnDTC_raw32_maxval@ */ Scalar_ULONG 0 SWC_OUTP_type_CM_uint32_raw32 0.0 4.294967295E+9 /end CHARACTERISTIC
/begin CHARACTERISTIC KOUTP_RRBatwarnDTC_raw32_minval "" VALUE 0x0000 /* @ECU_Address@KOUTP_RRBatwarnDTC_raw32_minval@ */ Scalar_ULONG 0 SWC_OUTP_type_CM_uint32_raw32 0.0 4.294967295E+9 /end CHARACTERISTIC
/begin CHARACTERISTIC KOUTP_RRBatwarnDTC_raw32_ovrdval "" VALUE 0x0000 /* @ECU_Address@KOUTP_RRBatwarnDTC_raw32_ovrdval@ */ Scalar_ULONG 0 SWC_OUTP_type_CM_uint32_raw32 0.0 4.294967295E+9 /end CHARACTERISTIC
/begin CHARACTERISTIC KOUTP_RRDoorSWDTC_raw32_maxval "" VALUE 0x0000 /* @ECU_Address@KOUTP_RRDoorSWDTC_raw32_maxval@ */ Scalar_ULONG 0 SWC_OUTP_type_CM_uint32_raw32 0.0 4.294967295E+9 /end CHARACTERISTIC
/begin CHARACTERISTIC KOUTP_RRDoorSWDTC_raw32_minval "" VALUE 0x0000 /* @ECU_Address@KOUTP_RRDoorSWDTC_raw32_minval@ */ Scalar_ULONG 0 SWC_OUTP_type_CM_uint32_raw32 0.0 4.294967295E+9 /end CHARACTERISTIC
/begin CHARACTERISTIC KOUTP_RRDoorSWDTC_raw32_ovrdval "" VALUE 0x0000 /* @ECU_Address@KOUTP_RRDoorSWDTC_raw32_ovrdval@ */ Scalar_ULONG 0 SWC_OUTP_type_CM_uint32_raw32 0.0 4.294967295E+9 /end CHARACTERISTIC
/begin CHARACTERISTIC KOUTP_RRPressIndiDTC_raw32_maxval "" VALUE 0x0000 /* @ECU_Address@KOUTP_RRPressIndiDTC_raw32_maxval@ */ Scalar_ULONG 0 SWC_OUTP_type_CM_uint32_raw32 0.0 4.294967295E+9 /end CHARACTERISTIC
/begin CHARACTERISTIC KOUTP_RRPressIndiDTC_raw32_minval "" VALUE 0x0000 /* @ECU_Address@KOUTP_RRPressIndiDTC_raw32_minval@ */ Scalar_ULONG 0 SWC_OUTP_type_CM_uint32_raw32 0.0 4.294967295E+9 /end CHARACTERISTIC
/begin CHARACTERISTIC KOUTP_RRPressIndiDTC_raw32_ovrdval "" VALUE 0x0000 /* @ECU_Address@KOUTP_RRPressIndiDTC_raw32_ovrdval@ */ Scalar_ULONG 0 SWC_OUTP_type_CM_uint32_raw32 0.0 4.294967295E+9 /end CHARACTERISTIC
/begin CHARACTERISTIC KOUTP_RRSensorFailDTC_raw32_maxval "" VALUE 0x0000 /* @ECU_Address@KOUTP_RRSensorFailDTC_raw32_maxval@ */ Scalar_ULONG 0 SWC_OUTP_type_CM_uint32_raw32 0.0 4.294967295E+9 /end CHARACTERISTIC
/begin CHARACTERISTIC KOUTP_RRSensorFailDTC_raw32_minval "" VALUE 0x0000 /* @ECU_Address@KOUTP_RRSensorFailDTC_raw32_minval@ */ Scalar_ULONG 0 SWC_OUTP_type_CM_uint32_raw32 0.0 4.294967295E+9 /end CHARACTERISTIC
/begin CHARACTERISTIC KOUTP_RRSensorFailDTC_raw32_ovrdval "" VALUE 0x0000 /* @ECU_Address@KOUTP_RRSensorFailDTC_raw32_ovrdval@ */ Scalar_ULONG 0 SWC_OUTP_type_CM_uint32_raw32 0.0 4.294967295E+9 /end CHARACTERISTIC
/begin CHARACTERISTIC KOUTP_RRWheelTmpHighDTC_raw32_maxval "" VALUE 0x0000 /* @ECU_Address@KOUTP_RRWheelTmpHighDTC_raw32_maxval@ */ Scalar_ULONG 0 SWC_OUTP_type_CM_uint32_raw32 0.0 4.294967295E+9 /end CHARACTERISTIC
/begin CHARACTERISTIC KOUTP_RRWheelTmpHighDTC_raw32_minval "" VALUE 0x0000 /* @ECU_Address@KOUTP_RRWheelTmpHighDTC_raw32_minval@ */ Scalar_ULONG 0 SWC_OUTP_type_CM_uint32_raw32 0.0 4.294967295E+9 /end CHARACTERISTIC
/begin CHARACTERISTIC KOUTP_RRWheelTmpHighDTC_raw32_ovrdval "" VALUE 0x0000 /* @ECU_Address@KOUTP_RRWheelTmpHighDTC_raw32_ovrdval@ */ Scalar_ULONG 0 SWC_OUTP_type_CM_uint32_raw32 0.0 4.294967295E+9 /end CHARACTERISTIC
/begin CHARACTERISTIC KOUTP_RrMCUSigErrDetDTC_raw32_maxval "" VALUE 0x0000 /* @ECU_Address@KOUTP_RrMCUSigErrDetDTC_raw32_maxval@ */ Scalar_ULONG 0 SWC_OUTP_type_CM_uint32_raw32 0.0 4.294967295E+9 /end CHARACTERISTIC
/begin CHARACTERISTIC KOUTP_RrMCUSigErrDetDTC_raw32_minval "" VALUE 0x0000 /* @ECU_Address@KOUTP_RrMCUSigErrDetDTC_raw32_minval@ */ Scalar_ULONG 0 SWC_OUTP_type_CM_uint32_raw32 0.0 4.294967295E+9 /end CHARACTERISTIC
/begin CHARACTERISTIC KOUTP_RrMCUSigErrDetDTC_raw32_ovrdval "" VALUE 0x0000 /* @ECU_Address@KOUTP_RrMCUSigErrDetDTC_raw32_ovrdval@ */ Scalar_ULONG 0 SWC_OUTP_type_CM_uint32_raw32 0.0 4.294967295E+9 /end CHARACTERISTIC
/begin CHARACTERISTIC KOUTP_RrMCUTqErrDTC_raw32_maxval "" VALUE 0x0000 /* @ECU_Address@KOUTP_RrMCUTqErrDTC_raw32_maxval@ */ Scalar_ULONG 0 SWC_OUTP_type_CM_uint32_raw32 0.0 4.294967295E+9 /end CHARACTERISTIC
/begin CHARACTERISTIC KOUTP_RrMCUTqErrDTC_raw32_minval "" VALUE 0x0000 /* @ECU_Address@KOUTP_RrMCUTqErrDTC_raw32_minval@ */ Scalar_ULONG 0 SWC_OUTP_type_CM_uint32_raw32 0.0 4.294967295E+9 /end CHARACTERISTIC
/begin CHARACTERISTIC KOUTP_RrMCUTqErrDTC_raw32_ovrdval "" VALUE 0x0000 /* @ECU_Address@KOUTP_RrMCUTqErrDTC_raw32_ovrdval@ */ Scalar_ULONG 0 SWC_OUTP_type_CM_uint32_raw32 0.0 4.294967295E+9 /end CHARACTERISTIC
/begin CHARACTERISTIC KOUTP_Shifter1CSErrDTC_raw32_maxval "" VALUE 0x0000 /* @ECU_Address@KOUTP_Shifter1CSErrDTC_raw32_maxval@ */ Scalar_ULONG 0 SWC_OUTP_type_CM_uint32_raw32 0.0 4.294967295E+9 /end CHARACTERISTIC
/begin CHARACTERISTIC KOUTP_Shifter1CSErrDTC_raw32_minval "" VALUE 0x0000 /* @ECU_Address@KOUTP_Shifter1CSErrDTC_raw32_minval@ */ Scalar_ULONG 0 SWC_OUTP_type_CM_uint32_raw32 0.0 4.294967295E+9 /end CHARACTERISTIC
/begin CHARACTERISTIC KOUTP_Shifter1CSErrDTC_raw32_ovrdval "" VALUE 0x0000 /* @ECU_Address@KOUTP_Shifter1CSErrDTC_raw32_ovrdval@ */ Scalar_ULONG 0 SWC_OUTP_type_CM_uint32_raw32 0.0 4.294967295E+9 /end CHARACTERISTIC
/begin CHARACTERISTIC KOUTP_Shifter1NoComDTC_raw32_maxval "" VALUE 0x0000 /* @ECU_Address@KOUTP_Shifter1NoComDTC_raw32_maxval@ */ Scalar_ULONG 0 SWC_OUTP_type_CM_uint32_raw32 0.0 4.294967295E+9 /end CHARACTERISTIC
/begin CHARACTERISTIC KOUTP_Shifter1NoComDTC_raw32_minval "" VALUE 0x0000 /* @ECU_Address@KOUTP_Shifter1NoComDTC_raw32_minval@ */ Scalar_ULONG 0 SWC_OUTP_type_CM_uint32_raw32 0.0 4.294967295E+9 /end CHARACTERISTIC
/begin CHARACTERISTIC KOUTP_Shifter1NoComDTC_raw32_ovrdval "" VALUE 0x0000 /* @ECU_Address@KOUTP_Shifter1NoComDTC_raw32_ovrdval@ */ Scalar_ULONG 0 SWC_OUTP_type_CM_uint32_raw32 0.0 4.294967295E+9 /end CHARACTERISTIC
/begin CHARACTERISTIC KOUTP_Shifter1RCErrDTC_raw32_maxval "" VALUE 0x0000 /* @ECU_Address@KOUTP_Shifter1RCErrDTC_raw32_maxval@ */ Scalar_ULONG 0 SWC_OUTP_type_CM_uint32_raw32 0.0 4.294967295E+9 /end CHARACTERISTIC
/begin CHARACTERISTIC KOUTP_Shifter1RCErrDTC_raw32_minval "" VALUE 0x0000 /* @ECU_Address@KOUTP_Shifter1RCErrDTC_raw32_minval@ */ Scalar_ULONG 0 SWC_OUTP_type_CM_uint32_raw32 0.0 4.294967295E+9 /end CHARACTERISTIC
/begin CHARACTERISTIC KOUTP_Shifter1RCErrDTC_raw32_ovrdval "" VALUE 0x0000 /* @ECU_Address@KOUTP_Shifter1RCErrDTC_raw32_ovrdval@ */ Scalar_ULONG 0 SWC_OUTP_type_CM_uint32_raw32 0.0 4.294967295E+9 /end CHARACTERISTIC
/begin CHARACTERISTIC KOUTP_TailgaSWDTC_raw32_maxval "" VALUE 0x0000 /* @ECU_Address@KOUTP_TailgaSWDTC_raw32_maxval@ */ Scalar_ULONG 0 SWC_OUTP_type_CM_uint32_raw32 0.0 4.294967295E+9 /end CHARACTERISTIC
/begin CHARACTERISTIC KOUTP_TailgaSWDTC_raw32_minval "" VALUE 0x0000 /* @ECU_Address@KOUTP_TailgaSWDTC_raw32_minval@ */ Scalar_ULONG 0 SWC_OUTP_type_CM_uint32_raw32 0.0 4.294967295E+9 /end CHARACTERISTIC
/begin CHARACTERISTIC KOUTP_TailgaSWDTC_raw32_ovrdval "" VALUE 0x0000 /* @ECU_Address@KOUTP_TailgaSWDTC_raw32_ovrdval@ */ Scalar_ULONG 0 SWC_OUTP_type_CM_uint32_raw32 0.0 4.294967295E+9 /end CHARACTERISTIC
/begin CHARACTERISTIC KOUTP_ZoneSCPNoComDTC_raw32_maxval "" VALUE 0x0000 /* @ECU_Address@KOUTP_ZoneSCPNoComDTC_raw32_maxval@ */ Scalar_ULONG 0 SWC_OUTP_type_CM_uint32_raw32 0.0 4.294967295E+9 /end CHARACTERISTIC
/begin CHARACTERISTIC KOUTP_ZoneSCPNoComDTC_raw32_minval "" VALUE 0x0000 /* @ECU_Address@KOUTP_ZoneSCPNoComDTC_raw32_minval@ */ Scalar_ULONG 0 SWC_OUTP_type_CM_uint32_raw32 0.0 4.294967295E+9 /end CHARACTERISTIC
/begin CHARACTERISTIC KOUTP_ZoneSCPNoComDTC_raw32_ovrdval "" VALUE 0x0000 /* @ECU_Address@KOUTP_ZoneSCPNoComDTC_raw32_ovrdval@ */ Scalar_ULONG 0 SWC_OUTP_type_CM_uint32_raw32 0.0 4.294967295E+9 /end CHARACTERISTIC
/begin CHARACTERISTIC KOUTP_CLRTIME_min_maxval "" VALUE 0x0000 /* @ECU_Address@KOUTP_CLRTIME_min_maxval@ */ Scalar_UWORD 0 SWC_OUTP_type_CM_uint16_min 0.0 65535.0 /end CHARACTERISTIC
/begin CHARACTERISTIC KOUTP_CLRTIME_min_minval "" VALUE 0x0000 /* @ECU_Address@KOUTP_CLRTIME_min_minval@ */ Scalar_UWORD 0 SWC_OUTP_type_CM_uint16_min 0.0 65535.0 /end CHARACTERISTIC
/begin CHARACTERISTIC KOUTP_CLRTIME_min_ovrdval "" VALUE 0x0000 /* @ECU_Address@KOUTP_CLRTIME_min_ovrdval@ */ Scalar_UWORD 0 SWC_OUTP_type_CM_uint16_min 0.0 65535.0 /end CHARACTERISTIC
/begin CHARACTERISTIC KOUTP_APPD_pct_ovrdflg "" VALUE 0x0000 /* @ECU_Address@KOUTP_APPD_pct_ovrdflg@ */ Scalar_BOOLEAN 0 SWC_OUTP_type_CM_boolean_flg 0.0 1.0 /end CHARACTERISTIC
/begin CHARACTERISTIC KOUTP_APPE_pct_ovrdflg "" VALUE 0x0000 /* @ECU_Address@KOUTP_APPE_pct_ovrdflg@ */ Scalar_BOOLEAN 0 SWC_OUTP_type_CM_boolean_flg 0.0 1.0 /end CHARACTERISTIC
/begin CHARACTERISTIC KOUTP_AVGBATTEMPL_C_ovrdflg "" VALUE 0x0000 /* @ECU_Address@KOUTP_AVGBATTEMPL_C_ovrdflg@ */ Scalar_BOOLEAN 0 SWC_OUTP_type_CM_boolean_flg 0.0 1.0 /end CHARACTERISTIC
/begin CHARACTERISTIC KOUTP_AVGBATTEMPL_sec_ovrdflg "" VALUE 0x0000 /* @ECU_Address@KOUTP_AVGBATTEMPL_sec_ovrdflg@ */ Scalar_BOOLEAN 0 SWC_OUTP_type_CM_boolean_flg 0.0 1.0 /end CHARACTERISTIC
/begin CHARACTERISTIC KOUTP_ActAPSPosn_pct_ovrdflg "" VALUE 0x0000 /* @ECU_Address@KOUTP_ActAPSPosn_pct_ovrdflg@ */ Scalar_BOOLEAN 0 SWC_OUTP_type_CM_boolean_flg 0.0 1.0 /end CHARACTERISTIC
/begin CHARACTERISTIC KOUTP_AvgBattTempOFFL_C_ovrdflg "" VALUE 0x0000 /* @ECU_Address@KOUTP_AvgBattTempOFFL_C_ovrdflg@ */ Scalar_BOOLEAN 0 SWC_OUTP_type_CM_boolean_flg 0.0 1.0 /end CHARACTERISTIC
/begin CHARACTERISTIC KOUTP_AvgBattTempOFFR_C_ovrdflg "" VALUE 0x0000 /* @ECU_Address@KOUTP_AvgBattTempOFFR_C_ovrdflg@ */ Scalar_BOOLEAN 0 SWC_OUTP_type_CM_boolean_flg 0.0 1.0 /end CHARACTERISTIC
/begin CHARACTERISTIC KOUTP_AvgBattTempOVCL_C_ovrdflg "" VALUE 0x0000 /* @ECU_Address@KOUTP_AvgBattTempOVCL_C_ovrdflg@ */ Scalar_BOOLEAN 0 SWC_OUTP_type_CM_boolean_flg 0.0 1.0 /end CHARACTERISTIC
/begin CHARACTERISTIC KOUTP_AvgBattTempOVCR_C_ovrdflg "" VALUE 0x0000 /* @ECU_Address@KOUTP_AvgBattTempOVCR_C_ovrdflg@ */ Scalar_BOOLEAN 0 SWC_OUTP_type_CM_boolean_flg 0.0 1.0 /end CHARACTERISTIC
/begin CHARACTERISTIC KOUTP_AvgBattTempPSAL_C_ovrdflg "" VALUE 0x0000 /* @ECU_Address@KOUTP_AvgBattTempPSAL_C_ovrdflg@ */ Scalar_BOOLEAN 0 SWC_OUTP_type_CM_boolean_flg 0.0 1.0 /end CHARACTERISTIC
/begin CHARACTERISTIC KOUTP_AvgBattTempPSAR_C_ovrdflg "" VALUE 0x0000 /* @ECU_Address@KOUTP_AvgBattTempPSAR_C_ovrdflg@ */ Scalar_BOOLEAN 0 SWC_OUTP_type_CM_boolean_flg 0.0 1.0 /end CHARACTERISTIC
/begin CHARACTERISTIC KOUTP_BATSOC_pct_ovrdflg "" VALUE 0x0000 /* @ECU_Address@KOUTP_BATSOC_pct_ovrdflg@ */ Scalar_BOOLEAN 0 SWC_OUTP_type_CM_boolean_flg 0.0 1.0 /end CHARACTERISTIC
/begin CHARACTERISTIC KOUTP_BATSOH_pct_ovrdflg "" VALUE 0x0000 /* @ECU_Address@KOUTP_BATSOH_pct_ovrdflg@ */ Scalar_BOOLEAN 0 SWC_OUTP_type_CM_boolean_flg 0.0 1.0 /end CHARACTERISTIC
/begin CHARACTERISTIC KOUTP_BattTempPSAL_sec_ovrdflg "" VALUE 0x0000 /* @ECU_Address@KOUTP_BattTempPSAL_sec_ovrdflg@ */ Scalar_BOOLEAN 0 SWC_OUTP_type_CM_boolean_flg 0.0 1.0 /end CHARACTERISTIC
/begin CHARACTERISTIC KOUTP_BattTempPSAR_sec_ovrdflg "" VALUE 0x0000 /* @ECU_Address@KOUTP_BattTempPSAR_sec_ovrdflg@ */ Scalar_BOOLEAN 0 SWC_OUTP_type_CM_boolean_flg 0.0 1.0 /end CHARACTERISTIC
/begin CHARACTERISTIC KOUTP_CALID_cnt_ovrdflg "" VALUE 0x0000 /* @ECU_Address@KOUTP_CALID_cnt_ovrdflg@ */ Scalar_BOOLEAN 0 SWC_OUTP_type_CM_boolean_flg 0.0 1.0 /end CHARACTERISTIC
/begin CHARACTERISTIC KOUTP_CDEODTL_km_ovrdflg "" VALUE 0x0000 /* @ECU_Address@KOUTP_CDEODTL_km_ovrdflg@ */ Scalar_BOOLEAN 0 SWC_OUTP_type_CM_boolean_flg 0.0 1.0 /end CHARACTERISTIC
/begin CHARACTERISTIC KOUTP_CDEODTR_km_ovrdflg "" VALUE 0x0000 /* @ECU_Address@KOUTP_CDEODTR_km_ovrdflg@ */ Scalar_BOOLEAN 0 SWC_OUTP_type_CM_boolean_flg 0.0 1.0 /end CHARACTERISTIC
/begin CHARACTERISTIC KOUTP_CLRDIST_km_ovrdflg "" VALUE 0x0000 /* @ECU_Address@KOUTP_CLRDIST_km_ovrdflg@ */ Scalar_BOOLEAN 0 SWC_OUTP_type_CM_boolean_flg 0.0 1.0 /end CHARACTERISTIC
/begin CHARACTERISTIC KOUTP_CLRTIME_min_ovrdflg "" VALUE 0x0000 /* @ECU_Address@KOUTP_CLRTIME_min_ovrdflg@ */ Scalar_BOOLEAN 0 SWC_OUTP_type_CM_boolean_flg 0.0 1.0 /end CHARACTERISTIC
/begin CHARACTERISTIC KOUTP_CPSAL_sec_ovrdflg "" VALUE 0x0000 /* @ECU_Address@KOUTP_CPSAL_sec_ovrdflg@ */ Scalar_BOOLEAN 0 SWC_OUTP_type_CM_boolean_flg 0.0 1.0 /end CHARACTERISTIC
/begin CHARACTERISTIC KOUTP_CPSAR_sec_ovrdflg "" VALUE 0x0000 /* @ECU_Address@KOUTP_CPSAR_sec_ovrdflg@ */ Scalar_BOOLEAN 0 SWC_OUTP_type_CM_boolean_flg 0.0 1.0 /end CHARACTERISTIC
/begin CHARACTERISTIC KOUTP_DIDModelVersionChksum_raw_ovrdflg "" VALUE 0x0000 /* @ECU_Address@KOUTP_DIDModelVersionChksum_raw_ovrdflg@ */ Scalar_BOOLEAN 0 SWC_OUTP_type_CM_boolean_flg 0.0 1.0 /end CHARACTERISTIC
/begin CHARACTERISTIC KOUTP_DIDModelVersion_raw_ovrdflg "" VALUE 0x0000 /* @ECU_Address@KOUTP_DIDModelVersion_raw_ovrdflg@ */ Scalar_BOOLEAN 0 SWC_OUTP_type_CM_boolean_flg 0.0 1.0 /end CHARACTERISTIC
/begin CHARACTERISTIC KOUTP_EAPS1MIN_pct_ovrdflg "" VALUE 0x0000 /* @ECU_Address@KOUTP_EAPS1MIN_pct_ovrdflg@ */ Scalar_BOOLEAN 0 SWC_OUTP_type_CM_boolean_flg 0.0 1.0 /end CHARACTERISTIC
/begin CHARACTERISTIC KOUTP_EAPS1NRM_pct_ovrdflg "" VALUE 0x0000 /* @ECU_Address@KOUTP_EAPS1NRM_pct_ovrdflg@ */ Scalar_BOOLEAN 0 SWC_OUTP_type_CM_boolean_flg 0.0 1.0 /end CHARACTERISTIC
/begin CHARACTERISTIC KOUTP_EAPS2MIN_pct_ovrdflg "" VALUE 0x0000 /* @ECU_Address@KOUTP_EAPS2MIN_pct_ovrdflg@ */ Scalar_BOOLEAN 0 SWC_OUTP_type_CM_boolean_flg 0.0 1.0 /end CHARACTERISTIC
/begin CHARACTERISTIC KOUTP_EAPS2NRM_pct_ovrdflg "" VALUE 0x0000 /* @ECU_Address@KOUTP_EAPS2NRM_pct_ovrdflg@ */ Scalar_BOOLEAN 0 SWC_OUTP_type_CM_boolean_flg 0.0 1.0 /end CHARACTERISTIC
/begin CHARACTERISTIC KOUTP_ECUNAME_cnt_ovrdflg "" VALUE 0x0000 /* @ECU_Address@KOUTP_ECUNAME_cnt_ovrdflg@ */ Scalar_BOOLEAN 0 SWC_OUTP_type_CM_boolean_flg 0.0 1.0 /end CHARACTERISTIC
/begin CHARACTERISTIC KOUTP_ETMATOEL_kWh_ovrdflg "" VALUE 0x0000 /* @ECU_Address@KOUTP_ETMATOEL_kWh_ovrdflg@ */ Scalar_BOOLEAN 0 SWC_OUTP_type_CM_boolean_flg 0.0 1.0 /end CHARACTERISTIC
/begin CHARACTERISTIC KOUTP_ETMATOER_kWh_ovrdflg "" VALUE 0x0000 /* @ECU_Address@KOUTP_ETMATOER_kWh_ovrdflg@ */ Scalar_BOOLEAN 0 SWC_OUTP_type_CM_boolean_flg 0.0 1.0 /end CHARACTERISTIC
/begin CHARACTERISTIC KOUTP_ETMBTOEL_kWh_ovrdflg "" VALUE 0x0000 /* @ECU_Address@KOUTP_ETMBTOEL_kWh_ovrdflg@ */ Scalar_BOOLEAN 0 SWC_OUTP_type_CM_boolean_flg 0.0 1.0 /end CHARACTERISTIC
/begin CHARACTERISTIC KOUTP_ETMBTOER_kWh_ovrdflg "" VALUE 0x0000 /* @ECU_Address@KOUTP_ETMBTOER_kWh_ovrdflg@ */ Scalar_BOOLEAN 0 SWC_OUTP_type_CM_boolean_flg 0.0 1.0 /end CHARACTERISTIC
/begin CHARACTERISTIC KOUTP_FCMACCSigErrDetDTC_raw32_ovrdflg "" VALUE 0x0000 /* @ECU_Address@KOUTP_FCMACCSigErrDetDTC_raw32_ovrdflg@ */ Scalar_BOOLEAN 0 SWC_OUTP_type_CM_boolean_flg 0.0 1.0 /end CHARACTERISTIC
/begin CHARACTERISTIC KOUTP_FCRUSSDTC_raw32_ovrdflg "" VALUE 0x0000 /* @ECU_Address@KOUTP_FCRUSSDTC_raw32_ovrdflg@ */ Scalar_BOOLEAN 0 SWC_OUTP_type_CM_boolean_flg 0.0 1.0 /end CHARACTERISTIC
/begin CHARACTERISTIC KOUTP_FLDoorSWDTC_raw32_ovrdflg "" VALUE 0x0000 /* @ECU_Address@KOUTP_FLDoorSWDTC_raw32_ovrdflg@ */ Scalar_BOOLEAN 0 SWC_OUTP_type_CM_boolean_flg 0.0 1.0 /end CHARACTERISTIC
/begin CHARACTERISTIC KOUTP_FLLUSSDTC_raw32_ovrdflg "" VALUE 0x0000 /* @ECU_Address@KOUTP_FLLUSSDTC_raw32_ovrdflg@ */ Scalar_BOOLEAN 0 SWC_OUTP_type_CM_boolean_flg 0.0 1.0 /end CHARACTERISTIC
/begin CHARACTERISTIC KOUTP_FLRUSSDTC_raw32_ovrdflg "" VALUE 0x0000 /* @ECU_Address@KOUTP_FLRUSSDTC_raw32_ovrdflg@ */ Scalar_BOOLEAN 0 SWC_OUTP_type_CM_boolean_flg 0.0 1.0 /end CHARACTERISTIC
/begin CHARACTERISTIC KOUTP_FMLUSSDTC_raw32_ovrdflg "" VALUE 0x0000 /* @ECU_Address@KOUTP_FMLUSSDTC_raw32_ovrdflg@ */ Scalar_BOOLEAN 0 SWC_OUTP_type_CM_boolean_flg 0.0 1.0 /end CHARACTERISTIC
/begin CHARACTERISTIC KOUTP_FMRUSSDTC_raw32_ovrdflg "" VALUE 0x0000 /* @ECU_Address@KOUTP_FMRUSSDTC_raw32_ovrdflg@ */ Scalar_BOOLEAN 0 SWC_OUTP_type_CM_boolean_flg 0.0 1.0 /end CHARACTERISTIC
/begin CHARACTERISTIC KOUTP_FRDoorSWDTC_raw32_ovrdflg "" VALUE 0x0000 /* @ECU_Address@KOUTP_FRDoorSWDTC_raw32_ovrdflg@ */ Scalar_BOOLEAN 0 SWC_OUTP_type_CM_boolean_flg 0.0 1.0 /end CHARACTERISTIC
/begin CHARACTERISTIC KOUTP_FrMCUSigErrDetDTC_raw32_ovrdflg "" VALUE 0x0000 /* @ECU_Address@KOUTP_FrMCUSigErrDetDTC_raw32_ovrdflg@ */ Scalar_BOOLEAN 0 SWC_OUTP_type_CM_boolean_flg 0.0 1.0 /end CHARACTERISTIC
/begin CHARACTERISTIC KOUTP_FrMCUTqErrDTC_raw32_ovrdflg "" VALUE 0x0000 /* @ECU_Address@KOUTP_FrMCUTqErrDTC_raw32_ovrdflg@ */ Scalar_BOOLEAN 0 SWC_OUTP_type_CM_boolean_flg 0.0 1.0 /end CHARACTERISTIC
/begin CHARACTERISTIC KOUTP_GECHGOVCACL_kWh_ovrdflg "" VALUE 0x0000 /* @ECU_Address@KOUTP_GECHGOVCACL_kWh_ovrdflg@ */ Scalar_BOOLEAN 0 SWC_OUTP_type_CM_boolean_flg 0.0 1.0 /end CHARACTERISTIC
/begin CHARACTERISTIC KOUTP_GECHGOVCACR_kWh_ovrdflg "" VALUE 0x0000 /* @ECU_Address@KOUTP_GECHGOVCACR_kWh_ovrdflg@ */ Scalar_BOOLEAN 0 SWC_OUTP_type_CM_boolean_flg 0.0 1.0 /end CHARACTERISTIC
/begin CHARACTERISTIC KOUTP_GECHGOVCDCL_kWh_ovrdflg "" VALUE 0x0000 /* @ECU_Address@KOUTP_GECHGOVCDCL_kWh_ovrdflg@ */ Scalar_BOOLEAN 0 SWC_OUTP_type_CM_boolean_flg 0.0 1.0 /end CHARACTERISTIC
/begin CHARACTERISTIC KOUTP_GECHGOVCDCR_kWh_ovrdflg "" VALUE 0x0000 /* @ECU_Address@KOUTP_GECHGOVCDCR_kWh_ovrdflg@ */ Scalar_BOOLEAN 0 SWC_OUTP_type_CM_boolean_flg 0.0 1.0 /end CHARACTERISTIC
/begin CHARACTERISTIC KOUTP_HEVBATT_V_ovrdflg "" VALUE 0x0000 /* @ECU_Address@KOUTP_HEVBATT_V_ovrdflg@ */ Scalar_BOOLEAN 0 SWC_OUTP_type_CM_boolean_flg 0.0 1.0 /end CHARACTERISTIC
/begin CHARACTERISTIC KOUTP_HEVMODE_enum_ovrdflg "" VALUE 0x0000 /* @ECU_Address@KOUTP_HEVMODE_enum_ovrdflg@ */ Scalar_BOOLEAN 0 SWC_OUTP_type_CM_boolean_flg 0.0 1.0 /end CHARACTERISTIC
/begin CHARACTERISTIC KOUTP_HVB4PreDTC_raw32_ovrdflg "" VALUE 0x0000 /* @ECU_Address@KOUTP_HVB4PreDTC_raw32_ovrdflg@ */ Scalar_BOOLEAN 0 SWC_OUTP_type_CM_boolean_flg 0.0 1.0 /end CHARACTERISTIC
/begin CHARACTERISTIC KOUTP_HVBATT_A_ovrdflg "" VALUE 0x0000 /* @ECU_Address@KOUTP_HVBATT_A_ovrdflg@ */ Scalar_BOOLEAN 0 SWC_OUTP_type_CM_boolean_flg 0.0 1.0 /end CHARACTERISTIC
/begin CHARACTERISTIC KOUTP_HVBCellVoltMax_V_ovrdflg "" VALUE 0x0000 /* @ECU_Address@KOUTP_HVBCellVoltMax_V_ovrdflg@ */ Scalar_BOOLEAN 0 SWC_OUTP_type_CM_boolean_flg 0.0 1.0 /end CHARACTERISTIC
/begin CHARACTERISTIC KOUTP_HVBCellVoltMin_V_ovrdflg "" VALUE 0x0000 /* @ECU_Address@KOUTP_HVBCellVoltMin_V_ovrdflg@ */ Scalar_BOOLEAN 0 SWC_OUTP_type_CM_boolean_flg 0.0 1.0 /end CHARACTERISTIC
/begin CHARACTERISTIC KOUTP_HVBNAH_Ahr_ovrdflg "" VALUE 0x0000 /* @ECU_Address@KOUTP_HVBNAH_Ahr_ovrdflg@ */ Scalar_BOOLEAN 0 SWC_OUTP_type_CM_boolean_flg 0.0 1.0 /end CHARACTERISTIC
/begin CHARACTERISTIC KOUTP_HVBNE_kWh_ovrdflg "" VALUE 0x0000 /* @ECU_Address@KOUTP_HVBNE_kWh_ovrdflg@ */ Scalar_BOOLEAN 0 SWC_OUTP_type_CM_boolean_flg 0.0 1.0 /end CHARACTERISTIC
/begin CHARACTERISTIC KOUTP_HVBattCurr_Ahps_ovrdflg "" VALUE 0x0000 /* @ECU_Address@KOUTP_HVBattCurr_Ahps_ovrdflg@ */ Scalar_BOOLEAN 0 SWC_OUTP_type_CM_boolean_flg 0.0 1.0 /end CHARACTERISTIC
/begin CHARACTERISTIC KOUTP_HVRlyCloDTC_raw32_ovrdflg "" VALUE 0x0000 /* @ECU_Address@KOUTP_HVRlyCloDTC_raw32_ovrdflg@ */ Scalar_BOOLEAN 0 SWC_OUTP_type_CM_boolean_flg 0.0 1.0 /end CHARACTERISTIC
/begin CHARACTERISTIC KOUTP_HVRlyOpDTC_raw32_ovrdflg "" VALUE 0x0000 /* @ECU_Address@KOUTP_HVRlyOpDTC_raw32_ovrdflg@ */ Scalar_BOOLEAN 0 SWC_OUTP_type_CM_boolean_flg 0.0 1.0 /end CHARACTERISTIC
/begin CHARACTERISTIC KOUTP_HVRlyOpFail_flg_maxval "" VALUE 0x0000 /* @ECU_Address@KOUTP_HVRlyOpFail_flg_maxval@ */ Scalar_BOOLEAN 0 SWC_OUTP_type_CM_boolean_flg 0.0 1.0 /end CHARACTERISTIC
/begin CHARACTERISTIC KOUTP_HVRlyOpFail_flg_minval "" VALUE 0x0000 /* @ECU_Address@KOUTP_HVRlyOpFail_flg_minval@ */ Scalar_BOOLEAN 0 SWC_OUTP_type_CM_boolean_flg 0.0 1.0 /end CHARACTERISTIC
/begin CHARACTERISTIC KOUTP_HVRlyOpFail_flg_ovrdflg "" VALUE 0x0000 /* @ECU_Address@KOUTP_HVRlyOpFail_flg_ovrdflg@ */ Scalar_BOOLEAN 0 SWC_OUTP_type_CM_boolean_flg 0.0 1.0 /end CHARACTERISTIC
/begin CHARACTERISTIC KOUTP_HVRlyOpFail_flg_ovrdval "" VALUE 0x0000 /* @ECU_Address@KOUTP_HVRlyOpFail_flg_ovrdval@ */ Scalar_BOOLEAN 0 SWC_OUTP_type_CM_boolean_flg 0.0 1.0 /end CHARACTERISTIC
/begin CHARACTERISTIC KOUTP_HiLvSaChkDTC_raw32_ovrdflg "" VALUE 0x0000 /* @ECU_Address@KOUTP_HiLvSaChkDTC_raw32_ovrdflg@ */ Scalar_BOOLEAN 0 SWC_OUTP_type_CM_boolean_flg 0.0 1.0 /end CHARACTERISTIC
/begin CHARACTERISTIC KOUTP_HoodSWDTC_raw32_ovrdflg "" VALUE 0x0000 /* @ECU_Address@KOUTP_HoodSWDTC_raw32_ovrdflg@ */ Scalar_BOOLEAN 0 SWC_OUTP_type_CM_boolean_flg 0.0 1.0 /end CHARACTERISTIC
/begin CHARACTERISTIC KOUTP_ISAMalfuncDetDTC_raw32_ovrdflg "" VALUE 0x0000 /* @ECU_Address@KOUTP_ISAMalfuncDetDTC_raw32_ovrdflg@ */ Scalar_BOOLEAN 0 SWC_OUTP_type_CM_boolean_flg 0.0 1.0 /end CHARACTERISTIC
/begin CHARACTERISTIC KOUTP_IniLVLoDTC_raw32_ovrdflg "" VALUE 0x0000 /* @ECU_Address@KOUTP_IniLVLoDTC_raw32_ovrdflg@ */ Scalar_BOOLEAN 0 SWC_OUTP_type_CM_boolean_flg 0.0 1.0 /end CHARACTERISTIC
/begin CHARACTERISTIC KOUTP_KeyAuthDTC_raw32_ovrdflg "" VALUE 0x0000 /* @ECU_Address@KOUTP_KeyAuthDTC_raw32_ovrdflg@ */ Scalar_BOOLEAN 0 SWC_OUTP_type_CM_boolean_flg 0.0 1.0 /end CHARACTERISTIC
/begin CHARACTERISTIC KOUTP_LFBatwarnDTC_raw32_ovrdflg "" VALUE 0x0000 /* @ECU_Address@KOUTP_LFBatwarnDTC_raw32_ovrdflg@ */ Scalar_BOOLEAN 0 SWC_OUTP_type_CM_boolean_flg 0.0 1.0 /end CHARACTERISTIC
/begin CHARACTERISTIC KOUTP_LFPressIndiDTC_raw32_ovrdflg "" VALUE 0x0000 /* @ECU_Address@KOUTP_LFPressIndiDTC_raw32_ovrdflg@ */ Scalar_BOOLEAN 0 SWC_OUTP_type_CM_boolean_flg 0.0 1.0 /end CHARACTERISTIC
/begin CHARACTERISTIC KOUTP_LFSensorFailDTC_raw32_ovrdflg "" VALUE 0x0000 /* @ECU_Address@KOUTP_LFSensorFailDTC_raw32_ovrdflg@ */ Scalar_BOOLEAN 0 SWC_OUTP_type_CM_boolean_flg 0.0 1.0 /end CHARACTERISTIC
/begin CHARACTERISTIC KOUTP_LFWheelTmpHighDTC_raw32_ovrdflg "" VALUE 0x0000 /* @ECU_Address@KOUTP_LFWheelTmpHighDTC_raw32_ovrdflg@ */ Scalar_BOOLEAN 0 SWC_OUTP_type_CM_boolean_flg 0.0 1.0 /end CHARACTERISTIC
/begin CHARACTERISTIC KOUTP_LRBatwarnDTC_raw32_ovrdflg "" VALUE 0x0000 /* @ECU_Address@KOUTP_LRBatwarnDTC_raw32_ovrdflg@ */ Scalar_BOOLEAN 0 SWC_OUTP_type_CM_boolean_flg 0.0 1.0 /end CHARACTERISTIC
/begin CHARACTERISTIC KOUTP_LRPressIndiDTC_raw32_ovrdflg "" VALUE 0x0000 /* @ECU_Address@KOUTP_LRPressIndiDTC_raw32_ovrdflg@ */ Scalar_BOOLEAN 0 SWC_OUTP_type_CM_boolean_flg 0.0 1.0 /end CHARACTERISTIC
/begin CHARACTERISTIC KOUTP_LRSensorFailDTC_raw32_ovrdflg "" VALUE 0x0000 /* @ECU_Address@KOUTP_LRSensorFailDTC_raw32_ovrdflg@ */ Scalar_BOOLEAN 0 SWC_OUTP_type_CM_boolean_flg 0.0 1.0 /end CHARACTERISTIC
/begin CHARACTERISTIC KOUTP_LRWheelTmpHighDTC_raw32_ovrdflg "" VALUE 0x0000 /* @ECU_Address@KOUTP_LRWheelTmpHighDTC_raw32_ovrdflg@ */ Scalar_BOOLEAN 0 SWC_OUTP_type_CM_boolean_flg 0.0 1.0 /end CHARACTERISTIC
/begin CHARACTERISTIC KOUTP_LVSupHiDTC_raw32_ovrdflg "" VALUE 0x0000 /* @ECU_Address@KOUTP_LVSupHiDTC_raw32_ovrdflg@ */ Scalar_BOOLEAN 0 SWC_OUTP_type_CM_boolean_flg 0.0 1.0 /end CHARACTERISTIC
/begin CHARACTERISTIC KOUTP_LVSupLoDTC_raw32_ovrdflg "" VALUE 0x0000 /* @ECU_Address@KOUTP_LVSupLoDTC_raw32_ovrdflg@ */ Scalar_BOOLEAN 0 SWC_OUTP_type_CM_boolean_flg 0.0 1.0 /end CHARACTERISTIC
/begin CHARACTERISTIC KOUTP_LVSysErrPwrOutErr_flg_maxval "" VALUE 0x0000 /* @ECU_Address@KOUTP_LVSysErrPwrOutErr_flg_maxval@ */ Scalar_BOOLEAN 0 SWC_OUTP_type_CM_boolean_flg 0.0 1.0 /end CHARACTERISTIC
/begin CHARACTERISTIC KOUTP_LVSysErrPwrOutErr_flg_minval "" VALUE 0x0000 /* @ECU_Address@KOUTP_LVSysErrPwrOutErr_flg_minval@ */ Scalar_BOOLEAN 0 SWC_OUTP_type_CM_boolean_flg 0.0 1.0 /end CHARACTERISTIC
/begin CHARACTERISTIC KOUTP_LVSysErrPwrOutErr_flg_ovrdflg "" VALUE 0x0000 /* @ECU_Address@KOUTP_LVSysErrPwrOutErr_flg_ovrdflg@ */ Scalar_BOOLEAN 0 SWC_OUTP_type_CM_boolean_flg 0.0 1.0 /end CHARACTERISTIC
/begin CHARACTERISTIC KOUTP_LVSysErrPwrOutErr_flg_ovrdval "" VALUE 0x0000 /* @ECU_Address@KOUTP_LVSysErrPwrOutErr_flg_ovrdval@ */ Scalar_BOOLEAN 0 SWC_OUTP_type_CM_boolean_flg 0.0 1.0 /end CHARACTERISTIC
/begin CHARACTERISTIC KOUTP_LimpHomeActTmp_flg_maxval "" VALUE 0x0000 /* @ECU_Address@KOUTP_LimpHomeActTmp_flg_maxval@ */ Scalar_BOOLEAN 0 SWC_OUTP_type_CM_boolean_flg 0.0 1.0 /end CHARACTERISTIC
/begin CHARACTERISTIC KOUTP_LimpHomeActTmp_flg_minval "" VALUE 0x0000 /* @ECU_Address@KOUTP_LimpHomeActTmp_flg_minval@ */ Scalar_BOOLEAN 0 SWC_OUTP_type_CM_boolean_flg 0.0 1.0 /end CHARACTERISTIC
/begin CHARACTERISTIC KOUTP_LimpHomeActTmp_flg_ovrdflg "" VALUE 0x0000 /* @ECU_Address@KOUTP_LimpHomeActTmp_flg_ovrdflg@ */ Scalar_BOOLEAN 0 SWC_OUTP_type_CM_boolean_flg 0.0 1.0 /end CHARACTERISTIC
/begin CHARACTERISTIC KOUTP_LimpHomeActTmp_flg_ovrdval "" VALUE 0x0000 /* @ECU_Address@KOUTP_LimpHomeActTmp_flg_ovrdval@ */ Scalar_BOOLEAN 0 SWC_OUTP_type_CM_boolean_flg 0.0 1.0 /end CHARACTERISTIC
/begin CHARACTERISTIC KOUTP_Lv1ErrDTC_raw32_ovrdflg "" VALUE 0x0000 /* @ECU_Address@KOUTP_Lv1ErrDTC_raw32_ovrdflg@ */ Scalar_BOOLEAN 0 SWC_OUTP_type_CM_boolean_flg 0.0 1.0 /end CHARACTERISTIC
/begin CHARACTERISTIC KOUTP_Lv2ErrDTC_raw32_ovrdflg "" VALUE 0x0000 /* @ECU_Address@KOUTP_Lv2ErrDTC_raw32_ovrdflg@ */ Scalar_BOOLEAN 0 SWC_OUTP_type_CM_boolean_flg 0.0 1.0 /end CHARACTERISTIC
/begin CHARACTERISTIC KOUTP_Lv3ErrDTC_raw32_ovrdflg "" VALUE 0x0000 /* @ECU_Address@KOUTP_Lv3ErrDTC_raw32_ovrdflg@ */ Scalar_BOOLEAN 0 SWC_OUTP_type_CM_boolean_flg 0.0 1.0 /end CHARACTERISTIC
/begin CHARACTERISTIC KOUTP_Lv4ErrDTC_raw32_ovrdflg "" VALUE 0x0000 /* @ECU_Address@KOUTP_Lv4ErrDTC_raw32_ovrdflg@ */ Scalar_BOOLEAN 0 SWC_OUTP_type_CM_boolean_flg 0.0 1.0 /end CHARACTERISTIC
/begin CHARACTERISTIC KOUTP_MCU4PreDTC_raw32_ovrdflg "" VALUE 0x0000 /* @ECU_Address@KOUTP_MCU4PreDTC_raw32_ovrdflg@ */ Scalar_BOOLEAN 0 SWC_OUTP_type_CM_boolean_flg 0.0 1.0 /end CHARACTERISTIC
/begin CHARACTERISTIC KOUTP_MCUActDTC_raw32_ovrdflg "" VALUE 0x0000 /* @ECU_Address@KOUTP_MCUActDTC_raw32_ovrdflg@ */ Scalar_BOOLEAN 0 SWC_OUTP_type_CM_boolean_flg 0.0 1.0 /end CHARACTERISTIC
/begin CHARACTERISTIC KOUTP_MCUActDisFail_flg_maxval "" VALUE 0x0000 /* @ECU_Address@KOUTP_MCUActDisFail_flg_maxval@ */ Scalar_BOOLEAN 0 SWC_OUTP_type_CM_boolean_flg 0.0 1.0 /end CHARACTERISTIC
/begin CHARACTERISTIC KOUTP_MCUActDisFail_flg_minval "" VALUE 0x0000 /* @ECU_Address@KOUTP_MCUActDisFail_flg_minval@ */ Scalar_BOOLEAN 0 SWC_OUTP_type_CM_boolean_flg 0.0 1.0 /end CHARACTERISTIC
/begin CHARACTERISTIC KOUTP_MCUActDisFail_flg_ovrdflg "" VALUE 0x0000 /* @ECU_Address@KOUTP_MCUActDisFail_flg_ovrdflg@ */ Scalar_BOOLEAN 0 SWC_OUTP_type_CM_boolean_flg 0.0 1.0 /end CHARACTERISTIC
/begin CHARACTERISTIC KOUTP_MCUActDisFail_flg_ovrdval "" VALUE 0x0000 /* @ECU_Address@KOUTP_MCUActDisFail_flg_ovrdval@ */ Scalar_BOOLEAN 0 SWC_OUTP_type_CM_boolean_flg 0.0 1.0 /end CHARACTERISTIC
/begin CHARACTERISTIC KOUTP_MCUDisDTC_raw32_ovrdflg "" VALUE 0x0000 /* @ECU_Address@KOUTP_MCUDisDTC_raw32_ovrdflg@ */ Scalar_BOOLEAN 0 SWC_OUTP_type_CM_boolean_flg 0.0 1.0 /end CHARACTERISTIC
/begin CHARACTERISTIC KOUTP_MCUF1CSErrDTC_raw32_ovrdflg "" VALUE 0x0000 /* @ECU_Address@KOUTP_MCUF1CSErrDTC_raw32_ovrdflg@ */ Scalar_BOOLEAN 0 SWC_OUTP_type_CM_boolean_flg 0.0 1.0 /end CHARACTERISTIC
/begin CHARACTERISTIC KOUTP_MCUF1NoComDTC_raw32_ovrdflg "" VALUE 0x0000 /* @ECU_Address@KOUTP_MCUF1NoComDTC_raw32_ovrdflg@ */ Scalar_BOOLEAN 0 SWC_OUTP_type_CM_boolean_flg 0.0 1.0 /end CHARACTERISTIC
/begin CHARACTERISTIC KOUTP_MCUF1RCErrDTC_raw32_ovrdflg "" VALUE 0x0000 /* @ECU_Address@KOUTP_MCUF1RCErrDTC_raw32_ovrdflg@ */ Scalar_BOOLEAN 0 SWC_OUTP_type_CM_boolean_flg 0.0 1.0 /end CHARACTERISTIC
/begin CHARACTERISTIC KOUTP_MCUR1CSErrDTC_raw32_ovrdflg "" VALUE 0x0000 /* @ECU_Address@KOUTP_MCUR1CSErrDTC_raw32_ovrdflg@ */ Scalar_BOOLEAN 0 SWC_OUTP_type_CM_boolean_flg 0.0 1.0 /end CHARACTERISTIC
/begin CHARACTERISTIC KOUTP_MCUR1NoComDTC_raw32_ovrdflg "" VALUE 0x0000 /* @ECU_Address@KOUTP_MCUR1NoComDTC_raw32_ovrdflg@ */ Scalar_BOOLEAN 0 SWC_OUTP_type_CM_boolean_flg 0.0 1.0 /end CHARACTERISTIC
/begin CHARACTERISTIC KOUTP_MCUR1RCErrDTC_raw32_ovrdflg "" VALUE 0x0000 /* @ECU_Address@KOUTP_MCUR1RCErrDTC_raw32_ovrdflg@ */ Scalar_BOOLEAN 0 SWC_OUTP_type_CM_boolean_flg 0.0 1.0 /end CHARACTERISTIC
/begin CHARACTERISTIC KOUTP_MSAMalfuncDetDTC_raw32_ovrdflg "" VALUE 0x0000 /* @ECU_Address@KOUTP_MSAMalfuncDetDTC_raw32_ovrdflg@ */ Scalar_BOOLEAN 0 SWC_OUTP_type_CM_boolean_flg 0.0 1.0 /end CHARACTERISTIC
/begin CHARACTERISTIC KOUTP_MidLvSaChkDTC_raw32_ovrdflg "" VALUE 0x0000 /* @ECU_Address@KOUTP_MidLvSaChkDTC_raw32_ovrdflg@ */ Scalar_BOOLEAN 0 SWC_OUTP_type_CM_boolean_flg 0.0 1.0 /end CHARACTERISTIC
/begin CHARACTERISTIC KOUTP_OBC4PreDTC_raw32_ovrdflg "" VALUE 0x0000 /* @ECU_Address@KOUTP_OBC4PreDTC_raw32_ovrdflg@ */ Scalar_BOOLEAN 0 SWC_OUTP_type_CM_boolean_flg 0.0 1.0 /end CHARACTERISTIC
/begin CHARACTERISTIC KOUTP_ONtoRdyDTC_raw32_ovrdflg "" VALUE 0x0000 /* @ECU_Address@KOUTP_ONtoRdyDTC_raw32_ovrdflg@ */ Scalar_BOOLEAN 0 SWC_OUTP_type_CM_boolean_flg 0.0 1.0 /end CHARACTERISTIC
/begin CHARACTERISTIC KOUTP_RCLUSSDTC_raw32_ovrdflg "" VALUE 0x0000 /* @ECU_Address@KOUTP_RCLUSSDTC_raw32_ovrdflg@ */ Scalar_BOOLEAN 0 SWC_OUTP_type_CM_boolean_flg 0.0 1.0 /end CHARACTERISTIC
/begin CHARACTERISTIC KOUTP_RCRUSSDTC_raw32_ovrdflg "" VALUE 0x0000 /* @ECU_Address@KOUTP_RCRUSSDTC_raw32_ovrdflg@ */ Scalar_BOOLEAN 0 SWC_OUTP_type_CM_boolean_flg 0.0 1.0 /end CHARACTERISTIC
/begin CHARACTERISTIC KOUTP_RFBatwarnDTC_raw32_ovrdflg "" VALUE 0x0000 /* @ECU_Address@KOUTP_RFBatwarnDTC_raw32_ovrdflg@ */ Scalar_BOOLEAN 0 SWC_OUTP_type_CM_boolean_flg 0.0 1.0 /end CHARACTERISTIC
/begin CHARACTERISTIC KOUTP_RFPressIndiDTC_raw32_ovrdflg "" VALUE 0x0000 /* @ECU_Address@KOUTP_RFPressIndiDTC_raw32_ovrdflg@ */ Scalar_BOOLEAN 0 SWC_OUTP_type_CM_boolean_flg 0.0 1.0 /end CHARACTERISTIC
/begin CHARACTERISTIC KOUTP_RFSensorFailDTC_raw32_ovrdflg "" VALUE 0x0000 /* @ECU_Address@KOUTP_RFSensorFailDTC_raw32_ovrdflg@ */ Scalar_BOOLEAN 0 SWC_OUTP_type_CM_boolean_flg 0.0 1.0 /end CHARACTERISTIC
/begin CHARACTERISTIC KOUTP_RFWheelTmpHighDTC_raw32_ovrdflg "" VALUE 0x0000 /* @ECU_Address@KOUTP_RFWheelTmpHighDTC_raw32_ovrdflg@ */ Scalar_BOOLEAN 0 SWC_OUTP_type_CM_boolean_flg 0.0 1.0 /end CHARACTERISTIC
/begin CHARACTERISTIC KOUTP_RLDoorSWDTC_raw32_ovrdflg "" VALUE 0x0000 /* @ECU_Address@KOUTP_RLDoorSWDTC_raw32_ovrdflg@ */ Scalar_BOOLEAN 0 SWC_OUTP_type_CM_boolean_flg 0.0 1.0 /end CHARACTERISTIC
/begin CHARACTERISTIC KOUTP_RLLUSSDTC_raw32_ovrdflg "" VALUE 0x0000 /* @ECU_Address@KOUTP_RLLUSSDTC_raw32_ovrdflg@ */ Scalar_BOOLEAN 0 SWC_OUTP_type_CM_boolean_flg 0.0 1.0 /end CHARACTERISTIC
/begin CHARACTERISTIC KOUTP_RLRUSSDTC_raw32_ovrdflg "" VALUE 0x0000 /* @ECU_Address@KOUTP_RLRUSSDTC_raw32_ovrdflg@ */ Scalar_BOOLEAN 0 SWC_OUTP_type_CM_boolean_flg 0.0 1.0 /end CHARACTERISTIC
/begin CHARACTERISTIC KOUTP_RMLUSSDTC_raw32_ovrdflg "" VALUE 0x0000 /* @ECU_Address@KOUTP_RMLUSSDTC_raw32_ovrdflg@ */ Scalar_BOOLEAN 0 SWC_OUTP_type_CM_boolean_flg 0.0 1.0 /end CHARACTERISTIC
/begin CHARACTERISTIC KOUTP_RMRUSSDTC_raw32_ovrdflg "" VALUE 0x0000 /* @ECU_Address@KOUTP_RMRUSSDTC_raw32_ovrdflg@ */ Scalar_BOOLEAN 0 SWC_OUTP_type_CM_boolean_flg 0.0 1.0 /end CHARACTERISTIC
/begin CHARACTERISTIC KOUTP_RRBatwarnDTC_raw32_ovrdflg "" VALUE 0x0000 /* @ECU_Address@KOUTP_RRBatwarnDTC_raw32_ovrdflg@ */ Scalar_BOOLEAN 0 SWC_OUTP_type_CM_boolean_flg 0.0 1.0 /end CHARACTERISTIC
/begin CHARACTERISTIC KOUTP_RRDoorSWDTC_raw32_ovrdflg "" VALUE 0x0000 /* @ECU_Address@KOUTP_RRDoorSWDTC_raw32_ovrdflg@ */ Scalar_BOOLEAN 0 SWC_OUTP_type_CM_boolean_flg 0.0 1.0 /end CHARACTERISTIC
/begin CHARACTERISTIC KOUTP_RRPressIndiDTC_raw32_ovrdflg "" VALUE 0x0000 /* @ECU_Address@KOUTP_RRPressIndiDTC_raw32_ovrdflg@ */ Scalar_BOOLEAN 0 SWC_OUTP_type_CM_boolean_flg 0.0 1.0 /end CHARACTERISTIC
/begin CHARACTERISTIC KOUTP_RRSensorFailDTC_raw32_ovrdflg "" VALUE 0x0000 /* @ECU_Address@KOUTP_RRSensorFailDTC_raw32_ovrdflg@ */ Scalar_BOOLEAN 0 SWC_OUTP_type_CM_boolean_flg 0.0 1.0 /end CHARACTERISTIC
/begin CHARACTERISTIC KOUTP_RRWheelTmpHighDTC_raw32_ovrdflg "" VALUE 0x0000 /* @ECU_Address@KOUTP_RRWheelTmpHighDTC_raw32_ovrdflg@ */ Scalar_BOOLEAN 0 SWC_OUTP_type_CM_boolean_flg 0.0 1.0 /end CHARACTERISTIC
/begin CHARACTERISTIC KOUTP_ResetPedalZeroPosStart_flg_maxval "" VALUE 0x0000 /* @ECU_Address@KOUTP_ResetPedalZeroPosStart_flg_maxval@ */ Scalar_BOOLEAN 0 SWC_OUTP_type_CM_boolean_flg 0.0 1.0 /end CHARACTERISTIC
/begin CHARACTERISTIC KOUTP_ResetPedalZeroPosStart_flg_minval "" VALUE 0x0000 /* @ECU_Address@KOUTP_ResetPedalZeroPosStart_flg_minval@ */ Scalar_BOOLEAN 0 SWC_OUTP_type_CM_boolean_flg 0.0 1.0 /end CHARACTERISTIC
/begin CHARACTERISTIC KOUTP_ResetPedalZeroPosStart_flg_ovrdflg "" VALUE 0x0000 /* @ECU_Address@KOUTP_ResetPedalZeroPosStart_flg_ovrdflg@ */ Scalar_BOOLEAN 0 SWC_OUTP_type_CM_boolean_flg 0.0 1.0 /end CHARACTERISTIC
/begin CHARACTERISTIC KOUTP_ResetPedalZeroPosStart_flg_ovrdval "" VALUE 0x0000 /* @ECU_Address@KOUTP_ResetPedalZeroPosStart_flg_ovrdval@ */ Scalar_BOOLEAN 0 SWC_OUTP_type_CM_boolean_flg 0.0 1.0 /end CHARACTERISTIC
/begin CHARACTERISTIC KOUTP_RrMCUSigErrDetDTC_raw32_ovrdflg "" VALUE 0x0000 /* @ECU_Address@KOUTP_RrMCUSigErrDetDTC_raw32_ovrdflg@ */ Scalar_BOOLEAN 0 SWC_OUTP_type_CM_boolean_flg 0.0 1.0 /end CHARACTERISTIC
/begin CHARACTERISTIC KOUTP_RrMCUTqErrDTC_raw32_ovrdflg "" VALUE 0x0000 /* @ECU_Address@KOUTP_RrMCUTqErrDTC_raw32_ovrdflg@ */ Scalar_BOOLEAN 0 SWC_OUTP_type_CM_boolean_flg 0.0 1.0 /end CHARACTERISTIC
/begin CHARACTERISTIC KOUTP_Shifter1CSErrDTC_raw32_ovrdflg "" VALUE 0x0000 /* @ECU_Address@KOUTP_Shifter1CSErrDTC_raw32_ovrdflg@ */ Scalar_BOOLEAN 0 SWC_OUTP_type_CM_boolean_flg 0.0 1.0 /end CHARACTERISTIC
/begin CHARACTERISTIC KOUTP_Shifter1NoComDTC_raw32_ovrdflg "" VALUE 0x0000 /* @ECU_Address@KOUTP_Shifter1NoComDTC_raw32_ovrdflg@ */ Scalar_BOOLEAN 0 SWC_OUTP_type_CM_boolean_flg 0.0 1.0 /end CHARACTERISTIC
/begin CHARACTERISTIC KOUTP_Shifter1RCErrDTC_raw32_ovrdflg "" VALUE 0x0000 /* @ECU_Address@KOUTP_Shifter1RCErrDTC_raw32_ovrdflg@ */ Scalar_BOOLEAN 0 SWC_OUTP_type_CM_boolean_flg 0.0 1.0 /end CHARACTERISTIC
/begin CHARACTERISTIC KOUTP_SysAllowReadySta_flg_maxval "" VALUE 0x0000 /* @ECU_Address@KOUTP_SysAllowReadySta_flg_maxval@ */ Scalar_BOOLEAN 0 SWC_OUTP_type_CM_boolean_flg 0.0 1.0 /end CHARACTERISTIC
/begin CHARACTERISTIC KOUTP_SysAllowReadySta_flg_minval "" VALUE 0x0000 /* @ECU_Address@KOUTP_SysAllowReadySta_flg_minval@ */ Scalar_BOOLEAN 0 SWC_OUTP_type_CM_boolean_flg 0.0 1.0 /end CHARACTERISTIC
/begin CHARACTERISTIC KOUTP_SysAllowReadySta_flg_ovrdflg "" VALUE 0x0000 /* @ECU_Address@KOUTP_SysAllowReadySta_flg_ovrdflg@ */ Scalar_BOOLEAN 0 SWC_OUTP_type_CM_boolean_flg 0.0 1.0 /end CHARACTERISTIC
/begin CHARACTERISTIC KOUTP_SysAllowReadySta_flg_ovrdval "" VALUE 0x0000 /* @ECU_Address@KOUTP_SysAllowReadySta_flg_ovrdval@ */ Scalar_BOOLEAN 0 SWC_OUTP_type_CM_boolean_flg 0.0 1.0 /end CHARACTERISTIC
/begin CHARACTERISTIC KOUTP_TailgaSWDTC_raw32_ovrdflg "" VALUE 0x0000 /* @ECU_Address@KOUTP_TailgaSWDTC_raw32_ovrdflg@ */ Scalar_BOOLEAN 0 SWC_OUTP_type_CM_boolean_flg 0.0 1.0 /end CHARACTERISTIC
/begin CHARACTERISTIC KOUTP_VCUBrkSWSta_enum_ovrdflg "" VALUE 0x0000 /* @ECU_Address@KOUTP_VCUBrkSWSta_enum_ovrdflg@ */ Scalar_BOOLEAN 0 SWC_OUTP_type_CM_boolean_flg 0.0 1.0 /end CHARACTERISTIC
/begin CHARACTERISTIC KOUTP_VCUFLDoorSta_flg_maxval "" VALUE 0x0000 /* @ECU_Address@KOUTP_VCUFLDoorSta_flg_maxval@ */ Scalar_BOOLEAN 0 SWC_OUTP_type_CM_boolean_flg 0.0 1.0 /end CHARACTERISTIC
/begin CHARACTERISTIC KOUTP_VCUFLDoorSta_flg_minval "" VALUE 0x0000 /* @ECU_Address@KOUTP_VCUFLDoorSta_flg_minval@ */ Scalar_BOOLEAN 0 SWC_OUTP_type_CM_boolean_flg 0.0 1.0 /end CHARACTERISTIC
/begin CHARACTERISTIC KOUTP_VCUFLDoorSta_flg_ovrdflg "" VALUE 0x0000 /* @ECU_Address@KOUTP_VCUFLDoorSta_flg_ovrdflg@ */ Scalar_BOOLEAN 0 SWC_OUTP_type_CM_boolean_flg 0.0 1.0 /end CHARACTERISTIC
/begin CHARACTERISTIC KOUTP_VCUFLDoorSta_flg_ovrdval "" VALUE 0x0000 /* @ECU_Address@KOUTP_VCUFLDoorSta_flg_ovrdval@ */ Scalar_BOOLEAN 0 SWC_OUTP_type_CM_boolean_flg 0.0 1.0 /end CHARACTERISTIC
/begin CHARACTERISTIC KOUTP_VCUFRDoorSta_flg_maxval "" VALUE 0x0000 /* @ECU_Address@KOUTP_VCUFRDoorSta_flg_maxval@ */ Scalar_BOOLEAN 0 SWC_OUTP_type_CM_boolean_flg 0.0 1.0 /end CHARACTERISTIC
/begin CHARACTERISTIC KOUTP_VCUFRDoorSta_flg_minval "" VALUE 0x0000 /* @ECU_Address@KOUTP_VCUFRDoorSta_flg_minval@ */ Scalar_BOOLEAN 0 SWC_OUTP_type_CM_boolean_flg 0.0 1.0 /end CHARACTERISTIC
/begin CHARACTERISTIC KOUTP_VCUFRDoorSta_flg_ovrdflg "" VALUE 0x0000 /* @ECU_Address@KOUTP_VCUFRDoorSta_flg_ovrdflg@ */ Scalar_BOOLEAN 0 SWC_OUTP_type_CM_boolean_flg 0.0 1.0 /end CHARACTERISTIC
/begin CHARACTERISTIC KOUTP_VCUFRDoorSta_flg_ovrdval "" VALUE 0x0000 /* @ECU_Address@KOUTP_VCUFRDoorSta_flg_ovrdval@ */ Scalar_BOOLEAN 0 SWC_OUTP_type_CM_boolean_flg 0.0 1.0 /end CHARACTERISTIC
/begin CHARACTERISTIC KOUTP_VCUHoodSWSta_flg_maxval "" VALUE 0x0000 /* @ECU_Address@KOUTP_VCUHoodSWSta_flg_maxval@ */ Scalar_BOOLEAN 0 SWC_OUTP_type_CM_boolean_flg 0.0 1.0 /end CHARACTERISTIC
/begin CHARACTERISTIC KOUTP_VCUHoodSWSta_flg_minval "" VALUE 0x0000 /* @ECU_Address@KOUTP_VCUHoodSWSta_flg_minval@ */ Scalar_BOOLEAN 0 SWC_OUTP_type_CM_boolean_flg 0.0 1.0 /end CHARACTERISTIC
/begin CHARACTERISTIC KOUTP_VCUHoodSWSta_flg_ovrdflg "" VALUE 0x0000 /* @ECU_Address@KOUTP_VCUHoodSWSta_flg_ovrdflg@ */ Scalar_BOOLEAN 0 SWC_OUTP_type_CM_boolean_flg 0.0 1.0 /end CHARACTERISTIC
/begin CHARACTERISTIC KOUTP_VCUHoodSWSta_flg_ovrdval "" VALUE 0x0000 /* @ECU_Address@KOUTP_VCUHoodSWSta_flg_ovrdval@ */ Scalar_BOOLEAN 0 SWC_OUTP_type_CM_boolean_flg 0.0 1.0 /end CHARACTERISTIC
/begin CHARACTERISTIC KOUTP_VCURAPSErrLv2_flg_maxval "" VALUE 0x0000 /* @ECU_Address@KOUTP_VCURAPSErrLv2_flg_maxval@ */ Scalar_BOOLEAN 0 SWC_OUTP_type_CM_boolean_flg 0.0 1.0 /end CHARACTERISTIC
/begin CHARACTERISTIC KOUTP_VCURAPSErrLv2_flg_minval "" VALUE 0x0000 /* @ECU_Address@KOUTP_VCURAPSErrLv2_flg_minval@ */ Scalar_BOOLEAN 0 SWC_OUTP_type_CM_boolean_flg 0.0 1.0 /end CHARACTERISTIC
/begin CHARACTERISTIC KOUTP_VCURAPSErrLv2_flg_ovrdflg "" VALUE 0x0000 /* @ECU_Address@KOUTP_VCURAPSErrLv2_flg_ovrdflg@ */ Scalar_BOOLEAN 0 SWC_OUTP_type_CM_boolean_flg 0.0 1.0 /end CHARACTERISTIC
/begin CHARACTERISTIC KOUTP_VCURAPSErrLv2_flg_ovrdval "" VALUE 0x0000 /* @ECU_Address@KOUTP_VCURAPSErrLv2_flg_ovrdval@ */ Scalar_BOOLEAN 0 SWC_OUTP_type_CM_boolean_flg 0.0 1.0 /end CHARACTERISTIC
/begin CHARACTERISTIC KOUTP_VCURAPSErrLv3_flg_maxval "" VALUE 0x0000 /* @ECU_Address@KOUTP_VCURAPSErrLv3_flg_maxval@ */ Scalar_BOOLEAN 0 SWC_OUTP_type_CM_boolean_flg 0.0 1.0 /end CHARACTERISTIC
/begin CHARACTERISTIC KOUTP_VCURAPSErrLv3_flg_minval "" VALUE 0x0000 /* @ECU_Address@KOUTP_VCURAPSErrLv3_flg_minval@ */ Scalar_BOOLEAN 0 SWC_OUTP_type_CM_boolean_flg 0.0 1.0 /end CHARACTERISTIC
/begin CHARACTERISTIC KOUTP_VCURAPSErrLv3_flg_ovrdflg "" VALUE 0x0000 /* @ECU_Address@KOUTP_VCURAPSErrLv3_flg_ovrdflg@ */ Scalar_BOOLEAN 0 SWC_OUTP_type_CM_boolean_flg 0.0 1.0 /end CHARACTERISTIC
/begin CHARACTERISTIC KOUTP_VCURAPSErrLv3_flg_ovrdval "" VALUE 0x0000 /* @ECU_Address@KOUTP_VCURAPSErrLv3_flg_ovrdval@ */ Scalar_BOOLEAN 0 SWC_OUTP_type_CM_boolean_flg 0.0 1.0 /end CHARACTERISTIC
/begin CHARACTERISTIC KOUTP_VCURLDoorSta_flg_maxval "" VALUE 0x0000 /* @ECU_Address@KOUTP_VCURLDoorSta_flg_maxval@ */ Scalar_BOOLEAN 0 SWC_OUTP_type_CM_boolean_flg 0.0 1.0 /end CHARACTERISTIC
/begin CHARACTERISTIC KOUTP_VCURLDoorSta_flg_minval "" VALUE 0x0000 /* @ECU_Address@KOUTP_VCURLDoorSta_flg_minval@ */ Scalar_BOOLEAN 0 SWC_OUTP_type_CM_boolean_flg 0.0 1.0 /end CHARACTERISTIC
/begin CHARACTERISTIC KOUTP_VCURLDoorSta_flg_ovrdflg "" VALUE 0x0000 /* @ECU_Address@KOUTP_VCURLDoorSta_flg_ovrdflg@ */ Scalar_BOOLEAN 0 SWC_OUTP_type_CM_boolean_flg 0.0 1.0 /end CHARACTERISTIC
/begin CHARACTERISTIC KOUTP_VCURLDoorSta_flg_ovrdval "" VALUE 0x0000 /* @ECU_Address@KOUTP_VCURLDoorSta_flg_ovrdval@ */ Scalar_BOOLEAN 0 SWC_OUTP_type_CM_boolean_flg 0.0 1.0 /end CHARACTERISTIC
/begin CHARACTERISTIC KOUTP_VCURRDoorSta_flg_maxval "" VALUE 0x0000 /* @ECU_Address@KOUTP_VCURRDoorSta_flg_maxval@ */ Scalar_BOOLEAN 0 SWC_OUTP_type_CM_boolean_flg 0.0 1.0 /end CHARACTERISTIC
/begin CHARACTERISTIC KOUTP_VCURRDoorSta_flg_minval "" VALUE 0x0000 /* @ECU_Address@KOUTP_VCURRDoorSta_flg_minval@ */ Scalar_BOOLEAN 0 SWC_OUTP_type_CM_boolean_flg 0.0 1.0 /end CHARACTERISTIC
/begin CHARACTERISTIC KOUTP_VCURRDoorSta_flg_ovrdflg "" VALUE 0x0000 /* @ECU_Address@KOUTP_VCURRDoorSta_flg_ovrdflg@ */ Scalar_BOOLEAN 0 SWC_OUTP_type_CM_boolean_flg 0.0 1.0 /end CHARACTERISTIC
/begin CHARACTERISTIC KOUTP_VCURRDoorSta_flg_ovrdval "" VALUE 0x0000 /* @ECU_Address@KOUTP_VCURRDoorSta_flg_ovrdval@ */ Scalar_BOOLEAN 0 SWC_OUTP_type_CM_boolean_flg 0.0 1.0 /end CHARACTERISTIC
/begin CHARACTERISTIC KOUTP_VCUTailgateSWSta_flg_maxval "" VALUE 0x0000 /* @ECU_Address@KOUTP_VCUTailgateSWSta_flg_maxval@ */ Scalar_BOOLEAN 0 SWC_OUTP_type_CM_boolean_flg 0.0 1.0 /end CHARACTERISTIC
/begin CHARACTERISTIC KOUTP_VCUTailgateSWSta_flg_minval "" VALUE 0x0000 /* @ECU_Address@KOUTP_VCUTailgateSWSta_flg_minval@ */ Scalar_BOOLEAN 0 SWC_OUTP_type_CM_boolean_flg 0.0 1.0 /end CHARACTERISTIC
/begin CHARACTERISTIC KOUTP_VCUTailgateSWSta_flg_ovrdflg "" VALUE 0x0000 /* @ECU_Address@KOUTP_VCUTailgateSWSta_flg_ovrdflg@ */ Scalar_BOOLEAN 0 SWC_OUTP_type_CM_boolean_flg 0.0 1.0 /end CHARACTERISTIC
/begin CHARACTERISTIC KOUTP_VCUTailgateSWSta_flg_ovrdval "" VALUE 0x0000 /* @ECU_Address@KOUTP_VCUTailgateSWSta_flg_ovrdval@ */ Scalar_BOOLEAN 0 SWC_OUTP_type_CM_boolean_flg 0.0 1.0 /end CHARACTERISTIC
/begin CHARACTERISTIC KOUTP_VehMalfunLevel_enum_ovrdflg "" VALUE 0x0000 /* @ECU_Address@KOUTP_VehMalfunLevel_enum_ovrdflg@ */ Scalar_BOOLEAN 0 SWC_OUTP_type_CM_boolean_flg 0.0 1.0 /end CHARACTERISTIC
/begin CHARACTERISTIC KOUTP_ZoneSCPNoComDTC_raw32_ovrdflg "" VALUE 0x0000 /* @ECU_Address@KOUTP_ZoneSCPNoComDTC_raw32_ovrdflg@ */ Scalar_BOOLEAN 0 SWC_OUTP_type_CM_boolean_flg 0.0 1.0 /end CHARACTERISTIC
/begin CHARACTERISTIC KOUTP_CALID_cnt_maxval "" VALUE 0x0000 /* @ECU_Address@KOUTP_CALID_cnt_maxval@ */ Scalar_UBYTE 0 SWC_OUTP_type_CM_uint8_cnt 0.0 255.0 /end CHARACTERISTIC
/begin CHARACTERISTIC KOUTP_CALID_cnt_minval "" VALUE 0x0000 /* @ECU_Address@KOUTP_CALID_cnt_minval@ */ Scalar_UBYTE 0 SWC_OUTP_type_CM_uint8_cnt 0.0 255.0 /end CHARACTERISTIC
/begin CHARACTERISTIC KOUTP_CALID_cnt_ovrdval "" VALUE 0x0000 /* @ECU_Address@KOUTP_CALID_cnt_ovrdval@ */ Scalar_UBYTE 0 SWC_OUTP_type_CM_uint8_enum 0.0 255.0 /end CHARACTERISTIC
/begin CHARACTERISTIC KOUTP_DIDModelVersionChksum_raw_maxval "" VALUE 0x0000 /* @ECU_Address@KOUTP_DIDModelVersionChksum_raw_maxval@ */ Scalar_UBYTE 0 SWC_OUTP_type_CM_uint8_enum 0.0 255.0 /end CHARACTERISTIC
/begin CHARACTERISTIC KOUTP_DIDModelVersionChksum_raw_minval "" VALUE 0x0000 /* @ECU_Address@KOUTP_DIDModelVersionChksum_raw_minval@ */ Scalar_UBYTE 0 SWC_OUTP_type_CM_uint8_enum 0.0 255.0 /end CHARACTERISTIC
/begin CHARACTERISTIC KOUTP_DIDModelVersionChksum_raw_ovrdval "" VALUE 0x0000 /* @ECU_Address@KOUTP_DIDModelVersionChksum_raw_ovrdval@ */ Scalar_UBYTE 0 SWC_OUTP_type_CM_uint8_enum 0.0 255.0 /end CHARACTERISTIC
/begin CHARACTERISTIC KOUTP_DIDModelVersion_raw_maxval "" VALUE 0x0000 /* @ECU_Address@KOUTP_DIDModelVersion_raw_maxval@ */ Scalar_UBYTE 0 SWC_OUTP_type_CM_uint8_enum 0.0 255.0 /end CHARACTERISTIC
/begin CHARACTERISTIC KOUTP_DIDModelVersion_raw_minval "" VALUE 0x0000 /* @ECU_Address@KOUTP_DIDModelVersion_raw_minval@ */ Scalar_UBYTE 0 SWC_OUTP_type_CM_uint8_enum 0.0 255.0 /end CHARACTERISTIC
/begin CHARACTERISTIC KOUTP_DIDModelVersion_raw_ovrdval "" VALUE 0x0000 /* @ECU_Address@KOUTP_DIDModelVersion_raw_ovrdval@ */ Scalar_UBYTE 0 SWC_OUTP_type_CM_uint8_enum 0.0 255.0 /end CHARACTERISTIC
/begin CHARACTERISTIC KOUTP_ECUNAME_cnt_maxval "" VALUE 0x0000 /* @ECU_Address@KOUTP_ECUNAME_cnt_maxval@ */ Scalar_UBYTE 0 SWC_OUTP_type_CM_uint8_cnt 0.0 255.0 /end CHARACTERISTIC
/begin CHARACTERISTIC KOUTP_ECUNAME_cnt_minval "" VALUE 0x0000 /* @ECU_Address@KOUTP_ECUNAME_cnt_minval@ */ Scalar_UBYTE 0 SWC_OUTP_type_CM_uint8_cnt 0.0 255.0 /end CHARACTERISTIC
/begin CHARACTERISTIC KOUTP_ECUNAME_cnt_ovrdval "" VALUE 0x0000 /* @ECU_Address@KOUTP_ECUNAME_cnt_ovrdval@ */ Scalar_UBYTE 0 SWC_OUTP_type_CM_uint8_enum 0.0 255.0 /end CHARACTERISTIC
/begin CHARACTERISTIC KOUTP_HEVMODE_enum_maxval "" VALUE 0x0000 /* @ECU_Address@KOUTP_HEVMODE_enum_maxval@ */ Scalar_UBYTE 0 SWC_OUTP_type_CM_uint8_enum 0.0 255.0 /end CHARACTERISTIC
/begin CHARACTERISTIC KOUTP_HEVMODE_enum_minval "" VALUE 0x0000 /* @ECU_Address@KOUTP_HEVMODE_enum_minval@ */ Scalar_UBYTE 0 SWC_OUTP_type_CM_uint8_enum 0.0 255.0 /end CHARACTERISTIC
/begin CHARACTERISTIC KOUTP_HEVMODE_enum_ovrdval "" VALUE 0x0000 /* @ECU_Address@KOUTP_HEVMODE_enum_ovrdval@ */ Scalar_UBYTE 0 SWC_OUTP_type_CM_uint8_enum 0.0 255.0 /end CHARACTERISTIC
/begin CHARACTERISTIC KOUTP_VCUBrkSWSta_enum_maxval "" VALUE 0x0000 /* @ECU_Address@KOUTP_VCUBrkSWSta_enum_maxval@ */ Scalar_UBYTE 0 SWC_OUTP_type_CM_uint8_enum 0.0 255.0 /end CHARACTERISTIC
/begin CHARACTERISTIC KOUTP_VCUBrkSWSta_enum_minval "" VALUE 0x0000 /* @ECU_Address@KOUTP_VCUBrkSWSta_enum_minval@ */ Scalar_UBYTE 0 SWC_OUTP_type_CM_uint8_enum 0.0 255.0 /end CHARACTERISTIC
/begin CHARACTERISTIC KOUTP_VCUBrkSWSta_enum_ovrdval "" VALUE 0x0000 /* @ECU_Address@KOUTP_VCUBrkSWSta_enum_ovrdval@ */ Scalar_UBYTE 0 SWC_OUTP_type_CM_uint8_enum 0.0 255.0 /end CHARACTERISTIC
/begin CHARACTERISTIC KOUTP_VehMalfunLevel_enum_maxval "" VALUE 0x0000 /* @ECU_Address@KOUTP_VehMalfunLevel_enum_maxval@ */ Scalar_UBYTE 0 SWC_OUTP_type_CM_uint8_enum 0.0 255.0 /end CHARACTERISTIC
/begin CHARACTERISTIC KOUTP_VehMalfunLevel_enum_minval "" VALUE 0x0000 /* @ECU_Address@KOUTP_VehMalfunLevel_enum_minval@ */ Scalar_UBYTE 0 SWC_OUTP_type_CM_uint8_enum 0.0 255.0 /end CHARACTERISTIC
/begin CHARACTERISTIC KOUTP_VehMalfunLevel_enum_ovrdval "" VALUE 0x0000 /* @ECU_Address@KOUTP_VehMalfunLevel_enum_ovrdval@ */ Scalar_UBYTE 0 SWC_OUTP_type_CM_uint8_enum 0.0 255.0 /end CHARACTERISTIC
/begin COMPU_METHOD SWC_OUTP_type_CM_single_pct "Q = V" RAT_FUNC "%8.6" "pct" COEFFS 0 1 0 0 0 1 /end COMPU_METHOD
/begin COMPU_METHOD SWC_OUTP_type_CM_single_C "Q = V" RAT_FUNC "%8.6" "C" COEFFS 0 1 0 0 0 1 /end COMPU_METHOD
/begin COMPU_METHOD SWC_OUTP_type_CM_single_km "Q = V" RAT_FUNC "%8.6" "km" COEFFS 0 1 0 0 0 1 /end COMPU_METHOD
/begin COMPU_METHOD SWC_OUTP_type_CM_single_A "Q = V" RAT_FUNC "%8.6" "A" COEFFS 0 1 0 0 0 1 /end COMPU_METHOD
/begin COMPU_METHOD SWC_OUTP_type_CM_single_V "Q = V" RAT_FUNC "%8.6" "V" COEFFS 0 1 0 0 0 1 /end COMPU_METHOD
/begin COMPU_METHOD SWC_OUTP_type_CM_single_kWh "Q = V" RAT_FUNC "%8.6" "kWh" COEFFS 0 1 0 0 0 1 /end COMPU_METHOD
/begin COMPU_METHOD SWC_OUTP_type_CM_single_Ahr "Q = V" RAT_FUNC "%8.6" "Ahr" COEFFS 0 1 0 0 0 1 /end COMPU_METHOD
/begin COMPU_METHOD SWC_OUTP_type_CM_single_Ahps "Q = V" RAT_FUNC "%8.6" "Ahps" COEFFS 0 1 0 0 0 1 /end COMPU_METHOD
/begin COMPU_METHOD SWC_OUTP_type_CM_single_kW "Q = V" RAT_FUNC "%8.6" "kW" COEFFS 0 1 0 0 0 1 /end COMPU_METHOD
/begin COMPU_METHOD SWC_OUTP_type_CM_uint32_raw32 "Q = V" RAT_FUNC "%10.0" "raw32" COEFFS 0 1 0 0 0 1 /end COMPU_METHOD
/begin COMPU_METHOD SWC_OUTP_type_CM_uint32_sec "Q = V" RAT_FUNC "%10.0" "sec" COEFFS 0 1 0 0 0 1 /end COMPU_METHOD
/begin COMPU_METHOD SWC_OUTP_type_CM_uint16_min "Q = V" RAT_FUNC "%5.0" "min" COEFFS 0 1 0 0 0 1 /end COMPU_METHOD
/begin COMPU_METHOD SWC_OUTP_type_CM_boolean_flg "Q = V" RAT_FUNC "%1.0" "flg" COEFFS 0 1 0 0 0 1 /end COMPU_METHOD
/begin COMPU_METHOD SWC_OUTP_type_CM_uint8_enum "Q = V" RAT_FUNC "%3.0" "enum" COEFFS 0 1 0 0 0 1 /end COMPU_METHOD
/begin COMPU_METHOD SWC_OUTP_type_CM_uint8_cnt "Q = V" RAT_FUNC "%3.0" "cnt" COEFFS 0 1 0 0 0 1 /end COMPU_METHOD
/begin GROUP S318_Signal_Limit "SWC_OUTP_type/run_SWC_OUTP_5ms_sys/OUTP/outpmodule/VDDM_FCMACCSigErrDetDTC_raw32_Inproc/Signal_Limit"
 /begin REF_CHARACTERISTIC KOUTP_FCMACCSigErrDetDTC_raw32_maxval KOUTP_FCMACCSigErrDetDTC_raw32_minval /end REF_CHARACTERISTIC
/end GROUP
/begin GROUP S318_Signal_Override "SWC_OUTP_type/run_SWC_OUTP_5ms_sys/OUTP/outpmodule/VDDM_FCMACCSigErrDetDTC_raw32_Inproc/Signal_Override"
 /begin REF_CHARACTERISTIC KOUTP_FCMACCSigErrDetDTC_raw32_ovrdflg KOUTP_FCMACCSigErrDetDTC_raw32_ovrdval /end REF_CHARACTERISTIC
/end GROUP
/begin GROUP S319_Signal_Limit "SWC_OUTP_type/run_SWC_OUTP_5ms_sys/OUTP/outpmodule/VDDM_FCRUSSDTC_raw32_Inproc/Signal_Limit" /begin REF_CHARACTERISTIC KOUTP_FCRUSSDTC_raw32_maxval KOUTP_FCRUSSDTC_raw32_minval /end REF_CHARACTERISTIC /end GROUP
/begin GROUP S319_Signal_Override "SWC_OUTP_type/run_SWC_OUTP_5ms_sys/OUTP/outpmodule/VDDM_FCRUSSDTC_raw32_Inproc/Signal_Override"
 /begin REF_CHARACTERISTIC KOUTP_FCRUSSDTC_raw32_ovrdflg KOUTP_FCRUSSDTC_raw32_ovrdval /end REF_CHARACTERISTIC
/end GROUP
/begin GROUP S320_Signal_Limit "SWC_OUTP_type/run_SWC_OUTP_5ms_sys/OUTP/outpmodule/VDDM_FLDoorSWDTC_raw32_Inproc/Signal_Limit"
 /begin REF_CHARACTERISTIC KOUTP_FLDoorSWDTC_raw32_maxval KOUTP_FLDoorSWDTC_raw32_minval /end REF_CHARACTERISTIC
/end GROUP
/begin GROUP S320_Signal_Override "SWC_OUTP_type/run_SWC_OUTP_5ms_sys/OUTP/outpmodule/VDDM_FLDoorSWDTC_raw32_Inproc/Signal_Override"
 /begin REF_CHARACTERISTIC KOUTP_FLDoorSWDTC_raw32_ovrdflg KOUTP_FLDoorSWDTC_raw32_ovrdval /end REF_CHARACTERISTIC
/end GROUP
/begin GROUP S321_Signal_Limit "SWC_OUTP_type/run_SWC_OUTP_5ms_sys/OUTP/outpmodule/VDDM_FLLUSSDTC_raw32_Inproc/Signal_Limit" /begin REF_CHARACTERISTIC KOUTP_FLLUSSDTC_raw32_maxval KOUTP_FLLUSSDTC_raw32_minval /end REF_CHARACTERISTIC /end GROUP
/begin GROUP S321_Signal_Override "SWC_OUTP_type/run_SWC_OUTP_5ms_sys/OUTP/outpmodule/VDDM_FLLUSSDTC_raw32_Inproc/Signal_Override"
 /begin REF_CHARACTERISTIC KOUTP_FLLUSSDTC_raw32_ovrdflg KOUTP_FLLUSSDTC_raw32_ovrdval /end REF_CHARACTERISTIC
/end GROUP
/begin GROUP S322_Signal_Limit "SWC_OUTP_type/run_SWC_OUTP_5ms_sys/OUTP/outpmodule/VDDM_FLRUSSDTC_raw32_Inproc/Signal_Limit" /begin REF_CHARACTERISTIC KOUTP_FLRUSSDTC_raw32_maxval KOUTP_FLRUSSDTC_raw32_minval /end REF_CHARACTERISTIC /end GROUP
/begin GROUP S322_Signal_Override "SWC_OUTP_type/run_SWC_OUTP_5ms_sys/OUTP/outpmodule/VDDM_FLRUSSDTC_raw32_Inproc/Signal_Override"
 /begin REF_CHARACTERISTIC KOUTP_FLRUSSDTC_raw32_ovrdflg KOUTP_FLRUSSDTC_raw32_ovrdval /end REF_CHARACTERISTIC
/end GROUP
/begin GROUP S323_Signal_Limit "SWC_OUTP_type/run_SWC_OUTP_5ms_sys/OUTP/outpmodule/VDDM_FMLUSSDTC_raw32_Inproc/Signal_Limit" /begin REF_CHARACTERISTIC KOUTP_FMLUSSDTC_raw32_maxval KOUTP_FMLUSSDTC_raw32_minval /end REF_CHARACTERISTIC /end GROUP
/begin GROUP S323_Signal_Override "SWC_OUTP_type/run_SWC_OUTP_5ms_sys/OUTP/outpmodule/VDDM_FMLUSSDTC_raw32_Inproc/Signal_Override"
 /begin REF_CHARACTERISTIC KOUTP_FMLUSSDTC_raw32_ovrdflg KOUTP_FMLUSSDTC_raw32_ovrdval /end REF_CHARACTERISTIC
/end GROUP
/begin GROUP S324_Signal_Limit "SWC_OUTP_type/run_SWC_OUTP_5ms_sys/OUTP/outpmodule/VDDM_FMRUSSDTC_raw32_Inproc/Signal_Limit" /begin REF_CHARACTERISTIC KOUTP_FMRUSSDTC_raw32_maxval KOUTP_FMRUSSDTC_raw32_minval /end REF_CHARACTERISTIC /end GROUP
/begin GROUP S324_Signal_Override "SWC_OUTP_type/run_SWC_OUTP_5ms_sys/OUTP/outpmodule/VDDM_FMRUSSDTC_raw32_Inproc/Signal_Override"
 /begin REF_CHARACTERISTIC KOUTP_FMRUSSDTC_raw32_ovrdflg KOUTP_FMRUSSDTC_raw32_ovrdval /end REF_CHARACTERISTIC
/end GROUP
/begin GROUP S325_Signal_Limit "SWC_OUTP_type/run_SWC_OUTP_5ms_sys/OUTP/outpmodule/VDDM_FRDoorSWDTC_raw32_Inproc/Signal_Limit"
 /begin REF_CHARACTERISTIC KOUTP_FRDoorSWDTC_raw32_maxval KOUTP_FRDoorSWDTC_raw32_minval /end REF_CHARACTERISTIC
/end GROUP
/begin GROUP S325_Signal_Override "SWC_OUTP_type/run_SWC_OUTP_5ms_sys/OUTP/outpmodule/VDDM_FRDoorSWDTC_raw32_Inproc/Signal_Override"
 /begin REF_CHARACTERISTIC KOUTP_FRDoorSWDTC_raw32_ovrdflg KOUTP_FRDoorSWDTC_raw32_ovrdval /end REF_CHARACTERISTIC
/end GROUP
/begin GROUP S326_Signal_Limit "SWC_OUTP_type/run_SWC_OUTP_5ms_sys/OUTP/outpmodule/VDDM_FrMCUSigErrDetDTC_raw32_Inproc/Signal_Limit"
 /begin REF_CHARACTERISTIC KOUTP_FrMCUSigErrDetDTC_raw32_maxval KOUTP_FrMCUSigErrDetDTC_raw32_minval /end REF_CHARACTERISTIC
/end GROUP
/begin GROUP S326_Signal_Override "SWC_OUTP_type/run_SWC_OUTP_5ms_sys/OUTP/outpmodule/VDDM_FrMCUSigErrDetDTC_raw32_Inproc/Signal_Override"
 /begin REF_CHARACTERISTIC KOUTP_FrMCUSigErrDetDTC_raw32_ovrdflg KOUTP_FrMCUSigErrDetDTC_raw32_ovrdval /end REF_CHARACTERISTIC
/end GROUP
/begin GROUP S327_Signal_Limit "SWC_OUTP_type/run_SWC_OUTP_5ms_sys/OUTP/outpmodule/VDDM_FrMCUTqErrDTC_raw32_Inproc/Signal_Limit"
 /begin REF_CHARACTERISTIC KOUTP_FrMCUTqErrDTC_raw32_maxval KOUTP_FrMCUTqErrDTC_raw32_minval /end REF_CHARACTERISTIC
/end GROUP
/begin GROUP S327_Signal_Override "SWC_OUTP_type/run_SWC_OUTP_5ms_sys/OUTP/outpmodule/VDDM_FrMCUTqErrDTC_raw32_Inproc/Signal_Override"
 /begin REF_CHARACTERISTIC KOUTP_FrMCUTqErrDTC_raw32_ovrdflg KOUTP_FrMCUTqErrDTC_raw32_ovrdval /end REF_CHARACTERISTIC
/end GROUP
/begin GROUP S328_Signal_Limit "SWC_OUTP_type/run_SWC_OUTP_5ms_sys/OUTP/outpmodule/VDDM_HVB4PreDTC_raw32_Inproc/Signal_Limit"
 /begin REF_CHARACTERISTIC KOUTP_HVB4PreDTC_raw32_maxval KOUTP_HVB4PreDTC_raw32_minval /end REF_CHARACTERISTIC
/end GROUP
/begin GROUP S328_Signal_Override "SWC_OUTP_type/run_SWC_OUTP_5ms_sys/OUTP/outpmodule/VDDM_HVB4PreDTC_raw32_Inproc/Signal_Override"
 /begin REF_CHARACTERISTIC KOUTP_HVB4PreDTC_raw32_ovrdflg KOUTP_HVB4PreDTC_raw32_ovrdval /end REF_CHARACTERISTIC
/end GROUP
/begin GROUP S329_Signal_Limit "SWC_OUTP_type/run_SWC_OUTP_5ms_sys/OUTP/outpmodule/VDDM_HVRlyCloDTC_raw32_Inproc/Signal_Limit"
 /begin REF_CHARACTERISTIC KOUTP_HVRlyCloDTC_raw32_maxval KOUTP_HVRlyCloDTC_raw32_minval /end REF_CHARACTERISTIC
/end GROUP
/begin GROUP S329_Signal_Override "SWC_OUTP_type/run_SWC_OUTP_5ms_sys/OUTP/outpmodule/VDDM_HVRlyCloDTC_raw32_Inproc/Signal_Override"
 /begin REF_CHARACTERISTIC KOUTP_HVRlyCloDTC_raw32_ovrdflg KOUTP_HVRlyCloDTC_raw32_ovrdval /end REF_CHARACTERISTIC
/end GROUP
/begin GROUP S330_Signal_Limit "SWC_OUTP_type/run_SWC_OUTP_5ms_sys/OUTP/outpmodule/VDDM_HVRlyOpDTC_raw32_Inproc/Signal_Limit"
 /begin REF_CHARACTERISTIC KOUTP_HVRlyOpDTC_raw32_maxval KOUTP_HVRlyOpDTC_raw32_minval /end REF_CHARACTERISTIC
/end GROUP
/begin GROUP S330_Signal_Override "SWC_OUTP_type/run_SWC_OUTP_5ms_sys/OUTP/outpmodule/VDDM_HVRlyOpDTC_raw32_Inproc/Signal_Override"
 /begin REF_CHARACTERISTIC KOUTP_HVRlyOpDTC_raw32_ovrdflg KOUTP_HVRlyOpDTC_raw32_ovrdval /end REF_CHARACTERISTIC
/end GROUP
/begin GROUP S331_Signal_Limit "SWC_OUTP_type/run_SWC_OUTP_5ms_sys/OUTP/outpmodule/VDDM_HVRlyOpFail_flg_Inproc/Signal_Limit" /begin REF_CHARACTERISTIC KOUTP_HVRlyOpFail_flg_maxval KOUTP_HVRlyOpFail_flg_minval /end REF_CHARACTERISTIC /end GROUP
/begin GROUP S331_Signal_Override "SWC_OUTP_type/run_SWC_OUTP_5ms_sys/OUTP/outpmodule/VDDM_HVRlyOpFail_flg_Inproc/Signal_Override"
 /begin REF_CHARACTERISTIC KOUTP_HVRlyOpFail_flg_ovrdflg KOUTP_HVRlyOpFail_flg_ovrdval /end REF_CHARACTERISTIC
/end GROUP
/begin GROUP S332_Signal_Limit "SWC_OUTP_type/run_SWC_OUTP_5ms_sys/OUTP/outpmodule/VDDM_HiLvSaChkDTC_raw32_Inproc/Signal_Limit"
 /begin REF_CHARACTERISTIC KOUTP_HiLvSaChkDTC_raw32_maxval KOUTP_HiLvSaChkDTC_raw32_minval /end REF_CHARACTERISTIC
/end GROUP
/begin GROUP S332_Signal_Override "SWC_OUTP_type/run_SWC_OUTP_5ms_sys/OUTP/outpmodule/VDDM_HiLvSaChkDTC_raw32_Inproc/Signal_Override"
 /begin REF_CHARACTERISTIC KOUTP_HiLvSaChkDTC_raw32_ovrdflg KOUTP_HiLvSaChkDTC_raw32_ovrdval /end REF_CHARACTERISTIC
/end GROUP
/begin GROUP S333_Signal_Limit "SWC_OUTP_type/run_SWC_OUTP_5ms_sys/OUTP/outpmodule/VDDM_HoodSWDTC_raw32_Inproc/Signal_Limit" /begin REF_CHARACTERISTIC KOUTP_HoodSWDTC_raw32_maxval KOUTP_HoodSWDTC_raw32_minval /end REF_CHARACTERISTIC /end GROUP
/begin GROUP S333_Signal_Override "SWC_OUTP_type/run_SWC_OUTP_5ms_sys/OUTP/outpmodule/VDDM_HoodSWDTC_raw32_Inproc/Signal_Override"
 /begin REF_CHARACTERISTIC KOUTP_HoodSWDTC_raw32_ovrdflg KOUTP_HoodSWDTC_raw32_ovrdval /end REF_CHARACTERISTIC
/end GROUP
/begin GROUP S334_Signal_Limit "SWC_OUTP_type/run_SWC_OUTP_5ms_sys/OUTP/outpmodule/VDDM_ISAMalfuncDetDTC_raw32_Inproc/Signal_Limit"
 /begin REF_CHARACTERISTIC KOUTP_ISAMalfuncDetDTC_raw32_maxval KOUTP_ISAMalfuncDetDTC_raw32_minval /end REF_CHARACTERISTIC
/end GROUP
/begin GROUP S334_Signal_Override "SWC_OUTP_type/run_SWC_OUTP_5ms_sys/OUTP/outpmodule/VDDM_ISAMalfuncDetDTC_raw32_Inproc/Signal_Override"
 /begin REF_CHARACTERISTIC KOUTP_ISAMalfuncDetDTC_raw32_ovrdflg KOUTP_ISAMalfuncDetDTC_raw32_ovrdval /end REF_CHARACTERISTIC
/end GROUP
/begin GROUP S335_Signal_Limit "SWC_OUTP_type/run_SWC_OUTP_5ms_sys/OUTP/outpmodule/VDDM_IniLVLoDTC_raw32_Inproc/Signal_Limit"
 /begin REF_CHARACTERISTIC KOUTP_IniLVLoDTC_raw32_maxval KOUTP_IniLVLoDTC_raw32_minval /end REF_CHARACTERISTIC
/end GROUP
/begin GROUP S335_Signal_Override "SWC_OUTP_type/run_SWC_OUTP_5ms_sys/OUTP/outpmodule/VDDM_IniLVLoDTC_raw32_Inproc/Signal_Override"
 /begin REF_CHARACTERISTIC KOUTP_IniLVLoDTC_raw32_ovrdflg KOUTP_IniLVLoDTC_raw32_ovrdval /end REF_CHARACTERISTIC
/end GROUP
/begin GROUP S336_Signal_Limit "SWC_OUTP_type/run_SWC_OUTP_5ms_sys/OUTP/outpmodule/VDDM_KeyAuthDTC_raw32_Inproc/Signal_Limit"
 /begin REF_CHARACTERISTIC KOUTP_KeyAuthDTC_raw32_maxval KOUTP_KeyAuthDTC_raw32_minval /end REF_CHARACTERISTIC
/end GROUP
/begin GROUP S336_Signal_Override "SWC_OUTP_type/run_SWC_OUTP_5ms_sys/OUTP/outpmodule/VDDM_KeyAuthDTC_raw32_Inproc/Signal_Override"
 /begin REF_CHARACTERISTIC KOUTP_KeyAuthDTC_raw32_ovrdflg KOUTP_KeyAuthDTC_raw32_ovrdval /end REF_CHARACTERISTIC
/end GROUP
/begin GROUP S337_Signal_Limit "SWC_OUTP_type/run_SWC_OUTP_5ms_sys/OUTP/outpmodule/VDDM_LFBatwarnDTC_raw32_Inproc/Signal_Limit"
 /begin REF_CHARACTERISTIC KOUTP_LFBatwarnDTC_raw32_maxval KOUTP_LFBatwarnDTC_raw32_minval /end REF_CHARACTERISTIC
/end GROUP
/begin GROUP S337_Signal_Override "SWC_OUTP_type/run_SWC_OUTP_5ms_sys/OUTP/outpmodule/VDDM_LFBatwarnDTC_raw32_Inproc/Signal_Override"
 /begin REF_CHARACTERISTIC KOUTP_LFBatwarnDTC_raw32_ovrdflg KOUTP_LFBatwarnDTC_raw32_ovrdval /end REF_CHARACTERISTIC
/end GROUP
/begin GROUP S338_Signal_Limit "SWC_OUTP_type/run_SWC_OUTP_5ms_sys/OUTP/outpmodule/VDDM_LFPressIndiDTC_raw32_Inproc/Signal_Limit"
 /begin REF_CHARACTERISTIC KOUTP_LFPressIndiDTC_raw32_maxval KOUTP_LFPressIndiDTC_raw32_minval /end REF_CHARACTERISTIC
/end GROUP
/begin GROUP S338_Signal_Override "SWC_OUTP_type/run_SWC_OUTP_5ms_sys/OUTP/outpmodule/VDDM_LFPressIndiDTC_raw32_Inproc/Signal_Override"
 /begin REF_CHARACTERISTIC KOUTP_LFPressIndiDTC_raw32_ovrdflg KOUTP_LFPressIndiDTC_raw32_ovrdval /end REF_CHARACTERISTIC
/end GROUP
/begin GROUP S339_Signal_Limit "SWC_OUTP_type/run_SWC_OUTP_5ms_sys/OUTP/outpmodule/VDDM_LFSensorFailDTC_raw32_Inproc/Signal_Limit"
 /begin REF_CHARACTERISTIC KOUTP_LFSensorFailDTC_raw32_maxval KOUTP_LFSensorFailDTC_raw32_minval /end REF_CHARACTERISTIC
/end GROUP
/begin GROUP S339_Signal_Override "SWC_OUTP_type/run_SWC_OUTP_5ms_sys/OUTP/outpmodule/VDDM_LFSensorFailDTC_raw32_Inproc/Signal_Override"
 /begin REF_CHARACTERISTIC KOUTP_LFSensorFailDTC_raw32_ovrdflg KOUTP_LFSensorFailDTC_raw32_ovrdval /end REF_CHARACTERISTIC
/end GROUP
/begin GROUP S340_Signal_Limit "SWC_OUTP_type/run_SWC_OUTP_5ms_sys/OUTP/outpmodule/VDDM_LFWheelTmpHighDTC_raw32_Inproc/Signal_Limit"
 /begin REF_CHARACTERISTIC KOUTP_LFWheelTmpHighDTC_raw32_maxval KOUTP_LFWheelTmpHighDTC_raw32_minval /end REF_CHARACTERISTIC
/end GROUP
/begin GROUP S340_Signal_Override "SWC_OUTP_type/run_SWC_OUTP_5ms_sys/OUTP/outpmodule/VDDM_LFWheelTmpHighDTC_raw32_Inproc/Signal_Override"
 /begin REF_CHARACTERISTIC KOUTP_LFWheelTmpHighDTC_raw32_ovrdflg KOUTP_LFWheelTmpHighDTC_raw32_ovrdval /end REF_CHARACTERISTIC
/end GROUP
/begin GROUP S341_Signal_Limit "SWC_OUTP_type/run_SWC_OUTP_5ms_sys/OUTP/outpmodule/VDDM_LRBatwarnDTC_raw32_Inproc/Signal_Limit"
 /begin REF_CHARACTERISTIC KOUTP_LRBatwarnDTC_raw32_maxval KOUTP_LRBatwarnDTC_raw32_minval /end REF_CHARACTERISTIC
/end GROUP
/begin GROUP S341_Signal_Override "SWC_OUTP_type/run_SWC_OUTP_5ms_sys/OUTP/outpmodule/VDDM_LRBatwarnDTC_raw32_Inproc/Signal_Override"
 /begin REF_CHARACTERISTIC KOUTP_LRBatwarnDTC_raw32_ovrdflg KOUTP_LRBatwarnDTC_raw32_ovrdval /end REF_CHARACTERISTIC
/end GROUP
/begin GROUP S342_Signal_Limit "SWC_OUTP_type/run_SWC_OUTP_5ms_sys/OUTP/outpmodule/VDDM_LRPressIndiDTC_raw32_Inproc/Signal_Limit"
 /begin REF_CHARACTERISTIC KOUTP_LRPressIndiDTC_raw32_maxval KOUTP_LRPressIndiDTC_raw32_minval /end REF_CHARACTERISTIC
/end GROUP
/begin GROUP S342_Signal_Override "SWC_OUTP_type/run_SWC_OUTP_5ms_sys/OUTP/outpmodule/VDDM_LRPressIndiDTC_raw32_Inproc/Signal_Override"
 /begin REF_CHARACTERISTIC KOUTP_LRPressIndiDTC_raw32_ovrdflg KOUTP_LRPressIndiDTC_raw32_ovrdval /end REF_CHARACTERISTIC
/end GROUP
/begin GROUP S343_Signal_Limit "SWC_OUTP_type/run_SWC_OUTP_5ms_sys/OUTP/outpmodule/VDDM_LRSensorFailDTC_raw32_Inproc/Signal_Limit"
 /begin REF_CHARACTERISTIC KOUTP_LRSensorFailDTC_raw32_maxval KOUTP_LRSensorFailDTC_raw32_minval /end REF_CHARACTERISTIC
/end GROUP
/begin GROUP S343_Signal_Override "SWC_OUTP_type/run_SWC_OUTP_5ms_sys/OUTP/outpmodule/VDDM_LRSensorFailDTC_raw32_Inproc/Signal_Override"
 /begin REF_CHARACTERISTIC KOUTP_LRSensorFailDTC_raw32_ovrdflg KOUTP_LRSensorFailDTC_raw32_ovrdval /end REF_CHARACTERISTIC
/end GROUP
/begin GROUP S344_Signal_Limit "SWC_OUTP_type/run_SWC_OUTP_5ms_sys/OUTP/outpmodule/VDDM_LRWheelTmpHighDTC_raw32_Inproc/Signal_Limit"
 /begin REF_CHARACTERISTIC KOUTP_LRWheelTmpHighDTC_raw32_maxval KOUTP_LRWheelTmpHighDTC_raw32_minval /end REF_CHARACTERISTIC
/end GROUP
/begin GROUP S344_Signal_Override "SWC_OUTP_type/run_SWC_OUTP_5ms_sys/OUTP/outpmodule/VDDM_LRWheelTmpHighDTC_raw32_Inproc/Signal_Override"
 /begin REF_CHARACTERISTIC KOUTP_LRWheelTmpHighDTC_raw32_ovrdflg KOUTP_LRWheelTmpHighDTC_raw32_ovrdval /end REF_CHARACTERISTIC
/end GROUP
/begin GROUP S345_Signal_Limit "SWC_OUTP_type/run_SWC_OUTP_5ms_sys/OUTP/outpmodule/VDDM_LVSupHiDTC_raw32_Inproc/Signal_Limit"
 /begin REF_CHARACTERISTIC KOUTP_LVSupHiDTC_raw32_maxval KOUTP_LVSupHiDTC_raw32_minval /end REF_CHARACTERISTIC
/end GROUP
/begin GROUP S345_Signal_Override "SWC_OUTP_type/run_SWC_OUTP_5ms_sys/OUTP/outpmodule/VDDM_LVSupHiDTC_raw32_Inproc/Signal_Override"
 /begin REF_CHARACTERISTIC KOUTP_LVSupHiDTC_raw32_ovrdflg KOUTP_LVSupHiDTC_raw32_ovrdval /end REF_CHARACTERISTIC
/end GROUP
/begin GROUP S346_Signal_Limit "SWC_OUTP_type/run_SWC_OUTP_5ms_sys/OUTP/outpmodule/VDDM_LVSupLoDTC_raw32_Inproc/Signal_Limit"
 /begin REF_CHARACTERISTIC KOUTP_LVSupLoDTC_raw32_maxval KOUTP_LVSupLoDTC_raw32_minval /end REF_CHARACTERISTIC
/end GROUP
/begin GROUP S346_Signal_Override "SWC_OUTP_type/run_SWC_OUTP_5ms_sys/OUTP/outpmodule/VDDM_LVSupLoDTC_raw32_Inproc/Signal_Override"
 /begin REF_CHARACTERISTIC KOUTP_LVSupLoDTC_raw32_ovrdflg KOUTP_LVSupLoDTC_raw32_ovrdval /end REF_CHARACTERISTIC
/end GROUP
/begin GROUP S347_Signal_Limit "SWC_OUTP_type/run_SWC_OUTP_5ms_sys/OUTP/outpmodule/VDDM_LVSysErrPwrOutErr_flg_Inproc/Signal_Limit"
 /begin REF_CHARACTERISTIC KOUTP_LVSysErrPwrOutErr_flg_maxval KOUTP_LVSysErrPwrOutErr_flg_minval /end REF_CHARACTERISTIC
/end GROUP
/begin GROUP S347_Signal_Override "SWC_OUTP_type/run_SWC_OUTP_5ms_sys/OUTP/outpmodule/VDDM_LVSysErrPwrOutErr_flg_Inproc/Signal_Override"
 /begin REF_CHARACTERISTIC KOUTP_LVSysErrPwrOutErr_flg_ovrdflg KOUTP_LVSysErrPwrOutErr_flg_ovrdval /end REF_CHARACTERISTIC
/end GROUP
/begin GROUP S348_Signal_Limit "SWC_OUTP_type/run_SWC_OUTP_5ms_sys/OUTP/outpmodule/VDDM_LimpHomeActTmp_flg_Inproc/Signal_Limit"
 /begin REF_CHARACTERISTIC KOUTP_LimpHomeActTmp_flg_maxval KOUTP_LimpHomeActTmp_flg_minval /end REF_CHARACTERISTIC
/end GROUP
/begin GROUP S348_Signal_Override "SWC_OUTP_type/run_SWC_OUTP_5ms_sys/OUTP/outpmodule/VDDM_LimpHomeActTmp_flg_Inproc/Signal_Override"
 /begin REF_CHARACTERISTIC KOUTP_LimpHomeActTmp_flg_ovrdflg KOUTP_LimpHomeActTmp_flg_ovrdval /end REF_CHARACTERISTIC
/end GROUP
/begin GROUP S349_Signal_Limit "SWC_OUTP_type/run_SWC_OUTP_5ms_sys/OUTP/outpmodule/VDDM_Lv1ErrDTC_raw32_Inproc/Signal_Limit" /begin REF_CHARACTERISTIC KOUTP_Lv1ErrDTC_raw32_maxval KOUTP_Lv1ErrDTC_raw32_minval /end REF_CHARACTERISTIC /end GROUP
/begin GROUP S349_Signal_Override "SWC_OUTP_type/run_SWC_OUTP_5ms_sys/OUTP/outpmodule/VDDM_Lv1ErrDTC_raw32_Inproc/Signal_Override"
 /begin REF_CHARACTERISTIC KOUTP_Lv1ErrDTC_raw32_ovrdflg KOUTP_Lv1ErrDTC_raw32_ovrdval /end REF_CHARACTERISTIC
/end GROUP
/begin GROUP S350_Signal_Limit "SWC_OUTP_type/run_SWC_OUTP_5ms_sys/OUTP/outpmodule/VDDM_Lv2ErrDTC_raw32_Inproc/Signal_Limit" /begin REF_CHARACTERISTIC KOUTP_Lv2ErrDTC_raw32_maxval KOUTP_Lv2ErrDTC_raw32_minval /end REF_CHARACTERISTIC /end GROUP
/begin GROUP S350_Signal_Override "SWC_OUTP_type/run_SWC_OUTP_5ms_sys/OUTP/outpmodule/VDDM_Lv2ErrDTC_raw32_Inproc/Signal_Override"
 /begin REF_CHARACTERISTIC KOUTP_Lv2ErrDTC_raw32_ovrdflg KOUTP_Lv2ErrDTC_raw32_ovrdval /end REF_CHARACTERISTIC
/end GROUP
/begin GROUP S351_Signal_Limit "SWC_OUTP_type/run_SWC_OUTP_5ms_sys/OUTP/outpmodule/VDDM_Lv3ErrDTC_raw32_Inproc/Signal_Limit" /begin REF_CHARACTERISTIC KOUTP_Lv3ErrDTC_raw32_maxval KOUTP_Lv3ErrDTC_raw32_minval /end REF_CHARACTERISTIC /end GROUP
/begin GROUP S351_Signal_Override "SWC_OUTP_type/run_SWC_OUTP_5ms_sys/OUTP/outpmodule/VDDM_Lv3ErrDTC_raw32_Inproc/Signal_Override"
 /begin REF_CHARACTERISTIC KOUTP_Lv3ErrDTC_raw32_ovrdflg KOUTP_Lv3ErrDTC_raw32_ovrdval /end REF_CHARACTERISTIC
/end GROUP
/begin GROUP S352_Signal_Limit "SWC_OUTP_type/run_SWC_OUTP_5ms_sys/OUTP/outpmodule/VDDM_Lv4ErrDTC_raw32_Inproc/Signal_Limit" /begin REF_CHARACTERISTIC KOUTP_Lv4ErrDTC_raw32_maxval KOUTP_Lv4ErrDTC_raw32_minval /end REF_CHARACTERISTIC /end GROUP
/begin GROUP S352_Signal_Override "SWC_OUTP_type/run_SWC_OUTP_5ms_sys/OUTP/outpmodule/VDDM_Lv4ErrDTC_raw32_Inproc/Signal_Override"
 /begin REF_CHARACTERISTIC KOUTP_Lv4ErrDTC_raw32_ovrdflg KOUTP_Lv4ErrDTC_raw32_ovrdval /end REF_CHARACTERISTIC
/end GROUP
/begin GROUP S353_Signal_Limit "SWC_OUTP_type/run_SWC_OUTP_5ms_sys/OUTP/outpmodule/VDDM_MCU4PreDTC_raw32_Inproc/Signal_Limit"
 /begin REF_CHARACTERISTIC KOUTP_MCU4PreDTC_raw32_maxval KOUTP_MCU4PreDTC_raw32_minval /end REF_CHARACTERISTIC
/end GROUP
/begin GROUP S353_Signal_Override "SWC_OUTP_type/run_SWC_OUTP_5ms_sys/OUTP/outpmodule/VDDM_MCU4PreDTC_raw32_Inproc/Signal_Override"
 /begin REF_CHARACTERISTIC KOUTP_MCU4PreDTC_raw32_ovrdflg KOUTP_MCU4PreDTC_raw32_ovrdval /end REF_CHARACTERISTIC
/end GROUP
/begin GROUP S354_Signal_Limit "SWC_OUTP_type/run_SWC_OUTP_5ms_sys/OUTP/outpmodule/VDDM_MCUActDTC_raw32_Inproc/Signal_Limit" /begin REF_CHARACTERISTIC KOUTP_MCUActDTC_raw32_maxval KOUTP_MCUActDTC_raw32_minval /end REF_CHARACTERISTIC /end GROUP
/begin GROUP S354_Signal_Override "SWC_OUTP_type/run_SWC_OUTP_5ms_sys/OUTP/outpmodule/VDDM_MCUActDTC_raw32_Inproc/Signal_Override"
 /begin REF_CHARACTERISTIC KOUTP_MCUActDTC_raw32_ovrdflg KOUTP_MCUActDTC_raw32_ovrdval /end REF_CHARACTERISTIC
/end GROUP
/begin GROUP S355_Signal_Limit "SWC_OUTP_type/run_SWC_OUTP_5ms_sys/OUTP/outpmodule/VDDM_MCUActDisFail_flg_Inproc/Signal_Limit"
 /begin REF_CHARACTERISTIC KOUTP_MCUActDisFail_flg_maxval KOUTP_MCUActDisFail_flg_minval /end REF_CHARACTERISTIC
/end GROUP
/begin GROUP S355_Signal_Override "SWC_OUTP_type/run_SWC_OUTP_5ms_sys/OUTP/outpmodule/VDDM_MCUActDisFail_flg_Inproc/Signal_Override"
 /begin REF_CHARACTERISTIC KOUTP_MCUActDisFail_flg_ovrdflg KOUTP_MCUActDisFail_flg_ovrdval /end REF_CHARACTERISTIC
/end GROUP
/begin GROUP S356_Signal_Limit "SWC_OUTP_type/run_SWC_OUTP_5ms_sys/OUTP/outpmodule/VDDM_MCUDisDTC_raw32_Inproc/Signal_Limit" /begin REF_CHARACTERISTIC KOUTP_MCUDisDTC_raw32_maxval KOUTP_MCUDisDTC_raw32_minval /end REF_CHARACTERISTIC /end GROUP
/begin GROUP S356_Signal_Override "SWC_OUTP_type/run_SWC_OUTP_5ms_sys/OUTP/outpmodule/VDDM_MCUDisDTC_raw32_Inproc/Signal_Override"
 /begin REF_CHARACTERISTIC KOUTP_MCUDisDTC_raw32_ovrdflg KOUTP_MCUDisDTC_raw32_ovrdval /end REF_CHARACTERISTIC
/end GROUP
/begin GROUP S357_Signal_Limit "SWC_OUTP_type/run_SWC_OUTP_5ms_sys/OUTP/outpmodule/VDDM_MCUF1CSErrDTC_raw32_Inproc/Signal_Limit"
 /begin REF_CHARACTERISTIC KOUTP_MCUF1CSErrDTC_raw32_maxval KOUTP_MCUF1CSErrDTC_raw32_minval /end REF_CHARACTERISTIC
/end GROUP
/begin GROUP S357_Signal_Override "SWC_OUTP_type/run_SWC_OUTP_5ms_sys/OUTP/outpmodule/VDDM_MCUF1CSErrDTC_raw32_Inproc/Signal_Override"
 /begin REF_CHARACTERISTIC KOUTP_MCUF1CSErrDTC_raw32_ovrdflg KOUTP_MCUF1CSErrDTC_raw32_ovrdval /end REF_CHARACTERISTIC
/end GROUP
/begin GROUP S358_Signal_Limit "SWC_OUTP_type/run_SWC_OUTP_5ms_sys/OUTP/outpmodule/VDDM_MCUF1NoComDTC_raw32_Inproc/Signal_Limit"
 /begin REF_CHARACTERISTIC KOUTP_MCUF1NoComDTC_raw32_maxval KOUTP_MCUF1NoComDTC_raw32_minval /end REF_CHARACTERISTIC
/end GROUP
/begin GROUP S358_Signal_Override "SWC_OUTP_type/run_SWC_OUTP_5ms_sys/OUTP/outpmodule/VDDM_MCUF1NoComDTC_raw32_Inproc/Signal_Override"
 /begin REF_CHARACTERISTIC KOUTP_MCUF1NoComDTC_raw32_ovrdflg KOUTP_MCUF1NoComDTC_raw32_ovrdval /end REF_CHARACTERISTIC
/end GROUP
/begin GROUP S359_Signal_Limit "SWC_OUTP_type/run_SWC_OUTP_5ms_sys/OUTP/outpmodule/VDDM_MCUF1RCErrDTC_raw32_Inproc/Signal_Limit"
 /begin REF_CHARACTERISTIC KOUTP_MCUF1RCErrDTC_raw32_maxval KOUTP_MCUF1RCErrDTC_raw32_minval /end REF_CHARACTERISTIC
/end GROUP
/begin GROUP S359_Signal_Override "SWC_OUTP_type/run_SWC_OUTP_5ms_sys/OUTP/outpmodule/VDDM_MCUF1RCErrDTC_raw32_Inproc/Signal_Override"
 /begin REF_CHARACTERISTIC KOUTP_MCUF1RCErrDTC_raw32_ovrdflg KOUTP_MCUF1RCErrDTC_raw32_ovrdval /end REF_CHARACTERISTIC
/end GROUP
/begin GROUP S360_Signal_Limit "SWC_OUTP_type/run_SWC_OUTP_5ms_sys/OUTP/outpmodule/VDDM_MCUR1CSErrDTC_raw32_Inproc/Signal_Limit"
 /begin REF_CHARACTERISTIC KOUTP_MCUR1CSErrDTC_raw32_maxval KOUTP_MCUR1CSErrDTC_raw32_minval /end REF_CHARACTERISTIC
/end GROUP
/begin GROUP S360_Signal_Override "SWC_OUTP_type/run_SWC_OUTP_5ms_sys/OUTP/outpmodule/VDDM_MCUR1CSErrDTC_raw32_Inproc/Signal_Override"
 /begin REF_CHARACTERISTIC KOUTP_MCUR1CSErrDTC_raw32_ovrdflg KOUTP_MCUR1CSErrDTC_raw32_ovrdval /end REF_CHARACTERISTIC
/end GROUP
/begin GROUP S361_Signal_Limit "SWC_OUTP_type/run_SWC_OUTP_5ms_sys/OUTP/outpmodule/VDDM_MCUR1NoComDTC_raw32_Inproc/Signal_Limit"
 /begin REF_CHARACTERISTIC KOUTP_MCUR1NoComDTC_raw32_maxval KOUTP_MCUR1NoComDTC_raw32_minval /end REF_CHARACTERISTIC
/end GROUP
/begin GROUP S361_Signal_Override "SWC_OUTP_type/run_SWC_OUTP_5ms_sys/OUTP/outpmodule/VDDM_MCUR1NoComDTC_raw32_Inproc/Signal_Override"
 /begin REF_CHARACTERISTIC KOUTP_MCUR1NoComDTC_raw32_ovrdflg KOUTP_MCUR1NoComDTC_raw32_ovrdval /end REF_CHARACTERISTIC
/end GROUP
/begin GROUP S362_Signal_Limit "SWC_OUTP_type/run_SWC_OUTP_5ms_sys/OUTP/outpmodule/VDDM_MCUR1RCErrDTC_raw32_Inproc/Signal_Limit"
 /begin REF_CHARACTERISTIC KOUTP_MCUR1RCErrDTC_raw32_maxval KOUTP_MCUR1RCErrDTC_raw32_minval /end REF_CHARACTERISTIC
/end GROUP
/begin GROUP S362_Signal_Override "SWC_OUTP_type/run_SWC_OUTP_5ms_sys/OUTP/outpmodule/VDDM_MCUR1RCErrDTC_raw32_Inproc/Signal_Override"
 /begin REF_CHARACTERISTIC KOUTP_MCUR1RCErrDTC_raw32_ovrdflg KOUTP_MCUR1RCErrDTC_raw32_ovrdval /end REF_CHARACTERISTIC
/end GROUP
/begin GROUP S363_Signal_Limit "SWC_OUTP_type/run_SWC_OUTP_5ms_sys/OUTP/outpmodule/VDDM_MSAMalfuncDetDTC_raw32_Inproc/Signal_Limit"
 /begin REF_CHARACTERISTIC KOUTP_MSAMalfuncDetDTC_raw32_maxval KOUTP_MSAMalfuncDetDTC_raw32_minval /end REF_CHARACTERISTIC
/end GROUP
/begin GROUP S363_Signal_Override "SWC_OUTP_type/run_SWC_OUTP_5ms_sys/OUTP/outpmodule/VDDM_MSAMalfuncDetDTC_raw32_Inproc/Signal_Override"
 /begin REF_CHARACTERISTIC KOUTP_MSAMalfuncDetDTC_raw32_ovrdflg KOUTP_MSAMalfuncDetDTC_raw32_ovrdval /end REF_CHARACTERISTIC
/end GROUP
/begin GROUP S364_Signal_Limit "SWC_OUTP_type/run_SWC_OUTP_5ms_sys/OUTP/outpmodule/VDDM_MidLvSaChkDTC_raw32_Inproc/Signal_Limit"
 /begin REF_CHARACTERISTIC KOUTP_MidLvSaChkDTC_raw32_maxval KOUTP_MidLvSaChkDTC_raw32_minval /end REF_CHARACTERISTIC
/end GROUP
/begin GROUP S364_Signal_Override "SWC_OUTP_type/run_SWC_OUTP_5ms_sys/OUTP/outpmodule/VDDM_MidLvSaChkDTC_raw32_Inproc/Signal_Override"
 /begin REF_CHARACTERISTIC KOUTP_MidLvSaChkDTC_raw32_ovrdflg KOUTP_MidLvSaChkDTC_raw32_ovrdval /end REF_CHARACTERISTIC
/end GROUP
/begin GROUP S365_Signal_Limit "SWC_OUTP_type/run_SWC_OUTP_5ms_sys/OUTP/outpmodule/VDDM_OBC4PreDTC_raw32_Inproc/Signal_Limit"
 /begin REF_CHARACTERISTIC KOUTP_OBC4PreDTC_raw32_maxval KOUTP_OBC4PreDTC_raw32_minval /end REF_CHARACTERISTIC
/end GROUP
/begin GROUP S365_Signal_Override "SWC_OUTP_type/run_SWC_OUTP_5ms_sys/OUTP/outpmodule/VDDM_OBC4PreDTC_raw32_Inproc/Signal_Override"
 /begin REF_CHARACTERISTIC KOUTP_OBC4PreDTC_raw32_ovrdflg KOUTP_OBC4PreDTC_raw32_ovrdval /end REF_CHARACTERISTIC
/end GROUP
/begin GROUP S366_Signal_Limit "SWC_OUTP_type/run_SWC_OUTP_5ms_sys/OUTP/outpmodule/VDDM_ONtoRdyDTC_raw32_Inproc/Signal_Limit"
 /begin REF_CHARACTERISTIC KOUTP_ONtoRdyDTC_raw32_maxval KOUTP_ONtoRdyDTC_raw32_minval /end REF_CHARACTERISTIC
/end GROUP
/begin GROUP S366_Signal_Override "SWC_OUTP_type/run_SWC_OUTP_5ms_sys/OUTP/outpmodule/VDDM_ONtoRdyDTC_raw32_Inproc/Signal_Override"
 /begin REF_CHARACTERISTIC KOUTP_ONtoRdyDTC_raw32_ovrdflg KOUTP_ONtoRdyDTC_raw32_ovrdval /end REF_CHARACTERISTIC
/end GROUP
/begin GROUP S367_Signal_Limit "SWC_OUTP_type/run_SWC_OUTP_5ms_sys/OUTP/outpmodule/VDDM_RCLUSSDTC_raw32_Inproc/Signal_Limit" /begin REF_CHARACTERISTIC KOUTP_RCLUSSDTC_raw32_maxval KOUTP_RCLUSSDTC_raw32_minval /end REF_CHARACTERISTIC /end GROUP
/begin GROUP S367_Signal_Override "SWC_OUTP_type/run_SWC_OUTP_5ms_sys/OUTP/outpmodule/VDDM_RCLUSSDTC_raw32_Inproc/Signal_Override"
 /begin REF_CHARACTERISTIC KOUTP_RCLUSSDTC_raw32_ovrdflg KOUTP_RCLUSSDTC_raw32_ovrdval /end REF_CHARACTERISTIC
/end GROUP
/begin GROUP S368_Signal_Limit "SWC_OUTP_type/run_SWC_OUTP_5ms_sys/OUTP/outpmodule/VDDM_RCRUSSDTC_raw32_Inproc/Signal_Limit" /begin REF_CHARACTERISTIC KOUTP_RCRUSSDTC_raw32_maxval KOUTP_RCRUSSDTC_raw32_minval /end REF_CHARACTERISTIC /end GROUP
/begin GROUP S368_Signal_Override "SWC_OUTP_type/run_SWC_OUTP_5ms_sys/OUTP/outpmodule/VDDM_RCRUSSDTC_raw32_Inproc/Signal_Override"
 /begin REF_CHARACTERISTIC KOUTP_RCRUSSDTC_raw32_ovrdflg KOUTP_RCRUSSDTC_raw32_ovrdval /end REF_CHARACTERISTIC
/end GROUP
/begin GROUP S369_Signal_Limit "SWC_OUTP_type/run_SWC_OUTP_5ms_sys/OUTP/outpmodule/VDDM_RFBatwarnDTC_raw32_Inproc/Signal_Limit"
 /begin REF_CHARACTERISTIC KOUTP_RFBatwarnDTC_raw32_maxval KOUTP_RFBatwarnDTC_raw32_minval /end REF_CHARACTERISTIC
/end GROUP
/begin GROUP S369_Signal_Override "SWC_OUTP_type/run_SWC_OUTP_5ms_sys/OUTP/outpmodule/VDDM_RFBatwarnDTC_raw32_Inproc/Signal_Override"
 /begin REF_CHARACTERISTIC KOUTP_RFBatwarnDTC_raw32_ovrdflg KOUTP_RFBatwarnDTC_raw32_ovrdval /end REF_CHARACTERISTIC
/end GROUP
/begin GROUP S370_Signal_Limit "SWC_OUTP_type/run_SWC_OUTP_5ms_sys/OUTP/outpmodule/VDDM_RFPressIndiDTC_raw32_Inproc/Signal_Limit"
 /begin REF_CHARACTERISTIC KOUTP_RFPressIndiDTC_raw32_maxval KOUTP_RFPressIndiDTC_raw32_minval /end REF_CHARACTERISTIC
/end GROUP
/begin GROUP S370_Signal_Override "SWC_OUTP_type/run_SWC_OUTP_5ms_sys/OUTP/outpmodule/VDDM_RFPressIndiDTC_raw32_Inproc/Signal_Override"
 /begin REF_CHARACTERISTIC KOUTP_RFPressIndiDTC_raw32_ovrdflg KOUTP_RFPressIndiDTC_raw32_ovrdval /end REF_CHARACTERISTIC
/end GROUP
/begin GROUP S371_Signal_Limit "SWC_OUTP_type/run_SWC_OUTP_5ms_sys/OUTP/outpmodule/VDDM_RFSensorFailDTC_raw32_Inproc/Signal_Limit"
 /begin REF_CHARACTERISTIC KOUTP_RFSensorFailDTC_raw32_maxval KOUTP_RFSensorFailDTC_raw32_minval /end REF_CHARACTERISTIC
/end GROUP
/begin GROUP S371_Signal_Override "SWC_OUTP_type/run_SWC_OUTP_5ms_sys/OUTP/outpmodule/VDDM_RFSensorFailDTC_raw32_Inproc/Signal_Override"
 /begin REF_CHARACTERISTIC KOUTP_RFSensorFailDTC_raw32_ovrdflg KOUTP_RFSensorFailDTC_raw32_ovrdval /end REF_CHARACTERISTIC
/end GROUP
/begin GROUP S372_Signal_Limit "SWC_OUTP_type/run_SWC_OUTP_5ms_sys/OUTP/outpmodule/VDDM_RFWheelTmpHighDTC_raw32_Inproc/Signal_Limit"
 /begin REF_CHARACTERISTIC KOUTP_RFWheelTmpHighDTC_raw32_maxval KOUTP_RFWheelTmpHighDTC_raw32_minval /end REF_CHARACTERISTIC
/end GROUP
/begin GROUP S372_Signal_Override "SWC_OUTP_type/run_SWC_OUTP_5ms_sys/OUTP/outpmodule/VDDM_RFWheelTmpHighDTC_raw32_Inproc/Signal_Override"
 /begin REF_CHARACTERISTIC KOUTP_RFWheelTmpHighDTC_raw32_ovrdflg KOUTP_RFWheelTmpHighDTC_raw32_ovrdval /end REF_CHARACTERISTIC
/end GROUP
/begin GROUP S373_Signal_Limit "SWC_OUTP_type/run_SWC_OUTP_5ms_sys/OUTP/outpmodule/VDDM_RLDoorSWDTC_raw32_Inproc/Signal_Limit"
 /begin REF_CHARACTERISTIC KOUTP_RLDoorSWDTC_raw32_maxval KOUTP_RLDoorSWDTC_raw32_minval /end REF_CHARACTERISTIC
/end GROUP
/begin GROUP S373_Signal_Override "SWC_OUTP_type/run_SWC_OUTP_5ms_sys/OUTP/outpmodule/VDDM_RLDoorSWDTC_raw32_Inproc/Signal_Override"
 /begin REF_CHARACTERISTIC KOUTP_RLDoorSWDTC_raw32_ovrdflg KOUTP_RLDoorSWDTC_raw32_ovrdval /end REF_CHARACTERISTIC
/end GROUP
/begin GROUP S374_Signal_Limit "SWC_OUTP_type/run_SWC_OUTP_5ms_sys/OUTP/outpmodule/VDDM_RLLUSSDTC_raw32_Inproc/Signal_Limit" /begin REF_CHARACTERISTIC KOUTP_RLLUSSDTC_raw32_maxval KOUTP_RLLUSSDTC_raw32_minval /end REF_CHARACTERISTIC /end GROUP
/begin GROUP S374_Signal_Override "SWC_OUTP_type/run_SWC_OUTP_5ms_sys/OUTP/outpmodule/VDDM_RLLUSSDTC_raw32_Inproc/Signal_Override"
 /begin REF_CHARACTERISTIC KOUTP_RLLUSSDTC_raw32_ovrdflg KOUTP_RLLUSSDTC_raw32_ovrdval /end REF_CHARACTERISTIC
/end GROUP
/begin GROUP S375_Signal_Limit "SWC_OUTP_type/run_SWC_OUTP_5ms_sys/OUTP/outpmodule/VDDM_RLRUSSDTC_raw32_Inproc/Signal_Limit" /begin REF_CHARACTERISTIC KOUTP_RLRUSSDTC_raw32_maxval KOUTP_RLRUSSDTC_raw32_minval /end REF_CHARACTERISTIC /end GROUP
/begin GROUP S375_Signal_Override "SWC_OUTP_type/run_SWC_OUTP_5ms_sys/OUTP/outpmodule/VDDM_RLRUSSDTC_raw32_Inproc/Signal_Override"
 /begin REF_CHARACTERISTIC KOUTP_RLRUSSDTC_raw32_ovrdflg KOUTP_RLRUSSDTC_raw32_ovrdval /end REF_CHARACTERISTIC
/end GROUP
/begin GROUP S376_Signal_Limit "SWC_OUTP_type/run_SWC_OUTP_5ms_sys/OUTP/outpmodule/VDDM_RMLUSSDTC_raw32_Inproc/Signal_Limit" /begin REF_CHARACTERISTIC KOUTP_RMLUSSDTC_raw32_maxval KOUTP_RMLUSSDTC_raw32_minval /end REF_CHARACTERISTIC /end GROUP
/begin GROUP S376_Signal_Override "SWC_OUTP_type/run_SWC_OUTP_5ms_sys/OUTP/outpmodule/VDDM_RMLUSSDTC_raw32_Inproc/Signal_Override"
 /begin REF_CHARACTERISTIC KOUTP_RMLUSSDTC_raw32_ovrdflg KOUTP_RMLUSSDTC_raw32_ovrdval /end REF_CHARACTERISTIC
/end GROUP
/begin GROUP S377_Signal_Limit "SWC_OUTP_type/run_SWC_OUTP_5ms_sys/OUTP/outpmodule/VDDM_RMRUSSDTC_raw32_Inproc/Signal_Limit" /begin REF_CHARACTERISTIC KOUTP_RMRUSSDTC_raw32_maxval KOUTP_RMRUSSDTC_raw32_minval /end REF_CHARACTERISTIC /end GROUP
/begin GROUP S377_Signal_Override "SWC_OUTP_type/run_SWC_OUTP_5ms_sys/OUTP/outpmodule/VDDM_RMRUSSDTC_raw32_Inproc/Signal_Override"
 /begin REF_CHARACTERISTIC KOUTP_RMRUSSDTC_raw32_ovrdflg KOUTP_RMRUSSDTC_raw32_ovrdval /end REF_CHARACTERISTIC
/end GROUP
/begin GROUP S378_Signal_Limit "SWC_OUTP_type/run_SWC_OUTP_5ms_sys/OUTP/outpmodule/VDDM_RRBatwarnDTC_raw32_Inproc/Signal_Limit"
 /begin REF_CHARACTERISTIC KOUTP_RRBatwarnDTC_raw32_maxval KOUTP_RRBatwarnDTC_raw32_minval /end REF_CHARACTERISTIC
/end GROUP
/begin GROUP S378_Signal_Override "SWC_OUTP_type/run_SWC_OUTP_5ms_sys/OUTP/outpmodule/VDDM_RRBatwarnDTC_raw32_Inproc/Signal_Override"
 /begin REF_CHARACTERISTIC KOUTP_RRBatwarnDTC_raw32_ovrdflg KOUTP_RRBatwarnDTC_raw32_ovrdval /end REF_CHARACTERISTIC
/end GROUP
/begin GROUP S379_Signal_Limit "SWC_OUTP_type/run_SWC_OUTP_5ms_sys/OUTP/outpmodule/VDDM_RRDoorSWDTC_raw32_Inproc/Signal_Limit"
 /begin REF_CHARACTERISTIC KOUTP_RRDoorSWDTC_raw32_maxval KOUTP_RRDoorSWDTC_raw32_minval /end REF_CHARACTERISTIC
/end GROUP
/begin GROUP S379_Signal_Override "SWC_OUTP_type/run_SWC_OUTP_5ms_sys/OUTP/outpmodule/VDDM_RRDoorSWDTC_raw32_Inproc/Signal_Override"
 /begin REF_CHARACTERISTIC KOUTP_RRDoorSWDTC_raw32_ovrdflg KOUTP_RRDoorSWDTC_raw32_ovrdval /end REF_CHARACTERISTIC
/end GROUP
/begin GROUP S380_Signal_Limit "SWC_OUTP_type/run_SWC_OUTP_5ms_sys/OUTP/outpmodule/VDDM_RRPressIndiDTC_raw32_Inproc/Signal_Limit"
 /begin REF_CHARACTERISTIC KOUTP_RRPressIndiDTC_raw32_maxval KOUTP_RRPressIndiDTC_raw32_minval /end REF_CHARACTERISTIC
/end GROUP
/begin GROUP S380_Signal_Override "SWC_OUTP_type/run_SWC_OUTP_5ms_sys/OUTP/outpmodule/VDDM_RRPressIndiDTC_raw32_Inproc/Signal_Override"
 /begin REF_CHARACTERISTIC KOUTP_RRPressIndiDTC_raw32_ovrdflg KOUTP_RRPressIndiDTC_raw32_ovrdval /end REF_CHARACTERISTIC
/end GROUP
/begin GROUP S381_Signal_Limit "SWC_OUTP_type/run_SWC_OUTP_5ms_sys/OUTP/outpmodule/VDDM_RRSensorFailDTC_raw32_Inproc/Signal_Limit"
 /begin REF_CHARACTERISTIC KOUTP_RRSensorFailDTC_raw32_maxval KOUTP_RRSensorFailDTC_raw32_minval /end REF_CHARACTERISTIC
/end GROUP
/begin GROUP S381_Signal_Override "SWC_OUTP_type/run_SWC_OUTP_5ms_sys/OUTP/outpmodule/VDDM_RRSensorFailDTC_raw32_Inproc/Signal_Override"
 /begin REF_CHARACTERISTIC KOUTP_RRSensorFailDTC_raw32_ovrdflg KOUTP_RRSensorFailDTC_raw32_ovrdval /end REF_CHARACTERISTIC
/end GROUP
/begin GROUP S382_Signal_Limit "SWC_OUTP_type/run_SWC_OUTP_5ms_sys/OUTP/outpmodule/VDDM_RRWheelTmpHighDTC_raw32_Inproc/Signal_Limit"
 /begin REF_CHARACTERISTIC KOUTP_RRWheelTmpHighDTC_raw32_maxval KOUTP_RRWheelTmpHighDTC_raw32_minval /end REF_CHARACTERISTIC
/end GROUP
/begin GROUP S382_Signal_Override "SWC_OUTP_type/run_SWC_OUTP_5ms_sys/OUTP/outpmodule/VDDM_RRWheelTmpHighDTC_raw32_Inproc/Signal_Override"
 /begin REF_CHARACTERISTIC KOUTP_RRWheelTmpHighDTC_raw32_ovrdflg KOUTP_RRWheelTmpHighDTC_raw32_ovrdval /end REF_CHARACTERISTIC
/end GROUP
/begin GROUP S383_Signal_Limit "SWC_OUTP_type/run_SWC_OUTP_5ms_sys/OUTP/outpmodule/VDDM_RrMCUSigErrDetDTC_raw32_Inproc/Signal_Limit"
 /begin REF_CHARACTERISTIC KOUTP_RrMCUSigErrDetDTC_raw32_maxval KOUTP_RrMCUSigErrDetDTC_raw32_minval /end REF_CHARACTERISTIC
/end GROUP
/begin GROUP S383_Signal_Override "SWC_OUTP_type/run_SWC_OUTP_5ms_sys/OUTP/outpmodule/VDDM_RrMCUSigErrDetDTC_raw32_Inproc/Signal_Override"
 /begin REF_CHARACTERISTIC KOUTP_RrMCUSigErrDetDTC_raw32_ovrdflg KOUTP_RrMCUSigErrDetDTC_raw32_ovrdval /end REF_CHARACTERISTIC
/end GROUP
/begin GROUP S384_Signal_Limit "SWC_OUTP_type/run_SWC_OUTP_5ms_sys/OUTP/outpmodule/VDDM_RrMCUTqErrDTC_raw32_Inproc/Signal_Limit"
 /begin REF_CHARACTERISTIC KOUTP_RrMCUTqErrDTC_raw32_maxval KOUTP_RrMCUTqErrDTC_raw32_minval /end REF_CHARACTERISTIC
/end GROUP
/begin GROUP S384_Signal_Override "SWC_OUTP_type/run_SWC_OUTP_5ms_sys/OUTP/outpmodule/VDDM_RrMCUTqErrDTC_raw32_Inproc/Signal_Override"
 /begin REF_CHARACTERISTIC KOUTP_RrMCUTqErrDTC_raw32_ovrdflg KOUTP_RrMCUTqErrDTC_raw32_ovrdval /end REF_CHARACTERISTIC
/end GROUP
/begin GROUP S385_Signal_Limit "SWC_OUTP_type/run_SWC_OUTP_5ms_sys/OUTP/outpmodule/VDDM_Shifter1CSErrDTC_raw32_Inproc/Signal_Limit"
 /begin REF_CHARACTERISTIC KOUTP_Shifter1CSErrDTC_raw32_maxval KOUTP_Shifter1CSErrDTC_raw32_minval /end REF_CHARACTERISTIC
/end GROUP
/begin GROUP S385_Signal_Override "SWC_OUTP_type/run_SWC_OUTP_5ms_sys/OUTP/outpmodule/VDDM_Shifter1CSErrDTC_raw32_Inproc/Signal_Override"
 /begin REF_CHARACTERISTIC KOUTP_Shifter1CSErrDTC_raw32_ovrdflg KOUTP_Shifter1CSErrDTC_raw32_ovrdval /end REF_CHARACTERISTIC
/end GROUP
/begin GROUP S386_Signal_Limit "SWC_OUTP_type/run_SWC_OUTP_5ms_sys/OUTP/outpmodule/VDDM_Shifter1NoComDTC_raw32_Inproc/Signal_Limit"
 /begin REF_CHARACTERISTIC KOUTP_Shifter1NoComDTC_raw32_maxval KOUTP_Shifter1NoComDTC_raw32_minval /end REF_CHARACTERISTIC
/end GROUP
/begin GROUP S386_Signal_Override "SWC_OUTP_type/run_SWC_OUTP_5ms_sys/OUTP/outpmodule/VDDM_Shifter1NoComDTC_raw32_Inproc/Signal_Override"
 /begin REF_CHARACTERISTIC KOUTP_Shifter1NoComDTC_raw32_ovrdflg KOUTP_Shifter1NoComDTC_raw32_ovrdval /end REF_CHARACTERISTIC
/end GROUP
/begin GROUP S387_Signal_Limit "SWC_OUTP_type/run_SWC_OUTP_5ms_sys/OUTP/outpmodule/VDDM_Shifter1RCErrDTC_raw32_Inproc/Signal_Limit"
 /begin REF_CHARACTERISTIC KOUTP_Shifter1RCErrDTC_raw32_maxval KOUTP_Shifter1RCErrDTC_raw32_minval /end REF_CHARACTERISTIC
/end GROUP
/begin GROUP S387_Signal_Override "SWC_OUTP_type/run_SWC_OUTP_5ms_sys/OUTP/outpmodule/VDDM_Shifter1RCErrDTC_raw32_Inproc/Signal_Override"
 /begin REF_CHARACTERISTIC KOUTP_Shifter1RCErrDTC_raw32_ovrdflg KOUTP_Shifter1RCErrDTC_raw32_ovrdval /end REF_CHARACTERISTIC
/end GROUP
/begin GROUP S388_Signal_Limit "SWC_OUTP_type/run_SWC_OUTP_5ms_sys/OUTP/outpmodule/VDDM_SysAllowReadySta_flg_Inproc/Signal_Limit"
 /begin REF_CHARACTERISTIC KOUTP_SysAllowReadySta_flg_maxval KOUTP_SysAllowReadySta_flg_minval /end REF_CHARACTERISTIC
/end GROUP
/begin GROUP S388_Signal_Override "SWC_OUTP_type/run_SWC_OUTP_5ms_sys/OUTP/outpmodule/VDDM_SysAllowReadySta_flg_Inproc/Signal_Override"
 /begin REF_CHARACTERISTIC KOUTP_SysAllowReadySta_flg_ovrdflg KOUTP_SysAllowReadySta_flg_ovrdval /end REF_CHARACTERISTIC
/end GROUP
/begin GROUP S389_Signal_Limit "SWC_OUTP_type/run_SWC_OUTP_5ms_sys/OUTP/outpmodule/VDDM_TailgaSWDTC_raw32_Inproc/Signal_Limit"
 /begin REF_CHARACTERISTIC KOUTP_TailgaSWDTC_raw32_maxval KOUTP_TailgaSWDTC_raw32_minval /end REF_CHARACTERISTIC
/end GROUP
/begin GROUP S389_Signal_Override "SWC_OUTP_type/run_SWC_OUTP_5ms_sys/OUTP/outpmodule/VDDM_TailgaSWDTC_raw32_Inproc/Signal_Override"
 /begin REF_CHARACTERISTIC KOUTP_TailgaSWDTC_raw32_ovrdflg KOUTP_TailgaSWDTC_raw32_ovrdval /end REF_CHARACTERISTIC
/end GROUP
/begin GROUP S390_Signal_Limit "SWC_OUTP_type/run_SWC_OUTP_5ms_sys/OUTP/outpmodule/VDDM_VCUBrkSWSta_enum_Inproc/Signal_Limit"
 /begin REF_CHARACTERISTIC KOUTP_VCUBrkSWSta_enum_maxval KOUTP_VCUBrkSWSta_enum_minval /end REF_CHARACTERISTIC
/end GROUP
/begin GROUP S390_Signal_Override "SWC_OUTP_type/run_SWC_OUTP_5ms_sys/OUTP/outpmodule/VDDM_VCUBrkSWSta_enum_Inproc/Signal_Override"
 /begin REF_CHARACTERISTIC KOUTP_VCUBrkSWSta_enum_ovrdflg KOUTP_VCUBrkSWSta_enum_ovrdval /end REF_CHARACTERISTIC
/end GROUP
/begin GROUP S391_Signal_Limit "SWC_OUTP_type/run_SWC_OUTP_5ms_sys/OUTP/outpmodule/VDDM_VCUFLDoorSta_flg_Inproc/Signal_Limit"
 /begin REF_CHARACTERISTIC KOUTP_VCUFLDoorSta_flg_maxval KOUTP_VCUFLDoorSta_flg_minval /end REF_CHARACTERISTIC
/end GROUP
/begin GROUP S391_Signal_Override "SWC_OUTP_type/run_SWC_OUTP_5ms_sys/OUTP/outpmodule/VDDM_VCUFLDoorSta_flg_Inproc/Signal_Override"
 /begin REF_CHARACTERISTIC KOUTP_VCUFLDoorSta_flg_ovrdflg KOUTP_VCUFLDoorSta_flg_ovrdval /end REF_CHARACTERISTIC
/end GROUP
/begin GROUP S392_Signal_Limit "SWC_OUTP_type/run_SWC_OUTP_5ms_sys/OUTP/outpmodule/VDDM_VCUFRDoorSta_flg_Inproc/Signal_Limit"
 /begin REF_CHARACTERISTIC KOUTP_VCUFRDoorSta_flg_maxval KOUTP_VCUFRDoorSta_flg_minval /end REF_CHARACTERISTIC
/end GROUP
/begin GROUP S392_Signal_Override "SWC_OUTP_type/run_SWC_OUTP_5ms_sys/OUTP/outpmodule/VDDM_VCUFRDoorSta_flg_Inproc/Signal_Override"
 /begin REF_CHARACTERISTIC KOUTP_VCUFRDoorSta_flg_ovrdflg KOUTP_VCUFRDoorSta_flg_ovrdval /end REF_CHARACTERISTIC
/end GROUP
/begin GROUP S393_Signal_Limit "SWC_OUTP_type/run_SWC_OUTP_5ms_sys/OUTP/outpmodule/VDDM_VCUHoodSWSta_flg_Inproc/Signal_Limit"
 /begin REF_CHARACTERISTIC KOUTP_VCUHoodSWSta_flg_maxval KOUTP_VCUHoodSWSta_flg_minval /end REF_CHARACTERISTIC
/end GROUP
/begin GROUP S393_Signal_Override "SWC_OUTP_type/run_SWC_OUTP_5ms_sys/OUTP/outpmodule/VDDM_VCUHoodSWSta_flg_Inproc/Signal_Override"
 /begin REF_CHARACTERISTIC KOUTP_VCUHoodSWSta_flg_ovrdflg KOUTP_VCUHoodSWSta_flg_ovrdval /end REF_CHARACTERISTIC
/end GROUP
/begin GROUP S394_Signal_Limit "SWC_OUTP_type/run_SWC_OUTP_5ms_sys/OUTP/outpmodule/VDDM_VCURAPSErrLv2_flg_Inproc/Signal_Limit"
 /begin REF_CHARACTERISTIC KOUTP_VCURAPSErrLv2_flg_maxval KOUTP_VCURAPSErrLv2_flg_minval /end REF_CHARACTERISTIC
/end GROUP
/begin GROUP S394_Signal_Override "SWC_OUTP_type/run_SWC_OUTP_5ms_sys/OUTP/outpmodule/VDDM_VCURAPSErrLv2_flg_Inproc/Signal_Override"
 /begin REF_CHARACTERISTIC KOUTP_VCURAPSErrLv2_flg_ovrdflg KOUTP_VCURAPSErrLv2_flg_ovrdval /end REF_CHARACTERISTIC
/end GROUP
/begin GROUP S395_Signal_Limit "SWC_OUTP_type/run_SWC_OUTP_5ms_sys/OUTP/outpmodule/VDDM_VCURAPSErrLv3_flg_Inproc/Signal_Limit"
 /begin REF_CHARACTERISTIC KOUTP_VCURAPSErrLv3_flg_maxval KOUTP_VCURAPSErrLv3_flg_minval /end REF_CHARACTERISTIC
/end GROUP
/begin GROUP S395_Signal_Override "SWC_OUTP_type/run_SWC_OUTP_5ms_sys/OUTP/outpmodule/VDDM_VCURAPSErrLv3_flg_Inproc/Signal_Override"
 /begin REF_CHARACTERISTIC KOUTP_VCURAPSErrLv3_flg_ovrdflg KOUTP_VCURAPSErrLv3_flg_ovrdval /end REF_CHARACTERISTIC
/end GROUP
/begin GROUP S396_Signal_Limit "SWC_OUTP_type/run_SWC_OUTP_5ms_sys/OUTP/outpmodule/VDDM_VCURLDoorSta_flg_Inproc/Signal_Limit"
 /begin REF_CHARACTERISTIC KOUTP_VCURLDoorSta_flg_maxval KOUTP_VCURLDoorSta_flg_minval /end REF_CHARACTERISTIC
/end GROUP
/begin GROUP S396_Signal_Override "SWC_OUTP_type/run_SWC_OUTP_5ms_sys/OUTP/outpmodule/VDDM_VCURLDoorSta_flg_Inproc/Signal_Override"
 /begin REF_CHARACTERISTIC KOUTP_VCURLDoorSta_flg_ovrdflg KOUTP_VCURLDoorSta_flg_ovrdval /end REF_CHARACTERISTIC
/end GROUP
/begin GROUP S397_Signal_Limit "SWC_OUTP_type/run_SWC_OUTP_5ms_sys/OUTP/outpmodule/VDDM_VCURRDoorSta_flg_Inproc/Signal_Limit"
 /begin REF_CHARACTERISTIC KOUTP_VCURRDoorSta_flg_maxval KOUTP_VCURRDoorSta_flg_minval /end REF_CHARACTERISTIC
/end GROUP
/begin GROUP S397_Signal_Override "SWC_OUTP_type/run_SWC_OUTP_5ms_sys/OUTP/outpmodule/VDDM_VCURRDoorSta_flg_Inproc/Signal_Override"
 /begin REF_CHARACTERISTIC KOUTP_VCURRDoorSta_flg_ovrdflg KOUTP_VCURRDoorSta_flg_ovrdval /end REF_CHARACTERISTIC
/end GROUP
/begin GROUP S398_Signal_Limit "SWC_OUTP_type/run_SWC_OUTP_5ms_sys/OUTP/outpmodule/VDDM_VCUTailgateSWSta_flg_Inproc/Signal_Limit"
 /begin REF_CHARACTERISTIC KOUTP_VCUTailgateSWSta_flg_maxval KOUTP_VCUTailgateSWSta_flg_minval /end REF_CHARACTERISTIC
/end GROUP
/begin GROUP S398_Signal_Override "SWC_OUTP_type/run_SWC_OUTP_5ms_sys/OUTP/outpmodule/VDDM_VCUTailgateSWSta_flg_Inproc/Signal_Override"
 /begin REF_CHARACTERISTIC KOUTP_VCUTailgateSWSta_flg_ovrdflg KOUTP_VCUTailgateSWSta_flg_ovrdval /end REF_CHARACTERISTIC
/end GROUP
/begin GROUP S399_Signal_Limit "SWC_OUTP_type/run_SWC_OUTP_5ms_sys/OUTP/outpmodule/VDDM_VehMalfunLevel_enum_Inproc/Signal_Limit"
 /begin REF_CHARACTERISTIC KOUTP_VehMalfunLevel_enum_maxval KOUTP_VehMalfunLevel_enum_minval /end REF_CHARACTERISTIC
/end GROUP
/begin GROUP S399_Signal_Override "SWC_OUTP_type/run_SWC_OUTP_5ms_sys/OUTP/outpmodule/VDDM_VehMalfunLevel_enum_Inproc/Signal_Override"
 /begin REF_CHARACTERISTIC KOUTP_VehMalfunLevel_enum_ovrdflg KOUTP_VehMalfunLevel_enum_ovrdval /end REF_CHARACTERISTIC
/end GROUP
/begin GROUP S400_Signal_Limit "SWC_OUTP_type/run_SWC_OUTP_5ms_sys/OUTP/outpmodule/VDDM_ZoneSCPNoComDTC_raw32_Inproc/Signal_Limit"
 /begin REF_CHARACTERISTIC KOUTP_ZoneSCPNoComDTC_raw32_maxval KOUTP_ZoneSCPNoComDTC_raw32_minval /end REF_CHARACTERISTIC
/end GROUP
/begin GROUP S400_Signal_Override "SWC_OUTP_type/run_SWC_OUTP_5ms_sys/OUTP/outpmodule/VDDM_ZoneSCPNoComDTC_raw32_Inproc/Signal_Override"
 /begin REF_CHARACTERISTIC KOUTP_ZoneSCPNoComDTC_raw32_ovrdflg KOUTP_ZoneSCPNoComDTC_raw32_ovrdval /end REF_CHARACTERISTIC
/end GROUP
/begin GROUP S401_Signal_Limit "SWC_OUTP_type/run_SWC_OUTP_5ms_sys/OUTP/outpmodule/VDHP_ActAPSPosn_pct_Inproc/Signal_Limit" /begin REF_CHARACTERISTIC KOUTP_ActAPSPosn_pct_maxval KOUTP_ActAPSPosn_pct_minval /end REF_CHARACTERISTIC /end GROUP
/begin GROUP S401_Signal_Override "SWC_OUTP_type/run_SWC_OUTP_5ms_sys/OUTP/outpmodule/VDHP_ActAPSPosn_pct_Inproc/Signal_Override" /begin REF_CHARACTERISTIC KOUTP_ActAPSPosn_pct_ovrdflg KOUTP_ActAPSPosn_pct_ovrdval /end REF_CHARACTERISTIC /end GROUP
/begin GROUP S402_Signal_Limit "SWC_OUTP_type/run_SWC_OUTP_5ms_sys/OUTP/outpmodule/VDHP_EAPS1MIN_pct_Inproc/Signal_Limit" /begin REF_CHARACTERISTIC KOUTP_EAPS1MIN_pct_maxval KOUTP_EAPS1MIN_pct_minval /end REF_CHARACTERISTIC /end GROUP
/begin GROUP S402_Signal_Override "SWC_OUTP_type/run_SWC_OUTP_5ms_sys/OUTP/outpmodule/VDHP_EAPS1MIN_pct_Inproc/Signal_Override" /begin REF_CHARACTERISTIC KOUTP_EAPS1MIN_pct_ovrdflg KOUTP_EAPS1MIN_pct_ovrdval /end REF_CHARACTERISTIC /end GROUP
/begin GROUP S403_Signal_Limit "SWC_OUTP_type/run_SWC_OUTP_5ms_sys/OUTP/outpmodule/VDHP_EAPS1NRM_pct_Inproc/Signal_Limit" /begin REF_CHARACTERISTIC KOUTP_EAPS1NRM_pct_maxval KOUTP_EAPS1NRM_pct_minval /end REF_CHARACTERISTIC /end GROUP
/begin GROUP S403_Signal_Override "SWC_OUTP_type/run_SWC_OUTP_5ms_sys/OUTP/outpmodule/VDHP_EAPS1NRM_pct_Inproc/Signal_Override" /begin REF_CHARACTERISTIC KOUTP_EAPS1NRM_pct_ovrdflg KOUTP_EAPS1NRM_pct_ovrdval /end REF_CHARACTERISTIC /end GROUP
/begin GROUP S404_Signal_Limit "SWC_OUTP_type/run_SWC_OUTP_5ms_sys/OUTP/outpmodule/VDHP_EAPS2MIN_pct_Inproc/Signal_Limit" /begin REF_CHARACTERISTIC KOUTP_EAPS2MIN_pct_maxval KOUTP_EAPS2MIN_pct_minval /end REF_CHARACTERISTIC /end GROUP
/begin GROUP S404_Signal_Override "SWC_OUTP_type/run_SWC_OUTP_5ms_sys/OUTP/outpmodule/VDHP_EAPS2MIN_pct_Inproc/Signal_Override" /begin REF_CHARACTERISTIC KOUTP_EAPS2MIN_pct_ovrdflg KOUTP_EAPS2MIN_pct_ovrdval /end REF_CHARACTERISTIC /end GROUP
/begin GROUP S405_Signal_Limit "SWC_OUTP_type/run_SWC_OUTP_5ms_sys/OUTP/outpmodule/VDHP_EAPS2NRM_pct_Inproc/Signal_Limit" /begin REF_CHARACTERISTIC KOUTP_EAPS2NRM_pct_maxval KOUTP_EAPS2NRM_pct_minval /end REF_CHARACTERISTIC /end GROUP
/begin GROUP S405_Signal_Override "SWC_OUTP_type/run_SWC_OUTP_5ms_sys/OUTP/outpmodule/VDHP_EAPS2NRM_pct_Inproc/Signal_Override" /begin REF_CHARACTERISTIC KOUTP_EAPS2NRM_pct_ovrdflg KOUTP_EAPS2NRM_pct_ovrdval /end REF_CHARACTERISTIC /end GROUP
/begin GROUP S406_Signal_Limit "SWC_OUTP_type/run_SWC_OUTP_5ms_sys/OUTP/outpmodule/VDHP_ResetPedalZeroPosStart_flg_Inproc/Signal_Limit"
 /begin REF_CHARACTERISTIC KOUTP_ResetPedalZeroPosStart_flg_maxval KOUTP_ResetPedalZeroPosStart_flg_minval /end REF_CHARACTERISTIC
/end GROUP
/begin GROUP S406_Signal_Override "SWC_OUTP_type/run_SWC_OUTP_5ms_sys/OUTP/outpmodule/VDHP_ResetPedalZeroPosStart_flg_Inproc/Signal_Override"
 /begin REF_CHARACTERISTIC KOUTP_ResetPedalZeroPosStart_flg_ovrdflg KOUTP_ResetPedalZeroPosStart_flg_ovrdval /end REF_CHARACTERISTIC
/end GROUP
/begin GROUP S407_Signal_Limit "SWC_OUTP_type/run_SWC_OUTP_5ms_sys/OUTP/outpmodule/VDID_APPD_pct_Inproc/Signal_Limit" /begin REF_CHARACTERISTIC KOUTP_APPD_pct_maxval KOUTP_APPD_pct_minval /end REF_CHARACTERISTIC /end GROUP
/begin GROUP S407_Signal_Override "SWC_OUTP_type/run_SWC_OUTP_5ms_sys/OUTP/outpmodule/VDID_APPD_pct_Inproc/Signal_Override" /begin REF_CHARACTERISTIC KOUTP_APPD_pct_ovrdflg KOUTP_APPD_pct_ovrdval /end REF_CHARACTERISTIC /end GROUP
/begin GROUP S408_Signal_Limit "SWC_OUTP_type/run_SWC_OUTP_5ms_sys/OUTP/outpmodule/VDID_APPE_pct_Inproc/Signal_Limit" /begin REF_CHARACTERISTIC KOUTP_APPE_pct_maxval KOUTP_APPE_pct_minval /end REF_CHARACTERISTIC /end GROUP
/begin GROUP S408_Signal_Override "SWC_OUTP_type/run_SWC_OUTP_5ms_sys/OUTP/outpmodule/VDID_APPE_pct_Inproc/Signal_Override" /begin REF_CHARACTERISTIC KOUTP_APPE_pct_ovrdflg KOUTP_APPE_pct_ovrdval /end REF_CHARACTERISTIC /end GROUP
/begin GROUP S409_Signal_Limit "SWC_OUTP_type/run_SWC_OUTP_5ms_sys/OUTP/outpmodule/VDID_AVGBATTEMPL_C_Inproc/Signal_Limit" /begin REF_CHARACTERISTIC KOUTP_AVGBATTEMPL_C_maxval KOUTP_AVGBATTEMPL_C_minval /end REF_CHARACTERISTIC /end GROUP
/begin GROUP S409_Signal_Override "SWC_OUTP_type/run_SWC_OUTP_5ms_sys/OUTP/outpmodule/VDID_AVGBATTEMPL_C_Inproc/Signal_Override" /begin REF_CHARACTERISTIC KOUTP_AVGBATTEMPL_C_ovrdflg KOUTP_AVGBATTEMPL_C_ovrdval /end REF_CHARACTERISTIC /end GROUP
/begin GROUP S410_Signal_Limit "SWC_OUTP_type/run_SWC_OUTP_5ms_sys/OUTP/outpmodule/VDID_AVGBATTEMPL_sec_Inproc/Signal_Limit" /begin REF_CHARACTERISTIC KOUTP_AVGBATTEMPL_sec_maxval KOUTP_AVGBATTEMPL_sec_minval /end REF_CHARACTERISTIC /end GROUP
/begin GROUP S410_Signal_Override "SWC_OUTP_type/run_SWC_OUTP_5ms_sys/OUTP/outpmodule/VDID_AVGBATTEMPL_sec_Inproc/Signal_Override"
 /begin REF_CHARACTERISTIC KOUTP_AVGBATTEMPL_sec_ovrdflg KOUTP_AVGBATTEMPL_sec_ovrdval /end REF_CHARACTERISTIC
/end GROUP
/begin GROUP S411_Signal_Limit "SWC_OUTP_type/run_SWC_OUTP_5ms_sys/OUTP/outpmodule/VDID_AvgBattTempOFFL_C_Inproc/Signal_Limit"
 /begin REF_CHARACTERISTIC KOUTP_AvgBattTempOFFL_C_maxval KOUTP_AvgBattTempOFFL_C_minval /end REF_CHARACTERISTIC
/end GROUP
/begin GROUP S411_Signal_Override "SWC_OUTP_type/run_SWC_OUTP_5ms_sys/OUTP/outpmodule/VDID_AvgBattTempOFFL_C_Inproc/Signal_Override"
 /begin REF_CHARACTERISTIC KOUTP_AvgBattTempOFFL_C_ovrdflg KOUTP_AvgBattTempOFFL_C_ovrdval /end REF_CHARACTERISTIC
/end GROUP
/begin GROUP S412_Signal_Limit "SWC_OUTP_type/run_SWC_OUTP_5ms_sys/OUTP/outpmodule/VDID_AvgBattTempOFFR_C_Inproc/Signal_Limit"
 /begin REF_CHARACTERISTIC KOUTP_AvgBattTempOFFR_C_maxval KOUTP_AvgBattTempOFFR_C_minval /end REF_CHARACTERISTIC
/end GROUP
/begin GROUP S412_Signal_Override "SWC_OUTP_type/run_SWC_OUTP_5ms_sys/OUTP/outpmodule/VDID_AvgBattTempOFFR_C_Inproc/Signal_Override"
 /begin REF_CHARACTERISTIC KOUTP_AvgBattTempOFFR_C_ovrdflg KOUTP_AvgBattTempOFFR_C_ovrdval /end REF_CHARACTERISTIC
/end GROUP
/begin GROUP S413_Signal_Limit "SWC_OUTP_type/run_SWC_OUTP_5ms_sys/OUTP/outpmodule/VDID_AvgBattTempOVCL_C_Inproc/Signal_Limit"
 /begin REF_CHARACTERISTIC KOUTP_AvgBattTempOVCL_C_maxval KOUTP_AvgBattTempOVCL_C_minval /end REF_CHARACTERISTIC
/end GROUP
/begin GROUP S413_Signal_Override "SWC_OUTP_type/run_SWC_OUTP_5ms_sys/OUTP/outpmodule/VDID_AvgBattTempOVCL_C_Inproc/Signal_Override"
 /begin REF_CHARACTERISTIC KOUTP_AvgBattTempOVCL_C_ovrdflg KOUTP_AvgBattTempOVCL_C_ovrdval /end REF_CHARACTERISTIC
/end GROUP
/begin GROUP S414_Signal_Limit "SWC_OUTP_type/run_SWC_OUTP_5ms_sys/OUTP/outpmodule/VDID_AvgBattTempOVCR_C_Inproc/Signal_Limit"
 /begin REF_CHARACTERISTIC KOUTP_AvgBattTempOVCR_C_maxval KOUTP_AvgBattTempOVCR_C_minval /end REF_CHARACTERISTIC
/end GROUP
/begin GROUP S414_Signal_Override "SWC_OUTP_type/run_SWC_OUTP_5ms_sys/OUTP/outpmodule/VDID_AvgBattTempOVCR_C_Inproc/Signal_Override"
 /begin REF_CHARACTERISTIC KOUTP_AvgBattTempOVCR_C_ovrdflg KOUTP_AvgBattTempOVCR_C_ovrdval /end REF_CHARACTERISTIC
/end GROUP
/begin GROUP S415_Signal_Limit "SWC_OUTP_type/run_SWC_OUTP_5ms_sys/OUTP/outpmodule/VDID_AvgBattTempPSAL_C_Inproc/Signal_Limit"
 /begin REF_CHARACTERISTIC KOUTP_AvgBattTempPSAL_C_maxval KOUTP_AvgBattTempPSAL_C_minval /end REF_CHARACTERISTIC
/end GROUP
/begin GROUP S415_Signal_Override "SWC_OUTP_type/run_SWC_OUTP_5ms_sys/OUTP/outpmodule/VDID_AvgBattTempPSAL_C_Inproc/Signal_Override"
 /begin REF_CHARACTERISTIC KOUTP_AvgBattTempPSAL_C_ovrdflg KOUTP_AvgBattTempPSAL_C_ovrdval /end REF_CHARACTERISTIC
/end GROUP
/begin GROUP S416_Signal_Limit "SWC_OUTP_type/run_SWC_OUTP_5ms_sys/OUTP/outpmodule/VDID_AvgBattTempPSAR_C_Inproc/Signal_Limit"
 /begin REF_CHARACTERISTIC KOUTP_AvgBattTempPSAR_C_maxval KOUTP_AvgBattTempPSAR_C_minval /end REF_CHARACTERISTIC
/end GROUP
/begin GROUP S416_Signal_Override "SWC_OUTP_type/run_SWC_OUTP_5ms_sys/OUTP/outpmodule/VDID_AvgBattTempPSAR_C_Inproc/Signal_Override"
 /begin REF_CHARACTERISTIC KOUTP_AvgBattTempPSAR_C_ovrdflg KOUTP_AvgBattTempPSAR_C_ovrdval /end REF_CHARACTERISTIC
/end GROUP
/begin GROUP S417_Signal_Limit "SWC_OUTP_type/run_SWC_OUTP_5ms_sys/OUTP/outpmodule/VDID_BATSOC_pct_Inproc/Signal_Limit" /begin REF_CHARACTERISTIC KOUTP_BATSOC_pct_maxval KOUTP_BATSOC_pct_minval /end REF_CHARACTERISTIC /end GROUP
/begin GROUP S417_Signal_Override "SWC_OUTP_type/run_SWC_OUTP_5ms_sys/OUTP/outpmodule/VDID_BATSOC_pct_Inproc/Signal_Override" /begin REF_CHARACTERISTIC KOUTP_BATSOC_pct_ovrdflg KOUTP_BATSOC_pct_ovrdval /end REF_CHARACTERISTIC /end GROUP
/begin GROUP S418_Signal_Limit "SWC_OUTP_type/run_SWC_OUTP_5ms_sys/OUTP/outpmodule/VDID_BATSOH_pct_Inproc/Signal_Limit" /begin REF_CHARACTERISTIC KOUTP_BATSOH_pct_maxval KOUTP_BATSOH_pct_minval /end REF_CHARACTERISTIC /end GROUP
/begin GROUP S418_Signal_Override "SWC_OUTP_type/run_SWC_OUTP_5ms_sys/OUTP/outpmodule/VDID_BATSOH_pct_Inproc/Signal_Override" /begin REF_CHARACTERISTIC KOUTP_BATSOH_pct_ovrdflg KOUTP_BATSOH_pct_ovrdval /end REF_CHARACTERISTIC /end GROUP
/begin GROUP S419_Signal_Limit "SWC_OUTP_type/run_SWC_OUTP_5ms_sys/OUTP/outpmodule/VDID_BattTempPSAL_sec_Inproc/Signal_Limit"
 /begin REF_CHARACTERISTIC KOUTP_BattTempPSAL_sec_maxval KOUTP_BattTempPSAL_sec_minval /end REF_CHARACTERISTIC
/end GROUP
/begin GROUP S419_Signal_Override "SWC_OUTP_type/run_SWC_OUTP_5ms_sys/OUTP/outpmodule/VDID_BattTempPSAL_sec_Inproc/Signal_Override"
 /begin REF_CHARACTERISTIC KOUTP_BattTempPSAL_sec_ovrdflg KOUTP_BattTempPSAL_sec_ovrdval /end REF_CHARACTERISTIC
/end GROUP
/begin GROUP S420_Signal_Limit "SWC_OUTP_type/run_SWC_OUTP_5ms_sys/OUTP/outpmodule/VDID_BattTempPSAR_sec_Inproc/Signal_Limit"
 /begin REF_CHARACTERISTIC KOUTP_BattTempPSAR_sec_maxval KOUTP_BattTempPSAR_sec_minval /end REF_CHARACTERISTIC
/end GROUP
/begin GROUP S420_Signal_Override "SWC_OUTP_type/run_SWC_OUTP_5ms_sys/OUTP/outpmodule/VDID_BattTempPSAR_sec_Inproc/Signal_Override"
 /begin REF_CHARACTERISTIC KOUTP_BattTempPSAR_sec_ovrdflg KOUTP_BattTempPSAR_sec_ovrdval /end REF_CHARACTERISTIC
/end GROUP
/begin GROUP S421_Signal_Limit "SWC_OUTP_type/run_SWC_OUTP_5ms_sys/OUTP/outpmodule/VDID_CALID_cnt_Inproc/Signal_Limit" /begin REF_CHARACTERISTIC KOUTP_CALID_cnt_maxval KOUTP_CALID_cnt_minval /end REF_CHARACTERISTIC /end GROUP
/begin GROUP S421_Signal_Override "SWC_OUTP_type/run_SWC_OUTP_5ms_sys/OUTP/outpmodule/VDID_CALID_cnt_Inproc/Signal_Override" /begin REF_CHARACTERISTIC KOUTP_CALID_cnt_ovrdflg KOUTP_CALID_cnt_ovrdval /end REF_CHARACTERISTIC /end GROUP
/begin GROUP S422_Signal_Limit "SWC_OUTP_type/run_SWC_OUTP_5ms_sys/OUTP/outpmodule/VDID_CDEODTL_km_Inproc/Signal_Limit" /begin REF_CHARACTERISTIC KOUTP_CDEODTL_km_maxval KOUTP_CDEODTL_km_minval /end REF_CHARACTERISTIC /end GROUP
/begin GROUP S422_Signal_Override "SWC_OUTP_type/run_SWC_OUTP_5ms_sys/OUTP/outpmodule/VDID_CDEODTL_km_Inproc/Signal_Override" /begin REF_CHARACTERISTIC KOUTP_CDEODTL_km_ovrdflg KOUTP_CDEODTL_km_ovrdval /end REF_CHARACTERISTIC /end GROUP
/begin GROUP S423_Signal_Limit "SWC_OUTP_type/run_SWC_OUTP_5ms_sys/OUTP/outpmodule/VDID_CDEODTR_km_Inproc/Signal_Limit" /begin REF_CHARACTERISTIC KOUTP_CDEODTR_km_maxval KOUTP_CDEODTR_km_minval /end REF_CHARACTERISTIC /end GROUP
/begin GROUP S423_Signal_Override "SWC_OUTP_type/run_SWC_OUTP_5ms_sys/OUTP/outpmodule/VDID_CDEODTR_km_Inproc/Signal_Override" /begin REF_CHARACTERISTIC KOUTP_CDEODTR_km_ovrdflg KOUTP_CDEODTR_km_ovrdval /end REF_CHARACTERISTIC /end GROUP
/begin GROUP S424_Signal_Limit "SWC_OUTP_type/run_SWC_OUTP_5ms_sys/OUTP/outpmodule/VDID_CLRDIST_km_Inproc/Signal_Limit" /begin REF_CHARACTERISTIC KOUTP_CLRDIST_km_maxval KOUTP_CLRDIST_km_minval /end REF_CHARACTERISTIC /end GROUP
/begin GROUP S424_Signal_Override "SWC_OUTP_type/run_SWC_OUTP_5ms_sys/OUTP/outpmodule/VDID_CLRDIST_km_Inproc/Signal_Override" /begin REF_CHARACTERISTIC KOUTP_CLRDIST_km_ovrdflg KOUTP_CLRDIST_km_ovrdval /end REF_CHARACTERISTIC /end GROUP
/begin GROUP S425_Signal_Limit "SWC_OUTP_type/run_SWC_OUTP_5ms_sys/OUTP/outpmodule/VDID_CLRTIME_min_Inproc/Signal_Limit" /begin REF_CHARACTERISTIC KOUTP_CLRTIME_min_maxval KOUTP_CLRTIME_min_minval /end REF_CHARACTERISTIC /end GROUP
/begin GROUP S425_Signal_Override "SWC_OUTP_type/run_SWC_OUTP_5ms_sys/OUTP/outpmodule/VDID_CLRTIME_min_Inproc/Signal_Override" /begin REF_CHARACTERISTIC KOUTP_CLRTIME_min_ovrdflg KOUTP_CLRTIME_min_ovrdval /end REF_CHARACTERISTIC /end GROUP
/begin GROUP S426_Signal_Limit "SWC_OUTP_type/run_SWC_OUTP_5ms_sys/OUTP/outpmodule/VDID_CPSAL_sec_Inproc/Signal_Limit" /begin REF_CHARACTERISTIC KOUTP_CPSAL_sec_maxval KOUTP_CPSAL_sec_minval /end REF_CHARACTERISTIC /end GROUP
/begin GROUP S426_Signal_Override "SWC_OUTP_type/run_SWC_OUTP_5ms_sys/OUTP/outpmodule/VDID_CPSAL_sec_Inproc/Signal_Override" /begin REF_CHARACTERISTIC KOUTP_CPSAL_sec_ovrdflg KOUTP_CPSAL_sec_ovrdval /end REF_CHARACTERISTIC /end GROUP
/begin GROUP S427_Signal_Limit "SWC_OUTP_type/run_SWC_OUTP_5ms_sys/OUTP/outpmodule/VDID_CPSAR_sec_Inproc/Signal_Limit" /begin REF_CHARACTERISTIC KOUTP_CPSAR_sec_maxval KOUTP_CPSAR_sec_minval /end REF_CHARACTERISTIC /end GROUP
/begin GROUP S427_Signal_Override "SWC_OUTP_type/run_SWC_OUTP_5ms_sys/OUTP/outpmodule/VDID_CPSAR_sec_Inproc/Signal_Override" /begin REF_CHARACTERISTIC KOUTP_CPSAR_sec_ovrdflg KOUTP_CPSAR_sec_ovrdval /end REF_CHARACTERISTIC /end GROUP
/begin GROUP S428_Signal_Limit "SWC_OUTP_type/run_SWC_OUTP_5ms_sys/OUTP/outpmodule/VDID_DIDModelVersionChksum_raw_Inproc/Signal_Limit"
 /begin REF_CHARACTERISTIC KOUTP_DIDModelVersionChksum_raw_maxval KOUTP_DIDModelVersionChksum_raw_minval /end REF_CHARACTERISTIC
/end GROUP
/begin GROUP S428_Signal_Override "SWC_OUTP_type/run_SWC_OUTP_5ms_sys/OUTP/outpmodule/VDID_DIDModelVersionChksum_raw_Inproc/Signal_Override"
 /begin REF_CHARACTERISTIC KOUTP_DIDModelVersionChksum_raw_ovrdflg KOUTP_DIDModelVersionChksum_raw_ovrdval /end REF_CHARACTERISTIC
/end GROUP
/begin GROUP S429_Signal_Limit "SWC_OUTP_type/run_SWC_OUTP_5ms_sys/OUTP/outpmodule/VDID_DIDModelVersion_raw_Inproc/Signal_Limit"
 /begin REF_CHARACTERISTIC KOUTP_DIDModelVersion_raw_maxval KOUTP_DIDModelVersion_raw_minval /end REF_CHARACTERISTIC
/end GROUP
/begin GROUP S429_Signal_Override "SWC_OUTP_type/run_SWC_OUTP_5ms_sys/OUTP/outpmodule/VDID_DIDModelVersion_raw_Inproc/Signal_Override"
 /begin REF_CHARACTERISTIC KOUTP_DIDModelVersion_raw_ovrdflg KOUTP_DIDModelVersion_raw_ovrdval /end REF_CHARACTERISTIC
/end GROUP
/begin GROUP S430_Signal_Limit "SWC_OUTP_type/run_SWC_OUTP_5ms_sys/OUTP/outpmodule/VDID_ECUNAME_cnt_Inproc/Signal_Limit" /begin REF_CHARACTERISTIC KOUTP_ECUNAME_cnt_maxval KOUTP_ECUNAME_cnt_minval /end REF_CHARACTERISTIC /end GROUP
/begin GROUP S430_Signal_Override "SWC_OUTP_type/run_SWC_OUTP_5ms_sys/OUTP/outpmodule/VDID_ECUNAME_cnt_Inproc/Signal_Override" /begin REF_CHARACTERISTIC KOUTP_ECUNAME_cnt_ovrdflg KOUTP_ECUNAME_cnt_ovrdval /end REF_CHARACTERISTIC /end GROUP
/begin GROUP S431_Signal_Limit "SWC_OUTP_type/run_SWC_OUTP_5ms_sys/OUTP/outpmodule/VDID_ETMATOEL_kWh_Inproc/Signal_Limit" /begin REF_CHARACTERISTIC KOUTP_ETMATOEL_kWh_maxval KOUTP_ETMATOEL_kWh_minval /end REF_CHARACTERISTIC /end GROUP
/begin GROUP S431_Signal_Override "SWC_OUTP_type/run_SWC_OUTP_5ms_sys/OUTP/outpmodule/VDID_ETMATOEL_kWh_Inproc/Signal_Override" /begin REF_CHARACTERISTIC KOUTP_ETMATOEL_kWh_ovrdflg KOUTP_ETMATOEL_kWh_ovrdval /end REF_CHARACTERISTIC /end GROUP
/begin GROUP S432_Signal_Limit "SWC_OUTP_type/run_SWC_OUTP_5ms_sys/OUTP/outpmodule/VDID_ETMATOER_kWh_Inproc/Signal_Limit" /begin REF_CHARACTERISTIC KOUTP_ETMATOER_kWh_maxval KOUTP_ETMATOER_kWh_minval /end REF_CHARACTERISTIC /end GROUP
/begin GROUP S432_Signal_Override "SWC_OUTP_type/run_SWC_OUTP_5ms_sys/OUTP/outpmodule/VDID_ETMATOER_kWh_Inproc/Signal_Override" /begin REF_CHARACTERISTIC KOUTP_ETMATOER_kWh_ovrdflg KOUTP_ETMATOER_kWh_ovrdval /end REF_CHARACTERISTIC /end GROUP
/begin GROUP S433_Signal_Limit "SWC_OUTP_type/run_SWC_OUTP_5ms_sys/OUTP/outpmodule/VDID_ETMBTOEL_kWh_Inproc/Signal_Limit" /begin REF_CHARACTERISTIC KOUTP_ETMBTOEL_kWh_maxval KOUTP_ETMBTOEL_kWh_minval /end REF_CHARACTERISTIC /end GROUP
/begin GROUP S433_Signal_Override "SWC_OUTP_type/run_SWC_OUTP_5ms_sys/OUTP/outpmodule/VDID_ETMBTOEL_kWh_Inproc/Signal_Override" /begin REF_CHARACTERISTIC KOUTP_ETMBTOEL_kWh_ovrdflg KOUTP_ETMBTOEL_kWh_ovrdval /end REF_CHARACTERISTIC /end GROUP
/begin GROUP S434_Signal_Limit "SWC_OUTP_type/run_SWC_OUTP_5ms_sys/OUTP/outpmodule/VDID_ETMBTOER_kWh_Inproc/Signal_Limit" /begin REF_CHARACTERISTIC KOUTP_ETMBTOER_kWh_maxval KOUTP_ETMBTOER_kWh_minval /end REF_CHARACTERISTIC /end GROUP
/begin GROUP S434_Signal_Override "SWC_OUTP_type/run_SWC_OUTP_5ms_sys/OUTP/outpmodule/VDID_ETMBTOER_kWh_Inproc/Signal_Override" /begin REF_CHARACTERISTIC KOUTP_ETMBTOER_kWh_ovrdflg KOUTP_ETMBTOER_kWh_ovrdval /end REF_CHARACTERISTIC /end GROUP
/begin GROUP S435_Signal_Limit "SWC_OUTP_type/run_SWC_OUTP_5ms_sys/OUTP/outpmodule/VDID_GECHGOVCACL_kWh_Inproc/Signal_Limit" /begin REF_CHARACTERISTIC KOUTP_GECHGOVCACL_kWh_maxval KOUTP_GECHGOVCACL_kWh_minval /end REF_CHARACTERISTIC /end GROUP
/begin GROUP S435_Signal_Override "SWC_OUTP_type/run_SWC_OUTP_5ms_sys/OUTP/outpmodule/VDID_GECHGOVCACL_kWh_Inproc/Signal_Override"
 /begin REF_CHARACTERISTIC KOUTP_GECHGOVCACL_kWh_ovrdflg KOUTP_GECHGOVCACL_kWh_ovrdval /end REF_CHARACTERISTIC
/end GROUP
/begin GROUP S436_Signal_Limit "SWC_OUTP_type/run_SWC_OUTP_5ms_sys/OUTP/outpmodule/VDID_GECHGOVCACR_kWh_Inproc/Signal_Limit" /begin REF_CHARACTERISTIC KOUTP_GECHGOVCACR_kWh_maxval KOUTP_GECHGOVCACR_kWh_minval /end REF_CHARACTERISTIC /end GROUP
/begin GROUP S436_Signal_Override "SWC_OUTP_type/run_SWC_OUTP_5ms_sys/OUTP/outpmodule/VDID_GECHGOVCACR_kWh_Inproc/Signal_Override"
 /begin REF_CHARACTERISTIC KOUTP_GECHGOVCACR_kWh_ovrdflg KOUTP_GECHGOVCACR_kWh_ovrdval /end REF_CHARACTERISTIC
/end GROUP
/begin GROUP S437_Signal_Limit "SWC_OUTP_type/run_SWC_OUTP_5ms_sys/OUTP/outpmodule/VDID_GECHGOVCDCL_kWh_Inproc/Signal_Limit" /begin REF_CHARACTERISTIC KOUTP_GECHGOVCDCL_kWh_maxval KOUTP_GECHGOVCDCL_kWh_minval /end REF_CHARACTERISTIC /end GROUP
/begin GROUP S437_Signal_Override "SWC_OUTP_type/run_SWC_OUTP_5ms_sys/OUTP/outpmodule/VDID_GECHGOVCDCL_kWh_Inproc/Signal_Override"
 /begin REF_CHARACTERISTIC KOUTP_GECHGOVCDCL_kWh_ovrdflg KOUTP_GECHGOVCDCL_kWh_ovrdval /end REF_CHARACTERISTIC
/end GROUP
/begin GROUP S438_Signal_Limit "SWC_OUTP_type/run_SWC_OUTP_5ms_sys/OUTP/outpmodule/VDID_GECHGOVCDCR_kWh_Inproc/Signal_Limit" /begin REF_CHARACTERISTIC KOUTP_GECHGOVCDCR_kWh_maxval KOUTP_GECHGOVCDCR_kWh_minval /end REF_CHARACTERISTIC /end GROUP
/begin GROUP S438_Signal_Override "SWC_OUTP_type/run_SWC_OUTP_5ms_sys/OUTP/outpmodule/VDID_GECHGOVCDCR_kWh_Inproc/Signal_Override"
 /begin REF_CHARACTERISTIC KOUTP_GECHGOVCDCR_kWh_ovrdflg KOUTP_GECHGOVCDCR_kWh_ovrdval /end REF_CHARACTERISTIC
/end GROUP
/begin GROUP S439_Signal_Limit "SWC_OUTP_type/run_SWC_OUTP_5ms_sys/OUTP/outpmodule/VDID_HEVBATT_V_Inproc/Signal_Limit" /begin REF_CHARACTERISTIC KOUTP_HEVBATT_V_maxval KOUTP_HEVBATT_V_minval /end REF_CHARACTERISTIC /end GROUP
/begin GROUP S439_Signal_Override "SWC_OUTP_type/run_SWC_OUTP_5ms_sys/OUTP/outpmodule/VDID_HEVBATT_V_Inproc/Signal_Override" /begin REF_CHARACTERISTIC KOUTP_HEVBATT_V_ovrdflg KOUTP_HEVBATT_V_ovrdval /end REF_CHARACTERISTIC /end GROUP
/begin GROUP S440_Signal_Limit "SWC_OUTP_type/run_SWC_OUTP_5ms_sys/OUTP/outpmodule/VDID_HEVMODE_enum_Inproc/Signal_Limit" /begin REF_CHARACTERISTIC KOUTP_HEVMODE_enum_maxval KOUTP_HEVMODE_enum_minval /end REF_CHARACTERISTIC /end GROUP
/begin GROUP S440_Signal_Override "SWC_OUTP_type/run_SWC_OUTP_5ms_sys/OUTP/outpmodule/VDID_HEVMODE_enum_Inproc/Signal_Override" /begin REF_CHARACTERISTIC KOUTP_HEVMODE_enum_ovrdflg KOUTP_HEVMODE_enum_ovrdval /end REF_CHARACTERISTIC /end GROUP
/begin GROUP S441_Signal_Limit "SWC_OUTP_type/run_SWC_OUTP_5ms_sys/OUTP/outpmodule/VDID_HVBATT_A_Inproc/Signal_Limit" /begin REF_CHARACTERISTIC KOUTP_HVBATT_A_maxval KOUTP_HVBATT_A_minval /end REF_CHARACTERISTIC /end GROUP
/begin GROUP S441_Signal_Override "SWC_OUTP_type/run_SWC_OUTP_5ms_sys/OUTP/outpmodule/VDID_HVBATT_A_Inproc/Signal_Override" /begin REF_CHARACTERISTIC KOUTP_HVBATT_A_ovrdflg KOUTP_HVBATT_A_ovrdval /end REF_CHARACTERISTIC /end GROUP
/begin GROUP S442_Signal_Limit "SWC_OUTP_type/run_SWC_OUTP_5ms_sys/OUTP/outpmodule/VDID_HVBCellVoltMax_V_Inproc/Signal_Limit"
 /begin REF_CHARACTERISTIC KOUTP_HVBCellVoltMax_V_maxval KOUTP_HVBCellVoltMax_V_minval /end REF_CHARACTERISTIC
/end GROUP
/begin GROUP S442_Signal_Override "SWC_OUTP_type/run_SWC_OUTP_5ms_sys/OUTP/outpmodule/VDID_HVBCellVoltMax_V_Inproc/Signal_Override"
 /begin REF_CHARACTERISTIC KOUTP_HVBCellVoltMax_V_ovrdflg KOUTP_HVBCellVoltMax_V_ovrdval /end REF_CHARACTERISTIC
/end GROUP
/begin GROUP S443_Signal_Limit "SWC_OUTP_type/run_SWC_OUTP_5ms_sys/OUTP/outpmodule/VDID_HVBCellVoltMin_V_Inproc/Signal_Limit"
 /begin REF_CHARACTERISTIC KOUTP_HVBCellVoltMin_V_maxval KOUTP_HVBCellVoltMin_V_minval /end REF_CHARACTERISTIC
/end GROUP
/begin GROUP S443_Signal_Override "SWC_OUTP_type/run_SWC_OUTP_5ms_sys/OUTP/outpmodule/VDID_HVBCellVoltMin_V_Inproc/Signal_Override"
 /begin REF_CHARACTERISTIC KOUTP_HVBCellVoltMin_V_ovrdflg KOUTP_HVBCellVoltMin_V_ovrdval /end REF_CHARACTERISTIC
/end GROUP
/begin GROUP S444_Signal_Limit "SWC_OUTP_type/run_SWC_OUTP_5ms_sys/OUTP/outpmodule/VDID_HVBNAH_Ahr_Inproc/Signal_Limit" /begin REF_CHARACTERISTIC KOUTP_HVBNAH_Ahr_maxval KOUTP_HVBNAH_Ahr_minval /end REF_CHARACTERISTIC /end GROUP
/begin GROUP S444_Signal_Override "SWC_OUTP_type/run_SWC_OUTP_5ms_sys/OUTP/outpmodule/VDID_HVBNAH_Ahr_Inproc/Signal_Override" /begin REF_CHARACTERISTIC KOUTP_HVBNAH_Ahr_ovrdflg KOUTP_HVBNAH_Ahr_ovrdval /end REF_CHARACTERISTIC /end GROUP
/begin GROUP S445_Signal_Limit "SWC_OUTP_type/run_SWC_OUTP_5ms_sys/OUTP/outpmodule/VDID_HVBNE_kWh_Inproc/Signal_Limit" /begin REF_CHARACTERISTIC KOUTP_HVBNE_kWh_maxval KOUTP_HVBNE_kWh_minval /end REF_CHARACTERISTIC /end GROUP
/begin GROUP S445_Signal_Override "SWC_OUTP_type/run_SWC_OUTP_5ms_sys/OUTP/outpmodule/VDID_HVBNE_kWh_Inproc/Signal_Override" /begin REF_CHARACTERISTIC KOUTP_HVBNE_kWh_ovrdflg KOUTP_HVBNE_kWh_ovrdval /end REF_CHARACTERISTIC /end GROUP
/begin GROUP S446_Signal_Limit "SWC_OUTP_type/run_SWC_OUTP_5ms_sys/OUTP/outpmodule/VDID_HVBattCurr_Ahps_Inproc/Signal_Limit" /begin REF_CHARACTERISTIC KOUTP_HVBattCurr_Ahps_maxval KOUTP_HVBattCurr_Ahps_minval /end REF_CHARACTERISTIC /end GROUP
/begin GROUP S446_Signal_Override "SWC_OUTP_type/run_SWC_OUTP_5ms_sys/OUTP/outpmodule/VDID_HVBattCurr_Ahps_Inproc/Signal_Override"
 /begin REF_CHARACTERISTIC KOUTP_HVBattCurr_Ahps_ovrdflg KOUTP_HVBattCurr_Ahps_ovrdval /end REF_CHARACTERISTIC
/end GROUP
/begin GROUP S447_Signal_Limit "SWC_OUTP_type/run_SWC_OUTP_5ms_sys/OUTP/outpmodule/VDID_HVESSCHARGEACT_kW_Inproc/Signal_Limit"
 /begin REF_CHARACTERISTIC KOUTP_HVESSCHARGEACT_kW_maxval KOUTP_HVESSCHARGEACT_kW_minval /end REF_CHARACTERISTIC
/end GROUP
/end MODULE
/end PROJECT
