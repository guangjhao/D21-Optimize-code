ASAP2_VERSION 1 51
/begin PROJECT ProjectName "Project Comment Goes Here"
/begin HEADER "Header Comments go here" /end HEADER
/begin MODULE ModuleName "Module Comment Goes Here"
/begin MOD_COMMON "Mod Common Comment Here" BYTE_ORDER MSB_LAST ALIGNMENT_BYTE 1 ALIGNMENT_WORD 1 ALIGNMENT_LONG 1 ALIGNMENT_FLOAT32_IEEE 1 ALIGNMENT_FLOAT64_IEEE 1 /end MOD_COMMON
/begin FUNCTION convert_out90 "" /begin SUB_FUNCTION Constant gain offset MinMax Divide Add /end SUB_FUNCTION /begin DEF_CHARACTERISTIC /end DEF_CHARACTERISTIC /begin IN_MEASUREMENT /end IN_MEASUREMENT /begin OUT_MEASUREMENT /end OUT_MEASUREMENT /end FUNCTION
/begin FUNCTION convert_out94 "" /begin SUB_FUNCTION Constant gain offset MinMax Divide Add /end SUB_FUNCTION /begin DEF_CHARACTERISTIC /end DEF_CHARACTERISTIC /begin IN_MEASUREMENT /end IN_MEASUREMENT /begin OUT_MEASUREMENT /end OUT_MEASUREMENT /end FUNCTION
/begin FUNCTION convert_out97 "" /begin SUB_FUNCTION Constant gain offset MinMax Divide Add /end SUB_FUNCTION /begin DEF_CHARACTERISTIC /end DEF_CHARACTERISTIC /begin IN_MEASUREMENT /end IN_MEASUREMENT /begin OUT_MEASUREMENT /end OUT_MEASUREMENT /end FUNCTION
/begin FUNCTION convert_out98 "" /begin SUB_FUNCTION Constant gain offset MinMax Divide Add /end SUB_FUNCTION /begin DEF_CHARACTERISTIC /end DEF_CHARACTERISTIC /begin IN_MEASUREMENT /end IN_MEASUREMENT /begin OUT_MEASUREMENT /end OUT_MEASUREMENT /end FUNCTION
/begin FUNCTION convert_out99 "" /begin SUB_FUNCTION Constant gain offset MinMax Divide Add /end SUB_FUNCTION /begin DEF_CHARACTERISTIC /end DEF_CHARACTERISTIC /begin IN_MEASUREMENT /end IN_MEASUREMENT /begin OUT_MEASUREMENT /end OUT_MEASUREMENT /end FUNCTION
/begin FUNCTION pct2raw1 ""
 /begin SUB_FUNCTION convert_out1 convert_out4 Shift_Arithmetic1 Shift_Arithmetic2 Shift_Arithmetic39 Data_Type_Conversion1 Data_Type_Conversion2 Data_Type_Conversion3 Data_Type_Conversion4 Data_Type_Conversion5 Gain Gain1 /end SUB_FUNCTION
 /begin DEF_CHARACTERISTIC /end DEF_CHARACTERISTIC
 /begin IN_MEASUREMENT /end IN_MEASUREMENT
 /begin OUT_MEASUREMENT /end OUT_MEASUREMENT
/end FUNCTION
/begin FUNCTION pct2raw8 ""
 /begin SUB_FUNCTION convert_out1 convert_out4 Shift_Arithmetic1 Shift_Arithmetic2 Shift_Arithmetic39 Data_Type_Conversion1 Data_Type_Conversion2 Data_Type_Conversion3 Data_Type_Conversion4 Data_Type_Conversion5 Gain Gain1 /end SUB_FUNCTION
 /begin DEF_CHARACTERISTIC /end DEF_CHARACTERISTIC
 /begin IN_MEASUREMENT /end IN_MEASUREMENT
 /begin OUT_MEASUREMENT /end OUT_MEASUREMENT
/end FUNCTION
/begin FUNCTION uint16Touint8Array1 ""
 /begin SUB_FUNCTION Shift_Arithmetic39 Data_Type_Conversion1 Data_Type_Conversion2 Data_Type_Conversion5 /end SUB_FUNCTION
 /begin DEF_CHARACTERISTIC /end DEF_CHARACTERISTIC
 /begin IN_MEASUREMENT /end IN_MEASUREMENT
 /begin OUT_MEASUREMENT /end OUT_MEASUREMENT
/end FUNCTION
/begin FUNCTION uint16Touint8Array10 "" /begin SUB_FUNCTION Shift_Arithmetic39 /end SUB_FUNCTION /begin DEF_CHARACTERISTIC /end DEF_CHARACTERISTIC /begin IN_MEASUREMENT /end IN_MEASUREMENT /begin OUT_MEASUREMENT /end OUT_MEASUREMENT /end FUNCTION
/begin FUNCTION uint16Touint8Array11 "" /begin SUB_FUNCTION Shift_Arithmetic39 /end SUB_FUNCTION /begin DEF_CHARACTERISTIC /end DEF_CHARACTERISTIC /begin IN_MEASUREMENT /end IN_MEASUREMENT /begin OUT_MEASUREMENT /end OUT_MEASUREMENT /end FUNCTION
/begin FUNCTION uint16Touint8Array12 ""
 /begin SUB_FUNCTION Shift_Arithmetic39 Data_Type_Conversion1 Data_Type_Conversion5 /end SUB_FUNCTION
 /begin DEF_CHARACTERISTIC /end DEF_CHARACTERISTIC
 /begin IN_MEASUREMENT /end IN_MEASUREMENT
 /begin OUT_MEASUREMENT /end OUT_MEASUREMENT
/end FUNCTION
/begin FUNCTION uint16Touint8Array13 "" /begin SUB_FUNCTION Shift_Arithmetic39 /end SUB_FUNCTION /begin DEF_CHARACTERISTIC /end DEF_CHARACTERISTIC /begin IN_MEASUREMENT /end IN_MEASUREMENT /begin OUT_MEASUREMENT /end OUT_MEASUREMENT /end FUNCTION
/begin FUNCTION uint16Touint8Array14 "" /begin SUB_FUNCTION Shift_Arithmetic39 /end SUB_FUNCTION /begin DEF_CHARACTERISTIC /end DEF_CHARACTERISTIC /begin IN_MEASUREMENT /end IN_MEASUREMENT /begin OUT_MEASUREMENT /end OUT_MEASUREMENT /end FUNCTION
/begin FUNCTION uint16Touint8Array15 "" /begin SUB_FUNCTION Shift_Arithmetic39 /end SUB_FUNCTION /begin DEF_CHARACTERISTIC /end DEF_CHARACTERISTIC /begin IN_MEASUREMENT /end IN_MEASUREMENT /begin OUT_MEASUREMENT /end OUT_MEASUREMENT /end FUNCTION
/begin FUNCTION uint16Touint8Array16 "" /begin SUB_FUNCTION Shift_Arithmetic39 /end SUB_FUNCTION /begin DEF_CHARACTERISTIC /end DEF_CHARACTERISTIC /begin IN_MEASUREMENT /end IN_MEASUREMENT /begin OUT_MEASUREMENT /end OUT_MEASUREMENT /end FUNCTION
/begin FUNCTION uint16Touint8Array17 "" /begin SUB_FUNCTION Shift_Arithmetic39 /end SUB_FUNCTION /begin DEF_CHARACTERISTIC /end DEF_CHARACTERISTIC /begin IN_MEASUREMENT /end IN_MEASUREMENT /begin OUT_MEASUREMENT /end OUT_MEASUREMENT /end FUNCTION
/begin FUNCTION uint16Touint8Array18 "" /begin SUB_FUNCTION Shift_Arithmetic39 /end SUB_FUNCTION /begin DEF_CHARACTERISTIC /end DEF_CHARACTERISTIC /begin IN_MEASUREMENT /end IN_MEASUREMENT /begin OUT_MEASUREMENT /end OUT_MEASUREMENT /end FUNCTION
/begin FUNCTION uint16Touint8Array19 "" /begin SUB_FUNCTION Shift_Arithmetic39 /end SUB_FUNCTION /begin DEF_CHARACTERISTIC /end DEF_CHARACTERISTIC /begin IN_MEASUREMENT /end IN_MEASUREMENT /begin OUT_MEASUREMENT /end OUT_MEASUREMENT /end FUNCTION
/begin FUNCTION uint16Touint8Array2 ""
 /begin SUB_FUNCTION Shift_Arithmetic39 Data_Type_Conversion1 Data_Type_Conversion5 /end SUB_FUNCTION
 /begin DEF_CHARACTERISTIC /end DEF_CHARACTERISTIC
 /begin IN_MEASUREMENT /end IN_MEASUREMENT
 /begin OUT_MEASUREMENT /end OUT_MEASUREMENT
/end FUNCTION
/begin FUNCTION uint16Touint8Array20 "" /begin SUB_FUNCTION Shift_Arithmetic39 /end SUB_FUNCTION /begin DEF_CHARACTERISTIC /end DEF_CHARACTERISTIC /begin IN_MEASUREMENT /end IN_MEASUREMENT /begin OUT_MEASUREMENT /end OUT_MEASUREMENT /end FUNCTION
/begin FUNCTION uint16Touint8Array21 "" /begin SUB_FUNCTION Shift_Arithmetic39 /end SUB_FUNCTION /begin DEF_CHARACTERISTIC /end DEF_CHARACTERISTIC /begin IN_MEASUREMENT /end IN_MEASUREMENT /begin OUT_MEASUREMENT /end OUT_MEASUREMENT /end FUNCTION
/begin FUNCTION uint16Touint8Array22 "" /begin SUB_FUNCTION Shift_Arithmetic39 /end SUB_FUNCTION /begin DEF_CHARACTERISTIC /end DEF_CHARACTERISTIC /begin IN_MEASUREMENT /end IN_MEASUREMENT /begin OUT_MEASUREMENT /end OUT_MEASUREMENT /end FUNCTION
/begin FUNCTION uint16Touint8Array23 "" /begin SUB_FUNCTION Shift_Arithmetic39 /end SUB_FUNCTION /begin DEF_CHARACTERISTIC /end DEF_CHARACTERISTIC /begin IN_MEASUREMENT /end IN_MEASUREMENT /begin OUT_MEASUREMENT /end OUT_MEASUREMENT /end FUNCTION
/begin FUNCTION uint16Touint8Array24 "" /begin SUB_FUNCTION Shift_Arithmetic39 /end SUB_FUNCTION /begin DEF_CHARACTERISTIC /end DEF_CHARACTERISTIC /begin IN_MEASUREMENT /end IN_MEASUREMENT /begin OUT_MEASUREMENT /end OUT_MEASUREMENT /end FUNCTION
/begin FUNCTION uint16Touint8Array25 "" /begin SUB_FUNCTION Shift_Arithmetic39 /end SUB_FUNCTION /begin DEF_CHARACTERISTIC /end DEF_CHARACTERISTIC /begin IN_MEASUREMENT /end IN_MEASUREMENT /begin OUT_MEASUREMENT /end OUT_MEASUREMENT /end FUNCTION
/begin FUNCTION uint16Touint8Array26 "" /begin SUB_FUNCTION Shift_Arithmetic39 /end SUB_FUNCTION /begin DEF_CHARACTERISTIC /end DEF_CHARACTERISTIC /begin IN_MEASUREMENT /end IN_MEASUREMENT /begin OUT_MEASUREMENT /end OUT_MEASUREMENT /end FUNCTION
/begin FUNCTION uint16Touint8Array27 "" /begin SUB_FUNCTION Shift_Arithmetic39 /end SUB_FUNCTION /begin DEF_CHARACTERISTIC /end DEF_CHARACTERISTIC /begin IN_MEASUREMENT /end IN_MEASUREMENT /begin OUT_MEASUREMENT /end OUT_MEASUREMENT /end FUNCTION
/begin FUNCTION uint16Touint8Array28 "" /begin SUB_FUNCTION Shift_Arithmetic39 /end SUB_FUNCTION /begin DEF_CHARACTERISTIC /end DEF_CHARACTERISTIC /begin IN_MEASUREMENT /end IN_MEASUREMENT /begin OUT_MEASUREMENT /end OUT_MEASUREMENT /end FUNCTION
/begin FUNCTION uint16Touint8Array29 "" /begin SUB_FUNCTION Shift_Arithmetic39 /end SUB_FUNCTION /begin DEF_CHARACTERISTIC /end DEF_CHARACTERISTIC /begin IN_MEASUREMENT /end IN_MEASUREMENT /begin OUT_MEASUREMENT /end OUT_MEASUREMENT /end FUNCTION
/begin FUNCTION uint16Touint8Array3 ""
 /begin SUB_FUNCTION Shift_Arithmetic39 Data_Type_Conversion1 Data_Type_Conversion2 Data_Type_Conversion5 /end SUB_FUNCTION
 /begin DEF_CHARACTERISTIC /end DEF_CHARACTERISTIC
 /begin IN_MEASUREMENT /end IN_MEASUREMENT
 /begin OUT_MEASUREMENT /end OUT_MEASUREMENT
/end FUNCTION
/begin FUNCTION uint16Touint8Array4 "" /begin SUB_FUNCTION Shift_Arithmetic39 /end SUB_FUNCTION /begin DEF_CHARACTERISTIC /end DEF_CHARACTERISTIC /begin IN_MEASUREMENT /end IN_MEASUREMENT /begin OUT_MEASUREMENT /end OUT_MEASUREMENT /end FUNCTION
/begin FUNCTION uint16Touint8Array5 "" /begin SUB_FUNCTION Shift_Arithmetic39 /end SUB_FUNCTION /begin DEF_CHARACTERISTIC /end DEF_CHARACTERISTIC /begin IN_MEASUREMENT /end IN_MEASUREMENT /begin OUT_MEASUREMENT /end OUT_MEASUREMENT /end FUNCTION
/begin FUNCTION uint16Touint8Array6 "" /begin SUB_FUNCTION Shift_Arithmetic39 /end SUB_FUNCTION /begin DEF_CHARACTERISTIC /end DEF_CHARACTERISTIC /begin IN_MEASUREMENT /end IN_MEASUREMENT /begin OUT_MEASUREMENT /end OUT_MEASUREMENT /end FUNCTION
/begin FUNCTION uint16Touint8Array7 "" /begin SUB_FUNCTION Shift_Arithmetic39 /end SUB_FUNCTION /begin DEF_CHARACTERISTIC /end DEF_CHARACTERISTIC /begin IN_MEASUREMENT /end IN_MEASUREMENT /begin OUT_MEASUREMENT /end OUT_MEASUREMENT /end FUNCTION
/begin FUNCTION uint16Touint8Array8 "" /begin SUB_FUNCTION Shift_Arithmetic39 /end SUB_FUNCTION /begin DEF_CHARACTERISTIC /end DEF_CHARACTERISTIC /begin IN_MEASUREMENT /end IN_MEASUREMENT /begin OUT_MEASUREMENT /end OUT_MEASUREMENT /end FUNCTION
/begin FUNCTION uint16Touint8Array9 "" /begin SUB_FUNCTION Shift_Arithmetic39 /end SUB_FUNCTION /begin DEF_CHARACTERISTIC /end DEF_CHARACTERISTIC /begin IN_MEASUREMENT /end IN_MEASUREMENT /begin OUT_MEASUREMENT /end OUT_MEASUREMENT /end FUNCTION
/begin FUNCTION uint32Touint8Array ""
 /begin SUB_FUNCTION Shift_Arithmetic39 Shift_Arithmetic40 Shift_Arithmetic41 Data_Type_Conversion1 Data_Type_Conversion3 Data_Type_Conversion4 Data_Type_Conversion5 /end SUB_FUNCTION
 /begin DEF_CHARACTERISTIC /end DEF_CHARACTERISTIC
 /begin IN_MEASUREMENT /end IN_MEASUREMENT
 /begin OUT_MEASUREMENT /end OUT_MEASUREMENT
/end FUNCTION
/begin FUNCTION uint32Touint8Array1 ""
 /begin SUB_FUNCTION Shift_Arithmetic39 Shift_Arithmetic40 Shift_Arithmetic41 Data_Type_Conversion1 Data_Type_Conversion3 Data_Type_Conversion4 Data_Type_Conversion5 /end SUB_FUNCTION
 /begin DEF_CHARACTERISTIC /end DEF_CHARACTERISTIC
 /begin IN_MEASUREMENT /end IN_MEASUREMENT
 /begin OUT_MEASUREMENT /end OUT_MEASUREMENT
/end FUNCTION
/begin FUNCTION uint32Touint8Array10 ""
 /begin SUB_FUNCTION Shift_Arithmetic39 Shift_Arithmetic40 Shift_Arithmetic41 Data_Type_Conversion1 Data_Type_Conversion3 Data_Type_Conversion4 Data_Type_Conversion5 /end SUB_FUNCTION
 /begin DEF_CHARACTERISTIC /end DEF_CHARACTERISTIC
 /begin IN_MEASUREMENT /end IN_MEASUREMENT
 /begin OUT_MEASUREMENT /end OUT_MEASUREMENT
/end FUNCTION
/begin FUNCTION uint32Touint8Array11 ""
 /begin SUB_FUNCTION Shift_Arithmetic39 Shift_Arithmetic40 Shift_Arithmetic41 Data_Type_Conversion1 Data_Type_Conversion3 Data_Type_Conversion4 Data_Type_Conversion5 /end SUB_FUNCTION
 /begin DEF_CHARACTERISTIC /end DEF_CHARACTERISTIC
 /begin IN_MEASUREMENT /end IN_MEASUREMENT
 /begin OUT_MEASUREMENT /end OUT_MEASUREMENT
/end FUNCTION
/begin FUNCTION uint32Touint8Array12 ""
 /begin SUB_FUNCTION Shift_Arithmetic39 Shift_Arithmetic40 Shift_Arithmetic41 Data_Type_Conversion1 Data_Type_Conversion3 Data_Type_Conversion4 Data_Type_Conversion5 /end SUB_FUNCTION
 /begin DEF_CHARACTERISTIC /end DEF_CHARACTERISTIC
 /begin IN_MEASUREMENT /end IN_MEASUREMENT
 /begin OUT_MEASUREMENT /end OUT_MEASUREMENT
/end FUNCTION
/begin FUNCTION uint32Touint8Array13 "" /begin SUB_FUNCTION Shift_Arithmetic39 Shift_Arithmetic40 Shift_Arithmetic41 /end SUB_FUNCTION /begin DEF_CHARACTERISTIC /end DEF_CHARACTERISTIC /begin IN_MEASUREMENT /end IN_MEASUREMENT /begin OUT_MEASUREMENT /end OUT_MEASUREMENT /end FUNCTION
/begin FUNCTION uint32Touint8Array14 "" /begin SUB_FUNCTION Shift_Arithmetic39 Shift_Arithmetic40 Shift_Arithmetic41 /end SUB_FUNCTION /begin DEF_CHARACTERISTIC /end DEF_CHARACTERISTIC /begin IN_MEASUREMENT /end IN_MEASUREMENT /begin OUT_MEASUREMENT /end OUT_MEASUREMENT /end FUNCTION
/begin FUNCTION uint32Touint8Array15 "" /begin SUB_FUNCTION Shift_Arithmetic39 Shift_Arithmetic40 Shift_Arithmetic41 /end SUB_FUNCTION /begin DEF_CHARACTERISTIC /end DEF_CHARACTERISTIC /begin IN_MEASUREMENT /end IN_MEASUREMENT /begin OUT_MEASUREMENT /end OUT_MEASUREMENT /end FUNCTION
/begin FUNCTION uint32Touint8Array16 "" /begin SUB_FUNCTION Shift_Arithmetic39 Shift_Arithmetic40 Shift_Arithmetic41 /end SUB_FUNCTION /begin DEF_CHARACTERISTIC /end DEF_CHARACTERISTIC /begin IN_MEASUREMENT /end IN_MEASUREMENT /begin OUT_MEASUREMENT /end OUT_MEASUREMENT /end FUNCTION
/begin FUNCTION uint32Touint8Array17 "" /begin SUB_FUNCTION Shift_Arithmetic39 Shift_Arithmetic40 Shift_Arithmetic41 /end SUB_FUNCTION /begin DEF_CHARACTERISTIC /end DEF_CHARACTERISTIC /begin IN_MEASUREMENT /end IN_MEASUREMENT /begin OUT_MEASUREMENT /end OUT_MEASUREMENT /end FUNCTION
/begin FUNCTION uint32Touint8Array18 "" /begin SUB_FUNCTION Shift_Arithmetic39 Shift_Arithmetic40 Shift_Arithmetic41 /end SUB_FUNCTION /begin DEF_CHARACTERISTIC /end DEF_CHARACTERISTIC /begin IN_MEASUREMENT /end IN_MEASUREMENT /begin OUT_MEASUREMENT /end OUT_MEASUREMENT /end FUNCTION
/begin FUNCTION uint32Touint8Array19 "" /begin SUB_FUNCTION Shift_Arithmetic39 Shift_Arithmetic40 Shift_Arithmetic41 /end SUB_FUNCTION /begin DEF_CHARACTERISTIC /end DEF_CHARACTERISTIC /begin IN_MEASUREMENT /end IN_MEASUREMENT /begin OUT_MEASUREMENT /end OUT_MEASUREMENT /end FUNCTION
/begin FUNCTION uint32Touint8Array2 ""
 /begin SUB_FUNCTION Shift_Arithmetic39 Shift_Arithmetic40 Shift_Arithmetic41 Data_Type_Conversion1 Data_Type_Conversion3 Data_Type_Conversion4 Data_Type_Conversion5 /end SUB_FUNCTION
 /begin DEF_CHARACTERISTIC /end DEF_CHARACTERISTIC
 /begin IN_MEASUREMENT /end IN_MEASUREMENT
 /begin OUT_MEASUREMENT /end OUT_MEASUREMENT
/end FUNCTION
/begin FUNCTION uint32Touint8Array20 "" /begin SUB_FUNCTION Shift_Arithmetic39 Shift_Arithmetic40 Shift_Arithmetic41 /end SUB_FUNCTION /begin DEF_CHARACTERISTIC /end DEF_CHARACTERISTIC /begin IN_MEASUREMENT /end IN_MEASUREMENT /begin OUT_MEASUREMENT /end OUT_MEASUREMENT /end FUNCTION
/begin FUNCTION uint32Touint8Array21 "" /begin SUB_FUNCTION Shift_Arithmetic39 Shift_Arithmetic40 Shift_Arithmetic41 /end SUB_FUNCTION /begin DEF_CHARACTERISTIC /end DEF_CHARACTERISTIC /begin IN_MEASUREMENT /end IN_MEASUREMENT /begin OUT_MEASUREMENT /end OUT_MEASUREMENT /end FUNCTION
/begin FUNCTION uint32Touint8Array22 "" /begin SUB_FUNCTION Shift_Arithmetic39 Shift_Arithmetic40 Shift_Arithmetic41 /end SUB_FUNCTION /begin DEF_CHARACTERISTIC /end DEF_CHARACTERISTIC /begin IN_MEASUREMENT /end IN_MEASUREMENT /begin OUT_MEASUREMENT /end OUT_MEASUREMENT /end FUNCTION
/begin FUNCTION uint32Touint8Array23 "" /begin SUB_FUNCTION Shift_Arithmetic39 Shift_Arithmetic40 Shift_Arithmetic41 /end SUB_FUNCTION /begin DEF_CHARACTERISTIC /end DEF_CHARACTERISTIC /begin IN_MEASUREMENT /end IN_MEASUREMENT /begin OUT_MEASUREMENT /end OUT_MEASUREMENT /end FUNCTION
/begin FUNCTION uint32Touint8Array24 "" /begin SUB_FUNCTION Shift_Arithmetic39 Shift_Arithmetic40 Shift_Arithmetic41 /end SUB_FUNCTION /begin DEF_CHARACTERISTIC /end DEF_CHARACTERISTIC /begin IN_MEASUREMENT /end IN_MEASUREMENT /begin OUT_MEASUREMENT /end OUT_MEASUREMENT /end FUNCTION
/begin FUNCTION uint32Touint8Array25 "" /begin SUB_FUNCTION Shift_Arithmetic39 Shift_Arithmetic40 Shift_Arithmetic41 /end SUB_FUNCTION /begin DEF_CHARACTERISTIC /end DEF_CHARACTERISTIC /begin IN_MEASUREMENT /end IN_MEASUREMENT /begin OUT_MEASUREMENT /end OUT_MEASUREMENT /end FUNCTION
/begin FUNCTION uint32Touint8Array26 "" /begin SUB_FUNCTION Shift_Arithmetic39 Shift_Arithmetic40 Shift_Arithmetic41 /end SUB_FUNCTION /begin DEF_CHARACTERISTIC /end DEF_CHARACTERISTIC /begin IN_MEASUREMENT /end IN_MEASUREMENT /begin OUT_MEASUREMENT /end OUT_MEASUREMENT /end FUNCTION
/begin FUNCTION uint32Touint8Array27 "" /begin SUB_FUNCTION Shift_Arithmetic39 Shift_Arithmetic40 Shift_Arithmetic41 /end SUB_FUNCTION /begin DEF_CHARACTERISTIC /end DEF_CHARACTERISTIC /begin IN_MEASUREMENT /end IN_MEASUREMENT /begin OUT_MEASUREMENT /end OUT_MEASUREMENT /end FUNCTION
/begin FUNCTION uint32Touint8Array28 "" /begin SUB_FUNCTION Shift_Arithmetic39 Shift_Arithmetic40 Shift_Arithmetic41 /end SUB_FUNCTION /begin DEF_CHARACTERISTIC /end DEF_CHARACTERISTIC /begin IN_MEASUREMENT /end IN_MEASUREMENT /begin OUT_MEASUREMENT /end OUT_MEASUREMENT /end FUNCTION
/begin FUNCTION uint32Touint8Array29 ""
 /begin SUB_FUNCTION Shift_Arithmetic39 Shift_Arithmetic40 Shift_Arithmetic41 Data_Type_Conversion1 Data_Type_Conversion2 Data_Type_Conversion3 Data_Type_Conversion4 Data_Type_Conversion5 /end SUB_FUNCTION
 /begin DEF_CHARACTERISTIC /end DEF_CHARACTERISTIC
 /begin IN_MEASUREMENT /end IN_MEASUREMENT
 /begin OUT_MEASUREMENT /end OUT_MEASUREMENT
/end FUNCTION
/begin FUNCTION uint32Touint8Array3 ""
 /begin SUB_FUNCTION Shift_Arithmetic39 Shift_Arithmetic40 Shift_Arithmetic41 Data_Type_Conversion1 Data_Type_Conversion3 Data_Type_Conversion4 Data_Type_Conversion5 /end SUB_FUNCTION
 /begin DEF_CHARACTERISTIC /end DEF_CHARACTERISTIC
 /begin IN_MEASUREMENT /end IN_MEASUREMENT
 /begin OUT_MEASUREMENT /end OUT_MEASUREMENT
/end FUNCTION
/begin FUNCTION uint32Touint8Array30 ""
 /begin SUB_FUNCTION Shift_Arithmetic39 Shift_Arithmetic40 Shift_Arithmetic41 Data_Type_Conversion1 Data_Type_Conversion2 Data_Type_Conversion3 Data_Type_Conversion4 Data_Type_Conversion5 /end SUB_FUNCTION
 /begin DEF_CHARACTERISTIC /end DEF_CHARACTERISTIC
 /begin IN_MEASUREMENT /end IN_MEASUREMENT
 /begin OUT_MEASUREMENT /end OUT_MEASUREMENT
/end FUNCTION
/begin FUNCTION uint32Touint8Array31 ""
 /begin SUB_FUNCTION Shift_Arithmetic39 Shift_Arithmetic40 Shift_Arithmetic41 Data_Type_Conversion1 Data_Type_Conversion2 Data_Type_Conversion3 Data_Type_Conversion4 Data_Type_Conversion5 /end SUB_FUNCTION
 /begin DEF_CHARACTERISTIC /end DEF_CHARACTERISTIC
 /begin IN_MEASUREMENT /end IN_MEASUREMENT
 /begin OUT_MEASUREMENT /end OUT_MEASUREMENT
/end FUNCTION
/begin FUNCTION uint32Touint8Array32 ""
 /begin SUB_FUNCTION Shift_Arithmetic39 Shift_Arithmetic40 Shift_Arithmetic41 Data_Type_Conversion1 Data_Type_Conversion2 Data_Type_Conversion3 Data_Type_Conversion4 Data_Type_Conversion5 /end SUB_FUNCTION
 /begin DEF_CHARACTERISTIC /end DEF_CHARACTERISTIC
 /begin IN_MEASUREMENT /end IN_MEASUREMENT
 /begin OUT_MEASUREMENT /end OUT_MEASUREMENT
/end FUNCTION
/begin FUNCTION uint32Touint8Array33 ""
 /begin SUB_FUNCTION Shift_Arithmetic39 Shift_Arithmetic40 Shift_Arithmetic41 Data_Type_Conversion1 Data_Type_Conversion3 Data_Type_Conversion4 Data_Type_Conversion5 /end SUB_FUNCTION
 /begin DEF_CHARACTERISTIC /end DEF_CHARACTERISTIC
 /begin IN_MEASUREMENT /end IN_MEASUREMENT
 /begin OUT_MEASUREMENT /end OUT_MEASUREMENT
/end FUNCTION
/begin FUNCTION uint32Touint8Array34 ""
 /begin SUB_FUNCTION Shift_Arithmetic39 Shift_Arithmetic40 Shift_Arithmetic41 Data_Type_Conversion1 Data_Type_Conversion3 Data_Type_Conversion4 Data_Type_Conversion5 /end SUB_FUNCTION
 /begin DEF_CHARACTERISTIC /end DEF_CHARACTERISTIC
 /begin IN_MEASUREMENT /end IN_MEASUREMENT
 /begin OUT_MEASUREMENT /end OUT_MEASUREMENT
/end FUNCTION
/begin FUNCTION uint32Touint8Array35 "" /begin SUB_FUNCTION Shift_Arithmetic39 Shift_Arithmetic40 Shift_Arithmetic41 /end SUB_FUNCTION /begin DEF_CHARACTERISTIC /end DEF_CHARACTERISTIC /begin IN_MEASUREMENT /end IN_MEASUREMENT /begin OUT_MEASUREMENT /end OUT_MEASUREMENT /end FUNCTION
/begin FUNCTION uint32Touint8Array36 "" /begin SUB_FUNCTION Shift_Arithmetic39 Shift_Arithmetic40 Shift_Arithmetic41 /end SUB_FUNCTION /begin DEF_CHARACTERISTIC /end DEF_CHARACTERISTIC /begin IN_MEASUREMENT /end IN_MEASUREMENT /begin OUT_MEASUREMENT /end OUT_MEASUREMENT /end FUNCTION
/begin FUNCTION uint32Touint8Array37 "" /begin SUB_FUNCTION Shift_Arithmetic39 Shift_Arithmetic40 Shift_Arithmetic41 /end SUB_FUNCTION /begin DEF_CHARACTERISTIC /end DEF_CHARACTERISTIC /begin IN_MEASUREMENT /end IN_MEASUREMENT /begin OUT_MEASUREMENT /end OUT_MEASUREMENT /end FUNCTION
/begin FUNCTION uint32Touint8Array38 "" /begin SUB_FUNCTION Shift_Arithmetic39 Shift_Arithmetic40 Shift_Arithmetic41 /end SUB_FUNCTION /begin DEF_CHARACTERISTIC /end DEF_CHARACTERISTIC /begin IN_MEASUREMENT /end IN_MEASUREMENT /begin OUT_MEASUREMENT /end OUT_MEASUREMENT /end FUNCTION
/begin FUNCTION uint32Touint8Array39 "" /begin SUB_FUNCTION Shift_Arithmetic39 Shift_Arithmetic40 Shift_Arithmetic41 /end SUB_FUNCTION /begin DEF_CHARACTERISTIC /end DEF_CHARACTERISTIC /begin IN_MEASUREMENT /end IN_MEASUREMENT /begin OUT_MEASUREMENT /end OUT_MEASUREMENT /end FUNCTION
/begin FUNCTION uint32Touint8Array4 ""
 /begin SUB_FUNCTION Shift_Arithmetic39 Shift_Arithmetic40 Shift_Arithmetic41 Data_Type_Conversion1 Data_Type_Conversion2 Data_Type_Conversion3 Data_Type_Conversion4 Data_Type_Conversion5 /end SUB_FUNCTION
 /begin DEF_CHARACTERISTIC /end DEF_CHARACTERISTIC
 /begin IN_MEASUREMENT /end IN_MEASUREMENT
 /begin OUT_MEASUREMENT /end OUT_MEASUREMENT
/end FUNCTION
/begin FUNCTION uint32Touint8Array40 "" /begin SUB_FUNCTION Shift_Arithmetic39 Shift_Arithmetic40 Shift_Arithmetic41 /end SUB_FUNCTION /begin DEF_CHARACTERISTIC /end DEF_CHARACTERISTIC /begin IN_MEASUREMENT /end IN_MEASUREMENT /begin OUT_MEASUREMENT /end OUT_MEASUREMENT /end FUNCTION
/begin FUNCTION uint32Touint8Array41 "" /begin SUB_FUNCTION Shift_Arithmetic39 Shift_Arithmetic40 Shift_Arithmetic41 /end SUB_FUNCTION /begin DEF_CHARACTERISTIC /end DEF_CHARACTERISTIC /begin IN_MEASUREMENT /end IN_MEASUREMENT /begin OUT_MEASUREMENT /end OUT_MEASUREMENT /end FUNCTION
/begin FUNCTION uint32Touint8Array42 "" /begin SUB_FUNCTION Shift_Arithmetic39 Shift_Arithmetic40 Shift_Arithmetic41 /end SUB_FUNCTION /begin DEF_CHARACTERISTIC /end DEF_CHARACTERISTIC /begin IN_MEASUREMENT /end IN_MEASUREMENT /begin OUT_MEASUREMENT /end OUT_MEASUREMENT /end FUNCTION
/begin FUNCTION uint32Touint8Array43 "" /begin SUB_FUNCTION Shift_Arithmetic39 Shift_Arithmetic40 Shift_Arithmetic41 /end SUB_FUNCTION /begin DEF_CHARACTERISTIC /end DEF_CHARACTERISTIC /begin IN_MEASUREMENT /end IN_MEASUREMENT /begin OUT_MEASUREMENT /end OUT_MEASUREMENT /end FUNCTION
/begin FUNCTION uint32Touint8Array44 "" /begin SUB_FUNCTION Shift_Arithmetic39 Shift_Arithmetic40 Shift_Arithmetic41 /end SUB_FUNCTION /begin DEF_CHARACTERISTIC /end DEF_CHARACTERISTIC /begin IN_MEASUREMENT /end IN_MEASUREMENT /begin OUT_MEASUREMENT /end OUT_MEASUREMENT /end FUNCTION
/begin FUNCTION uint32Touint8Array45 "" /begin SUB_FUNCTION Shift_Arithmetic39 Shift_Arithmetic40 Shift_Arithmetic41 /end SUB_FUNCTION /begin DEF_CHARACTERISTIC /end DEF_CHARACTERISTIC /begin IN_MEASUREMENT /end IN_MEASUREMENT /begin OUT_MEASUREMENT /end OUT_MEASUREMENT /end FUNCTION
/begin FUNCTION uint32Touint8Array46 "" /begin SUB_FUNCTION Shift_Arithmetic39 Shift_Arithmetic40 Shift_Arithmetic41 /end SUB_FUNCTION /begin DEF_CHARACTERISTIC /end DEF_CHARACTERISTIC /begin IN_MEASUREMENT /end IN_MEASUREMENT /begin OUT_MEASUREMENT /end OUT_MEASUREMENT /end FUNCTION
/begin FUNCTION uint32Touint8Array47 "" /begin SUB_FUNCTION Shift_Arithmetic39 Shift_Arithmetic40 Shift_Arithmetic41 /end SUB_FUNCTION /begin DEF_CHARACTERISTIC /end DEF_CHARACTERISTIC /begin IN_MEASUREMENT /end IN_MEASUREMENT /begin OUT_MEASUREMENT /end OUT_MEASUREMENT /end FUNCTION
/begin FUNCTION uint32Touint8Array48 "" /begin SUB_FUNCTION Shift_Arithmetic39 Shift_Arithmetic40 Shift_Arithmetic41 /end SUB_FUNCTION /begin DEF_CHARACTERISTIC /end DEF_CHARACTERISTIC /begin IN_MEASUREMENT /end IN_MEASUREMENT /begin OUT_MEASUREMENT /end OUT_MEASUREMENT /end FUNCTION
/begin FUNCTION uint32Touint8Array49 "" /begin SUB_FUNCTION Shift_Arithmetic39 Shift_Arithmetic40 Shift_Arithmetic41 /end SUB_FUNCTION /begin DEF_CHARACTERISTIC /end DEF_CHARACTERISTIC /begin IN_MEASUREMENT /end IN_MEASUREMENT /begin OUT_MEASUREMENT /end OUT_MEASUREMENT /end FUNCTION
/begin FUNCTION uint32Touint8Array5 "" /begin SUB_FUNCTION Shift_Arithmetic39 Shift_Arithmetic40 Shift_Arithmetic41 /end SUB_FUNCTION /begin DEF_CHARACTERISTIC /end DEF_CHARACTERISTIC /begin IN_MEASUREMENT /end IN_MEASUREMENT /begin OUT_MEASUREMENT /end OUT_MEASUREMENT /end FUNCTION
/begin FUNCTION uint32Touint8Array50 "" /begin SUB_FUNCTION Shift_Arithmetic39 Shift_Arithmetic40 Shift_Arithmetic41 /end SUB_FUNCTION /begin DEF_CHARACTERISTIC /end DEF_CHARACTERISTIC /begin IN_MEASUREMENT /end IN_MEASUREMENT /begin OUT_MEASUREMENT /end OUT_MEASUREMENT /end FUNCTION
/begin FUNCTION uint32Touint8Array51 "" /begin SUB_FUNCTION Shift_Arithmetic39 Shift_Arithmetic40 Shift_Arithmetic41 /end SUB_FUNCTION /begin DEF_CHARACTERISTIC /end DEF_CHARACTERISTIC /begin IN_MEASUREMENT /end IN_MEASUREMENT /begin OUT_MEASUREMENT /end OUT_MEASUREMENT /end FUNCTION
/begin FUNCTION uint32Touint8Array52 "" /begin SUB_FUNCTION Shift_Arithmetic39 Shift_Arithmetic40 Shift_Arithmetic41 /end SUB_FUNCTION /begin DEF_CHARACTERISTIC /end DEF_CHARACTERISTIC /begin IN_MEASUREMENT /end IN_MEASUREMENT /begin OUT_MEASUREMENT /end OUT_MEASUREMENT /end FUNCTION
/begin FUNCTION uint32Touint8Array53 "" /begin SUB_FUNCTION Shift_Arithmetic39 Shift_Arithmetic40 Shift_Arithmetic41 /end SUB_FUNCTION /begin DEF_CHARACTERISTIC /end DEF_CHARACTERISTIC /begin IN_MEASUREMENT /end IN_MEASUREMENT /begin OUT_MEASUREMENT /end OUT_MEASUREMENT /end FUNCTION
/begin FUNCTION uint32Touint8Array54 "" /begin SUB_FUNCTION Shift_Arithmetic39 Shift_Arithmetic40 Shift_Arithmetic41 /end SUB_FUNCTION /begin DEF_CHARACTERISTIC /end DEF_CHARACTERISTIC /begin IN_MEASUREMENT /end IN_MEASUREMENT /begin OUT_MEASUREMENT /end OUT_MEASUREMENT /end FUNCTION
/begin FUNCTION uint32Touint8Array55 "" /begin SUB_FUNCTION Shift_Arithmetic39 Shift_Arithmetic40 Shift_Arithmetic41 /end SUB_FUNCTION /begin DEF_CHARACTERISTIC /end DEF_CHARACTERISTIC /begin IN_MEASUREMENT /end IN_MEASUREMENT /begin OUT_MEASUREMENT /end OUT_MEASUREMENT /end FUNCTION
/begin FUNCTION uint32Touint8Array56 "" /begin SUB_FUNCTION Shift_Arithmetic39 Shift_Arithmetic40 Shift_Arithmetic41 /end SUB_FUNCTION /begin DEF_CHARACTERISTIC /end DEF_CHARACTERISTIC /begin IN_MEASUREMENT /end IN_MEASUREMENT /begin OUT_MEASUREMENT /end OUT_MEASUREMENT /end FUNCTION
/begin FUNCTION uint32Touint8Array57 "" /begin SUB_FUNCTION Shift_Arithmetic39 Shift_Arithmetic40 Shift_Arithmetic41 /end SUB_FUNCTION /begin DEF_CHARACTERISTIC /end DEF_CHARACTERISTIC /begin IN_MEASUREMENT /end IN_MEASUREMENT /begin OUT_MEASUREMENT /end OUT_MEASUREMENT /end FUNCTION
/begin FUNCTION uint32Touint8Array58 "" /begin SUB_FUNCTION Shift_Arithmetic39 Shift_Arithmetic40 Shift_Arithmetic41 /end SUB_FUNCTION /begin DEF_CHARACTERISTIC /end DEF_CHARACTERISTIC /begin IN_MEASUREMENT /end IN_MEASUREMENT /begin OUT_MEASUREMENT /end OUT_MEASUREMENT /end FUNCTION
/begin FUNCTION uint32Touint8Array59 "" /begin SUB_FUNCTION Shift_Arithmetic39 Shift_Arithmetic40 Shift_Arithmetic41 /end SUB_FUNCTION /begin DEF_CHARACTERISTIC /end DEF_CHARACTERISTIC /begin IN_MEASUREMENT /end IN_MEASUREMENT /begin OUT_MEASUREMENT /end OUT_MEASUREMENT /end FUNCTION
/begin FUNCTION uint32Touint8Array6 "" /begin SUB_FUNCTION Shift_Arithmetic39 Shift_Arithmetic40 Shift_Arithmetic41 /end SUB_FUNCTION /begin DEF_CHARACTERISTIC /end DEF_CHARACTERISTIC /begin IN_MEASUREMENT /end IN_MEASUREMENT /begin OUT_MEASUREMENT /end OUT_MEASUREMENT /end FUNCTION
/begin FUNCTION uint32Touint8Array60 "" /begin SUB_FUNCTION Shift_Arithmetic39 Shift_Arithmetic40 Shift_Arithmetic41 /end SUB_FUNCTION /begin DEF_CHARACTERISTIC /end DEF_CHARACTERISTIC /begin IN_MEASUREMENT /end IN_MEASUREMENT /begin OUT_MEASUREMENT /end OUT_MEASUREMENT /end FUNCTION
/begin FUNCTION uint32Touint8Array61 "" /begin SUB_FUNCTION Shift_Arithmetic39 Shift_Arithmetic40 Shift_Arithmetic41 /end SUB_FUNCTION /begin DEF_CHARACTERISTIC /end DEF_CHARACTERISTIC /begin IN_MEASUREMENT /end IN_MEASUREMENT /begin OUT_MEASUREMENT /end OUT_MEASUREMENT /end FUNCTION
/begin FUNCTION uint32Touint8Array62 "" /begin SUB_FUNCTION Shift_Arithmetic39 Shift_Arithmetic40 Shift_Arithmetic41 /end SUB_FUNCTION /begin DEF_CHARACTERISTIC /end DEF_CHARACTERISTIC /begin IN_MEASUREMENT /end IN_MEASUREMENT /begin OUT_MEASUREMENT /end OUT_MEASUREMENT /end FUNCTION
/begin FUNCTION uint32Touint8Array63 "" /begin SUB_FUNCTION Shift_Arithmetic39 Shift_Arithmetic40 Shift_Arithmetic41 /end SUB_FUNCTION /begin DEF_CHARACTERISTIC /end DEF_CHARACTERISTIC /begin IN_MEASUREMENT /end IN_MEASUREMENT /begin OUT_MEASUREMENT /end OUT_MEASUREMENT /end FUNCTION
/begin FUNCTION uint32Touint8Array64 "" /begin SUB_FUNCTION Shift_Arithmetic39 Shift_Arithmetic40 Shift_Arithmetic41 /end SUB_FUNCTION /begin DEF_CHARACTERISTIC /end DEF_CHARACTERISTIC /begin IN_MEASUREMENT /end IN_MEASUREMENT /begin OUT_MEASUREMENT /end OUT_MEASUREMENT /end FUNCTION
/begin FUNCTION uint32Touint8Array65 "" /begin SUB_FUNCTION Shift_Arithmetic39 Shift_Arithmetic40 Shift_Arithmetic41 /end SUB_FUNCTION /begin DEF_CHARACTERISTIC /end DEF_CHARACTERISTIC /begin IN_MEASUREMENT /end IN_MEASUREMENT /begin OUT_MEASUREMENT /end OUT_MEASUREMENT /end FUNCTION
/begin FUNCTION uint32Touint8Array66 "" /begin SUB_FUNCTION Shift_Arithmetic39 Shift_Arithmetic40 Shift_Arithmetic41 /end SUB_FUNCTION /begin DEF_CHARACTERISTIC /end DEF_CHARACTERISTIC /begin IN_MEASUREMENT /end IN_MEASUREMENT /begin OUT_MEASUREMENT /end OUT_MEASUREMENT /end FUNCTION
/begin FUNCTION uint32Touint8Array67 "" /begin SUB_FUNCTION Shift_Arithmetic39 Shift_Arithmetic40 Shift_Arithmetic41 /end SUB_FUNCTION /begin DEF_CHARACTERISTIC /end DEF_CHARACTERISTIC /begin IN_MEASUREMENT /end IN_MEASUREMENT /begin OUT_MEASUREMENT /end OUT_MEASUREMENT /end FUNCTION
/begin FUNCTION uint32Touint8Array68 "" /begin SUB_FUNCTION Shift_Arithmetic39 Shift_Arithmetic40 Shift_Arithmetic41 /end SUB_FUNCTION /begin DEF_CHARACTERISTIC /end DEF_CHARACTERISTIC /begin IN_MEASUREMENT /end IN_MEASUREMENT /begin OUT_MEASUREMENT /end OUT_MEASUREMENT /end FUNCTION
/begin FUNCTION uint32Touint8Array69 "" /begin SUB_FUNCTION Shift_Arithmetic39 Shift_Arithmetic40 Shift_Arithmetic41 /end SUB_FUNCTION /begin DEF_CHARACTERISTIC /end DEF_CHARACTERISTIC /begin IN_MEASUREMENT /end IN_MEASUREMENT /begin OUT_MEASUREMENT /end OUT_MEASUREMENT /end FUNCTION
/begin FUNCTION uint32Touint8Array7 ""
 /begin SUB_FUNCTION Shift_Arithmetic39 Shift_Arithmetic40 Shift_Arithmetic41 Data_Type_Conversion1 Data_Type_Conversion3 Data_Type_Conversion4 Data_Type_Conversion5 /end SUB_FUNCTION
 /begin DEF_CHARACTERISTIC /end DEF_CHARACTERISTIC
 /begin IN_MEASUREMENT /end IN_MEASUREMENT
 /begin OUT_MEASUREMENT /end OUT_MEASUREMENT
/end FUNCTION
/begin FUNCTION uint32Touint8Array70 "" /begin SUB_FUNCTION Shift_Arithmetic39 Shift_Arithmetic40 Shift_Arithmetic41 /end SUB_FUNCTION /begin DEF_CHARACTERISTIC /end DEF_CHARACTERISTIC /begin IN_MEASUREMENT /end IN_MEASUREMENT /begin OUT_MEASUREMENT /end OUT_MEASUREMENT /end FUNCTION
/begin FUNCTION uint32Touint8Array71 "" /begin SUB_FUNCTION Shift_Arithmetic39 Shift_Arithmetic40 Shift_Arithmetic41 /end SUB_FUNCTION /begin DEF_CHARACTERISTIC /end DEF_CHARACTERISTIC /begin IN_MEASUREMENT /end IN_MEASUREMENT /begin OUT_MEASUREMENT /end OUT_MEASUREMENT /end FUNCTION
/begin FUNCTION uint32Touint8Array72 "" /begin SUB_FUNCTION Shift_Arithmetic39 Shift_Arithmetic40 Shift_Arithmetic41 /end SUB_FUNCTION /begin DEF_CHARACTERISTIC /end DEF_CHARACTERISTIC /begin IN_MEASUREMENT /end IN_MEASUREMENT /begin OUT_MEASUREMENT /end OUT_MEASUREMENT /end FUNCTION
/begin FUNCTION uint32Touint8Array73 "" /begin SUB_FUNCTION Shift_Arithmetic39 Shift_Arithmetic40 Shift_Arithmetic41 /end SUB_FUNCTION /begin DEF_CHARACTERISTIC /end DEF_CHARACTERISTIC /begin IN_MEASUREMENT /end IN_MEASUREMENT /begin OUT_MEASUREMENT /end OUT_MEASUREMENT /end FUNCTION
/begin FUNCTION uint32Touint8Array74 "" /begin SUB_FUNCTION Shift_Arithmetic39 Shift_Arithmetic40 Shift_Arithmetic41 /end SUB_FUNCTION /begin DEF_CHARACTERISTIC /end DEF_CHARACTERISTIC /begin IN_MEASUREMENT /end IN_MEASUREMENT /begin OUT_MEASUREMENT /end OUT_MEASUREMENT /end FUNCTION
/begin FUNCTION uint32Touint8Array75 "" /begin SUB_FUNCTION Shift_Arithmetic39 Shift_Arithmetic40 Shift_Arithmetic41 /end SUB_FUNCTION /begin DEF_CHARACTERISTIC /end DEF_CHARACTERISTIC /begin IN_MEASUREMENT /end IN_MEASUREMENT /begin OUT_MEASUREMENT /end OUT_MEASUREMENT /end FUNCTION
/begin FUNCTION uint32Touint8Array76 "" /begin SUB_FUNCTION Shift_Arithmetic39 Shift_Arithmetic40 Shift_Arithmetic41 /end SUB_FUNCTION /begin DEF_CHARACTERISTIC /end DEF_CHARACTERISTIC /begin IN_MEASUREMENT /end IN_MEASUREMENT /begin OUT_MEASUREMENT /end OUT_MEASUREMENT /end FUNCTION
/begin FUNCTION uint32Touint8Array77 "" /begin SUB_FUNCTION Shift_Arithmetic39 Shift_Arithmetic40 Shift_Arithmetic41 /end SUB_FUNCTION /begin DEF_CHARACTERISTIC /end DEF_CHARACTERISTIC /begin IN_MEASUREMENT /end IN_MEASUREMENT /begin OUT_MEASUREMENT /end OUT_MEASUREMENT /end FUNCTION
/begin FUNCTION uint32Touint8Array78 "" /begin SUB_FUNCTION Shift_Arithmetic39 Shift_Arithmetic40 Shift_Arithmetic41 /end SUB_FUNCTION /begin DEF_CHARACTERISTIC /end DEF_CHARACTERISTIC /begin IN_MEASUREMENT /end IN_MEASUREMENT /begin OUT_MEASUREMENT /end OUT_MEASUREMENT /end FUNCTION
/begin FUNCTION uint32Touint8Array79 "" /begin SUB_FUNCTION Shift_Arithmetic39 Shift_Arithmetic40 Shift_Arithmetic41 /end SUB_FUNCTION /begin DEF_CHARACTERISTIC /end DEF_CHARACTERISTIC /begin IN_MEASUREMENT /end IN_MEASUREMENT /begin OUT_MEASUREMENT /end OUT_MEASUREMENT /end FUNCTION
/begin FUNCTION uint32Touint8Array8 ""
 /begin SUB_FUNCTION Shift_Arithmetic39 Shift_Arithmetic40 Shift_Arithmetic41 Data_Type_Conversion1 Data_Type_Conversion3 Data_Type_Conversion4 Data_Type_Conversion5 /end SUB_FUNCTION
 /begin DEF_CHARACTERISTIC /end DEF_CHARACTERISTIC
 /begin IN_MEASUREMENT /end IN_MEASUREMENT
 /begin OUT_MEASUREMENT /end OUT_MEASUREMENT
/end FUNCTION
/begin FUNCTION uint32Touint8Array80 "" /begin SUB_FUNCTION Shift_Arithmetic39 Shift_Arithmetic40 Shift_Arithmetic41 /end SUB_FUNCTION /begin DEF_CHARACTERISTIC /end DEF_CHARACTERISTIC /begin IN_MEASUREMENT /end IN_MEASUREMENT /begin OUT_MEASUREMENT /end OUT_MEASUREMENT /end FUNCTION
/begin FUNCTION uint32Touint8Array81 "" /begin SUB_FUNCTION Shift_Arithmetic39 Shift_Arithmetic40 Shift_Arithmetic41 /end SUB_FUNCTION /begin DEF_CHARACTERISTIC /end DEF_CHARACTERISTIC /begin IN_MEASUREMENT /end IN_MEASUREMENT /begin OUT_MEASUREMENT /end OUT_MEASUREMENT /end FUNCTION
/begin FUNCTION uint32Touint8Array82 "" /begin SUB_FUNCTION Shift_Arithmetic39 Shift_Arithmetic40 Shift_Arithmetic41 /end SUB_FUNCTION /begin DEF_CHARACTERISTIC /end DEF_CHARACTERISTIC /begin IN_MEASUREMENT /end IN_MEASUREMENT /begin OUT_MEASUREMENT /end OUT_MEASUREMENT /end FUNCTION
/begin FUNCTION uint32Touint8Array83 "" /begin SUB_FUNCTION Shift_Arithmetic39 Shift_Arithmetic40 Shift_Arithmetic41 /end SUB_FUNCTION /begin DEF_CHARACTERISTIC /end DEF_CHARACTERISTIC /begin IN_MEASUREMENT /end IN_MEASUREMENT /begin OUT_MEASUREMENT /end OUT_MEASUREMENT /end FUNCTION
/begin FUNCTION uint32Touint8Array84 "" /begin SUB_FUNCTION Shift_Arithmetic39 Shift_Arithmetic40 Shift_Arithmetic41 /end SUB_FUNCTION /begin DEF_CHARACTERISTIC /end DEF_CHARACTERISTIC /begin IN_MEASUREMENT /end IN_MEASUREMENT /begin OUT_MEASUREMENT /end OUT_MEASUREMENT /end FUNCTION
/begin FUNCTION uint32Touint8Array85 "" /begin SUB_FUNCTION Shift_Arithmetic39 Shift_Arithmetic40 Shift_Arithmetic41 /end SUB_FUNCTION /begin DEF_CHARACTERISTIC /end DEF_CHARACTERISTIC /begin IN_MEASUREMENT /end IN_MEASUREMENT /begin OUT_MEASUREMENT /end OUT_MEASUREMENT /end FUNCTION
/begin FUNCTION uint32Touint8Array86 "" /begin SUB_FUNCTION Shift_Arithmetic39 Shift_Arithmetic40 Shift_Arithmetic41 /end SUB_FUNCTION /begin DEF_CHARACTERISTIC /end DEF_CHARACTERISTIC /begin IN_MEASUREMENT /end IN_MEASUREMENT /begin OUT_MEASUREMENT /end OUT_MEASUREMENT /end FUNCTION
/begin FUNCTION uint32Touint8Array9 ""
 /begin SUB_FUNCTION Shift_Arithmetic39 Shift_Arithmetic40 Shift_Arithmetic41 Data_Type_Conversion1 Data_Type_Conversion3 Data_Type_Conversion4 Data_Type_Conversion5 /end SUB_FUNCTION
 /begin DEF_CHARACTERISTIC /end DEF_CHARACTERISTIC
 /begin IN_MEASUREMENT /end IN_MEASUREMENT
 /begin OUT_MEASUREMENT /end OUT_MEASUREMENT
/end FUNCTION
/begin FUNCTION Shift_Arithmetic37 "" /begin DEF_CHARACTERISTIC /end DEF_CHARACTERISTIC /begin IN_MEASUREMENT /end IN_MEASUREMENT /begin OUT_MEASUREMENT /end OUT_MEASUREMENT /end FUNCTION
/begin FUNCTION Shift_Arithmetic38 "" /begin DEF_CHARACTERISTIC /end DEF_CHARACTERISTIC /begin IN_MEASUREMENT /end IN_MEASUREMENT /begin OUT_MEASUREMENT /end OUT_MEASUREMENT /end FUNCTION
/begin FUNCTION Shift_Arithmetic39 "" /begin DEF_CHARACTERISTIC /end DEF_CHARACTERISTIC /begin IN_MEASUREMENT /end IN_MEASUREMENT /begin OUT_MEASUREMENT /end OUT_MEASUREMENT /end FUNCTION
/begin FUNCTION Shift_Arithmetic40 "" /begin DEF_CHARACTERISTIC /end DEF_CHARACTERISTIC /begin IN_MEASUREMENT /end IN_MEASUREMENT /begin OUT_MEASUREMENT /end OUT_MEASUREMENT /end FUNCTION
/begin FUNCTION Shift_Arithmetic41 "" /begin DEF_CHARACTERISTIC /end DEF_CHARACTERISTIC /begin IN_MEASUREMENT /end IN_MEASUREMENT /begin OUT_MEASUREMENT /end OUT_MEASUREMENT /end FUNCTION
/begin FUNCTION Shift_Arithmetic42 "" /begin DEF_CHARACTERISTIC /end DEF_CHARACTERISTIC /begin IN_MEASUREMENT /end IN_MEASUREMENT /begin OUT_MEASUREMENT /end OUT_MEASUREMENT /end FUNCTION
/begin FUNCTION Constant "" /begin DEF_CHARACTERISTIC /end DEF_CHARACTERISTIC /begin IN_MEASUREMENT /end IN_MEASUREMENT /begin OUT_MEASUREMENT /end OUT_MEASUREMENT /end FUNCTION
/begin FUNCTION Constant1 "" /begin DEF_CHARACTERISTIC /end DEF_CHARACTERISTIC /begin IN_MEASUREMENT /end IN_MEASUREMENT /begin OUT_MEASUREMENT /end OUT_MEASUREMENT /end FUNCTION
/begin FUNCTION Constant10 "" /begin DEF_CHARACTERISTIC /end DEF_CHARACTERISTIC /begin IN_MEASUREMENT /end IN_MEASUREMENT /begin OUT_MEASUREMENT /end OUT_MEASUREMENT /end FUNCTION
/begin FUNCTION Constant11 "" /begin DEF_CHARACTERISTIC /end DEF_CHARACTERISTIC /begin IN_MEASUREMENT /end IN_MEASUREMENT /begin OUT_MEASUREMENT /end OUT_MEASUREMENT /end FUNCTION
/begin FUNCTION Constant12 "" /begin DEF_CHARACTERISTIC /end DEF_CHARACTERISTIC /begin IN_MEASUREMENT /end IN_MEASUREMENT /begin OUT_MEASUREMENT /end OUT_MEASUREMENT /end FUNCTION
/begin FUNCTION Constant13 "" /begin DEF_CHARACTERISTIC /end DEF_CHARACTERISTIC /begin IN_MEASUREMENT /end IN_MEASUREMENT /begin OUT_MEASUREMENT /end OUT_MEASUREMENT /end FUNCTION
/begin FUNCTION Constant14 "" /begin DEF_CHARACTERISTIC /end DEF_CHARACTERISTIC /begin IN_MEASUREMENT /end IN_MEASUREMENT /begin OUT_MEASUREMENT /end OUT_MEASUREMENT /end FUNCTION
/begin FUNCTION Constant15 "" /begin DEF_CHARACTERISTIC /end DEF_CHARACTERISTIC /begin IN_MEASUREMENT /end IN_MEASUREMENT /begin OUT_MEASUREMENT /end OUT_MEASUREMENT /end FUNCTION
/begin FUNCTION Constant16 "" /begin DEF_CHARACTERISTIC /end DEF_CHARACTERISTIC /begin IN_MEASUREMENT /end IN_MEASUREMENT /begin OUT_MEASUREMENT /end OUT_MEASUREMENT /end FUNCTION
/begin FUNCTION Constant2 "" /begin DEF_CHARACTERISTIC /end DEF_CHARACTERISTIC /begin IN_MEASUREMENT /end IN_MEASUREMENT /begin OUT_MEASUREMENT /end OUT_MEASUREMENT /end FUNCTION
/begin FUNCTION Constant3 "" /begin DEF_CHARACTERISTIC /end DEF_CHARACTERISTIC /begin IN_MEASUREMENT /end IN_MEASUREMENT /begin OUT_MEASUREMENT /end OUT_MEASUREMENT /end FUNCTION
/begin FUNCTION Constant4 "" /begin DEF_CHARACTERISTIC /end DEF_CHARACTERISTIC /begin IN_MEASUREMENT /end IN_MEASUREMENT /begin OUT_MEASUREMENT /end OUT_MEASUREMENT /end FUNCTION
/begin FUNCTION Constant5 "" /begin DEF_CHARACTERISTIC /end DEF_CHARACTERISTIC /begin IN_MEASUREMENT /end IN_MEASUREMENT /begin OUT_MEASUREMENT /end OUT_MEASUREMENT /end FUNCTION
/begin FUNCTION Constant6 "" /begin DEF_CHARACTERISTIC /end DEF_CHARACTERISTIC /begin IN_MEASUREMENT /end IN_MEASUREMENT /begin OUT_MEASUREMENT /end OUT_MEASUREMENT /end FUNCTION
/begin FUNCTION Constant7 "" /begin DEF_CHARACTERISTIC /end DEF_CHARACTERISTIC /begin IN_MEASUREMENT /end IN_MEASUREMENT /begin OUT_MEASUREMENT /end OUT_MEASUREMENT /end FUNCTION
/begin FUNCTION Constant8 "" /begin DEF_CHARACTERISTIC /end DEF_CHARACTERISTIC /begin IN_MEASUREMENT /end IN_MEASUREMENT /begin OUT_MEASUREMENT /end OUT_MEASUREMENT /end FUNCTION
/begin FUNCTION Constant9 "" /begin DEF_CHARACTERISTIC /end DEF_CHARACTERISTIC /begin IN_MEASUREMENT /end IN_MEASUREMENT /begin OUT_MEASUREMENT /end OUT_MEASUREMENT /end FUNCTION
/begin FUNCTION Data_Type_Conversion "" /begin DEF_CHARACTERISTIC /end DEF_CHARACTERISTIC /begin IN_MEASUREMENT /end IN_MEASUREMENT /begin OUT_MEASUREMENT /end OUT_MEASUREMENT /end FUNCTION
/begin FUNCTION Data_Type_Conversion1 "" /begin DEF_CHARACTERISTIC /end DEF_CHARACTERISTIC /begin IN_MEASUREMENT /end IN_MEASUREMENT /begin OUT_MEASUREMENT /end OUT_MEASUREMENT /end FUNCTION
/begin FUNCTION Data_Type_Conversion10 "" /begin DEF_CHARACTERISTIC /end DEF_CHARACTERISTIC /begin IN_MEASUREMENT /end IN_MEASUREMENT /begin OUT_MEASUREMENT /end OUT_MEASUREMENT /end FUNCTION
/begin FUNCTION Data_Type_Conversion11 "" /begin DEF_CHARACTERISTIC /end DEF_CHARACTERISTIC /begin IN_MEASUREMENT /end IN_MEASUREMENT /begin OUT_MEASUREMENT /end OUT_MEASUREMENT /end FUNCTION
/begin FUNCTION Data_Type_Conversion12 "" /begin DEF_CHARACTERISTIC /end DEF_CHARACTERISTIC /begin IN_MEASUREMENT /end IN_MEASUREMENT /begin OUT_MEASUREMENT /end OUT_MEASUREMENT /end FUNCTION
/begin FUNCTION Data_Type_Conversion13 "" /begin DEF_CHARACTERISTIC /end DEF_CHARACTERISTIC /begin IN_MEASUREMENT /end IN_MEASUREMENT /begin OUT_MEASUREMENT /end OUT_MEASUREMENT /end FUNCTION
/begin FUNCTION Data_Type_Conversion14 "" /begin DEF_CHARACTERISTIC /end DEF_CHARACTERISTIC /begin IN_MEASUREMENT /end IN_MEASUREMENT /begin OUT_MEASUREMENT /end OUT_MEASUREMENT /end FUNCTION
/begin FUNCTION Data_Type_Conversion15 "" /begin DEF_CHARACTERISTIC /end DEF_CHARACTERISTIC /begin IN_MEASUREMENT /end IN_MEASUREMENT /begin OUT_MEASUREMENT /end OUT_MEASUREMENT /end FUNCTION
/begin FUNCTION Data_Type_Conversion16 "" /begin DEF_CHARACTERISTIC /end DEF_CHARACTERISTIC /begin IN_MEASUREMENT /end IN_MEASUREMENT /begin OUT_MEASUREMENT /end OUT_MEASUREMENT /end FUNCTION
/begin FUNCTION Data_Type_Conversion168 "" /begin DEF_CHARACTERISTIC /end DEF_CHARACTERISTIC /begin IN_MEASUREMENT /end IN_MEASUREMENT /begin OUT_MEASUREMENT /end OUT_MEASUREMENT /end FUNCTION
/begin FUNCTION Data_Type_Conversion169 "" /begin DEF_CHARACTERISTIC /end DEF_CHARACTERISTIC /begin IN_MEASUREMENT /end IN_MEASUREMENT /begin OUT_MEASUREMENT /end OUT_MEASUREMENT /end FUNCTION
/begin FUNCTION Data_Type_Conversion17 "" /begin DEF_CHARACTERISTIC /end DEF_CHARACTERISTIC /begin IN_MEASUREMENT /end IN_MEASUREMENT /begin OUT_MEASUREMENT /end OUT_MEASUREMENT /end FUNCTION
/begin FUNCTION Data_Type_Conversion170 "" /begin DEF_CHARACTERISTIC /end DEF_CHARACTERISTIC /begin IN_MEASUREMENT /end IN_MEASUREMENT /begin OUT_MEASUREMENT /end OUT_MEASUREMENT /end FUNCTION
/begin FUNCTION Data_Type_Conversion171 "" /begin DEF_CHARACTERISTIC /end DEF_CHARACTERISTIC /begin IN_MEASUREMENT /end IN_MEASUREMENT /begin OUT_MEASUREMENT /end OUT_MEASUREMENT /end FUNCTION
/begin FUNCTION Data_Type_Conversion172 "" /begin DEF_CHARACTERISTIC /end DEF_CHARACTERISTIC /begin IN_MEASUREMENT /end IN_MEASUREMENT /begin OUT_MEASUREMENT /end OUT_MEASUREMENT /end FUNCTION
/begin FUNCTION Data_Type_Conversion174 "" /begin DEF_CHARACTERISTIC /end DEF_CHARACTERISTIC /begin IN_MEASUREMENT /end IN_MEASUREMENT /begin OUT_MEASUREMENT /end OUT_MEASUREMENT /end FUNCTION
/begin FUNCTION Data_Type_Conversion175 "" /begin DEF_CHARACTERISTIC /end DEF_CHARACTERISTIC /begin IN_MEASUREMENT /end IN_MEASUREMENT /begin OUT_MEASUREMENT /end OUT_MEASUREMENT /end FUNCTION
/begin FUNCTION Data_Type_Conversion176 "" /begin DEF_CHARACTERISTIC /end DEF_CHARACTERISTIC /begin IN_MEASUREMENT /end IN_MEASUREMENT /begin OUT_MEASUREMENT /end OUT_MEASUREMENT /end FUNCTION
/begin FUNCTION Data_Type_Conversion177 "" /begin DEF_CHARACTERISTIC /end DEF_CHARACTERISTIC /begin IN_MEASUREMENT /end IN_MEASUREMENT /begin OUT_MEASUREMENT /end OUT_MEASUREMENT /end FUNCTION
/begin FUNCTION Data_Type_Conversion179 "" /begin DEF_CHARACTERISTIC /end DEF_CHARACTERISTIC /begin IN_MEASUREMENT /end IN_MEASUREMENT /begin OUT_MEASUREMENT /end OUT_MEASUREMENT /end FUNCTION
/begin FUNCTION Data_Type_Conversion18 "" /begin DEF_CHARACTERISTIC /end DEF_CHARACTERISTIC /begin IN_MEASUREMENT /end IN_MEASUREMENT /begin OUT_MEASUREMENT /end OUT_MEASUREMENT /end FUNCTION
/begin FUNCTION Data_Type_Conversion19 "" /begin DEF_CHARACTERISTIC /end DEF_CHARACTERISTIC /begin IN_MEASUREMENT /end IN_MEASUREMENT /begin OUT_MEASUREMENT /end OUT_MEASUREMENT /end FUNCTION
/begin FUNCTION Data_Type_Conversion2 "" /begin DEF_CHARACTERISTIC /end DEF_CHARACTERISTIC /begin IN_MEASUREMENT /end IN_MEASUREMENT /begin OUT_MEASUREMENT /end OUT_MEASUREMENT /end FUNCTION
/begin FUNCTION Data_Type_Conversion20 "" /begin DEF_CHARACTERISTIC /end DEF_CHARACTERISTIC /begin IN_MEASUREMENT /end IN_MEASUREMENT /begin OUT_MEASUREMENT /end OUT_MEASUREMENT /end FUNCTION
/begin FUNCTION Data_Type_Conversion21 "" /begin DEF_CHARACTERISTIC /end DEF_CHARACTERISTIC /begin IN_MEASUREMENT /end IN_MEASUREMENT /begin OUT_MEASUREMENT /end OUT_MEASUREMENT /end FUNCTION
/begin FUNCTION Data_Type_Conversion22 "" /begin DEF_CHARACTERISTIC /end DEF_CHARACTERISTIC /begin IN_MEASUREMENT /end IN_MEASUREMENT /begin OUT_MEASUREMENT /end OUT_MEASUREMENT /end FUNCTION
/begin FUNCTION Data_Type_Conversion23 "" /begin DEF_CHARACTERISTIC /end DEF_CHARACTERISTIC /begin IN_MEASUREMENT /end IN_MEASUREMENT /begin OUT_MEASUREMENT /end OUT_MEASUREMENT /end FUNCTION
/begin FUNCTION Data_Type_Conversion25 "" /begin DEF_CHARACTERISTIC /end DEF_CHARACTERISTIC /begin IN_MEASUREMENT /end IN_MEASUREMENT /begin OUT_MEASUREMENT /end OUT_MEASUREMENT /end FUNCTION
/begin FUNCTION Data_Type_Conversion27 "" /begin DEF_CHARACTERISTIC /end DEF_CHARACTERISTIC /begin IN_MEASUREMENT /end IN_MEASUREMENT /begin OUT_MEASUREMENT /end OUT_MEASUREMENT /end FUNCTION
/begin FUNCTION Data_Type_Conversion29 "" /begin DEF_CHARACTERISTIC /end DEF_CHARACTERISTIC /begin IN_MEASUREMENT /end IN_MEASUREMENT /begin OUT_MEASUREMENT /end OUT_MEASUREMENT /end FUNCTION
/begin FUNCTION Data_Type_Conversion3 "" /begin DEF_CHARACTERISTIC /end DEF_CHARACTERISTIC /begin IN_MEASUREMENT /end IN_MEASUREMENT /begin OUT_MEASUREMENT /end OUT_MEASUREMENT /end FUNCTION
/begin FUNCTION Data_Type_Conversion33 "" /begin DEF_CHARACTERISTIC /end DEF_CHARACTERISTIC /begin IN_MEASUREMENT /end IN_MEASUREMENT /begin OUT_MEASUREMENT /end OUT_MEASUREMENT /end FUNCTION
/begin FUNCTION Data_Type_Conversion34 "" /begin DEF_CHARACTERISTIC /end DEF_CHARACTERISTIC /begin IN_MEASUREMENT /end IN_MEASUREMENT /begin OUT_MEASUREMENT /end OUT_MEASUREMENT /end FUNCTION
/begin FUNCTION Data_Type_Conversion35 "" /begin DEF_CHARACTERISTIC /end DEF_CHARACTERISTIC /begin IN_MEASUREMENT /end IN_MEASUREMENT /begin OUT_MEASUREMENT /end OUT_MEASUREMENT /end FUNCTION
/begin FUNCTION Data_Type_Conversion36 "" /begin DEF_CHARACTERISTIC /end DEF_CHARACTERISTIC /begin IN_MEASUREMENT /end IN_MEASUREMENT /begin OUT_MEASUREMENT /end OUT_MEASUREMENT /end FUNCTION
/begin FUNCTION Data_Type_Conversion4 "" /begin DEF_CHARACTERISTIC /end DEF_CHARACTERISTIC /begin IN_MEASUREMENT /end IN_MEASUREMENT /begin OUT_MEASUREMENT /end OUT_MEASUREMENT /end FUNCTION
/begin FUNCTION Data_Type_Conversion46 "" /begin DEF_CHARACTERISTIC /end DEF_CHARACTERISTIC /begin IN_MEASUREMENT /end IN_MEASUREMENT /begin OUT_MEASUREMENT /end OUT_MEASUREMENT /end FUNCTION
/begin FUNCTION Data_Type_Conversion47 "" /begin DEF_CHARACTERISTIC /end DEF_CHARACTERISTIC /begin IN_MEASUREMENT /end IN_MEASUREMENT /begin OUT_MEASUREMENT /end OUT_MEASUREMENT /end FUNCTION
/begin FUNCTION Data_Type_Conversion48 "" /begin DEF_CHARACTERISTIC /end DEF_CHARACTERISTIC /begin IN_MEASUREMENT /end IN_MEASUREMENT /begin OUT_MEASUREMENT /end OUT_MEASUREMENT /end FUNCTION
/begin FUNCTION Data_Type_Conversion49 "" /begin DEF_CHARACTERISTIC /end DEF_CHARACTERISTIC /begin IN_MEASUREMENT /end IN_MEASUREMENT /begin OUT_MEASUREMENT /end OUT_MEASUREMENT /end FUNCTION
/begin FUNCTION Data_Type_Conversion5 "" /begin DEF_CHARACTERISTIC /end DEF_CHARACTERISTIC /begin IN_MEASUREMENT /end IN_MEASUREMENT /begin OUT_MEASUREMENT /end OUT_MEASUREMENT /end FUNCTION
/begin FUNCTION Data_Type_Conversion50 "" /begin DEF_CHARACTERISTIC /end DEF_CHARACTERISTIC /begin IN_MEASUREMENT /end IN_MEASUREMENT /begin OUT_MEASUREMENT /end OUT_MEASUREMENT /end FUNCTION
/begin FUNCTION Data_Type_Conversion51 "" /begin DEF_CHARACTERISTIC /end DEF_CHARACTERISTIC /begin IN_MEASUREMENT /end IN_MEASUREMENT /begin OUT_MEASUREMENT /end OUT_MEASUREMENT /end FUNCTION
/begin FUNCTION Data_Type_Conversion52 "" /begin DEF_CHARACTERISTIC /end DEF_CHARACTERISTIC /begin IN_MEASUREMENT /end IN_MEASUREMENT /begin OUT_MEASUREMENT /end OUT_MEASUREMENT /end FUNCTION
/begin FUNCTION Data_Type_Conversion53 "" /begin DEF_CHARACTERISTIC /end DEF_CHARACTERISTIC /begin IN_MEASUREMENT /end IN_MEASUREMENT /begin OUT_MEASUREMENT /end OUT_MEASUREMENT /end FUNCTION
/begin FUNCTION Data_Type_Conversion54 "" /begin DEF_CHARACTERISTIC /end DEF_CHARACTERISTIC /begin IN_MEASUREMENT /end IN_MEASUREMENT /begin OUT_MEASUREMENT /end OUT_MEASUREMENT /end FUNCTION
/begin FUNCTION Data_Type_Conversion55 "" /begin DEF_CHARACTERISTIC /end DEF_CHARACTERISTIC /begin IN_MEASUREMENT /end IN_MEASUREMENT /begin OUT_MEASUREMENT /end OUT_MEASUREMENT /end FUNCTION
/begin FUNCTION Data_Type_Conversion56 "" /begin DEF_CHARACTERISTIC /end DEF_CHARACTERISTIC /begin IN_MEASUREMENT /end IN_MEASUREMENT /begin OUT_MEASUREMENT /end OUT_MEASUREMENT /end FUNCTION
/begin FUNCTION Data_Type_Conversion57 "" /begin DEF_CHARACTERISTIC /end DEF_CHARACTERISTIC /begin IN_MEASUREMENT /end IN_MEASUREMENT /begin OUT_MEASUREMENT /end OUT_MEASUREMENT /end FUNCTION
/begin FUNCTION Data_Type_Conversion58 "" /begin DEF_CHARACTERISTIC /end DEF_CHARACTERISTIC /begin IN_MEASUREMENT /end IN_MEASUREMENT /begin OUT_MEASUREMENT /end OUT_MEASUREMENT /end FUNCTION
/begin FUNCTION Data_Type_Conversion6 "" /begin DEF_CHARACTERISTIC /end DEF_CHARACTERISTIC /begin IN_MEASUREMENT /end IN_MEASUREMENT /begin OUT_MEASUREMENT /end OUT_MEASUREMENT /end FUNCTION
/begin FUNCTION Data_Type_Conversion7 "" /begin DEF_CHARACTERISTIC /end DEF_CHARACTERISTIC /begin IN_MEASUREMENT /end IN_MEASUREMENT /begin OUT_MEASUREMENT /end OUT_MEASUREMENT /end FUNCTION
/begin FUNCTION Data_Type_Conversion8 "" /begin DEF_CHARACTERISTIC /end DEF_CHARACTERISTIC /begin IN_MEASUREMENT /end IN_MEASUREMENT /begin OUT_MEASUREMENT /end OUT_MEASUREMENT /end FUNCTION
/begin FUNCTION Data_Type_Conversion9 "" /begin DEF_CHARACTERISTIC /end DEF_CHARACTERISTIC /begin IN_MEASUREMENT /end IN_MEASUREMENT /begin OUT_MEASUREMENT /end OUT_MEASUREMENT /end FUNCTION
/begin FUNCTION UnitConverter237 "" /begin DEF_CHARACTERISTIC /end DEF_CHARACTERISTIC /begin IN_MEASUREMENT /end IN_MEASUREMENT /begin OUT_MEASUREMENT /end OUT_MEASUREMENT /end FUNCTION
/begin FUNCTION UnitConverter239 "" /begin DEF_CHARACTERISTIC /end DEF_CHARACTERISTIC /begin IN_MEASUREMENT /end IN_MEASUREMENT /begin OUT_MEASUREMENT /end OUT_MEASUREMENT /end FUNCTION
/begin FUNCTION UnitConverter241 "" /begin DEF_CHARACTERISTIC /end DEF_CHARACTERISTIC /begin IN_MEASUREMENT /end IN_MEASUREMENT /begin OUT_MEASUREMENT /end OUT_MEASUREMENT /end FUNCTION
/begin FUNCTION UnitConverter242 "" /begin DEF_CHARACTERISTIC /end DEF_CHARACTERISTIC /begin IN_MEASUREMENT /end IN_MEASUREMENT /begin OUT_MEASUREMENT /end OUT_MEASUREMENT /end FUNCTION
/begin FUNCTION UnitConverter243 "" /begin DEF_CHARACTERISTIC /end DEF_CHARACTERISTIC /begin IN_MEASUREMENT /end IN_MEASUREMENT /begin OUT_MEASUREMENT /end OUT_MEASUREMENT /end FUNCTION
/begin FUNCTION UnitConverter244 "" /begin DEF_CHARACTERISTIC /end DEF_CHARACTERISTIC /begin IN_MEASUREMENT /end IN_MEASUREMENT /begin OUT_MEASUREMENT /end OUT_MEASUREMENT /end FUNCTION
/begin FUNCTION UnitConverter245 "" /begin DEF_CHARACTERISTIC /end DEF_CHARACTERISTIC /begin IN_MEASUREMENT /end IN_MEASUREMENT /begin OUT_MEASUREMENT /end OUT_MEASUREMENT /end FUNCTION
/begin FUNCTION UnitConverter246 "" /begin DEF_CHARACTERISTIC /end DEF_CHARACTERISTIC /begin IN_MEASUREMENT /end IN_MEASUREMENT /begin OUT_MEASUREMENT /end OUT_MEASUREMENT /end FUNCTION
/begin FUNCTION UnitConverter247 "" /begin DEF_CHARACTERISTIC /end DEF_CHARACTERISTIC /begin IN_MEASUREMENT /end IN_MEASUREMENT /begin OUT_MEASUREMENT /end OUT_MEASUREMENT /end FUNCTION
/begin FUNCTION UnitConverter248 "" /begin DEF_CHARACTERISTIC /end DEF_CHARACTERISTIC /begin IN_MEASUREMENT /end IN_MEASUREMENT /begin OUT_MEASUREMENT /end OUT_MEASUREMENT /end FUNCTION
/begin FUNCTION UnitConverter249 "" /begin DEF_CHARACTERISTIC /end DEF_CHARACTERISTIC /begin IN_MEASUREMENT /end IN_MEASUREMENT /begin OUT_MEASUREMENT /end OUT_MEASUREMENT /end FUNCTION
/begin FUNCTION UnitConverter251 "" /begin DEF_CHARACTERISTIC /end DEF_CHARACTERISTIC /begin IN_MEASUREMENT /end IN_MEASUREMENT /begin OUT_MEASUREMENT /end OUT_MEASUREMENT /end FUNCTION
/begin FUNCTION UnitConverter253 "" /begin DEF_CHARACTERISTIC /end DEF_CHARACTERISTIC /begin IN_MEASUREMENT /end IN_MEASUREMENT /begin OUT_MEASUREMENT /end OUT_MEASUREMENT /end FUNCTION
/begin FUNCTION UnitConverter255 "" /begin DEF_CHARACTERISTIC /end DEF_CHARACTERISTIC /begin IN_MEASUREMENT /end IN_MEASUREMENT /begin OUT_MEASUREMENT /end OUT_MEASUREMENT /end FUNCTION
/begin FUNCTION UnitConverter257 "" /begin DEF_CHARACTERISTIC /end DEF_CHARACTERISTIC /begin IN_MEASUREMENT /end IN_MEASUREMENT /begin OUT_MEASUREMENT /end OUT_MEASUREMENT /end FUNCTION
/begin FUNCTION UnitConverter258 "" /begin DEF_CHARACTERISTIC /end DEF_CHARACTERISTIC /begin IN_MEASUREMENT /end IN_MEASUREMENT /begin OUT_MEASUREMENT /end OUT_MEASUREMENT /end FUNCTION
/begin FUNCTION UnitConverter259 "" /begin DEF_CHARACTERISTIC /end DEF_CHARACTERISTIC /begin IN_MEASUREMENT /end IN_MEASUREMENT /begin OUT_MEASUREMENT /end OUT_MEASUREMENT /end FUNCTION
/begin FUNCTION UnitConverter260 "" /begin DEF_CHARACTERISTIC /end DEF_CHARACTERISTIC /begin IN_MEASUREMENT /end IN_MEASUREMENT /begin OUT_MEASUREMENT /end OUT_MEASUREMENT /end FUNCTION
/begin FUNCTION UnitConverter261 "" /begin DEF_CHARACTERISTIC /end DEF_CHARACTERISTIC /begin IN_MEASUREMENT /end IN_MEASUREMENT /begin OUT_MEASUREMENT /end OUT_MEASUREMENT /end FUNCTION
/begin FUNCTION UnitConverter262 "" /begin DEF_CHARACTERISTIC /end DEF_CHARACTERISTIC /begin IN_MEASUREMENT /end IN_MEASUREMENT /begin OUT_MEASUREMENT /end OUT_MEASUREMENT /end FUNCTION
/begin FUNCTION UnitConverter263 "" /begin DEF_CHARACTERISTIC /end DEF_CHARACTERISTIC /begin IN_MEASUREMENT /end IN_MEASUREMENT /begin OUT_MEASUREMENT /end OUT_MEASUREMENT /end FUNCTION
/begin FUNCTION UnitConverter264 "" /begin DEF_CHARACTERISTIC /end DEF_CHARACTERISTIC /begin IN_MEASUREMENT /end IN_MEASUREMENT /begin OUT_MEASUREMENT /end OUT_MEASUREMENT /end FUNCTION
/begin FUNCTION UnitConverter265 "" /begin DEF_CHARACTERISTIC /end DEF_CHARACTERISTIC /begin IN_MEASUREMENT /end IN_MEASUREMENT /begin OUT_MEASUREMENT /end OUT_MEASUREMENT /end FUNCTION
/begin FUNCTION UnitConverter266 "" /begin DEF_CHARACTERISTIC /end DEF_CHARACTERISTIC /begin IN_MEASUREMENT /end IN_MEASUREMENT /begin OUT_MEASUREMENT /end OUT_MEASUREMENT /end FUNCTION
/begin FUNCTION UnitConverter267 "" /begin DEF_CHARACTERISTIC /end DEF_CHARACTERISTIC /begin IN_MEASUREMENT /end IN_MEASUREMENT /begin OUT_MEASUREMENT /end OUT_MEASUREMENT /end FUNCTION
/begin FUNCTION UnitConverter268 "" /begin DEF_CHARACTERISTIC /end DEF_CHARACTERISTIC /begin IN_MEASUREMENT /end IN_MEASUREMENT /begin OUT_MEASUREMENT /end OUT_MEASUREMENT /end FUNCTION
/begin FUNCTION UnitConverter269 "" /begin DEF_CHARACTERISTIC /end DEF_CHARACTERISTIC /begin IN_MEASUREMENT /end IN_MEASUREMENT /begin OUT_MEASUREMENT /end OUT_MEASUREMENT /end FUNCTION
/begin FUNCTION UnitConverter270 "" /begin DEF_CHARACTERISTIC /end DEF_CHARACTERISTIC /begin IN_MEASUREMENT /end IN_MEASUREMENT /begin OUT_MEASUREMENT /end OUT_MEASUREMENT /end FUNCTION
/begin FUNCTION UnitConverter271 "" /begin DEF_CHARACTERISTIC /end DEF_CHARACTERISTIC /begin IN_MEASUREMENT /end IN_MEASUREMENT /begin OUT_MEASUREMENT /end OUT_MEASUREMENT /end FUNCTION
/begin FUNCTION UnitConverter272 "" /begin DEF_CHARACTERISTIC /end DEF_CHARACTERISTIC /begin IN_MEASUREMENT /end IN_MEASUREMENT /begin OUT_MEASUREMENT /end OUT_MEASUREMENT /end FUNCTION
/begin FUNCTION UnitConverter273 "" /begin DEF_CHARACTERISTIC /end DEF_CHARACTERISTIC /begin IN_MEASUREMENT /end IN_MEASUREMENT /begin OUT_MEASUREMENT /end OUT_MEASUREMENT /end FUNCTION
/begin FUNCTION UnitConverter274 "" /begin DEF_CHARACTERISTIC /end DEF_CHARACTERISTIC /begin IN_MEASUREMENT /end IN_MEASUREMENT /begin OUT_MEASUREMENT /end OUT_MEASUREMENT /end FUNCTION
/begin FUNCTION UnitConverter275 "" /begin DEF_CHARACTERISTIC /end DEF_CHARACTERISTIC /begin IN_MEASUREMENT /end IN_MEASUREMENT /begin OUT_MEASUREMENT /end OUT_MEASUREMENT /end FUNCTION
/begin FUNCTION UnitConverter276 "" /begin DEF_CHARACTERISTIC /end DEF_CHARACTERISTIC /begin IN_MEASUREMENT /end IN_MEASUREMENT /begin OUT_MEASUREMENT /end OUT_MEASUREMENT /end FUNCTION
/begin FUNCTION UnitConverter277 "" /begin DEF_CHARACTERISTIC /end DEF_CHARACTERISTIC /begin IN_MEASUREMENT /end IN_MEASUREMENT /begin OUT_MEASUREMENT /end OUT_MEASUREMENT /end FUNCTION
/begin FUNCTION UnitConverter278 "" /begin DEF_CHARACTERISTIC /end DEF_CHARACTERISTIC /begin IN_MEASUREMENT /end IN_MEASUREMENT /begin OUT_MEASUREMENT /end OUT_MEASUREMENT /end FUNCTION
/begin FUNCTION UnitConverter389 "" /begin DEF_CHARACTERISTIC /end DEF_CHARACTERISTIC /begin IN_MEASUREMENT /end IN_MEASUREMENT /begin OUT_MEASUREMENT /end OUT_MEASUREMENT /end FUNCTION
/begin FUNCTION UnitConverter390 "" /begin DEF_CHARACTERISTIC /end DEF_CHARACTERISTIC /begin IN_MEASUREMENT /end IN_MEASUREMENT /begin OUT_MEASUREMENT /end OUT_MEASUREMENT /end FUNCTION
/begin FUNCTION UnitConverter413 "" /begin DEF_CHARACTERISTIC /end DEF_CHARACTERISTIC /begin IN_MEASUREMENT /end IN_MEASUREMENT /begin OUT_MEASUREMENT /end OUT_MEASUREMENT /end FUNCTION
/begin FUNCTION UnitConverter414 "" /begin DEF_CHARACTERISTIC /end DEF_CHARACTERISTIC /begin IN_MEASUREMENT /end IN_MEASUREMENT /begin OUT_MEASUREMENT /end OUT_MEASUREMENT /end FUNCTION
/begin FUNCTION UnitConverter437 "" /begin DEF_CHARACTERISTIC /end DEF_CHARACTERISTIC /begin IN_MEASUREMENT /end IN_MEASUREMENT /begin OUT_MEASUREMENT /end OUT_MEASUREMENT /end FUNCTION
/begin FUNCTION UnitConverter438 "" /begin DEF_CHARACTERISTIC /end DEF_CHARACTERISTIC /begin IN_MEASUREMENT /end IN_MEASUREMENT /begin OUT_MEASUREMENT /end OUT_MEASUREMENT /end FUNCTION
/begin FUNCTION UnitConverter439 "" /begin DEF_CHARACTERISTIC /end DEF_CHARACTERISTIC /begin IN_MEASUREMENT /end IN_MEASUREMENT /begin OUT_MEASUREMENT /end OUT_MEASUREMENT /end FUNCTION
/begin FUNCTION UnitConverter440 "" /begin DEF_CHARACTERISTIC /end DEF_CHARACTERISTIC /begin IN_MEASUREMENT /end IN_MEASUREMENT /begin OUT_MEASUREMENT /end OUT_MEASUREMENT /end FUNCTION
/begin FUNCTION UnitConverter441 "" /begin DEF_CHARACTERISTIC /end DEF_CHARACTERISTIC /begin IN_MEASUREMENT /end IN_MEASUREMENT /begin OUT_MEASUREMENT /end OUT_MEASUREMENT /end FUNCTION
/begin FUNCTION UnitConverter442 "" /begin DEF_CHARACTERISTIC /end DEF_CHARACTERISTIC /begin IN_MEASUREMENT /end IN_MEASUREMENT /begin OUT_MEASUREMENT /end OUT_MEASUREMENT /end FUNCTION
/begin FUNCTION UnitConverter443 "" /begin DEF_CHARACTERISTIC /end DEF_CHARACTERISTIC /begin IN_MEASUREMENT /end IN_MEASUREMENT /begin OUT_MEASUREMENT /end OUT_MEASUREMENT /end FUNCTION
/begin FUNCTION UnitConverter444 "" /begin DEF_CHARACTERISTIC /end DEF_CHARACTERISTIC /begin IN_MEASUREMENT /end IN_MEASUREMENT /begin OUT_MEASUREMENT /end OUT_MEASUREMENT /end FUNCTION
/begin FUNCTION UnitConverter445 "" /begin DEF_CHARACTERISTIC /end DEF_CHARACTERISTIC /begin IN_MEASUREMENT /end IN_MEASUREMENT /begin OUT_MEASUREMENT /end OUT_MEASUREMENT /end FUNCTION
/begin FUNCTION UnitConverter446 "" /begin DEF_CHARACTERISTIC /end DEF_CHARACTERISTIC /begin IN_MEASUREMENT /end IN_MEASUREMENT /begin OUT_MEASUREMENT /end OUT_MEASUREMENT /end FUNCTION
/begin FUNCTION UnitConverter447 "" /begin DEF_CHARACTERISTIC /end DEF_CHARACTERISTIC /begin IN_MEASUREMENT /end IN_MEASUREMENT /begin OUT_MEASUREMENT /end OUT_MEASUREMENT /end FUNCTION
/begin FUNCTION UnitConverter448 "" /begin DEF_CHARACTERISTIC /end DEF_CHARACTERISTIC /begin IN_MEASUREMENT /end IN_MEASUREMENT /begin OUT_MEASUREMENT /end OUT_MEASUREMENT /end FUNCTION
/begin FUNCTION UnitConverter449 "" /begin DEF_CHARACTERISTIC /end DEF_CHARACTERISTIC /begin IN_MEASUREMENT /end IN_MEASUREMENT /begin OUT_MEASUREMENT /end OUT_MEASUREMENT /end FUNCTION
/begin FUNCTION UnitConverter450 "" /begin DEF_CHARACTERISTIC /end DEF_CHARACTERISTIC /begin IN_MEASUREMENT /end IN_MEASUREMENT /begin OUT_MEASUREMENT /end OUT_MEASUREMENT /end FUNCTION
/begin FUNCTION UnitConverter451 "" /begin DEF_CHARACTERISTIC /end DEF_CHARACTERISTIC /begin IN_MEASUREMENT /end IN_MEASUREMENT /begin OUT_MEASUREMENT /end OUT_MEASUREMENT /end FUNCTION
/begin FUNCTION Multiply1 "" /begin DEF_CHARACTERISTIC /end DEF_CHARACTERISTIC /begin IN_MEASUREMENT /end IN_MEASUREMENT /begin OUT_MEASUREMENT /end OUT_MEASUREMENT /end FUNCTION
/begin FUNCTION Multiply2 "" /begin DEF_CHARACTERISTIC /end DEF_CHARACTERISTIC /begin IN_MEASUREMENT /end IN_MEASUREMENT /begin OUT_MEASUREMENT /end OUT_MEASUREMENT /end FUNCTION
/begin FUNCTION Logical_Operator1 "" /begin DEF_CHARACTERISTIC /end DEF_CHARACTERISTIC /begin IN_MEASUREMENT /end IN_MEASUREMENT /begin OUT_MEASUREMENT /end OUT_MEASUREMENT /end FUNCTION
/begin FUNCTION Switch "" /begin DEF_CHARACTERISTIC /end DEF_CHARACTERISTIC /begin IN_MEASUREMENT /end IN_MEASUREMENT /begin OUT_MEASUREMENT /end OUT_MEASUREMENT /end FUNCTION
/begin FUNCTION Switch1 "" /begin DEF_CHARACTERISTIC /end DEF_CHARACTERISTIC /begin IN_MEASUREMENT /end IN_MEASUREMENT /begin OUT_MEASUREMENT /end OUT_MEASUREMENT /end FUNCTION
/begin FUNCTION DTCHeader ""
 /begin SUB_FUNCTION Bit_Shift1 Bit_Shift10 Bit_Shift11 Bit_Shift12 Bit_Shift13 Bit_Shift14 Bit_Shift15 Bit_Shift16 Bit_Shift17 Bit_Shift18 Bit_Shift19 Bit_Shift2 Bit_Shift20 Bit_Shift21 Bit_Shift22 Bit_Shift23 Bit_Shift24 Bit_Shift27 Bit_Shift28 Bit_Shift29 Bit_Shift3 Bit_Shift30 Bit_Shift31 Bit_Shift32 Bit_Shift33 Bit_Shift34 Bit_Shift4 Bit_Shift5 Bit_Shift6 Bit_Shift7 Bit_Shift8 Bit_Shift9 Data_Type_Conversion1 Data_Type_Conversion10 Data_Type_Conversion11 Data_Type_Conversion12 Data_Type_Conversion13 Data_Type_Conversion14 Data_Type_Conversion15 Data_Type_Conversion16 Data_Type_Conversion17 Data_Type_Conversion18 Data_Type_Conversion19 Data_Type_Conversion2 Data_Type_Conversion20 Data_Type_Conversion21 Data_Type_Conversion22 Data_Type_Conversion23 Data_Type_Conversion24 Data_Type_Conversion3 Data_Type_Conversion36 Data_Type_Conversion37 Data_Type_Conversion38 Data_Type_Conversion39 Data_Type_Conversion4 Data_Type_Conversion40 Data_Type_Conversion41 Data_Type_Conversion42 Data_Type_Conversion43 Data_Type_Conversion5 Data_Type_Conversion6 Data_Type_Conversion7 Data_Type_Conversion8 Data_Type_Conversion9 /end SUB_FUNCTION
 /begin DEF_CHARACTERISTIC /end DEF_CHARACTERISTIC
 /begin IN_MEASUREMENT /end IN_MEASUREMENT
 /begin OUT_MEASUREMENT /end OUT_MEASUREMENT
/end FUNCTION
/begin FUNCTION DTCHeader1 ""
 /begin SUB_FUNCTION Bit_Shift1 Bit_Shift10 Bit_Shift11 Bit_Shift12 Bit_Shift13 Bit_Shift14 Bit_Shift15 Bit_Shift16 Bit_Shift17 Bit_Shift18 Bit_Shift19 Bit_Shift2 Bit_Shift20 Bit_Shift21 Bit_Shift22 Bit_Shift23 Bit_Shift24 Bit_Shift27 Bit_Shift28 Bit_Shift29 Bit_Shift3 Bit_Shift30 Bit_Shift31 Bit_Shift32 Bit_Shift33 Bit_Shift34 Bit_Shift4 Bit_Shift5 Bit_Shift6 Bit_Shift7 Bit_Shift8 Bit_Shift9 Data_Type_Conversion1 Data_Type_Conversion10 Data_Type_Conversion11 Data_Type_Conversion12 Data_Type_Conversion13 Data_Type_Conversion14 Data_Type_Conversion15 Data_Type_Conversion16 Data_Type_Conversion17 Data_Type_Conversion18 Data_Type_Conversion19 Data_Type_Conversion2 Data_Type_Conversion20 Data_Type_Conversion21 Data_Type_Conversion22 Data_Type_Conversion23 Data_Type_Conversion24 Data_Type_Conversion3 Data_Type_Conversion36 Data_Type_Conversion37 Data_Type_Conversion38 Data_Type_Conversion39 Data_Type_Conversion4 Data_Type_Conversion40 Data_Type_Conversion41 Data_Type_Conversion42 Data_Type_Conversion43 Data_Type_Conversion5 Data_Type_Conversion6 Data_Type_Conversion7 Data_Type_Conversion8 Data_Type_Conversion9 /end SUB_FUNCTION
 /begin DEF_CHARACTERISTIC /end DEF_CHARACTERISTIC
 /begin IN_MEASUREMENT /end IN_MEASUREMENT
 /begin OUT_MEASUREMENT /end OUT_MEASUREMENT
/end FUNCTION
/begin FUNCTION DTCHeader2 ""
 /begin SUB_FUNCTION Bit_Shift1 Bit_Shift10 Bit_Shift11 Bit_Shift12 Bit_Shift13 Bit_Shift14 Bit_Shift15 Bit_Shift16 Bit_Shift17 Bit_Shift18 Bit_Shift19 Bit_Shift2 Bit_Shift20 Bit_Shift21 Bit_Shift22 Bit_Shift23 Bit_Shift24 Bit_Shift27 Bit_Shift28 Bit_Shift29 Bit_Shift3 Bit_Shift30 Bit_Shift31 Bit_Shift32 Bit_Shift33 Bit_Shift34 Bit_Shift4 Bit_Shift5 Bit_Shift6 Bit_Shift7 Bit_Shift8 Bit_Shift9 Data_Type_Conversion1 Data_Type_Conversion10 Data_Type_Conversion11 Data_Type_Conversion12 Data_Type_Conversion13 Data_Type_Conversion14 Data_Type_Conversion15 Data_Type_Conversion16 Data_Type_Conversion17 Data_Type_Conversion18 Data_Type_Conversion19 Data_Type_Conversion2 Data_Type_Conversion20 Data_Type_Conversion21 Data_Type_Conversion22 Data_Type_Conversion23 Data_Type_Conversion24 Data_Type_Conversion3 Data_Type_Conversion36 Data_Type_Conversion37 Data_Type_Conversion38 Data_Type_Conversion39 Data_Type_Conversion4 Data_Type_Conversion40 Data_Type_Conversion41 Data_Type_Conversion42 Data_Type_Conversion43 Data_Type_Conversion5 Data_Type_Conversion6 Data_Type_Conversion7 Data_Type_Conversion8 Data_Type_Conversion9 /end SUB_FUNCTION
 /begin DEF_CHARACTERISTIC /end DEF_CHARACTERISTIC
 /begin IN_MEASUREMENT /end IN_MEASUREMENT
 /begin OUT_MEASUREMENT /end OUT_MEASUREMENT
/end FUNCTION
/begin FUNCTION DTCHeader3 ""
 /begin SUB_FUNCTION Bit_Shift1 Bit_Shift10 Bit_Shift11 Bit_Shift12 Bit_Shift13 Bit_Shift14 Bit_Shift15 Bit_Shift16 Bit_Shift17 Bit_Shift18 Bit_Shift19 Bit_Shift2 Bit_Shift20 Bit_Shift21 Bit_Shift22 Bit_Shift23 Bit_Shift24 Bit_Shift27 Bit_Shift28 Bit_Shift29 Bit_Shift3 Bit_Shift30 Bit_Shift31 Bit_Shift32 Bit_Shift33 Bit_Shift34 Bit_Shift4 Bit_Shift5 Bit_Shift6 Bit_Shift7 Bit_Shift8 Bit_Shift9 Data_Type_Conversion1 Data_Type_Conversion10 Data_Type_Conversion11 Data_Type_Conversion12 Data_Type_Conversion13 Data_Type_Conversion14 Data_Type_Conversion15 Data_Type_Conversion16 Data_Type_Conversion17 Data_Type_Conversion18 Data_Type_Conversion19 Data_Type_Conversion2 Data_Type_Conversion20 Data_Type_Conversion21 Data_Type_Conversion22 Data_Type_Conversion23 Data_Type_Conversion24 Data_Type_Conversion3 Data_Type_Conversion36 Data_Type_Conversion37 Data_Type_Conversion38 Data_Type_Conversion39 Data_Type_Conversion4 Data_Type_Conversion40 Data_Type_Conversion41 Data_Type_Conversion42 Data_Type_Conversion43 Data_Type_Conversion5 Data_Type_Conversion6 Data_Type_Conversion7 Data_Type_Conversion8 Data_Type_Conversion9 /end SUB_FUNCTION
 /begin DEF_CHARACTERISTIC /end DEF_CHARACTERISTIC
 /begin IN_MEASUREMENT /end IN_MEASUREMENT
 /begin OUT_MEASUREMENT /end OUT_MEASUREMENT
/end FUNCTION
/begin FUNCTION DTCHeader4 ""
 /begin SUB_FUNCTION Bit_Shift1 Bit_Shift10 Bit_Shift11 Bit_Shift12 Bit_Shift13 Bit_Shift14 Bit_Shift15 Bit_Shift16 Bit_Shift17 Bit_Shift18 Bit_Shift19 Bit_Shift2 Bit_Shift20 Bit_Shift21 Bit_Shift22 Bit_Shift23 Bit_Shift24 Bit_Shift27 Bit_Shift28 Bit_Shift29 Bit_Shift3 Bit_Shift30 Bit_Shift31 Bit_Shift32 Bit_Shift33 Bit_Shift34 Bit_Shift4 Bit_Shift5 Bit_Shift6 Bit_Shift7 Bit_Shift8 Bit_Shift9 Data_Type_Conversion1 Data_Type_Conversion10 Data_Type_Conversion11 Data_Type_Conversion12 Data_Type_Conversion13 Data_Type_Conversion14 Data_Type_Conversion15 Data_Type_Conversion16 Data_Type_Conversion17 Data_Type_Conversion18 Data_Type_Conversion19 Data_Type_Conversion2 Data_Type_Conversion20 Data_Type_Conversion21 Data_Type_Conversion22 Data_Type_Conversion23 Data_Type_Conversion24 Data_Type_Conversion3 Data_Type_Conversion36 Data_Type_Conversion37 Data_Type_Conversion38 Data_Type_Conversion39 Data_Type_Conversion4 Data_Type_Conversion40 Data_Type_Conversion41 Data_Type_Conversion42 Data_Type_Conversion43 Data_Type_Conversion5 Data_Type_Conversion6 Data_Type_Conversion7 Data_Type_Conversion8 Data_Type_Conversion9 /end SUB_FUNCTION
 /begin DEF_CHARACTERISTIC /end DEF_CHARACTERISTIC
 /begin IN_MEASUREMENT /end IN_MEASUREMENT
 /begin OUT_MEASUREMENT /end OUT_MEASUREMENT
/end FUNCTION
/begin FUNCTION DTCHeader5 ""
 /begin SUB_FUNCTION Bit_Shift1 Bit_Shift10 Bit_Shift11 Bit_Shift12 Bit_Shift13 Bit_Shift14 Bit_Shift15 Bit_Shift16 Bit_Shift17 Bit_Shift18 Bit_Shift19 Bit_Shift2 Bit_Shift20 Bit_Shift21 Bit_Shift22 Bit_Shift23 Bit_Shift24 Bit_Shift27 Bit_Shift28 Bit_Shift29 Bit_Shift3 Bit_Shift30 Bit_Shift31 Bit_Shift32 Bit_Shift33 Bit_Shift34 Bit_Shift4 Bit_Shift5 Bit_Shift6 Bit_Shift7 Bit_Shift8 Bit_Shift9 Data_Type_Conversion1 Data_Type_Conversion10 Data_Type_Conversion11 Data_Type_Conversion12 Data_Type_Conversion13 Data_Type_Conversion14 Data_Type_Conversion15 Data_Type_Conversion16 Data_Type_Conversion17 Data_Type_Conversion18 Data_Type_Conversion19 Data_Type_Conversion2 Data_Type_Conversion20 Data_Type_Conversion21 Data_Type_Conversion22 Data_Type_Conversion23 Data_Type_Conversion24 Data_Type_Conversion3 Data_Type_Conversion36 Data_Type_Conversion37 Data_Type_Conversion38 Data_Type_Conversion39 Data_Type_Conversion4 Data_Type_Conversion40 Data_Type_Conversion41 Data_Type_Conversion42 Data_Type_Conversion43 Data_Type_Conversion5 Data_Type_Conversion6 Data_Type_Conversion7 Data_Type_Conversion8 Data_Type_Conversion9 /end SUB_FUNCTION
 /begin DEF_CHARACTERISTIC /end DEF_CHARACTERISTIC
 /begin IN_MEASUREMENT /end IN_MEASUREMENT
 /begin OUT_MEASUREMENT /end OUT_MEASUREMENT
/end FUNCTION
/begin FUNCTION DTCHeader6 ""
 /begin SUB_FUNCTION Bit_Shift1 Bit_Shift10 Bit_Shift11 Bit_Shift12 Bit_Shift13 Bit_Shift14 Bit_Shift15 Bit_Shift16 Bit_Shift17 Bit_Shift18 Bit_Shift19 Bit_Shift2 Bit_Shift20 Bit_Shift21 Bit_Shift22 Bit_Shift23 Bit_Shift24 Bit_Shift27 Bit_Shift28 Bit_Shift29 Bit_Shift3 Bit_Shift30 Bit_Shift31 Bit_Shift32 Bit_Shift33 Bit_Shift34 Bit_Shift4 Bit_Shift5 Bit_Shift6 Bit_Shift7 Bit_Shift8 Bit_Shift9 Data_Type_Conversion1 Data_Type_Conversion10 Data_Type_Conversion11 Data_Type_Conversion12 Data_Type_Conversion13 Data_Type_Conversion14 Data_Type_Conversion15 Data_Type_Conversion16 Data_Type_Conversion17 Data_Type_Conversion18 Data_Type_Conversion19 Data_Type_Conversion2 Data_Type_Conversion20 Data_Type_Conversion21 Data_Type_Conversion22 Data_Type_Conversion23 Data_Type_Conversion24 Data_Type_Conversion3 Data_Type_Conversion36 Data_Type_Conversion37 Data_Type_Conversion38 Data_Type_Conversion39 Data_Type_Conversion4 Data_Type_Conversion40 Data_Type_Conversion41 Data_Type_Conversion42 Data_Type_Conversion43 Data_Type_Conversion5 Data_Type_Conversion6 Data_Type_Conversion7 Data_Type_Conversion8 Data_Type_Conversion9 /end SUB_FUNCTION
 /begin DEF_CHARACTERISTIC /end DEF_CHARACTERISTIC
 /begin IN_MEASUREMENT /end IN_MEASUREMENT
 /begin OUT_MEASUREMENT /end OUT_MEASUREMENT
/end FUNCTION
/begin FUNCTION DTCHeader7 ""
 /begin SUB_FUNCTION Bit_Shift1 Bit_Shift10 Bit_Shift11 Bit_Shift12 Bit_Shift13 Bit_Shift14 Bit_Shift15 Bit_Shift16 Bit_Shift17 Bit_Shift18 Bit_Shift19 Bit_Shift2 Bit_Shift20 Bit_Shift21 Bit_Shift22 Bit_Shift23 Bit_Shift24 Bit_Shift27 Bit_Shift28 Bit_Shift29 Bit_Shift3 Bit_Shift30 Bit_Shift31 Bit_Shift32 Bit_Shift33 Bit_Shift34 Bit_Shift4 Bit_Shift5 Bit_Shift6 Bit_Shift7 Bit_Shift8 Bit_Shift9 Data_Type_Conversion1 Data_Type_Conversion10 Data_Type_Conversion11 Data_Type_Conversion12 Data_Type_Conversion13 Data_Type_Conversion14 Data_Type_Conversion15 Data_Type_Conversion16 Data_Type_Conversion17 Data_Type_Conversion18 Data_Type_Conversion19 Data_Type_Conversion2 Data_Type_Conversion20 Data_Type_Conversion21 Data_Type_Conversion22 Data_Type_Conversion23 Data_Type_Conversion24 Data_Type_Conversion3 Data_Type_Conversion36 Data_Type_Conversion37 Data_Type_Conversion38 Data_Type_Conversion39 Data_Type_Conversion4 Data_Type_Conversion40 Data_Type_Conversion41 Data_Type_Conversion42 Data_Type_Conversion43 Data_Type_Conversion5 Data_Type_Conversion6 Data_Type_Conversion7 Data_Type_Conversion8 Data_Type_Conversion9 /end SUB_FUNCTION
 /begin DEF_CHARACTERISTIC /end DEF_CHARACTERISTIC
 /begin IN_MEASUREMENT /end IN_MEASUREMENT
 /begin OUT_MEASUREMENT /end OUT_MEASUREMENT
/end FUNCTION
/begin FUNCTION DTCHeader8 ""
 /begin SUB_FUNCTION Bit_Shift1 Bit_Shift10 Bit_Shift11 Bit_Shift12 Bit_Shift13 Bit_Shift14 Bit_Shift15 Bit_Shift16 Bit_Shift17 Bit_Shift18 Bit_Shift19 Bit_Shift2 Bit_Shift20 Bit_Shift21 Bit_Shift22 Bit_Shift23 Bit_Shift24 Bit_Shift27 Bit_Shift28 Bit_Shift29 Bit_Shift3 Bit_Shift30 Bit_Shift31 Bit_Shift32 Bit_Shift33 Bit_Shift34 Bit_Shift4 Bit_Shift5 Bit_Shift6 Bit_Shift7 Bit_Shift8 Bit_Shift9 Data_Type_Conversion1 Data_Type_Conversion10 Data_Type_Conversion11 Data_Type_Conversion12 Data_Type_Conversion13 Data_Type_Conversion14 Data_Type_Conversion15 Data_Type_Conversion16 Data_Type_Conversion17 Data_Type_Conversion18 Data_Type_Conversion19 Data_Type_Conversion2 Data_Type_Conversion20 Data_Type_Conversion21 Data_Type_Conversion22 Data_Type_Conversion23 Data_Type_Conversion24 Data_Type_Conversion3 Data_Type_Conversion36 Data_Type_Conversion37 Data_Type_Conversion38 Data_Type_Conversion39 Data_Type_Conversion4 Data_Type_Conversion40 Data_Type_Conversion41 Data_Type_Conversion42 Data_Type_Conversion43 Data_Type_Conversion5 Data_Type_Conversion6 Data_Type_Conversion7 Data_Type_Conversion8 Data_Type_Conversion9 /end SUB_FUNCTION
 /begin DEF_CHARACTERISTIC /end DEF_CHARACTERISTIC
 /begin IN_MEASUREMENT /end IN_MEASUREMENT
 /begin OUT_MEASUREMENT /end OUT_MEASUREMENT
/end FUNCTION
/begin FUNCTION DTCHeader9 ""
 /begin SUB_FUNCTION Bit_Shift1 Bit_Shift10 Bit_Shift11 Bit_Shift12 Bit_Shift13 Bit_Shift14 Bit_Shift15 Bit_Shift16 Bit_Shift17 Bit_Shift18 Bit_Shift19 Bit_Shift2 Bit_Shift20 Bit_Shift21 Bit_Shift22 Bit_Shift23 Bit_Shift24 Bit_Shift27 Bit_Shift28 Bit_Shift29 Bit_Shift3 Bit_Shift30 Bit_Shift31 Bit_Shift32 Bit_Shift33 Bit_Shift34 Bit_Shift4 Bit_Shift5 Bit_Shift6 Bit_Shift7 Bit_Shift8 Bit_Shift9 Data_Type_Conversion1 Data_Type_Conversion10 Data_Type_Conversion11 Data_Type_Conversion12 Data_Type_Conversion13 Data_Type_Conversion14 Data_Type_Conversion15 Data_Type_Conversion16 Data_Type_Conversion17 Data_Type_Conversion18 Data_Type_Conversion19 Data_Type_Conversion2 Data_Type_Conversion20 Data_Type_Conversion21 Data_Type_Conversion22 Data_Type_Conversion23 Data_Type_Conversion24 Data_Type_Conversion3 Data_Type_Conversion36 Data_Type_Conversion37 Data_Type_Conversion38 Data_Type_Conversion39 Data_Type_Conversion4 Data_Type_Conversion40 Data_Type_Conversion41 Data_Type_Conversion42 Data_Type_Conversion43 Data_Type_Conversion5 Data_Type_Conversion6 Data_Type_Conversion7 Data_Type_Conversion8 Data_Type_Conversion9 /end SUB_FUNCTION
 /begin DEF_CHARACTERISTIC /end DEF_CHARACTERISTIC
 /begin IN_MEASUREMENT /end IN_MEASUREMENT
 /begin OUT_MEASUREMENT /end OUT_MEASUREMENT
/end FUNCTION
/begin FUNCTION DTCID_Status "" /begin SUB_FUNCTION Bit_Shift37 /end SUB_FUNCTION /begin DEF_CHARACTERISTIC /end DEF_CHARACTERISTIC /begin IN_MEASUREMENT /end IN_MEASUREMENT /begin OUT_MEASUREMENT /end OUT_MEASUREMENT /end FUNCTION
/begin FUNCTION DTCID_Status1 "" /begin SUB_FUNCTION Bit_Shift37 /end SUB_FUNCTION /begin DEF_CHARACTERISTIC /end DEF_CHARACTERISTIC /begin IN_MEASUREMENT /end IN_MEASUREMENT /begin OUT_MEASUREMENT /end OUT_MEASUREMENT /end FUNCTION
/begin FUNCTION DTCID_Status10 "" /begin SUB_FUNCTION Bit_Shift37 /end SUB_FUNCTION /begin DEF_CHARACTERISTIC /end DEF_CHARACTERISTIC /begin IN_MEASUREMENT /end IN_MEASUREMENT /begin OUT_MEASUREMENT /end OUT_MEASUREMENT /end FUNCTION
/begin FUNCTION DTCID_Status100 "" /begin SUB_FUNCTION Bit_Shift37 /end SUB_FUNCTION /begin DEF_CHARACTERISTIC /end DEF_CHARACTERISTIC /begin IN_MEASUREMENT /end IN_MEASUREMENT /begin OUT_MEASUREMENT /end OUT_MEASUREMENT /end FUNCTION
/begin FUNCTION DTCID_Status101 "" /begin SUB_FUNCTION Bit_Shift37 /end SUB_FUNCTION /begin DEF_CHARACTERISTIC /end DEF_CHARACTERISTIC /begin IN_MEASUREMENT /end IN_MEASUREMENT /begin OUT_MEASUREMENT /end OUT_MEASUREMENT /end FUNCTION
/begin FUNCTION DTCID_Status102 "" /begin SUB_FUNCTION Bit_Shift37 /end SUB_FUNCTION /begin DEF_CHARACTERISTIC /end DEF_CHARACTERISTIC /begin IN_MEASUREMENT /end IN_MEASUREMENT /begin OUT_MEASUREMENT /end OUT_MEASUREMENT /end FUNCTION
/begin FUNCTION DTCID_Status103 "" /begin SUB_FUNCTION Bit_Shift37 /end SUB_FUNCTION /begin DEF_CHARACTERISTIC /end DEF_CHARACTERISTIC /begin IN_MEASUREMENT /end IN_MEASUREMENT /begin OUT_MEASUREMENT /end OUT_MEASUREMENT /end FUNCTION
/begin FUNCTION DTCID_Status104 "" /begin SUB_FUNCTION Bit_Shift37 /end SUB_FUNCTION /begin DEF_CHARACTERISTIC /end DEF_CHARACTERISTIC /begin IN_MEASUREMENT /end IN_MEASUREMENT /begin OUT_MEASUREMENT /end OUT_MEASUREMENT /end FUNCTION
/begin FUNCTION DTCID_Status105 "" /begin SUB_FUNCTION Bit_Shift37 /end SUB_FUNCTION /begin DEF_CHARACTERISTIC /end DEF_CHARACTERISTIC /begin IN_MEASUREMENT /end IN_MEASUREMENT /begin OUT_MEASUREMENT /end OUT_MEASUREMENT /end FUNCTION
/begin FUNCTION DTCID_Status106 "" /begin SUB_FUNCTION Bit_Shift37 /end SUB_FUNCTION /begin DEF_CHARACTERISTIC /end DEF_CHARACTERISTIC /begin IN_MEASUREMENT /end IN_MEASUREMENT /begin OUT_MEASUREMENT /end OUT_MEASUREMENT /end FUNCTION
/begin FUNCTION DTCID_Status107 "" /begin SUB_FUNCTION Bit_Shift37 /end SUB_FUNCTION /begin DEF_CHARACTERISTIC /end DEF_CHARACTERISTIC /begin IN_MEASUREMENT /end IN_MEASUREMENT /begin OUT_MEASUREMENT /end OUT_MEASUREMENT /end FUNCTION
/begin FUNCTION DTCID_Status108 "" /begin SUB_FUNCTION Bit_Shift37 /end SUB_FUNCTION /begin DEF_CHARACTERISTIC /end DEF_CHARACTERISTIC /begin IN_MEASUREMENT /end IN_MEASUREMENT /begin OUT_MEASUREMENT /end OUT_MEASUREMENT /end FUNCTION
/begin FUNCTION DTCID_Status109 "" /begin SUB_FUNCTION Bit_Shift37 /end SUB_FUNCTION /begin DEF_CHARACTERISTIC /end DEF_CHARACTERISTIC /begin IN_MEASUREMENT /end IN_MEASUREMENT /begin OUT_MEASUREMENT /end OUT_MEASUREMENT /end FUNCTION
/begin FUNCTION DTCID_Status11 "" /begin SUB_FUNCTION Bit_Shift37 /end SUB_FUNCTION /begin DEF_CHARACTERISTIC /end DEF_CHARACTERISTIC /begin IN_MEASUREMENT /end IN_MEASUREMENT /begin OUT_MEASUREMENT /end OUT_MEASUREMENT /end FUNCTION
/begin FUNCTION DTCID_Status110 "" /begin SUB_FUNCTION Bit_Shift37 /end SUB_FUNCTION /begin DEF_CHARACTERISTIC /end DEF_CHARACTERISTIC /begin IN_MEASUREMENT /end IN_MEASUREMENT /begin OUT_MEASUREMENT /end OUT_MEASUREMENT /end FUNCTION
/begin FUNCTION DTCID_Status111 "" /begin SUB_FUNCTION Bit_Shift37 /end SUB_FUNCTION /begin DEF_CHARACTERISTIC /end DEF_CHARACTERISTIC /begin IN_MEASUREMENT /end IN_MEASUREMENT /begin OUT_MEASUREMENT /end OUT_MEASUREMENT /end FUNCTION
/begin FUNCTION DTCID_Status112 "" /begin SUB_FUNCTION Bit_Shift37 /end SUB_FUNCTION /begin DEF_CHARACTERISTIC /end DEF_CHARACTERISTIC /begin IN_MEASUREMENT /end IN_MEASUREMENT /begin OUT_MEASUREMENT /end OUT_MEASUREMENT /end FUNCTION
/begin FUNCTION DTCID_Status113 "" /begin SUB_FUNCTION Bit_Shift37 /end SUB_FUNCTION /begin DEF_CHARACTERISTIC /end DEF_CHARACTERISTIC /begin IN_MEASUREMENT /end IN_MEASUREMENT /begin OUT_MEASUREMENT /end OUT_MEASUREMENT /end FUNCTION
/begin FUNCTION DTCID_Status114 "" /begin SUB_FUNCTION Bit_Shift37 /end SUB_FUNCTION /begin DEF_CHARACTERISTIC /end DEF_CHARACTERISTIC /begin IN_MEASUREMENT /end IN_MEASUREMENT /begin OUT_MEASUREMENT /end OUT_MEASUREMENT /end FUNCTION
/begin FUNCTION DTCID_Status115 "" /begin SUB_FUNCTION Bit_Shift37 /end SUB_FUNCTION /begin DEF_CHARACTERISTIC /end DEF_CHARACTERISTIC /begin IN_MEASUREMENT /end IN_MEASUREMENT /begin OUT_MEASUREMENT /end OUT_MEASUREMENT /end FUNCTION
/begin FUNCTION DTCID_Status116 "" /begin SUB_FUNCTION Bit_Shift37 /end SUB_FUNCTION /begin DEF_CHARACTERISTIC /end DEF_CHARACTERISTIC /begin IN_MEASUREMENT /end IN_MEASUREMENT /begin OUT_MEASUREMENT /end OUT_MEASUREMENT /end FUNCTION
/begin FUNCTION DTCID_Status117 "" /begin SUB_FUNCTION Bit_Shift37 /end SUB_FUNCTION /begin DEF_CHARACTERISTIC /end DEF_CHARACTERISTIC /begin IN_MEASUREMENT /end IN_MEASUREMENT /begin OUT_MEASUREMENT /end OUT_MEASUREMENT /end FUNCTION
/begin FUNCTION DTCID_Status118 "" /begin SUB_FUNCTION Bit_Shift37 /end SUB_FUNCTION /begin DEF_CHARACTERISTIC /end DEF_CHARACTERISTIC /begin IN_MEASUREMENT /end IN_MEASUREMENT /begin OUT_MEASUREMENT /end OUT_MEASUREMENT /end FUNCTION
/begin FUNCTION DTCID_Status119 "" /begin SUB_FUNCTION Bit_Shift37 /end SUB_FUNCTION /begin DEF_CHARACTERISTIC /end DEF_CHARACTERISTIC /begin IN_MEASUREMENT /end IN_MEASUREMENT /begin OUT_MEASUREMENT /end OUT_MEASUREMENT /end FUNCTION
/begin FUNCTION DTCID_Status12 "" /begin SUB_FUNCTION Bit_Shift37 /end SUB_FUNCTION /begin DEF_CHARACTERISTIC /end DEF_CHARACTERISTIC /begin IN_MEASUREMENT /end IN_MEASUREMENT /begin OUT_MEASUREMENT /end OUT_MEASUREMENT /end FUNCTION
/begin FUNCTION DTCID_Status120 "" /begin SUB_FUNCTION Bit_Shift37 /end SUB_FUNCTION /begin DEF_CHARACTERISTIC /end DEF_CHARACTERISTIC /begin IN_MEASUREMENT /end IN_MEASUREMENT /begin OUT_MEASUREMENT /end OUT_MEASUREMENT /end FUNCTION
/begin FUNCTION DTCID_Status121 "" /begin SUB_FUNCTION Bit_Shift37 /end SUB_FUNCTION /begin DEF_CHARACTERISTIC /end DEF_CHARACTERISTIC /begin IN_MEASUREMENT /end IN_MEASUREMENT /begin OUT_MEASUREMENT /end OUT_MEASUREMENT /end FUNCTION
/begin FUNCTION DTCID_Status122 "" /begin SUB_FUNCTION Bit_Shift37 /end SUB_FUNCTION /begin DEF_CHARACTERISTIC /end DEF_CHARACTERISTIC /begin IN_MEASUREMENT /end IN_MEASUREMENT /begin OUT_MEASUREMENT /end OUT_MEASUREMENT /end FUNCTION
/begin FUNCTION DTCID_Status123 "" /begin SUB_FUNCTION Bit_Shift37 /end SUB_FUNCTION /begin DEF_CHARACTERISTIC /end DEF_CHARACTERISTIC /begin IN_MEASUREMENT /end IN_MEASUREMENT /begin OUT_MEASUREMENT /end OUT_MEASUREMENT /end FUNCTION
/begin FUNCTION DTCID_Status124 "" /begin SUB_FUNCTION Bit_Shift37 /end SUB_FUNCTION /begin DEF_CHARACTERISTIC /end DEF_CHARACTERISTIC /begin IN_MEASUREMENT /end IN_MEASUREMENT /begin OUT_MEASUREMENT /end OUT_MEASUREMENT /end FUNCTION
/begin FUNCTION DTCID_Status125 "" /begin SUB_FUNCTION Bit_Shift37 /end SUB_FUNCTION /begin DEF_CHARACTERISTIC /end DEF_CHARACTERISTIC /begin IN_MEASUREMENT /end IN_MEASUREMENT /begin OUT_MEASUREMENT /end OUT_MEASUREMENT /end FUNCTION
/begin FUNCTION DTCID_Status126 "" /begin SUB_FUNCTION Bit_Shift37 /end SUB_FUNCTION /begin DEF_CHARACTERISTIC /end DEF_CHARACTERISTIC /begin IN_MEASUREMENT /end IN_MEASUREMENT /begin OUT_MEASUREMENT /end OUT_MEASUREMENT /end FUNCTION
/begin FUNCTION DTCID_Status127 "" /begin SUB_FUNCTION Bit_Shift37 /end SUB_FUNCTION /begin DEF_CHARACTERISTIC /end DEF_CHARACTERISTIC /begin IN_MEASUREMENT /end IN_MEASUREMENT /begin OUT_MEASUREMENT /end OUT_MEASUREMENT /end FUNCTION
/begin FUNCTION DTCID_Status128 "" /begin SUB_FUNCTION Bit_Shift37 /end SUB_FUNCTION /begin DEF_CHARACTERISTIC /end DEF_CHARACTERISTIC /begin IN_MEASUREMENT /end IN_MEASUREMENT /begin OUT_MEASUREMENT /end OUT_MEASUREMENT /end FUNCTION
/begin FUNCTION DTCID_Status129 "" /begin SUB_FUNCTION Bit_Shift37 /end SUB_FUNCTION /begin DEF_CHARACTERISTIC /end DEF_CHARACTERISTIC /begin IN_MEASUREMENT /end IN_MEASUREMENT /begin OUT_MEASUREMENT /end OUT_MEASUREMENT /end FUNCTION
/begin FUNCTION DTCID_Status13 "" /begin SUB_FUNCTION Bit_Shift37 /end SUB_FUNCTION /begin DEF_CHARACTERISTIC /end DEF_CHARACTERISTIC /begin IN_MEASUREMENT /end IN_MEASUREMENT /begin OUT_MEASUREMENT /end OUT_MEASUREMENT /end FUNCTION
/begin FUNCTION DTCID_Status130 "" /begin SUB_FUNCTION Bit_Shift37 Data_Type_Conversion /end SUB_FUNCTION /begin DEF_CHARACTERISTIC /end DEF_CHARACTERISTIC /begin IN_MEASUREMENT /end IN_MEASUREMENT /begin OUT_MEASUREMENT /end OUT_MEASUREMENT /end FUNCTION
/begin FUNCTION DTCID_Status131 "" /begin SUB_FUNCTION Bit_Shift37 /end SUB_FUNCTION /begin DEF_CHARACTERISTIC /end DEF_CHARACTERISTIC /begin IN_MEASUREMENT /end IN_MEASUREMENT /begin OUT_MEASUREMENT /end OUT_MEASUREMENT /end FUNCTION
/begin FUNCTION DTCID_Status132 "" /begin SUB_FUNCTION Bit_Shift37 /end SUB_FUNCTION /begin DEF_CHARACTERISTIC /end DEF_CHARACTERISTIC /begin IN_MEASUREMENT /end IN_MEASUREMENT /begin OUT_MEASUREMENT /end OUT_MEASUREMENT /end FUNCTION
/begin FUNCTION DTCID_Status133 "" /begin SUB_FUNCTION Bit_Shift37 /end SUB_FUNCTION /begin DEF_CHARACTERISTIC /end DEF_CHARACTERISTIC /begin IN_MEASUREMENT /end IN_MEASUREMENT /begin OUT_MEASUREMENT /end OUT_MEASUREMENT /end FUNCTION
/begin FUNCTION DTCID_Status134 "" /begin SUB_FUNCTION Bit_Shift37 /end SUB_FUNCTION /begin DEF_CHARACTERISTIC /end DEF_CHARACTERISTIC /begin IN_MEASUREMENT /end IN_MEASUREMENT /begin OUT_MEASUREMENT /end OUT_MEASUREMENT /end FUNCTION
/begin FUNCTION DTCID_Status135 "" /begin SUB_FUNCTION Bit_Shift37 /end SUB_FUNCTION /begin DEF_CHARACTERISTIC /end DEF_CHARACTERISTIC /begin IN_MEASUREMENT /end IN_MEASUREMENT /begin OUT_MEASUREMENT /end OUT_MEASUREMENT /end FUNCTION
/begin FUNCTION DTCID_Status136 "" /begin SUB_FUNCTION Bit_Shift37 /end SUB_FUNCTION /begin DEF_CHARACTERISTIC /end DEF_CHARACTERISTIC /begin IN_MEASUREMENT /end IN_MEASUREMENT /begin OUT_MEASUREMENT /end OUT_MEASUREMENT /end FUNCTION
/begin FUNCTION DTCID_Status137 "" /begin SUB_FUNCTION Bit_Shift37 /end SUB_FUNCTION /begin DEF_CHARACTERISTIC /end DEF_CHARACTERISTIC /begin IN_MEASUREMENT /end IN_MEASUREMENT /begin OUT_MEASUREMENT /end OUT_MEASUREMENT /end FUNCTION
/begin FUNCTION DTCID_Status138 "" /begin SUB_FUNCTION Bit_Shift37 /end SUB_FUNCTION /begin DEF_CHARACTERISTIC /end DEF_CHARACTERISTIC /begin IN_MEASUREMENT /end IN_MEASUREMENT /begin OUT_MEASUREMENT /end OUT_MEASUREMENT /end FUNCTION
/begin FUNCTION DTCID_Status139 "" /begin SUB_FUNCTION Bit_Shift37 Data_Type_Conversion /end SUB_FUNCTION /begin DEF_CHARACTERISTIC /end DEF_CHARACTERISTIC /begin IN_MEASUREMENT /end IN_MEASUREMENT /begin OUT_MEASUREMENT /end OUT_MEASUREMENT /end FUNCTION
/begin FUNCTION DTCID_Status14 "" /begin SUB_FUNCTION Bit_Shift37 /end SUB_FUNCTION /begin DEF_CHARACTERISTIC /end DEF_CHARACTERISTIC /begin IN_MEASUREMENT /end IN_MEASUREMENT /begin OUT_MEASUREMENT /end OUT_MEASUREMENT /end FUNCTION
/begin FUNCTION DTCID_Status140 "" /begin SUB_FUNCTION Bit_Shift37 Data_Type_Conversion /end SUB_FUNCTION /begin DEF_CHARACTERISTIC /end DEF_CHARACTERISTIC /begin IN_MEASUREMENT /end IN_MEASUREMENT /begin OUT_MEASUREMENT /end OUT_MEASUREMENT /end FUNCTION
/begin FUNCTION DTCID_Status141 "" /begin SUB_FUNCTION Bit_Shift37 Data_Type_Conversion /end SUB_FUNCTION /begin DEF_CHARACTERISTIC /end DEF_CHARACTERISTIC /begin IN_MEASUREMENT /end IN_MEASUREMENT /begin OUT_MEASUREMENT /end OUT_MEASUREMENT /end FUNCTION
/begin FUNCTION DTCID_Status142 "" /begin SUB_FUNCTION Bit_Shift37 Data_Type_Conversion /end SUB_FUNCTION /begin DEF_CHARACTERISTIC /end DEF_CHARACTERISTIC /begin IN_MEASUREMENT /end IN_MEASUREMENT /begin OUT_MEASUREMENT /end OUT_MEASUREMENT /end FUNCTION
/begin FUNCTION DTCID_Status143 "" /begin SUB_FUNCTION Bit_Shift37 Data_Type_Conversion /end SUB_FUNCTION /begin DEF_CHARACTERISTIC /end DEF_CHARACTERISTIC /begin IN_MEASUREMENT /end IN_MEASUREMENT /begin OUT_MEASUREMENT /end OUT_MEASUREMENT /end FUNCTION
/begin FUNCTION DTCID_Status144 "" /begin SUB_FUNCTION Bit_Shift37 /end SUB_FUNCTION /begin DEF_CHARACTERISTIC /end DEF_CHARACTERISTIC /begin IN_MEASUREMENT /end IN_MEASUREMENT /begin OUT_MEASUREMENT /end OUT_MEASUREMENT /end FUNCTION
/begin FUNCTION DTCID_Status145 "" /begin SUB_FUNCTION Bit_Shift37 Data_Type_Conversion /end SUB_FUNCTION /begin DEF_CHARACTERISTIC /end DEF_CHARACTERISTIC /begin IN_MEASUREMENT /end IN_MEASUREMENT /begin OUT_MEASUREMENT /end OUT_MEASUREMENT /end FUNCTION
/begin FUNCTION DTCID_Status146 "" /begin SUB_FUNCTION Bit_Shift37 Data_Type_Conversion /end SUB_FUNCTION /begin DEF_CHARACTERISTIC /end DEF_CHARACTERISTIC /begin IN_MEASUREMENT /end IN_MEASUREMENT /begin OUT_MEASUREMENT /end OUT_MEASUREMENT /end FUNCTION
/begin FUNCTION DTCID_Status147 "" /begin SUB_FUNCTION Bit_Shift37 /end SUB_FUNCTION /begin DEF_CHARACTERISTIC /end DEF_CHARACTERISTIC /begin IN_MEASUREMENT /end IN_MEASUREMENT /begin OUT_MEASUREMENT /end OUT_MEASUREMENT /end FUNCTION
/begin FUNCTION DTCID_Status148 "" /begin SUB_FUNCTION Bit_Shift37 /end SUB_FUNCTION /begin DEF_CHARACTERISTIC /end DEF_CHARACTERISTIC /begin IN_MEASUREMENT /end IN_MEASUREMENT /begin OUT_MEASUREMENT /end OUT_MEASUREMENT /end FUNCTION
/begin FUNCTION DTCID_Status149 "" /begin SUB_FUNCTION Bit_Shift37 /end SUB_FUNCTION /begin DEF_CHARACTERISTIC /end DEF_CHARACTERISTIC /begin IN_MEASUREMENT /end IN_MEASUREMENT /begin OUT_MEASUREMENT /end OUT_MEASUREMENT /end FUNCTION
/begin FUNCTION DTCID_Status15 "" /begin SUB_FUNCTION Bit_Shift37 /end SUB_FUNCTION /begin DEF_CHARACTERISTIC /end DEF_CHARACTERISTIC /begin IN_MEASUREMENT /end IN_MEASUREMENT /begin OUT_MEASUREMENT /end OUT_MEASUREMENT /end FUNCTION
/begin FUNCTION DTCID_Status150 "" /begin SUB_FUNCTION Bit_Shift37 /end SUB_FUNCTION /begin DEF_CHARACTERISTIC /end DEF_CHARACTERISTIC /begin IN_MEASUREMENT /end IN_MEASUREMENT /begin OUT_MEASUREMENT /end OUT_MEASUREMENT /end FUNCTION
/begin FUNCTION DTCID_Status151 "" /begin SUB_FUNCTION Bit_Shift37 /end SUB_FUNCTION /begin DEF_CHARACTERISTIC /end DEF_CHARACTERISTIC /begin IN_MEASUREMENT /end IN_MEASUREMENT /begin OUT_MEASUREMENT /end OUT_MEASUREMENT /end FUNCTION
/begin FUNCTION DTCID_Status152 "" /begin SUB_FUNCTION Bit_Shift37 /end SUB_FUNCTION /begin DEF_CHARACTERISTIC /end DEF_CHARACTERISTIC /begin IN_MEASUREMENT /end IN_MEASUREMENT /begin OUT_MEASUREMENT /end OUT_MEASUREMENT /end FUNCTION
/begin FUNCTION DTCID_Status153 "" /begin SUB_FUNCTION Bit_Shift37 /end SUB_FUNCTION /begin DEF_CHARACTERISTIC /end DEF_CHARACTERISTIC /begin IN_MEASUREMENT /end IN_MEASUREMENT /begin OUT_MEASUREMENT /end OUT_MEASUREMENT /end FUNCTION
/begin FUNCTION DTCID_Status154 "" /begin SUB_FUNCTION Bit_Shift37 /end SUB_FUNCTION /begin DEF_CHARACTERISTIC /end DEF_CHARACTERISTIC /begin IN_MEASUREMENT /end IN_MEASUREMENT /begin OUT_MEASUREMENT /end OUT_MEASUREMENT /end FUNCTION
/begin FUNCTION DTCID_Status155 "" /begin SUB_FUNCTION Bit_Shift37 /end SUB_FUNCTION /begin DEF_CHARACTERISTIC /end DEF_CHARACTERISTIC /begin IN_MEASUREMENT /end IN_MEASUREMENT /begin OUT_MEASUREMENT /end OUT_MEASUREMENT /end FUNCTION
/begin FUNCTION DTCID_Status156 "" /begin SUB_FUNCTION Bit_Shift37 /end SUB_FUNCTION /begin DEF_CHARACTERISTIC /end DEF_CHARACTERISTIC /begin IN_MEASUREMENT /end IN_MEASUREMENT /begin OUT_MEASUREMENT /end OUT_MEASUREMENT /end FUNCTION
/begin FUNCTION DTCID_Status157 "" /begin SUB_FUNCTION Bit_Shift37 /end SUB_FUNCTION /begin DEF_CHARACTERISTIC /end DEF_CHARACTERISTIC /begin IN_MEASUREMENT /end IN_MEASUREMENT /begin OUT_MEASUREMENT /end OUT_MEASUREMENT /end FUNCTION
/begin FUNCTION DTCID_Status158 "" /begin SUB_FUNCTION Bit_Shift37 /end SUB_FUNCTION /begin DEF_CHARACTERISTIC /end DEF_CHARACTERISTIC /begin IN_MEASUREMENT /end IN_MEASUREMENT /begin OUT_MEASUREMENT /end OUT_MEASUREMENT /end FUNCTION
/begin FUNCTION DTCID_Status159 "" /begin SUB_FUNCTION Bit_Shift37 /end SUB_FUNCTION /begin DEF_CHARACTERISTIC /end DEF_CHARACTERISTIC /begin IN_MEASUREMENT /end IN_MEASUREMENT /begin OUT_MEASUREMENT /end OUT_MEASUREMENT /end FUNCTION
/begin FUNCTION DTCID_Status16 "" /begin SUB_FUNCTION Bit_Shift37 /end SUB_FUNCTION /begin DEF_CHARACTERISTIC /end DEF_CHARACTERISTIC /begin IN_MEASUREMENT /end IN_MEASUREMENT /begin OUT_MEASUREMENT /end OUT_MEASUREMENT /end FUNCTION
/begin FUNCTION DTCID_Status160 "" /begin SUB_FUNCTION Bit_Shift37 /end SUB_FUNCTION /begin DEF_CHARACTERISTIC /end DEF_CHARACTERISTIC /begin IN_MEASUREMENT /end IN_MEASUREMENT /begin OUT_MEASUREMENT /end OUT_MEASUREMENT /end FUNCTION
/begin FUNCTION DTCID_Status161 "" /begin SUB_FUNCTION Bit_Shift37 /end SUB_FUNCTION /begin DEF_CHARACTERISTIC /end DEF_CHARACTERISTIC /begin IN_MEASUREMENT /end IN_MEASUREMENT /begin OUT_MEASUREMENT /end OUT_MEASUREMENT /end FUNCTION
/begin FUNCTION DTCID_Status162 "" /begin SUB_FUNCTION Bit_Shift37 Data_Type_Conversion /end SUB_FUNCTION /begin DEF_CHARACTERISTIC /end DEF_CHARACTERISTIC /begin IN_MEASUREMENT /end IN_MEASUREMENT /begin OUT_MEASUREMENT /end OUT_MEASUREMENT /end FUNCTION
/begin FUNCTION DTCID_Status163 "" /begin SUB_FUNCTION Bit_Shift37 Data_Type_Conversion /end SUB_FUNCTION /begin DEF_CHARACTERISTIC /end DEF_CHARACTERISTIC /begin IN_MEASUREMENT /end IN_MEASUREMENT /begin OUT_MEASUREMENT /end OUT_MEASUREMENT /end FUNCTION
/begin FUNCTION DTCID_Status164 "" /begin SUB_FUNCTION Bit_Shift37 Data_Type_Conversion /end SUB_FUNCTION /begin DEF_CHARACTERISTIC /end DEF_CHARACTERISTIC /begin IN_MEASUREMENT /end IN_MEASUREMENT /begin OUT_MEASUREMENT /end OUT_MEASUREMENT /end FUNCTION
/begin FUNCTION DTCID_Status165 "" /begin SUB_FUNCTION Bit_Shift37 Data_Type_Conversion /end SUB_FUNCTION /begin DEF_CHARACTERISTIC /end DEF_CHARACTERISTIC /begin IN_MEASUREMENT /end IN_MEASUREMENT /begin OUT_MEASUREMENT /end OUT_MEASUREMENT /end FUNCTION
/begin FUNCTION DTCID_Status166 "" /begin SUB_FUNCTION Bit_Shift37 Data_Type_Conversion /end SUB_FUNCTION /begin DEF_CHARACTERISTIC /end DEF_CHARACTERISTIC /begin IN_MEASUREMENT /end IN_MEASUREMENT /begin OUT_MEASUREMENT /end OUT_MEASUREMENT /end FUNCTION
/begin FUNCTION DTCID_Status167 "" /begin SUB_FUNCTION Bit_Shift37 Data_Type_Conversion /end SUB_FUNCTION /begin DEF_CHARACTERISTIC /end DEF_CHARACTERISTIC /begin IN_MEASUREMENT /end IN_MEASUREMENT /begin OUT_MEASUREMENT /end OUT_MEASUREMENT /end FUNCTION
/begin FUNCTION DTCID_Status168 "" /begin SUB_FUNCTION Bit_Shift37 /end SUB_FUNCTION /begin DEF_CHARACTERISTIC /end DEF_CHARACTERISTIC /begin IN_MEASUREMENT /end IN_MEASUREMENT /begin OUT_MEASUREMENT /end OUT_MEASUREMENT /end FUNCTION
/begin FUNCTION DTCID_Status169 "" /begin SUB_FUNCTION Bit_Shift37 /end SUB_FUNCTION /begin DEF_CHARACTERISTIC /end DEF_CHARACTERISTIC /begin IN_MEASUREMENT /end IN_MEASUREMENT /begin OUT_MEASUREMENT /end OUT_MEASUREMENT /end FUNCTION
/begin FUNCTION DTCID_Status17 "" /begin SUB_FUNCTION Bit_Shift37 /end SUB_FUNCTION /begin DEF_CHARACTERISTIC /end DEF_CHARACTERISTIC /begin IN_MEASUREMENT /end IN_MEASUREMENT /begin OUT_MEASUREMENT /end OUT_MEASUREMENT /end FUNCTION
/begin FUNCTION DTCID_Status170 "" /begin SUB_FUNCTION Bit_Shift37 Data_Type_Conversion /end SUB_FUNCTION /begin DEF_CHARACTERISTIC /end DEF_CHARACTERISTIC /begin IN_MEASUREMENT /end IN_MEASUREMENT /begin OUT_MEASUREMENT /end OUT_MEASUREMENT /end FUNCTION
/begin FUNCTION DTCID_Status171 "" /begin SUB_FUNCTION Bit_Shift37 Data_Type_Conversion /end SUB_FUNCTION /begin DEF_CHARACTERISTIC /end DEF_CHARACTERISTIC /begin IN_MEASUREMENT /end IN_MEASUREMENT /begin OUT_MEASUREMENT /end OUT_MEASUREMENT /end FUNCTION
/begin FUNCTION DTCID_Status172 "" /begin SUB_FUNCTION Bit_Shift37 Data_Type_Conversion /end SUB_FUNCTION /begin DEF_CHARACTERISTIC /end DEF_CHARACTERISTIC /begin IN_MEASUREMENT /end IN_MEASUREMENT /begin OUT_MEASUREMENT /end OUT_MEASUREMENT /end FUNCTION
/begin FUNCTION DTCID_Status173 "" /begin SUB_FUNCTION Bit_Shift37 Data_Type_Conversion /end SUB_FUNCTION /begin DEF_CHARACTERISTIC /end DEF_CHARACTERISTIC /begin IN_MEASUREMENT /end IN_MEASUREMENT /begin OUT_MEASUREMENT /end OUT_MEASUREMENT /end FUNCTION
/begin FUNCTION DTCID_Status174 "" /begin SUB_FUNCTION Bit_Shift37 /end SUB_FUNCTION /begin DEF_CHARACTERISTIC /end DEF_CHARACTERISTIC /begin IN_MEASUREMENT /end IN_MEASUREMENT /begin OUT_MEASUREMENT /end OUT_MEASUREMENT /end FUNCTION
/begin FUNCTION DTCID_Status175 "" /begin SUB_FUNCTION Bit_Shift37 Data_Type_Conversion /end SUB_FUNCTION /begin DEF_CHARACTERISTIC /end DEF_CHARACTERISTIC /begin IN_MEASUREMENT /end IN_MEASUREMENT /begin OUT_MEASUREMENT /end OUT_MEASUREMENT /end FUNCTION
/begin FUNCTION DTCID_Status176 "" /begin SUB_FUNCTION Bit_Shift37 Data_Type_Conversion /end SUB_FUNCTION /begin DEF_CHARACTERISTIC /end DEF_CHARACTERISTIC /begin IN_MEASUREMENT /end IN_MEASUREMENT /begin OUT_MEASUREMENT /end OUT_MEASUREMENT /end FUNCTION
/begin FUNCTION DTCID_Status18 "" /begin SUB_FUNCTION Bit_Shift37 /end SUB_FUNCTION /begin DEF_CHARACTERISTIC /end DEF_CHARACTERISTIC /begin IN_MEASUREMENT /end IN_MEASUREMENT /begin OUT_MEASUREMENT /end OUT_MEASUREMENT /end FUNCTION
/begin FUNCTION DTCID_Status19 "" /begin SUB_FUNCTION Bit_Shift37 /end SUB_FUNCTION /begin DEF_CHARACTERISTIC /end DEF_CHARACTERISTIC /begin IN_MEASUREMENT /end IN_MEASUREMENT /begin OUT_MEASUREMENT /end OUT_MEASUREMENT /end FUNCTION
/begin FUNCTION DTCID_Status2 "" /begin SUB_FUNCTION Bit_Shift37 /end SUB_FUNCTION /begin DEF_CHARACTERISTIC /end DEF_CHARACTERISTIC /begin IN_MEASUREMENT /end IN_MEASUREMENT /begin OUT_MEASUREMENT /end OUT_MEASUREMENT /end FUNCTION
/begin FUNCTION DTCID_Status20 "" /begin SUB_FUNCTION Bit_Shift37 /end SUB_FUNCTION /begin DEF_CHARACTERISTIC /end DEF_CHARACTERISTIC /begin IN_MEASUREMENT /end IN_MEASUREMENT /begin OUT_MEASUREMENT /end OUT_MEASUREMENT /end FUNCTION
/begin FUNCTION DTCID_Status21 "" /begin SUB_FUNCTION Bit_Shift37 /end SUB_FUNCTION /begin DEF_CHARACTERISTIC /end DEF_CHARACTERISTIC /begin IN_MEASUREMENT /end IN_MEASUREMENT /begin OUT_MEASUREMENT /end OUT_MEASUREMENT /end FUNCTION
/begin FUNCTION DTCID_Status22 "" /begin SUB_FUNCTION Bit_Shift37 /end SUB_FUNCTION /begin DEF_CHARACTERISTIC /end DEF_CHARACTERISTIC /begin IN_MEASUREMENT /end IN_MEASUREMENT /begin OUT_MEASUREMENT /end OUT_MEASUREMENT /end FUNCTION
/begin FUNCTION DTCID_Status23 "" /begin SUB_FUNCTION Bit_Shift37 /end SUB_FUNCTION /begin DEF_CHARACTERISTIC /end DEF_CHARACTERISTIC /begin IN_MEASUREMENT /end IN_MEASUREMENT /begin OUT_MEASUREMENT /end OUT_MEASUREMENT /end FUNCTION
/begin FUNCTION DTCID_Status24 "" /begin SUB_FUNCTION Bit_Shift37 /end SUB_FUNCTION /begin DEF_CHARACTERISTIC /end DEF_CHARACTERISTIC /begin IN_MEASUREMENT /end IN_MEASUREMENT /begin OUT_MEASUREMENT /end OUT_MEASUREMENT /end FUNCTION
/begin FUNCTION DTCID_Status25 "" /begin SUB_FUNCTION Bit_Shift37 /end SUB_FUNCTION /begin DEF_CHARACTERISTIC /end DEF_CHARACTERISTIC /begin IN_MEASUREMENT /end IN_MEASUREMENT /begin OUT_MEASUREMENT /end OUT_MEASUREMENT /end FUNCTION
/begin FUNCTION DTCID_Status26 "" /begin SUB_FUNCTION Bit_Shift37 /end SUB_FUNCTION /begin DEF_CHARACTERISTIC /end DEF_CHARACTERISTIC /begin IN_MEASUREMENT /end IN_MEASUREMENT /begin OUT_MEASUREMENT /end OUT_MEASUREMENT /end FUNCTION
/begin FUNCTION DTCID_Status27 "" /begin SUB_FUNCTION Bit_Shift37 /end SUB_FUNCTION /begin DEF_CHARACTERISTIC /end DEF_CHARACTERISTIC /begin IN_MEASUREMENT /end IN_MEASUREMENT /begin OUT_MEASUREMENT /end OUT_MEASUREMENT /end FUNCTION
/begin FUNCTION DTCID_Status28 "" /begin SUB_FUNCTION Bit_Shift37 /end SUB_FUNCTION /begin DEF_CHARACTERISTIC /end DEF_CHARACTERISTIC /begin IN_MEASUREMENT /end IN_MEASUREMENT /begin OUT_MEASUREMENT /end OUT_MEASUREMENT /end FUNCTION
/begin FUNCTION DTCID_Status29 "" /begin SUB_FUNCTION Bit_Shift37 /end SUB_FUNCTION /begin DEF_CHARACTERISTIC /end DEF_CHARACTERISTIC /begin IN_MEASUREMENT /end IN_MEASUREMENT /begin OUT_MEASUREMENT /end OUT_MEASUREMENT /end FUNCTION
/begin FUNCTION DTCID_Status3 "" /begin SUB_FUNCTION Bit_Shift37 /end SUB_FUNCTION /begin DEF_CHARACTERISTIC /end DEF_CHARACTERISTIC /begin IN_MEASUREMENT /end IN_MEASUREMENT /begin OUT_MEASUREMENT /end OUT_MEASUREMENT /end FUNCTION
/begin FUNCTION DTCID_Status30 "" /begin SUB_FUNCTION Bit_Shift37 /end SUB_FUNCTION /begin DEF_CHARACTERISTIC /end DEF_CHARACTERISTIC /begin IN_MEASUREMENT /end IN_MEASUREMENT /begin OUT_MEASUREMENT /end OUT_MEASUREMENT /end FUNCTION
/begin FUNCTION DTCID_Status31 "" /begin SUB_FUNCTION Bit_Shift37 /end SUB_FUNCTION /begin DEF_CHARACTERISTIC /end DEF_CHARACTERISTIC /begin IN_MEASUREMENT /end IN_MEASUREMENT /begin OUT_MEASUREMENT /end OUT_MEASUREMENT /end FUNCTION
/begin FUNCTION DTCID_Status32 "" /begin SUB_FUNCTION Bit_Shift37 /end SUB_FUNCTION /begin DEF_CHARACTERISTIC /end DEF_CHARACTERISTIC /begin IN_MEASUREMENT /end IN_MEASUREMENT /begin OUT_MEASUREMENT /end OUT_MEASUREMENT /end FUNCTION
/begin FUNCTION DTCID_Status33 "" /begin SUB_FUNCTION Bit_Shift37 /end SUB_FUNCTION /begin DEF_CHARACTERISTIC /end DEF_CHARACTERISTIC /begin IN_MEASUREMENT /end IN_MEASUREMENT /begin OUT_MEASUREMENT /end OUT_MEASUREMENT /end FUNCTION
/begin FUNCTION DTCID_Status34 "" /begin SUB_FUNCTION Bit_Shift37 /end SUB_FUNCTION /begin DEF_CHARACTERISTIC /end DEF_CHARACTERISTIC /begin IN_MEASUREMENT /end IN_MEASUREMENT /begin OUT_MEASUREMENT /end OUT_MEASUREMENT /end FUNCTION
/begin FUNCTION DTCID_Status35 "" /begin SUB_FUNCTION Bit_Shift37 /end SUB_FUNCTION /begin DEF_CHARACTERISTIC /end DEF_CHARACTERISTIC /begin IN_MEASUREMENT /end IN_MEASUREMENT /begin OUT_MEASUREMENT /end OUT_MEASUREMENT /end FUNCTION
/begin FUNCTION DTCID_Status36 "" /begin SUB_FUNCTION Bit_Shift37 /end SUB_FUNCTION /begin DEF_CHARACTERISTIC /end DEF_CHARACTERISTIC /begin IN_MEASUREMENT /end IN_MEASUREMENT /begin OUT_MEASUREMENT /end OUT_MEASUREMENT /end FUNCTION
/begin FUNCTION DTCID_Status37 "" /begin SUB_FUNCTION Bit_Shift37 /end SUB_FUNCTION /begin DEF_CHARACTERISTIC /end DEF_CHARACTERISTIC /begin IN_MEASUREMENT /end IN_MEASUREMENT /begin OUT_MEASUREMENT /end OUT_MEASUREMENT /end FUNCTION
/begin FUNCTION DTCID_Status38 "" /begin SUB_FUNCTION Bit_Shift37 /end SUB_FUNCTION /begin DEF_CHARACTERISTIC /end DEF_CHARACTERISTIC /begin IN_MEASUREMENT /end IN_MEASUREMENT /begin OUT_MEASUREMENT /end OUT_MEASUREMENT /end FUNCTION
/begin FUNCTION DTCID_Status39 "" /begin SUB_FUNCTION Bit_Shift37 /end SUB_FUNCTION /begin DEF_CHARACTERISTIC /end DEF_CHARACTERISTIC /begin IN_MEASUREMENT /end IN_MEASUREMENT /begin OUT_MEASUREMENT /end OUT_MEASUREMENT /end FUNCTION
/begin FUNCTION DTCID_Status4 "" /begin SUB_FUNCTION Bit_Shift37 /end SUB_FUNCTION /begin DEF_CHARACTERISTIC /end DEF_CHARACTERISTIC /begin IN_MEASUREMENT /end IN_MEASUREMENT /begin OUT_MEASUREMENT /end OUT_MEASUREMENT /end FUNCTION
/begin FUNCTION DTCID_Status40 "" /begin SUB_FUNCTION Bit_Shift37 /end SUB_FUNCTION /begin DEF_CHARACTERISTIC /end DEF_CHARACTERISTIC /begin IN_MEASUREMENT /end IN_MEASUREMENT /begin OUT_MEASUREMENT /end OUT_MEASUREMENT /end FUNCTION
/begin FUNCTION DTCID_Status41 "" /begin SUB_FUNCTION Bit_Shift37 /end SUB_FUNCTION /begin DEF_CHARACTERISTIC /end DEF_CHARACTERISTIC /begin IN_MEASUREMENT /end IN_MEASUREMENT /begin OUT_MEASUREMENT /end OUT_MEASUREMENT /end FUNCTION
/begin FUNCTION DTCID_Status42 "" /begin SUB_FUNCTION Bit_Shift37 /end SUB_FUNCTION /begin DEF_CHARACTERISTIC /end DEF_CHARACTERISTIC /begin IN_MEASUREMENT /end IN_MEASUREMENT /begin OUT_MEASUREMENT /end OUT_MEASUREMENT /end FUNCTION
/begin FUNCTION DTCID_Status43 "" /begin SUB_FUNCTION Bit_Shift37 /end SUB_FUNCTION /begin DEF_CHARACTERISTIC /end DEF_CHARACTERISTIC /begin IN_MEASUREMENT /end IN_MEASUREMENT /begin OUT_MEASUREMENT /end OUT_MEASUREMENT /end FUNCTION
/begin FUNCTION DTCID_Status44 "" /begin SUB_FUNCTION Bit_Shift37 /end SUB_FUNCTION /begin DEF_CHARACTERISTIC /end DEF_CHARACTERISTIC /begin IN_MEASUREMENT /end IN_MEASUREMENT /begin OUT_MEASUREMENT /end OUT_MEASUREMENT /end FUNCTION
/begin FUNCTION DTCID_Status45 "" /begin SUB_FUNCTION Bit_Shift37 /end SUB_FUNCTION /begin DEF_CHARACTERISTIC /end DEF_CHARACTERISTIC /begin IN_MEASUREMENT /end IN_MEASUREMENT /begin OUT_MEASUREMENT /end OUT_MEASUREMENT /end FUNCTION
/begin FUNCTION DTCID_Status46 "" /begin SUB_FUNCTION Bit_Shift37 /end SUB_FUNCTION /begin DEF_CHARACTERISTIC /end DEF_CHARACTERISTIC /begin IN_MEASUREMENT /end IN_MEASUREMENT /begin OUT_MEASUREMENT /end OUT_MEASUREMENT /end FUNCTION
/begin FUNCTION DTCID_Status47 "" /begin SUB_FUNCTION Bit_Shift37 /end SUB_FUNCTION /begin DEF_CHARACTERISTIC /end DEF_CHARACTERISTIC /begin IN_MEASUREMENT /end IN_MEASUREMENT /begin OUT_MEASUREMENT /end OUT_MEASUREMENT /end FUNCTION
/begin FUNCTION DTCID_Status48 "" /begin SUB_FUNCTION Bit_Shift37 /end SUB_FUNCTION /begin DEF_CHARACTERISTIC /end DEF_CHARACTERISTIC /begin IN_MEASUREMENT /end IN_MEASUREMENT /begin OUT_MEASUREMENT /end OUT_MEASUREMENT /end FUNCTION
/begin FUNCTION DTCID_Status49 "" /begin SUB_FUNCTION Bit_Shift37 /end SUB_FUNCTION /begin DEF_CHARACTERISTIC /end DEF_CHARACTERISTIC /begin IN_MEASUREMENT /end IN_MEASUREMENT /begin OUT_MEASUREMENT /end OUT_MEASUREMENT /end FUNCTION
/begin FUNCTION DTCID_Status5 "" /begin SUB_FUNCTION Bit_Shift37 /end SUB_FUNCTION /begin DEF_CHARACTERISTIC /end DEF_CHARACTERISTIC /begin IN_MEASUREMENT /end IN_MEASUREMENT /begin OUT_MEASUREMENT /end OUT_MEASUREMENT /end FUNCTION
/begin FUNCTION DTCID_Status50 "" /begin SUB_FUNCTION Bit_Shift37 /end SUB_FUNCTION /begin DEF_CHARACTERISTIC /end DEF_CHARACTERISTIC /begin IN_MEASUREMENT /end IN_MEASUREMENT /begin OUT_MEASUREMENT /end OUT_MEASUREMENT /end FUNCTION
/begin FUNCTION DTCID_Status51 "" /begin SUB_FUNCTION Bit_Shift37 /end SUB_FUNCTION /begin DEF_CHARACTERISTIC /end DEF_CHARACTERISTIC /begin IN_MEASUREMENT /end IN_MEASUREMENT /begin OUT_MEASUREMENT /end OUT_MEASUREMENT /end FUNCTION
/begin FUNCTION DTCID_Status52 "" /begin SUB_FUNCTION Bit_Shift37 /end SUB_FUNCTION /begin DEF_CHARACTERISTIC /end DEF_CHARACTERISTIC /begin IN_MEASUREMENT /end IN_MEASUREMENT /begin OUT_MEASUREMENT /end OUT_MEASUREMENT /end FUNCTION
/begin FUNCTION DTCID_Status53 "" /begin SUB_FUNCTION Bit_Shift37 /end SUB_FUNCTION /begin DEF_CHARACTERISTIC /end DEF_CHARACTERISTIC /begin IN_MEASUREMENT /end IN_MEASUREMENT /begin OUT_MEASUREMENT /end OUT_MEASUREMENT /end FUNCTION
/begin FUNCTION DTCID_Status54 "" /begin SUB_FUNCTION Bit_Shift37 /end SUB_FUNCTION /begin DEF_CHARACTERISTIC /end DEF_CHARACTERISTIC /begin IN_MEASUREMENT /end IN_MEASUREMENT /begin OUT_MEASUREMENT /end OUT_MEASUREMENT /end FUNCTION
/begin FUNCTION DTCID_Status55 "" /begin SUB_FUNCTION Bit_Shift37 /end SUB_FUNCTION /begin DEF_CHARACTERISTIC /end DEF_CHARACTERISTIC /begin IN_MEASUREMENT /end IN_MEASUREMENT /begin OUT_MEASUREMENT /end OUT_MEASUREMENT /end FUNCTION
/begin FUNCTION DTCID_Status56 "" /begin SUB_FUNCTION Bit_Shift37 /end SUB_FUNCTION /begin DEF_CHARACTERISTIC /end DEF_CHARACTERISTIC /begin IN_MEASUREMENT /end IN_MEASUREMENT /begin OUT_MEASUREMENT /end OUT_MEASUREMENT /end FUNCTION
/begin FUNCTION DTCID_Status57 "" /begin SUB_FUNCTION Bit_Shift37 /end SUB_FUNCTION /begin DEF_CHARACTERISTIC /end DEF_CHARACTERISTIC /begin IN_MEASUREMENT /end IN_MEASUREMENT /begin OUT_MEASUREMENT /end OUT_MEASUREMENT /end FUNCTION
/begin FUNCTION DTCID_Status58 "" /begin SUB_FUNCTION Bit_Shift37 /end SUB_FUNCTION /begin DEF_CHARACTERISTIC /end DEF_CHARACTERISTIC /begin IN_MEASUREMENT /end IN_MEASUREMENT /begin OUT_MEASUREMENT /end OUT_MEASUREMENT /end FUNCTION
/begin FUNCTION DTCID_Status59 "" /begin SUB_FUNCTION Bit_Shift37 /end SUB_FUNCTION /begin DEF_CHARACTERISTIC /end DEF_CHARACTERISTIC /begin IN_MEASUREMENT /end IN_MEASUREMENT /begin OUT_MEASUREMENT /end OUT_MEASUREMENT /end FUNCTION
/begin FUNCTION DTCID_Status6 "" /begin SUB_FUNCTION Bit_Shift37 /end SUB_FUNCTION /begin DEF_CHARACTERISTIC /end DEF_CHARACTERISTIC /begin IN_MEASUREMENT /end IN_MEASUREMENT /begin OUT_MEASUREMENT /end OUT_MEASUREMENT /end FUNCTION
/begin FUNCTION DTCID_Status60 "" /begin SUB_FUNCTION Bit_Shift37 /end SUB_FUNCTION /begin DEF_CHARACTERISTIC /end DEF_CHARACTERISTIC /begin IN_MEASUREMENT /end IN_MEASUREMENT /begin OUT_MEASUREMENT /end OUT_MEASUREMENT /end FUNCTION
/begin FUNCTION DTCID_Status61 "" /begin SUB_FUNCTION Bit_Shift37 /end SUB_FUNCTION /begin DEF_CHARACTERISTIC /end DEF_CHARACTERISTIC /begin IN_MEASUREMENT /end IN_MEASUREMENT /begin OUT_MEASUREMENT /end OUT_MEASUREMENT /end FUNCTION
/begin FUNCTION DTCID_Status62 "" /begin SUB_FUNCTION Bit_Shift37 /end SUB_FUNCTION /begin DEF_CHARACTERISTIC /end DEF_CHARACTERISTIC /begin IN_MEASUREMENT /end IN_MEASUREMENT /begin OUT_MEASUREMENT /end OUT_MEASUREMENT /end FUNCTION
/begin FUNCTION DTCID_Status63 "" /begin SUB_FUNCTION Bit_Shift37 /end SUB_FUNCTION /begin DEF_CHARACTERISTIC /end DEF_CHARACTERISTIC /begin IN_MEASUREMENT /end IN_MEASUREMENT /begin OUT_MEASUREMENT /end OUT_MEASUREMENT /end FUNCTION
/begin FUNCTION DTCID_Status64 "" /begin SUB_FUNCTION Bit_Shift37 /end SUB_FUNCTION /begin DEF_CHARACTERISTIC /end DEF_CHARACTERISTIC /begin IN_MEASUREMENT /end IN_MEASUREMENT /begin OUT_MEASUREMENT /end OUT_MEASUREMENT /end FUNCTION
/begin FUNCTION DTCID_Status65 "" /begin SUB_FUNCTION Bit_Shift37 /end SUB_FUNCTION /begin DEF_CHARACTERISTIC /end DEF_CHARACTERISTIC /begin IN_MEASUREMENT /end IN_MEASUREMENT /begin OUT_MEASUREMENT /end OUT_MEASUREMENT /end FUNCTION
/begin FUNCTION DTCID_Status66 "" /begin SUB_FUNCTION Bit_Shift37 /end SUB_FUNCTION /begin DEF_CHARACTERISTIC /end DEF_CHARACTERISTIC /begin IN_MEASUREMENT /end IN_MEASUREMENT /begin OUT_MEASUREMENT /end OUT_MEASUREMENT /end FUNCTION
/begin FUNCTION DTCID_Status67 "" /begin SUB_FUNCTION Bit_Shift37 /end SUB_FUNCTION /begin DEF_CHARACTERISTIC /end DEF_CHARACTERISTIC /begin IN_MEASUREMENT /end IN_MEASUREMENT /begin OUT_MEASUREMENT /end OUT_MEASUREMENT /end FUNCTION
/begin FUNCTION DTCID_Status68 "" /begin SUB_FUNCTION Bit_Shift37 /end SUB_FUNCTION /begin DEF_CHARACTERISTIC /end DEF_CHARACTERISTIC /begin IN_MEASUREMENT /end IN_MEASUREMENT /begin OUT_MEASUREMENT /end OUT_MEASUREMENT /end FUNCTION
/begin FUNCTION DTCID_Status69 "" /begin SUB_FUNCTION Bit_Shift37 /end SUB_FUNCTION /begin DEF_CHARACTERISTIC /end DEF_CHARACTERISTIC /begin IN_MEASUREMENT /end IN_MEASUREMENT /begin OUT_MEASUREMENT /end OUT_MEASUREMENT /end FUNCTION
/begin FUNCTION DTCID_Status7 "" /begin SUB_FUNCTION Bit_Shift37 /end SUB_FUNCTION /begin DEF_CHARACTERISTIC /end DEF_CHARACTERISTIC /begin IN_MEASUREMENT /end IN_MEASUREMENT /begin OUT_MEASUREMENT /end OUT_MEASUREMENT /end FUNCTION
/begin FUNCTION DTCID_Status70 "" /begin SUB_FUNCTION Bit_Shift37 /end SUB_FUNCTION /begin DEF_CHARACTERISTIC /end DEF_CHARACTERISTIC /begin IN_MEASUREMENT /end IN_MEASUREMENT /begin OUT_MEASUREMENT /end OUT_MEASUREMENT /end FUNCTION
/begin FUNCTION DTCID_Status71 "" /begin SUB_FUNCTION Bit_Shift37 /end SUB_FUNCTION /begin DEF_CHARACTERISTIC /end DEF_CHARACTERISTIC /begin IN_MEASUREMENT /end IN_MEASUREMENT /begin OUT_MEASUREMENT /end OUT_MEASUREMENT /end FUNCTION
/begin FUNCTION DTCID_Status72 "" /begin SUB_FUNCTION Bit_Shift37 /end SUB_FUNCTION /begin DEF_CHARACTERISTIC /end DEF_CHARACTERISTIC /begin IN_MEASUREMENT /end IN_MEASUREMENT /begin OUT_MEASUREMENT /end OUT_MEASUREMENT /end FUNCTION
/begin FUNCTION DTCID_Status73 "" /begin SUB_FUNCTION Bit_Shift37 /end SUB_FUNCTION /begin DEF_CHARACTERISTIC /end DEF_CHARACTERISTIC /begin IN_MEASUREMENT /end IN_MEASUREMENT /begin OUT_MEASUREMENT /end OUT_MEASUREMENT /end FUNCTION
/begin FUNCTION DTCID_Status74 "" /begin SUB_FUNCTION Bit_Shift37 /end SUB_FUNCTION /begin DEF_CHARACTERISTIC /end DEF_CHARACTERISTIC /begin IN_MEASUREMENT /end IN_MEASUREMENT /begin OUT_MEASUREMENT /end OUT_MEASUREMENT /end FUNCTION
/begin FUNCTION DTCID_Status75 "" /begin SUB_FUNCTION Bit_Shift37 /end SUB_FUNCTION /begin DEF_CHARACTERISTIC /end DEF_CHARACTERISTIC /begin IN_MEASUREMENT /end IN_MEASUREMENT /begin OUT_MEASUREMENT /end OUT_MEASUREMENT /end FUNCTION
/begin FUNCTION DTCID_Status76 "" /begin SUB_FUNCTION Bit_Shift37 /end SUB_FUNCTION /begin DEF_CHARACTERISTIC /end DEF_CHARACTERISTIC /begin IN_MEASUREMENT /end IN_MEASUREMENT /begin OUT_MEASUREMENT /end OUT_MEASUREMENT /end FUNCTION
/begin FUNCTION DTCID_Status77 "" /begin SUB_FUNCTION Bit_Shift37 /end SUB_FUNCTION /begin DEF_CHARACTERISTIC /end DEF_CHARACTERISTIC /begin IN_MEASUREMENT /end IN_MEASUREMENT /begin OUT_MEASUREMENT /end OUT_MEASUREMENT /end FUNCTION
/begin FUNCTION DTCID_Status78 "" /begin SUB_FUNCTION Bit_Shift37 /end SUB_FUNCTION /begin DEF_CHARACTERISTIC /end DEF_CHARACTERISTIC /begin IN_MEASUREMENT /end IN_MEASUREMENT /begin OUT_MEASUREMENT /end OUT_MEASUREMENT /end FUNCTION
/begin FUNCTION DTCID_Status79 "" /begin SUB_FUNCTION Bit_Shift37 /end SUB_FUNCTION /begin DEF_CHARACTERISTIC /end DEF_CHARACTERISTIC /begin IN_MEASUREMENT /end IN_MEASUREMENT /begin OUT_MEASUREMENT /end OUT_MEASUREMENT /end FUNCTION
/begin FUNCTION DTCID_Status8 "" /begin SUB_FUNCTION Bit_Shift37 /end SUB_FUNCTION /begin DEF_CHARACTERISTIC /end DEF_CHARACTERISTIC /begin IN_MEASUREMENT /end IN_MEASUREMENT /begin OUT_MEASUREMENT /end OUT_MEASUREMENT /end FUNCTION
/begin FUNCTION DTCID_Status80 "" /begin SUB_FUNCTION Bit_Shift37 /end SUB_FUNCTION /begin DEF_CHARACTERISTIC /end DEF_CHARACTERISTIC /begin IN_MEASUREMENT /end IN_MEASUREMENT /begin OUT_MEASUREMENT /end OUT_MEASUREMENT /end FUNCTION
/begin FUNCTION DTCID_Status81 "" /begin SUB_FUNCTION Bit_Shift37 /end SUB_FUNCTION /begin DEF_CHARACTERISTIC /end DEF_CHARACTERISTIC /begin IN_MEASUREMENT /end IN_MEASUREMENT /begin OUT_MEASUREMENT /end OUT_MEASUREMENT /end FUNCTION
/begin FUNCTION DTCID_Status82 "" /begin SUB_FUNCTION Bit_Shift37 /end SUB_FUNCTION /begin DEF_CHARACTERISTIC /end DEF_CHARACTERISTIC /begin IN_MEASUREMENT /end IN_MEASUREMENT /begin OUT_MEASUREMENT /end OUT_MEASUREMENT /end FUNCTION
/begin FUNCTION DTCID_Status83 "" /begin SUB_FUNCTION Bit_Shift37 /end SUB_FUNCTION /begin DEF_CHARACTERISTIC /end DEF_CHARACTERISTIC /begin IN_MEASUREMENT /end IN_MEASUREMENT /begin OUT_MEASUREMENT /end OUT_MEASUREMENT /end FUNCTION
/begin FUNCTION DTCID_Status84 "" /begin SUB_FUNCTION Bit_Shift37 /end SUB_FUNCTION /begin DEF_CHARACTERISTIC /end DEF_CHARACTERISTIC /begin IN_MEASUREMENT /end IN_MEASUREMENT /begin OUT_MEASUREMENT /end OUT_MEASUREMENT /end FUNCTION
/begin FUNCTION DTCID_Status85 "" /begin SUB_FUNCTION Bit_Shift37 /end SUB_FUNCTION /begin DEF_CHARACTERISTIC /end DEF_CHARACTERISTIC /begin IN_MEASUREMENT /end IN_MEASUREMENT /begin OUT_MEASUREMENT /end OUT_MEASUREMENT /end FUNCTION
/begin FUNCTION DTCID_Status86 "" /begin SUB_FUNCTION Bit_Shift37 /end SUB_FUNCTION /begin DEF_CHARACTERISTIC /end DEF_CHARACTERISTIC /begin IN_MEASUREMENT /end IN_MEASUREMENT /begin OUT_MEASUREMENT /end OUT_MEASUREMENT /end FUNCTION
/begin FUNCTION DTCID_Status87 "" /begin SUB_FUNCTION Bit_Shift37 /end SUB_FUNCTION /begin DEF_CHARACTERISTIC /end DEF_CHARACTERISTIC /begin IN_MEASUREMENT /end IN_MEASUREMENT /begin OUT_MEASUREMENT /end OUT_MEASUREMENT /end FUNCTION
/begin FUNCTION DTCID_Status88 "" /begin SUB_FUNCTION Bit_Shift37 /end SUB_FUNCTION /begin DEF_CHARACTERISTIC /end DEF_CHARACTERISTIC /begin IN_MEASUREMENT /end IN_MEASUREMENT /begin OUT_MEASUREMENT /end OUT_MEASUREMENT /end FUNCTION
/begin FUNCTION DTCID_Status89 "" /begin SUB_FUNCTION Bit_Shift37 /end SUB_FUNCTION /begin DEF_CHARACTERISTIC /end DEF_CHARACTERISTIC /begin IN_MEASUREMENT /end IN_MEASUREMENT /begin OUT_MEASUREMENT /end OUT_MEASUREMENT /end FUNCTION
/begin FUNCTION DTCID_Status9 "" /begin SUB_FUNCTION Bit_Shift37 /end SUB_FUNCTION /begin DEF_CHARACTERISTIC /end DEF_CHARACTERISTIC /begin IN_MEASUREMENT /end IN_MEASUREMENT /begin OUT_MEASUREMENT /end OUT_MEASUREMENT /end FUNCTION
/begin FUNCTION DTCID_Status90 "" /begin SUB_FUNCTION Bit_Shift37 /end SUB_FUNCTION /begin DEF_CHARACTERISTIC /end DEF_CHARACTERISTIC /begin IN_MEASUREMENT /end IN_MEASUREMENT /begin OUT_MEASUREMENT /end OUT_MEASUREMENT /end FUNCTION
/begin FUNCTION DTCID_Status91 "" /begin SUB_FUNCTION Bit_Shift37 /end SUB_FUNCTION /begin DEF_CHARACTERISTIC /end DEF_CHARACTERISTIC /begin IN_MEASUREMENT /end IN_MEASUREMENT /begin OUT_MEASUREMENT /end OUT_MEASUREMENT /end FUNCTION
/begin FUNCTION DTCID_Status92 "" /begin SUB_FUNCTION Bit_Shift37 /end SUB_FUNCTION /begin DEF_CHARACTERISTIC /end DEF_CHARACTERISTIC /begin IN_MEASUREMENT /end IN_MEASUREMENT /begin OUT_MEASUREMENT /end OUT_MEASUREMENT /end FUNCTION
/begin FUNCTION DTCID_Status93 "" /begin SUB_FUNCTION Bit_Shift37 /end SUB_FUNCTION /begin DEF_CHARACTERISTIC /end DEF_CHARACTERISTIC /begin IN_MEASUREMENT /end IN_MEASUREMENT /begin OUT_MEASUREMENT /end OUT_MEASUREMENT /end FUNCTION
/begin FUNCTION DTCID_Status94 "" /begin SUB_FUNCTION Bit_Shift37 /end SUB_FUNCTION /begin DEF_CHARACTERISTIC /end DEF_CHARACTERISTIC /begin IN_MEASUREMENT /end IN_MEASUREMENT /begin OUT_MEASUREMENT /end OUT_MEASUREMENT /end FUNCTION
/begin FUNCTION DTCID_Status95 "" /begin SUB_FUNCTION Bit_Shift37 /end SUB_FUNCTION /begin DEF_CHARACTERISTIC /end DEF_CHARACTERISTIC /begin IN_MEASUREMENT /end IN_MEASUREMENT /begin OUT_MEASUREMENT /end OUT_MEASUREMENT /end FUNCTION
/begin FUNCTION DTCID_Status96 "" /begin SUB_FUNCTION Bit_Shift37 /end SUB_FUNCTION /begin DEF_CHARACTERISTIC /end DEF_CHARACTERISTIC /begin IN_MEASUREMENT /end IN_MEASUREMENT /begin OUT_MEASUREMENT /end OUT_MEASUREMENT /end FUNCTION
/begin FUNCTION DTCID_Status97 "" /begin SUB_FUNCTION Bit_Shift37 /end SUB_FUNCTION /begin DEF_CHARACTERISTIC /end DEF_CHARACTERISTIC /begin IN_MEASUREMENT /end IN_MEASUREMENT /begin OUT_MEASUREMENT /end OUT_MEASUREMENT /end FUNCTION
/begin FUNCTION DTCID_Status98 "" /begin SUB_FUNCTION Bit_Shift37 /end SUB_FUNCTION /begin DEF_CHARACTERISTIC /end DEF_CHARACTERISTIC /begin IN_MEASUREMENT /end IN_MEASUREMENT /begin OUT_MEASUREMENT /end OUT_MEASUREMENT /end FUNCTION
/begin FUNCTION DTCID_Status99 "" /begin SUB_FUNCTION Bit_Shift37 /end SUB_FUNCTION /begin DEF_CHARACTERISTIC /end DEF_CHARACTERISTIC /begin IN_MEASUREMENT /end IN_MEASUREMENT /begin OUT_MEASUREMENT /end OUT_MEASUREMENT /end FUNCTION
/begin FUNCTION detect_change "" /begin SUB_FUNCTION FixPt_Relational_Operator Delay_Input1 /end SUB_FUNCTION /begin DEF_CHARACTERISTIC /end DEF_CHARACTERISTIC /begin IN_MEASUREMENT /end IN_MEASUREMENT /begin OUT_MEASUREMENT /end OUT_MEASUREMENT /end FUNCTION
/begin FUNCTION Constant "" /begin DEF_CHARACTERISTIC DTC_D00201 /end DEF_CHARACTERISTIC /begin IN_MEASUREMENT /end IN_MEASUREMENT /begin OUT_MEASUREMENT /end OUT_MEASUREMENT /end FUNCTION
/begin FUNCTION Constant1 "" /begin DEF_CHARACTERISTIC DTC_D00202 /end DEF_CHARACTERISTIC /begin IN_MEASUREMENT /end IN_MEASUREMENT /begin OUT_MEASUREMENT /end OUT_MEASUREMENT /end FUNCTION
/begin FUNCTION Constant10 "" /begin DEF_CHARACTERISTIC DTC_10020B /end DEF_CHARACTERISTIC /begin IN_MEASUREMENT /end IN_MEASUREMENT /begin OUT_MEASUREMENT /end OUT_MEASUREMENT /end FUNCTION
/begin FUNCTION Constant100 "" /begin DEF_CHARACTERISTIC DTC_900305 /end DEF_CHARACTERISTIC /begin IN_MEASUREMENT /end IN_MEASUREMENT /begin OUT_MEASUREMENT /end OUT_MEASUREMENT /end FUNCTION
/begin FUNCTION Constant101 "" /begin DEF_CHARACTERISTIC DTC_900253 /end DEF_CHARACTERISTIC /begin IN_MEASUREMENT /end IN_MEASUREMENT /begin OUT_MEASUREMENT /end OUT_MEASUREMENT /end FUNCTION
/begin FUNCTION Constant102 "" /begin DEF_CHARACTERISTIC DTC_900254 /end DEF_CHARACTERISTIC /begin IN_MEASUREMENT /end IN_MEASUREMENT /begin OUT_MEASUREMENT /end OUT_MEASUREMENT /end FUNCTION
/begin FUNCTION Constant103 "" /begin DEF_CHARACTERISTIC DTC_100A10 /end DEF_CHARACTERISTIC /begin IN_MEASUREMENT /end IN_MEASUREMENT /begin OUT_MEASUREMENT /end OUT_MEASUREMENT /end FUNCTION
/begin FUNCTION Constant104 "" /begin DEF_CHARACTERISTIC DTC_100A12 /end DEF_CHARACTERISTIC /begin IN_MEASUREMENT /end IN_MEASUREMENT /begin OUT_MEASUREMENT /end OUT_MEASUREMENT /end FUNCTION
/begin FUNCTION Constant105 "" /begin DEF_CHARACTERISTIC DTC_100A16 /end DEF_CHARACTERISTIC /begin IN_MEASUREMENT /end IN_MEASUREMENT /begin OUT_MEASUREMENT /end OUT_MEASUREMENT /end FUNCTION
/begin FUNCTION Constant106 "" /begin DEF_CHARACTERISTIC DTC_100A17 /end DEF_CHARACTERISTIC /begin IN_MEASUREMENT /end IN_MEASUREMENT /begin OUT_MEASUREMENT /end OUT_MEASUREMENT /end FUNCTION
/begin FUNCTION Constant107 "" /begin DEF_CHARACTERISTIC DTC_100A18 /end DEF_CHARACTERISTIC /begin IN_MEASUREMENT /end IN_MEASUREMENT /begin OUT_MEASUREMENT /end OUT_MEASUREMENT /end FUNCTION
/begin FUNCTION Constant108 "" /begin DEF_CHARACTERISTIC DTC_100A19 /end DEF_CHARACTERISTIC /begin IN_MEASUREMENT /end IN_MEASUREMENT /begin OUT_MEASUREMENT /end OUT_MEASUREMENT /end FUNCTION
/begin FUNCTION Constant109 "" /begin DEF_CHARACTERISTIC DTC_01201C /end DEF_CHARACTERISTIC /begin IN_MEASUREMENT /end IN_MEASUREMENT /begin OUT_MEASUREMENT /end OUT_MEASUREMENT /end FUNCTION
/begin FUNCTION Constant11 "" /begin DEF_CHARACTERISTIC DTC_10020C /end DEF_CHARACTERISTIC /begin IN_MEASUREMENT /end IN_MEASUREMENT /begin OUT_MEASUREMENT /end OUT_MEASUREMENT /end FUNCTION
/begin FUNCTION Constant110 "" /begin DEF_CHARACTERISTIC DTC_02201C /end DEF_CHARACTERISTIC /begin IN_MEASUREMENT /end IN_MEASUREMENT /begin OUT_MEASUREMENT /end OUT_MEASUREMENT /end FUNCTION
/begin FUNCTION Constant111 "" /begin DEF_CHARACTERISTIC DTC_0560A2 /end DEF_CHARACTERISTIC /begin IN_MEASUREMENT /end IN_MEASUREMENT /begin OUT_MEASUREMENT /end OUT_MEASUREMENT /end FUNCTION
/begin FUNCTION Constant112 "" /begin DEF_CHARACTERISTIC DTC_0560A3 /end DEF_CHARACTERISTIC /begin IN_MEASUREMENT /end IN_MEASUREMENT /begin OUT_MEASUREMENT /end OUT_MEASUREMENT /end FUNCTION
/begin FUNCTION Constant113 "" /begin DEF_CHARACTERISTIC DTC_085D92 /end DEF_CHARACTERISTIC /begin IN_MEASUREMENT /end IN_MEASUREMENT /begin OUT_MEASUREMENT /end OUT_MEASUREMENT /end FUNCTION
/begin FUNCTION Constant114 "" /begin DEF_CHARACTERISTIC DTC_0A1B92 /end DEF_CHARACTERISTIC /begin IN_MEASUREMENT /end IN_MEASUREMENT /begin OUT_MEASUREMENT /end OUT_MEASUREMENT /end FUNCTION
/begin FUNCTION Constant115 "" /begin DEF_CHARACTERISTIC DTC_0A1C92 /end DEF_CHARACTERISTIC /begin IN_MEASUREMENT /end IN_MEASUREMENT /begin OUT_MEASUREMENT /end OUT_MEASUREMENT /end FUNCTION
/begin FUNCTION Constant116 "" /begin DEF_CHARACTERISTIC DTC_0A9492 /end DEF_CHARACTERISTIC /begin IN_MEASUREMENT /end IN_MEASUREMENT /begin OUT_MEASUREMENT /end OUT_MEASUREMENT /end FUNCTION
/begin FUNCTION Constant117 "" /begin DEF_CHARACTERISTIC DTC_0AE172 /end DEF_CHARACTERISTIC /begin IN_MEASUREMENT /end IN_MEASUREMENT /begin OUT_MEASUREMENT /end OUT_MEASUREMENT /end FUNCTION
/begin FUNCTION Constant118 "" /begin DEF_CHARACTERISTIC DTC_0C1900 /end DEF_CHARACTERISTIC /begin IN_MEASUREMENT /end IN_MEASUREMENT /begin OUT_MEASUREMENT /end OUT_MEASUREMENT /end FUNCTION
/begin FUNCTION Constant119 "" /begin DEF_CHARACTERISTIC DTC_0C1A00 /end DEF_CHARACTERISTIC /begin IN_MEASUREMENT /end IN_MEASUREMENT /begin OUT_MEASUREMENT /end OUT_MEASUREMENT /end FUNCTION
/begin FUNCTION Constant12 "" /begin DEF_CHARACTERISTIC DTC_10020D /end DEF_CHARACTERISTIC /begin IN_MEASUREMENT /end IN_MEASUREMENT /begin OUT_MEASUREMENT /end OUT_MEASUREMENT /end FUNCTION
/begin FUNCTION Constant120 "" /begin DEF_CHARACTERISTIC DTC_0FC592 /end DEF_CHARACTERISTIC /begin IN_MEASUREMENT /end IN_MEASUREMENT /begin OUT_MEASUREMENT /end OUT_MEASUREMENT /end FUNCTION
/begin FUNCTION Constant121 "" /begin DEF_CHARACTERISTIC DTC_210900 /end DEF_CHARACTERISTIC /begin IN_MEASUREMENT /end IN_MEASUREMENT /begin OUT_MEASUREMENT /end OUT_MEASUREMENT /end FUNCTION
/begin FUNCTION Constant122 "" /begin DEF_CHARACTERISTIC DTC_211300 /end DEF_CHARACTERISTIC /begin IN_MEASUREMENT /end IN_MEASUREMENT /begin OUT_MEASUREMENT /end OUT_MEASUREMENT /end FUNCTION
/begin FUNCTION Constant123 "" /begin DEF_CHARACTERISTIC DTC_213500 /end DEF_CHARACTERISTIC /begin IN_MEASUREMENT /end IN_MEASUREMENT /begin OUT_MEASUREMENT /end OUT_MEASUREMENT /end FUNCTION
/begin FUNCTION Constant124 "" /begin DEF_CHARACTERISTIC DTC_216300 /end DEF_CHARACTERISTIC /begin IN_MEASUREMENT /end IN_MEASUREMENT /begin OUT_MEASUREMENT /end OUT_MEASUREMENT /end FUNCTION
/begin FUNCTION Constant125 "" /begin DEF_CHARACTERISTIC DTC_216400 /end DEF_CHARACTERISTIC /begin IN_MEASUREMENT /end IN_MEASUREMENT /begin OUT_MEASUREMENT /end OUT_MEASUREMENT /end FUNCTION
/begin FUNCTION Constant126 "" /begin DEF_CHARACTERISTIC DTC_254F01 /end DEF_CHARACTERISTIC /begin IN_MEASUREMENT /end IN_MEASUREMENT /begin OUT_MEASUREMENT /end OUT_MEASUREMENT /end FUNCTION
/begin FUNCTION Constant127 "" /begin DEF_CHARACTERISTIC DTC_2F8F63 /end DEF_CHARACTERISTIC /begin IN_MEASUREMENT /end IN_MEASUREMENT /begin OUT_MEASUREMENT /end OUT_MEASUREMENT /end FUNCTION
/begin FUNCTION Constant128 "" /begin DEF_CHARACTERISTIC DTC_2F9063 /end DEF_CHARACTERISTIC /begin IN_MEASUREMENT /end IN_MEASUREMENT /begin OUT_MEASUREMENT /end OUT_MEASUREMENT /end FUNCTION
/begin FUNCTION Constant129 "" /begin DEF_CHARACTERISTIC DTC_2FF573 /end DEF_CHARACTERISTIC /begin IN_MEASUREMENT /end IN_MEASUREMENT /begin OUT_MEASUREMENT /end OUT_MEASUREMENT /end FUNCTION
/begin FUNCTION Constant13 "" /begin DEF_CHARACTERISTIC DTC_10020E /end DEF_CHARACTERISTIC /begin IN_MEASUREMENT /end IN_MEASUREMENT /begin OUT_MEASUREMENT /end OUT_MEASUREMENT /end FUNCTION
/begin FUNCTION Constant130 "" /begin DEF_CHARACTERISTIC DTC_343A01 /end DEF_CHARACTERISTIC /begin IN_MEASUREMENT /end IN_MEASUREMENT /begin OUT_MEASUREMENT /end OUT_MEASUREMENT /end FUNCTION
/begin FUNCTION Constant131 "" /begin DEF_CHARACTERISTIC DTC_404001 /end DEF_CHARACTERISTIC /begin IN_MEASUREMENT /end IN_MEASUREMENT /begin OUT_MEASUREMENT /end OUT_MEASUREMENT /end FUNCTION
/begin FUNCTION Constant132 "" /begin DEF_CHARACTERISTIC DTC_407700 /end DEF_CHARACTERISTIC /begin IN_MEASUREMENT /end IN_MEASUREMENT /begin OUT_MEASUREMENT /end OUT_MEASUREMENT /end FUNCTION
/begin FUNCTION Constant133 "" /begin DEF_CHARACTERISTIC DTC_460B7F /end DEF_CHARACTERISTIC /begin IN_MEASUREMENT /end IN_MEASUREMENT /begin OUT_MEASUREMENT /end OUT_MEASUREMENT /end FUNCTION
/begin FUNCTION Constant134 "" /begin DEF_CHARACTERISTIC DTC_460B7E /end DEF_CHARACTERISTIC /begin IN_MEASUREMENT /end IN_MEASUREMENT /begin OUT_MEASUREMENT /end OUT_MEASUREMENT /end FUNCTION
/begin FUNCTION Constant135 "" /begin DEF_CHARACTERISTIC DTC_46107F /end DEF_CHARACTERISTIC /begin IN_MEASUREMENT /end IN_MEASUREMENT /begin OUT_MEASUREMENT /end OUT_MEASUREMENT /end FUNCTION
/begin FUNCTION Constant136 "" /begin DEF_CHARACTERISTIC DTC_46107E /end DEF_CHARACTERISTIC /begin IN_MEASUREMENT /end IN_MEASUREMENT /begin OUT_MEASUREMENT /end OUT_MEASUREMENT /end FUNCTION
/begin FUNCTION Constant137 "" /begin DEF_CHARACTERISTIC DTC_461592 /end DEF_CHARACTERISTIC /begin IN_MEASUREMENT /end IN_MEASUREMENT /begin OUT_MEASUREMENT /end OUT_MEASUREMENT /end FUNCTION
/begin FUNCTION Constant138 "" /begin DEF_CHARACTERISTIC DTC_80B701 /end DEF_CHARACTERISTIC /begin IN_MEASUREMENT /end IN_MEASUREMENT /begin OUT_MEASUREMENT /end OUT_MEASUREMENT /end FUNCTION
/begin FUNCTION Constant139 "" /begin DEF_CHARACTERISTIC DTC_C02888 /end DEF_CHARACTERISTIC /begin IN_MEASUREMENT /end IN_MEASUREMENT /begin OUT_MEASUREMENT /end OUT_MEASUREMENT /end FUNCTION
/begin FUNCTION Constant14 "" /begin DEF_CHARACTERISTIC DTC_100210 /end DEF_CHARACTERISTIC /begin IN_MEASUREMENT /end IN_MEASUREMENT /begin OUT_MEASUREMENT /end OUT_MEASUREMENT /end FUNCTION
/begin FUNCTION Constant140 "" /begin DEF_CHARACTERISTIC DTC_C03788 /end DEF_CHARACTERISTIC /begin IN_MEASUREMENT /end IN_MEASUREMENT /begin OUT_MEASUREMENT /end OUT_MEASUREMENT /end FUNCTION
/begin FUNCTION Constant141 "" /begin DEF_CHARACTERISTIC DTC_C04688 /end DEF_CHARACTERISTIC /begin IN_MEASUREMENT /end IN_MEASUREMENT /begin OUT_MEASUREMENT /end OUT_MEASUREMENT /end FUNCTION
/begin FUNCTION Constant142 "" /begin DEF_CHARACTERISTIC DTC_C05588 /end DEF_CHARACTERISTIC /begin IN_MEASUREMENT /end IN_MEASUREMENT /begin OUT_MEASUREMENT /end OUT_MEASUREMENT /end FUNCTION
/begin FUNCTION Constant143 "" /begin DEF_CHARACTERISTIC DTC_C06488 /end DEF_CHARACTERISTIC /begin IN_MEASUREMENT /end IN_MEASUREMENT /begin OUT_MEASUREMENT /end OUT_MEASUREMENT /end FUNCTION
/begin FUNCTION Constant144 "" /begin DEF_CHARACTERISTIC DTC_C08088 /end DEF_CHARACTERISTIC /begin IN_MEASUREMENT /end IN_MEASUREMENT /begin OUT_MEASUREMENT /end OUT_MEASUREMENT /end FUNCTION
/begin FUNCTION Constant145 "" /begin DEF_CHARACTERISTIC DTC_C08988 /end DEF_CHARACTERISTIC /begin IN_MEASUREMENT /end IN_MEASUREMENT /begin OUT_MEASUREMENT /end OUT_MEASUREMENT /end FUNCTION
/begin FUNCTION Constant146 "" /begin DEF_CHARACTERISTIC DTC_C0E101 /end DEF_CHARACTERISTIC /begin IN_MEASUREMENT /end IN_MEASUREMENT /begin OUT_MEASUREMENT /end OUT_MEASUREMENT /end FUNCTION
/begin FUNCTION Constant147 "" /begin DEF_CHARACTERISTIC DTC_C0E301 /end DEF_CHARACTERISTIC /begin IN_MEASUREMENT /end IN_MEASUREMENT /begin OUT_MEASUREMENT /end OUT_MEASUREMENT /end FUNCTION
/begin FUNCTION Constant148 "" /begin DEF_CHARACTERISTIC DTC_C0EA8C /end DEF_CHARACTERISTIC /begin IN_MEASUREMENT /end IN_MEASUREMENT /begin OUT_MEASUREMENT /end OUT_MEASUREMENT /end FUNCTION
/begin FUNCTION Constant149 "" /begin DEF_CHARACTERISTIC DTC_C0EB8C /end DEF_CHARACTERISTIC /begin IN_MEASUREMENT /end IN_MEASUREMENT /begin OUT_MEASUREMENT /end OUT_MEASUREMENT /end FUNCTION
/begin FUNCTION Constant15 "" /begin DEF_CHARACTERISTIC DTC_100211 /end DEF_CHARACTERISTIC /begin IN_MEASUREMENT /end IN_MEASUREMENT /begin OUT_MEASUREMENT /end OUT_MEASUREMENT /end FUNCTION
/begin FUNCTION Constant150 "" /begin DEF_CHARACTERISTIC DTC_085D8C /end DEF_CHARACTERISTIC /begin IN_MEASUREMENT /end IN_MEASUREMENT /begin OUT_MEASUREMENT /end OUT_MEASUREMENT /end FUNCTION
/begin FUNCTION Constant151 "" /begin DEF_CHARACTERISTIC DTC_C8108C /end DEF_CHARACTERISTIC /begin IN_MEASUREMENT /end IN_MEASUREMENT /begin OUT_MEASUREMENT /end OUT_MEASUREMENT /end FUNCTION
/begin FUNCTION Constant152 "" /begin DEF_CHARACTERISTIC DTC_C8228C /end DEF_CHARACTERISTIC /begin IN_MEASUREMENT /end IN_MEASUREMENT /begin OUT_MEASUREMENT /end OUT_MEASUREMENT /end FUNCTION
/begin FUNCTION Constant153 "" /begin DEF_CHARACTERISTIC DTC_C8278C /end DEF_CHARACTERISTIC /begin IN_MEASUREMENT /end IN_MEASUREMENT /begin OUT_MEASUREMENT /end OUT_MEASUREMENT /end FUNCTION
/begin FUNCTION Constant154 "" /begin DEF_CHARACTERISTIC DTC_C8288C /end DEF_CHARACTERISTIC /begin IN_MEASUREMENT /end IN_MEASUREMENT /begin OUT_MEASUREMENT /end OUT_MEASUREMENT /end FUNCTION
/begin FUNCTION Constant155 "" /begin DEF_CHARACTERISTIC DTC_45D68C /end DEF_CHARACTERISTIC /begin IN_MEASUREMENT /end IN_MEASUREMENT /begin OUT_MEASUREMENT /end OUT_MEASUREMENT /end FUNCTION
/begin FUNCTION Constant156 "" /begin DEF_CHARACTERISTIC DTC_C8BF8C /end DEF_CHARACTERISTIC /begin IN_MEASUREMENT /end IN_MEASUREMENT /begin OUT_MEASUREMENT /end OUT_MEASUREMENT /end FUNCTION
/begin FUNCTION Constant157 "" /begin DEF_CHARACTERISTIC DTC_82008C /end DEF_CHARACTERISTIC /begin IN_MEASUREMENT /end IN_MEASUREMENT /begin OUT_MEASUREMENT /end OUT_MEASUREMENT /end FUNCTION
/begin FUNCTION Constant158 "" /begin DEF_CHARACTERISTIC DTC_03648C /end DEF_CHARACTERISTIC /begin IN_MEASUREMENT /end IN_MEASUREMENT /begin OUT_MEASUREMENT /end OUT_MEASUREMENT /end FUNCTION
/begin FUNCTION Constant159 "" /begin DEF_CHARACTERISTIC DTC_C7928C /end DEF_CHARACTERISTIC /begin IN_MEASUREMENT /end IN_MEASUREMENT /begin OUT_MEASUREMENT /end OUT_MEASUREMENT /end FUNCTION
/begin FUNCTION Constant16 "" /begin DEF_CHARACTERISTIC DTC_100212 /end DEF_CHARACTERISTIC /begin IN_MEASUREMENT /end IN_MEASUREMENT /begin OUT_MEASUREMENT /end OUT_MEASUREMENT /end FUNCTION
/begin FUNCTION Constant160 "" /begin DEF_CHARACTERISTIC DTC_C7968C /end DEF_CHARACTERISTIC /begin IN_MEASUREMENT /end IN_MEASUREMENT /begin OUT_MEASUREMENT /end OUT_MEASUREMENT /end FUNCTION
/begin FUNCTION Constant161 "" /begin DEF_CHARACTERISTIC DTC_C7988C /end DEF_CHARACTERISTIC /begin IN_MEASUREMENT /end IN_MEASUREMENT /begin OUT_MEASUREMENT /end OUT_MEASUREMENT /end FUNCTION
/begin FUNCTION Constant162 "" /begin DEF_CHARACTERISTIC DTC_C1EB81 /end DEF_CHARACTERISTIC /begin IN_MEASUREMENT /end IN_MEASUREMENT /begin OUT_MEASUREMENT /end OUT_MEASUREMENT /end FUNCTION
/begin FUNCTION Constant163 "" /begin DEF_CHARACTERISTIC DTC_C71501 /end DEF_CHARACTERISTIC /begin IN_MEASUREMENT /end IN_MEASUREMENT /begin OUT_MEASUREMENT /end OUT_MEASUREMENT /end FUNCTION
/begin FUNCTION Constant164 "" /begin DEF_CHARACTERISTIC DTC_C71601 /end DEF_CHARACTERISTIC /begin IN_MEASUREMENT /end IN_MEASUREMENT /begin OUT_MEASUREMENT /end OUT_MEASUREMENT /end FUNCTION
/begin FUNCTION Constant165 "" /begin DEF_CHARACTERISTIC DTC_C71701 /end DEF_CHARACTERISTIC /begin IN_MEASUREMENT /end IN_MEASUREMENT /begin OUT_MEASUREMENT /end OUT_MEASUREMENT /end FUNCTION
/begin FUNCTION Constant166 "" /begin DEF_CHARACTERISTIC DTC_C71801 /end DEF_CHARACTERISTIC /begin IN_MEASUREMENT /end IN_MEASUREMENT /begin OUT_MEASUREMENT /end OUT_MEASUREMENT /end FUNCTION
/begin FUNCTION Constant167 "" /begin DEF_CHARACTERISTIC DTC_C79801 /end DEF_CHARACTERISTIC /begin IN_MEASUREMENT /end IN_MEASUREMENT /begin OUT_MEASUREMENT /end OUT_MEASUREMENT /end FUNCTION
/begin FUNCTION Constant168 "" /begin DEF_CHARACTERISTIC DTC_C8BF04 /end DEF_CHARACTERISTIC /begin IN_MEASUREMENT /end IN_MEASUREMENT /begin OUT_MEASUREMENT /end OUT_MEASUREMENT /end FUNCTION
/begin FUNCTION Constant169 "" /begin DEF_CHARACTERISTIC DTC_C8BF92 /end DEF_CHARACTERISTIC /begin IN_MEASUREMENT /end IN_MEASUREMENT /begin OUT_MEASUREMENT /end OUT_MEASUREMENT /end FUNCTION
/begin FUNCTION Constant17 "" /begin DEF_CHARACTERISTIC DTC_100213 /end DEF_CHARACTERISTIC /begin IN_MEASUREMENT /end IN_MEASUREMENT /begin OUT_MEASUREMENT /end OUT_MEASUREMENT /end FUNCTION
/begin FUNCTION Constant170 "" /begin DEF_CHARACTERISTIC DTC_F003A2 /end DEF_CHARACTERISTIC /begin IN_MEASUREMENT /end IN_MEASUREMENT /begin OUT_MEASUREMENT /end OUT_MEASUREMENT /end FUNCTION
/begin FUNCTION Constant171 "" /begin DEF_CHARACTERISTIC DTC_0A9493 /end DEF_CHARACTERISTIC /begin IN_MEASUREMENT /end IN_MEASUREMENT /begin OUT_MEASUREMENT /end OUT_MEASUREMENT /end FUNCTION
/begin FUNCTION Constant172 "" /begin DEF_CHARACTERISTIC DTC_0A9494 /end DEF_CHARACTERISTIC /begin IN_MEASUREMENT /end IN_MEASUREMENT /begin OUT_MEASUREMENT /end OUT_MEASUREMENT /end FUNCTION
/begin FUNCTION Constant173 "" /begin DEF_CHARACTERISTIC DTC_085D83 /end DEF_CHARACTERISTIC /begin IN_MEASUREMENT /end IN_MEASUREMENT /begin OUT_MEASUREMENT /end OUT_MEASUREMENT /end FUNCTION
/begin FUNCTION Constant174 "" /begin DEF_CHARACTERISTIC DTC_C81083 /end DEF_CHARACTERISTIC /begin IN_MEASUREMENT /end IN_MEASUREMENT /begin OUT_MEASUREMENT /end OUT_MEASUREMENT /end FUNCTION
/begin FUNCTION Constant175 "" /begin DEF_CHARACTERISTIC DTC_085D87 /end DEF_CHARACTERISTIC /begin IN_MEASUREMENT /end IN_MEASUREMENT /begin OUT_MEASUREMENT /end OUT_MEASUREMENT /end FUNCTION
/begin FUNCTION Constant176 "" /begin DEF_CHARACTERISTIC DTC_C81087 /end DEF_CHARACTERISTIC /begin IN_MEASUREMENT /end IN_MEASUREMENT /begin OUT_MEASUREMENT /end OUT_MEASUREMENT /end FUNCTION
/begin FUNCTION Constant177 "" /begin DEF_CHARACTERISTIC DTC_C82283 /end DEF_CHARACTERISTIC /begin IN_MEASUREMENT /end IN_MEASUREMENT /begin OUT_MEASUREMENT /end OUT_MEASUREMENT /end FUNCTION
/begin FUNCTION Constant178 "" /begin DEF_CHARACTERISTIC DTC_C82287 /end DEF_CHARACTERISTIC /begin IN_MEASUREMENT /end IN_MEASUREMENT /begin OUT_MEASUREMENT /end OUT_MEASUREMENT /end FUNCTION
/begin FUNCTION Constant179 "" /begin DEF_CHARACTERISTIC DTC_C82883 /end DEF_CHARACTERISTIC /begin IN_MEASUREMENT /end IN_MEASUREMENT /begin OUT_MEASUREMENT /end OUT_MEASUREMENT /end FUNCTION
/begin FUNCTION Constant18 "" /begin DEF_CHARACTERISTIC DTC_100214 /end DEF_CHARACTERISTIC /begin IN_MEASUREMENT /end IN_MEASUREMENT /begin OUT_MEASUREMENT /end OUT_MEASUREMENT /end FUNCTION
/begin FUNCTION Constant180 "" /begin DEF_CHARACTERISTIC DTC_C82887 /end DEF_CHARACTERISTIC /begin IN_MEASUREMENT /end IN_MEASUREMENT /begin OUT_MEASUREMENT /end OUT_MEASUREMENT /end FUNCTION
/begin FUNCTION Constant181 "" /begin DEF_CHARACTERISTIC DTC_45D683 /end DEF_CHARACTERISTIC /begin IN_MEASUREMENT /end IN_MEASUREMENT /begin OUT_MEASUREMENT /end OUT_MEASUREMENT /end FUNCTION
/begin FUNCTION Constant182 "" /begin DEF_CHARACTERISTIC DTC_45D687 /end DEF_CHARACTERISTIC /begin IN_MEASUREMENT /end IN_MEASUREMENT /begin OUT_MEASUREMENT /end OUT_MEASUREMENT /end FUNCTION
/begin FUNCTION Constant183 "" /begin DEF_CHARACTERISTIC DTC_C8BF83 /end DEF_CHARACTERISTIC /begin IN_MEASUREMENT /end IN_MEASUREMENT /begin OUT_MEASUREMENT /end OUT_MEASUREMENT /end FUNCTION
/begin FUNCTION Constant184 "" /begin DEF_CHARACTERISTIC DTC_C8BF87 /end DEF_CHARACTERISTIC /begin IN_MEASUREMENT /end IN_MEASUREMENT /begin OUT_MEASUREMENT /end OUT_MEASUREMENT /end FUNCTION
/begin FUNCTION Constant185 "" /begin DEF_CHARACTERISTIC DTC_036483 /end DEF_CHARACTERISTIC /begin IN_MEASUREMENT /end IN_MEASUREMENT /begin OUT_MEASUREMENT /end OUT_MEASUREMENT /end FUNCTION
/begin FUNCTION Constant186 "" /begin DEF_CHARACTERISTIC DTC_036487 /end DEF_CHARACTERISTIC /begin IN_MEASUREMENT /end IN_MEASUREMENT /begin OUT_MEASUREMENT /end OUT_MEASUREMENT /end FUNCTION
/begin FUNCTION Constant187 "" /begin DEF_CHARACTERISTIC DTC_C79283 /end DEF_CHARACTERISTIC /begin IN_MEASUREMENT /end IN_MEASUREMENT /begin OUT_MEASUREMENT /end OUT_MEASUREMENT /end FUNCTION
/begin FUNCTION Constant188 "" /begin DEF_CHARACTERISTIC DTC_C79287 /end DEF_CHARACTERISTIC /begin IN_MEASUREMENT /end IN_MEASUREMENT /begin OUT_MEASUREMENT /end OUT_MEASUREMENT /end FUNCTION
/begin FUNCTION Constant189 "" /begin DEF_CHARACTERISTIC DTC_C79883 /end DEF_CHARACTERISTIC /begin IN_MEASUREMENT /end IN_MEASUREMENT /begin OUT_MEASUREMENT /end OUT_MEASUREMENT /end FUNCTION
/begin FUNCTION Constant19 "" /begin DEF_CHARACTERISTIC DTC_100215 /end DEF_CHARACTERISTIC /begin IN_MEASUREMENT /end IN_MEASUREMENT /begin OUT_MEASUREMENT /end OUT_MEASUREMENT /end FUNCTION
/begin FUNCTION Constant190 "" /begin DEF_CHARACTERISTIC DTC_C79887 /end DEF_CHARACTERISTIC /begin IN_MEASUREMENT /end IN_MEASUREMENT /begin OUT_MEASUREMENT /end OUT_MEASUREMENT /end FUNCTION
/begin FUNCTION Constant191 "" /begin DEF_CHARACTERISTIC DTC_820083 /end DEF_CHARACTERISTIC /begin IN_MEASUREMENT /end IN_MEASUREMENT /begin OUT_MEASUREMENT /end OUT_MEASUREMENT /end FUNCTION
/begin FUNCTION Constant192 "" /begin DEF_CHARACTERISTIC DTC_820087 /end DEF_CHARACTERISTIC /begin IN_MEASUREMENT /end IN_MEASUREMENT /begin OUT_MEASUREMENT /end OUT_MEASUREMENT /end FUNCTION
/begin FUNCTION Constant193 "" /begin DEF_CHARACTERISTIC DTC_45D692 /end DEF_CHARACTERISTIC /begin IN_MEASUREMENT /end IN_MEASUREMENT /begin OUT_MEASUREMENT /end OUT_MEASUREMENT /end FUNCTION
/begin FUNCTION Constant194 "" /begin DEF_CHARACTERISTIC DTC_C82292 /end DEF_CHARACTERISTIC /begin IN_MEASUREMENT /end IN_MEASUREMENT /begin OUT_MEASUREMENT /end OUT_MEASUREMENT /end FUNCTION
/begin FUNCTION Constant195 "" /begin DEF_CHARACTERISTIC DTC_0E2D04 /end DEF_CHARACTERISTIC /begin IN_MEASUREMENT /end IN_MEASUREMENT /begin OUT_MEASUREMENT /end OUT_MEASUREMENT /end FUNCTION
/begin FUNCTION Constant196 "" /begin DEF_CHARACTERISTIC DTC_C79683 /end DEF_CHARACTERISTIC /begin IN_MEASUREMENT /end IN_MEASUREMENT /begin OUT_MEASUREMENT /end OUT_MEASUREMENT /end FUNCTION
/begin FUNCTION Constant197 "" /begin DEF_CHARACTERISTIC DTC_C79687 /end DEF_CHARACTERISTIC /begin IN_MEASUREMENT /end IN_MEASUREMENT /begin OUT_MEASUREMENT /end OUT_MEASUREMENT /end FUNCTION
/begin FUNCTION Constant198 "" /begin DEF_CHARACTERISTIC /end DEF_CHARACTERISTIC /begin IN_MEASUREMENT /end IN_MEASUREMENT /begin OUT_MEASUREMENT /end OUT_MEASUREMENT /end FUNCTION
/begin FUNCTION Constant2 "" /begin DEF_CHARACTERISTIC DTC_D00203 /end DEF_CHARACTERISTIC /begin IN_MEASUREMENT /end IN_MEASUREMENT /begin OUT_MEASUREMENT /end OUT_MEASUREMENT /end FUNCTION
/begin FUNCTION Constant20 "" /begin DEF_CHARACTERISTIC DTC_100216 /end DEF_CHARACTERISTIC /begin IN_MEASUREMENT /end IN_MEASUREMENT /begin OUT_MEASUREMENT /end OUT_MEASUREMENT /end FUNCTION
/begin FUNCTION Constant200 "" /begin DEF_CHARACTERISTIC /end DEF_CHARACTERISTIC /begin IN_MEASUREMENT /end IN_MEASUREMENT /begin OUT_MEASUREMENT /end OUT_MEASUREMENT /end FUNCTION
/begin FUNCTION Constant201 "" /begin DEF_CHARACTERISTIC /end DEF_CHARACTERISTIC /begin IN_MEASUREMENT /end IN_MEASUREMENT /begin OUT_MEASUREMENT /end OUT_MEASUREMENT /end FUNCTION
/begin FUNCTION Constant202 "" /begin DEF_CHARACTERISTIC /end DEF_CHARACTERISTIC /begin IN_MEASUREMENT /end IN_MEASUREMENT /begin OUT_MEASUREMENT /end OUT_MEASUREMENT /end FUNCTION
/begin FUNCTION Constant203 "" /begin DEF_CHARACTERISTIC /end DEF_CHARACTERISTIC /begin IN_MEASUREMENT /end IN_MEASUREMENT /begin OUT_MEASUREMENT /end OUT_MEASUREMENT /end FUNCTION
/begin FUNCTION Constant204 "" /begin DEF_CHARACTERISTIC /end DEF_CHARACTERISTIC /begin IN_MEASUREMENT /end IN_MEASUREMENT /begin OUT_MEASUREMENT /end OUT_MEASUREMENT /end FUNCTION
/begin FUNCTION Constant205 "" /begin DEF_CHARACTERISTIC /end DEF_CHARACTERISTIC /begin IN_MEASUREMENT /end IN_MEASUREMENT /begin OUT_MEASUREMENT /end OUT_MEASUREMENT /end FUNCTION
/begin FUNCTION Constant206 "" /begin DEF_CHARACTERISTIC /end DEF_CHARACTERISTIC /begin IN_MEASUREMENT /end IN_MEASUREMENT /begin OUT_MEASUREMENT /end OUT_MEASUREMENT /end FUNCTION
/begin FUNCTION Constant207 "" /begin DEF_CHARACTERISTIC /end DEF_CHARACTERISTIC /begin IN_MEASUREMENT /end IN_MEASUREMENT /begin OUT_MEASUREMENT /end OUT_MEASUREMENT /end FUNCTION
/begin FUNCTION Constant208 "" /begin DEF_CHARACTERISTIC /end DEF_CHARACTERISTIC /begin IN_MEASUREMENT /end IN_MEASUREMENT /begin OUT_MEASUREMENT /end OUT_MEASUREMENT /end FUNCTION
/begin FUNCTION Constant209 "" /begin DEF_CHARACTERISTIC /end DEF_CHARACTERISTIC /begin IN_MEASUREMENT /end IN_MEASUREMENT /begin OUT_MEASUREMENT /end OUT_MEASUREMENT /end FUNCTION
/begin FUNCTION Constant21 "" /begin DEF_CHARACTERISTIC DTC_100217 /end DEF_CHARACTERISTIC /begin IN_MEASUREMENT /end IN_MEASUREMENT /begin OUT_MEASUREMENT /end OUT_MEASUREMENT /end FUNCTION
/begin FUNCTION Constant210 "" /begin DEF_CHARACTERISTIC /end DEF_CHARACTERISTIC /begin IN_MEASUREMENT /end IN_MEASUREMENT /begin OUT_MEASUREMENT /end OUT_MEASUREMENT /end FUNCTION
/begin FUNCTION Constant211 "" /begin DEF_CHARACTERISTIC /end DEF_CHARACTERISTIC /begin IN_MEASUREMENT /end IN_MEASUREMENT /begin OUT_MEASUREMENT /end OUT_MEASUREMENT /end FUNCTION
/begin FUNCTION Constant212 "" /begin DEF_CHARACTERISTIC /end DEF_CHARACTERISTIC /begin IN_MEASUREMENT /end IN_MEASUREMENT /begin OUT_MEASUREMENT /end OUT_MEASUREMENT /end FUNCTION
/begin FUNCTION Constant213 "" /begin DEF_CHARACTERISTIC /end DEF_CHARACTERISTIC /begin IN_MEASUREMENT /end IN_MEASUREMENT /begin OUT_MEASUREMENT /end OUT_MEASUREMENT /end FUNCTION
/begin FUNCTION Constant214 "" /begin DEF_CHARACTERISTIC /end DEF_CHARACTERISTIC /begin IN_MEASUREMENT /end IN_MEASUREMENT /begin OUT_MEASUREMENT /end OUT_MEASUREMENT /end FUNCTION
/begin FUNCTION Constant215 "" /begin DEF_CHARACTERISTIC /end DEF_CHARACTERISTIC /begin IN_MEASUREMENT /end IN_MEASUREMENT /begin OUT_MEASUREMENT /end OUT_MEASUREMENT /end FUNCTION
/begin FUNCTION Constant216 "" /begin DEF_CHARACTERISTIC /end DEF_CHARACTERISTIC /begin IN_MEASUREMENT /end IN_MEASUREMENT /begin OUT_MEASUREMENT /end OUT_MEASUREMENT /end FUNCTION
/begin FUNCTION Constant217 "" /begin DEF_CHARACTERISTIC /end DEF_CHARACTERISTIC /begin IN_MEASUREMENT /end IN_MEASUREMENT /begin OUT_MEASUREMENT /end OUT_MEASUREMENT /end FUNCTION
/begin FUNCTION Constant218 "" /begin DEF_CHARACTERISTIC /end DEF_CHARACTERISTIC /begin IN_MEASUREMENT /end IN_MEASUREMENT /begin OUT_MEASUREMENT /end OUT_MEASUREMENT /end FUNCTION
/begin FUNCTION Constant219 "" /begin DEF_CHARACTERISTIC /end DEF_CHARACTERISTIC /begin IN_MEASUREMENT /end IN_MEASUREMENT /begin OUT_MEASUREMENT /end OUT_MEASUREMENT /end FUNCTION
/begin FUNCTION Constant22 "" /begin DEF_CHARACTERISTIC DTC_100218 /end DEF_CHARACTERISTIC /begin IN_MEASUREMENT /end IN_MEASUREMENT /begin OUT_MEASUREMENT /end OUT_MEASUREMENT /end FUNCTION
/begin FUNCTION Constant220 "" /begin DEF_CHARACTERISTIC /end DEF_CHARACTERISTIC /begin IN_MEASUREMENT /end IN_MEASUREMENT /begin OUT_MEASUREMENT /end OUT_MEASUREMENT /end FUNCTION
/begin FUNCTION Constant221 "" /begin DEF_CHARACTERISTIC /end DEF_CHARACTERISTIC /begin IN_MEASUREMENT /end IN_MEASUREMENT /begin OUT_MEASUREMENT /end OUT_MEASUREMENT /end FUNCTION
/begin FUNCTION Constant23 "" /begin DEF_CHARACTERISTIC DTC_100219 /end DEF_CHARACTERISTIC /begin IN_MEASUREMENT /end IN_MEASUREMENT /begin OUT_MEASUREMENT /end OUT_MEASUREMENT /end FUNCTION
/begin FUNCTION Constant24 "" /begin DEF_CHARACTERISTIC DTC_10021A /end DEF_CHARACTERISTIC /begin IN_MEASUREMENT /end IN_MEASUREMENT /begin OUT_MEASUREMENT /end OUT_MEASUREMENT /end FUNCTION
/begin FUNCTION Constant25 "" /begin DEF_CHARACTERISTIC DTC_10021B /end DEF_CHARACTERISTIC /begin IN_MEASUREMENT /end IN_MEASUREMENT /begin OUT_MEASUREMENT /end OUT_MEASUREMENT /end FUNCTION
/begin FUNCTION Constant26 "" /begin DEF_CHARACTERISTIC DTC_10021C /end DEF_CHARACTERISTIC /begin IN_MEASUREMENT /end IN_MEASUREMENT /begin OUT_MEASUREMENT /end OUT_MEASUREMENT /end FUNCTION
/begin FUNCTION Constant27 "" /begin DEF_CHARACTERISTIC DTC_10021D /end DEF_CHARACTERISTIC /begin IN_MEASUREMENT /end IN_MEASUREMENT /begin OUT_MEASUREMENT /end OUT_MEASUREMENT /end FUNCTION
/begin FUNCTION Constant28 "" /begin DEF_CHARACTERISTIC DTC_10021E /end DEF_CHARACTERISTIC /begin IN_MEASUREMENT /end IN_MEASUREMENT /begin OUT_MEASUREMENT /end OUT_MEASUREMENT /end FUNCTION
/begin FUNCTION Constant29 "" /begin DEF_CHARACTERISTIC DTC_90021F /end DEF_CHARACTERISTIC /begin IN_MEASUREMENT /end IN_MEASUREMENT /begin OUT_MEASUREMENT /end OUT_MEASUREMENT /end FUNCTION
/begin FUNCTION Constant3 "" /begin DEF_CHARACTERISTIC DTC_D00204 /end DEF_CHARACTERISTIC /begin IN_MEASUREMENT /end IN_MEASUREMENT /begin OUT_MEASUREMENT /end OUT_MEASUREMENT /end FUNCTION
/begin FUNCTION Constant30 "" /begin DEF_CHARACTERISTIC DTC_100220 /end DEF_CHARACTERISTIC /begin IN_MEASUREMENT /end IN_MEASUREMENT /begin OUT_MEASUREMENT /end OUT_MEASUREMENT /end FUNCTION
/begin FUNCTION Constant31 "" /begin DEF_CHARACTERISTIC DTC_100221 /end DEF_CHARACTERISTIC /begin IN_MEASUREMENT /end IN_MEASUREMENT /begin OUT_MEASUREMENT /end OUT_MEASUREMENT /end FUNCTION
/begin FUNCTION Constant32 "" /begin DEF_CHARACTERISTIC DTC_100223 /end DEF_CHARACTERISTIC /begin IN_MEASUREMENT /end IN_MEASUREMENT /begin OUT_MEASUREMENT /end OUT_MEASUREMENT /end FUNCTION
/begin FUNCTION Constant33 "" /begin DEF_CHARACTERISTIC DTC_100224 /end DEF_CHARACTERISTIC /begin IN_MEASUREMENT /end IN_MEASUREMENT /begin OUT_MEASUREMENT /end OUT_MEASUREMENT /end FUNCTION
/begin FUNCTION Constant34 "" /begin DEF_CHARACTERISTIC DTC_100225 /end DEF_CHARACTERISTIC /begin IN_MEASUREMENT /end IN_MEASUREMENT /begin OUT_MEASUREMENT /end OUT_MEASUREMENT /end FUNCTION
/begin FUNCTION Constant35 "" /begin DEF_CHARACTERISTIC DTC_100226 /end DEF_CHARACTERISTIC /begin IN_MEASUREMENT /end IN_MEASUREMENT /begin OUT_MEASUREMENT /end OUT_MEASUREMENT /end FUNCTION
/begin FUNCTION Constant36 "" /begin DEF_CHARACTERISTIC DTC_100227 /end DEF_CHARACTERISTIC /begin IN_MEASUREMENT /end IN_MEASUREMENT /begin OUT_MEASUREMENT /end OUT_MEASUREMENT /end FUNCTION
/begin FUNCTION Constant37 "" /begin DEF_CHARACTERISTIC DTC_D00228 /end DEF_CHARACTERISTIC /begin IN_MEASUREMENT /end IN_MEASUREMENT /begin OUT_MEASUREMENT /end OUT_MEASUREMENT /end FUNCTION
/begin FUNCTION Constant38 "" /begin DEF_CHARACTERISTIC DTC_D00229 /end DEF_CHARACTERISTIC /begin IN_MEASUREMENT /end IN_MEASUREMENT /begin OUT_MEASUREMENT /end OUT_MEASUREMENT /end FUNCTION
/begin FUNCTION Constant39 "" /begin DEF_CHARACTERISTIC DTC_D0022A /end DEF_CHARACTERISTIC /begin IN_MEASUREMENT /end IN_MEASUREMENT /begin OUT_MEASUREMENT /end OUT_MEASUREMENT /end FUNCTION
/begin FUNCTION Constant4 "" /begin DEF_CHARACTERISTIC DTC_D00205 /end DEF_CHARACTERISTIC /begin IN_MEASUREMENT /end IN_MEASUREMENT /begin OUT_MEASUREMENT /end OUT_MEASUREMENT /end FUNCTION
/begin FUNCTION Constant40 "" /begin DEF_CHARACTERISTIC DTC_D0022B /end DEF_CHARACTERISTIC /begin IN_MEASUREMENT /end IN_MEASUREMENT /begin OUT_MEASUREMENT /end OUT_MEASUREMENT /end FUNCTION
/begin FUNCTION Constant41 "" /begin DEF_CHARACTERISTIC DTC_D0022C /end DEF_CHARACTERISTIC /begin IN_MEASUREMENT /end IN_MEASUREMENT /begin OUT_MEASUREMENT /end OUT_MEASUREMENT /end FUNCTION
/begin FUNCTION Constant42 "" /begin DEF_CHARACTERISTIC DTC_D0022D /end DEF_CHARACTERISTIC /begin IN_MEASUREMENT /end IN_MEASUREMENT /begin OUT_MEASUREMENT /end OUT_MEASUREMENT /end FUNCTION
/begin FUNCTION Constant43 "" /begin DEF_CHARACTERISTIC DTC_90022F /end DEF_CHARACTERISTIC /begin IN_MEASUREMENT /end IN_MEASUREMENT /begin OUT_MEASUREMENT /end OUT_MEASUREMENT /end FUNCTION
/begin FUNCTION Constant44 "" /begin DEF_CHARACTERISTIC DTC_D00230 /end DEF_CHARACTERISTIC /begin IN_MEASUREMENT /end IN_MEASUREMENT /begin OUT_MEASUREMENT /end OUT_MEASUREMENT /end FUNCTION
/begin FUNCTION Constant45 "" /begin DEF_CHARACTERISTIC DTC_D00231 /end DEF_CHARACTERISTIC /begin IN_MEASUREMENT /end IN_MEASUREMENT /begin OUT_MEASUREMENT /end OUT_MEASUREMENT /end FUNCTION
/begin FUNCTION Constant46 "" /begin DEF_CHARACTERISTIC DTC_D00232 /end DEF_CHARACTERISTIC /begin IN_MEASUREMENT /end IN_MEASUREMENT /begin OUT_MEASUREMENT /end OUT_MEASUREMENT /end FUNCTION
/begin RECORD_LAYOUT Scalar_UWORD FNC_VALUES 1 UWORD COLUMN_DIR DIRECT /end RECORD_LAYOUT
/begin RECORD_LAYOUT Scalar_ULONG FNC_VALUES 1 ULONG COLUMN_DIR DIRECT /end RECORD_LAYOUT
/begin RECORD_LAYOUT Scalar_LONG FNC_VALUES 1 SLONG COLUMN_DIR DIRECT /end RECORD_LAYOUT
/begin CHARACTERISTIC DTC_01201C "" VALUE 0 Scalar_UWORD 0 SWC_HALOUT_type_CM_uint16 0 65535 /end CHARACTERISTIC
/begin CHARACTERISTIC DTC_02201C "" VALUE 0 Scalar_UWORD 0 SWC_HALOUT_type_CM_uint16 0 65535 /end CHARACTERISTIC
/begin CHARACTERISTIC DTC_036483 "" VALUE 0 Scalar_UWORD 0 SWC_HALOUT_type_CM_uint16 0 65535 /end CHARACTERISTIC
/begin CHARACTERISTIC DTC_036487 "" VALUE 0 Scalar_UWORD 0 SWC_HALOUT_type_CM_uint16 0 65535 /end CHARACTERISTIC
/begin CHARACTERISTIC DTC_03648C "" VALUE 0 Scalar_UWORD 0 SWC_HALOUT_type_CM_uint16 0 65535 /end CHARACTERISTIC
/begin CHARACTERISTIC DTC_0560A2 "" VALUE 0 Scalar_UWORD 0 SWC_HALOUT_type_CM_uint16 0 65535 /end CHARACTERISTIC
/begin CHARACTERISTIC DTC_0560A3 "" VALUE 0 Scalar_UWORD 0 SWC_HALOUT_type_CM_uint16 0 65535 /end CHARACTERISTIC
/begin CHARACTERISTIC DTC_085D83 "" VALUE 0 Scalar_UWORD 0 SWC_HALOUT_type_CM_uint16 0 65535 /end CHARACTERISTIC
/begin CHARACTERISTIC DTC_085D87 "" VALUE 0 Scalar_UWORD 0 SWC_HALOUT_type_CM_uint16 0 65535 /end CHARACTERISTIC
/begin CHARACTERISTIC DTC_085D8C "" VALUE 0 Scalar_UWORD 0 SWC_HALOUT_type_CM_uint16 0 65535 /end CHARACTERISTIC
/begin CHARACTERISTIC DTC_085D92 "" VALUE 0 Scalar_UWORD 0 SWC_HALOUT_type_CM_uint16 0 65535 /end CHARACTERISTIC
/begin CHARACTERISTIC DTC_0A1B92 "" VALUE 0 Scalar_UWORD 0 SWC_HALOUT_type_CM_uint16 0 65535 /end CHARACTERISTIC
/begin CHARACTERISTIC DTC_0A1C92 "" VALUE 0 Scalar_UWORD 0 SWC_HALOUT_type_CM_uint16 0 65535 /end CHARACTERISTIC
/begin CHARACTERISTIC DTC_0A9492 "" VALUE 0 Scalar_UWORD 0 SWC_HALOUT_type_CM_uint16 0 65535 /end CHARACTERISTIC
/begin CHARACTERISTIC DTC_0A9493 "" VALUE 0 Scalar_UWORD 0 SWC_HALOUT_type_CM_uint16 0 65535 /end CHARACTERISTIC
/begin CHARACTERISTIC DTC_0A9494 "" VALUE 0 Scalar_UWORD 0 SWC_HALOUT_type_CM_uint16 0 65535 /end CHARACTERISTIC
/begin CHARACTERISTIC DTC_0AE172 "" VALUE 0 Scalar_UWORD 0 SWC_HALOUT_type_CM_uint16 0 65535 /end CHARACTERISTIC
/begin CHARACTERISTIC DTC_0C1900 "" VALUE 0 Scalar_UWORD 0 SWC_HALOUT_type_CM_uint16 0 65535 /end CHARACTERISTIC
/begin CHARACTERISTIC DTC_0C1A00 "" VALUE 0 Scalar_UWORD 0 SWC_HALOUT_type_CM_uint16 0 65535 /end CHARACTERISTIC
/begin CHARACTERISTIC DTC_0E2D04 "" VALUE 0 Scalar_UWORD 0 SWC_HALOUT_type_CM_uint16 0 65535 /end CHARACTERISTIC
/begin CHARACTERISTIC DTC_0FC592 "" VALUE 0 Scalar_UWORD 0 SWC_HALOUT_type_CM_uint16 0 65535 /end CHARACTERISTIC
/begin CHARACTERISTIC DTC_10020B "" VALUE 0 Scalar_UWORD 0 SWC_HALOUT_type_CM_uint16 0 65535 /end CHARACTERISTIC
/begin CHARACTERISTIC DTC_10020C "" VALUE 0 Scalar_UWORD 0 SWC_HALOUT_type_CM_uint16 0 65535 /end CHARACTERISTIC
/begin CHARACTERISTIC DTC_10020D "" VALUE 0 Scalar_UWORD 0 SWC_HALOUT_type_CM_uint16 0 65535 /end CHARACTERISTIC
/begin CHARACTERISTIC DTC_10020E "" VALUE 0 Scalar_UWORD 0 SWC_HALOUT_type_CM_uint16 0 65535 /end CHARACTERISTIC
/begin CHARACTERISTIC DTC_100210 "" VALUE 0 Scalar_UWORD 0 SWC_HALOUT_type_CM_uint16 0 65535 /end CHARACTERISTIC
/begin CHARACTERISTIC DTC_100211 "" VALUE 0 Scalar_UWORD 0 SWC_HALOUT_type_CM_uint16 0 65535 /end CHARACTERISTIC
/begin CHARACTERISTIC DTC_100212 "" VALUE 0 Scalar_UWORD 0 SWC_HALOUT_type_CM_uint16 0 65535 /end CHARACTERISTIC
/begin CHARACTERISTIC DTC_100213 "" VALUE 0 Scalar_UWORD 0 SWC_HALOUT_type_CM_uint16 0 65535 /end CHARACTERISTIC
/begin CHARACTERISTIC DTC_100214 "" VALUE 0 Scalar_UWORD 0 SWC_HALOUT_type_CM_uint16 0 65535 /end CHARACTERISTIC
/begin CHARACTERISTIC DTC_100215 "" VALUE 0 Scalar_UWORD 0 SWC_HALOUT_type_CM_uint16 0 65535 /end CHARACTERISTIC
/begin CHARACTERISTIC DTC_100216 "" VALUE 0 Scalar_UWORD 0 SWC_HALOUT_type_CM_uint16 0 65535 /end CHARACTERISTIC
/begin CHARACTERISTIC DTC_100217 "" VALUE 0 Scalar_UWORD 0 SWC_HALOUT_type_CM_uint16 0 65535 /end CHARACTERISTIC
/begin CHARACTERISTIC DTC_100218 "" VALUE 0 Scalar_UWORD 0 SWC_HALOUT_type_CM_uint16 0 65535 /end CHARACTERISTIC
/begin CHARACTERISTIC DTC_100219 "" VALUE 0 Scalar_UWORD 0 SWC_HALOUT_type_CM_uint16 0 65535 /end CHARACTERISTIC
/begin CHARACTERISTIC DTC_10021A "" VALUE 0 Scalar_UWORD 0 SWC_HALOUT_type_CM_uint16 0 65535 /end CHARACTERISTIC
/begin CHARACTERISTIC DTC_10021B "" VALUE 0 Scalar_UWORD 0 SWC_HALOUT_type_CM_uint16 0 65535 /end CHARACTERISTIC
/begin CHARACTERISTIC DTC_10021C "" VALUE 0 Scalar_UWORD 0 SWC_HALOUT_type_CM_uint16 0 65535 /end CHARACTERISTIC
/begin CHARACTERISTIC DTC_10021D "" VALUE 0 Scalar_UWORD 0 SWC_HALOUT_type_CM_uint16 0 65535 /end CHARACTERISTIC
/begin CHARACTERISTIC DTC_10021E "" VALUE 0 Scalar_UWORD 0 SWC_HALOUT_type_CM_uint16 0 65535 /end CHARACTERISTIC
/begin CHARACTERISTIC DTC_100220 "" VALUE 0 Scalar_UWORD 0 SWC_HALOUT_type_CM_uint16 0 65535 /end CHARACTERISTIC
/begin CHARACTERISTIC DTC_100221 "" VALUE 0 Scalar_UWORD 0 SWC_HALOUT_type_CM_uint16 0 65535 /end CHARACTERISTIC
/begin CHARACTERISTIC DTC_100223 "" VALUE 0 Scalar_UWORD 0 SWC_HALOUT_type_CM_uint16 0 65535 /end CHARACTERISTIC
/begin CHARACTERISTIC DTC_100224 "" VALUE 0 Scalar_UWORD 0 SWC_HALOUT_type_CM_uint16 0 65535 /end CHARACTERISTIC
/begin CHARACTERISTIC DTC_100225 "" VALUE 0 Scalar_UWORD 0 SWC_HALOUT_type_CM_uint16 0 65535 /end CHARACTERISTIC
/begin CHARACTERISTIC DTC_100226 "" VALUE 0 Scalar_UWORD 0 SWC_HALOUT_type_CM_uint16 0 65535 /end CHARACTERISTIC
/begin CHARACTERISTIC DTC_100227 "" VALUE 0 Scalar_UWORD 0 SWC_HALOUT_type_CM_uint16 0 65535 /end CHARACTERISTIC
/begin CHARACTERISTIC DTC_100A10 "" VALUE 0 Scalar_UWORD 0 SWC_HALOUT_type_CM_uint16 0 65535 /end CHARACTERISTIC
/begin CHARACTERISTIC DTC_100A12 "" VALUE 0 Scalar_UWORD 0 SWC_HALOUT_type_CM_uint16 0 65535 /end CHARACTERISTIC
/begin CHARACTERISTIC DTC_100A16 "" VALUE 0 Scalar_UWORD 0 SWC_HALOUT_type_CM_uint16 0 65535 /end CHARACTERISTIC
/begin CHARACTERISTIC DTC_100A17 "" VALUE 0 Scalar_UWORD 0 SWC_HALOUT_type_CM_uint16 0 65535 /end CHARACTERISTIC
/begin CHARACTERISTIC DTC_100A18 "" VALUE 0 Scalar_UWORD 0 SWC_HALOUT_type_CM_uint16 0 65535 /end CHARACTERISTIC
/begin CHARACTERISTIC DTC_100A19 "" VALUE 0 Scalar_UWORD 0 SWC_HALOUT_type_CM_uint16 0 65535 /end CHARACTERISTIC
/begin CHARACTERISTIC DTC_210900 "" VALUE 0 Scalar_UWORD 0 SWC_HALOUT_type_CM_uint16 0 65535 /end CHARACTERISTIC
/begin CHARACTERISTIC DTC_211300 "" VALUE 0 Scalar_UWORD 0 SWC_HALOUT_type_CM_uint16 0 65535 /end CHARACTERISTIC
/begin CHARACTERISTIC DTC_213500 "" VALUE 0 Scalar_UWORD 0 SWC_HALOUT_type_CM_uint16 0 65535 /end CHARACTERISTIC
/begin CHARACTERISTIC DTC_216300 "" VALUE 0 Scalar_UWORD 0 SWC_HALOUT_type_CM_uint16 0 65535 /end CHARACTERISTIC
/begin CHARACTERISTIC DTC_216400 "" VALUE 0 Scalar_UWORD 0 SWC_HALOUT_type_CM_uint16 0 65535 /end CHARACTERISTIC
/begin CHARACTERISTIC DTC_254F01 "" VALUE 0 Scalar_UWORD 0 SWC_HALOUT_type_CM_uint16 0 65535 /end CHARACTERISTIC
/begin CHARACTERISTIC DTC_2F8F63 "" VALUE 0 Scalar_UWORD 0 SWC_HALOUT_type_CM_uint16 0 65535 /end CHARACTERISTIC
/begin CHARACTERISTIC DTC_2F9063 "" VALUE 0 Scalar_UWORD 0 SWC_HALOUT_type_CM_uint16 0 65535 /end CHARACTERISTIC
/begin CHARACTERISTIC DTC_2FF573 "" VALUE 0 Scalar_UWORD 0 SWC_HALOUT_type_CM_uint16 0 65535 /end CHARACTERISTIC
/begin CHARACTERISTIC DTC_343A01 "" VALUE 0 Scalar_UWORD 0 SWC_HALOUT_type_CM_uint16 0 65535 /end CHARACTERISTIC
/begin CHARACTERISTIC DTC_404001 "" VALUE 0 Scalar_UWORD 0 SWC_HALOUT_type_CM_uint16 0 65535 /end CHARACTERISTIC
/begin CHARACTERISTIC DTC_407700 "" VALUE 0 Scalar_UWORD 0 SWC_HALOUT_type_CM_uint16 0 65535 /end CHARACTERISTIC
/begin CHARACTERISTIC DTC_45D683 "" VALUE 0 Scalar_UWORD 0 SWC_HALOUT_type_CM_uint16 0 65535 /end CHARACTERISTIC
/begin CHARACTERISTIC DTC_45D687 "" VALUE 0 Scalar_UWORD 0 SWC_HALOUT_type_CM_uint16 0 65535 /end CHARACTERISTIC
/begin CHARACTERISTIC DTC_45D68C "" VALUE 0 Scalar_UWORD 0 SWC_HALOUT_type_CM_uint16 0 65535 /end CHARACTERISTIC
/begin CHARACTERISTIC DTC_45D692 "" VALUE 0 Scalar_UWORD 0 SWC_HALOUT_type_CM_uint16 0 65535 /end CHARACTERISTIC
/begin CHARACTERISTIC DTC_460B7E "" VALUE 0 Scalar_UWORD 0 SWC_HALOUT_type_CM_uint16 0 65535 /end CHARACTERISTIC
/begin CHARACTERISTIC DTC_460B7F "" VALUE 0 Scalar_UWORD 0 SWC_HALOUT_type_CM_uint16 0 65535 /end CHARACTERISTIC
/begin CHARACTERISTIC DTC_46107E "" VALUE 0 Scalar_UWORD 0 SWC_HALOUT_type_CM_uint16 0 65535 /end CHARACTERISTIC
/begin CHARACTERISTIC DTC_46107F "" VALUE 0 Scalar_UWORD 0 SWC_HALOUT_type_CM_uint16 0 65535 /end CHARACTERISTIC
/begin CHARACTERISTIC DTC_461592 "" VALUE 0 Scalar_UWORD 0 SWC_HALOUT_type_CM_uint16 0 65535 /end CHARACTERISTIC
/begin CHARACTERISTIC DTC_80B701 "" VALUE 0 Scalar_UWORD 0 SWC_HALOUT_type_CM_uint16 0 65535 /end CHARACTERISTIC
/begin CHARACTERISTIC DTC_820083 "" VALUE 0 Scalar_UWORD 0 SWC_HALOUT_type_CM_uint16 0 65535 /end CHARACTERISTIC
/begin CHARACTERISTIC DTC_820087 "" VALUE 0 Scalar_UWORD 0 SWC_HALOUT_type_CM_uint16 0 65535 /end CHARACTERISTIC
/begin CHARACTERISTIC DTC_82008C "" VALUE 0 Scalar_UWORD 0 SWC_HALOUT_type_CM_uint16 0 65535 /end CHARACTERISTIC
/begin CHARACTERISTIC DTC_90021F "" VALUE 0 Scalar_UWORD 0 SWC_HALOUT_type_CM_uint16 0 65535 /end CHARACTERISTIC
/begin CHARACTERISTIC DTC_90022F "" VALUE 0 Scalar_UWORD 0 SWC_HALOUT_type_CM_uint16 0 65535 /end CHARACTERISTIC
/begin CHARACTERISTIC DTC_900253 "" VALUE 0 Scalar_UWORD 0 SWC_HALOUT_type_CM_uint16 0 65535 /end CHARACTERISTIC
/begin CHARACTERISTIC DTC_900254 "" VALUE 0 Scalar_UWORD 0 SWC_HALOUT_type_CM_uint16 0 65535 /end CHARACTERISTIC
/begin CHARACTERISTIC DTC_900305 "" VALUE 0 Scalar_UWORD 0 SWC_HALOUT_type_CM_uint16 0 65535 /end CHARACTERISTIC
/begin CHARACTERISTIC DTC_C02888 "" VALUE 0 Scalar_UWORD 0 SWC_HALOUT_type_CM_uint16 0 65535 /end CHARACTERISTIC
/begin CHARACTERISTIC DTC_C03788 "" VALUE 0 Scalar_UWORD 0 SWC_HALOUT_type_CM_uint16 0 65535 /end CHARACTERISTIC
/begin CHARACTERISTIC DTC_C04688 "" VALUE 0 Scalar_UWORD 0 SWC_HALOUT_type_CM_uint16 0 65535 /end CHARACTERISTIC
/begin CHARACTERISTIC DTC_C05588 "" VALUE 0 Scalar_UWORD 0 SWC_HALOUT_type_CM_uint16 0 65535 /end CHARACTERISTIC
/begin CHARACTERISTIC DTC_C06488 "" VALUE 0 Scalar_UWORD 0 SWC_HALOUT_type_CM_uint16 0 65535 /end CHARACTERISTIC
/begin CHARACTERISTIC DTC_C08088 "" VALUE 0 Scalar_UWORD 0 SWC_HALOUT_type_CM_uint16 0 65535 /end CHARACTERISTIC
/begin CHARACTERISTIC DTC_C08988 "" VALUE 0 Scalar_UWORD 0 SWC_HALOUT_type_CM_uint16 0 65535 /end CHARACTERISTIC
/begin CHARACTERISTIC DTC_C0E101 "" VALUE 0 Scalar_UWORD 0 SWC_HALOUT_type_CM_uint16 0 65535 /end CHARACTERISTIC
/begin CHARACTERISTIC DTC_C0E301 "" VALUE 0 Scalar_UWORD 0 SWC_HALOUT_type_CM_uint16 0 65535 /end CHARACTERISTIC
/begin CHARACTERISTIC DTC_C0EA8C "" VALUE 0 Scalar_UWORD 0 SWC_HALOUT_type_CM_uint16 0 65535 /end CHARACTERISTIC
/begin CHARACTERISTIC DTC_C0EB8C "" VALUE 0 Scalar_UWORD 0 SWC_HALOUT_type_CM_uint16 0 65535 /end CHARACTERISTIC
/begin CHARACTERISTIC DTC_C1EB81 "" VALUE 0 Scalar_UWORD 0 SWC_HALOUT_type_CM_uint16 0 65535 /end CHARACTERISTIC
/begin CHARACTERISTIC DTC_C71501 "" VALUE 0 Scalar_UWORD 0 SWC_HALOUT_type_CM_uint16 0 65535 /end CHARACTERISTIC
/begin CHARACTERISTIC DTC_C71601 "" VALUE 0 Scalar_UWORD 0 SWC_HALOUT_type_CM_uint16 0 65535 /end CHARACTERISTIC
/begin CHARACTERISTIC DTC_C71701 "" VALUE 0 Scalar_UWORD 0 SWC_HALOUT_type_CM_uint16 0 65535 /end CHARACTERISTIC
/begin CHARACTERISTIC DTC_C71801 "" VALUE 0 Scalar_UWORD 0 SWC_HALOUT_type_CM_uint16 0 65535 /end CHARACTERISTIC
/begin CHARACTERISTIC DTC_C79283 "" VALUE 0 Scalar_UWORD 0 SWC_HALOUT_type_CM_uint16 0 65535 /end CHARACTERISTIC
/begin CHARACTERISTIC DTC_C79287 "" VALUE 0 Scalar_UWORD 0 SWC_HALOUT_type_CM_uint16 0 65535 /end CHARACTERISTIC
/begin CHARACTERISTIC DTC_C7928C "" VALUE 0 Scalar_UWORD 0 SWC_HALOUT_type_CM_uint16 0 65535 /end CHARACTERISTIC
/begin CHARACTERISTIC DTC_C79683 "" VALUE 0 Scalar_UWORD 0 SWC_HALOUT_type_CM_uint16 0 65535 /end CHARACTERISTIC
/begin CHARACTERISTIC DTC_C79687 "" VALUE 0 Scalar_UWORD 0 SWC_HALOUT_type_CM_uint16 0 65535 /end CHARACTERISTIC
/begin CHARACTERISTIC DTC_C7968C "" VALUE 0 Scalar_UWORD 0 SWC_HALOUT_type_CM_uint16 0 65535 /end CHARACTERISTIC
/begin CHARACTERISTIC DTC_C79801 "" VALUE 0 Scalar_UWORD 0 SWC_HALOUT_type_CM_uint16 0 65535 /end CHARACTERISTIC
/begin CHARACTERISTIC DTC_C79883 "" VALUE 0 Scalar_UWORD 0 SWC_HALOUT_type_CM_uint16 0 65535 /end CHARACTERISTIC
/begin CHARACTERISTIC DTC_C79887 "" VALUE 0 Scalar_UWORD 0 SWC_HALOUT_type_CM_uint16 0 65535 /end CHARACTERISTIC
/begin CHARACTERISTIC DTC_C7988C "" VALUE 0 Scalar_UWORD 0 SWC_HALOUT_type_CM_uint16 0 65535 /end CHARACTERISTIC
/begin CHARACTERISTIC DTC_C81083 "" VALUE 0 Scalar_UWORD 0 SWC_HALOUT_type_CM_uint16 0 65535 /end CHARACTERISTIC
/begin CHARACTERISTIC DTC_C81087 "" VALUE 0 Scalar_UWORD 0 SWC_HALOUT_type_CM_uint16 0 65535 /end CHARACTERISTIC
/begin CHARACTERISTIC DTC_C8108C "" VALUE 0 Scalar_UWORD 0 SWC_HALOUT_type_CM_uint16 0 65535 /end CHARACTERISTIC
/begin CHARACTERISTIC DTC_C82283 "" VALUE 0 Scalar_UWORD 0 SWC_HALOUT_type_CM_uint16 0 65535 /end CHARACTERISTIC
/begin CHARACTERISTIC DTC_C82287 "" VALUE 0 Scalar_UWORD 0 SWC_HALOUT_type_CM_uint16 0 65535 /end CHARACTERISTIC
/begin CHARACTERISTIC DTC_C8228C "" VALUE 0 Scalar_UWORD 0 SWC_HALOUT_type_CM_uint16 0 65535 /end CHARACTERISTIC
/begin CHARACTERISTIC DTC_C82292 "" VALUE 0 Scalar_UWORD 0 SWC_HALOUT_type_CM_uint16 0 65535 /end CHARACTERISTIC
/begin CHARACTERISTIC DTC_C8278C "" VALUE 0 Scalar_UWORD 0 SWC_HALOUT_type_CM_uint16 0 65535 /end CHARACTERISTIC
/begin CHARACTERISTIC DTC_C82883 "" VALUE 0 Scalar_UWORD 0 SWC_HALOUT_type_CM_uint16 0 65535 /end CHARACTERISTIC
/begin CHARACTERISTIC DTC_C82887 "" VALUE 0 Scalar_UWORD 0 SWC_HALOUT_type_CM_uint16 0 65535 /end CHARACTERISTIC
/begin CHARACTERISTIC DTC_C8288C "" VALUE 0 Scalar_UWORD 0 SWC_HALOUT_type_CM_uint16 0 65535 /end CHARACTERISTIC
/begin CHARACTERISTIC DTC_C8BF04 "" VALUE 0 Scalar_UWORD 0 SWC_HALOUT_type_CM_uint16 0 65535 /end CHARACTERISTIC
/begin CHARACTERISTIC DTC_C8BF83 "" VALUE 0 Scalar_UWORD 0 SWC_HALOUT_type_CM_uint16 0 65535 /end CHARACTERISTIC
/begin CHARACTERISTIC DTC_C8BF87 "" VALUE 0 Scalar_UWORD 0 SWC_HALOUT_type_CM_uint16 0 65535 /end CHARACTERISTIC
/begin CHARACTERISTIC DTC_C8BF8C "" VALUE 0 Scalar_UWORD 0 SWC_HALOUT_type_CM_uint16 0 65535 /end CHARACTERISTIC
/begin CHARACTERISTIC DTC_C8BF92 "" VALUE 0 Scalar_UWORD 0 SWC_HALOUT_type_CM_uint16 0 65535 /end CHARACTERISTIC
/begin CHARACTERISTIC DTC_D00201 "" VALUE 0 Scalar_UWORD 0 SWC_HALOUT_type_CM_uint16 0 65535 /end CHARACTERISTIC
/begin CHARACTERISTIC DTC_D00202 "" VALUE 0 Scalar_UWORD 0 SWC_HALOUT_type_CM_uint16 0 65535 /end CHARACTERISTIC
/begin CHARACTERISTIC DTC_D00203 "" VALUE 0 Scalar_UWORD 0 SWC_HALOUT_type_CM_uint16 0 65535 /end CHARACTERISTIC
/begin CHARACTERISTIC DTC_D00204 "" VALUE 0 Scalar_UWORD 0 SWC_HALOUT_type_CM_uint16 0 65535 /end CHARACTERISTIC
/begin CHARACTERISTIC DTC_D00205 "" VALUE 0 Scalar_UWORD 0 SWC_HALOUT_type_CM_uint16 0 65535 /end CHARACTERISTIC
/begin CHARACTERISTIC DTC_D00228 "" VALUE 0 Scalar_UWORD 0 SWC_HALOUT_type_CM_uint16 0 65535 /end CHARACTERISTIC
/begin CHARACTERISTIC DTC_D00229 "" VALUE 0 Scalar_UWORD 0 SWC_HALOUT_type_CM_uint16 0 65535 /end CHARACTERISTIC
/begin CHARACTERISTIC DTC_D0022A "" VALUE 0 Scalar_UWORD 0 SWC_HALOUT_type_CM_uint16 0 65535 /end CHARACTERISTIC
/begin CHARACTERISTIC DTC_D0022B "" VALUE 0 Scalar_UWORD 0 SWC_HALOUT_type_CM_uint16 0 65535 /end CHARACTERISTIC
/begin CHARACTERISTIC DTC_D0022C "" VALUE 0 Scalar_UWORD 0 SWC_HALOUT_type_CM_uint16 0 65535 /end CHARACTERISTIC
/begin CHARACTERISTIC DTC_D0022D "" VALUE 0 Scalar_UWORD 0 SWC_HALOUT_type_CM_uint16 0 65535 /end CHARACTERISTIC
/begin CHARACTERISTIC DTC_D00230 "" VALUE 0 Scalar_UWORD 0 SWC_HALOUT_type_CM_uint16 0 65535 /end CHARACTERISTIC
/begin CHARACTERISTIC DTC_D00231 "" VALUE 0 Scalar_UWORD 0 SWC_HALOUT_type_CM_uint16 0 65535 /end CHARACTERISTIC
/begin CHARACTERISTIC DTC_D00232 "" VALUE 0 Scalar_UWORD 0 SWC_HALOUT_type_CM_uint16 0 65535 /end CHARACTERISTIC
/begin CHARACTERISTIC DTC_F003A2 "" VALUE 0 Scalar_UWORD 0 SWC_HALOUT_type_CM_uint16 0 65535 /end CHARACTERISTIC
/begin COMPU_METHOD SWC_HALOUT_type_CM_uint16 "Q = V" RAT_FUNC "%5.0" "" COEFFS 0 1 0 0 0 1 /end COMPU_METHOD
/begin GROUP S20_DTC_list "SWC_HALOUT_type/run_SWC_HALOUT_Tx_5ms_sys/OUTP_AFTER/DTC_list"
 /begin REF_CHARACTERISTIC DTC_01201C DTC_02201C DTC_036483 DTC_036487 DTC_03648C DTC_0560A2 DTC_0560A3 DTC_085D83 DTC_085D87 DTC_085D8C DTC_085D92 DTC_0A1B92 DTC_0A1C92 DTC_0A9492 DTC_0A9493 DTC_0A9494 DTC_0AE172 DTC_0C1900 DTC_0C1A00 DTC_0E2D04 DTC_0FC592 DTC_10020B DTC_10020C DTC_10020D DTC_10020E DTC_100210 DTC_100211 DTC_100212 DTC_100213 DTC_100214 DTC_100215 DTC_100216 DTC_100217 DTC_100218 DTC_100219 DTC_10021A DTC_10021B DTC_10021C DTC_10021D DTC_10021E DTC_100220 DTC_100221 DTC_100223 DTC_100224 DTC_100225 DTC_100226 DTC_100227 DTC_100A10 DTC_100A12 DTC_100A16 DTC_100A17 DTC_100A18 DTC_100A19 DTC_210900 DTC_211300 DTC_213500 DTC_216300 DTC_216400 DTC_254F01 DTC_2F8F63 DTC_2F9063 DTC_2FF573 DTC_343A01 DTC_404001 DTC_407700 DTC_45D683 DTC_45D687 DTC_45D68C DTC_45D692 DTC_460B7E DTC_460B7F DTC_46107E DTC_46107F DTC_461592 DTC_80B701 DTC_820083 DTC_820087 DTC_82008C DTC_90021F DTC_90022F DTC_900253 DTC_900254 DTC_900305 DTC_C02888 DTC_C03788 DTC_C04688 DTC_C05588 DTC_C06488 DTC_C08088 DTC_C08988 DTC_C0E101 DTC_C0E301 DTC_C0EA8C DTC_C0EB8C DTC_C1EB81 DTC_C71501 DTC_C71601 DTC_C71701 DTC_C71801 DTC_C79283 DTC_C79287 DTC_C7928C DTC_C79683 DTC_C79687 DTC_C7968C DTC_C79801 DTC_C79883 DTC_C79887 DTC_C7988C DTC_C81083 DTC_C81087 DTC_C8108C DTC_C82283 DTC_C82287 DTC_C8228C DTC_C82292 DTC_C8278C DTC_C82883 DTC_C82887 DTC_C8288C DTC_C8BF04 DTC_C8BF83 DTC_C8BF87 DTC_C8BF8C DTC_C8BF92 DTC_D00201 DTC_D00202 DTC_D00203 DTC_D00204 DTC_D00205 DTC_D00228 DTC_D00229 DTC_D0022A DTC_D0022B DTC_D0022C DTC_D0022D DTC_D00230 DTC_D00231 DTC_D00232 DTC_F003A2 /end REF_CHARACTERISTIC
/end GROUP
/end MODULE
/end PROJECT
