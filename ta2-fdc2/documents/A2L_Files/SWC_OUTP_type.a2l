ASAP2_VERSION 1 31
/begin PROJECT ProjectName "Project Comment Goes Here"
/begin HEADER "Header Comments go here" /end HEADER
/begin MODULE ModuleName "Module Comment Goes Here"
/begin MOD_COMMON "Mod Common Comment Here" BYTE_ORDER MSB_LAST /end MOD_COMMON
/begin RECORD_LAYOUT Scalar_BOOLEAN FNC_VALUES 1 UBYTE COLUMN_DIR DIRECT /end RECORD_LAYOUT
/begin RECORD_LAYOUT Scalar_UBYTE FNC_VALUES 1 UBYTE COLUMN_DIR DIRECT /end RECORD_LAYOUT
/begin RECORD_LAYOUT Scalar_FLOAT32_IEEE FNC_VALUES 1 FLOAT32_IEEE COLUMN_DIR DIRECT /end RECORD_LAYOUT
/begin RECORD_LAYOUT Lookup1D_ULONG FNC_VALUES 1 ULONG COLUMN_DIR DIRECT /end RECORD_LAYOUT
/begin RECORD_LAYOUT Lookup1D_X_ULONG AXIS_PTS_X 1 ULONG INDEX_INCR DIRECT /end RECORD_LAYOUT
/begin RECORD_LAYOUT Lookup1D_SLONG FNC_VALUES 1 SLONG COLUMN_DIR DIRECT /end RECORD_LAYOUT
/begin RECORD_LAYOUT Lookup1D_X_LONG AXIS_PTS_X 1 SLONG INDEX_INCR DIRECT /end RECORD_LAYOUT
/begin CHARACTERISTIC KOUTP_GRADE_Deg_maxval "" VALUE 0x0000 /* @ECU_Address@KOUTP_GRADE_Deg_maxval@ */ Scalar_FLOAT32_IEEE 0 SWC_OUTP_type_CM_single_Deg -65535.0 65535.0 /end CHARACTERISTIC
/begin CHARACTERISTIC KOUTP_GRADE_Deg_minval "" VALUE 0x0000 /* @ECU_Address@KOUTP_GRADE_Deg_minval@ */ Scalar_FLOAT32_IEEE 0 SWC_OUTP_type_CM_single_Deg -65535.0 65535.0 /end CHARACTERISTIC
/begin CHARACTERISTIC KOUTP_GRADE_Deg_ovrdval "" VALUE 0x0000 /* @ECU_Address@KOUTP_GRADE_Deg_ovrdval@ */ Scalar_FLOAT32_IEEE 0 SWC_OUTP_type_CM_single_Deg -65535.0 65535.0 /end CHARACTERISTIC
/begin CHARACTERISTIC KOUTP_LFRawWhlSpeed_kph_maxval "" VALUE 0x0000 /* @ECU_Address@KOUTP_LFRawWhlSpeed_kph_maxval@ */ Scalar_FLOAT32_IEEE 0 SWC_OUTP_type_CM_single_kph -65535.0 65535.0 /end CHARACTERISTIC
/begin CHARACTERISTIC KOUTP_LFRawWhlSpeed_kph_minval "" VALUE 0x0000 /* @ECU_Address@KOUTP_LFRawWhlSpeed_kph_minval@ */ Scalar_FLOAT32_IEEE 0 SWC_OUTP_type_CM_single_kph -65535.0 65535.0 /end CHARACTERISTIC
/begin CHARACTERISTIC KOUTP_LFRawWhlSpeed_kph_ovrdval "" VALUE 0x0000 /* @ECU_Address@KOUTP_LFRawWhlSpeed_kph_ovrdval@ */ Scalar_FLOAT32_IEEE 0 SWC_OUTP_type_CM_single_kph -65535.0 65535.0 /end CHARACTERISTIC
/begin CHARACTERISTIC KOUTP_LRRawWhlSpeed_kph_maxval "" VALUE 0x0000 /* @ECU_Address@KOUTP_LRRawWhlSpeed_kph_maxval@ */ Scalar_FLOAT32_IEEE 0 SWC_OUTP_type_CM_single_kph -65535.0 65535.0 /end CHARACTERISTIC
/begin CHARACTERISTIC KOUTP_LRRawWhlSpeed_kph_minval "" VALUE 0x0000 /* @ECU_Address@KOUTP_LRRawWhlSpeed_kph_minval@ */ Scalar_FLOAT32_IEEE 0 SWC_OUTP_type_CM_single_kph -65535.0 65535.0 /end CHARACTERISTIC
/begin CHARACTERISTIC KOUTP_LRRawWhlSpeed_kph_ovrdval "" VALUE 0x0000 /* @ECU_Address@KOUTP_LRRawWhlSpeed_kph_ovrdval@ */ Scalar_FLOAT32_IEEE 0 SWC_OUTP_type_CM_single_kph -65535.0 65535.0 /end CHARACTERISTIC
/begin CHARACTERISTIC KOUTP_LatAccel_Gps_maxval "" VALUE 0x0000 /* @ECU_Address@KOUTP_LatAccel_Gps_maxval@ */ Scalar_FLOAT32_IEEE 0 SWC_OUTP_type_CM_single_Gps -65535.0 65535.0 /end CHARACTERISTIC
/begin CHARACTERISTIC KOUTP_LatAccel_Gps_minval "" VALUE 0x0000 /* @ECU_Address@KOUTP_LatAccel_Gps_minval@ */ Scalar_FLOAT32_IEEE 0 SWC_OUTP_type_CM_single_Gps -65535.0 65535.0 /end CHARACTERISTIC
/begin CHARACTERISTIC KOUTP_LatAccel_Gps_ovrdval "" VALUE 0x0000 /* @ECU_Address@KOUTP_LatAccel_Gps_ovrdval@ */ Scalar_FLOAT32_IEEE 0 SWC_OUTP_type_CM_single_Gps -65535.0 65535.0 /end CHARACTERISTIC
/begin CHARACTERISTIC KOUTP_LongAccel_Gps_maxval "" VALUE 0x0000 /* @ECU_Address@KOUTP_LongAccel_Gps_maxval@ */ Scalar_FLOAT32_IEEE 0 SWC_OUTP_type_CM_single_Gps -65535.0 65535.0 /end CHARACTERISTIC
/begin CHARACTERISTIC KOUTP_LongAccel_Gps_minval "" VALUE 0x0000 /* @ECU_Address@KOUTP_LongAccel_Gps_minval@ */ Scalar_FLOAT32_IEEE 0 SWC_OUTP_type_CM_single_Gps -65535.0 65535.0 /end CHARACTERISTIC
/begin CHARACTERISTIC KOUTP_LongAccel_Gps_ovrdval "" VALUE 0x0000 /* @ECU_Address@KOUTP_LongAccel_Gps_ovrdval@ */ Scalar_FLOAT32_IEEE 0 SWC_OUTP_type_CM_single_Gps -65535.0 65535.0 /end CHARACTERISTIC
/begin CHARACTERISTIC KOUTP_MCPressure_bar_maxval "" VALUE 0x0000 /* @ECU_Address@KOUTP_MCPressure_bar_maxval@ */ Scalar_FLOAT32_IEEE 0 SWC_OUTP_type_CM_single_bar -65535.0 65535.0 /end CHARACTERISTIC
/begin CHARACTERISTIC KOUTP_MCPressure_bar_minval "" VALUE 0x0000 /* @ECU_Address@KOUTP_MCPressure_bar_minval@ */ Scalar_FLOAT32_IEEE 0 SWC_OUTP_type_CM_single_bar -65535.0 65535.0 /end CHARACTERISTIC
/begin CHARACTERISTIC KOUTP_MCPressure_bar_ovrdval "" VALUE 0x0000 /* @ECU_Address@KOUTP_MCPressure_bar_ovrdval@ */ Scalar_FLOAT32_IEEE 0 SWC_OUTP_type_CM_single_bar -65535.0 65535.0 /end CHARACTERISTIC
/begin CHARACTERISTIC KOUTP_RFRawWhlSpeed_kph_maxval "" VALUE 0x0000 /* @ECU_Address@KOUTP_RFRawWhlSpeed_kph_maxval@ */ Scalar_FLOAT32_IEEE 0 SWC_OUTP_type_CM_single_kph -65535.0 65535.0 /end CHARACTERISTIC
/begin CHARACTERISTIC KOUTP_RFRawWhlSpeed_kph_minval "" VALUE 0x0000 /* @ECU_Address@KOUTP_RFRawWhlSpeed_kph_minval@ */ Scalar_FLOAT32_IEEE 0 SWC_OUTP_type_CM_single_kph -65535.0 65535.0 /end CHARACTERISTIC
/begin CHARACTERISTIC KOUTP_RFRawWhlSpeed_kph_ovrdval "" VALUE 0x0000 /* @ECU_Address@KOUTP_RFRawWhlSpeed_kph_ovrdval@ */ Scalar_FLOAT32_IEEE 0 SWC_OUTP_type_CM_single_kph -65535.0 65535.0 /end CHARACTERISTIC
/begin CHARACTERISTIC KOUTP_RRRawWhlSpeed_kph_maxval "" VALUE 0x0000 /* @ECU_Address@KOUTP_RRRawWhlSpeed_kph_maxval@ */ Scalar_FLOAT32_IEEE 0 SWC_OUTP_type_CM_single_kph -65535.0 65535.0 /end CHARACTERISTIC
/begin CHARACTERISTIC KOUTP_RRRawWhlSpeed_kph_minval "" VALUE 0x0000 /* @ECU_Address@KOUTP_RRRawWhlSpeed_kph_minval@ */ Scalar_FLOAT32_IEEE 0 SWC_OUTP_type_CM_single_kph -65535.0 65535.0 /end CHARACTERISTIC
/begin CHARACTERISTIC KOUTP_RRRawWhlSpeed_kph_ovrdval "" VALUE 0x0000 /* @ECU_Address@KOUTP_RRRawWhlSpeed_kph_ovrdval@ */ Scalar_FLOAT32_IEEE 0 SWC_OUTP_type_CM_single_kph -65535.0 65535.0 /end CHARACTERISTIC
/begin CHARACTERISTIC KOUTP_SASAngle_Deg_maxval "" VALUE 0x0000 /* @ECU_Address@KOUTP_SASAngle_Deg_maxval@ */ Scalar_FLOAT32_IEEE 0 SWC_OUTP_type_CM_single_Deg -65535.0 65535.0 /end CHARACTERISTIC
/begin CHARACTERISTIC KOUTP_SASAngle_Deg_minval "" VALUE 0x0000 /* @ECU_Address@KOUTP_SASAngle_Deg_minval@ */ Scalar_FLOAT32_IEEE 0 SWC_OUTP_type_CM_single_Deg -65535.0 65535.0 /end CHARACTERISTIC
/begin CHARACTERISTIC KOUTP_SASAngle_Deg_ovrdval "" VALUE 0x0000 /* @ECU_Address@KOUTP_SASAngle_Deg_ovrdval@ */ Scalar_FLOAT32_IEEE 0 SWC_OUTP_type_CM_single_Deg -65535.0 65535.0 /end CHARACTERISTIC
/begin CHARACTERISTIC KOUTP_SASSpeed_degps_maxval "" VALUE 0x0000 /* @ECU_Address@KOUTP_SASSpeed_degps_maxval@ */ Scalar_FLOAT32_IEEE 0 SWC_OUTP_type_CM_single_degps -65535.0 65535.0 /end CHARACTERISTIC
/begin CHARACTERISTIC KOUTP_SASSpeed_degps_minval "" VALUE 0x0000 /* @ECU_Address@KOUTP_SASSpeed_degps_minval@ */ Scalar_FLOAT32_IEEE 0 SWC_OUTP_type_CM_single_degps -65535.0 65535.0 /end CHARACTERISTIC
/begin CHARACTERISTIC KOUTP_SASSpeed_degps_ovrdval "" VALUE 0x0000 /* @ECU_Address@KOUTP_SASSpeed_degps_ovrdval@ */ Scalar_FLOAT32_IEEE 0 SWC_OUTP_type_CM_single_degps -65535.0 65535.0 /end CHARACTERISTIC
/begin CHARACTERISTIC KOUTP_ChrgPlugSta_enum_ovrdflg "" VALUE 0x0000 /* @ECU_Address@KOUTP_ChrgPlugSta_enum_ovrdflg@ */ Scalar_BOOLEAN 0 SWC_OUTP_type_CM_boolean_flg 0.0 1.0 /end CHARACTERISTIC
/begin CHARACTERISTIC KOUTP_DKCPDkeyAreaRAPSSta_enum_ovrdflg "" VALUE 0x0000 /* @ECU_Address@KOUTP_DKCPDkeyAreaRAPSSta_enum_ovrdflg@ */ Scalar_BOOLEAN 0 SWC_OUTP_type_CM_boolean_flg 0.0 1.0 /end CHARACTERISTIC
/begin CHARACTERISTIC KOUTP_DKCParkingModeCmd_enum_ovrdflg "" VALUE 0x0000 /* @ECU_Address@KOUTP_DKCParkingModeCmd_enum_ovrdflg@ */ Scalar_BOOLEAN 0 SWC_OUTP_type_CM_boolean_flg 0.0 1.0 /end CHARACTERISTIC
/begin CHARACTERISTIC KOUTP_DriIntendTimeOut_flg_maxval "" VALUE 0x0000 /* @ECU_Address@KOUTP_DriIntendTimeOut_flg_maxval@ */ Scalar_BOOLEAN 0 SWC_OUTP_type_CM_boolean_flg 0.0 1.0 /end CHARACTERISTIC
/begin CHARACTERISTIC KOUTP_DriIntendTimeOut_flg_minval "" VALUE 0x0000 /* @ECU_Address@KOUTP_DriIntendTimeOut_flg_minval@ */ Scalar_BOOLEAN 0 SWC_OUTP_type_CM_boolean_flg 0.0 1.0 /end CHARACTERISTIC
/begin CHARACTERISTIC KOUTP_DriIntendTimeOut_flg_ovrdflg "" VALUE 0x0000 /* @ECU_Address@KOUTP_DriIntendTimeOut_flg_ovrdflg@ */ Scalar_BOOLEAN 0 SWC_OUTP_type_CM_boolean_flg 0.0 1.0 /end CHARACTERISTIC
/begin CHARACTERISTIC KOUTP_DriIntendTimeOut_flg_ovrdval "" VALUE 0x0000 /* @ECU_Address@KOUTP_DriIntendTimeOut_flg_ovrdval@ */ Scalar_BOOLEAN 0 SWC_OUTP_type_CM_boolean_flg 0.0 1.0 /end CHARACTERISTIC
/begin CHARACTERISTIC KOUTP_DriIntend_enum_ovrdflg "" VALUE 0x0000 /* @ECU_Address@KOUTP_DriIntend_enum_ovrdflg@ */ Scalar_BOOLEAN 0 SWC_OUTP_type_CM_boolean_flg 0.0 1.0 /end CHARACTERISTIC
/begin CHARACTERISTIC KOUTP_DriverSeatBeltCmdTimeOut_flg_maxval "" VALUE 0x0000 /* @ECU_Address@KOUTP_DriverSeatBeltCmdTimeOut_flg_maxval@ */ Scalar_BOOLEAN 0 SWC_OUTP_type_CM_boolean_flg 0.0 1.0 /end CHARACTERISTIC
/begin CHARACTERISTIC KOUTP_DriverSeatBeltCmdTimeOut_flg_minval "" VALUE 0x0000 /* @ECU_Address@KOUTP_DriverSeatBeltCmdTimeOut_flg_minval@ */ Scalar_BOOLEAN 0 SWC_OUTP_type_CM_boolean_flg 0.0 1.0 /end CHARACTERISTIC
/begin CHARACTERISTIC KOUTP_DriverSeatBeltCmdTimeOut_flg_ovrdflg "" VALUE 0x0000 /* @ECU_Address@KOUTP_DriverSeatBeltCmdTimeOut_flg_ovrdflg@ */ Scalar_BOOLEAN 0 SWC_OUTP_type_CM_boolean_flg 0.0 1.0 /end CHARACTERISTIC
/begin CHARACTERISTIC KOUTP_DriverSeatBeltCmdTimeOut_flg_ovrdval "" VALUE 0x0000 /* @ECU_Address@KOUTP_DriverSeatBeltCmdTimeOut_flg_ovrdval@ */ Scalar_BOOLEAN 0 SWC_OUTP_type_CM_boolean_flg 0.0 1.0 /end CHARACTERISTIC
/begin CHARACTERISTIC KOUTP_DriverSeatBeltCmd_flg_maxval "" VALUE 0x0000 /* @ECU_Address@KOUTP_DriverSeatBeltCmd_flg_maxval@ */ Scalar_BOOLEAN 0 SWC_OUTP_type_CM_boolean_flg 0.0 1.0 /end CHARACTERISTIC
/begin CHARACTERISTIC KOUTP_DriverSeatBeltCmd_flg_minval "" VALUE 0x0000 /* @ECU_Address@KOUTP_DriverSeatBeltCmd_flg_minval@ */ Scalar_BOOLEAN 0 SWC_OUTP_type_CM_boolean_flg 0.0 1.0 /end CHARACTERISTIC
/begin CHARACTERISTIC KOUTP_DriverSeatBeltCmd_flg_ovrdflg "" VALUE 0x0000 /* @ECU_Address@KOUTP_DriverSeatBeltCmd_flg_ovrdflg@ */ Scalar_BOOLEAN 0 SWC_OUTP_type_CM_boolean_flg 0.0 1.0 /end CHARACTERISTIC
/begin CHARACTERISTIC KOUTP_DriverSeatBeltCmd_flg_ovrdval "" VALUE 0x0000 /* @ECU_Address@KOUTP_DriverSeatBeltCmd_flg_ovrdval@ */ Scalar_BOOLEAN 0 SWC_OUTP_type_CM_boolean_flg 0.0 1.0 /end CHARACTERISTIC
/begin CHARACTERISTIC KOUTP_EPBErrStaTimeOut_flg_maxval "" VALUE 0x0000 /* @ECU_Address@KOUTP_EPBErrStaTimeOut_flg_maxval@ */ Scalar_BOOLEAN 0 SWC_OUTP_type_CM_boolean_flg 0.0 1.0 /end CHARACTERISTIC
/begin CHARACTERISTIC KOUTP_EPBErrStaTimeOut_flg_minval "" VALUE 0x0000 /* @ECU_Address@KOUTP_EPBErrStaTimeOut_flg_minval@ */ Scalar_BOOLEAN 0 SWC_OUTP_type_CM_boolean_flg 0.0 1.0 /end CHARACTERISTIC
/begin CHARACTERISTIC KOUTP_EPBErrStaTimeOut_flg_ovrdflg "" VALUE 0x0000 /* @ECU_Address@KOUTP_EPBErrStaTimeOut_flg_ovrdflg@ */ Scalar_BOOLEAN 0 SWC_OUTP_type_CM_boolean_flg 0.0 1.0 /end CHARACTERISTIC
/begin CHARACTERISTIC KOUTP_EPBErrStaTimeOut_flg_ovrdval "" VALUE 0x0000 /* @ECU_Address@KOUTP_EPBErrStaTimeOut_flg_ovrdval@ */ Scalar_BOOLEAN 0 SWC_OUTP_type_CM_boolean_flg 0.0 1.0 /end CHARACTERISTIC
/begin CHARACTERISTIC KOUTP_EPBErrSta_enum_ovrdflg "" VALUE 0x0000 /* @ECU_Address@KOUTP_EPBErrSta_enum_ovrdflg@ */ Scalar_BOOLEAN 0 SWC_OUTP_type_CM_boolean_flg 0.0 1.0 /end CHARACTERISTIC
/begin CHARACTERISTIC KOUTP_EPBExtApplyAvailTimeOut_flg_maxval "" VALUE 0x0000 /* @ECU_Address@KOUTP_EPBExtApplyAvailTimeOut_flg_maxval@ */ Scalar_BOOLEAN 0 SWC_OUTP_type_CM_boolean_flg 0.0 1.0 /end CHARACTERISTIC
/begin CHARACTERISTIC KOUTP_EPBExtApplyAvailTimeOut_flg_minval "" VALUE 0x0000 /* @ECU_Address@KOUTP_EPBExtApplyAvailTimeOut_flg_minval@ */ Scalar_BOOLEAN 0 SWC_OUTP_type_CM_boolean_flg 0.0 1.0 /end CHARACTERISTIC
/begin CHARACTERISTIC KOUTP_EPBExtApplyAvailTimeOut_flg_ovrdflg "" VALUE 0x0000 /* @ECU_Address@KOUTP_EPBExtApplyAvailTimeOut_flg_ovrdflg@ */ Scalar_BOOLEAN 0 SWC_OUTP_type_CM_boolean_flg 0.0 1.0 /end CHARACTERISTIC
/begin CHARACTERISTIC KOUTP_EPBExtApplyAvailTimeOut_flg_ovrdval "" VALUE 0x0000 /* @ECU_Address@KOUTP_EPBExtApplyAvailTimeOut_flg_ovrdval@ */ Scalar_BOOLEAN 0 SWC_OUTP_type_CM_boolean_flg 0.0 1.0 /end CHARACTERISTIC
/begin CHARACTERISTIC KOUTP_EPBExtApplyAvail_flg_maxval "" VALUE 0x0000 /* @ECU_Address@KOUTP_EPBExtApplyAvail_flg_maxval@ */ Scalar_BOOLEAN 0 SWC_OUTP_type_CM_boolean_flg 0.0 1.0 /end CHARACTERISTIC
/begin CHARACTERISTIC KOUTP_EPBExtApplyAvail_flg_minval "" VALUE 0x0000 /* @ECU_Address@KOUTP_EPBExtApplyAvail_flg_minval@ */ Scalar_BOOLEAN 0 SWC_OUTP_type_CM_boolean_flg 0.0 1.0 /end CHARACTERISTIC
/begin CHARACTERISTIC KOUTP_EPBExtApplyAvail_flg_ovrdflg "" VALUE 0x0000 /* @ECU_Address@KOUTP_EPBExtApplyAvail_flg_ovrdflg@ */ Scalar_BOOLEAN 0 SWC_OUTP_type_CM_boolean_flg 0.0 1.0 /end CHARACTERISTIC
/begin CHARACTERISTIC KOUTP_EPBExtApplyAvail_flg_ovrdval "" VALUE 0x0000 /* @ECU_Address@KOUTP_EPBExtApplyAvail_flg_ovrdval@ */ Scalar_BOOLEAN 0 SWC_OUTP_type_CM_boolean_flg 0.0 1.0 /end CHARACTERISTIC
/begin CHARACTERISTIC KOUTP_EPBExtReleaseAvailTimeOut_flg_maxval "" VALUE 0x0000 /* @ECU_Address@KOUTP_EPBExtReleaseAvailTimeOut_flg_maxval@ */ Scalar_BOOLEAN 0 SWC_OUTP_type_CM_boolean_flg 0.0 1.0 /end CHARACTERISTIC
/begin CHARACTERISTIC KOUTP_EPBExtReleaseAvailTimeOut_flg_minval "" VALUE 0x0000 /* @ECU_Address@KOUTP_EPBExtReleaseAvailTimeOut_flg_minval@ */ Scalar_BOOLEAN 0 SWC_OUTP_type_CM_boolean_flg 0.0 1.0 /end CHARACTERISTIC
/begin CHARACTERISTIC KOUTP_EPBExtReleaseAvailTimeOut_flg_ovrdflg "" VALUE 0x0000 /* @ECU_Address@KOUTP_EPBExtReleaseAvailTimeOut_flg_ovrdflg@ */ Scalar_BOOLEAN 0 SWC_OUTP_type_CM_boolean_flg 0.0 1.0 /end CHARACTERISTIC
/begin CHARACTERISTIC KOUTP_EPBExtReleaseAvailTimeOut_flg_ovrdval "" VALUE 0x0000 /* @ECU_Address@KOUTP_EPBExtReleaseAvailTimeOut_flg_ovrdval@ */ Scalar_BOOLEAN 0 SWC_OUTP_type_CM_boolean_flg 0.0 1.0 /end CHARACTERISTIC
/begin CHARACTERISTIC KOUTP_EPBExtReleaseAvail_flg_maxval "" VALUE 0x0000 /* @ECU_Address@KOUTP_EPBExtReleaseAvail_flg_maxval@ */ Scalar_BOOLEAN 0 SWC_OUTP_type_CM_boolean_flg 0.0 1.0 /end CHARACTERISTIC
/begin CHARACTERISTIC KOUTP_EPBExtReleaseAvail_flg_minval "" VALUE 0x0000 /* @ECU_Address@KOUTP_EPBExtReleaseAvail_flg_minval@ */ Scalar_BOOLEAN 0 SWC_OUTP_type_CM_boolean_flg 0.0 1.0 /end CHARACTERISTIC
/begin CHARACTERISTIC KOUTP_EPBExtReleaseAvail_flg_ovrdflg "" VALUE 0x0000 /* @ECU_Address@KOUTP_EPBExtReleaseAvail_flg_ovrdflg@ */ Scalar_BOOLEAN 0 SWC_OUTP_type_CM_boolean_flg 0.0 1.0 /end CHARACTERISTIC
/begin CHARACTERISTIC KOUTP_EPBExtReleaseAvail_flg_ovrdval "" VALUE 0x0000 /* @ECU_Address@KOUTP_EPBExtReleaseAvail_flg_ovrdval@ */ Scalar_BOOLEAN 0 SWC_OUTP_type_CM_boolean_flg 0.0 1.0 /end CHARACTERISTIC
/begin CHARACTERISTIC KOUTP_EPBStaTimeOut_flg_maxval "" VALUE 0x0000 /* @ECU_Address@KOUTP_EPBStaTimeOut_flg_maxval@ */ Scalar_BOOLEAN 0 SWC_OUTP_type_CM_boolean_flg 0.0 1.0 /end CHARACTERISTIC
/begin CHARACTERISTIC KOUTP_EPBStaTimeOut_flg_minval "" VALUE 0x0000 /* @ECU_Address@KOUTP_EPBStaTimeOut_flg_minval@ */ Scalar_BOOLEAN 0 SWC_OUTP_type_CM_boolean_flg 0.0 1.0 /end CHARACTERISTIC
/begin CHARACTERISTIC KOUTP_EPBStaTimeOut_flg_ovrdflg "" VALUE 0x0000 /* @ECU_Address@KOUTP_EPBStaTimeOut_flg_ovrdflg@ */ Scalar_BOOLEAN 0 SWC_OUTP_type_CM_boolean_flg 0.0 1.0 /end CHARACTERISTIC
/begin CHARACTERISTIC KOUTP_EPBStaTimeOut_flg_ovrdval "" VALUE 0x0000 /* @ECU_Address@KOUTP_EPBStaTimeOut_flg_ovrdval@ */ Scalar_BOOLEAN 0 SWC_OUTP_type_CM_boolean_flg 0.0 1.0 /end CHARACTERISTIC
/begin CHARACTERISTIC KOUTP_EPBSta_enum_ovrdflg "" VALUE 0x0000 /* @ECU_Address@KOUTP_EPBSta_enum_ovrdflg@ */ Scalar_BOOLEAN 0 SWC_OUTP_type_CM_boolean_flg 0.0 1.0 /end CHARACTERISTIC
/begin CHARACTERISTIC KOUTP_EPSAOIControlTimeOut_flg_maxval "" VALUE 0x0000 /* @ECU_Address@KOUTP_EPSAOIControlTimeOut_flg_maxval@ */ Scalar_BOOLEAN 0 SWC_OUTP_type_CM_boolean_flg 0.0 1.0 /end CHARACTERISTIC
/begin CHARACTERISTIC KOUTP_EPSAOIControlTimeOut_flg_minval "" VALUE 0x0000 /* @ECU_Address@KOUTP_EPSAOIControlTimeOut_flg_minval@ */ Scalar_BOOLEAN 0 SWC_OUTP_type_CM_boolean_flg 0.0 1.0 /end CHARACTERISTIC
/begin CHARACTERISTIC KOUTP_EPSAOIControlTimeOut_flg_ovrdflg "" VALUE 0x0000 /* @ECU_Address@KOUTP_EPSAOIControlTimeOut_flg_ovrdflg@ */ Scalar_BOOLEAN 0 SWC_OUTP_type_CM_boolean_flg 0.0 1.0 /end CHARACTERISTIC
/begin CHARACTERISTIC KOUTP_EPSAOIControlTimeOut_flg_ovrdval "" VALUE 0x0000 /* @ECU_Address@KOUTP_EPSAOIControlTimeOut_flg_ovrdval@ */ Scalar_BOOLEAN 0 SWC_OUTP_type_CM_boolean_flg 0.0 1.0 /end CHARACTERISTIC
/begin CHARACTERISTIC KOUTP_EPSAOIControl_enum_ovrdflg "" VALUE 0x0000 /* @ECU_Address@KOUTP_EPSAOIControl_enum_ovrdflg@ */ Scalar_BOOLEAN 0 SWC_OUTP_type_CM_boolean_flg 0.0 1.0 /end CHARACTERISTIC
/begin CHARACTERISTIC KOUTP_ESCAPSStaTimeOut_flg_maxval "" VALUE 0x0000 /* @ECU_Address@KOUTP_ESCAPSStaTimeOut_flg_maxval@ */ Scalar_BOOLEAN 0 SWC_OUTP_type_CM_boolean_flg 0.0 1.0 /end CHARACTERISTIC
/begin CHARACTERISTIC KOUTP_ESCAPSStaTimeOut_flg_minval "" VALUE 0x0000 /* @ECU_Address@KOUTP_ESCAPSStaTimeOut_flg_minval@ */ Scalar_BOOLEAN 0 SWC_OUTP_type_CM_boolean_flg 0.0 1.0 /end CHARACTERISTIC
/begin CHARACTERISTIC KOUTP_ESCAPSStaTimeOut_flg_ovrdflg "" VALUE 0x0000 /* @ECU_Address@KOUTP_ESCAPSStaTimeOut_flg_ovrdflg@ */ Scalar_BOOLEAN 0 SWC_OUTP_type_CM_boolean_flg 0.0 1.0 /end CHARACTERISTIC
/begin CHARACTERISTIC KOUTP_ESCAPSStaTimeOut_flg_ovrdval "" VALUE 0x0000 /* @ECU_Address@KOUTP_ESCAPSStaTimeOut_flg_ovrdval@ */ Scalar_BOOLEAN 0 SWC_OUTP_type_CM_boolean_flg 0.0 1.0 /end CHARACTERISTIC
/begin CHARACTERISTIC KOUTP_ESCAPSSta_enum_ovrdflg "" VALUE 0x0000 /* @ECU_Address@KOUTP_ESCAPSSta_enum_ovrdflg@ */ Scalar_BOOLEAN 0 SWC_OUTP_type_CM_boolean_flg 0.0 1.0 /end CHARACTERISTIC
/begin CHARACTERISTIC KOUTP_ESCStandstillTimeOut_flg_maxval "" VALUE 0x0000 /* @ECU_Address@KOUTP_ESCStandstillTimeOut_flg_maxval@ */ Scalar_BOOLEAN 0 SWC_OUTP_type_CM_boolean_flg 0.0 1.0 /end CHARACTERISTIC
/begin CHARACTERISTIC KOUTP_ESCStandstillTimeOut_flg_minval "" VALUE 0x0000 /* @ECU_Address@KOUTP_ESCStandstillTimeOut_flg_minval@ */ Scalar_BOOLEAN 0 SWC_OUTP_type_CM_boolean_flg 0.0 1.0 /end CHARACTERISTIC
/begin CHARACTERISTIC KOUTP_ESCStandstillTimeOut_flg_ovrdflg "" VALUE 0x0000 /* @ECU_Address@KOUTP_ESCStandstillTimeOut_flg_ovrdflg@ */ Scalar_BOOLEAN 0 SWC_OUTP_type_CM_boolean_flg 0.0 1.0 /end CHARACTERISTIC
/begin CHARACTERISTIC KOUTP_ESCStandstillTimeOut_flg_ovrdval "" VALUE 0x0000 /* @ECU_Address@KOUTP_ESCStandstillTimeOut_flg_ovrdval@ */ Scalar_BOOLEAN 0 SWC_OUTP_type_CM_boolean_flg 0.0 1.0 /end CHARACTERISTIC
/begin CHARACTERISTIC KOUTP_ESCStandstill_flg_maxval "" VALUE 0x0000 /* @ECU_Address@KOUTP_ESCStandstill_flg_maxval@ */ Scalar_BOOLEAN 0 SWC_OUTP_type_CM_boolean_flg 0.0 1.0 /end CHARACTERISTIC
/begin CHARACTERISTIC KOUTP_ESCStandstill_flg_minval "" VALUE 0x0000 /* @ECU_Address@KOUTP_ESCStandstill_flg_minval@ */ Scalar_BOOLEAN 0 SWC_OUTP_type_CM_boolean_flg 0.0 1.0 /end CHARACTERISTIC
/begin CHARACTERISTIC KOUTP_ESCStandstill_flg_ovrdflg "" VALUE 0x0000 /* @ECU_Address@KOUTP_ESCStandstill_flg_ovrdflg@ */ Scalar_BOOLEAN 0 SWC_OUTP_type_CM_boolean_flg 0.0 1.0 /end CHARACTERISTIC
/begin CHARACTERISTIC KOUTP_ESCStandstill_flg_ovrdval "" VALUE 0x0000 /* @ECU_Address@KOUTP_ESCStandstill_flg_ovrdval@ */ Scalar_BOOLEAN 0 SWC_OUTP_type_CM_boolean_flg 0.0 1.0 /end CHARACTERISTIC
/begin CHARACTERISTIC KOUTP_FSOffSwTimeOut_flg_maxval "" VALUE 0x0000 /* @ECU_Address@KOUTP_FSOffSwTimeOut_flg_maxval@ */ Scalar_BOOLEAN 0 SWC_OUTP_type_CM_boolean_flg 0.0 1.0 /end CHARACTERISTIC
/begin CHARACTERISTIC KOUTP_FSOffSwTimeOut_flg_minval "" VALUE 0x0000 /* @ECU_Address@KOUTP_FSOffSwTimeOut_flg_minval@ */ Scalar_BOOLEAN 0 SWC_OUTP_type_CM_boolean_flg 0.0 1.0 /end CHARACTERISTIC
/begin CHARACTERISTIC KOUTP_FSOffSwTimeOut_flg_ovrdflg "" VALUE 0x0000 /* @ECU_Address@KOUTP_FSOffSwTimeOut_flg_ovrdflg@ */ Scalar_BOOLEAN 0 SWC_OUTP_type_CM_boolean_flg 0.0 1.0 /end CHARACTERISTIC
/begin CHARACTERISTIC KOUTP_FSOffSwTimeOut_flg_ovrdval "" VALUE 0x0000 /* @ECU_Address@KOUTP_FSOffSwTimeOut_flg_ovrdval@ */ Scalar_BOOLEAN 0 SWC_OUTP_type_CM_boolean_flg 0.0 1.0 /end CHARACTERISTIC
/begin CHARACTERISTIC KOUTP_FSOffSw_enum_ovrdflg "" VALUE 0x0000 /* @ECU_Address@KOUTP_FSOffSw_enum_ovrdflg@ */ Scalar_BOOLEAN 0 SWC_OUTP_type_CM_boolean_flg 0.0 1.0 /end CHARACTERISTIC
/begin CHARACTERISTIC KOUTP_GRADETimeOut_flg_maxval "" VALUE 0x0000 /* @ECU_Address@KOUTP_GRADETimeOut_flg_maxval@ */ Scalar_BOOLEAN 0 SWC_OUTP_type_CM_boolean_flg 0.0 1.0 /end CHARACTERISTIC
/begin CHARACTERISTIC KOUTP_GRADETimeOut_flg_minval "" VALUE 0x0000 /* @ECU_Address@KOUTP_GRADETimeOut_flg_minval@ */ Scalar_BOOLEAN 0 SWC_OUTP_type_CM_boolean_flg 0.0 1.0 /end CHARACTERISTIC
/begin CHARACTERISTIC KOUTP_GRADETimeOut_flg_ovrdflg "" VALUE 0x0000 /* @ECU_Address@KOUTP_GRADETimeOut_flg_ovrdflg@ */ Scalar_BOOLEAN 0 SWC_OUTP_type_CM_boolean_flg 0.0 1.0 /end CHARACTERISTIC
/begin CHARACTERISTIC KOUTP_GRADETimeOut_flg_ovrdval "" VALUE 0x0000 /* @ECU_Address@KOUTP_GRADETimeOut_flg_ovrdval@ */ Scalar_BOOLEAN 0 SWC_OUTP_type_CM_boolean_flg 0.0 1.0 /end CHARACTERISTIC
/begin CHARACTERISTIC KOUTP_GRADE_Deg_ovrdflg "" VALUE 0x0000 /* @ECU_Address@KOUTP_GRADE_Deg_ovrdflg@ */ Scalar_BOOLEAN 0 SWC_OUTP_type_CM_boolean_flg 0.0 1.0 /end CHARACTERISTIC
/begin CHARACTERISTIC KOUTP_IVIScreenTimeOut_flg_maxval "" VALUE 0x0000 /* @ECU_Address@KOUTP_IVIScreenTimeOut_flg_maxval@ */ Scalar_BOOLEAN 0 SWC_OUTP_type_CM_boolean_flg 0.0 1.0 /end CHARACTERISTIC
/begin CHARACTERISTIC KOUTP_IVIScreenTimeOut_flg_minval "" VALUE 0x0000 /* @ECU_Address@KOUTP_IVIScreenTimeOut_flg_minval@ */ Scalar_BOOLEAN 0 SWC_OUTP_type_CM_boolean_flg 0.0 1.0 /end CHARACTERISTIC
/begin CHARACTERISTIC KOUTP_IVIScreenTimeOut_flg_ovrdflg "" VALUE 0x0000 /* @ECU_Address@KOUTP_IVIScreenTimeOut_flg_ovrdflg@ */ Scalar_BOOLEAN 0 SWC_OUTP_type_CM_boolean_flg 0.0 1.0 /end CHARACTERISTIC
/begin CHARACTERISTIC KOUTP_IVIScreenTimeOut_flg_ovrdval "" VALUE 0x0000 /* @ECU_Address@KOUTP_IVIScreenTimeOut_flg_ovrdval@ */ Scalar_BOOLEAN 0 SWC_OUTP_type_CM_boolean_flg 0.0 1.0 /end CHARACTERISTIC
/begin CHARACTERISTIC KOUTP_IVIScreen_enum_ovrdflg "" VALUE 0x0000 /* @ECU_Address@KOUTP_IVIScreen_enum_ovrdflg@ */ Scalar_BOOLEAN 0 SWC_OUTP_type_CM_boolean_flg 0.0 1.0 /end CHARACTERISTIC
/begin CHARACTERISTIC KOUTP_IVIStatusTimeOut_flg_maxval "" VALUE 0x0000 /* @ECU_Address@KOUTP_IVIStatusTimeOut_flg_maxval@ */ Scalar_BOOLEAN 0 SWC_OUTP_type_CM_boolean_flg 0.0 1.0 /end CHARACTERISTIC
/begin CHARACTERISTIC KOUTP_IVIStatusTimeOut_flg_minval "" VALUE 0x0000 /* @ECU_Address@KOUTP_IVIStatusTimeOut_flg_minval@ */ Scalar_BOOLEAN 0 SWC_OUTP_type_CM_boolean_flg 0.0 1.0 /end CHARACTERISTIC
/begin CHARACTERISTIC KOUTP_IVIStatusTimeOut_flg_ovrdflg "" VALUE 0x0000 /* @ECU_Address@KOUTP_IVIStatusTimeOut_flg_ovrdflg@ */ Scalar_BOOLEAN 0 SWC_OUTP_type_CM_boolean_flg 0.0 1.0 /end CHARACTERISTIC
/begin CHARACTERISTIC KOUTP_IVIStatusTimeOut_flg_ovrdval "" VALUE 0x0000 /* @ECU_Address@KOUTP_IVIStatusTimeOut_flg_ovrdval@ */ Scalar_BOOLEAN 0 SWC_OUTP_type_CM_boolean_flg 0.0 1.0 /end CHARACTERISTIC
/begin CHARACTERISTIC KOUTP_IVIStatus_flg_maxval "" VALUE 0x0000 /* @ECU_Address@KOUTP_IVIStatus_flg_maxval@ */ Scalar_BOOLEAN 0 SWC_OUTP_type_CM_boolean_flg 0.0 1.0 /end CHARACTERISTIC
/begin CHARACTERISTIC KOUTP_IVIStatus_flg_minval "" VALUE 0x0000 /* @ECU_Address@KOUTP_IVIStatus_flg_minval@ */ Scalar_BOOLEAN 0 SWC_OUTP_type_CM_boolean_flg 0.0 1.0 /end CHARACTERISTIC
/begin CHARACTERISTIC KOUTP_IVIStatus_flg_ovrdflg "" VALUE 0x0000 /* @ECU_Address@KOUTP_IVIStatus_flg_ovrdflg@ */ Scalar_BOOLEAN 0 SWC_OUTP_type_CM_boolean_flg 0.0 1.0 /end CHARACTERISTIC
/begin CHARACTERISTIC KOUTP_IVIStatus_flg_ovrdval "" VALUE 0x0000 /* @ECU_Address@KOUTP_IVIStatus_flg_ovrdval@ */ Scalar_BOOLEAN 0 SWC_OUTP_type_CM_boolean_flg 0.0 1.0 /end CHARACTERISTIC
/begin CHARACTERISTIC KOUTP_IVIUserTakeOverAPSSta_flg_maxval "" VALUE 0x0000 /* @ECU_Address@KOUTP_IVIUserTakeOverAPSSta_flg_maxval@ */ Scalar_BOOLEAN 0 SWC_OUTP_type_CM_boolean_flg 0.0 1.0 /end CHARACTERISTIC
/begin CHARACTERISTIC KOUTP_IVIUserTakeOverAPSSta_flg_minval "" VALUE 0x0000 /* @ECU_Address@KOUTP_IVIUserTakeOverAPSSta_flg_minval@ */ Scalar_BOOLEAN 0 SWC_OUTP_type_CM_boolean_flg 0.0 1.0 /end CHARACTERISTIC
/begin CHARACTERISTIC KOUTP_IVIUserTakeOverAPSSta_flg_ovrdflg "" VALUE 0x0000 /* @ECU_Address@KOUTP_IVIUserTakeOverAPSSta_flg_ovrdflg@ */ Scalar_BOOLEAN 0 SWC_OUTP_type_CM_boolean_flg 0.0 1.0 /end CHARACTERISTIC
/begin CHARACTERISTIC KOUTP_IVIUserTakeOverAPSSta_flg_ovrdval "" VALUE 0x0000 /* @ECU_Address@KOUTP_IVIUserTakeOverAPSSta_flg_ovrdval@ */ Scalar_BOOLEAN 0 SWC_OUTP_type_CM_boolean_flg 0.0 1.0 /end CHARACTERISTIC
/begin CHARACTERISTIC KOUTP_LFPulseCountTimeOut_flg_maxval "" VALUE 0x0000 /* @ECU_Address@KOUTP_LFPulseCountTimeOut_flg_maxval@ */ Scalar_BOOLEAN 0 SWC_OUTP_type_CM_boolean_flg 0.0 1.0 /end CHARACTERISTIC
/begin CHARACTERISTIC KOUTP_LFPulseCountTimeOut_flg_minval "" VALUE 0x0000 /* @ECU_Address@KOUTP_LFPulseCountTimeOut_flg_minval@ */ Scalar_BOOLEAN 0 SWC_OUTP_type_CM_boolean_flg 0.0 1.0 /end CHARACTERISTIC
/begin CHARACTERISTIC KOUTP_LFPulseCountTimeOut_flg_ovrdflg "" VALUE 0x0000 /* @ECU_Address@KOUTP_LFPulseCountTimeOut_flg_ovrdflg@ */ Scalar_BOOLEAN 0 SWC_OUTP_type_CM_boolean_flg 0.0 1.0 /end CHARACTERISTIC
/begin CHARACTERISTIC KOUTP_LFPulseCountTimeOut_flg_ovrdval "" VALUE 0x0000 /* @ECU_Address@KOUTP_LFPulseCountTimeOut_flg_ovrdval@ */ Scalar_BOOLEAN 0 SWC_OUTP_type_CM_boolean_flg 0.0 1.0 /end CHARACTERISTIC
/begin CHARACTERISTIC KOUTP_LFPulseCountVTimeOut_flg_maxval "" VALUE 0x0000 /* @ECU_Address@KOUTP_LFPulseCountVTimeOut_flg_maxval@ */ Scalar_BOOLEAN 0 SWC_OUTP_type_CM_boolean_flg 0.0 1.0 /end CHARACTERISTIC
/begin CHARACTERISTIC KOUTP_LFPulseCountVTimeOut_flg_minval "" VALUE 0x0000 /* @ECU_Address@KOUTP_LFPulseCountVTimeOut_flg_minval@ */ Scalar_BOOLEAN 0 SWC_OUTP_type_CM_boolean_flg 0.0 1.0 /end CHARACTERISTIC
/begin CHARACTERISTIC KOUTP_LFPulseCountVTimeOut_flg_ovrdflg "" VALUE 0x0000 /* @ECU_Address@KOUTP_LFPulseCountVTimeOut_flg_ovrdflg@ */ Scalar_BOOLEAN 0 SWC_OUTP_type_CM_boolean_flg 0.0 1.0 /end CHARACTERISTIC
/begin CHARACTERISTIC KOUTP_LFPulseCountVTimeOut_flg_ovrdval "" VALUE 0x0000 /* @ECU_Address@KOUTP_LFPulseCountVTimeOut_flg_ovrdval@ */ Scalar_BOOLEAN 0 SWC_OUTP_type_CM_boolean_flg 0.0 1.0 /end CHARACTERISTIC
/begin CHARACTERISTIC KOUTP_LFPulseCountV_flg_maxval "" VALUE 0x0000 /* @ECU_Address@KOUTP_LFPulseCountV_flg_maxval@ */ Scalar_BOOLEAN 0 SWC_OUTP_type_CM_boolean_flg 0.0 1.0 /end CHARACTERISTIC
/begin CHARACTERISTIC KOUTP_LFPulseCountV_flg_minval "" VALUE 0x0000 /* @ECU_Address@KOUTP_LFPulseCountV_flg_minval@ */ Scalar_BOOLEAN 0 SWC_OUTP_type_CM_boolean_flg 0.0 1.0 /end CHARACTERISTIC
/begin CHARACTERISTIC KOUTP_LFPulseCountV_flg_ovrdflg "" VALUE 0x0000 /* @ECU_Address@KOUTP_LFPulseCountV_flg_ovrdflg@ */ Scalar_BOOLEAN 0 SWC_OUTP_type_CM_boolean_flg 0.0 1.0 /end CHARACTERISTIC
/begin CHARACTERISTIC KOUTP_LFPulseCountV_flg_ovrdval "" VALUE 0x0000 /* @ECU_Address@KOUTP_LFPulseCountV_flg_ovrdval@ */ Scalar_BOOLEAN 0 SWC_OUTP_type_CM_boolean_flg 0.0 1.0 /end CHARACTERISTIC
/begin CHARACTERISTIC KOUTP_LFPulseCount_enum_ovrdflg "" VALUE 0x0000 /* @ECU_Address@KOUTP_LFPulseCount_enum_ovrdflg@ */ Scalar_BOOLEAN 0 SWC_OUTP_type_CM_boolean_flg 0.0 1.0 /end CHARACTERISTIC
/begin CHARACTERISTIC KOUTP_LFRawWhlSpeedTimeOut_flg_maxval "" VALUE 0x0000 /* @ECU_Address@KOUTP_LFRawWhlSpeedTimeOut_flg_maxval@ */ Scalar_BOOLEAN 0 SWC_OUTP_type_CM_boolean_flg 0.0 1.0 /end CHARACTERISTIC
/begin CHARACTERISTIC KOUTP_LFRawWhlSpeedTimeOut_flg_minval "" VALUE 0x0000 /* @ECU_Address@KOUTP_LFRawWhlSpeedTimeOut_flg_minval@ */ Scalar_BOOLEAN 0 SWC_OUTP_type_CM_boolean_flg 0.0 1.0 /end CHARACTERISTIC
/begin CHARACTERISTIC KOUTP_LFRawWhlSpeedTimeOut_flg_ovrdflg "" VALUE 0x0000 /* @ECU_Address@KOUTP_LFRawWhlSpeedTimeOut_flg_ovrdflg@ */ Scalar_BOOLEAN 0 SWC_OUTP_type_CM_boolean_flg 0.0 1.0 /end CHARACTERISTIC
/begin CHARACTERISTIC KOUTP_LFRawWhlSpeedTimeOut_flg_ovrdval "" VALUE 0x0000 /* @ECU_Address@KOUTP_LFRawWhlSpeedTimeOut_flg_ovrdval@ */ Scalar_BOOLEAN 0 SWC_OUTP_type_CM_boolean_flg 0.0 1.0 /end CHARACTERISTIC
/begin CHARACTERISTIC KOUTP_LFRawWhlSpeedVTimeOut_flg_maxval "" VALUE 0x0000 /* @ECU_Address@KOUTP_LFRawWhlSpeedVTimeOut_flg_maxval@ */ Scalar_BOOLEAN 0 SWC_OUTP_type_CM_boolean_flg 0.0 1.0 /end CHARACTERISTIC
/begin CHARACTERISTIC KOUTP_LFRawWhlSpeedVTimeOut_flg_minval "" VALUE 0x0000 /* @ECU_Address@KOUTP_LFRawWhlSpeedVTimeOut_flg_minval@ */ Scalar_BOOLEAN 0 SWC_OUTP_type_CM_boolean_flg 0.0 1.0 /end CHARACTERISTIC
/begin CHARACTERISTIC KOUTP_LFRawWhlSpeedVTimeOut_flg_ovrdflg "" VALUE 0x0000 /* @ECU_Address@KOUTP_LFRawWhlSpeedVTimeOut_flg_ovrdflg@ */ Scalar_BOOLEAN 0 SWC_OUTP_type_CM_boolean_flg 0.0 1.0 /end CHARACTERISTIC
/begin CHARACTERISTIC KOUTP_LFRawWhlSpeedVTimeOut_flg_ovrdval "" VALUE 0x0000 /* @ECU_Address@KOUTP_LFRawWhlSpeedVTimeOut_flg_ovrdval@ */ Scalar_BOOLEAN 0 SWC_OUTP_type_CM_boolean_flg 0.0 1.0 /end CHARACTERISTIC
/begin CHARACTERISTIC KOUTP_LFRawWhlSpeedV_flg_maxval "" VALUE 0x0000 /* @ECU_Address@KOUTP_LFRawWhlSpeedV_flg_maxval@ */ Scalar_BOOLEAN 0 SWC_OUTP_type_CM_boolean_flg 0.0 1.0 /end CHARACTERISTIC
/begin CHARACTERISTIC KOUTP_LFRawWhlSpeedV_flg_minval "" VALUE 0x0000 /* @ECU_Address@KOUTP_LFRawWhlSpeedV_flg_minval@ */ Scalar_BOOLEAN 0 SWC_OUTP_type_CM_boolean_flg 0.0 1.0 /end CHARACTERISTIC
/begin CHARACTERISTIC KOUTP_LFRawWhlSpeedV_flg_ovrdflg "" VALUE 0x0000 /* @ECU_Address@KOUTP_LFRawWhlSpeedV_flg_ovrdflg@ */ Scalar_BOOLEAN 0 SWC_OUTP_type_CM_boolean_flg 0.0 1.0 /end CHARACTERISTIC
/begin CHARACTERISTIC KOUTP_LFRawWhlSpeedV_flg_ovrdval "" VALUE 0x0000 /* @ECU_Address@KOUTP_LFRawWhlSpeedV_flg_ovrdval@ */ Scalar_BOOLEAN 0 SWC_OUTP_type_CM_boolean_flg 0.0 1.0 /end CHARACTERISTIC
/begin CHARACTERISTIC KOUTP_LFRawWhlSpeed_kph_ovrdflg "" VALUE 0x0000 /* @ECU_Address@KOUTP_LFRawWhlSpeed_kph_ovrdflg@ */ Scalar_BOOLEAN 0 SWC_OUTP_type_CM_boolean_flg 0.0 1.0 /end CHARACTERISTIC
/begin CHARACTERISTIC KOUTP_LFWhlRotDirTimeOut_flg_maxval "" VALUE 0x0000 /* @ECU_Address@KOUTP_LFWhlRotDirTimeOut_flg_maxval@ */ Scalar_BOOLEAN 0 SWC_OUTP_type_CM_boolean_flg 0.0 1.0 /end CHARACTERISTIC
/begin CHARACTERISTIC KOUTP_LFWhlRotDirTimeOut_flg_minval "" VALUE 0x0000 /* @ECU_Address@KOUTP_LFWhlRotDirTimeOut_flg_minval@ */ Scalar_BOOLEAN 0 SWC_OUTP_type_CM_boolean_flg 0.0 1.0 /end CHARACTERISTIC
/begin CHARACTERISTIC KOUTP_LFWhlRotDirTimeOut_flg_ovrdflg "" VALUE 0x0000 /* @ECU_Address@KOUTP_LFWhlRotDirTimeOut_flg_ovrdflg@ */ Scalar_BOOLEAN 0 SWC_OUTP_type_CM_boolean_flg 0.0 1.0 /end CHARACTERISTIC
/begin CHARACTERISTIC KOUTP_LFWhlRotDirTimeOut_flg_ovrdval "" VALUE 0x0000 /* @ECU_Address@KOUTP_LFWhlRotDirTimeOut_flg_ovrdval@ */ Scalar_BOOLEAN 0 SWC_OUTP_type_CM_boolean_flg 0.0 1.0 /end CHARACTERISTIC
/begin CHARACTERISTIC KOUTP_LFWhlRotDir_enum_ovrdflg "" VALUE 0x0000 /* @ECU_Address@KOUTP_LFWhlRotDir_enum_ovrdflg@ */ Scalar_BOOLEAN 0 SWC_OUTP_type_CM_boolean_flg 0.0 1.0 /end CHARACTERISTIC
/begin CHARACTERISTIC KOUTP_LRPulseCountTimeOut_flg_maxval "" VALUE 0x0000 /* @ECU_Address@KOUTP_LRPulseCountTimeOut_flg_maxval@ */ Scalar_BOOLEAN 0 SWC_OUTP_type_CM_boolean_flg 0.0 1.0 /end CHARACTERISTIC
/begin CHARACTERISTIC KOUTP_LRPulseCountTimeOut_flg_minval "" VALUE 0x0000 /* @ECU_Address@KOUTP_LRPulseCountTimeOut_flg_minval@ */ Scalar_BOOLEAN 0 SWC_OUTP_type_CM_boolean_flg 0.0 1.0 /end CHARACTERISTIC
/begin CHARACTERISTIC KOUTP_LRPulseCountTimeOut_flg_ovrdflg "" VALUE 0x0000 /* @ECU_Address@KOUTP_LRPulseCountTimeOut_flg_ovrdflg@ */ Scalar_BOOLEAN 0 SWC_OUTP_type_CM_boolean_flg 0.0 1.0 /end CHARACTERISTIC
/begin CHARACTERISTIC KOUTP_LRPulseCountTimeOut_flg_ovrdval "" VALUE 0x0000 /* @ECU_Address@KOUTP_LRPulseCountTimeOut_flg_ovrdval@ */ Scalar_BOOLEAN 0 SWC_OUTP_type_CM_boolean_flg 0.0 1.0 /end CHARACTERISTIC
/begin CHARACTERISTIC KOUTP_LRPulseCountVTimeOut_flg_maxval "" VALUE 0x0000 /* @ECU_Address@KOUTP_LRPulseCountVTimeOut_flg_maxval@ */ Scalar_BOOLEAN 0 SWC_OUTP_type_CM_boolean_flg 0.0 1.0 /end CHARACTERISTIC
/begin CHARACTERISTIC KOUTP_LRPulseCountVTimeOut_flg_minval "" VALUE 0x0000 /* @ECU_Address@KOUTP_LRPulseCountVTimeOut_flg_minval@ */ Scalar_BOOLEAN 0 SWC_OUTP_type_CM_boolean_flg 0.0 1.0 /end CHARACTERISTIC
/begin CHARACTERISTIC KOUTP_LRPulseCountVTimeOut_flg_ovrdflg "" VALUE 0x0000 /* @ECU_Address@KOUTP_LRPulseCountVTimeOut_flg_ovrdflg@ */ Scalar_BOOLEAN 0 SWC_OUTP_type_CM_boolean_flg 0.0 1.0 /end CHARACTERISTIC
/begin CHARACTERISTIC KOUTP_LRPulseCountVTimeOut_flg_ovrdval "" VALUE 0x0000 /* @ECU_Address@KOUTP_LRPulseCountVTimeOut_flg_ovrdval@ */ Scalar_BOOLEAN 0 SWC_OUTP_type_CM_boolean_flg 0.0 1.0 /end CHARACTERISTIC
/begin CHARACTERISTIC KOUTP_LRPulseCountV_flg_maxval "" VALUE 0x0000 /* @ECU_Address@KOUTP_LRPulseCountV_flg_maxval@ */ Scalar_BOOLEAN 0 SWC_OUTP_type_CM_boolean_flg 0.0 1.0 /end CHARACTERISTIC
/begin CHARACTERISTIC KOUTP_LRPulseCountV_flg_minval "" VALUE 0x0000 /* @ECU_Address@KOUTP_LRPulseCountV_flg_minval@ */ Scalar_BOOLEAN 0 SWC_OUTP_type_CM_boolean_flg 0.0 1.0 /end CHARACTERISTIC
/begin CHARACTERISTIC KOUTP_LRPulseCountV_flg_ovrdflg "" VALUE 0x0000 /* @ECU_Address@KOUTP_LRPulseCountV_flg_ovrdflg@ */ Scalar_BOOLEAN 0 SWC_OUTP_type_CM_boolean_flg 0.0 1.0 /end CHARACTERISTIC
/begin CHARACTERISTIC KOUTP_LRPulseCountV_flg_ovrdval "" VALUE 0x0000 /* @ECU_Address@KOUTP_LRPulseCountV_flg_ovrdval@ */ Scalar_BOOLEAN 0 SWC_OUTP_type_CM_boolean_flg 0.0 1.0 /end CHARACTERISTIC
/begin CHARACTERISTIC KOUTP_LRPulseCount_enum_ovrdflg "" VALUE 0x0000 /* @ECU_Address@KOUTP_LRPulseCount_enum_ovrdflg@ */ Scalar_BOOLEAN 0 SWC_OUTP_type_CM_boolean_flg 0.0 1.0 /end CHARACTERISTIC
/begin CHARACTERISTIC KOUTP_LRRawWhlSpeedTimeOut_flg_maxval "" VALUE 0x0000 /* @ECU_Address@KOUTP_LRRawWhlSpeedTimeOut_flg_maxval@ */ Scalar_BOOLEAN 0 SWC_OUTP_type_CM_boolean_flg 0.0 1.0 /end CHARACTERISTIC
/begin CHARACTERISTIC KOUTP_LRRawWhlSpeedTimeOut_flg_minval "" VALUE 0x0000 /* @ECU_Address@KOUTP_LRRawWhlSpeedTimeOut_flg_minval@ */ Scalar_BOOLEAN 0 SWC_OUTP_type_CM_boolean_flg 0.0 1.0 /end CHARACTERISTIC
/begin CHARACTERISTIC KOUTP_LRRawWhlSpeedTimeOut_flg_ovrdflg "" VALUE 0x0000 /* @ECU_Address@KOUTP_LRRawWhlSpeedTimeOut_flg_ovrdflg@ */ Scalar_BOOLEAN 0 SWC_OUTP_type_CM_boolean_flg 0.0 1.0 /end CHARACTERISTIC
/begin CHARACTERISTIC KOUTP_LRRawWhlSpeedTimeOut_flg_ovrdval "" VALUE 0x0000 /* @ECU_Address@KOUTP_LRRawWhlSpeedTimeOut_flg_ovrdval@ */ Scalar_BOOLEAN 0 SWC_OUTP_type_CM_boolean_flg 0.0 1.0 /end CHARACTERISTIC
/begin CHARACTERISTIC KOUTP_LRRawWhlSpeedVTimeOut_flg_maxval "" VALUE 0x0000 /* @ECU_Address@KOUTP_LRRawWhlSpeedVTimeOut_flg_maxval@ */ Scalar_BOOLEAN 0 SWC_OUTP_type_CM_boolean_flg 0.0 1.0 /end CHARACTERISTIC
/begin CHARACTERISTIC KOUTP_LRRawWhlSpeedVTimeOut_flg_minval "" VALUE 0x0000 /* @ECU_Address@KOUTP_LRRawWhlSpeedVTimeOut_flg_minval@ */ Scalar_BOOLEAN 0 SWC_OUTP_type_CM_boolean_flg 0.0 1.0 /end CHARACTERISTIC
/begin CHARACTERISTIC KOUTP_LRRawWhlSpeedVTimeOut_flg_ovrdflg "" VALUE 0x0000 /* @ECU_Address@KOUTP_LRRawWhlSpeedVTimeOut_flg_ovrdflg@ */ Scalar_BOOLEAN 0 SWC_OUTP_type_CM_boolean_flg 0.0 1.0 /end CHARACTERISTIC
/begin CHARACTERISTIC KOUTP_LRRawWhlSpeedVTimeOut_flg_ovrdval "" VALUE 0x0000 /* @ECU_Address@KOUTP_LRRawWhlSpeedVTimeOut_flg_ovrdval@ */ Scalar_BOOLEAN 0 SWC_OUTP_type_CM_boolean_flg 0.0 1.0 /end CHARACTERISTIC
/begin CHARACTERISTIC KOUTP_LRRawWhlSpeedV_flg_maxval "" VALUE 0x0000 /* @ECU_Address@KOUTP_LRRawWhlSpeedV_flg_maxval@ */ Scalar_BOOLEAN 0 SWC_OUTP_type_CM_boolean_flg 0.0 1.0 /end CHARACTERISTIC
/begin CHARACTERISTIC KOUTP_LRRawWhlSpeedV_flg_minval "" VALUE 0x0000 /* @ECU_Address@KOUTP_LRRawWhlSpeedV_flg_minval@ */ Scalar_BOOLEAN 0 SWC_OUTP_type_CM_boolean_flg 0.0 1.0 /end CHARACTERISTIC
/begin CHARACTERISTIC KOUTP_LRRawWhlSpeedV_flg_ovrdflg "" VALUE 0x0000 /* @ECU_Address@KOUTP_LRRawWhlSpeedV_flg_ovrdflg@ */ Scalar_BOOLEAN 0 SWC_OUTP_type_CM_boolean_flg 0.0 1.0 /end CHARACTERISTIC
/begin CHARACTERISTIC KOUTP_LRRawWhlSpeedV_flg_ovrdval "" VALUE 0x0000 /* @ECU_Address@KOUTP_LRRawWhlSpeedV_flg_ovrdval@ */ Scalar_BOOLEAN 0 SWC_OUTP_type_CM_boolean_flg 0.0 1.0 /end CHARACTERISTIC
/begin CHARACTERISTIC KOUTP_LRRawWhlSpeed_kph_ovrdflg "" VALUE 0x0000 /* @ECU_Address@KOUTP_LRRawWhlSpeed_kph_ovrdflg@ */ Scalar_BOOLEAN 0 SWC_OUTP_type_CM_boolean_flg 0.0 1.0 /end CHARACTERISTIC
/begin CHARACTERISTIC KOUTP_LRWhlRotDirTimeOut_flg_maxval "" VALUE 0x0000 /* @ECU_Address@KOUTP_LRWhlRotDirTimeOut_flg_maxval@ */ Scalar_BOOLEAN 0 SWC_OUTP_type_CM_boolean_flg 0.0 1.0 /end CHARACTERISTIC
/begin CHARACTERISTIC KOUTP_LRWhlRotDirTimeOut_flg_minval "" VALUE 0x0000 /* @ECU_Address@KOUTP_LRWhlRotDirTimeOut_flg_minval@ */ Scalar_BOOLEAN 0 SWC_OUTP_type_CM_boolean_flg 0.0 1.0 /end CHARACTERISTIC
/begin CHARACTERISTIC KOUTP_LRWhlRotDirTimeOut_flg_ovrdflg "" VALUE 0x0000 /* @ECU_Address@KOUTP_LRWhlRotDirTimeOut_flg_ovrdflg@ */ Scalar_BOOLEAN 0 SWC_OUTP_type_CM_boolean_flg 0.0 1.0 /end CHARACTERISTIC
/begin CHARACTERISTIC KOUTP_LRWhlRotDirTimeOut_flg_ovrdval "" VALUE 0x0000 /* @ECU_Address@KOUTP_LRWhlRotDirTimeOut_flg_ovrdval@ */ Scalar_BOOLEAN 0 SWC_OUTP_type_CM_boolean_flg 0.0 1.0 /end CHARACTERISTIC
/begin CHARACTERISTIC KOUTP_LRWhlRotDir_enum_ovrdflg "" VALUE 0x0000 /* @ECU_Address@KOUTP_LRWhlRotDir_enum_ovrdflg@ */ Scalar_BOOLEAN 0 SWC_OUTP_type_CM_boolean_flg 0.0 1.0 /end CHARACTERISTIC
/begin CHARACTERISTIC KOUTP_LatAccelTimeOut_flg_maxval "" VALUE 0x0000 /* @ECU_Address@KOUTP_LatAccelTimeOut_flg_maxval@ */ Scalar_BOOLEAN 0 SWC_OUTP_type_CM_boolean_flg 0.0 1.0 /end CHARACTERISTIC
/begin CHARACTERISTIC KOUTP_LatAccelTimeOut_flg_minval "" VALUE 0x0000 /* @ECU_Address@KOUTP_LatAccelTimeOut_flg_minval@ */ Scalar_BOOLEAN 0 SWC_OUTP_type_CM_boolean_flg 0.0 1.0 /end CHARACTERISTIC
/begin CHARACTERISTIC KOUTP_LatAccelTimeOut_flg_ovrdflg "" VALUE 0x0000 /* @ECU_Address@KOUTP_LatAccelTimeOut_flg_ovrdflg@ */ Scalar_BOOLEAN 0 SWC_OUTP_type_CM_boolean_flg 0.0 1.0 /end CHARACTERISTIC
/begin CHARACTERISTIC KOUTP_LatAccelTimeOut_flg_ovrdval "" VALUE 0x0000 /* @ECU_Address@KOUTP_LatAccelTimeOut_flg_ovrdval@ */ Scalar_BOOLEAN 0 SWC_OUTP_type_CM_boolean_flg 0.0 1.0 /end CHARACTERISTIC
/begin CHARACTERISTIC KOUTP_LatAccelVTimeOut_flg_maxval "" VALUE 0x0000 /* @ECU_Address@KOUTP_LatAccelVTimeOut_flg_maxval@ */ Scalar_BOOLEAN 0 SWC_OUTP_type_CM_boolean_flg 0.0 1.0 /end CHARACTERISTIC
/begin CHARACTERISTIC KOUTP_LatAccelVTimeOut_flg_minval "" VALUE 0x0000 /* @ECU_Address@KOUTP_LatAccelVTimeOut_flg_minval@ */ Scalar_BOOLEAN 0 SWC_OUTP_type_CM_boolean_flg 0.0 1.0 /end CHARACTERISTIC
/begin CHARACTERISTIC KOUTP_LatAccelVTimeOut_flg_ovrdflg "" VALUE 0x0000 /* @ECU_Address@KOUTP_LatAccelVTimeOut_flg_ovrdflg@ */ Scalar_BOOLEAN 0 SWC_OUTP_type_CM_boolean_flg 0.0 1.0 /end CHARACTERISTIC
/begin CHARACTERISTIC KOUTP_LatAccelVTimeOut_flg_ovrdval "" VALUE 0x0000 /* @ECU_Address@KOUTP_LatAccelVTimeOut_flg_ovrdval@ */ Scalar_BOOLEAN 0 SWC_OUTP_type_CM_boolean_flg 0.0 1.0 /end CHARACTERISTIC
/begin CHARACTERISTIC KOUTP_LatAccelV_flg_maxval "" VALUE 0x0000 /* @ECU_Address@KOUTP_LatAccelV_flg_maxval@ */ Scalar_BOOLEAN 0 SWC_OUTP_type_CM_boolean_flg 0.0 1.0 /end CHARACTERISTIC
/begin CHARACTERISTIC KOUTP_LatAccelV_flg_minval "" VALUE 0x0000 /* @ECU_Address@KOUTP_LatAccelV_flg_minval@ */ Scalar_BOOLEAN 0 SWC_OUTP_type_CM_boolean_flg 0.0 1.0 /end CHARACTERISTIC
/begin CHARACTERISTIC KOUTP_LatAccelV_flg_ovrdflg "" VALUE 0x0000 /* @ECU_Address@KOUTP_LatAccelV_flg_ovrdflg@ */ Scalar_BOOLEAN 0 SWC_OUTP_type_CM_boolean_flg 0.0 1.0 /end CHARACTERISTIC
/begin CHARACTERISTIC KOUTP_LatAccelV_flg_ovrdval "" VALUE 0x0000 /* @ECU_Address@KOUTP_LatAccelV_flg_ovrdval@ */ Scalar_BOOLEAN 0 SWC_OUTP_type_CM_boolean_flg 0.0 1.0 /end CHARACTERISTIC
/begin CHARACTERISTIC KOUTP_LatAccel_Gps_ovrdflg "" VALUE 0x0000 /* @ECU_Address@KOUTP_LatAccel_Gps_ovrdflg@ */ Scalar_BOOLEAN 0 SWC_OUTP_type_CM_boolean_flg 0.0 1.0 /end CHARACTERISTIC
/begin CHARACTERISTIC KOUTP_LongAccelTimeOut_flg_maxval "" VALUE 0x0000 /* @ECU_Address@KOUTP_LongAccelTimeOut_flg_maxval@ */ Scalar_BOOLEAN 0 SWC_OUTP_type_CM_boolean_flg 0.0 1.0 /end CHARACTERISTIC
/begin CHARACTERISTIC KOUTP_LongAccelTimeOut_flg_minval "" VALUE 0x0000 /* @ECU_Address@KOUTP_LongAccelTimeOut_flg_minval@ */ Scalar_BOOLEAN 0 SWC_OUTP_type_CM_boolean_flg 0.0 1.0 /end CHARACTERISTIC
/begin CHARACTERISTIC KOUTP_LongAccelTimeOut_flg_ovrdflg "" VALUE 0x0000 /* @ECU_Address@KOUTP_LongAccelTimeOut_flg_ovrdflg@ */ Scalar_BOOLEAN 0 SWC_OUTP_type_CM_boolean_flg 0.0 1.0 /end CHARACTERISTIC
/begin CHARACTERISTIC KOUTP_LongAccelTimeOut_flg_ovrdval "" VALUE 0x0000 /* @ECU_Address@KOUTP_LongAccelTimeOut_flg_ovrdval@ */ Scalar_BOOLEAN 0 SWC_OUTP_type_CM_boolean_flg 0.0 1.0 /end CHARACTERISTIC
/begin CHARACTERISTIC KOUTP_LongAccelVTimeOut_flg_maxval "" VALUE 0x0000 /* @ECU_Address@KOUTP_LongAccelVTimeOut_flg_maxval@ */ Scalar_BOOLEAN 0 SWC_OUTP_type_CM_boolean_flg 0.0 1.0 /end CHARACTERISTIC
/begin CHARACTERISTIC KOUTP_LongAccelVTimeOut_flg_minval "" VALUE 0x0000 /* @ECU_Address@KOUTP_LongAccelVTimeOut_flg_minval@ */ Scalar_BOOLEAN 0 SWC_OUTP_type_CM_boolean_flg 0.0 1.0 /end CHARACTERISTIC
/begin CHARACTERISTIC KOUTP_LongAccelVTimeOut_flg_ovrdflg "" VALUE 0x0000 /* @ECU_Address@KOUTP_LongAccelVTimeOut_flg_ovrdflg@ */ Scalar_BOOLEAN 0 SWC_OUTP_type_CM_boolean_flg 0.0 1.0 /end CHARACTERISTIC
/begin CHARACTERISTIC KOUTP_LongAccelVTimeOut_flg_ovrdval "" VALUE 0x0000 /* @ECU_Address@KOUTP_LongAccelVTimeOut_flg_ovrdval@ */ Scalar_BOOLEAN 0 SWC_OUTP_type_CM_boolean_flg 0.0 1.0 /end CHARACTERISTIC
/begin CHARACTERISTIC KOUTP_LongAccelV_flg_maxval "" VALUE 0x0000 /* @ECU_Address@KOUTP_LongAccelV_flg_maxval@ */ Scalar_BOOLEAN 0 SWC_OUTP_type_CM_boolean_flg 0.0 1.0 /end CHARACTERISTIC
/begin CHARACTERISTIC KOUTP_LongAccelV_flg_minval "" VALUE 0x0000 /* @ECU_Address@KOUTP_LongAccelV_flg_minval@ */ Scalar_BOOLEAN 0 SWC_OUTP_type_CM_boolean_flg 0.0 1.0 /end CHARACTERISTIC
/begin CHARACTERISTIC KOUTP_LongAccelV_flg_ovrdflg "" VALUE 0x0000 /* @ECU_Address@KOUTP_LongAccelV_flg_ovrdflg@ */ Scalar_BOOLEAN 0 SWC_OUTP_type_CM_boolean_flg 0.0 1.0 /end CHARACTERISTIC
/begin CHARACTERISTIC KOUTP_LongAccelV_flg_ovrdval "" VALUE 0x0000 /* @ECU_Address@KOUTP_LongAccelV_flg_ovrdval@ */ Scalar_BOOLEAN 0 SWC_OUTP_type_CM_boolean_flg 0.0 1.0 /end CHARACTERISTIC
/begin CHARACTERISTIC KOUTP_LongAccel_Gps_ovrdflg "" VALUE 0x0000 /* @ECU_Address@KOUTP_LongAccel_Gps_ovrdflg@ */ Scalar_BOOLEAN 0 SWC_OUTP_type_CM_boolean_flg 0.0 1.0 /end CHARACTERISTIC
/begin CHARACTERISTIC KOUTP_MCPressureTimeOut_flg_maxval "" VALUE 0x0000 /* @ECU_Address@KOUTP_MCPressureTimeOut_flg_maxval@ */ Scalar_BOOLEAN 0 SWC_OUTP_type_CM_boolean_flg 0.0 1.0 /end CHARACTERISTIC
/begin CHARACTERISTIC KOUTP_MCPressureTimeOut_flg_minval "" VALUE 0x0000 /* @ECU_Address@KOUTP_MCPressureTimeOut_flg_minval@ */ Scalar_BOOLEAN 0 SWC_OUTP_type_CM_boolean_flg 0.0 1.0 /end CHARACTERISTIC
/begin CHARACTERISTIC KOUTP_MCPressureTimeOut_flg_ovrdflg "" VALUE 0x0000 /* @ECU_Address@KOUTP_MCPressureTimeOut_flg_ovrdflg@ */ Scalar_BOOLEAN 0 SWC_OUTP_type_CM_boolean_flg 0.0 1.0 /end CHARACTERISTIC
/begin CHARACTERISTIC KOUTP_MCPressureTimeOut_flg_ovrdval "" VALUE 0x0000 /* @ECU_Address@KOUTP_MCPressureTimeOut_flg_ovrdval@ */ Scalar_BOOLEAN 0 SWC_OUTP_type_CM_boolean_flg 0.0 1.0 /end CHARACTERISTIC
/begin CHARACTERISTIC KOUTP_MCPressureVTimeOut_flg_maxval "" VALUE 0x0000 /* @ECU_Address@KOUTP_MCPressureVTimeOut_flg_maxval@ */ Scalar_BOOLEAN 0 SWC_OUTP_type_CM_boolean_flg 0.0 1.0 /end CHARACTERISTIC
/begin CHARACTERISTIC KOUTP_MCPressureVTimeOut_flg_minval "" VALUE 0x0000 /* @ECU_Address@KOUTP_MCPressureVTimeOut_flg_minval@ */ Scalar_BOOLEAN 0 SWC_OUTP_type_CM_boolean_flg 0.0 1.0 /end CHARACTERISTIC
/begin CHARACTERISTIC KOUTP_MCPressureVTimeOut_flg_ovrdflg "" VALUE 0x0000 /* @ECU_Address@KOUTP_MCPressureVTimeOut_flg_ovrdflg@ */ Scalar_BOOLEAN 0 SWC_OUTP_type_CM_boolean_flg 0.0 1.0 /end CHARACTERISTIC
/begin CHARACTERISTIC KOUTP_MCPressureVTimeOut_flg_ovrdval "" VALUE 0x0000 /* @ECU_Address@KOUTP_MCPressureVTimeOut_flg_ovrdval@ */ Scalar_BOOLEAN 0 SWC_OUTP_type_CM_boolean_flg 0.0 1.0 /end CHARACTERISTIC
/begin CHARACTERISTIC KOUTP_MCPressureV_bar_maxval "" VALUE 0x0000 /* @ECU_Address@KOUTP_MCPressureV_bar_maxval@ */ Scalar_BOOLEAN 0 SWC_OUTP_type_CM_boolean_flg 0.0 1.0 /end CHARACTERISTIC
/begin CHARACTERISTIC KOUTP_MCPressureV_bar_minval "" VALUE 0x0000 /* @ECU_Address@KOUTP_MCPressureV_bar_minval@ */ Scalar_BOOLEAN 0 SWC_OUTP_type_CM_boolean_flg 0.0 1.0 /end CHARACTERISTIC
/begin CHARACTERISTIC KOUTP_MCPressureV_bar_ovrdflg "" VALUE 0x0000 /* @ECU_Address@KOUTP_MCPressureV_bar_ovrdflg@ */ Scalar_BOOLEAN 0 SWC_OUTP_type_CM_boolean_flg 0.0 1.0 /end CHARACTERISTIC
/begin CHARACTERISTIC KOUTP_MCPressureV_bar_ovrdval "" VALUE 0x0000 /* @ECU_Address@KOUTP_MCPressureV_bar_ovrdval@ */ Scalar_BOOLEAN 0 SWC_OUTP_type_CM_boolean_bar 0.0 1.0 /end CHARACTERISTIC
/begin CHARACTERISTIC KOUTP_MCPressure_bar_ovrdflg "" VALUE 0x0000 /* @ECU_Address@KOUTP_MCPressure_bar_ovrdflg@ */ Scalar_BOOLEAN 0 SWC_OUTP_type_CM_boolean_flg 0.0 1.0 /end CHARACTERISTIC
/begin CHARACTERISTIC KOUTP_ModOperation_enum_ovrdflg "" VALUE 0x0000 /* @ECU_Address@KOUTP_ModOperation_enum_ovrdflg@ */ Scalar_BOOLEAN 0 SWC_OUTP_type_CM_boolean_flg 0.0 1.0 /end CHARACTERISTIC
/begin CHARACTERISTIC KOUTP_PASAFCL_enum_ovrdflg "" VALUE 0x0000 /* @ECU_Address@KOUTP_PASAFCL_enum_ovrdflg@ */ Scalar_BOOLEAN 0 SWC_OUTP_type_CM_boolean_flg 0.0 1.0 /end CHARACTERISTIC
/begin CHARACTERISTIC KOUTP_PASAFCR_enum_ovrdflg "" VALUE 0x0000 /* @ECU_Address@KOUTP_PASAFCR_enum_ovrdflg@ */ Scalar_BOOLEAN 0 SWC_OUTP_type_CM_boolean_flg 0.0 1.0 /end CHARACTERISTIC
/begin CHARACTERISTIC KOUTP_PASAFML_enum_ovrdflg "" VALUE 0x0000 /* @ECU_Address@KOUTP_PASAFML_enum_ovrdflg@ */ Scalar_BOOLEAN 0 SWC_OUTP_type_CM_boolean_flg 0.0 1.0 /end CHARACTERISTIC
/begin CHARACTERISTIC KOUTP_PASAFMR_enum_ovrdflg "" VALUE 0x0000 /* @ECU_Address@KOUTP_PASAFMR_enum_ovrdflg@ */ Scalar_BOOLEAN 0 SWC_OUTP_type_CM_boolean_flg 0.0 1.0 /end CHARACTERISTIC
/begin CHARACTERISTIC KOUTP_PASARCL_enum_ovrdflg "" VALUE 0x0000 /* @ECU_Address@KOUTP_PASARCL_enum_ovrdflg@ */ Scalar_BOOLEAN 0 SWC_OUTP_type_CM_boolean_flg 0.0 1.0 /end CHARACTERISTIC
/begin CHARACTERISTIC KOUTP_PASARCR_enum_ovrdflg "" VALUE 0x0000 /* @ECU_Address@KOUTP_PASARCR_enum_ovrdflg@ */ Scalar_BOOLEAN 0 SWC_OUTP_type_CM_boolean_flg 0.0 1.0 /end CHARACTERISTIC
/begin CHARACTERISTIC KOUTP_PASARML_enum_ovrdflg "" VALUE 0x0000 /* @ECU_Address@KOUTP_PASARML_enum_ovrdflg@ */ Scalar_BOOLEAN 0 SWC_OUTP_type_CM_boolean_flg 0.0 1.0 /end CHARACTERISTIC
/begin CHARACTERISTIC KOUTP_PASARMR_enum_ovrdflg "" VALUE 0x0000 /* @ECU_Address@KOUTP_PASARMR_enum_ovrdflg@ */ Scalar_BOOLEAN 0 SWC_OUTP_type_CM_boolean_flg 0.0 1.0 /end CHARACTERISTIC
/begin CHARACTERISTIC KOUTP_PASDFCL_cm_ovrdflg "" VALUE 0x0000 /* @ECU_Address@KOUTP_PASDFCL_cm_ovrdflg@ */ Scalar_BOOLEAN 0 SWC_OUTP_type_CM_boolean_flg 0.0 1.0 /end CHARACTERISTIC
/begin CHARACTERISTIC KOUTP_PASDFCR_cm_ovrdflg "" VALUE 0x0000 /* @ECU_Address@KOUTP_PASDFCR_cm_ovrdflg@ */ Scalar_BOOLEAN 0 SWC_OUTP_type_CM_boolean_flg 0.0 1.0 /end CHARACTERISTIC
/begin CHARACTERISTIC KOUTP_PASDFML_cm_ovrdflg "" VALUE 0x0000 /* @ECU_Address@KOUTP_PASDFML_cm_ovrdflg@ */ Scalar_BOOLEAN 0 SWC_OUTP_type_CM_boolean_flg 0.0 1.0 /end CHARACTERISTIC
/begin CHARACTERISTIC KOUTP_PASDFMR_cm_ovrdflg "" VALUE 0x0000 /* @ECU_Address@KOUTP_PASDFMR_cm_ovrdflg@ */ Scalar_BOOLEAN 0 SWC_OUTP_type_CM_boolean_flg 0.0 1.0 /end CHARACTERISTIC
/begin CHARACTERISTIC KOUTP_PASDRCL_cm_ovrdflg "" VALUE 0x0000 /* @ECU_Address@KOUTP_PASDRCL_cm_ovrdflg@ */ Scalar_BOOLEAN 0 SWC_OUTP_type_CM_boolean_flg 0.0 1.0 /end CHARACTERISTIC
/begin CHARACTERISTIC KOUTP_PASDRCR_cm_ovrdflg "" VALUE 0x0000 /* @ECU_Address@KOUTP_PASDRCR_cm_ovrdflg@ */ Scalar_BOOLEAN 0 SWC_OUTP_type_CM_boolean_flg 0.0 1.0 /end CHARACTERISTIC
/begin CHARACTERISTIC KOUTP_PASDRML_cm_ovrdflg "" VALUE 0x0000 /* @ECU_Address@KOUTP_PASDRML_cm_ovrdflg@ */ Scalar_BOOLEAN 0 SWC_OUTP_type_CM_boolean_flg 0.0 1.0 /end CHARACTERISTIC
/begin CHARACTERISTIC KOUTP_PASDRMR_cm_ovrdflg "" VALUE 0x0000 /* @ECU_Address@KOUTP_PASDRMR_cm_ovrdflg@ */ Scalar_BOOLEAN 0 SWC_OUTP_type_CM_boolean_flg 0.0 1.0 /end CHARACTERISTIC
/begin CHARACTERISTIC KOUTP_PUIDLowPower_flg_maxval "" VALUE 0x0000 /* @ECU_Address@KOUTP_PUIDLowPower_flg_maxval@ */ Scalar_BOOLEAN 0 SWC_OUTP_type_CM_boolean_flg 0.0 1.0 /end CHARACTERISTIC
/begin CHARACTERISTIC KOUTP_PUIDLowPower_flg_minval "" VALUE 0x0000 /* @ECU_Address@KOUTP_PUIDLowPower_flg_minval@ */ Scalar_BOOLEAN 0 SWC_OUTP_type_CM_boolean_flg 0.0 1.0 /end CHARACTERISTIC
/begin CHARACTERISTIC KOUTP_PUIDLowPower_flg_ovrdflg "" VALUE 0x0000 /* @ECU_Address@KOUTP_PUIDLowPower_flg_ovrdflg@ */ Scalar_BOOLEAN 0 SWC_OUTP_type_CM_boolean_flg 0.0 1.0 /end CHARACTERISTIC
/begin CHARACTERISTIC KOUTP_PUIDLowPower_flg_ovrdval "" VALUE 0x0000 /* @ECU_Address@KOUTP_PUIDLowPower_flg_ovrdval@ */ Scalar_BOOLEAN 0 SWC_OUTP_type_CM_boolean_flg 0.0 1.0 /end CHARACTERISTIC
/begin CHARACTERISTIC KOUTP_RAPSBCMLamp_enum_ovrdflg "" VALUE 0x0000 /* @ECU_Address@KOUTP_RAPSBCMLamp_enum_ovrdflg@ */ Scalar_BOOLEAN 0 SWC_OUTP_type_CM_boolean_flg 0.0 1.0 /end CHARACTERISTIC
/begin CHARACTERISTIC KOUTP_RAPSBCMLockReq_flg_maxval "" VALUE 0x0000 /* @ECU_Address@KOUTP_RAPSBCMLockReq_flg_maxval@ */ Scalar_BOOLEAN 0 SWC_OUTP_type_CM_boolean_flg 0.0 1.0 /end CHARACTERISTIC
/begin CHARACTERISTIC KOUTP_RAPSBCMLockReq_flg_minval "" VALUE 0x0000 /* @ECU_Address@KOUTP_RAPSBCMLockReq_flg_minval@ */ Scalar_BOOLEAN 0 SWC_OUTP_type_CM_boolean_flg 0.0 1.0 /end CHARACTERISTIC
/begin CHARACTERISTIC KOUTP_RAPSBCMLockReq_flg_ovrdflg "" VALUE 0x0000 /* @ECU_Address@KOUTP_RAPSBCMLockReq_flg_ovrdflg@ */ Scalar_BOOLEAN 0 SWC_OUTP_type_CM_boolean_flg 0.0 1.0 /end CHARACTERISTIC
/begin CHARACTERISTIC KOUTP_RAPSBCMLockReq_flg_ovrdval "" VALUE 0x0000 /* @ECU_Address@KOUTP_RAPSBCMLockReq_flg_ovrdval@ */ Scalar_BOOLEAN 0 SWC_OUTP_type_CM_boolean_flg 0.0 1.0 /end CHARACTERISTIC
/begin CHARACTERISTIC KOUTP_RAPSErrLv1_flg_maxval "" VALUE 0x0000 /* @ECU_Address@KOUTP_RAPSErrLv1_flg_maxval@ */ Scalar_BOOLEAN 0 SWC_OUTP_type_CM_boolean_flg 0.0 1.0 /end CHARACTERISTIC
/begin CHARACTERISTIC KOUTP_RAPSErrLv1_flg_minval "" VALUE 0x0000 /* @ECU_Address@KOUTP_RAPSErrLv1_flg_minval@ */ Scalar_BOOLEAN 0 SWC_OUTP_type_CM_boolean_flg 0.0 1.0 /end CHARACTERISTIC
/begin CHARACTERISTIC KOUTP_RAPSErrLv1_flg_ovrdflg "" VALUE 0x0000 /* @ECU_Address@KOUTP_RAPSErrLv1_flg_ovrdflg@ */ Scalar_BOOLEAN 0 SWC_OUTP_type_CM_boolean_flg 0.0 1.0 /end CHARACTERISTIC
/begin CHARACTERISTIC KOUTP_RAPSErrLv1_flg_ovrdval "" VALUE 0x0000 /* @ECU_Address@KOUTP_RAPSErrLv1_flg_ovrdval@ */ Scalar_BOOLEAN 0 SWC_OUTP_type_CM_boolean_flg 0.0 1.0 /end CHARACTERISTIC
/begin CHARACTERISTIC KOUTP_RAPSErrWarnSta_enum_ovrdflg "" VALUE 0x0000 /* @ECU_Address@KOUTP_RAPSErrWarnSta_enum_ovrdflg@ */ Scalar_BOOLEAN 0 SWC_OUTP_type_CM_boolean_flg 0.0 1.0 /end CHARACTERISTIC
/begin CHARACTERISTIC KOUTP_RFPulseCountTimeOut_flg_maxval "" VALUE 0x0000 /* @ECU_Address@KOUTP_RFPulseCountTimeOut_flg_maxval@ */ Scalar_BOOLEAN 0 SWC_OUTP_type_CM_boolean_flg 0.0 1.0 /end CHARACTERISTIC
/begin CHARACTERISTIC KOUTP_RFPulseCountTimeOut_flg_minval "" VALUE 0x0000 /* @ECU_Address@KOUTP_RFPulseCountTimeOut_flg_minval@ */ Scalar_BOOLEAN 0 SWC_OUTP_type_CM_boolean_flg 0.0 1.0 /end CHARACTERISTIC
/begin CHARACTERISTIC KOUTP_RFPulseCountTimeOut_flg_ovrdflg "" VALUE 0x0000 /* @ECU_Address@KOUTP_RFPulseCountTimeOut_flg_ovrdflg@ */ Scalar_BOOLEAN 0 SWC_OUTP_type_CM_boolean_flg 0.0 1.0 /end CHARACTERISTIC
/begin CHARACTERISTIC KOUTP_RFPulseCountTimeOut_flg_ovrdval "" VALUE 0x0000 /* @ECU_Address@KOUTP_RFPulseCountTimeOut_flg_ovrdval@ */ Scalar_BOOLEAN 0 SWC_OUTP_type_CM_boolean_flg 0.0 1.0 /end CHARACTERISTIC
/begin CHARACTERISTIC KOUTP_RFPulseCountVTimeOut_flg_maxval "" VALUE 0x0000 /* @ECU_Address@KOUTP_RFPulseCountVTimeOut_flg_maxval@ */ Scalar_BOOLEAN 0 SWC_OUTP_type_CM_boolean_flg 0.0 1.0 /end CHARACTERISTIC
/begin CHARACTERISTIC KOUTP_RFPulseCountVTimeOut_flg_minval "" VALUE 0x0000 /* @ECU_Address@KOUTP_RFPulseCountVTimeOut_flg_minval@ */ Scalar_BOOLEAN 0 SWC_OUTP_type_CM_boolean_flg 0.0 1.0 /end CHARACTERISTIC
/begin CHARACTERISTIC KOUTP_RFPulseCountVTimeOut_flg_ovrdflg "" VALUE 0x0000 /* @ECU_Address@KOUTP_RFPulseCountVTimeOut_flg_ovrdflg@ */ Scalar_BOOLEAN 0 SWC_OUTP_type_CM_boolean_flg 0.0 1.0 /end CHARACTERISTIC
/begin CHARACTERISTIC KOUTP_RFPulseCountVTimeOut_flg_ovrdval "" VALUE 0x0000 /* @ECU_Address@KOUTP_RFPulseCountVTimeOut_flg_ovrdval@ */ Scalar_BOOLEAN 0 SWC_OUTP_type_CM_boolean_flg 0.0 1.0 /end CHARACTERISTIC
/begin CHARACTERISTIC KOUTP_RFPulseCountV_flg_maxval "" VALUE 0x0000 /* @ECU_Address@KOUTP_RFPulseCountV_flg_maxval@ */ Scalar_BOOLEAN 0 SWC_OUTP_type_CM_boolean_flg 0.0 1.0 /end CHARACTERISTIC
/begin CHARACTERISTIC KOUTP_RFPulseCountV_flg_minval "" VALUE 0x0000 /* @ECU_Address@KOUTP_RFPulseCountV_flg_minval@ */ Scalar_BOOLEAN 0 SWC_OUTP_type_CM_boolean_flg 0.0 1.0 /end CHARACTERISTIC
/begin CHARACTERISTIC KOUTP_RFPulseCountV_flg_ovrdflg "" VALUE 0x0000 /* @ECU_Address@KOUTP_RFPulseCountV_flg_ovrdflg@ */ Scalar_BOOLEAN 0 SWC_OUTP_type_CM_boolean_flg 0.0 1.0 /end CHARACTERISTIC
/begin CHARACTERISTIC KOUTP_RFPulseCountV_flg_ovrdval "" VALUE 0x0000 /* @ECU_Address@KOUTP_RFPulseCountV_flg_ovrdval@ */ Scalar_BOOLEAN 0 SWC_OUTP_type_CM_boolean_flg 0.0 1.0 /end CHARACTERISTIC
/begin CHARACTERISTIC KOUTP_RFPulseCount_enum_ovrdflg "" VALUE 0x0000 /* @ECU_Address@KOUTP_RFPulseCount_enum_ovrdflg@ */ Scalar_BOOLEAN 0 SWC_OUTP_type_CM_boolean_flg 0.0 1.0 /end CHARACTERISTIC
/begin CHARACTERISTIC KOUTP_RFRawWhlSpeedTimeOut_flg_maxval "" VALUE 0x0000 /* @ECU_Address@KOUTP_RFRawWhlSpeedTimeOut_flg_maxval@ */ Scalar_BOOLEAN 0 SWC_OUTP_type_CM_boolean_flg 0.0 1.0 /end CHARACTERISTIC
/begin CHARACTERISTIC KOUTP_RFRawWhlSpeedTimeOut_flg_minval "" VALUE 0x0000 /* @ECU_Address@KOUTP_RFRawWhlSpeedTimeOut_flg_minval@ */ Scalar_BOOLEAN 0 SWC_OUTP_type_CM_boolean_flg 0.0 1.0 /end CHARACTERISTIC
/begin CHARACTERISTIC KOUTP_RFRawWhlSpeedTimeOut_flg_ovrdflg "" VALUE 0x0000 /* @ECU_Address@KOUTP_RFRawWhlSpeedTimeOut_flg_ovrdflg@ */ Scalar_BOOLEAN 0 SWC_OUTP_type_CM_boolean_flg 0.0 1.0 /end CHARACTERISTIC
/begin CHARACTERISTIC KOUTP_RFRawWhlSpeedTimeOut_flg_ovrdval "" VALUE 0x0000 /* @ECU_Address@KOUTP_RFRawWhlSpeedTimeOut_flg_ovrdval@ */ Scalar_BOOLEAN 0 SWC_OUTP_type_CM_boolean_flg 0.0 1.0 /end CHARACTERISTIC
/begin CHARACTERISTIC KOUTP_RFRawWhlSpeedVTimeOut_flg_maxval "" VALUE 0x0000 /* @ECU_Address@KOUTP_RFRawWhlSpeedVTimeOut_flg_maxval@ */ Scalar_BOOLEAN 0 SWC_OUTP_type_CM_boolean_flg 0.0 1.0 /end CHARACTERISTIC
/begin CHARACTERISTIC KOUTP_RFRawWhlSpeedVTimeOut_flg_minval "" VALUE 0x0000 /* @ECU_Address@KOUTP_RFRawWhlSpeedVTimeOut_flg_minval@ */ Scalar_BOOLEAN 0 SWC_OUTP_type_CM_boolean_flg 0.0 1.0 /end CHARACTERISTIC
/begin CHARACTERISTIC KOUTP_RFRawWhlSpeedVTimeOut_flg_ovrdflg "" VALUE 0x0000 /* @ECU_Address@KOUTP_RFRawWhlSpeedVTimeOut_flg_ovrdflg@ */ Scalar_BOOLEAN 0 SWC_OUTP_type_CM_boolean_flg 0.0 1.0 /end CHARACTERISTIC
/begin CHARACTERISTIC KOUTP_RFRawWhlSpeedVTimeOut_flg_ovrdval "" VALUE 0x0000 /* @ECU_Address@KOUTP_RFRawWhlSpeedVTimeOut_flg_ovrdval@ */ Scalar_BOOLEAN 0 SWC_OUTP_type_CM_boolean_flg 0.0 1.0 /end CHARACTERISTIC
/begin CHARACTERISTIC KOUTP_RFRawWhlSpeedV_flg_maxval "" VALUE 0x0000 /* @ECU_Address@KOUTP_RFRawWhlSpeedV_flg_maxval@ */ Scalar_BOOLEAN 0 SWC_OUTP_type_CM_boolean_flg 0.0 1.0 /end CHARACTERISTIC
/begin CHARACTERISTIC KOUTP_RFRawWhlSpeedV_flg_minval "" VALUE 0x0000 /* @ECU_Address@KOUTP_RFRawWhlSpeedV_flg_minval@ */ Scalar_BOOLEAN 0 SWC_OUTP_type_CM_boolean_flg 0.0 1.0 /end CHARACTERISTIC
/begin CHARACTERISTIC KOUTP_RFRawWhlSpeedV_flg_ovrdflg "" VALUE 0x0000 /* @ECU_Address@KOUTP_RFRawWhlSpeedV_flg_ovrdflg@ */ Scalar_BOOLEAN 0 SWC_OUTP_type_CM_boolean_flg 0.0 1.0 /end CHARACTERISTIC
/begin CHARACTERISTIC KOUTP_RFRawWhlSpeedV_flg_ovrdval "" VALUE 0x0000 /* @ECU_Address@KOUTP_RFRawWhlSpeedV_flg_ovrdval@ */ Scalar_BOOLEAN 0 SWC_OUTP_type_CM_boolean_flg 0.0 1.0 /end CHARACTERISTIC
/begin CHARACTERISTIC KOUTP_RFRawWhlSpeed_kph_ovrdflg "" VALUE 0x0000 /* @ECU_Address@KOUTP_RFRawWhlSpeed_kph_ovrdflg@ */ Scalar_BOOLEAN 0 SWC_OUTP_type_CM_boolean_flg 0.0 1.0 /end CHARACTERISTIC
/begin CHARACTERISTIC KOUTP_RFWhlRotDirTimeOut_flg_maxval "" VALUE 0x0000 /* @ECU_Address@KOUTP_RFWhlRotDirTimeOut_flg_maxval@ */ Scalar_BOOLEAN 0 SWC_OUTP_type_CM_boolean_flg 0.0 1.0 /end CHARACTERISTIC
/begin CHARACTERISTIC KOUTP_RFWhlRotDirTimeOut_flg_minval "" VALUE 0x0000 /* @ECU_Address@KOUTP_RFWhlRotDirTimeOut_flg_minval@ */ Scalar_BOOLEAN 0 SWC_OUTP_type_CM_boolean_flg 0.0 1.0 /end CHARACTERISTIC
/begin CHARACTERISTIC KOUTP_RFWhlRotDirTimeOut_flg_ovrdflg "" VALUE 0x0000 /* @ECU_Address@KOUTP_RFWhlRotDirTimeOut_flg_ovrdflg@ */ Scalar_BOOLEAN 0 SWC_OUTP_type_CM_boolean_flg 0.0 1.0 /end CHARACTERISTIC
/begin CHARACTERISTIC KOUTP_RFWhlRotDirTimeOut_flg_ovrdval "" VALUE 0x0000 /* @ECU_Address@KOUTP_RFWhlRotDirTimeOut_flg_ovrdval@ */ Scalar_BOOLEAN 0 SWC_OUTP_type_CM_boolean_flg 0.0 1.0 /end CHARACTERISTIC
/begin CHARACTERISTIC KOUTP_RFWhlRotDir_enum_ovrdflg "" VALUE 0x0000 /* @ECU_Address@KOUTP_RFWhlRotDir_enum_ovrdflg@ */ Scalar_BOOLEAN 0 SWC_OUTP_type_CM_boolean_flg 0.0 1.0 /end CHARACTERISTIC
/begin CHARACTERISTIC KOUTP_RRPulseCountTimeOut_flg_maxval "" VALUE 0x0000 /* @ECU_Address@KOUTP_RRPulseCountTimeOut_flg_maxval@ */ Scalar_BOOLEAN 0 SWC_OUTP_type_CM_boolean_flg 0.0 1.0 /end CHARACTERISTIC
/begin CHARACTERISTIC KOUTP_RRPulseCountTimeOut_flg_minval "" VALUE 0x0000 /* @ECU_Address@KOUTP_RRPulseCountTimeOut_flg_minval@ */ Scalar_BOOLEAN 0 SWC_OUTP_type_CM_boolean_flg 0.0 1.0 /end CHARACTERISTIC
/begin CHARACTERISTIC KOUTP_RRPulseCountTimeOut_flg_ovrdflg "" VALUE 0x0000 /* @ECU_Address@KOUTP_RRPulseCountTimeOut_flg_ovrdflg@ */ Scalar_BOOLEAN 0 SWC_OUTP_type_CM_boolean_flg 0.0 1.0 /end CHARACTERISTIC
/begin CHARACTERISTIC KOUTP_RRPulseCountTimeOut_flg_ovrdval "" VALUE 0x0000 /* @ECU_Address@KOUTP_RRPulseCountTimeOut_flg_ovrdval@ */ Scalar_BOOLEAN 0 SWC_OUTP_type_CM_boolean_flg 0.0 1.0 /end CHARACTERISTIC
/begin CHARACTERISTIC KOUTP_RRPulseCountVTimeOut_flg_maxval "" VALUE 0x0000 /* @ECU_Address@KOUTP_RRPulseCountVTimeOut_flg_maxval@ */ Scalar_BOOLEAN 0 SWC_OUTP_type_CM_boolean_flg 0.0 1.0 /end CHARACTERISTIC
/begin CHARACTERISTIC KOUTP_RRPulseCountVTimeOut_flg_minval "" VALUE 0x0000 /* @ECU_Address@KOUTP_RRPulseCountVTimeOut_flg_minval@ */ Scalar_BOOLEAN 0 SWC_OUTP_type_CM_boolean_flg 0.0 1.0 /end CHARACTERISTIC
/begin CHARACTERISTIC KOUTP_RRPulseCountVTimeOut_flg_ovrdflg "" VALUE 0x0000 /* @ECU_Address@KOUTP_RRPulseCountVTimeOut_flg_ovrdflg@ */ Scalar_BOOLEAN 0 SWC_OUTP_type_CM_boolean_flg 0.0 1.0 /end CHARACTERISTIC
/begin CHARACTERISTIC KOUTP_RRPulseCountVTimeOut_flg_ovrdval "" VALUE 0x0000 /* @ECU_Address@KOUTP_RRPulseCountVTimeOut_flg_ovrdval@ */ Scalar_BOOLEAN 0 SWC_OUTP_type_CM_boolean_flg 0.0 1.0 /end CHARACTERISTIC
/begin CHARACTERISTIC KOUTP_RRPulseCountV_flg_maxval "" VALUE 0x0000 /* @ECU_Address@KOUTP_RRPulseCountV_flg_maxval@ */ Scalar_BOOLEAN 0 SWC_OUTP_type_CM_boolean_flg 0.0 1.0 /end CHARACTERISTIC
/begin CHARACTERISTIC KOUTP_RRPulseCountV_flg_minval "" VALUE 0x0000 /* @ECU_Address@KOUTP_RRPulseCountV_flg_minval@ */ Scalar_BOOLEAN 0 SWC_OUTP_type_CM_boolean_flg 0.0 1.0 /end CHARACTERISTIC
/begin CHARACTERISTIC KOUTP_RRPulseCountV_flg_ovrdflg "" VALUE 0x0000 /* @ECU_Address@KOUTP_RRPulseCountV_flg_ovrdflg@ */ Scalar_BOOLEAN 0 SWC_OUTP_type_CM_boolean_flg 0.0 1.0 /end CHARACTERISTIC
/begin CHARACTERISTIC KOUTP_RRPulseCountV_flg_ovrdval "" VALUE 0x0000 /* @ECU_Address@KOUTP_RRPulseCountV_flg_ovrdval@ */ Scalar_BOOLEAN 0 SWC_OUTP_type_CM_boolean_flg 0.0 1.0 /end CHARACTERISTIC
/begin CHARACTERISTIC KOUTP_RRPulseCount_enum_ovrdflg "" VALUE 0x0000 /* @ECU_Address@KOUTP_RRPulseCount_enum_ovrdflg@ */ Scalar_BOOLEAN 0 SWC_OUTP_type_CM_boolean_flg 0.0 1.0 /end CHARACTERISTIC
/begin CHARACTERISTIC KOUTP_RRRawWhlSpeedTimeOut_flg_maxval "" VALUE 0x0000 /* @ECU_Address@KOUTP_RRRawWhlSpeedTimeOut_flg_maxval@ */ Scalar_BOOLEAN 0 SWC_OUTP_type_CM_boolean_flg 0.0 1.0 /end CHARACTERISTIC
/begin CHARACTERISTIC KOUTP_RRRawWhlSpeedTimeOut_flg_minval "" VALUE 0x0000 /* @ECU_Address@KOUTP_RRRawWhlSpeedTimeOut_flg_minval@ */ Scalar_BOOLEAN 0 SWC_OUTP_type_CM_boolean_flg 0.0 1.0 /end CHARACTERISTIC
/begin CHARACTERISTIC KOUTP_RRRawWhlSpeedTimeOut_flg_ovrdflg "" VALUE 0x0000 /* @ECU_Address@KOUTP_RRRawWhlSpeedTimeOut_flg_ovrdflg@ */ Scalar_BOOLEAN 0 SWC_OUTP_type_CM_boolean_flg 0.0 1.0 /end CHARACTERISTIC
/begin CHARACTERISTIC KOUTP_RRRawWhlSpeedTimeOut_flg_ovrdval "" VALUE 0x0000 /* @ECU_Address@KOUTP_RRRawWhlSpeedTimeOut_flg_ovrdval@ */ Scalar_BOOLEAN 0 SWC_OUTP_type_CM_boolean_flg 0.0 1.0 /end CHARACTERISTIC
/begin CHARACTERISTIC KOUTP_RRRawWhlSpeedVTimeOut_flg_maxval "" VALUE 0x0000 /* @ECU_Address@KOUTP_RRRawWhlSpeedVTimeOut_flg_maxval@ */ Scalar_BOOLEAN 0 SWC_OUTP_type_CM_boolean_flg 0.0 1.0 /end CHARACTERISTIC
/begin CHARACTERISTIC KOUTP_RRRawWhlSpeedVTimeOut_flg_minval "" VALUE 0x0000 /* @ECU_Address@KOUTP_RRRawWhlSpeedVTimeOut_flg_minval@ */ Scalar_BOOLEAN 0 SWC_OUTP_type_CM_boolean_flg 0.0 1.0 /end CHARACTERISTIC
/begin CHARACTERISTIC KOUTP_RRRawWhlSpeedVTimeOut_flg_ovrdflg "" VALUE 0x0000 /* @ECU_Address@KOUTP_RRRawWhlSpeedVTimeOut_flg_ovrdflg@ */ Scalar_BOOLEAN 0 SWC_OUTP_type_CM_boolean_flg 0.0 1.0 /end CHARACTERISTIC
/begin CHARACTERISTIC KOUTP_RRRawWhlSpeedVTimeOut_flg_ovrdval "" VALUE 0x0000 /* @ECU_Address@KOUTP_RRRawWhlSpeedVTimeOut_flg_ovrdval@ */ Scalar_BOOLEAN 0 SWC_OUTP_type_CM_boolean_flg 0.0 1.0 /end CHARACTERISTIC
/begin CHARACTERISTIC KOUTP_RRRawWhlSpeedV_flg_maxval "" VALUE 0x0000 /* @ECU_Address@KOUTP_RRRawWhlSpeedV_flg_maxval@ */ Scalar_BOOLEAN 0 SWC_OUTP_type_CM_boolean_flg 0.0 1.0 /end CHARACTERISTIC
/begin CHARACTERISTIC KOUTP_RRRawWhlSpeedV_flg_minval "" VALUE 0x0000 /* @ECU_Address@KOUTP_RRRawWhlSpeedV_flg_minval@ */ Scalar_BOOLEAN 0 SWC_OUTP_type_CM_boolean_flg 0.0 1.0 /end CHARACTERISTIC
/begin CHARACTERISTIC KOUTP_RRRawWhlSpeedV_flg_ovrdflg "" VALUE 0x0000 /* @ECU_Address@KOUTP_RRRawWhlSpeedV_flg_ovrdflg@ */ Scalar_BOOLEAN 0 SWC_OUTP_type_CM_boolean_flg 0.0 1.0 /end CHARACTERISTIC
/begin CHARACTERISTIC KOUTP_RRRawWhlSpeedV_flg_ovrdval "" VALUE 0x0000 /* @ECU_Address@KOUTP_RRRawWhlSpeedV_flg_ovrdval@ */ Scalar_BOOLEAN 0 SWC_OUTP_type_CM_boolean_flg 0.0 1.0 /end CHARACTERISTIC
/begin CHARACTERISTIC KOUTP_RRRawWhlSpeed_kph_ovrdflg "" VALUE 0x0000 /* @ECU_Address@KOUTP_RRRawWhlSpeed_kph_ovrdflg@ */ Scalar_BOOLEAN 0 SWC_OUTP_type_CM_boolean_flg 0.0 1.0 /end CHARACTERISTIC
/begin CHARACTERISTIC KOUTP_RRWhlRotDirTimeOut_flg_maxval "" VALUE 0x0000 /* @ECU_Address@KOUTP_RRWhlRotDirTimeOut_flg_maxval@ */ Scalar_BOOLEAN 0 SWC_OUTP_type_CM_boolean_flg 0.0 1.0 /end CHARACTERISTIC
/begin CHARACTERISTIC KOUTP_RRWhlRotDirTimeOut_flg_minval "" VALUE 0x0000 /* @ECU_Address@KOUTP_RRWhlRotDirTimeOut_flg_minval@ */ Scalar_BOOLEAN 0 SWC_OUTP_type_CM_boolean_flg 0.0 1.0 /end CHARACTERISTIC
/begin CHARACTERISTIC KOUTP_RRWhlRotDirTimeOut_flg_ovrdflg "" VALUE 0x0000 /* @ECU_Address@KOUTP_RRWhlRotDirTimeOut_flg_ovrdflg@ */ Scalar_BOOLEAN 0 SWC_OUTP_type_CM_boolean_flg 0.0 1.0 /end CHARACTERISTIC
/begin CHARACTERISTIC KOUTP_RRWhlRotDirTimeOut_flg_ovrdval "" VALUE 0x0000 /* @ECU_Address@KOUTP_RRWhlRotDirTimeOut_flg_ovrdval@ */ Scalar_BOOLEAN 0 SWC_OUTP_type_CM_boolean_flg 0.0 1.0 /end CHARACTERISTIC
/begin CHARACTERISTIC KOUTP_RRWhlRotDir_enum_ovrdflg "" VALUE 0x0000 /* @ECU_Address@KOUTP_RRWhlRotDir_enum_ovrdflg@ */ Scalar_BOOLEAN 0 SWC_OUTP_type_CM_boolean_flg 0.0 1.0 /end CHARACTERISTIC
/begin CHARACTERISTIC KOUTP_SASAngleTimeOut_flg_maxval "" VALUE 0x0000 /* @ECU_Address@KOUTP_SASAngleTimeOut_flg_maxval@ */ Scalar_BOOLEAN 0 SWC_OUTP_type_CM_boolean_flg 0.0 1.0 /end CHARACTERISTIC
/begin CHARACTERISTIC KOUTP_SASAngleTimeOut_flg_minval "" VALUE 0x0000 /* @ECU_Address@KOUTP_SASAngleTimeOut_flg_minval@ */ Scalar_BOOLEAN 0 SWC_OUTP_type_CM_boolean_flg 0.0 1.0 /end CHARACTERISTIC
/begin CHARACTERISTIC KOUTP_SASAngleTimeOut_flg_ovrdflg "" VALUE 0x0000 /* @ECU_Address@KOUTP_SASAngleTimeOut_flg_ovrdflg@ */ Scalar_BOOLEAN 0 SWC_OUTP_type_CM_boolean_flg 0.0 1.0 /end CHARACTERISTIC
/begin CHARACTERISTIC KOUTP_SASAngleTimeOut_flg_ovrdval "" VALUE 0x0000 /* @ECU_Address@KOUTP_SASAngleTimeOut_flg_ovrdval@ */ Scalar_BOOLEAN 0 SWC_OUTP_type_CM_boolean_flg 0.0 1.0 /end CHARACTERISTIC
/begin CHARACTERISTIC KOUTP_SASAngle_Deg_ovrdflg "" VALUE 0x0000 /* @ECU_Address@KOUTP_SASAngle_Deg_ovrdflg@ */ Scalar_BOOLEAN 0 SWC_OUTP_type_CM_boolean_flg 0.0 1.0 /end CHARACTERISTIC
/begin CHARACTERISTIC KOUTP_SASCALTimeOut_flg_maxval "" VALUE 0x0000 /* @ECU_Address@KOUTP_SASCALTimeOut_flg_maxval@ */ Scalar_BOOLEAN 0 SWC_OUTP_type_CM_boolean_flg 0.0 1.0 /end CHARACTERISTIC
/begin CHARACTERISTIC KOUTP_SASCALTimeOut_flg_minval "" VALUE 0x0000 /* @ECU_Address@KOUTP_SASCALTimeOut_flg_minval@ */ Scalar_BOOLEAN 0 SWC_OUTP_type_CM_boolean_flg 0.0 1.0 /end CHARACTERISTIC
/begin CHARACTERISTIC KOUTP_SASCALTimeOut_flg_ovrdflg "" VALUE 0x0000 /* @ECU_Address@KOUTP_SASCALTimeOut_flg_ovrdflg@ */ Scalar_BOOLEAN 0 SWC_OUTP_type_CM_boolean_flg 0.0 1.0 /end CHARACTERISTIC
/begin CHARACTERISTIC KOUTP_SASCALTimeOut_flg_ovrdval "" VALUE 0x0000 /* @ECU_Address@KOUTP_SASCALTimeOut_flg_ovrdval@ */ Scalar_BOOLEAN 0 SWC_OUTP_type_CM_boolean_flg 0.0 1.0 /end CHARACTERISTIC
/begin CHARACTERISTIC KOUTP_SASCAL_flg_maxval "" VALUE 0x0000 /* @ECU_Address@KOUTP_SASCAL_flg_maxval@ */ Scalar_BOOLEAN 0 SWC_OUTP_type_CM_boolean_flg 0.0 1.0 /end CHARACTERISTIC
/begin CHARACTERISTIC KOUTP_SASCAL_flg_minval "" VALUE 0x0000 /* @ECU_Address@KOUTP_SASCAL_flg_minval@ */ Scalar_BOOLEAN 0 SWC_OUTP_type_CM_boolean_flg 0.0 1.0 /end CHARACTERISTIC
/begin CHARACTERISTIC KOUTP_SASCAL_flg_ovrdflg "" VALUE 0x0000 /* @ECU_Address@KOUTP_SASCAL_flg_ovrdflg@ */ Scalar_BOOLEAN 0 SWC_OUTP_type_CM_boolean_flg 0.0 1.0 /end CHARACTERISTIC
/begin CHARACTERISTIC KOUTP_SASCAL_flg_ovrdval "" VALUE 0x0000 /* @ECU_Address@KOUTP_SASCAL_flg_ovrdval@ */ Scalar_BOOLEAN 0 SWC_OUTP_type_CM_boolean_flg 0.0 1.0 /end CHARACTERISTIC
/begin CHARACTERISTIC KOUTP_SASSpeedTimeOut_flg_maxval "" VALUE 0x0000 /* @ECU_Address@KOUTP_SASSpeedTimeOut_flg_maxval@ */ Scalar_BOOLEAN 0 SWC_OUTP_type_CM_boolean_flg 0.0 1.0 /end CHARACTERISTIC
/begin CHARACTERISTIC KOUTP_SASSpeedTimeOut_flg_minval "" VALUE 0x0000 /* @ECU_Address@KOUTP_SASSpeedTimeOut_flg_minval@ */ Scalar_BOOLEAN 0 SWC_OUTP_type_CM_boolean_flg 0.0 1.0 /end CHARACTERISTIC
/begin CHARACTERISTIC KOUTP_SASSpeedTimeOut_flg_ovrdflg "" VALUE 0x0000 /* @ECU_Address@KOUTP_SASSpeedTimeOut_flg_ovrdflg@ */ Scalar_BOOLEAN 0 SWC_OUTP_type_CM_boolean_flg 0.0 1.0 /end CHARACTERISTIC
/begin CHARACTERISTIC KOUTP_SASSpeedTimeOut_flg_ovrdval "" VALUE 0x0000 /* @ECU_Address@KOUTP_SASSpeedTimeOut_flg_ovrdval@ */ Scalar_BOOLEAN 0 SWC_OUTP_type_CM_boolean_flg 0.0 1.0 /end CHARACTERISTIC
/begin CHARACTERISTIC KOUTP_SASSpeedValidTimeOut_flg_maxval "" VALUE 0x0000 /* @ECU_Address@KOUTP_SASSpeedValidTimeOut_flg_maxval@ */ Scalar_BOOLEAN 0 SWC_OUTP_type_CM_boolean_flg 0.0 1.0 /end CHARACTERISTIC
/begin CHARACTERISTIC KOUTP_SASSpeedValidTimeOut_flg_minval "" VALUE 0x0000 /* @ECU_Address@KOUTP_SASSpeedValidTimeOut_flg_minval@ */ Scalar_BOOLEAN 0 SWC_OUTP_type_CM_boolean_flg 0.0 1.0 /end CHARACTERISTIC
/begin CHARACTERISTIC KOUTP_SASSpeedValidTimeOut_flg_ovrdflg "" VALUE 0x0000 /* @ECU_Address@KOUTP_SASSpeedValidTimeOut_flg_ovrdflg@ */ Scalar_BOOLEAN 0 SWC_OUTP_type_CM_boolean_flg 0.0 1.0 /end CHARACTERISTIC
/begin CHARACTERISTIC KOUTP_SASSpeedValidTimeOut_flg_ovrdval "" VALUE 0x0000 /* @ECU_Address@KOUTP_SASSpeedValidTimeOut_flg_ovrdval@ */ Scalar_BOOLEAN 0 SWC_OUTP_type_CM_boolean_flg 0.0 1.0 /end CHARACTERISTIC
/begin CHARACTERISTIC KOUTP_SASSpeedValid_flg_maxval "" VALUE 0x0000 /* @ECU_Address@KOUTP_SASSpeedValid_flg_maxval@ */ Scalar_BOOLEAN 0 SWC_OUTP_type_CM_boolean_flg 0.0 1.0 /end CHARACTERISTIC
/begin CHARACTERISTIC KOUTP_SASSpeedValid_flg_minval "" VALUE 0x0000 /* @ECU_Address@KOUTP_SASSpeedValid_flg_minval@ */ Scalar_BOOLEAN 0 SWC_OUTP_type_CM_boolean_flg 0.0 1.0 /end CHARACTERISTIC
/begin CHARACTERISTIC KOUTP_SASSpeedValid_flg_ovrdflg "" VALUE 0x0000 /* @ECU_Address@KOUTP_SASSpeedValid_flg_ovrdflg@ */ Scalar_BOOLEAN 0 SWC_OUTP_type_CM_boolean_flg 0.0 1.0 /end CHARACTERISTIC
/begin CHARACTERISTIC KOUTP_SASSpeedValid_flg_ovrdval "" VALUE 0x0000 /* @ECU_Address@KOUTP_SASSpeedValid_flg_ovrdval@ */ Scalar_BOOLEAN 0 SWC_OUTP_type_CM_boolean_flg 0.0 1.0 /end CHARACTERISTIC
/begin CHARACTERISTIC KOUTP_SASSpeed_degps_ovrdflg "" VALUE 0x0000 /* @ECU_Address@KOUTP_SASSpeed_degps_ovrdflg@ */ Scalar_BOOLEAN 0 SWC_OUTP_type_CM_boolean_flg 0.0 1.0 /end CHARACTERISTIC
/begin CHARACTERISTIC KOUTP_SASVTimeOut_flg_maxval "" VALUE 0x0000 /* @ECU_Address@KOUTP_SASVTimeOut_flg_maxval@ */ Scalar_BOOLEAN 0 SWC_OUTP_type_CM_boolean_flg 0.0 1.0 /end CHARACTERISTIC
/begin CHARACTERISTIC KOUTP_SASVTimeOut_flg_minval "" VALUE 0x0000 /* @ECU_Address@KOUTP_SASVTimeOut_flg_minval@ */ Scalar_BOOLEAN 0 SWC_OUTP_type_CM_boolean_flg 0.0 1.0 /end CHARACTERISTIC
/begin CHARACTERISTIC KOUTP_SASVTimeOut_flg_ovrdflg "" VALUE 0x0000 /* @ECU_Address@KOUTP_SASVTimeOut_flg_ovrdflg@ */ Scalar_BOOLEAN 0 SWC_OUTP_type_CM_boolean_flg 0.0 1.0 /end CHARACTERISTIC
/begin CHARACTERISTIC KOUTP_SASVTimeOut_flg_ovrdval "" VALUE 0x0000 /* @ECU_Address@KOUTP_SASVTimeOut_flg_ovrdval@ */ Scalar_BOOLEAN 0 SWC_OUTP_type_CM_boolean_flg 0.0 1.0 /end CHARACTERISTIC
/begin CHARACTERISTIC KOUTP_SASV_flg_maxval "" VALUE 0x0000 /* @ECU_Address@KOUTP_SASV_flg_maxval@ */ Scalar_BOOLEAN 0 SWC_OUTP_type_CM_boolean_flg 0.0 1.0 /end CHARACTERISTIC
/begin CHARACTERISTIC KOUTP_SASV_flg_minval "" VALUE 0x0000 /* @ECU_Address@KOUTP_SASV_flg_minval@ */ Scalar_BOOLEAN 0 SWC_OUTP_type_CM_boolean_flg 0.0 1.0 /end CHARACTERISTIC
/begin CHARACTERISTIC KOUTP_SASV_flg_ovrdflg "" VALUE 0x0000 /* @ECU_Address@KOUTP_SASV_flg_ovrdflg@ */ Scalar_BOOLEAN 0 SWC_OUTP_type_CM_boolean_flg 0.0 1.0 /end CHARACTERISTIC
/begin CHARACTERISTIC KOUTP_SASV_flg_ovrdval "" VALUE 0x0000 /* @ECU_Address@KOUTP_SASV_flg_ovrdval@ */ Scalar_BOOLEAN 0 SWC_OUTP_type_CM_boolean_flg 0.0 1.0 /end CHARACTERISTIC
/begin CHARACTERISTIC KOUTP_SNSRLayout_enum_ovrdflg "" VALUE 0x0000 /* @ECU_Address@KOUTP_SNSRLayout_enum_ovrdflg@ */ Scalar_BOOLEAN 0 SWC_OUTP_type_CM_boolean_flg 0.0 1.0 /end CHARACTERISTIC
/begin CHARACTERISTIC KOUTP_ShifterHandleCmdTimeOut_flg_maxval "" VALUE 0x0000 /* @ECU_Address@KOUTP_ShifterHandleCmdTimeOut_flg_maxval@ */ Scalar_BOOLEAN 0 SWC_OUTP_type_CM_boolean_flg 0.0 1.0 /end CHARACTERISTIC
/begin CHARACTERISTIC KOUTP_ShifterHandleCmdTimeOut_flg_minval "" VALUE 0x0000 /* @ECU_Address@KOUTP_ShifterHandleCmdTimeOut_flg_minval@ */ Scalar_BOOLEAN 0 SWC_OUTP_type_CM_boolean_flg 0.0 1.0 /end CHARACTERISTIC
/begin CHARACTERISTIC KOUTP_ShifterHandleCmdTimeOut_flg_ovrdflg "" VALUE 0x0000 /* @ECU_Address@KOUTP_ShifterHandleCmdTimeOut_flg_ovrdflg@ */ Scalar_BOOLEAN 0 SWC_OUTP_type_CM_boolean_flg 0.0 1.0 /end CHARACTERISTIC
/begin CHARACTERISTIC KOUTP_ShifterHandleCmdTimeOut_flg_ovrdval "" VALUE 0x0000 /* @ECU_Address@KOUTP_ShifterHandleCmdTimeOut_flg_ovrdval@ */ Scalar_BOOLEAN 0 SWC_OUTP_type_CM_boolean_flg 0.0 1.0 /end CHARACTERISTIC
/begin CHARACTERISTIC KOUTP_ShifterHandleCmd_enum_ovrdflg "" VALUE 0x0000 /* @ECU_Address@KOUTP_ShifterHandleCmd_enum_ovrdflg@ */ Scalar_BOOLEAN 0 SWC_OUTP_type_CM_boolean_flg 0.0 1.0 /end CHARACTERISTIC
/begin CHARACTERISTIC KOUTP_StaFSya_flg_maxval "" VALUE 0x0000 /* @ECU_Address@KOUTP_StaFSya_flg_maxval@ */ Scalar_BOOLEAN 0 SWC_OUTP_type_CM_boolean_flg 0.0 1.0 /end CHARACTERISTIC
/begin CHARACTERISTIC KOUTP_StaFSya_flg_minval "" VALUE 0x0000 /* @ECU_Address@KOUTP_StaFSya_flg_minval@ */ Scalar_BOOLEAN 0 SWC_OUTP_type_CM_boolean_flg 0.0 1.0 /end CHARACTERISTIC
/begin CHARACTERISTIC KOUTP_StaFSya_flg_ovrdflg "" VALUE 0x0000 /* @ECU_Address@KOUTP_StaFSya_flg_ovrdflg@ */ Scalar_BOOLEAN 0 SWC_OUTP_type_CM_boolean_flg 0.0 1.0 /end CHARACTERISTIC
/begin CHARACTERISTIC KOUTP_StaFSya_flg_ovrdval "" VALUE 0x0000 /* @ECU_Address@KOUTP_StaFSya_flg_ovrdval@ */ Scalar_BOOLEAN 0 SWC_OUTP_type_CM_boolean_flg 0.0 1.0 /end CHARACTERISTIC
/begin CHARACTERISTIC KOUTP_TCSActiveTimeOut_flg_maxval "" VALUE 0x0000 /* @ECU_Address@KOUTP_TCSActiveTimeOut_flg_maxval@ */ Scalar_BOOLEAN 0 SWC_OUTP_type_CM_boolean_flg 0.0 1.0 /end CHARACTERISTIC
/begin CHARACTERISTIC KOUTP_TCSActiveTimeOut_flg_minval "" VALUE 0x0000 /* @ECU_Address@KOUTP_TCSActiveTimeOut_flg_minval@ */ Scalar_BOOLEAN 0 SWC_OUTP_type_CM_boolean_flg 0.0 1.0 /end CHARACTERISTIC
/begin CHARACTERISTIC KOUTP_TCSActiveTimeOut_flg_ovrdflg "" VALUE 0x0000 /* @ECU_Address@KOUTP_TCSActiveTimeOut_flg_ovrdflg@ */ Scalar_BOOLEAN 0 SWC_OUTP_type_CM_boolean_flg 0.0 1.0 /end CHARACTERISTIC
/begin CHARACTERISTIC KOUTP_TCSActiveTimeOut_flg_ovrdval "" VALUE 0x0000 /* @ECU_Address@KOUTP_TCSActiveTimeOut_flg_ovrdval@ */ Scalar_BOOLEAN 0 SWC_OUTP_type_CM_boolean_flg 0.0 1.0 /end CHARACTERISTIC
/begin CHARACTERISTIC KOUTP_TCSActive_flg_maxval "" VALUE 0x0000 /* @ECU_Address@KOUTP_TCSActive_flg_maxval@ */ Scalar_BOOLEAN 0 SWC_OUTP_type_CM_boolean_flg 0.0 1.0 /end CHARACTERISTIC
/begin CHARACTERISTIC KOUTP_TCSActive_flg_minval "" VALUE 0x0000 /* @ECU_Address@KOUTP_TCSActive_flg_minval@ */ Scalar_BOOLEAN 0 SWC_OUTP_type_CM_boolean_flg 0.0 1.0 /end CHARACTERISTIC
/begin CHARACTERISTIC KOUTP_TCSActive_flg_ovrdflg "" VALUE 0x0000 /* @ECU_Address@KOUTP_TCSActive_flg_ovrdflg@ */ Scalar_BOOLEAN 0 SWC_OUTP_type_CM_boolean_flg 0.0 1.0 /end CHARACTERISTIC
/begin CHARACTERISTIC KOUTP_TCSActive_flg_ovrdval "" VALUE 0x0000 /* @ECU_Address@KOUTP_TCSActive_flg_ovrdval@ */ Scalar_BOOLEAN 0 SWC_OUTP_type_CM_boolean_flg 0.0 1.0 /end CHARACTERISTIC
/begin CHARACTERISTIC KOUTP_USSStaFCL_flg_maxval "" VALUE 0x0000 /* @ECU_Address@KOUTP_USSStaFCL_flg_maxval@ */ Scalar_BOOLEAN 0 SWC_OUTP_type_CM_boolean_flg 0.0 1.0 /end CHARACTERISTIC
/begin CHARACTERISTIC KOUTP_USSStaFCL_flg_minval "" VALUE 0x0000 /* @ECU_Address@KOUTP_USSStaFCL_flg_minval@ */ Scalar_BOOLEAN 0 SWC_OUTP_type_CM_boolean_flg 0.0 1.0 /end CHARACTERISTIC
/begin CHARACTERISTIC KOUTP_USSStaFCL_flg_ovrdflg "" VALUE 0x0000 /* @ECU_Address@KOUTP_USSStaFCL_flg_ovrdflg@ */ Scalar_BOOLEAN 0 SWC_OUTP_type_CM_boolean_flg 0.0 1.0 /end CHARACTERISTIC
/begin CHARACTERISTIC KOUTP_USSStaFCL_flg_ovrdval "" VALUE 0x0000 /* @ECU_Address@KOUTP_USSStaFCL_flg_ovrdval@ */ Scalar_BOOLEAN 0 SWC_OUTP_type_CM_boolean_flg 0.0 1.0 /end CHARACTERISTIC
/begin CHARACTERISTIC KOUTP_USSStaFCR_flg_maxval "" VALUE 0x0000 /* @ECU_Address@KOUTP_USSStaFCR_flg_maxval@ */ Scalar_BOOLEAN 0 SWC_OUTP_type_CM_boolean_flg 0.0 1.0 /end CHARACTERISTIC
/begin CHARACTERISTIC KOUTP_USSStaFCR_flg_minval "" VALUE 0x0000 /* @ECU_Address@KOUTP_USSStaFCR_flg_minval@ */ Scalar_BOOLEAN 0 SWC_OUTP_type_CM_boolean_flg 0.0 1.0 /end CHARACTERISTIC
/begin CHARACTERISTIC KOUTP_USSStaFCR_flg_ovrdflg "" VALUE 0x0000 /* @ECU_Address@KOUTP_USSStaFCR_flg_ovrdflg@ */ Scalar_BOOLEAN 0 SWC_OUTP_type_CM_boolean_flg 0.0 1.0 /end CHARACTERISTIC
/begin CHARACTERISTIC KOUTP_USSStaFCR_flg_ovrdval "" VALUE 0x0000 /* @ECU_Address@KOUTP_USSStaFCR_flg_ovrdval@ */ Scalar_BOOLEAN 0 SWC_OUTP_type_CM_boolean_flg 0.0 1.0 /end CHARACTERISTIC
/begin CHARACTERISTIC KOUTP_USSStaFLL_flg_maxval "" VALUE 0x0000 /* @ECU_Address@KOUTP_USSStaFLL_flg_maxval@ */ Scalar_BOOLEAN 0 SWC_OUTP_type_CM_boolean_flg 0.0 1.0 /end CHARACTERISTIC
/begin CHARACTERISTIC KOUTP_USSStaFLL_flg_minval "" VALUE 0x0000 /* @ECU_Address@KOUTP_USSStaFLL_flg_minval@ */ Scalar_BOOLEAN 0 SWC_OUTP_type_CM_boolean_flg 0.0 1.0 /end CHARACTERISTIC
/begin CHARACTERISTIC KOUTP_USSStaFLL_flg_ovrdflg "" VALUE 0x0000 /* @ECU_Address@KOUTP_USSStaFLL_flg_ovrdflg@ */ Scalar_BOOLEAN 0 SWC_OUTP_type_CM_boolean_flg 0.0 1.0 /end CHARACTERISTIC
/begin CHARACTERISTIC KOUTP_USSStaFLL_flg_ovrdval "" VALUE 0x0000 /* @ECU_Address@KOUTP_USSStaFLL_flg_ovrdval@ */ Scalar_BOOLEAN 0 SWC_OUTP_type_CM_boolean_flg 0.0 1.0 /end CHARACTERISTIC
/begin CHARACTERISTIC KOUTP_USSStaFLR_flg_maxval "" VALUE 0x0000 /* @ECU_Address@KOUTP_USSStaFLR_flg_maxval@ */ Scalar_BOOLEAN 0 SWC_OUTP_type_CM_boolean_flg 0.0 1.0 /end CHARACTERISTIC
/begin CHARACTERISTIC KOUTP_USSStaFLR_flg_minval "" VALUE 0x0000 /* @ECU_Address@KOUTP_USSStaFLR_flg_minval@ */ Scalar_BOOLEAN 0 SWC_OUTP_type_CM_boolean_flg 0.0 1.0 /end CHARACTERISTIC
/begin CHARACTERISTIC KOUTP_USSStaFLR_flg_ovrdflg "" VALUE 0x0000 /* @ECU_Address@KOUTP_USSStaFLR_flg_ovrdflg@ */ Scalar_BOOLEAN 0 SWC_OUTP_type_CM_boolean_flg 0.0 1.0 /end CHARACTERISTIC
/begin CHARACTERISTIC KOUTP_USSStaFLR_flg_ovrdval "" VALUE 0x0000 /* @ECU_Address@KOUTP_USSStaFLR_flg_ovrdval@ */ Scalar_BOOLEAN 0 SWC_OUTP_type_CM_boolean_flg 0.0 1.0 /end CHARACTERISTIC
/begin CHARACTERISTIC KOUTP_USSStaFML_flg_maxval "" VALUE 0x0000 /* @ECU_Address@KOUTP_USSStaFML_flg_maxval@ */ Scalar_BOOLEAN 0 SWC_OUTP_type_CM_boolean_flg 0.0 1.0 /end CHARACTERISTIC
/begin CHARACTERISTIC KOUTP_USSStaFML_flg_minval "" VALUE 0x0000 /* @ECU_Address@KOUTP_USSStaFML_flg_minval@ */ Scalar_BOOLEAN 0 SWC_OUTP_type_CM_boolean_flg 0.0 1.0 /end CHARACTERISTIC
/begin CHARACTERISTIC KOUTP_USSStaFML_flg_ovrdflg "" VALUE 0x0000 /* @ECU_Address@KOUTP_USSStaFML_flg_ovrdflg@ */ Scalar_BOOLEAN 0 SWC_OUTP_type_CM_boolean_flg 0.0 1.0 /end CHARACTERISTIC
/begin CHARACTERISTIC KOUTP_USSStaFML_flg_ovrdval "" VALUE 0x0000 /* @ECU_Address@KOUTP_USSStaFML_flg_ovrdval@ */ Scalar_BOOLEAN 0 SWC_OUTP_type_CM_boolean_flg 0.0 1.0 /end CHARACTERISTIC
/begin CHARACTERISTIC KOUTP_USSStaFMR_flg_maxval "" VALUE 0x0000 /* @ECU_Address@KOUTP_USSStaFMR_flg_maxval@ */ Scalar_BOOLEAN 0 SWC_OUTP_type_CM_boolean_flg 0.0 1.0 /end CHARACTERISTIC
/begin CHARACTERISTIC KOUTP_USSStaFMR_flg_minval "" VALUE 0x0000 /* @ECU_Address@KOUTP_USSStaFMR_flg_minval@ */ Scalar_BOOLEAN 0 SWC_OUTP_type_CM_boolean_flg 0.0 1.0 /end CHARACTERISTIC
/begin CHARACTERISTIC KOUTP_USSStaFMR_flg_ovrdflg "" VALUE 0x0000 /* @ECU_Address@KOUTP_USSStaFMR_flg_ovrdflg@ */ Scalar_BOOLEAN 0 SWC_OUTP_type_CM_boolean_flg 0.0 1.0 /end CHARACTERISTIC
/begin CHARACTERISTIC KOUTP_USSStaFMR_flg_ovrdval "" VALUE 0x0000 /* @ECU_Address@KOUTP_USSStaFMR_flg_ovrdval@ */ Scalar_BOOLEAN 0 SWC_OUTP_type_CM_boolean_flg 0.0 1.0 /end CHARACTERISTIC
/begin CHARACTERISTIC KOUTP_USSStaRCL_flg_maxval "" VALUE 0x0000 /* @ECU_Address@KOUTP_USSStaRCL_flg_maxval@ */ Scalar_BOOLEAN 0 SWC_OUTP_type_CM_boolean_flg 0.0 1.0 /end CHARACTERISTIC
/begin CHARACTERISTIC KOUTP_USSStaRCL_flg_minval "" VALUE 0x0000 /* @ECU_Address@KOUTP_USSStaRCL_flg_minval@ */ Scalar_BOOLEAN 0 SWC_OUTP_type_CM_boolean_flg 0.0 1.0 /end CHARACTERISTIC
/begin CHARACTERISTIC KOUTP_USSStaRCL_flg_ovrdflg "" VALUE 0x0000 /* @ECU_Address@KOUTP_USSStaRCL_flg_ovrdflg@ */ Scalar_BOOLEAN 0 SWC_OUTP_type_CM_boolean_flg 0.0 1.0 /end CHARACTERISTIC
/begin CHARACTERISTIC KOUTP_USSStaRCL_flg_ovrdval "" VALUE 0x0000 /* @ECU_Address@KOUTP_USSStaRCL_flg_ovrdval@ */ Scalar_BOOLEAN 0 SWC_OUTP_type_CM_boolean_flg 0.0 1.0 /end CHARACTERISTIC
/begin CHARACTERISTIC KOUTP_USSStaRCR_flg_maxval "" VALUE 0x0000 /* @ECU_Address@KOUTP_USSStaRCR_flg_maxval@ */ Scalar_BOOLEAN 0 SWC_OUTP_type_CM_boolean_flg 0.0 1.0 /end CHARACTERISTIC
/begin CHARACTERISTIC KOUTP_USSStaRCR_flg_minval "" VALUE 0x0000 /* @ECU_Address@KOUTP_USSStaRCR_flg_minval@ */ Scalar_BOOLEAN 0 SWC_OUTP_type_CM_boolean_flg 0.0 1.0 /end CHARACTERISTIC
/begin CHARACTERISTIC KOUTP_USSStaRCR_flg_ovrdflg "" VALUE 0x0000 /* @ECU_Address@KOUTP_USSStaRCR_flg_ovrdflg@ */ Scalar_BOOLEAN 0 SWC_OUTP_type_CM_boolean_flg 0.0 1.0 /end CHARACTERISTIC
/begin CHARACTERISTIC KOUTP_USSStaRCR_flg_ovrdval "" VALUE 0x0000 /* @ECU_Address@KOUTP_USSStaRCR_flg_ovrdval@ */ Scalar_BOOLEAN 0 SWC_OUTP_type_CM_boolean_flg 0.0 1.0 /end CHARACTERISTIC
/begin CHARACTERISTIC KOUTP_USSStaRLL_flg_maxval "" VALUE 0x0000 /* @ECU_Address@KOUTP_USSStaRLL_flg_maxval@ */ Scalar_BOOLEAN 0 SWC_OUTP_type_CM_boolean_flg 0.0 1.0 /end CHARACTERISTIC
/begin CHARACTERISTIC KOUTP_USSStaRLL_flg_minval "" VALUE 0x0000 /* @ECU_Address@KOUTP_USSStaRLL_flg_minval@ */ Scalar_BOOLEAN 0 SWC_OUTP_type_CM_boolean_flg 0.0 1.0 /end CHARACTERISTIC
/begin CHARACTERISTIC KOUTP_USSStaRLL_flg_ovrdflg "" VALUE 0x0000 /* @ECU_Address@KOUTP_USSStaRLL_flg_ovrdflg@ */ Scalar_BOOLEAN 0 SWC_OUTP_type_CM_boolean_flg 0.0 1.0 /end CHARACTERISTIC
/begin CHARACTERISTIC KOUTP_USSStaRLL_flg_ovrdval "" VALUE 0x0000 /* @ECU_Address@KOUTP_USSStaRLL_flg_ovrdval@ */ Scalar_BOOLEAN 0 SWC_OUTP_type_CM_boolean_flg 0.0 1.0 /end CHARACTERISTIC
/begin CHARACTERISTIC KOUTP_USSStaRLR_flg_maxval "" VALUE 0x0000 /* @ECU_Address@KOUTP_USSStaRLR_flg_maxval@ */ Scalar_BOOLEAN 0 SWC_OUTP_type_CM_boolean_flg 0.0 1.0 /end CHARACTERISTIC
/begin CHARACTERISTIC KOUTP_USSStaRLR_flg_minval "" VALUE 0x0000 /* @ECU_Address@KOUTP_USSStaRLR_flg_minval@ */ Scalar_BOOLEAN 0 SWC_OUTP_type_CM_boolean_flg 0.0 1.0 /end CHARACTERISTIC
/begin CHARACTERISTIC KOUTP_USSStaRLR_flg_ovrdflg "" VALUE 0x0000 /* @ECU_Address@KOUTP_USSStaRLR_flg_ovrdflg@ */ Scalar_BOOLEAN 0 SWC_OUTP_type_CM_boolean_flg 0.0 1.0 /end CHARACTERISTIC
/begin CHARACTERISTIC KOUTP_USSStaRLR_flg_ovrdval "" VALUE 0x0000 /* @ECU_Address@KOUTP_USSStaRLR_flg_ovrdval@ */ Scalar_BOOLEAN 0 SWC_OUTP_type_CM_boolean_flg 0.0 1.0 /end CHARACTERISTIC
/begin CHARACTERISTIC KOUTP_USSStaRML_flg_maxval "" VALUE 0x0000 /* @ECU_Address@KOUTP_USSStaRML_flg_maxval@ */ Scalar_BOOLEAN 0 SWC_OUTP_type_CM_boolean_flg 0.0 1.0 /end CHARACTERISTIC
/begin CHARACTERISTIC KOUTP_USSStaRML_flg_minval "" VALUE 0x0000 /* @ECU_Address@KOUTP_USSStaRML_flg_minval@ */ Scalar_BOOLEAN 0 SWC_OUTP_type_CM_boolean_flg 0.0 1.0 /end CHARACTERISTIC
/begin CHARACTERISTIC KOUTP_USSStaRML_flg_ovrdflg "" VALUE 0x0000 /* @ECU_Address@KOUTP_USSStaRML_flg_ovrdflg@ */ Scalar_BOOLEAN 0 SWC_OUTP_type_CM_boolean_flg 0.0 1.0 /end CHARACTERISTIC
/begin CHARACTERISTIC KOUTP_USSStaRML_flg_ovrdval "" VALUE 0x0000 /* @ECU_Address@KOUTP_USSStaRML_flg_ovrdval@ */ Scalar_BOOLEAN 0 SWC_OUTP_type_CM_boolean_flg 0.0 1.0 /end CHARACTERISTIC
/begin CHARACTERISTIC KOUTP_USSStaRMR_flg_maxval "" VALUE 0x0000 /* @ECU_Address@KOUTP_USSStaRMR_flg_maxval@ */ Scalar_BOOLEAN 0 SWC_OUTP_type_CM_boolean_flg 0.0 1.0 /end CHARACTERISTIC
/begin CHARACTERISTIC KOUTP_USSStaRMR_flg_minval "" VALUE 0x0000 /* @ECU_Address@KOUTP_USSStaRMR_flg_minval@ */ Scalar_BOOLEAN 0 SWC_OUTP_type_CM_boolean_flg 0.0 1.0 /end CHARACTERISTIC
/begin CHARACTERISTIC KOUTP_USSStaRMR_flg_ovrdflg "" VALUE 0x0000 /* @ECU_Address@KOUTP_USSStaRMR_flg_ovrdflg@ */ Scalar_BOOLEAN 0 SWC_OUTP_type_CM_boolean_flg 0.0 1.0 /end CHARACTERISTIC
/begin CHARACTERISTIC KOUTP_USSStaRMR_flg_ovrdval "" VALUE 0x0000 /* @ECU_Address@KOUTP_USSStaRMR_flg_ovrdval@ */ Scalar_BOOLEAN 0 SWC_OUTP_type_CM_boolean_flg 0.0 1.0 /end CHARACTERISTIC
/begin CHARACTERISTIC KOUTP_ChrgPlugSta_enum_ovrdval "" VALUE 0x0000 /* @ECU_Address@KOUTP_ChrgPlugSta_enum_ovrdval@ */ Scalar_UBYTE 0 SWC_OUTP_type_CM_uint8_enum 0.0 255.0 /end CHARACTERISTIC
/begin CHARACTERISTIC KOUTP_DKCPDkeyAreaRAPSSta_enum_maxval "" VALUE 0x0000 /* @ECU_Address@KOUTP_DKCPDkeyAreaRAPSSta_enum_maxval@ */ Scalar_UBYTE 0 SWC_OUTP_type_CM_uint8_enum 0.0 255.0 /end CHARACTERISTIC
/begin CHARACTERISTIC KOUTP_DKCPDkeyAreaRAPSSta_enum_minval "" VALUE 0x0000 /* @ECU_Address@KOUTP_DKCPDkeyAreaRAPSSta_enum_minval@ */ Scalar_UBYTE 0 SWC_OUTP_type_CM_uint8_enum 0.0 255.0 /end CHARACTERISTIC
/begin CHARACTERISTIC KOUTP_DKCPDkeyAreaRAPSSta_enum_ovrdval "" VALUE 0x0000 /* @ECU_Address@KOUTP_DKCPDkeyAreaRAPSSta_enum_ovrdval@ */ Scalar_UBYTE 0 SWC_OUTP_type_CM_uint8_enum 0.0 255.0 /end CHARACTERISTIC
/begin CHARACTERISTIC KOUTP_DKCParkingModeCmd_enum_maxval "" VALUE 0x0000 /* @ECU_Address@KOUTP_DKCParkingModeCmd_enum_maxval@ */ Scalar_UBYTE 0 SWC_OUTP_type_CM_uint8_enum 0.0 255.0 /end CHARACTERISTIC
/begin CHARACTERISTIC KOUTP_DKCParkingModeCmd_enum_minval "" VALUE 0x0000 /* @ECU_Address@KOUTP_DKCParkingModeCmd_enum_minval@ */ Scalar_UBYTE 0 SWC_OUTP_type_CM_uint8_enum 0.0 255.0 /end CHARACTERISTIC
/begin CHARACTERISTIC KOUTP_DKCParkingModeCmd_enum_ovrdval "" VALUE 0x0000 /* @ECU_Address@KOUTP_DKCParkingModeCmd_enum_ovrdval@ */ Scalar_UBYTE 0 SWC_OUTP_type_CM_uint8_enum 0.0 255.0 /end CHARACTERISTIC
/begin CHARACTERISTIC KOUTP_DriIntend_enum_maxval "" VALUE 0x0000 /* @ECU_Address@KOUTP_DriIntend_enum_maxval@ */ Scalar_UBYTE 0 SWC_OUTP_type_CM_uint8_enum 0.0 255.0 /end CHARACTERISTIC
/begin CHARACTERISTIC KOUTP_DriIntend_enum_minval "" VALUE 0x0000 /* @ECU_Address@KOUTP_DriIntend_enum_minval@ */ Scalar_UBYTE 0 SWC_OUTP_type_CM_uint8_enum 0.0 255.0 /end CHARACTERISTIC
/begin CHARACTERISTIC KOUTP_DriIntend_enum_ovrdval "" VALUE 0x0000 /* @ECU_Address@KOUTP_DriIntend_enum_ovrdval@ */ Scalar_UBYTE 0 SWC_OUTP_type_CM_uint8_enum 0.0 255.0 /end CHARACTERISTIC
/begin CHARACTERISTIC KOUTP_EPBErrSta_enum_maxval "" VALUE 0x0000 /* @ECU_Address@KOUTP_EPBErrSta_enum_maxval@ */ Scalar_UBYTE 0 SWC_OUTP_type_CM_uint8_enum 0.0 255.0 /end CHARACTERISTIC
/begin CHARACTERISTIC KOUTP_EPBErrSta_enum_minval "" VALUE 0x0000 /* @ECU_Address@KOUTP_EPBErrSta_enum_minval@ */ Scalar_UBYTE 0 SWC_OUTP_type_CM_uint8_enum 0.0 255.0 /end CHARACTERISTIC
/begin CHARACTERISTIC KOUTP_EPBErrSta_enum_ovrdval "" VALUE 0x0000 /* @ECU_Address@KOUTP_EPBErrSta_enum_ovrdval@ */ Scalar_UBYTE 0 SWC_OUTP_type_CM_uint8_enum 0.0 255.0 /end CHARACTERISTIC
/begin CHARACTERISTIC KOUTP_EPBSta_enum_maxval "" VALUE 0x0000 /* @ECU_Address@KOUTP_EPBSta_enum_maxval@ */ Scalar_UBYTE 0 SWC_OUTP_type_CM_uint8_enum 0.0 255.0 /end CHARACTERISTIC
/begin CHARACTERISTIC KOUTP_EPBSta_enum_minval "" VALUE 0x0000 /* @ECU_Address@KOUTP_EPBSta_enum_minval@ */ Scalar_UBYTE 0 SWC_OUTP_type_CM_uint8_enum 0.0 255.0 /end CHARACTERISTIC
/begin CHARACTERISTIC KOUTP_EPBSta_enum_ovrdval "" VALUE 0x0000 /* @ECU_Address@KOUTP_EPBSta_enum_ovrdval@ */ Scalar_UBYTE 0 SWC_OUTP_type_CM_uint8_enum 0.0 255.0 /end CHARACTERISTIC
/begin CHARACTERISTIC KOUTP_EPSAOIControl_enum_maxval "" VALUE 0x0000 /* @ECU_Address@KOUTP_EPSAOIControl_enum_maxval@ */ Scalar_UBYTE 0 SWC_OUTP_type_CM_uint8_enum 0.0 255.0 /end CHARACTERISTIC
/begin CHARACTERISTIC KOUTP_EPSAOIControl_enum_minval "" VALUE 0x0000 /* @ECU_Address@KOUTP_EPSAOIControl_enum_minval@ */ Scalar_UBYTE 0 SWC_OUTP_type_CM_uint8_enum 0.0 255.0 /end CHARACTERISTIC
/begin CHARACTERISTIC KOUTP_EPSAOIControl_enum_ovrdval "" VALUE 0x0000 /* @ECU_Address@KOUTP_EPSAOIControl_enum_ovrdval@ */ Scalar_UBYTE 0 SWC_OUTP_type_CM_uint8_enum 0.0 255.0 /end CHARACTERISTIC
/begin CHARACTERISTIC KOUTP_ESCAPSSta_enum_maxval "" VALUE 0x0000 /* @ECU_Address@KOUTP_ESCAPSSta_enum_maxval@ */ Scalar_UBYTE 0 SWC_OUTP_type_CM_uint8_enum 0.0 255.0 /end CHARACTERISTIC
/begin CHARACTERISTIC KOUTP_ESCAPSSta_enum_minval "" VALUE 0x0000 /* @ECU_Address@KOUTP_ESCAPSSta_enum_minval@ */ Scalar_UBYTE 0 SWC_OUTP_type_CM_uint8_enum 0.0 255.0 /end CHARACTERISTIC
/begin CHARACTERISTIC KOUTP_ESCAPSSta_enum_ovrdval "" VALUE 0x0000 /* @ECU_Address@KOUTP_ESCAPSSta_enum_ovrdval@ */ Scalar_UBYTE 0 SWC_OUTP_type_CM_uint8_enum 0.0 255.0 /end CHARACTERISTIC
/begin CHARACTERISTIC KOUTP_FSOffSw_enum_maxval "" VALUE 0x0000 /* @ECU_Address@KOUTP_FSOffSw_enum_maxval@ */ Scalar_UBYTE 0 SWC_OUTP_type_CM_uint8_enum 0.0 255.0 /end CHARACTERISTIC
/begin CHARACTERISTIC KOUTP_FSOffSw_enum_minval "" VALUE 0x0000 /* @ECU_Address@KOUTP_FSOffSw_enum_minval@ */ Scalar_UBYTE 0 SWC_OUTP_type_CM_uint8_enum 0.0 255.0 /end CHARACTERISTIC
/begin CHARACTERISTIC KOUTP_FSOffSw_enum_ovrdval "" VALUE 0x0000 /* @ECU_Address@KOUTP_FSOffSw_enum_ovrdval@ */ Scalar_UBYTE 0 SWC_OUTP_type_CM_uint8_enum 0.0 255.0 /end CHARACTERISTIC
/begin CHARACTERISTIC KOUTP_IVIScreen_enum_maxval "" VALUE 0x0000 /* @ECU_Address@KOUTP_IVIScreen_enum_maxval@ */ Scalar_UBYTE 0 SWC_OUTP_type_CM_uint8_enum 0.0 255.0 /end CHARACTERISTIC
/begin CHARACTERISTIC KOUTP_IVIScreen_enum_minval "" VALUE 0x0000 /* @ECU_Address@KOUTP_IVIScreen_enum_minval@ */ Scalar_UBYTE 0 SWC_OUTP_type_CM_uint8_enum 0.0 255.0 /end CHARACTERISTIC
/begin CHARACTERISTIC KOUTP_IVIScreen_enum_ovrdval "" VALUE 0x0000 /* @ECU_Address@KOUTP_IVIScreen_enum_ovrdval@ */ Scalar_UBYTE 0 SWC_OUTP_type_CM_uint8_enum 0.0 255.0 /end CHARACTERISTIC
/begin CHARACTERISTIC KOUTP_LFPulseCount_enum_maxval "" VALUE 0x0000 /* @ECU_Address@KOUTP_LFPulseCount_enum_maxval@ */ Scalar_UBYTE 0 SWC_OUTP_type_CM_uint8_enum 0.0 255.0 /end CHARACTERISTIC
/begin CHARACTERISTIC KOUTP_LFPulseCount_enum_minval "" VALUE 0x0000 /* @ECU_Address@KOUTP_LFPulseCount_enum_minval@ */ Scalar_UBYTE 0 SWC_OUTP_type_CM_uint8_enum 0.0 255.0 /end CHARACTERISTIC
/begin CHARACTERISTIC KOUTP_LFPulseCount_enum_ovrdval "" VALUE 0x0000 /* @ECU_Address@KOUTP_LFPulseCount_enum_ovrdval@ */ Scalar_UBYTE 0 SWC_OUTP_type_CM_uint8_enum 0.0 255.0 /end CHARACTERISTIC
/begin CHARACTERISTIC KOUTP_LFWhlRotDir_enum_maxval "" VALUE 0x0000 /* @ECU_Address@KOUTP_LFWhlRotDir_enum_maxval@ */ Scalar_UBYTE 0 SWC_OUTP_type_CM_uint8_enum 0.0 255.0 /end CHARACTERISTIC
/begin CHARACTERISTIC KOUTP_LFWhlRotDir_enum_minval "" VALUE 0x0000 /* @ECU_Address@KOUTP_LFWhlRotDir_enum_minval@ */ Scalar_UBYTE 0 SWC_OUTP_type_CM_uint8_enum 0.0 255.0 /end CHARACTERISTIC
/begin CHARACTERISTIC KOUTP_LFWhlRotDir_enum_ovrdval "" VALUE 0x0000 /* @ECU_Address@KOUTP_LFWhlRotDir_enum_ovrdval@ */ Scalar_UBYTE 0 SWC_OUTP_type_CM_uint8_enum 0.0 255.0 /end CHARACTERISTIC
/begin CHARACTERISTIC KOUTP_LRPulseCount_enum_maxval "" VALUE 0x0000 /* @ECU_Address@KOUTP_LRPulseCount_enum_maxval@ */ Scalar_UBYTE 0 SWC_OUTP_type_CM_uint8_enum 0.0 255.0 /end CHARACTERISTIC
/begin CHARACTERISTIC KOUTP_LRPulseCount_enum_minval "" VALUE 0x0000 /* @ECU_Address@KOUTP_LRPulseCount_enum_minval@ */ Scalar_UBYTE 0 SWC_OUTP_type_CM_uint8_enum 0.0 255.0 /end CHARACTERISTIC
/begin CHARACTERISTIC KOUTP_LRPulseCount_enum_ovrdval "" VALUE 0x0000 /* @ECU_Address@KOUTP_LRPulseCount_enum_ovrdval@ */ Scalar_UBYTE 0 SWC_OUTP_type_CM_uint8_enum 0.0 255.0 /end CHARACTERISTIC
/begin CHARACTERISTIC KOUTP_LRWhlRotDir_enum_maxval "" VALUE 0x0000 /* @ECU_Address@KOUTP_LRWhlRotDir_enum_maxval@ */ Scalar_UBYTE 0 SWC_OUTP_type_CM_uint8_enum 0.0 255.0 /end CHARACTERISTIC
/begin CHARACTERISTIC KOUTP_LRWhlRotDir_enum_minval "" VALUE 0x0000 /* @ECU_Address@KOUTP_LRWhlRotDir_enum_minval@ */ Scalar_UBYTE 0 SWC_OUTP_type_CM_uint8_enum 0.0 255.0 /end CHARACTERISTIC
/begin CHARACTERISTIC KOUTP_LRWhlRotDir_enum_ovrdval "" VALUE 0x0000 /* @ECU_Address@KOUTP_LRWhlRotDir_enum_ovrdval@ */ Scalar_UBYTE 0 SWC_OUTP_type_CM_uint8_enum 0.0 255.0 /end CHARACTERISTIC
/begin CHARACTERISTIC KOUTP_ModOperation_enum_maxval "" VALUE 0x0000 /* @ECU_Address@KOUTP_ModOperation_enum_maxval@ */ Scalar_UBYTE 0 SWC_OUTP_type_CM_uint8_enum 0.0 255.0 /end CHARACTERISTIC
/begin CHARACTERISTIC KOUTP_ModOperation_enum_minval "" VALUE 0x0000 /* @ECU_Address@KOUTP_ModOperation_enum_minval@ */ Scalar_UBYTE 0 SWC_OUTP_type_CM_uint8_enum 0.0 255.0 /end CHARACTERISTIC
/begin CHARACTERISTIC KOUTP_ModOperation_enum_ovrdval "" VALUE 0x0000 /* @ECU_Address@KOUTP_ModOperation_enum_ovrdval@ */ Scalar_UBYTE 0 SWC_OUTP_type_CM_uint8_enum 0.0 255.0 /end CHARACTERISTIC
/begin CHARACTERISTIC KOUTP_PASAFCL_enum_maxval "" VALUE 0x0000 /* @ECU_Address@KOUTP_PASAFCL_enum_maxval@ */ Scalar_UBYTE 0 SWC_OUTP_type_CM_uint8_enum 0.0 255.0 /end CHARACTERISTIC
/begin CHARACTERISTIC KOUTP_PASAFCL_enum_minval "" VALUE 0x0000 /* @ECU_Address@KOUTP_PASAFCL_enum_minval@ */ Scalar_UBYTE 0 SWC_OUTP_type_CM_uint8_enum 0.0 255.0 /end CHARACTERISTIC
/begin CHARACTERISTIC KOUTP_PASAFCL_enum_ovrdval "" VALUE 0x0000 /* @ECU_Address@KOUTP_PASAFCL_enum_ovrdval@ */ Scalar_UBYTE 0 SWC_OUTP_type_CM_uint8_enum 0.0 255.0 /end CHARACTERISTIC
/begin CHARACTERISTIC KOUTP_PASAFCR_enum_maxval "" VALUE 0x0000 /* @ECU_Address@KOUTP_PASAFCR_enum_maxval@ */ Scalar_UBYTE 0 SWC_OUTP_type_CM_uint8_enum 0.0 255.0 /end CHARACTERISTIC
/begin CHARACTERISTIC KOUTP_PASAFCR_enum_minval "" VALUE 0x0000 /* @ECU_Address@KOUTP_PASAFCR_enum_minval@ */ Scalar_UBYTE 0 SWC_OUTP_type_CM_uint8_enum 0.0 255.0 /end CHARACTERISTIC
/begin CHARACTERISTIC KOUTP_PASAFCR_enum_ovrdval "" VALUE 0x0000 /* @ECU_Address@KOUTP_PASAFCR_enum_ovrdval@ */ Scalar_UBYTE 0 SWC_OUTP_type_CM_uint8_enum 0.0 255.0 /end CHARACTERISTIC
/begin CHARACTERISTIC KOUTP_PASAFML_enum_maxval "" VALUE 0x0000 /* @ECU_Address@KOUTP_PASAFML_enum_maxval@ */ Scalar_UBYTE 0 SWC_OUTP_type_CM_uint8_enum 0.0 255.0 /end CHARACTERISTIC
/begin CHARACTERISTIC KOUTP_PASAFML_enum_minval "" VALUE 0x0000 /* @ECU_Address@KOUTP_PASAFML_enum_minval@ */ Scalar_UBYTE 0 SWC_OUTP_type_CM_uint8_enum 0.0 255.0 /end CHARACTERISTIC
/begin CHARACTERISTIC KOUTP_PASAFML_enum_ovrdval "" VALUE 0x0000 /* @ECU_Address@KOUTP_PASAFML_enum_ovrdval@ */ Scalar_UBYTE 0 SWC_OUTP_type_CM_uint8_enum 0.0 255.0 /end CHARACTERISTIC
/begin CHARACTERISTIC KOUTP_PASAFMR_enum_maxval "" VALUE 0x0000 /* @ECU_Address@KOUTP_PASAFMR_enum_maxval@ */ Scalar_UBYTE 0 SWC_OUTP_type_CM_uint8_enum 0.0 255.0 /end CHARACTERISTIC
/begin CHARACTERISTIC KOUTP_PASAFMR_enum_minval "" VALUE 0x0000 /* @ECU_Address@KOUTP_PASAFMR_enum_minval@ */ Scalar_UBYTE 0 SWC_OUTP_type_CM_uint8_enum 0.0 255.0 /end CHARACTERISTIC
/begin CHARACTERISTIC KOUTP_PASAFMR_enum_ovrdval "" VALUE 0x0000 /* @ECU_Address@KOUTP_PASAFMR_enum_ovrdval@ */ Scalar_UBYTE 0 SWC_OUTP_type_CM_uint8_enum 0.0 255.0 /end CHARACTERISTIC
/begin CHARACTERISTIC KOUTP_PASARCL_enum_maxval "" VALUE 0x0000 /* @ECU_Address@KOUTP_PASARCL_enum_maxval@ */ Scalar_UBYTE 0 SWC_OUTP_type_CM_uint8_enum 0.0 255.0 /end CHARACTERISTIC
/begin CHARACTERISTIC KOUTP_PASARCL_enum_minval "" VALUE 0x0000 /* @ECU_Address@KOUTP_PASARCL_enum_minval@ */ Scalar_UBYTE 0 SWC_OUTP_type_CM_uint8_enum 0.0 255.0 /end CHARACTERISTIC
/begin CHARACTERISTIC KOUTP_PASARCL_enum_ovrdval "" VALUE 0x0000 /* @ECU_Address@KOUTP_PASARCL_enum_ovrdval@ */ Scalar_UBYTE 0 SWC_OUTP_type_CM_uint8_enum 0.0 255.0 /end CHARACTERISTIC
/begin CHARACTERISTIC KOUTP_PASARCR_enum_maxval "" VALUE 0x0000 /* @ECU_Address@KOUTP_PASARCR_enum_maxval@ */ Scalar_UBYTE 0 SWC_OUTP_type_CM_uint8_enum 0.0 255.0 /end CHARACTERISTIC
/begin CHARACTERISTIC KOUTP_PASARCR_enum_minval "" VALUE 0x0000 /* @ECU_Address@KOUTP_PASARCR_enum_minval@ */ Scalar_UBYTE 0 SWC_OUTP_type_CM_uint8_enum 0.0 255.0 /end CHARACTERISTIC
/begin CHARACTERISTIC KOUTP_PASARCR_enum_ovrdval "" VALUE 0x0000 /* @ECU_Address@KOUTP_PASARCR_enum_ovrdval@ */ Scalar_UBYTE 0 SWC_OUTP_type_CM_uint8_enum 0.0 255.0 /end CHARACTERISTIC
/begin CHARACTERISTIC KOUTP_PASARML_enum_maxval "" VALUE 0x0000 /* @ECU_Address@KOUTP_PASARML_enum_maxval@ */ Scalar_UBYTE 0 SWC_OUTP_type_CM_uint8_enum 0.0 255.0 /end CHARACTERISTIC
/begin CHARACTERISTIC KOUTP_PASARML_enum_minval "" VALUE 0x0000 /* @ECU_Address@KOUTP_PASARML_enum_minval@ */ Scalar_UBYTE 0 SWC_OUTP_type_CM_uint8_enum 0.0 255.0 /end CHARACTERISTIC
/begin CHARACTERISTIC KOUTP_PASARML_enum_ovrdval "" VALUE 0x0000 /* @ECU_Address@KOUTP_PASARML_enum_ovrdval@ */ Scalar_UBYTE 0 SWC_OUTP_type_CM_uint8_enum 0.0 255.0 /end CHARACTERISTIC
/begin CHARACTERISTIC KOUTP_PASARMR_enum_maxval "" VALUE 0x0000 /* @ECU_Address@KOUTP_PASARMR_enum_maxval@ */ Scalar_UBYTE 0 SWC_OUTP_type_CM_uint8_enum 0.0 255.0 /end CHARACTERISTIC
/begin CHARACTERISTIC KOUTP_PASARMR_enum_minval "" VALUE 0x0000 /* @ECU_Address@KOUTP_PASARMR_enum_minval@ */ Scalar_UBYTE 0 SWC_OUTP_type_CM_uint8_enum 0.0 255.0 /end CHARACTERISTIC
/begin CHARACTERISTIC KOUTP_PASARMR_enum_ovrdval "" VALUE 0x0000 /* @ECU_Address@KOUTP_PASARMR_enum_ovrdval@ */ Scalar_UBYTE 0 SWC_OUTP_type_CM_uint8_enum 0.0 255.0 /end CHARACTERISTIC
/begin CHARACTERISTIC KOUTP_PASDFCL_cm_maxval "" VALUE 0x0000 /* @ECU_Address@KOUTP_PASDFCL_cm_maxval@ */ Scalar_UBYTE 0 SWC_OUTP_type_CM_uint8_cm 0.0 255.0 /end CHARACTERISTIC
/begin CHARACTERISTIC KOUTP_PASDFCL_cm_minval "" VALUE 0x0000 /* @ECU_Address@KOUTP_PASDFCL_cm_minval@ */ Scalar_UBYTE 0 SWC_OUTP_type_CM_uint8_cm 0.0 255.0 /end CHARACTERISTIC
/begin CHARACTERISTIC KOUTP_PASDFCL_cm_ovrdval "" VALUE 0x0000 /* @ECU_Address@KOUTP_PASDFCL_cm_ovrdval@ */ Scalar_UBYTE 0 SWC_OUTP_type_CM_uint8_enum 0.0 255.0 /end CHARACTERISTIC
/begin CHARACTERISTIC KOUTP_PASDFCR_cm_maxval "" VALUE 0x0000 /* @ECU_Address@KOUTP_PASDFCR_cm_maxval@ */ Scalar_UBYTE 0 SWC_OUTP_type_CM_uint8_cm 0.0 255.0 /end CHARACTERISTIC
/begin CHARACTERISTIC KOUTP_PASDFCR_cm_minval "" VALUE 0x0000 /* @ECU_Address@KOUTP_PASDFCR_cm_minval@ */ Scalar_UBYTE 0 SWC_OUTP_type_CM_uint8_cm 0.0 255.0 /end CHARACTERISTIC
/begin CHARACTERISTIC KOUTP_PASDFCR_cm_ovrdval "" VALUE 0x0000 /* @ECU_Address@KOUTP_PASDFCR_cm_ovrdval@ */ Scalar_UBYTE 0 SWC_OUTP_type_CM_uint8_enum 0.0 255.0 /end CHARACTERISTIC
/begin CHARACTERISTIC KOUTP_PASDFML_cm_maxval "" VALUE 0x0000 /* @ECU_Address@KOUTP_PASDFML_cm_maxval@ */ Scalar_UBYTE 0 SWC_OUTP_type_CM_uint8_cm 0.0 255.0 /end CHARACTERISTIC
/begin CHARACTERISTIC KOUTP_PASDFML_cm_minval "" VALUE 0x0000 /* @ECU_Address@KOUTP_PASDFML_cm_minval@ */ Scalar_UBYTE 0 SWC_OUTP_type_CM_uint8_cm 0.0 255.0 /end CHARACTERISTIC
/begin CHARACTERISTIC KOUTP_PASDFML_cm_ovrdval "" VALUE 0x0000 /* @ECU_Address@KOUTP_PASDFML_cm_ovrdval@ */ Scalar_UBYTE 0 SWC_OUTP_type_CM_uint8_enum 0.0 255.0 /end CHARACTERISTIC
/begin CHARACTERISTIC KOUTP_PASDFMR_cm_maxval "" VALUE 0x0000 /* @ECU_Address@KOUTP_PASDFMR_cm_maxval@ */ Scalar_UBYTE 0 SWC_OUTP_type_CM_uint8_cm 0.0 255.0 /end CHARACTERISTIC
/begin CHARACTERISTIC KOUTP_PASDFMR_cm_minval "" VALUE 0x0000 /* @ECU_Address@KOUTP_PASDFMR_cm_minval@ */ Scalar_UBYTE 0 SWC_OUTP_type_CM_uint8_cm 0.0 255.0 /end CHARACTERISTIC
/begin CHARACTERISTIC KOUTP_PASDFMR_cm_ovrdval "" VALUE 0x0000 /* @ECU_Address@KOUTP_PASDFMR_cm_ovrdval@ */ Scalar_UBYTE 0 SWC_OUTP_type_CM_uint8_enum 0.0 255.0 /end CHARACTERISTIC
/begin CHARACTERISTIC KOUTP_PASDRCL_cm_maxval "" VALUE 0x0000 /* @ECU_Address@KOUTP_PASDRCL_cm_maxval@ */ Scalar_UBYTE 0 SWC_OUTP_type_CM_uint8_cm 0.0 255.0 /end CHARACTERISTIC
/begin CHARACTERISTIC KOUTP_PASDRCL_cm_minval "" VALUE 0x0000 /* @ECU_Address@KOUTP_PASDRCL_cm_minval@ */ Scalar_UBYTE 0 SWC_OUTP_type_CM_uint8_cm 0.0 255.0 /end CHARACTERISTIC
/begin CHARACTERISTIC KOUTP_PASDRCL_cm_ovrdval "" VALUE 0x0000 /* @ECU_Address@KOUTP_PASDRCL_cm_ovrdval@ */ Scalar_UBYTE 0 SWC_OUTP_type_CM_uint8_enum 0.0 255.0 /end CHARACTERISTIC
/begin CHARACTERISTIC KOUTP_PASDRCR_cm_maxval "" VALUE 0x0000 /* @ECU_Address@KOUTP_PASDRCR_cm_maxval@ */ Scalar_UBYTE 0 SWC_OUTP_type_CM_uint8_cm 0.0 255.0 /end CHARACTERISTIC
/begin CHARACTERISTIC KOUTP_PASDRCR_cm_minval "" VALUE 0x0000 /* @ECU_Address@KOUTP_PASDRCR_cm_minval@ */ Scalar_UBYTE 0 SWC_OUTP_type_CM_uint8_cm 0.0 255.0 /end CHARACTERISTIC
/begin CHARACTERISTIC KOUTP_PASDRCR_cm_ovrdval "" VALUE 0x0000 /* @ECU_Address@KOUTP_PASDRCR_cm_ovrdval@ */ Scalar_UBYTE 0 SWC_OUTP_type_CM_uint8_enum 0.0 255.0 /end CHARACTERISTIC
/begin CHARACTERISTIC KOUTP_PASDRML_cm_maxval "" VALUE 0x0000 /* @ECU_Address@KOUTP_PASDRML_cm_maxval@ */ Scalar_UBYTE 0 SWC_OUTP_type_CM_uint8_cm 0.0 255.0 /end CHARACTERISTIC
/begin CHARACTERISTIC KOUTP_PASDRML_cm_minval "" VALUE 0x0000 /* @ECU_Address@KOUTP_PASDRML_cm_minval@ */ Scalar_UBYTE 0 SWC_OUTP_type_CM_uint8_cm 0.0 255.0 /end CHARACTERISTIC
/begin CHARACTERISTIC KOUTP_PASDRML_cm_ovrdval "" VALUE 0x0000 /* @ECU_Address@KOUTP_PASDRML_cm_ovrdval@ */ Scalar_UBYTE 0 SWC_OUTP_type_CM_uint8_enum 0.0 255.0 /end CHARACTERISTIC
/begin CHARACTERISTIC KOUTP_PASDRMR_cm_maxval "" VALUE 0x0000 /* @ECU_Address@KOUTP_PASDRMR_cm_maxval@ */ Scalar_UBYTE 0 SWC_OUTP_type_CM_uint8_cm 0.0 255.0 /end CHARACTERISTIC
/begin CHARACTERISTIC KOUTP_PASDRMR_cm_minval "" VALUE 0x0000 /* @ECU_Address@KOUTP_PASDRMR_cm_minval@ */ Scalar_UBYTE 0 SWC_OUTP_type_CM_uint8_cm 0.0 255.0 /end CHARACTERISTIC
/begin CHARACTERISTIC KOUTP_PASDRMR_cm_ovrdval "" VALUE 0x0000 /* @ECU_Address@KOUTP_PASDRMR_cm_ovrdval@ */ Scalar_UBYTE 0 SWC_OUTP_type_CM_uint8_enum 0.0 255.0 /end CHARACTERISTIC
/begin CHARACTERISTIC KOUTP_RAPSBCMLamp_enum_maxval "" VALUE 0x0000 /* @ECU_Address@KOUTP_RAPSBCMLamp_enum_maxval@ */ Scalar_UBYTE 0 SWC_OUTP_type_CM_uint8_enum 0.0 255.0 /end CHARACTERISTIC
/begin CHARACTERISTIC KOUTP_RAPSBCMLamp_enum_minval "" VALUE 0x0000 /* @ECU_Address@KOUTP_RAPSBCMLamp_enum_minval@ */ Scalar_UBYTE 0 SWC_OUTP_type_CM_uint8_enum 0.0 255.0 /end CHARACTERISTIC
/begin CHARACTERISTIC KOUTP_RAPSBCMLamp_enum_ovrdval "" VALUE 0x0000 /* @ECU_Address@KOUTP_RAPSBCMLamp_enum_ovrdval@ */ Scalar_UBYTE 0 SWC_OUTP_type_CM_uint8_enum 0.0 255.0 /end CHARACTERISTIC
/begin CHARACTERISTIC KOUTP_RAPSErrWarnSta_enum_maxval "" VALUE 0x0000 /* @ECU_Address@KOUTP_RAPSErrWarnSta_enum_maxval@ */ Scalar_UBYTE 0 SWC_OUTP_type_CM_uint8_enum 0.0 255.0 /end CHARACTERISTIC
/begin CHARACTERISTIC KOUTP_RAPSErrWarnSta_enum_minval "" VALUE 0x0000 /* @ECU_Address@KOUTP_RAPSErrWarnSta_enum_minval@ */ Scalar_UBYTE 0 SWC_OUTP_type_CM_uint8_enum 0.0 255.0 /end CHARACTERISTIC
/begin CHARACTERISTIC KOUTP_RAPSErrWarnSta_enum_ovrdval "" VALUE 0x0000 /* @ECU_Address@KOUTP_RAPSErrWarnSta_enum_ovrdval@ */ Scalar_UBYTE 0 SWC_OUTP_type_CM_uint8_enum 0.0 255.0 /end CHARACTERISTIC
/begin CHARACTERISTIC KOUTP_RFPulseCount_enum_maxval "" VALUE 0x0000 /* @ECU_Address@KOUTP_RFPulseCount_enum_maxval@ */ Scalar_UBYTE 0 SWC_OUTP_type_CM_uint8_enum 0.0 255.0 /end CHARACTERISTIC
/begin CHARACTERISTIC KOUTP_RFPulseCount_enum_minval "" VALUE 0x0000 /* @ECU_Address@KOUTP_RFPulseCount_enum_minval@ */ Scalar_UBYTE 0 SWC_OUTP_type_CM_uint8_enum 0.0 255.0 /end CHARACTERISTIC
/begin CHARACTERISTIC KOUTP_RFPulseCount_enum_ovrdval "" VALUE 0x0000 /* @ECU_Address@KOUTP_RFPulseCount_enum_ovrdval@ */ Scalar_UBYTE 0 SWC_OUTP_type_CM_uint8_enum 0.0 255.0 /end CHARACTERISTIC
/begin CHARACTERISTIC KOUTP_RFWhlRotDir_enum_maxval "" VALUE 0x0000 /* @ECU_Address@KOUTP_RFWhlRotDir_enum_maxval@ */ Scalar_UBYTE 0 SWC_OUTP_type_CM_uint8_enum 0.0 255.0 /end CHARACTERISTIC
/begin CHARACTERISTIC KOUTP_RFWhlRotDir_enum_minval "" VALUE 0x0000 /* @ECU_Address@KOUTP_RFWhlRotDir_enum_minval@ */ Scalar_UBYTE 0 SWC_OUTP_type_CM_uint8_enum 0.0 255.0 /end CHARACTERISTIC
/begin CHARACTERISTIC KOUTP_RFWhlRotDir_enum_ovrdval "" VALUE 0x0000 /* @ECU_Address@KOUTP_RFWhlRotDir_enum_ovrdval@ */ Scalar_UBYTE 0 SWC_OUTP_type_CM_uint8_enum 0.0 255.0 /end CHARACTERISTIC
/begin CHARACTERISTIC KOUTP_RRPulseCount_enum_maxval "" VALUE 0x0000 /* @ECU_Address@KOUTP_RRPulseCount_enum_maxval@ */ Scalar_UBYTE 0 SWC_OUTP_type_CM_uint8_enum 0.0 255.0 /end CHARACTERISTIC
/begin CHARACTERISTIC KOUTP_RRPulseCount_enum_minval "" VALUE 0x0000 /* @ECU_Address@KOUTP_RRPulseCount_enum_minval@ */ Scalar_UBYTE 0 SWC_OUTP_type_CM_uint8_enum 0.0 255.0 /end CHARACTERISTIC
/begin CHARACTERISTIC KOUTP_RRPulseCount_enum_ovrdval "" VALUE 0x0000 /* @ECU_Address@KOUTP_RRPulseCount_enum_ovrdval@ */ Scalar_UBYTE 0 SWC_OUTP_type_CM_uint8_enum 0.0 255.0 /end CHARACTERISTIC
/begin CHARACTERISTIC KOUTP_RRWhlRotDir_enum_maxval "" VALUE 0x0000 /* @ECU_Address@KOUTP_RRWhlRotDir_enum_maxval@ */ Scalar_UBYTE 0 SWC_OUTP_type_CM_uint8_enum 0.0 255.0 /end CHARACTERISTIC
/begin CHARACTERISTIC KOUTP_RRWhlRotDir_enum_minval "" VALUE 0x0000 /* @ECU_Address@KOUTP_RRWhlRotDir_enum_minval@ */ Scalar_UBYTE 0 SWC_OUTP_type_CM_uint8_enum 0.0 255.0 /end CHARACTERISTIC
/begin CHARACTERISTIC KOUTP_RRWhlRotDir_enum_ovrdval "" VALUE 0x0000 /* @ECU_Address@KOUTP_RRWhlRotDir_enum_ovrdval@ */ Scalar_UBYTE 0 SWC_OUTP_type_CM_uint8_enum 0.0 255.0 /end CHARACTERISTIC
/begin CHARACTERISTIC KOUTP_SNSRLayout_enum_maxval "" VALUE 0x0000 /* @ECU_Address@KOUTP_SNSRLayout_enum_maxval@ */ Scalar_UBYTE 0 SWC_OUTP_type_CM_uint8_enum 0.0 255.0 /end CHARACTERISTIC
/begin CHARACTERISTIC KOUTP_SNSRLayout_enum_minval "" VALUE 0x0000 /* @ECU_Address@KOUTP_SNSRLayout_enum_minval@ */ Scalar_UBYTE 0 SWC_OUTP_type_CM_uint8_enum 0.0 255.0 /end CHARACTERISTIC
/begin CHARACTERISTIC KOUTP_SNSRLayout_enum_ovrdval "" VALUE 0x0000 /* @ECU_Address@KOUTP_SNSRLayout_enum_ovrdval@ */ Scalar_UBYTE 0 SWC_OUTP_type_CM_uint8_enum 0.0 255.0 /end CHARACTERISTIC
/begin CHARACTERISTIC KOUTP_ShifterHandleCmd_enum_maxval "" VALUE 0x0000 /* @ECU_Address@KOUTP_ShifterHandleCmd_enum_maxval@ */ Scalar_UBYTE 0 SWC_OUTP_type_CM_uint8_enum 0.0 255.0 /end CHARACTERISTIC
/begin CHARACTERISTIC KOUTP_ShifterHandleCmd_enum_minval "" VALUE 0x0000 /* @ECU_Address@KOUTP_ShifterHandleCmd_enum_minval@ */ Scalar_UBYTE 0 SWC_OUTP_type_CM_uint8_enum 0.0 255.0 /end CHARACTERISTIC
/begin CHARACTERISTIC KOUTP_ShifterHandleCmd_enum_ovrdval "" VALUE 0x0000 /* @ECU_Address@KOUTP_ShifterHandleCmd_enum_ovrdval@ */ Scalar_UBYTE 0 SWC_OUTP_type_CM_uint8_enum 0.0 255.0 /end CHARACTERISTIC
/begin COMPU_METHOD SWC_OUTP_type_CM_single_Deg "Q = V" RAT_FUNC "%8.6" "Deg" COEFFS 0 1 0 0 0 1 /end COMPU_METHOD
/begin COMPU_METHOD SWC_OUTP_type_CM_single_kph "Q = V" RAT_FUNC "%8.6" "kph" COEFFS 0 1 0 0 0 1 /end COMPU_METHOD
/begin COMPU_METHOD SWC_OUTP_type_CM_single_Gps "Q = V" RAT_FUNC "%8.6" "Gps" COEFFS 0 1 0 0 0 1 /end COMPU_METHOD
/begin COMPU_METHOD SWC_OUTP_type_CM_single_bar "Q = V" RAT_FUNC "%8.6" "bar" COEFFS 0 1 0 0 0 1 /end COMPU_METHOD
/begin COMPU_METHOD SWC_OUTP_type_CM_single_degps "Q = V" RAT_FUNC "%8.6" "degps" COEFFS 0 1 0 0 0 1 /end COMPU_METHOD
/begin COMPU_METHOD SWC_OUTP_type_CM_boolean_flg "Q = V" RAT_FUNC "%1.0" "flg" COEFFS 0 1 0 0 0 1 /end COMPU_METHOD
/begin COMPU_METHOD SWC_OUTP_type_CM_boolean_bar "Q = V" RAT_FUNC "%1.0" "bar" COEFFS 0 1 0 0 0 1 /end COMPU_METHOD
/begin COMPU_METHOD SWC_OUTP_type_CM_uint8_enum "Q = V" RAT_FUNC "%3.0" "enum" COEFFS 0 1 0 0 0 1 /end COMPU_METHOD
/begin COMPU_METHOD SWC_OUTP_type_CM_uint8_cm "Q = V" RAT_FUNC "%3.0" "cm" COEFFS 0 1 0 0 0 1 /end COMPU_METHOD
/begin GROUP S58_Signal_Override "SWC_OUTP_type/run_SWC_OUTP_5ms_sys/OUTP/outpmodule/VAPM_ChrgPlugSta_enum_Inproc/Signal_Override"
 /begin REF_CHARACTERISTIC KOUTP_ChrgPlugSta_enum_ovrdflg KOUTP_ChrgPlugSta_enum_ovrdval /end REF_CHARACTERISTIC
/end GROUP
/begin GROUP S59_Signal_Limit "SWC_OUTP_type/run_SWC_OUTP_5ms_sys/OUTP/outpmodule/VAPM_DKCPDkeyAreaRAPSSta_enum_Inproc/Signal_Limit"
 /begin REF_CHARACTERISTIC KOUTP_DKCPDkeyAreaRAPSSta_enum_maxval KOUTP_DKCPDkeyAreaRAPSSta_enum_minval /end REF_CHARACTERISTIC
/end GROUP
/begin GROUP S59_Signal_Override "SWC_OUTP_type/run_SWC_OUTP_5ms_sys/OUTP/outpmodule/VAPM_DKCPDkeyAreaRAPSSta_enum_Inproc/Signal_Override"
 /begin REF_CHARACTERISTIC KOUTP_DKCPDkeyAreaRAPSSta_enum_ovrdflg KOUTP_DKCPDkeyAreaRAPSSta_enum_ovrdval /end REF_CHARACTERISTIC
/end GROUP
/begin GROUP S60_Signal_Limit "SWC_OUTP_type/run_SWC_OUTP_5ms_sys/OUTP/outpmodule/VAPM_DKCParkingModeCmd_enum_Inproc/Signal_Limit"
 /begin REF_CHARACTERISTIC KOUTP_DKCParkingModeCmd_enum_maxval KOUTP_DKCParkingModeCmd_enum_minval /end REF_CHARACTERISTIC
/end GROUP
/begin GROUP S60_Signal_Override "SWC_OUTP_type/run_SWC_OUTP_5ms_sys/OUTP/outpmodule/VAPM_DKCParkingModeCmd_enum_Inproc/Signal_Override"
 /begin REF_CHARACTERISTIC KOUTP_DKCParkingModeCmd_enum_ovrdflg KOUTP_DKCParkingModeCmd_enum_ovrdval /end REF_CHARACTERISTIC
/end GROUP
/begin GROUP S61_Signal_Limit "SWC_OUTP_type/run_SWC_OUTP_5ms_sys/OUTP/outpmodule/VAPM_DriIntendTimeOut_flg_Inproc/Signal_Limit"
 /begin REF_CHARACTERISTIC KOUTP_DriIntendTimeOut_flg_maxval KOUTP_DriIntendTimeOut_flg_minval /end REF_CHARACTERISTIC
/end GROUP
/begin GROUP S61_Signal_Override "SWC_OUTP_type/run_SWC_OUTP_5ms_sys/OUTP/outpmodule/VAPM_DriIntendTimeOut_flg_Inproc/Signal_Override"
 /begin REF_CHARACTERISTIC KOUTP_DriIntendTimeOut_flg_ovrdflg KOUTP_DriIntendTimeOut_flg_ovrdval /end REF_CHARACTERISTIC
/end GROUP
/begin GROUP S62_Signal_Limit "SWC_OUTP_type/run_SWC_OUTP_5ms_sys/OUTP/outpmodule/VAPM_DriIntend_enum_Inproc/Signal_Limit" /begin REF_CHARACTERISTIC KOUTP_DriIntend_enum_maxval KOUTP_DriIntend_enum_minval /end REF_CHARACTERISTIC /end GROUP
/begin GROUP S62_Signal_Override "SWC_OUTP_type/run_SWC_OUTP_5ms_sys/OUTP/outpmodule/VAPM_DriIntend_enum_Inproc/Signal_Override" /begin REF_CHARACTERISTIC KOUTP_DriIntend_enum_ovrdflg KOUTP_DriIntend_enum_ovrdval /end REF_CHARACTERISTIC /end GROUP
/begin GROUP S63_Signal_Limit "SWC_OUTP_type/run_SWC_OUTP_5ms_sys/OUTP/outpmodule/VAPM_DriverSeatBeltCmdTimeOut_flg_Inproc/Signal_Limit"
 /begin REF_CHARACTERISTIC KOUTP_DriverSeatBeltCmdTimeOut_flg_maxval KOUTP_DriverSeatBeltCmdTimeOut_flg_minval /end REF_CHARACTERISTIC
/end GROUP
/begin GROUP S63_Signal_Override "SWC_OUTP_type/run_SWC_OUTP_5ms_sys/OUTP/outpmodule/VAPM_DriverSeatBeltCmdTimeOut_flg_Inproc/Signal_Override"
 /begin REF_CHARACTERISTIC KOUTP_DriverSeatBeltCmdTimeOut_flg_ovrdflg KOUTP_DriverSeatBeltCmdTimeOut_flg_ovrdval /end REF_CHARACTERISTIC
/end GROUP
/begin GROUP S64_Signal_Limit "SWC_OUTP_type/run_SWC_OUTP_5ms_sys/OUTP/outpmodule/VAPM_DriverSeatBeltCmd_flg_Inproc/Signal_Limit"
 /begin REF_CHARACTERISTIC KOUTP_DriverSeatBeltCmd_flg_maxval KOUTP_DriverSeatBeltCmd_flg_minval /end REF_CHARACTERISTIC
/end GROUP
/begin GROUP S64_Signal_Override "SWC_OUTP_type/run_SWC_OUTP_5ms_sys/OUTP/outpmodule/VAPM_DriverSeatBeltCmd_flg_Inproc/Signal_Override"
 /begin REF_CHARACTERISTIC KOUTP_DriverSeatBeltCmd_flg_ovrdflg KOUTP_DriverSeatBeltCmd_flg_ovrdval /end REF_CHARACTERISTIC
/end GROUP
/begin GROUP S65_Signal_Limit "SWC_OUTP_type/run_SWC_OUTP_5ms_sys/OUTP/outpmodule/VAPM_EPBErrStaTimeOut_flg_Inproc/Signal_Limit"
 /begin REF_CHARACTERISTIC KOUTP_EPBErrStaTimeOut_flg_maxval KOUTP_EPBErrStaTimeOut_flg_minval /end REF_CHARACTERISTIC
/end GROUP
/begin GROUP S65_Signal_Override "SWC_OUTP_type/run_SWC_OUTP_5ms_sys/OUTP/outpmodule/VAPM_EPBErrStaTimeOut_flg_Inproc/Signal_Override"
 /begin REF_CHARACTERISTIC KOUTP_EPBErrStaTimeOut_flg_ovrdflg KOUTP_EPBErrStaTimeOut_flg_ovrdval /end REF_CHARACTERISTIC
/end GROUP
/begin GROUP S66_Signal_Limit "SWC_OUTP_type/run_SWC_OUTP_5ms_sys/OUTP/outpmodule/VAPM_EPBErrSta_enum_Inproc/Signal_Limit" /begin REF_CHARACTERISTIC KOUTP_EPBErrSta_enum_maxval KOUTP_EPBErrSta_enum_minval /end REF_CHARACTERISTIC /end GROUP
/begin GROUP S66_Signal_Override "SWC_OUTP_type/run_SWC_OUTP_5ms_sys/OUTP/outpmodule/VAPM_EPBErrSta_enum_Inproc/Signal_Override" /begin REF_CHARACTERISTIC KOUTP_EPBErrSta_enum_ovrdflg KOUTP_EPBErrSta_enum_ovrdval /end REF_CHARACTERISTIC /end GROUP
/begin GROUP S67_Signal_Limit "SWC_OUTP_type/run_SWC_OUTP_5ms_sys/OUTP/outpmodule/VAPM_EPBExtApplyAvailTimeOut_flg_Inproc/Signal_Limit"
 /begin REF_CHARACTERISTIC KOUTP_EPBExtApplyAvailTimeOut_flg_maxval KOUTP_EPBExtApplyAvailTimeOut_flg_minval /end REF_CHARACTERISTIC
/end GROUP
/begin GROUP S67_Signal_Override "SWC_OUTP_type/run_SWC_OUTP_5ms_sys/OUTP/outpmodule/VAPM_EPBExtApplyAvailTimeOut_flg_Inproc/Signal_Override"
 /begin REF_CHARACTERISTIC KOUTP_EPBExtApplyAvailTimeOut_flg_ovrdflg KOUTP_EPBExtApplyAvailTimeOut_flg_ovrdval /end REF_CHARACTERISTIC
/end GROUP
/begin GROUP S68_Signal_Limit "SWC_OUTP_type/run_SWC_OUTP_5ms_sys/OUTP/outpmodule/VAPM_EPBExtApplyAvail_flg_Inproc/Signal_Limit"
 /begin REF_CHARACTERISTIC KOUTP_EPBExtApplyAvail_flg_maxval KOUTP_EPBExtApplyAvail_flg_minval /end REF_CHARACTERISTIC
/end GROUP
/begin GROUP S68_Signal_Override "SWC_OUTP_type/run_SWC_OUTP_5ms_sys/OUTP/outpmodule/VAPM_EPBExtApplyAvail_flg_Inproc/Signal_Override"
 /begin REF_CHARACTERISTIC KOUTP_EPBExtApplyAvail_flg_ovrdflg KOUTP_EPBExtApplyAvail_flg_ovrdval /end REF_CHARACTERISTIC
/end GROUP
/begin GROUP S69_Signal_Limit "SWC_OUTP_type/run_SWC_OUTP_5ms_sys/OUTP/outpmodule/VAPM_EPBExtReleaseAvailTimeOut_flg_Inproc/Signal_Limit"
 /begin REF_CHARACTERISTIC KOUTP_EPBExtReleaseAvailTimeOut_flg_maxval KOUTP_EPBExtReleaseAvailTimeOut_flg_minval /end REF_CHARACTERISTIC
/end GROUP
/begin GROUP S69_Signal_Override "SWC_OUTP_type/run_SWC_OUTP_5ms_sys/OUTP/outpmodule/VAPM_EPBExtReleaseAvailTimeOut_flg_Inproc/Signal_Override"
 /begin REF_CHARACTERISTIC KOUTP_EPBExtReleaseAvailTimeOut_flg_ovrdflg KOUTP_EPBExtReleaseAvailTimeOut_flg_ovrdval /end REF_CHARACTERISTIC
/end GROUP
/begin GROUP S70_Signal_Limit "SWC_OUTP_type/run_SWC_OUTP_5ms_sys/OUTP/outpmodule/VAPM_EPBExtReleaseAvail_flg_Inproc/Signal_Limit"
 /begin REF_CHARACTERISTIC KOUTP_EPBExtReleaseAvail_flg_maxval KOUTP_EPBExtReleaseAvail_flg_minval /end REF_CHARACTERISTIC
/end GROUP
/begin GROUP S70_Signal_Override "SWC_OUTP_type/run_SWC_OUTP_5ms_sys/OUTP/outpmodule/VAPM_EPBExtReleaseAvail_flg_Inproc/Signal_Override"
 /begin REF_CHARACTERISTIC KOUTP_EPBExtReleaseAvail_flg_ovrdflg KOUTP_EPBExtReleaseAvail_flg_ovrdval /end REF_CHARACTERISTIC
/end GROUP
/begin GROUP S71_Signal_Limit "SWC_OUTP_type/run_SWC_OUTP_5ms_sys/OUTP/outpmodule/VAPM_EPBStaTimeOut_flg_Inproc/Signal_Limit"
 /begin REF_CHARACTERISTIC KOUTP_EPBStaTimeOut_flg_maxval KOUTP_EPBStaTimeOut_flg_minval /end REF_CHARACTERISTIC
/end GROUP
/begin GROUP S71_Signal_Override "SWC_OUTP_type/run_SWC_OUTP_5ms_sys/OUTP/outpmodule/VAPM_EPBStaTimeOut_flg_Inproc/Signal_Override"
 /begin REF_CHARACTERISTIC KOUTP_EPBStaTimeOut_flg_ovrdflg KOUTP_EPBStaTimeOut_flg_ovrdval /end REF_CHARACTERISTIC
/end GROUP
/begin GROUP S72_Signal_Limit "SWC_OUTP_type/run_SWC_OUTP_5ms_sys/OUTP/outpmodule/VAPM_EPBSta_enum_Inproc/Signal_Limit" /begin REF_CHARACTERISTIC KOUTP_EPBSta_enum_maxval KOUTP_EPBSta_enum_minval /end REF_CHARACTERISTIC /end GROUP
/begin GROUP S72_Signal_Override "SWC_OUTP_type/run_SWC_OUTP_5ms_sys/OUTP/outpmodule/VAPM_EPBSta_enum_Inproc/Signal_Override" /begin REF_CHARACTERISTIC KOUTP_EPBSta_enum_ovrdflg KOUTP_EPBSta_enum_ovrdval /end REF_CHARACTERISTIC /end GROUP
/begin GROUP S73_Signal_Limit "SWC_OUTP_type/run_SWC_OUTP_5ms_sys/OUTP/outpmodule/VAPM_EPSAOIControlTimeOut_flg_Inproc/Signal_Limit"
 /begin REF_CHARACTERISTIC KOUTP_EPSAOIControlTimeOut_flg_maxval KOUTP_EPSAOIControlTimeOut_flg_minval /end REF_CHARACTERISTIC
/end GROUP
/begin GROUP S73_Signal_Override "SWC_OUTP_type/run_SWC_OUTP_5ms_sys/OUTP/outpmodule/VAPM_EPSAOIControlTimeOut_flg_Inproc/Signal_Override"
 /begin REF_CHARACTERISTIC KOUTP_EPSAOIControlTimeOut_flg_ovrdflg KOUTP_EPSAOIControlTimeOut_flg_ovrdval /end REF_CHARACTERISTIC
/end GROUP
/begin GROUP S74_Signal_Limit "SWC_OUTP_type/run_SWC_OUTP_5ms_sys/OUTP/outpmodule/VAPM_EPSAOIControl_enum_Inproc/Signal_Limit"
 /begin REF_CHARACTERISTIC KOUTP_EPSAOIControl_enum_maxval KOUTP_EPSAOIControl_enum_minval /end REF_CHARACTERISTIC
/end GROUP
/begin GROUP S74_Signal_Override "SWC_OUTP_type/run_SWC_OUTP_5ms_sys/OUTP/outpmodule/VAPM_EPSAOIControl_enum_Inproc/Signal_Override"
 /begin REF_CHARACTERISTIC KOUTP_EPSAOIControl_enum_ovrdflg KOUTP_EPSAOIControl_enum_ovrdval /end REF_CHARACTERISTIC
/end GROUP
/begin GROUP S75_Signal_Limit "SWC_OUTP_type/run_SWC_OUTP_5ms_sys/OUTP/outpmodule/VAPM_ESCAPSStaTimeOut_flg_Inproc/Signal_Limit"
 /begin REF_CHARACTERISTIC KOUTP_ESCAPSStaTimeOut_flg_maxval KOUTP_ESCAPSStaTimeOut_flg_minval /end REF_CHARACTERISTIC
/end GROUP
/begin GROUP S75_Signal_Override "SWC_OUTP_type/run_SWC_OUTP_5ms_sys/OUTP/outpmodule/VAPM_ESCAPSStaTimeOut_flg_Inproc/Signal_Override"
 /begin REF_CHARACTERISTIC KOUTP_ESCAPSStaTimeOut_flg_ovrdflg KOUTP_ESCAPSStaTimeOut_flg_ovrdval /end REF_CHARACTERISTIC
/end GROUP
/begin GROUP S76_Signal_Limit "SWC_OUTP_type/run_SWC_OUTP_5ms_sys/OUTP/outpmodule/VAPM_ESCAPSSta_enum_Inproc/Signal_Limit" /begin REF_CHARACTERISTIC KOUTP_ESCAPSSta_enum_maxval KOUTP_ESCAPSSta_enum_minval /end REF_CHARACTERISTIC /end GROUP
/begin GROUP S76_Signal_Override "SWC_OUTP_type/run_SWC_OUTP_5ms_sys/OUTP/outpmodule/VAPM_ESCAPSSta_enum_Inproc/Signal_Override" /begin REF_CHARACTERISTIC KOUTP_ESCAPSSta_enum_ovrdflg KOUTP_ESCAPSSta_enum_ovrdval /end REF_CHARACTERISTIC /end GROUP
/begin GROUP S77_Signal_Limit "SWC_OUTP_type/run_SWC_OUTP_5ms_sys/OUTP/outpmodule/VAPM_ESCStandstillTimeOut_flg_Inproc/Signal_Limit"
 /begin REF_CHARACTERISTIC KOUTP_ESCStandstillTimeOut_flg_maxval KOUTP_ESCStandstillTimeOut_flg_minval /end REF_CHARACTERISTIC
/end GROUP
/begin GROUP S77_Signal_Override "SWC_OUTP_type/run_SWC_OUTP_5ms_sys/OUTP/outpmodule/VAPM_ESCStandstillTimeOut_flg_Inproc/Signal_Override"
 /begin REF_CHARACTERISTIC KOUTP_ESCStandstillTimeOut_flg_ovrdflg KOUTP_ESCStandstillTimeOut_flg_ovrdval /end REF_CHARACTERISTIC
/end GROUP
/begin GROUP S78_Signal_Limit "SWC_OUTP_type/run_SWC_OUTP_5ms_sys/OUTP/outpmodule/VAPM_ESCStandstill_flg_Inproc/Signal_Limit"
 /begin REF_CHARACTERISTIC KOUTP_ESCStandstill_flg_maxval KOUTP_ESCStandstill_flg_minval /end REF_CHARACTERISTIC
/end GROUP
/begin GROUP S78_Signal_Override "SWC_OUTP_type/run_SWC_OUTP_5ms_sys/OUTP/outpmodule/VAPM_ESCStandstill_flg_Inproc/Signal_Override"
 /begin REF_CHARACTERISTIC KOUTP_ESCStandstill_flg_ovrdflg KOUTP_ESCStandstill_flg_ovrdval /end REF_CHARACTERISTIC
/end GROUP
/begin GROUP S79_Signal_Limit "SWC_OUTP_type/run_SWC_OUTP_5ms_sys/OUTP/outpmodule/VAPM_FSOffSwTimeOut_flg_Inproc/Signal_Limit"
 /begin REF_CHARACTERISTIC KOUTP_FSOffSwTimeOut_flg_maxval KOUTP_FSOffSwTimeOut_flg_minval /end REF_CHARACTERISTIC
/end GROUP
/begin GROUP S79_Signal_Override "SWC_OUTP_type/run_SWC_OUTP_5ms_sys/OUTP/outpmodule/VAPM_FSOffSwTimeOut_flg_Inproc/Signal_Override"
 /begin REF_CHARACTERISTIC KOUTP_FSOffSwTimeOut_flg_ovrdflg KOUTP_FSOffSwTimeOut_flg_ovrdval /end REF_CHARACTERISTIC
/end GROUP
/begin GROUP S80_Signal_Limit "SWC_OUTP_type/run_SWC_OUTP_5ms_sys/OUTP/outpmodule/VAPM_FSOffSw_enum_Inproc/Signal_Limit" /begin REF_CHARACTERISTIC KOUTP_FSOffSw_enum_maxval KOUTP_FSOffSw_enum_minval /end REF_CHARACTERISTIC /end GROUP
/begin GROUP S80_Signal_Override "SWC_OUTP_type/run_SWC_OUTP_5ms_sys/OUTP/outpmodule/VAPM_FSOffSw_enum_Inproc/Signal_Override" /begin REF_CHARACTERISTIC KOUTP_FSOffSw_enum_ovrdflg KOUTP_FSOffSw_enum_ovrdval /end REF_CHARACTERISTIC /end GROUP
/begin GROUP S81_Signal_Limit "SWC_OUTP_type/run_SWC_OUTP_5ms_sys/OUTP/outpmodule/VAPM_GRADETimeOut_flg_Inproc/Signal_Limit"
 /begin REF_CHARACTERISTIC KOUTP_GRADETimeOut_flg_maxval KOUTP_GRADETimeOut_flg_minval /end REF_CHARACTERISTIC
/end GROUP
/begin GROUP S81_Signal_Override "SWC_OUTP_type/run_SWC_OUTP_5ms_sys/OUTP/outpmodule/VAPM_GRADETimeOut_flg_Inproc/Signal_Override"
 /begin REF_CHARACTERISTIC KOUTP_GRADETimeOut_flg_ovrdflg KOUTP_GRADETimeOut_flg_ovrdval /end REF_CHARACTERISTIC
/end GROUP
/begin GROUP S82_Signal_Limit "SWC_OUTP_type/run_SWC_OUTP_5ms_sys/OUTP/outpmodule/VAPM_GRADE_Deg_Inproc/Signal_Limit" /begin REF_CHARACTERISTIC KOUTP_GRADE_Deg_maxval KOUTP_GRADE_Deg_minval /end REF_CHARACTERISTIC /end GROUP
/begin GROUP S82_Signal_Override "SWC_OUTP_type/run_SWC_OUTP_5ms_sys/OUTP/outpmodule/VAPM_GRADE_Deg_Inproc/Signal_Override" /begin REF_CHARACTERISTIC KOUTP_GRADE_Deg_ovrdflg KOUTP_GRADE_Deg_ovrdval /end REF_CHARACTERISTIC /end GROUP
/begin GROUP S83_Signal_Limit "SWC_OUTP_type/run_SWC_OUTP_5ms_sys/OUTP/outpmodule/VAPM_IVIScreenTimeOut_flg_Inproc/Signal_Limit"
 /begin REF_CHARACTERISTIC KOUTP_IVIScreenTimeOut_flg_maxval KOUTP_IVIScreenTimeOut_flg_minval /end REF_CHARACTERISTIC
/end GROUP
/begin GROUP S83_Signal_Override "SWC_OUTP_type/run_SWC_OUTP_5ms_sys/OUTP/outpmodule/VAPM_IVIScreenTimeOut_flg_Inproc/Signal_Override"
 /begin REF_CHARACTERISTIC KOUTP_IVIScreenTimeOut_flg_ovrdflg KOUTP_IVIScreenTimeOut_flg_ovrdval /end REF_CHARACTERISTIC
/end GROUP
/begin GROUP S84_Signal_Limit "SWC_OUTP_type/run_SWC_OUTP_5ms_sys/OUTP/outpmodule/VAPM_IVIScreen_enum_Inproc/Signal_Limit" /begin REF_CHARACTERISTIC KOUTP_IVIScreen_enum_maxval KOUTP_IVIScreen_enum_minval /end REF_CHARACTERISTIC /end GROUP
/begin GROUP S84_Signal_Override "SWC_OUTP_type/run_SWC_OUTP_5ms_sys/OUTP/outpmodule/VAPM_IVIScreen_enum_Inproc/Signal_Override" /begin REF_CHARACTERISTIC KOUTP_IVIScreen_enum_ovrdflg KOUTP_IVIScreen_enum_ovrdval /end REF_CHARACTERISTIC /end GROUP
/begin GROUP S85_Signal_Limit "SWC_OUTP_type/run_SWC_OUTP_5ms_sys/OUTP/outpmodule/VAPM_IVIStatusTimeOut_flg_Inproc/Signal_Limit"
 /begin REF_CHARACTERISTIC KOUTP_IVIStatusTimeOut_flg_maxval KOUTP_IVIStatusTimeOut_flg_minval /end REF_CHARACTERISTIC
/end GROUP
/begin GROUP S85_Signal_Override "SWC_OUTP_type/run_SWC_OUTP_5ms_sys/OUTP/outpmodule/VAPM_IVIStatusTimeOut_flg_Inproc/Signal_Override"
 /begin REF_CHARACTERISTIC KOUTP_IVIStatusTimeOut_flg_ovrdflg KOUTP_IVIStatusTimeOut_flg_ovrdval /end REF_CHARACTERISTIC
/end GROUP
/begin GROUP S86_Signal_Limit "SWC_OUTP_type/run_SWC_OUTP_5ms_sys/OUTP/outpmodule/VAPM_IVIStatus_flg_Inproc/Signal_Limit" /begin REF_CHARACTERISTIC KOUTP_IVIStatus_flg_maxval KOUTP_IVIStatus_flg_minval /end REF_CHARACTERISTIC /end GROUP
/begin GROUP S86_Signal_Override "SWC_OUTP_type/run_SWC_OUTP_5ms_sys/OUTP/outpmodule/VAPM_IVIStatus_flg_Inproc/Signal_Override" /begin REF_CHARACTERISTIC KOUTP_IVIStatus_flg_ovrdflg KOUTP_IVIStatus_flg_ovrdval /end REF_CHARACTERISTIC /end GROUP
/begin GROUP S87_Signal_Limit "SWC_OUTP_type/run_SWC_OUTP_5ms_sys/OUTP/outpmodule/VAPM_IVIUserTakeOverAPSSta_flg_Inproc/Signal_Limit"
 /begin REF_CHARACTERISTIC KOUTP_IVIUserTakeOverAPSSta_flg_maxval KOUTP_IVIUserTakeOverAPSSta_flg_minval /end REF_CHARACTERISTIC
/end GROUP
/begin GROUP S87_Signal_Override "SWC_OUTP_type/run_SWC_OUTP_5ms_sys/OUTP/outpmodule/VAPM_IVIUserTakeOverAPSSta_flg_Inproc/Signal_Override"
 /begin REF_CHARACTERISTIC KOUTP_IVIUserTakeOverAPSSta_flg_ovrdflg KOUTP_IVIUserTakeOverAPSSta_flg_ovrdval /end REF_CHARACTERISTIC
/end GROUP
/begin GROUP S88_Signal_Limit "SWC_OUTP_type/run_SWC_OUTP_5ms_sys/OUTP/outpmodule/VAPM_LFPulseCountTimeOut_flg_Inproc/Signal_Limit"
 /begin REF_CHARACTERISTIC KOUTP_LFPulseCountTimeOut_flg_maxval KOUTP_LFPulseCountTimeOut_flg_minval /end REF_CHARACTERISTIC
/end GROUP
/begin GROUP S88_Signal_Override "SWC_OUTP_type/run_SWC_OUTP_5ms_sys/OUTP/outpmodule/VAPM_LFPulseCountTimeOut_flg_Inproc/Signal_Override"
 /begin REF_CHARACTERISTIC KOUTP_LFPulseCountTimeOut_flg_ovrdflg KOUTP_LFPulseCountTimeOut_flg_ovrdval /end REF_CHARACTERISTIC
/end GROUP
/begin GROUP S89_Signal_Limit "SWC_OUTP_type/run_SWC_OUTP_5ms_sys/OUTP/outpmodule/VAPM_LFPulseCountVTimeOut_flg_Inproc/Signal_Limit"
 /begin REF_CHARACTERISTIC KOUTP_LFPulseCountVTimeOut_flg_maxval KOUTP_LFPulseCountVTimeOut_flg_minval /end REF_CHARACTERISTIC
/end GROUP
/begin GROUP S89_Signal_Override "SWC_OUTP_type/run_SWC_OUTP_5ms_sys/OUTP/outpmodule/VAPM_LFPulseCountVTimeOut_flg_Inproc/Signal_Override"
 /begin REF_CHARACTERISTIC KOUTP_LFPulseCountVTimeOut_flg_ovrdflg KOUTP_LFPulseCountVTimeOut_flg_ovrdval /end REF_CHARACTERISTIC
/end GROUP
/begin GROUP S90_Signal_Limit "SWC_OUTP_type/run_SWC_OUTP_5ms_sys/OUTP/outpmodule/VAPM_LFPulseCountV_flg_Inproc/Signal_Limit"
 /begin REF_CHARACTERISTIC KOUTP_LFPulseCountV_flg_maxval KOUTP_LFPulseCountV_flg_minval /end REF_CHARACTERISTIC
/end GROUP
/begin GROUP S90_Signal_Override "SWC_OUTP_type/run_SWC_OUTP_5ms_sys/OUTP/outpmodule/VAPM_LFPulseCountV_flg_Inproc/Signal_Override"
 /begin REF_CHARACTERISTIC KOUTP_LFPulseCountV_flg_ovrdflg KOUTP_LFPulseCountV_flg_ovrdval /end REF_CHARACTERISTIC
/end GROUP
/begin GROUP S91_Signal_Limit "SWC_OUTP_type/run_SWC_OUTP_5ms_sys/OUTP/outpmodule/VAPM_LFPulseCount_enum_Inproc/Signal_Limit"
 /begin REF_CHARACTERISTIC KOUTP_LFPulseCount_enum_maxval KOUTP_LFPulseCount_enum_minval /end REF_CHARACTERISTIC
/end GROUP
/begin GROUP S91_Signal_Override "SWC_OUTP_type/run_SWC_OUTP_5ms_sys/OUTP/outpmodule/VAPM_LFPulseCount_enum_Inproc/Signal_Override"
 /begin REF_CHARACTERISTIC KOUTP_LFPulseCount_enum_ovrdflg KOUTP_LFPulseCount_enum_ovrdval /end REF_CHARACTERISTIC
/end GROUP
/begin GROUP S92_Signal_Limit "SWC_OUTP_type/run_SWC_OUTP_5ms_sys/OUTP/outpmodule/VAPM_LFRawWhlSpeedTimeOut_flg_Inproc/Signal_Limit"
 /begin REF_CHARACTERISTIC KOUTP_LFRawWhlSpeedTimeOut_flg_maxval KOUTP_LFRawWhlSpeedTimeOut_flg_minval /end REF_CHARACTERISTIC
/end GROUP
/begin GROUP S92_Signal_Override "SWC_OUTP_type/run_SWC_OUTP_5ms_sys/OUTP/outpmodule/VAPM_LFRawWhlSpeedTimeOut_flg_Inproc/Signal_Override"
 /begin REF_CHARACTERISTIC KOUTP_LFRawWhlSpeedTimeOut_flg_ovrdflg KOUTP_LFRawWhlSpeedTimeOut_flg_ovrdval /end REF_CHARACTERISTIC
/end GROUP
/begin GROUP S93_Signal_Limit "SWC_OUTP_type/run_SWC_OUTP_5ms_sys/OUTP/outpmodule/VAPM_LFRawWhlSpeedVTimeOut_flg_Inproc/Signal_Limit"
 /begin REF_CHARACTERISTIC KOUTP_LFRawWhlSpeedVTimeOut_flg_maxval KOUTP_LFRawWhlSpeedVTimeOut_flg_minval /end REF_CHARACTERISTIC
/end GROUP
/begin GROUP S93_Signal_Override "SWC_OUTP_type/run_SWC_OUTP_5ms_sys/OUTP/outpmodule/VAPM_LFRawWhlSpeedVTimeOut_flg_Inproc/Signal_Override"
 /begin REF_CHARACTERISTIC KOUTP_LFRawWhlSpeedVTimeOut_flg_ovrdflg KOUTP_LFRawWhlSpeedVTimeOut_flg_ovrdval /end REF_CHARACTERISTIC
/end GROUP
/begin GROUP S94_Signal_Limit "SWC_OUTP_type/run_SWC_OUTP_5ms_sys/OUTP/outpmodule/VAPM_LFRawWhlSpeedV_flg_Inproc/Signal_Limit"
 /begin REF_CHARACTERISTIC KOUTP_LFRawWhlSpeedV_flg_maxval KOUTP_LFRawWhlSpeedV_flg_minval /end REF_CHARACTERISTIC
/end GROUP
/begin GROUP S94_Signal_Override "SWC_OUTP_type/run_SWC_OUTP_5ms_sys/OUTP/outpmodule/VAPM_LFRawWhlSpeedV_flg_Inproc/Signal_Override"
 /begin REF_CHARACTERISTIC KOUTP_LFRawWhlSpeedV_flg_ovrdflg KOUTP_LFRawWhlSpeedV_flg_ovrdval /end REF_CHARACTERISTIC
/end GROUP
/begin GROUP S95_Signal_Limit "SWC_OUTP_type/run_SWC_OUTP_5ms_sys/OUTP/outpmodule/VAPM_LFRawWhlSpeed_kph_Inproc/Signal_Limit"
 /begin REF_CHARACTERISTIC KOUTP_LFRawWhlSpeed_kph_maxval KOUTP_LFRawWhlSpeed_kph_minval /end REF_CHARACTERISTIC
/end GROUP
/begin GROUP S95_Signal_Override "SWC_OUTP_type/run_SWC_OUTP_5ms_sys/OUTP/outpmodule/VAPM_LFRawWhlSpeed_kph_Inproc/Signal_Override"
 /begin REF_CHARACTERISTIC KOUTP_LFRawWhlSpeed_kph_ovrdflg KOUTP_LFRawWhlSpeed_kph_ovrdval /end REF_CHARACTERISTIC
/end GROUP
/begin GROUP S96_Signal_Limit "SWC_OUTP_type/run_SWC_OUTP_5ms_sys/OUTP/outpmodule/VAPM_LFWhlRotDirTimeOut_flg_Inproc/Signal_Limit"
 /begin REF_CHARACTERISTIC KOUTP_LFWhlRotDirTimeOut_flg_maxval KOUTP_LFWhlRotDirTimeOut_flg_minval /end REF_CHARACTERISTIC
/end GROUP
/begin GROUP S96_Signal_Override "SWC_OUTP_type/run_SWC_OUTP_5ms_sys/OUTP/outpmodule/VAPM_LFWhlRotDirTimeOut_flg_Inproc/Signal_Override"
 /begin REF_CHARACTERISTIC KOUTP_LFWhlRotDirTimeOut_flg_ovrdflg KOUTP_LFWhlRotDirTimeOut_flg_ovrdval /end REF_CHARACTERISTIC
/end GROUP
/begin GROUP S97_Signal_Limit "SWC_OUTP_type/run_SWC_OUTP_5ms_sys/OUTP/outpmodule/VAPM_LFWhlRotDir_enum_Inproc/Signal_Limit"
 /begin REF_CHARACTERISTIC KOUTP_LFWhlRotDir_enum_maxval KOUTP_LFWhlRotDir_enum_minval /end REF_CHARACTERISTIC
/end GROUP
/begin GROUP S97_Signal_Override "SWC_OUTP_type/run_SWC_OUTP_5ms_sys/OUTP/outpmodule/VAPM_LFWhlRotDir_enum_Inproc/Signal_Override"
 /begin REF_CHARACTERISTIC KOUTP_LFWhlRotDir_enum_ovrdflg KOUTP_LFWhlRotDir_enum_ovrdval /end REF_CHARACTERISTIC
/end GROUP
/begin GROUP S98_Signal_Limit "SWC_OUTP_type/run_SWC_OUTP_5ms_sys/OUTP/outpmodule/VAPM_LRPulseCountTimeOut_flg_Inproc/Signal_Limit"
 /begin REF_CHARACTERISTIC KOUTP_LRPulseCountTimeOut_flg_maxval KOUTP_LRPulseCountTimeOut_flg_minval /end REF_CHARACTERISTIC
/end GROUP
/begin GROUP S98_Signal_Override "SWC_OUTP_type/run_SWC_OUTP_5ms_sys/OUTP/outpmodule/VAPM_LRPulseCountTimeOut_flg_Inproc/Signal_Override"
 /begin REF_CHARACTERISTIC KOUTP_LRPulseCountTimeOut_flg_ovrdflg KOUTP_LRPulseCountTimeOut_flg_ovrdval /end REF_CHARACTERISTIC
/end GROUP
/begin GROUP S99_Signal_Limit "SWC_OUTP_type/run_SWC_OUTP_5ms_sys/OUTP/outpmodule/VAPM_LRPulseCountVTimeOut_flg_Inproc/Signal_Limit"
 /begin REF_CHARACTERISTIC KOUTP_LRPulseCountVTimeOut_flg_maxval KOUTP_LRPulseCountVTimeOut_flg_minval /end REF_CHARACTERISTIC
/end GROUP
/begin GROUP S99_Signal_Override "SWC_OUTP_type/run_SWC_OUTP_5ms_sys/OUTP/outpmodule/VAPM_LRPulseCountVTimeOut_flg_Inproc/Signal_Override"
 /begin REF_CHARACTERISTIC KOUTP_LRPulseCountVTimeOut_flg_ovrdflg KOUTP_LRPulseCountVTimeOut_flg_ovrdval /end REF_CHARACTERISTIC
/end GROUP
/begin GROUP S100_Signal_Limit "SWC_OUTP_type/run_SWC_OUTP_5ms_sys/OUTP/outpmodule/VAPM_LRPulseCountV_flg_Inproc/Signal_Limit"
 /begin REF_CHARACTERISTIC KOUTP_LRPulseCountV_flg_maxval KOUTP_LRPulseCountV_flg_minval /end REF_CHARACTERISTIC
/end GROUP
/begin GROUP S100_Signal_Override "SWC_OUTP_type/run_SWC_OUTP_5ms_sys/OUTP/outpmodule/VAPM_LRPulseCountV_flg_Inproc/Signal_Override"
 /begin REF_CHARACTERISTIC KOUTP_LRPulseCountV_flg_ovrdflg KOUTP_LRPulseCountV_flg_ovrdval /end REF_CHARACTERISTIC
/end GROUP
/begin GROUP S101_Signal_Limit "SWC_OUTP_type/run_SWC_OUTP_5ms_sys/OUTP/outpmodule/VAPM_LRPulseCount_enum_Inproc/Signal_Limit"
 /begin REF_CHARACTERISTIC KOUTP_LRPulseCount_enum_maxval KOUTP_LRPulseCount_enum_minval /end REF_CHARACTERISTIC
/end GROUP
/begin GROUP S101_Signal_Override "SWC_OUTP_type/run_SWC_OUTP_5ms_sys/OUTP/outpmodule/VAPM_LRPulseCount_enum_Inproc/Signal_Override"
 /begin REF_CHARACTERISTIC KOUTP_LRPulseCount_enum_ovrdflg KOUTP_LRPulseCount_enum_ovrdval /end REF_CHARACTERISTIC
/end GROUP
/begin GROUP S102_Signal_Limit "SWC_OUTP_type/run_SWC_OUTP_5ms_sys/OUTP/outpmodule/VAPM_LRRawWhlSpeedTimeOut_flg_Inproc/Signal_Limit"
 /begin REF_CHARACTERISTIC KOUTP_LRRawWhlSpeedTimeOut_flg_maxval KOUTP_LRRawWhlSpeedTimeOut_flg_minval /end REF_CHARACTERISTIC
/end GROUP
/begin GROUP S102_Signal_Override "SWC_OUTP_type/run_SWC_OUTP_5ms_sys/OUTP/outpmodule/VAPM_LRRawWhlSpeedTimeOut_flg_Inproc/Signal_Override"
 /begin REF_CHARACTERISTIC KOUTP_LRRawWhlSpeedTimeOut_flg_ovrdflg KOUTP_LRRawWhlSpeedTimeOut_flg_ovrdval /end REF_CHARACTERISTIC
/end GROUP
/begin GROUP S103_Signal_Limit "SWC_OUTP_type/run_SWC_OUTP_5ms_sys/OUTP/outpmodule/VAPM_LRRawWhlSpeedVTimeOut_flg_Inproc/Signal_Limit"
 /begin REF_CHARACTERISTIC KOUTP_LRRawWhlSpeedVTimeOut_flg_maxval KOUTP_LRRawWhlSpeedVTimeOut_flg_minval /end REF_CHARACTERISTIC
/end GROUP
/begin GROUP S103_Signal_Override "SWC_OUTP_type/run_SWC_OUTP_5ms_sys/OUTP/outpmodule/VAPM_LRRawWhlSpeedVTimeOut_flg_Inproc/Signal_Override"
 /begin REF_CHARACTERISTIC KOUTP_LRRawWhlSpeedVTimeOut_flg_ovrdflg KOUTP_LRRawWhlSpeedVTimeOut_flg_ovrdval /end REF_CHARACTERISTIC
/end GROUP
/begin GROUP S104_Signal_Limit "SWC_OUTP_type/run_SWC_OUTP_5ms_sys/OUTP/outpmodule/VAPM_LRRawWhlSpeedV_flg_Inproc/Signal_Limit"
 /begin REF_CHARACTERISTIC KOUTP_LRRawWhlSpeedV_flg_maxval KOUTP_LRRawWhlSpeedV_flg_minval /end REF_CHARACTERISTIC
/end GROUP
/begin GROUP S104_Signal_Override "SWC_OUTP_type/run_SWC_OUTP_5ms_sys/OUTP/outpmodule/VAPM_LRRawWhlSpeedV_flg_Inproc/Signal_Override"
 /begin REF_CHARACTERISTIC KOUTP_LRRawWhlSpeedV_flg_ovrdflg KOUTP_LRRawWhlSpeedV_flg_ovrdval /end REF_CHARACTERISTIC
/end GROUP
/begin GROUP S105_Signal_Limit "SWC_OUTP_type/run_SWC_OUTP_5ms_sys/OUTP/outpmodule/VAPM_LRRawWhlSpeed_kph_Inproc/Signal_Limit"
 /begin REF_CHARACTERISTIC KOUTP_LRRawWhlSpeed_kph_maxval KOUTP_LRRawWhlSpeed_kph_minval /end REF_CHARACTERISTIC
/end GROUP
/begin GROUP S105_Signal_Override "SWC_OUTP_type/run_SWC_OUTP_5ms_sys/OUTP/outpmodule/VAPM_LRRawWhlSpeed_kph_Inproc/Signal_Override"
 /begin REF_CHARACTERISTIC KOUTP_LRRawWhlSpeed_kph_ovrdflg KOUTP_LRRawWhlSpeed_kph_ovrdval /end REF_CHARACTERISTIC
/end GROUP
/begin GROUP S106_Signal_Limit "SWC_OUTP_type/run_SWC_OUTP_5ms_sys/OUTP/outpmodule/VAPM_LRWhlRotDirTimeOut_flg_Inproc/Signal_Limit"
 /begin REF_CHARACTERISTIC KOUTP_LRWhlRotDirTimeOut_flg_maxval KOUTP_LRWhlRotDirTimeOut_flg_minval /end REF_CHARACTERISTIC
/end GROUP
/begin GROUP S106_Signal_Override "SWC_OUTP_type/run_SWC_OUTP_5ms_sys/OUTP/outpmodule/VAPM_LRWhlRotDirTimeOut_flg_Inproc/Signal_Override"
 /begin REF_CHARACTERISTIC KOUTP_LRWhlRotDirTimeOut_flg_ovrdflg KOUTP_LRWhlRotDirTimeOut_flg_ovrdval /end REF_CHARACTERISTIC
/end GROUP
/begin GROUP S107_Signal_Limit "SWC_OUTP_type/run_SWC_OUTP_5ms_sys/OUTP/outpmodule/VAPM_LRWhlRotDir_enum_Inproc/Signal_Limit"
 /begin REF_CHARACTERISTIC KOUTP_LRWhlRotDir_enum_maxval KOUTP_LRWhlRotDir_enum_minval /end REF_CHARACTERISTIC
/end GROUP
/begin GROUP S107_Signal_Override "SWC_OUTP_type/run_SWC_OUTP_5ms_sys/OUTP/outpmodule/VAPM_LRWhlRotDir_enum_Inproc/Signal_Override"
 /begin REF_CHARACTERISTIC KOUTP_LRWhlRotDir_enum_ovrdflg KOUTP_LRWhlRotDir_enum_ovrdval /end REF_CHARACTERISTIC
/end GROUP
/begin GROUP S108_Signal_Limit "SWC_OUTP_type/run_SWC_OUTP_5ms_sys/OUTP/outpmodule/VAPM_LatAccelTimeOut_flg_Inproc/Signal_Limit"
 /begin REF_CHARACTERISTIC KOUTP_LatAccelTimeOut_flg_maxval KOUTP_LatAccelTimeOut_flg_minval /end REF_CHARACTERISTIC
/end GROUP
/begin GROUP S108_Signal_Override "SWC_OUTP_type/run_SWC_OUTP_5ms_sys/OUTP/outpmodule/VAPM_LatAccelTimeOut_flg_Inproc/Signal_Override"
 /begin REF_CHARACTERISTIC KOUTP_LatAccelTimeOut_flg_ovrdflg KOUTP_LatAccelTimeOut_flg_ovrdval /end REF_CHARACTERISTIC
/end GROUP
/begin GROUP S109_Signal_Limit "SWC_OUTP_type/run_SWC_OUTP_5ms_sys/OUTP/outpmodule/VAPM_LatAccelVTimeOut_flg_Inproc/Signal_Limit"
 /begin REF_CHARACTERISTIC KOUTP_LatAccelVTimeOut_flg_maxval KOUTP_LatAccelVTimeOut_flg_minval /end REF_CHARACTERISTIC
/end GROUP
/begin GROUP S109_Signal_Override "SWC_OUTP_type/run_SWC_OUTP_5ms_sys/OUTP/outpmodule/VAPM_LatAccelVTimeOut_flg_Inproc/Signal_Override"
 /begin REF_CHARACTERISTIC KOUTP_LatAccelVTimeOut_flg_ovrdflg KOUTP_LatAccelVTimeOut_flg_ovrdval /end REF_CHARACTERISTIC
/end GROUP
/begin GROUP S110_Signal_Limit "SWC_OUTP_type/run_SWC_OUTP_5ms_sys/OUTP/outpmodule/VAPM_LatAccelV_flg_Inproc/Signal_Limit" /begin REF_CHARACTERISTIC KOUTP_LatAccelV_flg_maxval KOUTP_LatAccelV_flg_minval /end REF_CHARACTERISTIC /end GROUP
/begin GROUP S110_Signal_Override "SWC_OUTP_type/run_SWC_OUTP_5ms_sys/OUTP/outpmodule/VAPM_LatAccelV_flg_Inproc/Signal_Override" /begin REF_CHARACTERISTIC KOUTP_LatAccelV_flg_ovrdflg KOUTP_LatAccelV_flg_ovrdval /end REF_CHARACTERISTIC /end GROUP
/begin GROUP S111_Signal_Limit "SWC_OUTP_type/run_SWC_OUTP_5ms_sys/OUTP/outpmodule/VAPM_LatAccel_Gps_Inproc/Signal_Limit" /begin REF_CHARACTERISTIC KOUTP_LatAccel_Gps_maxval KOUTP_LatAccel_Gps_minval /end REF_CHARACTERISTIC /end GROUP
/begin GROUP S111_Signal_Override "SWC_OUTP_type/run_SWC_OUTP_5ms_sys/OUTP/outpmodule/VAPM_LatAccel_Gps_Inproc/Signal_Override" /begin REF_CHARACTERISTIC KOUTP_LatAccel_Gps_ovrdflg KOUTP_LatAccel_Gps_ovrdval /end REF_CHARACTERISTIC /end GROUP
/begin GROUP S112_Signal_Limit "SWC_OUTP_type/run_SWC_OUTP_5ms_sys/OUTP/outpmodule/VAPM_LongAccelTimeOut_flg_Inproc/Signal_Limit"
 /begin REF_CHARACTERISTIC KOUTP_LongAccelTimeOut_flg_maxval KOUTP_LongAccelTimeOut_flg_minval /end REF_CHARACTERISTIC
/end GROUP
/begin GROUP S112_Signal_Override "SWC_OUTP_type/run_SWC_OUTP_5ms_sys/OUTP/outpmodule/VAPM_LongAccelTimeOut_flg_Inproc/Signal_Override"
 /begin REF_CHARACTERISTIC KOUTP_LongAccelTimeOut_flg_ovrdflg KOUTP_LongAccelTimeOut_flg_ovrdval /end REF_CHARACTERISTIC
/end GROUP
/begin GROUP S113_Signal_Limit "SWC_OUTP_type/run_SWC_OUTP_5ms_sys/OUTP/outpmodule/VAPM_LongAccelVTimeOut_flg_Inproc/Signal_Limit"
 /begin REF_CHARACTERISTIC KOUTP_LongAccelVTimeOut_flg_maxval KOUTP_LongAccelVTimeOut_flg_minval /end REF_CHARACTERISTIC
/end GROUP
/begin GROUP S113_Signal_Override "SWC_OUTP_type/run_SWC_OUTP_5ms_sys/OUTP/outpmodule/VAPM_LongAccelVTimeOut_flg_Inproc/Signal_Override"
 /begin REF_CHARACTERISTIC KOUTP_LongAccelVTimeOut_flg_ovrdflg KOUTP_LongAccelVTimeOut_flg_ovrdval /end REF_CHARACTERISTIC
/end GROUP
/begin GROUP S114_Signal_Limit "SWC_OUTP_type/run_SWC_OUTP_5ms_sys/OUTP/outpmodule/VAPM_LongAccelV_flg_Inproc/Signal_Limit" /begin REF_CHARACTERISTIC KOUTP_LongAccelV_flg_maxval KOUTP_LongAccelV_flg_minval /end REF_CHARACTERISTIC /end GROUP
/begin GROUP S114_Signal_Override "SWC_OUTP_type/run_SWC_OUTP_5ms_sys/OUTP/outpmodule/VAPM_LongAccelV_flg_Inproc/Signal_Override" /begin REF_CHARACTERISTIC KOUTP_LongAccelV_flg_ovrdflg KOUTP_LongAccelV_flg_ovrdval /end REF_CHARACTERISTIC /end GROUP
/begin GROUP S115_Signal_Limit "SWC_OUTP_type/run_SWC_OUTP_5ms_sys/OUTP/outpmodule/VAPM_LongAccel_Gps_Inproc/Signal_Limit" /begin REF_CHARACTERISTIC KOUTP_LongAccel_Gps_maxval KOUTP_LongAccel_Gps_minval /end REF_CHARACTERISTIC /end GROUP
/begin GROUP S115_Signal_Override "SWC_OUTP_type/run_SWC_OUTP_5ms_sys/OUTP/outpmodule/VAPM_LongAccel_Gps_Inproc/Signal_Override" /begin REF_CHARACTERISTIC KOUTP_LongAccel_Gps_ovrdflg KOUTP_LongAccel_Gps_ovrdval /end REF_CHARACTERISTIC /end GROUP
/begin GROUP S116_Signal_Limit "SWC_OUTP_type/run_SWC_OUTP_5ms_sys/OUTP/outpmodule/VAPM_MCPressureTimeOut_flg_Inproc/Signal_Limit"
 /begin REF_CHARACTERISTIC KOUTP_MCPressureTimeOut_flg_maxval KOUTP_MCPressureTimeOut_flg_minval /end REF_CHARACTERISTIC
/end GROUP
/begin GROUP S116_Signal_Override "SWC_OUTP_type/run_SWC_OUTP_5ms_sys/OUTP/outpmodule/VAPM_MCPressureTimeOut_flg_Inproc/Signal_Override"
 /begin REF_CHARACTERISTIC KOUTP_MCPressureTimeOut_flg_ovrdflg KOUTP_MCPressureTimeOut_flg_ovrdval /end REF_CHARACTERISTIC
/end GROUP
/begin GROUP S117_Signal_Limit "SWC_OUTP_type/run_SWC_OUTP_5ms_sys/OUTP/outpmodule/VAPM_MCPressureVTimeOut_flg_Inproc/Signal_Limit"
 /begin REF_CHARACTERISTIC KOUTP_MCPressureVTimeOut_flg_maxval KOUTP_MCPressureVTimeOut_flg_minval /end REF_CHARACTERISTIC
/end GROUP
/begin GROUP S117_Signal_Override "SWC_OUTP_type/run_SWC_OUTP_5ms_sys/OUTP/outpmodule/VAPM_MCPressureVTimeOut_flg_Inproc/Signal_Override"
 /begin REF_CHARACTERISTIC KOUTP_MCPressureVTimeOut_flg_ovrdflg KOUTP_MCPressureVTimeOut_flg_ovrdval /end REF_CHARACTERISTIC
/end GROUP
/begin GROUP S118_Signal_Limit "SWC_OUTP_type/run_SWC_OUTP_5ms_sys/OUTP/outpmodule/VAPM_MCPressureV_bar_Inproc/Signal_Limit" /begin REF_CHARACTERISTIC KOUTP_MCPressureV_bar_maxval KOUTP_MCPressureV_bar_minval /end REF_CHARACTERISTIC /end GROUP
/begin GROUP S118_Signal_Override "SWC_OUTP_type/run_SWC_OUTP_5ms_sys/OUTP/outpmodule/VAPM_MCPressureV_bar_Inproc/Signal_Override"
 /begin REF_CHARACTERISTIC KOUTP_MCPressureV_bar_ovrdflg KOUTP_MCPressureV_bar_ovrdval /end REF_CHARACTERISTIC
/end GROUP
/begin GROUP S119_Signal_Limit "SWC_OUTP_type/run_SWC_OUTP_5ms_sys/OUTP/outpmodule/VAPM_MCPressure_bar_Inproc/Signal_Limit" /begin REF_CHARACTERISTIC KOUTP_MCPressure_bar_maxval KOUTP_MCPressure_bar_minval /end REF_CHARACTERISTIC /end GROUP
/begin GROUP S119_Signal_Override "SWC_OUTP_type/run_SWC_OUTP_5ms_sys/OUTP/outpmodule/VAPM_MCPressure_bar_Inproc/Signal_Override" /begin REF_CHARACTERISTIC KOUTP_MCPressure_bar_ovrdflg KOUTP_MCPressure_bar_ovrdval /end REF_CHARACTERISTIC /end GROUP
/begin GROUP S120_Signal_Limit "SWC_OUTP_type/run_SWC_OUTP_5ms_sys/OUTP/outpmodule/VAPM_ModOperation_enum_Inproc/Signal_Limit"
 /begin REF_CHARACTERISTIC KOUTP_ModOperation_enum_maxval KOUTP_ModOperation_enum_minval /end REF_CHARACTERISTIC
/end GROUP
/begin GROUP S120_Signal_Override "SWC_OUTP_type/run_SWC_OUTP_5ms_sys/OUTP/outpmodule/VAPM_ModOperation_enum_Inproc/Signal_Override"
 /begin REF_CHARACTERISTIC KOUTP_ModOperation_enum_ovrdflg KOUTP_ModOperation_enum_ovrdval /end REF_CHARACTERISTIC
/end GROUP
/begin GROUP S121_Signal_Limit "SWC_OUTP_type/run_SWC_OUTP_5ms_sys/OUTP/outpmodule/VAPM_PASAFCL_enum_Inproc/Signal_Limit" /begin REF_CHARACTERISTIC KOUTP_PASAFCL_enum_maxval KOUTP_PASAFCL_enum_minval /end REF_CHARACTERISTIC /end GROUP
/begin GROUP S121_Signal_Override "SWC_OUTP_type/run_SWC_OUTP_5ms_sys/OUTP/outpmodule/VAPM_PASAFCL_enum_Inproc/Signal_Override" /begin REF_CHARACTERISTIC KOUTP_PASAFCL_enum_ovrdflg KOUTP_PASAFCL_enum_ovrdval /end REF_CHARACTERISTIC /end GROUP
/begin GROUP S122_Signal_Limit "SWC_OUTP_type/run_SWC_OUTP_5ms_sys/OUTP/outpmodule/VAPM_PASAFCR_enum_Inproc/Signal_Limit" /begin REF_CHARACTERISTIC KOUTP_PASAFCR_enum_maxval KOUTP_PASAFCR_enum_minval /end REF_CHARACTERISTIC /end GROUP
/begin GROUP S122_Signal_Override "SWC_OUTP_type/run_SWC_OUTP_5ms_sys/OUTP/outpmodule/VAPM_PASAFCR_enum_Inproc/Signal_Override" /begin REF_CHARACTERISTIC KOUTP_PASAFCR_enum_ovrdflg KOUTP_PASAFCR_enum_ovrdval /end REF_CHARACTERISTIC /end GROUP
/begin GROUP S123_Signal_Limit "SWC_OUTP_type/run_SWC_OUTP_5ms_sys/OUTP/outpmodule/VAPM_PASAFML_enum_Inproc/Signal_Limit" /begin REF_CHARACTERISTIC KOUTP_PASAFML_enum_maxval KOUTP_PASAFML_enum_minval /end REF_CHARACTERISTIC /end GROUP
/begin GROUP S123_Signal_Override "SWC_OUTP_type/run_SWC_OUTP_5ms_sys/OUTP/outpmodule/VAPM_PASAFML_enum_Inproc/Signal_Override" /begin REF_CHARACTERISTIC KOUTP_PASAFML_enum_ovrdflg KOUTP_PASAFML_enum_ovrdval /end REF_CHARACTERISTIC /end GROUP
/begin GROUP S124_Signal_Limit "SWC_OUTP_type/run_SWC_OUTP_5ms_sys/OUTP/outpmodule/VAPM_PASAFMR_enum_Inproc/Signal_Limit" /begin REF_CHARACTERISTIC KOUTP_PASAFMR_enum_maxval KOUTP_PASAFMR_enum_minval /end REF_CHARACTERISTIC /end GROUP
/begin GROUP S124_Signal_Override "SWC_OUTP_type/run_SWC_OUTP_5ms_sys/OUTP/outpmodule/VAPM_PASAFMR_enum_Inproc/Signal_Override" /begin REF_CHARACTERISTIC KOUTP_PASAFMR_enum_ovrdflg KOUTP_PASAFMR_enum_ovrdval /end REF_CHARACTERISTIC /end GROUP
/begin GROUP S125_Signal_Limit "SWC_OUTP_type/run_SWC_OUTP_5ms_sys/OUTP/outpmodule/VAPM_PASARCL_enum_Inproc/Signal_Limit" /begin REF_CHARACTERISTIC KOUTP_PASARCL_enum_maxval KOUTP_PASARCL_enum_minval /end REF_CHARACTERISTIC /end GROUP
/begin GROUP S125_Signal_Override "SWC_OUTP_type/run_SWC_OUTP_5ms_sys/OUTP/outpmodule/VAPM_PASARCL_enum_Inproc/Signal_Override" /begin REF_CHARACTERISTIC KOUTP_PASARCL_enum_ovrdflg KOUTP_PASARCL_enum_ovrdval /end REF_CHARACTERISTIC /end GROUP
/begin GROUP S126_Signal_Limit "SWC_OUTP_type/run_SWC_OUTP_5ms_sys/OUTP/outpmodule/VAPM_PASARCR_enum_Inproc/Signal_Limit" /begin REF_CHARACTERISTIC KOUTP_PASARCR_enum_maxval KOUTP_PASARCR_enum_minval /end REF_CHARACTERISTIC /end GROUP
/begin GROUP S126_Signal_Override "SWC_OUTP_type/run_SWC_OUTP_5ms_sys/OUTP/outpmodule/VAPM_PASARCR_enum_Inproc/Signal_Override" /begin REF_CHARACTERISTIC KOUTP_PASARCR_enum_ovrdflg KOUTP_PASARCR_enum_ovrdval /end REF_CHARACTERISTIC /end GROUP
/begin GROUP S127_Signal_Limit "SWC_OUTP_type/run_SWC_OUTP_5ms_sys/OUTP/outpmodule/VAPM_PASARML_enum_Inproc/Signal_Limit" /begin REF_CHARACTERISTIC KOUTP_PASARML_enum_maxval KOUTP_PASARML_enum_minval /end REF_CHARACTERISTIC /end GROUP
/begin GROUP S127_Signal_Override "SWC_OUTP_type/run_SWC_OUTP_5ms_sys/OUTP/outpmodule/VAPM_PASARML_enum_Inproc/Signal_Override" /begin REF_CHARACTERISTIC KOUTP_PASARML_enum_ovrdflg KOUTP_PASARML_enum_ovrdval /end REF_CHARACTERISTIC /end GROUP
/begin GROUP S128_Signal_Limit "SWC_OUTP_type/run_SWC_OUTP_5ms_sys/OUTP/outpmodule/VAPM_PASARMR_enum_Inproc/Signal_Limit" /begin REF_CHARACTERISTIC KOUTP_PASARMR_enum_maxval KOUTP_PASARMR_enum_minval /end REF_CHARACTERISTIC /end GROUP
/begin GROUP S128_Signal_Override "SWC_OUTP_type/run_SWC_OUTP_5ms_sys/OUTP/outpmodule/VAPM_PASARMR_enum_Inproc/Signal_Override" /begin REF_CHARACTERISTIC KOUTP_PASARMR_enum_ovrdflg KOUTP_PASARMR_enum_ovrdval /end REF_CHARACTERISTIC /end GROUP
/begin GROUP S129_Signal_Limit "SWC_OUTP_type/run_SWC_OUTP_5ms_sys/OUTP/outpmodule/VAPM_PASDFCL_cm_Inproc/Signal_Limit" /begin REF_CHARACTERISTIC KOUTP_PASDFCL_cm_maxval KOUTP_PASDFCL_cm_minval /end REF_CHARACTERISTIC /end GROUP
/begin GROUP S129_Signal_Override "SWC_OUTP_type/run_SWC_OUTP_5ms_sys/OUTP/outpmodule/VAPM_PASDFCL_cm_Inproc/Signal_Override" /begin REF_CHARACTERISTIC KOUTP_PASDFCL_cm_ovrdflg KOUTP_PASDFCL_cm_ovrdval /end REF_CHARACTERISTIC /end GROUP
/begin GROUP S130_Signal_Limit "SWC_OUTP_type/run_SWC_OUTP_5ms_sys/OUTP/outpmodule/VAPM_PASDFCR_cm_Inproc/Signal_Limit" /begin REF_CHARACTERISTIC KOUTP_PASDFCR_cm_maxval KOUTP_PASDFCR_cm_minval /end REF_CHARACTERISTIC /end GROUP
/begin GROUP S130_Signal_Override "SWC_OUTP_type/run_SWC_OUTP_5ms_sys/OUTP/outpmodule/VAPM_PASDFCR_cm_Inproc/Signal_Override" /begin REF_CHARACTERISTIC KOUTP_PASDFCR_cm_ovrdflg KOUTP_PASDFCR_cm_ovrdval /end REF_CHARACTERISTIC /end GROUP
/begin GROUP S131_Signal_Limit "SWC_OUTP_type/run_SWC_OUTP_5ms_sys/OUTP/outpmodule/VAPM_PASDFML_cm_Inproc/Signal_Limit" /begin REF_CHARACTERISTIC KOUTP_PASDFML_cm_maxval KOUTP_PASDFML_cm_minval /end REF_CHARACTERISTIC /end GROUP
/begin GROUP S131_Signal_Override "SWC_OUTP_type/run_SWC_OUTP_5ms_sys/OUTP/outpmodule/VAPM_PASDFML_cm_Inproc/Signal_Override" /begin REF_CHARACTERISTIC KOUTP_PASDFML_cm_ovrdflg KOUTP_PASDFML_cm_ovrdval /end REF_CHARACTERISTIC /end GROUP
/begin GROUP S132_Signal_Limit "SWC_OUTP_type/run_SWC_OUTP_5ms_sys/OUTP/outpmodule/VAPM_PASDFMR_cm_Inproc/Signal_Limit" /begin REF_CHARACTERISTIC KOUTP_PASDFMR_cm_maxval KOUTP_PASDFMR_cm_minval /end REF_CHARACTERISTIC /end GROUP
/begin GROUP S132_Signal_Override "SWC_OUTP_type/run_SWC_OUTP_5ms_sys/OUTP/outpmodule/VAPM_PASDFMR_cm_Inproc/Signal_Override" /begin REF_CHARACTERISTIC KOUTP_PASDFMR_cm_ovrdflg KOUTP_PASDFMR_cm_ovrdval /end REF_CHARACTERISTIC /end GROUP
/begin GROUP S133_Signal_Limit "SWC_OUTP_type/run_SWC_OUTP_5ms_sys/OUTP/outpmodule/VAPM_PASDRCL_cm_Inproc/Signal_Limit" /begin REF_CHARACTERISTIC KOUTP_PASDRCL_cm_maxval KOUTP_PASDRCL_cm_minval /end REF_CHARACTERISTIC /end GROUP
/begin GROUP S133_Signal_Override "SWC_OUTP_type/run_SWC_OUTP_5ms_sys/OUTP/outpmodule/VAPM_PASDRCL_cm_Inproc/Signal_Override" /begin REF_CHARACTERISTIC KOUTP_PASDRCL_cm_ovrdflg KOUTP_PASDRCL_cm_ovrdval /end REF_CHARACTERISTIC /end GROUP
/begin GROUP S134_Signal_Limit "SWC_OUTP_type/run_SWC_OUTP_5ms_sys/OUTP/outpmodule/VAPM_PASDRCR_cm_Inproc/Signal_Limit" /begin REF_CHARACTERISTIC KOUTP_PASDRCR_cm_maxval KOUTP_PASDRCR_cm_minval /end REF_CHARACTERISTIC /end GROUP
/begin GROUP S134_Signal_Override "SWC_OUTP_type/run_SWC_OUTP_5ms_sys/OUTP/outpmodule/VAPM_PASDRCR_cm_Inproc/Signal_Override" /begin REF_CHARACTERISTIC KOUTP_PASDRCR_cm_ovrdflg KOUTP_PASDRCR_cm_ovrdval /end REF_CHARACTERISTIC /end GROUP
/begin GROUP S135_Signal_Limit "SWC_OUTP_type/run_SWC_OUTP_5ms_sys/OUTP/outpmodule/VAPM_PASDRML_cm_Inproc/Signal_Limit" /begin REF_CHARACTERISTIC KOUTP_PASDRML_cm_maxval KOUTP_PASDRML_cm_minval /end REF_CHARACTERISTIC /end GROUP
/begin GROUP S135_Signal_Override "SWC_OUTP_type/run_SWC_OUTP_5ms_sys/OUTP/outpmodule/VAPM_PASDRML_cm_Inproc/Signal_Override" /begin REF_CHARACTERISTIC KOUTP_PASDRML_cm_ovrdflg KOUTP_PASDRML_cm_ovrdval /end REF_CHARACTERISTIC /end GROUP
/begin GROUP S136_Signal_Limit "SWC_OUTP_type/run_SWC_OUTP_5ms_sys/OUTP/outpmodule/VAPM_PASDRMR_cm_Inproc/Signal_Limit" /begin REF_CHARACTERISTIC KOUTP_PASDRMR_cm_maxval KOUTP_PASDRMR_cm_minval /end REF_CHARACTERISTIC /end GROUP
/begin GROUP S136_Signal_Override "SWC_OUTP_type/run_SWC_OUTP_5ms_sys/OUTP/outpmodule/VAPM_PASDRMR_cm_Inproc/Signal_Override" /begin REF_CHARACTERISTIC KOUTP_PASDRMR_cm_ovrdflg KOUTP_PASDRMR_cm_ovrdval /end REF_CHARACTERISTIC /end GROUP
/begin GROUP S137_Signal_Limit "SWC_OUTP_type/run_SWC_OUTP_5ms_sys/OUTP/outpmodule/VAPM_PUIDLowPower_flg_Inproc/Signal_Limit"
 /begin REF_CHARACTERISTIC KOUTP_PUIDLowPower_flg_maxval KOUTP_PUIDLowPower_flg_minval /end REF_CHARACTERISTIC
/end GROUP
/begin GROUP S137_Signal_Override "SWC_OUTP_type/run_SWC_OUTP_5ms_sys/OUTP/outpmodule/VAPM_PUIDLowPower_flg_Inproc/Signal_Override"
 /begin REF_CHARACTERISTIC KOUTP_PUIDLowPower_flg_ovrdflg KOUTP_PUIDLowPower_flg_ovrdval /end REF_CHARACTERISTIC
/end GROUP
/begin GROUP S138_Signal_Limit "SWC_OUTP_type/run_SWC_OUTP_5ms_sys/OUTP/outpmodule/VAPM_RAPSBCMLamp_enum_Inproc/Signal_Limit"
 /begin REF_CHARACTERISTIC KOUTP_RAPSBCMLamp_enum_maxval KOUTP_RAPSBCMLamp_enum_minval /end REF_CHARACTERISTIC
/end GROUP
/begin GROUP S138_Signal_Override "SWC_OUTP_type/run_SWC_OUTP_5ms_sys/OUTP/outpmodule/VAPM_RAPSBCMLamp_enum_Inproc/Signal_Override"
 /begin REF_CHARACTERISTIC KOUTP_RAPSBCMLamp_enum_ovrdflg KOUTP_RAPSBCMLamp_enum_ovrdval /end REF_CHARACTERISTIC
/end GROUP
/begin GROUP S139_Signal_Limit "SWC_OUTP_type/run_SWC_OUTP_5ms_sys/OUTP/outpmodule/VAPM_RAPSBCMLockReq_flg_Inproc/Signal_Limit"
 /begin REF_CHARACTERISTIC KOUTP_RAPSBCMLockReq_flg_maxval KOUTP_RAPSBCMLockReq_flg_minval /end REF_CHARACTERISTIC
/end GROUP
/begin GROUP S139_Signal_Override "SWC_OUTP_type/run_SWC_OUTP_5ms_sys/OUTP/outpmodule/VAPM_RAPSBCMLockReq_flg_Inproc/Signal_Override"
 /begin REF_CHARACTERISTIC KOUTP_RAPSBCMLockReq_flg_ovrdflg KOUTP_RAPSBCMLockReq_flg_ovrdval /end REF_CHARACTERISTIC
/end GROUP
/begin GROUP S140_Signal_Limit "SWC_OUTP_type/run_SWC_OUTP_5ms_sys/OUTP/outpmodule/VAPM_RAPSErrLv1_flg_Inproc/Signal_Limit" /begin REF_CHARACTERISTIC KOUTP_RAPSErrLv1_flg_maxval KOUTP_RAPSErrLv1_flg_minval /end REF_CHARACTERISTIC /end GROUP
/begin GROUP S140_Signal_Override "SWC_OUTP_type/run_SWC_OUTP_5ms_sys/OUTP/outpmodule/VAPM_RAPSErrLv1_flg_Inproc/Signal_Override" /begin REF_CHARACTERISTIC KOUTP_RAPSErrLv1_flg_ovrdflg KOUTP_RAPSErrLv1_flg_ovrdval /end REF_CHARACTERISTIC /end GROUP
/begin GROUP S141_Signal_Limit "SWC_OUTP_type/run_SWC_OUTP_5ms_sys/OUTP/outpmodule/VAPM_RAPSErrWarnSta_enum_Inproc/Signal_Limit"
 /begin REF_CHARACTERISTIC KOUTP_RAPSErrWarnSta_enum_maxval KOUTP_RAPSErrWarnSta_enum_minval /end REF_CHARACTERISTIC
/end GROUP
/begin GROUP S141_Signal_Override "SWC_OUTP_type/run_SWC_OUTP_5ms_sys/OUTP/outpmodule/VAPM_RAPSErrWarnSta_enum_Inproc/Signal_Override"
 /begin REF_CHARACTERISTIC KOUTP_RAPSErrWarnSta_enum_ovrdflg KOUTP_RAPSErrWarnSta_enum_ovrdval /end REF_CHARACTERISTIC
/end GROUP
/begin GROUP S142_Signal_Limit "SWC_OUTP_type/run_SWC_OUTP_5ms_sys/OUTP/outpmodule/VAPM_RFPulseCountTimeOut_flg_Inproc/Signal_Limit"
 /begin REF_CHARACTERISTIC KOUTP_RFPulseCountTimeOut_flg_maxval KOUTP_RFPulseCountTimeOut_flg_minval /end REF_CHARACTERISTIC
/end GROUP
/begin GROUP S142_Signal_Override "SWC_OUTP_type/run_SWC_OUTP_5ms_sys/OUTP/outpmodule/VAPM_RFPulseCountTimeOut_flg_Inproc/Signal_Override"
 /begin REF_CHARACTERISTIC KOUTP_RFPulseCountTimeOut_flg_ovrdflg KOUTP_RFPulseCountTimeOut_flg_ovrdval /end REF_CHARACTERISTIC
/end GROUP
/begin GROUP S143_Signal_Limit "SWC_OUTP_type/run_SWC_OUTP_5ms_sys/OUTP/outpmodule/VAPM_RFPulseCountVTimeOut_flg_Inproc/Signal_Limit"
 /begin REF_CHARACTERISTIC KOUTP_RFPulseCountVTimeOut_flg_maxval KOUTP_RFPulseCountVTimeOut_flg_minval /end REF_CHARACTERISTIC
/end GROUP
/begin GROUP S143_Signal_Override "SWC_OUTP_type/run_SWC_OUTP_5ms_sys/OUTP/outpmodule/VAPM_RFPulseCountVTimeOut_flg_Inproc/Signal_Override"
 /begin REF_CHARACTERISTIC KOUTP_RFPulseCountVTimeOut_flg_ovrdflg KOUTP_RFPulseCountVTimeOut_flg_ovrdval /end REF_CHARACTERISTIC
/end GROUP
/begin GROUP S144_Signal_Limit "SWC_OUTP_type/run_SWC_OUTP_5ms_sys/OUTP/outpmodule/VAPM_RFPulseCountV_flg_Inproc/Signal_Limit"
 /begin REF_CHARACTERISTIC KOUTP_RFPulseCountV_flg_maxval KOUTP_RFPulseCountV_flg_minval /end REF_CHARACTERISTIC
/end GROUP
/begin GROUP S144_Signal_Override "SWC_OUTP_type/run_SWC_OUTP_5ms_sys/OUTP/outpmodule/VAPM_RFPulseCountV_flg_Inproc/Signal_Override"
 /begin REF_CHARACTERISTIC KOUTP_RFPulseCountV_flg_ovrdflg KOUTP_RFPulseCountV_flg_ovrdval /end REF_CHARACTERISTIC
/end GROUP
/begin GROUP S145_Signal_Limit "SWC_OUTP_type/run_SWC_OUTP_5ms_sys/OUTP/outpmodule/VAPM_RFPulseCount_enum_Inproc/Signal_Limit"
 /begin REF_CHARACTERISTIC KOUTP_RFPulseCount_enum_maxval KOUTP_RFPulseCount_enum_minval /end REF_CHARACTERISTIC
/end GROUP
/begin GROUP S145_Signal_Override "SWC_OUTP_type/run_SWC_OUTP_5ms_sys/OUTP/outpmodule/VAPM_RFPulseCount_enum_Inproc/Signal_Override"
 /begin REF_CHARACTERISTIC KOUTP_RFPulseCount_enum_ovrdflg KOUTP_RFPulseCount_enum_ovrdval /end REF_CHARACTERISTIC
/end GROUP
/begin GROUP S146_Signal_Limit "SWC_OUTP_type/run_SWC_OUTP_5ms_sys/OUTP/outpmodule/VAPM_RFRawWhlSpeedTimeOut_flg_Inproc/Signal_Limit"
 /begin REF_CHARACTERISTIC KOUTP_RFRawWhlSpeedTimeOut_flg_maxval KOUTP_RFRawWhlSpeedTimeOut_flg_minval /end REF_CHARACTERISTIC
/end GROUP
/begin GROUP S146_Signal_Override "SWC_OUTP_type/run_SWC_OUTP_5ms_sys/OUTP/outpmodule/VAPM_RFRawWhlSpeedTimeOut_flg_Inproc/Signal_Override"
 /begin REF_CHARACTERISTIC KOUTP_RFRawWhlSpeedTimeOut_flg_ovrdflg KOUTP_RFRawWhlSpeedTimeOut_flg_ovrdval /end REF_CHARACTERISTIC
/end GROUP
/begin GROUP S147_Signal_Limit "SWC_OUTP_type/run_SWC_OUTP_5ms_sys/OUTP/outpmodule/VAPM_RFRawWhlSpeedVTimeOut_flg_Inproc/Signal_Limit"
 /begin REF_CHARACTERISTIC KOUTP_RFRawWhlSpeedVTimeOut_flg_maxval KOUTP_RFRawWhlSpeedVTimeOut_flg_minval /end REF_CHARACTERISTIC
/end GROUP
/begin GROUP S147_Signal_Override "SWC_OUTP_type/run_SWC_OUTP_5ms_sys/OUTP/outpmodule/VAPM_RFRawWhlSpeedVTimeOut_flg_Inproc/Signal_Override"
 /begin REF_CHARACTERISTIC KOUTP_RFRawWhlSpeedVTimeOut_flg_ovrdflg KOUTP_RFRawWhlSpeedVTimeOut_flg_ovrdval /end REF_CHARACTERISTIC
/end GROUP
/begin GROUP S148_Signal_Limit "SWC_OUTP_type/run_SWC_OUTP_5ms_sys/OUTP/outpmodule/VAPM_RFRawWhlSpeedV_flg_Inproc/Signal_Limit"
 /begin REF_CHARACTERISTIC KOUTP_RFRawWhlSpeedV_flg_maxval KOUTP_RFRawWhlSpeedV_flg_minval /end REF_CHARACTERISTIC
/end GROUP
/begin GROUP S148_Signal_Override "SWC_OUTP_type/run_SWC_OUTP_5ms_sys/OUTP/outpmodule/VAPM_RFRawWhlSpeedV_flg_Inproc/Signal_Override"
 /begin REF_CHARACTERISTIC KOUTP_RFRawWhlSpeedV_flg_ovrdflg KOUTP_RFRawWhlSpeedV_flg_ovrdval /end REF_CHARACTERISTIC
/end GROUP
/begin GROUP S149_Signal_Limit "SWC_OUTP_type/run_SWC_OUTP_5ms_sys/OUTP/outpmodule/VAPM_RFRawWhlSpeed_kph_Inproc/Signal_Limit"
 /begin REF_CHARACTERISTIC KOUTP_RFRawWhlSpeed_kph_maxval KOUTP_RFRawWhlSpeed_kph_minval /end REF_CHARACTERISTIC
/end GROUP
/begin GROUP S149_Signal_Override "SWC_OUTP_type/run_SWC_OUTP_5ms_sys/OUTP/outpmodule/VAPM_RFRawWhlSpeed_kph_Inproc/Signal_Override"
 /begin REF_CHARACTERISTIC KOUTP_RFRawWhlSpeed_kph_ovrdflg KOUTP_RFRawWhlSpeed_kph_ovrdval /end REF_CHARACTERISTIC
/end GROUP
/begin GROUP S150_Signal_Limit "SWC_OUTP_type/run_SWC_OUTP_5ms_sys/OUTP/outpmodule/VAPM_RFWhlRotDirTimeOut_flg_Inproc/Signal_Limit"
 /begin REF_CHARACTERISTIC KOUTP_RFWhlRotDirTimeOut_flg_maxval KOUTP_RFWhlRotDirTimeOut_flg_minval /end REF_CHARACTERISTIC
/end GROUP
/begin GROUP S150_Signal_Override "SWC_OUTP_type/run_SWC_OUTP_5ms_sys/OUTP/outpmodule/VAPM_RFWhlRotDirTimeOut_flg_Inproc/Signal_Override"
 /begin REF_CHARACTERISTIC KOUTP_RFWhlRotDirTimeOut_flg_ovrdflg KOUTP_RFWhlRotDirTimeOut_flg_ovrdval /end REF_CHARACTERISTIC
/end GROUP
/begin GROUP S151_Signal_Limit "SWC_OUTP_type/run_SWC_OUTP_5ms_sys/OUTP/outpmodule/VAPM_RFWhlRotDir_enum_Inproc/Signal_Limit"
 /begin REF_CHARACTERISTIC KOUTP_RFWhlRotDir_enum_maxval KOUTP_RFWhlRotDir_enum_minval /end REF_CHARACTERISTIC
/end GROUP
/begin GROUP S151_Signal_Override "SWC_OUTP_type/run_SWC_OUTP_5ms_sys/OUTP/outpmodule/VAPM_RFWhlRotDir_enum_Inproc/Signal_Override"
 /begin REF_CHARACTERISTIC KOUTP_RFWhlRotDir_enum_ovrdflg KOUTP_RFWhlRotDir_enum_ovrdval /end REF_CHARACTERISTIC
/end GROUP
/begin GROUP S152_Signal_Limit "SWC_OUTP_type/run_SWC_OUTP_5ms_sys/OUTP/outpmodule/VAPM_RRPulseCountTimeOut_flg_Inproc/Signal_Limit"
 /begin REF_CHARACTERISTIC KOUTP_RRPulseCountTimeOut_flg_maxval KOUTP_RRPulseCountTimeOut_flg_minval /end REF_CHARACTERISTIC
/end GROUP
/begin GROUP S152_Signal_Override "SWC_OUTP_type/run_SWC_OUTP_5ms_sys/OUTP/outpmodule/VAPM_RRPulseCountTimeOut_flg_Inproc/Signal_Override"
 /begin REF_CHARACTERISTIC KOUTP_RRPulseCountTimeOut_flg_ovrdflg KOUTP_RRPulseCountTimeOut_flg_ovrdval /end REF_CHARACTERISTIC
/end GROUP
/begin GROUP S153_Signal_Limit "SWC_OUTP_type/run_SWC_OUTP_5ms_sys/OUTP/outpmodule/VAPM_RRPulseCountVTimeOut_flg_Inproc/Signal_Limit"
 /begin REF_CHARACTERISTIC KOUTP_RRPulseCountVTimeOut_flg_maxval KOUTP_RRPulseCountVTimeOut_flg_minval /end REF_CHARACTERISTIC
/end GROUP
/begin GROUP S153_Signal_Override "SWC_OUTP_type/run_SWC_OUTP_5ms_sys/OUTP/outpmodule/VAPM_RRPulseCountVTimeOut_flg_Inproc/Signal_Override"
 /begin REF_CHARACTERISTIC KOUTP_RRPulseCountVTimeOut_flg_ovrdflg KOUTP_RRPulseCountVTimeOut_flg_ovrdval /end REF_CHARACTERISTIC
/end GROUP
/begin GROUP S154_Signal_Limit "SWC_OUTP_type/run_SWC_OUTP_5ms_sys/OUTP/outpmodule/VAPM_RRPulseCountV_flg_Inproc/Signal_Limit"
 /begin REF_CHARACTERISTIC KOUTP_RRPulseCountV_flg_maxval KOUTP_RRPulseCountV_flg_minval /end REF_CHARACTERISTIC
/end GROUP
/begin GROUP S154_Signal_Override "SWC_OUTP_type/run_SWC_OUTP_5ms_sys/OUTP/outpmodule/VAPM_RRPulseCountV_flg_Inproc/Signal_Override"
 /begin REF_CHARACTERISTIC KOUTP_RRPulseCountV_flg_ovrdflg KOUTP_RRPulseCountV_flg_ovrdval /end REF_CHARACTERISTIC
/end GROUP
/begin GROUP S155_Signal_Limit "SWC_OUTP_type/run_SWC_OUTP_5ms_sys/OUTP/outpmodule/VAPM_RRPulseCount_enum_Inproc/Signal_Limit"
 /begin REF_CHARACTERISTIC KOUTP_RRPulseCount_enum_maxval KOUTP_RRPulseCount_enum_minval /end REF_CHARACTERISTIC
/end GROUP
/begin GROUP S155_Signal_Override "SWC_OUTP_type/run_SWC_OUTP_5ms_sys/OUTP/outpmodule/VAPM_RRPulseCount_enum_Inproc/Signal_Override"
 /begin REF_CHARACTERISTIC KOUTP_RRPulseCount_enum_ovrdflg KOUTP_RRPulseCount_enum_ovrdval /end REF_CHARACTERISTIC
/end GROUP
/begin GROUP S156_Signal_Limit "SWC_OUTP_type/run_SWC_OUTP_5ms_sys/OUTP/outpmodule/VAPM_RRRawWhlSpeedTimeOut_flg_Inproc/Signal_Limit"
 /begin REF_CHARACTERISTIC KOUTP_RRRawWhlSpeedTimeOut_flg_maxval KOUTP_RRRawWhlSpeedTimeOut_flg_minval /end REF_CHARACTERISTIC
/end GROUP
/begin GROUP S156_Signal_Override "SWC_OUTP_type/run_SWC_OUTP_5ms_sys/OUTP/outpmodule/VAPM_RRRawWhlSpeedTimeOut_flg_Inproc/Signal_Override"
 /begin REF_CHARACTERISTIC KOUTP_RRRawWhlSpeedTimeOut_flg_ovrdflg KOUTP_RRRawWhlSpeedTimeOut_flg_ovrdval /end REF_CHARACTERISTIC
/end GROUP
/begin GROUP S157_Signal_Limit "SWC_OUTP_type/run_SWC_OUTP_5ms_sys/OUTP/outpmodule/VAPM_RRRawWhlSpeedVTimeOut_flg_Inproc/Signal_Limit"
 /begin REF_CHARACTERISTIC KOUTP_RRRawWhlSpeedVTimeOut_flg_maxval KOUTP_RRRawWhlSpeedVTimeOut_flg_minval /end REF_CHARACTERISTIC
/end GROUP
/begin GROUP S157_Signal_Override "SWC_OUTP_type/run_SWC_OUTP_5ms_sys/OUTP/outpmodule/VAPM_RRRawWhlSpeedVTimeOut_flg_Inproc/Signal_Override"
 /begin REF_CHARACTERISTIC KOUTP_RRRawWhlSpeedVTimeOut_flg_ovrdflg KOUTP_RRRawWhlSpeedVTimeOut_flg_ovrdval /end REF_CHARACTERISTIC
/end GROUP
/begin GROUP S158_Signal_Limit "SWC_OUTP_type/run_SWC_OUTP_5ms_sys/OUTP/outpmodule/VAPM_RRRawWhlSpeedV_flg_Inproc/Signal_Limit"
 /begin REF_CHARACTERISTIC KOUTP_RRRawWhlSpeedV_flg_maxval KOUTP_RRRawWhlSpeedV_flg_minval /end REF_CHARACTERISTIC
/end GROUP
/begin GROUP S158_Signal_Override "SWC_OUTP_type/run_SWC_OUTP_5ms_sys/OUTP/outpmodule/VAPM_RRRawWhlSpeedV_flg_Inproc/Signal_Override"
 /begin REF_CHARACTERISTIC KOUTP_RRRawWhlSpeedV_flg_ovrdflg KOUTP_RRRawWhlSpeedV_flg_ovrdval /end REF_CHARACTERISTIC
/end GROUP
/begin GROUP S159_Signal_Limit "SWC_OUTP_type/run_SWC_OUTP_5ms_sys/OUTP/outpmodule/VAPM_RRRawWhlSpeed_kph_Inproc/Signal_Limit"
 /begin REF_CHARACTERISTIC KOUTP_RRRawWhlSpeed_kph_maxval KOUTP_RRRawWhlSpeed_kph_minval /end REF_CHARACTERISTIC
/end GROUP
/begin GROUP S159_Signal_Override "SWC_OUTP_type/run_SWC_OUTP_5ms_sys/OUTP/outpmodule/VAPM_RRRawWhlSpeed_kph_Inproc/Signal_Override"
 /begin REF_CHARACTERISTIC KOUTP_RRRawWhlSpeed_kph_ovrdflg KOUTP_RRRawWhlSpeed_kph_ovrdval /end REF_CHARACTERISTIC
/end GROUP
/begin GROUP S160_Signal_Limit "SWC_OUTP_type/run_SWC_OUTP_5ms_sys/OUTP/outpmodule/VAPM_RRWhlRotDirTimeOut_flg_Inproc/Signal_Limit"
 /begin REF_CHARACTERISTIC KOUTP_RRWhlRotDirTimeOut_flg_maxval KOUTP_RRWhlRotDirTimeOut_flg_minval /end REF_CHARACTERISTIC
/end GROUP
/begin GROUP S160_Signal_Override "SWC_OUTP_type/run_SWC_OUTP_5ms_sys/OUTP/outpmodule/VAPM_RRWhlRotDirTimeOut_flg_Inproc/Signal_Override"
 /begin REF_CHARACTERISTIC KOUTP_RRWhlRotDirTimeOut_flg_ovrdflg KOUTP_RRWhlRotDirTimeOut_flg_ovrdval /end REF_CHARACTERISTIC
/end GROUP
/begin GROUP S161_Signal_Limit "SWC_OUTP_type/run_SWC_OUTP_5ms_sys/OUTP/outpmodule/VAPM_RRWhlRotDir_enum_Inproc/Signal_Limit"
 /begin REF_CHARACTERISTIC KOUTP_RRWhlRotDir_enum_maxval KOUTP_RRWhlRotDir_enum_minval /end REF_CHARACTERISTIC
/end GROUP
/begin GROUP S161_Signal_Override "SWC_OUTP_type/run_SWC_OUTP_5ms_sys/OUTP/outpmodule/VAPM_RRWhlRotDir_enum_Inproc/Signal_Override"
 /begin REF_CHARACTERISTIC KOUTP_RRWhlRotDir_enum_ovrdflg KOUTP_RRWhlRotDir_enum_ovrdval /end REF_CHARACTERISTIC
/end GROUP
/begin GROUP S162_Signal_Limit "SWC_OUTP_type/run_SWC_OUTP_5ms_sys/OUTP/outpmodule/VAPM_SASAngleTimeOut_flg_Inproc/Signal_Limit"
 /begin REF_CHARACTERISTIC KOUTP_SASAngleTimeOut_flg_maxval KOUTP_SASAngleTimeOut_flg_minval /end REF_CHARACTERISTIC
/end GROUP
/begin GROUP S162_Signal_Override "SWC_OUTP_type/run_SWC_OUTP_5ms_sys/OUTP/outpmodule/VAPM_SASAngleTimeOut_flg_Inproc/Signal_Override"
 /begin REF_CHARACTERISTIC KOUTP_SASAngleTimeOut_flg_ovrdflg KOUTP_SASAngleTimeOut_flg_ovrdval /end REF_CHARACTERISTIC
/end GROUP
/begin GROUP S163_Signal_Limit "SWC_OUTP_type/run_SWC_OUTP_5ms_sys/OUTP/outpmodule/VAPM_SASAngle_Deg_Inproc/Signal_Limit" /begin REF_CHARACTERISTIC KOUTP_SASAngle_Deg_maxval KOUTP_SASAngle_Deg_minval /end REF_CHARACTERISTIC /end GROUP
/begin GROUP S163_Signal_Override "SWC_OUTP_type/run_SWC_OUTP_5ms_sys/OUTP/outpmodule/VAPM_SASAngle_Deg_Inproc/Signal_Override" /begin REF_CHARACTERISTIC KOUTP_SASAngle_Deg_ovrdflg KOUTP_SASAngle_Deg_ovrdval /end REF_CHARACTERISTIC /end GROUP
/begin GROUP S164_Signal_Limit "SWC_OUTP_type/run_SWC_OUTP_5ms_sys/OUTP/outpmodule/VAPM_SASCALTimeOut_flg_Inproc/Signal_Limit"
 /begin REF_CHARACTERISTIC KOUTP_SASCALTimeOut_flg_maxval KOUTP_SASCALTimeOut_flg_minval /end REF_CHARACTERISTIC
/end GROUP
/begin GROUP S164_Signal_Override "SWC_OUTP_type/run_SWC_OUTP_5ms_sys/OUTP/outpmodule/VAPM_SASCALTimeOut_flg_Inproc/Signal_Override"
 /begin REF_CHARACTERISTIC KOUTP_SASCALTimeOut_flg_ovrdflg KOUTP_SASCALTimeOut_flg_ovrdval /end REF_CHARACTERISTIC
/end GROUP
/begin GROUP S165_Signal_Limit "SWC_OUTP_type/run_SWC_OUTP_5ms_sys/OUTP/outpmodule/VAPM_SASCAL_flg_Inproc/Signal_Limit" /begin REF_CHARACTERISTIC KOUTP_SASCAL_flg_maxval KOUTP_SASCAL_flg_minval /end REF_CHARACTERISTIC /end GROUP
/begin GROUP S165_Signal_Override "SWC_OUTP_type/run_SWC_OUTP_5ms_sys/OUTP/outpmodule/VAPM_SASCAL_flg_Inproc/Signal_Override" /begin REF_CHARACTERISTIC KOUTP_SASCAL_flg_ovrdflg KOUTP_SASCAL_flg_ovrdval /end REF_CHARACTERISTIC /end GROUP
/begin GROUP S166_Signal_Limit "SWC_OUTP_type/run_SWC_OUTP_5ms_sys/OUTP/outpmodule/VAPM_SASSpeedTimeOut_flg_Inproc/Signal_Limit"
 /begin REF_CHARACTERISTIC KOUTP_SASSpeedTimeOut_flg_maxval KOUTP_SASSpeedTimeOut_flg_minval /end REF_CHARACTERISTIC
/end GROUP
/begin GROUP S166_Signal_Override "SWC_OUTP_type/run_SWC_OUTP_5ms_sys/OUTP/outpmodule/VAPM_SASSpeedTimeOut_flg_Inproc/Signal_Override"
 /begin REF_CHARACTERISTIC KOUTP_SASSpeedTimeOut_flg_ovrdflg KOUTP_SASSpeedTimeOut_flg_ovrdval /end REF_CHARACTERISTIC
/end GROUP
/begin GROUP S167_Signal_Limit "SWC_OUTP_type/run_SWC_OUTP_5ms_sys/OUTP/outpmodule/VAPM_SASSpeedValidTimeOut_flg_Inproc/Signal_Limit"
 /begin REF_CHARACTERISTIC KOUTP_SASSpeedValidTimeOut_flg_maxval KOUTP_SASSpeedValidTimeOut_flg_minval /end REF_CHARACTERISTIC
/end GROUP
/begin GROUP S167_Signal_Override "SWC_OUTP_type/run_SWC_OUTP_5ms_sys/OUTP/outpmodule/VAPM_SASSpeedValidTimeOut_flg_Inproc/Signal_Override"
 /begin REF_CHARACTERISTIC KOUTP_SASSpeedValidTimeOut_flg_ovrdflg KOUTP_SASSpeedValidTimeOut_flg_ovrdval /end REF_CHARACTERISTIC
/end GROUP
/begin GROUP S168_Signal_Limit "SWC_OUTP_type/run_SWC_OUTP_5ms_sys/OUTP/outpmodule/VAPM_SASSpeedValid_flg_Inproc/Signal_Limit"
 /begin REF_CHARACTERISTIC KOUTP_SASSpeedValid_flg_maxval KOUTP_SASSpeedValid_flg_minval /end REF_CHARACTERISTIC
/end GROUP
/begin GROUP S168_Signal_Override "SWC_OUTP_type/run_SWC_OUTP_5ms_sys/OUTP/outpmodule/VAPM_SASSpeedValid_flg_Inproc/Signal_Override"
 /begin REF_CHARACTERISTIC KOUTP_SASSpeedValid_flg_ovrdflg KOUTP_SASSpeedValid_flg_ovrdval /end REF_CHARACTERISTIC
/end GROUP
/begin GROUP S169_Signal_Limit "SWC_OUTP_type/run_SWC_OUTP_5ms_sys/OUTP/outpmodule/VAPM_SASSpeed_degps_Inproc/Signal_Limit" /begin REF_CHARACTERISTIC KOUTP_SASSpeed_degps_maxval KOUTP_SASSpeed_degps_minval /end REF_CHARACTERISTIC /end GROUP
/begin GROUP S169_Signal_Override "SWC_OUTP_type/run_SWC_OUTP_5ms_sys/OUTP/outpmodule/VAPM_SASSpeed_degps_Inproc/Signal_Override" /begin REF_CHARACTERISTIC KOUTP_SASSpeed_degps_ovrdflg KOUTP_SASSpeed_degps_ovrdval /end REF_CHARACTERISTIC /end GROUP
/begin GROUP S170_Signal_Limit "SWC_OUTP_type/run_SWC_OUTP_5ms_sys/OUTP/outpmodule/VAPM_SASVTimeOut_flg_Inproc/Signal_Limit" /begin REF_CHARACTERISTIC KOUTP_SASVTimeOut_flg_maxval KOUTP_SASVTimeOut_flg_minval /end REF_CHARACTERISTIC /end GROUP
/begin GROUP S170_Signal_Override "SWC_OUTP_type/run_SWC_OUTP_5ms_sys/OUTP/outpmodule/VAPM_SASVTimeOut_flg_Inproc/Signal_Override"
 /begin REF_CHARACTERISTIC KOUTP_SASVTimeOut_flg_ovrdflg KOUTP_SASVTimeOut_flg_ovrdval /end REF_CHARACTERISTIC
/end GROUP
/begin GROUP S171_Signal_Limit "SWC_OUTP_type/run_SWC_OUTP_5ms_sys/OUTP/outpmodule/VAPM_SASV_flg_Inproc/Signal_Limit" /begin REF_CHARACTERISTIC KOUTP_SASV_flg_maxval KOUTP_SASV_flg_minval /end REF_CHARACTERISTIC /end GROUP
/begin GROUP S171_Signal_Override "SWC_OUTP_type/run_SWC_OUTP_5ms_sys/OUTP/outpmodule/VAPM_SASV_flg_Inproc/Signal_Override" /begin REF_CHARACTERISTIC KOUTP_SASV_flg_ovrdflg KOUTP_SASV_flg_ovrdval /end REF_CHARACTERISTIC /end GROUP
/begin GROUP S172_Signal_Limit "SWC_OUTP_type/run_SWC_OUTP_5ms_sys/OUTP/outpmodule/VAPM_SNSRLayout_enum_Inproc/Signal_Limit" /begin REF_CHARACTERISTIC KOUTP_SNSRLayout_enum_maxval KOUTP_SNSRLayout_enum_minval /end REF_CHARACTERISTIC /end GROUP
/begin GROUP S172_Signal_Override "SWC_OUTP_type/run_SWC_OUTP_5ms_sys/OUTP/outpmodule/VAPM_SNSRLayout_enum_Inproc/Signal_Override"
 /begin REF_CHARACTERISTIC KOUTP_SNSRLayout_enum_ovrdflg KOUTP_SNSRLayout_enum_ovrdval /end REF_CHARACTERISTIC
/end GROUP
/begin GROUP S173_Signal_Limit "SWC_OUTP_type/run_SWC_OUTP_5ms_sys/OUTP/outpmodule/VAPM_ShifterHandleCmdTimeOut_flg_Inproc/Signal_Limit"
 /begin REF_CHARACTERISTIC KOUTP_ShifterHandleCmdTimeOut_flg_maxval KOUTP_ShifterHandleCmdTimeOut_flg_minval /end REF_CHARACTERISTIC
/end GROUP
/begin GROUP S173_Signal_Override "SWC_OUTP_type/run_SWC_OUTP_5ms_sys/OUTP/outpmodule/VAPM_ShifterHandleCmdTimeOut_flg_Inproc/Signal_Override"
 /begin REF_CHARACTERISTIC KOUTP_ShifterHandleCmdTimeOut_flg_ovrdflg KOUTP_ShifterHandleCmdTimeOut_flg_ovrdval /end REF_CHARACTERISTIC
/end GROUP
/begin GROUP S174_Signal_Limit "SWC_OUTP_type/run_SWC_OUTP_5ms_sys/OUTP/outpmodule/VAPM_ShifterHandleCmd_enum_Inproc/Signal_Limit"
 /begin REF_CHARACTERISTIC KOUTP_ShifterHandleCmd_enum_maxval KOUTP_ShifterHandleCmd_enum_minval /end REF_CHARACTERISTIC
/end GROUP
/begin GROUP S174_Signal_Override "SWC_OUTP_type/run_SWC_OUTP_5ms_sys/OUTP/outpmodule/VAPM_ShifterHandleCmd_enum_Inproc/Signal_Override"
 /begin REF_CHARACTERISTIC KOUTP_ShifterHandleCmd_enum_ovrdflg KOUTP_ShifterHandleCmd_enum_ovrdval /end REF_CHARACTERISTIC
/end GROUP
/begin GROUP S175_Signal_Limit "SWC_OUTP_type/run_SWC_OUTP_5ms_sys/OUTP/outpmodule/VAPM_StaFSya_flg_Inproc/Signal_Limit" /begin REF_CHARACTERISTIC KOUTP_StaFSya_flg_maxval KOUTP_StaFSya_flg_minval /end REF_CHARACTERISTIC /end GROUP
/begin GROUP S175_Signal_Override "SWC_OUTP_type/run_SWC_OUTP_5ms_sys/OUTP/outpmodule/VAPM_StaFSya_flg_Inproc/Signal_Override" /begin REF_CHARACTERISTIC KOUTP_StaFSya_flg_ovrdflg KOUTP_StaFSya_flg_ovrdval /end REF_CHARACTERISTIC /end GROUP
/begin GROUP S176_Signal_Limit "SWC_OUTP_type/run_SWC_OUTP_5ms_sys/OUTP/outpmodule/VAPM_TCSActiveTimeOut_flg_Inproc/Signal_Limit"
 /begin REF_CHARACTERISTIC KOUTP_TCSActiveTimeOut_flg_maxval KOUTP_TCSActiveTimeOut_flg_minval /end REF_CHARACTERISTIC
/end GROUP
/begin GROUP S176_Signal_Override "SWC_OUTP_type/run_SWC_OUTP_5ms_sys/OUTP/outpmodule/VAPM_TCSActiveTimeOut_flg_Inproc/Signal_Override"
 /begin REF_CHARACTERISTIC KOUTP_TCSActiveTimeOut_flg_ovrdflg KOUTP_TCSActiveTimeOut_flg_ovrdval /end REF_CHARACTERISTIC
/end GROUP
/begin GROUP S177_Signal_Limit "SWC_OUTP_type/run_SWC_OUTP_5ms_sys/OUTP/outpmodule/VAPM_TCSActive_flg_Inproc/Signal_Limit" /begin REF_CHARACTERISTIC KOUTP_TCSActive_flg_maxval KOUTP_TCSActive_flg_minval /end REF_CHARACTERISTIC /end GROUP
/begin GROUP S177_Signal_Override "SWC_OUTP_type/run_SWC_OUTP_5ms_sys/OUTP/outpmodule/VAPM_TCSActive_flg_Inproc/Signal_Override" /begin REF_CHARACTERISTIC KOUTP_TCSActive_flg_ovrdflg KOUTP_TCSActive_flg_ovrdval /end REF_CHARACTERISTIC /end GROUP
/begin GROUP S178_Signal_Limit "SWC_OUTP_type/run_SWC_OUTP_5ms_sys/OUTP/outpmodule/VAPM_USSStaFCL_flg_Inproc/Signal_Limit" /begin REF_CHARACTERISTIC KOUTP_USSStaFCL_flg_maxval KOUTP_USSStaFCL_flg_minval /end REF_CHARACTERISTIC /end GROUP
/begin GROUP S178_Signal_Override "SWC_OUTP_type/run_SWC_OUTP_5ms_sys/OUTP/outpmodule/VAPM_USSStaFCL_flg_Inproc/Signal_Override" /begin REF_CHARACTERISTIC KOUTP_USSStaFCL_flg_ovrdflg KOUTP_USSStaFCL_flg_ovrdval /end REF_CHARACTERISTIC /end GROUP
/begin GROUP S179_Signal_Limit "SWC_OUTP_type/run_SWC_OUTP_5ms_sys/OUTP/outpmodule/VAPM_USSStaFCR_flg_Inproc/Signal_Limit" /begin REF_CHARACTERISTIC KOUTP_USSStaFCR_flg_maxval KOUTP_USSStaFCR_flg_minval /end REF_CHARACTERISTIC /end GROUP
/begin GROUP S179_Signal_Override "SWC_OUTP_type/run_SWC_OUTP_5ms_sys/OUTP/outpmodule/VAPM_USSStaFCR_flg_Inproc/Signal_Override" /begin REF_CHARACTERISTIC KOUTP_USSStaFCR_flg_ovrdflg KOUTP_USSStaFCR_flg_ovrdval /end REF_CHARACTERISTIC /end GROUP
/begin GROUP S180_Signal_Limit "SWC_OUTP_type/run_SWC_OUTP_5ms_sys/OUTP/outpmodule/VAPM_USSStaFLL_flg_Inproc/Signal_Limit" /begin REF_CHARACTERISTIC KOUTP_USSStaFLL_flg_maxval KOUTP_USSStaFLL_flg_minval /end REF_CHARACTERISTIC /end GROUP
/begin GROUP S180_Signal_Override "SWC_OUTP_type/run_SWC_OUTP_5ms_sys/OUTP/outpmodule/VAPM_USSStaFLL_flg_Inproc/Signal_Override" /begin REF_CHARACTERISTIC KOUTP_USSStaFLL_flg_ovrdflg KOUTP_USSStaFLL_flg_ovrdval /end REF_CHARACTERISTIC /end GROUP
/begin GROUP S181_Signal_Limit "SWC_OUTP_type/run_SWC_OUTP_5ms_sys/OUTP/outpmodule/VAPM_USSStaFLR_flg_Inproc/Signal_Limit" /begin REF_CHARACTERISTIC KOUTP_USSStaFLR_flg_maxval KOUTP_USSStaFLR_flg_minval /end REF_CHARACTERISTIC /end GROUP
/begin GROUP S181_Signal_Override "SWC_OUTP_type/run_SWC_OUTP_5ms_sys/OUTP/outpmodule/VAPM_USSStaFLR_flg_Inproc/Signal_Override" /begin REF_CHARACTERISTIC KOUTP_USSStaFLR_flg_ovrdflg KOUTP_USSStaFLR_flg_ovrdval /end REF_CHARACTERISTIC /end GROUP
/begin GROUP S182_Signal_Limit "SWC_OUTP_type/run_SWC_OUTP_5ms_sys/OUTP/outpmodule/VAPM_USSStaFML_flg_Inproc/Signal_Limit" /begin REF_CHARACTERISTIC KOUTP_USSStaFML_flg_maxval KOUTP_USSStaFML_flg_minval /end REF_CHARACTERISTIC /end GROUP
/begin GROUP S182_Signal_Override "SWC_OUTP_type/run_SWC_OUTP_5ms_sys/OUTP/outpmodule/VAPM_USSStaFML_flg_Inproc/Signal_Override" /begin REF_CHARACTERISTIC KOUTP_USSStaFML_flg_ovrdflg KOUTP_USSStaFML_flg_ovrdval /end REF_CHARACTERISTIC /end GROUP
/begin GROUP S183_Signal_Limit "SWC_OUTP_type/run_SWC_OUTP_5ms_sys/OUTP/outpmodule/VAPM_USSStaFMR_flg_Inproc/Signal_Limit" /begin REF_CHARACTERISTIC KOUTP_USSStaFMR_flg_maxval KOUTP_USSStaFMR_flg_minval /end REF_CHARACTERISTIC /end GROUP
/begin GROUP S183_Signal_Override "SWC_OUTP_type/run_SWC_OUTP_5ms_sys/OUTP/outpmodule/VAPM_USSStaFMR_flg_Inproc/Signal_Override" /begin REF_CHARACTERISTIC KOUTP_USSStaFMR_flg_ovrdflg KOUTP_USSStaFMR_flg_ovrdval /end REF_CHARACTERISTIC /end GROUP
/begin GROUP S184_Signal_Limit "SWC_OUTP_type/run_SWC_OUTP_5ms_sys/OUTP/outpmodule/VAPM_USSStaRCL_flg_Inproc/Signal_Limit" /begin REF_CHARACTERISTIC KOUTP_USSStaRCL_flg_maxval KOUTP_USSStaRCL_flg_minval /end REF_CHARACTERISTIC /end GROUP
/begin GROUP S184_Signal_Override "SWC_OUTP_type/run_SWC_OUTP_5ms_sys/OUTP/outpmodule/VAPM_USSStaRCL_flg_Inproc/Signal_Override" /begin REF_CHARACTERISTIC KOUTP_USSStaRCL_flg_ovrdflg KOUTP_USSStaRCL_flg_ovrdval /end REF_CHARACTERISTIC /end GROUP
/begin GROUP S185_Signal_Limit "SWC_OUTP_type/run_SWC_OUTP_5ms_sys/OUTP/outpmodule/VAPM_USSStaRCR_flg_Inproc/Signal_Limit" /begin REF_CHARACTERISTIC KOUTP_USSStaRCR_flg_maxval KOUTP_USSStaRCR_flg_minval /end REF_CHARACTERISTIC /end GROUP
/begin GROUP S185_Signal_Override "SWC_OUTP_type/run_SWC_OUTP_5ms_sys/OUTP/outpmodule/VAPM_USSStaRCR_flg_Inproc/Signal_Override" /begin REF_CHARACTERISTIC KOUTP_USSStaRCR_flg_ovrdflg KOUTP_USSStaRCR_flg_ovrdval /end REF_CHARACTERISTIC /end GROUP
/begin GROUP S186_Signal_Limit "SWC_OUTP_type/run_SWC_OUTP_5ms_sys/OUTP/outpmodule/VAPM_USSStaRLL_flg_Inproc/Signal_Limit" /begin REF_CHARACTERISTIC KOUTP_USSStaRLL_flg_maxval KOUTP_USSStaRLL_flg_minval /end REF_CHARACTERISTIC /end GROUP
/begin GROUP S186_Signal_Override "SWC_OUTP_type/run_SWC_OUTP_5ms_sys/OUTP/outpmodule/VAPM_USSStaRLL_flg_Inproc/Signal_Override" /begin REF_CHARACTERISTIC KOUTP_USSStaRLL_flg_ovrdflg KOUTP_USSStaRLL_flg_ovrdval /end REF_CHARACTERISTIC /end GROUP
/begin GROUP S187_Signal_Limit "SWC_OUTP_type/run_SWC_OUTP_5ms_sys/OUTP/outpmodule/VAPM_USSStaRLR_flg_Inproc/Signal_Limit" /begin REF_CHARACTERISTIC KOUTP_USSStaRLR_flg_maxval KOUTP_USSStaRLR_flg_minval /end REF_CHARACTERISTIC /end GROUP
/begin GROUP S187_Signal_Override "SWC_OUTP_type/run_SWC_OUTP_5ms_sys/OUTP/outpmodule/VAPM_USSStaRLR_flg_Inproc/Signal_Override" /begin REF_CHARACTERISTIC KOUTP_USSStaRLR_flg_ovrdflg KOUTP_USSStaRLR_flg_ovrdval /end REF_CHARACTERISTIC /end GROUP
/begin GROUP S188_Signal_Limit "SWC_OUTP_type/run_SWC_OUTP_5ms_sys/OUTP/outpmodule/VAPM_USSStaRML_flg_Inproc/Signal_Limit" /begin REF_CHARACTERISTIC KOUTP_USSStaRML_flg_maxval KOUTP_USSStaRML_flg_minval /end REF_CHARACTERISTIC /end GROUP
/begin GROUP S188_Signal_Override "SWC_OUTP_type/run_SWC_OUTP_5ms_sys/OUTP/outpmodule/VAPM_USSStaRML_flg_Inproc/Signal_Override" /begin REF_CHARACTERISTIC KOUTP_USSStaRML_flg_ovrdflg KOUTP_USSStaRML_flg_ovrdval /end REF_CHARACTERISTIC /end GROUP
/begin GROUP S189_Signal_Limit "SWC_OUTP_type/run_SWC_OUTP_5ms_sys/OUTP/outpmodule/VAPM_USSStaRMR_flg_Inproc/Signal_Limit" /begin REF_CHARACTERISTIC KOUTP_USSStaRMR_flg_maxval KOUTP_USSStaRMR_flg_minval /end REF_CHARACTERISTIC /end GROUP
/begin GROUP S189_Signal_Override "SWC_OUTP_type/run_SWC_OUTP_5ms_sys/OUTP/outpmodule/VAPM_USSStaRMR_flg_Inproc/Signal_Override" /begin REF_CHARACTERISTIC KOUTP_USSStaRMR_flg_ovrdflg KOUTP_USSStaRMR_flg_ovrdval /end REF_CHARACTERISTIC /end GROUP
/end MODULE
/end PROJECT
