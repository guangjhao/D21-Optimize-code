/******************************************************************************
* ASAP2 file: SWC_HALIN_type.a2l
* Code generation for model "SWC_HALIN_type".
* Model version : 1.3
* Simulink Coder version : 9.6 (R2021b) 14-May-2021
* C source code generated on : Thu May 29 15:13:37 2025
* Target selection: autosar.tlc
* Embedded hardware selection: ARM Compatible->ARM Cortex-M
* Code generation objectives: Unspecified
* Validation result: Not run
* (add additional file header information here)
******************************************************************************/
/* Version 1.31 */
ASAP2_VERSION 1 31
/begin PROJECT ProjectName "Project Comment Goes Here"
/begin HEADER "Header Comments go here" /end HEADER
/begin MODULE ModuleName "Module Comment Goes Here"
/begin MOD_PAR "MOD PAR Comment Goes Here" /end MOD_PAR
/begin MOD_COMMON "Mod Common Comment Here" BYTE_ORDER MSB_LAST /end MOD_COMMON
/begin RECORD_LAYOUT Scalar_BOOLEAN FNC_VALUES 1 UBYTE COLUMN_DIR DIRECT /end RECORD_LAYOUT
/begin RECORD_LAYOUT Scalar_UBYTE FNC_VALUES 1 UBYTE COLUMN_DIR DIRECT /end RECORD_LAYOUT
/begin RECORD_LAYOUT Scalar_BYTE FNC_VALUES 1 SBYTE COLUMN_DIR DIRECT /end RECORD_LAYOUT
/begin RECORD_LAYOUT Scalar_UWORD FNC_VALUES 1 UWORD COLUMN_DIR DIRECT /end RECORD_LAYOUT
/begin RECORD_LAYOUT Scalar_SWORD FNC_VALUES 1 SWORD COLUMN_DIR DIRECT /end RECORD_LAYOUT
/begin RECORD_LAYOUT Scalar_ULONG FNC_VALUES 1 ULONG COLUMN_DIR DIRECT /end RECORD_LAYOUT
/begin CHARACTERISTIC KHAL_CAN1ABM1E2E_flg "" VALUE 0x0000 /* @ECU_Address@KHAL_CAN1ABM1E2E_flg@ */ Scalar_BOOLEAN 0 SWC_HALIN_type_CM_boolean_flg 0.0 1.0 /end CHARACTERISTIC
/begin CHARACTERISTIC KHAL_CAN1EPB1E2E_flg "" VALUE 0x0000 /* @ECU_Address@KHAL_CAN1EPB1E2E_flg@ */ Scalar_BOOLEAN 0 SWC_HALIN_type_CM_boolean_flg 0.0 1.0 /end CHARACTERISTIC
/begin CHARACTERISTIC KHAL_CAN1EPS1E2E_flg "" VALUE 0x0000 /* @ECU_Address@KHAL_CAN1EPS1E2E_flg@ */ Scalar_BOOLEAN 0 SWC_HALIN_type_CM_boolean_flg 0.0 1.0 /end CHARACTERISTIC
/begin CHARACTERISTIC KHAL_CAN1ESC1E2E_flg "" VALUE 0x0000 /* @ECU_Address@KHAL_CAN1ESC1E2E_flg@ */ Scalar_BOOLEAN 0 SWC_HALIN_type_CM_boolean_flg 0.0 1.0 /end CHARACTERISTIC
/begin CHARACTERISTIC KHAL_CAN1ESC5E2E_flg "" VALUE 0x0000 /* @ECU_Address@KHAL_CAN1ESC5E2E_flg@ */ Scalar_BOOLEAN 0 SWC_HALIN_type_CM_boolean_flg 0.0 1.0 /end CHARACTERISTIC
/begin CHARACTERISTIC KHAL_CAN3BMS1E2E_flg "" VALUE 0x0000 /* @ECU_Address@KHAL_CAN3BMS1E2E_flg@ */ Scalar_BOOLEAN 0 SWC_HALIN_type_CM_boolean_flg 0.0 1.0 /end CHARACTERISTIC
/begin CHARACTERISTIC KHAL_CAN3BMS6E2E_flg "" VALUE 0x0000 /* @ECU_Address@KHAL_CAN3BMS6E2E_flg@ */ Scalar_BOOLEAN 0 SWC_HALIN_type_CM_boolean_flg 0.0 1.0 /end CHARACTERISTIC
/begin CHARACTERISTIC KHAL_CAN3CCU1E2E_flg "" VALUE 0x0000 /* @ECU_Address@KHAL_CAN3CCU1E2E_flg@ */ Scalar_BOOLEAN 0 SWC_HALIN_type_CM_boolean_flg 0.0 1.0 /end CHARACTERISTIC
/begin CHARACTERISTIC KHAL_CAN3CCU2E2E_flg "" VALUE 0x0000 /* @ECU_Address@KHAL_CAN3CCU2E2E_flg@ */ Scalar_BOOLEAN 0 SWC_HALIN_type_CM_boolean_flg 0.0 1.0 /end CHARACTERISTIC
/begin CHARACTERISTIC KHAL_CAN3MCUBF1E2E_flg "" VALUE 0x0000 /* @ECU_Address@KHAL_CAN3MCUBF1E2E_flg@ */ Scalar_BOOLEAN 0 SWC_HALIN_type_CM_boolean_flg 0.0 1.0 /end CHARACTERISTIC
/begin CHARACTERISTIC KHAL_CAN3MCUBR1E2E_flg "" VALUE 0x0000 /* @ECU_Address@KHAL_CAN3MCUBR1E2E_flg@ */ Scalar_BOOLEAN 0 SWC_HALIN_type_CM_boolean_flg 0.0 1.0 /end CHARACTERISTIC
/begin CHARACTERISTIC KHAL_CAN3MCUNF1E2E_flg "" VALUE 0x0000 /* @ECU_Address@KHAL_CAN3MCUNF1E2E_flg@ */ Scalar_BOOLEAN 0 SWC_HALIN_type_CM_boolean_flg 0.0 1.0 /end CHARACTERISTIC
/begin CHARACTERISTIC KHAL_CAN3MCUNR1E2E_flg "" VALUE 0x0000 /* @ECU_Address@KHAL_CAN3MCUNR1E2E_flg@ */ Scalar_BOOLEAN 0 SWC_HALIN_type_CM_boolean_flg 0.0 1.0 /end CHARACTERISTIC
/begin CHARACTERISTIC KHAL_CAN3Shifter1E2E_flg "" VALUE 0x0000 /* @ECU_Address@KHAL_CAN3Shifter1E2E_flg@ */ Scalar_BOOLEAN 0 SWC_HALIN_type_CM_boolean_flg 0.0 1.0 /end CHARACTERISTIC
/begin CHARACTERISTIC KHAL_CAN3Shifter2E2E_flg "" VALUE 0x0000 /* @ECU_Address@KHAL_CAN3Shifter2E2E_flg@ */ Scalar_BOOLEAN 0 SWC_HALIN_type_CM_boolean_flg 0.0 1.0 /end CHARACTERISTIC
/begin MEASUREMENT VHAL_GPSLONG_enum "" ULONG SWC_HALIN_type_CM_uint32_enum 0 0 0.0 4.294967295E+9 ECU_ADDRESS 0x0000 /* @ECU_Address@VHAL_GPSLONG_enum@ */ /end MEASUREMENT
/begin MEASUREMENT VHAL_TBOXHWVER_enum "" ULONG SWC_HALIN_type_CM_uint32_enum 0 0 0.0 4.294967295E+9 ECU_ADDRESS 0x0000 /* @ECU_Address@VHAL_TBOXHWVER_enum@ */ /end MEASUREMENT
/begin MEASUREMENT VHAL_TBOXSWVER_enum "" ULONG SWC_HALIN_type_CM_uint32_enum 0 0 0.0 4.294967295E+9 ECU_ADDRESS 0x0000 /* @ECU_Address@VHAL_TBOXSWVER_enum@ */ /end MEASUREMENT
/begin MEASUREMENT VHAL_LDrvControlCommand_pct "" FLOAT32_IEEE SWC_HALIN_type_CM_single_pct 0 0 0.0 127.0 ECU_ADDRESS 0x0000 /* @ECU_Address@VHAL_LDrvControlCommand_pct@ */ /end MEASUREMENT
/begin MEASUREMENT VHAL_LPasControlCommand_pct "" FLOAT32_IEEE SWC_HALIN_type_CM_single_pct 0 0 0.0 127.0 ECU_ADDRESS 0x0000 /* @ECU_Address@VHAL_LPasControlCommand_pct@ */ /end MEASUREMENT
/begin MEASUREMENT VHAL_LRLDControlCommand_pct "" FLOAT32_IEEE SWC_HALIN_type_CM_single_pct 0 0 0.0 127.0 ECU_ADDRESS 0x0000 /* @ECU_Address@VHAL_LRLDControlCommand_pct@ */ /end MEASUREMENT
/begin MEASUREMENT VHAL_LRRDControlCommand_pct "" FLOAT32_IEEE SWC_HALIN_type_CM_single_pct 0 0 0.0 127.0 ECU_ADDRESS 0x0000 /* @ECU_Address@VHAL_LRRDControlCommand_pct@ */ /end MEASUREMENT
/begin MEASUREMENT VHAL_MFRDNBrightReq_pct "" FLOAT32_IEEE SWC_HALIN_type_CM_single_pct 0 0 0.0 100.0 ECU_ADDRESS 0x0000 /* @ECU_Address@VHAL_MFRDNBrightReq_pct@ */ /end MEASUREMENT
/begin MEASUREMENT VHAL_SOCV2LLimit_pct "" FLOAT32_IEEE SWC_HALIN_type_CM_single_pct 0 0 0.0 15.0 ECU_ADDRESS 0x0000 /* @ECU_Address@VHAL_SOCV2LLimit_pct@ */ /end MEASUREMENT
/begin MEASUREMENT VHAL_IVICLBlowerYSta_pct "" FLOAT32_IEEE SWC_HALIN_type_CM_single_pct 0 0 0.0 127.0 ECU_ADDRESS 0x0000 /* @ECU_Address@VHAL_IVICLBlowerYSta_pct@ */ /end MEASUREMENT
/begin MEASUREMENT VHAL_IVICLBlowerZSta_pct "" FLOAT32_IEEE SWC_HALIN_type_CM_single_pct 0 0 0.0 127.0 ECU_ADDRESS 0x0000 /* @ECU_Address@VHAL_IVICLBlowerZSta_pct@ */ /end MEASUREMENT
/begin MEASUREMENT VHAL_IVICRBlowerYSta_pct "" FLOAT32_IEEE SWC_HALIN_type_CM_single_pct 0 0 0.0 127.0 ECU_ADDRESS 0x0000 /* @ECU_Address@VHAL_IVICRBlowerYSta_pct@ */ /end MEASUREMENT
/begin MEASUREMENT VHAL_IVICRBlowerZSta_pct "" FLOAT32_IEEE SWC_HALIN_type_CM_single_pct 0 0 0.0 127.0 ECU_ADDRESS 0x0000 /* @ECU_Address@VHAL_IVICRBlowerZSta_pct@ */ /end MEASUREMENT
/begin MEASUREMENT VHAL_IVILBlowerYSta_pct "" FLOAT32_IEEE SWC_HALIN_type_CM_single_pct 0 0 0.0 127.0 ECU_ADDRESS 0x0000 /* @ECU_Address@VHAL_IVILBlowerYSta_pct@ */ /end MEASUREMENT
/begin MEASUREMENT VHAL_IVILBlowerZSta_pct "" FLOAT32_IEEE SWC_HALIN_type_CM_single_pct 0 0 0.0 127.0 ECU_ADDRESS 0x0000 /* @ECU_Address@VHAL_IVILBlowerZSta_pct@ */ /end MEASUREMENT
/begin MEASUREMENT VHAL_IVIRBlowerYSta_pct "" FLOAT32_IEEE SWC_HALIN_type_CM_single_pct 0 0 0.0 127.0 ECU_ADDRESS 0x0000 /* @ECU_Address@VHAL_IVIRBlowerYSta_pct@ */ /end MEASUREMENT
/begin MEASUREMENT VHAL_IVIRBlowerZSta_pct "" FLOAT32_IEEE SWC_HALIN_type_CM_single_pct 0 0 0.0 127.0 ECU_ADDRESS 0x0000 /* @ECU_Address@VHAL_IVIRBlowerZSta_pct@ */ /end MEASUREMENT
/begin MEASUREMENT VHAL_METERKPHCalcu_kph "" FLOAT32_IEEE SWC_HALIN_type_CM_single_kph 0 0 0.0 254.0 ECU_ADDRESS 0x0000 /* @ECU_Address@VHAL_METERKPHCalcu_kph@ */ /end MEASUREMENT
/begin MEASUREMENT VHAL_IVITimeDay_DAY "" FLOAT32_IEEE SWC_HALIN_type_CM_single_DAY 0 0 0.0 31.0 ECU_ADDRESS 0x0000 /* @ECU_Address@VHAL_IVITimeDay_DAY@ */ /end MEASUREMENT
/begin MEASUREMENT VHAL_IVITimeHour_hr "" FLOAT32_IEEE SWC_HALIN_type_CM_single_hr 0 0 0.0 31.0 ECU_ADDRESS 0x0000 /* @ECU_Address@VHAL_IVITimeHour_hr@ */ /end MEASUREMENT
/begin MEASUREMENT VHAL_IVITimeMinute_min "" FLOAT32_IEEE SWC_HALIN_type_CM_single_min 0 0 0.0 63.0 ECU_ADDRESS 0x0000 /* @ECU_Address@VHAL_IVITimeMinute_min@ */ /end MEASUREMENT
/begin MEASUREMENT VHAL_IVITimeMonth_MONTH "" FLOAT32_IEEE SWC_HALIN_type_CM_single_MONTH 0 0 0.0 12.0 ECU_ADDRESS 0x0000 /* @ECU_Address@VHAL_IVITimeMonth_MONTH@ */ /end MEASUREMENT
/begin MEASUREMENT VHAL_IVITimeSecond_s "" FLOAT32_IEEE SWC_HALIN_type_CM_single_s 0 0 0.0 63.0 ECU_ADDRESS 0x0000 /* @ECU_Address@VHAL_IVITimeSecond_s@ */ /end MEASUREMENT
/begin MEASUREMENT VHAL_GPSLAT_s "" FLOAT32_IEEE SWC_HALIN_type_CM_single_s 0 0 0.0 4.294967295E+9 ECU_ADDRESS 0x0000 /* @ECU_Address@VHAL_GPSLAT_s@ */ /end MEASUREMENT
/begin MEASUREMENT VHAL_FrMotorAvailTq_Nm "" FLOAT32_IEEE SWC_HALIN_type_CM_single_Nm 0 0 0.0 1022.0 ECU_ADDRESS 0x0000 /* @ECU_Address@VHAL_FrMotorAvailTq_Nm@ */ /end MEASUREMENT
/begin MEASUREMENT VHAL_HVBChrgPwrTotal_kWh "" FLOAT32_IEEE SWC_HALIN_type_CM_single_kWh 0 0 0.0 262143.0 ECU_ADDRESS 0x0000 /* @ECU_Address@VHAL_HVBChrgPwrTotal_kWh@ */ /end MEASUREMENT
/begin MEASUREMENT VHAL_RrMotorAvailTq_Nm "" FLOAT32_IEEE SWC_HALIN_type_CM_single_Nm 0 0 0.0 1022.0 ECU_ADDRESS 0x0000 /* @ECU_Address@VHAL_RrMotorAvailTq_Nm@ */ /end MEASUREMENT
/begin MEASUREMENT VHAL_HVBDrvPwrTotal_kWh "" FLOAT32_IEEE SWC_HALIN_type_CM_single_kWh 0 0 0.0 262143.0 ECU_ADDRESS 0x0000 /* @ECU_Address@VHAL_HVBDrvPwrTotal_kWh@ */ /end MEASUREMENT
/begin MEASUREMENT VHAL_FrMotorAvailTqNidec_Nm "" FLOAT32_IEEE SWC_HALIN_type_CM_single_Nm 0 0 0.0 1022.0 ECU_ADDRESS 0x0000 /* @ECU_Address@VHAL_FrMotorAvailTqNidec_Nm@ */ /end MEASUREMENT
/begin MEASUREMENT VHAL_FrEOPSpdSetNidec_rpm "" FLOAT32_IEEE SWC_HALIN_type_CM_single_rpm 0 0 0.0 4000.0 ECU_ADDRESS 0x0000 /* @ECU_Address@VHAL_FrEOPSpdSetNidec_rpm@ */ /end MEASUREMENT
/begin MEASUREMENT VHAL_RrMotorAvailTqNidec_Nm "" FLOAT32_IEEE SWC_HALIN_type_CM_single_Nm 0 0 0.0 1022.0 ECU_ADDRESS 0x0000 /* @ECU_Address@VHAL_RrMotorAvailTqNidec_Nm@ */ /end MEASUREMENT
/begin MEASUREMENT VHAL_RrEOPSpdSetNidec_rpm "" FLOAT32_IEEE SWC_HALIN_type_CM_single_rpm 0 0 0.0 4000.0 ECU_ADDRESS 0x0000 /* @ECU_Address@VHAL_RrEOPSpdSetNidec_rpm@ */ /end MEASUREMENT
/begin MEASUREMENT VHAL_RemainChrgTime_min "" FLOAT32_IEEE SWC_HALIN_type_CM_single_min 0 0 0.0 4094.0 ECU_ADDRESS 0x0000 /* @ECU_Address@VHAL_RemainChrgTime_min@ */ /end MEASUREMENT
/begin MEASUREMENT VHAL_HVBCellVoltMax_mV "" FLOAT32_IEEE SWC_HALIN_type_CM_single_mV 0 0 0.0 65533.0 ECU_ADDRESS 0x0000 /* @ECU_Address@VHAL_HVBCellVoltMax_mV@ */ /end MEASUREMENT
/begin MEASUREMENT VHAL_HVBCellVoltMin_mV "" FLOAT32_IEEE SWC_HALIN_type_CM_single_mV 0 0 0.0 65533.0 ECU_ADDRESS 0x0000 /* @ECU_Address@VHAL_HVBCellVoltMin_mV@ */ /end MEASUREMENT
/begin MEASUREMENT VHAL_OBCACCSLimit_A "" FLOAT32_IEEE SWC_HALIN_type_CM_single_A 0 0 0.0 80.0 ECU_ADDRESS 0x0000 /* @ECU_Address@VHAL_OBCACCSLimit_A@ */ /end MEASUREMENT
/begin MEASUREMENT VHAL_ZFRTHCMCLEVentActYSta_pct "" FLOAT32_IEEE SWC_HALIN_type_CM_single_pct 0 0 0.0 127.0 ECU_ADDRESS 0x0000 /* @ECU_Address@VHAL_ZFRTHCMCLEVentActYSta_pct@ */ /end MEASUREMENT
/begin MEASUREMENT VHAL_ZFRTHCMCREVentActYSta_pct "" FLOAT32_IEEE SWC_HALIN_type_CM_single_pct 0 0 0.0 127.0 ECU_ADDRESS 0x0000 /* @ECU_Address@VHAL_ZFRTHCMCREVentActYSta_pct@ */ /end MEASUREMENT
/begin MEASUREMENT VHAL_ZFRTHCMLEVentActYSta_pct "" FLOAT32_IEEE SWC_HALIN_type_CM_single_pct 0 0 0.0 127.0 ECU_ADDRESS 0x0000 /* @ECU_Address@VHAL_ZFRTHCMLEVentActYSta_pct@ */ /end MEASUREMENT
/begin MEASUREMENT VHAL_ZFRTHCMREVentActYSta_pct "" FLOAT32_IEEE SWC_HALIN_type_CM_single_pct 0 0 0.0 127.0 ECU_ADDRESS 0x0000 /* @ECU_Address@VHAL_ZFRTHCMREVentActYSta_pct@ */ /end MEASUREMENT
/begin MEASUREMENT VHAL_PTHighP_KPa "" FLOAT32_IEEE SWC_HALIN_type_CM_single_KPa 0 0 0.0 4000.0 ECU_ADDRESS 0x0000 /* @ECU_Address@VHAL_PTHighP_KPa@ */ /end MEASUREMENT
/begin MEASUREMENT VHAL_PTLowP1_KPa "" FLOAT32_IEEE SWC_HALIN_type_CM_single_KPa 0 0 0.0 4000.0 ECU_ADDRESS 0x0000 /* @ECU_Address@VHAL_PTLowP1_KPa@ */ /end MEASUREMENT
/begin MEASUREMENT VHAL_PTLowP2_KPa "" FLOAT32_IEEE SWC_HALIN_type_CM_single_KPa 0 0 0.0 4000.0 ECU_ADDRESS 0x0000 /* @ECU_Address@VHAL_PTLowP2_KPa@ */ /end MEASUREMENT
/begin MEASUREMENT VHAL_COMPActualPwr_W "" FLOAT32_IEEE SWC_HALIN_type_CM_single_W 0 0 0.0 6000.0 ECU_ADDRESS 0x0000 /* @ECU_Address@VHAL_COMPActualPwr_W@ */ /end MEASUREMENT
/begin MEASUREMENT VHAL_COMPStatorSpd_rpm "" FLOAT32_IEEE SWC_HALIN_type_CM_single_rpm 0 0 0.0 8500.0 ECU_ADDRESS 0x0000 /* @ECU_Address@VHAL_COMPStatorSpd_rpm@ */ /end MEASUREMENT
/begin MEASUREMENT VHAL_LDrvValWdwOpened_pct "" FLOAT32_IEEE SWC_HALIN_type_CM_single_pct 0 0 0.0 100.0 ECU_ADDRESS 0x0000 /* @ECU_Address@VHAL_LDrvValWdwOpened_pct@ */ /end MEASUREMENT
/begin MEASUREMENT VHAL_LPasValWdwOpened_pct "" FLOAT32_IEEE SWC_HALIN_type_CM_single_pct 0 0 0.0 100.0 ECU_ADDRESS 0x0000 /* @ECU_Address@VHAL_LPasValWdwOpened_pct@ */ /end MEASUREMENT
/begin MEASUREMENT VHAL_LRLDValWdwOpened_pct "" FLOAT32_IEEE SWC_HALIN_type_CM_single_pct 0 0 0.0 100.0 ECU_ADDRESS 0x0000 /* @ECU_Address@VHAL_LRLDValWdwOpened_pct@ */ /end MEASUREMENT
/begin MEASUREMENT VHAL_LRRDValWdwOpened_pct "" FLOAT32_IEEE SWC_HALIN_type_CM_single_pct 0 0 0.0 100.0 ECU_ADDRESS 0x0000 /* @ECU_Address@VHAL_LRRDValWdwOpened_pct@ */ /end MEASUREMENT
/begin MEASUREMENT VHAL_BPPTGOpenRatioSta_pct "" FLOAT32_IEEE SWC_HALIN_type_CM_single_pct 0 0 0.0 127.0 ECU_ADDRESS 0x0000 /* @ECU_Address@VHAL_BPPTGOpenRatioSta_pct@ */ /end MEASUREMENT
/begin MEASUREMENT VHAL_BPAPMWinFOpenedSta_pct "" FLOAT32_IEEE SWC_HALIN_type_CM_single_pct 0 0 0.0 127.0 ECU_ADDRESS 0x0000 /* @ECU_Address@VHAL_BPAPMWinFOpenedSta_pct@ */ /end MEASUREMENT
/begin MEASUREMENT VHAL_BPAPMWinROpenedSta_pct "" FLOAT32_IEEE SWC_HALIN_type_CM_single_pct 0 0 0.0 127.0 ECU_ADDRESS 0x0000 /* @ECU_Address@VHAL_BPAPMWinROpenedSta_pct@ */ /end MEASUREMENT
/begin MEASUREMENT VHAL_PTGOpenRatio_pct "" FLOAT32_IEEE SWC_HALIN_type_CM_single_pct 0 0 0.0 127.0 ECU_ADDRESS 0x0000 /* @ECU_Address@VHAL_PTGOpenRatio_pct@ */ /end MEASUREMENT
/begin MEASUREMENT VHAL_BDAPMWinFOpenedSta_pct "" FLOAT32_IEEE SWC_HALIN_type_CM_single_pct 0 0 0.0 127.0 ECU_ADDRESS 0x0000 /* @ECU_Address@VHAL_BDAPMWinFOpenedSta_pct@ */ /end MEASUREMENT
/begin MEASUREMENT VHAL_BDAPMWinROpenedSta_pct "" FLOAT32_IEEE SWC_HALIN_type_CM_single_pct 0 0 0.0 127.0 ECU_ADDRESS 0x0000 /* @ECU_Address@VHAL_BDAPMWinROpenedSta_pct@ */ /end MEASUREMENT
/begin MEASUREMENT VHAL_TimeSyncFromBSDay_DAY "" FLOAT32_IEEE SWC_HALIN_type_CM_single_DAY 0 0 0.0 31.0 ECU_ADDRESS 0x0000 /* @ECU_Address@VHAL_TimeSyncFromBSDay_DAY@ */ /end MEASUREMENT
/begin MEASUREMENT VHAL_TimeSyncFromBSHour_hr "" FLOAT32_IEEE SWC_HALIN_type_CM_single_hr 0 0 0.0 23.0 ECU_ADDRESS 0x0000 /* @ECU_Address@VHAL_TimeSyncFromBSHour_hr@ */ /end MEASUREMENT
/begin MEASUREMENT VHAL_ReserveChargeOFFMonth_MONTH "" FLOAT32_IEEE SWC_HALIN_type_CM_single_MONTH 0 0 0.0 12.0 ECU_ADDRESS 0x0000 /* @ECU_Address@VHAL_ReserveChargeOFFMonth_MONTH@ */ /end MEASUREMENT
/begin MEASUREMENT VHAL_ReserveChargeOnDay_DAY "" FLOAT32_IEEE SWC_HALIN_type_CM_single_DAY 0 0 0.0 31.0 ECU_ADDRESS 0x0000 /* @ECU_Address@VHAL_ReserveChargeOnDay_DAY@ */ /end MEASUREMENT
/begin MEASUREMENT VHAL_ReserveChargeOnHour_hr "" FLOAT32_IEEE SWC_HALIN_type_CM_single_hr 0 0 0.0 23.0 ECU_ADDRESS 0x0000 /* @ECU_Address@VHAL_ReserveChargeOnHour_hr@ */ /end MEASUREMENT
/begin MEASUREMENT VHAL_ReserveChargeOnMinute_min "" FLOAT32_IEEE SWC_HALIN_type_CM_single_min 0 0 0.0 59.0 ECU_ADDRESS 0x0000 /* @ECU_Address@VHAL_ReserveChargeOnMinute_min@ */ /end MEASUREMENT
/begin MEASUREMENT VHAL_ReserveChargeOnMonth_MONTH "" FLOAT32_IEEE SWC_HALIN_type_CM_single_MONTH 0 0 0.0 12.0 ECU_ADDRESS 0x0000 /* @ECU_Address@VHAL_ReserveChargeOnMonth_MONTH@ */ /end MEASUREMENT
/begin MEASUREMENT VHAL_TimeSyncFromBSMinute_min "" FLOAT32_IEEE SWC_HALIN_type_CM_single_min 0 0 0.0 59.0 ECU_ADDRESS 0x0000 /* @ECU_Address@VHAL_TimeSyncFromBSMinute_min@ */ /end MEASUREMENT
/begin MEASUREMENT VHAL_TimeSyncFromBSMonth_MONTH "" FLOAT32_IEEE SWC_HALIN_type_CM_single_MONTH 0 0 0.0 12.0 ECU_ADDRESS 0x0000 /* @ECU_Address@VHAL_TimeSyncFromBSMonth_MONTH@ */ /end MEASUREMENT
/begin MEASUREMENT VHAL_TimeSyncFromBSSecond_s "" FLOAT32_IEEE SWC_HALIN_type_CM_single_s 0 0 0.0 59.0 ECU_ADDRESS 0x0000 /* @ECU_Address@VHAL_TimeSyncFromBSSecond_s@ */ /end MEASUREMENT
/begin MEASUREMENT VHAL_ChargePercentSet_pct "" FLOAT32_IEEE SWC_HALIN_type_CM_single_pct 0 0 0.0 100.0 ECU_ADDRESS 0x0000 /* @ECU_Address@VHAL_ChargePercentSet_pct@ */ /end MEASUREMENT
/begin MEASUREMENT VHAL_ReserveChargeOFFDay_DAY "" FLOAT32_IEEE SWC_HALIN_type_CM_single_DAY 0 0 0.0 31.0 ECU_ADDRESS 0x0000 /* @ECU_Address@VHAL_ReserveChargeOFFDay_DAY@ */ /end MEASUREMENT
/begin MEASUREMENT VHAL_ReserveChargeOFFHour_hr "" FLOAT32_IEEE SWC_HALIN_type_CM_single_hr 0 0 0.0 23.0 ECU_ADDRESS 0x0000 /* @ECU_Address@VHAL_ReserveChargeOFFHour_hr@ */ /end MEASUREMENT
/begin MEASUREMENT VHAL_ReserveChargeOFFMinute_min "" FLOAT32_IEEE SWC_HALIN_type_CM_single_min 0 0 0.0 59.0 ECU_ADDRESS 0x0000 /* @ECU_Address@VHAL_ReserveChargeOFFMinute_min@ */ /end MEASUREMENT
/begin MEASUREMENT VHAL_FrMCUHWVer_enum "" UWORD SWC_HALIN_type_CM_uint16_enum 0 0 0.0 65535.0 ECU_ADDRESS 0x0000 /* @ECU_Address@VHAL_FrMCUHWVer_enum@ */ /end MEASUREMENT
/begin MEASUREMENT VHAL_FrMCUSWVer_enum "" UWORD SWC_HALIN_type_CM_uint16_enum 0 0 0.0 65535.0 ECU_ADDRESS 0x0000 /* @ECU_Address@VHAL_FrMCUSWVer_enum@ */ /end MEASUREMENT
/begin MEASUREMENT VHAL_RrMCU3HWVer_enum "" UWORD SWC_HALIN_type_CM_uint16_enum 0 0 0.0 65535.0 ECU_ADDRESS 0x0000 /* @ECU_Address@VHAL_RrMCU3HWVer_enum@ */ /end MEASUREMENT
/begin MEASUREMENT VHAL_RrMCU3SWVer_enum "" UWORD SWC_HALIN_type_CM_uint16_enum 0 0 0.0 65535.0 ECU_ADDRESS 0x0000 /* @ECU_Address@VHAL_RrMCU3SWVer_enum@ */ /end MEASUREMENT
/begin MEASUREMENT VHAL_FrMCUHWVerNidec_enum "" UWORD SWC_HALIN_type_CM_uint16_enum 0 0 0.0 65535.0 ECU_ADDRESS 0x0000 /* @ECU_Address@VHAL_FrMCUHWVerNidec_enum@ */ /end MEASUREMENT
/begin MEASUREMENT VHAL_FrMCUSWVerNidec_enum "" UWORD SWC_HALIN_type_CM_uint16_enum 0 0 0.0 65535.0 ECU_ADDRESS 0x0000 /* @ECU_Address@VHAL_FrMCUSWVerNidec_enum@ */ /end MEASUREMENT
/begin MEASUREMENT VHAL_RrMCU3HWVerNidec_enum "" UWORD SWC_HALIN_type_CM_uint16_enum 0 0 0.0 65535.0 ECU_ADDRESS 0x0000 /* @ECU_Address@VHAL_RrMCU3HWVerNidec_enum@ */ /end MEASUREMENT
/begin MEASUREMENT VHAL_RrMCU3SWVerNidec_enum "" UWORD SWC_HALIN_type_CM_uint16_enum 0 0 0.0 65535.0 ECU_ADDRESS 0x0000 /* @ECU_Address@VHAL_RrMCU3SWVerNidec_enum@ */ /end MEASUREMENT
/begin MEASUREMENT VHAL_BPPTGLeftHallPosnSta_enum "" UWORD SWC_HALIN_type_CM_uint16_enum 0 0 0.0 1023.0 ECU_ADDRESS 0x0000 /* @ECU_Address@VHAL_BPPTGLeftHallPosnSta_enum@ */ /end MEASUREMENT
/begin MEASUREMENT VHAL_LifeCountABM1_enum "" UBYTE SWC_HALIN_type_CM_uint8_enum 0 0 0.0 14.0 ECU_ADDRESS 0x0000 /* @ECU_Address@VHAL_LifeCountABM1_enum@ */ /end MEASUREMENT
/begin MEASUREMENT VHAL_ESC5CS_enum "" UBYTE SWC_HALIN_type_CM_uint8_enum 0 0 0.0 255.0 ECU_ADDRESS 0x0000 /* @ECU_Address@VHAL_ESC5CS_enum@ */ /end MEASUREMENT
/begin MEASUREMENT VHAL_ESC5RC_enum "" UBYTE SWC_HALIN_type_CM_uint8_enum 0 0 0.0 14.0 ECU_ADDRESS 0x0000 /* @ECU_Address@VHAL_ESC5RC_enum@ */ /end MEASUREMENT
/begin MEASUREMENT VHAL_ESCADASSta_enum "" UBYTE SWC_HALIN_type_CM_uint8_enum 0 0 0.0 6.0 ECU_ADDRESS 0x0000 /* @ECU_Address@VHAL_ESCADASSta_enum@ */ /end MEASUREMENT
/begin MEASUREMENT VHAL_ESCAPSSta_enum "" UBYTE SWC_HALIN_type_CM_uint8_enum 0 0 0.0 5.0 ECU_ADDRESS 0x0000 /* @ECU_Address@VHAL_ESCAPSSta_enum@ */ /end MEASUREMENT
/begin MEASUREMENT VHAL_RDCActive_enum "" UBYTE SWC_HALIN_type_CM_uint8_enum 0 0 0.0 2.0 ECU_ADDRESS 0x0000 /* @ECU_Address@VHAL_RDCActive_enum@ */ /end MEASUREMENT
/begin MEASUREMENT VHAL_EPB1RC_enum "" UBYTE SWC_HALIN_type_CM_uint8_enum 0 0 0.0 14.0 ECU_ADDRESS 0x0000 /* @ECU_Address@VHAL_EPB1RC_enum@ */ /end MEASUREMENT
/begin MEASUREMENT VHAL_EPBErrSta_enum "" UBYTE SWC_HALIN_type_CM_uint8_enum 0 0 0.0 2.0 ECU_ADDRESS 0x0000 /* @ECU_Address@VHAL_EPBErrSta_enum@ */ /end MEASUREMENT
/begin MEASUREMENT VHAL_EPBSta_enum "" UBYTE SWC_HALIN_type_CM_uint8_enum 0 0 0.0 4.0 ECU_ADDRESS 0x0000 /* @ECU_Address@VHAL_EPBSta_enum@ */ /end MEASUREMENT
/begin MEASUREMENT VHAL_DriIntend_enum "" UBYTE SWC_HALIN_type_CM_uint8_enum 0 0 0.0 2.0 ECU_ADDRESS 0x0000 /* @ECU_Address@VHAL_DriIntend_enum@ */ /end MEASUREMENT
/begin MEASUREMENT VHAL_EPSAOIControl_enum "" UBYTE SWC_HALIN_type_CM_uint8_enum 0 0 0.0 3.0 ECU_ADDRESS 0x0000 /* @ECU_Address@VHAL_EPSAOIControl_enum@ */ /end MEASUREMENT
/begin MEASUREMENT VHAL_EPSRC_enum "" UBYTE SWC_HALIN_type_CM_uint8_enum 0 0 0.0 14.0 ECU_ADDRESS 0x0000 /* @ECU_Address@VHAL_EPSRC_enum@ */ /end MEASUREMENT
/begin MEASUREMENT VHAL_EpasFailed_enum "" UBYTE SWC_HALIN_type_CM_uint8_enum 0 0 0.0 2.0 ECU_ADDRESS 0x0000 /* @ECU_Address@VHAL_EpasFailed_enum@ */ /end MEASUREMENT
/begin MEASUREMENT VHAL_ESC1CS_enum "" UBYTE SWC_HALIN_type_CM_uint8_enum 0 0 0.0 255.0 ECU_ADDRESS 0x0000 /* @ECU_Address@VHAL_ESC1CS_enum@ */ /end MEASUREMENT
/begin MEASUREMENT VHAL_ESC1RC_enum "" UBYTE SWC_HALIN_type_CM_uint8_enum 0 0 0.0 14.0 ECU_ADDRESS 0x0000 /* @ECU_Address@VHAL_ESC1RC_enum@ */ /end MEASUREMENT
/begin MEASUREMENT VHAL_ESCOFFStatus_enum "" UBYTE SWC_HALIN_type_CM_uint8_enum 0 0 0.0 2.0 ECU_ADDRESS 0x0000 /* @ECU_Address@VHAL_ESCOFFStatus_enum@ */ /end MEASUREMENT
/begin MEASUREMENT VHAL_ESCWnlmpSta_enum "" UBYTE SWC_HALIN_type_CM_uint8_enum 0 0 0.0 2.0 ECU_ADDRESS 0x0000 /* @ECU_Address@VHAL_ESCWnlmpSta_enum@ */ /end MEASUREMENT
/begin MEASUREMENT VHAL_LFPulseCount_enum "" UBYTE SWC_HALIN_type_CM_uint8_enum 0 0 0.0 255.0 ECU_ADDRESS 0x0000 /* @ECU_Address@VHAL_LFPulseCount_enum@ */ /end MEASUREMENT
/begin MEASUREMENT VHAL_ChecksumABM1_enum "" UBYTE SWC_HALIN_type_CM_uint8_enum 0 0 0.0 255.0 ECU_ADDRESS 0x0000 /* @ECU_Address@VHAL_ChecksumABM1_enum@ */ /end MEASUREMENT
/begin MEASUREMENT VHAL_LFWhlRotDir_enum "" UBYTE SWC_HALIN_type_CM_uint8_enum 0 0 0.0 3.0 ECU_ADDRESS 0x0000 /* @ECU_Address@VHAL_LFWhlRotDir_enum@ */ /end MEASUREMENT
/begin MEASUREMENT VHAL_LRPulseCount_enum "" UBYTE SWC_HALIN_type_CM_uint8_enum 0 0 0.0 255.0 ECU_ADDRESS 0x0000 /* @ECU_Address@VHAL_LRPulseCount_enum@ */ /end MEASUREMENT
/begin MEASUREMENT VHAL_LRWhlRotDir_enum "" UBYTE SWC_HALIN_type_CM_uint8_enum 0 0 0.0 3.0 ECU_ADDRESS 0x0000 /* @ECU_Address@VHAL_LRWhlRotDir_enum@ */ /end MEASUREMENT
/begin MEASUREMENT VHAL_RFPulseCount_enum "" UBYTE SWC_HALIN_type_CM_uint8_enum 0 0 0.0 255.0 ECU_ADDRESS 0x0000 /* @ECU_Address@VHAL_RFPulseCount_enum@ */ /end MEASUREMENT
/begin MEASUREMENT VHAL_CrashOutputSts_enum "" UBYTE SWC_HALIN_type_CM_uint8_enum 0 0 0.0 255.0 ECU_ADDRESS 0x0000 /* @ECU_Address@VHAL_CrashOutputSts_enum@ */ /end MEASUREMENT
/begin MEASUREMENT VHAL_RFWhlRotDir_enum "" UBYTE SWC_HALIN_type_CM_uint8_enum 0 0 0.0 3.0 ECU_ADDRESS 0x0000 /* @ECU_Address@VHAL_RFWhlRotDir_enum@ */ /end MEASUREMENT
/begin MEASUREMENT VHAL_RRPulseCount_enum "" UBYTE SWC_HALIN_type_CM_uint8_enum 0 0 0.0 255.0 ECU_ADDRESS 0x0000 /* @ECU_Address@VHAL_RRPulseCount_enum@ */ /end MEASUREMENT
/begin MEASUREMENT VHAL_RRWhlRotDir_enum "" UBYTE SWC_HALIN_type_CM_uint8_enum 0 0 0.0 3.0 ECU_ADDRESS 0x0000 /* @ECU_Address@VHAL_RRWhlRotDir_enum@ */ /end MEASUREMENT
/begin MEASUREMENT VHAL_IVIPWModeReq_enum "" UBYTE SWC_HALIN_type_CM_uint8_enum 0 0 0.0 3.0 ECU_ADDRESS 0x0000 /* @ECU_Address@VHAL_IVIPWModeReq_enum@ */ /end MEASUREMENT
/begin MEASUREMENT VHAL_IVIPwrLockSW_enum "" UBYTE SWC_HALIN_type_CM_uint8_enum 0 0 0.0 3.0 ECU_ADDRESS 0x0000 /* @ECU_Address@VHAL_IVIPwrLockSW_enum@ */ /end MEASUREMENT
/begin MEASUREMENT VHAL_IVIReqV2L_enum "" UBYTE SWC_HALIN_type_CM_uint8_enum 0 0 0.0 2.0 ECU_ADDRESS 0x0000 /* @ECU_Address@VHAL_IVIReqV2L_enum@ */ /end MEASUREMENT
/begin MEASUREMENT VHAL_IVISWCRUndefinedSta_enum "" UBYTE SWC_HALIN_type_CM_uint8_enum 0 0 0.0 15.0 ECU_ADDRESS 0x0000 /* @ECU_Address@VHAL_IVISWCRUndefinedSta_enum@ */ /end MEASUREMENT
/begin MEASUREMENT VHAL_IVIScreen_enum "" UBYTE SWC_HALIN_type_CM_uint8_enum 0 0 0.0 62.0 ECU_ADDRESS 0x0000 /* @ECU_Address@VHAL_IVIScreen_enum@ */ /end MEASUREMENT
/begin MEASUREMENT VHAL_OFFACMODE_enum "" UBYTE SWC_HALIN_type_CM_uint8_enum 0 0 0.0 7.0 ECU_ADDRESS 0x0000 /* @ECU_Address@VHAL_OFFACMODE_enum@ */ /end MEASUREMENT
/begin MEASUREMENT VHAL_PSEATventreq_enum "" UBYTE SWC_HALIN_type_CM_uint8_enum 0 0 0.0 7.0 ECU_ADDRESS 0x0000 /* @ECU_Address@VHAL_PSEATventreq_enum@ */ /end MEASUREMENT
/begin MEASUREMENT VHAL_PerdV2L_enum "" UBYTE SWC_HALIN_type_CM_uint8_enum 0 0 0.0 15.0 ECU_ADDRESS 0x0000 /* @ECU_Address@VHAL_PerdV2L_enum@ */ /end MEASUREMENT
/begin MEASUREMENT VHAL_RollModeSWCmd_enum "" UBYTE SWC_HALIN_type_CM_uint8_enum 0 0 0.0 3.0 ECU_ADDRESS 0x0000 /* @ECU_Address@VHAL_RollModeSWCmd_enum@ */ /end MEASUREMENT
/begin MEASUREMENT VHAL_SenstivityPosition_enum "" UBYTE SWC_HALIN_type_CM_uint8_enum 0 0 0.0 15.0 ECU_ADDRESS 0x0000 /* @ECU_Address@VHAL_SenstivityPosition_enum@ */ /end MEASUREMENT
/begin MEASUREMENT VHAL_TCSSWCmd_enum "" UBYTE SWC_HALIN_type_CM_uint8_enum 0 0 0.0 3.0 ECU_ADDRESS 0x0000 /* @ECU_Address@VHAL_TCSSWCmd_enum@ */ /end MEASUREMENT
/begin MEASUREMENT VHAL_TurnSwTimeSet_enum "" UBYTE SWC_HALIN_type_CM_uint8_enum 0 0 0.0 3.0 ECU_ADDRESS 0x0000 /* @ECU_Address@VHAL_TurnSwTimeSet_enum@ */ /end MEASUREMENT
/begin MEASUREMENT VHAL_WlcmLightMode_enum "" UBYTE SWC_HALIN_type_CM_uint8_enum 0 0 0.0 3.0 ECU_ADDRESS 0x0000 /* @ECU_Address@VHAL_WlcmLightMode_enum@ */ /end MEASUREMENT
/begin MEASUREMENT VHAL_sigAirIntenZon1Req_enum "" UBYTE SWC_HALIN_type_CM_uint8_enum 0 0 0.0 15.0 ECU_ADDRESS 0x0000 /* @ECU_Address@VHAL_sigAirIntenZon1Req_enum@ */ /end MEASUREMENT
/begin MEASUREMENT VHAL_IVIHMICustmiFunSta_enum "" UBYTE SWC_HALIN_type_CM_uint8_enum 0 0 0.0 15.0 ECU_ADDRESS 0x0000 /* @ECU_Address@VHAL_IVIHMICustmiFunSta_enum@ */ /end MEASUREMENT
/begin MEASUREMENT VHAL_IVIHMICustmiKEYSta_enum "" UBYTE SWC_HALIN_type_CM_uint8_enum 0 0 0.0 15.0 ECU_ADDRESS 0x0000 /* @ECU_Address@VHAL_IVIHMICustmiKEYSta_enum@ */ /end MEASUREMENT
/begin MEASUREMENT VHAL_IVILBlowerModeSta_enum "" UBYTE SWC_HALIN_type_CM_uint8_enum 0 0 0.0 3.0 ECU_ADDRESS 0x0000 /* @ECU_Address@VHAL_IVILBlowerModeSta_enum@ */ /end MEASUREMENT
/begin MEASUREMENT VHAL_AmbLightBrightnessSet_enum "" UBYTE SWC_HALIN_type_CM_uint8_enum 0 0 0.0 127.0 ECU_ADDRESS 0x0000 /* @ECU_Address@VHAL_AmbLightBrightnessSet_enum@ */ /end MEASUREMENT
/begin MEASUREMENT VHAL_IVILSEATventCmd_enum "" UBYTE SWC_HALIN_type_CM_uint8_enum 0 0 0.0 7.0 ECU_ADDRESS 0x0000 /* @ECU_Address@VHAL_IVILSEATventCmd_enum@ */ /end MEASUREMENT
/begin MEASUREMENT VHAL_IVIMLFootLiftCmd_enum "" UBYTE SWC_HALIN_type_CM_uint8_enum 0 0 0.0 3.0 ECU_ADDRESS 0x0000 /* @ECU_Address@VHAL_IVIMLFootLiftCmd_enum@ */ /end MEASUREMENT
/begin MEASUREMENT VHAL_IVIMLReclinerCmd_enum "" UBYTE SWC_HALIN_type_CM_uint8_enum 0 0 0.0 3.0 ECU_ADDRESS 0x0000 /* @ECU_Address@VHAL_IVIMLReclinerCmd_enum@ */ /end MEASUREMENT
/begin MEASUREMENT VHAL_IVIMLSEATventCmd_enum "" UBYTE SWC_HALIN_type_CM_uint8_enum 0 0 0.0 7.0 ECU_ADDRESS 0x0000 /* @ECU_Address@VHAL_IVIMLSEATventCmd_enum@ */ /end MEASUREMENT
/begin MEASUREMENT VHAL_IVIMLSeatLiftCmd_enum "" UBYTE SWC_HALIN_type_CM_uint8_enum 0 0 0.0 3.0 ECU_ADDRESS 0x0000 /* @ECU_Address@VHAL_IVIMLSeatLiftCmd_enum@ */ /end MEASUREMENT
/begin MEASUREMENT VHAL_AmbLightColorSet_enum "" UBYTE SWC_HALIN_type_CM_uint8_enum 0 0 0.0 127.0 ECU_ADDRESS 0x0000 /* @ECU_Address@VHAL_AmbLightColorSet_enum@ */ /end MEASUREMENT
/begin MEASUREMENT VHAL_IVIMLSliderCmd_enum "" UBYTE SWC_HALIN_type_CM_uint8_enum 0 0 0.0 3.0 ECU_ADDRESS 0x0000 /* @ECU_Address@VHAL_IVIMLSliderCmd_enum@ */ /end MEASUREMENT
/begin MEASUREMENT VHAL_IVIMRFootLiftCmd_enum "" UBYTE SWC_HALIN_type_CM_uint8_enum 0 0 0.0 3.0 ECU_ADDRESS 0x0000 /* @ECU_Address@VHAL_IVIMRFootLiftCmd_enum@ */ /end MEASUREMENT
/begin MEASUREMENT VHAL_IVIMRReclinerCmd_enum "" UBYTE SWC_HALIN_type_CM_uint8_enum 0 0 0.0 3.0 ECU_ADDRESS 0x0000 /* @ECU_Address@VHAL_IVIMRReclinerCmd_enum@ */ /end MEASUREMENT
/begin MEASUREMENT VHAL_IVIMRSEATventCmd_enum "" UBYTE SWC_HALIN_type_CM_uint8_enum 0 0 0.0 7.0 ECU_ADDRESS 0x0000 /* @ECU_Address@VHAL_IVIMRSEATventCmd_enum@ */ /end MEASUREMENT
/begin MEASUREMENT VHAL_IVIMRSeatLiftCmd_enum "" UBYTE SWC_HALIN_type_CM_uint8_enum 0 0 0.0 3.0 ECU_ADDRESS 0x0000 /* @ECU_Address@VHAL_IVIMRSeatLiftCmd_enum@ */ /end MEASUREMENT
/begin MEASUREMENT VHAL_IVIMRSliderCmd_enum "" UBYTE SWC_HALIN_type_CM_uint8_enum 0 0 0.0 3.0 ECU_ADDRESS 0x0000 /* @ECU_Address@VHAL_IVIMRSliderCmd_enum@ */ /end MEASUREMENT
/begin MEASUREMENT VHAL_IVIRBlowerModeSta_enum "" UBYTE SWC_HALIN_type_CM_uint8_enum 0 0 0.0 3.0 ECU_ADDRESS 0x0000 /* @ECU_Address@VHAL_IVIRBlowerModeSta_enum@ */ /end MEASUREMENT
/begin MEASUREMENT VHAL_IVIRSEATventCmd_enum "" UBYTE SWC_HALIN_type_CM_uint8_enum 0 0 0.0 7.0 ECU_ADDRESS 0x0000 /* @ECU_Address@VHAL_IVIRSEATventCmd_enum@ */ /end MEASUREMENT
/begin MEASUREMENT VHAL_IVICreateAccReqSta_enum "" UBYTE SWC_HALIN_type_CM_uint8_enum 0 0 0.0 7.0 ECU_ADDRESS 0x0000 /* @ECU_Address@VHAL_IVICreateAccReqSta_enum@ */ /end MEASUREMENT
/begin MEASUREMENT VHAL_IVIDelAccReqSta_enum "" UBYTE SWC_HALIN_type_CM_uint8_enum 0 0 0.0 7.0 ECU_ADDRESS 0x0000 /* @ECU_Address@VHAL_IVIDelAccReqSta_enum@ */ /end MEASUREMENT
/begin MEASUREMENT VHAL_IVIEPSForceCmd_enum "" UBYTE SWC_HALIN_type_CM_uint8_enum 0 0 0.0 3.0 ECU_ADDRESS 0x0000 /* @ECU_Address@VHAL_IVIEPSForceCmd_enum@ */ /end MEASUREMENT
/begin MEASUREMENT VHAL_IVILinkAccSta_enum "" UBYTE SWC_HALIN_type_CM_uint8_enum 0 0 0.0 7.0 ECU_ADDRESS 0x0000 /* @ECU_Address@VHAL_IVILinkAccSta_enum@ */ /end MEASUREMENT
/begin MEASUREMENT VHAL_IVILinkKeySta_enum "" UBYTE SWC_HALIN_type_CM_uint8_enum 0 0 0.0 15.0 ECU_ADDRESS 0x0000 /* @ECU_Address@VHAL_IVILinkKeySta_enum@ */ /end MEASUREMENT
/begin MEASUREMENT VHAL_IVILocatedSTA_enum "" UBYTE SWC_HALIN_type_CM_uint8_enum 0 0 0.0 3.0 ECU_ADDRESS 0x0000 /* @ECU_Address@VHAL_IVILocatedSTA_enum@ */ /end MEASUREMENT
/begin MEASUREMENT VHAL_IVISWCVibModeSta_enum "" UBYTE SWC_HALIN_type_CM_uint8_enum 0 0 0.0 3.0 ECU_ADDRESS 0x0000 /* @ECU_Address@VHAL_IVISWCVibModeSta_enum@ */ /end MEASUREMENT
/begin MEASUREMENT VHAL_IVITimeCheck_enum "" UBYTE SWC_HALIN_type_CM_uint8_enum 0 0 0.0 255.0 ECU_ADDRESS 0x0000 /* @ECU_Address@VHAL_IVITimeCheck_enum@ */ /end MEASUREMENT
/begin MEASUREMENT VHAL_UserSet_enum "" UBYTE SWC_HALIN_type_CM_uint8_enum 0 0 0.0 7.0 ECU_ADDRESS 0x0000 /* @ECU_Address@VHAL_UserSet_enum@ */ /end MEASUREMENT
/begin MEASUREMENT VHAL_AVMParkingmode_enum "" UBYTE SWC_HALIN_type_CM_uint8_enum 0 0 0.0 15.0 ECU_ADDRESS 0x0000 /* @ECU_Address@VHAL_AVMParkingmode_enum@ */ /end MEASUREMENT
/begin MEASUREMENT VHAL_AVMparkingcancel_enum "" UBYTE SWC_HALIN_type_CM_uint8_enum 0 0 0.0 3.0 ECU_ADDRESS 0x0000 /* @ECU_Address@VHAL_AVMparkingcancel_enum@ */ /end MEASUREMENT
/begin MEASUREMENT VHAL_AVMparkingexcute_enum "" UBYTE SWC_HALIN_type_CM_uint8_enum 0 0 0.0 3.0 ECU_ADDRESS 0x0000 /* @ECU_Address@VHAL_AVMparkingexcute_enum@ */ /end MEASUREMENT
/begin MEASUREMENT VHAL_CAASSw_enum "" UBYTE SWC_HALIN_type_CM_uint8_enum 0 0 0.0 3.0 ECU_ADDRESS 0x0000 /* @ECU_Address@VHAL_CAASSw_enum@ */ /end MEASUREMENT
/begin MEASUREMENT VHAL_DSEATventreq_enum "" UBYTE SWC_HALIN_type_CM_uint8_enum 0 0 0.0 7.0 ECU_ADDRESS 0x0000 /* @ECU_Address@VHAL_DSEATventreq_enum@ */ /end MEASUREMENT
/begin MEASUREMENT VHAL_ESCSWCmd_enum "" UBYTE SWC_HALIN_type_CM_uint8_enum 0 0 0.0 3.0 ECU_ADDRESS 0x0000 /* @ECU_Address@VHAL_ESCSWCmd_enum@ */ /end MEASUREMENT
/begin MEASUREMENT VHAL_FSOffSw_enum "" UBYTE SWC_HALIN_type_CM_uint8_enum 0 0 0.0 3.0 ECU_ADDRESS 0x0000 /* @ECU_Address@VHAL_FSOffSw_enum@ */ /end MEASUREMENT
/begin MEASUREMENT VHAL_HeadLampSW_enum "" UBYTE SWC_HALIN_type_CM_uint8_enum 0 0 0.0 3.0 ECU_ADDRESS 0x0000 /* @ECU_Address@VHAL_HeadLampSW_enum@ */ /end MEASUREMENT
/begin MEASUREMENT VHAL_HoodLatchSW_enum "" UBYTE SWC_HALIN_type_CM_uint8_enum 0 0 0.0 3.0 ECU_ADDRESS 0x0000 /* @ECU_Address@VHAL_HoodLatchSW_enum@ */ /end MEASUREMENT
/begin MEASUREMENT VHAL_IVIAirIntZ3Cmd_enum "" UBYTE SWC_HALIN_type_CM_uint8_enum 0 0 0.0 7.0 ECU_ADDRESS 0x0000 /* @ECU_Address@VHAL_IVIAirIntZ3Cmd_enum@ */ /end MEASUREMENT
/begin MEASUREMENT VHAL_IVIDSEATHeaterCmd_enum "" UBYTE SWC_HALIN_type_CM_uint8_enum 0 0 0.0 7.0 ECU_ADDRESS 0x0000 /* @ECU_Address@VHAL_IVIDSEATHeaterCmd_enum@ */ /end MEASUREMENT
/begin MEASUREMENT VHAL_IVIDSEATFroEdgeHeightCmd_enum "" UBYTE SWC_HALIN_type_CM_uint8_enum 0 0 0.0 3.0 ECU_ADDRESS 0x0000 /* @ECU_Address@VHAL_IVIDSEATFroEdgeHeightCmd_enum@ */ /end MEASUREMENT
/begin MEASUREMENT VHAL_IVIDSEATHeightCmd_enum "" UBYTE SWC_HALIN_type_CM_uint8_enum 0 0 0.0 3.0 ECU_ADDRESS 0x0000 /* @ECU_Address@VHAL_IVIDSEATHeightCmd_enum@ */ /end MEASUREMENT
/begin MEASUREMENT VHAL_IVIDSEATReclineCmd_enum "" UBYTE SWC_HALIN_type_CM_uint8_enum 0 0 0.0 3.0 ECU_ADDRESS 0x0000 /* @ECU_Address@VHAL_IVIDSEATReclineCmd_enum@ */ /end MEASUREMENT
/begin MEASUREMENT VHAL_IVIDSEATSlideCmd_enum "" UBYTE SWC_HALIN_type_CM_uint8_enum 0 0 0.0 3.0 ECU_ADDRESS 0x0000 /* @ECU_Address@VHAL_IVIDSEATSlideCmd_enum@ */ /end MEASUREMENT
/begin MEASUREMENT VHAL_IVIFGSAirIntCmd_enum "" UBYTE SWC_HALIN_type_CM_uint8_enum 0 0 0.0 7.0 ECU_ADDRESS 0x0000 /* @ECU_Address@VHAL_IVIFGSAirIntCmd_enum@ */ /end MEASUREMENT
/begin MEASUREMENT VHAL_IVIFGSChCmd_enum "" UBYTE SWC_HALIN_type_CM_uint8_enum 0 0 0.0 3.0 ECU_ADDRESS 0x0000 /* @ECU_Address@VHAL_IVIFGSChCmd_enum@ */ /end MEASUREMENT
/begin MEASUREMENT VHAL_IVIISAOffsetSpd_enum "" UBYTE SWC_HALIN_type_CM_uint8_enum 0 0 0.0 14.0 ECU_ADDRESS 0x0000 /* @ECU_Address@VHAL_IVIISAOffsetSpd_enum@ */ /end MEASUREMENT
/begin MEASUREMENT VHAL_IVIPSEATHeaterCmd_enum "" UBYTE SWC_HALIN_type_CM_uint8_enum 0 0 0.0 7.0 ECU_ADDRESS 0x0000 /* @ECU_Address@VHAL_IVIPSEATHeaterCmd_enum@ */ /end MEASUREMENT
/begin MEASUREMENT VHAL_IVIPSEATReclineCmd_enum "" UBYTE SWC_HALIN_type_CM_uint8_enum 0 0 0.0 3.0 ECU_ADDRESS 0x0000 /* @ECU_Address@VHAL_IVIPSEATReclineCmd_enum@ */ /end MEASUREMENT
/begin MEASUREMENT VHAL_IVIPSEATSlideCmd_enum "" UBYTE SWC_HALIN_type_CM_uint8_enum 0 0 0.0 3.0 ECU_ADDRESS 0x0000 /* @ECU_Address@VHAL_IVIPSEATSlideCmd_enum@ */ /end MEASUREMENT
/begin MEASUREMENT VHAL_IVIPTGModeSW_enum "" UBYTE SWC_HALIN_type_CM_uint8_enum 0 0 0.0 3.0 ECU_ADDRESS 0x0000 /* @ECU_Address@VHAL_IVIPTGModeSW_enum@ */ /end MEASUREMENT
/begin MEASUREMENT VHAL_IVIPTGOpenHeight_enum "" UBYTE SWC_HALIN_type_CM_uint8_enum 0 0 0.0 7.0 ECU_ADDRESS 0x0000 /* @ECU_Address@VHAL_IVIPTGOpenHeight_enum@ */ /end MEASUREMENT
/begin MEASUREMENT VHAL_IVIPTGStaSW_enum "" UBYTE SWC_HALIN_type_CM_uint8_enum 0 0 0.0 3.0 ECU_ADDRESS 0x0000 /* @ECU_Address@VHAL_IVIPTGStaSW_enum@ */ /end MEASUREMENT
/begin MEASUREMENT VHAL_EBMRLampSta_enum "" UBYTE SWC_HALIN_type_CM_uint8_enum 0 0 0.0 2.0 ECU_ADDRESS 0x0000 /* @ECU_Address@VHAL_EBMRLampSta_enum@ */ /end MEASUREMENT
/begin MEASUREMENT VHAL_FrEDURotateDirction_enum "" UBYTE SWC_HALIN_type_CM_uint8_enum 0 0 0.0 2.0 ECU_ADDRESS 0x0000 /* @ECU_Address@VHAL_FrEDURotateDirction_enum@ */ /end MEASUREMENT
/begin MEASUREMENT VHAL_FrMCU1Chksum_enum "" UBYTE SWC_HALIN_type_CM_uint8_enum 0 0 0.0 255.0 ECU_ADDRESS 0x0000 /* @ECU_Address@VHAL_FrMCU1Chksum_enum@ */ /end MEASUREMENT
/begin MEASUREMENT VHAL_FrMCU1RolCnt_enum "" UBYTE SWC_HALIN_type_CM_uint8_enum 0 0 0.0 14.0 ECU_ADDRESS 0x0000 /* @ECU_Address@VHAL_FrMCU1RolCnt_enum@ */ /end MEASUREMENT
/begin MEASUREMENT VHAL_FrMCUErr_enum "" UBYTE SWC_HALIN_type_CM_uint8_enum 0 0 0.0 255.0 ECU_ADDRESS 0x0000 /* @ECU_Address@VHAL_FrMCUErr_enum@ */ /end MEASUREMENT
/begin MEASUREMENT VHAL_FrMCUSysSta_enum "" UBYTE SWC_HALIN_type_CM_uint8_enum 0 0 0.0 15.0 ECU_ADDRESS 0x0000 /* @ECU_Address@VHAL_FrMCUSysSta_enum@ */ /end MEASUREMENT
/begin MEASUREMENT VHAL_MCUWarnF_enum "" UBYTE SWC_HALIN_type_CM_uint8_enum 0 0 0.0 7.0 ECU_ADDRESS 0x0000 /* @ECU_Address@VHAL_MCUWarnF_enum@ */ /end MEASUREMENT
/begin MEASUREMENT VHAL_FrFailcode1_enum "" UBYTE SWC_HALIN_type_CM_uint8_enum 0 0 0.0 255.0 ECU_ADDRESS 0x0000 /* @ECU_Address@VHAL_FrFailcode1_enum@ */ /end MEASUREMENT
/begin MEASUREMENT VHAL_FrFailcode2_enum "" UBYTE SWC_HALIN_type_CM_uint8_enum 0 0 0.0 255.0 ECU_ADDRESS 0x0000 /* @ECU_Address@VHAL_FrFailcode2_enum@ */ /end MEASUREMENT
/begin MEASUREMENT VHAL_FrFailcodehistory1_enum "" UBYTE SWC_HALIN_type_CM_uint8_enum 0 0 0.0 2.0 ECU_ADDRESS 0x0000 /* @ECU_Address@VHAL_FrFailcodehistory1_enum@ */ /end MEASUREMENT
/begin MEASUREMENT VHAL_FrFailcodehistory2_enum "" UBYTE SWC_HALIN_type_CM_uint8_enum 0 0 0.0 2.0 ECU_ADDRESS 0x0000 /* @ECU_Address@VHAL_FrFailcodehistory2_enum@ */ /end MEASUREMENT
/begin MEASUREMENT VHAL_FrMCUTempWarn_enum "" UBYTE SWC_HALIN_type_CM_uint8_enum 0 0 0.0 3.0 ECU_ADDRESS 0x0000 /* @ECU_Address@VHAL_FrMCUTempWarn_enum@ */ /end MEASUREMENT
/begin MEASUREMENT VHAL_FrTMTempWarn_enum "" UBYTE SWC_HALIN_type_CM_uint8_enum 0 0 0.0 3.0 ECU_ADDRESS 0x0000 /* @ECU_Address@VHAL_FrTMTempWarn_enum@ */ /end MEASUREMENT
/begin MEASUREMENT VHAL_MCUBFLLCTempWarnSta_enum "" UBYTE SWC_HALIN_type_CM_uint8_enum 0 0 0.0 3.0 ECU_ADDRESS 0x0000 /* @ECU_Address@VHAL_MCUBFLLCTempWarnSta_enum@ */ /end MEASUREMENT
/begin MEASUREMENT VHAL_MCUWarnR_enum "" UBYTE SWC_HALIN_type_CM_uint8_enum 0 0 0.0 7.0 ECU_ADDRESS 0x0000 /* @ECU_Address@VHAL_MCUWarnR_enum@ */ /end MEASUREMENT
/begin MEASUREMENT VHAL_RrEDURotateDirction_enum "" UBYTE SWC_HALIN_type_CM_uint8_enum 0 0 0.0 2.0 ECU_ADDRESS 0x0000 /* @ECU_Address@VHAL_RrEDURotateDirction_enum@ */ /end MEASUREMENT
/begin MEASUREMENT VHAL_RrMCU1Chksum_enum "" UBYTE SWC_HALIN_type_CM_uint8_enum 0 0 0.0 255.0 ECU_ADDRESS 0x0000 /* @ECU_Address@VHAL_RrMCU1Chksum_enum@ */ /end MEASUREMENT
/begin MEASUREMENT VHAL_RrMCU1RolCnt_enum "" UBYTE SWC_HALIN_type_CM_uint8_enum 0 0 0.0 14.0 ECU_ADDRESS 0x0000 /* @ECU_Address@VHAL_RrMCU1RolCnt_enum@ */ /end MEASUREMENT
/begin MEASUREMENT VHAL_RrMCUErr_enum "" UBYTE SWC_HALIN_type_CM_uint8_enum 0 0 0.0 255.0 ECU_ADDRESS 0x0000 /* @ECU_Address@VHAL_RrMCUErr_enum@ */ /end MEASUREMENT
/begin MEASUREMENT VHAL_RrMCUSysSta_enum "" UBYTE SWC_HALIN_type_CM_uint8_enum 0 0 0.0 15.0 ECU_ADDRESS 0x0000 /* @ECU_Address@VHAL_RrMCUSysSta_enum@ */ /end MEASUREMENT
/begin MEASUREMENT VHAL_MCUBRLLCTempWarnSta_enum "" UBYTE SWC_HALIN_type_CM_uint8_enum 0 0 0.0 3.0 ECU_ADDRESS 0x0000 /* @ECU_Address@VHAL_MCUBRLLCTempWarnSta_enum@ */ /end MEASUREMENT
/begin MEASUREMENT VHAL_RrFailcode1_enum "" UBYTE SWC_HALIN_type_CM_uint8_enum 0 0 0.0 255.0 ECU_ADDRESS 0x0000 /* @ECU_Address@VHAL_RrFailcode1_enum@ */ /end MEASUREMENT
/begin MEASUREMENT VHAL_RrFailcode2_enum "" UBYTE SWC_HALIN_type_CM_uint8_enum 0 0 0.0 255.0 ECU_ADDRESS 0x0000 /* @ECU_Address@VHAL_RrFailcode2_enum@ */ /end MEASUREMENT
/begin MEASUREMENT VHAL_RrFailcodehistory1_enum "" UBYTE SWC_HALIN_type_CM_uint8_enum 0 0 0.0 2.0 ECU_ADDRESS 0x0000 /* @ECU_Address@VHAL_RrFailcodehistory1_enum@ */ /end MEASUREMENT
/begin MEASUREMENT VHAL_RrFailcodehistory2_enum "" UBYTE SWC_HALIN_type_CM_uint8_enum 0 0 0.0 2.0 ECU_ADDRESS 0x0000 /* @ECU_Address@VHAL_RrFailcodehistory2_enum@ */ /end MEASUREMENT
/begin MEASUREMENT VHAL_RrMCUTempWarn_enum "" UBYTE SWC_HALIN_type_CM_uint8_enum 0 0 0.0 3.0 ECU_ADDRESS 0x0000 /* @ECU_Address@VHAL_RrMCUTempWarn_enum@ */ /end MEASUREMENT
/begin MEASUREMENT VHAL_RrTMTempWarn_enum "" UBYTE SWC_HALIN_type_CM_uint8_enum 0 0 0.0 3.0 ECU_ADDRESS 0x0000 /* @ECU_Address@VHAL_RrTMTempWarn_enum@ */ /end MEASUREMENT
/begin MEASUREMENT VHAL_FrEDURotateDirctionNidec_enum "" UBYTE SWC_HALIN_type_CM_uint8_enum 0 0 0.0 2.0 ECU_ADDRESS 0x0000 /* @ECU_Address@VHAL_FrEDURotateDirctionNidec_enum@ */ /end MEASUREMENT
/begin MEASUREMENT VHAL_FrMCU1ChksumNidec_enum "" UBYTE SWC_HALIN_type_CM_uint8_enum 0 0 0.0 255.0 ECU_ADDRESS 0x0000 /* @ECU_Address@VHAL_FrMCU1ChksumNidec_enum@ */ /end MEASUREMENT
/begin MEASUREMENT VHAL_FrMCU1RolCntNidec_enum "" UBYTE SWC_HALIN_type_CM_uint8_enum 0 0 0.0 15.0 ECU_ADDRESS 0x0000 /* @ECU_Address@VHAL_FrMCU1RolCntNidec_enum@ */ /end MEASUREMENT
/begin MEASUREMENT VHAL_FrMCUErrNidec_enum "" UBYTE SWC_HALIN_type_CM_uint8_enum 0 0 0.0 255.0 ECU_ADDRESS 0x0000 /* @ECU_Address@VHAL_FrMCUErrNidec_enum@ */ /end MEASUREMENT
/begin MEASUREMENT VHAL_BMSChckSum1_enum "" UBYTE SWC_HALIN_type_CM_uint8_enum 0 0 0.0 255.0 ECU_ADDRESS 0x0000 /* @ECU_Address@VHAL_BMSChckSum1_enum@ */ /end MEASUREMENT
/begin MEASUREMENT VHAL_FrMCUSysStaNidec_enum "" UBYTE SWC_HALIN_type_CM_uint8_enum 0 0 0.0 15.0 ECU_ADDRESS 0x0000 /* @ECU_Address@VHAL_FrMCUSysStaNidec_enum@ */ /end MEASUREMENT
/begin MEASUREMENT VHAL_MCUWarnFNidec_enum "" UBYTE SWC_HALIN_type_CM_uint8_enum 0 0 0.0 7.0 ECU_ADDRESS 0x0000 /* @ECU_Address@VHAL_MCUWarnFNidec_enum@ */ /end MEASUREMENT
/begin MEASUREMENT VHAL_FrFailcode1Nidec_enum "" UBYTE SWC_HALIN_type_CM_uint8_enum 0 0 0.0 255.0 ECU_ADDRESS 0x0000 /* @ECU_Address@VHAL_FrFailcode1Nidec_enum@ */ /end MEASUREMENT
/begin MEASUREMENT VHAL_FrFailcode2Nidec_enum "" UBYTE SWC_HALIN_type_CM_uint8_enum 0 0 0.0 255.0 ECU_ADDRESS 0x0000 /* @ECU_Address@VHAL_FrFailcode2Nidec_enum@ */ /end MEASUREMENT
/begin MEASUREMENT VHAL_FrFailcodehistory1Nidec_enum "" UBYTE SWC_HALIN_type_CM_uint8_enum 0 0 0.0 2.0 ECU_ADDRESS 0x0000 /* @ECU_Address@VHAL_FrFailcodehistory1Nidec_enum@ */ /end MEASUREMENT
/begin MEASUREMENT VHAL_FrFailcodehistory2Nidec_enum "" UBYTE SWC_HALIN_type_CM_uint8_enum 0 0 0.0 2.0 ECU_ADDRESS 0x0000 /* @ECU_Address@VHAL_FrFailcodehistory2Nidec_enum@ */ /end MEASUREMENT
/begin MEASUREMENT VHAL_FrMCUTempWarnNidec_enum "" UBYTE SWC_HALIN_type_CM_uint8_enum 0 0 0.0 3.0 ECU_ADDRESS 0x0000 /* @ECU_Address@VHAL_FrMCUTempWarnNidec_enum@ */ /end MEASUREMENT
/begin MEASUREMENT VHAL_FrTMTempWarnNidec_enum "" UBYTE SWC_HALIN_type_CM_uint8_enum 0 0 0.0 3.0 ECU_ADDRESS 0x0000 /* @ECU_Address@VHAL_FrTMTempWarnNidec_enum@ */ /end MEASUREMENT
/begin MEASUREMENT VHAL_MCUWarnRNidec_enum "" UBYTE SWC_HALIN_type_CM_uint8_enum 0 0 0.0 7.0 ECU_ADDRESS 0x0000 /* @ECU_Address@VHAL_MCUWarnRNidec_enum@ */ /end MEASUREMENT
/begin MEASUREMENT VHAL_RrEDURotateDirctionNidec_enum "" UBYTE SWC_HALIN_type_CM_uint8_enum 0 0 0.0 2.0 ECU_ADDRESS 0x0000 /* @ECU_Address@VHAL_RrEDURotateDirctionNidec_enum@ */ /end MEASUREMENT
/begin MEASUREMENT VHAL_RrMCU1ChksumNidec_enum "" UBYTE SWC_HALIN_type_CM_uint8_enum 0 0 0.0 255.0 ECU_ADDRESS 0x0000 /* @ECU_Address@VHAL_RrMCU1ChksumNidec_enum@ */ /end MEASUREMENT
/begin MEASUREMENT VHAL_RrMCU1RolCntNidec_enum "" UBYTE SWC_HALIN_type_CM_uint8_enum 0 0 0.0 15.0 ECU_ADDRESS 0x0000 /* @ECU_Address@VHAL_RrMCU1RolCntNidec_enum@ */ /end MEASUREMENT
/begin MEASUREMENT VHAL_RrMCUErrNidec_enum "" UBYTE SWC_HALIN_type_CM_uint8_enum 0 0 0.0 255.0 ECU_ADDRESS 0x0000 /* @ECU_Address@VHAL_RrMCUErrNidec_enum@ */ /end MEASUREMENT
/begin MEASUREMENT VHAL_RrMCUSysStaNidec_enum "" UBYTE SWC_HALIN_type_CM_uint8_enum 0 0 0.0 15.0 ECU_ADDRESS 0x0000 /* @ECU_Address@VHAL_RrMCUSysStaNidec_enum@ */ /end MEASUREMENT
/begin MEASUREMENT VHAL_RrFailcode1Nidec_enum "" UBYTE SWC_HALIN_type_CM_uint8_enum 0 0 0.0 255.0 ECU_ADDRESS 0x0000 /* @ECU_Address@VHAL_RrFailcode1Nidec_enum@ */ /end MEASUREMENT
/begin MEASUREMENT VHAL_RrFailcode2Nidec_enum "" UBYTE SWC_HALIN_type_CM_uint8_enum 0 0 0.0 255.0 ECU_ADDRESS 0x0000 /* @ECU_Address@VHAL_RrFailcode2Nidec_enum@ */ /end MEASUREMENT
/begin MEASUREMENT VHAL_RrFailcodehistory1Nidec_enum "" UBYTE SWC_HALIN_type_CM_uint8_enum 0 0 0.0 2.0 ECU_ADDRESS 0x0000 /* @ECU_Address@VHAL_RrFailcodehistory1Nidec_enum@ */ /end MEASUREMENT
/begin MEASUREMENT VHAL_RrFailcodehistory2Nidec_enum "" UBYTE SWC_HALIN_type_CM_uint8_enum 0 0 0.0 2.0 ECU_ADDRESS 0x0000 /* @ECU_Address@VHAL_RrFailcodehistory2Nidec_enum@ */ /end MEASUREMENT
/begin MEASUREMENT VHAL_RrMCUTempWarnNidec_enum "" UBYTE SWC_HALIN_type_CM_uint8_enum 0 0 0.0 3.0 ECU_ADDRESS 0x0000 /* @ECU_Address@VHAL_RrMCUTempWarnNidec_enum@ */ /end MEASUREMENT
/begin MEASUREMENT VHAL_RrTMTempWarnNidec_enum "" UBYTE SWC_HALIN_type_CM_uint8_enum 0 0 0.0 3.0 ECU_ADDRESS 0x0000 /* @ECU_Address@VHAL_RrTMTempWarnNidec_enum@ */ /end MEASUREMENT
/begin MEASUREMENT VHAL_ShifterCRC8_enum "" UBYTE SWC_HALIN_type_CM_uint8_enum 0 0 0.0 255.0 ECU_ADDRESS 0x0000 /* @ECU_Address@VHAL_ShifterCRC8_enum@ */ /end MEASUREMENT
/begin MEASUREMENT VHAL_ShifterFailsta_enum "" UBYTE SWC_HALIN_type_CM_uint8_enum 0 0 0.0 7.0 ECU_ADDRESS 0x0000 /* @ECU_Address@VHAL_ShifterFailsta_enum@ */ /end MEASUREMENT
/begin MEASUREMENT VHAL_ShifterHandleCmd_enum "" UBYTE SWC_HALIN_type_CM_uint8_enum 0 0 0.0 255.0 ECU_ADDRESS 0x0000 /* @ECU_Address@VHAL_ShifterHandleCmd_enum@ */ /end MEASUREMENT
/begin MEASUREMENT VHAL_ShifterRC_enum "" UBYTE SWC_HALIN_type_CM_uint8_enum 0 0 0.0 14.0 ECU_ADDRESS 0x0000 /* @ECU_Address@VHAL_ShifterRC_enum@ */ /end MEASUREMENT
/begin MEASUREMENT VHAL_CSW2FWasSwSta_enum "" UBYTE SWC_HALIN_type_CM_uint8_enum 0 0 0.0 3.0 ECU_ADDRESS 0x0000 /* @ECU_Address@VHAL_CSW2FWasSwSta_enum@ */ /end MEASUREMENT
/begin MEASUREMENT VHAL_CSW2FWipSwSta_enum "" UBYTE SWC_HALIN_type_CM_uint8_enum 0 0 0.0 7.0 ECU_ADDRESS 0x0000 /* @ECU_Address@VHAL_CSW2FWipSwSta_enum@ */ /end MEASUREMENT
/begin MEASUREMENT VHAL_CSW2RWipWasSwSta_enum "" UBYTE SWC_HALIN_type_CM_uint8_enum 0 0 0.0 3.0 ECU_ADDRESS 0x0000 /* @ECU_Address@VHAL_CSW2RWipWasSwSta_enum@ */ /end MEASUREMENT
/begin MEASUREMENT VHAL_CSW2TurnSwSta_enum "" UBYTE SWC_HALIN_type_CM_uint8_enum 0 0 0.0 5.0 ECU_ADDRESS 0x0000 /* @ECU_Address@VHAL_CSW2TurnSwSta_enum@ */ /end MEASUREMENT
/begin MEASUREMENT VHAL_BMSRolCnct1_enum "" UBYTE SWC_HALIN_type_CM_uint8_enum 0 0 0.0 14.0 ECU_ADDRESS 0x0000 /* @ECU_Address@VHAL_BMSRolCnct1_enum@ */ /end MEASUREMENT
/begin MEASUREMENT VHAL_MaxCellTempNum_enum "" UBYTE SWC_HALIN_type_CM_uint8_enum 0 0 0.0 253.0 ECU_ADDRESS 0x0000 /* @ECU_Address@VHAL_MaxCellTempNum_enum@ */ /end MEASUREMENT
/begin MEASUREMENT VHAL_MaxCellVoltNum_enum "" UBYTE SWC_HALIN_type_CM_uint8_enum 0 0 0.0 253.0 ECU_ADDRESS 0x0000 /* @ECU_Address@VHAL_MaxCellVoltNum_enum@ */ /end MEASUREMENT
/begin MEASUREMENT VHAL_MinCellTempNum_enum "" UBYTE SWC_HALIN_type_CM_uint8_enum 0 0 0.0 253.0 ECU_ADDRESS 0x0000 /* @ECU_Address@VHAL_MinCellTempNum_enum@ */ /end MEASUREMENT
/begin MEASUREMENT VHAL_MinCellVoltNum_enum "" UBYTE SWC_HALIN_type_CM_uint8_enum 0 0 0.0 253.0 ECU_ADDRESS 0x0000 /* @ECU_Address@VHAL_MinCellVoltNum_enum@ */ /end MEASUREMENT
/begin MEASUREMENT VHAL_BMSChckSum_enum "" UBYTE SWC_HALIN_type_CM_uint8_enum 0 0 0.0 255.0 ECU_ADDRESS 0x0000 /* @ECU_Address@VHAL_BMSChckSum_enum@ */ /end MEASUREMENT
/begin MEASUREMENT VHAL_BMSRolCnct_enum "" UBYTE SWC_HALIN_type_CM_uint8_enum 0 0 0.0 14.0 ECU_ADDRESS 0x0000 /* @ECU_Address@VHAL_BMSRolCnct_enum@ */ /end MEASUREMENT
/begin MEASUREMENT VHAL_ChrgInLockReq_enum "" UBYTE SWC_HALIN_type_CM_uint8_enum 0 0 0.0 2.0 ECU_ADDRESS 0x0000 /* @ECU_Address@VHAL_ChrgInLockReq_enum@ */ /end MEASUREMENT
/begin MEASUREMENT VHAL_ChrgPlugSta_enum "" UBYTE SWC_HALIN_type_CM_uint8_enum 0 0 0.0 3.0 ECU_ADDRESS 0x0000 /* @ECU_Address@VHAL_ChrgPlugSta_enum@ */ /end MEASUREMENT
/begin MEASUREMENT VHAL_DisChrgPlugErr_enum "" UBYTE SWC_HALIN_type_CM_uint8_enum 0 0 0.0 3.0 ECU_ADDRESS 0x0000 /* @ECU_Address@VHAL_DisChrgPlugErr_enum@ */ /end MEASUREMENT
/begin MEASUREMENT VHAL_ExtChrgSta_enum "" UBYTE SWC_HALIN_type_CM_uint8_enum 0 0 0.0 3.0 ECU_ADDRESS 0x0000 /* @ECU_Address@VHAL_ExtChrgSta_enum@ */ /end MEASUREMENT
/begin MEASUREMENT VHAL_HVBChrgErr_enum "" UBYTE SWC_HALIN_type_CM_uint8_enum 0 0 0.0 255.0 ECU_ADDRESS 0x0000 /* @ECU_Address@VHAL_HVBChrgErr_enum@ */ /end MEASUREMENT
/begin MEASUREMENT VHAL_HVBOvrTempWarn_enum "" UBYTE SWC_HALIN_type_CM_uint8_enum 0 0 0.0 2.0 ECU_ADDRESS 0x0000 /* @ECU_Address@VHAL_HVBOvrTempWarn_enum@ */ /end MEASUREMENT
/begin MEASUREMENT VHAL_HVBPreheatPrecoolSta_enum "" UBYTE SWC_HALIN_type_CM_uint8_enum 0 0 0.0 2.0 ECU_ADDRESS 0x0000 /* @ECU_Address@VHAL_HVBPreheatPrecoolSta_enum@ */ /end MEASUREMENT
/begin MEASUREMENT VHAL_HVBattReady4Pre_enum "" UBYTE SWC_HALIN_type_CM_uint8_enum 0 0 0.0 2.0 ECU_ADDRESS 0x0000 /* @ECU_Address@VHAL_HVBattReady4Pre_enum@ */ /end MEASUREMENT
/begin MEASUREMENT VHAL_V2LSta_enum "" UBYTE SWC_HALIN_type_CM_uint8_enum 0 0 0.0 3.0 ECU_ADDRESS 0x0000 /* @ECU_Address@VHAL_V2LSta_enum@ */ /end MEASUREMENT
/begin MEASUREMENT VHAL_MainRlyNegSta_enum "" UBYTE SWC_HALIN_type_CM_uint8_enum 0 0 0.0 255.0 ECU_ADDRESS 0x0000 /* @ECU_Address@VHAL_MainRlyNegSta_enum@ */ /end MEASUREMENT
/begin MEASUREMENT VHAL_MainRlyPosSta_enum "" UBYTE SWC_HALIN_type_CM_uint8_enum 0 0 0.0 255.0 ECU_ADDRESS 0x0000 /* @ECU_Address@VHAL_MainRlyPosSta_enum@ */ /end MEASUREMENT
/begin MEASUREMENT VHAL_CSCCU1_enum "" UBYTE SWC_HALIN_type_CM_uint8_enum 0 0 0.0 255.0 ECU_ADDRESS 0x0000 /* @ECU_Address@VHAL_CSCCU1_enum@ */ /end MEASUREMENT
/begin MEASUREMENT VHAL_DCDCPreCompleted_enum "" UBYTE SWC_HALIN_type_CM_uint8_enum 0 0 0.0 2.0 ECU_ADDRESS 0x0000 /* @ECU_Address@VHAL_DCDCPreCompleted_enum@ */ /end MEASUREMENT
/begin MEASUREMENT VHAL_OBCPreCompleted_enum "" UBYTE SWC_HALIN_type_CM_uint8_enum 0 0 0.0 2.0 ECU_ADDRESS 0x0000 /* @ECU_Address@VHAL_OBCPreCompleted_enum@ */ /end MEASUREMENT
/begin MEASUREMENT VHAL_RCCCU1_enum "" UBYTE SWC_HALIN_type_CM_uint8_enum 0 0 0.0 14.0 ECU_ADDRESS 0x0000 /* @ECU_Address@VHAL_RCCCU1_enum@ */ /end MEASUREMENT
/begin MEASUREMENT VHAL_CSCCU2_enum "" UBYTE SWC_HALIN_type_CM_uint8_enum 0 0 0.0 255.0 ECU_ADDRESS 0x0000 /* @ECU_Address@VHAL_CSCCU2_enum@ */ /end MEASUREMENT
/begin MEASUREMENT VHAL_DCDCFaultSta_enum "" UBYTE SWC_HALIN_type_CM_uint8_enum 0 0 0.0 3.0 ECU_ADDRESS 0x0000 /* @ECU_Address@VHAL_DCDCFaultSta_enum@ */ /end MEASUREMENT
/begin MEASUREMENT VHAL_OBCFaultSta_enum "" UBYTE SWC_HALIN_type_CM_uint8_enum 0 0 0.0 3.0 ECU_ADDRESS 0x0000 /* @ECU_Address@VHAL_OBCFaultSta_enum@ */ /end MEASUREMENT
/begin MEASUREMENT VHAL_OBCV2LSta_enum "" UBYTE SWC_HALIN_type_CM_uint8_enum 0 0 0.0 2.0 ECU_ADDRESS 0x0000 /* @ECU_Address@VHAL_OBCV2LSta_enum@ */ /end MEASUREMENT
/begin MEASUREMENT VHAL_OBCACCurLim_enum "" UBYTE SWC_HALIN_type_CM_uint8_enum 0 0 0.0 3.0 ECU_ADDRESS 0x0000 /* @ECU_Address@VHAL_OBCACCurLim_enum@ */ /end MEASUREMENT
/begin MEASUREMENT VHAL_RCCCU2_enum "" UBYTE SWC_HALIN_type_CM_uint8_enum 0 0 0.0 14.0 ECU_ADDRESS 0x0000 /* @ECU_Address@VHAL_RCCCU2_enum@ */ /end MEASUREMENT
/begin MEASUREMENT VHAL_EBMErrSta_enum "" UBYTE SWC_HALIN_type_CM_uint8_enum 0 0 0.0 2.0 ECU_ADDRESS 0x0000 /* @ECU_Address@VHAL_EBMErrSta_enum@ */ /end MEASUREMENT
/begin MEASUREMENT VHAL_BPPSEATModeSta_enum "" UBYTE SWC_HALIN_type_CM_uint8_enum 0 0 0.0 7.0 ECU_ADDRESS 0x0000 /* @ECU_Address@VHAL_BPPSEATModeSta_enum@ */ /end MEASUREMENT
/begin MEASUREMENT VHAL_BPPSEATVentSta_enum "" UBYTE SWC_HALIN_type_CM_uint8_enum 0 0 0.0 4.0 ECU_ADDRESS 0x0000 /* @ECU_Address@VHAL_BPPSEATVentSta_enum@ */ /end MEASUREMENT
/begin MEASUREMENT VHAL_BPPSEATheaterSta_enum "" UBYTE SWC_HALIN_type_CM_uint8_enum 0 0 0.0 4.0 ECU_ADDRESS 0x0000 /* @ECU_Address@VHAL_BPPSEATheaterSta_enum@ */ /end MEASUREMENT
/begin MEASUREMENT VHAL_BPPTGActiveSta_enum "" UBYTE SWC_HALIN_type_CM_uint8_enum 0 0 0.0 7.0 ECU_ADDRESS 0x0000 /* @ECU_Address@VHAL_BPPTGActiveSta_enum@ */ /end MEASUREMENT
/begin MEASUREMENT VHAL_BPPTGInsideSW1Sta_enum "" UBYTE SWC_HALIN_type_CM_uint8_enum 0 0 0.0 3.0 ECU_ADDRESS 0x0000 /* @ECU_Address@VHAL_BPPTGInsideSW1Sta_enum@ */ /end MEASUREMENT
/begin MEASUREMENT VHAL_BPPTGInsideSW2Sta_enum "" UBYTE SWC_HALIN_type_CM_uint8_enum 0 0 0.0 3.0 ECU_ADDRESS 0x0000 /* @ECU_Address@VHAL_BPPTGInsideSW2Sta_enum@ */ /end MEASUREMENT
/begin MEASUREMENT VHAL_BPPTGRDILCmd_enum "" UBYTE SWC_HALIN_type_CM_uint8_enum 0 0 0.0 3.0 ECU_ADDRESS 0x0000 /* @ECU_Address@VHAL_BPPTGRDILCmd_enum@ */ /end MEASUREMENT
/begin MEASUREMENT VHAL_BPPTGSysSta_enum "" UBYTE SWC_HALIN_type_CM_uint8_enum 0 0 0.0 3.0 ECU_ADDRESS 0x0000 /* @ECU_Address@VHAL_BPPTGSysSta_enum@ */ /end MEASUREMENT
/begin MEASUREMENT VHAL_BPSEATLVentSta_enum "" UBYTE SWC_HALIN_type_CM_uint8_enum 0 0 0.0 7.0 ECU_ADDRESS 0x0000 /* @ECU_Address@VHAL_BPSEATLVentSta_enum@ */ /end MEASUREMENT
/begin MEASUREMENT VHAL_BPSEATMLVentSta_enum "" UBYTE SWC_HALIN_type_CM_uint8_enum 0 0 0.0 7.0 ECU_ADDRESS 0x0000 /* @ECU_Address@VHAL_BPSEATMLVentSta_enum@ */ /end MEASUREMENT
/begin MEASUREMENT VHAL_BDDSEATMemSetSta_enum "" UBYTE SWC_HALIN_type_CM_uint8_enum 0 0 0.0 3.0 ECU_ADDRESS 0x0000 /* @ECU_Address@VHAL_BDDSEATMemSetSta_enum@ */ /end MEASUREMENT
/begin MEASUREMENT VHAL_BPSEATMRVentSta_enum "" UBYTE SWC_HALIN_type_CM_uint8_enum 0 0 0.0 7.0 ECU_ADDRESS 0x0000 /* @ECU_Address@VHAL_BPSEATMRVentSta_enum@ */ /end MEASUREMENT
/begin MEASUREMENT VHAL_BPSEATRVentSta_enum "" UBYTE SWC_HALIN_type_CM_uint8_enum 0 0 0.0 7.0 ECU_ADDRESS 0x0000 /* @ECU_Address@VHAL_BPSEATRVentSta_enum@ */ /end MEASUREMENT
/begin MEASUREMENT VHAL_DKCKeyNumSta_enum "" UBYTE SWC_HALIN_type_CM_uint8_enum 0 0 0.0 15.0 ECU_ADDRESS 0x0000 /* @ECU_Address@VHAL_DKCKeyNumSta_enum@ */ /end MEASUREMENT
/begin MEASUREMENT VHAL_DKCKeyTypeSta_enum "" UBYTE SWC_HALIN_type_CM_uint8_enum 0 0 0.0 3.0 ECU_ADDRESS 0x0000 /* @ECU_Address@VHAL_DKCKeyTypeSta_enum@ */ /end MEASUREMENT
/begin MEASUREMENT VHAL_DKCPDkeyAreaRAPSSta_enum "" UBYTE SWC_HALIN_type_CM_uint8_enum 0 0 0.0 3.0 ECU_ADDRESS 0x0000 /* @ECU_Address@VHAL_DKCPDkeyAreaRAPSSta_enum@ */ /end MEASUREMENT
/begin MEASUREMENT VHAL_DKCParkingModeCmd_enum "" UBYTE SWC_HALIN_type_CM_uint8_enum 0 0 0.0 4.0 ECU_ADDRESS 0x0000 /* @ECU_Address@VHAL_DKCParkingModeCmd_enum@ */ /end MEASUREMENT
/begin MEASUREMENT VHAL_DKCReVehData_enum "" UBYTE SWC_HALIN_type_CM_uint8_enum 0 0 0.0 15.0 ECU_ADDRESS 0x0000 /* @ECU_Address@VHAL_DKCReVehData_enum@ */ /end MEASUREMENT
/begin MEASUREMENT VHAL_PCommandToBCM_enum "" UBYTE SWC_HALIN_type_CM_uint8_enum 0 0 0.0 15.0 ECU_ADDRESS 0x0000 /* @ECU_Address@VHAL_PCommandToBCM_enum@ */ /end MEASUREMENT
/begin MEASUREMENT VHAL_PCommandToPTG_enum "" UBYTE SWC_HALIN_type_CM_uint8_enum 0 0 0.0 5.0 ECU_ADDRESS 0x0000 /* @ECU_Address@VHAL_PCommandToPTG_enum@ */ /end MEASUREMENT
/begin MEASUREMENT VHAL_PDKeyAreaLockUnlock_enum "" UBYTE SWC_HALIN_type_CM_uint8_enum 0 0 0.0 3.0 ECU_ADDRESS 0x0000 /* @ECU_Address@VHAL_PDKeyAreaLockUnlock_enum@ */ /end MEASUREMENT
/begin MEASUREMENT VHAL_BDDSEATModeSta_enum "" UBYTE SWC_HALIN_type_CM_uint8_enum 0 0 0.0 7.0 ECU_ADDRESS 0x0000 /* @ECU_Address@VHAL_BDDSEATModeSta_enum@ */ /end MEASUREMENT
/begin MEASUREMENT VHAL_PDKeyAreaPS_enum "" UBYTE SWC_HALIN_type_CM_uint8_enum 0 0 0.0 3.0 ECU_ADDRESS 0x0000 /* @ECU_Address@VHAL_PDKeyAreaPS_enum@ */ /end MEASUREMENT
/begin MEASUREMENT VHAL_PDKeyAreaPTG_enum "" UBYTE SWC_HALIN_type_CM_uint8_enum 0 0 0.0 3.0 ECU_ADDRESS 0x0000 /* @ECU_Address@VHAL_PDKeyAreaPTG_enum@ */ /end MEASUREMENT
/begin MEASUREMENT VHAL_PDKeyWelcome_enum "" UBYTE SWC_HALIN_type_CM_uint8_enum 0 0 0.0 15.0 ECU_ADDRESS 0x0000 /* @ECU_Address@VHAL_PDKeyWelcome_enum@ */ /end MEASUREMENT
/begin MEASUREMENT VHAL_PDkeyShowIVI_enum "" UBYTE SWC_HALIN_type_CM_uint8_enum 0 0 0.0 15.0 ECU_ADDRESS 0x0000 /* @ECU_Address@VHAL_PDkeyShowIVI_enum@ */ /end MEASUREMENT
/begin MEASUREMENT VHAL_PKeyMode_enum "" UBYTE SWC_HALIN_type_CM_uint8_enum 0 0 0.0 15.0 ECU_ADDRESS 0x0000 /* @ECU_Address@VHAL_PKeyMode_enum@ */ /end MEASUREMENT
/begin MEASUREMENT VHAL_BDDSEATVentSta_enum "" UBYTE SWC_HALIN_type_CM_uint8_enum 0 0 0.0 4.0 ECU_ADDRESS 0x0000 /* @ECU_Address@VHAL_BDDSEATVentSta_enum@ */ /end MEASUREMENT
/begin MEASUREMENT VHAL_PTGActiveSta_enum "" UBYTE SWC_HALIN_type_CM_uint8_enum 0 0 0.0 7.0 ECU_ADDRESS 0x0000 /* @ECU_Address@VHAL_PTGActiveSta_enum@ */ /end MEASUREMENT
/begin MEASUREMENT VHAL_PTGHWVer_enum "" UBYTE SWC_HALIN_type_CM_uint8_enum 0 0 0.0 31.0 ECU_ADDRESS 0x0000 /* @ECU_Address@VHAL_PTGHWVer_enum@ */ /end MEASUREMENT
/begin MEASUREMENT VHAL_PTGInnerSW2_enum "" UBYTE SWC_HALIN_type_CM_uint8_enum 0 0 0.0 3.0 ECU_ADDRESS 0x0000 /* @ECU_Address@VHAL_PTGInnerSW2_enum@ */ /end MEASUREMENT
/begin MEASUREMENT VHAL_PTGRDILSta_enum "" UBYTE SWC_HALIN_type_CM_uint8_enum 0 0 0.0 3.0 ECU_ADDRESS 0x0000 /* @ECU_Address@VHAL_PTGRDILSta_enum@ */ /end MEASUREMENT
/begin MEASUREMENT VHAL_PTGSWVer_enum "" UBYTE SWC_HALIN_type_CM_uint8_enum 0 0 0.0 31.0 ECU_ADDRESS 0x0000 /* @ECU_Address@VHAL_PTGSWVer_enum@ */ /end MEASUREMENT
/begin MEASUREMENT VHAL_PTGSysSta_enum "" UBYTE SWC_HALIN_type_CM_uint8_enum 0 0 0.0 3.0 ECU_ADDRESS 0x0000 /* @ECU_Address@VHAL_PTGSysSta_enum@ */ /end MEASUREMENT
/begin MEASUREMENT VHAL_BDDSEATheaterSta_enum "" UBYTE SWC_HALIN_type_CM_uint8_enum 0 0 0.0 4.0 ECU_ADDRESS 0x0000 /* @ECU_Address@VHAL_BDDSEATheaterSta_enum@ */ /end MEASUREMENT
/begin MEASUREMENT VHAL_ADASACCSta_enum "" UBYTE SWC_HALIN_type_CM_uint8_enum 0 0 0.0 7.0 ECU_ADDRESS 0x0000 /* @ECU_Address@VHAL_ADASACCSta_enum@ */ /end MEASUREMENT
/begin MEASUREMENT VHAL_ADASAEBReq_enum "" UBYTE SWC_HALIN_type_CM_uint8_enum 0 0 0.0 7.0 ECU_ADDRESS 0x0000 /* @ECU_Address@VHAL_ADASAEBReq_enum@ */ /end MEASUREMENT
/begin MEASUREMENT VHAL_ADASAEBSta_enum "" UBYTE SWC_HALIN_type_CM_uint8_enum 0 0 0.0 7.0 ECU_ADDRESS 0x0000 /* @ECU_Address@VHAL_ADASAEBSta_enum@ */ /end MEASUREMENT
/begin MEASUREMENT VHAL_ADASCAMSpdLim_enum "" UBYTE SWC_HALIN_type_CM_uint8_enum 0 0 0.0 31.0 ECU_ADDRESS 0x0000 /* @ECU_Address@VHAL_ADASCAMSpdLim_enum@ */ /end MEASUREMENT
/begin MEASUREMENT VHAL_ADASDBSReq_enum "" UBYTE SWC_HALIN_type_CM_uint8_enum 0 0 0.0 3.0 ECU_ADDRESS 0x0000 /* @ECU_Address@VHAL_ADASDBSReq_enum@ */ /end MEASUREMENT
/begin MEASUREMENT VHAL_ADASFCWSta_enum "" UBYTE SWC_HALIN_type_CM_uint8_enum 0 0 0.0 7.0 ECU_ADDRESS 0x0000 /* @ECU_Address@VHAL_ADASFCWSta_enum@ */ /end MEASUREMENT
/begin MEASUREMENT VHAL_ADASISASta_enum "" UBYTE SWC_HALIN_type_CM_uint8_enum 0 0 0.0 6.0 ECU_ADDRESS 0x0000 /* @ECU_Address@VHAL_ADASISASta_enum@ */ /end MEASUREMENT
/begin MEASUREMENT VHAL_ADASLDWSta_enum "" UBYTE SWC_HALIN_type_CM_uint8_enum 0 0 0.0 7.0 ECU_ADDRESS 0x0000 /* @ECU_Address@VHAL_ADASLDWSta_enum@ */ /end MEASUREMENT
/begin MEASUREMENT VHAL_ADASLFCHandsOffWarning_enum "" UBYTE SWC_HALIN_type_CM_uint8_enum 0 0 0.0 3.0 ECU_ADDRESS 0x0000 /* @ECU_Address@VHAL_ADASLFCHandsOffWarning_enum@ */ /end MEASUREMENT
/begin MEASUREMENT VHAL_ADASLFCSta_enum "" UBYTE SWC_HALIN_type_CM_uint8_enum 0 0 0.0 7.0 ECU_ADDRESS 0x0000 /* @ECU_Address@VHAL_ADASLFCSta_enum@ */ /end MEASUREMENT
/begin MEASUREMENT VHAL_ADASLFCWarnSound_enum "" UBYTE SWC_HALIN_type_CM_uint8_enum 0 0 0.0 255.0 ECU_ADDRESS 0x0000 /* @ECU_Address@VHAL_ADASLFCWarnSound_enum@ */ /end MEASUREMENT
/begin MEASUREMENT VHAL_ADASLKASta_enum "" UBYTE SWC_HALIN_type_CM_uint8_enum 0 0 0.0 7.0 ECU_ADDRESS 0x0000 /* @ECU_Address@VHAL_ADASLKASta_enum@ */ /end MEASUREMENT
/begin MEASUREMENT VHAL_ADASLaneModeL_enum "" UBYTE SWC_HALIN_type_CM_uint8_enum 0 0 0.0 7.0 ECU_ADDRESS 0x0000 /* @ECU_Address@VHAL_ADASLaneModeL_enum@ */ /end MEASUREMENT
/begin MEASUREMENT VHAL_ADASLaneModeR_enum "" UBYTE SWC_HALIN_type_CM_uint8_enum 0 0 0.0 7.0 ECU_ADDRESS 0x0000 /* @ECU_Address@VHAL_ADASLaneModeR_enum@ */ /end MEASUREMENT
/begin MEASUREMENT VHAL_ADASLanetypeL_enum "" UBYTE SWC_HALIN_type_CM_uint8_enum 0 0 0.0 2.0 ECU_ADDRESS 0x0000 /* @ECU_Address@VHAL_ADASLanetypeL_enum@ */ /end MEASUREMENT
/begin MEASUREMENT VHAL_ADASLanetypeR_enum "" UBYTE SWC_HALIN_type_CM_uint8_enum 0 0 0.0 2.0 ECU_ADDRESS 0x0000 /* @ECU_Address@VHAL_ADASLanetypeR_enum@ */ /end MEASUREMENT
/begin MEASUREMENT VHAL_ADASSLIFSpdLim_enum "" UBYTE SWC_HALIN_type_CM_uint8_enum 0 0 0.0 31.0 ECU_ADDRESS 0x0000 /* @ECU_Address@VHAL_ADASSLIFSpdLim_enum@ */ /end MEASUREMENT
/begin MEASUREMENT VHAL_ADASSLIFSta_enum "" UBYTE SWC_HALIN_type_CM_uint8_enum 0 0 0.0 5.0 ECU_ADDRESS 0x0000 /* @ECU_Address@VHAL_ADASSLIFSta_enum@ */ /end MEASUREMENT
/begin MEASUREMENT VHAL_ADASShftPosnReq_enum "" UBYTE SWC_HALIN_type_CM_uint8_enum 0 0 0.0 7.0 ECU_ADDRESS 0x0000 /* @ECU_Address@VHAL_ADASShftPosnReq_enum@ */ /end MEASUREMENT
/begin MEASUREMENT VHAL_ADASVehSpdLim_enum "" UBYTE SWC_HALIN_type_CM_uint8_enum 0 0 0.0 254.0 ECU_ADDRESS 0x0000 /* @ECU_Address@VHAL_ADASVehSpdLim_enum@ */ /end MEASUREMENT
/begin MEASUREMENT VHAL_ADASWarningMsg_enum "" UBYTE SWC_HALIN_type_CM_uint8_enum 0 0 0.0 15.0 ECU_ADDRESS 0x0000 /* @ECU_Address@VHAL_ADASWarningMsg_enum@ */ /end MEASUREMENT
/begin MEASUREMENT VHAL_FCM1Checksum_enum "" UBYTE SWC_HALIN_type_CM_uint8_enum 0 0 0.0 255.0 ECU_ADDRESS 0x0000 /* @ECU_Address@VHAL_FCM1Checksum_enum@ */ /end MEASUREMENT
/begin MEASUREMENT VHAL_FCM1LifeCount_enum "" UBYTE SWC_HALIN_type_CM_uint8_enum 0 0 0.0 14.0 ECU_ADDRESS 0x0000 /* @ECU_Address@VHAL_FCM1LifeCount_enum@ */ /end MEASUREMENT
/begin MEASUREMENT VHAL_FCMACCmode_enum "" UBYTE SWC_HALIN_type_CM_uint8_enum 0 0 0.0 2.0 ECU_ADDRESS 0x0000 /* @ECU_Address@VHAL_FCMACCmode_enum@ */ /end MEASUREMENT
/begin MEASUREMENT VHAL_FCMLKATOIAct_enum "" UBYTE SWC_HALIN_type_CM_uint8_enum 0 0 0.0 255.0 ECU_ADDRESS 0x0000 /* @ECU_Address@VHAL_FCMLKATOIAct_enum@ */ /end MEASUREMENT
/begin MEASUREMENT VHAL_ForceLowBeam_enum "" UBYTE SWC_HALIN_type_CM_uint8_enum 0 0 0.0 2.0 ECU_ADDRESS 0x0000 /* @ECU_Address@VHAL_ForceLowBeam_enum@ */ /end MEASUREMENT
/begin MEASUREMENT VHAL_ISAWarningMsg_enum "" UBYTE SWC_HALIN_type_CM_uint8_enum 0 0 0.0 6.0 ECU_ADDRESS 0x0000 /* @ECU_Address@VHAL_ISAWarningMsg_enum@ */ /end MEASUREMENT
/begin MEASUREMENT VHAL_ACCObjDstLvl_enum "" UBYTE SWC_HALIN_type_CM_uint8_enum 0 0 0.0 7.0 ECU_ADDRESS 0x0000 /* @ECU_Address@VHAL_ACCObjDstLvl_enum@ */ /end MEASUREMENT
/begin MEASUREMENT VHAL_LVDAMuteSta_enum "" UBYTE SWC_HALIN_type_CM_uint8_enum 0 0 0.0 3.0 ECU_ADDRESS 0x0000 /* @ECU_Address@VHAL_LVDAMuteSta_enum@ */ /end MEASUREMENT
/begin MEASUREMENT VHAL_TargetType_enum "" UBYTE SWC_HALIN_type_CM_uint8_enum 0 0 0.0 15.0 ECU_ADDRESS 0x0000 /* @ECU_Address@VHAL_TargetType_enum@ */ /end MEASUREMENT
/begin MEASUREMENT VHAL_TimeGapLevel_enum "" UBYTE SWC_HALIN_type_CM_uint8_enum 0 0 0.0 7.0 ECU_ADDRESS 0x0000 /* @ECU_Address@VHAL_TimeGapLevel_enum@ */ /end MEASUREMENT
/begin MEASUREMENT VHAL_ADBVehDst1Val_enum "" UBYTE SWC_HALIN_type_CM_uint8_enum 0 0 0.0 15.0 ECU_ADDRESS 0x0000 /* @ECU_Address@VHAL_ADBVehDst1Val_enum@ */ /end MEASUREMENT
/begin MEASUREMENT VHAL_SRRBSDWarnL_enum "" UBYTE SWC_HALIN_type_CM_uint8_enum 0 0 0.0 3.0 ECU_ADDRESS 0x0000 /* @ECU_Address@VHAL_SRRBSDWarnL_enum@ */ /end MEASUREMENT
/begin MEASUREMENT VHAL_SRRBSDWarnR_enum "" UBYTE SWC_HALIN_type_CM_uint8_enum 0 0 0.0 3.0 ECU_ADDRESS 0x0000 /* @ECU_Address@VHAL_SRRBSDWarnR_enum@ */ /end MEASUREMENT
/begin MEASUREMENT VHAL_SRRODAWarnL_enum "" UBYTE SWC_HALIN_type_CM_uint8_enum 0 0 0.0 3.0 ECU_ADDRESS 0x0000 /* @ECU_Address@VHAL_SRRODAWarnL_enum@ */ /end MEASUREMENT
/begin MEASUREMENT VHAL_SRRODAWarnR_enum "" UBYTE SWC_HALIN_type_CM_uint8_enum 0 0 0.0 3.0 ECU_ADDRESS 0x0000 /* @ECU_Address@VHAL_SRRODAWarnR_enum@ */ /end MEASUREMENT
/begin MEASUREMENT VHAL_BrkDiscTempSta_flg "" UBYTE SWC_HALIN_type_CM_boolean_flg 0 0 0.0 1.0 ECU_ADDRESS 0x0000 /* @ECU_Address@VHAL_BrkDiscTempSta_flg@ */ /end MEASUREMENT
/begin MEASUREMENT VHAL_BrkPedalPosSta_flg "" UBYTE SWC_HALIN_type_CM_boolean_flg 0 0 0.0 1.0 ECU_ADDRESS 0x0000 /* @ECU_Address@VHAL_BrkPedalPosSta_flg@ */ /end MEASUREMENT
/begin MEASUREMENT VHAL_BrkSwSta_flg "" UBYTE SWC_HALIN_type_CM_boolean_flg 0 0 0.0 1.0 ECU_ADDRESS 0x0000 /* @ECU_Address@VHAL_BrkSwSta_flg@ */ /end MEASUREMENT
/begin MEASUREMENT VHAL_BrkSwV_flg "" UBYTE SWC_HALIN_type_CM_boolean_flg 0 0 0.0 1.0 ECU_ADDRESS 0x0000 /* @ECU_Address@VHAL_BrkSwV_flg@ */ /end MEASUREMENT
/begin MEASUREMENT VHAL_ESCStandstill_flg "" UBYTE SWC_HALIN_type_CM_boolean_flg 0 0 0.0 1.0 ECU_ADDRESS 0x0000 /* @ECU_Address@VHAL_ESCStandstill_flg@ */ /end MEASUREMENT
/begin MEASUREMENT VHAL_PABSwitchCmd_flg "" UBYTE SWC_HALIN_type_CM_boolean_flg 0 0 0.0 1.0 ECU_ADDRESS 0x0000 /* @ECU_Address@VHAL_PABSwitchCmd_flg@ */ /end MEASUREMENT
/begin MEASUREMENT VHAL_FrRBCActive_flg "" UBYTE SWC_HALIN_type_CM_boolean_flg 0 0 0.0 1.0 ECU_ADDRESS 0x0000 /* @ECU_Address@VHAL_FrRBCActive_flg@ */ /end MEASUREMENT
/begin MEASUREMENT VHAL_LatAccelV_flg "" UBYTE SWC_HALIN_type_CM_boolean_flg 0 0 0.0 1.0 ECU_ADDRESS 0x0000 /* @ECU_Address@VHAL_LatAccelV_flg@ */ /end MEASUREMENT
/begin MEASUREMENT VHAL_LongAccelV_flg "" UBYTE SWC_HALIN_type_CM_boolean_flg 0 0 0.0 1.0 ECU_ADDRESS 0x0000 /* @ECU_Address@VHAL_LongAccelV_flg@ */ /end MEASUREMENT
/begin MEASUREMENT VHAL_MCPressureV_flg "" UBYTE SWC_HALIN_type_CM_boolean_flg 0 0 0.0 1.0 ECU_ADDRESS 0x0000 /* @ECU_Address@VHAL_MCPressureV_flg@ */ /end MEASUREMENT
/begin MEASUREMENT VHAL_PsngrSeatBeltCmd_flg "" UBYTE SWC_HALIN_type_CM_boolean_flg 0 0 0.0 1.0 ECU_ADDRESS 0x0000 /* @ECU_Address@VHAL_PsngrSeatBeltCmd_flg@ */ /end MEASUREMENT
/begin MEASUREMENT VHAL_RrRBCActive_flg "" UBYTE SWC_HALIN_type_CM_boolean_flg 0 0 0.0 1.0 ECU_ADDRESS 0x0000 /* @ECU_Address@VHAL_RrRBCActive_flg@ */ /end MEASUREMENT
/begin MEASUREMENT VHAL_YawRateV_flg "" UBYTE SWC_HALIN_type_CM_boolean_flg 0 0 0.0 1.0 ECU_ADDRESS 0x0000 /* @ECU_Address@VHAL_YawRateV_flg@ */ /end MEASUREMENT
/begin MEASUREMENT VHAL_LowBrakeFluidSta_flg "" UBYTE SWC_HALIN_type_CM_boolean_flg 0 0 0.0 1.0 ECU_ADDRESS 0x0000 /* @ECU_Address@VHAL_LowBrakeFluidSta_flg@ */ /end MEASUREMENT
/begin MEASUREMENT VHAL_eBSTAmberWnlmpSta_flg "" UBYTE SWC_HALIN_type_CM_boolean_flg 0 0 0.0 1.0 ECU_ADDRESS 0x0000 /* @ECU_Address@VHAL_eBSTAmberWnlmpSta_flg@ */ /end MEASUREMENT
/begin MEASUREMENT VHAL_eBSTBeepReq_flg "" UBYTE SWC_HALIN_type_CM_boolean_flg 0 0 0.0 1.0 ECU_ADDRESS 0x0000 /* @ECU_Address@VHAL_eBSTBeepReq_flg@ */ /end MEASUREMENT
/begin MEASUREMENT VHAL_eBSTRedWnlmpSta_flg "" UBYTE SWC_HALIN_type_CM_boolean_flg 0 0 0.0 1.0 ECU_ADDRESS 0x0000 /* @ECU_Address@VHAL_eBSTRedWnlmpSta_flg@ */ /end MEASUREMENT
/begin MEASUREMENT VHAL_RCenterSeatBeltCmd_flg "" UBYTE SWC_HALIN_type_CM_boolean_flg 0 0 0.0 1.0 ECU_ADDRESS 0x0000 /* @ECU_Address@VHAL_RCenterSeatBeltCmd_flg@ */ /end MEASUREMENT
/begin MEASUREMENT VHAL_RDriverSeatBeltCmd_flg "" UBYTE SWC_HALIN_type_CM_boolean_flg 0 0 0.0 1.0 ECU_ADDRESS 0x0000 /* @ECU_Address@VHAL_RDriverSeatBeltCmd_flg@ */ /end MEASUREMENT
/begin MEASUREMENT VHAL_RPsngrSeatBeltCmd_flg "" UBYTE SWC_HALIN_type_CM_boolean_flg 0 0 0.0 1.0 ECU_ADDRESS 0x0000 /* @ECU_Address@VHAL_RPsngrSeatBeltCmd_flg@ */ /end MEASUREMENT
/begin MEASUREMENT VHAL_TLHPsngrSeatBeltCmd_flg "" UBYTE SWC_HALIN_type_CM_boolean_flg 0 0 0.0 1.0 ECU_ADDRESS 0x0000 /* @ECU_Address@VHAL_TLHPsngrSeatBeltCmd_flg@ */ /end MEASUREMENT
/begin MEASUREMENT VHAL_TRHPsngrSeatBeltCmd_flg "" UBYTE SWC_HALIN_type_CM_boolean_flg 0 0 0.0 1.0 ECU_ADDRESS 0x0000 /* @ECU_Address@VHAL_TRHPsngrSeatBeltCmd_flg@ */ /end MEASUREMENT
/begin MEASUREMENT VHAL_ABMPassengerODSSta_flg "" UBYTE SWC_HALIN_type_CM_boolean_flg 0 0 0.0 1.0 ECU_ADDRESS 0x0000 /* @ECU_Address@VHAL_ABMPassengerODSSta_flg@ */ /end MEASUREMENT
/begin MEASUREMENT VHAL_DOASta_flg "" UBYTE SWC_HALIN_type_CM_boolean_flg 0 0 0.0 1.0 ECU_ADDRESS 0x0000 /* @ECU_Address@VHAL_DOASta_flg@ */ /end MEASUREMENT
/begin MEASUREMENT VHAL_EPBCarWashMode_flg "" UBYTE SWC_HALIN_type_CM_boolean_flg 0 0 0.0 1.0 ECU_ADDRESS 0x0000 /* @ECU_Address@VHAL_EPBCarWashMode_flg@ */ /end MEASUREMENT
/begin MEASUREMENT VHAL_EPBExtApplyAvail_flg "" UBYTE SWC_HALIN_type_CM_boolean_flg 0 0 0.0 1.0 ECU_ADDRESS 0x0000 /* @ECU_Address@VHAL_EPBExtApplyAvail_flg@ */ /end MEASUREMENT
/begin MEASUREMENT VHAL_EPBExtReleaseAvail_flg "" UBYTE SWC_HALIN_type_CM_boolean_flg 0 0 0.0 1.0 ECU_ADDRESS 0x0000 /* @ECU_Address@VHAL_EPBExtReleaseAvail_flg@ */ /end MEASUREMENT
/begin MEASUREMENT VHAL_ABMRearPassengerCTRODSSta_flg "" UBYTE SWC_HALIN_type_CM_boolean_flg 0 0 0.0 1.0 ECU_ADDRESS 0x0000 /* @ECU_Address@VHAL_ABMRearPassengerCTRODSSta_flg@ */ /end MEASUREMENT
/begin MEASUREMENT VHAL_SASCAL_flg "" UBYTE SWC_HALIN_type_CM_boolean_flg 0 0 0.0 1.0 ECU_ADDRESS 0x0000 /* @ECU_Address@VHAL_SASCAL_flg@ */ /end MEASUREMENT
/begin MEASUREMENT VHAL_SASSpeedValid_flg "" UBYTE SWC_HALIN_type_CM_boolean_flg 0 0 0.0 1.0 ECU_ADDRESS 0x0000 /* @ECU_Address@VHAL_SASSpeedValid_flg@ */ /end MEASUREMENT
/begin MEASUREMENT VHAL_SASV_flg "" UBYTE SWC_HALIN_type_CM_boolean_flg 0 0 0.0 1.0 ECU_ADDRESS 0x0000 /* @ECU_Address@VHAL_SASV_flg@ */ /end MEASUREMENT
/begin MEASUREMENT VHAL_ABMRearPassengerLHODSSta_flg "" UBYTE SWC_HALIN_type_CM_boolean_flg 0 0 0.0 1.0 ECU_ADDRESS 0x0000 /* @ECU_Address@VHAL_ABMRearPassengerLHODSSta_flg@ */ /end MEASUREMENT
/begin MEASUREMENT VHAL_ABSActive_flg "" UBYTE SWC_HALIN_type_CM_boolean_flg 0 0 0.0 1.0 ECU_ADDRESS 0x0000 /* @ECU_Address@VHAL_ABSActive_flg@ */ /end MEASUREMENT
/begin MEASUREMENT VHAL_ABSFailed_flg "" UBYTE SWC_HALIN_type_CM_boolean_flg 0 0 0.0 1.0 ECU_ADDRESS 0x0000 /* @ECU_Address@VHAL_ABSFailed_flg@ */ /end MEASUREMENT
/begin MEASUREMENT VHAL_ABSWnlmpSta_flg "" UBYTE SWC_HALIN_type_CM_boolean_flg 0 0 0.0 1.0 ECU_ADDRESS 0x0000 /* @ECU_Address@VHAL_ABSWnlmpSta_flg@ */ /end MEASUREMENT
/begin MEASUREMENT VHAL_AVHActive_flg "" UBYTE SWC_HALIN_type_CM_boolean_flg 0 0 0.0 1.0 ECU_ADDRESS 0x0000 /* @ECU_Address@VHAL_AVHActive_flg@ */ /end MEASUREMENT
/begin MEASUREMENT VHAL_AVHFailed_flg "" UBYTE SWC_HALIN_type_CM_boolean_flg 0 0 0.0 1.0 ECU_ADDRESS 0x0000 /* @ECU_Address@VHAL_AVHFailed_flg@ */ /end MEASUREMENT
/begin MEASUREMENT VHAL_AmberWnlmpSta_flg "" UBYTE SWC_HALIN_type_CM_boolean_flg 0 0 0.0 1.0 ECU_ADDRESS 0x0000 /* @ECU_Address@VHAL_AmberWnlmpSta_flg@ */ /end MEASUREMENT
/begin MEASUREMENT VHAL_BTCSActive_flg "" UBYTE SWC_HALIN_type_CM_boolean_flg 0 0 0.0 1.0 ECU_ADDRESS 0x0000 /* @ECU_Address@VHAL_BTCSActive_flg@ */ /end MEASUREMENT
/begin MEASUREMENT VHAL_EBDActive_flg "" UBYTE SWC_HALIN_type_CM_boolean_flg 0 0 0.0 1.0 ECU_ADDRESS 0x0000 /* @ECU_Address@VHAL_EBDActive_flg@ */ /end MEASUREMENT
/begin MEASUREMENT VHAL_EBDFailed_flg "" UBYTE SWC_HALIN_type_CM_boolean_flg 0 0 0.0 1.0 ECU_ADDRESS 0x0000 /* @ECU_Address@VHAL_EBDFailed_flg@ */ /end MEASUREMENT
/begin MEASUREMENT VHAL_ABMRearPassengerRHODSSta_flg "" UBYTE SWC_HALIN_type_CM_boolean_flg 0 0 0.0 1.0 ECU_ADDRESS 0x0000 /* @ECU_Address@VHAL_ABMRearPassengerRHODSSta_flg@ */ /end MEASUREMENT
/begin MEASUREMENT VHAL_ESCActive_flg "" UBYTE SWC_HALIN_type_CM_boolean_flg 0 0 0.0 1.0 ECU_ADDRESS 0x0000 /* @ECU_Address@VHAL_ESCActive_flg@ */ /end MEASUREMENT
/begin MEASUREMENT VHAL_ESCBeepReq_flg "" UBYTE SWC_HALIN_type_CM_boolean_flg 0 0 0.0 1.0 ECU_ADDRESS 0x0000 /* @ECU_Address@VHAL_ESCBeepReq_flg@ */ /end MEASUREMENT
/begin MEASUREMENT VHAL_ESCFailed_flg "" UBYTE SWC_HALIN_type_CM_boolean_flg 0 0 0.0 1.0 ECU_ADDRESS 0x0000 /* @ECU_Address@VHAL_ESCFailed_flg@ */ /end MEASUREMENT
/begin MEASUREMENT VHAL_ESCOfflmpSta_flg "" UBYTE SWC_HALIN_type_CM_boolean_flg 0 0 0.0 1.0 ECU_ADDRESS 0x0000 /* @ECU_Address@VHAL_ESCOfflmpSta_flg@ */ /end MEASUREMENT
/begin MEASUREMENT VHAL_ESSActive_flg "" UBYTE SWC_HALIN_type_CM_boolean_flg 0 0 0.0 1.0 ECU_ADDRESS 0x0000 /* @ECU_Address@VHAL_ESSActive_flg@ */ /end MEASUREMENT
/begin MEASUREMENT VHAL_FrPTCSActive_flg "" UBYTE SWC_HALIN_type_CM_boolean_flg 0 0 0.0 1.0 ECU_ADDRESS 0x0000 /* @ECU_Address@VHAL_FrPTCSActive_flg@ */ /end MEASUREMENT
/begin MEASUREMENT VHAL_AirBagFailCmd_flg "" UBYTE SWC_HALIN_type_CM_boolean_flg 0 0 0.0 1.0 ECU_ADDRESS 0x0000 /* @ECU_Address@VHAL_AirBagFailCmd_flg@ */ /end MEASUREMENT
/begin MEASUREMENT VHAL_HBBActive_flg "" UBYTE SWC_HALIN_type_CM_boolean_flg 0 0 0.0 1.0 ECU_ADDRESS 0x0000 /* @ECU_Address@VHAL_HBBActive_flg@ */ /end MEASUREMENT
/begin MEASUREMENT VHAL_HBBFailed_flg "" UBYTE SWC_HALIN_type_CM_boolean_flg 0 0 0.0 1.0 ECU_ADDRESS 0x0000 /* @ECU_Address@VHAL_HBBFailed_flg@ */ /end MEASUREMENT
/begin MEASUREMENT VHAL_HDDActive_flg "" UBYTE SWC_HALIN_type_CM_boolean_flg 0 0 0.0 1.0 ECU_ADDRESS 0x0000 /* @ECU_Address@VHAL_HDDActive_flg@ */ /end MEASUREMENT
/begin MEASUREMENT VHAL_HDDFailed_flg "" UBYTE SWC_HALIN_type_CM_boolean_flg 0 0 0.0 1.0 ECU_ADDRESS 0x0000 /* @ECU_Address@VHAL_HDDFailed_flg@ */ /end MEASUREMENT
/begin MEASUREMENT VHAL_HSAActive_flg "" UBYTE SWC_HALIN_type_CM_boolean_flg 0 0 0.0 1.0 ECU_ADDRESS 0x0000 /* @ECU_Address@VHAL_HSAActive_flg@ */ /end MEASUREMENT
/begin MEASUREMENT VHAL_HSAFailed_flg "" UBYTE SWC_HALIN_type_CM_boolean_flg 0 0 0.0 1.0 ECU_ADDRESS 0x0000 /* @ECU_Address@VHAL_HSAFailed_flg@ */ /end MEASUREMENT
/begin MEASUREMENT VHAL_LFPulseCountV_flg "" UBYTE SWC_HALIN_type_CM_boolean_flg 0 0 0.0 1.0 ECU_ADDRESS 0x0000 /* @ECU_Address@VHAL_LFPulseCountV_flg@ */ /end MEASUREMENT
/begin MEASUREMENT VHAL_LFRawWhlSpeedV_flg "" UBYTE SWC_HALIN_type_CM_boolean_flg 0 0 0.0 1.0 ECU_ADDRESS 0x0000 /* @ECU_Address@VHAL_LFRawWhlSpeedV_flg@ */ /end MEASUREMENT
/begin MEASUREMENT VHAL_LRPulseCountV_flg "" UBYTE SWC_HALIN_type_CM_boolean_flg 0 0 0.0 1.0 ECU_ADDRESS 0x0000 /* @ECU_Address@VHAL_LRPulseCountV_flg@ */ /end MEASUREMENT
/begin MEASUREMENT VHAL_LRRawWhlSpeedV_flg "" UBYTE SWC_HALIN_type_CM_boolean_flg 0 0 0.0 1.0 ECU_ADDRESS 0x0000 /* @ECU_Address@VHAL_LRRawWhlSpeedV_flg@ */ /end MEASUREMENT
/begin MEASUREMENT VHAL_PBAActive_flg "" UBYTE SWC_HALIN_type_CM_boolean_flg 0 0 0.0 1.0 ECU_ADDRESS 0x0000 /* @ECU_Address@VHAL_PBAActive_flg@ */ /end MEASUREMENT
/begin MEASUREMENT VHAL_PBAFailed_flg "" UBYTE SWC_HALIN_type_CM_boolean_flg 0 0 0.0 1.0 ECU_ADDRESS 0x0000 /* @ECU_Address@VHAL_PBAFailed_flg@ */ /end MEASUREMENT
/begin MEASUREMENT VHAL_RFPulseCountV_flg "" UBYTE SWC_HALIN_type_CM_boolean_flg 0 0 0.0 1.0 ECU_ADDRESS 0x0000 /* @ECU_Address@VHAL_RFPulseCountV_flg@ */ /end MEASUREMENT
/begin MEASUREMENT VHAL_RFRawWhlSpeedV_flg "" UBYTE SWC_HALIN_type_CM_boolean_flg 0 0 0.0 1.0 ECU_ADDRESS 0x0000 /* @ECU_Address@VHAL_RFRawWhlSpeedV_flg@ */ /end MEASUREMENT
/begin MEASUREMENT VHAL_RRPulseCountV_flg "" UBYTE SWC_HALIN_type_CM_boolean_flg 0 0 0.0 1.0 ECU_ADDRESS 0x0000 /* @ECU_Address@VHAL_RRPulseCountV_flg@ */ /end MEASUREMENT
/begin MEASUREMENT VHAL_RRRawWhlSpeedV_flg "" UBYTE SWC_HALIN_type_CM_boolean_flg 0 0 0.0 1.0 ECU_ADDRESS 0x0000 /* @ECU_Address@VHAL_RRRawWhlSpeedV_flg@ */ /end MEASUREMENT
/begin MEASUREMENT VHAL_DriverSeatBeltCmd_flg "" UBYTE SWC_HALIN_type_CM_boolean_flg 0 0 0.0 1.0 ECU_ADDRESS 0x0000 /* @ECU_Address@VHAL_DriverSeatBeltCmd_flg@ */ /end MEASUREMENT
/begin MEASUREMENT VHAL_RedWnlmpSta_flg "" UBYTE SWC_HALIN_type_CM_boolean_flg 0 0 0.0 1.0 ECU_ADDRESS 0x0000 /* @ECU_Address@VHAL_RedWnlmpSta_flg@ */ /end MEASUREMENT
/begin MEASUREMENT VHAL_RrPTCSActive_flg "" UBYTE SWC_HALIN_type_CM_boolean_flg 0 0 0.0 1.0 ECU_ADDRESS 0x0000 /* @ECU_Address@VHAL_RrPTCSActive_flg@ */ /end MEASUREMENT
/begin MEASUREMENT VHAL_TCSActive_flg "" UBYTE SWC_HALIN_type_CM_boolean_flg 0 0 0.0 1.0 ECU_ADDRESS 0x0000 /* @ECU_Address@VHAL_TCSActive_flg@ */ /end MEASUREMENT
/begin MEASUREMENT VHAL_TCSFailed_flg "" UBYTE SWC_HALIN_type_CM_boolean_flg 0 0 0.0 1.0 ECU_ADDRESS 0x0000 /* @ECU_Address@VHAL_TCSFailed_flg@ */ /end MEASUREMENT
/begin MEASUREMENT VHAL_ACCAvail_flg "" UBYTE SWC_HALIN_type_CM_boolean_flg 0 0 0.0 1.0 ECU_ADDRESS 0x0000 /* @ECU_Address@VHAL_ACCAvail_flg@ */ /end MEASUREMENT
/begin MEASUREMENT VHAL_AEBAvail_flg "" UBYTE SWC_HALIN_type_CM_boolean_flg 0 0 0.0 1.0 ECU_ADDRESS 0x0000 /* @ECU_Address@VHAL_AEBAvail_flg@ */ /end MEASUREMENT
/begin MEASUREMENT VHAL_ActBrkLampSta_flg "" UBYTE SWC_HALIN_type_CM_boolean_flg 0 0 0.0 1.0 ECU_ADDRESS 0x0000 /* @ECU_Address@VHAL_ActBrkLampSta_flg@ */ /end MEASUREMENT
/begin MEASUREMENT VHAL_CANMsgInvalidABM1_flg "" UBYTE SWC_HALIN_type_CM_boolean_flg 0 0 0.0 1.0 ECU_ADDRESS 0x0000 /* @ECU_Address@VHAL_CANMsgInvalidABM1_flg@ */ /end MEASUREMENT
/begin MEASUREMENT VHAL_CANMsgInvalidEPB1_flg "" UBYTE SWC_HALIN_type_CM_boolean_flg 0 0 0.0 1.0 ECU_ADDRESS 0x0000 /* @ECU_Address@VHAL_CANMsgInvalidEPB1_flg@ */ /end MEASUREMENT
/begin MEASUREMENT VHAL_CANMsgInvalidEPS1_flg "" UBYTE SWC_HALIN_type_CM_boolean_flg 0 0 0.0 1.0 ECU_ADDRESS 0x0000 /* @ECU_Address@VHAL_CANMsgInvalidEPS1_flg@ */ /end MEASUREMENT
/begin MEASUREMENT VHAL_CANMsgInvalidESC1_flg "" UBYTE SWC_HALIN_type_CM_boolean_flg 0 0 0.0 1.0 ECU_ADDRESS 0x0000 /* @ECU_Address@VHAL_CANMsgInvalidESC1_flg@ */ /end MEASUREMENT
/begin MEASUREMENT VHAL_CANMsgInvalidESC5_flg "" UBYTE SWC_HALIN_type_CM_boolean_flg 0 0 0.0 1.0 ECU_ADDRESS 0x0000 /* @ECU_Address@VHAL_CANMsgInvalidESC5_flg@ */ /end MEASUREMENT
/begin MEASUREMENT VHAL_CANMsgInvalideBST1_flg "" UBYTE SWC_HALIN_type_CM_boolean_flg 0 0 0.0 1.0 ECU_ADDRESS 0x0000 /* @ECU_Address@VHAL_CANMsgInvalideBST1_flg@ */ /end MEASUREMENT
/begin MEASUREMENT VHAL_HMIACAirIntMCmd_flg "" UBYTE SWC_HALIN_type_CM_boolean_flg 0 0 0.0 1.0 ECU_ADDRESS 0x0000 /* @ECU_Address@VHAL_HMIACAirIntMCmd_flg@ */ /end MEASUREMENT
/begin MEASUREMENT VHAL_HMIACAirIntPCmd_flg "" UBYTE SWC_HALIN_type_CM_boolean_flg 0 0 0.0 1.0 ECU_ADDRESS 0x0000 /* @ECU_Address@VHAL_HMIACAirIntPCmd_flg@ */ /end MEASUREMENT
/begin MEASUREMENT VHAL_HMIZLSetTMCmd_flg "" UBYTE SWC_HALIN_type_CM_boolean_flg 0 0 0.0 1.0 ECU_ADDRESS 0x0000 /* @ECU_Address@VHAL_HMIZLSetTMCmd_flg@ */ /end MEASUREMENT
/begin MEASUREMENT VHAL_IVIPTGUSStaSW_flg "" UBYTE SWC_HALIN_type_CM_boolean_flg 0 0 0.0 1.0 ECU_ADDRESS 0x0000 /* @ECU_Address@VHAL_IVIPTGUSStaSW_flg@ */ /end MEASUREMENT
/begin MEASUREMENT VHAL_IVIPwroffreq_flg "" UBYTE SWC_HALIN_type_CM_boolean_flg 0 0 0.0 1.0 ECU_ADDRESS 0x0000 /* @ECU_Address@VHAL_IVIPwroffreq_flg@ */ /end MEASUREMENT
/begin MEASUREMENT VHAL_IVIRRDefReq_flg "" UBYTE SWC_HALIN_type_CM_boolean_flg 0 0 0.0 1.0 ECU_ADDRESS 0x0000 /* @ECU_Address@VHAL_IVIRRDefReq_flg@ */ /end MEASUREMENT
/begin MEASUREMENT VHAL_IVIStartChgreq_flg "" UBYTE SWC_HALIN_type_CM_boolean_flg 0 0 0.0 1.0 ECU_ADDRESS 0x0000 /* @ECU_Address@VHAL_IVIStartChgreq_flg@ */ /end MEASUREMENT
/begin MEASUREMENT VHAL_IVIStatus_flg "" UBYTE SWC_HALIN_type_CM_boolean_flg 0 0 0.0 1.0 ECU_ADDRESS 0x0000 /* @ECU_Address@VHAL_IVIStatus_flg@ */ /end MEASUREMENT
/begin MEASUREMENT VHAL_HMIZLSetTPCmd_flg "" UBYTE SWC_HALIN_type_CM_boolean_flg 0 0 0.0 1.0 ECU_ADDRESS 0x0000 /* @ECU_Address@VHAL_HMIZLSetTPCmd_flg@ */ /end MEASUREMENT
/begin MEASUREMENT VHAL_IVIStopChgreq_flg "" UBYTE SWC_HALIN_type_CM_boolean_flg 0 0 0.0 1.0 ECU_ADDRESS 0x0000 /* @ECU_Address@VHAL_IVIStopChgreq_flg@ */ /end MEASUREMENT
/begin MEASUREMENT VHAL_IVITrailerCheckReqSta_flg "" UBYTE SWC_HALIN_type_CM_boolean_flg 0 0 0.0 1.0 ECU_ADDRESS 0x0000 /* @ECU_Address@VHAL_IVITrailerCheckReqSta_flg@ */ /end MEASUREMENT
/begin MEASUREMENT VHAL_IVITrailerModeSWSta_flg "" UBYTE SWC_HALIN_type_CM_boolean_flg 0 0 0.0 1.0 ECU_ADDRESS 0x0000 /* @ECU_Address@VHAL_IVITrailerModeSWSta_flg@ */ /end MEASUREMENT
/begin MEASUREMENT VHAL_IVITriggerreq_flg "" UBYTE SWC_HALIN_type_CM_boolean_flg 0 0 0.0 1.0 ECU_ADDRESS 0x0000 /* @ECU_Address@VHAL_IVITriggerreq_flg@ */ /end MEASUREMENT
/begin MEASUREMENT VHAL_IVIUnlockChgreq_flg "" UBYTE SWC_HALIN_type_CM_boolean_flg 0 0 0.0 1.0 ECU_ADDRESS 0x0000 /* @ECU_Address@VHAL_IVIUnlockChgreq_flg@ */ /end MEASUREMENT
/begin MEASUREMENT VHAL_IVIWIMAINSW_flg "" UBYTE SWC_HALIN_type_CM_boolean_flg 0 0 0.0 1.0 ECU_ADDRESS 0x0000 /* @ECU_Address@VHAL_IVIWIMAINSW_flg@ */ /end MEASUREMENT
/begin MEASUREMENT VHAL_HMIZRSetTMCmd_flg "" UBYTE SWC_HALIN_type_CM_boolean_flg 0 0 0.0 1.0 ECU_ADDRESS 0x0000 /* @ECU_Address@VHAL_HMIZRSetTMCmd_flg@ */ /end MEASUREMENT
/begin MEASUREMENT VHAL_LightShowStartReq_flg "" UBYTE SWC_HALIN_type_CM_boolean_flg 0 0 0.0 1.0 ECU_ADDRESS 0x0000 /* @ECU_Address@VHAL_LightShowStartReq_flg@ */ /end MEASUREMENT
/begin MEASUREMENT VHAL_LightShowStopReq_flg "" UBYTE SWC_HALIN_type_CM_boolean_flg 0 0 0.0 1.0 ECU_ADDRESS 0x0000 /* @ECU_Address@VHAL_LightShowStopReq_flg@ */ /end MEASUREMENT
/begin MEASUREMENT VHAL_RFogLampSW_flg "" UBYTE SWC_HALIN_type_CM_boolean_flg 0 0 0.0 1.0 ECU_ADDRESS 0x0000 /* @ECU_Address@VHAL_RFogLampSW_flg@ */ /end MEASUREMENT
/begin MEASUREMENT VHAL_RoomLampMode_flg "" UBYTE SWC_HALIN_type_CM_boolean_flg 0 0 0.0 1.0 ECU_ADDRESS 0x0000 /* @ECU_Address@VHAL_RoomLampMode_flg@ */ /end MEASUREMENT
/begin MEASUREMENT VHAL_SOCADJBUTT_flg "" UBYTE SWC_HALIN_type_CM_boolean_flg 0 0 0.0 1.0 ECU_ADDRESS 0x0000 /* @ECU_Address@VHAL_SOCADJBUTT_flg@ */ /end MEASUREMENT
/begin MEASUREMENT VHAL_HMIZRSetTPCmd_flg "" UBYTE SWC_HALIN_type_CM_boolean_flg 0 0 0.0 1.0 ECU_ADDRESS 0x0000 /* @ECU_Address@VHAL_HMIZRSetTPCmd_flg@ */ /end MEASUREMENT
/begin MEASUREMENT VHAL_SchedChgStart_flg "" UBYTE SWC_HALIN_type_CM_boolean_flg 0 0 0.0 1.0 ECU_ADDRESS 0x0000 /* @ECU_Address@VHAL_SchedChgStart_flg@ */ /end MEASUREMENT
/begin MEASUREMENT VHAL_SchedChgStop_flg "" UBYTE SWC_HALIN_type_CM_boolean_flg 0 0 0.0 1.0 ECU_ADDRESS 0x0000 /* @ECU_Address@VHAL_SchedChgStop_flg@ */ /end MEASUREMENT
/begin MEASUREMENT VHAL_SchedChgbutt_flg "" UBYTE SWC_HALIN_type_CM_boolean_flg 0 0 0.0 1.0 ECU_ADDRESS 0x0000 /* @ECU_Address@VHAL_SchedChgbutt_flg@ */ /end MEASUREMENT
/begin MEASUREMENT VHAL_SchedChgwake_flg "" UBYTE SWC_HALIN_type_CM_boolean_flg 0 0 0.0 1.0 ECU_ADDRESS 0x0000 /* @ECU_Address@VHAL_SchedChgwake_flg@ */ /end MEASUREMENT
/begin MEASUREMENT VHAL_SetUnlockSingle_flg "" UBYTE SWC_HALIN_type_CM_boolean_flg 0 0 0.0 1.0 ECU_ADDRESS 0x0000 /* @ECU_Address@VHAL_SetUnlockSingle_flg@ */ /end MEASUREMENT
/begin MEASUREMENT VHAL_AmbLighLowBatAlertSW_flg "" UBYTE SWC_HALIN_type_CM_boolean_flg 0 0 0.0 1.0 ECU_ADDRESS 0x0000 /* @ECU_Address@VHAL_AmbLighLowBatAlertSW_flg@ */ /end MEASUREMENT
/begin MEASUREMENT VHAL_TPMSCaliButt_flg "" UBYTE SWC_HALIN_type_CM_boolean_flg 0 0 0.0 1.0 ECU_ADDRESS 0x0000 /* @ECU_Address@VHAL_TPMSCaliButt_flg@ */ /end MEASUREMENT
/begin MEASUREMENT VHAL_TPMSResButt_flg "" UBYTE SWC_HALIN_type_CM_boolean_flg 0 0 0.0 1.0 ECU_ADDRESS 0x0000 /* @ECU_Address@VHAL_TPMSResButt_flg@ */ /end MEASUREMENT
/begin MEASUREMENT VHAL_WalkawayLockSW_flg "" UBYTE SWC_HALIN_type_CM_boolean_flg 0 0 0.0 1.0 ECU_ADDRESS 0x0000 /* @ECU_Address@VHAL_WalkawayLockSW_flg@ */ /end MEASUREMENT
/begin MEASUREMENT VHAL_sigDfrstReq_flg "" UBYTE SWC_HALIN_type_CM_boolean_flg 0 0 0.0 1.0 ECU_ADDRESS 0x0000 /* @ECU_Address@VHAL_sigDfrstReq_flg@ */ /end MEASUREMENT
/begin MEASUREMENT VHAL_sigFaceReq_flg "" UBYTE SWC_HALIN_type_CM_boolean_flg 0 0 0.0 1.0 ECU_ADDRESS 0x0000 /* @ECU_Address@VHAL_sigFaceReq_flg@ */ /end MEASUREMENT
/begin MEASUREMENT VHAL_sigFootReq_flg "" UBYTE SWC_HALIN_type_CM_boolean_flg 0 0 0.0 1.0 ECU_ADDRESS 0x0000 /* @ECU_Address@VHAL_sigFootReq_flg@ */ /end MEASUREMENT
/begin MEASUREMENT VHAL_sigRecircReq_flg "" UBYTE SWC_HALIN_type_CM_boolean_flg 0 0 0.0 1.0 ECU_ADDRESS 0x0000 /* @ECU_Address@VHAL_sigRecircReq_flg@ */ /end MEASUREMENT
/begin MEASUREMENT VHAL_AmbLighSafetyAlertSW_flg "" UBYTE SWC_HALIN_type_CM_boolean_flg 0 0 0.0 1.0 ECU_ADDRESS 0x0000 /* @ECU_Address@VHAL_AmbLighSafetyAlertSW_flg@ */ /end MEASUREMENT
/begin MEASUREMENT VHAL_IVIMLFMostCmd_flg "" UBYTE SWC_HALIN_type_CM_boolean_flg 0 0 0.0 1.0 ECU_ADDRESS 0x0000 /* @ECU_Address@VHAL_IVIMLFMostCmd_flg@ */ /end MEASUREMENT
/begin MEASUREMENT VHAL_IVIMLNapModeCmd_flg "" UBYTE SWC_HALIN_type_CM_boolean_flg 0 0 0.0 1.0 ECU_ADDRESS 0x0000 /* @ECU_Address@VHAL_IVIMLNapModeCmd_flg@ */ /end MEASUREMENT
/begin MEASUREMENT VHAL_IVIMLRestoreCmd_flg "" UBYTE SWC_HALIN_type_CM_boolean_flg 0 0 0.0 1.0 ECU_ADDRESS 0x0000 /* @ECU_Address@VHAL_IVIMLRestoreCmd_flg@ */ /end MEASUREMENT
/begin MEASUREMENT VHAL_IVIMLSldRestoreCmd_flg "" UBYTE SWC_HALIN_type_CM_boolean_flg 0 0 0.0 1.0 ECU_ADDRESS 0x0000 /* @ECU_Address@VHAL_IVIMLSldRestoreCmd_flg@ */ /end MEASUREMENT
/begin MEASUREMENT VHAL_IVIMLZeroGravityCmd_flg "" UBYTE SWC_HALIN_type_CM_boolean_flg 0 0 0.0 1.0 ECU_ADDRESS 0x0000 /* @ECU_Address@VHAL_IVIMLZeroGravityCmd_flg@ */ /end MEASUREMENT
/begin MEASUREMENT VHAL_IVIMRFMostCmd_flg "" UBYTE SWC_HALIN_type_CM_boolean_flg 0 0 0.0 1.0 ECU_ADDRESS 0x0000 /* @ECU_Address@VHAL_IVIMRFMostCmd_flg@ */ /end MEASUREMENT
/begin MEASUREMENT VHAL_IVIMRNapModeCmd_flg "" UBYTE SWC_HALIN_type_CM_boolean_flg 0 0 0.0 1.0 ECU_ADDRESS 0x0000 /* @ECU_Address@VHAL_IVIMRNapModeCmd_flg@ */ /end MEASUREMENT
/begin MEASUREMENT VHAL_IVIMRRestoreCmd_flg "" UBYTE SWC_HALIN_type_CM_boolean_flg 0 0 0.0 1.0 ECU_ADDRESS 0x0000 /* @ECU_Address@VHAL_IVIMRRestoreCmd_flg@ */ /end MEASUREMENT
/begin MEASUREMENT VHAL_IVIMRSldRestoreCmd_flg "" UBYTE SWC_HALIN_type_CM_boolean_flg 0 0 0.0 1.0 ECU_ADDRESS 0x0000 /* @ECU_Address@VHAL_IVIMRSldRestoreCmd_flg@ */ /end MEASUREMENT
/begin MEASUREMENT VHAL_AmbLightDimInDarkSW_flg "" UBYTE SWC_HALIN_type_CM_boolean_flg 0 0 0.0 1.0 ECU_ADDRESS 0x0000 /* @ECU_Address@VHAL_AmbLightDimInDarkSW_flg@ */ /end MEASUREMENT
/begin MEASUREMENT VHAL_IVIMRZeroGravityCmd_flg "" UBYTE SWC_HALIN_type_CM_boolean_flg 0 0 0.0 1.0 ECU_ADDRESS 0x0000 /* @ECU_Address@VHAL_IVIMRZeroGravityCmd_flg@ */ /end MEASUREMENT
/begin MEASUREMENT VHAL_IVISnowModeCmd_flg "" UBYTE SWC_HALIN_type_CM_boolean_flg 0 0 0.0 1.0 ECU_ADDRESS 0x0000 /* @ECU_Address@VHAL_IVISnowModeCmd_flg@ */ /end MEASUREMENT
/begin MEASUREMENT VHAL_IVIUserTakeOverAPSSta_flg "" UBYTE SWC_HALIN_type_CM_boolean_flg 0 0 0.0 1.0 ECU_ADDRESS 0x0000 /* @ECU_Address@VHAL_IVIUserTakeOverAPSSta_flg@ */ /end MEASUREMENT
/begin MEASUREMENT VHAL_IVIZon1WindDirSWReqSta_flg "" UBYTE SWC_HALIN_type_CM_boolean_flg 0 0 0.0 1.0 ECU_ADDRESS 0x0000 /* @ECU_Address@VHAL_IVIZon1WindDirSWReqSta_flg@ */ /end MEASUREMENT
/begin MEASUREMENT VHAL_AmbLightSW_flg "" UBYTE SWC_HALIN_type_CM_boolean_flg 0 0 0.0 1.0 ECU_ADDRESS 0x0000 /* @ECU_Address@VHAL_AmbLightSW_flg@ */ /end MEASUREMENT
/begin MEASUREMENT VHAL_HMIACAutoBtnCmd_flg "" UBYTE SWC_HALIN_type_CM_boolean_flg 0 0 0.0 1.0 ECU_ADDRESS 0x0000 /* @ECU_Address@VHAL_HMIACAutoBtnCmd_flg@ */ /end MEASUREMENT
/begin MEASUREMENT VHAL_AmbLightWlcmLightSW_flg "" UBYTE SWC_HALIN_type_CM_boolean_flg 0 0 0.0 1.0 ECU_ADDRESS 0x0000 /* @ECU_Address@VHAL_AmbLightWlcmLightSW_flg@ */ /end MEASUREMENT
/begin MEASUREMENT VHAL_FCPFrEvtBtnACMaxReq_flg "" UBYTE SWC_HALIN_type_CM_boolean_flg 0 0 0.0 1.0 ECU_ADDRESS 0x0000 /* @ECU_Address@VHAL_FCPFrEvtBtnACMaxReq_flg@ */ /end MEASUREMENT
/begin MEASUREMENT VHAL_FCPFrEvtBtnACReq_flg "" UBYTE SWC_HALIN_type_CM_boolean_flg 0 0 0.0 1.0 ECU_ADDRESS 0x0000 /* @ECU_Address@VHAL_FCPFrEvtBtnACReq_flg@ */ /end MEASUREMENT
/begin MEASUREMENT VHAL_FCPFrEvtBtnAutoReq_flg "" UBYTE SWC_HALIN_type_CM_boolean_flg 0 0 0.0 1.0 ECU_ADDRESS 0x0000 /* @ECU_Address@VHAL_FCPFrEvtBtnAutoReq_flg@ */ /end MEASUREMENT
/begin MEASUREMENT VHAL_FCPFrEvtBtnSyncReq_flg "" UBYTE SWC_HALIN_type_CM_boolean_flg 0 0 0.0 1.0 ECU_ADDRESS 0x0000 /* @ECU_Address@VHAL_FCPFrEvtBtnSyncReq_flg@ */ /end MEASUREMENT
/begin MEASUREMENT VHAL_IVIAutoWipHSpdSWCmd_flg "" UBYTE SWC_HALIN_type_CM_boolean_flg 0 0 0.0 1.0 ECU_ADDRESS 0x0000 /* @ECU_Address@VHAL_IVIAutoWipHSpdSWCmd_flg@ */ /end MEASUREMENT
/begin MEASUREMENT VHAL_IVICLWinLockDoorSWSta_flg "" UBYTE SWC_HALIN_type_CM_boolean_flg 0 0 0.0 1.0 ECU_ADDRESS 0x0000 /* @ECU_Address@VHAL_IVICLWinLockDoorSWSta_flg@ */ /end MEASUREMENT
/begin MEASUREMENT VHAL_IVIDrivingLockSWSta_flg "" UBYTE SWC_HALIN_type_CM_boolean_flg 0 0 0.0 1.0 ECU_ADDRESS 0x0000 /* @ECU_Address@VHAL_IVIDrivingLockSWSta_flg@ */ /end MEASUREMENT
/begin MEASUREMENT VHAL_HMIACBtnCmd_flg "" UBYTE SWC_HALIN_type_CM_boolean_flg 0 0 0.0 1.0 ECU_ADDRESS 0x0000 /* @ECU_Address@VHAL_HMIACBtnCmd_flg@ */ /end MEASUREMENT
/begin MEASUREMENT VHAL_IVIFrTrunkUnlockReqSta_flg "" UBYTE SWC_HALIN_type_CM_boolean_flg 0 0 0.0 1.0 ECU_ADDRESS 0x0000 /* @ECU_Address@VHAL_IVIFrTrunkUnlockReqSta_flg@ */ /end MEASUREMENT
/begin MEASUREMENT VHAL_IVILinkAccReqSta_flg "" UBYTE SWC_HALIN_type_CM_boolean_flg 0 0 0.0 1.0 ECU_ADDRESS 0x0000 /* @ECU_Address@VHAL_IVILinkAccReqSta_flg@ */ /end MEASUREMENT
/begin MEASUREMENT VHAL_IVILockSoundSWSta_flg "" UBYTE SWC_HALIN_type_CM_boolean_flg 0 0 0.0 1.0 ECU_ADDRESS 0x0000 /* @ECU_Address@VHAL_IVILockSoundSWSta_flg@ */ /end MEASUREMENT
/begin MEASUREMENT VHAL_IVIMirrorFoldedSWSta_flg "" UBYTE SWC_HALIN_type_CM_boolean_flg 0 0 0.0 1.0 ECU_ADDRESS 0x0000 /* @ECU_Address@VHAL_IVIMirrorFoldedSWSta_flg@ */ /end MEASUREMENT
/begin MEASUREMENT VHAL_IVISilentChrgAlertSta_flg "" UBYTE SWC_HALIN_type_CM_boolean_flg 0 0 0.0 1.0 ECU_ADDRESS 0x0000 /* @ECU_Address@VHAL_IVISilentChrgAlertSta_flg@ */ /end MEASUREMENT
/begin MEASUREMENT VHAL_HMIACFrDefogBtnCmd_flg "" UBYTE SWC_HALIN_type_CM_boolean_flg 0 0 0.0 1.0 ECU_ADDRESS 0x0000 /* @ECU_Address@VHAL_HMIACFrDefogBtnCmd_flg@ */ /end MEASUREMENT
/begin MEASUREMENT VHAL_IVIStoppingUnlockSWSta_flg "" UBYTE SWC_HALIN_type_CM_boolean_flg 0 0 0.0 1.0 ECU_ADDRESS 0x0000 /* @ECU_Address@VHAL_IVIStoppingUnlockSWSta_flg@ */ /end MEASUREMENT
/begin MEASUREMENT VHAL_IVIWPTCSWSta_flg "" UBYTE SWC_HALIN_type_CM_boolean_flg 0 0 0.0 1.0 ECU_ADDRESS 0x0000 /* @ECU_Address@VHAL_IVIWPTCSWSta_flg@ */ /end MEASUREMENT
/begin MEASUREMENT VHAL_IVIsigScreenReqSta_flg "" UBYTE SWC_HALIN_type_CM_boolean_flg 0 0 0.0 1.0 ECU_ADDRESS 0x0000 /* @ECU_Address@VHAL_IVIsigScreenReqSta_flg@ */ /end MEASUREMENT
/begin MEASUREMENT VHAL_HMIACRecycleBtnCmd_flg "" UBYTE SWC_HALIN_type_CM_boolean_flg 0 0 0.0 1.0 ECU_ADDRESS 0x0000 /* @ECU_Address@VHAL_HMIACRecycleBtnCmd_flg@ */ /end MEASUREMENT
/begin MEASUREMENT VHAL_LINKtoDrive_flg "" UBYTE SWC_HALIN_type_CM_boolean_flg 0 0 0.0 1.0 ECU_ADDRESS 0x0000 /* @ECU_Address@VHAL_LINKtoDrive_flg@ */ /end MEASUREMENT
/begin MEASUREMENT VHAL_OpenDrOpenWdoSW_flg "" UBYTE SWC_HALIN_type_CM_boolean_flg 0 0 0.0 1.0 ECU_ADDRESS 0x0000 /* @ECU_Address@VHAL_OpenDrOpenWdoSW_flg@ */ /end MEASUREMENT
/begin MEASUREMENT VHAL_PWCONTINUEUSE_flg "" UBYTE SWC_HALIN_type_CM_boolean_flg 0 0 0.0 1.0 ECU_ADDRESS 0x0000 /* @ECU_Address@VHAL_PWCONTINUEUSE_flg@ */ /end MEASUREMENT
/begin MEASUREMENT VHAL_SmartEcoModeSW_flg "" UBYTE SWC_HALIN_type_CM_boolean_flg 0 0 0.0 1.0 ECU_ADDRESS 0x0000 /* @ECU_Address@VHAL_SmartEcoModeSW_flg@ */ /end MEASUREMENT
/begin MEASUREMENT VHAL_AVMErrSTA_flg "" UBYTE SWC_HALIN_type_CM_boolean_flg 0 0 0.0 1.0 ECU_ADDRESS 0x0000 /* @ECU_Address@VHAL_AVMErrSTA_flg@ */ /end MEASUREMENT
/begin MEASUREMENT VHAL_AVMOFFRecButt_flg "" UBYTE SWC_HALIN_type_CM_boolean_flg 0 0 0.0 1.0 ECU_ADDRESS 0x0000 /* @ECU_Address@VHAL_AVMOFFRecButt_flg@ */ /end MEASUREMENT
/begin MEASUREMENT VHAL_HMIACWindDirMCmd_flg "" UBYTE SWC_HALIN_type_CM_boolean_flg 0 0 0.0 1.0 ECU_ADDRESS 0x0000 /* @ECU_Address@VHAL_HMIACWindDirMCmd_flg@ */ /end MEASUREMENT
/begin MEASUREMENT VHAL_ApproachUnlockSW_flg "" UBYTE SWC_HALIN_type_CM_boolean_flg 0 0 0.0 1.0 ECU_ADDRESS 0x0000 /* @ECU_Address@VHAL_ApproachUnlockSW_flg@ */ /end MEASUREMENT
/begin MEASUREMENT VHAL_CDLLockButt_flg "" UBYTE SWC_HALIN_type_CM_boolean_flg 0 0 0.0 1.0 ECU_ADDRESS 0x0000 /* @ECU_Address@VHAL_CDLLockButt_flg@ */ /end MEASUREMENT
/begin MEASUREMENT VHAL_CDLUnlockButt_flg "" UBYTE SWC_HALIN_type_CM_boolean_flg 0 0 0.0 1.0 ECU_ADDRESS 0x0000 /* @ECU_Address@VHAL_CDLUnlockButt_flg@ */ /end MEASUREMENT
/begin MEASUREMENT VHAL_DSEATantiset_flg "" UBYTE SWC_HALIN_type_CM_boolean_flg 0 0 0.0 1.0 ECU_ADDRESS 0x0000 /* @ECU_Address@VHAL_DSEATantiset_flg@ */ /end MEASUREMENT
/begin MEASUREMENT VHAL_DSEATentryfunset_flg "" UBYTE SWC_HALIN_type_CM_boolean_flg 0 0 0.0 1.0 ECU_ADDRESS 0x0000 /* @ECU_Address@VHAL_DSEATentryfunset_flg@ */ /end MEASUREMENT
/begin MEASUREMENT VHAL_Distanceunit_flg "" UBYTE SWC_HALIN_type_CM_boolean_flg 0 0 0.0 1.0 ECU_ADDRESS 0x0000 /* @ECU_Address@VHAL_Distanceunit_flg@ */ /end MEASUREMENT
/begin MEASUREMENT VHAL_HMIACWindDirPCmd_flg "" UBYTE SWC_HALIN_type_CM_boolean_flg 0 0 0.0 1.0 ECU_ADDRESS 0x0000 /* @ECU_Address@VHAL_HMIACWindDirPCmd_flg@ */ /end MEASUREMENT
/begin MEASUREMENT VHAL_FollowMeSW_flg "" UBYTE SWC_HALIN_type_CM_boolean_flg 0 0 0.0 1.0 ECU_ADDRESS 0x0000 /* @ECU_Address@VHAL_FollowMeSW_flg@ */ /end MEASUREMENT
/begin MEASUREMENT VHAL_IVIACCAdaptiveSta_flg "" UBYTE SWC_HALIN_type_CM_boolean_flg 0 0 0.0 1.0 ECU_ADDRESS 0x0000 /* @ECU_Address@VHAL_IVIACCAdaptiveSta_flg@ */ /end MEASUREMENT
/begin MEASUREMENT VHAL_IVICarWashModeCmd_flg "" UBYTE SWC_HALIN_type_CM_boolean_flg 0 0 0.0 1.0 ECU_ADDRESS 0x0000 /* @ECU_Address@VHAL_IVICarWashModeCmd_flg@ */ /end MEASUREMENT
/begin MEASUREMENT VHAL_IVIChargePortSWSta_flg "" UBYTE SWC_HALIN_type_CM_boolean_flg 0 0 0.0 1.0 ECU_ADDRESS 0x0000 /* @ECU_Address@VHAL_IVIChargePortSWSta_flg@ */ /end MEASUREMENT
/begin MEASUREMENT VHAL_HMIAutoInterLightCmd_flg "" UBYTE SWC_HALIN_type_CM_boolean_flg 0 0 0.0 1.0 ECU_ADDRESS 0x0000 /* @ECU_Address@VHAL_HMIAutoInterLightCmd_flg@ */ /end MEASUREMENT
/begin MEASUREMENT VHAL_IVICreepSWReq_flg "" UBYTE SWC_HALIN_type_CM_boolean_flg 0 0 0.0 1.0 ECU_ADDRESS 0x0000 /* @ECU_Address@VHAL_IVICreepSWReq_flg@ */ /end MEASUREMENT
/begin MEASUREMENT VHAL_IVIDSEATMemory1Sta_flg "" UBYTE SWC_HALIN_type_CM_boolean_flg 0 0 0.0 1.0 ECU_ADDRESS 0x0000 /* @ECU_Address@VHAL_IVIDSEATMemory1Sta_flg@ */ /end MEASUREMENT
/begin MEASUREMENT VHAL_IVIDSEATMemory2Sta_flg "" UBYTE SWC_HALIN_type_CM_boolean_flg 0 0 0.0 1.0 ECU_ADDRESS 0x0000 /* @ECU_Address@VHAL_IVIDSEATMemory2Sta_flg@ */ /end MEASUREMENT
/begin MEASUREMENT VHAL_IVIDSEATMemoryOPTCLSSta_flg "" UBYTE SWC_HALIN_type_CM_boolean_flg 0 0 0.0 1.0 ECU_ADDRESS 0x0000 /* @ECU_Address@VHAL_IVIDSEATMemoryOPTCLSSta_flg@ */ /end MEASUREMENT
/begin MEASUREMENT VHAL_HMIBCMPostDefogBtnCmd_flg "" UBYTE SWC_HALIN_type_CM_boolean_flg 0 0 0.0 1.0 ECU_ADDRESS 0x0000 /* @ECU_Address@VHAL_HMIBCMPostDefogBtnCmd_flg@ */ /end MEASUREMENT
/begin MEASUREMENT VHAL_IVIIONSWCmd_flg "" UBYTE SWC_HALIN_type_CM_boolean_flg 0 0 0.0 1.0 ECU_ADDRESS 0x0000 /* @ECU_Address@VHAL_IVIIONSWCmd_flg@ */ /end MEASUREMENT
/begin MEASUREMENT VHAL_IVINightModeSta_flg "" UBYTE SWC_HALIN_type_CM_boolean_flg 0 0 0.0 1.0 ECU_ADDRESS 0x0000 /* @ECU_Address@VHAL_IVINightModeSta_flg@ */ /end MEASUREMENT
/begin MEASUREMENT VHAL_CANMsgInvalidHMI1_flg "" UBYTE SWC_HALIN_type_CM_boolean_flg 0 0 0.0 1.0 ECU_ADDRESS 0x0000 /* @ECU_Address@VHAL_CANMsgInvalidHMI1_flg@ */ /end MEASUREMENT
/begin MEASUREMENT VHAL_CANMsgInvalidIVI1_flg "" UBYTE SWC_HALIN_type_CM_boolean_flg 0 0 0.0 1.0 ECU_ADDRESS 0x0000 /* @ECU_Address@VHAL_CANMsgInvalidIVI1_flg@ */ /end MEASUREMENT
/begin MEASUREMENT VHAL_CANMsgInvalidIVI2_flg "" UBYTE SWC_HALIN_type_CM_boolean_flg 0 0 0.0 1.0 ECU_ADDRESS 0x0000 /* @ECU_Address@VHAL_CANMsgInvalidIVI2_flg@ */ /end MEASUREMENT
/begin MEASUREMENT VHAL_CANMsgInvalidIVI3_flg "" UBYTE SWC_HALIN_type_CM_boolean_flg 0 0 0.0 1.0 ECU_ADDRESS 0x0000 /* @ECU_Address@VHAL_CANMsgInvalidIVI3_flg@ */ /end MEASUREMENT
/begin MEASUREMENT VHAL_CANMsgInvalidMETER1_flg "" UBYTE SWC_HALIN_type_CM_boolean_flg 0 0 0.0 1.0 ECU_ADDRESS 0x0000 /* @ECU_Address@VHAL_CANMsgInvalidMETER1_flg@ */ /end MEASUREMENT
/begin MEASUREMENT VHAL_FrActvDmpDisabSta_flg "" UBYTE SWC_HALIN_type_CM_boolean_flg 0 0 0.0 1.0 ECU_ADDRESS 0x0000 /* @ECU_Address@VHAL_FrActvDmpDisabSta_flg@ */ /end MEASUREMENT
/begin MEASUREMENT VHAL_FrEDUDrtSta_flg "" UBYTE SWC_HALIN_type_CM_boolean_flg 0 0 0.0 1.0 ECU_ADDRESS 0x0000 /* @ECU_Address@VHAL_FrEDUDrtSta_flg@ */ /end MEASUREMENT
/begin MEASUREMENT VHAL_FrEDUOpratingSta_flg "" UBYTE SWC_HALIN_type_CM_boolean_flg 0 0 0.0 1.0 ECU_ADDRESS 0x0000 /* @ECU_Address@VHAL_FrEDUOpratingSta_flg@ */ /end MEASUREMENT
/begin MEASUREMENT VHAL_FrMCUDischrgSta_flg "" UBYTE SWC_HALIN_type_CM_boolean_flg 0 0 0.0 1.0 ECU_ADDRESS 0x0000 /* @ECU_Address@VHAL_FrMCUDischrgSta_flg@ */ /end MEASUREMENT
/begin MEASUREMENT VHAL_FrMCUEnaSta_flg "" UBYTE SWC_HALIN_type_CM_boolean_flg 0 0 0.0 1.0 ECU_ADDRESS 0x0000 /* @ECU_Address@VHAL_FrMCUEnaSta_flg@ */ /end MEASUREMENT
/begin MEASUREMENT VHAL_FrMCUIGNsta_flg "" UBYTE SWC_HALIN_type_CM_boolean_flg 0 0 0.0 1.0 ECU_ADDRESS 0x0000 /* @ECU_Address@VHAL_FrMCUIGNsta_flg@ */ /end MEASUREMENT
/begin MEASUREMENT VHAL_FrMCUReady_flg "" UBYTE SWC_HALIN_type_CM_boolean_flg 0 0 0.0 1.0 ECU_ADDRESS 0x0000 /* @ECU_Address@VHAL_FrMCUReady_flg@ */ /end MEASUREMENT
/begin MEASUREMENT VHAL_FrMCUReady4Pre_flg "" UBYTE SWC_HALIN_type_CM_boolean_flg 0 0 0.0 1.0 ECU_ADDRESS 0x0000 /* @ECU_Address@VHAL_FrMCUReady4Pre_flg@ */ /end MEASUREMENT
/begin MEASUREMENT VHAL_FireDetErr_flg "" UBYTE SWC_HALIN_type_CM_boolean_flg 0 0 0.0 1.0 ECU_ADDRESS 0x0000 /* @ECU_Address@VHAL_FireDetErr_flg@ */ /end MEASUREMENT
/begin MEASUREMENT VHAL_RrActvDmpDisabSta_flg "" UBYTE SWC_HALIN_type_CM_boolean_flg 0 0 0.0 1.0 ECU_ADDRESS 0x0000 /* @ECU_Address@VHAL_RrActvDmpDisabSta_flg@ */ /end MEASUREMENT
/begin MEASUREMENT VHAL_RrEDUDrtSta_flg "" UBYTE SWC_HALIN_type_CM_boolean_flg 0 0 0.0 1.0 ECU_ADDRESS 0x0000 /* @ECU_Address@VHAL_RrEDUDrtSta_flg@ */ /end MEASUREMENT
/begin MEASUREMENT VHAL_RrEDUOpratingSta_flg "" UBYTE SWC_HALIN_type_CM_boolean_flg 0 0 0.0 1.0 ECU_ADDRESS 0x0000 /* @ECU_Address@VHAL_RrEDUOpratingSta_flg@ */ /end MEASUREMENT
/begin MEASUREMENT VHAL_RrMCUDischrgSta_flg "" UBYTE SWC_HALIN_type_CM_boolean_flg 0 0 0.0 1.0 ECU_ADDRESS 0x0000 /* @ECU_Address@VHAL_RrMCUDischrgSta_flg@ */ /end MEASUREMENT
/begin MEASUREMENT VHAL_RrMCUEnaSta_flg "" UBYTE SWC_HALIN_type_CM_boolean_flg 0 0 0.0 1.0 ECU_ADDRESS 0x0000 /* @ECU_Address@VHAL_RrMCUEnaSta_flg@ */ /end MEASUREMENT
/begin MEASUREMENT VHAL_RrMCUIGNsta_flg "" UBYTE SWC_HALIN_type_CM_boolean_flg 0 0 0.0 1.0 ECU_ADDRESS 0x0000 /* @ECU_Address@VHAL_RrMCUIGNsta_flg@ */ /end MEASUREMENT
/begin MEASUREMENT VHAL_RrMCUReady_flg "" UBYTE SWC_HALIN_type_CM_boolean_flg 0 0 0.0 1.0 ECU_ADDRESS 0x0000 /* @ECU_Address@VHAL_RrMCUReady_flg@ */ /end MEASUREMENT
/begin MEASUREMENT VHAL_RrMCUReady4Pre_flg "" UBYTE SWC_HALIN_type_CM_boolean_flg 0 0 0.0 1.0 ECU_ADDRESS 0x0000 /* @ECU_Address@VHAL_RrMCUReady4Pre_flg@ */ /end MEASUREMENT
/begin MEASUREMENT VHAL_FrActvDmpDisabStaNidec_flg "" UBYTE SWC_HALIN_type_CM_boolean_flg 0 0 0.0 1.0 ECU_ADDRESS 0x0000 /* @ECU_Address@VHAL_FrActvDmpDisabStaNidec_flg@ */ /end MEASUREMENT
/begin MEASUREMENT VHAL_FrEDUDrtStaNidec_flg "" UBYTE SWC_HALIN_type_CM_boolean_flg 0 0 0.0 1.0 ECU_ADDRESS 0x0000 /* @ECU_Address@VHAL_FrEDUDrtStaNidec_flg@ */ /end MEASUREMENT
/begin MEASUREMENT VHAL_FrEDUOpratingStaNidec_flg "" UBYTE SWC_HALIN_type_CM_boolean_flg 0 0 0.0 1.0 ECU_ADDRESS 0x0000 /* @ECU_Address@VHAL_FrEDUOpratingStaNidec_flg@ */ /end MEASUREMENT
/begin MEASUREMENT VHAL_FrMCUDischrgStaNidec_flg "" UBYTE SWC_HALIN_type_CM_boolean_flg 0 0 0.0 1.0 ECU_ADDRESS 0x0000 /* @ECU_Address@VHAL_FrMCUDischrgStaNidec_flg@ */ /end MEASUREMENT
/begin MEASUREMENT VHAL_FrMCUEnaStaNidec_flg "" UBYTE SWC_HALIN_type_CM_boolean_flg 0 0 0.0 1.0 ECU_ADDRESS 0x0000 /* @ECU_Address@VHAL_FrMCUEnaStaNidec_flg@ */ /end MEASUREMENT
/begin MEASUREMENT VHAL_FrMCUIGNstaNidec_flg "" UBYTE SWC_HALIN_type_CM_boolean_flg 0 0 0.0 1.0 ECU_ADDRESS 0x0000 /* @ECU_Address@VHAL_FrMCUIGNstaNidec_flg@ */ /end MEASUREMENT
/begin MEASUREMENT VHAL_FrMCUReady4PreNidec_flg "" UBYTE SWC_HALIN_type_CM_boolean_flg 0 0 0.0 1.0 ECU_ADDRESS 0x0000 /* @ECU_Address@VHAL_FrMCUReady4PreNidec_flg@ */ /end MEASUREMENT
/begin MEASUREMENT VHAL_FrMCUReadyNidec_flg "" UBYTE SWC_HALIN_type_CM_boolean_flg 0 0 0.0 1.0 ECU_ADDRESS 0x0000 /* @ECU_Address@VHAL_FrMCUReadyNidec_flg@ */ /end MEASUREMENT
/begin MEASUREMENT VHAL_HVBattErr_flg "" UBYTE SWC_HALIN_type_CM_boolean_flg 0 0 0.0 1.0 ECU_ADDRESS 0x0000 /* @ECU_Address@VHAL_HVBattErr_flg@ */ /end MEASUREMENT
/begin MEASUREMENT VHAL_RrActvDmpDisabStaNidec_flg "" UBYTE SWC_HALIN_type_CM_boolean_flg 0 0 0.0 1.0 ECU_ADDRESS 0x0000 /* @ECU_Address@VHAL_RrActvDmpDisabStaNidec_flg@ */ /end MEASUREMENT
/begin MEASUREMENT VHAL_RrEDUDrtStaNidec_flg "" UBYTE SWC_HALIN_type_CM_boolean_flg 0 0 0.0 1.0 ECU_ADDRESS 0x0000 /* @ECU_Address@VHAL_RrEDUDrtStaNidec_flg@ */ /end MEASUREMENT
/begin MEASUREMENT VHAL_RrEDUOpratingStaNidec_flg "" UBYTE SWC_HALIN_type_CM_boolean_flg 0 0 0.0 1.0 ECU_ADDRESS 0x0000 /* @ECU_Address@VHAL_RrEDUOpratingStaNidec_flg@ */ /end MEASUREMENT
/begin MEASUREMENT VHAL_RrMCUDischrgStaNidec_flg "" UBYTE SWC_HALIN_type_CM_boolean_flg 0 0 0.0 1.0 ECU_ADDRESS 0x0000 /* @ECU_Address@VHAL_RrMCUDischrgStaNidec_flg@ */ /end MEASUREMENT
/begin MEASUREMENT VHAL_RrMCUEnaStaNidec_flg "" UBYTE SWC_HALIN_type_CM_boolean_flg 0 0 0.0 1.0 ECU_ADDRESS 0x0000 /* @ECU_Address@VHAL_RrMCUEnaStaNidec_flg@ */ /end MEASUREMENT
/begin MEASUREMENT VHAL_RrMCUIGNstaNidec_flg "" UBYTE SWC_HALIN_type_CM_boolean_flg 0 0 0.0 1.0 ECU_ADDRESS 0x0000 /* @ECU_Address@VHAL_RrMCUIGNstaNidec_flg@ */ /end MEASUREMENT
/begin MEASUREMENT VHAL_RrMCUReady4PreNidec_flg "" UBYTE SWC_HALIN_type_CM_boolean_flg 0 0 0.0 1.0 ECU_ADDRESS 0x0000 /* @ECU_Address@VHAL_RrMCUReady4PreNidec_flg@ */ /end MEASUREMENT
/begin MEASUREMENT VHAL_RrMCUReadyNidec_flg "" UBYTE SWC_HALIN_type_CM_boolean_flg 0 0 0.0 1.0 ECU_ADDRESS 0x0000 /* @ECU_Address@VHAL_RrMCUReadyNidec_flg@ */ /end MEASUREMENT
/begin MEASUREMENT VHAL_CSW2DimSwSta_flg "" UBYTE SWC_HALIN_type_CM_boolean_flg 0 0 0.0 1.0 ECU_ADDRESS 0x0000 /* @ECU_Address@VHAL_CSW2DimSwSta_flg@ */ /end MEASUREMENT
/begin MEASUREMENT VHAL_CSW2PassSWSta_flg "" UBYTE SWC_HALIN_type_CM_boolean_flg 0 0 0.0 1.0 ECU_ADDRESS 0x0000 /* @ECU_Address@VHAL_CSW2PassSWSta_flg@ */ /end MEASUREMENT
/begin MEASUREMENT VHAL_BMSREADY_flg "" UBYTE SWC_HALIN_type_CM_boolean_flg 0 0 0.0 1.0 ECU_ADDRESS 0x0000 /* @ECU_Address@VHAL_BMSREADY_flg@ */ /end MEASUREMENT
/begin MEASUREMENT VHAL_BMSWarn1_flg "" UBYTE SWC_HALIN_type_CM_boolean_flg 0 0 0.0 1.0 ECU_ADDRESS 0x0000 /* @ECU_Address@VHAL_BMSWarn1_flg@ */ /end MEASUREMENT
/begin MEASUREMENT VHAL_BMSWarn2_flg "" UBYTE SWC_HALIN_type_CM_boolean_flg 0 0 0.0 1.0 ECU_ADDRESS 0x0000 /* @ECU_Address@VHAL_BMSWarn2_flg@ */ /end MEASUREMENT
/begin MEASUREMENT VHAL_BMSWarn3_flg "" UBYTE SWC_HALIN_type_CM_boolean_flg 0 0 0.0 1.0 ECU_ADDRESS 0x0000 /* @ECU_Address@VHAL_BMSWarn3_flg@ */ /end MEASUREMENT
/begin MEASUREMENT VHAL_BMSWarn4_flg "" UBYTE SWC_HALIN_type_CM_boolean_flg 0 0 0.0 1.0 ECU_ADDRESS 0x0000 /* @ECU_Address@VHAL_BMSWarn4_flg@ */ /end MEASUREMENT
/begin MEASUREMENT VHAL_BMSWarn5_flg "" UBYTE SWC_HALIN_type_CM_boolean_flg 0 0 0.0 1.0 ECU_ADDRESS 0x0000 /* @ECU_Address@VHAL_BMSWarn5_flg@ */ /end MEASUREMENT
/begin MEASUREMENT VHAL_BMSWarn6_flg "" UBYTE SWC_HALIN_type_CM_boolean_flg 0 0 0.0 1.0 ECU_ADDRESS 0x0000 /* @ECU_Address@VHAL_BMSWarn6_flg@ */ /end MEASUREMENT
/begin MEASUREMENT VHAL_BMSWarn7_flg "" UBYTE SWC_HALIN_type_CM_boolean_flg 0 0 0.0 1.0 ECU_ADDRESS 0x0000 /* @ECU_Address@VHAL_BMSWarn7_flg@ */ /end MEASUREMENT
/begin MEASUREMENT VHAL_BMSWarn8_flg "" UBYTE SWC_HALIN_type_CM_boolean_flg 0 0 0.0 1.0 ECU_ADDRESS 0x0000 /* @ECU_Address@VHAL_BMSWarn8_flg@ */ /end MEASUREMENT
/begin MEASUREMENT VHAL_HVBContactorSta_flg "" UBYTE SWC_HALIN_type_CM_boolean_flg 0 0 0.0 1.0 ECU_ADDRESS 0x0000 /* @ECU_Address@VHAL_HVBContactorSta_flg@ */ /end MEASUREMENT
/begin MEASUREMENT VHAL_HVBHVILErr_flg "" UBYTE SWC_HALIN_type_CM_boolean_flg 0 0 0.0 1.0 ECU_ADDRESS 0x0000 /* @ECU_Address@VHAL_HVBHVILErr_flg@ */ /end MEASUREMENT
/begin MEASUREMENT VHAL_HVBOvrTempErr_flg "" UBYTE SWC_HALIN_type_CM_boolean_flg 0 0 0.0 1.0 ECU_ADDRESS 0x0000 /* @ECU_Address@VHAL_HVBOvrTempErr_flg@ */ /end MEASUREMENT
/begin MEASUREMENT VHAL_HVILSta_flg "" UBYTE SWC_HALIN_type_CM_boolean_flg 0 0 0.0 1.0 ECU_ADDRESS 0x0000 /* @ECU_Address@VHAL_HVILSta_flg@ */ /end MEASUREMENT
/begin MEASUREMENT VHAL_OBCWakeup4Plugin_flg "" UBYTE SWC_HALIN_type_CM_boolean_flg 0 0 0.0 1.0 ECU_ADDRESS 0x0000 /* @ECU_Address@VHAL_OBCWakeup4Plugin_flg@ */ /end MEASUREMENT
/begin MEASUREMENT VHAL_DCDCEnaSta_flg "" UBYTE SWC_HALIN_type_CM_boolean_flg 0 0 0.0 1.0 ECU_ADDRESS 0x0000 /* @ECU_Address@VHAL_DCDCEnaSta_flg@ */ /end MEASUREMENT
/begin MEASUREMENT VHAL_DCDCReady4Pre_flg "" UBYTE SWC_HALIN_type_CM_boolean_flg 0 0 0.0 1.0 ECU_ADDRESS 0x0000 /* @ECU_Address@VHAL_DCDCReady4Pre_flg@ */ /end MEASUREMENT
/begin MEASUREMENT VHAL_OBCEnaSta_flg "" UBYTE SWC_HALIN_type_CM_boolean_flg 0 0 0.0 1.0 ECU_ADDRESS 0x0000 /* @ECU_Address@VHAL_OBCEnaSta_flg@ */ /end MEASUREMENT
/begin MEASUREMENT VHAL_OBCPluginSta_flg "" UBYTE SWC_HALIN_type_CM_boolean_flg 0 0 0.0 1.0 ECU_ADDRESS 0x0000 /* @ECU_Address@VHAL_OBCPluginSta_flg@ */ /end MEASUREMENT
/begin MEASUREMENT VHAL_OBCReady4Pre_flg "" UBYTE SWC_HALIN_type_CM_boolean_flg 0 0 0.0 1.0 ECU_ADDRESS 0x0000 /* @ECU_Address@VHAL_OBCReady4Pre_flg@ */ /end MEASUREMENT
/begin MEASUREMENT VHAL_CANMsgInvalidBMS1_flg "" UBYTE SWC_HALIN_type_CM_boolean_flg 0 0 0.0 1.0 ECU_ADDRESS 0x0000 /* @ECU_Address@VHAL_CANMsgInvalidBMS1_flg@ */ /end MEASUREMENT
/begin MEASUREMENT VHAL_CANMsgInvalidBMS3_flg "" UBYTE SWC_HALIN_type_CM_boolean_flg 0 0 0.0 1.0 ECU_ADDRESS 0x0000 /* @ECU_Address@VHAL_CANMsgInvalidBMS3_flg@ */ /end MEASUREMENT
/begin MEASUREMENT VHAL_CANMsgInvalidBMS4_flg "" UBYTE SWC_HALIN_type_CM_boolean_flg 0 0 0.0 1.0 ECU_ADDRESS 0x0000 /* @ECU_Address@VHAL_CANMsgInvalidBMS4_flg@ */ /end MEASUREMENT
/begin MEASUREMENT VHAL_CANMsgInvalidBMS5_flg "" UBYTE SWC_HALIN_type_CM_boolean_flg 0 0 0.0 1.0 ECU_ADDRESS 0x0000 /* @ECU_Address@VHAL_CANMsgInvalidBMS5_flg@ */ /end MEASUREMENT
/begin MEASUREMENT VHAL_CANMsgInvalidBMS6_flg "" UBYTE SWC_HALIN_type_CM_boolean_flg 0 0 0.0 1.0 ECU_ADDRESS 0x0000 /* @ECU_Address@VHAL_CANMsgInvalidBMS6_flg@ */ /end MEASUREMENT
/begin MEASUREMENT VHAL_CANMsgInvalidBMS8_flg "" UBYTE SWC_HALIN_type_CM_boolean_flg 0 0 0.0 1.0 ECU_ADDRESS 0x0000 /* @ECU_Address@VHAL_CANMsgInvalidBMS8_flg@ */ /end MEASUREMENT
/begin MEASUREMENT VHAL_CANMsgInvalidCCU1_flg "" UBYTE SWC_HALIN_type_CM_boolean_flg 0 0 0.0 1.0 ECU_ADDRESS 0x0000 /* @ECU_Address@VHAL_CANMsgInvalidCCU1_flg@ */ /end MEASUREMENT
/begin MEASUREMENT VHAL_CANMsgInvalidCCU2_flg "" UBYTE SWC_HALIN_type_CM_boolean_flg 0 0 0.0 1.0 ECU_ADDRESS 0x0000 /* @ECU_Address@VHAL_CANMsgInvalidCCU2_flg@ */ /end MEASUREMENT
/begin MEASUREMENT VHAL_CANMsgInvalidEBM1_flg "" UBYTE SWC_HALIN_type_CM_boolean_flg 0 0 0.0 1.0 ECU_ADDRESS 0x0000 /* @ECU_Address@VHAL_CANMsgInvalidEBM1_flg@ */ /end MEASUREMENT
/begin MEASUREMENT VHAL_CANMsgInvalidMCUBF1_flg "" UBYTE SWC_HALIN_type_CM_boolean_flg 0 0 0.0 1.0 ECU_ADDRESS 0x0000 /* @ECU_Address@VHAL_CANMsgInvalidMCUBF1_flg@ */ /end MEASUREMENT
/begin MEASUREMENT VHAL_CANMsgInvalidMCUBF2_flg "" UBYTE SWC_HALIN_type_CM_boolean_flg 0 0 0.0 1.0 ECU_ADDRESS 0x0000 /* @ECU_Address@VHAL_CANMsgInvalidMCUBF2_flg@ */ /end MEASUREMENT
/begin MEASUREMENT VHAL_CANMsgInvalidMCUBR1_flg "" UBYTE SWC_HALIN_type_CM_boolean_flg 0 0 0.0 1.0 ECU_ADDRESS 0x0000 /* @ECU_Address@VHAL_CANMsgInvalidMCUBR1_flg@ */ /end MEASUREMENT
/begin MEASUREMENT VHAL_CANMsgInvalidMCUBR2_flg "" UBYTE SWC_HALIN_type_CM_boolean_flg 0 0 0.0 1.0 ECU_ADDRESS 0x0000 /* @ECU_Address@VHAL_CANMsgInvalidMCUBR2_flg@ */ /end MEASUREMENT
/begin MEASUREMENT VHAL_CANMsgInvalidMCUNF1_flg "" UBYTE SWC_HALIN_type_CM_boolean_flg 0 0 0.0 1.0 ECU_ADDRESS 0x0000 /* @ECU_Address@VHAL_CANMsgInvalidMCUNF1_flg@ */ /end MEASUREMENT
/begin MEASUREMENT VHAL_CANMsgInvalidMCUNF2_flg "" UBYTE SWC_HALIN_type_CM_boolean_flg 0 0 0.0 1.0 ECU_ADDRESS 0x0000 /* @ECU_Address@VHAL_CANMsgInvalidMCUNF2_flg@ */ /end MEASUREMENT
/begin MEASUREMENT VHAL_CANMsgInvalidMCUNF3_flg "" UBYTE SWC_HALIN_type_CM_boolean_flg 0 0 0.0 1.0 ECU_ADDRESS 0x0000 /* @ECU_Address@VHAL_CANMsgInvalidMCUNF3_flg@ */ /end MEASUREMENT
/begin MEASUREMENT VHAL_CANMsgInvalidMCUNR1_flg "" UBYTE SWC_HALIN_type_CM_boolean_flg 0 0 0.0 1.0 ECU_ADDRESS 0x0000 /* @ECU_Address@VHAL_CANMsgInvalidMCUNR1_flg@ */ /end MEASUREMENT
/begin MEASUREMENT VHAL_CANMsgInvalidMCUNR2_flg "" UBYTE SWC_HALIN_type_CM_boolean_flg 0 0 0.0 1.0 ECU_ADDRESS 0x0000 /* @ECU_Address@VHAL_CANMsgInvalidMCUNR2_flg@ */ /end MEASUREMENT
/begin MEASUREMENT VHAL_CANMsgInvalidMCUNR3_flg "" UBYTE SWC_HALIN_type_CM_boolean_flg 0 0 0.0 1.0 ECU_ADDRESS 0x0000 /* @ECU_Address@VHAL_CANMsgInvalidMCUNR3_flg@ */ /end MEASUREMENT
/begin MEASUREMENT VHAL_CANMsgInvalidShifter1_flg "" UBYTE SWC_HALIN_type_CM_boolean_flg 0 0 0.0 1.0 ECU_ADDRESS 0x0000 /* @ECU_Address@VHAL_CANMsgInvalidShifter1_flg@ */ /end MEASUREMENT
/begin MEASUREMENT VHAL_CANMsgInvalidShifter2_flg "" UBYTE SWC_HALIN_type_CM_boolean_flg 0 0 0.0 1.0 ECU_ADDRESS 0x0000 /* @ECU_Address@VHAL_CANMsgInvalidShifter2_flg@ */ /end MEASUREMENT
/begin MEASUREMENT VHAL_BDDSEATAntiSta_flg "" UBYTE SWC_HALIN_type_CM_boolean_flg 0 0 0.0 1.0 ECU_ADDRESS 0x0000 /* @ECU_Address@VHAL_BDDSEATAntiSta_flg@ */ /end MEASUREMENT
/begin MEASUREMENT VHAL_BDDSEATEntryFunSta_flg "" UBYTE SWC_HALIN_type_CM_boolean_flg 0 0 0.0 1.0 ECU_ADDRESS 0x0000 /* @ECU_Address@VHAL_BDDSEATEntryFunSta_flg@ */ /end MEASUREMENT
/begin MEASUREMENT VHAL_BDDoorRHandleCloseSta_flg "" UBYTE SWC_HALIN_type_CM_boolean_flg 0 0 0.0 1.0 ECU_ADDRESS 0x0000 /* @ECU_Address@VHAL_BDDoorRHandleCloseSta_flg@ */ /end MEASUREMENT
/begin MEASUREMENT VHAL_FRTurnLPErr_flg "" UBYTE SWC_HALIN_type_CM_boolean_flg 0 0 0.0 1.0 ECU_ADDRESS 0x0000 /* @ECU_Address@VHAL_FRTurnLPErr_flg@ */ /end MEASUREMENT
/begin MEASUREMENT VHAL_FRTurnLightWarning_flg "" UBYTE SWC_HALIN_type_CM_boolean_flg 0 0 0.0 1.0 ECU_ADDRESS 0x0000 /* @ECU_Address@VHAL_FRTurnLightWarning_flg@ */ /end MEASUREMENT
/begin MEASUREMENT VHAL_FWiperAS_flg "" UBYTE SWC_HALIN_type_CM_boolean_flg 0 0 0.0 1.0 ECU_ADDRESS 0x0000 /* @ECU_Address@VHAL_FWiperAS_flg@ */ /end MEASUREMENT
/begin MEASUREMENT VHAL_FWiperProtection_flg "" UBYTE SWC_HALIN_type_CM_boolean_flg 0 0 0.0 1.0 ECU_ADDRESS 0x0000 /* @ECU_Address@VHAL_FWiperProtection_flg@ */ /end MEASUREMENT
/begin MEASUREMENT VHAL_LADBHibeamIndication_flg "" UBYTE SWC_HALIN_type_CM_boolean_flg 0 0 0.0 1.0 ECU_ADDRESS 0x0000 /* @ECU_Address@VHAL_LADBHibeamIndication_flg@ */ /end MEASUREMENT
/begin MEASUREMENT VHAL_LADBOperationStatus_flg "" UBYTE SWC_HALIN_type_CM_boolean_flg 0 0 0.0 1.0 ECU_ADDRESS 0x0000 /* @ECU_Address@VHAL_LADBOperationStatus_flg@ */ /end MEASUREMENT
/begin MEASUREMENT VHAL_LADBWarning_flg "" UBYTE SWC_HALIN_type_CM_boolean_flg 0 0 0.0 1.0 ECU_ADDRESS 0x0000 /* @ECU_Address@VHAL_LADBWarning_flg@ */ /end MEASUREMENT
/begin MEASUREMENT VHAL_LAHBWarning_flg "" UBYTE SWC_HALIN_type_CM_boolean_flg 0 0 0.0 1.0 ECU_ADDRESS 0x0000 /* @ECU_Address@VHAL_LAHBWarning_flg@ */ /end MEASUREMENT
/begin MEASUREMENT VHAL_LDRLWarning_flg "" UBYTE SWC_HALIN_type_CM_boolean_flg 0 0 0.0 1.0 ECU_ADDRESS 0x0000 /* @ECU_Address@VHAL_LDRLWarning_flg@ */ /end MEASUREMENT
/begin MEASUREMENT VHAL_BPPSEATErrorSta_flg "" UBYTE SWC_HALIN_type_CM_boolean_flg 0 0 0.0 1.0 ECU_ADDRESS 0x0000 /* @ECU_Address@VHAL_BPPSEATErrorSta_flg@ */ /end MEASUREMENT
/begin MEASUREMENT VHAL_LLBWarning_flg "" UBYTE SWC_HALIN_type_CM_boolean_flg 0 0 0.0 1.0 ECU_ADDRESS 0x0000 /* @ECU_Address@VHAL_LLBWarning_flg@ */ /end MEASUREMENT
/begin MEASUREMENT VHAL_LpositionLampWarning_flg "" UBYTE SWC_HALIN_type_CM_boolean_flg 0 0 0.0 1.0 ECU_ADDRESS 0x0000 /* @ECU_Address@VHAL_LpositionLampWarning_flg@ */ /end MEASUREMENT
/begin MEASUREMENT VHAL_RADBHibeamIndication_flg "" UBYTE SWC_HALIN_type_CM_boolean_flg 0 0 0.0 1.0 ECU_ADDRESS 0x0000 /* @ECU_Address@VHAL_RADBHibeamIndication_flg@ */ /end MEASUREMENT
/begin MEASUREMENT VHAL_RADBOperationStatus_flg "" UBYTE SWC_HALIN_type_CM_boolean_flg 0 0 0.0 1.0 ECU_ADDRESS 0x0000 /* @ECU_Address@VHAL_RADBOperationStatus_flg@ */ /end MEASUREMENT
/begin MEASUREMENT VHAL_RADBWarning_flg "" UBYTE SWC_HALIN_type_CM_boolean_flg 0 0 0.0 1.0 ECU_ADDRESS 0x0000 /* @ECU_Address@VHAL_RADBWarning_flg@ */ /end MEASUREMENT
/begin MEASUREMENT VHAL_RAHBWarning_flg "" UBYTE SWC_HALIN_type_CM_boolean_flg 0 0 0.0 1.0 ECU_ADDRESS 0x0000 /* @ECU_Address@VHAL_RAHBWarning_flg@ */ /end MEASUREMENT
/begin MEASUREMENT VHAL_RDRLWarning_flg "" UBYTE SWC_HALIN_type_CM_boolean_flg 0 0 0.0 1.0 ECU_ADDRESS 0x0000 /* @ECU_Address@VHAL_RDRLWarning_flg@ */ /end MEASUREMENT
/begin MEASUREMENT VHAL_RLBWarning_flg "" UBYTE SWC_HALIN_type_CM_boolean_flg 0 0 0.0 1.0 ECU_ADDRESS 0x0000 /* @ECU_Address@VHAL_RLBWarning_flg@ */ /end MEASUREMENT
/begin MEASUREMENT VHAL_RpositionLampWarning_flg "" UBYTE SWC_HALIN_type_CM_boolean_flg 0 0 0.0 1.0 ECU_ADDRESS 0x0000 /* @ECU_Address@VHAL_RpositionLampWarning_flg@ */ /end MEASUREMENT
/begin MEASUREMENT VHAL_TrailerCheck_flg "" UBYTE SWC_HALIN_type_CM_boolean_flg 0 0 0.0 1.0 ECU_ADDRESS 0x0000 /* @ECU_Address@VHAL_TrailerCheck_flg@ */ /end MEASUREMENT
/begin MEASUREMENT VHAL_ZFRBCMChargerDoorSWSta_flg "" UBYTE SWC_HALIN_type_CM_boolean_flg 0 0 0.0 1.0 ECU_ADDRESS 0x0000 /* @ECU_Address@VHAL_ZFRBCMChargerDoorSWSta_flg@ */ /end MEASUREMENT
/begin MEASUREMENT VHAL_ZFRBCMHRLTurnLPNormalSta_flg "" UBYTE SWC_HALIN_type_CM_boolean_flg 0 0 0.0 1.0 ECU_ADDRESS 0x0000 /* @ECU_Address@VHAL_ZFRBCMHRLTurnLPNormalSta_flg@ */ /end MEASUREMENT
/begin MEASUREMENT VHAL_ZFRBCMHRRTurnLPHNormalSta_flg "" UBYTE SWC_HALIN_type_CM_boolean_flg 0 0 0.0 1.0 ECU_ADDRESS 0x0000 /* @ECU_Address@VHAL_ZFRBCMHRRTurnLPHNormalSta_flg@ */ /end MEASUREMENT
/begin MEASUREMENT VHAL_FrPMMLimpHomeActReq_flg "" UBYTE SWC_HALIN_type_CM_boolean_flg 0 0 0.0 1.0 ECU_ADDRESS 0x0000 /* @ECU_Address@VHAL_FrPMMLimpHomeActReq_flg@ */ /end MEASUREMENT
/begin MEASUREMENT VHAL_BPPTGExistSta_flg "" UBYTE SWC_HALIN_type_CM_boolean_flg 0 0 0.0 1.0 ECU_ADDRESS 0x0000 /* @ECU_Address@VHAL_BPPTGExistSta_flg@ */ /end MEASUREMENT
/begin MEASUREMENT VHAL_CSWDimSw_flg "" UBYTE SWC_HALIN_type_CM_boolean_flg 0 0 0.0 1.0 ECU_ADDRESS 0x0000 /* @ECU_Address@VHAL_CSWDimSw_flg@ */ /end MEASUREMENT
/begin MEASUREMENT VHAL_CSWPassSWSta_flg "" UBYTE SWC_HALIN_type_CM_boolean_flg 0 0 0.0 1.0 ECU_ADDRESS 0x0000 /* @ECU_Address@VHAL_CSWPassSWSta_flg@ */ /end MEASUREMENT
/begin MEASUREMENT VHAL_FAPWL01LINResponseError_flg "" UBYTE SWC_HALIN_type_CM_boolean_flg 0 0 0.0 1.0 ECU_ADDRESS 0x0000 /* @ECU_Address@VHAL_FAPWL01LINResponseError_flg@ */ /end MEASUREMENT
/begin MEASUREMENT VHAL_LDrvMotorRelayError_flg "" UBYTE SWC_HALIN_type_CM_boolean_flg 0 0 0.0 1.0 ECU_ADDRESS 0x0000 /* @ECU_Address@VHAL_LDrvMotorRelayError_flg@ */ /end MEASUREMENT
/begin MEASUREMENT VHAL_LDrvMotorRippleError_flg "" UBYTE SWC_HALIN_type_CM_boolean_flg 0 0 0.0 1.0 ECU_ADDRESS 0x0000 /* @ECU_Address@VHAL_LDrvMotorRippleError_flg@ */ /end MEASUREMENT
/begin MEASUREMENT VHAL_LPasMotorRelayError_flg "" UBYTE SWC_HALIN_type_CM_boolean_flg 0 0 0.0 1.0 ECU_ADDRESS 0x0000 /* @ECU_Address@VHAL_LPasMotorRelayError_flg@ */ /end MEASUREMENT
/begin MEASUREMENT VHAL_LPasMotorRippleError_flg "" UBYTE SWC_HALIN_type_CM_boolean_flg 0 0 0.0 1.0 ECU_ADDRESS 0x0000 /* @ECU_Address@VHAL_LPasMotorRippleError_flg@ */ /end MEASUREMENT
/begin MEASUREMENT VHAL_LRLDMotorRelayError_flg "" UBYTE SWC_HALIN_type_CM_boolean_flg 0 0 0.0 1.0 ECU_ADDRESS 0x0000 /* @ECU_Address@VHAL_LRLDMotorRelayError_flg@ */ /end MEASUREMENT
/begin MEASUREMENT VHAL_LRLDMotorRippleError_flg "" UBYTE SWC_HALIN_type_CM_boolean_flg 0 0 0.0 1.0 ECU_ADDRESS 0x0000 /* @ECU_Address@VHAL_LRLDMotorRippleError_flg@ */ /end MEASUREMENT
/begin MEASUREMENT VHAL_BPPTGIsSetHeightSta_flg "" UBYTE SWC_HALIN_type_CM_boolean_flg 0 0 0.0 1.0 ECU_ADDRESS 0x0000 /* @ECU_Address@VHAL_BPPTGIsSetHeightSta_flg@ */ /end MEASUREMENT
/begin MEASUREMENT VHAL_LRRDMotorRelayError_flg "" UBYTE SWC_HALIN_type_CM_boolean_flg 0 0 0.0 1.0 ECU_ADDRESS 0x0000 /* @ECU_Address@VHAL_LRRDMotorRelayError_flg@ */ /end MEASUREMENT
/begin MEASUREMENT VHAL_LRRDMotorRippleError_flg "" UBYTE SWC_HALIN_type_CM_boolean_flg 0 0 0.0 1.0 ECU_ADDRESS 0x0000 /* @ECU_Address@VHAL_LRRDMotorRippleError_flg@ */ /end MEASUREMENT
/begin MEASUREMENT VHAL_RAPWL01LINResponseError_flg "" UBYTE SWC_HALIN_type_CM_boolean_flg 0 0 0.0 1.0 ECU_ADDRESS 0x0000 /* @ECU_Address@VHAL_RAPWL01LINResponseError_flg@ */ /end MEASUREMENT
/begin MEASUREMENT VHAL_RLSLampSta_flg "" UBYTE SWC_HALIN_type_CM_boolean_flg 0 0 0.0 1.0 ECU_ADDRESS 0x0000 /* @ECU_Address@VHAL_RLSLampSta_flg@ */ /end MEASUREMENT
/begin MEASUREMENT VHAL_SWC2LADASSta_flg "" UBYTE SWC_HALIN_type_CM_boolean_flg 0 0 0.0 1.0 ECU_ADDRESS 0x0000 /* @ECU_Address@VHAL_SWC2LADASSta_flg@ */ /end MEASUREMENT
/begin MEASUREMENT VHAL_SWC2LDriveModeSta_flg "" UBYTE SWC_HALIN_type_CM_boolean_flg 0 0 0.0 1.0 ECU_ADDRESS 0x0000 /* @ECU_Address@VHAL_SWC2LDriveModeSta_flg@ */ /end MEASUREMENT
/begin MEASUREMENT VHAL_SWC2LHomeSta_flg "" UBYTE SWC_HALIN_type_CM_boolean_flg 0 0 0.0 1.0 ECU_ADDRESS 0x0000 /* @ECU_Address@VHAL_SWC2LHomeSta_flg@ */ /end MEASUREMENT
/begin MEASUREMENT VHAL_BDDSEATErrorSta_flg "" UBYTE SWC_HALIN_type_CM_boolean_flg 0 0 0.0 1.0 ECU_ADDRESS 0x0000 /* @ECU_Address@VHAL_BDDSEATErrorSta_flg@ */ /end MEASUREMENT
/begin MEASUREMENT VHAL_SWC2LLeftSta_flg "" UBYTE SWC_HALIN_type_CM_boolean_flg 0 0 0.0 1.0 ECU_ADDRESS 0x0000 /* @ECU_Address@VHAL_SWC2LLeftSta_flg@ */ /end MEASUREMENT
/begin MEASUREMENT VHAL_SWC2LRegenUpSta_flg "" UBYTE SWC_HALIN_type_CM_boolean_flg 0 0 0.0 1.0 ECU_ADDRESS 0x0000 /* @ECU_Address@VHAL_SWC2LRegenUpSta_flg@ */ /end MEASUREMENT
/begin MEASUREMENT VHAL_SWC2LRightSta_flg "" UBYTE SWC_HALIN_type_CM_boolean_flg 0 0 0.0 1.0 ECU_ADDRESS 0x0000 /* @ECU_Address@VHAL_SWC2LRightSta_flg@ */ /end MEASUREMENT
/begin MEASUREMENT VHAL_SWC2LScrollDownSta_flg "" UBYTE SWC_HALIN_type_CM_boolean_flg 0 0 0.0 1.0 ECU_ADDRESS 0x0000 /* @ECU_Address@VHAL_SWC2LScrollDownSta_flg@ */ /end MEASUREMENT
/begin MEASUREMENT VHAL_SWC2LScrollPressSta_flg "" UBYTE SWC_HALIN_type_CM_boolean_flg 0 0 0.0 1.0 ECU_ADDRESS 0x0000 /* @ECU_Address@VHAL_SWC2LScrollPressSta_flg@ */ /end MEASUREMENT
/begin MEASUREMENT VHAL_SWC2LScrollUpSta_flg "" UBYTE SWC_HALIN_type_CM_boolean_flg 0 0 0.0 1.0 ECU_ADDRESS 0x0000 /* @ECU_Address@VHAL_SWC2LScrollUpSta_flg@ */ /end MEASUREMENT
/begin MEASUREMENT VHAL_SWC2RCustomizeSta_flg "" UBYTE SWC_HALIN_type_CM_boolean_flg 0 0 0.0 1.0 ECU_ADDRESS 0x0000 /* @ECU_Address@VHAL_SWC2RCustomizeSta_flg@ */ /end MEASUREMENT
/begin MEASUREMENT VHAL_SWC2RLeftSta_flg "" UBYTE SWC_HALIN_type_CM_boolean_flg 0 0 0.0 1.0 ECU_ADDRESS 0x0000 /* @ECU_Address@VHAL_SWC2RLeftSta_flg@ */ /end MEASUREMENT
/begin MEASUREMENT VHAL_SWC2RPageSwitchSta_flg "" UBYTE SWC_HALIN_type_CM_boolean_flg 0 0 0.0 1.0 ECU_ADDRESS 0x0000 /* @ECU_Address@VHAL_SWC2RPageSwitchSta_flg@ */ /end MEASUREMENT
/begin MEASUREMENT VHAL_SWC2RRegenDownSta_flg "" UBYTE SWC_HALIN_type_CM_boolean_flg 0 0 0.0 1.0 ECU_ADDRESS 0x0000 /* @ECU_Address@VHAL_SWC2RRegenDownSta_flg@ */ /end MEASUREMENT
/begin MEASUREMENT VHAL_SWC2RRightSta_flg "" UBYTE SWC_HALIN_type_CM_boolean_flg 0 0 0.0 1.0 ECU_ADDRESS 0x0000 /* @ECU_Address@VHAL_SWC2RRightSta_flg@ */ /end MEASUREMENT
/begin MEASUREMENT VHAL_SWC2RScrollDownSta_flg "" UBYTE SWC_HALIN_type_CM_boolean_flg 0 0 0.0 1.0 ECU_ADDRESS 0x0000 /* @ECU_Address@VHAL_SWC2RScrollDownSta_flg@ */ /end MEASUREMENT
/begin MEASUREMENT VHAL_SWC2RScrollPressSta_flg "" UBYTE SWC_HALIN_type_CM_boolean_flg 0 0 0.0 1.0 ECU_ADDRESS 0x0000 /* @ECU_Address@VHAL_SWC2RScrollPressSta_flg@ */ /end MEASUREMENT
/begin MEASUREMENT VHAL_SWC2RScrollUpSta_flg "" UBYTE SWC_HALIN_type_CM_boolean_flg 0 0 0.0 1.0 ECU_ADDRESS 0x0000 /* @ECU_Address@VHAL_SWC2RScrollUpSta_flg@ */ /end MEASUREMENT
/begin MEASUREMENT VHAL_SWC2RVRSta_flg "" UBYTE SWC_HALIN_type_CM_boolean_flg 0 0 0.0 1.0 ECU_ADDRESS 0x0000 /* @ECU_Address@VHAL_SWC2RVRSta_flg@ */ /end MEASUREMENT
/begin MEASUREMENT VHAL_SWCACCSta_flg "" UBYTE SWC_HALIN_type_CM_boolean_flg 0 0 0.0 1.0 ECU_ADDRESS 0x0000 /* @ECU_Address@VHAL_SWCACCSta_flg@ */ /end MEASUREMENT
/begin MEASUREMENT VHAL_SWCCANCELSta_flg "" UBYTE SWC_HALIN_type_CM_boolean_flg 0 0 0.0 1.0 ECU_ADDRESS 0x0000 /* @ECU_Address@VHAL_SWCCANCELSta_flg@ */ /end MEASUREMENT
/begin MEASUREMENT VHAL_SWCDistanceSta_flg "" UBYTE SWC_HALIN_type_CM_boolean_flg 0 0 0.0 1.0 ECU_ADDRESS 0x0000 /* @ECU_Address@VHAL_SWCDistanceSta_flg@ */ /end MEASUREMENT
/begin MEASUREMENT VHAL_SWCDownSta_flg "" UBYTE SWC_HALIN_type_CM_boolean_flg 0 0 0.0 1.0 ECU_ADDRESS 0x0000 /* @ECU_Address@VHAL_SWCDownSta_flg@ */ /end MEASUREMENT
/begin MEASUREMENT VHAL_SWCLKASta_flg "" UBYTE SWC_HALIN_type_CM_boolean_flg 0 0 0.0 1.0 ECU_ADDRESS 0x0000 /* @ECU_Address@VHAL_SWCLKASta_flg@ */ /end MEASUREMENT
/begin MEASUREMENT VHAL_SWCLeftSta_flg "" UBYTE SWC_HALIN_type_CM_boolean_flg 0 0 0.0 1.0 ECU_ADDRESS 0x0000 /* @ECU_Address@VHAL_SWCLeftSta_flg@ */ /end MEASUREMENT
/begin MEASUREMENT VHAL_SWCRegenDown_flg "" UBYTE SWC_HALIN_type_CM_boolean_flg 0 0 0.0 1.0 ECU_ADDRESS 0x0000 /* @ECU_Address@VHAL_SWCRegenDown_flg@ */ /end MEASUREMENT
/begin MEASUREMENT VHAL_SWCRegenUp_flg "" UBYTE SWC_HALIN_type_CM_boolean_flg 0 0 0.0 1.0 ECU_ADDRESS 0x0000 /* @ECU_Address@VHAL_SWCRegenUp_flg@ */ /end MEASUREMENT
/begin MEASUREMENT VHAL_SWCResUpSta_flg "" UBYTE SWC_HALIN_type_CM_boolean_flg 0 0 0.0 1.0 ECU_ADDRESS 0x0000 /* @ECU_Address@VHAL_SWCResUpSta_flg@ */ /end MEASUREMENT
/begin MEASUREMENT VHAL_SWCRightSta_flg "" UBYTE SWC_HALIN_type_CM_boolean_flg 0 0 0.0 1.0 ECU_ADDRESS 0x0000 /* @ECU_Address@VHAL_SWCRightSta_flg@ */ /end MEASUREMENT
/begin MEASUREMENT VHAL_SWCSetdownSta_flg "" UBYTE SWC_HALIN_type_CM_boolean_flg 0 0 0.0 1.0 ECU_ADDRESS 0x0000 /* @ECU_Address@VHAL_SWCSetdownSta_flg@ */ /end MEASUREMENT
/begin MEASUREMENT VHAL_SWCTripSta_flg "" UBYTE SWC_HALIN_type_CM_boolean_flg 0 0 0.0 1.0 ECU_ADDRESS 0x0000 /* @ECU_Address@VHAL_SWCTripSta_flg@ */ /end MEASUREMENT
/begin MEASUREMENT VHAL_SWCUndefinedSta_flg "" UBYTE SWC_HALIN_type_CM_boolean_flg 0 0 0.0 1.0 ECU_ADDRESS 0x0000 /* @ECU_Address@VHAL_SWCUndefinedSta_flg@ */ /end MEASUREMENT
/begin MEASUREMENT VHAL_SWCUpSta_flg "" UBYTE SWC_HALIN_type_CM_boolean_flg 0 0 0.0 1.0 ECU_ADDRESS 0x0000 /* @ECU_Address@VHAL_SWCUpSta_flg@ */ /end MEASUREMENT
/begin MEASUREMENT VHAL_SWCVRSta_flg "" UBYTE SWC_HALIN_type_CM_boolean_flg 0 0 0.0 1.0 ECU_ADDRESS 0x0000 /* @ECU_Address@VHAL_SWCVRSta_flg@ */ /end MEASUREMENT
/begin MEASUREMENT VHAL_SWCmodeSta_flg "" UBYTE SWC_HALIN_type_CM_boolean_flg 0 0 0.0 1.0 ECU_ADDRESS 0x0000 /* @ECU_Address@VHAL_SWCmodeSta_flg@ */ /end MEASUREMENT
/begin MEASUREMENT VHAL_ACT1ResponseError_flg "" UBYTE SWC_HALIN_type_CM_boolean_flg 0 0 0.0 1.0 ECU_ADDRESS 0x0000 /* @ECU_Address@VHAL_ACT1ResponseError_flg@ */ /end MEASUREMENT
/begin MEASUREMENT VHAL_DSEATAntiSta_flg "" UBYTE SWC_HALIN_type_CM_boolean_flg 0 0 0.0 1.0 ECU_ADDRESS 0x0000 /* @ECU_Address@VHAL_DSEATAntiSta_flg@ */ /end MEASUREMENT
/begin MEASUREMENT VHAL_DSEATEntryFunSta_flg "" UBYTE SWC_HALIN_type_CM_boolean_flg 0 0 0.0 1.0 ECU_ADDRESS 0x0000 /* @ECU_Address@VHAL_DSEATEntryFunSta_flg@ */ /end MEASUREMENT
/begin MEASUREMENT VHAL_DSEATErrorSta_flg "" UBYTE SWC_HALIN_type_CM_boolean_flg 0 0 0.0 1.0 ECU_ADDRESS 0x0000 /* @ECU_Address@VHAL_DSEATErrorSta_flg@ */ /end MEASUREMENT
/begin MEASUREMENT VHAL_PSEATErrorSta_flg "" UBYTE SWC_HALIN_type_CM_boolean_flg 0 0 0.0 1.0 ECU_ADDRESS 0x0000 /* @ECU_Address@VHAL_PSEATErrorSta_flg@ */ /end MEASUREMENT
/begin MEASUREMENT VHAL_BPDoorFHandleCloseSta_flg "" UBYTE SWC_HALIN_type_CM_boolean_flg 0 0 0.0 1.0 ECU_ADDRESS 0x0000 /* @ECU_Address@VHAL_BPDoorFHandleCloseSta_flg@ */ /end MEASUREMENT
/begin MEASUREMENT VHAL_BPDoorRHandleCloseSta_flg "" UBYTE SWC_HALIN_type_CM_boolean_flg 0 0 0.0 1.0 ECU_ADDRESS 0x0000 /* @ECU_Address@VHAL_BPDoorRHandleCloseSta_flg@ */ /end MEASUREMENT
/begin MEASUREMENT VHAL_PKeyMiss_flg "" UBYTE SWC_HALIN_type_CM_boolean_flg 0 0 0.0 1.0 ECU_ADDRESS 0x0000 /* @ECU_Address@VHAL_PKeyMiss_flg@ */ /end MEASUREMENT
/begin MEASUREMENT VHAL_PUIDLowPower_flg "" UBYTE SWC_HALIN_type_CM_boolean_flg 0 0 0.0 1.0 ECU_ADDRESS 0x0000 /* @ECU_Address@VHAL_PUIDLowPower_flg@ */ /end MEASUREMENT
/begin MEASUREMENT VHAL_PTGAutoStaus_flg "" UBYTE SWC_HALIN_type_CM_boolean_flg 0 0 0.0 1.0 ECU_ADDRESS 0x0000 /* @ECU_Address@VHAL_PTGAutoStaus_flg@ */ /end MEASUREMENT
/begin MEASUREMENT VHAL_PTGExist_flg "" UBYTE SWC_HALIN_type_CM_boolean_flg 0 0 0.0 1.0 ECU_ADDRESS 0x0000 /* @ECU_Address@VHAL_PTGExist_flg@ */ /end MEASUREMENT
/begin MEASUREMENT VHAL_PTGIsSetHeight_flg "" UBYTE SWC_HALIN_type_CM_boolean_flg 0 0 0.0 1.0 ECU_ADDRESS 0x0000 /* @ECU_Address@VHAL_PTGIsSetHeight_flg@ */ /end MEASUREMENT
/begin MEASUREMENT VHAL_DrLockSta_flg "" UBYTE SWC_HALIN_type_CM_boolean_flg 0 0 0.0 1.0 ECU_ADDRESS 0x0000 /* @ECU_Address@VHAL_DrLockSta_flg@ */ /end MEASUREMENT
/begin MEASUREMENT VHAL_MIRRORFOLDSW_flg "" UBYTE SWC_HALIN_type_CM_boolean_flg 0 0 0.0 1.0 ECU_ADDRESS 0x0000 /* @ECU_Address@VHAL_MIRRORFOLDSW_flg@ */ /end MEASUREMENT
/begin MEASUREMENT VHAL_RLTurnLPErr_flg "" UBYTE SWC_HALIN_type_CM_boolean_flg 0 0 0.0 1.0 ECU_ADDRESS 0x0000 /* @ECU_Address@VHAL_RLTurnLPErr_flg@ */ /end MEASUREMENT
/begin MEASUREMENT VHAL_RRTurnLPErr_flg "" UBYTE SWC_HALIN_type_CM_boolean_flg 0 0 0.0 1.0 ECU_ADDRESS 0x0000 /* @ECU_Address@VHAL_RRTurnLPErr_flg@ */ /end MEASUREMENT
/begin MEASUREMENT VHAL_RWiperAS_flg "" UBYTE SWC_HALIN_type_CM_boolean_flg 0 0 0.0 1.0 ECU_ADDRESS 0x0000 /* @ECU_Address@VHAL_RWiperAS_flg@ */ /end MEASUREMENT
/begin MEASUREMENT VHAL_RWiperProtection_flg "" UBYTE SWC_HALIN_type_CM_boolean_flg 0 0 0.0 1.0 ECU_ADDRESS 0x0000 /* @ECU_Address@VHAL_RWiperProtection_flg@ */ /end MEASUREMENT
/begin MEASUREMENT VHAL_DrPMMLVOutPErrLmp_flg "" UBYTE SWC_HALIN_type_CM_boolean_flg 0 0 0.0 1.0 ECU_ADDRESS 0x0000 /* @ECU_Address@VHAL_DrPMMLVOutPErrLmp_flg@ */ /end MEASUREMENT
/begin MEASUREMENT VHAL_DrPMMSysErrLmp_flg "" UBYTE SWC_HALIN_type_CM_boolean_flg 0 0 0.0 1.0 ECU_ADDRESS 0x0000 /* @ECU_Address@VHAL_DrPMMSysErrLmp_flg@ */ /end MEASUREMENT
/begin MEASUREMENT VHAL_DrSCPSysErrLmp_flg "" UBYTE SWC_HALIN_type_CM_boolean_flg 0 0 0.0 1.0 ECU_ADDRESS 0x0000 /* @ECU_Address@VHAL_DrSCPSysErrLmp_flg@ */ /end MEASUREMENT
/begin MEASUREMENT VHAL_DrStdAErrSta_flg "" UBYTE SWC_HALIN_type_CM_boolean_flg 0 0 0.0 1.0 ECU_ADDRESS 0x0000 /* @ECU_Address@VHAL_DrStdAErrSta_flg@ */ /end MEASUREMENT
/begin MEASUREMENT VHAL_BDDoorFHandleCloseSta_flg "" UBYTE SWC_HALIN_type_CM_boolean_flg 0 0 0.0 1.0 ECU_ADDRESS 0x0000 /* @ECU_Address@VHAL_BDDoorFHandleCloseSta_flg@ */ /end MEASUREMENT
/begin MEASUREMENT VHAL_ChargeInletLockSta_flg "" UBYTE SWC_HALIN_type_CM_boolean_flg 0 0 0.0 1.0 ECU_ADDRESS 0x0000 /* @ECU_Address@VHAL_ChargeInletLockSta_flg@ */ /end MEASUREMENT
/begin MEASUREMENT VHAL_CompProEN_flg "" UBYTE SWC_HALIN_type_CM_boolean_flg 0 0 0.0 1.0 ECU_ADDRESS 0x0000 /* @ECU_Address@VHAL_CompProEN_flg@ */ /end MEASUREMENT
/begin MEASUREMENT VHAL_FLTurnLPErr_flg "" UBYTE SWC_HALIN_type_CM_boolean_flg 0 0 0.0 1.0 ECU_ADDRESS 0x0000 /* @ECU_Address@VHAL_FLTurnLPErr_flg@ */ /end MEASUREMENT
/begin MEASUREMENT VHAL_FLTurnLightWarning_flg "" UBYTE SWC_HALIN_type_CM_boolean_flg 0 0 0.0 1.0 ECU_ADDRESS 0x0000 /* @ECU_Address@VHAL_FLTurnLightWarning_flg@ */ /end MEASUREMENT
/begin MEASUREMENT VHAL_CANMsgInvalidBodyZoneDR1_flg "" UBYTE SWC_HALIN_type_CM_boolean_flg 0 0 0.0 1.0 ECU_ADDRESS 0x0000 /* @ECU_Address@VHAL_CANMsgInvalidBodyZoneDR1_flg@ */ /end MEASUREMENT
/begin MEASUREMENT VHAL_CANMsgInvalidBodyZoneDR2_flg "" UBYTE SWC_HALIN_type_CM_boolean_flg 0 0 0.0 1.0 ECU_ADDRESS 0x0000 /* @ECU_Address@VHAL_CANMsgInvalidBodyZoneDR2_flg@ */ /end MEASUREMENT
/begin MEASUREMENT VHAL_CANMsgInvalidBodyZonePS1_flg "" UBYTE SWC_HALIN_type_CM_boolean_flg 0 0 0.0 1.0 ECU_ADDRESS 0x0000 /* @ECU_Address@VHAL_CANMsgInvalidBodyZonePS1_flg@ */ /end MEASUREMENT
/begin MEASUREMENT VHAL_CANMsgInvalidBodyZonePS2_flg "" UBYTE SWC_HALIN_type_CM_boolean_flg 0 0 0.0 1.0 ECU_ADDRESS 0x0000 /* @ECU_Address@VHAL_CANMsgInvalidBodyZonePS2_flg@ */ /end MEASUREMENT
/begin MEASUREMENT VHAL_CANMsgInvalidDKC1_flg "" UBYTE SWC_HALIN_type_CM_boolean_flg 0 0 0.0 1.0 ECU_ADDRESS 0x0000 /* @ECU_Address@VHAL_CANMsgInvalidDKC1_flg@ */ /end MEASUREMENT
/begin MEASUREMENT VHAL_CANMsgInvalidDKC2_flg "" UBYTE SWC_HALIN_type_CM_boolean_flg 0 0 0.0 1.0 ECU_ADDRESS 0x0000 /* @ECU_Address@VHAL_CANMsgInvalidDKC2_flg@ */ /end MEASUREMENT
/begin MEASUREMENT VHAL_CANMsgInvalidPTG1_flg "" UBYTE SWC_HALIN_type_CM_boolean_flg 0 0 0.0 1.0 ECU_ADDRESS 0x0000 /* @ECU_Address@VHAL_CANMsgInvalidPTG1_flg@ */ /end MEASUREMENT
/begin MEASUREMENT VHAL_CANMsgInvalidZONEDR1_flg "" UBYTE SWC_HALIN_type_CM_boolean_flg 0 0 0.0 1.0 ECU_ADDRESS 0x0000 /* @ECU_Address@VHAL_CANMsgInvalidZONEDR1_flg@ */ /end MEASUREMENT
/begin MEASUREMENT VHAL_CANMsgInvalidZONEDRVCU_flg "" UBYTE SWC_HALIN_type_CM_boolean_flg 0 0 0.0 1.0 ECU_ADDRESS 0x0000 /* @ECU_Address@VHAL_CANMsgInvalidZONEDRVCU_flg@ */ /end MEASUREMENT
/begin MEASUREMENT VHAL_ADASFCWMute_flg "" UBYTE SWC_HALIN_type_CM_boolean_flg 0 0 0.0 1.0 ECU_ADDRESS 0x0000 /* @ECU_Address@VHAL_ADASFCWMute_flg@ */ /end MEASUREMENT
/begin MEASUREMENT VHAL_ADASFaultSta_flg "" UBYTE SWC_HALIN_type_CM_boolean_flg 0 0 0.0 1.0 ECU_ADDRESS 0x0000 /* @ECU_Address@VHAL_ADASFaultSta_flg@ */ /end MEASUREMENT
/begin MEASUREMENT VHAL_ADASFltWrnReq_flg "" UBYTE SWC_HALIN_type_CM_boolean_flg 0 0 0.0 1.0 ECU_ADDRESS 0x0000 /* @ECU_Address@VHAL_ADASFltWrnReq_flg@ */ /end MEASUREMENT
/begin MEASUREMENT VHAL_ADASForceIdle_flg "" UBYTE SWC_HALIN_type_CM_boolean_flg 0 0 0.0 1.0 ECU_ADDRESS 0x0000 /* @ECU_Address@VHAL_ADASForceIdle_flg@ */ /end MEASUREMENT
/begin MEASUREMENT VHAL_ADASLDWMute_flg "" UBYTE SWC_HALIN_type_CM_boolean_flg 0 0 0.0 1.0 ECU_ADDRESS 0x0000 /* @ECU_Address@VHAL_ADASLDWMute_flg@ */ /end MEASUREMENT
/begin MEASUREMENT VHAL_ADASShftPosnReqA_flg "" UBYTE SWC_HALIN_type_CM_boolean_flg 0 0 0.0 1.0 ECU_ADDRESS 0x0000 /* @ECU_Address@VHAL_ADASShftPosnReqA_flg@ */ /end MEASUREMENT
/begin MEASUREMENT VHAL_AEBVehHoldReq_flg "" UBYTE SWC_HALIN_type_CM_boolean_flg 0 0 0.0 1.0 ECU_ADDRESS 0x0000 /* @ECU_Address@VHAL_AEBVehHoldReq_flg@ */ /end MEASUREMENT
/begin MEASUREMENT VHAL_CameraBlockage_flg "" UBYTE SWC_HALIN_type_CM_boolean_flg 0 0 0.0 1.0 ECU_ADDRESS 0x0000 /* @ECU_Address@VHAL_CameraBlockage_flg@ */ /end MEASUREMENT
/begin MEASUREMENT VHAL_FCMLKATOIFault_flg "" UBYTE SWC_HALIN_type_CM_boolean_flg 0 0 0.0 1.0 ECU_ADDRESS 0x0000 /* @ECU_Address@VHAL_FCMLKATOIFault_flg@ */ /end MEASUREMENT
/begin MEASUREMENT VHAL_HazardWarningReq_flg "" UBYTE SWC_HALIN_type_CM_boolean_flg 0 0 0.0 1.0 ECU_ADDRESS 0x0000 /* @ECU_Address@VHAL_HazardWarningReq_flg@ */ /end MEASUREMENT
/begin MEASUREMENT VHAL_LKAHODDisplayWarning_flg "" UBYTE SWC_HALIN_type_CM_boolean_flg 0 0 0.0 1.0 ECU_ADDRESS 0x0000 /* @ECU_Address@VHAL_LKAHODDisplayWarning_flg@ */ /end MEASUREMENT
/begin MEASUREMENT VHAL_LKAHODSoundWarning_flg "" UBYTE SWC_HALIN_type_CM_boolean_flg 0 0 0.0 1.0 ECU_ADDRESS 0x0000 /* @ECU_Address@VHAL_LKAHODSoundWarning_flg@ */ /end MEASUREMENT
/begin MEASUREMENT VHAL_LVDAACCStatusInformation_flg "" UBYTE SWC_HALIN_type_CM_boolean_flg 0 0 0.0 1.0 ECU_ADDRESS 0x0000 /* @ECU_Address@VHAL_LVDAACCStatusInformation_flg@ */ /end MEASUREMENT
/begin MEASUREMENT VHAL_LVDADisabled_flg "" UBYTE SWC_HALIN_type_CM_boolean_flg 0 0 0.0 1.0 ECU_ADDRESS 0x0000 /* @ECU_Address@VHAL_LVDADisabled_flg@ */ /end MEASUREMENT
/begin MEASUREMENT VHAL_LVDAFailinfo_flg "" UBYTE SWC_HALIN_type_CM_boolean_flg 0 0 0.0 1.0 ECU_ADDRESS 0x0000 /* @ECU_Address@VHAL_LVDAFailinfo_flg@ */ /end MEASUREMENT
/begin MEASUREMENT VHAL_LVDAWarning_flg "" UBYTE SWC_HALIN_type_CM_boolean_flg 0 0 0.0 1.0 ECU_ADDRESS 0x0000 /* @ECU_Address@VHAL_LVDAWarning_flg@ */ /end MEASUREMENT
/begin MEASUREMENT VHAL_LeftTurnLightReq_flg "" UBYTE SWC_HALIN_type_CM_boolean_flg 0 0 0.0 1.0 ECU_ADDRESS 0x0000 /* @ECU_Address@VHAL_LeftTurnLightReq_flg@ */ /end MEASUREMENT
/begin MEASUREMENT VHAL_RightTurnLightReq_flg "" UBYTE SWC_HALIN_type_CM_boolean_flg 0 0 0.0 1.0 ECU_ADDRESS 0x0000 /* @ECU_Address@VHAL_RightTurnLightReq_flg@ */ /end MEASUREMENT
/begin MEASUREMENT VHAL_ACCTakeoverReq_flg "" UBYTE SWC_HALIN_type_CM_boolean_flg 0 0 0.0 1.0 ECU_ADDRESS 0x0000 /* @ECU_Address@VHAL_ACCTakeoverReq_flg@ */ /end MEASUREMENT
/begin MEASUREMENT VHAL_ADASDrvInputTqBoostAct_flg "" UBYTE SWC_HALIN_type_CM_boolean_flg 0 0 0.0 1.0 ECU_ADDRESS 0x0000 /* @ECU_Address@VHAL_ADASDrvInputTqBoostAct_flg@ */ /end MEASUREMENT
/begin MEASUREMENT VHAL_ADASStrWhlAngCtrlStatus_flg "" UBYTE SWC_HALIN_type_CM_boolean_flg 0 0 0.0 1.0 ECU_ADDRESS 0x0000 /* @ECU_Address@VHAL_ADASStrWhlAngCtrlStatus_flg@ */ /end MEASUREMENT
/begin MEASUREMENT VHAL_ACCVehHoldReq_flg "" UBYTE SWC_HALIN_type_CM_boolean_flg 0 0 0.0 1.0 ECU_ADDRESS 0x0000 /* @ECU_Address@VHAL_ACCVehHoldReq_flg@ */ /end MEASUREMENT
/begin MEASUREMENT VHAL_SRRODASoundL_flg "" UBYTE SWC_HALIN_type_CM_boolean_flg 0 0 0.0 1.0 ECU_ADDRESS 0x0000 /* @ECU_Address@VHAL_SRRODASoundL_flg@ */ /end MEASUREMENT
/begin MEASUREMENT VHAL_SRRODASoundR_flg "" UBYTE SWC_HALIN_type_CM_boolean_flg 0 0 0.0 1.0 ECU_ADDRESS 0x0000 /* @ECU_Address@VHAL_SRRODASoundR_flg@ */ /end MEASUREMENT
/begin COMPU_METHOD SWC_HALIN_type_CM_boolean_flg "Q = V" RAT_FUNC "%1.0" "flg" COEFFS 0 1 0 0 0 1 /end COMPU_METHOD
/begin COMPU_METHOD SWC_HALIN_type_CM_uint32_enum "Q = V" RAT_FUNC "%10.0" "enum" COEFFS 0 1 0 0 0 1 /end COMPU_METHOD
/begin COMPU_METHOD SWC_HALIN_type_CM_single_Nm "Q = V" RAT_FUNC "%8.6" "Nm" COEFFS 0 1 0 0 0 1 /end COMPU_METHOD
/begin COMPU_METHOD SWC_HALIN_type_CM_single_kph "Q = V" RAT_FUNC "%8.6" "kph" COEFFS 0 1 0 0 0 1 /end COMPU_METHOD
/begin COMPU_METHOD SWC_HALIN_type_CM_single_pct "Q = V" RAT_FUNC "%8.6" "pct" COEFFS 0 1 0 0 0 1 /end COMPU_METHOD
/begin COMPU_METHOD SWC_HALIN_type_CM_single_A "Q = V" RAT_FUNC "%8.6" "A" COEFFS 0 1 0 0 0 1 /end COMPU_METHOD
/begin COMPU_METHOD SWC_HALIN_type_CM_single_DAY "Q = V" RAT_FUNC "%8.6" "DAY" COEFFS 0 1 0 0 0 1 /end COMPU_METHOD
/begin COMPU_METHOD SWC_HALIN_type_CM_single_hr "Q = V" RAT_FUNC "%8.6" "hr" COEFFS 0 1 0 0 0 1 /end COMPU_METHOD
/begin COMPU_METHOD SWC_HALIN_type_CM_single_min "Q = V" RAT_FUNC "%8.6" "min" COEFFS 0 1 0 0 0 1 /end COMPU_METHOD
/begin COMPU_METHOD SWC_HALIN_type_CM_single_MONTH "Q = V" RAT_FUNC "%8.6" "MONTH" COEFFS 0 1 0 0 0 1 /end COMPU_METHOD
/begin COMPU_METHOD SWC_HALIN_type_CM_single_s "Q = V" RAT_FUNC "%8.6" "s" COEFFS 0 1 0 0 0 1 /end COMPU_METHOD
/begin COMPU_METHOD SWC_HALIN_type_CM_single_kWh "Q = V" RAT_FUNC "%8.6" "kWh" COEFFS 0 1 0 0 0 1 /end COMPU_METHOD
/begin COMPU_METHOD SWC_HALIN_type_CM_single_rpm "Q = V" RAT_FUNC "%8.6" "rpm" COEFFS 0 1 0 0 0 1 /end COMPU_METHOD
/begin COMPU_METHOD SWC_HALIN_type_CM_single_mV "Q = V" RAT_FUNC "%8.6" "mV" COEFFS 0 1 0 0 0 1 /end COMPU_METHOD
/begin COMPU_METHOD SWC_HALIN_type_CM_single_KPa "Q = V" RAT_FUNC "%8.6" "KPa" COEFFS 0 1 0 0 0 1 /end COMPU_METHOD
/begin COMPU_METHOD SWC_HALIN_type_CM_single_W "Q = V" RAT_FUNC "%8.6" "W" COEFFS 0 1 0 0 0 1 /end COMPU_METHOD
/begin COMPU_METHOD SWC_HALIN_type_CM_uint16_enum "Q = V" RAT_FUNC "%5.0" "enum" COEFFS 0 1 0 0 0 1 /end COMPU_METHOD
/begin COMPU_METHOD SWC_HALIN_type_CM_uint8_enum "Q = V" RAT_FUNC "%3.0" "enum" COEFFS 0 1 0 0 0 1 /end COMPU_METHOD
/begin GROUP SWC_HALIN_type "SWC_HALIN_type" /* Root */ ROOT /begin SUB_GROUP Root_run_SWC_HALIN_Rx_5ms_sys /end SUB_GROUP /end GROUP
/begin GROUP Root_run_SWC_HALIN_Rx_5ms_sys "SWC_HALIN_type/run_SWC_HALIN_Rx_5ms_sys" /begin SUB_GROUP S3_HAL_IN /end SUB_GROUP /end GROUP
/begin GROUP S3_HAL_IN "SWC_HALIN_type/run_SWC_HALIN_Rx_5ms_sys/HAL_IN" /begin SUB_GROUP S6_CAN1 S6_CAN2 S6_CAN3 S6_CAN4 S6_CAN5 S6_CAN6 /end SUB_GROUP /end GROUP
/begin GROUP S6_CAN1 "SWC_HALIN_type/run_SWC_HALIN_Rx_5ms_sys/HAL_IN/CAN1"
 /begin SUB_GROUP S9_ABM1 S9_EPB1 S9_EPS1 S9_ESC1 S9_ESC5 S9_VHAL_CANMsgInvalidABM1_flg S9_VHAL_CANMsgInvalidEPB1_flg S9_VHAL_CANMsgInvalidEPS1_flg S9_VHAL_CANMsgInvalidESC1_flg S9_VHAL_CANMsgInvalidESC5_flg S9_VHAL_CANMsgInvalideBST1_flg /end SUB_GROUP
 /begin REF_MEASUREMENT VHAL_ABMPassengerODSSta_flg VHAL_ABMRearPassengerCTRODSSta_flg VHAL_ABMRearPassengerLHODSSta_flg VHAL_ABMRearPassengerRHODSSta_flg VHAL_ABSActive_flg VHAL_ABSFailed_flg VHAL_ABSWnlmpSta_flg VHAL_ACCAvail_flg VHAL_AEBAvail_flg VHAL_AVHActive_flg VHAL_AVHFailed_flg VHAL_ActBrkLampSta_flg VHAL_AirBagFailCmd_flg VHAL_AmberWnlmpSta_flg VHAL_BTCSActive_flg VHAL_BrkDiscTempSta_flg VHAL_BrkPedalPosSta_flg VHAL_BrkSwSta_flg VHAL_BrkSwV_flg VHAL_ChecksumABM1_enum VHAL_CrashOutputSts_enum VHAL_DOASta_flg VHAL_DriIntend_enum VHAL_DriverSeatBeltCmd_flg VHAL_EBDActive_flg VHAL_EBDFailed_flg VHAL_EPB1RC_enum VHAL_EPBCarWashMode_flg VHAL_EPBErrSta_enum VHAL_EPBExtApplyAvail_flg VHAL_EPBExtReleaseAvail_flg VHAL_EPBSta_enum VHAL_EPSAOIControl_enum VHAL_EPSRC_enum VHAL_ESC1CS_enum VHAL_ESC1RC_enum VHAL_ESC5CS_enum VHAL_ESC5RC_enum VHAL_ESCADASSta_enum VHAL_ESCAPSSta_enum VHAL_ESCActive_flg VHAL_ESCBeepReq_flg VHAL_ESCFailed_flg VHAL_ESCOFFStatus_enum VHAL_ESCOfflmpSta_flg VHAL_ESCStandstill_flg VHAL_ESCWnlmpSta_enum VHAL_ESSActive_flg VHAL_EpasFailed_enum VHAL_FrPTCSActive_flg VHAL_FrRBCActive_flg VHAL_HBBActive_flg VHAL_HBBFailed_flg VHAL_HDDActive_flg VHAL_HDDFailed_flg VHAL_HSAActive_flg VHAL_HSAFailed_flg VHAL_LFPulseCountV_flg VHAL_LFPulseCount_enum VHAL_LFRawWhlSpeedV_flg VHAL_LFWhlRotDir_enum VHAL_LRPulseCountV_flg VHAL_LRPulseCount_enum VHAL_LRRawWhlSpeedV_flg VHAL_LRWhlRotDir_enum VHAL_LatAccelV_flg VHAL_LifeCountABM1_enum VHAL_LongAccelV_flg VHAL_LowBrakeFluidSta_flg VHAL_MCPressureV_flg VHAL_PABSwitchCmd_flg VHAL_PBAActive_flg VHAL_PBAFailed_flg VHAL_PsngrSeatBeltCmd_flg VHAL_RCenterSeatBeltCmd_flg VHAL_RDCActive_enum VHAL_RDriverSeatBeltCmd_flg VHAL_RFPulseCountV_flg VHAL_RFPulseCount_enum VHAL_RFRawWhlSpeedV_flg VHAL_RFWhlRotDir_enum VHAL_RPsngrSeatBeltCmd_flg VHAL_RRPulseCountV_flg VHAL_RRPulseCount_enum VHAL_RRRawWhlSpeedV_flg VHAL_RRWhlRotDir_enum VHAL_RedWnlmpSta_flg VHAL_RrPTCSActive_flg VHAL_RrRBCActive_flg VHAL_SASCAL_flg VHAL_SASSpeedValid_flg VHAL_SASV_flg VHAL_TCSActive_flg VHAL_TCSFailed_flg VHAL_TLHPsngrSeatBeltCmd_flg VHAL_TRHPsngrSeatBeltCmd_flg VHAL_YawRateV_flg VHAL_eBSTAmberWnlmpSta_flg VHAL_eBSTBeepReq_flg VHAL_eBSTRedWnlmpSta_flg /end REF_MEASUREMENT
/end GROUP
/begin GROUP S6_CAN2 "SWC_HALIN_type/run_SWC_HALIN_Rx_5ms_sys/HAL_IN/CAN2"
 /begin SUB_GROUP S10_IVI1 S10_IVI2 S10_METER1 S10_VHAL_CANMsgInvalidHMI1_flg S10_VHAL_CANMsgInvalidIVI1_flg S10_VHAL_CANMsgInvalidIVI2_flg S10_VHAL_CANMsgInvalidIVI3_flg S10_VHAL_CANMsgInvalidMETER1_flg /end SUB_GROUP
 /begin REF_MEASUREMENT VHAL_AVMErrSTA_flg VHAL_AVMOFFRecButt_flg VHAL_AVMParkingmode_enum VHAL_AVMparkingcancel_enum VHAL_AVMparkingexcute_enum VHAL_AmbLighLowBatAlertSW_flg VHAL_AmbLighSafetyAlertSW_flg VHAL_AmbLightBrightnessSet_enum VHAL_AmbLightColorSet_enum VHAL_AmbLightDimInDarkSW_flg VHAL_AmbLightSW_flg VHAL_AmbLightWlcmLightSW_flg VHAL_ApproachUnlockSW_flg VHAL_CAASSw_enum VHAL_CDLLockButt_flg VHAL_CDLUnlockButt_flg VHAL_DSEATantiset_flg VHAL_DSEATentryfunset_flg VHAL_DSEATventreq_enum VHAL_Distanceunit_flg VHAL_ESCSWCmd_enum VHAL_FCPFrEvtBtnACMaxReq_flg VHAL_FCPFrEvtBtnACReq_flg VHAL_FCPFrEvtBtnAutoReq_flg VHAL_FCPFrEvtBtnSyncReq_flg VHAL_FSOffSw_enum VHAL_FollowMeSW_flg VHAL_GPSLAT_s VHAL_GPSLONG_enum VHAL_HMIACAirIntMCmd_flg VHAL_HMIACAirIntPCmd_flg VHAL_HMIACAutoBtnCmd_flg VHAL_HMIACBtnCmd_flg VHAL_HMIACFrDefogBtnCmd_flg VHAL_HMIACRecycleBtnCmd_flg VHAL_HMIACWindDirMCmd_flg VHAL_HMIACWindDirPCmd_flg VHAL_HMIAutoInterLightCmd_flg VHAL_HMIBCMPostDefogBtnCmd_flg VHAL_HMIZLSetTMCmd_flg VHAL_HMIZLSetTPCmd_flg VHAL_HMIZRSetTMCmd_flg VHAL_HMIZRSetTPCmd_flg VHAL_HeadLampSW_enum VHAL_HoodLatchSW_enum VHAL_IVIACCAdaptiveSta_flg VHAL_IVIAirIntZ3Cmd_enum VHAL_IVIAutoWipHSpdSWCmd_flg VHAL_IVICLBlowerYSta_pct VHAL_IVICLBlowerZSta_pct VHAL_IVICLWinLockDoorSWSta_flg VHAL_IVICRBlowerYSta_pct VHAL_IVICRBlowerZSta_pct VHAL_IVICarWashModeCmd_flg VHAL_IVIChargePortSWSta_flg VHAL_IVICreateAccReqSta_enum VHAL_IVICreepSWReq_flg VHAL_IVIDSEATFroEdgeHeightCmd_enum VHAL_IVIDSEATHeaterCmd_enum VHAL_IVIDSEATHeightCmd_enum VHAL_IVIDSEATMemory1Sta_flg VHAL_IVIDSEATMemory2Sta_flg VHAL_IVIDSEATMemoryOPTCLSSta_flg VHAL_IVIDSEATReclineCmd_enum VHAL_IVIDSEATSlideCmd_enum VHAL_IVIDelAccReqSta_enum VHAL_IVIDrivingLockSWSta_flg VHAL_IVIEPSForceCmd_enum VHAL_IVIFGSAirIntCmd_enum VHAL_IVIFGSChCmd_enum VHAL_IVIFrTrunkUnlockReqSta_flg VHAL_IVIHMICustmiFunSta_enum VHAL_IVIHMICustmiKEYSta_enum VHAL_IVIIONSWCmd_flg VHAL_IVIISAOffsetSpd_enum VHAL_IVILBlowerModeSta_enum VHAL_IVILBlowerYSta_pct VHAL_IVILBlowerZSta_pct VHAL_IVILSEATventCmd_enum VHAL_IVILinkAccReqSta_flg VHAL_IVILinkAccSta_enum VHAL_IVILinkKeySta_enum VHAL_IVILocatedSTA_enum VHAL_IVILockSoundSWSta_flg VHAL_IVIMLFMostCmd_flg VHAL_IVIMLFootLiftCmd_enum VHAL_IVIMLNapModeCmd_flg VHAL_IVIMLReclinerCmd_enum VHAL_IVIMLRestoreCmd_flg VHAL_IVIMLSEATventCmd_enum VHAL_IVIMLSeatLiftCmd_enum VHAL_IVIMLSldRestoreCmd_flg VHAL_IVIMLSliderCmd_enum VHAL_IVIMLZeroGravityCmd_flg VHAL_IVIMRFMostCmd_flg VHAL_IVIMRFootLiftCmd_enum VHAL_IVIMRNapModeCmd_flg VHAL_IVIMRReclinerCmd_enum VHAL_IVIMRRestoreCmd_flg VHAL_IVIMRSEATventCmd_enum VHAL_IVIMRSeatLiftCmd_enum VHAL_IVIMRSldRestoreCmd_flg VHAL_IVIMRSliderCmd_enum VHAL_IVIMRZeroGravityCmd_flg VHAL_IVIMirrorFoldedSWSta_flg VHAL_IVINightModeSta_flg VHAL_IVIPSEATHeaterCmd_enum VHAL_IVIPSEATReclineCmd_enum VHAL_IVIPSEATSlideCmd_enum VHAL_IVIPTGModeSW_enum VHAL_IVIPTGOpenHeight_enum VHAL_IVIPTGStaSW_enum VHAL_IVIPTGUSStaSW_flg VHAL_IVIPWModeReq_enum VHAL_IVIPwrLockSW_enum VHAL_IVIPwroffreq_flg VHAL_IVIRBlowerModeSta_enum VHAL_IVIRBlowerYSta_pct VHAL_IVIRBlowerZSta_pct VHAL_IVIRRDefReq_flg VHAL_IVIRSEATventCmd_enum VHAL_IVIReqV2L_enum VHAL_IVISWCRUndefinedSta_enum VHAL_IVISWCVibModeSta_enum VHAL_IVIScreen_enum VHAL_IVISilentChrgAlertSta_flg VHAL_IVISnowModeCmd_flg VHAL_IVIStartChgreq_flg VHAL_IVIStatus_flg VHAL_IVIStopChgreq_flg VHAL_IVIStoppingUnlockSWSta_flg VHAL_IVITimeCheck_enum VHAL_IVITimeDay_DAY VHAL_IVITimeHour_hr VHAL_IVITimeMinute_min VHAL_IVITimeMonth_MONTH VHAL_IVITimeSecond_s VHAL_IVITrailerCheckReqSta_flg VHAL_IVITrailerModeSWSta_flg VHAL_IVITriggerreq_flg VHAL_IVIUnlockChgreq_flg VHAL_IVIUserTakeOverAPSSta_flg VHAL_IVIWIMAINSW_flg VHAL_IVIWPTCSWSta_flg VHAL_IVIZon1WindDirSWReqSta_flg VHAL_IVIsigScreenReqSta_flg VHAL_LDrvControlCommand_pct VHAL_LINKtoDrive_flg VHAL_LPasControlCommand_pct VHAL_LRLDControlCommand_pct VHAL_LRRDControlCommand_pct VHAL_LightShowStartReq_flg VHAL_LightShowStopReq_flg VHAL_METERKPHCalcu_kph VHAL_MFRDNBrightReq_pct VHAL_OFFACMODE_enum VHAL_OpenDrOpenWdoSW_flg VHAL_PSEATventreq_enum VHAL_PWCONTINUEUSE_flg VHAL_PerdV2L_enum VHAL_RFogLampSW_flg VHAL_RollModeSWCmd_enum VHAL_RoomLampMode_flg VHAL_SOCADJBUTT_flg VHAL_SOCV2LLimit_pct VHAL_SchedChgStart_flg VHAL_SchedChgStop_flg VHAL_SchedChgbutt_flg VHAL_SchedChgwake_flg VHAL_SenstivityPosition_enum VHAL_SetUnlockSingle_flg VHAL_SmartEcoModeSW_flg VHAL_TCSSWCmd_enum VHAL_TPMSCaliButt_flg VHAL_TPMSResButt_flg VHAL_TurnSwTimeSet_enum VHAL_UserSet_enum VHAL_WalkawayLockSW_flg VHAL_WlcmLightMode_enum VHAL_sigAirIntenZon1Req_enum VHAL_sigDfrstReq_flg VHAL_sigFaceReq_flg VHAL_sigFootReq_flg VHAL_sigRecircReq_flg /end REF_MEASUREMENT
/end GROUP
/begin GROUP S6_CAN3 "SWC_HALIN_type/run_SWC_HALIN_Rx_5ms_sys/HAL_IN/CAN3"
 /begin SUB_GROUP S11_BMS1 S11_BMS3 S11_BMS4 S11_BMS5 S11_BMS6 S11_CCU1 S11_CCU2 S11_MCU_B_F1 S11_MCU_B_F2 S11_MCU_B_R1 S11_MCU_B_R2 S11_MCU_N_F1 S11_MCU_N_F2 S11_MCU_N_R1 S11_MCU_N_R2 S11_Shifter1 S11_Shifter2 S11_VHAL_CANMsgInvalidBMS1_flg S11_VHAL_CANMsgInvalidBMS3_flg S11_VHAL_CANMsgInvalidBMS4_flg S11_VHAL_CANMsgInvalidBMS5_flg S11_VHAL_CANMsgInvalidBMS6_flg S11_VHAL_CANMsgInvalidBMS8_flg S11_VHAL_CANMsgInvalidCCU1_flg S11_VHAL_CANMsgInvalidCCU2_flg S11_VHAL_CANMsgInvalidEBM1_flg S11_VHAL_CANMsgInvalidMCUBF1_flg S11_VHAL_CANMsgInvalidMCUBF2_flg S11_VHAL_CANMsgInvalidMCUBR1_flg S11_VHAL_CANMsgInvalidMCUBR2_flg S11_VHAL_CANMsgInvalidMCUNF1_flg S11_VHAL_CANMsgInvalidMCUNF2_flg S11_VHAL_CANMsgInvalidMCUNF3_flg S11_VHAL_CANMsgInvalidMCUNR1_flg S11_VHAL_CANMsgInvalidMCUNR2_flg S11_VHAL_CANMsgInvalidMCUNR3_flg S11_VHAL_CANMsgInvalidShifter1_flg S11_VHAL_CANMsgInvalidShifter2_flg /end SUB_GROUP
 /begin REF_MEASUREMENT VHAL_BMSChckSum1_enum VHAL_BMSChckSum_enum VHAL_BMSREADY_flg VHAL_BMSRolCnct1_enum VHAL_BMSRolCnct_enum VHAL_BMSWarn1_flg VHAL_BMSWarn2_flg VHAL_BMSWarn3_flg VHAL_BMSWarn4_flg VHAL_BMSWarn5_flg VHAL_BMSWarn6_flg VHAL_BMSWarn7_flg VHAL_BMSWarn8_flg VHAL_CSCCU1_enum VHAL_CSCCU2_enum VHAL_CSW2DimSwSta_flg VHAL_CSW2FWasSwSta_enum VHAL_CSW2FWipSwSta_enum VHAL_CSW2PassSWSta_flg VHAL_CSW2RWipWasSwSta_enum VHAL_CSW2TurnSwSta_enum VHAL_ChrgInLockReq_enum VHAL_ChrgPlugSta_enum VHAL_DCDCEnaSta_flg VHAL_DCDCFaultSta_enum VHAL_DCDCPreCompleted_enum VHAL_DCDCReady4Pre_flg VHAL_DisChrgPlugErr_enum VHAL_EBMErrSta_enum VHAL_EBMRLampSta_enum VHAL_ExtChrgSta_enum VHAL_FireDetErr_flg VHAL_FrActvDmpDisabStaNidec_flg VHAL_FrActvDmpDisabSta_flg VHAL_FrEDUDrtStaNidec_flg VHAL_FrEDUDrtSta_flg VHAL_FrEDUOpratingStaNidec_flg VHAL_FrEDUOpratingSta_flg VHAL_FrEDURotateDirctionNidec_enum VHAL_FrEDURotateDirction_enum VHAL_FrEOPSpdSetNidec_rpm VHAL_FrFailcode1Nidec_enum VHAL_FrFailcode1_enum VHAL_FrFailcode2Nidec_enum VHAL_FrFailcode2_enum VHAL_FrFailcodehistory1Nidec_enum VHAL_FrFailcodehistory1_enum VHAL_FrFailcodehistory2Nidec_enum VHAL_FrFailcodehistory2_enum VHAL_FrMCU1ChksumNidec_enum VHAL_FrMCU1Chksum_enum VHAL_FrMCU1RolCntNidec_enum VHAL_FrMCU1RolCnt_enum VHAL_FrMCUDischrgStaNidec_flg VHAL_FrMCUDischrgSta_flg VHAL_FrMCUEnaStaNidec_flg VHAL_FrMCUEnaSta_flg VHAL_FrMCUErrNidec_enum VHAL_FrMCUErr_enum VHAL_FrMCUHWVerNidec_enum VHAL_FrMCUHWVer_enum VHAL_FrMCUIGNstaNidec_flg VHAL_FrMCUIGNsta_flg VHAL_FrMCUReady4PreNidec_flg VHAL_FrMCUReady4Pre_flg VHAL_FrMCUReadyNidec_flg VHAL_FrMCUReady_flg VHAL_FrMCUSWVerNidec_enum VHAL_FrMCUSWVer_enum VHAL_FrMCUSysStaNidec_enum VHAL_FrMCUSysSta_enum VHAL_FrMCUTempWarnNidec_enum VHAL_FrMCUTempWarn_enum VHAL_FrMotorAvailTqNidec_Nm VHAL_FrMotorAvailTq_Nm VHAL_FrTMTempWarnNidec_enum VHAL_FrTMTempWarn_enum VHAL_HVBCellVoltMax_mV VHAL_HVBCellVoltMin_mV VHAL_HVBChrgErr_enum VHAL_HVBChrgPwrTotal_kWh VHAL_HVBContactorSta_flg VHAL_HVBDrvPwrTotal_kWh VHAL_HVBHVILErr_flg VHAL_HVBOvrTempErr_flg VHAL_HVBOvrTempWarn_enum VHAL_HVBPreheatPrecoolSta_enum VHAL_HVBattErr_flg VHAL_HVBattReady4Pre_enum VHAL_HVILSta_flg VHAL_MCUBFLLCTempWarnSta_enum VHAL_MCUBRLLCTempWarnSta_enum VHAL_MCUWarnFNidec_enum VHAL_MCUWarnF_enum VHAL_MCUWarnRNidec_enum VHAL_MCUWarnR_enum VHAL_MainRlyNegSta_enum VHAL_MainRlyPosSta_enum VHAL_MaxCellTempNum_enum VHAL_MaxCellVoltNum_enum VHAL_MinCellTempNum_enum VHAL_MinCellVoltNum_enum VHAL_OBCACCSLimit_A VHAL_OBCACCurLim_enum VHAL_OBCEnaSta_flg VHAL_OBCFaultSta_enum VHAL_OBCPluginSta_flg VHAL_OBCPreCompleted_enum VHAL_OBCReady4Pre_flg VHAL_OBCV2LSta_enum VHAL_OBCWakeup4Plugin_flg VHAL_RCCCU1_enum VHAL_RCCCU2_enum VHAL_RemainChrgTime_min VHAL_RrActvDmpDisabStaNidec_flg VHAL_RrActvDmpDisabSta_flg VHAL_RrEDUDrtStaNidec_flg VHAL_RrEDUDrtSta_flg VHAL_RrEDUOpratingStaNidec_flg VHAL_RrEDUOpratingSta_flg VHAL_RrEDURotateDirctionNidec_enum VHAL_RrEDURotateDirction_enum VHAL_RrEOPSpdSetNidec_rpm VHAL_RrFailcode1Nidec_enum VHAL_RrFailcode1_enum VHAL_RrFailcode2Nidec_enum VHAL_RrFailcode2_enum VHAL_RrFailcodehistory1Nidec_enum VHAL_RrFailcodehistory1_enum VHAL_RrFailcodehistory2Nidec_enum VHAL_RrFailcodehistory2_enum VHAL_RrMCU1ChksumNidec_enum VHAL_RrMCU1Chksum_enum VHAL_RrMCU1RolCntNidec_enum VHAL_RrMCU1RolCnt_enum VHAL_RrMCU3HWVerNidec_enum VHAL_RrMCU3HWVer_enum VHAL_RrMCU3SWVerNidec_enum VHAL_RrMCU3SWVer_enum VHAL_RrMCUDischrgStaNidec_flg VHAL_RrMCUDischrgSta_flg VHAL_RrMCUEnaStaNidec_flg VHAL_RrMCUEnaSta_flg VHAL_RrMCUErrNidec_enum VHAL_RrMCUErr_enum VHAL_RrMCUIGNstaNidec_flg VHAL_RrMCUIGNsta_flg VHAL_RrMCUReady4PreNidec_flg VHAL_RrMCUReady4Pre_flg VHAL_RrMCUReadyNidec_flg VHAL_RrMCUReady_flg VHAL_RrMCUSysStaNidec_enum VHAL_RrMCUSysSta_enum VHAL_RrMCUTempWarnNidec_enum VHAL_RrMCUTempWarn_enum VHAL_RrMotorAvailTqNidec_Nm VHAL_RrMotorAvailTq_Nm VHAL_RrTMTempWarnNidec_enum VHAL_RrTMTempWarn_enum VHAL_ShifterCRC8_enum VHAL_ShifterFailsta_enum VHAL_ShifterHandleCmd_enum VHAL_ShifterRC_enum VHAL_V2LSta_enum /end REF_MEASUREMENT
/end GROUP
/begin GROUP S6_CAN4 "SWC_HALIN_type/run_SWC_HALIN_Rx_5ms_sys/HAL_IN/CAN4"
 /begin SUB_GROUP S12_VHAL_CANMsgInvalidBodyZoneDR1_flg S12_VHAL_CANMsgInvalidBodyZoneDR2_flg S12_VHAL_CANMsgInvalidBodyZonePS1_flg S12_VHAL_CANMsgInvalidBodyZonePS2_flg S12_VHAL_CANMsgInvalidDKC1_flg S12_VHAL_CANMsgInvalidDKC2_flg S12_VHAL_CANMsgInvalidPTG1_flg S12_VHAL_CANMsgInvalidZONEDR1_flg S12_VHAL_CANMsgInvalidZONEDRVCU_flg S12_VHAL_CANMsgInvalidZONEFR1_flg S12_VHAL_CANMsgInvalidZONEFRVCU_flg S12_VHAL_CANMsgInvalidzGWAPTC1_flg S12_VHAL_CANMsgInvalidzGWCANFr1_flg S12_VHAL_CANMsgInvalidzGWLINDr1_flg S12_VHAL_CANMsgInvalidzGWLINDr2_flg S12_VHAL_CANMsgInvalidzGWLINFr1_flg S12_VHAL_CANMsgInvalidzGWLINFr2_flg S12_VHAL_CANMsgInvalidzGWSEAT1_flg S12_ZONE_DR1 S12_ZONE_DR_VCU S12_ZONE_FR1 S12_ZONE_FR_VCU S12_zGW_APTC1 S12_zGW_CANFr1 S12_zGW_LINDr1 S12_zGW_LINFr1 S12_zGW_LINFr2 S12_zGW_SEAT1 /end SUB_GROUP
 /begin REF_MEASUREMENT VHAL_ACT1ResponseError_flg VHAL_BDAPMWinFOpenedSta_pct VHAL_BDAPMWinROpenedSta_pct VHAL_BDDSEATAntiSta_flg VHAL_BDDSEATEntryFunSta_flg VHAL_BDDSEATErrorSta_flg VHAL_BDDSEATMemSetSta_enum VHAL_BDDSEATModeSta_enum VHAL_BDDSEATVentSta_enum VHAL_BDDSEATheaterSta_enum VHAL_BDDoorFHandleCloseSta_flg VHAL_BDDoorRHandleCloseSta_flg VHAL_BPAPMWinFOpenedSta_pct VHAL_BPAPMWinROpenedSta_pct VHAL_BPDoorFHandleCloseSta_flg VHAL_BPDoorRHandleCloseSta_flg VHAL_BPPSEATErrorSta_flg VHAL_BPPSEATModeSta_enum VHAL_BPPSEATVentSta_enum VHAL_BPPSEATheaterSta_enum VHAL_BPPTGActiveSta_enum VHAL_BPPTGExistSta_flg VHAL_BPPTGInsideSW1Sta_enum VHAL_BPPTGInsideSW2Sta_enum VHAL_BPPTGIsSetHeightSta_flg VHAL_BPPTGLeftHallPosnSta_enum VHAL_BPPTGOpenRatioSta_pct VHAL_BPPTGRDILCmd_enum VHAL_BPPTGSysSta_enum VHAL_BPSEATLVentSta_enum VHAL_BPSEATMLVentSta_enum VHAL_BPSEATMRVentSta_enum VHAL_BPSEATRVentSta_enum VHAL_COMPActualPwr_W VHAL_COMPStatorSpd_rpm VHAL_CSWDimSw_flg VHAL_CSWPassSWSta_flg VHAL_ChargeInletLockSta_flg VHAL_CompProEN_flg VHAL_DKCKeyNumSta_enum VHAL_DKCKeyTypeSta_enum VHAL_DKCPDkeyAreaRAPSSta_enum VHAL_DKCParkingModeCmd_enum VHAL_DKCReVehData_enum VHAL_DSEATAntiSta_flg VHAL_DSEATEntryFunSta_flg VHAL_DSEATErrorSta_flg VHAL_DrLockSta_flg VHAL_DrPMMLVOutPErrLmp_flg VHAL_DrPMMSysErrLmp_flg VHAL_DrSCPSysErrLmp_flg VHAL_DrStdAErrSta_flg VHAL_FAPWL01LINResponseError_flg VHAL_FLTurnLPErr_flg VHAL_FLTurnLightWarning_flg VHAL_FRTurnLPErr_flg VHAL_FRTurnLightWarning_flg VHAL_FWiperAS_flg VHAL_FWiperProtection_flg VHAL_FrPMMLimpHomeActReq_flg VHAL_LADBHibeamIndication_flg VHAL_LADBOperationStatus_flg VHAL_LADBWarning_flg VHAL_LAHBWarning_flg VHAL_LDRLWarning_flg VHAL_LDrvMotorRelayError_flg VHAL_LDrvMotorRippleError_flg VHAL_LDrvValWdwOpened_pct VHAL_LLBWarning_flg VHAL_LPasMotorRelayError_flg VHAL_LPasMotorRippleError_flg VHAL_LPasValWdwOpened_pct VHAL_LRLDMotorRelayError_flg VHAL_LRLDMotorRippleError_flg VHAL_LRLDValWdwOpened_pct VHAL_LRRDMotorRelayError_flg VHAL_LRRDMotorRippleError_flg VHAL_LRRDValWdwOpened_pct VHAL_LpositionLampWarning_flg VHAL_MIRRORFOLDSW_flg VHAL_PCommandToBCM_enum VHAL_PCommandToPTG_enum VHAL_PDKeyAreaLockUnlock_enum VHAL_PDKeyAreaPS_enum VHAL_PDKeyAreaPTG_enum VHAL_PDKeyWelcome_enum VHAL_PDkeyShowIVI_enum VHAL_PKeyMiss_flg VHAL_PKeyMode_enum VHAL_PSEATErrorSta_flg VHAL_PTGActiveSta_enum VHAL_PTGAutoStaus_flg VHAL_PTGExist_flg VHAL_PTGHWVer_enum VHAL_PTGInnerSW2_enum VHAL_PTGIsSetHeight_flg VHAL_PTGOpenRatio_pct VHAL_PTGRDILSta_enum VHAL_PTGSWVer_enum VHAL_PTGSysSta_enum VHAL_PTHighP_KPa VHAL_PTLowP1_KPa VHAL_PTLowP2_KPa VHAL_PUIDLowPower_flg VHAL_RADBHibeamIndication_flg VHAL_RADBOperationStatus_flg VHAL_RADBWarning_flg VHAL_RAHBWarning_flg VHAL_RAPWL01LINResponseError_flg VHAL_RDRLWarning_flg VHAL_RLBWarning_flg VHAL_RLSLampSta_flg VHAL_RLTurnLPErr_flg VHAL_RRTurnLPErr_flg VHAL_RWiperAS_flg VHAL_RWiperProtection_flg VHAL_RpositionLampWarning_flg VHAL_SWC2LADASSta_flg VHAL_SWC2LDriveModeSta_flg VHAL_SWC2LHomeSta_flg VHAL_SWC2LLeftSta_flg VHAL_SWC2LRegenUpSta_flg VHAL_SWC2LRightSta_flg VHAL_SWC2LScrollDownSta_flg VHAL_SWC2LScrollPressSta_flg VHAL_SWC2LScrollUpSta_flg VHAL_SWC2RCustomizeSta_flg VHAL_SWC2RLeftSta_flg VHAL_SWC2RPageSwitchSta_flg VHAL_SWC2RRegenDownSta_flg VHAL_SWC2RRightSta_flg VHAL_SWC2RScrollDownSta_flg VHAL_SWC2RScrollPressSta_flg VHAL_SWC2RScrollUpSta_flg VHAL_SWC2RVRSta_flg VHAL_SWCACCSta_flg VHAL_SWCCANCELSta_flg VHAL_SWCDistanceSta_flg VHAL_SWCDownSta_flg VHAL_SWCLKASta_flg VHAL_SWCLeftSta_flg VHAL_SWCRegenDown_flg VHAL_SWCRegenUp_flg VHAL_SWCResUpSta_flg VHAL_SWCRightSta_flg VHAL_SWCSetdownSta_flg VHAL_SWCTripSta_flg VHAL_SWCUndefinedSta_flg VHAL_SWCUpSta_flg VHAL_SWCVRSta_flg VHAL_SWCmodeSta_flg VHAL_TrailerCheck_flg VHAL_ZFRBCMChargerDoorSWSta_flg VHAL_ZFRBCMHRLTurnLPNormalSta_flg VHAL_ZFRBCMHRRTurnLPHNormalSta_flg VHAL_ZFRTHCMCLEVentActYSta_pct VHAL_ZFRTHCMCREVentActYSta_pct VHAL_ZFRTHCMLEVentActYSta_pct VHAL_ZFRTHCMREVentActYSta_pct /end REF_MEASUREMENT
/end GROUP
/begin GROUP S6_CAN5 "SWC_HALIN_type/run_SWC_HALIN_Rx_5ms_sys/HAL_IN/CAN5"
 /begin SUB_GROUP S13_TBOX2 S13_TBOX3 S13_VHAL_CANMsgInvalidTBOX2_flg S13_VHAL_CANMsgInvalidTBOX3_flg /end SUB_GROUP
 /begin REF_MEASUREMENT VHAL_ChargePercentSet_pct VHAL_ReserveChargeOFFDay_DAY VHAL_ReserveChargeOFFHour_hr VHAL_ReserveChargeOFFMinute_min VHAL_ReserveChargeOFFMonth_MONTH VHAL_ReserveChargeOnDay_DAY VHAL_ReserveChargeOnHour_hr VHAL_ReserveChargeOnMinute_min VHAL_ReserveChargeOnMonth_MONTH VHAL_TBOXHWVER_enum VHAL_TBOXSWVER_enum VHAL_TimeSyncFromBSDay_DAY VHAL_TimeSyncFromBSHour_hr VHAL_TimeSyncFromBSMinute_min VHAL_TimeSyncFromBSMonth_MONTH VHAL_TimeSyncFromBSSecond_s /end REF_MEASUREMENT
/end GROUP
/begin GROUP S6_CAN6 "SWC_HALIN_type/run_SWC_HALIN_Rx_5ms_sys/HAL_IN/CAN6"
 /begin SUB_GROUP S14_FCM1 S14_FCM2 S14_FCM3 S14_FCM4 S14_VHAL_CANMsgInvalidFCM1_flg S14_VHAL_CANMsgInvalidFCM2_flg S14_VHAL_CANMsgInvalidFCM3_flg S14_VHAL_CANMsgInvalidFCM4_flg S14_VHAL_CANMsgInvalidSRR1_flg /end SUB_GROUP
 /begin REF_MEASUREMENT VHAL_ACCObjDstLvl_enum VHAL_ACCTakeoverReq_flg VHAL_ACCVehHoldReq_flg VHAL_ADASACCSta_enum VHAL_ADASAEBReq_enum VHAL_ADASAEBSta_enum VHAL_ADASCAMSpdLim_enum VHAL_ADASDBSReq_enum VHAL_ADASDrvInputTqBoostAct_flg VHAL_ADASFCWMute_flg VHAL_ADASFCWSta_enum VHAL_ADASFaultSta_flg VHAL_ADASFltWrnReq_flg VHAL_ADASForceIdle_flg VHAL_ADASISASta_enum VHAL_ADASLDWMute_flg VHAL_ADASLDWSta_enum VHAL_ADASLFCHandsOffWarning_enum VHAL_ADASLFCSta_enum VHAL_ADASLFCWarnSound_enum VHAL_ADASLKASta_enum VHAL_ADASLaneModeL_enum VHAL_ADASLaneModeR_enum VHAL_ADASLanetypeL_enum VHAL_ADASLanetypeR_enum VHAL_ADASSLIFSpdLim_enum VHAL_ADASSLIFSta_enum VHAL_ADASShftPosnReqA_flg VHAL_ADASShftPosnReq_enum VHAL_ADASStrWhlAngCtrlStatus_flg VHAL_ADASVehSpdLim_enum VHAL_ADASWarningMsg_enum VHAL_ADBVehDst1Val_enum VHAL_AEBVehHoldReq_flg VHAL_CameraBlockage_flg VHAL_FCM1Checksum_enum VHAL_FCM1LifeCount_enum VHAL_FCMACCmode_enum VHAL_FCMLKATOIAct_enum VHAL_FCMLKATOIFault_flg VHAL_ForceLowBeam_enum VHAL_HazardWarningReq_flg VHAL_ISAWarningMsg_enum VHAL_LKAHODDisplayWarning_flg VHAL_LKAHODSoundWarning_flg VHAL_LVDAACCStatusInformation_flg VHAL_LVDADisabled_flg VHAL_LVDAFailinfo_flg VHAL_LVDAMuteSta_enum VHAL_LVDAWarning_flg VHAL_LeftTurnLightReq_flg VHAL_RightTurnLightReq_flg VHAL_SRRBSDWarnL_enum VHAL_SRRBSDWarnR_enum VHAL_SRRODASoundL_flg VHAL_SRRODASoundR_flg VHAL_SRRODAWarnL_enum VHAL_SRRODAWarnR_enum VHAL_TargetType_enum VHAL_TimeGapLevel_enum /end REF_MEASUREMENT
/end GROUP
/begin GROUP S9_ABM1 "SWC_HALIN_type/run_SWC_HALIN_Rx_5ms_sys/HAL_IN/CAN1/ABM1" /begin SUB_GROUP S15_DDM_CS_RC_Comparison /end SUB_GROUP /begin REF_CHARACTERISTIC KHAL_CAN1ABM1E2E_flg /end REF_CHARACTERISTIC /end GROUP
/begin GROUP S9_EPB1 "SWC_HALIN_type/run_SWC_HALIN_Rx_5ms_sys/HAL_IN/CAN1/EPB1" /begin SUB_GROUP S16_DDM_CS_RC_Comparison /end SUB_GROUP /begin REF_CHARACTERISTIC KHAL_CAN1EPB1E2E_flg /end REF_CHARACTERISTIC /end GROUP
/begin GROUP S9_EPS1 "SWC_HALIN_type/run_SWC_HALIN_Rx_5ms_sys/HAL_IN/CAN1/EPS1" /begin SUB_GROUP S17_DDM_CS_RC_Comparison S17_SASAngle S17_SASSpeed /end SUB_GROUP /begin REF_CHARACTERISTIC KHAL_CAN1EPS1E2E_flg /end REF_CHARACTERISTIC /end GROUP
/begin GROUP S9_ESC1 "SWC_HALIN_type/run_SWC_HALIN_Rx_5ms_sys/HAL_IN/CAN1/ESC1"
 /begin SUB_GROUP S18_DDM_CS_RC_Comparison S18_FrntAxlTrqReqDrv S18_GRADE S18_LFRawWhlSpeed S18_LRRawWhlSpeed S18_RFRawWhlSpeed S18_RRRawWhlSpeed S18_RearAxlTrqReqDrv S18_VehSpeed /end SUB_GROUP
 /begin REF_CHARACTERISTIC KHAL_CAN1ESC1E2E_flg /end REF_CHARACTERISTIC
/end GROUP
/begin GROUP S9_ESC5 "SWC_HALIN_type/run_SWC_HALIN_Rx_5ms_sys/HAL_IN/CAN1/ESC5"
 /begin SUB_GROUP S19_BrkPedalPos S19_DDM_CS_RC_Comparison S19_FrntAxlTrqReqBrk S19_LatAccel S19_LongAccel S19_MCPressure S19_MeterIndVehSpeed S19_RearAxlTrqReqBrk S19_YawRate /end SUB_GROUP
 /begin REF_CHARACTERISTIC KHAL_CAN1ESC5E2E_flg /end REF_CHARACTERISTIC
/end GROUP
/begin GROUP S9_VHAL_CANMsgInvalidABM1_flg "SWC_HALIN_type/run_SWC_HALIN_Rx_5ms_sys/HAL_IN/CAN1/VHAL_CANMsgInvalidABM1_flg" /begin REF_MEASUREMENT VHAL_CANMsgInvalidABM1_flg /end REF_MEASUREMENT /end GROUP
/begin GROUP S9_VHAL_CANMsgInvalidEPB1_flg "SWC_HALIN_type/run_SWC_HALIN_Rx_5ms_sys/HAL_IN/CAN1/VHAL_CANMsgInvalidEPB1_flg" /begin REF_MEASUREMENT VHAL_CANMsgInvalidEPB1_flg /end REF_MEASUREMENT /end GROUP
/begin GROUP S9_VHAL_CANMsgInvalidEPS1_flg "SWC_HALIN_type/run_SWC_HALIN_Rx_5ms_sys/HAL_IN/CAN1/VHAL_CANMsgInvalidEPS1_flg" /begin REF_MEASUREMENT VHAL_CANMsgInvalidEPS1_flg /end REF_MEASUREMENT /end GROUP
/begin GROUP S9_VHAL_CANMsgInvalidESC1_flg "SWC_HALIN_type/run_SWC_HALIN_Rx_5ms_sys/HAL_IN/CAN1/VHAL_CANMsgInvalidESC1_flg" /begin REF_MEASUREMENT VHAL_CANMsgInvalidESC1_flg /end REF_MEASUREMENT /end GROUP
/begin GROUP S9_VHAL_CANMsgInvalidESC5_flg "SWC_HALIN_type/run_SWC_HALIN_Rx_5ms_sys/HAL_IN/CAN1/VHAL_CANMsgInvalidESC5_flg" /begin REF_MEASUREMENT VHAL_CANMsgInvalidESC5_flg /end REF_MEASUREMENT /end GROUP
/begin GROUP S9_VHAL_CANMsgInvalideBST1_flg "SWC_HALIN_type/run_SWC_HALIN_Rx_5ms_sys/HAL_IN/CAN1/VHAL_CANMsgInvalideBST1_flg" /begin REF_MEASUREMENT VHAL_CANMsgInvalideBST1_flg /end REF_MEASUREMENT /end GROUP
/begin GROUP S10_IVI1 "SWC_HALIN_type/run_SWC_HALIN_Rx_5ms_sys/HAL_IN/CAN2/IVI1" /begin SUB_GROUP S250_IVITimeYear /end SUB_GROUP /end GROUP
/begin GROUP S10_IVI2 "SWC_HALIN_type/run_SWC_HALIN_Rx_5ms_sys/HAL_IN/CAN2/IVI2"
 /begin SUB_GROUP S251_ACChgCurSet S251_SOCLimitSet S251_SchedChglimit S251_sigSetTempZon1Req S251_sigSetTempZon2Req /end SUB_GROUP
/end GROUP
/begin GROUP S10_METER1 "SWC_HALIN_type/run_SWC_HALIN_Rx_5ms_sys/HAL_IN/CAN2/METER1" /begin SUB_GROUP S253_ODOMETER /end SUB_GROUP /end GROUP
/begin GROUP S10_VHAL_CANMsgInvalidHMI1_flg "SWC_HALIN_type/run_SWC_HALIN_Rx_5ms_sys/HAL_IN/CAN2/VHAL_CANMsgInvalidHMI1_flg" /begin REF_MEASUREMENT VHAL_CANMsgInvalidHMI1_flg /end REF_MEASUREMENT /end GROUP
/begin GROUP S10_VHAL_CANMsgInvalidIVI1_flg "SWC_HALIN_type/run_SWC_HALIN_Rx_5ms_sys/HAL_IN/CAN2/VHAL_CANMsgInvalidIVI1_flg" /begin REF_MEASUREMENT VHAL_CANMsgInvalidIVI1_flg /end REF_MEASUREMENT /end GROUP
/begin GROUP S10_VHAL_CANMsgInvalidIVI2_flg "SWC_HALIN_type/run_SWC_HALIN_Rx_5ms_sys/HAL_IN/CAN2/VHAL_CANMsgInvalidIVI2_flg" /begin REF_MEASUREMENT VHAL_CANMsgInvalidIVI2_flg /end REF_MEASUREMENT /end GROUP
/begin GROUP S10_VHAL_CANMsgInvalidIVI3_flg "SWC_HALIN_type/run_SWC_HALIN_Rx_5ms_sys/HAL_IN/CAN2/VHAL_CANMsgInvalidIVI3_flg" /begin REF_MEASUREMENT VHAL_CANMsgInvalidIVI3_flg /end REF_MEASUREMENT /end GROUP
/begin GROUP S10_VHAL_CANMsgInvalidMETER1_flg "SWC_HALIN_type/run_SWC_HALIN_Rx_5ms_sys/HAL_IN/CAN2/VHAL_CANMsgInvalidMETER1_flg" /begin REF_MEASUREMENT VHAL_CANMsgInvalidMETER1_flg /end REF_MEASUREMENT /end GROUP
/begin GROUP S11_BMS1 "SWC_HALIN_type/run_SWC_HALIN_Rx_5ms_sys/HAL_IN/CAN3/BMS1"
 /begin SUB_GROUP S462_DDM_CS_RC_Comparison S462_HVBPwrAvailChrg S462_HVBPwrAvailChrg30 S462_HVBPwrAvailChrg60 S462_HVBPwrAvailDchrg S462_HVBPwrAvailDchrg30 S462_HVBPwrAvailDchrg60 S462_HVBattCurr S462_HVBattVolt /end SUB_GROUP
 /begin REF_CHARACTERISTIC KHAL_CAN3BMS1E2E_flg /end REF_CHARACTERISTIC
/end GROUP
/begin GROUP S11_BMS3 "SWC_HALIN_type/run_SWC_HALIN_Rx_5ms_sys/HAL_IN/CAN3/BMS3"
 /begin SUB_GROUP S463_ACChrgCurrDis S463_HVBChrgPwr S463_HVBDrvPwr S463_HVBFullChrgPwr S463_HVBIsoImpedenceN S463_HVBIsoImpedenceP S463_HVBSOH S463_HVBattPackVolt S463_HVBattSOC S463_HVBattSOCDis /end SUB_GROUP
/end GROUP
/begin GROUP S11_BMS4 "SWC_HALIN_type/run_SWC_HALIN_Rx_5ms_sys/HAL_IN/CAN3/BMS4" /begin SUB_GROUP S464_CellTempAvg S464_HVBMTempMax S464_HVBMTempMin /end SUB_GROUP /end GROUP
/begin GROUP S11_BMS5 "SWC_HALIN_type/run_SWC_HALIN_Rx_5ms_sys/HAL_IN/CAN3/BMS5"
 /begin SUB_GROUP S465_HVInVolt S465_LVBattDet12V S465_OBCDCCurLm S465_OBCDCVoltLm /end SUB_GROUP
/end GROUP
/begin GROUP S11_BMS6 "SWC_HALIN_type/run_SWC_HALIN_Rx_5ms_sys/HAL_IN/CAN3/BMS6" /begin SUB_GROUP S466_DDM_CS_RC_Comparison /end SUB_GROUP /begin REF_CHARACTERISTIC KHAL_CAN3BMS6E2E_flg /end REF_CHARACTERISTIC /end GROUP
/begin GROUP S11_CCU1 "SWC_HALIN_type/run_SWC_HALIN_Rx_5ms_sys/HAL_IN/CAN3/CCU1"
 /begin SUB_GROUP S468_DCDCAuxCur S468_DCDCAuxVolt S468_DCDCHVCur S468_DCDCInVoltInf S468_DDM_CS_RC_Comparison S468_OBCDCCurrInf S468_OBCDCVoltInf /end SUB_GROUP
 /begin REF_CHARACTERISTIC KHAL_CAN3CCU1E2E_flg /end REF_CHARACTERISTIC
/end GROUP
/begin GROUP S11_CCU2 "SWC_HALIN_type/run_SWC_HALIN_Rx_5ms_sys/HAL_IN/CAN3/CCU2"
 /begin SUB_GROUP S469_DCDCTemp S469_DDM_CS_RC_Comparison S469_OBCACCurrInf S469_OBCACVoltInf S469_OBCTemp /end SUB_GROUP
 /begin REF_CHARACTERISTIC KHAL_CAN3CCU2E2E_flg /end REF_CHARACTERISTIC
/end GROUP
/begin GROUP S11_MCU_B_F1 "SWC_HALIN_type/run_SWC_HALIN_Rx_5ms_sys/HAL_IN/CAN3/MCU_B_F1"
 /begin SUB_GROUP S471_DDM_CS_RC_Comparison S471_FrEDURealTMTq S471_FrEDUTqReqFbk S471_FrMCUBAT S471_FrMCUDCBusCurr S471_FrMCUDCBusVolt S471_FrMCUTemp S471_FrRegenAvailTq S471_FrTMSpd S471_FrTMTemp S471_FrTMid S471_FrTMiq S471_MCUBFRealPwrKwSta /end SUB_GROUP
 /begin REF_CHARACTERISTIC KHAL_CAN3MCUBF1E2E_flg /end REF_CHARACTERISTIC
/end GROUP
/begin GROUP S11_MCU_B_F2 "SWC_HALIN_type/run_SWC_HALIN_Rx_5ms_sys/HAL_IN/CAN3/MCU_B_F2" /begin SUB_GROUP S472_FrCoolanttempReq S472_FrLLCTemp S472_FrLLCflowReq /end SUB_GROUP /end GROUP
/begin GROUP S11_MCU_B_R1 "SWC_HALIN_type/run_SWC_HALIN_Rx_5ms_sys/HAL_IN/CAN3/MCU_B_R1"
 /begin SUB_GROUP S473_DDM_CS_RC_Comparison S473_MCUBRRealPwrKwSta S473_RrEDURealTMTq S473_RrEDUTqReqFbk S473_RrMCUBAT S473_RrMCUDCBusCurr S473_RrMCUDCBusVolt S473_RrMCUTemp S473_RrRegenAvailTq S473_RrTMSpd S473_RrTMTemp S473_RrTMid S473_RrTMiq /end SUB_GROUP
 /begin REF_CHARACTERISTIC KHAL_CAN3MCUBR1E2E_flg /end REF_CHARACTERISTIC
/end GROUP
/begin GROUP S11_MCU_B_R2 "SWC_HALIN_type/run_SWC_HALIN_Rx_5ms_sys/HAL_IN/CAN3/MCU_B_R2" /begin SUB_GROUP S474_RrCoolanttempReq S474_RrLLCTemp S474_RrLLCflowReq /end SUB_GROUP /end GROUP
/begin GROUP S11_MCU_N_F1 "SWC_HALIN_type/run_SWC_HALIN_Rx_5ms_sys/HAL_IN/CAN3/MCU_N_F1"
 /begin SUB_GROUP S475_DDM_CS_RC_Comparison S475_FrEDURealTMTqNidec S475_FrEDUTqReqFbkNidec S475_FrMCUBATNidec S475_FrMCUDCBusCurrNidec S475_FrMCUDCBusVoltNidec S475_FrMCUTempNidec S475_FrRegenAvailTqNidec S475_FrTMSpdNidec S475_FrTMTempNidec S475_FrTMidNidec S475_FrTMiqNidec /end SUB_GROUP
 /begin REF_CHARACTERISTIC KHAL_CAN3MCUNF1E2E_flg /end REF_CHARACTERISTIC
/end GROUP
/begin GROUP S11_MCU_N_F2 "SWC_HALIN_type/run_SWC_HALIN_Rx_5ms_sys/HAL_IN/CAN3/MCU_N_F2"
 /begin SUB_GROUP S476_FrCoolanttempReqNidec S476_FrLLCTempNidec S476_FrLLCflowReqNidec /end SUB_GROUP
/end GROUP
/begin GROUP S11_MCU_N_R1 "SWC_HALIN_type/run_SWC_HALIN_Rx_5ms_sys/HAL_IN/CAN3/MCU_N_R1"
 /begin SUB_GROUP S478_DDM_CS_RC_Comparison S478_RrEDURealTMTqNidec S478_RrEDUTqReqFbkNidec S478_RrMCUBATNidec S478_RrMCUDCBusCurrNidec S478_RrMCUDCBusVoltNidec S478_RrMCUTempNidec S478_RrRegenAvailTqNidec S478_RrTMSpdNidec S478_RrTMTempNidec S478_RrTMidNidec S478_RrTMiqNidec /end SUB_GROUP
 /begin REF_CHARACTERISTIC KHAL_CAN3MCUNR1E2E_flg /end REF_CHARACTERISTIC
/end GROUP
/begin GROUP S11_MCU_N_R2 "SWC_HALIN_type/run_SWC_HALIN_Rx_5ms_sys/HAL_IN/CAN3/MCU_N_R2"
 /begin SUB_GROUP S479_RrCoolanttempReqNidec S479_RrLLCTempNidec S479_RrLLCflowReqNidec /end SUB_GROUP
/end GROUP
/begin GROUP S11_Shifter1 "SWC_HALIN_type/run_SWC_HALIN_Rx_5ms_sys/HAL_IN/CAN3/Shifter1" /begin SUB_GROUP S481_DDM_CS_RC_Comparison /end SUB_GROUP /begin REF_CHARACTERISTIC KHAL_CAN3Shifter1E2E_flg /end REF_CHARACTERISTIC /end GROUP
/begin GROUP S11_Shifter2 "SWC_HALIN_type/run_SWC_HALIN_Rx_5ms_sys/HAL_IN/CAN3/Shifter2" /begin SUB_GROUP S482_DDM_CS_RC_Comparison /end SUB_GROUP /begin REF_CHARACTERISTIC KHAL_CAN3Shifter2E2E_flg /end REF_CHARACTERISTIC /end GROUP
/begin GROUP S11_VHAL_CANMsgInvalidBMS1_flg "SWC_HALIN_type/run_SWC_HALIN_Rx_5ms_sys/HAL_IN/CAN3/VHAL_CANMsgInvalidBMS1_flg" /begin REF_MEASUREMENT VHAL_CANMsgInvalidBMS1_flg /end REF_MEASUREMENT /end GROUP
/begin GROUP S11_VHAL_CANMsgInvalidBMS3_flg "SWC_HALIN_type/run_SWC_HALIN_Rx_5ms_sys/HAL_IN/CAN3/VHAL_CANMsgInvalidBMS3_flg" /begin REF_MEASUREMENT VHAL_CANMsgInvalidBMS3_flg /end REF_MEASUREMENT /end GROUP
/begin GROUP S11_VHAL_CANMsgInvalidBMS4_flg "SWC_HALIN_type/run_SWC_HALIN_Rx_5ms_sys/HAL_IN/CAN3/VHAL_CANMsgInvalidBMS4_flg" /begin REF_MEASUREMENT VHAL_CANMsgInvalidBMS4_flg /end REF_MEASUREMENT /end GROUP
/begin GROUP S11_VHAL_CANMsgInvalidBMS5_flg "SWC_HALIN_type/run_SWC_HALIN_Rx_5ms_sys/HAL_IN/CAN3/VHAL_CANMsgInvalidBMS5_flg" /begin REF_MEASUREMENT VHAL_CANMsgInvalidBMS5_flg /end REF_MEASUREMENT /end GROUP
/begin GROUP S11_VHAL_CANMsgInvalidBMS6_flg "SWC_HALIN_type/run_SWC_HALIN_Rx_5ms_sys/HAL_IN/CAN3/VHAL_CANMsgInvalidBMS6_flg" /begin REF_MEASUREMENT VHAL_CANMsgInvalidBMS6_flg /end REF_MEASUREMENT /end GROUP
/begin GROUP S11_VHAL_CANMsgInvalidBMS8_flg "SWC_HALIN_type/run_SWC_HALIN_Rx_5ms_sys/HAL_IN/CAN3/VHAL_CANMsgInvalidBMS8_flg" /begin REF_MEASUREMENT VHAL_CANMsgInvalidBMS8_flg /end REF_MEASUREMENT /end GROUP
/begin GROUP S11_VHAL_CANMsgInvalidCCU1_flg "SWC_HALIN_type/run_SWC_HALIN_Rx_5ms_sys/HAL_IN/CAN3/VHAL_CANMsgInvalidCCU1_flg" /begin REF_MEASUREMENT VHAL_CANMsgInvalidCCU1_flg /end REF_MEASUREMENT /end GROUP
/begin GROUP S11_VHAL_CANMsgInvalidCCU2_flg "SWC_HALIN_type/run_SWC_HALIN_Rx_5ms_sys/HAL_IN/CAN3/VHAL_CANMsgInvalidCCU2_flg" /begin REF_MEASUREMENT VHAL_CANMsgInvalidCCU2_flg /end REF_MEASUREMENT /end GROUP
/begin GROUP S11_VHAL_CANMsgInvalidEBM1_flg "SWC_HALIN_type/run_SWC_HALIN_Rx_5ms_sys/HAL_IN/CAN3/VHAL_CANMsgInvalidEBM1_flg" /begin REF_MEASUREMENT VHAL_CANMsgInvalidEBM1_flg /end REF_MEASUREMENT /end GROUP
/begin GROUP S11_VHAL_CANMsgInvalidMCUBF1_flg "SWC_HALIN_type/run_SWC_HALIN_Rx_5ms_sys/HAL_IN/CAN3/VHAL_CANMsgInvalidMCUBF1_flg" /begin REF_MEASUREMENT VHAL_CANMsgInvalidMCUBF1_flg /end REF_MEASUREMENT /end GROUP
/begin GROUP S11_VHAL_CANMsgInvalidMCUBF2_flg "SWC_HALIN_type/run_SWC_HALIN_Rx_5ms_sys/HAL_IN/CAN3/VHAL_CANMsgInvalidMCUBF2_flg" /begin REF_MEASUREMENT VHAL_CANMsgInvalidMCUBF2_flg /end REF_MEASUREMENT /end GROUP
/begin GROUP S11_VHAL_CANMsgInvalidMCUBR1_flg "SWC_HALIN_type/run_SWC_HALIN_Rx_5ms_sys/HAL_IN/CAN3/VHAL_CANMsgInvalidMCUBR1_flg" /begin REF_MEASUREMENT VHAL_CANMsgInvalidMCUBR1_flg /end REF_MEASUREMENT /end GROUP
/begin GROUP S11_VHAL_CANMsgInvalidMCUBR2_flg "SWC_HALIN_type/run_SWC_HALIN_Rx_5ms_sys/HAL_IN/CAN3/VHAL_CANMsgInvalidMCUBR2_flg" /begin REF_MEASUREMENT VHAL_CANMsgInvalidMCUBR2_flg /end REF_MEASUREMENT /end GROUP
/begin GROUP S11_VHAL_CANMsgInvalidMCUNF1_flg "SWC_HALIN_type/run_SWC_HALIN_Rx_5ms_sys/HAL_IN/CAN3/VHAL_CANMsgInvalidMCUNF1_flg" /begin REF_MEASUREMENT VHAL_CANMsgInvalidMCUNF1_flg /end REF_MEASUREMENT /end GROUP
/begin GROUP S11_VHAL_CANMsgInvalidMCUNF2_flg "SWC_HALIN_type/run_SWC_HALIN_Rx_5ms_sys/HAL_IN/CAN3/VHAL_CANMsgInvalidMCUNF2_flg" /begin REF_MEASUREMENT VHAL_CANMsgInvalidMCUNF2_flg /end REF_MEASUREMENT /end GROUP
/begin GROUP S11_VHAL_CANMsgInvalidMCUNF3_flg "SWC_HALIN_type/run_SWC_HALIN_Rx_5ms_sys/HAL_IN/CAN3/VHAL_CANMsgInvalidMCUNF3_flg" /begin REF_MEASUREMENT VHAL_CANMsgInvalidMCUNF3_flg /end REF_MEASUREMENT /end GROUP
/begin GROUP S11_VHAL_CANMsgInvalidMCUNR1_flg "SWC_HALIN_type/run_SWC_HALIN_Rx_5ms_sys/HAL_IN/CAN3/VHAL_CANMsgInvalidMCUNR1_flg" /begin REF_MEASUREMENT VHAL_CANMsgInvalidMCUNR1_flg /end REF_MEASUREMENT /end GROUP
/begin GROUP S11_VHAL_CANMsgInvalidMCUNR2_flg "SWC_HALIN_type/run_SWC_HALIN_Rx_5ms_sys/HAL_IN/CAN3/VHAL_CANMsgInvalidMCUNR2_flg" /begin REF_MEASUREMENT VHAL_CANMsgInvalidMCUNR2_flg /end REF_MEASUREMENT /end GROUP
/begin GROUP S11_VHAL_CANMsgInvalidMCUNR3_flg "SWC_HALIN_type/run_SWC_HALIN_Rx_5ms_sys/HAL_IN/CAN3/VHAL_CANMsgInvalidMCUNR3_flg" /begin REF_MEASUREMENT VHAL_CANMsgInvalidMCUNR3_flg /end REF_MEASUREMENT /end GROUP
/begin GROUP S11_VHAL_CANMsgInvalidShifter1_flg "SWC_HALIN_type/run_SWC_HALIN_Rx_5ms_sys/HAL_IN/CAN3/VHAL_CANMsgInvalidShifter1_flg" /begin REF_MEASUREMENT VHAL_CANMsgInvalidShifter1_flg /end REF_MEASUREMENT /end GROUP
/begin GROUP S11_VHAL_CANMsgInvalidShifter2_flg "SWC_HALIN_type/run_SWC_HALIN_Rx_5ms_sys/HAL_IN/CAN3/VHAL_CANMsgInvalidShifter2_flg" /begin REF_MEASUREMENT VHAL_CANMsgInvalidShifter2_flg /end REF_MEASUREMENT /end GROUP
/begin GROUP S12_VHAL_CANMsgInvalidBodyZoneDR1_flg "SWC_HALIN_type/run_SWC_HALIN_Rx_5ms_sys/HAL_IN/CAN4/VHAL_CANMsgInvalidBodyZoneDR1_flg" /begin REF_MEASUREMENT VHAL_CANMsgInvalidBodyZoneDR1_flg /end REF_MEASUREMENT /end GROUP
/begin GROUP S12_VHAL_CANMsgInvalidBodyZoneDR2_flg "SWC_HALIN_type/run_SWC_HALIN_Rx_5ms_sys/HAL_IN/CAN4/VHAL_CANMsgInvalidBodyZoneDR2_flg" /begin REF_MEASUREMENT VHAL_CANMsgInvalidBodyZoneDR2_flg /end REF_MEASUREMENT /end GROUP
/begin GROUP S12_VHAL_CANMsgInvalidBodyZonePS1_flg "SWC_HALIN_type/run_SWC_HALIN_Rx_5ms_sys/HAL_IN/CAN4/VHAL_CANMsgInvalidBodyZonePS1_flg" /begin REF_MEASUREMENT VHAL_CANMsgInvalidBodyZonePS1_flg /end REF_MEASUREMENT /end GROUP
/begin GROUP S12_VHAL_CANMsgInvalidBodyZonePS2_flg "SWC_HALIN_type/run_SWC_HALIN_Rx_5ms_sys/HAL_IN/CAN4/VHAL_CANMsgInvalidBodyZonePS2_flg" /begin REF_MEASUREMENT VHAL_CANMsgInvalidBodyZonePS2_flg /end REF_MEASUREMENT /end GROUP
/begin GROUP S12_VHAL_CANMsgInvalidDKC1_flg "SWC_HALIN_type/run_SWC_HALIN_Rx_5ms_sys/HAL_IN/CAN4/VHAL_CANMsgInvalidDKC1_flg" /begin REF_MEASUREMENT VHAL_CANMsgInvalidDKC1_flg /end REF_MEASUREMENT /end GROUP
/begin GROUP S12_VHAL_CANMsgInvalidDKC2_flg "SWC_HALIN_type/run_SWC_HALIN_Rx_5ms_sys/HAL_IN/CAN4/VHAL_CANMsgInvalidDKC2_flg" /begin REF_MEASUREMENT VHAL_CANMsgInvalidDKC2_flg /end REF_MEASUREMENT /end GROUP
/begin GROUP S12_VHAL_CANMsgInvalidPTG1_flg "SWC_HALIN_type/run_SWC_HALIN_Rx_5ms_sys/HAL_IN/CAN4/VHAL_CANMsgInvalidPTG1_flg" /begin REF_MEASUREMENT VHAL_CANMsgInvalidPTG1_flg /end REF_MEASUREMENT /end GROUP
/begin GROUP S12_VHAL_CANMsgInvalidZONEDR1_flg "SWC_HALIN_type/run_SWC_HALIN_Rx_5ms_sys/HAL_IN/CAN4/VHAL_CANMsgInvalidZONEDR1_flg" /begin REF_MEASUREMENT VHAL_CANMsgInvalidZONEDR1_flg /end REF_MEASUREMENT /end GROUP
/begin GROUP S12_VHAL_CANMsgInvalidZONEDRVCU_flg "SWC_HALIN_type/run_SWC_HALIN_Rx_5ms_sys/HAL_IN/CAN4/VHAL_CANMsgInvalidZONEDRVCU_flg" /begin REF_MEASUREMENT VHAL_CANMsgInvalidZONEDRVCU_flg /end REF_MEASUREMENT /end GROUP
/end MODULE
/end PROJECT
/* (add any file trailer comments here) */ /* EOF SWC_HALIN_type.a2l */
