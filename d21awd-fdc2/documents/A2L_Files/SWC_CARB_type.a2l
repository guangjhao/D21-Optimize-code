/******************************************************************************
* ASAP2 file: SWC_CARB_type.a2l
* Code generation for model "SWC_CARB_type".
* Model version : 1.10
* Simulink Coder version : 9.6 (R2021b) 14-May-2021
* C source code generated on : Thu Jun 26 17:37:08 2025
* Target selection: autosar.tlc
* Embedded hardware selection: ARM Compatible->ARM Cortex-M
* Code generation objectives: Unspecified
* Validation result: Not run
* (add additional file header information here)
******************************************************************************/ ASAP2_VERSION 1 31
/* Version 1.31 */
/begin PROJECT ProjectName "Project Comment Goes Here"
/begin HEADER "Header Comments go here" /end HEADER
/begin MODULE ModuleName "Module Comment Goes Here"
/begin MOD_PAR "MOD PAR Comment Goes Here" /end MOD_PAR
/begin MOD_COMMON "Mod Common Comment Here" BYTE_ORDER MSB_LAST /end MOD_COMMON
/begin RECORD_LAYOUT Scalar_BOOLEAN FNC_VALUES 1 UBYTE COLUMN_DIR DIRECT /end RECORD_LAYOUT
/begin RECORD_LAYOUT Scalar_UBYTE FNC_VALUES 1 UBYTE COLUMN_DIR DIRECT /end RECORD_LAYOUT
/begin RECORD_LAYOUT Scalar_BYTE FNC_VALUES 1 SBYTE COLUMN_DIR DIRECT /end RECORD_LAYOUT
/begin RECORD_LAYOUT Scalar_UWORD FNC_VALUES 1 UWORD COLUMN_DIR DIRECT /end RECORD_LAYOUT
/begin RECORD_LAYOUT Scalar_SWORD FNC_VALUES 1 SWORD COLUMN_DIR DIRECT /end RECORD_LAYOUT
/begin RECORD_LAYOUT Scalar_ULONG FNC_VALUES 1 ULONG COLUMN_DIR DIRECT /end RECORD_LAYOUT
/begin RECORD_LAYOUT Scalar_LONG FNC_VALUES 1 SLONG COLUMN_DIR DIRECT /end RECORD_LAYOUT
/begin RECORD_LAYOUT Scalar_FLOAT32_IEEE FNC_VALUES 1 FLOAT32_IEEE COLUMN_DIR DIRECT /end RECORD_LAYOUT
/begin RECORD_LAYOUT Scalar_FLOAT64_IEEE FNC_VALUES 1 FLOAT64_IEEE COLUMN_DIR DIRECT /end RECORD_LAYOUT
/begin RECORD_LAYOUT Lookup1D_BOOLEAN FNC_VALUES 1 UBYTE COLUMN_DIR DIRECT /end RECORD_LAYOUT
/begin RECORD_LAYOUT Lookup1D_X_BOOLEAN AXIS_PTS_X 1 UBYTE INDEX_INCR DIRECT /end RECORD_LAYOUT
/begin RECORD_LAYOUT Lookup1D_BYTE FNC_VALUES 1 SBYTE COLUMN_DIR DIRECT /end RECORD_LAYOUT
/begin RECORD_LAYOUT Lookup1D_X_BYTE AXIS_PTS_X 1 SBYTE INDEX_INCR DIRECT /end RECORD_LAYOUT
/begin RECORD_LAYOUT Lookup1D_UBYTE FNC_VALUES 1 UBYTE COLUMN_DIR DIRECT /end RECORD_LAYOUT
/begin RECORD_LAYOUT Lookup1D_X_UBYTE AXIS_PTS_X 1 UBYTE INDEX_INCR DIRECT /end RECORD_LAYOUT
/begin RECORD_LAYOUT Lookup1D_UWORD FNC_VALUES 1 UWORD COLUMN_DIR DIRECT /end RECORD_LAYOUT
/begin RECORD_LAYOUT Lookup1D_X_UWORD AXIS_PTS_X 1 UWORD INDEX_INCR DIRECT /end RECORD_LAYOUT
/begin RECORD_LAYOUT Lookup1D_WORD FNC_VALUES 1 SWORD COLUMN_DIR DIRECT /end RECORD_LAYOUT
/begin RECORD_LAYOUT Lookup1D_X_WORD AXIS_PTS_X 1 SWORD INDEX_INCR DIRECT /end RECORD_LAYOUT
/begin RECORD_LAYOUT Lookup1D_ULONG FNC_VALUES 1 ULONG COLUMN_DIR DIRECT /end RECORD_LAYOUT
/begin RECORD_LAYOUT Lookup1D_X_ULONG AXIS_PTS_X 1 ULONG INDEX_INCR DIRECT /end RECORD_LAYOUT
/begin RECORD_LAYOUT Lookup1D_SLONG FNC_VALUES 1 SLONG COLUMN_DIR DIRECT /end RECORD_LAYOUT
/begin RECORD_LAYOUT Lookup1D_X_LONG AXIS_PTS_X 1 SLONG INDEX_INCR DIRECT /end RECORD_LAYOUT
/begin RECORD_LAYOUT Lookup1D_FLOAT32_IEEE FNC_VALUES 1 FLOAT32_IEEE COLUMN_DIR DIRECT /end RECORD_LAYOUT
/begin RECORD_LAYOUT Lookup1D_X_FLOAT32_IEEE AXIS_PTS_X 1 FLOAT32_IEEE INDEX_INCR DIRECT /end RECORD_LAYOUT
/begin RECORD_LAYOUT Lookup1D_FLOAT64_IEEE FNC_VALUES 1 FLOAT64_IEEE COLUMN_DIR DIRECT /end RECORD_LAYOUT
/begin RECORD_LAYOUT Lookup1D_X_FLOAT64_IEEE AXIS_PTS_X 1 FLOAT64_IEEE INDEX_INCR DIRECT /end RECORD_LAYOUT
/begin RECORD_LAYOUT Lookup2D_BOOLEAN FNC_VALUES 1 UBYTE COLUMN_DIR DIRECT /end RECORD_LAYOUT
/begin RECORD_LAYOUT Lookup2D_X_BOOLEAN AXIS_PTS_X 1 UBYTE INDEX_INCR DIRECT /end RECORD_LAYOUT
/begin RECORD_LAYOUT Lookup2D_UBYTE FNC_VALUES 1 UBYTE COLUMN_DIR DIRECT /end RECORD_LAYOUT
/begin RECORD_LAYOUT Lookup2D_X_UBYTE AXIS_PTS_X 1 UBYTE INDEX_INCR DIRECT /end RECORD_LAYOUT
/begin RECORD_LAYOUT Lookup2D_BYTE FNC_VALUES 1 SBYTE COLUMN_DIR DIRECT /end RECORD_LAYOUT
/begin RECORD_LAYOUT Lookup2D_X_BYTE AXIS_PTS_X 1 SBYTE INDEX_INCR DIRECT /end RECORD_LAYOUT
/begin RECORD_LAYOUT Lookup2D_UWORD FNC_VALUES 1 UWORD COLUMN_DIR DIRECT /end RECORD_LAYOUT
/begin RECORD_LAYOUT Lookup2D_X_UWORD AXIS_PTS_X 1 UWORD INDEX_INCR DIRECT /end RECORD_LAYOUT
/begin RECORD_LAYOUT Lookup2D_WORD FNC_VALUES 1 SWORD COLUMN_DIR DIRECT /end RECORD_LAYOUT
/begin RECORD_LAYOUT Lookup2D_X_WORD AXIS_PTS_X 1 SWORD INDEX_INCR DIRECT /end RECORD_LAYOUT
/begin RECORD_LAYOUT Lookup2D_ULONG FNC_VALUES 1 ULONG COLUMN_DIR DIRECT /end RECORD_LAYOUT
/begin RECORD_LAYOUT Lookup2D_X_ULONG AXIS_PTS_X 1 ULONG INDEX_INCR DIRECT /end RECORD_LAYOUT
/begin RECORD_LAYOUT Lookup2D_LONG FNC_VALUES 1 SLONG COLUMN_DIR DIRECT /end RECORD_LAYOUT
/begin RECORD_LAYOUT Lookup2D_X_LONG AXIS_PTS_X 1 SLONG INDEX_INCR DIRECT /end RECORD_LAYOUT
/begin RECORD_LAYOUT Lookup2D_FLOAT32_IEEE FNC_VALUES 1 FLOAT32_IEEE COLUMN_DIR DIRECT /end RECORD_LAYOUT
/begin RECORD_LAYOUT Lookup2D_X_FLOAT32_IEEE AXIS_PTS_X 1 FLOAT32_IEEE INDEX_INCR DIRECT /end RECORD_LAYOUT
/begin RECORD_LAYOUT Lookup2D_FLOAT64_IEEE FNC_VALUES 1 FLOAT64_IEEE COLUMN_DIR DIRECT /end RECORD_LAYOUT
/begin RECORD_LAYOUT Lookup2D_X_FLOAT64_IEEE AXIS_PTS_X 1 FLOAT64_IEEE INDEX_INCR DIRECT /end RECORD_LAYOUT
/begin CHARACTERISTIC KDID_CPSAVehSpdThres_kph "" VALUE 0x0000 /* @ECU_Address@KDID_CPSAVehSpdThres_kph@ */ Scalar_FLOAT32_IEEE 0 SWC_CARB_type_CM_single_sec 0.0 100.0 /end CHARACTERISTIC
/begin CHARACTERISTIC KDID_IPSAVehSpdThres_kph "" VALUE 0x0000 /* @ECU_Address@KDID_IPSAVehSpdThres_kph@ */ Scalar_FLOAT32_IEEE 0 SWC_CARB_type_CM_single_sec 0.0 2.0 /end CHARACTERISTIC
/begin CHARACTERISTIC KDID_PropActiveTripThres_s "" VALUE 0x0000 /* @ECU_Address@KDID_PropActiveTripThres_s@ */ Scalar_FLOAT32_IEEE 0 SWC_CARB_type_CM_single_sec 0.0 10.0 /end CHARACTERISTIC
/begin CHARACTERISTIC KDID_PSARResetThres_sec "" VALUE 0x0000 /* @ECU_Address@KDID_PSARResetThres_sec@ */ Scalar_ULONG 0 SWC_CARB_type_CM_uint32_sec 0.0 4.294967295E+9 /end CHARACTERISTIC
/begin CHARACTERISTIC KDID_DIDModelVersion_raw "" VALUE 0x0000 /* @ECU_Address@KDID_DIDModelVersion_raw@ */ Scalar_UBYTE 0 SWC_CARB_type_CM_uint8_enum 0.0 255.0 /end CHARACTERISTIC
/begin MEASUREMENT VDID_PSAR_sec "" ULONG SWC_CARB_type_CM_uint32_sec 0 0 0.0 4.294967295E+9 ECU_ADDRESS 0x0000 /* @ECU_Address@VDID_PSAR_sec@ */ /end MEASUREMENT
/begin MEASUREMENT VDID_CPSAL_sec "" ULONG SWC_CARB_type_CM_uint32_sec 0 0 0.0 4.294967295E+9 ECU_ADDRESS 0x0000 /* @ECU_Address@VDID_CPSAL_sec@ */ /end MEASUREMENT
/begin MEASUREMENT VDID_CPSAR_sec "" ULONG SWC_CARB_type_CM_uint32_sec 0 0 0.0 4.294967295E+9 ECU_ADDRESS 0x0000 /* @ECU_Address@VDID_CPSAR_sec@ */ /end MEASUREMENT
/begin MEASUREMENT VDID_IPSAL_sec "" ULONG SWC_CARB_type_CM_uint32_sec 0 0 0.0 4.294967295E+9 ECU_ADDRESS 0x0000 /* @ECU_Address@VDID_IPSAL_sec@ */ /end MEASUREMENT
/begin MEASUREMENT VDID_IPSAR_sec "" ULONG SWC_CARB_type_CM_uint32_sec 0 0 0.0 4.294967295E+9 ECU_ADDRESS 0x0000 /* @ECU_Address@VDID_IPSAR_sec@ */ /end MEASUREMENT
/begin MEASUREMENT VDID_PSAL_sec "" ULONG SWC_CARB_type_CM_uint32_sec 0 0 0.0 4.294967295E+9 ECU_ADDRESS 0x0000 /* @ECU_Address@VDID_PSAL_sec@ */ /end MEASUREMENT
/begin MEASUREMENT VDID_QTYPSATRIPSR_cnt "" ULONG SWC_CARB_type_CM_uint32_cnt 0 0 0.0 4.294967295E+9 ECU_ADDRESS 0x0000 /* @ECU_Address@VDID_QTYPSATRIPSR_cnt@ */ /end MEASUREMENT
/begin MEASUREMENT VDID_QTYPSATRIPSL_cnt "" ULONG SWC_CARB_type_CM_uint32_cnt 0 0 0.0 4.294967295E+9 ECU_ADDRESS 0x0000 /* @ECU_Address@VDID_QTYPSATRIPSL_cnt@ */ /end MEASUREMENT
/begin MEASUREMENT VDID_ODOMETER_km "" FLOAT32_IEEE SWC_CARB_type_CM_single_km 0 0 0.0 4.294967295E+8 ECU_ADDRESS 0x0000 /* @ECU_Address@VDID_ODOMETER_km@ */ /end MEASUREMENT
/begin MEASUREMENT VDID_ResetCDEODTR_km "" FLOAT32_IEEE SWC_CARB_type_CM_single_km 0 0 0.0 4.294967295E+8 ECU_ADDRESS 0x0000 /* @ECU_Address@VDID_ResetCDEODTR_km@ */ /end MEASUREMENT
/begin MEASUREMENT VDID_CDEODTR_km "" FLOAT32_IEEE SWC_CARB_type_CM_single_km 0 0 0.0 4.294967295E+8 ECU_ADDRESS 0x0000 /* @ECU_Address@VDID_CDEODTR_km@ */ /end MEASUREMENT
/begin MEASUREMENT VDID_PKERNumerator_kphsqr "" FLOAT32_IEEE SWC_CARB_type_CM_single_kphsqr 0 0 0.0 3.4028E+38 ECU_ADDRESS 0x0000 /* @ECU_Address@VDID_PKERNumerator_kphsqr@ */ /end MEASUREMENT
/begin MEASUREMENT VDID_PKER_kphsqr "" FLOAT32_IEEE SWC_CARB_type_CM_single_kphsqr 0 0 0.0 4.294967295E+9 ECU_ADDRESS 0x0000 /* @ECU_Address@VDID_PKER_kphsqr@ */ /end MEASUREMENT
/begin MEASUREMENT VDID_PKELNumerator_kphsqr "" FLOAT32_IEEE SWC_CARB_type_CM_single_kphsqr 0 0 0.0 3.4028E+38 ECU_ADDRESS 0x0000 /* @ECU_Address@VDID_PKELNumerator_kphsqr@ */ /end MEASUREMENT
/begin MEASUREMENT VDID_CDEODTL_km "" FLOAT32_IEEE SWC_CARB_type_CM_single_km 0 0 -40.0 215.0 ECU_ADDRESS 0x0000 /* @ECU_Address@VDID_CDEODTL_km@ */ /end MEASUREMENT
/begin MEASUREMENT VDID_PKEL_kphsqr "" FLOAT32_IEEE SWC_CARB_type_CM_single_kphsqr 0 0 0.0 4.294967295E+9 ECU_ADDRESS 0x0000 /* @ECU_Address@VDID_PKEL_kphsqr@ */ /end MEASUREMENT
/begin MEASUREMENT VDID_MILDIST_km "" FLOAT32_IEEE SWC_CARB_type_CM_single_km 0 0 0.0 65535.0 ECU_ADDRESS 0x0000 /* @ECU_Address@VDID_MILDIST_km@ */ /end MEASUREMENT
/begin MEASUREMENT VDID_CLRDIST_km "" FLOAT32_IEEE SWC_CARB_type_CM_single_km 0 0 0.0 65535.0 ECU_ADDRESS 0x0000 /* @ECU_Address@VDID_CLRDIST_km@ */ /end MEASUREMENT
/begin MEASUREMENT VDID_VSS_kph "" FLOAT32_IEEE SWC_CARB_type_CM_single_kph 0 0 0.0 255.0 ECU_ADDRESS 0x0000 /* @ECU_Address@VDID_VSS_kph@ */ /end MEASUREMENT
/begin MEASUREMENT VDID_APPD_pct "" FLOAT32_IEEE SWC_CARB_type_CM_single_pct 0 0 0.0 100.0 ECU_ADDRESS 0x0000 /* @ECU_Address@VDID_APPD_pct@ */ /end MEASUREMENT
/begin MEASUREMENT VDID_APPE_pct "" FLOAT32_IEEE SWC_CARB_type_CM_single_pct 0 0 0.0 100.0 ECU_ADDRESS 0x0000 /* @ECU_Address@VDID_APPE_pct@ */ /end MEASUREMENT
/begin MEASUREMENT VDID_RUNTM_s "" UWORD SWC_CARB_type_CM_uint16_s 0 0 0.0 65535.0 ECU_ADDRESS 0x0000 /* @ECU_Address@VDID_RUNTM_s@ */ /end MEASUREMENT
/begin MEASUREMENT VDID_NUMPSATRIPSFLTMEMCLR_cnt "" UWORD SWC_CARB_type_CM_uint16_cnt 0 0 0.0 65535.0 ECU_ADDRESS 0x0000 /* @ECU_Address@VDID_NUMPSATRIPSFLTMEMCLR_cnt@ */ /end MEASUREMENT
/begin MEASUREMENT VDID_ECUNAME_cnt "" UBYTE SWC_CARB_type_CM_uint8 0 0 0 255 ARRAY_SIZE 20 ECU_ADDRESS 0x0000 /* @ECU_Address@VDID_ECUNAME_cnt@ */ /end MEASUREMENT
/begin MEASUREMENT VDID_VinCode_cnt "" UBYTE SWC_CARB_type_CM_uint8 0 0 0 255 ARRAY_SIZE 17 ECU_ADDRESS 0x0000 /* @ECU_Address@VDID_VinCode_cnt@ */ /end MEASUREMENT
/begin MEASUREMENT VDID_CALID_cnt "" UBYTE SWC_CARB_type_CM_uint8 0 0 0 255 ARRAY_SIZE 16 ECU_ADDRESS 0x0000 /* @ECU_Address@VDID_CALID_cnt@ */ /end MEASUREMENT
/begin MEASUREMENT VDID_PROTOCOLID_enum "" UBYTE SWC_CARB_type_CM_uint8_enum 0 0 0.0 2.0 ECU_ADDRESS 0x0000 /* @ECU_Address@VDID_PROTOCOLID_enum@ */ /end MEASUREMENT
/begin MEASUREMENT VDID_DIDModelVersion_raw "" UBYTE SWC_CARB_type_CM_uint8_raw 0 0 0.0 255.0 ECU_ADDRESS 0x0000 /* @ECU_Address@VDID_DIDModelVersion_raw@ */ /end MEASUREMENT
/begin MEASUREMENT VDID_DIDModelVersionChksum_raw "" UBYTE SWC_CARB_type_CM_uint8_raw 0 0 0.0 255.0 ECU_ADDRESS 0x0000 /* @ECU_Address@VDID_DIDModelVersionChksum_raw@ */ /end MEASUREMENT
/begin COMPU_METHOD SWC_CARB_type_CM_single_sec "Q = V" RAT_FUNC "%8.6" "sec" COEFFS 0 1 0 0 0 1 /end COMPU_METHOD
/begin COMPU_METHOD SWC_CARB_type_CM_uint32_sec "Q = V" RAT_FUNC "%10.0" "sec" COEFFS 0 1 0 0 0 1 /end COMPU_METHOD
/begin COMPU_METHOD SWC_CARB_type_CM_uint8_enum "Q = V" RAT_FUNC "%3.0" "enum" COEFFS 0 1 0 0 0 1 /end COMPU_METHOD
/begin COMPU_METHOD SWC_CARB_type_CM_uint32_cnt "Q = V" RAT_FUNC "%10.0" "cnt" COEFFS 0 1 0 0 0 1 /end COMPU_METHOD
/begin COMPU_METHOD SWC_CARB_type_CM_single_km "Q = V" RAT_FUNC "%8.6" "km" COEFFS 0 1 0 0 0 1 /end COMPU_METHOD
/begin COMPU_METHOD SWC_CARB_type_CM_single_kphsqr "Q = V" RAT_FUNC "%8.6" "kphsqr" COEFFS 0 1 0 0 0 1 /end COMPU_METHOD
/begin COMPU_METHOD SWC_CARB_type_CM_single_kph "Q = V" RAT_FUNC "%8.6" "kph" COEFFS 0 1 0 0 0 1 /end COMPU_METHOD
/begin COMPU_METHOD SWC_CARB_type_CM_single_pct "Q = V" RAT_FUNC "%8.6" "pct" COEFFS 0 1 0 0 0 1 /end COMPU_METHOD
/begin COMPU_METHOD SWC_CARB_type_CM_uint16_s "Q = V" RAT_FUNC "%5.0" "s" COEFFS 0 1 0 0 0 1 /end COMPU_METHOD
/begin COMPU_METHOD SWC_CARB_type_CM_uint16_cnt "Q = V" RAT_FUNC "%5.0" "cnt" COEFFS 0 1 0 0 0 1 /end COMPU_METHOD
/begin COMPU_METHOD SWC_CARB_type_CM_uint8 "Q = V" RAT_FUNC "%3.0" "" COEFFS 0 1 0 0 0 1 /end COMPU_METHOD
/begin COMPU_METHOD SWC_CARB_type_CM_uint8_raw "Q = V" RAT_FUNC "%3.0" "raw" COEFFS 0 1 0 0 0 1 /end COMPU_METHOD
/begin GROUP SWC_CARB_type "SWC_CARB_type" /* Root */ ROOT /begin SUB_GROUP Root_run_SWC_CARB_5ms_sys /end SUB_GROUP /end GROUP
/begin GROUP Root_run_SWC_CARB_5ms_sys "SWC_CARB_type/run_SWC_CARB_5ms_sys" /begin SUB_GROUP S2_DID /end SUB_GROUP /end GROUP
/begin GROUP S2_DID "SWC_CARB_type/run_SWC_CARB_5ms_sys/DID" /begin SUB_GROUP S3_Subsystem /end SUB_GROUP /end GROUP
/begin GROUP S3_Subsystem "SWC_CARB_type/run_SWC_CARB_5ms_sys/DID/Subsystem"
 /begin SUB_GROUP S5_0xF819__Total_Propulsion_System_Active_Time S5_Initializable_U32counter S5_Initializable_U32counter1 S5_Subsystem /end SUB_GROUP
 /begin REF_CHARACTERISTIC KDID_PropActiveTripThres_s /end REF_CHARACTERISTIC
 /begin REF_MEASUREMENT VDID_APPD_pct VDID_APPE_pct VDID_CALID_cnt VDID_CDEODTL_km VDID_CDEODTR_km VDID_CLRDIST_km VDID_ECUNAME_cnt VDID_MILDIST_km VDID_NUMPSATRIPSFLTMEMCLR_cnt VDID_ODOMETER_km VDID_PKELNumerator_kphsqr VDID_PKEL_kphsqr VDID_PKERNumerator_kphsqr VDID_PKER_kphsqr VDID_PROTOCOLID_enum VDID_RUNTM_s VDID_ResetCDEODTR_km VDID_VSS_kph VDID_VinCode_cnt /end REF_MEASUREMENT
/end GROUP
/begin GROUP S5_0xF819__Total_Propulsion_System_Active_Time "SWC_CARB_type/run_SWC_CARB_5ms_sys/DID/Subsystem/0xF819: Total Propulsion System Active Time"
 /begin SUB_GROUP S6_Seconds_Counter S6_Seconds_Counter1 S6_Seconds_Counter2 S6_Seconds_Counter3 S6_Seconds_Counter4 S6_Seconds_Counter5 /end SUB_GROUP
 /begin REF_CHARACTERISTIC KDID_CPSAVehSpdThres_kph KDID_IPSAVehSpdThres_kph KDID_PSARResetThres_sec /end REF_CHARACTERISTIC
/end GROUP
/begin GROUP S5_Initializable_U32counter "SWC_CARB_type/run_SWC_CARB_5ms_sys/DID/Subsystem/Initializable_U32counter" /begin REF_MEASUREMENT VDID_QTYPSATRIPSR_cnt /end REF_MEASUREMENT /end GROUP
/begin GROUP S5_Initializable_U32counter1 "SWC_CARB_type/run_SWC_CARB_5ms_sys/DID/Subsystem/Initializable_U32counter1" /begin REF_MEASUREMENT VDID_QTYPSATRIPSL_cnt /end REF_MEASUREMENT /end GROUP
/begin GROUP S5_Subsystem "SWC_CARB_type/run_SWC_CARB_5ms_sys/DID/Subsystem/Subsystem" /begin SUB_GROUP S27_Checksum /end SUB_GROUP /begin REF_CHARACTERISTIC KDID_DIDModelVersion_raw /end REF_CHARACTERISTIC /begin REF_MEASUREMENT VDID_DIDModelVersion_raw /end REF_MEASUREMENT /end GROUP
/begin GROUP S6_Seconds_Counter "SWC_CARB_type/run_SWC_CARB_5ms_sys/DID/Subsystem/0xF819: Total Propulsion System Active Time/Seconds_Counter" /begin REF_MEASUREMENT VDID_PSAR_sec /end REF_MEASUREMENT /end GROUP
/begin GROUP S6_Seconds_Counter1 "SWC_CARB_type/run_SWC_CARB_5ms_sys/DID/Subsystem/0xF819: Total Propulsion System Active Time/Seconds_Counter1" /begin REF_MEASUREMENT VDID_PSAL_sec /end REF_MEASUREMENT /end GROUP
/begin GROUP S6_Seconds_Counter2 "SWC_CARB_type/run_SWC_CARB_5ms_sys/DID/Subsystem/0xF819: Total Propulsion System Active Time/Seconds_Counter2" /begin REF_MEASUREMENT VDID_IPSAR_sec /end REF_MEASUREMENT /end GROUP
/begin GROUP S6_Seconds_Counter3 "SWC_CARB_type/run_SWC_CARB_5ms_sys/DID/Subsystem/0xF819: Total Propulsion System Active Time/Seconds_Counter3" /begin REF_MEASUREMENT VDID_IPSAL_sec /end REF_MEASUREMENT /end GROUP
/begin GROUP S6_Seconds_Counter4 "SWC_CARB_type/run_SWC_CARB_5ms_sys/DID/Subsystem/0xF819: Total Propulsion System Active Time/Seconds_Counter4" /begin REF_MEASUREMENT VDID_CPSAR_sec /end REF_MEASUREMENT /end GROUP
/begin GROUP S6_Seconds_Counter5 "SWC_CARB_type/run_SWC_CARB_5ms_sys/DID/Subsystem/0xF819: Total Propulsion System Active Time/Seconds_Counter5" /begin REF_MEASUREMENT VDID_CPSAL_sec /end REF_MEASUREMENT /end GROUP
/begin GROUP S27_Checksum "SWC_CARB_type/run_SWC_CARB_5ms_sys/DID/Subsystem/Subsystem/Checksum" /begin REF_MEASUREMENT VDID_DIDModelVersionChksum_raw /end REF_MEASUREMENT /end GROUP
/end MODULE
/end PROJECT
/* (add any file trailer comments here) */
/* EOF SWC_CARB_type.a2l */
