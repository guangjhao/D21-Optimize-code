AUTOSAR XML (schema 4-3-0)
package /FVT_UDS_Impl_Type_ARPkg
  impl type u32Array10_UdsDtcHeader_type: category=ARRAY
    element u32HeaderData: category=VALUE, array-size=10, array-size-semantics=FIXED-SIZE, base-type=uint32
  impl type u32Array320_UdsDTC_type: category=ARRAY
    element u32_DTCData: category=VALUE, array-size=320, array-size-semantics=FIXED-SIZE, base-type=uint32
package /FVT_UDS_Interface_ARPkg
  client server interface IF_UDSCDD
    operation CSOP_DdmClearDTCNotification
      arg u8_ClearDTCcmd: type=uint8, direction=OUT, server-argument-impl-policy=USE-ARGUMENT-TYPE
    operation CSOP_DdmRestartOperationCycle
    operation CSOP_SetDTCStatus
      arg u8_ReturnStatus: type=uint8, direction=OUT, server-argument-impl-policy=USE-ARGUMENT-TYPE
      arg u32Array10_Header: type=u32Array10_UdsDtcHeader_type, direction=IN, server-argument-impl-policy=USE-ARGUMENT-TYPE
      arg u32Array320_DTC: type=u32Array320_UdsDTC_type, direction=IN, server-argument-impl-policy=USE-ARGUMENT-TYPE
