ASAP2_VERSION 1 31
/begin PROJECT ProjectName "Project Comment Goes Here"
/begin HEADER "Header Comments go here" /end HEADER
/begin MODULE ModuleName "Module Comment Goes Here"
/begin MOD_COMMON "Mod Common Comment Here" BYTE_ORDER MSB_LAST /end MOD_COMMON
/begin RECORD_LAYOUT Scalar_BOOLEAN FNC_VALUES 1 UBYTE COLUMN_DIR DIRECT /end RECORD_LAYOUT
/begin RECORD_LAYOUT Scalar_UBYTE FNC_VALUES 1 UBYTE COLUMN_DIR DIRECT /end RECORD_LAYOUT
/begin RECORD_LAYOUT Scalar_UWORD FNC_VALUES 1 UWORD COLUMN_DIR DIRECT /end RECORD_LAYOUT
/begin RECORD_LAYOUT Scalar_FLOAT32_IEEE FNC_VALUES 1 FLOAT32_IEEE COLUMN_DIR DIRECT /end RECORD_LAYOUT
/begin RECORD_LAYOUT Lookup1D_X_BYTE AXIS_PTS_X 1 SBYTE INDEX_INCR DIRECT /end RECORD_LAYOUT
/begin RECORD_LAYOUT Lookup1D_UWORD FNC_VALUES 1 UWORD COLUMN_DIR DIRECT /end RECORD_LAYOUT
/begin RECORD_LAYOUT Lookup1D_FLOAT32_IEEE FNC_VALUES 1 FLOAT32_IEEE COLUMN_DIR DIRECT /end RECORD_LAYOUT
/begin RECORD_LAYOUT Lookup1D_X_FLOAT32_IEEE AXIS_PTS_X 1 FLOAT32_IEEE INDEX_INCR DIRECT /end RECORD_LAYOUT
/begin RECORD_LAYOUT Lookup2D_FLOAT32_IEEE FNC_VALUES 1 FLOAT32_IEEE COLUMN_DIR DIRECT /end RECORD_LAYOUT
/begin RECORD_LAYOUT Lookup2D_X_FLOAT32_IEEE AXIS_PTS_X 1 FLOAT32_IEEE INDEX_INCR DIRECT /end RECORD_LAYOUT
/begin CHARACTERISTIC MTHC_APTCQA_Y_W "" CURVE 0x0000 /* @ECU_Address@MTHC_APTCQA_Y_W@ */ Lookup1D_FLOAT32_IEEE 0 SWC_FDC_type_CM_single_W 0.0 10000.0
 /begin AXIS_DESCR COM_AXIS NO_INPUT_QUANTITY SWC_FDC_type_CM_single_C 10 -40.0 200.0 AXIS_PTS_REF ATHC_APTCQA_X_C /end AXIS_DESCR
/end CHARACTERISTIC
/begin AXIS_PTS ATHC_APTCQA_X_C "" 0x0000 /* @ECU_Address@ATHC_APTCQA_X_C@ */ NO_INPUT_QUANTITY Lookup1D_X_FLOAT32_IEEE 0 SWC_FDC_type_CM_single_C 10 -40.0 200.0 /end AXIS_PTS
/begin CHARACTERISTIC MTHC_APTCQB_Y_W "" CURVE 0x0000 /* @ECU_Address@MTHC_APTCQB_Y_W@ */ Lookup1D_FLOAT32_IEEE 0 SWC_FDC_type_CM_single_W 0.0 10000.0
 /begin AXIS_DESCR COM_AXIS NO_INPUT_QUANTITY SWC_FDC_type_CM_single_C 10 -40.0 200.0 AXIS_PTS_REF ATHC_APTCQB_X_C /end AXIS_DESCR
/end CHARACTERISTIC
/begin AXIS_PTS ATHC_APTCQB_X_C "" 0x0000 /* @ECU_Address@ATHC_APTCQB_X_C@ */ NO_INPUT_QUANTITY Lookup1D_X_FLOAT32_IEEE 0 SWC_FDC_type_CM_single_C 10 -40.0 200.0 /end AXIS_PTS
/begin CHARACTERISTIC MTQD_AfterTqMinGain_Y_c "" CURVE 0x0000 /* @ECU_Address@MTQD_AfterTqMinGain_Y_c@ */ Lookup1D_FLOAT32_IEEE 0 SWC_FDC_type_CM_single_c 0.0 1.0
 /begin AXIS_DESCR COM_AXIS NO_INPUT_QUANTITY SWC_FDC_type_CM_single_Deg 19 -90.0 90.0 AXIS_PTS_REF ATQD_AfterTqMinGain_X_Deg /end AXIS_DESCR
/end CHARACTERISTIC
/begin AXIS_PTS ATQD_AfterTqMinGain_X_Deg "" 0x0000 /* @ECU_Address@ATQD_AfterTqMinGain_X_Deg@ */ NO_INPUT_QUANTITY Lookup1D_X_FLOAT32_IEEE 0 SWC_FDC_type_CM_single_Deg 19 -90.0 90.0 /end AXIS_PTS
/begin CHARACTERISTIC MTQD_FAfterTqCMDGain_Z_c "" MAP 0x0000 /* @ECU_Address@MTQD_FAfterTqCMDGain_Z_c@ */ Lookup2D_FLOAT32_IEEE 0 SWC_FDC_type_CM_single_c 0.0 1.0
 /begin AXIS_DESCR COM_AXIS VTQD_FrShaftSpd_rpm SWC_FDC_type_CM_single_rpm 17 -100000.0 100000.0 AXIS_PTS_REF ATQD_FAfterTqCMDGain_X_rpm /end AXIS_DESCR
 /begin AXIS_DESCR COM_AXIS VTQD_FrontSlideRate_pct SWC_FDC_type_CM_single_pct 19 -125.0 125.0 AXIS_PTS_REF ATQD_FAfterTqCMDGain_Y_pct /end AXIS_DESCR
/end CHARACTERISTIC
/begin AXIS_PTS ATQD_FAfterTqCMDGain_Y_pct "" 0x0000 /* @ECU_Address@ATQD_FAfterTqCMDGain_Y_pct@ */ VTQD_FrontSlideRate_pct Lookup2D_X_FLOAT32_IEEE 0 SWC_FDC_type_CM_single_pct 19 -125.0 125.0 /end AXIS_PTS
/begin AXIS_PTS ATQD_FAfterTqCMDGain_X_rpm "" 0x0000 /* @ECU_Address@ATQD_FAfterTqCMDGain_X_rpm@ */ VTQD_FrShaftSpd_rpm Lookup2D_X_FLOAT32_IEEE 0 SWC_FDC_type_CM_single_rpm 17 -100000.0 100000.0 /end AXIS_PTS
/begin CHARACTERISTIC MTQD_RAfterTqCMDGain_Z_c "" MAP 0x0000 /* @ECU_Address@MTQD_RAfterTqCMDGain_Z_c@ */ Lookup2D_FLOAT32_IEEE 0 SWC_FDC_type_CM_single_c 0.0 1.0
 /begin AXIS_DESCR COM_AXIS VTQD_RrShaftSpd_rpm SWC_FDC_type_CM_single_rpm 17 -100000.0 100000.0 AXIS_PTS_REF ATQD_FAfterTqCMDGain_X_rpm /end AXIS_DESCR
 /begin AXIS_DESCR COM_AXIS VTQD_RearSlideRate_pct SWC_FDC_type_CM_single_pct 19 -125.0 125.0 AXIS_PTS_REF ATQD_FAfterTqCMDGain_Y_pct /end AXIS_DESCR
/end CHARACTERISTIC
/begin CHARACTERISTIC MTQD_AWDLoadTrqnsGain_Z_c "" MAP 0x0000 /* @ECU_Address@MTQD_AWDLoadTrqnsGain_Z_c@ */ Lookup2D_FLOAT32_IEEE 0 SWC_FDC_type_CM_single_c 0.0 1.5
 /begin AXIS_DESCR COM_AXIS VTQD_EstVehWeightResult_kg SWC_FDC_type_CM_single_kg 27 0.0 10000.0 AXIS_PTS_REF ATQD_AWDLoadTrqnsGain_X_kg /end AXIS_DESCR
 /begin AXIS_DESCR COM_AXIS VTQD_AWDLoadTrqnsGain_pct SWC_FDC_type_CM_single_pct 27 -1.0 125.0 AXIS_PTS_REF ATQD_AWDLoadTrqnsGain_Y_pct /end AXIS_DESCR
/end CHARACTERISTIC
/begin AXIS_PTS ATQD_AWDLoadTrqnsGain_Y_pct "" 0x0000 /* @ECU_Address@ATQD_AWDLoadTrqnsGain_Y_pct@ */ VTQD_AWDLoadTrqnsGain_pct Lookup2D_X_FLOAT32_IEEE 0 SWC_FDC_type_CM_single_pct 27 -1.0 125.0 /end AXIS_PTS
/begin AXIS_PTS ATQD_AWDLoadTrqnsGain_X_kg "" 0x0000 /* @ECU_Address@ATQD_AWDLoadTrqnsGain_X_kg@ */ VTQD_EstVehWeightResult_kg Lookup2D_X_FLOAT32_IEEE 0 SWC_FDC_type_CM_single_kg 27 0.0 10000.0 /end AXIS_PTS
/begin CHARACTERISTIC MTQD_CreepRrTqSpRat_Z_rat "" MAP 0x0000 /* @ECU_Address@MTQD_CreepRrTqSpRat_Z_rat@ */ Lookup2D_FLOAT32_IEEE 0 SWC_FDC_type_CM_single_rat 0.0 1.0
 /begin AXIS_DESCR COM_AXIS VTQD_RrShaftSpd_rpm SWC_FDC_type_CM_single_rpm 15 -100000.0 100000.0 AXIS_PTS_REF ATQD_CreepRrTqSpRat_X_rpm /end AXIS_DESCR
 /begin AXIS_DESCR COM_AXIS VTQD_DriverWhlTqDem_Nm SWC_FDC_type_CM_single_Nm 18 -100000.0 100000.0 AXIS_PTS_REF ATQD_CreepRrTqSpRat_Y_Nm /end AXIS_DESCR
/end CHARACTERISTIC
/begin AXIS_PTS ATQD_CreepRrTqSpRat_Y_Nm "" 0x0000 /* @ECU_Address@ATQD_CreepRrTqSpRat_Y_Nm@ */ VTQD_DriverWhlTqDem_Nm Lookup2D_X_FLOAT32_IEEE 0 SWC_FDC_type_CM_single_Nm 18 -100000.0 100000.0 /end AXIS_PTS
/begin AXIS_PTS ATQD_CreepRrTqSpRat_X_rpm "" 0x0000 /* @ECU_Address@ATQD_CreepRrTqSpRat_X_rpm@ */ VTQD_RrShaftSpd_rpm Lookup2D_X_FLOAT32_IEEE 0 SWC_FDC_type_CM_single_rpm 15 -100000.0 100000.0 /end AXIS_PTS
/begin CHARACTERISTIC MTQD_ECORrEDUSpRat_Z_rat "" MAP 0x0000 /* @ECU_Address@MTQD_ECORrEDUSpRat_Z_rat@ */ Lookup2D_FLOAT32_IEEE 0 SWC_FDC_type_CM_single_gain 0.0 1.0
 /begin AXIS_DESCR COM_AXIS VTQD_RrShaftSpd_rpm SWC_FDC_type_CM_single_rpm 27 -100000.0 100000.0 AXIS_PTS_REF ATQD_NRMRrEDUSpRat_X_rpm /end AXIS_DESCR
 /begin AXIS_DESCR COM_AXIS VTQD_DriverWhlTqDem_Nm SWC_FDC_type_CM_single_Nm 27 -100000.0 100000.0 AXIS_PTS_REF ATQD_NRMRrEDUSpRat_Y_Nm /end AXIS_DESCR
/end CHARACTERISTIC
/begin AXIS_PTS ATQD_NRMRrEDUSpRat_Y_Nm "" 0x0000 /* @ECU_Address@ATQD_NRMRrEDUSpRat_Y_Nm@ */ VTQD_DriverWhlTqDem_Nm Lookup2D_X_FLOAT32_IEEE 0 SWC_FDC_type_CM_single_Nm 27 -100000.0 100000.0 /end AXIS_PTS
/begin AXIS_PTS ATQD_NRMRrEDUSpRat_X_rpm "" 0x0000 /* @ECU_Address@ATQD_NRMRrEDUSpRat_X_rpm@ */ VTQD_RrShaftSpd_rpm Lookup2D_X_FLOAT32_IEEE 0 SWC_FDC_type_CM_single_rpm 27 -100000.0 100000.0 /end AXIS_PTS
/begin CHARACTERISTIC MTQD_EscapeModePedTqFr_Z_Nm "" MAP 0x0000 /* @ECU_Address@MTQD_EscapeModePedTqFr_Z_Nm@ */ Lookup2D_FLOAT32_IEEE 0 SWC_FDC_type_CM_single_Nm -100000.0 100000.0
 /begin AXIS_DESCR COM_AXIS VTQD_ActAPSPosn_pct SWC_FDC_type_CM_single_kph 7 -1.0 255.0 AXIS_PTS_REF ATQD_EscapeModePedTqFr_X_pct /end AXIS_DESCR
 /begin AXIS_DESCR COM_AXIS VTQD_FrShaftSpd_rpm SWC_FDC_type_CM_single_rpm 9 -100000.0 100000.0 AXIS_PTS_REF ATQD_EscapeModePedTqFr_Y_rpm /end AXIS_DESCR
/end CHARACTERISTIC
/begin AXIS_PTS ATQD_EscapeModePedTqFr_Y_rpm "" 0x0000 /* @ECU_Address@ATQD_EscapeModePedTqFr_Y_rpm@ */ VTQD_FrShaftSpd_rpm Lookup2D_X_FLOAT32_IEEE 0 SWC_FDC_type_CM_single_rpm 9 -100000.0 100000.0 /end AXIS_PTS
/begin AXIS_PTS ATQD_EscapeModePedTqFr_X_pct "" 0x0000 /* @ECU_Address@ATQD_EscapeModePedTqFr_X_pct@ */ VTQD_ActAPSPosn_pct Lookup2D_X_FLOAT32_IEEE 0 SWC_FDC_type_CM_single_kph 7 -1.0 255.0 /end AXIS_PTS
/begin CHARACTERISTIC MTQD_EscapeModePedTqRr_Z_Nm "" MAP 0x0000 /* @ECU_Address@MTQD_EscapeModePedTqRr_Z_Nm@ */ Lookup2D_FLOAT32_IEEE 0 SWC_FDC_type_CM_single_Nm -100000.0 100000.0
 /begin AXIS_DESCR COM_AXIS VTQD_ActAPSPosn_pct SWC_FDC_type_CM_single_kph 7 -1.0 255.0 AXIS_PTS_REF ATQD_EscapeModePedTqFr_X_pct /end AXIS_DESCR
 /begin AXIS_DESCR COM_AXIS VTQD_RrShaftSpd_rpm SWC_FDC_type_CM_single_rpm 9 -100000.0 100000.0 AXIS_PTS_REF ATQD_EscapeModePedTqFr_Y_rpm /end AXIS_DESCR
/end CHARACTERISTIC
/begin CHARACTERISTIC MTQD_NRMRrEDUSpRat_Z_rat "" MAP 0x0000 /* @ECU_Address@MTQD_NRMRrEDUSpRat_Z_rat@ */ Lookup2D_FLOAT32_IEEE 0 SWC_FDC_type_CM_single_gain 0.0 1.0
 /begin AXIS_DESCR COM_AXIS VTQD_RrShaftSpd_rpm SWC_FDC_type_CM_single_rpm 27 -100000.0 100000.0 AXIS_PTS_REF ATQD_NRMRrEDUSpRat_X_rpm /end AXIS_DESCR
 /begin AXIS_DESCR COM_AXIS VTQD_DriverWhlTqDem_Nm SWC_FDC_type_CM_single_Nm 27 -100000.0 100000.0 AXIS_PTS_REF ATQD_NRMRrEDUSpRat_Y_Nm /end AXIS_DESCR
/end CHARACTERISTIC
/begin CHARACTERISTIC MTQD_RrRatioWithFrSR_Z_rat "" MAP 0x0000 /* @ECU_Address@MTQD_RrRatioWithFrSR_Z_rat@ */ Lookup2D_FLOAT32_IEEE 0 SWC_FDC_type_CM_single_rat 0.0 1.0
 /begin AXIS_DESCR COM_AXIS VTQD_FrontSlideRate_pct SWC_FDC_type_CM_single_pct 23 -125.0 125.0 AXIS_PTS_REF ATQD_RrRatioWithFrSR_X_pct /end AXIS_DESCR
 /begin AXIS_DESCR COM_AXIS VTQD_OrigRrDriverRatio_rat SWC_FDC_type_CM_single_rat 11 0.0 1.0 AXIS_PTS_REF ATQD_RrRatioWithFrSR_Y_rat /end AXIS_DESCR
/end CHARACTERISTIC
/begin AXIS_PTS ATQD_RrRatioWithFrSR_Y_rat "" 0x0000 /* @ECU_Address@ATQD_RrRatioWithFrSR_Y_rat@ */ VTQD_OrigRrDriverRatio_rat Lookup2D_X_FLOAT32_IEEE 0 SWC_FDC_type_CM_single_rat 11 0.0 1.0 /end AXIS_PTS
/begin AXIS_PTS ATQD_RrRatioWithFrSR_X_pct "" 0x0000 /* @ECU_Address@ATQD_RrRatioWithFrSR_X_pct@ */ VTQD_FrontSlideRate_pct Lookup2D_X_FLOAT32_IEEE 0 SWC_FDC_type_CM_single_pct 23 -125.0 125.0 /end AXIS_PTS
/begin CHARACTERISTIC MTQD_RrRatioWithRrSR_Z_rat "" MAP 0x0000 /* @ECU_Address@MTQD_RrRatioWithRrSR_Z_rat@ */ Lookup2D_FLOAT32_IEEE 0 SWC_FDC_type_CM_single_rat 0.0 1.0
 /begin AXIS_DESCR COM_AXIS VTQD_RearSlideRate_pct SWC_FDC_type_CM_single_pct 23 -125.0 125.0 AXIS_PTS_REF ATQD_RrRatioWithFrSR_X_pct /end AXIS_DESCR
 /begin AXIS_DESCR COM_AXIS VTQD_RrRatioWithFrSR_rat SWC_FDC_type_CM_single_rat 11 0.0 1.0 AXIS_PTS_REF ATQD_RrRatioWithFrSR_Y_rat /end AXIS_DESCR
/end CHARACTERISTIC
/begin CHARACTERISTIC MTQD_RrTqSRRateTs_Y_c "" CURVE 0x0000 /* @ECU_Address@MTQD_RrTqSRRateTs_Y_c@ */ Lookup1D_FLOAT32_IEEE 0 SWC_FDC_type_CM_single_c 0.0 1.0
 /begin AXIS_DESCR COM_AXIS VTQD_ActAPSPosn_pct SWC_FDC_type_CM_single_pct 14 -10.0 125.0 AXIS_PTS_REF ATQD_RrTqSRRateTs_X_pct /end AXIS_DESCR
/end CHARACTERISTIC
/begin AXIS_PTS ATQD_RrTqSRRateTs_X_pct "" 0x0000 /* @ECU_Address@ATQD_RrTqSRRateTs_X_pct@ */ VTQD_ActAPSPosn_pct Lookup1D_X_FLOAT32_IEEE 0 SWC_FDC_type_CM_single_pct 14 -10.0 125.0 /end AXIS_PTS
/begin CHARACTERISTIC MTQD_SPORTRrEDUSpRat_Z_rat "" MAP 0x0000 /* @ECU_Address@MTQD_SPORTRrEDUSpRat_Z_rat@ */ Lookup2D_FLOAT32_IEEE 0 SWC_FDC_type_CM_single_gain 0.0 1.0
 /begin AXIS_DESCR COM_AXIS VTQD_RrShaftSpd_rpm SWC_FDC_type_CM_single_rpm 27 -100000.0 100000.0 AXIS_PTS_REF ATQD_NRMRrEDUSpRat_X_rpm /end AXIS_DESCR
 /begin AXIS_DESCR COM_AXIS VTQD_DriverWhlTqDem_Nm SWC_FDC_type_CM_single_Nm 27 -100000.0 100000.0 AXIS_PTS_REF ATQD_NRMRrEDUSpRat_Y_Nm /end AXIS_DESCR
/end CHARACTERISTIC
/begin CHARACTERISTIC MTQD_SnowMRrEDUSpRat_Z_rat "" MAP 0x0000 /* @ECU_Address@MTQD_SnowMRrEDUSpRat_Z_rat@ */ Lookup2D_FLOAT32_IEEE 0 SWC_FDC_type_CM_single_gain 0.0 1.0
 /begin AXIS_DESCR COM_AXIS VTQD_RrShaftSpd_rpm SWC_FDC_type_CM_single_rpm 27 -100000.0 100000.0 AXIS_PTS_REF ATQD_NRMRrEDUSpRat_X_rpm /end AXIS_DESCR
 /begin AXIS_DESCR COM_AXIS VTQD_DriverWhlTqDem_Nm SWC_FDC_type_CM_single_Nm 27 -100000.0 100000.0 AXIS_PTS_REF ATQD_NRMRrEDUSpRat_Y_Nm /end AXIS_DESCR
/end CHARACTERISTIC
/begin CHARACTERISTIC MVMC_PedalTqRWhlSlipGain_Z_Nm "" MAP 0x0000 /* @ECU_Address@MVMC_PedalTqRWhlSlipGain_Z_Nm@ */ Lookup2D_FLOAT32_IEEE 0 SWC_FDC_type_CM_single_Nm -10000.0 10000.0
 /begin AXIS_DESCR COM_AXIS VVMC_FrRrSlipRate_rat SWC_FDC_type_CM_single_rat 13 -1.0 1.0 AXIS_PTS_REF AVMC_PedalTqRWhlSlipGain_X_rat /end AXIS_DESCR
 /begin AXIS_DESCR COM_AXIS VVMC_VehicleSpeed_kph SWC_FDC_type_CM_single_kph 17 0.0 255.0 AXIS_PTS_REF AVMC_PedalTqRWhlSlipGain_Y_kph /end AXIS_DESCR
/end CHARACTERISTIC
/begin AXIS_PTS AVMC_PedalTqRWhlSlipGain_Y_kph "" 0x0000 /* @ECU_Address@AVMC_PedalTqRWhlSlipGain_Y_kph@ */ VVMC_VehicleSpeed_kph Lookup2D_X_FLOAT32_IEEE 0 SWC_FDC_type_CM_single_kph 17 0.0 255.0 /end AXIS_PTS
/begin AXIS_PTS AVMC_PedalTqRWhlSlipGain_X_rat "" 0x0000 /* @ECU_Address@AVMC_PedalTqRWhlSlipGain_X_rat@ */ VVMC_FrRrSlipRate_rat Lookup2D_X_FLOAT32_IEEE 0 SWC_FDC_type_CM_single_rat 13 -1.0 1.0 /end AXIS_PTS
/begin CHARACTERISTIC MVMC_RearWhlTqSlipGain_Z_Nm "" MAP 0x0000 /* @ECU_Address@MVMC_RearWhlTqSlipGain_Z_Nm@ */ Lookup2D_FLOAT32_IEEE 0 SWC_FDC_type_CM_single_Nm -10000.0 10000.0
 /begin AXIS_DESCR COM_AXIS VVMC_FrRrSlipRate_rat SWC_FDC_type_CM_single_rat 13 -1.0 1.0 AXIS_PTS_REF AVMC_RearWhlTqSlipGain_X_rat /end AXIS_DESCR
 /begin AXIS_DESCR COM_AXIS VVMC_VehicleSpeed_kph SWC_FDC_type_CM_single_kph 17 0.0 255.0 AXIS_PTS_REF AVMC_RearWhlTqSlipGain_Y_kph /end AXIS_DESCR
/end CHARACTERISTIC
/begin AXIS_PTS AVMC_RearWhlTqSlipGain_Y_kph "" 0x0000 /* @ECU_Address@AVMC_RearWhlTqSlipGain_Y_kph@ */ VVMC_VehicleSpeed_kph Lookup2D_X_FLOAT32_IEEE 0 SWC_FDC_type_CM_single_kph 17 0.0 255.0 /end AXIS_PTS
/begin AXIS_PTS AVMC_RearWhlTqSlipGain_X_rat "" 0x0000 /* @ECU_Address@AVMC_RearWhlTqSlipGain_X_rat@ */ VVMC_FrRrSlipRate_rat Lookup2D_X_FLOAT32_IEEE 0 SWC_FDC_type_CM_single_rat 13 -1.0 1.0 /end AXIS_PTS
/begin CHARACTERISTIC MVMC_PedalTqRWhSTRGGain_Z_Nm "" MAP 0x0000 /* @ECU_Address@MVMC_PedalTqRWhSTRGGain_Z_Nm@ */ Lookup2D_FLOAT32_IEEE 0 SWC_FDC_type_CM_single_Nm -10000.0 10000.0
 /begin AXIS_DESCR COM_AXIS NO_INPUT_QUANTITY SWC_FDC_type_CM_single_deg 8 -900.0 900.0 AXIS_PTS_REF AVMC_PedalTqRWhSTRGGain_X_deg /end AXIS_DESCR
 /begin AXIS_DESCR COM_AXIS VVMC_VehicleSpeed_kph SWC_FDC_type_CM_single_kph 8 0.0 255.0 AXIS_PTS_REF AVMC_PedalTqRWhSTRGGain_Y_kph /end AXIS_DESCR
/end CHARACTERISTIC
/begin AXIS_PTS AVMC_PedalTqRWhSTRGGain_Y_kph "" 0x0000 /* @ECU_Address@AVMC_PedalTqRWhSTRGGain_Y_kph@ */ VVMC_VehicleSpeed_kph Lookup2D_X_FLOAT32_IEEE 0 SWC_FDC_type_CM_single_kph 8 0.0 255.0 /end AXIS_PTS
/begin AXIS_PTS AVMC_PedalTqRWhSTRGGain_X_deg "" 0x0000 /* @ECU_Address@AVMC_PedalTqRWhSTRGGain_X_deg@ */ NO_INPUT_QUANTITY Lookup2D_X_FLOAT32_IEEE 0 SWC_FDC_type_CM_single_deg 8 -900.0 900.0 /end AXIS_PTS
/begin CHARACTERISTIC MVMC_PedalTqRWhlRatio_Z_rat "" MAP 0x0000 /* @ECU_Address@MVMC_PedalTqRWhlRatio_Z_rat@ */ Lookup2D_FLOAT32_IEEE 0 SWC_FDC_type_CM_single_rat 0.0 1.0
 /begin AXIS_DESCR COM_AXIS VVMC_VMCWhlTq4RatioCalcu_Nm SWC_FDC_type_CM_single_Nm 35 -10000.0 10000.0 AXIS_PTS_REF AVMC_PedalTqRWhlRatio_X_Nm /end AXIS_DESCR
 /begin AXIS_DESCR COM_AXIS VVMC_ESCLongAccelFilt_Gps SWC_FDC_type_CM_single_gps 21 -5.0 5.0 AXIS_PTS_REF AVMC_PedalTqRWhlRatio_Y_gps /end AXIS_DESCR
/end CHARACTERISTIC
/begin AXIS_PTS AVMC_PedalTqRWhlRatio_Y_gps "" 0x0000 /* @ECU_Address@AVMC_PedalTqRWhlRatio_Y_gps@ */ VVMC_ESCLongAccelFilt_Gps Lookup2D_X_FLOAT32_IEEE 0 SWC_FDC_type_CM_single_gps 21 -5.0 5.0 /end AXIS_PTS
/begin AXIS_PTS AVMC_PedalTqRWhlRatio_X_Nm "" 0x0000 /* @ECU_Address@AVMC_PedalTqRWhlRatio_X_Nm@ */ VVMC_VMCWhlTq4RatioCalcu_Nm Lookup2D_X_FLOAT32_IEEE 0 SWC_FDC_type_CM_single_Nm 35 -10000.0 10000.0 /end AXIS_PTS
/begin CHARACTERISTIC MVMC_RearWhlTqRatio_Z_rat "" MAP 0x0000 /* @ECU_Address@MVMC_RearWhlTqRatio_Z_rat@ */ Lookup2D_FLOAT32_IEEE 0 SWC_FDC_type_CM_single_rat 0.0 1.0
 /begin AXIS_DESCR COM_AXIS VVMC_VMCWhlTq4RatioCalcu_Nm SWC_FDC_type_CM_single_Nm 35 -10000.0 10000.0 AXIS_PTS_REF AVMC_RearWhlTqRatio_X_Nm /end AXIS_DESCR
 /begin AXIS_DESCR COM_AXIS VVMC_ESCLongAccelFilt_Gps SWC_FDC_type_CM_single_gps 21 -5.0 5.0 AXIS_PTS_REF AVMC_RearWhlTqRatio_Y_gps /end AXIS_DESCR
/end CHARACTERISTIC
/begin AXIS_PTS AVMC_RearWhlTqRatio_Y_gps "" 0x0000 /* @ECU_Address@AVMC_RearWhlTqRatio_Y_gps@ */ VVMC_ESCLongAccelFilt_Gps Lookup2D_X_FLOAT32_IEEE 0 SWC_FDC_type_CM_single_gps 21 -5.0 5.0 /end AXIS_PTS
/begin AXIS_PTS AVMC_RearWhlTqRatio_X_Nm "" 0x0000 /* @ECU_Address@AVMC_RearWhlTqRatio_X_Nm@ */ VVMC_VMCWhlTq4RatioCalcu_Nm Lookup2D_X_FLOAT32_IEEE 0 SWC_FDC_type_CM_single_Nm 35 -10000.0 10000.0 /end AXIS_PTS
/begin CHARACTERISTIC MVMC_RearWhlTqSTRGGain_Z_Nm "" MAP 0x0000 /* @ECU_Address@MVMC_RearWhlTqSTRGGain_Z_Nm@ */ Lookup2D_FLOAT32_IEEE 0 SWC_FDC_type_CM_single_Nm -10000.0 10000.0
 /begin AXIS_DESCR COM_AXIS NO_INPUT_QUANTITY SWC_FDC_type_CM_single_deg 8 -900.0 900.0 AXIS_PTS_REF AVMC_RearWhlTqSTRGGain_X_deg /end AXIS_DESCR
 /begin AXIS_DESCR COM_AXIS VVMC_VehicleSpeed_kph SWC_FDC_type_CM_single_kph 8 0.0 255.0 AXIS_PTS_REF AVMC_RearWhlTqSTRGGain_Y_kph /end AXIS_DESCR
/end CHARACTERISTIC
/begin AXIS_PTS AVMC_RearWhlTqSTRGGain_Y_kph "" 0x0000 /* @ECU_Address@AVMC_RearWhlTqSTRGGain_Y_kph@ */ VVMC_VehicleSpeed_kph Lookup2D_X_FLOAT32_IEEE 0 SWC_FDC_type_CM_single_kph 8 0.0 255.0 /end AXIS_PTS
/begin AXIS_PTS AVMC_RearWhlTqSTRGGain_X_deg "" 0x0000 /* @ECU_Address@AVMC_RearWhlTqSTRGGain_X_deg@ */ NO_INPUT_QUANTITY Lookup2D_X_FLOAT32_IEEE 0 SWC_FDC_type_CM_single_deg 8 -900.0 900.0 /end AXIS_PTS
/begin CHARACTERISTIC MVMC_ACCDeltaTqGradeGn_Y_Nm "" CURVE 0x0000 /* @ECU_Address@MVMC_ACCDeltaTqGradeGn_Y_Nm@ */ Lookup1D_FLOAT32_IEEE 0 SWC_FDC_type_CM_single_Nm -3000.0 3000.0
 /begin AXIS_DESCR COM_AXIS NO_INPUT_QUANTITY SWC_FDC_type_CM_single_deg 23 -40.0 40.0 AXIS_PTS_REF AVMC_ACCDeltaTqGradeGn_X_deg /end AXIS_DESCR
/end CHARACTERISTIC
/begin AXIS_PTS AVMC_ACCDeltaTqGradeGn_X_deg "" 0x0000 /* @ECU_Address@AVMC_ACCDeltaTqGradeGn_X_deg@ */ NO_INPUT_QUANTITY Lookup1D_X_FLOAT32_IEEE 0 SWC_FDC_type_CM_single_deg 23 -40.0 40.0 /end AXIS_PTS
/begin CHARACTERISTIC MVMC_ACCDeltaTqIGain4OVRD_Z_Nm "" MAP 0x0000 /* @ECU_Address@MVMC_ACCDeltaTqIGain4OVRD_Z_Nm@ */ Lookup2D_FLOAT32_IEEE 0 SWC_FDC_type_CM_single_Nm -50.0 50.0
 /begin AXIS_DESCR COM_AXIS VVMC_VehicleSpeed_kph SWC_FDC_type_CM_single_kph 17 0.0 300.0 AXIS_PTS_REF AVMC_ACCDeltaTqIGain4OVRD_X_kph /end AXIS_DESCR
 /begin AXIS_DESCR COM_AXIS VVMC_ActAccDev_mps2 SWC_FDC_type_CM_single_mps2 21 -10.0 10.0 AXIS_PTS_REF AVMC_ACCDeltaTqIGain4OVRD_Y_mps2 /end AXIS_DESCR
/end CHARACTERISTIC
/begin AXIS_PTS AVMC_ACCDeltaTqIGain4OVRD_Y_mps2 "" 0x0000 /* @ECU_Address@AVMC_ACCDeltaTqIGain4OVRD_Y_mps2@ */ VVMC_ActAccDev_mps2 Lookup2D_X_FLOAT32_IEEE 0 SWC_FDC_type_CM_single_mps2 21 -10.0 10.0 /end AXIS_PTS
/begin AXIS_PTS AVMC_ACCDeltaTqIGain4OVRD_X_kph "" 0x0000 /* @ECU_Address@AVMC_ACCDeltaTqIGain4OVRD_X_kph@ */ VVMC_VehicleSpeed_kph Lookup2D_X_FLOAT32_IEEE 0 SWC_FDC_type_CM_single_kph 17 0.0 300.0 /end AXIS_PTS
/begin CHARACTERISTIC MVMC_ACCDeltaTqIGain_Z_Nm "" MAP 0x0000 /* @ECU_Address@MVMC_ACCDeltaTqIGain_Z_Nm@ */ Lookup2D_FLOAT32_IEEE 0 SWC_FDC_type_CM_single_Nm -50.0 50.0
 /begin AXIS_DESCR COM_AXIS VVMC_VehicleSpeed_kph SWC_FDC_type_CM_single_kph 17 0.0 300.0 AXIS_PTS_REF AVMC_ACCDeltaTqIGain_X_kph /end AXIS_DESCR
 /begin AXIS_DESCR COM_AXIS VVMC_ActAccDev_mps2 SWC_FDC_type_CM_single_mps2 21 -10.0 10.0 AXIS_PTS_REF AVMC_ACCDeltaTqIGain_Y_mps2 /end AXIS_DESCR
/end CHARACTERISTIC
/begin AXIS_PTS AVMC_ACCDeltaTqIGain_Y_mps2 "" 0x0000 /* @ECU_Address@AVMC_ACCDeltaTqIGain_Y_mps2@ */ VVMC_ActAccDev_mps2 Lookup2D_X_FLOAT32_IEEE 0 SWC_FDC_type_CM_single_mps2 21 -10.0 10.0 /end AXIS_PTS
/begin AXIS_PTS AVMC_ACCDeltaTqIGain_X_kph "" 0x0000 /* @ECU_Address@AVMC_ACCDeltaTqIGain_X_kph@ */ VVMC_VehicleSpeed_kph Lookup2D_X_FLOAT32_IEEE 0 SWC_FDC_type_CM_single_kph 17 0.0 300.0 /end AXIS_PTS
/begin CHARACTERISTIC MVMC_ACCDeltaTqPGain_Z_Nm "" MAP 0x0000 /* @ECU_Address@MVMC_ACCDeltaTqPGain_Z_Nm@ */ Lookup2D_FLOAT32_IEEE 0 SWC_FDC_type_CM_single_Nm -20.0 20.0
 /begin AXIS_DESCR COM_AXIS VVMC_VehicleSpeed_kph SWC_FDC_type_CM_single_kph 17 0.0 300.0 AXIS_PTS_REF AVMC_ACCDeltaTqPGain_X_kph /end AXIS_DESCR
 /begin AXIS_DESCR COM_AXIS VVMC_ACCActSpdDev_kph SWC_FDC_type_CM_single_kph 21 -300.0 300.0 AXIS_PTS_REF AVMC_ACCDeltaTqPGain_Y_kph /end AXIS_DESCR
/end CHARACTERISTIC
/begin AXIS_PTS AVMC_ACCDeltaTqPGain_Y_kph "" 0x0000 /* @ECU_Address@AVMC_ACCDeltaTqPGain_Y_kph@ */ VVMC_ACCActSpdDev_kph Lookup2D_X_FLOAT32_IEEE 0 SWC_FDC_type_CM_single_kph 21 -300.0 300.0 /end AXIS_PTS
/begin AXIS_PTS AVMC_ACCDeltaTqPGain_X_kph "" 0x0000 /* @ECU_Address@AVMC_ACCDeltaTqPGain_X_kph@ */ VVMC_VehicleSpeed_kph Lookup2D_X_FLOAT32_IEEE 0 SWC_FDC_type_CM_single_kph 17 0.0 300.0 /end AXIS_PTS
/begin CHARACTERISTIC MVMC_ACCLoSpdTqLoLim4JP_Z_Nm "" MAP 0x0000 /* @ECU_Address@MVMC_ACCLoSpdTqLoLim4JP_Z_Nm@ */ Lookup2D_FLOAT32_IEEE 0 SWC_FDC_type_CM_single_Nm -5000.0 5000.0
 /begin AXIS_DESCR COM_AXIS VVMC_VehicleSpeed_kph SWC_FDC_type_CM_single_kph 17 0.0 300.0 AXIS_PTS_REF AVMC_ACCLoSpdTqLoLim4JP_X_kph /end AXIS_DESCR
 /begin AXIS_DESCR COM_AXIS NO_INPUT_QUANTITY SWC_FDC_type_CM_single_deg 23 -50.0 50.0 AXIS_PTS_REF AVMC_ACCLoSpdTqLoLim4JP_Y_deg /end AXIS_DESCR
/end CHARACTERISTIC
/begin AXIS_PTS AVMC_ACCLoSpdTqLoLim4JP_Y_deg "" 0x0000 /* @ECU_Address@AVMC_ACCLoSpdTqLoLim4JP_Y_deg@ */ NO_INPUT_QUANTITY Lookup2D_X_FLOAT32_IEEE 0 SWC_FDC_type_CM_single_deg 23 -50.0 50.0 /end AXIS_PTS
/begin AXIS_PTS AVMC_ACCLoSpdTqLoLim4JP_X_kph "" 0x0000 /* @ECU_Address@AVMC_ACCLoSpdTqLoLim4JP_X_kph@ */ VVMC_VehicleSpeed_kph Lookup2D_X_FLOAT32_IEEE 0 SWC_FDC_type_CM_single_kph 17 0.0 300.0 /end AXIS_PTS
/begin CHARACTERISTIC MVMC_ACCLoSpdTqLowerLim_Z_Nm "" MAP 0x0000 /* @ECU_Address@MVMC_ACCLoSpdTqLowerLim_Z_Nm@ */ Lookup2D_FLOAT32_IEEE 0 SWC_FDC_type_CM_single_Nm -5000.0 5000.0
 /begin AXIS_DESCR COM_AXIS VVMC_VehicleSpeed_kph SWC_FDC_type_CM_single_kph 17 0.0 300.0 AXIS_PTS_REF AVMC_ACCLoSpdTqLowerLim_X_kph /end AXIS_DESCR
 /begin AXIS_DESCR COM_AXIS NO_INPUT_QUANTITY SWC_FDC_type_CM_single_deg 23 -50.0 50.0 AXIS_PTS_REF AVMC_ACCLoSpdTqLowerLim_Y_deg /end AXIS_DESCR
/end CHARACTERISTIC
/begin AXIS_PTS AVMC_ACCLoSpdTqLowerLim_Y_deg "" 0x0000 /* @ECU_Address@AVMC_ACCLoSpdTqLowerLim_Y_deg@ */ NO_INPUT_QUANTITY Lookup2D_X_FLOAT32_IEEE 0 SWC_FDC_type_CM_single_deg 23 -50.0 50.0 /end AXIS_PTS
/begin AXIS_PTS AVMC_ACCLoSpdTqLowerLim_X_kph "" 0x0000 /* @ECU_Address@AVMC_ACCLoSpdTqLowerLim_X_kph@ */ VVMC_VehicleSpeed_kph Lookup2D_X_FLOAT32_IEEE 0 SWC_FDC_type_CM_single_kph 17 0.0 300.0 /end AXIS_PTS
/begin CHARACTERISTIC MVMC_ADSPosGFBDeltaTq_Z_Nm "" MAP 0x0000 /* @ECU_Address@MVMC_ADSPosGFBDeltaTq_Z_Nm@ */ Lookup2D_FLOAT32_IEEE 0 SWC_FDC_type_CM_single_Nm -50.0 50.0
 /begin AXIS_DESCR COM_AXIS VVMC_VehicleSpeed_kph SWC_FDC_type_CM_single_kph 17 0.0 300.0 AXIS_PTS_REF AVMC_ADSPosGFBDeltaTq_X_kph /end AXIS_DESCR
 /begin AXIS_DESCR COM_AXIS VVMC_ActAccDev_mps2 SWC_FDC_type_CM_single_mps2 21 -10.0 10.0 AXIS_PTS_REF AVMC_ADSPosGFBDeltaTq_Y_mps2 /end AXIS_DESCR
/end CHARACTERISTIC
/begin AXIS_PTS AVMC_ADSPosGFBDeltaTq_Y_mps2 "" 0x0000 /* @ECU_Address@AVMC_ADSPosGFBDeltaTq_Y_mps2@ */ VVMC_ActAccDev_mps2 Lookup2D_X_FLOAT32_IEEE 0 SWC_FDC_type_CM_single_mps2 21 -10.0 10.0 /end AXIS_PTS
/begin AXIS_PTS AVMC_ADSPosGFBDeltaTq_X_kph "" 0x0000 /* @ECU_Address@AVMC_ADSPosGFBDeltaTq_X_kph@ */ VVMC_VehicleSpeed_kph Lookup2D_X_FLOAT32_IEEE 0 SWC_FDC_type_CM_single_kph 17 0.0 300.0 /end AXIS_PTS
/begin CHARACTERISTIC MVMC_DISCDeltaTqIGain_Z_Nm "" MAP 0x0000 /* @ECU_Address@MVMC_DISCDeltaTqIGain_Z_Nm@ */ Lookup2D_FLOAT32_IEEE 0 SWC_FDC_type_CM_single_Nm -50.0 50.0
 /begin AXIS_DESCR COM_AXIS VVMC_VehicleSpeed_kph SWC_FDC_type_CM_single_kph 17 0.0 300.0 AXIS_PTS_REF AVMC_DISCDeltaTqIGain_X_kph /end AXIS_DESCR
 /begin AXIS_DESCR COM_AXIS VVMC_ActAccDev_mps2 SWC_FDC_type_CM_single_mps2 21 -10.0 10.0 AXIS_PTS_REF AVMC_DISCDeltaTqIGain_Y_mps2 /end AXIS_DESCR
/end CHARACTERISTIC
/begin AXIS_PTS AVMC_DISCDeltaTqIGain_Y_mps2 "" 0x0000 /* @ECU_Address@AVMC_DISCDeltaTqIGain_Y_mps2@ */ VVMC_ActAccDev_mps2 Lookup2D_X_FLOAT32_IEEE 0 SWC_FDC_type_CM_single_mps2 21 -10.0 10.0 /end AXIS_PTS
/begin AXIS_PTS AVMC_DISCDeltaTqIGain_X_kph "" 0x0000 /* @ECU_Address@AVMC_DISCDeltaTqIGain_X_kph@ */ VVMC_VehicleSpeed_kph Lookup2D_X_FLOAT32_IEEE 0 SWC_FDC_type_CM_single_kph 17 0.0 300.0 /end AXIS_PTS
/begin CHARACTERISTIC MVMC_HoldResTq_Y_Nm "" CURVE 0x0000 /* @ECU_Address@MVMC_HoldResTq_Y_Nm@ */ Lookup1D_FLOAT32_IEEE 0 SWC_FDC_type_CM_single_Nm -100.0 100.0
 /begin AXIS_DESCR COM_AXIS VVMC_VehicleSpeed_kph SWC_FDC_type_CM_single_kph 21 0.0 50.0 AXIS_PTS_REF AVMC_HoldResTq_X_kph /end AXIS_DESCR
/end CHARACTERISTIC
/begin AXIS_PTS AVMC_HoldResTq_X_kph "" 0x0000 /* @ECU_Address@AVMC_HoldResTq_X_kph@ */ VVMC_VehicleSpeed_kph Lookup1D_X_FLOAT32_IEEE 0 SWC_FDC_type_CM_single_kph 21 0.0 50.0 /end AXIS_PTS
/begin CHARACTERISTIC MVMC_MCPresBaseTq_Y_Nm "" CURVE 0x0000 /* @ECU_Address@MVMC_MCPresBaseTq_Y_Nm@ */ Lookup1D_FLOAT32_IEEE 0 SWC_FDC_type_CM_single_Nm -1000.0 1000.0
 /begin AXIS_DESCR COM_AXIS NO_INPUT_QUANTITY SWC_FDC_type_CM_single_bar 17 -500.0 500.0 AXIS_PTS_REF AVMC_MCPresBaseTq_X_bar /end AXIS_DESCR
/end CHARACTERISTIC
/begin AXIS_PTS AVMC_MCPresBaseTq_X_bar "" 0x0000 /* @ECU_Address@AVMC_MCPresBaseTq_X_bar@ */ NO_INPUT_QUANTITY Lookup1D_X_FLOAT32_IEEE 0 SWC_FDC_type_CM_single_bar 17 -500.0 500.0 /end AXIS_PTS
/begin CHARACTERISTIC MVMC_NegZCHoldTq_Y_Nm "" CURVE 0x0000 /* @ECU_Address@MVMC_NegZCHoldTq_Y_Nm@ */ Lookup1D_FLOAT32_IEEE 0 SWC_FDC_type_CM_single_Nm -10000.0 10000.0
 /begin AXIS_DESCR COM_AXIS NO_INPUT_QUANTITY SWC_FDC_type_CM_single_kph 21 0.0 300.0 AXIS_PTS_REF AVMC_NegZCHoldTq_X_kph /end AXIS_DESCR
/end CHARACTERISTIC
/begin AXIS_PTS AVMC_NegZCHoldTq_X_kph "" 0x0000 /* @ECU_Address@AVMC_NegZCHoldTq_X_kph@ */ NO_INPUT_QUANTITY Lookup1D_X_FLOAT32_IEEE 0 SWC_FDC_type_CM_single_kph 21 0.0 300.0 /end AXIS_PTS
/begin CHARACTERISTIC MVMC_PosZCHoldTq_Y_Nm "" CURVE 0x0000 /* @ECU_Address@MVMC_PosZCHoldTq_Y_Nm@ */ Lookup1D_FLOAT32_IEEE 0 SWC_FDC_type_CM_single_Nm -10000.0 10000.0
 /begin AXIS_DESCR COM_AXIS NO_INPUT_QUANTITY SWC_FDC_type_CM_single_kph 21 0.0 300.0 AXIS_PTS_REF AVMC_PosZCHoldTq_X_kph /end AXIS_DESCR
/end CHARACTERISTIC
/begin AXIS_PTS AVMC_PosZCHoldTq_X_kph "" 0x0000 /* @ECU_Address@AVMC_PosZCHoldTq_X_kph@ */ NO_INPUT_QUANTITY Lookup1D_X_FLOAT32_IEEE 0 SWC_FDC_type_CM_single_kph 21 0.0 300.0 /end AXIS_PTS
/begin CHARACTERISTIC MVMC_TMRevPrvtTq4JP_Z_Nm "" MAP 0x0000 /* @ECU_Address@MVMC_TMRevPrvtTq4JP_Z_Nm@ */ Lookup2D_FLOAT32_IEEE 0 SWC_FDC_type_CM_single_Nm -500.0 500.0
 /begin AXIS_DESCR COM_AXIS NO_INPUT_QUANTITY SWC_FDC_type_CM_single_rpm 25 -200.0 200.0 AXIS_PTS_REF AVMC_TMRevPrvtTq4JP_X_rpm /end AXIS_DESCR
 /begin AXIS_DESCR COM_AXIS NO_INPUT_QUANTITY SWC_FDC_type_CM_single_enum 4 0.0 3.0 AXIS_PTS_REF AVMC_TMRevPrvtTq4JP_Y_enum /end AXIS_DESCR
/end CHARACTERISTIC
/begin AXIS_PTS AVMC_TMRevPrvtTq4JP_Y_enum "" 0x0000 /* @ECU_Address@AVMC_TMRevPrvtTq4JP_Y_enum@ */ NO_INPUT_QUANTITY Lookup2D_X_FLOAT32_IEEE 0 SWC_FDC_type_CM_single_enum 4 0.0 3.0 /end AXIS_PTS
/begin AXIS_PTS AVMC_TMRevPrvtTq4JP_X_rpm "" 0x0000 /* @ECU_Address@AVMC_TMRevPrvtTq4JP_X_rpm@ */ NO_INPUT_QUANTITY Lookup2D_X_FLOAT32_IEEE 0 SWC_FDC_type_CM_single_rpm 25 -200.0 200.0 /end AXIS_PTS
/begin CHARACTERISTIC MVMC_TMRevPrvtTq_Y_Nm "" CURVE 0x0000 /* @ECU_Address@MVMC_TMRevPrvtTq_Y_Nm@ */ Lookup1D_FLOAT32_IEEE 0 SWC_FDC_type_CM_single_Nm -500.0 500.0
 /begin AXIS_DESCR COM_AXIS NO_INPUT_QUANTITY SWC_FDC_type_CM_single_rpm 13 -200.0 200.0 AXIS_PTS_REF AVMC_TMRevPrvtTq_X_rpm /end AXIS_DESCR
/end CHARACTERISTIC
/begin AXIS_PTS AVMC_TMRevPrvtTq_X_rpm "" 0x0000 /* @ECU_Address@AVMC_TMRevPrvtTq_X_rpm@ */ NO_INPUT_QUANTITY Lookup1D_X_FLOAT32_IEEE 0 SWC_FDC_type_CM_single_rpm 13 -200.0 200.0 /end AXIS_PTS
/begin CHARACTERISTIC MVMC_TMSpdBaseTq_Y_Nm "" CURVE 0x0000 /* @ECU_Address@MVMC_TMSpdBaseTq_Y_Nm@ */ Lookup1D_FLOAT32_IEEE 0 SWC_FDC_type_CM_single_Nm 0.0 500.0
 /begin AXIS_DESCR COM_AXIS NO_INPUT_QUANTITY SWC_FDC_type_CM_single_rpm 13 -100.0 100.0 AXIS_PTS_REF AVMC_TMSpdBaseTq_X_rpm /end AXIS_DESCR
/end CHARACTERISTIC
/begin AXIS_PTS AVMC_TMSpdBaseTq_X_rpm "" 0x0000 /* @ECU_Address@AVMC_TMSpdBaseTq_X_rpm@ */ NO_INPUT_QUANTITY Lookup1D_X_FLOAT32_IEEE 0 SWC_FDC_type_CM_single_rpm 13 -100.0 100.0 /end AXIS_PTS
/begin CHARACTERISTIC MVMC_VHTMSpdCtrl_Z_Nm "" MAP 0x0000 /* @ECU_Address@MVMC_VHTMSpdCtrl_Z_Nm@ */ Lookup2D_FLOAT32_IEEE 0 SWC_FDC_type_CM_single_Nm -500.0 500.0
 /begin AXIS_DESCR COM_AXIS NO_INPUT_QUANTITY SWC_FDC_type_CM_single_rpm 21 -3000.0 3000.0 AXIS_PTS_REF AVMC_VHTMSpdCtrl_X_rpm /end AXIS_DESCR
 /begin AXIS_DESCR COM_AXIS NO_INPUT_QUANTITY SWC_FDC_type_CM_single_enum 4 0.0 3.0 AXIS_PTS_REF AVMC_VHTMSpdCtrl_Y_enum /end AXIS_DESCR
/end CHARACTERISTIC
/begin AXIS_PTS AVMC_VHTMSpdCtrl_Y_enum "" 0x0000 /* @ECU_Address@AVMC_VHTMSpdCtrl_Y_enum@ */ NO_INPUT_QUANTITY Lookup2D_X_FLOAT32_IEEE 0 SWC_FDC_type_CM_single_enum 4 0.0 3.0 /end AXIS_PTS
/begin AXIS_PTS AVMC_VHTMSpdCtrl_X_rpm "" 0x0000 /* @ECU_Address@AVMC_VHTMSpdCtrl_X_rpm@ */ NO_INPUT_QUANTITY Lookup2D_X_FLOAT32_IEEE 0 SWC_FDC_type_CM_single_rpm 21 -3000.0 3000.0 /end AXIS_PTS
/begin CHARACTERISTIC MVMC_VehHoldTqIncGain_Y_Nm "" CURVE 0x0000 /* @ECU_Address@MVMC_VehHoldTqIncGain_Y_Nm@ */ Lookup1D_FLOAT32_IEEE 0 SWC_FDC_type_CM_single_Nm -1000.0 1000.0
 /begin AXIS_DESCR COM_AXIS NO_INPUT_QUANTITY SWC_FDC_type_CM_single_deg 10 -50.0 50.0 AXIS_PTS_REF AVMC_VehHoldTqIncGain_X_deg /end AXIS_DESCR
/end CHARACTERISTIC
/begin AXIS_PTS AVMC_VehHoldTqIncGain_X_deg "" 0x0000 /* @ECU_Address@AVMC_VehHoldTqIncGain_X_deg@ */ NO_INPUT_QUANTITY Lookup1D_X_FLOAT32_IEEE 0 SWC_FDC_type_CM_single_deg 10 -50.0 50.0 /end AXIS_PTS
/begin CHARACTERISTIC MVMC_ZCWaitTimeNeg_Y_s "" CURVE 0x0000 /* @ECU_Address@MVMC_ZCWaitTimeNeg_Y_s@ */ Lookup1D_FLOAT32_IEEE 0 SWC_FDC_type_CM_single_s 0.0 5.0
 /begin AXIS_DESCR COM_AXIS NO_INPUT_QUANTITY SWC_FDC_type_CM_single_kph 21 0.0 300.0 AXIS_PTS_REF AVMC_ZCWaitTimeNeg_X_kph /end AXIS_DESCR
/end CHARACTERISTIC
/begin AXIS_PTS AVMC_ZCWaitTimeNeg_X_kph "" 0x0000 /* @ECU_Address@AVMC_ZCWaitTimeNeg_X_kph@ */ NO_INPUT_QUANTITY Lookup1D_X_FLOAT32_IEEE 0 SWC_FDC_type_CM_single_kph 21 0.0 300.0 /end AXIS_PTS
/begin CHARACTERISTIC MVMC_ZCWaitTimePos_Y_s "" CURVE 0x0000 /* @ECU_Address@MVMC_ZCWaitTimePos_Y_s@ */ Lookup1D_FLOAT32_IEEE 0 SWC_FDC_type_CM_single_s 0.0 5.0
 /begin AXIS_DESCR COM_AXIS NO_INPUT_QUANTITY SWC_FDC_type_CM_single_kph 21 0.0 300.0 AXIS_PTS_REF AVMC_ZCWaitTimePos_X_kph /end AXIS_DESCR
/end CHARACTERISTIC
/begin AXIS_PTS AVMC_ZCWaitTimePos_X_kph "" 0x0000 /* @ECU_Address@AVMC_ZCWaitTimePos_X_kph@ */ NO_INPUT_QUANTITY Lookup1D_X_FLOAT32_IEEE 0 SWC_FDC_type_CM_single_kph 21 0.0 300.0 /end AXIS_PTS
/begin CHARACTERISTIC MVMC_DISCDeltaTqPGain_Z_Nm "" MAP 0x0000 /* @ECU_Address@MVMC_DISCDeltaTqPGain_Z_Nm@ */ Lookup2D_FLOAT32_IEEE 0 SWC_FDC_type_CM_single_Nm -3000.0 3000.0
 /begin AXIS_DESCR COM_AXIS VVMC_FeatSetSpdForCalcu_kph SWC_FDC_type_CM_single_kph 19 0.0 300.0 AXIS_PTS_REF AVMC_DISCDeltaTqPGain_X_kph /end AXIS_DESCR
 /begin AXIS_DESCR COM_AXIS NO_INPUT_QUANTITY SWC_FDC_type_CM_single_kph 21 -300.0 300.0 AXIS_PTS_REF AVMC_DISCDeltaTqPGain_Y_kph /end AXIS_DESCR
/end CHARACTERISTIC
/begin AXIS_PTS AVMC_DISCDeltaTqPGain_Y_kph "" 0x0000 /* @ECU_Address@AVMC_DISCDeltaTqPGain_Y_kph@ */ NO_INPUT_QUANTITY Lookup2D_X_FLOAT32_IEEE 0 SWC_FDC_type_CM_single_kph 21 -300.0 300.0 /end AXIS_PTS
/begin AXIS_PTS AVMC_DISCDeltaTqPGain_X_kph "" 0x0000 /* @ECU_Address@AVMC_DISCDeltaTqPGain_X_kph@ */ VVMC_FeatSetSpdForCalcu_kph Lookup2D_X_FLOAT32_IEEE 0 SWC_FDC_type_CM_single_kph 19 0.0 300.0 /end AXIS_PTS
/begin CHARACTERISTIC MVMC_ACCPedalOvrdTqHys_Y_Nm "" CURVE 0x0000 /* @ECU_Address@MVMC_ACCPedalOvrdTqHys_Y_Nm@ */ Lookup1D_FLOAT32_IEEE 0 SWC_FDC_type_CM_single_Nm -1000.0 1000.0
 /begin AXIS_DESCR FIX_AXIS NO_INPUT_QUANTITY SWC_FDC_type_CM_uint32 8 0 7 FIX_AXIS_PAR_DIST 0 1 8 /end AXIS_DESCR
/end CHARACTERISTIC
/begin CHARACTERISTIC KTHC_DcChSetTemp_C "" VALUE 0x0000 /* @ECU_Address@KTHC_DcChSetTemp_C@ */ Scalar_FLOAT32_IEEE 0 SWC_FDC_type_CM_single_C -40.0 200.0 /end CHARACTERISTIC
/begin CHARACTERISTIC KTHC_KiAPTCDcCh_K "" VALUE 0x0000 /* @ECU_Address@KTHC_KiAPTCDcCh_K@ */ Scalar_FLOAT32_IEEE 0 SWC_FDC_type_CM_single_K -10000.0 10000.0 /end CHARACTERISTIC
/begin CHARACTERISTIC KTHC_KiAPTCDeice_K "" VALUE 0x0000 /* @ECU_Address@KTHC_KiAPTCDeice_K@ */ Scalar_FLOAT32_IEEE 0 SWC_FDC_type_CM_single_K -10000.0 10000.0 /end CHARACTERISTIC
/begin CHARACTERISTIC KTHC_KiAPTCTcabinC2_K "" VALUE 0x0000 /* @ECU_Address@KTHC_KiAPTCTcabinC2_K@ */ Scalar_FLOAT32_IEEE 0 SWC_FDC_type_CM_single_K -10000.0 10000.0 /end CHARACTERISTIC
/begin CHARACTERISTIC KTHC_KiAPTCTcabinC_K "" VALUE 0x0000 /* @ECU_Address@KTHC_KiAPTCTcabinC_K@ */ Scalar_FLOAT32_IEEE 0 SWC_FDC_type_CM_single_K -10000.0 10000.0 /end CHARACTERISTIC
/begin CHARACTERISTIC KTHC_KiAPTCTcabinD1_K "" VALUE 0x0000 /* @ECU_Address@KTHC_KiAPTCTcabinD1_K@ */ Scalar_FLOAT32_IEEE 0 SWC_FDC_type_CM_single_K -10000.0 10000.0 /end CHARACTERISTIC
/begin CHARACTERISTIC KTHC_KiAPTCTcabinD2_K "" VALUE 0x0000 /* @ECU_Address@KTHC_KiAPTCTcabinD2_K@ */ Scalar_FLOAT32_IEEE 0 SWC_FDC_type_CM_single_K -10000.0 10000.0 /end CHARACTERISTIC
/begin CHARACTERISTIC KTHC_KiAPTCTcabinD3_K "" VALUE 0x0000 /* @ECU_Address@KTHC_KiAPTCTcabinD3_K@ */ Scalar_FLOAT32_IEEE 0 SWC_FDC_type_CM_single_K -10000.0 10000.0 /end CHARACTERISTIC
/begin CHARACTERISTIC KTHC_KiAPTCTcabinH_K "" VALUE 0x0000 /* @ECU_Address@KTHC_KiAPTCTcabinH_K@ */ Scalar_FLOAT32_IEEE 0 SWC_FDC_type_CM_single_K -10000.0 10000.0 /end CHARACTERISTIC
/begin CHARACTERISTIC KTHC_KiBlowerDeice_K "" VALUE 0x0000 /* @ECU_Address@KTHC_KiBlowerDeice_K@ */ Scalar_FLOAT32_IEEE 0 SWC_FDC_type_CM_single_K -10000.0 10000.0 /end CHARACTERISTIC
/begin CHARACTERISTIC KTHC_KiBlowerTcabinC_K "" VALUE 0x0000 /* @ECU_Address@KTHC_KiBlowerTcabinC_K@ */ Scalar_FLOAT32_IEEE 0 SWC_FDC_type_CM_single_K -10000.0 10000.0 /end CHARACTERISTIC
/begin CHARACTERISTIC KTHC_KiBlowerTcabinD_K "" VALUE 0x0000 /* @ECU_Address@KTHC_KiBlowerTcabinD_K@ */ Scalar_FLOAT32_IEEE 0 SWC_FDC_type_CM_single_K -10000.0 10000.0 /end CHARACTERISTIC
/begin CHARACTERISTIC KTHC_KiBlowerTcabinH_K "" VALUE 0x0000 /* @ECU_Address@KTHC_KiBlowerTcabinH_K@ */ Scalar_FLOAT32_IEEE 0 SWC_FDC_type_CM_single_K -10000.0 10000.0 /end CHARACTERISTIC
/begin CHARACTERISTIC KTHC_KiCompPhigh_K "" VALUE 0x0000 /* @ECU_Address@KTHC_KiCompPhigh_K@ */ Scalar_FLOAT32_IEEE 0 SWC_FDC_type_CM_single_K -10000.0 10000.0 /end CHARACTERISTIC
/begin CHARACTERISTIC KTHC_KiCompPlow1_K "" VALUE 0x0000 /* @ECU_Address@KTHC_KiCompPlow1_K@ */ Scalar_FLOAT32_IEEE 0 SWC_FDC_type_CM_single_K -10000.0 10000.0 /end CHARACTERISTIC
/begin CHARACTERISTIC KTHC_KiCompPlow2_K "" VALUE 0x0000 /* @ECU_Address@KTHC_KiCompPlow2_K@ */ Scalar_FLOAT32_IEEE 0 SWC_FDC_type_CM_single_K -10000.0 10000.0 /end CHARACTERISTIC
/begin CHARACTERISTIC KTHC_KiCompTcabinC1_K "" VALUE 0x0000 /* @ECU_Address@KTHC_KiCompTcabinC1_K@ */ Scalar_FLOAT32_IEEE 0 SWC_FDC_type_CM_single_K -10000.0 10000.0 /end CHARACTERISTIC
/begin CHARACTERISTIC KTHC_KiCompTcabinC_K "" VALUE 0x0000 /* @ECU_Address@KTHC_KiCompTcabinC_K@ */ Scalar_FLOAT32_IEEE 0 SWC_FDC_type_CM_single_K -10000.0 10000.0 /end CHARACTERISTIC
/begin CHARACTERISTIC KTHC_KiCompTcabinD_K "" VALUE 0x0000 /* @ECU_Address@KTHC_KiCompTcabinD_K@ */ Scalar_FLOAT32_IEEE 0 SWC_FDC_type_CM_single_K -10000.0 10000.0 /end CHARACTERISTIC
/begin CHARACTERISTIC KTHC_KiCompTcabinH_K "" VALUE 0x0000 /* @ECU_Address@KTHC_KiCompTcabinH_K@ */ Scalar_FLOAT32_IEEE 0 SWC_FDC_type_CM_single_K -10000.0 10000.0 /end CHARACTERISTIC
/begin CHARACTERISTIC KTHC_KiCompTwinC_K "" VALUE 0x0000 /* @ECU_Address@KTHC_KiCompTwinC_K@ */ Scalar_FLOAT32_IEEE 0 SWC_FDC_type_CM_single_K -10000.0 10000.0 /end CHARACTERISTIC
/begin CHARACTERISTIC KTHC_KiCompTwinD_K "" VALUE 0x0000 /* @ECU_Address@KTHC_KiCompTwinD_K@ */ Scalar_FLOAT32_IEEE 0 SWC_FDC_type_CM_single_K -10000.0 10000.0 /end CHARACTERISTIC
/begin CHARACTERISTIC KTHC_KiEXV1SHDeice_K "" VALUE 0x0000 /* @ECU_Address@KTHC_KiEXV1SHDeice_K@ */ Scalar_FLOAT32_IEEE 0 SWC_FDC_type_CM_single_K -10000.0 10000.0 /end CHARACTERISTIC
/begin CHARACTERISTIC KTHC_KiEXV1SH_K "" VALUE 0x0000 /* @ECU_Address@KTHC_KiEXV1SH_K@ */ Scalar_FLOAT32_IEEE 0 SWC_FDC_type_CM_single_K -10000.0 10000.0 /end CHARACTERISTIC
/begin CHARACTERISTIC KTHC_KiEXV2SHD_K "" VALUE 0x0000 /* @ECU_Address@KTHC_KiEXV2SHD_K@ */ Scalar_FLOAT32_IEEE 0 SWC_FDC_type_CM_single_K -10000.0 10000.0 /end CHARACTERISTIC
/begin CHARACTERISTIC KTHC_KiEXV2SH_K "" VALUE 0x0000 /* @ECU_Address@KTHC_KiEXV2SH_K@ */ Scalar_FLOAT32_IEEE 0 SWC_FDC_type_CM_single_K -10000.0 10000.0 /end CHARACTERISTIC
/begin CHARACTERISTIC KTHC_KpAPTCDcCh_K "" VALUE 0x0000 /* @ECU_Address@KTHC_KpAPTCDcCh_K@ */ Scalar_FLOAT32_IEEE 0 SWC_FDC_type_CM_single_K -10000.0 10000.0 /end CHARACTERISTIC
/begin CHARACTERISTIC KTHC_KpAPTCDeice_K "" VALUE 0x0000 /* @ECU_Address@KTHC_KpAPTCDeice_K@ */ Scalar_FLOAT32_IEEE 0 SWC_FDC_type_CM_single_K -10000.0 10000.0 /end CHARACTERISTIC
/begin CHARACTERISTIC KTHC_KpAPTCTcabinC2_K "" VALUE 0x0000 /* @ECU_Address@KTHC_KpAPTCTcabinC2_K@ */ Scalar_FLOAT32_IEEE 0 SWC_FDC_type_CM_single_K -10000.0 10000.0 /end CHARACTERISTIC
/begin CHARACTERISTIC KTHC_KpAPTCTcabinC_K "" VALUE 0x0000 /* @ECU_Address@KTHC_KpAPTCTcabinC_K@ */ Scalar_FLOAT32_IEEE 0 SWC_FDC_type_CM_single_K -10000.0 10000.0 /end CHARACTERISTIC
/begin CHARACTERISTIC KTHC_KpAPTCTcabinD1_K "" VALUE 0x0000 /* @ECU_Address@KTHC_KpAPTCTcabinD1_K@ */ Scalar_FLOAT32_IEEE 0 SWC_FDC_type_CM_single_K -10000.0 10000.0 /end CHARACTERISTIC
/begin CHARACTERISTIC KTHC_KpAPTCTcabinD2_K "" VALUE 0x0000 /* @ECU_Address@KTHC_KpAPTCTcabinD2_K@ */ Scalar_FLOAT32_IEEE 0 SWC_FDC_type_CM_single_K -10000.0 10000.0 /end CHARACTERISTIC
/begin CHARACTERISTIC KTHC_KpAPTCTcabinD3_K "" VALUE 0x0000 /* @ECU_Address@KTHC_KpAPTCTcabinD3_K@ */ Scalar_FLOAT32_IEEE 0 SWC_FDC_type_CM_single_K -10000.0 10000.0 /end CHARACTERISTIC
/begin CHARACTERISTIC KTHC_KpAPTCTcabinH_K "" VALUE 0x0000 /* @ECU_Address@KTHC_KpAPTCTcabinH_K@ */ Scalar_FLOAT32_IEEE 0 SWC_FDC_type_CM_single_K -10000.0 10000.0 /end CHARACTERISTIC
/begin CHARACTERISTIC KTHC_KpBlowerDeice_K "" VALUE 0x0000 /* @ECU_Address@KTHC_KpBlowerDeice_K@ */ Scalar_FLOAT32_IEEE 0 SWC_FDC_type_CM_single_K -10000.0 10000.0 /end CHARACTERISTIC
/begin CHARACTERISTIC KTHC_KpBlowerTcabinC_K "" VALUE 0x0000 /* @ECU_Address@KTHC_KpBlowerTcabinC_K@ */ Scalar_FLOAT32_IEEE 0 SWC_FDC_type_CM_single_K -10000.0 10000.0 /end CHARACTERISTIC
/begin CHARACTERISTIC KTHC_KpBlowerTcabinD_K "" VALUE 0x0000 /* @ECU_Address@KTHC_KpBlowerTcabinD_K@ */ Scalar_FLOAT32_IEEE 0 SWC_FDC_type_CM_single_K -10000.0 10000.0 /end CHARACTERISTIC
/begin CHARACTERISTIC KTHC_KpBlowerTcabinH_K "" VALUE 0x0000 /* @ECU_Address@KTHC_KpBlowerTcabinH_K@ */ Scalar_FLOAT32_IEEE 0 SWC_FDC_type_CM_single_K -10000.0 10000.0 /end CHARACTERISTIC
/begin CHARACTERISTIC KTHC_KpCompPhigh_K "" VALUE 0x0000 /* @ECU_Address@KTHC_KpCompPhigh_K@ */ Scalar_FLOAT32_IEEE 0 SWC_FDC_type_CM_single_K -10000.0 10000.0 /end CHARACTERISTIC
/begin CHARACTERISTIC KTHC_KpCompPlow1_K "" VALUE 0x0000 /* @ECU_Address@KTHC_KpCompPlow1_K@ */ Scalar_FLOAT32_IEEE 0 SWC_FDC_type_CM_single_K -10000.0 10000.0 /end CHARACTERISTIC
/begin CHARACTERISTIC KTHC_KpCompPlow2_K "" VALUE 0x0000 /* @ECU_Address@KTHC_KpCompPlow2_K@ */ Scalar_FLOAT32_IEEE 0 SWC_FDC_type_CM_single_K -10000.0 10000.0 /end CHARACTERISTIC
/begin CHARACTERISTIC KTHC_KpCompTcabinC1_K "" VALUE 0x0000 /* @ECU_Address@KTHC_KpCompTcabinC1_K@ */ Scalar_FLOAT32_IEEE 0 SWC_FDC_type_CM_single_K -10000.0 10000.0 /end CHARACTERISTIC
/begin CHARACTERISTIC KTHC_KpCompTcabinC_K "" VALUE 0x0000 /* @ECU_Address@KTHC_KpCompTcabinC_K@ */ Scalar_FLOAT32_IEEE 0 SWC_FDC_type_CM_single_K -10000.0 10000.0 /end CHARACTERISTIC
/begin CHARACTERISTIC KTHC_KpCompTcabinD_K "" VALUE 0x0000 /* @ECU_Address@KTHC_KpCompTcabinD_K@ */ Scalar_FLOAT32_IEEE 0 SWC_FDC_type_CM_single_K -10000.0 10000.0 /end CHARACTERISTIC
/begin CHARACTERISTIC KTHC_KpCompTcabinH_K "" VALUE 0x0000 /* @ECU_Address@KTHC_KpCompTcabinH_K@ */ Scalar_FLOAT32_IEEE 0 SWC_FDC_type_CM_single_K -10000.0 10000.0 /end CHARACTERISTIC
/begin CHARACTERISTIC KTHC_KpCompTwinC_K "" VALUE 0x0000 /* @ECU_Address@KTHC_KpCompTwinC_K@ */ Scalar_FLOAT32_IEEE 0 SWC_FDC_type_CM_single_K -10000.0 10000.0 /end CHARACTERISTIC
/begin CHARACTERISTIC KTHC_KpCompTwinD_K "" VALUE 0x0000 /* @ECU_Address@KTHC_KpCompTwinD_K@ */ Scalar_FLOAT32_IEEE 0 SWC_FDC_type_CM_single_K -10000.0 10000.0 /end CHARACTERISTIC
/begin CHARACTERISTIC KTHC_KpEXV1SHDeice_K "" VALUE 0x0000 /* @ECU_Address@KTHC_KpEXV1SHDeice_K@ */ Scalar_FLOAT32_IEEE 0 SWC_FDC_type_CM_single_K -10000.0 10000.0 /end CHARACTERISTIC
/begin CHARACTERISTIC KTHC_KpEXV1SH_K "" VALUE 0x0000 /* @ECU_Address@KTHC_KpEXV1SH_K@ */ Scalar_FLOAT32_IEEE 0 SWC_FDC_type_CM_single_K -10000.0 10000.0 /end CHARACTERISTIC
/begin CHARACTERISTIC KTHC_KpEXV2SHD_K "" VALUE 0x0000 /* @ECU_Address@KTHC_KpEXV2SHD_K@ */ Scalar_FLOAT32_IEEE 0 SWC_FDC_type_CM_single_K -10000.0 10000.0 /end CHARACTERISTIC
/begin CHARACTERISTIC KTHC_KpEXV2SH_K "" VALUE 0x0000 /* @ECU_Address@KTHC_KpEXV2SH_K@ */ Scalar_FLOAT32_IEEE 0 SWC_FDC_type_CM_single_K -10000.0 10000.0 /end CHARACTERISTIC
/begin CHARACTERISTIC KTHC_KrpmCompPhigh_K "" VALUE 0x0000 /* @ECU_Address@KTHC_KrpmCompPhigh_K@ */ Scalar_FLOAT32_IEEE 0 SWC_FDC_type_CM_single_K -10000.0 10000.0 /end CHARACTERISTIC
/begin CHARACTERISTIC KTHC_KrpmCompPlow1_K "" VALUE 0x0000 /* @ECU_Address@KTHC_KrpmCompPlow1_K@ */ Scalar_FLOAT32_IEEE 0 SWC_FDC_type_CM_single_K -10000.0 10000.0 /end CHARACTERISTIC
/begin CHARACTERISTIC KTHC_KrpmCompPlow2_K "" VALUE 0x0000 /* @ECU_Address@KTHC_KrpmCompPlow2_K@ */ Scalar_FLOAT32_IEEE 0 SWC_FDC_type_CM_single_K -10000.0 10000.0 /end CHARACTERISTIC
/begin CHARACTERISTIC KTHC_KrpmCompTcabinC1_K "" VALUE 0x0000 /* @ECU_Address@KTHC_KrpmCompTcabinC1_K@ */ Scalar_FLOAT32_IEEE 0 SWC_FDC_type_CM_single_K -10000.0 10000.0 /end CHARACTERISTIC
/begin CHARACTERISTIC KTHC_KrpmCompTcabinC_K "" VALUE 0x0000 /* @ECU_Address@KTHC_KrpmCompTcabinC_K@ */ Scalar_FLOAT32_IEEE 0 SWC_FDC_type_CM_single_K -10000.0 10000.0 /end CHARACTERISTIC
/begin CHARACTERISTIC KTHC_KrpmCompTcabinD_K "" VALUE 0x0000 /* @ECU_Address@KTHC_KrpmCompTcabinD_K@ */ Scalar_FLOAT32_IEEE 0 SWC_FDC_type_CM_single_K -10000.0 10000.0 /end CHARACTERISTIC
/begin CHARACTERISTIC KTHC_KrpmCompTcabinH_K "" VALUE 0x0000 /* @ECU_Address@KTHC_KrpmCompTcabinH_K@ */ Scalar_FLOAT32_IEEE 0 SWC_FDC_type_CM_single_K -10000.0 10000.0 /end CHARACTERISTIC
/begin CHARACTERISTIC KTHC_KrpmCompTwinC_K "" VALUE 0x0000 /* @ECU_Address@KTHC_KrpmCompTwinC_K@ */ Scalar_FLOAT32_IEEE 0 SWC_FDC_type_CM_single_K -10000.0 10000.0 /end CHARACTERISTIC
/begin CHARACTERISTIC KTHC_KrpmCompTwinD_K "" VALUE 0x0000 /* @ECU_Address@KTHC_KrpmCompTwinD_K@ */ Scalar_FLOAT32_IEEE 0 SWC_FDC_type_CM_single_K -10000.0 10000.0 /end CHARACTERISTIC
/begin CHARACTERISTIC KTHC_MotorInTempDefH_C "" VALUE 0x0000 /* @ECU_Address@KTHC_MotorInTempDefH_C@ */ Scalar_FLOAT32_IEEE 0 SWC_FDC_type_CM_single_C -40.0 200.0 /end CHARACTERISTIC
/begin CHARACTERISTIC KTHC_MotorInTempDefL_C "" VALUE 0x0000 /* @ECU_Address@KTHC_MotorInTempDefL_C@ */ Scalar_FLOAT32_IEEE 0 SWC_FDC_type_CM_single_C -40.0 200.0 /end CHARACTERISTIC
/begin CHARACTERISTIC KTHC_PhighSetpoint_kPa "" VALUE 0x0000 /* @ECU_Address@KTHC_PhighSetpoint_kPa@ */ Scalar_FLOAT32_IEEE 0 SWC_FDC_type_CM_single_kPa -10000.0 10000.0 /end CHARACTERISTIC
/begin CHARACTERISTIC KTHC_Plow1Setpoint_kPa "" VALUE 0x0000 /* @ECU_Address@KTHC_Plow1Setpoint_kPa@ */ Scalar_FLOAT32_IEEE 0 SWC_FDC_type_CM_single_kPa 0.0 10000.0 /end CHARACTERISTIC
/begin CHARACTERISTIC KTHC_TdiffC_C "" VALUE 0x0000 /* @ECU_Address@KTHC_TdiffC_C@ */ Scalar_FLOAT32_IEEE 0 SWC_FDC_type_CM_single_C -40.0 200.0 /end CHARACTERISTIC
/begin CHARACTERISTIC KTHC_TdiffD_C "" VALUE 0x0000 /* @ECU_Address@KTHC_TdiffD_C@ */ Scalar_FLOAT32_IEEE 0 SWC_FDC_type_CM_single_C -40.0 200.0 /end CHARACTERISTIC
/begin CHARACTERISTIC KTHC_TdiffH_C "" VALUE 0x0000 /* @ECU_Address@KTHC_TdiffH_C@ */ Scalar_FLOAT32_IEEE 0 SWC_FDC_type_CM_single_C -40.0 200.0 /end CHARACTERISTIC
/begin CHARACTERISTIC KTHC_TventL1_C "" VALUE 0x0000 /* @ECU_Address@KTHC_TventL1_C@ */ Scalar_FLOAT32_IEEE 0 SWC_FDC_type_CM_single_C -40.0 200.0 /end CHARACTERISTIC
/begin CHARACTERISTIC KTHC_TventL2_C "" VALUE 0x0000 /* @ECU_Address@KTHC_TventL2_C@ */ Scalar_FLOAT32_IEEE 0 SWC_FDC_type_CM_single_C -40.0 200.0 /end CHARACTERISTIC
/begin CHARACTERISTIC KTHC_TventL3_C "" VALUE 0x0000 /* @ECU_Address@KTHC_TventL3_C@ */ Scalar_FLOAT32_IEEE 0 SWC_FDC_type_CM_single_C -40.0 200.0 /end CHARACTERISTIC
/begin CHARACTERISTIC KTHC_TventL4_C "" VALUE 0x0000 /* @ECU_Address@KTHC_TventL4_C@ */ Scalar_FLOAT32_IEEE 0 SWC_FDC_type_CM_single_C -40.0 200.0 /end CHARACTERISTIC
/begin CHARACTERISTIC KTHC_TventL5_C "" VALUE 0x0000 /* @ECU_Address@KTHC_TventL5_C@ */ Scalar_FLOAT32_IEEE 0 SWC_FDC_type_CM_single_C -40.0 200.0 /end CHARACTERISTIC
/begin CHARACTERISTIC KTHC_VBRearClosed_K "" VALUE 0x0000 /* @ECU_Address@KTHC_VBRearClosed_K@ */ Scalar_FLOAT32_IEEE 0 SWC_FDC_type_CM_single_K 0.0 1.0 /end CHARACTERISTIC
/begin CHARACTERISTIC KTHC_VBlowerDcCh_K "" VALUE 0x0000 /* @ECU_Address@KTHC_VBlowerDcCh_K@ */ Scalar_FLOAT32_IEEE 0 SWC_FDC_type_CM_single_K 0.0 1.0 /end CHARACTERISTIC
/begin CHARACTERISTIC KTHC_VBlowerMin_K "" VALUE 0x0000 /* @ECU_Address@KTHC_VBlowerMin_K@ */ Scalar_FLOAT32_IEEE 0 SWC_FDC_type_CM_single_K 0.0 1.0 /end CHARACTERISTIC
/begin CHARACTERISTIC KTHC_VBstep_K "" VALUE 0x0000 /* @ECU_Address@KTHC_VBstep_K@ */ Scalar_FLOAT32_IEEE 0 SWC_FDC_type_CM_single_K 0.0 1.0 /end CHARACTERISTIC
/begin CHARACTERISTIC KTHC_VGainStep_K "" VALUE 0x0000 /* @ECU_Address@KTHC_VGainStep_K@ */ Scalar_FLOAT32_IEEE 0 SWC_FDC_type_CM_single_K 0.0 1.0 /end CHARACTERISTIC
/begin CHARACTERISTIC KTQD_AvailBRgnTqVSOC_pct "" VALUE 0x0000 /* @ECU_Address@KTQD_AvailBRgnTqVSOC_pct@ */ Scalar_FLOAT32_IEEE 0 SWC_FDC_type_CM_single_pct 0.0 100.0 /end CHARACTERISTIC
/begin CHARACTERISTIC KTQD_AvailBrkRgnTqSpd_kph "" VALUE 0x0000 /* @ECU_Address@KTQD_AvailBrkRgnTqSpd_kph@ */ Scalar_FLOAT32_IEEE 0 SWC_FDC_type_CM_single_kph 0.0 300.0 /end CHARACTERISTIC
/begin CHARACTERISTIC KTQD_BRegenCalEnTq_Nm "" VALUE 0x0000 /* @ECU_Address@KTQD_BRegenCalEnTq_Nm@ */ Scalar_FLOAT32_IEEE 0 SWC_FDC_type_CM_single_Nm 0.0 100.0 /end CHARACTERISTIC
/begin CHARACTERISTIC KTQD_BRgnPermDisDelay_s "" VALUE 0x0000 /* @ECU_Address@KTQD_BRgnPermDisDelay_s@ */ Scalar_FLOAT32_IEEE 0 SWC_FDC_type_CM_single_s 0.0 60.0 /end CHARACTERISTIC
/begin CHARACTERISTIC KTQD_DriveProtVehSpdGain_kph "" VALUE 0x0000 /* @ECU_Address@KTQD_DriveProtVehSpdGain_kph@ */ Scalar_FLOAT32_IEEE 0 SWC_FDC_type_CM_single_kph -300.0 300.0 /end CHARACTERISTIC
/begin CHARACTERISTIC KTQD_EscModeTqLimSpdDev_kph "" VALUE 0x0000 /* @ECU_Address@KTQD_EscModeTqLimSpdDev_kph@ */ Scalar_FLOAT32_IEEE 0 SWC_FDC_type_CM_single_kph -1.0 255.0 /end CHARACTERISTIC
/begin CHARACTERISTIC KTQD_FAfterTqCMDGainDec_c "" VALUE 0x0000 /* @ECU_Address@KTQD_FAfterTqCMDGainDec_c@ */ Scalar_FLOAT32_IEEE 0 SWC_FDC_type_CM_single_c -100.0 0.0 /end CHARACTERISTIC
/begin CHARACTERISTIC KTQD_FAfterTqCMDGainInc_c "" VALUE 0x0000 /* @ECU_Address@KTQD_FAfterTqCMDGainInc_c@ */ Scalar_FLOAT32_IEEE 0 SWC_FDC_type_CM_single_c 0.0 100.0 /end CHARACTERISTIC
/begin CHARACTERISTIC KTQD_ForcePLimitSpd_kph "" VALUE 0x0000 /* @ECU_Address@KTQD_ForcePLimitSpd_kph@ */ Scalar_FLOAT32_IEEE 0 SWC_FDC_type_CM_single_kph 0.0 300.0 /end CHARACTERISTIC
/begin CHARACTERISTIC KTQD_FrBRgnCalLowLim_Nm "" VALUE 0x0000 /* @ECU_Address@KTQD_FrBRgnCalLowLim_Nm@ */ Scalar_FLOAT32_IEEE 0 SWC_FDC_type_CM_single_Nm -100000.0 100000.0 /end CHARACTERISTIC
/begin CHARACTERISTIC KTQD_FrBRgnCalUpLim_Nm "" VALUE 0x0000 /* @ECU_Address@KTQD_FrBRgnCalUpLim_Nm@ */ Scalar_FLOAT32_IEEE 0 SWC_FDC_type_CM_single_Nm -100000.0 100000.0 /end CHARACTERISTIC
/begin CHARACTERISTIC KTQD_FrBatapCont_factor "" VALUE 0x0000 /* @ECU_Address@KTQD_FrBatapCont_factor@ */ Scalar_FLOAT32_IEEE 0 SWC_FDC_type_CM_single_factor -100000.0 100000.0 /end CHARACTERISTIC
/begin CHARACTERISTIC KTQD_FrEDURollRgnLowTq_Nm "" VALUE 0x0000 /* @ECU_Address@KTQD_FrEDURollRgnLowTq_Nm@ */ Scalar_FLOAT32_IEEE 0 SWC_FDC_type_CM_single_Nm -100000.0 100000.0 /end CHARACTERISTIC
/begin CHARACTERISTIC KTQD_FrEDURollRgnUpTq_Nm "" VALUE 0x0000 /* @ECU_Address@KTQD_FrEDURollRgnUpTq_Nm@ */ Scalar_FLOAT32_IEEE 0 SWC_FDC_type_CM_single_Nm -100000.0 100000.0 /end CHARACTERISTIC
/begin CHARACTERISTIC KTQD_FrIdcMax_A "" VALUE 0x0000 /* @ECU_Address@KTQD_FrIdcMax_A@ */ Scalar_FLOAT32_IEEE 0 SWC_FDC_type_CM_single_A 0.0 1022.0 /end CHARACTERISTIC
/begin CHARACTERISTIC KTQD_FrIdcMin_A "" VALUE 0x0000 /* @ECU_Address@KTQD_FrIdcMin_A@ */ Scalar_FLOAT32_IEEE 0 SWC_FDC_type_CM_single_A -1022.0 0.0 /end CHARACTERISTIC
/begin CHARACTERISTIC KTQD_FrMotorRefPower_kW "" VALUE 0x0000 /* @ECU_Address@KTQD_FrMotorRefPower_kW@ */ Scalar_FLOAT32_IEEE 0 SWC_FDC_type_CM_single_kW 0.0 1000.0 /end CHARACTERISTIC
/begin CHARACTERISTIC KTQD_FrUdcMax_V "" VALUE 0x0000 /* @ECU_Address@KTQD_FrUdcMax_V@ */ Scalar_FLOAT32_IEEE 0 SWC_FDC_type_CM_single_V 0.0 1022.0 /end CHARACTERISTIC
/begin CHARACTERISTIC KTQD_FrUdcMin_V "" VALUE 0x0000 /* @ECU_Address@KTQD_FrUdcMin_V@ */ Scalar_FLOAT32_IEEE 0 SWC_FDC_type_CM_single_V 0.0 1022.0 /end CHARACTERISTIC
/begin CHARACTERISTIC KTQD_FrUppTheldTrq_Nm "" VALUE 0x0000 /* @ECU_Address@KTQD_FrUppTheldTrq_Nm@ */ Scalar_FLOAT32_IEEE 0 SWC_FDC_type_CM_single_Nm -100000.0 100000.0 /end CHARACTERISTIC
/begin CHARACTERISTIC KTQD_FreeWhlDetStableSpd_kph "" VALUE 0x0000 /* @ECU_Address@KTQD_FreeWhlDetStableSpd_kph@ */ Scalar_FLOAT32_IEEE 0 SWC_FDC_type_CM_single_kph -255.0 255.0 /end CHARACTERISTIC
/begin CHARACTERISTIC KTQD_NewSlideRateTs_c "" VALUE 0x0000 /* @ECU_Address@KTQD_NewSlideRateTs_c@ */ Scalar_FLOAT32_IEEE 0 SWC_FDC_type_CM_single_c 0.0 1.0 /end CHARACTERISTIC
/begin CHARACTERISTIC KTQD_OvrSpdSetDownOffSet_kph "" VALUE 0x0000 /* @ECU_Address@KTQD_OvrSpdSetDownOffSet_kph@ */ Scalar_FLOAT32_IEEE 0 SWC_FDC_type_CM_single_kph -300.0 300.0 /end CHARACTERISTIC
/begin CHARACTERISTIC KTQD_RAfterTqCMDGainDec_c "" VALUE 0x0000 /* @ECU_Address@KTQD_RAfterTqCMDGainDec_c@ */ Scalar_FLOAT32_IEEE 0 SWC_FDC_type_CM_single_c -100.0 0.0 /end CHARACTERISTIC
/begin CHARACTERISTIC KTQD_RAfterTqCMDGainInc_c "" VALUE 0x0000 /* @ECU_Address@KTQD_RAfterTqCMDGainInc_c@ */ Scalar_FLOAT32_IEEE 0 SWC_FDC_type_CM_single_c 0.0 100.0 /end CHARACTERISTIC
/begin CHARACTERISTIC KTQD_RegBrkLPOff_c "" VALUE 0x0000 /* @ECU_Address@KTQD_RegBrkLPOff_c@ */ Scalar_FLOAT32_IEEE 0 SWC_FDC_type_CM_single_C -10.0 10.0 /end CHARACTERISTIC
/begin CHARACTERISTIC KTQD_RegBrkLPOn_c "" VALUE 0x0000 /* @ECU_Address@KTQD_RegBrkLPOn_c@ */ Scalar_FLOAT32_IEEE 0 SWC_FDC_type_CM_single_C -10.0 10.0 /end CHARACTERISTIC
/begin CHARACTERISTIC KTQD_RrBRgnCalLowLim_Nm "" VALUE 0x0000 /* @ECU_Address@KTQD_RrBRgnCalLowLim_Nm@ */ Scalar_FLOAT32_IEEE 0 SWC_FDC_type_CM_single_Nm -100000.0 100000.0 /end CHARACTERISTIC
/begin CHARACTERISTIC KTQD_RrBRgnCalUpLim_Nm "" VALUE 0x0000 /* @ECU_Address@KTQD_RrBRgnCalUpLim_Nm@ */ Scalar_FLOAT32_IEEE 0 SWC_FDC_type_CM_single_Nm -100000.0 100000.0 /end CHARACTERISTIC
/begin CHARACTERISTIC KTQD_RrBatapCont_factor "" VALUE 0x0000 /* @ECU_Address@KTQD_RrBatapCont_factor@ */ Scalar_FLOAT32_IEEE 0 SWC_FDC_type_CM_single_factor -100000.0 100000.0 /end CHARACTERISTIC
/begin CHARACTERISTIC KTQD_RrEDURollRgnLowTq_Nm "" VALUE 0x0000 /* @ECU_Address@KTQD_RrEDURollRgnLowTq_Nm@ */ Scalar_FLOAT32_IEEE 0 SWC_FDC_type_CM_single_Nm -100000.0 100000.0 /end CHARACTERISTIC
/begin CHARACTERISTIC KTQD_RrEDURollRgnUpTq_Nm "" VALUE 0x0000 /* @ECU_Address@KTQD_RrEDURollRgnUpTq_Nm@ */ Scalar_FLOAT32_IEEE 0 SWC_FDC_type_CM_single_Nm -100000.0 100000.0 /end CHARACTERISTIC
/begin CHARACTERISTIC KTQD_RrIdcMax_A "" VALUE 0x0000 /* @ECU_Address@KTQD_RrIdcMax_A@ */ Scalar_FLOAT32_IEEE 0 SWC_FDC_type_CM_single_A 0.0 1022.0 /end CHARACTERISTIC
/begin CHARACTERISTIC KTQD_RrIdcMin_A "" VALUE 0x0000 /* @ECU_Address@KTQD_RrIdcMin_A@ */ Scalar_FLOAT32_IEEE 0 SWC_FDC_type_CM_single_A -1022.0 0.0 /end CHARACTERISTIC
/begin CHARACTERISTIC KTQD_RrMotorRefPower_kW "" VALUE 0x0000 /* @ECU_Address@KTQD_RrMotorRefPower_kW@ */ Scalar_FLOAT32_IEEE 0 SWC_FDC_type_CM_single_kW 0.0 1000.0 /end CHARACTERISTIC
/begin CHARACTERISTIC KTQD_RrUdcMax_V "" VALUE 0x0000 /* @ECU_Address@KTQD_RrUdcMax_V@ */ Scalar_FLOAT32_IEEE 0 SWC_FDC_type_CM_single_V 0.0 1022.0 /end CHARACTERISTIC
/begin CHARACTERISTIC KTQD_RrUdcMin_V "" VALUE 0x0000 /* @ECU_Address@KTQD_RrUdcMin_V@ */ Scalar_FLOAT32_IEEE 0 SWC_FDC_type_CM_single_V 0.0 1022.0 /end CHARACTERISTIC
/begin CHARACTERISTIC KTQD_RrUppTheldTrq_Nm "" VALUE 0x0000 /* @ECU_Address@KTQD_RrUppTheldTrq_Nm@ */ Scalar_FLOAT32_IEEE 0 SWC_FDC_type_CM_single_Nm -100000.0 100000.0 /end CHARACTERISTIC
/begin CHARACTERISTIC KTQD_ShifterFail2P_s "" VALUE 0x0000 /* @ECU_Address@KTQD_ShifterFail2P_s@ */ Scalar_FLOAT32_IEEE 0 SWC_FDC_type_CM_single_s 0.0 5.0 /end CHARACTERISTIC
/begin CHARACTERISTIC KTQD_SimSoundWaveDec_pct "" VALUE 0x0000 /* @ECU_Address@KTQD_SimSoundWaveDec_pct@ */ Scalar_FLOAT32_IEEE 0 SWC_FDC_type_CM_single_pct -10000.0 0.0 /end CHARACTERISTIC
/begin CHARACTERISTIC KTQD_SimSoundWaveInc_pct "" VALUE 0x0000 /* @ECU_Address@KTQD_SimSoundWaveInc_pct@ */ Scalar_FLOAT32_IEEE 0 SWC_FDC_type_CM_single_pct 0.0 10000.0 /end CHARACTERISTIC
/begin CHARACTERISTIC KTQD_TCSCompUpLimit_Nm "" VALUE 0x0000 /* @ECU_Address@KTQD_TCSCompUpLimit_Nm@ */ Scalar_FLOAT32_IEEE 0 SWC_FDC_type_CM_single_Nm -100000.0 100000.0 /end CHARACTERISTIC
/begin CHARACTERISTIC KTQD_TMTqDeviationLow_c "" VALUE 0x0000 /* @ECU_Address@KTQD_TMTqDeviationLow_c@ */ Scalar_FLOAT32_IEEE 0 SWC_FDC_type_CM_single_c 0.0 1.2 /end CHARACTERISTIC
/begin CHARACTERISTIC KTQD_TMTqDeviationUp_c "" VALUE 0x0000 /* @ECU_Address@KTQD_TMTqDeviationUp_c@ */ Scalar_FLOAT32_IEEE 0 SWC_FDC_type_CM_single_c 0.0 1.2 /end CHARACTERISTIC
/begin CHARACTERISTIC KTQD_Veh2MetSpdHiBand_kph "" VALUE 0x0000 /* @ECU_Address@KTQD_Veh2MetSpdHiBand_kph@ */ Scalar_FLOAT32_IEEE 0 SWC_FDC_type_CM_single_kph 0.0 300.0 /end CHARACTERISTIC
/begin CHARACTERISTIC KTQD_Veh2MetSpdLowBand_kph "" VALUE 0x0000 /* @ECU_Address@KTQD_Veh2MetSpdLowBand_kph@ */ Scalar_FLOAT32_IEEE 0 SWC_FDC_type_CM_single_kph 0.0 300.0 /end CHARACTERISTIC
/begin CHARACTERISTIC KTQD_WhlEnDetStableSpd_kph "" VALUE 0x0000 /* @ECU_Address@KTQD_WhlEnDetStableSpd_kph@ */ Scalar_FLOAT32_IEEE 0 SWC_FDC_type_CM_single_kph -255.0 255.0 /end CHARACTERISTIC
/begin CHARACTERISTIC KTQD_WhlSpeedStableDev_kph "" VALUE 0x0000 /* @ECU_Address@KTQD_WhlSpeedStableDev_kph@ */ Scalar_FLOAT32_IEEE 0 SWC_FDC_type_CM_single_kph -255.0 255.0 /end CHARACTERISTIC
/begin CHARACTERISTIC KTQD_WhlStableDetTime_s "" VALUE 0x0000 /* @ECU_Address@KTQD_WhlStableDetTime_s@ */ Scalar_FLOAT32_IEEE 0 SWC_FDC_type_CM_single_s 0.0 3600.0 /end CHARACTERISTIC
/begin CHARACTERISTIC KTQR_ADASCancelBRgnSlopeF_Nmps "" VALUE 0x0000 /* @ECU_Address@KTQR_ADASCancelBRgnSlopeF_Nmps@ */ Scalar_FLOAT32_IEEE 0 SWC_FDC_type_CM_single_Nmps -100000.0 0.0 /end CHARACTERISTIC
/begin CHARACTERISTIC KTQR_ADASCancelBRgnSlopeR_Nmps "" VALUE 0x0000 /* @ECU_Address@KTQR_ADASCancelBRgnSlopeR_Nmps@ */ Scalar_FLOAT32_IEEE 0 SWC_FDC_type_CM_single_Nmps -100000.0 0.0 /end CHARACTERISTIC
/begin CHARACTERISTIC KTQR_FinalFEDUTrqLowLim_Nm "" VALUE 0x0000 /* @ECU_Address@KTQR_FinalFEDUTrqLowLim_Nm@ */ Scalar_FLOAT32_IEEE 0 SWC_FDC_type_CM_single_Nm -100000.0 0.0 /end CHARACTERISTIC
/begin CHARACTERISTIC KTQR_FinalFEDUTrqUpLim_Nm "" VALUE 0x0000 /* @ECU_Address@KTQR_FinalFEDUTrqUpLim_Nm@ */ Scalar_FLOAT32_IEEE 0 SWC_FDC_type_CM_single_Nm 0.0 100000.0 /end CHARACTERISTIC
/begin CHARACTERISTIC KTQR_FinalREDUTrqLowLim_Nm "" VALUE 0x0000 /* @ECU_Address@KTQR_FinalREDUTrqLowLim_Nm@ */ Scalar_FLOAT32_IEEE 0 SWC_FDC_type_CM_single_Nm -100000.0 0.0 /end CHARACTERISTIC
/begin CHARACTERISTIC KTQR_FinalREDUTrqUpLim_Nm "" VALUE 0x0000 /* @ECU_Address@KTQR_FinalREDUTrqUpLim_Nm@ */ Scalar_FLOAT32_IEEE 0 SWC_FDC_type_CM_single_Nm 0.0 100000.0 /end CHARACTERISTIC
/begin CHARACTERISTIC KTQR_FrTMGearEff_c "" VALUE 0x0000 /* @ECU_Address@KTQR_FrTMGearEff_c@ */ Scalar_FLOAT32_IEEE 0 SWC_FDC_type_CM_single_c 0.0 1.0 /end CHARACTERISTIC
/begin CHARACTERISTIC KTQR_GearEnChangeTq_Nm "" VALUE 0x0000 /* @ECU_Address@KTQR_GearEnChangeTq_Nm@ */ Scalar_FLOAT32_IEEE 0 SWC_FDC_type_CM_single_Nm -1.0 1000.0 /end CHARACTERISTIC
/begin CHARACTERISTIC KTQR_LaunchEnPedal_pct "" VALUE 0x0000 /* @ECU_Address@KTQR_LaunchEnPedal_pct@ */ Scalar_FLOAT32_IEEE 0 SWC_FDC_type_CM_single_pct 0.0 125.0 /end CHARACTERISTIC
/begin CHARACTERISTIC KTQR_LaunchEnSpd_kph "" VALUE 0x0000 /* @ECU_Address@KTQR_LaunchEnSpd_kph@ */ Scalar_FLOAT32_IEEE 0 SWC_FDC_type_CM_single_kph -10.0 125.0 /end CHARACTERISTIC
/begin CHARACTERISTIC KTQR_RrTMGearEff_c "" VALUE 0x0000 /* @ECU_Address@KTQR_RrTMGearEff_c@ */ Scalar_FLOAT32_IEEE 0 SWC_FDC_type_CM_single_c 0.0 1.0 /end CHARACTERISTIC
/begin CHARACTERISTIC KVMC_ACCOvrdPedalTqLinearLim_Nm "" VALUE 0x0000 /* @ECU_Address@KVMC_ACCOvrdPedalTqLinearLim_Nm@ */ Scalar_FLOAT32_IEEE 0 SWC_FDC_type_CM_single_Nm 0.0 3000.0 /end CHARACTERISTIC
/begin CHARACTERISTIC KVMC_ACCOvrdPedalTqRatio_Nm "" VALUE 0x0000 /* @ECU_Address@KVMC_ACCOvrdPedalTqRatio_Nm@ */ Scalar_FLOAT32_IEEE 0 SWC_FDC_type_CM_single_Nm 0.0 3000.0 /end CHARACTERISTIC
/begin CHARACTERISTIC KVMC_ACCPedalOvrdPosn4Hold_pct "" VALUE 0x0000 /* @ECU_Address@KVMC_ACCPedalOvrdPosn4Hold_pct@ */ Scalar_FLOAT32_IEEE 0 SWC_FDC_type_CM_single_pct 0.0 100.0 /end CHARACTERISTIC
/begin CHARACTERISTIC KVMC_ACCPedalOvrdPosn_pct "" VALUE 0x0000 /* @ECU_Address@KVMC_ACCPedalOvrdPosn_pct@ */ Scalar_FLOAT32_IEEE 0 SWC_FDC_type_CM_single_pct 0.0 100.0 /end CHARACTERISTIC
/begin CHARACTERISTIC KVMC_ACCPedalOvrdResPosn_pct "" VALUE 0x0000 /* @ECU_Address@KVMC_ACCPedalOvrdResPosn_pct@ */ Scalar_FLOAT32_IEEE 0 SWC_FDC_type_CM_single_pct 0.0 100.0 /end CHARACTERISTIC
/begin CHARACTERISTIC KVMC_ACCPedalOvrdRestTime_s "" VALUE 0x0000 /* @ECU_Address@KVMC_ACCPedalOvrdRestTime_s@ */ Scalar_FLOAT32_IEEE 0 SWC_FDC_type_CM_single_s 0.0 3600.0 /end CHARACTERISTIC
/begin CHARACTERISTIC KVMC_ACCReqCMdBond_mps2 "" VALUE 0x0000 /* @ECU_Address@KVMC_ACCReqCMdBond_mps2@ */ Scalar_FLOAT32_IEEE 0 SWC_FDC_type_CM_single_mps2 -20.0 20.0 /end CHARACTERISTIC
/begin CHARACTERISTIC KVMC_ACCResUpEnAccCMD_mps2 "" VALUE 0x0000 /* @ECU_Address@KVMC_ACCResUpEnAccCMD_mps2@ */ Scalar_FLOAT32_IEEE 0 SWC_FDC_type_CM_single_mps2 -10.0 10.0 /end CHARACTERISTIC
/begin CHARACTERISTIC KVMC_ACCResUpEnGrade_Deg "" VALUE 0x0000 /* @ECU_Address@KVMC_ACCResUpEnGrade_Deg@ */ Scalar_FLOAT32_IEEE 0 SWC_FDC_type_CM_single_Deg -90.0 90.0 /end CHARACTERISTIC
/begin CHARACTERISTIC KVMC_ACCSpdDevLowLim_kph "" VALUE 0x0000 /* @ECU_Address@KVMC_ACCSpdDevLowLim_kph@ */ Scalar_FLOAT32_IEEE 0 SWC_FDC_type_CM_single_kph -100.0 0.0 /end CHARACTERISTIC
/begin CHARACTERISTIC KVMC_ACCSpdDevUpLim_kph "" VALUE 0x0000 /* @ECU_Address@KVMC_ACCSpdDevUpLim_kph@ */ Scalar_FLOAT32_IEEE 0 SWC_FDC_type_CM_single_kph 0.0 100.0 /end CHARACTERISTIC
/begin CHARACTERISTIC KVMC_ACCTq2ZeroDisMCPress2_bar "" VALUE 0x0000 /* @ECU_Address@KVMC_ACCTq2ZeroDisMCPress2_bar@ */ Scalar_FLOAT32_IEEE 0 SWC_FDC_type_CM_single_bar 0.0 500.0 /end CHARACTERISTIC
/begin CHARACTERISTIC KVMC_ACCTq2ZeroDisMCPress_bar "" VALUE 0x0000 /* @ECU_Address@KVMC_ACCTq2ZeroDisMCPress_bar@ */ Scalar_FLOAT32_IEEE 0 SWC_FDC_type_CM_single_bar 0.0 500.0 /end CHARACTERISTIC
/begin CHARACTERISTIC KVMC_ACCTq2ZeroEnMCPress2_bar "" VALUE 0x0000 /* @ECU_Address@KVMC_ACCTq2ZeroEnMCPress2_bar@ */ Scalar_FLOAT32_IEEE 0 SWC_FDC_type_CM_single_bar 0.0 500.0 /end CHARACTERISTIC
/begin CHARACTERISTIC KVMC_ACCTq2ZeroEnMCPress_bar "" VALUE 0x0000 /* @ECU_Address@KVMC_ACCTq2ZeroEnMCPress_bar@ */ Scalar_FLOAT32_IEEE 0 SWC_FDC_type_CM_single_bar 0.0 500.0 /end CHARACTERISTIC
/begin CHARACTERISTIC KVMC_ADASWhlTqLowerLim_Nm "" VALUE 0x0000 /* @ECU_Address@KVMC_ADASWhlTqLowerLim_Nm@ */ Scalar_FLOAT32_IEEE 0 SWC_FDC_type_CM_single_Nm -15000.0 15000.0 /end CHARACTERISTIC
/begin CHARACTERISTIC KVMC_ADASWhlTqUpperLim_Nm "" VALUE 0x0000 /* @ECU_Address@KVMC_ADASWhlTqUpperLim_Nm@ */ Scalar_FLOAT32_IEEE 0 SWC_FDC_type_CM_single_Nm -15000.0 15000.0 /end CHARACTERISTIC
/begin CHARACTERISTIC KVMC_APSAllowSetACCMCP_bar "" VALUE 0x0000 /* @ECU_Address@KVMC_APSAllowSetACCMCP_bar@ */ Scalar_FLOAT32_IEEE 0 SWC_FDC_type_CM_single_bar 0.0 100.0 /end CHARACTERISTIC
/begin CHARACTERISTIC KVMC_APSAllowSetACCPosn_pct "" VALUE 0x0000 /* @ECU_Address@KVMC_APSAllowSetACCPosn_pct@ */ Scalar_FLOAT32_IEEE 0 SWC_FDC_type_CM_single_pct 0.0 100.0 /end CHARACTERISTIC
/begin CHARACTERISTIC KVMC_AccDevLowLim_mps2 "" VALUE 0x0000 /* @ECU_Address@KVMC_AccDevLowLim_mps2@ */ Scalar_FLOAT32_IEEE 0 SWC_FDC_type_CM_single_mps2 -20.0 0.0 /end CHARACTERISTIC
/begin CHARACTERISTIC KVMC_AccDevUpLim_mps2 "" VALUE 0x0000 /* @ECU_Address@KVMC_AccDevUpLim_mps2@ */ Scalar_FLOAT32_IEEE 0 SWC_FDC_type_CM_single_mps2 0.0 20.0 /end CHARACTERISTIC
/begin CHARACTERISTIC KVMC_AccTurnHoldTqDecSR_Nmps "" VALUE 0x0000 /* @ECU_Address@KVMC_AccTurnHoldTqDecSR_Nmps@ */ Scalar_FLOAT32_IEEE 0 SWC_FDC_type_CM_single_Nmps -10000.0 10000.0 /end CHARACTERISTIC
/begin CHARACTERISTIC KVMC_AllowSetSpdDist_m "" VALUE 0x0000 /* @ECU_Address@KVMC_AllowSetSpdDist_m@ */ Scalar_FLOAT32_IEEE 0 SWC_FDC_type_CM_single_m 0.0 50.0 /end CHARACTERISTIC
/begin CHARACTERISTIC KVMC_CAASCtrlAllowTime_s "" VALUE 0x0000 /* @ECU_Address@KVMC_CAASCtrlAllowTime_s@ */ Scalar_FLOAT32_IEEE 0 SWC_FDC_type_CM_single_s 0.0 3600.0 /end CHARACTERISTIC
/begin CHARACTERISTIC KVMC_CAASEnVehSpd_kph "" VALUE 0x0000 /* @ECU_Address@KVMC_CAASEnVehSpd_kph@ */ Scalar_FLOAT32_IEEE 0 SWC_FDC_type_CM_single_kph -10.0 300.0 /end CHARACTERISTIC
/begin CHARACTERISTIC KVMC_CCSpdDevLowLim_kph "" VALUE 0x0000 /* @ECU_Address@KVMC_CCSpdDevLowLim_kph@ */ Scalar_FLOAT32_IEEE 0 SWC_FDC_type_CM_single_kph -100.0 0.0 /end CHARACTERISTIC
/begin CHARACTERISTIC KVMC_CCSpdDevUpLim_kph "" VALUE 0x0000 /* @ECU_Address@KVMC_CCSpdDevUpLim_kph@ */ Scalar_FLOAT32_IEEE 0 SWC_FDC_type_CM_single_kph 0.0 100.0 /end CHARACTERISTIC
/begin CHARACTERISTIC KVMC_CCTqLowLim_Nm "" VALUE 0x0000 /* @ECU_Address@KVMC_CCTqLowLim_Nm@ */ Scalar_FLOAT32_IEEE 0 SWC_FDC_type_CM_single_Nm -15000.0 15000.0 /end CHARACTERISTIC
/begin CHARACTERISTIC KVMC_CCTqUpLim_Nm "" VALUE 0x0000 /* @ECU_Address@KVMC_CCTqUpLim_Nm@ */ Scalar_FLOAT32_IEEE 0 SWC_FDC_type_CM_single_Nm -15000.0 15000.0 /end CHARACTERISTIC
/begin CHARACTERISTIC KVMC_CutOffNegTqSpd_kph "" VALUE 0x0000 /* @ECU_Address@KVMC_CutOffNegTqSpd_kph@ */ Scalar_FLOAT32_IEEE 0 SWC_FDC_type_CM_single_kph 0.0 20.0 /end CHARACTERISTIC
/begin CHARACTERISTIC KVMC_ESCLongGBWFilter_raw32 "" VALUE 0x0000 /* @ECU_Address@KVMC_ESCLongGBWFilter_raw32@ */ Scalar_FLOAT32_IEEE 0 SWC_FDC_type_CM_single_raw32 0.0 100.0 /end CHARACTERISTIC
/begin CHARACTERISTIC KVMC_ESCSSMCPThres_bar "" VALUE 0x0000 /* @ECU_Address@KVMC_ESCSSMCPThres_bar@ */ Scalar_FLOAT32_IEEE 0 SWC_FDC_type_CM_single_bar 0.0 50.0 /end CHARACTERISTIC
/begin CHARACTERISTIC KVMC_ExternalDoorAllowTime_s "" VALUE 0x0000 /* @ECU_Address@KVMC_ExternalDoorAllowTime_s@ */ Scalar_FLOAT32_IEEE 0 SWC_FDC_type_CM_single_s 0.0 10.0 /end CHARACTERISTIC
/begin CHARACTERISTIC KVMC_ExternalShiftAllowTime_s "" VALUE 0x0000 /* @ECU_Address@KVMC_ExternalShiftAllowTime_s@ */ Scalar_FLOAT32_IEEE 0 SWC_FDC_type_CM_single_s 0.0 10.0 /end CHARACTERISTIC
/begin CHARACTERISTIC KVMC_ExternalTqAllowTime_s "" VALUE 0x0000 /* @ECU_Address@KVMC_ExternalTqAllowTime_s@ */ Scalar_FLOAT32_IEEE 0 SWC_FDC_type_CM_single_sec 0.0 10.0 /end CHARACTERISTIC
/begin CHARACTERISTIC KVMC_HillUpResetTMSpd_rpm "" VALUE 0x0000 /* @ECU_Address@KVMC_HillUpResetTMSpd_rpm@ */ Scalar_FLOAT32_IEEE 0 SWC_FDC_type_CM_single_rpm -1000.0 1000.0 /end CHARACTERISTIC
/begin CHARACTERISTIC KVMC_HoldAllowZeroTqGrade_deg "" VALUE 0x0000 /* @ECU_Address@KVMC_HoldAllowZeroTqGrade_deg@ */ Scalar_FLOAT32_IEEE 0 SWC_FDC_type_CM_single_deg -45.0 45.0 /end CHARACTERISTIC
/begin CHARACTERISTIC KVMC_HoldResTqDisDeltaAcc_mps2 "" VALUE 0x0000 /* @ECU_Address@KVMC_HoldResTqDisDeltaAcc_mps2@ */ Scalar_FLOAT32_IEEE 0 SWC_FDC_type_CM_single_mps2 -1.0 1.0 /end CHARACTERISTIC
/begin CHARACTERISTIC KVMC_HoldResTqDisSpd_kph "" VALUE 0x0000 /* @ECU_Address@KVMC_HoldResTqDisSpd_kph@ */ Scalar_FLOAT32_IEEE 0 SWC_FDC_type_CM_single_kph 0.0 10.0 /end CHARACTERISTIC
/begin CHARACTERISTIC KVMC_HoldTqAddDisDec_mps2 "" VALUE 0x0000 /* @ECU_Address@KVMC_HoldTqAddDisDec_mps2@ */ Scalar_FLOAT32_IEEE 0 SWC_FDC_type_CM_single_mps2 -2.0 2.0 /end CHARACTERISTIC
/begin CHARACTERISTIC KVMC_HoldTqCalDeltaAccThres_Gps "" VALUE 0x0000 /* @ECU_Address@KVMC_HoldTqCalDeltaAccThres_Gps@ */ Scalar_FLOAT32_IEEE 0 SWC_FDC_type_CM_single_gps -2.0 2.0 /end CHARACTERISTIC
/begin CHARACTERISTIC KVMC_HoldTqCalSpd1_kph "" VALUE 0x0000 /* @ECU_Address@KVMC_HoldTqCalSpd1_kph@ */ Scalar_FLOAT32_IEEE 0 SWC_FDC_type_CM_single_kph 0.0 20.0 /end CHARACTERISTIC
/begin CHARACTERISTIC KVMC_HoldTqCtrlGradeThres_deg "" VALUE 0x0000 /* @ECU_Address@KVMC_HoldTqCtrlGradeThres_deg@ */ Scalar_FLOAT32_IEEE 0 SWC_FDC_type_CM_single_deg -50.0 50.0 /end CHARACTERISTIC
/begin CHARACTERISTIC KVMC_HoldTqCtrlTargetGx_mps2 "" VALUE 0x0000 /* @ECU_Address@KVMC_HoldTqCtrlTargetGx_mps2@ */ Scalar_FLOAT32_IEEE 0 SWC_FDC_type_CM_single_mps2 -10.0 10.0 /end CHARACTERISTIC
/begin CHARACTERISTIC KVMC_IMUGxFilter_raw32 "" VALUE 0x0000 /* @ECU_Address@KVMC_IMUGxFilter_raw32@ */ Scalar_FLOAT32_IEEE 0 SWC_FDC_type_CM_single_raw32 0.0 100.0 /end CHARACTERISTIC
/begin CHARACTERISTIC KVMC_IMUGyFilter_raw32 "" VALUE 0x0000 /* @ECU_Address@KVMC_IMUGyFilter_raw32@ */ Scalar_FLOAT32_IEEE 0 SWC_FDC_type_CM_single_raw32 0.0 100.0 /end CHARACTERISTIC
/begin CHARACTERISTIC KVMC_IMUGzFilter_raw32 "" VALUE 0x0000 /* @ECU_Address@KVMC_IMUGzFilter_raw32@ */ Scalar_FLOAT32_IEEE 0 SWC_FDC_type_CM_single_raw32 0.0 100.0 /end CHARACTERISTIC
/begin CHARACTERISTIC KVMC_IMURxFilter_raw32 "" VALUE 0x0000 /* @ECU_Address@KVMC_IMURxFilter_raw32@ */ Scalar_FLOAT32_IEEE 0 SWC_FDC_type_CM_single_raw32 0.0 100.0 /end CHARACTERISTIC
/begin CHARACTERISTIC KVMC_IMURyFilter_raw32 "" VALUE 0x0000 /* @ECU_Address@KVMC_IMURyFilter_raw32@ */ Scalar_FLOAT32_IEEE 0 SWC_FDC_type_CM_single_raw32 0.0 100.0 /end CHARACTERISTIC
/begin CHARACTERISTIC KVMC_IMURzFilter_raw32 "" VALUE 0x0000 /* @ECU_Address@KVMC_IMURzFilter_raw32@ */ Scalar_FLOAT32_IEEE 0 SWC_FDC_type_CM_single_raw32 0.0 100.0 /end CHARACTERISTIC
/begin CHARACTERISTIC KVMC_IgnrAvailBrgnSpd_kph "" VALUE 0x0000 /* @ECU_Address@KVMC_IgnrAvailBrgnSpd_kph@ */ Scalar_FLOAT32_IEEE 0 SWC_FDC_type_CM_single_kph 0.0 20.0 /end CHARACTERISTIC
/begin CHARACTERISTIC KVMC_MaxReqAccel_mps2 "" VALUE 0x0000 /* @ECU_Address@KVMC_MaxReqAccel_mps2@ */ Scalar_FLOAT32_IEEE 0 SWC_FDC_type_CM_single_mps2 -10.0 10.0 /end CHARACTERISTIC
/begin CHARACTERISTIC KVMC_MinReqAccel_mps2 "" VALUE 0x0000 /* @ECU_Address@KVMC_MinReqAccel_mps2@ */ Scalar_FLOAT32_IEEE 0 SWC_FDC_type_CM_single_mps2 -10.0 10.0 /end CHARACTERISTIC
/begin CHARACTERISTIC KVMC_NegReqDeltaTqGain_rat "" VALUE 0x0000 /* @ECU_Address@KVMC_NegReqDeltaTqGain_rat@ */ Scalar_FLOAT32_IEEE 0 SWC_FDC_type_CM_single_rat 0.0 1.0 /end CHARACTERISTIC
/begin CHARACTERISTIC KVMC_NegReqEnSpd_kph "" VALUE 0x0000 /* @ECU_Address@KVMC_NegReqEnSpd_kph@ */ Scalar_FLOAT32_IEEE 0 SWC_FDC_type_CM_single_kph 0.0 100.0 /end CHARACTERISTIC
/begin CHARACTERISTIC KVMC_NegReqSwEnSlope_Deg "" VALUE 0x0000 /* @ECU_Address@KVMC_NegReqSwEnSlope_Deg@ */ Scalar_FLOAT32_IEEE 0 SWC_FDC_type_CM_single_Deg -90.0 90.0 /end CHARACTERISTIC
/begin CHARACTERISTIC KVMC_NegReqSwEnSpd_kph "" VALUE 0x0000 /* @ECU_Address@KVMC_NegReqSwEnSpd_kph@ */ Scalar_FLOAT32_IEEE 0 SWC_FDC_type_CM_single_kph 0.0 100.0 /end CHARACTERISTIC
/begin CHARACTERISTIC KVMC_NotAllowSetSpdDist_m "" VALUE 0x0000 /* @ECU_Address@KVMC_NotAllowSetSpdDist_m@ */ Scalar_FLOAT32_IEEE 0 SWC_FDC_type_CM_single_m 0.0 50.0 /end CHARACTERISTIC
/begin CHARACTERISTIC KVMC_OVRD2ActRgnTarget_Nm "" VALUE 0x0000 /* @ECU_Address@KVMC_OVRD2ActRgnTarget_Nm@ */ Scalar_FLOAT32_IEEE 0 SWC_FDC_type_CM_single_Nm -3000.0 3000.0 /end CHARACTERISTIC
/begin CHARACTERISTIC KVMC_OVRDResTqDec4Smooth_Nm "" VALUE 0x0000 /* @ECU_Address@KVMC_OVRDResTqDec4Smooth_Nm@ */ Scalar_FLOAT32_IEEE 0 SWC_FDC_type_CM_single_Nm -3000.0 3000.0 /end CHARACTERISTIC
/begin CHARACTERISTIC KVMC_SoftUphillTqIncSR_Nm "" VALUE 0x0000 /* @ECU_Address@KVMC_SoftUphillTqIncSR_Nm@ */ Scalar_FLOAT32_IEEE 0 SWC_FDC_type_CM_single_Nm -100.0 100.0 /end CHARACTERISTIC
/begin CHARACTERISTIC KVMC_StandstillTqRamp2ZeroSlope_Nmps "" VALUE 0x0000 /* @ECU_Address@KVMC_StandstillTqRamp2ZeroSlope_Nmps@ */ Scalar_FLOAT32_IEEE 0 SWC_FDC_type_CM_single_Nmps -3000.0 3000.0 /end CHARACTERISTIC
/begin CHARACTERISTIC KVMC_TMRevSpdPassThres_rpm "" VALUE 0x0000 /* @ECU_Address@KVMC_TMRevSpdPassThres_rpm@ */ Scalar_FLOAT32_IEEE 0 SWC_FDC_type_CM_single_rpm -100.0 100.0 /end CHARACTERISTIC
/begin CHARACTERISTIC KVMC_TMRevSpdThres_rpm "" VALUE 0x0000 /* @ECU_Address@KVMC_TMRevSpdThres_rpm@ */ Scalar_FLOAT32_IEEE 0 SWC_FDC_type_CM_single_rpm -100.0 100.0 /end CHARACTERISTIC
/begin CHARACTERISTIC KVMC_TimeGapBandLv1_s "" VALUE 0x0000 /* @ECU_Address@KVMC_TimeGapBandLv1_s@ */ Scalar_FLOAT32_IEEE 0 SWC_FDC_type_CM_single_s 0.0 25.5 /end CHARACTERISTIC
/begin CHARACTERISTIC KVMC_TimeGapBandLv2_s "" VALUE 0x0000 /* @ECU_Address@KVMC_TimeGapBandLv2_s@ */ Scalar_FLOAT32_IEEE 0 SWC_FDC_type_CM_single_s 0.0 25.5 /end CHARACTERISTIC
/begin CHARACTERISTIC KVMC_TimeGapBandLv3_s "" VALUE 0x0000 /* @ECU_Address@KVMC_TimeGapBandLv3_s@ */ Scalar_FLOAT32_IEEE 0 SWC_FDC_type_CM_single_s 0.0 25.5 /end CHARACTERISTIC
/begin CHARACTERISTIC KVMC_TimeGapBandLv4_s "" VALUE 0x0000 /* @ECU_Address@KVMC_TimeGapBandLv4_s@ */ Scalar_FLOAT32_IEEE 0 SWC_FDC_type_CM_single_s 0.0 25.5 /end CHARACTERISTIC
/begin CHARACTERISTIC KVMC_TimeGapMax_s "" VALUE 0x0000 /* @ECU_Address@KVMC_TimeGapMax_s@ */ Scalar_FLOAT32_IEEE 0 SWC_FDC_type_CM_single_s 0.0 25.5 /end CHARACTERISTIC
/begin CHARACTERISTIC KVMC_TqMCPRelFactor_Nm "" VALUE 0x0000 /* @ECU_Address@KVMC_TqMCPRelFactor_Nm@ */ Scalar_FLOAT32_IEEE 0 SWC_FDC_type_CM_single_Nm -3000.0 3000.0 /end CHARACTERISTIC
/begin CHARACTERISTIC KVMC_VHTMSpdCtrlSR_raw32 "" VALUE 0x0000 /* @ECU_Address@KVMC_VHTMSpdCtrlSR_raw32@ */ Scalar_FLOAT32_IEEE 0 SWC_FDC_type_CM_single_raw32 -500.0 500.0 /end CHARACTERISTIC
/begin CHARACTERISTIC KVMC_VehHoldDecSR_Nm "" VALUE 0x0000 /* @ECU_Address@KVMC_VehHoldDecSR_Nm@ */ Scalar_FLOAT32_IEEE 0 SWC_FDC_type_CM_single_Nm -1000.0 1000.0 /end CHARACTERISTIC
/begin CHARACTERISTIC KVMC_VehHoldTqIncMCP_bar "" VALUE 0x0000 /* @ECU_Address@KVMC_VehHoldTqIncMCP_bar@ */ Scalar_FLOAT32_IEEE 0 SWC_FDC_type_CM_single_bar -1.0 50.0 /end CHARACTERISTIC
/begin CHARACTERISTIC KVMC_VehHoldTqIncMinTq_Nm "" VALUE 0x0000 /* @ECU_Address@KVMC_VehHoldTqIncMinTq_Nm@ */ Scalar_FLOAT32_IEEE 0 SWC_FDC_type_CM_single_Nm -1000.0 1000.0 /end CHARACTERISTIC
/begin CHARACTERISTIC KVMC_ZeroRgnTqSpdCtrlTime_s "" VALUE 0x0000 /* @ECU_Address@KVMC_ZeroRgnTqSpdCtrlTime_s@ */ Scalar_FLOAT32_IEEE 0 SWC_FDC_type_CM_single_s 0.01 10.0 /end CHARACTERISTIC
/begin CHARACTERISTIC KVMC_ZeroRgnTqSpd_kph "" VALUE 0x0000 /* @ECU_Address@KVMC_ZeroRgnTqSpd_kph@ */ Scalar_FLOAT32_IEEE 0 SWC_FDC_type_CM_single_kph 0.0 10.0 /end CHARACTERISTIC
/begin CHARACTERISTIC KTHC_APTCQminC_W "" VALUE 0x0000 /* @ECU_Address@KTHC_APTCQminC_W@ */ Scalar_UWORD 0 SWC_FDC_type_CM_uint16_W 0.0 10000.0 /end CHARACTERISTIC
/begin CHARACTERISTIC KTHC_APTCQoffT_cnt "" VALUE 0x0000 /* @ECU_Address@KTHC_APTCQoffT_cnt@ */ Scalar_UWORD 0 SWC_FDC_type_CM_uint16_cnt 0.0 65535.0 /end CHARACTERISTIC
/begin CHARACTERISTIC KTHC_APTCQonT_cnt "" VALUE 0x0000 /* @ECU_Address@KTHC_APTCQonT_cnt@ */ Scalar_UWORD 0 SWC_FDC_type_CM_uint16_cnt 0.0 65535.0 /end CHARACTERISTIC
/begin CHARACTERISTIC KTHC_DAPTCQ1_W "" VALUE 0x0000 /* @ECU_Address@KTHC_DAPTCQ1_W@ */ Scalar_UWORD 0 SWC_FDC_type_CM_uint16_W 0.0 10000.0 /end CHARACTERISTIC
/begin CHARACTERISTIC KTHC_DAPTCQ2_W "" VALUE 0x0000 /* @ECU_Address@KTHC_DAPTCQ2_W@ */ Scalar_UWORD 0 SWC_FDC_type_CM_uint16_W 0.0 10000.0 /end CHARACTERISTIC
/begin CHARACTERISTIC KTHC_DAPTCQ3_W "" VALUE 0x0000 /* @ECU_Address@KTHC_DAPTCQ3_W@ */ Scalar_UWORD 0 SWC_FDC_type_CM_uint16_W 0.0 10000.0 /end CHARACTERISTIC
/begin CHARACTERISTIC KTHC_EXVBlancePulse_K "" VALUE 0x0000 /* @ECU_Address@KTHC_EXVBlancePulse_K@ */ Scalar_UWORD 0 SWC_FDC_type_CM_uint16_K 0.0 1000.0 /end CHARACTERISTIC
/begin CHARACTERISTIC KTHC_PBlaceTime1_K "" VALUE 0x0000 /* @ECU_Address@KTHC_PBlaceTime1_K@ */ Scalar_UWORD 0 SWC_FDC_type_CM_uint16_K 0.0 200.0 /end CHARACTERISTIC
/begin CHARACTERISTIC KTHC_PBlaceTime2_K "" VALUE 0x0000 /* @ECU_Address@KTHC_PBlaceTime2_K@ */ Scalar_UWORD 0 SWC_FDC_type_CM_uint16_K 0.0 200.0 /end CHARACTERISTIC
/begin CHARACTERISTIC KTHC_PBlaceTime3_K "" VALUE 0x0000 /* @ECU_Address@KTHC_PBlaceTime3_K@ */ Scalar_UWORD 0 SWC_FDC_type_CM_uint16_K 0.0 200.0 /end CHARACTERISTIC
/begin CHARACTERISTIC KTHC_PBlaceTime4_K "" VALUE 0x0000 /* @ECU_Address@KTHC_PBlaceTime4_K@ */ Scalar_UWORD 0 SWC_FDC_type_CM_uint16_K 0.0 200.0 /end CHARACTERISTIC
/begin CHARACTERISTIC KVMC_AccFSCalSet_enum "" VALUE 0x0000 /* @ECU_Address@KVMC_AccFSCalSet_enum@ */ Scalar_UWORD 0 SWC_FDC_type_CM_uint16_enum 0.0 2000.0 /end CHARACTERISTIC
/begin CHARACTERISTIC KVMC_AccFSSlect_enum "" VALUE 0x0000 /* @ECU_Address@KVMC_AccFSSlect_enum@ */ Scalar_UWORD 0 SWC_FDC_type_CM_uint16_enum 0.0 2000.0 /end CHARACTERISTIC
/begin CHARACTERISTIC KVMC_GyroFSCalSet_enum "" VALUE 0x0000 /* @ECU_Address@KVMC_GyroFSCalSet_enum@ */ Scalar_UWORD 0 SWC_FDC_type_CM_uint16_enum 0.0 50.0 /end CHARACTERISTIC
/begin CHARACTERISTIC KVMC_GyroFSSlect_enum "" VALUE 0x0000 /* @ECU_Address@KVMC_GyroFSSlect_enum@ */ Scalar_UWORD 0 SWC_FDC_type_CM_uint16_enum 0.0 50.0 /end CHARACTERISTIC
/begin CHARACTERISTIC KTHC_APTCPWMEN_flg "" VALUE 0x0000 /* @ECU_Address@KTHC_APTCPWMEN_flg@ */ Scalar_BOOLEAN 0 SWC_FDC_type_CM_boolean_flg 0.0 1.0 /end CHARACTERISTIC
/begin CHARACTERISTIC KTHC_TevaErrHandleEN_flg "" VALUE 0x0000 /* @ECU_Address@KTHC_TevaErrHandleEN_flg@ */ Scalar_BOOLEAN 0 SWC_FDC_type_CM_boolean_flg 0.0 1.0 /end CHARACTERISTIC
/begin CHARACTERISTIC KTQD_AWDWhlTqRatioSW_flg "" VALUE 0x0000 /* @ECU_Address@KTQD_AWDWhlTqRatioSW_flg@ */ Scalar_BOOLEAN 0 SWC_FDC_type_CM_boolean_flg 0.0 1.0 /end CHARACTERISTIC
/begin CHARACTERISTIC KTQD_ActWhlSkipSta_enum_ovrdflg "" VALUE 0x0000 /* @ECU_Address@KTQD_ActWhlSkipSta_enum_ovrdflg@ */ Scalar_BOOLEAN 0 SWC_FDC_type_CM_boolean_flg 0.0 1.0 /end CHARACTERISTIC
/begin CHARACTERISTIC KTQD_DecideEDUActTqSW_flg "" VALUE 0x0000 /* @ECU_Address@KTQD_DecideEDUActTqSW_flg@ */ Scalar_BOOLEAN 0 SWC_FDC_type_CM_boolean_flg 0.0 1.0 /end CHARACTERISTIC
/begin CHARACTERISTIC KTQD_ESCModeTqCtrlSW_flg "" VALUE 0x0000 /* @ECU_Address@KTQD_ESCModeTqCtrlSW_flg@ */ Scalar_BOOLEAN 0 SWC_FDC_type_CM_boolean_flg 0.0 1.0 /end CHARACTERISTIC
/begin CHARACTERISTIC KTQD_ExtDoorAllow_flg_ovrdflg "" VALUE 0x0000 /* @ECU_Address@KTQD_ExtDoorAllow_flg_ovrdflg@ */ Scalar_BOOLEAN 0 SWC_FDC_type_CM_boolean_flg 0.0 1.0 /end CHARACTERISTIC
/begin CHARACTERISTIC KTQD_ExtDoorAllow_flg_ovrdval "" VALUE 0x0000 /* @ECU_Address@KTQD_ExtDoorAllow_flg_ovrdval@ */ Scalar_BOOLEAN 0 SWC_FDC_type_CM_boolean_flg 0.0 1.0 /end CHARACTERISTIC
/begin CHARACTERISTIC KTQD_ExtShftAllow_flg_ovrdflg "" VALUE 0x0000 /* @ECU_Address@KTQD_ExtShftAllow_flg_ovrdflg@ */ Scalar_BOOLEAN 0 SWC_FDC_type_CM_boolean_flg 0.0 1.0 /end CHARACTERISTIC
/begin CHARACTERISTIC KTQD_ExtShftAllow_flg_ovrdval "" VALUE 0x0000 /* @ECU_Address@KTQD_ExtShftAllow_flg_ovrdval@ */ Scalar_BOOLEAN 0 SWC_FDC_type_CM_boolean_flg 0.0 1.0 /end CHARACTERISTIC
/begin CHARACTERISTIC KTQD_ExtTqAllow_flg_ovrdflg "" VALUE 0x0000 /* @ECU_Address@KTQD_ExtTqAllow_flg_ovrdflg@ */ Scalar_BOOLEAN 0 SWC_FDC_type_CM_boolean_flg 0.0 1.0 /end CHARACTERISTIC
/begin CHARACTERISTIC KTQD_ExtTqAllow_flg_ovrdval "" VALUE 0x0000 /* @ECU_Address@KTQD_ExtTqAllow_flg_ovrdval@ */ Scalar_BOOLEAN 0 SWC_FDC_type_CM_boolean_flg 0.0 1.0 /end CHARACTERISTIC
/begin CHARACTERISTIC KTQD_FrAvailBRgnTqV_flg_ovrdflg "" VALUE 0x0000 /* @ECU_Address@KTQD_FrAvailBRgnTqV_flg_ovrdflg@ */ Scalar_BOOLEAN 0 SWC_FDC_type_CM_boolean_flg 0.0 1.0 /end CHARACTERISTIC
/begin CHARACTERISTIC KTQD_FrAvailBRgnTqV_flg_ovrdval "" VALUE 0x0000 /* @ECU_Address@KTQD_FrAvailBRgnTqV_flg_ovrdval@ */ Scalar_BOOLEAN 0 SWC_FDC_type_CM_boolean_flg 0.0 1.0 /end CHARACTERISTIC
/begin CHARACTERISTIC KTQD_FrTCSCompensateSW_flg "" VALUE 0x0000 /* @ECU_Address@KTQD_FrTCSCompensateSW_flg@ */ Scalar_BOOLEAN 0 SWC_FDC_type_CM_boolean_flg 0.0 1.0 /end CHARACTERISTIC
/begin CHARACTERISTIC KTQD_NewPrelaodSW_flg "" VALUE 0x0000 /* @ECU_Address@KTQD_NewPrelaodSW_flg@ */ Scalar_BOOLEAN 0 SWC_FDC_type_CM_boolean_flg 0.0 1.0 /end CHARACTERISTIC
/begin CHARACTERISTIC KTQD_NewTotalCapTqSW_flg "" VALUE 0x0000 /* @ECU_Address@KTQD_NewTotalCapTqSW_flg@ */ Scalar_BOOLEAN 0 SWC_FDC_type_CM_boolean_flg 0.0 1.0 /end CHARACTERISTIC
/begin CHARACTERISTIC KTQD_NewWhlTqDistSW_flg "" VALUE 0x0000 /* @ECU_Address@KTQD_NewWhlTqDistSW_flg@ */ Scalar_BOOLEAN 0 SWC_FDC_type_CM_boolean_flg 0.0 1.0 /end CHARACTERISTIC
/begin CHARACTERISTIC KTQD_OPDHoldAllowGearPSW_flg "" VALUE 0x0000 /* @ECU_Address@KTQD_OPDHoldAllowGearPSW_flg@ */ Scalar_BOOLEAN 0 SWC_FDC_type_CM_boolean_flg 0.0 1.0 /end CHARACTERISTIC
/begin CHARACTERISTIC KTQD_PTCSPermSta_flg "" VALUE 0x0000 /* @ECU_Address@KTQD_PTCSPermSta_flg@ */ Scalar_BOOLEAN 0 SWC_FDC_type_CM_boolean_flg 0.0 1.0 /end CHARACTERISTIC
/begin CHARACTERISTIC KTQD_PassAPSActive_flg_ovrdflg "" VALUE 0x0000 /* @ECU_Address@KTQD_PassAPSActive_flg_ovrdflg@ */ Scalar_BOOLEAN 0 SWC_FDC_type_CM_boolean_flg 0.0 1.0 /end CHARACTERISTIC
/begin CHARACTERISTIC KTQD_PassAPSActive_flg_ovrdval "" VALUE 0x0000 /* @ECU_Address@KTQD_PassAPSActive_flg_ovrdval@ */ Scalar_BOOLEAN 0 SWC_FDC_type_CM_boolean_flg 0.0 1.0 /end CHARACTERISTIC
/begin CHARACTERISTIC KTQD_RrAvailBRgnTqV_flg_ovrdflg "" VALUE 0x0000 /* @ECU_Address@KTQD_RrAvailBRgnTqV_flg_ovrdflg@ */ Scalar_BOOLEAN 0 SWC_FDC_type_CM_boolean_flg 0.0 1.0 /end CHARACTERISTIC
/begin CHARACTERISTIC KTQD_RrAvailBRgnTqV_flg_ovrdval "" VALUE 0x0000 /* @ECU_Address@KTQD_RrAvailBRgnTqV_flg_ovrdval@ */ Scalar_BOOLEAN 0 SWC_FDC_type_CM_boolean_flg 0.0 1.0 /end CHARACTERISTIC
/begin CHARACTERISTIC KTQD_RrTCSCompensateSW_flg "" VALUE 0x0000 /* @ECU_Address@KTQD_RrTCSCompensateSW_flg@ */ Scalar_BOOLEAN 0 SWC_FDC_type_CM_boolean_flg 0.0 1.0 /end CHARACTERISTIC
/begin CHARACTERISTIC KTQD_ShifterInvalidSW_flg "" VALUE 0x0000 /* @ECU_Address@KTQD_ShifterInvalidSW_flg@ */ Scalar_BOOLEAN 0 SWC_FDC_type_CM_boolean_flg 0.0 1.0 /end CHARACTERISTIC
/begin CHARACTERISTIC KTQD_SpdCtrlMode_enum_ovrdflg "" VALUE 0x0000 /* @ECU_Address@KTQD_SpdCtrlMode_enum_ovrdflg@ */ Scalar_BOOLEAN 0 SWC_FDC_type_CM_boolean_flg 0.0 1.0 /end CHARACTERISTIC
/begin CHARACTERISTIC KTQD_TCSCreepDriveTqSW_flg "" VALUE 0x0000 /* @ECU_Address@KTQD_TCSCreepDriveTqSW_flg@ */ Scalar_BOOLEAN 0 SWC_FDC_type_CM_boolean_flg 0.0 1.0 /end CHARACTERISTIC
/begin CHARACTERISTIC KTQR_ACCCancelNoRBC_flg "" VALUE 0x0000 /* @ECU_Address@KTQR_ACCCancelNoRBC_flg@ */ Scalar_BOOLEAN 0 SWC_FDC_type_CM_boolean_flg 0.0 1.0 /end CHARACTERISTIC
/begin CHARACTERISTIC KTQR_ADASCancelBRgnSlopeSW_flg "" VALUE 0x0000 /* @ECU_Address@KTQR_ADASCancelBRgnSlopeSW_flg@ */ Scalar_BOOLEAN 0 SWC_FDC_type_CM_boolean_flg 0.0 1.0 /end CHARACTERISTIC
/begin CHARACTERISTIC KTQR_FrAbsoluteMTTqDir_flg "" VALUE 0x0000 /* @ECU_Address@KTQR_FrAbsoluteMTTqDir_flg@ */ Scalar_BOOLEAN 0 SWC_FDC_type_CM_boolean_flg 0.0 1.0 /end CHARACTERISTIC
/begin CHARACTERISTIC KTQR_GearChangeTqDSW_flg "" VALUE 0x0000 /* @ECU_Address@KTQR_GearChangeTqDSW_flg@ */ Scalar_BOOLEAN 0 SWC_FDC_type_CM_boolean_flg 0.0 1.0 /end CHARACTERISTIC
/begin CHARACTERISTIC KTQR_GearChangeTqSW_flg "" VALUE 0x0000 /* @ECU_Address@KTQR_GearChangeTqSW_flg@ */ Scalar_BOOLEAN 0 SWC_FDC_type_CM_boolean_flg 0.0 1.0 /end CHARACTERISTIC
/begin CHARACTERISTIC KTQR_NewRampArchSW_flg "" VALUE 0x0000 /* @ECU_Address@KTQR_NewRampArchSW_flg@ */ Scalar_BOOLEAN 0 SWC_FDC_type_CM_boolean_flg 0.0 1.0 /end CHARACTERISTIC
/begin CHARACTERISTIC KTQR_RrAbsoluteMTTqDir_flg "" VALUE 0x0000 /* @ECU_Address@KTQR_RrAbsoluteMTTqDir_flg@ */ Scalar_BOOLEAN 0 SWC_FDC_type_CM_boolean_flg 0.0 1.0 /end CHARACTERISTIC
/begin CHARACTERISTIC KTQR_TCSActTQRLimSW_flg "" VALUE 0x0000 /* @ECU_Address@KTQR_TCSActTQRLimSW_flg@ */ Scalar_BOOLEAN 0 SWC_FDC_type_CM_boolean_flg 0.0 1.0 /end CHARACTERISTIC
/begin CHARACTERISTIC KVMC_ACCDeltaTqFollowADSCmd_flg "" VALUE 0x0000 /* @ECU_Address@KVMC_ACCDeltaTqFollowADSCmd_flg@ */ Scalar_BOOLEAN 0 SWC_FDC_type_CM_boolean_flg 0.0 1.0 /end CHARACTERISTIC
/begin CHARACTERISTIC KVMC_ACCLoSpdFollowBRgnSW_flg "" VALUE 0x0000 /* @ECU_Address@KVMC_ACCLoSpdFollowBRgnSW_flg@ */ Scalar_BOOLEAN 0 SWC_FDC_type_CM_boolean_flg 0.0 1.0 /end CHARACTERISTIC
/begin CHARACTERISTIC KVMC_ACCOvrdTestSW_flg "" VALUE 0x0000 /* @ECU_Address@KVMC_ACCOvrdTestSW_flg@ */ Scalar_BOOLEAN 0 SWC_FDC_type_CM_boolean_flg 0.0 1.0 /end CHARACTERISTIC
/begin CHARACTERISTIC KVMC_ACCRgnCtrl2Hold_flg "" VALUE 0x0000 /* @ECU_Address@KVMC_ACCRgnCtrl2Hold_flg@ */ Scalar_BOOLEAN 0 SWC_FDC_type_CM_boolean_flg 0.0 1.0 /end CHARACTERISTIC
/begin CHARACTERISTIC KVMC_AddBRegen2ACCLoop_flg "" VALUE 0x0000 /* @ECU_Address@KVMC_AddBRegen2ACCLoop_flg@ */ Scalar_BOOLEAN 0 SWC_FDC_type_CM_boolean_flg 0.0 1.0 /end CHARACTERISTIC
/begin CHARACTERISTIC KVMC_AllowSetSpdOvrdVal_flg "" VALUE 0x0000 /* @ECU_Address@KVMC_AllowSetSpdOvrdVal_flg@ */ Scalar_BOOLEAN 0 SWC_FDC_type_CM_boolean_flg 0.0 1.0 /end CHARACTERISTIC
/begin CHARACTERISTIC KVMC_AllowSetSpdOvrd_flg "" VALUE 0x0000 /* @ECU_Address@KVMC_AllowSetSpdOvrd_flg@ */ Scalar_BOOLEAN 0 SWC_FDC_type_CM_boolean_flg 0.0 1.0 /end CHARACTERISTIC
/begin CHARACTERISTIC KVMC_CAASVMCReqA_flg_ovrdflg "" VALUE 0x0000 /* @ECU_Address@KVMC_CAASVMCReqA_flg_ovrdflg@ */ Scalar_BOOLEAN 0 SWC_FDC_type_CM_boolean_flg 0.0 1.0 /end CHARACTERISTIC
/begin CHARACTERISTIC KVMC_CAASVMCReqA_flg_ovrdval "" VALUE 0x0000 /* @ECU_Address@KVMC_CAASVMCReqA_flg_ovrdval@ */ Scalar_BOOLEAN 0 SWC_FDC_type_CM_boolean_flg 0.0 1.0 /end CHARACTERISTIC
/begin CHARACTERISTIC KVMC_CCDISCPGainSW_flg "" VALUE 0x0000 /* @ECU_Address@KVMC_CCDISCPGainSW_flg@ */ Scalar_BOOLEAN 0 SWC_FDC_type_CM_boolean_flg 0.0 1.0 /end CHARACTERISTIC
/begin CHARACTERISTIC KVMC_CompareFrRrLongAcl_flg "" VALUE 0x0000 /* @ECU_Address@KVMC_CompareFrRrLongAcl_flg@ */ Scalar_BOOLEAN 0 SWC_FDC_type_CM_boolean_flg 0.0 1.0 /end CHARACTERISTIC
/begin CHARACTERISTIC KVMC_HoldAdd2GradeGn_flg "" VALUE 0x0000 /* @ECU_Address@KVMC_HoldAdd2GradeGn_flg@ */ Scalar_BOOLEAN 0 SWC_FDC_type_CM_boolean_flg 0.0 1.0 /end CHARACTERISTIC
/begin CHARACTERISTIC KVMC_HoldGradeOnlyInc_flg "" VALUE 0x0000 /* @ECU_Address@KVMC_HoldGradeOnlyInc_flg@ */ Scalar_BOOLEAN 0 SWC_FDC_type_CM_boolean_flg 0.0 1.0 /end CHARACTERISTIC
/begin CHARACTERISTIC KVMC_HoldTqCalTest_flg "" VALUE 0x0000 /* @ECU_Address@KVMC_HoldTqCalTest_flg@ */ Scalar_BOOLEAN 0 SWC_FDC_type_CM_boolean_flg 0.0 1.0 /end CHARACTERISTIC
/begin CHARACTERISTIC KVMC_HoldTqCtrlSourceSW_flg "" VALUE 0x0000 /* @ECU_Address@KVMC_HoldTqCtrlSourceSW_flg@ */ Scalar_BOOLEAN 0 SWC_FDC_type_CM_boolean_flg 0.0 1.0 /end CHARACTERISTIC
/begin CHARACTERISTIC KVMC_NegReqZeroPosTq_flg "" VALUE 0x0000 /* @ECU_Address@KVMC_NegReqZeroPosTq_flg@ */ Scalar_BOOLEAN 0 SWC_FDC_type_CM_boolean_flg 0.0 1.0 /end CHARACTERISTIC
/begin CHARACTERISTIC KVMC_OVRDResSmoothTest_SW "" VALUE 0x0000 /* @ECU_Address@KVMC_OVRDResSmoothTest_SW@ */ Scalar_BOOLEAN 0 SWC_FDC_type_CM_boolean_flg 0.0 1.0 /end CHARACTERISTIC
/begin CHARACTERISTIC KVMC_ReqAccelLimitSW_flg "" VALUE 0x0000 /* @ECU_Address@KVMC_ReqAccelLimitSW_flg@ */ Scalar_BOOLEAN 0 SWC_FDC_type_CM_boolean_flg 0.0 1.0 /end CHARACTERISTIC
/begin CHARACTERISTIC KVMC_SmallGradeTMRevPrvt_flg "" VALUE 0x0000 /* @ECU_Address@KVMC_SmallGradeTMRevPrvt_flg@ */ Scalar_BOOLEAN 0 SWC_FDC_type_CM_boolean_flg 0.0 1.0 /end CHARACTERISTIC
/begin CHARACTERISTIC KVMC_TMRevPrvtTqAddEveryTT_flg "" VALUE 0x0000 /* @ECU_Address@KVMC_TMRevPrvtTqAddEveryTT_flg@ */ Scalar_BOOLEAN 0 SWC_FDC_type_CM_boolean_flg 0.0 1.0 /end CHARACTERISTIC
/begin CHARACTERISTIC KVMC_TqSafetyCtrl_flg "" VALUE 0x0000 /* @ECU_Address@KVMC_TqSafetyCtrl_flg@ */ Scalar_BOOLEAN 0 SWC_FDC_type_CM_boolean_flg 0.0 1.0 /end CHARACTERISTIC
/begin CHARACTERISTIC KVMC_VHJerkPrvt_flg "" VALUE 0x0000 /* @ECU_Address@KVMC_VHJerkPrvt_flg@ */ Scalar_BOOLEAN 0 SWC_FDC_type_CM_boolean_flg 0.0 1.0 /end CHARACTERISTIC
/begin CHARACTERISTIC KVMC_VHTMSpdCtrlChkTMDir_flg "" VALUE 0x0000 /* @ECU_Address@KVMC_VHTMSpdCtrlChkTMDir_flg@ */ Scalar_BOOLEAN 0 SWC_FDC_type_CM_boolean_flg 0.0 1.0 /end CHARACTERISTIC
/begin CHARACTERISTIC KVMC_ZCChkRealWhlTqSW_flg "" VALUE 0x0000 /* @ECU_Address@KVMC_ZCChkRealWhlTqSW_flg@ */ Scalar_BOOLEAN 0 SWC_FDC_type_CM_boolean_flg 0.0 1.0 /end CHARACTERISTIC
/begin CHARACTERISTIC KVMC_ZeroCrossTestSW_flg "" VALUE 0x0000 /* @ECU_Address@KVMC_ZeroCrossTestSW_flg@ */ Scalar_BOOLEAN 0 SWC_FDC_type_CM_boolean_flg 0.0 1.0 /end CHARACTERISTIC
/begin CHARACTERISTIC KTHC_EWP3SpdDeice_K "" VALUE 0x0000 /* @ECU_Address@KTHC_EWP3SpdDeice_K@ */ Scalar_UBYTE 0 SWC_FDC_type_CM_uint8_K 0.0 255.0 /end CHARACTERISTIC
/begin CHARACTERISTIC KTHC_EWPDcCharge_K "" VALUE 0x0000 /* @ECU_Address@KTHC_EWPDcCharge_K@ */ Scalar_UBYTE 0 SWC_FDC_type_CM_uint8_K 0.0 255.0 /end CHARACTERISTIC
/begin CHARACTERISTIC KTHC_EWPLv1_K "" VALUE 0x0000 /* @ECU_Address@KTHC_EWPLv1_K@ */ Scalar_UBYTE 0 SWC_FDC_type_CM_uint8_K 0.0 255.0 /end CHARACTERISTIC
/begin CHARACTERISTIC KTHC_EWPLv2_K "" VALUE 0x0000 /* @ECU_Address@KTHC_EWPLv2_K@ */ Scalar_UBYTE 0 SWC_FDC_type_CM_uint8_K 0.0 255.0 /end CHARACTERISTIC
/begin CHARACTERISTIC KTHC_EWPLv3_K "" VALUE 0x0000 /* @ECU_Address@KTHC_EWPLv3_K@ */ Scalar_UBYTE 0 SWC_FDC_type_CM_uint8_K 0.0 255.0 /end CHARACTERISTIC
/begin CHARACTERISTIC KTHC_EWPLv4_K "" VALUE 0x0000 /* @ECU_Address@KTHC_EWPLv4_K@ */ Scalar_UBYTE 0 SWC_FDC_type_CM_uint8_K 0.0 255.0 /end CHARACTERISTIC
/begin CHARACTERISTIC KTHC_EWPLv5_K "" VALUE 0x0000 /* @ECU_Address@KTHC_EWPLv5_K@ */ Scalar_UBYTE 0 SWC_FDC_type_CM_uint8_K 0.0 255.0 /end CHARACTERISTIC
/begin CHARACTERISTIC KTHC_EWPStopT_cnt "" VALUE 0x0000 /* @ECU_Address@KTHC_EWPStopT_cnt@ */ Scalar_UBYTE 0 SWC_FDC_type_CM_uint8_cnt 0.0 255.0 /end CHARACTERISTIC
/begin CHARACTERISTIC KTHC_FANDefLv_pct "" VALUE 0x0000 /* @ECU_Address@KTHC_FANDefLv_pct@ */ Scalar_UBYTE 0 SWC_FDC_type_CM_uint8_pct 0.0 100.0 /end CHARACTERISTIC
/begin CHARACTERISTIC KTHC_FANLv1_pct "" VALUE 0x0000 /* @ECU_Address@KTHC_FANLv1_pct@ */ Scalar_UBYTE 0 SWC_FDC_type_CM_uint8_pct 0.0 100.0 /end CHARACTERISTIC
/begin CHARACTERISTIC KTHC_FANLv2_pct "" VALUE 0x0000 /* @ECU_Address@KTHC_FANLv2_pct@ */ Scalar_UBYTE 0 SWC_FDC_type_CM_uint8_pct 0.0 100.0 /end CHARACTERISTIC
/begin CHARACTERISTIC KTHC_FANLv3_pct "" VALUE 0x0000 /* @ECU_Address@KTHC_FANLv3_pct@ */ Scalar_UBYTE 0 SWC_FDC_type_CM_uint8_pct 0.0 100.0 /end CHARACTERISTIC
/begin CHARACTERISTIC KTHC_FANLv4_pct "" VALUE 0x0000 /* @ECU_Address@KTHC_FANLv4_pct@ */ Scalar_UBYTE 0 SWC_FDC_type_CM_uint8_pct 0.0 100.0 /end CHARACTERISTIC
/begin CHARACTERISTIC KTHC_FANLv5_pct "" VALUE 0x0000 /* @ECU_Address@KTHC_FANLv5_pct@ */ Scalar_UBYTE 0 SWC_FDC_type_CM_uint8_pct 0.0 100.0 /end CHARACTERISTIC
/begin CHARACTERISTIC KTHC_RefrigerantType_enum "" VALUE 0x0000 /* @ECU_Address@KTHC_RefrigerantType_enum@ */ Scalar_UBYTE 0 SWC_FDC_type_CM_uint8_enum 0.0 2.0 /end CHARACTERISTIC
/begin CHARACTERISTIC KTHC_ValueSWT_cnt "" VALUE 0x0000 /* @ECU_Address@KTHC_ValueSWT_cnt@ */ Scalar_UBYTE 0 SWC_FDC_type_CM_uint8_cnt 0.0 255.0 /end CHARACTERISTIC
/begin CHARACTERISTIC KTPM_TPMSModelVersionInit_raw "" VALUE 0x0000 /* @ECU_Address@KTPM_TPMSModelVersionInit_raw@ */ Scalar_UBYTE 0 SWC_FDC_type_CM_uint8_kph 1.0 255.0 /end CHARACTERISTIC
/begin CHARACTERISTIC KTQD_ActWhlSkipSta_enum_ovrdval "" VALUE 0x0000 /* @ECU_Address@KTQD_ActWhlSkipSta_enum_ovrdval@ */ Scalar_UBYTE 0 SWC_FDC_type_CM_uint8_enum 0.0 15.0 /end CHARACTERISTIC
/begin CHARACTERISTIC KTQD_CCActiveMetSpdHiMPH_mph "" VALUE 0x0000 /* @ECU_Address@KTQD_CCActiveMetSpdHiMPH_mph@ */ Scalar_UBYTE 0 SWC_FDC_type_CM_uint8_kph 0.0 250.0 /end CHARACTERISTIC
/begin CHARACTERISTIC KTQD_CCActiveMetSpdHi_kph "" VALUE 0x0000 /* @ECU_Address@KTQD_CCActiveMetSpdHi_kph@ */ Scalar_UBYTE 0 SWC_FDC_type_CM_uint8_kph 0.0 250.0 /end CHARACTERISTIC
/begin CHARACTERISTIC KTQD_CCActiveMetSpdLoMPH_mph "" VALUE 0x0000 /* @ECU_Address@KTQD_CCActiveMetSpdLoMPH_mph@ */ Scalar_UBYTE 0 SWC_FDC_type_CM_uint8_kph 0.0 250.0 /end CHARACTERISTIC
/begin CHARACTERISTIC KTQD_CCActiveMetSpdLo_kph "" VALUE 0x0000 /* @ECU_Address@KTQD_CCActiveMetSpdLo_kph@ */ Scalar_UBYTE 0 SWC_FDC_type_CM_uint8_kph 0.0 250.0 /end CHARACTERISTIC
/begin CHARACTERISTIC KTQD_EscModeWhlSpdDely_cnt "" VALUE 0x0000 /* @ECU_Address@KTQD_EscModeWhlSpdDely_cnt@ */ Scalar_UBYTE 0 SWC_FDC_type_CM_uint8_cnt 0.0 255.0 /end CHARACTERISTIC
/begin CHARACTERISTIC KTQD_RegenButEnSpd_kph "" VALUE 0x0000 /* @ECU_Address@KTQD_RegenButEnSpd_kph@ */ Scalar_UBYTE 0 SWC_FDC_type_CM_uint8_kph 0.0 255.0 /end CHARACTERISTIC
/begin CHARACTERISTIC KTQD_SimSoundWaveSet_enum "" VALUE 0x0000 /* @ECU_Address@KTQD_SimSoundWaveSet_enum@ */ Scalar_UBYTE 0 SWC_FDC_type_CM_uint8_enum 0.0 15.0 /end CHARACTERISTIC
/begin CHARACTERISTIC KTQD_SpdCtrlMode_enum_ovrdval "" VALUE 0x0000 /* @ECU_Address@KTQD_SpdCtrlMode_enum_ovrdval@ */ Scalar_UBYTE 0 SWC_FDC_type_CM_uint8_enum 0.0 5.0 /end CHARACTERISTIC
/begin CHARACTERISTIC KTQD_VirtualShifterCMD_enum "" VALUE 0x0000 /* @ECU_Address@KTQD_VirtualShifterCMD_enum@ */ Scalar_UBYTE 0 SWC_FDC_type_CM_uint8_enum 0.0 255.0 /end CHARACTERISTIC
/begin CHARACTERISTIC KVMC_IMUAccXRollAveLevel_enum "" VALUE 0x0000 /* @ECU_Address@KVMC_IMUAccXRollAveLevel_enum@ */ Scalar_UBYTE 0 SWC_FDC_type_CM_uint8_enum 1.0 100.0 /end CHARACTERISTIC
/begin CHARACTERISTIC KVMC_IMUAccYRollAveLevel_enum "" VALUE 0x0000 /* @ECU_Address@KVMC_IMUAccYRollAveLevel_enum@ */ Scalar_UBYTE 0 SWC_FDC_type_CM_uint8_enum 1.0 100.0 /end CHARACTERISTIC
/begin CHARACTERISTIC KVMC_IMUAccZRollAveLevel_enum "" VALUE 0x0000 /* @ECU_Address@KVMC_IMUAccZRollAveLevel_enum@ */ Scalar_UBYTE 0 SWC_FDC_type_CM_uint8_enum 1.0 100.0 /end CHARACTERISTIC
/begin CHARACTERISTIC KVMC_IMUGyroXRollAveLevel_enum "" VALUE 0x0000 /* @ECU_Address@KVMC_IMUGyroXRollAveLevel_enum@ */ Scalar_UBYTE 0 SWC_FDC_type_CM_uint8_enum 1.0 100.0 /end CHARACTERISTIC
/begin CHARACTERISTIC KVMC_IMUGyroYRollAveLevel_enum "" VALUE 0x0000 /* @ECU_Address@KVMC_IMUGyroYRollAveLevel_enum@ */ Scalar_UBYTE 0 SWC_FDC_type_CM_uint8_enum 1.0 100.0 /end CHARACTERISTIC
/begin CHARACTERISTIC KVMC_IMUGyroZRollAveLevel_enum "" VALUE 0x0000 /* @ECU_Address@KVMC_IMUGyroZRollAveLevel_enum@ */ Scalar_UBYTE 0 SWC_FDC_type_CM_uint8_enum 1.0 100.0 /end CHARACTERISTIC
/begin MEASUREMENT VTPM_WriteChkLFID_raw "" ULONG SWC_FDC_type_CM_uint32_raw 0 0 0.0 4.294967295E+9 ECU_ADDRESS 0x0000 /* @ECU_Address@VTPM_WriteChkLFID_raw@ */ /end MEASUREMENT
/begin MEASUREMENT VTPM_WriteChkLRID_raw "" ULONG SWC_FDC_type_CM_uint32_raw 0 0 0.0 4.294967295E+9 ECU_ADDRESS 0x0000 /* @ECU_Address@VTPM_WriteChkLRID_raw@ */ /end MEASUREMENT
/begin MEASUREMENT VTPM_WriteChkRFID_raw "" ULONG SWC_FDC_type_CM_uint32_raw 0 0 0.0 4.294967295E+9 ECU_ADDRESS 0x0000 /* @ECU_Address@VTPM_WriteChkRFID_raw@ */ /end MEASUREMENT
/begin MEASUREMENT VTPM_WriteChkRRID_raw "" ULONG SWC_FDC_type_CM_uint32_raw 0 0 0.0 4.294967295E+9 ECU_ADDRESS 0x0000 /* @ECU_Address@VTPM_WriteChkRRID_raw@ */ /end MEASUREMENT
/begin MEASUREMENT VTPM_WriteChkfinLFID_raw "" ULONG SWC_FDC_type_CM_uint32_raw 0 0 0.0 4.294967295E+9 ECU_ADDRESS 0x0000 /* @ECU_Address@VTPM_WriteChkfinLFID_raw@ */ /end MEASUREMENT
/begin MEASUREMENT VTPM_WriteChkfinLRID_raw "" ULONG SWC_FDC_type_CM_uint32_raw 0 0 0.0 4.294967295E+9 ECU_ADDRESS 0x0000 /* @ECU_Address@VTPM_WriteChkfinLRID_raw@ */ /end MEASUREMENT
/begin MEASUREMENT VTPM_WriteChkfinRFID_raw "" ULONG SWC_FDC_type_CM_uint32_raw 0 0 0.0 4.294967295E+9 ECU_ADDRESS 0x0000 /* @ECU_Address@VTPM_WriteChkfinRFID_raw@ */ /end MEASUREMENT
/begin MEASUREMENT VTPM_WriteChkfinRRID_raw "" ULONG SWC_FDC_type_CM_uint32_raw 0 0 0.0 4.294967295E+9 ECU_ADDRESS 0x0000 /* @ECU_Address@VTPM_WriteChkfinRRID_raw@ */ /end MEASUREMENT
/begin MEASUREMENT VTHC_FDTWVCmd_pct "" FLOAT32_IEEE SWC_FDC_type_CM_single_pct 0 0 0.0 99.96 ECU_ADDRESS 0x0000 /* @ECU_Address@VTHC_FDTWVCmd_pct@ */ /end MEASUREMENT
/begin MEASUREMENT VVMC_SensingAccX_G "" FLOAT32_IEEE SWC_FDC_type_CM_single_G 0 0 -65.536 65.536 ECU_ADDRESS 0x0000 /* @ECU_Address@VVMC_SensingAccX_G@ */ /end MEASUREMENT
/begin MEASUREMENT VVMC_MemOffsetAccX_G "" FLOAT32_IEEE SWC_FDC_type_CM_single_G 0 0 -65.536 65.536 ECU_ADDRESS 0x0000 /* @ECU_Address@VVMC_MemOffsetAccX_G@ */ /end MEASUREMENT
/begin MEASUREMENT VVMC_SensingGyroY_Dps "" FLOAT32_IEEE SWC_FDC_type_CM_single_Dps 0 0 -1966.0 1966.0 ECU_ADDRESS 0x0000 /* @ECU_Address@VVMC_SensingGyroY_Dps@ */ /end MEASUREMENT
/begin MEASUREMENT VVMC_MemOffsetGyroY_Dps "" FLOAT32_IEEE SWC_FDC_type_CM_single_Dps 0 0 -1966.0 1966.0 ECU_ADDRESS 0x0000 /* @ECU_Address@VVMC_MemOffsetGyroY_Dps@ */ /end MEASUREMENT
/begin MEASUREMENT VVMC_SensingAccY_G "" FLOAT32_IEEE SWC_FDC_type_CM_single_G 0 0 -65.536 65.536 ECU_ADDRESS 0x0000 /* @ECU_Address@VVMC_SensingAccY_G@ */ /end MEASUREMENT
/begin MEASUREMENT VVMC_MemOffsetAccY_G "" FLOAT32_IEEE SWC_FDC_type_CM_single_G 0 0 -65.536 65.536 ECU_ADDRESS 0x0000 /* @ECU_Address@VVMC_MemOffsetAccY_G@ */ /end MEASUREMENT
/begin MEASUREMENT VVMC_SensingAccZ_G "" FLOAT32_IEEE SWC_FDC_type_CM_single_G 0 0 -65.536 65.536 ECU_ADDRESS 0x0000 /* @ECU_Address@VVMC_SensingAccZ_G@ */ /end MEASUREMENT
/begin MEASUREMENT VVMC_MemOffsetAccZ_G "" FLOAT32_IEEE SWC_FDC_type_CM_single_G 0 0 -65.536 65.536 ECU_ADDRESS 0x0000 /* @ECU_Address@VVMC_MemOffsetAccZ_G@ */ /end MEASUREMENT
/begin MEASUREMENT VVMC_LastADASWhlTqCal_Nm "" FLOAT32_IEEE SWC_FDC_type_CM_single_Nm 0 0 -100000.0 100000.0 ECU_ADDRESS 0x0000 /* @ECU_Address@VVMC_LastADASWhlTqCal_Nm@ */ /end MEASUREMENT
/begin MEASUREMENT VVMC_ACCDeltaAclAftCompare_mps2 "" FLOAT32_IEEE SWC_FDC_type_CM_single_mps2 0 0 -15.0 15.0 ECU_ADDRESS 0x0000 /* @ECU_Address@VVMC_ACCDeltaAclAftCompare_mps2@ */ /end MEASUREMENT
/begin MEASUREMENT VVMC_ACCDeltaAccel_mps2 "" FLOAT32_IEEE SWC_FDC_type_CM_single_mps2 0 0 -15.0 15.0 ECU_ADDRESS 0x0000 /* @ECU_Address@VVMC_ACCDeltaAccel_mps2@ */ /end MEASUREMENT
/begin MEASUREMENT VVMC_ActAccDev_mps2 "" FLOAT32_IEEE SWC_FDC_type_CM_single_mps2 0 0 -20.0 20.0 ECU_ADDRESS 0x0000 /* @ECU_Address@VVMC_ActAccDev_mps2@ */ /end MEASUREMENT
/begin MEASUREMENT VVMC_DISCDeltaTqIGain_Nm "" FLOAT32_IEEE SWC_FDC_type_CM_single_Nm 0 0 -20.0 20.0 ECU_ADDRESS 0x0000 /* @ECU_Address@VVMC_DISCDeltaTqIGain_Nm@ */ /end MEASUREMENT
/begin MEASUREMENT VVMC_ADSPosGFBPCTDeltaTq_Nm "" FLOAT32_IEEE SWC_FDC_type_CM_single_Nm 0 0 -100.0 100.0 ECU_ADDRESS 0x0000 /* @ECU_Address@VVMC_ADSPosGFBPCTDeltaTq_Nm@ */ /end MEASUREMENT
/begin MEASUREMENT VVMC_ACCDeltaTqIGain4OVRD_Nm "" FLOAT32_IEEE SWC_FDC_type_CM_single_Nm 0 0 -20.0 20.0 ECU_ADDRESS 0x0000 /* @ECU_Address@VVMC_ACCDeltaTqIGain4OVRD_Nm@ */ /end MEASUREMENT
/begin MEASUREMENT VVMC_ACCDeltaTqIGainOri_Nm "" FLOAT32_IEEE SWC_FDC_type_CM_single_Nm 0 0 -20.0 20.0 ECU_ADDRESS 0x0000 /* @ECU_Address@VVMC_ACCDeltaTqIGainOri_Nm@ */ /end MEASUREMENT
/begin MEASUREMENT VVMC_ACCDeltaTqIGain_Nm "" FLOAT32_IEEE SWC_FDC_type_CM_single_Nm 0 0 -20.0 20.0 ECU_ADDRESS 0x0000 /* @ECU_Address@VVMC_ACCDeltaTqIGain_Nm@ */ /end MEASUREMENT
/begin MEASUREMENT VVMC_ACCActSpdDev_kph "" FLOAT32_IEEE SWC_FDC_type_CM_single_kph 0 0 -200.0 200.0 ECU_ADDRESS 0x0000 /* @ECU_Address@VVMC_ACCActSpdDev_kph@ */ /end MEASUREMENT
/begin MEASUREMENT VVMC_ACCDeltaTqPGain_Nm "" FLOAT32_IEEE SWC_FDC_type_CM_single_Nm 0 0 -20.0 20.0 ECU_ADDRESS 0x0000 /* @ECU_Address@VVMC_ACCDeltaTqPGain_Nm@ */ /end MEASUREMENT
/begin MEASUREMENT VVMC_ACCDeltaTq_Nm "" FLOAT32_IEEE SWC_FDC_type_CM_single_Nm 0 0 -100000.0 100000.0 ECU_ADDRESS 0x0000 /* @ECU_Address@VVMC_ACCDeltaTq_Nm@ */ /end MEASUREMENT
/begin MEASUREMENT VVMC_TMSpdBaseTq_Nm "" FLOAT32_IEEE SWC_FDC_type_CM_single_Nm 0 0 0.0 500.0 ECU_ADDRESS 0x0000 /* @ECU_Address@VVMC_TMSpdBaseTq_Nm@ */ /end MEASUREMENT
/begin MEASUREMENT VVMC_MCPresBaseTq_Nm "" FLOAT32_IEEE SWC_FDC_type_CM_single_Nm 0 0 -500.0 500.0 ECU_ADDRESS 0x0000 /* @ECU_Address@VVMC_MCPresBaseTq_Nm@ */ /end MEASUREMENT
/begin MEASUREMENT VVMC_HoldResTq_Nm "" FLOAT32_IEEE SWC_FDC_type_CM_single_Nm 0 0 -100.0 100.0 ECU_ADDRESS 0x0000 /* @ECU_Address@VVMC_HoldResTq_Nm@ */ /end MEASUREMENT
/begin MEASUREMENT VVMC_OriADASWhlTq_Nm "" FLOAT32_IEEE SWC_FDC_type_CM_single_Nm 0 0 -100000.0 100000.0 ECU_ADDRESS 0x0000 /* @ECU_Address@VVMC_OriADASWhlTq_Nm@ */ /end MEASUREMENT
/begin MEASUREMENT VVMC_ADASOvrdWhlTqCtrl_Nm "" FLOAT32_IEEE SWC_FDC_type_CM_single_Nm 0 0 -100000.0 100000.0 ECU_ADDRESS 0x0000 /* @ECU_Address@VVMC_ADASOvrdWhlTqCtrl_Nm@ */ /end MEASUREMENT
/begin MEASUREMENT VVMC_ADASOvrdWhlTq_Nm "" FLOAT32_IEEE SWC_FDC_type_CM_single_Nm 0 0 -100000.0 100000.0 ECU_ADDRESS 0x0000 /* @ECU_Address@VVMC_ADASOvrdWhlTq_Nm@ */ /end MEASUREMENT
/begin MEASUREMENT VVMC_ADASWhlTqReqOvrd_Nm "" FLOAT32_IEEE SWC_FDC_type_CM_single_Nm 0 0 -100000.0 100000.0 ECU_ADDRESS 0x0000 /* @ECU_Address@VVMC_ADASWhlTqReqOvrd_Nm@ */ /end MEASUREMENT
/begin MEASUREMENT VVMC_ADASWhlTqCalZeroRgnCtrl_Nm "" FLOAT32_IEEE SWC_FDC_type_CM_single_Nm 0 0 -100000.0 100000.0 ECU_ADDRESS 0x0000 /* @ECU_Address@VVMC_ADASWhlTqCalZeroRgnCtrl_Nm@ */ /end MEASUREMENT
/begin MEASUREMENT VVMC_FrntAxlTrqReqBrk_Nm "" FLOAT32_IEEE SWC_FDC_type_CM_single_Nm 0 0 -100000.0 100000.0 ECU_ADDRESS 0x0000 /* @ECU_Address@VVMC_FrntAxlTrqReqBrk_Nm@ */ /end MEASUREMENT
/begin MEASUREMENT VVMC_RearAxlTrqReqBrk_Nm "" FLOAT32_IEEE SWC_FDC_type_CM_single_Nm 0 0 -100000.0 100000.0 ECU_ADDRESS 0x0000 /* @ECU_Address@VVMC_RearAxlTrqReqBrk_Nm@ */ /end MEASUREMENT
/begin MEASUREMENT VVMC_ADSBRgnDeltaTq_Nm "" FLOAT32_IEEE SWC_FDC_type_CM_single_Nm 0 0 -3000.0 3000.0 ECU_ADDRESS 0x0000 /* @ECU_Address@VVMC_ADSBRgnDeltaTq_Nm@ */ /end MEASUREMENT
/begin MEASUREMENT VVMC_ACCRgnTq2Hold_Nm "" FLOAT32_IEEE SWC_FDC_type_CM_single_Nm 0 0 -3000.0 3000.0 ECU_ADDRESS 0x0000 /* @ECU_Address@VVMC_ACCRgnTq2Hold_Nm@ */ /end MEASUREMENT
/begin MEASUREMENT VVMC_ACCLowSpdTqEnSpdHi_Nm "" FLOAT32_IEEE SWC_FDC_type_CM_single_Nm 0 0 -100000.0 100000.0 ECU_ADDRESS 0x0000 /* @ECU_Address@VVMC_ACCLowSpdTqEnSpdHi_Nm@ */ /end MEASUREMENT
/begin MEASUREMENT VVMC_ACCLowSpdTqEnSpdLo_Nm "" FLOAT32_IEEE SWC_FDC_type_CM_single_Nm 0 0 -100000.0 100000.0 ECU_ADDRESS 0x0000 /* @ECU_Address@VVMC_ACCLowSpdTqEnSpdLo_Nm@ */ /end MEASUREMENT
/begin MEASUREMENT VVMC_ACCLowSpdTq_Nm "" FLOAT32_IEEE SWC_FDC_type_CM_single_Nm 0 0 -100000.0 100000.0 ECU_ADDRESS 0x0000 /* @ECU_Address@VVMC_ACCLowSpdTq_Nm@ */ /end MEASUREMENT
/begin MEASUREMENT VVMC_ACCLowSpdTqAftFollowESC_Nm "" FLOAT32_IEEE SWC_FDC_type_CM_single_Nm 0 0 -100000.0 100000.0 ECU_ADDRESS 0x0000 /* @ECU_Address@VVMC_ACCLowSpdTqAftFollowESC_Nm@ */ /end MEASUREMENT
/begin MEASUREMENT VVMC_ACCTqRampOutByMCP_Nm "" FLOAT32_IEEE SWC_FDC_type_CM_single_Nm 0 0 -100000.0 100000.0 ECU_ADDRESS 0x0000 /* @ECU_Address@VVMC_ACCTqRampOutByMCP_Nm@ */ /end MEASUREMENT
/begin MEASUREMENT VVMC_ACCTqNegReq_Nm "" FLOAT32_IEEE SWC_FDC_type_CM_single_Nm 0 0 -100000.0 100000.0 ECU_ADDRESS 0x0000 /* @ECU_Address@VVMC_ACCTqNegReq_Nm@ */ /end MEASUREMENT
/begin MEASUREMENT VVMC_ACCTqNegReqNotLowSpd_Nm "" FLOAT32_IEEE SWC_FDC_type_CM_single_Nm 0 0 -100000.0 100000.0 ECU_ADDRESS 0x0000 /* @ECU_Address@VVMC_ACCTqNegReqNotLowSpd_Nm@ */ /end MEASUREMENT
/begin MEASUREMENT VVMC_ADASWhlTqCalNegCMD_Nm "" FLOAT32_IEEE SWC_FDC_type_CM_single_Nm 0 0 -100000.0 100000.0 ECU_ADDRESS 0x0000 /* @ECU_Address@VVMC_ADASWhlTqCalNegCMD_Nm@ */ /end MEASUREMENT
/begin MEASUREMENT VVMC_ADASWhlTqCalBftHold_Nm "" FLOAT32_IEEE SWC_FDC_type_CM_single_Nm 0 0 -5000.0 5000.0 ECU_ADDRESS 0x0000 /* @ECU_Address@VVMC_ADASWhlTqCalBftHold_Nm@ */ /end MEASUREMENT
/begin MEASUREMENT VVMC_ACCDeltaTqGradeGn_Nm "" FLOAT32_IEEE SWC_FDC_type_CM_single_Nm 0 0 -1500.0 1500.0 ECU_ADDRESS 0x0000 /* @ECU_Address@VVMC_ACCDeltaTqGradeGn_Nm@ */ /end MEASUREMENT
/begin MEASUREMENT VVMC_HoldTqTarget_Nm "" FLOAT32_IEEE SWC_FDC_type_CM_single_Nm 0 0 -6000.0 6000.0 ECU_ADDRESS 0x0000 /* @ECU_Address@VVMC_HoldTqTarget_Nm@ */ /end MEASUREMENT
/begin MEASUREMENT VVMC_HoldTqTargetFinal_Nm "" FLOAT32_IEEE SWC_FDC_type_CM_single_Nm 0 0 -6000.0 6000.0 ECU_ADDRESS 0x0000 /* @ECU_Address@VVMC_HoldTqTargetFinal_Nm@ */ /end MEASUREMENT
/begin MEASUREMENT VVMC_HoldTqGradeGnFinal_Nm "" FLOAT32_IEEE SWC_FDC_type_CM_single_Nm 0 0 -6000.0 6000.0 ECU_ADDRESS 0x0000 /* @ECU_Address@VVMC_HoldTqGradeGnFinal_Nm@ */ /end MEASUREMENT
/begin MEASUREMENT VVMC_ZeroSpdTMSpdCtrlTarget_rpm "" FLOAT32_IEEE SWC_FDC_type_CM_single_rpm 0 0 -3000.0 3000.0 ECU_ADDRESS 0x0000 /* @ECU_Address@VVMC_ZeroSpdTMSpdCtrlTarget_rpm@ */ /end MEASUREMENT
/begin MEASUREMENT VVMC_TMRevPrvtTq4JertPrvt_Nm "" FLOAT32_IEEE SWC_FDC_type_CM_single_Nm 0 0 -100.0 100.0 ECU_ADDRESS 0x0000 /* @ECU_Address@VVMC_TMRevPrvtTq4JertPrvt_Nm@ */ /end MEASUREMENT
/begin MEASUREMENT VVMC_VHTMSpdCtrlDeltaTq_Nm "" FLOAT32_IEEE SWC_FDC_type_CM_single_Nm 0 0 -100.0 100.0 ECU_ADDRESS 0x0000 /* @ECU_Address@VVMC_VHTMSpdCtrlDeltaTq_Nm@ */ /end MEASUREMENT
/begin MEASUREMENT VVMC_VHJerkPrvtTq_Nm "" FLOAT32_IEEE SWC_FDC_type_CM_single_Nm 0 0 -6000.0 6000.0 ECU_ADDRESS 0x0000 /* @ECU_Address@VVMC_VHJerkPrvtTq_Nm@ */ /end MEASUREMENT
/begin MEASUREMENT VVMC_TMRevPrvtTq_Nm "" FLOAT32_IEEE SWC_FDC_type_CM_single_Nm 0 0 -100.0 100.0 ECU_ADDRESS 0x0000 /* @ECU_Address@VVMC_TMRevPrvtTq_Nm@ */ /end MEASUREMENT
/begin MEASUREMENT VVMC_ADASWhlTqCalVehHoldPosTq_Nm "" FLOAT32_IEEE SWC_FDC_type_CM_single_Nm 0 0 -100000.0 100000.0 ECU_ADDRESS 0x0000 /* @ECU_Address@VVMC_ADASWhlTqCalVehHoldPosTq_Nm@ */ /end MEASUREMENT
/begin MEASUREMENT VVMC_ADASWhlTqVehHoldBfrSS_Nm "" FLOAT32_IEEE SWC_FDC_type_CM_single_Nm 0 0 -100000.0 100000.0 ECU_ADDRESS 0x0000 /* @ECU_Address@VVMC_ADASWhlTqVehHoldBfrSS_Nm@ */ /end MEASUREMENT
/begin MEASUREMENT VVMC_ADASWhlTqCalVehHold_Nm "" FLOAT32_IEEE SWC_FDC_type_CM_single_Nm 0 0 -100000.0 100000.0 ECU_ADDRESS 0x0000 /* @ECU_Address@VVMC_ADASWhlTqCalVehHold_Nm@ */ /end MEASUREMENT
/begin MEASUREMENT VVMC_ADASWhlTqCalAftHold_Nm "" FLOAT32_IEEE SWC_FDC_type_CM_single_Nm 0 0 -5000.0 5000.0 ECU_ADDRESS 0x0000 /* @ECU_Address@VVMC_ADASWhlTqCalAftHold_Nm@ */ /end MEASUREMENT
/begin MEASUREMENT VVMC_ADASWhlTqCalAftSafety_Nm "" FLOAT32_IEEE SWC_FDC_type_CM_single_Nm 0 0 -100000.0 100000.0 ECU_ADDRESS 0x0000 /* @ECU_Address@VVMC_ADASWhlTqCalAftSafety_Nm@ */ /end MEASUREMENT
/begin MEASUREMENT VVMC_ADASWhlTqCalBftZC_Nm "" FLOAT32_IEEE SWC_FDC_type_CM_single_Nm 0 0 -100000.0 100000.0 ECU_ADDRESS 0x0000 /* @ECU_Address@VVMC_ADASWhlTqCalBftZC_Nm@ */ /end MEASUREMENT
/begin MEASUREMENT VVMC_NegZCHoldTq_Nm "" FLOAT32_IEEE SWC_FDC_type_CM_single_Nm 0 0 -10000.0 10000.0 ECU_ADDRESS 0x0000 /* @ECU_Address@VVMC_NegZCHoldTq_Nm@ */ /end MEASUREMENT
/begin MEASUREMENT VVMC_ZCWaitTimeNeg_s "" FLOAT32_IEEE SWC_FDC_type_CM_single_s 0 0 0.0 10.0 ECU_ADDRESS 0x0000 /* @ECU_Address@VVMC_ZCWaitTimeNeg_s@ */ /end MEASUREMENT
/begin MEASUREMENT VVMC_PosZCHoldTq_Nm "" FLOAT32_IEEE SWC_FDC_type_CM_single_Nm 0 0 -10000.0 10000.0 ECU_ADDRESS 0x0000 /* @ECU_Address@VVMC_PosZCHoldTq_Nm@ */ /end MEASUREMENT
/begin MEASUREMENT VVMC_ZCWaitTimePos_s "" FLOAT32_IEEE SWC_FDC_type_CM_single_s 0 0 0.0 10.0 ECU_ADDRESS 0x0000 /* @ECU_Address@VVMC_ZCWaitTimePos_s@ */ /end MEASUREMENT
/begin MEASUREMENT VVMC_ADASWhlTqCal_Nm "" FLOAT32_IEEE SWC_FDC_type_CM_single_Nm 0 0 -100000.0 100000.0 ECU_ADDRESS 0x0000 /* @ECU_Address@VVMC_ADASWhlTqCal_Nm@ */ /end MEASUREMENT
/begin MEASUREMENT VVMC_ADASWhlTqReq_Nm "" FLOAT32_IEEE SWC_FDC_type_CM_single_Nm 0 0 -100000.0 100000.0 ECU_ADDRESS 0x0000 /* @ECU_Address@VVMC_ADASWhlTqReq_Nm@ */ /end MEASUREMENT
/begin MEASUREMENT VVMC_CCPGainDeltaTq_Nm "" FLOAT32_IEEE SWC_FDC_type_CM_single_Nm 0 0 -100000.0 100000.0 ECU_ADDRESS 0x0000 /* @ECU_Address@VVMC_CCPGainDeltaTq_Nm@ */ /end MEASUREMENT
/begin MEASUREMENT VVMC_LastCruzWhlTqCal_Nm "" FLOAT32_IEEE SWC_FDC_type_CM_single_Nm 0 0 -100000.0 100000.0 ECU_ADDRESS 0x0000 /* @ECU_Address@VVMC_LastCruzWhlTqCal_Nm@ */ /end MEASUREMENT
/begin MEASUREMENT VVMC_CCIGainDeltaTq_Nm "" FLOAT32_IEEE SWC_FDC_type_CM_single_Nm 0 0 -100000.0 100000.0 ECU_ADDRESS 0x0000 /* @ECU_Address@VVMC_CCIGainDeltaTq_Nm@ */ /end MEASUREMENT
/begin MEASUREMENT VVMC_CruzWhlTqCalAftSafety_Nm "" FLOAT32_IEEE SWC_FDC_type_CM_single_Nm 0 0 -100000.0 100000.0 ECU_ADDRESS 0x0000 /* @ECU_Address@VVMC_CruzWhlTqCalAftSafety_Nm@ */ /end MEASUREMENT
/begin MEASUREMENT VVMC_CruzWhlTqCal_Nm "" FLOAT32_IEEE SWC_FDC_type_CM_single_Nm 0 0 -100000.0 100000.0 ECU_ADDRESS 0x0000 /* @ECU_Address@VVMC_CruzWhlTqCal_Nm@ */ /end MEASUREMENT
/begin MEASUREMENT VVMC_CruzWhlTqReq_Nm "" FLOAT32_IEEE SWC_FDC_type_CM_single_Nm 0 0 -100000.0 100000.0 ECU_ADDRESS 0x0000 /* @ECU_Address@VVMC_CruzWhlTqReq_Nm@ */ /end MEASUREMENT
/begin MEASUREMENT VVMC_VMCWhlTq4RatioCalcu_Nm "" FLOAT32_IEEE SWC_FDC_type_CM_single_Nm 0 0 -100000.0 100000.0 ECU_ADDRESS 0x0000 /* @ECU_Address@VVMC_VMCWhlTq4RatioCalcu_Nm@ */ /end MEASUREMENT
/begin MEASUREMENT VVMC_PedalTqRWhlRatio_rat "" FLOAT32_IEEE SWC_FDC_type_CM_single_rat 0 0 0.0 1.0 ECU_ADDRESS 0x0000 /* @ECU_Address@VVMC_PedalTqRWhlRatio_rat@ */ /end MEASUREMENT
/begin MEASUREMENT VVMC_RearTqRatioBfrSlip_rat "" FLOAT32_IEEE SWC_FDC_type_CM_single_rat 0 0 0.0 1.0 ECU_ADDRESS 0x0000 /* @ECU_Address@VVMC_RearTqRatioBfrSlip_rat@ */ /end MEASUREMENT
/begin MEASUREMENT VVMC_ADASRrWhlTqBfrSlip_Nm "" FLOAT32_IEEE SWC_FDC_type_CM_single_Nm 0 0 -100000.0 100000.0 ECU_ADDRESS 0x0000 /* @ECU_Address@VVMC_ADASRrWhlTqBfrSlip_Nm@ */ /end MEASUREMENT
/begin MEASUREMENT VVMC_FrRrSlipRate_rat "" FLOAT32_IEEE SWC_FDC_type_CM_single_rat 0 0 -1.0 1.0 ECU_ADDRESS 0x0000 /* @ECU_Address@VVMC_FrRrSlipRate_rat@ */ /end MEASUREMENT
/begin MEASUREMENT VVMC_PedalTqRWhlSlipGain_Nm "" FLOAT32_IEEE SWC_FDC_type_CM_single_Nm 0 0 -100000.0 100000.0 ECU_ADDRESS 0x0000 /* @ECU_Address@VVMC_PedalTqRWhlSlipGain_Nm@ */ /end MEASUREMENT
/begin MEASUREMENT VVMC_RearWhlTqSlipGain_Nm "" FLOAT32_IEEE SWC_FDC_type_CM_single_Nm 0 0 -100000.0 100000.0 ECU_ADDRESS 0x0000 /* @ECU_Address@VVMC_RearWhlTqSlipGain_Nm@ */ /end MEASUREMENT
/begin MEASUREMENT VVMC_PedalTqRWhSTRGGain_Nm "" FLOAT32_IEEE SWC_FDC_type_CM_single_Nm 0 0 -100000.0 100000.0 ECU_ADDRESS 0x0000 /* @ECU_Address@VVMC_PedalTqRWhSTRGGain_Nm@ */ /end MEASUREMENT
/begin MEASUREMENT VVMC_RearWhlTqSTRGGain_Nm "" FLOAT32_IEEE SWC_FDC_type_CM_single_Nm 0 0 -100000.0 100000.0 ECU_ADDRESS 0x0000 /* @ECU_Address@VVMC_RearWhlTqSTRGGain_Nm@ */ /end MEASUREMENT
/begin MEASUREMENT VVMC_RearTqRatioAftSlip_rat "" FLOAT32_IEEE SWC_FDC_type_CM_single_rat 0 0 0.0 1.0 ECU_ADDRESS 0x0000 /* @ECU_Address@VVMC_RearTqRatioAftSlip_rat@ */ /end MEASUREMENT
/begin MEASUREMENT VVMC_ADASRrWhlTqAftSlip_Nm "" FLOAT32_IEEE SWC_FDC_type_CM_single_Nm 0 0 -100000.0 100000.0 ECU_ADDRESS 0x0000 /* @ECU_Address@VVMC_ADASRrWhlTqAftSlip_Nm@ */ /end MEASUREMENT
/begin MEASUREMENT VVMC_ADASRrWhlTqAftLim_Nm "" FLOAT32_IEEE SWC_FDC_type_CM_single_Nm 0 0 -100000.0 100000.0 ECU_ADDRESS 0x0000 /* @ECU_Address@VVMC_ADASRrWhlTqAftLim_Nm@ */ /end MEASUREMENT
/begin MEASUREMENT VVMC_ADASFrWhlTqAftSlip_Nm "" FLOAT32_IEEE SWC_FDC_type_CM_single_Nm 0 0 -100000.0 100000.0 ECU_ADDRESS 0x0000 /* @ECU_Address@VVMC_ADASFrWhlTqAftSlip_Nm@ */ /end MEASUREMENT
/begin MEASUREMENT VVMC_ADASFrWhlTqAftLim_Nm "" FLOAT32_IEEE SWC_FDC_type_CM_single_Nm 0 0 -100000.0 100000.0 ECU_ADDRESS 0x0000 /* @ECU_Address@VVMC_ADASFrWhlTqAftLim_Nm@ */ /end MEASUREMENT
/begin MEASUREMENT VVMC_ADASRrWhlTq_Nm "" FLOAT32_IEEE SWC_FDC_type_CM_single_Nm 0 0 -100000.0 100000.0 ECU_ADDRESS 0x0000 /* @ECU_Address@VVMC_ADASRrWhlTq_Nm@ */ /end MEASUREMENT
/begin MEASUREMENT VVMC_RearTqRatio_rat "" FLOAT32_IEEE SWC_FDC_type_CM_single_rat 0 0 0.0 1.0 ECU_ADDRESS 0x0000 /* @ECU_Address@VVMC_RearTqRatio_rat@ */ /end MEASUREMENT
/begin MEASUREMENT VVMC_TimeGapCalcu_s "" FLOAT32_IEEE SWC_FDC_type_CM_single_s 0 0 0.0 25.5 ECU_ADDRESS 0x0000 /* @ECU_Address@VVMC_TimeGapCalcu_s@ */ /end MEASUREMENT
/begin MEASUREMENT VVMC_APSSpeedCMD_kph "" FLOAT32_IEEE SWC_FDC_type_CM_single_kph 0 0 0.0 20.0 ECU_ADDRESS 0x0000 /* @ECU_Address@VVMC_APSSpeedCMD_kph@ */ /end MEASUREMENT
/begin MEASUREMENT VVMC_SensingGyroZ_Dps "" FLOAT32_IEEE SWC_FDC_type_CM_single_Dps 0 0 -1966.0 1966.0 ECU_ADDRESS 0x0000 /* @ECU_Address@VVMC_SensingGyroZ_Dps@ */ /end MEASUREMENT
/begin MEASUREMENT VVMC_MemOffsetGyroZ_Dps "" FLOAT32_IEEE SWC_FDC_type_CM_single_Dps 0 0 -1966.0 1966.0 ECU_ADDRESS 0x0000 /* @ECU_Address@VVMC_MemOffsetGyroZ_Dps@ */ /end MEASUREMENT
/begin MEASUREMENT VVMC_SensingGyroX_Dps "" FLOAT32_IEEE SWC_FDC_type_CM_single_Dps 0 0 -1966.0 1966.0 ECU_ADDRESS 0x0000 /* @ECU_Address@VVMC_SensingGyroX_Dps@ */ /end MEASUREMENT
/begin MEASUREMENT VVMC_MemOffsetGyroX_Dps "" FLOAT32_IEEE SWC_FDC_type_CM_single_Dps 0 0 -1966.0 1966.0 ECU_ADDRESS 0x0000 /* @ECU_Address@VVMC_MemOffsetGyroX_Dps@ */ /end MEASUREMENT
/begin MEASUREMENT VVMC_ADASFrWhlTqBfrSlip_Nm "" FLOAT32_IEEE SWC_FDC_type_CM_single_Nm 0 0 -100000.0 100000.0 ECU_ADDRESS 0x0000 /* @ECU_Address@VVMC_ADASFrWhlTqBfrSlip_Nm@ */ /end MEASUREMENT
/begin MEASUREMENT VVMC_ADASFrWhlTq_Nm "" FLOAT32_IEEE SWC_FDC_type_CM_single_Nm 0 0 -100000.0 100000.0 ECU_ADDRESS 0x0000 /* @ECU_Address@VVMC_ADASFrWhlTq_Nm@ */ /end MEASUREMENT
/begin MEASUREMENT VVMC_CalibratedAccXAftRA_G "" FLOAT32_IEEE SWC_FDC_type_CM_single_G 0 0 -65.536 65.536 ECU_ADDRESS 0x0000 /* @ECU_Address@VVMC_CalibratedAccXAftRA_G@ */ /end MEASUREMENT
/begin MEASUREMENT VTQR_FrntAxlTrqReqBrkRamp_Nm "" FLOAT32_IEEE SWC_FDC_type_CM_single_Nm 0 0 -100000.0 100000.0 ECU_ADDRESS 0x0000 /* @ECU_Address@VTQR_FrntAxlTrqReqBrkRamp_Nm@ */ /end MEASUREMENT
/begin MEASUREMENT VTQR_RampTqCMDGain_c "" FLOAT32_IEEE SWC_FDC_type_CM_single_c 0 0 -1.0 1.0 ECU_ADDRESS 0x0000 /* @ECU_Address@VTQR_RampTqCMDGain_c@ */ /end MEASUREMENT
/begin MEASUREMENT VTQR_ActFEDUTqUpLimit_Nm "" FLOAT32_IEEE SWC_FDC_type_CM_single_Nm 0 0 0.0 100000.0 ECU_ADDRESS 0x0000 /* @ECU_Address@VTQR_ActFEDUTqUpLimit_Nm@ */ /end MEASUREMENT
/begin MEASUREMENT VTQR_FEDUWhlTqReqSmoothDelay_Nm "" FLOAT32_IEEE SWC_FDC_type_CM_single_Nm 0 0 -100000.0 100000.0 ECU_ADDRESS 0x0000 /* @ECU_Address@VTQR_FEDUWhlTqReqSmoothDelay_Nm@ */ /end MEASUREMENT
/begin MEASUREMENT VTQR_REDUWhlTqReqSmoothDelay_Nm "" FLOAT32_IEEE SWC_FDC_type_CM_single_Nm 0 0 -100000.0 100000.0 ECU_ADDRESS 0x0000 /* @ECU_Address@VTQR_REDUWhlTqReqSmoothDelay_Nm@ */ /end MEASUREMENT
/begin MEASUREMENT VTQR_ActFEDUTqLowLimit_Nm "" FLOAT32_IEEE SWC_FDC_type_CM_single_Nm 0 0 -100000.0 100000.0 ECU_ADDRESS 0x0000 /* @ECU_Address@VTQR_ActFEDUTqLowLimit_Nm@ */ /end MEASUREMENT
/begin MEASUREMENT VTQR_NoABSFEDUWhlTqReq_Nm "" FLOAT32_IEEE SWC_FDC_type_CM_single_Nm 0 0 -100000.0 100000.0 ECU_ADDRESS 0x0000 /* @ECU_Address@VTQR_NoABSFEDUWhlTqReq_Nm@ */ /end MEASUREMENT
/begin MEASUREMENT VTQR_ActualFEDUWhlTqReq_Nm "" FLOAT32_IEEE SWC_FDC_type_CM_single_Nm 0 0 -100000.0 100000.0 ECU_ADDRESS 0x0000 /* @ECU_Address@VTQR_ActualFEDUWhlTqReq_Nm@ */ /end MEASUREMENT
/begin MEASUREMENT VTQR_InitFEDUWhlTqReq_Nm "" FLOAT32_IEEE SWC_FDC_type_CM_single_Nm 0 0 -100000.0 100000.0 ECU_ADDRESS 0x0000 /* @ECU_Address@VTQR_InitFEDUWhlTqReq_Nm@ */ /end MEASUREMENT
/begin MEASUREMENT VTQR_FrTMTqReq_Nm "" FLOAT32_IEEE SWC_FDC_type_CM_single_Nm 0 0 -100000.0 100000.0 ECU_ADDRESS 0x0000 /* @ECU_Address@VTQR_FrTMTqReq_Nm@ */ /end MEASUREMENT
/begin MEASUREMENT VTQR_RearAxlTrqReqBrkRamp_Nm "" FLOAT32_IEEE SWC_FDC_type_CM_single_Nm 0 0 -100000.0 100000.0 ECU_ADDRESS 0x0000 /* @ECU_Address@VTQR_RearAxlTrqReqBrkRamp_Nm@ */ /end MEASUREMENT
/begin MEASUREMENT VTQR_ActREDUTqUpLimit_Nm "" FLOAT32_IEEE SWC_FDC_type_CM_single_Nm 0 0 0.0 100000.0 ECU_ADDRESS 0x0000 /* @ECU_Address@VTQR_ActREDUTqUpLimit_Nm@ */ /end MEASUREMENT
/begin MEASUREMENT VTQR_ActREDUTqLowLimit_Nm "" FLOAT32_IEEE SWC_FDC_type_CM_single_Nm 0 0 -100000.0 100000.0 ECU_ADDRESS 0x0000 /* @ECU_Address@VTQR_ActREDUTqLowLimit_Nm@ */ /end MEASUREMENT
/begin MEASUREMENT VTQR_NoABSREDUWhlTqReq_Nm "" FLOAT32_IEEE SWC_FDC_type_CM_single_Nm 0 0 -100000.0 100000.0 ECU_ADDRESS 0x0000 /* @ECU_Address@VTQR_NoABSREDUWhlTqReq_Nm@ */ /end MEASUREMENT
/begin MEASUREMENT VTQR_ActualREDUWhlTqReq_Nm "" FLOAT32_IEEE SWC_FDC_type_CM_single_Nm 0 0 -100000.0 100000.0 ECU_ADDRESS 0x0000 /* @ECU_Address@VTQR_ActualREDUWhlTqReq_Nm@ */ /end MEASUREMENT
/begin MEASUREMENT VTQR_InitREDUWhlTqReq_Nm "" FLOAT32_IEEE SWC_FDC_type_CM_single_Nm 0 0 -100000.0 100000.0 ECU_ADDRESS 0x0000 /* @ECU_Address@VTQR_InitREDUWhlTqReq_Nm@ */ /end MEASUREMENT
/begin MEASUREMENT VTQR_RrTMTqReq_Nm "" FLOAT32_IEEE SWC_FDC_type_CM_single_Nm 0 0 -100000.0 100000.0 ECU_ADDRESS 0x0000 /* @ECU_Address@VTQR_RrTMTqReq_Nm@ */ /end MEASUREMENT
/begin MEASUREMENT VTQR_FrFirstOrderOutTqDelay_Nm "" FLOAT32_IEEE SWC_FDC_type_CM_single_Nm 0 0 -100000.0 100000.0 ECU_ADDRESS 0x0000 /* @ECU_Address@VTQR_FrFirstOrderOutTqDelay_Nm@ */ /end MEASUREMENT
/begin MEASUREMENT VTQR_RrFirstOrderOutTqDelay_Nm "" FLOAT32_IEEE SWC_FDC_type_CM_single_Nm 0 0 -100000.0 100000.0 ECU_ADDRESS 0x0000 /* @ECU_Address@VTQR_RrFirstOrderOutTqDelay_Nm@ */ /end MEASUREMENT
/begin MEASUREMENT VTQD_VehSpeed4Cal_kph "" FLOAT32_IEEE SWC_FDC_type_CM_single_kph 0 0 0.0 300.0 ECU_ADDRESS 0x0000 /* @ECU_Address@VTQD_VehSpeed4Cal_kph@ */ /end MEASUREMENT
/begin MEASUREMENT VTQD_LFSlideRate_pct "" FLOAT32_IEEE SWC_FDC_type_CM_single_pct 0 0 -125.0 125.0 ECU_ADDRESS 0x0000 /* @ECU_Address@VTQD_LFSlideRate_pct@ */ /end MEASUREMENT
/begin MEASUREMENT VTQD_RFSlideRate_pct "" FLOAT32_IEEE SWC_FDC_type_CM_single_pct 0 0 -125.0 125.0 ECU_ADDRESS 0x0000 /* @ECU_Address@VTQD_RFSlideRate_pct@ */ /end MEASUREMENT
/begin MEASUREMENT VTQD_LRSlideRate_pct "" FLOAT32_IEEE SWC_FDC_type_CM_single_pct 0 0 -125.0 125.0 ECU_ADDRESS 0x0000 /* @ECU_Address@VTQD_LRSlideRate_pct@ */ /end MEASUREMENT
/begin MEASUREMENT VTQD_RRSlideRate_pct "" FLOAT32_IEEE SWC_FDC_type_CM_single_pct 0 0 -125.0 125.0 ECU_ADDRESS 0x0000 /* @ECU_Address@VTQD_RRSlideRate_pct@ */ /end MEASUREMENT
/begin MEASUREMENT VTQD_CoordTqDem_Nm "" FLOAT32_IEEE SWC_FDC_type_CM_single_Nm 0 0 -100000.0 100000.0 ECU_ADDRESS 0x0000 /* @ECU_Address@VTQD_CoordTqDem_Nm@ */ /end MEASUREMENT
/begin MEASUREMENT VTQD_SnowMRrEDUSpRat_rat "" FLOAT32_IEEE SWC_FDC_type_CM_single_rat 0 0 0.0 1.0 ECU_ADDRESS 0x0000 /* @ECU_Address@VTQD_SnowMRrEDUSpRat_rat@ */ /end MEASUREMENT
/begin MEASUREMENT VTQD_AWDLoadTrqnsGain_pct "" FLOAT32_IEEE SWC_FDC_type_CM_single_pct 0 0 0.0 300.0 ECU_ADDRESS 0x0000 /* @ECU_Address@VTQD_AWDLoadTrqnsGain_pct@ */ /end MEASUREMENT
/begin MEASUREMENT VTQD_AWDLoadTrqnsGain_c "" FLOAT32_IEEE SWC_FDC_type_CM_single_c 0 0 0.0 1.5 ECU_ADDRESS 0x0000 /* @ECU_Address@VTQD_AWDLoadTrqnsGain_c@ */ /end MEASUREMENT
/begin MEASUREMENT VTQD_OrigRrDriverRatio_rat "" FLOAT32_IEEE SWC_FDC_type_CM_single_rat 0 0 0.0 1.0 ECU_ADDRESS 0x0000 /* @ECU_Address@VTQD_OrigRrDriverRatio_rat@ */ /end MEASUREMENT
/begin MEASUREMENT VTQD_FrontSlideRate_pct "" FLOAT32_IEEE SWC_FDC_type_CM_single_pct 0 0 -125.0 125.0 ECU_ADDRESS 0x0000 /* @ECU_Address@VTQD_FrontSlideRate_pct@ */ /end MEASUREMENT
/begin MEASUREMENT VTQD_RrRatioWithFrSR_rat "" FLOAT32_IEEE SWC_FDC_type_CM_single_rat 0 0 0.0 1.0 ECU_ADDRESS 0x0000 /* @ECU_Address@VTQD_RrRatioWithFrSR_rat@ */ /end MEASUREMENT
/begin MEASUREMENT VTQD_RearSlideRate_pct "" FLOAT32_IEEE SWC_FDC_type_CM_single_pct 0 0 -125.0 125.0 ECU_ADDRESS 0x0000 /* @ECU_Address@VTQD_RearSlideRate_pct@ */ /end MEASUREMENT
/begin MEASUREMENT VTQD_RrRatioWithRrSR_rat "" FLOAT32_IEEE SWC_FDC_type_CM_single_rat 0 0 0.0 1.0 ECU_ADDRESS 0x0000 /* @ECU_Address@VTQD_RrRatioWithRrSR_rat@ */ /end MEASUREMENT
/begin MEASUREMENT VTQD_CreepRrTqSpRat_rat "" FLOAT32_IEEE SWC_FDC_type_CM_single_rat 0 0 0.0 1.0 ECU_ADDRESS 0x0000 /* @ECU_Address@VTQD_CreepRrTqSpRat_rat@ */ /end MEASUREMENT
/begin MEASUREMENT VTQD_RrTqSRRateTs_c "" FLOAT32_IEEE SWC_FDC_type_CM_single_c 0 0 0.0 1.0 ECU_ADDRESS 0x0000 /* @ECU_Address@VTQD_RrTqSRRateTs_c@ */ /end MEASUREMENT
/begin MEASUREMENT VTQD_FrEDUSpRat_rat "" FLOAT32_IEEE SWC_FDC_type_CM_single_rat 0 0 0.0 1.0 ECU_ADDRESS 0x0000 /* @ECU_Address@VTQD_FrEDUSpRat_rat@ */ /end MEASUREMENT
/begin MEASUREMENT VTQD_EscapeModePedTqRr_Nm "" FLOAT32_IEEE SWC_FDC_type_CM_single_Nm 0 0 -100000.0 100000.0 ECU_ADDRESS 0x0000 /* @ECU_Address@VTQD_EscapeModePedTqRr_Nm@ */ /end MEASUREMENT
/begin MEASUREMENT VTQD_RrEDUSpRat_rat "" FLOAT32_IEEE SWC_FDC_type_CM_single_rat 0 0 0.0 1.0 ECU_ADDRESS 0x0000 /* @ECU_Address@VTQD_RrEDUSpRat_rat@ */ /end MEASUREMENT
/begin MEASUREMENT VTQD_CoordTqDemRr_Nm "" FLOAT32_IEEE SWC_FDC_type_CM_single_Nm 0 0 -100000.0 100000.0 ECU_ADDRESS 0x0000 /* @ECU_Address@VTQD_CoordTqDemRr_Nm@ */ /end MEASUREMENT
/begin MEASUREMENT VTQD_FrTCSCompensateTq_Nm "" FLOAT32_IEEE SWC_FDC_type_CM_single_Nm 0 0 -100000.0 100000.0 ECU_ADDRESS 0x0000 /* @ECU_Address@VTQD_FrTCSCompensateTq_Nm@ */ /end MEASUREMENT
/begin MEASUREMENT VTQD_EscapeModePedTqFr_Nm "" FLOAT32_IEEE SWC_FDC_type_CM_single_Nm 0 0 -100000.0 100000.0 ECU_ADDRESS 0x0000 /* @ECU_Address@VTQD_EscapeModePedTqFr_Nm@ */ /end MEASUREMENT
/begin MEASUREMENT VTQD_CoordTqDemFr_Nm "" FLOAT32_IEEE SWC_FDC_type_CM_single_Nm 0 0 -100000.0 100000.0 ECU_ADDRESS 0x0000 /* @ECU_Address@VTQD_CoordTqDemFr_Nm@ */ /end MEASUREMENT
/begin MEASUREMENT VTQD_CoordWhlTqDemFr_Nm "" FLOAT32_IEEE SWC_FDC_type_CM_single_Nm 0 0 -100000.0 100000.0 ECU_ADDRESS 0x0000 /* @ECU_Address@VTQD_CoordWhlTqDemFr_Nm@ */ /end MEASUREMENT
/begin MEASUREMENT VTQD_RrTCSCompensateTq_Nm "" FLOAT32_IEEE SWC_FDC_type_CM_single_Nm 0 0 -100000.0 100000.0 ECU_ADDRESS 0x0000 /* @ECU_Address@VTQD_RrTCSCompensateTq_Nm@ */ /end MEASUREMENT
/begin MEASUREMENT VTQD_CoordWhlTqDemRr_Nm "" FLOAT32_IEEE SWC_FDC_type_CM_single_Nm 0 0 -100000.0 100000.0 ECU_ADDRESS 0x0000 /* @ECU_Address@VTQD_CoordWhlTqDemRr_Nm@ */ /end MEASUREMENT
/begin MEASUREMENT VTQD_FrAvailableTqUpLimt_Nm "" FLOAT32_IEEE SWC_FDC_type_CM_single_Nm 0 0 -100000.0 100000.0 ECU_ADDRESS 0x0000 /* @ECU_Address@VTQD_FrAvailableTqUpLimt_Nm@ */ /end MEASUREMENT
/begin MEASUREMENT VTQD_AfterTqMinGain_c "" FLOAT32_IEEE SWC_FDC_type_CM_single_c 0 0 0.0 1.0 ECU_ADDRESS 0x0000 /* @ECU_Address@VTQD_AfterTqMinGain_c@ */ /end MEASUREMENT
/begin MEASUREMENT VTQD_AfterAvailableTqDemFr_Nm "" FLOAT32_IEEE SWC_FDC_type_CM_single_Nm 0 0 -100000.0 100000.0 ECU_ADDRESS 0x0000 /* @ECU_Address@VTQD_AfterAvailableTqDemFr_Nm@ */ /end MEASUREMENT
/begin MEASUREMENT VTQD_RrAvailableTqUpLimt_Nm "" FLOAT32_IEEE SWC_FDC_type_CM_single_Nm 0 0 -100000.0 100000.0 ECU_ADDRESS 0x0000 /* @ECU_Address@VTQD_RrAvailableTqUpLimt_Nm@ */ /end MEASUREMENT
/begin MEASUREMENT VTQD_AfterAvailableTqDemRr_Nm "" FLOAT32_IEEE SWC_FDC_type_CM_single_Nm 0 0 -100000.0 100000.0 ECU_ADDRESS 0x0000 /* @ECU_Address@VTQD_AfterAvailableTqDemRr_Nm@ */ /end MEASUREMENT
/begin MEASUREMENT VTQD_DriverWhlTqDemFr_Nm "" FLOAT32_IEEE SWC_FDC_type_CM_single_Nm 0 0 -100000.0 100000.0 ECU_ADDRESS 0x0000 /* @ECU_Address@VTQD_DriverWhlTqDemFr_Nm@ */ /end MEASUREMENT
/begin MEASUREMENT VTQD_DriverWhlTqDemRr_Nm "" FLOAT32_IEEE SWC_FDC_type_CM_single_Nm 0 0 -100000.0 100000.0 ECU_ADDRESS 0x0000 /* @ECU_Address@VTQD_DriverWhlTqDemRr_Nm@ */ /end MEASUREMENT
/begin MEASUREMENT VTQD_FrEDUAvailBrkRgnTq_Nm "" FLOAT32_IEEE SWC_FDC_type_CM_single_Nm 0 0 -100000.0 100000.0 ECU_ADDRESS 0x0000 /* @ECU_Address@VTQD_FrEDUAvailBrkRgnTq_Nm@ */ /end MEASUREMENT
/begin MEASUREMENT VTQD_RrEDUAvailBrkRgnTq_Nm "" FLOAT32_IEEE SWC_FDC_type_CM_single_Nm 0 0 -100000.0 100000.0 ECU_ADDRESS 0x0000 /* @ECU_Address@VTQD_RrEDUAvailBrkRgnTq_Nm@ */ /end MEASUREMENT
/begin MEASUREMENT VTQD_FrTMTqDeviation_c "" FLOAT32_IEEE SWC_FDC_type_CM_single_c 0 0 0.0 2.0 ECU_ADDRESS 0x0000 /* @ECU_Address@VTQD_FrTMTqDeviation_c@ */ /end MEASUREMENT
/begin MEASUREMENT VTQD_ActFrTMTqDeviation_c "" FLOAT32_IEEE SWC_FDC_type_CM_single_c 0 0 0.0 2.0 ECU_ADDRESS 0x0000 /* @ECU_Address@VTQD_ActFrTMTqDeviation_c@ */ /end MEASUREMENT
/begin MEASUREMENT VTQD_FrBRegenCal_Nm "" FLOAT32_IEEE SWC_FDC_type_CM_single_Nm 0 0 -100000.0 100000.0 ECU_ADDRESS 0x0000 /* @ECU_Address@VTQD_FrBRegenCal_Nm@ */ /end MEASUREMENT
/begin MEASUREMENT VTQD_FrEDUActTq_Nm "" FLOAT32_IEEE SWC_FDC_type_CM_single_Nm 0 0 -100000.0 100000.0 ECU_ADDRESS 0x0000 /* @ECU_Address@VTQD_FrEDUActTq_Nm@ */ /end MEASUREMENT
/begin MEASUREMENT VTQD_RrTMTqDeviation_c "" FLOAT32_IEEE SWC_FDC_type_CM_single_c 0 0 0.0 2.0 ECU_ADDRESS 0x0000 /* @ECU_Address@VTQD_RrTMTqDeviation_c@ */ /end MEASUREMENT
/begin MEASUREMENT VTQD_ActRrTMTqDeviation_c "" FLOAT32_IEEE SWC_FDC_type_CM_single_c 0 0 0.0 2.0 ECU_ADDRESS 0x0000 /* @ECU_Address@VTQD_ActRrTMTqDeviation_c@ */ /end MEASUREMENT
/begin MEASUREMENT VTQD_RrBRegenCal_Nm "" FLOAT32_IEEE SWC_FDC_type_CM_single_Nm 0 0 -100000.0 100000.0 ECU_ADDRESS 0x0000 /* @ECU_Address@VTQD_RrBRegenCal_Nm@ */ /end MEASUREMENT
/begin MEASUREMENT VTQD_RrEDUActTq_Nm "" FLOAT32_IEEE SWC_FDC_type_CM_single_Nm 0 0 -100000.0 100000.0 ECU_ADDRESS 0x0000 /* @ECU_Address@VTQD_RrEDUActTq_Nm@ */ /end MEASUREMENT
/begin MEASUREMENT VTQD_FrARgnTqDeviation_c "" FLOAT32_IEEE SWC_FDC_type_CM_single_c 0 0 0.0 2.0 ECU_ADDRESS 0x0000 /* @ECU_Address@VTQD_FrARgnTqDeviation_c@ */ /end MEASUREMENT
/begin MEASUREMENT VTQD_FrARegenCal_Nm "" FLOAT32_IEEE SWC_FDC_type_CM_single_Nm 0 0 -100000.0 100000.0 ECU_ADDRESS 0x0000 /* @ECU_Address@VTQD_FrARegenCal_Nm@ */ /end MEASUREMENT
/begin MEASUREMENT VTQD_FrEDURolRgnTq_Nm "" FLOAT32_IEEE SWC_FDC_type_CM_single_Nm 0 0 -100000.0 100000.0 ECU_ADDRESS 0x0000 /* @ECU_Address@VTQD_FrEDURolRgnTq_Nm@ */ /end MEASUREMENT
/begin MEASUREMENT VTQD_RrARgnTqDeviation_c "" FLOAT32_IEEE SWC_FDC_type_CM_single_c 0 0 0.0 2.0 ECU_ADDRESS 0x0000 /* @ECU_Address@VTQD_RrARgnTqDeviation_c@ */ /end MEASUREMENT
/begin MEASUREMENT VTQD_RrARegenCal_Nm "" FLOAT32_IEEE SWC_FDC_type_CM_single_Nm 0 0 -100000.0 100000.0 ECU_ADDRESS 0x0000 /* @ECU_Address@VTQD_RrARegenCal_Nm@ */ /end MEASUREMENT
/begin MEASUREMENT VTQD_RrEDURolRgnTq_Nm "" FLOAT32_IEEE SWC_FDC_type_CM_single_Nm 0 0 -100000.0 100000.0 ECU_ADDRESS 0x0000 /* @ECU_Address@VTQD_RrEDURolRgnTq_Nm@ */ /end MEASUREMENT
/begin MEASUREMENT VTQD_FrIdcMin_A "" FLOAT32_IEEE SWC_FDC_type_CM_single_A 0 0 -1022.0 0.0 ECU_ADDRESS 0x0000 /* @ECU_Address@VTQD_FrIdcMin_A@ */ /end MEASUREMENT
/begin MEASUREMENT VTQD_FrIdcMax_A "" FLOAT32_IEEE SWC_FDC_type_CM_single_A 0 0 0.0 1022.0 ECU_ADDRESS 0x0000 /* @ECU_Address@VTQD_FrIdcMax_A@ */ /end MEASUREMENT
/begin MEASUREMENT VTQD_FrUdcMin_V "" FLOAT32_IEEE SWC_FDC_type_CM_single_V 0 0 0.0 1022.0 ECU_ADDRESS 0x0000 /* @ECU_Address@VTQD_FrUdcMin_V@ */ /end MEASUREMENT
/begin MEASUREMENT VTQD_FrUdcMax_V "" FLOAT32_IEEE SWC_FDC_type_CM_single_V 0 0 0.0 1022.0 ECU_ADDRESS 0x0000 /* @ECU_Address@VTQD_FrUdcMax_V@ */ /end MEASUREMENT
/begin MEASUREMENT VTQD_RrIdcMin_A "" FLOAT32_IEEE SWC_FDC_type_CM_single_A 0 0 -1022.0 0.0 ECU_ADDRESS 0x0000 /* @ECU_Address@VTQD_RrIdcMin_A@ */ /end MEASUREMENT
/begin MEASUREMENT VTQD_RrIdcMax_A "" FLOAT32_IEEE SWC_FDC_type_CM_single_A 0 0 0.0 1022.0 ECU_ADDRESS 0x0000 /* @ECU_Address@VTQD_RrIdcMax_A@ */ /end MEASUREMENT
/begin MEASUREMENT VTQD_RrUdcMin_V "" FLOAT32_IEEE SWC_FDC_type_CM_single_V 0 0 0.0 1022.0 ECU_ADDRESS 0x0000 /* @ECU_Address@VTQD_RrUdcMin_V@ */ /end MEASUREMENT
/begin MEASUREMENT VTQD_RrUdcMax_V "" FLOAT32_IEEE SWC_FDC_type_CM_single_V 0 0 0.0 1022.0 ECU_ADDRESS 0x0000 /* @ECU_Address@VTQD_RrUdcMax_V@ */ /end MEASUREMENT
/begin MEASUREMENT VTQD_MaxWhlSlideRate_pct "" FLOAT32_IEEE SWC_FDC_type_CM_single_pct 0 0 -125.0 125.0 ECU_ADDRESS 0x0000 /* @ECU_Address@VTQD_MaxWhlSlideRate_pct@ */ /end MEASUREMENT
/begin MEASUREMENT VTQD_MinWhlSlideRate_pct "" FLOAT32_IEEE SWC_FDC_type_CM_single_pct 0 0 -125.0 125.0 ECU_ADDRESS 0x0000 /* @ECU_Address@VTQD_MinWhlSlideRate_pct@ */ /end MEASUREMENT
/begin MEASUREMENT VTQD_LeftSlideRate_pct "" FLOAT32_IEEE SWC_FDC_type_CM_single_pct 0 0 -125.0 125.0 ECU_ADDRESS 0x0000 /* @ECU_Address@VTQD_LeftSlideRate_pct@ */ /end MEASUREMENT
/begin MEASUREMENT VTQD_RightSlideRate_pct "" FLOAT32_IEEE SWC_FDC_type_CM_single_pct 0 0 -125.0 125.0 ECU_ADDRESS 0x0000 /* @ECU_Address@VTQD_RightSlideRate_pct@ */ /end MEASUREMENT
/begin MEASUREMENT VTQD_FrMotorPwr_W "" FLOAT32_IEEE SWC_FDC_type_CM_single_W 0 0 -200000.0 200000.0 ECU_ADDRESS 0x0000 /* @ECU_Address@VTQD_FrMotorPwr_W@ */ /end MEASUREMENT
/begin MEASUREMENT VTQD_RrMotorPwr_W "" FLOAT32_IEEE SWC_FDC_type_CM_single_W 0 0 -200000.0 200000.0 ECU_ADDRESS 0x0000 /* @ECU_Address@VTQD_RrMotorPwr_W@ */ /end MEASUREMENT
/begin MEASUREMENT VTQD_SysMotorPower_pct "" FLOAT32_IEEE SWC_FDC_type_CM_single_pct 0 0 -125.0 125.0 ECU_ADDRESS 0x0000 /* @ECU_Address@VTQD_SysMotorPower_pct@ */ /end MEASUREMENT
/begin MEASUREMENT VTQD_SysMotorTorque_pct "" FLOAT32_IEEE SWC_FDC_type_CM_single_pct 0 0 -125.0 125.0 ECU_ADDRESS 0x0000 /* @ECU_Address@VTQD_SysMotorTorque_pct@ */ /end MEASUREMENT
/begin MEASUREMENT VTQD_SysMotorPerform_pct "" FLOAT32_IEEE SWC_FDC_type_CM_single_pct 0 0 -125.0 125.0 ECU_ADDRESS 0x0000 /* @ECU_Address@VTQD_SysMotorPerform_pct@ */ /end MEASUREMENT
/begin MEASUREMENT VTQD_SimSouWaveCMD_pct "" FLOAT32_IEEE SWC_FDC_type_CM_single_pct 0 0 -125.0 125.0 ECU_ADDRESS 0x0000 /* @ECU_Address@VTQD_SimSouWaveCMD_pct@ */ /end MEASUREMENT
/begin MEASUREMENT VTQD_CalMeterSpeed_kph "" FLOAT32_IEEE SWC_FDC_type_CM_single_kph 0 0 0.0 300.0 ECU_ADDRESS 0x0000 /* @ECU_Address@VTQD_CalMeterSpeed_kph@ */ /end MEASUREMENT
/begin MEASUREMENT VTQD_SpdLim4SetSpd_raw32 "" FLOAT32_IEEE SWC_FDC_type_CM_single_raw32 0 0 0.0 254.0 ECU_ADDRESS 0x0000 /* @ECU_Address@VTQD_SpdLim4SetSpd_raw32@ */ /end MEASUREMENT
/begin MEASUREMENT VVMC_AccFSSlect_enum "" UWORD SWC_FDC_type_CM_uint16_enum 0 0 0.0 65535.0 ECU_ADDRESS 0x0000 /* @ECU_Address@VVMC_AccFSSlect_enum@ */ /end MEASUREMENT
/begin MEASUREMENT VVMC_AccFSCalSet_enum "" UWORD SWC_FDC_type_CM_uint16_enum 0 0 0.0 65535.0 ECU_ADDRESS 0x0000 /* @ECU_Address@VVMC_AccFSCalSet_enum@ */ /end MEASUREMENT
/begin MEASUREMENT VVMC_GyroFSSlect_enum "" UWORD SWC_FDC_type_CM_uint16_enum 0 0 0.0 65535.0 ECU_ADDRESS 0x0000 /* @ECU_Address@VVMC_GyroFSSlect_enum@ */ /end MEASUREMENT
/begin MEASUREMENT VVMC_GyroFSCalSet_enum "" UWORD SWC_FDC_type_CM_uint16_enum 0 0 0.0 65535.0 ECU_ADDRESS 0x0000 /* @ECU_Address@VVMC_GyroFSCalSet_enum@ */ /end MEASUREMENT
/begin MEASUREMENT VTPM_Flashchkdatavalid_enum "" UBYTE SWC_FDC_type_CM_uint8_enum 0 0 0.0 255.0 ECU_ADDRESS 0x0000 /* @ECU_Address@VTPM_Flashchkdatavalid_enum@ */ /end MEASUREMENT
/begin MEASUREMENT VTPM_Flashdatavalid_enum "" UBYTE SWC_FDC_type_CM_uint8_enum 0 0 0.0 255.0 ECU_ADDRESS 0x0000 /* @ECU_Address@VTPM_Flashdatavalid_enum@ */ /end MEASUREMENT
/begin MEASUREMENT VTPM_ModelVersion_raw "" UBYTE SWC_FDC_type_CM_uint8_raw 0 0 0.0 255.0 ECU_ADDRESS 0x0000 /* @ECU_Address@VTPM_ModelVersion_raw@ */ /end MEASUREMENT
/begin MEASUREMENT VTPM_ModelVersionChksum_raw "" UBYTE SWC_FDC_type_CM_uint8_raw 0 0 0.0 255.0 ECU_ADDRESS 0x0000 /* @ECU_Address@VTPM_ModelVersionChksum_raw@ */ /end MEASUREMENT
/begin MEASUREMENT VTHC_FDEWP1Cmd_enum "" UBYTE SWC_FDC_type_CM_uint8_enum 0 0 0.0 255.0 ECU_ADDRESS 0x0000 /* @ECU_Address@VTHC_FDEWP1Cmd_enum@ */ /end MEASUREMENT
/begin MEASUREMENT VTHC_FDEWP2Cmd_enum "" UBYTE SWC_FDC_type_CM_uint8_enum 0 0 0.0 255.0 ECU_ADDRESS 0x0000 /* @ECU_Address@VTHC_FDEWP2Cmd_enum@ */ /end MEASUREMENT
/begin MEASUREMENT VTHC_FDEWP3Cmd_enum "" UBYTE SWC_FDC_type_CM_uint8_enum 0 0 0.0 255.0 ECU_ADDRESS 0x0000 /* @ECU_Address@VTHC_FDEWP3Cmd_enum@ */ /end MEASUREMENT
/begin MEASUREMENT VVMC_CCCtrlSta_enum "" UBYTE SWC_FDC_type_CM_uint8_enum 0 0 0.0 7.0 ECU_ADDRESS 0x0000 /* @ECU_Address@VVMC_CCCtrlSta_enum@ */ /end MEASUREMENT
/begin MEASUREMENT VVMC_APSShiftPosnReq_enum "" UBYTE SWC_FDC_type_CM_uint8_enum 0 0 0.0 15.0 ECU_ADDRESS 0x0000 /* @ECU_Address@VVMC_APSShiftPosnReq_enum@ */ /end MEASUREMENT
/begin MEASUREMENT VTQR_EVDriveMode_enum "" UBYTE SWC_FDC_type_CM_uint8_enum 0 0 0.0 15.0 ECU_ADDRESS 0x0000 /* @ECU_Address@VTQR_EVDriveMode_enum@ */ /end MEASUREMENT
/begin MEASUREMENT VTQD_GearShiftCMD_enum "" UBYTE SWC_FDC_type_CM_uint8_enum 0 0 0.0 7.0 ECU_ADDRESS 0x0000 /* @ECU_Address@VTQD_GearShiftCMD_enum@ */ /end MEASUREMENT
/begin MEASUREMENT VTQD_RegenSWSta_enum "" UBYTE SWC_FDC_type_CM_uint8_enum 0 0 0.0 4.0 ECU_ADDRESS 0x0000 /* @ECU_Address@VTQD_RegenSWSta_enum@ */ /end MEASUREMENT
/begin MEASUREMENT VTQD_ActWhlSkipSta_enum "" UBYTE SWC_FDC_type_CM_uint8_enum 0 0 0.0 15.0 ECU_ADDRESS 0x0000 /* @ECU_Address@VTQD_ActWhlSkipSta_enum@ */ /end MEASUREMENT
/begin MEASUREMENT VTQD_SkipDirect_enum "" UBYTE SWC_FDC_type_CM_uint8_enum 0 0 0.0 15.0 ECU_ADDRESS 0x0000 /* @ECU_Address@VTQD_SkipDirect_enum@ */ /end MEASUREMENT
/begin MEASUREMENT VTQD_TqSource_enum "" UBYTE SWC_FDC_type_CM_uint8_enum 0 0 0.0 15.0 ECU_ADDRESS 0x0000 /* @ECU_Address@VTQD_TqSource_enum@ */ /end MEASUREMENT
/begin MEASUREMENT VTQD_TqSourceFr_enum "" UBYTE SWC_FDC_type_CM_uint8_enum 0 0 0.0 9.0 ECU_ADDRESS 0x0000 /* @ECU_Address@VTQD_TqSourceFr_enum@ */ /end MEASUREMENT
/begin MEASUREMENT VTQD_TqSourceRr_enum "" UBYTE SWC_FDC_type_CM_uint8_enum 0 0 0.0 9.0 ECU_ADDRESS 0x0000 /* @ECU_Address@VTQD_TqSourceRr_enum@ */ /end MEASUREMENT
/begin MEASUREMENT VTQD_PButtonSta_enum "" UBYTE SWC_FDC_type_CM_uint8_enum 0 0 0.0 2.0 ECU_ADDRESS 0x0000 /* @ECU_Address@VTQD_PButtonSta_enum@ */ /end MEASUREMENT
/begin MEASUREMENT VTQD_WhlSkipSta_enum "" UBYTE SWC_FDC_type_CM_uint8_enum 0 0 0.0 15.0 ECU_ADDRESS 0x0000 /* @ECU_Address@VTQD_WhlSkipSta_enum@ */ /end MEASUREMENT
/begin MEASUREMENT VTHC_FDSOV1Cmd_flg "" UBYTE SWC_FDC_type_CM_boolean_flg 0 0 0.0 1.0 ECU_ADDRESS 0x0000 /* @ECU_Address@VTHC_FDSOV1Cmd_flg@ */ /end MEASUREMENT
/begin MEASUREMENT VTHC_FDSOV2Cmd_flg "" UBYTE SWC_FDC_type_CM_boolean_flg 0 0 0.0 1.0 ECU_ADDRESS 0x0000 /* @ECU_Address@VTHC_FDSOV2Cmd_flg@ */ /end MEASUREMENT
/begin MEASUREMENT VTHC_FDSOV3Cmd_flg "" UBYTE SWC_FDC_type_CM_boolean_flg 0 0 0.0 1.0 ECU_ADDRESS 0x0000 /* @ECU_Address@VTHC_FDSOV3Cmd_flg@ */ /end MEASUREMENT
/begin MEASUREMENT VTHC_FDFWVCmd_flg "" UBYTE SWC_FDC_type_CM_boolean_flg 0 0 0.0 1.0 ECU_ADDRESS 0x0000 /* @ECU_Address@VTHC_FDFWVCmd_flg@ */ /end MEASUREMENT
/begin MEASUREMENT VVMC_ACCCtrlAllow_flg "" UBYTE SWC_FDC_type_CM_boolean_flg 0 0 0.0 1.0 ECU_ADDRESS 0x0000 /* @ECU_Address@VVMC_ACCCtrlAllow_flg@ */ /end MEASUREMENT
/begin MEASUREMENT VVMC_APSCtrlAvail_flg "" UBYTE SWC_FDC_type_CM_boolean_flg 0 0 0.0 1.0 ECU_ADDRESS 0x0000 /* @ECU_Address@VVMC_APSCtrlAvail_flg@ */ /end MEASUREMENT
/begin MEASUREMENT VVMC_APSActive_flg "" UBYTE SWC_FDC_type_CM_boolean_flg 0 0 0.0 1.0 ECU_ADDRESS 0x0000 /* @ECU_Address@VVMC_APSActive_flg@ */ /end MEASUREMENT
/begin MEASUREMENT VVMC_RrWhlStandstill_flg "" UBYTE SWC_FDC_type_CM_boolean_flg 0 0 0.0 1.0 ECU_ADDRESS 0x0000 /* @ECU_Address@VVMC_RrWhlStandstill_flg@ */ /end MEASUREMENT
/begin MEASUREMENT VVMC_OVRDAccCtrl_flg "" UBYTE SWC_FDC_type_CM_boolean_flg 0 0 0.0 1.0 ECU_ADDRESS 0x0000 /* @ECU_Address@VVMC_OVRDAccCtrl_flg@ */ /end MEASUREMENT
/begin MEASUREMENT VVMC_MCPreBaseTqEn_flg "" UBYTE SWC_FDC_type_CM_boolean_flg 0 0 0.0 1.0 ECU_ADDRESS 0x0000 /* @ECU_Address@VVMC_MCPreBaseTqEn_flg@ */ /end MEASUREMENT
/begin MEASUREMENT VVMC_ADASNegReq_flg "" UBYTE SWC_FDC_type_CM_boolean_flg 0 0 0.0 1.0 ECU_ADDRESS 0x0000 /* @ECU_Address@VVMC_ADASNegReq_flg@ */ /end MEASUREMENT
/begin MEASUREMENT VVMC_ADASActive_flg "" UBYTE SWC_FDC_type_CM_boolean_flg 0 0 0.0 1.0 ECU_ADDRESS 0x0000 /* @ECU_Address@VVMC_ADASActive_flg@ */ /end MEASUREMENT
/begin MEASUREMENT VVMC_ACCCtrlAvail_flg "" UBYTE SWC_FDC_type_CM_boolean_flg 0 0 0.0 1.0 ECU_ADDRESS 0x0000 /* @ECU_Address@VVMC_ACCCtrlAvail_flg@ */ /end MEASUREMENT
/begin MEASUREMENT VVMC_ACCPedalOvrd_flg "" UBYTE SWC_FDC_type_CM_boolean_flg 0 0 0.0 1.0 ECU_ADDRESS 0x0000 /* @ECU_Address@VVMC_ACCPedalOvrd_flg@ */ /end MEASUREMENT
/begin MEASUREMENT VVMC_HoldTqCtrlEn_flg "" UBYTE SWC_FDC_type_CM_boolean_flg 0 0 0.0 1.0 ECU_ADDRESS 0x0000 /* @ECU_Address@VVMC_HoldTqCtrlEn_flg@ */ /end MEASUREMENT
/begin MEASUREMENT VVMC_AccPedalOvrdDISC_flg "" UBYTE SWC_FDC_type_CM_boolean_flg 0 0 0.0 1.0 ECU_ADDRESS 0x0000 /* @ECU_Address@VVMC_AccPedalOvrdDISC_flg@ */ /end MEASUREMENT
/begin MEASUREMENT VVMC_CruzActive_flg "" UBYTE SWC_FDC_type_CM_boolean_flg 0 0 0.0 1.0 ECU_ADDRESS 0x0000 /* @ECU_Address@VVMC_CruzActive_flg@ */ /end MEASUREMENT
/begin MEASUREMENT VVMC_CCPedalOvrd_flg "" UBYTE SWC_FDC_type_CM_boolean_flg 0 0 0.0 1.0 ECU_ADDRESS 0x0000 /* @ECU_Address@VVMC_CCPedalOvrd_flg@ */ /end MEASUREMENT
/begin MEASUREMENT VVMC_APSEnCMD_flg "" UBYTE SWC_FDC_type_CM_boolean_flg 0 0 0.0 1.0 ECU_ADDRESS 0x0000 /* @ECU_Address@VVMC_APSEnCMD_flg@ */ /end MEASUREMENT
/begin MEASUREMENT VVMC_CAASActive_flg "" UBYTE SWC_FDC_type_CM_boolean_flg 0 0 0.0 1.0 ECU_ADDRESS 0x0000 /* @ECU_Address@VVMC_CAASActive_flg@ */ /end MEASUREMENT
/begin MEASUREMENT VVMC_AllowSetSpd_flg "" UBYTE SWC_FDC_type_CM_boolean_flg 0 0 0.0 1.0 ECU_ADDRESS 0x0000 /* @ECU_Address@VVMC_AllowSetSpd_flg@ */ /end MEASUREMENT
/begin MEASUREMENT VVMC_SetACCDisableAPS_flg "" UBYTE SWC_FDC_type_CM_boolean_flg 0 0 0.0 1.0 ECU_ADDRESS 0x0000 /* @ECU_Address@VVMC_SetACCDisableAPS_flg@ */ /end MEASUREMENT
/begin MEASUREMENT VVMC_CCSpdWar_flg "" UBYTE SWC_FDC_type_CM_boolean_flg 0 0 0.0 1.0 ECU_ADDRESS 0x0000 /* @ECU_Address@VVMC_CCSpdWar_flg@ */ /end MEASUREMENT
/begin MEASUREMENT VVMC_TimeGapJudge_flag "" UBYTE SWC_FDC_type_CM_boolean_flag 0 0 0.0 1.0 ECU_ADDRESS 0x0000 /* @ECU_Address@VVMC_TimeGapJudge_flag@ */ /end MEASUREMENT
/begin MEASUREMENT VTQR_FrRampEnable_flg "" UBYTE SWC_FDC_type_CM_boolean_flg 0 0 0.0 1.0 ECU_ADDRESS 0x0000 /* @ECU_Address@VTQR_FrRampEnable_flg@ */ /end MEASUREMENT
/begin MEASUREMENT VTQR_RrRampEnable_flg "" UBYTE SWC_FDC_type_CM_boolean_flg 0 0 0.0 1.0 ECU_ADDRESS 0x0000 /* @ECU_Address@VTQR_RrRampEnable_flg@ */ /end MEASUREMENT
/begin MEASUREMENT VTQR_LaunchEn_flg "" UBYTE SWC_FDC_type_CM_boolean_flg 0 0 0.0 1.0 ECU_ADDRESS 0x0000 /* @ECU_Address@VTQR_LaunchEn_flg@ */ /end MEASUREMENT
/begin MEASUREMENT VTQD_ForceP_flg "" UBYTE SWC_FDC_type_CM_boolean_flg 0 0 0.0 1.0 ECU_ADDRESS 0x0000 /* @ECU_Address@VTQD_ForceP_flg@ */ /end MEASUREMENT
/begin MEASUREMENT VTQD_ShifterFail2P_flg "" UBYTE SWC_FDC_type_CM_boolean_flg 0 0 0.0 1.0 ECU_ADDRESS 0x0000 /* @ECU_Address@VTQD_ShifterFail2P_flg@ */ /end MEASUREMENT
/begin MEASUREMENT VTQD_IVIRockModeEn_flg "" UBYTE SWC_FDC_type_CM_boolean_flg 0 0 0.0 1.0 ECU_ADDRESS 0x0000 /* @ECU_Address@VTQD_IVIRockModeEn_flg@ */ /end MEASUREMENT
/begin MEASUREMENT VTQD_PBWLockTO_flg "" UBYTE SWC_FDC_type_CM_boolean_flg 0 0 0.0 1.0 ECU_ADDRESS 0x0000 /* @ECU_Address@VTQD_PBWLockTO_flg@ */ /end MEASUREMENT
/begin MEASUREMENT VTQD_PBWUnlockTO_flg "" UBYTE SWC_FDC_type_CM_boolean_flg 0 0 0.0 1.0 ECU_ADDRESS 0x0000 /* @ECU_Address@VTQD_PBWUnlockTO_flg@ */ /end MEASUREMENT
/begin MEASUREMENT VTQD_OPDModeDis_flg "" UBYTE SWC_FDC_type_CM_boolean_flg 0 0 0.0 1.0 ECU_ADDRESS 0x0000 /* @ECU_Address@VTQD_OPDModeDis_flg@ */ /end MEASUREMENT
/begin MEASUREMENT VTQD_RegenModeChange_flg "" UBYTE SWC_FDC_type_CM_boolean_flg 0 0 0.0 1.0 ECU_ADDRESS 0x0000 /* @ECU_Address@VTQD_RegenModeChange_flg@ */ /end MEASUREMENT
/begin MEASUREMENT VTQD_LFWhlQuickSkip_flg "" UBYTE SWC_FDC_type_CM_boolean_flg 0 0 0.0 1.0 ECU_ADDRESS 0x0000 /* @ECU_Address@VTQD_LFWhlQuickSkip_flg@ */ /end MEASUREMENT
/begin MEASUREMENT VTQD_LRWhlQuickSkip_flg "" UBYTE SWC_FDC_type_CM_boolean_flg 0 0 0.0 1.0 ECU_ADDRESS 0x0000 /* @ECU_Address@VTQD_LRWhlQuickSkip_flg@ */ /end MEASUREMENT
/begin MEASUREMENT VTQD_RFWhlQuickSkip_flg "" UBYTE SWC_FDC_type_CM_boolean_flg 0 0 0.0 1.0 ECU_ADDRESS 0x0000 /* @ECU_Address@VTQD_RFWhlQuickSkip_flg@ */ /end MEASUREMENT
/begin MEASUREMENT VTQD_RRWhlQuickSkip_flg "" UBYTE SWC_FDC_type_CM_boolean_flg 0 0 0.0 1.0 ECU_ADDRESS 0x0000 /* @ECU_Address@VTQD_RRWhlQuickSkip_flg@ */ /end MEASUREMENT
/begin MEASUREMENT VTQD_AllWhlStable_flg "" UBYTE SWC_FDC_type_CM_boolean_flg 0 0 0.0 1.0 ECU_ADDRESS 0x0000 /* @ECU_Address@VTQD_AllWhlStable_flg@ */ /end MEASUREMENT
/begin MEASUREMENT VTQD_LeftRightWhlSkip_flg "" UBYTE SWC_FDC_type_CM_boolean_flg 0 0 0.0 1.0 ECU_ADDRESS 0x0000 /* @ECU_Address@VTQD_LeftRightWhlSkip_flg@ */ /end MEASUREMENT
/begin MEASUREMENT VTQD_LeftWhlSkip_flg "" UBYTE SWC_FDC_type_CM_boolean_flg 0 0 0.0 1.0 ECU_ADDRESS 0x0000 /* @ECU_Address@VTQD_LeftWhlSkip_flg@ */ /end MEASUREMENT
/begin MEASUREMENT VTQD_RightWhlSkip_flg "" UBYTE SWC_FDC_type_CM_boolean_flg 0 0 0.0 1.0 ECU_ADDRESS 0x0000 /* @ECU_Address@VTQD_RightWhlSkip_flg@ */ /end MEASUREMENT
/begin MEASUREMENT VTQD_FrontRearWhlSkip_flg "" UBYTE SWC_FDC_type_CM_boolean_flg 0 0 0.0 1.0 ECU_ADDRESS 0x0000 /* @ECU_Address@VTQD_FrontRearWhlSkip_flg@ */ /end MEASUREMENT
/begin MEASUREMENT VTQD_FrontWhlSkip_flg "" UBYTE SWC_FDC_type_CM_boolean_flg 0 0 0.0 1.0 ECU_ADDRESS 0x0000 /* @ECU_Address@VTQD_FrontWhlSkip_flg@ */ /end MEASUREMENT
/begin MEASUREMENT VTQD_RearWhlSkip_flg "" UBYTE SWC_FDC_type_CM_boolean_flg 0 0 0.0 1.0 ECU_ADDRESS 0x0000 /* @ECU_Address@VTQD_RearWhlSkip_flg@ */ /end MEASUREMENT
/begin MEASUREMENT VTQD_DiagonalWhlSkip_flg "" UBYTE SWC_FDC_type_CM_boolean_flg 0 0 0.0 1.0 ECU_ADDRESS 0x0000 /* @ECU_Address@VTQD_DiagonalWhlSkip_flg@ */ /end MEASUREMENT
/begin MEASUREMENT VTQD_LFRRWhlSkip_flg "" UBYTE SWC_FDC_type_CM_boolean_flg 0 0 0.0 1.0 ECU_ADDRESS 0x0000 /* @ECU_Address@VTQD_LFRRWhlSkip_flg@ */ /end MEASUREMENT
/begin MEASUREMENT VTQD_RFLRWhlSkip_flg "" UBYTE SWC_FDC_type_CM_boolean_flg 0 0 0.0 1.0 ECU_ADDRESS 0x0000 /* @ECU_Address@VTQD_RFLRWhlSkip_flg@ */ /end MEASUREMENT
/begin MEASUREMENT VTQD_NoSuitbleGear_flg "" UBYTE SWC_FDC_type_CM_boolean_flg 0 0 0.0 1.0 ECU_ADDRESS 0x0000 /* @ECU_Address@VTQD_NoSuitbleGear_flg@ */ /end MEASUREMENT
/begin MEASUREMENT VTQD_ARegenActive_flg "" UBYTE SWC_FDC_type_CM_boolean_flg 0 0 0.0 1.0 ECU_ADDRESS 0x0000 /* @ECU_Address@VTQD_ARegenActive_flg@ */ /end MEASUREMENT
/begin MEASUREMENT VTQD_FrWhlTqDemNeg_flg "" UBYTE SWC_FDC_type_CM_boolean_flg 0 0 0.0 1.0 ECU_ADDRESS 0x0000 /* @ECU_Address@VTQD_FrWhlTqDemNeg_flg@ */ /end MEASUREMENT
/begin MEASUREMENT VTQD_RrWhlTqDemNeg_flg "" UBYTE SWC_FDC_type_CM_boolean_flg 0 0 0.0 1.0 ECU_ADDRESS 0x0000 /* @ECU_Address@VTQD_RrWhlTqDemNeg_flg@ */ /end MEASUREMENT
/begin MEASUREMENT VTQD_RgnAbnorSta_flg "" UBYTE SWC_FDC_type_CM_boolean_flg 0 0 0.0 1.0 ECU_ADDRESS 0x0000 /* @ECU_Address@VTQD_RgnAbnorSta_flg@ */ /end MEASUREMENT
/begin MEASUREMENT VTQD_PTCSPermSta_flg "" UBYTE SWC_FDC_type_CM_boolean_flg 0 0 0.0 1.0 ECU_ADDRESS 0x0000 /* @ECU_Address@VTQD_PTCSPermSta_flg@ */ /end MEASUREMENT
/begin MEASUREMENT VTQD_ExternalTqAllow_flg "" UBYTE SWC_FDC_type_CM_boolean_flg 0 0 0.0 1.0 ECU_ADDRESS 0x0000 /* @ECU_Address@VTQD_ExternalTqAllow_flg@ */ /end MEASUREMENT
/begin MEASUREMENT VTQD_DiagHCrash_flg "" UBYTE SWC_FDC_type_CM_boolean_flg 0 0 0.0 1.0 ECU_ADDRESS 0x0000 /* @ECU_Address@VTQD_DiagHCrash_flg@ */ /end MEASUREMENT
/begin MEASUREMENT VTQD_ReBrakeLPReq_flg "" UBYTE SWC_FDC_type_CM_boolean_flg 0 0 0.0 1.0 ECU_ADDRESS 0x0000 /* @ECU_Address@VTQD_ReBrakeLPReq_flg@ */ /end MEASUREMENT
/begin MEASUREMENT VTQD_ExtShftAllow_flg "" UBYTE SWC_FDC_type_CM_boolean_flg 0 0 0.0 1.0 ECU_ADDRESS 0x0000 /* @ECU_Address@VTQD_ExtShftAllow_flg@ */ /end MEASUREMENT
/begin MEASUREMENT VTQD_ExtDoorAllow_flg "" UBYTE SWC_FDC_type_CM_boolean_flg 0 0 0.0 1.0 ECU_ADDRESS 0x0000 /* @ECU_Address@VTQD_ExtDoorAllow_flg@ */ /end MEASUREMENT
/begin MEASUREMENT VTQD_RgnTqComLim_flg "" UBYTE SWC_FDC_type_CM_boolean_flg 0 0 0.0 1.0 ECU_ADDRESS 0x0000 /* @ECU_Address@VTQD_RgnTqComLim_flg@ */ /end MEASUREMENT
/begin MEASUREMENT VTQD_RockModeTCSReq_flg "" UBYTE SWC_FDC_type_CM_boolean_flg 0 0 0.0 1.0 ECU_ADDRESS 0x0000 /* @ECU_Address@VTQD_RockModeTCSReq_flg@ */ /end MEASUREMENT
/begin MEASUREMENT VTQD_SWCACCSta_flg "" UBYTE SWC_FDC_type_CM_boolean_flg 0 0 0.0 1.0 ECU_ADDRESS 0x0000 /* @ECU_Address@VTQD_SWCACCSta_flg@ */ /end MEASUREMENT
/begin MEASUREMENT VTQD_SWCResUpSta_flg "" UBYTE SWC_FDC_type_CM_boolean_flg 0 0 0.0 1.0 ECU_ADDRESS 0x0000 /* @ECU_Address@VTQD_SWCResUpSta_flg@ */ /end MEASUREMENT
/begin MEASUREMENT VTQD_SWCSetdownSta_flg "" UBYTE SWC_FDC_type_CM_boolean_flg 0 0 0.0 1.0 ECU_ADDRESS 0x0000 /* @ECU_Address@VTQD_SWCSetdownSta_flg@ */ /end MEASUREMENT
/begin MEASUREMENT VTQD_SWCCancelSta_flg "" UBYTE SWC_FDC_type_CM_boolean_flg 0 0 0.0 1.0 ECU_ADDRESS 0x0000 /* @ECU_Address@VTQD_SWCCancelSta_flg@ */ /end MEASUREMENT
/begin MEASUREMENT VTQD_SWC2LScrollPressSta_flg "" UBYTE SWC_FDC_type_CM_boolean_flg 0 0 0.0 1.0 ECU_ADDRESS 0x0000 /* @ECU_Address@VTQD_SWC2LScrollPressSta_flg@ */ /end MEASUREMENT
/begin MEASUREMENT VTQD_SWC2LADASSta_flg "" UBYTE SWC_FDC_type_CM_boolean_flg 0 0 0.0 1.0 ECU_ADDRESS 0x0000 /* @ECU_Address@VTQD_SWC2LADASSta_flg@ */ /end MEASUREMENT
/begin MEASUREMENT VTQD_SWC2CancelSta_flg "" UBYTE SWC_FDC_type_CM_boolean_flg 0 0 0.0 1.0 ECU_ADDRESS 0x0000 /* @ECU_Address@VTQD_SWC2CancelSta_flg@ */ /end MEASUREMENT
/begin MEASUREMENT VTQD_SWC2ScrollUpSta_flg "" UBYTE SWC_FDC_type_CM_boolean_flg 0 0 0.0 1.0 ECU_ADDRESS 0x0000 /* @ECU_Address@VTQD_SWC2ScrollUpSta_flg@ */ /end MEASUREMENT
/begin MEASUREMENT VTQD_Set2MeterSpd_flg "" UBYTE SWC_FDC_type_CM_boolean_flg 0 0 0.0 1.0 ECU_ADDRESS 0x0000 /* @ECU_Address@VTQD_Set2MeterSpd_flg@ */ /end MEASUREMENT
/begin MEASUREMENT VTQD_SetRoadSpdLim_flg "" UBYTE SWC_FDC_type_CM_boolean_flg 0 0 0.0 1.0 ECU_ADDRESS 0x0000 /* @ECU_Address@VTQD_SetRoadSpdLim_flg@ */ /end MEASUREMENT
/begin MEASUREMENT VTQD_SWC2ScrollDownSta_flg "" UBYTE SWC_FDC_type_CM_boolean_flg 0 0 0.0 1.0 ECU_ADDRESS 0x0000 /* @ECU_Address@VTQD_SWC2ScrollDownSta_flg@ */ /end MEASUREMENT
/begin MEASUREMENT VTQD_SWC2SetdownSta_flg "" UBYTE SWC_FDC_type_CM_boolean_flg 0 0 0.0 1.0 ECU_ADDRESS 0x0000 /* @ECU_Address@VTQD_SWC2SetdownSta_flg@ */ /end MEASUREMENT
/begin MEASUREMENT VTQD_SWC2ResUpSta_flg "" UBYTE SWC_FDC_type_CM_boolean_flg 0 0 0.0 1.0 ECU_ADDRESS 0x0000 /* @ECU_Address@VTQD_SWC2ResUpSta_flg@ */ /end MEASUREMENT
/begin MEASUREMENT VVMC_GRADE_rad "" FLOAT32_IEEE SWC_FDC_type_CM_single_rad 0 0 -100.0 100.0 ECU_ADDRESS 0x0000 /* @ECU_Address@VVMC_GRADE_rad@ */ /end MEASUREMENT
/begin MEASUREMENT VVMC_EstSlopeLowSpdGxStable_flg "" UBYTE SWC_FDC_type_CM_boolean_flg 0 0 0.0 1.0 ECU_ADDRESS 0x0000 /* @ECU_Address@VVMC_EstSlopeLowSpdGxStable_flg@ */ /end MEASUREMENT
/begin COMPU_METHOD SWC_FDC_type_CM_single_C "Q = V" RAT_FUNC "%8.6" "C" COEFFS 0 1 0 0 0 1 /end COMPU_METHOD
/begin COMPU_METHOD SWC_FDC_type_CM_single_s "Q = V" RAT_FUNC "%8.6" "s" COEFFS 0 1 0 0 0 1 /end COMPU_METHOD
/begin COMPU_METHOD SWC_FDC_type_CM_single_rpm "Q = V" RAT_FUNC "%8.6" "rpm" COEFFS 0 1 0 0 0 1 /end COMPU_METHOD
/begin COMPU_METHOD SWC_FDC_type_CM_uint8_enum "Q = V" RAT_FUNC "%3.0" "enum" COEFFS 0 1 0 0 0 1 /end COMPU_METHOD
/begin COMPU_METHOD SWC_FDC_type_CM_single_kph "Q = V" RAT_FUNC "%8.6" "kph" COEFFS 0 1 0 0 0 1 /end COMPU_METHOD
/begin COMPU_METHOD SWC_FDC_type_CM_single_c "Q = V" RAT_FUNC "%8.6" "c" COEFFS 0 1 0 0 0 1 /end COMPU_METHOD
/begin COMPU_METHOD SWC_FDC_type_CM_single_mps2 "Q = V" RAT_FUNC "%8.6" "mps2" COEFFS 0 1 0 0 0 1 /end COMPU_METHOD
/begin COMPU_METHOD SWC_FDC_type_CM_single_pct "Q = V" RAT_FUNC "%8.6" "pct" COEFFS 0 1 0 0 0 1 /end COMPU_METHOD
/begin COMPU_METHOD SWC_FDC_type_CM_single_enum "Q = V" RAT_FUNC "%8.6" "enum" COEFFS 0 1 0 0 0 1 /end COMPU_METHOD
/begin COMPU_METHOD SWC_FDC_type_CM_single_A "Q = V" RAT_FUNC "%8.6" "A" COEFFS 0 1 0 0 0 1 /end COMPU_METHOD
/begin COMPU_METHOD SWC_FDC_type_CM_single_W "Q = V" RAT_FUNC "%8.6" "W" COEFFS 0 1 0 0 0 1 /end COMPU_METHOD
/begin COMPU_METHOD SWC_FDC_type_CM_single_Deg "Q = V" RAT_FUNC "%8.6" "Deg" COEFFS 0 1 0 0 0 1 /end COMPU_METHOD
/begin COMPU_METHOD SWC_FDC_type_CM_single_kg "Q = V" RAT_FUNC "%8.6" "kg" COEFFS 0 1 0 0 0 1 /end COMPU_METHOD
/begin COMPU_METHOD SWC_FDC_type_CM_single_rat "Q = V" RAT_FUNC "%8.6" "rat" COEFFS 0 1 0 0 0 1 /end COMPU_METHOD
/begin COMPU_METHOD SWC_FDC_type_CM_single_Nm "Q = V" RAT_FUNC "%8.6" "Nm" COEFFS 0 1 0 0 0 1 /end COMPU_METHOD
/begin COMPU_METHOD SWC_FDC_type_CM_single_gain "Q = V" RAT_FUNC "%8.6" "gain" COEFFS 0 1 0 0 0 1 /end COMPU_METHOD
/begin COMPU_METHOD SWC_FDC_type_CM_single_deg "Q = V" RAT_FUNC "%8.6" "deg" COEFFS 0 1 0 0 0 1 /end COMPU_METHOD
/begin COMPU_METHOD SWC_FDC_type_CM_single_gps "Q = V" RAT_FUNC "%8.6" "gps" COEFFS 0 1 0 0 0 1 /end COMPU_METHOD
/begin COMPU_METHOD SWC_FDC_type_CM_single_bar "Q = V" RAT_FUNC "%8.6" "bar" COEFFS 0 1 0 0 0 1 /end COMPU_METHOD
/begin COMPU_METHOD SWC_FDC_type_CM_uint32 "Q = V" RAT_FUNC "%10.0" "" COEFFS 0 1 0 0 0 1 /end COMPU_METHOD
/begin COMPU_METHOD SWC_FDC_type_CM_single_Dps "Q = V" RAT_FUNC "%8.6" "Dps" COEFFS 0 1 0 0 0 1 /end COMPU_METHOD
/begin COMPU_METHOD SWC_FDC_type_CM_single_K "Q = V" RAT_FUNC "%8.6" "K" COEFFS 0 1 0 0 0 1 /end COMPU_METHOD
/begin COMPU_METHOD SWC_FDC_type_CM_single_kW "Q = V" RAT_FUNC "%8.6" "kW" COEFFS 0 1 0 0 0 1 /end COMPU_METHOD
/begin COMPU_METHOD SWC_FDC_type_CM_single_V "Q = V" RAT_FUNC "%8.6" "V" COEFFS 0 1 0 0 0 1 /end COMPU_METHOD
/begin COMPU_METHOD SWC_FDC_type_CM_single_sec "Q = V" RAT_FUNC "%8.6" "sec" COEFFS 0 1 0 0 0 1 /end COMPU_METHOD
/begin COMPU_METHOD SWC_FDC_type_CM_single_m "Q = V" RAT_FUNC "%8.6" "m" COEFFS 0 1 0 0 0 1 /end COMPU_METHOD
/begin COMPU_METHOD SWC_FDC_type_CM_single_kPa "Q = V" RAT_FUNC "%8.6" "kPa" COEFFS 0 1 0 0 0 1 /end COMPU_METHOD
/begin COMPU_METHOD SWC_FDC_type_CM_single_factor "Q = V" RAT_FUNC "%8.6" "factor" COEFFS 0 1 0 0 0 1 /end COMPU_METHOD
/begin COMPU_METHOD SWC_FDC_type_CM_single_Nmps "Q = V" RAT_FUNC "%8.6" "Nmps" COEFFS 0 1 0 0 0 1 /end COMPU_METHOD
/begin COMPU_METHOD SWC_FDC_type_CM_single_raw32 "Q = V" RAT_FUNC "%8.6" "raw32" COEFFS 0 1 0 0 0 1 /end COMPU_METHOD
/begin COMPU_METHOD SWC_FDC_type_CM_uint16_cnt "Q = V" RAT_FUNC "%5.0" "cnt" COEFFS 0 1 0 0 0 1 /end COMPU_METHOD
/begin COMPU_METHOD SWC_FDC_type_CM_uint16_W "Q = V" RAT_FUNC "%5.0" "W" COEFFS 0 1 0 0 0 1 /end COMPU_METHOD
/begin COMPU_METHOD SWC_FDC_type_CM_uint16_K "Q = V" RAT_FUNC "%5.0" "K" COEFFS 0 1 0 0 0 1 /end COMPU_METHOD
/begin COMPU_METHOD SWC_FDC_type_CM_uint16_enum "Q = V" RAT_FUNC "%5.0" "enum" COEFFS 0 1 0 0 0 1 /end COMPU_METHOD
/begin COMPU_METHOD SWC_FDC_type_CM_boolean_flg "Q = V" RAT_FUNC "%1.0" "flg" COEFFS 0 1 0 0 0 1 /end COMPU_METHOD
/begin COMPU_METHOD SWC_FDC_type_CM_uint8_cnt "Q = V" RAT_FUNC "%3.0" "cnt" COEFFS 0 1 0 0 0 1 /end COMPU_METHOD
/begin COMPU_METHOD SWC_FDC_type_CM_uint8_K "Q = V" RAT_FUNC "%3.0" "K" COEFFS 0 1 0 0 0 1 /end COMPU_METHOD
/begin COMPU_METHOD SWC_FDC_type_CM_uint8_pct "Q = V" RAT_FUNC "%3.0" "pct" COEFFS 0 1 0 0 0 1 /end COMPU_METHOD
/begin COMPU_METHOD SWC_FDC_type_CM_uint8_kph "Q = V" RAT_FUNC "%3.0" "kph" COEFFS 0 1 0 0 0 1 /end COMPU_METHOD
/begin COMPU_METHOD SWC_FDC_type_CM_uint32_raw "Q = V" RAT_FUNC "%10.0" "raw" COEFFS 0 1 0 0 0 1 /end COMPU_METHOD
/begin COMPU_METHOD SWC_FDC_type_CM_single_G "Q = V" RAT_FUNC "%8.6" "G" COEFFS 0 1 0 0 0 1 /end COMPU_METHOD
/begin COMPU_METHOD SWC_FDC_type_CM_uint8_raw "Q = V" RAT_FUNC "%3.0" "raw" COEFFS 0 1 0 0 0 1 /end COMPU_METHOD
/begin COMPU_METHOD SWC_FDC_type_CM_boolean_flag "Q = V" RAT_FUNC "%1.0" "flag" COEFFS 0 1 0 0 0 1 /end COMPU_METHOD
/begin COMPU_METHOD SWC_FDC_type_CM_single_rad "Q = V" RAT_FUNC "%8.6" "rad" COEFFS 0 1 0 0 0 1 /end COMPU_METHOD
/begin GROUP S680_APTC "SWC_FDC_type/run_SWC_FDC_RxTx_5ms_sys/APP/THC/ThermalControl/THCM_Conctrl/APTC"
 /begin SUB_GROUP S913_APTCPWMControl S913_APTCPWMControl1 S913_APTCPWMControl2 S913_Subsystem /end SUB_GROUP
 /begin REF_CHARACTERISTIC KTHC_APTCPWMEN_flg KTHC_APTCQminC_W KTHC_APTCQoffT_cnt KTHC_APTCQonT_cnt KTHC_DAPTCQ1_W KTHC_DAPTCQ2_W KTHC_DAPTCQ3_W KTHC_DcChSetTemp_C KTHC_KiAPTCDcCh_K KTHC_KiAPTCDeice_K KTHC_KiAPTCTcabinC2_K KTHC_KiAPTCTcabinC_K KTHC_KiAPTCTcabinD1_K KTHC_KiAPTCTcabinD2_K KTHC_KiAPTCTcabinD3_K KTHC_KiAPTCTcabinH_K KTHC_KpAPTCDcCh_K KTHC_KpAPTCDeice_K KTHC_KpAPTCTcabinC2_K KTHC_KpAPTCTcabinC_K KTHC_KpAPTCTcabinD1_K KTHC_KpAPTCTcabinD2_K KTHC_KpAPTCTcabinD3_K KTHC_KpAPTCTcabinH_K KTHC_TventL1_C KTHC_TventL2_C KTHC_TventL3_C KTHC_TventL4_C KTHC_TventL5_C MTHC_APTCQA_Y_W MTHC_APTCQB_Y_W /end REF_CHARACTERISTIC
/end GROUP
/begin GROUP S680_BlowerCtrl "SWC_FDC_type/run_SWC_FDC_RxTx_5ms_sys/APP/THC/ThermalControl/THCM_Conctrl/BlowerCtrl" /begin SUB_GROUP S914_Enabled_Subsystem1 /end SUB_GROUP
 /begin REF_CHARACTERISTIC KTHC_KiBlowerDeice_K KTHC_KiBlowerTcabinC_K KTHC_KiBlowerTcabinD_K KTHC_KiBlowerTcabinH_K KTHC_KpBlowerDeice_K KTHC_KpBlowerTcabinC_K KTHC_KpBlowerTcabinD_K KTHC_KpBlowerTcabinH_K KTHC_VBRearClosed_K KTHC_VBlowerDcCh_K KTHC_VBlowerMin_K KTHC_VBstep_K KTHC_VGainStep_K /end REF_CHARACTERISTIC
/end GROUP
/begin GROUP S680_CompCtrl "SWC_FDC_type/run_SWC_FDC_RxTx_5ms_sys/APP/THC/ThermalControl/THCM_Conctrl/CompCtrl" /begin SUB_GROUP S918_Enabled_Subsystem S918_Enabled_Subsystem1 /end SUB_GROUP
 /begin REF_CHARACTERISTIC KTHC_KiCompPhigh_K KTHC_KiCompPlow1_K KTHC_KiCompPlow2_K KTHC_KiCompTcabinC1_K KTHC_KiCompTcabinC_K KTHC_KiCompTcabinD_K KTHC_KiCompTcabinH_K KTHC_KiCompTwinC_K KTHC_KiCompTwinD_K KTHC_KpCompPhigh_K KTHC_KpCompPlow1_K KTHC_KpCompPlow2_K KTHC_KpCompTcabinC1_K KTHC_KpCompTcabinC_K KTHC_KpCompTcabinD_K KTHC_KpCompTcabinH_K KTHC_KpCompTwinC_K KTHC_KpCompTwinD_K KTHC_KrpmCompPhigh_K KTHC_KrpmCompPlow1_K KTHC_KrpmCompPlow2_K KTHC_KrpmCompTcabinC1_K KTHC_KrpmCompTcabinC_K KTHC_KrpmCompTcabinD_K KTHC_KrpmCompTcabinH_K KTHC_KrpmCompTwinC_K KTHC_KrpmCompTwinD_K KTHC_PhighSetpoint_kPa KTHC_Plow1Setpoint_kPa /end REF_CHARACTERISTIC
/end GROUP
/begin GROUP S680_EWP1 "SWC_FDC_type/run_SWC_FDC_RxTx_5ms_sys/APP/THC/ThermalControl/THCM_Conctrl/EWP1"
 /begin REF_CHARACTERISTIC KTHC_EWP3SpdDeice_K KTHC_EWPDcCharge_K KTHC_EWPLv1_K KTHC_EWPLv2_K KTHC_EWPLv3_K KTHC_EWPLv4_K KTHC_EWPLv5_K /end REF_CHARACTERISTIC
/end GROUP
/begin GROUP S680_EWP2 "SWC_FDC_type/run_SWC_FDC_RxTx_5ms_sys/APP/THC/ThermalControl/THCM_Conctrl/EWP2"
 /begin REF_CHARACTERISTIC KTHC_EWP3SpdDeice_K KTHC_EWPDcCharge_K KTHC_EWPLv1_K KTHC_EWPLv2_K KTHC_EWPLv3_K KTHC_EWPLv4_K KTHC_EWPLv5_K /end REF_CHARACTERISTIC
/end GROUP
/begin GROUP S680_EWP3 "SWC_FDC_type/run_SWC_FDC_RxTx_5ms_sys/APP/THC/ThermalControl/THCM_Conctrl/EWP3"
 /begin REF_CHARACTERISTIC KTHC_EWP3SpdDeice_K KTHC_EWPDcCharge_K KTHC_EWPLv1_K KTHC_EWPLv2_K KTHC_EWPLv3_K KTHC_EWPLv4_K KTHC_EWPLv5_K /end REF_CHARACTERISTIC
/end GROUP
/begin GROUP S680_EXV1Ctrl "SWC_FDC_type/run_SWC_FDC_RxTx_5ms_sys/APP/THC/ThermalControl/THCM_Conctrl/EXV1Ctrl"
 /begin REF_CHARACTERISTIC KTHC_EXVBlancePulse_K KTHC_KiEXV1SHDeice_K KTHC_KiEXV1SH_K KTHC_KpEXV1SHDeice_K KTHC_KpEXV1SH_K KTHC_RefrigerantType_enum /end REF_CHARACTERISTIC
/end GROUP
/begin GROUP S680_EXV2Ctrl "SWC_FDC_type/run_SWC_FDC_RxTx_5ms_sys/APP/THC/ThermalControl/THCM_Conctrl/EXV2Ctrl"
 /begin REF_CHARACTERISTIC KTHC_EXVBlancePulse_K KTHC_KiEXV2SHD_K KTHC_KiEXV2SH_K KTHC_KpEXV2SHD_K KTHC_KpEXV2SH_K KTHC_RefrigerantType_enum /end REF_CHARACTERISTIC
/end GROUP
/begin GROUP S680_RadiatorFan "SWC_FDC_type/run_SWC_FDC_RxTx_5ms_sys/APP/THC/ThermalControl/THCM_Conctrl/RadiatorFan"
 /begin REF_CHARACTERISTIC KTHC_FANDefLv_pct KTHC_FANLv1_pct KTHC_FANLv2_pct KTHC_FANLv3_pct KTHC_FANLv4_pct KTHC_FANLv5_pct /end REF_CHARACTERISTIC
/end GROUP
/begin GROUP S680_SensorErrorHandle4 "SWC_FDC_type/run_SWC_FDC_RxTx_5ms_sys/APP/THC/ThermalControl/THCM_Conctrl/SensorErrorHandle4" /begin REF_CHARACTERISTIC KTHC_TevaErrHandleEN_flg /end REF_CHARACTERISTIC /end GROUP
/begin GROUP S680_SensorErrorHandle5 "SWC_FDC_type/run_SWC_FDC_RxTx_5ms_sys/APP/THC/ThermalControl/THCM_Conctrl/SensorErrorHandle5" /begin REF_CHARACTERISTIC KTHC_TevaErrHandleEN_flg /end REF_CHARACTERISTIC /end GROUP
/begin GROUP S680_SensorErrorHandle6 "SWC_FDC_type/run_SWC_FDC_RxTx_5ms_sys/APP/THC/ThermalControl/THCM_Conctrl/SensorErrorHandle6" /begin REF_CHARACTERISTIC KTHC_TevaErrHandleEN_flg /end REF_CHARACTERISTIC /end GROUP
/begin GROUP S680_SensorErrorHandle7 "SWC_FDC_type/run_SWC_FDC_RxTx_5ms_sys/APP/THC/ThermalControl/THCM_Conctrl/SensorErrorHandle7" /begin REF_CHARACTERISTIC KTHC_TevaErrHandleEN_flg /end REF_CHARACTERISTIC /end GROUP
/begin GROUP S680_SensorErrorHandle8 "SWC_FDC_type/run_SWC_FDC_RxTx_5ms_sys/APP/THC/ThermalControl/THCM_Conctrl/SensorErrorHandle8" /begin REF_CHARACTERISTIC KTHC_TevaErrHandleEN_flg /end REF_CHARACTERISTIC /end GROUP
/begin GROUP S680_SensorErrorHandle9 "SWC_FDC_type/run_SWC_FDC_RxTx_5ms_sys/APP/THC/ThermalControl/THCM_Conctrl/SensorErrorHandle9" /begin REF_CHARACTERISTIC KTHC_TevaErrHandleEN_flg /end REF_CHARACTERISTIC /end GROUP
/begin GROUP S680_Subsystem "SWC_FDC_type/run_SWC_FDC_RxTx_5ms_sys/APP/THC/ThermalControl/THCM_Conctrl/Subsystem"
 /begin REF_CHARACTERISTIC KTHC_PBlaceTime1_K KTHC_PBlaceTime2_K KTHC_PBlaceTime3_K KTHC_PBlaceTime4_K /end REF_CHARACTERISTIC
 /begin REF_MEASUREMENT VTHC_FDSOV1Cmd_flg VTHC_FDSOV2Cmd_flg VTHC_FDSOV3Cmd_flg /end REF_MEASUREMENT
/end GROUP
/begin GROUP S680_Subsystem1 "SWC_FDC_type/run_SWC_FDC_RxTx_5ms_sys/APP/THC/ThermalControl/THCM_Conctrl/Subsystem1"
 /begin SUB_GROUP S960_SensorErrorHandle1 S960_SensorErrorHandle2 S960_SensorErrorHandle3 S960_SensorErrorHandle4 S960_SensorErrorHandle5 S960_SensorErrorHandle9 /end SUB_GROUP
 /begin REF_CHARACTERISTIC KTHC_TdiffC_C KTHC_TdiffD_C KTHC_TdiffH_C /end REF_CHARACTERISTIC
/end GROUP
/begin GROUP S680_Subsystem2 "SWC_FDC_type/run_SWC_FDC_RxTx_5ms_sys/APP/THC/ThermalControl/THCM_Conctrl/Subsystem2" /begin SUB_GROUP S961_SensorErrorHandle9 /end SUB_GROUP /begin REF_CHARACTERISTIC KTHC_MotorInTempDefH_C KTHC_MotorInTempDefL_C /end REF_CHARACTERISTIC /end GROUP
/begin GROUP S680_Subsystem3 "SWC_FDC_type/run_SWC_FDC_RxTx_5ms_sys/APP/THC/ThermalControl/THCM_Conctrl/Subsystem3" /begin SUB_GROUP S962_Subsystem1 S962_Subsystem2 S962_Subsystem3 /end SUB_GROUP /begin REF_CHARACTERISTIC KTHC_EWPStopT_cnt KTHC_ValueSWT_cnt /end REF_CHARACTERISTIC
 /begin REF_MEASUREMENT VTHC_FDEWP1Cmd_enum VTHC_FDEWP2Cmd_enum VTHC_FDEWP3Cmd_enum VTHC_FDFWVCmd_flg VTHC_FDTWVCmd_pct /end REF_MEASUREMENT
/end GROUP
/begin GROUP S1073_Subsystem "SWC_FDC_type/run_SWC_FDC_RxTx_5ms_sys/APP/TPM/TPMS/ModelVersion/Subsystem" /begin REF_MEASUREMENT VTPM_ModelVersionChksum_raw VTPM_ModelVersion_raw /end REF_MEASUREMENT /end GROUP
/begin GROUP S1074_GetFlashWheelTemp "SWC_FDC_type/run_SWC_FDC_RxTx_5ms_sys/APP/TPM/TPMS/TPMS/GetFlashWheelTemp" /begin REF_CHARACTERISTIC KTPM_TPMSModelVersionInit_raw /end REF_CHARACTERISTIC /end GROUP
/begin GROUP S1074_Learn "SWC_FDC_type/run_SWC_FDC_RxTx_5ms_sys/APP/TPM/TPMS/TPMS/Learn" /begin SUB_GROUP S1085_AutoLocation S1085_LowerTirePressureCalibration /end SUB_GROUP /end GROUP
/begin GROUP S1074_Send "SWC_FDC_type/run_SWC_FDC_RxTx_5ms_sys/APP/TPM/TPMS/TPMS/Send" /begin SUB_GROUP S1086_Alarm S1086_DATA S1086_ResetAllow_CalibrateAllow /end SUB_GROUP /end GROUP
/begin GROUP S1074_Subsystem "SWC_FDC_type/run_SWC_FDC_RxTx_5ms_sys/APP/TPM/TPMS/TPMS/Subsystem"
 /begin REF_MEASUREMENT VTPM_Flashchkdatavalid_enum VTPM_Flashdatavalid_enum VTPM_WriteChkLFID_raw VTPM_WriteChkLRID_raw VTPM_WriteChkRFID_raw VTPM_WriteChkRRID_raw VTPM_WriteChkfinLFID_raw VTPM_WriteChkfinLRID_raw VTPM_WriteChkfinRFID_raw VTPM_WriteChkfinRRID_raw /end REF_MEASUREMENT
/end GROUP
/begin GROUP S1307_SR_Latch "SWC_FDC_type/run_SWC_FDC_RxTx_5ms_sys/APP/TQD/TorqueDemand/CrashDetect/SR_Latch" /begin REF_MEASUREMENT VTQD_DiagHCrash_flg /end REF_MEASUREMENT /end GROUP
/begin GROUP S1308_GearShiftPosn "SWC_FDC_type/run_SWC_FDC_RxTx_5ms_sys/APP/TQD/TorqueDemand/ShiftModule/GearShiftPosn" /begin SUB_GROUP S1316_Drive_Protection /end SUB_GROUP
 /begin REF_CHARACTERISTIC KTQD_DriveProtVehSpdGain_kph KTQD_ForcePLimitSpd_kph KTQD_OPDHoldAllowGearPSW_flg KTQD_ShifterFail2P_s /end REF_CHARACTERISTIC
 /begin REF_MEASUREMENT VTQD_ForceP_flg VTQD_GearShiftCMD_enum VTQD_ShifterFail2P_flg /end REF_MEASUREMENT
/end GROUP
/begin GROUP S1308_P_Button_State_Judge "SWC_FDC_type/run_SWC_FDC_RxTx_5ms_sys/APP/TQD/TorqueDemand/ShiftModule/P_Button_State_Judge" /begin REF_MEASUREMENT VTQD_PButtonSta_enum /end REF_MEASUREMENT /end GROUP
/begin GROUP S1308_SR_Latch "SWC_FDC_type/run_SWC_FDC_RxTx_5ms_sys/APP/TQD/TorqueDemand/ShiftModule/SR_Latch" /begin REF_MEASUREMENT VTQD_PBWLockTO_flg /end REF_MEASUREMENT /end GROUP
/begin GROUP S1308_SR_Latch1 "SWC_FDC_type/run_SWC_FDC_RxTx_5ms_sys/APP/TQD/TorqueDemand/ShiftModule/SR_Latch1" /begin REF_MEASUREMENT VTQD_PBWUnlockTO_flg /end REF_MEASUREMENT /end GROUP
/begin GROUP S1309_Hold "SWC_FDC_type/run_SWC_FDC_RxTx_5ms_sys/APP/TQD/TorqueDemand/Signal_convert/Hold" /begin REF_MEASUREMENT VTQD_RockModeTCSReq_flg /end REF_MEASUREMENT /end GROUP
/begin GROUP S1309_New_Wheel_Slide_Rate "SWC_FDC_type/run_SWC_FDC_RxTx_5ms_sys/APP/TQD/TorqueDemand/Signal_convert/New Wheel Slide Rate" /begin REF_CHARACTERISTIC KTQD_NewSlideRateTs_c /end REF_CHARACTERISTIC
 /begin REF_MEASUREMENT VTQD_FrontSlideRate_pct VTQD_LFSlideRate_pct VTQD_LRSlideRate_pct VTQD_LeftSlideRate_pct VTQD_MaxWhlSlideRate_pct VTQD_MinWhlSlideRate_pct VTQD_RFSlideRate_pct VTQD_RRSlideRate_pct VTQD_RearSlideRate_pct VTQD_RightSlideRate_pct VTQD_VehSpeed4Cal_kph /end REF_MEASUREMENT
/end GROUP
/begin GROUP S1309_OUTPUT_ONLY_ON_or_READY "SWC_FDC_type/run_SWC_FDC_RxTx_5ms_sys/APP/TQD/TorqueDemand/Signal_convert/OUTPUT ONLY ON or READY" /begin REF_CHARACTERISTIC KTQD_RegenButEnSpd_kph /end REF_CHARACTERISTIC /end GROUP
/begin GROUP S1309_Regen_Level_Switch_Botton "SWC_FDC_type/run_SWC_FDC_RxTx_5ms_sys/APP/TQD/TorqueDemand/Signal_convert/Regen Level Switch Botton" /begin SUB_GROUP S1370_RegenDOWN S1370_RegenUP /end SUB_GROUP /begin REF_MEASUREMENT VTQD_RegenSWSta_enum /end REF_MEASUREMENT /end GROUP
/begin GROUP S1309_SR_Latch "SWC_FDC_type/run_SWC_FDC_RxTx_5ms_sys/APP/TQD/TorqueDemand/Signal_convert/SR_Latch" /begin REF_MEASUREMENT VTQD_RegenModeChange_flg /end REF_MEASUREMENT /end GROUP
/begin GROUP S1309_SR_Latch4 "SWC_FDC_type/run_SWC_FDC_RxTx_5ms_sys/APP/TQD/TorqueDemand/Signal_convert/SR_Latch4" /begin REF_MEASUREMENT VTQD_OPDModeDis_flg /end REF_MEASUREMENT /end GROUP
/begin GROUP S1309_SR_Latch5 "SWC_FDC_type/run_SWC_FDC_RxTx_5ms_sys/APP/TQD/TorqueDemand/Signal_convert/SR_Latch5" /begin REF_MEASUREMENT VTQD_IVIRockModeEn_flg /end REF_MEASUREMENT /end GROUP
/begin GROUP S1309_SR_Latch8 "SWC_FDC_type/run_SWC_FDC_RxTx_5ms_sys/APP/TQD/TorqueDemand/Signal_convert/SR_Latch8" /begin REF_MEASUREMENT VTQD_RgnTqComLim_flg /end REF_MEASUREMENT /end GROUP
/begin GROUP S1309_SWC2_Subsystem "SWC_FDC_type/run_SWC_FDC_RxTx_5ms_sys/APP/TQD/TorqueDemand/Signal_convert/SWC2_Subsystem"
 /begin SUB_GROUP S1380_Big_Mike_Combo S1380_L_ScrollPress_Behavior S1380_Road_Speed_Limit_Convert S1380_Speed_Setting_Mode /end SUB_GROUP
 /begin REF_CHARACTERISTIC KTQD_OvrSpdSetDownOffSet_kph KTQD_SpdCtrlMode_enum_ovrdflg KTQD_SpdCtrlMode_enum_ovrdval /end REF_CHARACTERISTIC
 /begin REF_MEASUREMENT VTQD_SWC2CancelSta_flg VTQD_SWC2LADASSta_flg VTQD_SWC2LScrollPressSta_flg VTQD_SWC2ResUpSta_flg VTQD_SWC2ScrollDownSta_flg VTQD_SWC2ScrollUpSta_flg VTQD_SWC2SetdownSta_flg VTQD_Set2MeterSpd_flg VTQD_SetRoadSpdLim_flg VTQD_SpdLim4SetSpd_raw32 /end REF_MEASUREMENT
/end GROUP
/begin GROUP S1309_SWC_Subsystem "SWC_FDC_type/run_SWC_FDC_RxTx_5ms_sys/APP/TQD/TorqueDemand/Signal_convert/SWC_Subsystem"
 /begin SUB_GROUP S1381_SpdCtrlBotton_Behavior S1381_Speed_Setting_Mode S1381_Vehicle_to_Meter_Speed /end SUB_GROUP
 /begin REF_CHARACTERISTIC KTQD_SpdCtrlMode_enum_ovrdflg KTQD_SpdCtrlMode_enum_ovrdval KTQD_Veh2MetSpdHiBand_kph KTQD_Veh2MetSpdLowBand_kph /end REF_CHARACTERISTIC
 /begin REF_MEASUREMENT VTQD_CalMeterSpeed_kph VTQD_SWCACCSta_flg VTQD_SWCCancelSta_flg VTQD_SWCResUpSta_flg VTQD_SWCSetdownSta_flg /end REF_MEASUREMENT
/end GROUP
/begin GROUP S1309_Simulation_Sound_Wave_ "SWC_FDC_type/run_SWC_FDC_RxTx_5ms_sys/APP/TQD/TorqueDemand/Signal_convert/Simulation Sound Wave " /begin SUB_GROUP S1382_RateLimit /end SUB_GROUP
 /begin REF_CHARACTERISTIC KTQD_FrMotorRefPower_kW KTQD_FrUppTheldTrq_Nm KTQD_RrMotorRefPower_kW KTQD_RrUppTheldTrq_Nm KTQD_SimSoundWaveDec_pct KTQD_SimSoundWaveInc_pct KTQD_SimSoundWaveSet_enum /end REF_CHARACTERISTIC
 /begin REF_MEASUREMENT VTQD_FrMotorPwr_W VTQD_RrMotorPwr_W VTQD_SimSouWaveCMD_pct VTQD_SysMotorPerform_pct VTQD_SysMotorPower_pct VTQD_SysMotorTorque_pct /end REF_MEASUREMENT
/end GROUP
/begin GROUP S1309_Subsystem "SWC_FDC_type/run_SWC_FDC_RxTx_5ms_sys/APP/TQD/TorqueDemand/Signal_convert/Subsystem" /begin REF_CHARACTERISTIC KTQD_ShifterInvalidSW_flg KTQD_VirtualShifterCMD_enum /end REF_CHARACTERISTIC /end GROUP
/begin GROUP S1309_VehWeightEst "SWC_FDC_type/run_SWC_FDC_RxTx_5ms_sys/APP/TQD/TorqueDemand/Signal_convert/VehWeightEst" /begin SUB_GROUP S1384_Calaulation S1384_Condition S1384_Desicion /end SUB_GROUP /end GROUP
/begin GROUP S1309_Wheel_Status_Judgment "SWC_FDC_type/run_SWC_FDC_RxTx_5ms_sys/APP/TQD/TorqueDemand/Signal_convert/Wheel Status Judgment"
 /begin SUB_GROUP S1385_SR_Latch S1385_SR_Latch1 S1385_SR_Latch10 S1385_SR_Latch11 S1385_SR_Latch12 S1385_SR_Latch13 S1385_SR_Latch14 S1385_SR_Latch15 S1385_SR_Latch16 S1385_SR_Latch17 S1385_SR_Latch18 S1385_SR_Latch19 S1385_SR_Latch2 S1385_SR_Latch20 S1385_SR_Latch21 S1385_SR_Latch22 S1385_SR_Latch23 S1385_SR_Latch24 S1385_SR_Latch25 S1385_SR_Latch3 S1385_SR_Latch4 S1385_SR_Latch5 S1385_SR_Latch6 /end SUB_GROUP
 /begin REF_CHARACTERISTIC KTQD_ActWhlSkipSta_enum_ovrdflg KTQD_ActWhlSkipSta_enum_ovrdval KTQD_EscModeTqLimSpdDev_kph KTQD_EscModeWhlSpdDely_cnt KTQD_FreeWhlDetStableSpd_kph KTQD_WhlEnDetStableSpd_kph KTQD_WhlSpeedStableDev_kph KTQD_WhlStableDetTime_s /end REF_CHARACTERISTIC
 /begin REF_MEASUREMENT VTQD_ActWhlSkipSta_enum VTQD_AllWhlStable_flg VTQD_DiagonalWhlSkip_flg VTQD_FrontRearWhlSkip_flg VTQD_FrontWhlSkip_flg VTQD_LFRRWhlSkip_flg VTQD_LFWhlQuickSkip_flg VTQD_LRWhlQuickSkip_flg VTQD_LeftRightWhlSkip_flg VTQD_LeftWhlSkip_flg VTQD_RFLRWhlSkip_flg VTQD_RFWhlQuickSkip_flg VTQD_RRWhlQuickSkip_flg VTQD_RearWhlSkip_flg VTQD_RightWhlSkip_flg VTQD_SkipDirect_enum VTQD_WhlSkipSta_enum /end REF_MEASUREMENT
/end GROUP
/begin GROUP S1310_AvaliableTqLimit "SWC_FDC_type/run_SWC_FDC_RxTx_5ms_sys/APP/TQD/TorqueDemand/TorqueModule/AvaliableTqLimit"
 /begin SUB_GROUP S1849_If_Action_Subsystem1 S1849_If_Action_Subsystem2 S1849_RateLimit S1849_RateLimit1 S1849_TorqueCapacityCalcalation /end SUB_GROUP
 /begin REF_CHARACTERISTIC KTQD_AvailBRgnTqVSOC_pct KTQD_AvailBrkRgnTqSpd_kph KTQD_BRgnPermDisDelay_s KTQD_FAfterTqCMDGainDec_c KTQD_FAfterTqCMDGainInc_c KTQD_FrBatapCont_factor KTQD_RAfterTqCMDGainDec_c KTQD_RAfterTqCMDGainInc_c KTQD_RrBatapCont_factor MTQD_AfterTqMinGain_Y_c MTQD_FAfterTqCMDGain_Z_c MTQD_RAfterTqCMDGain_Z_c /end REF_CHARACTERISTIC
 /begin REF_MEASUREMENT VTQD_ARegenActive_flg VTQD_AfterAvailableTqDemFr_Nm VTQD_AfterAvailableTqDemRr_Nm VTQD_AfterTqMinGain_c VTQD_FrAvailableTqUpLimt_Nm VTQD_FrEDUAvailBrkRgnTq_Nm VTQD_RrAvailableTqUpLimt_Nm VTQD_RrEDUAvailBrkRgnTq_Nm /end REF_MEASUREMENT
/end GROUP
/begin GROUP S1310_DriverWhlTqDem "SWC_FDC_type/run_SWC_FDC_RxTx_5ms_sys/APP/TQD/TorqueDemand/TorqueModule/DriverWhlTqDem"
 /begin SUB_GROUP S1850_BOS S1850_Creep S1850_DriverTqCoordination S1850_PedalMapWhlTq S1850_RollingRegenJudge /end SUB_GROUP
/end GROUP
/begin GROUP S1310_ExtTqFuncHandShaking "SWC_FDC_type/run_SWC_FDC_RxTx_5ms_sys/APP/TQD/TorqueDemand/TorqueModule/ExtTqFuncHandShaking"
 /begin REF_CHARACTERISTIC KTQD_ExtDoorAllow_flg_ovrdflg KTQD_ExtDoorAllow_flg_ovrdval KTQD_ExtShftAllow_flg_ovrdflg KTQD_ExtShftAllow_flg_ovrdval KTQD_ExtTqAllow_flg_ovrdflg KTQD_ExtTqAllow_flg_ovrdval KTQD_PassAPSActive_flg_ovrdflg KTQD_PassAPSActive_flg_ovrdval /end REF_CHARACTERISTIC
 /begin REF_MEASUREMENT VTQD_ExtDoorAllow_flg VTQD_ExtShftAllow_flg VTQD_ExternalTqAllow_flg /end REF_MEASUREMENT
/end GROUP
/begin GROUP S1310_OPD_Hold "SWC_FDC_type/run_SWC_FDC_RxTx_5ms_sys/APP/TQD/TorqueDemand/TorqueModule/OPD Hold"
 /begin SUB_GROUP S1852_Deceleration_Calculation S1852_OPDHold_Request_ S1852_Parking_Requeest_Backup S1852_Release_Condition S1852_System_Status /end SUB_GROUP
/end GROUP
/begin GROUP S1310_Signal_for_ESC "SWC_FDC_type/run_SWC_FDC_RxTx_5ms_sys/APP/TQD/TorqueDemand/TorqueModule/Signal for ESC"
 /begin REF_CHARACTERISTIC KTQD_AvailBRgnTqVSOC_pct KTQD_BRegenCalEnTq_Nm KTQD_DecideEDUActTqSW_flg KTQD_FrAvailBRgnTqV_flg_ovrdflg KTQD_FrAvailBRgnTqV_flg_ovrdval KTQD_FrBRgnCalLowLim_Nm KTQD_FrBRgnCalUpLim_Nm KTQD_FrEDURollRgnLowTq_Nm KTQD_FrEDURollRgnUpTq_Nm KTQD_PTCSPermSta_flg KTQD_RrAvailBRgnTqV_flg_ovrdflg KTQD_RrAvailBRgnTqV_flg_ovrdval KTQD_RrBRgnCalLowLim_Nm KTQD_RrBRgnCalUpLim_Nm KTQD_RrEDURollRgnLowTq_Nm KTQD_RrEDURollRgnUpTq_Nm KTQD_TMTqDeviationLow_c KTQD_TMTqDeviationUp_c KVMC_ACCReqCMdBond_mps2 /end REF_CHARACTERISTIC
 /begin REF_MEASUREMENT VTQD_ActFrTMTqDeviation_c VTQD_ActRrTMTqDeviation_c VTQD_FrARegenCal_Nm VTQD_FrARgnTqDeviation_c VTQD_FrBRegenCal_Nm VTQD_FrEDUActTq_Nm VTQD_FrEDURolRgnTq_Nm VTQD_FrTMTqDeviation_c VTQD_FrWhlTqDemNeg_flg VTQD_PTCSPermSta_flg VTQD_RgnAbnorSta_flg VTQD_RrARegenCal_Nm VTQD_RrARgnTqDeviation_c VTQD_RrBRegenCal_Nm VTQD_RrEDUActTq_Nm VTQD_RrEDURolRgnTq_Nm VTQD_RrTMTqDeviation_c VTQD_RrWhlTqDemNeg_flg /end REF_MEASUREMENT
/end GROUP
/begin GROUP S1310_Signals_for_BCM "SWC_FDC_type/run_SWC_FDC_RxTx_5ms_sys/APP/TQD/TorqueDemand/TorqueModule/Signals for BCM" /begin REF_CHARACTERISTIC KTQD_RegBrkLPOff_c KTQD_RegBrkLPOn_c /end REF_CHARACTERISTIC /begin REF_MEASUREMENT VTQD_ReBrakeLPReq_flg /end REF_MEASUREMENT /end GROUP
/begin GROUP S1310_Signals_for_MCU "SWC_FDC_type/run_SWC_FDC_RxTx_5ms_sys/APP/TQD/TorqueDemand/TorqueModule/Signals for MCU"
 /begin REF_CHARACTERISTIC KTQD_FrIdcMax_A KTQD_FrIdcMin_A KTQD_FrUdcMax_V KTQD_FrUdcMin_V KTQD_RrIdcMax_A KTQD_RrIdcMin_A KTQD_RrUdcMax_V KTQD_RrUdcMin_V /end REF_CHARACTERISTIC
 /begin REF_MEASUREMENT VTQD_FrIdcMax_A VTQD_FrIdcMin_A VTQD_FrUdcMax_V VTQD_FrUdcMin_V VTQD_RrIdcMax_A VTQD_RrIdcMin_A VTQD_RrUdcMax_V VTQD_RrUdcMin_V /end REF_MEASUREMENT
/end GROUP
/begin GROUP S1310_TqCoordination "SWC_FDC_type/run_SWC_FDC_RxTx_5ms_sys/APP/TQD/TorqueDemand/TorqueModule/TqCoordination"
 /begin SUB_GROUP S1856_Coordinate_NoSuitbleGear_flg S1856_Total_Demand_Capacity_Torque_ /end SUB_GROUP
 /begin REF_CHARACTERISTIC KTQD_NewTotalCapTqSW_flg /end REF_CHARACTERISTIC
 /begin REF_MEASUREMENT VTQD_CoordTqDem_Nm VTQD_NoSuitbleGear_flg VTQD_TqSource_enum /end REF_MEASUREMENT
/end GROUP
/begin GROUP S1310_TqDistribution "SWC_FDC_type/run_SWC_FDC_RxTx_5ms_sys/APP/TQD/TorqueDemand/TorqueModule/TqDistribution" /begin SUB_GROUP S1857_AWD_Ratio S1857_New_Torque_Distribution /end SUB_GROUP
 /begin REF_CHARACTERISTIC KTQD_AWDWhlTqRatioSW_flg KTQD_ESCModeTqCtrlSW_flg KTQD_FrTCSCompensateSW_flg KTQD_NewPrelaodSW_flg KTQD_NewTotalCapTqSW_flg KTQD_NewWhlTqDistSW_flg KTQD_RrTCSCompensateSW_flg KTQD_TCSCompUpLimit_Nm KTQD_TCSCreepDriveTqSW_flg MTQD_AWDLoadTrqnsGain_Z_c MTQD_CreepRrTqSpRat_Z_rat MTQD_ECORrEDUSpRat_Z_rat MTQD_EscapeModePedTqFr_Z_Nm MTQD_EscapeModePedTqRr_Z_Nm MTQD_NRMRrEDUSpRat_Z_rat MTQD_RrRatioWithFrSR_Z_rat MTQD_RrRatioWithRrSR_Z_rat MTQD_RrTqSRRateTs_Y_c MTQD_SPORTRrEDUSpRat_Z_rat MTQD_SnowMRrEDUSpRat_Z_rat /end REF_CHARACTERISTIC
 /begin REF_MEASUREMENT VTQD_AWDLoadTrqnsGain_c VTQD_AWDLoadTrqnsGain_pct VTQD_CoordTqDemFr_Nm VTQD_CoordTqDemRr_Nm VTQD_CoordWhlTqDemFr_Nm VTQD_CoordWhlTqDemRr_Nm VTQD_CreepRrTqSpRat_rat VTQD_DriverWhlTqDemFr_Nm VTQD_DriverWhlTqDemRr_Nm VTQD_EscapeModePedTqFr_Nm VTQD_EscapeModePedTqRr_Nm VTQD_FrEDUSpRat_rat VTQD_FrTCSCompensateTq_Nm VTQD_OrigRrDriverRatio_rat VTQD_RrEDUSpRat_rat VTQD_RrRatioWithFrSR_rat VTQD_RrRatioWithRrSR_rat VTQD_RrTCSCompensateTq_Nm VTQD_RrTqSRRateTs_c VTQD_SnowMRrEDUSpRat_rat VTQD_TqSourceFr_enum VTQD_TqSourceRr_enum /end REF_MEASUREMENT
/end GROUP
/begin GROUP S2036_InverseAndTurnToMotorToq "SWC_FDC_type/run_SWC_FDC_RxTx_5ms_sys/APP/TQR/Determine Torque Request/TorqueArbitrament/InverseAndTurnToMotorToq" /begin SUB_GROUP S2037_SR_Latch S2037_SR_Latch1 /end SUB_GROUP
 /begin REF_CHARACTERISTIC KTQR_FrAbsoluteMTTqDir_flg KTQR_FrTMGearEff_c KTQR_GearChangeTqDSW_flg KTQR_GearChangeTqSW_flg KTQR_GearEnChangeTq_Nm KTQR_NewRampArchSW_flg KTQR_RrAbsoluteMTTqDir_flg KTQR_RrTMGearEff_c /end REF_CHARACTERISTIC
 /begin REF_MEASUREMENT VTQR_FrTMTqReq_Nm VTQR_InitFEDUWhlTqReq_Nm VTQR_InitREDUWhlTqReq_Nm VTQR_RrTMTqReq_Nm /end REF_MEASUREMENT
/end GROUP
/begin GROUP S2036_RampEnableJudge "SWC_FDC_type/run_SWC_FDC_RxTx_5ms_sys/APP/TQR/Determine Torque Request/TorqueArbitrament/RampEnableJudge" /begin SUB_GROUP S2038_SR_Latch3 S2038_SR_Latch4 /end SUB_GROUP
 /begin REF_CHARACTERISTIC KTQR_ACCCancelNoRBC_flg KTQR_ADASCancelBRgnSlopeF_Nmps KTQR_ADASCancelBRgnSlopeR_Nmps KTQR_ADASCancelBRgnSlopeSW_flg KTQR_FinalFEDUTrqLowLim_Nm KTQR_FinalFEDUTrqUpLim_Nm KTQR_FinalREDUTrqLowLim_Nm KTQR_FinalREDUTrqUpLim_Nm KTQR_NewRampArchSW_flg KTQR_TCSActTQRLimSW_flg /end REF_CHARACTERISTIC
 /begin REF_MEASUREMENT VTQR_ActFEDUTqLowLimit_Nm VTQR_ActFEDUTqUpLimit_Nm VTQR_ActREDUTqLowLimit_Nm VTQR_ActREDUTqUpLimit_Nm VTQR_ActualFEDUWhlTqReq_Nm VTQR_ActualREDUWhlTqReq_Nm VTQR_FrRampEnable_flg VTQR_FrntAxlTrqReqBrkRamp_Nm VTQR_NoABSFEDUWhlTqReq_Nm VTQR_NoABSREDUWhlTqReq_Nm VTQR_RearAxlTrqReqBrkRamp_Nm VTQR_RrRampEnable_flg /end REF_MEASUREMENT
/end GROUP
/begin GROUP S2036_TorqueSmooth "SWC_FDC_type/run_SWC_FDC_RxTx_5ms_sys/APP/TQR/Determine Torque Request/TorqueArbitrament/TorqueSmooth"
 /begin SUB_GROUP S2039_FirstOrderFilter S2039_FirstOrderFilter1 S2039_Front_First_order_filter_input_tau_map_and_determination S2039_Front_Torque_zero_point_transfer_boundary_map S2039_Front_Torque_zero_point_transfer_status_determination_ S2039_Front_torque_ramp_limtation_and_determination S2039_Front_wheel_first_order_filter_input_torque_command_determination S2039_Front_wheel_rate_limit_determination S2039_Limit S2039_Limit2 S2039_RateLimit S2039_RateLimit1 S2039_Rear_First_order_filter_input_tau_map_and_determination S2039_Rear_Torque_zero_point_transfer_boundary_map S2039_Rear_Torque_zero_point_transfer_status_determination_ S2039_Rear_torque_ramp_limtation_and_determination S2039_Rear_wheel_first_order_filter_input_torque_command_determination S2039_Rear_wheel_rate_limit_determination1 /end SUB_GROUP
 /begin REF_CHARACTERISTIC KTQR_LaunchEnPedal_pct KTQR_LaunchEnSpd_kph /end REF_CHARACTERISTIC
 /begin REF_MEASUREMENT VTQR_EVDriveMode_enum VTQR_FEDUWhlTqReqSmoothDelay_Nm VTQR_FrFirstOrderOutTqDelay_Nm VTQR_LaunchEn_flg VTQR_REDUWhlTqReqSmoothDelay_Nm VTQR_RampTqCMDGain_c VTQR_RrFirstOrderOutTqDelay_Nm /end REF_MEASUREMENT
/end GROUP
/begin GROUP S2303_ACC_Control_Allow_Judgement "SWC_FDC_type/run_SWC_FDC_RxTx_5ms_sys/APP/VMC/VMC/ACC_Function/ACC Control Allow Judgement" /begin REF_CHARACTERISTIC KVMC_ExternalTqAllowTime_s /end REF_CHARACTERISTIC /begin REF_MEASUREMENT VVMC_ACCCtrlAllow_flg /end REF_MEASUREMENT /end GROUP
/begin GROUP S2303_ACC_Torque_Source_Determination "SWC_FDC_type/run_SWC_FDC_RxTx_5ms_sys/APP/VMC/VMC/ACC_Function/ACC Torque Source Determination"
 /begin SUB_GROUP S2323_FirstOrderFilter6 S2323_SR_Latch S2323_SR_Latch1 S2323_SR_Latch2 S2323_Triggered_Subsystem2 /end SUB_GROUP
 /begin REF_CHARACTERISTIC KTQD_AWDWhlTqRatioSW_flg KTQD_FrUppTheldTrq_Nm KTQD_RrUppTheldTrq_Nm KVMC_ACCOvrdPedalTqLinearLim_Nm KVMC_ACCOvrdPedalTqRatio_Nm KVMC_ACCOvrdTestSW_flg KVMC_ACCPedalOvrdPosn4Hold_pct KVMC_ACCPedalOvrdPosn_pct KVMC_ACCPedalOvrdResPosn_pct KVMC_ACCPedalOvrdRestTime_s KVMC_ESCLongGBWFilter_raw32 KVMC_TimeGapBandLv1_s KVMC_TimeGapBandLv2_s KVMC_TimeGapBandLv3_s KVMC_TimeGapBandLv4_s KVMC_TimeGapMax_s MVMC_PedalTqRWhSTRGGain_Z_Nm MVMC_PedalTqRWhlRatio_Z_rat MVMC_PedalTqRWhlSlipGain_Z_Nm MVMC_RearWhlTqRatio_Z_rat MVMC_RearWhlTqSTRGGain_Z_Nm MVMC_RearWhlTqSlipGain_Z_Nm /end REF_CHARACTERISTIC
 /begin REF_MEASUREMENT VVMC_ACCPedalOvrd_flg VVMC_ADASFrWhlTqAftLim_Nm VVMC_ADASFrWhlTqAftSlip_Nm VVMC_ADASFrWhlTqBfrSlip_Nm VVMC_ADASFrWhlTq_Nm VVMC_ADASOvrdWhlTqCtrl_Nm VVMC_ADASOvrdWhlTq_Nm VVMC_ADASRrWhlTqAftLim_Nm VVMC_ADASRrWhlTqAftSlip_Nm VVMC_ADASRrWhlTqBfrSlip_Nm VVMC_ADASRrWhlTq_Nm VVMC_ADASWhlTqReqOvrd_Nm VVMC_ADASWhlTqReq_Nm VVMC_AccPedalOvrdDISC_flg VVMC_FrRrSlipRate_rat VVMC_PedalTqRWhSTRGGain_Nm VVMC_PedalTqRWhlRatio_rat VVMC_PedalTqRWhlSlipGain_Nm VVMC_RearTqRatioAftSlip_rat VVMC_RearTqRatioBfrSlip_rat VVMC_RearTqRatio_rat VVMC_RearWhlTqSTRGGain_Nm VVMC_RearWhlTqSlipGain_Nm VVMC_TimeGapCalcu_s VVMC_TimeGapJudge_flag VVMC_VMCWhlTq4RatioCalcu_Nm /end REF_MEASUREMENT
/end GROUP
/begin GROUP S2303_ACC_Wheel_Torque_Calculation "SWC_FDC_type/run_SWC_FDC_RxTx_5ms_sys/APP/VMC/VMC/ACC_Function/ACC Wheel Torque Calculation"
 /begin SUB_GROUP S2324_SR_Latch S2324_SR_Latch1 S2324_SR_Latch10 S2324_SR_Latch11 S2324_SR_Latch12 S2324_SR_Latch13 S2324_SR_Latch14 S2324_SR_Latch15 S2324_SR_Latch16 S2324_SR_Latch2 S2324_SR_Latch3 S2324_SR_Latch4 S2324_SR_Latch5 S2324_SR_Latch6 S2324_SR_Latch8 S2324_Triggered_Subsystem S2324_Triggered_Subsystem1 S2324_Triggered_Subsystem4 S2324_Triggered_Subsystem5 S2324_Triggered_Subsystem6 S2324_divide /end SUB_GROUP
 /begin REF_CHARACTERISTIC KTQR_FrTMGearEff_c KTQR_RrTMGearEff_c KVMC_ACCDeltaTqFollowADSCmd_flg KVMC_ACCLoSpdFollowBRgnSW_flg KVMC_ACCResUpEnAccCMD_mps2 KVMC_ACCResUpEnGrade_Deg KVMC_ACCRgnCtrl2Hold_flg KVMC_ACCSpdDevLowLim_kph KVMC_ACCSpdDevUpLim_kph KVMC_ACCTq2ZeroDisMCPress2_bar KVMC_ACCTq2ZeroDisMCPress_bar KVMC_ACCTq2ZeroEnMCPress2_bar KVMC_ACCTq2ZeroEnMCPress_bar KVMC_ADASWhlTqLowerLim_Nm KVMC_ADASWhlTqUpperLim_Nm KVMC_AccDevLowLim_mps2 KVMC_AccDevUpLim_mps2 KVMC_AccTurnHoldTqDecSR_Nmps KVMC_AddBRegen2ACCLoop_flg KVMC_CompareFrRrLongAcl_flg KVMC_CutOffNegTqSpd_kph KVMC_ESCSSMCPThres_bar KVMC_HillUpResetTMSpd_rpm KVMC_HoldAdd2GradeGn_flg KVMC_HoldAllowZeroTqGrade_deg KVMC_HoldGradeOnlyInc_flg KVMC_HoldResTqDisDeltaAcc_mps2 KVMC_HoldResTqDisSpd_kph KVMC_HoldTqAddDisDec_mps2 KVMC_HoldTqCalDeltaAccThres_Gps KVMC_HoldTqCalSpd1_kph KVMC_HoldTqCalTest_flg KVMC_HoldTqCtrlGradeThres_deg KVMC_HoldTqCtrlSourceSW_flg KVMC_HoldTqCtrlTargetGx_mps2 KVMC_IgnrAvailBrgnSpd_kph KVMC_MaxReqAccel_mps2 KVMC_MinReqAccel_mps2 KVMC_NegReqDeltaTqGain_rat KVMC_NegReqEnSpd_kph KVMC_NegReqSwEnSlope_Deg KVMC_NegReqSwEnSpd_kph KVMC_NegReqZeroPosTq_flg KVMC_OVRD2ActRgnTarget_Nm KVMC_OVRDResSmoothTest_SW KVMC_OVRDResTqDec4Smooth_Nm KVMC_ReqAccelLimitSW_flg KVMC_SmallGradeTMRevPrvt_flg KVMC_SoftUphillTqIncSR_Nm KVMC_StandstillTqRamp2ZeroSlope_Nmps KVMC_TMRevPrvtTqAddEveryTT_flg KVMC_TMRevSpdPassThres_rpm KVMC_TMRevSpdThres_rpm KVMC_TqMCPRelFactor_Nm KVMC_TqSafetyCtrl_flg KVMC_VHJerkPrvt_flg KVMC_VHTMSpdCtrlChkTMDir_flg KVMC_VHTMSpdCtrlSR_raw32 KVMC_VehHoldDecSR_Nm KVMC_VehHoldTqIncMCP_bar KVMC_VehHoldTqIncMinTq_Nm KVMC_ZCChkRealWhlTqSW_flg KVMC_ZeroCrossTestSW_flg KVMC_ZeroRgnTqSpdCtrlTime_s KVMC_ZeroRgnTqSpd_kph MVMC_ACCDeltaTqGradeGn_Y_Nm MVMC_ACCDeltaTqIGain4OVRD_Z_Nm MVMC_ACCDeltaTqIGain_Z_Nm MVMC_ACCDeltaTqPGain_Z_Nm MVMC_ACCLoSpdTqLoLim4JP_Z_Nm MVMC_ACCLoSpdTqLowerLim_Z_Nm MVMC_ADSPosGFBDeltaTq_Z_Nm MVMC_DISCDeltaTqIGain_Z_Nm MVMC_HoldResTq_Y_Nm MVMC_MCPresBaseTq_Y_Nm MVMC_NegZCHoldTq_Y_Nm MVMC_PosZCHoldTq_Y_Nm MVMC_TMRevPrvtTq4JP_Z_Nm MVMC_TMRevPrvtTq_Y_Nm MVMC_TMSpdBaseTq_Y_Nm MVMC_VHTMSpdCtrl_Z_Nm MVMC_VehHoldTqIncGain_Y_Nm MVMC_ZCWaitTimeNeg_Y_s MVMC_ZCWaitTimePos_Y_s /end REF_CHARACTERISTIC
 /begin REF_MEASUREMENT VVMC_ACCActSpdDev_kph VVMC_ACCDeltaAccel_mps2 VVMC_ACCDeltaAclAftCompare_mps2 VVMC_ACCDeltaTqGradeGn_Nm VVMC_ACCDeltaTqIGain4OVRD_Nm VVMC_ACCDeltaTqIGainOri_Nm VVMC_ACCDeltaTqIGain_Nm VVMC_ACCDeltaTqPGain_Nm VVMC_ACCDeltaTq_Nm VVMC_ACCLowSpdTqAftFollowESC_Nm VVMC_ACCLowSpdTqEnSpdHi_Nm VVMC_ACCLowSpdTqEnSpdLo_Nm VVMC_ACCLowSpdTq_Nm VVMC_ACCRgnTq2Hold_Nm VVMC_ACCTqNegReqNotLowSpd_Nm VVMC_ACCTqNegReq_Nm VVMC_ACCTqRampOutByMCP_Nm VVMC_ADASNegReq_flg VVMC_ADASWhlTqCalAftHold_Nm VVMC_ADASWhlTqCalAftSafety_Nm VVMC_ADASWhlTqCalBftHold_Nm VVMC_ADASWhlTqCalBftZC_Nm VVMC_ADASWhlTqCalNegCMD_Nm VVMC_ADASWhlTqCalVehHoldPosTq_Nm VVMC_ADASWhlTqCalVehHold_Nm VVMC_ADASWhlTqCalZeroRgnCtrl_Nm VVMC_ADASWhlTqCal_Nm VVMC_ADASWhlTqVehHoldBfrSS_Nm VVMC_ADSBRgnDeltaTq_Nm VVMC_ADSPosGFBPCTDeltaTq_Nm VVMC_ActAccDev_mps2 VVMC_DISCDeltaTqIGain_Nm VVMC_FrntAxlTrqReqBrk_Nm VVMC_HoldResTq_Nm VVMC_HoldTqCtrlEn_flg VVMC_HoldTqGradeGnFinal_Nm VVMC_HoldTqTargetFinal_Nm VVMC_HoldTqTarget_Nm VVMC_LastADASWhlTqCal_Nm VVMC_MCPreBaseTqEn_flg VVMC_MCPresBaseTq_Nm VVMC_NegZCHoldTq_Nm VVMC_OVRDAccCtrl_flg VVMC_OriADASWhlTq_Nm VVMC_PosZCHoldTq_Nm VVMC_RearAxlTrqReqBrk_Nm VVMC_RrWhlStandstill_flg VVMC_TMRevPrvtTq4JertPrvt_Nm VVMC_TMRevPrvtTq_Nm VVMC_TMSpdBaseTq_Nm VVMC_VHJerkPrvtTq_Nm VVMC_VHTMSpdCtrlDeltaTq_Nm VVMC_ZCWaitTimeNeg_s VVMC_ZCWaitTimePos_s VVMC_ZeroSpdTMSpdCtrlTarget_rpm /end REF_MEASUREMENT
/end GROUP
/begin GROUP S2303_Hand_Shaking "SWC_FDC_type/run_SWC_FDC_RxTx_5ms_sys/APP/VMC/VMC/ACC_Function/Hand Shaking" /begin REF_MEASUREMENT VVMC_ACCCtrlAvail_flg VVMC_ADASActive_flg /end REF_MEASUREMENT /end GROUP
/begin GROUP S2304_CAAS_HandShake "SWC_FDC_type/run_SWC_FDC_RxTx_5ms_sys/APP/VMC/VMC/APS function/CAAS HandShake" /begin SUB_GROUP S2396_DelayEnable /end SUB_GROUP
 /begin REF_CHARACTERISTIC KVMC_CAASCtrlAllowTime_s KVMC_CAASEnVehSpd_kph KVMC_CAASVMCReqA_flg_ovrdflg KVMC_CAASVMCReqA_flg_ovrdval /end REF_CHARACTERISTIC
 /begin REF_MEASUREMENT VVMC_CAASActive_flg /end REF_MEASUREMENT
/end GROUP
/begin GROUP S2304_Command_Determination1 "SWC_FDC_type/run_SWC_FDC_RxTx_5ms_sys/APP/VMC/VMC/APS function/Command Determination1"
 /begin REF_MEASUREMENT VVMC_APSEnCMD_flg VVMC_APSShiftPosnReq_enum VVMC_APSSpeedCMD_kph /end REF_MEASUREMENT
/end GROUP
/begin GROUP S2304_Hand_Shake "SWC_FDC_type/run_SWC_FDC_RxTx_5ms_sys/APP/VMC/VMC/APS function/Hand Shake" /begin SUB_GROUP S2398_DelayEnable S2398_DelayEnable1 S2398_DelayEnable2 /end SUB_GROUP
 /begin REF_CHARACTERISTIC KVMC_ExternalDoorAllowTime_s KVMC_ExternalShiftAllowTime_s KVMC_ExternalTqAllowTime_s /end REF_CHARACTERISTIC
 /begin REF_MEASUREMENT VVMC_APSActive_flg VVMC_APSCtrlAvail_flg /end REF_MEASUREMENT
/end GROUP
/begin GROUP S2304_Signal_Rounting "SWC_FDC_type/run_SWC_FDC_RxTx_5ms_sys/APP/VMC/VMC/APS function/Signal Rounting"
 /begin SUB_GROUP S2399_Signal_Determination_VINP_APSDecReqAtest_flg S2399_Signal_Determination_VINP_APSDecReqtest_mps2 S2399_Signal_Determination_VINP_APSReqtest_enum S2399_Signal_Determination_VINP_APSStaSystemtest_enum /end SUB_GROUP
/end GROUP
/begin GROUP S2304_Subsystem "SWC_FDC_type/run_SWC_FDC_RxTx_5ms_sys/APP/VMC/VMC/APS function/Subsystem"
 /begin REF_CHARACTERISTIC KVMC_APSAllowSetACCMCP_bar KVMC_APSAllowSetACCPosn_pct KVMC_AllowSetSpdDist_m KVMC_AllowSetSpdOvrdVal_flg KVMC_AllowSetSpdOvrd_flg KVMC_NotAllowSetSpdDist_m /end REF_CHARACTERISTIC
 /begin REF_MEASUREMENT VVMC_AllowSetSpd_flg VVMC_SetACCDisableAPS_flg /end REF_MEASUREMENT
/end GROUP
/begin GROUP S2305_CCActiveDetermination "SWC_FDC_type/run_SWC_FDC_RxTx_5ms_sys/APP/VMC/VMC/CruiseControlFunction/CCActiveDetermination"
 /begin REF_CHARACTERISTIC KTQD_CCActiveMetSpdHiMPH_mph KTQD_CCActiveMetSpdHi_kph KTQD_CCActiveMetSpdLoMPH_mph KTQD_CCActiveMetSpdLo_kph /end REF_CHARACTERISTIC
 /begin REF_MEASUREMENT VVMC_CCCtrlSta_enum VVMC_CCSpdWar_flg VVMC_CruzActive_flg /end REF_MEASUREMENT
/end GROUP
/begin GROUP S2305_CCDemandTorqueCalculation "SWC_FDC_type/run_SWC_FDC_RxTx_5ms_sys/APP/VMC/VMC/CruiseControlFunction/CCDemandTorqueCalculation"
 /begin REF_CHARACTERISTIC KTQR_FrTMGearEff_c KTQR_RrTMGearEff_c KVMC_AccDevLowLim_mps2 KVMC_AccDevUpLim_mps2 KVMC_CCDISCPGainSW_flg KVMC_CCSpdDevLowLim_kph KVMC_CCSpdDevUpLim_kph KVMC_CCTqLowLim_Nm KVMC_CCTqUpLim_Nm KVMC_TqSafetyCtrl_flg MVMC_DISCDeltaTqIGain_Z_Nm MVMC_DISCDeltaTqPGain_Z_Nm /end REF_CHARACTERISTIC
 /begin REF_MEASUREMENT VVMC_CCIGainDeltaTq_Nm VVMC_CCPGainDeltaTq_Nm VVMC_CruzWhlTqCalAftSafety_Nm VVMC_CruzWhlTqCal_Nm VVMC_LastCruzWhlTqCal_Nm /end REF_MEASUREMENT
/end GROUP
/begin GROUP S2305_CCTorqueSourceDetermination "SWC_FDC_type/run_SWC_FDC_RxTx_5ms_sys/APP/VMC/VMC/CruiseControlFunction/CCTorqueSourceDetermination" /begin SUB_GROUP S2414_SR_Latch /end SUB_GROUP /begin REF_CHARACTERISTIC KVMC_ACCPedalOvrdRestTime_s MVMC_ACCPedalOvrdTqHys_Y_Nm /end REF_CHARACTERISTIC /begin REF_MEASUREMENT VVMC_CCPedalOvrd_flg VVMC_CruzWhlTqReq_Nm /end REF_MEASUREMENT /end GROUP
/begin GROUP S2308_IMU_memorized_offset_result "SWC_FDC_type/run_SWC_FDC_RxTx_5ms_sys/APP/VMC/VMC/IMU/IMU memorized offset result" /begin REF_CHARACTERISTIC KVMC_AccFSCalSet_enum KVMC_GyroFSCalSet_enum /end REF_CHARACTERISTIC
 /begin REF_MEASUREMENT VVMC_AccFSCalSet_enum VVMC_GyroFSCalSet_enum VVMC_MemOffsetAccX_G VVMC_MemOffsetAccY_G VVMC_MemOffsetAccZ_G VVMC_MemOffsetGyroX_Dps VVMC_MemOffsetGyroY_Dps VVMC_MemOffsetGyroZ_Dps /end REF_MEASUREMENT
/end GROUP
/begin GROUP S2308_IMU_sensing_result_ "SWC_FDC_type/run_SWC_FDC_RxTx_5ms_sys/APP/VMC/VMC/IMU/IMU sensing result "
 /begin SUB_GROUP S2429_FirstOrderFilter1 S2429_FirstOrderFilter2 S2429_FirstOrderFilter3 S2429_FirstOrderFilter4 S2429_FirstOrderFilter5 S2429_FirstOrderFilter6 /end SUB_GROUP
 /begin REF_CHARACTERISTIC KVMC_AccFSSlect_enum KVMC_GyroFSSlect_enum KVMC_IMUAccXRollAveLevel_enum KVMC_IMUAccYRollAveLevel_enum KVMC_IMUAccZRollAveLevel_enum KVMC_IMUGxFilter_raw32 KVMC_IMUGyFilter_raw32 KVMC_IMUGyroXRollAveLevel_enum KVMC_IMUGyroYRollAveLevel_enum KVMC_IMUGyroZRollAveLevel_enum KVMC_IMUGzFilter_raw32 KVMC_IMURxFilter_raw32 KVMC_IMURyFilter_raw32 KVMC_IMURzFilter_raw32 /end REF_CHARACTERISTIC
 /begin REF_MEASUREMENT VVMC_AccFSSlect_enum VVMC_CalibratedAccXAftRA_G VVMC_GyroFSSlect_enum VVMC_SensingAccX_G VVMC_SensingAccY_G VVMC_SensingAccZ_G VVMC_SensingGyroX_Dps VVMC_SensingGyroY_Dps VVMC_SensingGyroZ_Dps /end REF_MEASUREMENT
/end GROUP
/begin GROUP S2310_Degrees_to_Radians1 "SWC_FDC_type/run_SWC_FDC_RxTx_5ms_sys/APP/VMC/VMC/Long Acceleration Calculation/Degrees to Radians1" /begin REF_MEASUREMENT VVMC_GRADE_rad /end REF_MEASUREMENT /end GROUP
/begin GROUP S2310_DelayEnable "SWC_FDC_type/run_SWC_FDC_RxTx_5ms_sys/APP/VMC/VMC/Long Acceleration Calculation/DelayEnable" /begin REF_MEASUREMENT VVMC_EstSlopeLowSpdGxStable_flg /end REF_MEASUREMENT /end GROUP
/begin GROUP S2311_MSADemandTorqueCalculation "SWC_FDC_type/run_SWC_FDC_RxTx_5ms_sys/APP/VMC/VMC/MSA function/MSADemandTorqueCalculation"
 /begin REF_CHARACTERISTIC KTQR_FrTMGearEff_c KTQR_RrTMGearEff_c KVMC_AccDevLowLim_mps2 KVMC_AccDevUpLim_mps2 MVMC_DISCDeltaTqIGain_Z_Nm MVMC_DISCDeltaTqPGain_Z_Nm /end REF_CHARACTERISTIC
/end GROUP
/begin GROUP S2314_Required_Acceleration "SWC_FDC_type/run_SWC_FDC_RxTx_5ms_sys/APP/VMC/VMC/SPD2ACC/Required_Acceleration" /begin REF_CHARACTERISTIC KVMC_ACCRgnCtrl2Hold_flg /end REF_CHARACTERISTIC /end GROUP
/begin GROUP S913_APTCPWMControl "SWC_FDC_type/run_SWC_FDC_RxTx_5ms_sys/APP/THC/ThermalControl/THCM_Conctrl/APTC/APTCPWMControl" /begin REF_CHARACTERISTIC KTHC_APTCPWMEN_flg KTHC_APTCQminC_W /end REF_CHARACTERISTIC /end GROUP
/begin GROUP S913_APTCPWMControl1 "SWC_FDC_type/run_SWC_FDC_RxTx_5ms_sys/APP/THC/ThermalControl/THCM_Conctrl/APTC/APTCPWMControl1" /begin REF_CHARACTERISTIC KTHC_APTCPWMEN_flg KTHC_APTCQminC_W /end REF_CHARACTERISTIC /end GROUP
/begin GROUP S913_APTCPWMControl2 "SWC_FDC_type/run_SWC_FDC_RxTx_5ms_sys/APP/THC/ThermalControl/THCM_Conctrl/APTC/APTCPWMControl2" /begin REF_CHARACTERISTIC KTHC_APTCPWMEN_flg KTHC_APTCQminC_W /end REF_CHARACTERISTIC /end GROUP
/begin GROUP S914_Enabled_Subsystem1 "SWC_FDC_type/run_SWC_FDC_RxTx_5ms_sys/APP/THC/ThermalControl/THCM_Conctrl/BlowerCtrl/Enabled Subsystem1" /begin REF_CHARACTERISTIC KTHC_VBlowerDcCh_K KTHC_VBlowerMin_K /end REF_CHARACTERISTIC /end GROUP
/begin GROUP S1316_Drive_Protection "SWC_FDC_type/run_SWC_FDC_RxTx_5ms_sys/APP/TQD/TorqueDemand/ShiftModule/GearShiftPosn/Drive Protection" /begin REF_CHARACTERISTIC KTQD_DriveProtVehSpdGain_kph /end REF_CHARACTERISTIC /end GROUP
/begin GROUP S1849_TorqueCapacityCalcalation "SWC_FDC_type/run_SWC_FDC_RxTx_5ms_sys/APP/TQD/TorqueDemand/TorqueModule/AvaliableTqLimit/TorqueCapacityCalcalation" /begin REF_CHARACTERISTIC KTQD_FrUppTheldTrq_Nm KTQD_RrUppTheldTrq_Nm /end REF_CHARACTERISTIC /end GROUP
/begin GROUP S1850_DriverTqCoordination "SWC_FDC_type/run_SWC_FDC_RxTx_5ms_sys/APP/TQD/TorqueDemand/TorqueModule/DriverWhlTqDem/DriverTqCoordination"
 /begin REF_CHARACTERISTIC KTQD_ESCModeTqCtrlSW_flg KTQD_EscModeTqLimSpdDev_kph KTQD_EscModeWhlSpdDely_cnt KTQD_NewPrelaodSW_flg /end REF_CHARACTERISTIC
/end GROUP
/begin GROUP S1850_PedalMapWhlTq "SWC_FDC_type/run_SWC_FDC_RxTx_5ms_sys/APP/TQD/TorqueDemand/TorqueModule/DriverWhlTqDem/PedalMapWhlTq" /begin REF_CHARACTERISTIC KVMC_ACCOvrdTestSW_flg /end REF_CHARACTERISTIC /end GROUP
/begin GROUP S1852_Parking_Requeest_Backup "SWC_FDC_type/run_SWC_FDC_RxTx_5ms_sys/APP/TQD/TorqueDemand/TorqueModule/OPD Hold/Parking Requeest Backup" /begin REF_CHARACTERISTIC KTQD_OPDHoldAllowGearPSW_flg /end REF_CHARACTERISTIC /end GROUP
/begin GROUP S2039_Front_torque_ramp_limtation_and_determination "SWC_FDC_type/run_SWC_FDC_RxTx_5ms_sys/APP/TQR/Determine Torque Request/TorqueArbitrament/TorqueSmooth/Front torque ramp limtation and determination" /begin REF_CHARACTERISTIC KTQR_FinalFEDUTrqLowLim_Nm KTQR_FinalFEDUTrqUpLim_Nm /end REF_CHARACTERISTIC /end GROUP
/begin GROUP S2039_Front_wheel_first_order_filter_input_torque_command_determination "SWC_FDC_type/run_SWC_FDC_RxTx_5ms_sys/APP/TQR/Determine Torque Request/TorqueArbitrament/TorqueSmooth/Front wheel first order filter input torque command determination" /begin REF_CHARACTERISTIC KTQR_GearChangeTqSW_flg KTQR_NewRampArchSW_flg /end REF_CHARACTERISTIC /end GROUP
/begin GROUP S2039_Front_wheel_rate_limit_determination "SWC_FDC_type/run_SWC_FDC_RxTx_5ms_sys/APP/TQR/Determine Torque Request/TorqueArbitrament/TorqueSmooth/Front wheel rate limit determination" /begin REF_CHARACTERISTIC KTQR_NewRampArchSW_flg /end REF_CHARACTERISTIC /end GROUP
/begin GROUP S2039_Rear_torque_ramp_limtation_and_determination "SWC_FDC_type/run_SWC_FDC_RxTx_5ms_sys/APP/TQR/Determine Torque Request/TorqueArbitrament/TorqueSmooth/Rear torque ramp limtation and determination" /begin REF_CHARACTERISTIC KTQR_FinalREDUTrqLowLim_Nm KTQR_FinalREDUTrqUpLim_Nm /end REF_CHARACTERISTIC /end GROUP
/begin GROUP S2039_Rear_wheel_first_order_filter_input_torque_command_determination "SWC_FDC_type/run_SWC_FDC_RxTx_5ms_sys/APP/TQR/Determine Torque Request/TorqueArbitrament/TorqueSmooth/Rear wheel first order filter input torque command determination" /begin REF_CHARACTERISTIC KTQR_GearChangeTqSW_flg KTQR_NewRampArchSW_flg /end REF_CHARACTERISTIC /end GROUP
/begin GROUP S2039_Rear_wheel_rate_limit_determination1 "SWC_FDC_type/run_SWC_FDC_RxTx_5ms_sys/APP/TQR/Determine Torque Request/TorqueArbitrament/TorqueSmooth/Rear wheel rate limit determination1" /begin REF_CHARACTERISTIC KTQR_NewRampArchSW_flg /end REF_CHARACTERISTIC /end GROUP
/begin GROUP S1415_ACC_Speed_Setting_ON "SWC_FDC_type/run_SWC_FDC_RxTx_5ms_sys/APP/TQD/TorqueDemand/Signal_convert/SWC2_Subsystem/Speed Setting Mode/ACC Speed Setting ON" /begin REF_CHARACTERISTIC KVMC_AllowSetSpdDist_m KVMC_NotAllowSetSpdDist_m /end REF_CHARACTERISTIC /end GROUP
/begin GROUP S1415_CC_Speed_Setting_ON "SWC_FDC_type/run_SWC_FDC_RxTx_5ms_sys/APP/TQD/TorqueDemand/Signal_convert/SWC2_Subsystem/Speed Setting Mode/CC Speed Setting ON"
 /begin REF_CHARACTERISTIC KTQD_CCActiveMetSpdHiMPH_mph KTQD_CCActiveMetSpdHi_kph KTQD_CCActiveMetSpdLoMPH_mph KTQD_CCActiveMetSpdLo_kph /end REF_CHARACTERISTIC
/end GROUP
/begin GROUP S1761_ACC_Speed_Setting_ON "SWC_FDC_type/run_SWC_FDC_RxTx_5ms_sys/APP/TQD/TorqueDemand/Signal_convert/SWC_Subsystem/Speed Setting Mode/ACC Speed Setting ON" /begin REF_CHARACTERISTIC KVMC_AllowSetSpdDist_m KVMC_NotAllowSetSpdDist_m /end REF_CHARACTERISTIC /end GROUP
/begin GROUP S1761_CC_Speed_Setting_ON "SWC_FDC_type/run_SWC_FDC_RxTx_5ms_sys/APP/TQD/TorqueDemand/Signal_convert/SWC_Subsystem/Speed Setting Mode/CC Speed Setting ON"
 /begin REF_CHARACTERISTIC KTQD_CCActiveMetSpdHiMPH_mph KTQD_CCActiveMetSpdHi_kph KTQD_CCActiveMetSpdLoMPH_mph KTQD_CCActiveMetSpdLo_kph /end REF_CHARACTERISTIC
/end GROUP
/begin GROUP S1794_Vehicle_Weight "SWC_FDC_type/run_SWC_FDC_RxTx_5ms_sys/APP/TQD/TorqueDemand/Signal_convert/VehWeightEst/Calaulation/Vehicle Weight" /begin REF_CHARACTERISTIC KTQR_FrTMGearEff_c KTQR_RrTMGearEff_c /end REF_CHARACTERISTIC /end GROUP
/begin GROUP S1866_Generation "SWC_FDC_type/run_SWC_FDC_RxTx_5ms_sys/APP/TQD/TorqueDemand/TorqueModule/AvaliableTqLimit/TorqueCapacityCalcalation/Generation" /begin REF_CHARACTERISTIC KTQD_NewTotalCapTqSW_flg /end REF_CHARACTERISTIC /end GROUP
/begin GROUP S1866_Motoring "SWC_FDC_type/run_SWC_FDC_RxTx_5ms_sys/APP/TQD/TorqueDemand/TorqueModule/AvaliableTqLimit/TorqueCapacityCalcalation/Motoring"
 /begin REF_CHARACTERISTIC KTQD_FrUppTheldTrq_Nm KTQD_NewTotalCapTqSW_flg KTQD_RrUppTheldTrq_Nm /end REF_CHARACTERISTIC
/end GROUP
/end MODULE
/end PROJECT
