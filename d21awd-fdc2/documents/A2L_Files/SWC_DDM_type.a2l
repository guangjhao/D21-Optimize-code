/******************************************************************************
* ASAP2 file: SWC_DDM_type.a2l
* Code generation for model "SWC_DDM_type".
* Model version : 1.20
* Simulink Coder version : 9.6 (R2021b) 14-May-2021
* C source code generated on : Thu Jun 26 13:50:34 2025
* Target selection: autosar.tlc
* Embedded hardware selection: ARM Compatible->ARM Cortex-M
* Code generation objectives: Unspecified
* Validation result: Not run
* (add additional file header information here)
******************************************************************************/
/* Version 1.31 */
ASAP2_VERSION 1 31
/begin PROJECT ProjectName "Project Comment Goes Here"
/begin HEADER "Header Comments go here" /end HEADER
/begin MODULE ModuleName "Module Comment Goes Here"
/begin MOD_PAR "MOD PAR Comment Goes Here" /end MOD_PAR
/begin MOD_COMMON "Mod Common Comment Here" BYTE_ORDER MSB_LAST /end MOD_COMMON
/begin RECORD_LAYOUT Scalar_BOOLEAN FNC_VALUES 1 UBYTE COLUMN_DIR DIRECT /end RECORD_LAYOUT
/begin RECORD_LAYOUT Scalar_UBYTE FNC_VALUES 1 UBYTE COLUMN_DIR DIRECT /end RECORD_LAYOUT
/begin RECORD_LAYOUT Scalar_BYTE FNC_VALUES 1 SBYTE COLUMN_DIR DIRECT /end RECORD_LAYOUT
/begin RECORD_LAYOUT Scalar_UWORD FNC_VALUES 1 UWORD COLUMN_DIR DIRECT /end RECORD_LAYOUT
/begin RECORD_LAYOUT Scalar_SWORD FNC_VALUES 1 SWORD COLUMN_DIR DIRECT /end RECORD_LAYOUT
/begin RECORD_LAYOUT Scalar_ULONG FNC_VALUES 1 ULONG COLUMN_DIR DIRECT /end RECORD_LAYOUT
/begin RECORD_LAYOUT Scalar_LONG FNC_VALUES 1 SLONG COLUMN_DIR DIRECT /end RECORD_LAYOUT
/begin RECORD_LAYOUT Scalar_FLOAT32_IEEE FNC_VALUES 1 FLOAT32_IEEE COLUMN_DIR DIRECT /end RECORD_LAYOUT
/begin RECORD_LAYOUT Scalar_FLOAT64_IEEE FNC_VALUES 1 FLOAT64_IEEE COLUMN_DIR DIRECT /end RECORD_LAYOUT
/begin RECORD_LAYOUT Lookup1D_BOOLEAN FNC_VALUES 1 UBYTE COLUMN_DIR DIRECT /end RECORD_LAYOUT
/begin RECORD_LAYOUT Lookup1D_X_BOOLEAN AXIS_PTS_X 1 UBYTE INDEX_INCR DIRECT /end RECORD_LAYOUT
/begin RECORD_LAYOUT Lookup1D_BYTE FNC_VALUES 1 SBYTE COLUMN_DIR DIRECT /end RECORD_LAYOUT
/begin RECORD_LAYOUT Lookup1D_X_BYTE AXIS_PTS_X 1 SBYTE INDEX_INCR DIRECT /end RECORD_LAYOUT
/begin RECORD_LAYOUT Lookup1D_FLOAT32_IEEE FNC_VALUES 1 FLOAT32_IEEE COLUMN_DIR DIRECT /end RECORD_LAYOUT
/begin RECORD_LAYOUT Lookup1D_X_FLOAT32_IEEE AXIS_PTS_X 1 FLOAT32_IEEE INDEX_INCR DIRECT /end RECORD_LAYOUT
/begin CHARACTERISTIC MDDM_FrTMTqDev_Y_Nm "" /* Characteristic Type */ CURVE 0x0000 /* @ECU_Address@MDDM_FrTMTqDev_Y_Nm@ */ Lookup1D_FLOAT32_IEEE /* Maxdiff */ 0 SWC_DDM_type_CM_single_Nm -100000.0 100000.0
 /begin AXIS_DESCR /* Description of X-Axis Points */ /* Axis Type */ COM_AXIS /* Reference to Input */ NO_INPUT_QUANTITY SWC_DDM_type_CM_single_Nm 33 -100000.0 100000.0 AXIS_PTS_REF ADDM_FrTMTqDev_X_Nm /end AXIS_DESCR
/end CHARACTERISTIC
/begin AXIS_PTS ADDM_FrTMTqDev_X_Nm "" 0x0000 /* @ECU_Address@ADDM_FrTMTqDev_X_Nm@ */ /* Input Quantity */ NO_INPUT_QUANTITY Lookup1D_X_FLOAT32_IEEE 0 SWC_DDM_type_CM_single_Nm 33 -100000.0 100000.0 /end AXIS_PTS
/begin CHARACTERISTIC MDDM_RrTMTqDev_Y_Nm "" /* Characteristic Type */ CURVE 0x0000 /* @ECU_Address@MDDM_RrTMTqDev_Y_Nm@ */ Lookup1D_FLOAT32_IEEE /* Maxdiff */ 0 SWC_DDM_type_CM_single_Nm -100000.0 100000.0
 /begin AXIS_DESCR /* Description of X-Axis Points */ /* Axis Type */ COM_AXIS /* Reference to Input */ NO_INPUT_QUANTITY SWC_DDM_type_CM_single_Nm 33 -100000.0 100000.0 AXIS_PTS_REF ADDM_RrTMTqDev_X_Nm /end AXIS_DESCR
/end CHARACTERISTIC
/begin AXIS_PTS ADDM_RrTMTqDev_X_Nm "" 0x0000 /* @ECU_Address@ADDM_RrTMTqDev_X_Nm@ */ /* Input Quantity */ NO_INPUT_QUANTITY Lookup1D_X_FLOAT32_IEEE 0 SWC_DDM_type_CM_single_Nm 33 -100000.0 100000.0 /end AXIS_PTS
/begin CHARACTERISTIC KDDM_5vAPS1OoRDetTO_s "" VALUE 0x0000 /* @ECU_Address@KDDM_5vAPS1OoRDetTO_s@ */ Scalar_FLOAT32_IEEE 0 SWC_DDM_type_CM_single_sec 0.0 10.0 /end CHARACTERISTIC
/begin CHARACTERISTIC KDDM_5vAPS1OoRHiLim_V "" VALUE 0x0000 /* @ECU_Address@KDDM_5vAPS1OoRHiLim_V@ */ Scalar_FLOAT32_IEEE 0 SWC_DDM_type_CM_single_V 0.0 15.0 /end CHARACTERISTIC
/begin CHARACTERISTIC KDDM_5vAPS1OoRLoLim_V "" VALUE 0x0000 /* @ECU_Address@KDDM_5vAPS1OoRLoLim_V@ */ Scalar_FLOAT32_IEEE 0 SWC_DDM_type_CM_single_V 0.0 15.0 /end CHARACTERISTIC
/begin CHARACTERISTIC KDDM_5vAPS1OoRPassTO_s "" VALUE 0x0000 /* @ECU_Address@KDDM_5vAPS1OoRPassTO_s@ */ Scalar_FLOAT32_IEEE 0 SWC_DDM_type_CM_single_sec 0.0 10.0 /end CHARACTERISTIC
/begin CHARACTERISTIC KDDM_5vAPS2OoRDetTO_s "" VALUE 0x0000 /* @ECU_Address@KDDM_5vAPS2OoRDetTO_s@ */ Scalar_FLOAT32_IEEE 0 SWC_DDM_type_CM_single_sec 0.0 10.0 /end CHARACTERISTIC
/begin CHARACTERISTIC KDDM_5vAPS2OoRHiLim_V "" VALUE 0x0000 /* @ECU_Address@KDDM_5vAPS2OoRHiLim_V@ */ Scalar_FLOAT32_IEEE 0 SWC_DDM_type_CM_single_V 0.0 15.0 /end CHARACTERISTIC
/begin CHARACTERISTIC KDDM_5vAPS2OoRLoLim_V "" VALUE 0x0000 /* @ECU_Address@KDDM_5vAPS2OoRLoLim_V@ */ Scalar_FLOAT32_IEEE 0 SWC_DDM_type_CM_single_V 0.0 15.0 /end CHARACTERISTIC
/begin CHARACTERISTIC KDDM_5vAPS2OoRPassTO_s "" VALUE 0x0000 /* @ECU_Address@KDDM_5vAPS2OoRPassTO_s@ */ Scalar_FLOAT32_IEEE 0 SWC_DDM_type_CM_single_sec 0.0 10.0 /end CHARACTERISTIC
/begin CHARACTERISTIC KDDM_APS1SigOoRDetTO_s "" VALUE 0x0000 /* @ECU_Address@KDDM_APS1SigOoRDetTO_s@ */ Scalar_FLOAT32_IEEE 0 SWC_DDM_type_CM_single_sec 0.0 10.0 /end CHARACTERISTIC
/begin CHARACTERISTIC KDDM_APS1SigOoRPassTO_s "" VALUE 0x0000 /* @ECU_Address@KDDM_APS1SigOoRPassTO_s@ */ Scalar_FLOAT32_IEEE 0 SWC_DDM_type_CM_single_sec 0.0 10.0 /end CHARACTERISTIC
/begin CHARACTERISTIC KDDM_APS2SigOoRDetTO_s "" VALUE 0x0000 /* @ECU_Address@KDDM_APS2SigOoRDetTO_s@ */ Scalar_FLOAT32_IEEE 0 SWC_DDM_type_CM_single_sec 0.0 10.0 /end CHARACTERISTIC
/begin CHARACTERISTIC KDDM_APS2SigOoRPassTO_s "" VALUE 0x0000 /* @ECU_Address@KDDM_APS2SigOoRPassTO_s@ */ Scalar_FLOAT32_IEEE 0 SWC_DDM_type_CM_single_sec 0.0 10.0 /end CHARACTERISTIC
/begin CHARACTERISTIC KDDM_APSCorrErrDetTO_s "" VALUE 0x0000 /* @ECU_Address@KDDM_APSCorrErrDetTO_s@ */ Scalar_FLOAT32_IEEE 0 SWC_DDM_type_CM_single_sec 0.0 10.0 /end CHARACTERISTIC
/begin CHARACTERISTIC KDDM_APSCorrErrPassTO_s "" VALUE 0x0000 /* @ECU_Address@KDDM_APSCorrErrPassTO_s@ */ Scalar_FLOAT32_IEEE 0 SWC_DDM_type_CM_single_sec 0.0 10.0 /end CHARACTERISTIC
/begin CHARACTERISTIC KDDM_BrkPedalPos_pct "" VALUE 0x0000 /* @ECU_Address@KDDM_BrkPedalPos_pct@ */ Scalar_FLOAT32_IEEE 0 SWC_DDM_type_CM_single_pct 0.0 100.0 /end CHARACTERISTIC
/begin CHARACTERISTIC KDDM_BrkSWErrDetTO_s "" VALUE 0x0000 /* @ECU_Address@KDDM_BrkSWErrDetTO_s@ */ Scalar_FLOAT32_IEEE 0 SWC_DDM_type_CM_single_sec 0.0 86400.0 /end CHARACTERISTIC
/begin CHARACTERISTIC KDDM_BrkSWErrPassTO_s "" VALUE 0x0000 /* @ECU_Address@KDDM_BrkSWErrPassTO_s@ */ Scalar_FLOAT32_IEEE 0 SWC_DDM_type_CM_single_sec 0.0 86400.0 /end CHARACTERISTIC
/begin CHARACTERISTIC KDDM_BrkSWNoBacDetTO_s "" VALUE 0x0000 /* @ECU_Address@KDDM_BrkSWNoBacDetTO_s@ */ Scalar_FLOAT32_IEEE 0 SWC_DDM_type_CM_single_sec 0.0 86400.0 /end CHARACTERISTIC
/begin CHARACTERISTIC KDDM_BrkSWNoBacPassTO_s "" VALUE 0x0000 /* @ECU_Address@KDDM_BrkSWNoBacPassTO_s@ */ Scalar_FLOAT32_IEEE 0 SWC_DDM_type_CM_single_sec 0.0 86400.0 /end CHARACTERISTIC
/begin CHARACTERISTIC KDDM_C1ABM1CSDetTO_s "" VALUE 0x0000 /* @ECU_Address@KDDM_C1ABM1CSDetTO_s@ */ Scalar_FLOAT32_IEEE 0 SWC_DDM_type_CM_single_sec 0.0 6000.0 /end CHARACTERISTIC
/begin CHARACTERISTIC KDDM_C1ABM1CSPassTO_s "" VALUE 0x0000 /* @ECU_Address@KDDM_C1ABM1CSPassTO_s@ */ Scalar_FLOAT32_IEEE 0 SWC_DDM_type_CM_single_sec 0.0 6000.0 /end CHARACTERISTIC
/begin CHARACTERISTIC KDDM_C1ABM1LCDetTO_s "" VALUE 0x0000 /* @ECU_Address@KDDM_C1ABM1LCDetTO_s@ */ Scalar_FLOAT32_IEEE 0 SWC_DDM_type_CM_single_sec 0.0 86400.0 /end CHARACTERISTIC
/begin CHARACTERISTIC KDDM_C1ABM1LCPassTO_s "" VALUE 0x0000 /* @ECU_Address@KDDM_C1ABM1LCPassTO_s@ */ Scalar_FLOAT32_IEEE 0 SWC_DDM_type_CM_single_sec 0.0 86400.0 /end CHARACTERISTIC
/begin CHARACTERISTIC KDDM_C1ABM1RCDetTO_s "" VALUE 0x0000 /* @ECU_Address@KDDM_C1ABM1RCDetTO_s@ */ Scalar_FLOAT32_IEEE 0 SWC_DDM_type_CM_single_sec 0.0 86400.0 /end CHARACTERISTIC
/begin CHARACTERISTIC KDDM_C1ABM1RCPassTO_s "" VALUE 0x0000 /* @ECU_Address@KDDM_C1ABM1RCPassTO_s@ */ Scalar_FLOAT32_IEEE 0 SWC_DDM_type_CM_single_sec 0.0 86400.0 /end CHARACTERISTIC
/begin CHARACTERISTIC KDDM_C3BMS1CSDetTO_s "" VALUE 0x0000 /* @ECU_Address@KDDM_C3BMS1CSDetTO_s@ */ Scalar_FLOAT32_IEEE 0 SWC_DDM_type_CM_single_sec 0.0 86400.0 /end CHARACTERISTIC
/begin CHARACTERISTIC KDDM_C3BMS1CSPassTO_s "" VALUE 0x0000 /* @ECU_Address@KDDM_C3BMS1CSPassTO_s@ */ Scalar_FLOAT32_IEEE 0 SWC_DDM_type_CM_single_sec 0.0 86400.0 /end CHARACTERISTIC
/begin CHARACTERISTIC KDDM_C3BMS1LCDetTO_s "" VALUE 0x0000 /* @ECU_Address@KDDM_C3BMS1LCDetTO_s@ */ Scalar_FLOAT32_IEEE 0 SWC_DDM_type_CM_single_sec 0.0 86400.0 /end CHARACTERISTIC
/begin CHARACTERISTIC KDDM_C3BMS1LCPassTO_s "" VALUE 0x0000 /* @ECU_Address@KDDM_C3BMS1LCPassTO_s@ */ Scalar_FLOAT32_IEEE 0 SWC_DDM_type_CM_single_sec 0.0 86400.0 /end CHARACTERISTIC
/begin CHARACTERISTIC KDDM_C3BMS1RCDetTO_s "" VALUE 0x0000 /* @ECU_Address@KDDM_C3BMS1RCDetTO_s@ */ Scalar_FLOAT32_IEEE 0 SWC_DDM_type_CM_single_sec 0.0 86400.0 /end CHARACTERISTIC
/begin CHARACTERISTIC KDDM_C3BMS1RCPassTO_s "" VALUE 0x0000 /* @ECU_Address@KDDM_C3BMS1RCPassTO_s@ */ Scalar_FLOAT32_IEEE 0 SWC_DDM_type_CM_single_sec 0.0 86400.0 /end CHARACTERISTIC
/begin CHARACTERISTIC KDDM_C3BMS6CSDetTO_s "" VALUE 0x0000 /* @ECU_Address@KDDM_C3BMS6CSDetTO_s@ */ Scalar_FLOAT32_IEEE 0 SWC_DDM_type_CM_single_sec 0.0 86400.0 /end CHARACTERISTIC
/begin CHARACTERISTIC KDDM_C3BMS6CSPassTO_s "" VALUE 0x0000 /* @ECU_Address@KDDM_C3BMS6CSPassTO_s@ */ Scalar_FLOAT32_IEEE 0 SWC_DDM_type_CM_single_sec 0.0 86400.0 /end CHARACTERISTIC
/begin CHARACTERISTIC KDDM_C3BMS6LCDetTO_s "" VALUE 0x0000 /* @ECU_Address@KDDM_C3BMS6LCDetTO_s@ */ Scalar_FLOAT32_IEEE 0 SWC_DDM_type_CM_single_sec 0.0 86400.0 /end CHARACTERISTIC
/begin CHARACTERISTIC KDDM_C3BMS6LCPassTO_s "" VALUE 0x0000 /* @ECU_Address@KDDM_C3BMS6LCPassTO_s@ */ Scalar_FLOAT32_IEEE 0 SWC_DDM_type_CM_single_sec 0.0 86400.0 /end CHARACTERISTIC
/begin CHARACTERISTIC KDDM_C3BMS6RCDetTO_s "" VALUE 0x0000 /* @ECU_Address@KDDM_C3BMS6RCDetTO_s@ */ Scalar_FLOAT32_IEEE 0 SWC_DDM_type_CM_single_sec 0.0 86400.0 /end CHARACTERISTIC
/begin CHARACTERISTIC KDDM_C3BMS6RCPassTO_s "" VALUE 0x0000 /* @ECU_Address@KDDM_C3BMS6RCPassTO_s@ */ Scalar_FLOAT32_IEEE 0 SWC_DDM_type_CM_single_sec 0.0 86400.0 /end CHARACTERISTIC
/begin CHARACTERISTIC KDDM_C3CCU1CSDetTO_s "" VALUE 0x0000 /* @ECU_Address@KDDM_C3CCU1CSDetTO_s@ */ Scalar_FLOAT32_IEEE 0 SWC_DDM_type_CM_single_sec 0.0 86400.0 /end CHARACTERISTIC
/begin CHARACTERISTIC KDDM_C3CCU1CSPassTO_s "" VALUE 0x0000 /* @ECU_Address@KDDM_C3CCU1CSPassTO_s@ */ Scalar_FLOAT32_IEEE 0 SWC_DDM_type_CM_single_sec 0.0 86400.0 /end CHARACTERISTIC
/begin CHARACTERISTIC KDDM_C3CCU1LCDetTO_s "" VALUE 0x0000 /* @ECU_Address@KDDM_C3CCU1LCDetTO_s@ */ Scalar_FLOAT32_IEEE 0 SWC_DDM_type_CM_single_sec 0.0 86400.0 /end CHARACTERISTIC
/begin CHARACTERISTIC KDDM_C3CCU1LCPassTO_s "" VALUE 0x0000 /* @ECU_Address@KDDM_C3CCU1LCPassTO_s@ */ Scalar_FLOAT32_IEEE 0 SWC_DDM_type_CM_single_sec 0.0 86400.0 /end CHARACTERISTIC
/begin CHARACTERISTIC KDDM_C3CCU1RCDetTO_s "" VALUE 0x0000 /* @ECU_Address@KDDM_C3CCU1RCDetTO_s@ */ Scalar_FLOAT32_IEEE 0 SWC_DDM_type_CM_single_sec 0.0 86400.0 /end CHARACTERISTIC
/begin CHARACTERISTIC KDDM_C3CCU1RCPassTO_s "" VALUE 0x0000 /* @ECU_Address@KDDM_C3CCU1RCPassTO_s@ */ Scalar_FLOAT32_IEEE 0 SWC_DDM_type_CM_single_sec 0.0 86400.0 /end CHARACTERISTIC
/begin CHARACTERISTIC KDDM_C3CCU2CSDetTO_s "" VALUE 0x0000 /* @ECU_Address@KDDM_C3CCU2CSDetTO_s@ */ Scalar_FLOAT32_IEEE 0 SWC_DDM_type_CM_single_sec 0.0 86400.0 /end CHARACTERISTIC
/begin CHARACTERISTIC KDDM_C3CCU2CSPassTO_s "" VALUE 0x0000 /* @ECU_Address@KDDM_C3CCU2CSPassTO_s@ */ Scalar_FLOAT32_IEEE 0 SWC_DDM_type_CM_single_sec 0.0 86400.0 /end CHARACTERISTIC
/begin CHARACTERISTIC KDDM_C3CCU2LCDetTO_s "" VALUE 0x0000 /* @ECU_Address@KDDM_C3CCU2LCDetTO_s@ */ Scalar_FLOAT32_IEEE 0 SWC_DDM_type_CM_single_sec 0.0 86400.0 /end CHARACTERISTIC
/begin CHARACTERISTIC KDDM_C3CCU2LCPassTO_s "" VALUE 0x0000 /* @ECU_Address@KDDM_C3CCU2LCPassTO_s@ */ Scalar_FLOAT32_IEEE 0 SWC_DDM_type_CM_single_sec 0.0 86400.0 /end CHARACTERISTIC
/begin CHARACTERISTIC KDDM_C3CCU2RCDetTO_s "" VALUE 0x0000 /* @ECU_Address@KDDM_C3CCU2RCDetTO_s@ */ Scalar_FLOAT32_IEEE 0 SWC_DDM_type_CM_single_sec 0.0 86400.0 /end CHARACTERISTIC
/begin CHARACTERISTIC KDDM_C3CCU2RCPassTO_s "" VALUE 0x0000 /* @ECU_Address@KDDM_C3CCU2RCPassTO_s@ */ Scalar_FLOAT32_IEEE 0 SWC_DDM_type_CM_single_sec 0.0 86400.0 /end CHARACTERISTIC
/begin CHARACTERISTIC KDDM_DrStSWDetTO_s "" VALUE 0x0000 /* @ECU_Address@KDDM_DrStSWDetTO_s@ */ Scalar_FLOAT32_IEEE 0 SWC_DDM_type_CM_single_sec 0.0 86400.0 /end CHARACTERISTIC
/begin CHARACTERISTIC KDDM_DrStSWPassTO_s "" VALUE 0x0000 /* @ECU_Address@KDDM_DrStSWPassTO_s@ */ Scalar_FLOAT32_IEEE 0 SWC_DDM_type_CM_single_sec 0.0 86400.0 /end CHARACTERISTIC
/begin CHARACTERISTIC KDDM_DrStSW_s "" VALUE 0x0000 /* @ECU_Address@KDDM_DrStSW_s@ */ Scalar_FLOAT32_IEEE 0 SWC_DDM_type_CM_single_sec 0.0 86400.0 /end CHARACTERISTIC
/begin CHARACTERISTIC KDDM_DrVCUNoComDetTO_s "" VALUE 0x0000 /* @ECU_Address@KDDM_DrVCUNoComDetTO_s@ */ Scalar_FLOAT32_IEEE 0 SWC_DDM_type_CM_single_sec 0.0 3600.0 /end CHARACTERISTIC
/begin CHARACTERISTIC KDDM_DrVCUNoComPassTO_s "" VALUE 0x0000 /* @ECU_Address@KDDM_DrVCUNoComPassTO_s@ */ Scalar_FLOAT32_IEEE 0 SWC_DDM_type_CM_single_sec 0.0 3600.0 /end CHARACTERISTIC
/begin CHARACTERISTIC KDDM_DwnDetWinBrkPos_pct "" VALUE 0x0000 /* @ECU_Address@KDDM_DwnDetWinBrkPos_pct@ */ Scalar_FLOAT32_IEEE 0 SWC_DDM_type_CM_single_pct 0.0 100.0 /end CHARACTERISTIC
/begin CHARACTERISTIC KDDM_EPB1CSErrDetTO_s "" VALUE 0x0000 /* @ECU_Address@KDDM_EPB1CSErrDetTO_s@ */ Scalar_FLOAT32_IEEE 0 SWC_DDM_type_CM_single_sec 0.0 10.0 /end CHARACTERISTIC
/begin CHARACTERISTIC KDDM_EPB1CSErrPassTO_s "" VALUE 0x0000 /* @ECU_Address@KDDM_EPB1CSErrPassTO_s@ */ Scalar_FLOAT32_IEEE 0 SWC_DDM_type_CM_single_sec 0.0 10.0 /end CHARACTERISTIC
/begin CHARACTERISTIC KDDM_EPB1NoComDetTO_s "" VALUE 0x0000 /* @ECU_Address@KDDM_EPB1NoComDetTO_s@ */ Scalar_FLOAT32_IEEE 0 SWC_DDM_type_CM_single_sec 0.0 10.0 /end CHARACTERISTIC
/begin CHARACTERISTIC KDDM_EPB1NoComPassTO_s "" VALUE 0x0000 /* @ECU_Address@KDDM_EPB1NoComPassTO_s@ */ Scalar_FLOAT32_IEEE 0 SWC_DDM_type_CM_single_sec 0.0 10.0 /end CHARACTERISTIC
/begin CHARACTERISTIC KDDM_EPB1RCErrDetTO_s "" VALUE 0x0000 /* @ECU_Address@KDDM_EPB1RCErrDetTO_s@ */ Scalar_FLOAT32_IEEE 0 SWC_DDM_type_CM_single_sec 0.0 10.0 /end CHARACTERISTIC
/begin CHARACTERISTIC KDDM_EPB1RCErrPassTO_s "" VALUE 0x0000 /* @ECU_Address@KDDM_EPB1RCErrPassTO_s@ */ Scalar_FLOAT32_IEEE 0 SWC_DDM_type_CM_single_sec 0.0 10.0 /end CHARACTERISTIC
/begin CHARACTERISTIC KDDM_EPBLockTODetTO_s "" VALUE 0x0000 /* @ECU_Address@KDDM_EPBLockTODetTO_s@ */ Scalar_FLOAT32_IEEE 0 SWC_DDM_type_CM_single_sec 0.0 10.0 /end CHARACTERISTIC
/begin CHARACTERISTIC KDDM_EPBLockTOPassTO_s "" VALUE 0x0000 /* @ECU_Address@KDDM_EPBLockTOPassTO_s@ */ Scalar_FLOAT32_IEEE 0 SWC_DDM_type_CM_single_sec 0.0 10.0 /end CHARACTERISTIC
/begin CHARACTERISTIC KDDM_EPBSigErrDetTO_s "" VALUE 0x0000 /* @ECU_Address@KDDM_EPBSigErrDetTO_s@ */ Scalar_FLOAT32_IEEE 0 SWC_DDM_type_CM_single_sec 0.0 10.0 /end CHARACTERISTIC
/begin CHARACTERISTIC KDDM_EPBSigErrPassTO_s "" VALUE 0x0000 /* @ECU_Address@KDDM_EPBSigErrPassTO_s@ */ Scalar_FLOAT32_IEEE 0 SWC_DDM_type_CM_single_sec 0.0 10.0 /end CHARACTERISTIC
/begin CHARACTERISTIC KDDM_EPBUnlockTODetTO_s "" VALUE 0x0000 /* @ECU_Address@KDDM_EPBUnlockTODetTO_s@ */ Scalar_FLOAT32_IEEE 0 SWC_DDM_type_CM_single_sec 0.0 10.0 /end CHARACTERISTIC
/begin CHARACTERISTIC KDDM_EPBUnlockTOPassTO_s "" VALUE 0x0000 /* @ECU_Address@KDDM_EPBUnlockTOPassTO_s@ */ Scalar_FLOAT32_IEEE 0 SWC_DDM_type_CM_single_sec 0.0 10.0 /end CHARACTERISTIC
/begin CHARACTERISTIC KDDM_ESC1CSErrDetTO_s "" VALUE 0x0000 /* @ECU_Address@KDDM_ESC1CSErrDetTO_s@ */ Scalar_FLOAT32_IEEE 0 SWC_DDM_type_CM_single_sec 0.0 10.0 /end CHARACTERISTIC
/begin CHARACTERISTIC KDDM_ESC1CSErrPassTO_s "" VALUE 0x0000 /* @ECU_Address@KDDM_ESC1CSErrPassTO_s@ */ Scalar_FLOAT32_IEEE 0 SWC_DDM_type_CM_single_sec 0.0 10.0 /end CHARACTERISTIC
/begin CHARACTERISTIC KDDM_ESC1NoComDetTO_s "" VALUE 0x0000 /* @ECU_Address@KDDM_ESC1NoComDetTO_s@ */ Scalar_FLOAT32_IEEE 0 SWC_DDM_type_CM_single_sec 0.0 10.0 /end CHARACTERISTIC
/begin CHARACTERISTIC KDDM_ESC1NoComPassTO_s "" VALUE 0x0000 /* @ECU_Address@KDDM_ESC1NoComPassTO_s@ */ Scalar_FLOAT32_IEEE 0 SWC_DDM_type_CM_single_sec 0.0 10.0 /end CHARACTERISTIC
/begin CHARACTERISTIC KDDM_ESC1RCErrDetTO_s "" VALUE 0x0000 /* @ECU_Address@KDDM_ESC1RCErrDetTO_s@ */ Scalar_FLOAT32_IEEE 0 SWC_DDM_type_CM_single_sec 0.0 10.0 /end CHARACTERISTIC
/begin CHARACTERISTIC KDDM_ESC1RCErrPassTO_s "" VALUE 0x0000 /* @ECU_Address@KDDM_ESC1RCErrPassTO_s@ */ Scalar_FLOAT32_IEEE 0 SWC_DDM_type_CM_single_sec 0.0 10.0 /end CHARACTERISTIC
/begin CHARACTERISTIC KDDM_ESC5CSErrDetTO_s "" VALUE 0x0000 /* @ECU_Address@KDDM_ESC5CSErrDetTO_s@ */ Scalar_FLOAT32_IEEE 0 SWC_DDM_type_CM_single_sec 0.0 10.0 /end CHARACTERISTIC
/begin CHARACTERISTIC KDDM_ESC5CSErrPassTO_s "" VALUE 0x0000 /* @ECU_Address@KDDM_ESC5CSErrPassTO_s@ */ Scalar_FLOAT32_IEEE 0 SWC_DDM_type_CM_single_sec 0.0 10.0 /end CHARACTERISTIC
/begin CHARACTERISTIC KDDM_ESC5NoComDetTO_s "" VALUE 0x0000 /* @ECU_Address@KDDM_ESC5NoComDetTO_s@ */ Scalar_FLOAT32_IEEE 0 SWC_DDM_type_CM_single_sec 0.0 10.0 /end CHARACTERISTIC
/begin CHARACTERISTIC KDDM_ESC5NoComPassTO_s "" VALUE 0x0000 /* @ECU_Address@KDDM_ESC5NoComPassTO_s@ */ Scalar_FLOAT32_IEEE 0 SWC_DDM_type_CM_single_sec 0.0 10.0 /end CHARACTERISTIC
/begin CHARACTERISTIC KDDM_ESC5RCErrDetTO_s "" VALUE 0x0000 /* @ECU_Address@KDDM_ESC5RCErrDetTO_s@ */ Scalar_FLOAT32_IEEE 0 SWC_DDM_type_CM_single_sec 0.0 10.0 /end CHARACTERISTIC
/begin CHARACTERISTIC KDDM_ESC5RCErrPassTO_s "" VALUE 0x0000 /* @ECU_Address@KDDM_ESC5RCErrPassTO_s@ */ Scalar_FLOAT32_IEEE 0 SWC_DDM_type_CM_single_sec 0.0 10.0 /end CHARACTERISTIC
/begin CHARACTERISTIC KDDM_FLDoorSWDetTO_s "" VALUE 0x0000 /* @ECU_Address@KDDM_FLDoorSWDetTO_s@ */ Scalar_FLOAT32_IEEE 0 SWC_DDM_type_CM_single_sec 0.0 86400.0 /end CHARACTERISTIC
/begin CHARACTERISTIC KDDM_FLDoorSWPassTO_s "" VALUE 0x0000 /* @ECU_Address@KDDM_FLDoorSWPassTO_s@ */ Scalar_FLOAT32_IEEE 0 SWC_DDM_type_CM_single_sec 0.0 86400.0 /end CHARACTERISTIC
/begin CHARACTERISTIC KDDM_FLDoorSW_s "" VALUE 0x0000 /* @ECU_Address@KDDM_FLDoorSW_s@ */ Scalar_FLOAT32_IEEE 0 SWC_DDM_type_CM_single_sec 0.0 86400.0 /end CHARACTERISTIC
/begin CHARACTERISTIC KDDM_FRDoorSWDetTO_s "" VALUE 0x0000 /* @ECU_Address@KDDM_FRDoorSWDetTO_s@ */ Scalar_FLOAT32_IEEE 0 SWC_DDM_type_CM_single_sec 0.0 86400.0 /end CHARACTERISTIC
/begin CHARACTERISTIC KDDM_FRDoorSWPassTO_s "" VALUE 0x0000 /* @ECU_Address@KDDM_FRDoorSWPassTO_s@ */ Scalar_FLOAT32_IEEE 0 SWC_DDM_type_CM_single_sec 0.0 86400.0 /end CHARACTERISTIC
/begin CHARACTERISTIC KDDM_FRDoorSW_s "" VALUE 0x0000 /* @ECU_Address@KDDM_FRDoorSW_s@ */ Scalar_FLOAT32_IEEE 0 SWC_DDM_type_CM_single_sec 0.0 86400.0 /end CHARACTERISTIC
/begin CHARACTERISTIC KDDM_FrMCUTqErrDetTO_s "" VALUE 0x0000 /* @ECU_Address@KDDM_FrMCUTqErrDetTO_s@ */ Scalar_FLOAT32_IEEE 0 SWC_DDM_type_CM_single_sec 0.0 10.0 /end CHARACTERISTIC
/begin CHARACTERISTIC KDDM_FrMCUTqErrPassTO_s "" VALUE 0x0000 /* @ECU_Address@KDDM_FrMCUTqErrPassTO_s@ */ Scalar_FLOAT32_IEEE 0 SWC_DDM_type_CM_single_sec 0.0 10.0 /end CHARACTERISTIC
/begin CHARACTERISTIC KDDM_FrVCUNoComDetTO_s "" VALUE 0x0000 /* @ECU_Address@KDDM_FrVCUNoComDetTO_s@ */ Scalar_FLOAT32_IEEE 0 SWC_DDM_type_CM_single_sec 0.0 3600.0 /end CHARACTERISTIC
/begin CHARACTERISTIC KDDM_FrVCUNoComPassTO_s "" VALUE 0x0000 /* @ECU_Address@KDDM_FrVCUNoComPassTO_s@ */ Scalar_FLOAT32_IEEE 0 SWC_DDM_type_CM_single_sec 0.0 3600.0 /end CHARACTERISTIC
/begin CHARACTERISTIC KDDM_HVRlyCloDetTO_s "" VALUE 0x0000 /* @ECU_Address@KDDM_HVRlyCloDetTO_s@ */ Scalar_FLOAT32_IEEE 0 SWC_DDM_type_CM_single_sec 0.0 86400.0 /end CHARACTERISTIC
/begin CHARACTERISTIC KDDM_HVRlyCloPassTO_s "" VALUE 0x0000 /* @ECU_Address@KDDM_HVRlyCloPassTO_s@ */ Scalar_FLOAT32_IEEE 0 SWC_DDM_type_CM_single_sec 0.0 86400.0 /end CHARACTERISTIC
/begin CHARACTERISTIC KDDM_HVRlyOpDetTO_s "" VALUE 0x0000 /* @ECU_Address@KDDM_HVRlyOpDetTO_s@ */ Scalar_FLOAT32_IEEE 0 SWC_DDM_type_CM_single_sec 0.0 86400.0 /end CHARACTERISTIC
/begin CHARACTERISTIC KDDM_HVRlyOpPassTO_s "" VALUE 0x0000 /* @ECU_Address@KDDM_HVRlyOpPassTO_s@ */ Scalar_FLOAT32_IEEE 0 SWC_DDM_type_CM_single_sec 0.0 86400.0 /end CHARACTERISTIC
/begin CHARACTERISTIC KDDM_HoodSWDetTO_s "" VALUE 0x0000 /* @ECU_Address@KDDM_HoodSWDetTO_s@ */ Scalar_FLOAT32_IEEE 0 SWC_DDM_type_CM_single_sec 0.0 86400.0 /end CHARACTERISTIC
/begin CHARACTERISTIC KDDM_HoodSWPassTO_s "" VALUE 0x0000 /* @ECU_Address@KDDM_HoodSWPassTO_s@ */ Scalar_FLOAT32_IEEE 0 SWC_DDM_type_CM_single_sec 0.0 86400.0 /end CHARACTERISTIC
/begin CHARACTERISTIC KDDM_HoodSW_s "" VALUE 0x0000 /* @ECU_Address@KDDM_HoodSW_s@ */ Scalar_FLOAT32_IEEE 0 SWC_DDM_type_CM_single_sec 0.0 86400.0 /end CHARACTERISTIC
/begin CHARACTERISTIC KDDM_IniLVLoDetTO_s "" VALUE 0x0000 /* @ECU_Address@KDDM_IniLVLoDetTO_s@ */ Scalar_FLOAT32_IEEE 0 SWC_DDM_type_CM_single_sec 0.0 86400.0 /end CHARACTERISTIC
/begin CHARACTERISTIC KDDM_IniLVLoPassTO_s "" VALUE 0x0000 /* @ECU_Address@KDDM_IniLVLoPassTO_s@ */ Scalar_FLOAT32_IEEE 0 SWC_DDM_type_CM_single_sec 0.0 86400.0 /end CHARACTERISTIC
/begin CHARACTERISTIC KDDM_IniLVLoThd_mv "" VALUE 0x0000 /* @ECU_Address@KDDM_IniLVLoThd_mv@ */ Scalar_FLOAT32_IEEE 0 SWC_DDM_type_CM_single_mv 0.0 86400.0 /end CHARACTERISTIC
/begin CHARACTERISTIC KDDM_KeyAuthDetTO_s "" VALUE 0x0000 /* @ECU_Address@KDDM_KeyAuthDetTO_s@ */ Scalar_FLOAT32_IEEE 0 SWC_DDM_type_CM_single_sec 0.0 86400.0 /end CHARACTERISTIC
/begin CHARACTERISTIC KDDM_KeyAuthPassTO_s "" VALUE 0x0000 /* @ECU_Address@KDDM_KeyAuthPassTO_s@ */ Scalar_FLOAT32_IEEE 0 SWC_DDM_type_CM_single_sec 0.0 86400.0 /end CHARACTERISTIC
/begin CHARACTERISTIC KDDM_LFBatwarnDetTO_s "" VALUE 0x0000 /* @ECU_Address@KDDM_LFBatwarnDetTO_s@ */ Scalar_FLOAT32_IEEE 0 SWC_DDM_type_CM_single_sec 0.0 10.0 /end CHARACTERISTIC
/begin CHARACTERISTIC KDDM_LFBatwarnPassTO_s "" VALUE 0x0000 /* @ECU_Address@KDDM_LFBatwarnPassTO_s@ */ Scalar_FLOAT32_IEEE 0 SWC_DDM_type_CM_single_sec 0.0 10.0 /end CHARACTERISTIC
/begin CHARACTERISTIC KDDM_LFPressIndiDetTO_s "" VALUE 0x0000 /* @ECU_Address@KDDM_LFPressIndiDetTO_s@ */ Scalar_FLOAT32_IEEE 0 SWC_DDM_type_CM_single_sec 0.0 10.0 /end CHARACTERISTIC
/begin CHARACTERISTIC KDDM_LFPressIndiPassTO_s "" VALUE 0x0000 /* @ECU_Address@KDDM_LFPressIndiPassTO_s@ */ Scalar_FLOAT32_IEEE 0 SWC_DDM_type_CM_single_sec 0.0 10.0 /end CHARACTERISTIC
/begin CHARACTERISTIC KDDM_LFSensorFailDetTO_s "" VALUE 0x0000 /* @ECU_Address@KDDM_LFSensorFailDetTO_s@ */ Scalar_FLOAT32_IEEE 0 SWC_DDM_type_CM_single_sec 0.0 10.0 /end CHARACTERISTIC
/begin CHARACTERISTIC KDDM_LFSensorFailPassTO_s "" VALUE 0x0000 /* @ECU_Address@KDDM_LFSensorFailPassTO_s@ */ Scalar_FLOAT32_IEEE 0 SWC_DDM_type_CM_single_sec 0.0 10.0 /end CHARACTERISTIC
/begin CHARACTERISTIC KDDM_LFWheelTmpHighDetTO_s "" VALUE 0x0000 /* @ECU_Address@KDDM_LFWheelTmpHighDetTO_s@ */ Scalar_FLOAT32_IEEE 0 SWC_DDM_type_CM_single_sec 0.0 10.0 /end CHARACTERISTIC
/begin CHARACTERISTIC KDDM_LFWheelTmpHighPassTO_s "" VALUE 0x0000 /* @ECU_Address@KDDM_LFWheelTmpHighPassTO_s@ */ Scalar_FLOAT32_IEEE 0 SWC_DDM_type_CM_single_sec 0.0 10.0 /end CHARACTERISTIC
/begin CHARACTERISTIC KDDM_LRBatwarnDetTO_s "" VALUE 0x0000 /* @ECU_Address@KDDM_LRBatwarnDetTO_s@ */ Scalar_FLOAT32_IEEE 0 SWC_DDM_type_CM_single_sec 0.0 10.0 /end CHARACTERISTIC
/begin CHARACTERISTIC KDDM_LRBatwarnPassTO_s "" VALUE 0x0000 /* @ECU_Address@KDDM_LRBatwarnPassTO_s@ */ Scalar_FLOAT32_IEEE 0 SWC_DDM_type_CM_single_sec 0.0 10.0 /end CHARACTERISTIC
/begin CHARACTERISTIC KDDM_LRPressIndiDetTO_s "" VALUE 0x0000 /* @ECU_Address@KDDM_LRPressIndiDetTO_s@ */ Scalar_FLOAT32_IEEE 0 SWC_DDM_type_CM_single_sec 0.0 10.0 /end CHARACTERISTIC
/begin CHARACTERISTIC KDDM_LRPressIndiPassTO_s "" VALUE 0x0000 /* @ECU_Address@KDDM_LRPressIndiPassTO_s@ */ Scalar_FLOAT32_IEEE 0 SWC_DDM_type_CM_single_sec 0.0 10.0 /end CHARACTERISTIC
/begin CHARACTERISTIC KDDM_LRSensorFailDetTO_s "" VALUE 0x0000 /* @ECU_Address@KDDM_LRSensorFailDetTO_s@ */ Scalar_FLOAT32_IEEE 0 SWC_DDM_type_CM_single_sec 0.0 10.0 /end CHARACTERISTIC
/begin CHARACTERISTIC KDDM_LRSensorFailPassTO_s "" VALUE 0x0000 /* @ECU_Address@KDDM_LRSensorFailPassTO_s@ */ Scalar_FLOAT32_IEEE 0 SWC_DDM_type_CM_single_sec 0.0 10.0 /end CHARACTERISTIC
/begin CHARACTERISTIC KDDM_LRWheelTmpHighDetTO_s "" VALUE 0x0000 /* @ECU_Address@KDDM_LRWheelTmpHighDetTO_s@ */ Scalar_FLOAT32_IEEE 0 SWC_DDM_type_CM_single_sec 0.0 10.0 /end CHARACTERISTIC
/begin CHARACTERISTIC KDDM_LRWheelTmpHighPassTO_s "" VALUE 0x0000 /* @ECU_Address@KDDM_LRWheelTmpHighPassTO_s@ */ Scalar_FLOAT32_IEEE 0 SWC_DDM_type_CM_single_sec 0.0 10.0 /end CHARACTERISTIC
/begin CHARACTERISTIC KDDM_LVInErrDetTO_s "" VALUE 0x0000 /* @ECU_Address@KDDM_LVInErrDetTO_s@ */ Scalar_FLOAT32_IEEE 0 SWC_DDM_type_CM_single_sec 0.0 3600.0 /end CHARACTERISTIC
/begin CHARACTERISTIC KDDM_LVInErrPassTO_s "" VALUE 0x0000 /* @ECU_Address@KDDM_LVInErrPassTO_s@ */ Scalar_FLOAT32_IEEE 0 SWC_DDM_type_CM_single_sec 0.0 3600.0 /end CHARACTERISTIC
/begin CHARACTERISTIC KDDM_LVSupHiDetTO_s "" VALUE 0x0000 /* @ECU_Address@KDDM_LVSupHiDetTO_s@ */ Scalar_FLOAT32_IEEE 0 SWC_DDM_type_CM_single_sec 0.0 86400.0 /end CHARACTERISTIC
/begin CHARACTERISTIC KDDM_LVSupHiPassTO_s "" VALUE 0x0000 /* @ECU_Address@KDDM_LVSupHiPassTO_s@ */ Scalar_FLOAT32_IEEE 0 SWC_DDM_type_CM_single_sec 0.0 86400.0 /end CHARACTERISTIC
/begin CHARACTERISTIC KDDM_LVSupHiThd_mv "" VALUE 0x0000 /* @ECU_Address@KDDM_LVSupHiThd_mv@ */ Scalar_FLOAT32_IEEE 0 SWC_DDM_type_CM_single_mv 0.0 86400.0 /end CHARACTERISTIC
/begin CHARACTERISTIC KDDM_LVSupLoDetTO_s "" VALUE 0x0000 /* @ECU_Address@KDDM_LVSupLoDetTO_s@ */ Scalar_FLOAT32_IEEE 0 SWC_DDM_type_CM_single_sec 0.0 86400.0 /end CHARACTERISTIC
/begin CHARACTERISTIC KDDM_LVSupLoPassTO_s "" VALUE 0x0000 /* @ECU_Address@KDDM_LVSupLoPassTO_s@ */ Scalar_FLOAT32_IEEE 0 SWC_DDM_type_CM_single_sec 0.0 86400.0 /end CHARACTERISTIC
/begin CHARACTERISTIC KDDM_LVSupLoThd_mv "" VALUE 0x0000 /* @ECU_Address@KDDM_LVSupLoThd_mv@ */ Scalar_FLOAT32_IEEE 0 SWC_DDM_type_CM_single_mv 0.0 86400.0 /end CHARACTERISTIC
/begin CHARACTERISTIC KDDM_Lv1ErrDetTO_s "" VALUE 0x0000 /* @ECU_Address@KDDM_Lv1ErrDetTO_s@ */ Scalar_FLOAT32_IEEE 0 SWC_DDM_type_CM_single_sec 0.0 86400.0 /end CHARACTERISTIC
/begin CHARACTERISTIC KDDM_Lv1ErrPassTO_s "" VALUE 0x0000 /* @ECU_Address@KDDM_Lv1ErrPassTO_s@ */ Scalar_FLOAT32_IEEE 0 SWC_DDM_type_CM_single_sec 0.0 86400.0 /end CHARACTERISTIC
/begin CHARACTERISTIC KDDM_Lv2ErrDetTO_s "" VALUE 0x0000 /* @ECU_Address@KDDM_Lv2ErrDetTO_s@ */ Scalar_FLOAT32_IEEE 0 SWC_DDM_type_CM_single_sec 0.0 86400.0 /end CHARACTERISTIC
/begin CHARACTERISTIC KDDM_Lv2ErrPassTO_s "" VALUE 0x0000 /* @ECU_Address@KDDM_Lv2ErrPassTO_s@ */ Scalar_FLOAT32_IEEE 0 SWC_DDM_type_CM_single_sec 0.0 86400.0 /end CHARACTERISTIC
/begin CHARACTERISTIC KDDM_Lv3ErrDetTO_s "" VALUE 0x0000 /* @ECU_Address@KDDM_Lv3ErrDetTO_s@ */ Scalar_FLOAT32_IEEE 0 SWC_DDM_type_CM_single_sec 0.0 86400.0 /end CHARACTERISTIC
/begin CHARACTERISTIC KDDM_Lv3ErrPassTO_s "" VALUE 0x0000 /* @ECU_Address@KDDM_Lv3ErrPassTO_s@ */ Scalar_FLOAT32_IEEE 0 SWC_DDM_type_CM_single_sec 0.0 86400.0 /end CHARACTERISTIC
/begin CHARACTERISTIC KDDM_Lv4ErrDetTO_s "" VALUE 0x0000 /* @ECU_Address@KDDM_Lv4ErrDetTO_s@ */ Scalar_FLOAT32_IEEE 0 SWC_DDM_type_CM_single_sec 0.0 86400.0 /end CHARACTERISTIC
/begin CHARACTERISTIC KDDM_Lv4ErrPassTO_s "" VALUE 0x0000 /* @ECU_Address@KDDM_Lv4ErrPassTO_s@ */ Scalar_FLOAT32_IEEE 0 SWC_DDM_type_CM_single_sec 0.0 86400.0 /end CHARACTERISTIC
/begin CHARACTERISTIC KDDM_MCUF1CSErrDetTO_s "" VALUE 0x0000 /* @ECU_Address@KDDM_MCUF1CSErrDetTO_s@ */ Scalar_FLOAT32_IEEE 0 SWC_DDM_type_CM_single_sec 0.0 10.0 /end CHARACTERISTIC
/begin CHARACTERISTIC KDDM_MCUF1CSErrPassTO_s "" VALUE 0x0000 /* @ECU_Address@KDDM_MCUF1CSErrPassTO_s@ */ Scalar_FLOAT32_IEEE 0 SWC_DDM_type_CM_single_sec 0.0 10.0 /end CHARACTERISTIC
/begin CHARACTERISTIC KDDM_MCUF1NoComDetTO_s "" VALUE 0x0000 /* @ECU_Address@KDDM_MCUF1NoComDetTO_s@ */ Scalar_FLOAT32_IEEE 0 SWC_DDM_type_CM_single_sec 0.0 10.0 /end CHARACTERISTIC
/begin CHARACTERISTIC KDDM_MCUF1NoComPassTO_s "" VALUE 0x0000 /* @ECU_Address@KDDM_MCUF1NoComPassTO_s@ */ Scalar_FLOAT32_IEEE 0 SWC_DDM_type_CM_single_sec 0.0 10.0 /end CHARACTERISTIC
/begin CHARACTERISTIC KDDM_MCUF1RCErrDetTO_s "" VALUE 0x0000 /* @ECU_Address@KDDM_MCUF1RCErrDetTO_s@ */ Scalar_FLOAT32_IEEE 0 SWC_DDM_type_CM_single_sec 0.0 10.0 /end CHARACTERISTIC
/begin CHARACTERISTIC KDDM_MCUF1RCErrPassTO_s "" VALUE 0x0000 /* @ECU_Address@KDDM_MCUF1RCErrPassTO_s@ */ Scalar_FLOAT32_IEEE 0 SWC_DDM_type_CM_single_sec 0.0 10.0 /end CHARACTERISTIC
/begin CHARACTERISTIC KDDM_MCUR1CSErrDetTO_s "" VALUE 0x0000 /* @ECU_Address@KDDM_MCUR1CSErrDetTO_s@ */ Scalar_FLOAT32_IEEE 0 SWC_DDM_type_CM_single_sec 0.0 10.0 /end CHARACTERISTIC
/begin CHARACTERISTIC KDDM_MCUR1CSErrPassTO_s "" VALUE 0x0000 /* @ECU_Address@KDDM_MCUR1CSErrPassTO_s@ */ Scalar_FLOAT32_IEEE 0 SWC_DDM_type_CM_single_sec 0.0 10.0 /end CHARACTERISTIC
/begin CHARACTERISTIC KDDM_MCUR1NoComDetTO_s "" VALUE 0x0000 /* @ECU_Address@KDDM_MCUR1NoComDetTO_s@ */ Scalar_FLOAT32_IEEE 0 SWC_DDM_type_CM_single_sec 0.0 10.0 /end CHARACTERISTIC
/begin CHARACTERISTIC KDDM_MCUR1NoComPassTO_s "" VALUE 0x0000 /* @ECU_Address@KDDM_MCUR1NoComPassTO_s@ */ Scalar_FLOAT32_IEEE 0 SWC_DDM_type_CM_single_sec 0.0 10.0 /end CHARACTERISTIC
/begin CHARACTERISTIC KDDM_MCUR1RCErrDetTO_s "" VALUE 0x0000 /* @ECU_Address@KDDM_MCUR1RCErrDetTO_s@ */ Scalar_FLOAT32_IEEE 0 SWC_DDM_type_CM_single_sec 0.0 10.0 /end CHARACTERISTIC
/begin CHARACTERISTIC KDDM_MCUR1RCErrPassTO_s "" VALUE 0x0000 /* @ECU_Address@KDDM_MCUR1RCErrPassTO_s@ */ Scalar_FLOAT32_IEEE 0 SWC_DDM_type_CM_single_sec 0.0 10.0 /end CHARACTERISTIC
/begin CHARACTERISTIC KDDM_ONtoRdyDetTO_s "" VALUE 0x0000 /* @ECU_Address@KDDM_ONtoRdyDetTO_s@ */ Scalar_FLOAT32_IEEE 0 SWC_DDM_type_CM_single_sec 0.0 86400.0 /end CHARACTERISTIC
/begin CHARACTERISTIC KDDM_ONtoRdyPassTO_s "" VALUE 0x0000 /* @ECU_Address@KDDM_ONtoRdyPassTO_s@ */ Scalar_FLOAT32_IEEE 0 SWC_DDM_type_CM_single_sec 0.0 86400.0 /end CHARACTERISTIC
/begin CHARACTERISTIC KDDM_RFBatwarnDetTO_s "" VALUE 0x0000 /* @ECU_Address@KDDM_RFBatwarnDetTO_s@ */ Scalar_FLOAT32_IEEE 0 SWC_DDM_type_CM_single_sec 0.0 10.0 /end CHARACTERISTIC
/begin CHARACTERISTIC KDDM_RFBatwarnPassTO_s "" VALUE 0x0000 /* @ECU_Address@KDDM_RFBatwarnPassTO_s@ */ Scalar_FLOAT32_IEEE 0 SWC_DDM_type_CM_single_sec 0.0 10.0 /end CHARACTERISTIC
/begin CHARACTERISTIC KDDM_RFPressIndiDetTO_s "" VALUE 0x0000 /* @ECU_Address@KDDM_RFPressIndiDetTO_s@ */ Scalar_FLOAT32_IEEE 0 SWC_DDM_type_CM_single_sec 0.0 10.0 /end CHARACTERISTIC
/begin CHARACTERISTIC KDDM_RFPressIndiPassTO_s "" VALUE 0x0000 /* @ECU_Address@KDDM_RFPressIndiPassTO_s@ */ Scalar_FLOAT32_IEEE 0 SWC_DDM_type_CM_single_sec 0.0 10.0 /end CHARACTERISTIC
/begin CHARACTERISTIC KDDM_RFSensorFailDetTO_s "" VALUE 0x0000 /* @ECU_Address@KDDM_RFSensorFailDetTO_s@ */ Scalar_FLOAT32_IEEE 0 SWC_DDM_type_CM_single_sec 0.0 10.0 /end CHARACTERISTIC
/begin CHARACTERISTIC KDDM_RFSensorFailPassTO_s "" VALUE 0x0000 /* @ECU_Address@KDDM_RFSensorFailPassTO_s@ */ Scalar_FLOAT32_IEEE 0 SWC_DDM_type_CM_single_sec 0.0 10.0 /end CHARACTERISTIC
/begin CHARACTERISTIC KDDM_RFWheelTmpHighDetTO_s "" VALUE 0x0000 /* @ECU_Address@KDDM_RFWheelTmpHighDetTO_s@ */ Scalar_FLOAT32_IEEE 0 SWC_DDM_type_CM_single_sec 0.0 10.0 /end CHARACTERISTIC
/begin CHARACTERISTIC KDDM_RFWheelTmpHighPassTO_s "" VALUE 0x0000 /* @ECU_Address@KDDM_RFWheelTmpHighPassTO_s@ */ Scalar_FLOAT32_IEEE 0 SWC_DDM_type_CM_single_sec 0.0 10.0 /end CHARACTERISTIC
/begin CHARACTERISTIC KDDM_RLDoorSWDetTO_s "" VALUE 0x0000 /* @ECU_Address@KDDM_RLDoorSWDetTO_s@ */ Scalar_FLOAT32_IEEE 0 SWC_DDM_type_CM_single_sec 0.0 86400.0 /end CHARACTERISTIC
/begin CHARACTERISTIC KDDM_RLDoorSWPassTO_s "" VALUE 0x0000 /* @ECU_Address@KDDM_RLDoorSWPassTO_s@ */ Scalar_FLOAT32_IEEE 0 SWC_DDM_type_CM_single_sec 0.0 86400.0 /end CHARACTERISTIC
/begin CHARACTERISTIC KDDM_RLDoorSW_s "" VALUE 0x0000 /* @ECU_Address@KDDM_RLDoorSW_s@ */ Scalar_FLOAT32_IEEE 0 SWC_DDM_type_CM_single_sec 0.0 86400.0 /end CHARACTERISTIC
/begin CHARACTERISTIC KDDM_RRBatwarnDetTO_s "" VALUE 0x0000 /* @ECU_Address@KDDM_RRBatwarnDetTO_s@ */ Scalar_FLOAT32_IEEE 0 SWC_DDM_type_CM_single_sec 0.0 10.0 /end CHARACTERISTIC
/begin CHARACTERISTIC KDDM_RRDoorSWDetTO_s "" VALUE 0x0000 /* @ECU_Address@KDDM_RRDoorSWDetTO_s@ */ Scalar_FLOAT32_IEEE 0 SWC_DDM_type_CM_single_sec 0.0 86400.0 /end CHARACTERISTIC
/begin CHARACTERISTIC KDDM_RRDoorSWPassTO_s "" VALUE 0x0000 /* @ECU_Address@KDDM_RRDoorSWPassTO_s@ */ Scalar_FLOAT32_IEEE 0 SWC_DDM_type_CM_single_sec 0.0 86400.0 /end CHARACTERISTIC
/begin CHARACTERISTIC KDDM_RRDoorSW_s "" VALUE 0x0000 /* @ECU_Address@KDDM_RRDoorSW_s@ */ Scalar_FLOAT32_IEEE 0 SWC_DDM_type_CM_single_sec 0.0 86400.0 /end CHARACTERISTIC
/begin CHARACTERISTIC KDDM_RRPressIndiDetTO_s "" VALUE 0x0000 /* @ECU_Address@KDDM_RRPressIndiDetTO_s@ */ Scalar_FLOAT32_IEEE 0 SWC_DDM_type_CM_single_sec 0.0 10.0 /end CHARACTERISTIC
/begin CHARACTERISTIC KDDM_RRPressIndiPassTO_s "" VALUE 0x0000 /* @ECU_Address@KDDM_RRPressIndiPassTO_s@ */ Scalar_FLOAT32_IEEE 0 SWC_DDM_type_CM_single_sec 0.0 10.0 /end CHARACTERISTIC
/begin CHARACTERISTIC KDDM_RRSensorFailDetTO_s "" VALUE 0x0000 /* @ECU_Address@KDDM_RRSensorFailDetTO_s@ */ Scalar_FLOAT32_IEEE 0 SWC_DDM_type_CM_single_sec 0.0 10.0 /end CHARACTERISTIC
/begin CHARACTERISTIC KDDM_RRSensorFailPassTO_s "" VALUE 0x0000 /* @ECU_Address@KDDM_RRSensorFailPassTO_s@ */ Scalar_FLOAT32_IEEE 0 SWC_DDM_type_CM_single_sec 0.0 10.0 /end CHARACTERISTIC
/begin CHARACTERISTIC KDDM_RRWheelTmpHighDetTO_s "" VALUE 0x0000 /* @ECU_Address@KDDM_RRWheelTmpHighDetTO_s@ */ Scalar_FLOAT32_IEEE 0 SWC_DDM_type_CM_single_sec 0.0 10.0 /end CHARACTERISTIC
/begin CHARACTERISTIC KDDM_RRWheelTmpHighPassTO_s "" VALUE 0x0000 /* @ECU_Address@KDDM_RRWheelTmpHighPassTO_s@ */ Scalar_FLOAT32_IEEE 0 SWC_DDM_type_CM_single_sec 0.0 10.0 /end CHARACTERISTIC
/begin CHARACTERISTIC KDDM_RegenErrDetTO_s "" VALUE 0x0000 /* @ECU_Address@KDDM_RegenErrDetTO_s@ */ Scalar_FLOAT32_IEEE 0 SWC_DDM_type_CM_single_sec 0.0 10.0 /end CHARACTERISTIC
/begin CHARACTERISTIC KDDM_RegenErrPassTO_s "" VALUE 0x0000 /* @ECU_Address@KDDM_RegenErrPassTO_s@ */ Scalar_FLOAT32_IEEE 0 SWC_DDM_type_CM_single_sec 0.0 10.0 /end CHARACTERISTIC
/begin CHARACTERISTIC KDDM_RrMCUTqErrDetTO_s "" VALUE 0x0000 /* @ECU_Address@KDDM_RrMCUTqErrDetTO_s@ */ Scalar_FLOAT32_IEEE 0 SWC_DDM_type_CM_single_sec 0.0 10.0 /end CHARACTERISTIC
/begin CHARACTERISTIC KDDM_RrMCUTqErrPassTO_s "" VALUE 0x0000 /* @ECU_Address@KDDM_RrMCUTqErrPassTO_s@ */ Scalar_FLOAT32_IEEE 0 SWC_DDM_type_CM_single_sec 0.0 10.0 /end CHARACTERISTIC
/begin CHARACTERISTIC KDDM_Shifter1CSErrDetTO_s "" VALUE 0x0000 /* @ECU_Address@KDDM_Shifter1CSErrDetTO_s@ */ Scalar_FLOAT32_IEEE 0 SWC_DDM_type_CM_single_sec 0.0 10.0 /end CHARACTERISTIC
/begin CHARACTERISTIC KDDM_Shifter1CSErrPassTO_s "" VALUE 0x0000 /* @ECU_Address@KDDM_Shifter1CSErrPassTO_s@ */ Scalar_FLOAT32_IEEE 0 SWC_DDM_type_CM_single_sec 0.0 10.0 /end CHARACTERISTIC
/begin CHARACTERISTIC KDDM_Shifter1NoComDetTO_s "" VALUE 0x0000 /* @ECU_Address@KDDM_Shifter1NoComDetTO_s@ */ Scalar_FLOAT32_IEEE 0 SWC_DDM_type_CM_single_sec 0.0 10.0 /end CHARACTERISTIC
/begin CHARACTERISTIC KDDM_Shifter1NoComPassTO_s "" VALUE 0x0000 /* @ECU_Address@KDDM_Shifter1NoComPassTO_s@ */ Scalar_FLOAT32_IEEE 0 SWC_DDM_type_CM_single_sec 0.0 10.0 /end CHARACTERISTIC
/begin CHARACTERISTIC KDDM_Shifter1RCErrDetTO_s "" VALUE 0x0000 /* @ECU_Address@KDDM_Shifter1RCErrDetTO_s@ */ Scalar_FLOAT32_IEEE 0 SWC_DDM_type_CM_single_sec 0.0 10.0 /end CHARACTERISTIC
/begin CHARACTERISTIC KDDM_Shifter1RCErrPassTO_s "" VALUE 0x0000 /* @ECU_Address@KDDM_Shifter1RCErrPassTO_s@ */ Scalar_FLOAT32_IEEE 0 SWC_DDM_type_CM_single_sec 0.0 10.0 /end CHARACTERISTIC
/begin CHARACTERISTIC KDDM_TailgaSWDetTO_s "" VALUE 0x0000 /* @ECU_Address@KDDM_TailgaSWDetTO_s@ */ Scalar_FLOAT32_IEEE 0 SWC_DDM_type_CM_single_sec 0.0 86400.0 /end CHARACTERISTIC
/begin CHARACTERISTIC KDDM_TailgaSWPassTO_s "" VALUE 0x0000 /* @ECU_Address@KDDM_TailgaSWPassTO_s@ */ Scalar_FLOAT32_IEEE 0 SWC_DDM_type_CM_single_sec 0.0 86400.0 /end CHARACTERISTIC
/begin CHARACTERISTIC KDDM_TailgaSW_s "" VALUE 0x0000 /* @ECU_Address@KDDM_TailgaSW_s@ */ Scalar_FLOAT32_IEEE 0 SWC_DDM_type_CM_single_sec 0.0 86400.0 /end CHARACTERISTIC
/begin CHARACTERISTIC KDDM_UpDetWinBrkPos_pct "" VALUE 0x0000 /* @ECU_Address@KDDM_UpDetWinBrkPos_pct@ */ Scalar_FLOAT32_IEEE 0 SWC_DDM_type_CM_single_pct 0.0 100.0 /end CHARACTERISTIC
/begin CHARACTERISTIC KDDM_BrkSWDiagnosisOffSW_flg "" VALUE 0x0000 /* @ECU_Address@KDDM_BrkSWDiagnosisOffSW_flg@ */ Scalar_BOOLEAN 0 SWC_DDM_type_CM_boolean_flg 0.0 1.0 /end CHARACTERISTIC
/begin CHARACTERISTIC KDDM_CommErrDiagnosisOffSW_flg "" VALUE 0x0000 /* @ECU_Address@KDDM_CommErrDiagnosisOffSW_flg@ */ Scalar_BOOLEAN 0 SWC_DDM_type_CM_boolean_flg 0.0 1.0 /end CHARACTERISTIC
/begin CHARACTERISTIC KDDM_DiagnosisTmp_flg_ovrdflg "" VALUE 0x0000 /* @ECU_Address@KDDM_DiagnosisTmp_flg_ovrdflg@ */ Scalar_BOOLEAN 0 SWC_DDM_type_CM_boolean_flg 0.0 1.0 /end CHARACTERISTIC
/begin CHARACTERISTIC KDDM_EPBErrPopupSW_flg "" VALUE 0x0000 /* @ECU_Address@KDDM_EPBErrPopupSW_flg@ */ Scalar_BOOLEAN 0 SWC_DDM_type_CM_boolean_flg 0.0 1.0 /end CHARACTERISTIC
/begin CHARACTERISTIC KDDM_FaultLvDiagnosisOffSW_flg "" VALUE 0x0000 /* @ECU_Address@KDDM_FaultLvDiagnosisOffSW_flg@ */ Scalar_BOOLEAN 0 SWC_DDM_type_CM_boolean_flg 0.0 1.0 /end CHARACTERISTIC
/begin CHARACTERISTIC KDDM_KeyAuthDiagnosisOffSW_flg "" VALUE 0x0000 /* @ECU_Address@KDDM_KeyAuthDiagnosisOffSW_flg@ */ Scalar_BOOLEAN 0 SWC_DDM_type_CM_boolean_flg 0.0 1.0 /end CHARACTERISTIC
/begin CHARACTERISTIC KDDM_LFBatwarnCFSSW_flg "" VALUE 0x0000 /* @ECU_Address@KDDM_LFBatwarnCFSSW_flg@ */ Scalar_BOOLEAN 0 SWC_DDM_type_CM_boolean_flg 0.0 1.0 /end CHARACTERISTIC
/begin CHARACTERISTIC KDDM_LFBatwarnDetSW_flg "" VALUE 0x0000 /* @ECU_Address@KDDM_LFBatwarnDetSW_flg@ */ Scalar_BOOLEAN 0 SWC_DDM_type_CM_boolean_flg 0.0 1.0 /end CHARACTERISTIC
/begin CHARACTERISTIC KDDM_LFBatwarnPassSW_flg "" VALUE 0x0000 /* @ECU_Address@KDDM_LFBatwarnPassSW_flg@ */ Scalar_BOOLEAN 0 SWC_DDM_type_CM_boolean_flg 0.0 1.0 /end CHARACTERISTIC
/begin CHARACTERISTIC KDDM_LFPressIndiCFSSW_flg "" VALUE 0x0000 /* @ECU_Address@KDDM_LFPressIndiCFSSW_flg@ */ Scalar_BOOLEAN 0 SWC_DDM_type_CM_boolean_flg 0.0 1.0 /end CHARACTERISTIC
/begin CHARACTERISTIC KDDM_LFPressIndiDetSW_flg "" VALUE 0x0000 /* @ECU_Address@KDDM_LFPressIndiDetSW_flg@ */ Scalar_BOOLEAN 0 SWC_DDM_type_CM_boolean_flg 0.0 1.0 /end CHARACTERISTIC
/begin CHARACTERISTIC KDDM_LFPressIndiPassSW_flg "" VALUE 0x0000 /* @ECU_Address@KDDM_LFPressIndiPassSW_flg@ */ Scalar_BOOLEAN 0 SWC_DDM_type_CM_boolean_flg 0.0 1.0 /end CHARACTERISTIC
/begin CHARACTERISTIC KDDM_LFSensorFailCFSSW_flg "" VALUE 0x0000 /* @ECU_Address@KDDM_LFSensorFailCFSSW_flg@ */ Scalar_BOOLEAN 0 SWC_DDM_type_CM_boolean_flg 0.0 1.0 /end CHARACTERISTIC
/begin CHARACTERISTIC KDDM_LFSensorFailDetSW_flg "" VALUE 0x0000 /* @ECU_Address@KDDM_LFSensorFailDetSW_flg@ */ Scalar_BOOLEAN 0 SWC_DDM_type_CM_boolean_flg 0.0 1.0 /end CHARACTERISTIC
/begin CHARACTERISTIC KDDM_LFSensorFailPassSW_flg "" VALUE 0x0000 /* @ECU_Address@KDDM_LFSensorFailPassSW_flg@ */ Scalar_BOOLEAN 0 SWC_DDM_type_CM_boolean_flg 0.0 1.0 /end CHARACTERISTIC
/begin CHARACTERISTIC KDDM_LFWheelTmpHighCFSSW_flg "" VALUE 0x0000 /* @ECU_Address@KDDM_LFWheelTmpHighCFSSW_flg@ */ Scalar_BOOLEAN 0 SWC_DDM_type_CM_boolean_flg 0.0 1.0 /end CHARACTERISTIC
/begin CHARACTERISTIC KDDM_LFWheelTmpHighDetSW_flg "" VALUE 0x0000 /* @ECU_Address@KDDM_LFWheelTmpHighDetSW_flg@ */ Scalar_BOOLEAN 0 SWC_DDM_type_CM_boolean_flg 0.0 1.0 /end CHARACTERISTIC
/begin CHARACTERISTIC KDDM_LFWheelTmpHighPassSW_flg "" VALUE 0x0000 /* @ECU_Address@KDDM_LFWheelTmpHighPassSW_flg@ */ Scalar_BOOLEAN 0 SWC_DDM_type_CM_boolean_flg 0.0 1.0 /end CHARACTERISTIC
/begin CHARACTERISTIC KDDM_LRBatwarnCFSSW_flg "" VALUE 0x0000 /* @ECU_Address@KDDM_LRBatwarnCFSSW_flg@ */ Scalar_BOOLEAN 0 SWC_DDM_type_CM_boolean_flg 0.0 1.0 /end CHARACTERISTIC
/begin CHARACTERISTIC KDDM_LRBatwarnDetSW_flg "" VALUE 0x0000 /* @ECU_Address@KDDM_LRBatwarnDetSW_flg@ */ Scalar_BOOLEAN 0 SWC_DDM_type_CM_boolean_flg 0.0 1.0 /end CHARACTERISTIC
/begin CHARACTERISTIC KDDM_LRBatwarnPassSW_flg "" VALUE 0x0000 /* @ECU_Address@KDDM_LRBatwarnPassSW_flg@ */ Scalar_BOOLEAN 0 SWC_DDM_type_CM_boolean_flg 0.0 1.0 /end CHARACTERISTIC
/begin CHARACTERISTIC KDDM_LRPressIndiCFSSW_flg "" VALUE 0x0000 /* @ECU_Address@KDDM_LRPressIndiCFSSW_flg@ */ Scalar_BOOLEAN 0 SWC_DDM_type_CM_boolean_flg 0.0 1.0 /end CHARACTERISTIC
/begin CHARACTERISTIC KDDM_LRPressIndiDetSW_flg "" VALUE 0x0000 /* @ECU_Address@KDDM_LRPressIndiDetSW_flg@ */ Scalar_BOOLEAN 0 SWC_DDM_type_CM_boolean_flg 0.0 1.0 /end CHARACTERISTIC
/begin CHARACTERISTIC KDDM_LRPressIndiPassSW_flg "" VALUE 0x0000 /* @ECU_Address@KDDM_LRPressIndiPassSW_flg@ */ Scalar_BOOLEAN 0 SWC_DDM_type_CM_boolean_flg 0.0 1.0 /end CHARACTERISTIC
/begin CHARACTERISTIC KDDM_LRSensorFailCFSSW_flg "" VALUE 0x0000 /* @ECU_Address@KDDM_LRSensorFailCFSSW_flg@ */ Scalar_BOOLEAN 0 SWC_DDM_type_CM_boolean_flg 0.0 1.0 /end CHARACTERISTIC
/begin CHARACTERISTIC KDDM_LRSensorFailDetSW_flg "" VALUE 0x0000 /* @ECU_Address@KDDM_LRSensorFailDetSW_flg@ */ Scalar_BOOLEAN 0 SWC_DDM_type_CM_boolean_flg 0.0 1.0 /end CHARACTERISTIC
/begin CHARACTERISTIC KDDM_LRSensorFailPassSW_flg "" VALUE 0x0000 /* @ECU_Address@KDDM_LRSensorFailPassSW_flg@ */ Scalar_BOOLEAN 0 SWC_DDM_type_CM_boolean_flg 0.0 1.0 /end CHARACTERISTIC
/begin CHARACTERISTIC KDDM_LRWheelTmpHighCFSSW_flg "" VALUE 0x0000 /* @ECU_Address@KDDM_LRWheelTmpHighCFSSW_flg@ */ Scalar_BOOLEAN 0 SWC_DDM_type_CM_boolean_flg 0.0 1.0 /end CHARACTERISTIC
/begin CHARACTERISTIC KDDM_LRWheelTmpHighDetSW_flg "" VALUE 0x0000 /* @ECU_Address@KDDM_LRWheelTmpHighDetSW_flg@ */ Scalar_BOOLEAN 0 SWC_DDM_type_CM_boolean_flg 0.0 1.0 /end CHARACTERISTIC
/begin CHARACTERISTIC KDDM_LRWheelTmpHighPassSW_flg "" VALUE 0x0000 /* @ECU_Address@KDDM_LRWheelTmpHighPassSW_flg@ */ Scalar_BOOLEAN 0 SWC_DDM_type_CM_boolean_flg 0.0 1.0 /end CHARACTERISTIC
/begin CHARACTERISTIC KDDM_LVDiagnosisOffSW_flg "" VALUE 0x0000 /* @ECU_Address@KDDM_LVDiagnosisOffSW_flg@ */ Scalar_BOOLEAN 0 SWC_DDM_type_CM_boolean_flg 0.0 1.0 /end CHARACTERISTIC
/begin CHARACTERISTIC KDDM_LimpHomeTmpSW_flg "" VALUE 0x0000 /* @ECU_Address@KDDM_LimpHomeTmpSW_flg@ */ Scalar_BOOLEAN 0 SWC_DDM_type_CM_boolean_flg 0.0 1.0 /end CHARACTERISTIC
/begin CHARACTERISTIC KDDM_ONtoRdyDiagnosisOffSW_flg "" VALUE 0x0000 /* @ECU_Address@KDDM_ONtoRdyDiagnosisOffSW_flg@ */ Scalar_BOOLEAN 0 SWC_DDM_type_CM_boolean_flg 0.0 1.0 /end CHARACTERISTIC
/begin CHARACTERISTIC KDDM_PwrUpDnDiagnosisOffSW_flg "" VALUE 0x0000 /* @ECU_Address@KDDM_PwrUpDnDiagnosisOffSW_flg@ */ Scalar_BOOLEAN 0 SWC_DDM_type_CM_boolean_flg 0.0 1.0 /end CHARACTERISTIC
/begin CHARACTERISTIC KDDM_RFBatwarnCFSSW_flg "" VALUE 0x0000 /* @ECU_Address@KDDM_RFBatwarnCFSSW_flg@ */ Scalar_BOOLEAN 0 SWC_DDM_type_CM_boolean_flg 0.0 1.0 /end CHARACTERISTIC
/begin CHARACTERISTIC KDDM_RFBatwarnDetSW_flg "" VALUE 0x0000 /* @ECU_Address@KDDM_RFBatwarnDetSW_flg@ */ Scalar_BOOLEAN 0 SWC_DDM_type_CM_boolean_flg 0.0 1.0 /end CHARACTERISTIC
/begin CHARACTERISTIC KDDM_RFBatwarnPassSW_flg "" VALUE 0x0000 /* @ECU_Address@KDDM_RFBatwarnPassSW_flg@ */ Scalar_BOOLEAN 0 SWC_DDM_type_CM_boolean_flg 0.0 1.0 /end CHARACTERISTIC
/begin CHARACTERISTIC KDDM_RFPressIndiCFSSW_flg "" VALUE 0x0000 /* @ECU_Address@KDDM_RFPressIndiCFSSW_flg@ */ Scalar_BOOLEAN 0 SWC_DDM_type_CM_boolean_flg 0.0 1.0 /end CHARACTERISTIC
/begin CHARACTERISTIC KDDM_RFPressIndiDetSW_flg "" VALUE 0x0000 /* @ECU_Address@KDDM_RFPressIndiDetSW_flg@ */ Scalar_BOOLEAN 0 SWC_DDM_type_CM_boolean_flg 0.0 1.0 /end CHARACTERISTIC
/begin CHARACTERISTIC KDDM_RFPressIndiPassSW_flg "" VALUE 0x0000 /* @ECU_Address@KDDM_RFPressIndiPassSW_flg@ */ Scalar_BOOLEAN 0 SWC_DDM_type_CM_boolean_flg 0.0 1.0 /end CHARACTERISTIC
/begin CHARACTERISTIC KDDM_RFSensorFailCFSSW_flg "" VALUE 0x0000 /* @ECU_Address@KDDM_RFSensorFailCFSSW_flg@ */ Scalar_BOOLEAN 0 SWC_DDM_type_CM_boolean_flg 0.0 1.0 /end CHARACTERISTIC
/begin CHARACTERISTIC KDDM_RFSensorFailDetSW_flg "" VALUE 0x0000 /* @ECU_Address@KDDM_RFSensorFailDetSW_flg@ */ Scalar_BOOLEAN 0 SWC_DDM_type_CM_boolean_flg 0.0 1.0 /end CHARACTERISTIC
/begin CHARACTERISTIC KDDM_RFSensorFailPassSW_flg "" VALUE 0x0000 /* @ECU_Address@KDDM_RFSensorFailPassSW_flg@ */ Scalar_BOOLEAN 0 SWC_DDM_type_CM_boolean_flg 0.0 1.0 /end CHARACTERISTIC
/begin CHARACTERISTIC KDDM_RFWheelTmpHighCFSSW_flg "" VALUE 0x0000 /* @ECU_Address@KDDM_RFWheelTmpHighCFSSW_flg@ */ Scalar_BOOLEAN 0 SWC_DDM_type_CM_boolean_flg 0.0 1.0 /end CHARACTERISTIC
/begin CHARACTERISTIC KDDM_RFWheelTmpHighDetSW_flg "" VALUE 0x0000 /* @ECU_Address@KDDM_RFWheelTmpHighDetSW_flg@ */ Scalar_BOOLEAN 0 SWC_DDM_type_CM_boolean_flg 0.0 1.0 /end CHARACTERISTIC
/begin CHARACTERISTIC KDDM_RFWheelTmpHighPassSW_flg "" VALUE 0x0000 /* @ECU_Address@KDDM_RFWheelTmpHighPassSW_flg@ */ Scalar_BOOLEAN 0 SWC_DDM_type_CM_boolean_flg 0.0 1.0 /end CHARACTERISTIC
/begin CHARACTERISTIC KDDM_RRBatwarnCFSSW_flg "" VALUE 0x0000 /* @ECU_Address@KDDM_RRBatwarnCFSSW_flg@ */ Scalar_BOOLEAN 0 SWC_DDM_type_CM_boolean_flg 0.0 1.0 /end CHARACTERISTIC
/begin CHARACTERISTIC KDDM_RRBatwarnDetSW_flg "" VALUE 0x0000 /* @ECU_Address@KDDM_RRBatwarnDetSW_flg@ */ Scalar_BOOLEAN 0 SWC_DDM_type_CM_boolean_flg 0.0 1.0 /end CHARACTERISTIC
/begin CHARACTERISTIC KDDM_RRBatwarnPassSW_flg "" VALUE 0x0000 /* @ECU_Address@KDDM_RRBatwarnPassSW_flg@ */ Scalar_BOOLEAN 0 SWC_DDM_type_CM_boolean_flg 0.0 1.0 /end CHARACTERISTIC
/begin CHARACTERISTIC KDDM_RRPressIndiCFSSW_flg "" VALUE 0x0000 /* @ECU_Address@KDDM_RRPressIndiCFSSW_flg@ */ Scalar_BOOLEAN 0 SWC_DDM_type_CM_boolean_flg 0.0 1.0 /end CHARACTERISTIC
/begin CHARACTERISTIC KDDM_RRPressIndiDetSW_flg "" VALUE 0x0000 /* @ECU_Address@KDDM_RRPressIndiDetSW_flg@ */ Scalar_BOOLEAN 0 SWC_DDM_type_CM_boolean_flg 0.0 1.0 /end CHARACTERISTIC
/begin CHARACTERISTIC KDDM_RRPressIndiPassSW_flg "" VALUE 0x0000 /* @ECU_Address@KDDM_RRPressIndiPassSW_flg@ */ Scalar_BOOLEAN 0 SWC_DDM_type_CM_boolean_flg 0.0 1.0 /end CHARACTERISTIC
/begin CHARACTERISTIC KDDM_RRSensorFailCFSSW_flg "" VALUE 0x0000 /* @ECU_Address@KDDM_RRSensorFailCFSSW_flg@ */ Scalar_BOOLEAN 0 SWC_DDM_type_CM_boolean_flg 0.0 1.0 /end CHARACTERISTIC
/begin CHARACTERISTIC KDDM_RRSensorFailDetSW_flg "" VALUE 0x0000 /* @ECU_Address@KDDM_RRSensorFailDetSW_flg@ */ Scalar_BOOLEAN 0 SWC_DDM_type_CM_boolean_flg 0.0 1.0 /end CHARACTERISTIC
/begin CHARACTERISTIC KDDM_RRSensorFailPassSW_flg "" VALUE 0x0000 /* @ECU_Address@KDDM_RRSensorFailPassSW_flg@ */ Scalar_BOOLEAN 0 SWC_DDM_type_CM_boolean_flg 0.0 1.0 /end CHARACTERISTIC
/begin CHARACTERISTIC KDDM_RRWheelTmpHighCFSSW_flg "" VALUE 0x0000 /* @ECU_Address@KDDM_RRWheelTmpHighCFSSW_flg@ */ Scalar_BOOLEAN 0 SWC_DDM_type_CM_boolean_flg 0.0 1.0 /end CHARACTERISTIC
/begin CHARACTERISTIC KDDM_RRWheelTmpHighDetSW_flg "" VALUE 0x0000 /* @ECU_Address@KDDM_RRWheelTmpHighDetSW_flg@ */ Scalar_BOOLEAN 0 SWC_DDM_type_CM_boolean_flg 0.0 1.0 /end CHARACTERISTIC
/begin CHARACTERISTIC KDDM_RRWheelTmpHighPassSW_flg "" VALUE 0x0000 /* @ECU_Address@KDDM_RRWheelTmpHighPassSW_flg@ */ Scalar_BOOLEAN 0 SWC_DDM_type_CM_boolean_flg 0.0 1.0 /end CHARACTERISTIC
/begin CHARACTERISTIC KDDM_SWFailDiagnosisOffSW_flg "" VALUE 0x0000 /* @ECU_Address@KDDM_SWFailDiagnosisOffSW_flg@ */ Scalar_BOOLEAN 0 SWC_DDM_type_CM_boolean_flg 0.0 1.0 /end CHARACTERISTIC
/begin CHARACTERISTIC KDDM_SysErrPwrOutSW_flg "" VALUE 0x0000 /* @ECU_Address@KDDM_SysErrPwrOutSW_flg@ */ Scalar_BOOLEAN 0 SWC_DDM_type_CM_boolean_flg 0.0 1.0 /end CHARACTERISTIC
/begin CHARACTERISTIC KDDM_SysErrShifterErrSW_flg "" VALUE 0x0000 /* @ECU_Address@KDDM_SysErrShifterErrSW_flg@ */ Scalar_BOOLEAN 0 SWC_DDM_type_CM_boolean_flg 0.0 1.0 /end CHARACTERISTIC
/begin CHARACTERISTIC KDDM_SysErrVCUErrSW_flg "" VALUE 0x0000 /* @ECU_Address@KDDM_SysErrVCUErrSW_flg@ */ Scalar_BOOLEAN 0 SWC_DDM_type_CM_boolean_flg 0.0 1.0 /end CHARACTERISTIC
/begin CHARACTERISTIC KDDM_TQDDiagnosisOffSW_flg "" VALUE 0x0000 /* @ECU_Address@KDDM_TQDDiagnosisOffSW_flg@ */ Scalar_BOOLEAN 0 SWC_DDM_type_CM_boolean_flg 0.0 1.0 /end CHARACTERISTIC
/begin CHARACTERISTIC KDDM_VCURAPSErrLv2_flg_ovrdflg "" VALUE 0x0000 /* @ECU_Address@KDDM_VCURAPSErrLv2_flg_ovrdflg@ */ Scalar_BOOLEAN 0 SWC_DDM_type_CM_boolean_flg 0.0 1.0 /end CHARACTERISTIC
/begin CHARACTERISTIC KDDM_VCURAPSErrLv2_flg_ovrdval "" VALUE 0x0000 /* @ECU_Address@KDDM_VCURAPSErrLv2_flg_ovrdval@ */ Scalar_BOOLEAN 0 SWC_DDM_type_CM_boolean_flg 0.0 1.0 /end CHARACTERISTIC
/begin CHARACTERISTIC KDDM_VCURAPSErrLv3_flg_ovrdflg "" VALUE 0x0000 /* @ECU_Address@KDDM_VCURAPSErrLv3_flg_ovrdflg@ */ Scalar_BOOLEAN 0 SWC_DDM_type_CM_boolean_flg 0.0 1.0 /end CHARACTERISTIC
/begin CHARACTERISTIC KDDM_VCURAPSErrLv3_flg_ovrdval "" VALUE 0x0000 /* @ECU_Address@KDDM_VCURAPSErrLv3_flg_ovrdval@ */ Scalar_BOOLEAN 0 SWC_DDM_type_CM_boolean_flg 0.0 1.0 /end CHARACTERISTIC
/begin CHARACTERISTIC KDDM_VMCDiagnosisOffSW_flg "" VALUE 0x0000 /* @ECU_Address@KDDM_VMCDiagnosisOffSW_flg@ */ Scalar_BOOLEAN 0 SWC_DDM_type_CM_boolean_flg 0.0 1.0 /end CHARACTERISTIC
/begin CHARACTERISTIC KDDM_VehMalfunLevelSW_flg "" VALUE 0x0000 /* @ECU_Address@KDDM_VehMalfunLevelSW_flg@ */ Scalar_BOOLEAN 0 SWC_DDM_type_CM_boolean_flg 0.0 1.0 /end CHARACTERISTIC
/begin CHARACTERISTIC KDDM_5vAPS1OoRDTC_cnt "" VALUE 0x0000 /* @ECU_Address@KDDM_5vAPS1OoRDTC_cnt@ */ Scalar_UBYTE 0 SWC_DDM_type_CM_uint8_cnt 0.0 100.0 /end CHARACTERISTIC
/begin CHARACTERISTIC KDDM_5vAPS2OoRDTC_cnt "" VALUE 0x0000 /* @ECU_Address@KDDM_5vAPS2OoRDTC_cnt@ */ Scalar_UBYTE 0 SWC_DDM_type_CM_uint8_cnt 0.0 100.0 /end CHARACTERISTIC
/begin CHARACTERISTIC KDDM_APS1SigOoRDTC_cnt "" VALUE 0x0000 /* @ECU_Address@KDDM_APS1SigOoRDTC_cnt@ */ Scalar_UBYTE 0 SWC_DDM_type_CM_uint8_cnt 0.0 100.0 /end CHARACTERISTIC
/begin CHARACTERISTIC KDDM_APS2SigOoRDTC_cnt "" VALUE 0x0000 /* @ECU_Address@KDDM_APS2SigOoRDTC_cnt@ */ Scalar_UBYTE 0 SWC_DDM_type_CM_uint8_cnt 0.0 100.0 /end CHARACTERISTIC
/begin CHARACTERISTIC KDDM_APSCorrErrDTC_cnt "" VALUE 0x0000 /* @ECU_Address@KDDM_APSCorrErrDTC_cnt@ */ Scalar_UBYTE 0 SWC_DDM_type_CM_uint8_cnt 0.0 100.0 /end CHARACTERISTIC
/begin CHARACTERISTIC KDDM_BrkSWErrDTC_cnt "" VALUE 0x0000 /* @ECU_Address@KDDM_BrkSWErrDTC_cnt@ */ Scalar_UBYTE 0 SWC_DDM_type_CM_uint8_cnt 0.0 255.0 /end CHARACTERISTIC
/begin CHARACTERISTIC KDDM_BrkSWNoBacDTC_cnt "" VALUE 0x0000 /* @ECU_Address@KDDM_BrkSWNoBacDTC_cnt@ */ Scalar_UBYTE 0 SWC_DDM_type_CM_uint8_cnt 0.0 255.0 /end CHARACTERISTIC
/begin CHARACTERISTIC KDDM_C1ABM1CSDTC_cnt "" VALUE 0x0000 /* @ECU_Address@KDDM_C1ABM1CSDTC_cnt@ */ Scalar_UBYTE 0 SWC_DDM_type_CM_uint8_cnt 0.0 255.0 /end CHARACTERISTIC
/begin CHARACTERISTIC KDDM_C1ABM1LCDTC_cnt "" VALUE 0x0000 /* @ECU_Address@KDDM_C1ABM1LCDTC_cnt@ */ Scalar_UBYTE 0 SWC_DDM_type_CM_uint8_cnt 0.0 255.0 /end CHARACTERISTIC
/begin CHARACTERISTIC KDDM_C1ABM1RCDTC_cnt "" VALUE 0x0000 /* @ECU_Address@KDDM_C1ABM1RCDTC_cnt@ */ Scalar_UBYTE 0 SWC_DDM_type_CM_uint8_cnt 0.0 255.0 /end CHARACTERISTIC
/begin CHARACTERISTIC KDDM_C3BMS1CSDTC_cnt "" VALUE 0x0000 /* @ECU_Address@KDDM_C3BMS1CSDTC_cnt@ */ Scalar_UBYTE 0 SWC_DDM_type_CM_uint8_cnt 0.0 255.0 /end CHARACTERISTIC
/begin CHARACTERISTIC KDDM_C3BMS1LCDTC_cnt "" VALUE 0x0000 /* @ECU_Address@KDDM_C3BMS1LCDTC_cnt@ */ Scalar_UBYTE 0 SWC_DDM_type_CM_uint8_cnt 0.0 255.0 /end CHARACTERISTIC
/begin CHARACTERISTIC KDDM_C3BMS1RCDTC_cnt "" VALUE 0x0000 /* @ECU_Address@KDDM_C3BMS1RCDTC_cnt@ */ Scalar_UBYTE 0 SWC_DDM_type_CM_uint8_cnt 0.0 255.0 /end CHARACTERISTIC
/begin CHARACTERISTIC KDDM_C3BMS6CSDTC_cnt "" VALUE 0x0000 /* @ECU_Address@KDDM_C3BMS6CSDTC_cnt@ */ Scalar_UBYTE 0 SWC_DDM_type_CM_uint8_cnt 0.0 255.0 /end CHARACTERISTIC
/begin CHARACTERISTIC KDDM_C3BMS6LCDTC_cnt "" VALUE 0x0000 /* @ECU_Address@KDDM_C3BMS6LCDTC_cnt@ */ Scalar_UBYTE 0 SWC_DDM_type_CM_uint8_cnt 0.0 255.0 /end CHARACTERISTIC
/begin CHARACTERISTIC KDDM_C3BMS6RCDTC_cnt "" VALUE 0x0000 /* @ECU_Address@KDDM_C3BMS6RCDTC_cnt@ */ Scalar_UBYTE 0 SWC_DDM_type_CM_uint8_cnt 0.0 255.0 /end CHARACTERISTIC
/begin CHARACTERISTIC KDDM_C3CCU1CSDTC_cnt "" VALUE 0x0000 /* @ECU_Address@KDDM_C3CCU1CSDTC_cnt@ */ Scalar_UBYTE 0 SWC_DDM_type_CM_uint8_cnt 0.0 255.0 /end CHARACTERISTIC
/begin CHARACTERISTIC KDDM_C3CCU1LCDTC_cnt "" VALUE 0x0000 /* @ECU_Address@KDDM_C3CCU1LCDTC_cnt@ */ Scalar_UBYTE 0 SWC_DDM_type_CM_uint8_cnt 0.0 255.0 /end CHARACTERISTIC
/begin CHARACTERISTIC KDDM_C3CCU1RCDTC_cnt "" VALUE 0x0000 /* @ECU_Address@KDDM_C3CCU1RCDTC_cnt@ */ Scalar_UBYTE 0 SWC_DDM_type_CM_uint8_cnt 0.0 255.0 /end CHARACTERISTIC
/begin CHARACTERISTIC KDDM_C3CCU2CSDTC_cnt "" VALUE 0x0000 /* @ECU_Address@KDDM_C3CCU2CSDTC_cnt@ */ Scalar_UBYTE 0 SWC_DDM_type_CM_uint8_cnt 0.0 255.0 /end CHARACTERISTIC
/begin CHARACTERISTIC KDDM_C3CCU2LCDTC_cnt "" VALUE 0x0000 /* @ECU_Address@KDDM_C3CCU2LCDTC_cnt@ */ Scalar_UBYTE 0 SWC_DDM_type_CM_uint8_cnt 0.0 255.0 /end CHARACTERISTIC
/begin CHARACTERISTIC KDDM_C3CCU2RCDTC_cnt "" VALUE 0x0000 /* @ECU_Address@KDDM_C3CCU2RCDTC_cnt@ */ Scalar_UBYTE 0 SWC_DDM_type_CM_uint8_cnt 0.0 255.0 /end CHARACTERISTIC
/begin CHARACTERISTIC KDDM_DTCClockerMax_cnt "" VALUE 0x0000 /* @ECU_Address@KDDM_DTCClockerMax_cnt@ */ Scalar_UBYTE 0 SWC_DDM_type_CM_uint8_cnt 0.0 255.0 /end CHARACTERISTIC
/begin CHARACTERISTIC KDDM_DTCDelay_cnt "" VALUE 0x0000 /* @ECU_Address@KDDM_DTCDelay_cnt@ */ Scalar_UBYTE 0 SWC_DDM_type_CM_uint8_cnt 0.0 20.0 /end CHARACTERISTIC
/begin CHARACTERISTIC KDDM_DrStSWDTC_cnt "" VALUE 0x0000 /* @ECU_Address@KDDM_DrStSWDTC_cnt@ */ Scalar_UBYTE 0 SWC_DDM_type_CM_uint8_cnt 0.0 255.0 /end CHARACTERISTIC
/begin CHARACTERISTIC KDDM_DrVCUNoComDTC_cnt "" VALUE 0x0000 /* @ECU_Address@KDDM_DrVCUNoComDTC_cnt@ */ Scalar_UBYTE 0 SWC_DDM_type_CM_uint8_cnt 0.0 100.0 /end CHARACTERISTIC
/begin CHARACTERISTIC KDDM_EPB1CSErrDTC_cnt "" VALUE 0x0000 /* @ECU_Address@KDDM_EPB1CSErrDTC_cnt@ */ Scalar_UBYTE 0 SWC_DDM_type_CM_uint8_cnt 0.0 100.0 /end CHARACTERISTIC
/begin CHARACTERISTIC KDDM_EPB1NoComDTC_cnt "" VALUE 0x0000 /* @ECU_Address@KDDM_EPB1NoComDTC_cnt@ */ Scalar_UBYTE 0 SWC_DDM_type_CM_uint8_cnt 0.0 100.0 /end CHARACTERISTIC
/begin CHARACTERISTIC KDDM_EPB1RCErrDTC_cnt "" VALUE 0x0000 /* @ECU_Address@KDDM_EPB1RCErrDTC_cnt@ */ Scalar_UBYTE 0 SWC_DDM_type_CM_uint8_cnt 0.0 100.0 /end CHARACTERISTIC
/begin CHARACTERISTIC KDDM_EPBLockTODTC_cnt "" VALUE 0x0000 /* @ECU_Address@KDDM_EPBLockTODTC_cnt@ */ Scalar_UBYTE 0 SWC_DDM_type_CM_uint8_cnt 0.0 100.0 /end CHARACTERISTIC
/begin CHARACTERISTIC KDDM_EPBSigErrDTC_cnt "" VALUE 0x0000 /* @ECU_Address@KDDM_EPBSigErrDTC_cnt@ */ Scalar_UBYTE 0 SWC_DDM_type_CM_uint8_cnt 0.0 100.0 /end CHARACTERISTIC
/begin CHARACTERISTIC KDDM_EPBUnlockTODTC_cnt "" VALUE 0x0000 /* @ECU_Address@KDDM_EPBUnlockTODTC_cnt@ */ Scalar_UBYTE 0 SWC_DDM_type_CM_uint8_cnt 0.0 100.0 /end CHARACTERISTIC
/begin CHARACTERISTIC KDDM_ESC1CSErrDTC_cnt "" VALUE 0x0000 /* @ECU_Address@KDDM_ESC1CSErrDTC_cnt@ */ Scalar_UBYTE 0 SWC_DDM_type_CM_uint8_cnt 0.0 100.0 /end CHARACTERISTIC
/begin CHARACTERISTIC KDDM_ESC1NoComDTC_cnt "" VALUE 0x0000 /* @ECU_Address@KDDM_ESC1NoComDTC_cnt@ */ Scalar_UBYTE 0 SWC_DDM_type_CM_uint8_cnt 0.0 100.0 /end CHARACTERISTIC
/begin CHARACTERISTIC KDDM_ESC1RCErrDTC_cnt "" VALUE 0x0000 /* @ECU_Address@KDDM_ESC1RCErrDTC_cnt@ */ Scalar_UBYTE 0 SWC_DDM_type_CM_uint8_cnt 0.0 100.0 /end CHARACTERISTIC
/begin CHARACTERISTIC KDDM_ESC5CSErrDTC_cnt "" VALUE 0x0000 /* @ECU_Address@KDDM_ESC5CSErrDTC_cnt@ */ Scalar_UBYTE 0 SWC_DDM_type_CM_uint8_cnt 0.0 100.0 /end CHARACTERISTIC
/begin CHARACTERISTIC KDDM_ESC5NoComDTC_cnt "" VALUE 0x0000 /* @ECU_Address@KDDM_ESC5NoComDTC_cnt@ */ Scalar_UBYTE 0 SWC_DDM_type_CM_uint8_cnt 0.0 100.0 /end CHARACTERISTIC
/begin CHARACTERISTIC KDDM_ESC5RCErrDTC_cnt "" VALUE 0x0000 /* @ECU_Address@KDDM_ESC5RCErrDTC_cnt@ */ Scalar_UBYTE 0 SWC_DDM_type_CM_uint8_cnt 0.0 100.0 /end CHARACTERISTIC
/begin CHARACTERISTIC KDDM_FLDoorSWDTC_cnt "" VALUE 0x0000 /* @ECU_Address@KDDM_FLDoorSWDTC_cnt@ */ Scalar_UBYTE 0 SWC_DDM_type_CM_uint8_cnt 0.0 255.0 /end CHARACTERISTIC
/begin CHARACTERISTIC KDDM_FRDoorSWDTC_cnt "" VALUE 0x0000 /* @ECU_Address@KDDM_FRDoorSWDTC_cnt@ */ Scalar_UBYTE 0 SWC_DDM_type_CM_uint8_cnt 0.0 255.0 /end CHARACTERISTIC
/begin CHARACTERISTIC KDDM_FrMCUTqErrDTC_cnt "" VALUE 0x0000 /* @ECU_Address@KDDM_FrMCUTqErrDTC_cnt@ */ Scalar_UBYTE 0 SWC_DDM_type_CM_uint8_cnt 0.0 100.0 /end CHARACTERISTIC
/begin CHARACTERISTIC KDDM_FrVCUNoComDTC_cnt "" VALUE 0x0000 /* @ECU_Address@KDDM_FrVCUNoComDTC_cnt@ */ Scalar_UBYTE 0 SWC_DDM_type_CM_uint8_cnt 0.0 100.0 /end CHARACTERISTIC
/begin CHARACTERISTIC KDDM_HVRlyCloDTC_cnt "" VALUE 0x0000 /* @ECU_Address@KDDM_HVRlyCloDTC_cnt@ */ Scalar_UBYTE 0 SWC_DDM_type_CM_uint8_cnt 0.0 255.0 /end CHARACTERISTIC
/begin CHARACTERISTIC KDDM_HVRlyOpDTC_cnt "" VALUE 0x0000 /* @ECU_Address@KDDM_HVRlyOpDTC_cnt@ */ Scalar_UBYTE 0 SWC_DDM_type_CM_uint8_cnt 0.0 255.0 /end CHARACTERISTIC
/begin CHARACTERISTIC KDDM_HoodSWDTC_cnt "" VALUE 0x0000 /* @ECU_Address@KDDM_HoodSWDTC_cnt@ */ Scalar_UBYTE 0 SWC_DDM_type_CM_uint8_cnt 0.0 255.0 /end CHARACTERISTIC
/begin CHARACTERISTIC KDDM_IniLVLoDTC_cnt "" VALUE 0x0000 /* @ECU_Address@KDDM_IniLVLoDTC_cnt@ */ Scalar_UBYTE 0 SWC_DDM_type_CM_uint8_cnt 0.0 255.0 /end CHARACTERISTIC
/begin CHARACTERISTIC KDDM_KeyAuthDTC_cnt "" VALUE 0x0000 /* @ECU_Address@KDDM_KeyAuthDTC_cnt@ */ Scalar_UBYTE 0 SWC_DDM_type_CM_uint8_cnt 0.0 255.0 /end CHARACTERISTIC
/begin CHARACTERISTIC KDDM_LFBatwarnDTC_cnt "" VALUE 0x0000 /* @ECU_Address@KDDM_LFBatwarnDTC_cnt@ */ Scalar_UBYTE 0 SWC_DDM_type_CM_uint8_cnt 0.0 100.0 /end CHARACTERISTIC
/begin CHARACTERISTIC KDDM_LFPressIndiDTC_cnt "" VALUE 0x0000 /* @ECU_Address@KDDM_LFPressIndiDTC_cnt@ */ Scalar_UBYTE 0 SWC_DDM_type_CM_uint8_cnt 0.0 100.0 /end CHARACTERISTIC
/begin CHARACTERISTIC KDDM_LFSensorFailDTC_cnt "" VALUE 0x0000 /* @ECU_Address@KDDM_LFSensorFailDTC_cnt@ */ Scalar_UBYTE 0 SWC_DDM_type_CM_uint8_cnt 0.0 100.0 /end CHARACTERISTIC
/begin CHARACTERISTIC KDDM_LFWheelTmpHighDTC_cnt "" VALUE 0x0000 /* @ECU_Address@KDDM_LFWheelTmpHighDTC_cnt@ */ Scalar_UBYTE 0 SWC_DDM_type_CM_uint8_cnt 0.0 100.0 /end CHARACTERISTIC
/begin CHARACTERISTIC KDDM_LRBatwarnDTC_cnt "" VALUE 0x0000 /* @ECU_Address@KDDM_LRBatwarnDTC_cnt@ */ Scalar_UBYTE 0 SWC_DDM_type_CM_uint8_cnt 0.0 100.0 /end CHARACTERISTIC
/begin CHARACTERISTIC KDDM_LRPressIndiDTC_cnt "" VALUE 0x0000 /* @ECU_Address@KDDM_LRPressIndiDTC_cnt@ */ Scalar_UBYTE 0 SWC_DDM_type_CM_uint8_cnt 0.0 100.0 /end CHARACTERISTIC
/begin CHARACTERISTIC KDDM_LRSensorFailDTC_cnt "" VALUE 0x0000 /* @ECU_Address@KDDM_LRSensorFailDTC_cnt@ */ Scalar_UBYTE 0 SWC_DDM_type_CM_uint8_cnt 0.0 100.0 /end CHARACTERISTIC
/begin CHARACTERISTIC KDDM_LRWheelTmpHighDTC_cnt "" VALUE 0x0000 /* @ECU_Address@KDDM_LRWheelTmpHighDTC_cnt@ */ Scalar_UBYTE 0 SWC_DDM_type_CM_uint8_cnt 0.0 100.0 /end CHARACTERISTIC
/begin CHARACTERISTIC KDDM_LVInErrDTC_cnt "" VALUE 0x0000 /* @ECU_Address@KDDM_LVInErrDTC_cnt@ */ Scalar_UBYTE 0 SWC_DDM_type_CM_uint8_cnt 0.0 100.0 /end CHARACTERISTIC
/begin CHARACTERISTIC KDDM_LVInErr_pct "" VALUE 0x0000 /* @ECU_Address@KDDM_LVInErr_pct@ */ Scalar_UBYTE 0 SWC_DDM_type_CM_uint8_cnt 0.0 100.0 /end CHARACTERISTIC
/begin CHARACTERISTIC KDDM_LVSupHiDTC_cnt "" VALUE 0x0000 /* @ECU_Address@KDDM_LVSupHiDTC_cnt@ */ Scalar_UBYTE 0 SWC_DDM_type_CM_uint8_cnt 0.0 255.0 /end CHARACTERISTIC
/begin CHARACTERISTIC KDDM_LVSupLoDTC_cnt "" VALUE 0x0000 /* @ECU_Address@KDDM_LVSupLoDTC_cnt@ */ Scalar_UBYTE 0 SWC_DDM_type_CM_uint8_cnt 0.0 255.0 /end CHARACTERISTIC
/begin CHARACTERISTIC KDDM_Lv1ErrDTC_cnt "" VALUE 0x0000 /* @ECU_Address@KDDM_Lv1ErrDTC_cnt@ */ Scalar_UBYTE 0 SWC_DDM_type_CM_uint8_cnt 0.0 255.0 /end CHARACTERISTIC
/begin CHARACTERISTIC KDDM_Lv2ErrDTC_cnt "" VALUE 0x0000 /* @ECU_Address@KDDM_Lv2ErrDTC_cnt@ */ Scalar_UBYTE 0 SWC_DDM_type_CM_uint8_cnt 0.0 255.0 /end CHARACTERISTIC
/begin CHARACTERISTIC KDDM_Lv3ErrDTC_cnt "" VALUE 0x0000 /* @ECU_Address@KDDM_Lv3ErrDTC_cnt@ */ Scalar_UBYTE 0 SWC_DDM_type_CM_uint8_cnt 0.0 255.0 /end CHARACTERISTIC
/begin CHARACTERISTIC KDDM_Lv4ErrDTC_cnt "" VALUE 0x0000 /* @ECU_Address@KDDM_Lv4ErrDTC_cnt@ */ Scalar_UBYTE 0 SWC_DDM_type_CM_uint8_cnt 0.0 255.0 /end CHARACTERISTIC
/begin CHARACTERISTIC KDDM_MCUF1CSErrDTC_cnt "" VALUE 0x0000 /* @ECU_Address@KDDM_MCUF1CSErrDTC_cnt@ */ Scalar_UBYTE 0 SWC_DDM_type_CM_uint8_cnt 0.0 100.0 /end CHARACTERISTIC
/begin CHARACTERISTIC KDDM_MCUF1NoComDTC_cnt "" VALUE 0x0000 /* @ECU_Address@KDDM_MCUF1NoComDTC_cnt@ */ Scalar_UBYTE 0 SWC_DDM_type_CM_uint8_cnt 0.0 100.0 /end CHARACTERISTIC
/begin CHARACTERISTIC KDDM_MCUF1RCErrDTC_cnt "" VALUE 0x0000 /* @ECU_Address@KDDM_MCUF1RCErrDTC_cnt@ */ Scalar_UBYTE 0 SWC_DDM_type_CM_uint8_cnt 0.0 100.0 /end CHARACTERISTIC
/begin CHARACTERISTIC KDDM_MCUR1CSErrDTC_cnt "" VALUE 0x0000 /* @ECU_Address@KDDM_MCUR1CSErrDTC_cnt@ */ Scalar_UBYTE 0 SWC_DDM_type_CM_uint8_cnt 0.0 100.0 /end CHARACTERISTIC
/begin CHARACTERISTIC KDDM_MCUR1NoComDTC_cnt "" VALUE 0x0000 /* @ECU_Address@KDDM_MCUR1NoComDTC_cnt@ */ Scalar_UBYTE 0 SWC_DDM_type_CM_uint8_cnt 0.0 100.0 /end CHARACTERISTIC
/begin CHARACTERISTIC KDDM_MCUR1RCErrDTC_cnt "" VALUE 0x0000 /* @ECU_Address@KDDM_MCUR1RCErrDTC_cnt@ */ Scalar_UBYTE 0 SWC_DDM_type_CM_uint8_cnt 0.0 100.0 /end CHARACTERISTIC
/begin CHARACTERISTIC KDDM_ONtoRdyDTC_cnt "" VALUE 0x0000 /* @ECU_Address@KDDM_ONtoRdyDTC_cnt@ */ Scalar_UBYTE 0 SWC_DDM_type_CM_uint8_cnt 0.0 255.0 /end CHARACTERISTIC
/begin CHARACTERISTIC KDDM_RFBatwarnDTC_cnt "" VALUE 0x0000 /* @ECU_Address@KDDM_RFBatwarnDTC_cnt@ */ Scalar_UBYTE 0 SWC_DDM_type_CM_uint8_cnt 0.0 100.0 /end CHARACTERISTIC
/begin CHARACTERISTIC KDDM_RFPressIndiDTC_cnt "" VALUE 0x0000 /* @ECU_Address@KDDM_RFPressIndiDTC_cnt@ */ Scalar_UBYTE 0 SWC_DDM_type_CM_uint8_cnt 0.0 100.0 /end CHARACTERISTIC
/begin CHARACTERISTIC KDDM_RFSensorFailDTC_cnt "" VALUE 0x0000 /* @ECU_Address@KDDM_RFSensorFailDTC_cnt@ */ Scalar_UBYTE 0 SWC_DDM_type_CM_uint8_cnt 0.0 100.0 /end CHARACTERISTIC
/begin CHARACTERISTIC KDDM_RFWheelTmpHighDTC_cnt "" VALUE 0x0000 /* @ECU_Address@KDDM_RFWheelTmpHighDTC_cnt@ */ Scalar_UBYTE 0 SWC_DDM_type_CM_uint8_cnt 0.0 100.0 /end CHARACTERISTIC
/begin CHARACTERISTIC KDDM_RLDoorSWDTC_cnt "" VALUE 0x0000 /* @ECU_Address@KDDM_RLDoorSWDTC_cnt@ */ Scalar_UBYTE 0 SWC_DDM_type_CM_uint8_cnt 0.0 255.0 /end CHARACTERISTIC
/begin CHARACTERISTIC KDDM_RRBatwarnDTC_cnt "" VALUE 0x0000 /* @ECU_Address@KDDM_RRBatwarnDTC_cnt@ */ Scalar_UBYTE 0 SWC_DDM_type_CM_uint8_cnt 0.0 100.0 /end CHARACTERISTIC
/begin CHARACTERISTIC KDDM_RRDoorSWDTC_cnt "" VALUE 0x0000 /* @ECU_Address@KDDM_RRDoorSWDTC_cnt@ */ Scalar_UBYTE 0 SWC_DDM_type_CM_uint8_cnt 0.0 255.0 /end CHARACTERISTIC
/begin CHARACTERISTIC KDDM_RRPressIndiDTC_cnt "" VALUE 0x0000 /* @ECU_Address@KDDM_RRPressIndiDTC_cnt@ */ Scalar_UBYTE 0 SWC_DDM_type_CM_uint8_cnt 0.0 100.0 /end CHARACTERISTIC
/begin CHARACTERISTIC KDDM_RRSensorFailDTC_cnt "" VALUE 0x0000 /* @ECU_Address@KDDM_RRSensorFailDTC_cnt@ */ Scalar_UBYTE 0 SWC_DDM_type_CM_uint8_cnt 0.0 100.0 /end CHARACTERISTIC
/begin CHARACTERISTIC KDDM_RRWheelTmpHighDTC_cnt "" VALUE 0x0000 /* @ECU_Address@KDDM_RRWheelTmpHighDTC_cnt@ */ Scalar_UBYTE 0 SWC_DDM_type_CM_uint8_cnt 0.0 100.0 /end CHARACTERISTIC
/begin CHARACTERISTIC KDDM_RegenErrDTC_cnt "" VALUE 0x0000 /* @ECU_Address@KDDM_RegenErrDTC_cnt@ */ Scalar_UBYTE 0 SWC_DDM_type_CM_uint8_cnt 0.0 255.0 /end CHARACTERISTIC
/begin CHARACTERISTIC KDDM_RrMCUTqErrDTC_cnt "" VALUE 0x0000 /* @ECU_Address@KDDM_RrMCUTqErrDTC_cnt@ */ Scalar_UBYTE 0 SWC_DDM_type_CM_uint8_cnt 0.0 100.0 /end CHARACTERISTIC
/begin CHARACTERISTIC KDDM_Shifter1CSErrDTC_cnt "" VALUE 0x0000 /* @ECU_Address@KDDM_Shifter1CSErrDTC_cnt@ */ Scalar_UBYTE 0 SWC_DDM_type_CM_uint8_cnt 0.0 100.0 /end CHARACTERISTIC
/begin CHARACTERISTIC KDDM_Shifter1NoComDTC_cnt "" VALUE 0x0000 /* @ECU_Address@KDDM_Shifter1NoComDTC_cnt@ */ Scalar_UBYTE 0 SWC_DDM_type_CM_uint8_cnt 0.0 100.0 /end CHARACTERISTIC
/begin CHARACTERISTIC KDDM_Shifter1RCErrDTC_cnt "" VALUE 0x0000 /* @ECU_Address@KDDM_Shifter1RCErrDTC_cnt@ */ Scalar_UBYTE 0 SWC_DDM_type_CM_uint8_cnt 0.0 100.0 /end CHARACTERISTIC
/begin CHARACTERISTIC KDDM_TailgaSWDTC_cnt "" VALUE 0x0000 /* @ECU_Address@KDDM_TailgaSWDTC_cnt@ */ Scalar_UBYTE 0 SWC_DDM_type_CM_uint8_cnt 0.0 255.0 /end CHARACTERISTIC
/begin CHARACTERISTIC ZoneFrMalfunLevel_enum "" VALUE 0x0000 /* @ECU_Address@ZoneFrMalfunLevel_enum@ */ Scalar_UBYTE 0 SWC_DDM_type_CM_uint8_enum 0.0 5.0 /end CHARACTERISTIC
/begin MEASUREMENT VDDM_AuxBatVolt_V "" FLOAT32_IEEE SWC_DDM_type_CM_single_V 0 0 0.0 25.4 ECU_ADDRESS 0x0000 /* @ECU_Address@VDDM_AuxBatVolt_V@ */ /end MEASUREMENT
/begin MEASUREMENT VDDM_FrTMTqDev_Nm "" FLOAT32_IEEE SWC_DDM_type_CM_single_Nm 0 0 0.0 100000.0 ECU_ADDRESS 0x0000 /* @ECU_Address@VDDM_FrTMTqDev_Nm@ */ /end MEASUREMENT
/begin MEASUREMENT VDDM_FrTMTqDiffAbs_Nm "" FLOAT32_IEEE SWC_DDM_type_CM_single_Nm 0 0 0.0 100000.0 ECU_ADDRESS 0x0000 /* @ECU_Address@VDDM_FrTMTqDiffAbs_Nm@ */ /end MEASUREMENT
/begin MEASUREMENT VDDM_RrTMTqDev_Nm "" FLOAT32_IEEE SWC_DDM_type_CM_single_Nm 0 0 0.0 100000.0 ECU_ADDRESS 0x0000 /* @ECU_Address@VDDM_RrTMTqDev_Nm@ */ /end MEASUREMENT
/begin MEASUREMENT VDDM_RrTMTqDiffAbs_Nm "" FLOAT32_IEEE SWC_DDM_type_CM_single_Nm 0 0 0.0 100000.0 ECU_ADDRESS 0x0000 /* @ECU_Address@VDDM_RrTMTqDiffAbs_Nm@ */ /end MEASUREMENT
/begin MEASUREMENT VDDM_CANBrkSW2Sta_enum "" UBYTE SWC_DDM_type_CM_uint8_enum 0 0 0.0 255.0 ECU_ADDRESS 0x0000 /* @ECU_Address@VDDM_CANBrkSW2Sta_enum@ */ /end MEASUREMENT
/begin MEASUREMENT VDDM_BrkPedalPosSta_enum "" UBYTE SWC_DDM_type_CM_uint8_enum 0 0 0.0 255.0 ECU_ADDRESS 0x0000 /* @ECU_Address@VDDM_BrkPedalPosSta_enum@ */ /end MEASUREMENT
/begin MEASUREMENT VDDM_KeyAuthDTC_cnt "" UBYTE SWC_DDM_type_CM_uint8_cnt 0 0 0.0 255.0 ECU_ADDRESS 0x0000 /* @ECU_Address@VDDM_KeyAuthDTC_cnt@ */ /end MEASUREMENT
/begin MEASUREMENT VDDM_ONtoRdyDTC_cnt "" UBYTE SWC_DDM_type_CM_uint8_cnt 0 0 0.0 255.0 ECU_ADDRESS 0x0000 /* @ECU_Address@VDDM_ONtoRdyDTC_cnt@ */ /end MEASUREMENT
/begin MEASUREMENT VDDM_VehMalfunLevelTmp_enum "" UBYTE SWC_DDM_type_CM_uint8_enum 0 0 0.0 255.0 ECU_ADDRESS 0x0000 /* @ECU_Address@VDDM_VehMalfunLevelTmp_enum@ */ /end MEASUREMENT
/begin MEASUREMENT VDDM_VehMalfunLevel_enum "" UBYTE SWC_DDM_type_CM_uint8_enum 0 0 0.0 255.0 ECU_ADDRESS 0x0000 /* @ECU_Address@VDDM_VehMalfunLevel_enum@ */ /end MEASUREMENT
/begin MEASUREMENT VDDM_BrakeSW_enum "" UBYTE SWC_DDM_type_CM_uint8_enum 0 0 0.0 255.0 ECU_ADDRESS 0x0000 /* @ECU_Address@VDDM_BrakeSW_enum@ */ /end MEASUREMENT
/begin MEASUREMENT VDDM_BrakeSigMatrix_enum "" UBYTE SWC_DDM_type_CM_uint8_enum 0 0 0.0 255.0 ECU_ADDRESS 0x0000 /* @ECU_Address@VDDM_BrakeSigMatrix_enum@ */ /end MEASUREMENT
/begin MEASUREMENT VDDM_DTCDetect_enum "" UBYTE SWC_DDM_type_CM_uint8_enum 0 0 0.0 255.0 ECU_ADDRESS 0x0000 /* @ECU_Address@VDDM_DTCDetect_enum@ */ /end MEASUREMENT
/begin MEASUREMENT VDDM_C3BMS6LCPass_flg "" UBYTE SWC_DDM_type_CM_boolean_flg 0 0 0.0 1.0 ECU_ADDRESS 0x0000 /* @ECU_Address@VDDM_C3BMS6LCPass_flg@ */ /end MEASUREMENT
/begin MEASUREMENT VDDM_C3BMS6LCCFSRls_flg "" UBYTE SWC_DDM_type_CM_boolean_flg 0 0 0.0 1.0 ECU_ADDRESS 0x0000 /* @ECU_Address@VDDM_C3BMS6LCCFSRls_flg@ */ /end MEASUREMENT
/begin MEASUREMENT VDDM_C3BMS6RCPass_flg "" UBYTE SWC_DDM_type_CM_boolean_flg 0 0 0.0 1.0 ECU_ADDRESS 0x0000 /* @ECU_Address@VDDM_C3BMS6RCPass_flg@ */ /end MEASUREMENT
/begin MEASUREMENT VDDM_C3BMS6RCCFSRls_flg "" UBYTE SWC_DDM_type_CM_boolean_flg 0 0 0.0 1.0 ECU_ADDRESS 0x0000 /* @ECU_Address@VDDM_C3BMS6RCCFSRls_flg@ */ /end MEASUREMENT
/begin MEASUREMENT VDDM_C3BMS6CSPass_flg "" UBYTE SWC_DDM_type_CM_boolean_flg 0 0 0.0 1.0 ECU_ADDRESS 0x0000 /* @ECU_Address@VDDM_C3BMS6CSPass_flg@ */ /end MEASUREMENT
/begin MEASUREMENT VDDM_C3BMS6CSCFSRls_flg "" UBYTE SWC_DDM_type_CM_boolean_flg 0 0 0.0 1.0 ECU_ADDRESS 0x0000 /* @ECU_Address@VDDM_C3BMS6CSCFSRls_flg@ */ /end MEASUREMENT
/begin MEASUREMENT VDDM_C3BMS1LCPass_flg "" UBYTE SWC_DDM_type_CM_boolean_flg 0 0 0.0 1.0 ECU_ADDRESS 0x0000 /* @ECU_Address@VDDM_C3BMS1LCPass_flg@ */ /end MEASUREMENT
/begin MEASUREMENT VDDM_C3BMS1LCCFSRls_flg "" UBYTE SWC_DDM_type_CM_boolean_flg 0 0 0.0 1.0 ECU_ADDRESS 0x0000 /* @ECU_Address@VDDM_C3BMS1LCCFSRls_flg@ */ /end MEASUREMENT
/begin MEASUREMENT VDDM_C3BMS1RCPass_flg "" UBYTE SWC_DDM_type_CM_boolean_flg 0 0 0.0 1.0 ECU_ADDRESS 0x0000 /* @ECU_Address@VDDM_C3BMS1RCPass_flg@ */ /end MEASUREMENT
/begin MEASUREMENT VDDM_C3BMS1RCCFSRls_flg "" UBYTE SWC_DDM_type_CM_boolean_flg 0 0 0.0 1.0 ECU_ADDRESS 0x0000 /* @ECU_Address@VDDM_C3BMS1RCCFSRls_flg@ */ /end MEASUREMENT
/begin MEASUREMENT VDDM_C3BMS1CSPass_flg "" UBYTE SWC_DDM_type_CM_boolean_flg 0 0 0.0 1.0 ECU_ADDRESS 0x0000 /* @ECU_Address@VDDM_C3BMS1CSPass_flg@ */ /end MEASUREMENT
/begin MEASUREMENT VDDM_C3BMS1CSCFSRls_flg "" UBYTE SWC_DDM_type_CM_boolean_flg 0 0 0.0 1.0 ECU_ADDRESS 0x0000 /* @ECU_Address@VDDM_C3BMS1CSCFSRls_flg@ */ /end MEASUREMENT
/begin MEASUREMENT VDDM_C3CCU1LCPass_flg "" UBYTE SWC_DDM_type_CM_boolean_flg 0 0 0.0 1.0 ECU_ADDRESS 0x0000 /* @ECU_Address@VDDM_C3CCU1LCPass_flg@ */ /end MEASUREMENT
/begin MEASUREMENT VDDM_C3CCU1LCCFSRls_flg "" UBYTE SWC_DDM_type_CM_boolean_flg 0 0 0.0 1.0 ECU_ADDRESS 0x0000 /* @ECU_Address@VDDM_C3CCU1LCCFSRls_flg@ */ /end MEASUREMENT
/begin MEASUREMENT VDDM_C3CCU1RCPass_flg "" UBYTE SWC_DDM_type_CM_boolean_flg 0 0 0.0 1.0 ECU_ADDRESS 0x0000 /* @ECU_Address@VDDM_C3CCU1RCPass_flg@ */ /end MEASUREMENT
/begin MEASUREMENT VDDM_C3CCU1RCCFSRls_flg "" UBYTE SWC_DDM_type_CM_boolean_flg 0 0 0.0 1.0 ECU_ADDRESS 0x0000 /* @ECU_Address@VDDM_C3CCU1RCCFSRls_flg@ */ /end MEASUREMENT
/begin MEASUREMENT VDDM_C3CCU1CSPass_flg "" UBYTE SWC_DDM_type_CM_boolean_flg 0 0 0.0 1.0 ECU_ADDRESS 0x0000 /* @ECU_Address@VDDM_C3CCU1CSPass_flg@ */ /end MEASUREMENT
/begin MEASUREMENT VDDM_C3CCU1CSCFSRls_flg "" UBYTE SWC_DDM_type_CM_boolean_flg 0 0 0.0 1.0 ECU_ADDRESS 0x0000 /* @ECU_Address@VDDM_C3CCU1CSCFSRls_flg@ */ /end MEASUREMENT
/begin MEASUREMENT VDDM_C3CCU2LCPass_flg "" UBYTE SWC_DDM_type_CM_boolean_flg 0 0 0.0 1.0 ECU_ADDRESS 0x0000 /* @ECU_Address@VDDM_C3CCU2LCPass_flg@ */ /end MEASUREMENT
/begin MEASUREMENT VDDM_C3CCU2LCCFSRls_flg "" UBYTE SWC_DDM_type_CM_boolean_flg 0 0 0.0 1.0 ECU_ADDRESS 0x0000 /* @ECU_Address@VDDM_C3CCU2LCCFSRls_flg@ */ /end MEASUREMENT
/begin MEASUREMENT VDDM_C3CCU2RCPass_flg "" UBYTE SWC_DDM_type_CM_boolean_flg 0 0 0.0 1.0 ECU_ADDRESS 0x0000 /* @ECU_Address@VDDM_C3CCU2RCPass_flg@ */ /end MEASUREMENT
/begin MEASUREMENT VDDM_C3CCU2RCCFSRls_flg "" UBYTE SWC_DDM_type_CM_boolean_flg 0 0 0.0 1.0 ECU_ADDRESS 0x0000 /* @ECU_Address@VDDM_C3CCU2RCCFSRls_flg@ */ /end MEASUREMENT
/begin MEASUREMENT VDDM_C3CCU2CSPass_flg "" UBYTE SWC_DDM_type_CM_boolean_flg 0 0 0.0 1.0 ECU_ADDRESS 0x0000 /* @ECU_Address@VDDM_C3CCU2CSPass_flg@ */ /end MEASUREMENT
/begin MEASUREMENT VDDM_C3CCU2CSCFSRls_flg "" UBYTE SWC_DDM_type_CM_boolean_flg 0 0 0.0 1.0 ECU_ADDRESS 0x0000 /* @ECU_Address@VDDM_C3CCU2CSCFSRls_flg@ */ /end MEASUREMENT
/begin MEASUREMENT VDDM_C1ABM1LCPass_flg "" UBYTE SWC_DDM_type_CM_boolean_flg 0 0 0.0 1.0 ECU_ADDRESS 0x0000 /* @ECU_Address@VDDM_C1ABM1LCPass_flg@ */ /end MEASUREMENT
/begin MEASUREMENT VDDM_C1ABM1LCCFSRls_flg "" UBYTE SWC_DDM_type_CM_boolean_flg 0 0 0.0 1.0 ECU_ADDRESS 0x0000 /* @ECU_Address@VDDM_C1ABM1LCCFSRls_flg@ */ /end MEASUREMENT
/begin MEASUREMENT VDDM_C1ABM1RCPass_flg "" UBYTE SWC_DDM_type_CM_boolean_flg 0 0 0.0 1.0 ECU_ADDRESS 0x0000 /* @ECU_Address@VDDM_C1ABM1RCPass_flg@ */ /end MEASUREMENT
/begin MEASUREMENT VDDM_C1ABM1RCCFSRls_flg "" UBYTE SWC_DDM_type_CM_boolean_flg 0 0 0.0 1.0 ECU_ADDRESS 0x0000 /* @ECU_Address@VDDM_C1ABM1RCCFSRls_flg@ */ /end MEASUREMENT
/begin MEASUREMENT VDDM_C1ABM1CSPass_flg "" UBYTE SWC_DDM_type_CM_boolean_flg 0 0 0.0 1.0 ECU_ADDRESS 0x0000 /* @ECU_Address@VDDM_C1ABM1CSPass_flg@ */ /end MEASUREMENT
/begin MEASUREMENT VDDM_C1ABM1CSCFSRls_flg "" UBYTE SWC_DDM_type_CM_boolean_flg 0 0 0.0 1.0 ECU_ADDRESS 0x0000 /* @ECU_Address@VDDM_C1ABM1CSCFSRls_flg@ */ /end MEASUREMENT
/begin MEASUREMENT VDDM_ESC1NoComCFSRls_flg "" UBYTE SWC_DDM_type_CM_boolean_flg 0 0 0.0 1.0 ECU_ADDRESS 0x0000 /* @ECU_Address@VDDM_ESC1NoComCFSRls_flg@ */ /end MEASUREMENT
/begin MEASUREMENT VDDM_ESC1RCErrCFSRls_flg "" UBYTE SWC_DDM_type_CM_boolean_flg 0 0 0.0 1.0 ECU_ADDRESS 0x0000 /* @ECU_Address@VDDM_ESC1RCErrCFSRls_flg@ */ /end MEASUREMENT
/begin MEASUREMENT VDDM_ESC1CSErrCFSRls_flg "" UBYTE SWC_DDM_type_CM_boolean_flg 0 0 0.0 1.0 ECU_ADDRESS 0x0000 /* @ECU_Address@VDDM_ESC1CSErrCFSRls_flg@ */ /end MEASUREMENT
/begin MEASUREMENT VDDM_ESC5NoComPass_flg "" UBYTE SWC_DDM_type_CM_boolean_flg 0 0 0.0 1.0 ECU_ADDRESS 0x0000 /* @ECU_Address@VDDM_ESC5NoComPass_flg@ */ /end MEASUREMENT
/begin MEASUREMENT VDDM_ESC5NoComCFSRls_flg "" UBYTE SWC_DDM_type_CM_boolean_flg 0 0 0.0 1.0 ECU_ADDRESS 0x0000 /* @ECU_Address@VDDM_ESC5NoComCFSRls_flg@ */ /end MEASUREMENT
/begin MEASUREMENT VDDM_ESC5RCErrPass_flg "" UBYTE SWC_DDM_type_CM_boolean_flg 0 0 0.0 1.0 ECU_ADDRESS 0x0000 /* @ECU_Address@VDDM_ESC5RCErrPass_flg@ */ /end MEASUREMENT
/begin MEASUREMENT VDDM_ESC5RCErrCFSRls_flg "" UBYTE SWC_DDM_type_CM_boolean_flg 0 0 0.0 1.0 ECU_ADDRESS 0x0000 /* @ECU_Address@VDDM_ESC5RCErrCFSRls_flg@ */ /end MEASUREMENT
/begin MEASUREMENT VDDM_ESC5CSErrPass_flg "" UBYTE SWC_DDM_type_CM_boolean_flg 0 0 0.0 1.0 ECU_ADDRESS 0x0000 /* @ECU_Address@VDDM_ESC5CSErrPass_flg@ */ /end MEASUREMENT
/begin MEASUREMENT VDDM_ESC5CSErrCFSRls_flg "" UBYTE SWC_DDM_type_CM_boolean_flg 0 0 0.0 1.0 ECU_ADDRESS 0x0000 /* @ECU_Address@VDDM_ESC5CSErrCFSRls_flg@ */ /end MEASUREMENT
/begin MEASUREMENT VDDM_OBCFaultLv1_flg "" UBYTE SWC_DDM_type_CM_boolean_flg 0 0 0.0 1.0 ECU_ADDRESS 0x0000 /* @ECU_Address@VDDM_OBCFaultLv1_flg@ */ /end MEASUREMENT
/begin MEASUREMENT VDDM_DCDCFaultLv1_flg "" UBYTE SWC_DDM_type_CM_boolean_flg 0 0 0.0 1.0 ECU_ADDRESS 0x0000 /* @ECU_Address@VDDM_DCDCFaultLv1_flg@ */ /end MEASUREMENT
/begin MEASUREMENT VDDM_MCUR1NoComPass_flg "" UBYTE SWC_DDM_type_CM_boolean_flg 0 0 0.0 1.0 ECU_ADDRESS 0x0000 /* @ECU_Address@VDDM_MCUR1NoComPass_flg@ */ /end MEASUREMENT
/begin MEASUREMENT VDDM_MCUR1NoComCFSRls_flg "" UBYTE SWC_DDM_type_CM_boolean_flg 0 0 0.0 1.0 ECU_ADDRESS 0x0000 /* @ECU_Address@VDDM_MCUR1NoComCFSRls_flg@ */ /end MEASUREMENT
/begin MEASUREMENT VDDM_MCUR1RCErrPass_flg "" UBYTE SWC_DDM_type_CM_boolean_flg 0 0 0.0 1.0 ECU_ADDRESS 0x0000 /* @ECU_Address@VDDM_MCUR1RCErrPass_flg@ */ /end MEASUREMENT
/begin MEASUREMENT VDDM_MCUR1RCErrCFSRls_flg "" UBYTE SWC_DDM_type_CM_boolean_flg 0 0 0.0 1.0 ECU_ADDRESS 0x0000 /* @ECU_Address@VDDM_MCUR1RCErrCFSRls_flg@ */ /end MEASUREMENT
/begin MEASUREMENT VDDM_MCUR1CSErrPass_flg "" UBYTE SWC_DDM_type_CM_boolean_flg 0 0 0.0 1.0 ECU_ADDRESS 0x0000 /* @ECU_Address@VDDM_MCUR1CSErrPass_flg@ */ /end MEASUREMENT
/begin MEASUREMENT VDDM_MCUR1CSErrCFSRls_flg "" UBYTE SWC_DDM_type_CM_boolean_flg 0 0 0.0 1.0 ECU_ADDRESS 0x0000 /* @ECU_Address@VDDM_MCUR1CSErrCFSRls_flg@ */ /end MEASUREMENT
/begin MEASUREMENT VDDM_MCUR1FaultLv1_flg "" UBYTE SWC_DDM_type_CM_boolean_flg 0 0 0.0 1.0 ECU_ADDRESS 0x0000 /* @ECU_Address@VDDM_MCUR1FaultLv1_flg@ */ /end MEASUREMENT
/begin MEASUREMENT VDDM_MCUF1NoComPass_flg "" UBYTE SWC_DDM_type_CM_boolean_flg 0 0 0.0 1.0 ECU_ADDRESS 0x0000 /* @ECU_Address@VDDM_MCUF1NoComPass_flg@ */ /end MEASUREMENT
/begin MEASUREMENT VDDM_MCUF1NoComCFSRls_flg "" UBYTE SWC_DDM_type_CM_boolean_flg 0 0 0.0 1.0 ECU_ADDRESS 0x0000 /* @ECU_Address@VDDM_MCUF1NoComCFSRls_flg@ */ /end MEASUREMENT
/begin MEASUREMENT VDDM_MCUF1RCErrPass_flg "" UBYTE SWC_DDM_type_CM_boolean_flg 0 0 0.0 1.0 ECU_ADDRESS 0x0000 /* @ECU_Address@VDDM_MCUF1RCErrPass_flg@ */ /end MEASUREMENT
/begin MEASUREMENT VDDM_MCUF1RCErrCFSRls_flg "" UBYTE SWC_DDM_type_CM_boolean_flg 0 0 0.0 1.0 ECU_ADDRESS 0x0000 /* @ECU_Address@VDDM_MCUF1RCErrCFSRls_flg@ */ /end MEASUREMENT
/begin MEASUREMENT VDDM_MCUF1CSErrPass_flg "" UBYTE SWC_DDM_type_CM_boolean_flg 0 0 0.0 1.0 ECU_ADDRESS 0x0000 /* @ECU_Address@VDDM_MCUF1CSErrPass_flg@ */ /end MEASUREMENT
/begin MEASUREMENT VDDM_MCUF1CSErrCFSRls_flg "" UBYTE SWC_DDM_type_CM_boolean_flg 0 0 0.0 1.0 ECU_ADDRESS 0x0000 /* @ECU_Address@VDDM_MCUF1CSErrCFSRls_flg@ */ /end MEASUREMENT
/begin MEASUREMENT VDDM_MCUF1FaultLv1_flg "" UBYTE SWC_DDM_type_CM_boolean_flg 0 0 0.0 1.0 ECU_ADDRESS 0x0000 /* @ECU_Address@VDDM_MCUF1FaultLv1_flg@ */ /end MEASUREMENT
/begin MEASUREMENT VDDM_BMSFaultLv1_flg "" UBYTE SWC_DDM_type_CM_boolean_flg 0 0 0.0 1.0 ECU_ADDRESS 0x0000 /* @ECU_Address@VDDM_BMSFaultLv1_flg@ */ /end MEASUREMENT
/begin MEASUREMENT VDDM_ESCFaultLv1_flg "" UBYTE SWC_DDM_type_CM_boolean_flg 0 0 0.0 1.0 ECU_ADDRESS 0x0000 /* @ECU_Address@VDDM_ESCFaultLv1_flg@ */ /end MEASUREMENT
/begin MEASUREMENT VDDM_Shifter1NoComPass_flg "" UBYTE SWC_DDM_type_CM_boolean_flg 0 0 0.0 1.0 ECU_ADDRESS 0x0000 /* @ECU_Address@VDDM_Shifter1NoComPass_flg@ */ /end MEASUREMENT
/begin MEASUREMENT VDDM_Shifter1NoComCFSRls_flg "" UBYTE SWC_DDM_type_CM_boolean_flg 0 0 0.0 1.0 ECU_ADDRESS 0x0000 /* @ECU_Address@VDDM_Shifter1NoComCFSRls_flg@ */ /end MEASUREMENT
/begin MEASUREMENT VDDM_Shifter1RCErrPass_flg "" UBYTE SWC_DDM_type_CM_boolean_flg 0 0 0.0 1.0 ECU_ADDRESS 0x0000 /* @ECU_Address@VDDM_Shifter1RCErrPass_flg@ */ /end MEASUREMENT
/begin MEASUREMENT VDDM_Shifter1RCErrCFSRls_flg "" UBYTE SWC_DDM_type_CM_boolean_flg 0 0 0.0 1.0 ECU_ADDRESS 0x0000 /* @ECU_Address@VDDM_Shifter1RCErrCFSRls_flg@ */ /end MEASUREMENT
/begin MEASUREMENT VDDM_Shifter1CSErrPass_flg "" UBYTE SWC_DDM_type_CM_boolean_flg 0 0 0.0 1.0 ECU_ADDRESS 0x0000 /* @ECU_Address@VDDM_Shifter1CSErrPass_flg@ */ /end MEASUREMENT
/begin MEASUREMENT VDDM_Shifter1CSErrCFSRls_flg "" UBYTE SWC_DDM_type_CM_boolean_flg 0 0 0.0 1.0 ECU_ADDRESS 0x0000 /* @ECU_Address@VDDM_Shifter1CSErrCFSRls_flg@ */ /end MEASUREMENT
/begin MEASUREMENT VDDM_ShifterFaultLv1_flg "" UBYTE SWC_DDM_type_CM_boolean_flg 0 0 0.0 1.0 ECU_ADDRESS 0x0000 /* @ECU_Address@VDDM_ShifterFaultLv1_flg@ */ /end MEASUREMENT
/begin MEASUREMENT VDDM_DrVCUNoComPass_flg "" UBYTE SWC_DDM_type_CM_boolean_flg 0 0 0.0 1.0 ECU_ADDRESS 0x0000 /* @ECU_Address@VDDM_DrVCUNoComPass_flg@ */ /end MEASUREMENT
/begin MEASUREMENT VDDM_DrVCUNoComCFSRls_flg "" UBYTE SWC_DDM_type_CM_boolean_flg 0 0 0.0 1.0 ECU_ADDRESS 0x0000 /* @ECU_Address@VDDM_DrVCUNoComCFSRls_flg@ */ /end MEASUREMENT
/begin MEASUREMENT VDDM_ZoneDrFaultLv1_flg "" UBYTE SWC_DDM_type_CM_boolean_flg 0 0 0.0 1.0 ECU_ADDRESS 0x0000 /* @ECU_Address@VDDM_ZoneDrFaultLv1_flg@ */ /end MEASUREMENT
/begin MEASUREMENT VDDM_FrVCUNoComPass_flg "" UBYTE SWC_DDM_type_CM_boolean_flg 0 0 0.0 1.0 ECU_ADDRESS 0x0000 /* @ECU_Address@VDDM_FrVCUNoComPass_flg@ */ /end MEASUREMENT
/begin MEASUREMENT VDDM_FrVCUNoComCFSRls_flg "" UBYTE SWC_DDM_type_CM_boolean_flg 0 0 0.0 1.0 ECU_ADDRESS 0x0000 /* @ECU_Address@VDDM_FrVCUNoComCFSRls_flg@ */ /end MEASUREMENT
/begin MEASUREMENT VDDM_ZoneFrFaultLv1_flg "" UBYTE SWC_DDM_type_CM_boolean_flg 0 0 0.0 1.0 ECU_ADDRESS 0x0000 /* @ECU_Address@VDDM_ZoneFrFaultLv1_flg@ */ /end MEASUREMENT
/begin MEASUREMENT VDDM_AWDMCURrFaultLv1_flg "" UBYTE SWC_DDM_type_CM_boolean_flg 0 0 0.0 1.0 ECU_ADDRESS 0x0000 /* @ECU_Address@VDDM_AWDMCURrFaultLv1_flg@ */ /end MEASUREMENT
/begin MEASUREMENT VDDM_AWDMCUFrFaultLv1_flg "" UBYTE SWC_DDM_type_CM_boolean_flg 0 0 0.0 1.0 ECU_ADDRESS 0x0000 /* @ECU_Address@VDDM_AWDMCUFrFaultLv1_flg@ */ /end MEASUREMENT
/begin MEASUREMENT VDDM_Lv1ErrPass_flg "" UBYTE SWC_DDM_type_CM_boolean_flg 0 0 0.0 1.0 ECU_ADDRESS 0x0000 /* @ECU_Address@VDDM_Lv1ErrPass_flg@ */ /end MEASUREMENT
/begin MEASUREMENT VDDM_Lv1ErrCFSRls_flg "" UBYTE SWC_DDM_type_CM_boolean_flg 0 0 0.0 1.0 ECU_ADDRESS 0x0000 /* @ECU_Address@VDDM_Lv1ErrCFSRls_flg@ */ /end MEASUREMENT
/begin MEASUREMENT VDDM_DCDCFaultLv2_flg "" UBYTE SWC_DDM_type_CM_boolean_flg 0 0 0.0 1.0 ECU_ADDRESS 0x0000 /* @ECU_Address@VDDM_DCDCFaultLv2_flg@ */ /end MEASUREMENT
/begin MEASUREMENT VDDM_MCUR1FaultLv2_flg "" UBYTE SWC_DDM_type_CM_boolean_flg 0 0 0.0 1.0 ECU_ADDRESS 0x0000 /* @ECU_Address@VDDM_MCUR1FaultLv2_flg@ */ /end MEASUREMENT
/begin MEASUREMENT VDDM_MCUF1FaultLv2_flg "" UBYTE SWC_DDM_type_CM_boolean_flg 0 0 0.0 1.0 ECU_ADDRESS 0x0000 /* @ECU_Address@VDDM_MCUF1FaultLv2_flg@ */ /end MEASUREMENT
/begin MEASUREMENT VDDM_BMSFaultLv2_flg "" UBYTE SWC_DDM_type_CM_boolean_flg 0 0 0.0 1.0 ECU_ADDRESS 0x0000 /* @ECU_Address@VDDM_BMSFaultLv2_flg@ */ /end MEASUREMENT
/begin MEASUREMENT VDDM_ZoneDrFaultLv2_flg "" UBYTE SWC_DDM_type_CM_boolean_flg 0 0 0.0 1.0 ECU_ADDRESS 0x0000 /* @ECU_Address@VDDM_ZoneDrFaultLv2_flg@ */ /end MEASUREMENT
/begin MEASUREMENT VDDM_ZoneFrFaultLv2_flg "" UBYTE SWC_DDM_type_CM_boolean_flg 0 0 0.0 1.0 ECU_ADDRESS 0x0000 /* @ECU_Address@VDDM_ZoneFrFaultLv2_flg@ */ /end MEASUREMENT
/begin MEASUREMENT VDDM_AWDMCUFaultLv2_flg "" UBYTE SWC_DDM_type_CM_boolean_flg 0 0 0.0 1.0 ECU_ADDRESS 0x0000 /* @ECU_Address@VDDM_AWDMCUFaultLv2_flg@ */ /end MEASUREMENT
/begin MEASUREMENT VDDM_Lv2ErrPass_flg "" UBYTE SWC_DDM_type_CM_boolean_flg 0 0 0.0 1.0 ECU_ADDRESS 0x0000 /* @ECU_Address@VDDM_Lv2ErrPass_flg@ */ /end MEASUREMENT
/begin MEASUREMENT VDDM_Lv2ErrCFSRls_flg "" UBYTE SWC_DDM_type_CM_boolean_flg 0 0 0.0 1.0 ECU_ADDRESS 0x0000 /* @ECU_Address@VDDM_Lv2ErrCFSRls_flg@ */ /end MEASUREMENT
/begin MEASUREMENT VDDM_MCUR1FaultLv3_flg "" UBYTE SWC_DDM_type_CM_boolean_flg 0 0 0.0 1.0 ECU_ADDRESS 0x0000 /* @ECU_Address@VDDM_MCUR1FaultLv3_flg@ */ /end MEASUREMENT
/begin MEASUREMENT VDDM_MCUF1FaultLv3_flg "" UBYTE SWC_DDM_type_CM_boolean_flg 0 0 0.0 1.0 ECU_ADDRESS 0x0000 /* @ECU_Address@VDDM_MCUF1FaultLv3_flg@ */ /end MEASUREMENT
/begin MEASUREMENT VDDM_BMSFaultLv3_flg "" UBYTE SWC_DDM_type_CM_boolean_flg 0 0 0.0 1.0 ECU_ADDRESS 0x0000 /* @ECU_Address@VDDM_BMSFaultLv3_flg@ */ /end MEASUREMENT
/begin MEASUREMENT VDDM_ZoneDrFaultLv3_flg "" UBYTE SWC_DDM_type_CM_boolean_flg 0 0 0.0 1.0 ECU_ADDRESS 0x0000 /* @ECU_Address@VDDM_ZoneDrFaultLv3_flg@ */ /end MEASUREMENT
/begin MEASUREMENT VDDM_ZoneFrFaultLv3_flg "" UBYTE SWC_DDM_type_CM_boolean_flg 0 0 0.0 1.0 ECU_ADDRESS 0x0000 /* @ECU_Address@VDDM_ZoneFrFaultLv3_flg@ */ /end MEASUREMENT
/begin MEASUREMENT VDDM_Lv3ErrPass_flg "" UBYTE SWC_DDM_type_CM_boolean_flg 0 0 0.0 1.0 ECU_ADDRESS 0x0000 /* @ECU_Address@VDDM_Lv3ErrPass_flg@ */ /end MEASUREMENT
/begin MEASUREMENT VDDM_Lv3ErrCFSRls_flg "" UBYTE SWC_DDM_type_CM_boolean_flg 0 0 0.0 1.0 ECU_ADDRESS 0x0000 /* @ECU_Address@VDDM_Lv3ErrCFSRls_flg@ */ /end MEASUREMENT
/begin MEASUREMENT VDDM_BMSFaultLv4_flg "" UBYTE SWC_DDM_type_CM_boolean_flg 0 0 0.0 1.0 ECU_ADDRESS 0x0000 /* @ECU_Address@VDDM_BMSFaultLv4_flg@ */ /end MEASUREMENT
/begin MEASUREMENT VDDM_ZoneDrFaultLv4_flg "" UBYTE SWC_DDM_type_CM_boolean_flg 0 0 0.0 1.0 ECU_ADDRESS 0x0000 /* @ECU_Address@VDDM_ZoneDrFaultLv4_flg@ */ /end MEASUREMENT
/begin MEASUREMENT VDDM_ZoneFrFaultLv4_flg "" UBYTE SWC_DDM_type_CM_boolean_flg 0 0 0.0 1.0 ECU_ADDRESS 0x0000 /* @ECU_Address@VDDM_ZoneFrFaultLv4_flg@ */ /end MEASUREMENT
/begin MEASUREMENT VDDM_Lv4ErrPass_flg "" UBYTE SWC_DDM_type_CM_boolean_flg 0 0 0.0 1.0 ECU_ADDRESS 0x0000 /* @ECU_Address@VDDM_Lv4ErrPass_flg@ */ /end MEASUREMENT
/begin MEASUREMENT VDDM_Lv4ErrCFSRls_flg "" UBYTE SWC_DDM_type_CM_boolean_flg 0 0 0.0 1.0 ECU_ADDRESS 0x0000 /* @ECU_Address@VDDM_Lv4ErrCFSRls_flg@ */ /end MEASUREMENT
/begin MEASUREMENT VDDM_BrkSWNoBac_flg "" UBYTE SWC_DDM_type_CM_boolean_flg 0 0 0.0 1.0 ECU_ADDRESS 0x0000 /* @ECU_Address@VDDM_BrkSWNoBac_flg@ */ /end MEASUREMENT
/begin MEASUREMENT VDDM_BrkSWPass_flg "" UBYTE SWC_DDM_type_CM_boolean_flg 0 0 0.0 1.0 ECU_ADDRESS 0x0000 /* @ECU_Address@VDDM_BrkSWPass_flg@ */ /end MEASUREMENT
/begin MEASUREMENT VDDM_BrkSWErr_flg "" UBYTE SWC_DDM_type_CM_boolean_flg 0 0 0.0 1.0 ECU_ADDRESS 0x0000 /* @ECU_Address@VDDM_BrkSWErr_flg@ */ /end MEASUREMENT
/begin MEASUREMENT VDDM_BrkSWErrPass_flg "" UBYTE SWC_DDM_type_CM_boolean_flg 0 0 0.0 1.0 ECU_ADDRESS 0x0000 /* @ECU_Address@VDDM_BrkSWErrPass_flg@ */ /end MEASUREMENT
/begin MEASUREMENT VDDM_BrkSWErrCFSRls_flg "" UBYTE SWC_DDM_type_CM_boolean_flg 0 0 0.0 1.0 ECU_ADDRESS 0x0000 /* @ECU_Address@VDDM_BrkSWErrCFSRls_flg@ */ /end MEASUREMENT
/begin MEASUREMENT VDDM_BrkSWNoBacPass_flg "" UBYTE SWC_DDM_type_CM_boolean_flg 0 0 0.0 1.0 ECU_ADDRESS 0x0000 /* @ECU_Address@VDDM_BrkSWNoBacPass_flg@ */ /end MEASUREMENT
/begin MEASUREMENT VDDM_BrkSWNoBacCFSRls_flg "" UBYTE SWC_DDM_type_CM_boolean_flg 0 0 0.0 1.0 ECU_ADDRESS 0x0000 /* @ECU_Address@VDDM_BrkSWNoBacCFSRls_flg@ */ /end MEASUREMENT
/begin MEASUREMENT VDDM_KeyAuthPass_flg "" UBYTE SWC_DDM_type_CM_boolean_flg 0 0 0.0 1.0 ECU_ADDRESS 0x0000 /* @ECU_Address@VDDM_KeyAuthPass_flg@ */ /end MEASUREMENT
/begin MEASUREMENT VDDM_KeyAuthCFSRls_flg "" UBYTE SWC_DDM_type_CM_boolean_flg 0 0 0.0 1.0 ECU_ADDRESS 0x0000 /* @ECU_Address@VDDM_KeyAuthCFSRls_flg@ */ /end MEASUREMENT
/begin MEASUREMENT VDDM_KeyAuthDet_flg "" UBYTE SWC_DDM_type_CM_boolean_flg 0 0 0.0 1.0 ECU_ADDRESS 0x0000 /* @ECU_Address@VDDM_KeyAuthDet_flg@ */ /end MEASUREMENT
/begin MEASUREMENT VDDM_KeyAuthCFS_flg "" UBYTE SWC_DDM_type_CM_boolean_flg 0 0 0.0 1.0 ECU_ADDRESS 0x0000 /* @ECU_Address@VDDM_KeyAuthCFS_flg@ */ /end MEASUREMENT
/begin MEASUREMENT VDDM_FLDoorSWCFSRls_flg "" UBYTE SWC_DDM_type_CM_boolean_flg 0 0 0.0 1.0 ECU_ADDRESS 0x0000 /* @ECU_Address@VDDM_FLDoorSWCFSRls_flg@ */ /end MEASUREMENT
/begin MEASUREMENT VDDM_RLDoorSWPass_flg "" UBYTE SWC_DDM_type_CM_boolean_flg 0 0 0.0 1.0 ECU_ADDRESS 0x0000 /* @ECU_Address@VDDM_RLDoorSWPass_flg@ */ /end MEASUREMENT
/begin MEASUREMENT VDDM_RLDoorSWCFSRls_flg "" UBYTE SWC_DDM_type_CM_boolean_flg 0 0 0.0 1.0 ECU_ADDRESS 0x0000 /* @ECU_Address@VDDM_RLDoorSWCFSRls_flg@ */ /end MEASUREMENT
/begin MEASUREMENT VDDM_FRDoorSWPass_flg "" UBYTE SWC_DDM_type_CM_boolean_flg 0 0 0.0 1.0 ECU_ADDRESS 0x0000 /* @ECU_Address@VDDM_FRDoorSWPass_flg@ */ /end MEASUREMENT
/begin MEASUREMENT VDDM_FRDoorSWCFSRls_flg "" UBYTE SWC_DDM_type_CM_boolean_flg 0 0 0.0 1.0 ECU_ADDRESS 0x0000 /* @ECU_Address@VDDM_FRDoorSWCFSRls_flg@ */ /end MEASUREMENT
/begin MEASUREMENT VDDM_RRDoorSWPass_flg "" UBYTE SWC_DDM_type_CM_boolean_flg 0 0 0.0 1.0 ECU_ADDRESS 0x0000 /* @ECU_Address@VDDM_RRDoorSWPass_flg@ */ /end MEASUREMENT
/begin MEASUREMENT VDDM_RRDoorSWCFSRls_flg "" UBYTE SWC_DDM_type_CM_boolean_flg 0 0 0.0 1.0 ECU_ADDRESS 0x0000 /* @ECU_Address@VDDM_RRDoorSWCFSRls_flg@ */ /end MEASUREMENT
/begin MEASUREMENT VDDM_HoodSWPass_flg "" UBYTE SWC_DDM_type_CM_boolean_flg 0 0 0.0 1.0 ECU_ADDRESS 0x0000 /* @ECU_Address@VDDM_HoodSWPass_flg@ */ /end MEASUREMENT
/begin MEASUREMENT VDDM_HoodSWCFSRls_flg "" UBYTE SWC_DDM_type_CM_boolean_flg 0 0 0.0 1.0 ECU_ADDRESS 0x0000 /* @ECU_Address@VDDM_HoodSWCFSRls_flg@ */ /end MEASUREMENT
/begin MEASUREMENT VDDM_TailgaSWPass_flg "" UBYTE SWC_DDM_type_CM_boolean_flg 0 0 0.0 1.0 ECU_ADDRESS 0x0000 /* @ECU_Address@VDDM_TailgaSWPass_flg@ */ /end MEASUREMENT
/begin MEASUREMENT VDDM_TailgaSWCFSRls_flg "" UBYTE SWC_DDM_type_CM_boolean_flg 0 0 0.0 1.0 ECU_ADDRESS 0x0000 /* @ECU_Address@VDDM_TailgaSWCFSRls_flg@ */ /end MEASUREMENT
/begin MEASUREMENT VDDM_ONtoRdyPass_flg "" UBYTE SWC_DDM_type_CM_boolean_flg 0 0 0.0 1.0 ECU_ADDRESS 0x0000 /* @ECU_Address@VDDM_ONtoRdyPass_flg@ */ /end MEASUREMENT
/begin MEASUREMENT VDDM_ONtoRdyCFSRls_flg "" UBYTE SWC_DDM_type_CM_boolean_flg 0 0 0.0 1.0 ECU_ADDRESS 0x0000 /* @ECU_Address@VDDM_ONtoRdyCFSRls_flg@ */ /end MEASUREMENT
/begin MEASUREMENT VDDM_ONtoRdyDet_flg "" UBYTE SWC_DDM_type_CM_boolean_flg 0 0 0.0 1.0 ECU_ADDRESS 0x0000 /* @ECU_Address@VDDM_ONtoRdyDet_flg@ */ /end MEASUREMENT
/begin MEASUREMENT VDDM_ONtoRdyCFS_flg "" UBYTE SWC_DDM_type_CM_boolean_flg 0 0 0.0 1.0 ECU_ADDRESS 0x0000 /* @ECU_Address@VDDM_ONtoRdyCFS_flg@ */ /end MEASUREMENT
/begin MEASUREMENT VDDM_HVRlyCloPass_flg "" UBYTE SWC_DDM_type_CM_boolean_flg 0 0 0.0 1.0 ECU_ADDRESS 0x0000 /* @ECU_Address@VDDM_HVRlyCloPass_flg@ */ /end MEASUREMENT
/begin MEASUREMENT VDDM_HVRlyCloCFSRls_flg "" UBYTE SWC_DDM_type_CM_boolean_flg 0 0 0.0 1.0 ECU_ADDRESS 0x0000 /* @ECU_Address@VDDM_HVRlyCloCFSRls_flg@ */ /end MEASUREMENT
/begin MEASUREMENT VDDM_HVRlyOpPass_flg "" UBYTE SWC_DDM_type_CM_boolean_flg 0 0 0.0 1.0 ECU_ADDRESS 0x0000 /* @ECU_Address@VDDM_HVRlyOpPass_flg@ */ /end MEASUREMENT
/begin MEASUREMENT VDDM_HVRlyOpCFSRls_flg "" UBYTE SWC_DDM_type_CM_boolean_flg 0 0 0.0 1.0 ECU_ADDRESS 0x0000 /* @ECU_Address@VDDM_HVRlyOpCFSRls_flg@ */ /end MEASUREMENT
/begin MEASUREMENT VDDM_IniLVLoPass_flg "" UBYTE SWC_DDM_type_CM_boolean_flg 0 0 0.0 1.0 ECU_ADDRESS 0x0000 /* @ECU_Address@VDDM_IniLVLoPass_flg@ */ /end MEASUREMENT
/begin MEASUREMENT VDDM_IniLVLoCFSRls_flg "" UBYTE SWC_DDM_type_CM_boolean_flg 0 0 0.0 1.0 ECU_ADDRESS 0x0000 /* @ECU_Address@VDDM_IniLVLoCFSRls_flg@ */ /end MEASUREMENT
/begin MEASUREMENT VDDM_LVSupLoPass_flg "" UBYTE SWC_DDM_type_CM_boolean_flg 0 0 0.0 1.0 ECU_ADDRESS 0x0000 /* @ECU_Address@VDDM_LVSupLoPass_flg@ */ /end MEASUREMENT
/begin MEASUREMENT VDDM_LVSupLoCFSRls_flg "" UBYTE SWC_DDM_type_CM_boolean_flg 0 0 0.0 1.0 ECU_ADDRESS 0x0000 /* @ECU_Address@VDDM_LVSupLoCFSRls_flg@ */ /end MEASUREMENT
/begin MEASUREMENT VDDM_LVSupHiPass_flg "" UBYTE SWC_DDM_type_CM_boolean_flg 0 0 0.0 1.0 ECU_ADDRESS 0x0000 /* @ECU_Address@VDDM_LVSupHiPass_flg@ */ /end MEASUREMENT
/begin MEASUREMENT VDDM_LVSupHiCFSRls_flg "" UBYTE SWC_DDM_type_CM_boolean_flg 0 0 0.0 1.0 ECU_ADDRESS 0x0000 /* @ECU_Address@VDDM_LVSupHiCFSRls_flg@ */ /end MEASUREMENT
/begin MEASUREMENT VDDM_LVInErrPass_flg "" UBYTE SWC_DDM_type_CM_boolean_flg 0 0 0.0 1.0 ECU_ADDRESS 0x0000 /* @ECU_Address@VDDM_LVInErrPass_flg@ */ /end MEASUREMENT
/begin MEASUREMENT VDDM_LVInErrCFSRls_flg "" UBYTE SWC_DDM_type_CM_boolean_flg 0 0 0.0 1.0 ECU_ADDRESS 0x0000 /* @ECU_Address@VDDM_LVInErrCFSRls_flg@ */ /end MEASUREMENT
/begin MEASUREMENT VDDM_DrStSWPass_flg "" UBYTE SWC_DDM_type_CM_boolean_flg 0 0 0.0 1.0 ECU_ADDRESS 0x0000 /* @ECU_Address@VDDM_DrStSWPass_flg@ */ /end MEASUREMENT
/begin MEASUREMENT VDDM_DrStSWCFSRls_flg "" UBYTE SWC_DDM_type_CM_boolean_flg 0 0 0.0 1.0 ECU_ADDRESS 0x0000 /* @ECU_Address@VDDM_DrStSWCFSRls_flg@ */ /end MEASUREMENT
/begin MEASUREMENT VDDM_EDriveSysErrPowerUp_flg "" UBYTE SWC_DDM_type_CM_boolean_flg 0 0 0.0 1.0 ECU_ADDRESS 0x0000 /* @ECU_Address@VDDM_EDriveSysErrPowerUp_flg@ */ /end MEASUREMENT
/begin MEASUREMENT VDDM_EDriveSysErrPowerDown_flg "" UBYTE SWC_DDM_type_CM_boolean_flg 0 0 0.0 1.0 ECU_ADDRESS 0x0000 /* @ECU_Address@VDDM_EDriveSysErrPowerDown_flg@ */ /end MEASUREMENT
/begin MEASUREMENT VDDM_EPB1NoComPass_flg "" UBYTE SWC_DDM_type_CM_boolean_flg 0 0 0.0 1.0 ECU_ADDRESS 0x0000 /* @ECU_Address@VDDM_EPB1NoComPass_flg@ */ /end MEASUREMENT
/begin MEASUREMENT VDDM_EPB1NoComCFSRls_flg "" UBYTE SWC_DDM_type_CM_boolean_flg 0 0 0.0 1.0 ECU_ADDRESS 0x0000 /* @ECU_Address@VDDM_EPB1NoComCFSRls_flg@ */ /end MEASUREMENT
/begin MEASUREMENT VDDM_EPB1RCErrPass_flg "" UBYTE SWC_DDM_type_CM_boolean_flg 0 0 0.0 1.0 ECU_ADDRESS 0x0000 /* @ECU_Address@VDDM_EPB1RCErrPass_flg@ */ /end MEASUREMENT
/begin MEASUREMENT VDDM_EPB1RCErrCFSRls_flg "" UBYTE SWC_DDM_type_CM_boolean_flg 0 0 0.0 1.0 ECU_ADDRESS 0x0000 /* @ECU_Address@VDDM_EPB1RCErrCFSRls_flg@ */ /end MEASUREMENT
/begin MEASUREMENT VDDM_EPB1CSErrPass_flg "" UBYTE SWC_DDM_type_CM_boolean_flg 0 0 0.0 1.0 ECU_ADDRESS 0x0000 /* @ECU_Address@VDDM_EPB1CSErrPass_flg@ */ /end MEASUREMENT
/begin MEASUREMENT VDDM_EPB1CSErrCFSRls_flg "" UBYTE SWC_DDM_type_CM_boolean_flg 0 0 0.0 1.0 ECU_ADDRESS 0x0000 /* @ECU_Address@VDDM_EPB1CSErrCFSRls_flg@ */ /end MEASUREMENT
/begin MEASUREMENT VDDM_EPBSigErrPass_flg "" UBYTE SWC_DDM_type_CM_boolean_flg 0 0 0.0 1.0 ECU_ADDRESS 0x0000 /* @ECU_Address@VDDM_EPBSigErrPass_flg@ */ /end MEASUREMENT
/begin MEASUREMENT VDDM_EPBSigErrCFSRls_flg "" UBYTE SWC_DDM_type_CM_boolean_flg 0 0 0.0 1.0 ECU_ADDRESS 0x0000 /* @ECU_Address@VDDM_EPBSigErrCFSRls_flg@ */ /end MEASUREMENT
/begin MEASUREMENT VDDM_5vAPS1OoRPass_flg "" UBYTE SWC_DDM_type_CM_boolean_flg 0 0 0.0 1.0 ECU_ADDRESS 0x0000 /* @ECU_Address@VDDM_5vAPS1OoRPass_flg@ */ /end MEASUREMENT
/begin MEASUREMENT VDDM_5vAPS1OoRCFSRls_flg "" UBYTE SWC_DDM_type_CM_boolean_flg 0 0 0.0 1.0 ECU_ADDRESS 0x0000 /* @ECU_Address@VDDM_5vAPS1OoRCFSRls_flg@ */ /end MEASUREMENT
/begin MEASUREMENT VDDM_5vAPS2OoRPass_flg "" UBYTE SWC_DDM_type_CM_boolean_flg 0 0 0.0 1.0 ECU_ADDRESS 0x0000 /* @ECU_Address@VDDM_5vAPS2OoRPass_flg@ */ /end MEASUREMENT
/begin MEASUREMENT VDDM_5vAPS2OoRCFSRls_flg "" UBYTE SWC_DDM_type_CM_boolean_flg 0 0 0.0 1.0 ECU_ADDRESS 0x0000 /* @ECU_Address@VDDM_5vAPS2OoRCFSRls_flg@ */ /end MEASUREMENT
/begin MEASUREMENT VDDM_APS1SigOoRPass_flg "" UBYTE SWC_DDM_type_CM_boolean_flg 0 0 0.0 1.0 ECU_ADDRESS 0x0000 /* @ECU_Address@VDDM_APS1SigOoRPass_flg@ */ /end MEASUREMENT
/begin MEASUREMENT VDDM_APS1SigOoRCFSRls_flg "" UBYTE SWC_DDM_type_CM_boolean_flg 0 0 0.0 1.0 ECU_ADDRESS 0x0000 /* @ECU_Address@VDDM_APS1SigOoRCFSRls_flg@ */ /end MEASUREMENT
/begin MEASUREMENT VDDM_APS2SigOoRPass_flg "" UBYTE SWC_DDM_type_CM_boolean_flg 0 0 0.0 1.0 ECU_ADDRESS 0x0000 /* @ECU_Address@VDDM_APS2SigOoRPass_flg@ */ /end MEASUREMENT
/begin MEASUREMENT VDDM_APS2SigOoRCFSRls_flg "" UBYTE SWC_DDM_type_CM_boolean_flg 0 0 0.0 1.0 ECU_ADDRESS 0x0000 /* @ECU_Address@VDDM_APS2SigOoRCFSRls_flg@ */ /end MEASUREMENT
/begin MEASUREMENT VDDM_APSCorrErrPass_flg "" UBYTE SWC_DDM_type_CM_boolean_flg 0 0 0.0 1.0 ECU_ADDRESS 0x0000 /* @ECU_Address@VDDM_APSCorrErrPass_flg@ */ /end MEASUREMENT
/begin MEASUREMENT VDDM_APSCorrErrCFSRls_flg "" UBYTE SWC_DDM_type_CM_boolean_flg 0 0 0.0 1.0 ECU_ADDRESS 0x0000 /* @ECU_Address@VDDM_APSCorrErrCFSRls_flg@ */ /end MEASUREMENT
/begin MEASUREMENT VDDM_RegenErrPass_flg "" UBYTE SWC_DDM_type_CM_boolean_flg 0 0 0.0 1.0 ECU_ADDRESS 0x0000 /* @ECU_Address@VDDM_RegenErrPass_flg@ */ /end MEASUREMENT
/begin MEASUREMENT VDDM_RegenErrCFSRls_flg "" UBYTE SWC_DDM_type_CM_boolean_flg 0 0 0.0 1.0 ECU_ADDRESS 0x0000 /* @ECU_Address@VDDM_RegenErrCFSRls_flg@ */ /end MEASUREMENT
/begin MEASUREMENT VDDM_EDriveSysErrFaultLv1_flg "" UBYTE SWC_DDM_type_CM_boolean_flg 0 0 0.0 1.0 ECU_ADDRESS 0x0000 /* @ECU_Address@VDDM_EDriveSysErrFaultLv1_flg@ */ /end MEASUREMENT
/begin MEASUREMENT VDDM_EDriveSysErrLVSup_flg "" UBYTE SWC_DDM_type_CM_boolean_flg 0 0 0.0 1.0 ECU_ADDRESS 0x0000 /* @ECU_Address@VDDM_EDriveSysErrLVSup_flg@ */ /end MEASUREMENT
/begin MEASUREMENT VDDM_EDriveSysErrTQD_flg "" UBYTE SWC_DDM_type_CM_boolean_flg 0 0 0.0 1.0 ECU_ADDRESS 0x0000 /* @ECU_Address@VDDM_EDriveSysErrTQD_flg@ */ /end MEASUREMENT
/begin MEASUREMENT VDDM_EPBUnlockTODFSRls_flg "" UBYTE SWC_DDM_type_CM_boolean_flg 0 0 0.0 1.0 ECU_ADDRESS 0x0000 /* @ECU_Address@VDDM_EPBUnlockTODFSRls_flg@ */ /end MEASUREMENT
/begin MEASUREMENT VDDM_EPBLockTOCFSRls_flg "" UBYTE SWC_DDM_type_CM_boolean_flg 0 0 0.0 1.0 ECU_ADDRESS 0x0000 /* @ECU_Address@VDDM_EPBLockTOCFSRls_flg@ */ /end MEASUREMENT
/begin MEASUREMENT VDDM_FrMCUTqErrPass_flg "" UBYTE SWC_DDM_type_CM_boolean_flg 0 0 0.0 1.0 ECU_ADDRESS 0x0000 /* @ECU_Address@VDDM_FrMCUTqErrPass_flg@ */ /end MEASUREMENT
/begin MEASUREMENT VDDM_FrMCUTqErrCFSRls_flg "" UBYTE SWC_DDM_type_CM_boolean_flg 0 0 0.0 1.0 ECU_ADDRESS 0x0000 /* @ECU_Address@VDDM_FrMCUTqErrCFSRls_flg@ */ /end MEASUREMENT
/begin MEASUREMENT VDDM_FrTMTqDiffGTDev_flg "" UBYTE SWC_DDM_type_CM_boolean_flg 0 0 0.0 1.0 ECU_ADDRESS 0x0000 /* @ECU_Address@VDDM_FrTMTqDiffGTDev_flg@ */ /end MEASUREMENT
/begin MEASUREMENT VDDM_RrMCUTqErrPass_flg "" UBYTE SWC_DDM_type_CM_boolean_flg 0 0 0.0 1.0 ECU_ADDRESS 0x0000 /* @ECU_Address@VDDM_RrMCUTqErrPass_flg@ */ /end MEASUREMENT
/begin MEASUREMENT VDDM_RrMCUTqErrCFSRls_flg "" UBYTE SWC_DDM_type_CM_boolean_flg 0 0 0.0 1.0 ECU_ADDRESS 0x0000 /* @ECU_Address@VDDM_RrMCUTqErrCFSRls_flg@ */ /end MEASUREMENT
/begin MEASUREMENT VDDM_RrTMTqDiffGTDev_flg "" UBYTE SWC_DDM_type_CM_boolean_flg 0 0 0.0 1.0 ECU_ADDRESS 0x0000 /* @ECU_Address@VDDM_RrTMTqDiffGTDev_flg@ */ /end MEASUREMENT
/begin MEASUREMENT VDDM_EDriveSysErrVCUErr_flg "" UBYTE SWC_DDM_type_CM_boolean_flg 0 0 0.0 1.0 ECU_ADDRESS 0x0000 /* @ECU_Address@VDDM_EDriveSysErrVCUErr_flg@ */ /end MEASUREMENT
/begin MEASUREMENT VDDM_EnterNewOperCyc_flg "" UBYTE SWC_DDM_type_CM_boolean_flg 0 0 0.0 1.0 ECU_ADDRESS 0x0000 /* @ECU_Address@VDDM_EnterNewOperCyc_flg@ */ /end MEASUREMENT
/begin MEASUREMENT VDDM_LimpHomeAct_flg "" UBYTE SWC_DDM_type_CM_boolean_flg 0 0 0.0 1.0 ECU_ADDRESS 0x0000 /* @ECU_Address@VDDM_LimpHomeAct_flg@ */ /end MEASUREMENT
/begin MEASUREMENT VDDM_RAPSErrWarnSta_flg "" UBYTE SWC_DDM_type_CM_boolean_flg 0 0 0.0 1.0 ECU_ADDRESS 0x0000 /* @ECU_Address@VDDM_RAPSErrWarnSta_flg@ */ /end MEASUREMENT
/begin MEASUREMENT VDDM_VCURAPSErrLv2_flg "" UBYTE SWC_DDM_type_CM_boolean_flg 0 0 0.0 1.0 ECU_ADDRESS 0x0000 /* @ECU_Address@VDDM_VCURAPSErrLv2_flg@ */ /end MEASUREMENT
/begin MEASUREMENT VDDM_EngagePFail_flg "" UBYTE SWC_DDM_type_CM_boolean_flg 0 0 0.0 1.0 ECU_ADDRESS 0x0000 /* @ECU_Address@VDDM_EngagePFail_flg@ */ /end MEASUREMENT
/begin MEASUREMENT VDDM_DisengagePFail_flg "" UBYTE SWC_DDM_type_CM_boolean_flg 0 0 0.0 1.0 ECU_ADDRESS 0x0000 /* @ECU_Address@VDDM_DisengagePFail_flg@ */ /end MEASUREMENT
/begin MEASUREMENT VDDM_VCURAPSErrLv3_flg "" UBYTE SWC_DDM_type_CM_boolean_flg 0 0 0.0 1.0 ECU_ADDRESS 0x0000 /* @ECU_Address@VDDM_VCURAPSErrLv3_flg@ */ /end MEASUREMENT
/begin MEASUREMENT VDDM_EDriveSysErrShifterErr_flg "" UBYTE SWC_DDM_type_CM_boolean_flg 0 0 0.0 1.0 ECU_ADDRESS 0x0000 /* @ECU_Address@VDDM_EDriveSysErrShifterErr_flg@ */ /end MEASUREMENT
/begin MEASUREMENT VDDM_PMMBattErr_flg "" UBYTE SWC_DDM_type_CM_boolean_flg 0 0 0.0 1.0 ECU_ADDRESS 0x0000 /* @ECU_Address@VDDM_PMMBattErr_flg@ */ /end MEASUREMENT
/begin MEASUREMENT VDDM_LVSysErrPwrOutErr_flg "" UBYTE SWC_DDM_type_CM_boolean_flg 0 0 0.0 1.0 ECU_ADDRESS 0x0000 /* @ECU_Address@VDDM_LVSysErrPwrOutErr_flg@ */ /end MEASUREMENT
/begin MEASUREMENT VDDM_RrMCUTqErrDFS_flg "" UBYTE SWC_DDM_type_CM_boolean_flg 0 0 0.0 1.0 ECU_ADDRESS 0x0000 /* @ECU_Address@VDDM_RrMCUTqErrDFS_flg@ */ /end MEASUREMENT
/begin MEASUREMENT VDDM_FrMCUTqErrDFS_flg "" UBYTE SWC_DDM_type_CM_boolean_flg 0 0 0.0 1.0 ECU_ADDRESS 0x0000 /* @ECU_Address@VDDM_FrMCUTqErrDFS_flg@ */ /end MEASUREMENT
/begin MEASUREMENT VDDM_EPBLockTODFS_flg "" UBYTE SWC_DDM_type_CM_boolean_flg 0 0 0.0 1.0 ECU_ADDRESS 0x0000 /* @ECU_Address@VDDM_EPBLockTODFS_flg@ */ /end MEASUREMENT
/begin MEASUREMENT VDDM_EPBUnlockTODFS_flg "" UBYTE SWC_DDM_type_CM_boolean_flg 0 0 0.0 1.0 ECU_ADDRESS 0x0000 /* @ECU_Address@VDDM_EPBUnlockTODFS_flg@ */ /end MEASUREMENT
/begin MEASUREMENT VDDM_RegenErrDFS_flg "" UBYTE SWC_DDM_type_CM_boolean_flg 0 0 0.0 1.0 ECU_ADDRESS 0x0000 /* @ECU_Address@VDDM_RegenErrDFS_flg@ */ /end MEASUREMENT
/begin MEASUREMENT VDDM_APSCorrErrDFS_flg "" UBYTE SWC_DDM_type_CM_boolean_flg 0 0 0.0 1.0 ECU_ADDRESS 0x0000 /* @ECU_Address@VDDM_APSCorrErrDFS_flg@ */ /end MEASUREMENT
/begin MEASUREMENT VDDM_APS2SigOoRDFS_flg "" UBYTE SWC_DDM_type_CM_boolean_flg 0 0 0.0 1.0 ECU_ADDRESS 0x0000 /* @ECU_Address@VDDM_APS2SigOoRDFS_flg@ */ /end MEASUREMENT
/begin MEASUREMENT VDDM_APS1SigOoRDFS_flg "" UBYTE SWC_DDM_type_CM_boolean_flg 0 0 0.0 1.0 ECU_ADDRESS 0x0000 /* @ECU_Address@VDDM_APS1SigOoRDFS_flg@ */ /end MEASUREMENT
/begin MEASUREMENT VDDM_5vAPS2OoRDFS_flg "" UBYTE SWC_DDM_type_CM_boolean_flg 0 0 0.0 1.0 ECU_ADDRESS 0x0000 /* @ECU_Address@VDDM_5vAPS2OoRDFS_flg@ */ /end MEASUREMENT
/begin MEASUREMENT VDDM_5vAPS1OoRDFS_flg "" UBYTE SWC_DDM_type_CM_boolean_flg 0 0 0.0 1.0 ECU_ADDRESS 0x0000 /* @ECU_Address@VDDM_5vAPS1OoRDFS_flg@ */ /end MEASUREMENT
/begin MEASUREMENT VDDM_EPBSigErrDFS_flg "" UBYTE SWC_DDM_type_CM_boolean_flg 0 0 0.0 1.0 ECU_ADDRESS 0x0000 /* @ECU_Address@VDDM_EPBSigErrDFS_flg@ */ /end MEASUREMENT
/begin MEASUREMENT VDDM_EPB1CSErrDFS_flg "" UBYTE SWC_DDM_type_CM_boolean_flg 0 0 0.0 1.0 ECU_ADDRESS 0x0000 /* @ECU_Address@VDDM_EPB1CSErrDFS_flg@ */ /end MEASUREMENT
/begin MEASUREMENT VDDM_EPB1RCErrDFS_flg "" UBYTE SWC_DDM_type_CM_boolean_flg 0 0 0.0 1.0 ECU_ADDRESS 0x0000 /* @ECU_Address@VDDM_EPB1RCErrDFS_flg@ */ /end MEASUREMENT
/begin MEASUREMENT VDDM_EPB1NoComDFS_flg "" UBYTE SWC_DDM_type_CM_boolean_flg 0 0 0.0 1.0 ECU_ADDRESS 0x0000 /* @ECU_Address@VDDM_EPB1NoComDFS_flg@ */ /end MEASUREMENT
/begin MEASUREMENT VDDM_DrStSWDFS_flg "" UBYTE SWC_DDM_type_CM_boolean_flg 0 0 0.0 1.0 ECU_ADDRESS 0x0000 /* @ECU_Address@VDDM_DrStSWDFS_flg@ */ /end MEASUREMENT
/begin MEASUREMENT VDDM_LVInErrDFS_flg "" UBYTE SWC_DDM_type_CM_boolean_flg 0 0 0.0 1.0 ECU_ADDRESS 0x0000 /* @ECU_Address@VDDM_LVInErrDFS_flg@ */ /end MEASUREMENT
/begin MEASUREMENT VDDM_LVSupHiDFS_flg "" UBYTE SWC_DDM_type_CM_boolean_flg 0 0 0.0 1.0 ECU_ADDRESS 0x0000 /* @ECU_Address@VDDM_LVSupHiDFS_flg@ */ /end MEASUREMENT
/begin MEASUREMENT VDDM_LVSupLoDFS_flg "" UBYTE SWC_DDM_type_CM_boolean_flg 0 0 0.0 1.0 ECU_ADDRESS 0x0000 /* @ECU_Address@VDDM_LVSupLoDFS_flg@ */ /end MEASUREMENT
/begin MEASUREMENT VDDM_IniLVLoDFS_flg "" UBYTE SWC_DDM_type_CM_boolean_flg 0 0 0.0 1.0 ECU_ADDRESS 0x0000 /* @ECU_Address@VDDM_IniLVLoDFS_flg@ */ /end MEASUREMENT
/begin MEASUREMENT VDDM_HVRlyOpDFS_flg "" UBYTE SWC_DDM_type_CM_boolean_flg 0 0 0.0 1.0 ECU_ADDRESS 0x0000 /* @ECU_Address@VDDM_HVRlyOpDFS_flg@ */ /end MEASUREMENT
/begin MEASUREMENT VDDM_HVRlyCloDFS_flg "" UBYTE SWC_DDM_type_CM_boolean_flg 0 0 0.0 1.0 ECU_ADDRESS 0x0000 /* @ECU_Address@VDDM_HVRlyCloDFS_flg@ */ /end MEASUREMENT
/begin MEASUREMENT VDDM_ONtoRdyDFS_flg "" UBYTE SWC_DDM_type_CM_boolean_flg 0 0 0.0 1.0 ECU_ADDRESS 0x0000 /* @ECU_Address@VDDM_ONtoRdyDFS_flg@ */ /end MEASUREMENT
/begin MEASUREMENT VDDM_TailgaSWDFS_flg "" UBYTE SWC_DDM_type_CM_boolean_flg 0 0 0.0 1.0 ECU_ADDRESS 0x0000 /* @ECU_Address@VDDM_TailgaSWDFS_flg@ */ /end MEASUREMENT
/begin MEASUREMENT VDDM_HoodSWDFS_flg "" UBYTE SWC_DDM_type_CM_boolean_flg 0 0 0.0 1.0 ECU_ADDRESS 0x0000 /* @ECU_Address@VDDM_HoodSWDFS_flg@ */ /end MEASUREMENT
/begin MEASUREMENT VDDM_RRDoorSWDFS_flg "" UBYTE SWC_DDM_type_CM_boolean_flg 0 0 0.0 1.0 ECU_ADDRESS 0x0000 /* @ECU_Address@VDDM_RRDoorSWDFS_flg@ */ /end MEASUREMENT
/begin MEASUREMENT VDDM_FRDoorSWDFS_flg "" UBYTE SWC_DDM_type_CM_boolean_flg 0 0 0.0 1.0 ECU_ADDRESS 0x0000 /* @ECU_Address@VDDM_FRDoorSWDFS_flg@ */ /end MEASUREMENT
/begin MEASUREMENT VDDM_RLDoorSWDFS_flg "" UBYTE SWC_DDM_type_CM_boolean_flg 0 0 0.0 1.0 ECU_ADDRESS 0x0000 /* @ECU_Address@VDDM_RLDoorSWDFS_flg@ */ /end MEASUREMENT
/begin MEASUREMENT VDDM_FLDoorSWDFS_flg "" UBYTE SWC_DDM_type_CM_boolean_flg 0 0 0.0 1.0 ECU_ADDRESS 0x0000 /* @ECU_Address@VDDM_FLDoorSWDFS_flg@ */ /end MEASUREMENT
/begin MEASUREMENT VDDM_KeyAuthDFS_flg "" UBYTE SWC_DDM_type_CM_boolean_flg 0 0 0.0 1.0 ECU_ADDRESS 0x0000 /* @ECU_Address@VDDM_KeyAuthDFS_flg@ */ /end MEASUREMENT
/begin MEASUREMENT VDDM_BrkSWNoBacDFS_flg "" UBYTE SWC_DDM_type_CM_boolean_flg 0 0 0.0 1.0 ECU_ADDRESS 0x0000 /* @ECU_Address@VDDM_BrkSWNoBacDFS_flg@ */ /end MEASUREMENT
/begin MEASUREMENT VDDM_BrkSWErrDFS_flg "" UBYTE SWC_DDM_type_CM_boolean_flg 0 0 0.0 1.0 ECU_ADDRESS 0x0000 /* @ECU_Address@VDDM_BrkSWErrDFS_flg@ */ /end MEASUREMENT
/begin MEASUREMENT VDDM_Lv4ErrDFS_flg "" UBYTE SWC_DDM_type_CM_boolean_flg 0 0 0.0 1.0 ECU_ADDRESS 0x0000 /* @ECU_Address@VDDM_Lv4ErrDFS_flg@ */ /end MEASUREMENT
/begin MEASUREMENT VDDM_Lv3ErrDFS_flg "" UBYTE SWC_DDM_type_CM_boolean_flg 0 0 0.0 1.0 ECU_ADDRESS 0x0000 /* @ECU_Address@VDDM_Lv3ErrDFS_flg@ */ /end MEASUREMENT
/begin MEASUREMENT VDDM_Lv2ErrDFS_flg "" UBYTE SWC_DDM_type_CM_boolean_flg 0 0 0.0 1.0 ECU_ADDRESS 0x0000 /* @ECU_Address@VDDM_Lv2ErrDFS_flg@ */ /end MEASUREMENT
/begin MEASUREMENT VDDM_Lv1ErrDFS_flg "" UBYTE SWC_DDM_type_CM_boolean_flg 0 0 0.0 1.0 ECU_ADDRESS 0x0000 /* @ECU_Address@VDDM_Lv1ErrDFS_flg@ */ /end MEASUREMENT
/begin MEASUREMENT VDDM_FrVCUNoComDFS_flg "" UBYTE SWC_DDM_type_CM_boolean_flg 0 0 0.0 1.0 ECU_ADDRESS 0x0000 /* @ECU_Address@VDDM_FrVCUNoComDFS_flg@ */ /end MEASUREMENT
/begin MEASUREMENT VDDM_DrVCUNoComDFS_flg "" UBYTE SWC_DDM_type_CM_boolean_flg 0 0 0.0 1.0 ECU_ADDRESS 0x0000 /* @ECU_Address@VDDM_DrVCUNoComDFS_flg@ */ /end MEASUREMENT
/begin MEASUREMENT VDDM_Shifter1CSErrDFS_flg "" UBYTE SWC_DDM_type_CM_boolean_flg 0 0 0.0 1.0 ECU_ADDRESS 0x0000 /* @ECU_Address@VDDM_Shifter1CSErrDFS_flg@ */ /end MEASUREMENT
/begin MEASUREMENT VDDM_Shifter1RCErrDFS_flg "" UBYTE SWC_DDM_type_CM_boolean_flg 0 0 0.0 1.0 ECU_ADDRESS 0x0000 /* @ECU_Address@VDDM_Shifter1RCErrDFS_flg@ */ /end MEASUREMENT
/begin MEASUREMENT VDDM_Shifter1NoComDFS_flg "" UBYTE SWC_DDM_type_CM_boolean_flg 0 0 0.0 1.0 ECU_ADDRESS 0x0000 /* @ECU_Address@VDDM_Shifter1NoComDFS_flg@ */ /end MEASUREMENT
/begin MEASUREMENT VDDM_MCUF1CSErrDFS_flg "" UBYTE SWC_DDM_type_CM_boolean_flg 0 0 0.0 1.0 ECU_ADDRESS 0x0000 /* @ECU_Address@VDDM_MCUF1CSErrDFS_flg@ */ /end MEASUREMENT
/begin MEASUREMENT VDDM_MCUF1RCErrDFS_flg "" UBYTE SWC_DDM_type_CM_boolean_flg 0 0 0.0 1.0 ECU_ADDRESS 0x0000 /* @ECU_Address@VDDM_MCUF1RCErrDFS_flg@ */ /end MEASUREMENT
/begin MEASUREMENT VDDM_MCUF1NoComDFS_flg "" UBYTE SWC_DDM_type_CM_boolean_flg 0 0 0.0 1.0 ECU_ADDRESS 0x0000 /* @ECU_Address@VDDM_MCUF1NoComDFS_flg@ */ /end MEASUREMENT
/begin MEASUREMENT VDDM_MCUR1CSErrDFS_flg "" UBYTE SWC_DDM_type_CM_boolean_flg 0 0 0.0 1.0 ECU_ADDRESS 0x0000 /* @ECU_Address@VDDM_MCUR1CSErrDFS_flg@ */ /end MEASUREMENT
/begin MEASUREMENT VDDM_MCUR1RCErrDFS_flg "" UBYTE SWC_DDM_type_CM_boolean_flg 0 0 0.0 1.0 ECU_ADDRESS 0x0000 /* @ECU_Address@VDDM_MCUR1RCErrDFS_flg@ */ /end MEASUREMENT
/begin MEASUREMENT VDDM_MCUR1NoComDFS_flg "" UBYTE SWC_DDM_type_CM_boolean_flg 0 0 0.0 1.0 ECU_ADDRESS 0x0000 /* @ECU_Address@VDDM_MCUR1NoComDFS_flg@ */ /end MEASUREMENT
/begin MEASUREMENT VDDM_ESC5CSErrDFS_flg "" UBYTE SWC_DDM_type_CM_boolean_flg 0 0 0.0 1.0 ECU_ADDRESS 0x0000 /* @ECU_Address@VDDM_ESC5CSErrDFS_flg@ */ /end MEASUREMENT
/begin MEASUREMENT VDDM_ESC5RCErrDFS_flg "" UBYTE SWC_DDM_type_CM_boolean_flg 0 0 0.0 1.0 ECU_ADDRESS 0x0000 /* @ECU_Address@VDDM_ESC5RCErrDFS_flg@ */ /end MEASUREMENT
/begin MEASUREMENT VDDM_ESC5NoComDFS_flg "" UBYTE SWC_DDM_type_CM_boolean_flg 0 0 0.0 1.0 ECU_ADDRESS 0x0000 /* @ECU_Address@VDDM_ESC5NoComDFS_flg@ */ /end MEASUREMENT
/begin MEASUREMENT VDDM_ESC1CSErrDFS_flg "" UBYTE SWC_DDM_type_CM_boolean_flg 0 0 0.0 1.0 ECU_ADDRESS 0x0000 /* @ECU_Address@VDDM_ESC1CSErrDFS_flg@ */ /end MEASUREMENT
/begin MEASUREMENT VDDM_ESC1RCErrDFS_flg "" UBYTE SWC_DDM_type_CM_boolean_flg 0 0 0.0 1.0 ECU_ADDRESS 0x0000 /* @ECU_Address@VDDM_ESC1RCErrDFS_flg@ */ /end MEASUREMENT
/begin MEASUREMENT VDDM_ESC1NoComDFS_flg "" UBYTE SWC_DDM_type_CM_boolean_flg 0 0 0.0 1.0 ECU_ADDRESS 0x0000 /* @ECU_Address@VDDM_ESC1NoComDFS_flg@ */ /end MEASUREMENT
/begin MEASUREMENT VDDM_C1ABM1CSDFS_flg "" UBYTE SWC_DDM_type_CM_boolean_flg 0 0 0.0 1.0 ECU_ADDRESS 0x0000 /* @ECU_Address@VDDM_C1ABM1CSDFS_flg@ */ /end MEASUREMENT
/begin MEASUREMENT VDDM_C1ABM1RCDFS_flg "" UBYTE SWC_DDM_type_CM_boolean_flg 0 0 0.0 1.0 ECU_ADDRESS 0x0000 /* @ECU_Address@VDDM_C1ABM1RCDFS_flg@ */ /end MEASUREMENT
/begin MEASUREMENT VDDM_C1ABM1LCDFS_flg "" UBYTE SWC_DDM_type_CM_boolean_flg 0 0 0.0 1.0 ECU_ADDRESS 0x0000 /* @ECU_Address@VDDM_C1ABM1LCDFS_flg@ */ /end MEASUREMENT
/begin MEASUREMENT VDDM_C3CCU2CSDFS_flg "" UBYTE SWC_DDM_type_CM_boolean_flg 0 0 0.0 1.0 ECU_ADDRESS 0x0000 /* @ECU_Address@VDDM_C3CCU2CSDFS_flg@ */ /end MEASUREMENT
/begin MEASUREMENT VDDM_C3CCU2RCDFS_flg "" UBYTE SWC_DDM_type_CM_boolean_flg 0 0 0.0 1.0 ECU_ADDRESS 0x0000 /* @ECU_Address@VDDM_C3CCU2RCDFS_flg@ */ /end MEASUREMENT
/begin MEASUREMENT VDDM_C3CCU2LCDFS_flg "" UBYTE SWC_DDM_type_CM_boolean_flg 0 0 0.0 1.0 ECU_ADDRESS 0x0000 /* @ECU_Address@VDDM_C3CCU2LCDFS_flg@ */ /end MEASUREMENT
/begin MEASUREMENT VDDM_C3CCU1CSDFS_flg "" UBYTE SWC_DDM_type_CM_boolean_flg 0 0 0.0 1.0 ECU_ADDRESS 0x0000 /* @ECU_Address@VDDM_C3CCU1CSDFS_flg@ */ /end MEASUREMENT
/begin MEASUREMENT VDDM_C3CCU1RCDFS_flg "" UBYTE SWC_DDM_type_CM_boolean_flg 0 0 0.0 1.0 ECU_ADDRESS 0x0000 /* @ECU_Address@VDDM_C3CCU1RCDFS_flg@ */ /end MEASUREMENT
/begin MEASUREMENT VDDM_C3CCU1LCDFS_flg "" UBYTE SWC_DDM_type_CM_boolean_flg 0 0 0.0 1.0 ECU_ADDRESS 0x0000 /* @ECU_Address@VDDM_C3CCU1LCDFS_flg@ */ /end MEASUREMENT
/begin MEASUREMENT VDDM_C3BMS1CSDFS_flg "" UBYTE SWC_DDM_type_CM_boolean_flg 0 0 0.0 1.0 ECU_ADDRESS 0x0000 /* @ECU_Address@VDDM_C3BMS1CSDFS_flg@ */ /end MEASUREMENT
/begin MEASUREMENT VDDM_C3BMS1RCDFS_flg "" UBYTE SWC_DDM_type_CM_boolean_flg 0 0 0.0 1.0 ECU_ADDRESS 0x0000 /* @ECU_Address@VDDM_C3BMS1RCDFS_flg@ */ /end MEASUREMENT
/begin MEASUREMENT VDDM_C3BMS1LCDFS_flg "" UBYTE SWC_DDM_type_CM_boolean_flg 0 0 0.0 1.0 ECU_ADDRESS 0x0000 /* @ECU_Address@VDDM_C3BMS1LCDFS_flg@ */ /end MEASUREMENT
/begin MEASUREMENT VDDM_C3BMS6CSDFS_flg "" UBYTE SWC_DDM_type_CM_boolean_flg 0 0 0.0 1.0 ECU_ADDRESS 0x0000 /* @ECU_Address@VDDM_C3BMS6CSDFS_flg@ */ /end MEASUREMENT
/begin MEASUREMENT VDDM_C3BMS6RCDFS_flg "" UBYTE SWC_DDM_type_CM_boolean_flg 0 0 0.0 1.0 ECU_ADDRESS 0x0000 /* @ECU_Address@VDDM_C3BMS6RCDFS_flg@ */ /end MEASUREMENT
/begin MEASUREMENT VDDM_C3BMS6LCDFS_flg "" UBYTE SWC_DDM_type_CM_boolean_flg 0 0 0.0 1.0 ECU_ADDRESS 0x0000 /* @ECU_Address@VDDM_C3BMS6LCDFS_flg@ */ /end MEASUREMENT
/begin COMPU_METHOD SWC_DDM_type_CM_single_Nm "Q = V" RAT_FUNC "%8.6" "Nm" COEFFS 0 1 0 0 0 1 /end COMPU_METHOD
/begin COMPU_METHOD SWC_DDM_type_CM_single_sec "Q = V" RAT_FUNC "%8.6" "sec" COEFFS 0 1 0 0 0 1 /end COMPU_METHOD
/begin COMPU_METHOD SWC_DDM_type_CM_single_V "Q = V" RAT_FUNC "%8.6" "V" COEFFS 0 1 0 0 0 1 /end COMPU_METHOD
/begin COMPU_METHOD SWC_DDM_type_CM_single_pct "Q = V" RAT_FUNC "%8.6" "pct" COEFFS 0 1 0 0 0 1 /end COMPU_METHOD
/begin COMPU_METHOD SWC_DDM_type_CM_single_mv "Q = V" RAT_FUNC "%8.6" "mv" COEFFS 0 1 0 0 0 1 /end COMPU_METHOD
/begin COMPU_METHOD SWC_DDM_type_CM_boolean_flg "Q = V" RAT_FUNC "%1.0" "flg" COEFFS 0 1 0 0 0 1 /end COMPU_METHOD
/begin COMPU_METHOD SWC_DDM_type_CM_uint8_cnt "Q = V" RAT_FUNC "%3.0" "cnt" COEFFS 0 1 0 0 0 1 /end COMPU_METHOD
/begin COMPU_METHOD SWC_DDM_type_CM_uint8_enum "Q = V" RAT_FUNC "%3.0" "enum" COEFFS 0 1 0 0 0 1 /end COMPU_METHOD
/begin GROUP SWC_DDM_type "SWC_DDM_type" /* Root */ ROOT /begin SUB_GROUP Root_run_SWC_DDM_5ms_sys /end SUB_GROUP /end GROUP
/begin GROUP Root_run_SWC_DDM_5ms_sys "SWC_DDM_type/run_SWC_DDM_5ms_sys" /begin SUB_GROUP S2_DDM /end SUB_GROUP /end GROUP
/begin GROUP S2_DDM "SWC_DDM_type/run_SWC_DDM_5ms_sys/DDM" /begin SUB_GROUP S3_DDM /end SUB_GROUP /begin REF_CHARACTERISTIC ZoneFrMalfunLevel_enum /end REF_CHARACTERISTIC /end GROUP
/begin GROUP S3_DDM "SWC_DDM_type/run_SWC_DDM_5ms_sys/DDM/DDM" /begin SUB_GROUP S5_Enabled_Subsystem S5_PMM S5_TPM S5_TQD S5_VMC_DDM /end SUB_GROUP
 /begin REF_CHARACTERISTIC KDDM_DiagnosisTmp_flg_ovrdflg KDDM_LimpHomeTmpSW_flg KDDM_SysErrPwrOutSW_flg KDDM_SysErrVCUErrSW_flg KDDM_VCURAPSErrLv2_flg_ovrdflg KDDM_VCURAPSErrLv2_flg_ovrdval KDDM_VCURAPSErrLv3_flg_ovrdflg KDDM_VCURAPSErrLv3_flg_ovrdval KDDM_VehMalfunLevelSW_flg /end REF_CHARACTERISTIC
 /begin REF_MEASUREMENT VDDM_EDriveSysErrVCUErr_flg VDDM_EnterNewOperCyc_flg VDDM_LVSysErrPwrOutErr_flg VDDM_LimpHomeAct_flg VDDM_RAPSErrWarnSta_flg VDDM_VCURAPSErrLv2_flg VDDM_VCURAPSErrLv3_flg VDDM_VehMalfunLevel_enum /end REF_MEASUREMENT
/end GROUP
/begin GROUP S5_Enabled_Subsystem "SWC_DDM_type/run_SWC_DDM_5ms_sys/DDM/DDM/Enabled Subsystem" /begin REF_CHARACTERISTIC KDDM_DTCClockerMax_cnt KDDM_DTCDelay_cnt /end REF_CHARACTERISTIC /begin REF_MEASUREMENT VDDM_DTCDetect_enum /end REF_MEASUREMENT /end GROUP
/begin GROUP S5_PMM "SWC_DDM_type/run_SWC_DDM_5ms_sys/DDM/DDM/PMM"
 /begin SUB_GROUP S13_Brake_switch_signal_abnormal1 S13_Comm_err S13_Fault_level S13_Key_authentication_failed S13_LV S13_SW_failure S13_System_conditions_of_ON_to_READY_not_satisfied S13_power_up_and_power_down /end SUB_GROUP
/end GROUP
/begin GROUP S5_TPM "SWC_DDM_type/run_SWC_DDM_5ms_sys/DDM/DDM/TPM"
 /begin SUB_GROUP S16_LFBatwarn S16_LFPressureLow S16_LFSensorfail S16_LFWheelTmpHigh S16_LRBatwarn S16_LRPressureLow S16_LRSensorfail S16_LRWheelTmpHigh S16_RFBatwarn S16_RFPressureLow S16_RFSensorfail S16_RFWheelTmpHigh S16_RRBatwarn S16_RRPressureLow S16_RRSensorfail S16_RRWheelTmpHigh /end SUB_GROUP
/end GROUP
/begin GROUP S5_TQD "SWC_DDM_type/run_SWC_DDM_5ms_sys/DDM/DDM/TQD"
 /begin SUB_GROUP S17_APS_DDM S17_EPB S17_ESC1_DDM S17_ESC5_DDM S17_MCU1_DDM S17_MCU_DDM S17_Regen_fail_DDM S17_Shifter1_DDM /end SUB_GROUP
 /begin REF_CHARACTERISTIC KDDM_EPBErrPopupSW_flg KDDM_SysErrShifterErrSW_flg /end REF_CHARACTERISTIC
 /begin REF_MEASUREMENT VDDM_DisengagePFail_flg VDDM_EDriveSysErrShifterErr_flg VDDM_EDriveSysErrTQD_flg VDDM_EngagePFail_flg VDDM_VehMalfunLevelTmp_enum /end REF_MEASUREMENT
/end GROUP
/begin GROUP S5_VMC_DDM "SWC_DDM_type/run_SWC_DDM_5ms_sys/DDM/DDM/VMC_DDM"
 /begin SUB_GROUP S18_ACC_Acceleration_Command_Error S18_BMS_Signal_Error_ S18_CCU_Signal_Error S18_ESC_Signal_Error S18_Enabled_Subsystem S18_FCM1 S18_FCMACC_Signal_Error S18_MCU_Fr_Signal_Error S18_MCU_Rr_Signal_Error S18_Shifter_Signal_Error S18_Zone_Dr_VCU S18_Zone_Fr_VCU S18_Zone_dr_Error S18_Zone_fr_Error /end SUB_GROUP
/end GROUP
/begin GROUP S13_Brake_switch_signal_abnormal1 "SWC_DDM_type/run_SWC_DDM_5ms_sys/DDM/DDM/PMM/Brake switch signal abnormal1"
 /begin SUB_GROUP S66_Brake_switch_signal_abnormal S66_Brake_switch_signal_abnormal_and_no_backup_signal S66_Subsystem /end SUB_GROUP
 /begin REF_CHARACTERISTIC KDDM_BrkPedalPos_pct /end REF_CHARACTERISTIC
 /begin REF_MEASUREMENT VDDM_BrkPedalPosSta_enum VDDM_CANBrkSW2Sta_enum /end REF_MEASUREMENT
/end GROUP
/begin GROUP S13_Comm_err "SWC_DDM_type/run_SWC_DDM_5ms_sys/DDM/DDM/PMM/Comm err"
 /begin SUB_GROUP S67_The_CAN_signal_between_VCU_and_ABM1_is_discontinuous S67_The_CAN_signal_between_VCU_and_ABM1_is_incomplete S67_The_CAN_signal_between_VCU_and_BMS1_is_discontinuous S67_The_CAN_signal_between_VCU_and_BMS1_is_incomplete S67_The_CAN_signal_between_VCU_and_BMS6_is_discontinuous1 S67_The_CAN_signal_between_VCU_and_BMS6_is_incomplete1 S67_The_CAN_signal_between_VCU_and_CCU1_is_discontinuous S67_The_CAN_signal_between_VCU_and_CCU1_is_incomplete S67_The_CAN_signal_between_VCU_and_CCU2_is_discontinuous S67_The_CAN_signal_between_VCU_and_CCU2_is_incomplete S67_VCU_lost_communication_with_ABM1 S67_VCU_lost_communication_with_BMS1 S67_VCU_lost_communication_with_BMS6 S67_VCU_lost_communication_with_CCU1 S67_VCU_lost_communication_with_CCU2 /end SUB_GROUP
/end GROUP
/begin GROUP S13_Fault_level "SWC_DDM_type/run_SWC_DDM_5ms_sys/DDM/DDM/PMM/Fault level"
 /begin SUB_GROUP S68_Fault_level_1_subsystem_error S68_Fault_level_2_subsystem_error S68_Fault_level_3_subsystem_error S68_Fault_level_4_subsystem_error1 /end SUB_GROUP
/end GROUP
/begin GROUP S13_Key_authentication_failed "SWC_DDM_type/run_SWC_DDM_5ms_sys/DDM/DDM/PMM/Key authentication failed" /begin SUB_GROUP S69_DTC_Couter1 S69_Test_Detection_Criteria1 /end SUB_GROUP
 /begin REF_CHARACTERISTIC KDDM_KeyAuthDTC_cnt KDDM_KeyAuthDetTO_s KDDM_KeyAuthDiagnosisOffSW_flg KDDM_KeyAuthPassTO_s /end REF_CHARACTERISTIC
 /begin REF_MEASUREMENT VDDM_KeyAuthCFSRls_flg VDDM_KeyAuthDFS_flg VDDM_KeyAuthPass_flg /end REF_MEASUREMENT
/end GROUP
/begin GROUP S13_LV "SWC_DDM_type/run_SWC_DDM_5ms_sys/DDM/DDM/PMM/LV"
 /begin SUB_GROUP S70_Initial_LV_battery_voltage_too_low S70_LV_analog_input_error S70_LV_power_supply_voltage_too_high S70_LV_power_supply_voltage_too_low /end SUB_GROUP
 /begin REF_MEASUREMENT VDDM_AuxBatVolt_V VDDM_EDriveSysErrLVSup_flg VDDM_PMMBattErr_flg /end REF_MEASUREMENT
/end GROUP
/begin GROUP S13_SW_failure "SWC_DDM_type/run_SWC_DDM_5ms_sys/DDM/DDM/PMM/SW failure"
 /begin SUB_GROUP S71_Driver_seat_switch_failure S71_FL_Door_switch_failure S71_FR_Door_switch_failure S71_Hood_switch_failure S71_RL_Door_switch_failure S71_RR_Door_switch_failure S71_Tailgate_switch_failure /end SUB_GROUP
/end GROUP
/begin GROUP S13_System_conditions_of_ON_to_READY_not_satisfied "SWC_DDM_type/run_SWC_DDM_5ms_sys/DDM/DDM/PMM/System conditions of ON to READY not satisfied" /begin SUB_GROUP S72_DTC_Couter1 S72_Test_Detection_Criteria1 /end SUB_GROUP
 /begin REF_CHARACTERISTIC KDDM_ONtoRdyDTC_cnt KDDM_ONtoRdyDetTO_s KDDM_ONtoRdyDiagnosisOffSW_flg KDDM_ONtoRdyPassTO_s /end REF_CHARACTERISTIC
 /begin REF_MEASUREMENT VDDM_ONtoRdyCFSRls_flg VDDM_ONtoRdyDFS_flg VDDM_ONtoRdyPass_flg /end REF_MEASUREMENT
/end GROUP
/begin GROUP S13_power_up_and_power_down "SWC_DDM_type/run_SWC_DDM_5ms_sys/DDM/DDM/PMM/power up and power down"
 /begin SUB_GROUP S73_BMS_HV_relay_closed_fail S73_BMS_HV_relay_opened_fail S73_BMS_ready_fail S73_DCDC_disable_fail S73_DCDC_enable_fail S73_DCDC_ready_for_precharge_fail S73_Fr_MCU_active_discharge_fail S73_Fr_MCU_disable_fail S73_Fr_MCU_ready_for_precharge_fail S73_HVB_ready_for_precharge_fail S73_High_level_system_safety_check_fail S73_Mid_level_system_safety_check_fail S73_OBC_ready_for_precharge_fail S73_Rr_MCU_active_discharge_fail S73_Rr_MCU_disable_fail S73_Rr_MCU_ready_for_precharge_fail /end SUB_GROUP
 /begin REF_MEASUREMENT VDDM_EDriveSysErrPowerDown_flg VDDM_EDriveSysErrPowerUp_flg /end REF_MEASUREMENT
/end GROUP
/begin GROUP S16_LFBatwarn "SWC_DDM_type/run_SWC_DDM_5ms_sys/DDM/DDM/TPM/LFBatwarn" /begin SUB_GROUP S569_DTC_Couter S569_Test_Detection_Criteria /end SUB_GROUP
 /begin REF_CHARACTERISTIC KDDM_LFBatwarnCFSSW_flg KDDM_LFBatwarnDTC_cnt KDDM_LFBatwarnDetSW_flg KDDM_LFBatwarnDetTO_s KDDM_LFBatwarnPassSW_flg KDDM_LFBatwarnPassTO_s /end REF_CHARACTERISTIC
/end GROUP
/begin GROUP S16_LFPressureLow "SWC_DDM_type/run_SWC_DDM_5ms_sys/DDM/DDM/TPM/LFPressureLow" /begin SUB_GROUP S570_DTC_Couter S570_Test_Detection_Criteria /end SUB_GROUP
 /begin REF_CHARACTERISTIC KDDM_LFPressIndiCFSSW_flg KDDM_LFPressIndiDTC_cnt KDDM_LFPressIndiDetSW_flg KDDM_LFPressIndiDetTO_s KDDM_LFPressIndiPassSW_flg KDDM_LFPressIndiPassTO_s /end REF_CHARACTERISTIC
/end GROUP
/begin GROUP S16_LFSensorfail "SWC_DDM_type/run_SWC_DDM_5ms_sys/DDM/DDM/TPM/LFSensorfail" /begin SUB_GROUP S571_DTC_Couter S571_Test_Detection_Criteria /end SUB_GROUP
 /begin REF_CHARACTERISTIC KDDM_LFSensorFailCFSSW_flg KDDM_LFSensorFailDTC_cnt KDDM_LFSensorFailDetSW_flg KDDM_LFSensorFailDetTO_s KDDM_LFSensorFailPassSW_flg KDDM_LFSensorFailPassTO_s /end REF_CHARACTERISTIC
/end GROUP
/begin GROUP S16_LFWheelTmpHigh "SWC_DDM_type/run_SWC_DDM_5ms_sys/DDM/DDM/TPM/LFWheelTmpHigh" /begin SUB_GROUP S572_DTC_Couter S572_Test_Detection_Criteria /end SUB_GROUP
 /begin REF_CHARACTERISTIC KDDM_LFWheelTmpHighCFSSW_flg KDDM_LFWheelTmpHighDTC_cnt KDDM_LFWheelTmpHighDetSW_flg KDDM_LFWheelTmpHighDetTO_s KDDM_LFWheelTmpHighPassSW_flg KDDM_LFWheelTmpHighPassTO_s /end REF_CHARACTERISTIC
/end GROUP
/begin GROUP S16_LRBatwarn "SWC_DDM_type/run_SWC_DDM_5ms_sys/DDM/DDM/TPM/LRBatwarn" /begin SUB_GROUP S573_DTC_Couter S573_Test_Detection_Criteria /end SUB_GROUP
 /begin REF_CHARACTERISTIC KDDM_LRBatwarnCFSSW_flg KDDM_LRBatwarnDTC_cnt KDDM_LRBatwarnDetSW_flg KDDM_LRBatwarnDetTO_s KDDM_LRBatwarnPassSW_flg KDDM_LRBatwarnPassTO_s /end REF_CHARACTERISTIC
/end GROUP
/begin GROUP S16_LRPressureLow "SWC_DDM_type/run_SWC_DDM_5ms_sys/DDM/DDM/TPM/LRPressureLow" /begin SUB_GROUP S574_DTC_Couter S574_Test_Detection_Criteria /end SUB_GROUP
 /begin REF_CHARACTERISTIC KDDM_LRPressIndiCFSSW_flg KDDM_LRPressIndiDTC_cnt KDDM_LRPressIndiDetSW_flg KDDM_LRPressIndiDetTO_s KDDM_LRPressIndiPassSW_flg KDDM_LRPressIndiPassTO_s /end REF_CHARACTERISTIC
/end GROUP
/begin GROUP S16_LRSensorfail "SWC_DDM_type/run_SWC_DDM_5ms_sys/DDM/DDM/TPM/LRSensorfail" /begin SUB_GROUP S575_DTC_Couter S575_Test_Detection_Criteria /end SUB_GROUP
 /begin REF_CHARACTERISTIC KDDM_LRSensorFailCFSSW_flg KDDM_LRSensorFailDTC_cnt KDDM_LRSensorFailDetSW_flg KDDM_LRSensorFailDetTO_s KDDM_LRSensorFailPassSW_flg KDDM_LRSensorFailPassTO_s /end REF_CHARACTERISTIC
/end GROUP
/begin GROUP S16_LRWheelTmpHigh "SWC_DDM_type/run_SWC_DDM_5ms_sys/DDM/DDM/TPM/LRWheelTmpHigh" /begin SUB_GROUP S576_DTC_Couter S576_Test_Detection_Criteria /end SUB_GROUP
 /begin REF_CHARACTERISTIC KDDM_LRWheelTmpHighCFSSW_flg KDDM_LRWheelTmpHighDTC_cnt KDDM_LRWheelTmpHighDetSW_flg KDDM_LRWheelTmpHighDetTO_s KDDM_LRWheelTmpHighPassSW_flg KDDM_LRWheelTmpHighPassTO_s /end REF_CHARACTERISTIC
/end GROUP
/begin GROUP S16_RFBatwarn "SWC_DDM_type/run_SWC_DDM_5ms_sys/DDM/DDM/TPM/RFBatwarn" /begin SUB_GROUP S577_DTC_Couter S577_Test_Detection_Criteria /end SUB_GROUP
 /begin REF_CHARACTERISTIC KDDM_RFBatwarnCFSSW_flg KDDM_RFBatwarnDTC_cnt KDDM_RFBatwarnDetSW_flg KDDM_RFBatwarnDetTO_s KDDM_RFBatwarnPassSW_flg KDDM_RFBatwarnPassTO_s /end REF_CHARACTERISTIC
/end GROUP
/begin GROUP S16_RFPressureLow "SWC_DDM_type/run_SWC_DDM_5ms_sys/DDM/DDM/TPM/RFPressureLow" /begin SUB_GROUP S578_DTC_Couter S578_Test_Detection_Criteria /end SUB_GROUP
 /begin REF_CHARACTERISTIC KDDM_RFPressIndiCFSSW_flg KDDM_RFPressIndiDTC_cnt KDDM_RFPressIndiDetSW_flg KDDM_RFPressIndiDetTO_s KDDM_RFPressIndiPassSW_flg KDDM_RFPressIndiPassTO_s /end REF_CHARACTERISTIC
/end GROUP
/begin GROUP S16_RFSensorfail "SWC_DDM_type/run_SWC_DDM_5ms_sys/DDM/DDM/TPM/RFSensorfail" /begin SUB_GROUP S579_DTC_Couter S579_Test_Detection_Criteria /end SUB_GROUP
 /begin REF_CHARACTERISTIC KDDM_RFSensorFailCFSSW_flg KDDM_RFSensorFailDTC_cnt KDDM_RFSensorFailDetSW_flg KDDM_RFSensorFailDetTO_s KDDM_RFSensorFailPassSW_flg KDDM_RFSensorFailPassTO_s /end REF_CHARACTERISTIC
/end GROUP
/begin GROUP S16_RFWheelTmpHigh "SWC_DDM_type/run_SWC_DDM_5ms_sys/DDM/DDM/TPM/RFWheelTmpHigh" /begin SUB_GROUP S580_DTC_Couter S580_Test_Detection_Criteria /end SUB_GROUP
 /begin REF_CHARACTERISTIC KDDM_RFWheelTmpHighCFSSW_flg KDDM_RFWheelTmpHighDTC_cnt KDDM_RFWheelTmpHighDetSW_flg KDDM_RFWheelTmpHighDetTO_s KDDM_RFWheelTmpHighPassSW_flg KDDM_RFWheelTmpHighPassTO_s /end REF_CHARACTERISTIC
/end GROUP
/begin GROUP S16_RRBatwarn "SWC_DDM_type/run_SWC_DDM_5ms_sys/DDM/DDM/TPM/RRBatwarn" /begin SUB_GROUP S581_DTC_Couter S581_Test_Detection_Criteria /end SUB_GROUP
 /begin REF_CHARACTERISTIC KDDM_RRBatwarnCFSSW_flg KDDM_RRBatwarnDTC_cnt KDDM_RRBatwarnDetSW_flg KDDM_RRBatwarnDetTO_s KDDM_RRBatwarnPassSW_flg /end REF_CHARACTERISTIC
/end GROUP
/begin GROUP S16_RRPressureLow "SWC_DDM_type/run_SWC_DDM_5ms_sys/DDM/DDM/TPM/RRPressureLow" /begin SUB_GROUP S582_DTC_Couter S582_Test_Detection_Criteria /end SUB_GROUP
 /begin REF_CHARACTERISTIC KDDM_RRPressIndiCFSSW_flg KDDM_RRPressIndiDTC_cnt KDDM_RRPressIndiDetSW_flg KDDM_RRPressIndiDetTO_s KDDM_RRPressIndiPassSW_flg KDDM_RRPressIndiPassTO_s /end REF_CHARACTERISTIC
/end GROUP
/begin GROUP S16_RRSensorfail "SWC_DDM_type/run_SWC_DDM_5ms_sys/DDM/DDM/TPM/RRSensorfail" /begin SUB_GROUP S583_DTC_Couter S583_Test_Detection_Criteria /end SUB_GROUP
 /begin REF_CHARACTERISTIC KDDM_RRSensorFailCFSSW_flg KDDM_RRSensorFailDTC_cnt KDDM_RRSensorFailDetSW_flg KDDM_RRSensorFailDetTO_s KDDM_RRSensorFailPassSW_flg KDDM_RRSensorFailPassTO_s /end REF_CHARACTERISTIC
/end GROUP
/begin GROUP S16_RRWheelTmpHigh "SWC_DDM_type/run_SWC_DDM_5ms_sys/DDM/DDM/TPM/RRWheelTmpHigh" /begin SUB_GROUP S584_DTC_Couter S584_Test_Detection_Criteria /end SUB_GROUP
 /begin REF_CHARACTERISTIC KDDM_RRWheelTmpHighCFSSW_flg KDDM_RRWheelTmpHighDTC_cnt KDDM_RRWheelTmpHighDetSW_flg KDDM_RRWheelTmpHighDetTO_s KDDM_RRWheelTmpHighPassSW_flg KDDM_RRWheelTmpHighPassTO_s /end REF_CHARACTERISTIC
/end GROUP
/begin GROUP S17_APS_DDM "SWC_DDM_type/run_SWC_DDM_5ms_sys/DDM/DDM/TQD/APS_DDM"
 /begin SUB_GROUP S761_DTC_Couter1 S761_DTC_Couter2 S761_DTC_Couter3 S761_DTC_Couter4 S761_DTC_Couter6 S761_Test_Detection_Criteria1 S761_Test_Detection_Criteria2 S761_Test_Detection_Criteria3 S761_Test_Detection_Criteria4 S761_Test_Detection_Criteria5 /end SUB_GROUP
 /begin REF_CHARACTERISTIC KDDM_5vAPS1OoRDTC_cnt KDDM_5vAPS1OoRDetTO_s KDDM_5vAPS1OoRHiLim_V KDDM_5vAPS1OoRLoLim_V KDDM_5vAPS1OoRPassTO_s KDDM_5vAPS2OoRDTC_cnt KDDM_5vAPS2OoRDetTO_s KDDM_5vAPS2OoRHiLim_V KDDM_5vAPS2OoRLoLim_V KDDM_5vAPS2OoRPassTO_s KDDM_APS1SigOoRDTC_cnt KDDM_APS1SigOoRDetTO_s KDDM_APS1SigOoRPassTO_s KDDM_APS2SigOoRDTC_cnt KDDM_APS2SigOoRDetTO_s KDDM_APS2SigOoRPassTO_s KDDM_APSCorrErrDTC_cnt KDDM_APSCorrErrDetTO_s KDDM_APSCorrErrPassTO_s KDDM_TQDDiagnosisOffSW_flg /end REF_CHARACTERISTIC
 /begin REF_MEASUREMENT VDDM_5vAPS1OoRCFSRls_flg VDDM_5vAPS1OoRDFS_flg VDDM_5vAPS1OoRPass_flg VDDM_5vAPS2OoRCFSRls_flg VDDM_5vAPS2OoRDFS_flg VDDM_5vAPS2OoRPass_flg VDDM_APS1SigOoRCFSRls_flg VDDM_APS1SigOoRDFS_flg VDDM_APS1SigOoRPass_flg VDDM_APS2SigOoRCFSRls_flg VDDM_APS2SigOoRDFS_flg VDDM_APS2SigOoRPass_flg VDDM_APSCorrErrCFSRls_flg VDDM_APSCorrErrDFS_flg VDDM_APSCorrErrPass_flg /end REF_MEASUREMENT
/end GROUP
/begin GROUP S17_EPB "SWC_DDM_type/run_SWC_DDM_5ms_sys/DDM/DDM/TQD/EPB"
 /begin SUB_GROUP S762_DTC_Couter1 S762_DTC_Couter3 S762_DTC_Couter4 S762_DTC_Couter5 S762_DTC_Couter6 S762_DTC_Couter7 S762_SR_Latch1 S762_SR_Latch3 S762_Test_Detection_Criteria1 S762_Test_Detection_Criteria2 S762_Test_Detection_Criteria3 S762_Test_Detection_Criteria4 S762_Test_Detection_Criteria5 S762_Test_Detection_Criteria6 /end SUB_GROUP
 /begin REF_CHARACTERISTIC KDDM_EPB1CSErrDTC_cnt KDDM_EPB1CSErrDetTO_s KDDM_EPB1CSErrPassTO_s KDDM_EPB1NoComDTC_cnt KDDM_EPB1NoComDetTO_s KDDM_EPB1NoComPassTO_s KDDM_EPB1RCErrDTC_cnt KDDM_EPB1RCErrDetTO_s KDDM_EPB1RCErrPassTO_s KDDM_EPBLockTODTC_cnt KDDM_EPBLockTODetTO_s KDDM_EPBLockTOPassTO_s KDDM_EPBSigErrDTC_cnt KDDM_EPBSigErrDetTO_s KDDM_EPBSigErrPassTO_s KDDM_EPBUnlockTODTC_cnt KDDM_EPBUnlockTODetTO_s KDDM_EPBUnlockTOPassTO_s KDDM_TQDDiagnosisOffSW_flg /end REF_CHARACTERISTIC
 /begin REF_MEASUREMENT VDDM_EPB1CSErrCFSRls_flg VDDM_EPB1CSErrDFS_flg VDDM_EPB1CSErrPass_flg VDDM_EPB1NoComCFSRls_flg VDDM_EPB1NoComDFS_flg VDDM_EPB1NoComPass_flg VDDM_EPB1RCErrCFSRls_flg VDDM_EPB1RCErrDFS_flg VDDM_EPB1RCErrPass_flg VDDM_EPBLockTOCFSRls_flg VDDM_EPBLockTODFS_flg VDDM_EPBSigErrCFSRls_flg VDDM_EPBSigErrDFS_flg VDDM_EPBSigErrPass_flg VDDM_EPBUnlockTODFSRls_flg VDDM_EPBUnlockTODFS_flg /end REF_MEASUREMENT
/end GROUP
/begin GROUP S17_ESC1_DDM "SWC_DDM_type/run_SWC_DDM_5ms_sys/DDM/DDM/TQD/ESC1_DDM"
 /begin SUB_GROUP S763_DTC_Couter1 S763_DTC_Couter2 S763_DTC_Couter7 S763_Test_Detection_Criteria2 S763_Test_Detection_Criteria3 S763_Test_Detection_Criteria4 /end SUB_GROUP
 /begin REF_CHARACTERISTIC KDDM_ESC1CSErrDTC_cnt KDDM_ESC1CSErrDetTO_s KDDM_ESC1CSErrPassTO_s KDDM_ESC1NoComDTC_cnt KDDM_ESC1NoComDetTO_s KDDM_ESC1NoComPassTO_s KDDM_ESC1RCErrDTC_cnt KDDM_ESC1RCErrDetTO_s KDDM_ESC1RCErrPassTO_s KDDM_TQDDiagnosisOffSW_flg /end REF_CHARACTERISTIC
 /begin REF_MEASUREMENT VDDM_ESC1CSErrCFSRls_flg VDDM_ESC1CSErrDFS_flg VDDM_ESC1NoComCFSRls_flg VDDM_ESC1NoComDFS_flg VDDM_ESC1RCErrCFSRls_flg VDDM_ESC1RCErrDFS_flg /end REF_MEASUREMENT
/end GROUP
/begin GROUP S17_ESC5_DDM "SWC_DDM_type/run_SWC_DDM_5ms_sys/DDM/DDM/TQD/ESC5_DDM"
 /begin SUB_GROUP S764_DTC_Couter1 S764_DTC_Couter2 S764_DTC_Couter7 S764_Test_Detection_Criteria2 S764_Test_Detection_Criteria3 S764_Test_Detection_Criteria4 /end SUB_GROUP
 /begin REF_CHARACTERISTIC KDDM_ESC5CSErrDTC_cnt KDDM_ESC5CSErrDetTO_s KDDM_ESC5CSErrPassTO_s KDDM_ESC5NoComDTC_cnt KDDM_ESC5NoComDetTO_s KDDM_ESC5NoComPassTO_s KDDM_ESC5RCErrDTC_cnt KDDM_ESC5RCErrDetTO_s KDDM_ESC5RCErrPassTO_s KDDM_TQDDiagnosisOffSW_flg /end REF_CHARACTERISTIC
 /begin REF_MEASUREMENT VDDM_ESC5CSErrCFSRls_flg VDDM_ESC5CSErrDFS_flg VDDM_ESC5CSErrPass_flg VDDM_ESC5NoComCFSRls_flg VDDM_ESC5NoComDFS_flg VDDM_ESC5NoComPass_flg VDDM_ESC5RCErrCFSRls_flg VDDM_ESC5RCErrDFS_flg VDDM_ESC5RCErrPass_flg /end REF_MEASUREMENT
/end GROUP
/begin GROUP S17_MCU1_DDM "SWC_DDM_type/run_SWC_DDM_5ms_sys/DDM/DDM/TQD/MCU1_DDM"
 /begin SUB_GROUP S765_DTC_Couter1 S765_DTC_Couter2 S765_DTC_Couter3 S765_DTC_Couter4 S765_DTC_Couter5 S765_DTC_Couter7 S765_Test_Detection_Criteria1 S765_Test_Detection_Criteria2 S765_Test_Detection_Criteria3 S765_Test_Detection_Criteria4 S765_Test_Detection_Criteria5 S765_Test_Detection_Criteria6 /end SUB_GROUP
 /begin REF_CHARACTERISTIC KDDM_MCUF1CSErrDTC_cnt KDDM_MCUF1CSErrDetTO_s KDDM_MCUF1CSErrPassTO_s KDDM_MCUF1NoComDTC_cnt KDDM_MCUF1NoComDetTO_s KDDM_MCUF1NoComPassTO_s KDDM_MCUF1RCErrDTC_cnt KDDM_MCUF1RCErrDetTO_s KDDM_MCUF1RCErrPassTO_s KDDM_MCUR1CSErrDTC_cnt KDDM_MCUR1CSErrDetTO_s KDDM_MCUR1CSErrPassTO_s KDDM_MCUR1NoComDTC_cnt KDDM_MCUR1NoComDetTO_s KDDM_MCUR1NoComPassTO_s KDDM_MCUR1RCErrDTC_cnt KDDM_MCUR1RCErrDetTO_s KDDM_MCUR1RCErrPassTO_s KDDM_TQDDiagnosisOffSW_flg /end REF_CHARACTERISTIC
 /begin REF_MEASUREMENT VDDM_MCUF1CSErrCFSRls_flg VDDM_MCUF1CSErrDFS_flg VDDM_MCUF1CSErrPass_flg VDDM_MCUF1NoComCFSRls_flg VDDM_MCUF1NoComDFS_flg VDDM_MCUF1NoComPass_flg VDDM_MCUF1RCErrCFSRls_flg VDDM_MCUF1RCErrDFS_flg VDDM_MCUF1RCErrPass_flg VDDM_MCUR1CSErrCFSRls_flg VDDM_MCUR1CSErrDFS_flg VDDM_MCUR1CSErrPass_flg VDDM_MCUR1NoComCFSRls_flg VDDM_MCUR1NoComDFS_flg VDDM_MCUR1NoComPass_flg VDDM_MCUR1RCErrCFSRls_flg VDDM_MCUR1RCErrDFS_flg VDDM_MCUR1RCErrPass_flg /end REF_MEASUREMENT
/end GROUP
/begin GROUP S17_MCU_DDM "SWC_DDM_type/run_SWC_DDM_5ms_sys/DDM/DDM/TQD/MCU_DDM"
 /begin SUB_GROUP S766_DTC_Couter1 S766_DTC_Couter3 S766_Test_Detection_Criteria1 S766_Test_Detection_Criteria2 /end SUB_GROUP
 /begin REF_CHARACTERISTIC KDDM_FrMCUTqErrDTC_cnt KDDM_FrMCUTqErrDetTO_s KDDM_FrMCUTqErrPassTO_s KDDM_RrMCUTqErrDTC_cnt KDDM_RrMCUTqErrDetTO_s KDDM_RrMCUTqErrPassTO_s KDDM_TQDDiagnosisOffSW_flg MDDM_FrTMTqDev_Y_Nm MDDM_RrTMTqDev_Y_Nm /end REF_CHARACTERISTIC
 /begin REF_MEASUREMENT VDDM_FrMCUTqErrCFSRls_flg VDDM_FrMCUTqErrDFS_flg VDDM_FrMCUTqErrPass_flg VDDM_FrTMTqDev_Nm VDDM_FrTMTqDiffAbs_Nm VDDM_FrTMTqDiffGTDev_flg VDDM_RrMCUTqErrCFSRls_flg VDDM_RrMCUTqErrDFS_flg VDDM_RrMCUTqErrPass_flg VDDM_RrTMTqDev_Nm VDDM_RrTMTqDiffAbs_Nm VDDM_RrTMTqDiffGTDev_flg /end REF_MEASUREMENT
/end GROUP
/begin GROUP S17_Regen_fail_DDM "SWC_DDM_type/run_SWC_DDM_5ms_sys/DDM/DDM/TQD/Regen_fail_DDM" /begin SUB_GROUP S767_DTC_Couter4 S767_Test_Detection_Criteria1 /end SUB_GROUP
 /begin REF_CHARACTERISTIC KDDM_RegenErrDTC_cnt KDDM_RegenErrDetTO_s KDDM_RegenErrPassTO_s KDDM_TQDDiagnosisOffSW_flg /end REF_CHARACTERISTIC
 /begin REF_MEASUREMENT VDDM_RegenErrCFSRls_flg VDDM_RegenErrDFS_flg VDDM_RegenErrPass_flg /end REF_MEASUREMENT
/end GROUP
/begin GROUP S17_Shifter1_DDM "SWC_DDM_type/run_SWC_DDM_5ms_sys/DDM/DDM/TQD/Shifter1_DDM"
 /begin SUB_GROUP S770_DTC_Couter1 S770_DTC_Couter2 S770_DTC_Couter4 S770_Test_Detection_Criteria1 S770_Test_Detection_Criteria2 S770_Test_Detection_Criteria3 /end SUB_GROUP
 /begin REF_CHARACTERISTIC KDDM_Shifter1CSErrDTC_cnt KDDM_Shifter1CSErrDetTO_s KDDM_Shifter1CSErrPassTO_s KDDM_Shifter1NoComDTC_cnt KDDM_Shifter1NoComDetTO_s KDDM_Shifter1NoComPassTO_s KDDM_Shifter1RCErrDTC_cnt KDDM_Shifter1RCErrDetTO_s KDDM_Shifter1RCErrPassTO_s KDDM_TQDDiagnosisOffSW_flg /end REF_CHARACTERISTIC
 /begin REF_MEASUREMENT VDDM_Shifter1CSErrCFSRls_flg VDDM_Shifter1CSErrDFS_flg VDDM_Shifter1CSErrPass_flg VDDM_Shifter1NoComCFSRls_flg VDDM_Shifter1NoComDFS_flg VDDM_Shifter1NoComPass_flg VDDM_Shifter1RCErrCFSRls_flg VDDM_Shifter1RCErrDFS_flg VDDM_Shifter1RCErrPass_flg /end REF_MEASUREMENT
/end GROUP
/begin GROUP S18_ACC_Acceleration_Command_Error "SWC_DDM_type/run_SWC_DDM_5ms_sys/DDM/DDM/VMC_DDM/ACC Acceleration Command Error" /begin SUB_GROUP S1009_ACC_Acceleration_Command_Error_ /end SUB_GROUP /end GROUP
/begin GROUP S18_BMS_Signal_Error_ "SWC_DDM_type/run_SWC_DDM_5ms_sys/DDM/DDM/VMC_DDM/BMS Signal Error " /begin SUB_GROUP S1010_BMS_Signal_Error_ /end SUB_GROUP /end GROUP
/begin GROUP S18_CCU_Signal_Error "SWC_DDM_type/run_SWC_DDM_5ms_sys/DDM/DDM/VMC_DDM/CCU Signal Error" /begin SUB_GROUP S1011_CCU_Signal_Error_ /end SUB_GROUP /end GROUP
/begin GROUP S18_ESC_Signal_Error "SWC_DDM_type/run_SWC_DDM_5ms_sys/DDM/DDM/VMC_DDM/ESC Signal Error" /begin SUB_GROUP S1012_ESC_Signal_Error_ /end SUB_GROUP /end GROUP
/begin GROUP S18_Enabled_Subsystem "SWC_DDM_type/run_SWC_DDM_5ms_sys/DDM/DDM/VMC_DDM/Enabled Subsystem"
 /begin SUB_GROUP S1013_EPS1_Checksum_Error S1013_EPS1_Lost_Comm S1013_EPS1_Rolling_Count_Error_ S1013_EPS1_Signal_Error /end SUB_GROUP
/end GROUP
/begin GROUP S18_FCM1 "SWC_DDM_type/run_SWC_DDM_5ms_sys/DDM/DDM/VMC_DDM/FCM1"
 /begin SUB_GROUP S1014_FCM1_Checksum_Error_ S1014_FCM1_Lost_Com S1014_FCM1_Rolling_Count_Error_ /end SUB_GROUP
/end GROUP
/begin GROUP S18_FCMACC_Signal_Error "SWC_DDM_type/run_SWC_DDM_5ms_sys/DDM/DDM/VMC_DDM/FCMACC Signal Error" /begin SUB_GROUP S1015_FCMACC_Signal_Error_ /end SUB_GROUP /end GROUP
/begin GROUP S18_MCU_Fr_Signal_Error "SWC_DDM_type/run_SWC_DDM_5ms_sys/DDM/DDM/VMC_DDM/MCU_Fr Signal Error" /begin SUB_GROUP S1016_MCU_Fr_Signal_Error_ /end SUB_GROUP /end GROUP
/begin GROUP S18_MCU_Rr_Signal_Error "SWC_DDM_type/run_SWC_DDM_5ms_sys/DDM/DDM/VMC_DDM/MCU_Rr Signal Error" /begin SUB_GROUP S1017_MCU_Rr_Signal_Error_ /end SUB_GROUP /end GROUP
/begin GROUP S18_Shifter_Signal_Error "SWC_DDM_type/run_SWC_DDM_5ms_sys/DDM/DDM/VMC_DDM/Shifter Signal Error" /begin SUB_GROUP S1018_Shifter_Signal_Error_ /end SUB_GROUP /end GROUP
/begin GROUP S18_Zone_Dr_VCU "SWC_DDM_type/run_SWC_DDM_5ms_sys/DDM/DDM/VMC_DDM/Zone_Dr_VCU" /begin SUB_GROUP S1019_DTC_Couter2 S1019_Test_Detection_Criteria2 /end SUB_GROUP
 /begin REF_CHARACTERISTIC KDDM_DrVCUNoComDTC_cnt KDDM_DrVCUNoComDetTO_s KDDM_DrVCUNoComPassTO_s KDDM_VMCDiagnosisOffSW_flg /end REF_CHARACTERISTIC
 /begin REF_MEASUREMENT VDDM_DrVCUNoComCFSRls_flg VDDM_DrVCUNoComDFS_flg VDDM_DrVCUNoComPass_flg /end REF_MEASUREMENT
/end GROUP
/begin GROUP S18_Zone_Fr_VCU "SWC_DDM_type/run_SWC_DDM_5ms_sys/DDM/DDM/VMC_DDM/Zone_Fr_VCU" /begin SUB_GROUP S1020_DTC_Couter2 S1020_Test_Detection_Criteria2 /end SUB_GROUP
 /begin REF_CHARACTERISTIC KDDM_FrVCUNoComDTC_cnt KDDM_FrVCUNoComDetTO_s KDDM_FrVCUNoComPassTO_s KDDM_VMCDiagnosisOffSW_flg /end REF_CHARACTERISTIC
 /begin REF_MEASUREMENT VDDM_FrVCUNoComCFSRls_flg VDDM_FrVCUNoComDFS_flg VDDM_FrVCUNoComPass_flg /end REF_MEASUREMENT
/end GROUP
/begin GROUP S18_Zone_dr_Error "SWC_DDM_type/run_SWC_DDM_5ms_sys/DDM/DDM/VMC_DDM/Zone_dr Error" /begin SUB_GROUP S1021_Zone_dr_Error_ /end SUB_GROUP /end GROUP
/begin GROUP S18_Zone_fr_Error "SWC_DDM_type/run_SWC_DDM_5ms_sys/DDM/DDM/VMC_DDM/Zone_fr Error" /begin SUB_GROUP S1022_Zone_fr_Error_ /end SUB_GROUP /end GROUP
/begin GROUP S66_Brake_switch_signal_abnormal "SWC_DDM_type/run_SWC_DDM_5ms_sys/DDM/DDM/PMM/Brake switch signal abnormal1/Brake switch signal abnormal" /begin SUB_GROUP S74_DTC_Couter1 S74_Test_Detection_Criteria1 /end SUB_GROUP
 /begin REF_CHARACTERISTIC KDDM_BrkSWDiagnosisOffSW_flg KDDM_BrkSWErrDTC_cnt KDDM_BrkSWErrDetTO_s KDDM_BrkSWErrPassTO_s KDDM_DwnDetWinBrkPos_pct KDDM_UpDetWinBrkPos_pct /end REF_CHARACTERISTIC
 /begin REF_MEASUREMENT VDDM_BrkSWErrCFSRls_flg VDDM_BrkSWErrDFS_flg VDDM_BrkSWErrPass_flg /end REF_MEASUREMENT
/end GROUP
/begin GROUP S66_Brake_switch_signal_abnormal_and_no_backup_signal "SWC_DDM_type/run_SWC_DDM_5ms_sys/DDM/DDM/PMM/Brake switch signal abnormal1/Brake switch signal abnormal and no backup signal" /begin SUB_GROUP S75_DTC_Couter1 S75_Test_Detection_Criteria1 /end SUB_GROUP
 /begin REF_CHARACTERISTIC KDDM_BrkSWDiagnosisOffSW_flg KDDM_BrkSWNoBacDTC_cnt KDDM_BrkSWNoBacDetTO_s KDDM_BrkSWNoBacPassTO_s KDDM_DwnDetWinBrkPos_pct KDDM_UpDetWinBrkPos_pct /end REF_CHARACTERISTIC
 /begin REF_MEASUREMENT VDDM_BrkSWNoBacCFSRls_flg VDDM_BrkSWNoBacDFS_flg VDDM_BrkSWNoBacPass_flg /end REF_MEASUREMENT
/end GROUP
/begin GROUP S66_Subsystem "SWC_DDM_type/run_SWC_DDM_5ms_sys/DDM/DDM/PMM/Brake switch signal abnormal1/Subsystem"
 /begin REF_MEASUREMENT VDDM_BrakeSW_enum VDDM_BrakeSigMatrix_enum VDDM_BrkSWErr_flg VDDM_BrkSWNoBac_flg VDDM_BrkSWPass_flg /end REF_MEASUREMENT
/end GROUP
/begin GROUP S67_The_CAN_signal_between_VCU_and_ABM1_is_discontinuous "SWC_DDM_type/run_SWC_DDM_5ms_sys/DDM/DDM/PMM/Comm err/The CAN signal between VCU and ABM1 is discontinuous" /begin SUB_GROUP S93_DTC_Couter1 S93_Test_Detection_Criteria1 /end SUB_GROUP
 /begin REF_CHARACTERISTIC KDDM_C1ABM1RCDTC_cnt KDDM_C1ABM1RCDetTO_s KDDM_C1ABM1RCPassTO_s KDDM_CommErrDiagnosisOffSW_flg /end REF_CHARACTERISTIC
 /begin REF_MEASUREMENT VDDM_C1ABM1RCCFSRls_flg VDDM_C1ABM1RCDFS_flg VDDM_C1ABM1RCPass_flg /end REF_MEASUREMENT
/end GROUP
/begin GROUP S67_The_CAN_signal_between_VCU_and_ABM1_is_incomplete "SWC_DDM_type/run_SWC_DDM_5ms_sys/DDM/DDM/PMM/Comm err/The CAN signal between VCU and ABM1 is incomplete" /begin SUB_GROUP S94_DTC_Couter1 S94_Test_Detection_Criteria1 /end SUB_GROUP
 /begin REF_CHARACTERISTIC KDDM_C1ABM1CSDTC_cnt KDDM_C1ABM1CSDetTO_s KDDM_C1ABM1CSPassTO_s KDDM_CommErrDiagnosisOffSW_flg /end REF_CHARACTERISTIC
 /begin REF_MEASUREMENT VDDM_C1ABM1CSCFSRls_flg VDDM_C1ABM1CSDFS_flg VDDM_C1ABM1CSPass_flg /end REF_MEASUREMENT
/end GROUP
/begin GROUP S67_The_CAN_signal_between_VCU_and_BMS1_is_discontinuous "SWC_DDM_type/run_SWC_DDM_5ms_sys/DDM/DDM/PMM/Comm err/The CAN signal between VCU and BMS1 is discontinuous" /begin SUB_GROUP S95_DTC_Couter1 S95_Test_Detection_Criteria /end SUB_GROUP
 /begin REF_CHARACTERISTIC KDDM_C3BMS1RCDTC_cnt KDDM_C3BMS1RCDetTO_s KDDM_C3BMS1RCPassTO_s KDDM_CommErrDiagnosisOffSW_flg /end REF_CHARACTERISTIC
 /begin REF_MEASUREMENT VDDM_C3BMS1RCCFSRls_flg VDDM_C3BMS1RCDFS_flg VDDM_C3BMS1RCPass_flg /end REF_MEASUREMENT
/end GROUP
/begin GROUP S67_The_CAN_signal_between_VCU_and_BMS1_is_incomplete "SWC_DDM_type/run_SWC_DDM_5ms_sys/DDM/DDM/PMM/Comm err/The CAN signal between VCU and BMS1 is incomplete" /begin SUB_GROUP S96_DTC_Couter1 S96_Test_Detection_Criteria1 /end SUB_GROUP
 /begin REF_CHARACTERISTIC KDDM_C3BMS1CSDTC_cnt KDDM_C3BMS1CSDetTO_s KDDM_C3BMS1CSPassTO_s KDDM_CommErrDiagnosisOffSW_flg /end REF_CHARACTERISTIC
 /begin REF_MEASUREMENT VDDM_C3BMS1CSCFSRls_flg VDDM_C3BMS1CSDFS_flg VDDM_C3BMS1CSPass_flg /end REF_MEASUREMENT
/end GROUP
/begin GROUP S67_The_CAN_signal_between_VCU_and_BMS6_is_discontinuous1 "SWC_DDM_type/run_SWC_DDM_5ms_sys/DDM/DDM/PMM/Comm err/The CAN signal between VCU and BMS6 is discontinuous1" /begin SUB_GROUP S97_DTC_Couter S97_Test_Detection_Criteria /end SUB_GROUP
 /begin REF_CHARACTERISTIC KDDM_C3BMS6RCDTC_cnt KDDM_C3BMS6RCDetTO_s KDDM_C3BMS6RCPassTO_s KDDM_CommErrDiagnosisOffSW_flg /end REF_CHARACTERISTIC
 /begin REF_MEASUREMENT VDDM_C3BMS6RCCFSRls_flg VDDM_C3BMS6RCDFS_flg VDDM_C3BMS6RCPass_flg /end REF_MEASUREMENT
/end GROUP
/begin GROUP S67_The_CAN_signal_between_VCU_and_BMS6_is_incomplete1 "SWC_DDM_type/run_SWC_DDM_5ms_sys/DDM/DDM/PMM/Comm err/The CAN signal between VCU and BMS6 is incomplete1" /begin SUB_GROUP S98_DTC_Couter1 S98_Test_Detection_Criteria1 /end SUB_GROUP
 /begin REF_CHARACTERISTIC KDDM_C3BMS6CSDTC_cnt KDDM_C3BMS6CSDetTO_s KDDM_C3BMS6CSPassTO_s KDDM_CommErrDiagnosisOffSW_flg /end REF_CHARACTERISTIC
 /begin REF_MEASUREMENT VDDM_C3BMS6CSCFSRls_flg VDDM_C3BMS6CSDFS_flg VDDM_C3BMS6CSPass_flg /end REF_MEASUREMENT
/end GROUP
/begin GROUP S67_The_CAN_signal_between_VCU_and_CCU1_is_discontinuous "SWC_DDM_type/run_SWC_DDM_5ms_sys/DDM/DDM/PMM/Comm err/The CAN signal between VCU and CCU1 is discontinuous" /begin SUB_GROUP S99_DTC_Couter1 S99_Test_Detection_Criteria1 /end SUB_GROUP
 /begin REF_CHARACTERISTIC KDDM_C3CCU1RCDTC_cnt KDDM_C3CCU1RCDetTO_s KDDM_C3CCU1RCPassTO_s KDDM_CommErrDiagnosisOffSW_flg /end REF_CHARACTERISTIC
 /begin REF_MEASUREMENT VDDM_C3CCU1RCCFSRls_flg VDDM_C3CCU1RCDFS_flg VDDM_C3CCU1RCPass_flg /end REF_MEASUREMENT
/end GROUP
/begin GROUP S67_The_CAN_signal_between_VCU_and_CCU1_is_incomplete "SWC_DDM_type/run_SWC_DDM_5ms_sys/DDM/DDM/PMM/Comm err/The CAN signal between VCU and CCU1 is incomplete" /begin SUB_GROUP S100_DTC_Couter1 S100_Test_Detection_Criteria1 /end SUB_GROUP
 /begin REF_CHARACTERISTIC KDDM_C3CCU1CSDTC_cnt KDDM_C3CCU1CSDetTO_s KDDM_C3CCU1CSPassTO_s KDDM_CommErrDiagnosisOffSW_flg /end REF_CHARACTERISTIC
 /begin REF_MEASUREMENT VDDM_C3CCU1CSCFSRls_flg VDDM_C3CCU1CSDFS_flg VDDM_C3CCU1CSPass_flg /end REF_MEASUREMENT
/end GROUP
/begin GROUP S67_The_CAN_signal_between_VCU_and_CCU2_is_discontinuous "SWC_DDM_type/run_SWC_DDM_5ms_sys/DDM/DDM/PMM/Comm err/The CAN signal between VCU and CCU2 is discontinuous" /begin SUB_GROUP S101_DTC_Couter1 S101_Test_Detection_Criteria1 /end SUB_GROUP
 /begin REF_CHARACTERISTIC KDDM_C3CCU2RCDTC_cnt KDDM_C3CCU2RCDetTO_s KDDM_C3CCU2RCPassTO_s KDDM_CommErrDiagnosisOffSW_flg /end REF_CHARACTERISTIC
 /begin REF_MEASUREMENT VDDM_C3CCU2RCCFSRls_flg VDDM_C3CCU2RCDFS_flg VDDM_C3CCU2RCPass_flg /end REF_MEASUREMENT
/end GROUP
/begin GROUP S67_The_CAN_signal_between_VCU_and_CCU2_is_incomplete "SWC_DDM_type/run_SWC_DDM_5ms_sys/DDM/DDM/PMM/Comm err/The CAN signal between VCU and CCU2 is incomplete" /begin SUB_GROUP S102_DTC_Couter1 S102_Test_Detection_Criteria1 /end SUB_GROUP
 /begin REF_CHARACTERISTIC KDDM_C3CCU2CSDTC_cnt KDDM_C3CCU2CSDetTO_s KDDM_C3CCU2CSPassTO_s KDDM_CommErrDiagnosisOffSW_flg /end REF_CHARACTERISTIC
 /begin REF_MEASUREMENT VDDM_C3CCU2CSCFSRls_flg VDDM_C3CCU2CSDFS_flg VDDM_C3CCU2CSPass_flg /end REF_MEASUREMENT
/end GROUP
/begin GROUP S67_VCU_lost_communication_with_ABM1 "SWC_DDM_type/run_SWC_DDM_5ms_sys/DDM/DDM/PMM/Comm err/VCU lost communication with ABM1" /begin SUB_GROUP S103_DTC_Couter1 S103_Test_Detection_Criteria1 /end SUB_GROUP
 /begin REF_CHARACTERISTIC KDDM_C1ABM1LCDTC_cnt KDDM_C1ABM1LCDetTO_s KDDM_C1ABM1LCPassTO_s KDDM_CommErrDiagnosisOffSW_flg /end REF_CHARACTERISTIC
 /begin REF_MEASUREMENT VDDM_C1ABM1LCCFSRls_flg VDDM_C1ABM1LCDFS_flg VDDM_C1ABM1LCPass_flg /end REF_MEASUREMENT
/end GROUP
/begin GROUP S67_VCU_lost_communication_with_BMS1 "SWC_DDM_type/run_SWC_DDM_5ms_sys/DDM/DDM/PMM/Comm err/VCU lost communication with BMS1" /begin SUB_GROUP S104_DTC_Couter1 S104_Test_Detection_Criteria1 /end SUB_GROUP
 /begin REF_CHARACTERISTIC KDDM_C3BMS1LCDTC_cnt KDDM_C3BMS1LCDetTO_s KDDM_C3BMS1LCPassTO_s KDDM_CommErrDiagnosisOffSW_flg /end REF_CHARACTERISTIC
 /begin REF_MEASUREMENT VDDM_C3BMS1LCCFSRls_flg VDDM_C3BMS1LCDFS_flg VDDM_C3BMS1LCPass_flg /end REF_MEASUREMENT
/end GROUP
/begin GROUP S67_VCU_lost_communication_with_BMS6 "SWC_DDM_type/run_SWC_DDM_5ms_sys/DDM/DDM/PMM/Comm err/VCU lost communication with BMS6" /begin SUB_GROUP S105_DTC_Couter1 S105_Test_Detection_Criteria1 /end SUB_GROUP
 /begin REF_CHARACTERISTIC KDDM_C3BMS6LCDTC_cnt KDDM_C3BMS6LCDetTO_s KDDM_C3BMS6LCPassTO_s KDDM_CommErrDiagnosisOffSW_flg /end REF_CHARACTERISTIC
 /begin REF_MEASUREMENT VDDM_C3BMS6LCCFSRls_flg VDDM_C3BMS6LCDFS_flg VDDM_C3BMS6LCPass_flg /end REF_MEASUREMENT
/end GROUP
/begin GROUP S67_VCU_lost_communication_with_CCU1 "SWC_DDM_type/run_SWC_DDM_5ms_sys/DDM/DDM/PMM/Comm err/VCU lost communication with CCU1" /begin SUB_GROUP S106_DTC_Couter1 S106_Test_Detection_Criteria1 /end SUB_GROUP
 /begin REF_CHARACTERISTIC KDDM_C3CCU1LCDTC_cnt KDDM_C3CCU1LCDetTO_s KDDM_C3CCU1LCPassTO_s KDDM_CommErrDiagnosisOffSW_flg /end REF_CHARACTERISTIC
 /begin REF_MEASUREMENT VDDM_C3CCU1LCCFSRls_flg VDDM_C3CCU1LCDFS_flg VDDM_C3CCU1LCPass_flg /end REF_MEASUREMENT
/end GROUP
/begin GROUP S67_VCU_lost_communication_with_CCU2 "SWC_DDM_type/run_SWC_DDM_5ms_sys/DDM/DDM/PMM/Comm err/VCU lost communication with CCU2" /begin SUB_GROUP S107_DTC_Couter1 S107_Test_Detection_Criteria1 /end SUB_GROUP
 /begin REF_CHARACTERISTIC KDDM_C3CCU2LCDTC_cnt KDDM_C3CCU2LCDetTO_s KDDM_C3CCU2LCPassTO_s KDDM_CommErrDiagnosisOffSW_flg /end REF_CHARACTERISTIC
 /begin REF_MEASUREMENT VDDM_C3CCU2LCCFSRls_flg VDDM_C3CCU2LCDFS_flg VDDM_C3CCU2LCPass_flg /end REF_MEASUREMENT
/end GROUP
/begin GROUP S68_Fault_level_1_subsystem_error "SWC_DDM_type/run_SWC_DDM_5ms_sys/DDM/DDM/PMM/Fault level/Fault level 1 subsystem error" /begin SUB_GROUP S228_DTC_Couter S228_Test_Detection_Criteria /end SUB_GROUP
 /begin REF_CHARACTERISTIC KDDM_FaultLvDiagnosisOffSW_flg KDDM_Lv1ErrDTC_cnt KDDM_Lv1ErrDetTO_s KDDM_Lv1ErrPassTO_s /end REF_CHARACTERISTIC
 /begin REF_MEASUREMENT VDDM_AWDMCUFrFaultLv1_flg VDDM_AWDMCURrFaultLv1_flg VDDM_BMSFaultLv1_flg VDDM_DCDCFaultLv1_flg VDDM_EDriveSysErrFaultLv1_flg VDDM_ESCFaultLv1_flg VDDM_Lv1ErrCFSRls_flg VDDM_Lv1ErrDFS_flg VDDM_Lv1ErrPass_flg VDDM_MCUF1FaultLv1_flg VDDM_MCUR1FaultLv1_flg VDDM_OBCFaultLv1_flg VDDM_ShifterFaultLv1_flg VDDM_ZoneDrFaultLv1_flg VDDM_ZoneFrFaultLv1_flg /end REF_MEASUREMENT
/end GROUP
/begin GROUP S68_Fault_level_2_subsystem_error "SWC_DDM_type/run_SWC_DDM_5ms_sys/DDM/DDM/PMM/Fault level/Fault level 2 subsystem error" /begin SUB_GROUP S229_DTC_Couter S229_Test_Detection_Criteria /end SUB_GROUP
 /begin REF_CHARACTERISTIC KDDM_FaultLvDiagnosisOffSW_flg KDDM_Lv2ErrDTC_cnt KDDM_Lv2ErrDetTO_s KDDM_Lv2ErrPassTO_s /end REF_CHARACTERISTIC
 /begin REF_MEASUREMENT VDDM_AWDMCUFaultLv2_flg VDDM_BMSFaultLv2_flg VDDM_DCDCFaultLv2_flg VDDM_Lv2ErrCFSRls_flg VDDM_Lv2ErrDFS_flg VDDM_Lv2ErrPass_flg VDDM_MCUF1FaultLv2_flg VDDM_MCUR1FaultLv2_flg VDDM_ZoneDrFaultLv2_flg VDDM_ZoneFrFaultLv2_flg /end REF_MEASUREMENT
/end GROUP
/begin GROUP S68_Fault_level_3_subsystem_error "SWC_DDM_type/run_SWC_DDM_5ms_sys/DDM/DDM/PMM/Fault level/Fault level 3 subsystem error" /begin SUB_GROUP S230_DTC_Couter S230_Test_Detection_Criteria /end SUB_GROUP
 /begin REF_CHARACTERISTIC KDDM_FaultLvDiagnosisOffSW_flg KDDM_Lv3ErrDTC_cnt KDDM_Lv3ErrDetTO_s KDDM_Lv3ErrPassTO_s /end REF_CHARACTERISTIC
 /begin REF_MEASUREMENT VDDM_BMSFaultLv3_flg VDDM_Lv3ErrCFSRls_flg VDDM_Lv3ErrDFS_flg VDDM_Lv3ErrPass_flg VDDM_MCUF1FaultLv3_flg VDDM_MCUR1FaultLv3_flg VDDM_ZoneDrFaultLv3_flg VDDM_ZoneFrFaultLv3_flg /end REF_MEASUREMENT
/end GROUP
/begin GROUP S68_Fault_level_4_subsystem_error1 "SWC_DDM_type/run_SWC_DDM_5ms_sys/DDM/DDM/PMM/Fault level/Fault level 4 subsystem error1" /begin SUB_GROUP S231_DTC_Couter S231_Test_Detection_Criteria /end SUB_GROUP
 /begin REF_CHARACTERISTIC KDDM_FaultLvDiagnosisOffSW_flg KDDM_Lv4ErrDTC_cnt KDDM_Lv4ErrDetTO_s KDDM_Lv4ErrPassTO_s /end REF_CHARACTERISTIC
 /begin REF_MEASUREMENT VDDM_BMSFaultLv4_flg VDDM_Lv4ErrCFSRls_flg VDDM_Lv4ErrDFS_flg VDDM_Lv4ErrPass_flg VDDM_ZoneDrFaultLv4_flg VDDM_ZoneFrFaultLv4_flg /end REF_MEASUREMENT
/end GROUP
/begin GROUP S69_DTC_Couter1 "SWC_DDM_type/run_SWC_DDM_5ms_sys/DDM/DDM/PMM/Key authentication failed/DTC_Couter1" /begin REF_MEASUREMENT VDDM_KeyAuthCFS_flg VDDM_KeyAuthDTC_cnt /end REF_MEASUREMENT /end GROUP
/begin GROUP S69_Test_Detection_Criteria1 "SWC_DDM_type/run_SWC_DDM_5ms_sys/DDM/DDM/PMM/Key authentication failed/Test Detection Criteria1" /begin REF_MEASUREMENT VDDM_KeyAuthDet_flg /end REF_MEASUREMENT /end GROUP
/begin GROUP S70_Initial_LV_battery_voltage_too_low "SWC_DDM_type/run_SWC_DDM_5ms_sys/DDM/DDM/PMM/LV/Initial LV battery voltage too low" /begin SUB_GROUP S272_DTC_Couter1 S272_Test_Detection_Criteria1 /end SUB_GROUP
 /begin REF_CHARACTERISTIC KDDM_IniLVLoDTC_cnt KDDM_IniLVLoDetTO_s KDDM_IniLVLoPassTO_s KDDM_IniLVLoThd_mv KDDM_LVDiagnosisOffSW_flg /end REF_CHARACTERISTIC
 /begin REF_MEASUREMENT VDDM_IniLVLoCFSRls_flg VDDM_IniLVLoDFS_flg VDDM_IniLVLoPass_flg /end REF_MEASUREMENT
/end GROUP
/begin GROUP S70_LV_analog_input_error "SWC_DDM_type/run_SWC_DDM_5ms_sys/DDM/DDM/PMM/LV/LV analog input error" /begin SUB_GROUP S273_DTC_Couter1 S273_Test_Detection_Criteria1 /end SUB_GROUP
 /begin REF_CHARACTERISTIC KDDM_LVDiagnosisOffSW_flg KDDM_LVInErrDTC_cnt KDDM_LVInErrDetTO_s KDDM_LVInErrPassTO_s KDDM_LVInErr_pct /end REF_CHARACTERISTIC
 /begin REF_MEASUREMENT VDDM_LVInErrCFSRls_flg VDDM_LVInErrDFS_flg VDDM_LVInErrPass_flg /end REF_MEASUREMENT
/end GROUP
/begin GROUP S70_LV_power_supply_voltage_too_high "SWC_DDM_type/run_SWC_DDM_5ms_sys/DDM/DDM/PMM/LV/LV power supply voltage too high" /begin SUB_GROUP S274_DTC_Couter1 S274_Test_Detection_Criteria1 /end SUB_GROUP
 /begin REF_CHARACTERISTIC KDDM_LVDiagnosisOffSW_flg KDDM_LVSupHiDTC_cnt KDDM_LVSupHiDetTO_s KDDM_LVSupHiPassTO_s KDDM_LVSupHiThd_mv /end REF_CHARACTERISTIC
 /begin REF_MEASUREMENT VDDM_LVSupHiCFSRls_flg VDDM_LVSupHiDFS_flg VDDM_LVSupHiPass_flg /end REF_MEASUREMENT
/end GROUP
/begin GROUP S70_LV_power_supply_voltage_too_low "SWC_DDM_type/run_SWC_DDM_5ms_sys/DDM/DDM/PMM/LV/LV power supply voltage too low" /begin SUB_GROUP S275_DTC_Couter1 S275_Test_Detection_Criteria1 /end SUB_GROUP
 /begin REF_CHARACTERISTIC KDDM_LVDiagnosisOffSW_flg KDDM_LVSupLoDTC_cnt KDDM_LVSupLoDetTO_s KDDM_LVSupLoPassTO_s KDDM_LVSupLoThd_mv /end REF_CHARACTERISTIC
 /begin REF_MEASUREMENT VDDM_LVSupLoCFSRls_flg VDDM_LVSupLoDFS_flg VDDM_LVSupLoPass_flg /end REF_MEASUREMENT
/end GROUP
/begin GROUP S71_Driver_seat_switch_failure "SWC_DDM_type/run_SWC_DDM_5ms_sys/DDM/DDM/PMM/SW failure/Driver seat switch failure"
 /begin SUB_GROUP S308_DTC_Couter2 S308_Subsystem S308_Test_Detection_Criteria2 /end SUB_GROUP
 /begin REF_CHARACTERISTIC KDDM_DrStSWDTC_cnt KDDM_DrStSWDetTO_s KDDM_DrStSWPassTO_s KDDM_DrStSW_s KDDM_SWFailDiagnosisOffSW_flg /end REF_CHARACTERISTIC
 /begin REF_MEASUREMENT VDDM_DrStSWCFSRls_flg VDDM_DrStSWDFS_flg VDDM_DrStSWPass_flg /end REF_MEASUREMENT
/end GROUP
/begin GROUP S71_FL_Door_switch_failure "SWC_DDM_type/run_SWC_DDM_5ms_sys/DDM/DDM/PMM/SW failure/FL Door switch failure"
 /begin SUB_GROUP S309_DTC_Couter2 S309_Subsystem S309_Test_Detection_Criteria2 /end SUB_GROUP
 /begin REF_CHARACTERISTIC KDDM_FLDoorSWDTC_cnt KDDM_FLDoorSWDetTO_s KDDM_FLDoorSWPassTO_s KDDM_FLDoorSW_s KDDM_SWFailDiagnosisOffSW_flg /end REF_CHARACTERISTIC
 /begin REF_MEASUREMENT VDDM_FLDoorSWCFSRls_flg VDDM_FLDoorSWDFS_flg /end REF_MEASUREMENT
/end GROUP
/begin GROUP S71_FR_Door_switch_failure "SWC_DDM_type/run_SWC_DDM_5ms_sys/DDM/DDM/PMM/SW failure/FR Door switch failure"
 /begin SUB_GROUP S310_DTC_Couter2 S310_Subsystem S310_Test_Detection_Criteria2 /end SUB_GROUP
 /begin REF_CHARACTERISTIC KDDM_FRDoorSWDTC_cnt KDDM_FRDoorSWDetTO_s KDDM_FRDoorSWPassTO_s KDDM_FRDoorSW_s KDDM_SWFailDiagnosisOffSW_flg /end REF_CHARACTERISTIC
 /begin REF_MEASUREMENT VDDM_FRDoorSWCFSRls_flg VDDM_FRDoorSWDFS_flg VDDM_FRDoorSWPass_flg /end REF_MEASUREMENT
/end GROUP
/begin GROUP S71_Hood_switch_failure "SWC_DDM_type/run_SWC_DDM_5ms_sys/DDM/DDM/PMM/SW failure/Hood switch failure"
 /begin SUB_GROUP S311_DTC_Couter2 S311_Subsystem S311_Test_Detection_Criteria2 /end SUB_GROUP
 /begin REF_CHARACTERISTIC KDDM_HoodSWDTC_cnt KDDM_HoodSWDetTO_s KDDM_HoodSWPassTO_s KDDM_HoodSW_s KDDM_SWFailDiagnosisOffSW_flg /end REF_CHARACTERISTIC
 /begin REF_MEASUREMENT VDDM_HoodSWCFSRls_flg VDDM_HoodSWDFS_flg VDDM_HoodSWPass_flg /end REF_MEASUREMENT
/end GROUP
/begin GROUP S71_RL_Door_switch_failure "SWC_DDM_type/run_SWC_DDM_5ms_sys/DDM/DDM/PMM/SW failure/RL Door switch failure"
 /begin SUB_GROUP S312_DTC_Couter2 S312_Subsystem S312_Test_Detection_Criteria2 /end SUB_GROUP
 /begin REF_CHARACTERISTIC KDDM_RLDoorSWDTC_cnt KDDM_RLDoorSWDetTO_s KDDM_RLDoorSWPassTO_s KDDM_RLDoorSW_s KDDM_SWFailDiagnosisOffSW_flg /end REF_CHARACTERISTIC
 /begin REF_MEASUREMENT VDDM_RLDoorSWCFSRls_flg VDDM_RLDoorSWDFS_flg VDDM_RLDoorSWPass_flg /end REF_MEASUREMENT
/end GROUP
/begin GROUP S71_RR_Door_switch_failure "SWC_DDM_type/run_SWC_DDM_5ms_sys/DDM/DDM/PMM/SW failure/RR Door switch failure"
 /begin SUB_GROUP S313_DTC_Couter2 S313_Subsystem S313_Test_Detection_Criteria2 /end SUB_GROUP
 /begin REF_CHARACTERISTIC KDDM_RRDoorSWDTC_cnt KDDM_RRDoorSWDetTO_s KDDM_RRDoorSWPassTO_s KDDM_RRDoorSW_s KDDM_SWFailDiagnosisOffSW_flg /end REF_CHARACTERISTIC
 /begin REF_MEASUREMENT VDDM_RRDoorSWCFSRls_flg VDDM_RRDoorSWDFS_flg VDDM_RRDoorSWPass_flg /end REF_MEASUREMENT
/end GROUP
/begin GROUP S71_Tailgate_switch_failure "SWC_DDM_type/run_SWC_DDM_5ms_sys/DDM/DDM/PMM/SW failure/Tailgate switch failure"
 /begin SUB_GROUP S314_DTC_Couter2 S314_Subsystem S314_Test_Detection_Criteria2 /end SUB_GROUP
 /begin REF_CHARACTERISTIC KDDM_SWFailDiagnosisOffSW_flg KDDM_TailgaSWDTC_cnt KDDM_TailgaSWDetTO_s KDDM_TailgaSWPassTO_s KDDM_TailgaSW_s /end REF_CHARACTERISTIC
 /begin REF_MEASUREMENT VDDM_TailgaSWCFSRls_flg VDDM_TailgaSWDFS_flg VDDM_TailgaSWPass_flg /end REF_MEASUREMENT
/end GROUP
/begin GROUP S72_DTC_Couter1 "SWC_DDM_type/run_SWC_DDM_5ms_sys/DDM/DDM/PMM/System conditions of ON to READY not satisfied/DTC_Couter1" /begin REF_MEASUREMENT VDDM_ONtoRdyCFS_flg VDDM_ONtoRdyDTC_cnt /end REF_MEASUREMENT /end GROUP
/begin GROUP S72_Test_Detection_Criteria1 "SWC_DDM_type/run_SWC_DDM_5ms_sys/DDM/DDM/PMM/System conditions of ON to READY not satisfied/Test Detection Criteria1" /begin REF_MEASUREMENT VDDM_ONtoRdyDet_flg /end REF_MEASUREMENT /end GROUP
/begin GROUP S73_BMS_HV_relay_closed_fail "SWC_DDM_type/run_SWC_DDM_5ms_sys/DDM/DDM/PMM/power up and power down/BMS HV relay closed fail" /begin SUB_GROUP S407_DTC_Couter1 S407_Test_Detection_Criteria1 /end SUB_GROUP
 /begin REF_CHARACTERISTIC KDDM_HVRlyCloDTC_cnt KDDM_HVRlyCloDetTO_s KDDM_HVRlyCloPassTO_s KDDM_PwrUpDnDiagnosisOffSW_flg /end REF_CHARACTERISTIC
 /begin REF_MEASUREMENT VDDM_HVRlyCloCFSRls_flg VDDM_HVRlyCloDFS_flg VDDM_HVRlyCloPass_flg /end REF_MEASUREMENT
/end GROUP
/begin GROUP S73_BMS_HV_relay_opened_fail "SWC_DDM_type/run_SWC_DDM_5ms_sys/DDM/DDM/PMM/power up and power down/BMS HV relay opened fail" /begin SUB_GROUP S408_DTC_Couter1 S408_Test_Detection_Criteria1 /end SUB_GROUP
 /begin REF_CHARACTERISTIC KDDM_HVRlyOpDTC_cnt KDDM_HVRlyOpDetTO_s KDDM_HVRlyOpPassTO_s KDDM_PwrUpDnDiagnosisOffSW_flg /end REF_CHARACTERISTIC
 /begin REF_MEASUREMENT VDDM_HVRlyOpCFSRls_flg VDDM_HVRlyOpDFS_flg VDDM_HVRlyOpPass_flg /end REF_MEASUREMENT
/end GROUP
/begin GROUP S73_BMS_ready_fail "SWC_DDM_type/run_SWC_DDM_5ms_sys/DDM/DDM/PMM/power up and power down/BMS ready fail" /begin REF_CHARACTERISTIC KDDM_PwrUpDnDiagnosisOffSW_flg /end REF_CHARACTERISTIC /end GROUP
/begin GROUP S73_DCDC_disable_fail "SWC_DDM_type/run_SWC_DDM_5ms_sys/DDM/DDM/PMM/power up and power down/DCDC disable fail" /begin REF_CHARACTERISTIC KDDM_PwrUpDnDiagnosisOffSW_flg /end REF_CHARACTERISTIC /end GROUP
/begin GROUP S73_DCDC_enable_fail "SWC_DDM_type/run_SWC_DDM_5ms_sys/DDM/DDM/PMM/power up and power down/DCDC enable fail" /begin REF_CHARACTERISTIC KDDM_PwrUpDnDiagnosisOffSW_flg /end REF_CHARACTERISTIC /end GROUP
/begin GROUP S73_DCDC_ready_for_precharge_fail "SWC_DDM_type/run_SWC_DDM_5ms_sys/DDM/DDM/PMM/power up and power down/DCDC ready for precharge fail" /begin REF_CHARACTERISTIC KDDM_PwrUpDnDiagnosisOffSW_flg /end REF_CHARACTERISTIC /end GROUP
/begin GROUP S73_Fr_MCU_active_discharge_fail "SWC_DDM_type/run_SWC_DDM_5ms_sys/DDM/DDM/PMM/power up and power down/Fr_MCU active discharge fail" /begin REF_CHARACTERISTIC KDDM_PwrUpDnDiagnosisOffSW_flg /end REF_CHARACTERISTIC /end GROUP
/begin GROUP S73_Fr_MCU_disable_fail "SWC_DDM_type/run_SWC_DDM_5ms_sys/DDM/DDM/PMM/power up and power down/Fr_MCU disable fail" /begin REF_CHARACTERISTIC KDDM_PwrUpDnDiagnosisOffSW_flg /end REF_CHARACTERISTIC /end GROUP
/begin GROUP S73_Fr_MCU_ready_for_precharge_fail "SWC_DDM_type/run_SWC_DDM_5ms_sys/DDM/DDM/PMM/power up and power down/Fr_MCU ready for precharge fail" /begin REF_CHARACTERISTIC KDDM_PwrUpDnDiagnosisOffSW_flg /end REF_CHARACTERISTIC /end GROUP
/begin GROUP S73_HVB_ready_for_precharge_fail "SWC_DDM_type/run_SWC_DDM_5ms_sys/DDM/DDM/PMM/power up and power down/HVB ready for precharge fail" /begin REF_CHARACTERISTIC KDDM_PwrUpDnDiagnosisOffSW_flg /end REF_CHARACTERISTIC /end GROUP
/begin GROUP S73_High_level_system_safety_check_fail "SWC_DDM_type/run_SWC_DDM_5ms_sys/DDM/DDM/PMM/power up and power down/High level system safety check fail" /begin REF_CHARACTERISTIC KDDM_PwrUpDnDiagnosisOffSW_flg /end REF_CHARACTERISTIC /end GROUP
/begin GROUP S73_Mid_level_system_safety_check_fail "SWC_DDM_type/run_SWC_DDM_5ms_sys/DDM/DDM/PMM/power up and power down/Mid level system safety check fail" /begin REF_CHARACTERISTIC KDDM_PwrUpDnDiagnosisOffSW_flg /end REF_CHARACTERISTIC /end GROUP
/begin GROUP S73_OBC_ready_for_precharge_fail "SWC_DDM_type/run_SWC_DDM_5ms_sys/DDM/DDM/PMM/power up and power down/OBC ready for precharge fail" /begin REF_CHARACTERISTIC KDDM_PwrUpDnDiagnosisOffSW_flg /end REF_CHARACTERISTIC /end GROUP
/begin GROUP S73_Rr_MCU_active_discharge_fail "SWC_DDM_type/run_SWC_DDM_5ms_sys/DDM/DDM/PMM/power up and power down/Rr_MCU active discharge fail" /begin REF_CHARACTERISTIC KDDM_PwrUpDnDiagnosisOffSW_flg /end REF_CHARACTERISTIC /end GROUP
/begin GROUP S73_Rr_MCU_disable_fail "SWC_DDM_type/run_SWC_DDM_5ms_sys/DDM/DDM/PMM/power up and power down/Rr_MCU disable fail" /begin REF_CHARACTERISTIC KDDM_PwrUpDnDiagnosisOffSW_flg /end REF_CHARACTERISTIC /end GROUP
/begin GROUP S73_Rr_MCU_ready_for_precharge_fail "SWC_DDM_type/run_SWC_DDM_5ms_sys/DDM/DDM/PMM/power up and power down/Rr_MCU ready for precharge fail" /begin REF_CHARACTERISTIC KDDM_PwrUpDnDiagnosisOffSW_flg /end REF_CHARACTERISTIC /end GROUP
/begin GROUP S1010_BMS_Signal_Error_ "SWC_DDM_type/run_SWC_DDM_5ms_sys/DDM/DDM/VMC_DDM/BMS Signal Error /BMS Signal Error " /begin REF_CHARACTERISTIC KDDM_VMCDiagnosisOffSW_flg /end REF_CHARACTERISTIC /end GROUP
/begin GROUP S1011_CCU_Signal_Error_ "SWC_DDM_type/run_SWC_DDM_5ms_sys/DDM/DDM/VMC_DDM/CCU Signal Error/CCU Signal Error " /begin REF_CHARACTERISTIC KDDM_VMCDiagnosisOffSW_flg /end REF_CHARACTERISTIC /end GROUP
/begin GROUP S1012_ESC_Signal_Error_ "SWC_DDM_type/run_SWC_DDM_5ms_sys/DDM/DDM/VMC_DDM/ESC Signal Error/ESC Signal Error " /begin REF_CHARACTERISTIC KDDM_VMCDiagnosisOffSW_flg /end REF_CHARACTERISTIC /end GROUP
/begin GROUP S1013_EPS1_Checksum_Error "SWC_DDM_type/run_SWC_DDM_5ms_sys/DDM/DDM/VMC_DDM/Enabled Subsystem/EPS1 Checksum Error" /begin REF_CHARACTERISTIC KDDM_VMCDiagnosisOffSW_flg /end REF_CHARACTERISTIC /end GROUP
/begin GROUP S1013_EPS1_Lost_Comm "SWC_DDM_type/run_SWC_DDM_5ms_sys/DDM/DDM/VMC_DDM/Enabled Subsystem/EPS1 Lost Comm" /begin REF_CHARACTERISTIC KDDM_VMCDiagnosisOffSW_flg /end REF_CHARACTERISTIC /end GROUP
/begin GROUP S1013_EPS1_Rolling_Count_Error_ "SWC_DDM_type/run_SWC_DDM_5ms_sys/DDM/DDM/VMC_DDM/Enabled Subsystem/EPS1 Rolling Count Error " /begin REF_CHARACTERISTIC KDDM_VMCDiagnosisOffSW_flg /end REF_CHARACTERISTIC /end GROUP
/begin GROUP S1013_EPS1_Signal_Error "SWC_DDM_type/run_SWC_DDM_5ms_sys/DDM/DDM/VMC_DDM/Enabled Subsystem/EPS1 Signal Error" /begin REF_CHARACTERISTIC KDDM_VMCDiagnosisOffSW_flg /end REF_CHARACTERISTIC /end GROUP
/begin GROUP S1014_FCM1_Checksum_Error_ "SWC_DDM_type/run_SWC_DDM_5ms_sys/DDM/DDM/VMC_DDM/FCM1/FCM1 Checksum Error " /begin REF_CHARACTERISTIC KDDM_VMCDiagnosisOffSW_flg /end REF_CHARACTERISTIC /end GROUP
/begin GROUP S1014_FCM1_Lost_Com "SWC_DDM_type/run_SWC_DDM_5ms_sys/DDM/DDM/VMC_DDM/FCM1/FCM1 Lost Com" /begin REF_CHARACTERISTIC KDDM_VMCDiagnosisOffSW_flg /end REF_CHARACTERISTIC /end GROUP
/begin GROUP S1014_FCM1_Rolling_Count_Error_ "SWC_DDM_type/run_SWC_DDM_5ms_sys/DDM/DDM/VMC_DDM/FCM1/FCM1 Rolling Count Error " /begin REF_CHARACTERISTIC KDDM_VMCDiagnosisOffSW_flg /end REF_CHARACTERISTIC /end GROUP
/begin GROUP S1015_FCMACC_Signal_Error_ "SWC_DDM_type/run_SWC_DDM_5ms_sys/DDM/DDM/VMC_DDM/FCMACC Signal Error/FCMACC Signal Error " /begin REF_CHARACTERISTIC KDDM_VMCDiagnosisOffSW_flg /end REF_CHARACTERISTIC /end GROUP
/begin GROUP S1016_MCU_Fr_Signal_Error_ "SWC_DDM_type/run_SWC_DDM_5ms_sys/DDM/DDM/VMC_DDM/MCU_Fr Signal Error/MCU_Fr Signal Error " /begin REF_CHARACTERISTIC KDDM_VMCDiagnosisOffSW_flg /end REF_CHARACTERISTIC /end GROUP
/begin GROUP S1017_MCU_Rr_Signal_Error_ "SWC_DDM_type/run_SWC_DDM_5ms_sys/DDM/DDM/VMC_DDM/MCU_Rr Signal Error/MCU_Rr Signal Error " /begin REF_CHARACTERISTIC KDDM_VMCDiagnosisOffSW_flg /end REF_CHARACTERISTIC /end GROUP
/begin GROUP S1018_Shifter_Signal_Error_ "SWC_DDM_type/run_SWC_DDM_5ms_sys/DDM/DDM/VMC_DDM/Shifter Signal Error/Shifter Signal Error " /begin REF_CHARACTERISTIC KDDM_VMCDiagnosisOffSW_flg /end REF_CHARACTERISTIC /end GROUP
/begin GROUP S1021_Zone_dr_Error_ "SWC_DDM_type/run_SWC_DDM_5ms_sys/DDM/DDM/VMC_DDM/Zone_dr Error/Zone_dr Error " /begin REF_CHARACTERISTIC KDDM_VMCDiagnosisOffSW_flg /end REF_CHARACTERISTIC /end GROUP
/begin GROUP S1022_Zone_fr_Error_ "SWC_DDM_type/run_SWC_DDM_5ms_sys/DDM/DDM/VMC_DDM/Zone_fr Error/Zone_fr Error " /begin REF_CHARACTERISTIC KDDM_VMCDiagnosisOffSW_flg /end REF_CHARACTERISTIC /end GROUP
/begin GROUP S308_Subsystem "SWC_DDM_type/run_SWC_DDM_5ms_sys/DDM/DDM/PMM/SW failure/Driver seat switch failure/Subsystem" /begin REF_CHARACTERISTIC KDDM_DrStSW_s /end REF_CHARACTERISTIC /end GROUP
/begin GROUP S309_Subsystem "SWC_DDM_type/run_SWC_DDM_5ms_sys/DDM/DDM/PMM/SW failure/FL Door switch failure/Subsystem" /begin REF_CHARACTERISTIC KDDM_FLDoorSW_s /end REF_CHARACTERISTIC /end GROUP
/begin GROUP S310_Subsystem "SWC_DDM_type/run_SWC_DDM_5ms_sys/DDM/DDM/PMM/SW failure/FR Door switch failure/Subsystem" /begin REF_CHARACTERISTIC KDDM_FRDoorSW_s /end REF_CHARACTERISTIC /end GROUP
/begin GROUP S311_Subsystem "SWC_DDM_type/run_SWC_DDM_5ms_sys/DDM/DDM/PMM/SW failure/Hood switch failure/Subsystem" /begin REF_CHARACTERISTIC KDDM_HoodSW_s /end REF_CHARACTERISTIC /end GROUP
/begin GROUP S312_Subsystem "SWC_DDM_type/run_SWC_DDM_5ms_sys/DDM/DDM/PMM/SW failure/RL Door switch failure/Subsystem" /begin REF_CHARACTERISTIC KDDM_RLDoorSW_s /end REF_CHARACTERISTIC /end GROUP
/begin GROUP S313_Subsystem "SWC_DDM_type/run_SWC_DDM_5ms_sys/DDM/DDM/PMM/SW failure/RR Door switch failure/Subsystem" /begin REF_CHARACTERISTIC KDDM_RRDoorSW_s /end REF_CHARACTERISTIC /end GROUP
/begin GROUP S314_Subsystem "SWC_DDM_type/run_SWC_DDM_5ms_sys/DDM/DDM/PMM/SW failure/Tailgate switch failure/Subsystem" /begin REF_CHARACTERISTIC KDDM_TailgaSW_s /end REF_CHARACTERISTIC /end GROUP
/end MODULE
/end PROJECT
/* (add any file trailer comments here) */ /* EOF SWC_DDM_type.a2l */
