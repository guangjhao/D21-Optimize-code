[part 1 of 3: package /CAN3/ISignalGroup]
AUTOSAR XML (schema 4-3-0)
package /CAN3/ISignalGroup
  36 x i signal group:
    CAN3_SG_BMS1: i-signal=[CAN3_BMSChckSum_1, CAN3_BMSRolCnct_1, CAN3_HVBPwrAvailChrg, CAN3_HVBPwrAvailChrg30, CAN3_HVBPwrAvailChrg60, CAN3_HVBPwrAvailDchrg, CAN3_HVBPwrAvailDchrg30, CAN3_HVBPwrAvailDchrg60, CAN3_HVBattCurr, CAN3_HVBattVolt], system-signal-group=CAN3_SG_BMS1
    CAN3_SG_BMS3: i-signal=[CAN3_ACChrgCurrDis, CAN3_BMS_HVBattCellBalance_Sta, CAN3_BMS_HVBattSOCDiff_Sta, CAN3_BMS_SOC_UseLimit_Sta, CAN3_Battsystfail_Num, CAN3_CellType, CAN3_ChrgCurType, CAN3_ChrgLampSta, CAN3_FireDetErr, CAN3_HVBChrgPwr, CAN3_HVBChrgPwrTotal, CAN3_HVBDrvPwr, CAN3_HVBDrvPwrTotal, CAN3_HVBFullChrgPwr, CAN3_HVBIsoImpedenceN, CAN3_HVBIsoImpedenceP, CAN3_HVBSOH, CAN3_HVBattErr, CAN3_HVBattPackVolt, CAN3_HVBattSOC, CAN3_HVBattSOCDis, CAN3_RechrgCyc, CAN3_RemainChrgTime], system-signal-group=CAN3_SG_BMS3
    CAN3_SG_BMS4: i-signal=[CAN3_CellTempAvg, CAN3_HVBCellVoltMax, CAN3_HVBCellVoltMin, CAN3_HVBMTempMax, CAN3_HVBMTempMin, CAN3_MaxCellTemp_Num, CAN3_MaxCellVolt_Num, CAN3_MinCellTemp_Num, CAN3_MinCellVolt_Num, CAN3_Mtemp01, CAN3_Mtemp02, CAN3_Mtemp03, CAN3_Mtemp04, CAN3_Mtemp05, CAN3_Mtemp06, CAN3_Mtemp07, CAN3_Mtemp08, CAN3_Mtemp09, CAN3_Mtemp10, CAN3_Mtemp11, CAN3_Mtemp12, CAN3_Mtemp13, CAN3_Mtemp14, CAN3_Mtemp15, CAN3_Mtemp16, CAN3_Mtemp17, CAN3_Mtemp18, CAN3_Mtemp19, CAN3_Mtemp20, CAN3_Mtemp21, CAN3_Mtemp22, CAN3_Mtemp23, CAN3_Mtemp24], system-signal-group=CAN3_SG_BMS4
    CAN3_SG_BMS5: i-signal=[CAN3_DCPortNeg_Temp, CAN3_DCPortPos_Temp, CAN3_HVInVolt, CAN3_LVBattDet12V, CAN3_OBCACCSLimit, CAN3_OBCDCCurLm, CAN3_OBCDCVoltLm, CAN3_OBCEna, CAN3_ReChargerStaFromEvcc], system-signal-group=CAN3_SG_BMS5
    CAN3_SG_BMS6: i-signal=[CAN3_BMSChckSum, CAN3_BMSRolCnct, CAN3_BMS_READY, CAN3_BMS_Warn_1, CAN3_BMS_Warn_2, CAN3_BMS_Warn_3, CAN3_BMS_Warn_4, CAN3_BMS_Warn_5, CAN3_BMS_Warn_6, CAN3_BMS_Warn_7, CAN3_BMS_Warn_8, CAN3_CellUnconsistErr, CAN3_ChrgInLockReq, CAN3_ChrgPlugSta, CAN3_DCChrgSysShockErr, CAN3_DisChrgPlugErr, CAN3_ExtChrgSta, CAN3_HVBCellOvrVoltErr, CAN3_HVBCellOvrVoltWarn, CAN3_HVBCellUdrVoltWarn, CAN3_HVBCellUnbalanErr, CAN3_HVBCellUndrVoltErr, CAN3_HVBChrgErr, CAN3_HVBContactorSta, CAN3_HVBHVILErr, CAN3_HVBOvrChrgCurrErr, CAN3_HVBOvrDchrgCurErr, CAN3_HVBOvrSOCErr, CAN3_HVBOvrTempErr, CAN3_HVBOvrTempWarn, CAN3_HVBOvrVoltErr, CAN3_HVBPrechrgSta, CAN3_HVBPreheatPrecoolSta, CAN3_HVBSOCJumpError, CAN3_HVBShrtChrgCurrErr, CAN3_HVBShrtDischrgCurrErr, CAN3_HVBTempDiffErr, CAN3_HVBUndrSOCErr, CAN3_HVBUndrTempErr, CAN3_HVBUndrTempWarn, CAN3_HVBUndrVoltErr, CAN3_HVBattReady4Pre, CAN3_HVILSta, CAN3_IsoDetSta, CAN3_SystemUncomErr, CAN3_V2LSta], system-signal-group=CAN3_SG_BMS6
    CAN3_SG_BMS8: i-signal=[CAN3_ACChrgStop, CAN3_BMS_HVBChrgCap_Sta, CAN3_BMS_HVBDchrgCap_Sta, CAN3_CurrentErrorID, CAN3_DCChrgCurrent, CAN3_DCChrgStop, CAN3_DCChrgVoltage, CAN3_G0standard, CAN3_MainChrgRlyNegDriReq, CAN3_MainChrgRlyNegOutterVoltage, CAN3_MainChrgRlyNegSta, CAN3_MainChrgRlyPosDriReq, CAN3_MainChrgRlyPosOutterVoltage, CAN3_MainChrgRlyPosSta, CAN3_MainPosstandard, CAN3_MainRlyNegDriReq, CAN3_MainRlyNegOutterVoltage, CAN3_MainRlyNegSta, CAN3_MainRlyPosDriReq, CAN3_MainRlyPosInnerVoltage, CAN3_MainRlyPosOutterVoltage, CAN3_MainRlyPosSta, CAN3_TherRunawayErrMask], system-signal-group=CAN3_SG_BMS8
    CAN3_SG_CCU1: i-signal=[CAN3_CS_CCU1, CAN3_DCDCAuxCur, CAN3_DCDCAuxVolt, CAN3_DCDCHVCur, CAN3_DCDCInVoltInf, CAN3_DCDCPreCompleted, CAN3_OBCDCCurrInf, CAN3_OBCDCVoltInf, CAN3_OBCPreCompleted, CAN3_OBCV2LINVOTP, CAN3_OBCV2LInsuFault, CAN3_OBCV2LVinOVP, CAN3_OBCV2LVinUVP, CAN3_OBCV2LVoutOCP, CAN3_OBCV2LVoutOVP, CAN3_OBCV2LVoutUVP, CAN3_OBCWakeup4Plugin, CAN3_RC_CCU1], system-signal-group=CAN3_SG_CCU1
    CAN3_SG_CCU2: i-signal=[CAN3_CS_CCU2, CAN3_DCDCEnaSta, CAN3_DCDCFaultSta, CAN3_DCDCReady4Pre, CAN3_DCDCTemp, CAN3_OBCACCurrInf, CAN3_OBCACVoltInf, CAN3_OBCDCP, CAN3_OBCEnaSta, CAN3_OBCFaultSta, CAN3_OBCPluginSta, CAN3_OBCReady4Pre, CAN3_OBCRlySta, CAN3_OBCTemp, CAN3_OBCV2LSta, CAN3_OBC_AC_Cur_Lim, CAN3_RC_CCU2], system-signal-group=CAN3_SG_CCU2
    CAN3_SG_EBM1: i-signal=[CAN3_EBM1_CS, CAN3_EBM1_RC, CAN3_EBMErrSta, CAN3_EBMRLampSta, CAN3_EBMSta], system-signal-group=CAN3_SG_EBM1
    CAN3_SG_FD3_BCM1: i-signal=[CAN3_AllDoorSW, CAN3_AntiTheftSeatFold, CAN3_AntitheftSta, CAN3_BCM_Buzzer_Req, CAN3_BCM_DoorLock_Sta, CAN3_BrakeLamp, CAN3_CTDCtrl, CAN3_CTDLockSW, CAN3_CTDUnlockSW, CAN3_CrashDetd, CAN3_Dimmer, CAN3_DimmerEN, CAN3_DoorLockIND, CAN3_DrDoorSW, CAN3_Fr_ChargingDoorCtrl, CAN3_Fr_FogLamp, CAN3_Fr_Wiper_H, CAN3_Fr_Wiper_L, CAN3_H_Beam, CAN3_HazardSW, CAN3_HoodSW, CAN3_HornCtrl, CAN3_LBSD, CAN3_LDRL, CAN3_LTurnLP, CAN3_L_APM_WdwEnable, CAN3_L_Beam, CAN3_LockSetting, CAN3_MirrorCtrl, CAN3_MirrorDefog, CAN3_PosLamp, CAN3_PsDoorSW, CAN3_RBSD, CAN3_RDRL, CAN3_RLDoorSW, CAN3_RRDoorSW, CAN3_RTurnLP, CAN3_ReverseLamp, CAN3_RoomLampH, CAN3_RoomLampL, CAN3_Rr_ChargingDoorCtrl, CAN3_Rr_Defog, CAN3_Rr_FogLamp, CAN3_Rr_Wiper, CAN3_TailgateHDSW, CAN3_TailgateRemote, CAN3_Tailgate_SW, CAN3_TrunkRel, CAN3_WasherCtrl, CAN3_WiperFixMode], system-signal-group=CAN3_SG_FD3_BCM1
    CAN3_SG_FD3_OTA1: i-signal=[CAN3_OTA_DL_Available, CAN3_OTA_DL_Speed, CAN3_OTA_Debug_Code, CAN3_OTA_Emergency_Sta, CAN3_OTA_InVehicle_FW, CAN3_OTA_Lock_Req, CAN3_OTA_MDA_Status, CAN3_OTA_Mode, CAN3_OTA_Network_Type, CAN3_OTA_Permit_Agreed, CAN3_OTA_Progress_Rate, CAN3_OTA_Remained_Time, CAN3_OTA_TBOXResetReq, CAN3_OTA_Update_Available, CAN3_OTA_Updating_ECU_8bit], system-signal-group=CAN3_SG_FD3_OTA1
    CAN3_SG_FD3_THCM1: i-signal=[CAN3_BatteryMode, CAN3_CCU_ACLampSts, CAN3_CCU_ACMaxLampSts, CAN3_CCU_AutoLampSts, CAN3_CCU_AutoMidLampSts, CAN3_CCU_Dispaly_Request, CAN3_CCU_EcoSts, CAN3_CCU_FrtOnOffLampSts, CAN3_CCU_HEATMaxLampSts, CAN3_CCU_RrOnOffLampSts, CAN3_CCU_SyncLampSts, CAN3_CabinMode, CAN3_EDriveMode, CAN3_FD_AGS_Cmd, CAN3_FD_RecyAuto_Cmd, CAN3_Fr_Coolantflow, CAN3_Fr_Coolanttemp, CAN3_HPThermalRecoveryReq, CAN3_Rr_Coolantflow, CAN3_Rr_Coolanttemp, CAN3_sigAirIntenZon1St, CAN3_sigAirIntenZon3St, CAN3_sigAmbAirT, CAN3_sigCbnAirT, CAN3_sigCbnPTCPwrAct, CAN3_sigCbnSolarLeft, CAN3_sigCbnSolarRight, CAN3_sigClmtCmprPwrAct, CAN3_sigClntTHvBattOut, CAN3_sigDfrstSt, CAN3_sigHvacSt, CAN3_sigRecircSt, CAN3_sigSetTempZon1St, CAN3_sigSetTempZon2St, CAN3_sigSetTempZon3St, CAN3_sigWindDirZon1St, CAN3_sigWindDirZon3St], system-signal-group=CAN3_SG_FD3_THCM1
    CAN3_SG_FD3_THCM2: i-signal=[CAN3_ACSubMode, CAN3_APTC_ActFrRiPwr, CAN3_BatLoopActWtFlw, CAN3_CCU_CbnPreACWkSts, CAN3_CCU_CbnPreEstimdTi, CAN3_CCU_CbnPreSts, CAN3_CCU_HiVoltageReq, CAN3_CoolgFanActDuty, CAN3_DeiceModReq, CAN3_FD_Blower_Cmd, CAN3_FD_Comp_Cmd, CAN3_FD_EWP1_Cmd, CAN3_FD_EWP2_Cmd, CAN3_FD_EWP3_Cmd, CAN3_FD_EXV1_Cmd, CAN3_FD_EXV2_Cmd, CAN3_FD_FWV_Cmd, CAN3_FD_FrLeAPTCHeatPwr_Cmd, CAN3_FD_FrRiAPTCHeatPwr_Cmd, CAN3_FD_FrWPTCHeatPwr_Cmd, CAN3_FD_RrAPTCHeatPwr_Cmd, CAN3_FD_SOTXV_Cmd, CAN3_FD_SOV1_Cmd, CAN3_FD_SOV2_Cmd, CAN3_FD_SOV3_Cmd, CAN3_FD_TWV_Cmd], system-signal-group=CAN3_SG_FD3_THCM2
    CAN3_SG_FD3_V2L1: i-signal=[CAN3_FDC_V2L_OBCExtrV2L_Cmd, CAN3_FDC_V2L_OBCIntrV2L_Cmd, CAN3_Req_OBCV2LEna, CAN3_Req_V2LSwOn, CAN3_Req_V2L_IVI_Popup], system-signal-group=CAN3_SG_FD3_V2L1
    CAN3_SG_FD3_VCU0: i-signal=[CAN3_EVCCAplusPwrUpReq, CAN3_FDADC12VDet, CAN3_FDADC12VDetAvg, CAN3_FDC_SYS_PmicBootPath, CAN3_FDC_VCU_ActMaxSlideRate_Sta, CAN3_FDC_VCU_AllowMovThd_OTA_Sta, CAN3_FDC_VCU_BrakeSigMatrix_Sta, CAN3_FDC_VCU_BrkPedalPosSta_Sta, CAN3_FDC_VCU_CANBrkSW2Sta_Sta, CAN3_FDC_VCU_DTCCarousel_Sta, CAN3_FDC_VCU_EAPS1Min_Sta, CAN3_FDC_VCU_EAPS1Raw_Sta, CAN3_FDC_VCU_EAPS2Min_Sta, CAN3_FDC_VCU_EAPS2Raw_Sta, CAN3_FDC_VCU_ForceP_Cmd, CAN3_FDC_VCU_LVChrgFreqCnt_Sta, CAN3_FDC_VCU_LVStaDropQukCnt_Sta, CAN3_FDC_VCU_LowIdleAccPedal_Sta, CAN3_FDC_VCU_OTAPwrReqOFFChk_Sta, CAN3_FDC_VCU_OTAPwrReqStdChk_Sta, CAN3_FDC_VCU_PwrReq_OTA_Sta, CAN3_FDC_VCU_RWDRDCActive_Sta, CAN3_FDC_VCU_RegenTqLimitEn_Sta, CAN3_FDC_VCU_SlideRegenLimTq_Sta, CAN3_FDC_VCU_VehActSpd_Sta, CAN3_FDC_VCU_VehMalfunLevel_Sta, CAN3_FDC_VMC_ActStESCYaw_Sta, CAN3_FDC_VMC_LongAcc_Sta, CAN3_FUSION_CMM1, CAN3_FUSION_CMM10, CAN3_FUSION_CMM2, CAN3_FUSION_CMM3, CAN3_FUSION_CMM4, CAN3_FUSION_CMM5, CAN3_FUSION_CMM6, CAN3_FUSION_CMM7, CAN3_FUSION_CMM8, CAN3_FUSION_CMM9, CAN3_Fr_TqSource, CAN3_HVRlyOpFail, CAN3_HVTHCMSysAvail, CAN3_LVBattChrgtimeAct, CAN3_LVBattVoltSta, CAN3_LVChrgHoldTAct, CAN3_LVSilentChrgLv, CAN3_LVSilentChrgReq, CAN3_LVSilentChrgSta, CAN3_MCUActDisFail, CAN3_PMMAllowECUSleep, CAN3_PmicBootReason, CAN3_PowerDownFault, CAN3_PowerDownState, CAN3_PowerUpFault, CAN3_PowerUpState, CAN3_PwrDownReq, CAN3_PwrStaConstraint, CAN3_PwrStaONTOIVIPopReq, CAN3_PwrStaONTOIVIPopT, CAN3_PwrStaSelect, CAN3_PwrStaTOSta, CAN3_PwrUpReq, CAN3_Rr_TqSource, CAN3_SchedChgTOSta, CAN3_SilentChkAllowSleep, CAN3_SysAllowReadySta, CAN3_SysPwrSta, CAN3_TCountSta, CAN3_TimerAllowSleep, CAN3_VCUBrkSWSta, CAN3_VCUFLDoorSta, CAN3_VCUFRDoorSta, CAN3_VCURLDoorSta, CAN3_VCURRDoorSta, CAN3_VehHVPwrAvail4THCM, CAN3_WisrBootReason], system-signal-group=CAN3_SG_FD3_VCU0
    CAN3_SG_FD3_VCU1:
      com-based-signal-group-transformations=E2E_PROFILE_01_CAN3_SG_FD3_VCU1
      i-signal=[CAN3_ActiveDischReq, CAN3_CS_VCU1, CAN3_CoastDwModeStaChk, CAN3_DCDCEnaReq, CAN3_DCDCVoltSetpoint, CAN3_DemoModeStaChk, CAN3_Dr_SeatSta, CAN3_DynoModeStaChk, CAN3_HVBatCnctReq, CAN3_HVSysReadyToCharge, CAN3_LVChrgFuncStaChk, CAN3_MSA_Crl_Sta, CAN3_P_Button_Sta, CAN3_PrkReq, CAN3_PrkReqValid, CAN3_PwrSta, CAN3_RC_VCU1, CAN3_ShiftGearPosn]
      system-signal-group=CAN3_SG_FD3_VCU1
      end-to-end-transformation-i-signal-props{transformer=Technology_E2E_PROFILE_01_CAN3_SG_FD3_VCU1, data-ids=17910, data-length=64}
    CAN3_SG_FD3_VCU1_toNIDEC:
      com-based-signal-group-transformations=E2E_PROFILE_01_CAN3_SG_FD3_VCU1_toNIDEC
      i-signal=[CAN3_ActiveDischReq_toNidec, CAN3_CS_VCU1_toNidec, CAN3_CoastDwModeStaChk_toNidec, CAN3_DCDCEnaReq_toNidec, CAN3_DCDCVoltSetpoint_toNidec, CAN3_DemoModeStaChk_toNidec, CAN3_Dr_SeatSta_toNidec, CAN3_DynoModeStaChk_toNidec, CAN3_Fr_ActvDmpDisabReq_toNidec, CAN3_Fr_MCUEnaReq_toNidec, CAN3_HVBatCnctReq_toNidec, CAN3_HVSysReadyToCharge_toNidec, CAN3_LVChrgFuncStaChk_toNidec, CAN3_MSA_Crl_Sta_toNidec, CAN3_PrkReq_toNidec, CAN3_PwrSta_toNidec, CAN3_RC_VCU1_toNidec, CAN3_Rr_ActvDmpDisabReq_toNidec, CAN3_Rr_MCUEnaReq_toNidec, CAN3_ShiftGearPosn_toNidec]
      system-signal-group=CAN3_SG_FD3_VCU1_toNIDEC
      end-to-end-transformation-i-signal-props{transformer=Technology_E2E_PROFILE_01_CAN3_SG_FD3_VCU1_toNIDEC, data-ids=13815, data-length=64}
    CAN3_SG_FD3_VCU2: i-signal=[CAN3_CS_VCU2_CAN1, CAN3_Fr_ActvDmpDisabReq, CAN3_Fr_IdcMax, CAN3_Fr_IdcMin, CAN3_Fr_MCUEnaReq, CAN3_Fr_TMTqReq, CAN3_Fr_TorqMax, CAN3_Fr_TorqMin, CAN3_Fr_UdcMax, CAN3_Fr_UdcMin, CAN3_RC_VCU2_CAN1, CAN3_Rr_ActvDmpDisabReq, CAN3_Rr_IdcMax, CAN3_Rr_IdcMin, CAN3_Rr_MCUEnaReq, CAN3_Rr_TMTqReq, CAN3_Rr_TorqMax, CAN3_Rr_TorqMin, CAN3_Rr_UdcMax, CAN3_Rr_UdcMin], system-signal-group=CAN3_SG_FD3_VCU2
    CAN3_SG_FD3_VCU2_toNIDEC: i-signal=[CAN3_CS_VCU2_CAN1_toNidec, CAN3_Fr_IdcMax_toNidec, CAN3_Fr_IdcMin_toNidec, CAN3_Fr_TMTqReq_toNidec, CAN3_Fr_TorqMax_toNidec, CAN3_Fr_TorqMin_toNidec, CAN3_Fr_UdcMax_toNidec, CAN3_Fr_UdcMin_toNidec, CAN3_RC_VCU2_CAN1_toNidec, CAN3_Rr_IdcMax_toNidec, CAN3_Rr_IdcMin_toNidec, CAN3_Rr_TMTqReq_toNidec, CAN3_Rr_TorqMax_toNidec, CAN3_Rr_TorqMin_toNidec, CAN3_Rr_UdcMax_toNidec, CAN3_Rr_UdcMin_toNidec], system-signal-group=CAN3_SG_FD3_VCU2_toNIDEC
    CAN3_SG_FD3_VCU4: i-signal=[CAN3_Fr_SpdMax, CAN3_Fr_SpdMin, CAN3_Fr_TMCtrlMode_Req, CAN3_Fr_TMSpdReq, CAN3_Rr_SpdMax, CAN3_Rr_SpdMin, CAN3_Rr_TMCtrlMode_Req, CAN3_Rr_TMSpdReq], system-signal-group=CAN3_SG_FD3_VCU4
    CAN3_SG_FD3_VCU5: i-signal=[CAN3_ActAPSPosn, CAN3_Fr_EDUSpd, CAN3_Fr_EDUSpdValid, CAN3_Rr_EDUSpd, CAN3_Rr_EDUSpdValid], system-signal-group=CAN3_SG_FD3_VCU5
    CAN3_SG_GW3_CE100_0: i-signal=[CAN3_AC_Chg_Cur_Set, CAN3_COMP_ActualPwr, CAN3_COMP_ConCur, CAN3_COMP_ConVolt, CAN3_ChargeInletLockSta, CAN3_Charge_Percent_Set, CAN3_CrashOutputSts, CAN3_DriverSeatBeltCmd, CAN3_IVI_Req_V2L, CAN3_IVI_Start_Chg_req, CAN3_IVI_Stop_Chg_req, CAN3_IVI_Time_Day, CAN3_IVI_Time_Hour, CAN3_IVI_Time_Minute, CAN3_IVI_Time_Month, CAN3_IVI_Time_Second, CAN3_IVI_Unlock_Chg_req, CAN3_PTC1_PowerConsumption, CAN3_Perd_V2L, CAN3_ReserveChargeOFF_Day, CAN3_ReserveChargeOFF_Hour, CAN3_ReserveChargeOFF_Minute, CAN3_ReserveChargeOFF_Month, CAN3_ReserveChargeOFF_Year, CAN3_ReserveChargeOn_Day, CAN3_ReserveChargeOn_Hour, CAN3_ReserveChargeOn_Minute, CAN3_ReserveChargeOn_Month, CAN3_ReserveChargeOn_Year, CAN3_SOC_ADJ_BUTT, CAN3_SOC_Limit_Set, CAN3_SOC_V2LLimit, CAN3_Sched_Chg_Start, CAN3_Sched_Chg_Stop, CAN3_Sched_Chg_butt, CAN3_Sched_Chg_limit, CAN3_VehSpeed], system-signal-group=CAN3_SG_GW3_CE100_0
    CAN3_SG_GW_ESC1_toNIDEC: i-signal=CAN3_VehSpeed_toNidec, system-signal-group=CAN3_SG_GW_ESC1_toNIDEC
    CAN3_SG_GW_IVI6_toNIDEC: i-signal=[CAN3_IVI_Time_Day_toNidec, CAN3_IVI_Time_Hour_toNidec, CAN3_IVI_Time_Minute_toNidec, CAN3_IVI_Time_Month_toNidec, CAN3_IVI_Time_Second_toNidec], system-signal-group=CAN3_SG_GW_IVI6_toNIDEC
    CAN3_SG_MCU_B_F1: i-signal=[CAN3_Fr_ActvDmpDisabSta, CAN3_Fr_EDUDrtSta, CAN3_Fr_EDUOpratingSta, CAN3_Fr_EDURealTMTq, CAN3_Fr_EDURotateDirction, CAN3_Fr_EDUTqReqFbk, CAN3_Fr_MCU1Chksum, CAN3_Fr_MCU1RolCnt, CAN3_Fr_MCUBAT, CAN3_Fr_MCUDCBusCurr, CAN3_Fr_MCUDCBusVolt, CAN3_Fr_MCUDischrgSta, CAN3_Fr_MCUEnaSta, CAN3_Fr_MCUErr, CAN3_Fr_MCUIGN_sta, CAN3_Fr_MCUReady, CAN3_Fr_MCUReady4Pre, CAN3_Fr_MCUSysSta, CAN3_Fr_MCUTemp, CAN3_Fr_MotorAvailTq, CAN3_Fr_RegenAvailTq, CAN3_Fr_Reserved_bits, CAN3_Fr_TMSpd, CAN3_Fr_TMTemp, CAN3_Fr_TMid, CAN3_Fr_TMiq, CAN3_MCUWarn_F, CAN3_MCU_B_F_IGBTDdeTemp_Sta, CAN3_MCU_B_F_RealPwrKw_Sta], system-signal-group=CAN3_SG_MCU_B_F1
    CAN3_SG_MCU_B_F2: i-signal=[CAN3_Fr_CoolanttempReq, CAN3_Fr_Failcode1, CAN3_Fr_Failcode2, CAN3_Fr_Failcodehistory1, CAN3_Fr_Failcodehistory2, CAN3_Fr_LLCTemp, CAN3_Fr_LLCflowReq, CAN3_Fr_MCU2Chksum, CAN3_Fr_MCU2RolCnt, CAN3_Fr_MCUTempWarn, CAN3_Fr_MCU_HW_Ver, CAN3_Fr_MCU_SW_Ver, CAN3_Fr_TMTempWarn, CAN3_MCU_B_F_FailLv_Sta, CAN3_MCU_B_F_KL302TqCnt_Sta, CAN3_MCU_B_F_LLCTempWarn_Sta], system-signal-group=CAN3_SG_MCU_B_F2
    CAN3_SG_MCU_B_R1: i-signal=[CAN3_MCUWarn_R, CAN3_MCU_B_R_IGBTDdeTemp_Sta, CAN3_MCU_B_R_RealPwrKw_Sta, CAN3_Rr_ActvDmpDisabSta, CAN3_Rr_EDUDrtSta, CAN3_Rr_EDUOpratingSta, CAN3_Rr_EDURealTMTq, CAN3_Rr_EDURotateDirction, CAN3_Rr_EDUTqReqFbk, CAN3_Rr_MCU1Chksum, CAN3_Rr_MCU1RolCnt, CAN3_Rr_MCUBAT, CAN3_Rr_MCUDCBusCurr, CAN3_Rr_MCUDCBusVolt, CAN3_Rr_MCUDischrgSta, CAN3_Rr_MCUEnaSta, CAN3_Rr_MCUErr, CAN3_Rr_MCUIGN_sta, CAN3_Rr_MCUReady, CAN3_Rr_MCUReady4Pre, CAN3_Rr_MCUSysSta, CAN3_Rr_MCUTemp, CAN3_Rr_MotorAvailTq, CAN3_Rr_RegenAvailTq, CAN3_Rr_Reserved_bits, CAN3_Rr_TMSpd, CAN3_Rr_TMTemp, CAN3_Rr_TMid, CAN3_Rr_TMiq], system-signal-group=CAN3_SG_MCU_B_R1
    CAN3_SG_MCU_B_R2: i-signal=[CAN3_MCU_B_R_FailLv_Sta, CAN3_MCU_B_R_KL302TqCnt_Sta, CAN3_MCU_B_R_LLCTempWarn_Sta, CAN3_Rr_CoolanttempReq, CAN3_Rr_Failcode1, CAN3_Rr_Failcode2, CAN3_Rr_Failcodehistory1, CAN3_Rr_Failcodehistory2, CAN3_Rr_LLCTemp, CAN3_Rr_LLCflowReq, CAN3_Rr_MCU2Chksum, CAN3_Rr_MCU2RolCnt, CAN3_Rr_MCU3_HW_Ver, CAN3_Rr_MCU3_SW_Ver, CAN3_Rr_MCUTempWarn, CAN3_Rr_TMTempWarn], system-signal-group=CAN3_SG_MCU_B_R2
    CAN3_SG_MCU_N_F1: i-signal=[CAN3_Fr_ActvDmpDisabSta_Nidec, CAN3_Fr_EDUDrtSta_Nidec, CAN3_Fr_EDUOpratingSta_Nidec, CAN3_Fr_EDURealTMTq_Nidec, CAN3_Fr_EDURotateDirction_Nidec, CAN3_Fr_EDUTqReqFbk_Nidec, CAN3_Fr_MCU1Chksum_Nidec, CAN3_Fr_MCU1RolCnt_Nidec, CAN3_Fr_MCUBAT_Nidec, CAN3_Fr_MCUDCBusCurr_Nidec, CAN3_Fr_MCUDCBusVolt_Nidec, CAN3_Fr_MCUDischrgSta_Nidec, CAN3_Fr_MCUEnaSta_Nidec, CAN3_Fr_MCUErr_Nidec, CAN3_Fr_MCUIGN_sta_Nidec, CAN3_Fr_MCUReady4Pre_Nidec, CAN3_Fr_MCUReady_Nidec, CAN3_Fr_MCUSysSta_Nidec, CAN3_Fr_MCUTemp_Nidec, CAN3_Fr_MotorAvailTq_Nidec, CAN3_Fr_RegenAvailTq_Nidec, CAN3_Fr_Reserved_bits_Nidec, CAN3_Fr_TMSpd_Nidec, CAN3_Fr_TMTemp_Nidec, CAN3_Fr_TMid_Nidec, CAN3_Fr_TMiq_Nidec, CAN3_MCUWarn_F_Nidec], system-signal-group=CAN3_SG_MCU_N_F1
    CAN3_SG_MCU_N_F2: i-signal=[CAN3_Fr_CoolanttempReq_Nidec, CAN3_Fr_EOP_SpdSet_Nidec, CAN3_Fr_Failcode1_Nidec, CAN3_Fr_Failcode2_Nidec, CAN3_Fr_Failcodehistory1_Nidec, CAN3_Fr_Failcodehistory2_Nidec, CAN3_Fr_LLCTemp_Nidec, CAN3_Fr_LLCflowReq_Nidec, CAN3_Fr_MCU2Chksum_Nidec, CAN3_Fr_MCU2RolCnt_Nidec, CAN3_Fr_MCUTempWarn_Nidec, CAN3_Fr_TMTempWarn_Nidec, CAN3_MCU_F_ResetCnt_Sta], system-signal-group=CAN3_SG_MCU_N_F2
    CAN3_SG_MCU_N_F3: i-signal=[CAN3_Fr_MCU_HW_Ver_Nidec, CAN3_Fr_MCU_SW_Ver_Nidec], system-signal-group=CAN3_SG_MCU_N_F3
    CAN3_SG_MCU_N_R1: i-signal=[CAN3_MCUWarn_R_Nidec, CAN3_Rr_ActvDmpDisabSta_Nidec, CAN3_Rr_EDUDrtSta_Nidec, CAN3_Rr_EDUOpratingSta_Nidec, CAN3_Rr_EDURealTMTq_Nidec, CAN3_Rr_EDURotateDirction_Nidec, CAN3_Rr_EDUTqReqFbk_Nidec, CAN3_Rr_MCU1Chksum_Nidec, CAN3_Rr_MCU1RolCnt_Nidec, CAN3_Rr_MCUBAT_Nidec, CAN3_Rr_MCUDCBusCurr_Nidec, CAN3_Rr_MCUDCBusVolt_Nidec, CAN3_Rr_MCUDischrgSta_Nidec, CAN3_Rr_MCUEnaSta_Nidec, CAN3_Rr_MCUErr_Nidec, CAN3_Rr_MCUIGN_sta_Nidec, CAN3_Rr_MCUReady4Pre_Nidec, CAN3_Rr_MCUReady_Nidec, CAN3_Rr_MCUSysSta_Nidec, CAN3_Rr_MCUTemp_Nidec, CAN3_Rr_MotorAvailTq_Nidec, CAN3_Rr_RegenAvailTq_Nidec, CAN3_Rr_Reserved_bits_Nidec, CAN3_Rr_TMSpd_Nidec, CAN3_Rr_TMTemp_Nidec, CAN3_Rr_TMid_Nidec, CAN3_Rr_TMiq_Nidec], system-signal-group=CAN3_SG_MCU_N_R1
    CAN3_SG_MCU_N_R2: i-signal=[CAN3_MCU_R_ResetCnt_Sta, CAN3_Rr_CoolanttempReq_Nidec, CAN3_Rr_EOP_SpdSet_Nidec, CAN3_Rr_Failcode1_Nidec, CAN3_Rr_Failcode2_Nidec, CAN3_Rr_Failcodehistory1_Nidec, CAN3_Rr_Failcodehistory2_Nidec, CAN3_Rr_LLCTemp_Nidec, CAN3_Rr_LLCflowReq_Nidec, CAN3_Rr_MCU2Chksum_Nidec, CAN3_Rr_MCU2RolCnt_Nidec, CAN3_Rr_MCUTempWarn_Nidec, CAN3_Rr_TMTempWarn_Nidec], system-signal-group=CAN3_SG_MCU_N_R2
    CAN3_SG_MCU_N_R3: i-signal=[CAN3_Rr_MCU3_HW_Ver_Nidec, CAN3_Rr_MCU3_SW_Ver_Nidec], system-signal-group=CAN3_SG_MCU_N_R3
    CAN3_SG_Shifter1: i-signal=[CAN3_Shifter_CRC8, CAN3_Shifter_Fail_sta, CAN3_Shifter_Handle_Cmd, CAN3_Shifter_RC], system-signal-group=CAN3_SG_Shifter1
    CAN3_SG_Shifter2: i-signal=[CAN3_CSW2_DimSw_Sta, CAN3_CSW2_FWasSw_Sta, CAN3_CSW2_FWipSw_Sta, CAN3_CSW2_PassSW_Sta, CAN3_CSW2_RWipWasSw_Sta, CAN3_CSW2_TurnSw_Sta], system-signal-group=CAN3_SG_Shifter2
