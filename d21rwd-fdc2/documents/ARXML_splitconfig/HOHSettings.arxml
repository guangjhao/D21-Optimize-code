AUTOSAR XML (schema 4-0-3)
package /Can
  module config Can: implementation-config-variant=VARIANT-PRE-COMPILE
    CanConfigSet
      8 x CanController, all with AutomaticBusOffRecovery=0, CanBusoffProcessing=INTERRUPT, CanControllerActivation=1, CanControllerBaseAddress=0, CanControllerIcomSupported=0, CanListenOnlyMode=0, CanLoopBackMode=0, CanProtocolException=0, CanRxProcessing=INTERRUPT, CanTimeStampEnable=DISABLE, CanTxFifoMode=1, CanTxProcessing=INTERRUPT, CanWakeupFunctionalityAPI=0, CanWakeupProcessing=POLLING, CanWakeupSupport=0, ManualBusOffRecovery=0, CanCpuClockRef=McuClockReferencePoint_LLCECAN_CLK:
        CAN1: CanControllerId=0, CanHwChannel=BCAN_1, SelfReceptionEnable=1, CanControllerDefaultBaudrate=CAN1/CanControllerBaudrateConfig
          CanControllerBaudrateConfig:
            CanBusLength = 40
            CanControllerBaudRate = 500.0
            CanControllerBaudRateConfigID = 0
            CanControllerCheckCanStandard = 1
            CanControllerPrescaller = 2
            CanControllerPropSeg = 47
            CanControllerSeg1 = 16
            CanControllerSeg2 = 16
            CanControllerSyncJumpWidth = 15
            CanPropDelayTranceiver = 150.0
            CanControllerFdBaudrateConfig:
              CanBusLengthFd = 40
              CanControllerFDPrescaller = 2
              CanControllerFdBaudRate = 2000.0
              CanControllerPropSeg = 9
              CanControllerSeg1 = 6
              CanControllerSeg2 = 4
              CanControllerSyncJumpWidth = 3
              CanControllerTxBitRateSwitch = 1
        CAN2: CanControllerId=1, CanHwChannel=BCAN_2, SelfReceptionEnable=1, CanControllerDefaultBaudrate=CAN2/CanControllerBaudrateConfig
          CanControllerBaudrateConfig:
            CanBusLength = 40
            CanControllerBaudRate = 500.0
            CanControllerBaudRateConfigID = 0
            CanControllerCheckCanStandard = 1
            CanControllerPrescaller = 2
            CanControllerPropSeg = 47
            CanControllerSeg1 = 16
            CanControllerSeg2 = 16
            CanControllerSyncJumpWidth = 15
            CanPropDelayTranceiver = 150.0
            CanControllerFdBaudrateConfig:
              CanBusLengthFd = 40
              CanControllerFDPrescaller = 2
              CanControllerFdBaudRate = 2000.0
              CanControllerPropSeg = 9
              CanControllerSeg1 = 6
              CanControllerSeg2 = 4
              CanControllerSyncJumpWidth = 3
              CanControllerTxBitRateSwitch = 1
        CAN3: CanHwChannel=BCAN_3, SelfReceptionEnable=1, CanControllerDefaultBaudrate=CAN3/CanControllerBaudrateConfig
          CanControllerBaudrateConfig:
            CanBusLength = 40
            CanControllerBaudRate = 500.0
            CanControllerBaudRateConfigID = 0
            CanControllerCheckCanStandard = 1
            CanControllerPrescaller = 2
            CanControllerPropSeg = 47
            CanControllerSeg1 = 16
            CanControllerSeg2 = 16
            CanControllerSyncJumpWidth = 15
            CanPropDelayTranceiver = 150.0
            CanControllerFdBaudrateConfig:
              CanBusLengthFd = 40
              CanControllerFDPrescaller = 2
              CanControllerFdBaudRate = 2000.0
              CanControllerPropSeg = 9
              CanControllerSeg1 = 6
              CanControllerSeg2 = 4
              CanControllerSyncJumpWidth = 3
              CanControllerTxBitRateSwitch = 1
        CAN4: CanHwChannel=BCAN_4, SelfReceptionEnable=1, CanControllerDefaultBaudrate=CAN4/CanControllerBaudrateConfig
          CanControllerBaudrateConfig:
            CanBusLength = 40
            CanControllerBaudRate = 500.0
            CanControllerBaudRateConfigID = 0
            CanControllerCheckCanStandard = 1
            CanControllerPrescaller = 2
            CanControllerPropSeg = 47
            CanControllerSeg1 = 16
            CanControllerSeg2 = 16
            CanControllerSyncJumpWidth = 15
            CanPropDelayTranceiver = 150.0
            CanControllerFdBaudrateConfig:
              CanBusLengthFd = 40
              CanControllerFDPrescaller = 2
              CanControllerFdBaudRate = 2000.0
              CanControllerPropSeg = 9
              CanControllerSeg1 = 6
              CanControllerSeg2 = 4
              CanControllerSyncJumpWidth = 3
              CanControllerTxBitRateSwitch = 1
        CAN5: CanHwChannel=BCAN_6, SelfReceptionEnable=1, CanControllerDefaultBaudrate=CAN5/CanControllerBaudrateConfig
          CanControllerBaudrateConfig:
            CanBusLength = 40
            CanControllerBaudRate = 500.0
            CanControllerBaudRateConfigID = 0
            CanControllerCheckCanStandard = 1
            CanControllerPrescaller = 2
            CanControllerPropSeg = 47
            CanControllerSeg1 = 16
            CanControllerSeg2 = 16
            CanControllerSyncJumpWidth = 15
            CanPropDelayTranceiver = 150.0
            CanControllerFdBaudrateConfig:
              CanBusLengthFd = 40
              CanControllerFDPrescaller = 2
              CanControllerFdBaudRate = 2000.0
              CanControllerPropSeg = 9
              CanControllerSeg1 = 6
              CanControllerSeg2 = 4
              CanControllerSyncJumpWidth = 3
              CanControllerTxBitRateSwitch = 1
        CAN6: CanHwChannel=BCAN_7, SelfReceptionEnable=1, CanControllerDefaultBaudrate=CAN6/CanControllerBaudrateConfig
          CanControllerBaudrateConfig:
            CanBusLength = 40
            CanControllerBaudRate = 500.0
            CanControllerBaudRateConfigID = 0
            CanControllerCheckCanStandard = 1
            CanControllerPrescaller = 2
            CanControllerPropSeg = 47
            CanControllerSeg1 = 16
            CanControllerSeg2 = 16
            CanControllerSyncJumpWidth = 15
            CanPropDelayTranceiver = 150.0
            CanControllerFdBaudrateConfig:
              CanBusLengthFd = 40
              CanControllerFDPrescaller = 2
              CanControllerFdBaudRate = 2000.0
              CanControllerPropSeg = 9
              CanControllerSeg1 = 6
              CanControllerSeg2 = 4
              CanControllerSyncJumpWidth = 3
              CanControllerTxBitRateSwitch = 1
        CAN7: CanHwChannel=BCAN_5, SelfReceptionEnable=1, CanControllerDefaultBaudrate=CAN7/CanControllerBaudrateConfig
          CanControllerBaudrateConfig:
            CanBusLength = 40
            CanControllerBaudRate = 500.0
            CanControllerBaudRateConfigID = 0
            CanControllerCheckCanStandard = 1
            CanControllerPrescaller = 2
            CanControllerPropSeg = 47
            CanControllerSeg1 = 16
            CanControllerSeg2 = 16
            CanControllerSyncJumpWidth = 15
            CanPropDelayTranceiver = 150.0
            CanControllerFdBaudrateConfig:
              CanBusLengthFd = 40
              CanControllerFDPrescaller = 2
              CanControllerFdBaudRate = 2000.0
              CanControllerPropSeg = 9
              CanControllerSeg1 = 6
              CanControllerSeg2 = 4
              CanControllerSyncJumpWidth = 3
              CanControllerTxBitRateSwitch = 1
        CAN_XCP: CanHwChannel=BCAN_15, SelfReceptionEnable=0, CanControllerDefaultBaudrate=CanControllerBaudrateConfig_0
          CanControllerBaudrateConfig_0 (CanControllerBaudrateConfig):
            CanBusLength = 40
            CanControllerBaudRate = 500.0
            CanControllerBaudRateConfigID = 0
            CanControllerCheckCanStandard = 1
            CanControllerPrescaller = 2
            CanControllerPropSeg = 47
            CanControllerSeg1 = 16
            CanControllerSeg2 = 16
            CanControllerSyncJumpWidth = 15
            CanPropDelayTranceiver = 150.0
            CanControllerFdBaudrateConfig:
              CanBusLengthFd = 40
              CanControllerFDPrescaller = 2
              CanControllerFdBaudRate = 2000.0
              CanControllerPropSeg = 9
              CanControllerSeg1 = 6
              CanControllerSeg2 = 4
              CanControllerSyncJumpWidth = 3
              CanControllerTxBitRateSwitch = 1
      CanErrorReporting:
        CAN_PROTOCOL_ERR = IGNORE
        CAN_PROTOCOL_WRN = INTERRUPT
        CONFIGURATION_ERR = IGNORE
        CanMainFunctionErrorEn = 0
        DATALOST_ERR = INTERRUPT
        INTERNAL_ERR = INTERRUPT
      147 x CanHardwareObject, all with CanHardwareObjectUsesPolling=0, CanIdType=STANDARD:
        HOH_1_CAN1: CanHandleType=BASIC, CanHwObjectCount=12, CanObjectType=RECEIVE, CanObjectId=0, CanControllerRef=CAN1
          CanHwFilter: CanHwFilterCode=0, CanHwFilterMask=0
          RangeFilter: RangeEnd=1408, RangeStart=1281
        HOH_2_CAN1: CanHandleType=BASIC, CanHwObjectCount=12, CanObjectType=RECEIVE, CanObjectId=1, CanControllerRef=CAN1
          CanAdvancedFeature: CanAdvancedFeatureRef=AF_ToCan6_Host
          CanHwFilter: CanHwFilterCode=338, CanHwFilterMask=2047
        HOH_3_CAN1: CanHandleType=BASIC, CanHwObjectCount=12, CanObjectType=RECEIVE, CanObjectId=2, CanControllerRef=CAN1
          CanAdvancedFeature: CanAdvancedFeatureRef=AF_Host
          CanHwFilter: CanHwFilterCode=360, CanHwFilterMask=2047
        HOH_4_CAN1: CanHandleType=BASIC, CanHwObjectCount=12, CanObjectType=RECEIVE, CanObjectId=3, CanControllerRef=CAN1
          CanAdvancedFeature: CanAdvancedFeatureRef=AF_ToCan6_Host
          CanHwFilter: CanHwFilterCode=391, CanHwFilterMask=2047
        HOH_5_CAN1: CanHandleType=BASIC, CanHwObjectCount=12, CanObjectType=RECEIVE, CanObjectId=4, CanControllerRef=CAN1
          CanAdvancedFeature: CanAdvancedFeatureRef=AF_ToCan6_Host
          CanHwFilter: CanHwFilterCode=421, CanHwFilterMask=2047
        HOH_6_CAN1: CanHandleType=BASIC, CanHwObjectCount=12, CanObjectType=RECEIVE, CanObjectId=5, CanControllerRef=CAN1
          CanAdvancedFeature: CanAdvancedFeatureRef=AF_ToCan2_6_Host
          CanHwFilter: CanHwFilterCode=427, CanHwFilterMask=2047
        HOH_7_CAN1: CanHandleType=BASIC, CanHwObjectCount=12, CanObjectType=RECEIVE, CanObjectId=6, CanControllerRef=CAN1
          CanAdvancedFeature: CanAdvancedFeatureRef=AF_ToCan6_Host
          CanHwFilter: CanHwFilterCode=515, CanHwFilterMask=2047
        HOH_8_CAN1: CanHandleType=BASIC, CanHwObjectCount=12, CanObjectType=RECEIVE, CanObjectId=7, CanControllerRef=CAN1
          CanAdvancedFeature: CanAdvancedFeatureRef=AF_Host
          CanHwFilter: CanHwFilterCode=1537, CanHwFilterMask=2047
        HOH_9_CAN1: CanHandleType=BASIC, CanHwObjectCount=12, CanObjectType=RECEIVE, CanObjectId=8, CanControllerRef=CAN1
          CanAdvancedFeature: CanAdvancedFeatureRef=AF_Host
          CanHwFilter: CanHwFilterCode=1553, CanHwFilterMask=2047
        HOH_10_CAN1: CanHandleType=BASIC, CanHwObjectCount=12, CanObjectType=RECEIVE, CanObjectId=9, CanControllerRef=CAN1
          CanAdvancedFeature: CanAdvancedFeatureRef=AF_Host
          CanHwFilter: CanHwFilterCode=1569, CanHwFilterMask=2047
        HOH_11_CAN1: CanHandleType=BASIC, CanHwObjectCount=12, CanObjectType=RECEIVE, CanObjectId=10, CanControllerRef=CAN1
          CanAdvancedFeature: CanAdvancedFeatureRef=AF_Host
          CanHwFilter: CanHwFilterCode=1570, CanHwFilterMask=2047
        HOH_12_CAN1: CanHandleType=BASIC, CanHwObjectCount=12, CanObjectType=RECEIVE, CanObjectId=11, CanControllerRef=CAN1
          CanAdvancedFeature: CanAdvancedFeatureRef=AF_Host
          CanHwFilter: CanHwFilterCode=1585, CanHwFilterMask=2047
        HOH_13_CAN1: CanHandleType=BASIC, CanHwObjectCount=12, CanObjectType=RECEIVE, CanObjectId=12, CanControllerRef=CAN1
          CanAdvancedFeature: CanAdvancedFeatureRef=AF_Host
          CanHwFilter: CanHwFilterCode=2041, CanHwFilterMask=2047
        HOH_1_CAN2: CanHandleType=BASIC, CanHwObjectCount=12, CanObjectType=RECEIVE, CanObjectId=13, CanControllerRef=CAN2
          CanHwFilter: CanHwFilterCode=0, CanHwFilterMask=0
          RangeFilter: RangeEnd=1408, RangeStart=1281
        HOH_2_CAN2: CanHandleType=BASIC, CanHwObjectCount=12, CanObjectType=RECEIVE, CanObjectId=14, CanControllerRef=CAN2
          CanAdvancedFeature: CanAdvancedFeatureRef=AF_ToCan1_Host
          CanHwFilter: CanHwFilterCode=602, CanHwFilterMask=2047
        HOH_3_CAN2: CanHandleType=BASIC, CanHwObjectCount=12, CanObjectType=RECEIVE, CanObjectId=15, CanControllerRef=CAN2
          CanAdvancedFeature: CanAdvancedFeatureRef=AF_ToCan1_5_Host
          CanHwFilter: CanHwFilterCode=1168, CanHwFilterMask=2047
        HOH_4_CAN2: CanHandleType=BASIC, CanHwObjectCount=12, CanObjectType=RECEIVE, CanObjectId=16, CanControllerRef=CAN2
          CanAdvancedFeature: CanAdvancedFeatureRef=AF_Host
          CanHwFilter: CanHwFilterCode=1169, CanHwFilterMask=2047
        HOH_5_CAN2: CanHandleType=BASIC, CanHwObjectCount=12, CanObjectType=RECEIVE, CanObjectId=17, CanControllerRef=CAN2
          CanAdvancedFeature: CanAdvancedFeatureRef=AF_ToCan5_6_Host
          CanHwFilter: CanHwFilterCode=1173, CanHwFilterMask=2047
        HOH_6_CAN2: CanHandleType=BASIC, CanHwObjectCount=12, CanObjectType=RECEIVE, CanObjectId=18, CanControllerRef=CAN2
          CanAdvancedFeature: CanAdvancedFeatureRef=AF_Host
          CanHwFilter: CanHwFilterCode=1175, CanHwFilterMask=2047
        HOH_7_CAN2: CanHandleType=BASIC, CanHwObjectCount=12, CanObjectType=RECEIVE, CanObjectId=19, CanControllerRef=CAN2
          CanAdvancedFeature: CanAdvancedFeatureRef=AF_Host
          CanHwFilter: CanHwFilterCode=1184, CanHwFilterMask=2047
        HOH_8_CAN2: CanHandleType=BASIC, CanHwObjectCount=12, CanObjectType=RECEIVE, CanObjectId=20, CanControllerRef=CAN2
          CanAdvancedFeature: CanAdvancedFeatureRef=AF_Host
          CanHwFilter: CanHwFilterCode=1538, CanHwFilterMask=2047
        HOH_9_CAN2: CanHandleType=BASIC, CanHwObjectCount=12, CanObjectType=RECEIVE, CanObjectId=21, CanControllerRef=CAN2
          CanAdvancedFeature: CanAdvancedFeatureRef=AF_Host
          CanHwFilter: CanHwFilterCode=1559, CanHwFilterMask=2047
        HOH_10_CAN2: CanHandleType=BASIC, CanHwObjectCount=12, CanObjectType=RECEIVE, CanObjectId=22, CanControllerRef=CAN2
          CanAdvancedFeature: CanAdvancedFeatureRef=AF_Host
          CanHwFilter: CanHwFilterCode=1568, CanHwFilterMask=2047
        HOH_11_CAN2: CanHandleType=BASIC, CanHwObjectCount=12, CanObjectType=RECEIVE, CanObjectId=23, CanControllerRef=CAN2
          CanAdvancedFeature: CanAdvancedFeatureRef=AF_Host
          CanHwFilter: CanHwFilterCode=1586, CanHwFilterMask=2047
        HOH_1_CAN3: CanHandleType=BASIC, CanHwObjectCount=12, CanObjectType=RECEIVE, CanObjectId=24, CanControllerRef=CAN3
          CanHwFilter: CanHwFilterCode=0, CanHwFilterMask=0
          RangeFilter: RangeEnd=1408, RangeStart=1281
        HOH_2_CAN3: CanHandleType=BASIC, CanHwObjectCount=12, CanObjectType=RECEIVE, CanObjectId=25, CanControllerRef=CAN3
          CanAdvancedFeature: CanAdvancedFeatureRef=AF_Host
          CanHwFilter: CanHwFilterCode=368, CanHwFilterMask=2047
        HOH_3_CAN3: CanHandleType=BASIC, CanHwObjectCount=12, CanObjectType=RECEIVE, CanObjectId=26, CanControllerRef=CAN3
          CanAdvancedFeature: CanAdvancedFeatureRef=AF_Host
          CanHwFilter: CanHwFilterCode=369, CanHwFilterMask=2047
        HOH_4_CAN3: CanHandleType=BASIC, CanHwObjectCount=12, CanObjectType=RECEIVE, CanObjectId=27, CanControllerRef=CAN3
          CanAdvancedFeature: CanAdvancedFeatureRef=AF_ToCan5_Host
          CanHwFilter: CanHwFilterCode=378, CanHwFilterMask=2047
        HOH_5_CAN3: CanHandleType=BASIC, CanHwObjectCount=12, CanObjectType=RECEIVE, CanObjectId=28, CanControllerRef=CAN3
          CanAdvancedFeature: CanAdvancedFeatureRef=AF_Host
          CanHwFilter: CanHwFilterCode=385, CanHwFilterMask=2047
        HOH_6_CAN3: CanHandleType=BASIC, CanHwObjectCount=12, CanObjectType=RECEIVE, CanObjectId=29, CanControllerRef=CAN3
          CanAdvancedFeature: CanAdvancedFeatureRef=AF_Host
          CanHwFilter: CanHwFilterCode=389, CanHwFilterMask=2047
        HOH_7_CAN3: CanHandleType=BASIC, CanHwObjectCount=12, CanObjectType=RECEIVE, CanObjectId=30, CanControllerRef=CAN3
          CanAdvancedFeature: CanAdvancedFeatureRef=AF_Host
          CanHwFilter: CanHwFilterCode=400, CanHwFilterMask=2047
        HOH_8_CAN3: CanHandleType=BASIC, CanHwObjectCount=12, CanObjectType=RECEIVE, CanObjectId=31, CanControllerRef=CAN3
          CanAdvancedFeature: CanAdvancedFeatureRef=AF_Host
          CanHwFilter: CanHwFilterCode=401, CanHwFilterMask=2047
        HOH_9_CAN3: CanHandleType=BASIC, CanHwObjectCount=12, CanObjectType=RECEIVE, CanObjectId=32, CanControllerRef=CAN3
          CanAdvancedFeature: CanAdvancedFeatureRef=AF_Host
          CanHwFilter: CanHwFilterCode=402, CanHwFilterMask=2047
        HOH_10_CAN3: CanHandleType=BASIC, CanHwObjectCount=12, CanObjectType=RECEIVE, CanObjectId=33, CanControllerRef=CAN3
          CanAdvancedFeature: CanAdvancedFeatureRef=AF_Host
          CanHwFilter: CanHwFilterCode=403, CanHwFilterMask=2047
        HOH_11_CAN3: CanHandleType=BASIC, CanHwObjectCount=12, CanObjectType=RECEIVE, CanObjectId=34, CanControllerRef=CAN3
          CanAdvancedFeature: CanAdvancedFeatureRef=AF_Host
          CanHwFilter: CanHwFilterCode=404, CanHwFilterMask=2047
        HOH_12_CAN3: CanHandleType=BASIC, CanHwObjectCount=12, CanObjectType=RECEIVE, CanObjectId=35, CanControllerRef=CAN3
          CanAdvancedFeature: CanAdvancedFeatureRef=AF_Host
          CanHwFilter: CanHwFilterCode=406, CanHwFilterMask=2047
        HOH_13_CAN3: CanHandleType=BASIC, CanHwObjectCount=12, CanObjectType=RECEIVE, CanObjectId=36, CanControllerRef=CAN3
          CanAdvancedFeature: CanAdvancedFeatureRef=AF_Host
          CanHwFilter: CanHwFilterCode=408, CanHwFilterMask=2047
        HOH_14_CAN3: CanHandleType=BASIC, CanHwObjectCount=12, CanObjectType=RECEIVE, CanObjectId=37, CanControllerRef=CAN3
          CanAdvancedFeature: CanAdvancedFeatureRef=AF_Host
          CanHwFilter: CanHwFilterCode=409, CanHwFilterMask=2047
        HOH_15_CAN3: CanHandleType=BASIC, CanHwObjectCount=12, CanObjectType=RECEIVE, CanObjectId=38, CanControllerRef=CAN3
          CanAdvancedFeature: CanAdvancedFeatureRef=AF_Host
          CanHwFilter: CanHwFilterCode=410, CanHwFilterMask=2047
        HOH_16_CAN3: CanHandleType=BASIC, CanHwObjectCount=12, CanObjectType=RECEIVE, CanObjectId=39, CanControllerRef=CAN3
          CanAdvancedFeature: CanAdvancedFeatureRef=AF_Host
          CanHwFilter: CanHwFilterCode=412, CanHwFilterMask=2047
        HOH_17_CAN3: CanHandleType=BASIC, CanHwObjectCount=12, CanObjectType=RECEIVE, CanObjectId=40, CanControllerRef=CAN3
          CanAdvancedFeature: CanAdvancedFeatureRef=AF_Host
          CanHwFilter: CanHwFilterCode=470, CanHwFilterMask=2047
        HOH_18_CAN3: CanHandleType=BASIC, CanHwObjectCount=12, CanObjectType=RECEIVE, CanObjectId=41, CanControllerRef=CAN3
          CanAdvancedFeature: CanAdvancedFeatureRef=AF_Host
          CanHwFilter: CanHwFilterCode=489, CanHwFilterMask=2047
        HOH_19_CAN3: CanHandleType=BASIC, CanHwObjectCount=12, CanObjectType=RECEIVE, CanObjectId=42, CanControllerRef=CAN3
          CanAdvancedFeature: CanAdvancedFeatureRef=AF_Host
          CanHwFilter: CanHwFilterCode=560, CanHwFilterMask=2047
        HOH_20_CAN3: CanHandleType=BASIC, CanHwObjectCount=12, CanObjectType=RECEIVE, CanObjectId=43, CanControllerRef=CAN3
          CanAdvancedFeature: CanAdvancedFeatureRef=AF_Host
          CanHwFilter: CanHwFilterCode=561, CanHwFilterMask=2047
        HOH_21_CAN3: CanHandleType=BASIC, CanHwObjectCount=12, CanObjectType=RECEIVE, CanObjectId=44, CanControllerRef=CAN3
          CanAdvancedFeature: CanAdvancedFeatureRef=AF_Host
          CanHwFilter: CanHwFilterCode=562, CanHwFilterMask=2047
        HOH_22_CAN3: CanHandleType=BASIC, CanHwObjectCount=12, CanObjectType=RECEIVE, CanObjectId=45, CanControllerRef=CAN3
          CanAdvancedFeature: CanAdvancedFeatureRef=AF_Host
          CanHwFilter: CanHwFilterCode=563, CanHwFilterMask=2047
        HOH_23_CAN3: CanHandleType=BASIC, CanHwObjectCount=12, CanObjectType=RECEIVE, CanObjectId=46, CanControllerRef=CAN3
          CanAdvancedFeature: CanAdvancedFeatureRef=AF_Host
          CanHwFilter: CanHwFilterCode=564, CanHwFilterMask=2047
        HOH_24_CAN3: CanHandleType=BASIC, CanHwObjectCount=12, CanObjectType=RECEIVE, CanObjectId=47, CanControllerRef=CAN3
          CanAdvancedFeature: CanAdvancedFeatureRef=AF_Host
          CanHwFilter: CanHwFilterCode=565, CanHwFilterMask=2047
        HOH_25_CAN3: CanHandleType=BASIC, CanHwObjectCount=12, CanObjectType=RECEIVE, CanObjectId=48, CanControllerRef=CAN3
          CanAdvancedFeature: CanAdvancedFeatureRef=AF_Host
          CanHwFilter: CanHwFilterCode=566, CanHwFilterMask=2047
        HOH_26_CAN3: CanHandleType=BASIC, CanHwObjectCount=12, CanObjectType=RECEIVE, CanObjectId=49, CanControllerRef=CAN3
          CanAdvancedFeature: CanAdvancedFeatureRef=AF_ToCan4_Host
          CanHwFilter: CanHwFilterCode=630, CanHwFilterMask=2047
        HOH_27_CAN3: CanHandleType=BASIC, CanHwObjectCount=12, CanObjectType=RECEIVE, CanObjectId=50, CanControllerRef=CAN3
          CanAdvancedFeature: CanAdvancedFeatureRef=AF_Host
          CanHwFilter: CanHwFilterCode=634, CanHwFilterMask=2047
        HOH_28_CAN3: CanHandleType=BASIC, CanHwObjectCount=12, CanObjectType=RECEIVE, CanObjectId=51, CanControllerRef=CAN3
          CanAdvancedFeature: CanAdvancedFeatureRef=AF_ToCan5_Host
          CanHwFilter: CanHwFilterCode=809, CanHwFilterMask=2047
        HOH_29_CAN3: CanHandleType=BASIC, CanHwObjectCount=12, CanObjectType=RECEIVE, CanObjectId=52, CanControllerRef=CAN3
          CanAdvancedFeature: CanAdvancedFeatureRef=AF_Host
          CanHwFilter: CanHwFilterCode=820, CanHwFilterMask=2047
        HOH_30_CAN3: CanHandleType=BASIC, CanHwObjectCount=12, CanObjectType=RECEIVE, CanObjectId=53, CanControllerRef=CAN3
          CanAdvancedFeature: CanAdvancedFeatureRef=AF_Host
          CanHwFilter: CanHwFilterCode=898, CanHwFilterMask=2047
        HOH_31_CAN3: CanHandleType=BASIC, CanHwObjectCount=12, CanObjectType=RECEIVE, CanObjectId=54, CanControllerRef=CAN3
          CanAdvancedFeature: CanAdvancedFeatureRef=AF_Host
          CanHwFilter: CanHwFilterCode=921, CanHwFilterMask=2047
        HOH_32_CAN3: CanHandleType=BASIC, CanHwObjectCount=12, CanObjectType=RECEIVE, CanObjectId=55, CanControllerRef=CAN3
          CanAdvancedFeature: CanAdvancedFeatureRef=AF_Host
          CanHwFilter: CanHwFilterCode=925, CanHwFilterMask=2047
        HOH_33_CAN3: CanHandleType=BASIC, CanHwObjectCount=12, CanObjectType=RECEIVE, CanObjectId=56, CanControllerRef=CAN3
          CanAdvancedFeature: CanAdvancedFeatureRef=AF_ToCan5_Host
          CanHwFilter: CanHwFilterCode=992, CanHwFilterMask=2047
        HOH_34_CAN3: CanHandleType=BASIC, CanHwObjectCount=12, CanObjectType=RECEIVE, CanObjectId=57, CanControllerRef=CAN3
          CanAdvancedFeature: CanAdvancedFeatureRef=AF_Host
          CanHwFilter: CanHwFilterCode=994, CanHwFilterMask=2047
        HOH_35_CAN3: CanHandleType=BASIC, CanHwObjectCount=12, CanObjectType=RECEIVE, CanObjectId=58, CanControllerRef=CAN3
          CanAdvancedFeature: CanAdvancedFeatureRef=AF_Host
          CanHwFilter: CanHwFilterCode=1539, CanHwFilterMask=2047
        HOH_36_CAN3: CanHandleType=BASIC, CanHwObjectCount=12, CanObjectType=RECEIVE, CanObjectId=59, CanControllerRef=CAN3
          CanAdvancedFeature: CanAdvancedFeatureRef=AF_Host
          CanHwFilter: CanHwFilterCode=1544, CanHwFilterMask=2047
        HOH_37_CAN3: CanHandleType=BASIC, CanHwObjectCount=12, CanObjectType=RECEIVE, CanObjectId=60, CanControllerRef=CAN3
          CanAdvancedFeature: CanAdvancedFeatureRef=AF_Host
          CanHwFilter: CanHwFilterCode=1545, CanHwFilterMask=2047
        HOH_38_CAN3: CanHandleType=BASIC, CanHwObjectCount=12, CanObjectType=RECEIVE, CanObjectId=61, CanControllerRef=CAN3
          CanAdvancedFeature: CanAdvancedFeatureRef=AF_Host
          CanHwFilter: CanHwFilterCode=1546, CanHwFilterMask=2047
        HOH_39_CAN3: CanHandleType=BASIC, CanHwObjectCount=12, CanObjectType=RECEIVE, CanObjectId=62, CanControllerRef=CAN3
          CanAdvancedFeature: CanAdvancedFeatureRef=AF_Host
          CanHwFilter: CanHwFilterCode=1555, CanHwFilterMask=2047
        HOH_40_CAN3: CanHandleType=BASIC, CanHwObjectCount=12, CanObjectType=RECEIVE, CanObjectId=63, CanControllerRef=CAN3
          CanAdvancedFeature: CanAdvancedFeatureRef=AF_Host
          CanHwFilter: CanHwFilterCode=1560, CanHwFilterMask=2047
        HOH_41_CAN3: CanHandleType=BASIC, CanHwObjectCount=12, CanObjectType=RECEIVE, CanObjectId=64, CanControllerRef=CAN3
          CanAdvancedFeature: CanAdvancedFeatureRef=AF_Host
          CanHwFilter: CanHwFilterCode=1571, CanHwFilterMask=2047
        HOH_42_CAN3: CanHandleType=BASIC, CanHwObjectCount=12, CanObjectType=RECEIVE, CanObjectId=65, CanControllerRef=CAN3
          CanAdvancedFeature: CanAdvancedFeatureRef=AF_Host
          CanHwFilter: CanHwFilterCode=1584, CanHwFilterMask=2047
        HOH_43_CAN3: CanHandleType=BASIC, CanHwObjectCount=12, CanObjectType=RECEIVE, CanObjectId=66, CanControllerRef=CAN3
          CanAdvancedFeature: CanAdvancedFeatureRef=AF_Host
          CanHwFilter: CanHwFilterCode=1587, CanHwFilterMask=2047
        HOH_44_CAN3: CanHandleType=BASIC, CanHwObjectCount=12, CanObjectType=RECEIVE, CanObjectId=67, CanControllerRef=CAN3
          CanAdvancedFeature: CanAdvancedFeatureRef=AF_Host
          CanHwFilter: CanHwFilterCode=1592, CanHwFilterMask=2047
        HOH_45_CAN3: CanHandleType=BASIC, CanHwObjectCount=12, CanObjectType=RECEIVE, CanObjectId=68, CanControllerRef=CAN3
          CanAdvancedFeature: CanAdvancedFeatureRef=AF_Host
          CanHwFilter: CanHwFilterCode=1603, CanHwFilterMask=2047
        HOH_46_CAN3: CanHandleType=BASIC, CanHwObjectCount=12, CanObjectType=RECEIVE, CanObjectId=69, CanControllerRef=CAN3
          CanAdvancedFeature: CanAdvancedFeatureRef=AF_Host
          CanHwFilter: CanHwFilterCode=1604, CanHwFilterMask=2047
        HOH_1_CAN4: CanHandleType=BASIC, CanHwObjectCount=12, CanObjectType=RECEIVE, CanObjectId=70, CanControllerRef=CAN4
          CanHwFilter: CanHwFilterCode=0, CanHwFilterMask=0
          RangeFilter: RangeEnd=1408, RangeStart=1281
        HOH_2_CAN4: CanHandleType=BASIC, CanHwObjectCount=12, CanObjectType=RECEIVE, CanObjectId=71, CanControllerRef=CAN4
          CanAdvancedFeature: CanAdvancedFeatureRef=AF_Host
          CanHwFilter: CanHwFilterCode=497, CanHwFilterMask=2047
        HOH_3_CAN4: CanHandleType=BASIC, CanHwObjectCount=12, CanObjectType=RECEIVE, CanObjectId=72, CanControllerRef=CAN4
          CanAdvancedFeature: CanAdvancedFeatureRef=AF_Host
          CanHwFilter: CanHwFilterCode=498, CanHwFilterMask=2047
        HOH_4_CAN4: CanHandleType=BASIC, CanHwObjectCount=12, CanObjectType=RECEIVE, CanObjectId=73, CanControllerRef=CAN4
          CanAdvancedFeature: CanAdvancedFeatureRef=AF_Host
          CanHwFilter: CanHwFilterCode=547, CanHwFilterMask=2047
        HOH_5_CAN4: CanHandleType=BASIC, CanHwObjectCount=12, CanObjectType=RECEIVE, CanObjectId=74, CanControllerRef=CAN4
          CanAdvancedFeature: CanAdvancedFeatureRef=AF_Host
          CanHwFilter: CanHwFilterCode=550, CanHwFilterMask=2047
        HOH_6_CAN4: CanHandleType=BASIC, CanHwObjectCount=12, CanObjectType=RECEIVE, CanObjectId=75, CanControllerRef=CAN4
          CanAdvancedFeature: CanAdvancedFeatureRef=AF_ToCan2_Host
          CanHwFilter: CanHwFilterCode=552, CanHwFilterMask=2047
        HOH_7_CAN4: CanHandleType=BASIC, CanHwObjectCount=12, CanObjectType=RECEIVE, CanObjectId=76, CanControllerRef=CAN4
          CanAdvancedFeature: CanAdvancedFeatureRef=AF_Host
          CanHwFilter: CanHwFilterCode=593, CanHwFilterMask=2047
        HOH_8_CAN4: CanHandleType=BASIC, CanHwObjectCount=12, CanObjectType=RECEIVE, CanObjectId=77, CanControllerRef=CAN4
          CanAdvancedFeature: CanAdvancedFeatureRef=AF_Host
          CanHwFilter: CanHwFilterCode=594, CanHwFilterMask=2047
        HOH_9_CAN4: CanHandleType=BASIC, CanHwObjectCount=12, CanObjectType=RECEIVE, CanObjectId=78, CanControllerRef=CAN4
          CanAdvancedFeature: CanAdvancedFeatureRef=AF_Host
          CanHwFilter: CanHwFilterCode=596, CanHwFilterMask=2047
        HOH_10_CAN4: CanHandleType=BASIC, CanHwObjectCount=12, CanObjectType=RECEIVE, CanObjectId=79, CanControllerRef=CAN4
          CanAdvancedFeature: CanAdvancedFeatureRef=AF_Host
          CanHwFilter: CanHwFilterCode=778, CanHwFilterMask=2047
        HOH_11_CAN4: CanHandleType=BASIC, CanHwObjectCount=12, CanObjectType=RECEIVE, CanObjectId=80, CanControllerRef=CAN4
          CanAdvancedFeature: CanAdvancedFeatureRef=AF_Host
          CanHwFilter: CanHwFilterCode=794, CanHwFilterMask=2047
        HOH_12_CAN4: CanHandleType=BASIC, CanHwObjectCount=12, CanObjectType=RECEIVE, CanObjectId=81, CanControllerRef=CAN4
          CanAdvancedFeature: CanAdvancedFeatureRef=AF_Host
          CanHwFilter: CanHwFilterCode=795, CanHwFilterMask=2047
        HOH_13_CAN4: CanHandleType=BASIC, CanHwObjectCount=12, CanObjectType=RECEIVE, CanObjectId=82, CanControllerRef=CAN4
          CanAdvancedFeature: CanAdvancedFeatureRef=AF_Host
          CanHwFilter: CanHwFilterCode=796, CanHwFilterMask=2047
        HOH_14_CAN4: CanHandleType=BASIC, CanHwObjectCount=12, CanObjectType=RECEIVE, CanObjectId=83, CanControllerRef=CAN4
          CanAdvancedFeature: CanAdvancedFeatureRef=AF_Host
          CanHwFilter: CanHwFilterCode=804, CanHwFilterMask=2047
        HOH_15_CAN4: CanHandleType=BASIC, CanHwObjectCount=12, CanObjectType=RECEIVE, CanObjectId=84, CanControllerRef=CAN4
          CanAdvancedFeature: CanAdvancedFeatureRef=AF_Host
          CanHwFilter: CanHwFilterCode=805, CanHwFilterMask=2047
        HOH_16_CAN4: CanHandleType=BASIC, CanHwObjectCount=12, CanObjectType=RECEIVE, CanObjectId=85, CanControllerRef=CAN4
          CanAdvancedFeature: CanAdvancedFeatureRef=AF_Host
          CanHwFilter: CanHwFilterCode=854, CanHwFilterMask=2047
        HOH_17_CAN4: CanHandleType=BASIC, CanHwObjectCount=12, CanObjectType=RECEIVE, CanObjectId=86, CanControllerRef=CAN4
          CanAdvancedFeature: CanAdvancedFeatureRef=AF_Host
          CanHwFilter: CanHwFilterCode=858, CanHwFilterMask=2047
        HOH_18_CAN4: CanHandleType=BASIC, CanHwObjectCount=12, CanObjectType=RECEIVE, CanObjectId=87, CanControllerRef=CAN4
          CanAdvancedFeature: CanAdvancedFeatureRef=AF_Host
          CanHwFilter: CanHwFilterCode=859, CanHwFilterMask=2047
        HOH_19_CAN4: CanHandleType=BASIC, CanHwObjectCount=12, CanObjectType=RECEIVE, CanObjectId=88, CanControllerRef=CAN4
          CanAdvancedFeature: CanAdvancedFeatureRef=AF_Host
          CanHwFilter: CanHwFilterCode=881, CanHwFilterMask=2047
        HOH_20_CAN4: CanHandleType=BASIC, CanHwObjectCount=12, CanObjectType=RECEIVE, CanObjectId=89, CanControllerRef=CAN4
          CanAdvancedFeature: CanAdvancedFeatureRef=AF_Host
          CanHwFilter: CanHwFilterCode=949, CanHwFilterMask=2047
        HOH_21_CAN4: CanHandleType=BASIC, CanHwObjectCount=12, CanObjectType=RECEIVE, CanObjectId=90, CanControllerRef=CAN4
          CanAdvancedFeature: CanAdvancedFeatureRef=AF_Host
          CanHwFilter: CanHwFilterCode=953, CanHwFilterMask=2047
        HOH_22_CAN4: CanHandleType=BASIC, CanHwObjectCount=12, CanObjectType=RECEIVE, CanObjectId=91, CanControllerRef=CAN4
          CanAdvancedFeature: CanAdvancedFeatureRef=AF_ToCan2_Host
          CanHwFilter: CanHwFilterCode=965, CanHwFilterMask=2047
        HOH_23_CAN4: CanHandleType=BASIC, CanHwObjectCount=12, CanObjectType=RECEIVE, CanObjectId=92, CanControllerRef=CAN4
          CanAdvancedFeature: CanAdvancedFeatureRef=AF_ToCan2_Host
          CanHwFilter: CanHwFilterCode=969, CanHwFilterMask=2047
        HOH_24_CAN4: CanHandleType=BASIC, CanHwObjectCount=12, CanObjectType=RECEIVE, CanObjectId=93, CanControllerRef=CAN4
          CanAdvancedFeature: CanAdvancedFeatureRef=AF_Host
          CanHwFilter: CanHwFilterCode=970, CanHwFilterMask=2047
        HOH_25_CAN4: CanHandleType=BASIC, CanHwObjectCount=12, CanObjectType=RECEIVE, CanObjectId=94, CanControllerRef=CAN4
          CanAdvancedFeature: CanAdvancedFeatureRef=AF_Host
          CanHwFilter: CanHwFilterCode=971, CanHwFilterMask=2047
        HOH_26_CAN4: CanHandleType=BASIC, CanHwObjectCount=12, CanObjectType=RECEIVE, CanObjectId=95, CanControllerRef=CAN4
          CanAdvancedFeature: CanAdvancedFeatureRef=AF_Host
          CanHwFilter: CanHwFilterCode=1006, CanHwFilterMask=2047
        HOH_27_CAN4: CanHandleType=BASIC, CanHwObjectCount=12, CanObjectType=RECEIVE, CanObjectId=96, CanControllerRef=CAN4
          CanAdvancedFeature: CanAdvancedFeatureRef=AF_Host
          CanHwFilter: CanHwFilterCode=1007, CanHwFilterMask=2047
        HOH_28_CAN4: CanHandleType=BASIC, CanHwObjectCount=12, CanObjectType=RECEIVE, CanObjectId=97, CanControllerRef=CAN4
          CanAdvancedFeature: CanAdvancedFeatureRef=AF_Host
          CanHwFilter: CanHwFilterCode=1540, CanHwFilterMask=2047
        HOH_29_CAN4: CanHandleType=BASIC, CanHwObjectCount=12, CanObjectType=RECEIVE, CanObjectId=98, CanControllerRef=CAN4
          CanAdvancedFeature: CanAdvancedFeatureRef=AF_Host
          CanHwFilter: CanHwFilterCode=1541, CanHwFilterMask=2047
        HOH_30_CAN4: CanHandleType=BASIC, CanHwObjectCount=12, CanObjectType=RECEIVE, CanObjectId=99, CanControllerRef=CAN4
          CanAdvancedFeature: CanAdvancedFeatureRef=AF_Host
          CanHwFilter: CanHwFilterCode=1542, CanHwFilterMask=2047
        HOH_31_CAN4: CanHandleType=BASIC, CanHwObjectCount=12, CanObjectType=RECEIVE, CanObjectId=100, CanControllerRef=CAN4
          CanAdvancedFeature: CanAdvancedFeatureRef=AF_Host
          CanHwFilter: CanHwFilterCode=1543, CanHwFilterMask=2047
        HOH_32_CAN4: CanHandleType=BASIC, CanHwObjectCount=12, CanObjectType=RECEIVE, CanObjectId=101, CanControllerRef=CAN4
          CanAdvancedFeature: CanAdvancedFeatureRef=AF_Host
          CanHwFilter: CanHwFilterCode=1556, CanHwFilterMask=2047
        HOH_33_CAN4: CanHandleType=BASIC, CanHwObjectCount=12, CanObjectType=RECEIVE, CanObjectId=102, CanControllerRef=CAN4
          CanAdvancedFeature: CanAdvancedFeatureRef=AF_Host
          CanHwFilter: CanHwFilterCode=1558, CanHwFilterMask=2047
        HOH_34_CAN4: CanHandleType=BASIC, CanHwObjectCount=12, CanObjectType=RECEIVE, CanObjectId=103, CanControllerRef=CAN4
          CanAdvancedFeature: CanAdvancedFeatureRef=AF_Host
          CanHwFilter: CanHwFilterCode=1572, CanHwFilterMask=2047
        HOH_35_CAN4: CanHandleType=BASIC, CanHwObjectCount=12, CanObjectType=RECEIVE, CanObjectId=104, CanControllerRef=CAN4
          CanAdvancedFeature: CanAdvancedFeatureRef=AF_Host
          CanHwFilter: CanHwFilterCode=1573, CanHwFilterMask=2047
        HOH_36_CAN4: CanHandleType=BASIC, CanHwObjectCount=12, CanObjectType=RECEIVE, CanObjectId=105, CanControllerRef=CAN4
          CanAdvancedFeature: CanAdvancedFeatureRef=AF_Host
          CanHwFilter: CanHwFilterCode=1574, CanHwFilterMask=2047
        HOH_37_CAN4: CanHandleType=BASIC, CanHwObjectCount=12, CanObjectType=RECEIVE, CanObjectId=106, CanControllerRef=CAN4
          CanAdvancedFeature: CanAdvancedFeatureRef=AF_Host
          CanHwFilter: CanHwFilterCode=1575, CanHwFilterMask=2047
        HOH_38_CAN4: CanHandleType=BASIC, CanHwObjectCount=12, CanObjectType=RECEIVE, CanObjectId=107, CanControllerRef=CAN4
          CanAdvancedFeature: CanAdvancedFeatureRef=AF_Host
          CanHwFilter: CanHwFilterCode=1576, CanHwFilterMask=2047
        HOH_39_CAN4: CanHandleType=BASIC, CanHwObjectCount=12, CanObjectType=RECEIVE, CanObjectId=108, CanControllerRef=CAN4
          CanAdvancedFeature: CanAdvancedFeatureRef=AF_Host
          CanHwFilter: CanHwFilterCode=1588, CanHwFilterMask=2047
        HOH_40_CAN4: CanHandleType=BASIC, CanHwObjectCount=12, CanObjectType=RECEIVE, CanObjectId=109, CanControllerRef=CAN4
          CanAdvancedFeature: CanAdvancedFeatureRef=AF_Host
          CanHwFilter: CanHwFilterCode=1589, CanHwFilterMask=2047
        HOH_41_CAN4: CanHandleType=BASIC, CanHwObjectCount=12, CanObjectType=RECEIVE, CanObjectId=110, CanControllerRef=CAN4
          CanAdvancedFeature: CanAdvancedFeatureRef=AF_Host
          CanHwFilter: CanHwFilterCode=1590, CanHwFilterMask=2047
        HOH_42_CAN4: CanHandleType=BASIC, CanHwObjectCount=12, CanObjectType=RECEIVE, CanObjectId=111, CanControllerRef=CAN4
          CanAdvancedFeature: CanAdvancedFeatureRef=AF_Host
          CanHwFilter: CanHwFilterCode=1600, CanHwFilterMask=2047
        HOH_43_CAN4: CanHandleType=BASIC, CanHwObjectCount=12, CanObjectType=RECEIVE, CanObjectId=112, CanControllerRef=CAN4
          CanAdvancedFeature: CanAdvancedFeatureRef=AF_Host
          CanHwFilter: CanHwFilterCode=1601, CanHwFilterMask=2047
        HOH_44_CAN4: CanHandleType=BASIC, CanHwObjectCount=12, CanObjectType=RECEIVE, CanObjectId=113, CanControllerRef=CAN4
          CanAdvancedFeature: CanAdvancedFeatureRef=AF_Host
          CanHwFilter: CanHwFilterCode=1602, CanHwFilterMask=2047
        HOH_45_CAN4: CanHandleType=BASIC, CanHwObjectCount=12, CanObjectType=RECEIVE, CanObjectId=114, CanControllerRef=CAN4
          CanAdvancedFeature: CanAdvancedFeatureRef=AF_Host
          CanHwFilter: CanHwFilterCode=1605, CanHwFilterMask=2047
        HOH_46_CAN4: CanHandleType=BASIC, CanHwObjectCount=12, CanObjectType=RECEIVE, CanObjectId=115, CanControllerRef=CAN4
          CanAdvancedFeature: CanAdvancedFeatureRef=AF_Host
          CanHwFilter: CanHwFilterCode=1606, CanHwFilterMask=2047
        HOH_1_CAN5: CanHandleType=BASIC, CanHwObjectCount=12, CanObjectType=RECEIVE, CanObjectId=116, CanControllerRef=CAN5
          CanHwFilter: CanHwFilterCode=0, CanHwFilterMask=0
          RangeFilter: RangeEnd=1408, RangeStart=1281
        HOH_2_CAN5: CanHandleType=BASIC, CanHwObjectCount=12, CanObjectType=RECEIVE, CanObjectId=117, CanControllerRef=CAN5
          CanAdvancedFeature: CanAdvancedFeatureRef=AF_Host
          CanHwFilter: CanHwFilterCode=1090, CanHwFilterMask=2047
        HOH_3_CAN5: CanHandleType=BASIC, CanHwObjectCount=12, CanObjectType=RECEIVE, CanObjectId=118, CanControllerRef=CAN5
          CanAdvancedFeature: CanAdvancedFeatureRef=AF_Host
          CanHwFilter: CanHwFilterCode=1174, CanHwFilterMask=2047
        HOH_4_CAN5: CanHandleType=BASIC, CanHwObjectCount=12, CanObjectType=RECEIVE, CanObjectId=119, CanControllerRef=CAN5
          CanAdvancedFeature: CanAdvancedFeatureRef=AF_Host
          CanHwFilter: CanHwFilterCode=1248, CanHwFilterMask=2047
        HOH_5_CAN5: CanHandleType=BASIC, CanHwObjectCount=12, CanObjectType=RECEIVE, CanObjectId=120, CanControllerRef=CAN5
          CanAdvancedFeature: CanAdvancedFeatureRef=AF_Host
          CanHwFilter: CanHwFilterCode=1249, CanHwFilterMask=2047
        HOH_6_CAN5: CanHandleType=BASIC, CanHwObjectCount=12, CanObjectType=RECEIVE, CanObjectId=121, CanControllerRef=CAN5
          CanAdvancedFeature: CanAdvancedFeatureRef=AF_Host
          CanHwFilter: CanHwFilterCode=1616, CanHwFilterMask=2047
        HOH_1_CAN6: CanHandleType=BASIC, CanHwObjectCount=12, CanObjectType=RECEIVE, CanObjectId=122, CanControllerRef=CAN6
          CanHwFilter: CanHwFilterCode=0, CanHwFilterMask=0
          RangeFilter: RangeEnd=1408, RangeStart=1281
        HOH_2_CAN6: CanHandleType=BASIC, CanHwObjectCount=12, CanObjectType=RECEIVE, CanObjectId=123, CanControllerRef=CAN6
          CanAdvancedFeature: CanAdvancedFeatureRef=AF_ToCan4_Host
          CanHwFilter: CanHwFilterCode=371, CanHwFilterMask=2047
        HOH_3_CAN6: CanHandleType=BASIC, CanHwObjectCount=12, CanObjectType=RECEIVE, CanObjectId=124, CanControllerRef=CAN6
          CanAdvancedFeature: CanAdvancedFeatureRef=AF_Host
          CanHwFilter: CanHwFilterCode=375, CanHwFilterMask=2047
        HOH_4_CAN6: CanHandleType=BASIC, CanHwObjectCount=12, CanObjectType=RECEIVE, CanObjectId=125, CanControllerRef=CAN6
          CanAdvancedFeature: CanAdvancedFeatureRef=AF_ToCan4_Host
          CanHwFilter: CanHwFilterCode=376, CanHwFilterMask=2047
        HOH_5_CAN6: CanHandleType=BASIC, CanHwObjectCount=12, CanObjectType=RECEIVE, CanObjectId=126, CanControllerRef=CAN6
          CanAdvancedFeature: CanAdvancedFeatureRef=AF_Host
          CanHwFilter: CanHwFilterCode=377, CanHwFilterMask=2047
        HOH_6_CAN6: CanHandleType=BASIC, CanHwObjectCount=12, CanObjectType=RECEIVE, CanObjectId=127, CanControllerRef=CAN6
          CanAdvancedFeature: CanAdvancedFeatureRef=AF_ToCan2_Host
          CanHwFilter: CanHwFilterCode=517, CanHwFilterMask=2047
        HOH_7_CAN6: CanHandleType=BASIC, CanHwObjectCount=12, CanObjectType=RECEIVE, CanObjectId=128, CanControllerRef=CAN6
          CanAdvancedFeature: CanAdvancedFeatureRef=AF_Host
          CanHwFilter: CanHwFilterCode=1552, CanHwFilterMask=2047
        HOH_8_CAN6: CanHandleType=BASIC, CanHwObjectCount=12, CanObjectType=RECEIVE, CanObjectId=129, CanControllerRef=CAN6
          CanAdvancedFeature: CanAdvancedFeatureRef=AF_Host
          CanHwFilter: CanHwFilterCode=1554, CanHwFilterMask=2047
        HOH_9_CAN6: CanHandleType=BASIC, CanHwObjectCount=12, CanObjectType=RECEIVE, CanObjectId=130, CanControllerRef=CAN6
          CanAdvancedFeature: CanAdvancedFeatureRef=AF_Host
          CanHwFilter: CanHwFilterCode=1557, CanHwFilterMask=2047
        HOH_0_Can8_Xcp: CanHandleType=FULL, CanHwObjectCount=16, CanObjectType=TRANSMIT, CanTxAddFrameMac=0, CanObjectId=139, CanControllerRef=CAN_XCP
          CanHwFilter: CanHwFilterCode=1569, CanHwFilterMask=0
        HOH_1_Can8_Xcp: CanHandleType=BASIC, CanHwObjectCount=1, CanObjectType=RECEIVE, CanObjectId=131, CanControllerRef=CAN_XCP
          CanAdvancedFeature: CanAdvancedFeatureRef=AF_Host
          CanHwFilter: CanHwFilterCode=1639, CanHwFilterMask=2047
        HOH_TX_0_CAN1: CanHandleType=BASIC, CanHwObjectCount=10, CanObjectType=TRANSMIT, CanTxAddFrameMac=0, CanObjectId=140, CanControllerRef=CAN1
          CanHwFilter: CanHwFilterCode=0, CanHwFilterMask=0
        HOH_TX_0_CAN2: CanHandleType=BASIC, CanHwObjectCount=13, CanObjectType=TRANSMIT, CanTxAddFrameMac=0, CanObjectId=141, CanControllerRef=CAN2
          CanHwFilter: CanHwFilterCode=0, CanHwFilterMask=0
        HOH_TX_0_CAN3: CanHandleType=BASIC, CanHwObjectCount=15, CanObjectType=TRANSMIT, CanTxAddFrameMac=0, CanObjectId=142, CanControllerRef=CAN3
          CanHwFilter: CanHwFilterCode=0, CanHwFilterMask=0
        HOH_TX_0_CAN4: CanHandleType=BASIC, CanHwObjectCount=10, CanObjectType=TRANSMIT, CanTxAddFrameMac=0, CanObjectId=143, CanControllerRef=CAN4
          CanHwFilter: CanHwFilterCode=0, CanHwFilterMask=0
        HOH_TX_0_CAN5: CanHandleType=BASIC, CanHwObjectCount=5, CanObjectType=TRANSMIT, CanTxAddFrameMac=0, CanObjectId=144, CanControllerRef=CAN5
          CanHwFilter: CanHwFilterCode=0, CanHwFilterMask=0
        HOH_TX_0_CAN6: CanHandleType=BASIC, CanHwObjectCount=10, CanObjectType=TRANSMIT, CanTxAddFrameMac=0, CanObjectId=145, CanControllerRef=CAN6
          CanHwFilter: CanHwFilterCode=0, CanHwFilterMask=0
        HOH_TX_0_CAN7: CanHandleType=BASIC, CanHwObjectCount=11, CanObjectType=TRANSMIT, CanTxAddFrameMac=0, CanObjectId=146, CanControllerRef=CAN7
          CanHwFilter: CanHwFilterCode=0, CanHwFilterMask=0
        HOH_TX_LOGGING_CAN1: CanHandleType=BASIC, CanHwObjectCount=16, CanObjectType=RECEIVE, CanObjectId=132, CanControllerRef=CAN1
          CanAdvancedFeature: CanAdvancedFeatureRef=AF_Host
          CanHwFilter: CanHwFilterCode=0, CanHwFilterMask=0
          RangeFilter: RangeEnd=2047, RangeStart=0
        HOH_TX_LOGGING_CAN2: CanHandleType=BASIC, CanHwObjectCount=16, CanObjectType=RECEIVE, CanObjectId=133, CanControllerRef=CAN2
          CanAdvancedFeature: CanAdvancedFeatureRef=AF_Host
          CanHwFilter: CanHwFilterCode=0, CanHwFilterMask=0
          RangeFilter: RangeEnd=2047, RangeStart=0
        HOH_TX_LOGGING_CAN3: CanHandleType=BASIC, CanHwObjectCount=16, CanObjectType=RECEIVE, CanObjectId=134, CanControllerRef=CAN3
          CanAdvancedFeature: CanAdvancedFeatureRef=AF_Host
          CanHwFilter: CanHwFilterCode=0, CanHwFilterMask=0
          RangeFilter: RangeEnd=2047, RangeStart=0
        HOH_TX_LOGGING_CAN4: CanHandleType=BASIC, CanHwObjectCount=16, CanObjectType=RECEIVE, CanObjectId=135, CanControllerRef=CAN4
          CanAdvancedFeature: CanAdvancedFeatureRef=AF_Host
          CanHwFilter: CanHwFilterCode=0, CanHwFilterMask=0
          RangeFilter: RangeEnd=2047, RangeStart=0
        HOH_TX_LOGGING_CAN5: CanHandleType=BASIC, CanHwObjectCount=16, CanObjectType=RECEIVE, CanObjectId=136, CanControllerRef=CAN5
          CanAdvancedFeature: CanAdvancedFeatureRef=AF_Host
          CanHwFilter: CanHwFilterCode=0, CanHwFilterMask=0
          RangeFilter: RangeEnd=2047, RangeStart=0
        HOH_TX_LOGGING_CAN6: CanHandleType=BASIC, CanHwObjectCount=16, CanObjectType=RECEIVE, CanObjectId=137, CanControllerRef=CAN6
          CanAdvancedFeature: CanAdvancedFeatureRef=AF_Host
          CanHwFilter: CanHwFilterCode=0, CanHwFilterMask=0
          RangeFilter: RangeEnd=2047, RangeStart=0
        HOH_TX_LOGGING_CAN7: CanHandleType=BASIC, CanHwObjectCount=16, CanObjectType=RECEIVE, CanObjectId=138, CanControllerRef=CAN7
          CanAdvancedFeature: CanAdvancedFeatureRef=AF_Host
          CanHwFilter: CanHwFilterCode=0, CanHwFilterMask=0
          RangeFilter: RangeEnd=2047, RangeStart=0
    CanGeneral:
      BusOffNotification = NULL_PTR
      CanAbortOnlyOneMB = 1
      CanApiEnableMbAbort = 0
      CanDevErrorDetect = 0
      CanEnableUserModeSupport = 0
      CanIndex = 0
      CanLPduReceiveCalloutFunction = CanRxProcessCallback
      CanMainFunctionModePeriod = 0.005
      CanMulticoreSupport = 0
      CanMultiplexedTransmission = 1
      CanPublicIcomSupport = 0
      CanTimeoutDuration = 1.0
      CanTimeoutMethod = OSIF_COUNTER_DUMMY
      CanVersionInfoApi = 1
      LPDUCalloutExtension = 1
      CanSupportTTCANRef = (unset)
