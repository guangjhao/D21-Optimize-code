AUTOSAR XML (schema 4-3-0)
package /FVT_UDS_Impl_Type_ARPkg
  impl type u32Array10_UdsDtcHeader_type: category=ARRAY
    element u32HeaderData: category=VALUE, array-size=10, array-size-semantics=FIXED-SIZE, base-type=uint32
  impl type u32Array320_UdsDTC_type: category=ARRAY
    element u32_DTCData: category=VALUE, array-size=320, array-size-semantics=FIXED-SIZE, base-type=uint32
  impl type u16Array320_UdsDTC_type: category=ARRAY
    element u16_DTCData: category=VALUE, array-size=320, array-size-semantics=FIXED-SIZE, base-type=uint16
package /FVT_UDS_Interface_ARPkg
  client server interface IF_UDSCDD
    4 x operation:
      CSOP_DdmClearDTCNotification
        arg u8_ClearDTCcmd: type=uint8, direction=OUT, server-argument-impl-policy=USE-ARGUMENT-TYPE
      CSOP_DdmClearZevDTCNotification
        arg u8_ClearZevDTCcmd: type=uint8, direction=OUT, server-argument-impl-policy=USE-ARGUMENT-TYPE
      CSOP_DdmRestartOperationCycle
      CSOP_SetDTCStatus
        4 x arg, all with server-argument-impl-policy=USE-ARGUMENT-TYPE:
          u8_ReturnStatus: type=uint8, direction=OUT
          u32Array10_Header: type=u32Array10_UdsDtcHeader_type, direction=IN
          u32Array320_DTC: type=u32Array320_UdsDTC_type, direction=IN
          u16Array320_DTCConst: type=u16Array320_UdsDTC_type, direction=IN
