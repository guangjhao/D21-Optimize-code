ASAP2_VERSION 1 31
/begin PROJECT ProjectName "Project Comment Goes Here"
/begin HEADER "Header Comments go here" /end HEADER
/begin MODULE ModuleName "Module Comment Goes Here"
/begin MOD_COMMON "Mod Common Comment Here" BYTE_ORDER MSB_LAST /end MOD_COMMON
/begin RECORD_LAYOUT Scalar_BOOLEAN FNC_VALUES 1 UBYTE COLUMN_DIR DIRECT /end RECORD_LAYOUT
/begin RECORD_LAYOUT Scalar_UBYTE FNC_VALUES 1 UBYTE COLUMN_DIR DIRECT /end RECORD_LAYOUT
/begin RECORD_LAYOUT Scalar_FLOAT32_IEEE FNC_VALUES 1 FLOAT32_IEEE COLUMN_DIR DIRECT /end RECORD_LAYOUT
/begin RECORD_LAYOUT Lookup1D_FLOAT32_IEEE FNC_VALUES 1 FLOAT32_IEEE COLUMN_DIR DIRECT /end RECORD_LAYOUT
/begin RECORD_LAYOUT Lookup1D_X_FLOAT32_IEEE AXIS_PTS_X 1 FLOAT32_IEEE INDEX_INCR DIRECT /end RECORD_LAYOUT
/begin RECORD_LAYOUT Lookup2D_WORD FNC_VALUES 1 SWORD COLUMN_DIR DIRECT /end RECORD_LAYOUT
/begin RECORD_LAYOUT Lookup2D_X_WORD AXIS_PTS_X 1 SWORD INDEX_INCR DIRECT /end RECORD_LAYOUT
/begin RECORD_LAYOUT Lookup2D_ULONG FNC_VALUES 1 ULONG COLUMN_DIR DIRECT /end RECORD_LAYOUT
/begin RECORD_LAYOUT Lookup2D_X_ULONG AXIS_PTS_X 1 ULONG INDEX_INCR DIRECT /end RECORD_LAYOUT
/begin RECORD_LAYOUT Lookup2D_LONG FNC_VALUES 1 SLONG COLUMN_DIR DIRECT /end RECORD_LAYOUT
/begin RECORD_LAYOUT Lookup2D_X_LONG AXIS_PTS_X 1 SLONG INDEX_INCR DIRECT /end RECORD_LAYOUT
/begin RECORD_LAYOUT Lookup2D_FLOAT32_IEEE FNC_VALUES 1 FLOAT32_IEEE COLUMN_DIR DIRECT /end RECORD_LAYOUT
/begin RECORD_LAYOUT Lookup2D_X_FLOAT32_IEEE AXIS_PTS_X 1 FLOAT32_IEEE INDEX_INCR DIRECT /end RECORD_LAYOUT
/begin RECORD_LAYOUT Lookup2D_FLOAT64_IEEE FNC_VALUES 1 FLOAT64_IEEE COLUMN_DIR DIRECT /end RECORD_LAYOUT
/begin RECORD_LAYOUT Lookup2D_X_FLOAT64_IEEE AXIS_PTS_X 1 FLOAT64_IEEE INDEX_INCR DIRECT /end RECORD_LAYOUT
/begin AXIS_PTS ATQD_NL1TqMapD_Y_pct "" 0x0000 /* @ECU_Address@ATQD_NL1TqMapD_Y_pct@ */ VTQD_ActAPSPosn_pct Lookup2D_X_FLOAT32_IEEE 0 SWC_FDC_type_CM_single_pct 35 0.0 110.0 /end AXIS_PTS
/begin AXIS_PTS ATQD_NL1TqMapD_X_rpm "" 0x0000 /* @ECU_Address@ATQD_NL1TqMapD_X_rpm@ */ VTQD_TqTargetShaftSpd_rpm Lookup2D_X_FLOAT32_IEEE 0 SWC_FDC_type_CM_single_rpm 42 -100000.0 100000.0 /end AXIS_PTS
/begin AXIS_PTS ATQR_NL1FEDUTs_Y_Nm "" 0x0000 /* @ECU_Address@ATQR_NL1FEDUTs_Y_Nm@ */ VTQR_FEDUWhlTqReqSmoothDelay_Nm Lookup2D_X_FLOAT32_IEEE 0 SWC_FDC_type_CM_single_Nm 18 -10000.0 10000.0 /end AXIS_PTS
/begin AXIS_PTS ATQR_NL1FEDUTs_X_rpm "" 0x0000 /* @ECU_Address@ATQR_NL1FEDUTs_X_rpm@ */ NO_INPUT_QUANTITY Lookup2D_X_FLOAT32_IEEE 0 SWC_FDC_type_CM_single_rpm 24 -100000.0 100000.0 /end AXIS_PTS
/begin AXIS_PTS ATQR_NL1REDUTqDecSR_Y_Nm "" 0x0000 /* @ECU_Address@ATQR_NL1REDUTqDecSR_Y_Nm@ */ VTQR_FEDUWhlTqReqSmoothDelay_Nm Lookup2D_X_FLOAT32_IEEE 0 SWC_FDC_type_CM_single_Nm 18 -10000.0 10000.0 /end AXIS_PTS
/begin AXIS_PTS ATQR_NL1FEDUTqIncSR_X_rpm "" 0x0000 /* @ECU_Address@ATQR_NL1FEDUTqIncSR_X_rpm@ */ NO_INPUT_QUANTITY Lookup2D_X_FLOAT32_IEEE 0 SWC_FDC_type_CM_single_rpm 24 -100000.0 100000.0 /end AXIS_PTS
/begin AXIS_PTS ATQR_NL1FEDUTqIncSR_Y_pct "" 0x0000 /* @ECU_Address@ATQR_NL1FEDUTqIncSR_Y_pct@ */ NO_INPUT_QUANTITY Lookup2D_X_FLOAT32_IEEE 0 SWC_FDC_type_CM_single_Nm 17 0.0 120.0 /end AXIS_PTS
/begin AXIS_PTS ATQR_NL1FEDUTqDecSR_Y_Nm "" 0x0000 /* @ECU_Address@ATQR_NL1FEDUTqDecSR_Y_Nm@ */ VTQR_FEDUWhlTqReqSmoothDelay_Nm Lookup2D_X_FLOAT32_IEEE 0 SWC_FDC_type_CM_single_Nm 18 -10000.0 10000.0 /end AXIS_PTS
/begin AXIS_PTS ATQR_NL1REDUTs_Y_Nm "" 0x0000 /* @ECU_Address@ATQR_NL1REDUTs_Y_Nm@ */ VTQR_REDUWhlTqReqSmoothDelay_Nm Lookup2D_X_FLOAT32_IEEE 0 SWC_FDC_type_CM_single_Nm 18 -10000.0 10000.0 /end AXIS_PTS
/begin CHARACTERISTIC MTQD_PedAccBrkTq_Y_Nm "" CURVE 0x0000 /* @ECU_Address@MTQD_PedAccBrkTq_Y_Nm@ */ Lookup1D_FLOAT32_IEEE 0 SWC_FDC_type_CM_single_Nm -100000.0 100000.0
 /begin AXIS_DESCR COM_AXIS VTQD_IVIPedalGRegenLim_pct SWC_FDC_type_CM_single_pct 10 -10.0 125.0 AXIS_PTS_REF ATQD_PedAccBrkTq_X_pct /end AXIS_DESCR
/end CHARACTERISTIC
/begin AXIS_PTS ATQD_PedAccBrkTq_X_pct "" 0x0000 /* @ECU_Address@ATQD_PedAccBrkTq_X_pct@ */ VTQD_IVIPedalGRegenLim_pct Lookup1D_X_FLOAT32_IEEE 0 SWC_FDC_type_CM_single_pct 10 -10.0 125.0 /end AXIS_PTS
/begin CHARACTERISTIC MTQD_PedalAccelCMDWC_Z_mps2 "" MAP 0x0000 /* @ECU_Address@MTQD_PedalAccelCMDWC_Z_mps2@ */ Lookup2D_FLOAT32_IEEE 0 SWC_FDC_type_CM_single_mps2 -20.0 20.0
 /begin AXIS_DESCR COM_AXIS VTQD_TqTargetShaftSpd_rpm SWC_FDC_type_CM_single_rpm 42 -100000.0 100000.0 AXIS_PTS_REF ATQD_PedalAccelCMD_X_rpm /end AXIS_DESCR
 /begin AXIS_DESCR COM_AXIS VTQD_ActAPSPosn_pct SWC_FDC_type_CM_single_pct 35 0.0 125.0 AXIS_PTS_REF ATQD_PedalAccelCMD_Y_pct /end AXIS_DESCR
/end CHARACTERISTIC
/begin AXIS_PTS ATQD_PedalAccelCMD_Y_pct "" 0x0000 /* @ECU_Address@ATQD_PedalAccelCMD_Y_pct@ */ VTQD_ActAPSPosn_pct Lookup2D_X_FLOAT32_IEEE 0 SWC_FDC_type_CM_single_pct 35 0.0 125.0 /end AXIS_PTS
/begin AXIS_PTS ATQD_PedalAccelCMD_X_rpm "" 0x0000 /* @ECU_Address@ATQD_PedalAccelCMD_X_rpm@ */ VTQD_TqTargetShaftSpd_rpm Lookup2D_X_FLOAT32_IEEE 0 SWC_FDC_type_CM_single_rpm 42 -100000.0 100000.0 /end AXIS_PTS
/begin CHARACTERISTIC MTQD_PedalAccelCMD_Z_mps2 "" MAP 0x0000 /* @ECU_Address@MTQD_PedalAccelCMD_Z_mps2@ */ Lookup2D_FLOAT32_IEEE 0 SWC_FDC_type_CM_single_mps2 -20.0 20.0
 /begin AXIS_DESCR COM_AXIS VTQD_TqTargetShaftSpd_rpm SWC_FDC_type_CM_single_rpm 42 -100000.0 100000.0 AXIS_PTS_REF ATQD_PedalAccelCMD_X_rpm /end AXIS_DESCR
 /begin AXIS_DESCR COM_AXIS VTQD_ActAPSPosn_pct SWC_FDC_type_CM_single_pct 35 0.0 125.0 AXIS_PTS_REF ATQD_PedalAccelCMD_Y_pct /end AXIS_DESCR
/end CHARACTERISTIC
/begin CHARACTERISTIC MTQD_PedalGDeltaTqIGain_Z_Nm "" MAP 0x0000 /* @ECU_Address@MTQD_PedalGDeltaTqIGain_Z_Nm@ */ Lookup2D_FLOAT32_IEEE 0 SWC_FDC_type_CM_single_Nm -50.0 50.0
 /begin AXIS_DESCR COM_AXIS NO_INPUT_QUANTITY SWC_FDC_type_CM_single_kph 17 0.0 300.0 AXIS_PTS_REF ATQD_PedalGDeltaTqIGain_X_kph /end AXIS_DESCR
 /begin AXIS_DESCR COM_AXIS VTQD_PedalAccDev_mps2 SWC_FDC_type_CM_single_mps2 21 -10.0 10.0 AXIS_PTS_REF ATQD_PedalGDeltaTqIGain_Y_mps2 /end AXIS_DESCR
/end CHARACTERISTIC
/begin AXIS_PTS ATQD_PedalGDeltaTqIGain_Y_mps2 "" 0x0000 /* @ECU_Address@ATQD_PedalGDeltaTqIGain_Y_mps2@ */ VTQD_PedalAccDev_mps2 Lookup2D_X_FLOAT32_IEEE 0 SWC_FDC_type_CM_single_mps2 21 -10.0 10.0 /end AXIS_PTS
/begin AXIS_PTS ATQD_PedalGDeltaTqIGain_X_kph "" 0x0000 /* @ECU_Address@ATQD_PedalGDeltaTqIGain_X_kph@ */ NO_INPUT_QUANTITY Lookup2D_X_FLOAT32_IEEE 0 SWC_FDC_type_CM_single_kph 17 0.0 300.0 /end AXIS_PTS
/begin CHARACTERISTIC MTQR_EL1FEDUTs_Z_c "" MAP 0x0000 /* @ECU_Address@MTQR_EL1FEDUTs_Z_c@ */ Lookup2D_FLOAT32_IEEE 0 SWC_FDC_type_CM_single_c 0.0 1.0
 /begin AXIS_DESCR COM_AXIS NO_INPUT_QUANTITY SWC_FDC_type_CM_single_rpm 24 -100000.0 100000.0 AXIS_PTS_REF ATQR_EL1FEDUTs_X_rpm /end AXIS_DESCR
 /begin AXIS_DESCR COM_AXIS VTQR_FEDUWhlTqReqSmoothDelay_Nm SWC_FDC_type_CM_single_Nm 18 -10000.0 10000.0 AXIS_PTS_REF ATQR_EL1FEDUTs_Y_Nm /end AXIS_DESCR
/end CHARACTERISTIC
/begin AXIS_PTS ATQR_EL1FEDUTs_Y_Nm "" 0x0000 /* @ECU_Address@ATQR_EL1FEDUTs_Y_Nm@ */ VTQR_FEDUWhlTqReqSmoothDelay_Nm Lookup2D_X_FLOAT32_IEEE 0 SWC_FDC_type_CM_single_Nm 18 -10000.0 10000.0 /end AXIS_PTS
/begin AXIS_PTS ATQR_EL1FEDUTs_X_rpm "" 0x0000 /* @ECU_Address@ATQR_EL1FEDUTs_X_rpm@ */ NO_INPUT_QUANTITY Lookup2D_X_FLOAT32_IEEE 0 SWC_FDC_type_CM_single_rpm 24 -100000.0 100000.0 /end AXIS_PTS
/begin CHARACTERISTIC MTQR_FEDUEL1RegenTs_Y_c "" CURVE 0x0000 /* @ECU_Address@MTQR_FEDUEL1RegenTs_Y_c@ */ Lookup1D_FLOAT32_IEEE 0 SWC_FDC_type_CM_single_c 0.0 1.0
 /begin AXIS_DESCR COM_AXIS NO_INPUT_QUANTITY SWC_FDC_type_CM_single_rpm 24 -100000.0 100000.0 AXIS_PTS_REF ATQR_FEDUEL1RegenTs_X_rpm /end AXIS_DESCR
/end CHARACTERISTIC
/begin AXIS_PTS ATQR_FEDUEL1RegenTs_X_rpm "" 0x0000 /* @ECU_Address@ATQR_FEDUEL1RegenTs_X_rpm@ */ NO_INPUT_QUANTITY Lookup1D_X_FLOAT32_IEEE 0 SWC_FDC_type_CM_single_rpm 24 -100000.0 100000.0 /end AXIS_PTS
/begin CHARACTERISTIC MTQR_EL2FEDUTs_Z_c "" MAP 0x0000 /* @ECU_Address@MTQR_EL2FEDUTs_Z_c@ */ Lookup2D_FLOAT32_IEEE 0 SWC_FDC_type_CM_single_c 0.0 1.0
 /begin AXIS_DESCR COM_AXIS NO_INPUT_QUANTITY SWC_FDC_type_CM_single_rpm 24 -100000.0 100000.0 AXIS_PTS_REF ATQR_EL1FEDUTs_X_rpm /end AXIS_DESCR
 /begin AXIS_DESCR COM_AXIS VTQR_FEDUWhlTqReqSmoothDelay_Nm SWC_FDC_type_CM_single_Nm 18 -10000.0 10000.0 AXIS_PTS_REF ATQR_EL1FEDUTs_Y_Nm /end AXIS_DESCR
/end CHARACTERISTIC
/begin CHARACTERISTIC MTQR_EL3FEDUTs_Z_c "" MAP 0x0000 /* @ECU_Address@MTQR_EL3FEDUTs_Z_c@ */ Lookup2D_FLOAT32_IEEE 0 SWC_FDC_type_CM_single_c 0.0 1.0
 /begin AXIS_DESCR COM_AXIS NO_INPUT_QUANTITY SWC_FDC_type_CM_single_rpm 24 -100000.0 100000.0 AXIS_PTS_REF ATQR_EL1FEDUTs_X_rpm /end AXIS_DESCR
 /begin AXIS_DESCR COM_AXIS VTQR_FEDUWhlTqReqSmoothDelay_Nm SWC_FDC_type_CM_single_Nm 18 -10000.0 10000.0 AXIS_PTS_REF ATQR_EL1FEDUTs_Y_Nm /end AXIS_DESCR
/end CHARACTERISTIC
/begin CHARACTERISTIC MTQR_EL4FEDUTs_Z_c "" MAP 0x0000 /* @ECU_Address@MTQR_EL4FEDUTs_Z_c@ */ Lookup2D_FLOAT32_IEEE 0 SWC_FDC_type_CM_single_c 0.0 1.0
 /begin AXIS_DESCR COM_AXIS NO_INPUT_QUANTITY SWC_FDC_type_CM_single_rpm 24 -100000.0 100000.0 AXIS_PTS_REF ATQR_EL1FEDUTs_X_rpm /end AXIS_DESCR
 /begin AXIS_DESCR COM_AXIS VTQR_FEDUWhlTqReqSmoothDelay_Nm SWC_FDC_type_CM_single_Nm 18 -10000.0 10000.0 AXIS_PTS_REF ATQR_EL1FEDUTs_Y_Nm /end AXIS_DESCR
/end CHARACTERISTIC
/begin CHARACTERISTIC MTQR_EL5FEDUTs_Z_c "" MAP 0x0000 /* @ECU_Address@MTQR_EL5FEDUTs_Z_c@ */ Lookup2D_FLOAT32_IEEE 0 SWC_FDC_type_CM_single_c 0.0 1.0
 /begin AXIS_DESCR COM_AXIS NO_INPUT_QUANTITY SWC_FDC_type_CM_single_rpm 24 -100000.0 100000.0 AXIS_PTS_REF ATQR_EL1FEDUTs_X_rpm /end AXIS_DESCR
 /begin AXIS_DESCR COM_AXIS VTQR_FEDUWhlTqReqSmoothDelay_Nm SWC_FDC_type_CM_single_Nm 18 -10000.0 10000.0 AXIS_PTS_REF ATQR_EL1FEDUTs_Y_Nm /end AXIS_DESCR
/end CHARACTERISTIC
/begin CHARACTERISTIC MTQR_EOPDFEDUTs_Z_c "" MAP 0x0000 /* @ECU_Address@MTQR_EOPDFEDUTs_Z_c@ */ Lookup2D_FLOAT32_IEEE 0 SWC_FDC_type_CM_single_c 0.0 1.0
 /begin AXIS_DESCR COM_AXIS NO_INPUT_QUANTITY SWC_FDC_type_CM_single_rpm 24 -100000.0 100000.0 AXIS_PTS_REF ATQR_EL1FEDUTs_X_rpm /end AXIS_DESCR
 /begin AXIS_DESCR COM_AXIS VTQR_FEDUWhlTqReqSmoothDelay_Nm SWC_FDC_type_CM_single_Nm 18 -10000.0 10000.0 AXIS_PTS_REF ATQR_EL1FEDUTs_Y_Nm /end AXIS_DESCR
/end CHARACTERISTIC
/begin CHARACTERISTIC MTQR_NL1FEDUTs_Z_c "" MAP 0x0000 /* @ECU_Address@MTQR_NL1FEDUTs_Z_c@ */ Lookup2D_FLOAT32_IEEE 0 SWC_FDC_type_CM_single_c 0.0 1.0
 /begin AXIS_DESCR COM_AXIS NO_INPUT_QUANTITY SWC_FDC_type_CM_single_rpm 24 -100000.0 100000.0 AXIS_PTS_REF ATQR_NL1FEDUTs_X_rpm /end AXIS_DESCR
 /begin AXIS_DESCR COM_AXIS VTQR_FEDUWhlTqReqSmoothDelay_Nm SWC_FDC_type_CM_single_Nm 18 -10000.0 10000.0 AXIS_PTS_REF ATQR_NL1FEDUTs_Y_Nm /end AXIS_DESCR
/end CHARACTERISTIC
/begin CHARACTERISTIC MTQR_NL2FEDUTs_Z_c "" MAP 0x0000 /* @ECU_Address@MTQR_NL2FEDUTs_Z_c@ */ Lookup2D_FLOAT32_IEEE 0 SWC_FDC_type_CM_single_c 0.0 1.0
 /begin AXIS_DESCR COM_AXIS NO_INPUT_QUANTITY SWC_FDC_type_CM_single_rpm 24 -100000.0 100000.0 AXIS_PTS_REF ATQR_NL1FEDUTs_X_rpm /end AXIS_DESCR
 /begin AXIS_DESCR COM_AXIS VTQR_FEDUWhlTqReqSmoothDelay_Nm SWC_FDC_type_CM_single_Nm 18 -10000.0 10000.0 AXIS_PTS_REF ATQR_NL1FEDUTs_Y_Nm /end AXIS_DESCR
/end CHARACTERISTIC
/begin CHARACTERISTIC MTQR_NL3FEDUTs_Z_c "" MAP 0x0000 /* @ECU_Address@MTQR_NL3FEDUTs_Z_c@ */ Lookup2D_FLOAT32_IEEE 0 SWC_FDC_type_CM_single_c 0.0 1.0
 /begin AXIS_DESCR COM_AXIS NO_INPUT_QUANTITY SWC_FDC_type_CM_single_rpm 24 -100000.0 100000.0 AXIS_PTS_REF ATQR_NL1FEDUTs_X_rpm /end AXIS_DESCR
 /begin AXIS_DESCR COM_AXIS VTQR_FEDUWhlTqReqSmoothDelay_Nm SWC_FDC_type_CM_single_Nm 18 -10000.0 10000.0 AXIS_PTS_REF ATQR_NL1FEDUTs_Y_Nm /end AXIS_DESCR
/end CHARACTERISTIC
/begin CHARACTERISTIC MTQR_NL4FEDUTs_Z_c "" MAP 0x0000 /* @ECU_Address@MTQR_NL4FEDUTs_Z_c@ */ Lookup2D_FLOAT32_IEEE 0 SWC_FDC_type_CM_single_c 0.0 1.0
 /begin AXIS_DESCR COM_AXIS NO_INPUT_QUANTITY SWC_FDC_type_CM_single_rpm 24 -100000.0 100000.0 AXIS_PTS_REF ATQR_NL1FEDUTs_X_rpm /end AXIS_DESCR
 /begin AXIS_DESCR COM_AXIS VTQR_FEDUWhlTqReqSmoothDelay_Nm SWC_FDC_type_CM_single_Nm 18 -10000.0 10000.0 AXIS_PTS_REF ATQR_NL1FEDUTs_Y_Nm /end AXIS_DESCR
/end CHARACTERISTIC
/begin CHARACTERISTIC MTQR_NL5FEDUTs_Z_c "" MAP 0x0000 /* @ECU_Address@MTQR_NL5FEDUTs_Z_c@ */ Lookup2D_FLOAT32_IEEE 0 SWC_FDC_type_CM_single_c 0.0 1.0
 /begin AXIS_DESCR COM_AXIS NO_INPUT_QUANTITY SWC_FDC_type_CM_single_rpm 24 -100000.0 100000.0 AXIS_PTS_REF ATQR_NL1FEDUTs_X_rpm /end AXIS_DESCR
 /begin AXIS_DESCR COM_AXIS VTQR_FEDUWhlTqReqSmoothDelay_Nm SWC_FDC_type_CM_single_Nm 18 -10000.0 10000.0 AXIS_PTS_REF ATQR_NL1FEDUTs_Y_Nm /end AXIS_DESCR
/end CHARACTERISTIC
/begin CHARACTERISTIC MTQR_NOPDFEDUTs_Z_c "" MAP 0x0000 /* @ECU_Address@MTQR_NOPDFEDUTs_Z_c@ */ Lookup2D_FLOAT32_IEEE 0 SWC_FDC_type_CM_single_c 0.0 1.0
 /begin AXIS_DESCR COM_AXIS NO_INPUT_QUANTITY SWC_FDC_type_CM_single_rpm 24 -100000.0 100000.0 AXIS_PTS_REF ATQR_NL1FEDUTs_X_rpm /end AXIS_DESCR
 /begin AXIS_DESCR COM_AXIS VTQR_FEDUWhlTqReqSmoothDelay_Nm SWC_FDC_type_CM_single_Nm 18 -10000.0 10000.0 AXIS_PTS_REF ATQR_NL1FEDUTs_Y_Nm /end AXIS_DESCR
/end CHARACTERISTIC
/begin CHARACTERISTIC MTQR_SL1FEDUTs_Z_c "" MAP 0x0000 /* @ECU_Address@MTQR_SL1FEDUTs_Z_c@ */ Lookup2D_FLOAT32_IEEE 0 SWC_FDC_type_CM_single_c 0.0 1.0
 /begin AXIS_DESCR COM_AXIS NO_INPUT_QUANTITY SWC_FDC_type_CM_single_rpm 24 -100000.0 100000.0 AXIS_PTS_REF ATQR_SL1FEDUTs_X_rpm /end AXIS_DESCR
 /begin AXIS_DESCR COM_AXIS VTQR_FEDUWhlTqReqSmoothDelay_Nm SWC_FDC_type_CM_single_Nm 18 -10000.0 10000.0 AXIS_PTS_REF ATQR_SL1FEDUTs_Y_Nm /end AXIS_DESCR
/end CHARACTERISTIC
/begin AXIS_PTS ATQR_SL1FEDUTs_Y_Nm "" 0x0000 /* @ECU_Address@ATQR_SL1FEDUTs_Y_Nm@ */ VTQR_FEDUWhlTqReqSmoothDelay_Nm Lookup2D_X_FLOAT32_IEEE 0 SWC_FDC_type_CM_single_Nm 18 -10000.0 10000.0 /end AXIS_PTS
/begin AXIS_PTS ATQR_SL1FEDUTs_X_rpm "" 0x0000 /* @ECU_Address@ATQR_SL1FEDUTs_X_rpm@ */ NO_INPUT_QUANTITY Lookup2D_X_FLOAT32_IEEE 0 SWC_FDC_type_CM_single_rpm 24 -100000.0 100000.0 /end AXIS_PTS
/begin CHARACTERISTIC MTQR_SL2FEDUTs_Z_c "" MAP 0x0000 /* @ECU_Address@MTQR_SL2FEDUTs_Z_c@ */ Lookup2D_FLOAT32_IEEE 0 SWC_FDC_type_CM_single_c 0.0 1.0
 /begin AXIS_DESCR COM_AXIS NO_INPUT_QUANTITY SWC_FDC_type_CM_single_rpm 24 -100000.0 100000.0 AXIS_PTS_REF ATQR_SL1FEDUTs_X_rpm /end AXIS_DESCR
 /begin AXIS_DESCR COM_AXIS VTQR_FEDUWhlTqReqSmoothDelay_Nm SWC_FDC_type_CM_single_Nm 18 -10000.0 10000.0 AXIS_PTS_REF ATQR_SL1FEDUTs_Y_Nm /end AXIS_DESCR
/end CHARACTERISTIC
/begin CHARACTERISTIC MTQR_SL3FEDUTs_Z_c "" MAP 0x0000 /* @ECU_Address@MTQR_SL3FEDUTs_Z_c@ */ Lookup2D_FLOAT32_IEEE 0 SWC_FDC_type_CM_single_c 0.0 1.0
 /begin AXIS_DESCR COM_AXIS NO_INPUT_QUANTITY SWC_FDC_type_CM_single_rpm 24 -100000.0 100000.0 AXIS_PTS_REF ATQR_SL1FEDUTs_X_rpm /end AXIS_DESCR
 /begin AXIS_DESCR COM_AXIS VTQR_FEDUWhlTqReqSmoothDelay_Nm SWC_FDC_type_CM_single_Nm 18 -10000.0 10000.0 AXIS_PTS_REF ATQR_SL1FEDUTs_Y_Nm /end AXIS_DESCR
/end CHARACTERISTIC
/begin CHARACTERISTIC MTQR_SL4FEDUTs_Z_c "" MAP 0x0000 /* @ECU_Address@MTQR_SL4FEDUTs_Z_c@ */ Lookup2D_FLOAT32_IEEE 0 SWC_FDC_type_CM_single_c 0.0 1.0
 /begin AXIS_DESCR COM_AXIS NO_INPUT_QUANTITY SWC_FDC_type_CM_single_rpm 24 -100000.0 100000.0 AXIS_PTS_REF ATQR_SL1FEDUTs_X_rpm /end AXIS_DESCR
 /begin AXIS_DESCR COM_AXIS VTQR_FEDUWhlTqReqSmoothDelay_Nm SWC_FDC_type_CM_single_Nm 18 -10000.0 10000.0 AXIS_PTS_REF ATQR_SL1FEDUTs_Y_Nm /end AXIS_DESCR
/end CHARACTERISTIC
/begin CHARACTERISTIC MTQR_SL5FEDUTs_Z_c "" MAP 0x0000 /* @ECU_Address@MTQR_SL5FEDUTs_Z_c@ */ Lookup2D_FLOAT32_IEEE 0 SWC_FDC_type_CM_single_c 0.0 1.0
 /begin AXIS_DESCR COM_AXIS NO_INPUT_QUANTITY SWC_FDC_type_CM_single_rpm 24 -100000.0 100000.0 AXIS_PTS_REF ATQR_SL1FEDUTs_X_rpm /end AXIS_DESCR
 /begin AXIS_DESCR COM_AXIS VTQR_FEDUWhlTqReqSmoothDelay_Nm SWC_FDC_type_CM_single_Nm 18 -10000.0 10000.0 AXIS_PTS_REF ATQR_SL1FEDUTs_Y_Nm /end AXIS_DESCR
/end CHARACTERISTIC
/begin CHARACTERISTIC MTQR_SOPDFEDUTs_Z_c "" MAP 0x0000 /* @ECU_Address@MTQR_SOPDFEDUTs_Z_c@ */ Lookup2D_FLOAT32_IEEE 0 SWC_FDC_type_CM_single_c 0.0 1.0
 /begin AXIS_DESCR COM_AXIS NO_INPUT_QUANTITY SWC_FDC_type_CM_single_rpm 24 -100000.0 100000.0 AXIS_PTS_REF ATQR_SL1FEDUTs_X_rpm /end AXIS_DESCR
 /begin AXIS_DESCR COM_AXIS VTQR_FEDUWhlTqReqSmoothDelay_Nm SWC_FDC_type_CM_single_Nm 18 -10000.0 10000.0 AXIS_PTS_REF ATQR_SL1FEDUTs_Y_Nm /end AXIS_DESCR
/end CHARACTERISTIC
/begin CHARACTERISTIC MTQR_FrNegRateLimitDecE_Z_Nm "" MAP 0x0000 /* @ECU_Address@MTQR_FrNegRateLimitDecE_Z_Nm@ */ Lookup2D_FLOAT32_IEEE 0 SWC_FDC_type_CM_single_Nm -10000.0 0.0
 /begin AXIS_DESCR COM_AXIS NO_INPUT_QUANTITY SWC_FDC_type_CM_single_Nm 16 -10000.0 10000.0 AXIS_PTS_REF ATQR_FrNegRateLimitIncN_X_rpm /end AXIS_DESCR
 /begin AXIS_DESCR COM_AXIS VTQR_FEDUWhlTqReqSmoothDelay_Nm SWC_FDC_type_CM_single_Nm 8 -10000.0 10000.0 AXIS_PTS_REF ATQR_FrNegRateLimitIncN_Y_Nm /end AXIS_DESCR
/end CHARACTERISTIC
/begin AXIS_PTS ATQR_FrNegRateLimitIncN_Y_Nm "" 0x0000 /* @ECU_Address@ATQR_FrNegRateLimitIncN_Y_Nm@ */ VTQR_FEDUWhlTqReqSmoothDelay_Nm Lookup2D_X_FLOAT32_IEEE 0 SWC_FDC_type_CM_single_Nm 8 -10000.0 10000.0 /end AXIS_PTS
/begin AXIS_PTS ATQR_FrNegRateLimitIncN_X_rpm "" 0x0000 /* @ECU_Address@ATQR_FrNegRateLimitIncN_X_rpm@ */ NO_INPUT_QUANTITY Lookup2D_X_FLOAT32_IEEE 0 SWC_FDC_type_CM_single_Nm 16 -10000.0 10000.0 /end AXIS_PTS
/begin CHARACTERISTIC MTQR_FrNegRateLimitDecN_Z_Nm "" MAP 0x0000 /* @ECU_Address@MTQR_FrNegRateLimitDecN_Z_Nm@ */ Lookup2D_FLOAT32_IEEE 0 SWC_FDC_type_CM_single_Nm -10000.0 0.0
 /begin AXIS_DESCR COM_AXIS NO_INPUT_QUANTITY SWC_FDC_type_CM_single_Nm 16 -10000.0 10000.0 AXIS_PTS_REF ATQR_FrNegRateLimitIncN_X_rpm /end AXIS_DESCR
 /begin AXIS_DESCR COM_AXIS VTQR_FEDUWhlTqReqSmoothDelay_Nm SWC_FDC_type_CM_single_Nm 8 -10000.0 10000.0 AXIS_PTS_REF ATQR_FrNegRateLimitIncN_Y_Nm /end AXIS_DESCR
/end CHARACTERISTIC
/begin CHARACTERISTIC MTQR_FrNegRateLimitDecS_Z_Nm "" MAP 0x0000 /* @ECU_Address@MTQR_FrNegRateLimitDecS_Z_Nm@ */ Lookup2D_FLOAT32_IEEE 0 SWC_FDC_type_CM_single_Nm -10000.0 0.0
 /begin AXIS_DESCR COM_AXIS NO_INPUT_QUANTITY SWC_FDC_type_CM_single_Nm 16 -10000.0 10000.0 AXIS_PTS_REF ATQR_FrNegRateLimitIncN_X_rpm /end AXIS_DESCR
 /begin AXIS_DESCR COM_AXIS VTQR_FEDUWhlTqReqSmoothDelay_Nm SWC_FDC_type_CM_single_Nm 8 -10000.0 10000.0 AXIS_PTS_REF ATQR_FrNegRateLimitIncN_Y_Nm /end AXIS_DESCR
/end CHARACTERISTIC
/begin CHARACTERISTIC MTQR_FrNegRateLimitIncE_Z_Nm "" MAP 0x0000 /* @ECU_Address@MTQR_FrNegRateLimitIncE_Z_Nm@ */ Lookup2D_FLOAT32_IEEE 0 SWC_FDC_type_CM_single_Nm 0.0 10000.0
 /begin AXIS_DESCR COM_AXIS NO_INPUT_QUANTITY SWC_FDC_type_CM_single_Nm 16 -10000.0 10000.0 AXIS_PTS_REF ATQR_FrNegRateLimitIncN_X_rpm /end AXIS_DESCR
 /begin AXIS_DESCR COM_AXIS VTQR_FEDUWhlTqReqSmoothDelay_Nm SWC_FDC_type_CM_single_Nm 8 -10000.0 10000.0 AXIS_PTS_REF ATQR_FrNegRateLimitIncN_Y_Nm /end AXIS_DESCR
/end CHARACTERISTIC
/begin CHARACTERISTIC MTQR_FrNegRateLimitIncN_Z_Nm "" MAP 0x0000 /* @ECU_Address@MTQR_FrNegRateLimitIncN_Z_Nm@ */ Lookup2D_FLOAT32_IEEE 0 SWC_FDC_type_CM_single_Nm 0.0 10000.0
 /begin AXIS_DESCR COM_AXIS NO_INPUT_QUANTITY SWC_FDC_type_CM_single_Nm 16 -10000.0 10000.0 AXIS_PTS_REF ATQR_FrNegRateLimitIncN_X_rpm /end AXIS_DESCR
 /begin AXIS_DESCR COM_AXIS VTQR_FEDUWhlTqReqSmoothDelay_Nm SWC_FDC_type_CM_single_Nm 8 -10000.0 10000.0 AXIS_PTS_REF ATQR_FrNegRateLimitIncN_Y_Nm /end AXIS_DESCR
/end CHARACTERISTIC
/begin CHARACTERISTIC MTQR_FrNegRateLimitIncS_Z_Nm "" MAP 0x0000 /* @ECU_Address@MTQR_FrNegRateLimitIncS_Z_Nm@ */ Lookup2D_FLOAT32_IEEE 0 SWC_FDC_type_CM_single_Nm 0.0 10000.0
 /begin AXIS_DESCR COM_AXIS NO_INPUT_QUANTITY SWC_FDC_type_CM_single_Nm 16 -10000.0 10000.0 AXIS_PTS_REF ATQR_FrNegRateLimitIncN_X_rpm /end AXIS_DESCR
 /begin AXIS_DESCR COM_AXIS VTQR_FEDUWhlTqReqSmoothDelay_Nm SWC_FDC_type_CM_single_Nm 8 -10000.0 10000.0 AXIS_PTS_REF ATQR_FrNegRateLimitIncN_Y_Nm /end AXIS_DESCR
/end CHARACTERISTIC
/begin CHARACTERISTIC MTQR_FrPosRateLimitDecE_Z_Nm "" MAP 0x0000 /* @ECU_Address@MTQR_FrPosRateLimitDecE_Z_Nm@ */ Lookup2D_FLOAT32_IEEE 0 SWC_FDC_type_CM_single_Nm -10000.0 0.0
 /begin AXIS_DESCR COM_AXIS NO_INPUT_QUANTITY SWC_FDC_type_CM_single_rpm 16 -100000.0 100000.0 AXIS_PTS_REF ATQR_FrPosRateLimitIncN_X_rpm /end AXIS_DESCR
 /begin AXIS_DESCR COM_AXIS VTQR_FEDUWhlTqReqSmoothDelay_Nm SWC_FDC_type_CM_single_Nm 8 -10000.0 10000.0 AXIS_PTS_REF ATQR_FrPosRateLimitIncN_Y_Nm /end AXIS_DESCR
/end CHARACTERISTIC
/begin AXIS_PTS ATQR_FrPosRateLimitIncN_Y_Nm "" 0x0000 /* @ECU_Address@ATQR_FrPosRateLimitIncN_Y_Nm@ */ VTQR_FEDUWhlTqReqSmoothDelay_Nm Lookup2D_X_FLOAT32_IEEE 0 SWC_FDC_type_CM_single_Nm 8 -10000.0 10000.0 /end AXIS_PTS
/begin AXIS_PTS ATQR_FrPosRateLimitIncN_X_rpm "" 0x0000 /* @ECU_Address@ATQR_FrPosRateLimitIncN_X_rpm@ */ NO_INPUT_QUANTITY Lookup2D_X_FLOAT32_IEEE 0 SWC_FDC_type_CM_single_rpm 16 -100000.0 100000.0 /end AXIS_PTS
/begin CHARACTERISTIC MTQR_FrPosRateLimitDecN_Z_Nm "" MAP 0x0000 /* @ECU_Address@MTQR_FrPosRateLimitDecN_Z_Nm@ */ Lookup2D_FLOAT32_IEEE 0 SWC_FDC_type_CM_single_Nm -10000.0 0.0
 /begin AXIS_DESCR COM_AXIS NO_INPUT_QUANTITY SWC_FDC_type_CM_single_rpm 16 -100000.0 100000.0 AXIS_PTS_REF ATQR_FrPosRateLimitIncN_X_rpm /end AXIS_DESCR
 /begin AXIS_DESCR COM_AXIS VTQR_FEDUWhlTqReqSmoothDelay_Nm SWC_FDC_type_CM_single_Nm 8 -10000.0 10000.0 AXIS_PTS_REF ATQR_FrPosRateLimitIncN_Y_Nm /end AXIS_DESCR
/end CHARACTERISTIC
/begin CHARACTERISTIC MTQR_FrPosRateLimitDecS_Z_Nm "" MAP 0x0000 /* @ECU_Address@MTQR_FrPosRateLimitDecS_Z_Nm@ */ Lookup2D_FLOAT32_IEEE 0 SWC_FDC_type_CM_single_Nm -10000.0 0.0
 /begin AXIS_DESCR COM_AXIS NO_INPUT_QUANTITY SWC_FDC_type_CM_single_rpm 16 -100000.0 100000.0 AXIS_PTS_REF ATQR_FrPosRateLimitIncN_X_rpm /end AXIS_DESCR
 /begin AXIS_DESCR COM_AXIS VTQR_FEDUWhlTqReqSmoothDelay_Nm SWC_FDC_type_CM_single_Nm 8 -10000.0 10000.0 AXIS_PTS_REF ATQR_FrPosRateLimitIncN_Y_Nm /end AXIS_DESCR
/end CHARACTERISTIC
/begin CHARACTERISTIC MTQR_FrPosRateLimitIncE_Z_Nm "" MAP 0x0000 /* @ECU_Address@MTQR_FrPosRateLimitIncE_Z_Nm@ */ Lookup2D_FLOAT32_IEEE 0 SWC_FDC_type_CM_single_Nm 0.0 10000.0
 /begin AXIS_DESCR COM_AXIS NO_INPUT_QUANTITY SWC_FDC_type_CM_single_rpm 16 -100000.0 100000.0 AXIS_PTS_REF ATQR_FrPosRateLimitIncN_X_rpm /end AXIS_DESCR
 /begin AXIS_DESCR COM_AXIS VTQR_FEDUWhlTqReqSmoothDelay_Nm SWC_FDC_type_CM_single_Nm 8 -10000.0 10000.0 AXIS_PTS_REF ATQR_FrPosRateLimitIncN_Y_Nm /end AXIS_DESCR
/end CHARACTERISTIC
/begin CHARACTERISTIC MTQR_FrPosRateLimitIncN_Z_Nm "" MAP 0x0000 /* @ECU_Address@MTQR_FrPosRateLimitIncN_Z_Nm@ */ Lookup2D_FLOAT32_IEEE 0 SWC_FDC_type_CM_single_Nm 0.0 10000.0
 /begin AXIS_DESCR COM_AXIS NO_INPUT_QUANTITY SWC_FDC_type_CM_single_rpm 16 -100000.0 100000.0 AXIS_PTS_REF ATQR_FrPosRateLimitIncN_X_rpm /end AXIS_DESCR
 /begin AXIS_DESCR COM_AXIS VTQR_FEDUWhlTqReqSmoothDelay_Nm SWC_FDC_type_CM_single_Nm 8 -10000.0 10000.0 AXIS_PTS_REF ATQR_FrPosRateLimitIncN_Y_Nm /end AXIS_DESCR
/end CHARACTERISTIC
/begin CHARACTERISTIC MTQR_FrPosRateLimitIncS_Z_Nm "" MAP 0x0000 /* @ECU_Address@MTQR_FrPosRateLimitIncS_Z_Nm@ */ Lookup2D_FLOAT32_IEEE 0 SWC_FDC_type_CM_single_Nm 0.0 10000.0
 /begin AXIS_DESCR COM_AXIS NO_INPUT_QUANTITY SWC_FDC_type_CM_single_rpm 16 -100000.0 100000.0 AXIS_PTS_REF ATQR_FrPosRateLimitIncN_X_rpm /end AXIS_DESCR
 /begin AXIS_DESCR COM_AXIS VTQR_FEDUWhlTqReqSmoothDelay_Nm SWC_FDC_type_CM_single_Nm 8 -10000.0 10000.0 AXIS_PTS_REF ATQR_FrPosRateLimitIncN_Y_Nm /end AXIS_DESCR
/end CHARACTERISTIC
/begin CHARACTERISTIC MTQR_EL1FEDUTqDecSR_Z_Nm "" MAP 0x0000 /* @ECU_Address@MTQR_EL1FEDUTqDecSR_Z_Nm@ */ Lookup2D_FLOAT32_IEEE 0 SWC_FDC_type_CM_single_Nm -100000.0 0.0
 /begin AXIS_DESCR COM_AXIS NO_INPUT_QUANTITY SWC_FDC_type_CM_single_rpm 24 -100000.0 100000.0 AXIS_PTS_REF ATQR_EL1FEDUTqIncSR_X_rpm /end AXIS_DESCR
 /begin AXIS_DESCR COM_AXIS VTQR_FEDUWhlTqReqSmoothDelay_Nm SWC_FDC_type_CM_single_Nm 18 -10000.0 10000.0 AXIS_PTS_REF ATQR_EL1FEDUTqDecSR_Y_Nm /end AXIS_DESCR
/end CHARACTERISTIC
/begin AXIS_PTS ATQR_EL1FEDUTqDecSR_Y_Nm "" 0x0000 /* @ECU_Address@ATQR_EL1FEDUTqDecSR_Y_Nm@ */ VTQR_FEDUWhlTqReqSmoothDelay_Nm Lookup2D_X_FLOAT32_IEEE 0 SWC_FDC_type_CM_single_Nm 18 -10000.0 10000.0 /end AXIS_PTS
/begin AXIS_PTS ATQR_EL1FEDUTqIncSR_X_rpm "" 0x0000 /* @ECU_Address@ATQR_EL1FEDUTqIncSR_X_rpm@ */ NO_INPUT_QUANTITY Lookup2D_X_FLOAT32_IEEE 0 SWC_FDC_type_CM_single_rpm 24 -100000.0 100000.0 /end AXIS_PTS
/begin CHARACTERISTIC MTQR_EL2FEDUTqDecSR_Z_Nm "" MAP 0x0000 /* @ECU_Address@MTQR_EL2FEDUTqDecSR_Z_Nm@ */ Lookup2D_FLOAT32_IEEE 0 SWC_FDC_type_CM_single_Nm -100000.0 0.0
 /begin AXIS_DESCR COM_AXIS NO_INPUT_QUANTITY SWC_FDC_type_CM_single_rpm 24 -100000.0 100000.0 AXIS_PTS_REF ATQR_EL1FEDUTqIncSR_X_rpm /end AXIS_DESCR
 /begin AXIS_DESCR COM_AXIS VTQR_FEDUWhlTqReqSmoothDelay_Nm SWC_FDC_type_CM_single_Nm 18 -10000.0 10000.0 AXIS_PTS_REF ATQR_EL1FEDUTqDecSR_Y_Nm /end AXIS_DESCR
/end CHARACTERISTIC
/begin CHARACTERISTIC MTQR_EL3FEDUTqDecSR_Z_Nm "" MAP 0x0000 /* @ECU_Address@MTQR_EL3FEDUTqDecSR_Z_Nm@ */ Lookup2D_FLOAT32_IEEE 0 SWC_FDC_type_CM_single_Nm -100000.0 0.0
 /begin AXIS_DESCR COM_AXIS NO_INPUT_QUANTITY SWC_FDC_type_CM_single_rpm 24 -100000.0 100000.0 AXIS_PTS_REF ATQR_EL1FEDUTqIncSR_X_rpm /end AXIS_DESCR
 /begin AXIS_DESCR COM_AXIS VTQR_FEDUWhlTqReqSmoothDelay_Nm SWC_FDC_type_CM_single_Nm 18 -10000.0 10000.0 AXIS_PTS_REF ATQR_EL1FEDUTqDecSR_Y_Nm /end AXIS_DESCR
/end CHARACTERISTIC
/begin CHARACTERISTIC MTQR_EL4FEDUTqDecSR_Z_Nm "" MAP 0x0000 /* @ECU_Address@MTQR_EL4FEDUTqDecSR_Z_Nm@ */ Lookup2D_FLOAT32_IEEE 0 SWC_FDC_type_CM_single_Nm -100000.0 0.0
 /begin AXIS_DESCR COM_AXIS NO_INPUT_QUANTITY SWC_FDC_type_CM_single_rpm 24 -100000.0 100000.0 AXIS_PTS_REF ATQR_EL1FEDUTqIncSR_X_rpm /end AXIS_DESCR
 /begin AXIS_DESCR COM_AXIS VTQR_FEDUWhlTqReqSmoothDelay_Nm SWC_FDC_type_CM_single_Nm 18 -10000.0 10000.0 AXIS_PTS_REF ATQR_EL1FEDUTqDecSR_Y_Nm /end AXIS_DESCR
/end CHARACTERISTIC
/begin CHARACTERISTIC MTQR_EL5FEDUTqDecSR_Z_Nm "" MAP 0x0000 /* @ECU_Address@MTQR_EL5FEDUTqDecSR_Z_Nm@ */ Lookup2D_FLOAT32_IEEE 0 SWC_FDC_type_CM_single_Nm -100000.0 0.0
 /begin AXIS_DESCR COM_AXIS NO_INPUT_QUANTITY SWC_FDC_type_CM_single_rpm 24 -100000.0 100000.0 AXIS_PTS_REF ATQR_EL1FEDUTqIncSR_X_rpm /end AXIS_DESCR
 /begin AXIS_DESCR COM_AXIS VTQR_FEDUWhlTqReqSmoothDelay_Nm SWC_FDC_type_CM_single_Nm 18 -10000.0 10000.0 AXIS_PTS_REF ATQR_EL1FEDUTqDecSR_Y_Nm /end AXIS_DESCR
/end CHARACTERISTIC
/begin CHARACTERISTIC MTQR_EOPDFEDUTqDecSR_Z_Nm "" MAP 0x0000 /* @ECU_Address@MTQR_EOPDFEDUTqDecSR_Z_Nm@ */ Lookup2D_FLOAT32_IEEE 0 SWC_FDC_type_CM_single_Nm -100000.0 0.0
 /begin AXIS_DESCR COM_AXIS NO_INPUT_QUANTITY SWC_FDC_type_CM_single_rpm 24 -100000.0 100000.0 AXIS_PTS_REF ATQR_EL1FEDUTqIncSR_X_rpm /end AXIS_DESCR
 /begin AXIS_DESCR COM_AXIS VTQR_FEDUWhlTqReqSmoothDelay_Nm SWC_FDC_type_CM_single_Nm 18 -10000.0 10000.0 AXIS_PTS_REF ATQR_EL1FEDUTqDecSR_Y_Nm /end AXIS_DESCR
/end CHARACTERISTIC
/begin CHARACTERISTIC MTQR_EL1FEDUTqIncSR_Z_Nm "" MAP 0x0000 /* @ECU_Address@MTQR_EL1FEDUTqIncSR_Z_Nm@ */ Lookup2D_FLOAT32_IEEE 0 SWC_FDC_type_CM_single_Nm 0.0 100000.0
 /begin AXIS_DESCR COM_AXIS NO_INPUT_QUANTITY SWC_FDC_type_CM_single_rpm 24 -100000.0 100000.0 AXIS_PTS_REF ATQR_EL1FEDUTqIncSR_X_rpm /end AXIS_DESCR
 /begin AXIS_DESCR COM_AXIS NO_INPUT_QUANTITY SWC_FDC_type_CM_single_Nm 17 0.0 120.0 AXIS_PTS_REF ATQR_EL1FEDUTqIncSR_Y_pct /end AXIS_DESCR
/end CHARACTERISTIC
/begin AXIS_PTS ATQR_EL1FEDUTqIncSR_Y_pct "" 0x0000 /* @ECU_Address@ATQR_EL1FEDUTqIncSR_Y_pct@ */ NO_INPUT_QUANTITY Lookup2D_X_FLOAT32_IEEE 0 SWC_FDC_type_CM_single_Nm 17 0.0 120.0 /end AXIS_PTS
/begin CHARACTERISTIC MTQR_EL2FEDUTqIncSR_Z_Nm "" MAP 0x0000 /* @ECU_Address@MTQR_EL2FEDUTqIncSR_Z_Nm@ */ Lookup2D_FLOAT32_IEEE 0 SWC_FDC_type_CM_single_Nm 0.0 100000.0
 /begin AXIS_DESCR COM_AXIS NO_INPUT_QUANTITY SWC_FDC_type_CM_single_rpm 24 -100000.0 100000.0 AXIS_PTS_REF ATQR_EL1FEDUTqIncSR_X_rpm /end AXIS_DESCR
 /begin AXIS_DESCR COM_AXIS NO_INPUT_QUANTITY SWC_FDC_type_CM_single_Nm 17 0.0 120.0 AXIS_PTS_REF ATQR_EL1FEDUTqIncSR_Y_pct /end AXIS_DESCR
/end CHARACTERISTIC
/begin CHARACTERISTIC MTQR_EL3FEDUTqIncSR_Z_Nm "" MAP 0x0000 /* @ECU_Address@MTQR_EL3FEDUTqIncSR_Z_Nm@ */ Lookup2D_FLOAT32_IEEE 0 SWC_FDC_type_CM_single_Nm 0.0 100000.0
 /begin AXIS_DESCR COM_AXIS NO_INPUT_QUANTITY SWC_FDC_type_CM_single_rpm 24 -100000.0 100000.0 AXIS_PTS_REF ATQR_EL1FEDUTqIncSR_X_rpm /end AXIS_DESCR
 /begin AXIS_DESCR COM_AXIS NO_INPUT_QUANTITY SWC_FDC_type_CM_single_Nm 17 0.0 120.0 AXIS_PTS_REF ATQR_EL1FEDUTqIncSR_Y_pct /end AXIS_DESCR
/end CHARACTERISTIC
/begin CHARACTERISTIC MTQR_EL4FEDUTqIncSR_Z_Nm "" MAP 0x0000 /* @ECU_Address@MTQR_EL4FEDUTqIncSR_Z_Nm@ */ Lookup2D_FLOAT32_IEEE 0 SWC_FDC_type_CM_single_Nm 0.0 100000.0
 /begin AXIS_DESCR COM_AXIS NO_INPUT_QUANTITY SWC_FDC_type_CM_single_rpm 24 -100000.0 100000.0 AXIS_PTS_REF ATQR_EL1FEDUTqIncSR_X_rpm /end AXIS_DESCR
 /begin AXIS_DESCR COM_AXIS NO_INPUT_QUANTITY SWC_FDC_type_CM_single_Nm 17 0.0 120.0 AXIS_PTS_REF ATQR_EL1FEDUTqIncSR_Y_pct /end AXIS_DESCR
/end CHARACTERISTIC
/begin CHARACTERISTIC MTQR_EL5FEDUTqIncSR_Z_Nm "" MAP 0x0000 /* @ECU_Address@MTQR_EL5FEDUTqIncSR_Z_Nm@ */ Lookup2D_FLOAT32_IEEE 0 SWC_FDC_type_CM_single_Nm 0.0 100000.0
 /begin AXIS_DESCR COM_AXIS NO_INPUT_QUANTITY SWC_FDC_type_CM_single_rpm 24 -100000.0 100000.0 AXIS_PTS_REF ATQR_EL1FEDUTqIncSR_X_rpm /end AXIS_DESCR
 /begin AXIS_DESCR COM_AXIS NO_INPUT_QUANTITY SWC_FDC_type_CM_single_Nm 17 0.0 120.0 AXIS_PTS_REF ATQR_EL1FEDUTqIncSR_Y_pct /end AXIS_DESCR
/end CHARACTERISTIC
/begin CHARACTERISTIC MTQR_EOPDFEDUTqIncSR_Z_Nm "" MAP 0x0000 /* @ECU_Address@MTQR_EOPDFEDUTqIncSR_Z_Nm@ */ Lookup2D_FLOAT32_IEEE 0 SWC_FDC_type_CM_single_Nm 0.0 100000.0
 /begin AXIS_DESCR COM_AXIS NO_INPUT_QUANTITY SWC_FDC_type_CM_single_rpm 24 -100000.0 100000.0 AXIS_PTS_REF ATQR_EL1FEDUTqIncSR_X_rpm /end AXIS_DESCR
 /begin AXIS_DESCR COM_AXIS NO_INPUT_QUANTITY SWC_FDC_type_CM_single_Nm 17 0.0 120.0 AXIS_PTS_REF ATQR_EL1FEDUTqIncSR_Y_pct /end AXIS_DESCR
/end CHARACTERISTIC
/begin CHARACTERISTIC MTQR_NL1FEDUTqDecSR_Z_Nm "" MAP 0x0000 /* @ECU_Address@MTQR_NL1FEDUTqDecSR_Z_Nm@ */ Lookup2D_FLOAT32_IEEE 0 SWC_FDC_type_CM_single_Nm -100000.0 0.0
 /begin AXIS_DESCR COM_AXIS NO_INPUT_QUANTITY SWC_FDC_type_CM_single_rpm 24 -100000.0 100000.0 AXIS_PTS_REF ATQR_NL1FEDUTqIncSR_X_rpm /end AXIS_DESCR
 /begin AXIS_DESCR COM_AXIS VTQR_FEDUWhlTqReqSmoothDelay_Nm SWC_FDC_type_CM_single_Nm 18 -10000.0 10000.0 AXIS_PTS_REF ATQR_NL1FEDUTqDecSR_Y_Nm /end AXIS_DESCR
/end CHARACTERISTIC
/begin CHARACTERISTIC MTQR_NL2FEDUTqDecSR_Z_Nm "" MAP 0x0000 /* @ECU_Address@MTQR_NL2FEDUTqDecSR_Z_Nm@ */ Lookup2D_FLOAT32_IEEE 0 SWC_FDC_type_CM_single_Nm -100000.0 0.0
 /begin AXIS_DESCR COM_AXIS NO_INPUT_QUANTITY SWC_FDC_type_CM_single_rpm 24 -100000.0 100000.0 AXIS_PTS_REF ATQR_NL1FEDUTqIncSR_X_rpm /end AXIS_DESCR
 /begin AXIS_DESCR COM_AXIS VTQR_FEDUWhlTqReqSmoothDelay_Nm SWC_FDC_type_CM_single_Nm 18 -10000.0 10000.0 AXIS_PTS_REF ATQR_NL1FEDUTqDecSR_Y_Nm /end AXIS_DESCR
/end CHARACTERISTIC
/begin CHARACTERISTIC MTQR_NL3FEDUTqDecSR_Z_Nm "" MAP 0x0000 /* @ECU_Address@MTQR_NL3FEDUTqDecSR_Z_Nm@ */ Lookup2D_FLOAT32_IEEE 0 SWC_FDC_type_CM_single_Nm -100000.0 0.0
 /begin AXIS_DESCR COM_AXIS NO_INPUT_QUANTITY SWC_FDC_type_CM_single_rpm 24 -100000.0 100000.0 AXIS_PTS_REF ATQR_NL1FEDUTqIncSR_X_rpm /end AXIS_DESCR
 /begin AXIS_DESCR COM_AXIS VTQR_FEDUWhlTqReqSmoothDelay_Nm SWC_FDC_type_CM_single_Nm 18 -10000.0 10000.0 AXIS_PTS_REF ATQR_NL1FEDUTqDecSR_Y_Nm /end AXIS_DESCR
/end CHARACTERISTIC
/begin CHARACTERISTIC MTQR_NL4FEDUTqDecSR_Z_Nm "" MAP 0x0000 /* @ECU_Address@MTQR_NL4FEDUTqDecSR_Z_Nm@ */ Lookup2D_FLOAT32_IEEE 0 SWC_FDC_type_CM_single_Nm -100000.0 0.0
 /begin AXIS_DESCR COM_AXIS NO_INPUT_QUANTITY SWC_FDC_type_CM_single_rpm 24 -100000.0 100000.0 AXIS_PTS_REF ATQR_NL1FEDUTqIncSR_X_rpm /end AXIS_DESCR
 /begin AXIS_DESCR COM_AXIS VTQR_FEDUWhlTqReqSmoothDelay_Nm SWC_FDC_type_CM_single_Nm 18 -10000.0 10000.0 AXIS_PTS_REF ATQR_NL1FEDUTqDecSR_Y_Nm /end AXIS_DESCR
/end CHARACTERISTIC
/begin CHARACTERISTIC MTQR_NL5FEDUTqDecSR_Z_Nm "" MAP 0x0000 /* @ECU_Address@MTQR_NL5FEDUTqDecSR_Z_Nm@ */ Lookup2D_FLOAT32_IEEE 0 SWC_FDC_type_CM_single_Nm -100000.0 0.0
 /begin AXIS_DESCR COM_AXIS NO_INPUT_QUANTITY SWC_FDC_type_CM_single_rpm 24 -100000.0 100000.0 AXIS_PTS_REF ATQR_NL1FEDUTqIncSR_X_rpm /end AXIS_DESCR
 /begin AXIS_DESCR COM_AXIS VTQR_FEDUWhlTqReqSmoothDelay_Nm SWC_FDC_type_CM_single_Nm 18 -10000.0 10000.0 AXIS_PTS_REF ATQR_NL1FEDUTqDecSR_Y_Nm /end AXIS_DESCR
/end CHARACTERISTIC
/begin CHARACTERISTIC MTQR_NOPDFEDUTqDecSR_Z_Nm "" MAP 0x0000 /* @ECU_Address@MTQR_NOPDFEDUTqDecSR_Z_Nm@ */ Lookup2D_FLOAT32_IEEE 0 SWC_FDC_type_CM_single_Nm -100000.0 0.0
 /begin AXIS_DESCR COM_AXIS NO_INPUT_QUANTITY SWC_FDC_type_CM_single_rpm 24 -100000.0 100000.0 AXIS_PTS_REF ATQR_NL1FEDUTqIncSR_X_rpm /end AXIS_DESCR
 /begin AXIS_DESCR COM_AXIS VTQR_FEDUWhlTqReqSmoothDelay_Nm SWC_FDC_type_CM_single_Nm 18 -10000.0 10000.0 AXIS_PTS_REF ATQR_NL1FEDUTqDecSR_Y_Nm /end AXIS_DESCR
/end CHARACTERISTIC
/begin CHARACTERISTIC MTQR_NL1FEDUTqIncSR_Z_Nm "" MAP 0x0000 /* @ECU_Address@MTQR_NL1FEDUTqIncSR_Z_Nm@ */ Lookup2D_FLOAT32_IEEE 0 SWC_FDC_type_CM_single_Nm 0.0 100000.0
 /begin AXIS_DESCR COM_AXIS NO_INPUT_QUANTITY SWC_FDC_type_CM_single_rpm 24 -100000.0 100000.0 AXIS_PTS_REF ATQR_NL1FEDUTqIncSR_X_rpm /end AXIS_DESCR
 /begin AXIS_DESCR COM_AXIS NO_INPUT_QUANTITY SWC_FDC_type_CM_single_Nm 17 0.0 120.0 AXIS_PTS_REF ATQR_NL1FEDUTqIncSR_Y_pct /end AXIS_DESCR
/end CHARACTERISTIC
/begin CHARACTERISTIC MTQR_NL2FEDUTqIncSR_Z_Nm "" MAP 0x0000 /* @ECU_Address@MTQR_NL2FEDUTqIncSR_Z_Nm@ */ Lookup2D_FLOAT32_IEEE 0 SWC_FDC_type_CM_single_Nm 0.0 100000.0
 /begin AXIS_DESCR COM_AXIS NO_INPUT_QUANTITY SWC_FDC_type_CM_single_rpm 24 -100000.0 100000.0 AXIS_PTS_REF ATQR_NL1FEDUTqIncSR_X_rpm /end AXIS_DESCR
 /begin AXIS_DESCR COM_AXIS NO_INPUT_QUANTITY SWC_FDC_type_CM_single_Nm 17 0.0 120.0 AXIS_PTS_REF ATQR_NL1FEDUTqIncSR_Y_pct /end AXIS_DESCR
/end CHARACTERISTIC
/begin CHARACTERISTIC MTQR_NL3FEDUTqIncSR_Z_Nm "" MAP 0x0000 /* @ECU_Address@MTQR_NL3FEDUTqIncSR_Z_Nm@ */ Lookup2D_FLOAT32_IEEE 0 SWC_FDC_type_CM_single_Nm 0.0 100000.0
 /begin AXIS_DESCR COM_AXIS NO_INPUT_QUANTITY SWC_FDC_type_CM_single_rpm 24 -100000.0 100000.0 AXIS_PTS_REF ATQR_NL1FEDUTqIncSR_X_rpm /end AXIS_DESCR
 /begin AXIS_DESCR COM_AXIS NO_INPUT_QUANTITY SWC_FDC_type_CM_single_Nm 17 0.0 120.0 AXIS_PTS_REF ATQR_NL1FEDUTqIncSR_Y_pct /end AXIS_DESCR
/end CHARACTERISTIC
/begin CHARACTERISTIC MTQR_NL4FEDUTqIncSR_Z_Nm "" MAP 0x0000 /* @ECU_Address@MTQR_NL4FEDUTqIncSR_Z_Nm@ */ Lookup2D_FLOAT32_IEEE 0 SWC_FDC_type_CM_single_Nm 0.0 100000.0
 /begin AXIS_DESCR COM_AXIS NO_INPUT_QUANTITY SWC_FDC_type_CM_single_rpm 24 -100000.0 100000.0 AXIS_PTS_REF ATQR_NL1FEDUTqIncSR_X_rpm /end AXIS_DESCR
 /begin AXIS_DESCR COM_AXIS NO_INPUT_QUANTITY SWC_FDC_type_CM_single_Nm 17 0.0 120.0 AXIS_PTS_REF ATQR_NL1FEDUTqIncSR_Y_pct /end AXIS_DESCR
/end CHARACTERISTIC
/begin CHARACTERISTIC MTQR_NL5FEDUTqIncSR_Z_Nm "" MAP 0x0000 /* @ECU_Address@MTQR_NL5FEDUTqIncSR_Z_Nm@ */ Lookup2D_FLOAT32_IEEE 0 SWC_FDC_type_CM_single_Nm 0.0 100000.0
 /begin AXIS_DESCR COM_AXIS NO_INPUT_QUANTITY SWC_FDC_type_CM_single_rpm 24 -100000.0 100000.0 AXIS_PTS_REF ATQR_NL1FEDUTqIncSR_X_rpm /end AXIS_DESCR
 /begin AXIS_DESCR COM_AXIS NO_INPUT_QUANTITY SWC_FDC_type_CM_single_Nm 17 0.0 120.0 AXIS_PTS_REF ATQR_NL1FEDUTqIncSR_Y_pct /end AXIS_DESCR
/end CHARACTERISTIC
/begin CHARACTERISTIC MTQR_NOPDFEDUTqIncSR_Z_Nm "" MAP 0x0000 /* @ECU_Address@MTQR_NOPDFEDUTqIncSR_Z_Nm@ */ Lookup2D_FLOAT32_IEEE 0 SWC_FDC_type_CM_single_Nm 0.0 100000.0
 /begin AXIS_DESCR COM_AXIS NO_INPUT_QUANTITY SWC_FDC_type_CM_single_rpm 24 -100000.0 100000.0 AXIS_PTS_REF ATQR_NL1FEDUTqIncSR_X_rpm /end AXIS_DESCR
 /begin AXIS_DESCR COM_AXIS NO_INPUT_QUANTITY SWC_FDC_type_CM_single_Nm 17 0.0 120.0 AXIS_PTS_REF ATQR_NL1FEDUTqIncSR_Y_pct /end AXIS_DESCR
/end CHARACTERISTIC
/begin CHARACTERISTIC MTQR_SL1FEDUTqDecSR_Z_Nm "" MAP 0x0000 /* @ECU_Address@MTQR_SL1FEDUTqDecSR_Z_Nm@ */ Lookup2D_FLOAT32_IEEE 0 SWC_FDC_type_CM_single_Nm -100000.0 0.0
 /begin AXIS_DESCR COM_AXIS NO_INPUT_QUANTITY SWC_FDC_type_CM_single_rpm 24 -100000.0 100000.0 AXIS_PTS_REF ATQR_SL1FEDUTqIncSR_X_rpm /end AXIS_DESCR
 /begin AXIS_DESCR COM_AXIS VTQR_FEDUWhlTqReqSmoothDelay_Nm SWC_FDC_type_CM_single_Nm 18 -10000.0 10000.0 AXIS_PTS_REF ATQR_SL1FEDUTqDecSR_Y_Nm /end AXIS_DESCR
/end CHARACTERISTIC
/begin AXIS_PTS ATQR_SL1FEDUTqDecSR_Y_Nm "" 0x0000 /* @ECU_Address@ATQR_SL1FEDUTqDecSR_Y_Nm@ */ VTQR_FEDUWhlTqReqSmoothDelay_Nm Lookup2D_X_FLOAT32_IEEE 0 SWC_FDC_type_CM_single_Nm 18 -10000.0 10000.0 /end AXIS_PTS
/begin AXIS_PTS ATQR_SL1FEDUTqIncSR_X_rpm "" 0x0000 /* @ECU_Address@ATQR_SL1FEDUTqIncSR_X_rpm@ */ NO_INPUT_QUANTITY Lookup2D_X_FLOAT32_IEEE 0 SWC_FDC_type_CM_single_rpm 24 -100000.0 100000.0 /end AXIS_PTS
/begin CHARACTERISTIC MTQR_SL2FEDUTqDecSR_Z_Nm "" MAP 0x0000 /* @ECU_Address@MTQR_SL2FEDUTqDecSR_Z_Nm@ */ Lookup2D_FLOAT32_IEEE 0 SWC_FDC_type_CM_single_Nm -100000.0 0.0
 /begin AXIS_DESCR COM_AXIS NO_INPUT_QUANTITY SWC_FDC_type_CM_single_rpm 24 -100000.0 100000.0 AXIS_PTS_REF ATQR_SL1FEDUTqIncSR_X_rpm /end AXIS_DESCR
 /begin AXIS_DESCR COM_AXIS VTQR_FEDUWhlTqReqSmoothDelay_Nm SWC_FDC_type_CM_single_Nm 18 -10000.0 10000.0 AXIS_PTS_REF ATQR_SL1FEDUTqDecSR_Y_Nm /end AXIS_DESCR
/end CHARACTERISTIC
/begin CHARACTERISTIC MTQR_SL3FEDUTqDecSR_Z_Nm "" MAP 0x0000 /* @ECU_Address@MTQR_SL3FEDUTqDecSR_Z_Nm@ */ Lookup2D_FLOAT32_IEEE 0 SWC_FDC_type_CM_single_Nm -100000.0 0.0
 /begin AXIS_DESCR COM_AXIS NO_INPUT_QUANTITY SWC_FDC_type_CM_single_rpm 24 -100000.0 100000.0 AXIS_PTS_REF ATQR_SL1FEDUTqIncSR_X_rpm /end AXIS_DESCR
 /begin AXIS_DESCR COM_AXIS VTQR_FEDUWhlTqReqSmoothDelay_Nm SWC_FDC_type_CM_single_Nm 18 -10000.0 10000.0 AXIS_PTS_REF ATQR_SL1FEDUTqDecSR_Y_Nm /end AXIS_DESCR
/end CHARACTERISTIC
/begin CHARACTERISTIC MTQR_SL4FEDUTqDecSR_Z_Nm "" MAP 0x0000 /* @ECU_Address@MTQR_SL4FEDUTqDecSR_Z_Nm@ */ Lookup2D_FLOAT32_IEEE 0 SWC_FDC_type_CM_single_Nm -100000.0 0.0
 /begin AXIS_DESCR COM_AXIS NO_INPUT_QUANTITY SWC_FDC_type_CM_single_rpm 24 -100000.0 100000.0 AXIS_PTS_REF ATQR_SL1FEDUTqIncSR_X_rpm /end AXIS_DESCR
 /begin AXIS_DESCR COM_AXIS VTQR_FEDUWhlTqReqSmoothDelay_Nm SWC_FDC_type_CM_single_Nm 18 -10000.0 10000.0 AXIS_PTS_REF ATQR_SL1FEDUTqDecSR_Y_Nm /end AXIS_DESCR
/end CHARACTERISTIC
/begin CHARACTERISTIC MTQR_SL5FEDUTqDecSR_Z_Nm "" MAP 0x0000 /* @ECU_Address@MTQR_SL5FEDUTqDecSR_Z_Nm@ */ Lookup2D_FLOAT32_IEEE 0 SWC_FDC_type_CM_single_Nm -100000.0 0.0
 /begin AXIS_DESCR COM_AXIS NO_INPUT_QUANTITY SWC_FDC_type_CM_single_rpm 24 -100000.0 100000.0 AXIS_PTS_REF ATQR_SL1FEDUTqIncSR_X_rpm /end AXIS_DESCR
 /begin AXIS_DESCR COM_AXIS VTQR_FEDUWhlTqReqSmoothDelay_Nm SWC_FDC_type_CM_single_Nm 18 -10000.0 10000.0 AXIS_PTS_REF ATQR_SL1FEDUTqDecSR_Y_Nm /end AXIS_DESCR
/end CHARACTERISTIC
/begin CHARACTERISTIC MTQR_SOPDFEDUTqDecSR_Z_Nm "" MAP 0x0000 /* @ECU_Address@MTQR_SOPDFEDUTqDecSR_Z_Nm@ */ Lookup2D_FLOAT32_IEEE 0 SWC_FDC_type_CM_single_Nm -100000.0 0.0
 /begin AXIS_DESCR COM_AXIS NO_INPUT_QUANTITY SWC_FDC_type_CM_single_rpm 24 -100000.0 100000.0 AXIS_PTS_REF ATQR_SL1FEDUTqIncSR_X_rpm /end AXIS_DESCR
 /begin AXIS_DESCR COM_AXIS VTQR_FEDUWhlTqReqSmoothDelay_Nm SWC_FDC_type_CM_single_Nm 18 -10000.0 10000.0 AXIS_PTS_REF ATQR_SL1FEDUTqDecSR_Y_Nm /end AXIS_DESCR
/end CHARACTERISTIC
/begin CHARACTERISTIC MTQR_SL1FEDUTqIncSR_Z_Nm "" MAP 0x0000 /* @ECU_Address@MTQR_SL1FEDUTqIncSR_Z_Nm@ */ Lookup2D_FLOAT32_IEEE 0 SWC_FDC_type_CM_single_Nm 0.0 100000.0
 /begin AXIS_DESCR COM_AXIS NO_INPUT_QUANTITY SWC_FDC_type_CM_single_rpm 24 -100000.0 100000.0 AXIS_PTS_REF ATQR_SL1FEDUTqIncSR_X_rpm /end AXIS_DESCR
 /begin AXIS_DESCR COM_AXIS NO_INPUT_QUANTITY SWC_FDC_type_CM_single_Nm 17 0.0 120.0 AXIS_PTS_REF ATQR_SL1FEDUTqIncSR_Y_pct /end AXIS_DESCR
/end CHARACTERISTIC
/begin AXIS_PTS ATQR_SL1FEDUTqIncSR_Y_pct "" 0x0000 /* @ECU_Address@ATQR_SL1FEDUTqIncSR_Y_pct@ */ NO_INPUT_QUANTITY Lookup2D_X_FLOAT32_IEEE 0 SWC_FDC_type_CM_single_Nm 17 0.0 120.0 /end AXIS_PTS
/begin CHARACTERISTIC MTQR_SL2FEDUTqIncSR_Z_Nm "" MAP 0x0000 /* @ECU_Address@MTQR_SL2FEDUTqIncSR_Z_Nm@ */ Lookup2D_FLOAT32_IEEE 0 SWC_FDC_type_CM_single_Nm 0.0 100000.0
 /begin AXIS_DESCR COM_AXIS NO_INPUT_QUANTITY SWC_FDC_type_CM_single_rpm 24 -100000.0 100000.0 AXIS_PTS_REF ATQR_SL1FEDUTqIncSR_X_rpm /end AXIS_DESCR
 /begin AXIS_DESCR COM_AXIS NO_INPUT_QUANTITY SWC_FDC_type_CM_single_Nm 17 0.0 120.0 AXIS_PTS_REF ATQR_SL1FEDUTqIncSR_Y_pct /end AXIS_DESCR
/end CHARACTERISTIC
/begin CHARACTERISTIC MTQR_SL3FEDUTqIncSR_Z_Nm "" MAP 0x0000 /* @ECU_Address@MTQR_SL3FEDUTqIncSR_Z_Nm@ */ Lookup2D_FLOAT32_IEEE 0 SWC_FDC_type_CM_single_Nm 0.0 100000.0
 /begin AXIS_DESCR COM_AXIS NO_INPUT_QUANTITY SWC_FDC_type_CM_single_rpm 24 -100000.0 100000.0 AXIS_PTS_REF ATQR_SL1FEDUTqIncSR_X_rpm /end AXIS_DESCR
 /begin AXIS_DESCR COM_AXIS NO_INPUT_QUANTITY SWC_FDC_type_CM_single_Nm 17 0.0 120.0 AXIS_PTS_REF ATQR_SL1FEDUTqIncSR_Y_pct /end AXIS_DESCR
/end CHARACTERISTIC
/begin CHARACTERISTIC MTQR_SL4FEDUTqIncSR_Z_Nm "" MAP 0x0000 /* @ECU_Address@MTQR_SL4FEDUTqIncSR_Z_Nm@ */ Lookup2D_FLOAT32_IEEE 0 SWC_FDC_type_CM_single_Nm 0.0 100000.0
 /begin AXIS_DESCR COM_AXIS NO_INPUT_QUANTITY SWC_FDC_type_CM_single_rpm 24 -100000.0 100000.0 AXIS_PTS_REF ATQR_SL1FEDUTqIncSR_X_rpm /end AXIS_DESCR
 /begin AXIS_DESCR COM_AXIS NO_INPUT_QUANTITY SWC_FDC_type_CM_single_Nm 17 0.0 120.0 AXIS_PTS_REF ATQR_SL1FEDUTqIncSR_Y_pct /end AXIS_DESCR
/end CHARACTERISTIC
/begin CHARACTERISTIC MTQR_SL5FEDUTqIncSR_Z_Nm "" MAP 0x0000 /* @ECU_Address@MTQR_SL5FEDUTqIncSR_Z_Nm@ */ Lookup2D_FLOAT32_IEEE 0 SWC_FDC_type_CM_single_Nm 0.0 100000.0
 /begin AXIS_DESCR COM_AXIS NO_INPUT_QUANTITY SWC_FDC_type_CM_single_rpm 24 -100000.0 100000.0 AXIS_PTS_REF ATQR_SL1FEDUTqIncSR_X_rpm /end AXIS_DESCR
 /begin AXIS_DESCR COM_AXIS NO_INPUT_QUANTITY SWC_FDC_type_CM_single_Nm 17 0.0 120.0 AXIS_PTS_REF ATQR_SL1FEDUTqIncSR_Y_pct /end AXIS_DESCR
/end CHARACTERISTIC
/begin CHARACTERISTIC MTQR_SOPDFEDUTqIncSR_Z_Nm "" MAP 0x0000 /* @ECU_Address@MTQR_SOPDFEDUTqIncSR_Z_Nm@ */ Lookup2D_FLOAT32_IEEE 0 SWC_FDC_type_CM_single_Nm 0.0 100000.0
 /begin AXIS_DESCR COM_AXIS NO_INPUT_QUANTITY SWC_FDC_type_CM_single_rpm 24 -100000.0 100000.0 AXIS_PTS_REF ATQR_SL1FEDUTqIncSR_X_rpm /end AXIS_DESCR
 /begin AXIS_DESCR COM_AXIS NO_INPUT_QUANTITY SWC_FDC_type_CM_single_Nm 17 0.0 120.0 AXIS_PTS_REF ATQR_SL1FEDUTqIncSR_Y_pct /end AXIS_DESCR
/end CHARACTERISTIC
/begin CHARACTERISTIC MTQR_EL1REDUTs_Z_c "" MAP 0x0000 /* @ECU_Address@MTQR_EL1REDUTs_Z_c@ */ Lookup2D_FLOAT32_IEEE 0 SWC_FDC_type_CM_single_c 0.0 1.0
 /begin AXIS_DESCR COM_AXIS NO_INPUT_QUANTITY SWC_FDC_type_CM_single_rpm 24 -100000.0 100000.0 AXIS_PTS_REF ATQR_EL1FEDUTs_X_rpm /end AXIS_DESCR
 /begin AXIS_DESCR COM_AXIS VTQR_REDUWhlTqReqSmoothDelay_Nm SWC_FDC_type_CM_single_Nm 18 -10000.0 10000.0 AXIS_PTS_REF ATQR_EL1REDUTs_Y_Nm /end AXIS_DESCR
/end CHARACTERISTIC
/begin AXIS_PTS ATQR_EL1REDUTs_Y_Nm "" 0x0000 /* @ECU_Address@ATQR_EL1REDUTs_Y_Nm@ */ VTQR_REDUWhlTqReqSmoothDelay_Nm Lookup2D_X_FLOAT32_IEEE 0 SWC_FDC_type_CM_single_Nm 18 -10000.0 10000.0 /end AXIS_PTS
/begin CHARACTERISTIC MTQR_REDUEL1RegenTs_Y_c "" CURVE 0x0000 /* @ECU_Address@MTQR_REDUEL1RegenTs_Y_c@ */ Lookup1D_FLOAT32_IEEE 0 SWC_FDC_type_CM_single_c 0.0 1.0
 /begin AXIS_DESCR COM_AXIS NO_INPUT_QUANTITY SWC_FDC_type_CM_single_rpm 24 -100000.0 100000.0 AXIS_PTS_REF ATQR_FEDUEL1RegenTs_X_rpm /end AXIS_DESCR
/end CHARACTERISTIC
/begin CHARACTERISTIC MTQR_EL2REDUTs_Z_c "" MAP 0x0000 /* @ECU_Address@MTQR_EL2REDUTs_Z_c@ */ Lookup2D_FLOAT32_IEEE 0 SWC_FDC_type_CM_single_c 0.0 1.0
 /begin AXIS_DESCR COM_AXIS NO_INPUT_QUANTITY SWC_FDC_type_CM_single_rpm 24 -100000.0 100000.0 AXIS_PTS_REF ATQR_EL1FEDUTs_X_rpm /end AXIS_DESCR
 /begin AXIS_DESCR COM_AXIS VTQR_REDUWhlTqReqSmoothDelay_Nm SWC_FDC_type_CM_single_Nm 18 -10000.0 10000.0 AXIS_PTS_REF ATQR_EL1REDUTs_Y_Nm /end AXIS_DESCR
/end CHARACTERISTIC
/begin CHARACTERISTIC MTQR_EL3REDUTs_Z_c "" MAP 0x0000 /* @ECU_Address@MTQR_EL3REDUTs_Z_c@ */ Lookup2D_FLOAT32_IEEE 0 SWC_FDC_type_CM_single_c 0.0 1.0
 /begin AXIS_DESCR COM_AXIS NO_INPUT_QUANTITY SWC_FDC_type_CM_single_rpm 24 -100000.0 100000.0 AXIS_PTS_REF ATQR_EL1FEDUTs_X_rpm /end AXIS_DESCR
 /begin AXIS_DESCR COM_AXIS VTQR_REDUWhlTqReqSmoothDelay_Nm SWC_FDC_type_CM_single_Nm 18 -10000.0 10000.0 AXIS_PTS_REF ATQR_EL1REDUTs_Y_Nm /end AXIS_DESCR
/end CHARACTERISTIC
/begin CHARACTERISTIC MTQR_EL4REDUTs_Z_c "" MAP 0x0000 /* @ECU_Address@MTQR_EL4REDUTs_Z_c@ */ Lookup2D_FLOAT32_IEEE 0 SWC_FDC_type_CM_single_c 0.0 1.0
 /begin AXIS_DESCR COM_AXIS NO_INPUT_QUANTITY SWC_FDC_type_CM_single_rpm 24 -100000.0 100000.0 AXIS_PTS_REF ATQR_EL1FEDUTs_X_rpm /end AXIS_DESCR
 /begin AXIS_DESCR COM_AXIS VTQR_REDUWhlTqReqSmoothDelay_Nm SWC_FDC_type_CM_single_Nm 18 -10000.0 10000.0 AXIS_PTS_REF ATQR_EL1REDUTs_Y_Nm /end AXIS_DESCR
/end CHARACTERISTIC
/begin CHARACTERISTIC MTQR_EL5REDUTs_Z_c "" MAP 0x0000 /* @ECU_Address@MTQR_EL5REDUTs_Z_c@ */ Lookup2D_FLOAT32_IEEE 0 SWC_FDC_type_CM_single_c 0.0 1.0
 /begin AXIS_DESCR COM_AXIS NO_INPUT_QUANTITY SWC_FDC_type_CM_single_rpm 24 -100000.0 100000.0 AXIS_PTS_REF ATQR_EL1FEDUTs_X_rpm /end AXIS_DESCR
 /begin AXIS_DESCR COM_AXIS VTQR_REDUWhlTqReqSmoothDelay_Nm SWC_FDC_type_CM_single_Nm 18 -10000.0 10000.0 AXIS_PTS_REF ATQR_EL1REDUTs_Y_Nm /end AXIS_DESCR
/end CHARACTERISTIC
/begin CHARACTERISTIC MTQR_EOPDREDUTs_Z_c "" MAP 0x0000 /* @ECU_Address@MTQR_EOPDREDUTs_Z_c@ */ Lookup2D_FLOAT32_IEEE 0 SWC_FDC_type_CM_single_c 0.0 1.0
 /begin AXIS_DESCR COM_AXIS NO_INPUT_QUANTITY SWC_FDC_type_CM_single_rpm 24 -100000.0 100000.0 AXIS_PTS_REF ATQR_EL1FEDUTs_X_rpm /end AXIS_DESCR
 /begin AXIS_DESCR COM_AXIS VTQR_REDUWhlTqReqSmoothDelay_Nm SWC_FDC_type_CM_single_Nm 18 -10000.0 10000.0 AXIS_PTS_REF ATQR_EL1REDUTs_Y_Nm /end AXIS_DESCR
/end CHARACTERISTIC
/begin CHARACTERISTIC MTQR_NL1REDUTs_Z_c "" MAP 0x0000 /* @ECU_Address@MTQR_NL1REDUTs_Z_c@ */ Lookup2D_FLOAT32_IEEE 0 SWC_FDC_type_CM_single_c 0.0 1.0
 /begin AXIS_DESCR COM_AXIS NO_INPUT_QUANTITY SWC_FDC_type_CM_single_rpm 24 -100000.0 100000.0 AXIS_PTS_REF ATQR_NL1FEDUTs_X_rpm /end AXIS_DESCR
 /begin AXIS_DESCR COM_AXIS VTQR_REDUWhlTqReqSmoothDelay_Nm SWC_FDC_type_CM_single_Nm 18 -10000.0 10000.0 AXIS_PTS_REF ATQR_NL1REDUTs_Y_Nm /end AXIS_DESCR
/end CHARACTERISTIC
/begin CHARACTERISTIC MTQR_NL2REDUTs_Z_c "" MAP 0x0000 /* @ECU_Address@MTQR_NL2REDUTs_Z_c@ */ Lookup2D_FLOAT32_IEEE 0 SWC_FDC_type_CM_single_c 0.0 1.0
 /begin AXIS_DESCR COM_AXIS NO_INPUT_QUANTITY SWC_FDC_type_CM_single_rpm 24 -100000.0 100000.0 AXIS_PTS_REF ATQR_NL1FEDUTs_X_rpm /end AXIS_DESCR
 /begin AXIS_DESCR COM_AXIS VTQR_REDUWhlTqReqSmoothDelay_Nm SWC_FDC_type_CM_single_Nm 18 -10000.0 10000.0 AXIS_PTS_REF ATQR_NL1REDUTs_Y_Nm /end AXIS_DESCR
/end CHARACTERISTIC
/begin CHARACTERISTIC MTQR_NL3REDUTs_Z_c "" MAP 0x0000 /* @ECU_Address@MTQR_NL3REDUTs_Z_c@ */ Lookup2D_FLOAT32_IEEE 0 SWC_FDC_type_CM_single_c 0.0 1.0
 /begin AXIS_DESCR COM_AXIS NO_INPUT_QUANTITY SWC_FDC_type_CM_single_rpm 24 -100000.0 100000.0 AXIS_PTS_REF ATQR_NL1FEDUTs_X_rpm /end AXIS_DESCR
 /begin AXIS_DESCR COM_AXIS VTQR_REDUWhlTqReqSmoothDelay_Nm SWC_FDC_type_CM_single_Nm 18 -10000.0 10000.0 AXIS_PTS_REF ATQR_NL1REDUTs_Y_Nm /end AXIS_DESCR
/end CHARACTERISTIC
/begin CHARACTERISTIC MTQR_NL4REDUTs_Z_c "" MAP 0x0000 /* @ECU_Address@MTQR_NL4REDUTs_Z_c@ */ Lookup2D_FLOAT32_IEEE 0 SWC_FDC_type_CM_single_c 0.0 1.0
 /begin AXIS_DESCR COM_AXIS NO_INPUT_QUANTITY SWC_FDC_type_CM_single_rpm 24 -100000.0 100000.0 AXIS_PTS_REF ATQR_NL1FEDUTs_X_rpm /end AXIS_DESCR
 /begin AXIS_DESCR COM_AXIS VTQR_REDUWhlTqReqSmoothDelay_Nm SWC_FDC_type_CM_single_Nm 18 -10000.0 10000.0 AXIS_PTS_REF ATQR_NL1REDUTs_Y_Nm /end AXIS_DESCR
/end CHARACTERISTIC
/begin CHARACTERISTIC MTQR_NL5REDUTs_Z_c "" MAP 0x0000 /* @ECU_Address@MTQR_NL5REDUTs_Z_c@ */ Lookup2D_FLOAT32_IEEE 0 SWC_FDC_type_CM_single_c 0.0 1.0
 /begin AXIS_DESCR COM_AXIS NO_INPUT_QUANTITY SWC_FDC_type_CM_single_rpm 24 -100000.0 100000.0 AXIS_PTS_REF ATQR_NL1FEDUTs_X_rpm /end AXIS_DESCR
 /begin AXIS_DESCR COM_AXIS VTQR_REDUWhlTqReqSmoothDelay_Nm SWC_FDC_type_CM_single_Nm 18 -10000.0 10000.0 AXIS_PTS_REF ATQR_NL1REDUTs_Y_Nm /end AXIS_DESCR
/end CHARACTERISTIC
/begin CHARACTERISTIC MTQR_NOPDREDUTs_Z_c "" MAP 0x0000 /* @ECU_Address@MTQR_NOPDREDUTs_Z_c@ */ Lookup2D_FLOAT32_IEEE 0 SWC_FDC_type_CM_single_c 0.0 1.0
 /begin AXIS_DESCR COM_AXIS NO_INPUT_QUANTITY SWC_FDC_type_CM_single_rpm 24 -100000.0 100000.0 AXIS_PTS_REF ATQR_NL1FEDUTs_X_rpm /end AXIS_DESCR
 /begin AXIS_DESCR COM_AXIS VTQR_REDUWhlTqReqSmoothDelay_Nm SWC_FDC_type_CM_single_Nm 18 -10000.0 10000.0 AXIS_PTS_REF ATQR_NL1REDUTs_Y_Nm /end AXIS_DESCR
/end CHARACTERISTIC
/begin CHARACTERISTIC MTQR_SL1REDUTs_Z_c "" MAP 0x0000 /* @ECU_Address@MTQR_SL1REDUTs_Z_c@ */ Lookup2D_FLOAT32_IEEE 0 SWC_FDC_type_CM_single_c 0.0 1.0
 /begin AXIS_DESCR COM_AXIS NO_INPUT_QUANTITY SWC_FDC_type_CM_single_rpm 24 -100000.0 100000.0 AXIS_PTS_REF ATQR_SL1FEDUTs_X_rpm /end AXIS_DESCR
 /begin AXIS_DESCR COM_AXIS VTQR_REDUWhlTqReqSmoothDelay_Nm SWC_FDC_type_CM_single_Nm 18 -10000.0 10000.0 AXIS_PTS_REF ATQR_SL1REDUTs_Y_Nm /end AXIS_DESCR
/end CHARACTERISTIC
/begin AXIS_PTS ATQR_SL1REDUTs_Y_Nm "" 0x0000 /* @ECU_Address@ATQR_SL1REDUTs_Y_Nm@ */ VTQR_REDUWhlTqReqSmoothDelay_Nm Lookup2D_X_FLOAT32_IEEE 0 SWC_FDC_type_CM_single_Nm 18 -10000.0 10000.0 /end AXIS_PTS
/begin CHARACTERISTIC MTQR_SL2REDUTs_Z_c "" MAP 0x0000 /* @ECU_Address@MTQR_SL2REDUTs_Z_c@ */ Lookup2D_FLOAT32_IEEE 0 SWC_FDC_type_CM_single_c 0.0 1.0
 /begin AXIS_DESCR COM_AXIS NO_INPUT_QUANTITY SWC_FDC_type_CM_single_rpm 24 -100000.0 100000.0 AXIS_PTS_REF ATQR_SL1FEDUTs_X_rpm /end AXIS_DESCR
 /begin AXIS_DESCR COM_AXIS VTQR_REDUWhlTqReqSmoothDelay_Nm SWC_FDC_type_CM_single_Nm 18 -10000.0 10000.0 AXIS_PTS_REF ATQR_SL1REDUTs_Y_Nm /end AXIS_DESCR
/end CHARACTERISTIC
/begin CHARACTERISTIC MTQR_SL3REDUTs_Z_c "" MAP 0x0000 /* @ECU_Address@MTQR_SL3REDUTs_Z_c@ */ Lookup2D_FLOAT32_IEEE 0 SWC_FDC_type_CM_single_c 0.0 1.0
 /begin AXIS_DESCR COM_AXIS NO_INPUT_QUANTITY SWC_FDC_type_CM_single_rpm 24 -100000.0 100000.0 AXIS_PTS_REF ATQR_SL1FEDUTs_X_rpm /end AXIS_DESCR
 /begin AXIS_DESCR COM_AXIS VTQR_REDUWhlTqReqSmoothDelay_Nm SWC_FDC_type_CM_single_Nm 18 -10000.0 10000.0 AXIS_PTS_REF ATQR_SL1REDUTs_Y_Nm /end AXIS_DESCR
/end CHARACTERISTIC
/begin CHARACTERISTIC MTQR_SL4REDUTs_Z_c "" MAP 0x0000 /* @ECU_Address@MTQR_SL4REDUTs_Z_c@ */ Lookup2D_FLOAT32_IEEE 0 SWC_FDC_type_CM_single_c 0.0 1.0
 /begin AXIS_DESCR COM_AXIS NO_INPUT_QUANTITY SWC_FDC_type_CM_single_rpm 24 -100000.0 100000.0 AXIS_PTS_REF ATQR_SL1FEDUTs_X_rpm /end AXIS_DESCR
 /begin AXIS_DESCR COM_AXIS VTQR_REDUWhlTqReqSmoothDelay_Nm SWC_FDC_type_CM_single_Nm 18 -10000.0 10000.0 AXIS_PTS_REF ATQR_SL1REDUTs_Y_Nm /end AXIS_DESCR
/end CHARACTERISTIC
/begin CHARACTERISTIC MTQR_SL5REDUTs_Z_c "" MAP 0x0000 /* @ECU_Address@MTQR_SL5REDUTs_Z_c@ */ Lookup2D_FLOAT32_IEEE 0 SWC_FDC_type_CM_single_c 0.0 1.0
 /begin AXIS_DESCR COM_AXIS NO_INPUT_QUANTITY SWC_FDC_type_CM_single_rpm 24 -100000.0 100000.0 AXIS_PTS_REF ATQR_SL1FEDUTs_X_rpm /end AXIS_DESCR
 /begin AXIS_DESCR COM_AXIS VTQR_REDUWhlTqReqSmoothDelay_Nm SWC_FDC_type_CM_single_Nm 18 -10000.0 10000.0 AXIS_PTS_REF ATQR_SL1REDUTs_Y_Nm /end AXIS_DESCR
/end CHARACTERISTIC
/begin CHARACTERISTIC MTQR_SOPDREDUTs_Z_c "" MAP 0x0000 /* @ECU_Address@MTQR_SOPDREDUTs_Z_c@ */ Lookup2D_FLOAT32_IEEE 0 SWC_FDC_type_CM_single_c 0.0 1.0
 /begin AXIS_DESCR COM_AXIS NO_INPUT_QUANTITY SWC_FDC_type_CM_single_rpm 24 -100000.0 100000.0 AXIS_PTS_REF ATQR_SL1FEDUTs_X_rpm /end AXIS_DESCR
 /begin AXIS_DESCR COM_AXIS VTQR_REDUWhlTqReqSmoothDelay_Nm SWC_FDC_type_CM_single_Nm 18 -10000.0 10000.0 AXIS_PTS_REF ATQR_SL1REDUTs_Y_Nm /end AXIS_DESCR
/end CHARACTERISTIC
/begin CHARACTERISTIC MTQR_RrNegRateLimitDecE_Z_Nm "" MAP 0x0000 /* @ECU_Address@MTQR_RrNegRateLimitDecE_Z_Nm@ */ Lookup2D_FLOAT32_IEEE 0 SWC_FDC_type_CM_single_Nm -10000.0 0.0
 /begin AXIS_DESCR COM_AXIS NO_INPUT_QUANTITY SWC_FDC_type_CM_single_Nm 16 -10000.0 10000.0 AXIS_PTS_REF ATQR_RrNegRateLimitIncN_X_rpm /end AXIS_DESCR
 /begin AXIS_DESCR COM_AXIS VTQR_REDUWhlTqReqSmoothDelay_Nm SWC_FDC_type_CM_single_Nm 8 -10000.0 10000.0 AXIS_PTS_REF ATQR_RrNegRateLimitIncN_Y_Nm /end AXIS_DESCR
/end CHARACTERISTIC
/begin AXIS_PTS ATQR_RrNegRateLimitIncN_Y_Nm "" 0x0000 /* @ECU_Address@ATQR_RrNegRateLimitIncN_Y_Nm@ */ VTQR_REDUWhlTqReqSmoothDelay_Nm Lookup2D_X_FLOAT32_IEEE 0 SWC_FDC_type_CM_single_Nm 8 -10000.0 10000.0 /end AXIS_PTS
/begin AXIS_PTS ATQR_RrNegRateLimitIncN_X_rpm "" 0x0000 /* @ECU_Address@ATQR_RrNegRateLimitIncN_X_rpm@ */ NO_INPUT_QUANTITY Lookup2D_X_FLOAT32_IEEE 0 SWC_FDC_type_CM_single_Nm 16 -10000.0 10000.0 /end AXIS_PTS
/begin CHARACTERISTIC MTQR_RrNegRateLimitDecN_Z_Nm "" MAP 0x0000 /* @ECU_Address@MTQR_RrNegRateLimitDecN_Z_Nm@ */ Lookup2D_FLOAT32_IEEE 0 SWC_FDC_type_CM_single_Nm -10000.0 0.0
 /begin AXIS_DESCR COM_AXIS NO_INPUT_QUANTITY SWC_FDC_type_CM_single_Nm 16 -10000.0 10000.0 AXIS_PTS_REF ATQR_RrNegRateLimitIncN_X_rpm /end AXIS_DESCR
 /begin AXIS_DESCR COM_AXIS VTQR_REDUWhlTqReqSmoothDelay_Nm SWC_FDC_type_CM_single_Nm 8 -10000.0 10000.0 AXIS_PTS_REF ATQR_RrNegRateLimitIncN_Y_Nm /end AXIS_DESCR
/end CHARACTERISTIC
/begin CHARACTERISTIC MTQR_RrNegRateLimitDecS_Z_Nm "" MAP 0x0000 /* @ECU_Address@MTQR_RrNegRateLimitDecS_Z_Nm@ */ Lookup2D_FLOAT32_IEEE 0 SWC_FDC_type_CM_single_Nm -10000.0 0.0
 /begin AXIS_DESCR COM_AXIS NO_INPUT_QUANTITY SWC_FDC_type_CM_single_Nm 16 -10000.0 10000.0 AXIS_PTS_REF ATQR_RrNegRateLimitIncN_X_rpm /end AXIS_DESCR
 /begin AXIS_DESCR COM_AXIS VTQR_REDUWhlTqReqSmoothDelay_Nm SWC_FDC_type_CM_single_Nm 8 -10000.0 10000.0 AXIS_PTS_REF ATQR_RrNegRateLimitIncN_Y_Nm /end AXIS_DESCR
/end CHARACTERISTIC
/begin CHARACTERISTIC MTQR_RrNegRateLimitIncE_Z_Nm "" MAP 0x0000 /* @ECU_Address@MTQR_RrNegRateLimitIncE_Z_Nm@ */ Lookup2D_FLOAT32_IEEE 0 SWC_FDC_type_CM_single_Nm 0.0 10000.0
 /begin AXIS_DESCR COM_AXIS NO_INPUT_QUANTITY SWC_FDC_type_CM_single_Nm 16 -10000.0 10000.0 AXIS_PTS_REF ATQR_RrNegRateLimitIncN_X_rpm /end AXIS_DESCR
 /begin AXIS_DESCR COM_AXIS VTQR_REDUWhlTqReqSmoothDelay_Nm SWC_FDC_type_CM_single_Nm 8 -10000.0 10000.0 AXIS_PTS_REF ATQR_RrNegRateLimitIncN_Y_Nm /end AXIS_DESCR
/end CHARACTERISTIC
/begin CHARACTERISTIC MTQR_RrNegRateLimitIncN_Z_Nm "" MAP 0x0000 /* @ECU_Address@MTQR_RrNegRateLimitIncN_Z_Nm@ */ Lookup2D_FLOAT32_IEEE 0 SWC_FDC_type_CM_single_Nm 0.0 10000.0
 /begin AXIS_DESCR COM_AXIS NO_INPUT_QUANTITY SWC_FDC_type_CM_single_Nm 16 -10000.0 10000.0 AXIS_PTS_REF ATQR_RrNegRateLimitIncN_X_rpm /end AXIS_DESCR
 /begin AXIS_DESCR COM_AXIS VTQR_REDUWhlTqReqSmoothDelay_Nm SWC_FDC_type_CM_single_Nm 8 -10000.0 10000.0 AXIS_PTS_REF ATQR_RrNegRateLimitIncN_Y_Nm /end AXIS_DESCR
/end CHARACTERISTIC
/begin CHARACTERISTIC MTQR_RrNegRateLimitIncS_Z_Nm "" MAP 0x0000 /* @ECU_Address@MTQR_RrNegRateLimitIncS_Z_Nm@ */ Lookup2D_FLOAT32_IEEE 0 SWC_FDC_type_CM_single_Nm 0.0 10000.0
 /begin AXIS_DESCR COM_AXIS NO_INPUT_QUANTITY SWC_FDC_type_CM_single_Nm 16 -10000.0 10000.0 AXIS_PTS_REF ATQR_RrNegRateLimitIncN_X_rpm /end AXIS_DESCR
 /begin AXIS_DESCR COM_AXIS VTQR_REDUWhlTqReqSmoothDelay_Nm SWC_FDC_type_CM_single_Nm 8 -10000.0 10000.0 AXIS_PTS_REF ATQR_RrNegRateLimitIncN_Y_Nm /end AXIS_DESCR
/end CHARACTERISTIC
/begin CHARACTERISTIC MTQR_RrPosRateLimitDecE_Z_Nm "" MAP 0x0000 /* @ECU_Address@MTQR_RrPosRateLimitDecE_Z_Nm@ */ Lookup2D_FLOAT32_IEEE 0 SWC_FDC_type_CM_single_Nm -10000.0 0.0
 /begin AXIS_DESCR COM_AXIS NO_INPUT_QUANTITY SWC_FDC_type_CM_single_rpm 16 -100000.0 100000.0 AXIS_PTS_REF ATQR_RrPosRateLimitIncN_X_rpm /end AXIS_DESCR
 /begin AXIS_DESCR COM_AXIS VTQR_REDUWhlTqReqSmoothDelay_Nm SWC_FDC_type_CM_single_Nm 8 -10000.0 10000.0 AXIS_PTS_REF ATQR_RrPosRateLimitIncN_Y_Nm /end AXIS_DESCR
/end CHARACTERISTIC
/begin AXIS_PTS ATQR_RrPosRateLimitIncN_Y_Nm "" 0x0000 /* @ECU_Address@ATQR_RrPosRateLimitIncN_Y_Nm@ */ VTQR_REDUWhlTqReqSmoothDelay_Nm Lookup2D_X_FLOAT32_IEEE 0 SWC_FDC_type_CM_single_Nm 8 -10000.0 10000.0 /end AXIS_PTS
/begin AXIS_PTS ATQR_RrPosRateLimitIncN_X_rpm "" 0x0000 /* @ECU_Address@ATQR_RrPosRateLimitIncN_X_rpm@ */ NO_INPUT_QUANTITY Lookup2D_X_FLOAT32_IEEE 0 SWC_FDC_type_CM_single_rpm 16 -100000.0 100000.0 /end AXIS_PTS
/begin CHARACTERISTIC MTQR_RrPosRateLimitDecN_Z_Nm "" MAP 0x0000 /* @ECU_Address@MTQR_RrPosRateLimitDecN_Z_Nm@ */ Lookup2D_FLOAT32_IEEE 0 SWC_FDC_type_CM_single_Nm -10000.0 0.0
 /begin AXIS_DESCR COM_AXIS NO_INPUT_QUANTITY SWC_FDC_type_CM_single_rpm 16 -100000.0 100000.0 AXIS_PTS_REF ATQR_RrPosRateLimitIncN_X_rpm /end AXIS_DESCR
 /begin AXIS_DESCR COM_AXIS VTQR_REDUWhlTqReqSmoothDelay_Nm SWC_FDC_type_CM_single_Nm 8 -10000.0 10000.0 AXIS_PTS_REF ATQR_RrPosRateLimitIncN_Y_Nm /end AXIS_DESCR
/end CHARACTERISTIC
/begin CHARACTERISTIC MTQR_RrPosRateLimitDecS_Z_Nm "" MAP 0x0000 /* @ECU_Address@MTQR_RrPosRateLimitDecS_Z_Nm@ */ Lookup2D_FLOAT32_IEEE 0 SWC_FDC_type_CM_single_Nm -10000.0 0.0
 /begin AXIS_DESCR COM_AXIS NO_INPUT_QUANTITY SWC_FDC_type_CM_single_rpm 16 -100000.0 100000.0 AXIS_PTS_REF ATQR_RrPosRateLimitIncN_X_rpm /end AXIS_DESCR
 /begin AXIS_DESCR COM_AXIS VTQR_REDUWhlTqReqSmoothDelay_Nm SWC_FDC_type_CM_single_Nm 8 -10000.0 10000.0 AXIS_PTS_REF ATQR_RrPosRateLimitIncN_Y_Nm /end AXIS_DESCR
/end CHARACTERISTIC
/begin CHARACTERISTIC MTQR_RrPosRateLimitIncE_Z_Nm "" MAP 0x0000 /* @ECU_Address@MTQR_RrPosRateLimitIncE_Z_Nm@ */ Lookup2D_FLOAT32_IEEE 0 SWC_FDC_type_CM_single_Nm 0.0 10000.0
 /begin AXIS_DESCR COM_AXIS NO_INPUT_QUANTITY SWC_FDC_type_CM_single_rpm 16 -100000.0 100000.0 AXIS_PTS_REF ATQR_RrPosRateLimitIncN_X_rpm /end AXIS_DESCR
 /begin AXIS_DESCR COM_AXIS VTQR_REDUWhlTqReqSmoothDelay_Nm SWC_FDC_type_CM_single_Nm 8 -10000.0 10000.0 AXIS_PTS_REF ATQR_RrPosRateLimitIncN_Y_Nm /end AXIS_DESCR
/end CHARACTERISTIC
/begin CHARACTERISTIC MTQR_RrPosRateLimitIncN_Z_Nm "" MAP 0x0000 /* @ECU_Address@MTQR_RrPosRateLimitIncN_Z_Nm@ */ Lookup2D_FLOAT32_IEEE 0 SWC_FDC_type_CM_single_Nm 0.0 10000.0
 /begin AXIS_DESCR COM_AXIS NO_INPUT_QUANTITY SWC_FDC_type_CM_single_rpm 16 -100000.0 100000.0 AXIS_PTS_REF ATQR_RrPosRateLimitIncN_X_rpm /end AXIS_DESCR
 /begin AXIS_DESCR COM_AXIS VTQR_REDUWhlTqReqSmoothDelay_Nm SWC_FDC_type_CM_single_Nm 8 -10000.0 10000.0 AXIS_PTS_REF ATQR_RrPosRateLimitIncN_Y_Nm /end AXIS_DESCR
/end CHARACTERISTIC
/begin CHARACTERISTIC MTQR_RrPosRateLimitIncS_Z_Nm "" MAP 0x0000 /* @ECU_Address@MTQR_RrPosRateLimitIncS_Z_Nm@ */ Lookup2D_FLOAT32_IEEE 0 SWC_FDC_type_CM_single_Nm 0.0 10000.0
 /begin AXIS_DESCR COM_AXIS NO_INPUT_QUANTITY SWC_FDC_type_CM_single_rpm 16 -100000.0 100000.0 AXIS_PTS_REF ATQR_RrPosRateLimitIncN_X_rpm /end AXIS_DESCR
 /begin AXIS_DESCR COM_AXIS VTQR_REDUWhlTqReqSmoothDelay_Nm SWC_FDC_type_CM_single_Nm 8 -10000.0 10000.0 AXIS_PTS_REF ATQR_RrPosRateLimitIncN_Y_Nm /end AXIS_DESCR
/end CHARACTERISTIC
/begin CHARACTERISTIC MTQR_EL1REDUTqDecSR_Z_Nm "" MAP 0x0000 /* @ECU_Address@MTQR_EL1REDUTqDecSR_Z_Nm@ */ Lookup2D_FLOAT32_IEEE 0 SWC_FDC_type_CM_single_Nm -100000.0 0.0
 /begin AXIS_DESCR COM_AXIS NO_INPUT_QUANTITY SWC_FDC_type_CM_single_rpm 24 -100000.0 100000.0 AXIS_PTS_REF ATQR_EL1FEDUTqIncSR_X_rpm /end AXIS_DESCR
 /begin AXIS_DESCR COM_AXIS VTQR_REDUWhlTqReqSmoothDelay_Nm SWC_FDC_type_CM_single_Nm 18 -10000.0 10000.0 AXIS_PTS_REF ATQR_EL1REDUTqDecSR_Y_Nm /end AXIS_DESCR
/end CHARACTERISTIC
/begin AXIS_PTS ATQR_EL1REDUTqDecSR_Y_Nm "" 0x0000 /* @ECU_Address@ATQR_EL1REDUTqDecSR_Y_Nm@ */ VTQR_REDUWhlTqReqSmoothDelay_Nm Lookup2D_X_FLOAT32_IEEE 0 SWC_FDC_type_CM_single_Nm 18 -10000.0 10000.0 /end AXIS_PTS
/begin CHARACTERISTIC MTQR_EL2REDUTqDecSR_Z_Nm "" MAP 0x0000 /* @ECU_Address@MTQR_EL2REDUTqDecSR_Z_Nm@ */ Lookup2D_FLOAT32_IEEE 0 SWC_FDC_type_CM_single_Nm -100000.0 0.0
 /begin AXIS_DESCR COM_AXIS NO_INPUT_QUANTITY SWC_FDC_type_CM_single_rpm 24 -100000.0 100000.0 AXIS_PTS_REF ATQR_EL1FEDUTqIncSR_X_rpm /end AXIS_DESCR
 /begin AXIS_DESCR COM_AXIS VTQR_REDUWhlTqReqSmoothDelay_Nm SWC_FDC_type_CM_single_Nm 18 -10000.0 10000.0 AXIS_PTS_REF ATQR_EL1REDUTqDecSR_Y_Nm /end AXIS_DESCR
/end CHARACTERISTIC
/begin CHARACTERISTIC MTQR_EL3REDUTqDecSR_Z_Nm "" MAP 0x0000 /* @ECU_Address@MTQR_EL3REDUTqDecSR_Z_Nm@ */ Lookup2D_FLOAT32_IEEE 0 SWC_FDC_type_CM_single_Nm -100000.0 0.0
 /begin AXIS_DESCR COM_AXIS NO_INPUT_QUANTITY SWC_FDC_type_CM_single_rpm 24 -100000.0 100000.0 AXIS_PTS_REF ATQR_EL1FEDUTqIncSR_X_rpm /end AXIS_DESCR
 /begin AXIS_DESCR COM_AXIS VTQR_REDUWhlTqReqSmoothDelay_Nm SWC_FDC_type_CM_single_Nm 18 -10000.0 10000.0 AXIS_PTS_REF ATQR_EL1REDUTqDecSR_Y_Nm /end AXIS_DESCR
/end CHARACTERISTIC
/begin CHARACTERISTIC MTQR_EL4REDUTqDecSR_Z_Nm "" MAP 0x0000 /* @ECU_Address@MTQR_EL4REDUTqDecSR_Z_Nm@ */ Lookup2D_FLOAT32_IEEE 0 SWC_FDC_type_CM_single_Nm -100000.0 0.0
 /begin AXIS_DESCR COM_AXIS NO_INPUT_QUANTITY SWC_FDC_type_CM_single_rpm 24 -100000.0 100000.0 AXIS_PTS_REF ATQR_EL1FEDUTqIncSR_X_rpm /end AXIS_DESCR
 /begin AXIS_DESCR COM_AXIS VTQR_REDUWhlTqReqSmoothDelay_Nm SWC_FDC_type_CM_single_Nm 18 -10000.0 10000.0 AXIS_PTS_REF ATQR_EL1REDUTqDecSR_Y_Nm /end AXIS_DESCR
/end CHARACTERISTIC
/begin CHARACTERISTIC MTQR_EL5REDUTqDecSR_Z_Nm "" MAP 0x0000 /* @ECU_Address@MTQR_EL5REDUTqDecSR_Z_Nm@ */ Lookup2D_FLOAT32_IEEE 0 SWC_FDC_type_CM_single_Nm -100000.0 0.0
 /begin AXIS_DESCR COM_AXIS NO_INPUT_QUANTITY SWC_FDC_type_CM_single_rpm 24 -100000.0 100000.0 AXIS_PTS_REF ATQR_EL1FEDUTqIncSR_X_rpm /end AXIS_DESCR
 /begin AXIS_DESCR COM_AXIS VTQR_REDUWhlTqReqSmoothDelay_Nm SWC_FDC_type_CM_single_Nm 18 -10000.0 10000.0 AXIS_PTS_REF ATQR_EL1REDUTqDecSR_Y_Nm /end AXIS_DESCR
/end CHARACTERISTIC
/begin CHARACTERISTIC MTQR_EOPDREDUTqDecSR_Z_Nm "" MAP 0x0000 /* @ECU_Address@MTQR_EOPDREDUTqDecSR_Z_Nm@ */ Lookup2D_FLOAT32_IEEE 0 SWC_FDC_type_CM_single_Nm -100000.0 0.0
 /begin AXIS_DESCR COM_AXIS NO_INPUT_QUANTITY SWC_FDC_type_CM_single_rpm 24 -100000.0 100000.0 AXIS_PTS_REF ATQR_EL1FEDUTqIncSR_X_rpm /end AXIS_DESCR
 /begin AXIS_DESCR COM_AXIS VTQR_REDUWhlTqReqSmoothDelay_Nm SWC_FDC_type_CM_single_Nm 18 -10000.0 10000.0 AXIS_PTS_REF ATQR_EL1REDUTqDecSR_Y_Nm /end AXIS_DESCR
/end CHARACTERISTIC
/begin CHARACTERISTIC MTQR_EL1REDUTqIncSR_Z_Nm "" MAP 0x0000 /* @ECU_Address@MTQR_EL1REDUTqIncSR_Z_Nm@ */ Lookup2D_FLOAT32_IEEE 0 SWC_FDC_type_CM_single_Nm 0.0 100000.0
 /begin AXIS_DESCR COM_AXIS NO_INPUT_QUANTITY SWC_FDC_type_CM_single_rpm 24 -100000.0 100000.0 AXIS_PTS_REF ATQR_EL1FEDUTqIncSR_X_rpm /end AXIS_DESCR
 /begin AXIS_DESCR COM_AXIS NO_INPUT_QUANTITY SWC_FDC_type_CM_single_Nm 17 0.0 120.0 AXIS_PTS_REF ATQR_EL1FEDUTqIncSR_Y_pct /end AXIS_DESCR
/end CHARACTERISTIC
/begin CHARACTERISTIC MTQR_EL2REDUTqIncSR_Z_Nm "" MAP 0x0000 /* @ECU_Address@MTQR_EL2REDUTqIncSR_Z_Nm@ */ Lookup2D_FLOAT32_IEEE 0 SWC_FDC_type_CM_single_Nm 0.0 100000.0
 /begin AXIS_DESCR COM_AXIS NO_INPUT_QUANTITY SWC_FDC_type_CM_single_rpm 24 -100000.0 100000.0 AXIS_PTS_REF ATQR_EL1FEDUTqIncSR_X_rpm /end AXIS_DESCR
 /begin AXIS_DESCR COM_AXIS NO_INPUT_QUANTITY SWC_FDC_type_CM_single_Nm 17 0.0 120.0 AXIS_PTS_REF ATQR_EL1FEDUTqIncSR_Y_pct /end AXIS_DESCR
/end CHARACTERISTIC
/begin CHARACTERISTIC MTQR_EL3REDUTqIncSR_Z_Nm "" MAP 0x0000 /* @ECU_Address@MTQR_EL3REDUTqIncSR_Z_Nm@ */ Lookup2D_FLOAT32_IEEE 0 SWC_FDC_type_CM_single_Nm 0.0 100000.0
 /begin AXIS_DESCR COM_AXIS NO_INPUT_QUANTITY SWC_FDC_type_CM_single_rpm 24 -100000.0 100000.0 AXIS_PTS_REF ATQR_EL1FEDUTqIncSR_X_rpm /end AXIS_DESCR
 /begin AXIS_DESCR COM_AXIS NO_INPUT_QUANTITY SWC_FDC_type_CM_single_Nm 17 0.0 120.0 AXIS_PTS_REF ATQR_EL1FEDUTqIncSR_Y_pct /end AXIS_DESCR
/end CHARACTERISTIC
/begin CHARACTERISTIC MTQR_EL4REDUTqIncSR_Z_Nm "" MAP 0x0000 /* @ECU_Address@MTQR_EL4REDUTqIncSR_Z_Nm@ */ Lookup2D_FLOAT32_IEEE 0 SWC_FDC_type_CM_single_Nm 0.0 100000.0
 /begin AXIS_DESCR COM_AXIS NO_INPUT_QUANTITY SWC_FDC_type_CM_single_rpm 24 -100000.0 100000.0 AXIS_PTS_REF ATQR_EL1FEDUTqIncSR_X_rpm /end AXIS_DESCR
 /begin AXIS_DESCR COM_AXIS NO_INPUT_QUANTITY SWC_FDC_type_CM_single_Nm 17 0.0 120.0 AXIS_PTS_REF ATQR_EL1FEDUTqIncSR_Y_pct /end AXIS_DESCR
/end CHARACTERISTIC
/begin CHARACTERISTIC MTQR_EL5REDUTqIncSR_Z_Nm "" MAP 0x0000 /* @ECU_Address@MTQR_EL5REDUTqIncSR_Z_Nm@ */ Lookup2D_FLOAT32_IEEE 0 SWC_FDC_type_CM_single_Nm 0.0 100000.0
 /begin AXIS_DESCR COM_AXIS NO_INPUT_QUANTITY SWC_FDC_type_CM_single_rpm 24 -100000.0 100000.0 AXIS_PTS_REF ATQR_EL1FEDUTqIncSR_X_rpm /end AXIS_DESCR
 /begin AXIS_DESCR COM_AXIS NO_INPUT_QUANTITY SWC_FDC_type_CM_single_Nm 17 0.0 120.0 AXIS_PTS_REF ATQR_EL1FEDUTqIncSR_Y_pct /end AXIS_DESCR
/end CHARACTERISTIC
/begin CHARACTERISTIC MTQR_EOPDREDUTqIncSR_Z_Nm "" MAP 0x0000 /* @ECU_Address@MTQR_EOPDREDUTqIncSR_Z_Nm@ */ Lookup2D_FLOAT32_IEEE 0 SWC_FDC_type_CM_single_Nm 0.0 100000.0
 /begin AXIS_DESCR COM_AXIS NO_INPUT_QUANTITY SWC_FDC_type_CM_single_rpm 24 -100000.0 100000.0 AXIS_PTS_REF ATQR_EL1FEDUTqIncSR_X_rpm /end AXIS_DESCR
 /begin AXIS_DESCR COM_AXIS NO_INPUT_QUANTITY SWC_FDC_type_CM_single_Nm 17 0.0 120.0 AXIS_PTS_REF ATQR_EL1FEDUTqIncSR_Y_pct /end AXIS_DESCR
/end CHARACTERISTIC
/begin CHARACTERISTIC MTQR_NL1REDUTqDecSR_Z_Nm "" MAP 0x0000 /* @ECU_Address@MTQR_NL1REDUTqDecSR_Z_Nm@ */ Lookup2D_FLOAT32_IEEE 0 SWC_FDC_type_CM_single_Nm -100000.0 0.0
 /begin AXIS_DESCR COM_AXIS NO_INPUT_QUANTITY SWC_FDC_type_CM_single_rpm 24 -100000.0 100000.0 AXIS_PTS_REF ATQR_NL1FEDUTqIncSR_X_rpm /end AXIS_DESCR
 /begin AXIS_DESCR COM_AXIS VTQR_REDUWhlTqReqSmoothDelay_Nm SWC_FDC_type_CM_single_Nm 18 -10000.0 10000.0 AXIS_PTS_REF ATQR_NL1REDUTqDecSR_Y_Nm /end AXIS_DESCR
/end CHARACTERISTIC
/begin CHARACTERISTIC MTQR_NL2REDUTqDecSR_Z_Nm "" MAP 0x0000 /* @ECU_Address@MTQR_NL2REDUTqDecSR_Z_Nm@ */ Lookup2D_FLOAT32_IEEE 0 SWC_FDC_type_CM_single_Nm -100000.0 0.0
 /begin AXIS_DESCR COM_AXIS NO_INPUT_QUANTITY SWC_FDC_type_CM_single_rpm 24 -100000.0 100000.0 AXIS_PTS_REF ATQR_NL1FEDUTqIncSR_X_rpm /end AXIS_DESCR
 /begin AXIS_DESCR COM_AXIS VTQR_REDUWhlTqReqSmoothDelay_Nm SWC_FDC_type_CM_single_Nm 18 -10000.0 10000.0 AXIS_PTS_REF ATQR_NL1REDUTqDecSR_Y_Nm /end AXIS_DESCR
/end CHARACTERISTIC
/begin CHARACTERISTIC MTQR_NL3REDUTqDecSR_Z_Nm "" MAP 0x0000 /* @ECU_Address@MTQR_NL3REDUTqDecSR_Z_Nm@ */ Lookup2D_FLOAT32_IEEE 0 SWC_FDC_type_CM_single_Nm -100000.0 0.0
 /begin AXIS_DESCR COM_AXIS NO_INPUT_QUANTITY SWC_FDC_type_CM_single_rpm 24 -100000.0 100000.0 AXIS_PTS_REF ATQR_NL1FEDUTqIncSR_X_rpm /end AXIS_DESCR
 /begin AXIS_DESCR COM_AXIS VTQR_REDUWhlTqReqSmoothDelay_Nm SWC_FDC_type_CM_single_Nm 18 -10000.0 10000.0 AXIS_PTS_REF ATQR_NL1REDUTqDecSR_Y_Nm /end AXIS_DESCR
/end CHARACTERISTIC
/begin CHARACTERISTIC MTQR_NL4REDUTqDecSR_Z_Nm "" MAP 0x0000 /* @ECU_Address@MTQR_NL4REDUTqDecSR_Z_Nm@ */ Lookup2D_FLOAT32_IEEE 0 SWC_FDC_type_CM_single_Nm -100000.0 0.0
 /begin AXIS_DESCR COM_AXIS NO_INPUT_QUANTITY SWC_FDC_type_CM_single_rpm 24 -100000.0 100000.0 AXIS_PTS_REF ATQR_NL1FEDUTqIncSR_X_rpm /end AXIS_DESCR
 /begin AXIS_DESCR COM_AXIS VTQR_REDUWhlTqReqSmoothDelay_Nm SWC_FDC_type_CM_single_Nm 18 -10000.0 10000.0 AXIS_PTS_REF ATQR_NL1REDUTqDecSR_Y_Nm /end AXIS_DESCR
/end CHARACTERISTIC
/begin CHARACTERISTIC MTQR_NL5REDUTqDecSR_Z_Nm "" MAP 0x0000 /* @ECU_Address@MTQR_NL5REDUTqDecSR_Z_Nm@ */ Lookup2D_FLOAT32_IEEE 0 SWC_FDC_type_CM_single_Nm -100000.0 0.0
 /begin AXIS_DESCR COM_AXIS NO_INPUT_QUANTITY SWC_FDC_type_CM_single_rpm 24 -100000.0 100000.0 AXIS_PTS_REF ATQR_NL1FEDUTqIncSR_X_rpm /end AXIS_DESCR
 /begin AXIS_DESCR COM_AXIS VTQR_REDUWhlTqReqSmoothDelay_Nm SWC_FDC_type_CM_single_Nm 18 -10000.0 10000.0 AXIS_PTS_REF ATQR_NL1REDUTqDecSR_Y_Nm /end AXIS_DESCR
/end CHARACTERISTIC
/begin CHARACTERISTIC MTQR_NOPDREDUTqDecSR_Z_Nm "" MAP 0x0000 /* @ECU_Address@MTQR_NOPDREDUTqDecSR_Z_Nm@ */ Lookup2D_FLOAT32_IEEE 0 SWC_FDC_type_CM_single_Nm -100000.0 0.0
 /begin AXIS_DESCR COM_AXIS NO_INPUT_QUANTITY SWC_FDC_type_CM_single_rpm 24 -100000.0 100000.0 AXIS_PTS_REF ATQR_NL1FEDUTqIncSR_X_rpm /end AXIS_DESCR
 /begin AXIS_DESCR COM_AXIS VTQR_REDUWhlTqReqSmoothDelay_Nm SWC_FDC_type_CM_single_Nm 18 -10000.0 10000.0 AXIS_PTS_REF ATQR_NL1REDUTqDecSR_Y_Nm /end AXIS_DESCR
/end CHARACTERISTIC
/begin CHARACTERISTIC MTQR_NL1REDUTqIncSR_Z_Nm "" MAP 0x0000 /* @ECU_Address@MTQR_NL1REDUTqIncSR_Z_Nm@ */ Lookup2D_FLOAT32_IEEE 0 SWC_FDC_type_CM_single_Nm 0.0 100000.0
 /begin AXIS_DESCR COM_AXIS NO_INPUT_QUANTITY SWC_FDC_type_CM_single_rpm 24 -100000.0 100000.0 AXIS_PTS_REF ATQR_NL1FEDUTqIncSR_X_rpm /end AXIS_DESCR
 /begin AXIS_DESCR COM_AXIS NO_INPUT_QUANTITY SWC_FDC_type_CM_single_Nm 17 0.0 120.0 AXIS_PTS_REF ATQR_NL1FEDUTqIncSR_Y_pct /end AXIS_DESCR
/end CHARACTERISTIC
/begin CHARACTERISTIC MTQR_NL2REDUTqIncSR_Z_Nm "" MAP 0x0000 /* @ECU_Address@MTQR_NL2REDUTqIncSR_Z_Nm@ */ Lookup2D_FLOAT32_IEEE 0 SWC_FDC_type_CM_single_Nm 0.0 100000.0
 /begin AXIS_DESCR COM_AXIS NO_INPUT_QUANTITY SWC_FDC_type_CM_single_rpm 24 -100000.0 100000.0 AXIS_PTS_REF ATQR_NL1FEDUTqIncSR_X_rpm /end AXIS_DESCR
 /begin AXIS_DESCR COM_AXIS NO_INPUT_QUANTITY SWC_FDC_type_CM_single_Nm 17 0.0 120.0 AXIS_PTS_REF ATQR_NL1FEDUTqIncSR_Y_pct /end AXIS_DESCR
/end CHARACTERISTIC
/begin CHARACTERISTIC MTQR_NL3REDUTqIncSR_Z_Nm "" MAP 0x0000 /* @ECU_Address@MTQR_NL3REDUTqIncSR_Z_Nm@ */ Lookup2D_FLOAT32_IEEE 0 SWC_FDC_type_CM_single_Nm 0.0 100000.0
 /begin AXIS_DESCR COM_AXIS NO_INPUT_QUANTITY SWC_FDC_type_CM_single_rpm 24 -100000.0 100000.0 AXIS_PTS_REF ATQR_NL1FEDUTqIncSR_X_rpm /end AXIS_DESCR
 /begin AXIS_DESCR COM_AXIS NO_INPUT_QUANTITY SWC_FDC_type_CM_single_Nm 17 0.0 120.0 AXIS_PTS_REF ATQR_NL1FEDUTqIncSR_Y_pct /end AXIS_DESCR
/end CHARACTERISTIC
/begin CHARACTERISTIC MTQR_NL4REDUTqIncSR_Z_Nm "" MAP 0x0000 /* @ECU_Address@MTQR_NL4REDUTqIncSR_Z_Nm@ */ Lookup2D_FLOAT32_IEEE 0 SWC_FDC_type_CM_single_Nm 0.0 100000.0
 /begin AXIS_DESCR COM_AXIS NO_INPUT_QUANTITY SWC_FDC_type_CM_single_rpm 24 -100000.0 100000.0 AXIS_PTS_REF ATQR_NL1FEDUTqIncSR_X_rpm /end AXIS_DESCR
 /begin AXIS_DESCR COM_AXIS NO_INPUT_QUANTITY SWC_FDC_type_CM_single_Nm 17 0.0 120.0 AXIS_PTS_REF ATQR_NL1FEDUTqIncSR_Y_pct /end AXIS_DESCR
/end CHARACTERISTIC
/begin CHARACTERISTIC MTQR_NL5REDUTqIncSR_Z_Nm "" MAP 0x0000 /* @ECU_Address@MTQR_NL5REDUTqIncSR_Z_Nm@ */ Lookup2D_FLOAT32_IEEE 0 SWC_FDC_type_CM_single_Nm 0.0 100000.0
 /begin AXIS_DESCR COM_AXIS NO_INPUT_QUANTITY SWC_FDC_type_CM_single_rpm 24 -100000.0 100000.0 AXIS_PTS_REF ATQR_NL1FEDUTqIncSR_X_rpm /end AXIS_DESCR
 /begin AXIS_DESCR COM_AXIS NO_INPUT_QUANTITY SWC_FDC_type_CM_single_Nm 17 0.0 120.0 AXIS_PTS_REF ATQR_NL1FEDUTqIncSR_Y_pct /end AXIS_DESCR
/end CHARACTERISTIC
/begin CHARACTERISTIC MTQR_NOPDREDUTqIncSR_Z_Nm "" MAP 0x0000 /* @ECU_Address@MTQR_NOPDREDUTqIncSR_Z_Nm@ */ Lookup2D_FLOAT32_IEEE 0 SWC_FDC_type_CM_single_Nm 0.0 100000.0
 /begin AXIS_DESCR COM_AXIS NO_INPUT_QUANTITY SWC_FDC_type_CM_single_rpm 24 -100000.0 100000.0 AXIS_PTS_REF ATQR_NL1FEDUTqIncSR_X_rpm /end AXIS_DESCR
 /begin AXIS_DESCR COM_AXIS NO_INPUT_QUANTITY SWC_FDC_type_CM_single_Nm 17 0.0 120.0 AXIS_PTS_REF ATQR_NL1FEDUTqIncSR_Y_pct /end AXIS_DESCR
/end CHARACTERISTIC
/begin CHARACTERISTIC MTQR_SL1REDUTqDecSR_Z_Nm "" MAP 0x0000 /* @ECU_Address@MTQR_SL1REDUTqDecSR_Z_Nm@ */ Lookup2D_FLOAT32_IEEE 0 SWC_FDC_type_CM_single_Nm -100000.0 0.0
 /begin AXIS_DESCR COM_AXIS NO_INPUT_QUANTITY SWC_FDC_type_CM_single_rpm 24 -100000.0 100000.0 AXIS_PTS_REF ATQR_SL1FEDUTqIncSR_X_rpm /end AXIS_DESCR
 /begin AXIS_DESCR COM_AXIS VTQR_REDUWhlTqReqSmoothDelay_Nm SWC_FDC_type_CM_single_Nm 18 -10000.0 10000.0 AXIS_PTS_REF ATQR_SL1REDUTqDecSR_Y_Nm /end AXIS_DESCR
/end CHARACTERISTIC
/begin AXIS_PTS ATQR_SL1REDUTqDecSR_Y_Nm "" 0x0000 /* @ECU_Address@ATQR_SL1REDUTqDecSR_Y_Nm@ */ VTQR_REDUWhlTqReqSmoothDelay_Nm Lookup2D_X_FLOAT32_IEEE 0 SWC_FDC_type_CM_single_Nm 18 -10000.0 10000.0 /end AXIS_PTS
/begin CHARACTERISTIC MTQR_SL2REDUTqDecSR_Z_Nm "" MAP 0x0000 /* @ECU_Address@MTQR_SL2REDUTqDecSR_Z_Nm@ */ Lookup2D_FLOAT32_IEEE 0 SWC_FDC_type_CM_single_Nm -100000.0 0.0
 /begin AXIS_DESCR COM_AXIS NO_INPUT_QUANTITY SWC_FDC_type_CM_single_rpm 24 -100000.0 100000.0 AXIS_PTS_REF ATQR_SL1FEDUTqIncSR_X_rpm /end AXIS_DESCR
 /begin AXIS_DESCR COM_AXIS VTQR_REDUWhlTqReqSmoothDelay_Nm SWC_FDC_type_CM_single_Nm 18 -10000.0 10000.0 AXIS_PTS_REF ATQR_SL1REDUTqDecSR_Y_Nm /end AXIS_DESCR
/end CHARACTERISTIC
/begin CHARACTERISTIC MTQR_SL3REDUTqDecSR_Z_Nm "" MAP 0x0000 /* @ECU_Address@MTQR_SL3REDUTqDecSR_Z_Nm@ */ Lookup2D_FLOAT32_IEEE 0 SWC_FDC_type_CM_single_Nm -100000.0 0.0
 /begin AXIS_DESCR COM_AXIS NO_INPUT_QUANTITY SWC_FDC_type_CM_single_rpm 24 -100000.0 100000.0 AXIS_PTS_REF ATQR_SL1FEDUTqIncSR_X_rpm /end AXIS_DESCR
 /begin AXIS_DESCR COM_AXIS VTQR_REDUWhlTqReqSmoothDelay_Nm SWC_FDC_type_CM_single_Nm 18 -10000.0 10000.0 AXIS_PTS_REF ATQR_SL1REDUTqDecSR_Y_Nm /end AXIS_DESCR
/end CHARACTERISTIC
/begin CHARACTERISTIC MTQR_SL4REDUTqDecSR_Z_Nm "" MAP 0x0000 /* @ECU_Address@MTQR_SL4REDUTqDecSR_Z_Nm@ */ Lookup2D_FLOAT32_IEEE 0 SWC_FDC_type_CM_single_Nm -100000.0 0.0
 /begin AXIS_DESCR COM_AXIS NO_INPUT_QUANTITY SWC_FDC_type_CM_single_rpm 24 -100000.0 100000.0 AXIS_PTS_REF ATQR_SL1FEDUTqIncSR_X_rpm /end AXIS_DESCR
 /begin AXIS_DESCR COM_AXIS VTQR_REDUWhlTqReqSmoothDelay_Nm SWC_FDC_type_CM_single_Nm 18 -10000.0 10000.0 AXIS_PTS_REF ATQR_SL1REDUTqDecSR_Y_Nm /end AXIS_DESCR
/end CHARACTERISTIC
/begin CHARACTERISTIC MTQR_SL5REDUTqDecSR_Z_Nm "" MAP 0x0000 /* @ECU_Address@MTQR_SL5REDUTqDecSR_Z_Nm@ */ Lookup2D_FLOAT32_IEEE 0 SWC_FDC_type_CM_single_Nm -100000.0 0.0
 /begin AXIS_DESCR COM_AXIS NO_INPUT_QUANTITY SWC_FDC_type_CM_single_rpm 24 -100000.0 100000.0 AXIS_PTS_REF ATQR_SL1FEDUTqIncSR_X_rpm /end AXIS_DESCR
 /begin AXIS_DESCR COM_AXIS VTQR_REDUWhlTqReqSmoothDelay_Nm SWC_FDC_type_CM_single_Nm 18 -10000.0 10000.0 AXIS_PTS_REF ATQR_SL1REDUTqDecSR_Y_Nm /end AXIS_DESCR
/end CHARACTERISTIC
/begin CHARACTERISTIC MTQR_SOPDREDUTqDecSR_Z_Nm "" MAP 0x0000 /* @ECU_Address@MTQR_SOPDREDUTqDecSR_Z_Nm@ */ Lookup2D_FLOAT32_IEEE 0 SWC_FDC_type_CM_single_Nm -100000.0 0.0
 /begin AXIS_DESCR COM_AXIS NO_INPUT_QUANTITY SWC_FDC_type_CM_single_rpm 24 -100000.0 100000.0 AXIS_PTS_REF ATQR_SL1FEDUTqIncSR_X_rpm /end AXIS_DESCR
 /begin AXIS_DESCR COM_AXIS VTQR_REDUWhlTqReqSmoothDelay_Nm SWC_FDC_type_CM_single_Nm 18 -10000.0 10000.0 AXIS_PTS_REF ATQR_SL1REDUTqDecSR_Y_Nm /end AXIS_DESCR
/end CHARACTERISTIC
/begin CHARACTERISTIC MTQR_SL1REDUTqIncSR_Z_Nm "" MAP 0x0000 /* @ECU_Address@MTQR_SL1REDUTqIncSR_Z_Nm@ */ Lookup2D_FLOAT32_IEEE 0 SWC_FDC_type_CM_single_Nm 0.0 100000.0
 /begin AXIS_DESCR COM_AXIS NO_INPUT_QUANTITY SWC_FDC_type_CM_single_rpm 24 -100000.0 100000.0 AXIS_PTS_REF ATQR_SL1FEDUTqIncSR_X_rpm /end AXIS_DESCR
 /begin AXIS_DESCR COM_AXIS NO_INPUT_QUANTITY SWC_FDC_type_CM_single_Nm 17 0.0 120.0 AXIS_PTS_REF ATQR_SL1FEDUTqIncSR_Y_pct /end AXIS_DESCR
/end CHARACTERISTIC
/begin CHARACTERISTIC MTQR_SL2REDUTqIncSR_Z_Nm "" MAP 0x0000 /* @ECU_Address@MTQR_SL2REDUTqIncSR_Z_Nm@ */ Lookup2D_FLOAT32_IEEE 0 SWC_FDC_type_CM_single_Nm 0.0 100000.0
 /begin AXIS_DESCR COM_AXIS NO_INPUT_QUANTITY SWC_FDC_type_CM_single_rpm 24 -100000.0 100000.0 AXIS_PTS_REF ATQR_SL1FEDUTqIncSR_X_rpm /end AXIS_DESCR
 /begin AXIS_DESCR COM_AXIS NO_INPUT_QUANTITY SWC_FDC_type_CM_single_Nm 17 0.0 120.0 AXIS_PTS_REF ATQR_SL1FEDUTqIncSR_Y_pct /end AXIS_DESCR
/end CHARACTERISTIC
/begin CHARACTERISTIC MTQR_SL3REDUTqIncSR_Z_Nm "" MAP 0x0000 /* @ECU_Address@MTQR_SL3REDUTqIncSR_Z_Nm@ */ Lookup2D_FLOAT32_IEEE 0 SWC_FDC_type_CM_single_Nm 0.0 100000.0
 /begin AXIS_DESCR COM_AXIS NO_INPUT_QUANTITY SWC_FDC_type_CM_single_rpm 24 -100000.0 100000.0 AXIS_PTS_REF ATQR_SL1FEDUTqIncSR_X_rpm /end AXIS_DESCR
 /begin AXIS_DESCR COM_AXIS NO_INPUT_QUANTITY SWC_FDC_type_CM_single_Nm 17 0.0 120.0 AXIS_PTS_REF ATQR_SL1FEDUTqIncSR_Y_pct /end AXIS_DESCR
/end CHARACTERISTIC
/begin CHARACTERISTIC MTQR_SL4REDUTqIncSR_Z_Nm "" MAP 0x0000 /* @ECU_Address@MTQR_SL4REDUTqIncSR_Z_Nm@ */ Lookup2D_FLOAT32_IEEE 0 SWC_FDC_type_CM_single_Nm 0.0 200000.0
 /begin AXIS_DESCR COM_AXIS NO_INPUT_QUANTITY SWC_FDC_type_CM_single_rpm 24 -100000.0 100000.0 AXIS_PTS_REF ATQR_SL1FEDUTqIncSR_X_rpm /end AXIS_DESCR
 /begin AXIS_DESCR COM_AXIS NO_INPUT_QUANTITY SWC_FDC_type_CM_single_Nm 17 0.0 120.0 AXIS_PTS_REF ATQR_SL1FEDUTqIncSR_Y_pct /end AXIS_DESCR
/end CHARACTERISTIC
/begin CHARACTERISTIC MTQR_SL5REDUTqIncSR_Z_Nm "" MAP 0x0000 /* @ECU_Address@MTQR_SL5REDUTqIncSR_Z_Nm@ */ Lookup2D_FLOAT32_IEEE 0 SWC_FDC_type_CM_single_Nm 0.0 200000.0
 /begin AXIS_DESCR COM_AXIS NO_INPUT_QUANTITY SWC_FDC_type_CM_single_rpm 24 -100000.0 100000.0 AXIS_PTS_REF ATQR_SL1FEDUTqIncSR_X_rpm /end AXIS_DESCR
 /begin AXIS_DESCR COM_AXIS NO_INPUT_QUANTITY SWC_FDC_type_CM_single_Nm 17 0.0 120.0 AXIS_PTS_REF ATQR_SL1FEDUTqIncSR_Y_pct /end AXIS_DESCR
/end CHARACTERISTIC
/begin CHARACTERISTIC MTQR_SOPDREDUTqIncSR_Z_Nm "" MAP 0x0000 /* @ECU_Address@MTQR_SOPDREDUTqIncSR_Z_Nm@ */ Lookup2D_FLOAT32_IEEE 0 SWC_FDC_type_CM_single_Nm 0.0 200000.0
 /begin AXIS_DESCR COM_AXIS NO_INPUT_QUANTITY SWC_FDC_type_CM_single_rpm 24 -100000.0 100000.0 AXIS_PTS_REF ATQR_SL1FEDUTqIncSR_X_rpm /end AXIS_DESCR
 /begin AXIS_DESCR COM_AXIS NO_INPUT_QUANTITY SWC_FDC_type_CM_single_Nm 17 0.0 120.0 AXIS_PTS_REF ATQR_SL1FEDUTqIncSR_Y_pct /end AXIS_DESCR
/end CHARACTERISTIC
/begin CHARACTERISTIC MTQD_ECOTqMapD_Z_Nm "" MAP 0x0000 /* @ECU_Address@MTQD_ECOTqMapD_Z_Nm@ */ Lookup2D_FLOAT32_IEEE 0 SWC_FDC_type_CM_single_Nm -100000.0 100000.0
 /begin AXIS_DESCR COM_AXIS VTQD_TqTargetShaftSpd_rpm SWC_FDC_type_CM_single_rpm 42 -100000.0 100000.0 AXIS_PTS_REF ATQD_ECOTqMapD_X_rpm /end AXIS_DESCR
 /begin AXIS_DESCR COM_AXIS VTQD_ActAPSPosn_pct SWC_FDC_type_CM_single_pct 35 0.0 110.0 AXIS_PTS_REF ATQD_ECOTqMapD_Y_pct /end AXIS_DESCR
/end CHARACTERISTIC
/begin AXIS_PTS ATQD_ECOTqMapD_Y_pct "" 0x0000 /* @ECU_Address@ATQD_ECOTqMapD_Y_pct@ */ VTQD_ActAPSPosn_pct Lookup2D_X_FLOAT32_IEEE 0 SWC_FDC_type_CM_single_pct 35 0.0 110.0 /end AXIS_PTS
/begin AXIS_PTS ATQD_ECOTqMapD_X_rpm "" 0x0000 /* @ECU_Address@ATQD_ECOTqMapD_X_rpm@ */ VTQD_TqTargetShaftSpd_rpm Lookup2D_X_FLOAT32_IEEE 0 SWC_FDC_type_CM_single_rpm 42 -100000.0 100000.0 /end AXIS_PTS
/begin CHARACTERISTIC MTQD_EL2TqMapD_Z_Nm "" MAP 0x0000 /* @ECU_Address@MTQD_EL2TqMapD_Z_Nm@ */ Lookup2D_FLOAT32_IEEE 0 SWC_FDC_type_CM_single_Nm -100000.0 100000.0
 /begin AXIS_DESCR COM_AXIS VTQD_TqTargetShaftSpd_rpm SWC_FDC_type_CM_single_rpm 42 -100000.0 100000.0 AXIS_PTS_REF ATQD_ECOTqMapD_X_rpm /end AXIS_DESCR
 /begin AXIS_DESCR COM_AXIS VTQD_ActAPSPosn_pct SWC_FDC_type_CM_single_pct 35 0.0 110.0 AXIS_PTS_REF ATQD_ECOTqMapD_Y_pct /end AXIS_DESCR
/end CHARACTERISTIC
/begin CHARACTERISTIC MTQD_EL3TqMapD_Z_Nm "" MAP 0x0000 /* @ECU_Address@MTQD_EL3TqMapD_Z_Nm@ */ Lookup2D_FLOAT32_IEEE 0 SWC_FDC_type_CM_single_Nm -100000.0 100000.0
 /begin AXIS_DESCR COM_AXIS VTQD_TqTargetShaftSpd_rpm SWC_FDC_type_CM_single_rpm 42 -100000.0 100000.0 AXIS_PTS_REF ATQD_ECOTqMapD_X_rpm /end AXIS_DESCR
 /begin AXIS_DESCR COM_AXIS VTQD_ActAPSPosn_pct SWC_FDC_type_CM_single_pct 35 0.0 110.0 AXIS_PTS_REF ATQD_ECOTqMapD_Y_pct /end AXIS_DESCR
/end CHARACTERISTIC
/begin CHARACTERISTIC MTQD_EL4TqMapD_Z_Nm "" MAP 0x0000 /* @ECU_Address@MTQD_EL4TqMapD_Z_Nm@ */ Lookup2D_FLOAT32_IEEE 0 SWC_FDC_type_CM_single_Nm -100000.0 100000.0
 /begin AXIS_DESCR COM_AXIS VTQD_TqTargetShaftSpd_rpm SWC_FDC_type_CM_single_rpm 42 -100000.0 100000.0 AXIS_PTS_REF ATQD_ECOTqMapD_X_rpm /end AXIS_DESCR
 /begin AXIS_DESCR COM_AXIS VTQD_ActAPSPosn_pct SWC_FDC_type_CM_single_pct 35 0.0 110.0 AXIS_PTS_REF ATQD_ECOTqMapD_Y_pct /end AXIS_DESCR
/end CHARACTERISTIC
/begin CHARACTERISTIC MTQD_EL5TqMapD_Z_Nm "" MAP 0x0000 /* @ECU_Address@MTQD_EL5TqMapD_Z_Nm@ */ Lookup2D_FLOAT32_IEEE 0 SWC_FDC_type_CM_single_Nm -100000.0 100000.0
 /begin AXIS_DESCR COM_AXIS VTQD_TqTargetShaftSpd_rpm SWC_FDC_type_CM_single_rpm 42 -100000.0 100000.0 AXIS_PTS_REF ATQD_ECOTqMapD_X_rpm /end AXIS_DESCR
 /begin AXIS_DESCR COM_AXIS VTQD_ActAPSPosn_pct SWC_FDC_type_CM_single_pct 35 0.0 110.0 AXIS_PTS_REF ATQD_ECOTqMapD_Y_pct /end AXIS_DESCR
/end CHARACTERISTIC
/begin CHARACTERISTIC MTQD_EOPDTqMapDCon_Z_Nm "" MAP 0x0000 /* @ECU_Address@MTQD_EOPDTqMapDCon_Z_Nm@ */ Lookup2D_FLOAT32_IEEE 0 SWC_FDC_type_CM_single_Nm -100000.0 100000.0
 /begin AXIS_DESCR COM_AXIS VTQD_TqTargetShaftSpd_rpm SWC_FDC_type_CM_single_rpm 42 -100000.0 100000.0 AXIS_PTS_REF ATQD_EOPDTqMapDCon_X_rpm /end AXIS_DESCR
 /begin AXIS_DESCR COM_AXIS NO_INPUT_QUANTITY SWC_FDC_type_CM_single_Deg 23 -180.0 180.0 AXIS_PTS_REF ATQD_EOPDTqMapDCon_Y_Deg /end AXIS_DESCR
/end CHARACTERISTIC
/begin AXIS_PTS ATQD_EOPDTqMapDCon_Y_Deg "" 0x0000 /* @ECU_Address@ATQD_EOPDTqMapDCon_Y_Deg@ */ NO_INPUT_QUANTITY Lookup2D_X_FLOAT32_IEEE 0 SWC_FDC_type_CM_single_Deg 23 -180.0 180.0 /end AXIS_PTS
/begin AXIS_PTS ATQD_EOPDTqMapDCon_X_rpm "" 0x0000 /* @ECU_Address@ATQD_EOPDTqMapDCon_X_rpm@ */ VTQD_TqTargetShaftSpd_rpm Lookup2D_X_FLOAT32_IEEE 0 SWC_FDC_type_CM_single_rpm 42 -100000.0 100000.0 /end AXIS_PTS
/begin CHARACTERISTIC MTQD_EOPDTqMapD_Z_Nm "" MAP 0x0000 /* @ECU_Address@MTQD_EOPDTqMapD_Z_Nm@ */ Lookup2D_FLOAT32_IEEE 0 SWC_FDC_type_CM_single_Nm -100000.0 100000.0
 /begin AXIS_DESCR COM_AXIS VTQD_TqTargetShaftSpd_rpm SWC_FDC_type_CM_single_rpm 42 -100000.0 100000.0 AXIS_PTS_REF ATQD_ECOTqMapD_X_rpm /end AXIS_DESCR
 /begin AXIS_DESCR COM_AXIS VTQD_ActAPSPosn_pct SWC_FDC_type_CM_single_pct 35 0.0 110.0 AXIS_PTS_REF ATQD_ECOTqMapD_Y_pct /end AXIS_DESCR
/end CHARACTERISTIC
/begin CHARACTERISTIC MTQD_RollGenMapEL1_Z_Nm "" MAP 0x0000 /* @ECU_Address@MTQD_RollGenMapEL1_Z_Nm@ */ Lookup2D_FLOAT32_IEEE 0 SWC_FDC_type_CM_single_Nm -100000.0 0.0
 /begin AXIS_DESCR COM_AXIS VTQD_TqTargetShaftSpd_rpm SWC_FDC_type_CM_single_rpm 24 -100000.0 100000.0 AXIS_PTS_REF ATQD_RollGenMapEL1_X_rpm /end AXIS_DESCR
 /begin AXIS_DESCR COM_AXIS VTQD_RollingShaftSpd_rpm SWC_FDC_type_CM_single_rpm 24 -100000.0 100000.0 AXIS_PTS_REF ATQD_RollGenMapEL1_Y_rpm /end AXIS_DESCR
/end CHARACTERISTIC
/begin AXIS_PTS ATQD_RollGenMapEL1_Y_rpm "" 0x0000 /* @ECU_Address@ATQD_RollGenMapEL1_Y_rpm@ */ VTQD_RollingShaftSpd_rpm Lookup2D_X_FLOAT32_IEEE 0 SWC_FDC_type_CM_single_rpm 24 -100000.0 100000.0 /end AXIS_PTS
/begin AXIS_PTS ATQD_RollGenMapEL1_X_rpm "" 0x0000 /* @ECU_Address@ATQD_RollGenMapEL1_X_rpm@ */ VTQD_TqTargetShaftSpd_rpm Lookup2D_X_FLOAT32_IEEE 0 SWC_FDC_type_CM_single_rpm 24 -100000.0 100000.0 /end AXIS_PTS
/begin CHARACTERISTIC MTQD_EMTqMapD_Z_Nm "" MAP 0x0000 /* @ECU_Address@MTQD_EMTqMapD_Z_Nm@ */ Lookup2D_FLOAT32_IEEE 0 SWC_FDC_type_CM_single_Nm -100000.0 100000.0
 /begin AXIS_DESCR COM_AXIS VTQD_TqTargetShaftSpd_rpm SWC_FDC_type_CM_single_rpm 42 -100000.0 100000.0 AXIS_PTS_REF ATQD_EMTqMapD_X_rpm /end AXIS_DESCR
 /begin AXIS_DESCR COM_AXIS VTQD_ActAPSPosn_pct SWC_FDC_type_CM_single_pct 35 0.0 110.0 AXIS_PTS_REF ATQD_EMTqMapD_Y_pct /end AXIS_DESCR
/end CHARACTERISTIC
/begin AXIS_PTS ATQD_EMTqMapD_Y_pct "" 0x0000 /* @ECU_Address@ATQD_EMTqMapD_Y_pct@ */ VTQD_ActAPSPosn_pct Lookup2D_X_FLOAT32_IEEE 0 SWC_FDC_type_CM_single_pct 35 0.0 110.0 /end AXIS_PTS
/begin AXIS_PTS ATQD_EMTqMapD_X_rpm "" 0x0000 /* @ECU_Address@ATQD_EMTqMapD_X_rpm@ */ VTQD_TqTargetShaftSpd_rpm Lookup2D_X_FLOAT32_IEEE 0 SWC_FDC_type_CM_single_rpm 42 -100000.0 100000.0 /end AXIS_PTS
/begin CHARACTERISTIC MTQD_NL2TqMapD_Z_Nm "" MAP 0x0000 /* @ECU_Address@MTQD_NL2TqMapD_Z_Nm@ */ Lookup2D_FLOAT32_IEEE 0 SWC_FDC_type_CM_single_Nm -100000.0 100000.0
 /begin AXIS_DESCR COM_AXIS VTQD_TqTargetShaftSpd_rpm SWC_FDC_type_CM_single_rpm 42 -100000.0 100000.0 AXIS_PTS_REF ATQD_NL1TqMapD_X_rpm /end AXIS_DESCR
 /begin AXIS_DESCR COM_AXIS VTQD_ActAPSPosn_pct SWC_FDC_type_CM_single_pct 35 0.0 110.0 AXIS_PTS_REF ATQD_NL1TqMapD_Y_pct /end AXIS_DESCR
/end CHARACTERISTIC
/begin CHARACTERISTIC MTQD_NL3TqMapD_Z_Nm "" MAP 0x0000 /* @ECU_Address@MTQD_NL3TqMapD_Z_Nm@ */ Lookup2D_FLOAT32_IEEE 0 SWC_FDC_type_CM_single_Nm -100000.0 100000.0
 /begin AXIS_DESCR COM_AXIS VTQD_TqTargetShaftSpd_rpm SWC_FDC_type_CM_single_rpm 42 -100000.0 100000.0 AXIS_PTS_REF ATQD_NL1TqMapD_X_rpm /end AXIS_DESCR
 /begin AXIS_DESCR COM_AXIS VTQD_ActAPSPosn_pct SWC_FDC_type_CM_single_pct 35 0.0 110.0 AXIS_PTS_REF ATQD_NL1TqMapD_Y_pct /end AXIS_DESCR
/end CHARACTERISTIC
/begin CHARACTERISTIC MTQD_NL4TqMapD_Z_Nm "" MAP 0x0000 /* @ECU_Address@MTQD_NL4TqMapD_Z_Nm@ */ Lookup2D_FLOAT32_IEEE 0 SWC_FDC_type_CM_single_Nm -100000.0 100000.0
 /begin AXIS_DESCR COM_AXIS VTQD_TqTargetShaftSpd_rpm SWC_FDC_type_CM_single_rpm 42 -100000.0 100000.0 AXIS_PTS_REF ATQD_NL1TqMapD_X_rpm /end AXIS_DESCR
 /begin AXIS_DESCR COM_AXIS VTQD_ActAPSPosn_pct SWC_FDC_type_CM_single_pct 35 0.0 110.0 AXIS_PTS_REF ATQD_NL1TqMapD_Y_pct /end AXIS_DESCR
/end CHARACTERISTIC
/begin CHARACTERISTIC MTQD_NL5TqMapD_Z_Nm "" MAP 0x0000 /* @ECU_Address@MTQD_NL5TqMapD_Z_Nm@ */ Lookup2D_FLOAT32_IEEE 0 SWC_FDC_type_CM_single_Nm -100000.0 100000.0
 /begin AXIS_DESCR COM_AXIS VTQD_TqTargetShaftSpd_rpm SWC_FDC_type_CM_single_rpm 42 -100000.0 100000.0 AXIS_PTS_REF ATQD_NL1TqMapD_X_rpm /end AXIS_DESCR
 /begin AXIS_DESCR COM_AXIS VTQD_ActAPSPosn_pct SWC_FDC_type_CM_single_pct 35 0.0 110.0 AXIS_PTS_REF ATQD_NL1TqMapD_Y_pct /end AXIS_DESCR
/end CHARACTERISTIC
/begin CHARACTERISTIC MTQD_NOPDTqMapDCon_Z_Nm "" MAP 0x0000 /* @ECU_Address@MTQD_NOPDTqMapDCon_Z_Nm@ */ Lookup2D_FLOAT32_IEEE 0 SWC_FDC_type_CM_single_Nm -100000.0 100000.0
 /begin AXIS_DESCR COM_AXIS VTQD_TqTargetShaftSpd_rpm SWC_FDC_type_CM_single_rpm 42 -100000.0 100000.0 AXIS_PTS_REF ATQD_NOPDTqMapDCon_X_rpm /end AXIS_DESCR
 /begin AXIS_DESCR COM_AXIS NO_INPUT_QUANTITY SWC_FDC_type_CM_single_Deg 23 -180.0 180.0 AXIS_PTS_REF ATQD_NOPDTqMapDCon_Y_Deg /end AXIS_DESCR
/end CHARACTERISTIC
/begin AXIS_PTS ATQD_NOPDTqMapDCon_Y_Deg "" 0x0000 /* @ECU_Address@ATQD_NOPDTqMapDCon_Y_Deg@ */ NO_INPUT_QUANTITY Lookup2D_X_FLOAT32_IEEE 0 SWC_FDC_type_CM_single_Deg 23 -180.0 180.0 /end AXIS_PTS
/begin AXIS_PTS ATQD_NOPDTqMapDCon_X_rpm "" 0x0000 /* @ECU_Address@ATQD_NOPDTqMapDCon_X_rpm@ */ VTQD_TqTargetShaftSpd_rpm Lookup2D_X_FLOAT32_IEEE 0 SWC_FDC_type_CM_single_rpm 42 -100000.0 100000.0 /end AXIS_PTS
/begin CHARACTERISTIC MTQD_NOPDTqMapD_Z_Nm "" MAP 0x0000 /* @ECU_Address@MTQD_NOPDTqMapD_Z_Nm@ */ Lookup2D_FLOAT32_IEEE 0 SWC_FDC_type_CM_single_Nm -100000.0 100000.0
 /begin AXIS_DESCR COM_AXIS VTQD_TqTargetShaftSpd_rpm SWC_FDC_type_CM_single_rpm 42 -100000.0 100000.0 AXIS_PTS_REF ATQD_NL1TqMapD_X_rpm /end AXIS_DESCR
 /begin AXIS_DESCR COM_AXIS VTQD_ActAPSPosn_pct SWC_FDC_type_CM_single_pct 35 0.0 110.0 AXIS_PTS_REF ATQD_NL1TqMapD_Y_pct /end AXIS_DESCR
/end CHARACTERISTIC
/begin CHARACTERISTIC MTQD_SNTqMapD_Z_Nm "" MAP 0x0000 /* @ECU_Address@MTQD_SNTqMapD_Z_Nm@ */ Lookup2D_FLOAT32_IEEE 0 SWC_FDC_type_CM_single_Nm -100000.0 100000.0
 /begin AXIS_DESCR COM_AXIS VTQD_TqTargetShaftSpd_rpm SWC_FDC_type_CM_single_rpm 42 -100000.0 100000.0 AXIS_PTS_REF ATQD_SNTqMapD_X_rpm /end AXIS_DESCR
 /begin AXIS_DESCR COM_AXIS VTQD_ActAPSPosn_pct SWC_FDC_type_CM_single_pct 35 0.0 110.0 AXIS_PTS_REF ATQD_SNTqMapD_Y_pct /end AXIS_DESCR
/end CHARACTERISTIC
/begin AXIS_PTS ATQD_SNTqMapD_Y_pct "" 0x0000 /* @ECU_Address@ATQD_SNTqMapD_Y_pct@ */ VTQD_ActAPSPosn_pct Lookup2D_X_FLOAT32_IEEE 0 SWC_FDC_type_CM_single_pct 35 0.0 110.0 /end AXIS_PTS
/begin AXIS_PTS ATQD_SNTqMapD_X_rpm "" 0x0000 /* @ECU_Address@ATQD_SNTqMapD_X_rpm@ */ VTQD_TqTargetShaftSpd_rpm Lookup2D_X_FLOAT32_IEEE 0 SWC_FDC_type_CM_single_rpm 42 -100000.0 100000.0 /end AXIS_PTS
/begin CHARACTERISTIC MTQD_SL1TqMapD_Z_Nm "" MAP 0x0000 /* @ECU_Address@MTQD_SL1TqMapD_Z_Nm@ */ Lookup2D_FLOAT32_IEEE 0 SWC_FDC_type_CM_single_Nm -100000.0 100000.0
 /begin AXIS_DESCR COM_AXIS VTQD_TqTargetShaftSpd_rpm SWC_FDC_type_CM_single_rpm 42 -100000.0 100000.0 AXIS_PTS_REF ATQD_SL1TqMapD_X_rpm /end AXIS_DESCR
 /begin AXIS_DESCR COM_AXIS VTQD_ActAPSPosn_pct SWC_FDC_type_CM_single_pct 35 0.0 110.0 AXIS_PTS_REF ATQD_SL1TqMapD_Y_pct /end AXIS_DESCR
/end CHARACTERISTIC
/begin AXIS_PTS ATQD_SL1TqMapD_Y_pct "" 0x0000 /* @ECU_Address@ATQD_SL1TqMapD_Y_pct@ */ VTQD_ActAPSPosn_pct Lookup2D_X_FLOAT32_IEEE 0 SWC_FDC_type_CM_single_pct 35 0.0 110.0 /end AXIS_PTS
/begin AXIS_PTS ATQD_SL1TqMapD_X_rpm "" 0x0000 /* @ECU_Address@ATQD_SL1TqMapD_X_rpm@ */ VTQD_TqTargetShaftSpd_rpm Lookup2D_X_FLOAT32_IEEE 0 SWC_FDC_type_CM_single_rpm 42 -100000.0 100000.0 /end AXIS_PTS
/begin CHARACTERISTIC MTQD_SL2TqMapD_Z_Nm "" MAP 0x0000 /* @ECU_Address@MTQD_SL2TqMapD_Z_Nm@ */ Lookup2D_FLOAT32_IEEE 0 SWC_FDC_type_CM_single_Nm -100000.0 100000.0
 /begin AXIS_DESCR COM_AXIS VTQD_TqTargetShaftSpd_rpm SWC_FDC_type_CM_single_rpm 42 -100000.0 100000.0 AXIS_PTS_REF ATQD_SL1TqMapD_X_rpm /end AXIS_DESCR
 /begin AXIS_DESCR COM_AXIS VTQD_ActAPSPosn_pct SWC_FDC_type_CM_single_pct 35 0.0 110.0 AXIS_PTS_REF ATQD_SL1TqMapD_Y_pct /end AXIS_DESCR
/end CHARACTERISTIC
/begin CHARACTERISTIC MTQD_SL3TqMapD_Z_Nm "" MAP 0x0000 /* @ECU_Address@MTQD_SL3TqMapD_Z_Nm@ */ Lookup2D_FLOAT32_IEEE 0 SWC_FDC_type_CM_single_Nm -100000.0 100000.0
 /begin AXIS_DESCR COM_AXIS VTQD_TqTargetShaftSpd_rpm SWC_FDC_type_CM_single_rpm 42 -100000.0 100000.0 AXIS_PTS_REF ATQD_SL1TqMapD_X_rpm /end AXIS_DESCR
 /begin AXIS_DESCR COM_AXIS VTQD_ActAPSPosn_pct SWC_FDC_type_CM_single_pct 35 0.0 110.0 AXIS_PTS_REF ATQD_SL1TqMapD_Y_pct /end AXIS_DESCR
/end CHARACTERISTIC
/begin CHARACTERISTIC MTQD_SL4TqMapD_Z_Nm "" MAP 0x0000 /* @ECU_Address@MTQD_SL4TqMapD_Z_Nm@ */ Lookup2D_FLOAT32_IEEE 0 SWC_FDC_type_CM_single_Nm -100000.0 100000.0
 /begin AXIS_DESCR COM_AXIS VTQD_TqTargetShaftSpd_rpm SWC_FDC_type_CM_single_rpm 42 -100000.0 100000.0 AXIS_PTS_REF ATQD_SL1TqMapD_X_rpm /end AXIS_DESCR
 /begin AXIS_DESCR COM_AXIS VTQD_ActAPSPosn_pct SWC_FDC_type_CM_single_pct 35 0.0 110.0 AXIS_PTS_REF ATQD_SL1TqMapD_Y_pct /end AXIS_DESCR
/end CHARACTERISTIC
/begin CHARACTERISTIC MTQD_SL5TqMapD_Z_Nm "" MAP 0x0000 /* @ECU_Address@MTQD_SL5TqMapD_Z_Nm@ */ Lookup2D_FLOAT32_IEEE 0 SWC_FDC_type_CM_single_Nm -100000.0 100000.0
 /begin AXIS_DESCR COM_AXIS VTQD_TqTargetShaftSpd_rpm SWC_FDC_type_CM_single_rpm 42 -100000.0 100000.0 AXIS_PTS_REF ATQD_SL1TqMapD_X_rpm /end AXIS_DESCR
 /begin AXIS_DESCR COM_AXIS VTQD_ActAPSPosn_pct SWC_FDC_type_CM_single_pct 35 0.0 110.0 AXIS_PTS_REF ATQD_SL1TqMapD_Y_pct /end AXIS_DESCR
/end CHARACTERISTIC
/begin CHARACTERISTIC MTQD_SOPDTqMapDCon_Z_Nm "" MAP 0x0000 /* @ECU_Address@MTQD_SOPDTqMapDCon_Z_Nm@ */ Lookup2D_FLOAT32_IEEE 0 SWC_FDC_type_CM_single_Nm -100000.0 100000.0
 /begin AXIS_DESCR COM_AXIS VTQD_TqTargetShaftSpd_rpm SWC_FDC_type_CM_single_rpm 42 -100000.0 100000.0 AXIS_PTS_REF ATQD_SOPDTqMapDCon_X_rpm /end AXIS_DESCR
 /begin AXIS_DESCR COM_AXIS NO_INPUT_QUANTITY SWC_FDC_type_CM_single_Deg 23 -180.0 180.0 AXIS_PTS_REF ATQD_SOPDTqMapDCon_Y_Deg /end AXIS_DESCR
/end CHARACTERISTIC
/begin AXIS_PTS ATQD_SOPDTqMapDCon_Y_Deg "" 0x0000 /* @ECU_Address@ATQD_SOPDTqMapDCon_Y_Deg@ */ NO_INPUT_QUANTITY Lookup2D_X_FLOAT32_IEEE 0 SWC_FDC_type_CM_single_Deg 23 -180.0 180.0 /end AXIS_PTS
/begin AXIS_PTS ATQD_SOPDTqMapDCon_X_rpm "" 0x0000 /* @ECU_Address@ATQD_SOPDTqMapDCon_X_rpm@ */ VTQD_TqTargetShaftSpd_rpm Lookup2D_X_FLOAT32_IEEE 0 SWC_FDC_type_CM_single_rpm 42 -100000.0 100000.0 /end AXIS_PTS
/begin CHARACTERISTIC MTQD_SOPDTqMapD_Z_Nm "" MAP 0x0000 /* @ECU_Address@MTQD_SOPDTqMapD_Z_Nm@ */ Lookup2D_FLOAT32_IEEE 0 SWC_FDC_type_CM_single_Nm -100000.0 100000.0
 /begin AXIS_DESCR COM_AXIS VTQD_TqTargetShaftSpd_rpm SWC_FDC_type_CM_single_rpm 42 -100000.0 100000.0 AXIS_PTS_REF ATQD_SL1TqMapD_X_rpm /end AXIS_DESCR
 /begin AXIS_DESCR COM_AXIS VTQD_ActAPSPosn_pct SWC_FDC_type_CM_single_pct 35 0.0 110.0 AXIS_PTS_REF ATQD_SL1TqMapD_Y_pct /end AXIS_DESCR
/end CHARACTERISTIC
/begin CHARACTERISTIC KTQD_OPDHTqDisAPSPosn_pct "" VALUE 0x0000 /* @ECU_Address@KTQD_OPDHTqDisAPSPosn_pct@ */ Scalar_FLOAT32_IEEE 0 SWC_FDC_type_CM_single_pct 0.0 125.0 /end CHARACTERISTIC
/begin CHARACTERISTIC KTQD_OPDHTqDisComSpd_kph "" VALUE 0x0000 /* @ECU_Address@KTQD_OPDHTqDisComSpd_kph@ */ Scalar_FLOAT32_IEEE 0 SWC_FDC_type_CM_single_kph -300.0 300.0 /end CHARACTERISTIC
/begin CHARACTERISTIC KTQD_PedAccARgnEnSpd_kph "" VALUE 0x0000 /* @ECU_Address@KTQD_PedAccARgnEnSpd_kph@ */ Scalar_FLOAT32_IEEE 0 SWC_FDC_type_CM_single_kph 0.0 300.0 /end CHARACTERISTIC
/begin CHARACTERISTIC KTQD_PedAccBrkDeltaTq_Nm "" VALUE 0x0000 /* @ECU_Address@KTQD_PedAccBrkDeltaTq_Nm@ */ Scalar_FLOAT32_IEEE 0 SWC_FDC_type_CM_single_Nm -100000.0 100000.0 /end CHARACTERISTIC
/begin CHARACTERISTIC KTQD_PedAccBrkEnPos_pct "" VALUE 0x0000 /* @ECU_Address@KTQD_PedAccBrkEnPos_pct@ */ Scalar_FLOAT32_IEEE 0 SWC_FDC_type_CM_single_pct 0.0 125.0 /end CHARACTERISTIC
/begin CHARACTERISTIC KTQD_PedAccCMDLowLim_mps2 "" VALUE 0x0000 /* @ECU_Address@KTQD_PedAccCMDLowLim_mps2@ */ Scalar_FLOAT32_IEEE 0 SWC_FDC_type_CM_single_mps2 -20.0 0.0 /end CHARACTERISTIC
/begin CHARACTERISTIC KTQD_PedAccCMDUpLim_mps2 "" VALUE 0x0000 /* @ECU_Address@KTQD_PedAccCMDUpLim_mps2@ */ Scalar_FLOAT32_IEEE 0 SWC_FDC_type_CM_single_mps2 0.0 20.0 /end CHARACTERISTIC
/begin CHARACTERISTIC KTQD_PedAccDevLowLim_mps2 "" VALUE 0x0000 /* @ECU_Address@KTQD_PedAccDevLowLim_mps2@ */ Scalar_FLOAT32_IEEE 0 SWC_FDC_type_CM_single_mps2 -20.0 0.0 /end CHARACTERISTIC
/begin CHARACTERISTIC KTQD_PedAccDevUpLim_mps2 "" VALUE 0x0000 /* @ECU_Address@KTQD_PedAccDevUpLim_mps2@ */ Scalar_FLOAT32_IEEE 0 SWC_FDC_type_CM_single_mps2 0.0 20.0 /end CHARACTERISTIC
/begin CHARACTERISTIC KTQD_PedAccTqLowLim_Nm "" VALUE 0x0000 /* @ECU_Address@KTQD_PedAccTqLowLim_Nm@ */ Scalar_FLOAT32_IEEE 0 SWC_FDC_type_CM_single_Nm -100000.0 100000.0 /end CHARACTERISTIC
/begin CHARACTERISTIC KTQD_PedAccTqUpLim_Nm "" VALUE 0x0000 /* @ECU_Address@KTQD_PedAccTqUpLim_Nm@ */ Scalar_FLOAT32_IEEE 0 SWC_FDC_type_CM_single_Nm -100000.0 100000.0 /end CHARACTERISTIC
/begin CHARACTERISTIC KTQD_PedGControlEnSpd_kph "" VALUE 0x0000 /* @ECU_Address@KTQD_PedGControlEnSpd_kph@ */ Scalar_FLOAT32_IEEE 0 SWC_FDC_type_CM_single_kph 0.0 300.0 /end CHARACTERISTIC
/begin CHARACTERISTIC KTQR_FrTqIncGainSW_flg "" VALUE 0x0000 /* @ECU_Address@KTQR_FrTqIncGainSW_flg@ */ Scalar_BOOLEAN 0 SWC_FDC_type_CM_boolean_flg 0.0 1.0 /end CHARACTERISTIC
/begin CHARACTERISTIC KTQR_RrTqIncGainSW_flg "" VALUE 0x0000 /* @ECU_Address@KTQR_RrTqIncGainSW_flg@ */ Scalar_BOOLEAN 0 SWC_FDC_type_CM_boolean_flg 0.0 1.0 /end CHARACTERISTIC
/begin CHARACTERISTIC KTQD_DiagnosisOff1_enum "" VALUE 0x0000 /* @ECU_Address@KTQD_DiagnosisOff1_enum@ */ Scalar_UBYTE 0 SWC_FDC_type_CM_uint8_enum 0.0 15.0 /end CHARACTERISTIC
/begin CHARACTERISTIC KTQD_DiagnosisOff2_enum "" VALUE 0x0000 /* @ECU_Address@KTQD_DiagnosisOff2_enum@ */ Scalar_UBYTE 0 SWC_FDC_type_CM_uint8_enum 0.0 15.0 /end CHARACTERISTIC
/begin CHARACTERISTIC KTQD_DiagnosisOff3_enum "" VALUE 0x0000 /* @ECU_Address@KTQD_DiagnosisOff3_enum@ */ Scalar_UBYTE 0 SWC_FDC_type_CM_uint8_enum 0.0 15.0 /end CHARACTERISTIC
/begin CHARACTERISTIC KTQD_DiagnosisOff4_enum "" VALUE 0x0000 /* @ECU_Address@KTQD_DiagnosisOff4_enum@ */ Scalar_UBYTE 0 SWC_FDC_type_CM_uint8_enum 0.0 15.0 /end CHARACTERISTIC
/begin CHARACTERISTIC KTQD_DiagnosisOff5_enum "" VALUE 0x0000 /* @ECU_Address@KTQD_DiagnosisOff5_enum@ */ Scalar_UBYTE 0 SWC_FDC_type_CM_uint8_enum 0.0 15.0 /end CHARACTERISTIC
/begin CHARACTERISTIC KTQD_DiagnosisOff6_enum "" VALUE 0x0000 /* @ECU_Address@KTQD_DiagnosisOff6_enum@ */ Scalar_UBYTE 0 SWC_FDC_type_CM_uint8_enum 0.0 15.0 /end CHARACTERISTIC
/begin CHARACTERISTIC KTQD_DiagnosisOff7_enum "" VALUE 0x0000 /* @ECU_Address@KTQD_DiagnosisOff7_enum@ */ Scalar_UBYTE 0 SWC_FDC_type_CM_uint8_enum 0.0 15.0 /end CHARACTERISTIC
/begin CHARACTERISTIC KTQD_DiagnosisOff8_enum "" VALUE 0x0000 /* @ECU_Address@KTQD_DiagnosisOff8_enum@ */ Scalar_UBYTE 0 SWC_FDC_type_CM_uint8_enum 0.0 15.0 /end CHARACTERISTIC
/begin CHARACTERISTIC KTQD_Engineering1_enum "" VALUE 0x0000 /* @ECU_Address@KTQD_Engineering1_enum@ */ Scalar_UBYTE 0 SWC_FDC_type_CM_uint8_enum 0.0 15.0 /end CHARACTERISTIC
/begin CHARACTERISTIC KTQD_Engineering2_enum "" VALUE 0x0000 /* @ECU_Address@KTQD_Engineering2_enum@ */ Scalar_UBYTE 0 SWC_FDC_type_CM_uint8_enum 0.0 15.0 /end CHARACTERISTIC
/begin CHARACTERISTIC KTQD_Engineering3_enum "" VALUE 0x0000 /* @ECU_Address@KTQD_Engineering3_enum@ */ Scalar_UBYTE 0 SWC_FDC_type_CM_uint8_enum 0.0 15.0 /end CHARACTERISTIC
/begin CHARACTERISTIC KTQD_Engineering4_enum "" VALUE 0x0000 /* @ECU_Address@KTQD_Engineering4_enum@ */ Scalar_UBYTE 0 SWC_FDC_type_CM_uint8_enum 0.0 15.0 /end CHARACTERISTIC
/begin CHARACTERISTIC KTQD_Engineering5_enum "" VALUE 0x0000 /* @ECU_Address@KTQD_Engineering5_enum@ */ Scalar_UBYTE 0 SWC_FDC_type_CM_uint8_enum 0.0 15.0 /end CHARACTERISTIC
/begin CHARACTERISTIC KTQD_Engineering6_enum "" VALUE 0x0000 /* @ECU_Address@KTQD_Engineering6_enum@ */ Scalar_UBYTE 0 SWC_FDC_type_CM_uint8_enum 0.0 15.0 /end CHARACTERISTIC
/begin CHARACTERISTIC KTQD_Engineering7_enum "" VALUE 0x0000 /* @ECU_Address@KTQD_Engineering7_enum@ */ Scalar_UBYTE 0 SWC_FDC_type_CM_uint8_enum 0.0 15.0 /end CHARACTERISTIC
/begin CHARACTERISTIC KTQD_Engineering8_enum "" VALUE 0x0000 /* @ECU_Address@KTQD_Engineering8_enum@ */ Scalar_UBYTE 0 SWC_FDC_type_CM_uint8_enum 0.0 15.0 /end CHARACTERISTIC
/begin CHARACTERISTIC KTQD_Exhibition1_enum "" VALUE 0x0000 /* @ECU_Address@KTQD_Exhibition1_enum@ */ Scalar_UBYTE 0 SWC_FDC_type_CM_uint8_enum 0.0 15.0 /end CHARACTERISTIC
/begin CHARACTERISTIC KTQD_Exhibition2_enum "" VALUE 0x0000 /* @ECU_Address@KTQD_Exhibition2_enum@ */ Scalar_UBYTE 0 SWC_FDC_type_CM_uint8_enum 0.0 15.0 /end CHARACTERISTIC
/begin CHARACTERISTIC KTQD_Exhibition3_enum "" VALUE 0x0000 /* @ECU_Address@KTQD_Exhibition3_enum@ */ Scalar_UBYTE 0 SWC_FDC_type_CM_uint8_enum 0.0 15.0 /end CHARACTERISTIC
/begin CHARACTERISTIC KTQD_Exhibition4_enum "" VALUE 0x0000 /* @ECU_Address@KTQD_Exhibition4_enum@ */ Scalar_UBYTE 0 SWC_FDC_type_CM_uint8_enum 0.0 15.0 /end CHARACTERISTIC
/begin CHARACTERISTIC KTQD_Exhibition5_enum "" VALUE 0x0000 /* @ECU_Address@KTQD_Exhibition5_enum@ */ Scalar_UBYTE 0 SWC_FDC_type_CM_uint8_enum 0.0 15.0 /end CHARACTERISTIC
/begin CHARACTERISTIC KTQD_Exhibition6_enum "" VALUE 0x0000 /* @ECU_Address@KTQD_Exhibition6_enum@ */ Scalar_UBYTE 0 SWC_FDC_type_CM_uint8_enum 0.0 15.0 /end CHARACTERISTIC
/begin CHARACTERISTIC KTQD_Exhibition7_enum "" VALUE 0x0000 /* @ECU_Address@KTQD_Exhibition7_enum@ */ Scalar_UBYTE 0 SWC_FDC_type_CM_uint8_enum 0.0 15.0 /end CHARACTERISTIC
/begin CHARACTERISTIC KTQD_Exhibition8_enum "" VALUE 0x0000 /* @ECU_Address@KTQD_Exhibition8_enum@ */ Scalar_UBYTE 0 SWC_FDC_type_CM_uint8_enum 0.0 15.0 /end CHARACTERISTIC
/begin CHARACTERISTIC KTQD_Manufacture1_enum "" VALUE 0x0000 /* @ECU_Address@KTQD_Manufacture1_enum@ */ Scalar_UBYTE 0 SWC_FDC_type_CM_uint8_enum 0.0 15.0 /end CHARACTERISTIC
/begin CHARACTERISTIC KTQD_Manufacture2_enum "" VALUE 0x0000 /* @ECU_Address@KTQD_Manufacture2_enum@ */ Scalar_UBYTE 0 SWC_FDC_type_CM_uint8_enum 0.0 15.0 /end CHARACTERISTIC
/begin CHARACTERISTIC KTQD_Manufacture3_enum "" VALUE 0x0000 /* @ECU_Address@KTQD_Manufacture3_enum@ */ Scalar_UBYTE 0 SWC_FDC_type_CM_uint8_enum 0.0 15.0 /end CHARACTERISTIC
/begin CHARACTERISTIC KTQD_Manufacture4_enum "" VALUE 0x0000 /* @ECU_Address@KTQD_Manufacture4_enum@ */ Scalar_UBYTE 0 SWC_FDC_type_CM_uint8_enum 0.0 15.0 /end CHARACTERISTIC
/begin CHARACTERISTIC KTQD_Manufacture5_enum "" VALUE 0x0000 /* @ECU_Address@KTQD_Manufacture5_enum@ */ Scalar_UBYTE 0 SWC_FDC_type_CM_uint8_enum 0.0 15.0 /end CHARACTERISTIC
/begin CHARACTERISTIC KTQD_Manufacture6_enum "" VALUE 0x0000 /* @ECU_Address@KTQD_Manufacture6_enum@ */ Scalar_UBYTE 0 SWC_FDC_type_CM_uint8_enum 0.0 15.0 /end CHARACTERISTIC
/begin CHARACTERISTIC KTQD_Manufacture7_enum "" VALUE 0x0000 /* @ECU_Address@KTQD_Manufacture7_enum@ */ Scalar_UBYTE 0 SWC_FDC_type_CM_uint8_enum 0.0 15.0 /end CHARACTERISTIC
/begin CHARACTERISTIC KTQD_Manufacture8_enum "" VALUE 0x0000 /* @ECU_Address@KTQD_Manufacture8_enum@ */ Scalar_UBYTE 0 SWC_FDC_type_CM_uint8_enum 0.0 15.0 /end CHARACTERISTIC
/begin CHARACTERISTIC KTQD_StreetFight1_enum "" VALUE 0x0000 /* @ECU_Address@KTQD_StreetFight1_enum@ */ Scalar_UBYTE 0 SWC_FDC_type_CM_uint8_enum 0.0 15.0 /end CHARACTERISTIC
/begin CHARACTERISTIC KTQD_StreetFight2_enum "" VALUE 0x0000 /* @ECU_Address@KTQD_StreetFight2_enum@ */ Scalar_UBYTE 0 SWC_FDC_type_CM_uint8_enum 0.0 15.0 /end CHARACTERISTIC
/begin CHARACTERISTIC KTQD_StreetFight3_enum "" VALUE 0x0000 /* @ECU_Address@KTQD_StreetFight3_enum@ */ Scalar_UBYTE 0 SWC_FDC_type_CM_uint8_enum 0.0 15.0 /end CHARACTERISTIC
/begin CHARACTERISTIC KTQD_StreetFight4_enum "" VALUE 0x0000 /* @ECU_Address@KTQD_StreetFight4_enum@ */ Scalar_UBYTE 0 SWC_FDC_type_CM_uint8_enum 0.0 15.0 /end CHARACTERISTIC
/begin CHARACTERISTIC KTQD_StreetFight5_enum "" VALUE 0x0000 /* @ECU_Address@KTQD_StreetFight5_enum@ */ Scalar_UBYTE 0 SWC_FDC_type_CM_uint8_enum 0.0 15.0 /end CHARACTERISTIC
/begin CHARACTERISTIC KTQD_StreetFight6_enum "" VALUE 0x0000 /* @ECU_Address@KTQD_StreetFight6_enum@ */ Scalar_UBYTE 0 SWC_FDC_type_CM_uint8_enum 0.0 15.0 /end CHARACTERISTIC
/begin CHARACTERISTIC KTQD_StreetFight7_enum "" VALUE 0x0000 /* @ECU_Address@KTQD_StreetFight7_enum@ */ Scalar_UBYTE 0 SWC_FDC_type_CM_uint8_enum 0.0 15.0 /end CHARACTERISTIC
/begin CHARACTERISTIC KTQD_StreetFight8_enum "" VALUE 0x0000 /* @ECU_Address@KTQD_StreetFight8_enum@ */ Scalar_UBYTE 0 SWC_FDC_type_CM_uint8_enum 0.0 15.0 /end CHARACTERISTIC
/begin MEASUREMENT VTQD_PedAccTqUpLim_Nm "" FLOAT32_IEEE SWC_FDC_type_CM_single_Nm 0 0 -100000.0 100000.0 ECU_ADDRESS 0x0000 /* @ECU_Address@VTQD_PedAccTqUpLim_Nm@ */ /end MEASUREMENT
/begin MEASUREMENT VTQD_LastPedalTqCal_Nm "" FLOAT32_IEEE SWC_FDC_type_CM_single_Nm 0 0 -100000.0 100000.0 ECU_ADDRESS 0x0000 /* @ECU_Address@VTQD_LastPedalTqCal_Nm@ */ /end MEASUREMENT
/begin MEASUREMENT VTQD_PedalAccelCMDWC_mps2 "" FLOAT32_IEEE SWC_FDC_type_CM_single_mps2 0 0 -20.0 20.0 ECU_ADDRESS 0x0000 /* @ECU_Address@VTQD_PedalAccelCMDWC_mps2@ */ /end MEASUREMENT
/begin MEASUREMENT VTQD_PedalAccelCMD_mps2 "" FLOAT32_IEEE SWC_FDC_type_CM_single_mps2 0 0 -20.0 20.0 ECU_ADDRESS 0x0000 /* @ECU_Address@VTQD_PedalAccelCMD_mps2@ */ /end MEASUREMENT
/begin MEASUREMENT VTQD_PedalReqAccel_mps2 "" FLOAT32_IEEE SWC_FDC_type_CM_single_mps2 0 0 -20.0 20.0 ECU_ADDRESS 0x0000 /* @ECU_Address@VTQD_PedalReqAccel_mps2@ */ /end MEASUREMENT
/begin MEASUREMENT VTQD_PedAccTqLowLim_Nm "" FLOAT32_IEEE SWC_FDC_type_CM_single_Nm 0 0 -100000.0 100000.0 ECU_ADDRESS 0x0000 /* @ECU_Address@VTQD_PedAccTqLowLim_Nm@ */ /end MEASUREMENT
/begin MEASUREMENT VTQD_PedAccBrkTq_Nm "" FLOAT32_IEEE SWC_FDC_type_CM_single_Nm 0 0 -100000.0 100000.0 ECU_ADDRESS 0x0000 /* @ECU_Address@VTQD_PedAccBrkTq_Nm@ */ /end MEASUREMENT
/begin MEASUREMENT VTQD_PedalAccDev_mps2 "" FLOAT32_IEEE SWC_FDC_type_CM_single_mps2 0 0 -20.0 20.0 ECU_ADDRESS 0x0000 /* @ECU_Address@VTQD_PedalAccDev_mps2@ */ /end MEASUREMENT
/begin MEASUREMENT VTQD_PedalAccDeltaTq_Nm "" FLOAT32_IEEE SWC_FDC_type_CM_single_Nm 0 0 -100000.0 100000.0 ECU_ADDRESS 0x0000 /* @ECU_Address@VTQD_PedalAccDeltaTq_Nm@ */ /end MEASUREMENT
/begin MEASUREMENT VTQD_PedalTqCal_Nm "" FLOAT32_IEEE SWC_FDC_type_CM_single_Nm 0 0 -100000.0 100000.0 ECU_ADDRESS 0x0000 /* @ECU_Address@VTQD_PedalTqCal_Nm@ */ /end MEASUREMENT
/begin MEASUREMENT VTQD_SOPDActTqMapD_Nm "" FLOAT32_IEEE SWC_FDC_type_CM_single_Nm 0 0 -100000.0 100000.0 ECU_ADDRESS 0x0000 /* @ECU_Address@VTQD_SOPDActTqMapD_Nm@ */ /end MEASUREMENT
/begin MEASUREMENT VTQD_EOPDActTqMapD_Nm "" FLOAT32_IEEE SWC_FDC_type_CM_single_Nm 0 0 -100000.0 100000.0 ECU_ADDRESS 0x0000 /* @ECU_Address@VTQD_EOPDActTqMapD_Nm@ */ /end MEASUREMENT
/begin MEASUREMENT VTQD_NOPDActTqMapD_Nm "" FLOAT32_IEEE SWC_FDC_type_CM_single_Nm 0 0 -100000.0 100000.0 ECU_ADDRESS 0x0000 /* @ECU_Address@VTQD_NOPDActTqMapD_Nm@ */ /end MEASUREMENT
/begin MEASUREMENT VTQD_CANCELCountDetTime_s "" FLOAT32_IEEE SWC_FDC_type_CM_single_s 0 0 0.0 3600.0 ECU_ADDRESS 0x0000 /* @ECU_Address@VTQD_CANCELCountDetTime_s@ */ /end MEASUREMENT
/begin MEASUREMENT VTPM_LFS1_cnt "" UBYTE SWC_FDC_type_CM_uint8_cnt 0 0 0.0 255.0 ECU_ADDRESS 0x0000 /* @ECU_Address@VTPM_LFS1_cnt@ */ /end MEASUREMENT
/begin MEASUREMENT VTPM_RRS1_cnt "" UBYTE SWC_FDC_type_CM_uint8_cnt 0 0 0.0 255.0 ECU_ADDRESS 0x0000 /* @ECU_Address@VTPM_RRS1_cnt@ */ /end MEASUREMENT
/begin MEASUREMENT VTPM_LRS1_cnt "" UBYTE SWC_FDC_type_CM_uint8_cnt 0 0 0.0 255.0 ECU_ADDRESS 0x0000 /* @ECU_Address@VTPM_LRS1_cnt@ */ /end MEASUREMENT
/begin MEASUREMENT VTPM_RFS1_cnt "" UBYTE SWC_FDC_type_CM_uint8_cnt 0 0 0.0 255.0 ECU_ADDRESS 0x0000 /* @ECU_Address@VTPM_RFS1_cnt@ */ /end MEASUREMENT
/begin MEASUREMENT VTPM_LFS4_cnt "" UBYTE SWC_FDC_type_CM_uint8_cnt 0 0 0.0 255.0 ECU_ADDRESS 0x0000 /* @ECU_Address@VTPM_LFS4_cnt@ */ /end MEASUREMENT
/begin MEASUREMENT VTPM_RRS4_cnt "" UBYTE SWC_FDC_type_CM_uint8_cnt 0 0 0.0 255.0 ECU_ADDRESS 0x0000 /* @ECU_Address@VTPM_RRS4_cnt@ */ /end MEASUREMENT
/begin MEASUREMENT VTPM_LRS4_cnt "" UBYTE SWC_FDC_type_CM_uint8_cnt 0 0 0.0 255.0 ECU_ADDRESS 0x0000 /* @ECU_Address@VTPM_LRS4_cnt@ */ /end MEASUREMENT
/begin MEASUREMENT VTPM_RFS4_cnt "" UBYTE SWC_FDC_type_CM_uint8_cnt 0 0 0.0 255.0 ECU_ADDRESS 0x0000 /* @ECU_Address@VTPM_RFS4_cnt@ */ /end MEASUREMENT
/begin MEASUREMENT VTPM_LFS3_cnt "" UBYTE SWC_FDC_type_CM_uint8_cnt 0 0 0.0 255.0 ECU_ADDRESS 0x0000 /* @ECU_Address@VTPM_LFS3_cnt@ */ /end MEASUREMENT
/begin MEASUREMENT VTPM_RRS3_cnt "" UBYTE SWC_FDC_type_CM_uint8_cnt 0 0 0.0 255.0 ECU_ADDRESS 0x0000 /* @ECU_Address@VTPM_RRS3_cnt@ */ /end MEASUREMENT
/begin MEASUREMENT VTPM_LRS3_cnt "" UBYTE SWC_FDC_type_CM_uint8_cnt 0 0 0.0 255.0 ECU_ADDRESS 0x0000 /* @ECU_Address@VTPM_LRS3_cnt@ */ /end MEASUREMENT
/begin MEASUREMENT VTPM_RFS3_cnt "" UBYTE SWC_FDC_type_CM_uint8_cnt 0 0 0.0 255.0 ECU_ADDRESS 0x0000 /* @ECU_Address@VTPM_RFS3_cnt@ */ /end MEASUREMENT
/begin MEASUREMENT VTPM_LFS2_cnt "" UBYTE SWC_FDC_type_CM_uint8_cnt 0 0 0.0 255.0 ECU_ADDRESS 0x0000 /* @ECU_Address@VTPM_LFS2_cnt@ */ /end MEASUREMENT
/begin MEASUREMENT VTPM_RRS2_cnt "" UBYTE SWC_FDC_type_CM_uint8_cnt 0 0 0.0 255.0 ECU_ADDRESS 0x0000 /* @ECU_Address@VTPM_RRS2_cnt@ */ /end MEASUREMENT
/begin MEASUREMENT VTPM_LRS2_cnt "" UBYTE SWC_FDC_type_CM_uint8_cnt 0 0 0.0 255.0 ECU_ADDRESS 0x0000 /* @ECU_Address@VTPM_LRS2_cnt@ */ /end MEASUREMENT
/begin MEASUREMENT VTPM_RFS2_cnt "" UBYTE SWC_FDC_type_CM_uint8_cnt 0 0 0.0 255.0 ECU_ADDRESS 0x0000 /* @ECU_Address@VTPM_RFS2_cnt@ */ /end MEASUREMENT
/begin MEASUREMENT VTQD_DiagnosisOff8_enum "" UBYTE SWC_FDC_type_CM_uint8_enum 0 0 0.0 15.0 ECU_ADDRESS 0x0000 /* @ECU_Address@VTQD_DiagnosisOff8_enum@ */ /end MEASUREMENT
/begin MEASUREMENT VTQD_DiagnosisOff1_enum "" UBYTE SWC_FDC_type_CM_uint8_enum 0 0 0.0 15.0 ECU_ADDRESS 0x0000 /* @ECU_Address@VTQD_DiagnosisOff1_enum@ */ /end MEASUREMENT
/begin MEASUREMENT VTQD_DiagnosisOff2_enum "" UBYTE SWC_FDC_type_CM_uint8_enum 0 0 0.0 15.0 ECU_ADDRESS 0x0000 /* @ECU_Address@VTQD_DiagnosisOff2_enum@ */ /end MEASUREMENT
/begin MEASUREMENT VTQD_DiagnosisOff3_enum "" UBYTE SWC_FDC_type_CM_uint8_enum 0 0 0.0 15.0 ECU_ADDRESS 0x0000 /* @ECU_Address@VTQD_DiagnosisOff3_enum@ */ /end MEASUREMENT
/begin MEASUREMENT VTQD_DiagnosisOff4_enum "" UBYTE SWC_FDC_type_CM_uint8_enum 0 0 0.0 15.0 ECU_ADDRESS 0x0000 /* @ECU_Address@VTQD_DiagnosisOff4_enum@ */ /end MEASUREMENT
/begin MEASUREMENT VTQD_DiagnosisOff5_enum "" UBYTE SWC_FDC_type_CM_uint8_enum 0 0 0.0 15.0 ECU_ADDRESS 0x0000 /* @ECU_Address@VTQD_DiagnosisOff5_enum@ */ /end MEASUREMENT
/begin MEASUREMENT VTQD_DiagnosisOff6_enum "" UBYTE SWC_FDC_type_CM_uint8_enum 0 0 0.0 15.0 ECU_ADDRESS 0x0000 /* @ECU_Address@VTQD_DiagnosisOff6_enum@ */ /end MEASUREMENT
/begin MEASUREMENT VTQD_DiagnosisOff7_enum "" UBYTE SWC_FDC_type_CM_uint8_enum 0 0 0.0 15.0 ECU_ADDRESS 0x0000 /* @ECU_Address@VTQD_DiagnosisOff7_enum@ */ /end MEASUREMENT
/begin MEASUREMENT VTQD_Engineering8_enum "" UBYTE SWC_FDC_type_CM_uint8_enum 0 0 0.0 15.0 ECU_ADDRESS 0x0000 /* @ECU_Address@VTQD_Engineering8_enum@ */ /end MEASUREMENT
/begin MEASUREMENT VTQD_Engineering1_enum "" UBYTE SWC_FDC_type_CM_uint8_enum 0 0 0.0 15.0 ECU_ADDRESS 0x0000 /* @ECU_Address@VTQD_Engineering1_enum@ */ /end MEASUREMENT
/begin MEASUREMENT VTQD_Engineering2_enum "" UBYTE SWC_FDC_type_CM_uint8_enum 0 0 0.0 15.0 ECU_ADDRESS 0x0000 /* @ECU_Address@VTQD_Engineering2_enum@ */ /end MEASUREMENT
/begin MEASUREMENT VTQD_Engineering3_enum "" UBYTE SWC_FDC_type_CM_uint8_enum 0 0 0.0 15.0 ECU_ADDRESS 0x0000 /* @ECU_Address@VTQD_Engineering3_enum@ */ /end MEASUREMENT
/begin MEASUREMENT VTQD_Engineering4_enum "" UBYTE SWC_FDC_type_CM_uint8_enum 0 0 0.0 15.0 ECU_ADDRESS 0x0000 /* @ECU_Address@VTQD_Engineering4_enum@ */ /end MEASUREMENT
/begin MEASUREMENT VTQD_Engineering5_enum "" UBYTE SWC_FDC_type_CM_uint8_enum 0 0 0.0 15.0 ECU_ADDRESS 0x0000 /* @ECU_Address@VTQD_Engineering5_enum@ */ /end MEASUREMENT
/begin MEASUREMENT VTQD_Engineering6_enum "" UBYTE SWC_FDC_type_CM_uint8_enum 0 0 0.0 15.0 ECU_ADDRESS 0x0000 /* @ECU_Address@VTQD_Engineering6_enum@ */ /end MEASUREMENT
/begin MEASUREMENT VTQD_Engineering7_enum "" UBYTE SWC_FDC_type_CM_uint8_enum 0 0 0.0 15.0 ECU_ADDRESS 0x0000 /* @ECU_Address@VTQD_Engineering7_enum@ */ /end MEASUREMENT
/begin MEASUREMENT VTQD_Exhibition8_enum "" UBYTE SWC_FDC_type_CM_uint8_enum 0 0 0.0 15.0 ECU_ADDRESS 0x0000 /* @ECU_Address@VTQD_Exhibition8_enum@ */ /end MEASUREMENT
/begin MEASUREMENT VTQD_Exhibition1_enum "" UBYTE SWC_FDC_type_CM_uint8_enum 0 0 0.0 15.0 ECU_ADDRESS 0x0000 /* @ECU_Address@VTQD_Exhibition1_enum@ */ /end MEASUREMENT
/begin MEASUREMENT VTQD_Exhibition2_enum "" UBYTE SWC_FDC_type_CM_uint8_enum 0 0 0.0 15.0 ECU_ADDRESS 0x0000 /* @ECU_Address@VTQD_Exhibition2_enum@ */ /end MEASUREMENT
/begin MEASUREMENT VTQD_Exhibition3_enum "" UBYTE SWC_FDC_type_CM_uint8_enum 0 0 0.0 15.0 ECU_ADDRESS 0x0000 /* @ECU_Address@VTQD_Exhibition3_enum@ */ /end MEASUREMENT
/begin MEASUREMENT VTQD_Exhibition4_enum "" UBYTE SWC_FDC_type_CM_uint8_enum 0 0 0.0 15.0 ECU_ADDRESS 0x0000 /* @ECU_Address@VTQD_Exhibition4_enum@ */ /end MEASUREMENT
/begin MEASUREMENT VTQD_Exhibition5_enum "" UBYTE SWC_FDC_type_CM_uint8_enum 0 0 0.0 15.0 ECU_ADDRESS 0x0000 /* @ECU_Address@VTQD_Exhibition5_enum@ */ /end MEASUREMENT
/begin MEASUREMENT VTQD_Exhibition6_enum "" UBYTE SWC_FDC_type_CM_uint8_enum 0 0 0.0 15.0 ECU_ADDRESS 0x0000 /* @ECU_Address@VTQD_Exhibition6_enum@ */ /end MEASUREMENT
/begin MEASUREMENT VTQD_Exhibition7_enum "" UBYTE SWC_FDC_type_CM_uint8_enum 0 0 0.0 15.0 ECU_ADDRESS 0x0000 /* @ECU_Address@VTQD_Exhibition7_enum@ */ /end MEASUREMENT
/begin MEASUREMENT VTQD_Manufacture8_enum "" UBYTE SWC_FDC_type_CM_uint8_enum 0 0 0.0 15.0 ECU_ADDRESS 0x0000 /* @ECU_Address@VTQD_Manufacture8_enum@ */ /end MEASUREMENT
/begin MEASUREMENT VTQD_Manufacture1_enum "" UBYTE SWC_FDC_type_CM_uint8_enum 0 0 0.0 15.0 ECU_ADDRESS 0x0000 /* @ECU_Address@VTQD_Manufacture1_enum@ */ /end MEASUREMENT
/begin MEASUREMENT VTQD_Manufacture2_enum "" UBYTE SWC_FDC_type_CM_uint8_enum 0 0 0.0 15.0 ECU_ADDRESS 0x0000 /* @ECU_Address@VTQD_Manufacture2_enum@ */ /end MEASUREMENT
/begin MEASUREMENT VTQD_Manufacture3_enum "" UBYTE SWC_FDC_type_CM_uint8_enum 0 0 0.0 15.0 ECU_ADDRESS 0x0000 /* @ECU_Address@VTQD_Manufacture3_enum@ */ /end MEASUREMENT
/begin MEASUREMENT VTQD_Manufacture4_enum "" UBYTE SWC_FDC_type_CM_uint8_enum 0 0 0.0 15.0 ECU_ADDRESS 0x0000 /* @ECU_Address@VTQD_Manufacture4_enum@ */ /end MEASUREMENT
/begin MEASUREMENT VTQD_Manufacture5_enum "" UBYTE SWC_FDC_type_CM_uint8_enum 0 0 0.0 15.0 ECU_ADDRESS 0x0000 /* @ECU_Address@VTQD_Manufacture5_enum@ */ /end MEASUREMENT
/begin MEASUREMENT VTQD_Manufacture6_enum "" UBYTE SWC_FDC_type_CM_uint8_enum 0 0 0.0 15.0 ECU_ADDRESS 0x0000 /* @ECU_Address@VTQD_Manufacture6_enum@ */ /end MEASUREMENT
/begin MEASUREMENT VTQD_Manufacture7_enum "" UBYTE SWC_FDC_type_CM_uint8_enum 0 0 0.0 15.0 ECU_ADDRESS 0x0000 /* @ECU_Address@VTQD_Manufacture7_enum@ */ /end MEASUREMENT
/begin MEASUREMENT VTQD_StreetFight8_enum "" UBYTE SWC_FDC_type_CM_uint8_enum 0 0 0.0 15.0 ECU_ADDRESS 0x0000 /* @ECU_Address@VTQD_StreetFight8_enum@ */ /end MEASUREMENT
/begin MEASUREMENT VTQD_StreetFight1_enum "" UBYTE SWC_FDC_type_CM_uint8_enum 0 0 0.0 15.0 ECU_ADDRESS 0x0000 /* @ECU_Address@VTQD_StreetFight1_enum@ */ /end MEASUREMENT
/begin MEASUREMENT VTQD_StreetFight2_enum "" UBYTE SWC_FDC_type_CM_uint8_enum 0 0 0.0 15.0 ECU_ADDRESS 0x0000 /* @ECU_Address@VTQD_StreetFight2_enum@ */ /end MEASUREMENT
/begin MEASUREMENT VTQD_StreetFight3_enum "" UBYTE SWC_FDC_type_CM_uint8_enum 0 0 0.0 15.0 ECU_ADDRESS 0x0000 /* @ECU_Address@VTQD_StreetFight3_enum@ */ /end MEASUREMENT
/begin MEASUREMENT VTQD_StreetFight4_enum "" UBYTE SWC_FDC_type_CM_uint8_enum 0 0 0.0 15.0 ECU_ADDRESS 0x0000 /* @ECU_Address@VTQD_StreetFight4_enum@ */ /end MEASUREMENT
/begin MEASUREMENT VTQD_StreetFight5_enum "" UBYTE SWC_FDC_type_CM_uint8_enum 0 0 0.0 15.0 ECU_ADDRESS 0x0000 /* @ECU_Address@VTQD_StreetFight5_enum@ */ /end MEASUREMENT
/begin MEASUREMENT VTQD_StreetFight6_enum "" UBYTE SWC_FDC_type_CM_uint8_enum 0 0 0.0 15.0 ECU_ADDRESS 0x0000 /* @ECU_Address@VTQD_StreetFight6_enum@ */ /end MEASUREMENT
/begin MEASUREMENT VTQD_StreetFight7_enum "" UBYTE SWC_FDC_type_CM_uint8_enum 0 0 0.0 15.0 ECU_ADDRESS 0x0000 /* @ECU_Address@VTQD_StreetFight7_enum@ */ /end MEASUREMENT
/begin MEASUREMENT VTQD_PedGControlTrig_flg "" UBYTE SWC_FDC_type_CM_boolean_flg 0 0 0.0 1.0 ECU_ADDRESS 0x0000 /* @ECU_Address@VTQD_PedGControlTrig_flg@ */ /end MEASUREMENT
/begin MEASUREMENT VTQD_OPDHoldRelPedTq_flg "" UBYTE SWC_FDC_type_CM_boolean_flg 0 0 0.0 1.0 ECU_ADDRESS 0x0000 /* @ECU_Address@VTQD_OPDHoldRelPedTq_flg@ */ /end MEASUREMENT
/begin MEASUREMENT VTQD_DiagnosisOff1Pass_flg "" UBYTE SWC_FDC_type_CM_boolean_flg 0 0 0.0 1.0 ECU_ADDRESS 0x0000 /* @ECU_Address@VTQD_DiagnosisOff1Pass_flg@ */ /end MEASUREMENT
/begin MEASUREMENT VTQD_DiagnosisOff2Pass_flg "" UBYTE SWC_FDC_type_CM_boolean_flg 0 0 0.0 1.0 ECU_ADDRESS 0x0000 /* @ECU_Address@VTQD_DiagnosisOff2Pass_flg@ */ /end MEASUREMENT
/begin MEASUREMENT VTQD_DiagnosisOff3Pass_flg "" UBYTE SWC_FDC_type_CM_boolean_flg 0 0 0.0 1.0 ECU_ADDRESS 0x0000 /* @ECU_Address@VTQD_DiagnosisOff3Pass_flg@ */ /end MEASUREMENT
/begin MEASUREMENT VTQD_DiagnosisOff4Pass_flg "" UBYTE SWC_FDC_type_CM_boolean_flg 0 0 0.0 1.0 ECU_ADDRESS 0x0000 /* @ECU_Address@VTQD_DiagnosisOff4Pass_flg@ */ /end MEASUREMENT
/begin MEASUREMENT VTQD_DiagnosisOff5Pass_flg "" UBYTE SWC_FDC_type_CM_boolean_flg 0 0 0.0 1.0 ECU_ADDRESS 0x0000 /* @ECU_Address@VTQD_DiagnosisOff5Pass_flg@ */ /end MEASUREMENT
/begin MEASUREMENT VTQD_DiagnosisOff6Pass_flg "" UBYTE SWC_FDC_type_CM_boolean_flg 0 0 0.0 1.0 ECU_ADDRESS 0x0000 /* @ECU_Address@VTQD_DiagnosisOff6Pass_flg@ */ /end MEASUREMENT
/begin MEASUREMENT VTQD_DiagnosisOff7Pass_flg "" UBYTE SWC_FDC_type_CM_boolean_flg 0 0 0.0 1.0 ECU_ADDRESS 0x0000 /* @ECU_Address@VTQD_DiagnosisOff7Pass_flg@ */ /end MEASUREMENT
/begin MEASUREMENT VTQD_DiagnosisOff8Pass_flg "" UBYTE SWC_FDC_type_CM_boolean_flg 0 0 0.0 1.0 ECU_ADDRESS 0x0000 /* @ECU_Address@VTQD_DiagnosisOff8Pass_flg@ */ /end MEASUREMENT
/begin MEASUREMENT VTQD_Engineering1Pass_flg "" UBYTE SWC_FDC_type_CM_boolean_flg 0 0 0.0 1.0 ECU_ADDRESS 0x0000 /* @ECU_Address@VTQD_Engineering1Pass_flg@ */ /end MEASUREMENT
/begin MEASUREMENT VTQD_Engineering2Pass_flg "" UBYTE SWC_FDC_type_CM_boolean_flg 0 0 0.0 1.0 ECU_ADDRESS 0x0000 /* @ECU_Address@VTQD_Engineering2Pass_flg@ */ /end MEASUREMENT
/begin MEASUREMENT VTQD_Engineering3Pass_flg "" UBYTE SWC_FDC_type_CM_boolean_flg 0 0 0.0 1.0 ECU_ADDRESS 0x0000 /* @ECU_Address@VTQD_Engineering3Pass_flg@ */ /end MEASUREMENT
/begin MEASUREMENT VTQD_Engineering4Pass_flg "" UBYTE SWC_FDC_type_CM_boolean_flg 0 0 0.0 1.0 ECU_ADDRESS 0x0000 /* @ECU_Address@VTQD_Engineering4Pass_flg@ */ /end MEASUREMENT
/begin MEASUREMENT VTQD_Engineering5Pass_flg "" UBYTE SWC_FDC_type_CM_boolean_flg 0 0 0.0 1.0 ECU_ADDRESS 0x0000 /* @ECU_Address@VTQD_Engineering5Pass_flg@ */ /end MEASUREMENT
/begin MEASUREMENT VTQD_Engineering6Pass_flg "" UBYTE SWC_FDC_type_CM_boolean_flg 0 0 0.0 1.0 ECU_ADDRESS 0x0000 /* @ECU_Address@VTQD_Engineering6Pass_flg@ */ /end MEASUREMENT
/begin MEASUREMENT VTQD_Engineering7Pass_flg "" UBYTE SWC_FDC_type_CM_boolean_flg 0 0 0.0 1.0 ECU_ADDRESS 0x0000 /* @ECU_Address@VTQD_Engineering7Pass_flg@ */ /end MEASUREMENT
/begin MEASUREMENT VTQD_Engineering8Pass_flg "" UBYTE SWC_FDC_type_CM_boolean_flg 0 0 0.0 1.0 ECU_ADDRESS 0x0000 /* @ECU_Address@VTQD_Engineering8Pass_flg@ */ /end MEASUREMENT
/begin MEASUREMENT VTQD_Exhibition1Pass_flg "" UBYTE SWC_FDC_type_CM_boolean_flg 0 0 0.0 1.0 ECU_ADDRESS 0x0000 /* @ECU_Address@VTQD_Exhibition1Pass_flg@ */ /end MEASUREMENT
/begin MEASUREMENT VTQD_Exhibition2Pass_flg "" UBYTE SWC_FDC_type_CM_boolean_flg 0 0 0.0 1.0 ECU_ADDRESS 0x0000 /* @ECU_Address@VTQD_Exhibition2Pass_flg@ */ /end MEASUREMENT
/begin MEASUREMENT VTQD_Exhibition3Pass_flg "" UBYTE SWC_FDC_type_CM_boolean_flg 0 0 0.0 1.0 ECU_ADDRESS 0x0000 /* @ECU_Address@VTQD_Exhibition3Pass_flg@ */ /end MEASUREMENT
/begin MEASUREMENT VTQD_Exhibition4Pass_flg "" UBYTE SWC_FDC_type_CM_boolean_flg 0 0 0.0 1.0 ECU_ADDRESS 0x0000 /* @ECU_Address@VTQD_Exhibition4Pass_flg@ */ /end MEASUREMENT
/begin MEASUREMENT VTQD_Exhibition5Pass_flg "" UBYTE SWC_FDC_type_CM_boolean_flg 0 0 0.0 1.0 ECU_ADDRESS 0x0000 /* @ECU_Address@VTQD_Exhibition5Pass_flg@ */ /end MEASUREMENT
/begin MEASUREMENT VTQD_Exhibition6Pass_flg "" UBYTE SWC_FDC_type_CM_boolean_flg 0 0 0.0 1.0 ECU_ADDRESS 0x0000 /* @ECU_Address@VTQD_Exhibition6Pass_flg@ */ /end MEASUREMENT
/begin MEASUREMENT VTQD_Exhibition7Pass_flg "" UBYTE SWC_FDC_type_CM_boolean_flg 0 0 0.0 1.0 ECU_ADDRESS 0x0000 /* @ECU_Address@VTQD_Exhibition7Pass_flg@ */ /end MEASUREMENT
/begin MEASUREMENT VTQD_Exhibition8Pass_flg "" UBYTE SWC_FDC_type_CM_boolean_flg 0 0 0.0 1.0 ECU_ADDRESS 0x0000 /* @ECU_Address@VTQD_Exhibition8Pass_flg@ */ /end MEASUREMENT
/begin MEASUREMENT VTQD_Manufacture1Pass_flg "" UBYTE SWC_FDC_type_CM_boolean_flg 0 0 0.0 1.0 ECU_ADDRESS 0x0000 /* @ECU_Address@VTQD_Manufacture1Pass_flg@ */ /end MEASUREMENT
/begin MEASUREMENT VTQD_Manufacture2Pass_flg "" UBYTE SWC_FDC_type_CM_boolean_flg 0 0 0.0 1.0 ECU_ADDRESS 0x0000 /* @ECU_Address@VTQD_Manufacture2Pass_flg@ */ /end MEASUREMENT
/begin MEASUREMENT VTQD_Manufacture3Pass_flg "" UBYTE SWC_FDC_type_CM_boolean_flg 0 0 0.0 1.0 ECU_ADDRESS 0x0000 /* @ECU_Address@VTQD_Manufacture3Pass_flg@ */ /end MEASUREMENT
/begin MEASUREMENT VTQD_Manufacture4Pass_flg "" UBYTE SWC_FDC_type_CM_boolean_flg 0 0 0.0 1.0 ECU_ADDRESS 0x0000 /* @ECU_Address@VTQD_Manufacture4Pass_flg@ */ /end MEASUREMENT
/begin MEASUREMENT VTQD_Manufacture5Pass_flg "" UBYTE SWC_FDC_type_CM_boolean_flg 0 0 0.0 1.0 ECU_ADDRESS 0x0000 /* @ECU_Address@VTQD_Manufacture5Pass_flg@ */ /end MEASUREMENT
/begin MEASUREMENT VTQD_Manufacture6Pass_flg "" UBYTE SWC_FDC_type_CM_boolean_flg 0 0 0.0 1.0 ECU_ADDRESS 0x0000 /* @ECU_Address@VTQD_Manufacture6Pass_flg@ */ /end MEASUREMENT
/begin MEASUREMENT VTQD_Manufacture7Pass_flg "" UBYTE SWC_FDC_type_CM_boolean_flg 0 0 0.0 1.0 ECU_ADDRESS 0x0000 /* @ECU_Address@VTQD_Manufacture7Pass_flg@ */ /end MEASUREMENT
/begin MEASUREMENT VTQD_Manufacture8Pass_flg "" UBYTE SWC_FDC_type_CM_boolean_flg 0 0 0.0 1.0 ECU_ADDRESS 0x0000 /* @ECU_Address@VTQD_Manufacture8Pass_flg@ */ /end MEASUREMENT
/begin MEASUREMENT VTQD_StreetFight1Pass_flg "" UBYTE SWC_FDC_type_CM_boolean_flg 0 0 0.0 1.0 ECU_ADDRESS 0x0000 /* @ECU_Address@VTQD_StreetFight1Pass_flg@ */ /end MEASUREMENT
/begin MEASUREMENT VTQD_StreetFight2Pass_flg "" UBYTE SWC_FDC_type_CM_boolean_flg 0 0 0.0 1.0 ECU_ADDRESS 0x0000 /* @ECU_Address@VTQD_StreetFight2Pass_flg@ */ /end MEASUREMENT
/begin MEASUREMENT VTQD_StreetFight3Pass_flg "" UBYTE SWC_FDC_type_CM_boolean_flg 0 0 0.0 1.0 ECU_ADDRESS 0x0000 /* @ECU_Address@VTQD_StreetFight3Pass_flg@ */ /end MEASUREMENT
/begin MEASUREMENT VTQD_StreetFight4Pass_flg "" UBYTE SWC_FDC_type_CM_boolean_flg 0 0 0.0 1.0 ECU_ADDRESS 0x0000 /* @ECU_Address@VTQD_StreetFight4Pass_flg@ */ /end MEASUREMENT
/begin MEASUREMENT VTQD_StreetFight5Pass_flg "" UBYTE SWC_FDC_type_CM_boolean_flg 0 0 0.0 1.0 ECU_ADDRESS 0x0000 /* @ECU_Address@VTQD_StreetFight5Pass_flg@ */ /end MEASUREMENT
/begin MEASUREMENT VTQD_StreetFight6Pass_flg "" UBYTE SWC_FDC_type_CM_boolean_flg 0 0 0.0 1.0 ECU_ADDRESS 0x0000 /* @ECU_Address@VTQD_StreetFight6Pass_flg@ */ /end MEASUREMENT
/begin MEASUREMENT VTQD_StreetFight7Pass_flg "" UBYTE SWC_FDC_type_CM_boolean_flg 0 0 0.0 1.0 ECU_ADDRESS 0x0000 /* @ECU_Address@VTQD_StreetFight7Pass_flg@ */ /end MEASUREMENT
/begin MEASUREMENT VTQD_StreetFight8Pass_flg "" UBYTE SWC_FDC_type_CM_boolean_flg 0 0 0.0 1.0 ECU_ADDRESS 0x0000 /* @ECU_Address@VTQD_StreetFight8Pass_flg@ */ /end MEASUREMENT
/begin COMPU_METHOD SWC_FDC_type_CM_single_s "Q = V" RAT_FUNC "%8.6" "s" COEFFS 0 1 0 0 0 1 /end COMPU_METHOD
/begin COMPU_METHOD SWC_FDC_type_CM_single_rpm "Q = V" RAT_FUNC "%8.6" "rpm" COEFFS 0 1 0 0 0 1 /end COMPU_METHOD
/begin COMPU_METHOD SWC_FDC_type_CM_uint8_enum "Q = V" RAT_FUNC "%3.0" "enum" COEFFS 0 1 0 0 0 1 /end COMPU_METHOD
/begin COMPU_METHOD SWC_FDC_type_CM_single_kph "Q = V" RAT_FUNC "%8.6" "kph" COEFFS 0 1 0 0 0 1 /end COMPU_METHOD
/begin COMPU_METHOD SWC_FDC_type_CM_single_c "Q = V" RAT_FUNC "%8.6" "c" COEFFS 0 1 0 0 0 1 /end COMPU_METHOD
/begin COMPU_METHOD SWC_FDC_type_CM_single_mps2 "Q = V" RAT_FUNC "%8.6" "mps2" COEFFS 0 1 0 0 0 1 /end COMPU_METHOD
/begin COMPU_METHOD SWC_FDC_type_CM_single_pct "Q = V" RAT_FUNC "%8.6" "pct" COEFFS 0 1 0 0 0 1 /end COMPU_METHOD
/begin COMPU_METHOD SWC_FDC_type_CM_single_Deg "Q = V" RAT_FUNC "%8.6" "Deg" COEFFS 0 1 0 0 0 1 /end COMPU_METHOD
/begin COMPU_METHOD SWC_FDC_type_CM_single_Nm "Q = V" RAT_FUNC "%8.6" "Nm" COEFFS 0 1 0 0 0 1 /end COMPU_METHOD
/begin COMPU_METHOD SWC_FDC_type_CM_boolean_flg "Q = V" RAT_FUNC "%1.0" "flg" COEFFS 0 1 0 0 0 1 /end COMPU_METHOD
/begin COMPU_METHOD SWC_FDC_type_CM_uint8_cnt "Q = V" RAT_FUNC "%3.0" "cnt" COEFFS 0 1 0 0 0 1 /end COMPU_METHOD
/begin GROUP S1927_Torque_Calculation "SWC_FDC_type/run_SWC_FDC_RxTx_5ms_sys/APP/TQD/TorqueDemand/TorqueModule/DriverWhlTqDem/PedalMapWhlTq/Pedal G-Control Mode/Torque Calculation"
 /begin REF_CHARACTERISTIC KTQD_PedAccARgnEnSpd_kph KTQD_PedAccBrkDeltaTq_Nm KTQD_PedAccBrkEnPos_pct KTQD_PedAccCMDLowLim_mps2 KTQD_PedAccCMDUpLim_mps2 KTQD_PedAccDevLowLim_mps2 KTQD_PedAccDevUpLim_mps2 KTQD_PedAccTqLowLim_Nm KTQD_PedAccTqUpLim_Nm KTQD_PedGControlEnSpd_kph MTQD_PedAccBrkTq_Y_Nm MTQD_PedalAccelCMDWC_Z_mps2 MTQD_PedalAccelCMD_Z_mps2 MTQD_PedalGDeltaTqIGain_Z_Nm /end REF_CHARACTERISTIC
 /begin REF_MEASUREMENT VTQD_LastPedalTqCal_Nm VTQD_PedAccBrkTq_Nm VTQD_PedAccTqLowLim_Nm VTQD_PedAccTqUpLim_Nm VTQD_PedalAccDeltaTq_Nm VTQD_PedalAccDev_mps2 VTQD_PedalAccelCMDWC_mps2 VTQD_PedalAccelCMD_mps2 VTQD_PedalReqAccel_mps2 VTQD_PedalTqCal_Nm /end REF_MEASUREMENT
/end GROUP
/begin GROUP S2074_Invalid "SWC_FDC_type/run_SWC_FDC_RxTx_5ms_sys/APP/TQR/Determine Torque Request/TorqueArbitrament/TorqueSmooth/Front First order filter input tau map and determination/VTQR_ECOFEDUTs_c/Invalid" /begin REF_CHARACTERISTIC MTQR_EL1FEDUTs_Z_c MTQR_FEDUEL1RegenTs_Y_c /end REF_CHARACTERISTIC /end GROUP
/begin GROUP S2074_LV1 "SWC_FDC_type/run_SWC_FDC_RxTx_5ms_sys/APP/TQR/Determine Torque Request/TorqueArbitrament/TorqueSmooth/Front First order filter input tau map and determination/VTQR_ECOFEDUTs_c/LV1" /begin REF_CHARACTERISTIC MTQR_EL1FEDUTs_Z_c MTQR_FEDUEL1RegenTs_Y_c /end REF_CHARACTERISTIC /end GROUP
/begin GROUP S2074_LV2 "SWC_FDC_type/run_SWC_FDC_RxTx_5ms_sys/APP/TQR/Determine Torque Request/TorqueArbitrament/TorqueSmooth/Front First order filter input tau map and determination/VTQR_ECOFEDUTs_c/LV2" /begin REF_CHARACTERISTIC MTQR_EL2FEDUTs_Z_c /end REF_CHARACTERISTIC /end GROUP
/begin GROUP S2074_LV3 "SWC_FDC_type/run_SWC_FDC_RxTx_5ms_sys/APP/TQR/Determine Torque Request/TorqueArbitrament/TorqueSmooth/Front First order filter input tau map and determination/VTQR_ECOFEDUTs_c/LV3" /begin REF_CHARACTERISTIC MTQR_EL3FEDUTs_Z_c /end REF_CHARACTERISTIC /end GROUP
/begin GROUP S2074_LV4 "SWC_FDC_type/run_SWC_FDC_RxTx_5ms_sys/APP/TQR/Determine Torque Request/TorqueArbitrament/TorqueSmooth/Front First order filter input tau map and determination/VTQR_ECOFEDUTs_c/LV4" /begin REF_CHARACTERISTIC MTQR_EL4FEDUTs_Z_c /end REF_CHARACTERISTIC /end GROUP
/begin GROUP S2074_LV5 "SWC_FDC_type/run_SWC_FDC_RxTx_5ms_sys/APP/TQR/Determine Torque Request/TorqueArbitrament/TorqueSmooth/Front First order filter input tau map and determination/VTQR_ECOFEDUTs_c/LV5" /begin REF_CHARACTERISTIC MTQR_EL5FEDUTs_Z_c /end REF_CHARACTERISTIC /end GROUP
/begin GROUP S2074_OPD "SWC_FDC_type/run_SWC_FDC_RxTx_5ms_sys/APP/TQR/Determine Torque Request/TorqueArbitrament/TorqueSmooth/Front First order filter input tau map and determination/VTQR_ECOFEDUTs_c/OPD" /begin REF_CHARACTERISTIC MTQR_EOPDFEDUTs_Z_c /end REF_CHARACTERISTIC /end GROUP
/begin GROUP S2077_Invalid "SWC_FDC_type/run_SWC_FDC_RxTx_5ms_sys/APP/TQR/Determine Torque Request/TorqueArbitrament/TorqueSmooth/Front First order filter input tau map and determination/VTQR_NORMALFEDUTs_c/Invalid" /begin REF_CHARACTERISTIC MTQR_NL1FEDUTs_Z_c /end REF_CHARACTERISTIC /end GROUP
/begin GROUP S2077_LV1 "SWC_FDC_type/run_SWC_FDC_RxTx_5ms_sys/APP/TQR/Determine Torque Request/TorqueArbitrament/TorqueSmooth/Front First order filter input tau map and determination/VTQR_NORMALFEDUTs_c/LV1" /begin REF_CHARACTERISTIC MTQR_NL1FEDUTs_Z_c /end REF_CHARACTERISTIC /end GROUP
/begin GROUP S2077_LV2 "SWC_FDC_type/run_SWC_FDC_RxTx_5ms_sys/APP/TQR/Determine Torque Request/TorqueArbitrament/TorqueSmooth/Front First order filter input tau map and determination/VTQR_NORMALFEDUTs_c/LV2" /begin REF_CHARACTERISTIC MTQR_NL2FEDUTs_Z_c /end REF_CHARACTERISTIC /end GROUP
/begin GROUP S2077_LV3 "SWC_FDC_type/run_SWC_FDC_RxTx_5ms_sys/APP/TQR/Determine Torque Request/TorqueArbitrament/TorqueSmooth/Front First order filter input tau map and determination/VTQR_NORMALFEDUTs_c/LV3" /begin REF_CHARACTERISTIC MTQR_NL3FEDUTs_Z_c /end REF_CHARACTERISTIC /end GROUP
/begin GROUP S2077_LV4 "SWC_FDC_type/run_SWC_FDC_RxTx_5ms_sys/APP/TQR/Determine Torque Request/TorqueArbitrament/TorqueSmooth/Front First order filter input tau map and determination/VTQR_NORMALFEDUTs_c/LV4" /begin REF_CHARACTERISTIC MTQR_NL4FEDUTs_Z_c /end REF_CHARACTERISTIC /end GROUP
/begin GROUP S2077_LV5 "SWC_FDC_type/run_SWC_FDC_RxTx_5ms_sys/APP/TQR/Determine Torque Request/TorqueArbitrament/TorqueSmooth/Front First order filter input tau map and determination/VTQR_NORMALFEDUTs_c/LV5" /begin REF_CHARACTERISTIC MTQR_NL5FEDUTs_Z_c /end REF_CHARACTERISTIC /end GROUP
/begin GROUP S2077_OPD "SWC_FDC_type/run_SWC_FDC_RxTx_5ms_sys/APP/TQR/Determine Torque Request/TorqueArbitrament/TorqueSmooth/Front First order filter input tau map and determination/VTQR_NORMALFEDUTs_c/OPD" /begin REF_CHARACTERISTIC MTQR_NOPDFEDUTs_Z_c /end REF_CHARACTERISTIC /end GROUP
/begin GROUP S2079_Invalid "SWC_FDC_type/run_SWC_FDC_RxTx_5ms_sys/APP/TQR/Determine Torque Request/TorqueArbitrament/TorqueSmooth/Front First order filter input tau map and determination/VTQR_SPORTFEDUTs_c/Invalid" /begin REF_CHARACTERISTIC MTQR_SL1FEDUTs_Z_c /end REF_CHARACTERISTIC /end GROUP
/begin GROUP S2079_LV1 "SWC_FDC_type/run_SWC_FDC_RxTx_5ms_sys/APP/TQR/Determine Torque Request/TorqueArbitrament/TorqueSmooth/Front First order filter input tau map and determination/VTQR_SPORTFEDUTs_c/LV1" /begin REF_CHARACTERISTIC MTQR_SL1FEDUTs_Z_c /end REF_CHARACTERISTIC /end GROUP
/begin GROUP S2079_LV2 "SWC_FDC_type/run_SWC_FDC_RxTx_5ms_sys/APP/TQR/Determine Torque Request/TorqueArbitrament/TorqueSmooth/Front First order filter input tau map and determination/VTQR_SPORTFEDUTs_c/LV2" /begin REF_CHARACTERISTIC MTQR_SL2FEDUTs_Z_c /end REF_CHARACTERISTIC /end GROUP
/begin GROUP S2079_LV3 "SWC_FDC_type/run_SWC_FDC_RxTx_5ms_sys/APP/TQR/Determine Torque Request/TorqueArbitrament/TorqueSmooth/Front First order filter input tau map and determination/VTQR_SPORTFEDUTs_c/LV3" /begin REF_CHARACTERISTIC MTQR_SL3FEDUTs_Z_c /end REF_CHARACTERISTIC /end GROUP
/begin GROUP S2079_LV4 "SWC_FDC_type/run_SWC_FDC_RxTx_5ms_sys/APP/TQR/Determine Torque Request/TorqueArbitrament/TorqueSmooth/Front First order filter input tau map and determination/VTQR_SPORTFEDUTs_c/LV4" /begin REF_CHARACTERISTIC MTQR_SL4FEDUTs_Z_c /end REF_CHARACTERISTIC /end GROUP
/begin GROUP S2079_LV5 "SWC_FDC_type/run_SWC_FDC_RxTx_5ms_sys/APP/TQR/Determine Torque Request/TorqueArbitrament/TorqueSmooth/Front First order filter input tau map and determination/VTQR_SPORTFEDUTs_c/LV5" /begin REF_CHARACTERISTIC MTQR_SL5FEDUTs_Z_c /end REF_CHARACTERISTIC /end GROUP
/begin GROUP S2079_OPD "SWC_FDC_type/run_SWC_FDC_RxTx_5ms_sys/APP/TQR/Determine Torque Request/TorqueArbitrament/TorqueSmooth/Front First order filter input tau map and determination/VTQR_SPORTFEDUTs_c/OPD" /begin REF_CHARACTERISTIC MTQR_SOPDFEDUTs_Z_c /end REF_CHARACTERISTIC /end GROUP
/begin GROUP S2114_VTQR_FrNegRateLimitDecE_Nm "SWC_FDC_type/run_SWC_FDC_RxTx_5ms_sys/APP/TQR/Determine Torque Request/TorqueArbitrament/TorqueSmooth/Front wheel rate limit determination/Negative Rate limit Determination/VTQR_FrNegRateLimitDecE_Nm" /begin REF_CHARACTERISTIC MTQR_FrNegRateLimitDecE_Z_Nm /end REF_CHARACTERISTIC /end GROUP
/begin GROUP S2114_VTQR_FrNegRateLimitDecN_Nm "SWC_FDC_type/run_SWC_FDC_RxTx_5ms_sys/APP/TQR/Determine Torque Request/TorqueArbitrament/TorqueSmooth/Front wheel rate limit determination/Negative Rate limit Determination/VTQR_FrNegRateLimitDecN_Nm" /begin REF_CHARACTERISTIC MTQR_FrNegRateLimitDecN_Z_Nm /end REF_CHARACTERISTIC /end GROUP
/begin GROUP S2114_VTQR_FrNegRateLimitDecS_Nm "SWC_FDC_type/run_SWC_FDC_RxTx_5ms_sys/APP/TQR/Determine Torque Request/TorqueArbitrament/TorqueSmooth/Front wheel rate limit determination/Negative Rate limit Determination/VTQR_FrNegRateLimitDecS_Nm" /begin REF_CHARACTERISTIC MTQR_FrNegRateLimitDecS_Z_Nm /end REF_CHARACTERISTIC /end GROUP
/begin GROUP S2114_VTQR_FrNegRateLimitIncE_Nm "SWC_FDC_type/run_SWC_FDC_RxTx_5ms_sys/APP/TQR/Determine Torque Request/TorqueArbitrament/TorqueSmooth/Front wheel rate limit determination/Negative Rate limit Determination/VTQR_FrNegRateLimitIncE_Nm" /begin REF_CHARACTERISTIC MTQR_FrNegRateLimitIncE_Z_Nm /end REF_CHARACTERISTIC /end GROUP
/begin GROUP S2114_VTQR_FrNegRateLimitIncN_Nm "SWC_FDC_type/run_SWC_FDC_RxTx_5ms_sys/APP/TQR/Determine Torque Request/TorqueArbitrament/TorqueSmooth/Front wheel rate limit determination/Negative Rate limit Determination/VTQR_FrNegRateLimitIncN_Nm" /begin REF_CHARACTERISTIC MTQR_FrNegRateLimitIncN_Z_Nm /end REF_CHARACTERISTIC /end GROUP
/begin GROUP S2114_VTQR_FrNegRateLimitIncS_Nm "SWC_FDC_type/run_SWC_FDC_RxTx_5ms_sys/APP/TQR/Determine Torque Request/TorqueArbitrament/TorqueSmooth/Front wheel rate limit determination/Negative Rate limit Determination/VTQR_FrNegRateLimitIncS_Nm" /begin REF_CHARACTERISTIC MTQR_FrNegRateLimitIncS_Z_Nm /end REF_CHARACTERISTIC /end GROUP
/begin GROUP S2115_VTQR_FrPosRateLimitDecE_Nm "SWC_FDC_type/run_SWC_FDC_RxTx_5ms_sys/APP/TQR/Determine Torque Request/TorqueArbitrament/TorqueSmooth/Front wheel rate limit determination/Positive Rate limit Determination/VTQR_FrPosRateLimitDecE_Nm" /begin REF_CHARACTERISTIC MTQR_FrPosRateLimitDecE_Z_Nm /end REF_CHARACTERISTIC /end GROUP
/begin GROUP S2115_VTQR_FrPosRateLimitDecN_Nm "SWC_FDC_type/run_SWC_FDC_RxTx_5ms_sys/APP/TQR/Determine Torque Request/TorqueArbitrament/TorqueSmooth/Front wheel rate limit determination/Positive Rate limit Determination/VTQR_FrPosRateLimitDecN_Nm" /begin REF_CHARACTERISTIC MTQR_FrPosRateLimitDecN_Z_Nm /end REF_CHARACTERISTIC /end GROUP
/begin GROUP S2115_VTQR_FrPosRateLimitDecS_Nm "SWC_FDC_type/run_SWC_FDC_RxTx_5ms_sys/APP/TQR/Determine Torque Request/TorqueArbitrament/TorqueSmooth/Front wheel rate limit determination/Positive Rate limit Determination/VTQR_FrPosRateLimitDecS_Nm" /begin REF_CHARACTERISTIC MTQR_FrPosRateLimitDecS_Z_Nm /end REF_CHARACTERISTIC /end GROUP
/begin GROUP S2115_VTQR_FrPosRateLimitIncE_Nm "SWC_FDC_type/run_SWC_FDC_RxTx_5ms_sys/APP/TQR/Determine Torque Request/TorqueArbitrament/TorqueSmooth/Front wheel rate limit determination/Positive Rate limit Determination/VTQR_FrPosRateLimitIncE_Nm" /begin REF_CHARACTERISTIC MTQR_FrPosRateLimitIncE_Z_Nm /end REF_CHARACTERISTIC /end GROUP
/begin GROUP S2115_VTQR_FrPosRateLimitIncN_Nm "SWC_FDC_type/run_SWC_FDC_RxTx_5ms_sys/APP/TQR/Determine Torque Request/TorqueArbitrament/TorqueSmooth/Front wheel rate limit determination/Positive Rate limit Determination/VTQR_FrPosRateLimitIncN_Nm" /begin REF_CHARACTERISTIC MTQR_FrPosRateLimitIncN_Z_Nm /end REF_CHARACTERISTIC /end GROUP
/begin GROUP S2115_VTQR_FrPosRateLimitIncS_Nm "SWC_FDC_type/run_SWC_FDC_RxTx_5ms_sys/APP/TQR/Determine Torque Request/TorqueArbitrament/TorqueSmooth/Front wheel rate limit determination/Positive Rate limit Determination/VTQR_FrPosRateLimitIncS_Nm" /begin REF_CHARACTERISTIC MTQR_FrPosRateLimitIncS_Z_Nm /end REF_CHARACTERISTIC /end GROUP
/begin GROUP S2118_Invalid "SWC_FDC_type/run_SWC_FDC_RxTx_5ms_sys/APP/TQR/Determine Torque Request/TorqueArbitrament/TorqueSmooth/Front wheel rate limit determination/VTQR_ECOFEDURateLimitDec_Nm/Invalid" /begin REF_CHARACTERISTIC MTQR_EL1FEDUTqDecSR_Z_Nm /end REF_CHARACTERISTIC /end GROUP
/begin GROUP S2118_LV1 "SWC_FDC_type/run_SWC_FDC_RxTx_5ms_sys/APP/TQR/Determine Torque Request/TorqueArbitrament/TorqueSmooth/Front wheel rate limit determination/VTQR_ECOFEDURateLimitDec_Nm/LV1" /begin REF_CHARACTERISTIC MTQR_EL1FEDUTqDecSR_Z_Nm /end REF_CHARACTERISTIC /end GROUP
/begin GROUP S2118_LV2 "SWC_FDC_type/run_SWC_FDC_RxTx_5ms_sys/APP/TQR/Determine Torque Request/TorqueArbitrament/TorqueSmooth/Front wheel rate limit determination/VTQR_ECOFEDURateLimitDec_Nm/LV2" /begin REF_CHARACTERISTIC MTQR_EL2FEDUTqDecSR_Z_Nm /end REF_CHARACTERISTIC /end GROUP
/begin GROUP S2118_LV3 "SWC_FDC_type/run_SWC_FDC_RxTx_5ms_sys/APP/TQR/Determine Torque Request/TorqueArbitrament/TorqueSmooth/Front wheel rate limit determination/VTQR_ECOFEDURateLimitDec_Nm/LV3" /begin REF_CHARACTERISTIC MTQR_EL3FEDUTqDecSR_Z_Nm /end REF_CHARACTERISTIC /end GROUP
/begin GROUP S2118_LV4 "SWC_FDC_type/run_SWC_FDC_RxTx_5ms_sys/APP/TQR/Determine Torque Request/TorqueArbitrament/TorqueSmooth/Front wheel rate limit determination/VTQR_ECOFEDURateLimitDec_Nm/LV4" /begin REF_CHARACTERISTIC MTQR_EL4FEDUTqDecSR_Z_Nm /end REF_CHARACTERISTIC /end GROUP
/begin GROUP S2118_LV5 "SWC_FDC_type/run_SWC_FDC_RxTx_5ms_sys/APP/TQR/Determine Torque Request/TorqueArbitrament/TorqueSmooth/Front wheel rate limit determination/VTQR_ECOFEDURateLimitDec_Nm/LV5" /begin REF_CHARACTERISTIC MTQR_EL5FEDUTqDecSR_Z_Nm /end REF_CHARACTERISTIC /end GROUP
/begin GROUP S2118_OPD "SWC_FDC_type/run_SWC_FDC_RxTx_5ms_sys/APP/TQR/Determine Torque Request/TorqueArbitrament/TorqueSmooth/Front wheel rate limit determination/VTQR_ECOFEDURateLimitDec_Nm/OPD" /begin REF_CHARACTERISTIC MTQR_EOPDFEDUTqDecSR_Z_Nm /end REF_CHARACTERISTIC /end GROUP
/begin GROUP S2119_Invalid "SWC_FDC_type/run_SWC_FDC_RxTx_5ms_sys/APP/TQR/Determine Torque Request/TorqueArbitrament/TorqueSmooth/Front wheel rate limit determination/VTQR_ECOFEDURateLimitInc_Nm/Invalid" /begin REF_CHARACTERISTIC MTQR_EL1FEDUTqIncSR_Z_Nm /end REF_CHARACTERISTIC /end GROUP
/begin GROUP S2119_LV1 "SWC_FDC_type/run_SWC_FDC_RxTx_5ms_sys/APP/TQR/Determine Torque Request/TorqueArbitrament/TorqueSmooth/Front wheel rate limit determination/VTQR_ECOFEDURateLimitInc_Nm/LV1" /begin REF_CHARACTERISTIC MTQR_EL1FEDUTqIncSR_Z_Nm /end REF_CHARACTERISTIC /end GROUP
/begin GROUP S2119_LV2 "SWC_FDC_type/run_SWC_FDC_RxTx_5ms_sys/APP/TQR/Determine Torque Request/TorqueArbitrament/TorqueSmooth/Front wheel rate limit determination/VTQR_ECOFEDURateLimitInc_Nm/LV2" /begin REF_CHARACTERISTIC KTQR_FrTqIncGainSW_flg MTQR_EL2FEDUTqIncSR_Z_Nm /end REF_CHARACTERISTIC /end GROUP
/begin GROUP S2119_LV3 "SWC_FDC_type/run_SWC_FDC_RxTx_5ms_sys/APP/TQR/Determine Torque Request/TorqueArbitrament/TorqueSmooth/Front wheel rate limit determination/VTQR_ECOFEDURateLimitInc_Nm/LV3" /begin REF_CHARACTERISTIC KTQR_FrTqIncGainSW_flg MTQR_EL3FEDUTqIncSR_Z_Nm /end REF_CHARACTERISTIC /end GROUP
/begin GROUP S2119_LV4 "SWC_FDC_type/run_SWC_FDC_RxTx_5ms_sys/APP/TQR/Determine Torque Request/TorqueArbitrament/TorqueSmooth/Front wheel rate limit determination/VTQR_ECOFEDURateLimitInc_Nm/LV4" /begin REF_CHARACTERISTIC KTQR_FrTqIncGainSW_flg MTQR_EL4FEDUTqIncSR_Z_Nm /end REF_CHARACTERISTIC /end GROUP
/begin GROUP S2119_LV5 "SWC_FDC_type/run_SWC_FDC_RxTx_5ms_sys/APP/TQR/Determine Torque Request/TorqueArbitrament/TorqueSmooth/Front wheel rate limit determination/VTQR_ECOFEDURateLimitInc_Nm/LV5" /begin REF_CHARACTERISTIC KTQR_FrTqIncGainSW_flg MTQR_EL5FEDUTqIncSR_Z_Nm /end REF_CHARACTERISTIC /end GROUP
/begin GROUP S2119_OPD "SWC_FDC_type/run_SWC_FDC_RxTx_5ms_sys/APP/TQR/Determine Torque Request/TorqueArbitrament/TorqueSmooth/Front wheel rate limit determination/VTQR_ECOFEDURateLimitInc_Nm/OPD" /begin REF_CHARACTERISTIC KTQR_FrTqIncGainSW_flg MTQR_EOPDFEDUTqIncSR_Z_Nm /end REF_CHARACTERISTIC /end GROUP
/begin GROUP S2124_Invalid "SWC_FDC_type/run_SWC_FDC_RxTx_5ms_sys/APP/TQR/Determine Torque Request/TorqueArbitrament/TorqueSmooth/Front wheel rate limit determination/VTQR_NORMALFEDURateLimitDec_Nm/Invalid" /begin REF_CHARACTERISTIC MTQR_NL1FEDUTqDecSR_Z_Nm /end REF_CHARACTERISTIC /end GROUP
/begin GROUP S2124_LV1 "SWC_FDC_type/run_SWC_FDC_RxTx_5ms_sys/APP/TQR/Determine Torque Request/TorqueArbitrament/TorqueSmooth/Front wheel rate limit determination/VTQR_NORMALFEDURateLimitDec_Nm/LV1" /begin REF_CHARACTERISTIC MTQR_NL1FEDUTqDecSR_Z_Nm /end REF_CHARACTERISTIC /end GROUP
/begin GROUP S2124_LV2 "SWC_FDC_type/run_SWC_FDC_RxTx_5ms_sys/APP/TQR/Determine Torque Request/TorqueArbitrament/TorqueSmooth/Front wheel rate limit determination/VTQR_NORMALFEDURateLimitDec_Nm/LV2" /begin REF_CHARACTERISTIC MTQR_NL2FEDUTqDecSR_Z_Nm /end REF_CHARACTERISTIC /end GROUP
/begin GROUP S2124_LV3 "SWC_FDC_type/run_SWC_FDC_RxTx_5ms_sys/APP/TQR/Determine Torque Request/TorqueArbitrament/TorqueSmooth/Front wheel rate limit determination/VTQR_NORMALFEDURateLimitDec_Nm/LV3" /begin REF_CHARACTERISTIC MTQR_NL3FEDUTqDecSR_Z_Nm /end REF_CHARACTERISTIC /end GROUP
/begin GROUP S2124_LV4 "SWC_FDC_type/run_SWC_FDC_RxTx_5ms_sys/APP/TQR/Determine Torque Request/TorqueArbitrament/TorqueSmooth/Front wheel rate limit determination/VTQR_NORMALFEDURateLimitDec_Nm/LV4" /begin REF_CHARACTERISTIC MTQR_NL4FEDUTqDecSR_Z_Nm /end REF_CHARACTERISTIC /end GROUP
/begin GROUP S2124_LV5 "SWC_FDC_type/run_SWC_FDC_RxTx_5ms_sys/APP/TQR/Determine Torque Request/TorqueArbitrament/TorqueSmooth/Front wheel rate limit determination/VTQR_NORMALFEDURateLimitDec_Nm/LV5" /begin REF_CHARACTERISTIC MTQR_NL5FEDUTqDecSR_Z_Nm /end REF_CHARACTERISTIC /end GROUP
/begin GROUP S2124_OPD "SWC_FDC_type/run_SWC_FDC_RxTx_5ms_sys/APP/TQR/Determine Torque Request/TorqueArbitrament/TorqueSmooth/Front wheel rate limit determination/VTQR_NORMALFEDURateLimitDec_Nm/OPD" /begin REF_CHARACTERISTIC MTQR_NOPDFEDUTqDecSR_Z_Nm /end REF_CHARACTERISTIC /end GROUP
/begin GROUP S2125_Invalid "SWC_FDC_type/run_SWC_FDC_RxTx_5ms_sys/APP/TQR/Determine Torque Request/TorqueArbitrament/TorqueSmooth/Front wheel rate limit determination/VTQR_NORMALFEDURateLimitInc_Nm/Invalid" /begin REF_CHARACTERISTIC MTQR_NL1FEDUTqIncSR_Z_Nm /end REF_CHARACTERISTIC /end GROUP
/begin GROUP S2125_LV1 "SWC_FDC_type/run_SWC_FDC_RxTx_5ms_sys/APP/TQR/Determine Torque Request/TorqueArbitrament/TorqueSmooth/Front wheel rate limit determination/VTQR_NORMALFEDURateLimitInc_Nm/LV1" /begin REF_CHARACTERISTIC MTQR_NL1FEDUTqIncSR_Z_Nm /end REF_CHARACTERISTIC /end GROUP
/begin GROUP S2125_LV2 "SWC_FDC_type/run_SWC_FDC_RxTx_5ms_sys/APP/TQR/Determine Torque Request/TorqueArbitrament/TorqueSmooth/Front wheel rate limit determination/VTQR_NORMALFEDURateLimitInc_Nm/LV2" /begin REF_CHARACTERISTIC KTQR_FrTqIncGainSW_flg MTQR_NL2FEDUTqIncSR_Z_Nm /end REF_CHARACTERISTIC /end GROUP
/begin GROUP S2125_LV3 "SWC_FDC_type/run_SWC_FDC_RxTx_5ms_sys/APP/TQR/Determine Torque Request/TorqueArbitrament/TorqueSmooth/Front wheel rate limit determination/VTQR_NORMALFEDURateLimitInc_Nm/LV3" /begin REF_CHARACTERISTIC KTQR_FrTqIncGainSW_flg MTQR_NL3FEDUTqIncSR_Z_Nm /end REF_CHARACTERISTIC /end GROUP
/begin GROUP S2125_LV4 "SWC_FDC_type/run_SWC_FDC_RxTx_5ms_sys/APP/TQR/Determine Torque Request/TorqueArbitrament/TorqueSmooth/Front wheel rate limit determination/VTQR_NORMALFEDURateLimitInc_Nm/LV4" /begin REF_CHARACTERISTIC KTQR_FrTqIncGainSW_flg MTQR_NL4FEDUTqIncSR_Z_Nm /end REF_CHARACTERISTIC /end GROUP
/begin GROUP S2125_LV5 "SWC_FDC_type/run_SWC_FDC_RxTx_5ms_sys/APP/TQR/Determine Torque Request/TorqueArbitrament/TorqueSmooth/Front wheel rate limit determination/VTQR_NORMALFEDURateLimitInc_Nm/LV5" /begin REF_CHARACTERISTIC KTQR_FrTqIncGainSW_flg MTQR_NL5FEDUTqIncSR_Z_Nm /end REF_CHARACTERISTIC /end GROUP
/begin GROUP S2125_OPD "SWC_FDC_type/run_SWC_FDC_RxTx_5ms_sys/APP/TQR/Determine Torque Request/TorqueArbitrament/TorqueSmooth/Front wheel rate limit determination/VTQR_NORMALFEDURateLimitInc_Nm/OPD" /begin REF_CHARACTERISTIC KTQR_FrTqIncGainSW_flg MTQR_NOPDFEDUTqIncSR_Z_Nm /end REF_CHARACTERISTIC /end GROUP
/begin GROUP S2128_Invalid "SWC_FDC_type/run_SWC_FDC_RxTx_5ms_sys/APP/TQR/Determine Torque Request/TorqueArbitrament/TorqueSmooth/Front wheel rate limit determination/VTQR_SPORTFEDURateLimitDec_Nm/Invalid" /begin REF_CHARACTERISTIC MTQR_SL1FEDUTqDecSR_Z_Nm /end REF_CHARACTERISTIC /end GROUP
/begin GROUP S2128_LV1 "SWC_FDC_type/run_SWC_FDC_RxTx_5ms_sys/APP/TQR/Determine Torque Request/TorqueArbitrament/TorqueSmooth/Front wheel rate limit determination/VTQR_SPORTFEDURateLimitDec_Nm/LV1" /begin REF_CHARACTERISTIC MTQR_SL1FEDUTqDecSR_Z_Nm /end REF_CHARACTERISTIC /end GROUP
/begin GROUP S2128_LV2 "SWC_FDC_type/run_SWC_FDC_RxTx_5ms_sys/APP/TQR/Determine Torque Request/TorqueArbitrament/TorqueSmooth/Front wheel rate limit determination/VTQR_SPORTFEDURateLimitDec_Nm/LV2" /begin REF_CHARACTERISTIC MTQR_SL2FEDUTqDecSR_Z_Nm /end REF_CHARACTERISTIC /end GROUP
/begin GROUP S2128_LV3 "SWC_FDC_type/run_SWC_FDC_RxTx_5ms_sys/APP/TQR/Determine Torque Request/TorqueArbitrament/TorqueSmooth/Front wheel rate limit determination/VTQR_SPORTFEDURateLimitDec_Nm/LV3" /begin REF_CHARACTERISTIC MTQR_SL3FEDUTqDecSR_Z_Nm /end REF_CHARACTERISTIC /end GROUP
/begin GROUP S2128_LV4 "SWC_FDC_type/run_SWC_FDC_RxTx_5ms_sys/APP/TQR/Determine Torque Request/TorqueArbitrament/TorqueSmooth/Front wheel rate limit determination/VTQR_SPORTFEDURateLimitDec_Nm/LV4" /begin REF_CHARACTERISTIC MTQR_SL4FEDUTqDecSR_Z_Nm /end REF_CHARACTERISTIC /end GROUP
/begin GROUP S2128_LV5 "SWC_FDC_type/run_SWC_FDC_RxTx_5ms_sys/APP/TQR/Determine Torque Request/TorqueArbitrament/TorqueSmooth/Front wheel rate limit determination/VTQR_SPORTFEDURateLimitDec_Nm/LV5" /begin REF_CHARACTERISTIC MTQR_SL5FEDUTqDecSR_Z_Nm /end REF_CHARACTERISTIC /end GROUP
/begin GROUP S2128_OPD "SWC_FDC_type/run_SWC_FDC_RxTx_5ms_sys/APP/TQR/Determine Torque Request/TorqueArbitrament/TorqueSmooth/Front wheel rate limit determination/VTQR_SPORTFEDURateLimitDec_Nm/OPD" /begin REF_CHARACTERISTIC MTQR_SOPDFEDUTqDecSR_Z_Nm /end REF_CHARACTERISTIC /end GROUP
/begin GROUP S2129_Invalid "SWC_FDC_type/run_SWC_FDC_RxTx_5ms_sys/APP/TQR/Determine Torque Request/TorqueArbitrament/TorqueSmooth/Front wheel rate limit determination/VTQR_SPORTFEDURateLimitInc_Nm/Invalid" /begin REF_CHARACTERISTIC MTQR_SL1FEDUTqIncSR_Z_Nm /end REF_CHARACTERISTIC /end GROUP
/begin GROUP S2129_LV1 "SWC_FDC_type/run_SWC_FDC_RxTx_5ms_sys/APP/TQR/Determine Torque Request/TorqueArbitrament/TorqueSmooth/Front wheel rate limit determination/VTQR_SPORTFEDURateLimitInc_Nm/LV1" /begin REF_CHARACTERISTIC MTQR_SL1FEDUTqIncSR_Z_Nm /end REF_CHARACTERISTIC /end GROUP
/begin GROUP S2129_LV2 "SWC_FDC_type/run_SWC_FDC_RxTx_5ms_sys/APP/TQR/Determine Torque Request/TorqueArbitrament/TorqueSmooth/Front wheel rate limit determination/VTQR_SPORTFEDURateLimitInc_Nm/LV2" /begin REF_CHARACTERISTIC KTQR_FrTqIncGainSW_flg MTQR_SL2FEDUTqIncSR_Z_Nm /end REF_CHARACTERISTIC /end GROUP
/begin GROUP S2129_LV3 "SWC_FDC_type/run_SWC_FDC_RxTx_5ms_sys/APP/TQR/Determine Torque Request/TorqueArbitrament/TorqueSmooth/Front wheel rate limit determination/VTQR_SPORTFEDURateLimitInc_Nm/LV3" /begin REF_CHARACTERISTIC KTQR_FrTqIncGainSW_flg MTQR_SL3FEDUTqIncSR_Z_Nm /end REF_CHARACTERISTIC /end GROUP
/begin GROUP S2129_LV4 "SWC_FDC_type/run_SWC_FDC_RxTx_5ms_sys/APP/TQR/Determine Torque Request/TorqueArbitrament/TorqueSmooth/Front wheel rate limit determination/VTQR_SPORTFEDURateLimitInc_Nm/LV4" /begin REF_CHARACTERISTIC KTQR_FrTqIncGainSW_flg MTQR_SL4FEDUTqIncSR_Z_Nm /end REF_CHARACTERISTIC /end GROUP
/begin GROUP S2129_LV5 "SWC_FDC_type/run_SWC_FDC_RxTx_5ms_sys/APP/TQR/Determine Torque Request/TorqueArbitrament/TorqueSmooth/Front wheel rate limit determination/VTQR_SPORTFEDURateLimitInc_Nm/LV5" /begin REF_CHARACTERISTIC KTQR_FrTqIncGainSW_flg MTQR_SL5FEDUTqIncSR_Z_Nm /end REF_CHARACTERISTIC /end GROUP
/begin GROUP S2129_OPD "SWC_FDC_type/run_SWC_FDC_RxTx_5ms_sys/APP/TQR/Determine Torque Request/TorqueArbitrament/TorqueSmooth/Front wheel rate limit determination/VTQR_SPORTFEDURateLimitInc_Nm/OPD" /begin REF_CHARACTERISTIC KTQR_FrTqIncGainSW_flg MTQR_SOPDFEDUTqIncSR_Z_Nm /end REF_CHARACTERISTIC /end GROUP
/begin GROUP S2188_Invalid "SWC_FDC_type/run_SWC_FDC_RxTx_5ms_sys/APP/TQR/Determine Torque Request/TorqueArbitrament/TorqueSmooth/Rear First order filter input tau map and determination/VTQR_ECOREDUTs_c/Invalid" /begin REF_CHARACTERISTIC MTQR_EL1REDUTs_Z_c MTQR_REDUEL1RegenTs_Y_c /end REF_CHARACTERISTIC /end GROUP
/begin GROUP S2188_LV1 "SWC_FDC_type/run_SWC_FDC_RxTx_5ms_sys/APP/TQR/Determine Torque Request/TorqueArbitrament/TorqueSmooth/Rear First order filter input tau map and determination/VTQR_ECOREDUTs_c/LV1" /begin REF_CHARACTERISTIC MTQR_EL1REDUTs_Z_c MTQR_REDUEL1RegenTs_Y_c /end REF_CHARACTERISTIC /end GROUP
/begin GROUP S2188_LV2 "SWC_FDC_type/run_SWC_FDC_RxTx_5ms_sys/APP/TQR/Determine Torque Request/TorqueArbitrament/TorqueSmooth/Rear First order filter input tau map and determination/VTQR_ECOREDUTs_c/LV2" /begin REF_CHARACTERISTIC MTQR_EL2REDUTs_Z_c /end REF_CHARACTERISTIC /end GROUP
/begin GROUP S2188_LV3 "SWC_FDC_type/run_SWC_FDC_RxTx_5ms_sys/APP/TQR/Determine Torque Request/TorqueArbitrament/TorqueSmooth/Rear First order filter input tau map and determination/VTQR_ECOREDUTs_c/LV3" /begin REF_CHARACTERISTIC MTQR_EL3REDUTs_Z_c /end REF_CHARACTERISTIC /end GROUP
/begin GROUP S2188_LV4 "SWC_FDC_type/run_SWC_FDC_RxTx_5ms_sys/APP/TQR/Determine Torque Request/TorqueArbitrament/TorqueSmooth/Rear First order filter input tau map and determination/VTQR_ECOREDUTs_c/LV4" /begin REF_CHARACTERISTIC MTQR_EL4REDUTs_Z_c /end REF_CHARACTERISTIC /end GROUP
/begin GROUP S2188_LV5 "SWC_FDC_type/run_SWC_FDC_RxTx_5ms_sys/APP/TQR/Determine Torque Request/TorqueArbitrament/TorqueSmooth/Rear First order filter input tau map and determination/VTQR_ECOREDUTs_c/LV5" /begin REF_CHARACTERISTIC MTQR_EL5REDUTs_Z_c /end REF_CHARACTERISTIC /end GROUP
/begin GROUP S2188_OPD "SWC_FDC_type/run_SWC_FDC_RxTx_5ms_sys/APP/TQR/Determine Torque Request/TorqueArbitrament/TorqueSmooth/Rear First order filter input tau map and determination/VTQR_ECOREDUTs_c/OPD" /begin REF_CHARACTERISTIC MTQR_EOPDREDUTs_Z_c /end REF_CHARACTERISTIC /end GROUP
/begin GROUP S2191_Invalid "SWC_FDC_type/run_SWC_FDC_RxTx_5ms_sys/APP/TQR/Determine Torque Request/TorqueArbitrament/TorqueSmooth/Rear First order filter input tau map and determination/VTQR_NORMALREDUTs_c/Invalid" /begin REF_CHARACTERISTIC MTQR_NL1REDUTs_Z_c /end REF_CHARACTERISTIC /end GROUP
/begin GROUP S2191_LV1 "SWC_FDC_type/run_SWC_FDC_RxTx_5ms_sys/APP/TQR/Determine Torque Request/TorqueArbitrament/TorqueSmooth/Rear First order filter input tau map and determination/VTQR_NORMALREDUTs_c/LV1" /begin REF_CHARACTERISTIC MTQR_NL1REDUTs_Z_c /end REF_CHARACTERISTIC /end GROUP
/begin GROUP S2191_LV2 "SWC_FDC_type/run_SWC_FDC_RxTx_5ms_sys/APP/TQR/Determine Torque Request/TorqueArbitrament/TorqueSmooth/Rear First order filter input tau map and determination/VTQR_NORMALREDUTs_c/LV2" /begin REF_CHARACTERISTIC MTQR_NL2REDUTs_Z_c /end REF_CHARACTERISTIC /end GROUP
/begin GROUP S2191_LV3 "SWC_FDC_type/run_SWC_FDC_RxTx_5ms_sys/APP/TQR/Determine Torque Request/TorqueArbitrament/TorqueSmooth/Rear First order filter input tau map and determination/VTQR_NORMALREDUTs_c/LV3" /begin REF_CHARACTERISTIC MTQR_NL3REDUTs_Z_c /end REF_CHARACTERISTIC /end GROUP
/begin GROUP S2191_LV4 "SWC_FDC_type/run_SWC_FDC_RxTx_5ms_sys/APP/TQR/Determine Torque Request/TorqueArbitrament/TorqueSmooth/Rear First order filter input tau map and determination/VTQR_NORMALREDUTs_c/LV4" /begin REF_CHARACTERISTIC MTQR_NL4REDUTs_Z_c /end REF_CHARACTERISTIC /end GROUP
/begin GROUP S2191_LV5 "SWC_FDC_type/run_SWC_FDC_RxTx_5ms_sys/APP/TQR/Determine Torque Request/TorqueArbitrament/TorqueSmooth/Rear First order filter input tau map and determination/VTQR_NORMALREDUTs_c/LV5" /begin REF_CHARACTERISTIC MTQR_NL5REDUTs_Z_c /end REF_CHARACTERISTIC /end GROUP
/begin GROUP S2191_OPD "SWC_FDC_type/run_SWC_FDC_RxTx_5ms_sys/APP/TQR/Determine Torque Request/TorqueArbitrament/TorqueSmooth/Rear First order filter input tau map and determination/VTQR_NORMALREDUTs_c/OPD" /begin REF_CHARACTERISTIC MTQR_NOPDREDUTs_Z_c /end REF_CHARACTERISTIC /end GROUP
/begin GROUP S2193_Invalid "SWC_FDC_type/run_SWC_FDC_RxTx_5ms_sys/APP/TQR/Determine Torque Request/TorqueArbitrament/TorqueSmooth/Rear First order filter input tau map and determination/VTQR_SPORTREDUTs_c/Invalid" /begin REF_CHARACTERISTIC MTQR_SL1REDUTs_Z_c /end REF_CHARACTERISTIC /end GROUP
/begin GROUP S2193_LV1 "SWC_FDC_type/run_SWC_FDC_RxTx_5ms_sys/APP/TQR/Determine Torque Request/TorqueArbitrament/TorqueSmooth/Rear First order filter input tau map and determination/VTQR_SPORTREDUTs_c/LV1" /begin REF_CHARACTERISTIC MTQR_SL1REDUTs_Z_c /end REF_CHARACTERISTIC /end GROUP
/begin GROUP S2193_LV2 "SWC_FDC_type/run_SWC_FDC_RxTx_5ms_sys/APP/TQR/Determine Torque Request/TorqueArbitrament/TorqueSmooth/Rear First order filter input tau map and determination/VTQR_SPORTREDUTs_c/LV2" /begin REF_CHARACTERISTIC MTQR_SL2REDUTs_Z_c /end REF_CHARACTERISTIC /end GROUP
/begin GROUP S2193_LV3 "SWC_FDC_type/run_SWC_FDC_RxTx_5ms_sys/APP/TQR/Determine Torque Request/TorqueArbitrament/TorqueSmooth/Rear First order filter input tau map and determination/VTQR_SPORTREDUTs_c/LV3" /begin REF_CHARACTERISTIC MTQR_SL3REDUTs_Z_c /end REF_CHARACTERISTIC /end GROUP
/begin GROUP S2193_LV4 "SWC_FDC_type/run_SWC_FDC_RxTx_5ms_sys/APP/TQR/Determine Torque Request/TorqueArbitrament/TorqueSmooth/Rear First order filter input tau map and determination/VTQR_SPORTREDUTs_c/LV4" /begin REF_CHARACTERISTIC MTQR_SL4REDUTs_Z_c /end REF_CHARACTERISTIC /end GROUP
/begin GROUP S2193_LV5 "SWC_FDC_type/run_SWC_FDC_RxTx_5ms_sys/APP/TQR/Determine Torque Request/TorqueArbitrament/TorqueSmooth/Rear First order filter input tau map and determination/VTQR_SPORTREDUTs_c/LV5" /begin REF_CHARACTERISTIC MTQR_SL5REDUTs_Z_c /end REF_CHARACTERISTIC /end GROUP
/begin GROUP S2193_OPD "SWC_FDC_type/run_SWC_FDC_RxTx_5ms_sys/APP/TQR/Determine Torque Request/TorqueArbitrament/TorqueSmooth/Rear First order filter input tau map and determination/VTQR_SPORTREDUTs_c/OPD" /begin REF_CHARACTERISTIC MTQR_SOPDREDUTs_Z_c /end REF_CHARACTERISTIC /end GROUP
/begin GROUP S2229_VTQR_RrNegRateLimitDecE_Nm "SWC_FDC_type/run_SWC_FDC_RxTx_5ms_sys/APP/TQR/Determine Torque Request/TorqueArbitrament/TorqueSmooth/Rear wheel rate limit determination1/Negative Rate limit Determination/VTQR_RrNegRateLimitDecE_Nm" /begin REF_CHARACTERISTIC MTQR_RrNegRateLimitDecE_Z_Nm /end REF_CHARACTERISTIC /end GROUP
/begin GROUP S2229_VTQR_RrNegRateLimitDecN_Nm "SWC_FDC_type/run_SWC_FDC_RxTx_5ms_sys/APP/TQR/Determine Torque Request/TorqueArbitrament/TorqueSmooth/Rear wheel rate limit determination1/Negative Rate limit Determination/VTQR_RrNegRateLimitDecN_Nm" /begin REF_CHARACTERISTIC MTQR_RrNegRateLimitDecN_Z_Nm /end REF_CHARACTERISTIC /end GROUP
/begin GROUP S2229_VTQR_RrNegRateLimitDecS_Nm "SWC_FDC_type/run_SWC_FDC_RxTx_5ms_sys/APP/TQR/Determine Torque Request/TorqueArbitrament/TorqueSmooth/Rear wheel rate limit determination1/Negative Rate limit Determination/VTQR_RrNegRateLimitDecS_Nm" /begin REF_CHARACTERISTIC MTQR_RrNegRateLimitDecS_Z_Nm /end REF_CHARACTERISTIC /end GROUP
/begin GROUP S2229_VTQR_RrNegRateLimitIncE_Nm "SWC_FDC_type/run_SWC_FDC_RxTx_5ms_sys/APP/TQR/Determine Torque Request/TorqueArbitrament/TorqueSmooth/Rear wheel rate limit determination1/Negative Rate limit Determination/VTQR_RrNegRateLimitIncE_Nm" /begin REF_CHARACTERISTIC MTQR_RrNegRateLimitIncE_Z_Nm /end REF_CHARACTERISTIC /end GROUP
/begin GROUP S2229_VTQR_RrNegRateLimitIncN_Nm "SWC_FDC_type/run_SWC_FDC_RxTx_5ms_sys/APP/TQR/Determine Torque Request/TorqueArbitrament/TorqueSmooth/Rear wheel rate limit determination1/Negative Rate limit Determination/VTQR_RrNegRateLimitIncN_Nm" /begin REF_CHARACTERISTIC MTQR_RrNegRateLimitIncN_Z_Nm /end REF_CHARACTERISTIC /end GROUP
/begin GROUP S2229_VTQR_RrNegRateLimitIncS_Nm "SWC_FDC_type/run_SWC_FDC_RxTx_5ms_sys/APP/TQR/Determine Torque Request/TorqueArbitrament/TorqueSmooth/Rear wheel rate limit determination1/Negative Rate limit Determination/VTQR_RrNegRateLimitIncS_Nm" /begin REF_CHARACTERISTIC MTQR_RrNegRateLimitIncS_Z_Nm /end REF_CHARACTERISTIC /end GROUP
/begin GROUP S2230_VTQR_RrPosRateLimitDecE_Nm "SWC_FDC_type/run_SWC_FDC_RxTx_5ms_sys/APP/TQR/Determine Torque Request/TorqueArbitrament/TorqueSmooth/Rear wheel rate limit determination1/Positive Rate limit Determination/VTQR_RrPosRateLimitDecE_Nm" /begin REF_CHARACTERISTIC MTQR_RrPosRateLimitDecE_Z_Nm /end REF_CHARACTERISTIC /end GROUP
/begin GROUP S2230_VTQR_RrPosRateLimitDecN_Nm "SWC_FDC_type/run_SWC_FDC_RxTx_5ms_sys/APP/TQR/Determine Torque Request/TorqueArbitrament/TorqueSmooth/Rear wheel rate limit determination1/Positive Rate limit Determination/VTQR_RrPosRateLimitDecN_Nm" /begin REF_CHARACTERISTIC MTQR_RrPosRateLimitDecN_Z_Nm /end REF_CHARACTERISTIC /end GROUP
/begin GROUP S2230_VTQR_RrPosRateLimitDecS_Nm "SWC_FDC_type/run_SWC_FDC_RxTx_5ms_sys/APP/TQR/Determine Torque Request/TorqueArbitrament/TorqueSmooth/Rear wheel rate limit determination1/Positive Rate limit Determination/VTQR_RrPosRateLimitDecS_Nm" /begin REF_CHARACTERISTIC MTQR_RrPosRateLimitDecS_Z_Nm /end REF_CHARACTERISTIC /end GROUP
/begin GROUP S2230_VTQR_RrPosRateLimitIncE_Nm "SWC_FDC_type/run_SWC_FDC_RxTx_5ms_sys/APP/TQR/Determine Torque Request/TorqueArbitrament/TorqueSmooth/Rear wheel rate limit determination1/Positive Rate limit Determination/VTQR_RrPosRateLimitIncE_Nm" /begin REF_CHARACTERISTIC MTQR_RrPosRateLimitIncE_Z_Nm /end REF_CHARACTERISTIC /end GROUP
/begin GROUP S2230_VTQR_RrPosRateLimitIncN_Nm "SWC_FDC_type/run_SWC_FDC_RxTx_5ms_sys/APP/TQR/Determine Torque Request/TorqueArbitrament/TorqueSmooth/Rear wheel rate limit determination1/Positive Rate limit Determination/VTQR_RrPosRateLimitIncN_Nm" /begin REF_CHARACTERISTIC MTQR_RrPosRateLimitIncN_Z_Nm /end REF_CHARACTERISTIC /end GROUP
/begin GROUP S2230_VTQR_RrPosRateLimitIncS_Nm "SWC_FDC_type/run_SWC_FDC_RxTx_5ms_sys/APP/TQR/Determine Torque Request/TorqueArbitrament/TorqueSmooth/Rear wheel rate limit determination1/Positive Rate limit Determination/VTQR_RrPosRateLimitIncS_Nm" /begin REF_CHARACTERISTIC MTQR_RrPosRateLimitIncS_Z_Nm /end REF_CHARACTERISTIC /end GROUP
/begin GROUP S2234_Invalid "SWC_FDC_type/run_SWC_FDC_RxTx_5ms_sys/APP/TQR/Determine Torque Request/TorqueArbitrament/TorqueSmooth/Rear wheel rate limit determination1/VTQR_ECOREDURateLimitDec_Nm/Invalid" /begin REF_CHARACTERISTIC MTQR_EL1REDUTqDecSR_Z_Nm /end REF_CHARACTERISTIC /end GROUP
/begin GROUP S2234_LV1 "SWC_FDC_type/run_SWC_FDC_RxTx_5ms_sys/APP/TQR/Determine Torque Request/TorqueArbitrament/TorqueSmooth/Rear wheel rate limit determination1/VTQR_ECOREDURateLimitDec_Nm/LV1" /begin REF_CHARACTERISTIC MTQR_EL1REDUTqDecSR_Z_Nm /end REF_CHARACTERISTIC /end GROUP
/begin GROUP S2234_LV2 "SWC_FDC_type/run_SWC_FDC_RxTx_5ms_sys/APP/TQR/Determine Torque Request/TorqueArbitrament/TorqueSmooth/Rear wheel rate limit determination1/VTQR_ECOREDURateLimitDec_Nm/LV2" /begin REF_CHARACTERISTIC MTQR_EL2REDUTqDecSR_Z_Nm /end REF_CHARACTERISTIC /end GROUP
/begin GROUP S2234_LV3 "SWC_FDC_type/run_SWC_FDC_RxTx_5ms_sys/APP/TQR/Determine Torque Request/TorqueArbitrament/TorqueSmooth/Rear wheel rate limit determination1/VTQR_ECOREDURateLimitDec_Nm/LV3" /begin REF_CHARACTERISTIC MTQR_EL3REDUTqDecSR_Z_Nm /end REF_CHARACTERISTIC /end GROUP
/begin GROUP S2234_LV4 "SWC_FDC_type/run_SWC_FDC_RxTx_5ms_sys/APP/TQR/Determine Torque Request/TorqueArbitrament/TorqueSmooth/Rear wheel rate limit determination1/VTQR_ECOREDURateLimitDec_Nm/LV4" /begin REF_CHARACTERISTIC MTQR_EL4REDUTqDecSR_Z_Nm /end REF_CHARACTERISTIC /end GROUP
/begin GROUP S2234_LV5 "SWC_FDC_type/run_SWC_FDC_RxTx_5ms_sys/APP/TQR/Determine Torque Request/TorqueArbitrament/TorqueSmooth/Rear wheel rate limit determination1/VTQR_ECOREDURateLimitDec_Nm/LV5" /begin REF_CHARACTERISTIC MTQR_EL5REDUTqDecSR_Z_Nm /end REF_CHARACTERISTIC /end GROUP
/begin GROUP S2234_OPD "SWC_FDC_type/run_SWC_FDC_RxTx_5ms_sys/APP/TQR/Determine Torque Request/TorqueArbitrament/TorqueSmooth/Rear wheel rate limit determination1/VTQR_ECOREDURateLimitDec_Nm/OPD" /begin REF_CHARACTERISTIC MTQR_EOPDREDUTqDecSR_Z_Nm /end REF_CHARACTERISTIC /end GROUP
/begin GROUP S2235_Invalid "SWC_FDC_type/run_SWC_FDC_RxTx_5ms_sys/APP/TQR/Determine Torque Request/TorqueArbitrament/TorqueSmooth/Rear wheel rate limit determination1/VTQR_ECOREDURateLimitInc_Nm/Invalid" /begin REF_CHARACTERISTIC MTQR_EL1REDUTqIncSR_Z_Nm /end REF_CHARACTERISTIC /end GROUP
/begin GROUP S2235_LV1 "SWC_FDC_type/run_SWC_FDC_RxTx_5ms_sys/APP/TQR/Determine Torque Request/TorqueArbitrament/TorqueSmooth/Rear wheel rate limit determination1/VTQR_ECOREDURateLimitInc_Nm/LV1" /begin REF_CHARACTERISTIC MTQR_EL1REDUTqIncSR_Z_Nm /end REF_CHARACTERISTIC /end GROUP
/begin GROUP S2235_LV2 "SWC_FDC_type/run_SWC_FDC_RxTx_5ms_sys/APP/TQR/Determine Torque Request/TorqueArbitrament/TorqueSmooth/Rear wheel rate limit determination1/VTQR_ECOREDURateLimitInc_Nm/LV2" /begin REF_CHARACTERISTIC KTQR_RrTqIncGainSW_flg MTQR_EL2REDUTqIncSR_Z_Nm /end REF_CHARACTERISTIC /end GROUP
/begin GROUP S2235_LV3 "SWC_FDC_type/run_SWC_FDC_RxTx_5ms_sys/APP/TQR/Determine Torque Request/TorqueArbitrament/TorqueSmooth/Rear wheel rate limit determination1/VTQR_ECOREDURateLimitInc_Nm/LV3" /begin REF_CHARACTERISTIC KTQR_RrTqIncGainSW_flg MTQR_EL3REDUTqIncSR_Z_Nm /end REF_CHARACTERISTIC /end GROUP
/begin GROUP S2235_LV4 "SWC_FDC_type/run_SWC_FDC_RxTx_5ms_sys/APP/TQR/Determine Torque Request/TorqueArbitrament/TorqueSmooth/Rear wheel rate limit determination1/VTQR_ECOREDURateLimitInc_Nm/LV4" /begin REF_CHARACTERISTIC KTQR_RrTqIncGainSW_flg MTQR_EL4REDUTqIncSR_Z_Nm /end REF_CHARACTERISTIC /end GROUP
/begin GROUP S2235_LV5 "SWC_FDC_type/run_SWC_FDC_RxTx_5ms_sys/APP/TQR/Determine Torque Request/TorqueArbitrament/TorqueSmooth/Rear wheel rate limit determination1/VTQR_ECOREDURateLimitInc_Nm/LV5" /begin REF_CHARACTERISTIC KTQR_RrTqIncGainSW_flg MTQR_EL5REDUTqIncSR_Z_Nm /end REF_CHARACTERISTIC /end GROUP
/begin GROUP S2235_OPD "SWC_FDC_type/run_SWC_FDC_RxTx_5ms_sys/APP/TQR/Determine Torque Request/TorqueArbitrament/TorqueSmooth/Rear wheel rate limit determination1/VTQR_ECOREDURateLimitInc_Nm/OPD" /begin REF_CHARACTERISTIC KTQR_RrTqIncGainSW_flg MTQR_EOPDREDUTqIncSR_Z_Nm /end REF_CHARACTERISTIC /end GROUP
/begin GROUP S2240_Invalid "SWC_FDC_type/run_SWC_FDC_RxTx_5ms_sys/APP/TQR/Determine Torque Request/TorqueArbitrament/TorqueSmooth/Rear wheel rate limit determination1/VTQR_NORMALREDURateLimitDec_Nm/Invalid" /begin REF_CHARACTERISTIC MTQR_NL1REDUTqDecSR_Z_Nm /end REF_CHARACTERISTIC /end GROUP
/begin GROUP S2240_LV1 "SWC_FDC_type/run_SWC_FDC_RxTx_5ms_sys/APP/TQR/Determine Torque Request/TorqueArbitrament/TorqueSmooth/Rear wheel rate limit determination1/VTQR_NORMALREDURateLimitDec_Nm/LV1" /begin REF_CHARACTERISTIC MTQR_NL1REDUTqDecSR_Z_Nm /end REF_CHARACTERISTIC /end GROUP
/begin GROUP S2240_LV2 "SWC_FDC_type/run_SWC_FDC_RxTx_5ms_sys/APP/TQR/Determine Torque Request/TorqueArbitrament/TorqueSmooth/Rear wheel rate limit determination1/VTQR_NORMALREDURateLimitDec_Nm/LV2" /begin REF_CHARACTERISTIC MTQR_NL2REDUTqDecSR_Z_Nm /end REF_CHARACTERISTIC /end GROUP
/begin GROUP S2240_LV3 "SWC_FDC_type/run_SWC_FDC_RxTx_5ms_sys/APP/TQR/Determine Torque Request/TorqueArbitrament/TorqueSmooth/Rear wheel rate limit determination1/VTQR_NORMALREDURateLimitDec_Nm/LV3" /begin REF_CHARACTERISTIC MTQR_NL3REDUTqDecSR_Z_Nm /end REF_CHARACTERISTIC /end GROUP
/begin GROUP S2240_LV4 "SWC_FDC_type/run_SWC_FDC_RxTx_5ms_sys/APP/TQR/Determine Torque Request/TorqueArbitrament/TorqueSmooth/Rear wheel rate limit determination1/VTQR_NORMALREDURateLimitDec_Nm/LV4" /begin REF_CHARACTERISTIC MTQR_NL4REDUTqDecSR_Z_Nm /end REF_CHARACTERISTIC /end GROUP
/begin GROUP S2240_LV5 "SWC_FDC_type/run_SWC_FDC_RxTx_5ms_sys/APP/TQR/Determine Torque Request/TorqueArbitrament/TorqueSmooth/Rear wheel rate limit determination1/VTQR_NORMALREDURateLimitDec_Nm/LV5" /begin REF_CHARACTERISTIC MTQR_NL5REDUTqDecSR_Z_Nm /end REF_CHARACTERISTIC /end GROUP
/begin GROUP S2240_OPD "SWC_FDC_type/run_SWC_FDC_RxTx_5ms_sys/APP/TQR/Determine Torque Request/TorqueArbitrament/TorqueSmooth/Rear wheel rate limit determination1/VTQR_NORMALREDURateLimitDec_Nm/OPD" /begin REF_CHARACTERISTIC MTQR_NOPDREDUTqDecSR_Z_Nm /end REF_CHARACTERISTIC /end GROUP
/begin GROUP S2241_Invalid "SWC_FDC_type/run_SWC_FDC_RxTx_5ms_sys/APP/TQR/Determine Torque Request/TorqueArbitrament/TorqueSmooth/Rear wheel rate limit determination1/VTQR_NORMALREDURateLimitInc_Nm/Invalid" /begin REF_CHARACTERISTIC MTQR_NL1REDUTqIncSR_Z_Nm /end REF_CHARACTERISTIC /end GROUP
/begin GROUP S2241_LV1 "SWC_FDC_type/run_SWC_FDC_RxTx_5ms_sys/APP/TQR/Determine Torque Request/TorqueArbitrament/TorqueSmooth/Rear wheel rate limit determination1/VTQR_NORMALREDURateLimitInc_Nm/LV1" /begin REF_CHARACTERISTIC MTQR_NL1REDUTqIncSR_Z_Nm /end REF_CHARACTERISTIC /end GROUP
/begin GROUP S2241_LV2 "SWC_FDC_type/run_SWC_FDC_RxTx_5ms_sys/APP/TQR/Determine Torque Request/TorqueArbitrament/TorqueSmooth/Rear wheel rate limit determination1/VTQR_NORMALREDURateLimitInc_Nm/LV2" /begin REF_CHARACTERISTIC KTQR_RrTqIncGainSW_flg MTQR_NL2REDUTqIncSR_Z_Nm /end REF_CHARACTERISTIC /end GROUP
/begin GROUP S2241_LV3 "SWC_FDC_type/run_SWC_FDC_RxTx_5ms_sys/APP/TQR/Determine Torque Request/TorqueArbitrament/TorqueSmooth/Rear wheel rate limit determination1/VTQR_NORMALREDURateLimitInc_Nm/LV3" /begin REF_CHARACTERISTIC KTQR_RrTqIncGainSW_flg MTQR_NL3REDUTqIncSR_Z_Nm /end REF_CHARACTERISTIC /end GROUP
/begin GROUP S2241_LV4 "SWC_FDC_type/run_SWC_FDC_RxTx_5ms_sys/APP/TQR/Determine Torque Request/TorqueArbitrament/TorqueSmooth/Rear wheel rate limit determination1/VTQR_NORMALREDURateLimitInc_Nm/LV4" /begin REF_CHARACTERISTIC KTQR_RrTqIncGainSW_flg MTQR_NL4REDUTqIncSR_Z_Nm /end REF_CHARACTERISTIC /end GROUP
/begin GROUP S2241_LV5 "SWC_FDC_type/run_SWC_FDC_RxTx_5ms_sys/APP/TQR/Determine Torque Request/TorqueArbitrament/TorqueSmooth/Rear wheel rate limit determination1/VTQR_NORMALREDURateLimitInc_Nm/LV5" /begin REF_CHARACTERISTIC KTQR_RrTqIncGainSW_flg MTQR_NL5REDUTqIncSR_Z_Nm /end REF_CHARACTERISTIC /end GROUP
/begin GROUP S2241_OPD "SWC_FDC_type/run_SWC_FDC_RxTx_5ms_sys/APP/TQR/Determine Torque Request/TorqueArbitrament/TorqueSmooth/Rear wheel rate limit determination1/VTQR_NORMALREDURateLimitInc_Nm/OPD" /begin REF_CHARACTERISTIC KTQR_RrTqIncGainSW_flg MTQR_NOPDREDUTqIncSR_Z_Nm /end REF_CHARACTERISTIC /end GROUP
/begin GROUP S2244_Invalid "SWC_FDC_type/run_SWC_FDC_RxTx_5ms_sys/APP/TQR/Determine Torque Request/TorqueArbitrament/TorqueSmooth/Rear wheel rate limit determination1/VTQR_SPORTREDURateLimitDec_Nm/Invalid" /begin REF_CHARACTERISTIC MTQR_SL1REDUTqDecSR_Z_Nm /end REF_CHARACTERISTIC /end GROUP
/begin GROUP S2244_LV1 "SWC_FDC_type/run_SWC_FDC_RxTx_5ms_sys/APP/TQR/Determine Torque Request/TorqueArbitrament/TorqueSmooth/Rear wheel rate limit determination1/VTQR_SPORTREDURateLimitDec_Nm/LV1" /begin REF_CHARACTERISTIC MTQR_SL1REDUTqDecSR_Z_Nm /end REF_CHARACTERISTIC /end GROUP
/begin GROUP S2244_LV2 "SWC_FDC_type/run_SWC_FDC_RxTx_5ms_sys/APP/TQR/Determine Torque Request/TorqueArbitrament/TorqueSmooth/Rear wheel rate limit determination1/VTQR_SPORTREDURateLimitDec_Nm/LV2" /begin REF_CHARACTERISTIC MTQR_SL2REDUTqDecSR_Z_Nm /end REF_CHARACTERISTIC /end GROUP
/begin GROUP S2244_LV3 "SWC_FDC_type/run_SWC_FDC_RxTx_5ms_sys/APP/TQR/Determine Torque Request/TorqueArbitrament/TorqueSmooth/Rear wheel rate limit determination1/VTQR_SPORTREDURateLimitDec_Nm/LV3" /begin REF_CHARACTERISTIC MTQR_SL3REDUTqDecSR_Z_Nm /end REF_CHARACTERISTIC /end GROUP
/begin GROUP S2244_LV4 "SWC_FDC_type/run_SWC_FDC_RxTx_5ms_sys/APP/TQR/Determine Torque Request/TorqueArbitrament/TorqueSmooth/Rear wheel rate limit determination1/VTQR_SPORTREDURateLimitDec_Nm/LV4" /begin REF_CHARACTERISTIC MTQR_SL4REDUTqDecSR_Z_Nm /end REF_CHARACTERISTIC /end GROUP
/begin GROUP S2244_LV5 "SWC_FDC_type/run_SWC_FDC_RxTx_5ms_sys/APP/TQR/Determine Torque Request/TorqueArbitrament/TorqueSmooth/Rear wheel rate limit determination1/VTQR_SPORTREDURateLimitDec_Nm/LV5" /begin REF_CHARACTERISTIC MTQR_SL5REDUTqDecSR_Z_Nm /end REF_CHARACTERISTIC /end GROUP
/begin GROUP S2244_OPD "SWC_FDC_type/run_SWC_FDC_RxTx_5ms_sys/APP/TQR/Determine Torque Request/TorqueArbitrament/TorqueSmooth/Rear wheel rate limit determination1/VTQR_SPORTREDURateLimitDec_Nm/OPD" /begin REF_CHARACTERISTIC MTQR_SOPDREDUTqDecSR_Z_Nm /end REF_CHARACTERISTIC /end GROUP
/begin GROUP S2245_Invalid "SWC_FDC_type/run_SWC_FDC_RxTx_5ms_sys/APP/TQR/Determine Torque Request/TorqueArbitrament/TorqueSmooth/Rear wheel rate limit determination1/VTQR_SPORTREDURateLimitInc_Nm/Invalid" /begin REF_CHARACTERISTIC MTQR_SL1REDUTqIncSR_Z_Nm /end REF_CHARACTERISTIC /end GROUP
/begin GROUP S2245_LV1 "SWC_FDC_type/run_SWC_FDC_RxTx_5ms_sys/APP/TQR/Determine Torque Request/TorqueArbitrament/TorqueSmooth/Rear wheel rate limit determination1/VTQR_SPORTREDURateLimitInc_Nm/LV1" /begin REF_CHARACTERISTIC MTQR_SL1REDUTqIncSR_Z_Nm /end REF_CHARACTERISTIC /end GROUP
/begin GROUP S2245_LV2 "SWC_FDC_type/run_SWC_FDC_RxTx_5ms_sys/APP/TQR/Determine Torque Request/TorqueArbitrament/TorqueSmooth/Rear wheel rate limit determination1/VTQR_SPORTREDURateLimitInc_Nm/LV2" /begin REF_CHARACTERISTIC KTQR_RrTqIncGainSW_flg MTQR_SL2REDUTqIncSR_Z_Nm /end REF_CHARACTERISTIC /end GROUP
/begin GROUP S2245_LV3 "SWC_FDC_type/run_SWC_FDC_RxTx_5ms_sys/APP/TQR/Determine Torque Request/TorqueArbitrament/TorqueSmooth/Rear wheel rate limit determination1/VTQR_SPORTREDURateLimitInc_Nm/LV3" /begin REF_CHARACTERISTIC KTQR_RrTqIncGainSW_flg MTQR_SL3REDUTqIncSR_Z_Nm /end REF_CHARACTERISTIC /end GROUP
/begin GROUP S2245_LV4 "SWC_FDC_type/run_SWC_FDC_RxTx_5ms_sys/APP/TQR/Determine Torque Request/TorqueArbitrament/TorqueSmooth/Rear wheel rate limit determination1/VTQR_SPORTREDURateLimitInc_Nm/LV4" /begin REF_CHARACTERISTIC KTQR_RrTqIncGainSW_flg MTQR_SL4REDUTqIncSR_Z_Nm /end REF_CHARACTERISTIC /end GROUP
/begin GROUP S2245_LV5 "SWC_FDC_type/run_SWC_FDC_RxTx_5ms_sys/APP/TQR/Determine Torque Request/TorqueArbitrament/TorqueSmooth/Rear wheel rate limit determination1/VTQR_SPORTREDURateLimitInc_Nm/LV5" /begin REF_CHARACTERISTIC KTQR_RrTqIncGainSW_flg MTQR_SL5REDUTqIncSR_Z_Nm /end REF_CHARACTERISTIC /end GROUP
/begin GROUP S2245_OPD "SWC_FDC_type/run_SWC_FDC_RxTx_5ms_sys/APP/TQR/Determine Torque Request/TorqueArbitrament/TorqueSmooth/Rear wheel rate limit determination1/VTQR_SPORTREDURateLimitInc_Nm/OPD" /begin REF_CHARACTERISTIC KTQR_RrTqIncGainSW_flg MTQR_SOPDREDUTqIncSR_Z_Nm /end REF_CHARACTERISTIC /end GROUP
/begin GROUP S1118_Enabled_Subsystem1 "SWC_FDC_type/run_SWC_FDC_RxTx_5ms_sys/APP/TPM/TPMS/TPMS/Learn/AutoLocation/IDIdentify/Subsystem1/Enabled Subsystem1" /begin REF_MEASUREMENT VTPM_RFS2_cnt /end REF_MEASUREMENT /end GROUP
/begin GROUP S1118_Enabled_Subsystem2 "SWC_FDC_type/run_SWC_FDC_RxTx_5ms_sys/APP/TPM/TPMS/TPMS/Learn/AutoLocation/IDIdentify/Subsystem1/Enabled Subsystem2" /begin REF_MEASUREMENT VTPM_LRS2_cnt /end REF_MEASUREMENT /end GROUP
/begin GROUP S1118_Enabled_Subsystem3 "SWC_FDC_type/run_SWC_FDC_RxTx_5ms_sys/APP/TPM/TPMS/TPMS/Learn/AutoLocation/IDIdentify/Subsystem1/Enabled Subsystem3" /begin REF_MEASUREMENT VTPM_RRS2_cnt /end REF_MEASUREMENT /end GROUP
/begin GROUP S1118_Enabled_Subsystem5 "SWC_FDC_type/run_SWC_FDC_RxTx_5ms_sys/APP/TPM/TPMS/TPMS/Learn/AutoLocation/IDIdentify/Subsystem1/Enabled Subsystem5" /begin REF_MEASUREMENT VTPM_LFS2_cnt /end REF_MEASUREMENT /end GROUP
/begin GROUP S1119_Enabled_Subsystem1 "SWC_FDC_type/run_SWC_FDC_RxTx_5ms_sys/APP/TPM/TPMS/TPMS/Learn/AutoLocation/IDIdentify/Subsystem2/Enabled Subsystem1" /begin REF_MEASUREMENT VTPM_RFS3_cnt /end REF_MEASUREMENT /end GROUP
/begin GROUP S1119_Enabled_Subsystem2 "SWC_FDC_type/run_SWC_FDC_RxTx_5ms_sys/APP/TPM/TPMS/TPMS/Learn/AutoLocation/IDIdentify/Subsystem2/Enabled Subsystem2" /begin REF_MEASUREMENT VTPM_LRS3_cnt /end REF_MEASUREMENT /end GROUP
/begin GROUP S1119_Enabled_Subsystem3 "SWC_FDC_type/run_SWC_FDC_RxTx_5ms_sys/APP/TPM/TPMS/TPMS/Learn/AutoLocation/IDIdentify/Subsystem2/Enabled Subsystem3" /begin REF_MEASUREMENT VTPM_RRS3_cnt /end REF_MEASUREMENT /end GROUP
/begin GROUP S1119_Enabled_Subsystem5 "SWC_FDC_type/run_SWC_FDC_RxTx_5ms_sys/APP/TPM/TPMS/TPMS/Learn/AutoLocation/IDIdentify/Subsystem2/Enabled Subsystem5" /begin REF_MEASUREMENT VTPM_LFS3_cnt /end REF_MEASUREMENT /end GROUP
/begin GROUP S1120_Enabled_Subsystem1 "SWC_FDC_type/run_SWC_FDC_RxTx_5ms_sys/APP/TPM/TPMS/TPMS/Learn/AutoLocation/IDIdentify/Subsystem3/Enabled Subsystem1" /begin REF_MEASUREMENT VTPM_RFS4_cnt /end REF_MEASUREMENT /end GROUP
/begin GROUP S1120_Enabled_Subsystem2 "SWC_FDC_type/run_SWC_FDC_RxTx_5ms_sys/APP/TPM/TPMS/TPMS/Learn/AutoLocation/IDIdentify/Subsystem3/Enabled Subsystem2" /begin REF_MEASUREMENT VTPM_LRS4_cnt /end REF_MEASUREMENT /end GROUP
/begin GROUP S1120_Enabled_Subsystem3 "SWC_FDC_type/run_SWC_FDC_RxTx_5ms_sys/APP/TPM/TPMS/TPMS/Learn/AutoLocation/IDIdentify/Subsystem3/Enabled Subsystem3" /begin REF_MEASUREMENT VTPM_RRS4_cnt /end REF_MEASUREMENT /end GROUP
/begin GROUP S1120_Enabled_Subsystem5 "SWC_FDC_type/run_SWC_FDC_RxTx_5ms_sys/APP/TPM/TPMS/TPMS/Learn/AutoLocation/IDIdentify/Subsystem3/Enabled Subsystem5" /begin REF_MEASUREMENT VTPM_LFS4_cnt /end REF_MEASUREMENT /end GROUP
/begin GROUP S1121_Enabled_Subsystem1 "SWC_FDC_type/run_SWC_FDC_RxTx_5ms_sys/APP/TPM/TPMS/TPMS/Learn/AutoLocation/IDIdentify/Subsystem7/Enabled Subsystem1" /begin REF_MEASUREMENT VTPM_RFS1_cnt /end REF_MEASUREMENT /end GROUP
/begin GROUP S1121_Enabled_Subsystem2 "SWC_FDC_type/run_SWC_FDC_RxTx_5ms_sys/APP/TPM/TPMS/TPMS/Learn/AutoLocation/IDIdentify/Subsystem7/Enabled Subsystem2" /begin REF_MEASUREMENT VTPM_LRS1_cnt /end REF_MEASUREMENT /end GROUP
/begin GROUP S1121_Enabled_Subsystem3 "SWC_FDC_type/run_SWC_FDC_RxTx_5ms_sys/APP/TPM/TPMS/TPMS/Learn/AutoLocation/IDIdentify/Subsystem7/Enabled Subsystem3" /begin REF_MEASUREMENT VTPM_RRS1_cnt /end REF_MEASUREMENT /end GROUP
/begin GROUP S1121_Enabled_Subsystem5 "SWC_FDC_type/run_SWC_FDC_RxTx_5ms_sys/APP/TPM/TPMS/TPMS/Learn/AutoLocation/IDIdentify/Subsystem7/Enabled Subsystem5" /begin REF_MEASUREMENT VTPM_LFS1_cnt /end REF_MEASUREMENT /end GROUP
/begin GROUP S1422_Key1 "SWC_FDC_type/run_SWC_FDC_RxTx_5ms_sys/APP/TQD/TorqueDemand/Signal_convert/SWC2_Subsystem/Big Mike Combo/Combo Key Detection/DiagnosisOff Mode/Key1" /begin REF_CHARACTERISTIC KTQD_DiagnosisOff1_enum /end REF_CHARACTERISTIC /begin REF_MEASUREMENT VTQD_DiagnosisOff1Pass_flg VTQD_DiagnosisOff1_enum /end REF_MEASUREMENT /end GROUP
/begin GROUP S1422_Key2 "SWC_FDC_type/run_SWC_FDC_RxTx_5ms_sys/APP/TQD/TorqueDemand/Signal_convert/SWC2_Subsystem/Big Mike Combo/Combo Key Detection/DiagnosisOff Mode/Key2" /begin REF_CHARACTERISTIC KTQD_DiagnosisOff2_enum /end REF_CHARACTERISTIC /begin REF_MEASUREMENT VTQD_DiagnosisOff2Pass_flg VTQD_DiagnosisOff2_enum /end REF_MEASUREMENT /end GROUP
/begin GROUP S1422_Key3 "SWC_FDC_type/run_SWC_FDC_RxTx_5ms_sys/APP/TQD/TorqueDemand/Signal_convert/SWC2_Subsystem/Big Mike Combo/Combo Key Detection/DiagnosisOff Mode/Key3" /begin REF_CHARACTERISTIC KTQD_DiagnosisOff3_enum /end REF_CHARACTERISTIC /begin REF_MEASUREMENT VTQD_DiagnosisOff3Pass_flg VTQD_DiagnosisOff3_enum /end REF_MEASUREMENT /end GROUP
/begin GROUP S1422_Key4 "SWC_FDC_type/run_SWC_FDC_RxTx_5ms_sys/APP/TQD/TorqueDemand/Signal_convert/SWC2_Subsystem/Big Mike Combo/Combo Key Detection/DiagnosisOff Mode/Key4" /begin REF_CHARACTERISTIC KTQD_DiagnosisOff4_enum /end REF_CHARACTERISTIC /begin REF_MEASUREMENT VTQD_DiagnosisOff4Pass_flg VTQD_DiagnosisOff4_enum /end REF_MEASUREMENT /end GROUP
/begin GROUP S1422_Key5 "SWC_FDC_type/run_SWC_FDC_RxTx_5ms_sys/APP/TQD/TorqueDemand/Signal_convert/SWC2_Subsystem/Big Mike Combo/Combo Key Detection/DiagnosisOff Mode/Key5" /begin REF_CHARACTERISTIC KTQD_DiagnosisOff5_enum /end REF_CHARACTERISTIC /begin REF_MEASUREMENT VTQD_DiagnosisOff5Pass_flg VTQD_DiagnosisOff5_enum /end REF_MEASUREMENT /end GROUP
/begin GROUP S1422_Key6 "SWC_FDC_type/run_SWC_FDC_RxTx_5ms_sys/APP/TQD/TorqueDemand/Signal_convert/SWC2_Subsystem/Big Mike Combo/Combo Key Detection/DiagnosisOff Mode/Key6" /begin REF_CHARACTERISTIC KTQD_DiagnosisOff6_enum /end REF_CHARACTERISTIC /begin REF_MEASUREMENT VTQD_DiagnosisOff6Pass_flg VTQD_DiagnosisOff6_enum /end REF_MEASUREMENT /end GROUP
/begin GROUP S1422_Key7 "SWC_FDC_type/run_SWC_FDC_RxTx_5ms_sys/APP/TQD/TorqueDemand/Signal_convert/SWC2_Subsystem/Big Mike Combo/Combo Key Detection/DiagnosisOff Mode/Key7" /begin REF_CHARACTERISTIC KTQD_DiagnosisOff7_enum /end REF_CHARACTERISTIC /begin REF_MEASUREMENT VTQD_DiagnosisOff7Pass_flg VTQD_DiagnosisOff7_enum /end REF_MEASUREMENT /end GROUP
/begin GROUP S1422_Key8 "SWC_FDC_type/run_SWC_FDC_RxTx_5ms_sys/APP/TQD/TorqueDemand/Signal_convert/SWC2_Subsystem/Big Mike Combo/Combo Key Detection/DiagnosisOff Mode/Key8" /begin REF_CHARACTERISTIC KTQD_DiagnosisOff8_enum /end REF_CHARACTERISTIC /begin REF_MEASUREMENT VTQD_DiagnosisOff8Pass_flg VTQD_DiagnosisOff8_enum /end REF_MEASUREMENT /end GROUP
/begin GROUP S1423_Key1 "SWC_FDC_type/run_SWC_FDC_RxTx_5ms_sys/APP/TQD/TorqueDemand/Signal_convert/SWC2_Subsystem/Big Mike Combo/Combo Key Detection/Engineering Mode/Key1" /begin REF_CHARACTERISTIC KTQD_Engineering1_enum /end REF_CHARACTERISTIC /begin REF_MEASUREMENT VTQD_Engineering1Pass_flg VTQD_Engineering1_enum /end REF_MEASUREMENT /end GROUP
/begin GROUP S1423_Key2 "SWC_FDC_type/run_SWC_FDC_RxTx_5ms_sys/APP/TQD/TorqueDemand/Signal_convert/SWC2_Subsystem/Big Mike Combo/Combo Key Detection/Engineering Mode/Key2" /begin REF_CHARACTERISTIC KTQD_Engineering2_enum /end REF_CHARACTERISTIC /begin REF_MEASUREMENT VTQD_Engineering2Pass_flg VTQD_Engineering2_enum /end REF_MEASUREMENT /end GROUP
/begin GROUP S1423_Key3 "SWC_FDC_type/run_SWC_FDC_RxTx_5ms_sys/APP/TQD/TorqueDemand/Signal_convert/SWC2_Subsystem/Big Mike Combo/Combo Key Detection/Engineering Mode/Key3" /begin REF_CHARACTERISTIC KTQD_Engineering3_enum /end REF_CHARACTERISTIC /begin REF_MEASUREMENT VTQD_Engineering3Pass_flg VTQD_Engineering3_enum /end REF_MEASUREMENT /end GROUP
/begin GROUP S1423_Key4 "SWC_FDC_type/run_SWC_FDC_RxTx_5ms_sys/APP/TQD/TorqueDemand/Signal_convert/SWC2_Subsystem/Big Mike Combo/Combo Key Detection/Engineering Mode/Key4" /begin REF_CHARACTERISTIC KTQD_Engineering4_enum /end REF_CHARACTERISTIC /begin REF_MEASUREMENT VTQD_Engineering4Pass_flg VTQD_Engineering4_enum /end REF_MEASUREMENT /end GROUP
/begin GROUP S1423_Key5 "SWC_FDC_type/run_SWC_FDC_RxTx_5ms_sys/APP/TQD/TorqueDemand/Signal_convert/SWC2_Subsystem/Big Mike Combo/Combo Key Detection/Engineering Mode/Key5" /begin REF_CHARACTERISTIC KTQD_Engineering5_enum /end REF_CHARACTERISTIC /begin REF_MEASUREMENT VTQD_Engineering5Pass_flg VTQD_Engineering5_enum /end REF_MEASUREMENT /end GROUP
/begin GROUP S1423_Key6 "SWC_FDC_type/run_SWC_FDC_RxTx_5ms_sys/APP/TQD/TorqueDemand/Signal_convert/SWC2_Subsystem/Big Mike Combo/Combo Key Detection/Engineering Mode/Key6" /begin REF_CHARACTERISTIC KTQD_Engineering6_enum /end REF_CHARACTERISTIC /begin REF_MEASUREMENT VTQD_Engineering6Pass_flg VTQD_Engineering6_enum /end REF_MEASUREMENT /end GROUP
/begin GROUP S1423_Key7 "SWC_FDC_type/run_SWC_FDC_RxTx_5ms_sys/APP/TQD/TorqueDemand/Signal_convert/SWC2_Subsystem/Big Mike Combo/Combo Key Detection/Engineering Mode/Key7" /begin REF_CHARACTERISTIC KTQD_Engineering7_enum /end REF_CHARACTERISTIC /begin REF_MEASUREMENT VTQD_Engineering7Pass_flg VTQD_Engineering7_enum /end REF_MEASUREMENT /end GROUP
/begin GROUP S1423_Key8 "SWC_FDC_type/run_SWC_FDC_RxTx_5ms_sys/APP/TQD/TorqueDemand/Signal_convert/SWC2_Subsystem/Big Mike Combo/Combo Key Detection/Engineering Mode/Key8" /begin REF_CHARACTERISTIC KTQD_Engineering8_enum /end REF_CHARACTERISTIC /begin REF_MEASUREMENT VTQD_Engineering8Pass_flg VTQD_Engineering8_enum /end REF_MEASUREMENT /end GROUP
/begin GROUP S1424_Key1 "SWC_FDC_type/run_SWC_FDC_RxTx_5ms_sys/APP/TQD/TorqueDemand/Signal_convert/SWC2_Subsystem/Big Mike Combo/Combo Key Detection/Exhibition Mode/Key1" /begin REF_CHARACTERISTIC KTQD_Exhibition1_enum /end REF_CHARACTERISTIC /begin REF_MEASUREMENT VTQD_Exhibition1Pass_flg VTQD_Exhibition1_enum /end REF_MEASUREMENT /end GROUP
/begin GROUP S1424_Key2 "SWC_FDC_type/run_SWC_FDC_RxTx_5ms_sys/APP/TQD/TorqueDemand/Signal_convert/SWC2_Subsystem/Big Mike Combo/Combo Key Detection/Exhibition Mode/Key2" /begin REF_CHARACTERISTIC KTQD_Exhibition2_enum /end REF_CHARACTERISTIC /begin REF_MEASUREMENT VTQD_Exhibition2Pass_flg VTQD_Exhibition2_enum /end REF_MEASUREMENT /end GROUP
/begin GROUP S1424_Key3 "SWC_FDC_type/run_SWC_FDC_RxTx_5ms_sys/APP/TQD/TorqueDemand/Signal_convert/SWC2_Subsystem/Big Mike Combo/Combo Key Detection/Exhibition Mode/Key3" /begin REF_CHARACTERISTIC KTQD_Exhibition3_enum /end REF_CHARACTERISTIC /begin REF_MEASUREMENT VTQD_Exhibition3Pass_flg VTQD_Exhibition3_enum /end REF_MEASUREMENT /end GROUP
/begin GROUP S1424_Key4 "SWC_FDC_type/run_SWC_FDC_RxTx_5ms_sys/APP/TQD/TorqueDemand/Signal_convert/SWC2_Subsystem/Big Mike Combo/Combo Key Detection/Exhibition Mode/Key4" /begin REF_CHARACTERISTIC KTQD_Exhibition4_enum /end REF_CHARACTERISTIC /begin REF_MEASUREMENT VTQD_Exhibition4Pass_flg VTQD_Exhibition4_enum /end REF_MEASUREMENT /end GROUP
/begin GROUP S1424_Key5 "SWC_FDC_type/run_SWC_FDC_RxTx_5ms_sys/APP/TQD/TorqueDemand/Signal_convert/SWC2_Subsystem/Big Mike Combo/Combo Key Detection/Exhibition Mode/Key5" /begin REF_CHARACTERISTIC KTQD_Exhibition5_enum /end REF_CHARACTERISTIC /begin REF_MEASUREMENT VTQD_Exhibition5Pass_flg VTQD_Exhibition5_enum /end REF_MEASUREMENT /end GROUP
/begin GROUP S1424_Key6 "SWC_FDC_type/run_SWC_FDC_RxTx_5ms_sys/APP/TQD/TorqueDemand/Signal_convert/SWC2_Subsystem/Big Mike Combo/Combo Key Detection/Exhibition Mode/Key6" /begin REF_CHARACTERISTIC KTQD_Exhibition6_enum /end REF_CHARACTERISTIC /begin REF_MEASUREMENT VTQD_Exhibition6Pass_flg VTQD_Exhibition6_enum /end REF_MEASUREMENT /end GROUP
/begin GROUP S1424_Key7 "SWC_FDC_type/run_SWC_FDC_RxTx_5ms_sys/APP/TQD/TorqueDemand/Signal_convert/SWC2_Subsystem/Big Mike Combo/Combo Key Detection/Exhibition Mode/Key7" /begin REF_CHARACTERISTIC KTQD_Exhibition7_enum /end REF_CHARACTERISTIC /begin REF_MEASUREMENT VTQD_Exhibition7Pass_flg VTQD_Exhibition7_enum /end REF_MEASUREMENT /end GROUP
/begin GROUP S1424_Key8 "SWC_FDC_type/run_SWC_FDC_RxTx_5ms_sys/APP/TQD/TorqueDemand/Signal_convert/SWC2_Subsystem/Big Mike Combo/Combo Key Detection/Exhibition Mode/Key8" /begin REF_CHARACTERISTIC KTQD_Exhibition8_enum /end REF_CHARACTERISTIC /begin REF_MEASUREMENT VTQD_Exhibition8Pass_flg VTQD_Exhibition8_enum /end REF_MEASUREMENT /end GROUP
/begin GROUP S1425_Key1 "SWC_FDC_type/run_SWC_FDC_RxTx_5ms_sys/APP/TQD/TorqueDemand/Signal_convert/SWC2_Subsystem/Big Mike Combo/Combo Key Detection/Manufacture Mode/Key1" /begin REF_CHARACTERISTIC KTQD_Manufacture1_enum /end REF_CHARACTERISTIC /begin REF_MEASUREMENT VTQD_Manufacture1Pass_flg VTQD_Manufacture1_enum /end REF_MEASUREMENT /end GROUP
/begin GROUP S1425_Key2 "SWC_FDC_type/run_SWC_FDC_RxTx_5ms_sys/APP/TQD/TorqueDemand/Signal_convert/SWC2_Subsystem/Big Mike Combo/Combo Key Detection/Manufacture Mode/Key2" /begin REF_CHARACTERISTIC KTQD_Manufacture2_enum /end REF_CHARACTERISTIC /begin REF_MEASUREMENT VTQD_Manufacture2Pass_flg VTQD_Manufacture2_enum /end REF_MEASUREMENT /end GROUP
/begin GROUP S1425_Key3 "SWC_FDC_type/run_SWC_FDC_RxTx_5ms_sys/APP/TQD/TorqueDemand/Signal_convert/SWC2_Subsystem/Big Mike Combo/Combo Key Detection/Manufacture Mode/Key3" /begin REF_CHARACTERISTIC KTQD_Manufacture3_enum /end REF_CHARACTERISTIC /begin REF_MEASUREMENT VTQD_Manufacture3Pass_flg VTQD_Manufacture3_enum /end REF_MEASUREMENT /end GROUP
/begin GROUP S1425_Key4 "SWC_FDC_type/run_SWC_FDC_RxTx_5ms_sys/APP/TQD/TorqueDemand/Signal_convert/SWC2_Subsystem/Big Mike Combo/Combo Key Detection/Manufacture Mode/Key4" /begin REF_CHARACTERISTIC KTQD_Manufacture4_enum /end REF_CHARACTERISTIC /begin REF_MEASUREMENT VTQD_Manufacture4Pass_flg VTQD_Manufacture4_enum /end REF_MEASUREMENT /end GROUP
/begin GROUP S1425_Key5 "SWC_FDC_type/run_SWC_FDC_RxTx_5ms_sys/APP/TQD/TorqueDemand/Signal_convert/SWC2_Subsystem/Big Mike Combo/Combo Key Detection/Manufacture Mode/Key5" /begin REF_CHARACTERISTIC KTQD_Manufacture5_enum /end REF_CHARACTERISTIC /begin REF_MEASUREMENT VTQD_Manufacture5Pass_flg VTQD_Manufacture5_enum /end REF_MEASUREMENT /end GROUP
/begin GROUP S1425_Key6 "SWC_FDC_type/run_SWC_FDC_RxTx_5ms_sys/APP/TQD/TorqueDemand/Signal_convert/SWC2_Subsystem/Big Mike Combo/Combo Key Detection/Manufacture Mode/Key6" /begin REF_CHARACTERISTIC KTQD_Manufacture6_enum /end REF_CHARACTERISTIC /begin REF_MEASUREMENT VTQD_Manufacture6Pass_flg VTQD_Manufacture6_enum /end REF_MEASUREMENT /end GROUP
/begin GROUP S1425_Key7 "SWC_FDC_type/run_SWC_FDC_RxTx_5ms_sys/APP/TQD/TorqueDemand/Signal_convert/SWC2_Subsystem/Big Mike Combo/Combo Key Detection/Manufacture Mode/Key7" /begin REF_CHARACTERISTIC KTQD_Manufacture7_enum /end REF_CHARACTERISTIC /begin REF_MEASUREMENT VTQD_Manufacture7Pass_flg VTQD_Manufacture7_enum /end REF_MEASUREMENT /end GROUP
/begin GROUP S1425_Key8 "SWC_FDC_type/run_SWC_FDC_RxTx_5ms_sys/APP/TQD/TorqueDemand/Signal_convert/SWC2_Subsystem/Big Mike Combo/Combo Key Detection/Manufacture Mode/Key8" /begin REF_CHARACTERISTIC KTQD_Manufacture8_enum /end REF_CHARACTERISTIC /begin REF_MEASUREMENT VTQD_Manufacture8Pass_flg VTQD_Manufacture8_enum /end REF_MEASUREMENT /end GROUP
/begin GROUP S1426_Key1 "SWC_FDC_type/run_SWC_FDC_RxTx_5ms_sys/APP/TQD/TorqueDemand/Signal_convert/SWC2_Subsystem/Big Mike Combo/Combo Key Detection/Street Fight Mode/Key1" /begin REF_CHARACTERISTIC KTQD_StreetFight1_enum /end REF_CHARACTERISTIC /begin REF_MEASUREMENT VTQD_StreetFight1Pass_flg VTQD_StreetFight1_enum /end REF_MEASUREMENT /end GROUP
/begin GROUP S1426_Key2 "SWC_FDC_type/run_SWC_FDC_RxTx_5ms_sys/APP/TQD/TorqueDemand/Signal_convert/SWC2_Subsystem/Big Mike Combo/Combo Key Detection/Street Fight Mode/Key2" /begin REF_CHARACTERISTIC KTQD_StreetFight2_enum /end REF_CHARACTERISTIC /begin REF_MEASUREMENT VTQD_StreetFight2Pass_flg VTQD_StreetFight2_enum /end REF_MEASUREMENT /end GROUP
/begin GROUP S1426_Key3 "SWC_FDC_type/run_SWC_FDC_RxTx_5ms_sys/APP/TQD/TorqueDemand/Signal_convert/SWC2_Subsystem/Big Mike Combo/Combo Key Detection/Street Fight Mode/Key3" /begin REF_CHARACTERISTIC KTQD_StreetFight3_enum /end REF_CHARACTERISTIC /begin REF_MEASUREMENT VTQD_StreetFight3Pass_flg VTQD_StreetFight3_enum /end REF_MEASUREMENT /end GROUP
/begin GROUP S1426_Key4 "SWC_FDC_type/run_SWC_FDC_RxTx_5ms_sys/APP/TQD/TorqueDemand/Signal_convert/SWC2_Subsystem/Big Mike Combo/Combo Key Detection/Street Fight Mode/Key4" /begin REF_CHARACTERISTIC KTQD_StreetFight4_enum /end REF_CHARACTERISTIC /begin REF_MEASUREMENT VTQD_StreetFight4Pass_flg VTQD_StreetFight4_enum /end REF_MEASUREMENT /end GROUP
/begin GROUP S1426_Key5 "SWC_FDC_type/run_SWC_FDC_RxTx_5ms_sys/APP/TQD/TorqueDemand/Signal_convert/SWC2_Subsystem/Big Mike Combo/Combo Key Detection/Street Fight Mode/Key5" /begin REF_CHARACTERISTIC KTQD_StreetFight5_enum /end REF_CHARACTERISTIC /begin REF_MEASUREMENT VTQD_StreetFight5Pass_flg VTQD_StreetFight5_enum /end REF_MEASUREMENT /end GROUP
/begin GROUP S1426_Key6 "SWC_FDC_type/run_SWC_FDC_RxTx_5ms_sys/APP/TQD/TorqueDemand/Signal_convert/SWC2_Subsystem/Big Mike Combo/Combo Key Detection/Street Fight Mode/Key6" /begin REF_CHARACTERISTIC KTQD_StreetFight6_enum /end REF_CHARACTERISTIC /begin REF_MEASUREMENT VTQD_StreetFight6Pass_flg VTQD_StreetFight6_enum /end REF_MEASUREMENT /end GROUP
/begin GROUP S1426_Key7 "SWC_FDC_type/run_SWC_FDC_RxTx_5ms_sys/APP/TQD/TorqueDemand/Signal_convert/SWC2_Subsystem/Big Mike Combo/Combo Key Detection/Street Fight Mode/Key7" /begin REF_CHARACTERISTIC KTQD_StreetFight7_enum /end REF_CHARACTERISTIC /begin REF_MEASUREMENT VTQD_StreetFight7Pass_flg VTQD_StreetFight7_enum /end REF_MEASUREMENT /end GROUP
/begin GROUP S1426_Key8 "SWC_FDC_type/run_SWC_FDC_RxTx_5ms_sys/APP/TQD/TorqueDemand/Signal_convert/SWC2_Subsystem/Big Mike Combo/Combo Key Detection/Street Fight Mode/Key8" /begin REF_CHARACTERISTIC KTQD_StreetFight8_enum /end REF_CHARACTERISTIC /begin REF_MEASUREMENT VTQD_StreetFight8Pass_flg VTQD_StreetFight8_enum /end REF_MEASUREMENT /end GROUP
/begin GROUP S1724_Timer "SWC_FDC_type/run_SWC_FDC_RxTx_5ms_sys/APP/TQD/TorqueDemand/Signal_convert/SWC2_Subsystem/Big Mike Combo/Signal Status Detection/Street Fight Switch Off/Timer" /begin REF_MEASUREMENT VTQD_CANCELCountDetTime_s /end REF_MEASUREMENT /end GROUP
/begin GROUP S1940_LUT_D_ECO "SWC_FDC_type/run_SWC_FDC_RxTx_5ms_sys/APP/TQD/TorqueDemand/TorqueModule/DriverWhlTqDem/PedalMapWhlTq/NoLHM/ShiftD/LUT_D_ECO" /begin SUB_GROUP S1943_ECO_OnePedal_TqMap /end SUB_GROUP
 /begin REF_CHARACTERISTIC MTQD_ECOTqMapD_Z_Nm MTQD_EL2TqMapD_Z_Nm MTQD_EL3TqMapD_Z_Nm MTQD_EL4TqMapD_Z_Nm MTQD_EL5TqMapD_Z_Nm MTQD_EOPDTqMapDCon_Z_Nm MTQD_EOPDTqMapD_Z_Nm MTQD_RollGenMapEL1_Z_Nm /end REF_CHARACTERISTIC
/end GROUP
/begin GROUP S1940_LUT_D_EscapeMode "SWC_FDC_type/run_SWC_FDC_RxTx_5ms_sys/APP/TQD/TorqueDemand/TorqueModule/DriverWhlTqDem/PedalMapWhlTq/NoLHM/ShiftD/LUT_D_EscapeMode" /begin REF_CHARACTERISTIC MTQD_EMTqMapD_Z_Nm /end REF_CHARACTERISTIC /end GROUP
/begin GROUP S1940_LUT_D_Normal "SWC_FDC_type/run_SWC_FDC_RxTx_5ms_sys/APP/TQD/TorqueDemand/TorqueModule/DriverWhlTqDem/PedalMapWhlTq/NoLHM/ShiftD/LUT_D_Normal" /begin SUB_GROUP S1945_NRM_OnePedal_TqMap /end SUB_GROUP
 /begin REF_CHARACTERISTIC MTQD_NL2TqMapD_Z_Nm MTQD_NL3TqMapD_Z_Nm MTQD_NL4TqMapD_Z_Nm MTQD_NL5TqMapD_Z_Nm MTQD_NOPDTqMapDCon_Z_Nm MTQD_NOPDTqMapD_Z_Nm /end REF_CHARACTERISTIC
/end GROUP
/begin GROUP S1940_LUT_D_SnowMode "SWC_FDC_type/run_SWC_FDC_RxTx_5ms_sys/APP/TQD/TorqueDemand/TorqueModule/DriverWhlTqDem/PedalMapWhlTq/NoLHM/ShiftD/LUT_D_SnowMode" /begin REF_CHARACTERISTIC MTQD_SNTqMapD_Z_Nm /end REF_CHARACTERISTIC /end GROUP
/begin GROUP S1940_LUT_D_Sport "SWC_FDC_type/run_SWC_FDC_RxTx_5ms_sys/APP/TQD/TorqueDemand/TorqueModule/DriverWhlTqDem/PedalMapWhlTq/NoLHM/ShiftD/LUT_D_Sport" /begin SUB_GROUP S1947_Sport_OnePedal_TqMap /end SUB_GROUP
 /begin REF_CHARACTERISTIC MTQD_SL1TqMapD_Z_Nm MTQD_SL2TqMapD_Z_Nm MTQD_SL3TqMapD_Z_Nm MTQD_SL4TqMapD_Z_Nm MTQD_SL5TqMapD_Z_Nm MTQD_SOPDTqMapDCon_Z_Nm MTQD_SOPDTqMapD_Z_Nm /end REF_CHARACTERISTIC
/end GROUP
/begin GROUP S1976_DelayEnable3 "SWC_FDC_type/run_SWC_FDC_RxTx_5ms_sys/APP/TQD/TorqueDemand/TorqueModule/DriverWhlTqDem/PedalMapWhlTq/Pedal G-Control Mode/Active Determination/DelayEnable3" /begin REF_MEASUREMENT VTQD_PedGControlTrig_flg /end REF_MEASUREMENT /end GROUP
/begin GROUP S1943_ECO_OnePedal_TqMap "SWC_FDC_type/run_SWC_FDC_RxTx_5ms_sys/APP/TQD/TorqueDemand/TorqueModule/DriverWhlTqDem/PedalMapWhlTq/NoLHM/ShiftD/LUT_D_ECO/ECO_OnePedal_TqMap" /begin REF_CHARACTERISTIC KTQD_OPDHTqDisAPSPosn_pct KTQD_OPDHTqDisComSpd_kph /end REF_CHARACTERISTIC /begin REF_MEASUREMENT VTQD_EOPDActTqMapD_Nm /end REF_MEASUREMENT /end GROUP
/begin GROUP S1945_NRM_OnePedal_TqMap "SWC_FDC_type/run_SWC_FDC_RxTx_5ms_sys/APP/TQD/TorqueDemand/TorqueModule/DriverWhlTqDem/PedalMapWhlTq/NoLHM/ShiftD/LUT_D_Normal/NRM_OnePedal_TqMap" /begin SUB_GROUP S1963_SR_Latch /end SUB_GROUP /begin REF_CHARACTERISTIC KTQD_OPDHTqDisAPSPosn_pct KTQD_OPDHTqDisComSpd_kph /end REF_CHARACTERISTIC /begin REF_MEASUREMENT VTQD_NOPDActTqMapD_Nm /end REF_MEASUREMENT /end GROUP
/begin GROUP S1947_Sport_OnePedal_TqMap "SWC_FDC_type/run_SWC_FDC_RxTx_5ms_sys/APP/TQD/TorqueDemand/TorqueModule/DriverWhlTqDem/PedalMapWhlTq/NoLHM/ShiftD/LUT_D_Sport/Sport_OnePedal_TqMap" /begin REF_CHARACTERISTIC KTQD_OPDHTqDisAPSPosn_pct KTQD_OPDHTqDisComSpd_kph /end REF_CHARACTERISTIC /begin REF_MEASUREMENT VTQD_SOPDActTqMapD_Nm /end REF_MEASUREMENT /end GROUP
/begin GROUP S1963_SR_Latch "SWC_FDC_type/run_SWC_FDC_RxTx_5ms_sys/APP/TQD/TorqueDemand/TorqueModule/DriverWhlTqDem/PedalMapWhlTq/NoLHM/ShiftD/LUT_D_Normal/NRM_OnePedal_TqMap/SR_Latch" /begin REF_MEASUREMENT VTQD_OPDHoldRelPedTq_flg /end REF_MEASUREMENT /end GROUP
/end MODULE
/end PROJECT
