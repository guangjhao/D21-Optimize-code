AUTOSAR XML (schema 4-3-0)
package /NmConfig
  nm config NmConfig: can-nm-cluster-coupling{coupled-cluster=CAN1, nm-busload-reduction-enabled=false, nm-immediate-restart-enabled=false}
    can nm cluster CAN1:
      communication-cluster=CAN1
      nm-channel-id=0
      nm-channel-sleep-master=false
      nm-synchronizing-network=false
      nm-busload-reduction-active=false
      nm-car-wake-up-filter-enabled=false
      nm-car-wake-up-rx-enabled=false
      nm-cbv-position=1
      nm-channel-active=false
      nm-immediate-nm-cycle-time=0.02
      nm-immediate-nm-transmissions=5
      nm-msg-cycle-time=0.7
      nm-network-timeout=1.0
      nm-nid-position=0
      nm-repeat-message-time=2
      nm-user-data-length=6
      nm-wait-bus-sleep-time=0.5
      can nm node FUSION: controller=CAN1, nm-if-ecu=FUSION, nm-node-id=0, nm-passive-mode-enabled=false, rx-nm-pdu=[CAN1_NMm_ABM, CAN1_NMm_EPAS, CAN1_NMm_ESC, CAN1_NMm_FCM, CAN1_NMm_SRR_M, CAN1_NMm_eBST], tx-nm-pdu=CAN1_NMm_FUSION, nm-msg-cycle-offset=0, nm-msg-reduced-time=0.001, nm-range-config={lower-can-id=0, upper-can-id=0}
    nm-if-ecus:
      nm ecu FUSION:
        bus-specific-nm-ecu=can-nm-ecu=nm-repeat-msg-indication-enabled=true
        ecu-instance=FUSION
        nm-bus-synchronization-enabled=false
        nm-com-control-enabled=true
        nm-cycletime-main-function=0.02
        nm-node-detection-enabled=true
        nm-node-id-enabled=true
        nm-passive-mode-enabled=false
        nm-pdu-rx-indication-enabled=false
        nm-remote-sleep-ind-enabled=false
        nm-repeat-msg-ind-enabled=true
        nm-state-change-ind-enabled=true
        nm-user-data-enabled=true
