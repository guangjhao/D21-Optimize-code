AUTOSAR XML (schema 4-3-0)
package /PduGroups
  11 x i signal i pdu group:
    FUSION_CAN1_Tx: communication-direction=OUT, communication-mode=CAN_Transmit_All
      i-signal-i-pdus:
        CAN1_FD1_C1000_0
        CAN1_FD1_C100_{0..3}
        CAN1_FD1_C10_0
        CAN1_FD1_C10_1
        CAN1_FD1_C200_0
        CAN1_FD1_C20_0
        CAN1_FD1_C250_0
        CAN1_FD1_C5000_0
        CAN1_FD1_C5000_1
        CAN1_FD1_C50_0
        CAN1_FD1_C50_1
        CAN1_FD1_C80_0
        CAN1_FD1_CE100_{0..2}
    FUSION_CAN1_Rx: communication-direction=IN, communication-mode=CAN_Receive_All
      i-signal-i-pdus:
        CAN1_AC_BTMS_C1000_{0..2}
        CAN1_AC_BTMS_C1000_4
        CAN1_AC_BTMS_C5000_0
        CAN1_ASC1_A
        CAN1_EBC1
        CAN1_EBC2
        CAN1_EBC5
        CAN1_ECAS_DM1
        CAN1_EMC1_EM1
        CAN1_HRW
        CAN1_TC1
        CAN1_TPMS{1..3}
        CAN1_VDC1
    FUSION_CAN2_Tx: communication-direction=OUT, communication-mode=CAN_Transmit_All
      i-signal-i-pdus:
        CAN2_FD2_C1000_0
        CAN2_FD2_C10_0
        CAN2_FD2_C200_0
        CAN2_FD2_C500_0
        CAN2_FD2_C50_0
        CAN2_FD2_CE100_0
        CAN2_GW2_C100_0
    FUSION_CAN2_Rx: communication-direction=IN, communication-mode=CAN_Receive_All, i-signal-i-pdus=CAN2_IVI_C100_0
    FUSION_CAN3_Tx: communication-direction=OUT, communication-mode=CAN_Transmit_All, i-signal-i-pdus=[CAN3_FD3_C100_0, CAN3_FD3_C10_0, CAN3_FD3_C10_1, CAN3_FD3_C200_0, CAN3_FD3_C200_1]
    FUSION_CAN3_Rx: communication-direction=IN, communication-mode=CAN_Receive_All
      i-signal-i-pdus:
        CAN3_B2TM_Info
        CAN3_B2V_BattInfo1
        CAN3_B2V_CurrentLimit
        CAN3_B2V_Fult1_32960
        CAN3_B2V_ST1
        CAN3_B2V_ST2
        CAN3_B2V_ST4
        CAN3_B2V_ST5
        CAN3_EWP1
        CAN3_TM_MCUSta{1..3}
    FUSION_CAN4_Tx: communication-direction=OUT, communication-mode=CAN_Transmit_All, i-signal-i-pdus=[CAN4_FD4_C100_0, CAN4_FD4_C10_0, CAN4_FD4_C200_0, CAN4_FD4_CE100_0, CAN4_FD4_CE100_1]
    FUSION_CAN4_Rx: communication-direction=IN, communication-mode=CAN_Receive_All
      i-signal-i-pdus:
        CAN4_ZFR_C100_0
        CAN4_ZFR_C5000_0
        CAN4_ZFR_CE100_0
        CAN4_ZRR_C5000_0
        CAN4_ZRR_CE100_0
        CAN4_ZRR_CE100_1
        CAN4_zGW_CANRr1_C50_0
    FUSION_CAN5_Tx: communication-direction=OUT, communication-mode=CAN_Transmit_All, i-signal-i-pdus=[CAN5_FD5_C100_0, CAN5_FD5_C200_0]
    FUSION_CAN6_Tx: communication-direction=OUT, communication-mode=CAN_Transmit_All, i-signal-i-pdus=CAN6_FD6_C200_0
    FUSION_CAN7_Tx: communication-direction=OUT, communication-mode=CAN_Transmit_All, i-signal-i-pdus=[CAN7_FD7_C100_0, CAN7_FD7_C10_0, CAN7_FD7_C200_0, CAN7_FD7_C50_0, CAN7_FD7_CE100_0]
