ASAP2_VERSION 1 31
/begin PROJECT ProjectName "Project Comment Goes Here"
/begin HEADER "Header Comments go here" /end HEADER
/begin MODULE ModuleName "Module Comment Goes Here"
/begin MOD_COMMON "Mod Common Comment Here" BYTE_ORDER MSB_LAST /end MOD_COMMON
/begin RECORD_LAYOUT Scalar_BOOLEAN FNC_VALUES 1 UBYTE COLUMN_DIR DIRECT /end RECORD_LAYOUT
/begin RECORD_LAYOUT Scalar_UBYTE FNC_VALUES 1 UBYTE COLUMN_DIR DIRECT /end RECORD_LAYOUT
/begin RECORD_LAYOUT Scalar_FLOAT32_IEEE FNC_VALUES 1 FLOAT32_IEEE COLUMN_DIR DIRECT /end RECORD_LAYOUT
/begin RECORD_LAYOUT Lookup1D_UBYTE FNC_VALUES 1 UBYTE COLUMN_DIR DIRECT /end RECORD_LAYOUT
/begin RECORD_LAYOUT Lookup1D_X_UBYTE AXIS_PTS_X 1 UBYTE INDEX_INCR DIRECT /end RECORD_LAYOUT
/begin RECORD_LAYOUT Lookup1D_UWORD FNC_VALUES 1 UWORD COLUMN_DIR DIRECT /end RECORD_LAYOUT
/begin RECORD_LAYOUT Lookup1D_X_UWORD AXIS_PTS_X 1 UWORD INDEX_INCR DIRECT /end RECORD_LAYOUT
/begin RECORD_LAYOUT Lookup1D_WORD FNC_VALUES 1 SWORD COLUMN_DIR DIRECT /end RECORD_LAYOUT
/begin RECORD_LAYOUT Lookup1D_X_WORD AXIS_PTS_X 1 SWORD INDEX_INCR DIRECT /end RECORD_LAYOUT
/begin RECORD_LAYOUT Lookup1D_ULONG FNC_VALUES 1 ULONG COLUMN_DIR DIRECT /end RECORD_LAYOUT
/begin RECORD_LAYOUT Lookup1D_X_ULONG AXIS_PTS_X 1 ULONG INDEX_INCR DIRECT /end RECORD_LAYOUT
/begin RECORD_LAYOUT Lookup1D_SLONG FNC_VALUES 1 SLONG COLUMN_DIR DIRECT /end RECORD_LAYOUT
/begin RECORD_LAYOUT Lookup1D_X_LONG AXIS_PTS_X 1 SLONG INDEX_INCR DIRECT /end RECORD_LAYOUT
/begin RECORD_LAYOUT Lookup1D_FLOAT64_IEEE FNC_VALUES 1 FLOAT64_IEEE COLUMN_DIR DIRECT /end RECORD_LAYOUT
/begin RECORD_LAYOUT Lookup1D_X_FLOAT64_IEEE AXIS_PTS_X 1 FLOAT64_IEEE INDEX_INCR DIRECT /end RECORD_LAYOUT
/begin RECORD_LAYOUT Lookup2D_BOOLEAN FNC_VALUES 1 UBYTE COLUMN_DIR DIRECT /end RECORD_LAYOUT
/begin RECORD_LAYOUT Lookup2D_X_BOOLEAN AXIS_PTS_X 1 UBYTE INDEX_INCR DIRECT /end RECORD_LAYOUT
/begin RECORD_LAYOUT Lookup2D_UBYTE FNC_VALUES 1 UBYTE COLUMN_DIR DIRECT /end RECORD_LAYOUT
/begin RECORD_LAYOUT Lookup2D_X_UBYTE AXIS_PTS_X 1 UBYTE INDEX_INCR DIRECT /end RECORD_LAYOUT
/begin RECORD_LAYOUT Lookup2D_BYTE FNC_VALUES 1 SBYTE COLUMN_DIR DIRECT /end RECORD_LAYOUT
/begin RECORD_LAYOUT Lookup2D_X_BYTE AXIS_PTS_X 1 SBYTE INDEX_INCR DIRECT /end RECORD_LAYOUT
/begin RECORD_LAYOUT Lookup2D_UWORD FNC_VALUES 1 UWORD COLUMN_DIR DIRECT /end RECORD_LAYOUT
/begin RECORD_LAYOUT Lookup2D_X_UWORD AXIS_PTS_X 1 UWORD INDEX_INCR DIRECT /end RECORD_LAYOUT
/begin RECORD_LAYOUT Lookup2D_WORD FNC_VALUES 1 SWORD COLUMN_DIR DIRECT /end RECORD_LAYOUT
/begin RECORD_LAYOUT Lookup2D_X_WORD AXIS_PTS_X 1 SWORD INDEX_INCR DIRECT /end RECORD_LAYOUT
/begin RECORD_LAYOUT Lookup2D_ULONG FNC_VALUES 1 ULONG COLUMN_DIR DIRECT /end RECORD_LAYOUT
/begin RECORD_LAYOUT Lookup2D_X_ULONG AXIS_PTS_X 1 ULONG INDEX_INCR DIRECT /end RECORD_LAYOUT
/begin RECORD_LAYOUT Lookup2D_LONG FNC_VALUES 1 SLONG COLUMN_DIR DIRECT /end RECORD_LAYOUT
/begin RECORD_LAYOUT Lookup2D_X_LONG AXIS_PTS_X 1 SLONG INDEX_INCR DIRECT /end RECORD_LAYOUT
/begin RECORD_LAYOUT Lookup2D_FLOAT32_IEEE FNC_VALUES 1 FLOAT32_IEEE COLUMN_DIR DIRECT /end RECORD_LAYOUT
/begin RECORD_LAYOUT Lookup2D_X_FLOAT32_IEEE AXIS_PTS_X 1 FLOAT32_IEEE INDEX_INCR DIRECT /end RECORD_LAYOUT
/begin RECORD_LAYOUT Lookup2D_FLOAT64_IEEE FNC_VALUES 1 FLOAT64_IEEE COLUMN_DIR DIRECT /end RECORD_LAYOUT
/begin RECORD_LAYOUT Lookup2D_X_FLOAT64_IEEE AXIS_PTS_X 1 FLOAT64_IEEE INDEX_INCR DIRECT /end RECORD_LAYOUT
/begin CHARACTERISTIC KDDM_ACCAccelCmdErrDetTO_s "" VALUE 0x0000 /* @ECU_Address@KDDM_ACCAccelCmdErrDetTO_s@ */ Scalar_FLOAT32_IEEE 0 SWC_DDM_type_CM_single_sec 0.0 10.0 /end CHARACTERISTIC
/begin CHARACTERISTIC KDDM_ACCAccelCmdErrDet_mps2 "" VALUE 0x0000 /* @ECU_Address@KDDM_ACCAccelCmdErrDet_mps2@ */ Scalar_FLOAT32_IEEE 0 SWC_DDM_type_CM_single_mps2 0.0 10.0 /end CHARACTERISTIC
/begin CHARACTERISTIC KDDM_ACCAccelCmdErrPassTO_s "" VALUE 0x0000 /* @ECU_Address@KDDM_ACCAccelCmdErrPassTO_s@ */ Scalar_FLOAT32_IEEE 0 SWC_DDM_type_CM_single_sec 0.0 10.0 /end CHARACTERISTIC
/begin CHARACTERISTIC KDDM_BMSRdyDetTO_s "" VALUE 0x0000 /* @ECU_Address@KDDM_BMSRdyDetTO_s@ */ Scalar_FLOAT32_IEEE 0 SWC_DDM_type_CM_single_sec 0.0 86400.0 /end CHARACTERISTIC
/begin CHARACTERISTIC KDDM_BMSRdyPassTO_s "" VALUE 0x0000 /* @ECU_Address@KDDM_BMSRdyPassTO_s@ */ Scalar_FLOAT32_IEEE 0 SWC_DDM_type_CM_single_sec 0.0 86400.0 /end CHARACTERISTIC
/begin CHARACTERISTIC KDDM_BMSSigErrDetTO_s "" VALUE 0x0000 /* @ECU_Address@KDDM_BMSSigErrDetTO_s@ */ Scalar_FLOAT32_IEEE 0 SWC_DDM_type_CM_single_sec 0.0 10.0 /end CHARACTERISTIC
/begin CHARACTERISTIC KDDM_BMSSigErrPassTO_s "" VALUE 0x0000 /* @ECU_Address@KDDM_BMSSigErrPassTO_s@ */ Scalar_FLOAT32_IEEE 0 SWC_DDM_type_CM_single_sec 0.0 10.0 /end CHARACTERISTIC
/begin CHARACTERISTIC KDDM_CCUSigErrDetTO_s "" VALUE 0x0000 /* @ECU_Address@KDDM_CCUSigErrDetTO_s@ */ Scalar_FLOAT32_IEEE 0 SWC_DDM_type_CM_single_sec 0.0 10.0 /end CHARACTERISTIC
/begin CHARACTERISTIC KDDM_CCUSigErrPassTO_s "" VALUE 0x0000 /* @ECU_Address@KDDM_CCUSigErrPassTO_s@ */ Scalar_FLOAT32_IEEE 0 SWC_DDM_type_CM_single_sec 0.0 10.0 /end CHARACTERISTIC
/begin CHARACTERISTIC KDDM_DCDC4PreDetTO_s "" VALUE 0x0000 /* @ECU_Address@KDDM_DCDC4PreDetTO_s@ */ Scalar_FLOAT32_IEEE 0 SWC_DDM_type_CM_single_sec 0.0 86400.0 /end CHARACTERISTIC
/begin CHARACTERISTIC KDDM_DCDC4PrePassTO_s "" VALUE 0x0000 /* @ECU_Address@KDDM_DCDC4PrePassTO_s@ */ Scalar_FLOAT32_IEEE 0 SWC_DDM_type_CM_single_sec 0.0 86400.0 /end CHARACTERISTIC
/begin CHARACTERISTIC KDDM_DCDCDisDetTO_s "" VALUE 0x0000 /* @ECU_Address@KDDM_DCDCDisDetTO_s@ */ Scalar_FLOAT32_IEEE 0 SWC_DDM_type_CM_single_sec 0.0 86400.0 /end CHARACTERISTIC
/begin CHARACTERISTIC KDDM_DCDCDisPassTO_s "" VALUE 0x0000 /* @ECU_Address@KDDM_DCDCDisPassTO_s@ */ Scalar_FLOAT32_IEEE 0 SWC_DDM_type_CM_single_sec 0.0 86400.0 /end CHARACTERISTIC
/begin CHARACTERISTIC KDDM_DCDCEnaDetTO_s "" VALUE 0x0000 /* @ECU_Address@KDDM_DCDCEnaDetTO_s@ */ Scalar_FLOAT32_IEEE 0 SWC_DDM_type_CM_single_sec 0.0 86400.0 /end CHARACTERISTIC
/begin CHARACTERISTIC KDDM_DCDCEnaPassTO_s "" VALUE 0x0000 /* @ECU_Address@KDDM_DCDCEnaPassTO_s@ */ Scalar_FLOAT32_IEEE 0 SWC_DDM_type_CM_single_sec 0.0 86400.0 /end CHARACTERISTIC
/begin CHARACTERISTIC KDDM_EPS1CSErrDetTO_s "" VALUE 0x0000 /* @ECU_Address@KDDM_EPS1CSErrDetTO_s@ */ Scalar_FLOAT32_IEEE 0 SWC_DDM_type_CM_single_sec 0.0 10.0 /end CHARACTERISTIC
/begin CHARACTERISTIC KDDM_EPS1CSErrPassTO_s "" VALUE 0x0000 /* @ECU_Address@KDDM_EPS1CSErrPassTO_s@ */ Scalar_FLOAT32_IEEE 0 SWC_DDM_type_CM_single_sec 0.0 10.0 /end CHARACTERISTIC
/begin CHARACTERISTIC KDDM_EPS1NoComDetTO_s "" VALUE 0x0000 /* @ECU_Address@KDDM_EPS1NoComDetTO_s@ */ Scalar_FLOAT32_IEEE 0 SWC_DDM_type_CM_single_sec 0.0 10.0 /end CHARACTERISTIC
/begin CHARACTERISTIC KDDM_EPS1NoComPassTO_s "" VALUE 0x0000 /* @ECU_Address@KDDM_EPS1NoComPassTO_s@ */ Scalar_FLOAT32_IEEE 0 SWC_DDM_type_CM_single_sec 0.0 10.0 /end CHARACTERISTIC
/begin CHARACTERISTIC KDDM_EPS1RCErrDetTO_s "" VALUE 0x0000 /* @ECU_Address@KDDM_EPS1RCErrDetTO_s@ */ Scalar_FLOAT32_IEEE 0 SWC_DDM_type_CM_single_sec 0.0 10.0 /end CHARACTERISTIC
/begin CHARACTERISTIC KDDM_EPS1RCErrPassTO_s "" VALUE 0x0000 /* @ECU_Address@KDDM_EPS1RCErrPassTO_s@ */ Scalar_FLOAT32_IEEE 0 SWC_DDM_type_CM_single_sec 0.0 10.0 /end CHARACTERISTIC
/begin CHARACTERISTIC KDDM_EPSSigErrDetTO_s "" VALUE 0x0000 /* @ECU_Address@KDDM_EPSSigErrDetTO_s@ */ Scalar_FLOAT32_IEEE 0 SWC_DDM_type_CM_single_sec 0.0 10.0 /end CHARACTERISTIC
/begin CHARACTERISTIC KDDM_EPSSigErrPassTO_s "" VALUE 0x0000 /* @ECU_Address@KDDM_EPSSigErrPassTO_s@ */ Scalar_FLOAT32_IEEE 0 SWC_DDM_type_CM_single_sec 0.0 10.0 /end CHARACTERISTIC
/begin CHARACTERISTIC KDDM_ESCSigErrDetTO_s "" VALUE 0x0000 /* @ECU_Address@KDDM_ESCSigErrDetTO_s@ */ Scalar_FLOAT32_IEEE 0 SWC_DDM_type_CM_single_sec 0.0 3600.0 /end CHARACTERISTIC
/begin CHARACTERISTIC KDDM_ESCSigErrPassTO_s "" VALUE 0x0000 /* @ECU_Address@KDDM_ESCSigErrPassTO_s@ */ Scalar_FLOAT32_IEEE 0 SWC_DDM_type_CM_single_sec 0.0 3600.0 /end CHARACTERISTIC
/begin CHARACTERISTIC KDDM_FCM1CSErrDetTO_s "" VALUE 0x0000 /* @ECU_Address@KDDM_FCM1CSErrDetTO_s@ */ Scalar_FLOAT32_IEEE 0 SWC_DDM_type_CM_single_sec 0.0 10.0 /end CHARACTERISTIC
/begin CHARACTERISTIC KDDM_FCM1CSErrPassTO_s "" VALUE 0x0000 /* @ECU_Address@KDDM_FCM1CSErrPassTO_s@ */ Scalar_FLOAT32_IEEE 0 SWC_DDM_type_CM_single_sec 0.0 10.0 /end CHARACTERISTIC
/begin CHARACTERISTIC KDDM_FCM1NoComDetTO_s "" VALUE 0x0000 /* @ECU_Address@KDDM_FCM1NoComDetTO_s@ */ Scalar_FLOAT32_IEEE 0 SWC_DDM_type_CM_single_sec 0.0 10.0 /end CHARACTERISTIC
/begin CHARACTERISTIC KDDM_FCM1NoComPassTO_s "" VALUE 0x0000 /* @ECU_Address@KDDM_FCM1NoComPassTO_s@ */ Scalar_FLOAT32_IEEE 0 SWC_DDM_type_CM_single_sec 0.0 10.0 /end CHARACTERISTIC
/begin CHARACTERISTIC KDDM_FCM1RCErrDetTO_s "" VALUE 0x0000 /* @ECU_Address@KDDM_FCM1RCErrDetTO_s@ */ Scalar_FLOAT32_IEEE 0 SWC_DDM_type_CM_single_sec 0.0 10.0 /end CHARACTERISTIC
/begin CHARACTERISTIC KDDM_FCM1RCErrPassTO_s "" VALUE 0x0000 /* @ECU_Address@KDDM_FCM1RCErrPassTO_s@ */ Scalar_FLOAT32_IEEE 0 SWC_DDM_type_CM_single_sec 0.0 10.0 /end CHARACTERISTIC
/begin CHARACTERISTIC KDDM_FCMACCSigErrDetTO_s "" VALUE 0x0000 /* @ECU_Address@KDDM_FCMACCSigErrDetTO_s@ */ Scalar_FLOAT32_IEEE 0 SWC_DDM_type_CM_single_sec 0.0 10.0 /end CHARACTERISTIC
/begin CHARACTERISTIC KDDM_FCMACCSigErrPassTO_s "" VALUE 0x0000 /* @ECU_Address@KDDM_FCMACCSigErrPassTO_s@ */ Scalar_FLOAT32_IEEE 0 SWC_DDM_type_CM_single_sec 0.0 10.0 /end CHARACTERISTIC
/begin CHARACTERISTIC KDDM_FrMCUSigErrDetTO_s "" VALUE 0x0000 /* @ECU_Address@KDDM_FrMCUSigErrDetTO_s@ */ Scalar_FLOAT32_IEEE 0 SWC_DDM_type_CM_single_sec 0.0 10.0 /end CHARACTERISTIC
/begin CHARACTERISTIC KDDM_FrMCUSigErrPassTO_s "" VALUE 0x0000 /* @ECU_Address@KDDM_FrMCUSigErrPassTO_s@ */ Scalar_FLOAT32_IEEE 0 SWC_DDM_type_CM_single_sec 0.0 10.0 /end CHARACTERISTIC
/begin CHARACTERISTIC KDDM_HVB4PreDetTO_s "" VALUE 0x0000 /* @ECU_Address@KDDM_HVB4PreDetTO_s@ */ Scalar_FLOAT32_IEEE 0 SWC_DDM_type_CM_single_sec 0.0 86400.0 /end CHARACTERISTIC
/begin CHARACTERISTIC KDDM_HVB4PrePassTO_s "" VALUE 0x0000 /* @ECU_Address@KDDM_HVB4PrePassTO_s@ */ Scalar_FLOAT32_IEEE 0 SWC_DDM_type_CM_single_sec 0.0 86400.0 /end CHARACTERISTIC
/begin CHARACTERISTIC KDDM_HVRlyCloDetTO_s "" VALUE 0x0000 /* @ECU_Address@KDDM_HVRlyCloDetTO_s@ */ Scalar_FLOAT32_IEEE 0 SWC_DDM_type_CM_single_sec 0.0 86400.0 /end CHARACTERISTIC
/begin CHARACTERISTIC KDDM_HVRlyCloPassTO_s "" VALUE 0x0000 /* @ECU_Address@KDDM_HVRlyCloPassTO_s@ */ Scalar_FLOAT32_IEEE 0 SWC_DDM_type_CM_single_sec 0.0 86400.0 /end CHARACTERISTIC
/begin CHARACTERISTIC KDDM_HVRlyOpDetTO_s "" VALUE 0x0000 /* @ECU_Address@KDDM_HVRlyOpDetTO_s@ */ Scalar_FLOAT32_IEEE 0 SWC_DDM_type_CM_single_sec 0.0 86400.0 /end CHARACTERISTIC
/begin CHARACTERISTIC KDDM_HVRlyOpPassTO_s "" VALUE 0x0000 /* @ECU_Address@KDDM_HVRlyOpPassTO_s@ */ Scalar_FLOAT32_IEEE 0 SWC_DDM_type_CM_single_sec 0.0 86400.0 /end CHARACTERISTIC
/begin CHARACTERISTIC KDDM_HiLvSaChkDetTO_s "" VALUE 0x0000 /* @ECU_Address@KDDM_HiLvSaChkDetTO_s@ */ Scalar_FLOAT32_IEEE 0 SWC_DDM_type_CM_single_sec 0.0 86400.0 /end CHARACTERISTIC
/begin CHARACTERISTIC KDDM_HiLvSaChkPassTO_s "" VALUE 0x0000 /* @ECU_Address@KDDM_HiLvSaChkPassTO_s@ */ Scalar_FLOAT32_IEEE 0 SWC_DDM_type_CM_single_sec 0.0 86400.0 /end CHARACTERISTIC
/begin CHARACTERISTIC KDDM_MCU4PreDetTO_s "" VALUE 0x0000 /* @ECU_Address@KDDM_MCU4PreDetTO_s@ */ Scalar_FLOAT32_IEEE 0 SWC_DDM_type_CM_single_sec 0.0 86400.0 /end CHARACTERISTIC
/begin CHARACTERISTIC KDDM_MCU4PrePassTO_s "" VALUE 0x0000 /* @ECU_Address@KDDM_MCU4PrePassTO_s@ */ Scalar_FLOAT32_IEEE 0 SWC_DDM_type_CM_single_sec 0.0 86400.0 /end CHARACTERISTIC
/begin CHARACTERISTIC KDDM_MCUActDetTO_s "" VALUE 0x0000 /* @ECU_Address@KDDM_MCUActDetTO_s@ */ Scalar_FLOAT32_IEEE 0 SWC_DDM_type_CM_single_sec 0.0 86400.0 /end CHARACTERISTIC
/begin CHARACTERISTIC KDDM_MCUActPassTO_s "" VALUE 0x0000 /* @ECU_Address@KDDM_MCUActPassTO_s@ */ Scalar_FLOAT32_IEEE 0 SWC_DDM_type_CM_single_sec 0.0 86400.0 /end CHARACTERISTIC
/begin CHARACTERISTIC KDDM_MCUDisDetTO_s "" VALUE 0x0000 /* @ECU_Address@KDDM_MCUDisDetTO_s@ */ Scalar_FLOAT32_IEEE 0 SWC_DDM_type_CM_single_sec 0.0 86400.0 /end CHARACTERISTIC
/begin CHARACTERISTIC KDDM_MCUDisPassTO_s "" VALUE 0x0000 /* @ECU_Address@KDDM_MCUDisPassTO_s@ */ Scalar_FLOAT32_IEEE 0 SWC_DDM_type_CM_single_sec 0.0 86400.0 /end CHARACTERISTIC
/begin CHARACTERISTIC KDDM_MCUDischrgVolt_V "" VALUE 0x0000 /* @ECU_Address@KDDM_MCUDischrgVolt_V@ */ Scalar_FLOAT32_IEEE 0 SWC_DDM_type_CM_single_V 0.0 60.0 /end CHARACTERISTIC
/begin CHARACTERISTIC KDDM_MidLvSaChkDetTO_s "" VALUE 0x0000 /* @ECU_Address@KDDM_MidLvSaChkDetTO_s@ */ Scalar_FLOAT32_IEEE 0 SWC_DDM_type_CM_single_sec 0.0 86400.0 /end CHARACTERISTIC
/begin CHARACTERISTIC KDDM_MidLvSaChkPassTO_s "" VALUE 0x0000 /* @ECU_Address@KDDM_MidLvSaChkPassTO_s@ */ Scalar_FLOAT32_IEEE 0 SWC_DDM_type_CM_single_sec 0.0 86400.0 /end CHARACTERISTIC
/begin CHARACTERISTIC KDDM_OBC4PreDetTO_s "" VALUE 0x0000 /* @ECU_Address@KDDM_OBC4PreDetTO_s@ */ Scalar_FLOAT32_IEEE 0 SWC_DDM_type_CM_single_sec 0.0 86400.0 /end CHARACTERISTIC
/begin CHARACTERISTIC KDDM_OBC4PrePassTO_s "" VALUE 0x0000 /* @ECU_Address@KDDM_OBC4PrePassTO_s@ */ Scalar_FLOAT32_IEEE 0 SWC_DDM_type_CM_single_sec 0.0 86400.0 /end CHARACTERISTIC
/begin CHARACTERISTIC KDDM_RrMCUSigErrDetTO_s "" VALUE 0x0000 /* @ECU_Address@KDDM_RrMCUSigErrDetTO_s@ */ Scalar_FLOAT32_IEEE 0 SWC_DDM_type_CM_single_sec 0.0 10.0 /end CHARACTERISTIC
/begin CHARACTERISTIC KDDM_RrMCUSigErrPassTO_s "" VALUE 0x0000 /* @ECU_Address@KDDM_RrMCUSigErrPassTO_s@ */ Scalar_FLOAT32_IEEE 0 SWC_DDM_type_CM_single_sec 0.0 10.0 /end CHARACTERISTIC
/begin CHARACTERISTIC KDDM_ShifterSigErrDetTO_s "" VALUE 0x0000 /* @ECU_Address@KDDM_ShifterSigErrDetTO_s@ */ Scalar_FLOAT32_IEEE 0 SWC_DDM_type_CM_single_sec 0.0 10.0 /end CHARACTERISTIC
/begin CHARACTERISTIC KDDM_ShifterSigErrPassTO_s "" VALUE 0x0000 /* @ECU_Address@KDDM_ShifterSigErrPassTO_s@ */ Scalar_FLOAT32_IEEE 0 SWC_DDM_type_CM_single_sec 0.0 10.0 /end CHARACTERISTIC
/begin CHARACTERISTIC KDDM_ZoneDrSigErrDetTO_s "" VALUE 0x0000 /* @ECU_Address@KDDM_ZoneDrSigErrDetTO_s@ */ Scalar_FLOAT32_IEEE 0 SWC_DDM_type_CM_single_sec 0.0 10.0 /end CHARACTERISTIC
/begin CHARACTERISTIC KDDM_ZoneDrSigErrPassTO_s "" VALUE 0x0000 /* @ECU_Address@KDDM_ZoneDrSigErrPassTO_s@ */ Scalar_FLOAT32_IEEE 0 SWC_DDM_type_CM_single_sec 0.0 10.0 /end CHARACTERISTIC
/begin CHARACTERISTIC KDDM_ZoneFrSigErrDetTO_s "" VALUE 0x0000 /* @ECU_Address@KDDM_ZoneFrSigErrDetTO_s@ */ Scalar_FLOAT32_IEEE 0 SWC_DDM_type_CM_single_sec 0.0 10.0 /end CHARACTERISTIC
/begin CHARACTERISTIC KDDM_ZoneFrSigErrPassTO_s "" VALUE 0x0000 /* @ECU_Address@KDDM_ZoneFrSigErrPassTO_s@ */ Scalar_FLOAT32_IEEE 0 SWC_DDM_type_CM_single_sec 0.0 10.0 /end CHARACTERISTIC
/begin CHARACTERISTIC KDDM_PwrUpDnDiagnosisOffSW_flg "" VALUE 0x0000 /* @ECU_Address@KDDM_PwrUpDnDiagnosisOffSW_flg@ */ Scalar_BOOLEAN 0 SWC_DDM_type_CM_boolean_flg 0.0 1.0 /end CHARACTERISTIC
/begin CHARACTERISTIC KDDM_ACCAccelCmdErrDTC_cnt "" VALUE 0x0000 /* @ECU_Address@KDDM_ACCAccelCmdErrDTC_cnt@ */ Scalar_UBYTE 0 SWC_DDM_type_CM_uint8_cnt 0.0 100.0 /end CHARACTERISTIC
/begin CHARACTERISTIC KDDM_BMSRdyDTC_cnt "" VALUE 0x0000 /* @ECU_Address@KDDM_BMSRdyDTC_cnt@ */ Scalar_UBYTE 0 SWC_DDM_type_CM_uint8_cnt 0.0 255.0 /end CHARACTERISTIC
/begin CHARACTERISTIC KDDM_BMSSigErrDTC_cnt "" VALUE 0x0000 /* @ECU_Address@KDDM_BMSSigErrDTC_cnt@ */ Scalar_UBYTE 0 SWC_DDM_type_CM_uint8_cnt 0.0 100.0 /end CHARACTERISTIC
/begin CHARACTERISTIC KDDM_CCUSigErrDTC_cnt "" VALUE 0x0000 /* @ECU_Address@KDDM_CCUSigErrDTC_cnt@ */ Scalar_UBYTE 0 SWC_DDM_type_CM_uint8_cnt 0.0 100.0 /end CHARACTERISTIC
/begin CHARACTERISTIC KDDM_DCDC4PreDTC_cnt "" VALUE 0x0000 /* @ECU_Address@KDDM_DCDC4PreDTC_cnt@ */ Scalar_UBYTE 0 SWC_DDM_type_CM_uint8_cnt 0.0 255.0 /end CHARACTERISTIC
/begin CHARACTERISTIC KDDM_DCDCDisDTC_cnt "" VALUE 0x0000 /* @ECU_Address@KDDM_DCDCDisDTC_cnt@ */ Scalar_UBYTE 0 SWC_DDM_type_CM_uint8_cnt 0.0 255.0 /end CHARACTERISTIC
/begin CHARACTERISTIC KDDM_DCDCEnaDTC_cnt "" VALUE 0x0000 /* @ECU_Address@KDDM_DCDCEnaDTC_cnt@ */ Scalar_UBYTE 0 SWC_DDM_type_CM_uint8_cnt 0.0 255.0 /end CHARACTERISTIC
/begin CHARACTERISTIC KDDM_EPS1CSErrDTC_cnt "" VALUE 0x0000 /* @ECU_Address@KDDM_EPS1CSErrDTC_cnt@ */ Scalar_UBYTE 0 SWC_DDM_type_CM_uint8_cnt 0.0 100.0 /end CHARACTERISTIC
/begin CHARACTERISTIC KDDM_EPS1NoComDTC_cnt "" VALUE 0x0000 /* @ECU_Address@KDDM_EPS1NoComDTC_cnt@ */ Scalar_UBYTE 0 SWC_DDM_type_CM_uint8_cnt 0.0 100.0 /end CHARACTERISTIC
/begin CHARACTERISTIC KDDM_EPS1RCErrDTC_cnt "" VALUE 0x0000 /* @ECU_Address@KDDM_EPS1RCErrDTC_cnt@ */ Scalar_UBYTE 0 SWC_DDM_type_CM_uint8_cnt 0.0 100.0 /end CHARACTERISTIC
/begin CHARACTERISTIC KDDM_EPSSigErrDTC_cnt "" VALUE 0x0000 /* @ECU_Address@KDDM_EPSSigErrDTC_cnt@ */ Scalar_UBYTE 0 SWC_DDM_type_CM_uint8_cnt 0.0 100.0 /end CHARACTERISTIC
/begin CHARACTERISTIC KDDM_ESCSigErrDTC_cnt "" VALUE 0x0000 /* @ECU_Address@KDDM_ESCSigErrDTC_cnt@ */ Scalar_UBYTE 0 SWC_DDM_type_CM_uint8_cnt 0.0 100.0 /end CHARACTERISTIC
/begin CHARACTERISTIC KDDM_FCM1CSErrDTC_cnt "" VALUE 0x0000 /* @ECU_Address@KDDM_FCM1CSErrDTC_cnt@ */ Scalar_UBYTE 0 SWC_DDM_type_CM_uint8_cnt 0.0 100.0 /end CHARACTERISTIC
/begin CHARACTERISTIC KDDM_FCM1NoComDTC_cnt "" VALUE 0x0000 /* @ECU_Address@KDDM_FCM1NoComDTC_cnt@ */ Scalar_UBYTE 0 SWC_DDM_type_CM_uint8_cnt 0.0 100.0 /end CHARACTERISTIC
/begin CHARACTERISTIC KDDM_FCM1RCErrDTC_cnt "" VALUE 0x0000 /* @ECU_Address@KDDM_FCM1RCErrDTC_cnt@ */ Scalar_UBYTE 0 SWC_DDM_type_CM_uint8_cnt 0.0 100.0 /end CHARACTERISTIC
/begin CHARACTERISTIC KDDM_FCMACCSigErrDTC_cnt "" VALUE 0x0000 /* @ECU_Address@KDDM_FCMACCSigErrDTC_cnt@ */ Scalar_UBYTE 0 SWC_DDM_type_CM_uint8_cnt 0.0 100.0 /end CHARACTERISTIC
/begin CHARACTERISTIC KDDM_FrMCUSigErrDTC_cnt "" VALUE 0x0000 /* @ECU_Address@KDDM_FrMCUSigErrDTC_cnt@ */ Scalar_UBYTE 0 SWC_DDM_type_CM_uint8_cnt 0.0 100.0 /end CHARACTERISTIC
/begin CHARACTERISTIC KDDM_HVB4PreDTC_cnt "" VALUE 0x0000 /* @ECU_Address@KDDM_HVB4PreDTC_cnt@ */ Scalar_UBYTE 0 SWC_DDM_type_CM_uint8_cnt 0.0 255.0 /end CHARACTERISTIC
/begin CHARACTERISTIC KDDM_HVRlyCloDTC_cnt "" VALUE 0x0000 /* @ECU_Address@KDDM_HVRlyCloDTC_cnt@ */ Scalar_UBYTE 0 SWC_DDM_type_CM_uint8_cnt 0.0 255.0 /end CHARACTERISTIC
/begin CHARACTERISTIC KDDM_HVRlyOpDTC_cnt "" VALUE 0x0000 /* @ECU_Address@KDDM_HVRlyOpDTC_cnt@ */ Scalar_UBYTE 0 SWC_DDM_type_CM_uint8_cnt 0.0 255.0 /end CHARACTERISTIC
/begin CHARACTERISTIC KDDM_HiLvSaChkDTC_cnt "" VALUE 0x0000 /* @ECU_Address@KDDM_HiLvSaChkDTC_cnt@ */ Scalar_UBYTE 0 SWC_DDM_type_CM_uint8_cnt 0.0 255.0 /end CHARACTERISTIC
/begin CHARACTERISTIC KDDM_MCU4PreDTC_cnt "" VALUE 0x0000 /* @ECU_Address@KDDM_MCU4PreDTC_cnt@ */ Scalar_UBYTE 0 SWC_DDM_type_CM_uint8_cnt 0.0 255.0 /end CHARACTERISTIC
/begin CHARACTERISTIC KDDM_MCUActDTC_cnt "" VALUE 0x0000 /* @ECU_Address@KDDM_MCUActDTC_cnt@ */ Scalar_UBYTE 0 SWC_DDM_type_CM_uint8_cnt 0.0 255.0 /end CHARACTERISTIC
/begin CHARACTERISTIC KDDM_MCUDisDTC_cnt "" VALUE 0x0000 /* @ECU_Address@KDDM_MCUDisDTC_cnt@ */ Scalar_UBYTE 0 SWC_DDM_type_CM_uint8_cnt 0.0 255.0 /end CHARACTERISTIC
/begin CHARACTERISTIC KDDM_MidLvSaChkDTC_cnt "" VALUE 0x0000 /* @ECU_Address@KDDM_MidLvSaChkDTC_cnt@ */ Scalar_UBYTE 0 SWC_DDM_type_CM_uint8_cnt 0.0 255.0 /end CHARACTERISTIC
/begin CHARACTERISTIC KDDM_OBC4PreDTC_cnt "" VALUE 0x0000 /* @ECU_Address@KDDM_OBC4PreDTC_cnt@ */ Scalar_UBYTE 0 SWC_DDM_type_CM_uint8_cnt 0.0 255.0 /end CHARACTERISTIC
/begin CHARACTERISTIC KDDM_RrMCUSigErrDTC_cnt "" VALUE 0x0000 /* @ECU_Address@KDDM_RrMCUSigErrDTC_cnt@ */ Scalar_UBYTE 0 SWC_DDM_type_CM_uint8_cnt 0.0 100.0 /end CHARACTERISTIC
/begin CHARACTERISTIC KDDM_ShifterSigErrDTC_cnt "" VALUE 0x0000 /* @ECU_Address@KDDM_ShifterSigErrDTC_cnt@ */ Scalar_UBYTE 0 SWC_DDM_type_CM_uint8_cnt 0.0 100.0 /end CHARACTERISTIC
/begin CHARACTERISTIC KDDM_ZoneDrSigErrDTC_cnt "" VALUE 0x0000 /* @ECU_Address@KDDM_ZoneDrSigErrDTC_cnt@ */ Scalar_UBYTE 0 SWC_DDM_type_CM_uint8_cnt 0.0 100.0 /end CHARACTERISTIC
/begin CHARACTERISTIC KDDM_ZoneFrSigErrDTC_cnt "" VALUE 0x0000 /* @ECU_Address@KDDM_ZoneFrSigErrDTC_cnt@ */ Scalar_UBYTE 0 SWC_DDM_type_CM_uint8_cnt 0.0 100.0 /end CHARACTERISTIC
/begin MEASUREMENT VDDM_FCMACCSigErrDetDTC_raw32 "" ULONG SWC_DDM_type_CM_uint32_raw32 0 0 0.0 4.294967295E+9 ECU_ADDRESS 0x0000 /* @ECU_Address@VDDM_FCMACCSigErrDetDTC_raw32@ */ /end MEASUREMENT
/begin MEASUREMENT VDDM_C3BMS6LCDTC_cnt "" UBYTE SWC_DDM_type_CM_uint8_cnt 0 0 0.0 255.0 ECU_ADDRESS 0x0000 /* @ECU_Address@VDDM_C3BMS6LCDTC_cnt@ */ /end MEASUREMENT
/begin MEASUREMENT VDDM_C3BMS6RCDTC_cnt "" UBYTE SWC_DDM_type_CM_uint8_cnt 0 0 0.0 255.0 ECU_ADDRESS 0x0000 /* @ECU_Address@VDDM_C3BMS6RCDTC_cnt@ */ /end MEASUREMENT
/begin MEASUREMENT VDDM_C3BMS6CSDTC_cnt "" UBYTE SWC_DDM_type_CM_uint8_cnt 0 0 0.0 255.0 ECU_ADDRESS 0x0000 /* @ECU_Address@VDDM_C3BMS6CSDTC_cnt@ */ /end MEASUREMENT
/begin MEASUREMENT VDDM_C3BMS1LCDTC_cnt "" UBYTE SWC_DDM_type_CM_uint8_cnt 0 0 0.0 255.0 ECU_ADDRESS 0x0000 /* @ECU_Address@VDDM_C3BMS1LCDTC_cnt@ */ /end MEASUREMENT
/begin MEASUREMENT VDDM_C3BMS1RCDTC_cnt "" UBYTE SWC_DDM_type_CM_uint8_cnt 0 0 0.0 255.0 ECU_ADDRESS 0x0000 /* @ECU_Address@VDDM_C3BMS1RCDTC_cnt@ */ /end MEASUREMENT
/begin MEASUREMENT VDDM_C3BMS1CSDTC_cnt "" UBYTE SWC_DDM_type_CM_uint8_cnt 0 0 0.0 255.0 ECU_ADDRESS 0x0000 /* @ECU_Address@VDDM_C3BMS1CSDTC_cnt@ */ /end MEASUREMENT
/begin MEASUREMENT VDDM_C3CCU1LCDTC_cnt "" UBYTE SWC_DDM_type_CM_uint8_cnt 0 0 0.0 255.0 ECU_ADDRESS 0x0000 /* @ECU_Address@VDDM_C3CCU1LCDTC_cnt@ */ /end MEASUREMENT
/begin MEASUREMENT VDDM_C3CCU1RCDTC_cnt "" UBYTE SWC_DDM_type_CM_uint8_cnt 0 0 0.0 255.0 ECU_ADDRESS 0x0000 /* @ECU_Address@VDDM_C3CCU1RCDTC_cnt@ */ /end MEASUREMENT
/begin MEASUREMENT VDDM_C3CCU1CSDTC_cnt "" UBYTE SWC_DDM_type_CM_uint8_cnt 0 0 0.0 255.0 ECU_ADDRESS 0x0000 /* @ECU_Address@VDDM_C3CCU1CSDTC_cnt@ */ /end MEASUREMENT
/begin MEASUREMENT VDDM_C3CCU2LCDTC_cnt "" UBYTE SWC_DDM_type_CM_uint8_cnt 0 0 0.0 255.0 ECU_ADDRESS 0x0000 /* @ECU_Address@VDDM_C3CCU2LCDTC_cnt@ */ /end MEASUREMENT
/begin MEASUREMENT VDDM_C3CCU2RCDTC_cnt "" UBYTE SWC_DDM_type_CM_uint8_cnt 0 0 0.0 255.0 ECU_ADDRESS 0x0000 /* @ECU_Address@VDDM_C3CCU2RCDTC_cnt@ */ /end MEASUREMENT
/begin MEASUREMENT VDDM_C3CCU2CSDTC_cnt "" UBYTE SWC_DDM_type_CM_uint8_cnt 0 0 0.0 255.0 ECU_ADDRESS 0x0000 /* @ECU_Address@VDDM_C3CCU2CSDTC_cnt@ */ /end MEASUREMENT
/begin MEASUREMENT VDDM_C1ABM1LCDTC_cnt "" UBYTE SWC_DDM_type_CM_uint8_cnt 0 0 0.0 255.0 ECU_ADDRESS 0x0000 /* @ECU_Address@VDDM_C1ABM1LCDTC_cnt@ */ /end MEASUREMENT
/begin MEASUREMENT VDDM_C1ABM1RCDTC_cnt "" UBYTE SWC_DDM_type_CM_uint8_cnt 0 0 0.0 255.0 ECU_ADDRESS 0x0000 /* @ECU_Address@VDDM_C1ABM1RCDTC_cnt@ */ /end MEASUREMENT
/begin MEASUREMENT VDDM_C1ABM1CSDTC_cnt "" UBYTE SWC_DDM_type_CM_uint8_cnt 0 0 0.0 255.0 ECU_ADDRESS 0x0000 /* @ECU_Address@VDDM_C1ABM1CSDTC_cnt@ */ /end MEASUREMENT
/begin MEASUREMENT VDDM_MCUNR1NoComDTC_cnt "" UBYTE SWC_DDM_type_CM_uint8_cnt 0 0 0.0 255.0 ECU_ADDRESS 0x0000 /* @ECU_Address@VDDM_MCUNR1NoComDTC_cnt@ */ /end MEASUREMENT
/begin MEASUREMENT VDDM_MCUNR1RCErrDTC_cnt "" UBYTE SWC_DDM_type_CM_uint8_cnt 0 0 0.0 255.0 ECU_ADDRESS 0x0000 /* @ECU_Address@VDDM_MCUNR1RCErrDTC_cnt@ */ /end MEASUREMENT
/begin MEASUREMENT VDDM_MCUNR1CSErrDTC_cnt "" UBYTE SWC_DDM_type_CM_uint8_cnt 0 0 0.0 255.0 ECU_ADDRESS 0x0000 /* @ECU_Address@VDDM_MCUNR1CSErrDTC_cnt@ */ /end MEASUREMENT
/begin MEASUREMENT VDDM_MCUNF1NoComDTC_cnt "" UBYTE SWC_DDM_type_CM_uint8_cnt 0 0 0.0 255.0 ECU_ADDRESS 0x0000 /* @ECU_Address@VDDM_MCUNF1NoComDTC_cnt@ */ /end MEASUREMENT
/begin MEASUREMENT VDDM_MCUNF1RCErrDTC_cnt "" UBYTE SWC_DDM_type_CM_uint8_cnt 0 0 0.0 255.0 ECU_ADDRESS 0x0000 /* @ECU_Address@VDDM_MCUNF1RCErrDTC_cnt@ */ /end MEASUREMENT
/begin MEASUREMENT VDDM_MCUNF1CSErrDTC_cnt "" UBYTE SWC_DDM_type_CM_uint8_cnt 0 0 0.0 255.0 ECU_ADDRESS 0x0000 /* @ECU_Address@VDDM_MCUNF1CSErrDTC_cnt@ */ /end MEASUREMENT
/begin MEASUREMENT VDDM_ESC1NoComDTC_cnt "" UBYTE SWC_DDM_type_CM_uint8_cnt 0 0 0.0 255.0 ECU_ADDRESS 0x0000 /* @ECU_Address@VDDM_ESC1NoComDTC_cnt@ */ /end MEASUREMENT
/begin MEASUREMENT VDDM_ESC1RCErrDTC_cnt "" UBYTE SWC_DDM_type_CM_uint8_cnt 0 0 0.0 255.0 ECU_ADDRESS 0x0000 /* @ECU_Address@VDDM_ESC1RCErrDTC_cnt@ */ /end MEASUREMENT
/begin MEASUREMENT VDDM_ESC1CSErrDTC_cnt "" UBYTE SWC_DDM_type_CM_uint8_cnt 0 0 0.0 255.0 ECU_ADDRESS 0x0000 /* @ECU_Address@VDDM_ESC1CSErrDTC_cnt@ */ /end MEASUREMENT
/begin MEASUREMENT VDDM_ESC5NoComDTC_cnt "" UBYTE SWC_DDM_type_CM_uint8_cnt 0 0 0.0 255.0 ECU_ADDRESS 0x0000 /* @ECU_Address@VDDM_ESC5NoComDTC_cnt@ */ /end MEASUREMENT
/begin MEASUREMENT VDDM_ESC5RCErrDTC_cnt "" UBYTE SWC_DDM_type_CM_uint8_cnt 0 0 0.0 255.0 ECU_ADDRESS 0x0000 /* @ECU_Address@VDDM_ESC5RCErrDTC_cnt@ */ /end MEASUREMENT
/begin MEASUREMENT VDDM_ESC5CSErrDTC_cnt "" UBYTE SWC_DDM_type_CM_uint8_cnt 0 0 0.0 255.0 ECU_ADDRESS 0x0000 /* @ECU_Address@VDDM_ESC5CSErrDTC_cnt@ */ /end MEASUREMENT
/begin MEASUREMENT VDDM_Shifter1NoComDTC_cnt "" UBYTE SWC_DDM_type_CM_uint8_cnt 0 0 0.0 255.0 ECU_ADDRESS 0x0000 /* @ECU_Address@VDDM_Shifter1NoComDTC_cnt@ */ /end MEASUREMENT
/begin MEASUREMENT VDDM_Shifter1RCErrDTC_cnt "" UBYTE SWC_DDM_type_CM_uint8_cnt 0 0 0.0 255.0 ECU_ADDRESS 0x0000 /* @ECU_Address@VDDM_Shifter1RCErrDTC_cnt@ */ /end MEASUREMENT
/begin MEASUREMENT VDDM_Shifter1CSErrDTC_cnt "" UBYTE SWC_DDM_type_CM_uint8_cnt 0 0 0.0 255.0 ECU_ADDRESS 0x0000 /* @ECU_Address@VDDM_Shifter1CSErrDTC_cnt@ */ /end MEASUREMENT
/begin MEASUREMENT VDDM_DrVCUNoComDTC_cnt "" UBYTE SWC_DDM_type_CM_uint8_cnt 0 0 0.0 255.0 ECU_ADDRESS 0x0000 /* @ECU_Address@VDDM_DrVCUNoComDTC_cnt@ */ /end MEASUREMENT
/begin MEASUREMENT VDDM_FrVCUNoComDTC_cnt "" UBYTE SWC_DDM_type_CM_uint8_cnt 0 0 0.0 255.0 ECU_ADDRESS 0x0000 /* @ECU_Address@VDDM_FrVCUNoComDTC_cnt@ */ /end MEASUREMENT
/begin MEASUREMENT VDDM_Lv1ErrDTC_cnt "" UBYTE SWC_DDM_type_CM_uint8_cnt 0 0 0.0 255.0 ECU_ADDRESS 0x0000 /* @ECU_Address@VDDM_Lv1ErrDTC_cnt@ */ /end MEASUREMENT
/begin MEASUREMENT VDDM_Lv2ErrDTC_cnt "" UBYTE SWC_DDM_type_CM_uint8_cnt 0 0 0.0 255.0 ECU_ADDRESS 0x0000 /* @ECU_Address@VDDM_Lv2ErrDTC_cnt@ */ /end MEASUREMENT
/begin MEASUREMENT VDDM_Lv3ErrDTC_cnt "" UBYTE SWC_DDM_type_CM_uint8_cnt 0 0 0.0 255.0 ECU_ADDRESS 0x0000 /* @ECU_Address@VDDM_Lv3ErrDTC_cnt@ */ /end MEASUREMENT
/begin MEASUREMENT VDDM_Lv4ErrDTC_cnt "" UBYTE SWC_DDM_type_CM_uint8_cnt 0 0 0.0 255.0 ECU_ADDRESS 0x0000 /* @ECU_Address@VDDM_Lv4ErrDTC_cnt@ */ /end MEASUREMENT
/begin MEASUREMENT VDDM_BrkSWErrDTC_cnt "" UBYTE SWC_DDM_type_CM_uint8_cnt 0 0 0.0 255.0 ECU_ADDRESS 0x0000 /* @ECU_Address@VDDM_BrkSWErrDTC_cnt@ */ /end MEASUREMENT
/begin MEASUREMENT VDDM_BrkSWNoBacDTC_cnt "" UBYTE SWC_DDM_type_CM_uint8_cnt 0 0 0.0 255.0 ECU_ADDRESS 0x0000 /* @ECU_Address@VDDM_BrkSWNoBacDTC_cnt@ */ /end MEASUREMENT
/begin MEASUREMENT VDDM_FLDoorSWDTC_cnt "" UBYTE SWC_DDM_type_CM_uint8_cnt 0 0 0.0 255.0 ECU_ADDRESS 0x0000 /* @ECU_Address@VDDM_FLDoorSWDTC_cnt@ */ /end MEASUREMENT
/begin MEASUREMENT VDDM_RLDoorSWDTC_cnt "" UBYTE SWC_DDM_type_CM_uint8_cnt 0 0 0.0 255.0 ECU_ADDRESS 0x0000 /* @ECU_Address@VDDM_RLDoorSWDTC_cnt@ */ /end MEASUREMENT
/begin MEASUREMENT VDDM_FRDoorSWDTC_cnt "" UBYTE SWC_DDM_type_CM_uint8_cnt 0 0 0.0 255.0 ECU_ADDRESS 0x0000 /* @ECU_Address@VDDM_FRDoorSWDTC_cnt@ */ /end MEASUREMENT
/begin MEASUREMENT VDDM_RRDoorSWDTC_cnt "" UBYTE SWC_DDM_type_CM_uint8_cnt 0 0 0.0 255.0 ECU_ADDRESS 0x0000 /* @ECU_Address@VDDM_RRDoorSWDTC_cnt@ */ /end MEASUREMENT
/begin MEASUREMENT VDDM_HoodSWDTC_cnt "" UBYTE SWC_DDM_type_CM_uint8_cnt 0 0 0.0 255.0 ECU_ADDRESS 0x0000 /* @ECU_Address@VDDM_HoodSWDTC_cnt@ */ /end MEASUREMENT
/begin MEASUREMENT VDDM_TailgaSWDTC_cnt "" UBYTE SWC_DDM_type_CM_uint8_cnt 0 0 0.0 255.0 ECU_ADDRESS 0x0000 /* @ECU_Address@VDDM_TailgaSWDTC_cnt@ */ /end MEASUREMENT
/begin MEASUREMENT VDDM_HVB4PreDTC_cnt "" UBYTE SWC_DDM_type_CM_uint8_cnt 0 0 0.0 255.0 ECU_ADDRESS 0x0000 /* @ECU_Address@VDDM_HVB4PreDTC_cnt@ */ /end MEASUREMENT
/begin MEASUREMENT VDDM_MCU4PreDTC_cnt "" UBYTE SWC_DDM_type_CM_uint8_cnt 0 0 0.0 255.0 ECU_ADDRESS 0x0000 /* @ECU_Address@VDDM_MCU4PreDTC_cnt@ */ /end MEASUREMENT
/begin MEASUREMENT VDDM_DCDC4PreDTC_cnt "" UBYTE SWC_DDM_type_CM_uint8_cnt 0 0 0.0 255.0 ECU_ADDRESS 0x0000 /* @ECU_Address@VDDM_DCDC4PreDTC_cnt@ */ /end MEASUREMENT
/begin MEASUREMENT VDDM_HVRlyCloDTC_cnt "" UBYTE SWC_DDM_type_CM_uint8_cnt 0 0 0.0 255.0 ECU_ADDRESS 0x0000 /* @ECU_Address@VDDM_HVRlyCloDTC_cnt@ */ /end MEASUREMENT
/begin MEASUREMENT VDDM_BMSRdyDTC_cnt "" UBYTE SWC_DDM_type_CM_uint8_cnt 0 0 0.0 255.0 ECU_ADDRESS 0x0000 /* @ECU_Address@VDDM_BMSRdyDTC_cnt@ */ /end MEASUREMENT
/begin MEASUREMENT VDDM_DCDCEnaDTC_cnt "" UBYTE SWC_DDM_type_CM_uint8_cnt 0 0 0.0 255.0 ECU_ADDRESS 0x0000 /* @ECU_Address@VDDM_DCDCEnaDTC_cnt@ */ /end MEASUREMENT
/begin MEASUREMENT VDDM_HiLvSaChkDTC_cnt "" UBYTE SWC_DDM_type_CM_uint8_cnt 0 0 0.0 255.0 ECU_ADDRESS 0x0000 /* @ECU_Address@VDDM_HiLvSaChkDTC_cnt@ */ /end MEASUREMENT
/begin MEASUREMENT VDDM_MidLvSaChkDTC_cnt "" UBYTE SWC_DDM_type_CM_uint8_cnt 0 0 0.0 255.0 ECU_ADDRESS 0x0000 /* @ECU_Address@VDDM_MidLvSaChkDTC_cnt@ */ /end MEASUREMENT
/begin MEASUREMENT VDDM_MCUDisDTC_cnt "" UBYTE SWC_DDM_type_CM_uint8_cnt 0 0 0.0 255.0 ECU_ADDRESS 0x0000 /* @ECU_Address@VDDM_MCUDisDTC_cnt@ */ /end MEASUREMENT
/begin MEASUREMENT VDDM_DCDCDisDTC_cnt "" UBYTE SWC_DDM_type_CM_uint8_cnt 0 0 0.0 255.0 ECU_ADDRESS 0x0000 /* @ECU_Address@VDDM_DCDCDisDTC_cnt@ */ /end MEASUREMENT
/begin MEASUREMENT VDDM_HVRlyOpDTC_cnt "" UBYTE SWC_DDM_type_CM_uint8_cnt 0 0 0.0 255.0 ECU_ADDRESS 0x0000 /* @ECU_Address@VDDM_HVRlyOpDTC_cnt@ */ /end MEASUREMENT
/begin MEASUREMENT VDDM_MCUActDTC_cnt "" UBYTE SWC_DDM_type_CM_uint8_cnt 0 0 0.0 255.0 ECU_ADDRESS 0x0000 /* @ECU_Address@VDDM_MCUActDTC_cnt@ */ /end MEASUREMENT
/begin MEASUREMENT VDDM_OBC4PreDTC_cnt "" UBYTE SWC_DDM_type_CM_uint8_cnt 0 0 0.0 255.0 ECU_ADDRESS 0x0000 /* @ECU_Address@VDDM_OBC4PreDTC_cnt@ */ /end MEASUREMENT
/begin MEASUREMENT VDDM_IniLVLoDTC_cnt "" UBYTE SWC_DDM_type_CM_uint8_cnt 0 0 0.0 255.0 ECU_ADDRESS 0x0000 /* @ECU_Address@VDDM_IniLVLoDTC_cnt@ */ /end MEASUREMENT
/begin MEASUREMENT VDDM_LVSupLoDTC_cnt "" UBYTE SWC_DDM_type_CM_uint8_cnt 0 0 0.0 255.0 ECU_ADDRESS 0x0000 /* @ECU_Address@VDDM_LVSupLoDTC_cnt@ */ /end MEASUREMENT
/begin MEASUREMENT VDDM_LVSupHiDTC_cnt "" UBYTE SWC_DDM_type_CM_uint8_cnt 0 0 0.0 255.0 ECU_ADDRESS 0x0000 /* @ECU_Address@VDDM_LVSupHiDTC_cnt@ */ /end MEASUREMENT
/begin MEASUREMENT VDDM_LVInErrDTC_cnt "" UBYTE SWC_DDM_type_CM_uint8_cnt 0 0 0.0 255.0 ECU_ADDRESS 0x0000 /* @ECU_Address@VDDM_LVInErrDTC_cnt@ */ /end MEASUREMENT
/begin MEASUREMENT VDDM_DrStSWDTC_cnt "" UBYTE SWC_DDM_type_CM_uint8_cnt 0 0 0.0 255.0 ECU_ADDRESS 0x0000 /* @ECU_Address@VDDM_DrStSWDTC_cnt@ */ /end MEASUREMENT
/begin MEASUREMENT VDDM_5vAPS1OoRDTC_cnt "" UBYTE SWC_DDM_type_CM_uint8_cnt 0 0 0.0 255.0 ECU_ADDRESS 0x0000 /* @ECU_Address@VDDM_5vAPS1OoRDTC_cnt@ */ /end MEASUREMENT
/begin MEASUREMENT VDDM_5vAPS2OoRDTC_cnt "" UBYTE SWC_DDM_type_CM_uint8_cnt 0 0 0.0 255.0 ECU_ADDRESS 0x0000 /* @ECU_Address@VDDM_5vAPS2OoRDTC_cnt@ */ /end MEASUREMENT
/begin MEASUREMENT VDDM_EPB1NoComDTC_cnt "" UBYTE SWC_DDM_type_CM_uint8_cnt 0 0 0.0 255.0 ECU_ADDRESS 0x0000 /* @ECU_Address@VDDM_EPB1NoComDTC_cnt@ */ /end MEASUREMENT
/begin MEASUREMENT VDDM_EPB1RCErrDTC_cnt "" UBYTE SWC_DDM_type_CM_uint8_cnt 0 0 0.0 255.0 ECU_ADDRESS 0x0000 /* @ECU_Address@VDDM_EPB1RCErrDTC_cnt@ */ /end MEASUREMENT
/begin MEASUREMENT VDDM_EPB1CSErrDTC_cnt "" UBYTE SWC_DDM_type_CM_uint8_cnt 0 0 0.0 255.0 ECU_ADDRESS 0x0000 /* @ECU_Address@VDDM_EPB1CSErrDTC_cnt@ */ /end MEASUREMENT
/begin MEASUREMENT VDDM_EPBUnlockTODTC_cnt "" UBYTE SWC_DDM_type_CM_uint8_cnt 0 0 0.0 255.0 ECU_ADDRESS 0x0000 /* @ECU_Address@VDDM_EPBUnlockTODTC_cnt@ */ /end MEASUREMENT
/begin MEASUREMENT VDDM_EPBLockTODTC_cnt "" UBYTE SWC_DDM_type_CM_uint8_cnt 0 0 0.0 255.0 ECU_ADDRESS 0x0000 /* @ECU_Address@VDDM_EPBLockTODTC_cnt@ */ /end MEASUREMENT
/begin MEASUREMENT VDDM_APS1SigOoRDTC_cnt "" UBYTE SWC_DDM_type_CM_uint8_cnt 0 0 0.0 255.0 ECU_ADDRESS 0x0000 /* @ECU_Address@VDDM_APS1SigOoRDTC_cnt@ */ /end MEASUREMENT
/begin MEASUREMENT VDDM_APS2SigOoRDTC_cnt "" UBYTE SWC_DDM_type_CM_uint8_cnt 0 0 0.0 255.0 ECU_ADDRESS 0x0000 /* @ECU_Address@VDDM_APS2SigOoRDTC_cnt@ */ /end MEASUREMENT
/begin MEASUREMENT VDDM_APSCorrErrDTC_cnt "" UBYTE SWC_DDM_type_CM_uint8_cnt 0 0 0.0 255.0 ECU_ADDRESS 0x0000 /* @ECU_Address@VDDM_APSCorrErrDTC_cnt@ */ /end MEASUREMENT
/begin MEASUREMENT VDDM_FCM1NoComDTC_cnt "" UBYTE SWC_DDM_type_CM_uint8_cnt 0 0 0.0 255.0 ECU_ADDRESS 0x0000 /* @ECU_Address@VDDM_FCM1NoComDTC_cnt@ */ /end MEASUREMENT
/begin MEASUREMENT VDDM_FCM1RCErrDTC_cnt "" UBYTE SWC_DDM_type_CM_uint8_cnt 0 0 0.0 255.0 ECU_ADDRESS 0x0000 /* @ECU_Address@VDDM_FCM1RCErrDTC_cnt@ */ /end MEASUREMENT
/begin MEASUREMENT VDDM_FCM1CSErrDTC_cnt "" UBYTE SWC_DDM_type_CM_uint8_cnt 0 0 0.0 255.0 ECU_ADDRESS 0x0000 /* @ECU_Address@VDDM_FCM1CSErrDTC_cnt@ */ /end MEASUREMENT
/begin MEASUREMENT VDDM_BMSSigErrDTC_cnt "" UBYTE SWC_DDM_type_CM_uint8_cnt 0 0 0.0 100.0 ECU_ADDRESS 0x0000 /* @ECU_Address@VDDM_BMSSigErrDTC_cnt@ */ /end MEASUREMENT
/begin MEASUREMENT VDDM_FCMACCSigErrDTC_cnt "" UBYTE SWC_DDM_type_CM_uint8_cnt 0 0 0.0 100.0 ECU_ADDRESS 0x0000 /* @ECU_Address@VDDM_FCMACCSigErrDTC_cnt@ */ /end MEASUREMENT
/begin MEASUREMENT VDDM_CCUSigErrDTC_cnt "" UBYTE SWC_DDM_type_CM_uint8_cnt 0 0 0.0 100.0 ECU_ADDRESS 0x0000 /* @ECU_Address@VDDM_CCUSigErrDTC_cnt@ */ /end MEASUREMENT
/begin MEASUREMENT VDDM_ACCAccelCmdErrDTC_cnt "" UBYTE SWC_DDM_type_CM_uint8_cnt 0 0 0.0 100.0 ECU_ADDRESS 0x0000 /* @ECU_Address@VDDM_ACCAccelCmdErrDTC_cnt@ */ /end MEASUREMENT
/begin MEASUREMENT VDDM_ESCSigErrDTC_cnt "" UBYTE SWC_DDM_type_CM_uint8_cnt 0 0 0.0 255.0 ECU_ADDRESS 0x0000 /* @ECU_Address@VDDM_ESCSigErrDTC_cnt@ */ /end MEASUREMENT
/begin MEASUREMENT VDDM_ShifterSigErrDTC_cnt "" UBYTE SWC_DDM_type_CM_uint8_cnt 0 0 0.0 255.0 ECU_ADDRESS 0x0000 /* @ECU_Address@VDDM_ShifterSigErrDTC_cnt@ */ /end MEASUREMENT
/begin MEASUREMENT VDDM_ZoneDrSigErrDTC_cnt "" UBYTE SWC_DDM_type_CM_uint8_cnt 0 0 0.0 255.0 ECU_ADDRESS 0x0000 /* @ECU_Address@VDDM_ZoneDrSigErrDTC_cnt@ */ /end MEASUREMENT
/begin MEASUREMENT VDDM_ZoneFrSigErrDTC_cnt "" UBYTE SWC_DDM_type_CM_uint8_cnt 0 0 0.0 255.0 ECU_ADDRESS 0x0000 /* @ECU_Address@VDDM_ZoneFrSigErrDTC_cnt@ */ /end MEASUREMENT
/begin MEASUREMENT VDDM_FrMCUSigErrDTC_cnt "" UBYTE SWC_DDM_type_CM_uint8_cnt 0 0 0.0 100.0 ECU_ADDRESS 0x0000 /* @ECU_Address@VDDM_FrMCUSigErrDTC_cnt@ */ /end MEASUREMENT
/begin MEASUREMENT VDDM_RrMCUSigErrDTC_cnt "" UBYTE SWC_DDM_type_CM_uint8_cnt 0 0 0.0 100.0 ECU_ADDRESS 0x0000 /* @ECU_Address@VDDM_RrMCUSigErrDTC_cnt@ */ /end MEASUREMENT
/begin MEASUREMENT VDDM_EPBSigErrDTC_cnt "" UBYTE SWC_DDM_type_CM_uint8_cnt 0 0 0.0 255.0 ECU_ADDRESS 0x0000 /* @ECU_Address@VDDM_EPBSigErrDTC_cnt@ */ /end MEASUREMENT
/begin MEASUREMENT VDDM_FrMCUNTqErrDTC_cnt "" UBYTE SWC_DDM_type_CM_uint8_cnt 0 0 0.0 255.0 ECU_ADDRESS 0x0000 /* @ECU_Address@VDDM_FrMCUNTqErrDTC_cnt@ */ /end MEASUREMENT
/begin MEASUREMENT VDDM_RrMCUNTqErrDTC_cnt "" UBYTE SWC_DDM_type_CM_uint8_cnt 0 0 0.0 255.0 ECU_ADDRESS 0x0000 /* @ECU_Address@VDDM_RrMCUNTqErrDTC_cnt@ */ /end MEASUREMENT
/begin MEASUREMENT VDDM_LFBatwarnDTC_cnt "" UBYTE SWC_DDM_type_CM_uint8_cnt 0 0 0.0 255.0 ECU_ADDRESS 0x0000 /* @ECU_Address@VDDM_LFBatwarnDTC_cnt@ */ /end MEASUREMENT
/begin MEASUREMENT VDDM_RFBatwarnDTC_cnt "" UBYTE SWC_DDM_type_CM_uint8_cnt 0 0 0.0 255.0 ECU_ADDRESS 0x0000 /* @ECU_Address@VDDM_RFBatwarnDTC_cnt@ */ /end MEASUREMENT
/begin MEASUREMENT VDDM_LRBatwarnDTC_cnt "" UBYTE SWC_DDM_type_CM_uint8_cnt 0 0 0.0 255.0 ECU_ADDRESS 0x0000 /* @ECU_Address@VDDM_LRBatwarnDTC_cnt@ */ /end MEASUREMENT
/begin MEASUREMENT VDDM_RRBatwarnDTC_cnt "" UBYTE SWC_DDM_type_CM_uint8_cnt 0 0 0.0 255.0 ECU_ADDRESS 0x0000 /* @ECU_Address@VDDM_RRBatwarnDTC_cnt@ */ /end MEASUREMENT
/begin MEASUREMENT VDDM_LFPressIndiDTC_cnt "" UBYTE SWC_DDM_type_CM_uint8_cnt 0 0 0.0 255.0 ECU_ADDRESS 0x0000 /* @ECU_Address@VDDM_LFPressIndiDTC_cnt@ */ /end MEASUREMENT
/begin MEASUREMENT VDDM_RFPressIndiDTC_cnt "" UBYTE SWC_DDM_type_CM_uint8_cnt 0 0 0.0 255.0 ECU_ADDRESS 0x0000 /* @ECU_Address@VDDM_RFPressIndiDTC_cnt@ */ /end MEASUREMENT
/begin MEASUREMENT VDDM_LRPressIndiDTC_cnt "" UBYTE SWC_DDM_type_CM_uint8_cnt 0 0 0.0 255.0 ECU_ADDRESS 0x0000 /* @ECU_Address@VDDM_LRPressIndiDTC_cnt@ */ /end MEASUREMENT
/begin MEASUREMENT VDDM_RRPressIndiDTC_cnt "" UBYTE SWC_DDM_type_CM_uint8_cnt 0 0 0.0 255.0 ECU_ADDRESS 0x0000 /* @ECU_Address@VDDM_RRPressIndiDTC_cnt@ */ /end MEASUREMENT
/begin MEASUREMENT VDDM_LFWheelTmpHighDTC_cnt "" UBYTE SWC_DDM_type_CM_uint8_cnt 0 0 0.0 255.0 ECU_ADDRESS 0x0000 /* @ECU_Address@VDDM_LFWheelTmpHighDTC_cnt@ */ /end MEASUREMENT
/begin MEASUREMENT VDDM_RFWheelTmpHighDTC_cnt "" UBYTE SWC_DDM_type_CM_uint8_cnt 0 0 0.0 255.0 ECU_ADDRESS 0x0000 /* @ECU_Address@VDDM_RFWheelTmpHighDTC_cnt@ */ /end MEASUREMENT
/begin MEASUREMENT VDDM_LRWheelTmpHighDTC_cnt "" UBYTE SWC_DDM_type_CM_uint8_cnt 0 0 0.0 255.0 ECU_ADDRESS 0x0000 /* @ECU_Address@VDDM_LRWheelTmpHighDTC_cnt@ */ /end MEASUREMENT
/begin MEASUREMENT VDDM_RRWheelTmpHighDTC_cnt "" UBYTE SWC_DDM_type_CM_uint8_cnt 0 0 0.0 255.0 ECU_ADDRESS 0x0000 /* @ECU_Address@VDDM_RRWheelTmpHighDTC_cnt@ */ /end MEASUREMENT
/begin MEASUREMENT VDDM_LFSensorFailDTC_cnt "" UBYTE SWC_DDM_type_CM_uint8_cnt 0 0 0.0 255.0 ECU_ADDRESS 0x0000 /* @ECU_Address@VDDM_LFSensorFailDTC_cnt@ */ /end MEASUREMENT
/begin MEASUREMENT VDDM_RFSensorFailDTC_cnt "" UBYTE SWC_DDM_type_CM_uint8_cnt 0 0 0.0 255.0 ECU_ADDRESS 0x0000 /* @ECU_Address@VDDM_RFSensorFailDTC_cnt@ */ /end MEASUREMENT
/begin MEASUREMENT VDDM_LRSensorFailDTC_cnt "" UBYTE SWC_DDM_type_CM_uint8_cnt 0 0 0.0 255.0 ECU_ADDRESS 0x0000 /* @ECU_Address@VDDM_LRSensorFailDTC_cnt@ */ /end MEASUREMENT
/begin MEASUREMENT VDDM_RRSensorFailDTC_cnt "" UBYTE SWC_DDM_type_CM_uint8_cnt 0 0 0.0 255.0 ECU_ADDRESS 0x0000 /* @ECU_Address@VDDM_RRSensorFailDTC_cnt@ */ /end MEASUREMENT
/begin MEASUREMENT VDDM_RegenErrDTC_cnt "" UBYTE SWC_DDM_type_CM_uint8_cnt 0 0 0.0 255.0 ECU_ADDRESS 0x0000 /* @ECU_Address@VDDM_RegenErrDTC_cnt@ */ /end MEASUREMENT
/begin MEASUREMENT VDDM_EPS1NoComDTC_cnt "" UBYTE SWC_DDM_type_CM_uint8_cnt 0 0 0.0 255.0 ECU_ADDRESS 0x0000 /* @ECU_Address@VDDM_EPS1NoComDTC_cnt@ */ /end MEASUREMENT
/begin MEASUREMENT VDDM_EPS1CSErrDTC_cnt "" UBYTE SWC_DDM_type_CM_uint8_cnt 0 0 0.0 255.0 ECU_ADDRESS 0x0000 /* @ECU_Address@VDDM_EPS1CSErrDTC_cnt@ */ /end MEASUREMENT
/begin MEASUREMENT VDDM_EPS1RCErrDTC_cnt "" UBYTE SWC_DDM_type_CM_uint8_cnt 0 0 0.0 255.0 ECU_ADDRESS 0x0000 /* @ECU_Address@VDDM_EPS1RCErrDTC_cnt@ */ /end MEASUREMENT
/begin MEASUREMENT VDDM_EPSSigErrDTC_cnt "" UBYTE SWC_DDM_type_CM_uint8_cnt 0 0 0.0 255.0 ECU_ADDRESS 0x0000 /* @ECU_Address@VDDM_EPSSigErrDTC_cnt@ */ /end MEASUREMENT
/begin MEASUREMENT VDDM_C3BMS6LCDet_flg "" UBYTE SWC_DDM_type_CM_boolean_flg 0 0 0.0 1.0 ECU_ADDRESS 0x0000 /* @ECU_Address@VDDM_C3BMS6LCDet_flg@ */ /end MEASUREMENT
/begin MEASUREMENT VDDM_C3BMS6LCCFS_flg "" UBYTE SWC_DDM_type_CM_boolean_flg 0 0 0.0 1.0 ECU_ADDRESS 0x0000 /* @ECU_Address@VDDM_C3BMS6LCCFS_flg@ */ /end MEASUREMENT
/begin MEASUREMENT VDDM_C3BMS6RCDet_flg "" UBYTE SWC_DDM_type_CM_boolean_flg 0 0 0.0 1.0 ECU_ADDRESS 0x0000 /* @ECU_Address@VDDM_C3BMS6RCDet_flg@ */ /end MEASUREMENT
/begin MEASUREMENT VDDM_C3BMS6RCCFS_flg "" UBYTE SWC_DDM_type_CM_boolean_flg 0 0 0.0 1.0 ECU_ADDRESS 0x0000 /* @ECU_Address@VDDM_C3BMS6RCCFS_flg@ */ /end MEASUREMENT
/begin MEASUREMENT VDDM_C3BMS6CSDet_flg "" UBYTE SWC_DDM_type_CM_boolean_flg 0 0 0.0 1.0 ECU_ADDRESS 0x0000 /* @ECU_Address@VDDM_C3BMS6CSDet_flg@ */ /end MEASUREMENT
/begin MEASUREMENT VDDM_C3BMS6CSCFS_flg "" UBYTE SWC_DDM_type_CM_boolean_flg 0 0 0.0 1.0 ECU_ADDRESS 0x0000 /* @ECU_Address@VDDM_C3BMS6CSCFS_flg@ */ /end MEASUREMENT
/begin MEASUREMENT VDDM_C3BMS1LCDet_flg "" UBYTE SWC_DDM_type_CM_boolean_flg 0 0 0.0 1.0 ECU_ADDRESS 0x0000 /* @ECU_Address@VDDM_C3BMS1LCDet_flg@ */ /end MEASUREMENT
/begin MEASUREMENT VDDM_C3BMS1LCCFS_flg "" UBYTE SWC_DDM_type_CM_boolean_flg 0 0 0.0 1.0 ECU_ADDRESS 0x0000 /* @ECU_Address@VDDM_C3BMS1LCCFS_flg@ */ /end MEASUREMENT
/begin MEASUREMENT VDDM_C3BMS1RCDet_flg "" UBYTE SWC_DDM_type_CM_boolean_flg 0 0 0.0 1.0 ECU_ADDRESS 0x0000 /* @ECU_Address@VDDM_C3BMS1RCDet_flg@ */ /end MEASUREMENT
/begin MEASUREMENT VDDM_C3BMS1RCCFS_flg "" UBYTE SWC_DDM_type_CM_boolean_flg 0 0 0.0 1.0 ECU_ADDRESS 0x0000 /* @ECU_Address@VDDM_C3BMS1RCCFS_flg@ */ /end MEASUREMENT
/begin MEASUREMENT VDDM_C3BMS1CSDet_flg "" UBYTE SWC_DDM_type_CM_boolean_flg 0 0 0.0 1.0 ECU_ADDRESS 0x0000 /* @ECU_Address@VDDM_C3BMS1CSDet_flg@ */ /end MEASUREMENT
/begin MEASUREMENT VDDM_C3BMS1CSCFS_flg "" UBYTE SWC_DDM_type_CM_boolean_flg 0 0 0.0 1.0 ECU_ADDRESS 0x0000 /* @ECU_Address@VDDM_C3BMS1CSCFS_flg@ */ /end MEASUREMENT
/begin MEASUREMENT VDDM_C3CCU1LCDet_flg "" UBYTE SWC_DDM_type_CM_boolean_flg 0 0 0.0 1.0 ECU_ADDRESS 0x0000 /* @ECU_Address@VDDM_C3CCU1LCDet_flg@ */ /end MEASUREMENT
/begin MEASUREMENT VDDM_C3CCU1LCCFS_flg "" UBYTE SWC_DDM_type_CM_boolean_flg 0 0 0.0 1.0 ECU_ADDRESS 0x0000 /* @ECU_Address@VDDM_C3CCU1LCCFS_flg@ */ /end MEASUREMENT
/begin MEASUREMENT VDDM_C3CCU1RCDet_flg "" UBYTE SWC_DDM_type_CM_boolean_flg 0 0 0.0 1.0 ECU_ADDRESS 0x0000 /* @ECU_Address@VDDM_C3CCU1RCDet_flg@ */ /end MEASUREMENT
/begin MEASUREMENT VDDM_C3CCU1RCCFS_flg "" UBYTE SWC_DDM_type_CM_boolean_flg 0 0 0.0 1.0 ECU_ADDRESS 0x0000 /* @ECU_Address@VDDM_C3CCU1RCCFS_flg@ */ /end MEASUREMENT
/begin MEASUREMENT VDDM_C3CCU1CSDet_flg "" UBYTE SWC_DDM_type_CM_boolean_flg 0 0 0.0 1.0 ECU_ADDRESS 0x0000 /* @ECU_Address@VDDM_C3CCU1CSDet_flg@ */ /end MEASUREMENT
/begin MEASUREMENT VDDM_C3CCU1CSCFS_flg "" UBYTE SWC_DDM_type_CM_boolean_flg 0 0 0.0 1.0 ECU_ADDRESS 0x0000 /* @ECU_Address@VDDM_C3CCU1CSCFS_flg@ */ /end MEASUREMENT
/begin MEASUREMENT VDDM_C3CCU2LCDet_flg "" UBYTE SWC_DDM_type_CM_boolean_flg 0 0 0.0 1.0 ECU_ADDRESS 0x0000 /* @ECU_Address@VDDM_C3CCU2LCDet_flg@ */ /end MEASUREMENT
/begin MEASUREMENT VDDM_C3CCU2LCCFS_flg "" UBYTE SWC_DDM_type_CM_boolean_flg 0 0 0.0 1.0 ECU_ADDRESS 0x0000 /* @ECU_Address@VDDM_C3CCU2LCCFS_flg@ */ /end MEASUREMENT
/begin MEASUREMENT VDDM_C3CCU2RCDet_flg "" UBYTE SWC_DDM_type_CM_boolean_flg 0 0 0.0 1.0 ECU_ADDRESS 0x0000 /* @ECU_Address@VDDM_C3CCU2RCDet_flg@ */ /end MEASUREMENT
/begin MEASUREMENT VDDM_C3CCU2RCCFS_flg "" UBYTE SWC_DDM_type_CM_boolean_flg 0 0 0.0 1.0 ECU_ADDRESS 0x0000 /* @ECU_Address@VDDM_C3CCU2RCCFS_flg@ */ /end MEASUREMENT
/begin MEASUREMENT VDDM_C3CCU2CSDet_flg "" UBYTE SWC_DDM_type_CM_boolean_flg 0 0 0.0 1.0 ECU_ADDRESS 0x0000 /* @ECU_Address@VDDM_C3CCU2CSDet_flg@ */ /end MEASUREMENT
/begin MEASUREMENT VDDM_C3CCU2CSCFS_flg "" UBYTE SWC_DDM_type_CM_boolean_flg 0 0 0.0 1.0 ECU_ADDRESS 0x0000 /* @ECU_Address@VDDM_C3CCU2CSCFS_flg@ */ /end MEASUREMENT
/begin MEASUREMENT VDDM_C1ABM1LCDet_flg "" UBYTE SWC_DDM_type_CM_boolean_flg 0 0 0.0 1.0 ECU_ADDRESS 0x0000 /* @ECU_Address@VDDM_C1ABM1LCDet_flg@ */ /end MEASUREMENT
/begin MEASUREMENT VDDM_C1ABM1LCCFS_flg "" UBYTE SWC_DDM_type_CM_boolean_flg 0 0 0.0 1.0 ECU_ADDRESS 0x0000 /* @ECU_Address@VDDM_C1ABM1LCCFS_flg@ */ /end MEASUREMENT
/begin MEASUREMENT VDDM_C1ABM1RCDet_flg "" UBYTE SWC_DDM_type_CM_boolean_flg 0 0 0.0 1.0 ECU_ADDRESS 0x0000 /* @ECU_Address@VDDM_C1ABM1RCDet_flg@ */ /end MEASUREMENT
/begin MEASUREMENT VDDM_C1ABM1RCCFS_flg "" UBYTE SWC_DDM_type_CM_boolean_flg 0 0 0.0 1.0 ECU_ADDRESS 0x0000 /* @ECU_Address@VDDM_C1ABM1RCCFS_flg@ */ /end MEASUREMENT
/begin MEASUREMENT VDDM_C1ABM1CSDet_flg "" UBYTE SWC_DDM_type_CM_boolean_flg 0 0 0.0 1.0 ECU_ADDRESS 0x0000 /* @ECU_Address@VDDM_C1ABM1CSDet_flg@ */ /end MEASUREMENT
/begin MEASUREMENT VDDM_C1ABM1CSCFS_flg "" UBYTE SWC_DDM_type_CM_boolean_flg 0 0 0.0 1.0 ECU_ADDRESS 0x0000 /* @ECU_Address@VDDM_C1ABM1CSCFS_flg@ */ /end MEASUREMENT
/begin MEASUREMENT VDDM_MCUNR1NoComDet_flg "" UBYTE SWC_DDM_type_CM_boolean_flg 0 0 0.0 1.0 ECU_ADDRESS 0x0000 /* @ECU_Address@VDDM_MCUNR1NoComDet_flg@ */ /end MEASUREMENT
/begin MEASUREMENT VDDM_MCUNR1NoComCFS_flg "" UBYTE SWC_DDM_type_CM_boolean_flg 0 0 0.0 1.0 ECU_ADDRESS 0x0000 /* @ECU_Address@VDDM_MCUNR1NoComCFS_flg@ */ /end MEASUREMENT
/begin MEASUREMENT VDDM_MCUNR1RCErrDet_flg "" UBYTE SWC_DDM_type_CM_boolean_flg 0 0 0.0 1.0 ECU_ADDRESS 0x0000 /* @ECU_Address@VDDM_MCUNR1RCErrDet_flg@ */ /end MEASUREMENT
/begin MEASUREMENT VDDM_MCUNR1RCErrCFS_flg "" UBYTE SWC_DDM_type_CM_boolean_flg 0 0 0.0 1.0 ECU_ADDRESS 0x0000 /* @ECU_Address@VDDM_MCUNR1RCErrCFS_flg@ */ /end MEASUREMENT
/begin MEASUREMENT VDDM_MCUNR1CSErrDet_flg "" UBYTE SWC_DDM_type_CM_boolean_flg 0 0 0.0 1.0 ECU_ADDRESS 0x0000 /* @ECU_Address@VDDM_MCUNR1CSErrDet_flg@ */ /end MEASUREMENT
/begin MEASUREMENT VDDM_MCUNR1CSErrCFS_flg "" UBYTE SWC_DDM_type_CM_boolean_flg 0 0 0.0 1.0 ECU_ADDRESS 0x0000 /* @ECU_Address@VDDM_MCUNR1CSErrCFS_flg@ */ /end MEASUREMENT
/begin MEASUREMENT VDDM_MCUNF1NoComDet_flg "" UBYTE SWC_DDM_type_CM_boolean_flg 0 0 0.0 1.0 ECU_ADDRESS 0x0000 /* @ECU_Address@VDDM_MCUNF1NoComDet_flg@ */ /end MEASUREMENT
/begin MEASUREMENT VDDM_MCUNF1NoComCFS_flg "" UBYTE SWC_DDM_type_CM_boolean_flg 0 0 0.0 1.0 ECU_ADDRESS 0x0000 /* @ECU_Address@VDDM_MCUNF1NoComCFS_flg@ */ /end MEASUREMENT
/begin MEASUREMENT VDDM_MCUNF1RCErrDet_flg "" UBYTE SWC_DDM_type_CM_boolean_flg 0 0 0.0 1.0 ECU_ADDRESS 0x0000 /* @ECU_Address@VDDM_MCUNF1RCErrDet_flg@ */ /end MEASUREMENT
/begin MEASUREMENT VDDM_MCUNF1RCErrCFS_flg "" UBYTE SWC_DDM_type_CM_boolean_flg 0 0 0.0 1.0 ECU_ADDRESS 0x0000 /* @ECU_Address@VDDM_MCUNF1RCErrCFS_flg@ */ /end MEASUREMENT
/begin MEASUREMENT VDDM_MCUNF1CSErrDet_flg "" UBYTE SWC_DDM_type_CM_boolean_flg 0 0 0.0 1.0 ECU_ADDRESS 0x0000 /* @ECU_Address@VDDM_MCUNF1CSErrDet_flg@ */ /end MEASUREMENT
/begin MEASUREMENT VDDM_MCUNF1CSErrCFS_flg "" UBYTE SWC_DDM_type_CM_boolean_flg 0 0 0.0 1.0 ECU_ADDRESS 0x0000 /* @ECU_Address@VDDM_MCUNF1CSErrCFS_flg@ */ /end MEASUREMENT
/begin MEASUREMENT VDDM_ESC1NoComDet_flg "" UBYTE SWC_DDM_type_CM_boolean_flg 0 0 0.0 1.0 ECU_ADDRESS 0x0000 /* @ECU_Address@VDDM_ESC1NoComDet_flg@ */ /end MEASUREMENT
/begin MEASUREMENT VDDM_ESC1NoComCFS_flg "" UBYTE SWC_DDM_type_CM_boolean_flg 0 0 0.0 1.0 ECU_ADDRESS 0x0000 /* @ECU_Address@VDDM_ESC1NoComCFS_flg@ */ /end MEASUREMENT
/begin MEASUREMENT VDDM_ESC1RCErrDet_flg "" UBYTE SWC_DDM_type_CM_boolean_flg 0 0 0.0 1.0 ECU_ADDRESS 0x0000 /* @ECU_Address@VDDM_ESC1RCErrDet_flg@ */ /end MEASUREMENT
/begin MEASUREMENT VDDM_ESC1RCErrCFS_flg "" UBYTE SWC_DDM_type_CM_boolean_flg 0 0 0.0 1.0 ECU_ADDRESS 0x0000 /* @ECU_Address@VDDM_ESC1RCErrCFS_flg@ */ /end MEASUREMENT
/begin MEASUREMENT VDDM_ESC1CSErrDet_flg "" UBYTE SWC_DDM_type_CM_boolean_flg 0 0 0.0 1.0 ECU_ADDRESS 0x0000 /* @ECU_Address@VDDM_ESC1CSErrDet_flg@ */ /end MEASUREMENT
/begin MEASUREMENT VDDM_ESC1CSErrCFS_flg "" UBYTE SWC_DDM_type_CM_boolean_flg 0 0 0.0 1.0 ECU_ADDRESS 0x0000 /* @ECU_Address@VDDM_ESC1CSErrCFS_flg@ */ /end MEASUREMENT
/begin MEASUREMENT VDDM_ESC1SigErr_flg "" UBYTE SWC_DDM_type_CM_boolean_flg 0 0 0.0 1.0 ECU_ADDRESS 0x0000 /* @ECU_Address@VDDM_ESC1SigErr_flg@ */ /end MEASUREMENT
/begin MEASUREMENT VDDM_ESC5NoComDet_flg "" UBYTE SWC_DDM_type_CM_boolean_flg 0 0 0.0 1.0 ECU_ADDRESS 0x0000 /* @ECU_Address@VDDM_ESC5NoComDet_flg@ */ /end MEASUREMENT
/begin MEASUREMENT VDDM_ESC5NoComCFS_flg "" UBYTE SWC_DDM_type_CM_boolean_flg 0 0 0.0 1.0 ECU_ADDRESS 0x0000 /* @ECU_Address@VDDM_ESC5NoComCFS_flg@ */ /end MEASUREMENT
/begin MEASUREMENT VDDM_ESC5RCErrDet_flg "" UBYTE SWC_DDM_type_CM_boolean_flg 0 0 0.0 1.0 ECU_ADDRESS 0x0000 /* @ECU_Address@VDDM_ESC5RCErrDet_flg@ */ /end MEASUREMENT
/begin MEASUREMENT VDDM_ESC5RCErrCFS_flg "" UBYTE SWC_DDM_type_CM_boolean_flg 0 0 0.0 1.0 ECU_ADDRESS 0x0000 /* @ECU_Address@VDDM_ESC5RCErrCFS_flg@ */ /end MEASUREMENT
/begin MEASUREMENT VDDM_ESC5CSErrDet_flg "" UBYTE SWC_DDM_type_CM_boolean_flg 0 0 0.0 1.0 ECU_ADDRESS 0x0000 /* @ECU_Address@VDDM_ESC5CSErrDet_flg@ */ /end MEASUREMENT
/begin MEASUREMENT VDDM_ESC5CSErrCFS_flg "" UBYTE SWC_DDM_type_CM_boolean_flg 0 0 0.0 1.0 ECU_ADDRESS 0x0000 /* @ECU_Address@VDDM_ESC5CSErrCFS_flg@ */ /end MEASUREMENT
/begin MEASUREMENT VDDM_ESC5SigErr_flg "" UBYTE SWC_DDM_type_CM_boolean_flg 0 0 0.0 1.0 ECU_ADDRESS 0x0000 /* @ECU_Address@VDDM_ESC5SigErr_flg@ */ /end MEASUREMENT
/begin MEASUREMENT VDDM_Shifter1NoComDet_flg "" UBYTE SWC_DDM_type_CM_boolean_flg 0 0 0.0 1.0 ECU_ADDRESS 0x0000 /* @ECU_Address@VDDM_Shifter1NoComDet_flg@ */ /end MEASUREMENT
/begin MEASUREMENT VDDM_Shifter1NoComCFS_flg "" UBYTE SWC_DDM_type_CM_boolean_flg 0 0 0.0 1.0 ECU_ADDRESS 0x0000 /* @ECU_Address@VDDM_Shifter1NoComCFS_flg@ */ /end MEASUREMENT
/begin MEASUREMENT VDDM_Shifter1RCErrDet_flg "" UBYTE SWC_DDM_type_CM_boolean_flg 0 0 0.0 1.0 ECU_ADDRESS 0x0000 /* @ECU_Address@VDDM_Shifter1RCErrDet_flg@ */ /end MEASUREMENT
/begin MEASUREMENT VDDM_Shifter1RCErrCFS_flg "" UBYTE SWC_DDM_type_CM_boolean_flg 0 0 0.0 1.0 ECU_ADDRESS 0x0000 /* @ECU_Address@VDDM_Shifter1RCErrCFS_flg@ */ /end MEASUREMENT
/begin MEASUREMENT VDDM_Shifter1CSErrDet_flg "" UBYTE SWC_DDM_type_CM_boolean_flg 0 0 0.0 1.0 ECU_ADDRESS 0x0000 /* @ECU_Address@VDDM_Shifter1CSErrDet_flg@ */ /end MEASUREMENT
/begin MEASUREMENT VDDM_Shifter1CSErrCFS_flg "" UBYTE SWC_DDM_type_CM_boolean_flg 0 0 0.0 1.0 ECU_ADDRESS 0x0000 /* @ECU_Address@VDDM_Shifter1CSErrCFS_flg@ */ /end MEASUREMENT
/begin MEASUREMENT VDDM_DrVCUNoComDet_flg "" UBYTE SWC_DDM_type_CM_boolean_flg 0 0 0.0 1.0 ECU_ADDRESS 0x0000 /* @ECU_Address@VDDM_DrVCUNoComDet_flg@ */ /end MEASUREMENT
/begin MEASUREMENT VDDM_DrVCUNoComCFS_flg "" UBYTE SWC_DDM_type_CM_boolean_flg 0 0 0.0 1.0 ECU_ADDRESS 0x0000 /* @ECU_Address@VDDM_DrVCUNoComCFS_flg@ */ /end MEASUREMENT
/begin MEASUREMENT VDDM_FrVCUNoComDet_flg "" UBYTE SWC_DDM_type_CM_boolean_flg 0 0 0.0 1.0 ECU_ADDRESS 0x0000 /* @ECU_Address@VDDM_FrVCUNoComDet_flg@ */ /end MEASUREMENT
/begin MEASUREMENT VDDM_FrVCUNoComCFS_flg "" UBYTE SWC_DDM_type_CM_boolean_flg 0 0 0.0 1.0 ECU_ADDRESS 0x0000 /* @ECU_Address@VDDM_FrVCUNoComCFS_flg@ */ /end MEASUREMENT
/begin MEASUREMENT VDDM_Lv1ErrDet_flg "" UBYTE SWC_DDM_type_CM_boolean_flg 0 0 0.0 1.0 ECU_ADDRESS 0x0000 /* @ECU_Address@VDDM_Lv1ErrDet_flg@ */ /end MEASUREMENT
/begin MEASUREMENT VDDM_Lv1ErrCFS_flg "" UBYTE SWC_DDM_type_CM_boolean_flg 0 0 0.0 1.0 ECU_ADDRESS 0x0000 /* @ECU_Address@VDDM_Lv1ErrCFS_flg@ */ /end MEASUREMENT
/begin MEASUREMENT VDDM_Lv2ErrDet_flg "" UBYTE SWC_DDM_type_CM_boolean_flg 0 0 0.0 1.0 ECU_ADDRESS 0x0000 /* @ECU_Address@VDDM_Lv2ErrDet_flg@ */ /end MEASUREMENT
/begin MEASUREMENT VDDM_Lv2ErrCFS_flg "" UBYTE SWC_DDM_type_CM_boolean_flg 0 0 0.0 1.0 ECU_ADDRESS 0x0000 /* @ECU_Address@VDDM_Lv2ErrCFS_flg@ */ /end MEASUREMENT
/begin MEASUREMENT VDDM_Lv3ErrDet_flg "" UBYTE SWC_DDM_type_CM_boolean_flg 0 0 0.0 1.0 ECU_ADDRESS 0x0000 /* @ECU_Address@VDDM_Lv3ErrDet_flg@ */ /end MEASUREMENT
/begin MEASUREMENT VDDM_Lv3ErrCFS_flg "" UBYTE SWC_DDM_type_CM_boolean_flg 0 0 0.0 1.0 ECU_ADDRESS 0x0000 /* @ECU_Address@VDDM_Lv3ErrCFS_flg@ */ /end MEASUREMENT
/begin MEASUREMENT VDDM_Lv4ErrDet_flg "" UBYTE SWC_DDM_type_CM_boolean_flg 0 0 0.0 1.0 ECU_ADDRESS 0x0000 /* @ECU_Address@VDDM_Lv4ErrDet_flg@ */ /end MEASUREMENT
/begin MEASUREMENT VDDM_Lv4ErrCFS_flg "" UBYTE SWC_DDM_type_CM_boolean_flg 0 0 0.0 1.0 ECU_ADDRESS 0x0000 /* @ECU_Address@VDDM_Lv4ErrCFS_flg@ */ /end MEASUREMENT
/begin MEASUREMENT VDDM_BrkSWErrDet_flg "" UBYTE SWC_DDM_type_CM_boolean_flg 0 0 0.0 1.0 ECU_ADDRESS 0x0000 /* @ECU_Address@VDDM_BrkSWErrDet_flg@ */ /end MEASUREMENT
/begin MEASUREMENT VDDM_BrkSWErrCFS_flg "" UBYTE SWC_DDM_type_CM_boolean_flg 0 0 0.0 1.0 ECU_ADDRESS 0x0000 /* @ECU_Address@VDDM_BrkSWErrCFS_flg@ */ /end MEASUREMENT
/begin MEASUREMENT VDDM_BrkSWNoBacDet_flg "" UBYTE SWC_DDM_type_CM_boolean_flg 0 0 0.0 1.0 ECU_ADDRESS 0x0000 /* @ECU_Address@VDDM_BrkSWNoBacDet_flg@ */ /end MEASUREMENT
/begin MEASUREMENT VDDM_BrkSWNoBacCFS_flg "" UBYTE SWC_DDM_type_CM_boolean_flg 0 0 0.0 1.0 ECU_ADDRESS 0x0000 /* @ECU_Address@VDDM_BrkSWNoBacCFS_flg@ */ /end MEASUREMENT
/begin MEASUREMENT VDDM_FLDoorSWDet_flg "" UBYTE SWC_DDM_type_CM_boolean_flg 0 0 0.0 1.0 ECU_ADDRESS 0x0000 /* @ECU_Address@VDDM_FLDoorSWDet_flg@ */ /end MEASUREMENT
/begin MEASUREMENT VDDM_FLDoorSWCFS_flg "" UBYTE SWC_DDM_type_CM_boolean_flg 0 0 0.0 1.0 ECU_ADDRESS 0x0000 /* @ECU_Address@VDDM_FLDoorSWCFS_flg@ */ /end MEASUREMENT
/begin MEASUREMENT VDDM_RLDoorSWDet_flg "" UBYTE SWC_DDM_type_CM_boolean_flg 0 0 0.0 1.0 ECU_ADDRESS 0x0000 /* @ECU_Address@VDDM_RLDoorSWDet_flg@ */ /end MEASUREMENT
/begin MEASUREMENT VDDM_RLDoorSWCFS_flg "" UBYTE SWC_DDM_type_CM_boolean_flg 0 0 0.0 1.0 ECU_ADDRESS 0x0000 /* @ECU_Address@VDDM_RLDoorSWCFS_flg@ */ /end MEASUREMENT
/begin MEASUREMENT VDDM_FRDoorSWDet_flg "" UBYTE SWC_DDM_type_CM_boolean_flg 0 0 0.0 1.0 ECU_ADDRESS 0x0000 /* @ECU_Address@VDDM_FRDoorSWDet_flg@ */ /end MEASUREMENT
/begin MEASUREMENT VDDM_FRDoorSWCFS_flg "" UBYTE SWC_DDM_type_CM_boolean_flg 0 0 0.0 1.0 ECU_ADDRESS 0x0000 /* @ECU_Address@VDDM_FRDoorSWCFS_flg@ */ /end MEASUREMENT
/begin MEASUREMENT VDDM_RRDoorSWDet_flg "" UBYTE SWC_DDM_type_CM_boolean_flg 0 0 0.0 1.0 ECU_ADDRESS 0x0000 /* @ECU_Address@VDDM_RRDoorSWDet_flg@ */ /end MEASUREMENT
/begin MEASUREMENT VDDM_RRDoorSWCFS_flg "" UBYTE SWC_DDM_type_CM_boolean_flg 0 0 0.0 1.0 ECU_ADDRESS 0x0000 /* @ECU_Address@VDDM_RRDoorSWCFS_flg@ */ /end MEASUREMENT
/begin MEASUREMENT VDDM_HoodSWDet_flg "" UBYTE SWC_DDM_type_CM_boolean_flg 0 0 0.0 1.0 ECU_ADDRESS 0x0000 /* @ECU_Address@VDDM_HoodSWDet_flg@ */ /end MEASUREMENT
/begin MEASUREMENT VDDM_HoodSWCFS_flg "" UBYTE SWC_DDM_type_CM_boolean_flg 0 0 0.0 1.0 ECU_ADDRESS 0x0000 /* @ECU_Address@VDDM_HoodSWCFS_flg@ */ /end MEASUREMENT
/begin MEASUREMENT VDDM_TailgaSWDet_flg "" UBYTE SWC_DDM_type_CM_boolean_flg 0 0 0.0 1.0 ECU_ADDRESS 0x0000 /* @ECU_Address@VDDM_TailgaSWDet_flg@ */ /end MEASUREMENT
/begin MEASUREMENT VDDM_TailgaSWCFS_flg "" UBYTE SWC_DDM_type_CM_boolean_flg 0 0 0.0 1.0 ECU_ADDRESS 0x0000 /* @ECU_Address@VDDM_TailgaSWCFS_flg@ */ /end MEASUREMENT
/begin MEASUREMENT VDDM_HVB4PrePass_flg "" UBYTE SWC_DDM_type_CM_boolean_flg 0 0 0.0 1.0 ECU_ADDRESS 0x0000 /* @ECU_Address@VDDM_HVB4PrePass_flg@ */ /end MEASUREMENT
/begin MEASUREMENT VDDM_HVB4PreCFSRls_flg "" UBYTE SWC_DDM_type_CM_boolean_flg 0 0 0.0 1.0 ECU_ADDRESS 0x0000 /* @ECU_Address@VDDM_HVB4PreCFSRls_flg@ */ /end MEASUREMENT
/begin MEASUREMENT VDDM_HVB4PreDet_flg "" UBYTE SWC_DDM_type_CM_boolean_flg 0 0 0.0 1.0 ECU_ADDRESS 0x0000 /* @ECU_Address@VDDM_HVB4PreDet_flg@ */ /end MEASUREMENT
/begin MEASUREMENT VDDM_HVB4PreCFS_flg "" UBYTE SWC_DDM_type_CM_boolean_flg 0 0 0.0 1.0 ECU_ADDRESS 0x0000 /* @ECU_Address@VDDM_HVB4PreCFS_flg@ */ /end MEASUREMENT
/begin MEASUREMENT VDDM_MCU4PrePass_flg "" UBYTE SWC_DDM_type_CM_boolean_flg 0 0 0.0 1.0 ECU_ADDRESS 0x0000 /* @ECU_Address@VDDM_MCU4PrePass_flg@ */ /end MEASUREMENT
/begin MEASUREMENT VDDM_MCU4PreCFSRls_flg "" UBYTE SWC_DDM_type_CM_boolean_flg 0 0 0.0 1.0 ECU_ADDRESS 0x0000 /* @ECU_Address@VDDM_MCU4PreCFSRls_flg@ */ /end MEASUREMENT
/begin MEASUREMENT VDDM_MCU4PreDet_flg "" UBYTE SWC_DDM_type_CM_boolean_flg 0 0 0.0 1.0 ECU_ADDRESS 0x0000 /* @ECU_Address@VDDM_MCU4PreDet_flg@ */ /end MEASUREMENT
/begin MEASUREMENT VDDM_MCU4PreCFS_flg "" UBYTE SWC_DDM_type_CM_boolean_flg 0 0 0.0 1.0 ECU_ADDRESS 0x0000 /* @ECU_Address@VDDM_MCU4PreCFS_flg@ */ /end MEASUREMENT
/begin MEASUREMENT VDDM_DCDC4PrePass_flg "" UBYTE SWC_DDM_type_CM_boolean_flg 0 0 0.0 1.0 ECU_ADDRESS 0x0000 /* @ECU_Address@VDDM_DCDC4PrePass_flg@ */ /end MEASUREMENT
/begin MEASUREMENT VDDM_DCDC4PreCFSRls_flg "" UBYTE SWC_DDM_type_CM_boolean_flg 0 0 0.0 1.0 ECU_ADDRESS 0x0000 /* @ECU_Address@VDDM_DCDC4PreCFSRls_flg@ */ /end MEASUREMENT
/begin MEASUREMENT VDDM_DCDC4PreDet_flg "" UBYTE SWC_DDM_type_CM_boolean_flg 0 0 0.0 1.0 ECU_ADDRESS 0x0000 /* @ECU_Address@VDDM_DCDC4PreDet_flg@ */ /end MEASUREMENT
/begin MEASUREMENT VDDM_DCDC4PreCFS_flg "" UBYTE SWC_DDM_type_CM_boolean_flg 0 0 0.0 1.0 ECU_ADDRESS 0x0000 /* @ECU_Address@VDDM_DCDC4PreCFS_flg@ */ /end MEASUREMENT
/begin MEASUREMENT VDDM_HVRlyCloPass_flg "" UBYTE SWC_DDM_type_CM_boolean_flg 0 0 0.0 1.0 ECU_ADDRESS 0x0000 /* @ECU_Address@VDDM_HVRlyCloPass_flg@ */ /end MEASUREMENT
/begin MEASUREMENT VDDM_HVRlyCloCFSRls_flg "" UBYTE SWC_DDM_type_CM_boolean_flg 0 0 0.0 1.0 ECU_ADDRESS 0x0000 /* @ECU_Address@VDDM_HVRlyCloCFSRls_flg@ */ /end MEASUREMENT
/begin MEASUREMENT VDDM_HVRlyCloDet_flg "" UBYTE SWC_DDM_type_CM_boolean_flg 0 0 0.0 1.0 ECU_ADDRESS 0x0000 /* @ECU_Address@VDDM_HVRlyCloDet_flg@ */ /end MEASUREMENT
/begin MEASUREMENT VDDM_HVRlyCloCFS_flg "" UBYTE SWC_DDM_type_CM_boolean_flg 0 0 0.0 1.0 ECU_ADDRESS 0x0000 /* @ECU_Address@VDDM_HVRlyCloCFS_flg@ */ /end MEASUREMENT
/begin MEASUREMENT VDDM_BMSRdyPass_flg "" UBYTE SWC_DDM_type_CM_boolean_flg 0 0 0.0 1.0 ECU_ADDRESS 0x0000 /* @ECU_Address@VDDM_BMSRdyPass_flg@ */ /end MEASUREMENT
/begin MEASUREMENT VDDM_BMSRdyCFSRls_flg "" UBYTE SWC_DDM_type_CM_boolean_flg 0 0 0.0 1.0 ECU_ADDRESS 0x0000 /* @ECU_Address@VDDM_BMSRdyCFSRls_flg@ */ /end MEASUREMENT
/begin MEASUREMENT VDDM_BMSRdyDet_flg "" UBYTE SWC_DDM_type_CM_boolean_flg 0 0 0.0 1.0 ECU_ADDRESS 0x0000 /* @ECU_Address@VDDM_BMSRdyDet_flg@ */ /end MEASUREMENT
/begin MEASUREMENT VDDM_BMSRdyCFS_flg "" UBYTE SWC_DDM_type_CM_boolean_flg 0 0 0.0 1.0 ECU_ADDRESS 0x0000 /* @ECU_Address@VDDM_BMSRdyCFS_flg@ */ /end MEASUREMENT
/begin MEASUREMENT VDDM_DCDCEnaPass_flg "" UBYTE SWC_DDM_type_CM_boolean_flg 0 0 0.0 1.0 ECU_ADDRESS 0x0000 /* @ECU_Address@VDDM_DCDCEnaPass_flg@ */ /end MEASUREMENT
/begin MEASUREMENT VDDM_DCDCEnaCFSRls_flg "" UBYTE SWC_DDM_type_CM_boolean_flg 0 0 0.0 1.0 ECU_ADDRESS 0x0000 /* @ECU_Address@VDDM_DCDCEnaCFSRls_flg@ */ /end MEASUREMENT
/begin MEASUREMENT VDDM_DCDCEnaDet_flg "" UBYTE SWC_DDM_type_CM_boolean_flg 0 0 0.0 1.0 ECU_ADDRESS 0x0000 /* @ECU_Address@VDDM_DCDCEnaDet_flg@ */ /end MEASUREMENT
/begin MEASUREMENT VDDM_DCDCEnaCFS_flg "" UBYTE SWC_DDM_type_CM_boolean_flg 0 0 0.0 1.0 ECU_ADDRESS 0x0000 /* @ECU_Address@VDDM_DCDCEnaCFS_flg@ */ /end MEASUREMENT
/begin MEASUREMENT VDDM_HiLvSaChkPass_flg "" UBYTE SWC_DDM_type_CM_boolean_flg 0 0 0.0 1.0 ECU_ADDRESS 0x0000 /* @ECU_Address@VDDM_HiLvSaChkPass_flg@ */ /end MEASUREMENT
/begin MEASUREMENT VDDM_HiLvSaChkCFSRls_flg "" UBYTE SWC_DDM_type_CM_boolean_flg 0 0 0.0 1.0 ECU_ADDRESS 0x0000 /* @ECU_Address@VDDM_HiLvSaChkCFSRls_flg@ */ /end MEASUREMENT
/begin MEASUREMENT VDDM_HiLvSaChkDet_flg "" UBYTE SWC_DDM_type_CM_boolean_flg 0 0 0.0 1.0 ECU_ADDRESS 0x0000 /* @ECU_Address@VDDM_HiLvSaChkDet_flg@ */ /end MEASUREMENT
/begin MEASUREMENT VDDM_HiLvSaChkCFS_flg "" UBYTE SWC_DDM_type_CM_boolean_flg 0 0 0.0 1.0 ECU_ADDRESS 0x0000 /* @ECU_Address@VDDM_HiLvSaChkCFS_flg@ */ /end MEASUREMENT
/begin MEASUREMENT VDDM_MidLvSaChkPass_flg "" UBYTE SWC_DDM_type_CM_boolean_flg 0 0 0.0 1.0 ECU_ADDRESS 0x0000 /* @ECU_Address@VDDM_MidLvSaChkPass_flg@ */ /end MEASUREMENT
/begin MEASUREMENT VDDM_MidLvSaChkCFSRls_flg "" UBYTE SWC_DDM_type_CM_boolean_flg 0 0 0.0 1.0 ECU_ADDRESS 0x0000 /* @ECU_Address@VDDM_MidLvSaChkCFSRls_flg@ */ /end MEASUREMENT
/begin MEASUREMENT VDDM_MidLvSaChkDet_flg "" UBYTE SWC_DDM_type_CM_boolean_flg 0 0 0.0 1.0 ECU_ADDRESS 0x0000 /* @ECU_Address@VDDM_MidLvSaChkDet_flg@ */ /end MEASUREMENT
/begin MEASUREMENT VDDM_MidLvSaChkCFS_flg "" UBYTE SWC_DDM_type_CM_boolean_flg 0 0 0.0 1.0 ECU_ADDRESS 0x0000 /* @ECU_Address@VDDM_MidLvSaChkCFS_flg@ */ /end MEASUREMENT
/begin MEASUREMENT VDDM_MCUDisPass_flg "" UBYTE SWC_DDM_type_CM_boolean_flg 0 0 0.0 1.0 ECU_ADDRESS 0x0000 /* @ECU_Address@VDDM_MCUDisPass_flg@ */ /end MEASUREMENT
/begin MEASUREMENT VDDM_MCUDisCFSRls_flg "" UBYTE SWC_DDM_type_CM_boolean_flg 0 0 0.0 1.0 ECU_ADDRESS 0x0000 /* @ECU_Address@VDDM_MCUDisCFSRls_flg@ */ /end MEASUREMENT
/begin MEASUREMENT VDDM_MCUDisDet_flg "" UBYTE SWC_DDM_type_CM_boolean_flg 0 0 0.0 1.0 ECU_ADDRESS 0x0000 /* @ECU_Address@VDDM_MCUDisDet_flg@ */ /end MEASUREMENT
/begin MEASUREMENT VDDM_MCUDisCFS_flg "" UBYTE SWC_DDM_type_CM_boolean_flg 0 0 0.0 1.0 ECU_ADDRESS 0x0000 /* @ECU_Address@VDDM_MCUDisCFS_flg@ */ /end MEASUREMENT
/begin MEASUREMENT VDDM_DCDCDisPass_flg "" UBYTE SWC_DDM_type_CM_boolean_flg 0 0 0.0 1.0 ECU_ADDRESS 0x0000 /* @ECU_Address@VDDM_DCDCDisPass_flg@ */ /end MEASUREMENT
/begin MEASUREMENT VDDM_DCDCDisCFSRls_flg "" UBYTE SWC_DDM_type_CM_boolean_flg 0 0 0.0 1.0 ECU_ADDRESS 0x0000 /* @ECU_Address@VDDM_DCDCDisCFSRls_flg@ */ /end MEASUREMENT
/begin MEASUREMENT VDDM_DCDCDisDet_flg "" UBYTE SWC_DDM_type_CM_boolean_flg 0 0 0.0 1.0 ECU_ADDRESS 0x0000 /* @ECU_Address@VDDM_DCDCDisDet_flg@ */ /end MEASUREMENT
/begin MEASUREMENT VDDM_DCDCDisCFS_flg "" UBYTE SWC_DDM_type_CM_boolean_flg 0 0 0.0 1.0 ECU_ADDRESS 0x0000 /* @ECU_Address@VDDM_DCDCDisCFS_flg@ */ /end MEASUREMENT
/begin MEASUREMENT VDDM_HVRlyOpPass_flg "" UBYTE SWC_DDM_type_CM_boolean_flg 0 0 0.0 1.0 ECU_ADDRESS 0x0000 /* @ECU_Address@VDDM_HVRlyOpPass_flg@ */ /end MEASUREMENT
/begin MEASUREMENT VDDM_HVRlyOpCFSRls_flg "" UBYTE SWC_DDM_type_CM_boolean_flg 0 0 0.0 1.0 ECU_ADDRESS 0x0000 /* @ECU_Address@VDDM_HVRlyOpCFSRls_flg@ */ /end MEASUREMENT
/begin MEASUREMENT VDDM_HVRlyOpDet_flg "" UBYTE SWC_DDM_type_CM_boolean_flg 0 0 0.0 1.0 ECU_ADDRESS 0x0000 /* @ECU_Address@VDDM_HVRlyOpDet_flg@ */ /end MEASUREMENT
/begin MEASUREMENT VDDM_HVRlyOpCFS_flg "" UBYTE SWC_DDM_type_CM_boolean_flg 0 0 0.0 1.0 ECU_ADDRESS 0x0000 /* @ECU_Address@VDDM_HVRlyOpCFS_flg@ */ /end MEASUREMENT
/begin MEASUREMENT VDDM_MCUActPass_flg "" UBYTE SWC_DDM_type_CM_boolean_flg 0 0 0.0 1.0 ECU_ADDRESS 0x0000 /* @ECU_Address@VDDM_MCUActPass_flg@ */ /end MEASUREMENT
/begin MEASUREMENT VDDM_MCUActCFSRls_flg "" UBYTE SWC_DDM_type_CM_boolean_flg 0 0 0.0 1.0 ECU_ADDRESS 0x0000 /* @ECU_Address@VDDM_MCUActCFSRls_flg@ */ /end MEASUREMENT
/begin MEASUREMENT VDDM_MCUActDet_flg "" UBYTE SWC_DDM_type_CM_boolean_flg 0 0 0.0 1.0 ECU_ADDRESS 0x0000 /* @ECU_Address@VDDM_MCUActDet_flg@ */ /end MEASUREMENT
/begin MEASUREMENT VDDM_MCUActCFS_flg "" UBYTE SWC_DDM_type_CM_boolean_flg 0 0 0.0 1.0 ECU_ADDRESS 0x0000 /* @ECU_Address@VDDM_MCUActCFS_flg@ */ /end MEASUREMENT
/begin MEASUREMENT VDDM_OBC4PrePass_flg "" UBYTE SWC_DDM_type_CM_boolean_flg 0 0 0.0 1.0 ECU_ADDRESS 0x0000 /* @ECU_Address@VDDM_OBC4PrePass_flg@ */ /end MEASUREMENT
/begin MEASUREMENT VDDM_OBC4PreCFSRls_flg "" UBYTE SWC_DDM_type_CM_boolean_flg 0 0 0.0 1.0 ECU_ADDRESS 0x0000 /* @ECU_Address@VDDM_OBC4PreCFSRls_flg@ */ /end MEASUREMENT
/begin MEASUREMENT VDDM_OBC4PreDet_flg "" UBYTE SWC_DDM_type_CM_boolean_flg 0 0 0.0 1.0 ECU_ADDRESS 0x0000 /* @ECU_Address@VDDM_OBC4PreDet_flg@ */ /end MEASUREMENT
/begin MEASUREMENT VDDM_OBC4PreCFS_flg "" UBYTE SWC_DDM_type_CM_boolean_flg 0 0 0.0 1.0 ECU_ADDRESS 0x0000 /* @ECU_Address@VDDM_OBC4PreCFS_flg@ */ /end MEASUREMENT
/begin MEASUREMENT VDDM_IniLVLoDet_flg "" UBYTE SWC_DDM_type_CM_boolean_flg 0 0 0.0 1.0 ECU_ADDRESS 0x0000 /* @ECU_Address@VDDM_IniLVLoDet_flg@ */ /end MEASUREMENT
/begin MEASUREMENT VDDM_IniLVLoCFS_flg "" UBYTE SWC_DDM_type_CM_boolean_flg 0 0 0.0 1.0 ECU_ADDRESS 0x0000 /* @ECU_Address@VDDM_IniLVLoCFS_flg@ */ /end MEASUREMENT
/begin MEASUREMENT VDDM_LVSupLoDet_flg "" UBYTE SWC_DDM_type_CM_boolean_flg 0 0 0.0 1.0 ECU_ADDRESS 0x0000 /* @ECU_Address@VDDM_LVSupLoDet_flg@ */ /end MEASUREMENT
/begin MEASUREMENT VDDM_LVSupLoCFS_flg "" UBYTE SWC_DDM_type_CM_boolean_flg 0 0 0.0 1.0 ECU_ADDRESS 0x0000 /* @ECU_Address@VDDM_LVSupLoCFS_flg@ */ /end MEASUREMENT
/begin MEASUREMENT VDDM_LVSupHiDet_flg "" UBYTE SWC_DDM_type_CM_boolean_flg 0 0 0.0 1.0 ECU_ADDRESS 0x0000 /* @ECU_Address@VDDM_LVSupHiDet_flg@ */ /end MEASUREMENT
/begin MEASUREMENT VDDM_LVSupHiCFS_flg "" UBYTE SWC_DDM_type_CM_boolean_flg 0 0 0.0 1.0 ECU_ADDRESS 0x0000 /* @ECU_Address@VDDM_LVSupHiCFS_flg@ */ /end MEASUREMENT
/begin MEASUREMENT VDDM_LVInErrDet_flg "" UBYTE SWC_DDM_type_CM_boolean_flg 0 0 0.0 1.0 ECU_ADDRESS 0x0000 /* @ECU_Address@VDDM_LVInErrDet_flg@ */ /end MEASUREMENT
/begin MEASUREMENT VDDM_LVInErrCFS_flg "" UBYTE SWC_DDM_type_CM_boolean_flg 0 0 0.0 1.0 ECU_ADDRESS 0x0000 /* @ECU_Address@VDDM_LVInErrCFS_flg@ */ /end MEASUREMENT
/begin MEASUREMENT VDDM_DrStSWDet_flg "" UBYTE SWC_DDM_type_CM_boolean_flg 0 0 0.0 1.0 ECU_ADDRESS 0x0000 /* @ECU_Address@VDDM_DrStSWDet_flg@ */ /end MEASUREMENT
/begin MEASUREMENT VDDM_DrStSWCFS_flg "" UBYTE SWC_DDM_type_CM_boolean_flg 0 0 0.0 1.0 ECU_ADDRESS 0x0000 /* @ECU_Address@VDDM_DrStSWCFS_flg@ */ /end MEASUREMENT
/begin MEASUREMENT VDDM_5vAPS1OoRDet_flg "" UBYTE SWC_DDM_type_CM_boolean_flg 0 0 0.0 1.0 ECU_ADDRESS 0x0000 /* @ECU_Address@VDDM_5vAPS1OoRDet_flg@ */ /end MEASUREMENT
/begin MEASUREMENT VDDM_5vAPS1OoRCFS_flg "" UBYTE SWC_DDM_type_CM_boolean_flg 0 0 0.0 1.0 ECU_ADDRESS 0x0000 /* @ECU_Address@VDDM_5vAPS1OoRCFS_flg@ */ /end MEASUREMENT
/begin MEASUREMENT VDDM_5vAPS2OoRDet_flg "" UBYTE SWC_DDM_type_CM_boolean_flg 0 0 0.0 1.0 ECU_ADDRESS 0x0000 /* @ECU_Address@VDDM_5vAPS2OoRDet_flg@ */ /end MEASUREMENT
/begin MEASUREMENT VDDM_5vAPS2OoRCFS_flg "" UBYTE SWC_DDM_type_CM_boolean_flg 0 0 0.0 1.0 ECU_ADDRESS 0x0000 /* @ECU_Address@VDDM_5vAPS2OoRCFS_flg@ */ /end MEASUREMENT
/begin MEASUREMENT VDDM_EPB1NoComDet_flg "" UBYTE SWC_DDM_type_CM_boolean_flg 0 0 0.0 1.0 ECU_ADDRESS 0x0000 /* @ECU_Address@VDDM_EPB1NoComDet_flg@ */ /end MEASUREMENT
/begin MEASUREMENT VDDM_EPB1NoComCFS_flg "" UBYTE SWC_DDM_type_CM_boolean_flg 0 0 0.0 1.0 ECU_ADDRESS 0x0000 /* @ECU_Address@VDDM_EPB1NoComCFS_flg@ */ /end MEASUREMENT
/begin MEASUREMENT VDDM_EPB1RCErrDet_flg "" UBYTE SWC_DDM_type_CM_boolean_flg 0 0 0.0 1.0 ECU_ADDRESS 0x0000 /* @ECU_Address@VDDM_EPB1RCErrDet_flg@ */ /end MEASUREMENT
/begin MEASUREMENT VDDM_EPB1RCErrCFS_flg "" UBYTE SWC_DDM_type_CM_boolean_flg 0 0 0.0 1.0 ECU_ADDRESS 0x0000 /* @ECU_Address@VDDM_EPB1RCErrCFS_flg@ */ /end MEASUREMENT
/begin MEASUREMENT VDDM_EPB1CSErrDet_flg "" UBYTE SWC_DDM_type_CM_boolean_flg 0 0 0.0 1.0 ECU_ADDRESS 0x0000 /* @ECU_Address@VDDM_EPB1CSErrDet_flg@ */ /end MEASUREMENT
/begin MEASUREMENT VDDM_EPB1CSErrCFS_flg "" UBYTE SWC_DDM_type_CM_boolean_flg 0 0 0.0 1.0 ECU_ADDRESS 0x0000 /* @ECU_Address@VDDM_EPB1CSErrCFS_flg@ */ /end MEASUREMENT
/begin MEASUREMENT VDDM_EPBUnlockTOPass_flg "" UBYTE SWC_DDM_type_CM_boolean_flg 0 0 0.0 1.0 ECU_ADDRESS 0x0000 /* @ECU_Address@VDDM_EPBUnlockTOPass_flg@ */ /end MEASUREMENT
/begin MEASUREMENT VDDM_EPBUnlockTODet_flg "" UBYTE SWC_DDM_type_CM_boolean_flg 0 0 0.0 1.0 ECU_ADDRESS 0x0000 /* @ECU_Address@VDDM_EPBUnlockTODet_flg@ */ /end MEASUREMENT
/begin MEASUREMENT VDDM_EPBUnlockTOCFS_flg "" UBYTE SWC_DDM_type_CM_boolean_flg 0 0 0.0 1.0 ECU_ADDRESS 0x0000 /* @ECU_Address@VDDM_EPBUnlockTOCFS_flg@ */ /end MEASUREMENT
/begin MEASUREMENT VDDM_EPBLockTOPass_flg "" UBYTE SWC_DDM_type_CM_boolean_flg 0 0 0.0 1.0 ECU_ADDRESS 0x0000 /* @ECU_Address@VDDM_EPBLockTOPass_flg@ */ /end MEASUREMENT
/begin MEASUREMENT VDDM_EPBLockTODet_flg "" UBYTE SWC_DDM_type_CM_boolean_flg 0 0 0.0 1.0 ECU_ADDRESS 0x0000 /* @ECU_Address@VDDM_EPBLockTODet_flg@ */ /end MEASUREMENT
/begin MEASUREMENT VDDM_EPBLockTOCFS_flg "" UBYTE SWC_DDM_type_CM_boolean_flg 0 0 0.0 1.0 ECU_ADDRESS 0x0000 /* @ECU_Address@VDDM_EPBLockTOCFS_flg@ */ /end MEASUREMENT
/begin MEASUREMENT VDDM_APS1SigOoRDet_flg "" UBYTE SWC_DDM_type_CM_boolean_flg 0 0 0.0 1.0 ECU_ADDRESS 0x0000 /* @ECU_Address@VDDM_APS1SigOoRDet_flg@ */ /end MEASUREMENT
/begin MEASUREMENT VDDM_APS1SigOoRCFS_flg "" UBYTE SWC_DDM_type_CM_boolean_flg 0 0 0.0 1.0 ECU_ADDRESS 0x0000 /* @ECU_Address@VDDM_APS1SigOoRCFS_flg@ */ /end MEASUREMENT
/begin MEASUREMENT VDDM_APS2SigOoRDet_flg "" UBYTE SWC_DDM_type_CM_boolean_flg 0 0 0.0 1.0 ECU_ADDRESS 0x0000 /* @ECU_Address@VDDM_APS2SigOoRDet_flg@ */ /end MEASUREMENT
/begin MEASUREMENT VDDM_APS2SigOoRCFS_flg "" UBYTE SWC_DDM_type_CM_boolean_flg 0 0 0.0 1.0 ECU_ADDRESS 0x0000 /* @ECU_Address@VDDM_APS2SigOoRCFS_flg@ */ /end MEASUREMENT
/begin MEASUREMENT VDDM_APSCorrErrDet_flg "" UBYTE SWC_DDM_type_CM_boolean_flg 0 0 0.0 1.0 ECU_ADDRESS 0x0000 /* @ECU_Address@VDDM_APSCorrErrDet_flg@ */ /end MEASUREMENT
/begin MEASUREMENT VDDM_APSCorrErrCFS_flg "" UBYTE SWC_DDM_type_CM_boolean_flg 0 0 0.0 1.0 ECU_ADDRESS 0x0000 /* @ECU_Address@VDDM_APSCorrErrCFS_flg@ */ /end MEASUREMENT
/begin MEASUREMENT VDDM_FCM1NoComPass_flg "" UBYTE SWC_DDM_type_CM_boolean_flg 0 0 0.0 1.0 ECU_ADDRESS 0x0000 /* @ECU_Address@VDDM_FCM1NoComPass_flg@ */ /end MEASUREMENT
/begin MEASUREMENT VDDM_FCM1NoComCFSRls_flg "" UBYTE SWC_DDM_type_CM_boolean_flg 0 0 0.0 1.0 ECU_ADDRESS 0x0000 /* @ECU_Address@VDDM_FCM1NoComCFSRls_flg@ */ /end MEASUREMENT
/begin MEASUREMENT VDDM_FCM1NoComDet_flg "" UBYTE SWC_DDM_type_CM_boolean_flg 0 0 0.0 1.0 ECU_ADDRESS 0x0000 /* @ECU_Address@VDDM_FCM1NoComDet_flg@ */ /end MEASUREMENT
/begin MEASUREMENT VDDM_FCM1NoComCFS_flg "" UBYTE SWC_DDM_type_CM_boolean_flg 0 0 0.0 1.0 ECU_ADDRESS 0x0000 /* @ECU_Address@VDDM_FCM1NoComCFS_flg@ */ /end MEASUREMENT
/begin MEASUREMENT VDDM_FCM1RCErrPass_flg "" UBYTE SWC_DDM_type_CM_boolean_flg 0 0 0.0 1.0 ECU_ADDRESS 0x0000 /* @ECU_Address@VDDM_FCM1RCErrPass_flg@ */ /end MEASUREMENT
/begin MEASUREMENT VDDM_FCM1RCErrCFSRls_flg "" UBYTE SWC_DDM_type_CM_boolean_flg 0 0 0.0 1.0 ECU_ADDRESS 0x0000 /* @ECU_Address@VDDM_FCM1RCErrCFSRls_flg@ */ /end MEASUREMENT
/begin MEASUREMENT VDDM_FCM1RCErrDet_flg "" UBYTE SWC_DDM_type_CM_boolean_flg 0 0 0.0 1.0 ECU_ADDRESS 0x0000 /* @ECU_Address@VDDM_FCM1RCErrDet_flg@ */ /end MEASUREMENT
/begin MEASUREMENT VDDM_FCM1RCErrCFS_flg "" UBYTE SWC_DDM_type_CM_boolean_flg 0 0 0.0 1.0 ECU_ADDRESS 0x0000 /* @ECU_Address@VDDM_FCM1RCErrCFS_flg@ */ /end MEASUREMENT
/begin MEASUREMENT VDDM_FCM1CSErrPass_flg "" UBYTE SWC_DDM_type_CM_boolean_flg 0 0 0.0 1.0 ECU_ADDRESS 0x0000 /* @ECU_Address@VDDM_FCM1CSErrPass_flg@ */ /end MEASUREMENT
/begin MEASUREMENT VDDM_FCM1CSErrCFSRls_flg "" UBYTE SWC_DDM_type_CM_boolean_flg 0 0 0.0 1.0 ECU_ADDRESS 0x0000 /* @ECU_Address@VDDM_FCM1CSErrCFSRls_flg@ */ /end MEASUREMENT
/begin MEASUREMENT VDDM_FCM1CSErrDet_flg "" UBYTE SWC_DDM_type_CM_boolean_flg 0 0 0.0 1.0 ECU_ADDRESS 0x0000 /* @ECU_Address@VDDM_FCM1CSErrDet_flg@ */ /end MEASUREMENT
/begin MEASUREMENT VDDM_FCM1CSErrCFS_flg "" UBYTE SWC_DDM_type_CM_boolean_flg 0 0 0.0 1.0 ECU_ADDRESS 0x0000 /* @ECU_Address@VDDM_FCM1CSErrCFS_flg@ */ /end MEASUREMENT
/begin MEASUREMENT VDDM_BMSSigErrPass_flg "" UBYTE SWC_DDM_type_CM_boolean_flg 0 0 0.0 1.0 ECU_ADDRESS 0x0000 /* @ECU_Address@VDDM_BMSSigErrPass_flg@ */ /end MEASUREMENT
/begin MEASUREMENT VDDM_BMSSigErrCFSRls_flg "" UBYTE SWC_DDM_type_CM_boolean_flg 0 0 0.0 1.0 ECU_ADDRESS 0x0000 /* @ECU_Address@VDDM_BMSSigErrCFSRls_flg@ */ /end MEASUREMENT
/begin MEASUREMENT VDDM_BMSSigErrDet_flg "" UBYTE SWC_DDM_type_CM_boolean_flg 0 0 0.0 1.0 ECU_ADDRESS 0x0000 /* @ECU_Address@VDDM_BMSSigErrDet_flg@ */ /end MEASUREMENT
/begin MEASUREMENT VDDM_BMSSigErrCFS_flg "" UBYTE SWC_DDM_type_CM_boolean_flg 0 0 0.0 1.0 ECU_ADDRESS 0x0000 /* @ECU_Address@VDDM_BMSSigErrCFS_flg@ */ /end MEASUREMENT
/begin MEASUREMENT VDDM_FCMACCSigErrPass_flg "" UBYTE SWC_DDM_type_CM_boolean_flg 0 0 0.0 1.0 ECU_ADDRESS 0x0000 /* @ECU_Address@VDDM_FCMACCSigErrPass_flg@ */ /end MEASUREMENT
/begin MEASUREMENT VDDM_FCMACCSigErrCFSRls_flg "" UBYTE SWC_DDM_type_CM_boolean_flg 0 0 0.0 1.0 ECU_ADDRESS 0x0000 /* @ECU_Address@VDDM_FCMACCSigErrCFSRls_flg@ */ /end MEASUREMENT
/begin MEASUREMENT VDDM_FCMACCSigErrDet_flg "" UBYTE SWC_DDM_type_CM_boolean_flg 0 0 0.0 1.0 ECU_ADDRESS 0x0000 /* @ECU_Address@VDDM_FCMACCSigErrDet_flg@ */ /end MEASUREMENT
/begin MEASUREMENT VDDM_FCMACCSigErrCFS_flg "" UBYTE SWC_DDM_type_CM_boolean_flg 0 0 0.0 1.0 ECU_ADDRESS 0x0000 /* @ECU_Address@VDDM_FCMACCSigErrCFS_flg@ */ /end MEASUREMENT
/begin MEASUREMENT VDDM_CCUSigErrPass_flg "" UBYTE SWC_DDM_type_CM_boolean_flg 0 0 0.0 1.0 ECU_ADDRESS 0x0000 /* @ECU_Address@VDDM_CCUSigErrPass_flg@ */ /end MEASUREMENT
/begin MEASUREMENT VDDM_CCUSigErrCFSRls_flg "" UBYTE SWC_DDM_type_CM_boolean_flg 0 0 0.0 1.0 ECU_ADDRESS 0x0000 /* @ECU_Address@VDDM_CCUSigErrCFSRls_flg@ */ /end MEASUREMENT
/begin MEASUREMENT VDDM_CCUSigErrDet_flg "" UBYTE SWC_DDM_type_CM_boolean_flg 0 0 0.0 1.0 ECU_ADDRESS 0x0000 /* @ECU_Address@VDDM_CCUSigErrDet_flg@ */ /end MEASUREMENT
/begin MEASUREMENT VDDM_CCUSigErrCFS_flg "" UBYTE SWC_DDM_type_CM_boolean_flg 0 0 0.0 1.0 ECU_ADDRESS 0x0000 /* @ECU_Address@VDDM_CCUSigErrCFS_flg@ */ /end MEASUREMENT
/begin MEASUREMENT VDDM_ACCAccelCmdErrPass_flg "" UBYTE SWC_DDM_type_CM_boolean_flg 0 0 0.0 1.0 ECU_ADDRESS 0x0000 /* @ECU_Address@VDDM_ACCAccelCmdErrPass_flg@ */ /end MEASUREMENT
/begin MEASUREMENT VDDM_ACCAccelCmdErrCFSRls_flg "" UBYTE SWC_DDM_type_CM_boolean_flg 0 0 0.0 1.0 ECU_ADDRESS 0x0000 /* @ECU_Address@VDDM_ACCAccelCmdErrCFSRls_flg@ */ /end MEASUREMENT
/begin MEASUREMENT VDDM_ACCAccelCmdErrDet_flg "" UBYTE SWC_DDM_type_CM_boolean_flg 0 0 0.0 1.0 ECU_ADDRESS 0x0000 /* @ECU_Address@VDDM_ACCAccelCmdErrDet_flg@ */ /end MEASUREMENT
/begin MEASUREMENT VDDM_ACCAccelCmdErrCFS_flg "" UBYTE SWC_DDM_type_CM_boolean_flg 0 0 0.0 1.0 ECU_ADDRESS 0x0000 /* @ECU_Address@VDDM_ACCAccelCmdErrCFS_flg@ */ /end MEASUREMENT
/begin MEASUREMENT VDDM_ESCSigErrPass_flg "" UBYTE SWC_DDM_type_CM_boolean_flg 0 0 0.0 1.0 ECU_ADDRESS 0x0000 /* @ECU_Address@VDDM_ESCSigErrPass_flg@ */ /end MEASUREMENT
/begin MEASUREMENT VDDM_ESCSigErrCFSRls_flg "" UBYTE SWC_DDM_type_CM_boolean_flg 0 0 0.0 1.0 ECU_ADDRESS 0x0000 /* @ECU_Address@VDDM_ESCSigErrCFSRls_flg@ */ /end MEASUREMENT
/begin MEASUREMENT VDDM_ESCSigErrDet_flg "" UBYTE SWC_DDM_type_CM_boolean_flg 0 0 0.0 1.0 ECU_ADDRESS 0x0000 /* @ECU_Address@VDDM_ESCSigErrDet_flg@ */ /end MEASUREMENT
/begin MEASUREMENT VDDM_ESCSigErrCFS_flg "" UBYTE SWC_DDM_type_CM_boolean_flg 0 0 0.0 1.0 ECU_ADDRESS 0x0000 /* @ECU_Address@VDDM_ESCSigErrCFS_flg@ */ /end MEASUREMENT
/begin MEASUREMENT VDDM_ShifterSigErrPass_flg "" UBYTE SWC_DDM_type_CM_boolean_flg 0 0 0.0 1.0 ECU_ADDRESS 0x0000 /* @ECU_Address@VDDM_ShifterSigErrPass_flg@ */ /end MEASUREMENT
/begin MEASUREMENT VDDM_ShifterSigErrCFSRls_flg "" UBYTE SWC_DDM_type_CM_boolean_flg 0 0 0.0 1.0 ECU_ADDRESS 0x0000 /* @ECU_Address@VDDM_ShifterSigErrCFSRls_flg@ */ /end MEASUREMENT
/begin MEASUREMENT VDDM_ShifterSigErrDet_flg "" UBYTE SWC_DDM_type_CM_boolean_flg 0 0 0.0 1.0 ECU_ADDRESS 0x0000 /* @ECU_Address@VDDM_ShifterSigErrDet_flg@ */ /end MEASUREMENT
/begin MEASUREMENT VDDM_ShifterSigErrCFS_flg "" UBYTE SWC_DDM_type_CM_boolean_flg 0 0 0.0 1.0 ECU_ADDRESS 0x0000 /* @ECU_Address@VDDM_ShifterSigErrCFS_flg@ */ /end MEASUREMENT
/begin MEASUREMENT VDDM_ZoneDrSigErrPass_flg "" UBYTE SWC_DDM_type_CM_boolean_flg 0 0 0.0 1.0 ECU_ADDRESS 0x0000 /* @ECU_Address@VDDM_ZoneDrSigErrPass_flg@ */ /end MEASUREMENT
/begin MEASUREMENT VDDM_ZoneDrSigErrCFSRls_flg "" UBYTE SWC_DDM_type_CM_boolean_flg 0 0 0.0 1.0 ECU_ADDRESS 0x0000 /* @ECU_Address@VDDM_ZoneDrSigErrCFSRls_flg@ */ /end MEASUREMENT
/begin MEASUREMENT VDDM_ZoneDrSigErrDet_flg "" UBYTE SWC_DDM_type_CM_boolean_flg 0 0 0.0 1.0 ECU_ADDRESS 0x0000 /* @ECU_Address@VDDM_ZoneDrSigErrDet_flg@ */ /end MEASUREMENT
/begin MEASUREMENT VDDM_ZoneDrSigErrCFS_flg "" UBYTE SWC_DDM_type_CM_boolean_flg 0 0 0.0 1.0 ECU_ADDRESS 0x0000 /* @ECU_Address@VDDM_ZoneDrSigErrCFS_flg@ */ /end MEASUREMENT
/begin MEASUREMENT VDDM_ZoneFrSigErrPass_flg "" UBYTE SWC_DDM_type_CM_boolean_flg 0 0 0.0 1.0 ECU_ADDRESS 0x0000 /* @ECU_Address@VDDM_ZoneFrSigErrPass_flg@ */ /end MEASUREMENT
/begin MEASUREMENT VDDM_ZoneFrSigErrCFSRls_flg "" UBYTE SWC_DDM_type_CM_boolean_flg 0 0 0.0 1.0 ECU_ADDRESS 0x0000 /* @ECU_Address@VDDM_ZoneFrSigErrCFSRls_flg@ */ /end MEASUREMENT
/begin MEASUREMENT VDDM_ZoneFrSigErrDet_flg "" UBYTE SWC_DDM_type_CM_boolean_flg 0 0 0.0 1.0 ECU_ADDRESS 0x0000 /* @ECU_Address@VDDM_ZoneFrSigErrDet_flg@ */ /end MEASUREMENT
/begin MEASUREMENT VDDM_ZoneFrSigErrCFS_flg "" UBYTE SWC_DDM_type_CM_boolean_flg 0 0 0.0 1.0 ECU_ADDRESS 0x0000 /* @ECU_Address@VDDM_ZoneFrSigErrCFS_flg@ */ /end MEASUREMENT
/begin MEASUREMENT VDDM_FrMCUSigErrPass_flg "" UBYTE SWC_DDM_type_CM_boolean_flg 0 0 0.0 1.0 ECU_ADDRESS 0x0000 /* @ECU_Address@VDDM_FrMCUSigErrPass_flg@ */ /end MEASUREMENT
/begin MEASUREMENT VDDM_FrMCUSigErrCFSRls_flg "" UBYTE SWC_DDM_type_CM_boolean_flg 0 0 0.0 1.0 ECU_ADDRESS 0x0000 /* @ECU_Address@VDDM_FrMCUSigErrCFSRls_flg@ */ /end MEASUREMENT
/begin MEASUREMENT VDDM_FrMCUSigErrDet_flg "" UBYTE SWC_DDM_type_CM_boolean_flg 0 0 0.0 1.0 ECU_ADDRESS 0x0000 /* @ECU_Address@VDDM_FrMCUSigErrDet_flg@ */ /end MEASUREMENT
/begin MEASUREMENT VDDM_FrMCUSigErrCFS_flg "" UBYTE SWC_DDM_type_CM_boolean_flg 0 0 0.0 1.0 ECU_ADDRESS 0x0000 /* @ECU_Address@VDDM_FrMCUSigErrCFS_flg@ */ /end MEASUREMENT
/begin MEASUREMENT VDDM_RrMCUSigErrPass_flg "" UBYTE SWC_DDM_type_CM_boolean_flg 0 0 0.0 1.0 ECU_ADDRESS 0x0000 /* @ECU_Address@VDDM_RrMCUSigErrPass_flg@ */ /end MEASUREMENT
/begin MEASUREMENT VDDM_RrMCUSigErrCFSRls_flg "" UBYTE SWC_DDM_type_CM_boolean_flg 0 0 0.0 1.0 ECU_ADDRESS 0x0000 /* @ECU_Address@VDDM_RrMCUSigErrCFSRls_flg@ */ /end MEASUREMENT
/begin MEASUREMENT VDDM_RrMCUSigErrDet_flg "" UBYTE SWC_DDM_type_CM_boolean_flg 0 0 0.0 1.0 ECU_ADDRESS 0x0000 /* @ECU_Address@VDDM_RrMCUSigErrDet_flg@ */ /end MEASUREMENT
/begin MEASUREMENT VDDM_RrMCUSigErrCFS_flg "" UBYTE SWC_DDM_type_CM_boolean_flg 0 0 0.0 1.0 ECU_ADDRESS 0x0000 /* @ECU_Address@VDDM_RrMCUSigErrCFS_flg@ */ /end MEASUREMENT
/begin MEASUREMENT VDDM_EPBSigErrDet_flg "" UBYTE SWC_DDM_type_CM_boolean_flg 0 0 0.0 1.0 ECU_ADDRESS 0x0000 /* @ECU_Address@VDDM_EPBSigErrDet_flg@ */ /end MEASUREMENT
/begin MEASUREMENT VDDM_EPBSigErrCFS_flg "" UBYTE SWC_DDM_type_CM_boolean_flg 0 0 0.0 1.0 ECU_ADDRESS 0x0000 /* @ECU_Address@VDDM_EPBSigErrCFS_flg@ */ /end MEASUREMENT
/begin MEASUREMENT VDDM_FrMCUNTqErrDet_flg "" UBYTE SWC_DDM_type_CM_boolean_flg 0 0 0.0 1.0 ECU_ADDRESS 0x0000 /* @ECU_Address@VDDM_FrMCUNTqErrDet_flg@ */ /end MEASUREMENT
/begin MEASUREMENT VDDM_FrMCUNTqErrCFS_flg "" UBYTE SWC_DDM_type_CM_boolean_flg 0 0 0.0 1.0 ECU_ADDRESS 0x0000 /* @ECU_Address@VDDM_FrMCUNTqErrCFS_flg@ */ /end MEASUREMENT
/begin MEASUREMENT VDDM_RrMCUNTqErrDet_flg "" UBYTE SWC_DDM_type_CM_boolean_flg 0 0 0.0 1.0 ECU_ADDRESS 0x0000 /* @ECU_Address@VDDM_RrMCUNTqErrDet_flg@ */ /end MEASUREMENT
/begin MEASUREMENT VDDM_RrMCUNTqErrCFS_flg "" UBYTE SWC_DDM_type_CM_boolean_flg 0 0 0.0 1.0 ECU_ADDRESS 0x0000 /* @ECU_Address@VDDM_RrMCUNTqErrCFS_flg@ */ /end MEASUREMENT
/begin MEASUREMENT VDDM_LFBatwarnDet_flg "" UBYTE SWC_DDM_type_CM_boolean_flg 0 0 0.0 1.0 ECU_ADDRESS 0x0000 /* @ECU_Address@VDDM_LFBatwarnDet_flg@ */ /end MEASUREMENT
/begin MEASUREMENT VDDM_RFBatwarnDet_flg "" UBYTE SWC_DDM_type_CM_boolean_flg 0 0 0.0 1.0 ECU_ADDRESS 0x0000 /* @ECU_Address@VDDM_RFBatwarnDet_flg@ */ /end MEASUREMENT
/begin MEASUREMENT VDDM_LRBatwarnDet_flg "" UBYTE SWC_DDM_type_CM_boolean_flg 0 0 0.0 1.0 ECU_ADDRESS 0x0000 /* @ECU_Address@VDDM_LRBatwarnDet_flg@ */ /end MEASUREMENT
/begin MEASUREMENT VDDM_RRBatwarnDet_flg "" UBYTE SWC_DDM_type_CM_boolean_flg 0 0 0.0 1.0 ECU_ADDRESS 0x0000 /* @ECU_Address@VDDM_RRBatwarnDet_flg@ */ /end MEASUREMENT
/begin MEASUREMENT VDDM_LFPressIndiDet_flg "" UBYTE SWC_DDM_type_CM_boolean_flg 0 0 0.0 1.0 ECU_ADDRESS 0x0000 /* @ECU_Address@VDDM_LFPressIndiDet_flg@ */ /end MEASUREMENT
/begin MEASUREMENT VDDM_RFPressIndiDet_flg "" UBYTE SWC_DDM_type_CM_boolean_flg 0 0 0.0 1.0 ECU_ADDRESS 0x0000 /* @ECU_Address@VDDM_RFPressIndiDet_flg@ */ /end MEASUREMENT
/begin MEASUREMENT VDDM_LRPressIndiDet_flg "" UBYTE SWC_DDM_type_CM_boolean_flg 0 0 0.0 1.0 ECU_ADDRESS 0x0000 /* @ECU_Address@VDDM_LRPressIndiDet_flg@ */ /end MEASUREMENT
/begin MEASUREMENT VDDM_RRPressIndiDet_flg "" UBYTE SWC_DDM_type_CM_boolean_flg 0 0 0.0 1.0 ECU_ADDRESS 0x0000 /* @ECU_Address@VDDM_RRPressIndiDet_flg@ */ /end MEASUREMENT
/begin MEASUREMENT VDDM_LFWheelTmpHighDet_flg "" UBYTE SWC_DDM_type_CM_boolean_flg 0 0 0.0 1.0 ECU_ADDRESS 0x0000 /* @ECU_Address@VDDM_LFWheelTmpHighDet_flg@ */ /end MEASUREMENT
/begin MEASUREMENT VDDM_RFWheelTmpHighDet_flg "" UBYTE SWC_DDM_type_CM_boolean_flg 0 0 0.0 1.0 ECU_ADDRESS 0x0000 /* @ECU_Address@VDDM_RFWheelTmpHighDet_flg@ */ /end MEASUREMENT
/begin MEASUREMENT VDDM_LRWheelTmpHighDet_flg "" UBYTE SWC_DDM_type_CM_boolean_flg 0 0 0.0 1.0 ECU_ADDRESS 0x0000 /* @ECU_Address@VDDM_LRWheelTmpHighDet_flg@ */ /end MEASUREMENT
/begin MEASUREMENT VDDM_RRWheelTmpHighDet_flg "" UBYTE SWC_DDM_type_CM_boolean_flg 0 0 0.0 1.0 ECU_ADDRESS 0x0000 /* @ECU_Address@VDDM_RRWheelTmpHighDet_flg@ */ /end MEASUREMENT
/begin MEASUREMENT VDDM_LFSensorFailDet_flg "" UBYTE SWC_DDM_type_CM_boolean_flg 0 0 0.0 1.0 ECU_ADDRESS 0x0000 /* @ECU_Address@VDDM_LFSensorFailDet_flg@ */ /end MEASUREMENT
/begin MEASUREMENT VDDM_RFSensorFailDet_flg "" UBYTE SWC_DDM_type_CM_boolean_flg 0 0 0.0 1.0 ECU_ADDRESS 0x0000 /* @ECU_Address@VDDM_RFSensorFailDet_flg@ */ /end MEASUREMENT
/begin MEASUREMENT VDDM_LRSensorFailDet_flg "" UBYTE SWC_DDM_type_CM_boolean_flg 0 0 0.0 1.0 ECU_ADDRESS 0x0000 /* @ECU_Address@VDDM_LRSensorFailDet_flg@ */ /end MEASUREMENT
/begin MEASUREMENT VDDM_RRSensorFailDet_flg "" UBYTE SWC_DDM_type_CM_boolean_flg 0 0 0.0 1.0 ECU_ADDRESS 0x0000 /* @ECU_Address@VDDM_RRSensorFailDet_flg@ */ /end MEASUREMENT
/begin MEASUREMENT VDDM_RegenErrDet_flg "" UBYTE SWC_DDM_type_CM_boolean_flg 0 0 0.0 1.0 ECU_ADDRESS 0x0000 /* @ECU_Address@VDDM_RegenErrDet_flg@ */ /end MEASUREMENT
/begin MEASUREMENT VDDM_RegenErrCFS_flg "" UBYTE SWC_DDM_type_CM_boolean_flg 0 0 0.0 1.0 ECU_ADDRESS 0x0000 /* @ECU_Address@VDDM_RegenErrCFS_flg@ */ /end MEASUREMENT
/begin MEASUREMENT VDDM_RrMCUSigErrDFS_flg "" UBYTE SWC_DDM_type_CM_boolean_flg 0 0 0.0 1.0 ECU_ADDRESS 0x0000 /* @ECU_Address@VDDM_RrMCUSigErrDFS_flg@ */ /end MEASUREMENT
/begin MEASUREMENT VDDM_FrMCUSigErrDFS_flg "" UBYTE SWC_DDM_type_CM_boolean_flg 0 0 0.0 1.0 ECU_ADDRESS 0x0000 /* @ECU_Address@VDDM_FrMCUSigErrDFS_flg@ */ /end MEASUREMENT
/begin MEASUREMENT VDDM_ZoneFrSigErrDFS_flg "" UBYTE SWC_DDM_type_CM_boolean_flg 0 0 0.0 1.0 ECU_ADDRESS 0x0000 /* @ECU_Address@VDDM_ZoneFrSigErrDFS_flg@ */ /end MEASUREMENT
/begin MEASUREMENT VDDM_ZoneDrSigErrDFS_flg "" UBYTE SWC_DDM_type_CM_boolean_flg 0 0 0.0 1.0 ECU_ADDRESS 0x0000 /* @ECU_Address@VDDM_ZoneDrSigErrDFS_flg@ */ /end MEASUREMENT
/begin MEASUREMENT VDDM_ShifterSigErrDFS_flg "" UBYTE SWC_DDM_type_CM_boolean_flg 0 0 0.0 1.0 ECU_ADDRESS 0x0000 /* @ECU_Address@VDDM_ShifterSigErrDFS_flg@ */ /end MEASUREMENT
/begin MEASUREMENT VDDM_ESCSigErrDFS_flg "" UBYTE SWC_DDM_type_CM_boolean_flg 0 0 0.0 1.0 ECU_ADDRESS 0x0000 /* @ECU_Address@VDDM_ESCSigErrDFS_flg@ */ /end MEASUREMENT
/begin MEASUREMENT VDDM_ACCAccelCmdErrDFS_flg "" UBYTE SWC_DDM_type_CM_boolean_flg 0 0 0.0 1.0 ECU_ADDRESS 0x0000 /* @ECU_Address@VDDM_ACCAccelCmdErrDFS_flg@ */ /end MEASUREMENT
/begin MEASUREMENT VDDM_CCUSigErrDFS_flg "" UBYTE SWC_DDM_type_CM_boolean_flg 0 0 0.0 1.0 ECU_ADDRESS 0x0000 /* @ECU_Address@VDDM_CCUSigErrDFS_flg@ */ /end MEASUREMENT
/begin MEASUREMENT VDDM_FCMACCSigErrDFS_flg "" UBYTE SWC_DDM_type_CM_boolean_flg 0 0 0.0 1.0 ECU_ADDRESS 0x0000 /* @ECU_Address@VDDM_FCMACCSigErrDFS_flg@ */ /end MEASUREMENT
/begin MEASUREMENT VDDM_BMSSigErrDFS_flg "" UBYTE SWC_DDM_type_CM_boolean_flg 0 0 0.0 1.0 ECU_ADDRESS 0x0000 /* @ECU_Address@VDDM_BMSSigErrDFS_flg@ */ /end MEASUREMENT
/begin MEASUREMENT VDDM_FCM1CSErrDFS_flg "" UBYTE SWC_DDM_type_CM_boolean_flg 0 0 0.0 1.0 ECU_ADDRESS 0x0000 /* @ECU_Address@VDDM_FCM1CSErrDFS_flg@ */ /end MEASUREMENT
/begin MEASUREMENT VDDM_FCM1RCErrDFS_flg "" UBYTE SWC_DDM_type_CM_boolean_flg 0 0 0.0 1.0 ECU_ADDRESS 0x0000 /* @ECU_Address@VDDM_FCM1RCErrDFS_flg@ */ /end MEASUREMENT
/begin MEASUREMENT VDDM_FCM1NoComDFS_flg "" UBYTE SWC_DDM_type_CM_boolean_flg 0 0 0.0 1.0 ECU_ADDRESS 0x0000 /* @ECU_Address@VDDM_FCM1NoComDFS_flg@ */ /end MEASUREMENT
/begin MEASUREMENT VDDM_OBC4PreDFS_flg "" UBYTE SWC_DDM_type_CM_boolean_flg 0 0 0.0 1.0 ECU_ADDRESS 0x0000 /* @ECU_Address@VDDM_OBC4PreDFS_flg@ */ /end MEASUREMENT
/begin MEASUREMENT VDDM_MCUActDFS_flg "" UBYTE SWC_DDM_type_CM_boolean_flg 0 0 0.0 1.0 ECU_ADDRESS 0x0000 /* @ECU_Address@VDDM_MCUActDFS_flg@ */ /end MEASUREMENT
/begin MEASUREMENT VDDM_HVRlyOpDFS_flg "" UBYTE SWC_DDM_type_CM_boolean_flg 0 0 0.0 1.0 ECU_ADDRESS 0x0000 /* @ECU_Address@VDDM_HVRlyOpDFS_flg@ */ /end MEASUREMENT
/begin MEASUREMENT VDDM_DCDCDisDFS_flg "" UBYTE SWC_DDM_type_CM_boolean_flg 0 0 0.0 1.0 ECU_ADDRESS 0x0000 /* @ECU_Address@VDDM_DCDCDisDFS_flg@ */ /end MEASUREMENT
/begin MEASUREMENT VDDM_MCUDisDFS_flg "" UBYTE SWC_DDM_type_CM_boolean_flg 0 0 0.0 1.0 ECU_ADDRESS 0x0000 /* @ECU_Address@VDDM_MCUDisDFS_flg@ */ /end MEASUREMENT
/begin MEASUREMENT VDDM_MidLvSaChkDFS_flg "" UBYTE SWC_DDM_type_CM_boolean_flg 0 0 0.0 1.0 ECU_ADDRESS 0x0000 /* @ECU_Address@VDDM_MidLvSaChkDFS_flg@ */ /end MEASUREMENT
/begin MEASUREMENT VDDM_HiLvSaChkDFS_flg "" UBYTE SWC_DDM_type_CM_boolean_flg 0 0 0.0 1.0 ECU_ADDRESS 0x0000 /* @ECU_Address@VDDM_HiLvSaChkDFS_flg@ */ /end MEASUREMENT
/begin MEASUREMENT VDDM_DCDCEnaDFS_flg "" UBYTE SWC_DDM_type_CM_boolean_flg 0 0 0.0 1.0 ECU_ADDRESS 0x0000 /* @ECU_Address@VDDM_DCDCEnaDFS_flg@ */ /end MEASUREMENT
/begin MEASUREMENT VDDM_BMSRdyDFS_flg "" UBYTE SWC_DDM_type_CM_boolean_flg 0 0 0.0 1.0 ECU_ADDRESS 0x0000 /* @ECU_Address@VDDM_BMSRdyDFS_flg@ */ /end MEASUREMENT
/begin MEASUREMENT VDDM_HVRlyCloDFS_flg "" UBYTE SWC_DDM_type_CM_boolean_flg 0 0 0.0 1.0 ECU_ADDRESS 0x0000 /* @ECU_Address@VDDM_HVRlyCloDFS_flg@ */ /end MEASUREMENT
/begin MEASUREMENT VDDM_DCDC4PreDFS_flg "" UBYTE SWC_DDM_type_CM_boolean_flg 0 0 0.0 1.0 ECU_ADDRESS 0x0000 /* @ECU_Address@VDDM_DCDC4PreDFS_flg@ */ /end MEASUREMENT
/begin MEASUREMENT VDDM_MCU4PreDFS_flg "" UBYTE SWC_DDM_type_CM_boolean_flg 0 0 0.0 1.0 ECU_ADDRESS 0x0000 /* @ECU_Address@VDDM_MCU4PreDFS_flg@ */ /end MEASUREMENT
/begin MEASUREMENT VDDM_HVB4PreDFS_flg "" UBYTE SWC_DDM_type_CM_boolean_flg 0 0 0.0 1.0 ECU_ADDRESS 0x0000 /* @ECU_Address@VDDM_HVB4PreDFS_flg@ */ /end MEASUREMENT
/begin MEASUREMENT VDDM_EPS1NoComPass_flg "" UBYTE SWC_DDM_type_CM_boolean_flg 0 0 0.0 1.0 ECU_ADDRESS 0x0000 /* @ECU_Address@VDDM_EPS1NoComPass_flg@ */ /end MEASUREMENT
/begin MEASUREMENT VDDM_EPS1NoComCFSRls_flg "" UBYTE SWC_DDM_type_CM_boolean_flg 0 0 0.0 1.0 ECU_ADDRESS 0x0000 /* @ECU_Address@VDDM_EPS1NoComCFSRls_flg@ */ /end MEASUREMENT
/begin MEASUREMENT VDDM_EPS1NoComDet_flg "" UBYTE SWC_DDM_type_CM_boolean_flg 0 0 0.0 1.0 ECU_ADDRESS 0x0000 /* @ECU_Address@VDDM_EPS1NoComDet_flg@ */ /end MEASUREMENT
/begin MEASUREMENT VDDM_EPS1NoComCFS_flg "" UBYTE SWC_DDM_type_CM_boolean_flg 0 0 0.0 1.0 ECU_ADDRESS 0x0000 /* @ECU_Address@VDDM_EPS1NoComCFS_flg@ */ /end MEASUREMENT
/begin MEASUREMENT VDDM_EPS1CSErrPass_flg "" UBYTE SWC_DDM_type_CM_boolean_flg 0 0 0.0 1.0 ECU_ADDRESS 0x0000 /* @ECU_Address@VDDM_EPS1CSErrPass_flg@ */ /end MEASUREMENT
/begin MEASUREMENT VDDM_EPS1CSErrCFSRls_flg "" UBYTE SWC_DDM_type_CM_boolean_flg 0 0 0.0 1.0 ECU_ADDRESS 0x0000 /* @ECU_Address@VDDM_EPS1CSErrCFSRls_flg@ */ /end MEASUREMENT
/begin MEASUREMENT VDDM_EPS1CSErrDet_flg "" UBYTE SWC_DDM_type_CM_boolean_flg 0 0 0.0 1.0 ECU_ADDRESS 0x0000 /* @ECU_Address@VDDM_EPS1CSErrDet_flg@ */ /end MEASUREMENT
/begin MEASUREMENT VDDM_EPS1CSErrCFS_flg "" UBYTE SWC_DDM_type_CM_boolean_flg 0 0 0.0 1.0 ECU_ADDRESS 0x0000 /* @ECU_Address@VDDM_EPS1CSErrCFS_flg@ */ /end MEASUREMENT
/begin MEASUREMENT VDDM_EPS1RCErrPass_flg "" UBYTE SWC_DDM_type_CM_boolean_flg 0 0 0.0 1.0 ECU_ADDRESS 0x0000 /* @ECU_Address@VDDM_EPS1RCErrPass_flg@ */ /end MEASUREMENT
/begin MEASUREMENT VDDM_EPS1RCErrCFSRls_flg "" UBYTE SWC_DDM_type_CM_boolean_flg 0 0 0.0 1.0 ECU_ADDRESS 0x0000 /* @ECU_Address@VDDM_EPS1RCErrCFSRls_flg@ */ /end MEASUREMENT
/begin MEASUREMENT VDDM_EPS1RCErrDet_flg "" UBYTE SWC_DDM_type_CM_boolean_flg 0 0 0.0 1.0 ECU_ADDRESS 0x0000 /* @ECU_Address@VDDM_EPS1RCErrDet_flg@ */ /end MEASUREMENT
/begin MEASUREMENT VDDM_EPS1RCErrCFS_flg "" UBYTE SWC_DDM_type_CM_boolean_flg 0 0 0.0 1.0 ECU_ADDRESS 0x0000 /* @ECU_Address@VDDM_EPS1RCErrCFS_flg@ */ /end MEASUREMENT
/begin MEASUREMENT VDDM_EPSSigErrPass_flg "" UBYTE SWC_DDM_type_CM_boolean_flg 0 0 0.0 1.0 ECU_ADDRESS 0x0000 /* @ECU_Address@VDDM_EPSSigErrPass_flg@ */ /end MEASUREMENT
/begin MEASUREMENT VDDM_EPSSigErrCFSRls_flg "" UBYTE SWC_DDM_type_CM_boolean_flg 0 0 0.0 1.0 ECU_ADDRESS 0x0000 /* @ECU_Address@VDDM_EPSSigErrCFSRls_flg@ */ /end MEASUREMENT
/begin MEASUREMENT VDDM_EPSSigErrDet_flg "" UBYTE SWC_DDM_type_CM_boolean_flg 0 0 0.0 1.0 ECU_ADDRESS 0x0000 /* @ECU_Address@VDDM_EPSSigErrDet_flg@ */ /end MEASUREMENT
/begin MEASUREMENT VDDM_EPSSigErrCFS_flg "" UBYTE SWC_DDM_type_CM_boolean_flg 0 0 0.0 1.0 ECU_ADDRESS 0x0000 /* @ECU_Address@VDDM_EPSSigErrCFS_flg@ */ /end MEASUREMENT
/begin MEASUREMENT VDDM_EPSSigErrDFS_flg "" UBYTE SWC_DDM_type_CM_boolean_flg 0 0 0.0 1.0 ECU_ADDRESS 0x0000 /* @ECU_Address@VDDM_EPSSigErrDFS_flg@ */ /end MEASUREMENT
/begin MEASUREMENT VDDM_EPS1RCErrDFS_flg "" UBYTE SWC_DDM_type_CM_boolean_flg 0 0 0.0 1.0 ECU_ADDRESS 0x0000 /* @ECU_Address@VDDM_EPS1RCErrDFS_flg@ */ /end MEASUREMENT
/begin MEASUREMENT VDDM_EPS1CSErrDFS_flg "" UBYTE SWC_DDM_type_CM_boolean_flg 0 0 0.0 1.0 ECU_ADDRESS 0x0000 /* @ECU_Address@VDDM_EPS1CSErrDFS_flg@ */ /end MEASUREMENT
/begin MEASUREMENT VDDM_EPS1NoComDFS_flg "" UBYTE SWC_DDM_type_CM_boolean_flg 0 0 0.0 1.0 ECU_ADDRESS 0x0000 /* @ECU_Address@VDDM_EPS1NoComDFS_flg@ */ /end MEASUREMENT
/begin COMPU_METHOD SWC_DDM_type_CM_single_sec "Q = V" RAT_FUNC "%8.6" "sec" COEFFS 0 1 0 0 0 1 /end COMPU_METHOD
/begin COMPU_METHOD SWC_DDM_type_CM_single_V "Q = V" RAT_FUNC "%8.6" "V" COEFFS 0 1 0 0 0 1 /end COMPU_METHOD
/begin COMPU_METHOD SWC_DDM_type_CM_single_mps2 "Q = V" RAT_FUNC "%8.6" "mps2" COEFFS 0 1 0 0 0 1 /end COMPU_METHOD
/begin COMPU_METHOD SWC_DDM_type_CM_boolean_flg "Q = V" RAT_FUNC "%1.0" "flg" COEFFS 0 1 0 0 0 1 /end COMPU_METHOD
/begin COMPU_METHOD SWC_DDM_type_CM_uint8_cnt "Q = V" RAT_FUNC "%3.0" "cnt" COEFFS 0 1 0 0 0 1 /end COMPU_METHOD
/begin COMPU_METHOD SWC_DDM_type_CM_uint32_raw32 "Q = V" RAT_FUNC "%10.0" "raw32" COEFFS 0 1 0 0 0 1 /end COMPU_METHOD
/begin GROUP S71_BMS_HV_relay_closed_fail "SWC_DDM_type/run_SWC_DDM_5ms_sys/DDM/DDM/PMM/power up and power down/BMS HV relay closed fail" /begin SUB_GROUP S405_DTC_Couter1 S405_Test_Detection_Criteria1 /end SUB_GROUP
 /begin REF_CHARACTERISTIC KDDM_HVRlyCloDTC_cnt KDDM_HVRlyCloDetTO_s KDDM_HVRlyCloPassTO_s KDDM_PwrUpDnDiagnosisOffSW_flg /end REF_CHARACTERISTIC
 /begin REF_MEASUREMENT VDDM_HVRlyCloCFSRls_flg VDDM_HVRlyCloDFS_flg VDDM_HVRlyCloPass_flg /end REF_MEASUREMENT
/end GROUP
/begin GROUP S71_BMS_HV_relay_opened_fail "SWC_DDM_type/run_SWC_DDM_5ms_sys/DDM/DDM/PMM/power up and power down/BMS HV relay opened fail" /begin SUB_GROUP S406_DTC_Couter1 S406_Test_Detection_Criteria1 /end SUB_GROUP
 /begin REF_CHARACTERISTIC KDDM_HVRlyOpDTC_cnt KDDM_HVRlyOpDetTO_s KDDM_HVRlyOpPassTO_s KDDM_PwrUpDnDiagnosisOffSW_flg /end REF_CHARACTERISTIC
 /begin REF_MEASUREMENT VDDM_HVRlyOpCFSRls_flg VDDM_HVRlyOpDFS_flg VDDM_HVRlyOpPass_flg /end REF_MEASUREMENT
/end GROUP
/begin GROUP S71_BMS_ready_fail "SWC_DDM_type/run_SWC_DDM_5ms_sys/DDM/DDM/PMM/power up and power down/BMS ready fail" /begin SUB_GROUP S407_DTC_Couter1 S407_Test_Detection_Criteria1 /end SUB_GROUP
 /begin REF_CHARACTERISTIC KDDM_BMSRdyDTC_cnt KDDM_BMSRdyDetTO_s KDDM_BMSRdyPassTO_s KDDM_PwrUpDnDiagnosisOffSW_flg /end REF_CHARACTERISTIC
 /begin REF_MEASUREMENT VDDM_BMSRdyCFSRls_flg VDDM_BMSRdyDFS_flg VDDM_BMSRdyPass_flg /end REF_MEASUREMENT
/end GROUP
/begin GROUP S71_DCDC_disable_fail "SWC_DDM_type/run_SWC_DDM_5ms_sys/DDM/DDM/PMM/power up and power down/DCDC disable fail" /begin SUB_GROUP S408_DTC_Couter1 S408_Test_Detection_Criteria1 /end SUB_GROUP
 /begin REF_CHARACTERISTIC KDDM_DCDCDisDTC_cnt KDDM_DCDCDisDetTO_s KDDM_DCDCDisPassTO_s KDDM_PwrUpDnDiagnosisOffSW_flg /end REF_CHARACTERISTIC
 /begin REF_MEASUREMENT VDDM_DCDCDisCFSRls_flg VDDM_DCDCDisDFS_flg VDDM_DCDCDisPass_flg /end REF_MEASUREMENT
/end GROUP
/begin GROUP S71_DCDC_enable_fail "SWC_DDM_type/run_SWC_DDM_5ms_sys/DDM/DDM/PMM/power up and power down/DCDC enable fail" /begin SUB_GROUP S409_DTC_Couter1 S409_Test_Detection_Criteria1 /end SUB_GROUP
 /begin REF_CHARACTERISTIC KDDM_DCDCEnaDTC_cnt KDDM_DCDCEnaDetTO_s KDDM_DCDCEnaPassTO_s KDDM_PwrUpDnDiagnosisOffSW_flg /end REF_CHARACTERISTIC
 /begin REF_MEASUREMENT VDDM_DCDCEnaCFSRls_flg VDDM_DCDCEnaDFS_flg VDDM_DCDCEnaPass_flg /end REF_MEASUREMENT
/end GROUP
/begin GROUP S71_DCDC_ready_for_precharge_fail "SWC_DDM_type/run_SWC_DDM_5ms_sys/DDM/DDM/PMM/power up and power down/DCDC ready for precharge fail" /begin SUB_GROUP S410_DTC_Couter1 S410_Test_Detection_Criteria1 /end SUB_GROUP
 /begin REF_CHARACTERISTIC KDDM_DCDC4PreDTC_cnt KDDM_DCDC4PreDetTO_s KDDM_DCDC4PrePassTO_s KDDM_PwrUpDnDiagnosisOffSW_flg /end REF_CHARACTERISTIC
 /begin REF_MEASUREMENT VDDM_DCDC4PreCFSRls_flg VDDM_DCDC4PreDFS_flg VDDM_DCDC4PrePass_flg /end REF_MEASUREMENT
/end GROUP
/begin GROUP S71_HVB_ready_for_precharge_fail "SWC_DDM_type/run_SWC_DDM_5ms_sys/DDM/DDM/PMM/power up and power down/HVB ready for precharge fail" /begin SUB_GROUP S411_DTC_Couter1 S411_Test_Detection_Criteria /end SUB_GROUP
 /begin REF_CHARACTERISTIC KDDM_HVB4PreDTC_cnt KDDM_HVB4PreDetTO_s KDDM_HVB4PrePassTO_s KDDM_PwrUpDnDiagnosisOffSW_flg /end REF_CHARACTERISTIC
 /begin REF_MEASUREMENT VDDM_HVB4PreCFSRls_flg VDDM_HVB4PreDFS_flg VDDM_HVB4PrePass_flg /end REF_MEASUREMENT
/end GROUP
/begin GROUP S71_High_level_system_safety_check_fail "SWC_DDM_type/run_SWC_DDM_5ms_sys/DDM/DDM/PMM/power up and power down/High level system safety check fail" /begin SUB_GROUP S412_DTC_Couter1 S412_Test_Detection_Criteria1 /end SUB_GROUP
 /begin REF_CHARACTERISTIC KDDM_HiLvSaChkDTC_cnt KDDM_HiLvSaChkDetTO_s KDDM_HiLvSaChkPassTO_s KDDM_PwrUpDnDiagnosisOffSW_flg /end REF_CHARACTERISTIC
 /begin REF_MEASUREMENT VDDM_HiLvSaChkCFSRls_flg VDDM_HiLvSaChkDFS_flg VDDM_HiLvSaChkPass_flg /end REF_MEASUREMENT
/end GROUP
/begin GROUP S71_MCU_active_discharge_fail "SWC_DDM_type/run_SWC_DDM_5ms_sys/DDM/DDM/PMM/power up and power down/MCU active discharge fail" /begin SUB_GROUP S413_DTC_Couter1 S413_Test_Detection_Criteria1 /end SUB_GROUP
 /begin REF_CHARACTERISTIC KDDM_MCUActDTC_cnt KDDM_MCUActDetTO_s KDDM_MCUActPassTO_s KDDM_MCUDischrgVolt_V KDDM_PwrUpDnDiagnosisOffSW_flg /end REF_CHARACTERISTIC
 /begin REF_MEASUREMENT VDDM_MCUActCFSRls_flg VDDM_MCUActDFS_flg VDDM_MCUActPass_flg /end REF_MEASUREMENT
/end GROUP
/begin GROUP S71_MCU_disable_fail "SWC_DDM_type/run_SWC_DDM_5ms_sys/DDM/DDM/PMM/power up and power down/MCU disable fail" /begin SUB_GROUP S414_DTC_Couter1 S414_Test_Detection_Criteria1 /end SUB_GROUP
 /begin REF_CHARACTERISTIC KDDM_MCUDisDTC_cnt KDDM_MCUDisDetTO_s KDDM_MCUDisPassTO_s KDDM_PwrUpDnDiagnosisOffSW_flg /end REF_CHARACTERISTIC
 /begin REF_MEASUREMENT VDDM_MCUDisCFSRls_flg VDDM_MCUDisDFS_flg VDDM_MCUDisPass_flg /end REF_MEASUREMENT
/end GROUP
/begin GROUP S71_MCU_ready_for_precharge_fail "SWC_DDM_type/run_SWC_DDM_5ms_sys/DDM/DDM/PMM/power up and power down/MCU ready for precharge fail" /begin SUB_GROUP S415_DTC_Couter1 S415_Test_Detection_Criteria1 /end SUB_GROUP
 /begin REF_CHARACTERISTIC KDDM_MCU4PreDTC_cnt KDDM_MCU4PreDetTO_s KDDM_MCU4PrePassTO_s KDDM_PwrUpDnDiagnosisOffSW_flg /end REF_CHARACTERISTIC
 /begin REF_MEASUREMENT VDDM_MCU4PreCFSRls_flg VDDM_MCU4PreDFS_flg VDDM_MCU4PrePass_flg /end REF_MEASUREMENT
/end GROUP
/begin GROUP S71_Mid_level_system_safety_check_fail "SWC_DDM_type/run_SWC_DDM_5ms_sys/DDM/DDM/PMM/power up and power down/Mid level system safety check fail" /begin SUB_GROUP S416_DTC_Couter1 S416_Test_Detection_Criteria1 /end SUB_GROUP
 /begin REF_CHARACTERISTIC KDDM_MidLvSaChkDTC_cnt KDDM_MidLvSaChkDetTO_s KDDM_MidLvSaChkPassTO_s KDDM_PwrUpDnDiagnosisOffSW_flg /end REF_CHARACTERISTIC
 /begin REF_MEASUREMENT VDDM_MidLvSaChkCFSRls_flg VDDM_MidLvSaChkDFS_flg VDDM_MidLvSaChkPass_flg /end REF_MEASUREMENT
/end GROUP
/begin GROUP S71_OBC_ready_for_precharge_fail "SWC_DDM_type/run_SWC_DDM_5ms_sys/DDM/DDM/PMM/power up and power down/OBC ready for precharge fail" /begin SUB_GROUP S417_DTC_Couter1 S417_Test_Detection_Criteria1 /end SUB_GROUP
 /begin REF_CHARACTERISTIC KDDM_OBC4PreDTC_cnt KDDM_OBC4PreDetTO_s KDDM_OBC4PrePassTO_s KDDM_PwrUpDnDiagnosisOffSW_flg /end REF_CHARACTERISTIC
 /begin REF_MEASUREMENT VDDM_OBC4PreCFSRls_flg VDDM_OBC4PreDFS_flg VDDM_OBC4PrePass_flg /end REF_MEASUREMENT
/end GROUP
/begin GROUP S540_DTC_Couter "SWC_DDM_type/run_SWC_DDM_5ms_sys/DDM/DDM/TPM/LFBatwarn/DTC_Couter" /begin REF_MEASUREMENT VDDM_LFBatwarnDTC_cnt /end REF_MEASUREMENT /end GROUP
/begin GROUP S540_Test_Detection_Criteria "SWC_DDM_type/run_SWC_DDM_5ms_sys/DDM/DDM/TPM/LFBatwarn/Test Detection Criteria" /begin REF_MEASUREMENT VDDM_LFBatwarnDet_flg /end REF_MEASUREMENT /end GROUP
/begin GROUP S541_DTC_Couter "SWC_DDM_type/run_SWC_DDM_5ms_sys/DDM/DDM/TPM/LFPressureLow/DTC_Couter" /begin REF_MEASUREMENT VDDM_LFPressIndiDTC_cnt /end REF_MEASUREMENT /end GROUP
/begin GROUP S541_Test_Detection_Criteria "SWC_DDM_type/run_SWC_DDM_5ms_sys/DDM/DDM/TPM/LFPressureLow/Test Detection Criteria" /begin REF_MEASUREMENT VDDM_LFPressIndiDet_flg /end REF_MEASUREMENT /end GROUP
/begin GROUP S542_DTC_Couter "SWC_DDM_type/run_SWC_DDM_5ms_sys/DDM/DDM/TPM/LFSensorfail/DTC_Couter" /begin REF_MEASUREMENT VDDM_LFSensorFailDTC_cnt /end REF_MEASUREMENT /end GROUP
/begin GROUP S542_Test_Detection_Criteria "SWC_DDM_type/run_SWC_DDM_5ms_sys/DDM/DDM/TPM/LFSensorfail/Test Detection Criteria" /begin REF_MEASUREMENT VDDM_LFSensorFailDet_flg /end REF_MEASUREMENT /end GROUP
/begin GROUP S543_DTC_Couter "SWC_DDM_type/run_SWC_DDM_5ms_sys/DDM/DDM/TPM/LFWheelTmpHigh/DTC_Couter" /begin REF_MEASUREMENT VDDM_LFWheelTmpHighDTC_cnt /end REF_MEASUREMENT /end GROUP
/begin GROUP S543_Test_Detection_Criteria "SWC_DDM_type/run_SWC_DDM_5ms_sys/DDM/DDM/TPM/LFWheelTmpHigh/Test Detection Criteria" /begin REF_MEASUREMENT VDDM_LFWheelTmpHighDet_flg /end REF_MEASUREMENT /end GROUP
/begin GROUP S544_DTC_Couter "SWC_DDM_type/run_SWC_DDM_5ms_sys/DDM/DDM/TPM/LRBatwarn/DTC_Couter" /begin REF_MEASUREMENT VDDM_LRBatwarnDTC_cnt /end REF_MEASUREMENT /end GROUP
/begin GROUP S544_Test_Detection_Criteria "SWC_DDM_type/run_SWC_DDM_5ms_sys/DDM/DDM/TPM/LRBatwarn/Test Detection Criteria" /begin REF_MEASUREMENT VDDM_LRBatwarnDet_flg /end REF_MEASUREMENT /end GROUP
/begin GROUP S545_DTC_Couter "SWC_DDM_type/run_SWC_DDM_5ms_sys/DDM/DDM/TPM/LRPressureLow/DTC_Couter" /begin REF_MEASUREMENT VDDM_LRPressIndiDTC_cnt /end REF_MEASUREMENT /end GROUP
/begin GROUP S545_Test_Detection_Criteria "SWC_DDM_type/run_SWC_DDM_5ms_sys/DDM/DDM/TPM/LRPressureLow/Test Detection Criteria" /begin REF_MEASUREMENT VDDM_LRPressIndiDet_flg /end REF_MEASUREMENT /end GROUP
/begin GROUP S546_DTC_Couter "SWC_DDM_type/run_SWC_DDM_5ms_sys/DDM/DDM/TPM/LRSensorfail/DTC_Couter" /begin REF_MEASUREMENT VDDM_LRSensorFailDTC_cnt /end REF_MEASUREMENT /end GROUP
/begin GROUP S546_Test_Detection_Criteria "SWC_DDM_type/run_SWC_DDM_5ms_sys/DDM/DDM/TPM/LRSensorfail/Test Detection Criteria" /begin REF_MEASUREMENT VDDM_LRSensorFailDet_flg /end REF_MEASUREMENT /end GROUP
/begin GROUP S547_DTC_Couter "SWC_DDM_type/run_SWC_DDM_5ms_sys/DDM/DDM/TPM/LRWheelTmpHigh/DTC_Couter" /begin REF_MEASUREMENT VDDM_LRWheelTmpHighDTC_cnt /end REF_MEASUREMENT /end GROUP
/begin GROUP S547_Test_Detection_Criteria "SWC_DDM_type/run_SWC_DDM_5ms_sys/DDM/DDM/TPM/LRWheelTmpHigh/Test Detection Criteria" /begin REF_MEASUREMENT VDDM_LRWheelTmpHighDet_flg /end REF_MEASUREMENT /end GROUP
/begin GROUP S548_DTC_Couter "SWC_DDM_type/run_SWC_DDM_5ms_sys/DDM/DDM/TPM/RFBatwarn/DTC_Couter" /begin REF_MEASUREMENT VDDM_RFBatwarnDTC_cnt /end REF_MEASUREMENT /end GROUP
/begin GROUP S548_Test_Detection_Criteria "SWC_DDM_type/run_SWC_DDM_5ms_sys/DDM/DDM/TPM/RFBatwarn/Test Detection Criteria" /begin REF_MEASUREMENT VDDM_RFBatwarnDet_flg /end REF_MEASUREMENT /end GROUP
/begin GROUP S549_DTC_Couter "SWC_DDM_type/run_SWC_DDM_5ms_sys/DDM/DDM/TPM/RFPressureLow/DTC_Couter" /begin REF_MEASUREMENT VDDM_RFPressIndiDTC_cnt /end REF_MEASUREMENT /end GROUP
/begin GROUP S549_Test_Detection_Criteria "SWC_DDM_type/run_SWC_DDM_5ms_sys/DDM/DDM/TPM/RFPressureLow/Test Detection Criteria" /begin REF_MEASUREMENT VDDM_RFPressIndiDet_flg /end REF_MEASUREMENT /end GROUP
/begin GROUP S550_DTC_Couter "SWC_DDM_type/run_SWC_DDM_5ms_sys/DDM/DDM/TPM/RFSensorfail/DTC_Couter" /begin REF_MEASUREMENT VDDM_RFSensorFailDTC_cnt /end REF_MEASUREMENT /end GROUP
/begin GROUP S550_Test_Detection_Criteria "SWC_DDM_type/run_SWC_DDM_5ms_sys/DDM/DDM/TPM/RFSensorfail/Test Detection Criteria" /begin REF_MEASUREMENT VDDM_RFSensorFailDet_flg /end REF_MEASUREMENT /end GROUP
/begin GROUP S551_DTC_Couter "SWC_DDM_type/run_SWC_DDM_5ms_sys/DDM/DDM/TPM/RFWheelTmpHigh/DTC_Couter" /begin REF_MEASUREMENT VDDM_RFWheelTmpHighDTC_cnt /end REF_MEASUREMENT /end GROUP
/begin GROUP S551_Test_Detection_Criteria "SWC_DDM_type/run_SWC_DDM_5ms_sys/DDM/DDM/TPM/RFWheelTmpHigh/Test Detection Criteria" /begin REF_MEASUREMENT VDDM_RFWheelTmpHighDet_flg /end REF_MEASUREMENT /end GROUP
/begin GROUP S552_DTC_Couter "SWC_DDM_type/run_SWC_DDM_5ms_sys/DDM/DDM/TPM/RRBatwarn/DTC_Couter" /begin REF_MEASUREMENT VDDM_RRBatwarnDTC_cnt /end REF_MEASUREMENT /end GROUP
/begin GROUP S552_Test_Detection_Criteria "SWC_DDM_type/run_SWC_DDM_5ms_sys/DDM/DDM/TPM/RRBatwarn/Test Detection Criteria" /begin REF_MEASUREMENT VDDM_RRBatwarnDet_flg /end REF_MEASUREMENT /end GROUP
/begin GROUP S553_DTC_Couter "SWC_DDM_type/run_SWC_DDM_5ms_sys/DDM/DDM/TPM/RRPressureLow/DTC_Couter" /begin REF_MEASUREMENT VDDM_RRPressIndiDTC_cnt /end REF_MEASUREMENT /end GROUP
/begin GROUP S553_Test_Detection_Criteria "SWC_DDM_type/run_SWC_DDM_5ms_sys/DDM/DDM/TPM/RRPressureLow/Test Detection Criteria" /begin REF_MEASUREMENT VDDM_RRPressIndiDet_flg /end REF_MEASUREMENT /end GROUP
/begin GROUP S554_DTC_Couter "SWC_DDM_type/run_SWC_DDM_5ms_sys/DDM/DDM/TPM/RRSensorfail/DTC_Couter" /begin REF_MEASUREMENT VDDM_RRSensorFailDTC_cnt /end REF_MEASUREMENT /end GROUP
/begin GROUP S554_Test_Detection_Criteria "SWC_DDM_type/run_SWC_DDM_5ms_sys/DDM/DDM/TPM/RRSensorfail/Test Detection Criteria" /begin REF_MEASUREMENT VDDM_RRSensorFailDet_flg /end REF_MEASUREMENT /end GROUP
/begin GROUP S555_DTC_Couter "SWC_DDM_type/run_SWC_DDM_5ms_sys/DDM/DDM/TPM/RRWheelTmpHigh/DTC_Couter" /begin REF_MEASUREMENT VDDM_RRWheelTmpHighDTC_cnt /end REF_MEASUREMENT /end GROUP
/begin GROUP S555_Test_Detection_Criteria "SWC_DDM_type/run_SWC_DDM_5ms_sys/DDM/DDM/TPM/RRWheelTmpHigh/Test Detection Criteria" /begin REF_MEASUREMENT VDDM_RRWheelTmpHighDet_flg /end REF_MEASUREMENT /end GROUP
/begin GROUP S732_DTC_Couter1 "SWC_DDM_type/run_SWC_DDM_5ms_sys/DDM/DDM/TQD/APS_DDM/DTC_Couter1" /begin REF_MEASUREMENT VDDM_APS2SigOoRCFS_flg VDDM_APS2SigOoRDTC_cnt /end REF_MEASUREMENT /end GROUP
/begin GROUP S732_DTC_Couter2 "SWC_DDM_type/run_SWC_DDM_5ms_sys/DDM/DDM/TQD/APS_DDM/DTC_Couter2" /begin REF_MEASUREMENT VDDM_APSCorrErrCFS_flg VDDM_APSCorrErrDTC_cnt /end REF_MEASUREMENT /end GROUP
/begin GROUP S732_DTC_Couter3 "SWC_DDM_type/run_SWC_DDM_5ms_sys/DDM/DDM/TQD/APS_DDM/DTC_Couter3" /begin REF_MEASUREMENT VDDM_5vAPS1OoRCFS_flg VDDM_5vAPS1OoRDTC_cnt /end REF_MEASUREMENT /end GROUP
/begin GROUP S732_DTC_Couter4 "SWC_DDM_type/run_SWC_DDM_5ms_sys/DDM/DDM/TQD/APS_DDM/DTC_Couter4" /begin REF_MEASUREMENT VDDM_5vAPS2OoRCFS_flg VDDM_5vAPS2OoRDTC_cnt /end REF_MEASUREMENT /end GROUP
/begin GROUP S732_DTC_Couter6 "SWC_DDM_type/run_SWC_DDM_5ms_sys/DDM/DDM/TQD/APS_DDM/DTC_Couter6" /begin REF_MEASUREMENT VDDM_APS1SigOoRCFS_flg VDDM_APS1SigOoRDTC_cnt /end REF_MEASUREMENT /end GROUP
/begin GROUP S732_Test_Detection_Criteria1 "SWC_DDM_type/run_SWC_DDM_5ms_sys/DDM/DDM/TQD/APS_DDM/Test Detection Criteria1" /begin REF_MEASUREMENT VDDM_APSCorrErrDet_flg /end REF_MEASUREMENT /end GROUP
/begin GROUP S732_Test_Detection_Criteria2 "SWC_DDM_type/run_SWC_DDM_5ms_sys/DDM/DDM/TQD/APS_DDM/Test Detection Criteria2" /begin REF_MEASUREMENT VDDM_5vAPS1OoRDet_flg /end REF_MEASUREMENT /end GROUP
/begin GROUP S732_Test_Detection_Criteria3 "SWC_DDM_type/run_SWC_DDM_5ms_sys/DDM/DDM/TQD/APS_DDM/Test Detection Criteria3" /begin REF_MEASUREMENT VDDM_APS1SigOoRDet_flg /end REF_MEASUREMENT /end GROUP
/begin GROUP S732_Test_Detection_Criteria4 "SWC_DDM_type/run_SWC_DDM_5ms_sys/DDM/DDM/TQD/APS_DDM/Test Detection Criteria4" /begin REF_MEASUREMENT VDDM_APS2SigOoRDet_flg /end REF_MEASUREMENT /end GROUP
/begin GROUP S732_Test_Detection_Criteria5 "SWC_DDM_type/run_SWC_DDM_5ms_sys/DDM/DDM/TQD/APS_DDM/Test Detection Criteria5" /begin REF_MEASUREMENT VDDM_5vAPS2OoRDet_flg /end REF_MEASUREMENT /end GROUP
/begin GROUP S733_DTC_Couter1 "SWC_DDM_type/run_SWC_DDM_5ms_sys/DDM/DDM/TQD/EPB/DTC_Couter1" /begin REF_MEASUREMENT VDDM_EPBUnlockTOCFS_flg VDDM_EPBUnlockTODTC_cnt /end REF_MEASUREMENT /end GROUP
/begin GROUP S733_DTC_Couter3 "SWC_DDM_type/run_SWC_DDM_5ms_sys/DDM/DDM/TQD/EPB/DTC_Couter3" /begin REF_MEASUREMENT VDDM_EPB1NoComCFS_flg VDDM_EPB1NoComDTC_cnt /end REF_MEASUREMENT /end GROUP
/begin GROUP S733_DTC_Couter4 "SWC_DDM_type/run_SWC_DDM_5ms_sys/DDM/DDM/TQD/EPB/DTC_Couter4" /begin REF_MEASUREMENT VDDM_EPB1CSErrCFS_flg VDDM_EPB1CSErrDTC_cnt /end REF_MEASUREMENT /end GROUP
/begin GROUP S733_DTC_Couter5 "SWC_DDM_type/run_SWC_DDM_5ms_sys/DDM/DDM/TQD/EPB/DTC_Couter5" /begin REF_MEASUREMENT VDDM_EPBLockTOCFS_flg VDDM_EPBLockTODTC_cnt /end REF_MEASUREMENT /end GROUP
/begin GROUP S733_DTC_Couter6 "SWC_DDM_type/run_SWC_DDM_5ms_sys/DDM/DDM/TQD/EPB/DTC_Couter6" /begin REF_MEASUREMENT VDDM_EPBSigErrCFS_flg VDDM_EPBSigErrDTC_cnt /end REF_MEASUREMENT /end GROUP
/begin GROUP S733_DTC_Couter7 "SWC_DDM_type/run_SWC_DDM_5ms_sys/DDM/DDM/TQD/EPB/DTC_Couter7" /begin REF_MEASUREMENT VDDM_EPB1RCErrCFS_flg VDDM_EPB1RCErrDTC_cnt /end REF_MEASUREMENT /end GROUP
/begin GROUP S733_SR_Latch1 "SWC_DDM_type/run_SWC_DDM_5ms_sys/DDM/DDM/TQD/EPB/SR_Latch1" /begin REF_MEASUREMENT VDDM_EPBLockTOPass_flg /end REF_MEASUREMENT /end GROUP
/begin GROUP S733_SR_Latch3 "SWC_DDM_type/run_SWC_DDM_5ms_sys/DDM/DDM/TQD/EPB/SR_Latch3" /begin REF_MEASUREMENT VDDM_EPBUnlockTOPass_flg /end REF_MEASUREMENT /end GROUP
/begin GROUP S733_Test_Detection_Criteria1 "SWC_DDM_type/run_SWC_DDM_5ms_sys/DDM/DDM/TQD/EPB/Test Detection Criteria1" /begin REF_MEASUREMENT VDDM_EPBLockTODet_flg /end REF_MEASUREMENT /end GROUP
/begin GROUP S733_Test_Detection_Criteria2 "SWC_DDM_type/run_SWC_DDM_5ms_sys/DDM/DDM/TQD/EPB/Test Detection Criteria2" /begin REF_MEASUREMENT VDDM_EPBUnlockTODet_flg /end REF_MEASUREMENT /end GROUP
/begin GROUP S733_Test_Detection_Criteria3 "SWC_DDM_type/run_SWC_DDM_5ms_sys/DDM/DDM/TQD/EPB/Test Detection Criteria3" /begin REF_MEASUREMENT VDDM_EPB1NoComDet_flg /end REF_MEASUREMENT /end GROUP
/begin GROUP S733_Test_Detection_Criteria4 "SWC_DDM_type/run_SWC_DDM_5ms_sys/DDM/DDM/TQD/EPB/Test Detection Criteria4" /begin REF_MEASUREMENT VDDM_EPB1RCErrDet_flg /end REF_MEASUREMENT /end GROUP
/begin GROUP S733_Test_Detection_Criteria5 "SWC_DDM_type/run_SWC_DDM_5ms_sys/DDM/DDM/TQD/EPB/Test Detection Criteria5" /begin REF_MEASUREMENT VDDM_EPB1CSErrDet_flg /end REF_MEASUREMENT /end GROUP
/begin GROUP S733_Test_Detection_Criteria6 "SWC_DDM_type/run_SWC_DDM_5ms_sys/DDM/DDM/TQD/EPB/Test Detection Criteria6" /begin REF_MEASUREMENT VDDM_EPBSigErrDet_flg /end REF_MEASUREMENT /end GROUP
/begin GROUP S734_DTC_Couter1 "SWC_DDM_type/run_SWC_DDM_5ms_sys/DDM/DDM/TQD/ESC1_DDM/DTC_Couter1" /begin REF_MEASUREMENT VDDM_ESC1NoComCFS_flg VDDM_ESC1NoComDTC_cnt /end REF_MEASUREMENT /end GROUP
/begin GROUP S734_DTC_Couter2 "SWC_DDM_type/run_SWC_DDM_5ms_sys/DDM/DDM/TQD/ESC1_DDM/DTC_Couter2" /begin REF_MEASUREMENT VDDM_ESC1CSErrCFS_flg VDDM_ESC1CSErrDTC_cnt /end REF_MEASUREMENT /end GROUP
/begin GROUP S734_DTC_Couter7 "SWC_DDM_type/run_SWC_DDM_5ms_sys/DDM/DDM/TQD/ESC1_DDM/DTC_Couter7" /begin REF_MEASUREMENT VDDM_ESC1RCErrCFS_flg VDDM_ESC1RCErrDTC_cnt /end REF_MEASUREMENT /end GROUP
/begin GROUP S734_Test_Detection_Criteria2 "SWC_DDM_type/run_SWC_DDM_5ms_sys/DDM/DDM/TQD/ESC1_DDM/Test Detection Criteria2" /begin REF_MEASUREMENT VDDM_ESC1NoComDet_flg /end REF_MEASUREMENT /end GROUP
/begin GROUP S734_Test_Detection_Criteria3 "SWC_DDM_type/run_SWC_DDM_5ms_sys/DDM/DDM/TQD/ESC1_DDM/Test Detection Criteria3" /begin REF_MEASUREMENT VDDM_ESC1RCErrDet_flg /end REF_MEASUREMENT /end GROUP
/begin GROUP S734_Test_Detection_Criteria4 "SWC_DDM_type/run_SWC_DDM_5ms_sys/DDM/DDM/TQD/ESC1_DDM/Test Detection Criteria4" /begin REF_MEASUREMENT VDDM_ESC1CSErrDet_flg /end REF_MEASUREMENT /end GROUP
/begin GROUP S735_DTC_Couter1 "SWC_DDM_type/run_SWC_DDM_5ms_sys/DDM/DDM/TQD/ESC5_DDM/DTC_Couter1" /begin REF_MEASUREMENT VDDM_ESC5NoComCFS_flg VDDM_ESC5NoComDTC_cnt /end REF_MEASUREMENT /end GROUP
/begin GROUP S735_DTC_Couter2 "SWC_DDM_type/run_SWC_DDM_5ms_sys/DDM/DDM/TQD/ESC5_DDM/DTC_Couter2" /begin REF_MEASUREMENT VDDM_ESC5CSErrCFS_flg VDDM_ESC5CSErrDTC_cnt /end REF_MEASUREMENT /end GROUP
/begin GROUP S735_DTC_Couter7 "SWC_DDM_type/run_SWC_DDM_5ms_sys/DDM/DDM/TQD/ESC5_DDM/DTC_Couter7" /begin REF_MEASUREMENT VDDM_ESC5RCErrCFS_flg VDDM_ESC5RCErrDTC_cnt /end REF_MEASUREMENT /end GROUP
/begin GROUP S735_Test_Detection_Criteria2 "SWC_DDM_type/run_SWC_DDM_5ms_sys/DDM/DDM/TQD/ESC5_DDM/Test Detection Criteria2" /begin REF_MEASUREMENT VDDM_ESC5NoComDet_flg /end REF_MEASUREMENT /end GROUP
/begin GROUP S735_Test_Detection_Criteria3 "SWC_DDM_type/run_SWC_DDM_5ms_sys/DDM/DDM/TQD/ESC5_DDM/Test Detection Criteria3" /begin REF_MEASUREMENT VDDM_ESC5RCErrDet_flg /end REF_MEASUREMENT /end GROUP
/begin GROUP S735_Test_Detection_Criteria4 "SWC_DDM_type/run_SWC_DDM_5ms_sys/DDM/DDM/TQD/ESC5_DDM/Test Detection Criteria4" /begin REF_MEASUREMENT VDDM_ESC5CSErrDet_flg /end REF_MEASUREMENT /end GROUP
/begin GROUP S736_DTC_Couter1 "SWC_DDM_type/run_SWC_DDM_5ms_sys/DDM/DDM/TQD/MCU1_Nidec_DDM/DTC_Couter1" /begin REF_MEASUREMENT VDDM_MCUNF1NoComCFS_flg VDDM_MCUNF1NoComDTC_cnt /end REF_MEASUREMENT /end GROUP
/begin GROUP S736_DTC_Couter2 "SWC_DDM_type/run_SWC_DDM_5ms_sys/DDM/DDM/TQD/MCU1_Nidec_DDM/DTC_Couter2" /begin REF_MEASUREMENT VDDM_MCUNR1NoComCFS_flg VDDM_MCUNR1NoComDTC_cnt /end REF_MEASUREMENT /end GROUP
/begin GROUP S736_DTC_Couter3 "SWC_DDM_type/run_SWC_DDM_5ms_sys/DDM/DDM/TQD/MCU1_Nidec_DDM/DTC_Couter3" /begin REF_MEASUREMENT VDDM_MCUNR1RCErrCFS_flg VDDM_MCUNR1RCErrDTC_cnt /end REF_MEASUREMENT /end GROUP
/begin GROUP S736_DTC_Couter4 "SWC_DDM_type/run_SWC_DDM_5ms_sys/DDM/DDM/TQD/MCU1_Nidec_DDM/DTC_Couter4" /begin REF_MEASUREMENT VDDM_MCUNF1CSErrCFS_flg VDDM_MCUNF1CSErrDTC_cnt /end REF_MEASUREMENT /end GROUP
/begin GROUP S736_DTC_Couter5 "SWC_DDM_type/run_SWC_DDM_5ms_sys/DDM/DDM/TQD/MCU1_Nidec_DDM/DTC_Couter5" /begin REF_MEASUREMENT VDDM_MCUNR1CSErrCFS_flg VDDM_MCUNR1CSErrDTC_cnt /end REF_MEASUREMENT /end GROUP
/begin GROUP S736_DTC_Couter7 "SWC_DDM_type/run_SWC_DDM_5ms_sys/DDM/DDM/TQD/MCU1_Nidec_DDM/DTC_Couter7" /begin REF_MEASUREMENT VDDM_MCUNF1RCErrCFS_flg VDDM_MCUNF1RCErrDTC_cnt /end REF_MEASUREMENT /end GROUP
/begin GROUP S736_Test_Detection_Criteria1 "SWC_DDM_type/run_SWC_DDM_5ms_sys/DDM/DDM/TQD/MCU1_Nidec_DDM/Test Detection Criteria1" /begin REF_MEASUREMENT VDDM_MCUNF1NoComDet_flg /end REF_MEASUREMENT /end GROUP
/begin GROUP S736_Test_Detection_Criteria2 "SWC_DDM_type/run_SWC_DDM_5ms_sys/DDM/DDM/TQD/MCU1_Nidec_DDM/Test Detection Criteria2" /begin REF_MEASUREMENT VDDM_MCUNR1NoComDet_flg /end REF_MEASUREMENT /end GROUP
/begin GROUP S736_Test_Detection_Criteria3 "SWC_DDM_type/run_SWC_DDM_5ms_sys/DDM/DDM/TQD/MCU1_Nidec_DDM/Test Detection Criteria3" /begin REF_MEASUREMENT VDDM_MCUNF1RCErrDet_flg /end REF_MEASUREMENT /end GROUP
/begin GROUP S736_Test_Detection_Criteria4 "SWC_DDM_type/run_SWC_DDM_5ms_sys/DDM/DDM/TQD/MCU1_Nidec_DDM/Test Detection Criteria4" /begin REF_MEASUREMENT VDDM_MCUNR1RCErrDet_flg /end REF_MEASUREMENT /end GROUP
/begin GROUP S736_Test_Detection_Criteria5 "SWC_DDM_type/run_SWC_DDM_5ms_sys/DDM/DDM/TQD/MCU1_Nidec_DDM/Test Detection Criteria5" /begin REF_MEASUREMENT VDDM_MCUNF1CSErrDet_flg /end REF_MEASUREMENT /end GROUP
/begin GROUP S736_Test_Detection_Criteria6 "SWC_DDM_type/run_SWC_DDM_5ms_sys/DDM/DDM/TQD/MCU1_Nidec_DDM/Test Detection Criteria6" /begin REF_MEASUREMENT VDDM_MCUNR1CSErrDet_flg /end REF_MEASUREMENT /end GROUP
/begin GROUP S737_DTC_Couter1 "SWC_DDM_type/run_SWC_DDM_5ms_sys/DDM/DDM/TQD/MCU_Nidec_DDM/DTC_Couter1" /begin REF_MEASUREMENT VDDM_RrMCUNTqErrCFS_flg VDDM_RrMCUNTqErrDTC_cnt /end REF_MEASUREMENT /end GROUP
/begin GROUP S737_DTC_Couter3 "SWC_DDM_type/run_SWC_DDM_5ms_sys/DDM/DDM/TQD/MCU_Nidec_DDM/DTC_Couter3" /begin REF_MEASUREMENT VDDM_FrMCUNTqErrCFS_flg VDDM_FrMCUNTqErrDTC_cnt /end REF_MEASUREMENT /end GROUP
/begin GROUP S737_Test_Detection_Criteria1 "SWC_DDM_type/run_SWC_DDM_5ms_sys/DDM/DDM/TQD/MCU_Nidec_DDM/Test Detection Criteria1" /begin REF_MEASUREMENT VDDM_FrMCUNTqErrDet_flg /end REF_MEASUREMENT /end GROUP
/begin GROUP S737_Test_Detection_Criteria2 "SWC_DDM_type/run_SWC_DDM_5ms_sys/DDM/DDM/TQD/MCU_Nidec_DDM/Test Detection Criteria2" /begin REF_MEASUREMENT VDDM_RrMCUNTqErrDet_flg /end REF_MEASUREMENT /end GROUP
/begin GROUP S738_DTC_Couter4 "SWC_DDM_type/run_SWC_DDM_5ms_sys/DDM/DDM/TQD/Regen_fail_DDM/DTC_Couter4" /begin REF_MEASUREMENT VDDM_RegenErrCFS_flg VDDM_RegenErrDTC_cnt /end REF_MEASUREMENT /end GROUP
/begin GROUP S738_Test_Detection_Criteria1 "SWC_DDM_type/run_SWC_DDM_5ms_sys/DDM/DDM/TQD/Regen_fail_DDM/Test Detection Criteria1" /begin REF_MEASUREMENT VDDM_RegenErrDet_flg /end REF_MEASUREMENT /end GROUP
/begin GROUP S739_DTC_Couter1 "SWC_DDM_type/run_SWC_DDM_5ms_sys/DDM/DDM/TQD/Shifter1_DDM/DTC_Couter1" /begin REF_MEASUREMENT VDDM_Shifter1RCErrCFS_flg VDDM_Shifter1RCErrDTC_cnt /end REF_MEASUREMENT /end GROUP
/begin GROUP S739_DTC_Couter2 "SWC_DDM_type/run_SWC_DDM_5ms_sys/DDM/DDM/TQD/Shifter1_DDM/DTC_Couter2" /begin REF_MEASUREMENT VDDM_Shifter1CSErrCFS_flg VDDM_Shifter1CSErrDTC_cnt /end REF_MEASUREMENT /end GROUP
/begin GROUP S739_DTC_Couter4 "SWC_DDM_type/run_SWC_DDM_5ms_sys/DDM/DDM/TQD/Shifter1_DDM/DTC_Couter4" /begin REF_MEASUREMENT VDDM_Shifter1NoComCFS_flg VDDM_Shifter1NoComDTC_cnt /end REF_MEASUREMENT /end GROUP
/begin GROUP S739_Test_Detection_Criteria1 "SWC_DDM_type/run_SWC_DDM_5ms_sys/DDM/DDM/TQD/Shifter1_DDM/Test Detection Criteria1" /begin REF_MEASUREMENT VDDM_Shifter1NoComDet_flg /end REF_MEASUREMENT /end GROUP
/begin GROUP S739_Test_Detection_Criteria2 "SWC_DDM_type/run_SWC_DDM_5ms_sys/DDM/DDM/TQD/Shifter1_DDM/Test Detection Criteria2" /begin REF_MEASUREMENT VDDM_Shifter1RCErrDet_flg /end REF_MEASUREMENT /end GROUP
/begin GROUP S739_Test_Detection_Criteria3 "SWC_DDM_type/run_SWC_DDM_5ms_sys/DDM/DDM/TQD/Shifter1_DDM/Test Detection Criteria3" /begin REF_MEASUREMENT VDDM_Shifter1CSErrDet_flg /end REF_MEASUREMENT /end GROUP
/begin GROUP S978_ACC_Acceleration_Command_Error_ "SWC_DDM_type/run_SWC_DDM_5ms_sys/DDM/DDM/VMC_DDM/ACC Acceleration Command Error/ACC Acceleration Command Error " /begin SUB_GROUP S992_DTC_Couter1 S992_Test_Detection_Criteria /end SUB_GROUP
 /begin REF_CHARACTERISTIC KDDM_ACCAccelCmdErrDTC_cnt KDDM_ACCAccelCmdErrDetTO_s KDDM_ACCAccelCmdErrDet_mps2 KDDM_ACCAccelCmdErrPassTO_s /end REF_CHARACTERISTIC
 /begin REF_MEASUREMENT VDDM_ACCAccelCmdErrCFSRls_flg VDDM_ACCAccelCmdErrDFS_flg VDDM_ACCAccelCmdErrPass_flg /end REF_MEASUREMENT
/end GROUP
/begin GROUP S979_BMS_Signal_Error_ "SWC_DDM_type/run_SWC_DDM_5ms_sys/DDM/DDM/VMC_DDM/BMS Signal Error /BMS Signal Error " /begin SUB_GROUP S1001_DTC_Couter1 S1001_Test_Detection_Criteria /end SUB_GROUP
 /begin REF_CHARACTERISTIC KDDM_BMSSigErrDTC_cnt KDDM_BMSSigErrDetTO_s KDDM_BMSSigErrPassTO_s /end REF_CHARACTERISTIC
 /begin REF_MEASUREMENT VDDM_BMSSigErrCFSRls_flg VDDM_BMSSigErrDFS_flg VDDM_BMSSigErrPass_flg /end REF_MEASUREMENT
/end GROUP
/begin GROUP S980_CCU_Signal_Error_ "SWC_DDM_type/run_SWC_DDM_5ms_sys/DDM/DDM/VMC_DDM/CCU Signal Error/CCU Signal Error " /begin SUB_GROUP S1010_DTC_Couter1 S1010_Test_Detection_Criteria /end SUB_GROUP
 /begin REF_CHARACTERISTIC KDDM_CCUSigErrDTC_cnt KDDM_CCUSigErrDetTO_s KDDM_CCUSigErrPassTO_s /end REF_CHARACTERISTIC
 /begin REF_MEASUREMENT VDDM_CCUSigErrCFSRls_flg VDDM_CCUSigErrDFS_flg VDDM_CCUSigErrPass_flg /end REF_MEASUREMENT
/end GROUP
/begin GROUP S981_ESC_Signal_Error_ "SWC_DDM_type/run_SWC_DDM_5ms_sys/DDM/DDM/VMC_DDM/ESC Signal Error/ESC Signal Error " /begin SUB_GROUP S1019_DTC_Couter S1019_Test_Detection_Criteria /end SUB_GROUP
 /begin REF_CHARACTERISTIC KDDM_ESCSigErrDTC_cnt KDDM_ESCSigErrDetTO_s KDDM_ESCSigErrPassTO_s /end REF_CHARACTERISTIC
 /begin REF_MEASUREMENT VDDM_ESC1SigErr_flg VDDM_ESC5SigErr_flg VDDM_ESCSigErrCFSRls_flg VDDM_ESCSigErrDFS_flg VDDM_ESCSigErrPass_flg /end REF_MEASUREMENT
/end GROUP
/begin GROUP S982_EPS1_Checksum_Error "SWC_DDM_type/run_SWC_DDM_5ms_sys/DDM/DDM/VMC_DDM/Enabled Subsystem/EPS1 Checksum Error" /begin SUB_GROUP S1028_DTC_Couter2 S1028_Test_Detection_Criteria /end SUB_GROUP
 /begin REF_CHARACTERISTIC KDDM_EPS1CSErrDTC_cnt KDDM_EPS1CSErrDetTO_s KDDM_EPS1CSErrPassTO_s /end REF_CHARACTERISTIC
 /begin REF_MEASUREMENT VDDM_EPS1CSErrCFSRls_flg VDDM_EPS1CSErrDFS_flg VDDM_EPS1CSErrPass_flg /end REF_MEASUREMENT
/end GROUP
/begin GROUP S982_EPS1_Lost_Comm "SWC_DDM_type/run_SWC_DDM_5ms_sys/DDM/DDM/VMC_DDM/Enabled Subsystem/EPS1 Lost Comm" /begin SUB_GROUP S1029_DTC_Couter2 S1029_Test_Detection_Criteria /end SUB_GROUP
 /begin REF_CHARACTERISTIC KDDM_EPS1NoComDTC_cnt KDDM_EPS1NoComDetTO_s KDDM_EPS1NoComPassTO_s /end REF_CHARACTERISTIC
 /begin REF_MEASUREMENT VDDM_EPS1NoComCFSRls_flg VDDM_EPS1NoComDFS_flg VDDM_EPS1NoComPass_flg /end REF_MEASUREMENT
/end GROUP
/begin GROUP S982_EPS1_Rolling_Count_Error_ "SWC_DDM_type/run_SWC_DDM_5ms_sys/DDM/DDM/VMC_DDM/Enabled Subsystem/EPS1 Rolling Count Error " /begin SUB_GROUP S1030_DTC_Couter2 S1030_Test_Detection_Criteria /end SUB_GROUP
 /begin REF_CHARACTERISTIC KDDM_EPS1RCErrDTC_cnt KDDM_EPS1RCErrDetTO_s KDDM_EPS1RCErrPassTO_s /end REF_CHARACTERISTIC
 /begin REF_MEASUREMENT VDDM_EPS1RCErrCFSRls_flg VDDM_EPS1RCErrDFS_flg VDDM_EPS1RCErrPass_flg /end REF_MEASUREMENT
/end GROUP
/begin GROUP S982_EPS1_Signal_Error "SWC_DDM_type/run_SWC_DDM_5ms_sys/DDM/DDM/VMC_DDM/Enabled Subsystem/EPS1 Signal Error" /begin SUB_GROUP S1031_DTC_Couter2 S1031_Test_Detection_Criteria /end SUB_GROUP
 /begin REF_CHARACTERISTIC KDDM_EPSSigErrDTC_cnt KDDM_EPSSigErrDetTO_s KDDM_EPSSigErrPassTO_s /end REF_CHARACTERISTIC
 /begin REF_MEASUREMENT VDDM_EPSSigErrCFSRls_flg VDDM_EPSSigErrDFS_flg VDDM_EPSSigErrPass_flg /end REF_MEASUREMENT
/end GROUP
/begin GROUP S983_FCM1_Checksum_Error_ "SWC_DDM_type/run_SWC_DDM_5ms_sys/DDM/DDM/VMC_DDM/FCM1/FCM1 Checksum Error " /begin SUB_GROUP S1064_DTC_Couter2 S1064_Test_Detection_Criteria /end SUB_GROUP
 /begin REF_CHARACTERISTIC KDDM_FCM1CSErrDTC_cnt KDDM_FCM1CSErrDetTO_s KDDM_FCM1CSErrPassTO_s /end REF_CHARACTERISTIC
 /begin REF_MEASUREMENT VDDM_FCM1CSErrCFSRls_flg VDDM_FCM1CSErrDFS_flg VDDM_FCM1CSErrPass_flg /end REF_MEASUREMENT
/end GROUP
/begin GROUP S983_FCM1_Lost_Com "SWC_DDM_type/run_SWC_DDM_5ms_sys/DDM/DDM/VMC_DDM/FCM1/FCM1 Lost Com" /begin SUB_GROUP S1065_DTC_Couter2 S1065_Test_Detection_Criteria /end SUB_GROUP
 /begin REF_CHARACTERISTIC KDDM_FCM1NoComDTC_cnt KDDM_FCM1NoComDetTO_s KDDM_FCM1NoComPassTO_s /end REF_CHARACTERISTIC
 /begin REF_MEASUREMENT VDDM_FCM1NoComCFSRls_flg VDDM_FCM1NoComDFS_flg VDDM_FCM1NoComPass_flg /end REF_MEASUREMENT
/end GROUP
/begin GROUP S983_FCM1_Rolling_Count_Error_ "SWC_DDM_type/run_SWC_DDM_5ms_sys/DDM/DDM/VMC_DDM/FCM1/FCM1 Rolling Count Error " /begin SUB_GROUP S1066_DTC_Couter2 S1066_Test_Detection_Criteria /end SUB_GROUP
 /begin REF_CHARACTERISTIC KDDM_FCM1RCErrDTC_cnt KDDM_FCM1RCErrDetTO_s KDDM_FCM1RCErrPassTO_s /end REF_CHARACTERISTIC
 /begin REF_MEASUREMENT VDDM_FCM1RCErrCFSRls_flg VDDM_FCM1RCErrDFS_flg VDDM_FCM1RCErrPass_flg /end REF_MEASUREMENT
/end GROUP
/begin GROUP S984_FCMACC_Signal_Error_ "SWC_DDM_type/run_SWC_DDM_5ms_sys/DDM/DDM/VMC_DDM/FCMACC Signal Error/FCMACC Signal Error "
 /begin SUB_GROUP S1091_DTC_Couter1 S1091_DTC_Info S1091_Test_Detection_Criteria /end SUB_GROUP
 /begin REF_CHARACTERISTIC KDDM_FCMACCSigErrDTC_cnt KDDM_FCMACCSigErrDetTO_s KDDM_FCMACCSigErrPassTO_s /end REF_CHARACTERISTIC
 /begin REF_MEASUREMENT VDDM_FCMACCSigErrCFSRls_flg VDDM_FCMACCSigErrDFS_flg VDDM_FCMACCSigErrPass_flg /end REF_MEASUREMENT
/end GROUP
/begin GROUP S985_MCU_Fr_Signal_Error_ "SWC_DDM_type/run_SWC_DDM_5ms_sys/DDM/DDM/VMC_DDM/MCU_Fr Signal Error/MCU_Fr Signal Error " /begin SUB_GROUP S1100_DTC_Couter1 S1100_Test_Detection_Criteria /end SUB_GROUP
 /begin REF_CHARACTERISTIC KDDM_FrMCUSigErrDTC_cnt KDDM_FrMCUSigErrDetTO_s KDDM_FrMCUSigErrPassTO_s /end REF_CHARACTERISTIC
 /begin REF_MEASUREMENT VDDM_FrMCUSigErrCFSRls_flg VDDM_FrMCUSigErrDFS_flg VDDM_FrMCUSigErrPass_flg /end REF_MEASUREMENT
/end GROUP
/begin GROUP S986_MCU_Rr_Signal_Error_ "SWC_DDM_type/run_SWC_DDM_5ms_sys/DDM/DDM/VMC_DDM/MCU_Rr Signal Error/MCU_Rr Signal Error " /begin SUB_GROUP S1109_DTC_Couter1 S1109_Test_Detection_Criteria /end SUB_GROUP
 /begin REF_CHARACTERISTIC KDDM_RrMCUSigErrDTC_cnt KDDM_RrMCUSigErrDetTO_s KDDM_RrMCUSigErrPassTO_s /end REF_CHARACTERISTIC
 /begin REF_MEASUREMENT VDDM_RrMCUSigErrCFSRls_flg VDDM_RrMCUSigErrDFS_flg VDDM_RrMCUSigErrPass_flg /end REF_MEASUREMENT
/end GROUP
/begin GROUP S987_Shifter_Signal_Error_ "SWC_DDM_type/run_SWC_DDM_5ms_sys/DDM/DDM/VMC_DDM/Shifter Signal Error/Shifter Signal Error " /begin SUB_GROUP S1118_DTC_Couter S1118_Test_Detection_Criteria /end SUB_GROUP
 /begin REF_CHARACTERISTIC KDDM_ShifterSigErrDTC_cnt KDDM_ShifterSigErrDetTO_s KDDM_ShifterSigErrPassTO_s /end REF_CHARACTERISTIC
 /begin REF_MEASUREMENT VDDM_ShifterSigErrCFSRls_flg VDDM_ShifterSigErrDFS_flg VDDM_ShifterSigErrPass_flg /end REF_MEASUREMENT
/end GROUP
/begin GROUP S988_DTC_Couter2 "SWC_DDM_type/run_SWC_DDM_5ms_sys/DDM/DDM/VMC_DDM/Zone_Dr_VCU/DTC_Couter2" /begin REF_MEASUREMENT VDDM_DrVCUNoComCFS_flg VDDM_DrVCUNoComDTC_cnt /end REF_MEASUREMENT /end GROUP
/begin GROUP S988_Test_Detection_Criteria2 "SWC_DDM_type/run_SWC_DDM_5ms_sys/DDM/DDM/VMC_DDM/Zone_Dr_VCU/Test Detection Criteria2" /begin REF_MEASUREMENT VDDM_DrVCUNoComDet_flg /end REF_MEASUREMENT /end GROUP
/begin GROUP S989_DTC_Couter2 "SWC_DDM_type/run_SWC_DDM_5ms_sys/DDM/DDM/VMC_DDM/Zone_Fr_VCU/DTC_Couter2" /begin REF_MEASUREMENT VDDM_FrVCUNoComCFS_flg VDDM_FrVCUNoComDTC_cnt /end REF_MEASUREMENT /end GROUP
/begin GROUP S989_Test_Detection_Criteria2 "SWC_DDM_type/run_SWC_DDM_5ms_sys/DDM/DDM/VMC_DDM/Zone_Fr_VCU/Test Detection Criteria2" /begin REF_MEASUREMENT VDDM_FrVCUNoComDet_flg /end REF_MEASUREMENT /end GROUP
/begin GROUP S990_Zone_dr_Error_ "SWC_DDM_type/run_SWC_DDM_5ms_sys/DDM/DDM/VMC_DDM/Zone_dr Error/Zone_dr Error " /begin SUB_GROUP S1143_DTC_Couter S1143_Test_Detection_Criteria /end SUB_GROUP
 /begin REF_CHARACTERISTIC KDDM_ZoneDrSigErrDTC_cnt KDDM_ZoneDrSigErrDetTO_s KDDM_ZoneDrSigErrPassTO_s /end REF_CHARACTERISTIC
 /begin REF_MEASUREMENT VDDM_ZoneDrSigErrCFSRls_flg VDDM_ZoneDrSigErrDFS_flg VDDM_ZoneDrSigErrPass_flg /end REF_MEASUREMENT
/end GROUP
/begin GROUP S991_Zone_fr_Error_ "SWC_DDM_type/run_SWC_DDM_5ms_sys/DDM/DDM/VMC_DDM/Zone_fr Error/Zone_fr Error " /begin SUB_GROUP S1152_DTC_Couter S1152_Test_Detection_Criteria /end SUB_GROUP
 /begin REF_CHARACTERISTIC KDDM_ZoneFrSigErrDTC_cnt KDDM_ZoneFrSigErrDetTO_s KDDM_ZoneFrSigErrPassTO_s /end REF_CHARACTERISTIC
 /begin REF_MEASUREMENT VDDM_ZoneFrSigErrCFSRls_flg VDDM_ZoneFrSigErrDFS_flg VDDM_ZoneFrSigErrPass_flg /end REF_MEASUREMENT
/end GROUP
/begin GROUP S72_DTC_Couter1 "SWC_DDM_type/run_SWC_DDM_5ms_sys/DDM/DDM/PMM/Brake switch signal abnormal/Brake switch signal abnormal/DTC_Couter1" /begin REF_MEASUREMENT VDDM_BrkSWErrCFS_flg VDDM_BrkSWErrDTC_cnt /end REF_MEASUREMENT /end GROUP
/begin GROUP S72_Test_Detection_Criteria1 "SWC_DDM_type/run_SWC_DDM_5ms_sys/DDM/DDM/PMM/Brake switch signal abnormal/Brake switch signal abnormal/Test Detection Criteria1" /begin REF_MEASUREMENT VDDM_BrkSWErrDet_flg /end REF_MEASUREMENT /end GROUP
/begin GROUP S73_DTC_Couter1 "SWC_DDM_type/run_SWC_DDM_5ms_sys/DDM/DDM/PMM/Brake switch signal abnormal/Brake switch signal abnormal and no backup signal/DTC_Couter1" /begin REF_MEASUREMENT VDDM_BrkSWNoBacCFS_flg VDDM_BrkSWNoBacDTC_cnt /end REF_MEASUREMENT /end GROUP
/begin GROUP S73_Test_Detection_Criteria1 "SWC_DDM_type/run_SWC_DDM_5ms_sys/DDM/DDM/PMM/Brake switch signal abnormal/Brake switch signal abnormal and no backup signal/Test Detection Criteria1" /begin REF_MEASUREMENT VDDM_BrkSWNoBacDet_flg /end REF_MEASUREMENT /end GROUP
/begin GROUP S91_DTC_Couter1 "SWC_DDM_type/run_SWC_DDM_5ms_sys/DDM/DDM/PMM/Comm err/The CAN signal between VCU and ABM1 is discontinuous/DTC_Couter1" /begin REF_MEASUREMENT VDDM_C1ABM1RCCFS_flg VDDM_C1ABM1RCDTC_cnt /end REF_MEASUREMENT /end GROUP
/begin GROUP S91_Test_Detection_Criteria1 "SWC_DDM_type/run_SWC_DDM_5ms_sys/DDM/DDM/PMM/Comm err/The CAN signal between VCU and ABM1 is discontinuous/Test Detection Criteria1" /begin REF_MEASUREMENT VDDM_C1ABM1RCDet_flg /end REF_MEASUREMENT /end GROUP
/begin GROUP S92_DTC_Couter1 "SWC_DDM_type/run_SWC_DDM_5ms_sys/DDM/DDM/PMM/Comm err/The CAN signal between VCU and ABM1 is incomplete/DTC_Couter1" /begin REF_MEASUREMENT VDDM_C1ABM1CSCFS_flg VDDM_C1ABM1CSDTC_cnt /end REF_MEASUREMENT /end GROUP
/begin GROUP S92_Test_Detection_Criteria1 "SWC_DDM_type/run_SWC_DDM_5ms_sys/DDM/DDM/PMM/Comm err/The CAN signal between VCU and ABM1 is incomplete/Test Detection Criteria1" /begin REF_MEASUREMENT VDDM_C1ABM1CSDet_flg /end REF_MEASUREMENT /end GROUP
/begin GROUP S93_DTC_Couter1 "SWC_DDM_type/run_SWC_DDM_5ms_sys/DDM/DDM/PMM/Comm err/The CAN signal between VCU and BMS1 is discontinuous/DTC_Couter1" /begin REF_MEASUREMENT VDDM_C3BMS1RCCFS_flg VDDM_C3BMS1RCDTC_cnt /end REF_MEASUREMENT /end GROUP
/begin GROUP S93_Test_Detection_Criteria "SWC_DDM_type/run_SWC_DDM_5ms_sys/DDM/DDM/PMM/Comm err/The CAN signal between VCU and BMS1 is discontinuous/Test Detection Criteria" /begin REF_MEASUREMENT VDDM_C3BMS1RCDet_flg /end REF_MEASUREMENT /end GROUP
/begin GROUP S94_DTC_Couter1 "SWC_DDM_type/run_SWC_DDM_5ms_sys/DDM/DDM/PMM/Comm err/The CAN signal between VCU and BMS1 is incomplete/DTC_Couter1" /begin REF_MEASUREMENT VDDM_C3BMS1CSCFS_flg VDDM_C3BMS1CSDTC_cnt /end REF_MEASUREMENT /end GROUP
/begin GROUP S94_Test_Detection_Criteria1 "SWC_DDM_type/run_SWC_DDM_5ms_sys/DDM/DDM/PMM/Comm err/The CAN signal between VCU and BMS1 is incomplete/Test Detection Criteria1" /begin REF_MEASUREMENT VDDM_C3BMS1CSDet_flg /end REF_MEASUREMENT /end GROUP
/begin GROUP S95_DTC_Couter "SWC_DDM_type/run_SWC_DDM_5ms_sys/DDM/DDM/PMM/Comm err/The CAN signal between VCU and BMS6 is discontinuous/DTC_Couter" /begin REF_MEASUREMENT VDDM_C3BMS6RCCFS_flg VDDM_C3BMS6RCDTC_cnt /end REF_MEASUREMENT /end GROUP
/begin GROUP S95_Test_Detection_Criteria "SWC_DDM_type/run_SWC_DDM_5ms_sys/DDM/DDM/PMM/Comm err/The CAN signal between VCU and BMS6 is discontinuous/Test Detection Criteria" /begin REF_MEASUREMENT VDDM_C3BMS6RCDet_flg /end REF_MEASUREMENT /end GROUP
/begin GROUP S96_DTC_Couter1 "SWC_DDM_type/run_SWC_DDM_5ms_sys/DDM/DDM/PMM/Comm err/The CAN signal between VCU and BMS6 is incomplete/DTC_Couter1" /begin REF_MEASUREMENT VDDM_C3BMS6CSCFS_flg VDDM_C3BMS6CSDTC_cnt /end REF_MEASUREMENT /end GROUP
/begin GROUP S96_Test_Detection_Criteria1 "SWC_DDM_type/run_SWC_DDM_5ms_sys/DDM/DDM/PMM/Comm err/The CAN signal between VCU and BMS6 is incomplete/Test Detection Criteria1" /begin REF_MEASUREMENT VDDM_C3BMS6CSDet_flg /end REF_MEASUREMENT /end GROUP
/begin GROUP S97_DTC_Couter1 "SWC_DDM_type/run_SWC_DDM_5ms_sys/DDM/DDM/PMM/Comm err/The CAN signal between VCU and CCU1 is discontinuous/DTC_Couter1" /begin REF_MEASUREMENT VDDM_C3CCU1RCCFS_flg VDDM_C3CCU1RCDTC_cnt /end REF_MEASUREMENT /end GROUP
/begin GROUP S97_Test_Detection_Criteria1 "SWC_DDM_type/run_SWC_DDM_5ms_sys/DDM/DDM/PMM/Comm err/The CAN signal between VCU and CCU1 is discontinuous/Test Detection Criteria1" /begin REF_MEASUREMENT VDDM_C3CCU1RCDet_flg /end REF_MEASUREMENT /end GROUP
/begin GROUP S98_DTC_Couter1 "SWC_DDM_type/run_SWC_DDM_5ms_sys/DDM/DDM/PMM/Comm err/The CAN signal between VCU and CCU1 is incomplete/DTC_Couter1" /begin REF_MEASUREMENT VDDM_C3CCU1CSCFS_flg VDDM_C3CCU1CSDTC_cnt /end REF_MEASUREMENT /end GROUP
/begin GROUP S98_Test_Detection_Criteria1 "SWC_DDM_type/run_SWC_DDM_5ms_sys/DDM/DDM/PMM/Comm err/The CAN signal between VCU and CCU1 is incomplete/Test Detection Criteria1" /begin REF_MEASUREMENT VDDM_C3CCU1CSDet_flg /end REF_MEASUREMENT /end GROUP
/begin GROUP S99_DTC_Couter1 "SWC_DDM_type/run_SWC_DDM_5ms_sys/DDM/DDM/PMM/Comm err/The CAN signal between VCU and CCU2 is discontinuous/DTC_Couter1" /begin REF_MEASUREMENT VDDM_C3CCU2RCCFS_flg VDDM_C3CCU2RCDTC_cnt /end REF_MEASUREMENT /end GROUP
/begin GROUP S99_Test_Detection_Criteria1 "SWC_DDM_type/run_SWC_DDM_5ms_sys/DDM/DDM/PMM/Comm err/The CAN signal between VCU and CCU2 is discontinuous/Test Detection Criteria1" /begin REF_MEASUREMENT VDDM_C3CCU2RCDet_flg /end REF_MEASUREMENT /end GROUP
/begin GROUP S100_DTC_Couter1 "SWC_DDM_type/run_SWC_DDM_5ms_sys/DDM/DDM/PMM/Comm err/The CAN signal between VCU and CCU2 is incomplete/DTC_Couter1" /begin REF_MEASUREMENT VDDM_C3CCU2CSCFS_flg VDDM_C3CCU2CSDTC_cnt /end REF_MEASUREMENT /end GROUP
/begin GROUP S100_Test_Detection_Criteria1 "SWC_DDM_type/run_SWC_DDM_5ms_sys/DDM/DDM/PMM/Comm err/The CAN signal between VCU and CCU2 is incomplete/Test Detection Criteria1" /begin REF_MEASUREMENT VDDM_C3CCU2CSDet_flg /end REF_MEASUREMENT /end GROUP
/begin GROUP S101_DTC_Couter1 "SWC_DDM_type/run_SWC_DDM_5ms_sys/DDM/DDM/PMM/Comm err/VCU lost communication with ABM1/DTC_Couter1" /begin REF_MEASUREMENT VDDM_C1ABM1LCCFS_flg VDDM_C1ABM1LCDTC_cnt /end REF_MEASUREMENT /end GROUP
/begin GROUP S101_Test_Detection_Criteria1 "SWC_DDM_type/run_SWC_DDM_5ms_sys/DDM/DDM/PMM/Comm err/VCU lost communication with ABM1/Test Detection Criteria1" /begin REF_MEASUREMENT VDDM_C1ABM1LCDet_flg /end REF_MEASUREMENT /end GROUP
/begin GROUP S102_DTC_Couter1 "SWC_DDM_type/run_SWC_DDM_5ms_sys/DDM/DDM/PMM/Comm err/VCU lost communication with BMS1/DTC_Couter1" /begin REF_MEASUREMENT VDDM_C3BMS1LCCFS_flg VDDM_C3BMS1LCDTC_cnt /end REF_MEASUREMENT /end GROUP
/begin GROUP S102_Test_Detection_Criteria1 "SWC_DDM_type/run_SWC_DDM_5ms_sys/DDM/DDM/PMM/Comm err/VCU lost communication with BMS1/Test Detection Criteria1" /begin REF_MEASUREMENT VDDM_C3BMS1LCDet_flg /end REF_MEASUREMENT /end GROUP
/begin GROUP S103_DTC_Couter1 "SWC_DDM_type/run_SWC_DDM_5ms_sys/DDM/DDM/PMM/Comm err/VCU lost communication with BMS6/DTC_Couter1" /begin REF_MEASUREMENT VDDM_C3BMS6LCCFS_flg VDDM_C3BMS6LCDTC_cnt /end REF_MEASUREMENT /end GROUP
/begin GROUP S103_Test_Detection_Criteria1 "SWC_DDM_type/run_SWC_DDM_5ms_sys/DDM/DDM/PMM/Comm err/VCU lost communication with BMS6/Test Detection Criteria1" /begin REF_MEASUREMENT VDDM_C3BMS6LCDet_flg /end REF_MEASUREMENT /end GROUP
/begin GROUP S104_DTC_Couter1 "SWC_DDM_type/run_SWC_DDM_5ms_sys/DDM/DDM/PMM/Comm err/VCU lost communication with CCU1/DTC_Couter1" /begin REF_MEASUREMENT VDDM_C3CCU1LCCFS_flg VDDM_C3CCU1LCDTC_cnt /end REF_MEASUREMENT /end GROUP
/begin GROUP S104_Test_Detection_Criteria1 "SWC_DDM_type/run_SWC_DDM_5ms_sys/DDM/DDM/PMM/Comm err/VCU lost communication with CCU1/Test Detection Criteria1" /begin REF_MEASUREMENT VDDM_C3CCU1LCDet_flg /end REF_MEASUREMENT /end GROUP
/begin GROUP S105_DTC_Couter1 "SWC_DDM_type/run_SWC_DDM_5ms_sys/DDM/DDM/PMM/Comm err/VCU lost communication with CCU2/DTC_Couter1" /begin REF_MEASUREMENT VDDM_C3CCU2LCCFS_flg VDDM_C3CCU2LCDTC_cnt /end REF_MEASUREMENT /end GROUP
/begin GROUP S105_Test_Detection_Criteria1 "SWC_DDM_type/run_SWC_DDM_5ms_sys/DDM/DDM/PMM/Comm err/VCU lost communication with CCU2/Test Detection Criteria1" /begin REF_MEASUREMENT VDDM_C3CCU2LCDet_flg /end REF_MEASUREMENT /end GROUP
/begin GROUP S226_DTC_Couter "SWC_DDM_type/run_SWC_DDM_5ms_sys/DDM/DDM/PMM/Fault level/Fault level 1 subsystem error/DTC_Couter" /begin REF_MEASUREMENT VDDM_Lv1ErrCFS_flg VDDM_Lv1ErrDTC_cnt /end REF_MEASUREMENT /end GROUP
/begin GROUP S226_Test_Detection_Criteria "SWC_DDM_type/run_SWC_DDM_5ms_sys/DDM/DDM/PMM/Fault level/Fault level 1 subsystem error/Test Detection Criteria" /begin REF_MEASUREMENT VDDM_Lv1ErrDet_flg /end REF_MEASUREMENT /end GROUP
/begin GROUP S227_DTC_Couter "SWC_DDM_type/run_SWC_DDM_5ms_sys/DDM/DDM/PMM/Fault level/Fault level 2 subsystem error/DTC_Couter" /begin REF_MEASUREMENT VDDM_Lv2ErrCFS_flg VDDM_Lv2ErrDTC_cnt /end REF_MEASUREMENT /end GROUP
/begin GROUP S227_Test_Detection_Criteria "SWC_DDM_type/run_SWC_DDM_5ms_sys/DDM/DDM/PMM/Fault level/Fault level 2 subsystem error/Test Detection Criteria" /begin REF_MEASUREMENT VDDM_Lv2ErrDet_flg /end REF_MEASUREMENT /end GROUP
/begin GROUP S228_DTC_Couter "SWC_DDM_type/run_SWC_DDM_5ms_sys/DDM/DDM/PMM/Fault level/Fault level 3 subsystem error/DTC_Couter" /begin REF_MEASUREMENT VDDM_Lv3ErrCFS_flg VDDM_Lv3ErrDTC_cnt /end REF_MEASUREMENT /end GROUP
/begin GROUP S228_Test_Detection_Criteria "SWC_DDM_type/run_SWC_DDM_5ms_sys/DDM/DDM/PMM/Fault level/Fault level 3 subsystem error/Test Detection Criteria" /begin REF_MEASUREMENT VDDM_Lv3ErrDet_flg /end REF_MEASUREMENT /end GROUP
/begin GROUP S229_DTC_Couter "SWC_DDM_type/run_SWC_DDM_5ms_sys/DDM/DDM/PMM/Fault level/Fault level 4 subsystem error1/DTC_Couter" /begin REF_MEASUREMENT VDDM_Lv4ErrCFS_flg VDDM_Lv4ErrDTC_cnt /end REF_MEASUREMENT /end GROUP
/begin GROUP S229_Test_Detection_Criteria "SWC_DDM_type/run_SWC_DDM_5ms_sys/DDM/DDM/PMM/Fault level/Fault level 4 subsystem error1/Test Detection Criteria" /begin REF_MEASUREMENT VDDM_Lv4ErrDet_flg /end REF_MEASUREMENT /end GROUP
/begin GROUP S270_DTC_Couter1 "SWC_DDM_type/run_SWC_DDM_5ms_sys/DDM/DDM/PMM/LV/Initial LV battery voltage too low/DTC_Couter1" /begin REF_MEASUREMENT VDDM_IniLVLoCFS_flg VDDM_IniLVLoDTC_cnt /end REF_MEASUREMENT /end GROUP
/begin GROUP S270_Test_Detection_Criteria1 "SWC_DDM_type/run_SWC_DDM_5ms_sys/DDM/DDM/PMM/LV/Initial LV battery voltage too low/Test Detection Criteria1" /begin REF_MEASUREMENT VDDM_IniLVLoDet_flg /end REF_MEASUREMENT /end GROUP
/begin GROUP S271_DTC_Couter1 "SWC_DDM_type/run_SWC_DDM_5ms_sys/DDM/DDM/PMM/LV/LV analog input error/DTC_Couter1" /begin REF_MEASUREMENT VDDM_LVInErrCFS_flg VDDM_LVInErrDTC_cnt /end REF_MEASUREMENT /end GROUP
/begin GROUP S271_Test_Detection_Criteria1 "SWC_DDM_type/run_SWC_DDM_5ms_sys/DDM/DDM/PMM/LV/LV analog input error/Test Detection Criteria1" /begin REF_MEASUREMENT VDDM_LVInErrDet_flg /end REF_MEASUREMENT /end GROUP
/begin GROUP S272_DTC_Couter1 "SWC_DDM_type/run_SWC_DDM_5ms_sys/DDM/DDM/PMM/LV/LV power supply voltage too high/DTC_Couter1" /begin REF_MEASUREMENT VDDM_LVSupHiCFS_flg VDDM_LVSupHiDTC_cnt /end REF_MEASUREMENT /end GROUP
/begin GROUP S272_Test_Detection_Criteria1 "SWC_DDM_type/run_SWC_DDM_5ms_sys/DDM/DDM/PMM/LV/LV power supply voltage too high/Test Detection Criteria1" /begin REF_MEASUREMENT VDDM_LVSupHiDet_flg /end REF_MEASUREMENT /end GROUP
/begin GROUP S273_DTC_Couter1 "SWC_DDM_type/run_SWC_DDM_5ms_sys/DDM/DDM/PMM/LV/LV power supply voltage too low/DTC_Couter1" /begin REF_MEASUREMENT VDDM_LVSupLoCFS_flg VDDM_LVSupLoDTC_cnt /end REF_MEASUREMENT /end GROUP
/begin GROUP S273_Test_Detection_Criteria1 "SWC_DDM_type/run_SWC_DDM_5ms_sys/DDM/DDM/PMM/LV/LV power supply voltage too low/Test Detection Criteria1" /begin REF_MEASUREMENT VDDM_LVSupLoDet_flg /end REF_MEASUREMENT /end GROUP
/begin GROUP S306_DTC_Couter2 "SWC_DDM_type/run_SWC_DDM_5ms_sys/DDM/DDM/PMM/SW failure/Driver seat switch failure/DTC_Couter2" /begin REF_MEASUREMENT VDDM_DrStSWCFS_flg VDDM_DrStSWDTC_cnt /end REF_MEASUREMENT /end GROUP
/begin GROUP S306_Test_Detection_Criteria2 "SWC_DDM_type/run_SWC_DDM_5ms_sys/DDM/DDM/PMM/SW failure/Driver seat switch failure/Test Detection Criteria2" /begin REF_MEASUREMENT VDDM_DrStSWDet_flg /end REF_MEASUREMENT /end GROUP
/begin GROUP S307_DTC_Couter2 "SWC_DDM_type/run_SWC_DDM_5ms_sys/DDM/DDM/PMM/SW failure/FL Door switch failure/DTC_Couter2" /begin REF_MEASUREMENT VDDM_FLDoorSWCFS_flg VDDM_FLDoorSWDTC_cnt /end REF_MEASUREMENT /end GROUP
/begin GROUP S307_Test_Detection_Criteria2 "SWC_DDM_type/run_SWC_DDM_5ms_sys/DDM/DDM/PMM/SW failure/FL Door switch failure/Test Detection Criteria2" /begin REF_MEASUREMENT VDDM_FLDoorSWDet_flg /end REF_MEASUREMENT /end GROUP
/begin GROUP S308_DTC_Couter2 "SWC_DDM_type/run_SWC_DDM_5ms_sys/DDM/DDM/PMM/SW failure/FR Door switch failure/DTC_Couter2" /begin REF_MEASUREMENT VDDM_FRDoorSWCFS_flg VDDM_FRDoorSWDTC_cnt /end REF_MEASUREMENT /end GROUP
/begin GROUP S308_Test_Detection_Criteria2 "SWC_DDM_type/run_SWC_DDM_5ms_sys/DDM/DDM/PMM/SW failure/FR Door switch failure/Test Detection Criteria2" /begin REF_MEASUREMENT VDDM_FRDoorSWDet_flg /end REF_MEASUREMENT /end GROUP
/begin GROUP S309_DTC_Couter2 "SWC_DDM_type/run_SWC_DDM_5ms_sys/DDM/DDM/PMM/SW failure/Hood switch failure/DTC_Couter2" /begin REF_MEASUREMENT VDDM_HoodSWCFS_flg VDDM_HoodSWDTC_cnt /end REF_MEASUREMENT /end GROUP
/begin GROUP S309_Test_Detection_Criteria2 "SWC_DDM_type/run_SWC_DDM_5ms_sys/DDM/DDM/PMM/SW failure/Hood switch failure/Test Detection Criteria2" /begin REF_MEASUREMENT VDDM_HoodSWDet_flg /end REF_MEASUREMENT /end GROUP
/begin GROUP S310_DTC_Couter2 "SWC_DDM_type/run_SWC_DDM_5ms_sys/DDM/DDM/PMM/SW failure/RL Door switch failure/DTC_Couter2" /begin REF_MEASUREMENT VDDM_RLDoorSWCFS_flg VDDM_RLDoorSWDTC_cnt /end REF_MEASUREMENT /end GROUP
/begin GROUP S310_Test_Detection_Criteria2 "SWC_DDM_type/run_SWC_DDM_5ms_sys/DDM/DDM/PMM/SW failure/RL Door switch failure/Test Detection Criteria2" /begin REF_MEASUREMENT VDDM_RLDoorSWDet_flg /end REF_MEASUREMENT /end GROUP
/begin GROUP S311_DTC_Couter2 "SWC_DDM_type/run_SWC_DDM_5ms_sys/DDM/DDM/PMM/SW failure/RR Door switch failure/DTC_Couter2" /begin REF_MEASUREMENT VDDM_RRDoorSWCFS_flg VDDM_RRDoorSWDTC_cnt /end REF_MEASUREMENT /end GROUP
/begin GROUP S311_Test_Detection_Criteria2 "SWC_DDM_type/run_SWC_DDM_5ms_sys/DDM/DDM/PMM/SW failure/RR Door switch failure/Test Detection Criteria2" /begin REF_MEASUREMENT VDDM_RRDoorSWDet_flg /end REF_MEASUREMENT /end GROUP
/begin GROUP S312_DTC_Couter2 "SWC_DDM_type/run_SWC_DDM_5ms_sys/DDM/DDM/PMM/SW failure/Tailgate switch failure/DTC_Couter2" /begin REF_MEASUREMENT VDDM_TailgaSWCFS_flg VDDM_TailgaSWDTC_cnt /end REF_MEASUREMENT /end GROUP
/begin GROUP S312_Test_Detection_Criteria2 "SWC_DDM_type/run_SWC_DDM_5ms_sys/DDM/DDM/PMM/SW failure/Tailgate switch failure/Test Detection Criteria2" /begin REF_MEASUREMENT VDDM_TailgaSWDet_flg /end REF_MEASUREMENT /end GROUP
/begin GROUP S405_DTC_Couter1 "SWC_DDM_type/run_SWC_DDM_5ms_sys/DDM/DDM/PMM/power up and power down/BMS HV relay closed fail/DTC_Couter1" /begin REF_MEASUREMENT VDDM_HVRlyCloCFS_flg VDDM_HVRlyCloDTC_cnt /end REF_MEASUREMENT /end GROUP
/begin GROUP S405_Test_Detection_Criteria1 "SWC_DDM_type/run_SWC_DDM_5ms_sys/DDM/DDM/PMM/power up and power down/BMS HV relay closed fail/Test Detection Criteria1" /begin REF_MEASUREMENT VDDM_HVRlyCloDet_flg /end REF_MEASUREMENT /end GROUP
/begin GROUP S406_DTC_Couter1 "SWC_DDM_type/run_SWC_DDM_5ms_sys/DDM/DDM/PMM/power up and power down/BMS HV relay opened fail/DTC_Couter1" /begin REF_MEASUREMENT VDDM_HVRlyOpCFS_flg VDDM_HVRlyOpDTC_cnt /end REF_MEASUREMENT /end GROUP
/begin GROUP S406_Test_Detection_Criteria1 "SWC_DDM_type/run_SWC_DDM_5ms_sys/DDM/DDM/PMM/power up and power down/BMS HV relay opened fail/Test Detection Criteria1" /begin REF_MEASUREMENT VDDM_HVRlyOpDet_flg /end REF_MEASUREMENT /end GROUP
/begin GROUP S407_DTC_Couter1 "SWC_DDM_type/run_SWC_DDM_5ms_sys/DDM/DDM/PMM/power up and power down/BMS ready fail/DTC_Couter1" /begin REF_MEASUREMENT VDDM_BMSRdyCFS_flg VDDM_BMSRdyDTC_cnt /end REF_MEASUREMENT /end GROUP
/begin GROUP S407_Test_Detection_Criteria1 "SWC_DDM_type/run_SWC_DDM_5ms_sys/DDM/DDM/PMM/power up and power down/BMS ready fail/Test Detection Criteria1" /begin REF_MEASUREMENT VDDM_BMSRdyDet_flg /end REF_MEASUREMENT /end GROUP
/begin GROUP S408_DTC_Couter1 "SWC_DDM_type/run_SWC_DDM_5ms_sys/DDM/DDM/PMM/power up and power down/DCDC disable fail/DTC_Couter1" /begin REF_MEASUREMENT VDDM_DCDCDisCFS_flg VDDM_DCDCDisDTC_cnt /end REF_MEASUREMENT /end GROUP
/begin GROUP S408_Test_Detection_Criteria1 "SWC_DDM_type/run_SWC_DDM_5ms_sys/DDM/DDM/PMM/power up and power down/DCDC disable fail/Test Detection Criteria1" /begin REF_MEASUREMENT VDDM_DCDCDisDet_flg /end REF_MEASUREMENT /end GROUP
/begin GROUP S409_DTC_Couter1 "SWC_DDM_type/run_SWC_DDM_5ms_sys/DDM/DDM/PMM/power up and power down/DCDC enable fail/DTC_Couter1" /begin REF_MEASUREMENT VDDM_DCDCEnaCFS_flg VDDM_DCDCEnaDTC_cnt /end REF_MEASUREMENT /end GROUP
/begin GROUP S409_Test_Detection_Criteria1 "SWC_DDM_type/run_SWC_DDM_5ms_sys/DDM/DDM/PMM/power up and power down/DCDC enable fail/Test Detection Criteria1" /begin REF_MEASUREMENT VDDM_DCDCEnaDet_flg /end REF_MEASUREMENT /end GROUP
/begin GROUP S410_DTC_Couter1 "SWC_DDM_type/run_SWC_DDM_5ms_sys/DDM/DDM/PMM/power up and power down/DCDC ready for precharge fail/DTC_Couter1" /begin REF_MEASUREMENT VDDM_DCDC4PreCFS_flg VDDM_DCDC4PreDTC_cnt /end REF_MEASUREMENT /end GROUP
/begin GROUP S410_Test_Detection_Criteria1 "SWC_DDM_type/run_SWC_DDM_5ms_sys/DDM/DDM/PMM/power up and power down/DCDC ready for precharge fail/Test Detection Criteria1" /begin REF_MEASUREMENT VDDM_DCDC4PreDet_flg /end REF_MEASUREMENT /end GROUP
/begin GROUP S411_DTC_Couter1 "SWC_DDM_type/run_SWC_DDM_5ms_sys/DDM/DDM/PMM/power up and power down/HVB ready for precharge fail/DTC_Couter1" /begin REF_MEASUREMENT VDDM_HVB4PreCFS_flg VDDM_HVB4PreDTC_cnt /end REF_MEASUREMENT /end GROUP
/begin GROUP S411_Test_Detection_Criteria "SWC_DDM_type/run_SWC_DDM_5ms_sys/DDM/DDM/PMM/power up and power down/HVB ready for precharge fail/Test Detection Criteria" /begin REF_MEASUREMENT VDDM_HVB4PreDet_flg /end REF_MEASUREMENT /end GROUP
/begin GROUP S412_DTC_Couter1 "SWC_DDM_type/run_SWC_DDM_5ms_sys/DDM/DDM/PMM/power up and power down/High level system safety check fail/DTC_Couter1" /begin REF_MEASUREMENT VDDM_HiLvSaChkCFS_flg VDDM_HiLvSaChkDTC_cnt /end REF_MEASUREMENT /end GROUP
/begin GROUP S412_Test_Detection_Criteria1 "SWC_DDM_type/run_SWC_DDM_5ms_sys/DDM/DDM/PMM/power up and power down/High level system safety check fail/Test Detection Criteria1" /begin REF_MEASUREMENT VDDM_HiLvSaChkDet_flg /end REF_MEASUREMENT /end GROUP
/begin GROUP S413_DTC_Couter1 "SWC_DDM_type/run_SWC_DDM_5ms_sys/DDM/DDM/PMM/power up and power down/MCU active discharge fail/DTC_Couter1" /begin REF_MEASUREMENT VDDM_MCUActCFS_flg VDDM_MCUActDTC_cnt /end REF_MEASUREMENT /end GROUP
/begin GROUP S413_Test_Detection_Criteria1 "SWC_DDM_type/run_SWC_DDM_5ms_sys/DDM/DDM/PMM/power up and power down/MCU active discharge fail/Test Detection Criteria1" /begin REF_MEASUREMENT VDDM_MCUActDet_flg /end REF_MEASUREMENT /end GROUP
/begin GROUP S414_DTC_Couter1 "SWC_DDM_type/run_SWC_DDM_5ms_sys/DDM/DDM/PMM/power up and power down/MCU disable fail/DTC_Couter1" /begin REF_MEASUREMENT VDDM_MCUDisCFS_flg VDDM_MCUDisDTC_cnt /end REF_MEASUREMENT /end GROUP
/begin GROUP S414_Test_Detection_Criteria1 "SWC_DDM_type/run_SWC_DDM_5ms_sys/DDM/DDM/PMM/power up and power down/MCU disable fail/Test Detection Criteria1" /begin REF_MEASUREMENT VDDM_MCUDisDet_flg /end REF_MEASUREMENT /end GROUP
/begin GROUP S415_DTC_Couter1 "SWC_DDM_type/run_SWC_DDM_5ms_sys/DDM/DDM/PMM/power up and power down/MCU ready for precharge fail/DTC_Couter1" /begin REF_MEASUREMENT VDDM_MCU4PreCFS_flg VDDM_MCU4PreDTC_cnt /end REF_MEASUREMENT /end GROUP
/begin GROUP S415_Test_Detection_Criteria1 "SWC_DDM_type/run_SWC_DDM_5ms_sys/DDM/DDM/PMM/power up and power down/MCU ready for precharge fail/Test Detection Criteria1" /begin REF_MEASUREMENT VDDM_MCU4PreDet_flg /end REF_MEASUREMENT /end GROUP
/begin GROUP S416_DTC_Couter1 "SWC_DDM_type/run_SWC_DDM_5ms_sys/DDM/DDM/PMM/power up and power down/Mid level system safety check fail/DTC_Couter1" /begin REF_MEASUREMENT VDDM_MidLvSaChkCFS_flg VDDM_MidLvSaChkDTC_cnt /end REF_MEASUREMENT /end GROUP
/begin GROUP S416_Test_Detection_Criteria1 "SWC_DDM_type/run_SWC_DDM_5ms_sys/DDM/DDM/PMM/power up and power down/Mid level system safety check fail/Test Detection Criteria1" /begin REF_MEASUREMENT VDDM_MidLvSaChkDet_flg /end REF_MEASUREMENT /end GROUP
/begin GROUP S417_DTC_Couter1 "SWC_DDM_type/run_SWC_DDM_5ms_sys/DDM/DDM/PMM/power up and power down/OBC ready for precharge fail/DTC_Couter1" /begin REF_MEASUREMENT VDDM_OBC4PreCFS_flg VDDM_OBC4PreDTC_cnt /end REF_MEASUREMENT /end GROUP
/begin GROUP S417_Test_Detection_Criteria1 "SWC_DDM_type/run_SWC_DDM_5ms_sys/DDM/DDM/PMM/power up and power down/OBC ready for precharge fail/Test Detection Criteria1" /begin REF_MEASUREMENT VDDM_OBC4PreDet_flg /end REF_MEASUREMENT /end GROUP
/begin GROUP S992_DTC_Couter1 "SWC_DDM_type/run_SWC_DDM_5ms_sys/DDM/DDM/VMC_DDM/ACC Acceleration Command Error/ACC Acceleration Command Error /DTC_Couter1" /begin REF_MEASUREMENT VDDM_ACCAccelCmdErrCFS_flg VDDM_ACCAccelCmdErrDTC_cnt /end REF_MEASUREMENT /end GROUP
/begin GROUP S992_Test_Detection_Criteria "SWC_DDM_type/run_SWC_DDM_5ms_sys/DDM/DDM/VMC_DDM/ACC Acceleration Command Error/ACC Acceleration Command Error /Test Detection Criteria" /begin REF_MEASUREMENT VDDM_ACCAccelCmdErrDet_flg /end REF_MEASUREMENT /end GROUP
/begin GROUP S1001_DTC_Couter1 "SWC_DDM_type/run_SWC_DDM_5ms_sys/DDM/DDM/VMC_DDM/BMS Signal Error /BMS Signal Error /DTC_Couter1" /begin REF_MEASUREMENT VDDM_BMSSigErrCFS_flg VDDM_BMSSigErrDTC_cnt /end REF_MEASUREMENT /end GROUP
/begin GROUP S1001_Test_Detection_Criteria "SWC_DDM_type/run_SWC_DDM_5ms_sys/DDM/DDM/VMC_DDM/BMS Signal Error /BMS Signal Error /Test Detection Criteria" /begin REF_MEASUREMENT VDDM_BMSSigErrDet_flg /end REF_MEASUREMENT /end GROUP
/begin GROUP S1010_DTC_Couter1 "SWC_DDM_type/run_SWC_DDM_5ms_sys/DDM/DDM/VMC_DDM/CCU Signal Error/CCU Signal Error /DTC_Couter1" /begin REF_MEASUREMENT VDDM_CCUSigErrCFS_flg VDDM_CCUSigErrDTC_cnt /end REF_MEASUREMENT /end GROUP
/begin GROUP S1010_Test_Detection_Criteria "SWC_DDM_type/run_SWC_DDM_5ms_sys/DDM/DDM/VMC_DDM/CCU Signal Error/CCU Signal Error /Test Detection Criteria" /begin REF_MEASUREMENT VDDM_CCUSigErrDet_flg /end REF_MEASUREMENT /end GROUP
/begin GROUP S1019_DTC_Couter "SWC_DDM_type/run_SWC_DDM_5ms_sys/DDM/DDM/VMC_DDM/ESC Signal Error/ESC Signal Error /DTC_Couter" /begin REF_MEASUREMENT VDDM_ESCSigErrCFS_flg VDDM_ESCSigErrDTC_cnt /end REF_MEASUREMENT /end GROUP
/begin GROUP S1019_Test_Detection_Criteria "SWC_DDM_type/run_SWC_DDM_5ms_sys/DDM/DDM/VMC_DDM/ESC Signal Error/ESC Signal Error /Test Detection Criteria" /begin REF_MEASUREMENT VDDM_ESCSigErrDet_flg /end REF_MEASUREMENT /end GROUP
/begin GROUP S1028_DTC_Couter2 "SWC_DDM_type/run_SWC_DDM_5ms_sys/DDM/DDM/VMC_DDM/Enabled Subsystem/EPS1 Checksum Error/DTC_Couter2" /begin REF_MEASUREMENT VDDM_EPS1CSErrCFS_flg VDDM_EPS1CSErrDTC_cnt /end REF_MEASUREMENT /end GROUP
/begin GROUP S1028_Test_Detection_Criteria "SWC_DDM_type/run_SWC_DDM_5ms_sys/DDM/DDM/VMC_DDM/Enabled Subsystem/EPS1 Checksum Error/Test Detection Criteria" /begin REF_MEASUREMENT VDDM_EPS1CSErrDet_flg /end REF_MEASUREMENT /end GROUP
/begin GROUP S1029_DTC_Couter2 "SWC_DDM_type/run_SWC_DDM_5ms_sys/DDM/DDM/VMC_DDM/Enabled Subsystem/EPS1 Lost Comm/DTC_Couter2" /begin REF_MEASUREMENT VDDM_EPS1NoComCFS_flg VDDM_EPS1NoComDTC_cnt /end REF_MEASUREMENT /end GROUP
/begin GROUP S1029_Test_Detection_Criteria "SWC_DDM_type/run_SWC_DDM_5ms_sys/DDM/DDM/VMC_DDM/Enabled Subsystem/EPS1 Lost Comm/Test Detection Criteria" /begin REF_MEASUREMENT VDDM_EPS1NoComDet_flg /end REF_MEASUREMENT /end GROUP
/begin GROUP S1030_DTC_Couter2 "SWC_DDM_type/run_SWC_DDM_5ms_sys/DDM/DDM/VMC_DDM/Enabled Subsystem/EPS1 Rolling Count Error /DTC_Couter2" /begin REF_MEASUREMENT VDDM_EPS1RCErrCFS_flg VDDM_EPS1RCErrDTC_cnt /end REF_MEASUREMENT /end GROUP
/begin GROUP S1030_Test_Detection_Criteria "SWC_DDM_type/run_SWC_DDM_5ms_sys/DDM/DDM/VMC_DDM/Enabled Subsystem/EPS1 Rolling Count Error /Test Detection Criteria" /begin REF_MEASUREMENT VDDM_EPS1RCErrDet_flg /end REF_MEASUREMENT /end GROUP
/begin GROUP S1031_DTC_Couter2 "SWC_DDM_type/run_SWC_DDM_5ms_sys/DDM/DDM/VMC_DDM/Enabled Subsystem/EPS1 Signal Error/DTC_Couter2" /begin REF_MEASUREMENT VDDM_EPSSigErrCFS_flg VDDM_EPSSigErrDTC_cnt /end REF_MEASUREMENT /end GROUP
/begin GROUP S1031_Test_Detection_Criteria "SWC_DDM_type/run_SWC_DDM_5ms_sys/DDM/DDM/VMC_DDM/Enabled Subsystem/EPS1 Signal Error/Test Detection Criteria" /begin REF_MEASUREMENT VDDM_EPSSigErrDet_flg /end REF_MEASUREMENT /end GROUP
/begin GROUP S1064_DTC_Couter2 "SWC_DDM_type/run_SWC_DDM_5ms_sys/DDM/DDM/VMC_DDM/FCM1/FCM1 Checksum Error /DTC_Couter2" /begin REF_MEASUREMENT VDDM_FCM1CSErrCFS_flg VDDM_FCM1CSErrDTC_cnt /end REF_MEASUREMENT /end GROUP
/begin GROUP S1064_Test_Detection_Criteria "SWC_DDM_type/run_SWC_DDM_5ms_sys/DDM/DDM/VMC_DDM/FCM1/FCM1 Checksum Error /Test Detection Criteria" /begin REF_MEASUREMENT VDDM_FCM1CSErrDet_flg /end REF_MEASUREMENT /end GROUP
/begin GROUP S1065_DTC_Couter2 "SWC_DDM_type/run_SWC_DDM_5ms_sys/DDM/DDM/VMC_DDM/FCM1/FCM1 Lost Com/DTC_Couter2" /begin REF_MEASUREMENT VDDM_FCM1NoComCFS_flg VDDM_FCM1NoComDTC_cnt /end REF_MEASUREMENT /end GROUP
/begin GROUP S1065_Test_Detection_Criteria "SWC_DDM_type/run_SWC_DDM_5ms_sys/DDM/DDM/VMC_DDM/FCM1/FCM1 Lost Com/Test Detection Criteria" /begin REF_MEASUREMENT VDDM_FCM1NoComDet_flg /end REF_MEASUREMENT /end GROUP
/begin GROUP S1066_DTC_Couter2 "SWC_DDM_type/run_SWC_DDM_5ms_sys/DDM/DDM/VMC_DDM/FCM1/FCM1 Rolling Count Error /DTC_Couter2" /begin REF_MEASUREMENT VDDM_FCM1RCErrCFS_flg VDDM_FCM1RCErrDTC_cnt /end REF_MEASUREMENT /end GROUP
/begin GROUP S1066_Test_Detection_Criteria "SWC_DDM_type/run_SWC_DDM_5ms_sys/DDM/DDM/VMC_DDM/FCM1/FCM1 Rolling Count Error /Test Detection Criteria" /begin REF_MEASUREMENT VDDM_FCM1RCErrDet_flg /end REF_MEASUREMENT /end GROUP
/begin GROUP S1091_DTC_Couter1 "SWC_DDM_type/run_SWC_DDM_5ms_sys/DDM/DDM/VMC_DDM/FCMACC Signal Error/FCMACC Signal Error /DTC_Couter1" /begin REF_MEASUREMENT VDDM_FCMACCSigErrCFS_flg VDDM_FCMACCSigErrDTC_cnt /end REF_MEASUREMENT /end GROUP
/begin GROUP S1091_DTC_Info "SWC_DDM_type/run_SWC_DDM_5ms_sys/DDM/DDM/VMC_DDM/FCMACC Signal Error/FCMACC Signal Error /DTC_Info" /begin REF_MEASUREMENT VDDM_FCMACCSigErrDetDTC_raw32 /end REF_MEASUREMENT /end GROUP
/begin GROUP S1091_Test_Detection_Criteria "SWC_DDM_type/run_SWC_DDM_5ms_sys/DDM/DDM/VMC_DDM/FCMACC Signal Error/FCMACC Signal Error /Test Detection Criteria" /begin REF_MEASUREMENT VDDM_FCMACCSigErrDet_flg /end REF_MEASUREMENT /end GROUP
/begin GROUP S1100_DTC_Couter1 "SWC_DDM_type/run_SWC_DDM_5ms_sys/DDM/DDM/VMC_DDM/MCU_Fr Signal Error/MCU_Fr Signal Error /DTC_Couter1" /begin REF_MEASUREMENT VDDM_FrMCUSigErrCFS_flg VDDM_FrMCUSigErrDTC_cnt /end REF_MEASUREMENT /end GROUP
/begin GROUP S1100_Test_Detection_Criteria "SWC_DDM_type/run_SWC_DDM_5ms_sys/DDM/DDM/VMC_DDM/MCU_Fr Signal Error/MCU_Fr Signal Error /Test Detection Criteria" /begin REF_MEASUREMENT VDDM_FrMCUSigErrDet_flg /end REF_MEASUREMENT /end GROUP
/begin GROUP S1109_DTC_Couter1 "SWC_DDM_type/run_SWC_DDM_5ms_sys/DDM/DDM/VMC_DDM/MCU_Rr Signal Error/MCU_Rr Signal Error /DTC_Couter1" /begin REF_MEASUREMENT VDDM_RrMCUSigErrCFS_flg VDDM_RrMCUSigErrDTC_cnt /end REF_MEASUREMENT /end GROUP
/begin GROUP S1109_Test_Detection_Criteria "SWC_DDM_type/run_SWC_DDM_5ms_sys/DDM/DDM/VMC_DDM/MCU_Rr Signal Error/MCU_Rr Signal Error /Test Detection Criteria" /begin REF_MEASUREMENT VDDM_RrMCUSigErrDet_flg /end REF_MEASUREMENT /end GROUP
/begin GROUP S1118_DTC_Couter "SWC_DDM_type/run_SWC_DDM_5ms_sys/DDM/DDM/VMC_DDM/Shifter Signal Error/Shifter Signal Error /DTC_Couter" /begin REF_MEASUREMENT VDDM_ShifterSigErrCFS_flg VDDM_ShifterSigErrDTC_cnt /end REF_MEASUREMENT /end GROUP
/begin GROUP S1118_Test_Detection_Criteria "SWC_DDM_type/run_SWC_DDM_5ms_sys/DDM/DDM/VMC_DDM/Shifter Signal Error/Shifter Signal Error /Test Detection Criteria" /begin REF_MEASUREMENT VDDM_ShifterSigErrDet_flg /end REF_MEASUREMENT /end GROUP
/begin GROUP S1143_DTC_Couter "SWC_DDM_type/run_SWC_DDM_5ms_sys/DDM/DDM/VMC_DDM/Zone_dr Error/Zone_dr Error /DTC_Couter" /begin REF_MEASUREMENT VDDM_ZoneDrSigErrCFS_flg VDDM_ZoneDrSigErrDTC_cnt /end REF_MEASUREMENT /end GROUP
/begin GROUP S1143_Test_Detection_Criteria "SWC_DDM_type/run_SWC_DDM_5ms_sys/DDM/DDM/VMC_DDM/Zone_dr Error/Zone_dr Error /Test Detection Criteria" /begin REF_MEASUREMENT VDDM_ZoneDrSigErrDet_flg /end REF_MEASUREMENT /end GROUP
/begin GROUP S1152_DTC_Couter "SWC_DDM_type/run_SWC_DDM_5ms_sys/DDM/DDM/VMC_DDM/Zone_fr Error/Zone_fr Error /DTC_Couter" /begin REF_MEASUREMENT VDDM_ZoneFrSigErrCFS_flg VDDM_ZoneFrSigErrDTC_cnt /end REF_MEASUREMENT /end GROUP
/begin GROUP S1152_Test_Detection_Criteria "SWC_DDM_type/run_SWC_DDM_5ms_sys/DDM/DDM/VMC_DDM/Zone_fr Error/Zone_fr Error /Test Detection Criteria" /begin REF_MEASUREMENT VDDM_ZoneFrSigErrDet_flg /end REF_MEASUREMENT /end GROUP
/end MODULE
/end PROJECT
