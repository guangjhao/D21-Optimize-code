AUTOSAR XML (schema 4-3-0)
package /AUTOSAR/Services/BswM
  mode declaration group AppModeGroup: category=EXPLICIT_ORDER, initial-mode=APP_MODE_ACTIVE, on-transition-value=2
    mode APP_MODE_ACTIVE: value=0
    mode APP_MODE_INACTIVE: value=1
  mode switch interface AppModeInterface: is-service=true
    mode group AppMode: type=AppModeGroup
  sender receiver interface AppModeRequestInterface: is-service=true
    data requestedMode: type=AppModeRequestType
  impl type AppModeRequestType: category=VALUE, base-type=uint8, compu {0=APP_MODE_ACTIVE, 1=APP_MODE_INACTIVE}, range raw 0..2
  data type mapping set AppModeTypeMap: mode-request-type-map{implementation-data-type=uint8, mode-group=AppModeGroup}
