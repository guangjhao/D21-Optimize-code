AUTOSAR XML (schema 4-3-0)
package /PduGroups
  i signal i pdu group PDUGroupName_Tx: communication-direction=OUT, communication-mode=CAN_Transmit_All, i-signal-i-pdus=FD_VCU2
  i signal i pdu group PDUGroupName_Rx: communication-direction=IN, communication-mode=CAN_Receive_All, i-signal-i-pdus=BMS2
