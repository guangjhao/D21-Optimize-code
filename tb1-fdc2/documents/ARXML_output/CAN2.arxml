[part 3 of 3: packages /CAN2/ConstantSpecification to /CAN2/ImplementationDataTypes]
AUTOSAR XML (schema 4-3-0)
package /CAN2/ConstantSpecification
  757 x constant specification:
    Init_CAN2_FDC_CHA_CACPresWarn_Sta: value-spec=0
    Init_CAN2_FDC_CHA_CACTempWarn_Sta: value-spec=0
    Init_CAN2_APS_ExitCondition: value-spec=0
    Init_CAN2_APS_RQ_Display: value-spec=0
    Init_CAN2_APS_SW_Ver: value-spec=0
    Init_CAN2_APS_Sta_System: value-spec=0
    Init_CAN2_CAAS_Sta: value-spec=0
    Init_CAN2_FDC_VCU_RegenLimInd_Sta: value-spec=0
    Init_CAN2_FDC_VCU_RegenMode_Sta: value-spec=0
    Init_CAN2_FDC_VCU_SmartEcoSpdLim_Sta: value-spec=0
    Init_CAN2_FDC_VCU_SmartEco_Sta: value-spec=0
    Init_CAN2_FDC_VMC_SetSpdDisp_Sta: value-spec=0
    Init_CAN2_FDC_VMC_SetSpd_Sta: value-spec=0
    Init_CAN2_FDC_VMC_SpdCtrlMode_Sta: value-spec=0
    Init_CAN2_FDC_VMC_SpdCtrl_Sta: value-spec=0
    Init_CAN2_PAS_A_FCL: value-spec=0
    Init_CAN2_PAS_A_FCR: value-spec=0
    Init_CAN2_PAS_A_FML: value-spec=0
    Init_CAN2_PAS_A_FMR: value-spec=0
    Init_CAN2_PAS_A_RCL: value-spec=0
    Init_CAN2_PAS_A_RCR: value-spec=0
    Init_CAN2_PAS_A_RML: value-spec=0
    Init_CAN2_PAS_A_RMR: value-spec=0
    Init_CAN2_PAS_Chime: value-spec=0
    Init_CAN2_PAS_D_FCL: value-spec=0
    Init_CAN2_PAS_D_FCR: value-spec=0
    Init_CAN2_PAS_D_FML: value-spec=0
    Init_CAN2_PAS_D_FMR: value-spec=0
    Init_CAN2_PAS_D_RCL: value-spec=0
    Init_CAN2_PAS_D_RCR: value-spec=0
    Init_CAN2_PAS_D_RML: value-spec=0
    Init_CAN2_PAS_D_RMR: value-spec=0
    Init_CAN2_PAS_SNSR_Layout: value-spec=0
    Init_CAN2_USS_Sta_FCL: value-spec=0
    Init_CAN2_USS_Sta_FCR: value-spec=0
    Init_CAN2_USS_Sta_FLL: value-spec=0
    Init_CAN2_USS_Sta_FLR: value-spec=0
    Init_CAN2_USS_Sta_FML: value-spec=0
    Init_CAN2_USS_Sta_FMR: value-spec=0
    Init_CAN2_USS_Sta_RCL: value-spec=0
    Init_CAN2_USS_Sta_RCR: value-spec=0
    Init_CAN2_USS_Sta_RLL: value-spec=0
    Init_CAN2_USS_Sta_RLR: value-spec=0
    Init_CAN2_USS_Sta_RML: value-spec=0
    Init_CAN2_USS_Sta_RMR: value-spec=0
    Init_CAN2_VMC_VCU_CC_Crl_Sta: value-spec=0
    Init_CAN2_VMC_VCU_MSA_Crl_Sta: value-spec=0
    Init_CAN2_APMDoorControlSta: value-spec=0
    Init_CAN2_ActAPSPosn: value-spec=0
    Init_CAN2_AllDoorSW: value-spec=0
    Init_CAN2_AntitheftSta: value-spec=0
    Init_CAN2_BCM_DoorLock_Sta: value-spec=0
    Init_CAN2_BrakeLamp: value-spec=0
    Init_CAN2_CCMSA_SpdWar: value-spec=0
    Init_CAN2_CCU_ACLampSts: value-spec=0
    Init_CAN2_CCU_ACMaxLampSts: value-spec=0
    Init_CAN2_CCU_AutoLampSts: value-spec=0
    Init_CAN2_CCU_AutoMidLampSts: value-spec=0
    Init_CAN2_CCU_Dispaly_Request: value-spec=0
    Init_CAN2_CCU_EcoSts: value-spec=0
    Init_CAN2_CCU_FrtOnOffLampSts: value-spec=0
    Init_CAN2_CCU_RrOnOffLampSts: value-spec=0
    Init_CAN2_CCU_SyncLampSts: value-spec=0
    Init_CAN2_CC_Crl_Sta: value-spec=0
    Init_CAN2_CoastDwModeStaChk: value-spec=0
    Init_CAN2_CreepSW_Sta: value-spec=0
    Init_CAN2_DISC_ButtSta: value-spec=0
    Init_CAN2_DISC_Sta: value-spec=0
    Init_CAN2_DemoModeStaChk: value-spec=0
    Init_CAN2_Dimmer: value-spec=0
    Init_CAN2_DimmerEN: value-spec=0
    Init_CAN2_DisengageP_Fail: value-spec=0
    Init_CAN2_DoorLockIND: value-spec=0
    Init_CAN2_DrDoorSW: value-spec=0
    Init_CAN2_Dr_SeatSta: value-spec=2
    Init_CAN2_DynoModeStaChk: value-spec=0
    Init_CAN2_EDriveSysErr_AccPedalErr: value-spec=0
    Init_CAN2_EDriveSysErr_MCUErr: value-spec=0
    Init_CAN2_EDriveSysErr_ShifterErr: value-spec=0
    Init_CAN2_EDriveSysErr_VCUErr: value-spec=0
    Init_CAN2_EVDriveMode: value-spec=0
    Init_CAN2_Eng_ActvDmpDisabSta: value-spec=0
    Init_CAN2_Eng_CoastDwSta: value-spec=0
    Init_CAN2_Eng_PwrLockSta: value-spec=0
    Init_CAN2_EngageP_Fail: value-spec=0
    Init_CAN2_FDC_THCM_CLEVentY_Sta: value-spec=0
    Init_CAN2_FDC_THCM_CLEVentZ_Sta: value-spec=0
    Init_CAN2_FDC_THCM_CLVent_Sta: value-spec=0
    Init_CAN2_FDC_THCM_CREVentY_Sta: value-spec=0
    Init_CAN2_FDC_THCM_CREVentZ_Sta: value-spec=0
    Init_CAN2_FDC_THCM_CRVent_Sta: value-spec=0
    Init_CAN2_FDC_THCM_DrEVentMode_Sta: value-spec=0
    Init_CAN2_FDC_THCM_DrEVentY_Sta: value-spec=0
    Init_CAN2_FDC_THCM_DrEVentZ_Sta: value-spec=0
    Init_CAN2_FDC_THCM_DrVent_Sta: value-spec=0
    Init_CAN2_FDC_THCM_PsEVentMode_Sta: value-spec=0
    Init_CAN2_FDC_THCM_PsEVentY_Sta: value-spec=0
    Init_CAN2_FDC_THCM_PsEVentZ_Sta: value-spec=0
    Init_CAN2_FDC_THCM_PsVent_Sta: value-spec=0
    Init_CAN2_FDC_VCU_PwrSaveReq_Cmd: value-spec=0
    Init_CAN2_FD_ABS_Warning: value-spec=0
    Init_CAN2_FD_Battery_Charge_Warning: value-spec=0
    Init_CAN2_FD_EDrive_System: value-spec=0
    Init_CAN2_FD_EPB_Error: value-spec=0
    Init_CAN2_FD_HV_Battery_Fault: value-spec=0
    Init_CAN2_FD_Park_Brake_Warning: value-spec=0
    Init_CAN2_FD_Power_limitation: value-spec=0
    Init_CAN2_FD_Steering_Warning: value-spec=0
    Init_CAN2_FD_TCS_Indicator: value-spec=0
    Init_CAN2_FD_Telltale_Fail: value-spec=0
    Init_CAN2_FalseNPrevent_Sta: value-spec=0
    Init_CAN2_FeatSetSpdFinal_raw32: value-spec=0
    Init_CAN2_FollowMe: value-spec=0
    Init_CAN2_Fr_FogLamp: value-spec=0
    Init_CAN2_HVRlyOpFail: value-spec=0
    Init_CAN2_HVSysErr_IsolationErr: value-spec=0
    Init_CAN2_HVSysErr_PackErr: value-spec=0
    Init_CAN2_HVSysErr_RelayErr: value-spec=0
    Init_CAN2_H_Beam: value-spec=0
    Init_CAN2_HazardSW: value-spec=0
    Init_CAN2_HoodSW: value-spec=0
    Init_CAN2_LBSD: value-spec=0
    Init_CAN2_LDRL: value-spec=0
    Init_CAN2_LTurnLP: value-spec=0
    Init_CAN2_LVChrgFuncStaChk: value-spec=0
    Init_CAN2_LVSysErr_PwrOutpErr: value-spec=0
    Init_CAN2_L_Beam: value-spec=0
    Init_CAN2_LimphomeAct: value-spec=0
    Init_CAN2_LockSetting: value-spec=0
    Init_CAN2_MCUActDisFail: value-spec=0
    Init_CAN2_MSA_Crl_Sta: value-spec=0
    Init_CAN2_MeterIndSpeed_raw32: value-spec=0
    Init_CAN2_PAS_Sta_F_Sys: value-spec=0
    Init_CAN2_PosLamp: value-spec=0
    Init_CAN2_PsDoorSW: value-spec=0
    Init_CAN2_PwrSta: value-spec=7
    Init_CAN2_PwrStaErr: value-spec=0
    Init_CAN2_PwrStaONTOIVIPopReq: value-spec=0
    Init_CAN2_PwrStaONTOIVIPopT: value-spec=0
    Init_CAN2_RBSD: value-spec=0
    Init_CAN2_RDRL: value-spec=0
    Init_CAN2_RLDoorSW: value-spec=0
    Init_CAN2_RRDoorSW: value-spec=0
    Init_CAN2_RTurnLP: value-spec=0
    Init_CAN2_Req_Internal_V2L_Status_Lamp: value-spec=0
    Init_CAN2_Req_V2LSwOn: value-spec=0
    Init_CAN2_Req_V2L_IVI_Popup: value-spec=0
    Init_CAN2_ReverseLamp: value-spec=0
    Init_CAN2_Rr_Defog: value-spec=0
    Init_CAN2_Rr_FogLamp: value-spec=0
    Init_CAN2_ShiftGearPosn: value-spec=1
    Init_CAN2_SysAllowReadySta: value-spec=0
    Init_CAN2_SysPwrSta: value-spec=0
    Init_CAN2_Tailgate_SW: value-spec=0
    Init_CAN2_VCUBrkSWSta: value-spec=0
    Init_CAN2_VCUFLDoorSta: value-spec=0
    Init_CAN2_VCUFRDoorSta: value-spec=0
    Init_CAN2_VCUHoodSWSta: value-spec=0
    Init_CAN2_VCURLDoorSta: value-spec=0
    Init_CAN2_VCURRDoorSta: value-spec=0
    Init_CAN2_VCUTailgateSWSta: value-spec=0
    Init_CAN2_VCU_OPDHold: value-spec=0
    Init_CAN2_VehMalfunLevel: value-spec=0
    Init_CAN2_XWDMode: value-spec=0
    Init_CAN2_sigAirIntenZon1St: value-spec=0
    Init_CAN2_sigAirIntenZon3St: value-spec=0
    Init_CAN2_sigAmbAirT: value-spec=0
    Init_CAN2_sigCbnAirT: value-spec=0
    Init_CAN2_sigDfrstSt: value-spec=0
    Init_CAN2_sigHvacSt: value-spec=0
    Init_CAN2_sigRecircSt: value-spec=0
    Init_CAN2_sigSetTempZon{1..3}St: value-spec=0
    Init_CAN2_sigWindDirZon1St: value-spec=7
    Init_CAN2_sigWindDirZon3St: value-spec=7
    Init_CAN2_FDC_BCM_TgateSWL_Sta: value-spec=0
    Init_CAN2_FDC_BCM_TgateSWR_Sta: value-spec=0
    Init_CAN2_FDC_BCM_WelcomeDemo_Sta: value-spec=0
    Init_CAN2_FDC_VCU_DACStatus_Sta: value-spec=0
    Init_CAN2_FDC_VCU_TUpASta_Sta: value-spec=0
    Init_CAN2_AutoLTips: value-spec=0
    Init_CAN2_CWheelTips: value-spec=0
    Init_CAN2_FDC_BCM_Acc{1..5}Sta_Sta: value-spec=0
    Init_CAN2_FDC_BCM_AmbBrightSta_Sta: value-spec=0
    Init_CAN2_FDC_BCM_AmbColorSta_Sta: value-spec=0
    Init_CAN2_FDC_BCM_AmbDimEN_Sta: value-spec=0
    Init_CAN2_FDC_BCM_AmbFunEN_Sta: value-spec=0
    Init_CAN2_FDC_BCM_AmbLinkDriSta_Sta: value-spec=0
    Init_CAN2_FDC_BCM_AmbODAEN_Sta: value-spec=0
    Init_CAN2_FDC_BCM_AmbPwrWarnEN_Sta: value-spec=0
    Init_CAN2_FDC_BCM_AmbWelEN_Sta: value-spec=0
    Init_CAN2_FDC_BCM_CLWinLockDr_Sta: value-spec=0
    Init_CAN2_FDC_BCM_FollowMeENFun_Sta: value-spec=0
    Init_CAN2_FDC_BCM_Key10Acc_Sta: value-spec=0
    Init_CAN2_FDC_BCM_Key{1..9}Acc_Sta: value-spec=0
    Init_CAN2_FDC_BCM_LockAlarm_Cmd: value-spec=0
    Init_CAN2_FDC_BCM_PTGOpenHeight_Sta: value-spec=7
    Init_CAN2_FDC_BCM_RmLpModeENFun_Sta: value-spec=0
    Init_CAN2_FDC_BCM_TurnSwTSetSta_Sta: value-spec=3
    Init_CAN2_FDC_BCM_UserNow_Sta: value-spec=0
    Init_CAN2_FDC_BCM_WalkInUnLkEnFun_Sta: value-spec=0
    Init_CAN2_FDC_BCM_WalkOutLkEnFun_Sta: value-spec=0
    Init_CAN2_FDC_DKC_DkeyShowIVI_Sta: value-spec=0
    Init_CAN2_FDC_DKC_KeyMiss_Sta: value-spec=0
    Init_CAN2_FDC_DKC_KeyNum_Sta: value-spec=0
    Init_CAN2_FDC_DKC_KeyType_Sta: value-spec=0
    Init_CAN2_FDC_DKC_UIDLowPower_Sta: value-spec=0
    Init_CAN2_FDC_SPTG_SPTGENFun_Sta: value-spec=0
    Init_CAN2_FDC_THCM_APTCForceOFF_Sta: value-spec=0
    Init_CAN2_FDC_THCM_APTCWarning_Sta: value-spec=0
    Init_CAN2_FDC_THCM_AirIntZ3_Sta: value-spec=0
    Init_CAN2_LFWheelShield: value-spec=0
    Init_CAN2_LRBatWarn: value-spec=0
    Init_CAN2_LRPressIndi: value-spec=0
    Init_CAN2_LRSensorFail: value-spec=0
    Init_CAN2_LRWheelDebug: value-spec=0
    Init_CAN2_LRWheelPSW: value-spec=0
    Init_CAN2_LRWheelPress: value-spec=0
    Init_CAN2_LRWheelShield: value-spec=0
    Init_CAN2_LRWheelTemp: value-spec=0
    Init_CAN2_LRWheelTmpIndi: value-spec=0
    Init_CAN2_RFWheelShield: value-spec=0
    Init_CAN2_RRBatWarn: value-spec=0
    Init_CAN2_RRPressIndi: value-spec=0
    Init_CAN2_RRSensorFail: value-spec=0
    Init_CAN2_RRWheelDebug: value-spec=0
    Init_CAN2_RRWheelPSW: value-spec=0
    Init_CAN2_RRWheelPress: value-spec=0
    Init_CAN2_RRWheelShield: value-spec=0
    Init_CAN2_RRWheelTemp: value-spec=0
    Init_CAN2_RRWheelTmpIndi: value-spec=0
    Init_CAN2_T1_TPMS_LFBatWarn: value-spec=0
    Init_CAN2_T1_TPMS_LFPressIndi: value-spec=0
    Init_CAN2_T1_TPMS_LFSensorFail: value-spec=0
    Init_CAN2_T1_TPMS_LFWheelDebug: value-spec=0
    Init_CAN2_T1_TPMS_LFWheelPSW: value-spec=0
    Init_CAN2_T1_TPMS_LFWheelPress: value-spec=0
    Init_CAN2_T1_TPMS_LFWheelTemp: value-spec=0
    Init_CAN2_T1_TPMS_LFWheelTmpIndi: value-spec=0
    Init_CAN2_T1_TPMS_RFBatWarn: value-spec=0
    Init_CAN2_T1_TPMS_RFPressIndi: value-spec=0
    Init_CAN2_T1_TPMS_RFSensorFail: value-spec=0
    Init_CAN2_T1_TPMS_RFWheelDebug: value-spec=0
    Init_CAN2_T1_TPMS_RFWheelPSW: value-spec=0
    Init_CAN2_T1_TPMS_RFWheelPress: value-spec=0
    Init_CAN2_T1_TPMS_RFWheelTemp: value-spec=0
    Init_CAN2_T1_TPMS_RFWheelTmpIndi: value-spec=0
    Init_CAN2_T1_TPMS_TPMSWarnIndi: value-spec=0
    Init_CAN2_TPMS_Cali_Butt_Allow: value-spec=0
    Init_CAN2_TPMS_Res_Butt_Allow: value-spec=0
    Init_CAN2_OTA_DL_Available: value-spec=0
    Init_CAN2_OTA_DL_Speed: value-spec=0
    Init_CAN2_OTA_Debug_Code: value-spec=0
    Init_CAN2_OTA_Emergency_Sta: value-spec=0
    Init_CAN2_OTA_InVehicle_FW: value-spec=0
    Init_CAN2_OTA_Lock_Req: value-spec=0
    Init_CAN2_OTA_MDA_Status: value-spec=0
    Init_CAN2_OTA_Mode: value-spec=0
    Init_CAN2_OTA_Network_Type: value-spec=0
    Init_CAN2_OTA_Permit_Agreed: value-spec=0
    Init_CAN2_OTA_Progress_Rate: value-spec=0
    Init_CAN2_OTA_Remained_Time: value-spec=0
    Init_CAN2_OTA_TBOXResetReq: value-spec=0
    Init_CAN2_OTA_Update_Available: value-spec=0
    Init_CAN2_OTA_Updating_ECU_8bit: value-spec=0
    Init_CAN2_FUSION_HW_Ver{1..3}: value-spec=0
    Init_CAN2_FUSION_SW_CarModel{1..3}: value-spec=0
    Init_CAN2_FUSION_SW_Controller1: value-spec=0
    Init_CAN2_FUSION_SW_Controller2: value-spec=0
    Init_CAN2_FUSION_SW_Country1: value-spec=0
    Init_CAN2_FUSION_SW_Country2: value-spec=0
    Init_CAN2_FUSION_SW_ECUGen1: value-spec=0
    Init_CAN2_FUSION_SW_ECUGen2: value-spec=0
    Init_CAN2_FUSION_SW_Major1: value-spec=0
    Init_CAN2_FUSION_SW_Major2: value-spec=0
    Init_CAN2_FUSION_SW_Minor1: value-spec=0
    Init_CAN2_FUSION_SW_Minor2: value-spec=0
    Init_CAN2_FUSION_SW_Patch1: value-spec=0
    Init_CAN2_FUSION_SW_Patch2: value-spec=0
    Init_CAN2_FUSION_SW_SHA{1..8}: value-spec=0
    Init_CAN2_FUSION_SW_Var{1..5}: value-spec=0
    Init_CAN2_FUSION_SW_change1: value-spec=0
    Init_CAN2_FUSION_SW_change2: value-spec=0
    Init_CAN2_FUSION_SW_dash1: value-spec=0
    Init_CAN2_FUSION_SW_dash2: value-spec=0
    Init_CAN2_ABS_Active: value-spec=0
    Init_CAN2_ABS_Failed: value-spec=0
    Init_CAN2_ABS_WnlmpSta: value-spec=0
    Init_CAN2_AVH_Failed: value-spec=0
    Init_CAN2_Amber_WnlmpSta: value-spec=0
    Init_CAN2_BrkSw_Sta: value-spec=0
    Init_CAN2_DCDCAuxCur: value-spec=0
    Init_CAN2_DCDCAuxVolt: value-spec=0
    Init_CAN2_DrPMMLVOutPErrLmp: value-spec=0
    Init_CAN2_DrPMMSysErrLmp: value-spec=0
    Init_CAN2_DrSCPSysErrLmp: value-spec=0
    Init_CAN2_FLTurn_Light_Warning: value-spec=0
    Init_CAN2_FRTurn_Light_Warning: value-spec=0
    Init_CAN2_FireDetErr: value-spec=0
    Init_CAN2_FrPMMLimpHomeActReq: value-spec=0
    Init_CAN2_HSA_Active: value-spec=0
    Init_CAN2_HSA_Failed: value-spec=0
    Init_CAN2_HVBattCurr: value-spec=10000
    Init_CAN2_HVBattErr: value-spec=0
    Init_CAN2_HVBattVolt: value-spec=0
    Init_CAN2_LADB_Hibeam_Indication: value-spec=0
    Init_CAN2_LADB_Operation_Status: value-spec=0
    Init_CAN2_LADB_Warning: value-spec=0
    Init_CAN2_LAHB_Warning: value-spec=0
    Init_CAN2_LDRL_Warning: value-spec=0
    Init_CAN2_LLB_Warning: value-spec=0
    Init_CAN2_Lposition_Lamp_Warning: value-spec=0
    Init_CAN2_Meter_Ind_VehSpeed: value-spec=0
    Init_CAN2_RADB_Hibeam_Indication: value-spec=0
    Init_CAN2_RADB_Operation_Status: value-spec=0
    Init_CAN2_RADB_Warning: value-spec=0
    Init_CAN2_RAHB_Warning: value-spec=0
    Init_CAN2_RDRL_Warning: value-spec=0
    Init_CAN2_RLB_Warning: value-spec=0
    Init_CAN2_Red_WnlmpSta: value-spec=0
    Init_CAN2_Rposition_Lamp_Warning: value-spec=0
    Init_CAN2_VehSpeed: value-spec=0
    Init_CAN2_ACChrgCurrDis: value-spec=10000
    Init_CAN2_Charge_Percent_Set: value-spec=100
    Init_CAN2_HVBChrgPwr: value-spec=0
    Init_CAN2_HVBattSOC: value-spec=0
    Init_CAN2_HVBattSOCDis: value-spec=0
    Init_CAN2_RemainChrgTime: value-spec=0
    Init_CAN2_Rr_MCU3_HW_Ver: value-spec=0
    Init_CAN2_Rr_MCU3_HW_Ver_Nidec: value-spec=0
    Init_CAN2_Rr_MCU3_SW_Ver: value-spec=0
    Init_CAN2_Rr_MCU3_SW_Ver_Nidec: value-spec=0
    Init_CAN2_TBOX_HW_VER: value-spec=0
    Init_CAN2_TBOX_SW_VER: value-spec=0
    Init_CAN2_TimeSyncFromBS_Day: value-spec=0
    Init_CAN2_TimeSyncFromBS_Hour: value-spec=0
    Init_CAN2_TimeSyncFromBS_Minute: value-spec=0
    Init_CAN2_TimeSyncFromBS_Month: value-spec=0
    Init_CAN2_TimeSyncFromBS_Second: value-spec=0
    Init_CAN2_TimeSyncFromBS_Year: value-spec=0
    Init_CAN2_COMP_ActualPwr: value-spec=8191
    Init_CAN2_CbnPreACEnaReq: value-spec=0
    Init_CAN2_ChargeInletLockSta: value-spec=0
    Init_CAN2_ChrgPlugSta: value-spec=0
    Init_CAN2_DKC_KeyNum_Sta: value-spec=0
    Init_CAN2_DKC_KeyType_Sta: value-spec=0
    Init_CAN2_DisChrgPlugErr: value-spec=0
    Init_CAN2_ExtChrgSta: value-spec=0
    Init_CAN2_FDC_BCM_DimSw: value-spec=0
    Init_CAN2_FDC_BCM_FWipSw_Sta: value-spec=7
    Init_CAN2_FDC_BCM_TurnSw_Sta: value-spec=3
    Init_CAN2_FrntPTCLeActHeatPwr: value-spec=255
    Init_CAN2_FrntPTCRearLeActHeatPwr: value-spec=255
    Init_CAN2_FrntPTCRearRiActHeatPwr: value-spec=255
    Init_CAN2_FrntPTCRiActHeatPwr: value-spec=255
    Init_CAN2_HVBChrgErr: value-spec=0
    Init_CAN2_HVBContactorSta: value-spec=0
    Init_CAN2_HVBMTempMax: value-spec=40
    Init_CAN2_HVBOvrTempErr: value-spec=0
    Init_CAN2_HVBOvrTempWarn: value-spec=0
    Init_CAN2_MainRlyNegSta: value-spec=0
    Init_CAN2_MainRlyPosSta: value-spec=0
    Init_CAN2_OBCACCSLimit: value-spec=255
    Init_CAN2_OBCACCurrInf: value-spec=0
    Init_CAN2_OBCACVoltInf: value-spec=0
    Init_CAN2_OBCFaultSta: value-spec=0
    Init_CAN2_OBC_AC_Cur_Lim: value-spec=0
    Init_CAN2_PTCActuPwrHSC6: value-spec=0
    Init_CAN2_P_Dkey_Show_IVI: value-spec=0
    Init_CAN2_P_KeyMiss: value-spec=0
    Init_CAN2_P_UID_LowPower: value-spec=0
    Init_CAN2_RLS_Lamp_Sta: value-spec=0
    Init_CAN2_Re_Radio: value-spec=0
    Init_CAN2_SWC_ACC_Sta: value-spec=0
    Init_CAN2_SWC_Down_Sta: value-spec=0
    Init_CAN2_SWC_LKA_Sta: value-spec=0
    Init_CAN2_SWC_Left_Sta: value-spec=0
    Init_CAN2_SWC_RegenDown: value-spec=0
    Init_CAN2_SWC_RegenUp: value-spec=0
    Init_CAN2_SWC_Right_Sta: value-spec=0
    Init_CAN2_SWC_Trip_Sta: value-spec=0
    Init_CAN2_SWC_Undefined_Sta: value-spec=0
    Init_CAN2_SWC_Up_Sta: value-spec=0
    Init_CAN2_SWC_VR_Sta: value-spec=0
    Init_CAN2_SWC_mode_Sta: value-spec=0
    Init_CAN2_Shifter_Fail_sta: value-spec=0
    Init_CAN2_Shifter_Handle_Cmd: value-spec=0
    Init_CAN2_TBOX_NET_SIG_STR: value-spec=0
    Init_CAN2_TBOX_TEST_STATUS: value-spec=15
    Init_CAN2_TrailerCheck: value-spec=0
    Init_CAN2_TrailerModeSta: value-spec=0
    Init_CAN2_V2LSta: value-spec=0
    Init_CAN2_ZFR_BCM_ChargerDoorSW_Sta: value-spec=0
    Init_CAN2_ZFR_EChrg_Active_Sta: value-spec=0
    Init_CAN2_ZFR_EChrg_Sys_Sta: value-spec=0
    Init_CAN2_Fr_EDUDrtSta: value-spec=0
    Init_CAN2_Fr_EDURealTMTq: value-spec=10220
    Init_CAN2_Fr_MCUTemp: value-spec=0
    Init_CAN2_Fr_MCUTempWarn: value-spec=3
    Init_CAN2_Fr_MotorAvailTq: value-spec=0
    Init_CAN2_Fr_TMSpd: value-spec=18000
    Init_CAN2_Fr_TMTemp: value-spec=0
    Init_CAN2_Fr_TMTempWarn: value-spec=3
    Init_CAN2_MCU_B_R_LLCTempWarn_Sta: value-spec=0
    Init_CAN2_Rr_EDUDrtSta: value-spec=0
    Init_CAN2_Rr_EDURealTMTq: value-spec=10220
    Init_CAN2_Rr_MCUTemp: value-spec=0
    Init_CAN2_Rr_MCUTempWarn: value-spec=3
    Init_CAN2_Rr_MotorAvailTq: value-spec=0
    Init_CAN2_Rr_TMSpd: value-spec=18000
    Init_CAN2_Rr_TMTemp: value-spec=0
    Init_CAN2_Rr_TMTempWarn: value-spec=3
    Init_CAN2_SWC2_L_DriveMode_Sta: value-spec=0
    Init_CAN2_SWC2_L_Home_Sta: value-spec=0
    Init_CAN2_SWC2_R_Customize_Sta: value-spec=0
    Init_CAN2_SWC2_R_Left_Sta: value-spec=0
    Init_CAN2_SWC2_R_PageSwitch_Sta: value-spec=0
    Init_CAN2_SWC2_R_Right_Sta: value-spec=0
    Init_CAN2_SWC2_R_ScrollDown_Sta: value-spec=0
    Init_CAN2_SWC2_R_ScrollPress_Sta: value-spec=0
    Init_CAN2_SWC2_R_ScrollUp_Sta: value-spec=0
    Init_CAN2_SWC2_R_VR_Sta: value-spec=0
    Init_CAN2_FAPWL_01_LIN_Response_Error: value-spec=0
    Init_CAN2_L_Drv_Motor_Relay_Error: value-spec=0
    Init_CAN2_L_Drv_Motor_Ripple_Error: value-spec=0
    Init_CAN2_L_Drv_Val_Wdw_Opened: value-spec=127
    Init_CAN2_L_Pas_Motor_Relay_Error: value-spec=0
    Init_CAN2_L_Pas_Motor_Ripple_Error: value-spec=0
    Init_CAN2_L_Pas_Val_Wdw_Opened: value-spec=127
    Init_CAN2_L_RLD_Motor_Relay_Error: value-spec=0
    Init_CAN2_L_RLD_Motor_Ripple_Error: value-spec=0
    Init_CAN2_L_RLD_Val_Wdw_Opened: value-spec=127
    Init_CAN2_L_RRD_Motor_Relay_Error: value-spec=0
    Init_CAN2_L_RRD_Motor_Ripple_Error: value-spec=0
    Init_CAN2_L_RRD_Val_Wdw_Opened: value-spec=127
    Init_CAN2_RAPWL_01_LIN_Response_Error: value-spec=0
    Init_CAN2_Rr_EDUDrtSta_Nidec: value-spec=0
    Init_CAN2_Rr_EDURealTMTq_Nidec: value-spec=1022
    Init_CAN2_Rr_MCUTempWarn_Nidec: value-spec=3
    Init_CAN2_Rr_MCUTemp_Nidec: value-spec=0
    Init_CAN2_Rr_MotorAvailTq_Nidec: value-spec=0
    Init_CAN2_Rr_TMSpd_Nidec: value-spec=17000
    Init_CAN2_Rr_TMTempWarn_Nidec: value-spec=3
    Init_CAN2_Rr_TMTemp_Nidec: value-spec=0
    Init_CAN2_A2B_Node_sta: value-spec=0
    Init_CAN2_AmbLigh_LowBatAlert_SW: value-spec=0
    Init_CAN2_AmbLigh_SafetyAlert_SW: value-spec=0
    Init_CAN2_AmbLightBrightnessSet: value-spec=101
    Init_CAN2_AmbLightColorSet: value-spec=64
    Init_CAN2_AmbLight_DimInDark_SW: value-spec=0
    Init_CAN2_AmbLight_SW: value-spec=0
    Init_CAN2_AmbLight_WlcmLight_SW: value-spec=0
    Init_CAN2_BrkAbn_GoReady_SW: value-spec=0
    Init_CAN2_FCP_FrEvt_BtnACMaxReq: value-spec=0
    Init_CAN2_FCP_FrEvt_BtnACReq: value-spec=0
    Init_CAN2_FCP_FrEvt_BtnAutoReq: value-spec=0
    Init_CAN2_FCP_FrEvt_BtnSyncReq: value-spec=0
    Init_CAN2_FCP_MidEvt_BtnAutoReq: value-spec=0
    Init_CAN2_IVI_AirRefresh_ByDMS_Sta: value-spec=0
    Init_CAN2_IVI_AutoTheme_But_Sta: value-spec=0
    Init_CAN2_IVI_CLWin_LockDoorSW_Sta: value-spec=0
    Init_CAN2_IVI_CreateAccReq_Sta: value-spec=0
    Init_CAN2_IVI_DMS_SW_Sta: value-spec=0
    Init_CAN2_IVI_DSEAT_anti_set_Sta: value-spec=0
    Init_CAN2_IVI_DelAccReq_Sta: value-spec=0
    Init_CAN2_IVI_FrTrunk_UnlockReq_Sta: value-spec=0
    Init_CAN2_IVI_HMI_Undefined_Sta: value-spec=0
    Init_CAN2_IVI_LinkAccReq_Sta: value-spec=0
    Init_CAN2_IVI_LinkAcc_Sta: value-spec=0
    Init_CAN2_IVI_LinkKey_Sta: value-spec=0
    Init_CAN2_IVI_Located_STA: value-spec=3
    Init_CAN2_IVI_Lock_SoundSW_Sta: value-spec=0
    Init_CAN2_IVI_NAVI_Foreground_Sta: value-spec=0
    Init_CAN2_IVI_OTA_Upd_Sta: value-spec=0
    Init_CAN2_IVI_QuickRefresh_Sta: value-spec=0
    Init_CAN2_IVI_SWC_VibMode_Sta: value-spec=0
    Init_CAN2_IVI_Time_Check: value-spec=0
    Init_CAN2_IVI_Time_Day: value-spec=0
    Init_CAN2_IVI_Time_Hour: value-spec=0
    Init_CAN2_IVI_Time_Minute: value-spec=0
    Init_CAN2_IVI_Time_Month: value-spec=0
    Init_CAN2_IVI_Time_Second: value-spec=0
    Init_CAN2_IVI_Time_Year: value-spec=0
    Init_CAN2_IVI_sigScreenReq_Sta: value-spec=0
    Init_CAN2_LINKtoDrive: value-spec=0
    Init_CAN2_OTA_CancelDL_Req: value-spec=0
    Init_CAN2_OTA_CompNTFY_Pres: value-spec=0
    Init_CAN2_OTA_DL_Req: value-spec=0
    Init_CAN2_OTA_SuspendDL_Req: value-spec=0
    Init_CAN2_OTA_UpdStart_Req: value-spec=0
    Init_CAN2_OpenDrOpenWdo_SW: value-spec=0
    Init_CAN2_PW_CLOSE_IMD: value-spec=0
    Init_CAN2_PW_CONTINUE_USE: value-spec=0
    Init_CAN2_Re_Radio_Sta: value-spec=0
    Init_CAN2_Sched_Chg_Day_Set: value-spec=0
    Init_CAN2_Sched_Chg_End_Time_HR: value-spec=0
    Init_CAN2_Sched_Chg_End_Time_Min: value-spec=0
    Init_CAN2_Sched_Chg_St_Time_HR: value-spec=0
    Init_CAN2_Sched_Chg_St_Time_Min: value-spec=0
    Init_CAN2_Sched_OTA_wake: value-spec=0
    Init_CAN2_SmartEco_Mode_SW: value-spec=0
    Init_CAN2_Upd_Countdown_Cancel: value-spec=0
    Init_CAN2_Upd_Countdown_Skip: value-spec=0
    Init_CAN2_UserSet: value-spec=0
    Init_CAN2_VehACModReq: value-spec=0
    Init_CAN2_mFRD_link_Sta: value-spec=0
    Init_CAN2_AC_Chg_Cur_Set: value-spec=0
    Init_CAN2_AEB_BUTT: value-spec=0
    Init_CAN2_AVM_Err_STA: value-spec=0
    Init_CAN2_AVM_OFF_Rec_Butt: value-spec=0
    Init_CAN2_AVM_Parking_mode: value-spec=0
    Init_CAN2_AVM_parking_cancel: value-spec=0
    Init_CAN2_AVM_parking_excute: value-spec=0
    Init_CAN2_Approach_Unlock_SW: value-spec=0
    Init_CAN2_BSDMute_BUTT: value-spec=0
    Init_CAN2_CAAS_Sw: value-spec=0
    Init_CAN2_CDL_Lock_Butt: value-spec=0
    Init_CAN2_CDL_Unlock_Butt: value-spec=0
    Init_CAN2_CameraWrn: value-spec=0
    Init_CAN2_DMS_Status: value-spec=0
    Init_CAN2_DMS_Warning_Distraction: value-spec=0
    Init_CAN2_DMS_Warning_Fatigue: value-spec=0
    Init_CAN2_DMS_Warning_Unresponsive: value-spec=0
    Init_CAN2_DSEAT_anti_set: value-spec=0
    Init_CAN2_DSEAT_entryfun_set: value-spec=0
    Init_CAN2_DSEAT_vent_req: value-spec=0
    Init_CAN2_Distance_unit: value-spec=0
    Init_CAN2_ESC_SW_Cmd: value-spec=0
    Init_CAN2_FCWMute_BUTT: value-spec=0
    Init_CAN2_FFogLampSW: value-spec=0
    Init_CAN2_FS_Off_Sw: value-spec=0
    Init_CAN2_FalseNPrevent_SW: value-spec=1
    Init_CAN2_FollowMeSW: value-spec=0
    Init_CAN2_GPS_LAT: value-spec=0
    Init_CAN2_GPS_LONG: value-spec=0
    Init_CAN2_HeadLampSW: value-spec=0
    Init_CAN2_Hood_Latch_SW: value-spec=0
    Init_CAN2_IVI_ACC_Adaptive_Sta: value-spec=0
    Init_CAN2_IVI_ActvDmpDisabSW: value-spec=0
    Init_CAN2_IVI_AirIntZ3_Cmd: value-spec=0
    Init_CAN2_IVI_CfmTo_Rdy: value-spec=0
    Init_CAN2_IVI_ChargePortSW_Sta: value-spec=0
    Init_CAN2_IVI_CoastDwSW: value-spec=0
    Init_CAN2_IVI_CreepSW_Req: value-spec=0
    Init_CAN2_IVI_DSEATHeater_Cmd: value-spec=0
    Init_CAN2_IVI_DSEAT_FroEdge_Height_Cmd: value-spec=0
    Init_CAN2_IVI_DSEAT_Height_Cmd: value-spec=0
    Init_CAN2_IVI_DSEAT_Memory1_Sta: value-spec=0
    Init_CAN2_IVI_DSEAT_Memory2_Sta: value-spec=0
    Init_CAN2_IVI_DSEAT_Memory_OPTCLS_Sta: value-spec=0
    Init_CAN2_IVI_DSEAT_Recline_Cmd: value-spec=0
    Init_CAN2_IVI_DSEAT_Slide_Cmd: value-spec=0
    Init_CAN2_IVI_ISA_OffsetSpd: value-spec=15
    Init_CAN2_IVI_LVChrgFuncSW: value-spec=0
    Init_CAN2_IVI_Mute_Sta: value-spec=0
    Init_CAN2_IVI_Night_Mode_Sta: value-spec=0
    Init_CAN2_IVI_PSEATHeater_Cmd: value-spec=0
    Init_CAN2_IVI_PSEAT_Recline_Cmd: value-spec=0
    Init_CAN2_IVI_PSEAT_Slide_Cmd: value-spec=0
    Init_CAN2_IVI_PTG_Mode_SW: value-spec=0
    Init_CAN2_IVI_PTG_Open_Height: value-spec=5
    Init_CAN2_IVI_PTG_Sta_SW: value-spec=0
    Init_CAN2_IVI_PTG_USSta_SW: value-spec=0
    Init_CAN2_IVI_PW_Mode_Req: value-spec=0
    Init_CAN2_IVI_Panel_Act: value-spec=0
    Init_CAN2_IVI_Panel_X_Coor: value-spec=0
    Init_CAN2_IVI_Panel_Y_Coor: value-spec=0
    Init_CAN2_IVI_PwrLockSW: value-spec=0
    Init_CAN2_IVI_Pwroff_req: value-spec=0
    Init_CAN2_IVI_RR_Def_Req: value-spec=0
    Init_CAN2_IVI_Req_V2L: value-spec=0
    Init_CAN2_IVI_SLIF_Warning_Sta: value-spec=3
    Init_CAN2_IVI_SWC_ACCMode_Sta: value-spec=0
    Init_CAN2_IVI_SWC_LUndefined_Sta: value-spec=0
    Init_CAN2_IVI_SWC_RUndefined_Sta: value-spec=0
    Init_CAN2_IVI_Screen: value-spec=0
    Init_CAN2_IVI_SetTempZon1_Sta: value-spec=31
    Init_CAN2_IVI_SetTempZon2_Sta: value-spec=31
    Init_CAN2_IVI_Start_Chg_req: value-spec=0
    Init_CAN2_IVI_Status: value-spec=0
    Init_CAN2_IVI_Stop_Chg_req: value-spec=0
    Init_CAN2_IVI_TrailerCheckReq_Sta: value-spec=0
    Init_CAN2_IVI_TrailerModeSW_Sta: value-spec=0
    Init_CAN2_IVI_Trigger_req: value-spec=0
    Init_CAN2_IVI_Unlock_Chg_req: value-spec=0
    Init_CAN2_IVI_WI_MAIN_SW: value-spec=0
    Init_CAN2_LDWMute_BUTT: value-spec=0
    Init_CAN2_LKA_BUTT: value-spec=0
    Init_CAN2_LVDAMute_BUTT: value-spec=0
    Init_CAN2_L_Drv_ControlCommand: value-spec=127
    Init_CAN2_L_Pas_ControlCommand: value-spec=127
    Init_CAN2_L_RLD_ControlCommand: value-spec=127
    Init_CAN2_L_RRD_ControlCommand: value-spec=127
    Init_CAN2_Light_ShowStart_Req: value-spec=0
    Init_CAN2_Light_ShowStop_Req: value-spec=0
    Init_CAN2_METER_Malfunc_Sta: value-spec=0
    Init_CAN2_MFRD_N_Bright_Req: value-spec=0
    Init_CAN2_NAVI_Cam_Dist_info: value-spec=0
    Init_CAN2_NAVI_Direction_STA: value-spec=0
    Init_CAN2_NAVI_Distance_info: value-spec=0
    Init_CAN2_NAVI_ForwardLinkLevel: value-spec=0
    Init_CAN2_NAVI_LinkClass: value-spec=0
    Init_CAN2_NAVI_RoadClass: value-spec=0
    Init_CAN2_NAVI_SpeedLimit: value-spec=0
    Init_CAN2_NAVI_Speed_Limit_A: value-spec=0
    Init_CAN2_NAVI_State: value-spec=0
    Init_CAN2_NAVI_Tollgate: value-spec=0
    Init_CAN2_NAVI_Tunnel: value-spec=0
    Init_CAN2_ODAMute_BUTT: value-spec=0
    Init_CAN2_OFF_AC_MODE: value-spec=0
    Init_CAN2_PSEAT_vent_req: value-spec=0
    Init_CAN2_Perd_V2L: value-spec=0
    Init_CAN2_Pressure_unit: value-spec=0
    Init_CAN2_RCTA_BUTT: value-spec=0
    Init_CAN2_RFogLampSW: value-spec=0
    Init_CAN2_Roll_Eng_Mode: value-spec=0
    Init_CAN2_Roll_Mode_SW_Cmd: value-spec=0
    Init_CAN2_RoomLampMode: value-spec=0
    Init_CAN2_SLG_Sw: value-spec=0
    Init_CAN2_SLIF_BUTT: value-spec=0
    Init_CAN2_SOC_ADJ_BUTT: value-spec=0
    Init_CAN2_SOC_Limit_Set: value-spec=25
    Init_CAN2_SOC_V2LLimit: value-spec=0
    Init_CAN2_Sched_Chg_Start: value-spec=0
    Init_CAN2_Sched_Chg_Stop: value-spec=0
    Init_CAN2_Sched_Chg_butt: value-spec=0
    Init_CAN2_Sched_Chg_limit: value-spec=25
    Init_CAN2_Sched_Chg_wake: value-spec=0
    Init_CAN2_SenstivityPosition: value-spec=0
    Init_CAN2_SetUnlockSingle: value-spec=0
    Init_CAN2_TCS_SW_Cmd: value-spec=0
    Init_CAN2_TPMS_Cali_Butt: value-spec=0
    Init_CAN2_TPMS_Res_Butt: value-spec=0
    Init_CAN2_Temperature_unit: value-spec=0
    Init_CAN2_Time_system: value-spec=0
    Init_CAN2_TurnSwTimeSet: value-spec=0
    Init_CAN2_User_p_download: value-spec=0
    Init_CAN2_User_p_upload: value-spec=0
    Init_CAN2_Walkaway_Lock_SW: value-spec=1
    Init_CAN2_Wifi_Reset: value-spec=0
    Init_CAN2_Wifi_Sta_IVI_TBOX: value-spec=0
    Init_CAN2_WlcmLight_Mode: value-spec=0
    Init_CAN2_sigAirIntenZon1Req: value-spec=0
    Init_CAN2_sigAirIntenZon3Req: value-spec=0
    Init_CAN2_sigDfrstReq: value-spec=0
    Init_CAN2_sigFaceReq: value-spec=0
    Init_CAN2_sigFootReq: value-spec=0
    Init_CAN2_sigHvacFrontReq: value-spec=0
    Init_CAN2_sigHvacRearReq: value-spec=0
    Init_CAN2_sigHvacReq: value-spec=0
    Init_CAN2_sigRecircReq: value-spec=0
    Init_CAN2_sigSetTempZon{1..3}Req: value-spec=0
    Init_CAN2_sigWindDirZon3Req: value-spec=7
    Init_CAN2_IVI_CLBlower_Y_Sta: value-spec=0
    Init_CAN2_IVI_CLBlower_Z_Sta: value-spec=0
    Init_CAN2_IVI_CRBlower_Y_Sta: value-spec=0
    Init_CAN2_IVI_CRBlower_Z_Sta: value-spec=0
    Init_CAN2_IVI_DrBlower_Mode_Sta: value-spec=0
    Init_CAN2_IVI_DrBlower_Y_Sta: value-spec=0
    Init_CAN2_IVI_DrBlower_Z_Sta: value-spec=0
    Init_CAN2_IVI_LSEATvent_Cmd: value-spec=0
    Init_CAN2_IVI_MLFMost_Cmd: value-spec=0
    Init_CAN2_IVI_MLFootLift_Cmd: value-spec=0
    Init_CAN2_IVI_MLNapMode_Cmd: value-spec=0
    Init_CAN2_IVI_MLRecliner_Cmd: value-spec=0
    Init_CAN2_IVI_MLRestore_Cmd: value-spec=0
    Init_CAN2_IVI_MLSEATvent_Cmd: value-spec=0
    Init_CAN2_IVI_MLSeatLift_Cmd: value-spec=0
    Init_CAN2_IVI_MLSldRestore_Cmd: value-spec=0
    Init_CAN2_IVI_MLSlider_Cmd: value-spec=0
    Init_CAN2_IVI_MLZeroGravity_Cmd: value-spec=0
    Init_CAN2_IVI_MRFMost_Cmd: value-spec=0
    Init_CAN2_IVI_MRFootLift_Cmd: value-spec=0
    Init_CAN2_IVI_MRNapMode_Cmd: value-spec=0
    Init_CAN2_IVI_MRRecliner_Cmd: value-spec=0
    Init_CAN2_IVI_MRRestore_Cmd: value-spec=0
    Init_CAN2_IVI_MRSEATvent_Cmd: value-spec=0
    Init_CAN2_IVI_MRSeatLift_Cmd: value-spec=0
    Init_CAN2_IVI_MRSldRestore_Cmd: value-spec=0
    Init_CAN2_IVI_MRSlider_Cmd: value-spec=0
    Init_CAN2_IVI_MRZeroGravity_Cmd: value-spec=0
    Init_CAN2_IVI_PsBlower_Mode_Sta: value-spec=0
    Init_CAN2_IVI_PsBlower_Y_Sta: value-spec=0
    Init_CAN2_IVI_PsBlower_Z_Sta: value-spec=0
    Init_CAN2_IVI_RSEATvent_Cmd: value-spec=0
    Init_CAN2_IVI_AmbiLgtSta: value-spec=0
    Init_CAN2_IVI_FrAtmoLamp_Cmd: value-spec=0
    Init_CAN2_IVI_FrRmLampBright_Cmd: value-spec=0
    Init_CAN2_IVI_Frontindoorlight_Sta: value-spec=0
    Init_CAN2_IVI_Passengerdoor_Sta: value-spec=0
    Init_CAN2_IVI_RrAtmoLamp_Cmd: value-spec=0
    Init_CAN2_IVI_RrRmLampBright_Cmd: value-spec=0
    Init_CAN2_IVI_RrRoomlamp_Cmd: value-spec=0
    Init_CAN2_APCforDTE: value-spec=9999
    Init_CAN2_AVGPwrConsumption: value-spec=9999
    Init_CAN2_AvailableTrip: value-spec=0
    Init_CAN2_Averaged_vehspeed: value-spec=0
    Init_CAN2_Charge: value-spec=0
    Init_CAN2_LEDlitWarnReq: value-spec=0
    Init_CAN2_METER_KPH_Calcu: value-spec=0
    Init_CAN2_METER_KPH_Real: value-spec=0
    Init_CAN2_METER_MPH_Calcu: value-spec=0
    Init_CAN2_METER_MPH_Real: value-spec=0
    Init_CAN2_ODOMETER: value-spec=0
    Init_CAN2_ParkBrake: value-spec=0
    Init_CAN2_Spd_Crl_Mode: value-spec=0
    Init_CAN2_Spd_Crl_Sta: value-spec=0
    Init_CAN2_Trip_A: value-spec=0
    Init_CAN2_Trip_B: value-spec=0
    Init_CAN2_SG_FD2_C200_1: value-spec=fields=[Init_CAN2_FDC_CHA_CACPresWarn_Sta, Init_CAN2_FDC_CHA_CACTempWarn_Sta]
    Init_CAN2_SG_FD2_C20_0: value-spec=fields=[Init_CAN2_APS_ExitCondition, Init_CAN2_APS_RQ_Display, Init_CAN2_APS_SW_Ver, Init_CAN2_APS_Sta_System, Init_CAN2_CAAS_Sta, Init_CAN2_FDC_VCU_RegenLimInd_Sta, Init_CAN2_FDC_VCU_RegenMode_Sta, Init_CAN2_FDC_VCU_SmartEcoSpdLim_Sta, Init_CAN2_FDC_VCU_SmartEco_Sta, Init_CAN2_FDC_VMC_SetSpdDisp_Sta, Init_CAN2_FDC_VMC_SetSpd_Sta, Init_CAN2_FDC_VMC_SpdCtrlMode_Sta, Init_CAN2_FDC_VMC_SpdCtrl_Sta, Init_CAN2_PAS_A_FCL, Init_CAN2_PAS_A_FCR, Init_CAN2_PAS_A_FML, Init_CAN2_PAS_A_FMR, Init_CAN2_PAS_A_RCL, Init_CAN2_PAS_A_RCR, Init_CAN2_PAS_A_RML, Init_CAN2_PAS_A_RMR, Init_CAN2_PAS_Chime, Init_CAN2_PAS_D_FCL, Init_CAN2_PAS_D_FCR, Init_CAN2_PAS_D_FML, Init_CAN2_PAS_D_FMR, Init_CAN2_PAS_D_RCL, Init_CAN2_PAS_D_RCR, Init_CAN2_PAS_D_RML, Init_CAN2_PAS_D_RMR, Init_CAN2_PAS_SNSR_Layout, Init_CAN2_USS_Sta_FCL, Init_CAN2_USS_Sta_FCR, Init_CAN2_USS_Sta_FLL, Init_CAN2_USS_Sta_FLR, Init_CAN2_USS_Sta_FML, Init_CAN2_USS_Sta_FMR, Init_CAN2_USS_Sta_RCL, Init_CAN2_USS_Sta_RCR, Init_CAN2_USS_Sta_RLL, Init_CAN2_USS_Sta_RLR, Init_CAN2_USS_Sta_RML, Init_CAN2_USS_Sta_RMR, Init_CAN2_VMC_VCU_CC_Crl_Sta, Init_CAN2_VMC_VCU_MSA_Crl_Sta]
    Init_CAN2_SG_FD2_CE100_0: value-spec=fields=[Init_CAN2_APMDoorControlSta, Init_CAN2_ActAPSPosn, Init_CAN2_AllDoorSW, Init_CAN2_AntitheftSta, Init_CAN2_BCM_DoorLock_Sta, Init_CAN2_BrakeLamp, Init_CAN2_CCMSA_SpdWar, Init_CAN2_CCU_ACLampSts, Init_CAN2_CCU_ACMaxLampSts, Init_CAN2_CCU_AutoLampSts, Init_CAN2_CCU_AutoMidLampSts, Init_CAN2_CCU_Dispaly_Request, Init_CAN2_CCU_EcoSts, Init_CAN2_CCU_FrtOnOffLampSts, Init_CAN2_CCU_RrOnOffLampSts, Init_CAN2_CCU_SyncLampSts, Init_CAN2_CC_Crl_Sta, Init_CAN2_CoastDwModeStaChk, Init_CAN2_CreepSW_Sta, Init_CAN2_DISC_ButtSta, Init_CAN2_DISC_Sta, Init_CAN2_DemoModeStaChk, Init_CAN2_Dimmer, Init_CAN2_DimmerEN, Init_CAN2_DisengageP_Fail, Init_CAN2_DoorLockIND, Init_CAN2_DrDoorSW, Init_CAN2_Dr_SeatSta, Init_CAN2_DynoModeStaChk, Init_CAN2_EDriveSysErr_AccPedalErr, Init_CAN2_EDriveSysErr_MCUErr, Init_CAN2_EDriveSysErr_ShifterErr, Init_CAN2_EDriveSysErr_VCUErr, Init_CAN2_EVDriveMode, Init_CAN2_Eng_ActvDmpDisabSta, Init_CAN2_Eng_CoastDwSta, Init_CAN2_Eng_PwrLockSta, Init_CAN2_EngageP_Fail, Init_CAN2_FDC_THCM_CLEVentY_Sta, Init_CAN2_FDC_THCM_CLEVentZ_Sta, Init_CAN2_FDC_THCM_CLVent_Sta, Init_CAN2_FDC_THCM_CREVentY_Sta, Init_CAN2_FDC_THCM_CREVentZ_Sta, Init_CAN2_FDC_THCM_CRVent_Sta, Init_CAN2_FDC_THCM_DrEVentMode_Sta, Init_CAN2_FDC_THCM_DrEVentY_Sta, Init_CAN2_FDC_THCM_DrEVentZ_Sta, Init_CAN2_FDC_THCM_DrVent_Sta, Init_CAN2_FDC_THCM_PsEVentMode_Sta, Init_CAN2_FDC_THCM_PsEVentY_Sta, Init_CAN2_FDC_THCM_PsEVentZ_Sta, Init_CAN2_FDC_THCM_PsVent_Sta, Init_CAN2_FDC_VCU_PwrSaveReq_Cmd, Init_CAN2_FD_ABS_Warning, Init_CAN2_FD_Battery_Charge_Warning, Init_CAN2_FD_EDrive_System, Init_CAN2_FD_EPB_Error, Init_CAN2_FD_HV_Battery_Fault, Init_CAN2_FD_Park_Brake_Warning, Init_CAN2_FD_Power_limitation, Init_CAN2_FD_Steering_Warning, Init_CAN2_FD_TCS_Indicator, Init_CAN2_FD_Telltale_Fail, Init_CAN2_FalseNPrevent_Sta, Init_CAN2_FeatSetSpdFinal_raw32, Init_CAN2_FollowMe, Init_CAN2_Fr_FogLamp, Init_CAN2_HVRlyOpFail, Init_CAN2_HVSysErr_IsolationErr, Init_CAN2_HVSysErr_PackErr, Init_CAN2_HVSysErr_RelayErr, Init_CAN2_H_Beam, Init_CAN2_HazardSW, Init_CAN2_HoodSW, Init_CAN2_LBSD, Init_CAN2_LDRL, Init_CAN2_LTurnLP, Init_CAN2_LVChrgFuncStaChk, Init_CAN2_LVSysErr_PwrOutpErr, Init_CAN2_L_Beam, Init_CAN2_LimphomeAct, Init_CAN2_LockSetting, Init_CAN2_MCUActDisFail, Init_CAN2_MSA_Crl_Sta, Init_CAN2_MeterIndSpeed_raw32, Init_CAN2_PAS_Sta_F_Sys, Init_CAN2_PosLamp, Init_CAN2_PsDoorSW, Init_CAN2_PwrSta, Init_CAN2_PwrStaErr, Init_CAN2_PwrStaONTOIVIPopReq, Init_CAN2_PwrStaONTOIVIPopT, Init_CAN2_RBSD, Init_CAN2_RDRL, Init_CAN2_RLDoorSW, Init_CAN2_RRDoorSW, Init_CAN2_RTurnLP, Init_CAN2_Req_Internal_V2L_Status_Lamp, Init_CAN2_Req_V2LSwOn, Init_CAN2_Req_V2L_IVI_Popup, Init_CAN2_ReverseLamp, Init_CAN2_Rr_Defog, Init_CAN2_Rr_FogLamp, Init_CAN2_ShiftGearPosn, Init_CAN2_SysAllowReadySta, Init_CAN2_SysPwrSta, Init_CAN2_Tailgate_SW, Init_CAN2_VCUBrkSWSta, Init_CAN2_VCUFLDoorSta, Init_CAN2_VCUFRDoorSta, Init_CAN2_VCUHoodSWSta, Init_CAN2_VCURLDoorSta, Init_CAN2_VCURRDoorSta, Init_CAN2_VCUTailgateSWSta, Init_CAN2_VCU_OPDHold, Init_CAN2_VehMalfunLevel, Init_CAN2_XWDMode, Init_CAN2_sigAirIntenZon1St, Init_CAN2_sigAirIntenZon3St, Init_CAN2_sigAmbAirT, Init_CAN2_sigCbnAirT, Init_CAN2_sigDfrstSt, Init_CAN2_sigHvacSt, Init_CAN2_sigRecircSt, Init_CAN2_sigSetTempZon1St, Init_CAN2_sigSetTempZon2St, Init_CAN2_sigSetTempZon3St, Init_CAN2_sigWindDirZon1St, Init_CAN2_sigWindDirZon3St]
    Init_CAN2_SG_FD2_CE100_1: value-spec=fields=[Init_CAN2_FDC_BCM_TgateSWL_Sta, Init_CAN2_FDC_BCM_TgateSWR_Sta, Init_CAN2_FDC_BCM_WelcomeDemo_Sta, Init_CAN2_FDC_VCU_DACStatus_Sta, Init_CAN2_FDC_VCU_TUpASta_Sta]
    Init_CAN2_SG_FD2_CE200_1: value-spec=fields=[Init_CAN2_AutoLTips, Init_CAN2_CWheelTips, Init_CAN2_FDC_BCM_Acc1Sta_Sta, Init_CAN2_FDC_BCM_Acc2Sta_Sta, Init_CAN2_FDC_BCM_Acc3Sta_Sta, Init_CAN2_FDC_BCM_Acc4Sta_Sta, Init_CAN2_FDC_BCM_Acc5Sta_Sta, Init_CAN2_FDC_BCM_AmbBrightSta_Sta, Init_CAN2_FDC_BCM_AmbColorSta_Sta, Init_CAN2_FDC_BCM_AmbDimEN_Sta, Init_CAN2_FDC_BCM_AmbFunEN_Sta, Init_CAN2_FDC_BCM_AmbLinkDriSta_Sta, Init_CAN2_FDC_BCM_AmbODAEN_Sta, Init_CAN2_FDC_BCM_AmbPwrWarnEN_Sta, Init_CAN2_FDC_BCM_AmbWelEN_Sta, Init_CAN2_FDC_BCM_CLWinLockDr_Sta, Init_CAN2_FDC_BCM_FollowMeENFun_Sta, Init_CAN2_FDC_BCM_Key10Acc_Sta, Init_CAN2_FDC_BCM_Key1Acc_Sta, Init_CAN2_FDC_BCM_Key2Acc_Sta, Init_CAN2_FDC_BCM_Key3Acc_Sta, Init_CAN2_FDC_BCM_Key4Acc_Sta, Init_CAN2_FDC_BCM_Key5Acc_Sta, Init_CAN2_FDC_BCM_Key6Acc_Sta, Init_CAN2_FDC_BCM_Key7Acc_Sta, Init_CAN2_FDC_BCM_Key8Acc_Sta, Init_CAN2_FDC_BCM_Key9Acc_Sta, Init_CAN2_FDC_BCM_LockAlarm_Cmd, Init_CAN2_FDC_BCM_PTGOpenHeight_Sta, Init_CAN2_FDC_BCM_RmLpModeENFun_Sta, Init_CAN2_FDC_BCM_TurnSwTSetSta_Sta, Init_CAN2_FDC_BCM_UserNow_Sta, Init_CAN2_FDC_BCM_WalkInUnLkEnFun_Sta, Init_CAN2_FDC_BCM_WalkOutLkEnFun_Sta, Init_CAN2_FDC_DKC_DkeyShowIVI_Sta, Init_CAN2_FDC_DKC_KeyMiss_Sta, Init_CAN2_FDC_DKC_KeyNum_Sta, Init_CAN2_FDC_DKC_KeyType_Sta, Init_CAN2_FDC_DKC_UIDLowPower_Sta, Init_CAN2_FDC_SPTG_SPTGENFun_Sta, Init_CAN2_FDC_THCM_APTCForceOFF_Sta, Init_CAN2_FDC_THCM_APTCWarning_Sta, Init_CAN2_FDC_THCM_AirIntZ3_Sta, Init_CAN2_LFWheelShield, Init_CAN2_LRBatWarn, Init_CAN2_LRPressIndi, Init_CAN2_LRSensorFail, Init_CAN2_LRWheelDebug, Init_CAN2_LRWheelPSW, Init_CAN2_LRWheelPress, Init_CAN2_LRWheelShield, Init_CAN2_LRWheelTemp, Init_CAN2_LRWheelTmpIndi, Init_CAN2_RFWheelShield, Init_CAN2_RRBatWarn, Init_CAN2_RRPressIndi, Init_CAN2_RRSensorFail, Init_CAN2_RRWheelDebug, Init_CAN2_RRWheelPSW, Init_CAN2_RRWheelPress, Init_CAN2_RRWheelShield, Init_CAN2_RRWheelTemp, Init_CAN2_RRWheelTmpIndi, Init_CAN2_T1_TPMS_LFBatWarn, Init_CAN2_T1_TPMS_LFPressIndi, Init_CAN2_T1_TPMS_LFSensorFail, Init_CAN2_T1_TPMS_LFWheelDebug, Init_CAN2_T1_TPMS_LFWheelPSW, Init_CAN2_T1_TPMS_LFWheelPress, Init_CAN2_T1_TPMS_LFWheelTemp, Init_CAN2_T1_TPMS_LFWheelTmpIndi, Init_CAN2_T1_TPMS_RFBatWarn, Init_CAN2_T1_TPMS_RFPressIndi, Init_CAN2_T1_TPMS_RFSensorFail, Init_CAN2_T1_TPMS_RFWheelDebug, Init_CAN2_T1_TPMS_RFWheelPSW, Init_CAN2_T1_TPMS_RFWheelPress, Init_CAN2_T1_TPMS_RFWheelTemp, Init_CAN2_T1_TPMS_RFWheelTmpIndi, Init_CAN2_T1_TPMS_TPMSWarnIndi, Init_CAN2_TPMS_Cali_Butt_Allow, Init_CAN2_TPMS_Res_Butt_Allow]
    Init_CAN2_SG_FD2_OTA1: value-spec=fields=[Init_CAN2_OTA_DL_Available, Init_CAN2_OTA_DL_Speed, Init_CAN2_OTA_Debug_Code, Init_CAN2_OTA_Emergency_Sta, Init_CAN2_OTA_InVehicle_FW, Init_CAN2_OTA_Lock_Req, Init_CAN2_OTA_MDA_Status, Init_CAN2_OTA_Mode, Init_CAN2_OTA_Network_Type, Init_CAN2_OTA_Permit_Agreed, Init_CAN2_OTA_Progress_Rate, Init_CAN2_OTA_Remained_Time, Init_CAN2_OTA_TBOXResetReq, Init_CAN2_OTA_Update_Available, Init_CAN2_OTA_Updating_ECU_8bit]
    Init_CAN2_SG_FD2_Version: value-spec=fields=[Init_CAN2_FUSION_HW_Ver1, Init_CAN2_FUSION_HW_Ver2, Init_CAN2_FUSION_HW_Ver3, Init_CAN2_FUSION_SW_CarModel1, Init_CAN2_FUSION_SW_CarModel2, Init_CAN2_FUSION_SW_CarModel3, Init_CAN2_FUSION_SW_Controller1, Init_CAN2_FUSION_SW_Controller2, Init_CAN2_FUSION_SW_Country1, Init_CAN2_FUSION_SW_Country2, Init_CAN2_FUSION_SW_ECUGen1, Init_CAN2_FUSION_SW_ECUGen2, Init_CAN2_FUSION_SW_Major1, Init_CAN2_FUSION_SW_Major2, Init_CAN2_FUSION_SW_Minor1, Init_CAN2_FUSION_SW_Minor2, Init_CAN2_FUSION_SW_Patch1, Init_CAN2_FUSION_SW_Patch2, Init_CAN2_FUSION_SW_SHA1, Init_CAN2_FUSION_SW_SHA2, Init_CAN2_FUSION_SW_SHA3, Init_CAN2_FUSION_SW_SHA4, Init_CAN2_FUSION_SW_SHA5, Init_CAN2_FUSION_SW_SHA6, Init_CAN2_FUSION_SW_SHA7, Init_CAN2_FUSION_SW_SHA8, Init_CAN2_FUSION_SW_Var1, Init_CAN2_FUSION_SW_Var2, Init_CAN2_FUSION_SW_Var3, Init_CAN2_FUSION_SW_Var4, Init_CAN2_FUSION_SW_Var5, Init_CAN2_FUSION_SW_change1, Init_CAN2_FUSION_SW_change2, Init_CAN2_FUSION_SW_dash1, Init_CAN2_FUSION_SW_dash2]
    Init_CAN2_SG_GW2_C10_0: value-spec=fields=[Init_CAN2_ABS_Active, Init_CAN2_ABS_Failed, Init_CAN2_ABS_WnlmpSta, Init_CAN2_AVH_Failed, Init_CAN2_Amber_WnlmpSta, Init_CAN2_BrkSw_Sta, Init_CAN2_HSA_Active, Init_CAN2_HSA_Failed, Init_CAN2_Meter_Ind_VehSpeed, Init_CAN2_Red_WnlmpSta, Init_CAN2_VehSpeed]
    Init_CAN2_SG_CGW_GW2_C10_0: value-spec=fields=[Init_CAN2_DCDCAuxCur, Init_CAN2_DCDCAuxVolt, Init_CAN2_DrPMMLVOutPErrLmp, Init_CAN2_DrPMMSysErrLmp, Init_CAN2_DrSCPSysErrLmp, Init_CAN2_FLTurn_Light_Warning, Init_CAN2_FRTurn_Light_Warning, Init_CAN2_FireDetErr, Init_CAN2_FrPMMLimpHomeActReq, Init_CAN2_HVBattCurr, Init_CAN2_HVBattErr, Init_CAN2_HVBattVolt, Init_CAN2_LADB_Hibeam_Indication, Init_CAN2_LADB_Operation_Status, Init_CAN2_LADB_Warning, Init_CAN2_LAHB_Warning, Init_CAN2_LDRL_Warning, Init_CAN2_LLB_Warning, Init_CAN2_Lposition_Lamp_Warning, Init_CAN2_RADB_Hibeam_Indication, Init_CAN2_RADB_Operation_Status, Init_CAN2_RADB_Warning, Init_CAN2_RAHB_Warning, Init_CAN2_RDRL_Warning, Init_CAN2_RLB_Warning, Init_CAN2_Rposition_Lamp_Warning]
    Init_CAN2_SG_GW2_CE1000_0: value-spec=fields=[Init_CAN2_ACChrgCurrDis, Init_CAN2_Charge_Percent_Set, Init_CAN2_HVBChrgPwr, Init_CAN2_HVBattSOC, Init_CAN2_HVBattSOCDis, Init_CAN2_RemainChrgTime, Init_CAN2_Rr_MCU3_HW_Ver, Init_CAN2_Rr_MCU3_HW_Ver_Nidec, Init_CAN2_Rr_MCU3_SW_Ver, Init_CAN2_Rr_MCU3_SW_Ver_Nidec, Init_CAN2_TBOX_HW_VER, Init_CAN2_TBOX_SW_VER, Init_CAN2_TimeSyncFromBS_Day, Init_CAN2_TimeSyncFromBS_Hour, Init_CAN2_TimeSyncFromBS_Minute, Init_CAN2_TimeSyncFromBS_Month, Init_CAN2_TimeSyncFromBS_Second, Init_CAN2_TimeSyncFromBS_Year]
    Init_CAN2_SG_GW2_CE100_0: value-spec=fields=[Init_CAN2_COMP_ActualPwr, Init_CAN2_CbnPreACEnaReq, Init_CAN2_ChargeInletLockSta, Init_CAN2_ChrgPlugSta, Init_CAN2_DKC_KeyNum_Sta, Init_CAN2_DKC_KeyType_Sta, Init_CAN2_DisChrgPlugErr, Init_CAN2_ExtChrgSta, Init_CAN2_FDC_BCM_DimSw, Init_CAN2_FDC_BCM_FWipSw_Sta, Init_CAN2_FDC_BCM_TurnSw_Sta, Init_CAN2_FrntPTCLeActHeatPwr, Init_CAN2_FrntPTCRearLeActHeatPwr, Init_CAN2_FrntPTCRearRiActHeatPwr, Init_CAN2_FrntPTCRiActHeatPwr, Init_CAN2_HVBChrgErr, Init_CAN2_HVBContactorSta, Init_CAN2_HVBMTempMax, Init_CAN2_HVBOvrTempErr, Init_CAN2_HVBOvrTempWarn, Init_CAN2_MainRlyNegSta, Init_CAN2_MainRlyPosSta, Init_CAN2_OBCACCSLimit, Init_CAN2_OBCACCurrInf, Init_CAN2_OBCACVoltInf, Init_CAN2_OBCFaultSta, Init_CAN2_OBC_AC_Cur_Lim, Init_CAN2_PTCActuPwrHSC6, Init_CAN2_P_Dkey_Show_IVI, Init_CAN2_P_KeyMiss, Init_CAN2_P_UID_LowPower, Init_CAN2_RLS_Lamp_Sta, Init_CAN2_Re_Radio, Init_CAN2_SWC_ACC_Sta, Init_CAN2_SWC_Down_Sta, Init_CAN2_SWC_LKA_Sta, Init_CAN2_SWC_Left_Sta, Init_CAN2_SWC_RegenDown, Init_CAN2_SWC_RegenUp, Init_CAN2_SWC_Right_Sta, Init_CAN2_SWC_Trip_Sta, Init_CAN2_SWC_Undefined_Sta, Init_CAN2_SWC_Up_Sta, Init_CAN2_SWC_VR_Sta, Init_CAN2_SWC_mode_Sta, Init_CAN2_Shifter_Fail_sta, Init_CAN2_Shifter_Handle_Cmd, Init_CAN2_TBOX_NET_SIG_STR, Init_CAN2_TBOX_TEST_STATUS, Init_CAN2_TrailerCheck, Init_CAN2_TrailerModeSta, Init_CAN2_V2LSta, Init_CAN2_ZFR_BCM_ChargerDoorSW_Sta, Init_CAN2_ZFR_EChrg_Active_Sta, Init_CAN2_ZFR_EChrg_Sys_Sta]
    Init_CAN2_SG_GW2_CE100_1: value-spec=fields=[Init_CAN2_Fr_EDUDrtSta, Init_CAN2_Fr_EDURealTMTq, Init_CAN2_Fr_MCUTemp, Init_CAN2_Fr_MCUTempWarn, Init_CAN2_Fr_MotorAvailTq, Init_CAN2_Fr_TMSpd, Init_CAN2_Fr_TMTemp, Init_CAN2_Fr_TMTempWarn, Init_CAN2_MCU_B_R_LLCTempWarn_Sta, Init_CAN2_Rr_EDUDrtSta, Init_CAN2_Rr_EDURealTMTq, Init_CAN2_Rr_MCUTemp, Init_CAN2_Rr_MCUTempWarn, Init_CAN2_Rr_MotorAvailTq, Init_CAN2_Rr_TMSpd, Init_CAN2_Rr_TMTemp, Init_CAN2_Rr_TMTempWarn, Init_CAN2_SWC2_L_DriveMode_Sta, Init_CAN2_SWC2_L_Home_Sta, Init_CAN2_SWC2_R_Customize_Sta, Init_CAN2_SWC2_R_Left_Sta, Init_CAN2_SWC2_R_PageSwitch_Sta, Init_CAN2_SWC2_R_Right_Sta, Init_CAN2_SWC2_R_ScrollDown_Sta, Init_CAN2_SWC2_R_ScrollPress_Sta, Init_CAN2_SWC2_R_ScrollUp_Sta, Init_CAN2_SWC2_R_VR_Sta]
    Init_CAN2_SG_GW2_CE100_2: value-spec=fields=[Init_CAN2_FAPWL_01_LIN_Response_Error, Init_CAN2_L_Drv_Motor_Relay_Error, Init_CAN2_L_Drv_Motor_Ripple_Error, Init_CAN2_L_Drv_Val_Wdw_Opened, Init_CAN2_L_Pas_Motor_Relay_Error, Init_CAN2_L_Pas_Motor_Ripple_Error, Init_CAN2_L_Pas_Val_Wdw_Opened, Init_CAN2_L_RLD_Motor_Relay_Error, Init_CAN2_L_RLD_Motor_Ripple_Error, Init_CAN2_L_RLD_Val_Wdw_Opened, Init_CAN2_L_RRD_Motor_Relay_Error, Init_CAN2_L_RRD_Motor_Ripple_Error, Init_CAN2_L_RRD_Val_Wdw_Opened, Init_CAN2_RAPWL_01_LIN_Response_Error, Init_CAN2_Rr_EDUDrtSta_Nidec, Init_CAN2_Rr_EDURealTMTq_Nidec, Init_CAN2_Rr_MCUTempWarn_Nidec, Init_CAN2_Rr_MCUTemp_Nidec, Init_CAN2_Rr_MotorAvailTq_Nidec, Init_CAN2_Rr_TMSpd_Nidec, Init_CAN2_Rr_TMTempWarn_Nidec, Init_CAN2_Rr_TMTemp_Nidec]
    Init_CAN2_SG_IVI1: value-spec=fields=[Init_CAN2_A2B_Node_sta, Init_CAN2_AmbLigh_LowBatAlert_SW, Init_CAN2_AmbLigh_SafetyAlert_SW, Init_CAN2_AmbLightBrightnessSet, Init_CAN2_AmbLightColorSet, Init_CAN2_AmbLight_DimInDark_SW, Init_CAN2_AmbLight_SW, Init_CAN2_AmbLight_WlcmLight_SW, Init_CAN2_BrkAbn_GoReady_SW, Init_CAN2_FCP_FrEvt_BtnACMaxReq, Init_CAN2_FCP_FrEvt_BtnACReq, Init_CAN2_FCP_FrEvt_BtnAutoReq, Init_CAN2_FCP_FrEvt_BtnSyncReq, Init_CAN2_FCP_MidEvt_BtnAutoReq, Init_CAN2_IVI_AirRefresh_ByDMS_Sta, Init_CAN2_IVI_AutoTheme_But_Sta, Init_CAN2_IVI_CLWin_LockDoorSW_Sta, Init_CAN2_IVI_CreateAccReq_Sta, Init_CAN2_IVI_DMS_SW_Sta, Init_CAN2_IVI_DSEAT_anti_set_Sta, Init_CAN2_IVI_DelAccReq_Sta, Init_CAN2_IVI_FrTrunk_UnlockReq_Sta, Init_CAN2_IVI_HMI_Undefined_Sta, Init_CAN2_IVI_LinkAccReq_Sta, Init_CAN2_IVI_LinkAcc_Sta, Init_CAN2_IVI_LinkKey_Sta, Init_CAN2_IVI_Located_STA, Init_CAN2_IVI_Lock_SoundSW_Sta, Init_CAN2_IVI_NAVI_Foreground_Sta, Init_CAN2_IVI_OTA_Upd_Sta, Init_CAN2_IVI_QuickRefresh_Sta, Init_CAN2_IVI_SWC_VibMode_Sta, Init_CAN2_IVI_Time_Check, Init_CAN2_IVI_Time_Day, Init_CAN2_IVI_Time_Hour, Init_CAN2_IVI_Time_Minute, Init_CAN2_IVI_Time_Month, Init_CAN2_IVI_Time_Second, Init_CAN2_IVI_Time_Year, Init_CAN2_IVI_sigScreenReq_Sta, Init_CAN2_LINKtoDrive, Init_CAN2_OTA_CancelDL_Req, Init_CAN2_OTA_CompNTFY_Pres, Init_CAN2_OTA_DL_Req, Init_CAN2_OTA_SuspendDL_Req, Init_CAN2_OTA_UpdStart_Req, Init_CAN2_OpenDrOpenWdo_SW, Init_CAN2_PW_CLOSE_IMD, Init_CAN2_PW_CONTINUE_USE, Init_CAN2_Re_Radio_Sta, Init_CAN2_Sched_Chg_Day_Set, Init_CAN2_Sched_Chg_End_Time_HR, Init_CAN2_Sched_Chg_End_Time_Min, Init_CAN2_Sched_Chg_St_Time_HR, Init_CAN2_Sched_Chg_St_Time_Min, Init_CAN2_Sched_OTA_wake, Init_CAN2_SmartEco_Mode_SW, Init_CAN2_Upd_Countdown_Cancel, Init_CAN2_Upd_Countdown_Skip, Init_CAN2_UserSet, Init_CAN2_VehACModReq, Init_CAN2_mFRD_link_Sta]
    Init_CAN2_SG_IVI2: value-spec=fields=[Init_CAN2_AC_Chg_Cur_Set, Init_CAN2_AEB_BUTT, Init_CAN2_AVM_Err_STA, Init_CAN2_AVM_OFF_Rec_Butt, Init_CAN2_AVM_Parking_mode, Init_CAN2_AVM_parking_cancel, Init_CAN2_AVM_parking_excute, Init_CAN2_Approach_Unlock_SW, Init_CAN2_BSDMute_BUTT, Init_CAN2_CAAS_Sw, Init_CAN2_CDL_Lock_Butt, Init_CAN2_CDL_Unlock_Butt, Init_CAN2_CameraWrn, Init_CAN2_DMS_Status, Init_CAN2_DMS_Warning_Distraction, Init_CAN2_DMS_Warning_Fatigue, Init_CAN2_DMS_Warning_Unresponsive, Init_CAN2_DSEAT_anti_set, Init_CAN2_DSEAT_entryfun_set, Init_CAN2_DSEAT_vent_req, Init_CAN2_Distance_unit, Init_CAN2_ESC_SW_Cmd, Init_CAN2_FCWMute_BUTT, Init_CAN2_FFogLampSW, Init_CAN2_FS_Off_Sw, Init_CAN2_FalseNPrevent_SW, Init_CAN2_FollowMeSW, Init_CAN2_GPS_LAT, Init_CAN2_GPS_LONG, Init_CAN2_HeadLampSW, Init_CAN2_Hood_Latch_SW, Init_CAN2_IVI_ACC_Adaptive_Sta, Init_CAN2_IVI_ActvDmpDisabSW, Init_CAN2_IVI_AirIntZ3_Cmd, Init_CAN2_IVI_CfmTo_Rdy, Init_CAN2_IVI_ChargePortSW_Sta, Init_CAN2_IVI_CoastDwSW, Init_CAN2_IVI_CreepSW_Req, Init_CAN2_IVI_DSEATHeater_Cmd, Init_CAN2_IVI_DSEAT_FroEdge_Height_Cmd, Init_CAN2_IVI_DSEAT_Height_Cmd, Init_CAN2_IVI_DSEAT_Memory1_Sta, Init_CAN2_IVI_DSEAT_Memory2_Sta, Init_CAN2_IVI_DSEAT_Memory_OPTCLS_Sta, Init_CAN2_IVI_DSEAT_Recline_Cmd, Init_CAN2_IVI_DSEAT_Slide_Cmd, Init_CAN2_IVI_ISA_OffsetSpd, Init_CAN2_IVI_LVChrgFuncSW, Init_CAN2_IVI_Mute_Sta, Init_CAN2_IVI_Night_Mode_Sta, Init_CAN2_IVI_PSEATHeater_Cmd, Init_CAN2_IVI_PSEAT_Recline_Cmd, Init_CAN2_IVI_PSEAT_Slide_Cmd, Init_CAN2_IVI_PTG_Mode_SW, Init_CAN2_IVI_PTG_Open_Height, Init_CAN2_IVI_PTG_Sta_SW, Init_CAN2_IVI_PTG_USSta_SW, Init_CAN2_IVI_PW_Mode_Req, Init_CAN2_IVI_Panel_Act, Init_CAN2_IVI_Panel_X_Coor, Init_CAN2_IVI_Panel_Y_Coor, Init_CAN2_IVI_PwrLockSW, Init_CAN2_IVI_Pwroff_req, Init_CAN2_IVI_RR_Def_Req, Init_CAN2_IVI_Req_V2L, Init_CAN2_IVI_SLIF_Warning_Sta, Init_CAN2_IVI_SWC_ACCMode_Sta, Init_CAN2_IVI_SWC_LUndefined_Sta, Init_CAN2_IVI_SWC_RUndefined_Sta, Init_CAN2_IVI_Screen, Init_CAN2_IVI_SetTempZon1_Sta, Init_CAN2_IVI_SetTempZon2_Sta, Init_CAN2_IVI_Start_Chg_req, Init_CAN2_IVI_Status, Init_CAN2_IVI_Stop_Chg_req, Init_CAN2_IVI_TrailerCheckReq_Sta, Init_CAN2_IVI_TrailerModeSW_Sta, Init_CAN2_IVI_Trigger_req, Init_CAN2_IVI_Unlock_Chg_req, Init_CAN2_IVI_WI_MAIN_SW, Init_CAN2_LDWMute_BUTT, Init_CAN2_LKA_BUTT, Init_CAN2_LVDAMute_BUTT, Init_CAN2_L_Drv_ControlCommand, Init_CAN2_L_Pas_ControlCommand, Init_CAN2_L_RLD_ControlCommand, Init_CAN2_L_RRD_ControlCommand, Init_CAN2_Light_ShowStart_Req, Init_CAN2_Light_ShowStop_Req, Init_CAN2_METER_Malfunc_Sta, Init_CAN2_MFRD_N_Bright_Req, Init_CAN2_NAVI_Cam_Dist_info, Init_CAN2_NAVI_Direction_STA, Init_CAN2_NAVI_Distance_info, Init_CAN2_NAVI_ForwardLinkLevel, Init_CAN2_NAVI_LinkClass, Init_CAN2_NAVI_RoadClass, Init_CAN2_NAVI_SpeedLimit, Init_CAN2_NAVI_Speed_Limit_A, Init_CAN2_NAVI_State, Init_CAN2_NAVI_Tollgate, Init_CAN2_NAVI_Tunnel, Init_CAN2_ODAMute_BUTT, Init_CAN2_OFF_AC_MODE, Init_CAN2_PSEAT_vent_req, Init_CAN2_Perd_V2L, Init_CAN2_Pressure_unit, Init_CAN2_RCTA_BUTT, Init_CAN2_RFogLampSW, Init_CAN2_Roll_Eng_Mode, Init_CAN2_Roll_Mode_SW_Cmd, Init_CAN2_RoomLampMode, Init_CAN2_SLG_Sw, Init_CAN2_SLIF_BUTT, Init_CAN2_SOC_ADJ_BUTT, Init_CAN2_SOC_Limit_Set, Init_CAN2_SOC_V2LLimit, Init_CAN2_Sched_Chg_Start, Init_CAN2_Sched_Chg_Stop, Init_CAN2_Sched_Chg_butt, Init_CAN2_Sched_Chg_limit, Init_CAN2_Sched_Chg_wake, Init_CAN2_SenstivityPosition, Init_CAN2_SetUnlockSingle, Init_CAN2_TCS_SW_Cmd, Init_CAN2_TPMS_Cali_Butt, Init_CAN2_TPMS_Res_Butt, Init_CAN2_Temperature_unit, Init_CAN2_Time_system, Init_CAN2_TurnSwTimeSet, Init_CAN2_User_p_download, Init_CAN2_User_p_upload, Init_CAN2_Walkaway_Lock_SW, Init_CAN2_Wifi_Reset, Init_CAN2_Wifi_Sta_IVI_TBOX, Init_CAN2_WlcmLight_Mode, Init_CAN2_sigAirIntenZon1Req, Init_CAN2_sigAirIntenZon3Req, Init_CAN2_sigDfrstReq, Init_CAN2_sigFaceReq, Init_CAN2_sigFootReq, Init_CAN2_sigHvacFrontReq, Init_CAN2_sigHvacRearReq, Init_CAN2_sigHvacReq, Init_CAN2_sigRecircReq, Init_CAN2_sigSetTempZon1Req, Init_CAN2_sigSetTempZon2Req, Init_CAN2_sigSetTempZon3Req, Init_CAN2_sigWindDirZon3Req]
    Init_CAN2_SG_IVI3: value-spec=fields=[Init_CAN2_IVI_CLBlower_Y_Sta, Init_CAN2_IVI_CLBlower_Z_Sta, Init_CAN2_IVI_CRBlower_Y_Sta, Init_CAN2_IVI_CRBlower_Z_Sta, Init_CAN2_IVI_DrBlower_Mode_Sta, Init_CAN2_IVI_DrBlower_Y_Sta, Init_CAN2_IVI_DrBlower_Z_Sta, Init_CAN2_IVI_LSEATvent_Cmd, Init_CAN2_IVI_MLFMost_Cmd, Init_CAN2_IVI_MLFootLift_Cmd, Init_CAN2_IVI_MLNapMode_Cmd, Init_CAN2_IVI_MLRecliner_Cmd, Init_CAN2_IVI_MLRestore_Cmd, Init_CAN2_IVI_MLSEATvent_Cmd, Init_CAN2_IVI_MLSeatLift_Cmd, Init_CAN2_IVI_MLSldRestore_Cmd, Init_CAN2_IVI_MLSlider_Cmd, Init_CAN2_IVI_MLZeroGravity_Cmd, Init_CAN2_IVI_MRFMost_Cmd, Init_CAN2_IVI_MRFootLift_Cmd, Init_CAN2_IVI_MRNapMode_Cmd, Init_CAN2_IVI_MRRecliner_Cmd, Init_CAN2_IVI_MRRestore_Cmd, Init_CAN2_IVI_MRSEATvent_Cmd, Init_CAN2_IVI_MRSeatLift_Cmd, Init_CAN2_IVI_MRSldRestore_Cmd, Init_CAN2_IVI_MRSlider_Cmd, Init_CAN2_IVI_MRZeroGravity_Cmd, Init_CAN2_IVI_PsBlower_Mode_Sta, Init_CAN2_IVI_PsBlower_Y_Sta, Init_CAN2_IVI_PsBlower_Z_Sta, Init_CAN2_IVI_RSEATvent_Cmd]
    Init_CAN2_SG_IVI_P20_0: value-spec=fields=[Init_CAN2_IVI_AmbiLgtSta, Init_CAN2_IVI_FrAtmoLamp_Cmd, Init_CAN2_IVI_FrRmLampBright_Cmd, Init_CAN2_IVI_Frontindoorlight_Sta, Init_CAN2_IVI_Passengerdoor_Sta, Init_CAN2_IVI_RrAtmoLamp_Cmd, Init_CAN2_IVI_RrRmLampBright_Cmd, Init_CAN2_IVI_RrRoomlamp_Cmd]
    Init_CAN2_SG_METER1: value-spec=fields=[Init_CAN2_APCforDTE, Init_CAN2_AVGPwrConsumption, Init_CAN2_AvailableTrip, Init_CAN2_Averaged_vehspeed, Init_CAN2_Charge, Init_CAN2_LEDlitWarnReq, Init_CAN2_METER_KPH_Calcu, Init_CAN2_METER_KPH_Real, Init_CAN2_METER_MPH_Calcu, Init_CAN2_METER_MPH_Real, Init_CAN2_ODOMETER, Init_CAN2_ParkBrake, Init_CAN2_Spd_Crl_Mode, Init_CAN2_Spd_Crl_Sta, Init_CAN2_Trip_A, Init_CAN2_Trip_B]
package /CAN2/ImplementationDataTypes
  18 x impl type, all with category=STRUCTURE:
    DT_CAN2_SG_FD2_C200_1
      element CAN2_FDC_CHA_CACPresWarn_Sta: implementation-data-type=uint8
      element CAN2_FDC_CHA_CACTempWarn_Sta: implementation-data-type=uint8
    DT_CAN2_SG_FD2_C20_0
      45 x element, all with category=TYPE_REFERENCE, implementation-data-type=uint8:
        CAN2_APS_ExitCondition
        CAN2_APS_RQ_Display
        CAN2_APS_SW_Ver
        CAN2_APS_Sta_System
        CAN2_CAAS_Sta
        CAN2_FDC_VCU_RegenLimInd_Sta
        CAN2_FDC_VCU_RegenMode_Sta
        CAN2_FDC_VCU_SmartEcoSpdLim_Sta
        CAN2_FDC_VCU_SmartEco_Sta
        CAN2_FDC_VMC_SetSpdDisp_Sta
        CAN2_FDC_VMC_SetSpd_Sta
        CAN2_FDC_VMC_SpdCtrlMode_Sta
        CAN2_FDC_VMC_SpdCtrl_Sta
        CAN2_PAS_A_FCL
        CAN2_PAS_A_FCR
        CAN2_PAS_A_FML
        CAN2_PAS_A_FMR
        CAN2_PAS_A_RCL
        CAN2_PAS_A_RCR
        CAN2_PAS_A_RML
        CAN2_PAS_A_RMR
        CAN2_PAS_Chime
        CAN2_PAS_D_FCL
        CAN2_PAS_D_FCR
        CAN2_PAS_D_FML
        CAN2_PAS_D_FMR
        CAN2_PAS_D_RCL
        CAN2_PAS_D_RCR
        CAN2_PAS_D_RML
        CAN2_PAS_D_RMR
        CAN2_PAS_SNSR_Layout
        CAN2_USS_Sta_FCL
        CAN2_USS_Sta_FCR
        CAN2_USS_Sta_FLL
        CAN2_USS_Sta_FLR
        CAN2_USS_Sta_FML
        CAN2_USS_Sta_FMR
        CAN2_USS_Sta_RCL
        CAN2_USS_Sta_RCR
        CAN2_USS_Sta_RLL
        CAN2_USS_Sta_RLR
        CAN2_USS_Sta_RML
        CAN2_USS_Sta_RMR
        CAN2_VMC_VCU_CC_Crl_Sta
        CAN2_VMC_VCU_MSA_Crl_Sta
    DT_CAN2_SG_FD2_CE100_0
      129 x element, all with category=TYPE_REFERENCE:
        CAN2_APMDoorControlSta: implementation-data-type=uint8
        CAN2_ActAPSPosn: implementation-data-type=uint8
        CAN2_AllDoorSW: implementation-data-type=uint8
        CAN2_AntitheftSta: implementation-data-type=uint8
        CAN2_BCM_DoorLock_Sta: implementation-data-type=uint8
        CAN2_BrakeLamp: implementation-data-type=uint8
        CAN2_CCMSA_SpdWar: implementation-data-type=uint8
        CAN2_CCU_ACLampSts: implementation-data-type=uint8
        CAN2_CCU_ACMaxLampSts: implementation-data-type=uint8
        CAN2_CCU_AutoLampSts: implementation-data-type=uint8
        CAN2_CCU_AutoMidLampSts: implementation-data-type=uint8
        CAN2_CCU_Dispaly_Request: implementation-data-type=uint8
        CAN2_CCU_EcoSts: implementation-data-type=uint8
        CAN2_CCU_FrtOnOffLampSts: implementation-data-type=uint8
        CAN2_CCU_RrOnOffLampSts: implementation-data-type=uint8
        CAN2_CCU_SyncLampSts: implementation-data-type=uint8
        CAN2_CC_Crl_Sta: implementation-data-type=uint8
        CAN2_CoastDwModeStaChk: implementation-data-type=uint8
        CAN2_CreepSW_Sta: implementation-data-type=uint8
        CAN2_DISC_ButtSta: implementation-data-type=uint8
        CAN2_DISC_Sta: implementation-data-type=uint8
        CAN2_DemoModeStaChk: implementation-data-type=uint8
        CAN2_Dimmer: implementation-data-type=uint8
        CAN2_DimmerEN: implementation-data-type=uint8
        CAN2_DisengageP_Fail: implementation-data-type=uint8
        CAN2_DoorLockIND: implementation-data-type=uint8
        CAN2_DrDoorSW: implementation-data-type=uint8
        CAN2_Dr_SeatSta: implementation-data-type=uint8
        CAN2_DynoModeStaChk: implementation-data-type=uint8
        CAN2_EDriveSysErr_AccPedalErr: implementation-data-type=uint8
        CAN2_EDriveSysErr_MCUErr: implementation-data-type=uint8
        CAN2_EDriveSysErr_ShifterErr: implementation-data-type=uint8
        CAN2_EDriveSysErr_VCUErr: implementation-data-type=uint8
        CAN2_EVDriveMode: implementation-data-type=uint8
        CAN2_Eng_ActvDmpDisabSta: implementation-data-type=uint8
        CAN2_Eng_CoastDwSta: implementation-data-type=uint8
        CAN2_Eng_PwrLockSta: implementation-data-type=uint8
        CAN2_EngageP_Fail: implementation-data-type=uint8
        CAN2_FDC_THCM_CLEVentY_Sta: implementation-data-type=uint8
        CAN2_FDC_THCM_CLEVentZ_Sta: implementation-data-type=uint8
        CAN2_FDC_THCM_CLVent_Sta: implementation-data-type=uint8
        CAN2_FDC_THCM_CREVentY_Sta: implementation-data-type=uint8
        CAN2_FDC_THCM_CREVentZ_Sta: implementation-data-type=uint8
        CAN2_FDC_THCM_CRVent_Sta: implementation-data-type=uint8
        CAN2_FDC_THCM_DrEVentMode_Sta: implementation-data-type=uint8
        CAN2_FDC_THCM_DrEVentY_Sta: implementation-data-type=uint8
        CAN2_FDC_THCM_DrEVentZ_Sta: implementation-data-type=uint8
        CAN2_FDC_THCM_DrVent_Sta: implementation-data-type=uint8
        CAN2_FDC_THCM_PsEVentMode_Sta: implementation-data-type=uint8
        CAN2_FDC_THCM_PsEVentY_Sta: implementation-data-type=uint8
        CAN2_FDC_THCM_PsEVentZ_Sta: implementation-data-type=uint8
        CAN2_FDC_THCM_PsVent_Sta: implementation-data-type=uint8
        CAN2_FDC_VCU_PwrSaveReq_Cmd: implementation-data-type=uint8
        CAN2_FD_ABS_Warning: implementation-data-type=uint8
        CAN2_FD_Battery_Charge_Warning: implementation-data-type=uint8
        CAN2_FD_EDrive_System: implementation-data-type=uint8
        CAN2_FD_EPB_Error: implementation-data-type=uint8
        CAN2_FD_HV_Battery_Fault: implementation-data-type=uint8
        CAN2_FD_Park_Brake_Warning: implementation-data-type=uint8
        CAN2_FD_Power_limitation: implementation-data-type=uint8
        CAN2_FD_Steering_Warning: implementation-data-type=uint8
        CAN2_FD_TCS_Indicator: implementation-data-type=uint8
        CAN2_FD_Telltale_Fail: implementation-data-type=uint8
        CAN2_FalseNPrevent_Sta: implementation-data-type=uint8
        CAN2_FeatSetSpdFinal_raw32: implementation-data-type=uint8
        CAN2_FollowMe: implementation-data-type=uint8
        CAN2_Fr_FogLamp: implementation-data-type=uint8
        CAN2_HVRlyOpFail: implementation-data-type=uint8
        CAN2_HVSysErr_IsolationErr: implementation-data-type=uint8
        CAN2_HVSysErr_PackErr: implementation-data-type=uint8
        CAN2_HVSysErr_RelayErr: implementation-data-type=uint8
        CAN2_H_Beam: implementation-data-type=uint8
        CAN2_HazardSW: implementation-data-type=uint8
        CAN2_HoodSW: implementation-data-type=uint8
        CAN2_LBSD: implementation-data-type=uint8
        CAN2_LDRL: implementation-data-type=uint8
        CAN2_LTurnLP: implementation-data-type=uint8
        CAN2_LVChrgFuncStaChk: implementation-data-type=uint8
        CAN2_LVSysErr_PwrOutpErr: implementation-data-type=uint8
        CAN2_L_Beam: implementation-data-type=uint8
        CAN2_LimphomeAct: implementation-data-type=uint8
        CAN2_LockSetting: implementation-data-type=uint8
        CAN2_MCUActDisFail: implementation-data-type=uint8
        CAN2_MSA_Crl_Sta: implementation-data-type=uint8
        CAN2_MeterIndSpeed_raw32: implementation-data-type=uint8
        CAN2_PAS_Sta_F_Sys: implementation-data-type=uint8
        CAN2_PosLamp: implementation-data-type=uint8
        CAN2_PsDoorSW: implementation-data-type=uint8
        CAN2_PwrSta: implementation-data-type=uint8
        CAN2_PwrStaErr: implementation-data-type=uint8
        CAN2_PwrStaONTOIVIPopReq: implementation-data-type=uint8
        CAN2_PwrStaONTOIVIPopT: implementation-data-type=uint16
        CAN2_RBSD: implementation-data-type=uint8
        CAN2_RDRL: implementation-data-type=uint8
        CAN2_RLDoorSW: implementation-data-type=uint8
        CAN2_RRDoorSW: implementation-data-type=uint8
        CAN2_RTurnLP: implementation-data-type=uint8
        CAN2_Req_Internal_V2L_Status_Lamp: implementation-data-type=uint8
        CAN2_Req_V2LSwOn: implementation-data-type=uint8
        CAN2_Req_V2L_IVI_Popup: implementation-data-type=uint8
        CAN2_ReverseLamp: implementation-data-type=uint8
        CAN2_Rr_Defog: implementation-data-type=uint8
        CAN2_Rr_FogLamp: implementation-data-type=uint8
        CAN2_ShiftGearPosn: implementation-data-type=uint8
        CAN2_SysAllowReadySta: implementation-data-type=uint8
        CAN2_SysPwrSta: implementation-data-type=uint8
        CAN2_Tailgate_SW: implementation-data-type=uint8
        CAN2_VCUBrkSWSta: implementation-data-type=uint8
        CAN2_VCUFLDoorSta: implementation-data-type=uint8
        CAN2_VCUFRDoorSta: implementation-data-type=uint8
        CAN2_VCUHoodSWSta: implementation-data-type=uint8
        CAN2_VCURLDoorSta: implementation-data-type=uint8
        CAN2_VCURRDoorSta: implementation-data-type=uint8
        CAN2_VCUTailgateSWSta: implementation-data-type=uint8
        CAN2_VCU_OPDHold: implementation-data-type=uint8
        CAN2_VehMalfunLevel: implementation-data-type=uint8
        CAN2_XWDMode: implementation-data-type=uint8
        CAN2_sigAirIntenZon1St: implementation-data-type=uint8
        CAN2_sigAirIntenZon3St: implementation-data-type=uint8
        CAN2_sigAmbAirT: implementation-data-type=uint8
        CAN2_sigCbnAirT: implementation-data-type=uint8
        CAN2_sigDfrstSt: implementation-data-type=uint8
        CAN2_sigHvacSt: implementation-data-type=uint8
        CAN2_sigRecircSt: implementation-data-type=uint8
        CAN2_sigSetTempZon{1..3}St: implementation-data-type=uint8
        CAN2_sigWindDirZon1St: implementation-data-type=uint8
        CAN2_sigWindDirZon3St: implementation-data-type=uint8
    DT_CAN2_SG_FD2_CE100_1
      5 x element, all with category=TYPE_REFERENCE, implementation-data-type=uint8:
        CAN2_FDC_BCM_TgateSWL_Sta
        CAN2_FDC_BCM_TgateSWR_Sta
        CAN2_FDC_BCM_WelcomeDemo_Sta
        CAN2_FDC_VCU_DACStatus_Sta
        CAN2_FDC_VCU_TUpASta_Sta
    DT_CAN2_SG_FD2_CE200_1
      82 x element, all with category=TYPE_REFERENCE, implementation-data-type=uint8:
        CAN2_AutoLTips
        CAN2_CWheelTips
        CAN2_FDC_BCM_Acc{1..5}Sta_Sta
        CAN2_FDC_BCM_AmbBrightSta_Sta
        CAN2_FDC_BCM_AmbColorSta_Sta
        CAN2_FDC_BCM_AmbDimEN_Sta
        CAN2_FDC_BCM_AmbFunEN_Sta
        CAN2_FDC_BCM_AmbLinkDriSta_Sta
        CAN2_FDC_BCM_AmbODAEN_Sta
        CAN2_FDC_BCM_AmbPwrWarnEN_Sta
        CAN2_FDC_BCM_AmbWelEN_Sta
        CAN2_FDC_BCM_CLWinLockDr_Sta
        CAN2_FDC_BCM_FollowMeENFun_Sta
        CAN2_FDC_BCM_Key10Acc_Sta
        CAN2_FDC_BCM_Key{1..9}Acc_Sta
        CAN2_FDC_BCM_LockAlarm_Cmd
        CAN2_FDC_BCM_PTGOpenHeight_Sta
        CAN2_FDC_BCM_RmLpModeENFun_Sta
        CAN2_FDC_BCM_TurnSwTSetSta_Sta
        CAN2_FDC_BCM_UserNow_Sta
        CAN2_FDC_BCM_WalkInUnLkEnFun_Sta
        CAN2_FDC_BCM_WalkOutLkEnFun_Sta
        CAN2_FDC_DKC_DkeyShowIVI_Sta
        CAN2_FDC_DKC_KeyMiss_Sta
        CAN2_FDC_DKC_KeyNum_Sta
        CAN2_FDC_DKC_KeyType_Sta
        CAN2_FDC_DKC_UIDLowPower_Sta
        CAN2_FDC_SPTG_SPTGENFun_Sta
        CAN2_FDC_THCM_APTCForceOFF_Sta
        CAN2_FDC_THCM_APTCWarning_Sta
        CAN2_FDC_THCM_AirIntZ3_Sta
        CAN2_LFWheelShield
        CAN2_LRBatWarn
        CAN2_LRPressIndi
        CAN2_LRSensorFail
        CAN2_LRWheelDebug
        CAN2_LRWheelPSW
        CAN2_LRWheelPress
        CAN2_LRWheelShield
        CAN2_LRWheelTemp
        CAN2_LRWheelTmpIndi
        CAN2_RFWheelShield
        CAN2_RRBatWarn
        CAN2_RRPressIndi
        CAN2_RRSensorFail
        CAN2_RRWheelDebug
        CAN2_RRWheelPSW
        CAN2_RRWheelPress
        CAN2_RRWheelShield
        CAN2_RRWheelTemp
        CAN2_RRWheelTmpIndi
        CAN2_T1_TPMS_LFBatWarn
        CAN2_T1_TPMS_LFPressIndi
        CAN2_T1_TPMS_LFSensorFail
        CAN2_T1_TPMS_LFWheelDebug
        CAN2_T1_TPMS_LFWheelPSW
        CAN2_T1_TPMS_LFWheelPress
        CAN2_T1_TPMS_LFWheelTemp
        CAN2_T1_TPMS_LFWheelTmpIndi
        CAN2_T1_TPMS_RFBatWarn
        CAN2_T1_TPMS_RFPressIndi
        CAN2_T1_TPMS_RFSensorFail
        CAN2_T1_TPMS_RFWheelDebug
        CAN2_T1_TPMS_RFWheelPSW
        CAN2_T1_TPMS_RFWheelPress
        CAN2_T1_TPMS_RFWheelTemp
        CAN2_T1_TPMS_RFWheelTmpIndi
        CAN2_T1_TPMS_TPMSWarnIndi
        CAN2_TPMS_Cali_Butt_Allow
        CAN2_TPMS_Res_Butt_Allow
    DT_CAN2_SG_FD2_OTA1
      15 x element, all with category=TYPE_REFERENCE:
        CAN2_OTA_DL_Available: implementation-data-type=uint8
        CAN2_OTA_DL_Speed: implementation-data-type=uint32
        CAN2_OTA_Debug_Code: implementation-data-type=uint8
        CAN2_OTA_Emergency_Sta: implementation-data-type=uint8
        CAN2_OTA_InVehicle_FW: implementation-data-type=uint8
        CAN2_OTA_Lock_Req: implementation-data-type=uint8
        CAN2_OTA_MDA_Status: implementation-data-type=uint8
        CAN2_OTA_Mode: implementation-data-type=uint8
        CAN2_OTA_Network_Type: implementation-data-type=uint8
        CAN2_OTA_Permit_Agreed: implementation-data-type=uint8
        CAN2_OTA_Progress_Rate: implementation-data-type=uint8
        CAN2_OTA_Remained_Time: implementation-data-type=uint16
        CAN2_OTA_TBOXResetReq: implementation-data-type=uint8
        CAN2_OTA_Update_Available: implementation-data-type=uint8
        CAN2_OTA_Updating_ECU_8bit: implementation-data-type=uint8
    DT_CAN2_SG_FD2_Version
      35 x element, all with category=TYPE_REFERENCE, implementation-data-type=uint8:
        CAN2_FUSION_HW_Ver{1..3}
        CAN2_FUSION_SW_CarModel{1..3}
        CAN2_FUSION_SW_Controller1
        CAN2_FUSION_SW_Controller2
        CAN2_FUSION_SW_Country1
        CAN2_FUSION_SW_Country2
        CAN2_FUSION_SW_ECUGen1
        CAN2_FUSION_SW_ECUGen2
        CAN2_FUSION_SW_Major1
        CAN2_FUSION_SW_Major2
        CAN2_FUSION_SW_Minor1
        CAN2_FUSION_SW_Minor2
        CAN2_FUSION_SW_Patch1
        CAN2_FUSION_SW_Patch2
        CAN2_FUSION_SW_SHA{1..8}
        CAN2_FUSION_SW_Var{1..5}
        CAN2_FUSION_SW_change1
        CAN2_FUSION_SW_change2
        CAN2_FUSION_SW_dash1
        CAN2_FUSION_SW_dash2
    DT_CAN2_SG_GW2_C10_0
      11 x element, all with category=TYPE_REFERENCE:
        CAN2_ABS_Active: implementation-data-type=uint8
        CAN2_ABS_Failed: implementation-data-type=uint8
        CAN2_ABS_WnlmpSta: implementation-data-type=uint8
        CAN2_AVH_Failed: implementation-data-type=uint8
        CAN2_Amber_WnlmpSta: implementation-data-type=uint8
        CAN2_BrkSw_Sta: implementation-data-type=uint8
        CAN2_HSA_Active: implementation-data-type=uint8
        CAN2_HSA_Failed: implementation-data-type=uint8
        CAN2_Meter_Ind_VehSpeed: implementation-data-type=uint16
        CAN2_Red_WnlmpSta: implementation-data-type=uint8
        CAN2_VehSpeed: implementation-data-type=uint16
    DT_CAN2_SG_CGW_GW2_C10_0
      26 x element, all with category=TYPE_REFERENCE:
        CAN2_DCDCAuxCur: implementation-data-type=uint16
        CAN2_DCDCAuxVolt: implementation-data-type=uint8
        CAN2_DrPMMLVOutPErrLmp: implementation-data-type=uint8
        CAN2_DrPMMSysErrLmp: implementation-data-type=uint8
        CAN2_DrSCPSysErrLmp: implementation-data-type=uint8
        CAN2_FLTurn_Light_Warning: implementation-data-type=uint8
        CAN2_FRTurn_Light_Warning: implementation-data-type=uint8
        CAN2_FireDetErr: implementation-data-type=uint8
        CAN2_FrPMMLimpHomeActReq: implementation-data-type=uint8
        CAN2_HVBattCurr: implementation-data-type=uint16
        CAN2_HVBattErr: implementation-data-type=uint8
        CAN2_HVBattVolt: implementation-data-type=uint16
        CAN2_LADB_Hibeam_Indication: implementation-data-type=uint8
        CAN2_LADB_Operation_Status: implementation-data-type=uint8
        CAN2_LADB_Warning: implementation-data-type=uint8
        CAN2_LAHB_Warning: implementation-data-type=uint8
        CAN2_LDRL_Warning: implementation-data-type=uint8
        CAN2_LLB_Warning: implementation-data-type=uint8
        CAN2_Lposition_Lamp_Warning: implementation-data-type=uint8
        CAN2_RADB_Hibeam_Indication: implementation-data-type=uint8
        CAN2_RADB_Operation_Status: implementation-data-type=uint8
        CAN2_RADB_Warning: implementation-data-type=uint8
        CAN2_RAHB_Warning: implementation-data-type=uint8
        CAN2_RDRL_Warning: implementation-data-type=uint8
        CAN2_RLB_Warning: implementation-data-type=uint8
        CAN2_Rposition_Lamp_Warning: implementation-data-type=uint8
    DT_CAN2_SG_GW2_CE1000_0
      18 x element, all with category=TYPE_REFERENCE:
        CAN2_ACChrgCurrDis: implementation-data-type=uint16
        CAN2_Charge_Percent_Set: implementation-data-type=uint8
        CAN2_HVBChrgPwr: implementation-data-type=uint16
        CAN2_HVBattSOC: implementation-data-type=uint8
        CAN2_HVBattSOCDis: implementation-data-type=uint8
        CAN2_RemainChrgTime: implementation-data-type=uint16
        CAN2_Rr_MCU3_HW_Ver: implementation-data-type=uint16
        CAN2_Rr_MCU3_HW_Ver_Nidec: implementation-data-type=uint16
        CAN2_Rr_MCU3_SW_Ver: implementation-data-type=uint16
        CAN2_Rr_MCU3_SW_Ver_Nidec: implementation-data-type=uint16
        CAN2_TBOX_HW_VER: implementation-data-type=uint32
        CAN2_TBOX_SW_VER: implementation-data-type=uint32
        CAN2_TimeSyncFromBS_Day: implementation-data-type=uint8
        CAN2_TimeSyncFromBS_Hour: implementation-data-type=uint8
        CAN2_TimeSyncFromBS_Minute: implementation-data-type=uint8
        CAN2_TimeSyncFromBS_Month: implementation-data-type=uint8
        CAN2_TimeSyncFromBS_Second: implementation-data-type=uint8
        CAN2_TimeSyncFromBS_Year: implementation-data-type=uint8
    DT_CAN2_SG_GW2_CE100_0
      55 x element, all with category=TYPE_REFERENCE:
        CAN2_COMP_ActualPwr: implementation-data-type=uint16
        CAN2_CbnPreACEnaReq: implementation-data-type=uint8
        CAN2_ChargeInletLockSta: implementation-data-type=uint8
        CAN2_ChrgPlugSta: implementation-data-type=uint8
        CAN2_DKC_KeyNum_Sta: implementation-data-type=uint8
        CAN2_DKC_KeyType_Sta: implementation-data-type=uint8
        CAN2_DisChrgPlugErr: implementation-data-type=uint8
        CAN2_ExtChrgSta: implementation-data-type=uint8
        CAN2_FDC_BCM_DimSw: implementation-data-type=uint8
        CAN2_FDC_BCM_FWipSw_Sta: implementation-data-type=uint8
        CAN2_FDC_BCM_TurnSw_Sta: implementation-data-type=uint8
        CAN2_FrntPTCLeActHeatPwr: implementation-data-type=uint8
        CAN2_FrntPTCRearLeActHeatPwr: implementation-data-type=uint8
        CAN2_FrntPTCRearRiActHeatPwr: implementation-data-type=uint8
        CAN2_FrntPTCRiActHeatPwr: implementation-data-type=uint8
        CAN2_HVBChrgErr: implementation-data-type=uint8
        CAN2_HVBContactorSta: implementation-data-type=uint8
        CAN2_HVBMTempMax: implementation-data-type=uint8
        CAN2_HVBOvrTempErr: implementation-data-type=uint8
        CAN2_HVBOvrTempWarn: implementation-data-type=uint8
        CAN2_MainRlyNegSta: implementation-data-type=uint8
        CAN2_MainRlyPosSta: implementation-data-type=uint8
        CAN2_OBCACCSLimit: implementation-data-type=uint8
        CAN2_OBCACCurrInf: implementation-data-type=uint16
        CAN2_OBCACVoltInf: implementation-data-type=uint16
        CAN2_OBCFaultSta: implementation-data-type=uint8
        CAN2_OBC_AC_Cur_Lim: implementation-data-type=uint8
        CAN2_PTCActuPwrHSC6: implementation-data-type=uint16
        CAN2_P_Dkey_Show_IVI: implementation-data-type=uint8
        CAN2_P_KeyMiss: implementation-data-type=uint8
        CAN2_P_UID_LowPower: implementation-data-type=uint8
        CAN2_RLS_Lamp_Sta: implementation-data-type=uint8
        CAN2_Re_Radio: implementation-data-type=uint8
        CAN2_SWC_ACC_Sta: implementation-data-type=uint8
        CAN2_SWC_Down_Sta: implementation-data-type=uint8
        CAN2_SWC_LKA_Sta: implementation-data-type=uint8
        CAN2_SWC_Left_Sta: implementation-data-type=uint8
        CAN2_SWC_RegenDown: implementation-data-type=uint8
        CAN2_SWC_RegenUp: implementation-data-type=uint8
        CAN2_SWC_Right_Sta: implementation-data-type=uint8
        CAN2_SWC_Trip_Sta: implementation-data-type=uint8
        CAN2_SWC_Undefined_Sta: implementation-data-type=uint8
        CAN2_SWC_Up_Sta: implementation-data-type=uint8
        CAN2_SWC_VR_Sta: implementation-data-type=uint8
        CAN2_SWC_mode_Sta: implementation-data-type=uint8
        CAN2_Shifter_Fail_sta: implementation-data-type=uint8
        CAN2_Shifter_Handle_Cmd: implementation-data-type=uint8
        CAN2_TBOX_NET_SIG_STR: implementation-data-type=uint8
        CAN2_TBOX_TEST_STATUS: implementation-data-type=uint8
        CAN2_TrailerCheck: implementation-data-type=uint8
        CAN2_TrailerModeSta: implementation-data-type=uint8
        CAN2_V2LSta: implementation-data-type=uint8
        CAN2_ZFR_BCM_ChargerDoorSW_Sta: implementation-data-type=uint8
        CAN2_ZFR_EChrg_Active_Sta: implementation-data-type=uint8
        CAN2_ZFR_EChrg_Sys_Sta: implementation-data-type=uint8
    DT_CAN2_SG_GW2_CE100_1
      27 x element, all with category=TYPE_REFERENCE:
        CAN2_Fr_EDUDrtSta: implementation-data-type=uint8
        CAN2_Fr_EDURealTMTq: implementation-data-type=uint16
        CAN2_Fr_MCUTemp: implementation-data-type=uint16
        CAN2_Fr_MCUTempWarn: implementation-data-type=uint8
        CAN2_Fr_MotorAvailTq: implementation-data-type=uint16
        CAN2_Fr_TMSpd: implementation-data-type=uint16
        CAN2_Fr_TMTemp: implementation-data-type=uint16
        CAN2_Fr_TMTempWarn: implementation-data-type=uint8
        CAN2_MCU_B_R_LLCTempWarn_Sta: implementation-data-type=uint8
        CAN2_Rr_EDUDrtSta: implementation-data-type=uint8
        CAN2_Rr_EDURealTMTq: implementation-data-type=uint16
        CAN2_Rr_MCUTemp: implementation-data-type=uint16
        CAN2_Rr_MCUTempWarn: implementation-data-type=uint8
        CAN2_Rr_MotorAvailTq: implementation-data-type=uint16
        CAN2_Rr_TMSpd: implementation-data-type=uint16
        CAN2_Rr_TMTemp: implementation-data-type=uint16
        CAN2_Rr_TMTempWarn: implementation-data-type=uint8
        CAN2_SWC2_L_DriveMode_Sta: implementation-data-type=uint8
        CAN2_SWC2_L_Home_Sta: implementation-data-type=uint8
        CAN2_SWC2_R_Customize_Sta: implementation-data-type=uint8
        CAN2_SWC2_R_Left_Sta: implementation-data-type=uint8
        CAN2_SWC2_R_PageSwitch_Sta: implementation-data-type=uint8
        CAN2_SWC2_R_Right_Sta: implementation-data-type=uint8
        CAN2_SWC2_R_ScrollDown_Sta: implementation-data-type=uint8
        CAN2_SWC2_R_ScrollPress_Sta: implementation-data-type=uint8
        CAN2_SWC2_R_ScrollUp_Sta: implementation-data-type=uint8
        CAN2_SWC2_R_VR_Sta: implementation-data-type=uint8
    DT_CAN2_SG_GW2_CE100_2
      22 x element, all with category=TYPE_REFERENCE:
        CAN2_FAPWL_01_LIN_Response_Error: implementation-data-type=uint8
        CAN2_L_Drv_Motor_Relay_Error: implementation-data-type=uint8
        CAN2_L_Drv_Motor_Ripple_Error: implementation-data-type=uint8
        CAN2_L_Drv_Val_Wdw_Opened: implementation-data-type=uint8
        CAN2_L_Pas_Motor_Relay_Error: implementation-data-type=uint8
        CAN2_L_Pas_Motor_Ripple_Error: implementation-data-type=uint8
        CAN2_L_Pas_Val_Wdw_Opened: implementation-data-type=uint8
        CAN2_L_RLD_Motor_Relay_Error: implementation-data-type=uint8
        CAN2_L_RLD_Motor_Ripple_Error: implementation-data-type=uint8
        CAN2_L_RLD_Val_Wdw_Opened: implementation-data-type=uint8
        CAN2_L_RRD_Motor_Relay_Error: implementation-data-type=uint8
        CAN2_L_RRD_Motor_Ripple_Error: implementation-data-type=uint8
        CAN2_L_RRD_Val_Wdw_Opened: implementation-data-type=uint8
        CAN2_RAPWL_01_LIN_Response_Error: implementation-data-type=uint8
        CAN2_Rr_EDUDrtSta_Nidec: implementation-data-type=uint8
        CAN2_Rr_EDURealTMTq_Nidec: implementation-data-type=uint16
        CAN2_Rr_MCUTempWarn_Nidec: implementation-data-type=uint8
        CAN2_Rr_MCUTemp_Nidec: implementation-data-type=uint16
        CAN2_Rr_MotorAvailTq_Nidec: implementation-data-type=uint16
        CAN2_Rr_TMSpd_Nidec: implementation-data-type=uint16
        CAN2_Rr_TMTempWarn_Nidec: implementation-data-type=uint8
        CAN2_Rr_TMTemp_Nidec: implementation-data-type=uint16
    DT_CAN2_SG_IVI1
      62 x element, all with category=TYPE_REFERENCE, implementation-data-type=uint8:
        CAN2_A2B_Node_sta
        CAN2_AmbLigh_LowBatAlert_SW
        CAN2_AmbLigh_SafetyAlert_SW
        CAN2_AmbLightBrightnessSet
        CAN2_AmbLightColorSet
        CAN2_AmbLight_DimInDark_SW
        CAN2_AmbLight_SW
        CAN2_AmbLight_WlcmLight_SW
        CAN2_BrkAbn_GoReady_SW
        CAN2_FCP_FrEvt_BtnACMaxReq
        CAN2_FCP_FrEvt_BtnACReq
        CAN2_FCP_FrEvt_BtnAutoReq
        CAN2_FCP_FrEvt_BtnSyncReq
        CAN2_FCP_MidEvt_BtnAutoReq
        CAN2_IVI_AirRefresh_ByDMS_Sta
        CAN2_IVI_AutoTheme_But_Sta
        CAN2_IVI_CLWin_LockDoorSW_Sta
        CAN2_IVI_CreateAccReq_Sta
        CAN2_IVI_DMS_SW_Sta
        CAN2_IVI_DSEAT_anti_set_Sta
        CAN2_IVI_DelAccReq_Sta
        CAN2_IVI_FrTrunk_UnlockReq_Sta
        CAN2_IVI_HMI_Undefined_Sta
        CAN2_IVI_LinkAccReq_Sta
        CAN2_IVI_LinkAcc_Sta
        CAN2_IVI_LinkKey_Sta
        CAN2_IVI_Located_STA
        CAN2_IVI_Lock_SoundSW_Sta
        CAN2_IVI_NAVI_Foreground_Sta
        CAN2_IVI_OTA_Upd_Sta
        CAN2_IVI_QuickRefresh_Sta
        CAN2_IVI_SWC_VibMode_Sta
        CAN2_IVI_Time_Check
        CAN2_IVI_Time_Day
        CAN2_IVI_Time_Hour
        CAN2_IVI_Time_Minute
        CAN2_IVI_Time_Month
        CAN2_IVI_Time_Second
        CAN2_IVI_Time_Year
        CAN2_IVI_sigScreenReq_Sta
        CAN2_LINKtoDrive
        CAN2_OTA_CancelDL_Req
        CAN2_OTA_CompNTFY_Pres
        CAN2_OTA_DL_Req
        CAN2_OTA_SuspendDL_Req
        CAN2_OTA_UpdStart_Req
        CAN2_OpenDrOpenWdo_SW
        CAN2_PW_CLOSE_IMD
        CAN2_PW_CONTINUE_USE
        CAN2_Re_Radio_Sta
        CAN2_Sched_Chg_Day_Set
        CAN2_Sched_Chg_End_Time_HR
        CAN2_Sched_Chg_End_Time_Min
        CAN2_Sched_Chg_St_Time_HR
        CAN2_Sched_Chg_St_Time_Min
        CAN2_Sched_OTA_wake
        CAN2_SmartEco_Mode_SW
        CAN2_Upd_Countdown_Cancel
        CAN2_Upd_Countdown_Skip
        CAN2_UserSet
        CAN2_VehACModReq
        CAN2_mFRD_link_Sta
    DT_CAN2_SG_IVI2
      149 x element, all with category=TYPE_REFERENCE:
        CAN2_AC_Chg_Cur_Set: implementation-data-type=uint8
        CAN2_AEB_BUTT: implementation-data-type=uint8
        CAN2_AVM_Err_STA: implementation-data-type=uint8
        CAN2_AVM_OFF_Rec_Butt: implementation-data-type=uint8
        CAN2_AVM_Parking_mode: implementation-data-type=uint8
        CAN2_AVM_parking_cancel: implementation-data-type=uint8
        CAN2_AVM_parking_excute: implementation-data-type=uint8
        CAN2_Approach_Unlock_SW: implementation-data-type=uint8
        CAN2_BSDMute_BUTT: implementation-data-type=uint8
        CAN2_CAAS_Sw: implementation-data-type=uint8
        CAN2_CDL_Lock_Butt: implementation-data-type=uint8
        CAN2_CDL_Unlock_Butt: implementation-data-type=uint8
        CAN2_CameraWrn: implementation-data-type=uint8
        CAN2_DMS_Status: implementation-data-type=uint8
        CAN2_DMS_Warning_Distraction: implementation-data-type=uint8
        CAN2_DMS_Warning_Fatigue: implementation-data-type=uint8
        CAN2_DMS_Warning_Unresponsive: implementation-data-type=uint8
        CAN2_DSEAT_anti_set: implementation-data-type=uint8
        CAN2_DSEAT_entryfun_set: implementation-data-type=uint8
        CAN2_DSEAT_vent_req: implementation-data-type=uint8
        CAN2_Distance_unit: implementation-data-type=uint8
        CAN2_ESC_SW_Cmd: implementation-data-type=uint8
        CAN2_FCWMute_BUTT: implementation-data-type=uint8
        CAN2_FFogLampSW: implementation-data-type=uint8
        CAN2_FS_Off_Sw: implementation-data-type=uint8
        CAN2_FalseNPrevent_SW: implementation-data-type=uint8
        CAN2_FollowMeSW: implementation-data-type=uint8
        CAN2_GPS_LAT: implementation-data-type=uint32
        CAN2_GPS_LONG: implementation-data-type=uint32
        CAN2_HeadLampSW: implementation-data-type=uint8
        CAN2_Hood_Latch_SW: implementation-data-type=uint8
        CAN2_IVI_ACC_Adaptive_Sta: implementation-data-type=uint8
        CAN2_IVI_ActvDmpDisabSW: implementation-data-type=uint8
        CAN2_IVI_AirIntZ3_Cmd: implementation-data-type=uint8
        CAN2_IVI_CfmTo_Rdy: implementation-data-type=uint8
        CAN2_IVI_ChargePortSW_Sta: implementation-data-type=uint8
        CAN2_IVI_CoastDwSW: implementation-data-type=uint8
        CAN2_IVI_CreepSW_Req: implementation-data-type=uint8
        CAN2_IVI_DSEATHeater_Cmd: implementation-data-type=uint8
        CAN2_IVI_DSEAT_FroEdge_Height_Cmd: implementation-data-type=uint8
        CAN2_IVI_DSEAT_Height_Cmd: implementation-data-type=uint8
        CAN2_IVI_DSEAT_Memory1_Sta: implementation-data-type=uint8
        CAN2_IVI_DSEAT_Memory2_Sta: implementation-data-type=uint8
        CAN2_IVI_DSEAT_Memory_OPTCLS_Sta: implementation-data-type=uint8
        CAN2_IVI_DSEAT_Recline_Cmd: implementation-data-type=uint8
        CAN2_IVI_DSEAT_Slide_Cmd: implementation-data-type=uint8
        CAN2_IVI_ISA_OffsetSpd: implementation-data-type=uint8
        CAN2_IVI_LVChrgFuncSW: implementation-data-type=uint8
        CAN2_IVI_Mute_Sta: implementation-data-type=uint8
        CAN2_IVI_Night_Mode_Sta: implementation-data-type=uint8
        CAN2_IVI_PSEATHeater_Cmd: implementation-data-type=uint8
        CAN2_IVI_PSEAT_Recline_Cmd: implementation-data-type=uint8
        CAN2_IVI_PSEAT_Slide_Cmd: implementation-data-type=uint8
        CAN2_IVI_PTG_Mode_SW: implementation-data-type=uint8
        CAN2_IVI_PTG_Open_Height: implementation-data-type=uint8
        CAN2_IVI_PTG_Sta_SW: implementation-data-type=uint8
        CAN2_IVI_PTG_USSta_SW: implementation-data-type=uint8
        CAN2_IVI_PW_Mode_Req: implementation-data-type=uint8
        CAN2_IVI_Panel_Act: implementation-data-type=uint8
        CAN2_IVI_Panel_X_Coor: implementation-data-type=uint16
        CAN2_IVI_Panel_Y_Coor: implementation-data-type=uint16
        CAN2_IVI_PwrLockSW: implementation-data-type=uint8
        CAN2_IVI_Pwroff_req: implementation-data-type=uint8
        CAN2_IVI_RR_Def_Req: implementation-data-type=uint8
        CAN2_IVI_Req_V2L: implementation-data-type=uint8
        CAN2_IVI_SLIF_Warning_Sta: implementation-data-type=uint8
        CAN2_IVI_SWC_ACCMode_Sta: implementation-data-type=uint8
        CAN2_IVI_SWC_LUndefined_Sta: implementation-data-type=uint8
        CAN2_IVI_SWC_RUndefined_Sta: implementation-data-type=uint8
        CAN2_IVI_Screen: implementation-data-type=uint8
        CAN2_IVI_SetTempZon1_Sta: implementation-data-type=uint8
        CAN2_IVI_SetTempZon2_Sta: implementation-data-type=uint8
        CAN2_IVI_Start_Chg_req: implementation-data-type=uint8
        CAN2_IVI_Status: implementation-data-type=uint8
        CAN2_IVI_Stop_Chg_req: implementation-data-type=uint8
        CAN2_IVI_TrailerCheckReq_Sta: implementation-data-type=uint8
        CAN2_IVI_TrailerModeSW_Sta: implementation-data-type=uint8
        CAN2_IVI_Trigger_req: implementation-data-type=uint8
        CAN2_IVI_Unlock_Chg_req: implementation-data-type=uint8
        CAN2_IVI_WI_MAIN_SW: implementation-data-type=uint8
        CAN2_LDWMute_BUTT: implementation-data-type=uint8
        CAN2_LKA_BUTT: implementation-data-type=uint8
        CAN2_LVDAMute_BUTT: implementation-data-type=uint8
        CAN2_L_Drv_ControlCommand: implementation-data-type=uint8
        CAN2_L_Pas_ControlCommand: implementation-data-type=uint8
        CAN2_L_RLD_ControlCommand: implementation-data-type=uint8
        CAN2_L_RRD_ControlCommand: implementation-data-type=uint8
        CAN2_Light_ShowStart_Req: implementation-data-type=uint8
        CAN2_Light_ShowStop_Req: implementation-data-type=uint8
        CAN2_METER_Malfunc_Sta: implementation-data-type=uint8
        CAN2_MFRD_N_Bright_Req: implementation-data-type=uint8
        CAN2_NAVI_Cam_Dist_info: implementation-data-type=uint8
        CAN2_NAVI_Direction_STA: implementation-data-type=uint8
        CAN2_NAVI_Distance_info: implementation-data-type=uint32
        CAN2_NAVI_ForwardLinkLevel: implementation-data-type=uint8
        CAN2_NAVI_LinkClass: implementation-data-type=uint8
        CAN2_NAVI_RoadClass: implementation-data-type=uint8
        CAN2_NAVI_SpeedLimit: implementation-data-type=uint8
        CAN2_NAVI_Speed_Limit_A: implementation-data-type=uint8
        CAN2_NAVI_State: implementation-data-type=uint8
        CAN2_NAVI_Tollgate: implementation-data-type=uint16
        CAN2_NAVI_Tunnel: implementation-data-type=uint16
        CAN2_ODAMute_BUTT: implementation-data-type=uint8
        CAN2_OFF_AC_MODE: implementation-data-type=uint8
        CAN2_PSEAT_vent_req: implementation-data-type=uint8
        CAN2_Perd_V2L: implementation-data-type=uint8
        CAN2_Pressure_unit: implementation-data-type=uint8
        CAN2_RCTA_BUTT: implementation-data-type=uint8
        CAN2_RFogLampSW: implementation-data-type=uint8
        CAN2_Roll_Eng_Mode: implementation-data-type=uint8
        CAN2_Roll_Mode_SW_Cmd: implementation-data-type=uint8
        CAN2_RoomLampMode: implementation-data-type=uint8
        CAN2_SLG_Sw: implementation-data-type=uint8
        CAN2_SLIF_BUTT: implementation-data-type=uint8
        CAN2_SOC_ADJ_BUTT: implementation-data-type=uint8
        CAN2_SOC_Limit_Set: implementation-data-type=uint8
        CAN2_SOC_V2LLimit: implementation-data-type=uint8
        CAN2_Sched_Chg_Start: implementation-data-type=uint8
        CAN2_Sched_Chg_Stop: implementation-data-type=uint8
        CAN2_Sched_Chg_butt: implementation-data-type=uint8
        CAN2_Sched_Chg_limit: implementation-data-type=uint8
        CAN2_Sched_Chg_wake: implementation-data-type=uint8
        CAN2_SenstivityPosition: implementation-data-type=uint8
        CAN2_SetUnlockSingle: implementation-data-type=uint8
        CAN2_TCS_SW_Cmd: implementation-data-type=uint8
        CAN2_TPMS_Cali_Butt: implementation-data-type=uint8
        CAN2_TPMS_Res_Butt: implementation-data-type=uint8
        CAN2_Temperature_unit: implementation-data-type=uint8
        CAN2_Time_system: implementation-data-type=uint8
        CAN2_TurnSwTimeSet: implementation-data-type=uint8
        CAN2_User_p_download: implementation-data-type=uint8
        CAN2_User_p_upload: implementation-data-type=uint8
        CAN2_Walkaway_Lock_SW: implementation-data-type=uint8
        CAN2_Wifi_Reset: implementation-data-type=uint8
        CAN2_Wifi_Sta_IVI_TBOX: implementation-data-type=uint8
        CAN2_WlcmLight_Mode: implementation-data-type=uint8
        CAN2_sigAirIntenZon1Req: implementation-data-type=uint8
        CAN2_sigAirIntenZon3Req: implementation-data-type=uint8
        CAN2_sigDfrstReq: implementation-data-type=uint8
        CAN2_sigFaceReq: implementation-data-type=uint8
        CAN2_sigFootReq: implementation-data-type=uint8
        CAN2_sigHvacFrontReq: implementation-data-type=uint8
        CAN2_sigHvacRearReq: implementation-data-type=uint8
        CAN2_sigHvacReq: implementation-data-type=uint8
        CAN2_sigRecircReq: implementation-data-type=uint8
        CAN2_sigSetTempZon{1..3}Req: implementation-data-type=uint8
        CAN2_sigWindDirZon3Req: implementation-data-type=uint8
    DT_CAN2_SG_IVI3
      32 x element, all with category=TYPE_REFERENCE, implementation-data-type=uint8:
        CAN2_IVI_CLBlower_Y_Sta
        CAN2_IVI_CLBlower_Z_Sta
        CAN2_IVI_CRBlower_Y_Sta
        CAN2_IVI_CRBlower_Z_Sta
        CAN2_IVI_DrBlower_Mode_Sta
        CAN2_IVI_DrBlower_Y_Sta
        CAN2_IVI_DrBlower_Z_Sta
        CAN2_IVI_LSEATvent_Cmd
        CAN2_IVI_MLFMost_Cmd
        CAN2_IVI_MLFootLift_Cmd
        CAN2_IVI_MLNapMode_Cmd
        CAN2_IVI_MLRecliner_Cmd
        CAN2_IVI_MLRestore_Cmd
        CAN2_IVI_MLSEATvent_Cmd
        CAN2_IVI_MLSeatLift_Cmd
        CAN2_IVI_MLSldRestore_Cmd
        CAN2_IVI_MLSlider_Cmd
        CAN2_IVI_MLZeroGravity_Cmd
        CAN2_IVI_MRFMost_Cmd
        CAN2_IVI_MRFootLift_Cmd
        CAN2_IVI_MRNapMode_Cmd
        CAN2_IVI_MRRecliner_Cmd
        CAN2_IVI_MRRestore_Cmd
        CAN2_IVI_MRSEATvent_Cmd
        CAN2_IVI_MRSeatLift_Cmd
        CAN2_IVI_MRSldRestore_Cmd
        CAN2_IVI_MRSlider_Cmd
        CAN2_IVI_MRZeroGravity_Cmd
        CAN2_IVI_PsBlower_Mode_Sta
        CAN2_IVI_PsBlower_Y_Sta
        CAN2_IVI_PsBlower_Z_Sta
        CAN2_IVI_RSEATvent_Cmd
    DT_CAN2_SG_IVI_P20_0
      8 x element, all with category=TYPE_REFERENCE, implementation-data-type=uint8:
        CAN2_IVI_AmbiLgtSta
        CAN2_IVI_FrAtmoLamp_Cmd
        CAN2_IVI_FrRmLampBright_Cmd
        CAN2_IVI_Frontindoorlight_Sta
        CAN2_IVI_Passengerdoor_Sta
        CAN2_IVI_RrAtmoLamp_Cmd
        CAN2_IVI_RrRmLampBright_Cmd
        CAN2_IVI_RrRoomlamp_Cmd
    DT_CAN2_SG_METER1
      16 x element, all with category=TYPE_REFERENCE:
        CAN2_APCforDTE: implementation-data-type=uint16
        CAN2_AVGPwrConsumption: implementation-data-type=uint16
        CAN2_AvailableTrip: implementation-data-type=uint16
        CAN2_Averaged_vehspeed: implementation-data-type=uint16
        CAN2_Charge: implementation-data-type=uint8
        CAN2_LEDlitWarnReq: implementation-data-type=uint8
        CAN2_METER_KPH_Calcu: implementation-data-type=uint8
        CAN2_METER_KPH_Real: implementation-data-type=uint16
        CAN2_METER_MPH_Calcu: implementation-data-type=uint8
        CAN2_METER_MPH_Real: implementation-data-type=uint16
        CAN2_ODOMETER: implementation-data-type=uint32
        CAN2_ParkBrake: implementation-data-type=uint8
        CAN2_Spd_Crl_Mode: implementation-data-type=uint8
        CAN2_Spd_Crl_Sta: implementation-data-type=uint8
        CAN2_Trip_A: implementation-data-type=uint32
        CAN2_Trip_B: implementation-data-type=uint32
