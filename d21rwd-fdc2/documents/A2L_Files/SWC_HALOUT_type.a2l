/******************************************************************************
* ASAP2 file: SWC_HALOUT_type.a2l
* Code generation for model "SWC_HALOUT_type".
* Model version : 1.45
* Simulink Coder version : 9.6 (R2021b) 14-May-2021
* C source code generated on : Tue Jun 10 15:30:57 2025
* Target selection: autosar.tlc
* Embedded hardware selection: ARM Compatible->ARM Cortex-M
* Code generation objectives: Unspecified
* Validation result: Not run
* (add additional file header information here)
******************************************************************************/ ASAP2_VERSION 1 31
/* Version 1.31 */
/begin PROJECT ProjectName "Project Comment Goes Here"
/begin HEADER "Header Comments go here" /end HEADER
/begin MODULE ModuleName "Module Comment Goes Here"
/begin MOD_PAR "MOD PAR Comment Goes Here" /end MOD_PAR
/begin MOD_COMMON "Mod Common Comment Here" BYTE_ORDER MSB_LAST /end MOD_COMMON
/begin RECORD_LAYOUT Scalar_BOOLEAN FNC_VALUES 1 UBYTE COLUMN_DIR DIRECT /end RECORD_LAYOUT
/begin RECORD_LAYOUT Scalar_UBYTE FNC_VALUES 1 UBYTE COLUMN_DIR DIRECT /end RECORD_LAYOUT
/begin RECORD_LAYOUT Scalar_BYTE FNC_VALUES 1 SBYTE COLUMN_DIR DIRECT /end RECORD_LAYOUT
/begin RECORD_LAYOUT Scalar_UWORD FNC_VALUES 1 UWORD COLUMN_DIR DIRECT /end RECORD_LAYOUT
/begin RECORD_LAYOUT Scalar_SWORD FNC_VALUES 1 SWORD COLUMN_DIR DIRECT /end RECORD_LAYOUT
/begin RECORD_LAYOUT Scalar_ULONG FNC_VALUES 1 ULONG COLUMN_DIR DIRECT /end RECORD_LAYOUT
/begin RECORD_LAYOUT Scalar_LONG FNC_VALUES 1 SLONG COLUMN_DIR DIRECT /end RECORD_LAYOUT
/begin RECORD_LAYOUT Scalar_FLOAT32_IEEE FNC_VALUES 1 FLOAT32_IEEE COLUMN_DIR DIRECT /end RECORD_LAYOUT
/begin RECORD_LAYOUT Scalar_FLOAT64_IEEE FNC_VALUES 1 FLOAT64_IEEE COLUMN_DIR DIRECT /end RECORD_LAYOUT
/begin RECORD_LAYOUT Lookup1D_BOOLEAN FNC_VALUES 1 UBYTE COLUMN_DIR DIRECT /end RECORD_LAYOUT
/begin RECORD_LAYOUT Lookup1D_X_BOOLEAN AXIS_PTS_X 1 UBYTE INDEX_INCR DIRECT /end RECORD_LAYOUT
/begin RECORD_LAYOUT Lookup1D_BYTE FNC_VALUES 1 SBYTE COLUMN_DIR DIRECT /end RECORD_LAYOUT
/begin RECORD_LAYOUT Lookup1D_X_BYTE AXIS_PTS_X 1 SBYTE INDEX_INCR DIRECT /end RECORD_LAYOUT
/begin RECORD_LAYOUT Lookup1D_UBYTE FNC_VALUES 1 UBYTE COLUMN_DIR DIRECT /end RECORD_LAYOUT
/begin RECORD_LAYOUT Lookup1D_X_UBYTE AXIS_PTS_X 1 UBYTE INDEX_INCR DIRECT /end RECORD_LAYOUT
/begin RECORD_LAYOUT Lookup1D_UWORD FNC_VALUES 1 UWORD COLUMN_DIR DIRECT /end RECORD_LAYOUT
/begin RECORD_LAYOUT Lookup1D_X_UWORD AXIS_PTS_X 1 UWORD INDEX_INCR DIRECT /end RECORD_LAYOUT
/begin RECORD_LAYOUT Lookup1D_WORD FNC_VALUES 1 SWORD COLUMN_DIR DIRECT /end RECORD_LAYOUT
/begin RECORD_LAYOUT Lookup1D_X_WORD AXIS_PTS_X 1 SWORD INDEX_INCR DIRECT /end RECORD_LAYOUT
/begin RECORD_LAYOUT Lookup1D_ULONG FNC_VALUES 1 ULONG COLUMN_DIR DIRECT /end RECORD_LAYOUT
/begin RECORD_LAYOUT Lookup1D_X_ULONG AXIS_PTS_X 1 ULONG INDEX_INCR DIRECT /end RECORD_LAYOUT
/begin RECORD_LAYOUT Lookup1D_SLONG FNC_VALUES 1 SLONG COLUMN_DIR DIRECT /end RECORD_LAYOUT
/begin RECORD_LAYOUT Lookup1D_X_LONG AXIS_PTS_X 1 SLONG INDEX_INCR DIRECT /end RECORD_LAYOUT
/begin RECORD_LAYOUT Lookup1D_FLOAT32_IEEE FNC_VALUES 1 FLOAT32_IEEE COLUMN_DIR DIRECT /end RECORD_LAYOUT
/begin RECORD_LAYOUT Lookup1D_X_FLOAT32_IEEE AXIS_PTS_X 1 FLOAT32_IEEE INDEX_INCR DIRECT /end RECORD_LAYOUT
/begin RECORD_LAYOUT Lookup1D_FLOAT64_IEEE FNC_VALUES 1 FLOAT64_IEEE COLUMN_DIR DIRECT /end RECORD_LAYOUT
/begin RECORD_LAYOUT Lookup1D_X_FLOAT64_IEEE AXIS_PTS_X 1 FLOAT64_IEEE INDEX_INCR DIRECT /end RECORD_LAYOUT
/begin RECORD_LAYOUT Lookup2D_BOOLEAN FNC_VALUES 1 UBYTE COLUMN_DIR DIRECT /end RECORD_LAYOUT
/begin RECORD_LAYOUT Lookup2D_X_BOOLEAN AXIS_PTS_X 1 UBYTE INDEX_INCR DIRECT /end RECORD_LAYOUT
/begin RECORD_LAYOUT Lookup2D_UBYTE FNC_VALUES 1 UBYTE COLUMN_DIR DIRECT /end RECORD_LAYOUT
/begin RECORD_LAYOUT Lookup2D_X_UBYTE AXIS_PTS_X 1 UBYTE INDEX_INCR DIRECT /end RECORD_LAYOUT
/begin RECORD_LAYOUT Lookup2D_BYTE FNC_VALUES 1 SBYTE COLUMN_DIR DIRECT /end RECORD_LAYOUT
/begin RECORD_LAYOUT Lookup2D_X_BYTE AXIS_PTS_X 1 SBYTE INDEX_INCR DIRECT /end RECORD_LAYOUT
/begin RECORD_LAYOUT Lookup2D_UWORD FNC_VALUES 1 UWORD COLUMN_DIR DIRECT /end RECORD_LAYOUT
/begin RECORD_LAYOUT Lookup2D_X_UWORD AXIS_PTS_X 1 UWORD INDEX_INCR DIRECT /end RECORD_LAYOUT
/begin RECORD_LAYOUT Lookup2D_WORD FNC_VALUES 1 SWORD COLUMN_DIR DIRECT /end RECORD_LAYOUT
/begin RECORD_LAYOUT Lookup2D_X_WORD AXIS_PTS_X 1 SWORD INDEX_INCR DIRECT /end RECORD_LAYOUT
/begin RECORD_LAYOUT Lookup2D_ULONG FNC_VALUES 1 ULONG COLUMN_DIR DIRECT /end RECORD_LAYOUT
/begin RECORD_LAYOUT Lookup2D_X_ULONG AXIS_PTS_X 1 ULONG INDEX_INCR DIRECT /end RECORD_LAYOUT
/begin RECORD_LAYOUT Lookup2D_LONG FNC_VALUES 1 SLONG COLUMN_DIR DIRECT /end RECORD_LAYOUT
/begin RECORD_LAYOUT Lookup2D_X_LONG AXIS_PTS_X 1 SLONG INDEX_INCR DIRECT /end RECORD_LAYOUT
/begin RECORD_LAYOUT Lookup2D_FLOAT32_IEEE FNC_VALUES 1 FLOAT32_IEEE COLUMN_DIR DIRECT /end RECORD_LAYOUT
/begin RECORD_LAYOUT Lookup2D_X_FLOAT32_IEEE AXIS_PTS_X 1 FLOAT32_IEEE INDEX_INCR DIRECT /end RECORD_LAYOUT
/begin RECORD_LAYOUT Lookup2D_FLOAT64_IEEE FNC_VALUES 1 FLOAT64_IEEE COLUMN_DIR DIRECT /end RECORD_LAYOUT
/begin RECORD_LAYOUT Lookup2D_X_FLOAT64_IEEE AXIS_PTS_X 1 FLOAT64_IEEE INDEX_INCR DIRECT /end RECORD_LAYOUT
/begin CHARACTERISTIC DTC_10020B "" VALUE 0x0000 /* @ECU_Address@DTC_10020B@ */ Scalar_UWORD 0 SWC_HALOUT_type_CM_uint16 0 65535 /end CHARACTERISTIC
/begin CHARACTERISTIC DTC_10020C "" VALUE 0x0000 /* @ECU_Address@DTC_10020C@ */ Scalar_UWORD 0 SWC_HALOUT_type_CM_uint16 0 65535 /end CHARACTERISTIC
/begin CHARACTERISTIC DTC_10020D "" VALUE 0x0000 /* @ECU_Address@DTC_10020D@ */ Scalar_UWORD 0 SWC_HALOUT_type_CM_uint16 0 65535 /end CHARACTERISTIC
/begin CHARACTERISTIC DTC_10020E "" VALUE 0x0000 /* @ECU_Address@DTC_10020E@ */ Scalar_UWORD 0 SWC_HALOUT_type_CM_uint16 0 65535 /end CHARACTERISTIC
/begin CHARACTERISTIC DTC_100210 "" VALUE 0x0000 /* @ECU_Address@DTC_100210@ */ Scalar_UWORD 0 SWC_HALOUT_type_CM_uint16 0 65535 /end CHARACTERISTIC
/begin CHARACTERISTIC DTC_100211 "" VALUE 0x0000 /* @ECU_Address@DTC_100211@ */ Scalar_UWORD 0 SWC_HALOUT_type_CM_uint16 0 65535 /end CHARACTERISTIC
/begin CHARACTERISTIC DTC_100212 "" VALUE 0x0000 /* @ECU_Address@DTC_100212@ */ Scalar_UWORD 0 SWC_HALOUT_type_CM_uint16 0 65535 /end CHARACTERISTIC
/begin CHARACTERISTIC DTC_100213 "" VALUE 0x0000 /* @ECU_Address@DTC_100213@ */ Scalar_UWORD 0 SWC_HALOUT_type_CM_uint16 0 65535 /end CHARACTERISTIC
/begin CHARACTERISTIC DTC_100214 "" VALUE 0x0000 /* @ECU_Address@DTC_100214@ */ Scalar_UWORD 0 SWC_HALOUT_type_CM_uint16 0 65535 /end CHARACTERISTIC
/begin CHARACTERISTIC DTC_100215 "" VALUE 0x0000 /* @ECU_Address@DTC_100215@ */ Scalar_UWORD 0 SWC_HALOUT_type_CM_uint16 0 65535 /end CHARACTERISTIC
/begin CHARACTERISTIC DTC_100216 "" VALUE 0x0000 /* @ECU_Address@DTC_100216@ */ Scalar_UWORD 0 SWC_HALOUT_type_CM_uint16 0 65535 /end CHARACTERISTIC
/begin CHARACTERISTIC DTC_100217 "" VALUE 0x0000 /* @ECU_Address@DTC_100217@ */ Scalar_UWORD 0 SWC_HALOUT_type_CM_uint16 0 65535 /end CHARACTERISTIC
/begin CHARACTERISTIC DTC_100218 "" VALUE 0x0000 /* @ECU_Address@DTC_100218@ */ Scalar_UWORD 0 SWC_HALOUT_type_CM_uint16 0 65535 /end CHARACTERISTIC
/begin CHARACTERISTIC DTC_100219 "" VALUE 0x0000 /* @ECU_Address@DTC_100219@ */ Scalar_UWORD 0 SWC_HALOUT_type_CM_uint16 0 65535 /end CHARACTERISTIC
/begin CHARACTERISTIC DTC_10021A "" VALUE 0x0000 /* @ECU_Address@DTC_10021A@ */ Scalar_UWORD 0 SWC_HALOUT_type_CM_uint16 0 65535 /end CHARACTERISTIC
/begin CHARACTERISTIC DTC_10021B "" VALUE 0x0000 /* @ECU_Address@DTC_10021B@ */ Scalar_UWORD 0 SWC_HALOUT_type_CM_uint16 0 65535 /end CHARACTERISTIC
/begin CHARACTERISTIC DTC_10021C "" VALUE 0x0000 /* @ECU_Address@DTC_10021C@ */ Scalar_UWORD 0 SWC_HALOUT_type_CM_uint16 0 65535 /end CHARACTERISTIC
/begin CHARACTERISTIC DTC_10021D "" VALUE 0x0000 /* @ECU_Address@DTC_10021D@ */ Scalar_UWORD 0 SWC_HALOUT_type_CM_uint16 0 65535 /end CHARACTERISTIC
/begin CHARACTERISTIC DTC_10021E "" VALUE 0x0000 /* @ECU_Address@DTC_10021E@ */ Scalar_UWORD 0 SWC_HALOUT_type_CM_uint16 0 65535 /end CHARACTERISTIC
/begin CHARACTERISTIC DTC_100220 "" VALUE 0x0000 /* @ECU_Address@DTC_100220@ */ Scalar_UWORD 0 SWC_HALOUT_type_CM_uint16 0 65535 /end CHARACTERISTIC
/begin CHARACTERISTIC DTC_100221 "" VALUE 0x0000 /* @ECU_Address@DTC_100221@ */ Scalar_UWORD 0 SWC_HALOUT_type_CM_uint16 0 65535 /end CHARACTERISTIC
/begin CHARACTERISTIC DTC_100223 "" VALUE 0x0000 /* @ECU_Address@DTC_100223@ */ Scalar_UWORD 0 SWC_HALOUT_type_CM_uint16 0 65535 /end CHARACTERISTIC
/begin CHARACTERISTIC DTC_100224 "" VALUE 0x0000 /* @ECU_Address@DTC_100224@ */ Scalar_UWORD 0 SWC_HALOUT_type_CM_uint16 0 65535 /end CHARACTERISTIC
/begin CHARACTERISTIC DTC_100225 "" VALUE 0x0000 /* @ECU_Address@DTC_100225@ */ Scalar_UWORD 0 SWC_HALOUT_type_CM_uint16 0 65535 /end CHARACTERISTIC
/begin CHARACTERISTIC DTC_100226 "" VALUE 0x0000 /* @ECU_Address@DTC_100226@ */ Scalar_UWORD 0 SWC_HALOUT_type_CM_uint16 0 65535 /end CHARACTERISTIC
/begin CHARACTERISTIC DTC_100227 "" VALUE 0x0000 /* @ECU_Address@DTC_100227@ */ Scalar_UWORD 0 SWC_HALOUT_type_CM_uint16 0 65535 /end CHARACTERISTIC
/begin CHARACTERISTIC DTC_100242 "" VALUE 0x0000 /* @ECU_Address@DTC_100242@ */ Scalar_UWORD 0 SWC_HALOUT_type_CM_uint16 0 65535 /end CHARACTERISTIC
/begin CHARACTERISTIC DTC_100243 "" VALUE 0x0000 /* @ECU_Address@DTC_100243@ */ Scalar_UWORD 0 SWC_HALOUT_type_CM_uint16 0 65535 /end CHARACTERISTIC
/begin CHARACTERISTIC DTC_100244 "" VALUE 0x0000 /* @ECU_Address@DTC_100244@ */ Scalar_UWORD 0 SWC_HALOUT_type_CM_uint16 0 65535 /end CHARACTERISTIC
/begin CHARACTERISTIC DTC_100247 "" VALUE 0x0000 /* @ECU_Address@DTC_100247@ */ Scalar_UWORD 0 SWC_HALOUT_type_CM_uint16 0 65535 /end CHARACTERISTIC
/begin CHARACTERISTIC DTC_100248 "" VALUE 0x0000 /* @ECU_Address@DTC_100248@ */ Scalar_UWORD 0 SWC_HALOUT_type_CM_uint16 0 65535 /end CHARACTERISTIC
/begin CHARACTERISTIC DTC_100249 "" VALUE 0x0000 /* @ECU_Address@DTC_100249@ */ Scalar_UWORD 0 SWC_HALOUT_type_CM_uint16 0 65535 /end CHARACTERISTIC
/begin CHARACTERISTIC DTC_100250 "" VALUE 0x0000 /* @ECU_Address@DTC_100250@ */ Scalar_UWORD 0 SWC_HALOUT_type_CM_uint16 0 65535 /end CHARACTERISTIC
/begin CHARACTERISTIC DTC_100251 "" VALUE 0x0000 /* @ECU_Address@DTC_100251@ */ Scalar_UWORD 0 SWC_HALOUT_type_CM_uint16 0 65535 /end CHARACTERISTIC
/begin CHARACTERISTIC DTC_100252 "" VALUE 0x0000 /* @ECU_Address@DTC_100252@ */ Scalar_UWORD 0 SWC_HALOUT_type_CM_uint16 0 65535 /end CHARACTERISTIC
/begin CHARACTERISTIC DTC_100A10 "" VALUE 0x0000 /* @ECU_Address@DTC_100A10@ */ Scalar_UWORD 0 SWC_HALOUT_type_CM_uint16 0 65535 /end CHARACTERISTIC
/begin CHARACTERISTIC DTC_100A12 "" VALUE 0x0000 /* @ECU_Address@DTC_100A12@ */ Scalar_UWORD 0 SWC_HALOUT_type_CM_uint16 0 65535 /end CHARACTERISTIC
/begin CHARACTERISTIC DTC_100A16 "" VALUE 0x0000 /* @ECU_Address@DTC_100A16@ */ Scalar_UWORD 0 SWC_HALOUT_type_CM_uint16 0 65535 /end CHARACTERISTIC
/begin CHARACTERISTIC DTC_100A17 "" VALUE 0x0000 /* @ECU_Address@DTC_100A17@ */ Scalar_UWORD 0 SWC_HALOUT_type_CM_uint16 0 65535 /end CHARACTERISTIC
/begin CHARACTERISTIC DTC_100A18 "" VALUE 0x0000 /* @ECU_Address@DTC_100A18@ */ Scalar_UWORD 0 SWC_HALOUT_type_CM_uint16 0 65535 /end CHARACTERISTIC
/begin CHARACTERISTIC DTC_100A19 "" VALUE 0x0000 /* @ECU_Address@DTC_100A19@ */ Scalar_UWORD 0 SWC_HALOUT_type_CM_uint16 0 65535 /end CHARACTERISTIC
/begin CHARACTERISTIC DTC_500B01 "" VALUE 0x0000 /* @ECU_Address@DTC_500B01@ */ Scalar_UWORD 0 SWC_HALOUT_type_CM_uint16 0 65535 /end CHARACTERISTIC
/begin CHARACTERISTIC DTC_500B02 "" VALUE 0x0000 /* @ECU_Address@DTC_500B02@ */ Scalar_UWORD 0 SWC_HALOUT_type_CM_uint16 0 65535 /end CHARACTERISTIC
/begin CHARACTERISTIC DTC_500B03 "" VALUE 0x0000 /* @ECU_Address@DTC_500B03@ */ Scalar_UWORD 0 SWC_HALOUT_type_CM_uint16 0 65535 /end CHARACTERISTIC
/begin CHARACTERISTIC DTC_500B04 "" VALUE 0x0000 /* @ECU_Address@DTC_500B04@ */ Scalar_UWORD 0 SWC_HALOUT_type_CM_uint16 0 65535 /end CHARACTERISTIC
/begin CHARACTERISTIC DTC_500B05 "" VALUE 0x0000 /* @ECU_Address@DTC_500B05@ */ Scalar_UWORD 0 SWC_HALOUT_type_CM_uint16 0 65535 /end CHARACTERISTIC
/begin CHARACTERISTIC DTC_500B06 "" VALUE 0x0000 /* @ECU_Address@DTC_500B06@ */ Scalar_UWORD 0 SWC_HALOUT_type_CM_uint16 0 65535 /end CHARACTERISTIC
/begin CHARACTERISTIC DTC_500B07 "" VALUE 0x0000 /* @ECU_Address@DTC_500B07@ */ Scalar_UWORD 0 SWC_HALOUT_type_CM_uint16 0 65535 /end CHARACTERISTIC
/begin CHARACTERISTIC DTC_500B08 "" VALUE 0x0000 /* @ECU_Address@DTC_500B08@ */ Scalar_UWORD 0 SWC_HALOUT_type_CM_uint16 0 65535 /end CHARACTERISTIC
/begin CHARACTERISTIC DTC_500B09 "" VALUE 0x0000 /* @ECU_Address@DTC_500B09@ */ Scalar_UWORD 0 SWC_HALOUT_type_CM_uint16 0 65535 /end CHARACTERISTIC
/begin CHARACTERISTIC DTC_500B0A "" VALUE 0x0000 /* @ECU_Address@DTC_500B0A@ */ Scalar_UWORD 0 SWC_HALOUT_type_CM_uint16 0 65535 /end CHARACTERISTIC
/begin CHARACTERISTIC DTC_500B0B "" VALUE 0x0000 /* @ECU_Address@DTC_500B0B@ */ Scalar_UWORD 0 SWC_HALOUT_type_CM_uint16 0 65535 /end CHARACTERISTIC
/begin CHARACTERISTIC DTC_500B0C "" VALUE 0x0000 /* @ECU_Address@DTC_500B0C@ */ Scalar_UWORD 0 SWC_HALOUT_type_CM_uint16 0 65535 /end CHARACTERISTIC
/begin CHARACTERISTIC DTC_500B0D "" VALUE 0x0000 /* @ECU_Address@DTC_500B0D@ */ Scalar_UWORD 0 SWC_HALOUT_type_CM_uint16 0 65535 /end CHARACTERISTIC
/begin CHARACTERISTIC DTC_500B0E "" VALUE 0x0000 /* @ECU_Address@DTC_500B0E@ */ Scalar_UWORD 0 SWC_HALOUT_type_CM_uint16 0 65535 /end CHARACTERISTIC
/begin CHARACTERISTIC DTC_500B0F "" VALUE 0x0000 /* @ECU_Address@DTC_500B0F@ */ Scalar_UWORD 0 SWC_HALOUT_type_CM_uint16 0 65535 /end CHARACTERISTIC
/begin CHARACTERISTIC DTC_500B10 "" VALUE 0x0000 /* @ECU_Address@DTC_500B10@ */ Scalar_UWORD 0 SWC_HALOUT_type_CM_uint16 0 65535 /end CHARACTERISTIC
/begin CHARACTERISTIC DTC_90021F "" VALUE 0x0000 /* @ECU_Address@DTC_90021F@ */ Scalar_UWORD 0 SWC_HALOUT_type_CM_uint16 0 65535 /end CHARACTERISTIC
/begin CHARACTERISTIC DTC_90022F "" VALUE 0x0000 /* @ECU_Address@DTC_90022F@ */ Scalar_UWORD 0 SWC_HALOUT_type_CM_uint16 0 65535 /end CHARACTERISTIC
/begin CHARACTERISTIC DTC_900253 "" VALUE 0x0000 /* @ECU_Address@DTC_900253@ */ Scalar_UWORD 0 SWC_HALOUT_type_CM_uint16 0 65535 /end CHARACTERISTIC
/begin CHARACTERISTIC DTC_900254 "" VALUE 0x0000 /* @ECU_Address@DTC_900254@ */ Scalar_UWORD 0 SWC_HALOUT_type_CM_uint16 0 65535 /end CHARACTERISTIC
/begin CHARACTERISTIC DTC_900301 "" VALUE 0x0000 /* @ECU_Address@DTC_900301@ */ Scalar_UWORD 0 SWC_HALOUT_type_CM_uint16 0 65535 /end CHARACTERISTIC
/begin CHARACTERISTIC DTC_900302 "" VALUE 0x0000 /* @ECU_Address@DTC_900302@ */ Scalar_UWORD 0 SWC_HALOUT_type_CM_uint16 0 65535 /end CHARACTERISTIC
/begin CHARACTERISTIC DTC_900303 "" VALUE 0x0000 /* @ECU_Address@DTC_900303@ */ Scalar_UWORD 0 SWC_HALOUT_type_CM_uint16 0 65535 /end CHARACTERISTIC
/begin CHARACTERISTIC DTC_900304 "" VALUE 0x0000 /* @ECU_Address@DTC_900304@ */ Scalar_UWORD 0 SWC_HALOUT_type_CM_uint16 0 65535 /end CHARACTERISTIC
/begin CHARACTERISTIC DTC_900305 "" VALUE 0x0000 /* @ECU_Address@DTC_900305@ */ Scalar_UWORD 0 SWC_HALOUT_type_CM_uint16 0 65535 /end CHARACTERISTIC
/begin CHARACTERISTIC DTC_900909 "" VALUE 0x0000 /* @ECU_Address@DTC_900909@ */ Scalar_UWORD 0 SWC_HALOUT_type_CM_uint16 0 65535 /end CHARACTERISTIC
/begin CHARACTERISTIC DTC_90090A "" VALUE 0x0000 /* @ECU_Address@DTC_90090A@ */ Scalar_UWORD 0 SWC_HALOUT_type_CM_uint16 0 65535 /end CHARACTERISTIC
/begin CHARACTERISTIC DTC_90090B "" VALUE 0x0000 /* @ECU_Address@DTC_90090B@ */ Scalar_UWORD 0 SWC_HALOUT_type_CM_uint16 0 65535 /end CHARACTERISTIC
/begin CHARACTERISTIC DTC_90090C "" VALUE 0x0000 /* @ECU_Address@DTC_90090C@ */ Scalar_UWORD 0 SWC_HALOUT_type_CM_uint16 0 65535 /end CHARACTERISTIC
/begin CHARACTERISTIC DTC_90090D "" VALUE 0x0000 /* @ECU_Address@DTC_90090D@ */ Scalar_UWORD 0 SWC_HALOUT_type_CM_uint16 0 65535 /end CHARACTERISTIC
/begin CHARACTERISTIC DTC_90090E "" VALUE 0x0000 /* @ECU_Address@DTC_90090E@ */ Scalar_UWORD 0 SWC_HALOUT_type_CM_uint16 0 65535 /end CHARACTERISTIC
/begin CHARACTERISTIC DTC_90090F "" VALUE 0x0000 /* @ECU_Address@DTC_90090F@ */ Scalar_UWORD 0 SWC_HALOUT_type_CM_uint16 0 65535 /end CHARACTERISTIC
/begin CHARACTERISTIC DTC_900910 "" VALUE 0x0000 /* @ECU_Address@DTC_900910@ */ Scalar_UWORD 0 SWC_HALOUT_type_CM_uint16 0 65535 /end CHARACTERISTIC
/begin CHARACTERISTIC DTC_900911 "" VALUE 0x0000 /* @ECU_Address@DTC_900911@ */ Scalar_UWORD 0 SWC_HALOUT_type_CM_uint16 0 65535 /end CHARACTERISTIC
/begin CHARACTERISTIC DTC_900912 "" VALUE 0x0000 /* @ECU_Address@DTC_900912@ */ Scalar_UWORD 0 SWC_HALOUT_type_CM_uint16 0 65535 /end CHARACTERISTIC
/begin CHARACTERISTIC DTC_900913 "" VALUE 0x0000 /* @ECU_Address@DTC_900913@ */ Scalar_UWORD 0 SWC_HALOUT_type_CM_uint16 0 65535 /end CHARACTERISTIC
/begin CHARACTERISTIC DTC_900914 "" VALUE 0x0000 /* @ECU_Address@DTC_900914@ */ Scalar_UWORD 0 SWC_HALOUT_type_CM_uint16 0 65535 /end CHARACTERISTIC
/begin CHARACTERISTIC DTC_C0288F "" VALUE 0x0000 /* @ECU_Address@DTC_C0288F@ */ Scalar_UWORD 0 SWC_HALOUT_type_CM_uint16 0 65535 /end CHARACTERISTIC
/begin CHARACTERISTIC DTC_C0378F "" VALUE 0x0000 /* @ECU_Address@DTC_C0378F@ */ Scalar_UWORD 0 SWC_HALOUT_type_CM_uint16 0 65535 /end CHARACTERISTIC
/begin CHARACTERISTIC DTC_C0468F "" VALUE 0x0000 /* @ECU_Address@DTC_C0468F@ */ Scalar_UWORD 0 SWC_HALOUT_type_CM_uint16 0 65535 /end CHARACTERISTIC
/begin CHARACTERISTIC DTC_C0558F "" VALUE 0x0000 /* @ECU_Address@DTC_C0558F@ */ Scalar_UWORD 0 SWC_HALOUT_type_CM_uint16 0 65535 /end CHARACTERISTIC
/begin CHARACTERISTIC DTC_C0648F "" VALUE 0x0000 /* @ECU_Address@DTC_C0648F@ */ Scalar_UWORD 0 SWC_HALOUT_type_CM_uint16 0 65535 /end CHARACTERISTIC
/begin CHARACTERISTIC DTC_C0808F "" VALUE 0x0000 /* @ECU_Address@DTC_C0808F@ */ Scalar_UWORD 0 SWC_HALOUT_type_CM_uint16 0 65535 /end CHARACTERISTIC
/begin CHARACTERISTIC DTC_D00201 "" VALUE 0x0000 /* @ECU_Address@DTC_D00201@ */ Scalar_UWORD 0 SWC_HALOUT_type_CM_uint16 0 65535 /end CHARACTERISTIC
/begin CHARACTERISTIC DTC_D00202 "" VALUE 0x0000 /* @ECU_Address@DTC_D00202@ */ Scalar_UWORD 0 SWC_HALOUT_type_CM_uint16 0 65535 /end CHARACTERISTIC
/begin CHARACTERISTIC DTC_D00203 "" VALUE 0x0000 /* @ECU_Address@DTC_D00203@ */ Scalar_UWORD 0 SWC_HALOUT_type_CM_uint16 0 65535 /end CHARACTERISTIC
/begin CHARACTERISTIC DTC_D00204 "" VALUE 0x0000 /* @ECU_Address@DTC_D00204@ */ Scalar_UWORD 0 SWC_HALOUT_type_CM_uint16 0 65535 /end CHARACTERISTIC
/begin CHARACTERISTIC DTC_D00205 "" VALUE 0x0000 /* @ECU_Address@DTC_D00205@ */ Scalar_UWORD 0 SWC_HALOUT_type_CM_uint16 0 65535 /end CHARACTERISTIC
/begin CHARACTERISTIC DTC_D00206 "" VALUE 0x0000 /* @ECU_Address@DTC_D00206@ */ Scalar_UWORD 0 SWC_HALOUT_type_CM_uint16 0 65535 /end CHARACTERISTIC
/begin CHARACTERISTIC DTC_D00207 "" VALUE 0x0000 /* @ECU_Address@DTC_D00207@ */ Scalar_UWORD 0 SWC_HALOUT_type_CM_uint16 0 65535 /end CHARACTERISTIC
/begin CHARACTERISTIC DTC_D00208 "" VALUE 0x0000 /* @ECU_Address@DTC_D00208@ */ Scalar_UWORD 0 SWC_HALOUT_type_CM_uint16 0 65535 /end CHARACTERISTIC
/begin CHARACTERISTIC DTC_D00209 "" VALUE 0x0000 /* @ECU_Address@DTC_D00209@ */ Scalar_UWORD 0 SWC_HALOUT_type_CM_uint16 0 65535 /end CHARACTERISTIC
/begin CHARACTERISTIC DTC_D0020A "" VALUE 0x0000 /* @ECU_Address@DTC_D0020A@ */ Scalar_UWORD 0 SWC_HALOUT_type_CM_uint16 0 65535 /end CHARACTERISTIC
/begin CHARACTERISTIC DTC_D00228 "" VALUE 0x0000 /* @ECU_Address@DTC_D00228@ */ Scalar_UWORD 0 SWC_HALOUT_type_CM_uint16 0 65535 /end CHARACTERISTIC
/begin CHARACTERISTIC DTC_D00229 "" VALUE 0x0000 /* @ECU_Address@DTC_D00229@ */ Scalar_UWORD 0 SWC_HALOUT_type_CM_uint16 0 65535 /end CHARACTERISTIC
/begin CHARACTERISTIC DTC_D0022A "" VALUE 0x0000 /* @ECU_Address@DTC_D0022A@ */ Scalar_UWORD 0 SWC_HALOUT_type_CM_uint16 0 65535 /end CHARACTERISTIC
/begin CHARACTERISTIC DTC_D0022B "" VALUE 0x0000 /* @ECU_Address@DTC_D0022B@ */ Scalar_UWORD 0 SWC_HALOUT_type_CM_uint16 0 65535 /end CHARACTERISTIC
/begin CHARACTERISTIC DTC_D0022C "" VALUE 0x0000 /* @ECU_Address@DTC_D0022C@ */ Scalar_UWORD 0 SWC_HALOUT_type_CM_uint16 0 65535 /end CHARACTERISTIC
/begin CHARACTERISTIC DTC_D0022D "" VALUE 0x0000 /* @ECU_Address@DTC_D0022D@ */ Scalar_UWORD 0 SWC_HALOUT_type_CM_uint16 0 65535 /end CHARACTERISTIC
/begin CHARACTERISTIC DTC_D00230 "" VALUE 0x0000 /* @ECU_Address@DTC_D00230@ */ Scalar_UWORD 0 SWC_HALOUT_type_CM_uint16 0 65535 /end CHARACTERISTIC
/begin CHARACTERISTIC DTC_D00231 "" VALUE 0x0000 /* @ECU_Address@DTC_D00231@ */ Scalar_UWORD 0 SWC_HALOUT_type_CM_uint16 0 65535 /end CHARACTERISTIC
/begin CHARACTERISTIC DTC_D00232 "" VALUE 0x0000 /* @ECU_Address@DTC_D00232@ */ Scalar_UWORD 0 SWC_HALOUT_type_CM_uint16 0 65535 /end CHARACTERISTIC
/begin CHARACTERISTIC DTC_D00234 "" VALUE 0x0000 /* @ECU_Address@DTC_D00234@ */ Scalar_UWORD 0 SWC_HALOUT_type_CM_uint16 0 65535 /end CHARACTERISTIC
/begin CHARACTERISTIC DTC_D00235 "" VALUE 0x0000 /* @ECU_Address@DTC_D00235@ */ Scalar_UWORD 0 SWC_HALOUT_type_CM_uint16 0 65535 /end CHARACTERISTIC
/begin CHARACTERISTIC DTC_D00236 "" VALUE 0x0000 /* @ECU_Address@DTC_D00236@ */ Scalar_UWORD 0 SWC_HALOUT_type_CM_uint16 0 65535 /end CHARACTERISTIC
/begin CHARACTERISTIC DTC_D00237 "" VALUE 0x0000 /* @ECU_Address@DTC_D00237@ */ Scalar_UWORD 0 SWC_HALOUT_type_CM_uint16 0 65535 /end CHARACTERISTIC
/begin CHARACTERISTIC DTC_D00238 "" VALUE 0x0000 /* @ECU_Address@DTC_D00238@ */ Scalar_UWORD 0 SWC_HALOUT_type_CM_uint16 0 65535 /end CHARACTERISTIC
/begin CHARACTERISTIC DTC_D0023A "" VALUE 0x0000 /* @ECU_Address@DTC_D0023A@ */ Scalar_UWORD 0 SWC_HALOUT_type_CM_uint16 0 65535 /end CHARACTERISTIC
/begin CHARACTERISTIC DTC_D0023B "" VALUE 0x0000 /* @ECU_Address@DTC_D0023B@ */ Scalar_UWORD 0 SWC_HALOUT_type_CM_uint16 0 65535 /end CHARACTERISTIC
/begin CHARACTERISTIC DTC_D0023C "" VALUE 0x0000 /* @ECU_Address@DTC_D0023C@ */ Scalar_UWORD 0 SWC_HALOUT_type_CM_uint16 0 65535 /end CHARACTERISTIC
/begin CHARACTERISTIC DTC_D0023D "" VALUE 0x0000 /* @ECU_Address@DTC_D0023D@ */ Scalar_UWORD 0 SWC_HALOUT_type_CM_uint16 0 65535 /end CHARACTERISTIC
/begin CHARACTERISTIC DTC_D0023E "" VALUE 0x0000 /* @ECU_Address@DTC_D0023E@ */ Scalar_UWORD 0 SWC_HALOUT_type_CM_uint16 0 65535 /end CHARACTERISTIC
/begin CHARACTERISTIC DTC_D00240 "" VALUE 0x0000 /* @ECU_Address@DTC_D00240@ */ Scalar_UWORD 0 SWC_HALOUT_type_CM_uint16 0 65535 /end CHARACTERISTIC
/begin CHARACTERISTIC DTC_D00241 "" VALUE 0x0000 /* @ECU_Address@DTC_D00241@ */ Scalar_UWORD 0 SWC_HALOUT_type_CM_uint16 0 65535 /end CHARACTERISTIC
/begin CHARACTERISTIC KHAL_CAN1FD1APS3E2E_flg "" VALUE 0x0000 /* @ECU_Address@KHAL_CAN1FD1APS3E2E_flg@ */ Scalar_BOOLEAN 0 SWC_HALOUT_type_CM_boolean_flg 0.0 1.0 /end CHARACTERISTIC
/begin CHARACTERISTIC KHAL_CAN1FD1APS3TxReq_flg "" VALUE 0x0000 /* @ECU_Address@KHAL_CAN1FD1APS3TxReq_flg@ */ Scalar_BOOLEAN 0 SWC_HALOUT_type_CM_boolean_flg 0.0 1.0 /end CHARACTERISTIC
/begin CHARACTERISTIC KHAL_CAN1FD1VCU2E2E_flg "" VALUE 0x0000 /* @ECU_Address@KHAL_CAN1FD1VCU2E2E_flg@ */ Scalar_BOOLEAN 0 SWC_HALOUT_type_CM_boolean_flg 0.0 1.0 /end CHARACTERISTIC
/begin CHARACTERISTIC KHAL_CAN1FD1VCU2TxReq_flg "" VALUE 0x0000 /* @ECU_Address@KHAL_CAN1FD1VCU2TxReq_flg@ */ Scalar_BOOLEAN 0 SWC_HALOUT_type_CM_boolean_flg 0.0 1.0 /end CHARACTERISTIC
/begin CHARACTERISTIC KHAL_CAN1FD1VCU3E2E_flg "" VALUE 0x0000 /* @ECU_Address@KHAL_CAN1FD1VCU3E2E_flg@ */ Scalar_BOOLEAN 0 SWC_HALOUT_type_CM_boolean_flg 0.0 1.0 /end CHARACTERISTIC
/begin CHARACTERISTIC KHAL_CAN1FD1VCU3TxReq_flg "" VALUE 0x0000 /* @ECU_Address@KHAL_CAN1FD1VCU3TxReq_flg@ */ Scalar_BOOLEAN 0 SWC_HALOUT_type_CM_boolean_flg 0.0 1.0 /end CHARACTERISTIC
/begin CHARACTERISTIC KHAL_CAN1TxReq_flg "" VALUE 0x0000 /* @ECU_Address@KHAL_CAN1TxReq_flg@ */ Scalar_BOOLEAN 0 SWC_HALOUT_type_CM_boolean_flg 0.0 1.0 /end CHARACTERISTIC
/begin CHARACTERISTIC KHAL_CAN1VMCFCM1E2E_flg "" VALUE 0x0000 /* @ECU_Address@KHAL_CAN1VMCFCM1E2E_flg@ */ Scalar_BOOLEAN 0 SWC_HALOUT_type_CM_boolean_flg 0.0 1.0 /end CHARACTERISTIC
/begin CHARACTERISTIC KHAL_CAN1VMCFCM1TxReq_flg "" VALUE 0x0000 /* @ECU_Address@KHAL_CAN1VMCFCM1TxReq_flg@ */ Scalar_BOOLEAN 0 SWC_HALOUT_type_CM_boolean_flg 0.0 1.0 /end CHARACTERISTIC
/begin CHARACTERISTIC KHAL_CAN2TxReq_flg "" VALUE 0x0000 /* @ECU_Address@KHAL_CAN2TxReq_flg@ */ Scalar_BOOLEAN 0 SWC_HALOUT_type_CM_boolean_flg 0.0 1.0 /end CHARACTERISTIC
/begin CHARACTERISTIC KHAL_CAN3FD3VCU1TxReq_flg "" VALUE 0x0000 /* @ECU_Address@KHAL_CAN3FD3VCU1TxReq_flg@ */ Scalar_BOOLEAN 0 SWC_HALOUT_type_CM_boolean_flg 0.0 1.0 /end CHARACTERISTIC
/begin CHARACTERISTIC KHAL_CAN3FD3VCU1toNIDECTxReq_flg "" VALUE 0x0000 /* @ECU_Address@KHAL_CAN3FD3VCU1toNIDECTxReq_flg@ */ Scalar_BOOLEAN 0 SWC_HALOUT_type_CM_boolean_flg 0.0 1.0 /end CHARACTERISTIC
/begin CHARACTERISTIC KHAL_CAN3FD3VCU2E2E_flg "" VALUE 0x0000 /* @ECU_Address@KHAL_CAN3FD3VCU2E2E_flg@ */ Scalar_BOOLEAN 0 SWC_HALOUT_type_CM_boolean_flg 0.0 1.0 /end CHARACTERISTIC
/begin CHARACTERISTIC KHAL_CAN3FD3VCU2TxReq_flg "" VALUE 0x0000 /* @ECU_Address@KHAL_CAN3FD3VCU2TxReq_flg@ */ Scalar_BOOLEAN 0 SWC_HALOUT_type_CM_boolean_flg 0.0 1.0 /end CHARACTERISTIC
/begin CHARACTERISTIC KHAL_CAN3FD3VCU2toNIDECE2E_flg "" VALUE 0x0000 /* @ECU_Address@KHAL_CAN3FD3VCU2toNIDECE2E_flg@ */ Scalar_BOOLEAN 0 SWC_HALOUT_type_CM_boolean_flg 0.0 1.0 /end CHARACTERISTIC
/begin CHARACTERISTIC KHAL_CAN3FD3VCU2toNIDECTxReq_flg "" VALUE 0x0000 /* @ECU_Address@KHAL_CAN3FD3VCU2toNIDECTxReq_flg@ */ Scalar_BOOLEAN 0 SWC_HALOUT_type_CM_boolean_flg 0.0 1.0 /end CHARACTERISTIC
/begin CHARACTERISTIC KHAL_CAN3TxReq_flg "" VALUE 0x0000 /* @ECU_Address@KHAL_CAN3TxReq_flg@ */ Scalar_BOOLEAN 0 SWC_HALOUT_type_CM_boolean_flg 0.0 1.0 /end CHARACTERISTIC
/begin CHARACTERISTIC KHAL_CAN4FD4CE1000E2E_flg "" VALUE 0x0000 /* @ECU_Address@KHAL_CAN4FD4CE1000E2E_flg@ */ Scalar_BOOLEAN 0 SWC_HALOUT_type_CM_boolean_flg 0.0 1.0 /end CHARACTERISTIC
/begin CHARACTERISTIC KHAL_CAN4FD4CE1000TxReq_flg "" VALUE 0x0000 /* @ECU_Address@KHAL_CAN4FD4CE1000TxReq_flg@ */ Scalar_BOOLEAN 0 SWC_HALOUT_type_CM_boolean_flg 0.0 1.0 /end CHARACTERISTIC
/begin CHARACTERISTIC KHAL_CAN4TxReq_flg "" VALUE 0x0000 /* @ECU_Address@KHAL_CAN4TxReq_flg@ */ Scalar_BOOLEAN 0 SWC_HALOUT_type_CM_boolean_flg 0.0 1.0 /end CHARACTERISTIC
/begin CHARACTERISTIC KHAL_CAN5TxReq_flg "" VALUE 0x0000 /* @ECU_Address@KHAL_CAN5TxReq_flg@ */ Scalar_BOOLEAN 0 SWC_HALOUT_type_CM_boolean_flg 0.0 1.0 /end CHARACTERISTIC
/begin CHARACTERISTIC KHAL_CAN6FD6APS3E2E_flg "" VALUE 0x0000 /* @ECU_Address@KHAL_CAN6FD6APS3E2E_flg@ */ Scalar_BOOLEAN 0 SWC_HALOUT_type_CM_boolean_flg 0.0 1.0 /end CHARACTERISTIC
/begin CHARACTERISTIC KHAL_CAN6FD6APS3TxReq_flg "" VALUE 0x0000 /* @ECU_Address@KHAL_CAN6FD6APS3TxReq_flg@ */ Scalar_BOOLEAN 0 SWC_HALOUT_type_CM_boolean_flg 0.0 1.0 /end CHARACTERISTIC
/begin CHARACTERISTIC KHAL_CAN6FD6VCU2E2E_flg "" VALUE 0x0000 /* @ECU_Address@KHAL_CAN6FD6VCU2E2E_flg@ */ Scalar_BOOLEAN 0 SWC_HALOUT_type_CM_boolean_flg 0.0 1.0 /end CHARACTERISTIC
/begin CHARACTERISTIC KHAL_CAN6FD6VCU2TxReq_flg "" VALUE 0x0000 /* @ECU_Address@KHAL_CAN6FD6VCU2TxReq_flg@ */ Scalar_BOOLEAN 0 SWC_HALOUT_type_CM_boolean_flg 0.0 1.0 /end CHARACTERISTIC
/begin CHARACTERISTIC KHAL_CAN6TxReq_flg "" VALUE 0x0000 /* @ECU_Address@KHAL_CAN6TxReq_flg@ */ Scalar_BOOLEAN 0 SWC_HALOUT_type_CM_boolean_flg 0.0 1.0 /end CHARACTERISTIC
/begin CHARACTERISTIC KHAL_CounterMAXE2E_enum "" VALUE 0x0000 /* @ECU_Address@KHAL_CounterMAXE2E_enum@ */ Scalar_UBYTE 0 SWC_HALOUT_type_CM_uint8_N_per_A 0.0 14.0 /end CHARACTERISTIC
/begin CHARACTERISTIC KHAL_CounterMAX_enum "" VALUE 0x0000 /* @ECU_Address@KHAL_CounterMAX_enum@ */ Scalar_UBYTE 0 SWC_HALOUT_type_CM_uint8_N_per_A 0.0 15.0 /end CHARACTERISTIC
/begin MEASUREMENT VDTC_DTCArray_raw32 "" ULONG SWC_HALOUT_type_CM_uint32 0 0 0 4294967295 /* Array Size */ ARRAY_SIZE 320 ECU_ADDRESS 0x0000 /* @ECU_Address@VDTC_DTCArray_raw32@ */ /end MEASUREMENT
/begin MEASUREMENT VDTC_HeaderArray_raw32 "" ULONG SWC_HALOUT_type_CM_uint32 0 0 0 4294967295 /* Array Size */ ARRAY_SIZE 10 ECU_ADDRESS 0x0000 /* @ECU_Address@VDTC_HeaderArray_raw32@ */ /end MEASUREMENT
/begin MEASUREMENT VHAL_TriggerDTC_flg "" UBYTE SWC_HALOUT_type_CM_boolean_flg 0 0 0.0 1.0 ECU_ADDRESS 0x0000 /* @ECU_Address@VHAL_TriggerDTC_flg@ */ /end MEASUREMENT
/begin COMPU_METHOD SWC_HALOUT_type_CM_uint16 "Q = V" RAT_FUNC "%5.0" "" COEFFS 0 1 0 0 0 1 /end COMPU_METHOD
/begin COMPU_METHOD SWC_HALOUT_type_CM_boolean_flg "Q = V" RAT_FUNC "%1.0" "flg" COEFFS 0 1 0 0 0 1 /end COMPU_METHOD
/begin COMPU_METHOD SWC_HALOUT_type_CM_uint8_N_per_A "Q = V" RAT_FUNC "%3.0" "N/A" COEFFS 0 1 0 0 0 1 /end COMPU_METHOD
/begin COMPU_METHOD SWC_HALOUT_type_CM_uint32 "Q = V" RAT_FUNC "%10.0" "" COEFFS 0 1 0 0 0 1 /end COMPU_METHOD
/begin GROUP SWC_HALOUT_type "SWC_HALOUT_type" /* Root */ ROOT /begin SUB_GROUP Root_run_SWC_HALOUT_Tx_5ms_sys /end SUB_GROUP /end GROUP
/begin GROUP Root_run_SWC_HALOUT_Tx_5ms_sys "SWC_HALOUT_type/run_SWC_HALOUT_Tx_5ms_sys" /begin SUB_GROUP S14_HAL_OUT S14_OUTP_AFTER /end SUB_GROUP /end GROUP
/begin GROUP S14_HAL_OUT "SWC_HALOUT_type/run_SWC_HALOUT_Tx_5ms_sys/HAL_OUT" /begin SUB_GROUP S20_CAN1 S20_CAN3 S20_CAN4 S20_CAN6 /end SUB_GROUP
 /begin REF_CHARACTERISTIC KHAL_CAN1TxReq_flg KHAL_CAN2TxReq_flg KHAL_CAN3TxReq_flg KHAL_CAN4TxReq_flg KHAL_CAN5TxReq_flg KHAL_CAN6TxReq_flg /end REF_CHARACTERISTIC
/end GROUP
/begin GROUP S14_OUTP_AFTER "SWC_HALOUT_type/run_SWC_HALOUT_Tx_5ms_sys/OUTP_AFTER" /begin SUB_GROUP S21_DTC_list /end SUB_GROUP /end GROUP
/begin GROUP S20_CAN1 "SWC_HALOUT_type/run_SWC_HALOUT_Tx_5ms_sys/HAL_OUT/CAN1"
 /begin SUB_GROUP S40_FD1_APS3_0x238 S40_FD1_VCU2_0x154 S40_FD1_VCU3_0x159 S40_VMC_FCM1_0x172 /end SUB_GROUP
 /begin REF_CHARACTERISTIC KHAL_CAN1FD1APS3TxReq_flg KHAL_CAN1FD1VCU2TxReq_flg KHAL_CAN1FD1VCU3TxReq_flg KHAL_CAN1VMCFCM1TxReq_flg /end REF_CHARACTERISTIC
/end GROUP
/begin GROUP S20_CAN3 "SWC_HALOUT_type/run_SWC_HALOUT_Tx_5ms_sys/HAL_OUT/CAN3" /begin SUB_GROUP S42_FD3_VCU2_0x153 S42_FD3_VCU2_toNIDEC_0x154 /end SUB_GROUP
 /begin REF_CHARACTERISTIC KHAL_CAN3FD3VCU1TxReq_flg KHAL_CAN3FD3VCU1toNIDECTxReq_flg KHAL_CAN3FD3VCU2TxReq_flg KHAL_CAN3FD3VCU2toNIDECTxReq_flg /end REF_CHARACTERISTIC
/end GROUP
/begin GROUP S20_CAN4 "SWC_HALOUT_type/run_SWC_HALOUT_Tx_5ms_sys/HAL_OUT/CAN4" /begin SUB_GROUP S43_FD4_CE100_0_0x116 /end SUB_GROUP /begin REF_CHARACTERISTIC KHAL_CAN4FD4CE1000TxReq_flg /end REF_CHARACTERISTIC /end GROUP
/begin GROUP S20_CAN6 "SWC_HALOUT_type/run_SWC_HALOUT_Tx_5ms_sys/HAL_OUT/CAN6" /begin SUB_GROUP S45_FD6_APS3_0x238 S45_FD6_VCU2_0x154 /end SUB_GROUP /begin REF_CHARACTERISTIC KHAL_CAN6FD6APS3TxReq_flg KHAL_CAN6FD6VCU2TxReq_flg /end REF_CHARACTERISTIC /end GROUP
/begin GROUP S21_DTC_list "SWC_HALOUT_type/run_SWC_HALOUT_Tx_5ms_sys/OUTP_AFTER/DTC_list"
 /begin REF_CHARACTERISTIC DTC_10020B DTC_10020C DTC_10020D DTC_10020E DTC_100210 DTC_100211 DTC_100212 DTC_100213 DTC_100214 DTC_100215 DTC_100216 DTC_100217 DTC_100218 DTC_100219 DTC_10021A DTC_10021B DTC_10021C DTC_10021D DTC_10021E DTC_100220 DTC_100221 DTC_100223 DTC_100224 DTC_100225 DTC_100226 DTC_100227 DTC_100242 DTC_100243 DTC_100244 DTC_100247 DTC_100248 DTC_100249 DTC_100250 DTC_100251 DTC_100252 DTC_100A10 DTC_100A12 DTC_100A16 DTC_100A17 DTC_100A18 DTC_100A19 DTC_500B01 DTC_500B02 DTC_500B03 DTC_500B04 DTC_500B05 DTC_500B06 DTC_500B07 DTC_500B08 DTC_500B09 DTC_500B0A DTC_500B0B DTC_500B0C DTC_500B0D DTC_500B0E DTC_500B0F DTC_500B10 DTC_90021F DTC_90022F DTC_900253 DTC_900254 DTC_900301 DTC_900302 DTC_900303 DTC_900304 DTC_900305 DTC_900909 DTC_90090A DTC_90090B DTC_90090C DTC_90090D DTC_90090E DTC_90090F DTC_900910 DTC_900911 DTC_900912 DTC_900913 DTC_900914 DTC_C0288F DTC_C0378F DTC_C0468F DTC_C0558F DTC_C0648F DTC_C0808F DTC_D00201 DTC_D00202 DTC_D00203 DTC_D00204 DTC_D00205 DTC_D00206 DTC_D00207 DTC_D00208 DTC_D00209 DTC_D0020A DTC_D00228 DTC_D00229 DTC_D0022A DTC_D0022B DTC_D0022C DTC_D0022D DTC_D00230 DTC_D00231 DTC_D00232 DTC_D00234 DTC_D00235 DTC_D00236 DTC_D00237 DTC_D00238 DTC_D0023A DTC_D0023B DTC_D0023C DTC_D0023D DTC_D0023E DTC_D00240 DTC_D00241 /end REF_CHARACTERISTIC
 /begin REF_MEASUREMENT VDTC_DTCArray_raw32 VDTC_HeaderArray_raw32 VHAL_TriggerDTC_flg /end REF_MEASUREMENT
/end GROUP
/begin GROUP S40_FD1_APS3_0x238 "SWC_HALOUT_type/run_SWC_HALOUT_Tx_5ms_sys/HAL_OUT/CAN1/FD1_APS3_0x238" /begin SUB_GROUP S48_RollingCounter_IfAction S48_RollingCounter_IfAction1 /end SUB_GROUP /begin REF_CHARACTERISTIC KHAL_CAN1FD1APS3E2E_flg /end REF_CHARACTERISTIC /end GROUP
/begin GROUP S40_FD1_VCU2_0x154 "SWC_HALOUT_type/run_SWC_HALOUT_Tx_5ms_sys/HAL_OUT/CAN1/FD1_VCU2_0x154" /begin SUB_GROUP S53_RollingCounter_IfAction S53_RollingCounter_IfAction1 /end SUB_GROUP /begin REF_CHARACTERISTIC KHAL_CAN1FD1VCU2E2E_flg /end REF_CHARACTERISTIC /end GROUP
/begin GROUP S40_FD1_VCU3_0x159 "SWC_HALOUT_type/run_SWC_HALOUT_Tx_5ms_sys/HAL_OUT/CAN1/FD1_VCU3_0x159" /begin SUB_GROUP S55_RollingCounter_IfAction S55_RollingCounter_IfAction1 /end SUB_GROUP /begin REF_CHARACTERISTIC KHAL_CAN1FD1VCU3E2E_flg /end REF_CHARACTERISTIC /end GROUP
/begin GROUP S40_VMC_FCM1_0x172 "SWC_HALOUT_type/run_SWC_HALOUT_Tx_5ms_sys/HAL_OUT/CAN1/VMC_FCM1_0x172" /begin SUB_GROUP S59_RollingCounter_IfAction S59_RollingCounter_IfAction1 /end SUB_GROUP /begin REF_CHARACTERISTIC KHAL_CAN1VMCFCM1E2E_flg /end REF_CHARACTERISTIC /end GROUP
/begin GROUP S42_FD3_VCU2_0x153 "SWC_HALOUT_type/run_SWC_HALOUT_Tx_5ms_sys/HAL_OUT/CAN3/FD3_VCU2_0x153" /begin SUB_GROUP S973_RollingCounter_IfAction S973_RollingCounter_IfAction1 /end SUB_GROUP /begin REF_CHARACTERISTIC KHAL_CAN3FD3VCU2E2E_flg /end REF_CHARACTERISTIC /end GROUP
/begin GROUP S42_FD3_VCU2_toNIDEC_0x154 "SWC_HALOUT_type/run_SWC_HALOUT_Tx_5ms_sys/HAL_OUT/CAN3/FD3_VCU2_toNIDEC_0x154" /begin SUB_GROUP S975_RollingCounter_IfAction S975_RollingCounter_IfAction1 /end SUB_GROUP /begin REF_CHARACTERISTIC KHAL_CAN3FD3VCU2toNIDECE2E_flg /end REF_CHARACTERISTIC /end GROUP
/begin GROUP S43_FD4_CE100_0_0x116 "SWC_HALOUT_type/run_SWC_HALOUT_Tx_5ms_sys/HAL_OUT/CAN4/FD4_CE100_0_0x116"
 /begin SUB_GROUP S1451_RollingCounter_IfAction S1451_RollingCounter_IfAction1 /end SUB_GROUP
 /begin REF_CHARACTERISTIC KHAL_CAN4FD4CE1000E2E_flg /end REF_CHARACTERISTIC
/end GROUP
/begin GROUP S45_FD6_APS3_0x238 "SWC_HALOUT_type/run_SWC_HALOUT_Tx_5ms_sys/HAL_OUT/CAN6/FD6_APS3_0x238"
 /begin SUB_GROUP S2006_RollingCounter_IfAction S2006_RollingCounter_IfAction1 /end SUB_GROUP
 /begin REF_CHARACTERISTIC KHAL_CAN6FD6APS3E2E_flg /end REF_CHARACTERISTIC
/end GROUP
/begin GROUP S45_FD6_VCU2_0x154 "SWC_HALOUT_type/run_SWC_HALOUT_Tx_5ms_sys/HAL_OUT/CAN6/FD6_VCU2_0x154"
 /begin SUB_GROUP S2010_RollingCounter_IfAction S2010_RollingCounter_IfAction1 /end SUB_GROUP
 /begin REF_CHARACTERISTIC KHAL_CAN6FD6VCU2E2E_flg /end REF_CHARACTERISTIC
/end GROUP
/begin GROUP S48_RollingCounter_IfAction "SWC_HALOUT_type/run_SWC_HALOUT_Tx_5ms_sys/HAL_OUT/CAN1/FD1_APS3_0x238/RollingCounter_IfAction" /begin REF_CHARACTERISTIC KHAL_CounterMAXE2E_enum KHAL_CounterMAX_enum /end REF_CHARACTERISTIC /end GROUP
/begin GROUP S48_RollingCounter_IfAction1 "SWC_HALOUT_type/run_SWC_HALOUT_Tx_5ms_sys/HAL_OUT/CAN1/FD1_APS3_0x238/RollingCounter_IfAction1" /begin REF_CHARACTERISTIC KHAL_CounterMAXE2E_enum KHAL_CounterMAX_enum /end REF_CHARACTERISTIC /end GROUP
/begin GROUP S53_RollingCounter_IfAction "SWC_HALOUT_type/run_SWC_HALOUT_Tx_5ms_sys/HAL_OUT/CAN1/FD1_VCU2_0x154/RollingCounter_IfAction" /begin REF_CHARACTERISTIC KHAL_CounterMAXE2E_enum KHAL_CounterMAX_enum /end REF_CHARACTERISTIC /end GROUP
/begin GROUP S53_RollingCounter_IfAction1 "SWC_HALOUT_type/run_SWC_HALOUT_Tx_5ms_sys/HAL_OUT/CAN1/FD1_VCU2_0x154/RollingCounter_IfAction1" /begin REF_CHARACTERISTIC KHAL_CounterMAXE2E_enum KHAL_CounterMAX_enum /end REF_CHARACTERISTIC /end GROUP
/begin GROUP S55_RollingCounter_IfAction "SWC_HALOUT_type/run_SWC_HALOUT_Tx_5ms_sys/HAL_OUT/CAN1/FD1_VCU3_0x159/RollingCounter_IfAction" /begin REF_CHARACTERISTIC KHAL_CounterMAXE2E_enum KHAL_CounterMAX_enum /end REF_CHARACTERISTIC /end GROUP
/begin GROUP S55_RollingCounter_IfAction1 "SWC_HALOUT_type/run_SWC_HALOUT_Tx_5ms_sys/HAL_OUT/CAN1/FD1_VCU3_0x159/RollingCounter_IfAction1" /begin REF_CHARACTERISTIC KHAL_CounterMAXE2E_enum KHAL_CounterMAX_enum /end REF_CHARACTERISTIC /end GROUP
/begin GROUP S59_RollingCounter_IfAction "SWC_HALOUT_type/run_SWC_HALOUT_Tx_5ms_sys/HAL_OUT/CAN1/VMC_FCM1_0x172/RollingCounter_IfAction" /begin REF_CHARACTERISTIC KHAL_CounterMAXE2E_enum KHAL_CounterMAX_enum /end REF_CHARACTERISTIC /end GROUP
/begin GROUP S59_RollingCounter_IfAction1 "SWC_HALOUT_type/run_SWC_HALOUT_Tx_5ms_sys/HAL_OUT/CAN1/VMC_FCM1_0x172/RollingCounter_IfAction1" /begin REF_CHARACTERISTIC KHAL_CounterMAXE2E_enum KHAL_CounterMAX_enum /end REF_CHARACTERISTIC /end GROUP
/begin GROUP S973_RollingCounter_IfAction "SWC_HALOUT_type/run_SWC_HALOUT_Tx_5ms_sys/HAL_OUT/CAN3/FD3_VCU2_0x153/RollingCounter_IfAction" /begin REF_CHARACTERISTIC KHAL_CounterMAXE2E_enum KHAL_CounterMAX_enum /end REF_CHARACTERISTIC /end GROUP
/begin GROUP S973_RollingCounter_IfAction1 "SWC_HALOUT_type/run_SWC_HALOUT_Tx_5ms_sys/HAL_OUT/CAN3/FD3_VCU2_0x153/RollingCounter_IfAction1" /begin REF_CHARACTERISTIC KHAL_CounterMAXE2E_enum KHAL_CounterMAX_enum /end REF_CHARACTERISTIC /end GROUP
/begin GROUP S975_RollingCounter_IfAction "SWC_HALOUT_type/run_SWC_HALOUT_Tx_5ms_sys/HAL_OUT/CAN3/FD3_VCU2_toNIDEC_0x154/RollingCounter_IfAction" /begin REF_CHARACTERISTIC KHAL_CounterMAXE2E_enum KHAL_CounterMAX_enum /end REF_CHARACTERISTIC /end GROUP
/begin GROUP S975_RollingCounter_IfAction1 "SWC_HALOUT_type/run_SWC_HALOUT_Tx_5ms_sys/HAL_OUT/CAN3/FD3_VCU2_toNIDEC_0x154/RollingCounter_IfAction1" /begin REF_CHARACTERISTIC KHAL_CounterMAXE2E_enum KHAL_CounterMAX_enum /end REF_CHARACTERISTIC /end GROUP
/begin GROUP S1451_RollingCounter_IfAction "SWC_HALOUT_type/run_SWC_HALOUT_Tx_5ms_sys/HAL_OUT/CAN4/FD4_CE100_0_0x116/RollingCounter_IfAction" /begin REF_CHARACTERISTIC KHAL_CounterMAXE2E_enum KHAL_CounterMAX_enum /end REF_CHARACTERISTIC /end GROUP
/begin GROUP S1451_RollingCounter_IfAction1 "SWC_HALOUT_type/run_SWC_HALOUT_Tx_5ms_sys/HAL_OUT/CAN4/FD4_CE100_0_0x116/RollingCounter_IfAction1" /begin REF_CHARACTERISTIC KHAL_CounterMAXE2E_enum KHAL_CounterMAX_enum /end REF_CHARACTERISTIC /end GROUP
/begin GROUP S2006_RollingCounter_IfAction "SWC_HALOUT_type/run_SWC_HALOUT_Tx_5ms_sys/HAL_OUT/CAN6/FD6_APS3_0x238/RollingCounter_IfAction" /begin REF_CHARACTERISTIC KHAL_CounterMAXE2E_enum KHAL_CounterMAX_enum /end REF_CHARACTERISTIC /end GROUP
/begin GROUP S2006_RollingCounter_IfAction1 "SWC_HALOUT_type/run_SWC_HALOUT_Tx_5ms_sys/HAL_OUT/CAN6/FD6_APS3_0x238/RollingCounter_IfAction1" /begin REF_CHARACTERISTIC KHAL_CounterMAXE2E_enum KHAL_CounterMAX_enum /end REF_CHARACTERISTIC /end GROUP
/begin GROUP S2010_RollingCounter_IfAction "SWC_HALOUT_type/run_SWC_HALOUT_Tx_5ms_sys/HAL_OUT/CAN6/FD6_VCU2_0x154/RollingCounter_IfAction" /begin REF_CHARACTERISTIC KHAL_CounterMAXE2E_enum KHAL_CounterMAX_enum /end REF_CHARACTERISTIC /end GROUP
/begin GROUP S2010_RollingCounter_IfAction1 "SWC_HALOUT_type/run_SWC_HALOUT_Tx_5ms_sys/HAL_OUT/CAN6/FD6_VCU2_0x154/RollingCounter_IfAction1" /begin REF_CHARACTERISTIC KHAL_CounterMAXE2E_enum KHAL_CounterMAX_enum /end REF_CHARACTERISTIC /end GROUP
/end MODULE
/end PROJECT
/* (add any file trailer comments here) */
/* EOF SWC_HALOUT_type.a2l */
