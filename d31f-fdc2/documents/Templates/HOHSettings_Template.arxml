AUTOSAR XML (schema 4-3-0)
HOH_11_CAN1 (CanHardwareObject):
  CanHandleType = BASIC
  CanHardwareObjectUsesPolling = 0
  CanHwObjectCount = 12
  CanIdType = STANDARD
  CanObjectType = RECEIVE
  CanObjectId = 69
  CanControllerRef = CAN1
  CanAdvancedFeature: CanAdvancedFeatureRef=AF_Host
  CanHwFilter: CanHwFilterCode=0, CanHwFilterMask=0
  RangeFilter: RangeEnd=1408, RangeStart=1281
