/******************************************************************************
* ASAP2 file: SWC_OUTP_type.a2l
* Code generation for model "SWC_OUTP_type".
* Model version : 1.8
* Simulink Coder version : 9.6 (R2021b) 14-May-2021
* C source code generated on : Tue May 27 09:42:31 2025
* Target selection: autosar.tlc
* Embedded hardware selection: ARM Compatible->ARM Cortex-M
* Code generation objectives: Unspecified
* Validation result: Not run
* (add additional file header information here)
******************************************************************************/
/* Version 1.31 */
ASAP2_VERSION 1 31
/begin PROJECT ProjectName "Project Comment Goes Here"
/begin HEADER "Header Comments go here" /end HEADER
/begin MODULE ModuleName "Module Comment Goes Here"
/begin MOD_PAR "MOD PAR Comment Goes Here" /end MOD_PAR
/begin MOD_COMMON "Mod Common Comment Here" BYTE_ORDER MSB_LAST /end MOD_COMMON
/begin MEASUREMENT VOUTP_RESSTIMESOCOFFRNGL_s "" ULONG SWC_OUTP_type_CM_uint32 0 0 0 4294967295 ARRAY_SIZE 8 ECU_ADDRESS 0x0000 /* @ECU_Address@VOUTP_RESSTIMESOCOFFRNGL_s@ */ /end MEASUREMENT
/begin MEASUREMENT VOUTP_RESSTIMESOCOFFRNGR_s "" ULONG SWC_OUTP_type_CM_uint32 0 0 0 4294967295 ARRAY_SIZE 8 ECU_ADDRESS 0x0000 /* @ECU_Address@VOUTP_RESSTIMESOCOFFRNGR_s@ */ /end MEASUREMENT
/begin MEASUREMENT VOUTP_RESSTIMESOCCHGRNGL_s "" ULONG SWC_OUTP_type_CM_uint32 0 0 0 4294967295 ARRAY_SIZE 8 ECU_ADDRESS 0x0000 /* @ECU_Address@VOUTP_RESSTIMESOCCHGRNGL_s@ */ /end MEASUREMENT
/begin MEASUREMENT VOUTP_RESSTIMESOCCHGRNGR_s "" ULONG SWC_OUTP_type_CM_uint32 0 0 0 4294967295 ARRAY_SIZE 8 ECU_ADDRESS 0x0000 /* @ECU_Address@VOUTP_RESSTIMESOCCHGRNGR_s@ */ /end MEASUREMENT
/begin MEASUREMENT VOUTP_RESSTIMESOCPSARNGL_s "" ULONG SWC_OUTP_type_CM_uint32 0 0 0 4294967295 ARRAY_SIZE 8 ECU_ADDRESS 0x0000 /* @ECU_Address@VOUTP_RESSTIMESOCPSARNGL_s@ */ /end MEASUREMENT
/begin MEASUREMENT VOUTP_RESSTIMESOCPSARNGR_s "" ULONG SWC_OUTP_type_CM_uint32 0 0 0 4294967295 ARRAY_SIZE 8 ECU_ADDRESS 0x0000 /* @ECU_Address@VOUTP_RESSTIMESOCPSARNGR_s@ */ /end MEASUREMENT
/begin MEASUREMENT VOUTP_C3BMS6RCDTC_raw32 "" ULONG SWC_OUTP_type_CM_uint32_raw32 0 0 0.0 4.294967295E+9 ECU_ADDRESS 0x0000 /* @ECU_Address@VOUTP_C3BMS6RCDTC_raw32@ */ /end MEASUREMENT
/begin MEASUREMENT VOUTP_C3BMS6CSDTC_raw32 "" ULONG SWC_OUTP_type_CM_uint32_raw32 0 0 0.0 4.294967295E+9 ECU_ADDRESS 0x0000 /* @ECU_Address@VOUTP_C3BMS6CSDTC_raw32@ */ /end MEASUREMENT
/begin MEASUREMENT VOUTP_C3BMS6LCDTC_raw32 "" ULONG SWC_OUTP_type_CM_uint32_raw32 0 0 0.0 4.294967295E+9 ECU_ADDRESS 0x0000 /* @ECU_Address@VOUTP_C3BMS6LCDTC_raw32@ */ /end MEASUREMENT
/begin MEASUREMENT VOUTP_C3BMS1RCDTC_raw32 "" ULONG SWC_OUTP_type_CM_uint32_raw32 0 0 0.0 4.294967295E+9 ECU_ADDRESS 0x0000 /* @ECU_Address@VOUTP_C3BMS1RCDTC_raw32@ */ /end MEASUREMENT
/begin MEASUREMENT VOUTP_C3BMS1CSDTC_raw32 "" ULONG SWC_OUTP_type_CM_uint32_raw32 0 0 0.0 4.294967295E+9 ECU_ADDRESS 0x0000 /* @ECU_Address@VOUTP_C3BMS1CSDTC_raw32@ */ /end MEASUREMENT
/begin MEASUREMENT VOUTP_C3BMS1LCDTC_raw32 "" ULONG SWC_OUTP_type_CM_uint32_raw32 0 0 0.0 4.294967295E+9 ECU_ADDRESS 0x0000 /* @ECU_Address@VOUTP_C3BMS1LCDTC_raw32@ */ /end MEASUREMENT
/begin MEASUREMENT VOUTP_C3CCU1RCDTC_raw32 "" ULONG SWC_OUTP_type_CM_uint32_raw32 0 0 0.0 4.294967295E+9 ECU_ADDRESS 0x0000 /* @ECU_Address@VOUTP_C3CCU1RCDTC_raw32@ */ /end MEASUREMENT
/begin MEASUREMENT VOUTP_C3CCU1CSDTC_raw32 "" ULONG SWC_OUTP_type_CM_uint32_raw32 0 0 0.0 4.294967295E+9 ECU_ADDRESS 0x0000 /* @ECU_Address@VOUTP_C3CCU1CSDTC_raw32@ */ /end MEASUREMENT
/begin MEASUREMENT VOUTP_C3CCU1LCDTC_raw32 "" ULONG SWC_OUTP_type_CM_uint32_raw32 0 0 0.0 4.294967295E+9 ECU_ADDRESS 0x0000 /* @ECU_Address@VOUTP_C3CCU1LCDTC_raw32@ */ /end MEASUREMENT
/begin MEASUREMENT VOUTP_C3CCU2RCDTC_raw32 "" ULONG SWC_OUTP_type_CM_uint32_raw32 0 0 0.0 4.294967295E+9 ECU_ADDRESS 0x0000 /* @ECU_Address@VOUTP_C3CCU2RCDTC_raw32@ */ /end MEASUREMENT
/begin MEASUREMENT VOUTP_C3CCU2CSDTC_raw32 "" ULONG SWC_OUTP_type_CM_uint32_raw32 0 0 0.0 4.294967295E+9 ECU_ADDRESS 0x0000 /* @ECU_Address@VOUTP_C3CCU2CSDTC_raw32@ */ /end MEASUREMENT
/begin MEASUREMENT VOUTP_C3CCU2LCDTC_raw32 "" ULONG SWC_OUTP_type_CM_uint32_raw32 0 0 0.0 4.294967295E+9 ECU_ADDRESS 0x0000 /* @ECU_Address@VOUTP_C3CCU2LCDTC_raw32@ */ /end MEASUREMENT
/begin MEASUREMENT VOUTP_C1ABM1RCDTC_raw32 "" ULONG SWC_OUTP_type_CM_uint32_raw32 0 0 0.0 4.294967295E+9 ECU_ADDRESS 0x0000 /* @ECU_Address@VOUTP_C1ABM1RCDTC_raw32@ */ /end MEASUREMENT
/begin MEASUREMENT VOUTP_C1ABM1CSDTC_raw32 "" ULONG SWC_OUTP_type_CM_uint32_raw32 0 0 0.0 4.294967295E+9 ECU_ADDRESS 0x0000 /* @ECU_Address@VOUTP_C1ABM1CSDTC_raw32@ */ /end MEASUREMENT
/begin MEASUREMENT VOUTP_C1ABM1LCDTC_raw32 "" ULONG SWC_OUTP_type_CM_uint32_raw32 0 0 0.0 4.294967295E+9 ECU_ADDRESS 0x0000 /* @ECU_Address@VOUTP_C1ABM1LCDTC_raw32@ */ /end MEASUREMENT
/begin MEASUREMENT VOUTP_Lv1ErrDTC_raw32 "" ULONG SWC_OUTP_type_CM_uint32_raw32 0 0 0.0 4.294967295E+9 ECU_ADDRESS 0x0000 /* @ECU_Address@VOUTP_Lv1ErrDTC_raw32@ */ /end MEASUREMENT
/begin MEASUREMENT VOUTP_Lv2ErrDTC_raw32 "" ULONG SWC_OUTP_type_CM_uint32_raw32 0 0 0.0 4.294967295E+9 ECU_ADDRESS 0x0000 /* @ECU_Address@VOUTP_Lv2ErrDTC_raw32@ */ /end MEASUREMENT
/begin MEASUREMENT VOUTP_Lv3ErrDTC_raw32 "" ULONG SWC_OUTP_type_CM_uint32_raw32 0 0 0.0 4.294967295E+9 ECU_ADDRESS 0x0000 /* @ECU_Address@VOUTP_Lv3ErrDTC_raw32@ */ /end MEASUREMENT
/begin MEASUREMENT VOUTP_Lv4ErrDTC_raw32 "" ULONG SWC_OUTP_type_CM_uint32_raw32 0 0 0.0 4.294967295E+9 ECU_ADDRESS 0x0000 /* @ECU_Address@VOUTP_Lv4ErrDTC_raw32@ */ /end MEASUREMENT
/begin MEASUREMENT VOUTP_BrkSWErrDTC_raw32 "" ULONG SWC_OUTP_type_CM_uint32_raw32 0 0 0.0 4.294967295E+9 ECU_ADDRESS 0x0000 /* @ECU_Address@VOUTP_BrkSWErrDTC_raw32@ */ /end MEASUREMENT
/begin MEASUREMENT VOUTP_BrkSWNoBacDTC_raw32 "" ULONG SWC_OUTP_type_CM_uint32_raw32 0 0 0.0 4.294967295E+9 ECU_ADDRESS 0x0000 /* @ECU_Address@VOUTP_BrkSWNoBacDTC_raw32@ */ /end MEASUREMENT
/begin MEASUREMENT VOUTP_KeyAuthDTC_raw32 "" ULONG SWC_OUTP_type_CM_uint32_raw32 0 0 0.0 4.294967295E+9 ECU_ADDRESS 0x0000 /* @ECU_Address@VOUTP_KeyAuthDTC_raw32@ */ /end MEASUREMENT
/begin MEASUREMENT VOUTP_ONtoRdyDTC_raw32 "" ULONG SWC_OUTP_type_CM_uint32_raw32 0 0 0.0 4.294967295E+9 ECU_ADDRESS 0x0000 /* @ECU_Address@VOUTP_ONtoRdyDTC_raw32@ */ /end MEASUREMENT
/begin MEASUREMENT VOUTP_HVB4PreDTC_raw32 "" ULONG SWC_OUTP_type_CM_uint32_raw32 0 0 0.0 4.294967295E+9 ECU_ADDRESS 0x0000 /* @ECU_Address@VOUTP_HVB4PreDTC_raw32@ */ /end MEASUREMENT
/begin MEASUREMENT VOUTP_MCU4PreDTC_raw32 "" ULONG SWC_OUTP_type_CM_uint32_raw32 0 0 0.0 4.294967295E+9 ECU_ADDRESS 0x0000 /* @ECU_Address@VOUTP_MCU4PreDTC_raw32@ */ /end MEASUREMENT
/begin MEASUREMENT VOUTP_DCDC4PreDTC_raw32 "" ULONG SWC_OUTP_type_CM_uint32_raw32 0 0 0.0 4.294967295E+9 ECU_ADDRESS 0x0000 /* @ECU_Address@VOUTP_DCDC4PreDTC_raw32@ */ /end MEASUREMENT
/begin MEASUREMENT VOUTP_HVRlyCloDTC_raw32 "" ULONG SWC_OUTP_type_CM_uint32_raw32 0 0 0.0 4.294967295E+9 ECU_ADDRESS 0x0000 /* @ECU_Address@VOUTP_HVRlyCloDTC_raw32@ */ /end MEASUREMENT
/begin MEASUREMENT VOUTP_BMSRdyDTC_raw32 "" ULONG SWC_OUTP_type_CM_uint32_raw32 0 0 0.0 4.294967295E+9 ECU_ADDRESS 0x0000 /* @ECU_Address@VOUTP_BMSRdyDTC_raw32@ */ /end MEASUREMENT
/begin MEASUREMENT VOUTP_DCDCEnaDTC_raw32 "" ULONG SWC_OUTP_type_CM_uint32_raw32 0 0 0.0 4.294967295E+9 ECU_ADDRESS 0x0000 /* @ECU_Address@VOUTP_DCDCEnaDTC_raw32@ */ /end MEASUREMENT
/begin MEASUREMENT VOUTP_HiLvSaChkDTC_raw32 "" ULONG SWC_OUTP_type_CM_uint32_raw32 0 0 0.0 4.294967295E+9 ECU_ADDRESS 0x0000 /* @ECU_Address@VOUTP_HiLvSaChkDTC_raw32@ */ /end MEASUREMENT
/begin MEASUREMENT VOUTP_MidLvSaChkDTC_raw32 "" ULONG SWC_OUTP_type_CM_uint32_raw32 0 0 0.0 4.294967295E+9 ECU_ADDRESS 0x0000 /* @ECU_Address@VOUTP_MidLvSaChkDTC_raw32@ */ /end MEASUREMENT
/begin MEASUREMENT VOUTP_MCUDisDTC_raw32 "" ULONG SWC_OUTP_type_CM_uint32_raw32 0 0 0.0 4.294967295E+9 ECU_ADDRESS 0x0000 /* @ECU_Address@VOUTP_MCUDisDTC_raw32@ */ /end MEASUREMENT
/begin MEASUREMENT VOUTP_DCDCDisDTC_raw32 "" ULONG SWC_OUTP_type_CM_uint32_raw32 0 0 0.0 4.294967295E+9 ECU_ADDRESS 0x0000 /* @ECU_Address@VOUTP_DCDCDisDTC_raw32@ */ /end MEASUREMENT
/begin MEASUREMENT VOUTP_HVRlyOpDTC_raw32 "" ULONG SWC_OUTP_type_CM_uint32_raw32 0 0 0.0 4.294967295E+9 ECU_ADDRESS 0x0000 /* @ECU_Address@VOUTP_HVRlyOpDTC_raw32@ */ /end MEASUREMENT
/begin MEASUREMENT VOUTP_MCUActDTC_raw32 "" ULONG SWC_OUTP_type_CM_uint32_raw32 0 0 0.0 4.294967295E+9 ECU_ADDRESS 0x0000 /* @ECU_Address@VOUTP_MCUActDTC_raw32@ */ /end MEASUREMENT
/begin MEASUREMENT VOUTP_OBC4PreDTC_raw32 "" ULONG SWC_OUTP_type_CM_uint32_raw32 0 0 0.0 4.294967295E+9 ECU_ADDRESS 0x0000 /* @ECU_Address@VOUTP_OBC4PreDTC_raw32@ */ /end MEASUREMENT
/begin MEASUREMENT VOUTP_IniLVLoDTC_raw32 "" ULONG SWC_OUTP_type_CM_uint32_raw32 0 0 0.0 4.294967295E+9 ECU_ADDRESS 0x0000 /* @ECU_Address@VOUTP_IniLVLoDTC_raw32@ */ /end MEASUREMENT
/begin MEASUREMENT VOUTP_LVSupLoDTC_raw32 "" ULONG SWC_OUTP_type_CM_uint32_raw32 0 0 0.0 4.294967295E+9 ECU_ADDRESS 0x0000 /* @ECU_Address@VOUTP_LVSupLoDTC_raw32@ */ /end MEASUREMENT
/begin MEASUREMENT VOUTP_LVSupHiDTC_raw32 "" ULONG SWC_OUTP_type_CM_uint32_raw32 0 0 0.0 4.294967295E+9 ECU_ADDRESS 0x0000 /* @ECU_Address@VOUTP_LVSupHiDTC_raw32@ */ /end MEASUREMENT
/begin MEASUREMENT VOUTP_DrStSWDTC_raw32 "" ULONG SWC_OUTP_type_CM_uint32_raw32 0 0 0.0 4.294967295E+9 ECU_ADDRESS 0x0000 /* @ECU_Address@VOUTP_DrStSWDTC_raw32@ */ /end MEASUREMENT
/begin MEASUREMENT VOUTP_FLDoorSWDTC_raw32 "" ULONG SWC_OUTP_type_CM_uint32_raw32 0 0 0.0 4.294967295E+9 ECU_ADDRESS 0x0000 /* @ECU_Address@VOUTP_FLDoorSWDTC_raw32@ */ /end MEASUREMENT
/begin MEASUREMENT VOUTP_FRDoorSWDTC_raw32 "" ULONG SWC_OUTP_type_CM_uint32_raw32 0 0 0.0 4.294967295E+9 ECU_ADDRESS 0x0000 /* @ECU_Address@VOUTP_FRDoorSWDTC_raw32@ */ /end MEASUREMENT
/begin MEASUREMENT VOUTP_HoodSWDTC_raw32 "" ULONG SWC_OUTP_type_CM_uint32_raw32 0 0 0.0 4.294967295E+9 ECU_ADDRESS 0x0000 /* @ECU_Address@VOUTP_HoodSWDTC_raw32@ */ /end MEASUREMENT
/begin MEASUREMENT VOUTP_APS1SigOoRDTC_raw32 "" ULONG SWC_OUTP_type_CM_uint32_raw32 0 0 0.0 4.294967295E+9 ECU_ADDRESS 0x0000 /* @ECU_Address@VOUTP_APS1SigOoRDTC_raw32@ */ /end MEASUREMENT
/begin MEASUREMENT VOUTP_APS2SigOoRDTC_raw32 "" ULONG SWC_OUTP_type_CM_uint32_raw32 0 0 0.0 4.294967295E+9 ECU_ADDRESS 0x0000 /* @ECU_Address@VOUTP_APS2SigOoRDTC_raw32@ */ /end MEASUREMENT
/begin MEASUREMENT VOUTP_APSCorrErrDTC_raw32 "" ULONG SWC_OUTP_type_CM_uint32_raw32 0 0 0.0 4.294967295E+9 ECU_ADDRESS 0x0000 /* @ECU_Address@VOUTP_APSCorrErrDTC_raw32@ */ /end MEASUREMENT
/begin MEASUREMENT VOUTP_MCUF1NoComDTC_raw32 "" ULONG SWC_OUTP_type_CM_uint32_raw32 0 0 0.0 4.294967295E+9 ECU_ADDRESS 0x0000 /* @ECU_Address@VOUTP_MCUF1NoComDTC_raw32@ */ /end MEASUREMENT
/begin MEASUREMENT VOUTP_MCUR1NoComDTC_raw32 "" ULONG SWC_OUTP_type_CM_uint32_raw32 0 0 0.0 4.294967295E+9 ECU_ADDRESS 0x0000 /* @ECU_Address@VOUTP_MCUR1NoComDTC_raw32@ */ /end MEASUREMENT
/begin MEASUREMENT VOUTP_ESC7NoComDTC_raw32 "" ULONG SWC_OUTP_type_CM_uint32_raw32 0 0 0.0 4.294967295E+9 ECU_ADDRESS 0x0000 /* @ECU_Address@VOUTP_ESC7NoComDTC_raw32@ */ /end MEASUREMENT
/begin MEASUREMENT VOUTP_ESC1NoComDTC_raw32 "" ULONG SWC_OUTP_type_CM_uint32_raw32 0 0 0.0 4.294967295E+9 ECU_ADDRESS 0x0000 /* @ECU_Address@VOUTP_ESC1NoComDTC_raw32@ */ /end MEASUREMENT
/begin MEASUREMENT VOUTP_ESC5NoComDTC_raw32 "" ULONG SWC_OUTP_type_CM_uint32_raw32 0 0 0.0 4.294967295E+9 ECU_ADDRESS 0x0000 /* @ECU_Address@VOUTP_ESC5NoComDTC_raw32@ */ /end MEASUREMENT
/begin MEASUREMENT VOUTP_DiagHCrashDTC_raw32 "" ULONG SWC_OUTP_type_CM_uint32_raw32 0 0 0.0 4.294967295E+9 ECU_ADDRESS 0x0000 /* @ECU_Address@VOUTP_DiagHCrashDTC_raw32@ */ /end MEASUREMENT
/begin MEASUREMENT VOUTP_DiagFLTSDTC_raw32 "" ULONG SWC_OUTP_type_CM_uint32_raw32 0 0 0.0 4.294967295E+9 ECU_ADDRESS 0x0000 /* @ECU_Address@VOUTP_DiagFLTSDTC_raw32@ */ /end MEASUREMENT
/begin MEASUREMENT VOUTP_DiagFRTSDTC_raw32 "" ULONG SWC_OUTP_type_CM_uint32_raw32 0 0 0.0 4.294967295E+9 ECU_ADDRESS 0x0000 /* @ECU_Address@VOUTP_DiagFRTSDTC_raw32@ */ /end MEASUREMENT
/begin MEASUREMENT VOUTP_DiagRLTSDTC_raw32 "" ULONG SWC_OUTP_type_CM_uint32_raw32 0 0 0.0 4.294967295E+9 ECU_ADDRESS 0x0000 /* @ECU_Address@VOUTP_DiagRLTSDTC_raw32@ */ /end MEASUREMENT
/begin MEASUREMENT VOUTP_DiagRRTSDTC_raw32 "" ULONG SWC_OUTP_type_CM_uint32_raw32 0 0 0.0 4.294967295E+9 ECU_ADDRESS 0x0000 /* @ECU_Address@VOUTP_DiagRRTSDTC_raw32@ */ /end MEASUREMENT
/begin MEASUREMENT VOUTP_FCLUSSDTC_raw32 "" ULONG SWC_OUTP_type_CM_uint32_raw32 0 0 0.0 4.294967295E+9 ECU_ADDRESS 0x0000 /* @ECU_Address@VOUTP_FCLUSSDTC_raw32@ */ /end MEASUREMENT
/begin MEASUREMENT VOUTP_FMLUSSDTC_raw32 "" ULONG SWC_OUTP_type_CM_uint32_raw32 0 0 0.0 4.294967295E+9 ECU_ADDRESS 0x0000 /* @ECU_Address@VOUTP_FMLUSSDTC_raw32@ */ /end MEASUREMENT
/begin MEASUREMENT VOUTP_FMRUSSDTC_raw32 "" ULONG SWC_OUTP_type_CM_uint32_raw32 0 0 0.0 4.294967295E+9 ECU_ADDRESS 0x0000 /* @ECU_Address@VOUTP_FMRUSSDTC_raw32@ */ /end MEASUREMENT
/begin MEASUREMENT VOUTP_FCRUSSDTC_raw32 "" ULONG SWC_OUTP_type_CM_uint32_raw32 0 0 0.0 4.294967295E+9 ECU_ADDRESS 0x0000 /* @ECU_Address@VOUTP_FCRUSSDTC_raw32@ */ /end MEASUREMENT
/begin MEASUREMENT VOUTP_RCLUSSDTC_raw32 "" ULONG SWC_OUTP_type_CM_uint32_raw32 0 0 0.0 4.294967295E+9 ECU_ADDRESS 0x0000 /* @ECU_Address@VOUTP_RCLUSSDTC_raw32@ */ /end MEASUREMENT
/begin MEASUREMENT VOUTP_RCRUSSDTC_raw32 "" ULONG SWC_OUTP_type_CM_uint32_raw32 0 0 0.0 4.294967295E+9 ECU_ADDRESS 0x0000 /* @ECU_Address@VOUTP_RCRUSSDTC_raw32@ */ /end MEASUREMENT
/begin MEASUREMENT VOUTP_FLLUSSDTC_raw32 "" ULONG SWC_OUTP_type_CM_uint32_raw32 0 0 0.0 4.294967295E+9 ECU_ADDRESS 0x0000 /* @ECU_Address@VOUTP_FLLUSSDTC_raw32@ */ /end MEASUREMENT
/begin MEASUREMENT VOUTP_FLRUSSDTC_raw32 "" ULONG SWC_OUTP_type_CM_uint32_raw32 0 0 0.0 4.294967295E+9 ECU_ADDRESS 0x0000 /* @ECU_Address@VOUTP_FLRUSSDTC_raw32@ */ /end MEASUREMENT
/begin MEASUREMENT VOUTP_FCM2NoComDTC_raw32 "" ULONG SWC_OUTP_type_CM_uint32_raw32 0 0 0.0 4.294967295E+9 ECU_ADDRESS 0x0000 /* @ECU_Address@VOUTP_FCM2NoComDTC_raw32@ */ /end MEASUREMENT
/begin MEASUREMENT VOUTP_FCM2RCErrDTC_raw32 "" ULONG SWC_OUTP_type_CM_uint32_raw32 0 0 0.0 4.294967295E+9 ECU_ADDRESS 0x0000 /* @ECU_Address@VOUTP_FCM2RCErrDTC_raw32@ */ /end MEASUREMENT
/begin MEASUREMENT VOUTP_FCM2CSErrDTC_raw32 "" ULONG SWC_OUTP_type_CM_uint32_raw32 0 0 0.0 4.294967295E+9 ECU_ADDRESS 0x0000 /* @ECU_Address@VOUTP_FCM2CSErrDTC_raw32@ */ /end MEASUREMENT
/begin MEASUREMENT VOUTP_FCM3NoComDTC_raw32 "" ULONG SWC_OUTP_type_CM_uint32_raw32 0 0 0.0 4.294967295E+9 ECU_ADDRESS 0x0000 /* @ECU_Address@VOUTP_FCM3NoComDTC_raw32@ */ /end MEASUREMENT
/begin MEASUREMENT VOUTP_FCM3RCErrDTC_raw32 "" ULONG SWC_OUTP_type_CM_uint32_raw32 0 0 0.0 4.294967295E+9 ECU_ADDRESS 0x0000 /* @ECU_Address@VOUTP_FCM3RCErrDTC_raw32@ */ /end MEASUREMENT
/begin MEASUREMENT VOUTP_FCM3CSErrDTC_raw32 "" ULONG SWC_OUTP_type_CM_uint32_raw32 0 0 0.0 4.294967295E+9 ECU_ADDRESS 0x0000 /* @ECU_Address@VOUTP_FCM3CSErrDTC_raw32@ */ /end MEASUREMENT
/begin MEASUREMENT VOUTP_FCM4NoComDTC_raw32 "" ULONG SWC_OUTP_type_CM_uint32_raw32 0 0 0.0 4.294967295E+9 ECU_ADDRESS 0x0000 /* @ECU_Address@VOUTP_FCM4NoComDTC_raw32@ */ /end MEASUREMENT
/begin MEASUREMENT VOUTP_FCM4CSErrDTC_raw32 "" ULONG SWC_OUTP_type_CM_uint32_raw32 0 0 0.0 4.294967295E+9 ECU_ADDRESS 0x0000 /* @ECU_Address@VOUTP_FCM4CSErrDTC_raw32@ */ /end MEASUREMENT
/begin MEASUREMENT VOUTP_FCM5NoComDTC_raw32 "" ULONG SWC_OUTP_type_CM_uint32_raw32 0 0 0.0 4.294967295E+9 ECU_ADDRESS 0x0000 /* @ECU_Address@VOUTP_FCM5NoComDTC_raw32@ */ /end MEASUREMENT
/begin MEASUREMENT VOUTP_FCM5CSErrDTC_raw32 "" ULONG SWC_OUTP_type_CM_uint32_raw32 0 0 0.0 4.294967295E+9 ECU_ADDRESS 0x0000 /* @ECU_Address@VOUTP_FCM5CSErrDTC_raw32@ */ /end MEASUREMENT
/begin MEASUREMENT VOUTP_BMSSigErrDetDTC_raw32 "" ULONG SWC_OUTP_type_CM_uint32_raw32 0 0 0.0 4.294967295E+9 ECU_ADDRESS 0x0000 /* @ECU_Address@VOUTP_BMSSigErrDetDTC_raw32@ */ /end MEASUREMENT
/begin MEASUREMENT VOUTP_FCMACCSigErrDetDTC_raw32 "" ULONG SWC_OUTP_type_CM_uint32_raw32 0 0 0.0 4.294967295E+9 ECU_ADDRESS 0x0000 /* @ECU_Address@VOUTP_FCMACCSigErrDetDTC_raw32@ */ /end MEASUREMENT
/begin MEASUREMENT VOUTP_FrMCUSigErrDetDTC_raw32 "" ULONG SWC_OUTP_type_CM_uint32_raw32 0 0 0.0 4.294967295E+9 ECU_ADDRESS 0x0000 /* @ECU_Address@VOUTP_FrMCUSigErrDetDTC_raw32@ */ /end MEASUREMENT
/begin MEASUREMENT VOUTP_CCUSigErrDetDTC_raw32 "" ULONG SWC_OUTP_type_CM_uint32_raw32 0 0 0.0 4.294967295E+9 ECU_ADDRESS 0x0000 /* @ECU_Address@VOUTP_CCUSigErrDetDTC_raw32@ */ /end MEASUREMENT
/begin MEASUREMENT VOUTP_ACCAccelCmdErrDetDTC_raw32 "" ULONG SWC_OUTP_type_CM_uint32_raw32 0 0 0.0 4.294967295E+9 ECU_ADDRESS 0x0000 /* @ECU_Address@VOUTP_ACCAccelCmdErrDetDTC_raw32@ */ /end MEASUREMENT
/begin MEASUREMENT VOUTP_ACCMalfuncDetDTC_raw32 "" ULONG SWC_OUTP_type_CM_uint32_raw32 0 0 0.0 4.294967295E+9 ECU_ADDRESS 0x0000 /* @ECU_Address@VOUTP_ACCMalfuncDetDTC_raw32@ */ /end MEASUREMENT
/begin MEASUREMENT VOUTP_CCMalfuncDetDTC_raw32 "" ULONG SWC_OUTP_type_CM_uint32_raw32 0 0 0.0 4.294967295E+9 ECU_ADDRESS 0x0000 /* @ECU_Address@VOUTP_CCMalfuncDetDTC_raw32@ */ /end MEASUREMENT
/begin MEASUREMENT VOUTP_MSAMalfuncDetDTC_raw32 "" ULONG SWC_OUTP_type_CM_uint32_raw32 0 0 0.0 4.294967295E+9 ECU_ADDRESS 0x0000 /* @ECU_Address@VOUTP_MSAMalfuncDetDTC_raw32@ */ /end MEASUREMENT
/begin MEASUREMENT VOUTP_ISAMalfuncDetDTC_raw32 "" ULONG SWC_OUTP_type_CM_uint32_raw32 0 0 0.0 4.294967295E+9 ECU_ADDRESS 0x0000 /* @ECU_Address@VOUTP_ISAMalfuncDetDTC_raw32@ */ /end MEASUREMENT
/begin MEASUREMENT VOUTP_MCUF1RCErrDTC_raw32 "" ULONG SWC_OUTP_type_CM_uint32_raw32 0 0 0.0 4.294967295E+9 ECU_ADDRESS 0x0000 /* @ECU_Address@VOUTP_MCUF1RCErrDTC_raw32@ */ /end MEASUREMENT
/begin MEASUREMENT VOUTP_MCUR1RCErrDTC_raw32 "" ULONG SWC_OUTP_type_CM_uint32_raw32 0 0 0.0 4.294967295E+9 ECU_ADDRESS 0x0000 /* @ECU_Address@VOUTP_MCUR1RCErrDTC_raw32@ */ /end MEASUREMENT
/begin MEASUREMENT VOUTP_MCUF1CSErrDTC_raw32 "" ULONG SWC_OUTP_type_CM_uint32_raw32 0 0 0.0 4.294967295E+9 ECU_ADDRESS 0x0000 /* @ECU_Address@VOUTP_MCUF1CSErrDTC_raw32@ */ /end MEASUREMENT
/begin MEASUREMENT VOUTP_MCUR1CSErrDTC_raw32 "" ULONG SWC_OUTP_type_CM_uint32_raw32 0 0 0.0 4.294967295E+9 ECU_ADDRESS 0x0000 /* @ECU_Address@VOUTP_MCUR1CSErrDTC_raw32@ */ /end MEASUREMENT
/begin MEASUREMENT VOUTP_ESC7RCErrDTC_raw32 "" ULONG SWC_OUTP_type_CM_uint32_raw32 0 0 0.0 4.294967295E+9 ECU_ADDRESS 0x0000 /* @ECU_Address@VOUTP_ESC7RCErrDTC_raw32@ */ /end MEASUREMENT
/begin MEASUREMENT VOUTP_ESC7CSErrDTC_raw32 "" ULONG SWC_OUTP_type_CM_uint32_raw32 0 0 0.0 4.294967295E+9 ECU_ADDRESS 0x0000 /* @ECU_Address@VOUTP_ESC7CSErrDTC_raw32@ */ /end MEASUREMENT
/begin MEASUREMENT VOUTP_ESC1RCErrDTC_raw32 "" ULONG SWC_OUTP_type_CM_uint32_raw32 0 0 0.0 4.294967295E+9 ECU_ADDRESS 0x0000 /* @ECU_Address@VOUTP_ESC1RCErrDTC_raw32@ */ /end MEASUREMENT
/begin MEASUREMENT VOUTP_ESC1CSErrDTC_raw32 "" ULONG SWC_OUTP_type_CM_uint32_raw32 0 0 0.0 4.294967295E+9 ECU_ADDRESS 0x0000 /* @ECU_Address@VOUTP_ESC1CSErrDTC_raw32@ */ /end MEASUREMENT
/begin MEASUREMENT VOUTP_ESC5RCErrDTC_raw32 "" ULONG SWC_OUTP_type_CM_uint32_raw32 0 0 0.0 4.294967295E+9 ECU_ADDRESS 0x0000 /* @ECU_Address@VOUTP_ESC5RCErrDTC_raw32@ */ /end MEASUREMENT
/begin MEASUREMENT VOUTP_ESC5CSErrDTC_raw32 "" ULONG SWC_OUTP_type_CM_uint32_raw32 0 0 0.0 4.294967295E+9 ECU_ADDRESS 0x0000 /* @ECU_Address@VOUTP_ESC5CSErrDTC_raw32@ */ /end MEASUREMENT
/begin MEASUREMENT VOUTP_FrMCUTqErrDTC_raw32 "" ULONG SWC_OUTP_type_CM_uint32_raw32 0 0 0.0 4.294967295E+9 ECU_ADDRESS 0x0000 /* @ECU_Address@VOUTP_FrMCUTqErrDTC_raw32@ */ /end MEASUREMENT
/begin MEASUREMENT VOUTP_LFBatwarnDTC_raw32 "" ULONG SWC_OUTP_type_CM_uint32_raw32 0 0 0.0 4.294967295E+9 ECU_ADDRESS 0x0000 /* @ECU_Address@VOUTP_LFBatwarnDTC_raw32@ */ /end MEASUREMENT
/begin MEASUREMENT VOUTP_LRBatwarnDTC_raw32 "" ULONG SWC_OUTP_type_CM_uint32_raw32 0 0 0.0 4.294967295E+9 ECU_ADDRESS 0x0000 /* @ECU_Address@VOUTP_LRBatwarnDTC_raw32@ */ /end MEASUREMENT
/begin MEASUREMENT VOUTP_LFPressIndiDTC_raw32 "" ULONG SWC_OUTP_type_CM_uint32_raw32 0 0 0.0 4.294967295E+9 ECU_ADDRESS 0x0000 /* @ECU_Address@VOUTP_LFPressIndiDTC_raw32@ */ /end MEASUREMENT
/begin MEASUREMENT VOUTP_LRPressIndiDTC_raw32 "" ULONG SWC_OUTP_type_CM_uint32_raw32 0 0 0.0 4.294967295E+9 ECU_ADDRESS 0x0000 /* @ECU_Address@VOUTP_LRPressIndiDTC_raw32@ */ /end MEASUREMENT
/begin MEASUREMENT VOUTP_LFWheelTmpHighDTC_raw32 "" ULONG SWC_OUTP_type_CM_uint32_raw32 0 0 0.0 4.294967295E+9 ECU_ADDRESS 0x0000 /* @ECU_Address@VOUTP_LFWheelTmpHighDTC_raw32@ */ /end MEASUREMENT
/begin MEASUREMENT VOUTP_LRWheelTmpHighDTC_raw32 "" ULONG SWC_OUTP_type_CM_uint32_raw32 0 0 0.0 4.294967295E+9 ECU_ADDRESS 0x0000 /* @ECU_Address@VOUTP_LRWheelTmpHighDTC_raw32@ */ /end MEASUREMENT
/begin MEASUREMENT VOUTP_LFSensorFailDTC_raw32 "" ULONG SWC_OUTP_type_CM_uint32_raw32 0 0 0.0 4.294967295E+9 ECU_ADDRESS 0x0000 /* @ECU_Address@VOUTP_LFSensorFailDTC_raw32@ */ /end MEASUREMENT
/begin MEASUREMENT VOUTP_LRSensorFailDTC_raw32 "" ULONG SWC_OUTP_type_CM_uint32_raw32 0 0 0.0 4.294967295E+9 ECU_ADDRESS 0x0000 /* @ECU_Address@VOUTP_LRSensorFailDTC_raw32@ */ /end MEASUREMENT
/begin MEASUREMENT VOUTP_C1EPAS2LCDTC_raw32 "" ULONG SWC_OUTP_type_CM_uint32_raw32 0 0 0.0 4.294967295E+9 ECU_ADDRESS 0x0000 /* @ECU_Address@VOUTP_C1EPAS2LCDTC_raw32@ */ /end MEASUREMENT
/begin MEASUREMENT VOUTP_5vAPS1PwrErrDTC_raw32 "" ULONG SWC_OUTP_type_CM_uint32_raw32 0 0 0.0 4.294967295E+9 ECU_ADDRESS 0x0000 /* @ECU_Address@VOUTP_5vAPS1PwrErrDTC_raw32@ */ /end MEASUREMENT
/begin MEASUREMENT VOUTP_5vAPS2PwrErrDTC_raw32 "" ULONG SWC_OUTP_type_CM_uint32_raw32 0 0 0.0 4.294967295E+9 ECU_ADDRESS 0x0000 /* @ECU_Address@VOUTP_5vAPS2PwrErrDTC_raw32@ */ /end MEASUREMENT
/begin MEASUREMENT VOUTP_EPBLockTODTC_raw32 "" ULONG SWC_OUTP_type_CM_uint32_raw32 0 0 0.0 4.294967295E+9 ECU_ADDRESS 0x0000 /* @ECU_Address@VOUTP_EPBLockTODTC_raw32@ */ /end MEASUREMENT
/begin MEASUREMENT VOUTP_EPBUnlockTODTC_raw32 "" ULONG SWC_OUTP_type_CM_uint32_raw32 0 0 0.0 4.294967295E+9 ECU_ADDRESS 0x0000 /* @ECU_Address@VOUTP_EPBUnlockTODTC_raw32@ */ /end MEASUREMENT
/begin MEASUREMENT VOUTP_PSAR_sec "" ULONG SWC_OUTP_type_CM_uint32_sec 0 0 0.0 4.294967295E+9 ECU_ADDRESS 0x0000 /* @ECU_Address@VOUTP_PSAR_sec@ */ /end MEASUREMENT
/begin MEASUREMENT VOUTP_PSAL_sec "" ULONG SWC_OUTP_type_CM_uint32_sec 0 0 0.0 4.294967295E+9 ECU_ADDRESS 0x0000 /* @ECU_Address@VOUTP_PSAL_sec@ */ /end MEASUREMENT
/begin MEASUREMENT VOUTP_IPSAR_sec "" ULONG SWC_OUTP_type_CM_uint32_sec 0 0 0.0 4.294967295E+9 ECU_ADDRESS 0x0000 /* @ECU_Address@VOUTP_IPSAR_sec@ */ /end MEASUREMENT
/begin MEASUREMENT VOUTP_IPSAL_sec "" ULONG SWC_OUTP_type_CM_uint32_sec 0 0 0.0 4.294967295E+9 ECU_ADDRESS 0x0000 /* @ECU_Address@VOUTP_IPSAL_sec@ */ /end MEASUREMENT
/begin MEASUREMENT VOUTP_CPSAR_sec "" ULONG SWC_OUTP_type_CM_uint32_sec 0 0 0.0 4.294967295E+9 ECU_ADDRESS 0x0000 /* @ECU_Address@VOUTP_CPSAR_sec@ */ /end MEASUREMENT
/begin MEASUREMENT VOUTP_CPSAL_sec "" ULONG SWC_OUTP_type_CM_uint32_sec 0 0 0.0 4.294967295E+9 ECU_ADDRESS 0x0000 /* @ECU_Address@VOUTP_CPSAL_sec@ */ /end MEASUREMENT
/begin MEASUREMENT VOUTP_QTYPSATRIPSR_cnt "" ULONG SWC_OUTP_type_CM_uint32_cnt 0 0 0.0 4.294967295E+9 ECU_ADDRESS 0x0000 /* @ECU_Address@VOUTP_QTYPSATRIPSR_cnt@ */ /end MEASUREMENT
/begin MEASUREMENT VOUTP_QTYPSATRIPSL_cnt "" ULONG SWC_OUTP_type_CM_uint32_cnt 0 0 0.0 4.294967295E+9 ECU_ADDRESS 0x0000 /* @ECU_Address@VOUTP_QTYPSATRIPSL_cnt@ */ /end MEASUREMENT
/begin MEASUREMENT VOUTP_BattTempPSAR_sec "" ULONG SWC_OUTP_type_CM_uint32_sec 0 0 0.0 4.294967295E+9 ECU_ADDRESS 0x0000 /* @ECU_Address@VOUTP_BattTempPSAR_sec@ */ /end MEASUREMENT
/begin MEASUREMENT VOUTP_BattTempPSAL_sec "" ULONG SWC_OUTP_type_CM_uint32_sec 0 0 0.0 4.294967295E+9 ECU_ADDRESS 0x0000 /* @ECU_Address@VOUTP_BattTempPSAL_sec@ */ /end MEASUREMENT
/begin MEASUREMENT VOUTP_OVCR_sec "" ULONG SWC_OUTP_type_CM_uint32_sec 0 0 0.0 4.294967295E+9 ECU_ADDRESS 0x0000 /* @ECU_Address@VOUTP_OVCR_sec@ */ /end MEASUREMENT
/begin MEASUREMENT VOUTP_OVCL_sec "" ULONG SWC_OUTP_type_CM_uint32_sec 0 0 0.0 4.294967295E+9 ECU_ADDRESS 0x0000 /* @ECU_Address@VOUTP_OVCL_sec@ */ /end MEASUREMENT
/begin MEASUREMENT VOUTP_OFFR_sec "" ULONG SWC_OUTP_type_CM_uint32_sec 0 0 0.0 4.294967295E+9 ECU_ADDRESS 0x0000 /* @ECU_Address@VOUTP_OFFR_sec@ */ /end MEASUREMENT
/begin MEASUREMENT VOUTP_OFFL_sec "" ULONG SWC_OUTP_type_CM_uint32_sec 0 0 0.0 4.294967295E+9 ECU_ADDRESS 0x0000 /* @ECU_Address@VOUTP_OFFL_sec@ */ /end MEASUREMENT
/begin MEASUREMENT VOUTP_AVGBATTEMPL_sec "" ULONG SWC_OUTP_type_CM_uint32_sec 0 0 0.0 4.294967295E+9 ECU_ADDRESS 0x0000 /* @ECU_Address@VOUTP_AVGBATTEMPL_sec@ */ /end MEASUREMENT
/begin MEASUREMENT VOUTP_DKCTimeSN_cnt "" ULONG SWC_OUTP_type_CM_uint32_cnt 0 0 0.0 4.294967295E+9 ECU_ADDRESS 0x0000 /* @ECU_Address@VOUTP_DKCTimeSN_cnt@ */ /end MEASUREMENT
/begin MEASUREMENT VOUTP_CFGEM1BAMPGN_raw "" ULONG SWC_OUTP_type_CM_uint32_raw 0 0 0.0 4.294967295E+9 ECU_ADDRESS 0x0000 /* @ECU_Address@VOUTP_CFGEM1BAMPGN_raw@ */ /end MEASUREMENT
/begin MEASUREMENT VOUTP_PmicBootPath_raw32 "" ULONG SWC_OUTP_type_CM_uint32_raw32 0 0 0.0 4.294967295E+9 ECU_ADDRESS 0x0000 /* @ECU_Address@VOUTP_PmicBootPath_raw32@ */ /end MEASUREMENT
/begin MEASUREMENT VOUTP_IDin_raw32 "" ULONG SWC_OUTP_type_CM_uint32_raw32 0 0 0.0 4.294967295E+9 ECU_ADDRESS 0x0000 /* @ECU_Address@VOUTP_IDin_raw32@ */ /end MEASUREMENT
/begin MEASUREMENT VOUTP_FlashS1ID_raw "" ULONG SWC_OUTP_type_CM_uint32_raw 0 0 0.0 4.294967295E+9 ECU_ADDRESS 0x0000 /* @ECU_Address@VOUTP_FlashS1ID_raw@ */ /end MEASUREMENT
/begin MEASUREMENT VOUTP_FlashS2ID_raw "" ULONG SWC_OUTP_type_CM_uint32_raw 0 0 0.0 4.294967295E+9 ECU_ADDRESS 0x0000 /* @ECU_Address@VOUTP_FlashS2ID_raw@ */ /end MEASUREMENT
/begin MEASUREMENT VOUTP_FlashS3ID_raw "" ULONG SWC_OUTP_type_CM_uint32_raw 0 0 0.0 4.294967295E+9 ECU_ADDRESS 0x0000 /* @ECU_Address@VOUTP_FlashS3ID_raw@ */ /end MEASUREMENT
/begin MEASUREMENT VOUTP_FlashS4ID_raw "" ULONG SWC_OUTP_type_CM_uint32_raw 0 0 0.0 4.294967295E+9 ECU_ADDRESS 0x0000 /* @ECU_Address@VOUTP_FlashS4ID_raw@ */ /end MEASUREMENT
/begin MEASUREMENT VOUTP_EHPSMotorDemSpd_rpm "" FLOAT32_IEEE SWC_OUTP_type_CM_single_rpm 0 0 -5000.0 27767.5 ECU_ADDRESS 0x0000 /* @ECU_Address@VOUTP_EHPSMotorDemSpd_rpm@ */ /end MEASUREMENT
/begin MEASUREMENT VOUTP_EHPSSpdCtrlMode_enum "" FLOAT32_IEEE SWC_OUTP_type_CM_single_enum 0 0 0.0 3.0 ECU_ADDRESS 0x0000 /* @ECU_Address@VOUTP_EHPSSpdCtrlMode_enum@ */ /end MEASUREMENT
/begin MEASUREMENT VOUTP_EACSpdDemand_rpm "" FLOAT32_IEEE SWC_OUTP_type_CM_single_rpm 0 0 -100000.0 100000.0 ECU_ADDRESS 0x0000 /* @ECU_Address@VOUTP_EACSpdDemand_rpm@ */ /end MEASUREMENT
/begin MEASUREMENT VOUTP_BrkPedalPos_pct "" FLOAT32_IEEE SWC_OUTP_type_CM_single_pct 0 0 0.0 100.0 ECU_ADDRESS 0x0000 /* @ECU_Address@VOUTP_BrkPedalPos_pct@ */ /end MEASUREMENT
/begin MEASUREMENT VOUTP_LFRawWhlSpeed_kph "" FLOAT32_IEEE SWC_OUTP_type_CM_single_kph 0 0 0.0 255.9375 ECU_ADDRESS 0x0000 /* @ECU_Address@VOUTP_LFRawWhlSpeed_kph@ */ /end MEASUREMENT
/begin MEASUREMENT VOUTP_LRRawWhlSpeed_kph "" FLOAT32_IEEE SWC_OUTP_type_CM_single_kph 0 0 0.0 255.9375 ECU_ADDRESS 0x0000 /* @ECU_Address@VOUTP_LRRawWhlSpeed_kph@ */ /end MEASUREMENT
/begin MEASUREMENT VOUTP_GRADE_Deg "" FLOAT32_IEEE SWC_OUTP_type_CM_single_Deg 0 0 -45.0 45.0 ECU_ADDRESS 0x0000 /* @ECU_Address@VOUTP_GRADE_Deg@ */ /end MEASUREMENT
/begin MEASUREMENT VOUTP_LatAccel_Gps "" FLOAT32_IEEE SWC_OUTP_type_CM_single_Gps 0 0 -1.27 1.27 ECU_ADDRESS 0x0000 /* @ECU_Address@VOUTP_LatAccel_Gps@ */ /end MEASUREMENT
/begin MEASUREMENT VOUTP_LongAccel_Gps "" FLOAT32_IEEE SWC_OUTP_type_CM_single_Gps 0 0 -1.27 1.27 ECU_ADDRESS 0x0000 /* @ECU_Address@VOUTP_LongAccel_Gps@ */ /end MEASUREMENT
/begin MEASUREMENT VOUTP_MCPressure_bar "" FLOAT32_IEEE SWC_OUTP_type_CM_single_bar 0 0 -9.7 195.0 ECU_ADDRESS 0x0000 /* @ECU_Address@VOUTP_MCPressure_bar@ */ /end MEASUREMENT
/begin MEASUREMENT VOUTP_APSProgressPCT_pct "" FLOAT32_IEEE SWC_OUTP_type_CM_single_pct 0 0 0.0 100.0 ECU_ADDRESS 0x0000 /* @ECU_Address@VOUTP_APSProgressPCT_pct@ */ /end MEASUREMENT
/begin MEASUREMENT VOUTP_APSAngleTarget_Deg "" FLOAT32_IEEE SWC_OUTP_type_CM_single_Deg 0 0 -900.0 900.0 ECU_ADDRESS 0x0000 /* @ECU_Address@VOUTP_APSAngleTarget_Deg@ */ /end MEASUREMENT
/begin MEASUREMENT VOUTP_APSSpeedCMD_kph "" FLOAT32_IEEE SWC_OUTP_type_CM_single_kph 0 0 0.0 15.0 ECU_ADDRESS 0x0000 /* @ECU_Address@VOUTP_APSSpeedCMD_kph@ */ /end MEASUREMENT
/begin MEASUREMENT VOUTP_ActAPSPosn_pct "" FLOAT32_IEEE SWC_OUTP_type_CM_single_pct 0 0 0.0 120.0 ECU_ADDRESS 0x0000 /* @ECU_Address@VOUTP_ActAPSPosn_pct@ */ /end MEASUREMENT
/begin MEASUREMENT VOUTP_EAPS1MIN_pct "" FLOAT32_IEEE SWC_OUTP_type_CM_single_pct 0 0 0.0 120.0 ECU_ADDRESS 0x0000 /* @ECU_Address@VOUTP_EAPS1MIN_pct@ */ /end MEASUREMENT
/begin MEASUREMENT VOUTP_EAPS2MIN_pct "" FLOAT32_IEEE SWC_OUTP_type_CM_single_pct 0 0 0.0 120.0 ECU_ADDRESS 0x0000 /* @ECU_Address@VOUTP_EAPS2MIN_pct@ */ /end MEASUREMENT
/begin MEASUREMENT VOUTP_EAPS1NRM_pct "" FLOAT32_IEEE SWC_OUTP_type_CM_single_pct 0 0 0.0 120.0 ECU_ADDRESS 0x0000 /* @ECU_Address@VOUTP_EAPS1NRM_pct@ */ /end MEASUREMENT
/begin MEASUREMENT VOUTP_EAPS2NRM_pct "" FLOAT32_IEEE SWC_OUTP_type_CM_single_pct 0 0 0.0 120.0 ECU_ADDRESS 0x0000 /* @ECU_Address@VOUTP_EAPS2NRM_pct@ */ /end MEASUREMENT
/begin MEASUREMENT VOUTP_MILDIST_km "" FLOAT32_IEEE SWC_OUTP_type_CM_single_km 0 0 0.0 65535.0 ECU_ADDRESS 0x0000 /* @ECU_Address@VOUTP_MILDIST_km@ */ /end MEASUREMENT
/begin MEASUREMENT VOUTP_CLRDIST_km "" FLOAT32_IEEE SWC_OUTP_type_CM_single_km 0 0 0.0 65535.0 ECU_ADDRESS 0x0000 /* @ECU_Address@VOUTP_CLRDIST_km@ */ /end MEASUREMENT
/begin MEASUREMENT VOUTP_APPD_pct "" FLOAT32_IEEE SWC_OUTP_type_CM_single_pct 0 0 0.0 100.0 ECU_ADDRESS 0x0000 /* @ECU_Address@VOUTP_APPD_pct@ */ /end MEASUREMENT
/begin MEASUREMENT VOUTP_APPE_pct "" FLOAT32_IEEE SWC_OUTP_type_CM_single_pct 0 0 0.0 100.0 ECU_ADDRESS 0x0000 /* @ECU_Address@VOUTP_APPE_pct@ */ /end MEASUREMENT
/begin MEASUREMENT VOUTP_BATSOC_pct "" FLOAT32_IEEE SWC_OUTP_type_CM_single_pct 0 0 0.0 100.0 ECU_ADDRESS 0x0000 /* @ECU_Address@VOUTP_BATSOC_pct@ */ /end MEASUREMENT
/begin MEASUREMENT VOUTP_HEVBATT_V "" FLOAT32_IEEE SWC_OUTP_type_CM_single_V 0 0 0.0 1023.98 ECU_ADDRESS 0x0000 /* @ECU_Address@VOUTP_HEVBATT_V@ */ /end MEASUREMENT
/begin MEASUREMENT VOUTP_ODOMETER_km "" FLOAT32_IEEE SWC_OUTP_type_CM_single_km 0 0 0.0 4.294967295E+8 ECU_ADDRESS 0x0000 /* @ECU_Address@VOUTP_ODOMETER_km@ */ /end MEASUREMENT
/begin MEASUREMENT VOUTP_BATSOH_pct "" FLOAT32_IEEE SWC_OUTP_type_CM_single_pct 0 0 0.0 100.0 ECU_ADDRESS 0x0000 /* @ECU_Address@VOUTP_BATSOH_pct@ */ /end MEASUREMENT
/begin MEASUREMENT VOUTP_HVBCellVoltMin_V "" FLOAT32_IEEE SWC_OUTP_type_CM_single_V 0 0 0.0 65.535 ECU_ADDRESS 0x0000 /* @ECU_Address@VOUTP_HVBCellVoltMin_V@ */ /end MEASUREMENT
/begin MEASUREMENT VOUTP_HVBCellVoltMax_V "" FLOAT32_IEEE SWC_OUTP_type_CM_single_V 0 0 0.0 65.535 ECU_ADDRESS 0x0000 /* @ECU_Address@VOUTP_HVBCellVoltMax_V@ */ /end MEASUREMENT
/begin MEASUREMENT VOUTP_HVESSCHARGELIM_kW "" FLOAT32_IEEE SWC_OUTP_type_CM_single_kW 0 0 0.0 3272.75 ECU_ADDRESS 0x0000 /* @ECU_Address@VOUTP_HVESSCHARGELIM_kW@ */ /end MEASUREMENT
/begin MEASUREMENT VOUTP_HVESSCHARGEACT_kW "" FLOAT32_IEEE SWC_OUTP_type_CM_single_kW 0 0 0.0 3272.75 ECU_ADDRESS 0x0000 /* @ECU_Address@VOUTP_HVESSCHARGEACT_kW@ */ /end MEASUREMENT
/begin MEASUREMENT VOUTP_HVESSENER_Whps "" FLOAT32_IEEE SWC_OUTP_type_CM_single_Whps 0 0 -2147.4836 2147.4836 ECU_ADDRESS 0x0000 /* @ECU_Address@VOUTP_HVESSENER_Whps@ */ /end MEASUREMENT
/begin MEASUREMENT VOUTP_HVBattCurr_Ahps "" FLOAT32_IEEE SWC_OUTP_type_CM_single_Ahps 0 0 -2147.4836 2147.4836 ECU_ADDRESS 0x0000 /* @ECU_Address@VOUTP_HVBattCurr_Ahps@ */ /end MEASUREMENT
/begin MEASUREMENT VOUTP_HVBNAH_Ahr "" FLOAT32_IEEE SWC_OUTP_type_CM_single_Ahr 0 0 -2.147483648E+6 2.147483647E+6 ECU_ADDRESS 0x0000 /* @ECU_Address@VOUTP_HVBNAH_Ahr@ */ /end MEASUREMENT
/begin MEASUREMENT VOUTP_HVBNE_kWh "" FLOAT32_IEEE SWC_OUTP_type_CM_single_kWh 0 0 -2.147483648E+6 2.147483647E+6 ECU_ADDRESS 0x0000 /* @ECU_Address@VOUTP_HVBNE_kWh@ */ /end MEASUREMENT
/begin MEASUREMENT VOUTP_GECHGOVCDCR_kWh "" FLOAT32_IEEE SWC_OUTP_type_CM_single_kWh 0 0 0.0 4.294967295E+8 ECU_ADDRESS 0x0000 /* @ECU_Address@VOUTP_GECHGOVCDCR_kWh@ */ /end MEASUREMENT
/begin MEASUREMENT VOUTP_GECHGOVCDCL_kWh "" FLOAT32_IEEE SWC_OUTP_type_CM_single_kWh 0 0 0.0 4.294967295E+8 ECU_ADDRESS 0x0000 /* @ECU_Address@VOUTP_GECHGOVCDCL_kWh@ */ /end MEASUREMENT
/begin MEASUREMENT VOUTP_GECHGOVCACR_kWh "" FLOAT32_IEEE SWC_OUTP_type_CM_single_kWh 0 0 0.0 4.294967295E+8 ECU_ADDRESS 0x0000 /* @ECU_Address@VOUTP_GECHGOVCACR_kWh@ */ /end MEASUREMENT
/begin MEASUREMENT VOUTP_GECHGOVCACL_kWh "" FLOAT32_IEEE SWC_OUTP_type_CM_single_kWh 0 0 0.0 4.294967295E+8 ECU_ADDRESS 0x0000 /* @ECU_Address@VOUTP_GECHGOVCACL_kWh@ */ /end MEASUREMENT
/begin MEASUREMENT VOUTP_RESSV2XENNONPSAR_kWh "" FLOAT32_IEEE SWC_OUTP_type_CM_single_kWh 0 0 0.0 4.294967295E+8 ECU_ADDRESS 0x0000 /* @ECU_Address@VOUTP_RESSV2XENNONPSAR_kWh@ */ /end MEASUREMENT
/begin MEASUREMENT VOUTP_RESSV2XENNONPSAL_kWh "" FLOAT32_IEEE SWC_OUTP_type_CM_single_kWh 0 0 0.0 4.294967295E+8 ECU_ADDRESS 0x0000 /* @ECU_Address@VOUTP_RESSV2XENNONPSAL_kWh@ */ /end MEASUREMENT
/begin MEASUREMENT VOUTP_PKER_kphsqr "" FLOAT32_IEEE SWC_OUTP_type_CM_single_kphsqr 0 0 0.0 4.294967295E+9 ECU_ADDRESS 0x0000 /* @ECU_Address@VOUTP_PKER_kphsqr@ */ /end MEASUREMENT
/begin MEASUREMENT VOUTP_PKEL_kphsqr "" FLOAT32_IEEE SWC_OUTP_type_CM_single_kphsqr 0 0 0.0 4.294967295E+9 ECU_ADDRESS 0x0000 /* @ECU_Address@VOUTP_PKEL_kphsqr@ */ /end MEASUREMENT
/begin MEASUREMENT VOUTP_CDEODTR_km "" FLOAT32_IEEE SWC_OUTP_type_CM_single_km 0 0 0.0 4.294967295E+8 ECU_ADDRESS 0x0000 /* @ECU_Address@VOUTP_CDEODTR_km@ */ /end MEASUREMENT
/begin MEASUREMENT VOUTP_CDEODTL_km "" FLOAT32_IEEE SWC_OUTP_type_CM_single_km 0 0 -40.0 215.0 ECU_ADDRESS 0x0000 /* @ECU_Address@VOUTP_CDEODTL_km@ */ /end MEASUREMENT
/begin MEASUREMENT VOUTP_AvgBattTempPSAR_C "" FLOAT32_IEEE SWC_OUTP_type_CM_single_C 0 0 -40.0 215.0 ECU_ADDRESS 0x0000 /* @ECU_Address@VOUTP_AvgBattTempPSAR_C@ */ /end MEASUREMENT
/begin MEASUREMENT VOUTP_AvgBattTempPSAL_C "" FLOAT32_IEEE SWC_OUTP_type_CM_single_C 0 0 -40.0 215.0 ECU_ADDRESS 0x0000 /* @ECU_Address@VOUTP_AvgBattTempPSAL_C@ */ /end MEASUREMENT
/begin MEASUREMENT VOUTP_AvgBattTempOVCR_C "" FLOAT32_IEEE SWC_OUTP_type_CM_single_C 0 0 -40.0 215.0 ECU_ADDRESS 0x0000 /* @ECU_Address@VOUTP_AvgBattTempOVCR_C@ */ /end MEASUREMENT
/begin MEASUREMENT VOUTP_AvgBattTempOVCL_C "" FLOAT32_IEEE SWC_OUTP_type_CM_single_C 0 0 -40.0 215.0 ECU_ADDRESS 0x0000 /* @ECU_Address@VOUTP_AvgBattTempOVCL_C@ */ /end MEASUREMENT
/begin MEASUREMENT VOUTP_AvgBattTempOFFR_C "" FLOAT32_IEEE SWC_OUTP_type_CM_single_C 0 0 -40.0 215.0 ECU_ADDRESS 0x0000 /* @ECU_Address@VOUTP_AvgBattTempOFFR_C@ */ /end MEASUREMENT
/begin MEASUREMENT VOUTP_AvgBattTempOFFL_C "" FLOAT32_IEEE SWC_OUTP_type_CM_single_C 0 0 -40.0 215.0 ECU_ADDRESS 0x0000 /* @ECU_Address@VOUTP_AvgBattTempOFFL_C@ */ /end MEASUREMENT
/begin MEASUREMENT VOUTP_ETMATOER_kWh "" FLOAT32_IEEE SWC_OUTP_type_CM_single_kWh 0 0 0.0 4.294967295E+9 ECU_ADDRESS 0x0000 /* @ECU_Address@VOUTP_ETMATOER_kWh@ */ /end MEASUREMENT
/begin MEASUREMENT VOUTP_ETMATOEL_kWh "" FLOAT32_IEEE SWC_OUTP_type_CM_single_kWh 0 0 0.0 4.294967295E+9 ECU_ADDRESS 0x0000 /* @ECU_Address@VOUTP_ETMATOEL_kWh@ */ /end MEASUREMENT
/begin MEASUREMENT VOUTP_ETMBTOER_kWh "" FLOAT32_IEEE SWC_OUTP_type_CM_single_kWh 0 0 0.0 4.294967295E+9 ECU_ADDRESS 0x0000 /* @ECU_Address@VOUTP_ETMBTOER_kWh@ */ /end MEASUREMENT
/begin MEASUREMENT VOUTP_ETMBTOEL_kWh "" FLOAT32_IEEE SWC_OUTP_type_CM_single_kWh 0 0 0.0 4.294967295E+9 ECU_ADDRESS 0x0000 /* @ECU_Address@VOUTP_ETMBTOEL_kWh@ */ /end MEASUREMENT
/begin MEASUREMENT VOUTP_MAXBATTEMPL_C "" FLOAT32_IEEE SWC_OUTP_type_CM_single_C 0 0 -40.0 215.0 ECU_ADDRESS 0x0000 /* @ECU_Address@VOUTP_MAXBATTEMPL_C@ */ /end MEASUREMENT
/begin MEASUREMENT VOUTP_MINBATTEMPL_C "" FLOAT32_IEEE SWC_OUTP_type_CM_single_C 0 0 -40.0 215.0 ECU_ADDRESS 0x0000 /* @ECU_Address@VOUTP_MINBATTEMPL_C@ */ /end MEASUREMENT
/begin MEASUREMENT VOUTP_AVGBATTEMPL_C "" FLOAT32_IEEE SWC_OUTP_type_CM_single_C 0 0 -40.0 215.0 ECU_ADDRESS 0x0000 /* @ECU_Address@VOUTP_AVGBATTEMPL_C@ */ /end MEASUREMENT
/begin MEASUREMENT VOUTP_PKERNumerator_kphsqr "" FLOAT32_IEEE SWC_OUTP_type_CM_single_kphsqr 0 0 0.0 3.4028E+38 ECU_ADDRESS 0x0000 /* @ECU_Address@VOUTP_PKERNumerator_kphsqr@ */ /end MEASUREMENT
/begin MEASUREMENT VOUTP_PKELNumerator_kphsqr "" FLOAT32_IEEE SWC_OUTP_type_CM_single_kphsqr 0 0 0.0 3.4028E+38 ECU_ADDRESS 0x0000 /* @ECU_Address@VOUTP_PKELNumerator_kphsqr@ */ /end MEASUREMENT
/begin MEASUREMENT VOUTP_HVBATT_A "" FLOAT32_IEEE SWC_OUTP_type_CM_single_A 0 0 -3276.8 3276.7 ECU_ADDRESS 0x0000 /* @ECU_Address@VOUTP_HVBATT_A@ */ /end MEASUREMENT
/begin MEASUREMENT VOUTP_DISCTargetSpd_kph "" FLOAT32_IEEE SWC_OUTP_type_CM_single_kph 0 0 0.0 250.0 ECU_ADDRESS 0x0000 /* @ECU_Address@VOUTP_DISCTargetSpd_kph@ */ /end MEASUREMENT
/begin MEASUREMENT VOUTP_DCCurr_A "" FLOAT32_IEEE SWC_OUTP_type_CM_single_A 0 0 -100000.0 100000.0 ECU_ADDRESS 0x0000 /* @ECU_Address@VOUTP_DCCurr_A@ */ /end MEASUREMENT
/begin MEASUREMENT VOUTP_DCVol_V "" FLOAT32_IEEE SWC_OUTP_type_CM_single_V 0 0 -100000.0 100000.0 ECU_ADDRESS 0x0000 /* @ECU_Address@VOUTP_DCVol_V@ */ /end MEASUREMENT
/begin MEASUREMENT VOUTP_FdcSlpTime_sec "" FLOAT32_IEEE SWC_OUTP_type_CM_single_sec 0 0 0.0 1.0E+7 ECU_ADDRESS 0x0000 /* @ECU_Address@VOUTP_FdcSlpTime_sec@ */ /end MEASUREMENT
/begin MEASUREMENT VOUTP_EWPPEReq_rpm "" FLOAT32_IEEE SWC_OUTP_type_CM_single_rpm 0 0 0.0 6375.0 ECU_ADDRESS 0x0000 /* @ECU_Address@VOUTP_EWPPEReq_rpm@ */ /end MEASUREMENT
/begin MEASUREMENT VOUTP_CoolFanReq_pct "" FLOAT32_IEEE SWC_OUTP_type_CM_single_pct 0 0 0.0 100.0 ECU_ADDRESS 0x0000 /* @ECU_Address@VOUTP_CoolFanReq_pct@ */ /end MEASUREMENT
/begin MEASUREMENT VOUTP_LFWheelTemp_C "" FLOAT32_IEEE SWC_OUTP_type_CM_single_C 0 0 -40.0 215.0 ECU_ADDRESS 0x0000 /* @ECU_Address@VOUTP_LFWheelTemp_C@ */ /end MEASUREMENT
/begin MEASUREMENT VOUTP_LRWheelTemp_C "" FLOAT32_IEEE SWC_OUTP_type_CM_single_C 0 0 -40.0 215.0 ECU_ADDRESS 0x0000 /* @ECU_Address@VOUTP_LRWheelTemp_C@ */ /end MEASUREMENT
/begin MEASUREMENT VOUTP_CreepSpdReq_rpm "" FLOAT32_IEEE SWC_OUTP_type_CM_single_rpm 0 0 -100000.0 100000.0 ECU_ADDRESS 0x0000 /* @ECU_Address@VOUTP_CreepSpdReq_rpm@ */ /end MEASUREMENT
/begin MEASUREMENT VOUTP_EVCU1EMotorSpd_rpm "" FLOAT32_IEEE SWC_OUTP_type_CM_single_rpm 0 0 -100000.0 100000.0 ECU_ADDRESS 0x0000 /* @ECU_Address@VOUTP_EVCU1EMotorSpd_rpm@ */ /end MEASUREMENT
/begin MEASUREMENT VOUTP_EVCU1EMotorPerformance_pct "" FLOAT32_IEEE SWC_OUTP_type_CM_single_pct 0 0 -125.0 125.0 ECU_ADDRESS 0x0000 /* @ECU_Address@VOUTP_EVCU1EMotorPerformance_pct@ */ /end MEASUREMENT
/begin MEASUREMENT VOUTP_EVCU2MaxTorqAvail_pct "" FLOAT32_IEEE SWC_OUTP_type_CM_single_pct 0 0 -125.0 125.0 ECU_ADDRESS 0x0000 /* @ECU_Address@VOUTP_EVCU2MaxTorqAvail_pct@ */ /end MEASUREMENT
/begin MEASUREMENT VOUTP_EVCU2MinTorqAvail_pct "" FLOAT32_IEEE SWC_OUTP_type_CM_single_pct 0 0 -125.0 125.0 ECU_ADDRESS 0x0000 /* @ECU_Address@VOUTP_EVCU2MinTorqAvail_pct@ */ /end MEASUREMENT
/begin MEASUREMENT VOUTP_EEC3NFricPercTorq_pct "" FLOAT32_IEEE SWC_OUTP_type_CM_single_pct 0 0 -125.0 125.0 ECU_ADDRESS 0x0000 /* @ECU_Address@VOUTP_EEC3NFricPercTorq_pct@ */ /end MEASUREMENT
/begin MEASUREMENT VOUTP_EEC3EMPressLoss_pct "" FLOAT32_IEEE SWC_OUTP_type_CM_single_pct 0 0 -125.0 125.0 ECU_ADDRESS 0x0000 /* @ECU_Address@VOUTP_EEC3EMPressLoss_pct@ */ /end MEASUREMENT
/begin MEASUREMENT VOUTP_ETC2ActDriveDirect_enum "" FLOAT32_IEEE SWC_OUTP_type_CM_single_enum 0 0 -10.0 10.0 ECU_ADDRESS 0x0000 /* @ECU_Address@VOUTP_ETC2ActDriveDirect_enum@ */ /end MEASUREMENT
/begin MEASUREMENT VOUTP_RC1PctTrqP4_pct "" FLOAT32_IEEE SWC_OUTP_type_CM_single_pct 0 0 -125.0 125.0 ECU_ADDRESS 0x0000 /* @ECU_Address@VOUTP_RC1PctTrqP4_pct@ */ /end MEASUREMENT
/begin MEASUREMENT VOUTP_RC1PctTrqPekTrqP5_pct "" FLOAT32_IEEE SWC_OUTP_type_CM_single_pct 0 0 -125.0 125.0 ECU_ADDRESS 0x0000 /* @ECU_Address@VOUTP_RC1PctTrqPekTrqP5_pct@ */ /end MEASUREMENT
/begin MEASUREMENT VOUTP_EMRC1ActEMpTrq_pct "" FLOAT32_IEEE SWC_OUTP_type_CM_single_pct 0 0 -125.0 125.0 ECU_ADDRESS 0x0000 /* @ECU_Address@VOUTP_EMRC1ActEMpTrq_pct@ */ /end MEASUREMENT
/begin MEASUREMENT VOUTP_EMRC1ActEMOutSftSpd_rpm "" FLOAT32_IEEE SWC_OUTP_type_CM_single_rpm 0 0 -100000.0 100000.0 ECU_ADDRESS 0x0000 /* @ECU_Address@VOUTP_EMRC1ActEMOutSftSpd_rpm@ */ /end MEASUREMENT
/begin MEASUREMENT VOUTP_EMRC1ActEMpTrqHrls_pct "" FLOAT32_IEEE SWC_OUTP_type_CM_single_pct 0 0 -125.0 125.0 ECU_ADDRESS 0x0000 /* @ECU_Address@VOUTP_EMRC1ActEMpTrqHrls_pct@ */ /end MEASUREMENT
/begin MEASUREMENT VOUTP_EMRC1ActMaxAvaEMRecpTrq_pct "" FLOAT32_IEEE SWC_OUTP_type_CM_single_pct 0 0 -125.0 125.0 ECU_ADDRESS 0x0000 /* @ECU_Address@VOUTP_EMRC1ActMaxAvaEMRecpTrq_pct@ */ /end MEASUREMENT
/begin MEASUREMENT VOUTP_EC1EMSpdIdleP1_rpm "" FLOAT32_IEEE SWC_OUTP_type_CM_single_rpm 0 0 -100000.0 100000.0 ECU_ADDRESS 0x0000 /* @ECU_Address@VOUTP_EC1EMSpdIdleP1_rpm@ */ /end MEASUREMENT
/begin MEASUREMENT VOUTP_EC1PercTorqIdleP1_pct "" FLOAT32_IEEE SWC_OUTP_type_CM_single_pct 0 0 -125.0 125.0 ECU_ADDRESS 0x0000 /* @ECU_Address@VOUTP_EC1PercTorqIdleP1_pct@ */ /end MEASUREMENT
/begin MEASUREMENT VOUTP_EC1EMSpdIdleP2_rpm "" FLOAT32_IEEE SWC_OUTP_type_CM_single_rpm 0 0 -100000.0 100000.0 ECU_ADDRESS 0x0000 /* @ECU_Address@VOUTP_EC1EMSpdIdleP2_rpm@ */ /end MEASUREMENT
/begin MEASUREMENT VOUTP_EC1PercTorqIdleP2_pct "" FLOAT32_IEEE SWC_OUTP_type_CM_single_pct 0 0 -125.0 125.0 ECU_ADDRESS 0x0000 /* @ECU_Address@VOUTP_EC1PercTorqIdleP2_pct@ */ /end MEASUREMENT
/begin MEASUREMENT VOUTP_EC1EMSpdIdleP3_rpm "" FLOAT32_IEEE SWC_OUTP_type_CM_single_rpm 0 0 -100000.0 100000.0 ECU_ADDRESS 0x0000 /* @ECU_Address@VOUTP_EC1EMSpdIdleP3_rpm@ */ /end MEASUREMENT
/begin MEASUREMENT VOUTP_EC1PercTorqIdleP3_pct "" FLOAT32_IEEE SWC_OUTP_type_CM_single_pct 0 0 -125.0 125.0 ECU_ADDRESS 0x0000 /* @ECU_Address@VOUTP_EC1PercTorqIdleP3_pct@ */ /end MEASUREMENT
/begin MEASUREMENT VOUTP_EC1EMSpdIdleP4_rpm "" FLOAT32_IEEE SWC_OUTP_type_CM_single_rpm 0 0 -100000.0 100000.0 ECU_ADDRESS 0x0000 /* @ECU_Address@VOUTP_EC1EMSpdIdleP4_rpm@ */ /end MEASUREMENT
/begin MEASUREMENT VOUTP_EC1PercTorqIdleP4_pct "" FLOAT32_IEEE SWC_OUTP_type_CM_single_pct 0 0 -125.0 125.0 ECU_ADDRESS 0x0000 /* @ECU_Address@VOUTP_EC1PercTorqIdleP4_pct@ */ /end MEASUREMENT
/begin MEASUREMENT VOUTP_EC1PercTorqIdleP5_pct "" FLOAT32_IEEE SWC_OUTP_type_CM_single_pct 0 0 -125.0 125.0 ECU_ADDRESS 0x0000 /* @ECU_Address@VOUTP_EC1PercTorqIdleP5_pct@ */ /end MEASUREMENT
/begin MEASUREMENT VOUTP_EC1EMSpdIdleP5_rpm "" FLOAT32_IEEE SWC_OUTP_type_CM_single_rpm 0 0 -100000.0 100000.0 ECU_ADDRESS 0x0000 /* @ECU_Address@VOUTP_EC1EMSpdIdleP5_rpm@ */ /end MEASUREMENT
/begin MEASUREMENT VOUTP_EC1EMRefTorq_Nm "" FLOAT32_IEEE SWC_OUTP_type_CM_single_Nm 0 0 -100000.0 100000.0 ECU_ADDRESS 0x0000 /* @ECU_Address@VOUTP_EC1EMRefTorq_Nm@ */ /end MEASUREMENT
/begin MEASUREMENT VOUTP_EC1EMMaxMEngOvrSP7_rpm "" FLOAT32_IEEE SWC_OUTP_type_CM_single_rpm 0 0 -100000.0 100000.0 ECU_ADDRESS 0x0000 /* @ECU_Address@VOUTP_EC1EMMaxMEngOvrSP7_rpm@ */ /end MEASUREMENT
/begin MEASUREMENT VOUTP_EC1EMMaxMOvrTmt_s "" FLOAT32_IEEE SWC_OUTP_type_CM_single_s 0 0 0.0 3600.0 ECU_ADDRESS 0x0000 /* @ECU_Address@VOUTP_EC1EMMaxMOvrTmt_s@ */ /end MEASUREMENT
/begin MEASUREMENT VOUTP_EC1EMReqSpdCtrlLoLmt_rpm "" FLOAT32_IEEE SWC_OUTP_type_CM_single_rpm 0 0 -100000.0 100000.0 ECU_ADDRESS 0x0000 /* @ECU_Address@VOUTP_EC1EMReqSpdCtrlLoLmt_rpm@ */ /end MEASUREMENT
/begin MEASUREMENT VOUTP_EC1EMReqTrqCtrlLoLmt_pct "" FLOAT32_IEEE SWC_OUTP_type_CM_single_pct 0 0 -125.0 125.0 ECU_ADDRESS 0x0000 /* @ECU_Address@VOUTP_EC1EMReqTrqCtrlLoLmt_pct@ */ /end MEASUREMENT
/begin MEASUREMENT VOUTP_EC1EMReqSpdCtrlUpLmt_rpm "" FLOAT32_IEEE SWC_OUTP_type_CM_single_rpm 0 0 -100000.0 100000.0 ECU_ADDRESS 0x0000 /* @ECU_Address@VOUTP_EC1EMReqSpdCtrlUpLmt_rpm@ */ /end MEASUREMENT
/begin MEASUREMENT VOUTP_EC1EMReqTrqCtrlUpLmt_pct "" FLOAT32_IEEE SWC_OUTP_type_CM_single_pct 0 0 -125.0 125.0 ECU_ADDRESS 0x0000 /* @ECU_Address@VOUTP_EC1EMReqTrqCtrlUpLmt_pct@ */ /end MEASUREMENT
/begin MEASUREMENT VOUTP_EC1EMExtRSCtrlUpLmt_rpm "" FLOAT32_IEEE SWC_OUTP_type_CM_single_rpm 0 0 -100000.0 100000.0 ECU_ADDRESS 0x0000 /* @ECU_Address@VOUTP_EC1EMExtRSCtrlUpLmt_rpm@ */ /end MEASUREMENT
/begin MEASUREMENT VOUTP_EC1EMMomOfInertia_kgpm2 "" FLOAT32_IEEE SWC_OUTP_type_CM_single_kgpm2 0 0 0.0 100000.0 ECU_ADDRESS 0x0000 /* @ECU_Address@VOUTP_EC1EMMomOfInertia_kgpm2@ */ /end MEASUREMENT
/begin MEASUREMENT VOUTP_EC1EMDefTrqLmt_rpm "" FLOAT32_IEEE SWC_OUTP_type_CM_single_rpm 0 0 -100000.0 100000.0 ECU_ADDRESS 0x0000 /* @ECU_Address@VOUTP_EC1EMDefTrqLmt_rpm@ */ /end MEASUREMENT
/begin MEASUREMENT VOUTP_EC1EMSpdHdleP6_rpm "" FLOAT32_IEEE SWC_OUTP_type_CM_single_rpm 0 0 -100000.0 100000.0 ECU_ADDRESS 0x0000 /* @ECU_Address@VOUTP_EC1EMSpdHdleP6_rpm@ */ /end MEASUREMENT
/begin MEASUREMENT VOUTP_EC1EMGainEndSpdGvn_gain "" FLOAT32_IEEE SWC_OUTP_type_CM_single_gain 0 0 0.0 100000.0 ECU_ADDRESS 0x0000 /* @ECU_Address@VOUTP_EC1EMGainEndSpdGvn_gain@ */ /end MEASUREMENT
/begin MEASUREMENT VOUTP_RC1RetCtrlMth_enum "" FLOAT32_IEEE SWC_OUTP_type_CM_single_enum 0 0 -125.0 130.0 ECU_ADDRESS 0x0000 /* @ECU_Address@VOUTP_RC1RetCtrlMth_enum@ */ /end MEASUREMENT
/begin MEASUREMENT VOUTP_RC1RetSpdIdleP1_rpm "" FLOAT32_IEEE SWC_OUTP_type_CM_single_rpm 0 0 -100000.0 100000.0 ECU_ADDRESS 0x0000 /* @ECU_Address@VOUTP_RC1RetSpdIdleP1_rpm@ */ /end MEASUREMENT
/begin MEASUREMENT VOUTP_RC1PctTrqIdleP1_pct "" FLOAT32_IEEE SWC_OUTP_type_CM_single_pct 0 0 -125.0 125.0 ECU_ADDRESS 0x0000 /* @ECU_Address@VOUTP_RC1PctTrqIdleP1_pct@ */ /end MEASUREMENT
/begin MEASUREMENT VOUTP_RC1MaxRetSpdP2_rpm "" FLOAT32_IEEE SWC_OUTP_type_CM_single_rpm 0 0 -100000.0 100000.0 ECU_ADDRESS 0x0000 /* @ECU_Address@VOUTP_RC1MaxRetSpdP2_rpm@ */ /end MEASUREMENT
/begin MEASUREMENT VOUTP_RC1RetSpdP2_pct "" FLOAT32_IEEE SWC_OUTP_type_CM_single_pct 0 0 -125.0 125.0 ECU_ADDRESS 0x0000 /* @ECU_Address@VOUTP_RC1RetSpdP2_pct@ */ /end MEASUREMENT
/begin MEASUREMENT VOUTP_RC1MaxRetSpdP3_rpm "" FLOAT32_IEEE SWC_OUTP_type_CM_single_rpm 0 0 -100000.0 100000.0 ECU_ADDRESS 0x0000 /* @ECU_Address@VOUTP_RC1MaxRetSpdP3_rpm@ */ /end MEASUREMENT
/begin MEASUREMENT VOUTP_RC1PctTrqP3_pct "" FLOAT32_IEEE SWC_OUTP_type_CM_single_pct 0 0 -125.0 125.0 ECU_ADDRESS 0x0000 /* @ECU_Address@VOUTP_RC1PctTrqP3_pct@ */ /end MEASUREMENT
/begin MEASUREMENT VOUTP_RC1RefRetTrq_Nm "" FLOAT32_IEEE SWC_OUTP_type_CM_single_Nm 0 0 -100000.0 100000.0 ECU_ADDRESS 0x0000 /* @ECU_Address@VOUTP_RC1RefRetTrq_Nm@ */ /end MEASUREMENT
/begin MEASUREMENT VOUTP_RC1RetSpdPekTrqP5_Nm "" FLOAT32_IEEE SWC_OUTP_type_CM_single_Nm 0 0 -100000.0 100000.0 ECU_ADDRESS 0x0000 /* @ECU_Address@VOUTP_RC1RetSpdPekTrqP5_Nm@ */ /end MEASUREMENT
/begin MEASUREMENT VOUTP_RC1RetSpdP4_rpm "" FLOAT32_IEEE SWC_OUTP_type_CM_single_rpm 0 0 -100000.0 100000.0 ECU_ADDRESS 0x0000 /* @ECU_Address@VOUTP_RC1RetSpdP4_rpm@ */ /end MEASUREMENT
/begin MEASUREMENT VOUTP_EMRC1DrvDemEMRtapTrq_pct "" FLOAT32_IEEE SWC_OUTP_type_CM_single_pct 0 0 -125.0 125.0 ECU_ADDRESS 0x0000 /* @ECU_Address@VOUTP_EMRC1DrvDemEMRtapTrq_pct@ */ /end MEASUREMENT
/begin MEASUREMENT VOUTP_EMRC1RetSelNonEng_pct "" FLOAT32_IEEE SWC_OUTP_type_CM_single_pct 0 0 -125.0 125.0 ECU_ADDRESS 0x0000 /* @ECU_Address@VOUTP_EMRC1RetSelNonEng_pct@ */ /end MEASUREMENT
/begin MEASUREMENT VOUTP_FrTMTqReq_Nm "" FLOAT32_IEEE SWC_OUTP_type_CM_single_Nm 0 0 -100000.0 100000.0 ECU_ADDRESS 0x0000 /* @ECU_Address@VOUTP_FrTMTqReq_Nm@ */ /end MEASUREMENT
/begin MEASUREMENT VOUTP_FeatSetSpdFinal_raw32 "" FLOAT32_IEEE SWC_OUTP_type_CM_single_raw32 0 0 0.0 255.0 ECU_ADDRESS 0x0000 /* @ECU_Address@VOUTP_FeatSetSpdFinal_raw32@ */ /end MEASUREMENT
/begin MEASUREMENT VOUTP_MeterIndSpeed_raw32 "" FLOAT32_IEEE SWC_OUTP_type_CM_single_raw32 0 0 0.0 254.0 ECU_ADDRESS 0x0000 /* @ECU_Address@VOUTP_MeterIndSpeed_raw32@ */ /end MEASUREMENT
/begin MEASUREMENT VOUTP_FeatReqSpd_kph "" FLOAT32_IEEE SWC_OUTP_type_CM_single_kph 0 0 0.0 255.75 ECU_ADDRESS 0x0000 /* @ECU_Address@VOUTP_FeatReqSpd_kph@ */ /end MEASUREMENT
/begin MEASUREMENT VOUTP_JerkPCT_pct "" FLOAT32_IEEE SWC_OUTP_type_CM_single_pct 0 0 0.0 100.0 ECU_ADDRESS 0x0000 /* @ECU_Address@VOUTP_JerkPCT_pct@ */ /end MEASUREMENT
/begin MEASUREMENT VOUTP_LimitPCT_pct "" FLOAT32_IEEE SWC_OUTP_type_CM_single_pct 0 0 0.0 100.0 ECU_ADDRESS 0x0000 /* @ECU_Address@VOUTP_LimitPCT_pct@ */ /end MEASUREMENT
/begin MEASUREMENT VOUTP_AccCalcuPID_mps2 "" FLOAT32_IEEE SWC_OUTP_type_CM_single_mps2 0 0 -15.0 10.55 ECU_ADDRESS 0x0000 /* @ECU_Address@VOUTP_AccCalcuPID_mps2@ */ /end MEASUREMENT
/begin MEASUREMENT VOUTP_ISOAccLimit_mps2 "" FLOAT32_IEEE SWC_OUTP_type_CM_single_mps2 0 0 0.0 10.0 ECU_ADDRESS 0x0000 /* @ECU_Address@VOUTP_ISOAccLimit_mps2@ */ /end MEASUREMENT
/begin MEASUREMENT VOUTP_ISODecLimit_mps2 "" FLOAT32_IEEE SWC_OUTP_type_CM_single_mps2 0 0 -10.0 0.0 ECU_ADDRESS 0x0000 /* @ECU_Address@VOUTP_ISODecLimit_mps2@ */ /end MEASUREMENT
/begin MEASUREMENT VOUTP_ISOJerkLimit_mps3 "" FLOAT32_IEEE SWC_OUTP_type_CM_single_mps3 0 0 0.0 10.0 ECU_ADDRESS 0x0000 /* @ECU_Address@VOUTP_ISOJerkLimit_mps3@ */ /end MEASUREMENT
/begin MEASUREMENT VOUTP_ACCRequiredAccel_mps2 "" FLOAT32_IEEE SWC_OUTP_type_CM_single_mps2 0 0 -15.0 10.55 ECU_ADDRESS 0x0000 /* @ECU_Address@VOUTP_ACCRequiredAccel_mps2@ */ /end MEASUREMENT
/begin MEASUREMENT VOUTP_DISCReqAcc_mps2 "" FLOAT32_IEEE SWC_OUTP_type_CM_single_mps2 0 0 -15.0 10.55 ECU_ADDRESS 0x0000 /* @ECU_Address@VOUTP_DISCReqAcc_mps2@ */ /end MEASUREMENT
/begin MEASUREMENT VOUTP_ActACCRequiredAccel_mps2 "" FLOAT32_IEEE SWC_OUTP_type_CM_single_mps2 0 0 -15.0 10.55 ECU_ADDRESS 0x0000 /* @ECU_Address@VOUTP_ActACCRequiredAccel_mps2@ */ /end MEASUREMENT
/begin MEASUREMENT VOUTP_LKAStrToqReq_Nm "" FLOAT32_IEEE SWC_OUTP_type_CM_single_Nm 0 0 -8.0 8.0 ECU_ADDRESS 0x0000 /* @ECU_Address@VOUTP_LKAStrToqReq_Nm@ */ /end MEASUREMENT
/begin MEASUREMENT VOUTP_ACCObjDist_m "" FLOAT32_IEEE SWC_OUTP_type_CM_single_m 0 0 0.0 204.6 ECU_ADDRESS 0x0000 /* @ECU_Address@VOUTP_ACCObjDist_m@ */ /end MEASUREMENT
/begin MEASUREMENT VOUTP_ACCObjRelSpd_mps "" FLOAT32_IEEE SWC_OUTP_type_CM_single_mps 0 0 -100.0 104.6 ECU_ADDRESS 0x0000 /* @ECU_Address@VOUTP_ACCObjRelSpd_mps@ */ /end MEASUREMENT
/begin MEASUREMENT VOUTP_ACCJerkUpperLimit_mps3 "" FLOAT32_IEEE SWC_OUTP_type_CM_single_mps3 0 0 -6.0 6.7 ECU_ADDRESS 0x0000 /* @ECU_Address@VOUTP_ACCJerkUpperLimit_mps3@ */ /end MEASUREMENT
/begin MEASUREMENT VOUTP_ACCComfortBandUpper_mps2 "" FLOAT32_IEEE SWC_OUTP_type_CM_single_mps2 0 0 -15.0 10.55 ECU_ADDRESS 0x0000 /* @ECU_Address@VOUTP_ACCComfortBandUpper_mps2@ */ /end MEASUREMENT
/begin MEASUREMENT VOUTP_ACCJerkLowerLimit_mps3 "" FLOAT32_IEEE SWC_OUTP_type_CM_single_mps3 0 0 -6.0 6.7 ECU_ADDRESS 0x0000 /* @ECU_Address@VOUTP_ACCJerkLowerLimit_mps3@ */ /end MEASUREMENT
/begin MEASUREMENT VOUTP_ACCComfortBandLower_mps2 "" FLOAT32_IEEE SWC_OUTP_type_CM_single_mps2 0 0 -15.0 10.55 ECU_ADDRESS 0x0000 /* @ECU_Address@VOUTP_ACCComfortBandLower_mps2@ */ /end MEASUREMENT
/begin MEASUREMENT VOUTP_ADASVehSpdLim_raw32 "" FLOAT32_IEEE SWC_OUTP_type_CM_single_raw32 0 0 0.0 254.0 ECU_ADDRESS 0x0000 /* @ECU_Address@VOUTP_ADASVehSpdLim_raw32@ */ /end MEASUREMENT
/begin MEASUREMENT VOUTP_ADASLanecurveL_raw32 "" FLOAT32_IEEE SWC_OUTP_type_CM_single_raw32 0 0 -0.03 0.03 ECU_ADDRESS 0x0000 /* @ECU_Address@VOUTP_ADASLanecurveL_raw32@ */ /end MEASUREMENT
/begin MEASUREMENT VOUTP_ADASLanecurveR_raw32 "" FLOAT32_IEEE SWC_OUTP_type_CM_single_raw32 0 0 -0.03 0.03 ECU_ADDRESS 0x0000 /* @ECU_Address@VOUTP_ADASLanecurveR_raw32@ */ /end MEASUREMENT
/begin MEASUREMENT VOUTP_APSDecReq_mps2 "" FLOAT32_IEEE SWC_OUTP_type_CM_single_mps2 0 0 0.0 25.4 ECU_ADDRESS 0x0000 /* @ECU_Address@VOUTP_APSDecReq_mps2@ */ /end MEASUREMENT
/begin MEASUREMENT VOUTP_LongAcc_Gps "" FLOAT32_IEEE SWC_OUTP_type_CM_single_Gps 0 0 -20.0 20.0 ECU_ADDRESS 0x0000 /* @ECU_Address@VOUTP_LongAcc_Gps@ */ /end MEASUREMENT
/begin MEASUREMENT VOUTP_CalibratedAccX_G "" FLOAT32_IEEE SWC_OUTP_type_CM_single_G 0 0 -65.536 65.536 ECU_ADDRESS 0x0000 /* @ECU_Address@VOUTP_CalibratedAccX_G@ */ /end MEASUREMENT
/begin MEASUREMENT VOUTP_CalibratedAccY_G "" FLOAT32_IEEE SWC_OUTP_type_CM_single_G 0 0 -65.536 65.536 ECU_ADDRESS 0x0000 /* @ECU_Address@VOUTP_CalibratedAccY_G@ */ /end MEASUREMENT
/begin MEASUREMENT VOUTP_CalibratedAccZ_G "" FLOAT32_IEEE SWC_OUTP_type_CM_single_G 0 0 -65.536 65.536 ECU_ADDRESS 0x0000 /* @ECU_Address@VOUTP_CalibratedAccZ_G@ */ /end MEASUREMENT
/begin MEASUREMENT VOUTP_CalibratedGyroX_Dps "" FLOAT32_IEEE SWC_OUTP_type_CM_single_Dps 0 0 -1966.0 1966.0 ECU_ADDRESS 0x0000 /* @ECU_Address@VOUTP_CalibratedGyroX_Dps@ */ /end MEASUREMENT
/begin MEASUREMENT VOUTP_CalibratedGyroY_Dps "" FLOAT32_IEEE SWC_OUTP_type_CM_single_Dps 0 0 -1966.0 1966.0 ECU_ADDRESS 0x0000 /* @ECU_Address@VOUTP_CalibratedGyroY_Dps@ */ /end MEASUREMENT
/begin MEASUREMENT VOUTP_CalibratedGyroZ_Dps "" FLOAT32_IEEE SWC_OUTP_type_CM_single_Dps 0 0 -1966.0 1966.0 ECU_ADDRESS 0x0000 /* @ECU_Address@VOUTP_CalibratedGyroZ_Dps@ */ /end MEASUREMENT
/begin MEASUREMENT VOUTP_FDCVMCAPSAngleTarget_deg "" FLOAT32_IEEE SWC_OUTP_type_CM_single_deg 0 0 -360.0 360.0 ECU_ADDRESS 0x0000 /* @ECU_Address@VOUTP_FDCVMCAPSAngleTarget_deg@ */ /end MEASUREMENT
/begin MEASUREMENT VOUTP_FDCVMCAngCtrlTqWtGn_pct "" FLOAT32_IEEE SWC_OUTP_type_CM_single_pct 0 0 0.0 102.0 ECU_ADDRESS 0x0000 /* @ECU_Address@VOUTP_FDCVMCAngCtrlTqWtGn_pct@ */ /end MEASUREMENT
/begin MEASUREMENT VOUTP_FDCVMCMaxAngCtrlOutTqLim_Nm "" FLOAT32_IEEE SWC_OUTP_type_CM_single_Nm 0 0 0.0 51.1 ECU_ADDRESS 0x0000 /* @ECU_Address@VOUTP_FDCVMCMaxAngCtrlOutTqLim_Nm@ */ /end MEASUREMENT
/begin MEASUREMENT VOUTP_FDCVMCDrInpTqBstGn_pct "" FLOAT32_IEEE SWC_OUTP_type_CM_single_pct 0 0 0.0 102.0 ECU_ADDRESS 0x0000 /* @ECU_Address@VOUTP_FDCVMCDrInpTqBstGn_pct@ */ /end MEASUREMENT
/begin MEASUREMENT VOUTP_RESSCNTDODRNGL_cnt "" UWORD SWC_OUTP_type_CM_uint16 0 0 0 65535 ARRAY_SIZE 8 ECU_ADDRESS 0x0000 /* @ECU_Address@VOUTP_RESSCNTDODRNGL_cnt@ */ /end MEASUREMENT
/begin MEASUREMENT VOUTP_RESSCNTDODRNGR_cnt "" UWORD SWC_OUTP_type_CM_uint16 0 0 0 65535 ARRAY_SIZE 8 ECU_ADDRESS 0x0000 /* @ECU_Address@VOUTP_RESSCNTDODRNGR_cnt@ */ /end MEASUREMENT
/begin MEASUREMENT VOUTP_APSDRLR_cm "" UWORD SWC_OUTP_type_CM_uint16_cm 0 0 0.0 65535.0 ECU_ADDRESS 0x0000 /* @ECU_Address@VOUTP_APSDRLR_cm@ */ /end MEASUREMENT
/begin MEASUREMENT VOUTP_APSDRLL_cm "" UWORD SWC_OUTP_type_CM_uint16_cm 0 0 0.0 65535.0 ECU_ADDRESS 0x0000 /* @ECU_Address@VOUTP_APSDRLL_cm@ */ /end MEASUREMENT
/begin MEASUREMENT VOUTP_APSDFLR_cm "" UWORD SWC_OUTP_type_CM_uint16_cm 0 0 0.0 65535.0 ECU_ADDRESS 0x0000 /* @ECU_Address@VOUTP_APSDFLR_cm@ */ /end MEASUREMENT
/begin MEASUREMENT VOUTP_APSDFLL_cm "" UWORD SWC_OUTP_type_CM_uint16_cm 0 0 0.0 65535.0 ECU_ADDRESS 0x0000 /* @ECU_Address@VOUTP_APSDFLL_cm@ */ /end MEASUREMENT
/begin MEASUREMENT VOUTP_MILTIME_min "" UWORD SWC_OUTP_type_CM_uint16_min 0 0 0.0 65535.0 ECU_ADDRESS 0x0000 /* @ECU_Address@VOUTP_MILTIME_min@ */ /end MEASUREMENT
/begin MEASUREMENT VOUTP_CLRTIME_min "" UWORD SWC_OUTP_type_CM_uint16_min 0 0 0.0 65535.0 ECU_ADDRESS 0x0000 /* @ECU_Address@VOUTP_CLRTIME_min@ */ /end MEASUREMENT
/begin MEASUREMENT VOUTP_NUMPSATRIPSFLTMEMCLR_cnt "" UWORD SWC_OUTP_type_CM_uint16_cnt 0 0 0.0 65535.0 ECU_ADDRESS 0x0000 /* @ECU_Address@VOUTP_NUMPSATRIPSFLTMEMCLR_cnt@ */ /end MEASUREMENT
/begin MEASUREMENT VOUTP_IGNCNTR_cnt "" UWORD SWC_OUTP_type_CM_uint16_cnt 0 0 0.0 65535.0 ECU_ADDRESS 0x0000 /* @ECU_Address@VOUTP_IGNCNTR_cnt@ */ /end MEASUREMENT
/begin MEASUREMENT VOUTP_CFGEM1BAMTSize_raw "" UWORD SWC_OUTP_type_CM_uint16_raw 0 0 0.0 65535.0 ECU_ADDRESS 0x0000 /* @ECU_Address@VOUTP_CFGEM1BAMTSize_raw@ */ /end MEASUREMENT
/begin MEASUREMENT VOUTP_ECUNAME_cnt "" UBYTE SWC_OUTP_type_CM_uint8 0 0 0 255 ARRAY_SIZE 20 ECU_ADDRESS 0x0000 /* @ECU_Address@VOUTP_ECUNAME_cnt@ */ /end MEASUREMENT
/begin MEASUREMENT VOUTP_CALID_cnt "" UBYTE SWC_OUTP_type_CM_uint8 0 0 0 255 ARRAY_SIZE 16 ECU_ADDRESS 0x0000 /* @ECU_Address@VOUTP_CALID_cnt@ */ /end MEASUREMENT
/begin MEASUREMENT VOUTP_EACEnDemand_enum "" UBYTE SWC_OUTP_type_CM_uint8_enum 0 0 0.0 255.0 ECU_ADDRESS 0x0000 /* @ECU_Address@VOUTP_EACEnDemand_enum@ */ /end MEASUREMENT
/begin MEASUREMENT VOUTP_EHPSEnDemand_enum "" UBYTE SWC_OUTP_type_CM_uint8_enum 0 0 0.0 255.0 ECU_ADDRESS 0x0000 /* @ECU_Address@VOUTP_EHPSEnDemand_enum@ */ /end MEASUREMENT
/begin MEASUREMENT VOUTP_DCDCEnDemamd_enum "" UBYTE SWC_OUTP_type_CM_uint8_enum 0 0 0.0 255.0 ECU_ADDRESS 0x0000 /* @ECU_Address@VOUTP_DCDCEnDemamd_enum@ */ /end MEASUREMENT
/begin MEASUREMENT VOUTP_FSOffSw_enum "" UBYTE SWC_OUTP_type_CM_uint8_enum 0 0 0.0 255.0 ECU_ADDRESS 0x0000 /* @ECU_Address@VOUTP_FSOffSw_enum@ */ /end MEASUREMENT
/begin MEASUREMENT VOUTP_ChrgPlugSta_enum "" UBYTE SWC_OUTP_type_CM_uint8_enum 0 0 0.0 255.0 ECU_ADDRESS 0x0000 /* @ECU_Address@VOUTP_ChrgPlugSta_enum@ */ /end MEASUREMENT
/begin MEASUREMENT VOUTP_PASDRMR_cm "" UBYTE SWC_OUTP_type_CM_uint8_cm 0 0 0.0 255.0 ECU_ADDRESS 0x0000 /* @ECU_Address@VOUTP_PASDRMR_cm@ */ /end MEASUREMENT
/begin MEASUREMENT VOUTP_PASDRML_cm "" UBYTE SWC_OUTP_type_CM_uint8_cm 0 0 0.0 255.0 ECU_ADDRESS 0x0000 /* @ECU_Address@VOUTP_PASDRML_cm@ */ /end MEASUREMENT
/begin MEASUREMENT VOUTP_PASDRCR_cm "" UBYTE SWC_OUTP_type_CM_uint8_cm 0 0 0.0 255.0 ECU_ADDRESS 0x0000 /* @ECU_Address@VOUTP_PASDRCR_cm@ */ /end MEASUREMENT
/begin MEASUREMENT VOUTP_PASDRCL_cm "" UBYTE SWC_OUTP_type_CM_uint8_cm 0 0 0.0 255.0 ECU_ADDRESS 0x0000 /* @ECU_Address@VOUTP_PASDRCL_cm@ */ /end MEASUREMENT
/begin MEASUREMENT VOUTP_PASDFMR_cm "" UBYTE SWC_OUTP_type_CM_uint8_cm 0 0 0.0 255.0 ECU_ADDRESS 0x0000 /* @ECU_Address@VOUTP_PASDFMR_cm@ */ /end MEASUREMENT
/begin MEASUREMENT VOUTP_PASDFML_cm "" UBYTE SWC_OUTP_type_CM_uint8_cm 0 0 0.0 255.0 ECU_ADDRESS 0x0000 /* @ECU_Address@VOUTP_PASDFML_cm@ */ /end MEASUREMENT
/begin MEASUREMENT VOUTP_PASDFCR_cm "" UBYTE SWC_OUTP_type_CM_uint8_cm 0 0 0.0 255.0 ECU_ADDRESS 0x0000 /* @ECU_Address@VOUTP_PASDFCR_cm@ */ /end MEASUREMENT
/begin MEASUREMENT VOUTP_PASDFCL_cm "" UBYTE SWC_OUTP_type_CM_uint8_cm 0 0 0.0 255.0 ECU_ADDRESS 0x0000 /* @ECU_Address@VOUTP_PASDFCL_cm@ */ /end MEASUREMENT
/begin MEASUREMENT VOUTP_PASAFCL_enum "" UBYTE SWC_OUTP_type_CM_uint8_enum 0 0 0.0 255.0 ECU_ADDRESS 0x0000 /* @ECU_Address@VOUTP_PASAFCL_enum@ */ /end MEASUREMENT
/begin MEASUREMENT VOUTP_PASARMR_enum "" UBYTE SWC_OUTP_type_CM_uint8_enum 0 0 0.0 255.0 ECU_ADDRESS 0x0000 /* @ECU_Address@VOUTP_PASARMR_enum@ */ /end MEASUREMENT
/begin MEASUREMENT VOUTP_PASARML_enum "" UBYTE SWC_OUTP_type_CM_uint8_enum 0 0 0.0 255.0 ECU_ADDRESS 0x0000 /* @ECU_Address@VOUTP_PASARML_enum@ */ /end MEASUREMENT
/begin MEASUREMENT VOUTP_PASARCR_enum "" UBYTE SWC_OUTP_type_CM_uint8_enum 0 0 0.0 255.0 ECU_ADDRESS 0x0000 /* @ECU_Address@VOUTP_PASARCR_enum@ */ /end MEASUREMENT
/begin MEASUREMENT VOUTP_PASARCL_enum "" UBYTE SWC_OUTP_type_CM_uint8_enum 0 0 0.0 255.0 ECU_ADDRESS 0x0000 /* @ECU_Address@VOUTP_PASARCL_enum@ */ /end MEASUREMENT
/begin MEASUREMENT VOUTP_PASAFMR_enum "" UBYTE SWC_OUTP_type_CM_uint8_enum 0 0 0.0 255.0 ECU_ADDRESS 0x0000 /* @ECU_Address@VOUTP_PASAFMR_enum@ */ /end MEASUREMENT
/begin MEASUREMENT VOUTP_PASAFML_enum "" UBYTE SWC_OUTP_type_CM_uint8_enum 0 0 0.0 255.0 ECU_ADDRESS 0x0000 /* @ECU_Address@VOUTP_PASAFML_enum@ */ /end MEASUREMENT
/begin MEASUREMENT VOUTP_PASAFCR_enum "" UBYTE SWC_OUTP_type_CM_uint8_enum 0 0 0.0 255.0 ECU_ADDRESS 0x0000 /* @ECU_Address@VOUTP_PASAFCR_enum@ */ /end MEASUREMENT
/begin MEASUREMENT VOUTP_Chime_enum "" UBYTE SWC_OUTP_type_CM_uint8_enum 0 0 0.0 255.0 ECU_ADDRESS 0x0000 /* @ECU_Address@VOUTP_Chime_enum@ */ /end MEASUREMENT
/begin MEASUREMENT VOUTP_ModOperation_enum "" UBYTE SWC_OUTP_type_CM_uint8_enum 0 0 0.0 255.0 ECU_ADDRESS 0x0000 /* @ECU_Address@VOUTP_ModOperation_enum@ */ /end MEASUREMENT
/begin MEASUREMENT VOUTP_LFWhlRotDir_enum "" UBYTE SWC_OUTP_type_CM_uint8_enum 0 0 0.0 3.0 ECU_ADDRESS 0x0000 /* @ECU_Address@VOUTP_LFWhlRotDir_enum@ */ /end MEASUREMENT
/begin MEASUREMENT VOUTP_LRWhlRotDir_enum "" UBYTE SWC_OUTP_type_CM_uint8_enum 0 0 0.0 3.0 ECU_ADDRESS 0x0000 /* @ECU_Address@VOUTP_LRWhlRotDir_enum@ */ /end MEASUREMENT
/begin MEASUREMENT VOUTP_LFPulseCount_enum "" UBYTE SWC_OUTP_type_CM_uint8_enum 0 0 0.0 255.0 ECU_ADDRESS 0x0000 /* @ECU_Address@VOUTP_LFPulseCount_enum@ */ /end MEASUREMENT
/begin MEASUREMENT VOUTP_LRPulseCount_enum "" UBYTE SWC_OUTP_type_CM_uint8_enum 0 0 0.0 255.0 ECU_ADDRESS 0x0000 /* @ECU_Address@VOUTP_LRPulseCount_enum@ */ /end MEASUREMENT
/begin MEASUREMENT VOUTP_DriIntend_enum "" UBYTE SWC_OUTP_type_CM_uint8_enum 0 0 0.0 2.0 ECU_ADDRESS 0x0000 /* @ECU_Address@VOUTP_DriIntend_enum@ */ /end MEASUREMENT
/begin MEASUREMENT VOUTP_EPSAOIControl_enum "" UBYTE SWC_OUTP_type_CM_uint8_enum 0 0 0.0 3.0 ECU_ADDRESS 0x0000 /* @ECU_Address@VOUTP_EPSAOIControl_enum@ */ /end MEASUREMENT
/begin MEASUREMENT VOUTP_ESCAPSSta_enum "" UBYTE SWC_OUTP_type_CM_uint8_enum 0 0 0.0 5.0 ECU_ADDRESS 0x0000 /* @ECU_Address@VOUTP_ESCAPSSta_enum@ */ /end MEASUREMENT
/begin MEASUREMENT VOUTP_EPBErrSta_enum "" UBYTE SWC_OUTP_type_CM_uint8_enum 0 0 0.0 2.0 ECU_ADDRESS 0x0000 /* @ECU_Address@VOUTP_EPBErrSta_enum@ */ /end MEASUREMENT
/begin MEASUREMENT VOUTP_EPBSta_enum "" UBYTE SWC_OUTP_type_CM_uint8_enum 0 0 0.0 4.0 ECU_ADDRESS 0x0000 /* @ECU_Address@VOUTP_EPBSta_enum@ */ /end MEASUREMENT
/begin MEASUREMENT VOUTP_AVMparkingcancel_enum "" UBYTE SWC_OUTP_type_CM_uint8_enum 0 0 0.0 3.0 ECU_ADDRESS 0x0000 /* @ECU_Address@VOUTP_AVMparkingcancel_enum@ */ /end MEASUREMENT
/begin MEASUREMENT VOUTP_AVMparkingexcute_enum "" UBYTE SWC_OUTP_type_CM_uint8_enum 0 0 0.0 3.0 ECU_ADDRESS 0x0000 /* @ECU_Address@VOUTP_AVMparkingexcute_enum@ */ /end MEASUREMENT
/begin MEASUREMENT VOUTP_AVMParkingmode_enum "" UBYTE SWC_OUTP_type_CM_uint8_enum 0 0 0.0 15.0 ECU_ADDRESS 0x0000 /* @ECU_Address@VOUTP_AVMParkingmode_enum@ */ /end MEASUREMENT
/begin MEASUREMENT VOUTP_CAASSw_enum "" UBYTE SWC_OUTP_type_CM_uint8_enum 0 0 0.0 3.0 ECU_ADDRESS 0x0000 /* @ECU_Address@VOUTP_CAASSw_enum@ */ /end MEASUREMENT
/begin MEASUREMENT VOUTP_IVIScreen_enum "" UBYTE SWC_OUTP_type_CM_uint8_enum 0 0 0.0 62.0 ECU_ADDRESS 0x0000 /* @ECU_Address@VOUTP_IVIScreen_enum@ */ /end MEASUREMENT
/begin MEASUREMENT VOUTP_APSRQDisplay_enum "" UBYTE SWC_OUTP_type_CM_uint8_enum 0 0 0.0 255.0 ECU_ADDRESS 0x0000 /* @ECU_Address@VOUTP_APSRQDisplay_enum@ */ /end MEASUREMENT
/begin MEASUREMENT VOUTP_APSSWVer_enum "" UBYTE SWC_OUTP_type_CM_uint8_enum 0 0 0.0 255.0 ECU_ADDRESS 0x0000 /* @ECU_Address@VOUTP_APSSWVer_enum@ */ /end MEASUREMENT
/begin MEASUREMENT VOUTP_APSHWVer_enum "" UBYTE SWC_OUTP_type_CM_uint8_enum 0 0 0.0 255.0 ECU_ADDRESS 0x0000 /* @ECU_Address@VOUTP_APSHWVer_enum@ */ /end MEASUREMENT
/begin MEASUREMENT VOUTP_APSExitCondition_enum "" UBYTE SWC_OUTP_type_CM_uint8_enum 0 0 0.0 255.0 ECU_ADDRESS 0x0000 /* @ECU_Address@VOUTP_APSExitCondition_enum@ */ /end MEASUREMENT
/begin MEASUREMENT VOUTP_CAASSta_enum "" UBYTE SWC_OUTP_type_CM_uint8_enum 0 0 0.0 7.0 ECU_ADDRESS 0x0000 /* @ECU_Address@VOUTP_CAASSta_enum@ */ /end MEASUREMENT
/begin MEASUREMENT VOUTP_DKCPDkeyAreaRAPSSta_enum "" UBYTE SWC_OUTP_type_CM_uint8_enum 0 0 0.0 2.0 ECU_ADDRESS 0x0000 /* @ECU_Address@VOUTP_DKCPDkeyAreaRAPSSta_enum@ */ /end MEASUREMENT
/begin MEASUREMENT VOUTP_DKCParkingModeCmd_enum "" UBYTE SWC_OUTP_type_CM_uint8_enum 0 0 0.0 4.0 ECU_ADDRESS 0x0000 /* @ECU_Address@VOUTP_DKCParkingModeCmd_enum@ */ /end MEASUREMENT
/begin MEASUREMENT VOUTP_APSShiftPosnReq_enum "" UBYTE SWC_OUTP_type_CM_uint8_enum 0 0 0.0 7.0 ECU_ADDRESS 0x0000 /* @ECU_Address@VOUTP_APSShiftPosnReq_enum@ */ /end MEASUREMENT
/begin MEASUREMENT VOUTP_RAPSBCMLamp_enum "" UBYTE SWC_OUTP_type_CM_uint8_enum 0 0 0.0 7.0 ECU_ADDRESS 0x0000 /* @ECU_Address@VOUTP_RAPSBCMLamp_enum@ */ /end MEASUREMENT
/begin MEASUREMENT VOUTP_APSPwrReq_enum "" UBYTE SWC_OUTP_type_CM_uint8_enum 0 0 0.0 7.0 ECU_ADDRESS 0x0000 /* @ECU_Address@VOUTP_APSPwrReq_enum@ */ /end MEASUREMENT
/begin MEASUREMENT VOUTP_RAPSErrWarnSta_enum "" UBYTE SWC_OUTP_type_CM_uint8_enum 0 0 0.0 7.0 ECU_ADDRESS 0x0000 /* @ECU_Address@VOUTP_RAPSErrWarnSta_enum@ */ /end MEASUREMENT
/begin MEASUREMENT VOUTP_InnerBuzzerModeSta_enum "" UBYTE SWC_OUTP_type_CM_uint8_enum 0 0 0.0 5.0 ECU_ADDRESS 0x0000 /* @ECU_Address@VOUTP_InnerBuzzerModeSta_enum@ */ /end MEASUREMENT
/begin MEASUREMENT VOUTP_FDCBCMFRoomLpSetSta_pct "" UBYTE SWC_OUTP_type_CM_uint8_pct 0 0 0.0 100.0 ECU_ADDRESS 0x0000 /* @ECU_Address@VOUTP_FDCBCMFRoomLpSetSta_pct@ */ /end MEASUREMENT
/begin MEASUREMENT VOUTP_FDCBCMFRoomLpCmd_pct "" UBYTE SWC_OUTP_type_CM_uint8_pct 0 0 0.0 100.0 ECU_ADDRESS 0x0000 /* @ECU_Address@VOUTP_FDCBCMFRoomLpCmd_pct@ */ /end MEASUREMENT
/begin MEASUREMENT VOUTP_FDCBCMMRoomLpSetSta_pct "" UBYTE SWC_OUTP_type_CM_uint8_pct 0 0 0.0 100.0 ECU_ADDRESS 0x0000 /* @ECU_Address@VOUTP_FDCBCMMRoomLpSetSta_pct@ */ /end MEASUREMENT
/begin MEASUREMENT VOUTP_FDCBCMMRoomLpCmd_pct "" UBYTE SWC_OUTP_type_CM_uint8_pct 0 0 0.0 100.0 ECU_ADDRESS 0x0000 /* @ECU_Address@VOUTP_FDCBCMMRoomLpCmd_pct@ */ /end MEASUREMENT
/begin MEASUREMENT VOUTP_FDCBCMRRoomLpSetSta_pct "" UBYTE SWC_OUTP_type_CM_uint8_pct 0 0 0.0 100.0 ECU_ADDRESS 0x0000 /* @ECU_Address@VOUTP_FDCBCMRRoomLpSetSta_pct@ */ /end MEASUREMENT
/begin MEASUREMENT VOUTP_FDCBCMRRoomLpCmd_pct "" UBYTE SWC_OUTP_type_CM_uint8_pct 0 0 0.0 100.0 ECU_ADDRESS 0x0000 /* @ECU_Address@VOUTP_FDCBCMRRoomLpCmd_pct@ */ /end MEASUREMENT
/begin MEASUREMENT VOUTP_FDCBCMOSDrOpenSWSta_enum "" UBYTE SWC_OUTP_type_CM_uint8_enum 0 0 0.0 255.0 ECU_ADDRESS 0x0000 /* @ECU_Address@VOUTP_FDCBCMOSDrOpenSWSta_enum@ */ /end MEASUREMENT
/begin MEASUREMENT VOUTP_DTCDetect_enum "" UBYTE SWC_OUTP_type_CM_uint8_enum 0 0 0.0 255.0 ECU_ADDRESS 0x0000 /* @ECU_Address@VOUTP_DTCDetect_enum@ */ /end MEASUREMENT
/begin MEASUREMENT VOUTP_PROTOCOLID_enum "" UBYTE SWC_OUTP_type_CM_uint8_enum 0 0 0.0 2.0 ECU_ADDRESS 0x0000 /* @ECU_Address@VOUTP_PROTOCOLID_enum@ */ /end MEASUREMENT
/begin MEASUREMENT VOUTP_RESSTTEMPRNGAXIS_enum "" UBYTE SWC_OUTP_type_CM_uint8_enum 0 0 0.0 255.0 ECU_ADDRESS 0x0000 /* @ECU_Address@VOUTP_RESSTTEMPRNGAXIS_enum@ */ /end MEASUREMENT
/begin MEASUREMENT VOUTP_RESSTIMESOCRNGAXIS_enum "" UBYTE SWC_OUTP_type_CM_uint8_enum 0 0 0.0 255.0 ECU_ADDRESS 0x0000 /* @ECU_Address@VOUTP_RESSTIMESOCRNGAXIS_enum@ */ /end MEASUREMENT
/begin MEASUREMENT VOUTP_RESSCNTSDODRNGAXIS_enum "" UBYTE SWC_OUTP_type_CM_uint8_enum 0 0 0.0 255.0 ECU_ADDRESS 0x0000 /* @ECU_Address@VOUTP_RESSCNTSDODRNGAXIS_enum@ */ /end MEASUREMENT
/begin MEASUREMENT VOUTP_HEVMODE_enum "" UBYTE SWC_OUTP_type_CM_uint8_enum 0 0 0.0 255.0 ECU_ADDRESS 0x0000 /* @ECU_Address@VOUTP_HEVMODE_enum@ */ /end MEASUREMENT
/begin MEASUREMENT VOUTP_DIDModelVersion_raw "" UBYTE SWC_OUTP_type_CM_uint8_raw 0 0 0.0 255.0 ECU_ADDRESS 0x0000 /* @ECU_Address@VOUTP_DIDModelVersion_raw@ */ /end MEASUREMENT
/begin MEASUREMENT VOUTP_DIDModelVersionChksum_raw "" UBYTE SWC_OUTP_type_CM_uint8_raw 0 0 0.0 255.0 ECU_ADDRESS 0x0000 /* @ECU_Address@VOUTP_DIDModelVersionChksum_raw@ */ /end MEASUREMENT
/begin MEASUREMENT VOUTP_DKCAuthSta_enum "" UBYTE SWC_OUTP_type_CM_uint8_enum 0 0 0.0 255.0 ECU_ADDRESS 0x0000 /* @ECU_Address@VOUTP_DKCAuthSta_enum@ */ /end MEASUREMENT
/begin MEASUREMENT VOUTP_KeyModeSta_enum "" UBYTE SWC_OUTP_type_CM_uint8_enum 0 0 0.0 255.0 ECU_ADDRESS 0x0000 /* @ECU_Address@VOUTP_KeyModeSta_enum@ */ /end MEASUREMENT
/begin MEASUREMENT VOUTP_DkeyShowIVISta_enum "" UBYTE SWC_OUTP_type_CM_uint8_enum 0 0 0.0 255.0 ECU_ADDRESS 0x0000 /* @ECU_Address@VOUTP_DkeyShowIVISta_enum@ */ /end MEASUREMENT
/begin MEASUREMENT VOUTP_KeyAreaPS_enum "" UBYTE SWC_OUTP_type_CM_uint8_enum 0 0 0.0 255.0 ECU_ADDRESS 0x0000 /* @ECU_Address@VOUTP_KeyAreaPS_enum@ */ /end MEASUREMENT
/begin MEASUREMENT VOUTP_KeyAreaLockUnlock_enum "" UBYTE SWC_OUTP_type_CM_uint8_enum 0 0 0.0 255.0 ECU_ADDRESS 0x0000 /* @ECU_Address@VOUTP_KeyAreaLockUnlock_enum@ */ /end MEASUREMENT
/begin MEASUREMENT VOUTP_PCommandToBCM_enum "" UBYTE SWC_OUTP_type_CM_uint8_enum 0 0 0.0 255.0 ECU_ADDRESS 0x0000 /* @ECU_Address@VOUTP_PCommandToBCM_enum@ */ /end MEASUREMENT
/begin MEASUREMENT VOUTP_DKeyWelcomeSta_enum "" UBYTE SWC_OUTP_type_CM_uint8_enum 0 0 0.0 255.0 ECU_ADDRESS 0x0000 /* @ECU_Address@VOUTP_DKeyWelcomeSta_enum@ */ /end MEASUREMENT
/begin MEASUREMENT VOUTP_KeyAreaPTG_enum "" UBYTE SWC_OUTP_type_CM_uint8_enum 0 0 0.0 255.0 ECU_ADDRESS 0x0000 /* @ECU_Address@VOUTP_KeyAreaPTG_enum@ */ /end MEASUREMENT
/begin MEASUREMENT VOUTP_KeyAreaSPTGSta_enum "" UBYTE SWC_OUTP_type_CM_uint8_enum 0 0 0.0 255.0 ECU_ADDRESS 0x0000 /* @ECU_Address@VOUTP_KeyAreaSPTGSta_enum@ */ /end MEASUREMENT
/begin MEASUREMENT VOUTP_DkeyAreaRAPSSta_enum "" UBYTE SWC_OUTP_type_CM_uint8_enum 0 0 0.0 255.0 ECU_ADDRESS 0x0000 /* @ECU_Address@VOUTP_DkeyAreaRAPSSta_enum@ */ /end MEASUREMENT
/begin MEASUREMENT VOUTP_ParkingModeCmd_enum "" UBYTE SWC_OUTP_type_CM_uint8_enum 0 0 0.0 255.0 ECU_ADDRESS 0x0000 /* @ECU_Address@VOUTP_ParkingModeCmd_enum@ */ /end MEASUREMENT
/begin MEASUREMENT VOUTP_KeyNumSta_enum "" UBYTE SWC_OUTP_type_CM_uint8_enum 0 0 0.0 255.0 ECU_ADDRESS 0x0000 /* @ECU_Address@VOUTP_KeyNumSta_enum@ */ /end MEASUREMENT
/begin MEASUREMENT VOUTP_KeyTypeSta_enum "" UBYTE SWC_OUTP_type_CM_uint8_enum 0 0 0.0 255.0 ECU_ADDRESS 0x0000 /* @ECU_Address@VOUTP_KeyTypeSta_enum@ */ /end MEASUREMENT
/begin MEASUREMENT VOUTP_DISCSta_enum "" UBYTE SWC_OUTP_type_CM_uint8_enum 0 0 0.0 3.0 ECU_ADDRESS 0x0000 /* @ECU_Address@VOUTP_DISCSta_enum@ */ /end MEASUREMENT
/begin MEASUREMENT VOUTP_Awake_enum "" UBYTE SWC_OUTP_type_CM_uint8_enum 0 0 0.0 15.0 ECU_ADDRESS 0x0000 /* @ECU_Address@VOUTP_Awake_enum@ */ /end MEASUREMENT
/begin MEASUREMENT VOUTP_ErrorState_enum "" UBYTE SWC_OUTP_type_CM_uint8_enum 0 0 0.0 8.0 ECU_ADDRESS 0x0000 /* @ECU_Address@VOUTP_ErrorState_enum@ */ /end MEASUREMENT
/begin MEASUREMENT VOUTP_NodeID_enum "" UBYTE SWC_OUTP_type_CM_uint8_enum 0 0 0.0 127.0 ECU_ADDRESS 0x0000 /* @ECU_Address@VOUTP_NodeID_enum@ */ /end MEASUREMENT
/begin MEASUREMENT VOUTP_PowerUpState_enum "" UBYTE SWC_OUTP_type_CM_uint8_enum 0 0 0.0 13.0 ECU_ADDRESS 0x0000 /* @ECU_Address@VOUTP_PowerUpState_enum@ */ /end MEASUREMENT
/begin MEASUREMENT VOUTP_PowerDownState_enum "" UBYTE SWC_OUTP_type_CM_uint8_enum 0 0 0.0 9.0 ECU_ADDRESS 0x0000 /* @ECU_Address@VOUTP_PowerDownState_enum@ */ /end MEASUREMENT
/begin MEASUREMENT VOUTP_ChrgState_enum "" UBYTE SWC_OUTP_type_CM_uint8_enum 0 0 0.0 8.0 ECU_ADDRESS 0x0000 /* @ECU_Address@VOUTP_ChrgState_enum@ */ /end MEASUREMENT
/begin MEASUREMENT VOUTP_PowerUpFault_enum "" UBYTE SWC_OUTP_type_CM_uint8_enum 0 0 0.0 13.0 ECU_ADDRESS 0x0000 /* @ECU_Address@VOUTP_PowerUpFault_enum@ */ /end MEASUREMENT
/begin MEASUREMENT VOUTP_PowerDownFault_enum "" UBYTE SWC_OUTP_type_CM_uint8_enum 0 0 0.0 11.0 ECU_ADDRESS 0x0000 /* @ECU_Address@VOUTP_PowerDownFault_enum@ */ /end MEASUREMENT
/begin MEASUREMENT VOUTP_ChrgFault_enum "" UBYTE SWC_OUTP_type_CM_uint8_enum 0 0 0.0 9.0 ECU_ADDRESS 0x0000 /* @ECU_Address@VOUTP_ChrgFault_enum@ */ /end MEASUREMENT
/begin MEASUREMENT VOUTP_BattHVDem_enum "" UBYTE SWC_OUTP_type_CM_uint8_enum 0 0 0.0 3.0 ECU_ADDRESS 0x0000 /* @ECU_Address@VOUTP_BattHVDem_enum@ */ /end MEASUREMENT
/begin MEASUREMENT VOUTP_DCDCRlyDem_enum "" UBYTE SWC_OUTP_type_CM_uint8_enum 0 0 0.0 3.0 ECU_ADDRESS 0x0000 /* @ECU_Address@VOUTP_DCDCRlyDem_enum@ */ /end MEASUREMENT
/begin MEASUREMENT VOUTP_CACRlyDem_enum "" UBYTE SWC_OUTP_type_CM_uint8_enum 0 0 0.0 3.0 ECU_ADDRESS 0x0000 /* @ECU_Address@VOUTP_CACRlyDem_enum@ */ /end MEASUREMENT
/begin MEASUREMENT VOUTP_MCUHVLoopDem_enum "" UBYTE SWC_OUTP_type_CM_uint8_enum 0 0 0.0 3.0 ECU_ADDRESS 0x0000 /* @ECU_Address@VOUTP_MCUHVLoopDem_enum@ */ /end MEASUREMENT
/begin MEASUREMENT VOUTP_EHPSRlyDem_enum "" UBYTE SWC_OUTP_type_CM_uint8_enum 0 0 0.0 3.0 ECU_ADDRESS 0x0000 /* @ECU_Address@VOUTP_EHPSRlyDem_enum@ */ /end MEASUREMENT
/begin MEASUREMENT VOUTP_ACHVLoopDem_enum "" UBYTE SWC_OUTP_type_CM_uint8_enum 0 0 0.0 3.0 ECU_ADDRESS 0x0000 /* @ECU_Address@VOUTP_ACHVLoopDem_enum@ */ /end MEASUREMENT
/begin MEASUREMENT VOUTP_HVSysReady_enum "" UBYTE SWC_OUTP_type_CM_uint8_enum 0 0 0.0 3.0 ECU_ADDRESS 0x0000 /* @ECU_Address@VOUTP_HVSysReady_enum@ */ /end MEASUREMENT
/begin MEASUREMENT VOUTP_DrivelineRelease_enum "" UBYTE SWC_OUTP_type_CM_uint8_enum 0 0 0.0 3.0 ECU_ADDRESS 0x0000 /* @ECU_Address@VOUTP_DrivelineRelease_enum@ */ /end MEASUREMENT
/begin MEASUREMENT VOUTP_ActiveDischargeReq_enum "" UBYTE SWC_OUTP_type_CM_uint8_enum 0 0 0.0 3.0 ECU_ADDRESS 0x0000 /* @ECU_Address@VOUTP_ActiveDischargeReq_enum@ */ /end MEASUREMENT
/begin MEASUREMENT VOUTP_LVBattLowInd_enum "" UBYTE SWC_OUTP_type_CM_uint8_enum 0 0 0.0 3.0 ECU_ADDRESS 0x0000 /* @ECU_Address@VOUTP_LVBattLowInd_enum@ */ /end MEASUREMENT
/begin MEASUREMENT VOUTP_FogTMSRlyCMD_enum "" UBYTE SWC_OUTP_type_CM_uint8_enum 0 0 0.0 3.0 ECU_ADDRESS 0x0000 /* @ECU_Address@VOUTP_FogTMSRlyCMD_enum@ */ /end MEASUREMENT
/begin MEASUREMENT VOUTP_Keystatus_enum "" UBYTE SWC_OUTP_type_CM_uint8_enum 0 0 0.0 2.0 ECU_ADDRESS 0x0000 /* @ECU_Address@VOUTP_Keystatus_enum@ */ /end MEASUREMENT
/begin MEASUREMENT VOUTP_CFGEM1Ctrl_raw "" UBYTE SWC_OUTP_type_CM_uint8_raw 0 0 0.0 255.0 ECU_ADDRESS 0x0000 /* @ECU_Address@VOUTP_CFGEM1Ctrl_raw@ */ /end MEASUREMENT
/begin MEASUREMENT VOUTP_CFGEM1BAMTNum_raw "" UBYTE SWC_OUTP_type_CM_uint8_raw 0 0 0.0 255.0 ECU_ADDRESS 0x0000 /* @ECU_Address@VOUTP_CFGEM1BAMTNum_raw@ */ /end MEASUREMENT
/begin MEASUREMENT VOUTP_CFGEM1BAMRsv_raw "" UBYTE SWC_OUTP_type_CM_uint8_raw 0 0 0.0 255.0 ECU_ADDRESS 0x0000 /* @ECU_Address@VOUTP_CFGEM1BAMRsv_raw@ */ /end MEASUREMENT
/begin MEASUREMENT VOUTP_DTbyte0_raw "" UBYTE SWC_OUTP_type_CM_uint8_raw 0 0 0.0 255.0 ECU_ADDRESS 0x0000 /* @ECU_Address@VOUTP_DTbyte0_raw@ */ /end MEASUREMENT
/begin MEASUREMENT VOUTP_DTbyte1_raw "" UBYTE SWC_OUTP_type_CM_uint8_raw 0 0 0.0 255.0 ECU_ADDRESS 0x0000 /* @ECU_Address@VOUTP_DTbyte1_raw@ */ /end MEASUREMENT
/begin MEASUREMENT VOUTP_DTbyte2_raw "" UBYTE SWC_OUTP_type_CM_uint8_raw 0 0 0.0 255.0 ECU_ADDRESS 0x0000 /* @ECU_Address@VOUTP_DTbyte2_raw@ */ /end MEASUREMENT
/begin MEASUREMENT VOUTP_DTbyte3_raw "" UBYTE SWC_OUTP_type_CM_uint8_raw 0 0 0.0 255.0 ECU_ADDRESS 0x0000 /* @ECU_Address@VOUTP_DTbyte3_raw@ */ /end MEASUREMENT
/begin MEASUREMENT VOUTP_DTbyte4_raw "" UBYTE SWC_OUTP_type_CM_uint8_raw 0 0 0.0 255.0 ECU_ADDRESS 0x0000 /* @ECU_Address@VOUTP_DTbyte4_raw@ */ /end MEASUREMENT
/begin MEASUREMENT VOUTP_DTbyte5_raw "" UBYTE SWC_OUTP_type_CM_uint8_raw 0 0 0.0 255.0 ECU_ADDRESS 0x0000 /* @ECU_Address@VOUTP_DTbyte5_raw@ */ /end MEASUREMENT
/begin MEASUREMENT VOUTP_DTbyte6_raw "" UBYTE SWC_OUTP_type_CM_uint8_raw 0 0 0.0 255.0 ECU_ADDRESS 0x0000 /* @ECU_Address@VOUTP_DTbyte6_raw@ */ /end MEASUREMENT
/begin MEASUREMENT VOUTP_DTbyte7_raw "" UBYTE SWC_OUTP_type_CM_uint8_raw 0 0 0.0 255.0 ECU_ADDRESS 0x0000 /* @ECU_Address@VOUTP_DTbyte7_raw@ */ /end MEASUREMENT
/begin MEASUREMENT VOUTP_HWVer1_cnt "" UBYTE SWC_OUTP_type_CM_uint8_cnt 0 0 0.0 255.0 ECU_ADDRESS 0x0000 /* @ECU_Address@VOUTP_HWVer1_cnt@ */ /end MEASUREMENT
/begin MEASUREMENT VOUTP_HWVer2_cnt "" UBYTE SWC_OUTP_type_CM_uint8_cnt 0 0 0.0 255.0 ECU_ADDRESS 0x0000 /* @ECU_Address@VOUTP_HWVer2_cnt@ */ /end MEASUREMENT
/begin MEASUREMENT VOUTP_HWVer3_cnt "" UBYTE SWC_OUTP_type_CM_uint8_cnt 0 0 0.0 255.0 ECU_ADDRESS 0x0000 /* @ECU_Address@VOUTP_HWVer3_cnt@ */ /end MEASUREMENT
/begin MEASUREMENT VOUTP_CarModel1_cnt "" UBYTE SWC_OUTP_type_CM_uint8_cnt 0 0 0.0 255.0 ECU_ADDRESS 0x0000 /* @ECU_Address@VOUTP_CarModel1_cnt@ */ /end MEASUREMENT
/begin MEASUREMENT VOUTP_CarModel2_cnt "" UBYTE SWC_OUTP_type_CM_uint8_cnt 0 0 0.0 255.0 ECU_ADDRESS 0x0000 /* @ECU_Address@VOUTP_CarModel2_cnt@ */ /end MEASUREMENT
/begin MEASUREMENT VOUTP_CarModel3_cnt "" UBYTE SWC_OUTP_type_CM_uint8_cnt 0 0 0.0 255.0 ECU_ADDRESS 0x0000 /* @ECU_Address@VOUTP_CarModel3_cnt@ */ /end MEASUREMENT
/begin MEASUREMENT VOUTP_ECU1_cnt "" UBYTE SWC_OUTP_type_CM_uint8_cnt 0 0 0.0 255.0 ECU_ADDRESS 0x0000 /* @ECU_Address@VOUTP_ECU1_cnt@ */ /end MEASUREMENT
/begin MEASUREMENT VOUTP_ECU2_cnt "" UBYTE SWC_OUTP_type_CM_uint8_cnt 0 0 0.0 255.0 ECU_ADDRESS 0x0000 /* @ECU_Address@VOUTP_ECU2_cnt@ */ /end MEASUREMENT
/begin MEASUREMENT VOUTP_Major1_cnt "" UBYTE SWC_OUTP_type_CM_uint8_cnt 0 0 0.0 255.0 ECU_ADDRESS 0x0000 /* @ECU_Address@VOUTP_Major1_cnt@ */ /end MEASUREMENT
/begin MEASUREMENT VOUTP_Major2_cnt "" UBYTE SWC_OUTP_type_CM_uint8_cnt 0 0 0.0 255.0 ECU_ADDRESS 0x0000 /* @ECU_Address@VOUTP_Major2_cnt@ */ /end MEASUREMENT
/begin MEASUREMENT VOUTP_Minor1_cnt "" UBYTE SWC_OUTP_type_CM_uint8_cnt 0 0 0.0 255.0 ECU_ADDRESS 0x0000 /* @ECU_Address@VOUTP_Minor1_cnt@ */ /end MEASUREMENT
/begin MEASUREMENT VOUTP_Minor2_cnt "" UBYTE SWC_OUTP_type_CM_uint8_cnt 0 0 0.0 255.0 ECU_ADDRESS 0x0000 /* @ECU_Address@VOUTP_Minor2_cnt@ */ /end MEASUREMENT
/begin MEASUREMENT VOUTP_Patch1_cnt "" UBYTE SWC_OUTP_type_CM_uint8_cnt 0 0 0.0 255.0 ECU_ADDRESS 0x0000 /* @ECU_Address@VOUTP_Patch1_cnt@ */ /end MEASUREMENT
/begin MEASUREMENT VOUTP_Patch2_cnt "" UBYTE SWC_OUTP_type_CM_uint8_cnt 0 0 0.0 255.0 ECU_ADDRESS 0x0000 /* @ECU_Address@VOUTP_Patch2_cnt@ */ /end MEASUREMENT
/begin MEASUREMENT VOUTP_Country1_cnt "" UBYTE SWC_OUTP_type_CM_uint8_cnt 0 0 0.0 255.0 ECU_ADDRESS 0x0000 /* @ECU_Address@VOUTP_Country1_cnt@ */ /end MEASUREMENT
/begin MEASUREMENT VOUTP_Country2_cnt "" UBYTE SWC_OUTP_type_CM_uint8_cnt 0 0 0.0 255.0 ECU_ADDRESS 0x0000 /* @ECU_Address@VOUTP_Country2_cnt@ */ /end MEASUREMENT
/begin MEASUREMENT VOUTP_Dash1_cnt "" UBYTE SWC_OUTP_type_CM_uint8_cnt 0 0 0.0 255.0 ECU_ADDRESS 0x0000 /* @ECU_Address@VOUTP_Dash1_cnt@ */ /end MEASUREMENT
/begin MEASUREMENT VOUTP_Change1_cnt "" UBYTE SWC_OUTP_type_CM_uint8_cnt 0 0 0.0 255.0 ECU_ADDRESS 0x0000 /* @ECU_Address@VOUTP_Change1_cnt@ */ /end MEASUREMENT
/begin MEASUREMENT VOUTP_Change2_cnt "" UBYTE SWC_OUTP_type_CM_uint8_cnt 0 0 0.0 255.0 ECU_ADDRESS 0x0000 /* @ECU_Address@VOUTP_Change2_cnt@ */ /end MEASUREMENT
/begin MEASUREMENT VOUTP_Dash2_cnt "" UBYTE SWC_OUTP_type_CM_uint8_cnt 0 0 0.0 255.0 ECU_ADDRESS 0x0000 /* @ECU_Address@VOUTP_Dash2_cnt@ */ /end MEASUREMENT
/begin MEASUREMENT VOUTP_PmicBootReason_enum "" UBYTE SWC_OUTP_type_CM_uint8_enum 0 0 0.0 255.0 ECU_ADDRESS 0x0000 /* @ECU_Address@VOUTP_PmicBootReason_enum@ */ /end MEASUREMENT
/begin MEASUREMENT VOUTP_CurrentNmState_enum "" UBYTE SWC_OUTP_type_CM_uint8_enum 0 0 0.0 255.0 ECU_ADDRESS 0x0000 /* @ECU_Address@VOUTP_CurrentNmState_enum@ */ /end MEASUREMENT
/begin MEASUREMENT VOUTP_ECUGen1_cnt "" UBYTE SWC_OUTP_type_CM_uint8_cnt 0 0 0.0 255.0 ECU_ADDRESS 0x0000 /* @ECU_Address@VOUTP_ECUGen1_cnt@ */ /end MEASUREMENT
/begin MEASUREMENT VOUTP_ECUGen2_cnt "" UBYTE SWC_OUTP_type_CM_uint8_cnt 0 0 0.0 255.0 ECU_ADDRESS 0x0000 /* @ECU_Address@VOUTP_ECUGen2_cnt@ */ /end MEASUREMENT
/begin MEASUREMENT VOUTP_DrivingMode_cnt "" UBYTE SWC_OUTP_type_CM_uint8_cnt 0 0 0.0 255.0 ECU_ADDRESS 0x0000 /* @ECU_Address@VOUTP_DrivingMode_cnt@ */ /end MEASUREMENT
/begin MEASUREMENT VOUTP_ModelYear_cnt "" UBYTE SWC_OUTP_type_CM_uint8_cnt 0 0 0.0 255.0 ECU_ADDRESS 0x0000 /* @ECU_Address@VOUTP_ModelYear_cnt@ */ /end MEASUREMENT
/begin MEASUREMENT VOUTP_LFWheelPress_raw8 "" UBYTE SWC_OUTP_type_CM_uint8_raw8 0 0 0.0 255.0 ECU_ADDRESS 0x0000 /* @ECU_Address@VOUTP_LFWheelPress_raw8@ */ /end MEASUREMENT
/begin MEASUREMENT VOUTP_LRWheelPress_raw8 "" UBYTE SWC_OUTP_type_CM_uint8_raw8 0 0 0.0 255.0 ECU_ADDRESS 0x0000 /* @ECU_Address@VOUTP_LRWheelPress_raw8@ */ /end MEASUREMENT
/begin MEASUREMENT VOUTP_LFPressIndi_enum "" UBYTE SWC_OUTP_type_CM_uint8_enum 0 0 0.0 4.0 ECU_ADDRESS 0x0000 /* @ECU_Address@VOUTP_LFPressIndi_enum@ */ /end MEASUREMENT
/begin MEASUREMENT VOUTP_LRPressIndi_enum "" UBYTE SWC_OUTP_type_CM_uint8_enum 0 0 0.0 4.0 ECU_ADDRESS 0x0000 /* @ECU_Address@VOUTP_LRPressIndi_enum@ */ /end MEASUREMENT
/begin MEASUREMENT VOUTP_LFWheelPSW_raw8 "" UBYTE SWC_OUTP_type_CM_uint8_raw8 0 0 0.0 200.0 ECU_ADDRESS 0x0000 /* @ECU_Address@VOUTP_LFWheelPSW_raw8@ */ /end MEASUREMENT
/begin MEASUREMENT VOUTP_LRWheelPSW_raw8 "" UBYTE SWC_OUTP_type_CM_uint8_raw8 0 0 0.0 200.0 ECU_ADDRESS 0x0000 /* @ECU_Address@VOUTP_LRWheelPSW_raw8@ */ /end MEASUREMENT
/begin MEASUREMENT VOUTP_CWheelTips_enum "" UBYTE SWC_OUTP_type_CM_uint8_enum 0 0 0.0 3.0 ECU_ADDRESS 0x0000 /* @ECU_Address@VOUTP_CWheelTips_enum@ */ /end MEASUREMENT
/begin MEASUREMENT VOUTP_AutoLTips_enum "" UBYTE SWC_OUTP_type_CM_uint8_enum 0 0 0.0 3.0 ECU_ADDRESS 0x0000 /* @ECU_Address@VOUTP_AutoLTips_enum@ */ /end MEASUREMENT
/begin MEASUREMENT VOUTP_LFP20_raw8 "" UBYTE SWC_OUTP_type_CM_uint8_raw8 0 0 0.0 255.0 ECU_ADDRESS 0x0000 /* @ECU_Address@VOUTP_LFP20_raw8@ */ /end MEASUREMENT
/begin MEASUREMENT VOUTP_LRP20_raw8 "" UBYTE SWC_OUTP_type_CM_uint8_raw8 0 0 0.0 255.0 ECU_ADDRESS 0x0000 /* @ECU_Address@VOUTP_LRP20_raw8@ */ /end MEASUREMENT
/begin MEASUREMENT VOUTP_ID1messageALTU_raw8 "" UBYTE SWC_OUTP_type_CM_uint8_raw8 0 0 0.0 255.0 ECU_ADDRESS 0x0000 /* @ECU_Address@VOUTP_ID1messageALTU_raw8@ */ /end MEASUREMENT
/begin MEASUREMENT VOUTP_ID2messageALTU_raw8 "" UBYTE SWC_OUTP_type_CM_uint8_raw8 0 0 0.0 255.0 ECU_ADDRESS 0x0000 /* @ECU_Address@VOUTP_ID2messageALTU_raw8@ */ /end MEASUREMENT
/begin MEASUREMENT VOUTP_ID3messageALTU_raw8 "" UBYTE SWC_OUTP_type_CM_uint8_raw8 0 0 0.0 255.0 ECU_ADDRESS 0x0000 /* @ECU_Address@VOUTP_ID3messageALTU_raw8@ */ /end MEASUREMENT
/begin MEASUREMENT VOUTP_ID4messageALTU_raw8 "" UBYTE SWC_OUTP_type_CM_uint8_raw8 0 0 0.0 255.0 ECU_ADDRESS 0x0000 /* @ECU_Address@VOUTP_ID4messageALTU_raw8@ */ /end MEASUREMENT
/begin MEASUREMENT VOUTP_LFPindi_enum "" UBYTE SWC_OUTP_type_CM_uint8_enum 0 0 0.0 3.0 ECU_ADDRESS 0x0000 /* @ECU_Address@VOUTP_LFPindi_enum@ */ /end MEASUREMENT
/begin MEASUREMENT VOUTP_LRPindi_enum "" UBYTE SWC_OUTP_type_CM_uint8_enum 0 0 0.0 3.0 ECU_ADDRESS 0x0000 /* @ECU_Address@VOUTP_LRPindi_enum@ */ /end MEASUREMENT
/begin MEASUREMENT VOUTP_Flashchkdatavalid_enum "" UBYTE SWC_OUTP_type_CM_uint8_enum 0 0 0.0 255.0 ECU_ADDRESS 0x0000 /* @ECU_Address@VOUTP_Flashchkdatavalid_enum@ */ /end MEASUREMENT
/begin MEASUREMENT VOUTP_Flashdatavalid_enum "" UBYTE SWC_OUTP_type_CM_uint8_enum 0 0 0.0 255.0 ECU_ADDRESS 0x0000 /* @ECU_Address@VOUTP_Flashdatavalid_enum@ */ /end MEASUREMENT
/begin MEASUREMENT VOUTP_Prepresstempvalid_enum "" UBYTE SWC_OUTP_type_CM_uint8_enum 0 0 0.0 255.0 ECU_ADDRESS 0x0000 /* @ECU_Address@VOUTP_Prepresstempvalid_enum@ */ /end MEASUREMENT
/begin MEASUREMENT VOUTP_FlashIDvalid_enum "" UBYTE SWC_OUTP_type_CM_uint8_enum 0 0 0.0 255.0 ECU_ADDRESS 0x0000 /* @ECU_Address@VOUTP_FlashIDvalid_enum@ */ /end MEASUREMENT
/begin MEASUREMENT VOUTP_LProgress_enum "" UBYTE SWC_OUTP_type_CM_uint8_enum 0 0 0.0 255.0 ECU_ADDRESS 0x0000 /* @ECU_Address@VOUTP_LProgress_enum@ */ /end MEASUREMENT
/begin MEASUREMENT VOUTP_ModelVersion_raw "" UBYTE SWC_OUTP_type_CM_uint8_raw 0 0 0.0 255.0 ECU_ADDRESS 0x0000 /* @ECU_Address@VOUTP_ModelVersion_raw@ */ /end MEASUREMENT
/begin MEASUREMENT VOUTP_ModelVersionChksum_raw "" UBYTE SWC_OUTP_type_CM_uint8_raw 0 0 0.0 255.0 ECU_ADDRESS 0x0000 /* @ECU_Address@VOUTP_ModelVersionChksum_raw@ */ /end MEASUREMENT
/begin MEASUREMENT VOUTP_CreepIND_enum "" UBYTE SWC_OUTP_type_CM_uint8_enum 0 0 0.0 15.0 ECU_ADDRESS 0x0000 /* @ECU_Address@VOUTP_CreepIND_enum@ */ /end MEASUREMENT
/begin MEASUREMENT VOUTP_ActTUpAIND_enum "" UBYTE SWC_OUTP_type_CM_uint8_enum 0 0 0.0 15.0 ECU_ADDRESS 0x0000 /* @ECU_Address@VOUTP_ActTUpAIND_enum@ */ /end MEASUREMENT
/begin MEASUREMENT VOUTP_ActDriveMode_enum "" UBYTE SWC_OUTP_type_CM_uint8_enum 0 0 0.0 15.0 ECU_ADDRESS 0x0000 /* @ECU_Address@VOUTP_ActDriveMode_enum@ */ /end MEASUREMENT
/begin MEASUREMENT VOUTP_EVCU1ActDrvMode_enum "" UBYTE SWC_OUTP_type_CM_uint8_enum 0 0 0.0 15.0 ECU_ADDRESS 0x0000 /* @ECU_Address@VOUTP_EVCU1ActDrvMode_enum@ */ /end MEASUREMENT
/begin MEASUREMENT VOUTP_EVCU1WheelSlipdet_enum "" UBYTE SWC_OUTP_type_CM_uint8_enum 0 0 0.0 15.0 ECU_ADDRESS 0x0000 /* @ECU_Address@VOUTP_EVCU1WheelSlipdet_enum@ */ /end MEASUREMENT
/begin MEASUREMENT VOUTP_EVCU1EMotorOvrerSpd_enum "" UBYTE SWC_OUTP_type_CM_uint8_enum 0 0 0.0 15.0 ECU_ADDRESS 0x0000 /* @ECU_Address@VOUTP_EVCU1EMotorOvrerSpd_enum@ */ /end MEASUREMENT
/begin MEASUREMENT VOUTP_EVCU1EBrakeTorqLow_enum "" UBYTE SWC_OUTP_type_CM_uint8_enum 0 0 0.0 15.0 ECU_ADDRESS 0x0000 /* @ECU_Address@VOUTP_EVCU1EBrakeTorqLow_enum@ */ /end MEASUREMENT
/begin MEASUREMENT VOUTP_EMRC1EMTquModeDrvBrk_enum "" UBYTE SWC_OUTP_type_CM_uint8_enum 0 0 0.0 15.0 ECU_ADDRESS 0x0000 /* @ECU_Address@VOUTP_EMRC1EMTquModeDrvBrk_enum@ */ /end MEASUREMENT
/begin MEASUREMENT VOUTP_EC1EMSupVarRTSC1MSG_cnt "" UBYTE SWC_OUTP_type_CM_uint8_cnt 0 0 0.0 255.0 ECU_ADDRESS 0x0000 /* @ECU_Address@VOUTP_EC1EMSupVarRTSC1MSG_cnt@ */ /end MEASUREMENT
/begin MEASUREMENT VOUTP_EC1EMSupTSC1CtrlPG1_cnt "" UBYTE SWC_OUTP_type_CM_uint8_cnt 0 0 0.0 255.0 ECU_ADDRESS 0x0000 /* @ECU_Address@VOUTP_EC1EMSupTSC1CtrlPG1_cnt@ */ /end MEASUREMENT
/begin MEASUREMENT VOUTP_EC1EMSupTSC1CtrlPG3_cnt "" UBYTE SWC_OUTP_type_CM_uint8_cnt 0 0 0.0 255.0 ECU_ADDRESS 0x0000 /* @ECU_Address@VOUTP_EC1EMSupTSC1CtrlPG3_cnt@ */ /end MEASUREMENT
/begin MEASUREMENT VOUTP_EC1EMSupTSC1CtrlPG2_cnt "" UBYTE SWC_OUTP_type_CM_uint8_cnt 0 0 0.0 255.0 ECU_ADDRESS 0x0000 /* @ECU_Address@VOUTP_EC1EMSupTSC1CtrlPG2_cnt@ */ /end MEASUREMENT
/begin MEASUREMENT VOUTP_EC1EMSupTSC1CtrlPG4_cnt "" UBYTE SWC_OUTP_type_CM_uint8_cnt 0 0 0.0 255.0 ECU_ADDRESS 0x0000 /* @ECU_Address@VOUTP_EC1EMSupTSC1CtrlPG4_cnt@ */ /end MEASUREMENT
/begin MEASUREMENT VOUTP_RC1RetType_enum "" UBYTE SWC_OUTP_type_CM_uint8_enum 0 0 0.0 255.0 ECU_ADDRESS 0x0000 /* @ECU_Address@VOUTP_RC1RetType_enum@ */ /end MEASUREMENT
/begin MEASUREMENT VOUTP_RC1RetLocat_enum "" UBYTE SWC_OUTP_type_CM_uint8_enum 0 0 0.0 255.0 ECU_ADDRESS 0x0000 /* @ECU_Address@VOUTP_RC1RetLocat_enum@ */ /end MEASUREMENT
/begin MEASUREMENT VOUTP_ETC1ShiftrPgs_enum "" UBYTE SWC_OUTP_type_CM_uint8_enum 0 0 0.0 15.0 ECU_ADDRESS 0x0000 /* @ECU_Address@VOUTP_ETC1ShiftrPgs_enum@ */ /end MEASUREMENT
/begin MEASUREMENT VOUTP_EVCU1RecuperHighSta_enum "" UBYTE SWC_OUTP_type_CM_uint8_enum 0 0 0.0 255.0 ECU_ADDRESS 0x0000 /* @ECU_Address@VOUTP_EVCU1RecuperHighSta_enum@ */ /end MEASUREMENT
/begin MEASUREMENT VOUTP_EMRC1SACtrlDev_cnt "" UBYTE SWC_OUTP_type_CM_uint8_cnt 0 0 0.0 255.0 ECU_ADDRESS 0x0000 /* @ECU_Address@VOUTP_EMRC1SACtrlDev_cnt@ */ /end MEASUREMENT
/begin MEASUREMENT VOUTP_HVPO120VGrpALDSt_enum "" UBYTE SWC_OUTP_type_CM_uint8_enum 0 0 0.0 255.0 ECU_ADDRESS 0x0000 /* @ECU_Address@VOUTP_HVPO120VGrpALDSt_enum@ */ /end MEASUREMENT
/begin MEASUREMENT VOUTP_HVPO120VGrpBLDSt_enum "" UBYTE SWC_OUTP_type_CM_uint8_enum 0 0 0.0 255.0 ECU_ADDRESS 0x0000 /* @ECU_Address@VOUTP_HVPO120VGrpBLDSt_enum@ */ /end MEASUREMENT
/begin MEASUREMENT VOUTP_FeatArbitrSta_enum "" UBYTE SWC_OUTP_type_CM_uint8_enum 0 0 0.0 6.0 ECU_ADDRESS 0x0000 /* @ECU_Address@VOUTP_FeatArbitrSta_enum@ */ /end MEASUREMENT
/begin MEASUREMENT VOUTP_FeatArbitrFinal_enum "" UBYTE SWC_OUTP_type_CM_uint8_enum 0 0 0.0 6.0 ECU_ADDRESS 0x0000 /* @ECU_Address@VOUTP_FeatArbitrFinal_enum@ */ /end MEASUREMENT
/begin MEASUREMENT VOUTP_ADASLKASta_enum "" UBYTE SWC_OUTP_type_CM_uint8_enum 0 0 0.0 7.0 ECU_ADDRESS 0x0000 /* @ECU_Address@VOUTP_ADASLKASta_enum@ */ /end MEASUREMENT
/begin MEASUREMENT VOUTP_LKATOIAct_enum "" UBYTE SWC_OUTP_type_CM_uint8_enum 0 0 0.0 255.0 ECU_ADDRESS 0x0000 /* @ECU_Address@VOUTP_LKATOIAct_enum@ */ /end MEASUREMENT
/begin MEASUREMENT VOUTP_ADASAEBReq_enum "" UBYTE SWC_OUTP_type_CM_uint8_enum 0 0 0.0 7.0 ECU_ADDRESS 0x0000 /* @ECU_Address@VOUTP_ADASAEBReq_enum@ */ /end MEASUREMENT
/begin MEASUREMENT VOUTP_ADASDBSReq_enum "" UBYTE SWC_OUTP_type_CM_uint8_enum 0 0 0.0 3.0 ECU_ADDRESS 0x0000 /* @ECU_Address@VOUTP_ADASDBSReq_enum@ */ /end MEASUREMENT
/begin MEASUREMENT VOUTP_ADASACCSta_enum "" UBYTE SWC_OUTP_type_CM_uint8_enum 0 0 0.0 7.0 ECU_ADDRESS 0x0000 /* @ECU_Address@VOUTP_ADASACCSta_enum@ */ /end MEASUREMENT
/begin MEASUREMENT VOUTP_ADASShftPosnReq_enum "" UBYTE SWC_OUTP_type_CM_uint8_enum 0 0 0.0 7.0 ECU_ADDRESS 0x0000 /* @ECU_Address@VOUTP_ADASShftPosnReq_enum@ */ /end MEASUREMENT
/begin MEASUREMENT VOUTP_ADASFCWSta_enum "" UBYTE SWC_OUTP_type_CM_uint8_enum 0 0 0.0 7.0 ECU_ADDRESS 0x0000 /* @ECU_Address@VOUTP_ADASFCWSta_enum@ */ /end MEASUREMENT
/begin MEASUREMENT VOUTP_ADASLDWSta_enum "" UBYTE SWC_OUTP_type_CM_uint8_enum 0 0 0.0 7.0 ECU_ADDRESS 0x0000 /* @ECU_Address@VOUTP_ADASLDWSta_enum@ */ /end MEASUREMENT
/begin MEASUREMENT VOUTP_ACCObjDstLvl_enum "" UBYTE SWC_OUTP_type_CM_uint8_enum 0 0 0.0 7.0 ECU_ADDRESS 0x0000 /* @ECU_Address@VOUTP_ACCObjDstLvl_enum@ */ /end MEASUREMENT
/begin MEASUREMENT VOUTP_ForceLowBeam_enum "" UBYTE SWC_OUTP_type_CM_uint8_enum 0 0 0.0 1.0 ECU_ADDRESS 0x0000 /* @ECU_Address@VOUTP_ForceLowBeam_enum@ */ /end MEASUREMENT
/begin MEASUREMENT VOUTP_ADASWarningMsg_enum "" UBYTE SWC_OUTP_type_CM_uint8_enum 0 0 0.0 15.0 ECU_ADDRESS 0x0000 /* @ECU_Address@VOUTP_ADASWarningMsg_enum@ */ /end MEASUREMENT
/begin MEASUREMENT VOUTP_ADASCAMSpdLim_enum "" UBYTE SWC_OUTP_type_CM_uint8_enum 0 0 0.0 31.0 ECU_ADDRESS 0x0000 /* @ECU_Address@VOUTP_ADASCAMSpdLim_enum@ */ /end MEASUREMENT
/begin MEASUREMENT VOUTP_ADASSLIFSpdLim_enum "" UBYTE SWC_OUTP_type_CM_uint8_enum 0 0 0.0 31.0 ECU_ADDRESS 0x0000 /* @ECU_Address@VOUTP_ADASSLIFSpdLim_enum@ */ /end MEASUREMENT
/begin MEASUREMENT VOUTP_ADASLFCSta_enum "" UBYTE SWC_OUTP_type_CM_uint8_enum 0 0 0.0 7.0 ECU_ADDRESS 0x0000 /* @ECU_Address@VOUTP_ADASLFCSta_enum@ */ /end MEASUREMENT
/begin MEASUREMENT VOUTP_ADASLaneModeL_enum "" UBYTE SWC_OUTP_type_CM_uint8_enum 0 0 0.0 7.0 ECU_ADDRESS 0x0000 /* @ECU_Address@VOUTP_ADASLaneModeL_enum@ */ /end MEASUREMENT
/begin MEASUREMENT VOUTP_ADASLaneModeR_enum "" UBYTE SWC_OUTP_type_CM_uint8_enum 0 0 0.0 7.0 ECU_ADDRESS 0x0000 /* @ECU_Address@VOUTP_ADASLaneModeR_enum@ */ /end MEASUREMENT
/begin MEASUREMENT VOUTP_ADASSLIFSta_enum "" UBYTE SWC_OUTP_type_CM_uint8_enum 0 0 0.0 5.0 ECU_ADDRESS 0x0000 /* @ECU_Address@VOUTP_ADASSLIFSta_enum@ */ /end MEASUREMENT
/begin MEASUREMENT VOUTP_ADASISASta_enum "" UBYTE SWC_OUTP_type_CM_uint8_enum 0 0 0.0 3.0 ECU_ADDRESS 0x0000 /* @ECU_Address@VOUTP_ADASISASta_enum@ */ /end MEASUREMENT
/begin MEASUREMENT VOUTP_ADASLFCHandsOffWarning_enum "" UBYTE SWC_OUTP_type_CM_uint8_enum 0 0 0.0 3.0 ECU_ADDRESS 0x0000 /* @ECU_Address@VOUTP_ADASLFCHandsOffWarning_enum@ */ /end MEASUREMENT
/begin MEASUREMENT VOUTP_LVDAMuteSta_enum "" UBYTE SWC_OUTP_type_CM_uint8_enum 0 0 0.0 3.0 ECU_ADDRESS 0x0000 /* @ECU_Address@VOUTP_LVDAMuteSta_enum@ */ /end MEASUREMENT
/begin MEASUREMENT VOUTP_ADASLFCWarnSound_enum "" UBYTE SWC_OUTP_type_CM_uint8_enum 0 0 0.0 255.0 ECU_ADDRESS 0x0000 /* @ECU_Address@VOUTP_ADASLFCWarnSound_enum@ */ /end MEASUREMENT
/begin MEASUREMENT VOUTP_FCMACCmode_enum "" UBYTE SWC_OUTP_type_CM_uint8_enum 0 0 0.0 2.0 ECU_ADDRESS 0x0000 /* @ECU_Address@VOUTP_FCMACCmode_enum@ */ /end MEASUREMENT
/begin MEASUREMENT VOUTP_ADASLanetypeR_enum "" UBYTE SWC_OUTP_type_CM_uint8_enum 0 0 0.0 2.0 ECU_ADDRESS 0x0000 /* @ECU_Address@VOUTP_ADASLanetypeR_enum@ */ /end MEASUREMENT
/begin MEASUREMENT VOUTP_ADASLanetypeL_enum "" UBYTE SWC_OUTP_type_CM_uint8_enum 0 0 0.0 2.0 ECU_ADDRESS 0x0000 /* @ECU_Address@VOUTP_ADASLanetypeL_enum@ */ /end MEASUREMENT
/begin MEASUREMENT VOUTP_ADASAEBSta_enum "" UBYTE SWC_OUTP_type_CM_uint8_enum 0 0 0.0 7.0 ECU_ADDRESS 0x0000 /* @ECU_Address@VOUTP_ADASAEBSta_enum@ */ /end MEASUREMENT
/begin MEASUREMENT VOUTP_FCMLDWRequest_enum "" UBYTE SWC_OUTP_type_CM_uint8_enum 0 0 0.0 3.0 ECU_ADDRESS 0x0000 /* @ECU_Address@VOUTP_FCMLDWRequest_enum@ */ /end MEASUREMENT
/begin MEASUREMENT VOUTP_CCCtrlSta_enum "" UBYTE SWC_OUTP_type_CM_uint8_enum 0 0 0.0 7.0 ECU_ADDRESS 0x0000 /* @ECU_Address@VOUTP_CCCtrlSta_enum@ */ /end MEASUREMENT
/begin MEASUREMENT VOUTP_MSACtrlSta_enum "" UBYTE SWC_OUTP_type_CM_uint8_enum 0 0 0.0 8.0 ECU_ADDRESS 0x0000 /* @ECU_Address@VOUTP_MSACtrlSta_enum@ */ /end MEASUREMENT
/begin MEASUREMENT VOUTP_APSStaSys_enum "" UBYTE SWC_OUTP_type_CM_uint8_enum 0 0 0.0 7.0 ECU_ADDRESS 0x0000 /* @ECU_Address@VOUTP_APSStaSys_enum@ */ /end MEASUREMENT
/begin MEASUREMENT VOUTP_APSReq_enum "" UBYTE SWC_OUTP_type_CM_uint8_enum 0 0 0.0 7.0 ECU_ADDRESS 0x0000 /* @ECU_Address@VOUTP_APSReq_enum@ */ /end MEASUREMENT
/begin MEASUREMENT VOUTP_ExtraMSACtrlSta_enum "" UBYTE SWC_OUTP_type_CM_uint8_enum 0 0 0.0 15.0 ECU_ADDRESS 0x0000 /* @ECU_Address@VOUTP_ExtraMSACtrlSta_enum@ */ /end MEASUREMENT
/begin MEASUREMENT VOUTP_CACTempOverHigh_flg "" UBYTE SWC_OUTP_type_CM_boolean_flg 0 0 0.0 1.0 ECU_ADDRESS 0x0000 /* @ECU_Address@VOUTP_CACTempOverHigh_flg@ */ /end MEASUREMENT
/begin MEASUREMENT VOUTP_CACPresWarn_flg "" UBYTE SWC_OUTP_type_CM_boolean_flg 0 0 0.0 1.0 ECU_ADDRESS 0x0000 /* @ECU_Address@VOUTP_CACPresWarn_flg@ */ /end MEASUREMENT
/begin MEASUREMENT VOUTP_CACPresReady_flg "" UBYTE SWC_OUTP_type_CM_boolean_flg 0 0 0.0 1.0 ECU_ADDRESS 0x0000 /* @ECU_Address@VOUTP_CACPresReady_flg@ */ /end MEASUREMENT
/begin MEASUREMENT VOUTP_CACOverrun_flg "" UBYTE SWC_OUTP_type_CM_boolean_flg 0 0 0.0 1.0 ECU_ADDRESS 0x0000 /* @ECU_Address@VOUTP_CACOverrun_flg@ */ /end MEASUREMENT
/begin MEASUREMENT VOUTP_CACRunFail_flg "" UBYTE SWC_OUTP_type_CM_boolean_flg 0 0 0.0 1.0 ECU_ADDRESS 0x0000 /* @ECU_Address@VOUTP_CACRunFail_flg@ */ /end MEASUREMENT
/begin MEASUREMENT VOUTP_CACFanReq_flg "" UBYTE SWC_OUTP_type_CM_boolean_flg 0 0 0.0 1.0 ECU_ADDRESS 0x0000 /* @ECU_Address@VOUTP_CACFanReq_flg@ */ /end MEASUREMENT
/begin MEASUREMENT VOUTP_EHPSSpdDemTimeout_flg "" UBYTE SWC_OUTP_type_CM_boolean_flg 0 0 0.0 1.0 ECU_ADDRESS 0x0000 /* @ECU_Address@VOUTP_EHPSSpdDemTimeout_flg@ */ /end MEASUREMENT
/begin MEASUREMENT VOUTP_EHPSEnTimeout_flg "" UBYTE SWC_OUTP_type_CM_boolean_flg 0 0 0.0 1.0 ECU_ADDRESS 0x0000 /* @ECU_Address@VOUTP_EHPSEnTimeout_flg@ */ /end MEASUREMENT
/begin MEASUREMENT VOUTP_EHPSDisEnTimeout_flg "" UBYTE SWC_OUTP_type_CM_boolean_flg 0 0 0.0 1.0 ECU_ADDRESS 0x0000 /* @ECU_Address@VOUTP_EHPSDisEnTimeout_flg@ */ /end MEASUREMENT
/begin MEASUREMENT VOUTP_FSOffSwTimeOut_flg "" UBYTE SWC_OUTP_type_CM_boolean_flg 0 0 0.0 1.0 ECU_ADDRESS 0x0000 /* @ECU_Address@VOUTP_FSOffSwTimeOut_flg@ */ /end MEASUREMENT
/begin MEASUREMENT VOUTP_BrkPedalPosTimeOut_flg "" UBYTE SWC_OUTP_type_CM_boolean_flg 0 0 0.0 1.0 ECU_ADDRESS 0x0000 /* @ECU_Address@VOUTP_BrkPedalPosTimeOut_flg@ */ /end MEASUREMENT
/begin MEASUREMENT VOUTP_LFRawWhlSpeedTimeOut_flg "" UBYTE SWC_OUTP_type_CM_boolean_flg 0 0 0.0 1.0 ECU_ADDRESS 0x0000 /* @ECU_Address@VOUTP_LFRawWhlSpeedTimeOut_flg@ */ /end MEASUREMENT
/begin MEASUREMENT VOUTP_LRRawWhlSpeedTimeOut_flg "" UBYTE SWC_OUTP_type_CM_boolean_flg 0 0 0.0 1.0 ECU_ADDRESS 0x0000 /* @ECU_Address@VOUTP_LRRawWhlSpeedTimeOut_flg@ */ /end MEASUREMENT
/begin MEASUREMENT VOUTP_LFRawWhlSpeedV_flg "" UBYTE SWC_OUTP_type_CM_boolean_flg 0 0 0.0 1.0 ECU_ADDRESS 0x0000 /* @ECU_Address@VOUTP_LFRawWhlSpeedV_flg@ */ /end MEASUREMENT
/begin MEASUREMENT VOUTP_LFRawWhlSpeedVTimeOut_flg "" UBYTE SWC_OUTP_type_CM_boolean_flg 0 0 0.0 1.0 ECU_ADDRESS 0x0000 /* @ECU_Address@VOUTP_LFRawWhlSpeedVTimeOut_flg@ */ /end MEASUREMENT
/begin MEASUREMENT VOUTP_LRRawWhlSpeedV_flg "" UBYTE SWC_OUTP_type_CM_boolean_flg 0 0 0.0 1.0 ECU_ADDRESS 0x0000 /* @ECU_Address@VOUTP_LRRawWhlSpeedV_flg@ */ /end MEASUREMENT
/begin MEASUREMENT VOUTP_LRRawWhlSpeedVTimeOut_flg "" UBYTE SWC_OUTP_type_CM_boolean_flg 0 0 0.0 1.0 ECU_ADDRESS 0x0000 /* @ECU_Address@VOUTP_LRRawWhlSpeedVTimeOut_flg@ */ /end MEASUREMENT
/begin MEASUREMENT VOUTP_LFWhlRotDirTimeOut_flg "" UBYTE SWC_OUTP_type_CM_boolean_flg 0 0 0.0 1.0 ECU_ADDRESS 0x0000 /* @ECU_Address@VOUTP_LFWhlRotDirTimeOut_flg@ */ /end MEASUREMENT
/begin MEASUREMENT VOUTP_LRWhlRotDirTimeOut_flg "" UBYTE SWC_OUTP_type_CM_boolean_flg 0 0 0.0 1.0 ECU_ADDRESS 0x0000 /* @ECU_Address@VOUTP_LRWhlRotDirTimeOut_flg@ */ /end MEASUREMENT
/begin MEASUREMENT VOUTP_LFPulseCountV_flg "" UBYTE SWC_OUTP_type_CM_boolean_flg 0 0 0.0 1.0 ECU_ADDRESS 0x0000 /* @ECU_Address@VOUTP_LFPulseCountV_flg@ */ /end MEASUREMENT
/begin MEASUREMENT VOUTP_LFPulseCountVTimeOut_flg "" UBYTE SWC_OUTP_type_CM_boolean_flg 0 0 0.0 1.0 ECU_ADDRESS 0x0000 /* @ECU_Address@VOUTP_LFPulseCountVTimeOut_flg@ */ /end MEASUREMENT
/begin MEASUREMENT VOUTP_LRPulseCountV_flg "" UBYTE SWC_OUTP_type_CM_boolean_flg 0 0 0.0 1.0 ECU_ADDRESS 0x0000 /* @ECU_Address@VOUTP_LRPulseCountV_flg@ */ /end MEASUREMENT
/begin MEASUREMENT VOUTP_LRPulseCountVTimeOut_flg "" UBYTE SWC_OUTP_type_CM_boolean_flg 0 0 0.0 1.0 ECU_ADDRESS 0x0000 /* @ECU_Address@VOUTP_LRPulseCountVTimeOut_flg@ */ /end MEASUREMENT
/begin MEASUREMENT VOUTP_LFPulseCountTimeOut_flg "" UBYTE SWC_OUTP_type_CM_boolean_flg 0 0 0.0 1.0 ECU_ADDRESS 0x0000 /* @ECU_Address@VOUTP_LFPulseCountTimeOut_flg@ */ /end MEASUREMENT
/begin MEASUREMENT VOUTP_LRPulseCountTimeOut_flg "" UBYTE SWC_OUTP_type_CM_boolean_flg 0 0 0.0 1.0 ECU_ADDRESS 0x0000 /* @ECU_Address@VOUTP_LRPulseCountTimeOut_flg@ */ /end MEASUREMENT
/begin MEASUREMENT VOUTP_DriIntendTimeOut_flg "" UBYTE SWC_OUTP_type_CM_boolean_flg 0 0 0.0 1.0 ECU_ADDRESS 0x0000 /* @ECU_Address@VOUTP_DriIntendTimeOut_flg@ */ /end MEASUREMENT
/begin MEASUREMENT VOUTP_EPSAOIControlTimeOut_flg "" UBYTE SWC_OUTP_type_CM_boolean_flg 0 0 0.0 1.0 ECU_ADDRESS 0x0000 /* @ECU_Address@VOUTP_EPSAOIControlTimeOut_flg@ */ /end MEASUREMENT
/begin MEASUREMENT VOUTP_GRADETimeOut_flg "" UBYTE SWC_OUTP_type_CM_boolean_flg 0 0 0.0 1.0 ECU_ADDRESS 0x0000 /* @ECU_Address@VOUTP_GRADETimeOut_flg@ */ /end MEASUREMENT
/begin MEASUREMENT VOUTP_LatAccelTimeOut_flg "" UBYTE SWC_OUTP_type_CM_boolean_flg 0 0 0.0 1.0 ECU_ADDRESS 0x0000 /* @ECU_Address@VOUTP_LatAccelTimeOut_flg@ */ /end MEASUREMENT
/begin MEASUREMENT VOUTP_LongAccelTimeOut_flg "" UBYTE SWC_OUTP_type_CM_boolean_flg 0 0 0.0 1.0 ECU_ADDRESS 0x0000 /* @ECU_Address@VOUTP_LongAccelTimeOut_flg@ */ /end MEASUREMENT
/begin MEASUREMENT VOUTP_MCPressureTimeOut_flg "" UBYTE SWC_OUTP_type_CM_boolean_flg 0 0 0.0 1.0 ECU_ADDRESS 0x0000 /* @ECU_Address@VOUTP_MCPressureTimeOut_flg@ */ /end MEASUREMENT
/begin MEASUREMENT VOUTP_LatAccelV_flg "" UBYTE SWC_OUTP_type_CM_boolean_flg 0 0 0.0 1.0 ECU_ADDRESS 0x0000 /* @ECU_Address@VOUTP_LatAccelV_flg@ */ /end MEASUREMENT
/begin MEASUREMENT VOUTP_LatAccelVTimeOut_flg "" UBYTE SWC_OUTP_type_CM_boolean_flg 0 0 0.0 1.0 ECU_ADDRESS 0x0000 /* @ECU_Address@VOUTP_LatAccelVTimeOut_flg@ */ /end MEASUREMENT
/begin MEASUREMENT VOUTP_LongAccelV_flg "" UBYTE SWC_OUTP_type_CM_boolean_flg 0 0 0.0 1.0 ECU_ADDRESS 0x0000 /* @ECU_Address@VOUTP_LongAccelV_flg@ */ /end MEASUREMENT
/begin MEASUREMENT VOUTP_LongAccelVTimeOut_flg "" UBYTE SWC_OUTP_type_CM_boolean_flg 0 0 0.0 1.0 ECU_ADDRESS 0x0000 /* @ECU_Address@VOUTP_LongAccelVTimeOut_flg@ */ /end MEASUREMENT
/begin MEASUREMENT VOUTP_MCPressureV_bar "" UBYTE SWC_OUTP_type_CM_boolean_bar 0 0 0.0 1.0 ECU_ADDRESS 0x0000 /* @ECU_Address@VOUTP_MCPressureV_bar@ */ /end MEASUREMENT
/begin MEASUREMENT VOUTP_MCPressureVTimeOut_flg "" UBYTE SWC_OUTP_type_CM_boolean_flg 0 0 0.0 1.0 ECU_ADDRESS 0x0000 /* @ECU_Address@VOUTP_MCPressureVTimeOut_flg@ */ /end MEASUREMENT
/begin MEASUREMENT VOUTP_BrkSwSta_flg "" UBYTE SWC_OUTP_type_CM_boolean_flg 0 0 0.0 1.0 ECU_ADDRESS 0x0000 /* @ECU_Address@VOUTP_BrkSwSta_flg@ */ /end MEASUREMENT
/begin MEASUREMENT VOUTP_BrkSwStaTimeOut_flg "" UBYTE SWC_OUTP_type_CM_boolean_flg 0 0 0.0 1.0 ECU_ADDRESS 0x0000 /* @ECU_Address@VOUTP_BrkSwStaTimeOut_flg@ */ /end MEASUREMENT
/begin MEASUREMENT VOUTP_BrkSwV_flg "" UBYTE SWC_OUTP_type_CM_boolean_flg 0 0 0.0 1.0 ECU_ADDRESS 0x0000 /* @ECU_Address@VOUTP_BrkSwV_flg@ */ /end MEASUREMENT
/begin MEASUREMENT VOUTP_BrkSwVTimeOut_flg "" UBYTE SWC_OUTP_type_CM_boolean_flg 0 0 0.0 1.0 ECU_ADDRESS 0x0000 /* @ECU_Address@VOUTP_BrkSwVTimeOut_flg@ */ /end MEASUREMENT
/begin MEASUREMENT VOUTP_ESCStandstill_flg "" UBYTE SWC_OUTP_type_CM_boolean_flg 0 0 0.0 1.0 ECU_ADDRESS 0x0000 /* @ECU_Address@VOUTP_ESCStandstill_flg@ */ /end MEASUREMENT
/begin MEASUREMENT VOUTP_ESCStandstillTimeOut_flg "" UBYTE SWC_OUTP_type_CM_boolean_flg 0 0 0.0 1.0 ECU_ADDRESS 0x0000 /* @ECU_Address@VOUTP_ESCStandstillTimeOut_flg@ */ /end MEASUREMENT
/begin MEASUREMENT VOUTP_ESCAPSStaTimeOut_flg "" UBYTE SWC_OUTP_type_CM_boolean_flg 0 0 0.0 1.0 ECU_ADDRESS 0x0000 /* @ECU_Address@VOUTP_ESCAPSStaTimeOut_flg@ */ /end MEASUREMENT
/begin MEASUREMENT VOUTP_EPBExtReleaseAvail_flg "" UBYTE SWC_OUTP_type_CM_boolean_flg 0 0 0.0 1.0 ECU_ADDRESS 0x0000 /* @ECU_Address@VOUTP_EPBExtReleaseAvail_flg@ */ /end MEASUREMENT
/begin MEASUREMENT VOUTP_EPBExtReleaseAvailTimeOut_flg "" UBYTE SWC_OUTP_type_CM_boolean_flg 0 0 0.0 1.0 ECU_ADDRESS 0x0000 /* @ECU_Address@VOUTP_EPBExtReleaseAvailTimeOut_flg@ */ /end MEASUREMENT
/begin MEASUREMENT VOUTP_EPBExtApplyAvail_flg "" UBYTE SWC_OUTP_type_CM_boolean_flg 0 0 0.0 1.0 ECU_ADDRESS 0x0000 /* @ECU_Address@VOUTP_EPBExtApplyAvail_flg@ */ /end MEASUREMENT
/begin MEASUREMENT VOUTP_EPBExtApplyAvailTimeOut_flg "" UBYTE SWC_OUTP_type_CM_boolean_flg 0 0 0.0 1.0 ECU_ADDRESS 0x0000 /* @ECU_Address@VOUTP_EPBExtApplyAvailTimeOut_flg@ */ /end MEASUREMENT
/begin MEASUREMENT VOUTP_EPBErrStaTimeOut_flg "" UBYTE SWC_OUTP_type_CM_boolean_flg 0 0 0.0 1.0 ECU_ADDRESS 0x0000 /* @ECU_Address@VOUTP_EPBErrStaTimeOut_flg@ */ /end MEASUREMENT
/begin MEASUREMENT VOUTP_EPBStaTimeOut_flg "" UBYTE SWC_OUTP_type_CM_boolean_flg 0 0 0.0 1.0 ECU_ADDRESS 0x0000 /* @ECU_Address@VOUTP_EPBStaTimeOut_flg@ */ /end MEASUREMENT
/begin MEASUREMENT VOUTP_AVMparkingcancelTimeOut_flg "" UBYTE SWC_OUTP_type_CM_boolean_flg 0 0 0.0 1.0 ECU_ADDRESS 0x0000 /* @ECU_Address@VOUTP_AVMparkingcancelTimeOut_flg@ */ /end MEASUREMENT
/begin MEASUREMENT VOUTP_AVMparkingexcuteTimeOut_flg "" UBYTE SWC_OUTP_type_CM_boolean_flg 0 0 0.0 1.0 ECU_ADDRESS 0x0000 /* @ECU_Address@VOUTP_AVMparkingexcuteTimeOut_flg@ */ /end MEASUREMENT
/begin MEASUREMENT VOUTP_AVMParkingmodeTimeOut_flg "" UBYTE SWC_OUTP_type_CM_boolean_flg 0 0 0.0 1.0 ECU_ADDRESS 0x0000 /* @ECU_Address@VOUTP_AVMParkingmodeTimeOut_flg@ */ /end MEASUREMENT
/begin MEASUREMENT VOUTP_AVMErrSTA_flg "" UBYTE SWC_OUTP_type_CM_boolean_flg 0 0 0.0 1.0 ECU_ADDRESS 0x0000 /* @ECU_Address@VOUTP_AVMErrSTA_flg@ */ /end MEASUREMENT
/begin MEASUREMENT VOUTP_AVMErrSTATimeOut_flg "" UBYTE SWC_OUTP_type_CM_boolean_flg 0 0 0.0 1.0 ECU_ADDRESS 0x0000 /* @ECU_Address@VOUTP_AVMErrSTATimeOut_flg@ */ /end MEASUREMENT
/begin MEASUREMENT VOUTP_IVIStatus_flg "" UBYTE SWC_OUTP_type_CM_boolean_flg 0 0 0.0 1.0 ECU_ADDRESS 0x0000 /* @ECU_Address@VOUTP_IVIStatus_flg@ */ /end MEASUREMENT
/begin MEASUREMENT VOUTP_IVIStatusTimeOut_flg "" UBYTE SWC_OUTP_type_CM_boolean_flg 0 0 0.0 1.0 ECU_ADDRESS 0x0000 /* @ECU_Address@VOUTP_IVIStatusTimeOut_flg@ */ /end MEASUREMENT
/begin MEASUREMENT VOUTP_CAASSwTimeOut_flg "" UBYTE SWC_OUTP_type_CM_boolean_flg 0 0 0.0 1.0 ECU_ADDRESS 0x0000 /* @ECU_Address@VOUTP_CAASSwTimeOut_flg@ */ /end MEASUREMENT
/begin MEASUREMENT VOUTP_IVIScreenTimeOut_flg "" UBYTE SWC_OUTP_type_CM_boolean_flg 0 0 0.0 1.0 ECU_ADDRESS 0x0000 /* @ECU_Address@VOUTP_IVIScreenTimeOut_flg@ */ /end MEASUREMENT
/begin MEASUREMENT VOUTP_ABSActive_flg "" UBYTE SWC_OUTP_type_CM_boolean_flg 0 0 0.0 1.0 ECU_ADDRESS 0x0000 /* @ECU_Address@VOUTP_ABSActive_flg@ */ /end MEASUREMENT
/begin MEASUREMENT VOUTP_ABSActiveTimeOut_flg "" UBYTE SWC_OUTP_type_CM_boolean_flg 0 0 0.0 1.0 ECU_ADDRESS 0x0000 /* @ECU_Address@VOUTP_ABSActiveTimeOut_flg@ */ /end MEASUREMENT
/begin MEASUREMENT VOUTP_DriverSeatBeltCmd_flg "" UBYTE SWC_OUTP_type_CM_boolean_flg 0 0 0.0 1.0 ECU_ADDRESS 0x0000 /* @ECU_Address@VOUTP_DriverSeatBeltCmd_flg@ */ /end MEASUREMENT
/begin MEASUREMENT VOUTP_DriverSeatBeltCmdTimeOut_flg "" UBYTE SWC_OUTP_type_CM_boolean_flg 0 0 0.0 1.0 ECU_ADDRESS 0x0000 /* @ECU_Address@VOUTP_DriverSeatBeltCmdTimeOut_flg@ */ /end MEASUREMENT
/begin MEASUREMENT VOUTP_APSVRqEPASCtrl_flg "" UBYTE SWC_OUTP_type_CM_boolean_flg 0 0 0.0 1.0 ECU_ADDRESS 0x0000 /* @ECU_Address@VOUTP_APSVRqEPASCtrl_flg@ */ /end MEASUREMENT
/begin MEASUREMENT VOUTP_APSRqEPASCtrl_flg "" UBYTE SWC_OUTP_type_CM_boolean_flg 0 0 0.0 1.0 ECU_ADDRESS 0x0000 /* @ECU_Address@VOUTP_APSRqEPASCtrl_flg@ */ /end MEASUREMENT
/begin MEASUREMENT VOUTP_PUIDLowPower_flg "" UBYTE SWC_OUTP_type_CM_boolean_flg 0 0 0.0 1.0 ECU_ADDRESS 0x0000 /* @ECU_Address@VOUTP_PUIDLowPower_flg@ */ /end MEASUREMENT
/begin MEASUREMENT VOUTP_CAASVMCReqA_flg "" UBYTE SWC_OUTP_type_CM_boolean_flg 0 0 0.0 1.0 ECU_ADDRESS 0x0000 /* @ECU_Address@VOUTP_CAASVMCReqA_flg@ */ /end MEASUREMENT
/begin MEASUREMENT VOUTP_APSVMCReqA_flg "" UBYTE SWC_OUTP_type_CM_boolean_flg 0 0 0.0 1.0 ECU_ADDRESS 0x0000 /* @ECU_Address@VOUTP_APSVMCReqA_flg@ */ /end MEASUREMENT
/begin MEASUREMENT VOUTP_RAPSBCMLockReq_flg "" UBYTE SWC_OUTP_type_CM_boolean_flg 0 0 0.0 1.0 ECU_ADDRESS 0x0000 /* @ECU_Address@VOUTP_RAPSBCMLockReq_flg@ */ /end MEASUREMENT
/begin MEASUREMENT VOUTP_RAPSErrLv1_flg "" UBYTE SWC_OUTP_type_CM_boolean_flg 0 0 0.0 1.0 ECU_ADDRESS 0x0000 /* @ECU_Address@VOUTP_RAPSErrLv1_flg@ */ /end MEASUREMENT
/begin MEASUREMENT VOUTP_IVIUserTakeOverAPSSta_flg "" UBYTE SWC_OUTP_type_CM_boolean_flg 0 0 0.0 1.0 ECU_ADDRESS 0x0000 /* @ECU_Address@VOUTP_IVIUserTakeOverAPSSta_flg@ */ /end MEASUREMENT
/begin MEASUREMENT VOUTP_FDCBCMLBeamCmd_flg "" UBYTE SWC_OUTP_type_CM_boolean_flg 0 0 0.0 1.0 ECU_ADDRESS 0x0000 /* @ECU_Address@VOUTP_FDCBCMLBeamCmd_flg@ */ /end MEASUREMENT
/begin MEASUREMENT VOUTP_FDCBCMPLampCmd_flg "" UBYTE SWC_OUTP_type_CM_boolean_flg 0 0 0.0 1.0 ECU_ADDRESS 0x0000 /* @ECU_Address@VOUTP_FDCBCMPLampCmd_flg@ */ /end MEASUREMENT
/begin MEASUREMENT VOUTP_FDCBCMHBeamCmd_flg "" UBYTE SWC_OUTP_type_CM_boolean_flg 0 0 0.0 1.0 ECU_ADDRESS 0x0000 /* @ECU_Address@VOUTP_FDCBCMHBeamCmd_flg@ */ /end MEASUREMENT
/begin MEASUREMENT VOUTP_FDCBCMSMKLCmd_flg "" UBYTE SWC_OUTP_type_CM_boolean_flg 0 0 0.0 1.0 ECU_ADDRESS 0x0000 /* @ECU_Address@VOUTP_FDCBCMSMKLCmd_flg@ */ /end MEASUREMENT
/begin MEASUREMENT VOUTP_FDCBCMSMKRCmd_flg "" UBYTE SWC_OUTP_type_CM_boolean_flg 0 0 0.0 1.0 ECU_ADDRESS 0x0000 /* @ECU_Address@VOUTP_FDCBCMSMKRCmd_flg@ */ /end MEASUREMENT
/begin MEASUREMENT VOUTP_FDCBCMDVRSignalLCmd_flg "" UBYTE SWC_OUTP_type_CM_boolean_flg 0 0 0.0 1.0 ECU_ADDRESS 0x0000 /* @ECU_Address@VOUTP_FDCBCMDVRSignalLCmd_flg@ */ /end MEASUREMENT
/begin MEASUREMENT VOUTP_FDCBCMDVRSignalRCmd_flg "" UBYTE SWC_OUTP_type_CM_boolean_flg 0 0 0.0 1.0 ECU_ADDRESS 0x0000 /* @ECU_Address@VOUTP_FDCBCMDVRSignalRCmd_flg@ */ /end MEASUREMENT
/begin MEASUREMENT VOUTP_FDCBCMBSDBuzzerCmd_flg "" UBYTE SWC_OUTP_type_CM_boolean_flg 0 0 0.0 1.0 ECU_ADDRESS 0x0000 /* @ECU_Address@VOUTP_FDCBCMBSDBuzzerCmd_flg@ */ /end MEASUREMENT
/begin MEASUREMENT VOUTP_FDCBCMSLTLpCmd_flg "" UBYTE SWC_OUTP_type_CM_boolean_flg 0 0 0.0 1.0 ECU_ADDRESS 0x0000 /* @ECU_Address@VOUTP_FDCBCMSLTLpCmd_flg@ */ /end MEASUREMENT
/begin MEASUREMENT VOUTP_FDCBCMSRTLpCmd_flg "" UBYTE SWC_OUTP_type_CM_boolean_flg 0 0 0.0 1.0 ECU_ADDRESS 0x0000 /* @ECU_Address@VOUTP_FDCBCMSRTLpCmd_flg@ */ /end MEASUREMENT
/begin MEASUREMENT VOUTP_FDCBCMLTurnLpCmd_flg "" UBYTE SWC_OUTP_type_CM_boolean_flg 0 0 0.0 1.0 ECU_ADDRESS 0x0000 /* @ECU_Address@VOUTP_FDCBCMLTurnLpCmd_flg@ */ /end MEASUREMENT
/begin MEASUREMENT VOUTP_FDCBCMRTurnLpCmd_flg "" UBYTE SWC_OUTP_type_CM_boolean_flg 0 0 0.0 1.0 ECU_ADDRESS 0x0000 /* @ECU_Address@VOUTP_FDCBCMRTurnLpCmd_flg@ */ /end MEASUREMENT
/begin MEASUREMENT VOUTP_FDCBCMStopINDCmd_flg "" UBYTE SWC_OUTP_type_CM_boolean_flg 0 0 0.0 1.0 ECU_ADDRESS 0x0000 /* @ECU_Address@VOUTP_FDCBCMStopINDCmd_flg@ */ /end MEASUREMENT
/begin MEASUREMENT VOUTP_FDCBCMSTOPBALLCmd_flg "" UBYTE SWC_OUTP_type_CM_boolean_flg 0 0 0.0 1.0 ECU_ADDRESS 0x0000 /* @ECU_Address@VOUTP_FDCBCMSTOPBALLCmd_flg@ */ /end MEASUREMENT
/begin MEASUREMENT VOUTP_FDCBCMInnerCallBellCmd_flg "" UBYTE SWC_OUTP_type_CM_boolean_flg 0 0 0.0 1.0 ECU_ADDRESS 0x0000 /* @ECU_Address@VOUTP_FDCBCMInnerCallBellCmd_flg@ */ /end MEASUREMENT
/begin MEASUREMENT VOUTP_FDCBCMCallBellCmd_flg "" UBYTE SWC_OUTP_type_CM_boolean_flg 0 0 0.0 1.0 ECU_ADDRESS 0x0000 /* @ECU_Address@VOUTP_FDCBCMCallBellCmd_flg@ */ /end MEASUREMENT
/begin MEASUREMENT VOUTP_FDCBCMWiperHCmd_flg "" UBYTE SWC_OUTP_type_CM_boolean_flg 0 0 0.0 1.0 ECU_ADDRESS 0x0000 /* @ECU_Address@VOUTP_FDCBCMWiperHCmd_flg@ */ /end MEASUREMENT
/begin MEASUREMENT VOUTP_FDCBCMWasherCmd_flg "" UBYTE SWC_OUTP_type_CM_boolean_flg 0 0 0.0 1.0 ECU_ADDRESS 0x0000 /* @ECU_Address@VOUTP_FDCBCMWasherCmd_flg@ */ /end MEASUREMENT
/begin MEASUREMENT VOUTP_FDCBCMWiperLCmd_flg "" UBYTE SWC_OUTP_type_CM_boolean_flg 0 0 0.0 1.0 ECU_ADDRESS 0x0000 /* @ECU_Address@VOUTP_FDCBCMWiperLCmd_flg@ */ /end MEASUREMENT
/begin MEASUREMENT VOUTP_FDCBCMLDRLCmd_flg "" UBYTE SWC_OUTP_type_CM_boolean_flg 0 0 0.0 1.0 ECU_ADDRESS 0x0000 /* @ECU_Address@VOUTP_FDCBCMLDRLCmd_flg@ */ /end MEASUREMENT
/begin MEASUREMENT VOUTP_FDCBCMRDRLCmd_flg "" UBYTE SWC_OUTP_type_CM_boolean_flg 0 0 0.0 1.0 ECU_ADDRESS 0x0000 /* @ECU_Address@VOUTP_FDCBCMRDRLCmd_flg@ */ /end MEASUREMENT
/begin MEASUREMENT VOUTP_FDCBCMRFLampCmd_flg "" UBYTE SWC_OUTP_type_CM_boolean_flg 0 0 0.0 1.0 ECU_ADDRESS 0x0000 /* @ECU_Address@VOUTP_FDCBCMRFLampCmd_flg@ */ /end MEASUREMENT
/begin MEASUREMENT VOUTP_FDCBCMFDoorSta_flg "" UBYTE SWC_OUTP_type_CM_boolean_flg 0 0 0.0 1.0 ECU_ADDRESS 0x0000 /* @ECU_Address@VOUTP_FDCBCMFDoorSta_flg@ */ /end MEASUREMENT
/begin MEASUREMENT VOUTP_FDCBCMMDoorSta_flg "" UBYTE SWC_OUTP_type_CM_boolean_flg 0 0 0.0 1.0 ECU_ADDRESS 0x0000 /* @ECU_Address@VOUTP_FDCBCMMDoorSta_flg@ */ /end MEASUREMENT
/begin MEASUREMENT VOUTP_FDCBCMRDoorSta_flg "" UBYTE SWC_OUTP_type_CM_boolean_flg 0 0 0.0 1.0 ECU_ADDRESS 0x0000 /* @ECU_Address@VOUTP_FDCBCMRDoorSta_flg@ */ /end MEASUREMENT
/begin MEASUREMENT VOUTP_FDCBCMRoomLpAmbCmd_flg "" UBYTE SWC_OUTP_type_CM_boolean_flg 0 0 0.0 1.0 ECU_ADDRESS 0x0000 /* @ECU_Address@VOUTP_FDCBCMRoomLpAmbCmd_flg@ */ /end MEASUREMENT
/begin MEASUREMENT VOUTP_FDCBCMLBSDRCmd_flg "" UBYTE SWC_OUTP_type_CM_boolean_flg 0 0 0.0 1.0 ECU_ADDRESS 0x0000 /* @ECU_Address@VOUTP_FDCBCMLBSDRCmd_flg@ */ /end MEASUREMENT
/begin MEASUREMENT VOUTP_FDCBCMLBSDYCmd_flg "" UBYTE SWC_OUTP_type_CM_boolean_flg 0 0 0.0 1.0 ECU_ADDRESS 0x0000 /* @ECU_Address@VOUTP_FDCBCMLBSDYCmd_flg@ */ /end MEASUREMENT
/begin MEASUREMENT VOUTP_FDCBCMRBSDRCmd_flg "" UBYTE SWC_OUTP_type_CM_boolean_flg 0 0 0.0 1.0 ECU_ADDRESS 0x0000 /* @ECU_Address@VOUTP_FDCBCMRBSDRCmd_flg@ */ /end MEASUREMENT
/begin MEASUREMENT VOUTP_FDCBCMRBSDYCmd_flg "" UBYTE SWC_OUTP_type_CM_boolean_flg 0 0 0.0 1.0 ECU_ADDRESS 0x0000 /* @ECU_Address@VOUTP_FDCBCMRBSDYCmd_flg@ */ /end MEASUREMENT
/begin MEASUREMENT VOUTP_FDCBCMEmExitSWSta_flg "" UBYTE SWC_OUTP_type_CM_boolean_flg 0 0 0.0 1.0 ECU_ADDRESS 0x0000 /* @ECU_Address@VOUTP_FDCBCMEmExitSWSta_flg@ */ /end MEASUREMENT
/begin MEASUREMENT VOUTP_FDCBCMInnerBuzzerCmd_flg "" UBYTE SWC_OUTP_type_CM_boolean_flg 0 0 0.0 1.0 ECU_ADDRESS 0x0000 /* @ECU_Address@VOUTP_FDCBCMInnerBuzzerCmd_flg@ */ /end MEASUREMENT
/begin MEASUREMENT VOUTP_FDCBCMRoomLpAmbSetSta_flg "" UBYTE SWC_OUTP_type_CM_boolean_flg 0 0 0.0 1.0 ECU_ADDRESS 0x0000 /* @ECU_Address@VOUTP_FDCBCMRoomLpAmbSetSta_flg@ */ /end MEASUREMENT
/begin MEASUREMENT VOUTP_FDCBCMRoomLpSetSta_flg "" UBYTE SWC_OUTP_type_CM_boolean_flg 0 0 0.0 1.0 ECU_ADDRESS 0x0000 /* @ECU_Address@VOUTP_FDCBCMRoomLpSetSta_flg@ */ /end MEASUREMENT
/begin MEASUREMENT VOUTP_FDCBCMHelpINDCmd_flg "" UBYTE SWC_OUTP_type_CM_boolean_flg 0 0 0.0 1.0 ECU_ADDRESS 0x0000 /* @ECU_Address@VOUTP_FDCBCMHelpINDCmd_flg@ */ /end MEASUREMENT
/begin MEASUREMENT VOUTP_FDCBCMEmSVCmd_flg "" UBYTE SWC_OUTP_type_CM_boolean_flg 0 0 0.0 1.0 ECU_ADDRESS 0x0000 /* @ECU_Address@VOUTP_FDCBCMEmSVCmd_flg@ */ /end MEASUREMENT
/begin MEASUREMENT VOUTP_FDCBCMFDOpenSVCmd_flg "" UBYTE SWC_OUTP_type_CM_boolean_flg 0 0 0.0 1.0 ECU_ADDRESS 0x0000 /* @ECU_Address@VOUTP_FDCBCMFDOpenSVCmd_flg@ */ /end MEASUREMENT
/begin MEASUREMENT VOUTP_FDCBCMFDCloseSVCmd_flg "" UBYTE SWC_OUTP_type_CM_boolean_flg 0 0 0.0 1.0 ECU_ADDRESS 0x0000 /* @ECU_Address@VOUTP_FDCBCMFDCloseSVCmd_flg@ */ /end MEASUREMENT
/begin MEASUREMENT VOUTP_FDCBCMMDOpenSVCmd_flg "" UBYTE SWC_OUTP_type_CM_boolean_flg 0 0 0.0 1.0 ECU_ADDRESS 0x0000 /* @ECU_Address@VOUTP_FDCBCMMDOpenSVCmd_flg@ */ /end MEASUREMENT
/begin MEASUREMENT VOUTP_FDCBCMMDCloseSVCmd_flg "" UBYTE SWC_OUTP_type_CM_boolean_flg 0 0 0.0 1.0 ECU_ADDRESS 0x0000 /* @ECU_Address@VOUTP_FDCBCMMDCloseSVCmd_flg@ */ /end MEASUREMENT
/begin MEASUREMENT VOUTP_FDCBCMLTurnSWSta_flg "" UBYTE SWC_OUTP_type_CM_boolean_flg 0 0 0.0 1.0 ECU_ADDRESS 0x0000 /* @ECU_Address@VOUTP_FDCBCMLTurnSWSta_flg@ */ /end MEASUREMENT
/begin MEASUREMENT VOUTP_FDCBCMRTurnSWSta_flg "" UBYTE SWC_OUTP_type_CM_boolean_flg 0 0 0.0 1.0 ECU_ADDRESS 0x0000 /* @ECU_Address@VOUTP_FDCBCMRTurnSWSta_flg@ */ /end MEASUREMENT
/begin MEASUREMENT VOUTP_FDCBCMRGearSta_flg "" UBYTE SWC_OUTP_type_CM_boolean_flg 0 0 0.0 1.0 ECU_ADDRESS 0x0000 /* @ECU_Address@VOUTP_FDCBCMRGearSta_flg@ */ /end MEASUREMENT
/begin MEASUREMENT VOUTP_FDCBCMBrakeCmd_flg "" UBYTE SWC_OUTP_type_CM_boolean_flg 0 0 0.0 1.0 ECU_ADDRESS 0x0000 /* @ECU_Address@VOUTP_FDCBCMBrakeCmd_flg@ */ /end MEASUREMENT
/begin MEASUREMENT VOUTP_FDCBCMTurnBuzzerENSta_flg "" UBYTE SWC_OUTP_type_CM_boolean_flg 0 0 0.0 1.0 ECU_ADDRESS 0x0000 /* @ECU_Address@VOUTP_FDCBCMTurnBuzzerENSta_flg@ */ /end MEASUREMENT
/begin MEASUREMENT VOUTP_KeepWakeUp_flg "" UBYTE SWC_OUTP_type_CM_boolean_flg 0 0 0.0 1.0 ECU_ADDRESS 0x0000 /* @ECU_Address@VOUTP_KeepWakeUp_flg@ */ /end MEASUREMENT
/begin MEASUREMENT VOUTP_EDriveSysErrVCUErr_flg "" UBYTE SWC_OUTP_type_CM_boolean_flg 0 0 0.0 1.0 ECU_ADDRESS 0x0000 /* @ECU_Address@VOUTP_EDriveSysErrVCUErr_flg@ */ /end MEASUREMENT
/begin MEASUREMENT VOUTP_EnterNewOperCyc_flg "" UBYTE SWC_OUTP_type_CM_boolean_flg 0 0 0.0 1.0 ECU_ADDRESS 0x0000 /* @ECU_Address@VOUTP_EnterNewOperCyc_flg@ */ /end MEASUREMENT
/begin MEASUREMENT VOUTP_LimpHomeActTmp_flg "" UBYTE SWC_OUTP_type_CM_boolean_flg 0 0 0.0 1.0 ECU_ADDRESS 0x0000 /* @ECU_Address@VOUTP_LimpHomeActTmp_flg@ */ /end MEASUREMENT
/begin MEASUREMENT VOUTP_EngagePFail_flg "" UBYTE SWC_OUTP_type_CM_boolean_flg 0 0 0.0 1.0 ECU_ADDRESS 0x0000 /* @ECU_Address@VOUTP_EngagePFail_flg@ */ /end MEASUREMENT
/begin MEASUREMENT VOUTP_DisengagePFail_flg "" UBYTE SWC_OUTP_type_CM_boolean_flg 0 0 0.0 1.0 ECU_ADDRESS 0x0000 /* @ECU_Address@VOUTP_DisengagePFail_flg@ */ /end MEASUREMENT
/begin MEASUREMENT VOUTP_EDriveSysErrShifterErr_flg "" UBYTE SWC_OUTP_type_CM_boolean_flg 0 0 0.0 1.0 ECU_ADDRESS 0x0000 /* @ECU_Address@VOUTP_EDriveSysErrShifterErr_flg@ */ /end MEASUREMENT
/begin MEASUREMENT VOUTP_LVSysErrPwrOutErr_flg "" UBYTE SWC_OUTP_type_CM_boolean_flg 0 0 0.0 1.0 ECU_ADDRESS 0x0000 /* @ECU_Address@VOUTP_LVSysErrPwrOutErr_flg@ */ /end MEASUREMENT
/begin MEASUREMENT VOUTP_HVRlyOpFail_flg "" UBYTE SWC_OUTP_type_CM_boolean_flg 0 0 0.0 1.0 ECU_ADDRESS 0x0000 /* @ECU_Address@VOUTP_HVRlyOpFail_flg@ */ /end MEASUREMENT
/begin MEASUREMENT VOUTP_MCUActDisFail_flg "" UBYTE SWC_OUTP_type_CM_boolean_flg 0 0 0.0 1.0 ECU_ADDRESS 0x0000 /* @ECU_Address@VOUTP_MCUActDisFail_flg@ */ /end MEASUREMENT
/begin MEASUREMENT VOUTP_KeyMissSta_flg "" UBYTE SWC_OUTP_type_CM_boolean_flg 0 0 0.0 1.0 ECU_ADDRESS 0x0000 /* @ECU_Address@VOUTP_KeyMissSta_flg@ */ /end MEASUREMENT
/begin MEASUREMENT VOUTP_FDCDKCAllowSleep_flg "" UBYTE SWC_OUTP_type_CM_boolean_flg 0 0 0.0 1.0 ECU_ADDRESS 0x0000 /* @ECU_Address@VOUTP_FDCDKCAllowSleep_flg@ */ /end MEASUREMENT
/begin MEASUREMENT VOUTP_JudgeKeepUnlockZone_flg "" UBYTE SWC_OUTP_type_CM_boolean_flg 0 0 0.0 1.0 ECU_ADDRESS 0x0000 /* @ECU_Address@VOUTP_JudgeKeepUnlockZone_flg@ */ /end MEASUREMENT
/begin MEASUREMENT VOUTP_DISCTurn_flg "" UBYTE SWC_OUTP_type_CM_boolean_flg 0 0 0.0 1.0 ECU_ADDRESS 0x0000 /* @ECU_Address@VOUTP_DISCTurn_flg@ */ /end MEASUREMENT
/begin MEASUREMENT VOUTP_DISCButtSta_flg "" UBYTE SWC_OUTP_type_CM_boolean_flg 0 0 0.0 1.0 ECU_ADDRESS 0x0000 /* @ECU_Address@VOUTP_DISCButtSta_flg@ */ /end MEASUREMENT
/begin MEASUREMENT VOUTP_AllCANTxReq_flg "" UBYTE SWC_OUTP_type_CM_boolean_flg 0 0 0.0 1.0 ECU_ADDRESS 0x0000 /* @ECU_Address@VOUTP_AllCANTxReq_flg@ */ /end MEASUREMENT
/begin MEASUREMENT VOUTP_NMmTxReq_flg "" UBYTE SWC_OUTP_type_CM_boolean_flg 0 0 0.0 1.0 ECU_ADDRESS 0x0000 /* @ECU_Address@VOUTP_NMmTxReq_flg@ */ /end MEASUREMENT
/begin MEASUREMENT VOUTP_CSB_flg "" UBYTE SWC_OUTP_type_CM_boolean_flg 0 0 0.0 1.0 ECU_ADDRESS 0x0000 /* @ECU_Address@VOUTP_CSB_flg@ */ /end MEASUREMENT
/begin MEASUREMENT VOUTP_PNI_flg "" UBYTE SWC_OUTP_type_CM_boolean_flg 0 0 0.0 1.0 ECU_ADDRESS 0x0000 /* @ECU_Address@VOUTP_PNI_flg@ */ /end MEASUREMENT
/begin MEASUREMENT VOUTP_ActiveWU_flg "" UBYTE SWC_OUTP_type_CM_boolean_flg 0 0 0.0 1.0 ECU_ADDRESS 0x0000 /* @ECU_Address@VOUTP_ActiveWU_flg@ */ /end MEASUREMENT
/begin MEASUREMENT VOUTP_NetworkReq_flg "" UBYTE SWC_OUTP_type_CM_boolean_flg 0 0 0.0 1.0 ECU_ADDRESS 0x0000 /* @ECU_Address@VOUTP_NetworkReq_flg@ */ /end MEASUREMENT
/begin MEASUREMENT VOUTP_IRCRlyClose_flg "" UBYTE SWC_OUTP_type_CM_boolean_flg 0 0 0.0 1.0 ECU_ADDRESS 0x0000 /* @ECU_Address@VOUTP_IRCRlyClose_flg@ */ /end MEASUREMENT
/begin MEASUREMENT VOUTP_IGNRlyClose_flg "" UBYTE SWC_OUTP_type_CM_boolean_flg 0 0 0.0 1.0 ECU_ADDRESS 0x0000 /* @ECU_Address@VOUTP_IGNRlyClose_flg@ */ /end MEASUREMENT
/begin MEASUREMENT VOUTP_HVILFail_flg "" UBYTE SWC_OUTP_type_CM_boolean_flg 0 0 0.0 1.0 ECU_ADDRESS 0x0000 /* @ECU_Address@VOUTP_HVILFail_flg@ */ /end MEASUREMENT
/begin MEASUREMENT VOUTP_LostHVComActivePwrDown_flg "" UBYTE SWC_OUTP_type_CM_boolean_flg 0 0 0.0 1.0 ECU_ADDRESS 0x0000 /* @ECU_Address@VOUTP_LostHVComActivePwrDown_flg@ */ /end MEASUREMENT
/begin MEASUREMENT VOUTP_ChrgPowerUpFail_flg "" UBYTE SWC_OUTP_type_CM_boolean_flg 0 0 0.0 1.0 ECU_ADDRESS 0x0000 /* @ECU_Address@VOUTP_ChrgPowerUpFail_flg@ */ /end MEASUREMENT
/begin MEASUREMENT VOUTP_ChrgBCUHVFail_flg "" UBYTE SWC_OUTP_type_CM_boolean_flg 0 0 0.0 1.0 ECU_ADDRESS 0x0000 /* @ECU_Address@VOUTP_ChrgBCUHVFail_flg@ */ /end MEASUREMENT
/begin MEASUREMENT VOUTP_HVFailureChkPass_flg "" UBYTE SWC_OUTP_type_CM_boolean_flg 0 0 0.0 1.0 ECU_ADDRESS 0x0000 /* @ECU_Address@VOUTP_HVFailureChkPass_flg@ */ /end MEASUREMENT
/begin MEASUREMENT VOUTP_HVILDetectFail_flg "" UBYTE SWC_OUTP_type_CM_boolean_flg 0 0 0.0 1.0 ECU_ADDRESS 0x0000 /* @ECU_Address@VOUTP_HVILDetectFail_flg@ */ /end MEASUREMENT
/begin MEASUREMENT VOUTP_EmergencyShutDown_flg "" UBYTE SWC_OUTP_type_CM_boolean_flg 0 0 0.0 1.0 ECU_ADDRESS 0x0000 /* @ECU_Address@VOUTP_EmergencyShutDown_flg@ */ /end MEASUREMENT
/begin MEASUREMENT VOUTP_NvWriteReqRisingEdge_flg "" UBYTE SWC_OUTP_type_CM_boolean_flg 0 0 0.0 1.0 ECU_ADDRESS 0x0000 /* @ECU_Address@VOUTP_NvWriteReqRisingEdge_flg@ */ /end MEASUREMENT
/begin MEASUREMENT VOUTP_FdcSlpReqRisingEdge_flg "" UBYTE SWC_OUTP_type_CM_boolean_flg 0 0 0.0 1.0 ECU_ADDRESS 0x0000 /* @ECU_Address@VOUTP_FdcSlpReqRisingEdge_flg@ */ /end MEASUREMENT
/begin MEASUREMENT VOUTP_AcoreRebootCmdACK_flg "" UBYTE SWC_OUTP_type_CM_boolean_flg 0 0 0.0 1.0 ECU_ADDRESS 0x0000 /* @ECU_Address@VOUTP_AcoreRebootCmdACK_flg@ */ /end MEASUREMENT
/begin MEASUREMENT VOUTP_AfterrunningMode_flg "" UBYTE SWC_OUTP_type_CM_boolean_flg 0 0 0.0 1.0 ECU_ADDRESS 0x0000 /* @ECU_Address@VOUTP_AfterrunningMode_flg@ */ /end MEASUREMENT
/begin MEASUREMENT VOUTP_LFBatWarn_flg "" UBYTE SWC_OUTP_type_CM_boolean_flg 0 0 0.0 1.0 ECU_ADDRESS 0x0000 /* @ECU_Address@VOUTP_LFBatWarn_flg@ */ /end MEASUREMENT
/begin MEASUREMENT VOUTP_RFBatWarn_flg "" UBYTE SWC_OUTP_type_CM_boolean_flg 0 0 0.0 1.0 ECU_ADDRESS 0x0000 /* @ECU_Address@VOUTP_RFBatWarn_flg@ */ /end MEASUREMENT
/begin MEASUREMENT VOUTP_LRBatWarn_flg "" UBYTE SWC_OUTP_type_CM_boolean_flg 0 0 0.0 1.0 ECU_ADDRESS 0x0000 /* @ECU_Address@VOUTP_LRBatWarn_flg@ */ /end MEASUREMENT
/begin MEASUREMENT VOUTP_LFSensorFail_flg "" UBYTE SWC_OUTP_type_CM_boolean_flg 0 0 0.0 1.0 ECU_ADDRESS 0x0000 /* @ECU_Address@VOUTP_LFSensorFail_flg@ */ /end MEASUREMENT
/begin MEASUREMENT VOUTP_LRSensorFail_flg "" UBYTE SWC_OUTP_type_CM_boolean_flg 0 0 0.0 1.0 ECU_ADDRESS 0x0000 /* @ECU_Address@VOUTP_LRSensorFail_flg@ */ /end MEASUREMENT
/begin MEASUREMENT VOUTP_LFWheelDebug_flg "" UBYTE SWC_OUTP_type_CM_boolean_flg 0 0 0.0 1.0 ECU_ADDRESS 0x0000 /* @ECU_Address@VOUTP_LFWheelDebug_flg@ */ /end MEASUREMENT
/begin MEASUREMENT VOUTP_LRWheelDebug_flg "" UBYTE SWC_OUTP_type_CM_boolean_flg 0 0 0.0 1.0 ECU_ADDRESS 0x0000 /* @ECU_Address@VOUTP_LRWheelDebug_flg@ */ /end MEASUREMENT
/begin MEASUREMENT VOUTP_LFWheelTmpIndi_flg "" UBYTE SWC_OUTP_type_CM_boolean_flg 0 0 0.0 1.0 ECU_ADDRESS 0x0000 /* @ECU_Address@VOUTP_LFWheelTmpIndi_flg@ */ /end MEASUREMENT
/begin MEASUREMENT VOUTP_LRWheelTmpIndi_flg "" UBYTE SWC_OUTP_type_CM_boolean_flg 0 0 0.0 1.0 ECU_ADDRESS 0x0000 /* @ECU_Address@VOUTP_LRWheelTmpIndi_flg@ */ /end MEASUREMENT
/begin MEASUREMENT VOUTP_LFSensorMode_flg "" UBYTE SWC_OUTP_type_CM_boolean_flg 0 0 0.0 1.0 ECU_ADDRESS 0x0000 /* @ECU_Address@VOUTP_LFSensorMode_flg@ */ /end MEASUREMENT
/begin MEASUREMENT VOUTP_LRSensorMode_flg "" UBYTE SWC_OUTP_type_CM_boolean_flg 0 0 0.0 1.0 ECU_ADDRESS 0x0000 /* @ECU_Address@VOUTP_LRSensorMode_flg@ */ /end MEASUREMENT
/begin MEASUREMENT VOUTP_ALFin_flg "" UBYTE SWC_OUTP_type_CM_boolean_flg 0 0 0.0 1.0 ECU_ADDRESS 0x0000 /* @ECU_Address@VOUTP_ALFin_flg@ */ /end MEASUREMENT
/begin MEASUREMENT VOUTP_FAT_flg "" UBYTE SWC_OUTP_type_CM_boolean_flg 0 0 0.0 1.0 ECU_ADDRESS 0x0000 /* @ECU_Address@VOUTP_FAT_flg@ */ /end MEASUREMENT
/begin MEASUREMENT VOUTP_Chkfin_flg "" UBYTE SWC_OUTP_type_CM_boolean_flg 0 0 0.0 1.0 ECU_ADDRESS 0x0000 /* @ECU_Address@VOUTP_Chkfin_flg@ */ /end MEASUREMENT
/begin MEASUREMENT VOUTP_ChkStorge_flg "" UBYTE SWC_OUTP_type_CM_boolean_flg 0 0 0.0 1.0 ECU_ADDRESS 0x0000 /* @ECU_Address@VOUTP_ChkStorge_flg@ */ /end MEASUREMENT
/begin MEASUREMENT VOUTP_ParkingProtectWarning_flg "" UBYTE SWC_OUTP_type_CM_boolean_flg 0 0 0.0 1.0 ECU_ADDRESS 0x0000 /* @ECU_Address@VOUTP_ParkingProtectWarning_flg@ */ /end MEASUREMENT
/begin MEASUREMENT VOUTP_GearFlashIndDis_flg "" UBYTE SWC_OUTP_type_CM_boolean_flg 0 0 0.0 1.0 ECU_ADDRESS 0x0000 /* @ECU_Address@VOUTP_GearFlashIndDis_flg@ */ /end MEASUREMENT
/begin MEASUREMENT VOUTP_GearFlashInd_flg "" UBYTE SWC_OUTP_type_CM_boolean_flg 0 0 0.0 1.0 ECU_ADDRESS 0x0000 /* @ECU_Address@VOUTP_GearFlashInd_flg@ */ /end MEASUREMENT
/begin MEASUREMENT VOUTP_FrontRearSlipRatioCtrl_flg "" UBYTE SWC_OUTP_type_CM_boolean_flg 0 0 0.0 1.0 ECU_ADDRESS 0x0000 /* @ECU_Address@VOUTP_FrontRearSlipRatioCtrl_flg@ */ /end MEASUREMENT
/begin MEASUREMENT VOUTP_LatAccCtrl_flg "" UBYTE SWC_OUTP_type_CM_boolean_flg 0 0 0.0 1.0 ECU_ADDRESS 0x0000 /* @ECU_Address@VOUTP_LatAccCtrl_flg@ */ /end MEASUREMENT
/begin MEASUREMENT VOUTP_LateralCtrl_flg "" UBYTE SWC_OUTP_type_CM_boolean_flg 0 0 0.0 1.0 ECU_ADDRESS 0x0000 /* @ECU_Address@VOUTP_LateralCtrl_flg@ */ /end MEASUREMENT
/begin MEASUREMENT VOUTP_LKATOIFault_flg "" UBYTE SWC_OUTP_type_CM_boolean_flg 0 0 0.0 1.0 ECU_ADDRESS 0x0000 /* @ECU_Address@VOUTP_LKATOIFault_flg@ */ /end MEASUREMENT
/begin MEASUREMENT VOUTP_ADASFaultSta_flg "" UBYTE SWC_OUTP_type_CM_boolean_flg 0 0 0.0 1.0 ECU_ADDRESS 0x0000 /* @ECU_Address@VOUTP_ADASFaultSta_flg@ */ /end MEASUREMENT
/begin MEASUREMENT VOUTP_AEBVehHoldReq_flg "" UBYTE SWC_OUTP_type_CM_boolean_flg 0 0 0.0 1.0 ECU_ADDRESS 0x0000 /* @ECU_Address@VOUTP_AEBVehHoldReq_flg@ */ /end MEASUREMENT
/begin MEASUREMENT VOUTP_ACCVehHoldReq_flg "" UBYTE SWC_OUTP_type_CM_boolean_flg 0 0 0.0 1.0 ECU_ADDRESS 0x0000 /* @ECU_Address@VOUTP_ACCVehHoldReq_flg@ */ /end MEASUREMENT
/begin MEASUREMENT VOUTP_ADASShftPosnReqA_flg "" UBYTE SWC_OUTP_type_CM_boolean_flg 0 0 0.0 1.0 ECU_ADDRESS 0x0000 /* @ECU_Address@VOUTP_ADASShftPosnReqA_flg@ */ /end MEASUREMENT
/begin MEASUREMENT VOUTP_ADASForceIdle_flg "" UBYTE SWC_OUTP_type_CM_boolean_flg 0 0 0.0 1.0 ECU_ADDRESS 0x0000 /* @ECU_Address@VOUTP_ADASForceIdle_flg@ */ /end MEASUREMENT
/begin MEASUREMENT VOUTP_HazardWarningReq_flg "" UBYTE SWC_OUTP_type_CM_boolean_flg 0 0 0.0 1.0 ECU_ADDRESS 0x0000 /* @ECU_Address@VOUTP_HazardWarningReq_flg@ */ /end MEASUREMENT
/begin MEASUREMENT VOUTP_LeftTurnLightReq_flg "" UBYTE SWC_OUTP_type_CM_boolean_flg 0 0 0.0 1.0 ECU_ADDRESS 0x0000 /* @ECU_Address@VOUTP_LeftTurnLightReq_flg@ */ /end MEASUREMENT
/begin MEASUREMENT VOUTP_ADASFltWrnReq_flg "" UBYTE SWC_OUTP_type_CM_boolean_flg 0 0 0.0 1.0 ECU_ADDRESS 0x0000 /* @ECU_Address@VOUTP_ADASFltWrnReq_flg@ */ /end MEASUREMENT
/begin MEASUREMENT VOUTP_ACCTakeoverReq_flg "" UBYTE SWC_OUTP_type_CM_boolean_flg 0 0 0.0 1.0 ECU_ADDRESS 0x0000 /* @ECU_Address@VOUTP_ACCTakeoverReq_flg@ */ /end MEASUREMENT
/begin MEASUREMENT VOUTP_LKAHODDisplayWarning_flg "" UBYTE SWC_OUTP_type_CM_boolean_flg 0 0 0.0 1.0 ECU_ADDRESS 0x0000 /* @ECU_Address@VOUTP_LKAHODDisplayWarning_flg@ */ /end MEASUREMENT
/begin MEASUREMENT VOUTP_LKAHODSoundWarning_flg "" UBYTE SWC_OUTP_type_CM_boolean_flg 0 0 0.0 1.0 ECU_ADDRESS 0x0000 /* @ECU_Address@VOUTP_LKAHODSoundWarning_flg@ */ /end MEASUREMENT
/begin MEASUREMENT VOUTP_ADASLDWMute_flg "" UBYTE SWC_OUTP_type_CM_boolean_flg 0 0 0.0 1.0 ECU_ADDRESS 0x0000 /* @ECU_Address@VOUTP_ADASLDWMute_flg@ */ /end MEASUREMENT
/begin MEASUREMENT VOUTP_ADASFCWMute_flg "" UBYTE SWC_OUTP_type_CM_boolean_flg 0 0 0.0 1.0 ECU_ADDRESS 0x0000 /* @ECU_Address@VOUTP_ADASFCWMute_flg@ */ /end MEASUREMENT
/begin MEASUREMENT VOUTP_LVDADisabled_flg "" UBYTE SWC_OUTP_type_CM_boolean_flg 0 0 0.0 1.0 ECU_ADDRESS 0x0000 /* @ECU_Address@VOUTP_LVDADisabled_flg@ */ /end MEASUREMENT
/begin MEASUREMENT VOUTP_LVDAFailinfo_flg "" UBYTE SWC_OUTP_type_CM_boolean_flg 0 0 0.0 1.0 ECU_ADDRESS 0x0000 /* @ECU_Address@VOUTP_LVDAFailinfo_flg@ */ /end MEASUREMENT
/begin MEASUREMENT VOUTP_LVDAWarning_flg "" UBYTE SWC_OUTP_type_CM_boolean_flg 0 0 0.0 1.0 ECU_ADDRESS 0x0000 /* @ECU_Address@VOUTP_LVDAWarning_flg@ */ /end MEASUREMENT
/begin MEASUREMENT VOUTP_LVDAACCStatusInformation_flg "" UBYTE SWC_OUTP_type_CM_boolean_flg 0 0 0.0 1.0 ECU_ADDRESS 0x0000 /* @ECU_Address@VOUTP_LVDAACCStatusInformation_flg@ */ /end MEASUREMENT
/begin MEASUREMENT VOUTP_FCMLDWFault_flg "" UBYTE SWC_OUTP_type_CM_boolean_flg 0 0 0.0 1.0 ECU_ADDRESS 0x0000 /* @ECU_Address@VOUTP_FCMLDWFault_flg@ */ /end MEASUREMENT
/begin MEASUREMENT VOUTP_ACCCtrlAvail_flg "" UBYTE SWC_OUTP_type_CM_boolean_flg 0 0 0.0 1.0 ECU_ADDRESS 0x0000 /* @ECU_Address@VOUTP_ACCCtrlAvail_flg@ */ /end MEASUREMENT
/begin MEASUREMENT VOUTP_ACCPedalOvrd_flg "" UBYTE SWC_OUTP_type_CM_boolean_flg 0 0 0.0 1.0 ECU_ADDRESS 0x0000 /* @ECU_Address@VOUTP_ACCPedalOvrd_flg@ */ /end MEASUREMENT
/begin MEASUREMENT VOUTP_APSCtrlAvail_flg "" UBYTE SWC_OUTP_type_CM_boolean_flg 0 0 0.0 1.0 ECU_ADDRESS 0x0000 /* @ECU_Address@VOUTP_APSCtrlAvail_flg@ */ /end MEASUREMENT
/begin MEASUREMENT VOUTP_APSActive_flg "" UBYTE SWC_OUTP_type_CM_boolean_flg 0 0 0.0 1.0 ECU_ADDRESS 0x0000 /* @ECU_Address@VOUTP_APSActive_flg@ */ /end MEASUREMENT
/begin MEASUREMENT VOUTP_APSDecReqA_flg "" UBYTE SWC_OUTP_type_CM_boolean_flg 0 0 0.0 1.0 ECU_ADDRESS 0x0000 /* @ECU_Address@VOUTP_APSDecReqA_flg@ */ /end MEASUREMENT
/begin MEASUREMENT VOUTP_CCMSASpdWar_flg "" UBYTE SWC_OUTP_type_CM_boolean_flg 0 0 0.0 1.0 ECU_ADDRESS 0x0000 /* @ECU_Address@VOUTP_CCMSASpdWar_flg@ */ /end MEASUREMENT
/begin MEASUREMENT VOUTP_IMUEnaCmd_flg "" UBYTE SWC_OUTP_type_CM_boolean_flg 0 0 0.0 1.0 ECU_ADDRESS 0x0000 /* @ECU_Address@VOUTP_IMUEnaCmd_flg@ */ /end MEASUREMENT
/begin MEASUREMENT VOUTP_CAASCtrlAvail_flg "" UBYTE SWC_OUTP_type_CM_boolean_flg 0 0 0.0 1.0 ECU_ADDRESS 0x0000 /* @ECU_Address@VOUTP_CAASCtrlAvail_flg@ */ /end MEASUREMENT
/begin MEASUREMENT VOUTP_CAASActive_flg "" UBYTE SWC_OUTP_type_CM_boolean_flg 0 0 0.0 1.0 ECU_ADDRESS 0x0000 /* @ECU_Address@VOUTP_CAASActive_flg@ */ /end MEASUREMENT
/begin MEASUREMENT VOUTP_FDCVMCAPSVRqEPSCtrl_flg "" UBYTE SWC_OUTP_type_CM_boolean_flg 0 0 0.0 1.0 ECU_ADDRESS 0x0000 /* @ECU_Address@VOUTP_FDCVMCAPSVRqEPSCtrl_flg@ */ /end MEASUREMENT
/begin MEASUREMENT VOUTP_FDCVMCAPSRqEPSCtrl_flg "" UBYTE SWC_OUTP_type_CM_boolean_flg 0 0 0.0 1.0 ECU_ADDRESS 0x0000 /* @ECU_Address@VOUTP_FDCVMCAPSRqEPSCtrl_flg@ */ /end MEASUREMENT
/begin MEASUREMENT VOUTP_FDCVMCDrInpTqBstAct_flg "" UBYTE SWC_OUTP_type_CM_boolean_flg 0 0 0.0 1.0 ECU_ADDRESS 0x0000 /* @ECU_Address@VOUTP_FDCVMCDrInpTqBstAct_flg@ */ /end MEASUREMENT
/begin COMPU_METHOD SWC_OUTP_type_CM_single_mps2 "Q = V" RAT_FUNC "%8.6" "mps2" COEFFS 0 1 0 0 0 1 /end COMPU_METHOD
/begin COMPU_METHOD SWC_OUTP_type_CM_single_mps3 "Q = V" RAT_FUNC "%8.6" "mps3" COEFFS 0 1 0 0 0 1 /end COMPU_METHOD
/begin COMPU_METHOD SWC_OUTP_type_CM_single_m "Q = V" RAT_FUNC "%8.6" "m" COEFFS 0 1 0 0 0 1 /end COMPU_METHOD
/begin COMPU_METHOD SWC_OUTP_type_CM_single_mps "Q = V" RAT_FUNC "%8.6" "mps" COEFFS 0 1 0 0 0 1 /end COMPU_METHOD
/begin COMPU_METHOD SWC_OUTP_type_CM_single_raw32 "Q = V" RAT_FUNC "%8.6" "raw32" COEFFS 0 1 0 0 0 1 /end COMPU_METHOD
/begin COMPU_METHOD SWC_OUTP_type_CM_single_pct "Q = V" RAT_FUNC "%8.6" "pct" COEFFS 0 1 0 0 0 1 /end COMPU_METHOD
/begin COMPU_METHOD SWC_OUTP_type_CM_single_Deg "Q = V" RAT_FUNC "%8.6" "Deg" COEFFS 0 1 0 0 0 1 /end COMPU_METHOD
/begin COMPU_METHOD SWC_OUTP_type_CM_single_kph "Q = V" RAT_FUNC "%8.6" "kph" COEFFS 0 1 0 0 0 1 /end COMPU_METHOD
/begin COMPU_METHOD SWC_OUTP_type_CM_single_C "Q = V" RAT_FUNC "%8.6" "C" COEFFS 0 1 0 0 0 1 /end COMPU_METHOD
/begin COMPU_METHOD SWC_OUTP_type_CM_single_km "Q = V" RAT_FUNC "%8.6" "km" COEFFS 0 1 0 0 0 1 /end COMPU_METHOD
/begin COMPU_METHOD SWC_OUTP_type_CM_single_Gps "Q = V" RAT_FUNC "%8.6" "Gps" COEFFS 0 1 0 0 0 1 /end COMPU_METHOD
/begin COMPU_METHOD SWC_OUTP_type_CM_single_G "Q = V" RAT_FUNC "%8.6" "G" COEFFS 0 1 0 0 0 1 /end COMPU_METHOD
/begin COMPU_METHOD SWC_OUTP_type_CM_single_Dps "Q = V" RAT_FUNC "%8.6" "Dps" COEFFS 0 1 0 0 0 1 /end COMPU_METHOD
/begin COMPU_METHOD SWC_OUTP_type_CM_single_rpm "Q = V" RAT_FUNC "%8.6" "rpm" COEFFS 0 1 0 0 0 1 /end COMPU_METHOD
/begin COMPU_METHOD SWC_OUTP_type_CM_single_A "Q = V" RAT_FUNC "%8.6" "A" COEFFS 0 1 0 0 0 1 /end COMPU_METHOD
/begin COMPU_METHOD SWC_OUTP_type_CM_single_V "Q = V" RAT_FUNC "%8.6" "V" COEFFS 0 1 0 0 0 1 /end COMPU_METHOD
/begin COMPU_METHOD SWC_OUTP_type_CM_single_gain "Q = V" RAT_FUNC "%8.6" "gain" COEFFS 0 1 0 0 0 1 /end COMPU_METHOD
/begin COMPU_METHOD SWC_OUTP_type_CM_single_s "Q = V" RAT_FUNC "%8.6" "s" COEFFS 0 1 0 0 0 1 /end COMPU_METHOD
/begin COMPU_METHOD SWC_OUTP_type_CM_single_kgpm2 "Q = V" RAT_FUNC "%8.6" "kgpm2" COEFFS 0 1 0 0 0 1 /end COMPU_METHOD
/begin COMPU_METHOD SWC_OUTP_type_CM_single_Nm "Q = V" RAT_FUNC "%8.6" "Nm" COEFFS 0 1 0 0 0 1 /end COMPU_METHOD
/begin COMPU_METHOD SWC_OUTP_type_CM_single_enum "Q = V" RAT_FUNC "%8.6" "enum" COEFFS 0 1 0 0 0 1 /end COMPU_METHOD
/begin COMPU_METHOD SWC_OUTP_type_CM_single_kWh "Q = V" RAT_FUNC "%8.6" "kWh" COEFFS 0 1 0 0 0 1 /end COMPU_METHOD
/begin COMPU_METHOD SWC_OUTP_type_CM_single_deg "Q = V" RAT_FUNC "%8.6" "deg" COEFFS 0 1 0 0 0 1 /end COMPU_METHOD
/begin COMPU_METHOD SWC_OUTP_type_CM_single_sec "Q = V" RAT_FUNC "%8.6" "sec" COEFFS 0 1 0 0 0 1 /end COMPU_METHOD
/begin COMPU_METHOD SWC_OUTP_type_CM_single_Ahr "Q = V" RAT_FUNC "%8.6" "Ahr" COEFFS 0 1 0 0 0 1 /end COMPU_METHOD
/begin COMPU_METHOD SWC_OUTP_type_CM_single_Ahps "Q = V" RAT_FUNC "%8.6" "Ahps" COEFFS 0 1 0 0 0 1 /end COMPU_METHOD
/begin COMPU_METHOD SWC_OUTP_type_CM_single_kW "Q = V" RAT_FUNC "%8.6" "kW" COEFFS 0 1 0 0 0 1 /end COMPU_METHOD
/begin COMPU_METHOD SWC_OUTP_type_CM_single_Whps "Q = V" RAT_FUNC "%8.6" "Whps" COEFFS 0 1 0 0 0 1 /end COMPU_METHOD
/begin COMPU_METHOD SWC_OUTP_type_CM_single_bar "Q = V" RAT_FUNC "%8.6" "bar" COEFFS 0 1 0 0 0 1 /end COMPU_METHOD
/begin COMPU_METHOD SWC_OUTP_type_CM_single_kphsqr "Q = V" RAT_FUNC "%8.6" "kphsqr" COEFFS 0 1 0 0 0 1 /end COMPU_METHOD
/begin COMPU_METHOD SWC_OUTP_type_CM_uint32_raw32 "Q = V" RAT_FUNC "%10.0" "raw32" COEFFS 0 1 0 0 0 1 /end COMPU_METHOD
/begin COMPU_METHOD SWC_OUTP_type_CM_uint32_sec "Q = V" RAT_FUNC "%10.0" "sec" COEFFS 0 1 0 0 0 1 /end COMPU_METHOD
/begin COMPU_METHOD SWC_OUTP_type_CM_uint32_raw "Q = V" RAT_FUNC "%10.0" "raw" COEFFS 0 1 0 0 0 1 /end COMPU_METHOD
/begin COMPU_METHOD SWC_OUTP_type_CM_uint32_cnt "Q = V" RAT_FUNC "%10.0" "cnt" COEFFS 0 1 0 0 0 1 /end COMPU_METHOD
/begin COMPU_METHOD SWC_OUTP_type_CM_uint16_cm "Q = V" RAT_FUNC "%5.0" "cm" COEFFS 0 1 0 0 0 1 /end COMPU_METHOD
/begin COMPU_METHOD SWC_OUTP_type_CM_uint16_raw "Q = V" RAT_FUNC "%5.0" "raw" COEFFS 0 1 0 0 0 1 /end COMPU_METHOD
/begin COMPU_METHOD SWC_OUTP_type_CM_uint16_min "Q = V" RAT_FUNC "%5.0" "min" COEFFS 0 1 0 0 0 1 /end COMPU_METHOD
/begin COMPU_METHOD SWC_OUTP_type_CM_uint16_cnt "Q = V" RAT_FUNC "%5.0" "cnt" COEFFS 0 1 0 0 0 1 /end COMPU_METHOD
/begin COMPU_METHOD SWC_OUTP_type_CM_boolean_flg "Q = V" RAT_FUNC "%1.0" "flg" COEFFS 0 1 0 0 0 1 /end COMPU_METHOD
/begin COMPU_METHOD SWC_OUTP_type_CM_boolean_bar "Q = V" RAT_FUNC "%1.0" "bar" COEFFS 0 1 0 0 0 1 /end COMPU_METHOD
/begin COMPU_METHOD SWC_OUTP_type_CM_uint8_enum "Q = V" RAT_FUNC "%3.0" "enum" COEFFS 0 1 0 0 0 1 /end COMPU_METHOD
/begin COMPU_METHOD SWC_OUTP_type_CM_uint8_cnt "Q = V" RAT_FUNC "%3.0" "cnt" COEFFS 0 1 0 0 0 1 /end COMPU_METHOD
/begin COMPU_METHOD SWC_OUTP_type_CM_uint8_pct "Q = V" RAT_FUNC "%3.0" "pct" COEFFS 0 1 0 0 0 1 /end COMPU_METHOD
/begin COMPU_METHOD SWC_OUTP_type_CM_uint8_raw "Q = V" RAT_FUNC "%3.0" "raw" COEFFS 0 1 0 0 0 1 /end COMPU_METHOD
/begin COMPU_METHOD SWC_OUTP_type_CM_uint8_raw8 "Q = V" RAT_FUNC "%3.0" "raw8" COEFFS 0 1 0 0 0 1 /end COMPU_METHOD
/begin COMPU_METHOD SWC_OUTP_type_CM_uint8_cm "Q = V" RAT_FUNC "%3.0" "cm" COEFFS 0 1 0 0 0 1 /end COMPU_METHOD
/begin COMPU_METHOD SWC_OUTP_type_CM_uint32 "Q = V" RAT_FUNC "%10.0" "" COEFFS 0 1 0 0 0 1 /end COMPU_METHOD
/begin COMPU_METHOD SWC_OUTP_type_CM_uint16 "Q = V" RAT_FUNC "%5.0" "" COEFFS 0 1 0 0 0 1 /end COMPU_METHOD
/begin COMPU_METHOD SWC_OUTP_type_CM_uint8 "Q = V" RAT_FUNC "%3.0" "" COEFFS 0 1 0 0 0 1 /end COMPU_METHOD
/begin GROUP SWC_OUTP_type "SWC_OUTP_type" /* Root */ ROOT /begin SUB_GROUP Root_run_SWC_OUTP_5ms_sys /end SUB_GROUP /end GROUP
/begin GROUP Root_run_SWC_OUTP_5ms_sys "SWC_OUTP_type/run_SWC_OUTP_5ms_sys" /begin SUB_GROUP S2_OUTP /end SUB_GROUP /end GROUP
/begin GROUP S2_OUTP "SWC_OUTP_type/run_SWC_OUTP_5ms_sys/OUTP" /begin SUB_GROUP S3_outpmodule /end SUB_GROUP /end GROUP
/begin GROUP S3_outpmodule "SWC_OUTP_type/run_SWC_OUTP_5ms_sys/OUTP/outpmodule"
 /begin SUB_GROUP S5_VACC_CACFanReq_flg_Inproc S5_VACC_CACOverrun_flg_Inproc S5_VACC_CACPresReady_flg_Inproc S5_VACC_CACPresWarn_flg_Inproc S5_VACC_CACRunFail_flg_Inproc S5_VACC_CACTempOverHigh_flg_Inproc S5_VACC_DCDCEnDemamd_enum_Inproc S5_VACC_EACEnDemand_enum_Inproc S5_VACC_EACSpdDemand_rpm_Inproc S5_VACC_EHPSDisEnTimeout_flg_Inproc S5_VACC_EHPSEnDemand_enum_Inproc S5_VACC_EHPSEnTimeout_flg_Inproc S5_VACC_EHPSMotorDemSpd_rpm_Inproc S5_VACC_EHPSSpdCtrlMode_enum_Inproc S5_VACC_EHPSSpdDemTimeout_flg_Inproc S5_VAPM_ABSActiveTimeOut_flg_Inproc S5_VAPM_ABSActive_flg_Inproc S5_VAPM_APSAngleTarget_Deg_Inproc S5_VAPM_APSDFLL_cm_Inproc S5_VAPM_APSDFLR_cm_Inproc S5_VAPM_APSDRLL_cm_Inproc S5_VAPM_APSDRLR_cm_Inproc S5_VAPM_APSExitCondition_enum_Inproc S5_VAPM_APSHWVer_enum_Inproc S5_VAPM_APSProgressPCT_pct_Inproc S5_VAPM_APSPwrReq_enum_Inproc S5_VAPM_APSRQDisplay_enum_Inproc S5_VAPM_APSRqEPASCtrl_flg_Inproc S5_VAPM_APSSWVer_enum_Inproc S5_VAPM_APSShiftPosnReq_enum_Inproc S5_VAPM_APSSpeedCMD_kph_Inproc S5_VAPM_APSVMCReqA_flg_Inproc S5_VAPM_APSVRqEPASCtrl_flg_Inproc S5_VAPM_AVMErrSTATimeOut_flg_Inproc S5_VAPM_AVMErrSTA_flg_Inproc S5_VAPM_AVMParkingmodeTimeOut_flg_Inproc S5_VAPM_AVMParkingmode_enum_Inproc S5_VAPM_AVMparkingcancelTimeOut_flg_Inproc S5_VAPM_AVMparkingcancel_enum_Inproc S5_VAPM_AVMparkingexcuteTimeOut_flg_Inproc S5_VAPM_AVMparkingexcute_enum_Inproc S5_VAPM_BrkPedalPosTimeOut_flg_Inproc S5_VAPM_BrkPedalPos_pct_Inproc S5_VAPM_BrkSwStaTimeOut_flg_Inproc S5_VAPM_BrkSwSta_flg_Inproc S5_VAPM_BrkSwVTimeOut_flg_Inproc S5_VAPM_BrkSwV_flg_Inproc S5_VAPM_CAASSta_enum_Inproc S5_VAPM_CAASSwTimeOut_flg_Inproc S5_VAPM_CAASSw_enum_Inproc S5_VAPM_CAASVMCReqA_flg_Inproc S5_VAPM_Chime_enum_Inproc S5_VAPM_ChrgPlugSta_enum_Inproc S5_VAPM_DKCPDkeyAreaRAPSSta_enum_Inproc S5_VAPM_DKCParkingModeCmd_enum_Inproc S5_VAPM_DriIntendTimeOut_flg_Inproc S5_VAPM_DriIntend_enum_Inproc S5_VAPM_DriverSeatBeltCmdTimeOut_flg_Inproc S5_VAPM_DriverSeatBeltCmd_flg_Inproc S5_VAPM_EPBErrStaTimeOut_flg_Inproc S5_VAPM_EPBErrSta_enum_Inproc S5_VAPM_EPBExtApplyAvailTimeOut_flg_Inproc S5_VAPM_EPBExtApplyAvail_flg_Inproc S5_VAPM_EPBExtReleaseAvailTimeOut_flg_Inproc S5_VAPM_EPBExtReleaseAvail_flg_Inproc S5_VAPM_EPBStaTimeOut_flg_Inproc S5_VAPM_EPBSta_enum_Inproc S5_VAPM_EPSAOIControlTimeOut_flg_Inproc S5_VAPM_EPSAOIControl_enum_Inproc S5_VAPM_ESCAPSStaTimeOut_flg_Inproc S5_VAPM_ESCAPSSta_enum_Inproc S5_VAPM_ESCStandstillTimeOut_flg_Inproc S5_VAPM_ESCStandstill_flg_Inproc S5_VAPM_FSOffSwTimeOut_flg_Inproc S5_VAPM_FSOffSw_enum_Inproc S5_VAPM_GRADETimeOut_flg_Inproc S5_VAPM_GRADE_Deg_Inproc S5_VAPM_IVIScreenTimeOut_flg_Inproc S5_VAPM_IVIScreen_enum_Inproc S5_VAPM_IVIStatusTimeOut_flg_Inproc S5_VAPM_IVIStatus_flg_Inproc S5_VAPM_IVIUserTakeOverAPSSta_flg_Inproc S5_VAPM_LFPulseCountTimeOut_flg_Inproc S5_VAPM_LFPulseCountVTimeOut_flg_Inproc S5_VAPM_LFPulseCountV_flg_Inproc S5_VAPM_LFPulseCount_enum_Inproc S5_VAPM_LFRawWhlSpeedTimeOut_flg_Inproc S5_VAPM_LFRawWhlSpeedVTimeOut_flg_Inproc S5_VAPM_LFRawWhlSpeedV_flg_Inproc S5_VAPM_LFRawWhlSpeed_kph_Inproc S5_VAPM_LFWhlRotDirTimeOut_flg_Inproc S5_VAPM_LFWhlRotDir_enum_Inproc S5_VAPM_LRPulseCountTimeOut_flg_Inproc S5_VAPM_LRPulseCountVTimeOut_flg_Inproc S5_VAPM_LRPulseCountV_flg_Inproc S5_VAPM_LRPulseCount_enum_Inproc S5_VAPM_LRRawWhlSpeedTimeOut_flg_Inproc S5_VAPM_LRRawWhlSpeedVTimeOut_flg_Inproc S5_VAPM_LRRawWhlSpeedV_flg_Inproc S5_VAPM_LRRawWhlSpeed_kph_Inproc S5_VAPM_LRWhlRotDirTimeOut_flg_Inproc S5_VAPM_LRWhlRotDir_enum_Inproc S5_VAPM_LatAccelTimeOut_flg_Inproc S5_VAPM_LatAccelVTimeOut_flg_Inproc S5_VAPM_LatAccelV_flg_Inproc S5_VAPM_LatAccel_Gps_Inproc S5_VAPM_LongAccelTimeOut_flg_Inproc S5_VAPM_LongAccelVTimeOut_flg_Inproc S5_VAPM_LongAccelV_flg_Inproc S5_VAPM_LongAccel_Gps_Inproc S5_VAPM_MCPressureTimeOut_flg_Inproc S5_VAPM_MCPressureVTimeOut_flg_Inproc S5_VAPM_MCPressureV_bar_Inproc S5_VAPM_MCPressure_bar_Inproc S5_VAPM_ModOperation_enum_Inproc S5_VAPM_PASAFCL_enum_Inproc S5_VAPM_PASAFCR_enum_Inproc S5_VAPM_PASAFML_enum_Inproc S5_VAPM_PASAFMR_enum_Inproc S5_VAPM_PASARCL_enum_Inproc S5_VAPM_PASARCR_enum_Inproc S5_VAPM_PASARML_enum_Inproc S5_VAPM_PASARMR_enum_Inproc S5_VAPM_PASDFCL_cm_Inproc S5_VAPM_PASDFCR_cm_Inproc S5_VAPM_PASDFML_cm_Inproc S5_VAPM_PASDFMR_cm_Inproc S5_VAPM_PASDRCL_cm_Inproc S5_VAPM_PASDRCR_cm_Inproc S5_VAPM_PASDRML_cm_Inproc S5_VAPM_PASDRMR_cm_Inproc S5_VAPM_PUIDLowPower_flg_Inproc S5_VAPM_RAPSBCMLamp_enum_Inproc S5_VAPM_RAPSBCMLockReq_flg_Inproc S5_VAPM_RAPSErrLv1_flg_Inproc S5_VAPM_RAPSErrWarnSta_enum_Inproc S5_VAPM_RFPulseCountTimeOut_flg_Inproc S5_VAPM_RFPulseCountVTimeOut_flg_Inproc S5_VAPM_RFPulseCountV_flg_Inproc S5_VAPM_RFPulseCount_enum_Inproc S5_VAPM_RFRawWhlSpeedTimeOut_flg_Inproc S5_VAPM_RFRawWhlSpeedVTimeOut_flg_Inproc S5_VAPM_RFRawWhlSpeedV_flg_Inproc S5_VAPM_RFRawWhlSpeed_kph_Inproc S5_VAPM_RFWhlRotDirTimeOut_flg_Inproc S5_VAPM_RFWhlRotDir_enum_Inproc S5_VAPM_RRPulseCountTimeOut_flg_Inproc S5_VAPM_RRPulseCountVTimeOut_flg_Inproc S5_VAPM_RRPulseCountV_flg_Inproc S5_VAPM_RRPulseCount_enum_Inproc S5_VAPM_RRRawWhlSpeedTimeOut_flg_Inproc S5_VAPM_RRRawWhlSpeedVTimeOut_flg_Inproc S5_VAPM_RRRawWhlSpeedV_flg_Inproc S5_VAPM_RRRawWhlSpeed_kph_Inproc S5_VAPM_RRWhlRotDirTimeOut_flg_Inproc S5_VAPM_RRWhlRotDir_enum_Inproc S5_VAPM_SASAngleTimeOut_flg_Inproc S5_VAPM_SASAngle_Deg_Inproc S5_VAPM_SASCALTimeOut_flg_Inproc S5_VAPM_SASCAL_flg_Inproc S5_VAPM_SASSpeedTimeOut_flg_Inproc S5_VAPM_SASSpeedValidTimeOut_flg_Inproc S5_VAPM_SASSpeedValid_flg_Inproc S5_VAPM_SASSpeed_degps_Inproc S5_VAPM_SASVTimeOut_flg_Inproc S5_VAPM_SASV_flg_Inproc S5_VAPM_SNSRLayout_enum_Inproc S5_VAPM_ShifterHandleCmdTimeOut_flg_Inproc S5_VAPM_ShifterHandleCmd_enum_Inproc S5_VAPM_StaFSya_flg_Inproc S5_VAPM_TCSActiveTimeOut_flg_Inproc S5_VAPM_TCSActive_flg_Inproc S5_VAPM_USSStaFCL_flg_Inproc S5_VAPM_USSStaFCR_flg_Inproc S5_VAPM_USSStaFLL_flg_Inproc S5_VAPM_USSStaFLR_flg_Inproc S5_VAPM_USSStaFML_flg_Inproc S5_VAPM_USSStaFMR_flg_Inproc S5_VAPM_USSStaRCL_flg_Inproc S5_VAPM_USSStaRCR_flg_Inproc S5_VAPM_USSStaRLL_flg_Inproc S5_VAPM_USSStaRLR_flg_Inproc S5_VAPM_USSStaRML_flg_Inproc S5_VAPM_USSStaRMR_flg_Inproc S5_VAPM_VehSpeedTimeOut_flg_Inproc S5_VAPM_VehSpeed_kph_Inproc S5_VAPM_YawRateTimeOut_flg_Inproc S5_VAPM_YawRateVTimeOut_flg_Inproc S5_VAPM_YawRateV_flg_Inproc S5_VAPM_YawRate_degps_Inproc S5_VBCM_FDCBCMBSDBuzzerCmd_flg_Inproc S5_VBCM_FDCBCMBrakeCmd_flg_Inproc S5_VBCM_FDCBCMCallBellCmd_flg_Inproc S5_VBCM_FDCBCMDVRSignalLCmd_flg_Inproc S5_VBCM_FDCBCMDVRSignalRCmd_flg_Inproc S5_VBCM_FDCBCMEmExitSWSta_flg_Inproc S5_VBCM_FDCBCMEmSVCmd_flg_Inproc S5_VBCM_FDCBCMFDCloseSVCmd_flg_Inproc S5_VBCM_FDCBCMFDOpenSVCmd_flg_Inproc S5_VBCM_FDCBCMFDoorSta_flg_Inproc S5_VBCM_FDCBCMFRoomLpCmd_pct_Inproc S5_VBCM_FDCBCMFRoomLpSetSta_pct_Inproc S5_VBCM_FDCBCMHBeamCmd_flg_Inproc S5_VBCM_FDCBCMHelpINDCmd_flg_Inproc S5_VBCM_FDCBCMInnerBuzzerCmd_flg_Inproc S5_VBCM_FDCBCMInnerCallBellCmd_flg_Inproc S5_VBCM_FDCBCMLBSDRCmd_flg_Inproc S5_VBCM_FDCBCMLBSDYCmd_flg_Inproc S5_VBCM_FDCBCMLBeamCmd_flg_Inproc S5_VBCM_FDCBCMLDRLCmd_flg_Inproc S5_VBCM_FDCBCMLTurnLpCmd_flg_Inproc S5_VBCM_FDCBCMLTurnSWSta_flg_Inproc S5_VBCM_FDCBCMMDCloseSVCmd_flg_Inproc S5_VBCM_FDCBCMMDOpenSVCmd_flg_Inproc S5_VBCM_FDCBCMMDoorSta_flg_Inproc S5_VBCM_FDCBCMMRoomLpCmd_pct_Inproc S5_VBCM_FDCBCMMRoomLpSetSta_pct_Inproc S5_VBCM_FDCBCMOSDrOpenSWSta_enum_Inproc S5_VBCM_FDCBCMPLampCmd_flg_Inproc S5_VBCM_FDCBCMRBSDRCmd_flg_Inproc S5_VBCM_FDCBCMRBSDYCmd_flg_Inproc S5_VBCM_FDCBCMRDRLCmd_flg_Inproc S5_VBCM_FDCBCMRDoorSta_flg_Inproc S5_VBCM_FDCBCMRFLampCmd_flg_Inproc S5_VBCM_FDCBCMRGearSta_flg_Inproc S5_VBCM_FDCBCMRRoomLpCmd_pct_Inproc S5_VBCM_FDCBCMRRoomLpSetSta_pct_Inproc S5_VBCM_FDCBCMRTurnLpCmd_flg_Inproc S5_VBCM_FDCBCMRTurnSWSta_flg_Inproc S5_VBCM_FDCBCMRoomLpAmbCmd_flg_Inproc S5_VBCM_FDCBCMRoomLpAmbSetSta_flg_Inproc S5_VBCM_FDCBCMRoomLpSetSta_flg_Inproc S5_VBCM_FDCBCMSLTLpCmd_flg_Inproc S5_VBCM_FDCBCMSMKLCmd_flg_Inproc S5_VBCM_FDCBCMSMKRCmd_flg_Inproc S5_VBCM_FDCBCMSRTLpCmd_flg_Inproc S5_VBCM_FDCBCMSTOPBALLCmd_flg_Inproc S5_VBCM_FDCBCMStopINDCmd_flg_Inproc S5_VBCM_FDCBCMTurnBuzzerENSta_flg_Inproc S5_VBCM_FDCBCMWasherCmd_flg_Inproc S5_VBCM_FDCBCMWiperHCmd_flg_Inproc S5_VBCM_FDCBCMWiperLCmd_flg_Inproc S5_VBCM_InnerBuzzerModeSta_enum_Inproc S5_VBCM_KeepWakeUp_flg_Inproc S5_VBCM_TurnLpPatternSta_enum_Inproc S5_VBCM_WakeUp_flg_Inproc S5_VDDM_5vAPS1PwrErrDTC_raw32_Inproc S5_VDDM_5vAPS2PwrErrDTC_raw32_Inproc S5_VDDM_ACCAccelCmdErrDetDTC_raw32_Inproc S5_VDDM_ACCMalfuncDetDTC_raw32_Inproc S5_VDDM_APS1SigOoRDTC_raw32_Inproc S5_VDDM_APS2SigOoRDTC_raw32_Inproc S5_VDDM_APSCorrErrDTC_raw32_Inproc S5_VDDM_BMSRdyDTC_raw32_Inproc S5_VDDM_BMSSigErrDetDTC_raw32_Inproc S5_VDDM_BrkSWErrDTC_raw32_Inproc S5_VDDM_BrkSWNoBacDTC_raw32_Inproc S5_VDDM_C1ABM1CSDTC_raw32_Inproc S5_VDDM_C1ABM1LCDTC_raw32_Inproc S5_VDDM_C1ABM1RCDTC_raw32_Inproc S5_VDDM_C1EPAS2LCDTC_raw32_Inproc S5_VDDM_C3BMS1CSDTC_raw32_Inproc S5_VDDM_C3BMS1LCDTC_raw32_Inproc S5_VDDM_C3BMS1RCDTC_raw32_Inproc S5_VDDM_C3BMS6CSDTC_raw32_Inproc S5_VDDM_C3BMS6LCDTC_raw32_Inproc S5_VDDM_C3BMS6RCDTC_raw32_Inproc S5_VDDM_C3CCU1CSDTC_raw32_Inproc S5_VDDM_C3CCU1LCDTC_raw32_Inproc S5_VDDM_C3CCU1RCDTC_raw32_Inproc S5_VDDM_C3CCU2CSDTC_raw32_Inproc S5_VDDM_C3CCU2LCDTC_raw32_Inproc S5_VDDM_C3CCU2RCDTC_raw32_Inproc S5_VDDM_CCMalfuncDetDTC_raw32_Inproc S5_VDDM_CCUSigErrDetDTC_raw32_Inproc S5_VDDM_DCDC4PreDTC_raw32_Inproc S5_VDDM_DCDCDisDTC_raw32_Inproc S5_VDDM_DCDCEnaDTC_raw32_Inproc S5_VDDM_DTCDetect_enum_Inproc S5_VDDM_DiagFLTSDTC_raw32_Inproc S5_VDDM_DiagFRTSDTC_raw32_Inproc S5_VDDM_DiagHCrashDTC_raw32_Inproc S5_VDDM_DiagRLTSDTC_raw32_Inproc S5_VDDM_DiagRRTSDTC_raw32_Inproc S5_VDDM_DisengagePFail_flg_Inproc S5_VDDM_DrStSWDTC_raw32_Inproc S5_VDDM_EDriveSysErrShifterErr_flg_Inproc S5_VDDM_EDriveSysErrVCUErr_flg_Inproc S5_VDDM_EPBLockTODTC_raw32_Inproc S5_VDDM_EPBUnlockTODTC_raw32_Inproc S5_VDDM_ESC1CSErrDTC_raw32_Inproc S5_VDDM_ESC1NoComDTC_raw32_Inproc S5_VDDM_ESC1RCErrDTC_raw32_Inproc S5_VDDM_ESC5CSErrDTC_raw32_Inproc S5_VDDM_ESC5NoComDTC_raw32_Inproc S5_VDDM_ESC5RCErrDTC_raw32_Inproc S5_VDDM_ESC7CSErrDTC_raw32_Inproc S5_VDDM_ESC7NoComDTC_raw32_Inproc S5_VDDM_ESC7RCErrDTC_raw32_Inproc S5_VDDM_EngagePFail_flg_Inproc S5_VDDM_EnterNewOperCyc_flg_Inproc S5_VDDM_FCLUSSDTC_raw32_Inproc S5_VDDM_FCM2CSErrDTC_raw32_Inproc S5_VDDM_FCM2NoComDTC_raw32_Inproc S5_VDDM_FCM2RCErrDTC_raw32_Inproc S5_VDDM_FCM3CSErrDTC_raw32_Inproc S5_VDDM_FCM3NoComDTC_raw32_Inproc S5_VDDM_FCM3RCErrDTC_raw32_Inproc S5_VDDM_FCM4CSErrDTC_raw32_Inproc S5_VDDM_FCM4NoComDTC_raw32_Inproc S5_VDDM_FCM5CSErrDTC_raw32_Inproc S5_VDDM_FCM5NoComDTC_raw32_Inproc S5_VDDM_FCMACCSigErrDetDTC_raw32_Inproc S5_VDDM_FCRUSSDTC_raw32_Inproc S5_VDDM_FLDoorSWDTC_raw32_Inproc S5_VDDM_FLLUSSDTC_raw32_Inproc S5_VDDM_FLRUSSDTC_raw32_Inproc S5_VDDM_FMLUSSDTC_raw32_Inproc S5_VDDM_FMRUSSDTC_raw32_Inproc S5_VDDM_FRDoorSWDTC_raw32_Inproc S5_VDDM_FrMCUSigErrDetDTC_raw32_Inproc S5_VDDM_FrMCUTqErrDTC_raw32_Inproc S5_VDDM_HVB4PreDTC_raw32_Inproc S5_VDDM_HVRlyCloDTC_raw32_Inproc S5_VDDM_HVRlyOpDTC_raw32_Inproc S5_VDDM_HVRlyOpFail_flg_Inproc S5_VDDM_HiLvSaChkDTC_raw32_Inproc S5_VDDM_HoodSWDTC_raw32_Inproc S5_VDDM_ISAMalfuncDetDTC_raw32_Inproc S5_VDDM_IniLVLoDTC_raw32_Inproc S5_VDDM_KeyAuthDTC_raw32_Inproc S5_VDDM_LFBatwarnDTC_raw32_Inproc S5_VDDM_LFPressIndiDTC_raw32_Inproc S5_VDDM_LFSensorFailDTC_raw32_Inproc S5_VDDM_LFWheelTmpHighDTC_raw32_Inproc S5_VDDM_LRBatwarnDTC_raw32_Inproc S5_VDDM_LRPressIndiDTC_raw32_Inproc S5_VDDM_LRSensorFailDTC_raw32_Inproc S5_VDDM_LRWheelTmpHighDTC_raw32_Inproc S5_VDDM_LVSupHiDTC_raw32_Inproc S5_VDDM_LVSupLoDTC_raw32_Inproc S5_VDDM_LVSysErrPwrOutErr_flg_Inproc S5_VDDM_LimpHomeActTmp_flg_Inproc S5_VDDM_Lv1ErrDTC_raw32_Inproc S5_VDDM_Lv2ErrDTC_raw32_Inproc S5_VDDM_Lv3ErrDTC_raw32_Inproc S5_VDDM_Lv4ErrDTC_raw32_Inproc S5_VDDM_MCU4PreDTC_raw32_Inproc S5_VDDM_MCUActDTC_raw32_Inproc S5_VDDM_MCUActDisFail_flg_Inproc S5_VDDM_MCUDisDTC_raw32_Inproc S5_VDDM_MCUF1CSErrDTC_raw32_Inproc S5_VDDM_MCUF1NoComDTC_raw32_Inproc S5_VDDM_MCUF1RCErrDTC_raw32_Inproc S5_VDDM_MCUR1CSErrDTC_raw32_Inproc S5_VDDM_MCUR1NoComDTC_raw32_Inproc S5_VDDM_MCUR1RCErrDTC_raw32_Inproc S5_VDDM_MSAMalfuncDetDTC_raw32_Inproc S5_VDDM_MidLvSaChkDTC_raw32_Inproc S5_VDDM_OBC4PreDTC_raw32_Inproc S5_VDDM_ONtoRdyDTC_raw32_Inproc S5_VDDM_RCLUSSDTC_raw32_Inproc S5_VDDM_RCRUSSDTC_raw32_Inproc S5_VDDM_RFBatwarnDTC_raw32_Inproc S5_VDDM_RFPressIndiDTC_raw32_Inproc S5_VDDM_RFSensorFailDTC_raw32_Inproc S5_VDDM_RFWheelTmpHighDTC_raw32_Inproc S5_VDDM_RLDoorSWDTC_raw32_Inproc S5_VDDM_RLLUSSDTC_raw32_Inproc S5_VDDM_RLRUSSDTC_raw32_Inproc S5_VDDM_RMLUSSDTC_raw32_Inproc S5_VDDM_RMRUSSDTC_raw32_Inproc S5_VDDM_RRBatwarnDTC_raw32_Inproc S5_VDDM_RRDoorSWDTC_raw32_Inproc S5_VDDM_RRPressIndiDTC_raw32_Inproc S5_VDDM_RRSensorFailDTC_raw32_Inproc S5_VDDM_RRWheelTmpHighDTC_raw32_Inproc S5_VDDM_RrMCUSigErrDetDTC_raw32_Inproc S5_VDDM_RrMCUTqErrDTC_raw32_Inproc S5_VDDM_Shifter1CSErrDTC_raw32_Inproc S5_VDDM_Shifter1NoComDTC_raw32_Inproc S5_VDDM_Shifter1RCErrDTC_raw32_Inproc S5_VDDM_SysAllowReadySta_flg_Inproc S5_VDDM_TailgaSWDTC_raw32_Inproc S5_VDDM_VCUBrkSWSta_enum_Inproc S5_VDDM_VCUFLDoorSta_flg_Inproc S5_VDDM_VCUFRDoorSta_flg_Inproc S5_VDDM_VCUHoodSWSta_flg_Inproc S5_VDDM_VCURAPSErrLv2_flg_Inproc S5_VDDM_VCURAPSErrLv3_flg_Inproc S5_VDDM_VCURLDoorSta_flg_Inproc S5_VDDM_VCURRDoorSta_flg_Inproc S5_VDDM_VCUTailgateSWSta_flg_Inproc S5_VDDM_VehMalfunLevel_enum_Inproc S5_VDDM_ZoneSCPNoComDTC_raw32_Inproc S5_VDHP_ActAPSPosn_pct_Inproc S5_VDHP_EAPS1MIN_pct_Inproc S5_VDHP_EAPS1NRM_pct_Inproc S5_VDHP_EAPS2MIN_pct_Inproc S5_VDHP_EAPS2NRM_pct_Inproc S5_VDHP_ResetPedalZeroPosStart_flg_Inproc S5_VDID_APPD_pct_Inproc S5_VDID_APPE_pct_Inproc S5_VDID_AVGBATTEMPL_C_Inproc S5_VDID_AVGBATTEMPL_sec_Inproc S5_VDID_AvgBattTempOFFL_C_Inproc S5_VDID_AvgBattTempOFFR_C_Inproc S5_VDID_AvgBattTempOVCL_C_Inproc S5_VDID_AvgBattTempOVCR_C_Inproc S5_VDID_AvgBattTempPSAL_C_Inproc S5_VDID_AvgBattTempPSAR_C_Inproc S5_VDID_BATSOC_pct_Inproc S5_VDID_BATSOH_pct_Inproc S5_VDID_BattTempPSAL_sec_Inproc S5_VDID_BattTempPSAR_sec_Inproc S5_VDID_CALID_cnt_Inproc S5_VDID_CDEODTL_km_Inproc S5_VDID_CDEODTR_km_Inproc S5_VDID_CLRDIST_km_Inproc S5_VDID_CLRTIME_min_Inproc S5_VDID_CPSAL_sec_Inproc S5_VDID_CPSAR_sec_Inproc S5_VDID_DIDModelVersionChksum_raw_Inproc S5_VDID_DIDModelVersion_raw_Inproc S5_VDID_ECUNAME_cnt_Inproc S5_VDID_ETMATOEL_kWh_Inproc S5_VDID_ETMATOER_kWh_Inproc S5_VDID_ETMBTOEL_kWh_Inproc S5_VDID_ETMBTOER_kWh_Inproc S5_VDID_GECHGOVCACL_kWh_Inproc S5_VDID_GECHGOVCACR_kWh_Inproc S5_VDID_GECHGOVCDCL_kWh_Inproc S5_VDID_GECHGOVCDCR_kWh_Inproc S5_VDID_HEVBATT_V_Inproc S5_VDID_HEVMODE_enum_Inproc S5_VDID_HVBATT_A_Inproc S5_VDID_HVBCellVoltMax_V_Inproc S5_VDID_HVBCellVoltMin_V_Inproc S5_VDID_HVBNAH_Ahr_Inproc S5_VDID_HVBNE_kWh_Inproc S5_VDID_HVBattCurr_Ahps_Inproc S5_VDID_HVESSCHARGEACT_kW_Inproc S5_VDID_HVESSCHARGELIM_kW_Inproc S5_VDID_HVESSENER_Whps_Inproc S5_VDID_IGNCNTR_cnt_Inproc S5_VDID_IPSAL_sec_Inproc S5_VDID_IPSAR_sec_Inproc S5_VDID_MAXBATTEMPL_C_Inproc S5_VDID_MILDIST_km_Inproc S5_VDID_MILTIME_min_Inproc S5_VDID_MINBATTEMPL_C_Inproc S5_VDID_NUMPSATRIPSFLTMEMCLR_cnt_Inproc S5_VDID_ODOMETER_km_Inproc S5_VDID_OFFL_sec_Inproc S5_VDID_OFFR_sec_Inproc S5_VDID_OVCL_sec_Inproc S5_VDID_OVCR_sec_Inproc S5_VDID_PKELNumerator_kphsqr_Inproc S5_VDID_PKEL_kphsqr_Inproc S5_VDID_PKERNumerator_kphsqr_Inproc S5_VDID_PKER_kphsqr_Inproc S5_VDID_PROTOCOLID_enum_Inproc S5_VDID_PSAL_sec_Inproc S5_VDID_PSAR_sec_Inproc S5_VDID_QTYPSATRIPSL_cnt_Inproc S5_VDID_QTYPSATRIPSR_cnt_Inproc S5_VDID_RESSCNTDODRNGL_cnt_Inproc S5_VDID_RESSCNTDODRNGR_cnt_Inproc S5_VDID_RESSCNTSDODRNGAXIS_enum_Inproc S5_VDID_RESSTIMESOCCHGRNGL_s_Inproc S5_VDID_RESSTIMESOCCHGRNGR_s_Inproc S5_VDID_RESSTIMESOCOFFRNGL_s_Inproc S5_VDID_RESSTIMESOCOFFRNGR_s_Inproc S5_VDID_RESSTIMESOCPSARNGL_s_Inproc S5_VDID_RESSTIMESOCPSARNGR_s_Inproc S5_VDID_RESSTIMESOCRNGAXIS_enum_Inproc S5_VDID_RESSTTEMPRNGAXIS_enum_Inproc S5_VDID_RESSV2XENNONPSAL_kWh_Inproc S5_VDID_RESSV2XENNONPSAR_kWh_Inproc S5_VDID_RUNTM_s_Inproc S5_VDID_ResetCDEODTR_km_Inproc S5_VDID_STASUP_enum_Inproc S5_VDID_TEBPSAL_kWh_Inproc S5_VDID_TEBPSAR_kWh_Inproc S5_VDID_TGEOVCL_kWh_Inproc S5_VDID_TGEOVCR_kWh_Inproc S5_VDID_TNBCPSAL_Ahr_Inproc S5_VDID_TNBCPSAR_Ahr_Inproc S5_VDID_TNECPSAL_kWh_Inproc S5_VDID_TNECPSAR_kWh_Inproc S5_VDID_VSS_kph_Inproc S5_VDID_VinCode_cnt_Inproc S5_VDID_WARMUPS_cnt_Inproc S5_VDKC_DKCAuthSta_enum_Inproc S5_VDKC_DKCTimeSN_cnt_Inproc S5_VDKC_DKeyWelcomeSta_enum_Inproc S5_VDKC_DkeyAreaRAPSSta_enum_Inproc S5_VDKC_DkeyShowIVISta_enum_Inproc S5_VDKC_FDCDKCAllowSleep_flg_Inproc S5_VDKC_JudgeKeepUnlockZone_flg_Inproc S5_VDKC_KeyAreaLockUnlock_enum_Inproc S5_VDKC_KeyAreaPS_enum_Inproc S5_VDKC_KeyAreaPTG_enum_Inproc S5_VDKC_KeyAreaSPTGSta_enum_Inproc S5_VDKC_KeyMissSta_flg_Inproc S5_VDKC_KeyModeSta_enum_Inproc S5_VDKC_KeyNumSta_enum_Inproc S5_VDKC_KeyTypeSta_enum_Inproc S5_VDKC_PCommandToBCM_enum_Inproc S5_VDKC_ParkingModeCmd_enum_Inproc S5_VDKC_TimeSNDKCFbk_cnt_Inproc S5_VDKC_UIDLowPowerSta_enum_Inproc S5_VDSC_DISCButtSta_flg_Inproc S5_VDSC_DISCSta_enum_Inproc S5_VDSC_DISCTargetSpd_kph_Inproc S5_VDSC_DISCTurn_flg_Inproc S5_VNMM_ActiveWU_flg_Inproc S5_VNMM_AllCANTxReq_flg_Inproc S5_VNMM_Awake_enum_Inproc S5_VNMM_CSB_flg_Inproc S5_VNMM_ErrorState_enum_Inproc S5_VNMM_NMmTxReq_flg_Inproc S5_VNMM_NetworkReq_flg_Inproc S5_VNMM_NodeID_enum_Inproc S5_VNMM_PNI_flg_Inproc S5_VNMM_RptMsgReq_flg_Inproc S5_VNMM_SysNMmSta_enum_Inproc S5_VNMM_WakeUp_enum_Inproc S5_VPMM_ACHVLoopDem_enum_Inproc S5_VPMM_ActiveDischargeReq_enum_Inproc S5_VPMM_BattHVDem_enum_Inproc S5_VPMM_CACRlyDem_enum_Inproc S5_VPMM_ChrgBCUHVFail_flg_Inproc S5_VPMM_ChrgFault_enum_Inproc S5_VPMM_ChrgPowerUpFail_flg_Inproc S5_VPMM_ChrgState_enum_Inproc S5_VPMM_DCCurr_A_Inproc S5_VPMM_DCDCRlyDem_enum_Inproc S5_VPMM_DCVol_V_Inproc S5_VPMM_DrivelineRelease_enum_Inproc S5_VPMM_EHPSRlyDem_enum_Inproc S5_VPMM_FogTMSRlyCMD_enum_Inproc S5_VPMM_HVFailureChkPass_flg_Inproc S5_VPMM_HVILDetectFail_flg_Inproc S5_VPMM_HVILFail_flg_Inproc S5_VPMM_HVSysReady_enum_Inproc S5_VPMM_IGNRlyClose_flg_Inproc S5_VPMM_IRCRlyClose_flg_Inproc S5_VPMM_LVBattLowInd_enum_Inproc S5_VPMM_LostHVComActivePwrDown_flg_Inproc S5_VPMM_MCUHVLoopDem_enum_Inproc S5_VPMM_PowerDownFault_enum_Inproc S5_VPMM_PowerDownState_enum_Inproc S5_VPMM_PowerUpFault_enum_Inproc S5_VPMM_PowerUpState_enum_Inproc S5_VPMM_SysPowerMode_enum_Inproc S5_VPMM_V2BACPosRlyFit_enum_Inproc S5_VPMM_V2BACPosRlySta_enum_Inproc S5_VPMM_V2BAirPosRlyFit_enum_Inproc S5_VPMM_V2BAirPosRlySta_enum_Inproc S5_VPMM_V2BAux1OnOff_enum_Inproc S5_VPMM_V2BAux1RlyFit_enum_Inproc S5_VPMM_V2BAux1RlySta_enum_Inproc S5_VPMM_V2BAux2OnOff_enum_Inproc S5_VPMM_V2BAux2RlyFit_enum_Inproc S5_VPMM_V2BAux2RlySta_enum_Inproc S5_VPMM_V2BAux3OnOff_enum_Inproc S5_VPMM_V2BAux3RlyFit_enum_Inproc S5_VPMM_V2BAux3RlySta_enum_Inproc S5_VPMM_V2BAux4RlyFit_enum_Inproc S5_VPMM_V2BAux4RlySta_enum_Inproc S5_VPMM_V2BDCDCPosRlyFit_enum_Inproc S5_VPMM_V2BDCDCPosRlySta_enum_Inproc S5_VPMM_V2BLifeSig_cnt_Inproc S5_VPMM_V2BMainPosRlyFit_enum_Inproc S5_VPMM_V2BMainPosRlySta_enum_Inproc S5_VPMM_V2BOilPosRlyFit_enum_Inproc S5_VPMM_V2BOilPosRlySta_enum_Inproc S5_VPMM_VCULife1_cnt_Inproc S5_VPMM_VCULife2_cnt_Inproc S5_VPMM_VCUMCUEn_flg_Inproc S5_VPMM_VCUMCUFailRst_flg_Inproc S5_VPMM_VSPFunc_enum_Inproc S5_VPMM_VSPIGNKeySta_enum_Inproc S5_VPMM_VSPReversed_flg_Inproc S5_VPMM_VSPTurnLeft_enum_Inproc S5_VPMM_VSPTurnRight_enum_Inproc S5_VPSA_EmergencyShutDown_flg_Inproc S5_VPSA_Keystatus_enum_Inproc S5_VSCP_CFGEM1BAMPGN_raw_Inproc S5_VSCP_CFGEM1BAMRsv_raw_Inproc S5_VSCP_CFGEM1BAMTNum_raw_Inproc S5_VSCP_CFGEM1BAMTSize_raw_Inproc S5_VSCP_CFGEM1Ctrl_raw_Inproc S5_VSCP_DTbyte0_raw_Inproc S5_VSCP_DTbyte1_raw_Inproc S5_VSCP_DTbyte2_raw_Inproc S5_VSCP_DTbyte3_raw_Inproc S5_VSCP_DTbyte4_raw_Inproc S5_VSCP_DTbyte5_raw_Inproc S5_VSCP_DTbyte6_raw_Inproc S5_VSCP_DTbyte7_raw_Inproc S5_VSCP_triggerBAM_flg_Inproc S5_VSCP_triggerDT_flg_Inproc S5_VSYS_AcoreRebootCmdACK_flg_Inproc S5_VSYS_CarModel1_cnt_Inproc S5_VSYS_CarModel2_cnt_Inproc S5_VSYS_CarModel3_cnt_Inproc S5_VSYS_Change1_cnt_Inproc S5_VSYS_Change2_cnt_Inproc S5_VSYS_Country1_cnt_Inproc S5_VSYS_Country2_cnt_Inproc S5_VSYS_CurrentNmState_enum_Inproc S5_VSYS_Dash1_cnt_Inproc S5_VSYS_Dash2_cnt_Inproc S5_VSYS_DrivingMode_cnt_Inproc S5_VSYS_ECU1_cnt_Inproc S5_VSYS_ECU2_cnt_Inproc S5_VSYS_ECUGen1_cnt_Inproc S5_VSYS_ECUGen2_cnt_Inproc S5_VSYS_FdcSlpReqRisingEdge_flg_Inproc S5_VSYS_FdcSlpTime_sec_Inproc S5_VSYS_HWVer1_cnt_Inproc S5_VSYS_HWVer2_cnt_Inproc S5_VSYS_HWVer3_cnt_Inproc S5_VSYS_Major1_cnt_Inproc S5_VSYS_Major2_cnt_Inproc S5_VSYS_Minor1_cnt_Inproc S5_VSYS_Minor2_cnt_Inproc S5_VSYS_ModelYear_cnt_Inproc S5_VSYS_NvWriteReqRisingEdge_flg_Inproc S5_VSYS_Patch1_cnt_Inproc S5_VSYS_Patch2_cnt_Inproc S5_VSYS_PmicBootPath_raw32_Inproc S5_VSYS_PmicBootReason_enum_Inproc S5_VSYS_SHA1_cnt_Inproc S5_VSYS_SHA2_cnt_Inproc S5_VSYS_SHA3_cnt_Inproc S5_VSYS_SHA4_cnt_Inproc S5_VSYS_SHA5_cnt_Inproc S5_VSYS_SHA6_cnt_Inproc S5_VSYS_SHA7_cnt_Inproc S5_VSYS_SHA8_cnt_Inproc S5_VSYS_Variation_cnt_Inproc S5_VSYS_WisrBootReason_raw32_Inproc S5_VTHC_AfterrunningMode_flg_Inproc S5_VTHC_CoolFanReq_pct_Inproc S5_VTHC_EWPPEReq_rpm_Inproc S5_VTPM_ALFin_flg_Inproc S5_VTPM_AutoLTips_enum_Inproc S5_VTPM_CWheelTips_enum_Inproc S5_VTPM_ChkStorge_flg_Inproc S5_VTPM_Chkfin_flg_Inproc S5_VTPM_FAT_flg_Inproc S5_VTPM_FlashIDvalid_enum_Inproc S5_VTPM_FlashS1ID_raw_Inproc S5_VTPM_FlashS2ID_raw_Inproc S5_VTPM_FlashS3ID_raw_Inproc S5_VTPM_FlashS4ID_raw_Inproc S5_VTPM_Flashchkdatavalid_enum_Inproc S5_VTPM_Flashdatavalid_enum_Inproc S5_VTPM_ID1messageALTU_raw8_Inproc S5_VTPM_ID2messageALTU_raw8_Inproc S5_VTPM_ID3messageALTU_raw8_Inproc S5_VTPM_ID4messageALTU_raw8_Inproc S5_VTPM_IDin_raw32_Inproc S5_VTPM_LFBatWarn_flg_Inproc S5_VTPM_LFP20_raw8_Inproc S5_VTPM_LFPindi_enum_Inproc S5_VTPM_LFPressIndi_enum_Inproc S5_VTPM_LFSensorFail_flg_Inproc S5_VTPM_LFSensorMode_flg_Inproc S5_VTPM_LFWheelDebug_flg_Inproc S5_VTPM_LFWheelPSW_raw8_Inproc S5_VTPM_LFWheelPress_raw8_Inproc S5_VTPM_LFWheelTemp_C_Inproc S5_VTPM_LFWheelTmpIndi_flg_Inproc S5_VTPM_LProgress_enum_Inproc S5_VTPM_LRBatWarn_flg_Inproc S5_VTPM_LRP20_raw8_Inproc S5_VTPM_LRPindi_enum_Inproc S5_VTPM_LRPressIndi_enum_Inproc S5_VTPM_LRSensorFail_flg_Inproc S5_VTPM_LRSensorMode_flg_Inproc S5_VTPM_LRWheelDebug_flg_Inproc S5_VTPM_LRWheelPSW_raw8_Inproc S5_VTPM_LRWheelPress_raw8_Inproc S5_VTPM_LRWheelTemp_C_Inproc S5_VTPM_LRWheelTmpIndi_flg_Inproc S5_VTPM_ModelVersionChksum_raw_Inproc S5_VTPM_ModelVersion_raw_Inproc S5_VTPM_Prepresstempvalid_enum_Inproc S5_VTPM_RFBatWarn_flg_Inproc S5_VTPM_RFP20_raw8_Inproc S5_VTPM_RFPind_enum_Inproc S5_VTPM_RFPressIndi_enum_Inproc S5_VTPM_RFSensorFail_flg_Inproc S5_VTPM_RFSensorMode_flg_Inproc S5_VTPM_RFWheelDebug_flg_Inproc S5_VTPM_RFWheelPSW_raw8_Inproc S5_VTPM_RFWheelPress_raw8_Inproc S5_VTPM_RFWheelTemp_C_Inproc S5_VTPM_RFWheelTmpIndi_flg_Inproc S5_VTPM_RRBatWarn_flg_Inproc S5_VTPM_RRP20_raw8_Inproc S5_VTPM_RRPindi_enum_Inproc S5_VTPM_RRPressIndi_enum_Inproc S5_VTPM_RRSensorFail_flg_Inproc S5_VTPM_RRSensorMode_flg_Inproc S5_VTPM_RRWheelDebug_flg_Inproc S5_VTPM_RRWheelPSW_raw8_Inproc S5_VTPM_RRWheelPress_raw8_Inproc S5_VTPM_RRWheelTemp_C_Inproc S5_VTPM_RRWheelTmpIndi_flg_Inproc S5_VTPM_S1ID_raw32_Inproc S5_VTPM_S1L_enum_Inproc S5_VTPM_S1WheelDebugALTU_pct_Inproc S5_VTPM_S2ID_raw32_Inproc S5_VTPM_S2L_enum_Inproc S5_VTPM_S2WheelDebugALTU_pct_Inproc S5_VTPM_S3ID_raw32_Inproc S5_VTPM_S3L_enum_Inproc S5_VTPM_S3WheelDebugALTU_pct_Inproc S5_VTPM_S4ID_raw32_Inproc S5_VTPM_S4L_enum_Inproc S5_VTPM_S4WheelDebugALTU_pct_Inproc S5_VTPM_SetIDLoc_flg_Inproc S5_VTPM_TPMSCaliButtAllow_flg_Inproc S5_VTPM_TPMSResButtAllow_flg_Inproc S5_VTPM_TPMSResButt_flg_Inproc S5_VTPM_TPMSSensorIDRegStart_flg_Inproc S5_VTPM_TPMSStorge_flg_Inproc S5_VTPM_TPMSTLCmd_flg_Inproc S5_VTPM_TPMSWarnIndi_enum_Inproc S5_VTPM_WriteChkLFID_raw_Inproc S5_VTPM_WriteChkLRID_raw_Inproc S5_VTPM_WriteChkRFID_raw_Inproc S5_VTPM_WriteChkRRID_raw_Inproc S5_VTPM_WriteChkfinLFID_raw_Inproc S5_VTPM_WriteChkfinLRID_raw_Inproc S5_VTPM_WriteChkfinRFID_raw_Inproc S5_VTPM_WriteChkfinRRID_raw_Inproc S5_VTPM_WritingCnt_enum_Inproc S5_VTPM_unlearnSfailvalid_enum_Inproc S5_VTPM_unlearnSfali_flg_Inproc S5_VTQD_ActDriveMode_enum_Inproc S5_VTQD_ActTUpAIND_enum_Inproc S5_VTQD_CreepIND_enum_Inproc S5_VTQD_CreepSpdReq_rpm_Inproc S5_VTQD_EC1EMDefTrqLmt_rpm_Inproc S5_VTQD_EC1EMExtRSCtrlUpLmt_rpm_Inproc S5_VTQD_EC1EMGainEndSpdGvn_gain_Inproc S5_VTQD_EC1EMMaxMEngOvrSP7_rpm_Inproc S5_VTQD_EC1EMMaxMOvrTmt_s_Inproc S5_VTQD_EC1EMMomOfInertia_kgpm2_Inproc S5_VTQD_EC1EMRefTorq_Nm_Inproc S5_VTQD_EC1EMReqSpdCtrlLoLmt_rpm_Inproc S5_VTQD_EC1EMReqSpdCtrlUpLmt_rpm_Inproc S5_VTQD_EC1EMReqTrqCtrlLoLmt_pct_Inproc S5_VTQD_EC1EMReqTrqCtrlUpLmt_pct_Inproc S5_VTQD_EC1EMSpdHdleP6_rpm_Inproc S5_VTQD_EC1EMSpdIdleP1_rpm_Inproc S5_VTQD_EC1EMSpdIdleP2_rpm_Inproc S5_VTQD_EC1EMSpdIdleP3_rpm_Inproc S5_VTQD_EC1EMSpdIdleP4_rpm_Inproc S5_VTQD_EC1EMSpdIdleP5_rpm_Inproc S5_VTQD_EC1EMSupTSC1CtrlPG1_cnt_Inproc S5_VTQD_EC1EMSupTSC1CtrlPG2_cnt_Inproc S5_VTQD_EC1EMSupTSC1CtrlPG3_cnt_Inproc S5_VTQD_EC1EMSupTSC1CtrlPG4_cnt_Inproc S5_VTQD_EC1EMSupVarRTSC1MSG_cnt_Inproc S5_VTQD_EC1PercTorqIdleP1_pct_Inproc S5_VTQD_EC1PercTorqIdleP2_pct_Inproc S5_VTQD_EC1PercTorqIdleP3_pct_Inproc S5_VTQD_EC1PercTorqIdleP4_pct_Inproc S5_VTQD_EC1PercTorqIdleP5_pct_Inproc S5_VTQD_EEC3EMPressLoss_pct_Inproc S5_VTQD_EEC3NFricPercTorq_pct_Inproc S5_VTQD_EMRC1ActEMOutSftSpd_rpm_Inproc S5_VTQD_EMRC1ActEMpTrqHrls_pct_Inproc S5_VTQD_EMRC1ActEMpTrq_pct_Inproc S5_VTQD_EMRC1ActMaxAvaEMRecpTrq_pct_Inproc S5_VTQD_EMRC1DrvDemEMRtapTrq_pct_Inproc S5_VTQD_EMRC1EMTquModeDrvBrk_enum_Inproc S5_VTQD_EMRC1RetSelNonEng_pct_Inproc S5_VTQD_EMRC1SACtrlDev_cnt_Inproc S5_VTQD_ETC1ShiftrPgs_enum_Inproc S5_VTQD_ETC2ActDriveDirect_enum_Inproc S5_VTQD_EVCU1ActDrvMode_enum_Inproc S5_VTQD_EVCU1EBrakeTorqLow_enum_Inproc S5_VTQD_EVCU1EMotorOvrerSpd_enum_Inproc S5_VTQD_EVCU1EMotorPerformance_pct_Inproc S5_VTQD_EVCU1EMotorSpd_rpm_Inproc S5_VTQD_EVCU1RecuperHighSta_enum_Inproc S5_VTQD_EVCU1WheelSlipdet_enum_Inproc S5_VTQD_EVCU2MaxTorqAvail_pct_Inproc S5_VTQD_EVCU2MinTorqAvail_pct_Inproc S5_VTQD_GearFlashIndDis_flg_Inproc S5_VTQD_GearFlashInd_flg_Inproc S5_VTQD_ParkingProtectWarning_flg_Inproc S5_VTQD_RC1MaxRetSpdP2_rpm_Inproc S5_VTQD_RC1MaxRetSpdP3_rpm_Inproc S5_VTQD_RC1PctTrqIdleP1_pct_Inproc S5_VTQD_RC1PctTrqP3_pct_Inproc S5_VTQD_RC1PctTrqP4_pct_Inproc S5_VTQD_RC1PctTrqPekTrqP5_pct_Inproc S5_VTQD_RC1RefRetTrq_Nm_Inproc S5_VTQD_RC1RetCtrlMth_enum_Inproc S5_VTQD_RC1RetLocat_enum_Inproc S5_VTQD_RC1RetSpdIdleP1_rpm_Inproc S5_VTQD_RC1RetSpdP2_pct_Inproc S5_VTQD_RC1RetSpdP4_rpm_Inproc S5_VTQD_RC1RetSpdPekTrqP5_Nm_Inproc S5_VTQD_RC1RetType_enum_Inproc S5_VTQD_SpdLimSta_flg_Inproc S5_VTQD_TMTqReq_Nm_Inproc S5_VTQD_TUpAIND_enum_Inproc S5_VTQD_VCU4PweLmtInd_flg_Inproc S5_VTQD_VCUBCMBuzzReq_flg_Inproc S5_VTQD_VCUEBSHBSw_enum_Inproc S5_VTQD_VCUEBSHHSw_enum_Inproc S5_VTQD_VCUEBSRd4BR_enum_Inproc S5_VTQD_VCUMCUCtrlMdTQD_enum_Inproc S5_VTQD_VCUMCUDemHiPosVal_rpm_Inproc S5_VTQD_VCUMCUDemLoNegVal_rpm_Inproc S5_VTQD_VCUMCUDemSpd_rpm_Inproc S5_VTQD_VCUMCUFootBrk_flg_Inproc S5_VTQD_VCUMCUGearSta_enum_Inproc S5_VTQD_VCUMCUHandBrk_flg_Inproc S5_VTQD_VCUTMVehSpd_kph_Inproc S5_VTQD_VehAcclLimitTG_mps2_Inproc S5_VTQD_VehSpdLimitTG_kph_Inproc S5_VTQR_FrTMTqReq_Nm_Inproc S5_VTQR_RrTMTqReq_Nm_Inproc S5_VV2L_HVPO120VGrpALDSt_enum_Inproc S5_VV2L_HVPO120VGrpBLDSt_enum_Inproc S5_VV2L_ReqOBCExtrV2LEna_enum_Inproc S5_VV2L_ReqOBCIntrV2LEna_enum_Inproc S5_VV2L_ReqOBCV2LEna_enum_Inproc S5_VV2L_ReqV2LIVIDisChrg_enum_Inproc S5_VV2L_ReqV2LIVIPopup_enum_Inproc S5_VVMC_ACCComfortBandLower_mps2_Inproc S5_VVMC_ACCComfortBandUpper_mps2_Inproc S5_VVMC_ACCCtrlAvail_flg_Inproc S5_VVMC_ACCJerkLowerLimit_mps3_Inproc S5_VVMC_ACCJerkUpperLimit_mps3_Inproc S5_VVMC_ACCObjDist_m_Inproc S5_VVMC_ACCObjDstLvl_enum_Inproc S5_VVMC_ACCObjRelSpd_mps_Inproc S5_VVMC_ACCPedalOvrd_flg_Inproc S5_VVMC_ACCRequiredAccel_mps2_Inproc S5_VVMC_ACCTakeoverReq_flg_Inproc S5_VVMC_ACCVehHoldReq_flg_Inproc S5_VVMC_ADASACCSta_enum_Inproc S5_VVMC_ADASAEBReq_enum_Inproc S5_VVMC_ADASAEBSta_enum_Inproc S5_VVMC_ADASCAMSpdLim_enum_Inproc S5_VVMC_ADASDBSReq_enum_Inproc S5_VVMC_ADASFCWMute_flg_Inproc S5_VVMC_ADASFCWSta_enum_Inproc S5_VVMC_ADASFaultSta_flg_Inproc S5_VVMC_ADASFltWrnReq_flg_Inproc S5_VVMC_ADASForceIdle_flg_Inproc S5_VVMC_ADASISASta_enum_Inproc S5_VVMC_ADASLDWMute_flg_Inproc S5_VVMC_ADASLDWSta_enum_Inproc S5_VVMC_ADASLFCHandsOffWarning_enum_Inproc S5_VVMC_ADASLFCSta_enum_Inproc S5_VVMC_ADASLFCWarnSound_enum_Inproc S5_VVMC_ADASLKASta_enum_Inproc S5_VVMC_ADASLaneModeL_enum_Inproc S5_VVMC_ADASLaneModeR_enum_Inproc S5_VVMC_ADASLanecurveL_raw32_Inproc S5_VVMC_ADASLanecurveR_raw32_Inproc S5_VVMC_ADASLanetypeL_enum_Inproc S5_VVMC_ADASLanetypeR_enum_Inproc S5_VVMC_ADASSLIFSpdLim_enum_Inproc S5_VVMC_ADASSLIFSta_enum_Inproc S5_VVMC_ADASShftPosnReqA_flg_Inproc S5_VVMC_ADASShftPosnReq_enum_Inproc S5_VVMC_ADASVehSpdLim_raw32_Inproc S5_VVMC_ADASWarningMsg_enum_Inproc S5_VVMC_AEBVehHoldReq_flg_Inproc S5_VVMC_APSActive_flg_Inproc S5_VVMC_APSCtrlAvail_flg_Inproc S5_VVMC_APSDecReqA_flg_Inproc S5_VVMC_APSDecReq_mps2_Inproc S5_VVMC_APSReq_enum_Inproc S5_VVMC_APSStaSys_enum_Inproc S5_VVMC_AccCalcuPID_mps2_Inproc S5_VVMC_ActACCRequiredAccel_mps2_Inproc S5_VVMC_CAASActive_flg_Inproc S5_VVMC_CAASCtrlAvail_flg_Inproc S5_VVMC_CCCtrlSta_enum_Inproc S5_VVMC_CCMSASpdWar_flg_Inproc S5_VVMC_CalibratedAccX_G_Inproc S5_VVMC_CalibratedAccY_G_Inproc S5_VVMC_CalibratedAccZ_G_Inproc S5_VVMC_CalibratedGyroX_Dps_Inproc S5_VVMC_CalibratedGyroY_Dps_Inproc S5_VVMC_CalibratedGyroZ_Dps_Inproc S5_VVMC_DISCReqAcc_mps2_Inproc S5_VVMC_ExtraMSACtrlSta_enum_Inproc S5_VVMC_FCMACCmode_enum_Inproc S5_VVMC_FCMLDWFault_flg_Inproc S5_VVMC_FCMLDWRequest_enum_Inproc S5_VVMC_FDCVMCAPSAngleTarget_deg_Inproc S5_VVMC_FDCVMCAPSRqEPSCtrl_flg_Inproc S5_VVMC_FDCVMCAPSVRqEPSCtrl_flg_Inproc S5_VVMC_FDCVMCAngCtrlTqWtGn_pct_Inproc S5_VVMC_FDCVMCDrInpTqBstAct_flg_Inproc S5_VVMC_FDCVMCDrInpTqBstGn_pct_Inproc S5_VVMC_FDCVMCMaxAngCtrlOutTqLim_Nm_Inproc S5_VVMC_FeatArbitrFinal_enum_Inproc S5_VVMC_FeatArbitrSta_enum_Inproc S5_VVMC_FeatReqSpd_kph_Inproc S5_VVMC_FeatSetSpdFinal_raw32_Inproc S5_VVMC_ForceLowBeam_enum_Inproc S5_VVMC_FrontRearSlipRatioCtrl_flg_Inproc S5_VVMC_HazardWarningReq_flg_Inproc S5_VVMC_IMUEnaCmd_flg_Inproc S5_VVMC_ISOAccLimit_mps2_Inproc S5_VVMC_ISODecLimit_mps2_Inproc S5_VVMC_ISOJerkLimit_mps3_Inproc S5_VVMC_JerkPCT_pct_Inproc S5_VVMC_LKAHODDisplayWarning_flg_Inproc S5_VVMC_LKAHODSoundWarning_flg_Inproc S5_VVMC_LKAStrToqReq_Nm_Inproc S5_VVMC_LKATOIAct_enum_Inproc S5_VVMC_LKATOIFault_flg_Inproc S5_VVMC_LVDAACCStatusInformation_flg_Inproc S5_VVMC_LVDADisabled_flg_Inproc S5_VVMC_LVDAFailinfo_flg_Inproc S5_VVMC_LVDAMuteSta_enum_Inproc S5_VVMC_LVDAWarning_flg_Inproc S5_VVMC_LatAccCtrl_flg_Inproc S5_VVMC_LateralCtrl_flg_Inproc S5_VVMC_LeftTurnLightReq_flg_Inproc S5_VVMC_LimitPCT_pct_Inproc S5_VVMC_LongAcc_Gps_Inproc S5_VVMC_MSACtrlSta_enum_Inproc S5_VVMC_MeterIndSpeed_raw32_Inproc S5_VVMC_RearWhlSlipRatioCtrl_flg_Inproc S5_VVMC_RightTurnLightReq_flg_Inproc S5_VVMC_SPD2ACCAct_flg_Inproc S5_VVMC_SafetyCtrl_flg_Inproc S5_VVMC_SingleWhlSlipRatioCtrl_flg_Inproc S5_VVMC_TargetType_enum_Inproc S5_VVMC_TimeGapCalcu_s_Inproc S5_VVMC_TimeGapLevel_enum_Inproc S5_VVMC_VMCACCCtrlAvail_flg_Inproc S5_VVMC_VMCAEBCtrlAvail_flg_Inproc S5_VVMC_VMCCCCtrlAvail_flg_Inproc S5_VVMC_VMCMSACtrlAvail_flg_Inproc S5_VVMC_VehicleSpeed_kph_Inproc S5_VVMC_VehicleSpeed_mph_Inproc /end SUB_GROUP
 /begin REF_MEASUREMENT VOUTP_5vAPS1PwrErrDTC_raw32 VOUTP_5vAPS2PwrErrDTC_raw32 VOUTP_ABSActiveTimeOut_flg VOUTP_ABSActive_flg VOUTP_ACCAccelCmdErrDetDTC_raw32 VOUTP_ACCComfortBandLower_mps2 VOUTP_ACCComfortBandUpper_mps2 VOUTP_ACCCtrlAvail_flg VOUTP_ACCJerkLowerLimit_mps3 VOUTP_ACCJerkUpperLimit_mps3 VOUTP_ACCMalfuncDetDTC_raw32 VOUTP_ACCObjDist_m VOUTP_ACCObjDstLvl_enum VOUTP_ACCObjRelSpd_mps VOUTP_ACCPedalOvrd_flg VOUTP_ACCRequiredAccel_mps2 VOUTP_ACCTakeoverReq_flg VOUTP_ACCVehHoldReq_flg VOUTP_ACHVLoopDem_enum VOUTP_ADASACCSta_enum VOUTP_ADASAEBReq_enum VOUTP_ADASAEBSta_enum VOUTP_ADASCAMSpdLim_enum VOUTP_ADASDBSReq_enum VOUTP_ADASFCWMute_flg VOUTP_ADASFCWSta_enum VOUTP_ADASFaultSta_flg VOUTP_ADASFltWrnReq_flg VOUTP_ADASForceIdle_flg VOUTP_ADASISASta_enum VOUTP_ADASLDWMute_flg VOUTP_ADASLDWSta_enum VOUTP_ADASLFCHandsOffWarning_enum VOUTP_ADASLFCSta_enum VOUTP_ADASLFCWarnSound_enum VOUTP_ADASLKASta_enum VOUTP_ADASLaneModeL_enum VOUTP_ADASLaneModeR_enum VOUTP_ADASLanecurveL_raw32 VOUTP_ADASLanecurveR_raw32 VOUTP_ADASLanetypeL_enum VOUTP_ADASLanetypeR_enum VOUTP_ADASSLIFSpdLim_enum VOUTP_ADASSLIFSta_enum VOUTP_ADASShftPosnReqA_flg VOUTP_ADASShftPosnReq_enum VOUTP_ADASVehSpdLim_raw32 VOUTP_ADASWarningMsg_enum VOUTP_AEBVehHoldReq_flg VOUTP_ALFin_flg VOUTP_APPD_pct VOUTP_APPE_pct VOUTP_APS1SigOoRDTC_raw32 VOUTP_APS2SigOoRDTC_raw32 VOUTP_APSActive_flg VOUTP_APSAngleTarget_Deg VOUTP_APSCorrErrDTC_raw32 VOUTP_APSCtrlAvail_flg VOUTP_APSDFLL_cm VOUTP_APSDFLR_cm VOUTP_APSDRLL_cm VOUTP_APSDRLR_cm VOUTP_APSDecReqA_flg VOUTP_APSDecReq_mps2 VOUTP_APSExitCondition_enum VOUTP_APSHWVer_enum VOUTP_APSProgressPCT_pct VOUTP_APSPwrReq_enum VOUTP_APSRQDisplay_enum VOUTP_APSReq_enum VOUTP_APSRqEPASCtrl_flg VOUTP_APSSWVer_enum VOUTP_APSShiftPosnReq_enum VOUTP_APSSpeedCMD_kph VOUTP_APSStaSys_enum VOUTP_APSVMCReqA_flg VOUTP_APSVRqEPASCtrl_flg VOUTP_AVGBATTEMPL_C VOUTP_AVGBATTEMPL_sec VOUTP_AVMErrSTATimeOut_flg VOUTP_AVMErrSTA_flg VOUTP_AVMParkingmodeTimeOut_flg VOUTP_AVMParkingmode_enum VOUTP_AVMparkingcancelTimeOut_flg VOUTP_AVMparkingcancel_enum VOUTP_AVMparkingexcuteTimeOut_flg VOUTP_AVMparkingexcute_enum VOUTP_AccCalcuPID_mps2 VOUTP_AcoreRebootCmdACK_flg VOUTP_ActACCRequiredAccel_mps2 VOUTP_ActAPSPosn_pct VOUTP_ActDriveMode_enum VOUTP_ActTUpAIND_enum VOUTP_ActiveDischargeReq_enum VOUTP_ActiveWU_flg VOUTP_AfterrunningMode_flg VOUTP_AllCANTxReq_flg VOUTP_AutoLTips_enum VOUTP_AvgBattTempOFFL_C VOUTP_AvgBattTempOFFR_C VOUTP_AvgBattTempOVCL_C VOUTP_AvgBattTempOVCR_C VOUTP_AvgBattTempPSAL_C VOUTP_AvgBattTempPSAR_C VOUTP_Awake_enum VOUTP_BATSOC_pct VOUTP_BATSOH_pct VOUTP_BMSRdyDTC_raw32 VOUTP_BMSSigErrDetDTC_raw32 VOUTP_BattHVDem_enum VOUTP_BattTempPSAL_sec VOUTP_BattTempPSAR_sec VOUTP_BrkPedalPosTimeOut_flg VOUTP_BrkPedalPos_pct VOUTP_BrkSWErrDTC_raw32 VOUTP_BrkSWNoBacDTC_raw32 VOUTP_BrkSwStaTimeOut_flg VOUTP_BrkSwSta_flg VOUTP_BrkSwVTimeOut_flg VOUTP_BrkSwV_flg VOUTP_C1ABM1CSDTC_raw32 VOUTP_C1ABM1LCDTC_raw32 VOUTP_C1ABM1RCDTC_raw32 VOUTP_C1EPAS2LCDTC_raw32 VOUTP_C3BMS1CSDTC_raw32 VOUTP_C3BMS1LCDTC_raw32 VOUTP_C3BMS1RCDTC_raw32 VOUTP_C3BMS6CSDTC_raw32 VOUTP_C3BMS6LCDTC_raw32 VOUTP_C3BMS6RCDTC_raw32 VOUTP_C3CCU1CSDTC_raw32 VOUTP_C3CCU1LCDTC_raw32 VOUTP_C3CCU1RCDTC_raw32 VOUTP_C3CCU2CSDTC_raw32 VOUTP_C3CCU2LCDTC_raw32 VOUTP_C3CCU2RCDTC_raw32 VOUTP_CAASActive_flg VOUTP_CAASCtrlAvail_flg VOUTP_CAASSta_enum VOUTP_CAASSwTimeOut_flg VOUTP_CAASSw_enum VOUTP_CAASVMCReqA_flg VOUTP_CACFanReq_flg VOUTP_CACOverrun_flg VOUTP_CACPresReady_flg VOUTP_CACPresWarn_flg VOUTP_CACRlyDem_enum VOUTP_CACRunFail_flg VOUTP_CACTempOverHigh_flg VOUTP_CALID_cnt VOUTP_CCCtrlSta_enum VOUTP_CCMSASpdWar_flg VOUTP_CCMalfuncDetDTC_raw32 VOUTP_CCUSigErrDetDTC_raw32 VOUTP_CDEODTL_km VOUTP_CDEODTR_km VOUTP_CFGEM1BAMPGN_raw VOUTP_CFGEM1BAMRsv_raw VOUTP_CFGEM1BAMTNum_raw VOUTP_CFGEM1BAMTSize_raw VOUTP_CFGEM1Ctrl_raw VOUTP_CLRDIST_km VOUTP_CLRTIME_min VOUTP_CPSAL_sec VOUTP_CPSAR_sec VOUTP_CSB_flg VOUTP_CWheelTips_enum VOUTP_CalibratedAccX_G VOUTP_CalibratedAccY_G VOUTP_CalibratedAccZ_G VOUTP_CalibratedGyroX_Dps VOUTP_CalibratedGyroY_Dps VOUTP_CalibratedGyroZ_Dps VOUTP_CarModel1_cnt VOUTP_CarModel2_cnt VOUTP_CarModel3_cnt VOUTP_Change1_cnt VOUTP_Change2_cnt VOUTP_Chime_enum VOUTP_ChkStorge_flg VOUTP_Chkfin_flg VOUTP_ChrgBCUHVFail_flg VOUTP_ChrgFault_enum VOUTP_ChrgPlugSta_enum VOUTP_ChrgPowerUpFail_flg VOUTP_ChrgState_enum VOUTP_CoolFanReq_pct VOUTP_Country1_cnt VOUTP_Country2_cnt VOUTP_CreepIND_enum VOUTP_CreepSpdReq_rpm VOUTP_CurrentNmState_enum VOUTP_DCCurr_A VOUTP_DCDC4PreDTC_raw32 VOUTP_DCDCDisDTC_raw32 VOUTP_DCDCEnDemamd_enum VOUTP_DCDCEnaDTC_raw32 VOUTP_DCDCRlyDem_enum VOUTP_DCVol_V VOUTP_DIDModelVersionChksum_raw VOUTP_DIDModelVersion_raw VOUTP_DISCButtSta_flg VOUTP_DISCReqAcc_mps2 VOUTP_DISCSta_enum VOUTP_DISCTargetSpd_kph VOUTP_DISCTurn_flg VOUTP_DKCAuthSta_enum VOUTP_DKCPDkeyAreaRAPSSta_enum VOUTP_DKCParkingModeCmd_enum VOUTP_DKCTimeSN_cnt VOUTP_DKeyWelcomeSta_enum VOUTP_DTCDetect_enum VOUTP_DTbyte0_raw VOUTP_DTbyte1_raw VOUTP_DTbyte2_raw VOUTP_DTbyte3_raw VOUTP_DTbyte4_raw VOUTP_DTbyte5_raw VOUTP_DTbyte6_raw VOUTP_DTbyte7_raw VOUTP_Dash1_cnt VOUTP_Dash2_cnt VOUTP_DiagFLTSDTC_raw32 VOUTP_DiagFRTSDTC_raw32 VOUTP_DiagHCrashDTC_raw32 VOUTP_DiagRLTSDTC_raw32 VOUTP_DiagRRTSDTC_raw32 VOUTP_DisengagePFail_flg VOUTP_DkeyAreaRAPSSta_enum VOUTP_DkeyShowIVISta_enum VOUTP_DrStSWDTC_raw32 VOUTP_DriIntendTimeOut_flg VOUTP_DriIntend_enum VOUTP_DrivelineRelease_enum VOUTP_DriverSeatBeltCmdTimeOut_flg VOUTP_DriverSeatBeltCmd_flg VOUTP_DrivingMode_cnt VOUTP_EACEnDemand_enum VOUTP_EACSpdDemand_rpm VOUTP_EAPS1MIN_pct VOUTP_EAPS1NRM_pct VOUTP_EAPS2MIN_pct VOUTP_EAPS2NRM_pct VOUTP_EC1EMDefTrqLmt_rpm VOUTP_EC1EMExtRSCtrlUpLmt_rpm VOUTP_EC1EMGainEndSpdGvn_gain VOUTP_EC1EMMaxMEngOvrSP7_rpm VOUTP_EC1EMMaxMOvrTmt_s VOUTP_EC1EMMomOfInertia_kgpm2 VOUTP_EC1EMRefTorq_Nm VOUTP_EC1EMReqSpdCtrlLoLmt_rpm VOUTP_EC1EMReqSpdCtrlUpLmt_rpm VOUTP_EC1EMReqTrqCtrlLoLmt_pct VOUTP_EC1EMReqTrqCtrlUpLmt_pct VOUTP_EC1EMSpdHdleP6_rpm VOUTP_EC1EMSpdIdleP1_rpm VOUTP_EC1EMSpdIdleP2_rpm VOUTP_EC1EMSpdIdleP3_rpm VOUTP_EC1EMSpdIdleP4_rpm VOUTP_EC1EMSpdIdleP5_rpm VOUTP_EC1EMSupTSC1CtrlPG1_cnt VOUTP_EC1EMSupTSC1CtrlPG2_cnt VOUTP_EC1EMSupTSC1CtrlPG3_cnt VOUTP_EC1EMSupTSC1CtrlPG4_cnt VOUTP_EC1EMSupVarRTSC1MSG_cnt VOUTP_EC1PercTorqIdleP1_pct VOUTP_EC1PercTorqIdleP2_pct VOUTP_EC1PercTorqIdleP3_pct VOUTP_EC1PercTorqIdleP4_pct VOUTP_EC1PercTorqIdleP5_pct VOUTP_ECU1_cnt VOUTP_ECU2_cnt VOUTP_ECUGen1_cnt VOUTP_ECUGen2_cnt VOUTP_ECUNAME_cnt VOUTP_EDriveSysErrShifterErr_flg VOUTP_EDriveSysErrVCUErr_flg VOUTP_EEC3EMPressLoss_pct VOUTP_EEC3NFricPercTorq_pct VOUTP_EHPSDisEnTimeout_flg VOUTP_EHPSEnDemand_enum VOUTP_EHPSEnTimeout_flg VOUTP_EHPSMotorDemSpd_rpm VOUTP_EHPSRlyDem_enum VOUTP_EHPSSpdCtrlMode_enum VOUTP_EHPSSpdDemTimeout_flg VOUTP_EMRC1ActEMOutSftSpd_rpm VOUTP_EMRC1ActEMpTrqHrls_pct VOUTP_EMRC1ActEMpTrq_pct VOUTP_EMRC1ActMaxAvaEMRecpTrq_pct VOUTP_EMRC1DrvDemEMRtapTrq_pct VOUTP_EMRC1EMTquModeDrvBrk_enum VOUTP_EMRC1RetSelNonEng_pct VOUTP_EMRC1SACtrlDev_cnt VOUTP_EPBErrStaTimeOut_flg VOUTP_EPBErrSta_enum VOUTP_EPBExtApplyAvailTimeOut_flg VOUTP_EPBExtApplyAvail_flg VOUTP_EPBExtReleaseAvailTimeOut_flg VOUTP_EPBExtReleaseAvail_flg VOUTP_EPBLockTODTC_raw32 VOUTP_EPBStaTimeOut_flg VOUTP_EPBSta_enum VOUTP_EPBUnlockTODTC_raw32 VOUTP_EPSAOIControlTimeOut_flg VOUTP_EPSAOIControl_enum VOUTP_ESC1CSErrDTC_raw32 VOUTP_ESC1NoComDTC_raw32 VOUTP_ESC1RCErrDTC_raw32 VOUTP_ESC5CSErrDTC_raw32 VOUTP_ESC5NoComDTC_raw32 VOUTP_ESC5RCErrDTC_raw32 VOUTP_ESC7CSErrDTC_raw32 VOUTP_ESC7NoComDTC_raw32 VOUTP_ESC7RCErrDTC_raw32 VOUTP_ESCAPSStaTimeOut_flg VOUTP_ESCAPSSta_enum VOUTP_ESCStandstillTimeOut_flg VOUTP_ESCStandstill_flg VOUTP_ETC1ShiftrPgs_enum VOUTP_ETC2ActDriveDirect_enum VOUTP_ETMATOEL_kWh VOUTP_ETMATOER_kWh VOUTP_ETMBTOEL_kWh VOUTP_ETMBTOER_kWh VOUTP_EVCU1ActDrvMode_enum VOUTP_EVCU1EBrakeTorqLow_enum VOUTP_EVCU1EMotorOvrerSpd_enum VOUTP_EVCU1EMotorPerformance_pct VOUTP_EVCU1EMotorSpd_rpm VOUTP_EVCU1RecuperHighSta_enum VOUTP_EVCU1WheelSlipdet_enum VOUTP_EVCU2MaxTorqAvail_pct VOUTP_EVCU2MinTorqAvail_pct VOUTP_EWPPEReq_rpm VOUTP_EmergencyShutDown_flg VOUTP_EngagePFail_flg VOUTP_EnterNewOperCyc_flg VOUTP_ErrorState_enum VOUTP_ExtraMSACtrlSta_enum VOUTP_FAT_flg VOUTP_FCLUSSDTC_raw32 VOUTP_FCM2CSErrDTC_raw32 VOUTP_FCM2NoComDTC_raw32 VOUTP_FCM2RCErrDTC_raw32 VOUTP_FCM3CSErrDTC_raw32 VOUTP_FCM3NoComDTC_raw32 VOUTP_FCM3RCErrDTC_raw32 VOUTP_FCM4CSErrDTC_raw32 VOUTP_FCM4NoComDTC_raw32 VOUTP_FCM5CSErrDTC_raw32 VOUTP_FCM5NoComDTC_raw32 VOUTP_FCMACCSigErrDetDTC_raw32 VOUTP_FCMACCmode_enum VOUTP_FCMLDWFault_flg VOUTP_FCMLDWRequest_enum VOUTP_FCRUSSDTC_raw32 VOUTP_FDCBCMBSDBuzzerCmd_flg VOUTP_FDCBCMBrakeCmd_flg VOUTP_FDCBCMCallBellCmd_flg VOUTP_FDCBCMDVRSignalLCmd_flg VOUTP_FDCBCMDVRSignalRCmd_flg VOUTP_FDCBCMEmExitSWSta_flg VOUTP_FDCBCMEmSVCmd_flg VOUTP_FDCBCMFDCloseSVCmd_flg VOUTP_FDCBCMFDOpenSVCmd_flg VOUTP_FDCBCMFDoorSta_flg VOUTP_FDCBCMFRoomLpCmd_pct VOUTP_FDCBCMFRoomLpSetSta_pct VOUTP_FDCBCMHBeamCmd_flg VOUTP_FDCBCMHelpINDCmd_flg VOUTP_FDCBCMInnerBuzzerCmd_flg VOUTP_FDCBCMInnerCallBellCmd_flg VOUTP_FDCBCMLBSDRCmd_flg VOUTP_FDCBCMLBSDYCmd_flg VOUTP_FDCBCMLBeamCmd_flg VOUTP_FDCBCMLDRLCmd_flg VOUTP_FDCBCMLTurnLpCmd_flg VOUTP_FDCBCMLTurnSWSta_flg VOUTP_FDCBCMMDCloseSVCmd_flg VOUTP_FDCBCMMDOpenSVCmd_flg VOUTP_FDCBCMMDoorSta_flg VOUTP_FDCBCMMRoomLpCmd_pct VOUTP_FDCBCMMRoomLpSetSta_pct VOUTP_FDCBCMOSDrOpenSWSta_enum VOUTP_FDCBCMPLampCmd_flg VOUTP_FDCBCMRBSDRCmd_flg VOUTP_FDCBCMRBSDYCmd_flg VOUTP_FDCBCMRDRLCmd_flg VOUTP_FDCBCMRDoorSta_flg VOUTP_FDCBCMRFLampCmd_flg VOUTP_FDCBCMRGearSta_flg VOUTP_FDCBCMRRoomLpCmd_pct VOUTP_FDCBCMRRoomLpSetSta_pct VOUTP_FDCBCMRTurnLpCmd_flg VOUTP_FDCBCMRTurnSWSta_flg VOUTP_FDCBCMRoomLpAmbCmd_flg VOUTP_FDCBCMRoomLpAmbSetSta_flg VOUTP_FDCBCMRoomLpSetSta_flg VOUTP_FDCBCMSLTLpCmd_flg VOUTP_FDCBCMSMKLCmd_flg VOUTP_FDCBCMSMKRCmd_flg VOUTP_FDCBCMSRTLpCmd_flg VOUTP_FDCBCMSTOPBALLCmd_flg VOUTP_FDCBCMStopINDCmd_flg VOUTP_FDCBCMTurnBuzzerENSta_flg VOUTP_FDCBCMWasherCmd_flg VOUTP_FDCBCMWiperHCmd_flg VOUTP_FDCBCMWiperLCmd_flg VOUTP_FDCDKCAllowSleep_flg VOUTP_FDCVMCAPSAngleTarget_deg VOUTP_FDCVMCAPSRqEPSCtrl_flg VOUTP_FDCVMCAPSVRqEPSCtrl_flg VOUTP_FDCVMCAngCtrlTqWtGn_pct VOUTP_FDCVMCDrInpTqBstAct_flg VOUTP_FDCVMCDrInpTqBstGn_pct VOUTP_FDCVMCMaxAngCtrlOutTqLim_Nm VOUTP_FLDoorSWDTC_raw32 VOUTP_FLLUSSDTC_raw32 VOUTP_FLRUSSDTC_raw32 VOUTP_FMLUSSDTC_raw32 VOUTP_FMRUSSDTC_raw32 VOUTP_FRDoorSWDTC_raw32 VOUTP_FSOffSwTimeOut_flg VOUTP_FSOffSw_enum VOUTP_FdcSlpReqRisingEdge_flg VOUTP_FdcSlpTime_sec VOUTP_FeatArbitrFinal_enum VOUTP_FeatArbitrSta_enum VOUTP_FeatReqSpd_kph VOUTP_FeatSetSpdFinal_raw32 VOUTP_FlashIDvalid_enum VOUTP_FlashS1ID_raw VOUTP_FlashS2ID_raw VOUTP_FlashS3ID_raw VOUTP_FlashS4ID_raw VOUTP_Flashchkdatavalid_enum VOUTP_Flashdatavalid_enum VOUTP_FogTMSRlyCMD_enum VOUTP_ForceLowBeam_enum VOUTP_FrMCUSigErrDetDTC_raw32 VOUTP_FrMCUTqErrDTC_raw32 VOUTP_FrTMTqReq_Nm VOUTP_FrontRearSlipRatioCtrl_flg VOUTP_GECHGOVCACL_kWh VOUTP_GECHGOVCACR_kWh VOUTP_GECHGOVCDCL_kWh VOUTP_GECHGOVCDCR_kWh VOUTP_GRADETimeOut_flg VOUTP_GRADE_Deg VOUTP_GearFlashIndDis_flg VOUTP_GearFlashInd_flg VOUTP_HEVBATT_V VOUTP_HEVMODE_enum VOUTP_HVB4PreDTC_raw32 VOUTP_HVBATT_A VOUTP_HVBCellVoltMax_V VOUTP_HVBCellVoltMin_V VOUTP_HVBNAH_Ahr VOUTP_HVBNE_kWh VOUTP_HVBattCurr_Ahps VOUTP_HVESSCHARGEACT_kW VOUTP_HVESSCHARGELIM_kW VOUTP_HVESSENER_Whps VOUTP_HVFailureChkPass_flg VOUTP_HVILDetectFail_flg VOUTP_HVILFail_flg VOUTP_HVPO120VGrpALDSt_enum VOUTP_HVPO120VGrpBLDSt_enum VOUTP_HVRlyCloDTC_raw32 VOUTP_HVRlyOpDTC_raw32 VOUTP_HVRlyOpFail_flg VOUTP_HVSysReady_enum VOUTP_HWVer1_cnt VOUTP_HWVer2_cnt VOUTP_HWVer3_cnt VOUTP_HazardWarningReq_flg VOUTP_HiLvSaChkDTC_raw32 VOUTP_HoodSWDTC_raw32 VOUTP_ID1messageALTU_raw8 VOUTP_ID2messageALTU_raw8 VOUTP_ID3messageALTU_raw8 VOUTP_ID4messageALTU_raw8 VOUTP_IDin_raw32 VOUTP_IGNCNTR_cnt VOUTP_IGNRlyClose_flg VOUTP_IMUEnaCmd_flg VOUTP_IPSAL_sec VOUTP_IPSAR_sec VOUTP_IRCRlyClose_flg VOUTP_ISAMalfuncDetDTC_raw32 VOUTP_ISOAccLimit_mps2 VOUTP_ISODecLimit_mps2 VOUTP_ISOJerkLimit_mps3 VOUTP_IVIScreenTimeOut_flg VOUTP_IVIScreen_enum VOUTP_IVIStatusTimeOut_flg VOUTP_IVIStatus_flg VOUTP_IVIUserTakeOverAPSSta_flg VOUTP_IniLVLoDTC_raw32 VOUTP_InnerBuzzerModeSta_enum VOUTP_JerkPCT_pct VOUTP_JudgeKeepUnlockZone_flg VOUTP_KeepWakeUp_flg VOUTP_KeyAreaLockUnlock_enum VOUTP_KeyAreaPS_enum VOUTP_KeyAreaPTG_enum VOUTP_KeyAreaSPTGSta_enum VOUTP_KeyAuthDTC_raw32 VOUTP_KeyMissSta_flg VOUTP_KeyModeSta_enum VOUTP_KeyNumSta_enum VOUTP_KeyTypeSta_enum VOUTP_Keystatus_enum VOUTP_LFBatWarn_flg VOUTP_LFBatwarnDTC_raw32 VOUTP_LFP20_raw8 VOUTP_LFPindi_enum VOUTP_LFPressIndiDTC_raw32 VOUTP_LFPressIndi_enum VOUTP_LFPulseCountTimeOut_flg VOUTP_LFPulseCountVTimeOut_flg VOUTP_LFPulseCountV_flg VOUTP_LFPulseCount_enum VOUTP_LFRawWhlSpeedTimeOut_flg VOUTP_LFRawWhlSpeedVTimeOut_flg VOUTP_LFRawWhlSpeedV_flg VOUTP_LFRawWhlSpeed_kph VOUTP_LFSensorFailDTC_raw32 VOUTP_LFSensorFail_flg VOUTP_LFSensorMode_flg VOUTP_LFWheelDebug_flg VOUTP_LFWheelPSW_raw8 VOUTP_LFWheelPress_raw8 VOUTP_LFWheelTemp_C VOUTP_LFWheelTmpHighDTC_raw32 VOUTP_LFWheelTmpIndi_flg VOUTP_LFWhlRotDirTimeOut_flg VOUTP_LFWhlRotDir_enum VOUTP_LKAHODDisplayWarning_flg VOUTP_LKAHODSoundWarning_flg VOUTP_LKAStrToqReq_Nm VOUTP_LKATOIAct_enum VOUTP_LKATOIFault_flg VOUTP_LProgress_enum VOUTP_LRBatWarn_flg VOUTP_LRBatwarnDTC_raw32 VOUTP_LRP20_raw8 VOUTP_LRPindi_enum VOUTP_LRPressIndiDTC_raw32 VOUTP_LRPressIndi_enum VOUTP_LRPulseCountTimeOut_flg VOUTP_LRPulseCountVTimeOut_flg VOUTP_LRPulseCountV_flg VOUTP_LRPulseCount_enum VOUTP_LRRawWhlSpeedTimeOut_flg VOUTP_LRRawWhlSpeedVTimeOut_flg VOUTP_LRRawWhlSpeedV_flg VOUTP_LRRawWhlSpeed_kph VOUTP_LRSensorFailDTC_raw32 VOUTP_LRSensorFail_flg VOUTP_LRSensorMode_flg VOUTP_LRWheelDebug_flg VOUTP_LRWheelPSW_raw8 VOUTP_LRWheelPress_raw8 VOUTP_LRWheelTemp_C VOUTP_LRWheelTmpHighDTC_raw32 VOUTP_LRWheelTmpIndi_flg VOUTP_LRWhlRotDirTimeOut_flg VOUTP_LRWhlRotDir_enum VOUTP_LVBattLowInd_enum VOUTP_LVDAACCStatusInformation_flg VOUTP_LVDADisabled_flg VOUTP_LVDAFailinfo_flg VOUTP_LVDAMuteSta_enum VOUTP_LVDAWarning_flg VOUTP_LVSupHiDTC_raw32 VOUTP_LVSupLoDTC_raw32 VOUTP_LVSysErrPwrOutErr_flg VOUTP_LatAccCtrl_flg VOUTP_LatAccelTimeOut_flg VOUTP_LatAccelVTimeOut_flg VOUTP_LatAccelV_flg VOUTP_LatAccel_Gps VOUTP_LateralCtrl_flg VOUTP_LeftTurnLightReq_flg VOUTP_LimitPCT_pct VOUTP_LimpHomeActTmp_flg VOUTP_LongAcc_Gps VOUTP_LongAccelTimeOut_flg VOUTP_LongAccelVTimeOut_flg VOUTP_LongAccelV_flg VOUTP_LongAccel_Gps VOUTP_LostHVComActivePwrDown_flg VOUTP_Lv1ErrDTC_raw32 VOUTP_Lv2ErrDTC_raw32 VOUTP_Lv3ErrDTC_raw32 VOUTP_Lv4ErrDTC_raw32 VOUTP_MAXBATTEMPL_C VOUTP_MCPressureTimeOut_flg VOUTP_MCPressureVTimeOut_flg VOUTP_MCPressureV_bar VOUTP_MCPressure_bar VOUTP_MCU4PreDTC_raw32 VOUTP_MCUActDTC_raw32 VOUTP_MCUActDisFail_flg VOUTP_MCUDisDTC_raw32 VOUTP_MCUF1CSErrDTC_raw32 VOUTP_MCUF1NoComDTC_raw32 VOUTP_MCUF1RCErrDTC_raw32 VOUTP_MCUHVLoopDem_enum VOUTP_MCUR1CSErrDTC_raw32 VOUTP_MCUR1NoComDTC_raw32 VOUTP_MCUR1RCErrDTC_raw32 VOUTP_MILDIST_km VOUTP_MILTIME_min VOUTP_MINBATTEMPL_C VOUTP_MSACtrlSta_enum VOUTP_MSAMalfuncDetDTC_raw32 VOUTP_Major1_cnt VOUTP_Major2_cnt VOUTP_MeterIndSpeed_raw32 VOUTP_MidLvSaChkDTC_raw32 VOUTP_Minor1_cnt VOUTP_Minor2_cnt VOUTP_ModOperation_enum VOUTP_ModelVersionChksum_raw VOUTP_ModelVersion_raw VOUTP_ModelYear_cnt VOUTP_NMmTxReq_flg VOUTP_NUMPSATRIPSFLTMEMCLR_cnt VOUTP_NetworkReq_flg VOUTP_NodeID_enum VOUTP_NvWriteReqRisingEdge_flg VOUTP_OBC4PreDTC_raw32 VOUTP_ODOMETER_km VOUTP_OFFL_sec VOUTP_OFFR_sec VOUTP_ONtoRdyDTC_raw32 VOUTP_OVCL_sec VOUTP_OVCR_sec VOUTP_PASAFCL_enum VOUTP_PASAFCR_enum VOUTP_PASAFML_enum VOUTP_PASAFMR_enum VOUTP_PASARCL_enum VOUTP_PASARCR_enum VOUTP_PASARML_enum VOUTP_PASARMR_enum VOUTP_PASDFCL_cm VOUTP_PASDFCR_cm VOUTP_PASDFML_cm VOUTP_PASDFMR_cm VOUTP_PASDRCL_cm VOUTP_PASDRCR_cm VOUTP_PASDRML_cm VOUTP_PASDRMR_cm VOUTP_PCommandToBCM_enum VOUTP_PKELNumerator_kphsqr VOUTP_PKEL_kphsqr VOUTP_PKERNumerator_kphsqr VOUTP_PKER_kphsqr VOUTP_PNI_flg VOUTP_PROTOCOLID_enum VOUTP_PSAL_sec VOUTP_PSAR_sec VOUTP_PUIDLowPower_flg VOUTP_ParkingModeCmd_enum VOUTP_ParkingProtectWarning_flg VOUTP_Patch1_cnt VOUTP_Patch2_cnt VOUTP_PmicBootPath_raw32 VOUTP_PmicBootReason_enum VOUTP_PowerDownFault_enum VOUTP_PowerDownState_enum VOUTP_PowerUpFault_enum VOUTP_PowerUpState_enum VOUTP_Prepresstempvalid_enum VOUTP_QTYPSATRIPSL_cnt VOUTP_QTYPSATRIPSR_cnt VOUTP_RAPSBCMLamp_enum VOUTP_RAPSBCMLockReq_flg VOUTP_RAPSErrLv1_flg VOUTP_RAPSErrWarnSta_enum VOUTP_RC1MaxRetSpdP2_rpm VOUTP_RC1MaxRetSpdP3_rpm VOUTP_RC1PctTrqIdleP1_pct VOUTP_RC1PctTrqP3_pct VOUTP_RC1PctTrqP4_pct VOUTP_RC1PctTrqPekTrqP5_pct VOUTP_RC1RefRetTrq_Nm VOUTP_RC1RetCtrlMth_enum VOUTP_RC1RetLocat_enum VOUTP_RC1RetSpdIdleP1_rpm VOUTP_RC1RetSpdP2_pct VOUTP_RC1RetSpdP4_rpm VOUTP_RC1RetSpdPekTrqP5_Nm VOUTP_RC1RetType_enum VOUTP_RCLUSSDTC_raw32 VOUTP_RCRUSSDTC_raw32 VOUTP_RESSCNTDODRNGL_cnt VOUTP_RESSCNTDODRNGR_cnt VOUTP_RESSCNTSDODRNGAXIS_enum VOUTP_RESSTIMESOCCHGRNGL_s VOUTP_RESSTIMESOCCHGRNGR_s VOUTP_RESSTIMESOCOFFRNGL_s VOUTP_RESSTIMESOCOFFRNGR_s VOUTP_RESSTIMESOCPSARNGL_s VOUTP_RESSTIMESOCPSARNGR_s VOUTP_RESSTIMESOCRNGAXIS_enum VOUTP_RESSTTEMPRNGAXIS_enum VOUTP_RESSV2XENNONPSAL_kWh VOUTP_RESSV2XENNONPSAR_kWh VOUTP_RFBatWarn_flg /end REF_MEASUREMENT
/end GROUP
/end MODULE
/end PROJECT
/* (add any file trailer comments here) */ /* EOF SWC_OUTP_type.a2l */
