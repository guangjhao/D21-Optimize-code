AUTOSAR XML (schema 4-3-0)
package /PduGroups
  12 x i signal i pdu group:
    FUSION_CAN1_Tx: communication-direction=OUT, communication-mode=CAN_Transmit_All
      i-signal-i-pdus:
        CAN1_ASC2_A
        CAN1_CCVS
        CAN1_CFGEM1_BAM
        CAN1_CFGEM1_DT
        CAN1_EEC2
        CAN1_EEC3
        CAN1_EMRC1
        CAN1_ETC1
        CAN1_ETC2
        CAN1_FD1_C100_{1..3}
        CAN1_FD1_CE100_1
        CAN1_GW1_C1000_1
        CAN1_GW1_C100_4
        CAN1_VCU_PDU_Demand_1
    FUSION_CAN1_Rx: communication-direction=IN, communication-mode=CAN_Receive_All
      i-signal-i-pdus:
        CAN1_DCDC_Status_1
        CAN1_DCDC_Status_2
        CAN1_EAC_Status_1
        CAN1_EBC1
        CAN1_EBC2
        CAN1_EBC5
        CAN1_EHPS_Status_1
        CAN1_EMC1_EM1
        CAN1_EPB1
        CAN1_PDU_Status_1
    FUSION_CAN2_Tx: communication-direction=OUT, communication-mode=CAN_Transmit_All
      i-signal-i-pdus:
        CAN2_FD2_C200_1
        CAN2_FD2_C20_0
        CAN2_FD2_CE100_0
        CAN2_FD2_CE100_1
        CAN2_FD2_CE200_1
        CAN2_FD2_OTA1
        CAN2_FD2_Version
        CAN2_GW2_C10_0
        CAN2_GW2_CE1000_0
        CAN2_GW2_CE100_{0..2}
    FUSION_CAN2_Rx: communication-direction=IN, communication-mode=CAN_Receive_All, i-signal-i-pdus=[CAN2_IVI1, CAN2_IVI2, CAN2_IVI3, CAN2_IVI_P20_0, CAN2_METER1]
    FUSION_CAN3_Tx: communication-direction=OUT, communication-mode=CAN_Transmit_All
      i-signal-i-pdus:
        CAN3_FD3_BCM1
        CAN3_FD3_OTA1
        CAN3_FD3_THCM1
        CAN3_FD3_THCM2
        CAN3_FD3_V2L1
        CAN3_FD3_VCU0
        CAN3_FD3_VCU1
        CAN3_FD3_VCU1_toNIDEC
        CAN3_FD3_VCU2
        CAN3_FD3_VCU2_toNIDEC
        CAN3_FD3_VCU4
        CAN3_FD3_VCU5
        CAN3_GW3_CE100_0
    FUSION_CAN3_Rx: communication-direction=IN, communication-mode=CAN_Receive_All
      i-signal-i-pdus:
        CAN3_BMS1
        CAN3_BMS{3..6}
        CAN3_BMS8
        CAN3_CCU1
        CAN3_CCU2
        CAN3_MCU_B_R1
        CAN3_MCU_B_R2
        CAN3_Shifter1
    FUSION_CAN4_Tx: communication-direction=OUT, communication-mode=CAN_Transmit_All
      i-signal-i-pdus:
        CAN4_FD4_C100_0
        CAN4_FD4_CE100_{0..3}
        CAN4_FD4_CE200_0
        CAN4_FD4_OTA1
        CAN4_GW4_CE100_0
        CAN4_GW4_CE200_0
    FUSION_CAN4_Rx: communication-direction=IN, communication-mode=CAN_Receive_All
      i-signal-i-pdus:
        CAN4_DKC1
        CAN4_DKC2
        CAN4_Z24_C1000_0
        CAN4_Z24_CE100_0
        CAN4_ZONE_DR1
        CAN4_ZONE_DR_VCU
        CAN4_ZONE_FR1
        CAN4_ZONE_FR_VCU
        CAN4_zGW_APTC1
        CAN4_zGW_CANFr1
        CAN4_zGW_LINDr1
    FUSION_CAN5_Tx: communication-direction=OUT, communication-mode=CAN_Transmit_All, i-signal-i-pdus=[CAN5_FD5_CE100_0, CAN5_FD5_Debug1, CAN5_FD5_Debug2, CAN5_FD5_Debug3, CAN5_FD5_OTA1, CAN5_GW5_CE100_0]
    FUSION_CAN5_Rx: communication-direction=IN, communication-mode=CAN_Receive_All, i-signal-i-pdus=[CAN5_TBOX1, CAN5_TBOX2, CAN5_TBOX3]
    FUSION_CAN7_Tx: communication-direction=OUT, communication-mode=CAN_Transmit_All, i-signal-i-pdus=[CAN7_FD7_CE100_0, CAN7_FD7_CE100_1]
    FUSION_CAN7_Rx: communication-direction=IN, communication-mode=CAN_Receive_All, i-signal-i-pdus=CAN7_Door_Fr1
