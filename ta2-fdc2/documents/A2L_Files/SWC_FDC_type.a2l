/******************************************************************************
* ASAP2 file: SWC_FDC_type.a2l
* Code generation for model "SWC_FDC_type".
* Model version : 1.15
* Simulink Coder version : 9.6 (R2021b) 14-May-2021
* C source code generated on : Mon May 26 18:32:26 2025
* Target selection: autosar.tlc
* Embedded hardware selection: ARM Compatible->ARM Cortex-M
* Code generation objectives: Unspecified
* Validation result: Not run
* (add additional file header information here)
******************************************************************************/
/* Version 1.31 */
ASAP2_VERSION 1 31
/begin PROJECT ProjectName "Project Comment Goes Here"
/begin HEADER "Header Comments go here" /end HEADER
/begin MODULE ModuleName "Module Comment Goes Here"
/begin MOD_PAR "MOD PAR Comment Goes Here" /end MOD_PAR
/begin MOD_COMMON "Mod Common Comment Here" BYTE_ORDER MSB_LAST /end MOD_COMMON
/begin RECORD_LAYOUT Scalar_BOOLEAN FNC_VALUES 1 UBYTE COLUMN_DIR DIRECT /end RECORD_LAYOUT
/begin RECORD_LAYOUT Scalar_UBYTE FNC_VALUES 1 UBYTE COLUMN_DIR DIRECT /end RECORD_LAYOUT
/begin RECORD_LAYOUT Scalar_BYTE FNC_VALUES 1 SBYTE COLUMN_DIR DIRECT /end RECORD_LAYOUT
/begin RECORD_LAYOUT Scalar_UWORD FNC_VALUES 1 UWORD COLUMN_DIR DIRECT /end RECORD_LAYOUT
/begin RECORD_LAYOUT Scalar_SWORD FNC_VALUES 1 SWORD COLUMN_DIR DIRECT /end RECORD_LAYOUT
/begin RECORD_LAYOUT Scalar_ULONG FNC_VALUES 1 ULONG COLUMN_DIR DIRECT /end RECORD_LAYOUT
/begin RECORD_LAYOUT Scalar_LONG FNC_VALUES 1 SLONG COLUMN_DIR DIRECT /end RECORD_LAYOUT
/begin RECORD_LAYOUT Scalar_FLOAT32_IEEE FNC_VALUES 1 FLOAT32_IEEE COLUMN_DIR DIRECT /end RECORD_LAYOUT
/begin RECORD_LAYOUT Scalar_FLOAT64_IEEE FNC_VALUES 1 FLOAT64_IEEE COLUMN_DIR DIRECT /end RECORD_LAYOUT
/begin RECORD_LAYOUT Lookup1D_BOOLEAN FNC_VALUES 1 UBYTE COLUMN_DIR DIRECT /end RECORD_LAYOUT
/begin RECORD_LAYOUT Lookup1D_X_BOOLEAN AXIS_PTS_X 1 UBYTE INDEX_INCR DIRECT /end RECORD_LAYOUT
/begin RECORD_LAYOUT Lookup1D_BYTE FNC_VALUES 1 SBYTE COLUMN_DIR DIRECT /end RECORD_LAYOUT
/begin RECORD_LAYOUT Lookup1D_X_BYTE AXIS_PTS_X 1 SBYTE INDEX_INCR DIRECT /end RECORD_LAYOUT
/begin RECORD_LAYOUT Lookup1D_UBYTE FNC_VALUES 1 UBYTE COLUMN_DIR DIRECT /end RECORD_LAYOUT
/begin RECORD_LAYOUT Lookup1D_X_UBYTE AXIS_PTS_X 1 UBYTE INDEX_INCR DIRECT /end RECORD_LAYOUT
/begin RECORD_LAYOUT Lookup1D_UWORD FNC_VALUES 1 UWORD COLUMN_DIR DIRECT /end RECORD_LAYOUT
/begin RECORD_LAYOUT Lookup1D_X_UWORD AXIS_PTS_X 1 UWORD INDEX_INCR DIRECT /end RECORD_LAYOUT
/begin RECORD_LAYOUT Lookup1D_WORD FNC_VALUES 1 SWORD COLUMN_DIR DIRECT /end RECORD_LAYOUT
/begin RECORD_LAYOUT Lookup1D_X_WORD AXIS_PTS_X 1 SWORD INDEX_INCR DIRECT /end RECORD_LAYOUT
/begin RECORD_LAYOUT Lookup1D_ULONG FNC_VALUES 1 ULONG COLUMN_DIR DIRECT /end RECORD_LAYOUT
/begin RECORD_LAYOUT Lookup1D_FLOAT32_IEEE FNC_VALUES 1 FLOAT32_IEEE COLUMN_DIR DIRECT /end RECORD_LAYOUT
/begin RECORD_LAYOUT Lookup1D_X_FLOAT32_IEEE AXIS_PTS_X 1 FLOAT32_IEEE INDEX_INCR DIRECT /end RECORD_LAYOUT
/begin RECORD_LAYOUT Lookup2D_FLOAT32_IEEE FNC_VALUES 1 FLOAT32_IEEE COLUMN_DIR DIRECT /end RECORD_LAYOUT
/begin RECORD_LAYOUT Lookup2D_X_FLOAT32_IEEE AXIS_PTS_X 1 FLOAT32_IEEE INDEX_INCR DIRECT /end RECORD_LAYOUT
/begin CHARACTERISTIC MACC_EHPSSpdCtrlMode_Z_rpm "" MAP 0x0000 /* @ECU_Address@MACC_EHPSSpdCtrlMode_Z_rpm@ */ Lookup2D_FLOAT32_IEEE 0 SWC_FDC_type_CM_single_rpm 0.0 2000.0
 /begin AXIS_DESCR COM_AXIS NO_INPUT_QUANTITY SWC_FDC_type_CM_single_eum 19 -30.0 30.0 AXIS_PTS_REF AACC_EHPSSpdCtrlMode_X_enum /end AXIS_DESCR
 /begin AXIS_DESCR COM_AXIS NO_INPUT_QUANTITY SWC_FDC_type_CM_single_rad 4 -30.0 30.0 AXIS_PTS_REF AACC_EHPSSpdCtrlMode_Y_rad /end AXIS_DESCR
/end CHARACTERISTIC
/begin AXIS_PTS AACC_EHPSSpdCtrlMode_Y_rad "" 0x0000 /* @ECU_Address@AACC_EHPSSpdCtrlMode_Y_rad@ */ NO_INPUT_QUANTITY Lookup2D_X_FLOAT32_IEEE 0 SWC_FDC_type_CM_single_rad 4 -30.0 30.0 /end AXIS_PTS
/begin AXIS_PTS AACC_EHPSSpdCtrlMode_X_enum "" 0x0000 /* @ECU_Address@AACC_EHPSSpdCtrlMode_X_enum@ */ NO_INPUT_QUANTITY Lookup2D_X_FLOAT32_IEEE 0 SWC_FDC_type_CM_single_eum 19 -30.0 30.0 /end AXIS_PTS
/begin CHARACTERISTIC MTHC_CoolingMCUEWPReq_Y_rpm "" CURVE 0x0000 /* @ECU_Address@MTHC_CoolingMCUEWPReq_Y_rpm@ */ Lookup1D_FLOAT32_IEEE 0 SWC_FDC_type_CM_single_rpm 0.0 6000.0
 /begin AXIS_DESCR COM_AXIS NO_INPUT_QUANTITY SWC_FDC_type_CM_single_C 11 -30.0 150.0 AXIS_PTS_REF ATHC_CoolingMCUEWPReq_X_C /end AXIS_DESCR
/end CHARACTERISTIC
/begin AXIS_PTS ATHC_CoolingMCUEWPReq_X_C "" 0x0000 /* @ECU_Address@ATHC_CoolingMCUEWPReq_X_C@ */ NO_INPUT_QUANTITY Lookup1D_X_FLOAT32_IEEE 0 SWC_FDC_type_CM_single_C 11 -30.0 150.0 /end AXIS_PTS
/begin CHARACTERISTIC MTHC_CoolingTMEWPReq_Y_rpm "" CURVE 0x0000 /* @ECU_Address@MTHC_CoolingTMEWPReq_Y_rpm@ */ Lookup1D_FLOAT32_IEEE 0 SWC_FDC_type_CM_single_rpm 0.0 6000.0
 /begin AXIS_DESCR COM_AXIS NO_INPUT_QUANTITY SWC_FDC_type_CM_single_C 11 -30.0 150.0 AXIS_PTS_REF ATHC_CoolingTMEWPReq_X_C /end AXIS_DESCR
/end CHARACTERISTIC
/begin AXIS_PTS ATHC_CoolingTMEWPReq_X_C "" 0x0000 /* @ECU_Address@ATHC_CoolingTMEWPReq_X_C@ */ NO_INPUT_QUANTITY Lookup1D_X_FLOAT32_IEEE 0 SWC_FDC_type_CM_single_C 11 -30.0 150.0 /end AXIS_PTS
/begin CHARACTERISTIC MTHC_CoolingPEUEWPReq_Y_rpm "" CURVE 0x0000 /* @ECU_Address@MTHC_CoolingPEUEWPReq_Y_rpm@ */ Lookup1D_FLOAT32_IEEE 0 SWC_FDC_type_CM_single_rpm 0.0 6000.0
 /begin AXIS_DESCR COM_AXIS NO_INPUT_QUANTITY SWC_FDC_type_CM_single_C 11 -50.0 150.0 AXIS_PTS_REF ATHC_CoolingPEUEWPReq_X_C /end AXIS_DESCR
/end CHARACTERISTIC
/begin AXIS_PTS ATHC_CoolingPEUEWPReq_X_C "" 0x0000 /* @ECU_Address@ATHC_CoolingPEUEWPReq_X_C@ */ NO_INPUT_QUANTITY Lookup1D_X_FLOAT32_IEEE 0 SWC_FDC_type_CM_single_C 11 -50.0 150.0 /end AXIS_PTS
/begin CHARACTERISTIC MTHC_ChargingPEUEWPReq_Y_rpm "" CURVE 0x0000 /* @ECU_Address@MTHC_ChargingPEUEWPReq_Y_rpm@ */ Lookup1D_FLOAT32_IEEE 0 SWC_FDC_type_CM_single_rpm 0.0 6000.0
 /begin AXIS_DESCR COM_AXIS NO_INPUT_QUANTITY SWC_FDC_type_CM_single_C 11 -50.0 150.0 AXIS_PTS_REF ATHC_ChargingPEUEWPReq_X_C /end AXIS_DESCR
/end CHARACTERISTIC
/begin AXIS_PTS ATHC_ChargingPEUEWPReq_X_C "" 0x0000 /* @ECU_Address@ATHC_ChargingPEUEWPReq_X_C@ */ NO_INPUT_QUANTITY Lookup1D_X_FLOAT32_IEEE 0 SWC_FDC_type_CM_single_C 11 -50.0 150.0 /end AXIS_PTS
/begin CHARACTERISTIC MTHC_CoolingMCUFanReq_Y_pct "" CURVE 0x0000 /* @ECU_Address@MTHC_CoolingMCUFanReq_Y_pct@ */ Lookup1D_FLOAT32_IEEE 0 SWC_FDC_type_CM_single_pct 0.0 100.0
 /begin AXIS_DESCR COM_AXIS NO_INPUT_QUANTITY SWC_FDC_type_CM_single_C 11 -30.0 150.0 AXIS_PTS_REF ATHC_CoolingMCUFanReq_X_C /end AXIS_DESCR
/end CHARACTERISTIC
/begin AXIS_PTS ATHC_CoolingMCUFanReq_X_C "" 0x0000 /* @ECU_Address@ATHC_CoolingMCUFanReq_X_C@ */ NO_INPUT_QUANTITY Lookup1D_X_FLOAT32_IEEE 0 SWC_FDC_type_CM_single_C 11 -30.0 150.0 /end AXIS_PTS
/begin CHARACTERISTIC MTHC_CoolingTMFanReq_Y_pct "" CURVE 0x0000 /* @ECU_Address@MTHC_CoolingTMFanReq_Y_pct@ */ Lookup1D_FLOAT32_IEEE 0 SWC_FDC_type_CM_single_pct 0.0 100.0
 /begin AXIS_DESCR COM_AXIS NO_INPUT_QUANTITY SWC_FDC_type_CM_single_C 11 -30.0 150.0 AXIS_PTS_REF ATHC_CoolingTMFanReq_X_C /end AXIS_DESCR
/end CHARACTERISTIC
/begin AXIS_PTS ATHC_CoolingTMFanReq_X_C "" 0x0000 /* @ECU_Address@ATHC_CoolingTMFanReq_X_C@ */ NO_INPUT_QUANTITY Lookup1D_X_FLOAT32_IEEE 0 SWC_FDC_type_CM_single_C 11 -30.0 150.0 /end AXIS_PTS
/begin CHARACTERISTIC MTHC_CoolingPEUFanReq_Y_pct "" CURVE 0x0000 /* @ECU_Address@MTHC_CoolingPEUFanReq_Y_pct@ */ Lookup1D_FLOAT32_IEEE 0 SWC_FDC_type_CM_single_pct 0.0 100.0
 /begin AXIS_DESCR COM_AXIS NO_INPUT_QUANTITY SWC_FDC_type_CM_single_C 11 -50.0 150.0 AXIS_PTS_REF ATHC_CoolingPEUFanReq_X_C /end AXIS_DESCR
/end CHARACTERISTIC
/begin AXIS_PTS ATHC_CoolingPEUFanReq_X_C "" 0x0000 /* @ECU_Address@ATHC_CoolingPEUFanReq_X_C@ */ NO_INPUT_QUANTITY Lookup1D_X_FLOAT32_IEEE 0 SWC_FDC_type_CM_single_C 11 -50.0 150.0 /end AXIS_PTS
/begin CHARACTERISTIC MTHC_ChargingPEUFanReq_Y_pct "" CURVE 0x0000 /* @ECU_Address@MTHC_ChargingPEUFanReq_Y_pct@ */ Lookup1D_FLOAT32_IEEE 0 SWC_FDC_type_CM_single_pct 0.0 100.0
 /begin AXIS_DESCR COM_AXIS NO_INPUT_QUANTITY SWC_FDC_type_CM_single_C 11 -50.0 150.0 AXIS_PTS_REF ATHC_ChargingPEUFanReq_X_C /end AXIS_DESCR
/end CHARACTERISTIC
/begin AXIS_PTS ATHC_ChargingPEUFanReq_X_C "" 0x0000 /* @ECU_Address@ATHC_ChargingPEUFanReq_X_C@ */ NO_INPUT_QUANTITY Lookup1D_X_FLOAT32_IEEE 0 SWC_FDC_type_CM_single_C 11 -50.0 150.0 /end AXIS_PTS
/begin CHARACTERISTIC KACC_AirPressInvalid_kpa "" VALUE 0x0000 /* @ECU_Address@KACC_AirPressInvalid_kpa@ */ Scalar_FLOAT32_IEEE 0 SWC_FDC_type_CM_single_pct 0.0 2400.0 /end CHARACTERISTIC
/begin CHARACTERISTIC KACC_CACEnableFailTime_s "" VALUE 0x0000 /* @ECU_Address@KACC_CACEnableFailTime_s@ */ Scalar_FLOAT32_IEEE 0 SWC_FDC_type_CM_single_s 0.0 3600.0 /end CHARACTERISTIC
/begin CHARACTERISTIC KACC_CACOverTempDelayTime_s "" VALUE 0x0000 /* @ECU_Address@KACC_CACOverTempDelayTime_s@ */ Scalar_FLOAT32_IEEE 0 SWC_FDC_type_CM_single_s 0.0 1000.0 /end CHARACTERISTIC
/begin CHARACTERISTIC KACC_CACOverTempRcv_s "" VALUE 0x0000 /* @ECU_Address@KACC_CACOverTempRcv_s@ */ Scalar_FLOAT32_IEEE 0 SWC_FDC_type_CM_single_s 0.0 7200.0 /end CHARACTERISTIC
/begin CHARACTERISTIC KACC_CACOverrunRcvTime_s "" VALUE 0x0000 /* @ECU_Address@KACC_CACOverrunRcvTime_s@ */ Scalar_FLOAT32_IEEE 0 SWC_FDC_type_CM_single_s 0.0 7200.0 /end CHARACTERISTIC
/begin CHARACTERISTIC KACC_CACOverrunTime_min "" VALUE 0x0000 /* @ECU_Address@KACC_CACOverrunTime_min@ */ Scalar_FLOAT32_IEEE 0 SWC_FDC_type_CM_single_min 0.0 120.0 /end CHARACTERISTIC
/begin CHARACTERISTIC KACC_CACPresLow_kPa "" VALUE 0x0000 /* @ECU_Address@KACC_CACPresLow_kPa@ */ Scalar_FLOAT32_IEEE 0 SWC_FDC_type_CM_single_kPa 0.0 3000.0 /end CHARACTERISTIC
/begin CHARACTERISTIC KACC_CACPresWarn_kPa "" VALUE 0x0000 /* @ECU_Address@KACC_CACPresWarn_kPa@ */ Scalar_FLOAT32_IEEE 0 SWC_FDC_type_CM_single_kPa 0.0 3000.0 /end CHARACTERISTIC
/begin CHARACTERISTIC KACC_CACStopTime_s "" VALUE 0x0000 /* @ECU_Address@KACC_CACStopTime_s@ */ Scalar_FLOAT32_IEEE 0 SWC_FDC_type_CM_single_s 0.0 3600.0 /end CHARACTERISTIC
/begin CHARACTERISTIC KACC_CACTempRev_C "" VALUE 0x0000 /* @ECU_Address@KACC_CACTempRev_C@ */ Scalar_FLOAT32_IEEE 0 SWC_FDC_type_CM_single_C 0.0 200.0 /end CHARACTERISTIC
/begin CHARACTERISTIC KACC_CACTempStop_C "" VALUE 0x0000 /* @ECU_Address@KACC_CACTempStop_C@ */ Scalar_FLOAT32_IEEE 0 SWC_FDC_type_CM_single_C 0.0 1000.0 /end CHARACTERISTIC
/begin CHARACTERISTIC KACC_CACTempWarn_C "" VALUE 0x0000 /* @ECU_Address@KACC_CACTempWarn_C@ */ Scalar_FLOAT32_IEEE 0 SWC_FDC_type_CM_single_C 0.0 200.0 /end CHARACTERISTIC
/begin CHARACTERISTIC KACC_CACTemp_C "" VALUE 0x0000 /* @ECU_Address@KACC_CACTemp_C@ */ Scalar_FLOAT32_IEEE 0 SWC_FDC_type_CM_single_degC -999.0 999.0 /end CHARACTERISTIC
/begin CHARACTERISTIC KACC_CP2VDamStiffReqFA_pct "" VALUE 0x0000 /* @ECU_Address@KACC_CP2VDamStiffReqFA_pct@ */ Scalar_FLOAT32_IEEE 0 SWC_FDC_type_CM_single_pct -150.0 150.0 /end CHARACTERISTIC
/begin CHARACTERISTIC KACC_CP2VDamStiffReqLA_pct "" VALUE 0x0000 /* @ECU_Address@KACC_CP2VDamStiffReqLA_pct@ */ Scalar_FLOAT32_IEEE 0 SWC_FDC_type_CM_single_pct -150.0 150.0 /end CHARACTERISTIC
/begin CHARACTERISTIC KACC_CP2VDamStiffReqRA_pct "" VALUE 0x0000 /* @ECU_Address@KACC_CP2VDamStiffReqRA_pct@ */ Scalar_FLOAT32_IEEE 0 SWC_FDC_type_CM_single_pct -150.0 150.0 /end CHARACTERISTIC
/begin CHARACTERISTIC KACC_DCDCErrLvHoldtime_s "" VALUE 0x0000 /* @ECU_Address@KACC_DCDCErrLvHoldtime_s@ */ Scalar_FLOAT32_IEEE 0 SWC_FDC_type_CM_single_s 0.0 7200.0 /end CHARACTERISTIC
/begin CHARACTERISTIC KACC_EACErrLvHoldtime_s "" VALUE 0x0000 /* @ECU_Address@KACC_EACErrLvHoldtime_s@ */ Scalar_FLOAT32_IEEE 0 SWC_FDC_type_CM_single_s 0.0 7200.0 /end CHARACTERISTIC
/begin CHARACTERISTIC KACC_EHPSDisStrWhlDiv_rad "" VALUE 0x0000 /* @ECU_Address@KACC_EHPSDisStrWhlDiv_rad@ */ Scalar_FLOAT32_IEEE 0 SWC_FDC_type_CM_single_rad -6.3 6.3 /end CHARACTERISTIC
/begin CHARACTERISTIC KACC_EHPSDisStrWhlHi_rad "" VALUE 0x0000 /* @ECU_Address@KACC_EHPSDisStrWhlHi_rad@ */ Scalar_FLOAT32_IEEE 0 SWC_FDC_type_CM_single_rad -6.3 6.3 /end CHARACTERISTIC
/begin CHARACTERISTIC KACC_EHPSDisStrWhlLo_rad "" VALUE 0x0000 /* @ECU_Address@KACC_EHPSDisStrWhlLo_rad@ */ Scalar_FLOAT32_IEEE 0 SWC_FDC_type_CM_single_rad -6.3 6.3 /end CHARACTERISTIC
/begin CHARACTERISTIC KACC_EHPSDisWaitTime_s "" VALUE 0x0000 /* @ECU_Address@KACC_EHPSDisWaitTime_s@ */ Scalar_FLOAT32_IEEE 0 SWC_FDC_type_CM_single_s 0.0 150000.0 /end CHARACTERISTIC
/begin CHARACTERISTIC KACC_EHPSDisableFailTime_s "" VALUE 0x0000 /* @ECU_Address@KACC_EHPSDisableFailTime_s@ */ Scalar_FLOAT32_IEEE 0 SWC_FDC_type_CM_single_s 0.0 7200.0 /end CHARACTERISTIC
/begin CHARACTERISTIC KACC_EHPSEnableFailTime_s "" VALUE 0x0000 /* @ECU_Address@KACC_EHPSEnableFailTime_s@ */ Scalar_FLOAT32_IEEE 0 SWC_FDC_type_CM_single_s 0.0 3600.0 /end CHARACTERISTIC
/begin CHARACTERISTIC KACC_EHPSErrLvHoldtime_s "" VALUE 0x0000 /* @ECU_Address@KACC_EHPSErrLvHoldtime_s@ */ Scalar_FLOAT32_IEEE 0 SWC_FDC_type_CM_single_s 0.0 7200.0 /end CHARACTERISTIC
/begin CHARACTERISTIC KACC_EHPSLimitSpd_rpm "" VALUE 0x0000 /* @ECU_Address@KACC_EHPSLimitSpd_rpm@ */ Scalar_FLOAT32_IEEE 0 SWC_FDC_type_CM_single_rpm 0.0 2000.0 /end CHARACTERISTIC
/begin CHARACTERISTIC KACC_EHPSSpdDemTimeout_s "" VALUE 0x0000 /* @ECU_Address@KACC_EHPSSpdDemTimeout_s@ */ Scalar_FLOAT32_IEEE 0 SWC_FDC_type_CM_single_s 0.0 7200.0 /end CHARACTERISTIC
/begin CHARACTERISTIC KACC_EHPSSpdDiv_rpm "" VALUE 0x0000 /* @ECU_Address@KACC_EHPSSpdDiv_rpm@ */ Scalar_FLOAT32_IEEE 0 SWC_FDC_type_CM_single_rpm 0.0 1500.0 /end CHARACTERISTIC
/begin CHARACTERISTIC KACC_EHPSStopTime_s "" VALUE 0x0000 /* @ECU_Address@KACC_EHPSStopTime_s@ */ Scalar_FLOAT32_IEEE 0 SWC_FDC_type_CM_single_s 0.0 3600.0 /end CHARACTERISTIC
/begin CHARACTERISTIC KACC_EcasSwDebounceTime_s "" VALUE 0x0000 /* @ECU_Address@KACC_EcasSwDebounceTime_s@ */ Scalar_FLOAT32_IEEE 0 SWC_FDC_type_CM_single_s 0.0 100.0 /end CHARACTERISTIC
/begin CHARACTERISTIC KACC_EcasSwTrigHoldTime_s "" VALUE 0x0000 /* @ECU_Address@KACC_EcasSwTrigHoldTime_s@ */ Scalar_FLOAT32_IEEE 0 SWC_FDC_type_CM_single_s 0.0 100.0 /end CHARACTERISTIC
/begin CHARACTERISTIC KACC_SpeedOverEHPSEnDemend_kph "" VALUE 0x0000 /* @ECU_Address@KACC_SpeedOverEHPSEnDemend_kph@ */ Scalar_FLOAT32_IEEE 0 SWC_FDC_type_CM_single_kph 0.0 100.0 /end CHARACTERISTIC
/begin CHARACTERISTIC KACC_StrWhlAngSampleTime_s "" VALUE 0x0000 /* @ECU_Address@KACC_StrWhlAngSampleTime_s@ */ Scalar_FLOAT32_IEEE 0 SWC_FDC_type_CM_single_s 0.0 60.0 /end CHARACTERISTIC
/begin CHARACTERISTIC KACC_StrWhlAng_rad "" VALUE 0x0000 /* @ECU_Address@KACC_StrWhlAng_rad@ */ Scalar_FLOAT32_IEEE 0 SWC_FDC_type_CM_single_rad -100000.0 10000.0 /end CHARACTERISTIC
/begin CHARACTERISTIC KACC_StrWhlNotMovingTime_s "" VALUE 0x0000 /* @ECU_Address@KACC_StrWhlNotMovingTime_s@ */ Scalar_FLOAT32_IEEE 0 SWC_FDC_type_CM_single_s 0.0 300.0 /end CHARACTERISTIC
/begin CHARACTERISTIC KACC_SwitchFailSensorRefRcv_s "" VALUE 0x0000 /* @ECU_Address@KACC_SwitchFailSensorRefRcv_s@ */ Scalar_FLOAT32_IEEE 0 SWC_FDC_type_CM_single_s 0.0 7200.0 /end CHARACTERISTIC
/begin CHARACTERISTIC KACC_SwitchFailSensorRef_kpa "" VALUE 0x0000 /* @ECU_Address@KACC_SwitchFailSensorRef_kpa@ */ Scalar_FLOAT32_IEEE 0 SWC_FDC_type_CM_single_kPa 0.0 3000.0 /end CHARACTERISTIC
/begin CHARACTERISTIC KACC_VCUEACpumpTempInvalid_C "" VALUE 0x0000 /* @ECU_Address@KACC_VCUEACpumpTempInvalid_C@ */ Scalar_FLOAT32_IEEE 0 SWC_FDC_type_CM_single_degC -150.0 150.0 /end CHARACTERISTIC
/begin CHARACTERISTIC KBCM_FLTurnLPLv_A "" VALUE 0x0000 /* @ECU_Address@KBCM_FLTurnLPLv_A@ */ Scalar_FLOAT32_IEEE 0 SWC_FDC_type_CM_single_mA 0.0 60000.0 /end CHARACTERISTIC
/begin CHARACTERISTIC KBCM_FRTurnLPLv_A "" VALUE 0x0000 /* @ECU_Address@KBCM_FRTurnLPLv_A@ */ Scalar_FLOAT32_IEEE 0 SWC_FDC_type_CM_single_mA 0.0 60000.0 /end CHARACTERISTIC
/begin CHARACTERISTIC KBCM_LampOFFV_V "" VALUE 0x0000 /* @ECU_Address@KBCM_LampOFFV_V@ */ Scalar_FLOAT32_IEEE 0 SWC_FDC_type_CM_single_V 0.0 5.0 /end CHARACTERISTIC
/begin CHARACTERISTIC KBCM_LampONV_V "" VALUE 0x0000 /* @ECU_Address@KBCM_LampONV_V@ */ Scalar_FLOAT32_IEEE 0 SWC_FDC_type_CM_single_V 0.0 5.0 /end CHARACTERISTIC
/begin CHARACTERISTIC KBCM_RLTurnLPLv_A "" VALUE 0x0000 /* @ECU_Address@KBCM_RLTurnLPLv_A@ */ Scalar_FLOAT32_IEEE 0 SWC_FDC_type_CM_single_mA 0.0 60000.0 /end CHARACTERISTIC
/begin CHARACTERISTIC KBCM_RRTurnLPLv_A "" VALUE 0x0000 /* @ECU_Address@KBCM_RRTurnLPLv_A@ */ Scalar_FLOAT32_IEEE 0 SWC_FDC_type_CM_single_mA 0.0 60000.0 /end CHARACTERISTIC
/begin CHARACTERISTIC KDHP_EAPS1MINMem_pct "" VALUE 0x0000 /* @ECU_Address@KDHP_EAPS1MINMem_pct@ */ Scalar_FLOAT32_IEEE 0 SWC_FDC_type_CM_single_pct 0.0 100.0 /end CHARACTERISTIC
/begin CHARACTERISTIC KDHP_EAPS2MINMem_pct "" VALUE 0x0000 /* @ECU_Address@KDHP_EAPS2MINMem_pct@ */ Scalar_FLOAT32_IEEE 0 SWC_FDC_type_CM_single_pct 0.0 100.0 /end CHARACTERISTIC
/begin CHARACTERISTIC KDHP_LVBattDet12V_V "" VALUE 0x0000 /* @ECU_Address@KDHP_LVBattDet12V_V@ */ Scalar_FLOAT32_IEEE 0 SWC_FDC_type_CM_single_V -50.0 50.0 /end CHARACTERISTIC
/begin CHARACTERISTIC KPMM_3in1RlyDelayTime_s "" VALUE 0x0000 /* @ECU_Address@KPMM_3in1RlyDelayTime_s@ */ Scalar_FLOAT32_IEEE 0 SWC_FDC_type_CM_single_s 0.0 3600.0 /end CHARACTERISTIC
/begin CHARACTERISTIC KPMM_ACMainRlyUpFailtime_s "" VALUE 0x0000 /* @ECU_Address@KPMM_ACMainRlyUpFailtime_s@ */ Scalar_FLOAT32_IEEE 0 SWC_FDC_type_CM_single_s 0.0 3600.0 /end CHARACTERISTIC
/begin CHARACTERISTIC KPMM_AfterrunTimeout_s "" VALUE 0x0000 /* @ECU_Address@KPMM_AfterrunTimeout_s@ */ Scalar_FLOAT32_IEEE 0 SWC_FDC_type_CM_single_s 0.0 100000.0 /end CHARACTERISTIC
/begin CHARACTERISTIC KPMM_AlcLockCheckFailtime_s "" VALUE 0x0000 /* @ECU_Address@KPMM_AlcLockCheckFailtime_s@ */ Scalar_FLOAT32_IEEE 0 SWC_FDC_type_CM_single_s 0.0 3600.0 /end CHARACTERISTIC
/begin CHARACTERISTIC KPMM_BCUGetChrgTO_s "" VALUE 0x0000 /* @ECU_Address@KPMM_BCUGetChrgTO_s@ */ Scalar_FLOAT32_IEEE 0 SWC_FDC_type_CM_single_s 0.0 3600.0 /end CHARACTERISTIC
/begin CHARACTERISTIC KPMM_BattDownFailtime_s "" VALUE 0x0000 /* @ECU_Address@KPMM_BattDownFailtime_s@ */ Scalar_FLOAT32_IEEE 0 SWC_FDC_type_CM_single_s 0.0 3600.0 /end CHARACTERISTIC
/begin CHARACTERISTIC KPMM_BattUpFailtime_s "" VALUE 0x0000 /* @ECU_Address@KPMM_BattUpFailtime_s@ */ Scalar_FLOAT32_IEEE 0 SWC_FDC_type_CM_single_s 0.0 3600.0 /end CHARACTERISTIC
/begin CHARACTERISTIC KPMM_ButtonHoldlimit_cnt "" VALUE 0x0000 /* @ECU_Address@KPMM_ButtonHoldlimit_cnt@ */ Scalar_FLOAT32_IEEE 0 SWC_FDC_type_CM_single_cnt 0.0 1000.0 /end CHARACTERISTIC
/begin CHARACTERISTIC KPMM_ChrgIntoPwrdownWait_s "" VALUE 0x0000 /* @ECU_Address@KPMM_ChrgIntoPwrdownWait_s@ */ Scalar_FLOAT32_IEEE 0 SWC_FDC_type_CM_single_s 0.0 3600.0 /end CHARACTERISTIC
/begin CHARACTERISTIC KPMM_ChrgwakeDebon_cnt "" VALUE 0x0000 /* @ECU_Address@KPMM_ChrgwakeDebon_cnt@ */ Scalar_FLOAT32_IEEE 0 SWC_FDC_type_CM_single_cnt 0.0 1000.0 /end CHARACTERISTIC
/begin CHARACTERISTIC KPMM_DCDCChrgFailtime_s "" VALUE 0x0000 /* @ECU_Address@KPMM_DCDCChrgFailtime_s@ */ Scalar_FLOAT32_IEEE 0 SWC_FDC_type_CM_single_s 0.0 3600.0 /end CHARACTERISTIC
/begin CHARACTERISTIC KPMM_DCDCEnableFailtime_s "" VALUE 0x0000 /* @ECU_Address@KPMM_DCDCEnableFailtime_s@ */ Scalar_FLOAT32_IEEE 0 SWC_FDC_type_CM_single_s 0.0 3600.0 /end CHARACTERISTIC
/begin CHARACTERISTIC KPMM_DCDCRlyDemDelayTime_s "" VALUE 0x0000 /* @ECU_Address@KPMM_DCDCRlyDemDelayTime_s@ */ Scalar_FLOAT32_IEEE 0 SWC_FDC_type_CM_single_s 0.0 3600.0 /end CHARACTERISTIC
/begin CHARACTERISTIC KPMM_DCDCRlyUpFailtime_s "" VALUE 0x0000 /* @ECU_Address@KPMM_DCDCRlyUpFailtime_s@ */ Scalar_FLOAT32_IEEE 0 SWC_FDC_type_CM_single_s 0.0 3600.0 /end CHARACTERISTIC
/begin CHARACTERISTIC KPMM_EACEnTimout_s "" VALUE 0x0000 /* @ECU_Address@KPMM_EACEnTimout_s@ */ Scalar_FLOAT32_IEEE 0 SWC_FDC_type_CM_single_s 0.0 3600.0 /end CHARACTERISTIC
/begin CHARACTERISTIC KPMM_EHPSEnTimout_s "" VALUE 0x0000 /* @ECU_Address@KPMM_EHPSEnTimout_s@ */ Scalar_FLOAT32_IEEE 0 SWC_FDC_type_CM_single_s 0.0 3600.0 /end CHARACTERISTIC
/begin CHARACTERISTIC KPMM_EHPSIniTimout_s "" VALUE 0x0000 /* @ECU_Address@KPMM_EHPSIniTimout_s@ */ Scalar_FLOAT32_IEEE 0 SWC_FDC_type_CM_single_s 0.0 3600.0 /end CHARACTERISTIC
/begin CHARACTERISTIC KPMM_EHPSSpdDem_rpm "" VALUE 0x0000 /* @ECU_Address@KPMM_EHPSSpdDem_rpm@ */ Scalar_FLOAT32_IEEE 0 SWC_FDC_type_CM_single_rpm 0.0 1500.0 /end CHARACTERISTIC
/begin CHARACTERISTIC KPMM_FakeHVILDuty_pct "" VALUE 0x0000 /* @ECU_Address@KPMM_FakeHVILDuty_pct@ */ Scalar_FLOAT32_IEEE 0 SWC_FDC_type_CM_single_pct 0.0 100.0 /end CHARACTERISTIC
/begin CHARACTERISTIC KPMM_FakeLVBattVol_V "" VALUE 0x0000 /* @ECU_Address@KPMM_FakeLVBattVol_V@ */ Scalar_FLOAT32_IEEE 0 SWC_FDC_type_CM_single_V -10.0 500.0 /end CHARACTERISTIC
/begin CHARACTERISTIC KPMM_HVILFailDetectTimes_cnt "" VALUE 0x0000 /* @ECU_Address@KPMM_HVILFailDetectTimes_cnt@ */ Scalar_FLOAT32_IEEE 0 SWC_FDC_type_CM_single_cnt 0.0 100.0 /end CHARACTERISTIC
/begin CHARACTERISTIC KPMM_HVILInvalidContTime_s "" VALUE 0x0000 /* @ECU_Address@KPMM_HVILInvalidContTime_s@ */ Scalar_FLOAT32_IEEE 0 SWC_FDC_type_CM_single_s 0.0 3600.0 /end CHARACTERISTIC
/begin CHARACTERISTIC KPMM_HVILPWMDutyMax_pct "" VALUE 0x0000 /* @ECU_Address@KPMM_HVILPWMDutyMax_pct@ */ Scalar_FLOAT32_IEEE 0 SWC_FDC_type_CM_single_pct 0.0 100.0 /end CHARACTERISTIC
/begin CHARACTERISTIC KPMM_HVILPWMDutyMin_pct "" VALUE 0x0000 /* @ECU_Address@KPMM_HVILPWMDutyMin_pct@ */ Scalar_FLOAT32_IEEE 0 SWC_FDC_type_CM_single_pct 0.0 100.0 /end CHARACTERISTIC
/begin CHARACTERISTIC KPMM_HVILPassDetectTimes_cnt "" VALUE 0x0000 /* @ECU_Address@KPMM_HVILPassDetectTimes_cnt@ */ Scalar_FLOAT32_IEEE 0 SWC_FDC_type_CM_single_cnt 0.0 100.0 /end CHARACTERISTIC
/begin CHARACTERISTIC KPMM_HVILValidContTime_s "" VALUE 0x0000 /* @ECU_Address@KPMM_HVILValidContTime_s@ */ Scalar_FLOAT32_IEEE 0 SWC_FDC_type_CM_single_s 0.0 3600.0 /end CHARACTERISTIC
/begin CHARACTERISTIC KPMM_HVRlyCheckFailtime_s "" VALUE 0x0000 /* @ECU_Address@KPMM_HVRlyCheckFailtime_s@ */ Scalar_FLOAT32_IEEE 0 SWC_FDC_type_CM_single_s 0.0 3600.0 /end CHARACTERISTIC
/begin CHARACTERISTIC KPMM_HVRlyOpenFailWT_s "" VALUE 0x0000 /* @ECU_Address@KPMM_HVRlyOpenFailWT_s@ */ Scalar_FLOAT32_IEEE 0 SWC_FDC_type_CM_single_s 0.0 3600.0 /end CHARACTERISTIC
/begin CHARACTERISTIC KPMM_HVRlyOpenFailtime_s "" VALUE 0x0000 /* @ECU_Address@KPMM_HVRlyOpenFailtime_s@ */ Scalar_FLOAT32_IEEE 0 SWC_FDC_type_CM_single_s 0.0 3600.0 /end CHARACTERISTIC
/begin CHARACTERISTIC KPMM_MCUDisChrgFSFailtime_s "" VALUE 0x0000 /* @ECU_Address@KPMM_MCUDisChrgFSFailtime_s@ */ Scalar_FLOAT32_IEEE 0 SWC_FDC_type_CM_single_s 0.0 3600.0 /end CHARACTERISTIC
/begin CHARACTERISTIC KPMM_MCUDisChrgFailtime_s "" VALUE 0x0000 /* @ECU_Address@KPMM_MCUDisChrgFailtime_s@ */ Scalar_FLOAT32_IEEE 0 SWC_FDC_type_CM_single_s 0.0 3600.0 /end CHARACTERISTIC
/begin CHARACTERISTIC KPMM_MCUDisableFailtime_s "" VALUE 0x0000 /* @ECU_Address@KPMM_MCUDisableFailtime_s@ */ Scalar_FLOAT32_IEEE 0 SWC_FDC_type_CM_single_s 0.0 3600.0 /end CHARACTERISTIC
/begin CHARACTERISTIC KPMM_MCUEnDischrgFailtime_s "" VALUE 0x0000 /* @ECU_Address@KPMM_MCUEnDischrgFailtime_s@ */ Scalar_FLOAT32_IEEE 0 SWC_FDC_type_CM_single_s 0.0 3600.0 /end CHARACTERISTIC
/begin CHARACTERISTIC KPMM_MCUEnableFailtime_s "" VALUE 0x0000 /* @ECU_Address@KPMM_MCUEnableFailtime_s@ */ Scalar_FLOAT32_IEEE 0 SWC_FDC_type_CM_single_s 0.0 3600.0 /end CHARACTERISTIC
/begin CHARACTERISTIC KPMM_MCUPassDisChrg_s "" VALUE 0x0000 /* @ECU_Address@KPMM_MCUPassDisChrg_s@ */ Scalar_FLOAT32_IEEE 0 SWC_FDC_type_CM_single_s 0.0 3600.0 /end CHARACTERISTIC
/begin CHARACTERISTIC KPMM_MCUPrechrgFailtime_s "" VALUE 0x0000 /* @ECU_Address@KPMM_MCUPrechrgFailtime_s@ */ Scalar_FLOAT32_IEEE 0 SWC_FDC_type_CM_single_s 0.0 3600.0 /end CHARACTERISTIC
/begin CHARACTERISTIC KPMM_PDUDisableFailtime_s "" VALUE 0x0000 /* @ECU_Address@KPMM_PDUDisableFailtime_s@ */ Scalar_FLOAT32_IEEE 0 SWC_FDC_type_CM_single_s 0.0 3600.0 /end CHARACTERISTIC
/begin CHARACTERISTIC KPMM_PDUDisableWaitime_s "" VALUE 0x0000 /* @ECU_Address@KPMM_PDUDisableWaitime_s@ */ Scalar_FLOAT32_IEEE 0 SWC_FDC_type_CM_single_s 0.0 3600.0 /end CHARACTERISTIC
/begin CHARACTERISTIC KPMM_PDULoadRlyPUFailtime_s "" VALUE 0x0000 /* @ECU_Address@KPMM_PDULoadRlyPUFailtime_s@ */ Scalar_FLOAT32_IEEE 0 SWC_FDC_type_CM_single_s 0.0 3600.0 /end CHARACTERISTIC
/begin CHARACTERISTIC KPMM_StaSwTime_s "" VALUE 0x0000 /* @ECU_Address@KPMM_StaSwTime_s@ */ Scalar_FLOAT32_IEEE 0 SWC_FDC_type_CM_single_s 0.0 3600.0 /end CHARACTERISTIC
/begin CHARACTERISTIC KPMM_SysInitialTO_s "" VALUE 0x0000 /* @ECU_Address@KPMM_SysInitialTO_s@ */ Scalar_FLOAT32_IEEE 0 SWC_FDC_type_CM_single_s 0.0 86400.0 /end CHARACTERISTIC
/begin CHARACTERISTIC KPMM_TargetDchrgVolt_V "" VALUE 0x0000 /* @ECU_Address@KPMM_TargetDchrgVolt_V@ */ Scalar_FLOAT32_IEEE 0 SWC_FDC_type_CM_single_V 0.0 800.0 /end CHARACTERISTIC
/begin CHARACTERISTIC KPMM_TargetEnDischrgVolt_V "" VALUE 0x0000 /* @ECU_Address@KPMM_TargetEnDischrgVolt_V@ */ Scalar_FLOAT32_IEEE 0 SWC_FDC_type_CM_single_V 0.0 800.0 /end CHARACTERISTIC
/begin CHARACTERISTIC KPMM_TargetPassDischrgVolt_V "" VALUE 0x0000 /* @ECU_Address@KPMM_TargetPassDischrgVolt_V@ */ Scalar_FLOAT32_IEEE 0 SWC_FDC_type_CM_single_V 0.0 800.0 /end CHARACTERISTIC
/begin CHARACTERISTIC KPMM_Time4Sleep_s "" VALUE 0x0000 /* @ECU_Address@KPMM_Time4Sleep_s@ */ Scalar_FLOAT32_IEEE 0 SWC_FDC_type_CM_single_s 0.0 3600.0 /end CHARACTERISTIC
/begin CHARACTERISTIC KPMM_TimeHVSelfChk4Chrg_s "" VALUE 0x0000 /* @ECU_Address@KPMM_TimeHVSelfChk4Chrg_s@ */ Scalar_FLOAT32_IEEE 0 SWC_FDC_type_CM_single_s 0.0 3600.0 /end CHARACTERISTIC
/begin CHARACTERISTIC KPMM_VoltForceOffInAfferun_v "" VALUE 0x0000 /* @ECU_Address@KPMM_VoltForceOffInAfferun_v@ */ Scalar_FLOAT32_IEEE 0 SWC_FDC_type_CM_single_v 0.0 48.0 /end CHARACTERISTIC
/begin CHARACTERISTIC KPMM_WaitAirPressTimeout_s "" VALUE 0x0000 /* @ECU_Address@KPMM_WaitAirPressTimeout_s@ */ Scalar_FLOAT32_IEEE 0 SWC_FDC_type_CM_single_s 0.0 7200.0 /end CHARACTERISTIC
/begin CHARACTERISTIC KPMM_WaitForAfterrunFail_s "" VALUE 0x0000 /* @ECU_Address@KPMM_WaitForAfterrunFail_s@ */ Scalar_FLOAT32_IEEE 0 SWC_FDC_type_CM_single_s 0.0 3600.0 /end CHARACTERISTIC
/begin CHARACTERISTIC KPSA_APSPosnSafe_pct "" VALUE 0x0000 /* @ECU_Address@KPSA_APSPosnSafe_pct@ */ Scalar_FLOAT32_IEEE 0 SWC_FDC_type_CM_single_pct 0.0 100.0 /end CHARACTERISTIC
/begin CHARACTERISTIC KPSA_ActTimeEmergencySD_s "" VALUE 0x0000 /* @ECU_Address@KPSA_ActTimeEmergencySD_s@ */ Scalar_FLOAT32_IEEE 0 SWC_FDC_type_CM_single_s 0.0 3600.0 /end CHARACTERISTIC
/begin CHARACTERISTIC KPSA_AfterrunWaitTime_s "" VALUE 0x0000 /* @ECU_Address@KPSA_AfterrunWaitTime_s@ */ Scalar_FLOAT32_IEEE 0 SWC_FDC_type_CM_single_s 0.0 1800.0 /end CHARACTERISTIC
/begin CHARACTERISTIC KPSA_AlcLockPassTime_s "" VALUE 0x0000 /* @ECU_Address@KPSA_AlcLockPassTime_s@ */ Scalar_FLOAT32_IEEE 0 SWC_FDC_type_CM_single_s 0.0 100.0 /end CHARACTERISTIC
/begin CHARACTERISTIC KPSA_KeystatusWaitTime_s "" VALUE 0x0000 /* @ECU_Address@KPSA_KeystatusWaitTime_s@ */ Scalar_FLOAT32_IEEE 0 SWC_FDC_type_CM_single_s 0.0 10.0 /end CHARACTERISTIC
/begin CHARACTERISTIC KPSA_PBOnTimeForEMStop_s "" VALUE 0x0000 /* @ECU_Address@KPSA_PBOnTimeForEMStop_s@ */ Scalar_FLOAT32_IEEE 0 SWC_FDC_type_CM_single_s 0.0 10.0 /end CHARACTERISTIC
/begin CHARACTERISTIC KPSA_PBTrigHoldtime_s "" VALUE 0x0000 /* @ECU_Address@KPSA_PBTrigHoldtime_s@ */ Scalar_FLOAT32_IEEE 0 SWC_FDC_type_CM_single_s 0.0 10.0 /end CHARACTERISTIC
/begin CHARACTERISTIC KPSA_RcvTimeEmergencySD_s "" VALUE 0x0000 /* @ECU_Address@KPSA_RcvTimeEmergencySD_s@ */ Scalar_FLOAT32_IEEE 0 SWC_FDC_type_CM_single_s 0.0 3600.0 /end CHARACTERISTIC
/begin CHARACTERISTIC KSCP_DelayECBAMandECDT_s "" VALUE 0x0000 /* @ECU_Address@KSCP_DelayECBAMandECDT_s@ */ Scalar_FLOAT32_IEEE 0 SWC_FDC_type_CM_single_s 0.0 3600.0 /end CHARACTERISTIC
/begin CHARACTERISTIC KSCP_DelayECDTandECDT_s "" VALUE 0x0000 /* @ECU_Address@KSCP_DelayECDTandECDT_s@ */ Scalar_FLOAT32_IEEE 0 SWC_FDC_type_CM_single_s 0.0 3600.0 /end CHARACTERISTIC
/begin CHARACTERISTIC KSCP_DelayECDTandRCBAM_s "" VALUE 0x0000 /* @ECU_Address@KSCP_DelayECDTandRCBAM_s@ */ Scalar_FLOAT32_IEEE 0 SWC_FDC_type_CM_single_s 0.0 3600.0 /end CHARACTERISTIC
/begin CHARACTERISTIC KSCP_DelayRCBAMandRCDT_s "" VALUE 0x0000 /* @ECU_Address@KSCP_DelayRCBAMandRCDT_s@ */ Scalar_FLOAT32_IEEE 0 SWC_FDC_type_CM_single_s 0.0 3600.0 /end CHARACTERISTIC
/begin CHARACTERISTIC KSCP_DelayRCDTandECBAM_s "" VALUE 0x0000 /* @ECU_Address@KSCP_DelayRCDTandECBAM_s@ */ Scalar_FLOAT32_IEEE 0 SWC_FDC_type_CM_single_s 0.0 3600.0 /end CHARACTERISTIC
/begin CHARACTERISTIC KSCP_DelayRCDTandRCDT_s "" VALUE 0x0000 /* @ECU_Address@KSCP_DelayRCDTandRCDT_s@ */ Scalar_FLOAT32_IEEE 0 SWC_FDC_type_CM_single_s 0.0 3600.0 /end CHARACTERISTIC
/begin CHARACTERISTIC KSCP_MCUMaxRefTq_Nm "" VALUE 0x0000 /* @ECU_Address@KSCP_MCUMaxRefTq_Nm@ */ Scalar_FLOAT32_IEEE 0 SWC_FDC_type_CM_single_Nm -10000.0 10000.0 /end CHARACTERISTIC
/begin CHARACTERISTIC KTHC_AfterrunMCUStartTemp_C "" VALUE 0x0000 /* @ECU_Address@KTHC_AfterrunMCUStartTemp_C@ */ Scalar_FLOAT32_IEEE 0 SWC_FDC_type_CM_single_C -50.0 255.0 /end CHARACTERISTIC
/begin CHARACTERISTIC KTHC_AfterrunMCUStopTemp_C "" VALUE 0x0000 /* @ECU_Address@KTHC_AfterrunMCUStopTemp_C@ */ Scalar_FLOAT32_IEEE 0 SWC_FDC_type_CM_single_C -50.0 255.0 /end CHARACTERISTIC
/begin CHARACTERISTIC KTHC_AfterrunTMStartTemp_C "" VALUE 0x0000 /* @ECU_Address@KTHC_AfterrunTMStartTemp_C@ */ Scalar_FLOAT32_IEEE 0 SWC_FDC_type_CM_single_C -50.0 255.0 /end CHARACTERISTIC
/begin CHARACTERISTIC KTHC_AfterrunTMStopTemp_C "" VALUE 0x0000 /* @ECU_Address@KTHC_AfterrunTMStopTemp_C@ */ Scalar_FLOAT32_IEEE 0 SWC_FDC_type_CM_single_C -50.0 255.0 /end CHARACTERISTIC
/begin CHARACTERISTIC KTHC_AfterrunningModeCoolFanReq_pct "" VALUE 0x0000 /* @ECU_Address@KTHC_AfterrunningModeCoolFanReq_pct@ */ Scalar_FLOAT32_IEEE 0 SWC_FDC_type_CM_single_pct 0.0 100.0 /end CHARACTERISTIC
/begin CHARACTERISTIC KTHC_AfterrunningModeEWPPEReq_rpm "" VALUE 0x0000 /* @ECU_Address@KTHC_AfterrunningModeEWPPEReq_rpm@ */ Scalar_FLOAT32_IEEE 0 SWC_FDC_type_CM_single_rpm 0.0 6000.0 /end CHARACTERISTIC
/begin CHARACTERISTIC KTHC_CoolingEWPDisSpdDem_rpm "" VALUE 0x0000 /* @ECU_Address@KTHC_CoolingEWPDisSpdDem_rpm@ */ Scalar_FLOAT32_IEEE 0 SWC_FDC_type_CM_single_rpm 0.0 15000.0 /end CHARACTERISTIC
/begin CHARACTERISTIC KTHC_CoolingEWPEnSpdDem_rpm "" VALUE 0x0000 /* @ECU_Address@KTHC_CoolingEWPEnSpdDem_rpm@ */ Scalar_FLOAT32_IEEE 0 SWC_FDC_type_CM_single_rpm 0.0 15000.0 /end CHARACTERISTIC
/begin CHARACTERISTIC KTHC_CoolingFanPWMDis_pct "" VALUE 0x0000 /* @ECU_Address@KTHC_CoolingFanPWMDis_pct@ */ Scalar_FLOAT32_IEEE 0 SWC_FDC_type_CM_single_pct 0.0 100.0 /end CHARACTERISTIC
/begin CHARACTERISTIC KTHC_CoolingFanPWMEn_pct "" VALUE 0x0000 /* @ECU_Address@KTHC_CoolingFanPWMEn_pct@ */ Scalar_FLOAT32_IEEE 0 SWC_FDC_type_CM_single_pct 0.0 100.0 /end CHARACTERISTIC
/begin CHARACTERISTIC KTHC_EWPPEFaultSpd_rpm "" VALUE 0x0000 /* @ECU_Address@KTHC_EWPPEFaultSpd_rpm@ */ Scalar_FLOAT32_IEEE 0 SWC_FDC_type_CM_single_rpm 0.0 15000.0 /end CHARACTERISTIC
/begin CHARACTERISTIC KTHC_LostEWPCoolingFan_pct "" VALUE 0x0000 /* @ECU_Address@KTHC_LostEWPCoolingFan_pct@ */ Scalar_FLOAT32_IEEE 0 SWC_FDC_type_CM_single_pct 0.0 100.0 /end CHARACTERISTIC
/begin CHARACTERISTIC KTHC_MCUDerationCoolFanReq_pct "" VALUE 0x0000 /* @ECU_Address@KTHC_MCUDerationCoolFanReq_pct@ */ Scalar_FLOAT32_IEEE 0 SWC_FDC_type_CM_single_pct 0.0 100.0 /end CHARACTERISTIC
/begin CHARACTERISTIC KTHC_MCUDerationEWPPEReq_rpm "" VALUE 0x0000 /* @ECU_Address@KTHC_MCUDerationEWPPEReq_rpm@ */ Scalar_FLOAT32_IEEE 0 SWC_FDC_type_CM_single_rpm 0.0 6000.0 /end CHARACTERISTIC
/begin CHARACTERISTIC KTHC_MCUTempErrCoolFanReq_pct "" VALUE 0x0000 /* @ECU_Address@KTHC_MCUTempErrCoolFanReq_pct@ */ Scalar_FLOAT32_IEEE 0 SWC_FDC_type_CM_single_pct 0.0 100.0 /end CHARACTERISTIC
/begin CHARACTERISTIC KTHC_MCUTempErrEWPPEReq_rpm "" VALUE 0x0000 /* @ECU_Address@KTHC_MCUTempErrEWPPEReq_rpm@ */ Scalar_FLOAT32_IEEE 0 SWC_FDC_type_CM_single_rpm 0.0 6000.0 /end CHARACTERISTIC
/begin CHARACTERISTIC KTHC_MCUTempError_C "" VALUE 0x0000 /* @ECU_Address@KTHC_MCUTempError_C@ */ Scalar_FLOAT32_IEEE 0 SWC_FDC_type_CM_single_C -50.0 255.0 /end CHARACTERISTIC
/begin CHARACTERISTIC KTHC_PEUDerationCoolFanReq_pct "" VALUE 0x0000 /* @ECU_Address@KTHC_PEUDerationCoolFanReq_pct@ */ Scalar_FLOAT32_IEEE 0 SWC_FDC_type_CM_single_pct 0.0 100.0 /end CHARACTERISTIC
/begin CHARACTERISTIC KTHC_PEUDerationEWPPEReq_rpm "" VALUE 0x0000 /* @ECU_Address@KTHC_PEUDerationEWPPEReq_rpm@ */ Scalar_FLOAT32_IEEE 0 SWC_FDC_type_CM_single_rpm 0.0 6000.0 /end CHARACTERISTIC
/begin CHARACTERISTIC KTHC_PEUDerationTemp_C "" VALUE 0x0000 /* @ECU_Address@KTHC_PEUDerationTemp_C@ */ Scalar_FLOAT32_IEEE 0 SWC_FDC_type_CM_single_C -50.0 255.0 /end CHARACTERISTIC
/begin CHARACTERISTIC KTHC_PEUTempErrCoolFanReq_pct "" VALUE 0x0000 /* @ECU_Address@KTHC_PEUTempErrCoolFanReq_pct@ */ Scalar_FLOAT32_IEEE 0 SWC_FDC_type_CM_single_pct 0.0 100.0 /end CHARACTERISTIC
/begin CHARACTERISTIC KTHC_PEUTempErrEWPPEReq_rpm "" VALUE 0x0000 /* @ECU_Address@KTHC_PEUTempErrEWPPEReq_rpm@ */ Scalar_FLOAT32_IEEE 0 SWC_FDC_type_CM_single_rpm 0.0 6000.0 /end CHARACTERISTIC
/begin CHARACTERISTIC KTHC_PEUTempError_C "" VALUE 0x0000 /* @ECU_Address@KTHC_PEUTempError_C@ */ Scalar_FLOAT32_IEEE 0 SWC_FDC_type_CM_single_C -50.0 255.0 /end CHARACTERISTIC
/begin CHARACTERISTIC KTHC_ServiceModeCoolFanReq_pct "" VALUE 0x0000 /* @ECU_Address@KTHC_ServiceModeCoolFanReq_pct@ */ Scalar_FLOAT32_IEEE 0 SWC_FDC_type_CM_single_pct 0.0 100.0 /end CHARACTERISTIC
/begin CHARACTERISTIC KTHC_ServiceModeEWPPEReq_rpm "" VALUE 0x0000 /* @ECU_Address@KTHC_ServiceModeEWPPEReq_rpm@ */ Scalar_FLOAT32_IEEE 0 SWC_FDC_type_CM_single_rpm 0.0 6000.0 /end CHARACTERISTIC
/begin CHARACTERISTIC KTHC_TMTempErrCoolFanReq_pct "" VALUE 0x0000 /* @ECU_Address@KTHC_TMTempErrCoolFanReq_pct@ */ Scalar_FLOAT32_IEEE 0 SWC_FDC_type_CM_single_pct 0.0 100.0 /end CHARACTERISTIC
/begin CHARACTERISTIC KTHC_TMTempErrEWPPEReq_rpm "" VALUE 0x0000 /* @ECU_Address@KTHC_TMTempErrEWPPEReq_rpm@ */ Scalar_FLOAT32_IEEE 0 SWC_FDC_type_CM_single_rpm 0.0 6000.0 /end CHARACTERISTIC
/begin CHARACTERISTIC KTHC_TMTempError_C "" VALUE 0x0000 /* @ECU_Address@KTHC_TMTempError_C@ */ Scalar_FLOAT32_IEEE 0 SWC_FDC_type_CM_single_C -50.0 255.0 /end CHARACTERISTIC
/begin CHARACTERISTIC KTQD_ActDrvDirMotorSpdLimit_rpm "" VALUE 0x0000 /* @ECU_Address@KTQD_ActDrvDirMotorSpdLimit_rpm@ */ Scalar_FLOAT32_IEEE 0 SWC_FDC_type_CM_single_rpm 0.0 50.0 /end CHARACTERISTIC
/begin CHARACTERISTIC KTQD_CAN1BusOffSpdRcv_kph "" VALUE 0x0000 /* @ECU_Address@KTQD_CAN1BusOffSpdRcv_kph@ */ Scalar_FLOAT32_IEEE 0 SWC_FDC_type_CM_single_kph 0.0 255.0 /end CHARACTERISTIC
/begin CHARACTERISTIC KTQD_ComLostTorqLimitRcv_kph "" VALUE 0x0000 /* @ECU_Address@KTQD_ComLostTorqLimitRcv_kph@ */ Scalar_FLOAT32_IEEE 0 SWC_FDC_type_CM_single_kph 0.0 255.0 /end CHARACTERISTIC
/begin CHARACTERISTIC KTQD_ComboBuzzerDelayDis_s "" VALUE 0x0000 /* @ECU_Address@KTQD_ComboBuzzerDelayDis_s@ */ Scalar_FLOAT32_IEEE 0 SWC_FDC_type_CM_single_s 0.0 3600.0 /end CHARACTERISTIC
/begin CHARACTERISTIC KTQD_ComboWarnBuzzerFlash_cnt "" VALUE 0x0000 /* @ECU_Address@KTQD_ComboWarnBuzzerFlash_cnt@ */ Scalar_FLOAT32_IEEE 0 SWC_FDC_type_CM_single_cnt 0.0 100.0 /end CHARACTERISTIC
/begin CHARACTERISTIC KTQD_ComboWarnBuzzerOff_s "" VALUE 0x0000 /* @ECU_Address@KTQD_ComboWarnBuzzerOff_s@ */ Scalar_FLOAT32_IEEE 0 SWC_FDC_type_CM_single_s 0.0 3600.0 /end CHARACTERISTIC
/begin CHARACTERISTIC KTQD_ComboWarnBuzzerOn_s "" VALUE 0x0000 /* @ECU_Address@KTQD_ComboWarnBuzzerOn_s@ */ Scalar_FLOAT32_IEEE 0 SWC_FDC_type_CM_single_s 0.0 3600.0 /end CHARACTERISTIC
/begin CHARACTERISTIC KTQD_ComboWarnBuzzerWait_s "" VALUE 0x0000 /* @ECU_Address@KTQD_ComboWarnBuzzerWait_s@ */ Scalar_FLOAT32_IEEE 0 SWC_FDC_type_CM_single_s 0.0 3600.0 /end CHARACTERISTIC
/begin CHARACTERISTIC KTQD_CurrEBrkAllow_A "" VALUE 0x0000 /* @ECU_Address@KTQD_CurrEBrkAllow_A@ */ Scalar_FLOAT32_IEEE 0 SWC_FDC_type_CM_single_A 0.0 600.0 /end CHARACTERISTIC
/begin CHARACTERISTIC KTQD_DMSLostTorqLimit_kph "" VALUE 0x0000 /* @ECU_Address@KTQD_DMSLostTorqLimit_kph@ */ Scalar_FLOAT32_IEEE 0 SWC_FDC_type_CM_single_kph 0.0 255.0 /end CHARACTERISTIC
/begin CHARACTERISTIC KTQD_DRTransferRestTq_Nm "" VALUE 0x0000 /* @ECU_Address@KTQD_DRTransferRestTq_Nm@ */ Scalar_FLOAT32_IEEE 0 SWC_FDC_type_CM_single_Nm -1000.0 1000.0 /end CHARACTERISTIC
/begin CHARACTERISTIC KTQD_DisLVChrgModeKeyDet_c "" VALUE 0x0000 /* @ECU_Address@KTQD_DisLVChrgModeKeyDet_c@ */ Scalar_FLOAT32_IEEE 0 SWC_FDC_type_CM_single_cnt 0.0 500.0 /end CHARACTERISTIC
/begin CHARACTERISTIC KTQD_DisLVChrgModeKeyDet_s "" VALUE 0x0000 /* @ECU_Address@KTQD_DisLVChrgModeKeyDet_s@ */ Scalar_FLOAT32_IEEE 0 SWC_FDC_type_CM_single_s 0.0 1000.0 /end CHARACTERISTIC
/begin CHARACTERISTIC KTQD_DisLVChrgModeUIFlash_cnt "" VALUE 0x0000 /* @ECU_Address@KTQD_DisLVChrgModeUIFlash_cnt@ */ Scalar_FLOAT32_IEEE 0 SWC_FDC_type_CM_single_cnt 0.0 255.0 /end CHARACTERISTIC
/begin CHARACTERISTIC KTQD_DisLVChrgModeUIOFF_s "" VALUE 0x0000 /* @ECU_Address@KTQD_DisLVChrgModeUIOFF_s@ */ Scalar_FLOAT32_IEEE 0 SWC_FDC_type_CM_single_s 0.0 10.0 /end CHARACTERISTIC
/begin CHARACTERISTIC KTQD_DisLVChrgModeUION_s "" VALUE 0x0000 /* @ECU_Address@KTQD_DisLVChrgModeUION_s@ */ Scalar_FLOAT32_IEEE 0 SWC_FDC_type_CM_single_s 0.0 10.0 /end CHARACTERISTIC
/begin CHARACTERISTIC KTQD_DisLVChrgModeUITimes_cnt "" VALUE 0x0000 /* @ECU_Address@KTQD_DisLVChrgModeUITimes_cnt@ */ Scalar_FLOAT32_IEEE 0 SWC_FDC_type_CM_single_cnt 0.0 255.0 /end CHARACTERISTIC
/begin CHARACTERISTIC KTQD_DisLVChrgModeUIWait_s "" VALUE 0x0000 /* @ECU_Address@KTQD_DisLVChrgModeUIWait_s@ */ Scalar_FLOAT32_IEEE 0 SWC_FDC_type_CM_single_s 0.0 100.0 /end CHARACTERISTIC
/begin CHARACTERISTIC KTQD_EBSIncMaxRegLim_pct "" VALUE 0x0000 /* @ECU_Address@KTQD_EBSIncMaxRegLim_pct@ */ Scalar_FLOAT32_IEEE 0 SWC_FDC_type_CM_single_pct 0.0 100.0 /end CHARACTERISTIC
/begin CHARACTERISTIC KTQD_EBSTqLimGain_c "" VALUE 0x0000 /* @ECU_Address@KTQD_EBSTqLimGain_c@ */ Scalar_FLOAT32_IEEE 0 SWC_FDC_type_CM_single_c 0.0 1.0 /end CHARACTERISTIC
/begin CHARACTERISTIC KTQD_ECOComfortSpdLim_rpm "" VALUE 0x0000 /* @ECU_Address@KTQD_ECOComfortSpdLim_rpm@ */ Scalar_FLOAT32_IEEE 0 SWC_FDC_type_CM_single_rpm 0.0 100000.0 /end CHARACTERISTIC
/begin CHARACTERISTIC KTQD_ECPVCUAcclLim_mps "" VALUE 0x0000 /* @ECU_Address@KTQD_ECPVCUAcclLim_mps@ */ Scalar_FLOAT32_IEEE 0 SWC_FDC_type_CM_single_mps2 0.0 10.0 /end CHARACTERISTIC
/begin CHARACTERISTIC KTQD_ECPVCUSpdLim_kph "" VALUE 0x0000 /* @ECU_Address@KTQD_ECPVCUSpdLim_kph@ */ Scalar_FLOAT32_IEEE 0 SWC_FDC_type_CM_single_kph 0.0 300.0 /end CHARACTERISTIC
/begin CHARACTERISTIC KTQD_EMTqModeAPSAct_pct "" VALUE 0x0000 /* @ECU_Address@KTQD_EMTqModeAPSAct_pct@ */ Scalar_FLOAT32_IEEE 0 SWC_FDC_type_CM_single_pct 0.0 100.0 /end CHARACTERISTIC
/begin CHARACTERISTIC KTQD_EnLVChrgModeKeyDet_cnt "" VALUE 0x0000 /* @ECU_Address@KTQD_EnLVChrgModeKeyDet_cnt@ */ Scalar_FLOAT32_IEEE 0 SWC_FDC_type_CM_single_cnt 0.0 500.0 /end CHARACTERISTIC
/begin CHARACTERISTIC KTQD_EnLVChrgModeUIFlash_cnt "" VALUE 0x0000 /* @ECU_Address@KTQD_EnLVChrgModeUIFlash_cnt@ */ Scalar_FLOAT32_IEEE 0 SWC_FDC_type_CM_single_cnt 0.0 255.0 /end CHARACTERISTIC
/begin CHARACTERISTIC KTQD_EnLVChrgModeUIOFF_s "" VALUE 0x0000 /* @ECU_Address@KTQD_EnLVChrgModeUIOFF_s@ */ Scalar_FLOAT32_IEEE 0 SWC_FDC_type_CM_single_s 0.0 10.0 /end CHARACTERISTIC
/begin CHARACTERISTIC KTQD_EnLVChrgModeUION_s "" VALUE 0x0000 /* @ECU_Address@KTQD_EnLVChrgModeUION_s@ */ Scalar_FLOAT32_IEEE 0 SWC_FDC_type_CM_single_s 0.0 10.0 /end CHARACTERISTIC
/begin CHARACTERISTIC KTQD_EnLVChrgModeUITimes_cnt "" VALUE 0x0000 /* @ECU_Address@KTQD_EnLVChrgModeUITimes_cnt@ */ Scalar_FLOAT32_IEEE 0 SWC_FDC_type_CM_single_cnt 0.0 255.0 /end CHARACTERISTIC
/begin CHARACTERISTIC KTQD_EnLVChrgModeUIWait_s "" VALUE 0x0000 /* @ECU_Address@KTQD_EnLVChrgModeUIWait_s@ */ Scalar_FLOAT32_IEEE 0 SWC_FDC_type_CM_single_s 0.0 100.0 /end CHARACTERISTIC
/begin CHARACTERISTIC KTQD_EnLVChrgModekeyDet_s "" VALUE 0x0000 /* @ECU_Address@KTQD_EnLVChrgModekeyDet_s@ */ Scalar_FLOAT32_IEEE 0 SWC_FDC_type_CM_single_s 0.0 1000.0 /end CHARACTERISTIC
/begin CHARACTERISTIC KTQD_GearFlashSetTime_s "" VALUE 0x0000 /* @ECU_Address@KTQD_GearFlashSetTime_s@ */ Scalar_FLOAT32_IEEE 0 SWC_FDC_type_CM_single_s 0.0 10.0 /end CHARACTERISTIC
/begin CHARACTERISTIC KTQD_GearRatio_rate "" VALUE 0x0000 /* @ECU_Address@KTQD_GearRatio_rate@ */ Scalar_FLOAT32_IEEE 0 SWC_FDC_type_CM_single_rate 0.0 20.0 /end CHARACTERISTIC
/begin CHARACTERISTIC KTQD_MCULostLimitTorq_gain "" VALUE 0x0000 /* @ECU_Address@KTQD_MCULostLimitTorq_gain@ */ Scalar_FLOAT32_IEEE 0 SWC_FDC_type_CM_single_Gain 0.0 10.0 /end CHARACTERISTIC
/begin CHARACTERISTIC KTQD_MCUMaxRefTorq_Nm "" VALUE 0x0000 /* @ECU_Address@KTQD_MCUMaxRefTorq_Nm@ */ Scalar_FLOAT32_IEEE 0 SWC_FDC_type_CM_single_Nm -100000.0 100000.0 /end CHARACTERISTIC
/begin CHARACTERISTIC KTQD_MotorOverDev_rpm "" VALUE 0x0000 /* @ECU_Address@KTQD_MotorOverDev_rpm@ */ Scalar_FLOAT32_IEEE 0 SWC_FDC_type_CM_single_rpm 0.0 500.0 /end CHARACTERISTIC
/begin CHARACTERISTIC KTQD_MotoringTqDemN_Nm "" VALUE 0x0000 /* @ECU_Address@KTQD_MotoringTqDemN_Nm@ */ Scalar_FLOAT32_IEEE 0 SWC_FDC_type_CM_single_Nm -100000.0 100000.0 /end CHARACTERISTIC
/begin CHARACTERISTIC KTQD_PwrFailWarnBuzzerFlash_cnt "" VALUE 0x0000 /* @ECU_Address@KTQD_PwrFailWarnBuzzerFlash_cnt@ */ Scalar_FLOAT32_IEEE 0 SWC_FDC_type_CM_single_s 0.0 3600.0 /end CHARACTERISTIC
/begin CHARACTERISTIC KTQD_PwrFailWarnBuzzerOff_s "" VALUE 0x0000 /* @ECU_Address@KTQD_PwrFailWarnBuzzerOff_s@ */ Scalar_FLOAT32_IEEE 0 SWC_FDC_type_CM_single_s 0.0 3600.0 /end CHARACTERISTIC
/begin CHARACTERISTIC KTQD_PwrFailWarnBuzzerOn_s "" VALUE 0x0000 /* @ECU_Address@KTQD_PwrFailWarnBuzzerOn_s@ */ Scalar_FLOAT32_IEEE 0 SWC_FDC_type_CM_single_s 0.0 3600.0 /end CHARACTERISTIC
/begin CHARACTERISTIC KTQD_PwrFailWarnBuzzerWait_s "" VALUE 0x0000 /* @ECU_Address@KTQD_PwrFailWarnBuzzerWait_s@ */ Scalar_FLOAT32_IEEE 0 SWC_FDC_type_CM_single_s 0.0 3600.0 /end CHARACTERISTIC
/begin CHARACTERISTIC KTQD_PwrUpWarnBuzzerFlash_cnt "" VALUE 0x0000 /* @ECU_Address@KTQD_PwrUpWarnBuzzerFlash_cnt@ */ Scalar_FLOAT32_IEEE 0 SWC_FDC_type_CM_single_s 0.0 3600.0 /end CHARACTERISTIC
/begin CHARACTERISTIC KTQD_PwrUpWarnBuzzerOff_s "" VALUE 0x0000 /* @ECU_Address@KTQD_PwrUpWarnBuzzerOff_s@ */ Scalar_FLOAT32_IEEE 0 SWC_FDC_type_CM_single_s 0.0 3600.0 /end CHARACTERISTIC
/begin CHARACTERISTIC KTQD_PwrUpWarnBuzzerOn_s "" VALUE 0x0000 /* @ECU_Address@KTQD_PwrUpWarnBuzzerOn_s@ */ Scalar_FLOAT32_IEEE 0 SWC_FDC_type_CM_single_s 0.0 3600.0 /end CHARACTERISTIC
/begin CHARACTERISTIC KTQD_PwrUpWarnBuzzerWait_s "" VALUE 0x0000 /* @ECU_Address@KTQD_PwrUpWarnBuzzerWait_s@ */ Scalar_FLOAT32_IEEE 0 SWC_FDC_type_CM_single_s 0.0 3600.0 /end CHARACTERISTIC
/begin CHARACTERISTIC KTQD_ReadyBuzzDelayTime_s "" VALUE 0x0000 /* @ECU_Address@KTQD_ReadyBuzzDelayTime_s@ */ Scalar_FLOAT32_IEEE 0 SWC_FDC_type_CM_single_s 0.0 3600.0 /end CHARACTERISTIC
/begin CHARACTERISTIC KTQD_ReadyBuzzOffTime_s "" VALUE 0x0000 /* @ECU_Address@KTQD_ReadyBuzzOffTime_s@ */ Scalar_FLOAT32_IEEE 0 SWC_FDC_type_CM_single_s 0.0 3600.0 /end CHARACTERISTIC
/begin CHARACTERISTIC KTQD_ReadyWarnBuzzerFlash_cnt "" VALUE 0x0000 /* @ECU_Address@KTQD_ReadyWarnBuzzerFlash_cnt@ */ Scalar_FLOAT32_IEEE 0 SWC_FDC_type_CM_single_s 0.0 3600.0 /end CHARACTERISTIC
/begin CHARACTERISTIC KTQD_ReadyWarnBuzzerOff_s "" VALUE 0x0000 /* @ECU_Address@KTQD_ReadyWarnBuzzerOff_s@ */ Scalar_FLOAT32_IEEE 0 SWC_FDC_type_CM_single_s 0.0 3600.0 /end CHARACTERISTIC
/begin CHARACTERISTIC KTQD_ReadyWarnBuzzerOn_s "" VALUE 0x0000 /* @ECU_Address@KTQD_ReadyWarnBuzzerOn_s@ */ Scalar_FLOAT32_IEEE 0 SWC_FDC_type_CM_single_s 0.0 3600.0 /end CHARACTERISTIC
/begin CHARACTERISTIC KTQD_ReadyWarnBuzzerWait_s "" VALUE 0x0000 /* @ECU_Address@KTQD_ReadyWarnBuzzerWait_s@ */ Scalar_FLOAT32_IEEE 0 SWC_FDC_type_CM_single_s 0.0 3600.0 /end CHARACTERISTIC
/begin CHARACTERISTIC KTQD_RefMotorPower_kW "" VALUE 0x0000 /* @ECU_Address@KTQD_RefMotorPower_kW@ */ Scalar_FLOAT32_IEEE 0 SWC_FDC_type_CM_single_kW 0.0 1000.0 /end CHARACTERISTIC
/begin CHARACTERISTIC KTQD_RotaDirRngLowTq_Nm "" VALUE 0x0000 /* @ECU_Address@KTQD_RotaDirRngLowTq_Nm@ */ Scalar_FLOAT32_IEEE 0 SWC_FDC_type_CM_single_Nm -1000.0 1000.0 /end CHARACTERISTIC
/begin CHARACTERISTIC KTQD_RotaDirRngUpTq_Nm "" VALUE 0x0000 /* @ECU_Address@KTQD_RotaDirRngUpTq_Nm@ */ Scalar_FLOAT32_IEEE 0 SWC_FDC_type_CM_single_Nm -1000.0 1000.0 /end CHARACTERISTIC
/begin CHARACTERISTIC KTQD_SOCEBrkAllow_pct "" VALUE 0x0000 /* @ECU_Address@KTQD_SOCEBrkAllow_pct@ */ Scalar_FLOAT32_IEEE 0 SWC_FDC_type_CM_single_pct 0.0 120.0 /end CHARACTERISTIC
/begin CHARACTERISTIC KTQD_SpdLimDiv_rpm "" VALUE 0x0000 /* @ECU_Address@KTQD_SpdLimDiv_rpm@ */ Scalar_FLOAT32_IEEE 0 SWC_FDC_type_CM_single_rpm 0.0 10000.0 /end CHARACTERISTIC
/begin CHARACTERISTIC KTQD_SpdLimIndFlash_cnt "" VALUE 0x0000 /* @ECU_Address@KTQD_SpdLimIndFlash_cnt@ */ Scalar_FLOAT32_IEEE 0 SWC_FDC_type_CM_single_cnt 0.0 1000.0 /end CHARACTERISTIC
/begin CHARACTERISTIC KTQD_SpdLimSatHi_kph "" VALUE 0x0000 /* @ECU_Address@KTQD_SpdLimSatHi_kph@ */ Scalar_FLOAT32_IEEE 0 SWC_FDC_type_CM_single_kph 0.0 300.0 /end CHARACTERISTIC
/begin CHARACTERISTIC KTQD_SpdLimSatLo_kph "" VALUE 0x0000 /* @ECU_Address@KTQD_SpdLimSatLo_kph@ */ Scalar_FLOAT32_IEEE 0 SWC_FDC_type_CM_single_kph 0.0 300.0 /end CHARACTERISTIC
/begin CHARACTERISTIC KTQD_TMSpd2FASpd_kph "" VALUE 0x0000 /* @ECU_Address@KTQD_TMSpd2FASpd_kph@ */ Scalar_FLOAT32_IEEE 0 SWC_FDC_type_CM_single_kph 0.0 255.0 /end CHARACTERISTIC
/begin CHARACTERISTIC KTQD_TorCtrlModeSwSmoTime_s "" VALUE 0x0000 /* @ECU_Address@KTQD_TorCtrlModeSwSmoTime_s@ */ Scalar_FLOAT32_IEEE 0 SWC_FDC_type_CM_single_s 0.0 10.0 /end CHARACTERISTIC
/begin CHARACTERISTIC KTQD_TorCtrlModeSwSmoTs_c "" VALUE 0x0000 /* @ECU_Address@KTQD_TorCtrlModeSwSmoTs_c@ */ Scalar_FLOAT32_IEEE 0 SWC_FDC_type_CM_single_c 0.0 10.0 /end CHARACTERISTIC
/begin CHARACTERISTIC KTQD_VCUMCUDemHiPosVal_rpm "" VALUE 0x0000 /* @ECU_Address@KTQD_VCUMCUDemHiPosVal_rpm@ */ Scalar_FLOAT32_IEEE 0 SWC_FDC_type_CM_single_rpm 0.0 3600.0 /end CHARACTERISTIC
/begin CHARACTERISTIC KTQD_VCUMCUDemLoNegVal_rpm "" VALUE 0x0000 /* @ECU_Address@KTQD_VCUMCUDemLoNegVal_rpm@ */ Scalar_FLOAT32_IEEE 0 SWC_FDC_type_CM_single_rpm 0.0 3600.0 /end CHARACTERISTIC
/begin CHARACTERISTIC KTQD_VCUMCUDemSpd_rpm "" VALUE 0x0000 /* @ECU_Address@KTQD_VCUMCUDemSpd_rpm@ */ Scalar_FLOAT32_IEEE 0 SWC_FDC_type_CM_single_rpm 0.0 3600.0 /end CHARACTERISTIC
/begin CHARACTERISTIC KTQD_VCUVehSpdErr_kph "" VALUE 0x0000 /* @ECU_Address@KTQD_VCUVehSpdErr_kph@ */ Scalar_FLOAT32_IEEE 0 SWC_FDC_type_CM_single_kph 0.0 1000.0 /end CHARACTERISTIC
/begin CHARACTERISTIC KTQD_VehSpdADJFactor_Factor "" VALUE 0x0000 /* @ECU_Address@KTQD_VehSpdADJFactor_Factor@ */ Scalar_FLOAT32_IEEE 0 SWC_FDC_type_CM_single_Factor 0.0 100.0 /end CHARACTERISTIC
/begin CHARACTERISTIC KTQD_VehSpdGearRatio_ratio "" VALUE 0x0000 /* @ECU_Address@KTQD_VehSpdGearRatio_ratio@ */ Scalar_FLOAT32_IEEE 0 SWC_FDC_type_CM_single_ratio 0.0 100.0 /end CHARACTERISTIC
/begin CHARACTERISTIC KTQD_VehSpdTireDiameter_m "" VALUE 0x0000 /* @ECU_Address@KTQD_VehSpdTireDiameter_m@ */ Scalar_FLOAT32_IEEE 0 SWC_FDC_type_CM_single_m 0.0 100.0 /end CHARACTERISTIC
/begin CHARACTERISTIC KTQD_VehSpdTireFactor_Factor "" VALUE 0x0000 /* @ECU_Address@KTQD_VehSpdTireFactor_Factor@ */ Scalar_FLOAT32_IEEE 0 SWC_FDC_type_CM_single_Factor 0.0 100.0 /end CHARACTERISTIC
/begin CHARACTERISTIC KTQD_noPBWarnBuzzerFlash_cnt "" VALUE 0x0000 /* @ECU_Address@KTQD_noPBWarnBuzzerFlash_cnt@ */ Scalar_FLOAT32_IEEE 0 SWC_FDC_type_CM_single_cnt 0.0 100.0 /end CHARACTERISTIC
/begin CHARACTERISTIC KTQD_noPBWarnBuzzerOff_s "" VALUE 0x0000 /* @ECU_Address@KTQD_noPBWarnBuzzerOff_s@ */ Scalar_FLOAT32_IEEE 0 SWC_FDC_type_CM_single_s 0.0 3600.0 /end CHARACTERISTIC
/begin CHARACTERISTIC KTQD_noPBWarnBuzzerOn_s "" VALUE 0x0000 /* @ECU_Address@KTQD_noPBWarnBuzzerOn_s@ */ Scalar_FLOAT32_IEEE 0 SWC_FDC_type_CM_single_s 0.0 3600.0 /end CHARACTERISTIC
/begin CHARACTERISTIC KTQD_noPBWarnBuzzerWait_s "" VALUE 0x0000 /* @ECU_Address@KTQD_noPBWarnBuzzerWait_s@ */ Scalar_FLOAT32_IEEE 0 SWC_FDC_type_CM_single_s 0.0 3600.0 /end CHARACTERISTIC
/begin CHARACTERISTIC KBCM_BSDFlashOFFT_cnt "" VALUE 0x0000 /* @ECU_Address@KBCM_BSDFlashOFFT_cnt@ */ Scalar_UWORD 0 SWC_FDC_type_CM_uint16_cnt 0.0 3000.0 /end CHARACTERISTIC
/begin CHARACTERISTIC KBCM_BSDFlashONT_cnt "" VALUE 0x0000 /* @ECU_Address@KBCM_BSDFlashONT_cnt@ */ Scalar_UWORD 0 SWC_FDC_type_CM_uint16_cnt 0.0 3000.0 /end CHARACTERISTIC
/begin CHARACTERISTIC KACC_CACPresWarn_ovrdflg_flg "" VALUE 0x0000 /* @ECU_Address@KACC_CACPresWarn_ovrdflg_flg@ */ Scalar_BOOLEAN 0 SWC_FDC_type_CM_boolean_flg 0.0 1.0 /end CHARACTERISTIC
/begin CHARACTERISTIC KACC_CACPresWarn_ovrdval_flg "" VALUE 0x0000 /* @ECU_Address@KACC_CACPresWarn_ovrdval_flg@ */ Scalar_BOOLEAN 0 SWC_FDC_type_CM_boolean_flg 0.0 1.0 /end CHARACTERISTIC
/begin CHARACTERISTIC KACC_CACPressureSWRev_flg "" VALUE 0x0000 /* @ECU_Address@KACC_CACPressureSWRev_flg@ */ Scalar_BOOLEAN 0 SWC_FDC_type_CM_boolean_flg 0.0 1.0 /end CHARACTERISTIC
/begin CHARACTERISTIC KACC_DTCACCReset_flg "" VALUE 0x0000 /* @ECU_Address@KACC_DTCACCReset_flg@ */ Scalar_BOOLEAN 0 SWC_FDC_type_CM_boolean_flg 0.0 1.0 /end CHARACTERISTIC
/begin CHARACTERISTIC KACC_ECASKneeSideSW_flg "" VALUE 0x0000 /* @ECU_Address@KACC_ECASKneeSideSW_flg@ */ Scalar_BOOLEAN 0 SWC_FDC_type_CM_boolean_flg 0.0 1.0 /end CHARACTERISTIC
/begin CHARACTERISTIC KACC_ECASSwitch_flg "" VALUE 0x0000 /* @ECU_Address@KACC_ECASSwitch_flg@ */ Scalar_BOOLEAN 0 SWC_FDC_type_CM_boolean_flg 0.0 1.0 /end CHARACTERISTIC
/begin CHARACTERISTIC KACC_EHPSCtrlModeStep2_flg "" VALUE 0x0000 /* @ECU_Address@KACC_EHPSCtrlModeStep2_flg@ */ Scalar_BOOLEAN 0 SWC_FDC_type_CM_boolean_flg 0.0 1.0 /end CHARACTERISTIC
/begin CHARACTERISTIC KACC_EcasSw1Down_flg "" VALUE 0x0000 /* @ECU_Address@KACC_EcasSw1Down_flg@ */ Scalar_BOOLEAN 0 SWC_FDC_type_CM_boolean_flg 0.0 1.0 /end CHARACTERISTIC
/begin CHARACTERISTIC KACC_EcasSw1Up_flg "" VALUE 0x0000 /* @ECU_Address@KACC_EcasSw1Up_flg@ */ Scalar_BOOLEAN 0 SWC_FDC_type_CM_boolean_flg 0.0 1.0 /end CHARACTERISTIC
/begin CHARACTERISTIC KACC_EcasSw2M2_flg "" VALUE 0x0000 /* @ECU_Address@KACC_EcasSw2M2_flg@ */ Scalar_BOOLEAN 0 SWC_FDC_type_CM_boolean_flg 0.0 1.0 /end CHARACTERISTIC
/begin CHARACTERISTIC KACC_EcasSw2Stop_flg "" VALUE 0x0000 /* @ECU_Address@KACC_EcasSw2Stop_flg@ */ Scalar_BOOLEAN 0 SWC_FDC_type_CM_boolean_flg 0.0 1.0 /end CHARACTERISTIC
/begin CHARACTERISTIC KACC_EcasSw3Knee_flg "" VALUE 0x0000 /* @ECU_Address@KACC_EcasSw3Knee_flg@ */ Scalar_BOOLEAN 0 SWC_FDC_type_CM_boolean_flg 0.0 1.0 /end CHARACTERISTIC
/begin CHARACTERISTIC KACC_EcasSw3M1_flg "" VALUE 0x0000 /* @ECU_Address@KACC_EcasSw3M1_flg@ */ Scalar_BOOLEAN 0 SWC_FDC_type_CM_boolean_flg 0.0 1.0 /end CHARACTERISTIC
/begin CHARACTERISTIC KACC_ServiceModeCACCMD_flg "" VALUE 0x0000 /* @ECU_Address@KACC_ServiceModeCACCMD_flg@ */ Scalar_BOOLEAN 0 SWC_FDC_type_CM_boolean_flg 0.0 1.0 /end CHARACTERISTIC
/begin CHARACTERISTIC KACC_ServiceModeCACON_flg "" VALUE 0x0000 /* @ECU_Address@KACC_ServiceModeCACON_flg@ */ Scalar_BOOLEAN 0 SWC_FDC_type_CM_boolean_flg 0.0 1.0 /end CHARACTERISTIC
/begin CHARACTERISTIC KACC_ServiceModeEHPSCMD_flg "" VALUE 0x0000 /* @ECU_Address@KACC_ServiceModeEHPSCMD_flg@ */ Scalar_BOOLEAN 0 SWC_FDC_type_CM_boolean_flg 0.0 1.0 /end CHARACTERISTIC
/begin CHARACTERISTIC KACC_ServiceModeEHPSON_flg "" VALUE 0x0000 /* @ECU_Address@KACC_ServiceModeEHPSON_flg@ */ Scalar_BOOLEAN 0 SWC_FDC_type_CM_boolean_flg 0.0 1.0 /end CHARACTERISTIC
/begin CHARACTERISTIC KBCM_FireBuzzerEN_flg "" VALUE 0x0000 /* @ECU_Address@KBCM_FireBuzzerEN_flg@ */ Scalar_BOOLEAN 0 SWC_FDC_type_CM_boolean_flg 0.0 1.0 /end CHARACTERISTIC
/begin CHARACTERISTIC KPMM_ForceEntrySleep_flg "" VALUE 0x0000 /* @ECU_Address@KPMM_ForceEntrySleep_flg@ */ Scalar_BOOLEAN 0 SWC_FDC_type_CM_boolean_flg 0.0 1.0 /end CHARACTERISTIC
/begin CHARACTERISTIC KPMM_ForceMCUFailRst_flg "" VALUE 0x0000 /* @ECU_Address@KPMM_ForceMCUFailRst_flg@ */ Scalar_BOOLEAN 0 SWC_FDC_type_CM_boolean_flg 0.0 1.0 /end CHARACTERISTIC
/begin CHARACTERISTIC KPMM_TwoSysSwOFF_flg "" VALUE 0x0000 /* @ECU_Address@KPMM_TwoSysSwOFF_flg@ */ Scalar_BOOLEAN 0 SWC_FDC_type_CM_boolean_flg 0.0 1.0 /end CHARACTERISTIC
/begin CHARACTERISTIC KPMM_usePDU3in1_flg "" VALUE 0x0000 /* @ECU_Address@KPMM_usePDU3in1_flg@ */ Scalar_BOOLEAN 0 SWC_FDC_type_CM_boolean_flg 0.0 1.0 /end CHARACTERISTIC
/begin CHARACTERISTIC KPSA_AlcLockPass_ovrdflg_flg "" VALUE 0x0000 /* @ECU_Address@KPSA_AlcLockPass_ovrdflg_flg@ */ Scalar_BOOLEAN 0 SWC_FDC_type_CM_boolean_flg 0.0 1.0 /end CHARACTERISTIC
/begin CHARACTERISTIC KPSA_AlcLockPass_ovrdval_flg "" VALUE 0x0000 /* @ECU_Address@KPSA_AlcLockPass_ovrdval_flg@ */ Scalar_BOOLEAN 0 SWC_FDC_type_CM_boolean_flg 0.0 1.0 /end CHARACTERISTIC
/begin CHARACTERISTIC KPSA_FakeWakeRESET_flg "" VALUE 0x0000 /* @ECU_Address@KPSA_FakeWakeRESET_flg@ */ Scalar_BOOLEAN 0 SWC_FDC_type_CM_boolean_flg 0.0 1.0 /end CHARACTERISTIC
/begin CHARACTERISTIC KPSA_Keystatus_enum_dovrdflg "" VALUE 0x0000 /* @ECU_Address@KPSA_Keystatus_enum_dovrdflg@ */ Scalar_BOOLEAN 0 SWC_FDC_type_CM_boolean_flg 0.0 1.0 /end CHARACTERISTIC
/begin CHARACTERISTIC KTHC_EWPFaultBypassSwitch_flag "" VALUE 0x0000 /* @ECU_Address@KTHC_EWPFaultBypassSwitch_flag@ */ Scalar_BOOLEAN 0 SWC_FDC_type_CM_boolean_flag 0.0 1.0 /end CHARACTERISTIC
/begin CHARACTERISTIC KTHC_ServiceModeCoolFanCMD_flg "" VALUE 0x0000 /* @ECU_Address@KTHC_ServiceModeCoolFanCMD_flg@ */ Scalar_BOOLEAN 0 SWC_FDC_type_CM_boolean_flg 0.0 1.0 /end CHARACTERISTIC
/begin CHARACTERISTIC KTHC_ServiceModeEWPPECMD_flg "" VALUE 0x0000 /* @ECU_Address@KTHC_ServiceModeEWPPECMD_flg@ */ Scalar_BOOLEAN 0 SWC_FDC_type_CM_boolean_flg 0.0 1.0 /end CHARACTERISTIC
/begin CHARACTERISTIC KTHC_ServiceModeON_flg "" VALUE 0x0000 /* @ECU_Address@KTHC_ServiceModeON_flg@ */ Scalar_BOOLEAN 0 SWC_FDC_type_CM_boolean_flg 0.0 1.0 /end CHARACTERISTIC
/begin CHARACTERISTIC KTQD_AbsoluteMotorSpdDir_flg "" VALUE 0x0000 /* @ECU_Address@KTQD_AbsoluteMotorSpdDir_flg@ */ Scalar_BOOLEAN 0 SWC_FDC_type_CM_boolean_flg 0.0 1.0 /end CHARACTERISTIC
/begin CHARACTERISTIC KTQD_AbsoluteMotorTqDir_flg "" VALUE 0x0000 /* @ECU_Address@KTQD_AbsoluteMotorTqDir_flg@ */ Scalar_BOOLEAN 0 SWC_FDC_type_CM_boolean_flg 0.0 1.0 /end CHARACTERISTIC
/begin CHARACTERISTIC KTQD_B2VAvaPlsChgCurrValid_flg "" VALUE 0x0000 /* @ECU_Address@KTQD_B2VAvaPlsChgCurrValid_flg@ */ Scalar_BOOLEAN 0 SWC_FDC_type_CM_boolean_flg 0.0 1.0 /end CHARACTERISTIC
/begin CHARACTERISTIC KTQD_CANMsgValidECP2_flg "" VALUE 0x0000 /* @ECU_Address@KTQD_CANMsgValidECP2_flg@ */ Scalar_BOOLEAN 0 SWC_FDC_type_CM_boolean_flg 0.0 1.0 /end CHARACTERISTIC
/begin CHARACTERISTIC KTQD_CANMsgValidECP3_flg "" VALUE 0x0000 /* @ECU_Address@KTQD_CANMsgValidECP3_flg@ */ Scalar_BOOLEAN 0 SWC_FDC_type_CM_boolean_flg 0.0 1.0 /end CHARACTERISTIC
/begin CHARACTERISTIC KTQD_DoorSaftySW_flg "" VALUE 0x0000 /* @ECU_Address@KTQD_DoorSaftySW_flg@ */ Scalar_BOOLEAN 0 SWC_FDC_type_CM_boolean_flg 0.0 1.0 /end CHARACTERISTIC
/begin CHARACTERISTIC KTQD_DoorStaSourceSW_flg "" VALUE 0x0000 /* @ECU_Address@KTQD_DoorStaSourceSW_flg@ */ Scalar_BOOLEAN 0 SWC_FDC_type_CM_boolean_flg 0.0 1.0 /end CHARACTERISTIC
/begin CHARACTERISTIC KTQD_ECPVCUAcclLimSw_flg "" VALUE 0x0000 /* @ECU_Address@KTQD_ECPVCUAcclLimSw_flg@ */ Scalar_BOOLEAN 0 SWC_FDC_type_CM_boolean_flg 0.0 1.0 /end CHARACTERISTIC
/begin CHARACTERISTIC KTQD_ECPVCUCreepSW_flg "" VALUE 0x0000 /* @ECU_Address@KTQD_ECPVCUCreepSW_flg@ */ Scalar_BOOLEAN 0 SWC_FDC_type_CM_boolean_flg 0.0 1.0 /end CHARACTERISTIC
/begin CHARACTERISTIC KTQD_ECPVCUSpdLimSw_flg "" VALUE 0x0000 /* @ECU_Address@KTQD_ECPVCUSpdLimSw_flg@ */ Scalar_BOOLEAN 0 SWC_FDC_type_CM_boolean_flg 0.0 1.0 /end CHARACTERISTIC
/begin CHARACTERISTIC KTQD_HVBPwrAvailDchrgValid_flg "" VALUE 0x0000 /* @ECU_Address@KTQD_HVBPwrAvailDchrgValid_flg@ */ Scalar_BOOLEAN 0 SWC_FDC_type_CM_boolean_flg 0.0 1.0 /end CHARACTERISTIC
/begin CHARACTERISTIC KTQD_MotorSpdValid_flg "" VALUE 0x0000 /* @ECU_Address@KTQD_MotorSpdValid_flg@ */ Scalar_BOOLEAN 0 SWC_FDC_type_CM_boolean_flg 0.0 1.0 /end CHARACTERISTIC
/begin CHARACTERISTIC KTQD_SeatBeltSta_flg "" VALUE 0x0000 /* @ECU_Address@KTQD_SeatBeltSta_flg@ */ Scalar_BOOLEAN 0 SWC_FDC_type_CM_boolean_flg 0.0 1.0 /end CHARACTERISTIC
/begin CHARACTERISTIC KTQD_TDDoorSW_flg "" VALUE 0x0000 /* @ECU_Address@KTQD_TDDoorSW_flg@ */ Scalar_BOOLEAN 0 SWC_FDC_type_CM_boolean_flg 0.0 1.0 /end CHARACTERISTIC
/begin CHARACTERISTIC KACC_CP2VAutoTracH_enum "" VALUE 0x0000 /* @ECU_Address@KACC_CP2VAutoTracH_enum@ */ Scalar_UBYTE 0 SWC_FDC_type_CM_uint8_enum 0.0 15.0 /end CHARACTERISTIC
/begin CHARACTERISTIC KACC_CP2VKneeCtrlMReq_enum "" VALUE 0x0000 /* @ECU_Address@KACC_CP2VKneeCtrlMReq_enum@ */ Scalar_UBYTE 0 SWC_FDC_type_CM_uint8_enum 0.0 15.0 /end CHARACTERISTIC
/begin CHARACTERISTIC KACC_CP2VKneeReqFA_enum "" VALUE 0x0000 /* @ECU_Address@KACC_CP2VKneeReqFA_enum@ */ Scalar_UBYTE 0 SWC_FDC_type_CM_uint8_enum 0.0 15.0 /end CHARACTERISTIC
/begin CHARACTERISTIC KACC_CP2VKneeReqRA_enum "" VALUE 0x0000 /* @ECU_Address@KACC_CP2VKneeReqRA_enum@ */ Scalar_UBYTE 0 SWC_FDC_type_CM_uint8_enum 0.0 15.0 /end CHARACTERISTIC
/begin CHARACTERISTIC KACC_CP2VKneeReqRSide_enum "" VALUE 0x0000 /* @ECU_Address@KACC_CP2VKneeReqRSide_enum@ */ Scalar_UBYTE 0 SWC_FDC_type_CM_uint8_enum 0.0 15.0 /end CHARACTERISTIC
/begin CHARACTERISTIC KACC_CP2VLA1PosCmd_enum "" VALUE 0x0000 /* @ECU_Address@KACC_CP2VLA1PosCmd_enum@ */ Scalar_UBYTE 0 SWC_FDC_type_CM_uint8_enum 0.0 15.0 /end CHARACTERISTIC
/begin CHARACTERISTIC KACC_CP2VLA2PosCmd_enum "" VALUE 0x0000 /* @ECU_Address@KACC_CP2VLA2PosCmd_enum@ */ Scalar_UBYTE 0 SWC_FDC_type_CM_uint8_enum 0.0 15.0 /end CHARACTERISTIC
/begin CHARACTERISTIC KACC_CP2VLvCtrlModeReq_enum "" VALUE 0x0000 /* @ECU_Address@KACC_CP2VLvCtrlModeReq_enum@ */ Scalar_UBYTE 0 SWC_FDC_type_CM_uint8_enum 0.0 15.0 /end CHARACTERISTIC
/begin CHARACTERISTIC KACC_CP2VNLvReqFA_enum "" VALUE 0x0000 /* @ECU_Address@KACC_CP2VNLvReqFA_enum@ */ Scalar_UBYTE 0 SWC_FDC_type_CM_uint8_enum 0.0 15.0 /end CHARACTERISTIC
/begin CHARACTERISTIC KACC_CP2VNLvReqRA_enum "" VALUE 0x0000 /* @ECU_Address@KACC_CP2VNLvReqRA_enum@ */ Scalar_UBYTE 0 SWC_FDC_type_CM_uint8_enum 0.0 15.0 /end CHARACTERISTIC
/begin CHARACTERISTIC KACC_DTCCACOverrun_cnt "" VALUE 0x0000 /* @ECU_Address@KACC_DTCCACOverrun_cnt@ */ Scalar_UBYTE 0 SWC_FDC_type_CM_uint8_cnt 0.0 255.0 /end CHARACTERISTIC
/begin CHARACTERISTIC KBCM_BSDRedMode_enum "" VALUE 0x0000 /* @ECU_Address@KBCM_BSDRedMode_enum@ */ Scalar_UBYTE 0 SWC_FDC_type_CM_uint8_enum 0.0 255.0 /end CHARACTERISTIC
/begin CHARACTERISTIC KBCM_BSDWarnReqLv_enum "" VALUE 0x0000 /* @ECU_Address@KBCM_BSDWarnReqLv_enum@ */ Scalar_UBYTE 0 SWC_FDC_type_CM_uint8_enum 0.0 255.0 /end CHARACTERISTIC
/begin CHARACTERISTIC KDHP_ResetPedalZeroPosReq_enum "" VALUE 0x0000 /* @ECU_Address@KDHP_ResetPedalZeroPosReq_enum@ */ Scalar_UBYTE 0 SWC_FDC_type_CM_uint8_enum 0.0 255.0 /end CHARACTERISTIC
/begin CHARACTERISTIC KPMM_ACPrechrgRlySts_enum "" VALUE 0x0000 /* @ECU_Address@KPMM_ACPrechrgRlySts_enum@ */ Scalar_UBYTE 0 SWC_FDC_type_CM_uint8_enum 0.0 255.0 /end CHARACTERISTIC
/begin CHARACTERISTIC KPMM_VSPFunc_enum "" VALUE 0x0000 /* @ECU_Address@KPMM_VSPFunc_enum@ */ Scalar_UBYTE 0 SWC_FDC_type_CM_uint8_enum 0.0 255.0 /end CHARACTERISTIC
/begin CHARACTERISTIC KPMM_VSPTurnL_enum "" VALUE 0x0000 /* @ECU_Address@KPMM_VSPTurnL_enum@ */ Scalar_UBYTE 0 SWC_FDC_type_CM_uint8_enum 0.0 255.0 /end CHARACTERISTIC
/begin CHARACTERISTIC KPMM_VSPTurnR_enum "" VALUE 0x0000 /* @ECU_Address@KPMM_VSPTurnR_enum@ */ Scalar_UBYTE 0 SWC_FDC_type_CM_uint8_enum 0.0 255.0 /end CHARACTERISTIC
/begin CHARACTERISTIC KPSA_Keystatus_enum_dovrdval "" VALUE 0x0000 /* @ECU_Address@KPSA_Keystatus_enum_dovrdval@ */ Scalar_UBYTE 0 SWC_FDC_type_CM_uint8_enum 0.0 2.0 /end CHARACTERISTIC
/begin CHARACTERISTIC KPSA_VehspdSafe_kph "" VALUE 0x0000 /* @ECU_Address@KPSA_VehspdSafe_kph@ */ Scalar_UBYTE 0 SWC_FDC_type_CM_uint8_kph 0.0 15.0 /end CHARACTERISTIC
/begin CHARACTERISTIC KTQD_ECPVCUDRM_enum "" VALUE 0x0000 /* @ECU_Address@KTQD_ECPVCUDRM_enum@ */ Scalar_UBYTE 0 SWC_FDC_type_CM_uint8_enum 0.0 15.0 /end CHARACTERISTIC
/begin CHARACTERISTIC KTQD_ECPVCURRegenSW_enum "" VALUE 0x0000 /* @ECU_Address@KTQD_ECPVCURRegenSW_enum@ */ Scalar_UBYTE 0 SWC_FDC_type_CM_uint8_enum 0.0 15.0 /end CHARACTERISTIC
/begin CHARACTERISTIC KTQD_FRHalbrakeReq_enum "" VALUE 0x0000 /* @ECU_Address@KTQD_FRHalbrakeReq_enum@ */ Scalar_UBYTE 0 SWC_FDC_type_CM_uint8_enum 0.0 15.0 /end CHARACTERISTIC
/begin CHARACTERISTIC KTQD_MCUAlarmCode_cnt "" VALUE 0x0000 /* @ECU_Address@KTQD_MCUAlarmCode_cnt@ */ Scalar_UBYTE 0 SWC_FDC_type_CM_uint8_enum 0.0 255.0 /end CHARACTERISTIC
/begin CHARACTERISTIC KTQD_MDHalbrakeReq_enum "" VALUE 0x0000 /* @ECU_Address@KTQD_MDHalbrakeReq_enum@ */ Scalar_UBYTE 0 SWC_FDC_type_CM_uint8_enum 0.0 15.0 /end CHARACTERISTIC
/begin CHARACTERISTIC KTQD_RecuperHighSta_enum "" VALUE 0x0000 /* @ECU_Address@KTQD_RecuperHighSta_enum@ */ Scalar_UBYTE 0 SWC_FDC_type_CM_uint8_enum 0.0 255.0 /end CHARACTERISTIC
/begin CHARACTERISTIC KTQD_TDHalbrakeReq_enum "" VALUE 0x0000 /* @ECU_Address@KTQD_TDHalbrakeReq_enum@ */ Scalar_UBYTE 0 SWC_FDC_type_CM_uint8_enum 0.0 15.0 /end CHARACTERISTIC
/begin MEASUREMENT VTHC_OriginalEWPSpdDem_rpm "" FLOAT32_IEEE SWC_FDC_type_CM_single_rpm 0 0 0.0 300000.0 ECU_ADDRESS 0x0000 /* @ECU_Address@VTHC_OriginalEWPSpdDem_rpm@ */ /end MEASUREMENT
/begin MEASUREMENT VTHC_EWPPEReq_rpm "" FLOAT32_IEEE SWC_FDC_type_CM_single_rpm 0 0 0.0 6375.0 ECU_ADDRESS 0x0000 /* @ECU_Address@VTHC_EWPPEReq_rpm@ */ /end MEASUREMENT
/begin MEASUREMENT VTHC_CoolFanReq_pct "" FLOAT32_IEEE SWC_FDC_type_CM_single_pct 0 0 0.0 100.0 ECU_ADDRESS 0x0000 /* @ECU_Address@VTHC_CoolFanReq_pct@ */ /end MEASUREMENT
/begin MEASUREMENT VACC_StrWhlAngLast_rad "" FLOAT32_IEEE SWC_FDC_type_CM_single_rad 0 0 -900.0 900.0 ECU_ADDRESS 0x0000 /* @ECU_Address@VACC_StrWhlAngLast_rad@ */ /end MEASUREMENT
/begin MEASUREMENT VACC_EHPSSpdCtrlMode_enum "" FLOAT32_IEEE SWC_FDC_type_CM_single_enum 0 0 0.0 3.0 ECU_ADDRESS 0x0000 /* @ECU_Address@VACC_EHPSSpdCtrlMode_enum@ */ /end MEASUREMENT
/begin MEASUREMENT VACC_EHPSSpdCtrlMode_rpm "" FLOAT32_IEEE SWC_FDC_type_CM_single_rpm 0 0 -100000.0 100000.0 ECU_ADDRESS 0x0000 /* @ECU_Address@VACC_EHPSSpdCtrlMode_rpm@ */ /end MEASUREMENT
/begin MEASUREMENT VACC_ACCEHPSDemSpd_rpm "" FLOAT32_IEEE SWC_FDC_type_CM_single_rpm 0 0 -100000.0 100000.0 ECU_ADDRESS 0x0000 /* @ECU_Address@VACC_ACCEHPSDemSpd_rpm@ */ /end MEASUREMENT
/begin MEASUREMENT VACC_EHPSMotorDemSpd_rpm "" FLOAT32_IEEE SWC_FDC_type_CM_single_rpm 0 0 -5000.0 27767.5 ECU_ADDRESS 0x0000 /* @ECU_Address@VACC_EHPSMotorDemSpd_rpm@ */ /end MEASUREMENT
/begin MEASUREMENT VACC_ASC2DamStiffReqFA_pct "" FLOAT32_IEEE SWC_FDC_type_CM_single_pct 0 0 -150.0 150.0 ECU_ADDRESS 0x0000 /* @ECU_Address@VACC_ASC2DamStiffReqFA_pct@ */ /end MEASUREMENT
/begin MEASUREMENT VACC_ASC2DamStiffReqRA_pct "" FLOAT32_IEEE SWC_FDC_type_CM_single_pct 0 0 -150.0 150.0 ECU_ADDRESS 0x0000 /* @ECU_Address@VACC_ASC2DamStiffReqRA_pct@ */ /end MEASUREMENT
/begin MEASUREMENT VACC_ASC2DamStiffReqLA_pct "" FLOAT32_IEEE SWC_FDC_type_CM_single_pct 0 0 -150.0 150.0 ECU_ADDRESS 0x0000 /* @ECU_Address@VACC_ASC2DamStiffReqLA_pct@ */ /end MEASUREMENT
/begin MEASUREMENT VACC_AirPressureFDisp_kpa "" FLOAT32_IEEE SWC_FDC_type_CM_single_kpa 0 0 0.0 2400.0 ECU_ADDRESS 0x0000 /* @ECU_Address@VACC_AirPressureFDisp_kpa@ */ /end MEASUREMENT
/begin MEASUREMENT VACC_AirPressureRDisp_kpa "" FLOAT32_IEEE SWC_FDC_type_CM_single_kpa 0 0 0.0 2400.0 ECU_ADDRESS 0x0000 /* @ECU_Address@VACC_AirPressureRDisp_kpa@ */ /end MEASUREMENT
/begin MEASUREMENT VACC_AirPressurePDisp_kpa "" FLOAT32_IEEE SWC_FDC_type_CM_single_kpa 0 0 0.0 2400.0 ECU_ADDRESS 0x0000 /* @ECU_Address@VACC_AirPressurePDisp_kpa@ */ /end MEASUREMENT
/begin MEASUREMENT VACC_VCUEACpumpTemp_C "" FLOAT32_IEEE SWC_FDC_type_CM_single_C 0 0 -150.0 150.0 ECU_ADDRESS 0x0000 /* @ECU_Address@VACC_VCUEACpumpTemp_C@ */ /end MEASUREMENT
/begin MEASUREMENT VACC_EACSpdDemand_rpm "" FLOAT32_IEEE SWC_FDC_type_CM_single_rpm 0 0 -100000.0 100000.0 ECU_ADDRESS 0x0000 /* @ECU_Address@VACC_EACSpdDemand_rpm@ */ /end MEASUREMENT
/begin MEASUREMENT VTQD_VCUTMVehSpd_kph "" FLOAT32_IEEE SWC_FDC_type_CM_single_kph 0 0 -300.0 300.0 ECU_ADDRESS 0x0000 /* @ECU_Address@VTQD_VCUTMVehSpd_kph@ */ /end MEASUREMENT
/begin MEASUREMENT VTQD_VCUVehSpd_kph "" FLOAT32_IEEE SWC_FDC_type_CM_single_kph 0 0 0.0 255.0 ECU_ADDRESS 0x0000 /* @ECU_Address@VTQD_VCUVehSpd_kph@ */ /end MEASUREMENT
/begin MEASUREMENT VTQD_TqTargetShaftDrivSpd_rpm "" FLOAT32_IEEE SWC_FDC_type_CM_single_rpm 0 0 -100000.0 100000.0 ECU_ADDRESS 0x0000 /* @ECU_Address@VTQD_TqTargetShaftDrivSpd_rpm@ */ /end MEASUREMENT
/begin MEASUREMENT VTQD_TqTargetShaftRevSpd_rpm "" FLOAT32_IEEE SWC_FDC_type_CM_single_rpm 0 0 -100000.0 100000.0 ECU_ADDRESS 0x0000 /* @ECU_Address@VTQD_TqTargetShaftRevSpd_rpm@ */ /end MEASUREMENT
/begin MEASUREMENT VTQD_TqTargetShaftSpd_rpm "" FLOAT32_IEEE SWC_FDC_type_CM_single_rpm 0 0 -100000.0 100000.0 ECU_ADDRESS 0x0000 /* @ECU_Address@VTQD_TqTargetShaftSpd_rpm@ */ /end MEASUREMENT
/begin MEASUREMENT VTQD_PTAvailMotTq_Nm "" FLOAT32_IEEE SWC_FDC_type_CM_single_Nm 0 0 -100000.0 100000.0 ECU_ADDRESS 0x0000 /* @ECU_Address@VTQD_PTAvailMotTq_Nm@ */ /end MEASUREMENT
/begin MEASUREMENT VTQD_EM1ReqTorqLimDriv_Nm "" FLOAT32_IEEE SWC_FDC_type_CM_single_Nm 0 0 -100000.0 100000.0 ECU_ADDRESS 0x0000 /* @ECU_Address@VTQD_EM1ReqTorqLimDriv_Nm@ */ /end MEASUREMENT
/begin MEASUREMENT VTQD_EM1ReqTorqLimBrk_Nm "" FLOAT32_IEEE SWC_FDC_type_CM_single_Nm 0 0 -100000.0 100000.0 ECU_ADDRESS 0x0000 /* @ECU_Address@VTQD_EM1ReqTorqLimBrk_Nm@ */ /end MEASUREMENT
/begin MEASUREMENT VTQD_DisFlashCycleTime_s "" FLOAT32_IEEE SWC_FDC_type_CM_single_s 0 0 0.0 3600.0 ECU_ADDRESS 0x0000 /* @ECU_Address@VTQD_DisFlashCycleTime_s@ */ /end MEASUREMENT
/begin MEASUREMENT VTQD_EnFlashCycleTime_s "" FLOAT32_IEEE SWC_FDC_type_CM_single_s 0 0 0.0 3600.0 ECU_ADDRESS 0x0000 /* @ECU_Address@VTQD_EnFlashCycleTime_s@ */ /end MEASUREMENT
/begin MEASUREMENT VTQD_DriverTqDem_Nm "" FLOAT32_IEEE SWC_FDC_type_CM_single_Nm 0 0 -100000.0 100000.0 ECU_ADDRESS 0x0000 /* @ECU_Address@VTQD_DriverTqDem_Nm@ */ /end MEASUREMENT
/begin MEASUREMENT VTQD_CoorTqDemRr_Nm "" FLOAT32_IEEE SWC_FDC_type_CM_single_Nm 0 0 -100000.0 100000.0 ECU_ADDRESS 0x0000 /* @ECU_Address@VTQD_CoorTqDemRr_Nm@ */ /end MEASUREMENT
/begin MEASUREMENT VTQD_PTAvailGenTq_Nm "" FLOAT32_IEEE SWC_FDC_type_CM_single_Nm 0 0 -100000.0 100000.0 ECU_ADDRESS 0x0000 /* @ECU_Address@VTQD_PTAvailGenTq_Nm@ */ /end MEASUREMENT
/begin MEASUREMENT VTQD_AfterAvailableTqDemRr_Nm "" FLOAT32_IEEE SWC_FDC_type_CM_single_Nm 0 0 -100000.0 100000.0 ECU_ADDRESS 0x0000 /* @ECU_Address@VTQD_AfterAvailableTqDemRr_Nm@ */ /end MEASUREMENT
/begin MEASUREMENT VTQD_RrRampTq_Nm "" FLOAT32_IEEE SWC_FDC_type_CM_single_Nm 0 0 -100000.0 100000.0 ECU_ADDRESS 0x0000 /* @ECU_Address@VTQD_RrRampTq_Nm@ */ /end MEASUREMENT
/begin MEASUREMENT VTQD_TMSpd_rpm "" FLOAT32_IEEE SWC_FDC_type_CM_single_rpm 0 0 -100000.0 100000.0 ECU_ADDRESS 0x0000 /* @ECU_Address@VTQD_TMSpd_rpm@ */ /end MEASUREMENT
/begin MEASUREMENT VTQD_SpecSpdLim_rpm "" FLOAT32_IEEE SWC_FDC_type_CM_single_rpm 0 0 -100000.0 100000.0 ECU_ADDRESS 0x0000 /* @ECU_Address@VTQD_SpecSpdLim_rpm@ */ /end MEASUREMENT
/begin MEASUREMENT VTQD_VCUMCUDemHiPosVal_rpm "" FLOAT32_IEEE SWC_FDC_type_CM_single_rpm 0 0 -100000.0 100000.0 ECU_ADDRESS 0x0000 /* @ECU_Address@VTQD_VCUMCUDemHiPosVal_rpm@ */ /end MEASUREMENT
/begin MEASUREMENT VTQD_TMTqReq_Nm "" FLOAT32_IEEE SWC_FDC_type_CM_single_Nm 0 0 -100000.0 100000.0 ECU_ADDRESS 0x0000 /* @ECU_Address@VTQD_TMTqReq_Nm@ */ /end MEASUREMENT
/begin MEASUREMENT VTQD_ADASDriverDemWhTq_Nm "" FLOAT32_IEEE SWC_FDC_type_CM_single_Nm 0 0 -100000.0 100000.0 ECU_ADDRESS 0x0000 /* @ECU_Address@VTQD_ADASDriverDemWhTq_Nm@ */ /end MEASUREMENT
/begin MEASUREMENT VTQD_RealWhTq_Nm "" FLOAT32_IEEE SWC_FDC_type_CM_single_Nm 0 0 -100000.0 100000.0 ECU_ADDRESS 0x0000 /* @ECU_Address@VTQD_RealWhTq_Nm@ */ /end MEASUREMENT
/begin MEASUREMENT VTQD_EC1EMRefTorq_Nm "" FLOAT32_IEEE SWC_FDC_type_CM_single_Nm 0 0 -100000.0 100000.0 ECU_ADDRESS 0x0000 /* @ECU_Address@VTQD_EC1EMRefTorq_Nm@ */ /end MEASUREMENT
/begin MEASUREMENT VTQD_EEC3NFricPercTorq_pct "" FLOAT32_IEEE SWC_FDC_type_CM_single_pct 0 0 -125.0 125.0 ECU_ADDRESS 0x0000 /* @ECU_Address@VTQD_EEC3NFricPercTorq_pct@ */ /end MEASUREMENT
/begin MEASUREMENT VTQD_EMRC1ActEMpTrq_pct "" FLOAT32_IEEE SWC_FDC_type_CM_single_pct 0 0 -125.0 125.0 ECU_ADDRESS 0x0000 /* @ECU_Address@VTQD_EMRC1ActEMpTrq_pct@ */ /end MEASUREMENT
/begin MEASUREMENT VTQD_EMRC1ActEMOutSftSpd_rpm "" FLOAT32_IEEE SWC_FDC_type_CM_single_rpm 0 0 -100000.0 100000.0 ECU_ADDRESS 0x0000 /* @ECU_Address@VTQD_EMRC1ActEMOutSftSpd_rpm@ */ /end MEASUREMENT
/begin MEASUREMENT VTQD_EMRC1ActMaxAvaEMRecpTrq_pct "" FLOAT32_IEEE SWC_FDC_type_CM_single_pct 0 0 -125.0 125.0 ECU_ADDRESS 0x0000 /* @ECU_Address@VTQD_EMRC1ActMaxAvaEMRecpTrq_pct@ */ /end MEASUREMENT
/begin MEASUREMENT VTQD_ETC2ActDriveDirect_enum "" FLOAT32_IEEE SWC_FDC_type_CM_single_enum 0 0 -10.0 10.0 ECU_ADDRESS 0x0000 /* @ECU_Address@VTQD_ETC2ActDriveDirect_enum@ */ /end MEASUREMENT
/begin MEASUREMENT VTQD_EVCU1EMotorSpd_rpm "" FLOAT32_IEEE SWC_FDC_type_CM_single_rpm 0 0 -100000.0 100000.0 ECU_ADDRESS 0x0000 /* @ECU_Address@VTQD_EVCU1EMotorSpd_rpm@ */ /end MEASUREMENT
/begin MEASUREMENT VTQD_EVCU1MotorTorque_pct "" FLOAT32_IEEE SWC_FDC_type_CM_single_pct 0 0 -125.0 125.0 ECU_ADDRESS 0x0000 /* @ECU_Address@VTQD_EVCU1MotorTorque_pct@ */ /end MEASUREMENT
/begin MEASUREMENT VTQD_EVCU1MotorPower_pct "" FLOAT32_IEEE SWC_FDC_type_CM_single_pct 0 0 -125.0 125.0 ECU_ADDRESS 0x0000 /* @ECU_Address@VTQD_EVCU1MotorPower_pct@ */ /end MEASUREMENT
/begin MEASUREMENT VTQD_EVCU1EMotorPerformance_pct "" FLOAT32_IEEE SWC_FDC_type_CM_single_pct 0 0 -125.0 125.0 ECU_ADDRESS 0x0000 /* @ECU_Address@VTQD_EVCU1EMotorPerformance_pct@ */ /end MEASUREMENT
/begin MEASUREMENT VTQD_EVCU2MaxTorqAvail_pct "" FLOAT32_IEEE SWC_FDC_type_CM_single_pct 0 0 -125.0 125.0 ECU_ADDRESS 0x0000 /* @ECU_Address@VTQD_EVCU2MaxTorqAvail_pct@ */ /end MEASUREMENT
/begin MEASUREMENT VTQD_EVCU2MinTorqAvail_pct "" FLOAT32_IEEE SWC_FDC_type_CM_single_pct 0 0 -125.0 125.0 ECU_ADDRESS 0x0000 /* @ECU_Address@VTQD_EVCU2MinTorqAvail_pct@ */ /end MEASUREMENT
/begin MEASUREMENT VTQD_VCUMCUDemLoNegVal_rpm "" FLOAT32_IEEE SWC_FDC_type_CM_single_rpm 0 0 -100000.0 100000.0 ECU_ADDRESS 0x0000 /* @ECU_Address@VTQD_VCUMCUDemLoNegVal_rpm@ */ /end MEASUREMENT
/begin MEASUREMENT VTQD_VCUMCUDemSpd_rpm "" FLOAT32_IEEE SWC_FDC_type_CM_single_rpm 0 0 -100000.0 100000.0 ECU_ADDRESS 0x0000 /* @ECU_Address@VTQD_VCUMCUDemSpd_rpm@ */ /end MEASUREMENT
/begin MEASUREMENT VTQD_RC1RefRetTrq_Nm "" FLOAT32_IEEE SWC_FDC_type_CM_single_Nm 0 0 -100000.0 100000.0 ECU_ADDRESS 0x0000 /* @ECU_Address@VTQD_RC1RefRetTrq_Nm@ */ /end MEASUREMENT
/begin MEASUREMENT VTQD_RrRampInpTqRr_Nm "" FLOAT32_IEEE SWC_FDC_type_CM_single_Nm 0 0 -100000.0 100000.0 ECU_ADDRESS 0x0000 /* @ECU_Address@VTQD_RrRampInpTqRr_Nm@ */ /end MEASUREMENT
/begin MEASUREMENT VTQD_CoorTqDemFr_Nm "" FLOAT32_IEEE SWC_FDC_type_CM_single_Nm 0 0 -100000.0 100000.0 ECU_ADDRESS 0x0000 /* @ECU_Address@VTQD_CoorTqDemFr_Nm@ */ /end MEASUREMENT
/begin MEASUREMENT VTQD_EC1EMMaxMEngOvrSP7_rpm "" FLOAT32_IEEE SWC_FDC_type_CM_single_rpm 0 0 -100000.0 100000.0 ECU_ADDRESS 0x0000 /* @ECU_Address@VTQD_EC1EMMaxMEngOvrSP7_rpm@ */ /end MEASUREMENT
/begin MEASUREMENT VTQD_EC1EMReqTrqCtrlUpLmt_pct "" FLOAT32_IEEE SWC_FDC_type_CM_single_pct 0 0 -125.0 125.0 ECU_ADDRESS 0x0000 /* @ECU_Address@VTQD_EC1EMReqTrqCtrlUpLmt_pct@ */ /end MEASUREMENT
/begin MEASUREMENT VTQD_EC1EMMaxMOvrTmt_s "" FLOAT32_IEEE SWC_FDC_type_CM_single_s 0 0 0.0 3600.0 ECU_ADDRESS 0x0000 /* @ECU_Address@VTQD_EC1EMMaxMOvrTmt_s@ */ /end MEASUREMENT
/begin MEASUREMENT VTQD_EC1EMSpdHdleP6_rpm "" FLOAT32_IEEE SWC_FDC_type_CM_single_rpm 0 0 -100000.0 100000.0 ECU_ADDRESS 0x0000 /* @ECU_Address@VTQD_EC1EMSpdHdleP6_rpm@ */ /end MEASUREMENT
/begin MEASUREMENT VTQD_EC1EMGainEndSpdGvn_gain "" FLOAT32_IEEE SWC_FDC_type_CM_single_gain 0 0 0.0 100000.0 ECU_ADDRESS 0x0000 /* @ECU_Address@VTQD_EC1EMGainEndSpdGvn_gain@ */ /end MEASUREMENT
/begin MEASUREMENT VTQD_EC1EMReqSpdCtrlLoLmt_rpm "" FLOAT32_IEEE SWC_FDC_type_CM_single_rpm 0 0 -100000.0 100000.0 ECU_ADDRESS 0x0000 /* @ECU_Address@VTQD_EC1EMReqSpdCtrlLoLmt_rpm@ */ /end MEASUREMENT
/begin MEASUREMENT VTQD_EC1EMReqSpdCtrlUpLmt_rpm "" FLOAT32_IEEE SWC_FDC_type_CM_single_rpm 0 0 -100000.0 100000.0 ECU_ADDRESS 0x0000 /* @ECU_Address@VTQD_EC1EMReqSpdCtrlUpLmt_rpm@ */ /end MEASUREMENT
/begin MEASUREMENT VTQD_EC1EMReqTrqCtrlLoLmt_pct "" FLOAT32_IEEE SWC_FDC_type_CM_single_pct 0 0 -125.0 125.0 ECU_ADDRESS 0x0000 /* @ECU_Address@VTQD_EC1EMReqTrqCtrlLoLmt_pct@ */ /end MEASUREMENT
/begin MEASUREMENT VTQD_EC1EMDefTrqLmt_rpm "" FLOAT32_IEEE SWC_FDC_type_CM_single_rpm 0 0 -100000.0 100000.0 ECU_ADDRESS 0x0000 /* @ECU_Address@VTQD_EC1EMDefTrqLmt_rpm@ */ /end MEASUREMENT
/begin MEASUREMENT VTQD_EC1EMExtRSCtrlUpLmt_rpm "" FLOAT32_IEEE SWC_FDC_type_CM_single_rpm 0 0 -100000.0 100000.0 ECU_ADDRESS 0x0000 /* @ECU_Address@VTQD_EC1EMExtRSCtrlUpLmt_rpm@ */ /end MEASUREMENT
/begin MEASUREMENT VTQD_EC1EMMomOfInertia_kgpm2 "" FLOAT32_IEEE SWC_FDC_type_CM_single_kgpm2 0 0 0.0 100000.0 ECU_ADDRESS 0x0000 /* @ECU_Address@VTQD_EC1EMMomOfInertia_kgpm2@ */ /end MEASUREMENT
/begin MEASUREMENT VTQD_EC1EMSpdIdleP3_rpm "" FLOAT32_IEEE SWC_FDC_type_CM_single_rpm 0 0 -100000.0 100000.0 ECU_ADDRESS 0x0000 /* @ECU_Address@VTQD_EC1EMSpdIdleP3_rpm@ */ /end MEASUREMENT
/begin MEASUREMENT VTQD_EC1PercTorqIdleP3_pct "" FLOAT32_IEEE SWC_FDC_type_CM_single_pct 0 0 -125.0 125.0 ECU_ADDRESS 0x0000 /* @ECU_Address@VTQD_EC1PercTorqIdleP3_pct@ */ /end MEASUREMENT
/begin MEASUREMENT VTQD_EC1EMSpdIdleP4_rpm "" FLOAT32_IEEE SWC_FDC_type_CM_single_rpm 0 0 -100000.0 100000.0 ECU_ADDRESS 0x0000 /* @ECU_Address@VTQD_EC1EMSpdIdleP4_rpm@ */ /end MEASUREMENT
/begin MEASUREMENT VTQD_EC1PercTorqIdleP4_pct "" FLOAT32_IEEE SWC_FDC_type_CM_single_pct 0 0 -125.0 125.0 ECU_ADDRESS 0x0000 /* @ECU_Address@VTQD_EC1PercTorqIdleP4_pct@ */ /end MEASUREMENT
/begin MEASUREMENT VTQD_EC1EMSpdIdleP5_rpm "" FLOAT32_IEEE SWC_FDC_type_CM_single_rpm 0 0 -100000.0 100000.0 ECU_ADDRESS 0x0000 /* @ECU_Address@VTQD_EC1EMSpdIdleP5_rpm@ */ /end MEASUREMENT
/begin MEASUREMENT VTQD_EC1PercTorqIdleP5_pct "" FLOAT32_IEEE SWC_FDC_type_CM_single_pct 0 0 -125.0 125.0 ECU_ADDRESS 0x0000 /* @ECU_Address@VTQD_EC1PercTorqIdleP5_pct@ */ /end MEASUREMENT
/begin MEASUREMENT VTQD_EC1EMSpdIdleP1_rpm "" FLOAT32_IEEE SWC_FDC_type_CM_single_rpm 0 0 -100000.0 100000.0 ECU_ADDRESS 0x0000 /* @ECU_Address@VTQD_EC1EMSpdIdleP1_rpm@ */ /end MEASUREMENT
/begin MEASUREMENT VTQD_EC1PercTorqIdleP1_pct "" FLOAT32_IEEE SWC_FDC_type_CM_single_pct 0 0 -125.0 125.0 ECU_ADDRESS 0x0000 /* @ECU_Address@VTQD_EC1PercTorqIdleP1_pct@ */ /end MEASUREMENT
/begin MEASUREMENT VTQD_EC1EMSpdIdleP2_rpm "" FLOAT32_IEEE SWC_FDC_type_CM_single_rpm 0 0 -100000.0 100000.0 ECU_ADDRESS 0x0000 /* @ECU_Address@VTQD_EC1EMSpdIdleP2_rpm@ */ /end MEASUREMENT
/begin MEASUREMENT VTQD_EC1PercTorqIdleP2_pct "" FLOAT32_IEEE SWC_FDC_type_CM_single_pct 0 0 -125.0 125.0 ECU_ADDRESS 0x0000 /* @ECU_Address@VTQD_EC1PercTorqIdleP2_pct@ */ /end MEASUREMENT
/begin MEASUREMENT VTQD_EEC3EMPressLoss_pct "" FLOAT32_IEEE SWC_FDC_type_CM_single_pct 0 0 -125.0 125.0 ECU_ADDRESS 0x0000 /* @ECU_Address@VTQD_EEC3EMPressLoss_pct@ */ /end MEASUREMENT
/begin MEASUREMENT VTQD_EMRC1ActEMpTrqHrls_pct "" FLOAT32_IEEE SWC_FDC_type_CM_single_pct 0 0 -125.0 125.0 ECU_ADDRESS 0x0000 /* @ECU_Address@VTQD_EMRC1ActEMpTrqHrls_pct@ */ /end MEASUREMENT
/begin MEASUREMENT VTQD_EMRC1DrvDemEMRtapTrq_pct "" FLOAT32_IEEE SWC_FDC_type_CM_single_pct 0 0 -125.0 125.0 ECU_ADDRESS 0x0000 /* @ECU_Address@VTQD_EMRC1DrvDemEMRtapTrq_pct@ */ /end MEASUREMENT
/begin MEASUREMENT VTQD_EMRC1RetSelNonEng_pct "" FLOAT32_IEEE SWC_FDC_type_CM_single_pct 0 0 -125.0 125.0 ECU_ADDRESS 0x0000 /* @ECU_Address@VTQD_EMRC1RetSelNonEng_pct@ */ /end MEASUREMENT
/begin MEASUREMENT VTQD_RC1RetCtrlMth_enum "" FLOAT32_IEEE SWC_FDC_type_CM_single_enum 0 0 -125.0 130.0 ECU_ADDRESS 0x0000 /* @ECU_Address@VTQD_RC1RetCtrlMth_enum@ */ /end MEASUREMENT
/begin MEASUREMENT VTQD_RC1RetSpdIdleP1_rpm "" FLOAT32_IEEE SWC_FDC_type_CM_single_rpm 0 0 -100000.0 100000.0 ECU_ADDRESS 0x0000 /* @ECU_Address@VTQD_RC1RetSpdIdleP1_rpm@ */ /end MEASUREMENT
/begin MEASUREMENT VTQD_RC1PctTrqIdleP1_pct "" FLOAT32_IEEE SWC_FDC_type_CM_single_pct 0 0 -125.0 125.0 ECU_ADDRESS 0x0000 /* @ECU_Address@VTQD_RC1PctTrqIdleP1_pct@ */ /end MEASUREMENT
/begin MEASUREMENT VTQD_RC1MaxRetSpdP2_rpm "" FLOAT32_IEEE SWC_FDC_type_CM_single_rpm 0 0 -100000.0 100000.0 ECU_ADDRESS 0x0000 /* @ECU_Address@VTQD_RC1MaxRetSpdP2_rpm@ */ /end MEASUREMENT
/begin MEASUREMENT VTQD_RC1RetSpdP2_pct "" FLOAT32_IEEE SWC_FDC_type_CM_single_pct 0 0 -125.0 125.0 ECU_ADDRESS 0x0000 /* @ECU_Address@VTQD_RC1RetSpdP2_pct@ */ /end MEASUREMENT
/begin MEASUREMENT VTQD_RC1PctTrqP3_pct "" FLOAT32_IEEE SWC_FDC_type_CM_single_pct 0 0 -125.0 125.0 ECU_ADDRESS 0x0000 /* @ECU_Address@VTQD_RC1PctTrqP3_pct@ */ /end MEASUREMENT
/begin MEASUREMENT VTQD_RC1RetSpdP4_rpm "" FLOAT32_IEEE SWC_FDC_type_CM_single_rpm 0 0 -100000.0 100000.0 ECU_ADDRESS 0x0000 /* @ECU_Address@VTQD_RC1RetSpdP4_rpm@ */ /end MEASUREMENT
/begin MEASUREMENT VTQD_RC1PctTrqP4_pct "" FLOAT32_IEEE SWC_FDC_type_CM_single_pct 0 0 -125.0 125.0 ECU_ADDRESS 0x0000 /* @ECU_Address@VTQD_RC1PctTrqP4_pct@ */ /end MEASUREMENT
/begin MEASUREMENT VTQD_RC1RetSpdPekTrqP5_Nm "" FLOAT32_IEEE SWC_FDC_type_CM_single_Nm 0 0 -100000.0 100000.0 ECU_ADDRESS 0x0000 /* @ECU_Address@VTQD_RC1RetSpdPekTrqP5_Nm@ */ /end MEASUREMENT
/begin MEASUREMENT VTQD_RC1PctTrqPekTrqP5_pct "" FLOAT32_IEEE SWC_FDC_type_CM_single_pct 0 0 -125.0 125.0 ECU_ADDRESS 0x0000 /* @ECU_Address@VTQD_RC1PctTrqPekTrqP5_pct@ */ /end MEASUREMENT
/begin MEASUREMENT VTQD_RC1MaxRetSpdP3_rpm "" FLOAT32_IEEE SWC_FDC_type_CM_single_rpm 0 0 -100000.0 100000.0 ECU_ADDRESS 0x0000 /* @ECU_Address@VTQD_RC1MaxRetSpdP3_rpm@ */ /end MEASUREMENT
/begin MEASUREMENT VTQD_CoordTqDem_Nm "" FLOAT32_IEEE SWC_FDC_type_CM_single_Nm 0 0 -100000.0 100000.0 ECU_ADDRESS 0x0000 /* @ECU_Address@VTQD_CoordTqDem_Nm@ */ /end MEASUREMENT
/begin MEASUREMENT VDHP_EAPS1RAW_pct "" FLOAT32_IEEE SWC_FDC_type_CM_single_pct 0 0 0.0 120.0 ECU_ADDRESS 0x0000 /* @ECU_Address@VDHP_EAPS1RAW_pct@ */ /end MEASUREMENT
/begin MEASUREMENT VDHP_EAPS2RAW_pct "" FLOAT32_IEEE SWC_FDC_type_CM_single_pct 0 0 0.0 120.0 ECU_ADDRESS 0x0000 /* @ECU_Address@VDHP_EAPS2RAW_pct@ */ /end MEASUREMENT
/begin MEASUREMENT VPMM_DCCurr_A "" FLOAT32_IEEE SWC_FDC_type_CM_single_A 0 0 -100000.0 100000.0 ECU_ADDRESS 0x0000 /* @ECU_Address@VPMM_DCCurr_A@ */ /end MEASUREMENT
/begin MEASUREMENT VPMM_DCVol_V "" FLOAT32_IEEE SWC_FDC_type_CM_single_V 0 0 -100000.0 100000.0 ECU_ADDRESS 0x0000 /* @ECU_Address@VPMM_DCVol_V@ */ /end MEASUREMENT
/begin MEASUREMENT VPMM_PMMEHPSDemSpd_rpm "" FLOAT32_IEEE SWC_FDC_type_CM_single_rpm 0 0 0.0 1500.0 ECU_ADDRESS 0x0000 /* @ECU_Address@VPMM_PMMEHPSDemSpd_rpm@ */ /end MEASUREMENT
/begin MEASUREMENT VPSA_Keystatus_enum "" UBYTE SWC_FDC_type_CM_uint8_enum 0 0 0.0 2.0 ECU_ADDRESS 0x0000 /* @ECU_Address@VPSA_Keystatus_enum@ */ /end MEASUREMENT
/begin MEASUREMENT VACC_EcasNLvReq_enum "" UBYTE SWC_FDC_type_CM_uint8_enum 0 0 0.0 15.0 ECU_ADDRESS 0x0000 /* @ECU_Address@VACC_EcasNLvReq_enum@ */ /end MEASUREMENT
/begin MEASUREMENT VACC_ASC2NLvReqFA_enum "" UBYTE SWC_FDC_type_CM_uint8_enum 0 0 0.0 15.0 ECU_ADDRESS 0x0000 /* @ECU_Address@VACC_ASC2NLvReqFA_enum@ */ /end MEASUREMENT
/begin MEASUREMENT VACC_ASC2AutoTracH_enum "" UBYTE SWC_FDC_type_CM_uint8_enum 0 0 0.0 15.0 ECU_ADDRESS 0x0000 /* @ECU_Address@VACC_ASC2AutoTracH_enum@ */ /end MEASUREMENT
/begin MEASUREMENT VACC_ASC2LA1PosCmd_enum "" UBYTE SWC_FDC_type_CM_uint8_enum 0 0 0.0 15.0 ECU_ADDRESS 0x0000 /* @ECU_Address@VACC_ASC2LA1PosCmd_enum@ */ /end MEASUREMENT
/begin MEASUREMENT VACC_ASC2LA2PosCmd_enum "" UBYTE SWC_FDC_type_CM_uint8_enum 0 0 0.0 15.0 ECU_ADDRESS 0x0000 /* @ECU_Address@VACC_ASC2LA2PosCmd_enum@ */ /end MEASUREMENT
/begin MEASUREMENT VACC_ASC2KneeCtrlMReq_enum "" UBYTE SWC_FDC_type_CM_uint8_enum 0 0 0.0 15.0 ECU_ADDRESS 0x0000 /* @ECU_Address@VACC_ASC2KneeCtrlMReq_enum@ */ /end MEASUREMENT
/begin MEASUREMENT VACC_ASC2NLvReqRA_enum "" UBYTE SWC_FDC_type_CM_uint8_enum 0 0 0.0 15.0 ECU_ADDRESS 0x0000 /* @ECU_Address@VACC_ASC2NLvReqRA_enum@ */ /end MEASUREMENT
/begin MEASUREMENT VACC_ASC2LvCtrlModeReq_enum "" UBYTE SWC_FDC_type_CM_uint8_enum 0 0 0.0 15.0 ECU_ADDRESS 0x0000 /* @ECU_Address@VACC_ASC2LvCtrlModeReq_enum@ */ /end MEASUREMENT
/begin MEASUREMENT VACC_EHPSEnDemand_enum "" UBYTE SWC_FDC_type_CM_uint8_enum 0 0 0.0 255.0 ECU_ADDRESS 0x0000 /* @ECU_Address@VACC_EHPSEnDemand_enum@ */ /end MEASUREMENT
/begin MEASUREMENT VACC_EACEnDemand_enum "" UBYTE SWC_FDC_type_CM_uint8_enum 0 0 0.0 255.0 ECU_ADDRESS 0x0000 /* @ECU_Address@VACC_EACEnDemand_enum@ */ /end MEASUREMENT
/begin MEASUREMENT VACC_DCDCEnDemamd_enum "" UBYTE SWC_FDC_type_CM_uint8_enum 0 0 0.0 255.0 ECU_ADDRESS 0x0000 /* @ECU_Address@VACC_DCDCEnDemamd_enum@ */ /end MEASUREMENT
/begin MEASUREMENT VTQD_EVCU1VehActDrvDir_enum "" UBYTE SWC_FDC_type_CM_uint8_enum 0 0 0.0 15.0 ECU_ADDRESS 0x0000 /* @ECU_Address@VTQD_EVCU1VehActDrvDir_enum@ */ /end MEASUREMENT
/begin MEASUREMENT VTQD_ReqGear_enum "" UBYTE SWC_FDC_type_CM_uint8_enum 0 0 0.0 15.0 ECU_ADDRESS 0x0000 /* @ECU_Address@VTQD_ReqGear_enum@ */ /end MEASUREMENT
/begin MEASUREMENT VTQD_RealGear_enum "" UBYTE SWC_FDC_type_CM_uint8_enum 0 0 0.0 15.0 ECU_ADDRESS 0x0000 /* @ECU_Address@VTQD_RealGear_enum@ */ /end MEASUREMENT
/begin MEASUREMENT VTQD_ActDriveMode_enum "" UBYTE SWC_FDC_type_CM_uint8_enum 0 0 0.0 15.0 ECU_ADDRESS 0x0000 /* @ECU_Address@VTQD_ActDriveMode_enum@ */ /end MEASUREMENT
/begin MEASUREMENT VTQD_TMRrotateDirection_enum "" UBYTE SWC_FDC_type_CM_uint8_enum 0 0 0.0 15.0 ECU_ADDRESS 0x0000 /* @ECU_Address@VTQD_TMRrotateDirection_enum@ */ /end MEASUREMENT
/begin MEASUREMENT VTQD_TqSource_enum "" UBYTE SWC_FDC_type_CM_uint8_enum 0 0 0.0 15.0 ECU_ADDRESS 0x0000 /* @ECU_Address@VTQD_TqSource_enum@ */ /end MEASUREMENT
/begin MEASUREMENT VTQD_TMRotateDirectionReq_enum "" UBYTE SWC_FDC_type_CM_uint8_enum 0 0 0.0 15.0 ECU_ADDRESS 0x0000 /* @ECU_Address@VTQD_TMRotateDirectionReq_enum@ */ /end MEASUREMENT
/begin MEASUREMENT VTQD_EMRC1EMTquModeDrvBrk_enum "" UBYTE SWC_FDC_type_CM_uint8_enum 0 0 0.0 15.0 ECU_ADDRESS 0x0000 /* @ECU_Address@VTQD_EMRC1EMTquModeDrvBrk_enum@ */ /end MEASUREMENT
/begin MEASUREMENT VTQD_EVCU1ActDrvMode_enum "" UBYTE SWC_FDC_type_CM_uint8_enum 0 0 0.0 15.0 ECU_ADDRESS 0x0000 /* @ECU_Address@VTQD_EVCU1ActDrvMode_enum@ */ /end MEASUREMENT
/begin MEASUREMENT VTQD_EVCU1EMotorOvrerSpd_enum "" UBYTE SWC_FDC_type_CM_uint8_enum 0 0 0.0 15.0 ECU_ADDRESS 0x0000 /* @ECU_Address@VTQD_EVCU1EMotorOvrerSpd_enum@ */ /end MEASUREMENT
/begin MEASUREMENT VTQD_EVCU1EBrakeTorqLow_enum "" UBYTE SWC_FDC_type_CM_uint8_enum 0 0 0.0 15.0 ECU_ADDRESS 0x0000 /* @ECU_Address@VTQD_EVCU1EBrakeTorqLow_enum@ */ /end MEASUREMENT
/begin MEASUREMENT VTQD_EVCU1RecuperHighSta_enum "" UBYTE SWC_FDC_type_CM_uint8_enum 0 0 0.0 255.0 ECU_ADDRESS 0x0000 /* @ECU_Address@VTQD_EVCU1RecuperHighSta_enum@ */ /end MEASUREMENT
/begin MEASUREMENT VTQD_VCUMCUGearSta_enum "" UBYTE SWC_FDC_type_CM_uint8_enum 0 0 0.0 15.0 ECU_ADDRESS 0x0000 /* @ECU_Address@VTQD_VCUMCUGearSta_enum@ */ /end MEASUREMENT
/begin MEASUREMENT VTQD_VCUEBSHBSw_enum "" UBYTE SWC_FDC_type_CM_uint8_enum 0 0 0.0 15.0 ECU_ADDRESS 0x0000 /* @ECU_Address@VTQD_VCUEBSHBSw_enum@ */ /end MEASUREMENT
/begin MEASUREMENT VTQD_TUpAIND_enum "" UBYTE SWC_FDC_type_CM_uint8_enum 0 0 0.0 15.0 ECU_ADDRESS 0x0000 /* @ECU_Address@VTQD_TUpAIND_enum@ */ /end MEASUREMENT
/begin MEASUREMENT VTQD_EC1EMSupVarRTSC1MSG_cnt "" UBYTE SWC_FDC_type_CM_uint8_cnt 0 0 0.0 255.0 ECU_ADDRESS 0x0000 /* @ECU_Address@VTQD_EC1EMSupVarRTSC1MSG_cnt@ */ /end MEASUREMENT
/begin MEASUREMENT VTQD_EC1EMSupTSC1CtrlPG1_cnt "" UBYTE SWC_FDC_type_CM_uint8_cnt 0 0 0.0 255.0 ECU_ADDRESS 0x0000 /* @ECU_Address@VTQD_EC1EMSupTSC1CtrlPG1_cnt@ */ /end MEASUREMENT
/begin MEASUREMENT VTQD_EC1EMSupTSC1CtrlPG2_cnt "" UBYTE SWC_FDC_type_CM_uint8_cnt 0 0 0.0 255.0 ECU_ADDRESS 0x0000 /* @ECU_Address@VTQD_EC1EMSupTSC1CtrlPG2_cnt@ */ /end MEASUREMENT
/begin MEASUREMENT VTQD_EC1EMSupTSC1CtrlPG3_cnt "" UBYTE SWC_FDC_type_CM_uint8_cnt 0 0 0.0 255.0 ECU_ADDRESS 0x0000 /* @ECU_Address@VTQD_EC1EMSupTSC1CtrlPG3_cnt@ */ /end MEASUREMENT
/begin MEASUREMENT VTQD_EC1EMSupTSC1CtrlPG4_cnt "" UBYTE SWC_FDC_type_CM_uint8_cnt 0 0 0.0 255.0 ECU_ADDRESS 0x0000 /* @ECU_Address@VTQD_EC1EMSupTSC1CtrlPG4_cnt@ */ /end MEASUREMENT
/begin MEASUREMENT VTQD_EMRC1SACtrlDev_cnt "" UBYTE SWC_FDC_type_CM_uint8_cnt 0 0 0.0 255.0 ECU_ADDRESS 0x0000 /* @ECU_Address@VTQD_EMRC1SACtrlDev_cnt@ */ /end MEASUREMENT
/begin MEASUREMENT VTQD_ETC1ShiftrPgs_enum "" UBYTE SWC_FDC_type_CM_uint8_enum 0 0 0.0 15.0 ECU_ADDRESS 0x0000 /* @ECU_Address@VTQD_ETC1ShiftrPgs_enum@ */ /end MEASUREMENT
/begin MEASUREMENT VTQD_EVCU1WheelSlipdet_enum "" UBYTE SWC_FDC_type_CM_uint8_enum 0 0 0.0 15.0 ECU_ADDRESS 0x0000 /* @ECU_Address@VTQD_EVCU1WheelSlipdet_enum@ */ /end MEASUREMENT
/begin MEASUREMENT VTQD_RC1RetType_enum "" UBYTE SWC_FDC_type_CM_uint8_enum 0 0 0.0 255.0 ECU_ADDRESS 0x0000 /* @ECU_Address@VTQD_RC1RetType_enum@ */ /end MEASUREMENT
/begin MEASUREMENT VTQD_RC1RetLocat_enum "" UBYTE SWC_FDC_type_CM_uint8_enum 0 0 0.0 255.0 ECU_ADDRESS 0x0000 /* @ECU_Address@VTQD_RC1RetLocat_enum@ */ /end MEASUREMENT
/begin MEASUREMENT VBCM_InnerBuzzerModeSta_enum "" UBYTE SWC_FDC_type_CM_uint8_enum 0 0 0.0 5.0 ECU_ADDRESS 0x0000 /* @ECU_Address@VBCM_InnerBuzzerModeSta_enum@ */ /end MEASUREMENT
/begin MEASUREMENT VBCM_TurnLpPatternSta_enum "" UBYTE SWC_FDC_type_CM_uint8_enum 0 0 0.0 3.0 ECU_ADDRESS 0x0000 /* @ECU_Address@VBCM_TurnLpPatternSta_enum@ */ /end MEASUREMENT
/begin MEASUREMENT VBCM_FDCBCMFRoomLpSetSta_pct "" UBYTE SWC_FDC_type_CM_uint8_pct 0 0 0.0 100.0 ECU_ADDRESS 0x0000 /* @ECU_Address@VBCM_FDCBCMFRoomLpSetSta_pct@ */ /end MEASUREMENT
/begin MEASUREMENT VBCM_FDCBCMFRoomLpCmd_pct "" UBYTE SWC_FDC_type_CM_uint8_pct 0 0 0.0 100.0 ECU_ADDRESS 0x0000 /* @ECU_Address@VBCM_FDCBCMFRoomLpCmd_pct@ */ /end MEASUREMENT
/begin MEASUREMENT VBCM_FDCBCMMRoomLpSetSta_pct "" UBYTE SWC_FDC_type_CM_uint8_pct 0 0 0.0 100.0 ECU_ADDRESS 0x0000 /* @ECU_Address@VBCM_FDCBCMMRoomLpSetSta_pct@ */ /end MEASUREMENT
/begin MEASUREMENT VBCM_FDCBCMMRoomLpCmd_pct "" UBYTE SWC_FDC_type_CM_uint8_pct 0 0 0.0 100.0 ECU_ADDRESS 0x0000 /* @ECU_Address@VBCM_FDCBCMMRoomLpCmd_pct@ */ /end MEASUREMENT
/begin MEASUREMENT VBCM_FDCBCMRRoomLpSetSta_pct "" UBYTE SWC_FDC_type_CM_uint8_pct 0 0 0.0 100.0 ECU_ADDRESS 0x0000 /* @ECU_Address@VBCM_FDCBCMRRoomLpSetSta_pct@ */ /end MEASUREMENT
/begin MEASUREMENT VBCM_FDCBCMRRoomLpCmd_pct "" UBYTE SWC_FDC_type_CM_uint8_pct 0 0 0.0 100.0 ECU_ADDRESS 0x0000 /* @ECU_Address@VBCM_FDCBCMRRoomLpCmd_pct@ */ /end MEASUREMENT
/begin MEASUREMENT VBCM_FDCBCMOSDrOpenSWSta_enum "" UBYTE SWC_FDC_type_CM_uint8_enum 0 0 0.0 255.0 ECU_ADDRESS 0x0000 /* @ECU_Address@VBCM_FDCBCMOSDrOpenSWSta_enum@ */ /end MEASUREMENT
/begin MEASUREMENT VPMM_PowerUpState_enum "" UBYTE SWC_FDC_type_CM_uint8_enum 0 0 0.0 13.0 ECU_ADDRESS 0x0000 /* @ECU_Address@VPMM_PowerUpState_enum@ */ /end MEASUREMENT
/begin MEASUREMENT VPMM_PowerDownFault_enum "" UBYTE SWC_FDC_type_CM_uint8_enum 0 0 0.0 11.0 ECU_ADDRESS 0x0000 /* @ECU_Address@VPMM_PowerDownFault_enum@ */ /end MEASUREMENT
/begin MEASUREMENT VPMM_ChrgFault_enum "" UBYTE SWC_FDC_type_CM_uint8_enum 0 0 0.0 9.0 ECU_ADDRESS 0x0000 /* @ECU_Address@VPMM_ChrgFault_enum@ */ /end MEASUREMENT
/begin MEASUREMENT VPMM_PDUEACRlySta_enum "" UBYTE SWC_FDC_type_CM_uint8_enum 0 0 0.0 3.0 ECU_ADDRESS 0x0000 /* @ECU_Address@VPMM_PDUEACRlySta_enum@ */ /end MEASUREMENT
/begin MEASUREMENT VPMM_V2BAirPosRlySta_enum "" UBYTE SWC_FDC_type_CM_uint8_enum 0 0 0.0 3.0 ECU_ADDRESS 0x0000 /* @ECU_Address@VPMM_V2BAirPosRlySta_enum@ */ /end MEASUREMENT
/begin MEASUREMENT VPMM_V2BAirPosRlyFit_enum "" UBYTE SWC_FDC_type_CM_uint8_enum 0 0 0.0 3.0 ECU_ADDRESS 0x0000 /* @ECU_Address@VPMM_V2BAirPosRlyFit_enum@ */ /end MEASUREMENT
/begin MEASUREMENT VPMM_PDUEHPSRlySta_enum "" UBYTE SWC_FDC_type_CM_uint8_enum 0 0 0.0 3.0 ECU_ADDRESS 0x0000 /* @ECU_Address@VPMM_PDUEHPSRlySta_enum@ */ /end MEASUREMENT
/begin MEASUREMENT VPMM_V2BOilPosRlySta_enum "" UBYTE SWC_FDC_type_CM_uint8_enum 0 0 0.0 3.0 ECU_ADDRESS 0x0000 /* @ECU_Address@VPMM_V2BOilPosRlySta_enum@ */ /end MEASUREMENT
/begin MEASUREMENT VPMM_V2BOilPosRlyFit_enum "" UBYTE SWC_FDC_type_CM_uint8_enum 0 0 0.0 3.0 ECU_ADDRESS 0x0000 /* @ECU_Address@VPMM_V2BOilPosRlyFit_enum@ */ /end MEASUREMENT
/begin MEASUREMENT VPMM_PDUDCDCRlySta_enum "" UBYTE SWC_FDC_type_CM_uint8_enum 0 0 0.0 3.0 ECU_ADDRESS 0x0000 /* @ECU_Address@VPMM_PDUDCDCRlySta_enum@ */ /end MEASUREMENT
/begin MEASUREMENT VPMM_V2BDCDCPosRlyFit_enum "" UBYTE SWC_FDC_type_CM_uint8_enum 0 0 0.0 3.0 ECU_ADDRESS 0x0000 /* @ECU_Address@VPMM_V2BDCDCPosRlyFit_enum@ */ /end MEASUREMENT
/begin MEASUREMENT VPMM_V2BDCDCPosRlySta_enum "" UBYTE SWC_FDC_type_CM_uint8_enum 0 0 0.0 3.0 ECU_ADDRESS 0x0000 /* @ECU_Address@VPMM_V2BDCDCPosRlySta_enum@ */ /end MEASUREMENT
/begin MEASUREMENT VPMM_AlcLockSta_enum "" UBYTE SWC_FDC_type_CM_uint8_enum 0 0 0.0 255.0 ECU_ADDRESS 0x0000 /* @ECU_Address@VPMM_AlcLockSta_enum@ */ /end MEASUREMENT
/begin MEASUREMENT VPMM_FogTMSRlyCMD_enum "" UBYTE SWC_FDC_type_CM_uint8_enum 0 0 0.0 3.0 ECU_ADDRESS 0x0000 /* @ECU_Address@VPMM_FogTMSRlyCMD_enum@ */ /end MEASUREMENT
/begin MEASUREMENT VPMM_VCULife1_cnt "" UBYTE SWC_FDC_type_CM_uint8_cnt 0 0 0.0 255.0 ECU_ADDRESS 0x0000 /* @ECU_Address@VPMM_VCULife1_cnt@ */ /end MEASUREMENT
/begin MEASUREMENT VPMM_VCULife2_cnt "" UBYTE SWC_FDC_type_CM_uint8_cnt 0 0 0.0 255.0 ECU_ADDRESS 0x0000 /* @ECU_Address@VPMM_VCULife2_cnt@ */ /end MEASUREMENT
/begin MEASUREMENT VPMM_V2BLifeSig_cnt "" UBYTE SWC_FDC_type_CM_uint8_cnt 0 0 0.0 255.0 ECU_ADDRESS 0x0000 /* @ECU_Address@VPMM_V2BLifeSig_cnt@ */ /end MEASUREMENT
/begin MEASUREMENT VPMM_V2BMainPosRlyFit_enum "" UBYTE SWC_FDC_type_CM_uint8_enum 0 0 0.0 3.0 ECU_ADDRESS 0x0000 /* @ECU_Address@VPMM_V2BMainPosRlyFit_enum@ */ /end MEASUREMENT
/begin MEASUREMENT VPMM_V2BMainPosRlySta_enum "" UBYTE SWC_FDC_type_CM_uint8_enum 0 0 0.0 3.0 ECU_ADDRESS 0x0000 /* @ECU_Address@VPMM_V2BMainPosRlySta_enum@ */ /end MEASUREMENT
/begin MEASUREMENT VPMM_V2BACPosRlySta_enum "" UBYTE SWC_FDC_type_CM_uint8_enum 0 0 0.0 3.0 ECU_ADDRESS 0x0000 /* @ECU_Address@VPMM_V2BACPosRlySta_enum@ */ /end MEASUREMENT
/begin MEASUREMENT VPMM_V2BACPosRlyFit_enum "" UBYTE SWC_FDC_type_CM_uint8_enum 0 0 0.0 3.0 ECU_ADDRESS 0x0000 /* @ECU_Address@VPMM_V2BACPosRlyFit_enum@ */ /end MEASUREMENT
/begin MEASUREMENT VPMM_VSPFunc_enum "" UBYTE SWC_FDC_type_CM_uint8_enum 0 0 0.0 3.0 ECU_ADDRESS 0x0000 /* @ECU_Address@VPMM_VSPFunc_enum@ */ /end MEASUREMENT
/begin MEASUREMENT VPMM_VSPIGNKeySta_enum "" UBYTE SWC_FDC_type_CM_uint8_enum 0 0 0.0 3.0 ECU_ADDRESS 0x0000 /* @ECU_Address@VPMM_VSPIGNKeySta_enum@ */ /end MEASUREMENT
/begin MEASUREMENT VPMM_VSPTurnRight_enum "" UBYTE SWC_FDC_type_CM_uint8_enum 0 0 0.0 255.0 ECU_ADDRESS 0x0000 /* @ECU_Address@VPMM_VSPTurnRight_enum@ */ /end MEASUREMENT
/begin MEASUREMENT VPMM_VSPTurnLeft_enum "" UBYTE SWC_FDC_type_CM_uint8_enum 0 0 0.0 255.0 ECU_ADDRESS 0x0000 /* @ECU_Address@VPMM_VSPTurnLeft_enum@ */ /end MEASUREMENT
/begin MEASUREMENT VPMM_V2BAux1OnOff_enum "" UBYTE SWC_FDC_type_CM_uint8_enum 0 0 0.0 3.0 ECU_ADDRESS 0x0000 /* @ECU_Address@VPMM_V2BAux1OnOff_enum@ */ /end MEASUREMENT
/begin MEASUREMENT VPMM_V2BAux2OnOff_enum "" UBYTE SWC_FDC_type_CM_uint8_enum 0 0 0.0 3.0 ECU_ADDRESS 0x0000 /* @ECU_Address@VPMM_V2BAux2OnOff_enum@ */ /end MEASUREMENT
/begin MEASUREMENT VPMM_V2BAux3OnOff_enum "" UBYTE SWC_FDC_type_CM_uint8_enum 0 0 0.0 3.0 ECU_ADDRESS 0x0000 /* @ECU_Address@VPMM_V2BAux3OnOff_enum@ */ /end MEASUREMENT
/begin MEASUREMENT VPMM_V2BAux1RlySta_enum "" UBYTE SWC_FDC_type_CM_uint8_enum 0 0 0.0 3.0 ECU_ADDRESS 0x0000 /* @ECU_Address@VPMM_V2BAux1RlySta_enum@ */ /end MEASUREMENT
/begin MEASUREMENT VPMM_V2BAux1RlyFit_enum "" UBYTE SWC_FDC_type_CM_uint8_enum 0 0 0.0 3.0 ECU_ADDRESS 0x0000 /* @ECU_Address@VPMM_V2BAux1RlyFit_enum@ */ /end MEASUREMENT
/begin MEASUREMENT VPMM_V2BAux2RlySta_enum "" UBYTE SWC_FDC_type_CM_uint8_enum 0 0 0.0 3.0 ECU_ADDRESS 0x0000 /* @ECU_Address@VPMM_V2BAux2RlySta_enum@ */ /end MEASUREMENT
/begin MEASUREMENT VPMM_V2BAux2RlyFit_enum "" UBYTE SWC_FDC_type_CM_uint8_enum 0 0 0.0 3.0 ECU_ADDRESS 0x0000 /* @ECU_Address@VPMM_V2BAux2RlyFit_enum@ */ /end MEASUREMENT
/begin MEASUREMENT VPMM_V2BAux3RlySta_enum "" UBYTE SWC_FDC_type_CM_uint8_enum 0 0 0.0 3.0 ECU_ADDRESS 0x0000 /* @ECU_Address@VPMM_V2BAux3RlySta_enum@ */ /end MEASUREMENT
/begin MEASUREMENT VPMM_V2BAux3RlyFit_enum "" UBYTE SWC_FDC_type_CM_uint8_enum 0 0 0.0 3.0 ECU_ADDRESS 0x0000 /* @ECU_Address@VPMM_V2BAux3RlyFit_enum@ */ /end MEASUREMENT
/begin MEASUREMENT VPMM_V2BAux4RlySta_enum "" UBYTE SWC_FDC_type_CM_uint8_enum 0 0 0.0 3.0 ECU_ADDRESS 0x0000 /* @ECU_Address@VPMM_V2BAux4RlySta_enum@ */ /end MEASUREMENT
/begin MEASUREMENT VPMM_V2BAux4RlyFit_enum "" UBYTE SWC_FDC_type_CM_uint8_enum 0 0 0.0 3.0 ECU_ADDRESS 0x0000 /* @ECU_Address@VPMM_V2BAux4RlyFit_enum@ */ /end MEASUREMENT
/begin MEASUREMENT VPMM_V2BRsv1_cnt "" UBYTE SWC_FDC_type_CM_uint8_cnt 0 0 0.0 255.0 ECU_ADDRESS 0x0000 /* @ECU_Address@VPMM_V2BRsv1_cnt@ */ /end MEASUREMENT
/begin MEASUREMENT VPMM_V2BRsv2_cnt "" UBYTE SWC_FDC_type_CM_uint8_cnt 0 0 0.0 255.0 ECU_ADDRESS 0x0000 /* @ECU_Address@VPMM_V2BRsv2_cnt@ */ /end MEASUREMENT
/begin MEASUREMENT VPMM_SysPowerMode_enum "" UBYTE SWC_FDC_type_CM_uint8_enum 0 0 0.0 10.0 ECU_ADDRESS 0x0000 /* @ECU_Address@VPMM_SysPowerMode_enum@ */ /end MEASUREMENT
/begin MEASUREMENT VPMM_PowerDownState_enum "" UBYTE SWC_FDC_type_CM_uint8_enum 0 0 0.0 9.0 ECU_ADDRESS 0x0000 /* @ECU_Address@VPMM_PowerDownState_enum@ */ /end MEASUREMENT
/begin MEASUREMENT VPMM_ChrgState_enum "" UBYTE SWC_FDC_type_CM_uint8_enum 0 0 0.0 8.0 ECU_ADDRESS 0x0000 /* @ECU_Address@VPMM_ChrgState_enum@ */ /end MEASUREMENT
/begin MEASUREMENT VPMM_PowerUpFault_enum "" UBYTE SWC_FDC_type_CM_uint8_enum 0 0 0.0 13.0 ECU_ADDRESS 0x0000 /* @ECU_Address@VPMM_PowerUpFault_enum@ */ /end MEASUREMENT
/begin MEASUREMENT VPMM_BattHVDem_enum "" UBYTE SWC_FDC_type_CM_uint8_enum 0 0 0.0 3.0 ECU_ADDRESS 0x0000 /* @ECU_Address@VPMM_BattHVDem_enum@ */ /end MEASUREMENT
/begin MEASUREMENT VPMM_DCDCRlyDem_enum "" UBYTE SWC_FDC_type_CM_uint8_enum 0 0 0.0 3.0 ECU_ADDRESS 0x0000 /* @ECU_Address@VPMM_DCDCRlyDem_enum@ */ /end MEASUREMENT
/begin MEASUREMENT VPMM_CACRlyDem_enum "" UBYTE SWC_FDC_type_CM_uint8_enum 0 0 0.0 3.0 ECU_ADDRESS 0x0000 /* @ECU_Address@VPMM_CACRlyDem_enum@ */ /end MEASUREMENT
/begin MEASUREMENT VPMM_MCUHVLoopDem_enum "" UBYTE SWC_FDC_type_CM_uint8_enum 0 0 0.0 3.0 ECU_ADDRESS 0x0000 /* @ECU_Address@VPMM_MCUHVLoopDem_enum@ */ /end MEASUREMENT
/begin MEASUREMENT VPMM_EHPSRlyDem_enum "" UBYTE SWC_FDC_type_CM_uint8_enum 0 0 0.0 3.0 ECU_ADDRESS 0x0000 /* @ECU_Address@VPMM_EHPSRlyDem_enum@ */ /end MEASUREMENT
/begin MEASUREMENT VPMM_ACHVLoopDem_enum "" UBYTE SWC_FDC_type_CM_uint8_enum 0 0 0.0 3.0 ECU_ADDRESS 0x0000 /* @ECU_Address@VPMM_ACHVLoopDem_enum@ */ /end MEASUREMENT
/begin MEASUREMENT VPMM_HVSysReady_enum "" UBYTE SWC_FDC_type_CM_uint8_enum 0 0 0.0 3.0 ECU_ADDRESS 0x0000 /* @ECU_Address@VPMM_HVSysReady_enum@ */ /end MEASUREMENT
/begin MEASUREMENT VPMM_DrivelineRelease_enum "" UBYTE SWC_FDC_type_CM_uint8_enum 0 0 0.0 3.0 ECU_ADDRESS 0x0000 /* @ECU_Address@VPMM_DrivelineRelease_enum@ */ /end MEASUREMENT
/begin MEASUREMENT VPMM_ExtTorquePrevent_enum "" UBYTE SWC_FDC_type_CM_uint8_enum 0 0 0.0 3.0 ECU_ADDRESS 0x0000 /* @ECU_Address@VPMM_ExtTorquePrevent_enum@ */ /end MEASUREMENT
/begin MEASUREMENT VPMM_VCUMCUCtrlMd_enum "" UBYTE SWC_FDC_type_CM_uint8_enum 0 0 0.0 3.0 ECU_ADDRESS 0x0000 /* @ECU_Address@VPMM_VCUMCUCtrlMd_enum@ */ /end MEASUREMENT
/begin MEASUREMENT VPSA_PBtrig_flg "" UBYTE SWC_FDC_type_CM_boolean_flg 0 0 0.0 1.0 ECU_ADDRESS 0x0000 /* @ECU_Address@VPSA_PBtrig_flg@ */ /end MEASUREMENT
/begin MEASUREMENT VPSA_AlcLockPass_flg "" UBYTE SWC_FDC_type_CM_boolean_flg 0 0 0.0 1.0 ECU_ADDRESS 0x0000 /* @ECU_Address@VPSA_AlcLockPass_flg@ */ /end MEASUREMENT
/begin MEASUREMENT VTHC_ServiceMode_flg "" UBYTE SWC_FDC_type_CM_boolean_flg 0 0 0.0 1.0 ECU_ADDRESS 0x0000 /* @ECU_Address@VTHC_ServiceMode_flg@ */ /end MEASUREMENT
/begin MEASUREMENT VTHC_AfterrunningMode_flg "" UBYTE SWC_FDC_type_CM_boolean_flg 0 0 0.0 1.0 ECU_ADDRESS 0x0000 /* @ECU_Address@VTHC_AfterrunningMode_flg@ */ /end MEASUREMENT
/begin MEASUREMENT VTHC_EWPSpdDemRelay_flg "" UBYTE SWC_FDC_type_CM_boolean_flg 0 0 0.0 1.0 ECU_ADDRESS 0x0000 /* @ECU_Address@VTHC_EWPSpdDemRelay_flg@ */ /end MEASUREMENT
/begin MEASUREMENT VACC_EcasSw1Down_flg "" UBYTE SWC_FDC_type_CM_boolean_flg 0 0 0.0 1.0 ECU_ADDRESS 0x0000 /* @ECU_Address@VACC_EcasSw1Down_flg@ */ /end MEASUREMENT
/begin MEASUREMENT VACC_EcasSw1Up_flg "" UBYTE SWC_FDC_type_CM_boolean_flg 0 0 0.0 1.0 ECU_ADDRESS 0x0000 /* @ECU_Address@VACC_EcasSw1Up_flg@ */ /end MEASUREMENT
/begin MEASUREMENT VACC_EcasSw2M2_flg "" UBYTE SWC_FDC_type_CM_boolean_flg 0 0 0.0 1.0 ECU_ADDRESS 0x0000 /* @ECU_Address@VACC_EcasSw2M2_flg@ */ /end MEASUREMENT
/begin MEASUREMENT VACC_EcasSw3M1_flg "" UBYTE SWC_FDC_type_CM_boolean_flg 0 0 0.0 1.0 ECU_ADDRESS 0x0000 /* @ECU_Address@VACC_EcasSw3M1_flg@ */ /end MEASUREMENT
/begin MEASUREMENT VACC_EcasSw2Stop_flg "" UBYTE SWC_FDC_type_CM_boolean_flg 0 0 0.0 1.0 ECU_ADDRESS 0x0000 /* @ECU_Address@VACC_EcasSw2Stop_flg@ */ /end MEASUREMENT
/begin MEASUREMENT VACC_EHPSSpdDemTimeout_flg "" UBYTE SWC_FDC_type_CM_boolean_flg 0 0 0.0 1.0 ECU_ADDRESS 0x0000 /* @ECU_Address@VACC_EHPSSpdDemTimeout_flg@ */ /end MEASUREMENT
/begin MEASUREMENT VACC_SASCalFinish_flg "" UBYTE SWC_FDC_type_CM_boolean_flg 0 0 0.0 1.0 ECU_ADDRESS 0x0000 /* @ECU_Address@VACC_SASCalFinish_flg@ */ /end MEASUREMENT
/begin MEASUREMENT VACC_StrWhlAngMemDet_flg "" UBYTE SWC_FDC_type_CM_boolean_flg 0 0 0.0 1.0 ECU_ADDRESS 0x0000 /* @ECU_Address@VACC_StrWhlAngMemDet_flg@ */ /end MEASUREMENT
/begin MEASUREMENT VACC_StrWhlNotMoving_flg "" UBYTE SWC_FDC_type_CM_boolean_flg 0 0 0.0 1.0 ECU_ADDRESS 0x0000 /* @ECU_Address@VACC_StrWhlNotMoving_flg@ */ /end MEASUREMENT
/begin MEASUREMENT VACC_EHPSDisable_flg "" UBYTE SWC_FDC_type_CM_boolean_flg 0 0 0.0 1.0 ECU_ADDRESS 0x0000 /* @ECU_Address@VACC_EHPSDisable_flg@ */ /end MEASUREMENT
/begin MEASUREMENT VACC_EBSBrakeRelease_flg "" UBYTE SWC_FDC_type_CM_boolean_flg 0 0 0.0 1.0 ECU_ADDRESS 0x0000 /* @ECU_Address@VACC_EBSBrakeRelease_flg@ */ /end MEASUREMENT
/begin MEASUREMENT VACC_CACOverrun_flg "" UBYTE SWC_FDC_type_CM_boolean_flg 0 0 0.0 1.0 ECU_ADDRESS 0x0000 /* @ECU_Address@VACC_CACOverrun_flg@ */ /end MEASUREMENT
/begin MEASUREMENT VACC_CACOverTempStop_flg "" UBYTE SWC_FDC_type_CM_boolean_flg 0 0 0.0 1.0 ECU_ADDRESS 0x0000 /* @ECU_Address@VACC_CACOverTempStop_flg@ */ /end MEASUREMENT
/begin MEASUREMENT VACC_CACForceStop_flg "" UBYTE SWC_FDC_type_CM_boolean_flg 0 0 0.0 1.0 ECU_ADDRESS 0x0000 /* @ECU_Address@VACC_CACForceStop_flg@ */ /end MEASUREMENT
/begin MEASUREMENT VACC_EACRefSensorDis_flg "" UBYTE SWC_FDC_type_CM_boolean_flg 0 0 0.0 1.0 ECU_ADDRESS 0x0000 /* @ECU_Address@VACC_EACRefSensorDis_flg@ */ /end MEASUREMENT
/begin MEASUREMENT VACC_EACRefSwitchEnable_flg "" UBYTE SWC_FDC_type_CM_boolean_flg 0 0 0.0 1.0 ECU_ADDRESS 0x0000 /* @ECU_Address@VACC_EACRefSwitchEnable_flg@ */ /end MEASUREMENT
/begin MEASUREMENT VACC_EACSensorPresLow_flg "" UBYTE SWC_FDC_type_CM_boolean_flg 0 0 0.0 1.0 ECU_ADDRESS 0x0000 /* @ECU_Address@VACC_EACSensorPresLow_flg@ */ /end MEASUREMENT
/begin MEASUREMENT VACC_EACPresLowReset_flg "" UBYTE SWC_FDC_type_CM_boolean_flg 0 0 0.0 1.0 ECU_ADDRESS 0x0000 /* @ECU_Address@VACC_EACPresLowReset_flg@ */ /end MEASUREMENT
/begin MEASUREMENT VACC_CACPresLow_flg "" UBYTE SWC_FDC_type_CM_boolean_flg 0 0 0.0 1.0 ECU_ADDRESS 0x0000 /* @ECU_Address@VACC_CACPresLow_flg@ */ /end MEASUREMENT
/begin MEASUREMENT VACC_EACErrLvHoldDis_flg "" UBYTE SWC_FDC_type_CM_boolean_flg 0 0 0.0 1.0 ECU_ADDRESS 0x0000 /* @ECU_Address@VACC_EACErrLvHoldDis_flg@ */ /end MEASUREMENT
/begin MEASUREMENT VACC_ACCEACEnableDem_flg "" UBYTE SWC_FDC_type_CM_boolean_flg 0 0 0.0 1.0 ECU_ADDRESS 0x0000 /* @ECU_Address@VACC_ACCEACEnableDem_flg@ */ /end MEASUREMENT
/begin MEASUREMENT VACC_CACEnableDem_flg "" UBYTE SWC_FDC_type_CM_boolean_flg 0 0 0.0 1.0 ECU_ADDRESS 0x0000 /* @ECU_Address@VACC_CACEnableDem_flg@ */ /end MEASUREMENT
/begin MEASUREMENT VACC_CACRunFail_flg "" UBYTE SWC_FDC_type_CM_boolean_flg 0 0 0.0 1.0 ECU_ADDRESS 0x0000 /* @ECU_Address@VACC_CACRunFail_flg@ */ /end MEASUREMENT
/begin MEASUREMENT VACC_InitEHPSEnDem_flg "" UBYTE SWC_FDC_type_CM_boolean_flg 0 0 0.0 1.0 ECU_ADDRESS 0x0000 /* @ECU_Address@VACC_InitEHPSEnDem_flg@ */ /end MEASUREMENT
/begin MEASUREMENT VACC_EHPSEnTimeout_flg "" UBYTE SWC_FDC_type_CM_boolean_flg 0 0 0.0 1.0 ECU_ADDRESS 0x0000 /* @ECU_Address@VACC_EHPSEnTimeout_flg@ */ /end MEASUREMENT
/begin MEASUREMENT VACC_EcasSw3Knee_flg "" UBYTE SWC_FDC_type_CM_boolean_flg 0 0 0.0 1.0 ECU_ADDRESS 0x0000 /* @ECU_Address@VACC_EcasSw3Knee_flg@ */ /end MEASUREMENT
/begin MEASUREMENT VACC_ASC2KneeReqFA_flg "" UBYTE SWC_FDC_type_CM_boolean_flg 0 0 0.0 1.0 ECU_ADDRESS 0x0000 /* @ECU_Address@VACC_ASC2KneeReqFA_flg@ */ /end MEASUREMENT
/begin MEASUREMENT VACC_ASC2KneeReqRA_flg "" UBYTE SWC_FDC_type_CM_boolean_flg 0 0 0.0 1.0 ECU_ADDRESS 0x0000 /* @ECU_Address@VACC_ASC2KneeReqRA_flg@ */ /end MEASUREMENT
/begin MEASUREMENT VACC_ASC2KneeReqLSide_flg "" UBYTE SWC_FDC_type_CM_boolean_flg 0 0 0.0 1.0 ECU_ADDRESS 0x0000 /* @ECU_Address@VACC_ASC2KneeReqLSide_flg@ */ /end MEASUREMENT
/begin MEASUREMENT VACC_ASC2KneeReqRSide_flg "" UBYTE SWC_FDC_type_CM_boolean_flg 0 0 0.0 1.0 ECU_ADDRESS 0x0000 /* @ECU_Address@VACC_ASC2KneeReqRSide_flg@ */ /end MEASUREMENT
/begin MEASUREMENT VACC_CACPresWarn_flg "" UBYTE SWC_FDC_type_CM_boolean_flg 0 0 0.0 1.0 ECU_ADDRESS 0x0000 /* @ECU_Address@VACC_CACPresWarn_flg@ */ /end MEASUREMENT
/begin MEASUREMENT VACC_CACPresReady_flg "" UBYTE SWC_FDC_type_CM_boolean_flg 0 0 0.0 1.0 ECU_ADDRESS 0x0000 /* @ECU_Address@VACC_CACPresReady_flg@ */ /end MEASUREMENT
/begin MEASUREMENT VACC_CACTempOverHigh_flg "" UBYTE SWC_FDC_type_CM_boolean_flg 0 0 0.0 1.0 ECU_ADDRESS 0x0000 /* @ECU_Address@VACC_CACTempOverHigh_flg@ */ /end MEASUREMENT
/begin MEASUREMENT VACC_EHPSDisEnTimeout_flg "" UBYTE SWC_FDC_type_CM_boolean_flg 0 0 0.0 1.0 ECU_ADDRESS 0x0000 /* @ECU_Address@VACC_EHPSDisEnTimeout_flg@ */ /end MEASUREMENT
/begin MEASUREMENT VACC_CoolingMode_flg "" UBYTE SWC_FDC_type_CM_boolean_flg 0 0 0.0 1.0 ECU_ADDRESS 0x0000 /* @ECU_Address@VACC_CoolingMode_flg@ */ /end MEASUREMENT
/begin MEASUREMENT VACC_EHPSForceStop_flg "" UBYTE SWC_FDC_type_CM_boolean_flg 0 0 0.0 1.0 ECU_ADDRESS 0x0000 /* @ECU_Address@VACC_EHPSForceStop_flg@ */ /end MEASUREMENT
/begin MEASUREMENT VACC_EHPSErrLvHoldDis_flg "" UBYTE SWC_FDC_type_CM_boolean_flg 0 0 0.0 1.0 ECU_ADDRESS 0x0000 /* @ECU_Address@VACC_EHPSErrLvHoldDis_flg@ */ /end MEASUREMENT
/begin MEASUREMENT VACC_ACCEHPSEnablDem_flg "" UBYTE SWC_FDC_type_CM_boolean_flg 0 0 0.0 1.0 ECU_ADDRESS 0x0000 /* @ECU_Address@VACC_ACCEHPSEnablDem_flg@ */ /end MEASUREMENT
/begin MEASUREMENT VACC_EHPSEnableDem_flg "" UBYTE SWC_FDC_type_CM_boolean_flg 0 0 0.0 1.0 ECU_ADDRESS 0x0000 /* @ECU_Address@VACC_EHPSEnableDem_flg@ */ /end MEASUREMENT
/begin MEASUREMENT VACC_DCDCEnableDem_flg "" UBYTE SWC_FDC_type_CM_boolean_flg 0 0 0.0 1.0 ECU_ADDRESS 0x0000 /* @ECU_Address@VACC_DCDCEnableDem_flg@ */ /end MEASUREMENT
/begin MEASUREMENT VACC_EACTempWarnInd_flg "" UBYTE SWC_FDC_type_CM_boolean_flg 0 0 0.0 1.0 ECU_ADDRESS 0x0000 /* @ECU_Address@VACC_EACTempWarnInd_flg@ */ /end MEASUREMENT
/begin MEASUREMENT VACC_EACPressWarnInd_flg "" UBYTE SWC_FDC_type_CM_boolean_flg 0 0 0.0 1.0 ECU_ADDRESS 0x0000 /* @ECU_Address@VACC_EACPressWarnInd_flg@ */ /end MEASUREMENT
/begin MEASUREMENT VACC_VCUEACPressureSW_flg "" UBYTE SWC_FDC_type_CM_boolean_flg 0 0 0.0 1.0 ECU_ADDRESS 0x0000 /* @ECU_Address@VACC_VCUEACPressureSW_flg@ */ /end MEASUREMENT
/begin MEASUREMENT VTQD_NeutralPositionOn_flg "" UBYTE SWC_FDC_type_CM_boolean_flg 0 0 0.0 1.0 ECU_ADDRESS 0x0000 /* @ECU_Address@VTQD_NeutralPositionOn_flg@ */ /end MEASUREMENT
/begin MEASUREMENT VTQD_DrivePositionOn_flg "" UBYTE SWC_FDC_type_CM_boolean_flg 0 0 0.0 1.0 ECU_ADDRESS 0x0000 /* @ECU_Address@VTQD_DrivePositionOn_flg@ */ /end MEASUREMENT
/begin MEASUREMENT VTQD_ReversePositionOn_flg "" UBYTE SWC_FDC_type_CM_boolean_flg 0 0 0.0 1.0 ECU_ADDRESS 0x0000 /* @ECU_Address@VTQD_ReversePositionOn_flg@ */ /end MEASUREMENT
/begin MEASUREMENT VTQD_BrkSWOn_flg "" UBYTE SWC_FDC_type_CM_boolean_flg 0 0 0.0 1.0 ECU_ADDRESS 0x0000 /* @ECU_Address@VTQD_BrkSWOn_flg@ */ /end MEASUREMENT
/begin MEASUREMENT VTQD_EVDriveReady_flg "" UBYTE SWC_FDC_type_CM_boolean_flg 0 0 0.0 1.0 ECU_ADDRESS 0x0000 /* @ECU_Address@VTQD_EVDriveReady_flg@ */ /end MEASUREMENT
/begin MEASUREMENT VTQD_IGNActive_flg "" UBYTE SWC_FDC_type_CM_boolean_flg 0 0 0.0 1.0 ECU_ADDRESS 0x0000 /* @ECU_Address@VTQD_IGNActive_flg@ */ /end MEASUREMENT
/begin MEASUREMENT VTQD_GearFlashInd_flg "" UBYTE SWC_FDC_type_CM_boolean_flg 0 0 0.0 1.0 ECU_ADDRESS 0x0000 /* @ECU_Address@VTQD_GearFlashInd_flg@ */ /end MEASUREMENT
/begin MEASUREMENT VTQD_VCUMCUHandBrk_flg "" UBYTE SWC_FDC_type_CM_boolean_flg 0 0 0.0 1.0 ECU_ADDRESS 0x0000 /* @ECU_Address@VTQD_VCUMCUHandBrk_flg@ */ /end MEASUREMENT
/begin MEASUREMENT VTQD_EM1LimitCtrlDriv_flg "" UBYTE SWC_FDC_type_CM_boolean_flg 0 0 0.0 1.0 ECU_ADDRESS 0x0000 /* @ECU_Address@VTQD_EM1LimitCtrlDriv_flg@ */ /end MEASUREMENT
/begin MEASUREMENT VTQD_TrqLimit_flg "" UBYTE SWC_FDC_type_CM_boolean_flg 0 0 0.0 1.0 ECU_ADDRESS 0x0000 /* @ECU_Address@VTQD_TrqLimit_flg@ */ /end MEASUREMENT
/begin MEASUREMENT VTQD_AccelPedalDepressed_flg "" UBYTE SWC_FDC_type_CM_boolean_flg 0 0 0.0 1.0 ECU_ADDRESS 0x0000 /* @ECU_Address@VTQD_AccelPedalDepressed_flg@ */ /end MEASUREMENT
/begin MEASUREMENT VTQD_NoSuitbleGear_flg "" UBYTE SWC_FDC_type_CM_boolean_flg 0 0 0.0 1.0 ECU_ADDRESS 0x0000 /* @ECU_Address@VTQD_NoSuitbleGear_flg@ */ /end MEASUREMENT
/begin MEASUREMENT VTQD_LostComEBS_flg "" UBYTE SWC_FDC_type_CM_boolean_flg 0 0 0.0 1.0 ECU_ADDRESS 0x0000 /* @ECU_Address@VTQD_LostComEBS_flg@ */ /end MEASUREMENT
/begin MEASUREMENT VTQD_LostComTempEBS_flg "" UBYTE SWC_FDC_type_CM_boolean_flg 0 0 0.0 1.0 ECU_ADDRESS 0x0000 /* @ECU_Address@VTQD_LostComTempEBS_flg@ */ /end MEASUREMENT
/begin MEASUREMENT VTQD_EBSLostZeroReg_flg "" UBYTE SWC_FDC_type_CM_boolean_flg 0 0 0.0 1.0 ECU_ADDRESS 0x0000 /* @ECU_Address@VTQD_EBSLostZeroReg_flg@ */ /end MEASUREMENT
/begin MEASUREMENT VTQD_EM1TorqueCtrlBrk_flg "" UBYTE SWC_FDC_type_CM_boolean_flg 0 0 0.0 1.0 ECU_ADDRESS 0x0000 /* @ECU_Address@VTQD_EM1TorqueCtrlBrk_flg@ */ /end MEASUREMENT
/begin MEASUREMENT VTQD_EM1TorqueCtrlDriv_flg "" UBYTE SWC_FDC_type_CM_boolean_flg 0 0 0.0 1.0 ECU_ADDRESS 0x0000 /* @ECU_Address@VTQD_EM1TorqueCtrlDriv_flg@ */ /end MEASUREMENT
/begin MEASUREMENT VTQD_ForceDischarge_flg "" UBYTE SWC_FDC_type_CM_boolean_flg 0 0 0.0 1.0 ECU_ADDRESS 0x0000 /* @ECU_Address@VTQD_ForceDischarge_flg@ */ /end MEASUREMENT
/begin MEASUREMENT VTQD_MDHalbrakeReq_flg "" UBYTE SWC_FDC_type_CM_boolean_flg 0 0 0.0 1.0 ECU_ADDRESS 0x0000 /* @ECU_Address@VTQD_MDHalbrakeReq_flg@ */ /end MEASUREMENT
/begin MEASUREMENT VTQD_ActMDDoorOPSta_flg "" UBYTE SWC_FDC_type_CM_boolean_flg 0 0 0.0 1.0 ECU_ADDRESS 0x0000 /* @ECU_Address@VTQD_ActMDDoorOPSta_flg@ */ /end MEASUREMENT
/begin MEASUREMENT VTQD_FRHalbrakeReq_flg "" UBYTE SWC_FDC_type_CM_boolean_flg 0 0 0.0 1.0 ECU_ADDRESS 0x0000 /* @ECU_Address@VTQD_FRHalbrakeReq_flg@ */ /end MEASUREMENT
/begin MEASUREMENT VTQD_ActFRDoorOPSta_flg "" UBYTE SWC_FDC_type_CM_boolean_flg 0 0 0.0 1.0 ECU_ADDRESS 0x0000 /* @ECU_Address@VTQD_ActFRDoorOPSta_flg@ */ /end MEASUREMENT
/begin MEASUREMENT VTQD_TDHalbrakeReq_flg "" UBYTE SWC_FDC_type_CM_boolean_flg 0 0 0.0 1.0 ECU_ADDRESS 0x0000 /* @ECU_Address@VTQD_TDHalbrakeReq_flg@ */ /end MEASUREMENT
/begin MEASUREMENT VTQD_ActTDDoorOPSta_flg "" UBYTE SWC_FDC_type_CM_boolean_flg 0 0 0.0 1.0 ECU_ADDRESS 0x0000 /* @ECU_Address@VTQD_ActTDDoorOPSta_flg@ */ /end MEASUREMENT
/begin MEASUREMENT VTQD_DoorOpen_flg "" UBYTE SWC_FDC_type_CM_boolean_flg 0 0 0.0 1.0 ECU_ADDRESS 0x0000 /* @ECU_Address@VTQD_DoorOpen_flg@ */ /end MEASUREMENT
/begin MEASUREMENT VTQD_LostComTempMCU_flg "" UBYTE SWC_FDC_type_CM_boolean_flg 0 0 0.0 1.0 ECU_ADDRESS 0x0000 /* @ECU_Address@VTQD_LostComTempMCU_flg@ */ /end MEASUREMENT
/begin MEASUREMENT VTQD_LostComBCU_flg "" UBYTE SWC_FDC_type_CM_boolean_flg 0 0 0.0 1.0 ECU_ADDRESS 0x0000 /* @ECU_Address@VTQD_LostComBCU_flg@ */ /end MEASUREMENT
/begin MEASUREMENT VTQD_ComLostZeroPwr_flg "" UBYTE SWC_FDC_type_CM_boolean_flg 0 0 0.0 1.0 ECU_ADDRESS 0x0000 /* @ECU_Address@VTQD_ComLostZeroPwr_flg@ */ /end MEASUREMENT
/begin MEASUREMENT VTQD_LVchrgSvrModeDelay_flg "" UBYTE SWC_FDC_type_CM_boolean_flg 0 0 0.0 1.0 ECU_ADDRESS 0x0000 /* @ECU_Address@VTQD_LVchrgSvrModeDelay_flg@ */ /end MEASUREMENT
/begin MEASUREMENT VTQD_EngModeOnSig_flg "" UBYTE SWC_FDC_type_CM_boolean_flg 0 0 0.0 1.0 ECU_ADDRESS 0x0000 /* @ECU_Address@VTQD_EngModeOnSig_flg@ */ /end MEASUREMENT
/begin MEASUREMENT VTQD_EngModeOnRiseDet_flg "" UBYTE SWC_FDC_type_CM_boolean_flg 0 0 0.0 1.0 ECU_ADDRESS 0x0000 /* @ECU_Address@VTQD_EngModeOnRiseDet_flg@ */ /end MEASUREMENT
/begin MEASUREMENT VTQD_EngModeOffSig_flg "" UBYTE SWC_FDC_type_CM_boolean_flg 0 0 0.0 1.0 ECU_ADDRESS 0x0000 /* @ECU_Address@VTQD_EngModeOffSig_flg@ */ /end MEASUREMENT
/begin MEASUREMENT VTQD_EngModeOffRiseDet_flg "" UBYTE SWC_FDC_type_CM_boolean_flg 0 0 0.0 1.0 ECU_ADDRESS 0x0000 /* @ECU_Address@VTQD_EngModeOffRiseDet_flg@ */ /end MEASUREMENT
/begin MEASUREMENT VTQD_EngModeDisDetEnd_flg "" UBYTE SWC_FDC_type_CM_boolean_flg 0 0 0.0 1.0 ECU_ADDRESS 0x0000 /* @ECU_Address@VTQD_EngModeDisDetEnd_flg@ */ /end MEASUREMENT
/begin MEASUREMENT VTQD_EngModeOffDelay_flg "" UBYTE SWC_FDC_type_CM_boolean_flg 0 0 0.0 1.0 ECU_ADDRESS 0x0000 /* @ECU_Address@VTQD_EngModeOffDelay_flg@ */ /end MEASUREMENT
/begin MEASUREMENT VTQD_EngModeEnDetEnd_flg "" UBYTE SWC_FDC_type_CM_boolean_flg 0 0 0.0 1.0 ECU_ADDRESS 0x0000 /* @ECU_Address@VTQD_EngModeEnDetEnd_flg@ */ /end MEASUREMENT
/begin MEASUREMENT VTQD_EngModeOnDelay_flg "" UBYTE SWC_FDC_type_CM_boolean_flg 0 0 0.0 1.0 ECU_ADDRESS 0x0000 /* @ECU_Address@VTQD_EngModeOnDelay_flg@ */ /end MEASUREMENT
/begin MEASUREMENT VTQD_InitLVchrgSvrMode_flg "" UBYTE SWC_FDC_type_CM_boolean_flg 0 0 0.0 1.0 ECU_ADDRESS 0x0000 /* @ECU_Address@VTQD_InitLVchrgSvrMode_flg@ */ /end MEASUREMENT
/begin MEASUREMENT VTQD_EngModeDisFlashFinished_flg "" UBYTE SWC_FDC_type_CM_boolean_flg 0 0 0.0 1.0 ECU_ADDRESS 0x0000 /* @ECU_Address@VTQD_EngModeDisFlashFinished_flg@ */ /end MEASUREMENT
/begin MEASUREMENT VTQD_EngModeEnFlashFinished_flg "" UBYTE SWC_FDC_type_CM_boolean_flg 0 0 0.0 1.0 ECU_ADDRESS 0x0000 /* @ECU_Address@VTQD_EngModeEnFlashFinished_flg@ */ /end MEASUREMENT
/begin MEASUREMENT VTQD_LVchrgSvrMode_flg "" UBYTE SWC_FDC_type_CM_boolean_flg 0 0 0.0 1.0 ECU_ADDRESS 0x0000 /* @ECU_Address@VTQD_LVchrgSvrMode_flg@ */ /end MEASUREMENT
/begin MEASUREMENT VTQD_LostComTempBCU_flg "" UBYTE SWC_FDC_type_CM_boolean_flg 0 0 0.0 1.0 ECU_ADDRESS 0x0000 /* @ECU_Address@VTQD_LostComTempBCU_flg@ */ /end MEASUREMENT
/begin MEASUREMENT VTQD_EM1LimitCtrlBrk_flg "" UBYTE SWC_FDC_type_CM_boolean_flg 0 0 0.0 1.0 ECU_ADDRESS 0x0000 /* @ECU_Address@VTQD_EM1LimitCtrlBrk_flg@ */ /end MEASUREMENT
/begin MEASUREMENT VTQD_TrqForceZero_flg "" UBYTE SWC_FDC_type_CM_boolean_flg 0 0 0.0 1.0 ECU_ADDRESS 0x0000 /* @ECU_Address@VTQD_TrqForceZero_flg@ */ /end MEASUREMENT
/begin MEASUREMENT VTQD_TrqCMDForveZero_flg "" UBYTE SWC_FDC_type_CM_boolean_flg 0 0 0.0 1.0 ECU_ADDRESS 0x0000 /* @ECU_Address@VTQD_TrqCMDForveZero_flg@ */ /end MEASUREMENT
/begin MEASUREMENT VTQD_AmberFlashOn_flg "" UBYTE SWC_FDC_type_CM_boolean_flg 0 0 0.0 1.0 ECU_ADDRESS 0x0000 /* @ECU_Address@VTQD_AmberFlashOn_flg@ */ /end MEASUREMENT
/begin MEASUREMENT VTQD_PwrUpBuzzer_flg "" UBYTE SWC_FDC_type_CM_boolean_flg 0 0 0.0 1.0 ECU_ADDRESS 0x0000 /* @ECU_Address@VTQD_PwrUpBuzzer_flg@ */ /end MEASUREMENT
/begin MEASUREMENT VTQD_ReadyBuzzer_flg "" UBYTE SWC_FDC_type_CM_boolean_flg 0 0 0.0 1.0 ECU_ADDRESS 0x0000 /* @ECU_Address@VTQD_ReadyBuzzer_flg@ */ /end MEASUREMENT
/begin MEASUREMENT VTQD_PwrFailBuzzer_flg "" UBYTE SWC_FDC_type_CM_boolean_flg 0 0 0.0 1.0 ECU_ADDRESS 0x0000 /* @ECU_Address@VTQD_PwrFailBuzzer_flg@ */ /end MEASUREMENT
/begin MEASUREMENT VTQD_ComboKeyBuzzer_flg "" UBYTE SWC_FDC_type_CM_boolean_flg 0 0 0.0 1.0 ECU_ADDRESS 0x0000 /* @ECU_Address@VTQD_ComboKeyBuzzer_flg@ */ /end MEASUREMENT
/begin MEASUREMENT VTQD_VCUBCMBuzzReq_flg "" UBYTE SWC_FDC_type_CM_boolean_flg 0 0 0.0 1.0 ECU_ADDRESS 0x0000 /* @ECU_Address@VTQD_VCUBCMBuzzReq_flg@ */ /end MEASUREMENT
/begin MEASUREMENT VTQD_SpdLimit_flg "" UBYTE SWC_FDC_type_CM_boolean_flg 0 0 0.0 1.0 ECU_ADDRESS 0x0000 /* @ECU_Address@VTQD_SpdLimit_flg@ */ /end MEASUREMENT
/begin MEASUREMENT VTQD_SpdForceZero_flg "" UBYTE SWC_FDC_type_CM_boolean_flg 0 0 0.0 1.0 ECU_ADDRESS 0x0000 /* @ECU_Address@VTQD_SpdForceZero_flg@ */ /end MEASUREMENT
/begin MEASUREMENT VSCP_SpdInRange_flg "" UBYTE SWC_FDC_type_CM_boolean_flg 0 0 0.0 1.0 ECU_ADDRESS 0x0000 /* @ECU_Address@VSCP_SpdInRange_flg@ */ /end MEASUREMENT
/begin MEASUREMENT VTQD_SpdLimSta_flg "" UBYTE SWC_FDC_type_CM_boolean_flg 0 0 0.0 1.0 ECU_ADDRESS 0x0000 /* @ECU_Address@VTQD_SpdLimSta_flg@ */ /end MEASUREMENT
/begin MEASUREMENT VTQD_GearFlashIndDis_flg "" UBYTE SWC_FDC_type_CM_boolean_flg 0 0 0.0 1.0 ECU_ADDRESS 0x0000 /* @ECU_Address@VTQD_GearFlashIndDis_flg@ */ /end MEASUREMENT
/begin MEASUREMENT VTQD_SpdLimInd_flg "" UBYTE SWC_FDC_type_CM_boolean_flg 0 0 0.0 1.0 ECU_ADDRESS 0x0000 /* @ECU_Address@VTQD_SpdLimInd_flg@ */ /end MEASUREMENT
/begin MEASUREMENT VTQD_VCU4PweLmtInd_flg "" UBYTE SWC_FDC_type_CM_boolean_flg 0 0 0.0 1.0 ECU_ADDRESS 0x0000 /* @ECU_Address@VTQD_VCU4PweLmtInd_flg@ */ /end MEASUREMENT
/begin MEASUREMENT VTQD_TqReductEnable_flg "" UBYTE SWC_FDC_type_CM_boolean_flg 0 0 0.0 1.0 ECU_ADDRESS 0x0000 /* @ECU_Address@VTQD_TqReductEnable_flg@ */ /end MEASUREMENT
/begin MEASUREMENT VTQD_VCUMCUFootBrk_flg "" UBYTE SWC_FDC_type_CM_boolean_flg 0 0 0.0 1.0 ECU_ADDRESS 0x0000 /* @ECU_Address@VTQD_VCUMCUFootBrk_flg@ */ /end MEASUREMENT
/begin MEASUREMENT VTQD_ActvDmpDisabReq_flg "" UBYTE SWC_FDC_type_CM_boolean_flg 0 0 0.0 1.0 ECU_ADDRESS 0x0000 /* @ECU_Address@VTQD_ActvDmpDisabReq_flg@ */ /end MEASUREMENT
/begin MEASUREMENT VTQD_AmberFlashOff_flg "" UBYTE SWC_FDC_type_CM_boolean_flg 0 0 0.0 1.0 ECU_ADDRESS 0x0000 /* @ECU_Address@VTQD_AmberFlashOff_flg@ */ /end MEASUREMENT
/begin MEASUREMENT VTQD_MotorSpdInV_flg "" UBYTE SWC_FDC_type_CM_boolean_flg 0 0 0.0 1.0 ECU_ADDRESS 0x0000 /* @ECU_Address@VTQD_MotorSpdInV_flg@ */ /end MEASUREMENT
/begin MEASUREMENT VTQD_ActCAN1BUSOFF_flg "" UBYTE SWC_FDC_type_CM_boolean_flg 0 0 0.0 1.0 ECU_ADDRESS 0x0000 /* @ECU_Address@VTQD_ActCAN1BUSOFF_flg@ */ /end MEASUREMENT
/begin MEASUREMENT VTQD_FASpeedInV_flg "" UBYTE SWC_FDC_type_CM_boolean_flg 0 0 0.0 1.0 ECU_ADDRESS 0x0000 /* @ECU_Address@VTQD_FASpeedInV_flg@ */ /end MEASUREMENT
/begin MEASUREMENT VTQD_MotorTrqInV_flg "" UBYTE SWC_FDC_type_CM_boolean_flg 0 0 0.0 1.0 ECU_ADDRESS 0x0000 /* @ECU_Address@VTQD_MotorTrqInV_flg@ */ /end MEASUREMENT
/begin MEASUREMENT VTQD_EM1OvrCtrlMBrkInV_flg "" UBYTE SWC_FDC_type_CM_boolean_flg 0 0 0.0 1.0 ECU_ADDRESS 0x0000 /* @ECU_Address@VTQD_EM1OvrCtrlMBrkInV_flg@ */ /end MEASUREMENT
/begin MEASUREMENT VTQD_EM1ReqTorqLimDrivInV_flg "" UBYTE SWC_FDC_type_CM_boolean_flg 0 0 0.0 1.0 ECU_ADDRESS 0x0000 /* @ECU_Address@VTQD_EM1ReqTorqLimDrivInV_flg@ */ /end MEASUREMENT
/begin MEASUREMENT VTQD_EM1ReqTorqLimBrkInV_flg "" UBYTE SWC_FDC_type_CM_boolean_flg 0 0 0.0 1.0 ECU_ADDRESS 0x0000 /* @ECU_Address@VTQD_EM1ReqTorqLimBrkInV_flg@ */ /end MEASUREMENT
/begin MEASUREMENT VTQD_MCUFailGradeInV_flg "" UBYTE SWC_FDC_type_CM_boolean_flg 0 0 0.0 1.0 ECU_ADDRESS 0x0000 /* @ECU_Address@VTQD_MCUFailGradeInV_flg@ */ /end MEASUREMENT
/begin MEASUREMENT VBCM_FDCBCMInnerBuzzerCmd_flg "" UBYTE SWC_FDC_type_CM_boolean_flg 0 0 0.0 1.0 ECU_ADDRESS 0x0000 /* @ECU_Address@VBCM_FDCBCMInnerBuzzerCmd_flg@ */ /end MEASUREMENT
/begin MEASUREMENT VBCM_FDCBCMLBeamCmd_flg "" UBYTE SWC_FDC_type_CM_boolean_flg 0 0 0.0 1.0 ECU_ADDRESS 0x0000 /* @ECU_Address@VBCM_FDCBCMLBeamCmd_flg@ */ /end MEASUREMENT
/begin MEASUREMENT VBCM_FDCBCMPLampCmd_flg "" UBYTE SWC_FDC_type_CM_boolean_flg 0 0 0.0 1.0 ECU_ADDRESS 0x0000 /* @ECU_Address@VBCM_FDCBCMPLampCmd_flg@ */ /end MEASUREMENT
/begin MEASUREMENT VBCM_FDCBCMHBeamCmd_flg "" UBYTE SWC_FDC_type_CM_boolean_flg 0 0 0.0 1.0 ECU_ADDRESS 0x0000 /* @ECU_Address@VBCM_FDCBCMHBeamCmd_flg@ */ /end MEASUREMENT
/begin MEASUREMENT VBCM_FDCBCMLTurnLpCmd_flg "" UBYTE SWC_FDC_type_CM_boolean_flg 0 0 0.0 1.0 ECU_ADDRESS 0x0000 /* @ECU_Address@VBCM_FDCBCMLTurnLpCmd_flg@ */ /end MEASUREMENT
/begin MEASUREMENT VBCM_FDCBCMSMKLCmd_flg "" UBYTE SWC_FDC_type_CM_boolean_flg 0 0 0.0 1.0 ECU_ADDRESS 0x0000 /* @ECU_Address@VBCM_FDCBCMSMKLCmd_flg@ */ /end MEASUREMENT
/begin MEASUREMENT VBCM_FDCBCMRTurnLpCmd_flg "" UBYTE SWC_FDC_type_CM_boolean_flg 0 0 0.0 1.0 ECU_ADDRESS 0x0000 /* @ECU_Address@VBCM_FDCBCMRTurnLpCmd_flg@ */ /end MEASUREMENT
/begin MEASUREMENT VBCM_FDCBCMSMKRCmd_flg "" UBYTE SWC_FDC_type_CM_boolean_flg 0 0 0.0 1.0 ECU_ADDRESS 0x0000 /* @ECU_Address@VBCM_FDCBCMSMKRCmd_flg@ */ /end MEASUREMENT
/begin MEASUREMENT VBCM_FDCBCMDVRSignalLCmd_flg "" UBYTE SWC_FDC_type_CM_boolean_flg 0 0 0.0 1.0 ECU_ADDRESS 0x0000 /* @ECU_Address@VBCM_FDCBCMDVRSignalLCmd_flg@ */ /end MEASUREMENT
/begin MEASUREMENT VBCM_FDCBCMDVRSignalRCmd_flg "" UBYTE SWC_FDC_type_CM_boolean_flg 0 0 0.0 1.0 ECU_ADDRESS 0x0000 /* @ECU_Address@VBCM_FDCBCMDVRSignalRCmd_flg@ */ /end MEASUREMENT
/begin MEASUREMENT VBCM_FDCBCMTurnBuzzerENSta_flg "" UBYTE SWC_FDC_type_CM_boolean_flg 0 0 0.0 1.0 ECU_ADDRESS 0x0000 /* @ECU_Address@VBCM_FDCBCMTurnBuzzerENSta_flg@ */ /end MEASUREMENT
/begin MEASUREMENT VBCM_FDCBCMBSDBuzzerCmd_flg "" UBYTE SWC_FDC_type_CM_boolean_flg 0 0 0.0 1.0 ECU_ADDRESS 0x0000 /* @ECU_Address@VBCM_FDCBCMBSDBuzzerCmd_flg@ */ /end MEASUREMENT
/begin MEASUREMENT VBCM_FDCBCMSLTLpCmd_flg "" UBYTE SWC_FDC_type_CM_boolean_flg 0 0 0.0 1.0 ECU_ADDRESS 0x0000 /* @ECU_Address@VBCM_FDCBCMSLTLpCmd_flg@ */ /end MEASUREMENT
/begin MEASUREMENT VBCM_FDCBCMSRTLpCmd_flg "" UBYTE SWC_FDC_type_CM_boolean_flg 0 0 0.0 1.0 ECU_ADDRESS 0x0000 /* @ECU_Address@VBCM_FDCBCMSRTLpCmd_flg@ */ /end MEASUREMENT
/begin MEASUREMENT VBCM_FDCBCMStopINDCmd_flg "" UBYTE SWC_FDC_type_CM_boolean_flg 0 0 0.0 1.0 ECU_ADDRESS 0x0000 /* @ECU_Address@VBCM_FDCBCMStopINDCmd_flg@ */ /end MEASUREMENT
/begin MEASUREMENT VBCM_FDCBCMSTOPBALLCmd_flg "" UBYTE SWC_FDC_type_CM_boolean_flg 0 0 0.0 1.0 ECU_ADDRESS 0x0000 /* @ECU_Address@VBCM_FDCBCMSTOPBALLCmd_flg@ */ /end MEASUREMENT
/begin MEASUREMENT VBCM_FDCBCMInnerCallBellCmd_flg "" UBYTE SWC_FDC_type_CM_boolean_flg 0 0 0.0 1.0 ECU_ADDRESS 0x0000 /* @ECU_Address@VBCM_FDCBCMInnerCallBellCmd_flg@ */ /end MEASUREMENT
/begin MEASUREMENT VBCM_FDCBCMCallBellCmd_flg "" UBYTE SWC_FDC_type_CM_boolean_flg 0 0 0.0 1.0 ECU_ADDRESS 0x0000 /* @ECU_Address@VBCM_FDCBCMCallBellCmd_flg@ */ /end MEASUREMENT
/begin MEASUREMENT VBCM_FDCBCMWiperHCmd_flg "" UBYTE SWC_FDC_type_CM_boolean_flg 0 0 0.0 1.0 ECU_ADDRESS 0x0000 /* @ECU_Address@VBCM_FDCBCMWiperHCmd_flg@ */ /end MEASUREMENT
/begin MEASUREMENT VBCM_FDCBCMWasherCmd_flg "" UBYTE SWC_FDC_type_CM_boolean_flg 0 0 0.0 1.0 ECU_ADDRESS 0x0000 /* @ECU_Address@VBCM_FDCBCMWasherCmd_flg@ */ /end MEASUREMENT
/begin MEASUREMENT VBCM_FDCBCMWiperLCmd_flg "" UBYTE SWC_FDC_type_CM_boolean_flg 0 0 0.0 1.0 ECU_ADDRESS 0x0000 /* @ECU_Address@VBCM_FDCBCMWiperLCmd_flg@ */ /end MEASUREMENT
/begin MEASUREMENT VBCM_FDCBCMLDRLCmd_flg "" UBYTE SWC_FDC_type_CM_boolean_flg 0 0 0.0 1.0 ECU_ADDRESS 0x0000 /* @ECU_Address@VBCM_FDCBCMLDRLCmd_flg@ */ /end MEASUREMENT
/begin MEASUREMENT VBCM_FDCBCMRDRLCmd_flg "" UBYTE SWC_FDC_type_CM_boolean_flg 0 0 0.0 1.0 ECU_ADDRESS 0x0000 /* @ECU_Address@VBCM_FDCBCMRDRLCmd_flg@ */ /end MEASUREMENT
/begin MEASUREMENT VBCM_FDCBCMRFLampCmd_flg "" UBYTE SWC_FDC_type_CM_boolean_flg 0 0 0.0 1.0 ECU_ADDRESS 0x0000 /* @ECU_Address@VBCM_FDCBCMRFLampCmd_flg@ */ /end MEASUREMENT
/begin MEASUREMENT VBCM_FDCBCMRoomLpAmbSetSta_flg "" UBYTE SWC_FDC_type_CM_boolean_flg 0 0 0.0 1.0 ECU_ADDRESS 0x0000 /* @ECU_Address@VBCM_FDCBCMRoomLpAmbSetSta_flg@ */ /end MEASUREMENT
/begin MEASUREMENT VBCM_FDCBCMRoomLpAmbCmd_flg "" UBYTE SWC_FDC_type_CM_boolean_flg 0 0 0.0 1.0 ECU_ADDRESS 0x0000 /* @ECU_Address@VBCM_FDCBCMRoomLpAmbCmd_flg@ */ /end MEASUREMENT
/begin MEASUREMENT VBCM_FDCBCMLBSDRCmd_flg "" UBYTE SWC_FDC_type_CM_boolean_flg 0 0 0.0 1.0 ECU_ADDRESS 0x0000 /* @ECU_Address@VBCM_FDCBCMLBSDRCmd_flg@ */ /end MEASUREMENT
/begin MEASUREMENT VBCM_FDCBCMLBSDYCmd_flg "" UBYTE SWC_FDC_type_CM_boolean_flg 0 0 0.0 1.0 ECU_ADDRESS 0x0000 /* @ECU_Address@VBCM_FDCBCMLBSDYCmd_flg@ */ /end MEASUREMENT
/begin MEASUREMENT VBCM_FDCBCMRBSDRCmd_flg "" UBYTE SWC_FDC_type_CM_boolean_flg 0 0 0.0 1.0 ECU_ADDRESS 0x0000 /* @ECU_Address@VBCM_FDCBCMRBSDRCmd_flg@ */ /end MEASUREMENT
/begin MEASUREMENT VBCM_FDCBCMRBSDYCmd_flg "" UBYTE SWC_FDC_type_CM_boolean_flg 0 0 0.0 1.0 ECU_ADDRESS 0x0000 /* @ECU_Address@VBCM_FDCBCMRBSDYCmd_flg@ */ /end MEASUREMENT
/begin MEASUREMENT VBCM_FDCBCMEmExitSWSta_flg "" UBYTE SWC_FDC_type_CM_boolean_flg 0 0 0.0 1.0 ECU_ADDRESS 0x0000 /* @ECU_Address@VBCM_FDCBCMEmExitSWSta_flg@ */ /end MEASUREMENT
/begin MEASUREMENT VBCM_FDCBCMRoomLpSetSta_flg "" UBYTE SWC_FDC_type_CM_boolean_flg 0 0 0.0 1.0 ECU_ADDRESS 0x0000 /* @ECU_Address@VBCM_FDCBCMRoomLpSetSta_flg@ */ /end MEASUREMENT
/begin MEASUREMENT VBCM_FDCBCMHelpINDCmd_flg "" UBYTE SWC_FDC_type_CM_boolean_flg 0 0 0.0 1.0 ECU_ADDRESS 0x0000 /* @ECU_Address@VBCM_FDCBCMHelpINDCmd_flg@ */ /end MEASUREMENT
/begin MEASUREMENT VBCM_FDCBCMEmSVCmd_flg "" UBYTE SWC_FDC_type_CM_boolean_flg 0 0 0.0 1.0 ECU_ADDRESS 0x0000 /* @ECU_Address@VBCM_FDCBCMEmSVCmd_flg@ */ /end MEASUREMENT
/begin MEASUREMENT VBCM_FDCBCMFDOpenSVCmd_flg "" UBYTE SWC_FDC_type_CM_boolean_flg 0 0 0.0 1.0 ECU_ADDRESS 0x0000 /* @ECU_Address@VBCM_FDCBCMFDOpenSVCmd_flg@ */ /end MEASUREMENT
/begin MEASUREMENT VBCM_FDCBCMFDCloseSVCmd_flg "" UBYTE SWC_FDC_type_CM_boolean_flg 0 0 0.0 1.0 ECU_ADDRESS 0x0000 /* @ECU_Address@VBCM_FDCBCMFDCloseSVCmd_flg@ */ /end MEASUREMENT
/begin MEASUREMENT VBCM_FDCBCMMDOpenSVCmd_flg "" UBYTE SWC_FDC_type_CM_boolean_flg 0 0 0.0 1.0 ECU_ADDRESS 0x0000 /* @ECU_Address@VBCM_FDCBCMMDOpenSVCmd_flg@ */ /end MEASUREMENT
/begin MEASUREMENT VBCM_FDCBCMMDCloseSVCmd_flg "" UBYTE SWC_FDC_type_CM_boolean_flg 0 0 0.0 1.0 ECU_ADDRESS 0x0000 /* @ECU_Address@VBCM_FDCBCMMDCloseSVCmd_flg@ */ /end MEASUREMENT
/begin MEASUREMENT VBCM_FDCBCMLTurnSWSta_flg "" UBYTE SWC_FDC_type_CM_boolean_flg 0 0 0.0 1.0 ECU_ADDRESS 0x0000 /* @ECU_Address@VBCM_FDCBCMLTurnSWSta_flg@ */ /end MEASUREMENT
/begin MEASUREMENT VBCM_FDCBCMRTurnSWSta_flg "" UBYTE SWC_FDC_type_CM_boolean_flg 0 0 0.0 1.0 ECU_ADDRESS 0x0000 /* @ECU_Address@VBCM_FDCBCMRTurnSWSta_flg@ */ /end MEASUREMENT
/begin MEASUREMENT VBCM_FDCBCMBrakeCmd_flg "" UBYTE SWC_FDC_type_CM_boolean_flg 0 0 0.0 1.0 ECU_ADDRESS 0x0000 /* @ECU_Address@VBCM_FDCBCMBrakeCmd_flg@ */ /end MEASUREMENT
/begin MEASUREMENT VBCM_WakeUp_flg "" UBYTE SWC_FDC_type_CM_boolean_flg 0 0 0.0 1.0 ECU_ADDRESS 0x0000 /* @ECU_Address@VBCM_WakeUp_flg@ */ /end MEASUREMENT
/begin MEASUREMENT VBCM_KeepWakeUp_flg "" UBYTE SWC_FDC_type_CM_boolean_flg 0 0 0.0 1.0 ECU_ADDRESS 0x0000 /* @ECU_Address@VBCM_KeepWakeUp_flg@ */ /end MEASUREMENT
/begin MEASUREMENT VBCM_FDCBCMRGearSta_flg "" UBYTE SWC_FDC_type_CM_boolean_flg 0 0 0.0 1.0 ECU_ADDRESS 0x0000 /* @ECU_Address@VBCM_FDCBCMRGearSta_flg@ */ /end MEASUREMENT
/begin MEASUREMENT VPMM_VCUMCUFailRst_flg "" UBYTE SWC_FDC_type_CM_boolean_flg 0 0 0.0 1.0 ECU_ADDRESS 0x0000 /* @ECU_Address@VPMM_VCUMCUFailRst_flg@ */ /end MEASUREMENT
/begin MEASUREMENT VPMM_VSPReversed_flg "" UBYTE SWC_FDC_type_CM_boolean_flg 0 0 0.0 1.0 ECU_ADDRESS 0x0000 /* @ECU_Address@VPMM_VSPReversed_flg@ */ /end MEASUREMENT
/begin MEASUREMENT VPMM_IRCRlyClose_flg "" UBYTE SWC_FDC_type_CM_boolean_flg 0 0 0.0 1.0 ECU_ADDRESS 0x0000 /* @ECU_Address@VPMM_IRCRlyClose_flg@ */ /end MEASUREMENT
/begin MEASUREMENT VPMM_IGNRlyClose_flg "" UBYTE SWC_FDC_type_CM_boolean_flg 0 0 0.0 1.0 ECU_ADDRESS 0x0000 /* @ECU_Address@VPMM_IGNRlyClose_flg@ */ /end MEASUREMENT
/begin MEASUREMENT VPMM_PMMDCDCEnableDem_flg "" UBYTE SWC_FDC_type_CM_boolean_flg 0 0 0.0 1.0 ECU_ADDRESS 0x0000 /* @ECU_Address@VPMM_PMMDCDCEnableDem_flg@ */ /end MEASUREMENT
/begin MEASUREMENT VPMM_PowerUpInhibit_flg "" UBYTE SWC_FDC_type_CM_boolean_flg 0 0 0.0 1.0 ECU_ADDRESS 0x0000 /* @ECU_Address@VPMM_PowerUpInhibit_flg@ */ /end MEASUREMENT
/begin MEASUREMENT VPMM_PowerDownCompleted_flg "" UBYTE SWC_FDC_type_CM_boolean_flg 0 0 0.0 1.0 ECU_ADDRESS 0x0000 /* @ECU_Address@VPMM_PowerDownCompleted_flg@ */ /end MEASUREMENT
/begin MEASUREMENT VPMM_PowerUpComplete_flg "" UBYTE SWC_FDC_type_CM_boolean_flg 0 0 0.0 1.0 ECU_ADDRESS 0x0000 /* @ECU_Address@VPMM_PowerUpComplete_flg@ */ /end MEASUREMENT
/begin MEASUREMENT VPMM_VCUMCUEn_flg "" UBYTE SWC_FDC_type_CM_boolean_flg 0 0 0.0 1.0 ECU_ADDRESS 0x0000 /* @ECU_Address@VPMM_VCUMCUEn_flg@ */ /end MEASUREMENT
/begin MEASUREMENT VPMM_PMMEACEnableDem_flg "" UBYTE SWC_FDC_type_CM_boolean_flg 0 0 0.0 1.0 ECU_ADDRESS 0x0000 /* @ECU_Address@VPMM_PMMEACEnableDem_flg@ */ /end MEASUREMENT
/begin MEASUREMENT VPMM_PMMEHPSEnableDem_flg "" UBYTE SWC_FDC_type_CM_boolean_flg 0 0 0.0 1.0 ECU_ADDRESS 0x0000 /* @ECU_Address@VPMM_PMMEHPSEnableDem_flg@ */ /end MEASUREMENT
/begin MEASUREMENT VPMM_EHPSIniFinish_flg "" UBYTE SWC_FDC_type_CM_boolean_flg 0 0 0.0 1.0 ECU_ADDRESS 0x0000 /* @ECU_Address@VPMM_EHPSIniFinish_flg@ */ /end MEASUREMENT
/begin MEASUREMENT VPMM_EACEnableCompleted_flg "" UBYTE SWC_FDC_type_CM_boolean_flg 0 0 0.0 1.0 ECU_ADDRESS 0x0000 /* @ECU_Address@VPMM_EACEnableCompleted_flg@ */ /end MEASUREMENT
/begin MEASUREMENT VPMM_ChrgPowerUpFail_flg "" UBYTE SWC_FDC_type_CM_boolean_flg 0 0 0.0 1.0 ECU_ADDRESS 0x0000 /* @ECU_Address@VPMM_ChrgPowerUpFail_flg@ */ /end MEASUREMENT
/begin MEASUREMENT VSCP_CFGEM1BAMPGN_raw "" ULONG SWC_FDC_type_CM_uint32_raw 0 0 0.0 4.294967295E+9 ECU_ADDRESS 0x0000 /* @ECU_Address@VSCP_CFGEM1BAMPGN_raw@ */ /end MEASUREMENT
/begin MEASUREMENT VSCP_CFGEM1BAMTSize_raw "" UWORD SWC_FDC_type_CM_uint16_raw 0 0 0.0 65535.0 ECU_ADDRESS 0x0000 /* @ECU_Address@VSCP_CFGEM1BAMTSize_raw@ */ /end MEASUREMENT
/begin MEASUREMENT VSCP_CFGEM1Ctrl_raw "" UBYTE SWC_FDC_type_CM_uint8_raw 0 0 0.0 255.0 ECU_ADDRESS 0x0000 /* @ECU_Address@VSCP_CFGEM1Ctrl_raw@ */ /end MEASUREMENT
/begin MEASUREMENT VSCP_CFGEM1BAMTNum_raw "" UBYTE SWC_FDC_type_CM_uint8_raw 0 0 0.0 255.0 ECU_ADDRESS 0x0000 /* @ECU_Address@VSCP_CFGEM1BAMTNum_raw@ */ /end MEASUREMENT
/begin MEASUREMENT VSCP_CFGEM1BAMRsv_raw "" UBYTE SWC_FDC_type_CM_uint8_raw 0 0 0.0 255.0 ECU_ADDRESS 0x0000 /* @ECU_Address@VSCP_CFGEM1BAMRsv_raw@ */ /end MEASUREMENT
/begin MEASUREMENT VSCP_DTbyte0_raw "" UBYTE SWC_FDC_type_CM_uint8_raw 0 0 0.0 255.0 ECU_ADDRESS 0x0000 /* @ECU_Address@VSCP_DTbyte0_raw@ */ /end MEASUREMENT
/begin MEASUREMENT VSCP_DTbyte1_raw "" UBYTE SWC_FDC_type_CM_uint8_raw 0 0 0.0 255.0 ECU_ADDRESS 0x0000 /* @ECU_Address@VSCP_DTbyte1_raw@ */ /end MEASUREMENT
/begin MEASUREMENT VSCP_DTbyte2_raw "" UBYTE SWC_FDC_type_CM_uint8_raw 0 0 0.0 255.0 ECU_ADDRESS 0x0000 /* @ECU_Address@VSCP_DTbyte2_raw@ */ /end MEASUREMENT
/begin MEASUREMENT VSCP_DTbyte3_raw "" UBYTE SWC_FDC_type_CM_uint8_raw 0 0 0.0 255.0 ECU_ADDRESS 0x0000 /* @ECU_Address@VSCP_DTbyte3_raw@ */ /end MEASUREMENT
/begin MEASUREMENT VSCP_DTbyte4_raw "" UBYTE SWC_FDC_type_CM_uint8_raw 0 0 0.0 255.0 ECU_ADDRESS 0x0000 /* @ECU_Address@VSCP_DTbyte4_raw@ */ /end MEASUREMENT
/begin MEASUREMENT VSCP_DTbyte5_raw "" UBYTE SWC_FDC_type_CM_uint8_raw 0 0 0.0 255.0 ECU_ADDRESS 0x0000 /* @ECU_Address@VSCP_DTbyte5_raw@ */ /end MEASUREMENT
/begin MEASUREMENT VSCP_DTbyte6_raw "" UBYTE SWC_FDC_type_CM_uint8_raw 0 0 0.0 255.0 ECU_ADDRESS 0x0000 /* @ECU_Address@VSCP_DTbyte6_raw@ */ /end MEASUREMENT
/begin MEASUREMENT VSCP_DTbyte7_raw "" UBYTE SWC_FDC_type_CM_uint8_raw 0 0 0.0 255.0 ECU_ADDRESS 0x0000 /* @ECU_Address@VSCP_DTbyte7_raw@ */ /end MEASUREMENT
/begin MEASUREMENT VSCP_triggerBAM_flg "" UBYTE SWC_FDC_type_CM_boolean_flg 0 0 0.0 1.0 ECU_ADDRESS 0x0000 /* @ECU_Address@VSCP_triggerBAM_flg@ */ /end MEASUREMENT
/begin MEASUREMENT VSCP_triggerDT_flg "" UBYTE SWC_FDC_type_CM_boolean_flg 0 0 0.0 1.0 ECU_ADDRESS 0x0000 /* @ECU_Address@VSCP_triggerDT_flg@ */ /end MEASUREMENT
/begin MEASUREMENT SWC_FDC_type_DW.tp_Powerdown "" UBYTE SWC_FDC_type_CM_uint8 0 0 0 255 ECU_ADDRESS 0x0000 /* @ECU_Address@SWC_FDC_type_DW.tp_Powerdown@ */ /end MEASUREMENT
/begin COMPU_METHOD SWC_FDC_type_CM_single_rpm "Q = V" RAT_FUNC "%8.6" "rpm" COEFFS 0 1 0 0 0 1 /end COMPU_METHOD
/begin COMPU_METHOD SWC_FDC_type_CM_single_eum "Q = V" RAT_FUNC "%8.6" "eum" COEFFS 0 1 0 0 0 1 /end COMPU_METHOD
/begin COMPU_METHOD SWC_FDC_type_CM_single_rad "Q = V" RAT_FUNC "%8.6" "rad" COEFFS 0 1 0 0 0 1 /end COMPU_METHOD
/begin COMPU_METHOD SWC_FDC_type_CM_single_C "Q = V" RAT_FUNC "%8.6" "C" COEFFS 0 1 0 0 0 1 /end COMPU_METHOD
/begin COMPU_METHOD SWC_FDC_type_CM_single_pct "Q = V" RAT_FUNC "%8.6" "pct" COEFFS 0 1 0 0 0 1 /end COMPU_METHOD
/begin COMPU_METHOD SWC_FDC_type_CM_single_Gain "Q = V" RAT_FUNC "%8.6" "Gain" COEFFS 0 1 0 0 0 1 /end COMPU_METHOD
/begin COMPU_METHOD SWC_FDC_type_CM_single_Nm "Q = V" RAT_FUNC "%8.6" "Nm" COEFFS 0 1 0 0 0 1 /end COMPU_METHOD
/begin COMPU_METHOD SWC_FDC_type_CM_single_enum "Q = V" RAT_FUNC "%8.6" "enum" COEFFS 0 1 0 0 0 1 /end COMPU_METHOD
/begin COMPU_METHOD SWC_FDC_type_CM_single_gain "Q = V" RAT_FUNC "%8.6" "gain" COEFFS 0 1 0 0 0 1 /end COMPU_METHOD
/begin COMPU_METHOD SWC_FDC_type_CM_single_A "Q = V" RAT_FUNC "%8.6" "A" COEFFS 0 1 0 0 0 1 /end COMPU_METHOD
/begin COMPU_METHOD SWC_FDC_type_CM_single_s "Q = V" RAT_FUNC "%8.6" "s" COEFFS 0 1 0 0 0 1 /end COMPU_METHOD
/begin COMPU_METHOD SWC_FDC_type_CM_single_min "Q = V" RAT_FUNC "%8.6" "min" COEFFS 0 1 0 0 0 1 /end COMPU_METHOD
/begin COMPU_METHOD SWC_FDC_type_CM_single_kPa "Q = V" RAT_FUNC "%8.6" "kPa" COEFFS 0 1 0 0 0 1 /end COMPU_METHOD
/begin COMPU_METHOD SWC_FDC_type_CM_single_degC "Q = V" RAT_FUNC "%8.6" "degC" COEFFS 0 1 0 0 0 1 /end COMPU_METHOD
/begin COMPU_METHOD SWC_FDC_type_CM_single_kph "Q = V" RAT_FUNC "%8.6" "kph" COEFFS 0 1 0 0 0 1 /end COMPU_METHOD
/begin COMPU_METHOD SWC_FDC_type_CM_single_mA "Q = V" RAT_FUNC "%8.6" "mA" COEFFS 0 1 0 0 0 1 /end COMPU_METHOD
/begin COMPU_METHOD SWC_FDC_type_CM_single_V "Q = V" RAT_FUNC "%8.6" "V" COEFFS 0 1 0 0 0 1 /end COMPU_METHOD
/begin COMPU_METHOD SWC_FDC_type_CM_single_cnt "Q = V" RAT_FUNC "%8.6" "cnt" COEFFS 0 1 0 0 0 1 /end COMPU_METHOD
/begin COMPU_METHOD SWC_FDC_type_CM_single_v "Q = V" RAT_FUNC "%8.6" "v" COEFFS 0 1 0 0 0 1 /end COMPU_METHOD
/begin COMPU_METHOD SWC_FDC_type_CM_single_c "Q = V" RAT_FUNC "%8.6" "c" COEFFS 0 1 0 0 0 1 /end COMPU_METHOD
/begin COMPU_METHOD SWC_FDC_type_CM_single_mps2 "Q = V" RAT_FUNC "%8.6" "mps2" COEFFS 0 1 0 0 0 1 /end COMPU_METHOD
/begin COMPU_METHOD SWC_FDC_type_CM_single_rate "Q = V" RAT_FUNC "%8.6" "rate" COEFFS 0 1 0 0 0 1 /end COMPU_METHOD
/begin COMPU_METHOD SWC_FDC_type_CM_single_kW "Q = V" RAT_FUNC "%8.6" "kW" COEFFS 0 1 0 0 0 1 /end COMPU_METHOD
/begin COMPU_METHOD SWC_FDC_type_CM_single_Factor "Q = V" RAT_FUNC "%8.6" "Factor" COEFFS 0 1 0 0 0 1 /end COMPU_METHOD
/begin COMPU_METHOD SWC_FDC_type_CM_single_ratio "Q = V" RAT_FUNC "%8.6" "ratio" COEFFS 0 1 0 0 0 1 /end COMPU_METHOD
/begin COMPU_METHOD SWC_FDC_type_CM_single_m "Q = V" RAT_FUNC "%8.6" "m" COEFFS 0 1 0 0 0 1 /end COMPU_METHOD
/begin COMPU_METHOD SWC_FDC_type_CM_uint16_cnt "Q = V" RAT_FUNC "%5.0" "cnt" COEFFS 0 1 0 0 0 1 /end COMPU_METHOD
/begin COMPU_METHOD SWC_FDC_type_CM_boolean_flg "Q = V" RAT_FUNC "%1.0" "flg" COEFFS 0 1 0 0 0 1 /end COMPU_METHOD
/begin COMPU_METHOD SWC_FDC_type_CM_boolean_flag "Q = V" RAT_FUNC "%1.0" "flag" COEFFS 0 1 0 0 0 1 /end COMPU_METHOD
/begin COMPU_METHOD SWC_FDC_type_CM_uint8_enum "Q = V" RAT_FUNC "%3.0" "enum" COEFFS 0 1 0 0 0 1 /end COMPU_METHOD
/begin COMPU_METHOD SWC_FDC_type_CM_uint8_cnt "Q = V" RAT_FUNC "%3.0" "cnt" COEFFS 0 1 0 0 0 1 /end COMPU_METHOD
/begin COMPU_METHOD SWC_FDC_type_CM_uint8_kph "Q = V" RAT_FUNC "%3.0" "kph" COEFFS 0 1 0 0 0 1 /end COMPU_METHOD
/begin COMPU_METHOD SWC_FDC_type_CM_single_kpa "Q = V" RAT_FUNC "%8.6" "kpa" COEFFS 0 1 0 0 0 1 /end COMPU_METHOD
/begin COMPU_METHOD SWC_FDC_type_CM_single_kgpm2 "Q = V" RAT_FUNC "%8.6" "kgpm2" COEFFS 0 1 0 0 0 1 /end COMPU_METHOD
/begin COMPU_METHOD SWC_FDC_type_CM_uint8_pct "Q = V" RAT_FUNC "%3.0" "pct" COEFFS 0 1 0 0 0 1 /end COMPU_METHOD
/begin COMPU_METHOD SWC_FDC_type_CM_uint32_raw "Q = V" RAT_FUNC "%10.0" "raw" COEFFS 0 1 0 0 0 1 /end COMPU_METHOD
/begin COMPU_METHOD SWC_FDC_type_CM_uint16_raw "Q = V" RAT_FUNC "%5.0" "raw" COEFFS 0 1 0 0 0 1 /end COMPU_METHOD
/begin COMPU_METHOD SWC_FDC_type_CM_uint8_raw "Q = V" RAT_FUNC "%3.0" "raw" COEFFS 0 1 0 0 0 1 /end COMPU_METHOD
/begin COMPU_METHOD SWC_FDC_type_CM_uint8 "Q = V" RAT_FUNC "%3.0" "" COEFFS 0 1 0 0 0 1 /end COMPU_METHOD
/begin GROUP SWC_FDC_type "SWC_FDC_type" /* Root */ ROOT /begin SUB_GROUP Root_run_SWC_FDC_RxTx_5ms_sys /end SUB_GROUP /end GROUP
/begin GROUP Root_run_SWC_FDC_RxTx_5ms_sys "SWC_FDC_type/run_SWC_FDC_RxTx_5ms_sys" /begin SUB_GROUP S2_APP /end SUB_GROUP /end GROUP
/begin GROUP S2_APP "SWC_FDC_type/run_SWC_FDC_RxTx_5ms_sys/APP" /begin SUB_GROUP S3_ACC S3_BCM S3_DHP S3_PMM S3_PSA S3_SCP S3_THC S3_TQD /end SUB_GROUP /end GROUP
/begin GROUP S3_ACC "SWC_FDC_type/run_SWC_FDC_RxTx_5ms_sys/APP/ACC" /begin SUB_GROUP S16_Input_Convert S16_Main S16_OutpConvert S16_SCP_In /end SUB_GROUP /end GROUP
/begin GROUP S3_BCM "SWC_FDC_type/run_SWC_FDC_RxTx_5ms_sys/APP/BCM" /begin SUB_GROUP S18_Subsystem /end SUB_GROUP /end GROUP
/begin GROUP S3_DHP "SWC_FDC_type/run_SWC_FDC_RxTx_5ms_sys/APP/DHP" /begin SUB_GROUP S19_DHP /end SUB_GROUP
 /begin REF_CHARACTERISTIC KDHP_EAPS1MINMem_pct KDHP_EAPS2MINMem_pct KDHP_LVBattDet12V_V KDHP_ResetPedalZeroPosReq_enum /end REF_CHARACTERISTIC
/end GROUP
/begin GROUP S3_PMM "SWC_FDC_type/run_SWC_FDC_RxTx_5ms_sys/APP/PMM" /begin SUB_GROUP S20_PowerModeManagement /end SUB_GROUP
 /begin REF_CHARACTERISTIC KPMM_ACPrechrgRlySts_enum KPMM_FakeHVILDuty_pct KPMM_FakeLVBattVol_V /end REF_CHARACTERISTIC
/end GROUP
/begin GROUP S3_PSA "SWC_FDC_type/run_SWC_FDC_RxTx_5ms_sys/APP/PSA" /begin SUB_GROUP S21_PSA /end SUB_GROUP /end GROUP
/begin GROUP S3_SCP "SWC_FDC_type/run_SWC_FDC_RxTx_5ms_sys/APP/SCP" /begin SUB_GROUP S22_EBS_J1939TP /end SUB_GROUP /end GROUP
/begin GROUP S3_THC "SWC_FDC_type/run_SWC_FDC_RxTx_5ms_sys/APP/THC" /begin SUB_GROUP S23_PE_Cooling_Management /end SUB_GROUP /end GROUP
/begin GROUP S3_TQD "SWC_FDC_type/run_SWC_FDC_RxTx_5ms_sys/APP/TQD" /begin SUB_GROUP S24_Input_Convert S24_Main S24_OutpConvert S24_SCP_In /end SUB_GROUP /end GROUP
/begin GROUP S16_Input_Convert "SWC_FDC_type/run_SWC_FDC_RxTx_5ms_sys/APP/ACC/Input_Convert"
 /begin SUB_GROUP S26_DTC_Couter S26_DelayEnable S26_DelayEnable1 S26_SR_Latch S26_SR_Latch2 S26_Switch_hold S26_Switch_hold1 S26_Switch_hold3 S26_Trigger S26__EcasSw1Down_Debounce S26__EcasSw1Up_Debounce S26__EcasSw2Stop_Debounce /end SUB_GROUP
 /begin REF_CHARACTERISTIC KACC_CACEnableFailTime_s KACC_CACOverrunRcvTime_s KACC_CACOverrunTime_min KACC_CACPresLow_kPa KACC_CACPresWarn_kPa KACC_CACStopTime_s KACC_CACTempStop_C KACC_DTCACCReset_flg KACC_DTCCACOverrun_cnt KACC_EACErrLvHoldtime_s KACC_EHPSCtrlModeStep2_flg KACC_EHPSDisStrWhlDiv_rad KACC_EHPSDisStrWhlHi_rad KACC_EHPSDisStrWhlLo_rad KACC_EHPSEnableFailTime_s KACC_EHPSErrLvHoldtime_s KACC_EHPSSpdDemTimeout_s KACC_EHPSSpdDiv_rpm KACC_EHPSStopTime_s KACC_EcasSwDebounceTime_s KACC_EcasSwTrigHoldTime_s KACC_SpeedOverEHPSEnDemend_kph KACC_StrWhlAngSampleTime_s KACC_StrWhlNotMovingTime_s KACC_SwitchFailSensorRefRcv_s KACC_SwitchFailSensorRef_kpa /end REF_CHARACTERISTIC
 /begin REF_MEASUREMENT VACC_CACForceStop_flg VACC_CACOverTempStop_flg VACC_CACPresLow_flg VACC_CoolingMode_flg VACC_EACPresLowReset_flg VACC_EACRefSensorDis_flg VACC_EACRefSwitchEnable_flg VACC_EACSensorPresLow_flg VACC_EBSBrakeRelease_flg VACC_EHPSDisable_flg VACC_EHPSForceStop_flg VACC_EHPSSpdDemTimeout_flg VACC_EcasNLvReq_enum VACC_SASCalFinish_flg VACC_StrWhlAngLast_rad VACC_StrWhlNotMoving_flg /end REF_MEASUREMENT
/end GROUP
/begin GROUP S16_Main "SWC_FDC_type/run_SWC_FDC_RxTx_5ms_sys/APP/ACC/Main"
 /begin SUB_GROUP S27_DCDC_Control S27_EAC_Control S27_ECAS_Control S27_EHPS_Control /end SUB_GROUP
/end GROUP
/begin GROUP S16_OutpConvert "SWC_FDC_type/run_SWC_FDC_RxTx_5ms_sys/APP/ACC/OutpConvert"
 /begin SUB_GROUP S29_AirPressure_SCP S29_EAC_Pressure_Indication S29_EAC_Temperature_Over_High_Detection S29_EHPS_Enable_TimeOut_Judgment S29_PCU_Demand_SCP S29_VCU1_SCP S29_VCU5_SCP /end SUB_GROUP
/end GROUP
/begin GROUP S16_SCP_In "SWC_FDC_type/run_SWC_FDC_RxTx_5ms_sys/APP/ACC/SCP_In"
 /begin REF_CHARACTERISTIC KACC_CACTemp_C KACC_CP2VAutoTracH_enum KACC_CP2VDamStiffReqFA_pct KACC_CP2VDamStiffReqLA_pct KACC_CP2VDamStiffReqRA_pct KACC_CP2VKneeCtrlMReq_enum KACC_CP2VKneeReqFA_enum KACC_CP2VKneeReqRA_enum KACC_CP2VKneeReqRSide_enum KACC_CP2VLA1PosCmd_enum KACC_CP2VLA2PosCmd_enum KACC_CP2VLvCtrlModeReq_enum KACC_CP2VNLvReqFA_enum KACC_CP2VNLvReqRA_enum KACC_ECASKneeSideSW_flg KACC_ECASSwitch_flg KACC_EcasSw1Down_flg KACC_EcasSw1Up_flg KACC_EcasSw2M2_flg KACC_EcasSw2Stop_flg KACC_EcasSw3Knee_flg KACC_EcasSw3M1_flg KACC_StrWhlAng_rad /end REF_CHARACTERISTIC
/end GROUP
/begin GROUP S18_Subsystem "SWC_FDC_type/run_SWC_FDC_RxTx_5ms_sys/APP/BCM/Subsystem"
 /begin SUB_GROUP S81_BSDandInnerBuzzer S81_DoorControl S81_ExteriorLight S81_FlasherSignal S81_RoomLamp S81_STOPBELL S81_Subsystem S81_WiperWasher /end SUB_GROUP
 /begin REF_MEASUREMENT VBCM_FDCBCMBrakeCmd_flg VBCM_FDCBCMRGearSta_flg /end REF_MEASUREMENT
/end GROUP
/begin GROUP S19_DHP "SWC_FDC_type/run_SWC_FDC_RxTx_5ms_sys/APP/DHP/DHP" /begin SUB_GROUP S204_APS_calaulation S204_Signal_convert /end SUB_GROUP /end GROUP
/begin GROUP S20_PowerModeManagement "SWC_FDC_type/run_SWC_FDC_RxTx_5ms_sys/APP/PMM/PowerModeManagement"
 /begin SUB_GROUP S227_PMM_Flag_Creator_ S227_PMM_SCP S227_PMM_State_Change_Configuration S227_PMM_Switch_Enum_Creator /end SUB_GROUP
 /begin REF_CHARACTERISTIC KPMM_ACMainRlyUpFailtime_s KPMM_AfterrunTimeout_s KPMM_AlcLockCheckFailtime_s KPMM_BCUGetChrgTO_s KPMM_BattDownFailtime_s KPMM_BattUpFailtime_s KPMM_ButtonHoldlimit_cnt KPMM_ChrgIntoPwrdownWait_s KPMM_ChrgwakeDebon_cnt KPMM_DCDCChrgFailtime_s KPMM_DCDCEnableFailtime_s KPMM_DCDCRlyDemDelayTime_s KPMM_DCDCRlyUpFailtime_s KPMM_EACEnTimout_s KPMM_EHPSEnTimout_s KPMM_EHPSIniTimout_s KPMM_EHPSSpdDem_rpm KPMM_ForceEntrySleep_flg KPMM_ForceMCUFailRst_flg KPMM_HVRlyCheckFailtime_s KPMM_HVRlyOpenFailWT_s KPMM_HVRlyOpenFailtime_s KPMM_MCUDisChrgFSFailtime_s KPMM_MCUDisChrgFailtime_s KPMM_MCUDisableFailtime_s KPMM_MCUEnDischrgFailtime_s KPMM_MCUEnableFailtime_s KPMM_MCUPassDisChrg_s KPMM_MCUPrechrgFailtime_s KPMM_PDUDisableFailtime_s KPMM_PDUDisableWaitime_s KPMM_PDULoadRlyPUFailtime_s KPMM_SysInitialTO_s KPMM_TargetDchrgVolt_V KPMM_TargetEnDischrgVolt_V KPMM_TargetPassDischrgVolt_V KPMM_Time4Sleep_s KPMM_TimeHVSelfChk4Chrg_s KPMM_VoltForceOffInAfferun_v KPMM_WaitAirPressTimeout_s KPMM_WaitForAfterrunFail_s KPSA_FakeWakeRESET_flg /end REF_CHARACTERISTIC
 /begin REF_MEASUREMENT SWC_FDC_type_DW.tp_Powerdown VPMM_ACHVLoopDem_enum VPMM_BattHVDem_enum VPMM_CACRlyDem_enum VPMM_ChrgPowerUpFail_flg VPMM_ChrgState_enum VPMM_DCDCRlyDem_enum VPMM_DrivelineRelease_enum VPMM_EACEnableCompleted_flg VPMM_EHPSIniFinish_flg VPMM_EHPSRlyDem_enum VPMM_ExtTorquePrevent_enum VPMM_HVSysReady_enum VPMM_IGNRlyClose_flg VPMM_IRCRlyClose_flg VPMM_MCUHVLoopDem_enum VPMM_PMMDCDCEnableDem_flg VPMM_PMMEACEnableDem_flg VPMM_PMMEHPSDemSpd_rpm VPMM_PMMEHPSEnableDem_flg VPMM_PowerDownCompleted_flg VPMM_PowerDownState_enum VPMM_PowerUpComplete_flg VPMM_PowerUpFault_enum VPMM_PowerUpInhibit_flg VPMM_SysPowerMode_enum VPMM_VCUMCUCtrlMd_enum VPMM_VCUMCUEn_flg VPMM_VCUMCUFailRst_flg /end REF_MEASUREMENT
/end GROUP
/begin GROUP S21_PSA "SWC_FDC_type/run_SWC_FDC_RxTx_5ms_sys/APP/PSA/PSA" /begin SUB_GROUP S327_PSA /end SUB_GROUP /end GROUP
/begin GROUP S22_EBS_J1939TP "SWC_FDC_type/run_SWC_FDC_RxTx_5ms_sys/APP/SCP/EBS_J1939TP"
 /begin REF_CHARACTERISTIC KSCP_DelayECBAMandECDT_s KSCP_DelayECDTandECDT_s KSCP_DelayECDTandRCBAM_s KSCP_DelayRCBAMandRCDT_s KSCP_DelayRCDTandECBAM_s KSCP_DelayRCDTandRCDT_s KSCP_MCUMaxRefTq_Nm /end REF_CHARACTERISTIC
 /begin REF_MEASUREMENT VSCP_CFGEM1BAMPGN_raw VSCP_CFGEM1BAMRsv_raw VSCP_CFGEM1BAMTNum_raw VSCP_CFGEM1BAMTSize_raw VSCP_CFGEM1Ctrl_raw VSCP_DTbyte0_raw VSCP_DTbyte1_raw VSCP_DTbyte2_raw VSCP_DTbyte3_raw VSCP_DTbyte4_raw VSCP_DTbyte5_raw VSCP_DTbyte6_raw VSCP_DTbyte7_raw VSCP_triggerBAM_flg VSCP_triggerDT_flg /end REF_MEASUREMENT
/end GROUP
/begin GROUP S23_PE_Cooling_Management "SWC_FDC_type/run_SWC_FDC_RxTx_5ms_sys/APP/THC/PE_Cooling_Management"
 /begin SUB_GROUP S343_Afterrun_Judgement S343_FUN_05_01_01_Thermal_Managemant_Mode_Determination S343_FUN_05_01_02_PE_EWP_Control S343_FUN_05_01_03_PE_CoolingFan_Control /end SUB_GROUP
 /begin REF_CHARACTERISTIC KTHC_AfterrunMCUStartTemp_C KTHC_AfterrunMCUStopTemp_C KTHC_AfterrunTMStartTemp_C KTHC_AfterrunTMStopTemp_C KTHC_AfterrunningModeCoolFanReq_pct KTHC_AfterrunningModeEWPPEReq_rpm KTHC_ServiceModeCoolFanCMD_flg KTHC_ServiceModeCoolFanReq_pct KTHC_ServiceModeEWPPECMD_flg KTHC_ServiceModeEWPPEReq_rpm KTHC_ServiceModeON_flg /end REF_CHARACTERISTIC
 /begin REF_MEASUREMENT VTHC_ServiceMode_flg /end REF_MEASUREMENT
/end GROUP
/begin GROUP S24_Input_Convert "SWC_FDC_type/run_SWC_FDC_RxTx_5ms_sys/APP/TQD/Input_Convert" /begin SUB_GROUP S353_Function S353_Input_Signal_Convert /end SUB_GROUP /end GROUP
/begin GROUP S24_Main "SWC_FDC_type/run_SWC_FDC_RxTx_5ms_sys/APP/TQD/Main"
 /begin SUB_GROUP S354_Available_Torqeu_Limitation S354_Driver_Torque_Demmand S354_Motor_Direction S354_Ramp_Input_Torque S354_Torque_Coordination S354_Torque_Distribution S354_Torque_Ramp /end SUB_GROUP
/end GROUP
/begin GROUP S24_OutpConvert "SWC_FDC_type/run_SWC_FDC_RxTx_5ms_sys/APP/TQD/OutpConvert"
 /begin SUB_GROUP S355_ABS_System_Enable S355_ADAS_DriverWheelTqDem S355_Buzzer_Request S355_EC1_SCP S355_EEC3_SCP S355_EMRC1_SCP S355_ETC1_SCP S355_ETC2_SCP S355_EVCU1_SCP S355_EVCU2_SCP S355_MCUCMD_SCP S355_MSF_SCP S355_RC1_SCP S355_TUpA_Indication /end SUB_GROUP
/end GROUP
/begin GROUP S24_SCP_In "SWC_FDC_type/run_SWC_FDC_RxTx_5ms_sys/APP/TQD/SCP_In" /begin SUB_GROUP S356_Input_Signal S356_Invalid_Condition /end SUB_GROUP
 /begin REF_CHARACTERISTIC KTQD_B2VAvaPlsChgCurrValid_flg KTQD_CANMsgValidECP2_flg KTQD_CANMsgValidECP3_flg KTQD_DoorSaftySW_flg KTQD_ECPVCUAcclLimSw_flg KTQD_ECPVCUAcclLim_mps KTQD_ECPVCUCreepSW_flg KTQD_ECPVCUDRM_enum KTQD_ECPVCURRegenSW_enum KTQD_ECPVCUSpdLimSw_flg KTQD_ECPVCUSpdLim_kph KTQD_FRHalbrakeReq_enum KTQD_HVBPwrAvailDchrgValid_flg KTQD_MCUAlarmCode_cnt KTQD_MDHalbrakeReq_enum KTQD_MotorSpdValid_flg KTQD_SeatBeltSta_flg KTQD_TDHalbrakeReq_enum /end REF_CHARACTERISTIC
/end GROUP
/begin GROUP S26__EcasSw1Down_Debounce "SWC_FDC_type/run_SWC_FDC_RxTx_5ms_sys/APP/ACC/Input_Convert/ EcasSw1Down Debounce" /begin REF_MEASUREMENT VACC_EcasSw1Down_flg /end REF_MEASUREMENT /end GROUP
/begin GROUP S26__EcasSw1Up_Debounce "SWC_FDC_type/run_SWC_FDC_RxTx_5ms_sys/APP/ACC/Input_Convert/ EcasSw1Up Debounce" /begin REF_MEASUREMENT VACC_EcasSw1Up_flg /end REF_MEASUREMENT /end GROUP
/begin GROUP S26__EcasSw2Stop_Debounce "SWC_FDC_type/run_SWC_FDC_RxTx_5ms_sys/APP/ACC/Input_Convert/ EcasSw2Stop Debounce" /begin REF_MEASUREMENT VACC_EcasSw2Stop_flg /end REF_MEASUREMENT /end GROUP
/begin GROUP S26_DTC_Couter "SWC_FDC_type/run_SWC_FDC_RxTx_5ms_sys/APP/ACC/Input_Convert/DTC_Couter" /begin REF_MEASUREMENT VACC_CACOverrun_flg /end REF_MEASUREMENT /end GROUP
/begin GROUP S26_DelayEnable "SWC_FDC_type/run_SWC_FDC_RxTx_5ms_sys/APP/ACC/Input_Convert/DelayEnable" /begin REF_MEASUREMENT VACC_CACRunFail_flg /end REF_MEASUREMENT /end GROUP
/begin GROUP S26_DelayEnable1 "SWC_FDC_type/run_SWC_FDC_RxTx_5ms_sys/APP/ACC/Input_Convert/DelayEnable1" /begin REF_MEASUREMENT VACC_EHPSEnTimeout_flg /end REF_MEASUREMENT /end GROUP
/begin GROUP S26_SR_Latch "SWC_FDC_type/run_SWC_FDC_RxTx_5ms_sys/APP/ACC/Input_Convert/SR_Latch" /begin REF_MEASUREMENT VACC_EACErrLvHoldDis_flg /end REF_MEASUREMENT /end GROUP
/begin GROUP S26_SR_Latch2 "SWC_FDC_type/run_SWC_FDC_RxTx_5ms_sys/APP/ACC/Input_Convert/SR_Latch2" /begin REF_MEASUREMENT VACC_EHPSErrLvHoldDis_flg /end REF_MEASUREMENT /end GROUP
/begin GROUP S26_Switch_hold "SWC_FDC_type/run_SWC_FDC_RxTx_5ms_sys/APP/ACC/Input_Convert/Switch hold" /begin REF_MEASUREMENT VACC_EcasSw2M2_flg /end REF_MEASUREMENT /end GROUP
/begin GROUP S26_Switch_hold1 "SWC_FDC_type/run_SWC_FDC_RxTx_5ms_sys/APP/ACC/Input_Convert/Switch hold1" /begin REF_MEASUREMENT VACC_EcasSw3Knee_flg /end REF_MEASUREMENT /end GROUP
/begin GROUP S26_Switch_hold3 "SWC_FDC_type/run_SWC_FDC_RxTx_5ms_sys/APP/ACC/Input_Convert/Switch hold3" /begin REF_MEASUREMENT VACC_EcasSw3M1_flg /end REF_MEASUREMENT /end GROUP
/begin GROUP S26_Trigger "SWC_FDC_type/run_SWC_FDC_RxTx_5ms_sys/APP/ACC/Input_Convert/Trigger" /begin REF_MEASUREMENT VACC_StrWhlAngMemDet_flg /end REF_MEASUREMENT /end GROUP
/begin GROUP S27_DCDC_Control "SWC_FDC_type/run_SWC_FDC_RxTx_5ms_sys/APP/ACC/Main/DCDC Control" /begin REF_CHARACTERISTIC KACC_DCDCErrLvHoldtime_s /end REF_CHARACTERISTIC /begin REF_MEASUREMENT VACC_DCDCEnableDem_flg /end REF_MEASUREMENT /end GROUP
/begin GROUP S27_EAC_Control "SWC_FDC_type/run_SWC_FDC_RxTx_5ms_sys/APP/ACC/Main/EAC Control" /begin REF_CHARACTERISTIC KACC_ServiceModeCACCMD_flg KACC_ServiceModeCACON_flg /end REF_CHARACTERISTIC /begin REF_MEASUREMENT VACC_ACCEACEnableDem_flg VACC_CACEnableDem_flg /end REF_MEASUREMENT /end GROUP
/begin GROUP S27_ECAS_Control "SWC_FDC_type/run_SWC_FDC_RxTx_5ms_sys/APP/ACC/Main/ECAS Control"
 /begin REF_MEASUREMENT VACC_ASC2AutoTracH_enum VACC_ASC2DamStiffReqFA_pct VACC_ASC2DamStiffReqLA_pct VACC_ASC2DamStiffReqRA_pct VACC_ASC2KneeCtrlMReq_enum VACC_ASC2KneeReqFA_flg VACC_ASC2KneeReqLSide_flg VACC_ASC2KneeReqRA_flg VACC_ASC2KneeReqRSide_flg VACC_ASC2LA1PosCmd_enum VACC_ASC2LA2PosCmd_enum VACC_ASC2LvCtrlModeReq_enum VACC_ASC2NLvReqFA_enum VACC_ASC2NLvReqRA_enum /end REF_MEASUREMENT
/end GROUP
/begin GROUP S27_EHPS_Control "SWC_FDC_type/run_SWC_FDC_RxTx_5ms_sys/APP/ACC/Main/EHPS Control"
 /begin REF_CHARACTERISTIC KACC_EHPSCtrlModeStep2_flg KACC_EHPSDisWaitTime_s KACC_EHPSLimitSpd_rpm KACC_EHPSSpdDiv_rpm KACC_ServiceModeEHPSCMD_flg KACC_ServiceModeEHPSON_flg MACC_EHPSSpdCtrlMode_Z_rpm /end REF_CHARACTERISTIC
 /begin REF_MEASUREMENT VACC_ACCEHPSDemSpd_rpm VACC_ACCEHPSEnablDem_flg VACC_EHPSEnableDem_flg VACC_EHPSMotorDemSpd_rpm VACC_EHPSSpdCtrlMode_enum VACC_EHPSSpdCtrlMode_rpm VACC_InitEHPSEnDem_flg /end REF_MEASUREMENT
/end GROUP
/begin GROUP S29_AirPressure_SCP "SWC_FDC_type/run_SWC_FDC_RxTx_5ms_sys/APP/ACC/OutpConvert/AirPressure SCP" /begin REF_CHARACTERISTIC KACC_AirPressInvalid_kpa /end REF_CHARACTERISTIC
 /begin REF_MEASUREMENT VACC_AirPressureFDisp_kpa VACC_AirPressurePDisp_kpa VACC_AirPressureRDisp_kpa /end REF_MEASUREMENT
/end GROUP
/begin GROUP S29_EAC_Pressure_Indication "SWC_FDC_type/run_SWC_FDC_RxTx_5ms_sys/APP/ACC/OutpConvert/EAC Pressure Indication"
 /begin REF_CHARACTERISTIC KACC_CACPresWarn_kPa KACC_CACPresWarn_ovrdflg_flg KACC_CACPresWarn_ovrdval_flg /end REF_CHARACTERISTIC
 /begin REF_MEASUREMENT VACC_CACPresReady_flg VACC_CACPresWarn_flg /end REF_MEASUREMENT
/end GROUP
/begin GROUP S29_EAC_Temperature_Over_High_Detection "SWC_FDC_type/run_SWC_FDC_RxTx_5ms_sys/APP/ACC/OutpConvert/EAC Temperature Over High Detection" /begin SUB_GROUP S70_DTC_Couter /end SUB_GROUP
 /begin REF_CHARACTERISTIC KACC_CACOverTempDelayTime_s KACC_CACOverTempRcv_s KACC_CACTempRev_C KACC_CACTempWarn_C KACC_DTCACCReset_flg /end REF_CHARACTERISTIC
/end GROUP
/begin GROUP S29_EHPS_Enable_TimeOut_Judgment "SWC_FDC_type/run_SWC_FDC_RxTx_5ms_sys/APP/ACC/OutpConvert/EHPS Enable TimeOut Judgment" /begin REF_CHARACTERISTIC KACC_EHPSDisableFailTime_s /end REF_CHARACTERISTIC /begin REF_MEASUREMENT VACC_EHPSDisEnTimeout_flg /end REF_MEASUREMENT /end GROUP
/begin GROUP S29_PCU_Demand_SCP "SWC_FDC_type/run_SWC_FDC_RxTx_5ms_sys/APP/ACC/OutpConvert/PCU Demand SCP"
 /begin REF_MEASUREMENT VACC_DCDCEnDemamd_enum VACC_EACEnDemand_enum VACC_EACSpdDemand_rpm VACC_EHPSEnDemand_enum /end REF_MEASUREMENT
/end GROUP
/begin GROUP S29_VCU1_SCP "SWC_FDC_type/run_SWC_FDC_RxTx_5ms_sys/APP/ACC/OutpConvert/VCU1 SCP" /begin REF_MEASUREMENT VACC_EACPressWarnInd_flg VACC_EACTempWarnInd_flg /end REF_MEASUREMENT /end GROUP
/begin GROUP S29_VCU5_SCP "SWC_FDC_type/run_SWC_FDC_RxTx_5ms_sys/APP/ACC/OutpConvert/VCU5 SCP" /begin REF_CHARACTERISTIC KACC_CACPressureSWRev_flg KACC_VCUEACpumpTempInvalid_C /end REF_CHARACTERISTIC /begin REF_MEASUREMENT VACC_VCUEACPressureSW_flg VACC_VCUEACpumpTemp_C /end REF_MEASUREMENT /end GROUP
/begin GROUP S81_BSDandInnerBuzzer "SWC_FDC_type/run_SWC_FDC_RxTx_5ms_sys/APP/BCM/Subsystem/BSDandInnerBuzzer" /begin SUB_GROUP S82_Subsystem S82_Subsystem1 /end SUB_GROUP /begin REF_CHARACTERISTIC KBCM_FireBuzzerEN_flg /end REF_CHARACTERISTIC
 /begin REF_MEASUREMENT VBCM_FDCBCMEmExitSWSta_flg VBCM_FDCBCMInnerBuzzerCmd_flg VBCM_InnerBuzzerModeSta_enum /end REF_MEASUREMENT
/end GROUP
/begin GROUP S81_DoorControl "SWC_FDC_type/run_SWC_FDC_RxTx_5ms_sys/APP/BCM/Subsystem/DoorControl" /begin SUB_GROUP S84_Subsystem S84_Subsystem1 S84_Subsystem2 S84_Subsystem3 /end SUB_GROUP /begin REF_MEASUREMENT VBCM_FDCBCMEmSVCmd_flg VBCM_FDCBCMOSDrOpenSWSta_enum /end REF_MEASUREMENT /end GROUP
/begin GROUP S81_ExteriorLight "SWC_FDC_type/run_SWC_FDC_RxTx_5ms_sys/APP/BCM/Subsystem/ExteriorLight" /begin SUB_GROUP S85_Subsystem4 /end SUB_GROUP
 /begin REF_MEASUREMENT VBCM_FDCBCMHBeamCmd_flg VBCM_FDCBCMLBeamCmd_flg VBCM_FDCBCMLDRLCmd_flg VBCM_FDCBCMPLampCmd_flg VBCM_FDCBCMRDRLCmd_flg VBCM_FDCBCMRFLampCmd_flg /end REF_MEASUREMENT
/end GROUP
/begin GROUP S81_FlasherSignal "SWC_FDC_type/run_SWC_FDC_RxTx_5ms_sys/APP/BCM/Subsystem/FlasherSignal"
 /begin REF_CHARACTERISTIC KBCM_FLTurnLPLv_A KBCM_FRTurnLPLv_A KBCM_RLTurnLPLv_A KBCM_RRTurnLPLv_A /end REF_CHARACTERISTIC
 /begin REF_MEASUREMENT VBCM_FDCBCMBSDBuzzerCmd_flg VBCM_FDCBCMDVRSignalLCmd_flg VBCM_FDCBCMDVRSignalRCmd_flg VBCM_FDCBCMLTurnLpCmd_flg VBCM_FDCBCMLTurnSWSta_flg VBCM_FDCBCMRTurnLpCmd_flg VBCM_FDCBCMRTurnSWSta_flg VBCM_FDCBCMSLTLpCmd_flg VBCM_FDCBCMSMKLCmd_flg VBCM_FDCBCMSMKRCmd_flg VBCM_FDCBCMSRTLpCmd_flg VBCM_FDCBCMTurnBuzzerENSta_flg VBCM_TurnLpPatternSta_enum /end REF_MEASUREMENT
/end GROUP
/begin GROUP S81_RoomLamp "SWC_FDC_type/run_SWC_FDC_RxTx_5ms_sys/APP/BCM/Subsystem/RoomLamp"
 /begin REF_MEASUREMENT VBCM_FDCBCMFRoomLpCmd_pct VBCM_FDCBCMFRoomLpSetSta_pct VBCM_FDCBCMMRoomLpCmd_pct VBCM_FDCBCMMRoomLpSetSta_pct VBCM_FDCBCMRRoomLpCmd_pct VBCM_FDCBCMRRoomLpSetSta_pct VBCM_FDCBCMRoomLpAmbCmd_flg VBCM_FDCBCMRoomLpAmbSetSta_flg VBCM_FDCBCMRoomLpSetSta_flg /end REF_MEASUREMENT
/end GROUP
/begin GROUP S81_STOPBELL "SWC_FDC_type/run_SWC_FDC_RxTx_5ms_sys/APP/BCM/Subsystem/STOPBELL"
 /begin REF_MEASUREMENT VBCM_FDCBCMCallBellCmd_flg VBCM_FDCBCMHelpINDCmd_flg VBCM_FDCBCMInnerCallBellCmd_flg VBCM_FDCBCMSTOPBALLCmd_flg VBCM_FDCBCMStopINDCmd_flg /end REF_MEASUREMENT
/end GROUP
/begin GROUP S81_Subsystem "SWC_FDC_type/run_SWC_FDC_RxTx_5ms_sys/APP/BCM/Subsystem/Subsystem" /begin REF_MEASUREMENT VBCM_KeepWakeUp_flg VBCM_WakeUp_flg /end REF_MEASUREMENT /end GROUP
/begin GROUP S81_WiperWasher "SWC_FDC_type/run_SWC_FDC_RxTx_5ms_sys/APP/BCM/Subsystem/WiperWasher"
 /begin REF_MEASUREMENT VBCM_FDCBCMWasherCmd_flg VBCM_FDCBCMWiperHCmd_flg VBCM_FDCBCMWiperLCmd_flg /end REF_MEASUREMENT
/end GROUP
/begin GROUP S204_APS_calaulation "SWC_FDC_type/run_SWC_FDC_RxTx_5ms_sys/APP/DHP/DHP/APS_calaulation" /begin SUB_GROUP S205_Calculation S205_StateJudge S205_ZPLearn /end SUB_GROUP /end GROUP
/begin GROUP S204_Signal_convert "SWC_FDC_type/run_SWC_FDC_RxTx_5ms_sys/APP/DHP/DHP/Signal_convert" /begin REF_MEASUREMENT VDHP_EAPS1RAW_pct VDHP_EAPS2RAW_pct /end REF_MEASUREMENT /end GROUP
/begin GROUP S227_PMM_Flag_Creator_ "SWC_FDC_type/run_SWC_FDC_RxTx_5ms_sys/APP/PMM/PowerModeManagement/PMM Flag Creator "
 /begin SUB_GROUP S232_EHPS_Initialization S232_Flag_with_Condition S232_HVIL_Judgement S232_Long_Idle_Detection S232_Low_Battery_Voltage S232_MCU_Discharge_Enable_Feedback S232_MCU_Status2_Lost_Communication S232_PMM_Relay_open_Chk__HV_unit_Chk /end SUB_GROUP
 /begin REF_CHARACTERISTIC KPMM_HVILFailDetectTimes_cnt KPMM_HVILInvalidContTime_s KPMM_HVILPWMDutyMax_pct KPMM_HVILPWMDutyMin_pct KPMM_HVILPassDetectTimes_cnt KPMM_HVILValidContTime_s /end REF_CHARACTERISTIC
/end GROUP
/begin GROUP S227_PMM_State_Change_Configuration "SWC_FDC_type/run_SWC_FDC_RxTx_5ms_sys/APP/PMM/PowerModeManagement/PMM State Change Configuration"
 /begin SUB_GROUP S233_PMM_AfterRun_to_Initialize_State S233_PMM_Boot_to_Initialize_State S233_PMM_Charge_to_PowerDown_State S233_PMM_Drive_to_PowerDown_State S233_PMM_Initialize_to_Charge_State S233_PMM_Initialize_to_Idle_State S233_PMM_Initialize_to_PowerUp_State S233_PMM_PowerUp_to_PowerDown_State /end SUB_GROUP
/end GROUP
/begin GROUP S227_PMM_Switch_Enum_Creator "SWC_FDC_type/run_SWC_FDC_RxTx_5ms_sys/APP/PMM/PowerModeManagement/PMM Switch Enum Creator" /begin SUB_GROUP S234_ChrgFault_SW S234_PowerDownFault_SW /end SUB_GROUP /begin REF_CHARACTERISTIC KPMM_StaSwTime_s KPMM_TwoSysSwOFF_flg /end REF_CHARACTERISTIC
 /begin REF_MEASUREMENT VPMM_ChrgFault_enum VPMM_PowerDownFault_enum VPMM_PowerUpState_enum /end REF_MEASUREMENT
/end GROUP
/begin GROUP S227_PMM_SCP "SWC_FDC_type/run_SWC_FDC_RxTx_5ms_sys/APP/PMM/PowerModeManagement/PMM_SCP"
 /begin REF_CHARACTERISTIC KPMM_3in1RlyDelayTime_s KPMM_VSPFunc_enum KPMM_VSPTurnL_enum KPMM_VSPTurnR_enum KPMM_usePDU3in1_flg /end REF_CHARACTERISTIC
 /begin REF_MEASUREMENT VPMM_AlcLockSta_enum VPMM_DCCurr_A VPMM_DCVol_V VPMM_FogTMSRlyCMD_enum VPMM_PDUDCDCRlySta_enum VPMM_PDUEACRlySta_enum VPMM_PDUEHPSRlySta_enum VPMM_V2BACPosRlyFit_enum VPMM_V2BACPosRlySta_enum VPMM_V2BAirPosRlyFit_enum VPMM_V2BAirPosRlySta_enum VPMM_V2BAux1OnOff_enum VPMM_V2BAux1RlyFit_enum VPMM_V2BAux1RlySta_enum VPMM_V2BAux2OnOff_enum VPMM_V2BAux2RlyFit_enum VPMM_V2BAux2RlySta_enum VPMM_V2BAux3OnOff_enum VPMM_V2BAux3RlyFit_enum VPMM_V2BAux3RlySta_enum VPMM_V2BAux4RlyFit_enum VPMM_V2BAux4RlySta_enum VPMM_V2BDCDCPosRlyFit_enum VPMM_V2BDCDCPosRlySta_enum VPMM_V2BLifeSig_cnt VPMM_V2BMainPosRlyFit_enum VPMM_V2BMainPosRlySta_enum VPMM_V2BOilPosRlyFit_enum VPMM_V2BOilPosRlySta_enum VPMM_V2BRsv1_cnt VPMM_V2BRsv2_cnt VPMM_VCULife1_cnt VPMM_VCULife2_cnt VPMM_VSPFunc_enum VPMM_VSPIGNKeySta_enum VPMM_VSPReversed_flg VPMM_VSPTurnLeft_enum VPMM_VSPTurnRight_enum /end REF_MEASUREMENT
/end GROUP
/begin GROUP S327_PSA "SWC_FDC_type/run_SWC_FDC_RxTx_5ms_sys/APP/PSA/PSA/PSA" /begin SUB_GROUP S328_SR_Latch1 /end SUB_GROUP
 /begin REF_CHARACTERISTIC KPMM_ChrgwakeDebon_cnt KPSA_APSPosnSafe_pct KPSA_ActTimeEmergencySD_s KPSA_AfterrunWaitTime_s KPSA_AlcLockPassTime_s KPSA_AlcLockPass_ovrdflg_flg KPSA_AlcLockPass_ovrdval_flg KPSA_FakeWakeRESET_flg KPSA_KeystatusWaitTime_s KPSA_Keystatus_enum_dovrdflg KPSA_Keystatus_enum_dovrdval KPSA_PBOnTimeForEMStop_s KPSA_PBTrigHoldtime_s KPSA_RcvTimeEmergencySD_s KPSA_VehspdSafe_kph /end REF_CHARACTERISTIC
 /begin REF_MEASUREMENT VPSA_AlcLockPass_flg VPSA_Keystatus_enum VPSA_PBtrig_flg /end REF_MEASUREMENT
/end GROUP
/begin GROUP S343_Afterrun_Judgement "SWC_FDC_type/run_SWC_FDC_RxTx_5ms_sys/APP/THC/PE_Cooling_Management/Afterrun Judgement" /begin REF_MEASUREMENT VTHC_AfterrunningMode_flg /end REF_MEASUREMENT /end GROUP
/begin GROUP S343_FUN_05_01_01_Thermal_Managemant_Mode_Determination "SWC_FDC_type/run_SWC_FDC_RxTx_5ms_sys/APP/THC/PE_Cooling_Management/FUN_05.01.01_Thermal_Managemant_Mode_Determination" /begin SUB_GROUP S345_Cooling_Mode S345_PECoolingMode S345_Subsystem /end SUB_GROUP /end GROUP
/begin GROUP S343_FUN_05_01_02_PE_EWP_Control "SWC_FDC_type/run_SWC_FDC_RxTx_5ms_sys/APP/THC/PE_Cooling_Management/FUN_05.01.02_PE_EWP_Control"
 /begin REF_CHARACTERISTIC KTHC_CoolingEWPDisSpdDem_rpm KTHC_CoolingEWPEnSpdDem_rpm KTHC_EWPFaultBypassSwitch_flag KTHC_EWPPEFaultSpd_rpm KTHC_MCUDerationEWPPEReq_rpm KTHC_MCUTempErrEWPPEReq_rpm KTHC_MCUTempError_C KTHC_PEUDerationEWPPEReq_rpm KTHC_PEUDerationTemp_C KTHC_PEUTempErrEWPPEReq_rpm KTHC_PEUTempError_C KTHC_TMTempErrEWPPEReq_rpm KTHC_TMTempError_C MTHC_ChargingPEUEWPReq_Y_rpm MTHC_CoolingMCUEWPReq_Y_rpm MTHC_CoolingPEUEWPReq_Y_rpm MTHC_CoolingTMEWPReq_Y_rpm /end REF_CHARACTERISTIC
 /begin REF_MEASUREMENT VTHC_EWPPEReq_rpm VTHC_EWPSpdDemRelay_flg VTHC_OriginalEWPSpdDem_rpm /end REF_MEASUREMENT
/end GROUP
/begin GROUP S343_FUN_05_01_03_PE_CoolingFan_Control "SWC_FDC_type/run_SWC_FDC_RxTx_5ms_sys/APP/THC/PE_Cooling_Management/FUN_05.01.03_PE_CoolingFan_Control"
 /begin REF_CHARACTERISTIC KTHC_CoolingFanPWMDis_pct KTHC_CoolingFanPWMEn_pct KTHC_LostEWPCoolingFan_pct KTHC_MCUDerationCoolFanReq_pct KTHC_MCUTempErrCoolFanReq_pct KTHC_MCUTempError_C KTHC_PEUDerationCoolFanReq_pct KTHC_PEUDerationTemp_C KTHC_PEUTempErrCoolFanReq_pct KTHC_PEUTempError_C KTHC_TMTempErrCoolFanReq_pct KTHC_TMTempError_C MTHC_ChargingPEUFanReq_Y_pct MTHC_CoolingMCUFanReq_Y_pct MTHC_CoolingPEUFanReq_Y_pct MTHC_CoolingTMFanReq_Y_pct /end REF_CHARACTERISTIC
 /begin REF_MEASUREMENT VTHC_CoolFanReq_pct /end REF_MEASUREMENT
/end GROUP
/begin GROUP S353_Function "SWC_FDC_type/run_SWC_FDC_RxTx_5ms_sys/APP/TQD/Input_Convert/Function"
 /begin SUB_GROUP S358_Acceleration_Limiter S358_BOS S358_Command_Limitation S358_Creep S358_Distribution_Rate S358_Door_Limit S358_MCU_Control_Mode S358_Parking_Protection S358_Pedal_Torque S358_Ramp_Limitation S358_Ramp_Parameter S358_Rolling_Regen S358_Shift_Modul S358_Speed_Limiter S358_TUpA S358_Torque_Capacity /end SUB_GROUP
/end GROUP
/begin GROUP S353_Input_Signal_Convert "SWC_FDC_type/run_SWC_FDC_RxTx_5ms_sys/APP/TQD/Input_Convert/Input Signal Convert"
 /begin SUB_GROUP S359_Big_Mike_Combo_V2_ S359_SR_Latch10 S359_SR_Latch3 S359_SR_Latch5 S359_SR_Latch6 S359_Timer1 S359_Timer2 S359_kph_to_rpm_ /end SUB_GROUP
 /begin REF_CHARACTERISTIC KTQD_AbsoluteMotorSpdDir_flg KTQD_ActDrvDirMotorSpdLimit_rpm KTQD_CAN1BusOffSpdRcv_kph KTQD_ComLostTorqLimitRcv_kph KTQD_DMSLostTorqLimit_kph KTQD_DRTransferRestTq_Nm KTQD_DisLVChrgModeKeyDet_c KTQD_DisLVChrgModeKeyDet_s KTQD_DisLVChrgModeUIFlash_cnt KTQD_DisLVChrgModeUIOFF_s KTQD_DisLVChrgModeUION_s KTQD_DisLVChrgModeUITimes_cnt KTQD_DisLVChrgModeUIWait_s KTQD_DoorStaSourceSW_flg KTQD_ECOComfortSpdLim_rpm KTQD_EnLVChrgModeKeyDet_cnt KTQD_EnLVChrgModeUIFlash_cnt KTQD_EnLVChrgModeUIOFF_s KTQD_EnLVChrgModeUION_s KTQD_EnLVChrgModeUITimes_cnt KTQD_EnLVChrgModeUIWait_s KTQD_EnLVChrgModekeyDet_s KTQD_GearFlashSetTime_s KTQD_MCUMaxRefTorq_Nm KTQD_RotaDirRngLowTq_Nm KTQD_RotaDirRngUpTq_Nm KTQD_SpdLimDiv_rpm KTQD_SpdLimIndFlash_cnt KTQD_SpdLimSatHi_kph KTQD_SpdLimSatLo_kph KTQD_TDDoorSW_flg KTQD_TMSpd2FASpd_kph KTQD_VCUMCUDemHiPosVal_rpm KTQD_VCUVehSpdErr_kph KTQD_VehSpdADJFactor_Factor KTQD_VehSpdGearRatio_ratio KTQD_VehSpdTireDiameter_m KTQD_VehSpdTireFactor_Factor /end REF_CHARACTERISTIC
 /begin REF_MEASUREMENT VSCP_SpdInRange_flg VTQD_AccelPedalDepressed_flg VTQD_ActCAN1BUSOFF_flg VTQD_ActDriveMode_enum VTQD_ActFRDoorOPSta_flg VTQD_ActMDDoorOPSta_flg VTQD_ActTDDoorOPSta_flg VTQD_ActvDmpDisabReq_flg VTQD_AmberFlashOff_flg VTQD_AmberFlashOn_flg VTQD_BrkSWOn_flg VTQD_ComLostZeroPwr_flg VTQD_DisFlashCycleTime_s VTQD_DoorOpen_flg VTQD_DrivePositionOn_flg VTQD_EBSLostZeroReg_flg VTQD_EM1LimitCtrlBrk_flg VTQD_EM1LimitCtrlDriv_flg VTQD_EM1ReqTorqLimBrk_Nm VTQD_EM1ReqTorqLimDriv_Nm VTQD_EM1TorqueCtrlBrk_flg VTQD_EM1TorqueCtrlDriv_flg VTQD_EVCU1VehActDrvDir_enum VTQD_EVDriveReady_flg VTQD_EnFlashCycleTime_s VTQD_EngModeDisDetEnd_flg VTQD_EngModeDisFlashFinished_flg VTQD_EngModeEnDetEnd_flg VTQD_EngModeEnFlashFinished_flg VTQD_EngModeOffDelay_flg VTQD_EngModeOffRiseDet_flg VTQD_EngModeOffSig_flg VTQD_EngModeOnDelay_flg VTQD_EngModeOnRiseDet_flg VTQD_EngModeOnSig_flg VTQD_FRHalbrakeReq_flg VTQD_ForceDischarge_flg VTQD_GearFlashIndDis_flg VTQD_GearFlashInd_flg VTQD_IGNActive_flg VTQD_InitLVchrgSvrMode_flg VTQD_LVchrgSvrModeDelay_flg VTQD_LVchrgSvrMode_flg VTQD_LostComBCU_flg VTQD_LostComEBS_flg VTQD_LostComTempBCU_flg VTQD_LostComTempEBS_flg VTQD_LostComTempMCU_flg VTQD_MDHalbrakeReq_flg VTQD_NeutralPositionOn_flg VTQD_PTAvailGenTq_Nm VTQD_PTAvailMotTq_Nm VTQD_RealGear_enum VTQD_ReqGear_enum VTQD_ReversePositionOn_flg VTQD_SpdForceZero_flg VTQD_SpdLimInd_flg VTQD_SpdLimSta_flg VTQD_SpdLimit_flg VTQD_SpecSpdLim_rpm VTQD_TDHalbrakeReq_flg VTQD_TMRotateDirectionReq_enum VTQD_TMRrotateDirection_enum VTQD_TMSpd_rpm VTQD_TqSource_enum VTQD_TqTargetShaftDrivSpd_rpm VTQD_TqTargetShaftRevSpd_rpm VTQD_TqTargetShaftSpd_rpm VTQD_TrqCMDForveZero_flg VTQD_TrqForceZero_flg VTQD_TrqLimit_flg VTQD_VCU4PweLmtInd_flg VTQD_VCUMCUDemHiPosVal_rpm VTQD_VCUTMVehSpd_kph VTQD_VCUVehSpd_kph /end REF_MEASUREMENT
/end GROUP
/begin GROUP S354_Available_Torqeu_Limitation "SWC_FDC_type/run_SWC_FDC_RxTx_5ms_sys/APP/TQD/Main/Available Torqeu Limitation" /begin REF_CHARACTERISTIC KTQD_EBSTqLimGain_c KTQD_MotoringTqDemN_Nm /end REF_CHARACTERISTIC /begin REF_MEASUREMENT VTQD_AfterAvailableTqDemRr_Nm /end REF_MEASUREMENT /end GROUP
/begin GROUP S354_Driver_Torque_Demmand "SWC_FDC_type/run_SWC_FDC_RxTx_5ms_sys/APP/TQD/Main/Driver Torque Demmand" /begin REF_CHARACTERISTIC KTQD_MCULostLimitTorq_gain /end REF_CHARACTERISTIC /begin REF_MEASUREMENT VTQD_DriverTqDem_Nm /end REF_MEASUREMENT /end GROUP
/begin GROUP S354_Motor_Direction "SWC_FDC_type/run_SWC_FDC_RxTx_5ms_sys/APP/TQD/Main/Motor Direction" /begin REF_CHARACTERISTIC KTQD_AbsoluteMotorTqDir_flg /end REF_CHARACTERISTIC /begin REF_MEASUREMENT VTQD_TMTqReq_Nm /end REF_MEASUREMENT /end GROUP
/begin GROUP S354_Ramp_Input_Torque "SWC_FDC_type/run_SWC_FDC_RxTx_5ms_sys/APP/TQD/Main/Ramp Input Torque" /begin REF_CHARACTERISTIC KTQD_TorCtrlModeSwSmoTime_s KTQD_TorCtrlModeSwSmoTs_c /end REF_CHARACTERISTIC /begin REF_MEASUREMENT VTQD_RrRampInpTqRr_Nm /end REF_MEASUREMENT /end GROUP
/begin GROUP S354_Torque_Coordination "SWC_FDC_type/run_SWC_FDC_RxTx_5ms_sys/APP/TQD/Main/Torque Coordination" /begin REF_CHARACTERISTIC KTQD_MotoringTqDemN_Nm /end REF_CHARACTERISTIC /begin REF_MEASUREMENT VTQD_CoordTqDem_Nm VTQD_NoSuitbleGear_flg /end REF_MEASUREMENT /end GROUP
/begin GROUP S354_Torque_Distribution "SWC_FDC_type/run_SWC_FDC_RxTx_5ms_sys/APP/TQD/Main/Torque Distribution" /begin REF_MEASUREMENT VTQD_CoorTqDemFr_Nm VTQD_CoorTqDemRr_Nm /end REF_MEASUREMENT /end GROUP
/begin GROUP S354_Torque_Ramp "SWC_FDC_type/run_SWC_FDC_RxTx_5ms_sys/APP/TQD/Main/Torque Ramp" /begin SUB_GROUP S734_FirstOrderFilter1 S734_Limit /end SUB_GROUP /begin REF_MEASUREMENT VTQD_RrRampTq_Nm /end REF_MEASUREMENT /end GROUP
/begin GROUP S355_ABS_System_Enable "SWC_FDC_type/run_SWC_FDC_RxTx_5ms_sys/APP/TQD/OutpConvert/ABS_System_Enable" /begin REF_MEASUREMENT VTQD_TqReductEnable_flg /end REF_MEASUREMENT /end GROUP
/begin GROUP S355_ADAS_DriverWheelTqDem "SWC_FDC_type/run_SWC_FDC_RxTx_5ms_sys/APP/TQD/OutpConvert/ADAS_DriverWheelTqDem" /begin REF_CHARACTERISTIC KTQD_GearRatio_rate /end REF_CHARACTERISTIC /begin REF_MEASUREMENT VTQD_ADASDriverDemWhTq_Nm VTQD_RealWhTq_Nm /end REF_MEASUREMENT /end GROUP
/begin GROUP S355_Buzzer_Request "SWC_FDC_type/run_SWC_FDC_RxTx_5ms_sys/APP/TQD/OutpConvert/Buzzer Request"
 /begin SUB_GROUP S743_DelayEnable S743_DelayEnable2 S743_Latch S743_SR_Latch1 S743_SR_Latch3 /end SUB_GROUP
 /begin REF_CHARACTERISTIC KTQD_ComboBuzzerDelayDis_s KTQD_ComboWarnBuzzerFlash_cnt KTQD_ComboWarnBuzzerOff_s KTQD_ComboWarnBuzzerOn_s KTQD_ComboWarnBuzzerWait_s KTQD_PwrFailWarnBuzzerFlash_cnt KTQD_PwrFailWarnBuzzerOff_s KTQD_PwrFailWarnBuzzerOn_s KTQD_PwrFailWarnBuzzerWait_s KTQD_PwrUpWarnBuzzerFlash_cnt KTQD_PwrUpWarnBuzzerOff_s KTQD_PwrUpWarnBuzzerOn_s KTQD_PwrUpWarnBuzzerWait_s KTQD_ReadyBuzzDelayTime_s KTQD_ReadyBuzzOffTime_s KTQD_ReadyWarnBuzzerFlash_cnt KTQD_ReadyWarnBuzzerOff_s KTQD_ReadyWarnBuzzerOn_s KTQD_ReadyWarnBuzzerWait_s KTQD_noPBWarnBuzzerFlash_cnt KTQD_noPBWarnBuzzerOff_s KTQD_noPBWarnBuzzerOn_s KTQD_noPBWarnBuzzerWait_s /end REF_CHARACTERISTIC
 /begin REF_MEASUREMENT VTQD_ComboKeyBuzzer_flg VTQD_PwrFailBuzzer_flg VTQD_PwrUpBuzzer_flg VTQD_ReadyBuzzer_flg VTQD_VCUBCMBuzzReq_flg /end REF_MEASUREMENT
/end GROUP
/begin GROUP S355_EC1_SCP "SWC_FDC_type/run_SWC_FDC_RxTx_5ms_sys/APP/TQD/OutpConvert/EC1 SCP" /begin REF_CHARACTERISTIC KTQD_MCUMaxRefTorq_Nm /end REF_CHARACTERISTIC
 /begin REF_MEASUREMENT VTQD_EC1EMDefTrqLmt_rpm VTQD_EC1EMExtRSCtrlUpLmt_rpm VTQD_EC1EMGainEndSpdGvn_gain VTQD_EC1EMMaxMEngOvrSP7_rpm VTQD_EC1EMMaxMOvrTmt_s VTQD_EC1EMMomOfInertia_kgpm2 VTQD_EC1EMRefTorq_Nm VTQD_EC1EMReqSpdCtrlLoLmt_rpm VTQD_EC1EMReqSpdCtrlUpLmt_rpm VTQD_EC1EMReqTrqCtrlLoLmt_pct VTQD_EC1EMReqTrqCtrlUpLmt_pct VTQD_EC1EMSpdHdleP6_rpm VTQD_EC1EMSpdIdleP1_rpm VTQD_EC1EMSpdIdleP2_rpm VTQD_EC1EMSpdIdleP3_rpm VTQD_EC1EMSpdIdleP4_rpm VTQD_EC1EMSpdIdleP5_rpm VTQD_EC1EMSupTSC1CtrlPG1_cnt VTQD_EC1EMSupTSC1CtrlPG2_cnt VTQD_EC1EMSupTSC1CtrlPG3_cnt VTQD_EC1EMSupTSC1CtrlPG4_cnt VTQD_EC1EMSupVarRTSC1MSG_cnt VTQD_EC1PercTorqIdleP1_pct VTQD_EC1PercTorqIdleP2_pct VTQD_EC1PercTorqIdleP3_pct VTQD_EC1PercTorqIdleP4_pct VTQD_EC1PercTorqIdleP5_pct /end REF_MEASUREMENT
/end GROUP
/begin GROUP S355_EEC3_SCP "SWC_FDC_type/run_SWC_FDC_RxTx_5ms_sys/APP/TQD/OutpConvert/EEC3 SCP" /begin REF_CHARACTERISTIC KTQD_MCUMaxRefTorq_Nm /end REF_CHARACTERISTIC /begin REF_MEASUREMENT VTQD_EEC3EMPressLoss_pct VTQD_EEC3NFricPercTorq_pct /end REF_MEASUREMENT /end GROUP
/begin GROUP S355_EMRC1_SCP "SWC_FDC_type/run_SWC_FDC_RxTx_5ms_sys/APP/TQD/OutpConvert/EMRC1 SCP"
 /begin REF_CHARACTERISTIC KTQD_EBSIncMaxRegLim_pct KTQD_EMTqModeAPSAct_pct KTQD_MCUMaxRefTorq_Nm /end REF_CHARACTERISTIC
 /begin REF_MEASUREMENT VTQD_EMRC1ActEMOutSftSpd_rpm VTQD_EMRC1ActEMpTrqHrls_pct VTQD_EMRC1ActEMpTrq_pct VTQD_EMRC1ActMaxAvaEMRecpTrq_pct VTQD_EMRC1DrvDemEMRtapTrq_pct VTQD_EMRC1EMTquModeDrvBrk_enum VTQD_EMRC1RetSelNonEng_pct VTQD_EMRC1SACtrlDev_cnt /end REF_MEASUREMENT
/end GROUP
/begin GROUP S355_ETC1_SCP "SWC_FDC_type/run_SWC_FDC_RxTx_5ms_sys/APP/TQD/OutpConvert/ETC1 SCP" /begin REF_MEASUREMENT VTQD_ETC1ShiftrPgs_enum /end REF_MEASUREMENT /end GROUP
/begin GROUP S355_ETC2_SCP "SWC_FDC_type/run_SWC_FDC_RxTx_5ms_sys/APP/TQD/OutpConvert/ETC2 SCP" /begin REF_MEASUREMENT VTQD_ETC2ActDriveDirect_enum /end REF_MEASUREMENT /end GROUP
/begin GROUP S355_EVCU1_SCP "SWC_FDC_type/run_SWC_FDC_RxTx_5ms_sys/APP/TQD/OutpConvert/EVCU1 SCP"
 /begin REF_CHARACTERISTIC KTQD_CurrEBrkAllow_A KTQD_MCUMaxRefTorq_Nm KTQD_MotorOverDev_rpm KTQD_RecuperHighSta_enum KTQD_RefMotorPower_kW KTQD_SOCEBrkAllow_pct KTQD_VCUMCUDemHiPosVal_rpm /end REF_CHARACTERISTIC
 /begin REF_MEASUREMENT VTQD_EVCU1ActDrvMode_enum VTQD_EVCU1EBrakeTorqLow_enum VTQD_EVCU1EMotorOvrerSpd_enum VTQD_EVCU1EMotorPerformance_pct VTQD_EVCU1EMotorSpd_rpm VTQD_EVCU1MotorPower_pct VTQD_EVCU1MotorTorque_pct VTQD_EVCU1RecuperHighSta_enum VTQD_EVCU1WheelSlipdet_enum /end REF_MEASUREMENT
/end GROUP
/begin GROUP S355_EVCU2_SCP "SWC_FDC_type/run_SWC_FDC_RxTx_5ms_sys/APP/TQD/OutpConvert/EVCU2 SCP" /begin REF_CHARACTERISTIC KTQD_MCUMaxRefTorq_Nm /end REF_CHARACTERISTIC /begin REF_MEASUREMENT VTQD_EVCU2MaxTorqAvail_pct VTQD_EVCU2MinTorqAvail_pct /end REF_MEASUREMENT /end GROUP
/begin GROUP S355_MCUCMD_SCP "SWC_FDC_type/run_SWC_FDC_RxTx_5ms_sys/APP/TQD/OutpConvert/MCUCMD SCP" /begin REF_CHARACTERISTIC KTQD_VCUMCUDemLoNegVal_rpm KTQD_VCUMCUDemSpd_rpm /end REF_CHARACTERISTIC
 /begin REF_MEASUREMENT VTQD_VCUMCUDemLoNegVal_rpm VTQD_VCUMCUDemSpd_rpm VTQD_VCUMCUFootBrk_flg VTQD_VCUMCUGearSta_enum /end REF_MEASUREMENT
/end GROUP
/begin GROUP S355_MSF_SCP "SWC_FDC_type/run_SWC_FDC_RxTx_5ms_sys/APP/TQD/OutpConvert/MSF SCP" /begin REF_MEASUREMENT VTQD_VCUEBSHBSw_enum /end REF_MEASUREMENT /end GROUP
/begin GROUP S355_RC1_SCP "SWC_FDC_type/run_SWC_FDC_RxTx_5ms_sys/APP/TQD/OutpConvert/RC1 SCP" /begin REF_CHARACTERISTIC KTQD_MCUMaxRefTorq_Nm /end REF_CHARACTERISTIC
 /begin REF_MEASUREMENT VTQD_RC1MaxRetSpdP2_rpm VTQD_RC1MaxRetSpdP3_rpm VTQD_RC1PctTrqIdleP1_pct VTQD_RC1PctTrqP3_pct VTQD_RC1PctTrqP4_pct VTQD_RC1PctTrqPekTrqP5_pct VTQD_RC1RefRetTrq_Nm VTQD_RC1RetCtrlMth_enum VTQD_RC1RetLocat_enum VTQD_RC1RetSpdIdleP1_rpm VTQD_RC1RetSpdP2_pct VTQD_RC1RetSpdP4_rpm VTQD_RC1RetSpdPekTrqP5_Nm VTQD_RC1RetType_enum /end REF_MEASUREMENT
/end GROUP
/begin GROUP S355_TUpA_Indication "SWC_FDC_type/run_SWC_FDC_RxTx_5ms_sys/APP/TQD/OutpConvert/TUpA Indication" /begin REF_MEASUREMENT VTQD_TUpAIND_enum /end REF_MEASUREMENT /end GROUP
/begin GROUP S356_Input_Signal "SWC_FDC_type/run_SWC_FDC_RxTx_5ms_sys/APP/TQD/SCP_In/Input Signal" /begin REF_MEASUREMENT VTQD_VCUMCUHandBrk_flg /end REF_MEASUREMENT /end GROUP
/begin GROUP S356_Invalid_Condition "SWC_FDC_type/run_SWC_FDC_RxTx_5ms_sys/APP/TQD/SCP_In/Invalid Condition"
 /begin REF_MEASUREMENT VTQD_EM1OvrCtrlMBrkInV_flg VTQD_EM1ReqTorqLimBrkInV_flg VTQD_EM1ReqTorqLimDrivInV_flg VTQD_FASpeedInV_flg VTQD_MCUFailGradeInV_flg VTQD_MotorSpdInV_flg VTQD_MotorTrqInV_flg /end REF_MEASUREMENT
/end GROUP
/begin GROUP S70_DTC_Couter "SWC_FDC_type/run_SWC_FDC_RxTx_5ms_sys/APP/ACC/OutpConvert/EAC Temperature Over High Detection/DTC_Couter" /begin REF_MEASUREMENT VACC_CACTempOverHigh_flg /end REF_MEASUREMENT /end GROUP
/begin GROUP S82_Subsystem "SWC_FDC_type/run_SWC_FDC_RxTx_5ms_sys/APP/BCM/Subsystem/BSDandInnerBuzzer/Subsystem"
 /begin REF_CHARACTERISTIC KBCM_BSDFlashOFFT_cnt KBCM_BSDFlashONT_cnt KBCM_BSDRedMode_enum KBCM_BSDWarnReqLv_enum /end REF_CHARACTERISTIC
 /begin REF_MEASUREMENT VBCM_FDCBCMLBSDRCmd_flg VBCM_FDCBCMLBSDYCmd_flg /end REF_MEASUREMENT
/end GROUP
/begin GROUP S82_Subsystem1 "SWC_FDC_type/run_SWC_FDC_RxTx_5ms_sys/APP/BCM/Subsystem/BSDandInnerBuzzer/Subsystem1"
 /begin REF_CHARACTERISTIC KBCM_BSDFlashOFFT_cnt KBCM_BSDFlashONT_cnt KBCM_BSDRedMode_enum KBCM_BSDWarnReqLv_enum /end REF_CHARACTERISTIC
 /begin REF_MEASUREMENT VBCM_FDCBCMRBSDRCmd_flg VBCM_FDCBCMRBSDYCmd_flg /end REF_MEASUREMENT
/end GROUP
/begin GROUP S84_Subsystem "SWC_FDC_type/run_SWC_FDC_RxTx_5ms_sys/APP/BCM/Subsystem/DoorControl/Subsystem" /begin REF_MEASUREMENT VBCM_FDCBCMFDOpenSVCmd_flg /end REF_MEASUREMENT /end GROUP
/begin GROUP S84_Subsystem1 "SWC_FDC_type/run_SWC_FDC_RxTx_5ms_sys/APP/BCM/Subsystem/DoorControl/Subsystem1" /begin REF_MEASUREMENT VBCM_FDCBCMFDCloseSVCmd_flg /end REF_MEASUREMENT /end GROUP
/begin GROUP S84_Subsystem2 "SWC_FDC_type/run_SWC_FDC_RxTx_5ms_sys/APP/BCM/Subsystem/DoorControl/Subsystem2" /begin REF_MEASUREMENT VBCM_FDCBCMMDOpenSVCmd_flg /end REF_MEASUREMENT /end GROUP
/begin GROUP S84_Subsystem3 "SWC_FDC_type/run_SWC_FDC_RxTx_5ms_sys/APP/BCM/Subsystem/DoorControl/Subsystem3" /begin REF_MEASUREMENT VBCM_FDCBCMMDCloseSVCmd_flg /end REF_MEASUREMENT /end GROUP
/begin GROUP S85_Subsystem4 "SWC_FDC_type/run_SWC_FDC_RxTx_5ms_sys/APP/BCM/Subsystem/ExteriorLight/Subsystem4" /begin SUB_GROUP S136_DelayOFF S136_DelayON /end SUB_GROUP /begin REF_CHARACTERISTIC KBCM_LampOFFV_V KBCM_LampONV_V /end REF_CHARACTERISTIC /end GROUP
/begin GROUP S232_EHPS_Initialization "SWC_FDC_type/run_SWC_FDC_RxTx_5ms_sys/APP/PMM/PowerModeManagement/PMM Flag Creator /EHPS Initialization" /begin REF_CHARACTERISTIC KPMM_EHPSSpdDem_rpm /end REF_CHARACTERISTIC /end GROUP
/begin GROUP S232_MCU_Discharge_Enable_Feedback "SWC_FDC_type/run_SWC_FDC_RxTx_5ms_sys/APP/PMM/PowerModeManagement/PMM Flag Creator /MCU Discharge Enable Feedback" /begin REF_CHARACTERISTIC KPMM_MCUDisChrgFailtime_s /end REF_CHARACTERISTIC /end GROUP
/begin GROUP S234_ChrgFault_SW "SWC_FDC_type/run_SWC_FDC_RxTx_5ms_sys/APP/PMM/PowerModeManagement/PMM Switch Enum Creator/ChrgFault_SW" /begin REF_CHARACTERISTIC KPMM_StaSwTime_s /end REF_CHARACTERISTIC /end GROUP
/begin GROUP S234_PowerDownFault_SW "SWC_FDC_type/run_SWC_FDC_RxTx_5ms_sys/APP/PMM/PowerModeManagement/PMM Switch Enum Creator/PowerDownFault_SW" /begin REF_CHARACTERISTIC KPMM_StaSwTime_s /end REF_CHARACTERISTIC /end GROUP
/begin GROUP S358_Acceleration_Limiter "SWC_FDC_type/run_SWC_FDC_RxTx_5ms_sys/APP/TQD/Input_Convert/Function/Acceleration Limiter" /begin REF_CHARACTERISTIC KTQD_MCUMaxRefTorq_Nm /end REF_CHARACTERISTIC /end GROUP
/begin GROUP S358_Creep "SWC_FDC_type/run_SWC_FDC_RxTx_5ms_sys/APP/TQD/Input_Convert/Function/Creep"
 /begin REF_CHARACTERISTIC KTQD_VehSpdADJFactor_Factor KTQD_VehSpdGearRatio_ratio KTQD_VehSpdTireDiameter_m KTQD_VehSpdTireFactor_Factor /end REF_CHARACTERISTIC
/end GROUP
/begin GROUP S358_Shift_Modul "SWC_FDC_type/run_SWC_FDC_RxTx_5ms_sys/APP/TQD/Input_Convert/Function/Shift Modul" /begin REF_CHARACTERISTIC KTQD_DMSLostTorqLimit_kph /end REF_CHARACTERISTIC /end GROUP
/begin GROUP S358_Speed_Limiter "SWC_FDC_type/run_SWC_FDC_RxTx_5ms_sys/APP/TQD/Input_Convert/Function/Speed Limiter" /begin REF_CHARACTERISTIC KTQD_MCUMaxRefTorq_Nm /end REF_CHARACTERISTIC /end GROUP
/begin GROUP S359_kph_to_rpm_ "SWC_FDC_type/run_SWC_FDC_RxTx_5ms_sys/APP/TQD/Input_Convert/Input Signal Convert/kph to rpm "
 /begin REF_CHARACTERISTIC KTQD_VCUMCUDemHiPosVal_rpm KTQD_VehSpdADJFactor_Factor KTQD_VehSpdGearRatio_ratio KTQD_VehSpdTireDiameter_m KTQD_VehSpdTireFactor_Factor /end REF_CHARACTERISTIC
/end GROUP
/end MODULE
/end PROJECT
/* (add any file trailer comments here) */ /* EOF SWC_FDC_type.a2l */
