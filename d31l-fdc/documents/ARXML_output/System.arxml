[part 1 of 2: package /SysEnv_ARPkg]
AUTOSAR XML (schema 4-3-0)
package /SysEnv_ARPkg
  system System_FDC: category=SYSTEM_DESCRIPTION, ecu-extract-version=1.0.0, system-version=1.0.0
    96 x system mapping:
      MAP_CAN1_ABM1: sender-receiver-to-signal-group-mapping{communication-direction=IN, data-element=SWC_FDC.root_FDC.R_CAN1_ABM1.CAN1_SG_ABM1, signal-group=CAN1_SG_ABM1, type-mapping=sender-rec-record-type-mapping=record-element-mappings=[{implementation-record-element=CAN1_AirBagFailCmd, system-signal=CAN1_AirBagFailCmd}, {implementation-record-element=CAN1_TRHPsngrSeatBeltCmd, system-signal=CAN1_TRHPsngrSeatBeltCmd}, {implementation-record-element=CAN1_TLHPsngrSeatBeltCmd, system-signal=CAN1_TLHPsngrSeatBeltCmd}, {implementation-record-element=CAN1_RPsngrSeatBeltCmd, system-signal=CAN1_RPsngrSeatBeltCmd}, {implementation-record-element=CAN1_RDriverSeatBeltCmd, system-signal=CAN1_RDriverSeatBeltCmd}, {implementation-record-element=CAN1_RCenterSeatBeltCmd, system-signal=CAN1_RCenterSeatBeltCmd}, {implementation-record-element=CAN1_PsngrSeatBeltCmd, system-signal=CAN1_PsngrSeatBeltCmd}, {implementation-record-element=CAN1_PABSwitchCmd, system-signal=CAN1_PABSwitchCmd}, {implementation-record-element=CAN1_LifeCount_ABM1, system-signal=CAN1_LifeCount_ABM1}, {implementation-record-element=CAN1_DriverSeatBeltCmd, system-signal=CAN1_DriverSeatBeltCmd}, {implementation-record-element=CAN1_CrashOutputSts, system-signal=CAN1_CrashOutputSts}, {implementation-record-element=CAN1_Checksum_ABM1, system-signal=CAN1_Checksum_ABM1}]}
      MAP_CAN1_EPAS1: sender-receiver-to-signal-group-mapping{communication-direction=IN, data-element=SWC_FDC.root_FDC.R_CAN1_EPAS1.CAN1_SG_EPAS1, signal-group=CAN1_SG_EPAS1, type-mapping=sender-rec-record-type-mapping=record-element-mappings=[{implementation-record-element=CAN1_DriIntend, system-signal=CAN1_DriIntend}, {implementation-record-element=CAN1_EPS_TOI_Fault, system-signal=CAN1_EPS_TOI_Fault}, {implementation-record-element=CAN1_EPS_AOI_Control, system-signal=CAN1_EPS_AOI_Control}, {implementation-record-element=CAN1_EPAS1_LifeCount, system-signal=CAN1_EPAS1_LifeCount}, {implementation-record-element=CAN1_EPAS1_Checksum, system-signal=CAN1_EPAS1_Checksum}]}
      MAP_CAN1_EPAS2: sender-receiver-to-signal-group-mapping{communication-direction=IN, data-element=SWC_FDC.root_FDC.R_CAN1_EPAS2.CAN1_SG_EPAS2, signal-group=CAN1_SG_EPAS2, type-mapping=sender-rec-record-type-mapping=record-element-mappings=[{implementation-record-element=CAN1_SAS_Angle, system-signal=CAN1_SAS_Angle}, {implementation-record-element=CAN1_SAS_V, system-signal=CAN1_SAS_V}, {implementation-record-element=CAN1_SAS_Speed_Valid, system-signal=CAN1_SAS_Speed_Valid}, {implementation-record-element=CAN1_SAS_Speed, system-signal=CAN1_SAS_Speed}, {implementation-record-element=CAN1_SAS_MsgCount, system-signal=CAN1_SAS_MsgCount}, {implementation-record-element=CAN1_SAS_CheckSum, system-signal=CAN1_SAS_CheckSum}, {implementation-record-element=CAN1_SAS_CAL, system-signal=CAN1_SAS_CAL}]}
      MAP_CAN1_EPB1: sender-receiver-to-signal-group-mapping{communication-direction=IN, data-element=SWC_FDC.root_FDC.R_CAN1_EPB1.CAN1_SG_EPB1, signal-group=CAN1_SG_EPB1, type-mapping=sender-rec-record-type-mapping=record-element-mappings=[{implementation-record-element=CAN1_DOA_Sta, system-signal=CAN1_DOA_Sta}, {implementation-record-element=CAN1_TakeOverReq, system-signal=CAN1_TakeOverReq}, {implementation-record-element=CAN1_EPBStaR, system-signal=CAN1_EPBStaR}, {implementation-record-element=CAN1_EPBStaL, system-signal=CAN1_EPBStaL}, {implementation-record-element=CAN1_EPBSta, system-signal=CAN1_EPBSta}, {implementation-record-element=CAN1_EPBRLampSta, system-signal=CAN1_EPBRLampSta}, {implementation-record-element=CAN1_EPBMsg, system-signal=CAN1_EPBMsg}, {implementation-record-element=CAN1_EPBExtReleaseAvail, system-signal=CAN1_EPBExtReleaseAvail}, {implementation-record-element=CAN1_EPBExtApplyAvail, system-signal=CAN1_EPBExtApplyAvail}, {implementation-record-element=CAN1_EPBErrSta, system-signal=CAN1_EPBErrSta}, {implementation-record-element=CAN1_EPBCarWashMode, system-signal=CAN1_EPBCarWashMode}, {implementation-record-element=CAN1_EPB1_RC, system-signal=CAN1_EPB1_RC}, {implementation-record-element=CAN1_EPB1_CS, system-signal=CAN1_EPB1_CS}]}
      MAP_CAN1_ESC1: sender-receiver-to-signal-group-mapping{communication-direction=IN, data-element=SWC_FDC.root_FDC.R_CAN1_ESC1.CAN1_SG_ESC1, signal-group=CAN1_SG_ESC1, type-mapping=sender-rec-record-type-mapping=record-element-mappings=[{implementation-record-element=CAN1_ESC1_CS, system-signal=CAN1_ESC1_CS}, {implementation-record-element=CAN1_VehSpeed, system-signal=CAN1_VehSpeed}, {implementation-record-element=CAN1_Rr_PTCS_Active, system-signal=CAN1_Rr_PTCS_Active}, {implementation-record-element=CAN1_RearAxlTrqReq_Drv, system-signal=CAN1_RearAxlTrqReq_Drv}, {implementation-record-element=CAN1_FrntAxlTrqReq_Drv, system-signal=CAN1_FrntAxlTrqReq_Drv}, {implementation-record-element=CAN1_Fr_PTCS_Active, system-signal=CAN1_Fr_PTCS_Active}, {implementation-record-element=CAN1_ESC1_RC, system-signal=CAN1_ESC1_RC}]}
      MAP_CAN1_ESC2: sender-receiver-to-signal-group-mapping{communication-direction=IN, data-element=SWC_FDC.root_FDC.R_CAN1_ESC2.CAN1_SG_ESC2, signal-group=CAN1_SG_ESC2, type-mapping=sender-rec-record-type-mapping=record-element-mappings=[{implementation-record-element=CAN1_F_WhlSpeed_CRC_8, system-signal=CAN1_F_WhlSpeed_CRC_8}, {implementation-record-element=CAN1_RF_WhlRotDir, system-signal=CAN1_RF_WhlRotDir}, {implementation-record-element=CAN1_RF_RawWhlSpeed_V, system-signal=CAN1_RF_RawWhlSpeed_V}, {implementation-record-element=CAN1_RF_RawWhlSpeed, system-signal=CAN1_RF_RawWhlSpeed}, {implementation-record-element=CAN1_RF_PulseCount_V, system-signal=CAN1_RF_PulseCount_V}, {implementation-record-element=CAN1_RF_PulseCount, system-signal=CAN1_RF_PulseCount}, {implementation-record-element=CAN1_LF_WhlRotDir, system-signal=CAN1_LF_WhlRotDir}, {implementation-record-element=CAN1_LF_RawWhlSpeed_V, system-signal=CAN1_LF_RawWhlSpeed_V}, {implementation-record-element=CAN1_LF_RawWhlSpeed, system-signal=CAN1_LF_RawWhlSpeed}, {implementation-record-element=CAN1_LF_PulseCount_V, system-signal=CAN1_LF_PulseCount_V}, {implementation-record-element=CAN1_LF_PulseCount, system-signal=CAN1_LF_PulseCount}, {implementation-record-element=CAN1_F_WhlSpeed_Count, system-signal=CAN1_F_WhlSpeed_Count}]}
      MAP_CAN1_ESC3: sender-receiver-to-signal-group-mapping{communication-direction=IN, data-element=SWC_FDC.root_FDC.R_CAN1_ESC3.CAN1_SG_ESC3, signal-group=CAN1_SG_ESC3, type-mapping=sender-rec-record-type-mapping=record-element-mappings=[{implementation-record-element=CAN1_LR_PulseCount, system-signal=CAN1_LR_PulseCount}, {implementation-record-element=CAN1_R_WhlSpeed_Count, system-signal=CAN1_R_WhlSpeed_Count}, {implementation-record-element=CAN1_R_WhlSpeed_CRC_8, system-signal=CAN1_R_WhlSpeed_CRC_8}, {implementation-record-element=CAN1_RR_WhlRotDir, system-signal=CAN1_RR_WhlRotDir}, {implementation-record-element=CAN1_RR_RawWhlSpeed_V, system-signal=CAN1_RR_RawWhlSpeed_V}, {implementation-record-element=CAN1_RR_RawWhlSpeed, system-signal=CAN1_RR_RawWhlSpeed}, {implementation-record-element=CAN1_RR_PulseCount_V, system-signal=CAN1_RR_PulseCount_V}, {implementation-record-element=CAN1_RR_PulseCount, system-signal=CAN1_RR_PulseCount}, {implementation-record-element=CAN1_LR_WhlRotDir, system-signal=CAN1_LR_WhlRotDir}, {implementation-record-element=CAN1_LR_RawWhlSpeed_V, system-signal=CAN1_LR_RawWhlSpeed_V}, {implementation-record-element=CAN1_LR_RawWhlSpeed, system-signal=CAN1_LR_RawWhlSpeed}, {implementation-record-element=CAN1_LR_PulseCount_V, system-signal=CAN1_LR_PulseCount_V}]}
      MAP_CAN1_ESC4: sender-receiver-to-signal-group-mapping{communication-direction=IN, data-element=SWC_FDC.root_FDC.R_CAN1_ESC4.CAN1_SG_ESC4, signal-group=CAN1_SG_ESC4, type-mapping=sender-rec-record-type-mapping=record-element-mappings=[{implementation-record-element=CAN1_ABS_Active, system-signal=CAN1_ABS_Active}, {implementation-record-element=CAN1_TCS_Failed, system-signal=CAN1_TCS_Failed}, {implementation-record-element=CAN1_TCS_Active, system-signal=CAN1_TCS_Active}, {implementation-record-element=CAN1_SystemVoltage, system-signal=CAN1_SystemVoltage}, {implementation-record-element=CAN1_Red_WnlmpSta, system-signal=CAN1_Red_WnlmpSta}, {implementation-record-element=CAN1_PBA_Failed, system-signal=CAN1_PBA_Failed}, {implementation-record-element=CAN1_PBA_Active, system-signal=CAN1_PBA_Active}, {implementation-record-element=CAN1_HSA_Failed, system-signal=CAN1_HSA_Failed}, {implementation-record-element=CAN1_HSA_Active, system-signal=CAN1_HSA_Active}, {implementation-record-element=CAN1_HDD_Failed, system-signal=CAN1_HDD_Failed}, {implementation-record-element=CAN1_HDD_Active, system-signal=CAN1_HDD_Active}, {implementation-record-element=CAN1_HBB_Failed, system-signal=CAN1_HBB_Failed}, {implementation-record-element=CAN1_HBB_Active, system-signal=CAN1_HBB_Active}, {implementation-record-element=CAN1_GRADE, system-signal=CAN1_GRADE}, {implementation-record-element=CAN1_ESS_Active, system-signal=CAN1_ESS_Active}, {implementation-record-element=CAN1_ESC_WnlmpSta, system-signal=CAN1_ESC_WnlmpSta}, {implementation-record-element=CAN1_ESC_Off_lmpSta, system-signal=CAN1_ESC_Off_lmpSta}, {implementation-record-element=CAN1_ESC_OFF_Status, system-signal=CAN1_ESC_OFF_Status}, {implementation-record-element=CAN1_ESC_Failed, system-signal=CAN1_ESC_Failed}, {implementation-record-element=CAN1_ESC_BeepReq, system-signal=CAN1_ESC_BeepReq}, {implementation-record-element=CAN1_ESC_Active, system-signal=CAN1_ESC_Active}, {implementation-record-element=CAN1_EBD_Failed, system-signal=CAN1_EBD_Failed}, {implementation-record-element=CAN1_EBD_Active, system-signal=CAN1_EBD_Active}, {implementation-record-element=CAN1_BTCS_Active, system-signal=CAN1_BTCS_Active}, {implementation-record-element=CAN1_Amber_WnlmpSta, system-signal=CAN1_Amber_WnlmpSta}, {implementation-record-element=CAN1_AVH_Failed, system-signal=CAN1_AVH_Failed}, {implementation-record-element=CAN1_AVH_Active, system-signal=CAN1_AVH_Active}, {implementation-record-element=CAN1_ABS_WnlmpSta, system-signal=CAN1_ABS_WnlmpSta}, {implementation-record-element=CAN1_ABS_Failed, system-signal=CAN1_ABS_Failed}]}
      MAP_CAN1_ESC5: sender-receiver-to-signal-group-mapping{communication-direction=IN, data-element=SWC_FDC.root_FDC.R_CAN1_ESC5.CAN1_SG_ESC5, signal-group=CAN1_SG_ESC5, type-mapping=sender-rec-record-type-mapping=record-element-mappings=[{implementation-record-element=CAN1_BrkSw_Sta, system-signal=CAN1_BrkSw_Sta}, {implementation-record-element=CAN1_YawRate_V, system-signal=CAN1_YawRate_V}, {implementation-record-element=CAN1_YawRate, system-signal=CAN1_YawRate}, {implementation-record-element=CAN1_MCPressure_V, system-signal=CAN1_MCPressure_V}, {implementation-record-element=CAN1_MCPressure, system-signal=CAN1_MCPressure}, {implementation-record-element=CAN1_LongAccel_V, system-signal=CAN1_LongAccel_V}, {implementation-record-element=CAN1_LongAccel, system-signal=CAN1_LongAccel}, {implementation-record-element=CAN1_LatAccel_V, system-signal=CAN1_LatAccel_V}, {implementation-record-element=CAN1_LatAccel, system-signal=CAN1_LatAccel}, {implementation-record-element=CAN1_ESC5_RC, system-signal=CAN1_ESC5_RC}, {implementation-record-element=CAN1_ESC5_CRC8, system-signal=CAN1_ESC5_CRC8}, {implementation-record-element=CAN1_BrkSw_V, system-signal=CAN1_BrkSw_V}]}
      MAP_CAN1_ESC6: sender-receiver-to-signal-group-mapping{communication-direction=IN, data-element=SWC_FDC.root_FDC.R_CAN1_ESC6.CAN1_SG_ESC6, signal-group=CAN1_SG_ESC6, type-mapping=sender-rec-record-type-mapping=record-element-mappings=[{implementation-record-element=CAN1_ACCAvail, system-signal=CAN1_ACCAvail}, {implementation-record-element=CAN1_Meter_Ind_VehSpeed, system-signal=CAN1_Meter_Ind_VehSpeed}, {implementation-record-element=CAN1_ESC_Standstill, system-signal=CAN1_ESC_Standstill}, {implementation-record-element=CAN1_ESC_APS_Sta, system-signal=CAN1_ESC_APS_Sta}, {implementation-record-element=CAN1_ESC_ADAS_Sta, system-signal=CAN1_ESC_ADAS_Sta}, {implementation-record-element=CAN1_ESC6_RC, system-signal=CAN1_ESC6_RC}, {implementation-record-element=CAN1_ESC6_CS, system-signal=CAN1_ESC6_CS}, {implementation-record-element=CAN1_DecErrSta, system-signal=CAN1_DecErrSta}, {implementation-record-element=CAN1_BrkDiscTempSta, system-signal=CAN1_BrkDiscTempSta}, {implementation-record-element=CAN1_ActBrkLamp_Sta, system-signal=CAN1_ActBrkLamp_Sta}, {implementation-record-element=CAN1_AEBAvail, system-signal=CAN1_AEBAvail}]}
      MAP_CAN1_ESC7: sender-receiver-to-signal-group-mapping{communication-direction=IN, data-element=SWC_FDC.root_FDC.R_CAN1_ESC7.CAN1_SG_ESC7, signal-group=CAN1_SG_ESC7, type-mapping=sender-rec-record-type-mapping=record-element-mappings=[{implementation-record-element=CAN1_BrkPedalPos, system-signal=CAN1_BrkPedalPos}, {implementation-record-element=CAN1_Rr_RBC_Active, system-signal=CAN1_Rr_RBC_Active}, {implementation-record-element=CAN1_RearAxlTrqReq_Brk, system-signal=CAN1_RearAxlTrqReq_Brk}, {implementation-record-element=CAN1_RDC_Active, system-signal=CAN1_RDC_Active}, {implementation-record-element=CAN1_FrntAxlTrqReq_Brk, system-signal=CAN1_FrntAxlTrqReq_Brk}, {implementation-record-element=CAN1_Fr_RBC_Active, system-signal=CAN1_Fr_RBC_Active}, {implementation-record-element=CAN1_ESC7_RC, system-signal=CAN1_ESC7_RC}, {implementation-record-element=CAN1_ESC7_CS, system-signal=CAN1_ESC7_CS}, {implementation-record-element=CAN1_BrkPedalPos_Sta, system-signal=CAN1_BrkPedalPos_Sta}]}
      MAP_CAN1_FCM2: sender-receiver-to-signal-group-mapping{communication-direction=IN, data-element=SWC_FDC.root_FDC.R_CAN1_FCM2.CAN1_SG_FCM2, signal-group=CAN1_SG_FCM2, type-mapping=sender-rec-record-type-mapping=record-element-mappings=[{implementation-record-element=CAN1_ACC_ComfortBandLower, system-signal=CAN1_ACC_ComfortBandLower}, {implementation-record-element=CAN1_FCM2_LifeCount, system-signal=CAN1_FCM2_LifeCount}, {implementation-record-element=CAN1_FCM2_Checksum, system-signal=CAN1_FCM2_Checksum}, {implementation-record-element=CAN1_AEB_VehHoldReq, system-signal=CAN1_AEB_VehHoldReq}, {implementation-record-element=CAN1_ADAS_FaultSta, system-signal=CAN1_ADAS_FaultSta}, {implementation-record-element=CAN1_ADAS_DBSReq, system-signal=CAN1_ADAS_DBSReq}, {implementation-record-element=CAN1_ADAS_AEBReq, system-signal=CAN1_ADAS_AEBReq}, {implementation-record-element=CAN1_ACC_VehHoldReq, system-signal=CAN1_ACC_VehHoldReq}, {implementation-record-element=CAN1_ACC_RequiredAccel, system-signal=CAN1_ACC_RequiredAccel}, {implementation-record-element=CAN1_ACC_JerkUpperLimit, system-signal=CAN1_ACC_JerkUpperLimit}, {implementation-record-element=CAN1_ACC_JerkLowerLimit, system-signal=CAN1_ACC_JerkLowerLimit}, {implementation-record-element=CAN1_ACC_ComfortBandUpper, system-signal=CAN1_ACC_ComfortBandUpper}]}
      MAP_CAN1_FCM3: sender-receiver-to-signal-group-mapping{communication-direction=IN, data-element=SWC_FDC.root_FDC.R_CAN1_FCM3.CAN1_SG_FCM3, signal-group=CAN1_SG_FCM3, type-mapping=sender-rec-record-type-mapping=record-element-mappings=[{implementation-record-element=CAN1_ACC_ObjDist, system-signal=CAN1_ACC_ObjDist}, {implementation-record-element=CAN1_FCM3_LifeCount, system-signal=CAN1_FCM3_LifeCount}, {implementation-record-element=CAN1_FCM3_Checksum, system-signal=CAN1_FCM3_Checksum}, {implementation-record-element=CAN1_ADAS_VehSpdLim, system-signal=CAN1_ADAS_VehSpdLim}, {implementation-record-element=CAN1_ADAS_ShftPosnReq_A, system-signal=CAN1_ADAS_ShftPosnReq_A}, {implementation-record-element=CAN1_ADAS_ShftPosnReq, system-signal=CAN1_ADAS_ShftPosnReq}, {implementation-record-element=CAN1_ADAS_ForceIdle, system-signal=CAN1_ADAS_ForceIdle}, {implementation-record-element=CAN1_ACC_ObjRelSpd, system-signal=CAN1_ACC_ObjRelSpd}]}
      MAP_CAN1_FCM4: sender-receiver-to-signal-group-mapping{communication-direction=IN, data-element=SWC_FDC.root_FDC.R_CAN1_FCM4.CAN1_SG_FCM4, signal-group=CAN1_SG_FCM4, type-mapping=sender-rec-record-type-mapping=record-element-mappings=[{implementation-record-element=CAN1_ACCSetSpeed, system-signal=CAN1_ACCSetSpeed}, {implementation-record-element=CAN1_TimeGapLevel, system-signal=CAN1_TimeGapLevel}, {implementation-record-element=CAN1_Target_Type, system-signal=CAN1_Target_Type}, {implementation-record-element=CAN1_RightTurnLightReq, system-signal=CAN1_RightTurnLightReq}, {implementation-record-element=CAN1_LeftTurnLightReq, system-signal=CAN1_LeftTurnLightReq}, {implementation-record-element=CAN1_HazardWarningReq, system-signal=CAN1_HazardWarningReq}, {implementation-record-element=CAN1_ForceLowBeam, system-signal=CAN1_ForceLowBeam}, {implementation-record-element=CAN1_FCM4_Checksum, system-signal=CAN1_FCM4_Checksum}, {implementation-record-element=CAN1_ADAS_WarningMsg, system-signal=CAN1_ADAS_WarningMsg}, {implementation-record-element=CAN1_ADAS_SLIF_SpdLim, system-signal=CAN1_ADAS_SLIF_SpdLim}, {implementation-record-element=CAN1_ADAS_LDW_Sta, system-signal=CAN1_ADAS_LDW_Sta}, {implementation-record-element=CAN1_ADAS_FltWrnReq, system-signal=CAN1_ADAS_FltWrnReq}, {implementation-record-element=CAN1_ADAS_FCW_Sta, system-signal=CAN1_ADAS_FCW_Sta}, {implementation-record-element=CAN1_ADAS_CAM_SpdLim, system-signal=CAN1_ADAS_CAM_SpdLim}, {implementation-record-element=CAN1_ADAS_AEB_Sta, system-signal=CAN1_ADAS_AEB_Sta}, {implementation-record-element=CAN1_ADAS_ACC_Sta, system-signal=CAN1_ADAS_ACC_Sta}, {implementation-record-element=CAN1_ACC_TakeoverReq, system-signal=CAN1_ACC_TakeoverReq}, {implementation-record-element=CAN1_ACC_ObjDstLvl, system-signal=CAN1_ACC_ObjDstLvl}, {implementation-record-element=CAN1_ACCSetSpeed_Disp, system-signal=CAN1_ACCSetSpeed_Disp}]}
      MAP_CAN1_FD_APS1: sender-receiver-to-signal-group-mapping{communication-direction=OUT, data-element=SWC_FDC.root_FDC.P_CAN1_FD_APS1.CAN1_SG_FD_APS1, signal-group=CAN1_SG_FD_APS1, type-mapping=sender-rec-record-type-mapping=record-element-mappings=[{implementation-record-element=CAN1_APS_Angle_Target, system-signal=CAN1_APS_Angle_Target}, {implementation-record-element=CAN1_APS_V_Rq_EPAS_Ctrl, system-signal=CAN1_APS_V_Rq_EPAS_Ctrl}, {implementation-record-element=CAN1_APS_Sta_System, system-signal=CAN1_APS_Sta_System}, {implementation-record-element=CAN1_APS_Rq_EPAS_Ctrl, system-signal=CAN1_APS_Rq_EPAS_Ctrl}]}
      MAP_CAN1_FD_APS2: sender-receiver-to-signal-group-mapping{communication-direction=OUT, data-element=SWC_FDC.root_FDC.P_CAN1_FD_APS2.CAN1_SG_FD_APS2, signal-group=CAN1_SG_FD_APS2, type-mapping=sender-rec-record-type-mapping=record-element-mappings=[{implementation-record-element=CAN1_APS_D_FLL, system-signal=CAN1_APS_D_FLL}, {implementation-record-element=CAN1_USS_Sta_RMR, system-signal=CAN1_USS_Sta_RMR}, {implementation-record-element=CAN1_USS_Sta_RML, system-signal=CAN1_USS_Sta_RML}, {implementation-record-element=CAN1_USS_Sta_RLR, system-signal=CAN1_USS_Sta_RLR}, {implementation-record-element=CAN1_USS_Sta_RLL, system-signal=CAN1_USS_Sta_RLL}, {implementation-record-element=CAN1_USS_Sta_RCR, system-signal=CAN1_USS_Sta_RCR}, {implementation-record-element=CAN1_USS_Sta_RCL, system-signal=CAN1_USS_Sta_RCL}, {implementation-record-element=CAN1_USS_Sta_FMR, system-signal=CAN1_USS_Sta_FMR}, {implementation-record-element=CAN1_USS_Sta_FML, system-signal=CAN1_USS_Sta_FML}, {implementation-record-element=CAN1_USS_Sta_FLR, system-signal=CAN1_USS_Sta_FLR}, {implementation-record-element=CAN1_USS_Sta_FLL, system-signal=CAN1_USS_Sta_FLL}, {implementation-record-element=CAN1_USS_Sta_FCR, system-signal=CAN1_USS_Sta_FCR}, {implementation-record-element=CAN1_USS_Sta_FCL, system-signal=CAN1_USS_Sta_FCL}, {implementation-record-element=CAN1_PAS_Sta_F_Sys, system-signal=CAN1_PAS_Sta_F_Sys}, {implementation-record-element=CAN1_PAS_SNSR_Layout, system-signal=CAN1_PAS_SNSR_Layout}, {implementation-record-element=CAN1_PAS_Mod_Operation, system-signal=CAN1_PAS_Mod_Operation}, {implementation-record-element=CAN1_PAS_D_RMR, system-signal=CAN1_PAS_D_RMR}, {implementation-record-element=CAN1_PAS_D_RML, system-signal=CAN1_PAS_D_RML}, {implementation-record-element=CAN1_PAS_D_RCR, system-signal=CAN1_PAS_D_RCR}, {implementation-record-element=CAN1_PAS_D_RCL, system-signal=CAN1_PAS_D_RCL}, {implementation-record-element=CAN1_PAS_D_FMR, system-signal=CAN1_PAS_D_FMR}, {implementation-record-element=CAN1_PAS_D_FML, system-signal=CAN1_PAS_D_FML}, {implementation-record-element=CAN1_PAS_D_FCR, system-signal=CAN1_PAS_D_FCR}, {implementation-record-element=CAN1_PAS_D_FCL, system-signal=CAN1_PAS_D_FCL}, {implementation-record-element=CAN1_PAS_Chime, system-signal=CAN1_PAS_Chime}, {implementation-record-element=CAN1_PAS_A_RMR, system-signal=CAN1_PAS_A_RMR}, {implementation-record-element=CAN1_PAS_A_RML, system-signal=CAN1_PAS_A_RML}, {implementation-record-element=CAN1_PAS_A_RCR, system-signal=CAN1_PAS_A_RCR}, {implementation-record-element=CAN1_PAS_A_RCL, system-signal=CAN1_PAS_A_RCL}, {implementation-record-element=CAN1_PAS_A_FMR, system-signal=CAN1_PAS_A_FMR}, {implementation-record-element=CAN1_PAS_A_FML, system-signal=CAN1_PAS_A_FML}, {implementation-record-element=CAN1_PAS_A_FCR, system-signal=CAN1_PAS_A_FCR}, {implementation-record-element=CAN1_PAS_A_FCL, system-signal=CAN1_PAS_A_FCL}, {implementation-record-element=CAN1_APS_SW_Ver, system-signal=CAN1_APS_SW_Ver}, {implementation-record-element=CAN1_APS_RQ_Display, system-signal=CAN1_APS_RQ_Display}, {implementation-record-element=CAN1_APS_Progress_PCT, system-signal=CAN1_APS_Progress_PCT}, {implementation-record-element=CAN1_APS_HW_Ver, system-signal=CAN1_APS_HW_Ver}, {implementation-record-element=CAN1_APS_ExitCondition, system-signal=CAN1_APS_ExitCondition}, {implementation-record-element=CAN1_APS_D_RLR, system-signal=CAN1_APS_D_RLR}, {implementation-record-element=CAN1_APS_D_RLL, system-signal=CAN1_APS_D_RLL}, {implementation-record-element=CAN1_APS_D_FLR, system-signal=CAN1_APS_D_FLR}]}
      MAP_CAN1_FD_APS3: sender-receiver-to-signal-group-mapping{communication-direction=OUT, data-element=SWC_FDC.root_FDC.P_CAN1_FD_APS3.CAN1_SG_FD_APS3, signal-group=CAN1_SG_FD_APS3, type-mapping=sender-rec-record-type-mapping=record-element-mappings=[{implementation-record-element=CAN1_APS3_LifeCount, system-signal=CAN1_APS3_LifeCount}, {implementation-record-element=CAN1_SPTG_Sta, system-signal=CAN1_SPTG_Sta}, {implementation-record-element=CAN1_SPTGDet, system-signal=CAN1_SPTGDet}, {implementation-record-element=CAN1_CAAS_Sta, system-signal=CAN1_CAAS_Sta}, {implementation-record-element=CAN1_APS_Req, system-signal=CAN1_APS_Req}, {implementation-record-element=CAN1_APS_DecReq_A, system-signal=CAN1_APS_DecReq_A}, {implementation-record-element=CAN1_APS_DecReq, system-signal=CAN1_APS_DecReq}, {implementation-record-element=CAN1_APSOpenPTG, system-signal=CAN1_APSOpenPTG}, {implementation-record-element=CAN1_APS3_checksum, system-signal=CAN1_APS3_checksum}]}
      MAP_CAN1_FD_BCM1: sender-receiver-to-signal-group-mapping{communication-direction=OUT, data-element=SWC_FDC.root_FDC.P_CAN1_FD_BCM1.CAN1_SG_FD_BCM1, signal-group=CAN1_SG_FD_BCM1, type-mapping=sender-rec-record-type-mapping=record-element-mappings=[{implementation-record-element=CAN1_AllDoorSW, system-signal=CAN1_AllDoorSW}, {implementation-record-element=CAN1_WiperFixMode, system-signal=CAN1_WiperFixMode}, {implementation-record-element=CAN1_WasherCtrl, system-signal=CAN1_WasherCtrl}, {implementation-record-element=CAN1_TrunkRel, system-signal=CAN1_TrunkRel}, {implementation-record-element=CAN1_Tailgate_SW, system-signal=CAN1_Tailgate_SW}, {implementation-record-element=CAN1_TailgateRemote, system-signal=CAN1_TailgateRemote}, {implementation-record-element=CAN1_TailgateHDSW, system-signal=CAN1_TailgateHDSW}, {implementation-record-element=CAN1_Rr_Wiper, system-signal=CAN1_Rr_Wiper}, {implementation-record-element=CAN1_Rr_FogLamp, system-signal=CAN1_Rr_FogLamp}, {implementation-record-element=CAN1_Rr_Defog, system-signal=CAN1_Rr_Defog}, {implementation-record-element=CAN1_Rr_ChargingDoorCtrl, system-signal=CAN1_Rr_ChargingDoorCtrl}, {implementation-record-element=CAN1_RoomLampL, system-signal=CAN1_RoomLampL}, {implementation-record-element=CAN1_RoomLampH, system-signal=CAN1_RoomLampH}, {implementation-record-element=CAN1_ReverseLamp, system-signal=CAN1_ReverseLamp}, {implementation-record-element=CAN1_RTurnLP, system-signal=CAN1_RTurnLP}, {implementation-record-element=CAN1_RRDoorSW, system-signal=CAN1_RRDoorSW}, {implementation-record-element=CAN1_RLDoorSW, system-signal=CAN1_RLDoorSW}, {implementation-record-element=CAN1_RDRL, system-signal=CAN1_RDRL}, {implementation-record-element=CAN1_RBSD, system-signal=CAN1_RBSD}, {implementation-record-element=CAN1_PsDoorSW, system-signal=CAN1_PsDoorSW}, {implementation-record-element=CAN1_PosLamp, system-signal=CAN1_PosLamp}, {implementation-record-element=CAN1_MirrorDefog, system-signal=CAN1_MirrorDefog}, {implementation-record-element=CAN1_MirrorCtrl, system-signal=CAN1_MirrorCtrl}, {implementation-record-element=CAN1_LockSetting, system-signal=CAN1_LockSetting}, {implementation-record-element=CAN1_L_Beam, system-signal=CAN1_L_Beam}, {implementation-record-element=CAN1_L_APM_WdwEnable, system-signal=CAN1_L_APM_WdwEnable}, {implementation-record-element=CAN1_LTurnLP, system-signal=CAN1_LTurnLP}, {implementation-record-element=CAN1_LDRL, system-signal=CAN1_LDRL}, {implementation-record-element=CAN1_LBSD, system-signal=CAN1_LBSD}, {implementation-record-element=CAN1_HornCtrl, system-signal=CAN1_HornCtrl}, {implementation-record-element=CAN1_HoodSW, system-signal=CAN1_HoodSW}, {implementation-record-element=CAN1_HazardSW, system-signal=CAN1_HazardSW}, {implementation-record-element=CAN1_H_Beam, system-signal=CAN1_H_Beam}, {implementation-record-element=CAN1_Fr_Wiper_L, system-signal=CAN1_Fr_Wiper_L}, {implementation-record-element=CAN1_Fr_Wiper_H, system-signal=CAN1_Fr_Wiper_H}, {implementation-record-element=CAN1_Fr_FogLamp, system-signal=CAN1_Fr_FogLamp}, {implementation-record-element=CAN1_Fr_ChargingDoorCtrl, system-signal=CAN1_Fr_ChargingDoorCtrl}, {implementation-record-element=CAN1_DrDoorSW, system-signal=CAN1_DrDoorSW}, {implementation-record-element=CAN1_DoorLockIND, system-signal=CAN1_DoorLockIND}, {implementation-record-element=CAN1_DimmerEN, system-signal=CAN1_DimmerEN}, {implementation-record-element=CAN1_Dimmer, system-signal=CAN1_Dimmer}, {implementation-record-element=CAN1_CrashDetd, system-signal=CAN1_CrashDetd}, {implementation-record-element=CAN1_CTDUnlockSW, system-signal=CAN1_CTDUnlockSW}, {implementation-record-element=CAN1_CTDLockSW, system-signal=CAN1_CTDLockSW}, {implementation-record-element=CAN1_CTDCtrl, system-signal=CAN1_CTDCtrl}, {implementation-record-element=CAN1_BrakeLamp, system-signal=CAN1_BrakeLamp}, {implementation-record-element=CAN1_BCM_DoorLock_Sta, system-signal=CAN1_BCM_DoorLock_Sta}, {implementation-record-element=CAN1_BCM_Buzzer_Req, system-signal=CAN1_BCM_Buzzer_Req}, {implementation-record-element=CAN1_AntitheftSta, system-signal=CAN1_AntitheftSta}, {implementation-record-element=CAN1_AntiTheftSeatFold, system-signal=CAN1_AntiTheftSeatFold}]}
      MAP_CAN1_FD_THCM1: sender-receiver-to-signal-group-mapping{communication-direction=OUT, data-element=SWC_FDC.root_FDC.P_CAN1_FD_THCM1.CAN1_SG_FD_THCM1, signal-group=CAN1_SG_FD_THCM1, type-mapping=sender-rec-record-type-mapping=record-element-mappings=[{implementation-record-element=CAN1_BatteryMode, system-signal=CAN1_BatteryMode}, {implementation-record-element=CAN1_sigWindDirZon3St, system-signal=CAN1_sigWindDirZon3St}, {implementation-record-element=CAN1_sigWindDirZon1St, system-signal=CAN1_sigWindDirZon1St}, {implementation-record-element=CAN1_sigSetTempZon3St, system-signal=CAN1_sigSetTempZon3St}, {implementation-record-element=CAN1_sigSetTempZon2St, system-signal=CAN1_sigSetTempZon2St}, {implementation-record-element=CAN1_sigSetTempZon1St, system-signal=CAN1_sigSetTempZon1St}, {implementation-record-element=CAN1_sigRecircSt, system-signal=CAN1_sigRecircSt}, {implementation-record-element=CAN1_sigHvacSt, system-signal=CAN1_sigHvacSt}, {implementation-record-element=CAN1_sigDfrstSt, system-signal=CAN1_sigDfrstSt}, {implementation-record-element=CAN1_sigClntTHvBattOut, system-signal=CAN1_sigClntTHvBattOut}, {implementation-record-element=CAN1_sigClmtCmprPwrAct, system-signal=CAN1_sigClmtCmprPwrAct}, {implementation-record-element=CAN1_sigCbnSolarRight, system-signal=CAN1_sigCbnSolarRight}, {implementation-record-element=CAN1_sigCbnSolarLeft, system-signal=CAN1_sigCbnSolarLeft}, {implementation-record-element=CAN1_sigCbnPTCPwrAct, system-signal=CAN1_sigCbnPTCPwrAct}, {implementation-record-element=CAN1_sigCbnAirT, system-signal=CAN1_sigCbnAirT}, {implementation-record-element=CAN1_sigAmbAirT, system-signal=CAN1_sigAmbAirT}, {implementation-record-element=CAN1_sigAirIntenZon3St, system-signal=CAN1_sigAirIntenZon3St}, {implementation-record-element=CAN1_sigAirIntenZon1St, system-signal=CAN1_sigAirIntenZon1St}, {implementation-record-element=CAN1_Rr_Coolanttemp, system-signal=CAN1_Rr_Coolanttemp}, {implementation-record-element=CAN1_Rr_Coolantflow, system-signal=CAN1_Rr_Coolantflow}, {implementation-record-element=CAN1_HPThermalRecoveryReq, system-signal=CAN1_HPThermalRecoveryReq}, {implementation-record-element=CAN1_Fr_Coolanttemp, system-signal=CAN1_Fr_Coolanttemp}, {implementation-record-element=CAN1_Fr_Coolantflow, system-signal=CAN1_Fr_Coolantflow}, {implementation-record-element=CAN1_FD_RecyAuto_Cmd, system-signal=CAN1_FD_RecyAuto_Cmd}, {implementation-record-element=CAN1_FD_AGS_Cmd, system-signal=CAN1_FD_AGS_Cmd}, {implementation-record-element=CAN1_EDriveMode, system-signal=CAN1_EDriveMode}, {implementation-record-element=CAN1_CabinMode, system-signal=CAN1_CabinMode}, {implementation-record-element=CAN1_CCU_SyncLampSts, system-signal=CAN1_CCU_SyncLampSts}, {implementation-record-element=CAN1_CCU_RrOnOffLampSts, system-signal=CAN1_CCU_RrOnOffLampSts}, {implementation-record-element=CAN1_CCU_HEATMaxLampSts, system-signal=CAN1_CCU_HEATMaxLampSts}, {implementation-record-element=CAN1_CCU_FrtOnOffLampSts, system-signal=CAN1_CCU_FrtOnOffLampSts}, {implementation-record-element=CAN1_CCU_EcoSts, system-signal=CAN1_CCU_EcoSts}, {implementation-record-element=CAN1_CCU_Dispaly_Request, system-signal=CAN1_CCU_Dispaly_Request}, {implementation-record-element=CAN1_CCU_AutoMidLampSts, system-signal=CAN1_CCU_AutoMidLampSts}, {implementation-record-element=CAN1_CCU_AutoLampSts, system-signal=CAN1_CCU_AutoLampSts}, {implementation-record-element=CAN1_CCU_ACMaxLampSts, system-signal=CAN1_CCU_ACMaxLampSts}, {implementation-record-element=CAN1_CCU_ACLampSts, system-signal=CAN1_CCU_ACLampSts}]}
      MAP_CAN1_FD_VCU1: sender-receiver-to-signal-group-mapping{communication-direction=OUT, data-element=SWC_FDC.root_FDC.P_CAN1_FD_VCU1.CAN1_SG_FD_VCU1, signal-group=CAN1_SG_FD_VCU1, type-mapping=sender-rec-record-type-mapping=record-element-mappings=[{implementation-record-element=CAN1_CC_Crl_Sta, system-signal=CAN1_CC_Crl_Sta}, {implementation-record-element=CAN1_XWDMode, system-signal=CAN1_XWDMode}, {implementation-record-element=CAN1_ShiftGearPosn, system-signal=CAN1_ShiftGearPosn}, {implementation-record-element=CAN1_PwrSta, system-signal=CAN1_PwrSta}, {implementation-record-element=CAN1_PrkReqValid, system-signal=CAN1_PrkReqValid}, {implementation-record-element=CAN1_PrkReq, system-signal=CAN1_PrkReq}, {implementation-record-element=CAN1_P_Button_Sta, system-signal=CAN1_P_Button_Sta}, {implementation-record-element=CAN1_MSA_Crl_Sta, system-signal=CAN1_MSA_Crl_Sta}, {implementation-record-element=CAN1_LVPwrSta, system-signal=CAN1_LVPwrSta}, {implementation-record-element=CAN1_HVPwrSta, system-signal=CAN1_HVPwrSta}]}
      MAP_CAN1_FD_VCU2: sender-receiver-to-signal-group-mapping{communication-direction=OUT, data-element=SWC_FDC.root_FDC.P_CAN1_FD_VCU2.CAN1_SG_FD_VCU2, signal-group=CAN1_SG_FD_VCU2, type-mapping=sender-rec-record-type-mapping=record-element-mappings=[{implementation-record-element=CAN1_ACC_CtrlAvail, system-signal=CAN1_ACC_CtrlAvail}, {implementation-record-element=CAN1_VehActPwr, system-signal=CAN1_VehActPwr}, {implementation-record-element=CAN1_Rr_DriverTq, system-signal=CAN1_Rr_DriverTq}, {implementation-record-element=CAN1_RC_VCU2_CAN1, system-signal=CAN1_RC_VCU2_CAN1}, {implementation-record-element=CAN1_Fr_DriverTq, system-signal=CAN1_Fr_DriverTq}, {implementation-record-element=CAN1_DriverTq, system-signal=CAN1_DriverTq}, {implementation-record-element=CAN1_CS_VCU2_CAN1, system-signal=CAN1_CS_VCU2_CAN1}, {implementation-record-element=CAN1_ActAPSPosn, system-signal=CAN1_ActAPSPosn}, {implementation-record-element=CAN1_AccPedal_Override, system-signal=CAN1_AccPedal_Override}]}
      MAP_CAN1_FD_VCU3: sender-receiver-to-signal-group-mapping{communication-direction=OUT, data-element=SWC_FDC.root_FDC.P_CAN1_FD_VCU3.CAN1_SG_FD_VCU3, signal-group=CAN1_SG_FD_VCU3, type-mapping=sender-rec-record-type-mapping=record-element-mappings=[{implementation-record-element=CAN1_CS_VCU3_CAN1, system-signal=CAN1_CS_VCU3_CAN1}, {implementation-record-element=CAN1_Rr_RgnPermSta, system-signal=CAN1_Rr_RgnPermSta}, {implementation-record-element=CAN1_Rr_RgnDecrSta, system-signal=CAN1_Rr_RgnDecrSta}, {implementation-record-element=CAN1_Rr_EDUSpdValid, system-signal=CAN1_Rr_EDUSpdValid}, {implementation-record-element=CAN1_Rr_EDUSpd, system-signal=CAN1_Rr_EDUSpd}, {implementation-record-element=CAN1_Rr_EDURealDrvOrBRgnTq, system-signal=CAN1_Rr_EDURealDrvOrBRgnTq}, {implementation-record-element=CAN1_Rr_EDURealARgnTq, system-signal=CAN1_Rr_EDURealARgnTq}, {implementation-record-element=CAN1_Rr_EDUAvailBrkRgnTqValid, system-signal=CAN1_Rr_EDUAvailBrkRgnTqValid}, {implementation-record-element=CAN1_Rr_EDUAvailBrkRgnTq, system-signal=CAN1_Rr_EDUAvailBrkRgnTq}, {implementation-record-element=CAN1_RgnAbnorSta, system-signal=CAN1_RgnAbnorSta}, {implementation-record-element=CAN1_RC_VCU3_CAN1, system-signal=CAN1_RC_VCU3_CAN1}, {implementation-record-element=CAN1_PTCS_PermSta, system-signal=CAN1_PTCS_PermSta}, {implementation-record-element=CAN1_Fr_RgnPermSta, system-signal=CAN1_Fr_RgnPermSta}, {implementation-record-element=CAN1_Fr_RgnDecrSta, system-signal=CAN1_Fr_RgnDecrSta}, {implementation-record-element=CAN1_Fr_EDUSpdValid, system-signal=CAN1_Fr_EDUSpdValid}, {implementation-record-element=CAN1_Fr_EDUSpd, system-signal=CAN1_Fr_EDUSpd}, {implementation-record-element=CAN1_Fr_EDURealDrvOrBRgnTq, system-signal=CAN1_Fr_EDURealDrvOrBRgnTq}, {implementation-record-element=CAN1_Fr_EDURealARgnTq, system-signal=CAN1_Fr_EDURealARgnTq}, {implementation-record-element=CAN1_Fr_EDUAvailBrkRgnTqValid, system-signal=CAN1_Fr_EDUAvailBrkRgnTqValid}, {implementation-record-element=CAN1_Fr_EDUAvailBrkRgnTq, system-signal=CAN1_Fr_EDUAvailBrkRgnTq}, {implementation-record-element=CAN1_EquivAccPedalSWSta, system-signal=CAN1_EquivAccPedalSWSta}]}
      MAP_CAN1_FD_VCU4: sender-receiver-to-signal-group-mapping{communication-direction=OUT, data-element=SWC_FDC.root_FDC.P_CAN1_FD_VCU4.CAN1_SG_FD_VCU4, signal-group=CAN1_SG_FD_VCU4, type-mapping=sender-rec-record-type-mapping=record-element-mappings=[{implementation-record-element=CAN1_Eng_AGSCloseSta, system-signal=CAN1_Eng_AGSCloseSta}, {implementation-record-element=CAN1_VehMalfunLevel, system-signal=CAN1_VehMalfunLevel}, {implementation-record-element=CAN1_Eng_PwrLockSta, system-signal=CAN1_Eng_PwrLockSta}, {implementation-record-element=CAN1_Eng_CoastDwSta, system-signal=CAN1_Eng_CoastDwSta}, {implementation-record-element=CAN1_Eng_ActvDmpDisabSta, system-signal=CAN1_Eng_ActvDmpDisabSta}]}
      MAP_CAN1_SRR1: sender-receiver-to-signal-group-mapping{communication-direction=IN, data-element=SWC_FDC.root_FDC.R_CAN1_SRR1.CAN1_SG_SRR1, signal-group=CAN1_SG_SRR1, type-mapping=sender-rec-record-type-mapping=record-element-mappings=[{implementation-record-element=CAN1_SRR1_Chksum, system-signal=CAN1_SRR1_Chksum}, {implementation-record-element=CAN1_SRR_RCTA_WarnR, system-signal=CAN1_SRR_RCTA_WarnR}, {implementation-record-element=CAN1_SRR_RCTA_WarnL, system-signal=CAN1_SRR_RCTA_WarnL}, {implementation-record-element=CAN1_SRR_RCTA_Sta, system-signal=CAN1_SRR_RCTA_Sta}, {implementation-record-element=CAN1_SRR_ODA_WarnR, system-signal=CAN1_SRR_ODA_WarnR}, {implementation-record-element=CAN1_SRR_ODA_WarnL, system-signal=CAN1_SRR_ODA_WarnL}, {implementation-record-element=CAN1_SRR_ODA_Sta, system-signal=CAN1_SRR_ODA_Sta}, {implementation-record-element=CAN1_SRR_ODA_SoundR, system-signal=CAN1_SRR_ODA_SoundR}, {implementation-record-element=CAN1_SRR_ODA_SoundL, system-signal=CAN1_SRR_ODA_SoundL}, {implementation-record-element=CAN1_SRR_ODA_Mute, system-signal=CAN1_SRR_ODA_Mute}, {implementation-record-element=CAN1_SRR_FltWrnReq, system-signal=CAN1_SRR_FltWrnReq}, {implementation-record-element=CAN1_SRR_BSD_WarnR, system-signal=CAN1_SRR_BSD_WarnR}, {implementation-record-element=CAN1_SRR_BSD_WarnL, system-signal=CAN1_SRR_BSD_WarnL}, {implementation-record-element=CAN1_SRR_BSD_Sta, system-signal=CAN1_SRR_BSD_Sta}, {implementation-record-element=CAN1_SRR_BSD_SoundR, system-signal=CAN1_SRR_BSD_SoundR}, {implementation-record-element=CAN1_SRR_BSD_SoundL, system-signal=CAN1_SRR_BSD_SoundL}, {implementation-record-element=CAN1_SRR_BSD_Mute, system-signal=CAN1_SRR_BSD_Mute}, {implementation-record-element=CAN1_SRR1_LifeCount, system-signal=CAN1_SRR1_LifeCount}]}
      MAP_CAN2_FD_APS1: sender-receiver-to-signal-group-mapping{communication-direction=OUT, data-element=SWC_FDC.root_FDC.P_CAN2_FD_APS1.CAN2_SG_FD_APS1, signal-group=CAN2_SG_FD_APS1, type-mapping=sender-rec-record-type-mapping=record-element-mappings=[{implementation-record-element=CAN2_APS_Angle_Target, system-signal=CAN2_APS_Angle_Target}, {implementation-record-element=CAN2_APS_V_Rq_EPAS_Ctrl, system-signal=CAN2_APS_V_Rq_EPAS_Ctrl}, {implementation-record-element=CAN2_APS_Sta_System, system-signal=CAN2_APS_Sta_System}, {implementation-record-element=CAN2_APS_Rq_EPAS_Ctrl, system-signal=CAN2_APS_Rq_EPAS_Ctrl}]}
      MAP_CAN2_FD_APS2: sender-receiver-to-signal-group-mapping{communication-direction=OUT, data-element=SWC_FDC.root_FDC.P_CAN2_FD_APS2.CAN2_SG_FD_APS2, signal-group=CAN2_SG_FD_APS2, type-mapping=sender-rec-record-type-mapping=record-element-mappings=[{implementation-record-element=CAN2_APS_D_FLL, system-signal=CAN2_APS_D_FLL}, {implementation-record-element=CAN2_USS_Sta_RMR, system-signal=CAN2_USS_Sta_RMR}, {implementation-record-element=CAN2_USS_Sta_RML, system-signal=CAN2_USS_Sta_RML}, {implementation-record-element=CAN2_USS_Sta_RLR, system-signal=CAN2_USS_Sta_RLR}, {implementation-record-element=CAN2_USS_Sta_RLL, system-signal=CAN2_USS_Sta_RLL}, {implementation-record-element=CAN2_USS_Sta_RCR, system-signal=CAN2_USS_Sta_RCR}, {implementation-record-element=CAN2_USS_Sta_RCL, system-signal=CAN2_USS_Sta_RCL}, {implementation-record-element=CAN2_USS_Sta_FMR, system-signal=CAN2_USS_Sta_FMR}, {implementation-record-element=CAN2_USS_Sta_FML, system-signal=CAN2_USS_Sta_FML}, {implementation-record-element=CAN2_USS_Sta_FLR, system-signal=CAN2_USS_Sta_FLR}, {implementation-record-element=CAN2_USS_Sta_FLL, system-signal=CAN2_USS_Sta_FLL}, {implementation-record-element=CAN2_USS_Sta_FCR, system-signal=CAN2_USS_Sta_FCR}, {implementation-record-element=CAN2_USS_Sta_FCL, system-signal=CAN2_USS_Sta_FCL}, {implementation-record-element=CAN2_PAS_Sta_F_Sys, system-signal=CAN2_PAS_Sta_F_Sys}, {implementation-record-element=CAN2_PAS_SNSR_Layout, system-signal=CAN2_PAS_SNSR_Layout}, {implementation-record-element=CAN2_PAS_Mod_Operation, system-signal=CAN2_PAS_Mod_Operation}, {implementation-record-element=CAN2_PAS_D_RMR, system-signal=CAN2_PAS_D_RMR}, {implementation-record-element=CAN2_PAS_D_RML, system-signal=CAN2_PAS_D_RML}, {implementation-record-element=CAN2_PAS_D_RCR, system-signal=CAN2_PAS_D_RCR}, {implementation-record-element=CAN2_PAS_D_RCL, system-signal=CAN2_PAS_D_RCL}, {implementation-record-element=CAN2_PAS_D_FMR, system-signal=CAN2_PAS_D_FMR}, {implementation-record-element=CAN2_PAS_D_FML, system-signal=CAN2_PAS_D_FML}, {implementation-record-element=CAN2_PAS_D_FCR, system-signal=CAN2_PAS_D_FCR}, {implementation-record-element=CAN2_PAS_D_FCL, system-signal=CAN2_PAS_D_FCL}, {implementation-record-element=CAN2_PAS_Chime, system-signal=CAN2_PAS_Chime}, {implementation-record-element=CAN2_PAS_A_RMR, system-signal=CAN2_PAS_A_RMR}, {implementation-record-element=CAN2_PAS_A_RML, system-signal=CAN2_PAS_A_RML}, {implementation-record-element=CAN2_PAS_A_RCR, system-signal=CAN2_PAS_A_RCR}, {implementation-record-element=CAN2_PAS_A_RCL, system-signal=CAN2_PAS_A_RCL}, {implementation-record-element=CAN2_PAS_A_FMR, system-signal=CAN2_PAS_A_FMR}, {implementation-record-element=CAN2_PAS_A_FML, system-signal=CAN2_PAS_A_FML}, {implementation-record-element=CAN2_PAS_A_FCR, system-signal=CAN2_PAS_A_FCR}, {implementation-record-element=CAN2_PAS_A_FCL, system-signal=CAN2_PAS_A_FCL}, {implementation-record-element=CAN2_FDC_VCU_SmartEco_Sta, system-signal=CAN2_FDC_VCU_SmartEco_Sta}, {implementation-record-element=CAN2_FDC_VCU_SmartEcoSpdLim_Sta, system-signal=CAN2_FDC_VCU_SmartEcoSpdLim_Sta}, {implementation-record-element=CAN2_FDC_VCU_RegenLimInd_Sta, system-signal=CAN2_FDC_VCU_RegenLimInd_Sta}, {implementation-record-element=CAN2_APS_SW_Ver, system-signal=CAN2_APS_SW_Ver}, {implementation-record-element=CAN2_APS_RQ_Display, system-signal=CAN2_APS_RQ_Display}, {implementation-record-element=CAN2_APS_Progress_PCT, system-signal=CAN2_APS_Progress_PCT}, {implementation-record-element=CAN2_APS_HW_Ver, system-signal=CAN2_APS_HW_Ver}, {implementation-record-element=CAN2_APS_ExitCondition, system-signal=CAN2_APS_ExitCondition}, {implementation-record-element=CAN2_APS_D_RLR, system-signal=CAN2_APS_D_RLR}, {implementation-record-element=CAN2_APS_D_RLL, system-signal=CAN2_APS_D_RLL}, {implementation-record-element=CAN2_APS_D_FLR, system-signal=CAN2_APS_D_FLR}]}
      MAP_CAN2_FD_APS3: sender-receiver-to-signal-group-mapping{communication-direction=OUT, data-element=SWC_FDC.root_FDC.P_CAN2_FD_APS3.CAN2_SG_FD_APS3, signal-group=CAN2_SG_FD_APS3, type-mapping=sender-rec-record-type-mapping=record-element-mappings=[{implementation-record-element=CAN2_APS3_LifeCount, system-signal=CAN2_APS3_LifeCount}, {implementation-record-element=CAN2_SPTG_Sta, system-signal=CAN2_SPTG_Sta}, {implementation-record-element=CAN2_SPTGDet, system-signal=CAN2_SPTGDet}, {implementation-record-element=CAN2_CAAS_Sta, system-signal=CAN2_CAAS_Sta}, {implementation-record-element=CAN2_APS_Req, system-signal=CAN2_APS_Req}, {implementation-record-element=CAN2_APS_DecReq_A, system-signal=CAN2_APS_DecReq_A}, {implementation-record-element=CAN2_APS_DecReq, system-signal=CAN2_APS_DecReq}, {implementation-record-element=CAN2_APSOpenPTG, system-signal=CAN2_APSOpenPTG}, {implementation-record-element=CAN2_APS3_checksum, system-signal=CAN2_APS3_checksum}]}
      MAP_CAN2_FD_BCM1: sender-receiver-to-signal-group-mapping{communication-direction=OUT, data-element=SWC_FDC.root_FDC.P_CAN2_FD_BCM1.CAN2_SG_FD_BCM1, signal-group=CAN2_SG_FD_BCM1, type-mapping=sender-rec-record-type-mapping=record-element-mappings=[{implementation-record-element=CAN2_APMDoorControlSta, system-signal=CAN2_APMDoorControlSta}, {implementation-record-element=CAN2_WiperFixMode, system-signal=CAN2_WiperFixMode}, {implementation-record-element=CAN2_WasherCtrl, system-signal=CAN2_WasherCtrl}, {implementation-record-element=CAN2_TrunkRel, system-signal=CAN2_TrunkRel}, {implementation-record-element=CAN2_Tailgate_SW, system-signal=CAN2_Tailgate_SW}, {implementation-record-element=CAN2_TailgateRemote, system-signal=CAN2_TailgateRemote}, {implementation-record-element=CAN2_TailgateHDSW, system-signal=CAN2_TailgateHDSW}, {implementation-record-element=CAN2_Rr_Wiper, system-signal=CAN2_Rr_Wiper}, {implementation-record-element=CAN2_Rr_FogLamp, system-signal=CAN2_Rr_FogLamp}, {implementation-record-element=CAN2_Rr_Defog, system-signal=CAN2_Rr_Defog}, {implementation-record-element=CAN2_Rr_ChargingDoorCtrl, system-signal=CAN2_Rr_ChargingDoorCtrl}, {implementation-record-element=CAN2_RoomLampL, system-signal=CAN2_RoomLampL}, {implementation-record-element=CAN2_RoomLampH, system-signal=CAN2_RoomLampH}, {implementation-record-element=CAN2_ReverseLamp, system-signal=CAN2_ReverseLamp}, {implementation-record-element=CAN2_RTurnLP, system-signal=CAN2_RTurnLP}, {implementation-record-element=CAN2_RRDoorSW, system-signal=CAN2_RRDoorSW}, {implementation-record-element=CAN2_RLDoorSW, system-signal=CAN2_RLDoorSW}, {implementation-record-element=CAN2_RDRL, system-signal=CAN2_RDRL}, {implementation-record-element=CAN2_RBSD, system-signal=CAN2_RBSD}, {implementation-record-element=CAN2_PsDoorSW, system-signal=CAN2_PsDoorSW}, {implementation-record-element=CAN2_PosLamp, system-signal=CAN2_PosLamp}, {implementation-record-element=CAN2_MirrorDefog, system-signal=CAN2_MirrorDefog}, {implementation-record-element=CAN2_MirrorCtrl, system-signal=CAN2_MirrorCtrl}, {implementation-record-element=CAN2_LockSetting, system-signal=CAN2_LockSetting}, {implementation-record-element=CAN2_L_Beam, system-signal=CAN2_L_Beam}, {implementation-record-element=CAN2_L_APM_WdwEnable, system-signal=CAN2_L_APM_WdwEnable}, {implementation-record-element=CAN2_LTurnLP, system-signal=CAN2_LTurnLP}, {implementation-record-element=CAN2_LDRL, system-signal=CAN2_LDRL}, {implementation-record-element=CAN2_LBSD, system-signal=CAN2_LBSD}, {implementation-record-element=CAN2_HornCtrl, system-signal=CAN2_HornCtrl}, {implementation-record-element=CAN2_HoodSW, system-signal=CAN2_HoodSW}, {implementation-record-element=CAN2_HazardSW, system-signal=CAN2_HazardSW}, {implementation-record-element=CAN2_H_Beam, system-signal=CAN2_H_Beam}, {implementation-record-element=CAN2_Fr_Wiper_L, system-signal=CAN2_Fr_Wiper_L}, {implementation-record-element=CAN2_Fr_Wiper_H, system-signal=CAN2_Fr_Wiper_H}, {implementation-record-element=CAN2_Fr_FogLamp, system-signal=CAN2_Fr_FogLamp}, {implementation-record-element=CAN2_Fr_ChargingDoorCtrl, system-signal=CAN2_Fr_ChargingDoorCtrl}, {implementation-record-element=CAN2_FollowMe, system-signal=CAN2_FollowMe}, {implementation-record-element=CAN2_FDC_THCM_APTCWarning_Sta, system-signal=CAN2_FDC_THCM_APTCWarning_Sta}, {implementation-record-element=CAN2_FDC_BCM_LockAlarm_Cmd, system-signal=CAN2_FDC_BCM_LockAlarm_Cmd}, {implementation-record-element=CAN2_DrDoorSW, system-signal=CAN2_DrDoorSW}, {implementation-record-element=CAN2_DoorLockIND, system-signal=CAN2_DoorLockIND}, {implementation-record-element=CAN2_DimmerEN, system-signal=CAN2_DimmerEN}, {implementation-record-element=CAN2_Dimmer, system-signal=CAN2_Dimmer}, {implementation-record-element=CAN2_CrashDetd, system-signal=CAN2_CrashDetd}, {implementation-record-element=CAN2_CTDUnlockSW, system-signal=CAN2_CTDUnlockSW}, {implementation-record-element=CAN2_CTDLockSW, system-signal=CAN2_CTDLockSW}, {implementation-record-element=CAN2_CTDCtrl, system-signal=CAN2_CTDCtrl}, {implementation-record-element=CAN2_BrakeLamp, system-signal=CAN2_BrakeLamp}, {implementation-record-element=CAN2_BCM_DoorLock_Sta, system-signal=CAN2_BCM_DoorLock_Sta}, {implementation-record-element=CAN2_BCM_Buzzer_Req, system-signal=CAN2_BCM_Buzzer_Req}, {implementation-record-element=CAN2_AntitheftSta, system-signal=CAN2_AntitheftSta}, {implementation-record-element=CAN2_AntiTheftSeatFold, system-signal=CAN2_AntiTheftSeatFold}, {implementation-record-element=CAN2_AllDoorSW, system-signal=CAN2_AllDoorSW}]}
      MAP_CAN2_FD_BCM2: sender-receiver-to-signal-group-mapping{communication-direction=OUT, data-element=SWC_FDC.root_FDC.P_CAN2_FD_BCM2.CAN2_SG_FD_BCM2, signal-group=CAN2_SG_FD_BCM2, type-mapping=sender-rec-record-type-mapping=record-element-mappings=[{implementation-record-element=CAN2_AmbLightBreath1, system-signal=CAN2_AmbLightBreath1}, {implementation-record-element=CAN2_User6IPAmbLightBrightness, system-signal=CAN2_User6IPAmbLightBrightness}, {implementation-record-element=CAN2_User6DrAmbLightBrightness, system-signal=CAN2_User6DrAmbLightBrightness}, {implementation-record-element=CAN2_User6AmbLightColor, system-signal=CAN2_User6AmbLightColor}, {implementation-record-element=CAN2_User5IPAmbLightBrightness, system-signal=CAN2_User5IPAmbLightBrightness}, {implementation-record-element=CAN2_User5DrAmbLightBrightness, system-signal=CAN2_User5DrAmbLightBrightness}, {implementation-record-element=CAN2_User5AmbLightColor, system-signal=CAN2_User5AmbLightColor}, {implementation-record-element=CAN2_User4IPAmbLightBrightness, system-signal=CAN2_User4IPAmbLightBrightness}, {implementation-record-element=CAN2_User4DrAmbLightBrightness, system-signal=CAN2_User4DrAmbLightBrightness}, {implementation-record-element=CAN2_User4AmbLightColor, system-signal=CAN2_User4AmbLightColor}, {implementation-record-element=CAN2_User3IPAmbLightBrightness, system-signal=CAN2_User3IPAmbLightBrightness}, {implementation-record-element=CAN2_User3DrAmbLightBrightness, system-signal=CAN2_User3DrAmbLightBrightness}, {implementation-record-element=CAN2_User3AmbLightColor, system-signal=CAN2_User3AmbLightColor}, {implementation-record-element=CAN2_User2IPAmbLightBrightness, system-signal=CAN2_User2IPAmbLightBrightness}, {implementation-record-element=CAN2_User2DrAmbLightBrightness, system-signal=CAN2_User2DrAmbLightBrightness}, {implementation-record-element=CAN2_User2AmbLightColor, system-signal=CAN2_User2AmbLightColor}, {implementation-record-element=CAN2_User1IPAmbLightBrightness, system-signal=CAN2_User1IPAmbLightBrightness}, {implementation-record-element=CAN2_User1DrAmbLightBrightness, system-signal=CAN2_User1DrAmbLightBrightness}, {implementation-record-element=CAN2_User1AmbLightColor, system-signal=CAN2_User1AmbLightColor}, {implementation-record-element=CAN2_LampPwr, system-signal=CAN2_LampPwr}, {implementation-record-element=CAN2_AmbLightColor3, system-signal=CAN2_AmbLightColor3}, {implementation-record-element=CAN2_AmbLightColor2, system-signal=CAN2_AmbLightColor2}, {implementation-record-element=CAN2_AmbLightColor1, system-signal=CAN2_AmbLightColor1}, {implementation-record-element=CAN2_AmbLightBrightness3, system-signal=CAN2_AmbLightBrightness3}, {implementation-record-element=CAN2_AmbLightBrightness2, system-signal=CAN2_AmbLightBrightness2}, {implementation-record-element=CAN2_AmbLightBrightness1, system-signal=CAN2_AmbLightBrightness1}, {implementation-record-element=CAN2_AmbLightBreath3, system-signal=CAN2_AmbLightBreath3}, {implementation-record-element=CAN2_AmbLightBreath2, system-signal=CAN2_AmbLightBreath2}]}
      MAP_CAN2_FD_OTA1: sender-receiver-to-signal-group-mapping{communication-direction=OUT, data-element=SWC_VES.root_FDC.P_CAN2_FD_OTA1.CAN2_SG_FD_OTA1, signal-group=CAN2_SG_FD_OTA1, type-mapping=sender-rec-record-type-mapping=record-element-mappings=[{implementation-record-element=CAN2_OTA_DL_Available, system-signal=CAN2_OTA_DL_Available}, {implementation-record-element=CAN2_OTA_Updating_ECU_8bit, system-signal=CAN2_OTA_Updating_ECU_8bit}, {implementation-record-element=CAN2_OTA_Updating_ECU, system-signal=CAN2_OTA_Updating_ECU}, {implementation-record-element=CAN2_OTA_Update_Available, system-signal=CAN2_OTA_Update_Available}, {implementation-record-element=CAN2_OTA_Up_Backcount, system-signal=CAN2_OTA_Up_Backcount}, {implementation-record-element=CAN2_OTA_TBOXResetReq, system-signal=CAN2_OTA_TBOXResetReq}, {implementation-record-element=CAN2_OTA_Remained_Time, system-signal=CAN2_OTA_Remained_Time}, {implementation-record-element=CAN2_OTA_Progress_Rate, system-signal=CAN2_OTA_Progress_Rate}, {implementation-record-element=CAN2_OTA_Permit_Agreed, system-signal=CAN2_OTA_Permit_Agreed}, {implementation-record-element=CAN2_OTA_Network_Type, system-signal=CAN2_OTA_Network_Type}, {implementation-record-element=CAN2_OTA_Mode, system-signal=CAN2_OTA_Mode}, {implementation-record-element=CAN2_OTA_MDA_Status, system-signal=CAN2_OTA_MDA_Status}, {implementation-record-element=CAN2_OTA_Lock_Req, system-signal=CAN2_OTA_Lock_Req}, {implementation-record-element=CAN2_OTA_InVehicle_FW, system-signal=CAN2_OTA_InVehicle_FW}, {implementation-record-element=CAN2_OTA_Debug_Code, system-signal=CAN2_OTA_Debug_Code}, {implementation-record-element=CAN2_OTA_DL_Speed, system-signal=CAN2_OTA_DL_Speed}]}
      MAP_CAN2_FD_THCM1: sender-receiver-to-signal-group-mapping{communication-direction=OUT, data-element=SWC_FDC.root_FDC.P_CAN2_FD_THCM1.CAN2_SG_FD_THCM1, signal-group=CAN2_SG_FD_THCM1, type-mapping=sender-rec-record-type-mapping=record-element-mappings=[{implementation-record-element=CAN2_BatteryMode, system-signal=CAN2_BatteryMode}, {implementation-record-element=CAN2_sigWindDirZon3St, system-signal=CAN2_sigWindDirZon3St}, {implementation-record-element=CAN2_sigWindDirZon1St, system-signal=CAN2_sigWindDirZon1St}, {implementation-record-element=CAN2_sigSetTempZon3St, system-signal=CAN2_sigSetTempZon3St}, {implementation-record-element=CAN2_sigSetTempZon2St, system-signal=CAN2_sigSetTempZon2St}, {implementation-record-element=CAN2_sigSetTempZon1St, system-signal=CAN2_sigSetTempZon1St}, {implementation-record-element=CAN2_sigRecircSt, system-signal=CAN2_sigRecircSt}, {implementation-record-element=CAN2_sigHvacSt, system-signal=CAN2_sigHvacSt}, {implementation-record-element=CAN2_sigDfrstSt, system-signal=CAN2_sigDfrstSt}, {implementation-record-element=CAN2_sigClntTHvBattOut, system-signal=CAN2_sigClntTHvBattOut}, {implementation-record-element=CAN2_sigClmtCmprPwrAct, system-signal=CAN2_sigClmtCmprPwrAct}, {implementation-record-element=CAN2_sigCbnSolarRight, system-signal=CAN2_sigCbnSolarRight}, {implementation-record-element=CAN2_sigCbnSolarLeft, system-signal=CAN2_sigCbnSolarLeft}, {implementation-record-element=CAN2_sigCbnPTCPwrAct, system-signal=CAN2_sigCbnPTCPwrAct}, {implementation-record-element=CAN2_sigCbnAirT, system-signal=CAN2_sigCbnAirT}, {implementation-record-element=CAN2_sigAmbAirT, system-signal=CAN2_sigAmbAirT}, {implementation-record-element=CAN2_sigAirIntenZon3St, system-signal=CAN2_sigAirIntenZon3St}, {implementation-record-element=CAN2_sigAirIntenZon1St, system-signal=CAN2_sigAirIntenZon1St}, {implementation-record-element=CAN2_Rr_Coolanttemp, system-signal=CAN2_Rr_Coolanttemp}, {implementation-record-element=CAN2_Rr_Coolantflow, system-signal=CAN2_Rr_Coolantflow}, {implementation-record-element=CAN2_HPThermalRecoveryReq, system-signal=CAN2_HPThermalRecoveryReq}, {implementation-record-element=CAN2_Fr_Coolanttemp, system-signal=CAN2_Fr_Coolanttemp}, {implementation-record-element=CAN2_Fr_Coolantflow, system-signal=CAN2_Fr_Coolantflow}, {implementation-record-element=CAN2_FD_RecyAuto_Cmd, system-signal=CAN2_FD_RecyAuto_Cmd}, {implementation-record-element=CAN2_FD_AGS_Cmd, system-signal=CAN2_FD_AGS_Cmd}, {implementation-record-element=CAN2_EDriveMode, system-signal=CAN2_EDriveMode}, {implementation-record-element=CAN2_CabinMode, system-signal=CAN2_CabinMode}, {implementation-record-element=CAN2_CCU_SyncLampSts, system-signal=CAN2_CCU_SyncLampSts}, {implementation-record-element=CAN2_CCU_RrOnOffLampSts, system-signal=CAN2_CCU_RrOnOffLampSts}, {implementation-record-element=CAN2_CCU_HEATMaxLampSts, system-signal=CAN2_CCU_HEATMaxLampSts}, {implementation-record-element=CAN2_CCU_FrtOnOffLampSts, system-signal=CAN2_CCU_FrtOnOffLampSts}, {implementation-record-element=CAN2_CCU_EcoSts, system-signal=CAN2_CCU_EcoSts}, {implementation-record-element=CAN2_CCU_Dispaly_Request, system-signal=CAN2_CCU_Dispaly_Request}, {implementation-record-element=CAN2_CCU_AutoMidLampSts, system-signal=CAN2_CCU_AutoMidLampSts}, {implementation-record-element=CAN2_CCU_AutoLampSts, system-signal=CAN2_CCU_AutoLampSts}, {implementation-record-element=CAN2_CCU_ACMaxLampSts, system-signal=CAN2_CCU_ACMaxLampSts}, {implementation-record-element=CAN2_CCU_ACLampSts, system-signal=CAN2_CCU_ACLampSts}]}
      MAP_CAN2_FD_TPMS1: sender-receiver-to-signal-group-mapping{communication-direction=OUT, data-element=SWC_FDC.root_FDC.P_CAN2_FD_TPMS1.CAN2_SG_FD_TPMS1, signal-group=CAN2_SG_FD_TPMS1, type-mapping=sender-rec-record-type-mapping=record-element-mappings=[{implementation-record-element=CAN2_AutoLTips, system-signal=CAN2_AutoLTips}, {implementation-record-element=CAN2_TPMS_Res_Butt_Allow, system-signal=CAN2_TPMS_Res_Butt_Allow}, {implementation-record-element=CAN2_TPMS_Cali_Butt_Allow, system-signal=CAN2_TPMS_Cali_Butt_Allow}, {implementation-record-element=CAN2_TPMSWarnIndi, system-signal=CAN2_TPMSWarnIndi}, {implementation-record-element=CAN2_RRWheelTmpIndi, system-signal=CAN2_RRWheelTmpIndi}, {implementation-record-element=CAN2_RRWheelTemp, system-signal=CAN2_RRWheelTemp}, {implementation-record-element=CAN2_RRWheelPress, system-signal=CAN2_RRWheelPress}, {implementation-record-element=CAN2_RRWheelPSW, system-signal=CAN2_RRWheelPSW}, {implementation-record-element=CAN2_RRWheelDebug, system-signal=CAN2_RRWheelDebug}, {implementation-record-element=CAN2_RRSensorMode, system-signal=CAN2_RRSensorMode}, {implementation-record-element=CAN2_RRSensorFail, system-signal=CAN2_RRSensorFail}, {implementation-record-element=CAN2_RRPressIndi, system-signal=CAN2_RRPressIndi}, {implementation-record-element=CAN2_RRBatWarn, system-signal=CAN2_RRBatWarn}, {implementation-record-element=CAN2_RFWheelTmpIndi, system-signal=CAN2_RFWheelTmpIndi}, {implementation-record-element=CAN2_RFWheelTemp, system-signal=CAN2_RFWheelTemp}, {implementation-record-element=CAN2_RFWheelPress, system-signal=CAN2_RFWheelPress}, {implementation-record-element=CAN2_RFWheelPSW, system-signal=CAN2_RFWheelPSW}, {implementation-record-element=CAN2_RFWheelDebug, system-signal=CAN2_RFWheelDebug}, {implementation-record-element=CAN2_RFSensorMode, system-signal=CAN2_RFSensorMode}, {implementation-record-element=CAN2_RFSensorFail, system-signal=CAN2_RFSensorFail}, {implementation-record-element=CAN2_RFPressIndi, system-signal=CAN2_RFPressIndi}, {implementation-record-element=CAN2_RFBatWarn, system-signal=CAN2_RFBatWarn}, {implementation-record-element=CAN2_LRWheelTmpIndi, system-signal=CAN2_LRWheelTmpIndi}, {implementation-record-element=CAN2_LRWheelTemp, system-signal=CAN2_LRWheelTemp}, {implementation-record-element=CAN2_LRWheelPress, system-signal=CAN2_LRWheelPress}, {implementation-record-element=CAN2_LRWheelPSW, system-signal=CAN2_LRWheelPSW}, {implementation-record-element=CAN2_LRWheelDebug, system-signal=CAN2_LRWheelDebug}, {implementation-record-element=CAN2_LRSensorMode, system-signal=CAN2_LRSensorMode}, {implementation-record-element=CAN2_LRSensorFail, system-signal=CAN2_LRSensorFail}, {implementation-record-element=CAN2_LRPressIndi, system-signal=CAN2_LRPressIndi}, {implementation-record-element=CAN2_LRBatWarn, system-signal=CAN2_LRBatWarn}, {implementation-record-element=CAN2_LFWheelTmpIndi, system-signal=CAN2_LFWheelTmpIndi}, {implementation-record-element=CAN2_LFWheelTemp, system-signal=CAN2_LFWheelTemp}, {implementation-record-element=CAN2_LFWheelPress, system-signal=CAN2_LFWheelPress}, {implementation-record-element=CAN2_LFWheelPSW, system-signal=CAN2_LFWheelPSW}, {implementation-record-element=CAN2_LFWheelDebug, system-signal=CAN2_LFWheelDebug}, {implementation-record-element=CAN2_LFSensorMode, system-signal=CAN2_LFSensorMode}, {implementation-record-element=CAN2_LFSensorFail, system-signal=CAN2_LFSensorFail}, {implementation-record-element=CAN2_LFPressIndi, system-signal=CAN2_LFPressIndi}, {implementation-record-element=CAN2_LFBatWarn, system-signal=CAN2_LFBatWarn}, {implementation-record-element=CAN2_CWheelTips, system-signal=CAN2_CWheelTips}]}
      MAP_CAN2_FD_TPMS2: sender-receiver-to-signal-group-mapping{communication-direction=OUT, data-element=SWC_FDC.root_FDC.P_CAN2_FD_TPMS2.CAN2_SG_FD_TPMS2, signal-group=CAN2_SG_FD_TPMS2, type-mapping=sender-rec-record-type-mapping=record-element-mappings=[{implementation-record-element=CAN2_ID1_ALTU, system-signal=CAN2_ID1_ALTU}, {implementation-record-element=CAN2_S4WheelDebug_ALTU, system-signal=CAN2_S4WheelDebug_ALTU}, {implementation-record-element=CAN2_S3WheelDebug_ALTU, system-signal=CAN2_S3WheelDebug_ALTU}, {implementation-record-element=CAN2_S2WheelDebug_ALTU, system-signal=CAN2_S2WheelDebug_ALTU}, {implementation-record-element=CAN2_S1WheelDebug_ALTU, system-signal=CAN2_S1WheelDebug_ALTU}, {implementation-record-element=CAN2_RF_FAT_ALTU, system-signal=CAN2_RF_FAT_ALTU}, {implementation-record-element=CAN2_IDin_ALTU, system-signal=CAN2_IDin_ALTU}, {implementation-record-element=CAN2_ID4_message_ALTU, system-signal=CAN2_ID4_message_ALTU}, {implementation-record-element=CAN2_ID4_Loc_ALTU, system-signal=CAN2_ID4_Loc_ALTU}, {implementation-record-element=CAN2_ID4_ALTU, system-signal=CAN2_ID4_ALTU}, {implementation-record-element=CAN2_ID3_message_ALTU, system-signal=CAN2_ID3_message_ALTU}, {implementation-record-element=CAN2_ID3_Loc_ALTU, system-signal=CAN2_ID3_Loc_ALTU}, {implementation-record-element=CAN2_ID3_ALTU, system-signal=CAN2_ID3_ALTU}, {implementation-record-element=CAN2_ID2_message_ALTU, system-signal=CAN2_ID2_message_ALTU}, {implementation-record-element=CAN2_ID2_Loc_ALTU, system-signal=CAN2_ID2_Loc_ALTU}, {implementation-record-element=CAN2_ID2_ALTU, system-signal=CAN2_ID2_ALTU}, {implementation-record-element=CAN2_ID1_message_ALTU, system-signal=CAN2_ID1_message_ALTU}, {implementation-record-element=CAN2_ID1_Loc_ALTU, system-signal=CAN2_ID1_Loc_ALTU}]}
      MAP_CAN2_FD_V2L1: sender-receiver-to-signal-group-mapping{communication-direction=OUT, data-element=SWC_FDC.root_FDC.P_CAN2_FD_V2L1.CAN2_SG_FD_V2L1, signal-group=CAN2_SG_FD_V2L1, type-mapping=sender-rec-record-type-mapping=record-element-mappings=[{implementation-record-element=CAN2_Req_OBCV2LEna, system-signal=CAN2_Req_OBCV2LEna}, {implementation-record-element=CAN2_Req_V2L_IVI_Popup, system-signal=CAN2_Req_V2L_IVI_Popup}, {implementation-record-element=CAN2_Req_V2LSwOn, system-signal=CAN2_Req_V2LSwOn}]}
      MAP_CAN2_FD_VCU0: sender-receiver-to-signal-group-mapping{communication-direction=OUT, data-element=SWC_FDC.root_FDC.P_CAN2_FD_VCU0.CAN2_SG_FD_VCU0, signal-group=CAN2_SG_FD_VCU0, type-mapping=sender-rec-record-type-mapping=record-element-mappings=[{implementation-record-element=CAN2_EVCCAplusPwrUpReq, system-signal=CAN2_EVCCAplusPwrUpReq}, {implementation-record-element=CAN2_VehHVPwrAvail4THCM, system-signal=CAN2_VehHVPwrAvail4THCM}, {implementation-record-element=CAN2_VCUTailgateSWSta, system-signal=CAN2_VCUTailgateSWSta}, {implementation-record-element=CAN2_VCURRDoorSta, system-signal=CAN2_VCURRDoorSta}, {implementation-record-element=CAN2_VCURLDoorSta, system-signal=CAN2_VCURLDoorSta}, {implementation-record-element=CAN2_VCUHoodSWSta, system-signal=CAN2_VCUHoodSWSta}, {implementation-record-element=CAN2_VCUFRDoorSta, system-signal=CAN2_VCUFRDoorSta}, {implementation-record-element=CAN2_VCUFLDoorSta, system-signal=CAN2_VCUFLDoorSta}, {implementation-record-element=CAN2_VCUBrkSWSta, system-signal=CAN2_VCUBrkSWSta}, {implementation-record-element=CAN2_TimerAllowSleep, system-signal=CAN2_TimerAllowSleep}, {implementation-record-element=CAN2_TCountSta, system-signal=CAN2_TCountSta}, {implementation-record-element=CAN2_SysPwrSta, system-signal=CAN2_SysPwrSta}, {implementation-record-element=CAN2_SysAllowReadySta, system-signal=CAN2_SysAllowReadySta}, {implementation-record-element=CAN2_SilentChkAllowSleep, system-signal=CAN2_SilentChkAllowSleep}, {implementation-record-element=CAN2_SchedChgTOSta, system-signal=CAN2_SchedChgTOSta}, {implementation-record-element=CAN2_Rr_TqSource, system-signal=CAN2_Rr_TqSource}, {implementation-record-element=CAN2_PwrUpReq, system-signal=CAN2_PwrUpReq}, {implementation-record-element=CAN2_PwrStaTOSta, system-signal=CAN2_PwrStaTOSta}, {implementation-record-element=CAN2_PwrStaSelect, system-signal=CAN2_PwrStaSelect}, {implementation-record-element=CAN2_PwrStaONTOIVIPopT, system-signal=CAN2_PwrStaONTOIVIPopT}, {implementation-record-element=CAN2_PwrStaONTOIVIPopReq, system-signal=CAN2_PwrStaONTOIVIPopReq}, {implementation-record-element=CAN2_PwrStaConstraint, system-signal=CAN2_PwrStaConstraint}, {implementation-record-element=CAN2_PwrDownReq, system-signal=CAN2_PwrDownReq}, {implementation-record-element=CAN2_PowerUpState, system-signal=CAN2_PowerUpState}, {implementation-record-element=CAN2_PowerUpFault, system-signal=CAN2_PowerUpFault}, {implementation-record-element=CAN2_PowerDownState, system-signal=CAN2_PowerDownState}, {implementation-record-element=CAN2_PowerDownFault, system-signal=CAN2_PowerDownFault}, {implementation-record-element=CAN2_PMMAllowECUSleep, system-signal=CAN2_PMMAllowECUSleep}, {implementation-record-element=CAN2_MCUActDisFail, system-signal=CAN2_MCUActDisFail}, {implementation-record-element=CAN2_LVSilentChrgSta, system-signal=CAN2_LVSilentChrgSta}, {implementation-record-element=CAN2_LVSilentChrgReq, system-signal=CAN2_LVSilentChrgReq}, {implementation-record-element=CAN2_LVSilentChrgLv, system-signal=CAN2_LVSilentChrgLv}, {implementation-record-element=CAN2_LVChrgHoldTAct, system-signal=CAN2_LVChrgHoldTAct}, {implementation-record-element=CAN2_LVBattVoltSta, system-signal=CAN2_LVBattVoltSta}, {implementation-record-element=CAN2_LVBattChrgtimeAct, system-signal=CAN2_LVBattChrgtimeAct}, {implementation-record-element=CAN2_HVTHCMSysAvail, system-signal=CAN2_HVTHCMSysAvail}, {implementation-record-element=CAN2_HVRlyOpFail, system-signal=CAN2_HVRlyOpFail}, {implementation-record-element=CAN2_Fr_TqSource, system-signal=CAN2_Fr_TqSource}, {implementation-record-element=CAN2_FDADC12VDetAvg, system-signal=CAN2_FDADC12VDetAvg}]}
      MAP_CAN2_FD_VCU1: sender-receiver-to-signal-group-mapping{communication-direction=OUT, data-element=SWC_FDC.root_FDC.P_CAN2_FD_VCU1.CAN2_SG_FD_VCU1, signal-group=CAN2_SG_FD_VCU1, type-mapping=sender-rec-record-type-mapping=record-element-mappings=[{implementation-record-element=CAN2_ActiveDischReq, system-signal=CAN2_ActiveDischReq}, {implementation-record-element=CAN2_XWDMode, system-signal=CAN2_XWDMode}, {implementation-record-element=CAN2_VCU_OPDHold, system-signal=CAN2_VCU_OPDHold}, {implementation-record-element=CAN2_ShiftGearPosn, system-signal=CAN2_ShiftGearPosn}, {implementation-record-element=CAN2_Rr_MCUEnaReq, system-signal=CAN2_Rr_MCUEnaReq}, {implementation-record-element=CAN2_Rr_ActvDmpDisabReq, system-signal=CAN2_Rr_ActvDmpDisabReq}, {implementation-record-element=CAN2_RC_VCU1_CAN2, system-signal=CAN2_RC_VCU1_CAN2}, {implementation-record-element=CAN2_PwrSta, system-signal=CAN2_PwrSta}, {implementation-record-element=CAN2_PrkReq, system-signal=CAN2_PrkReq}, {implementation-record-element=CAN2_MSA_Crl_Sta, system-signal=CAN2_MSA_Crl_Sta}, {implementation-record-element=CAN2_LVChrgFuncStaChk, system-signal=CAN2_LVChrgFuncStaChk}, {implementation-record-element=CAN2_HVSysReadyToCharge, system-signal=CAN2_HVSysReadyToCharge}, {implementation-record-element=CAN2_HVBatCnctReq, system-signal=CAN2_HVBatCnctReq}, {implementation-record-element=CAN2_Fr_MCUEnaReq, system-signal=CAN2_Fr_MCUEnaReq}, {implementation-record-element=CAN2_Fr_ActvDmpDisabReq, system-signal=CAN2_Fr_ActvDmpDisabReq}, {implementation-record-element=CAN2_FalseNPrevent_Sta, system-signal=CAN2_FalseNPrevent_Sta}, {implementation-record-element=CAN2_FDC_VCU_PwrSaveReq_Cmd, system-signal=CAN2_FDC_VCU_PwrSaveReq_Cmd}, {implementation-record-element=CAN2_EngageP_Fail, system-signal=CAN2_EngageP_Fail}, {implementation-record-element=CAN2_DynoModeStaChk, system-signal=CAN2_DynoModeStaChk}, {implementation-record-element=CAN2_Dr_SeatSta, system-signal=CAN2_Dr_SeatSta}, {implementation-record-element=CAN2_DisengageP_Fail, system-signal=CAN2_DisengageP_Fail}, {implementation-record-element=CAN2_DemoModeStaChk, system-signal=CAN2_DemoModeStaChk}, {implementation-record-element=CAN2_DCDCVoltSetpoint, system-signal=CAN2_DCDCVoltSetpoint}, {implementation-record-element=CAN2_DCDCEnaReq, system-signal=CAN2_DCDCEnaReq}, {implementation-record-element=CAN2_CreepSW_Sta, system-signal=CAN2_CreepSW_Sta}, {implementation-record-element=CAN2_CoastDwModeStaChk, system-signal=CAN2_CoastDwModeStaChk}, {implementation-record-element=CAN2_CS_VCU1_CAN2, system-signal=CAN2_CS_VCU1_CAN2}, {implementation-record-element=CAN2_CC_Crl_Sta, system-signal=CAN2_CC_Crl_Sta}]}
      MAP_CAN2_FD_VCU2: sender-receiver-to-signal-group-mapping{communication-direction=OUT, data-element=SWC_FDC.root_FDC.P_CAN2_FD_VCU2.CAN2_SG_FD_VCU2, signal-group=CAN2_SG_FD_VCU2, type-mapping=sender-rec-record-type-mapping=record-element-mappings=[{implementation-record-element=CAN2_ACC_CtrlAvail, system-signal=CAN2_ACC_CtrlAvail}, {implementation-record-element=CAN2_VehActPwr, system-signal=CAN2_VehActPwr}, {implementation-record-element=CAN2_Rr_DriverTq, system-signal=CAN2_Rr_DriverTq}, {implementation-record-element=CAN2_RC_VCU2_CAN1, system-signal=CAN2_RC_VCU2_CAN1}, {implementation-record-element=CAN2_Fr_DriverTq, system-signal=CAN2_Fr_DriverTq}, {implementation-record-element=CAN2_DriverTq, system-signal=CAN2_DriverTq}, {implementation-record-element=CAN2_CS_VCU2_CAN1, system-signal=CAN2_CS_VCU2_CAN1}, {implementation-record-element=CAN2_ActAPSPosn, system-signal=CAN2_ActAPSPosn}, {implementation-record-element=CAN2_AccPedal_Override, system-signal=CAN2_AccPedal_Override}]}
      MAP_CAN2_FD_VCU4: sender-receiver-to-signal-group-mapping{communication-direction=OUT, data-element=SWC_FDC.root_FDC.P_CAN2_FD_VCU4.CAN2_SG_FD_VCU4, signal-group=CAN2_SG_FD_VCU4, type-mapping=sender-rec-record-type-mapping=record-element-mappings=[{implementation-record-element=CAN2_EVDriveMode, system-signal=CAN2_EVDriveMode}, {implementation-record-element=CAN2_ZoneDR_SCP_CommErr, system-signal=CAN2_ZoneDR_SCP_CommErr}, {implementation-record-element=CAN2_VehMalfunLevel, system-signal=CAN2_VehMalfunLevel}, {implementation-record-element=CAN2_VCU_ISAErr, system-signal=CAN2_VCU_ISAErr}, {implementation-record-element=CAN2_VCU_ACCErr, system-signal=CAN2_VCU_ACCErr}, {implementation-record-element=CAN2_Eng_PwrLockSta, system-signal=CAN2_Eng_PwrLockSta}, {implementation-record-element=CAN2_Eng_CoastDwSta, system-signal=CAN2_Eng_CoastDwSta}, {implementation-record-element=CAN2_Eng_ActvDmpDisabSta, system-signal=CAN2_Eng_ActvDmpDisabSta}, {implementation-record-element=CAN2_Eng_AGSCloseSta, system-signal=CAN2_Eng_AGSCloseSta}]}
      MAP_CAN2_FD_VCU5: sender-receiver-to-signal-group-mapping{communication-direction=OUT, data-element=SWC_FDC.root_FDC.P_CAN2_FD_VCU5.CAN2_SG_FD_VCU5, signal-group=CAN2_SG_FD_VCU5, type-mapping=sender-rec-record-type-mapping=record-element-mappings=[{implementation-record-element=CAN2_EDriveSysErr_AccPedalErr, system-signal=CAN2_EDriveSysErr_AccPedalErr}, {implementation-record-element=CAN2_Re_VehThdChkSta, system-signal=CAN2_Re_VehThdChkSta}, {implementation-record-element=CAN2_PwrStaErr, system-signal=CAN2_PwrStaErr}, {implementation-record-element=CAN2_LowSOCWarn, system-signal=CAN2_LowSOCWarn}, {implementation-record-element=CAN2_LimphomeAct, system-signal=CAN2_LimphomeAct}, {implementation-record-element=CAN2_LVSysErr_PwrOutpErr, system-signal=CAN2_LVSysErr_PwrOutpErr}, {implementation-record-element=CAN2_HVSysErr_RelayErr, system-signal=CAN2_HVSysErr_RelayErr}, {implementation-record-element=CAN2_HVSysErr_PackErr, system-signal=CAN2_HVSysErr_PackErr}, {implementation-record-element=CAN2_HVSysErr_IsolationErr, system-signal=CAN2_HVSysErr_IsolationErr}, {implementation-record-element=CAN2_EDriveSysErr_VCUErr, system-signal=CAN2_EDriveSysErr_VCUErr}, {implementation-record-element=CAN2_EDriveSysErr_ShifterErr, system-signal=CAN2_EDriveSysErr_ShifterErr}, {implementation-record-element=CAN2_EDriveSysErr_MCUErr, system-signal=CAN2_EDriveSysErr_MCUErr}]}
      MAP_CAN2_FD_VCU6: sender-receiver-to-signal-group-mapping{communication-direction=OUT, data-element=SWC_FDC.root_FDC.P_CAN2_FD_VCU6.CAN2_SG_FD_VCU6, signal-group=CAN2_SG_FD_VCU6, type-mapping=sender-rec-record-type-mapping=record-element-mappings=[{implementation-record-element=CAN2_FUSION_HW_Ver1, system-signal=CAN2_FUSION_HW_Ver1}, {implementation-record-element=CAN2_FUSION_SW_dash2, system-signal=CAN2_FUSION_SW_dash2}, {implementation-record-element=CAN2_FUSION_SW_dash1, system-signal=CAN2_FUSION_SW_dash1}, {implementation-record-element=CAN2_FUSION_SW_change2, system-signal=CAN2_FUSION_SW_change2}, {implementation-record-element=CAN2_FUSION_SW_change1, system-signal=CAN2_FUSION_SW_change1}, {implementation-record-element=CAN2_FUSION_SW_Var, system-signal=CAN2_FUSION_SW_Var}, {implementation-record-element=CAN2_FUSION_SW_SHA8, system-signal=CAN2_FUSION_SW_SHA8}, {implementation-record-element=CAN2_FUSION_SW_SHA7, system-signal=CAN2_FUSION_SW_SHA7}, {implementation-record-element=CAN2_FUSION_SW_SHA6, system-signal=CAN2_FUSION_SW_SHA6}, {implementation-record-element=CAN2_FUSION_SW_SHA5, system-signal=CAN2_FUSION_SW_SHA5}, {implementation-record-element=CAN2_FUSION_SW_SHA4, system-signal=CAN2_FUSION_SW_SHA4}, {implementation-record-element=CAN2_FUSION_SW_SHA3, system-signal=CAN2_FUSION_SW_SHA3}, {implementation-record-element=CAN2_FUSION_SW_SHA2, system-signal=CAN2_FUSION_SW_SHA2}, {implementation-record-element=CAN2_FUSION_SW_SHA1, system-signal=CAN2_FUSION_SW_SHA1}, {implementation-record-element=CAN2_FUSION_SW_Patch2, system-signal=CAN2_FUSION_SW_Patch2}, {implementation-record-element=CAN2_FUSION_SW_Patch1, system-signal=CAN2_FUSION_SW_Patch1}, {implementation-record-element=CAN2_FUSION_SW_Minor2, system-signal=CAN2_FUSION_SW_Minor2}, {implementation-record-element=CAN2_FUSION_SW_Minor1, system-signal=CAN2_FUSION_SW_Minor1}, {implementation-record-element=CAN2_FUSION_SW_Major2, system-signal=CAN2_FUSION_SW_Major2}, {implementation-record-element=CAN2_FUSION_SW_Major1, system-signal=CAN2_FUSION_SW_Major1}, {implementation-record-element=CAN2_FUSION_SW_Country2, system-signal=CAN2_FUSION_SW_Country2}, {implementation-record-element=CAN2_FUSION_SW_Country1, system-signal=CAN2_FUSION_SW_Country1}, {implementation-record-element=CAN2_FUSION_SW_Controller2, system-signal=CAN2_FUSION_SW_Controller2}, {implementation-record-element=CAN2_FUSION_SW_Controller1, system-signal=CAN2_FUSION_SW_Controller1}, {implementation-record-element=CAN2_FUSION_SW_CarModel3, system-signal=CAN2_FUSION_SW_CarModel3}, {implementation-record-element=CAN2_FUSION_SW_CarModel2, system-signal=CAN2_FUSION_SW_CarModel2}, {implementation-record-element=CAN2_FUSION_SW_CarModel1, system-signal=CAN2_FUSION_SW_CarModel1}, {implementation-record-element=CAN2_FUSION_HW_Ver3, system-signal=CAN2_FUSION_HW_Ver3}, {implementation-record-element=CAN2_FUSION_HW_Ver2, system-signal=CAN2_FUSION_HW_Ver2}]}
      MAP_CAN2_FD_VMC1: sender-receiver-to-signal-group-mapping{communication-direction=OUT, data-element=SWC_FDC.root_FDC.P_CAN2_FD_VMC1.CAN2_SG_FD_VMC1, signal-group=CAN2_SG_FD_VMC1, type-mapping=sender-rec-record-type-mapping=sender-rec-record-element-mapping{implementation-record-element=CAN2_CCMSA_SpdWar, system-signal=CAN2_CCMSA_SpdWar}}
      MAP_CAN2_IVI1: sender-receiver-to-signal-group-mapping{communication-direction=IN, data-element=SWC_FDC.root_FDC.R_CAN2_IVI1.CAN2_SG_IVI1, signal-group=CAN2_SG_IVI1, type-mapping=sender-rec-record-type-mapping=record-element-mappings=[{implementation-record-element=CAN2_AmbLightColorSet, system-signal=CAN2_AmbLightColorSet}, {implementation-record-element=CAN2_VehACModReq, system-signal=CAN2_VehACModReq}, {implementation-record-element=CAN2_Upd_Countdown_Skip, system-signal=CAN2_Upd_Countdown_Skip}, {implementation-record-element=CAN2_Upd_Countdown_Cancel, system-signal=CAN2_Upd_Countdown_Cancel}, {implementation-record-element=CAN2_SmartEco_Mode_SW, system-signal=CAN2_SmartEco_Mode_SW}, {implementation-record-element=CAN2_Sched_OTA_wake, system-signal=CAN2_Sched_OTA_wake}, {implementation-record-element=CAN2_PW_CONTINUE_USE, system-signal=CAN2_PW_CONTINUE_USE}, {implementation-record-element=CAN2_PW_CLOSE_IMD, system-signal=CAN2_PW_CLOSE_IMD}, {implementation-record-element=CAN2_OpenDrOpenWdo_SW, system-signal=CAN2_OpenDrOpenWdo_SW}, {implementation-record-element=CAN2_OTA_UpdStart_Req, system-signal=CAN2_OTA_UpdStart_Req}, {implementation-record-element=CAN2_OTA_SuspendDL_Req, system-signal=CAN2_OTA_SuspendDL_Req}, {implementation-record-element=CAN2_OTA_DL_Req, system-signal=CAN2_OTA_DL_Req}, {implementation-record-element=CAN2_OTA_CompNTFY_Pres, system-signal=CAN2_OTA_CompNTFY_Pres}, {implementation-record-element=CAN2_OTA_CancelDL_Req, system-signal=CAN2_OTA_CancelDL_Req}, {implementation-record-element=CAN2_LINKtoDrive, system-signal=CAN2_LINKtoDrive}, {implementation-record-element=CAN2_IVI_OTA_Upd_Sta, system-signal=CAN2_IVI_OTA_Upd_Sta}, {implementation-record-element=CAN2_IVI_Lock_SoundSW_Sta, system-signal=CAN2_IVI_Lock_SoundSW_Sta}, {implementation-record-element=CAN2_IPAmbLightBrightnessSet, system-signal=CAN2_IPAmbLightBrightnessSet}, {implementation-record-element=CAN2_FCP_MidEvt_BtnAutoReq, system-signal=CAN2_FCP_MidEvt_BtnAutoReq}, {implementation-record-element=CAN2_FCP_FrEvt_BtnSyncReq, system-signal=CAN2_FCP_FrEvt_BtnSyncReq}, {implementation-record-element=CAN2_FCP_FrEvt_BtnAutoReq, system-signal=CAN2_FCP_FrEvt_BtnAutoReq}, {implementation-record-element=CAN2_FCP_FrEvt_BtnACReq, system-signal=CAN2_FCP_FrEvt_BtnACReq}, {implementation-record-element=CAN2_FCP_FrEvt_BtnACMaxReq, system-signal=CAN2_FCP_FrEvt_BtnACMaxReq}, {implementation-record-element=CAN2_DRAmbLightBrightnessSet, system-signal=CAN2_DRAmbLightBrightnessSet}, {implementation-record-element=CAN2_BrkAbn_GoReady_SW, system-signal=CAN2_BrkAbn_GoReady_SW}, {implementation-record-element=CAN2_AmbLightUserSet, system-signal=CAN2_AmbLightUserSet}]}
      MAP_CAN2_IVI2: sender-receiver-to-signal-group-mapping{communication-direction=IN, data-element=SWC_FDC.root_FDC.R_CAN2_IVI2.CAN2_SG_IVI2, signal-group=CAN2_SG_IVI2, type-mapping=sender-rec-record-type-mapping=record-element-mappings=[{implementation-record-element=CAN2_AC_Chg_Cur_Set, system-signal=CAN2_AC_Chg_Cur_Set}, {implementation-record-element=CAN2_sigWindDirZon3Req, system-signal=CAN2_sigWindDirZon3Req}, {implementation-record-element=CAN2_sigSetTempZon3Req, system-signal=CAN2_sigSetTempZon3Req}, {implementation-record-element=CAN2_sigSetTempZon2Req, system-signal=CAN2_sigSetTempZon2Req}, {implementation-record-element=CAN2_sigSetTempZon1Req, system-signal=CAN2_sigSetTempZon1Req}, {implementation-record-element=CAN2_sigRecircReq, system-signal=CAN2_sigRecircReq}, {implementation-record-element=CAN2_sigHvacReq, system-signal=CAN2_sigHvacReq}, {implementation-record-element=CAN2_sigHvacRearReq, system-signal=CAN2_sigHvacRearReq}, {implementation-record-element=CAN2_sigHvacFrontReq, system-signal=CAN2_sigHvacFrontReq}, {implementation-record-element=CAN2_sigFootReq, system-signal=CAN2_sigFootReq}, {implementation-record-element=CAN2_sigFaceReq, system-signal=CAN2_sigFaceReq}, {implementation-record-element=CAN2_sigDfrstReq, system-signal=CAN2_sigDfrstReq}, {implementation-record-element=CAN2_sigAirIntenZon3Req, system-signal=CAN2_sigAirIntenZon3Req}, {implementation-record-element=CAN2_sigAirIntenZon1Req, system-signal=CAN2_sigAirIntenZon1Req}, {implementation-record-element=CAN2_Wifi_Sta_IVI_TBOX, system-signal=CAN2_Wifi_Sta_IVI_TBOX}, {implementation-record-element=CAN2_Wifi_Reset, system-signal=CAN2_Wifi_Reset}, {implementation-record-element=CAN2_Walkaway_Lock_SW, system-signal=CAN2_Walkaway_Lock_SW}, {implementation-record-element=CAN2_User_p_upload, system-signal=CAN2_User_p_upload}, {implementation-record-element=CAN2_User_p_download, system-signal=CAN2_User_p_download}, {implementation-record-element=CAN2_TurnSwTimeSet, system-signal=CAN2_TurnSwTimeSet}, {implementation-record-element=CAN2_Time_system, system-signal=CAN2_Time_system}, {implementation-record-element=CAN2_Temperature_unit, system-signal=CAN2_Temperature_unit}, {implementation-record-element=CAN2_TPMS_Res_Butt, system-signal=CAN2_TPMS_Res_Butt}, {implementation-record-element=CAN2_TPMS_Cali_Butt, system-signal=CAN2_TPMS_Cali_Butt}, {implementation-record-element=CAN2_TCS_SW_Cmd, system-signal=CAN2_TCS_SW_Cmd}, {implementation-record-element=CAN2_SetUnlockSingle, system-signal=CAN2_SetUnlockSingle}, {implementation-record-element=CAN2_SenstivityPosition, system-signal=CAN2_SenstivityPosition}, {implementation-record-element=CAN2_Sched_Chg_wake, system-signal=CAN2_Sched_Chg_wake}, {implementation-record-element=CAN2_Sched_Chg_limit, system-signal=CAN2_Sched_Chg_limit}, {implementation-record-element=CAN2_Sched_Chg_butt, system-signal=CAN2_Sched_Chg_butt}, {implementation-record-element=CAN2_Sched_Chg_Stop, system-signal=CAN2_Sched_Chg_Stop}, {implementation-record-element=CAN2_Sched_Chg_Start, system-signal=CAN2_Sched_Chg_Start}, {implementation-record-element=CAN2_SOC_V2LLimit, system-signal=CAN2_SOC_V2LLimit}, {implementation-record-element=CAN2_SOC_Limit_Set, system-signal=CAN2_SOC_Limit_Set}, {implementation-record-element=CAN2_SOC_ADJ_BUTT, system-signal=CAN2_SOC_ADJ_BUTT}, {implementation-record-element=CAN2_SLIF_BUTT, system-signal=CAN2_SLIF_BUTT}, {implementation-record-element=CAN2_SLG_Sw, system-signal=CAN2_SLG_Sw}, {implementation-record-element=CAN2_RoomLampMode, system-signal=CAN2_RoomLampMode}, {implementation-record-element=CAN2_Roll_Mode_SW_Cmd, system-signal=CAN2_Roll_Mode_SW_Cmd}, {implementation-record-element=CAN2_Roll_Eng_Mode, system-signal=CAN2_Roll_Eng_Mode}, {implementation-record-element=CAN2_RFogLampSW, system-signal=CAN2_RFogLampSW}, {implementation-record-element=CAN2_RCTA_BUTT, system-signal=CAN2_RCTA_BUTT}, {implementation-record-element=CAN2_Pressure_unit, system-signal=CAN2_Pressure_unit}, {implementation-record-element=CAN2_Perd_V2L, system-signal=CAN2_Perd_V2L}, {implementation-record-element=CAN2_PSEAT_vent_req, system-signal=CAN2_PSEAT_vent_req}, {implementation-record-element=CAN2_OFF_AC_MODE, system-signal=CAN2_OFF_AC_MODE}, {implementation-record-element=CAN2_ODAMute_BUTT, system-signal=CAN2_ODAMute_BUTT}, {implementation-record-element=CAN2_NAVI_Tunnel, system-signal=CAN2_NAVI_Tunnel}, {implementation-record-element=CAN2_NAVI_Tollgate, system-signal=CAN2_NAVI_Tollgate}, {implementation-record-element=CAN2_NAVI_State, system-signal=CAN2_NAVI_State}, {implementation-record-element=CAN2_NAVI_Speed_Limit_A, system-signal=CAN2_NAVI_Speed_Limit_A}, {implementation-record-element=CAN2_NAVI_SpeedLimit, system-signal=CAN2_NAVI_SpeedLimit}, {implementation-record-element=CAN2_NAVI_RoadClass, system-signal=CAN2_NAVI_RoadClass}, {implementation-record-element=CAN2_NAVI_LinkClass, system-signal=CAN2_NAVI_LinkClass}, {implementation-record-element=CAN2_NAVI_ForwardLinkLevel, system-signal=CAN2_NAVI_ForwardLinkLevel}, {implementation-record-element=CAN2_NAVI_Distance_info, system-signal=CAN2_NAVI_Distance_info}, {implementation-record-element=CAN2_NAVI_Direction_STA, system-signal=CAN2_NAVI_Direction_STA}, {implementation-record-element=CAN2_NAVI_Cam_Dist_info, system-signal=CAN2_NAVI_Cam_Dist_info}, {implementation-record-element=CAN2_MFRD_N_Bright_Req, system-signal=CAN2_MFRD_N_Bright_Req}, {implementation-record-element=CAN2_METER_Malfunc_Sta, system-signal=CAN2_METER_Malfunc_Sta}, {implementation-record-element=CAN2_L_RRD_ControlCommand, system-signal=CAN2_L_RRD_ControlCommand}, {implementation-record-element=CAN2_L_RLD_ControlCommand, system-signal=CAN2_L_RLD_ControlCommand}, {implementation-record-element=CAN2_L_Pas_ControlCommand, system-signal=CAN2_L_Pas_ControlCommand}, {implementation-record-element=CAN2_L_Drv_ControlCommand, system-signal=CAN2_L_Drv_ControlCommand}, {implementation-record-element=CAN2_LVDAMute_BUTT, system-signal=CAN2_LVDAMute_BUTT}, {implementation-record-element=CAN2_LKA_BUTT, system-signal=CAN2_LKA_BUTT}, {implementation-record-element=CAN2_LDWMute_BUTT, system-signal=CAN2_LDWMute_BUTT}, {implementation-record-element=CAN2_IVI_WI_MAIN_SW, system-signal=CAN2_IVI_WI_MAIN_SW}, {implementation-record-element=CAN2_IVI_Unlock_Chg_req, system-signal=CAN2_IVI_Unlock_Chg_req}, {implementation-record-element=CAN2_IVI_Trigger_req, system-signal=CAN2_IVI_Trigger_req}, {implementation-record-element=CAN2_IVI_Stop_Chg_req, system-signal=CAN2_IVI_Stop_Chg_req}, {implementation-record-element=CAN2_IVI_Status, system-signal=CAN2_IVI_Status}, {implementation-record-element=CAN2_IVI_Start_Chg_req, system-signal=CAN2_IVI_Start_Chg_req}, {implementation-record-element=CAN2_IVI_Screen, system-signal=CAN2_IVI_Screen}, {implementation-record-element=CAN2_IVI_Req_V2L, system-signal=CAN2_IVI_Req_V2L}, {implementation-record-element=CAN2_IVI_RR_Def_Req, system-signal=CAN2_IVI_RR_Def_Req}, {implementation-record-element=CAN2_IVI_Pwroff_req, system-signal=CAN2_IVI_Pwroff_req}, {implementation-record-element=CAN2_IVI_PwrLockSW, system-signal=CAN2_IVI_PwrLockSW}, {implementation-record-element=CAN2_IVI_Panel_Y_Coor, system-signal=CAN2_IVI_Panel_Y_Coor}, {implementation-record-element=CAN2_IVI_Panel_X_Coor, system-signal=CAN2_IVI_Panel_X_Coor}, {implementation-record-element=CAN2_IVI_Panel_Act, system-signal=CAN2_IVI_Panel_Act}, {implementation-record-element=CAN2_IVI_PW_Mode_Req, system-signal=CAN2_IVI_PW_Mode_Req}, {implementation-record-element=CAN2_IVI_PTG_USSta_SW, system-signal=CAN2_IVI_PTG_USSta_SW}, {implementation-record-element=CAN2_IVI_PTG_Sta_SW, system-signal=CAN2_IVI_PTG_Sta_SW}, {implementation-record-element=CAN2_IVI_PTG_Open_Height, system-signal=CAN2_IVI_PTG_Open_Height}, {implementation-record-element=CAN2_IVI_PTG_Mode_SW, system-signal=CAN2_IVI_PTG_Mode_SW}, {implementation-record-element=CAN2_IVI_Night_Mode_Sta, system-signal=CAN2_IVI_Night_Mode_Sta}, {implementation-record-element=CAN2_IVI_Mute_Sta, system-signal=CAN2_IVI_Mute_Sta}, {implementation-record-element=CAN2_IVI_LVChrgFuncSW, system-signal=CAN2_IVI_LVChrgFuncSW}, {implementation-record-element=CAN2_IVI_ISA_OffsetSpd, system-signal=CAN2_IVI_ISA_OffsetSpd}, {implementation-record-element=CAN2_IVI_CreepSW_Req, system-signal=CAN2_IVI_CreepSW_Req}, {implementation-record-element=CAN2_IVI_CoastDwSW, system-signal=CAN2_IVI_CoastDwSW}, {implementation-record-element=CAN2_IVI_ActvDmpDisabSW, system-signal=CAN2_IVI_ActvDmpDisabSW}, {implementation-record-element=CAN2_IVI_AGSCloseSW, system-signal=CAN2_IVI_AGSCloseSW}, {implementation-record-element=CAN2_Hood_Latch_SW, system-signal=CAN2_Hood_Latch_SW}, {implementation-record-element=CAN2_HeadLampSW, system-signal=CAN2_HeadLampSW}, {implementation-record-element=CAN2_GPS_LONG, system-signal=CAN2_GPS_LONG}, {implementation-record-element=CAN2_GPS_LAT, system-signal=CAN2_GPS_LAT}, {implementation-record-element=CAN2_FollowMeSW, system-signal=CAN2_FollowMeSW}, {implementation-record-element=CAN2_FalseNPrevent_SW, system-signal=CAN2_FalseNPrevent_SW}, {implementation-record-element=CAN2_FS_Off_Sw, system-signal=CAN2_FS_Off_Sw}, {implementation-record-element=CAN2_FFogLampSW, system-signal=CAN2_FFogLampSW}, {implementation-record-element=CAN2_FCWMute_BUTT, system-signal=CAN2_FCWMute_BUTT}, {implementation-record-element=CAN2_ESC_SW_Cmd, system-signal=CAN2_ESC_SW_Cmd}, {implementation-record-element=CAN2_Distance_unit, system-signal=CAN2_Distance_unit}, {implementation-record-element=CAN2_DSEAT_vent_req, system-signal=CAN2_DSEAT_vent_req}, {implementation-record-element=CAN2_DSEAT_entryfun_set, system-signal=CAN2_DSEAT_entryfun_set}, {implementation-record-element=CAN2_DSEAT_anti_set, system-signal=CAN2_DSEAT_anti_set}, {implementation-record-element=CAN2_CameraWrn, system-signal=CAN2_CameraWrn}, {implementation-record-element=CAN2_CDL_Unlock_Butt, system-signal=CAN2_CDL_Unlock_Butt}, {implementation-record-element=CAN2_CDL_Lock_Butt, system-signal=CAN2_CDL_Lock_Butt}, {implementation-record-element=CAN2_CAAS_Sw, system-signal=CAN2_CAAS_Sw}, {implementation-record-element=CAN2_BSDMute_BUTT, system-signal=CAN2_BSDMute_BUTT}, {implementation-record-element=CAN2_Approach_Unlock_SW, system-signal=CAN2_Approach_Unlock_SW}, {implementation-record-element=CAN2_AVM_parking_excute, system-signal=CAN2_AVM_parking_excute}, {implementation-record-element=CAN2_AVM_parking_cancel, system-signal=CAN2_AVM_parking_cancel}, {implementation-record-element=CAN2_AVM_Parking_mode, system-signal=CAN2_AVM_Parking_mode}, {implementation-record-element=CAN2_AVM_OFF_Rec_Butt, system-signal=CAN2_AVM_OFF_Rec_Butt}, {implementation-record-element=CAN2_AVM_Err_STA, system-signal=CAN2_AVM_Err_STA}, {implementation-record-element=CAN2_AEB_BUTT, system-signal=CAN2_AEB_BUTT}]}
      MAP_CAN2_IVI6: sender-receiver-to-signal-group-mapping{communication-direction=IN, data-element=SWC_FDC.root_FDC.R_CAN2_IVI6.CAN2_SG_IVI6, signal-group=CAN2_SG_IVI6, type-mapping=sender-rec-record-type-mapping=record-element-mappings=[{implementation-record-element=CAN2_IVI_Located_STA, system-signal=CAN2_IVI_Located_STA}, {implementation-record-element=CAN2_IVI_Time_Year, system-signal=CAN2_IVI_Time_Year}, {implementation-record-element=CAN2_IVI_Time_Second, system-signal=CAN2_IVI_Time_Second}, {implementation-record-element=CAN2_IVI_Time_Month, system-signal=CAN2_IVI_Time_Month}, {implementation-record-element=CAN2_IVI_Time_Minute, system-signal=CAN2_IVI_Time_Minute}, {implementation-record-element=CAN2_IVI_Time_Hour, system-signal=CAN2_IVI_Time_Hour}, {implementation-record-element=CAN2_IVI_Time_Day, system-signal=CAN2_IVI_Time_Day}, {implementation-record-element=CAN2_IVI_Time_Check, system-signal=CAN2_IVI_Time_Check}]}
      MAP_CAN2_METER1: sender-receiver-to-signal-group-mapping{communication-direction=IN, data-element=SWC_FDC.root_FDC.R_CAN2_METER1.CAN2_SG_METER1, signal-group=CAN2_SG_METER1, type-mapping=sender-rec-record-type-mapping=record-element-mappings=[{implementation-record-element=CAN2_APCforDTE, system-signal=CAN2_APCforDTE}, {implementation-record-element=CAN2_Trip_B, system-signal=CAN2_Trip_B}, {implementation-record-element=CAN2_Trip_A, system-signal=CAN2_Trip_A}, {implementation-record-element=CAN2_Spd_Crl_Sta, system-signal=CAN2_Spd_Crl_Sta}, {implementation-record-element=CAN2_Spd_Crl_Mode, system-signal=CAN2_Spd_Crl_Mode}, {implementation-record-element=CAN2_ParkBrake, system-signal=CAN2_ParkBrake}, {implementation-record-element=CAN2_ODOMETER, system-signal=CAN2_ODOMETER}, {implementation-record-element=CAN2_METER_MPH_Real, system-signal=CAN2_METER_MPH_Real}, {implementation-record-element=CAN2_METER_MPH_Calcu, system-signal=CAN2_METER_MPH_Calcu}, {implementation-record-element=CAN2_METER_KPH_Real, system-signal=CAN2_METER_KPH_Real}, {implementation-record-element=CAN2_METER_KPH_Calcu, system-signal=CAN2_METER_KPH_Calcu}, {implementation-record-element=CAN2_LEDlitWarnReq, system-signal=CAN2_LEDlitWarnReq}, {implementation-record-element=CAN2_Charge, system-signal=CAN2_Charge}, {implementation-record-element=CAN2_Averaged_vehspeed, system-signal=CAN2_Averaged_vehspeed}, {implementation-record-element=CAN2_AvailableTrip, system-signal=CAN2_AvailableTrip}, {implementation-record-element=CAN2_AVGPwrConsumption, system-signal=CAN2_AVGPwrConsumption}]}
      MAP_CAN3_BMS1: sender-receiver-to-signal-group-mapping{communication-direction=IN, data-element=SWC_FDC.root_FDC.R_CAN3_BMS1.CAN3_SG_BMS1, signal-group=CAN3_SG_BMS1, type-mapping=sender-rec-record-type-mapping=record-element-mappings=[{implementation-record-element=CAN3_BMSChckSum_1, system-signal=CAN3_BMSChckSum_1}, {implementation-record-element=CAN3_HVBattVolt, system-signal=CAN3_HVBattVolt}, {implementation-record-element=CAN3_HVBattCurr, system-signal=CAN3_HVBattCurr}, {implementation-record-element=CAN3_HVBPwrAvailDchrg60, system-signal=CAN3_HVBPwrAvailDchrg60}, {implementation-record-element=CAN3_HVBPwrAvailDchrg30, system-signal=CAN3_HVBPwrAvailDchrg30}, {implementation-record-element=CAN3_HVBPwrAvailDchrg, system-signal=CAN3_HVBPwrAvailDchrg}, {implementation-record-element=CAN3_HVBPwrAvailChrg60, system-signal=CAN3_HVBPwrAvailChrg60}, {implementation-record-element=CAN3_HVBPwrAvailChrg30, system-signal=CAN3_HVBPwrAvailChrg30}, {implementation-record-element=CAN3_HVBPwrAvailChrg, system-signal=CAN3_HVBPwrAvailChrg}, {implementation-record-element=CAN3_BMSRolCnct_1, system-signal=CAN3_BMSRolCnct_1}]}
      MAP_CAN3_BMS2: sender-receiver-to-signal-group-mapping{communication-direction=IN, data-element=SWC_FDC.root_FDC.R_CAN3_BMS2.CAN3_SG_BMS2, signal-group=CAN3_SG_BMS2, type-mapping=sender-rec-record-type-mapping=record-element-mappings=[{implementation-record-element=CAN3_HVInVolt, system-signal=CAN3_HVInVolt}, {implementation-record-element=CAN3_ReChargerStaFromEvcc, system-signal=CAN3_ReChargerStaFromEvcc}, {implementation-record-element=CAN3_OBCDCVoltLm, system-signal=CAN3_OBCDCVoltLm}, {implementation-record-element=CAN3_OBCDCCurLm, system-signal=CAN3_OBCDCCurLm}, {implementation-record-element=CAN3_LVBattDet12V, system-signal=CAN3_LVBattDet12V}]}
      MAP_CAN3_BMS3: sender-receiver-to-signal-group-mapping{communication-direction=IN, data-element=SWC_FDC.root_FDC.R_CAN3_BMS3.CAN3_SG_BMS3, signal-group=CAN3_SG_BMS3, type-mapping=sender-rec-record-type-mapping=record-element-mappings=[{implementation-record-element=CAN3_ACChrgCurrDis, system-signal=CAN3_ACChrgCurrDis}, {implementation-record-element=CAN3_SOC_UseLimit, system-signal=CAN3_SOC_UseLimit}, {implementation-record-element=CAN3_RemainChrgTime, system-signal=CAN3_RemainChrgTime}, {implementation-record-element=CAN3_RechrgCyc, system-signal=CAN3_RechrgCyc}, {implementation-record-element=CAN3_HVBattSOCDis, system-signal=CAN3_HVBattSOCDis}, {implementation-record-element=CAN3_HVBattSOCDiff, system-signal=CAN3_HVBattSOCDiff}, {implementation-record-element=CAN3_HVBattSOC, system-signal=CAN3_HVBattSOC}, {implementation-record-element=CAN3_HVBattPackVolt, system-signal=CAN3_HVBattPackVolt}, {implementation-record-element=CAN3_HVBSOH, system-signal=CAN3_HVBSOH}, {implementation-record-element=CAN3_HVBIsoImpedenceP, system-signal=CAN3_HVBIsoImpedenceP}, {implementation-record-element=CAN3_HVBIsoImpedenceN, system-signal=CAN3_HVBIsoImpedenceN}, {implementation-record-element=CAN3_HVBFullChrgPwr, system-signal=CAN3_HVBFullChrgPwr}, {implementation-record-element=CAN3_HVBDrvPwrTotal, system-signal=CAN3_HVBDrvPwrTotal}, {implementation-record-element=CAN3_HVBDrvPwr, system-signal=CAN3_HVBDrvPwr}, {implementation-record-element=CAN3_HVBChrgPwrTotal, system-signal=CAN3_HVBChrgPwrTotal}, {implementation-record-element=CAN3_HVBChrgPwr, system-signal=CAN3_HVBChrgPwr}, {implementation-record-element=CAN3_CellType, system-signal=CAN3_CellType}, {implementation-record-element=CAN3_Battsystfail_Num, system-signal=CAN3_Battsystfail_Num}, {implementation-record-element=CAN3_BMS_HVBattCellBalance_Sta, system-signal=CAN3_BMS_HVBattCellBalance_Sta}]}
      MAP_CAN3_BMS4: sender-receiver-to-signal-group-mapping{communication-direction=IN, data-element=SWC_FDC.root_FDC.R_CAN3_BMS4.CAN3_SG_BMS4, signal-group=CAN3_SG_BMS4, type-mapping=sender-rec-record-type-mapping=record-element-mappings=[{implementation-record-element=CAN3_CellTempAvg, system-signal=CAN3_CellTempAvg}, {implementation-record-element=CAN3_Mtemp20, system-signal=CAN3_Mtemp20}, {implementation-record-element=CAN3_Mtemp19, system-signal=CAN3_Mtemp19}, {implementation-record-element=CAN3_Mtemp18, system-signal=CAN3_Mtemp18}, {implementation-record-element=CAN3_Mtemp17, system-signal=CAN3_Mtemp17}, {implementation-record-element=CAN3_Mtemp16, system-signal=CAN3_Mtemp16}, {implementation-record-element=CAN3_Mtemp15, system-signal=CAN3_Mtemp15}, {implementation-record-element=CAN3_Mtemp14, system-signal=CAN3_Mtemp14}, {implementation-record-element=CAN3_Mtemp13, system-signal=CAN3_Mtemp13}, {implementation-record-element=CAN3_Mtemp12, system-signal=CAN3_Mtemp12}, {implementation-record-element=CAN3_Mtemp11, system-signal=CAN3_Mtemp11}, {implementation-record-element=CAN3_Mtemp10, system-signal=CAN3_Mtemp10}, {implementation-record-element=CAN3_Mtemp09, system-signal=CAN3_Mtemp09}, {implementation-record-element=CAN3_Mtemp08, system-signal=CAN3_Mtemp08}, {implementation-record-element=CAN3_Mtemp07, system-signal=CAN3_Mtemp07}, {implementation-record-element=CAN3_Mtemp06, system-signal=CAN3_Mtemp06}, {implementation-record-element=CAN3_Mtemp05, system-signal=CAN3_Mtemp05}, {implementation-record-element=CAN3_Mtemp04, system-signal=CAN3_Mtemp04}, {implementation-record-element=CAN3_Mtemp03, system-signal=CAN3_Mtemp03}, {implementation-record-element=CAN3_Mtemp02, system-signal=CAN3_Mtemp02}, {implementation-record-element=CAN3_Mtemp01, system-signal=CAN3_Mtemp01}, {implementation-record-element=CAN3_MinCellVolt_Num, system-signal=CAN3_MinCellVolt_Num}, {implementation-record-element=CAN3_MinCellTemp_Num, system-signal=CAN3_MinCellTemp_Num}, {implementation-record-element=CAN3_MaxCellVolt_Num, system-signal=CAN3_MaxCellVolt_Num}, {implementation-record-element=CAN3_MaxCellTemp_Num, system-signal=CAN3_MaxCellTemp_Num}, {implementation-record-element=CAN3_HVBMTempMin, system-signal=CAN3_HVBMTempMin}, {implementation-record-element=CAN3_HVBMTempMax, system-signal=CAN3_HVBMTempMax}, {implementation-record-element=CAN3_HVBCellVoltMin, system-signal=CAN3_HVBCellVoltMin}, {implementation-record-element=CAN3_HVBCellVoltMax, system-signal=CAN3_HVBCellVoltMax}]}
      MAP_CAN3_BMS6: sender-receiver-to-signal-group-mapping{communication-direction=IN, data-element=SWC_FDC.root_FDC.R_CAN3_BMS6.CAN3_SG_BMS6, signal-group=CAN3_SG_BMS6, type-mapping=sender-rec-record-type-mapping=record-element-mappings=[{implementation-record-element=CAN3_BMSChckSum, system-signal=CAN3_BMSChckSum}, {implementation-record-element=CAN3_V2LSta, system-signal=CAN3_V2LSta}, {implementation-record-element=CAN3_SystemUncomErr, system-signal=CAN3_SystemUncomErr}, {implementation-record-element=CAN3_IsoDetSta, system-signal=CAN3_IsoDetSta}, {implementation-record-element=CAN3_HVILSta, system-signal=CAN3_HVILSta}, {implementation-record-element=CAN3_HVBattReady4Pre, system-signal=CAN3_HVBattReady4Pre}, {implementation-record-element=CAN3_HVBUndrVoltErr, system-signal=CAN3_HVBUndrVoltErr}, {implementation-record-element=CAN3_HVBUndrTempWarn, system-signal=CAN3_HVBUndrTempWarn}, {implementation-record-element=CAN3_HVBUndrTempErr, system-signal=CAN3_HVBUndrTempErr}, {implementation-record-element=CAN3_HVBUndrSOCErr, system-signal=CAN3_HVBUndrSOCErr}, {implementation-record-element=CAN3_HVBTempDiffErr, system-signal=CAN3_HVBTempDiffErr}, {implementation-record-element=CAN3_HVBShrtDischrgCurrErr, system-signal=CAN3_HVBShrtDischrgCurrErr}, {implementation-record-element=CAN3_HVBShrtChrgCurrErr, system-signal=CAN3_HVBShrtChrgCurrErr}, {implementation-record-element=CAN3_HVBSOCJumpError, system-signal=CAN3_HVBSOCJumpError}, {implementation-record-element=CAN3_HVBPreheatPrecoolSta, system-signal=CAN3_HVBPreheatPrecoolSta}, {implementation-record-element=CAN3_HVBPrechrgSta, system-signal=CAN3_HVBPrechrgSta}, {implementation-record-element=CAN3_HVBOvrVoltErr, system-signal=CAN3_HVBOvrVoltErr}, {implementation-record-element=CAN3_HVBOvrTempWarn, system-signal=CAN3_HVBOvrTempWarn}, {implementation-record-element=CAN3_HVBOvrTempErr, system-signal=CAN3_HVBOvrTempErr}, {implementation-record-element=CAN3_HVBOvrSOCErr, system-signal=CAN3_HVBOvrSOCErr}, {implementation-record-element=CAN3_HVBOvrDchrgCurErr, system-signal=CAN3_HVBOvrDchrgCurErr}, {implementation-record-element=CAN3_HVBOvrChrgCurrErr, system-signal=CAN3_HVBOvrChrgCurrErr}, {implementation-record-element=CAN3_HVBHVILErr, system-signal=CAN3_HVBHVILErr}, {implementation-record-element=CAN3_HVBContactorSta, system-signal=CAN3_HVBContactorSta}, {implementation-record-element=CAN3_HVBChrgErr, system-signal=CAN3_HVBChrgErr}, {implementation-record-element=CAN3_HVBCellUndrVoltErr, system-signal=CAN3_HVBCellUndrVoltErr}, {implementation-record-element=CAN3_HVBCellUnbalanErr, system-signal=CAN3_HVBCellUnbalanErr}, {implementation-record-element=CAN3_HVBCellUdrVoltWarn, system-signal=CAN3_HVBCellUdrVoltWarn}, {implementation-record-element=CAN3_HVBCellOvrVoltWarn, system-signal=CAN3_HVBCellOvrVoltWarn}, {implementation-record-element=CAN3_HVBCellOvrVoltErr, system-signal=CAN3_HVBCellOvrVoltErr}, {implementation-record-element=CAN3_ExtChrgSta, system-signal=CAN3_ExtChrgSta}, {implementation-record-element=CAN3_DisChrgPlugErr, system-signal=CAN3_DisChrgPlugErr}, {implementation-record-element=CAN3_DCChrgSysShockErr, system-signal=CAN3_DCChrgSysShockErr}, {implementation-record-element=CAN3_ChrgPlugSta, system-signal=CAN3_ChrgPlugSta}, {implementation-record-element=CAN3_ChrgInLockReq, system-signal=CAN3_ChrgInLockReq}, {implementation-record-element=CAN3_CellUnconsistErr, system-signal=CAN3_CellUnconsistErr}, {implementation-record-element=CAN3_BMS_Warn_8, system-signal=CAN3_BMS_Warn_8}, {implementation-record-element=CAN3_BMS_Warn_7, system-signal=CAN3_BMS_Warn_7}, {implementation-record-element=CAN3_BMS_Warn_6, system-signal=CAN3_BMS_Warn_6}, {implementation-record-element=CAN3_BMS_Warn_5, system-signal=CAN3_BMS_Warn_5}, {implementation-record-element=CAN3_BMS_Warn_4, system-signal=CAN3_BMS_Warn_4}, {implementation-record-element=CAN3_BMS_Warn_3, system-signal=CAN3_BMS_Warn_3}, {implementation-record-element=CAN3_BMS_Warn_2, system-signal=CAN3_BMS_Warn_2}, {implementation-record-element=CAN3_BMS_Warn_1, system-signal=CAN3_BMS_Warn_1}, {implementation-record-element=CAN3_BMS_READY, system-signal=CAN3_BMS_READY}, {implementation-record-element=CAN3_BMSRolCnct, system-signal=CAN3_BMSRolCnct}]}
      MAP_CAN3_BMS7: sender-receiver-to-signal-group-mapping{communication-direction=IN, data-element=SWC_FDC.root_FDC.R_CAN3_BMS7.CAN3_SG_BMS7, signal-group=CAN3_SG_BMS7, type-mapping=sender-rec-record-type-mapping=record-element-mappings=[{implementation-record-element=CAN3_ChrgCurType, system-signal=CAN3_ChrgCurType}, {implementation-record-element=CAN3_HVBattErr, system-signal=CAN3_HVBattErr}, {implementation-record-element=CAN3_FireDetErr, system-signal=CAN3_FireDetErr}, {implementation-record-element=CAN3_ChrgLampSta, system-signal=CAN3_ChrgLampSta}]}
      MAP_CAN3_CCU1: sender-receiver-to-signal-group-mapping{communication-direction=IN, data-element=SWC_FDC.root_FDC.R_CAN3_CCU1.CAN3_SG_CCU1, signal-group=CAN3_SG_CCU1, type-mapping=sender-rec-record-type-mapping=record-element-mappings=[{implementation-record-element=CAN3_CS_CCU1, system-signal=CAN3_CS_CCU1}, {implementation-record-element=CAN3_RC_CCU1, system-signal=CAN3_RC_CCU1}, {implementation-record-element=CAN3_OBCWakeup4Plugin, system-signal=CAN3_OBCWakeup4Plugin}, {implementation-record-element=CAN3_OBCPreCompleted, system-signal=CAN3_OBCPreCompleted}, {implementation-record-element=CAN3_OBCDCVoltInf, system-signal=CAN3_OBCDCVoltInf}, {implementation-record-element=CAN3_OBCDCCurrInf, system-signal=CAN3_OBCDCCurrInf}, {implementation-record-element=CAN3_DCDCPreCompleted, system-signal=CAN3_DCDCPreCompleted}, {implementation-record-element=CAN3_DCDCInVoltInf, system-signal=CAN3_DCDCInVoltInf}, {implementation-record-element=CAN3_DCDCAuxVolt, system-signal=CAN3_DCDCAuxVolt}]}
      MAP_CAN3_CCU2: sender-receiver-to-signal-group-mapping{communication-direction=IN, data-element=SWC_FDC.root_FDC.R_CAN3_CCU2.CAN3_SG_CCU2, signal-group=CAN3_SG_CCU2, type-mapping=sender-rec-record-type-mapping=record-element-mappings=[{implementation-record-element=CAN3_CS_CCU2, system-signal=CAN3_CS_CCU2}, {implementation-record-element=CAN3_ReqOBCV2LEna, system-signal=CAN3_ReqOBCV2LEna}, {implementation-record-element=CAN3_RC_CCU2, system-signal=CAN3_RC_CCU2}, {implementation-record-element=CAN3_OBC_AC_Cur_Lim, system-signal=CAN3_OBC_AC_Cur_Lim}, {implementation-record-element=CAN3_OBCV2LSta, system-signal=CAN3_OBCV2LSta}, {implementation-record-element=CAN3_OBCTemp, system-signal=CAN3_OBCTemp}, {implementation-record-element=CAN3_OBCReady4Pre, system-signal=CAN3_OBCReady4Pre}, {implementation-record-element=CAN3_OBCPluginSta, system-signal=CAN3_OBCPluginSta}, {implementation-record-element=CAN3_OBCFaultSta, system-signal=CAN3_OBCFaultSta}, {implementation-record-element=CAN3_OBCEnaSta, system-signal=CAN3_OBCEnaSta}, {implementation-record-element=CAN3_OBCDCP, system-signal=CAN3_OBCDCP}, {implementation-record-element=CAN3_OBCACVoltInf, system-signal=CAN3_OBCACVoltInf}, {implementation-record-element=CAN3_OBCACCurrInf, system-signal=CAN3_OBCACCurrInf}, {implementation-record-element=CAN3_DCDCTemp, system-signal=CAN3_DCDCTemp}, {implementation-record-element=CAN3_DCDCReady4Pre, system-signal=CAN3_DCDCReady4Pre}, {implementation-record-element=CAN3_DCDCFaultSta, system-signal=CAN3_DCDCFaultSta}, {implementation-record-element=CAN3_DCDCEnaSta, system-signal=CAN3_DCDCEnaSta}]}
      MAP_CAN3_CCU4: sender-receiver-to-signal-group-mapping{communication-direction=IN, data-element=SWC_FDC.root_FDC.R_CAN3_CCU4.CAN3_SG_CCU4, signal-group=CAN3_SG_CCU4, type-mapping=sender-rec-record-type-mapping=record-element-mappings=[{implementation-record-element=CAN3_DCDCAuxCur, system-signal=CAN3_DCDCAuxCur}, {implementation-record-element=CAN3_OBCV2LVoutUVP, system-signal=CAN3_OBCV2LVoutUVP}, {implementation-record-element=CAN3_OBCV2LVoutOVP, system-signal=CAN3_OBCV2LVoutOVP}, {implementation-record-element=CAN3_OBCV2LVoutOCP, system-signal=CAN3_OBCV2LVoutOCP}, {implementation-record-element=CAN3_OBCV2LVinUVP, system-signal=CAN3_OBCV2LVinUVP}, {implementation-record-element=CAN3_OBCV2LVinOVP, system-signal=CAN3_OBCV2LVinOVP}, {implementation-record-element=CAN3_OBCV2LInsuFault, system-signal=CAN3_OBCV2LInsuFault}, {implementation-record-element=CAN3_OBCV2LINVOTP, system-signal=CAN3_OBCV2LINVOTP}, {implementation-record-element=CAN3_DCDCHVCur, system-signal=CAN3_DCDCHVCur}]}
