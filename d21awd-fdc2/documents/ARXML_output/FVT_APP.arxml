AUTOSAR XML (schema 4-3-0)
package /Impl_Type_ACC_ARPkg
  impl type BACC_outputs: category=STRUCTURE
    4 x element, all with category=TYPE_REFERENCE:
      VACC_HVTHCMSysAvail_enum: implementation-data-type=uint8
      VACC_LVBattVoltSta_enum: implementation-data-type=uint8
      VACC_VehHVPwrAvail4THCM_W: implementation-data-type=float32
      VACC_TMPwrAvailDchrg_kW: implementation-data-type=float32
package /Interface_ACC_ARPkg
  sender receiver interface IF_BACC_outputs
    data BACC_outputs: type=BACC_outputs
package /Impl_Type_APM_ARPkg
  impl type BAPM_outputs: category=STRUCTURE
    176 x element, all with category=TYPE_REFERENCE:
      VAPM_VehSpeed_kph: implementation-data-type=float32
      VAPM_VehSpeedTimeOut_flg: implementation-data-type=boolean
      VAPM_FSOffSw_enum: implementation-data-type=uint8
      VAPM_FSOffSwTimeOut_flg: implementation-data-type=boolean
      VAPM_ChrgPlugSta_enum: implementation-data-type=uint8
      VAPM_PASDRMR_cm: implementation-data-type=uint8
      VAPM_PASDRML_cm: implementation-data-type=uint8
      VAPM_PASDRCR_cm: implementation-data-type=uint8
      VAPM_PASDRCL_cm: implementation-data-type=uint8
      VAPM_PASDFMR_cm: implementation-data-type=uint8
      VAPM_PASDFML_cm: implementation-data-type=uint8
      VAPM_PASDFCR_cm: implementation-data-type=uint8
      VAPM_PASDFCL_cm: implementation-data-type=uint8
      VAPM_APSDRLR_cm: implementation-data-type=uint16
      VAPM_APSDRLL_cm: implementation-data-type=uint16
      VAPM_APSDFLR_cm: implementation-data-type=uint16
      VAPM_APSDFLL_cm: implementation-data-type=uint16
      VAPM_PASAFCL_enum: implementation-data-type=uint8
      VAPM_PASARMR_enum: implementation-data-type=uint8
      VAPM_PASARML_enum: implementation-data-type=uint8
      VAPM_PASARCR_enum: implementation-data-type=uint8
      VAPM_PASARCL_enum: implementation-data-type=uint8
      VAPM_PASAFMR_enum: implementation-data-type=uint8
      VAPM_PASAFML_enum: implementation-data-type=uint8
      VAPM_PASAFCR_enum: implementation-data-type=uint8
      VAPM_USSStaRMR_flg: implementation-data-type=boolean
      VAPM_USSStaRML_flg: implementation-data-type=boolean
      VAPM_USSStaRLR_flg: implementation-data-type=boolean
      VAPM_USSStaRLL_flg: implementation-data-type=boolean
      VAPM_USSStaRCR_flg: implementation-data-type=boolean
      VAPM_USSStaRCL_flg: implementation-data-type=boolean
      VAPM_USSStaFMR_flg: implementation-data-type=boolean
      VAPM_USSStaFML_flg: implementation-data-type=boolean
      VAPM_USSStaFLR_flg: implementation-data-type=boolean
      VAPM_USSStaFLL_flg: implementation-data-type=boolean
      VAPM_USSStaFCR_flg: implementation-data-type=boolean
      VAPM_USSStaFCL_flg: implementation-data-type=boolean
      VAPM_Chime_enum: implementation-data-type=uint8
      VAPM_SNSRLayout_enum: implementation-data-type=uint8
      VAPM_StaFSya_flg: implementation-data-type=boolean
      VAPM_ModOperation_enum: implementation-data-type=uint8
      VAPM_BrkPedalPos_pct: implementation-data-type=float32
      VAPM_BrkPedalPosTimeOut_flg: implementation-data-type=boolean
      VAPM_ActAPSPosn_pct: implementation-data-type=float32
      VAPM_LFRawWhlSpeed_kph: implementation-data-type=float32
      VAPM_LFRawWhlSpeedTimeOut_flg: implementation-data-type=boolean
      VAPM_RFRawWhlSpeed_kph: implementation-data-type=float32
      VAPM_RFRawWhlSpeedTimeOut_flg: implementation-data-type=boolean
      VAPM_LRRawWhlSpeed_kph: implementation-data-type=float32
      VAPM_LRRawWhlSpeedTimeOut_flg: implementation-data-type=boolean
      VAPM_RRRawWhlSpeed_kph: implementation-data-type=float32
      VAPM_RRRawWhlSpeedTimeOut_flg: implementation-data-type=boolean
      VAPM_LFRawWhlSpeedV_flg: implementation-data-type=boolean
      VAPM_LFRawWhlSpeedVTimeOut_flg: implementation-data-type=boolean
      VAPM_RFRawWhlSpeedV_flg: implementation-data-type=boolean
      VAPM_RFRawWhlSpeedVTimeOut_flg: implementation-data-type=boolean
      VAPM_LRRawWhlSpeedV_flg: implementation-data-type=boolean
      VAPM_LRRawWhlSpeedVTimeOut_flg: implementation-data-type=boolean
      VAPM_RRRawWhlSpeedV_flg: implementation-data-type=boolean
      VAPM_RRRawWhlSpeedVTimeOut_flg: implementation-data-type=boolean
      VAPM_LFWhlRotDir_enum: implementation-data-type=uint8
      VAPM_LFWhlRotDirTimeOut_flg: implementation-data-type=boolean
      VAPM_RFWhlRotDir_enum: implementation-data-type=uint8
      VAPM_RFWhlRotDirTimeOut_flg: implementation-data-type=boolean
      VAPM_LRWhlRotDir_enum: implementation-data-type=uint8
      VAPM_LRWhlRotDirTimeOut_flg: implementation-data-type=boolean
      VAPM_RRWhlRotDir_enum: implementation-data-type=uint8
      VAPM_RRWhlRotDirTimeOut_flg: implementation-data-type=boolean
      VAPM_LFPulseCountV_flg: implementation-data-type=boolean
      VAPM_LFPulseCountVTimeOut_flg: implementation-data-type=boolean
      VAPM_RFPulseCountV_flg: implementation-data-type=boolean
      VAPM_RFPulseCountVTimeOut_flg: implementation-data-type=boolean
      VAPM_LRPulseCountV_flg: implementation-data-type=boolean
      VAPM_LRPulseCountVTimeOut_flg: implementation-data-type=boolean
      VAPM_RRPulseCountV_flg: implementation-data-type=boolean
      VAPM_RRPulseCountVTimeOut_flg: implementation-data-type=boolean
      VAPM_LFPulseCount_enum: implementation-data-type=uint8
      VAPM_LFPulseCountTimeOut_flg: implementation-data-type=boolean
      VAPM_RFPulseCount_enum: implementation-data-type=uint8
      VAPM_RFPulseCountTimeOut_flg: implementation-data-type=boolean
      VAPM_LRPulseCount_enum: implementation-data-type=uint8
      VAPM_LRPulseCountTimeOut_flg: implementation-data-type=boolean
      VAPM_RRPulseCount_enum: implementation-data-type=uint8
      VAPM_RRPulseCountTimeOut_flg: implementation-data-type=boolean
      VAPM_ShifterHandleCmd_enum: implementation-data-type=uint8
      VAPM_ShifterHandleCmdTimeOut_flg: implementation-data-type=boolean
      VAPM_DriIntend_enum: implementation-data-type=uint8
      VAPM_DriIntendTimeOut_flg: implementation-data-type=boolean
      VAPM_EPSAOIControl_enum: implementation-data-type=uint8
      VAPM_EPSAOIControlTimeOut_flg: implementation-data-type=boolean
      VAPM_SASAngle_Deg: implementation-data-type=float32
      VAPM_SASAngleTimeOut_flg: implementation-data-type=boolean
      VAPM_SASSpeed_degps: implementation-data-type=float32
      VAPM_SASSpeedTimeOut_flg: implementation-data-type=boolean
      VAPM_SASSpeedValid_flg: implementation-data-type=boolean
      VAPM_SASSpeedValidTimeOut_flg: implementation-data-type=boolean
      VAPM_SASCAL_flg: implementation-data-type=boolean
      VAPM_SASCALTimeOut_flg: implementation-data-type=boolean
      VAPM_SASV_flg: implementation-data-type=boolean
      VAPM_SASVTimeOut_flg: implementation-data-type=boolean
      VAPM_GRADE_Deg: implementation-data-type=float32
      VAPM_GRADETimeOut_flg: implementation-data-type=boolean
      VAPM_YawRate_degps: implementation-data-type=float32
      VAPM_YawRateTimeOut_flg: implementation-data-type=boolean
      VAPM_LatAccel_Gps: implementation-data-type=float32
      VAPM_LatAccelTimeOut_flg: implementation-data-type=boolean
      VAPM_LongAccel_Gps: implementation-data-type=float32
      VAPM_LongAccelTimeOut_flg: implementation-data-type=boolean
      VAPM_MCPressure_bar: implementation-data-type=float32
      VAPM_MCPressureTimeOut_flg: implementation-data-type=boolean
      VAPM_YawRateV_flg: implementation-data-type=boolean
      VAPM_YawRateVTimeOut_flg: implementation-data-type=boolean
      VAPM_LatAccelV_flg: implementation-data-type=boolean
      VAPM_LatAccelVTimeOut_flg: implementation-data-type=boolean
      VAPM_LongAccelV_flg: implementation-data-type=boolean
      VAPM_LongAccelVTimeOut_flg: implementation-data-type=boolean
      VAPM_MCPressureV_bar: implementation-data-type=boolean
      VAPM_MCPressureVTimeOut_flg: implementation-data-type=boolean
      VAPM_BrkSwSta_flg: implementation-data-type=boolean
      VAPM_BrkSwStaTimeOut_flg: implementation-data-type=boolean
      VAPM_BrkSwV_flg: implementation-data-type=boolean
      VAPM_BrkSwVTimeOut_flg: implementation-data-type=boolean
      VAPM_ESCStandstill_flg: implementation-data-type=boolean
      VAPM_ESCStandstillTimeOut_flg: implementation-data-type=boolean
      VAPM_ESCAPSSta_enum: implementation-data-type=uint8
      VAPM_ESCAPSStaTimeOut_flg: implementation-data-type=boolean
      VAPM_EPBExtReleaseAvail_flg: implementation-data-type=boolean
      VAPM_EPBExtReleaseAvailTimeOut_flg: implementation-data-type=boolean
      VAPM_EPBExtApplyAvail_flg: implementation-data-type=boolean
      VAPM_EPBExtApplyAvailTimeOut_flg: implementation-data-type=boolean
      VAPM_EPBErrSta_enum: implementation-data-type=uint8
      VAPM_EPBErrStaTimeOut_flg: implementation-data-type=boolean
      VAPM_EPBSta_enum: implementation-data-type=uint8
      VAPM_EPBStaTimeOut_flg: implementation-data-type=boolean
      VAPM_AVMparkingcancel_enum: implementation-data-type=uint8
      VAPM_AVMparkingcancelTimeOut_flg: implementation-data-type=boolean
      VAPM_AVMparkingexcute_enum: implementation-data-type=uint8
      VAPM_AVMparkingexcuteTimeOut_flg: implementation-data-type=boolean
      VAPM_AVMParkingmode_enum: implementation-data-type=uint8
      VAPM_AVMParkingmodeTimeOut_flg: implementation-data-type=boolean
      VAPM_AVMErrSTA_flg: implementation-data-type=boolean
      VAPM_AVMErrSTATimeOut_flg: implementation-data-type=boolean
      VAPM_IVIStatus_flg: implementation-data-type=boolean
      VAPM_IVIStatusTimeOut_flg: implementation-data-type=boolean
      VAPM_CAASSw_enum: implementation-data-type=uint8
      VAPM_CAASSwTimeOut_flg: implementation-data-type=boolean
      VAPM_IVIScreen_enum: implementation-data-type=uint8
      VAPM_IVIScreenTimeOut_flg: implementation-data-type=boolean
      VAPM_ABSActive_flg: implementation-data-type=boolean
      VAPM_ABSActiveTimeOut_flg: implementation-data-type=boolean
      VAPM_TCSActive_flg: implementation-data-type=boolean
      VAPM_TCSActiveTimeOut_flg: implementation-data-type=boolean
      VAPM_DriverSeatBeltCmd_flg: implementation-data-type=boolean
      VAPM_DriverSeatBeltCmdTimeOut_flg: implementation-data-type=boolean
      VAPM_APSProgressPCT_pct: implementation-data-type=float32
      VAPM_APSRQDisplay_enum: implementation-data-type=uint8
      VAPM_APSSWVer_enum: implementation-data-type=uint8
      VAPM_APSHWVer_enum: implementation-data-type=uint8
      VAPM_APSExitCondition_enum: implementation-data-type=uint8
      VAPM_APSAngleTarget_Deg: implementation-data-type=float32
      VAPM_APSVRqEPASCtrl_flg: implementation-data-type=boolean
      VAPM_APSRqEPASCtrl_flg: implementation-data-type=boolean
      VAPM_CAASSta_enum: implementation-data-type=uint8
      VAPM_DKCPDkeyAreaRAPSSta_enum: implementation-data-type=uint8
      VAPM_DKCParkingModeCmd_enum: implementation-data-type=uint8
      VAPM_PUIDLowPower_flg: implementation-data-type=boolean
      VAPM_CAASVMCReqA_flg: implementation-data-type=boolean
      VAPM_APSShiftPosnReq_enum: implementation-data-type=uint8
      VAPM_APSSpeedCMD_kph: implementation-data-type=float32
      VAPM_APSVMCReqA_flg: implementation-data-type=boolean
      VAPM_RAPSBCMLamp_enum: implementation-data-type=uint8
      VAPM_RAPSBCMLockReq_flg: implementation-data-type=boolean
      VAPM_APSPwrReq_enum: implementation-data-type=uint8
      VAPM_RAPSErrWarnSta_enum: implementation-data-type=uint8
      VAPM_RAPSErrLv1_flg: implementation-data-type=boolean
      VAPM_IVIUserTakeOverAPSSta_flg: implementation-data-type=boolean
package /Interface_APM_ARPkg
  sender receiver interface IF_BAPM_outputs
    data BAPM_outputs: type=BAPM_outputs
package /Impl_Type_BCM_ARPkg
  impl type BBCM_outputs: category=STRUCTURE
    185 x element, all with category=TYPE_REFERENCE:
      VBCM_AntitheftSta_enum: implementation-data-type=uint8
      VBCM_TailgateRemote_enum: implementation-data-type=uint8
      VBCM_HornCtrl_flg: implementation-data-type=boolean
      VBCM_AllDoorSW_flg: implementation-data-type=boolean
      VBCM_BCMDoorLockSta_flg: implementation-data-type=boolean
      VBCM_AntitheftSeatFlod_flg: implementation-data-type=boolean
      VBCM_HoodSW_flg: implementation-data-type=boolean
      VBCM_TailgateSW_flg: implementation-data-type=boolean
      VBCM_DrDoorSW_flg: implementation-data-type=boolean
      VBCM_PsDoorSW_flg: implementation-data-type=boolean
      VBCM_RLDoorSW_flg: implementation-data-type=boolean
      VBCM_RRDoorSW_flg: implementation-data-type=boolean
      VBCM_LockSetting_flg: implementation-data-type=boolean
      VBCM_FrChargingDoorCtrl_enum: implementation-data-type=uint8
      VBCM_RrChargingDoorCtrl_enum: implementation-data-type=uint8
      VBCM_CrashDetd_flg: implementation-data-type=boolean
      VBCM_CTDCtrl_enum: implementation-data-type=uint8
      VBCM_DoorLockIND_flg: implementation-data-type=boolean
      VBCM_CTDLockSW_flg: implementation-data-type=boolean
      VBCM_Dimmer_pct: implementation-data-type=float32
      VBCM_DimmerEN_flg: implementation-data-type=boolean
      VBCM_PosLamp_flg: implementation-data-type=boolean
      VBCM_LBeam_flg: implementation-data-type=boolean
      VBCM_HBeam_flg: implementation-data-type=boolean
      VBCM_RrFogLamp_flg: implementation-data-type=boolean
      VBCM_BrakeLamp_flg: implementation-data-type=boolean
      VBCM_ReverseLamp_flg: implementation-data-type=boolean
      VBCM_LDRL_flg: implementation-data-type=boolean
      VBCM_RDRL_flg: implementation-data-type=boolean
      VBCM_LBSD_flg: implementation-data-type=boolean
      VBCM_RBSD_flg: implementation-data-type=boolean
      VBCM_HazardSW_flg: implementation-data-type=boolean
      VBCM_LTurnLP_flg: implementation-data-type=boolean
      VBCM_RTurnLP_flg: implementation-data-type=boolean
      VBCM_BCMBuzzerReq_flg: implementation-data-type=boolean
      VBCM_MirrorCtrl_enum: implementation-data-type=uint8
      VBCM_MirrorDefog_flg: implementation-data-type=boolean
      VBCM_RrDefog_flg: implementation-data-type=boolean
      VBCM_RoomLampH_flg: implementation-data-type=boolean
      VBCM_RoomLampL_flg: implementation-data-type=boolean
      VBCM_TrunkRel_flg: implementation-data-type=boolean
      VBCM_TailgateHDSW_flg: implementation-data-type=boolean
      VBCM_FrWiperL_flg: implementation-data-type=boolean
      VBCM_FrWiperH_flg: implementation-data-type=boolean
      VBCM_RrWiper_flg: implementation-data-type=boolean
      VBCM_WasherCtrl_enum: implementation-data-type=uint8
      VBCM_WiperFixMode_flg: implementation-data-type=boolean
      VBCM_SleepReq_flg: implementation-data-type=boolean
      VBCM_AmbLightBreath{1..6}_enum: implementation-data-type=uint8
      VBCM_AmbLightBrightness{1..6}_enum: implementation-data-type=uint8
      VBCM_AmbLightColor{1..6}_enum: implementation-data-type=uint8
      VBCM_LampPwr_flg: implementation-data-type=boolean
      VBCM_SPTGDet_flg: implementation-data-type=boolean
      VBCM_APSOpenPTG_flg: implementation-data-type=boolean
      VBCM_FollowMe_flg: implementation-data-type=boolean
      VBCM_IVIRST_flg: implementation-data-type=boolean
      VBCM_CountAlarm_enum: implementation-data-type=uint8
      VBCM_MFSWTri_flg: implementation-data-type=boolean
      VBCM_MirrorFlodPos_flg: implementation-data-type=boolean
      VBCM_FuelDoorPos_flg: implementation-data-type=boolean
      VBCM_MFRDNBrightReq_pct: implementation-data-type=uint8
      VBCM_PTGInnerSW2_enum: implementation-data-type=uint8
      VBCM_DiagHCrash_flg: implementation-data-type=boolean
      VBCM_DiagFLTS_flg: implementation-data-type=boolean
      VBCM_DiagFRTS_flg: implementation-data-type=boolean
      VBCM_DiagRLTS_flg: implementation-data-type=boolean
      VBCM_DiagRRTS_flg: implementation-data-type=boolean
      VBCM_DrvWdwCtrlCmd_pct: implementation-data-type=uint8
      VBCM_PasWdwCtrlCmd_pct: implementation-data-type=uint8
      VBCM_DrRWdwCtrlCmd_pct: implementation-data-type=uint8
      VBCM_PsRWdwCtrlCmd_pct: implementation-data-type=uint8
      VBCM_APMDoorControlSta_flg: implementation-data-type=boolean
      VBCM_AmbFunEN_flg: implementation-data-type=boolean
      VBCM_AmbWelEN_flg: implementation-data-type=boolean
      VBCM_AmbDimEN_flg: implementation-data-type=boolean
      VBCM_AmbLinkDriSta_flg: implementation-data-type=boolean
      VBCM_AmbPwrWarnEN_flg: implementation-data-type=boolean
      VBCM_AmbODAEN_flg: implementation-data-type=boolean
      VBCM_AmbColorSta_enum: implementation-data-type=uint8
      VBCM_AmbBrightSta_enum: implementation-data-type=uint8
      VBCM_LockAlarm_enum: implementation-data-type=uint8
      VBCM_ATCtrl_enum: implementation-data-type=uint8
      VBCM_fUnlockSingle_flg: implementation-data-type=boolean
      VBCM_UserNow_enum: implementation-data-type=uint8
      VBCM_AmbFunENFlash_enum: implementation-data-type=uint8
      VBCM_AmbWelENFlash_enum: implementation-data-type=uint8
      VBCM_AmbDimENFlash_enum: implementation-data-type=uint8
      VBCM_AmbLinkDriStaFlash_enum: implementation-data-type=uint8
      VBCM_AmbPwrWarnENFlash_enum: implementation-data-type=uint8
      VBCM_AmbODAENFlash_enum: implementation-data-type=uint8
      VBCM_AmbColorSta{1..5}_enum: implementation-data-type=uint8
      VBCM_AmbColorSta7_enum: implementation-data-type=uint8
      VBCM_AmbBrightnessSta{1..5}_enum: implementation-data-type=uint8
      VBCM_AmbBrightnessSta7_enum: implementation-data-type=uint8
      VBCM_HazardIND_flg: implementation-data-type=boolean
      VBCM_DimSwSta_flg: implementation-data-type=boolean
      VBCM_PassSWSta_flg: implementation-data-type=boolean
      VBCM_FWipSwSta_enum: implementation-data-type=uint8
      VBCM_FWasSwSta_enum: implementation-data-type=uint8
      VBCM_TurnSwSta_enum: implementation-data-type=uint8
      VBCM_TurnSwTSetSta_enum: implementation-data-type=uint8
      VBCM_SPTGENFun_flg: implementation-data-type=boolean
      VBCM_SPTGENFunMem_enum: implementation-data-type=uint8
      VBCM_OutMode_enum: implementation-data-type=uint8
      VBCM_TurnSwTimeSetSta123_enum: implementation-data-type=uint8
      VBCM_TurnSwTimeSetSta457_enum: implementation-data-type=uint8
      VBCM_FDLHandleLampCmd_flg: implementation-data-type=boolean
      VBCM_FDRHandleLampCmd_flg: implementation-data-type=boolean
      VBCM_FDHandleCmd_enum: implementation-data-type=uint8
      VBCM_HBeamADB_enum: implementation-data-type=uint8
      VBCM_WalkInUnLkENMem_enum: implementation-data-type=uint8
      VBCM_WalkOutLkENMem_enum: implementation-data-type=uint8
      VBCM_RmLpModeENMem_enum: implementation-data-type=uint8
      VBCM_LockSettingStaMem_enum: implementation-data-type=uint8
      VBCM_FollowMeENMem_enum: implementation-data-type=uint8
      VBCM_WalkInUnLkENFunSta_flg: implementation-data-type=boolean
      VBCM_WalkOutLkENFunSta_flg: implementation-data-type=boolean
      VBCM_RmLpModeENFunSta_flg: implementation-data-type=boolean
      VBCM_FollowMeENFunSta_flg: implementation-data-type=boolean
      VBCM_HoodRelCmd_flg: implementation-data-type=boolean
      VBCM_WelcomeLight_enum: implementation-data-type=uint8
      VBCM_PTGOpenHeightSta_enum: implementation-data-type=uint8
      VBCM_UserHeightSet_cnt: implementation-data-type=uint16
      VBCM_PTGUserHeight{1..5}_cnt: implementation-data-type=uint16
      VBCM_PTGUserHeight7_cnt: implementation-data-type=uint16
      VBCM_PTGOpenHeight12_enum: implementation-data-type=uint8
      VBCM_PTGOpenHeight34_enum: implementation-data-type=uint8
      VBCM_PTGOpenHeight57_enum: implementation-data-type=uint8
      VBCM_SenstivityPosnCmd_enum: implementation-data-type=uint8
      VBCM_TimeGapLevelSta_enum: implementation-data-type=uint8
      VBCM_ACCLevelMem12_enum: implementation-data-type=uint8
      VBCM_ACCLevelMem34_enum: implementation-data-type=uint8
      VBCM_ACCLevelMem57_enum: implementation-data-type=uint8
      VBCM_LRightStaCmd_flg: implementation-data-type=boolean
      VBCM_LLeftStaCmd_flg: implementation-data-type=boolean
      VBCM_AutoLockSta_flg: implementation-data-type=boolean
      VBCM_AutoLockMem_enum: implementation-data-type=uint8
      VBCM_AutoUnlockSta_flg: implementation-data-type=boolean
      VBCM_AutoUnlockMem_enum: implementation-data-type=uint8
      VBCM_HMIKey{1..8}FuncSta_enum: implementation-data-type=uint8
      VBCM_AutoWipHSpdENSta_flg: implementation-data-type=boolean
      VBCM_DrvWdwReqAP_enum: implementation-data-type=uint8
      VBCM_PasWdwReqAP_enum: implementation-data-type=uint8
      VBCM_DrRWdwReqAP_enum: implementation-data-type=uint8
      VBCM_PsRWdwReqAP_enum: implementation-data-type=uint8
      VBCM_CLWinLockDrSta_flg: implementation-data-type=boolean
      VBCM_CLWinLockDrStaMem_enum: implementation-data-type=uint8
      VBCM_WinLFOpenedSta_pct: implementation-data-type=uint8
      VBCM_WinRFOpenedSta_pct: implementation-data-type=uint8
      VBCM_WinLROpenedSta_pct: implementation-data-type=uint8
      VBCM_WinRROpenedSta_pct: implementation-data-type=uint8
package /Interface_BCM_ARPkg
  sender receiver interface IF_BBCM_outputs
    data BBCM_outputs: type=BBCM_outputs
package /Impl_Type_DDM_ARPkg
  impl type BDDM_outputs: category=STRUCTURE
    198 x element, all with category=TYPE_REFERENCE:
      VDDM_C3BMS6RCDTC_raw32: implementation-data-type=uint32
      VDDM_C3BMS6CSDTC_raw32: implementation-data-type=uint32
      VDDM_C3BMS6LCDTC_raw32: implementation-data-type=uint32
      VDDM_C3BMS1RCDTC_raw32: implementation-data-type=uint32
      VDDM_C3BMS1CSDTC_raw32: implementation-data-type=uint32
      VDDM_C3BMS1LCDTC_raw32: implementation-data-type=uint32
      VDDM_C3CCU1RCDTC_raw32: implementation-data-type=uint32
      VDDM_C3CCU1CSDTC_raw32: implementation-data-type=uint32
      VDDM_C3CCU1LCDTC_raw32: implementation-data-type=uint32
      VDDM_C3CCU2RCDTC_raw32: implementation-data-type=uint32
      VDDM_C3CCU2CSDTC_raw32: implementation-data-type=uint32
      VDDM_C3CCU2LCDTC_raw32: implementation-data-type=uint32
      VDDM_C1ABM1RCDTC_raw32: implementation-data-type=uint32
      VDDM_C1ABM1CSDTC_raw32: implementation-data-type=uint32
      VDDM_C1ABM1LCDTC_raw32: implementation-data-type=uint32
      VDDM_Lv{1..4}ErrDTC_raw32: implementation-data-type=uint32
      VDDM_BrkSWErrDTC_raw32: implementation-data-type=uint32
      VDDM_BrkSWNoBacDTC_raw32: implementation-data-type=uint32
      VDDM_KeyAuthDTC_raw32: implementation-data-type=uint32
      VDDM_ONtoRdyDTC_raw32: implementation-data-type=uint32
      VDDM_HVB4PreDTC_raw32: implementation-data-type=uint32
      VDDM_MCU4PreDTC_raw32: implementation-data-type=uint32
      VDDM_DCDC4PreDTC_raw32: implementation-data-type=uint32
      VDDM_HVRlyCloDTC_raw32: implementation-data-type=uint32
      VDDM_BMSRdyDTC_raw32: implementation-data-type=uint32
      VDDM_DCDCEnaDTC_raw32: implementation-data-type=uint32
      VDDM_HiLvSaChkDTC_raw32: implementation-data-type=uint32
      VDDM_MidLvSaChkDTC_raw32: implementation-data-type=uint32
      VDDM_MCUDisDTC_raw32: implementation-data-type=uint32
      VDDM_DCDCDisDTC_raw32: implementation-data-type=uint32
      VDDM_HVRlyOpDTC_raw32: implementation-data-type=uint32
      VDDM_MCUActDTC_raw32: implementation-data-type=uint32
      VDDM_OBC4PreDTC_raw32: implementation-data-type=uint32
      VDDM_IniLVLoDTC_raw32: implementation-data-type=uint32
      VDDM_LVSupLoDTC_raw32: implementation-data-type=uint32
      VDDM_LVSupHiDTC_raw32: implementation-data-type=uint32
      VDDM_LVInErrDTC_raw32: implementation-data-type=uint32
      VDDM_DrStSWDTC_raw32: implementation-data-type=uint32
      VDDM_FLDoorSWDTC_raw32: implementation-data-type=uint32
      VDDM_RLDoorSWDTC_raw32: implementation-data-type=uint32
      VDDM_FRDoorSWDTC_raw32: implementation-data-type=uint32
      VDDM_RRDoorSWDTC_raw32: implementation-data-type=uint32
      VDDM_HoodSWDTC_raw32: implementation-data-type=uint32
      VDDM_TailgaSWDTC_raw32: implementation-data-type=uint32
      VDDM_EDriveSysErrVCUErr_flg: implementation-data-type=boolean
      VDDM_VehMalfunLevel_enum: implementation-data-type=uint8
      VDDM_APS1SigOoRDTC_raw32: implementation-data-type=uint32
      VDDM_APS2SigOoRDTC_raw32: implementation-data-type=uint32
      VDDM_APSCorrErrDTC_raw32: implementation-data-type=uint32
      VDDM_MCUF1NoComDTC_raw32: implementation-data-type=uint32
      VDDM_MCUR1NoComDTC_raw32: implementation-data-type=uint32
      VDDM_Shifter1NoComDTC_raw32: implementation-data-type=uint32
      VDDM_ESC7NoComDTC_raw32: implementation-data-type=uint32
      VDDM_ESC1NoComDTC_raw32: implementation-data-type=uint32
      VDDM_ESC5NoComDTC_raw32: implementation-data-type=uint32
      VDDM_EnterNewOperCyc_flg: implementation-data-type=boolean
      VDDM_DiagHCrashDTC_raw32: implementation-data-type=uint32
      VDDM_DiagFLTSDTC_raw32: implementation-data-type=uint32
      VDDM_DiagFRTSDTC_raw32: implementation-data-type=uint32
      VDDM_DiagRLTSDTC_raw32: implementation-data-type=uint32
      VDDM_DiagRRTSDTC_raw32: implementation-data-type=uint32
      VDDM_FCLUSSDTC_raw32: implementation-data-type=uint32
      VDDM_FMLUSSDTC_raw32: implementation-data-type=uint32
      VDDM_FMRUSSDTC_raw32: implementation-data-type=uint32
      VDDM_FCRUSSDTC_raw32: implementation-data-type=uint32
      VDDM_RCLUSSDTC_raw32: implementation-data-type=uint32
      VDDM_RMLUSSDTC_raw32: implementation-data-type=uint32
      VDDM_RMRUSSDTC_raw32: implementation-data-type=uint32
      VDDM_RCRUSSDTC_raw32: implementation-data-type=uint32
      VDDM_FLLUSSDTC_raw32: implementation-data-type=uint32
      VDDM_FLRUSSDTC_raw32: implementation-data-type=uint32
      VDDM_RLLUSSDTC_raw32: implementation-data-type=uint32
      VDDM_RLRUSSDTC_raw32: implementation-data-type=uint32
      VDDM_FCM2NoComDTC_raw32: implementation-data-type=uint32
      VDDM_FCM2RCErrDTC_raw32: implementation-data-type=uint32
      VDDM_FCM2CSErrDTC_raw32: implementation-data-type=uint32
      VDDM_FCM3NoComDTC_raw32: implementation-data-type=uint32
      VDDM_FCM3RCErrDTC_raw32: implementation-data-type=uint32
      VDDM_FCM3CSErrDTC_raw32: implementation-data-type=uint32
      VDDM_FCM4NoComDTC_raw32: implementation-data-type=uint32
      VDDM_FCM4CSErrDTC_raw32: implementation-data-type=uint32
      VDDM_FCM5NoComDTC_raw32: implementation-data-type=uint32
      VDDM_FCM5CSErrDTC_raw32: implementation-data-type=uint32
      VDDM_ZoneSCPNoComDTC_raw32: implementation-data-type=uint32
      VDDM_BMSSigErrDetDTC_raw32: implementation-data-type=uint32
      VDDM_FCMACCSigErrDetDTC_raw32: implementation-data-type=uint32
      VDDM_FrMCUSigErrDetDTC_raw32: implementation-data-type=uint32
      VDDM_RrMCUSigErrDetDTC_raw32: implementation-data-type=uint32
      VDDM_CCUSigErrDetDTC_raw32: implementation-data-type=uint32
      VDDM_ACCAccelCmdErrDetDTC_raw32: implementation-data-type=uint32
      VDDM_ACCMalfuncDetDTC_raw32: implementation-data-type=uint32
      VDDM_CCMalfuncDetDTC_raw32: implementation-data-type=uint32
      VDDM_MSAMalfuncDetDTC_raw32: implementation-data-type=uint32
      VDDM_ISAMalfuncDetDTC_raw32: implementation-data-type=uint32
      VDDM_MCUF1RCErrDTC_raw32: implementation-data-type=uint32
      VDDM_MCUR1RCErrDTC_raw32: implementation-data-type=uint32
      VDDM_MCUF1CSErrDTC_raw32: implementation-data-type=uint32
      VDDM_MCUR1CSErrDTC_raw32: implementation-data-type=uint32
      VDDM_Shifter1RCErrDTC_raw32: implementation-data-type=uint32
      VDDM_Shifter1CSErrDTC_raw32: implementation-data-type=uint32
      VDDM_ESC7RCErrDTC_raw32: implementation-data-type=uint32
      VDDM_ESC7CSErrDTC_raw32: implementation-data-type=uint32
      VDDM_ESC1RCErrDTC_raw32: implementation-data-type=uint32
      VDDM_ESC1CSErrDTC_raw32: implementation-data-type=uint32
      VDDM_ESC5RCErrDTC_raw32: implementation-data-type=uint32
      VDDM_ESC5CSErrDTC_raw32: implementation-data-type=uint32
      VDDM_FrMCUTqErrDTC_raw32: implementation-data-type=uint32
      VDDM_RrMCUTqErrDTC_raw32: implementation-data-type=uint32
      VDDM_LFBatwarnDTC_raw32: implementation-data-type=uint32
      VDDM_RFBatwarnDTC_raw32: implementation-data-type=uint32
      VDDM_LRBatwarnDTC_raw32: implementation-data-type=uint32
      VDDM_RRBatwarnDTC_raw32: implementation-data-type=uint32
      VDDM_LFPressIndiDTC_raw32: implementation-data-type=uint32
      VDDM_RFPressIndiDTC_raw32: implementation-data-type=uint32
      VDDM_LRPressIndiDTC_raw32: implementation-data-type=uint32
      VDDM_RRPressIndiDTC_raw32: implementation-data-type=uint32
      VDDM_LFWheelTmpHighDTC_raw32: implementation-data-type=uint32
      VDDM_RFWheelTmpHighDTC_raw32: implementation-data-type=uint32
      VDDM_LRWheelTmpHighDTC_raw32: implementation-data-type=uint32
      VDDM_RRWheelTmpHighDTC_raw32: implementation-data-type=uint32
      VDDM_LFSensorFailDTC_raw32: implementation-data-type=uint32
      VDDM_RFSensorFailDTC_raw32: implementation-data-type=uint32
      VDDM_LRSensorFailDTC_raw32: implementation-data-type=uint32
      VDDM_RRSensorFailDTC_raw32: implementation-data-type=uint32
      VDDM_C1EPAS2LCDTC_raw32: implementation-data-type=uint32
      VDDM_5vAPS1PwrErrDTC_raw32: implementation-data-type=uint32
      VDDM_5vAPS2PwrErrDTC_raw32: implementation-data-type=uint32
      VDDM_EPBLockTODTC_raw32: implementation-data-type=uint32
      VDDM_EPBUnlockTODTC_raw32: implementation-data-type=uint32
      VDDM_LimpHomeAct_flg: implementation-data-type=boolean
      VDDM_EDriveSysErr_VCUErrTmp_flg: implementation-data-type=boolean
      VDDM_EPB1NoComDTC_raw32: implementation-data-type=uint32
      VDDM_EPB1RCErrDTC_raw32: implementation-data-type=uint32
      VDDM_EPB1CSErrDTC_raw32: implementation-data-type=uint32
      VDDM_EPBSigErrDTC_raw32: implementation-data-type=uint32
      VDDM_FCM1NoComDTC_raw32: implementation-data-type=uint32
      VDDM_FCM1RCErrDTC_raw32: implementation-data-type=uint32
      VDDM_FCM1CSErrDTC_raw32: implementation-data-type=uint32
      VDDM_ESCSigErrDetDTC_raw32: implementation-data-type=uint32
      VDDM_ShifterSigErrDetDTC_raw32: implementation-data-type=uint32
      VDDM_DrVCUNoComDTC_raw32: implementation-data-type=uint32
      VDDM_FrVCUNoComDTC_raw32: implementation-data-type=uint32
      VDDM_ZoneDrSigErrDetDTC_raw32: implementation-data-type=uint32
      VDDM_ZoneFrSigErrDetDTC_raw32: implementation-data-type=uint32
      VDDM_EPS1NoComDTC_raw32: implementation-data-type=uint32
      VDDM_EPS1RCErrDTC_raw32: implementation-data-type=uint32
      VDDM_EPS1CSErrDTC_raw32: implementation-data-type=uint32
      VDDM_EPSSigErrDTC_raw32: implementation-data-type=uint32
      VDDM_DTCDetect_enum: implementation-data-type=uint8
      VDDM_EngagePFail_flg: implementation-data-type=boolean
      VDDM_DisengagePFail_flg: implementation-data-type=boolean
      VDDM_VCURAPSErrLv2_flg: implementation-data-type=boolean
      VDDM_VCURAPSErrLv3_flg: implementation-data-type=boolean
      VDDM_EDriveSysErrShifterErr_flg: implementation-data-type=boolean
      VDDM_PMMBattErr_flg: implementation-data-type=boolean
      VDDM_LVSysErrPwrOutErr_flg: implementation-data-type=boolean
      VDDM_HVRlyOpFail_flg: implementation-data-type=boolean
      VDDM_MCUActDisFail_flg: implementation-data-type=boolean
      VDDM_VCUBrkSWSta_enum: implementation-data-type=uint8
      VDDM_VCUFLDoorSta_flg: implementation-data-type=boolean
      VDDM_VCUFRDoorSta_flg: implementation-data-type=boolean
      VDDM_VCURLDoorSta_flg: implementation-data-type=boolean
      VDDM_VCURRDoorSta_flg: implementation-data-type=boolean
      VDDM_SysAllowReadySta_flg: implementation-data-type=boolean
      VDDM_VCUHoodSWSta_flg: implementation-data-type=boolean
      VDDM_VCUTailgateSWSta_flg: implementation-data-type=boolean
      VDDM_DrStSWCFS_flg: implementation-data-type=boolean
      VDDM_EPB1Err_flg: implementation-data-type=boolean
      VDDM_ESC1Err_flg: implementation-data-type=boolean
      VDDM_ESC5Err_flg: implementation-data-type=boolean
      VDDM_EPBSigErrCFS_flg: implementation-data-type=boolean
      VDDM_CAN{1..6}BusErrorDTC_raw32: implementation-data-type=uint32
      VDDM_FrMCU4PreDTC_raw32: implementation-data-type=uint32
      VDDM_FrMCUDisDTC_raw32: implementation-data-type=uint32
      VDDM_FrMCUActDTC_raw32: implementation-data-type=uint32
      VDDM_RegenErrCFS_flg: implementation-data-type=boolean
      VDDM_RegenErrDTC_raw32: implementation-data-type=uint32
      VDDM_Shifter1Err_flg: implementation-data-type=boolean
      VDDM_ShifterSigErrCFS_flg: implementation-data-type=boolean
      VDDM_MCUF1Err_flg: implementation-data-type=boolean
      VDDM_MCUR1Err_flg: implementation-data-type=boolean
      VDDM_BrkSWNoBacCFS_flg: implementation-data-type=boolean
      VDDM_4D2CErr_flg: implementation-data-type=boolean
      VDDM_5vAPS1OoRCFS_flg: implementation-data-type=boolean
      VDDM_5vAPS2OoRCFS_flg: implementation-data-type=boolean
      VDDM_APS1SigOoRCFS_flg: implementation-data-type=boolean
      VDDM_APS2SigOoRCFS_flg: implementation-data-type=boolean
      VDDM_APSCorrErrCFS_flg: implementation-data-type=boolean
      VDDM_SystemPowerUpErr_flg: implementation-data-type=boolean
      VDDM_SystemPowerDownErr_flg: implementation-data-type=boolean
package /Interface_DDM_ARPkg
  sender receiver interface IF_BDDM_outputs
    data BDDM_outputs: type=BDDM_outputs
package /Impl_Type_DHP_ARPkg
  impl type BDHP_outputs: category=STRUCTURE
    14 x element, all with category=TYPE_REFERENCE:
      VDHP_ActAPSPosn_pct: implementation-data-type=float32
      VDHP_LowIdleAccPedal_flg: implementation-data-type=boolean
      VDHP_AccPedalSWSta_flg: implementation-data-type=boolean
      VDHP_EAPS12RangeSta_enum: implementation-data-type=uint8
      VDHP_EAPCRBAD_flg: implementation-data-type=boolean
      VDHP_EAPS1MIN_pct: implementation-data-type=float32
      VDHP_EAPS2MIN_pct: implementation-data-type=float32
      VDHP_ResetPedalZeroPosStart_flg: implementation-data-type=boolean
      VDHP_EAPS1NRM_pct: implementation-data-type=float32
      VDHP_EAPS2NRM_pct: implementation-data-type=float32
      VDHP_EAPS1BAD_flg: implementation-data-type=boolean
      VDHP_EAPS2BAD_flg: implementation-data-type=boolean
      VDHP_EAPS1RAW_pct: implementation-data-type=float32
      VDHP_EAPS2RAW_pct: implementation-data-type=float32
package /Interface_DHP_ARPkg
  sender receiver interface IF_BDHP_outputs
    data BDHP_outputs: type=BDHP_outputs
package /Impl_Type_DID_ARPkg
  impl type BDID_outputs: category=STRUCTURE
    29 x element, all with category=TYPE_REFERENCE:
      VDID_VSS_kph: implementation-data-type=float32
      VDID_RUNTM_s: implementation-data-type=uint16
      VDID_MILDIST_km: implementation-data-type=float32
      VDID_CLRDIST_km: implementation-data-type=float32
      VDID_APPD_pct: implementation-data-type=float32
      VDID_APPE_pct: implementation-data-type=float32
      VDID_ODOMETER_km: implementation-data-type=float32
      VDID_NUMPSATRIPSFLTMEMCLR_cnt: implementation-data-type=uint16
      VDID_PSAR_sec: implementation-data-type=uint32
      VDID_PSAL_sec: implementation-data-type=uint32
      VDID_IPSAR_sec: implementation-data-type=uint32
      VDID_IPSAL_sec: implementation-data-type=uint32
      VDID_CPSAR_sec: implementation-data-type=uint32
      VDID_CPSAL_sec: implementation-data-type=uint32
      VDID_PKER_kphsqr: implementation-data-type=float32
      VDID_PKEL_kphsqr: implementation-data-type=float32
      VDID_ResetCDEODTR_km: implementation-data-type=float32
      VDID_CDEODTR_km: implementation-data-type=float32
      VDID_CDEODTL_km: implementation-data-type=float32
      VDID_QTYPSATRIPSR_cnt: implementation-data-type=uint32
      VDID_QTYPSATRIPSL_cnt: implementation-data-type=uint32
      VDID_PROTOCOLID_enum: implementation-data-type=uint8
      VDID_CALID_cnt: implementation-data-type=u8_Array16_type
      VDID_ECUNAME_cnt: implementation-data-type=u8_Array20_type
      VDID_PKERNumerator_kphsqr: implementation-data-type=float32
      VDID_PKELNumerator_kphsqr: implementation-data-type=float32
      VDID_VinCode_cnt: implementation-data-type=u8_Array17_type
      VDID_DIDModelVersion_raw: implementation-data-type=uint8
      VDID_DIDModelVersionChksum_raw: implementation-data-type=uint8
package /Interface_DID_ARPkg
  sender receiver interface IF_BDID_outputs
    data BDID_outputs: type=BDID_outputs
package /Impl_Type_DKC_ARPkg
  impl type BDKC_outputs: category=STRUCTURE
    50 x element, all with category=TYPE_REFERENCE:
      VDKC_DKCTimeSN_cnt: implementation-data-type=uint32
      VDKC_DKCAuthSta_enum: implementation-data-type=uint8
      VDKC_TimeSNDKCFbk_cnt: implementation-data-type=uint32
      VDKC_PCommandToBCM_enum: implementation-data-type=uint8
      VDKC_KeyAreaLockUnlock_enum: implementation-data-type=uint8
      VDKC_KeyMissSta_flg: implementation-data-type=boolean
      VDKC_ShippingMode_flg: implementation-data-type=boolean
      VDKC_KeyNumSta_enum: implementation-data-type=uint8
      VDKC_DkeyShowIVISta_enum: implementation-data-type=uint8
      VDKC_DkeyAreaRAPSSta_enum: implementation-data-type=uint8
      VDKC_KeyAreaPS_enum: implementation-data-type=uint8
      VDKC_KeyAreaSPTGSta_enum: implementation-data-type=uint8
      VDKC_KeyAreaPTG_enum: implementation-data-type=uint8
      VDKC_UWB4Invalid_flg: implementation-data-type=uint8
      VDKC_UWBOnOff_flg: implementation-data-type=boolean
      VDKC_UWB3Invalid_flg: implementation-data-type=uint8
      VDKC_UWB1Invalid_flg: implementation-data-type=uint8
      VDKC_UWB2Invalid_flg: implementation-data-type=uint8
      VDKC_UWB0Invalid_flg: implementation-data-type=uint8
      VDKC_UIDBatVolt_enum: implementation-data-type=uint16
      VDKC_CoordinateX_enum: implementation-data-type=sint16
      VDKC_FDCSPTGDet_flg: implementation-data-type=boolean
      VDKC_FDCSPTGOpen_flg: implementation-data-type=boolean
      VDKC_UIDLowPowerSta_flg: implementation-data-type=boolean
      VDKC_CoordinateY_enum: implementation-data-type=sint16
      VDKC_AllowSleep_flg: implementation-data-type=boolean
      VDKC_KeyTypeSta_enum: implementation-data-type=uint8
      VDKC_CalDistance_enum: implementation-data-type=uint8
      VDKC_UWBDetPTGArea_enum: implementation-data-type=uint8
      VDKC_A0UWBEvent_enum: implementation-data-type=uint8
      VDKC_ParkingModeCmd_enum: implementation-data-type=uint8
      VDKC_KeyModeSta_enum: implementation-data-type=uint8
      VDKC_ReVehData_enum: implementation-data-type=uint8
      VDKC_UWB0Distance_enum: implementation-data-type=uint16
      VDKC_DKeyWelcomeSta_enum: implementation-data-type=uint8
      VDKC_UWB{1..4}Distance_enum: implementation-data-type=uint16
      VDKC_BLERSSI_enum: implementation-data-type=uint8
      VDKC_BLEdcEvent_enum: implementation-data-type=uint8
      VDKC_UWB{0..4}FPP_enum: implementation-data-type=sint16
      VDKC_UWBDetArea_enum: implementation-data-type=uint8
      VDKC_OutputPCMDModule_enum: implementation-data-type=uint8
      VDKC_FDCDKCAllowSleep_flg: implementation-data-type=boolean
      VDKC_JudgeKeepUnlockZone_flg: implementation-data-type=boolean
package /Interface_DKC_ARPkg
  sender receiver interface IF_BDKC_outputs
    data BDKC_outputs: type=BDKC_outputs
package /Impl_Type_DSC_ARPkg
  impl type BDSC_outputs: category=STRUCTURE
    4 x element, all with category=TYPE_REFERENCE:
      VDSC_DISCTurn_flg: implementation-data-type=boolean
      VDSC_DISCTargetSpd_kph: implementation-data-type=float32
      VDSC_DISCSta_enum: implementation-data-type=uint8
      VDSC_DISCButtSta_flg: implementation-data-type=boolean
package /Interface_DSC_ARPkg
  sender receiver interface IF_BDSC_outputs
    data BDSC_outputs: type=BDSC_outputs
package /Impl_Type_NMM_ARPkg
  impl type BNMM_outputs: category=STRUCTURE
    13 x element, all with category=TYPE_REFERENCE:
      VNMM_AllCANTxReq_flg: implementation-data-type=boolean
      VNMM_NMmTxReq_flg: implementation-data-type=boolean
      VNMM_Awake_enum: implementation-data-type=uint8
      VNMM_CSB_flg: implementation-data-type=boolean
      VNMM_ErrorState_enum: implementation-data-type=uint8
      VNMM_NodeID_enum: implementation-data-type=uint8
      VNMM_PNI_flg: implementation-data-type=boolean
      VNMM_RptMsgReq_flg: implementation-data-type=boolean
      VNMM_WakeUp_enum: implementation-data-type=uint8
      VNMM_ActiveWU_flg: implementation-data-type=boolean
      VNMM_SysNMmSta_enum: implementation-data-type=uint8
      VNMM_NetworkReq_flg: implementation-data-type=boolean
      VNMM_NetworkReqCalled_flg: implementation-data-type=boolean
package /Interface_NMM_ARPkg
  sender receiver interface IF_BNMM_outputs
    data BNMM_outputs: type=BNMM_outputs
package /Impl_Type_PMM_ARPkg
  impl type BPMM_outputs: category=STRUCTURE
    56 x element, all with category=TYPE_REFERENCE:
      VPMM_PowerUpState_enum: implementation-data-type=uint8
      VPMM_PowerDownState_enum: implementation-data-type=uint8
      VPMM_PowerUpFault_enum: implementation-data-type=uint8
      VPMM_PowerDownFault_enum: implementation-data-type=uint8
      VPMM_ActiveDischargeReq_flg: implementation-data-type=boolean
      VPMM_DCDCEnaReq_flg: implementation-data-type=boolean
      VPMM_DCDCVoltSetpoint_V: implementation-data-type=float32
      VPMM_HVBatCnctReq_flg: implementation-data-type=boolean
      VPMM_HVSysReadyToCharge_enum: implementation-data-type=uint8
      VPMM_PowerSta_enum: implementation-data-type=uint8
      VPMM_LVPwrSta_flg: implementation-data-type=boolean
      VPMM_HVPwrSta_flg: implementation-data-type=boolean
      VPMM_SysPowerMode_enum: implementation-data-type=uint8
      VPMM_FrMCUEnaReq_flg: implementation-data-type=boolean
      VPMM_RrMCUEnaReq_flg: implementation-data-type=boolean
      VPMM_DrivetrainSelect_enum: implementation-data-type=uint8
      VPMM_DrSeatSta_enum: implementation-data-type=uint8
      VPMM_PwrStaSelect_enum: implementation-data-type=uint8
      VPMM_PwrStaConstraint_enum: implementation-data-type=uint8
      VPMM_TCountSta_enum: implementation-data-type=uint8
      VPMM_PwrUpReq_enum: implementation-data-type=uint8
      VPMM_PwrDownReq_enum: implementation-data-type=uint8
      VPMM_LowSOCWarn_enum: implementation-data-type=uint8
      VPMM_ReVehThdChkSta_enum: implementation-data-type=uint8
      VPMM_EvccAplusPwrUpReq_flg: implementation-data-type=boolean
      VPMM_PwrStaONTOPopReq_flg: implementation-data-type=boolean
      VPMM_IVIPwrStaONTOPopT_s: implementation-data-type=float32
      VPMM_LVChrgHoldTtimer_s: implementation-data-type=float32
      VPMM_LVBattChrgTimeCnt_s: implementation-data-type=float32
      VPMM_SilentChkAllowSleep_flg: implementation-data-type=boolean
      VPMM_TimerAllowSleep_flg: implementation-data-type=boolean
      VPMM_FDADC12VDetAvg_mV: implementation-data-type=float32
      VPMM_PMMAllowECUSleep_flg: implementation-data-type=boolean
      VPMM_LVSilentChrgSta_enum: implementation-data-type=uint8
      VPMM_LVSilentChrgReq_flg: implementation-data-type=boolean
      VPMM_LVSilentChrgLv_enum: implementation-data-type=uint8
      VPMM_LVBattChktime_s: implementation-data-type=float32
      VPMM_SafetyChkMLv_flg: implementation-data-type=boolean
      VPMM_SafetyChkHLv_flg: implementation-data-type=boolean
      VPMM_HVChrgPreActionErrSta_enum: implementation-data-type=uint8
      VPMM_MCUReady_flg: implementation-data-type=boolean
      VPMM_MCUReady4Pre_flg: implementation-data-type=boolean
      VPMM_CtrlFrPwrStbA1P_flg: implementation-data-type=boolean
      VPMM_CtrlFrRC1_flg: implementation-data-type=boolean
      VPMM_CtrlFrBMSCCUCIR_flg: implementation-data-type=boolean
      VPMM_CtrlFrEDUINVERTER_flg: implementation-data-type=boolean
      VPMM_HWResetSta_enum: implementation-data-type=uint8
      VPMM_CtrlDrPwrStbA2_flg: implementation-data-type=boolean
      VPMM_PwrStaTOSta_enum: implementation-data-type=uint8
      VPMM_PMMAllowNMSleep_flg: implementation-data-type=boolean
      VPMM_Sched_ChgTOSta_enum: implementation-data-type=uint8
      VPMM_PwrReq_OTA_enum: implementation-data-type=uint8
      VPMM_OTAPwrReqOFFChkSta_enum: implementation-data-type=uint8
      VPMM_OTAPwrReqStdChkSta_enum: implementation-data-type=uint8
      VPMM_MCUDCBusMaxVolt_V: implementation-data-type=float32
      VPMM_PwrReqRAPSAvail_flg: implementation-data-type=boolean
package /Interface_PMM_ARPkg
  sender receiver interface IF_BPMM_outputs
    data BPMM_outputs: type=BPMM_outputs
package /Impl_Type_SYS_ARPkg
  impl type BSYS_outputs: category=STRUCTURE
    43 x element, all with category=TYPE_REFERENCE:
      VSYS_HWVer{1..3}_cnt: implementation-data-type=uint8
      VSYS_CarModel{1..3}_cnt: implementation-data-type=uint8
      VSYS_ECU1_cnt: implementation-data-type=uint8
      VSYS_ECU2_cnt: implementation-data-type=uint8
      VSYS_Major1_cnt: implementation-data-type=uint8
      VSYS_Major2_cnt: implementation-data-type=uint8
      VSYS_Minor1_cnt: implementation-data-type=uint8
      VSYS_Minor2_cnt: implementation-data-type=uint8
      VSYS_Patch1_cnt: implementation-data-type=uint8
      VSYS_Patch2_cnt: implementation-data-type=uint8
      VSYS_Country1_cnt: implementation-data-type=uint8
      VSYS_Country2_cnt: implementation-data-type=uint8
      VSYS_Variation_cnt: implementation-data-type=uint8
      VSYS_Dash1_cnt: implementation-data-type=uint8
      VSYS_Change1_cnt: implementation-data-type=uint8
      VSYS_Change2_cnt: implementation-data-type=uint8
      VSYS_Dash2_cnt: implementation-data-type=uint8
      VSYS_SHA{1..8}_cnt: implementation-data-type=uint8
      VSYS_NvWriteReqRisingEdge_flg: implementation-data-type=boolean
      VSYS_FdcSlpReqRisingEdge_flg: implementation-data-type=boolean
      VSYS_FdcSlpTime_sec: implementation-data-type=float32
      VSYS_PmicBootReason_enum: implementation-data-type=uint8
      VSYS_WisrBootReason_raw32: implementation-data-type=uint32
      VSYS_AcoreRebootCmdACK_flg: implementation-data-type=boolean
      VSYS_CurrentNmState_enum: implementation-data-type=uint8
      VSYS_ECUGen1_cnt: implementation-data-type=uint8
      VSYS_ECUGen2_cnt: implementation-data-type=uint8
      VSYS_PmicBootPath_raw32: implementation-data-type=uint32
      VSYS_DrivingMode_cnt: implementation-data-type=uint8
      VSYS_ModelYear_cnt: implementation-data-type=uint8
      VSYS_Var4_cnt: implementation-data-type=uint8
      VSYS_Var5_cnt: implementation-data-type=uint8
package /Interface_SYS_ARPkg
  sender receiver interface IF_BSYS_outputs
    data BSYS_outputs: type=BSYS_outputs
package /Impl_Type_THC_ARPkg
  impl type BTHC_outputs: category=STRUCTURE
    202 x element, all with category=TYPE_REFERENCE:
      VTHC_FDCompCmd_rpm: implementation-data-type=uint16
      VTHC_FDSOV{1..3}Cmd_flg: implementation-data-type=boolean
      VTHC_FDEXV1Cmd_step: implementation-data-type=uint16
      VTHC_FDEXV2Cmd_step: implementation-data-type=uint16
      VTHC_FDSOTXVCmd_flg: implementation-data-type=boolean
      VTHC_FDFWVCmd_flg: implementation-data-type=boolean
      VTHC_FDTWVCmd_pct: implementation-data-type=float32
      VTHC_FDFrWPTCHeatPwrCmd_W: implementation-data-type=float32
      VTHC_CoolgFanActDuty_pct: implementation-data-type=float32
      VTHC_FDAGSCmd_enum: implementation-data-type=uint8
      VTHC_FDEWP{1..3}Cmd_enum: implementation-data-type=uint8
      VTHC_FDFrLeAPTCHeatPwrCmd_W: implementation-data-type=float32
      VTHC_FDFrRiAPTCHeatPwrCmd_W: implementation-data-type=float32
      VTHC_FDRrAPTCHeatPwrCmd_W: implementation-data-type=float32
      VTHC_FDBlowerCmd_pct: implementation-data-type=float32
      VTHC_BatteryMode_enum: implementation-data-type=uint8
      VTHC_EDriveMode_enum: implementation-data-type=uint8
      VTHC_CabinMode_enum: implementation-data-type=uint8
      VTHC_CCUACLampSts_flg: implementation-data-type=boolean
      VTHC_CCUAutoLampSts_flg: implementation-data-type=boolean
      VTHC_CCUACMaxLampSts_flg: implementation-data-type=boolean
      VTHC_CCUSyncLampSts_flg: implementation-data-type=boolean
      VTHC_sigAirIntenZon1St_enum: implementation-data-type=uint8
      VTHC_sigWindDirZon1St_enum: implementation-data-type=uint8
      VTHC_sigRecircSt_flg: implementation-data-type=boolean
      VTHC_sigSetTempZon1St_C: implementation-data-type=float32
      VTHC_sigSetTempZon2St_C: implementation-data-type=float32
      VTHC_sigClntTHvBattOut_C: implementation-data-type=float32
      VTHC_sigCbnSolarLeft_W: implementation-data-type=float32
      VTHC_sigClntTHvBattIn_C: implementation-data-type=float32
      VTHC_sigCbnSolarRight_W: implementation-data-type=float32
      VTHC_sigAmbAirT_C: implementation-data-type=float32
      VTHC_sigCbnAirT_C: implementation-data-type=float32
      VTHC_ACSubMode_enum: implementation-data-type=uint8
      VTHC_FDRecyAutoCmd_enum: implementation-data-type=uint8
      VTHC_CompP_K: implementation-data-type=float32
      VTHC_CompI_K: implementation-data-type=float32
      VTHC_CompU_K: implementation-data-type=float32
      VTHC_CompDeltaU_K: implementation-data-type=float32
      VTHC_Compe_K: implementation-data-type=float32
      VTHC_Blowere_K: implementation-data-type=float32
      VTHC_BlowerP_K: implementation-data-type=float32
      VTHC_BlowerU_K: implementation-data-type=float32
      VTHC_Vbase_pct: implementation-data-type=float32
      VTHC_BlowerI_K: implementation-data-type=float32
      VTHC_EXV2P_K: implementation-data-type=float32
      VTHC_EXV2I_K: implementation-data-type=float32
      VTHC_EXV2U_K: implementation-data-type=float32
      VTHC_EXV2e_K: implementation-data-type=float32
      VTHC_APTCP_K: implementation-data-type=float32
      VTHC_APTCI_K: implementation-data-type=float32
      VTHC_APTCU_K: implementation-data-type=float32
      VTHC_APTCe_K: implementation-data-type=float32
      VTHC_EXV1P_K: implementation-data-type=float32
      VTHC_EXV1I_K: implementation-data-type=float32
      VTHC_EXV1U_K: implementation-data-type=float32
      VTHC_EXV1e_K: implementation-data-type=float32
      VTHC_ACModeMem_enum: implementation-data-type=uint8
      VTHC_Face_flg: implementation-data-type=boolean
      VTHC_Foot_flg: implementation-data-type=boolean
      VTHC_Frost_flg: implementation-data-type=boolean
      VTHC_FaceM_flg: implementation-data-type=boolean
      VTHC_FootM_flg: implementation-data-type=boolean
      VTHC_CCUSyncSts_flg: implementation-data-type=boolean
      VTHC_ACForceOFF_flg: implementation-data-type=boolean
      VTHC_RecAutoFlg_flg: implementation-data-type=boolean
      VTHC_AirIntenZone1M_enum: implementation-data-type=uint8
      VTHC_fdefog_flg: implementation-data-type=boolean
      VTHC_sigSetTempZon2StM_C: implementation-data-type=float32
      VTHC_sigDfrstSt_flg: implementation-data-type=boolean
      VTHC_FDCTHCAirIntZ3Sta_enum: implementation-data-type=uint8
      VTHC_FDCTHCLEVentModeSta_enum: implementation-data-type=uint8
      VTHC_FDCTHCREVentModeSta_enum: implementation-data-type=uint8
      VTHC_FDCTHCLEVentZSta_enum: implementation-data-type=uint8
      VTHC_FDCTHCCLEVentZSta_enum: implementation-data-type=uint8
      VTHC_FDCTHCREVentZSta_enum: implementation-data-type=uint8
      VTHC_FDCTHCCREVentZSta_enum: implementation-data-type=uint8
      VTHC_FDCTHCLEVentYSta_enum: implementation-data-type=uint8
      VTHC_FDCTHCLVentENSta_flg: implementation-data-type=boolean
      VTHC_FDCTHCCLEVentYSta_enum: implementation-data-type=uint8
      VTHC_FDCTHCCLVentENSta_flg: implementation-data-type=boolean
      VTHC_FDCTHCREVentYSta_enum: implementation-data-type=uint8
      VTHC_FDCTHCRVentENSta_flg: implementation-data-type=boolean
      VTHC_FDCTHCCREVentYSta_enum: implementation-data-type=uint8
      VTHC_FDCTHCCRVentENSta_flg: implementation-data-type=boolean
      VTHC_FDCTHCMAPTCForceOFFSta_flg: implementation-data-type=boolean
      VTHC_Z1TUP_flg: implementation-data-type=boolean
      VTHC_Z1TDN_flg: implementation-data-type=boolean
      VTHC_Z2TUP_flg: implementation-data-type=boolean
      VTHC_Z2TDN_flg: implementation-data-type=boolean
      VTHC_FDCFGSAirIntSta_enum: implementation-data-type=uint8
      VTHC_FDCFGSChSta_enum: implementation-data-type=uint8
      VTHC_FDCFGSAirIntCmd_enum: implementation-data-type=uint8
      VTHC_FDCFGSFuncSta_enum: implementation-data-type=uint8
      VTHC_FDCFGSChCmd_enum: implementation-data-type=uint8
      VTHC_FDCFGSIONSWSta_flg: implementation-data-type=boolean
      VTHC_FDCFGSIONCmd_flg: implementation-data-type=boolean
      VTHC_FDCTHCMPreWPTCHeatSta_enum: implementation-data-type=uint8
      VTHC_EWPBUflag{1..3}_flg: implementation-data-type=boolean
      VTHC_FaceMSet_enum: implementation-data-type=uint8
      VTHC_FootMSet_enum: implementation-data-type=uint8
      VTHC_fdefogSet_enum: implementation-data-type=uint8
      VTHC_CCUSyncStsSet_enum: implementation-data-type=uint8
      VTHC_sigRecircStSet_enum: implementation-data-type=uint8
      VTHC_RecyAutoSet_enum: implementation-data-type=uint8
      VTHC_AirIntenZone1MSet{1..5}_enum: implementation-data-type=uint8
      VTHC_AirIntenZone1MSet7_enum: implementation-data-type=uint8
      VTHC_AirIntenZone3MSet{1..5}_enum: implementation-data-type=uint8
      VTHC_AirIntenZone3MSet7_enum: implementation-data-type=uint8
      VTHC_IONSWStaSet_enum: implementation-data-type=uint8
      VTHC_FDCFGSChStaSet123_enum: implementation-data-type=uint8
      VTHC_FDCFGSChStaSet457_enum: implementation-data-type=uint8
      VTHC_FDCFGSAirIntStaSet123_enum: implementation-data-type=uint8
      VTHC_FDCFGSAirIntStaSet457_enum: implementation-data-type=uint8
      VTHC_LVentENSet_enum: implementation-data-type=uint8
      VTHC_CLVentENSet_enum: implementation-data-type=uint8
      VTHC_RVentENSet_enum: implementation-data-type=uint8
      VTHC_CRVentENSet_enum: implementation-data-type=uint8
      VTHC_LEVentModeStaSet123_enum: implementation-data-type=uint8
      VTHC_LEVentModeStaSet457_enum: implementation-data-type=uint8
      VTHC_REVentModeStaSet123_enum: implementation-data-type=uint8
      VTHC_REVentModeStaSet457_enum: implementation-data-type=uint8
      VTHC_FDCTHCLEVentZStaSet{1..5}_enum: implementation-data-type=uint8
      VTHC_FDCTHCLEVentZStaSet7_enum: implementation-data-type=uint8
      VTHC_FDCTHCCLEVentZStaSet{1..5}_enum: implementation-data-type=uint8
      VTHC_FDCTHCCLEVentZStaSet7_enum: implementation-data-type=uint8
      VTHC_FDCTHCREVentZStaSet{1..5}_enum: implementation-data-type=uint8
      VTHC_FDCTHCREVentZStaSet7_enum: implementation-data-type=uint8
      VTHC_FDCTHCCREVentZStaSet{1..5}_enum: implementation-data-type=uint8
      VTHC_FDCTHCCREVentZStaSet7_enum: implementation-data-type=uint8
      VTHC_FDCTHCLEVentYStaSet{1..5}_enum: implementation-data-type=uint8
      VTHC_FDCTHCLEVentYStaSet7_enum: implementation-data-type=uint8
      VTHC_FDCTHCCLEVentYStaSet{1..5}_enum: implementation-data-type=uint8
      VTHC_FDCTHCCLEVentYStaSet7_enum: implementation-data-type=uint8
      VTHC_FDCTHCREVentYStaSet{1..5}_enum: implementation-data-type=uint8
      VTHC_FDCTHCREVentYStaSet7_enum: implementation-data-type=uint8
      VTHC_FDCTHCCREVentYStaSet{1..5}_enum: implementation-data-type=uint8
      VTHC_FDCTHCCREVentYStaSet7_enum: implementation-data-type=uint8
      VTHC_SettempZon1Set{1..5}_enum: implementation-data-type=uint8
      VTHC_SettempZon1Set7_enum: implementation-data-type=uint8
      VTHC_ACModeSet123_enum: implementation-data-type=uint8
      VTHC_ACModeSet457_enum: implementation-data-type=uint8
      VTHC_FACESet_enum: implementation-data-type=uint8
      VTHC_FOOTSet_enum: implementation-data-type=uint8
      VTHC_FrostSet_enum: implementation-data-type=uint8
      VTHC_LVentEN_flg: implementation-data-type=boolean
      VTHC_CLVentEN_flg: implementation-data-type=boolean
      VTHC_RVentEN_flg: implementation-data-type=boolean
      VTHC_CRVentEN_flg: implementation-data-type=boolean
      VTHC_FDCFGSLearnCmd_enum: implementation-data-type=uint8
      VTHC_FDCFGSFuncSta_flg: implementation-data-type=boolean
      VTHC_THSysErrlampReq_flg: implementation-data-type=boolean
package /Interface_THC_ARPkg
  sender receiver interface IF_BTHC_outputs
    data BTHC_outputs: type=BTHC_outputs
package /Impl_Type_TPM_ARPkg
  impl type BTPM_outputs: category=STRUCTURE
    114 x element, all with category=TYPE_REFERENCE:
      VTPM_LFBatWarn_flg: implementation-data-type=boolean
      VTPM_RFBatWarn_flg: implementation-data-type=boolean
      VTPM_LRBatWarn_flg: implementation-data-type=boolean
      VTPM_RRBatWarn_flg: implementation-data-type=boolean
      VTPM_LFWheelPress_raw8: implementation-data-type=uint8
      VTPM_RFWheelPress_raw8: implementation-data-type=uint8
      VTPM_LRWheelPress_raw8: implementation-data-type=uint8
      VTPM_RRWheelPress_raw8: implementation-data-type=uint8
      VTPM_LFWheelTemp_C: implementation-data-type=float32
      VTPM_RFWheelTemp_C: implementation-data-type=float32
      VTPM_LRWheelTemp_C: implementation-data-type=float32
      VTPM_RRWheelTemp_C: implementation-data-type=float32
      VTPM_LFSensorFail_flg: implementation-data-type=boolean
      VTPM_RFSensorFail_flg: implementation-data-type=boolean
      VTPM_LRSensorFail_flg: implementation-data-type=boolean
      VTPM_RRSensorFail_flg: implementation-data-type=boolean
      VTPM_LFWheelDebug_flg: implementation-data-type=boolean
      VTPM_LRWheelDebug_flg: implementation-data-type=boolean
      VTPM_RFWheelDebug_flg: implementation-data-type=boolean
      VTPM_RRWheelDebug_flg: implementation-data-type=boolean
      VTPM_TPMSResButtAllow_flg: implementation-data-type=boolean
      VTPM_TPMSCaliButtAllow_flg: implementation-data-type=boolean
      VTPM_LFPressIndi_enum: implementation-data-type=uint8
      VTPM_RFPressIndi_enum: implementation-data-type=uint8
      VTPM_LRPressIndi_enum: implementation-data-type=uint8
      VTPM_RRPressIndi_enum: implementation-data-type=uint8
      VTPM_TPMSWarnIndi_enum: implementation-data-type=uint8
      VTPM_LFWheelTmpIndi_flg: implementation-data-type=boolean
      VTPM_RFWheelTmpIndi_flg: implementation-data-type=boolean
      VTPM_LRWheelTmpIndi_flg: implementation-data-type=boolean
      VTPM_RRWheelTmpIndi_flg: implementation-data-type=boolean
      VTPM_LFWheelPSW_raw8: implementation-data-type=uint8
      VTPM_LRWheelPSW_raw8: implementation-data-type=uint8
      VTPM_RFWheelPSW_raw8: implementation-data-type=uint8
      VTPM_RRWheelPSW_raw8: implementation-data-type=uint8
      VTPM_LFS1_cnt: implementation-data-type=uint8
      VTPM_RFS1_cnt: implementation-data-type=uint8
      VTPM_RRS1_cnt: implementation-data-type=uint8
      VTPM_LRS1_cnt: implementation-data-type=uint8
      VTPM_LFS2_cnt: implementation-data-type=uint8
      VTPM_RFS2_cnt: implementation-data-type=uint8
      VTPM_RRS2_cnt: implementation-data-type=uint8
      VTPM_LRS2_cnt: implementation-data-type=uint8
      VTPM_LFS3_cnt: implementation-data-type=uint8
      VTPM_RFS3_cnt: implementation-data-type=uint8
      VTPM_RRS3_cnt: implementation-data-type=uint8
      VTPM_LRS3_cnt: implementation-data-type=uint8
      VTPM_LFS4_cnt: implementation-data-type=uint8
      VTPM_RFS4_cnt: implementation-data-type=uint8
      VTPM_RRS4_cnt: implementation-data-type=uint8
      VTPM_LRS4_cnt: implementation-data-type=uint8
      VTPM_CWheelTips_enum: implementation-data-type=uint8
      VTPM_AutoLTips_enum: implementation-data-type=uint8
      VTPM_LFSensorMode_flg: implementation-data-type=boolean
      VTPM_RFSensorMode_flg: implementation-data-type=boolean
      VTPM_LRSensorMode_flg: implementation-data-type=boolean
      VTPM_RRSensorMode_flg: implementation-data-type=boolean
      VTPM_S{1..4}ID_raw32: implementation-data-type=uint32
      VTPM_S{1..4}L_enum: implementation-data-type=uint8
      VTPM_ALFin_flg: implementation-data-type=boolean
      VTPM_IDLock_flg: implementation-data-type=boolean
      VTPM_LFP20_raw8: implementation-data-type=uint8
      VTPM_RFP20_raw8: implementation-data-type=uint8
      VTPM_LRP20_raw8: implementation-data-type=uint8
      VTPM_RRP20_raw8: implementation-data-type=uint8
      VTPM_FAT_flg: implementation-data-type=boolean
      VTPM_IDin_raw32: implementation-data-type=uint32
      VTPM_S{1..4}WheelDebugALTU_pct: implementation-data-type=float32
      VTPM_ID{1..4}messageALTU_raw8: implementation-data-type=uint8
      VTPM_Chkfin_flg: implementation-data-type=boolean
      VTPM_SetIDLoc_flg: implementation-data-type=boolean
      VTPM_TPMSStorge_flg: implementation-data-type=boolean
      VTPM_ChkStorge_flg: implementation-data-type=boolean
      VTPM_TPMSResButt_flg: implementation-data-type=boolean
      VTPM_LFPindi_enum: implementation-data-type=uint8
      VTPM_RFPind_enum: implementation-data-type=uint8
      VTPM_LRPindi_enum: implementation-data-type=uint8
      VTPM_RRPindi_enum: implementation-data-type=uint8
      VTPM_WriteChkLFID_raw: implementation-data-type=uint32
      VTPM_WriteChkRFID_raw: implementation-data-type=uint32
      VTPM_WriteChkLRID_raw: implementation-data-type=uint32
      VTPM_WriteChkRRID_raw: implementation-data-type=uint32
      VTPM_WriteChkfinLFID_raw: implementation-data-type=uint32
      VTPM_WriteChkfinRFID_raw: implementation-data-type=uint32
      VTPM_WriteChkfinLRID_raw: implementation-data-type=uint32
      VTPM_WriteChkfinRRID_raw: implementation-data-type=uint32
      VTPM_Flashchkdatavalid_enum: implementation-data-type=uint8
      VTPM_Flashdatavalid_enum: implementation-data-type=uint8
      VTPM_unlearnSfali_flg: implementation-data-type=boolean
      VTPM_unlearnSfailvalid_enum: implementation-data-type=uint8
      VTPM_Prepresstempvalid_enum: implementation-data-type=uint8
      VTPM_FlashS{1..4}ID_raw: implementation-data-type=uint32
      VTPM_FlashIDvalid_enum: implementation-data-type=uint8
      VTPM_WritingCnt_enum: implementation-data-type=uint8
      VTPM_TPMSTLCmd_flg: implementation-data-type=boolean
      VTPM_LProgress_enum: implementation-data-type=uint8
      VTPM_TPMSSensorIDRegStart_flg: implementation-data-type=boolean
      VTPM_ModelVersion_raw: implementation-data-type=uint8
      VTPM_ModelVersionChksum_raw: implementation-data-type=uint8
package /Interface_TPM_ARPkg
  sender receiver interface IF_BTPM_outputs
    data BTPM_outputs: type=BTPM_outputs
package /Impl_Type_TQD_ARPkg
  impl type BTQD_outputs: category=STRUCTURE
    122 x element, all with category=TYPE_REFERENCE:
      VTQD_GearActualPosn_enum: implementation-data-type=uint8
      VTQD_ParkRequest_flg: implementation-data-type=boolean
      VTQD_PBWLockTO_flg: implementation-data-type=boolean
      VTQD_PBWUnlockTO_flg: implementation-data-type=boolean
      VTQD_DriverWhlTqDem_Nm: implementation-data-type=float32
      VTQD_AfterAvailableTqDemFr_Nm: implementation-data-type=float32
      VTQD_AfterAvailableTqDemRr_Nm: implementation-data-type=float32
      VTQD_TqSourceFr_enum: implementation-data-type=uint8
      VTQD_TqSourceRr_enum: implementation-data-type=uint8
      VTQD_FrEDUAvailBrkRgnTq_Nm: implementation-data-type=float32
      VTQD_RrEDUAvailBrkRgnTq_Nm: implementation-data-type=float32
      VTQD_TqTargetShaftSpd_rpm: implementation-data-type=float32
      VTQD_LimpHomeAct_flg: implementation-data-type=boolean
      VTQD_RollRegenEnable_flg: implementation-data-type=boolean
      VTQD_EVDriveMode_enum: implementation-data-type=uint8
      VTQD_EVDriveModeValid_flg: implementation-data-type=boolean
      VTQD_ShiftGearPosn_enum: implementation-data-type=uint8
      VTQD_PButtonSta_enum: implementation-data-type=uint8
      VTQD_FrActvDmpDisabReq_flg: implementation-data-type=boolean
      VTQD_RrActvDmpDisabReq_flg: implementation-data-type=boolean
      VTQD_FrRgnDecrSta_flg: implementation-data-type=boolean
      VTQD_RrRgnDecrSta_flg: implementation-data-type=boolean
      VTQD_DriverWhlTqDemFr_Nm: implementation-data-type=float32
      VTQD_DriverWhlTqDemRr_Nm: implementation-data-type=float32
      VTQD_FrEDUActTq_Nm: implementation-data-type=float32
      VTQD_RrEDUActTq_Nm: implementation-data-type=float32
      VTQD_FrEDURolRgnTq_Nm: implementation-data-type=float32
      VTQD_RrEDURolRgnTq_Nm: implementation-data-type=float32
      VTQD_FrEDUSpd_rpm: implementation-data-type=float32
      VTQD_RrEDUSpd_rpm: implementation-data-type=float32
      VTQD_FrEDUSpdValid_flg: implementation-data-type=boolean
      VTQD_FrEDUAvailBrkRgnTqV_flg: implementation-data-type=boolean
      VTQD_RrEDUSpdValid_flg: implementation-data-type=boolean
      VTQD_RrEDUAvailBrkRgnTqV_flg: implementation-data-type=boolean
      VTQD_RgnAbnorSta_flg: implementation-data-type=boolean
      VTQD_PTCSPermSta_flg: implementation-data-type=boolean
      VTQD_FrRgnPermSta_flg: implementation-data-type=boolean
      VTQD_RrRgnPermSta_flg: implementation-data-type=boolean
      VTQD_ExternalTqAllow_flg: implementation-data-type=boolean
      VTQD_FrIdcMin_A: implementation-data-type=float32
      VTQD_FrIdcMax_A: implementation-data-type=float32
      VTQD_FrUdcMin_V: implementation-data-type=float32
      VTQD_FrUdcMax_V: implementation-data-type=float32
      VTQD_RrIdcMin_A: implementation-data-type=float32
      VTQD_RrIdcMax_A: implementation-data-type=float32
      VTQD_RrUdcMin_V: implementation-data-type=float32
      VTQD_RrUdcMax_V: implementation-data-type=float32
      VTQD_CoordWhlTqDemFr_Nm: implementation-data-type=float32
      VTQD_CoordWhlTqDemRr_Nm: implementation-data-type=float32
      VTQD_CreepEnable_flg: implementation-data-type=boolean
      VTQD_CrashDetd_flg: implementation-data-type=boolean
      VTQD_DiagHCrash_flg: implementation-data-type=boolean
      VTQD_ReBrakeLPReq_flg: implementation-data-type=boolean
      VTQD_LoSpdBrkCtrl_flg: implementation-data-type=boolean
      VTQD_LowIdleAccPedal_flg: implementation-data-type=boolean
      VTQD_APSStaSys_enum: implementation-data-type=uint8
      VTQD_APSReq_enum: implementation-data-type=uint8
      VTQD_APSDecReqA_flg: implementation-data-type=boolean
      VTQD_APSDecReq_mps2: implementation-data-type=float32
      VTQD_ExtShftAllow_flg: implementation-data-type=boolean
      VTQD_EstVehWeightResult_kg: implementation-data-type=float32
      VTQD_BOSEnable_flg: implementation-data-type=boolean
      VTQD_CreepON_flg: implementation-data-type=boolean
      VTQD_PreLoadHold_flg: implementation-data-type=boolean
      VTQD_PreLoadPreEn_flg: implementation-data-type=boolean
      VTQD_CreepPrLoadEnable_flg: implementation-data-type=boolean
      VTQD_RDCActive_enum: implementation-data-type=uint8
      VTQD_EquivAccPedalSWSta_flg: implementation-data-type=boolean
      VTQD_DriveProtEn_flg: implementation-data-type=boolean
      VTQD_ActParkRequest_flg: implementation-data-type=boolean
      VTQD_RegenTqLimitEn_flg: implementation-data-type=boolean
      VTQD_PedAccTqEn_flg: implementation-data-type=boolean
      VTQD_IVIPwrLockSta_enum: implementation-data-type=uint8
      VTQD_ExtDoorAllow_flg: implementation-data-type=boolean
      VTQD_WhlTqCapGenFr_Nm: implementation-data-type=float32
      VTQD_WhlTqCapGenRr_Nm: implementation-data-type=float32
      VTQD_OPDHoldLamp_flg: implementation-data-type=boolean
      VTQD_RegenMode_enum: implementation-data-type=uint8
      VTQD_SaveRegenMode_enum: implementation-data-type=uint8
      VTQD_FDCVCURegenMode_enum: implementation-data-type=uint8
      VTQD_SpdCtrlMode_enum: implementation-data-type=uint8
      VTQD_SpdCtrlSta_flg: implementation-data-type=boolean
      VTQD_SetSpd_kph: implementation-data-type=float32
      VTQD_SWCCancelSta_flg: implementation-data-type=boolean
      VTQD_SWCSetdownSta_flg: implementation-data-type=boolean
      VTQD_SWCResUpSta_flg: implementation-data-type=boolean
      VTQD_CreepBaseTqD_Nm: implementation-data-type=float32
      VTQD_VehActSpd_kph: implementation-data-type=float32
      VTQD_RegenLimIndSta_flg: implementation-data-type=boolean
      VTQD_BrkSwSta_flg: implementation-data-type=boolean
      VTQD_SWC2CancelSta_flg: implementation-data-type=boolean
      VTQD_SWC2SetdownSta_flg: implementation-data-type=boolean
      VTQD_SWC2ResUpSta_flg: implementation-data-type=boolean
      VTQD_SWC2LADASSta_flg: implementation-data-type=boolean
      VTQD_SpdLim4SetSpd_raw32: implementation-data-type=float32
      VTQD_SetSpdLimWarn_flg: implementation-data-type=boolean
      VTQD_MaxWhlSlideRate_pct: implementation-data-type=float32
      VTQD_MinWhlSlideRate_pct: implementation-data-type=float32
      VTQD_LeftSlideRate_pct: implementation-data-type=float32
      VTQD_RightSlideRate_pct: implementation-data-type=float32
      VTQD_FrontSlideRate_pct: implementation-data-type=float32
      VTQD_RearSlideRate_pct: implementation-data-type=float32
      VTQD_TrailerDisOPDSta_flg: implementation-data-type=boolean
      VTQD_ComboKeyPreEn_flg: implementation-data-type=boolean
      VTQD_ComboKeyEn_flg: implementation-data-type=boolean
      VTQD_SysMode_enum: implementation-data-type=uint8
      VTQD_WhlTqCapMotFr_Nm: implementation-data-type=float32
      VTQD_WhlTqCapMotRr_Nm: implementation-data-type=float32
      VTQD_FrShaftSpd_rpm: implementation-data-type=float32
      VTQD_RrShaftSpd_rpm: implementation-data-type=float32
      VTQD_EPBCarWashMode_flg: implementation-data-type=boolean
      VTQD_IVIRockModeEn_flg: implementation-data-type=boolean
      VTQD_ForceP_flg: implementation-data-type=boolean
      VTQD_SlideRegenLimTq_Nm: implementation-data-type=float32
      VTQD_SimSoundCmd_pct: implementation-data-type=float32
      VTQD_SimSouWaveReq_pct: implementation-data-type=float32
      VTQD_RockModeTCSReq_flg: implementation-data-type=boolean
      VTQD_TMEnOutpTqSta_enum: implementation-data-type=uint8
      VTQD_OPDHoldForceEn_flg: implementation-data-type=boolean
      VTQD_OPDHoldAlarm_flg: implementation-data-type=boolean
      VTQD_CrashUnlockReq_flg: implementation-data-type=boolean
      VTQD_CTDCtrl_enum: implementation-data-type=uint8
package /Interface_TQD_ARPkg
  sender receiver interface IF_BTQD_outputs
    data BTQD_outputs: type=BTQD_outputs
package /Impl_Type_TQR_ARPkg
  impl type BTQR_outputs: category=STRUCTURE
    22 x element, all with category=TYPE_REFERENCE:
      VTQR_FrTMTqReq_Nm: implementation-data-type=float32
      VTQR_FEDUTMSpdReq_rpm: implementation-data-type=float32
      VTQR_RrTMTqReq_Nm: implementation-data-type=float32
      VTQR_REDUTMSpdReq_rpm: implementation-data-type=float32
      VTQR_ActualFEDUWhlTqReq_Nm: implementation-data-type=float32
      VTQR_ActualREDUWhlTqReq_Nm: implementation-data-type=float32
      VTQR_NoABSFEDUWhlTqReq_Nm: implementation-data-type=float32
      VTQR_NoABSREDUWhlTqReq_Nm: implementation-data-type=float32
      VTQR_RShaftSpdTqLimLow_flg: implementation-data-type=boolean
      VTQR_RTimerTqLimLow_flg: implementation-data-type=boolean
      VTQR_FShaftSpdTqLimLow_flg: implementation-data-type=boolean
      VTQR_FTimerTqLimLow_flg: implementation-data-type=boolean
      VTQR_FrFirstOrderInpTs_c: implementation-data-type=float32
      VTQR_RrFirstOrderInpTs_c: implementation-data-type=float32
      VTQR_FrRateLimitInc_Nm: implementation-data-type=float32
      VTQR_FrRateLimitDec_Nm: implementation-data-type=float32
      VTQR_RrRateLimitInc_Nm: implementation-data-type=float32
      VTQR_RrRateLimitDec_Nm: implementation-data-type=float32
      VTQR_FrTqZeroTransLowBound_Nm: implementation-data-type=float32
      VTQR_RrTqZeroTransUpBound_Nm: implementation-data-type=float32
      VTQR_FrTqZeroTrans_enum: implementation-data-type=uint8
      VTQR_RrTqZeroTrans_enum: implementation-data-type=uint8
package /Interface_TQR_ARPkg
  sender receiver interface IF_BTQR_outputs
    data BTQR_outputs: type=BTQR_outputs
package /Impl_Type_V2L_ARPkg
  impl type BV2L_outputs: category=STRUCTURE
    7 x element, all with category=TYPE_REFERENCE, implementation-data-type=uint8:
      VV2L_ReqOBCV2LEna_enum
      VV2L_ReqV2LIVIPopup_enum
      VV2L_ReqV2LIVIDisChrg_enum
      VV2L_ReqOBCExtrV2LEna_enum
      VV2L_ReqOBCIntrV2LEna_enum
      VV2L_HVPO120VGrpALDSt_enum
      VV2L_HVPO120VGrpBLDSt_enum
package /Interface_V2L_ARPkg
  sender receiver interface IF_BV2L_outputs
    data BV2L_outputs: type=BV2L_outputs
package /Impl_Type_VMC_ARPkg
  impl type BVMC_outputs: category=STRUCTURE
    160 x element, all with category=TYPE_REFERENCE:
      VVMC_FeatSetSpdFinal_raw32: implementation-data-type=float32
      VVMC_VehicleSpeed_mph: implementation-data-type=float32
      VVMC_VehicleSpeed_kph: implementation-data-type=float32
      VVMC_MeterIndSpeed_raw32: implementation-data-type=float32
      VVMC_MeterIndSpeedForCalcu_kph: implementation-data-type=float32
      VVMC_VMCAEBCtrlAvail_flg: implementation-data-type=boolean
      VVMC_VMCACCCtrlAvail_flg: implementation-data-type=boolean
      VVMC_VMCCCCtrlAvail_flg: implementation-data-type=boolean
      VVMC_VMCMSACtrlAvail_flg: implementation-data-type=boolean
      VVMC_FeatArbitrSta_enum: implementation-data-type=uint8
      VVMC_FeatReqSpd_kph: implementation-data-type=float32
      VVMC_JerkPCT_pct: implementation-data-type=float32
      VVMC_LimitPCT_pct: implementation-data-type=float32
      VVMC_LFWhlSpeedRollAve_kph: implementation-data-type=float32
      VVMC_RFWhlSpeedRollAve_kph: implementation-data-type=float32
      VVMC_LRWhlSpeedRollAve_kph: implementation-data-type=float32
      VVMC_RRWhlSpeedRollAve_kph: implementation-data-type=float32
      VVMC_FrontRearSlipRatioCtrl_flg: implementation-data-type=boolean
      VVMC_RearWhlSlipRatioCtrl_flg: implementation-data-type=boolean
      VVMC_SingleWhlSlipRatioCtrl_flg: implementation-data-type=boolean
      VVMC_LatAccCtrl_flg: implementation-data-type=boolean
      VVMC_SafetyCtrl_flg: implementation-data-type=boolean
      VVMC_EstSlope_Deg: implementation-data-type=float32
      VVMC_SPD2ACCAct_flg: implementation-data-type=boolean
      VVMC_AccCalcuPID_mps2: implementation-data-type=float32
      VVMC_ISOAccLimit_mps2: implementation-data-type=float32
      VVMC_ISODecLimit_mps2: implementation-data-type=float32
      VVMC_ISOJerkLimit_mps3: implementation-data-type=float32
      VVMC_ACCRequiredAccel_mps2: implementation-data-type=float32
      VVMC_DISCReqAcc_mps2: implementation-data-type=float32
      VVMC_FeatArbitrFinal_enum: implementation-data-type=uint8
      VVMC_ActACCRequiredAccel_mps2: implementation-data-type=float32
      VVMC_LateralCtrl_flg: implementation-data-type=boolean
      VVMC_ADASLKASta_enum: implementation-data-type=uint8
      VVMC_LKAStrToqReq_Nm: implementation-data-type=float32
      VVMC_LKATOIFault_flg: implementation-data-type=boolean
      VVMC_LKATOIAct_enum: implementation-data-type=uint8
      VVMC_ADASAEBReq_enum: implementation-data-type=uint8
      VVMC_ADASFaultSta_flg: implementation-data-type=boolean
      VVMC_AEBVehHoldReq_flg: implementation-data-type=boolean
      VVMC_ACCVehHoldReq_flg: implementation-data-type=boolean
      VVMC_ADASDBSReq_enum: implementation-data-type=uint8
      VVMC_ADASACCSta_enum: implementation-data-type=uint8
      VVMC_ACCObjDist_m: implementation-data-type=float32
      VVMC_ACCObjRelSpd_mps: implementation-data-type=float32
      VVMC_TimeGapLevel_enum: implementation-data-type=uint8
      VVMC_ACCJerkUpperLimit_mps3: implementation-data-type=float32
      VVMC_ACCComfortBandUpper_mps2: implementation-data-type=float32
      VVMC_ACCJerkLowerLimit_mps3: implementation-data-type=float32
      VVMC_ACCComfortBandLower_mps2: implementation-data-type=float32
      VVMC_ADASVehSpdLim_raw32: implementation-data-type=float32
      VVMC_ADASShftPosnReqA_flg: implementation-data-type=boolean
      VVMC_ADASShftPosnReq_enum: implementation-data-type=uint8
      VVMC_ADASForceIdle_flg: implementation-data-type=boolean
      VVMC_HazardWarningReq_flg: implementation-data-type=boolean
      VVMC_RightTurnLightReq_flg: implementation-data-type=boolean
      VVMC_LeftTurnLightReq_flg: implementation-data-type=boolean
      VVMC_ADASFCWSta_enum: implementation-data-type=uint8
      VVMC_ADASLDWSta_enum: implementation-data-type=uint8
      VVMC_ADASFltWrnReq_flg: implementation-data-type=boolean
      VVMC_ACCObjDstLvl_enum: implementation-data-type=uint8
      VVMC_ForceLowBeam_enum: implementation-data-type=uint8
      VVMC_ACCTakeoverReq_flg: implementation-data-type=boolean
      VVMC_ADASWarningMsg_enum: implementation-data-type=uint8
      VVMC_ADASCAMSpdLim_enum: implementation-data-type=uint8
      VVMC_TargetType_enum: implementation-data-type=uint8
      VVMC_ADASSLIFSpdLim_enum: implementation-data-type=uint8
      VVMC_LKAHODDisplayWarning_flg: implementation-data-type=boolean
      VVMC_LKAHODSoundWarning_flg: implementation-data-type=boolean
      VVMC_ADASLFCSta_enum: implementation-data-type=uint8
      VVMC_ADASLaneModeL_enum: implementation-data-type=uint8
      VVMC_ADASLaneModeR_enum: implementation-data-type=uint8
      VVMC_ADASSLIFSta_enum: implementation-data-type=uint8
      VVMC_ADASISASta_enum: implementation-data-type=uint8
      VVMC_ADASLDWMute_flg: implementation-data-type=boolean
      VVMC_ADASFCWMute_flg: implementation-data-type=boolean
      VVMC_ADASLFCHandsOffWarning_enum: implementation-data-type=uint8
      VVMC_LVDADisabled_flg: implementation-data-type=boolean
      VVMC_LVDAMuteSta_enum: implementation-data-type=uint8
      VVMC_LVDAFailinfo_flg: implementation-data-type=boolean
      VVMC_LVDAWarning_flg: implementation-data-type=boolean
      VVMC_LVDAACCStatusInformation_flg: implementation-data-type=boolean
      VVMC_ADASLFCWarnSound_enum: implementation-data-type=uint8
      VVMC_FCMACCmode_enum: implementation-data-type=uint8
      VVMC_ADASLanetypeR_enum: implementation-data-type=uint8
      VVMC_ADASLanetypeL_enum: implementation-data-type=uint8
      VVMC_ADASLanecurveL_raw32: implementation-data-type=float32
      VVMC_ADASLanecurveR_raw32: implementation-data-type=float32
      VVMC_ADASAEBSta_enum: implementation-data-type=uint8
      VVMC_FCMLDWRequest_enum: implementation-data-type=uint8
      VVMC_FCMLDWFault_flg: implementation-data-type=boolean
      VVMC_ADASActive_flg: implementation-data-type=boolean
      VVMC_ACCCtrlAvail_flg: implementation-data-type=boolean
      VVMC_ADASNegReq_flg: implementation-data-type=boolean
      VVMC_ACCPedalOvrd_flg: implementation-data-type=boolean
      VVMC_ADASWhlTqReq_Nm: implementation-data-type=float32
      VVMC_AccPedalOvrdDISC_flg: implementation-data-type=boolean
      VVMC_RearTqRatio_rat: implementation-data-type=float32
      VVMC_TimeGapCalcu_s: implementation-data-type=float32
      VVMC_CCCtrlSta_enum: implementation-data-type=uint8
      VVMC_CruzActive_flg: implementation-data-type=boolean
      VVMC_CCPedalOvrd_flg: implementation-data-type=boolean
      VVMC_CruzWhlTqReq_Nm: implementation-data-type=float32
      VVMC_MSACtrlSta_enum: implementation-data-type=uint8
      VVMC_MSAActive_flg: implementation-data-type=boolean
      VVMC_MSAWhlTqReq_Nm: implementation-data-type=float32
      VVMC_APSCtrlAvail_flg: implementation-data-type=boolean
      VVMC_APSActive_flg: implementation-data-type=boolean
      VVMC_APSSpeedCMD_kph: implementation-data-type=float32
      VVMC_APSShiftPosnReq_enum: implementation-data-type=uint8
      VVMC_APSStaSys_enum: implementation-data-type=uint8
      VVMC_APSDecReqA_flg: implementation-data-type=boolean
      VVMC_APSDecReq_mps2: implementation-data-type=float32
      VVMC_APSReq_enum: implementation-data-type=uint8
      VVMC_LongAcc_Gps: implementation-data-type=float32
      VVMC_RawWhlSpdSlideRate_pct: implementation-data-type=float32
      VVMC_LFWhlSpdSlideRate_pct: implementation-data-type=float32
      VVMC_RFWhlSpdSlideRate_pct: implementation-data-type=float32
      VVMC_LRWhlSpdSlideRate_pct: implementation-data-type=float32
      VVMC_RRWhlSpdSlideRate_pct: implementation-data-type=float32
      VVMC_PredictVehSpd_kph: implementation-data-type=float32
      VVMC_LF4WhlSpdSlideRate_pct: implementation-data-type=float32
      VVMC_RF4WhlSpdSlideRate_pct: implementation-data-type=float32
      VVMC_LR4WhlSpdSlideRate_pct: implementation-data-type=float32
      VVMC_RR4WhlSpdSlideRate_pct: implementation-data-type=float32
      VVMC_4WhlSpdSlideRate_pct: implementation-data-type=float32
      VVMC_ActMaxSlideRate_pct: implementation-data-type=float32
      VVMC_ActLFSlideRate_pct: implementation-data-type=float32
      VVMC_ActRFSlideRate_pct: implementation-data-type=float32
      VVMC_ActLRSlideRate_pct: implementation-data-type=float32
      VVMC_ActRRSlideRate_pct: implementation-data-type=float32
      VVMC_AltLWhlSlideRate_pct: implementation-data-type=float32
      VVMC_AltRWhlSlideRate_pct: implementation-data-type=float32
      VVMC_AltWhlSlideRate_pct: implementation-data-type=float32
      VVMC_CCMSASpdWar_flg: implementation-data-type=boolean
      VVMC_IMUEnaCmd_flg: implementation-data-type=boolean
      VVMC_RWDRDCActive_enum: implementation-data-type=uint8
      VVMC_MSAWhlTqActive_flg: implementation-data-type=boolean
      VVMC_RDCEnSlideRate_pct: implementation-data-type=float32
      VVMC_ActStESCYaw_Dps: implementation-data-type=float32
      VVMC_ACCOvrdMemTq_Nm: implementation-data-type=float32
      VVMC_CAASCtrlAvail_flg: implementation-data-type=boolean
      VVMC_CAASActive_flg: implementation-data-type=boolean
      VVMC_ExtraMSACtrlSta_enum: implementation-data-type=uint8
      VVMC_CalibratedAccX_G: implementation-data-type=float32
      VVMC_CalibratedAccY_G: implementation-data-type=float32
      VVMC_CalibratedAccZ_G: implementation-data-type=float32
      VVMC_CalibratedGyroX_Dps: implementation-data-type=float32
      VVMC_CalibratedGyroY_Dps: implementation-data-type=float32
      VVMC_CalibratedGyroZ_Dps: implementation-data-type=float32
      VVMC_SetACCDisableAPS_flg: implementation-data-type=boolean
      VVMC_FDCVMCAPSVRqEPSCtrl_flg: implementation-data-type=boolean
      VVMC_FDCVMCAPSAngleTarget_deg: implementation-data-type=float32
      VVMC_FDCVMCAPSRqEPSCtrl_flg: implementation-data-type=boolean
      VVMC_FDCVMCAngCtrlTqWtGn_pct: implementation-data-type=float32
      VVMC_FDCVMCDrInpTqBstAct_flg: implementation-data-type=boolean
      VVMC_FDCVMCMaxAngCtrlOutTqLim_Nm: implementation-data-type=float32
      VVMC_FDCVMCDrInpTqBstGn_pct: implementation-data-type=float32
      VVMC_VehPitchAngleSta_enum: implementation-data-type=uint8
      VVMC_DMSModeCmd_enum: implementation-data-type=uint8
package /Interface_VMC_ARPkg
  sender receiver interface IF_BVMC_outputs
    data BVMC_outputs: type=BVMC_outputs
package /Impl_Type_APP_ARPkg
  9 x impl type, all with category=ARRAY:
    bool_Array3_type
      element bool_Array3: category=VALUE, array-size=3, array-size-semantics=FIXED-SIZE, base-type=boolean
    u16_Array3_type
      element u16_Array3: category=VALUE, array-size=3, array-size-semantics=FIXED-SIZE, base-type=uint16
    u8_Array16_type
      element u8_Array16: category=VALUE, array-size=16, array-size-semantics=FIXED-SIZE, base-type=uint8
    u8_Array8_type
      element u8_Array8: category=VALUE, array-size=8, array-size-semantics=FIXED-SIZE, base-type=uint8
    u16_Array8_type
      element u16_Array8: category=VALUE, array-size=8, array-size-semantics=FIXED-SIZE, base-type=uint16
    u32_Array8_type
      element u32_Array8: category=VALUE, array-size=8, array-size-semantics=FIXED-SIZE, base-type=uint32
    u8_Array17_type
      element u8_Array17: category=VALUE, array-size=17, array-size-semantics=FIXED-SIZE, base-type=uint8
    u8_Array20_type
      element u8_Array20: category=VALUE, array-size=20, array-size-semantics=FIXED-SIZE, base-type=uint8
    u8_Array12_type
      element u8_Array12: category=VALUE, array-size=12, array-size-semantics=FIXED-SIZE, base-type=uint8
