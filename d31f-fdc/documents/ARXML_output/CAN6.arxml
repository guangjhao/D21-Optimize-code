AUTOSAR XML (schema 4-3-0)
package /CAN6/ISignalGroup
  12 x i signal group:
    CAN6_SG_FCM1: i-signal=[CAN6_ACC_ComfortBandLower, CAN6_ACC_ComfortBandUpper, CAN6_ACC_JerkLowerLimit, CAN6_ACC_JerkUpperLimit, CAN6_ACC_ObjDist, CAN6_ACC_ObjDstLvl, CAN6_ACC_ObjRelSpd, CAN6_ACC_RequiredAccel, CAN6_ACC_TakeoverReq, CAN6_ACC_VehHoldReq, CAN6_ADAS_ACC_Sta, CAN6_ADAS_AEBReq, CAN6_ADAS_AEB_Sta, CAN6_ADAS_CAM_SpdLim, CAN6_ADAS_DBSReq, CAN6_ADAS_FCW_Mute, CAN6_ADAS_FCW_Sensitivity, CAN6_ADAS_FCW_Sta, CAN6_ADAS_FaultSta, CAN6_ADAS_FltWrnReq, CAN6_ADAS_ForceIdle, CAN6_ADAS_ISA_Sta, CAN6_ADAS_LDW_Mute, CAN6_ADAS_LDW_Sensitivity, CAN6_ADAS_LDW_Sta, CAN6_ADAS_LFC_Hands_Off_Warning, CAN6_ADAS_LFC_Sta, CAN6_ADAS_LFC_Warn_Sound, CAN6_ADAS_LKA_Sta, CAN6_ADAS_LaneModeL, CAN6_ADAS_LaneModeR, CAN6_ADAS_Lane_curveL, CAN6_ADAS_Lane_curveR, CAN6_ADAS_LanetypeL, CAN6_ADAS_LanetypeR, CAN6_ADAS_SLIF_SpdLim, CAN6_ADAS_SLIF_Sta, CAN6_ADAS_ShftPosnReq, CAN6_ADAS_ShftPosnReq_A, CAN6_ADAS_VehSpdLim, CAN6_ADAS_WarningMsg, CAN6_AEB_VehHoldReq, CAN6_CameraBlockage, CAN6_FCM1_Checksum, CAN6_FCM1_LifeCount, CAN6_FCM_ACCmode, CAN6_FCM_LKA_StrToqReq, CAN6_FCM_LKA_TOIAct, CAN6_FCM_LKA_TOIFault, CAN6_ForceLowBeam, CAN6_HazardWarningReq, CAN6_ISA_WarningMsg, CAN6_LKA_HOD_Display_Warning, CAN6_LKA_HOD_Sound_Warning, CAN6_LVDA_ACCStatusInformation, CAN6_LVDA_Disabled, CAN6_LVDA_Failinfo, CAN6_LVDA_Mute_Sta, CAN6_LVDA_Warning, CAN6_LeftTurnLightReq, CAN6_RightTurnLightReq, CAN6_Target_Type, CAN6_TimeGapLevel], system-signal-group=CAN6_SG_FCM1
    CAN6_SG_FCM2: i-signal=[CAN6_ADB_FR_CMR_Sta, CAN6_ADB_ILLAmbtSta, CAN6_ADB_VehDst10Val, CAN6_ADB_VehDst1Val, CAN6_ADB_VehDst2Val, CAN6_ADB_VehDst3Val, CAN6_ADB_VehDst4Val, CAN6_ADB_VehDst5Val, CAN6_ADB_VehDst6Val, CAN6_ADB_VehDst7Val, CAN6_ADB_VehDst8Val, CAN6_ADB_VehDst9Val, CAN6_ADB_VehLtAngl10Val, CAN6_ADB_VehLtAngl1Val, CAN6_ADB_VehLtAngl2Val, CAN6_ADB_VehLtAngl3Val, CAN6_ADB_VehLtAngl4Val, CAN6_ADB_VehLtAngl5Val, CAN6_ADB_VehLtAngl6Val, CAN6_ADB_VehLtAngl7Val, CAN6_ADB_VehLtAngl8Val, CAN6_ADB_VehLtAngl9Val, CAN6_ADB_VehNumVal, CAN6_ADB_VehRtAngl10Val, CAN6_ADB_VehRtAngl1Val, CAN6_ADB_VehRtAngl2Val, CAN6_ADB_VehRtAngl3Val, CAN6_ADB_VehRtAngl4Val, CAN6_ADB_VehRtAngl5Val, CAN6_ADB_VehRtAngl6Val, CAN6_ADB_VehRtAngl7Val, CAN6_ADB_VehRtAngl8Val, CAN6_ADB_VehRtAngl9Val, CAN6_FCM2_Checksum, CAN6_FCM2_LifeCount], system-signal-group=CAN6_SG_FCM2
    CAN6_SG_FCM3: i-signal=[CAN6_ME_Lane_CurvDervLt, CAN6_ME_Lane_CurvDervLt2, CAN6_ME_Lane_CurvDervRt, CAN6_ME_Lane_CurvDervRt2, CAN6_ME_Lane_CurvLt, CAN6_ME_Lane_CurvLt2, CAN6_ME_Lane_CurvRt, CAN6_ME_Lane_CurvRt2, CAN6_ME_Lane_HeadAngLt, CAN6_ME_Lane_HeadAngLt2, CAN6_ME_Lane_HeadAngRt, CAN6_ME_Lane_HeadAngRt2, CAN6_ME_Lane_PosLt, CAN6_ME_Lane_PosLt2, CAN6_ME_Lane_PosRt, CAN6_ME_Lane_PosRt2], system-signal-group=CAN6_SG_FCM3
    CAN6_SG_FCM4: i-signal=[CAN6_ADAS_AngCtrlTqWeightGain, CAN6_ADAS_DesStrWhlAngCtrlCmd, CAN6_ADAS_DrvInputTqBoostAct, CAN6_ADAS_DrvInputTqBoostGain, CAN6_ADAS_MaxAngCtrlOutTqLimit, CAN6_ADAS_StrWhlAngCtrlStatus, CAN6_FCM4_Checksum, CAN6_FCM4_LifeCount], system-signal-group=CAN6_SG_FCM4
    CAN6_SG_FD6_APS3: i-signal=[CAN6_APS3_LifeCount, CAN6_APS3_checksum, CAN6_APSOpenPTG, CAN6_APS_DecReq, CAN6_APS_DecReq_A, CAN6_APS_Req, CAN6_APS_Sta_System, CAN6_CAAS_Sta, CAN6_FDC_VMC_APS_Angle_Target, CAN6_FDC_VMC_APS_Rq_EPS_Ctrl, CAN6_FDC_VMC_APS_V_Rq_EPS_Ctrl, CAN6_SPTGDet, CAN6_SPTG_Sta], system-signal-group=CAN6_SG_FD6_APS3
    CAN6_SG_FD6_BCM1: i-signal=[CAN6_AllDoorSW, CAN6_AntiTheftSeatFold, CAN6_AntitheftSta, CAN6_BCM_Buzzer_Req, CAN6_BCM_DoorLock_Sta, CAN6_BrakeLamp, CAN6_CTDCtrl, CAN6_CTDLockSW, CAN6_CTDUnlockSW, CAN6_CrashDetd, CAN6_Dimmer, CAN6_DimmerEN, CAN6_DoorLockIND, CAN6_DrDoorSW, CAN6_Fr_ChargingDoorCtrl, CAN6_Fr_FogLamp, CAN6_Fr_Wiper_H, CAN6_Fr_Wiper_L, CAN6_H_Beam, CAN6_HazardSW, CAN6_HoodSW, CAN6_HornCtrl, CAN6_LBSD, CAN6_LDRL, CAN6_LTurnLP, CAN6_L_APM_WdwEnable, CAN6_L_Beam, CAN6_LockSetting, CAN6_MirrorCtrl, CAN6_MirrorDefog, CAN6_PosLamp, CAN6_PsDoorSW, CAN6_RBSD, CAN6_RDRL, CAN6_RLDoorSW, CAN6_RRDoorSW, CAN6_RTurnLP, CAN6_ReverseLamp, CAN6_RoomLampH, CAN6_RoomLampL, CAN6_Rr_ChargingDoorCtrl, CAN6_Rr_Defog, CAN6_Rr_FogLamp, CAN6_Rr_Wiper, CAN6_TailgateHDSW, CAN6_TailgateRemote, CAN6_Tailgate_SW, CAN6_TrunkRel, CAN6_WasherCtrl, CAN6_WiperFixMode], system-signal-group=CAN6_SG_FD6_BCM1
    CAN6_SG_FD6_VCU1: i-signal=[CAN6_CC_Crl_Sta, CAN6_Eng_AGSCloseSta, CAN6_Eng_ActvDmpDisabSta, CAN6_Eng_CoastDwSta, CAN6_Eng_PwrLockSta, CAN6_HVPwrSta, CAN6_LVPwrSta, CAN6_MSA_Crl_Sta, CAN6_P_Button_Sta, CAN6_PrkReq, CAN6_PrkReqValid, CAN6_PwrSta, CAN6_ShiftGearPosn, CAN6_VCU_OPDHold, CAN6_VehMalfunLevel, CAN6_XWDMode], system-signal-group=CAN6_SG_FD6_VCU1
    CAN6_SG_FD6_VCU2: i-signal=[CAN6_ACC_CtrlAvail, CAN6_AccPedal_Override, CAN6_ActAPSPosn, CAN6_CS_VCU2_CAN6, CAN6_DriverTq, CAN6_Fr_DriverTq, CAN6_RC_VCU2_CAN6, CAN6_Rr_DriverTq, CAN6_VehActPwr], system-signal-group=CAN6_SG_FD6_VCU2
    CAN6_SG_FD6_VMC1: i-signal=[CAN6_AccCalcuPID, CAN6_CCMSA_SpdWar, CAN6_DISCReqAcc, CAN6_DISC_ButtSta, CAN6_DISC_DISCTargetSpd, CAN6_DISC_DISCTurn, CAN6_DISC_Sta, CAN6_FDC_VMC_LongAccel_Cmd, CAN6_FeatArbitrFinal, CAN6_FeatArbitrSta, CAN6_FeatReqSpd, CAN6_FeatSetSpdFinal_raw32, CAN6_FrontRearSlipRatioCtrl, CAN6_JerkPCT, CAN6_LatAccCtrl, CAN6_LateralCtrl, CAN6_LimitPCT, CAN6_MeterIndSpeed_raw32, CAN6_RearWhlSlipRatioCtrl, CAN6_SPD2ACCAct, CAN6_SafetyCtrl, CAN6_SingleWhlSlipRatioCtrl, CAN6_TimeGapCalcu, CAN6_VMC_ACCCtrlAvail, CAN6_VMC_AEBCtrlAvail, CAN6_VMC_CCCtrlAvail, CAN6_VMC_MSACtrlAvail, CAN6_VMC_VCU_ACC_CtrlAvail, CAN6_VMC_VCU_APSCtrlAvail_flg, CAN6_VMC_VCU_AccPedal_Override, CAN6_VMC_VCU_CC_Crl_Sta, CAN6_VMC_VCU_MSA_Crl_Sta, CAN6_VehicleSpeed_kph, CAN6_VehicleSpeed_mph], system-signal-group=CAN6_SG_FD6_VMC1
    CAN6_SG_GW6_CE100_0: i-signal=[CAN6_FDC_BCM_DimSw, CAN6_FDC_BCM_FWipSw_Sta, CAN6_FDC_BCM_LLeftSta_Cmd, CAN6_FDC_BCM_LRightSta_Cmd, CAN6_FDC_BCM_PassSW_Sta, CAN6_FDC_BCM_TurnSw_Sta, CAN6_FDC_VMC_SpdCtrlMode_Sta, CAN6_FDC_VMC_SpdCtrl_Sta], system-signal-group=CAN6_SG_GW6_CE100_0
    CAN6_SG_CGW_GW6_CE100_0: i-signal=[CAN6_IVI_Time_Day, CAN6_IVI_Time_Hour, CAN6_IVI_Time_Minute, CAN6_IVI_Time_Month, CAN6_IVI_Time_Second, CAN6_ODOMETER, CAN6_SWC2_L_ADAS_Sta, CAN6_SWC2_L_DriveMode_Sta, CAN6_SWC2_L_ScrollDown_Sta, CAN6_SWC2_L_ScrollPress_Sta, CAN6_SWC2_L_ScrollUp_Sta, CAN6_SWC2_R_Customize_Sta, CAN6_SWC_ACC_Sta, CAN6_SWC_CANCEL_Sta, CAN6_SWC_Distance_Sta, CAN6_SWC_LKA_Sta, CAN6_SWC_Res_Up_Sta, CAN6_SWC_Set_down_Sta], system-signal-group=CAN6_SG_CGW_GW6_CE100_0
    CAN6_SG_SRR1: i-signal=[CAN6_SRR1_Chksum, CAN6_SRR1_LifeCount, CAN6_SRR_BSD_Mute, CAN6_SRR_BSD_SoundL, CAN6_SRR_BSD_SoundR, CAN6_SRR_BSD_Sta, CAN6_SRR_BSD_WarnL, CAN6_SRR_BSD_WarnR, CAN6_SRR_ODA_Mute, CAN6_SRR_ODA_SoundL, CAN6_SRR_ODA_SoundR, CAN6_SRR_ODA_Sta, CAN6_SRR_ODA_WarnL, CAN6_SRR_ODA_WarnR, CAN6_SRR_RCTA_Sta, CAN6_SRR_RCTA_WarnL, CAN6_SRR_RCTA_WarnR], system-signal-group=CAN6_SG_SRR1
package /CAN6/Cluster
  can cluster CAN6: baudrate=500, can-fd-baudrate=2000
    can physical channel CAN6: comm-connectors=ConnCAN6
      frame CAN6_DiagFuncReqFT: id 0x7D0, frame-length=8, can-addressing-mode=STANDARD, can-fd-frame-support=true, can-frame-rx-behavior=CAN-FD, can-frame-tx-behavior=CAN-FD
        n pdu CAN6_DiagFuncReqFT: length=8
      frame CAN6_DiagFuncReqOBD: id 0x7DF, frame-length=8, can-addressing-mode=STANDARD, can-fd-frame-support=true, can-frame-rx-behavior=CAN-FD, can-frame-tx-behavior=CAN-FD
        n pdu CAN6_DiagFuncReqOBD: length=8
      frame CAN6_DiagPhysReqToFCM: id 0x690, frame-length=8, can-addressing-mode=STANDARD, can-fd-frame-support=true, can-frame-rx-behavior=CAN-FD, can-frame-tx-behavior=CAN-FD
        n pdu CAN6_DiagPhysReqToFCM: length=8
      frame CAN6_DiagPhysReqToMRR: id 0x695, frame-length=8, can-addressing-mode=STANDARD, can-fd-frame-support=true, can-frame-rx-behavior=CAN-FD, can-frame-tx-behavior=CAN-FD
        n pdu CAN6_DiagPhysReqToMRR: length=8
      frame CAN6_DiagPhysReqToSRR_M: id 0x692, frame-length=8, can-addressing-mode=STANDARD, can-fd-frame-support=true, can-frame-rx-behavior=CAN-FD, can-frame-tx-behavior=CAN-FD
        n pdu CAN6_DiagPhysReqToSRR_M: length=8
      frame CAN6_DiagRespFromFCM: id 0x610, frame-length=8, can-addressing-mode=STANDARD, can-fd-frame-support=true, can-frame-rx-behavior=CAN-FD, can-frame-tx-behavior=CAN-FD
        n pdu CAN6_DiagRespFromFCM: length=8
      frame CAN6_DiagRespFromMRR: id 0x615, frame-length=8, can-addressing-mode=STANDARD, can-fd-frame-support=true, can-frame-rx-behavior=CAN-FD, can-frame-tx-behavior=CAN-FD
        n pdu CAN6_DiagRespFromMRR: length=8
      frame CAN6_DiagRespFromSRR_M: id 0x612, frame-length=8, can-addressing-mode=STANDARD, can-fd-frame-support=true, can-frame-rx-behavior=CAN-FD, can-frame-tx-behavior=CAN-FD
        n pdu CAN6_DiagRespFromSRR_M: length=8
      frame CAN6_FCM1: id 0x173, frame-length=32, can-addressing-mode=STANDARD, can-fd-frame-support=true, can-frame-rx-behavior=CAN-FD, can-frame-tx-behavior=CAN-FD
        pdu CAN6_FCM1: length=32, minimum-delay=0.0, transmission-mode-true-timing=cyclic-timing=time-period=0.01, unused-bit-pattern=0
          mapping CAN6_SG_FCM1: i-signal-group=CAN6_SG_FCM1, start-position=0, transfer-property=PENDING
          signal CAN6_ACC_ComfortBandLower: start 72, 9 bit, big-endian, i-signal-type=PRIMITIVE, init-value=constant-reference=Init_CAN6_ACC_ComfortBandLower, base-type=uint16, implementation-data-type=uint16, transfer-property=PENDING
          signal CAN6_ACC_ComfortBandUpper: start 56, 9 bit, big-endian, i-signal-type=PRIMITIVE, init-value=constant-reference=Init_CAN6_ACC_ComfortBandUpper, base-type=uint16, implementation-data-type=uint16, transfer-property=PENDING
          signal CAN6_ACC_JerkLowerLimit: start 79, 7 bit, big-endian, i-signal-type=PRIMITIVE, init-value=constant-reference=Init_CAN6_ACC_JerkLowerLimit, base-type=uint8, implementation-data-type=uint8, transfer-property=PENDING
          signal CAN6_ACC_JerkUpperLimit: start 63, 7 bit, big-endian, i-signal-type=PRIMITIVE, init-value=constant-reference=Init_CAN6_ACC_JerkUpperLimit, base-type=uint8, implementation-data-type=uint8, transfer-property=PENDING
          signal CAN6_ACC_ObjDist: start 102, 11 bit, big-endian, i-signal-type=PRIMITIVE, init-value=constant-reference=Init_CAN6_ACC_ObjDist, base-type=uint16, implementation-data-type=uint16, transfer-property=PENDING
          signal CAN6_ACC_ObjDstLvl: start 143, 3 bit, big-endian, i-signal-type=PRIMITIVE, init-value=constant-reference=Init_CAN6_ACC_ObjDstLvl, base-type=uint8, implementation-data-type=uint8, transfer-property=PENDING
          signal CAN6_ACC_ObjRelSpd: start 106, 11 bit, big-endian, i-signal-type=PRIMITIVE, init-value=constant-reference=Init_CAN6_ACC_ObjRelSpd, base-type=uint16, implementation-data-type=uint16, transfer-property=PENDING
          signal CAN6_ACC_RequiredAccel: start 40, 9 bit, big-endian, i-signal-type=PRIMITIVE, init-value=constant-reference=Init_CAN6_ACC_RequiredAccel, base-type=uint16, implementation-data-type=uint16, transfer-property=PENDING
          signal CAN6_ACC_TakeoverReq: start 156, 1 bit, big-endian, i-signal-type=PRIMITIVE, init-value=constant-reference=Init_CAN6_ACC_TakeoverReq, base-type=uint8, implementation-data-type=uint8, transfer-property=PENDING
          signal CAN6_ACC_VehHoldReq: start 30, 1 bit, big-endian, i-signal-type=PRIMITIVE, init-value=constant-reference=Init_CAN6_ACC_VehHoldReq, base-type=uint8, implementation-data-type=uint8, transfer-property=PENDING
          signal CAN6_ADAS_ACC_Sta: start 130, 3 bit, big-endian, i-signal-type=PRIMITIVE, init-value=constant-reference=Init_CAN6_ADAS_ACC_Sta, base-type=uint8, implementation-data-type=uint8, transfer-property=PENDING
          signal CAN6_ADAS_AEBReq: start 46, 3 bit, big-endian, i-signal-type=PRIMITIVE, init-value=constant-reference=Init_CAN6_ADAS_AEBReq, base-type=uint8, implementation-data-type=uint8, transfer-property=PENDING
          signal CAN6_ADAS_AEB_Sta: start 126, 3 bit, big-endian, i-signal-type=PRIMITIVE, init-value=constant-reference=Init_CAN6_ADAS_AEB_Sta, base-type=uint8, implementation-data-type=uint8, transfer-property=PENDING
          signal CAN6_ADAS_CAM_SpdLim: start 167, 5 bit, big-endian, i-signal-type=PRIMITIVE, init-value=constant-reference=Init_CAN6_ADAS_CAM_SpdLim, base-type=uint8, implementation-data-type=uint8, transfer-property=PENDING
          signal CAN6_ADAS_DBSReq: start 29, 2 bit, big-endian, i-signal-type=PRIMITIVE, init-value=constant-reference=Init_CAN6_ADAS_DBSReq, base-type=uint8, implementation-data-type=uint8, transfer-property=PENDING
          signal CAN6_ADAS_FCW_Mute: start 197, 1 bit, big-endian, i-signal-type=PRIMITIVE, init-value=constant-reference=Init_CAN6_ADAS_FCW_Mute, base-type=uint8, implementation-data-type=uint8, transfer-property=PENDING
          signal CAN6_ADAS_FCW_Sensitivity: start 199, 1 bit, big-endian, i-signal-type=PRIMITIVE, init-value=constant-reference=Init_CAN6_ADAS_FCW_Sensitivity, base-type=uint8, implementation-data-type=uint8, transfer-property=PENDING
          signal CAN6_ADAS_FCW_Sta: start 122, 3 bit, big-endian, i-signal-type=PRIMITIVE, init-value=constant-reference=Init_CAN6_ADAS_FCW_Sta, base-type=uint8, implementation-data-type=uint8, transfer-property=PENDING
          signal CAN6_ADAS_FaultSta: start 47, 1 bit, big-endian, i-signal-type=PRIMITIVE, init-value=constant-reference=Init_CAN6_ADAS_FaultSta, base-type=uint8, implementation-data-type=uint8, transfer-property=PENDING
          signal CAN6_ADAS_FltWrnReq: start 131, 1 bit, big-endian, i-signal-type=PRIMITIVE, init-value=constant-reference=Init_CAN6_ADAS_FltWrnReq, base-type=uint8, implementation-data-type=uint8, transfer-property=PENDING
          signal CAN6_ADAS_ForceIdle: start 107, 1 bit, big-endian, i-signal-type=PRIMITIVE, init-value=constant-reference=Init_CAN6_ADAS_ForceIdle, base-type=uint8, implementation-data-type=uint8, transfer-property=PENDING
          signal CAN6_ADAS_ISA_Sta: start 147, 4 bit, big-endian, i-signal-type=PRIMITIVE, init-value=constant-reference=Init_CAN6_ADAS_ISA_Sta, base-type=uint8, implementation-data-type=uint8, transfer-property=PENDING
          signal CAN6_ADAS_LDW_Mute: start 198, 1 bit, big-endian, i-signal-type=PRIMITIVE, init-value=constant-reference=Init_CAN6_ADAS_LDW_Mute, base-type=uint8, implementation-data-type=uint8, transfer-property=PENDING
          signal CAN6_ADAS_LDW_Sensitivity: start 187, 1 bit, big-endian, i-signal-type=PRIMITIVE, init-value=constant-reference=Init_CAN6_ADAS_LDW_Sensitivity, base-type=uint8, implementation-data-type=uint8, transfer-property=PENDING
          signal CAN6_ADAS_LDW_Sta: start 134, 3 bit, big-endian, i-signal-type=PRIMITIVE, init-value=constant-reference=Init_CAN6_ADAS_LDW_Sta, base-type=uint8, implementation-data-type=uint8, transfer-property=PENDING
          signal CAN6_ADAS_LFC_Hands_Off_Warning: start 196, 2 bit, big-endian, i-signal-type=PRIMITIVE, init-value=constant-reference=Init_CAN6_ADAS_LFC_Hands_Off_Warning, base-type=uint8, implementation-data-type=uint8, transfer-property=PENDING
          signal CAN6_ADAS_LFC_Sta: start 180, 3 bit, big-endian, i-signal-type=PRIMITIVE, init-value=constant-reference=Init_CAN6_ADAS_LFC_Sta, base-type=uint8, implementation-data-type=uint8, transfer-property=PENDING
          signal CAN6_ADAS_LFC_Warn_Sound: start 204, 8 bit, big-endian, i-signal-type=PRIMITIVE, init-value=constant-reference=Init_CAN6_ADAS_LFC_Warn_Sound, base-type=uint8, implementation-data-type=uint8, transfer-property=PENDING
          signal CAN6_ADAS_LKA_Sta: start 168, 3 bit, big-endian, i-signal-type=PRIMITIVE, init-value=constant-reference=Init_CAN6_ADAS_LKA_Sta, base-type=uint8, implementation-data-type=uint8, transfer-property=PENDING
          signal CAN6_ADAS_LaneModeL: start 177, 3 bit, big-endian, i-signal-type=PRIMITIVE, init-value=constant-reference=Init_CAN6_ADAS_LaneModeL, base-type=uint8, implementation-data-type=uint8, transfer-property=PENDING
          signal CAN6_ADAS_LaneModeR: start 190, 3 bit, big-endian, i-signal-type=PRIMITIVE, init-value=constant-reference=Init_CAN6_ADAS_LaneModeR, base-type=uint8, implementation-data-type=uint8, transfer-property=PENDING
          signal CAN6_ADAS_Lane_curveL: start 222, 7 bit, big-endian, i-signal-type=PRIMITIVE, init-value=constant-reference=Init_CAN6_ADAS_Lane_curveL, base-type=uint8, implementation-data-type=uint8, transfer-property=PENDING
          signal CAN6_ADAS_Lane_curveR: start 230, 7 bit, big-endian, i-signal-type=PRIMITIVE, init-value=constant-reference=Init_CAN6_ADAS_Lane_curveR, base-type=uint8, implementation-data-type=uint8, transfer-property=PENDING
          signal CAN6_ADAS_LanetypeL: start 208, 2 bit, big-endian, i-signal-type=PRIMITIVE, init-value=constant-reference=Init_CAN6_ADAS_LanetypeL, base-type=uint8, implementation-data-type=uint8, transfer-property=PENDING
          signal CAN6_ADAS_LanetypeR: start 210, 2 bit, big-endian, i-signal-type=PRIMITIVE, init-value=constant-reference=Init_CAN6_ADAS_LanetypeR, base-type=uint8, implementation-data-type=uint8, transfer-property=PENDING
          signal CAN6_ADAS_SLIF_SpdLim: start 174, 5 bit, big-endian, i-signal-type=PRIMITIVE, init-value=constant-reference=Init_CAN6_ADAS_SLIF_SpdLim, base-type=uint8, implementation-data-type=uint8, transfer-property=PENDING
          signal CAN6_ADAS_SLIF_Sta: start 186, 3 bit, big-endian, i-signal-type=PRIMITIVE, init-value=constant-reference=Init_CAN6_ADAS_SLIF_Sta, base-type=uint8, implementation-data-type=uint8, transfer-property=PENDING
          signal CAN6_ADAS_ShftPosnReq: start 43, 3 bit, big-endian, i-signal-type=PRIMITIVE, init-value=constant-reference=Init_CAN6_ADAS_ShftPosnReq, base-type=uint8, implementation-data-type=uint8, transfer-property=PENDING
          signal CAN6_ADAS_ShftPosnReq_A: start 103, 1 bit, big-endian, i-signal-type=PRIMITIVE, init-value=constant-reference=Init_CAN6_ADAS_ShftPosnReq_A, base-type=uint8, implementation-data-type=uint8, transfer-property=PENDING
          signal CAN6_ADAS_VehSpdLim: start 95, 8 bit, big-endian, i-signal-type=PRIMITIVE, init-value=constant-reference=Init_CAN6_ADAS_VehSpdLim, base-type=uint8, implementation-data-type=uint8, transfer-property=PENDING
          signal CAN6_ADAS_WarningMsg: start 155, 4 bit, big-endian, i-signal-type=PRIMITIVE, init-value=constant-reference=Init_CAN6_ADAS_WarningMsg, base-type=uint8, implementation-data-type=uint8, transfer-property=PENDING
          signal CAN6_AEB_VehHoldReq: start 27, 1 bit, big-endian, i-signal-type=PRIMITIVE, init-value=constant-reference=Init_CAN6_AEB_VehHoldReq, base-type=uint8, implementation-data-type=uint8, transfer-property=PENDING
          signal CAN6_CameraBlockage: start 157, 1 bit, big-endian, i-signal-type=PRIMITIVE, init-value=constant-reference=Init_CAN6_CameraBlockage, base-type=uint8, implementation-data-type=uint8, transfer-property=PENDING
          signal CAN6_FCM1_Checksum: start 7, 8 bit, big-endian, i-signal-type=PRIMITIVE, init-value=constant-reference=Init_CAN6_FCM1_Checksum, base-type=uint8, implementation-data-type=uint8, transfer-property=PENDING
          signal CAN6_FCM1_LifeCount: start 11, 4 bit, big-endian, i-signal-type=PRIMITIVE, init-value=constant-reference=Init_CAN6_FCM1_LifeCount, base-type=uint8, implementation-data-type=uint8, transfer-property=PENDING
          signal CAN6_FCM_ACCmode: start 212, 2 bit, big-endian, i-signal-type=PRIMITIVE, init-value=constant-reference=Init_CAN6_FCM_ACCmode, base-type=uint8, implementation-data-type=uint8, transfer-property=PENDING
          signal CAN6_FCM_LKA_StrToqReq: start 26, 11 bit, big-endian, i-signal-type=PRIMITIVE, init-value=constant-reference=Init_CAN6_FCM_LKA_StrToqReq, base-type=uint16, implementation-data-type=uint16, transfer-property=PENDING
          signal CAN6_FCM_LKA_TOIAct: start 23, 8 bit, big-endian, i-signal-type=PRIMITIVE, init-value=constant-reference=Init_CAN6_FCM_LKA_TOIAct, base-type=uint8, implementation-data-type=uint8, transfer-property=PENDING
          signal CAN6_FCM_LKA_TOIFault: start 31, 1 bit, big-endian, i-signal-type=PRIMITIVE, init-value=constant-reference=Init_CAN6_FCM_LKA_TOIFault, base-type=uint8, implementation-data-type=uint8, transfer-property=PENDING
          signal CAN6_ForceLowBeam: start 140, 2 bit, big-endian, i-signal-type=PRIMITIVE, init-value=constant-reference=Init_CAN6_ForceLowBeam, base-type=uint8, implementation-data-type=uint8, transfer-property=PENDING
          signal CAN6_HazardWarningReq: start 127, 1 bit, big-endian, i-signal-type=PRIMITIVE, init-value=constant-reference=Init_CAN6_HazardWarningReq, base-type=uint8, implementation-data-type=uint8, transfer-property=PENDING
          signal CAN6_ISA_WarningMsg: start 151, 4 bit, big-endian, i-signal-type=PRIMITIVE, init-value=constant-reference=Init_CAN6_ISA_WarningMsg, base-type=uint8, implementation-data-type=uint8, transfer-property=PENDING
          signal CAN6_LKA_HOD_Display_Warning: start 169, 1 bit, big-endian, i-signal-type=PRIMITIVE, init-value=constant-reference=Init_CAN6_LKA_HOD_Display_Warning, base-type=uint8, implementation-data-type=uint8, transfer-property=PENDING
          signal CAN6_LKA_HOD_Sound_Warning: start 181, 1 bit, big-endian, i-signal-type=PRIMITIVE, init-value=constant-reference=Init_CAN6_LKA_HOD_Sound_Warning, base-type=uint8, implementation-data-type=uint8, transfer-property=PENDING
          signal CAN6_LVDA_ACCStatusInformation: start 205, 1 bit, big-endian, i-signal-type=PRIMITIVE, init-value=constant-reference=Init_CAN6_LVDA_ACCStatusInformation, base-type=uint8, implementation-data-type=uint8, transfer-property=PENDING
          signal CAN6_LVDA_Disabled: start 194, 1 bit, big-endian, i-signal-type=PRIMITIVE, init-value=constant-reference=Init_CAN6_LVDA_Disabled, base-type=uint8, implementation-data-type=uint8, transfer-property=PENDING
          signal CAN6_LVDA_Failinfo: start 207, 1 bit, big-endian, i-signal-type=PRIMITIVE, init-value=constant-reference=Init_CAN6_LVDA_Failinfo, base-type=uint8, implementation-data-type=uint8, transfer-property=PENDING
          signal CAN6_LVDA_Mute_Sta: start 193, 2 bit, big-endian, i-signal-type=PRIMITIVE, init-value=constant-reference=Init_CAN6_LVDA_Mute_Sta, base-type=uint8, implementation-data-type=uint8, transfer-property=PENDING
          signal CAN6_LVDA_Warning: start 206, 1 bit, big-endian, i-signal-type=PRIMITIVE, init-value=constant-reference=Init_CAN6_LVDA_Warning, base-type=uint8, implementation-data-type=uint8, transfer-property=PENDING
          signal CAN6_LeftTurnLightReq: start 135, 1 bit, big-endian, i-signal-type=PRIMITIVE, init-value=constant-reference=Init_CAN6_LeftTurnLightReq, base-type=uint8, implementation-data-type=uint8, transfer-property=PENDING
          signal CAN6_RightTurnLightReq: start 123, 1 bit, big-endian, i-signal-type=PRIMITIVE, init-value=constant-reference=Init_CAN6_RightTurnLightReq, base-type=uint8, implementation-data-type=uint8, transfer-property=PENDING
          signal CAN6_Target_Type: start 162, 4 bit, big-endian, i-signal-type=PRIMITIVE, init-value=constant-reference=Init_CAN6_Target_Type, base-type=uint8, implementation-data-type=uint8, transfer-property=PENDING
          signal CAN6_TimeGapLevel: start 138, 3 bit, big-endian, i-signal-type=PRIMITIVE, init-value=constant-reference=Init_CAN6_TimeGapLevel, base-type=uint8, implementation-data-type=uint8, transfer-property=PENDING
      frame CAN6_FCM2: id 0x178, frame-length=32, can-addressing-mode=STANDARD, can-fd-frame-support=true, can-frame-rx-behavior=CAN-FD, can-frame-tx-behavior=CAN-FD
        pdu CAN6_FCM2: length=32, minimum-delay=0.0, transmission-mode-true-timing=cyclic-timing=time-period=0.05, unused-bit-pattern=0
          mapping CAN6_SG_FCM2: i-signal-group=CAN6_SG_FCM2, start-position=0, transfer-property=PENDING
          signal CAN6_ADB_FR_CMR_Sta: start 23, 2 bit, big-endian, i-signal-type=PRIMITIVE, init-value=constant-reference=Init_CAN6_ADB_FR_CMR_Sta, base-type=uint8, implementation-data-type=uint8, transfer-property=PENDING
          signal CAN6_ADB_ILLAmbtSta: start 17, 2 bit, big-endian, i-signal-type=PRIMITIVE, init-value=constant-reference=Init_CAN6_ADB_ILLAmbtSta, base-type=uint8, implementation-data-type=uint8, transfer-property=PENDING
          signal CAN6_ADB_VehDst10Val: start 247, 4 bit, big-endian, i-signal-type=PRIMITIVE, init-value=constant-reference=Init_CAN6_ADB_VehDst10Val, base-type=uint8, implementation-data-type=uint8, transfer-property=PENDING
          signal CAN6_ADB_VehDst1Val: start 203, 4 bit, big-endian, i-signal-type=PRIMITIVE, init-value=constant-reference=Init_CAN6_ADB_VehDst1Val, base-type=uint8, implementation-data-type=uint8, transfer-property=PENDING
          signal CAN6_ADB_VehDst2Val: start 215, 4 bit, big-endian, i-signal-type=PRIMITIVE, init-value=constant-reference=Init_CAN6_ADB_VehDst2Val, base-type=uint8, implementation-data-type=uint8, transfer-property=PENDING
          signal CAN6_ADB_VehDst3Val: start 211, 4 bit, big-endian, i-signal-type=PRIMITIVE, init-value=constant-reference=Init_CAN6_ADB_VehDst3Val, base-type=uint8, implementation-data-type=uint8, transfer-property=PENDING
          signal CAN6_ADB_VehDst4Val: start 223, 4 bit, big-endian, i-signal-type=PRIMITIVE, init-value=constant-reference=Init_CAN6_ADB_VehDst4Val, base-type=uint8, implementation-data-type=uint8, transfer-property=PENDING
          signal CAN6_ADB_VehDst5Val: start 219, 4 bit, big-endian, i-signal-type=PRIMITIVE, init-value=constant-reference=Init_CAN6_ADB_VehDst5Val, base-type=uint8, implementation-data-type=uint8, transfer-property=PENDING
          signal CAN6_ADB_VehDst6Val: start 231, 4 bit, big-endian, i-signal-type=PRIMITIVE, init-value=constant-reference=Init_CAN6_ADB_VehDst6Val, base-type=uint8, implementation-data-type=uint8, transfer-property=PENDING
          signal CAN6_ADB_VehDst7Val: start 227, 4 bit, big-endian, i-signal-type=PRIMITIVE, init-value=constant-reference=Init_CAN6_ADB_VehDst7Val, base-type=uint8, implementation-data-type=uint8, transfer-property=PENDING
          signal CAN6_ADB_VehDst8Val: start 239, 4 bit, big-endian, i-signal-type=PRIMITIVE, init-value=constant-reference=Init_CAN6_ADB_VehDst8Val, base-type=uint8, implementation-data-type=uint8, transfer-property=PENDING
          signal CAN6_ADB_VehDst9Val: start 235, 4 bit, big-endian, i-signal-type=PRIMITIVE, init-value=constant-reference=Init_CAN6_ADB_VehDst9Val, base-type=uint8, implementation-data-type=uint8, transfer-property=PENDING
          signal CAN6_ADB_VehLtAngl10Val: start 189, 9 bit, big-endian, i-signal-type=PRIMITIVE, init-value=constant-reference=Init_CAN6_ADB_VehLtAngl10Val, base-type=uint16, implementation-data-type=uint16, transfer-property=PENDING
          signal CAN6_ADB_VehLtAngl1Val: start 31, 9 bit, big-endian, i-signal-type=PRIMITIVE, init-value=constant-reference=Init_CAN6_ADB_VehLtAngl1Val, base-type=uint16, implementation-data-type=uint16, transfer-property=PENDING
          signal CAN6_ADB_VehLtAngl2Val: start 45, 9 bit, big-endian, i-signal-type=PRIMITIVE, init-value=constant-reference=Init_CAN6_ADB_VehLtAngl2Val, base-type=uint16, implementation-data-type=uint16, transfer-property=PENDING
          signal CAN6_ADB_VehLtAngl3Val: start 59, 9 bit, big-endian, i-signal-type=PRIMITIVE, init-value=constant-reference=Init_CAN6_ADB_VehLtAngl3Val, base-type=uint16, implementation-data-type=uint16, transfer-property=PENDING
          signal CAN6_ADB_VehLtAngl4Val: start 73, 9 bit, big-endian, i-signal-type=PRIMITIVE, init-value=constant-reference=Init_CAN6_ADB_VehLtAngl4Val, base-type=uint16, implementation-data-type=uint16, transfer-property=PENDING
          signal CAN6_ADB_VehLtAngl5Val: start 103, 9 bit, big-endian, i-signal-type=PRIMITIVE, init-value=constant-reference=Init_CAN6_ADB_VehLtAngl5Val, base-type=uint16, implementation-data-type=uint16, transfer-property=PENDING
          signal CAN6_ADB_VehLtAngl6Val: start 117, 9 bit, big-endian, i-signal-type=PRIMITIVE, init-value=constant-reference=Init_CAN6_ADB_VehLtAngl6Val, base-type=uint16, implementation-data-type=uint16, transfer-property=PENDING
          signal CAN6_ADB_VehLtAngl7Val: start 131, 9 bit, big-endian, i-signal-type=PRIMITIVE, init-value=constant-reference=Init_CAN6_ADB_VehLtAngl7Val, base-type=uint16, implementation-data-type=uint16, transfer-property=PENDING
          signal CAN6_ADB_VehLtAngl8Val: start 145, 9 bit, big-endian, i-signal-type=PRIMITIVE, init-value=constant-reference=Init_CAN6_ADB_VehLtAngl8Val, base-type=uint16, implementation-data-type=uint16, transfer-property=PENDING
          signal CAN6_ADB_VehLtAngl9Val: start 175, 9 bit, big-endian, i-signal-type=PRIMITIVE, init-value=constant-reference=Init_CAN6_ADB_VehLtAngl9Val, base-type=uint16, implementation-data-type=uint16, transfer-property=PENDING
          signal CAN6_ADB_VehNumVal: start 21, 4 bit, big-endian, i-signal-type=PRIMITIVE, init-value=constant-reference=Init_CAN6_ADB_VehNumVal, base-type=uint8, implementation-data-type=uint8, transfer-property=PENDING
          signal CAN6_ADB_VehRtAngl10Val: start 196, 9 bit, big-endian, i-signal-type=PRIMITIVE, init-value=constant-reference=Init_CAN6_ADB_VehRtAngl10Val, base-type=uint16, implementation-data-type=uint16, transfer-property=PENDING
          signal CAN6_ADB_VehRtAngl1Val: start 38, 9 bit, big-endian, i-signal-type=PRIMITIVE, init-value=constant-reference=Init_CAN6_ADB_VehRtAngl1Val, base-type=uint16, implementation-data-type=uint16, transfer-property=PENDING
          signal CAN6_ADB_VehRtAngl2Val: start 52, 9 bit, big-endian, i-signal-type=PRIMITIVE, init-value=constant-reference=Init_CAN6_ADB_VehRtAngl2Val, base-type=uint16, implementation-data-type=uint16, transfer-property=PENDING
          signal CAN6_ADB_VehRtAngl3Val: start 66, 9 bit, big-endian, i-signal-type=PRIMITIVE, init-value=constant-reference=Init_CAN6_ADB_VehRtAngl3Val, base-type=uint16, implementation-data-type=uint16, transfer-property=PENDING
          signal CAN6_ADB_VehRtAngl4Val: start 80, 9 bit, big-endian, i-signal-type=PRIMITIVE, init-value=constant-reference=Init_CAN6_ADB_VehRtAngl4Val, base-type=uint16, implementation-data-type=uint16, transfer-property=PENDING
          signal CAN6_ADB_VehRtAngl5Val: start 110, 9 bit, big-endian, i-signal-type=PRIMITIVE, init-value=constant-reference=Init_CAN6_ADB_VehRtAngl5Val, base-type=uint16, implementation-data-type=uint16, transfer-property=PENDING
          signal CAN6_ADB_VehRtAngl6Val: start 124, 9 bit, big-endian, i-signal-type=PRIMITIVE, init-value=constant-reference=Init_CAN6_ADB_VehRtAngl6Val, base-type=uint16, implementation-data-type=uint16, transfer-property=PENDING
          signal CAN6_ADB_VehRtAngl7Val: start 138, 9 bit, big-endian, i-signal-type=PRIMITIVE, init-value=constant-reference=Init_CAN6_ADB_VehRtAngl7Val, base-type=uint16, implementation-data-type=uint16, transfer-property=PENDING
          signal CAN6_ADB_VehRtAngl8Val: start 152, 9 bit, big-endian, i-signal-type=PRIMITIVE, init-value=constant-reference=Init_CAN6_ADB_VehRtAngl8Val, base-type=uint16, implementation-data-type=uint16, transfer-property=PENDING
          signal CAN6_ADB_VehRtAngl9Val: start 182, 9 bit, big-endian, i-signal-type=PRIMITIVE, init-value=constant-reference=Init_CAN6_ADB_VehRtAngl9Val, base-type=uint16, implementation-data-type=uint16, transfer-property=PENDING
          signal CAN6_FCM2_Checksum: start 7, 8 bit, big-endian, i-signal-type=PRIMITIVE, init-value=constant-reference=Init_CAN6_FCM2_Checksum, base-type=uint8, implementation-data-type=uint8, transfer-property=PENDING
          signal CAN6_FCM2_LifeCount: start 11, 4 bit, big-endian, i-signal-type=PRIMITIVE, init-value=constant-reference=Init_CAN6_FCM2_LifeCount, base-type=uint8, implementation-data-type=uint8, transfer-property=PENDING
      frame CAN6_FCM3: id 0x179, frame-length=32, can-addressing-mode=STANDARD, can-fd-frame-support=true, can-frame-rx-behavior=CAN-FD, can-frame-tx-behavior=CAN-FD
        pdu CAN6_FCM3: length=32, minimum-delay=0.0, transmission-mode-true-timing=cyclic-timing=time-period=0.05, unused-bit-pattern=0
          mapping CAN6_SG_FCM3: i-signal-group=CAN6_SG_FCM3, start-position=0, transfer-property=PENDING
          signal CAN6_ME_Lane_CurvDervLt: start 7, 16 bit, big-endian, i-signal-type=PRIMITIVE, init-value=constant-reference=Init_CAN6_ME_Lane_CurvDervLt, base-type=uint16, implementation-data-type=uint16, transfer-property=PENDING
          signal CAN6_ME_Lane_CurvDervLt2: start 23, 16 bit, big-endian, i-signal-type=PRIMITIVE, init-value=constant-reference=Init_CAN6_ME_Lane_CurvDervLt2, base-type=uint16, implementation-data-type=uint16, transfer-property=PENDING
          signal CAN6_ME_Lane_CurvDervRt: start 39, 16 bit, big-endian, i-signal-type=PRIMITIVE, init-value=constant-reference=Init_CAN6_ME_Lane_CurvDervRt, base-type=uint16, implementation-data-type=uint16, transfer-property=PENDING
          signal CAN6_ME_Lane_CurvDervRt2: start 55, 16 bit, big-endian, i-signal-type=PRIMITIVE, init-value=constant-reference=Init_CAN6_ME_Lane_CurvDervRt2, base-type=uint16, implementation-data-type=uint16, transfer-property=PENDING
          signal CAN6_ME_Lane_CurvLt: start 71, 16 bit, big-endian, i-signal-type=PRIMITIVE, init-value=constant-reference=Init_CAN6_ME_Lane_CurvLt, base-type=uint16, implementation-data-type=uint16, transfer-property=PENDING
          signal CAN6_ME_Lane_CurvLt2: start 87, 16 bit, big-endian, i-signal-type=PRIMITIVE, init-value=constant-reference=Init_CAN6_ME_Lane_CurvLt2, base-type=uint16, implementation-data-type=uint16, transfer-property=PENDING
          signal CAN6_ME_Lane_CurvRt: start 103, 16 bit, big-endian, i-signal-type=PRIMITIVE, init-value=constant-reference=Init_CAN6_ME_Lane_CurvRt, base-type=uint16, implementation-data-type=uint16, transfer-property=PENDING
          signal CAN6_ME_Lane_CurvRt2: start 119, 16 bit, big-endian, i-signal-type=PRIMITIVE, init-value=constant-reference=Init_CAN6_ME_Lane_CurvRt2, base-type=uint16, implementation-data-type=uint16, transfer-property=PENDING
          signal CAN6_ME_Lane_HeadAngLt: start 193, 10 bit, big-endian, i-signal-type=PRIMITIVE, init-value=constant-reference=Init_CAN6_ME_Lane_HeadAngLt, base-type=uint16, implementation-data-type=uint16, transfer-property=PENDING
          signal CAN6_ME_Lane_HeadAngLt2: start 209, 10 bit, big-endian, i-signal-type=PRIMITIVE, init-value=constant-reference=Init_CAN6_ME_Lane_HeadAngLt2, base-type=uint16, implementation-data-type=uint16, transfer-property=PENDING
          signal CAN6_ME_Lane_HeadAngRt: start 225, 10 bit, big-endian, i-signal-type=PRIMITIVE, init-value=constant-reference=Init_CAN6_ME_Lane_HeadAngRt, base-type=uint16, implementation-data-type=uint16, transfer-property=PENDING
          signal CAN6_ME_Lane_HeadAngRt2: start 241, 10 bit, big-endian, i-signal-type=PRIMITIVE, init-value=constant-reference=Init_CAN6_ME_Lane_HeadAngRt2, base-type=uint16, implementation-data-type=uint16, transfer-property=PENDING
          signal CAN6_ME_Lane_PosLt: start 130, 11 bit, big-endian, i-signal-type=PRIMITIVE, init-value=constant-reference=Init_CAN6_ME_Lane_PosLt, base-type=uint16, implementation-data-type=uint16, transfer-property=PENDING
          signal CAN6_ME_Lane_PosLt2: start 146, 11 bit, big-endian, i-signal-type=PRIMITIVE, init-value=constant-reference=Init_CAN6_ME_Lane_PosLt2, base-type=uint16, implementation-data-type=uint16, transfer-property=PENDING
          signal CAN6_ME_Lane_PosRt: start 162, 11 bit, big-endian, i-signal-type=PRIMITIVE, init-value=constant-reference=Init_CAN6_ME_Lane_PosRt, base-type=uint16, implementation-data-type=uint16, transfer-property=PENDING
          signal CAN6_ME_Lane_PosRt2: start 178, 11 bit, big-endian, i-signal-type=PRIMITIVE, init-value=constant-reference=Init_CAN6_ME_Lane_PosRt2, base-type=uint16, implementation-data-type=uint16, transfer-property=PENDING
      frame CAN6_FCM4: id 0x177, frame-length=32, can-addressing-mode=STANDARD, can-fd-frame-support=true, can-frame-rx-behavior=CAN-FD, can-frame-tx-behavior=CAN-FD
        pdu CAN6_FCM4: length=32, minimum-delay=0.0, transmission-mode-true-timing=cyclic-timing=time-period=0.01, unused-bit-pattern=0
          mapping CAN6_SG_FCM4: i-signal-group=CAN6_SG_FCM4, start-position=0, transfer-property=PENDING
          signal CAN6_ADAS_AngCtrlTqWeightGain: start 47, 8 bit, big-endian, i-signal-type=PRIMITIVE, init-value=constant-reference=Init_CAN6_ADAS_AngCtrlTqWeightGain, base-type=uint8, implementation-data-type=uint8, transfer-property=PENDING
          signal CAN6_ADAS_DesStrWhlAngCtrlCmd: start 55, 16 bit, big-endian, i-signal-type=PRIMITIVE, init-value=constant-reference=Init_CAN6_ADAS_DesStrWhlAngCtrlCmd, base-type=uint16, implementation-data-type=uint16, transfer-property=PENDING
          signal CAN6_ADAS_DrvInputTqBoostAct: start 29, 1 bit, big-endian, i-signal-type=PRIMITIVE, init-value=constant-reference=Init_CAN6_ADAS_DrvInputTqBoostAct, base-type=uint8, implementation-data-type=uint8, transfer-property=PENDING
          signal CAN6_ADAS_DrvInputTqBoostGain: start 39, 8 bit, big-endian, i-signal-type=PRIMITIVE, init-value=constant-reference=Init_CAN6_ADAS_DrvInputTqBoostGain, base-type=uint8, implementation-data-type=uint8, transfer-property=PENDING
          signal CAN6_ADAS_MaxAngCtrlOutTqLimit: start 23, 9 bit, big-endian, i-signal-type=PRIMITIVE, init-value=constant-reference=Init_CAN6_ADAS_MaxAngCtrlOutTqLimit, base-type=uint16, implementation-data-type=uint16, transfer-property=PENDING
          signal CAN6_ADAS_StrWhlAngCtrlStatus: start 30, 1 bit, big-endian, i-signal-type=PRIMITIVE, init-value=constant-reference=Init_CAN6_ADAS_StrWhlAngCtrlStatus, base-type=uint8, implementation-data-type=uint8, transfer-property=PENDING
          signal CAN6_FCM4_Checksum: start 7, 8 bit, big-endian, i-signal-type=PRIMITIVE, init-value=constant-reference=Init_CAN6_FCM4_Checksum, base-type=uint8, implementation-data-type=uint8, transfer-property=PENDING
          signal CAN6_FCM4_LifeCount: start 11, 4 bit, big-endian, i-signal-type=PRIMITIVE, init-value=constant-reference=Init_CAN6_FCM4_LifeCount, base-type=uint8, implementation-data-type=uint8, transfer-property=PENDING
      frame CAN6_FD6_APS3: id 0x238, frame-length=16, can-addressing-mode=STANDARD, can-fd-frame-support=true, can-frame-rx-behavior=CAN-FD, can-frame-tx-behavior=CAN-FD
        pdu CAN6_FD6_APS3: length=16, minimum-delay=0.0, transmission-mode-true-timing=cyclic-timing=time-period=0.01, unused-bit-pattern=0
          mapping CAN6_SG_FD6_APS3: i-signal-group=CAN6_SG_FD6_APS3, start-position=0, transfer-property=PENDING
          signal CAN6_APS3_LifeCount: start 11, 4 bit, big-endian, i-signal-type=PRIMITIVE, init-value=constant-reference=Init_CAN6_APS3_LifeCount, base-type=uint8, implementation-data-type=uint8, transfer-property=PENDING
          signal CAN6_APS3_checksum: start 7, 8 bit, big-endian, i-signal-type=PRIMITIVE, init-value=constant-reference=Init_CAN6_APS3_checksum, base-type=uint8, implementation-data-type=uint8, transfer-property=PENDING
          signal CAN6_APSOpenPTG: start 16, 1 bit, big-endian, i-signal-type=PRIMITIVE, init-value=constant-reference=Init_CAN6_APSOpenPTG, base-type=uint8, implementation-data-type=uint8, transfer-property=PENDING
          signal CAN6_APS_DecReq: start 31, 8 bit, big-endian, i-signal-type=PRIMITIVE, init-value=constant-reference=Init_CAN6_APS_DecReq, base-type=uint8, implementation-data-type=uint8, transfer-property=PENDING
          signal CAN6_APS_DecReq_A: start 23, 1 bit, big-endian, i-signal-type=PRIMITIVE, init-value=constant-reference=Init_CAN6_APS_DecReq_A, base-type=uint8, implementation-data-type=uint8, transfer-property=PENDING
          signal CAN6_APS_Req: start 22, 3 bit, big-endian, i-signal-type=PRIMITIVE, init-value=constant-reference=Init_CAN6_APS_Req, base-type=uint8, implementation-data-type=uint8, transfer-property=PENDING
          signal CAN6_APS_Sta_System: start 50, 3 bit, big-endian, i-signal-type=PRIMITIVE, init-value=constant-reference=Init_CAN6_APS_Sta_System, base-type=uint8, implementation-data-type=uint8, transfer-property=PENDING
          signal CAN6_CAAS_Sta: start 19, 3 bit, big-endian, i-signal-type=PRIMITIVE, init-value=constant-reference=Init_CAN6_CAAS_Sta, base-type=uint8, implementation-data-type=uint8, transfer-property=PENDING
          signal CAN6_FDC_VMC_APS_Angle_Target: start 39, 16 bit, big-endian, i-signal-type=PRIMITIVE, init-value=constant-reference=Init_CAN6_FDC_VMC_APS_Angle_Target, base-type=uint16, implementation-data-type=uint16, transfer-property=PENDING
          signal CAN6_FDC_VMC_APS_Rq_EPS_Ctrl: start 56, 1 bit, big-endian, i-signal-type=PRIMITIVE, init-value=constant-reference=Init_CAN6_FDC_VMC_APS_Rq_EPS_Ctrl, base-type=uint8, implementation-data-type=uint8, transfer-property=PENDING
          signal CAN6_FDC_VMC_APS_V_Rq_EPS_Ctrl: start 51, 1 bit, big-endian, i-signal-type=PRIMITIVE, init-value=constant-reference=Init_CAN6_FDC_VMC_APS_V_Rq_EPS_Ctrl, base-type=uint8, implementation-data-type=uint8, transfer-property=PENDING
          signal CAN6_SPTGDet: start 55, 1 bit, big-endian, i-signal-type=PRIMITIVE, init-value=constant-reference=Init_CAN6_SPTGDet, base-type=uint8, implementation-data-type=uint8, transfer-property=PENDING
          signal CAN6_SPTG_Sta: start 54, 3 bit, big-endian, i-signal-type=PRIMITIVE, init-value=constant-reference=Init_CAN6_SPTG_Sta, base-type=uint8, implementation-data-type=uint8, transfer-property=PENDING
      frame CAN6_FD6_BCM1: id 0x216, frame-length=16, can-addressing-mode=STANDARD, can-fd-frame-support=true, can-frame-rx-behavior=CAN-FD, can-frame-tx-behavior=CAN-FD
        pdu CAN6_FD6_BCM1: length=16, minimum-delay=0.0, transmission-mode-true-timing={cyclic-timing=time-period=0.2, event-controlled-timing={number-of-repetitions=0, repetition-period=0}}, unused-bit-pattern=0
          mapping CAN6_SG_FD6_BCM1: i-signal-group=CAN6_SG_FD6_BCM1, start-position=0, transfer-property=TRIGGERED-ON-CHANGE
          signal CAN6_AllDoorSW: start 124, 1 bit, big-endian, i-signal-type=PRIMITIVE, init-value=constant-reference=Init_CAN6_AllDoorSW, base-type=uint8, implementation-data-type=uint8, transfer-property=TRIGGERED-ON-CHANGE
          signal CAN6_AntiTheftSeatFold: start 84, 1 bit, big-endian, i-signal-type=PRIMITIVE, init-value=constant-reference=Init_CAN6_AntiTheftSeatFold, base-type=uint8, implementation-data-type=uint8, transfer-property=TRIGGERED-ON-CHANGE
          signal CAN6_AntitheftSta: start 83, 2 bit, big-endian, i-signal-type=PRIMITIVE, init-value=constant-reference=Init_CAN6_AntitheftSta, base-type=uint8, implementation-data-type=uint8, transfer-property=TRIGGERED-ON-CHANGE
          signal CAN6_BCM_Buzzer_Req: start 64, 1 bit, big-endian, i-signal-type=PRIMITIVE, init-value=constant-reference=Init_CAN6_BCM_Buzzer_Req, base-type=uint8, implementation-data-type=uint8, transfer-property=TRIGGERED-ON-CHANGE
          signal CAN6_BCM_DoorLock_Sta: start 70, 1 bit, big-endian, i-signal-type=PRIMITIVE, init-value=constant-reference=Init_CAN6_BCM_DoorLock_Sta, base-type=uint8, implementation-data-type=uint8, transfer-property=TRIGGERED-ON-CHANGE
          signal CAN6_BrakeLamp: start 90, 1 bit, big-endian, i-signal-type=PRIMITIVE, init-value=constant-reference=Init_CAN6_BrakeLamp, base-type=uint8, implementation-data-type=uint8, transfer-property=TRIGGERED-ON-CHANGE
          signal CAN6_CTDCtrl: start 113, 2 bit, big-endian, i-signal-type=PRIMITIVE, init-value=constant-reference=Init_CAN6_CTDCtrl, base-type=uint8, implementation-data-type=uint8, transfer-property=TRIGGERED-ON-CHANGE
          signal CAN6_CTDLockSW: start 118, 1 bit, big-endian, i-signal-type=PRIMITIVE, init-value=constant-reference=Init_CAN6_CTDLockSW, base-type=uint8, implementation-data-type=uint8, transfer-property=TRIGGERED-ON-CHANGE
          signal CAN6_CTDUnlockSW: start 119, 1 bit, big-endian, i-signal-type=PRIMITIVE, init-value=constant-reference=Init_CAN6_CTDUnlockSW, base-type=uint8, implementation-data-type=uint8, transfer-property=TRIGGERED-ON-CHANGE
          signal CAN6_CrashDetd: start 85, 1 bit, big-endian, i-signal-type=PRIMITIVE, init-value=constant-reference=Init_CAN6_CrashDetd, base-type=uint8, implementation-data-type=uint8, transfer-property=TRIGGERED-ON-CHANGE
          signal CAN6_Dimmer: start 78, 7 bit, big-endian, i-signal-type=PRIMITIVE, init-value=constant-reference=Init_CAN6_Dimmer, base-type=uint8, implementation-data-type=uint8, transfer-property=TRIGGERED-ON-CHANGE
          signal CAN6_DimmerEN: start 69, 1 bit, big-endian, i-signal-type=PRIMITIVE, init-value=constant-reference=Init_CAN6_DimmerEN, base-type=uint8, implementation-data-type=uint8, transfer-property=TRIGGERED-ON-CHANGE
          signal CAN6_DoorLockIND: start 125, 1 bit, big-endian, i-signal-type=PRIMITIVE, init-value=constant-reference=Init_CAN6_DoorLockIND, base-type=uint8, implementation-data-type=uint8, transfer-property=TRIGGERED-ON-CHANGE
          signal CAN6_DrDoorSW: start 120, 1 bit, big-endian, i-signal-type=PRIMITIVE, init-value=constant-reference=Init_CAN6_DrDoorSW, base-type=uint8, implementation-data-type=uint8, transfer-property=TRIGGERED-ON-CHANGE
          signal CAN6_Fr_ChargingDoorCtrl: start 115, 2 bit, big-endian, i-signal-type=PRIMITIVE, init-value=constant-reference=Init_CAN6_Fr_ChargingDoorCtrl, base-type=uint8, implementation-data-type=uint8, transfer-property=TRIGGERED-ON-CHANGE
          signal CAN6_Fr_FogLamp: start 93, 1 bit, big-endian, i-signal-type=PRIMITIVE, init-value=constant-reference=Init_CAN6_Fr_FogLamp, base-type=uint8, implementation-data-type=uint8, transfer-property=TRIGGERED-ON-CHANGE
          signal CAN6_Fr_Wiper_H: start 110, 1 bit, big-endian, i-signal-type=PRIMITIVE, init-value=constant-reference=Init_CAN6_Fr_Wiper_H, base-type=uint8, implementation-data-type=uint8, transfer-property=TRIGGERED-ON-CHANGE
          signal CAN6_Fr_Wiper_L: start 111, 1 bit, big-endian, i-signal-type=PRIMITIVE, init-value=constant-reference=Init_CAN6_Fr_Wiper_L, base-type=uint8, implementation-data-type=uint8, transfer-property=TRIGGERED-ON-CHANGE
          signal CAN6_H_Beam: start 101, 1 bit, big-endian, i-signal-type=PRIMITIVE, init-value=constant-reference=Init_CAN6_H_Beam, base-type=uint8, implementation-data-type=uint8, transfer-property=TRIGGERED-ON-CHANGE
          signal CAN6_HazardSW: start 95, 1 bit, big-endian, i-signal-type=PRIMITIVE, init-value=constant-reference=Init_CAN6_HazardSW, base-type=uint8, implementation-data-type=uint8, transfer-property=TRIGGERED-ON-CHANGE
          signal CAN6_HoodSW: start 126, 1 bit, big-endian, i-signal-type=PRIMITIVE, init-value=constant-reference=Init_CAN6_HoodSW, base-type=uint8, implementation-data-type=uint8, transfer-property=TRIGGERED-ON-CHANGE
          signal CAN6_HornCtrl: start 71, 1 bit, big-endian, i-signal-type=PRIMITIVE, init-value=constant-reference=Init_CAN6_HornCtrl, base-type=uint8, implementation-data-type=uint8, transfer-property=TRIGGERED-ON-CHANGE
          signal CAN6_LBSD: start 91, 1 bit, big-endian, i-signal-type=PRIMITIVE, init-value=constant-reference=Init_CAN6_LBSD, base-type=uint8, implementation-data-type=uint8, transfer-property=TRIGGERED-ON-CHANGE
          signal CAN6_LDRL: start 103, 1 bit, big-endian, i-signal-type=PRIMITIVE, init-value=constant-reference=Init_CAN6_LDRL, base-type=uint8, implementation-data-type=uint8, transfer-property=TRIGGERED-ON-CHANGE
          signal CAN6_LTurnLP: start 80, 1 bit, big-endian, i-signal-type=PRIMITIVE, init-value=constant-reference=Init_CAN6_LTurnLP, base-type=uint8, implementation-data-type=uint8, transfer-property=TRIGGERED-ON-CHANGE
          signal CAN6_L_APM_WdwEnable: start 87, 1 bit, big-endian, i-signal-type=PRIMITIVE, init-value=constant-reference=Init_CAN6_L_APM_WdwEnable, base-type=uint8, implementation-data-type=uint8, transfer-property=TRIGGERED-ON-CHANGE
          signal CAN6_L_Beam: start 100, 1 bit, big-endian, i-signal-type=PRIMITIVE, init-value=constant-reference=Init_CAN6_L_Beam, base-type=uint8, implementation-data-type=uint8, transfer-property=TRIGGERED-ON-CHANGE
          signal CAN6_LockSetting: start 79, 1 bit, big-endian, i-signal-type=PRIMITIVE, init-value=constant-reference=Init_CAN6_LockSetting, base-type=uint8, implementation-data-type=uint8, transfer-property=TRIGGERED-ON-CHANGE
          signal CAN6_MirrorCtrl: start 109, 2 bit, big-endian, i-signal-type=PRIMITIVE, init-value=constant-reference=Init_CAN6_MirrorCtrl, base-type=uint8, implementation-data-type=uint8, transfer-property=TRIGGERED-ON-CHANGE
          signal CAN6_MirrorDefog: start 104, 1 bit, big-endian, i-signal-type=PRIMITIVE, init-value=constant-reference=Init_CAN6_MirrorDefog, base-type=uint8, implementation-data-type=uint8, transfer-property=TRIGGERED-ON-CHANGE
          signal CAN6_PosLamp: start 102, 1 bit, big-endian, i-signal-type=PRIMITIVE, init-value=constant-reference=Init_CAN6_PosLamp, base-type=uint8, implementation-data-type=uint8, transfer-property=TRIGGERED-ON-CHANGE
          signal CAN6_PsDoorSW: start 121, 1 bit, big-endian, i-signal-type=PRIMITIVE, init-value=constant-reference=Init_CAN6_PsDoorSW, base-type=uint8, implementation-data-type=uint8, transfer-property=TRIGGERED-ON-CHANGE
          signal CAN6_RBSD: start 92, 1 bit, big-endian, i-signal-type=PRIMITIVE, init-value=constant-reference=Init_CAN6_RBSD, base-type=uint8, implementation-data-type=uint8, transfer-property=TRIGGERED-ON-CHANGE
          signal CAN6_RDRL: start 88, 1 bit, big-endian, i-signal-type=PRIMITIVE, init-value=constant-reference=Init_CAN6_RDRL, base-type=uint8, implementation-data-type=uint8, transfer-property=TRIGGERED-ON-CHANGE
          signal CAN6_RLDoorSW: start 122, 1 bit, big-endian, i-signal-type=PRIMITIVE, init-value=constant-reference=Init_CAN6_RLDoorSW, base-type=uint8, implementation-data-type=uint8, transfer-property=TRIGGERED-ON-CHANGE
          signal CAN6_RRDoorSW: start 123, 1 bit, big-endian, i-signal-type=PRIMITIVE, init-value=constant-reference=Init_CAN6_RRDoorSW, base-type=uint8, implementation-data-type=uint8, transfer-property=TRIGGERED-ON-CHANGE
          signal CAN6_RTurnLP: start 81, 1 bit, big-endian, i-signal-type=PRIMITIVE, init-value=constant-reference=Init_CAN6_RTurnLP, base-type=uint8, implementation-data-type=uint8, transfer-property=TRIGGERED-ON-CHANGE
          signal CAN6_ReverseLamp: start 89, 1 bit, big-endian, i-signal-type=PRIMITIVE, init-value=constant-reference=Init_CAN6_ReverseLamp, base-type=uint8, implementation-data-type=uint8, transfer-property=TRIGGERED-ON-CHANGE
          signal CAN6_RoomLampH: start 68, 1 bit, big-endian, i-signal-type=PRIMITIVE, init-value=constant-reference=Init_CAN6_RoomLampH, base-type=uint8, implementation-data-type=uint8, transfer-property=TRIGGERED-ON-CHANGE
          signal CAN6_RoomLampL: start 67, 1 bit, big-endian, i-signal-type=PRIMITIVE, init-value=constant-reference=Init_CAN6_RoomLampL, base-type=uint8, implementation-data-type=uint8, transfer-property=TRIGGERED-ON-CHANGE
          signal CAN6_Rr_ChargingDoorCtrl: start 117, 2 bit, big-endian, i-signal-type=PRIMITIVE, init-value=constant-reference=Init_CAN6_Rr_ChargingDoorCtrl, base-type=uint8, implementation-data-type=uint8, transfer-property=TRIGGERED-ON-CHANGE
          signal CAN6_Rr_Defog: start 105, 1 bit, big-endian, i-signal-type=PRIMITIVE, init-value=constant-reference=Init_CAN6_Rr_Defog, base-type=uint8, implementation-data-type=uint8, transfer-property=TRIGGERED-ON-CHANGE
          signal CAN6_Rr_FogLamp: start 94, 1 bit, big-endian, i-signal-type=PRIMITIVE, init-value=constant-reference=Init_CAN6_Rr_FogLamp, base-type=uint8, implementation-data-type=uint8, transfer-property=TRIGGERED-ON-CHANGE
          signal CAN6_Rr_Wiper: start 96, 1 bit, big-endian, i-signal-type=PRIMITIVE, init-value=constant-reference=Init_CAN6_Rr_Wiper, base-type=uint8, implementation-data-type=uint8, transfer-property=TRIGGERED-ON-CHANGE
          signal CAN6_TailgateHDSW: start 107, 1 bit, big-endian, i-signal-type=PRIMITIVE, init-value=constant-reference=Init_CAN6_TailgateHDSW, base-type=uint8, implementation-data-type=uint8, transfer-property=TRIGGERED-ON-CHANGE
          signal CAN6_TailgateRemote: start 66, 2 bit, big-endian, i-signal-type=PRIMITIVE, init-value=constant-reference=Init_CAN6_TailgateRemote, base-type=uint8, implementation-data-type=uint8, transfer-property=TRIGGERED-ON-CHANGE
          signal CAN6_Tailgate_SW: start 127, 1 bit, big-endian, i-signal-type=PRIMITIVE, init-value=constant-reference=Init_CAN6_Tailgate_SW, base-type=uint8, implementation-data-type=uint8, transfer-property=TRIGGERED-ON-CHANGE
          signal CAN6_TrunkRel: start 106, 1 bit, big-endian, i-signal-type=PRIMITIVE, init-value=constant-reference=Init_CAN6_TrunkRel, base-type=uint8, implementation-data-type=uint8, transfer-property=TRIGGERED-ON-CHANGE
          signal CAN6_WasherCtrl: start 99, 2 bit, big-endian, i-signal-type=PRIMITIVE, init-value=constant-reference=Init_CAN6_WasherCtrl, base-type=uint8, implementation-data-type=uint8, transfer-property=TRIGGERED-ON-CHANGE
          signal CAN6_WiperFixMode: start 97, 1 bit, big-endian, i-signal-type=PRIMITIVE, init-value=constant-reference=Init_CAN6_WiperFixMode, base-type=uint8, implementation-data-type=uint8, transfer-property=TRIGGERED-ON-CHANGE
      frame CAN6_FD6_VCU1: id 0x116, frame-length=12, can-addressing-mode=STANDARD, can-fd-frame-support=true, can-frame-rx-behavior=CAN-FD, can-frame-tx-behavior=CAN-FD
        pdu CAN6_FD6_VCU1: length=12, minimum-delay=0.0, transmission-mode-true-timing={cyclic-timing=time-period=0.1, event-controlled-timing={number-of-repetitions=0, repetition-period=0}}, unused-bit-pattern=0
          mapping CAN6_SG_FD6_VCU1: i-signal-group=CAN6_SG_FD6_VCU1, start-position=0, transfer-property=TRIGGERED-ON-CHANGE
          signal CAN6_CC_Crl_Sta: start 28, 3 bit, big-endian, i-signal-type=PRIMITIVE, init-value=constant-reference=Init_CAN6_CC_Crl_Sta, base-type=uint8, implementation-data-type=uint8, transfer-property=TRIGGERED-ON-CHANGE
          signal CAN6_Eng_AGSCloseSta: start 65, 1 bit, big-endian, i-signal-type=PRIMITIVE, init-value=constant-reference=Init_CAN6_Eng_AGSCloseSta, base-type=uint8, implementation-data-type=uint8, transfer-property=TRIGGERED-ON-CHANGE
          signal CAN6_Eng_ActvDmpDisabSta: start 71, 2 bit, big-endian, i-signal-type=PRIMITIVE, init-value=constant-reference=Init_CAN6_Eng_ActvDmpDisabSta, base-type=uint8, implementation-data-type=uint8, transfer-property=TRIGGERED-ON-CHANGE
          signal CAN6_Eng_CoastDwSta: start 69, 2 bit, big-endian, i-signal-type=PRIMITIVE, init-value=constant-reference=Init_CAN6_Eng_CoastDwSta, base-type=uint8, implementation-data-type=uint8, transfer-property=TRIGGERED-ON-CHANGE
          signal CAN6_Eng_PwrLockSta: start 67, 2 bit, big-endian, i-signal-type=PRIMITIVE, init-value=constant-reference=Init_CAN6_Eng_PwrLockSta, base-type=uint8, implementation-data-type=uint8, transfer-property=TRIGGERED-ON-CHANGE
          signal CAN6_HVPwrSta: start 59, 1 bit, big-endian, i-signal-type=PRIMITIVE, init-value=constant-reference=Init_CAN6_HVPwrSta, base-type=uint8, implementation-data-type=uint8, transfer-property=TRIGGERED-ON-CHANGE
          signal CAN6_LVPwrSta: start 58, 1 bit, big-endian, i-signal-type=PRIMITIVE, init-value=constant-reference=Init_CAN6_LVPwrSta, base-type=uint8, implementation-data-type=uint8, transfer-property=TRIGGERED-ON-CHANGE
          signal CAN6_MSA_Crl_Sta: start 31, 3 bit, big-endian, i-signal-type=PRIMITIVE, init-value=constant-reference=Init_CAN6_MSA_Crl_Sta, base-type=uint8, implementation-data-type=uint8, transfer-property=TRIGGERED-ON-CHANGE
          signal CAN6_P_Button_Sta: start 7, 2 bit, big-endian, i-signal-type=PRIMITIVE, init-value=constant-reference=Init_CAN6_P_Button_Sta, base-type=uint8, implementation-data-type=uint8, transfer-property=TRIGGERED-ON-CHANGE
          signal CAN6_PrkReq: start 45, 1 bit, big-endian, i-signal-type=PRIMITIVE, init-value=constant-reference=Init_CAN6_PrkReq, base-type=uint8, implementation-data-type=uint8, transfer-property=TRIGGERED-ON-CHANGE
          signal CAN6_PrkReqValid: start 4, 1 bit, big-endian, i-signal-type=PRIMITIVE, init-value=constant-reference=Init_CAN6_PrkReqValid, base-type=uint8, implementation-data-type=uint8, transfer-property=TRIGGERED-ON-CHANGE
          signal CAN6_PwrSta: start 63, 3 bit, big-endian, i-signal-type=PRIMITIVE, init-value=constant-reference=Init_CAN6_PwrSta, base-type=uint8, implementation-data-type=uint8, transfer-property=TRIGGERED-ON-CHANGE
          signal CAN6_ShiftGearPosn: start 38, 3 bit, big-endian, i-signal-type=PRIMITIVE, init-value=constant-reference=Init_CAN6_ShiftGearPosn, base-type=uint8, implementation-data-type=uint8, transfer-property=TRIGGERED-ON-CHANGE
          signal CAN6_VCU_OPDHold: start 5, 1 bit, big-endian, i-signal-type=PRIMITIVE, init-value=constant-reference=Init_CAN6_VCU_OPDHold, base-type=uint8, implementation-data-type=uint8, transfer-property=TRIGGERED-ON-CHANGE
          signal CAN6_VehMalfunLevel: start 74, 3 bit, big-endian, i-signal-type=PRIMITIVE, init-value=constant-reference=Init_CAN6_VehMalfunLevel, base-type=uint8, implementation-data-type=uint8, transfer-property=TRIGGERED-ON-CHANGE
          signal CAN6_XWDMode: start 57, 2 bit, big-endian, i-signal-type=PRIMITIVE, init-value=constant-reference=Init_CAN6_XWDMode, base-type=uint8, implementation-data-type=uint8, transfer-property=TRIGGERED-ON-CHANGE
      frame CAN6_FD6_VCU2: id 0x154, frame-length=16, can-addressing-mode=STANDARD, can-fd-frame-support=true, can-frame-rx-behavior=CAN-FD, can-frame-tx-behavior=CAN-FD
        pdu CAN6_FD6_VCU2: length=16, minimum-delay=0.0, transmission-mode-true-timing=cyclic-timing=time-period=0.01, unused-bit-pattern=0
          mapping CAN6_SG_FD6_VCU2: i-signal-group=CAN6_SG_FD6_VCU2, start-position=0, transfer-property=PENDING
          signal CAN6_ACC_CtrlAvail: start 55, 1 bit, big-endian, i-signal-type=PRIMITIVE, init-value=constant-reference=Init_CAN6_ACC_CtrlAvail, base-type=uint8, implementation-data-type=uint8, transfer-property=PENDING
          signal CAN6_AccPedal_Override: start 54, 1 bit, big-endian, i-signal-type=PRIMITIVE, init-value=constant-reference=Init_CAN6_AccPedal_Override, base-type=uint8, implementation-data-type=uint8, transfer-property=PENDING
          signal CAN6_ActAPSPosn: start 127, 8 bit, big-endian, i-signal-type=PRIMITIVE, init-value=constant-reference=Init_CAN6_ActAPSPosn, base-type=uint8, implementation-data-type=uint8, transfer-property=PENDING
          signal CAN6_CS_VCU2_CAN6: start 7, 8 bit, big-endian, i-signal-type=PRIMITIVE, init-value=constant-reference=Init_CAN6_CS_VCU2_CAN6, base-type=uint8, implementation-data-type=uint8, transfer-property=PENDING
          signal CAN6_DriverTq: start 111, 16 bit, big-endian, i-signal-type=PRIMITIVE, init-value=constant-reference=Init_CAN6_DriverTq, base-type=uint16, implementation-data-type=uint16, transfer-property=PENDING
          signal CAN6_Fr_DriverTq: start 23, 16 bit, big-endian, i-signal-type=PRIMITIVE, init-value=constant-reference=Init_CAN6_Fr_DriverTq, base-type=uint16, implementation-data-type=uint16, transfer-property=PENDING
          signal CAN6_RC_VCU2_CAN6: start 11, 4 bit, big-endian, i-signal-type=PRIMITIVE, init-value=constant-reference=Init_CAN6_RC_VCU2_CAN6, base-type=uint8, implementation-data-type=uint8, transfer-property=PENDING
          signal CAN6_Rr_DriverTq: start 39, 16 bit, big-endian, i-signal-type=PRIMITIVE, init-value=constant-reference=Init_CAN6_Rr_DriverTq, base-type=uint16, implementation-data-type=uint16, transfer-property=PENDING
          signal CAN6_VehActPwr: start 87, 24 bit, big-endian, i-signal-type=PRIMITIVE, init-value=constant-reference=Init_CAN6_VehActPwr, base-type=uint32, implementation-data-type=uint32, transfer-property=PENDING
      frame CAN6_FD6_VMC1: id 0x17F, frame-length=24, can-addressing-mode=STANDARD, can-fd-frame-support=true, can-frame-rx-behavior=CAN-FD, can-frame-tx-behavior=CAN-FD
        pdu CAN6_FD6_VMC1: length=24, minimum-delay=0.0, transmission-mode-true-timing={cyclic-timing=time-period=0.01, event-controlled-timing={number-of-repetitions=0, repetition-period=0}}, unused-bit-pattern=0
          mapping CAN6_SG_FD6_VMC1: i-signal-group=CAN6_SG_FD6_VMC1, start-position=0, transfer-property=TRIGGERED-ON-CHANGE
          signal CAN6_AccCalcuPID: start 72, 9 bit, big-endian, i-signal-type=PRIMITIVE, init-value=constant-reference=Init_CAN6_AccCalcuPID, base-type=uint16, implementation-data-type=uint16, transfer-property=PENDING
          signal CAN6_CCMSA_SpdWar: start 133, 1 bit, big-endian, i-signal-type=PRIMITIVE, init-value=constant-reference=Init_CAN6_CCMSA_SpdWar, base-type=uint8, implementation-data-type=uint8, transfer-property=TRIGGERED-ON-CHANGE
          signal CAN6_DISCReqAcc: start 56, 9 bit, big-endian, i-signal-type=PRIMITIVE, init-value=constant-reference=Init_CAN6_DISCReqAcc, base-type=uint16, implementation-data-type=uint16, transfer-property=PENDING
          signal CAN6_DISC_ButtSta: start 60, 1 bit, big-endian, i-signal-type=PRIMITIVE, init-value=constant-reference=Init_CAN6_DISC_ButtSta, base-type=uint8, implementation-data-type=uint8, transfer-property=PENDING
          signal CAN6_DISC_DISCTargetSpd: start 91, 12 bit, big-endian, i-signal-type=PRIMITIVE, init-value=constant-reference=Init_CAN6_DISC_DISCTargetSpd, base-type=uint16, implementation-data-type=uint16, transfer-property=PENDING
          signal CAN6_DISC_DISCTurn: start 62, 1 bit, big-endian, i-signal-type=PRIMITIVE, init-value=constant-reference=Init_CAN6_DISC_DISCTurn, base-type=uint8, implementation-data-type=uint8, transfer-property=PENDING
          signal CAN6_DISC_Sta: start 132, 2 bit, big-endian, i-signal-type=PRIMITIVE, init-value=constant-reference=Init_CAN6_DISC_Sta, base-type=uint8, implementation-data-type=uint8, transfer-property=PENDING
          signal CAN6_FDC_VMC_LongAccel_Cmd: start 7, 8 bit, big-endian, i-signal-type=PRIMITIVE, init-value=constant-reference=Init_CAN6_FDC_VMC_LongAccel_Cmd, base-type=uint8, implementation-data-type=uint8, transfer-property=PENDING
          signal CAN6_FeatArbitrFinal: start 59, 3 bit, big-endian, i-signal-type=PRIMITIVE, init-value=constant-reference=Init_CAN6_FeatArbitrFinal, base-type=uint8, implementation-data-type=uint8, transfer-property=PENDING
          signal CAN6_FeatArbitrSta: start 130, 3 bit, big-endian, i-signal-type=PRIMITIVE, init-value=constant-reference=Init_CAN6_FeatArbitrSta, base-type=uint8, implementation-data-type=uint8, transfer-property=PENDING
          signal CAN6_FeatReqSpd: start 178, 11 bit, big-endian, i-signal-type=PRIMITIVE, init-value=constant-reference=Init_CAN6_FeatReqSpd, base-type=uint16, implementation-data-type=uint16, transfer-property=PENDING
          signal CAN6_FeatSetSpdFinal_raw32: start 47, 8 bit, big-endian, i-signal-type=PRIMITIVE, init-value=constant-reference=Init_CAN6_FeatSetSpdFinal_raw32, base-type=uint8, implementation-data-type=uint8, transfer-property=PENDING
          signal CAN6_FrontRearSlipRatioCtrl: start 159, 1 bit, big-endian, i-signal-type=PRIMITIVE, init-value=constant-reference=Init_CAN6_FrontRearSlipRatioCtrl, base-type=uint8, implementation-data-type=uint8, transfer-property=PENDING
          signal CAN6_JerkPCT: start 150, 7 bit, big-endian, i-signal-type=PRIMITIVE, init-value=constant-reference=Init_CAN6_JerkPCT, base-type=uint8, implementation-data-type=uint8, transfer-property=PENDING
          signal CAN6_LatAccCtrl: start 134, 1 bit, big-endian, i-signal-type=PRIMITIVE, init-value=constant-reference=Init_CAN6_LatAccCtrl, base-type=uint8, implementation-data-type=uint8, transfer-property=PENDING
          signal CAN6_LateralCtrl: start 135, 1 bit, big-endian, i-signal-type=PRIMITIVE, init-value=constant-reference=Init_CAN6_LateralCtrl, base-type=uint8, implementation-data-type=uint8, transfer-property=PENDING
          signal CAN6_LimitPCT: start 142, 7 bit, big-endian, i-signal-type=PRIMITIVE, init-value=constant-reference=Init_CAN6_LimitPCT, base-type=uint8, implementation-data-type=uint8, transfer-property=PENDING
          signal CAN6_MeterIndSpeed_raw32: start 55, 8 bit, big-endian, i-signal-type=PRIMITIVE, init-value=constant-reference=Init_CAN6_MeterIndSpeed_raw32, base-type=uint8, implementation-data-type=uint8, transfer-property=PENDING
          signal CAN6_RearWhlSlipRatioCtrl: start 158, 1 bit, big-endian, i-signal-type=PRIMITIVE, init-value=constant-reference=Init_CAN6_RearWhlSlipRatioCtrl, base-type=uint8, implementation-data-type=uint8, transfer-property=PENDING
          signal CAN6_SPD2ACCAct: start 61, 1 bit, big-endian, i-signal-type=PRIMITIVE, init-value=constant-reference=Init_CAN6_SPD2ACCAct, base-type=uint8, implementation-data-type=uint8, transfer-property=PENDING
          signal CAN6_SafetyCtrl: start 143, 1 bit, big-endian, i-signal-type=PRIMITIVE, init-value=constant-reference=Init_CAN6_SafetyCtrl, base-type=uint8, implementation-data-type=uint8, transfer-property=PENDING
          signal CAN6_SingleWhlSlipRatioCtrl: start 151, 1 bit, big-endian, i-signal-type=PRIMITIVE, init-value=constant-reference=Init_CAN6_SingleWhlSlipRatioCtrl, base-type=uint8, implementation-data-type=uint8, transfer-property=PENDING
          signal CAN6_TimeGapCalcu: start 175, 8 bit, big-endian, i-signal-type=PRIMITIVE, init-value=constant-reference=Init_CAN6_TimeGapCalcu, base-type=uint8, implementation-data-type=uint8, transfer-property=PENDING
          signal CAN6_VMC_ACCCtrlAvail: start 167, 1 bit, big-endian, i-signal-type=PRIMITIVE, init-value=constant-reference=Init_CAN6_VMC_ACCCtrlAvail, base-type=uint8, implementation-data-type=uint8, transfer-property=PENDING
          signal CAN6_VMC_AEBCtrlAvail: start 155, 1 bit, big-endian, i-signal-type=PRIMITIVE, init-value=constant-reference=Init_CAN6_VMC_AEBCtrlAvail, base-type=uint8, implementation-data-type=uint8, transfer-property=PENDING
          signal CAN6_VMC_CCCtrlAvail: start 156, 1 bit, big-endian, i-signal-type=PRIMITIVE, init-value=constant-reference=Init_CAN6_VMC_CCCtrlAvail, base-type=uint8, implementation-data-type=uint8, transfer-property=PENDING
          signal CAN6_VMC_MSACtrlAvail: start 157, 1 bit, big-endian, i-signal-type=PRIMITIVE, init-value=constant-reference=Init_CAN6_VMC_MSACtrlAvail, base-type=uint8, implementation-data-type=uint8, transfer-property=PENDING
          signal CAN6_VMC_VCU_ACC_CtrlAvail: start 160, 1 bit, big-endian, i-signal-type=PRIMITIVE, init-value=constant-reference=Init_CAN6_VMC_VCU_ACC_CtrlAvail, base-type=uint8, implementation-data-type=uint8, transfer-property=PENDING
          signal CAN6_VMC_VCU_APSCtrlAvail_flg: start 166, 1 bit, big-endian, i-signal-type=PRIMITIVE, init-value=constant-reference=Init_CAN6_VMC_VCU_APSCtrlAvail_flg, base-type=uint8, implementation-data-type=uint8, transfer-property=PENDING
          signal CAN6_VMC_VCU_AccPedal_Override: start 161, 1 bit, big-endian, i-signal-type=PRIMITIVE, init-value=constant-reference=Init_CAN6_VMC_VCU_AccPedal_Override, base-type=uint8, implementation-data-type=uint8, transfer-property=PENDING
          signal CAN6_VMC_VCU_CC_Crl_Sta: start 154, 3 bit, big-endian, i-signal-type=PRIMITIVE, init-value=constant-reference=Init_CAN6_VMC_VCU_CC_Crl_Sta, base-type=uint8, implementation-data-type=uint8, transfer-property=PENDING
          signal CAN6_VMC_VCU_MSA_Crl_Sta: start 165, 3 bit, big-endian, i-signal-type=PRIMITIVE, init-value=constant-reference=Init_CAN6_VMC_VCU_MSA_Crl_Sta, base-type=uint8, implementation-data-type=uint8, transfer-property=PENDING
          signal CAN6_VehicleSpeed_kph: start 111, 12 bit, big-endian, i-signal-type=PRIMITIVE, init-value=constant-reference=Init_CAN6_VehicleSpeed_kph, base-type=uint16, implementation-data-type=uint16, transfer-property=PENDING
          signal CAN6_VehicleSpeed_mph: start 115, 12 bit, big-endian, i-signal-type=PRIMITIVE, init-value=constant-reference=Init_CAN6_VehicleSpeed_mph, base-type=uint16, implementation-data-type=uint16, transfer-property=PENDING
      frame CAN6_GW6_CE100_0: id 0x1C6, frame-length=32, can-addressing-mode=STANDARD, can-fd-frame-support=true, can-frame-rx-behavior=CAN-FD, can-frame-tx-behavior=CAN-FD
        pdu CAN6_GW6_CE100_0: length=32, minimum-delay=0.0, transmission-mode-true-timing={cyclic-timing=time-period=0.1, event-controlled-timing={number-of-repetitions=0, repetition-period=0}}, unused-bit-pattern=0
          mapping CAN6_SG_GW6_CE100_0: i-signal-group=CAN6_SG_GW6_CE100_0, start-position=0, transfer-property=TRIGGERED-ON-CHANGE
          mapping CAN6_SG_CGW_GW6_CE100_0: i-signal-group=CAN6_SG_CGW_GW6_CE100_0, start-position=0, transfer-property=TRIGGERED-ON-CHANGE
          signal CAN6_FDC_BCM_DimSw: start 27, 1 bit, big-endian, i-signal-type=PRIMITIVE, init-value=constant-reference=Init_CAN6_FDC_BCM_DimSw, base-type=uint8, implementation-data-type=uint8, transfer-property=TRIGGERED-ON-CHANGE
          signal CAN6_FDC_BCM_FWipSw_Sta: start 26, 3 bit, big-endian, i-signal-type=PRIMITIVE, init-value=constant-reference=Init_CAN6_FDC_BCM_FWipSw_Sta, base-type=uint8, implementation-data-type=uint8, transfer-property=TRIGGERED-ON-CHANGE
          signal CAN6_FDC_BCM_LLeftSta_Cmd: start 43, 1 bit, big-endian, i-signal-type=PRIMITIVE, init-value=constant-reference=Init_CAN6_FDC_BCM_LLeftSta_Cmd, base-type=uint8, implementation-data-type=uint8, transfer-property=TRIGGERED-ON-CHANGE
          signal CAN6_FDC_BCM_LRightSta_Cmd: start 42, 1 bit, big-endian, i-signal-type=PRIMITIVE, init-value=constant-reference=Init_CAN6_FDC_BCM_LRightSta_Cmd, base-type=uint8, implementation-data-type=uint8, transfer-property=TRIGGERED-ON-CHANGE
          signal CAN6_FDC_BCM_PassSW_Sta: start 30, 1 bit, big-endian, i-signal-type=PRIMITIVE, init-value=constant-reference=Init_CAN6_FDC_BCM_PassSW_Sta, base-type=uint8, implementation-data-type=uint8, transfer-property=TRIGGERED-ON-CHANGE
          signal CAN6_FDC_BCM_TurnSw_Sta: start 29, 2 bit, big-endian, i-signal-type=PRIMITIVE, init-value=constant-reference=Init_CAN6_FDC_BCM_TurnSw_Sta, base-type=uint8, implementation-data-type=uint8, transfer-property=TRIGGERED-ON-CHANGE
          signal CAN6_FDC_VMC_SpdCtrlMode_Sta: start 34, 3 bit, big-endian, i-signal-type=PRIMITIVE, init-value=constant-reference=Init_CAN6_FDC_VMC_SpdCtrlMode_Sta, base-type=uint8, implementation-data-type=uint8, transfer-property=TRIGGERED-ON-CHANGE
          signal CAN6_FDC_VMC_SpdCtrl_Sta: start 35, 1 bit, big-endian, i-signal-type=PRIMITIVE, init-value=constant-reference=Init_CAN6_FDC_VMC_SpdCtrl_Sta, base-type=uint8, implementation-data-type=uint8, transfer-property=TRIGGERED-ON-CHANGE
          signal CAN6_IVI_Time_Day: start 228, 5 bit, big-endian, i-signal-type=PRIMITIVE, init-value=constant-reference=Init_CAN6_IVI_Time_Day, base-type=uint8, implementation-data-type=uint8, transfer-property=PENDING
          signal CAN6_IVI_Time_Hour: start 236, 5 bit, big-endian, i-signal-type=PRIMITIVE, init-value=constant-reference=Init_CAN6_IVI_Time_Hour, base-type=uint8, implementation-data-type=uint8, transfer-property=PENDING
          signal CAN6_IVI_Time_Minute: start 245, 6 bit, big-endian, i-signal-type=PRIMITIVE, init-value=constant-reference=Init_CAN6_IVI_Time_Minute, base-type=uint8, implementation-data-type=uint8, transfer-property=PENDING
          signal CAN6_IVI_Time_Month: start 219, 4 bit, big-endian, i-signal-type=PRIMITIVE, init-value=constant-reference=Init_CAN6_IVI_Time_Month, base-type=uint8, implementation-data-type=uint8, transfer-property=PENDING
          signal CAN6_IVI_Time_Second: start 253, 6 bit, big-endian, i-signal-type=PRIMITIVE, init-value=constant-reference=Init_CAN6_IVI_Time_Second, base-type=uint8, implementation-data-type=uint8, transfer-property=PENDING
          signal CAN6_ODOMETER: start 7, 24 bit, big-endian, i-signal-type=PRIMITIVE, init-value=constant-reference=Init_CAN6_ODOMETER, base-type=uint32, implementation-data-type=uint32, transfer-property=TRIGGERED-ON-CHANGE
          signal CAN6_SWC2_L_ADAS_Sta: start 41, 1 bit, big-endian, i-signal-type=PRIMITIVE, init-value=constant-reference=Init_CAN6_SWC2_L_ADAS_Sta, base-type=uint8, implementation-data-type=uint8, transfer-property=TRIGGERED-ON-CHANGE
          signal CAN6_SWC2_L_DriveMode_Sta: start 55, 1 bit, big-endian, i-signal-type=PRIMITIVE, init-value=constant-reference=Init_CAN6_SWC2_L_DriveMode_Sta, base-type=uint8, implementation-data-type=uint8, transfer-property=TRIGGERED-ON-CHANGE
          signal CAN6_SWC2_L_ScrollDown_Sta: start 45, 1 bit, big-endian, i-signal-type=PRIMITIVE, init-value=constant-reference=Init_CAN6_SWC2_L_ScrollDown_Sta, base-type=uint8, implementation-data-type=uint8, transfer-property=TRIGGERED-ON-CHANGE
          signal CAN6_SWC2_L_ScrollPress_Sta: start 44, 1 bit, big-endian, i-signal-type=PRIMITIVE, init-value=constant-reference=Init_CAN6_SWC2_L_ScrollPress_Sta, base-type=uint8, implementation-data-type=uint8, transfer-property=TRIGGERED-ON-CHANGE
          signal CAN6_SWC2_L_ScrollUp_Sta: start 46, 1 bit, big-endian, i-signal-type=PRIMITIVE, init-value=constant-reference=Init_CAN6_SWC2_L_ScrollUp_Sta, base-type=uint8, implementation-data-type=uint8, transfer-property=TRIGGERED-ON-CHANGE
          signal CAN6_SWC2_R_Customize_Sta: start 40, 1 bit, big-endian, i-signal-type=PRIMITIVE, init-value=constant-reference=Init_CAN6_SWC2_R_Customize_Sta, base-type=uint8, implementation-data-type=uint8, transfer-property=TRIGGERED-ON-CHANGE
          signal CAN6_SWC_ACC_Sta: start 37, 1 bit, big-endian, i-signal-type=PRIMITIVE, init-value=constant-reference=Init_CAN6_SWC_ACC_Sta, base-type=uint8, implementation-data-type=uint8, transfer-property=TRIGGERED-ON-CHANGE
          signal CAN6_SWC_CANCEL_Sta: start 39, 1 bit, big-endian, i-signal-type=PRIMITIVE, init-value=constant-reference=Init_CAN6_SWC_CANCEL_Sta, base-type=uint8, implementation-data-type=uint8, transfer-property=TRIGGERED-ON-CHANGE
          signal CAN6_SWC_Distance_Sta: start 47, 1 bit, big-endian, i-signal-type=PRIMITIVE, init-value=constant-reference=Init_CAN6_SWC_Distance_Sta, base-type=uint8, implementation-data-type=uint8, transfer-property=TRIGGERED-ON-CHANGE
          signal CAN6_SWC_LKA_Sta: start 38, 1 bit, big-endian, i-signal-type=PRIMITIVE, init-value=constant-reference=Init_CAN6_SWC_LKA_Sta, base-type=uint8, implementation-data-type=uint8, transfer-property=TRIGGERED-ON-CHANGE
          signal CAN6_SWC_Res_Up_Sta: start 36, 1 bit, big-endian, i-signal-type=PRIMITIVE, init-value=constant-reference=Init_CAN6_SWC_Res_Up_Sta, base-type=uint8, implementation-data-type=uint8, transfer-property=TRIGGERED-ON-CHANGE
          signal CAN6_SWC_Set_down_Sta: start 31, 1 bit, big-endian, i-signal-type=PRIMITIVE, init-value=constant-reference=Init_CAN6_SWC_Set_down_Sta, base-type=uint8, implementation-data-type=uint8, transfer-property=TRIGGERED-ON-CHANGE
      frame CAN6_SRR1: id 0x205, frame-length=8, can-addressing-mode=STANDARD, can-fd-frame-support=true, can-frame-rx-behavior=CAN-FD, can-frame-tx-behavior=CAN-FD
        pdu CAN6_SRR1: length=8, minimum-delay=0.0, transmission-mode-true-timing=cyclic-timing=time-period=0.1, unused-bit-pattern=0
          mapping CAN6_SG_SRR1: i-signal-group=CAN6_SG_SRR1, start-position=0, transfer-property=PENDING
          signal CAN6_SRR1_Chksum: start 7, 8 bit, big-endian, i-signal-type=PRIMITIVE, init-value=constant-reference=Init_CAN6_SRR1_Chksum, base-type=uint8, implementation-data-type=uint8, transfer-property=PENDING
          signal CAN6_SRR1_LifeCount: start 11, 4 bit, big-endian, i-signal-type=PRIMITIVE, init-value=constant-reference=Init_CAN6_SRR1_LifeCount, base-type=uint8, implementation-data-type=uint8, transfer-property=PENDING
          signal CAN6_SRR_BSD_Mute: start 46, 1 bit, big-endian, i-signal-type=PRIMITIVE, init-value=constant-reference=Init_CAN6_SRR_BSD_Mute, base-type=uint8, implementation-data-type=uint8, transfer-property=PENDING
          signal CAN6_SRR_BSD_SoundL: start 45, 1 bit, big-endian, i-signal-type=PRIMITIVE, init-value=constant-reference=Init_CAN6_SRR_BSD_SoundL, base-type=uint8, implementation-data-type=uint8, transfer-property=PENDING
          signal CAN6_SRR_BSD_SoundR: start 44, 1 bit, big-endian, i-signal-type=PRIMITIVE, init-value=constant-reference=Init_CAN6_SRR_BSD_SoundR, base-type=uint8, implementation-data-type=uint8, transfer-property=PENDING
          signal CAN6_SRR_BSD_Sta: start 26, 3 bit, big-endian, i-signal-type=PRIMITIVE, init-value=constant-reference=Init_CAN6_SRR_BSD_Sta, base-type=uint8, implementation-data-type=uint8, transfer-property=PENDING
          signal CAN6_SRR_BSD_WarnL: start 43, 2 bit, big-endian, i-signal-type=PRIMITIVE, init-value=constant-reference=Init_CAN6_SRR_BSD_WarnL, base-type=uint8, implementation-data-type=uint8, transfer-property=PENDING
          signal CAN6_SRR_BSD_WarnR: start 41, 2 bit, big-endian, i-signal-type=PRIMITIVE, init-value=constant-reference=Init_CAN6_SRR_BSD_WarnR, base-type=uint8, implementation-data-type=uint8, transfer-property=PENDING
          signal CAN6_SRR_ODA_Mute: start 38, 1 bit, big-endian, i-signal-type=PRIMITIVE, init-value=constant-reference=Init_CAN6_SRR_ODA_Mute, base-type=uint8, implementation-data-type=uint8, transfer-property=PENDING
          signal CAN6_SRR_ODA_SoundL: start 37, 1 bit, big-endian, i-signal-type=PRIMITIVE, init-value=constant-reference=Init_CAN6_SRR_ODA_SoundL, base-type=uint8, implementation-data-type=uint8, transfer-property=PENDING
          signal CAN6_SRR_ODA_SoundR: start 36, 1 bit, big-endian, i-signal-type=PRIMITIVE, init-value=constant-reference=Init_CAN6_SRR_ODA_SoundR, base-type=uint8, implementation-data-type=uint8, transfer-property=PENDING
          signal CAN6_SRR_ODA_Sta: start 18, 3 bit, big-endian, i-signal-type=PRIMITIVE, init-value=constant-reference=Init_CAN6_SRR_ODA_Sta, base-type=uint8, implementation-data-type=uint8, transfer-property=PENDING
          signal CAN6_SRR_ODA_WarnL: start 35, 2 bit, big-endian, i-signal-type=PRIMITIVE, init-value=constant-reference=Init_CAN6_SRR_ODA_WarnL, base-type=uint8, implementation-data-type=uint8, transfer-property=PENDING
          signal CAN6_SRR_ODA_WarnR: start 33, 2 bit, big-endian, i-signal-type=PRIMITIVE, init-value=constant-reference=Init_CAN6_SRR_ODA_WarnR, base-type=uint8, implementation-data-type=uint8, transfer-property=PENDING
          signal CAN6_SRR_RCTA_Sta: start 30, 3 bit, big-endian, i-signal-type=PRIMITIVE, init-value=constant-reference=Init_CAN6_SRR_RCTA_Sta, base-type=uint8, implementation-data-type=uint8, transfer-property=PENDING
          signal CAN6_SRR_RCTA_WarnL: start 49, 1 bit, big-endian, i-signal-type=PRIMITIVE, init-value=constant-reference=Init_CAN6_SRR_RCTA_WarnL, base-type=uint8, implementation-data-type=uint8, transfer-property=PENDING
          signal CAN6_SRR_RCTA_WarnR: start 48, 1 bit, big-endian, i-signal-type=PRIMITIVE, init-value=constant-reference=Init_CAN6_SRR_RCTA_WarnR, base-type=uint8, implementation-data-type=uint8, transfer-property=PENDING
      frame CAN6_NMm_FUSION_TX: id 0x500, frame-length=8, can-addressing-mode=STANDARD, can-fd-frame-support=false, can-frame-rx-behavior=CAN-20, can-frame-tx-behavior=CAN-20
        nm pdu CAN6_NMm_FUSION_TX: length=8, unused-bit-pattern=0
      frame CAN6_NMm_FUSION_RX: id 0x500, frame-length=8, can-addressing-mode=STANDARD, can-fd-frame-support=false, can-frame-rx-behavior=CAN-20, can-frame-tx-behavior=CAN-20
        nm pdu CAN6_NMm_FUSION_RX: length=8, unused-bit-pattern=0
package /CAN6/ConstantSpecification
  299 x constant specification:
    Init_CAN6_ACC_ComfortBandLower: value-spec=0
    Init_CAN6_ACC_ComfortBandUpper: value-spec=0
    Init_CAN6_ACC_JerkLowerLimit: value-spec=0
    Init_CAN6_ACC_JerkUpperLimit: value-spec=0
    Init_CAN6_ACC_ObjDist: value-spec=2046
    Init_CAN6_ACC_ObjDstLvl: value-spec=0
    Init_CAN6_ACC_ObjRelSpd: value-spec=0
    Init_CAN6_ACC_RequiredAccel: value-spec=0
    Init_CAN6_ACC_TakeoverReq: value-spec=0
    Init_CAN6_ACC_VehHoldReq: value-spec=0
    Init_CAN6_ADAS_ACC_Sta: value-spec=0
    Init_CAN6_ADAS_AEBReq: value-spec=0
    Init_CAN6_ADAS_AEB_Sta: value-spec=0
    Init_CAN6_ADAS_CAM_SpdLim: value-spec=0
    Init_CAN6_ADAS_DBSReq: value-spec=0
    Init_CAN6_ADAS_FCW_Mute: value-spec=0
    Init_CAN6_ADAS_FCW_Sensitivity: value-spec=0
    Init_CAN6_ADAS_FCW_Sta: value-spec=0
    Init_CAN6_ADAS_FaultSta: value-spec=0
    Init_CAN6_ADAS_FltWrnReq: value-spec=0
    Init_CAN6_ADAS_ForceIdle: value-spec=0
    Init_CAN6_ADAS_ISA_Sta: value-spec=0
    Init_CAN6_ADAS_LDW_Mute: value-spec=0
    Init_CAN6_ADAS_LDW_Sensitivity: value-spec=0
    Init_CAN6_ADAS_LDW_Sta: value-spec=0
    Init_CAN6_ADAS_LFC_Hands_Off_Warning: value-spec=0
    Init_CAN6_ADAS_LFC_Sta: value-spec=0
    Init_CAN6_ADAS_LFC_Warn_Sound: value-spec=0
    Init_CAN6_ADAS_LKA_Sta: value-spec=0
    Init_CAN6_ADAS_LaneModeL: value-spec=0
    Init_CAN6_ADAS_LaneModeR: value-spec=0
    Init_CAN6_ADAS_Lane_curveL: value-spec=60
    Init_CAN6_ADAS_Lane_curveR: value-spec=60
    Init_CAN6_ADAS_LanetypeL: value-spec=0
    Init_CAN6_ADAS_LanetypeR: value-spec=0
    Init_CAN6_ADAS_SLIF_SpdLim: value-spec=0
    Init_CAN6_ADAS_SLIF_Sta: value-spec=0
    Init_CAN6_ADAS_ShftPosnReq: value-spec=0
    Init_CAN6_ADAS_ShftPosnReq_A: value-spec=0
    Init_CAN6_ADAS_VehSpdLim: value-spec=0
    Init_CAN6_ADAS_WarningMsg: value-spec=0
    Init_CAN6_AEB_VehHoldReq: value-spec=0
    Init_CAN6_CameraBlockage: value-spec=0
    Init_CAN6_FCM1_Checksum: value-spec=0
    Init_CAN6_FCM1_LifeCount: value-spec=0
    Init_CAN6_FCM_ACCmode: value-spec=0
    Init_CAN6_FCM_LKA_StrToqReq: value-spec=1000
    Init_CAN6_FCM_LKA_TOIAct: value-spec=0
    Init_CAN6_FCM_LKA_TOIFault: value-spec=0
    Init_CAN6_ForceLowBeam: value-spec=0
    Init_CAN6_HazardWarningReq: value-spec=0
    Init_CAN6_ISA_WarningMsg: value-spec=0
    Init_CAN6_LKA_HOD_Display_Warning: value-spec=0
    Init_CAN6_LKA_HOD_Sound_Warning: value-spec=0
    Init_CAN6_LVDA_ACCStatusInformation: value-spec=0
    Init_CAN6_LVDA_Disabled: value-spec=0
    Init_CAN6_LVDA_Failinfo: value-spec=0
    Init_CAN6_LVDA_Mute_Sta: value-spec=0
    Init_CAN6_LVDA_Warning: value-spec=0
    Init_CAN6_LeftTurnLightReq: value-spec=0
    Init_CAN6_RightTurnLightReq: value-spec=0
    Init_CAN6_Target_Type: value-spec=0
    Init_CAN6_TimeGapLevel: value-spec=0
    Init_CAN6_ADB_FR_CMR_Sta: value-spec=0
    Init_CAN6_ADB_ILLAmbtSta: value-spec=0
    Init_CAN6_ADB_VehDst10Val: value-spec=0
    Init_CAN6_ADB_VehDst{1..9}Val: value-spec=0
    Init_CAN6_ADB_VehLtAngl10Val: value-spec=510
    Init_CAN6_ADB_VehLtAngl{1..9}Val: value-spec=510
    Init_CAN6_ADB_VehNumVal: value-spec=0
    Init_CAN6_ADB_VehRtAngl10Val: value-spec=510
    Init_CAN6_ADB_VehRtAngl{1..9}Val: value-spec=510
    Init_CAN6_FCM2_Checksum: value-spec=0
    Init_CAN6_FCM2_LifeCount: value-spec=0
    Init_CAN6_ME_Lane_CurvDervLt: value-spec=0
    Init_CAN6_ME_Lane_CurvDervLt2: value-spec=0
    Init_CAN6_ME_Lane_CurvDervRt: value-spec=0
    Init_CAN6_ME_Lane_CurvDervRt2: value-spec=0
    Init_CAN6_ME_Lane_CurvLt: value-spec=0
    Init_CAN6_ME_Lane_CurvLt2: value-spec=0
    Init_CAN6_ME_Lane_CurvRt: value-spec=0
    Init_CAN6_ME_Lane_CurvRt2: value-spec=0
    Init_CAN6_ME_Lane_HeadAngLt: value-spec=0
    Init_CAN6_ME_Lane_HeadAngLt2: value-spec=0
    Init_CAN6_ME_Lane_HeadAngRt: value-spec=0
    Init_CAN6_ME_Lane_HeadAngRt2: value-spec=0
    Init_CAN6_ME_Lane_PosLt: value-spec=0
    Init_CAN6_ME_Lane_PosLt2: value-spec=0
    Init_CAN6_ME_Lane_PosRt: value-spec=0
    Init_CAN6_ME_Lane_PosRt2: value-spec=0
    Init_CAN6_ADAS_AngCtrlTqWeightGain: value-spec=0
    Init_CAN6_ADAS_DesStrWhlAngCtrlCmd: value-spec=9000
    Init_CAN6_ADAS_DrvInputTqBoostAct: value-spec=0
    Init_CAN6_ADAS_DrvInputTqBoostGain: value-spec=0
    Init_CAN6_ADAS_MaxAngCtrlOutTqLimit: value-spec=0
    Init_CAN6_ADAS_StrWhlAngCtrlStatus: value-spec=0
    Init_CAN6_FCM4_Checksum: value-spec=0
    Init_CAN6_FCM4_LifeCount: value-spec=0
    Init_CAN6_APS3_LifeCount: value-spec=0
    Init_CAN6_APS3_checksum: value-spec=0
    Init_CAN6_APSOpenPTG: value-spec=0
    Init_CAN6_APS_DecReq: value-spec=0
    Init_CAN6_APS_DecReq_A: value-spec=0
    Init_CAN6_APS_Req: value-spec=0
    Init_CAN6_APS_Sta_System: value-spec=0
    Init_CAN6_CAAS_Sta: value-spec=0
    Init_CAN6_FDC_VMC_APS_Angle_Target: value-spec=0
    Init_CAN6_FDC_VMC_APS_Rq_EPS_Ctrl: value-spec=0
    Init_CAN6_FDC_VMC_APS_V_Rq_EPS_Ctrl: value-spec=0
    Init_CAN6_SPTGDet: value-spec=0
    Init_CAN6_SPTG_Sta: value-spec=0
    Init_CAN6_AllDoorSW: value-spec=0
    Init_CAN6_AntiTheftSeatFold: value-spec=0
    Init_CAN6_AntitheftSta: value-spec=0
    Init_CAN6_BCM_Buzzer_Req: value-spec=0
    Init_CAN6_BCM_DoorLock_Sta: value-spec=0
    Init_CAN6_BrakeLamp: value-spec=0
    Init_CAN6_CTDCtrl: value-spec=0
    Init_CAN6_CTDLockSW: value-spec=0
    Init_CAN6_CTDUnlockSW: value-spec=0
    Init_CAN6_CrashDetd: value-spec=0
    Init_CAN6_Dimmer: value-spec=0
    Init_CAN6_DimmerEN: value-spec=0
    Init_CAN6_DoorLockIND: value-spec=0
    Init_CAN6_DrDoorSW: value-spec=0
    Init_CAN6_Fr_ChargingDoorCtrl: value-spec=0
    Init_CAN6_Fr_FogLamp: value-spec=0
    Init_CAN6_Fr_Wiper_H: value-spec=0
    Init_CAN6_Fr_Wiper_L: value-spec=0
    Init_CAN6_H_Beam: value-spec=0
    Init_CAN6_HazardSW: value-spec=0
    Init_CAN6_HoodSW: value-spec=0
    Init_CAN6_HornCtrl: value-spec=0
    Init_CAN6_LBSD: value-spec=0
    Init_CAN6_LDRL: value-spec=0
    Init_CAN6_LTurnLP: value-spec=0
    Init_CAN6_L_APM_WdwEnable: value-spec=0
    Init_CAN6_L_Beam: value-spec=0
    Init_CAN6_LockSetting: value-spec=0
    Init_CAN6_MirrorCtrl: value-spec=0
    Init_CAN6_MirrorDefog: value-spec=0
    Init_CAN6_PosLamp: value-spec=0
    Init_CAN6_PsDoorSW: value-spec=0
    Init_CAN6_RBSD: value-spec=0
    Init_CAN6_RDRL: value-spec=0
    Init_CAN6_RLDoorSW: value-spec=0
    Init_CAN6_RRDoorSW: value-spec=0
    Init_CAN6_RTurnLP: value-spec=0
    Init_CAN6_ReverseLamp: value-spec=0
    Init_CAN6_RoomLampH: value-spec=0
    Init_CAN6_RoomLampL: value-spec=0
    Init_CAN6_Rr_ChargingDoorCtrl: value-spec=0
    Init_CAN6_Rr_Defog: value-spec=0
    Init_CAN6_Rr_FogLamp: value-spec=0
    Init_CAN6_Rr_Wiper: value-spec=0
    Init_CAN6_TailgateHDSW: value-spec=0
    Init_CAN6_TailgateRemote: value-spec=0
    Init_CAN6_Tailgate_SW: value-spec=0
    Init_CAN6_TrunkRel: value-spec=0
    Init_CAN6_WasherCtrl: value-spec=0
    Init_CAN6_WiperFixMode: value-spec=0
    Init_CAN6_CC_Crl_Sta: value-spec=0
    Init_CAN6_Eng_AGSCloseSta: value-spec=0
    Init_CAN6_Eng_ActvDmpDisabSta: value-spec=0
    Init_CAN6_Eng_CoastDwSta: value-spec=0
    Init_CAN6_Eng_PwrLockSta: value-spec=0
    Init_CAN6_HVPwrSta: value-spec=0
    Init_CAN6_LVPwrSta: value-spec=0
    Init_CAN6_MSA_Crl_Sta: value-spec=0
    Init_CAN6_P_Button_Sta: value-spec=0
    Init_CAN6_PrkReq: value-spec=0
    Init_CAN6_PrkReqValid: value-spec=0
    Init_CAN6_PwrSta: value-spec=7
    Init_CAN6_ShiftGearPosn: value-spec=1
    Init_CAN6_VCU_OPDHold: value-spec=0
    Init_CAN6_VehMalfunLevel: value-spec=0
    Init_CAN6_XWDMode: value-spec=0
    Init_CAN6_ACC_CtrlAvail: value-spec=0
    Init_CAN6_AccPedal_Override: value-spec=0
    Init_CAN6_ActAPSPosn: value-spec=0
    Init_CAN6_CS_VCU2_CAN6: value-spec=0
    Init_CAN6_DriverTq: value-spec=4300
    Init_CAN6_Fr_DriverTq: value-spec=10600
    Init_CAN6_RC_VCU2_CAN6: value-spec=0
    Init_CAN6_Rr_DriverTq: value-spec=10600
    Init_CAN6_VehActPwr: value-spec=600000
    Init_CAN6_AccCalcuPID: value-spec=0
    Init_CAN6_CCMSA_SpdWar: value-spec=0
    Init_CAN6_DISCReqAcc: value-spec=0
    Init_CAN6_DISC_ButtSta: value-spec=0
    Init_CAN6_DISC_DISCTargetSpd: value-spec=0
    Init_CAN6_DISC_DISCTurn: value-spec=0
    Init_CAN6_DISC_Sta: value-spec=0
    Init_CAN6_FDC_VMC_LongAccel_Cmd: value-spec=127
    Init_CAN6_FeatArbitrFinal: value-spec=0
    Init_CAN6_FeatArbitrSta: value-spec=0
    Init_CAN6_FeatReqSpd: value-spec=0
    Init_CAN6_FeatSetSpdFinal_raw32: value-spec=0
    Init_CAN6_FrontRearSlipRatioCtrl: value-spec=0
    Init_CAN6_JerkPCT: value-spec=0
    Init_CAN6_LatAccCtrl: value-spec=0
    Init_CAN6_LateralCtrl: value-spec=0
    Init_CAN6_LimitPCT: value-spec=0
    Init_CAN6_MeterIndSpeed_raw32: value-spec=0
    Init_CAN6_RearWhlSlipRatioCtrl: value-spec=0
    Init_CAN6_SPD2ACCAct: value-spec=0
    Init_CAN6_SafetyCtrl: value-spec=0
    Init_CAN6_SingleWhlSlipRatioCtrl: value-spec=0
    Init_CAN6_TimeGapCalcu: value-spec=0
    Init_CAN6_VMC_ACCCtrlAvail: value-spec=0
    Init_CAN6_VMC_AEBCtrlAvail: value-spec=0
    Init_CAN6_VMC_CCCtrlAvail: value-spec=0
    Init_CAN6_VMC_MSACtrlAvail: value-spec=0
    Init_CAN6_VMC_VCU_ACC_CtrlAvail: value-spec=0
    Init_CAN6_VMC_VCU_APSCtrlAvail_flg: value-spec=0
    Init_CAN6_VMC_VCU_AccPedal_Override: value-spec=0
    Init_CAN6_VMC_VCU_CC_Crl_Sta: value-spec=0
    Init_CAN6_VMC_VCU_MSA_Crl_Sta: value-spec=0
    Init_CAN6_VehicleSpeed_kph: value-spec=0
    Init_CAN6_VehicleSpeed_mph: value-spec=0
    Init_CAN6_FDC_BCM_DimSw: value-spec=0
    Init_CAN6_FDC_BCM_FWipSw_Sta: value-spec=7
    Init_CAN6_FDC_BCM_LLeftSta_Cmd: value-spec=0
    Init_CAN6_FDC_BCM_LRightSta_Cmd: value-spec=0
    Init_CAN6_FDC_BCM_PassSW_Sta: value-spec=0
    Init_CAN6_FDC_BCM_TurnSw_Sta: value-spec=3
    Init_CAN6_FDC_VMC_SpdCtrlMode_Sta: value-spec=0
    Init_CAN6_FDC_VMC_SpdCtrl_Sta: value-spec=0
    Init_CAN6_IVI_Time_Day: value-spec=0
    Init_CAN6_IVI_Time_Hour: value-spec=0
    Init_CAN6_IVI_Time_Minute: value-spec=0
    Init_CAN6_IVI_Time_Month: value-spec=0
    Init_CAN6_IVI_Time_Second: value-spec=0
    Init_CAN6_ODOMETER: value-spec=0
    Init_CAN6_SWC2_L_ADAS_Sta: value-spec=0
    Init_CAN6_SWC2_L_DriveMode_Sta: value-spec=0
    Init_CAN6_SWC2_L_ScrollDown_Sta: value-spec=0
    Init_CAN6_SWC2_L_ScrollPress_Sta: value-spec=0
    Init_CAN6_SWC2_L_ScrollUp_Sta: value-spec=0
    Init_CAN6_SWC2_R_Customize_Sta: value-spec=0
    Init_CAN6_SWC_ACC_Sta: value-spec=0
    Init_CAN6_SWC_CANCEL_Sta: value-spec=0
    Init_CAN6_SWC_Distance_Sta: value-spec=0
    Init_CAN6_SWC_LKA_Sta: value-spec=0
    Init_CAN6_SWC_Res_Up_Sta: value-spec=0
    Init_CAN6_SWC_Set_down_Sta: value-spec=0
    Init_CAN6_SRR1_Chksum: value-spec=0
    Init_CAN6_SRR1_LifeCount: value-spec=0
    Init_CAN6_SRR_BSD_Mute: value-spec=0
    Init_CAN6_SRR_BSD_SoundL: value-spec=0
    Init_CAN6_SRR_BSD_SoundR: value-spec=0
    Init_CAN6_SRR_BSD_Sta: value-spec=0
    Init_CAN6_SRR_BSD_WarnL: value-spec=0
    Init_CAN6_SRR_BSD_WarnR: value-spec=0
    Init_CAN6_SRR_ODA_Mute: value-spec=0
    Init_CAN6_SRR_ODA_SoundL: value-spec=0
    Init_CAN6_SRR_ODA_SoundR: value-spec=0
    Init_CAN6_SRR_ODA_Sta: value-spec=0
    Init_CAN6_SRR_ODA_WarnL: value-spec=0
    Init_CAN6_SRR_ODA_WarnR: value-spec=0
    Init_CAN6_SRR_RCTA_Sta: value-spec=0
    Init_CAN6_SRR_RCTA_WarnL: value-spec=0
    Init_CAN6_SRR_RCTA_WarnR: value-spec=0
    Init_CAN6_SG_FCM1: value-spec=fields=[Init_CAN6_ACC_ComfortBandLower, Init_CAN6_ACC_ComfortBandUpper, Init_CAN6_ACC_JerkLowerLimit, Init_CAN6_ACC_JerkUpperLimit, Init_CAN6_ACC_ObjDist, Init_CAN6_ACC_ObjDstLvl, Init_CAN6_ACC_ObjRelSpd, Init_CAN6_ACC_RequiredAccel, Init_CAN6_ACC_TakeoverReq, Init_CAN6_ACC_VehHoldReq, Init_CAN6_ADAS_ACC_Sta, Init_CAN6_ADAS_AEBReq, Init_CAN6_ADAS_AEB_Sta, Init_CAN6_ADAS_CAM_SpdLim, Init_CAN6_ADAS_DBSReq, Init_CAN6_ADAS_FCW_Mute, Init_CAN6_ADAS_FCW_Sensitivity, Init_CAN6_ADAS_FCW_Sta, Init_CAN6_ADAS_FaultSta, Init_CAN6_ADAS_FltWrnReq, Init_CAN6_ADAS_ForceIdle, Init_CAN6_ADAS_ISA_Sta, Init_CAN6_ADAS_LDW_Mute, Init_CAN6_ADAS_LDW_Sensitivity, Init_CAN6_ADAS_LDW_Sta, Init_CAN6_ADAS_LFC_Hands_Off_Warning, Init_CAN6_ADAS_LFC_Sta, Init_CAN6_ADAS_LFC_Warn_Sound, Init_CAN6_ADAS_LKA_Sta, Init_CAN6_ADAS_LaneModeL, Init_CAN6_ADAS_LaneModeR, Init_CAN6_ADAS_Lane_curveL, Init_CAN6_ADAS_Lane_curveR, Init_CAN6_ADAS_LanetypeL, Init_CAN6_ADAS_LanetypeR, Init_CAN6_ADAS_SLIF_SpdLim, Init_CAN6_ADAS_SLIF_Sta, Init_CAN6_ADAS_ShftPosnReq, Init_CAN6_ADAS_ShftPosnReq_A, Init_CAN6_ADAS_VehSpdLim, Init_CAN6_ADAS_WarningMsg, Init_CAN6_AEB_VehHoldReq, Init_CAN6_CameraBlockage, Init_CAN6_FCM1_Checksum, Init_CAN6_FCM1_LifeCount, Init_CAN6_FCM_ACCmode, Init_CAN6_FCM_LKA_StrToqReq, Init_CAN6_FCM_LKA_TOIAct, Init_CAN6_FCM_LKA_TOIFault, Init_CAN6_ForceLowBeam, Init_CAN6_HazardWarningReq, Init_CAN6_ISA_WarningMsg, Init_CAN6_LKA_HOD_Display_Warning, Init_CAN6_LKA_HOD_Sound_Warning, Init_CAN6_LVDA_ACCStatusInformation, Init_CAN6_LVDA_Disabled, Init_CAN6_LVDA_Failinfo, Init_CAN6_LVDA_Mute_Sta, Init_CAN6_LVDA_Warning, Init_CAN6_LeftTurnLightReq, Init_CAN6_RightTurnLightReq, Init_CAN6_Target_Type, Init_CAN6_TimeGapLevel]
    Init_CAN6_SG_FCM2: value-spec=fields=[Init_CAN6_ADB_FR_CMR_Sta, Init_CAN6_ADB_ILLAmbtSta, Init_CAN6_ADB_VehDst10Val, Init_CAN6_ADB_VehDst1Val, Init_CAN6_ADB_VehDst2Val, Init_CAN6_ADB_VehDst3Val, Init_CAN6_ADB_VehDst4Val, Init_CAN6_ADB_VehDst5Val, Init_CAN6_ADB_VehDst6Val, Init_CAN6_ADB_VehDst7Val, Init_CAN6_ADB_VehDst8Val, Init_CAN6_ADB_VehDst9Val, Init_CAN6_ADB_VehLtAngl10Val, Init_CAN6_ADB_VehLtAngl1Val, Init_CAN6_ADB_VehLtAngl2Val, Init_CAN6_ADB_VehLtAngl3Val, Init_CAN6_ADB_VehLtAngl4Val, Init_CAN6_ADB_VehLtAngl5Val, Init_CAN6_ADB_VehLtAngl6Val, Init_CAN6_ADB_VehLtAngl7Val, Init_CAN6_ADB_VehLtAngl8Val, Init_CAN6_ADB_VehLtAngl9Val, Init_CAN6_ADB_VehNumVal, Init_CAN6_ADB_VehRtAngl10Val, Init_CAN6_ADB_VehRtAngl1Val, Init_CAN6_ADB_VehRtAngl2Val, Init_CAN6_ADB_VehRtAngl3Val, Init_CAN6_ADB_VehRtAngl4Val, Init_CAN6_ADB_VehRtAngl5Val, Init_CAN6_ADB_VehRtAngl6Val, Init_CAN6_ADB_VehRtAngl7Val, Init_CAN6_ADB_VehRtAngl8Val, Init_CAN6_ADB_VehRtAngl9Val, Init_CAN6_FCM2_Checksum, Init_CAN6_FCM2_LifeCount]
    Init_CAN6_SG_FCM3: value-spec=fields=[Init_CAN6_ME_Lane_CurvDervLt, Init_CAN6_ME_Lane_CurvDervLt2, Init_CAN6_ME_Lane_CurvDervRt, Init_CAN6_ME_Lane_CurvDervRt2, Init_CAN6_ME_Lane_CurvLt, Init_CAN6_ME_Lane_CurvLt2, Init_CAN6_ME_Lane_CurvRt, Init_CAN6_ME_Lane_CurvRt2, Init_CAN6_ME_Lane_HeadAngLt, Init_CAN6_ME_Lane_HeadAngLt2, Init_CAN6_ME_Lane_HeadAngRt, Init_CAN6_ME_Lane_HeadAngRt2, Init_CAN6_ME_Lane_PosLt, Init_CAN6_ME_Lane_PosLt2, Init_CAN6_ME_Lane_PosRt, Init_CAN6_ME_Lane_PosRt2]
    Init_CAN6_SG_FCM4: value-spec=fields=[Init_CAN6_ADAS_AngCtrlTqWeightGain, Init_CAN6_ADAS_DesStrWhlAngCtrlCmd, Init_CAN6_ADAS_DrvInputTqBoostAct, Init_CAN6_ADAS_DrvInputTqBoostGain, Init_CAN6_ADAS_MaxAngCtrlOutTqLimit, Init_CAN6_ADAS_StrWhlAngCtrlStatus, Init_CAN6_FCM4_Checksum, Init_CAN6_FCM4_LifeCount]
    Init_CAN6_SG_FD6_APS3: value-spec=fields=[Init_CAN6_APS3_LifeCount, Init_CAN6_APS3_checksum, Init_CAN6_APSOpenPTG, Init_CAN6_APS_DecReq, Init_CAN6_APS_DecReq_A, Init_CAN6_APS_Req, Init_CAN6_APS_Sta_System, Init_CAN6_CAAS_Sta, Init_CAN6_FDC_VMC_APS_Angle_Target, Init_CAN6_FDC_VMC_APS_Rq_EPS_Ctrl, Init_CAN6_FDC_VMC_APS_V_Rq_EPS_Ctrl, Init_CAN6_SPTGDet, Init_CAN6_SPTG_Sta]
    Init_CAN6_SG_FD6_BCM1: value-spec=fields=[Init_CAN6_AllDoorSW, Init_CAN6_AntiTheftSeatFold, Init_CAN6_AntitheftSta, Init_CAN6_BCM_Buzzer_Req, Init_CAN6_BCM_DoorLock_Sta, Init_CAN6_BrakeLamp, Init_CAN6_CTDCtrl, Init_CAN6_CTDLockSW, Init_CAN6_CTDUnlockSW, Init_CAN6_CrashDetd, Init_CAN6_Dimmer, Init_CAN6_DimmerEN, Init_CAN6_DoorLockIND, Init_CAN6_DrDoorSW, Init_CAN6_Fr_ChargingDoorCtrl, Init_CAN6_Fr_FogLamp, Init_CAN6_Fr_Wiper_H, Init_CAN6_Fr_Wiper_L, Init_CAN6_H_Beam, Init_CAN6_HazardSW, Init_CAN6_HoodSW, Init_CAN6_HornCtrl, Init_CAN6_LBSD, Init_CAN6_LDRL, Init_CAN6_LTurnLP, Init_CAN6_L_APM_WdwEnable, Init_CAN6_L_Beam, Init_CAN6_LockSetting, Init_CAN6_MirrorCtrl, Init_CAN6_MirrorDefog, Init_CAN6_PosLamp, Init_CAN6_PsDoorSW, Init_CAN6_RBSD, Init_CAN6_RDRL, Init_CAN6_RLDoorSW, Init_CAN6_RRDoorSW, Init_CAN6_RTurnLP, Init_CAN6_ReverseLamp, Init_CAN6_RoomLampH, Init_CAN6_RoomLampL, Init_CAN6_Rr_ChargingDoorCtrl, Init_CAN6_Rr_Defog, Init_CAN6_Rr_FogLamp, Init_CAN6_Rr_Wiper, Init_CAN6_TailgateHDSW, Init_CAN6_TailgateRemote, Init_CAN6_Tailgate_SW, Init_CAN6_TrunkRel, Init_CAN6_WasherCtrl, Init_CAN6_WiperFixMode]
    Init_CAN6_SG_FD6_VCU1: value-spec=fields=[Init_CAN6_CC_Crl_Sta, Init_CAN6_Eng_AGSCloseSta, Init_CAN6_Eng_ActvDmpDisabSta, Init_CAN6_Eng_CoastDwSta, Init_CAN6_Eng_PwrLockSta, Init_CAN6_HVPwrSta, Init_CAN6_LVPwrSta, Init_CAN6_MSA_Crl_Sta, Init_CAN6_P_Button_Sta, Init_CAN6_PrkReq, Init_CAN6_PrkReqValid, Init_CAN6_PwrSta, Init_CAN6_ShiftGearPosn, Init_CAN6_VCU_OPDHold, Init_CAN6_VehMalfunLevel, Init_CAN6_XWDMode]
    Init_CAN6_SG_FD6_VCU2: value-spec=fields=[Init_CAN6_ACC_CtrlAvail, Init_CAN6_AccPedal_Override, Init_CAN6_ActAPSPosn, Init_CAN6_CS_VCU2_CAN6, Init_CAN6_DriverTq, Init_CAN6_Fr_DriverTq, Init_CAN6_RC_VCU2_CAN6, Init_CAN6_Rr_DriverTq, Init_CAN6_VehActPwr]
    Init_CAN6_SG_FD6_VMC1: value-spec=fields=[Init_CAN6_AccCalcuPID, Init_CAN6_CCMSA_SpdWar, Init_CAN6_DISCReqAcc, Init_CAN6_DISC_ButtSta, Init_CAN6_DISC_DISCTargetSpd, Init_CAN6_DISC_DISCTurn, Init_CAN6_DISC_Sta, Init_CAN6_FDC_VMC_LongAccel_Cmd, Init_CAN6_FeatArbitrFinal, Init_CAN6_FeatArbitrSta, Init_CAN6_FeatReqSpd, Init_CAN6_FeatSetSpdFinal_raw32, Init_CAN6_FrontRearSlipRatioCtrl, Init_CAN6_JerkPCT, Init_CAN6_LatAccCtrl, Init_CAN6_LateralCtrl, Init_CAN6_LimitPCT, Init_CAN6_MeterIndSpeed_raw32, Init_CAN6_RearWhlSlipRatioCtrl, Init_CAN6_SPD2ACCAct, Init_CAN6_SafetyCtrl, Init_CAN6_SingleWhlSlipRatioCtrl, Init_CAN6_TimeGapCalcu, Init_CAN6_VMC_ACCCtrlAvail, Init_CAN6_VMC_AEBCtrlAvail, Init_CAN6_VMC_CCCtrlAvail, Init_CAN6_VMC_MSACtrlAvail, Init_CAN6_VMC_VCU_ACC_CtrlAvail, Init_CAN6_VMC_VCU_APSCtrlAvail_flg, Init_CAN6_VMC_VCU_AccPedal_Override, Init_CAN6_VMC_VCU_CC_Crl_Sta, Init_CAN6_VMC_VCU_MSA_Crl_Sta, Init_CAN6_VehicleSpeed_kph, Init_CAN6_VehicleSpeed_mph]
    Init_CAN6_SG_GW6_CE100_0: value-spec=fields=[Init_CAN6_FDC_BCM_DimSw, Init_CAN6_FDC_BCM_FWipSw_Sta, Init_CAN6_FDC_BCM_LLeftSta_Cmd, Init_CAN6_FDC_BCM_LRightSta_Cmd, Init_CAN6_FDC_BCM_PassSW_Sta, Init_CAN6_FDC_BCM_TurnSw_Sta, Init_CAN6_FDC_VMC_SpdCtrlMode_Sta, Init_CAN6_FDC_VMC_SpdCtrl_Sta]
    Init_CAN6_SG_CGW_GW6_CE100_0: value-spec=fields=[Init_CAN6_IVI_Time_Day, Init_CAN6_IVI_Time_Hour, Init_CAN6_IVI_Time_Minute, Init_CAN6_IVI_Time_Month, Init_CAN6_IVI_Time_Second, Init_CAN6_ODOMETER, Init_CAN6_SWC2_L_ADAS_Sta, Init_CAN6_SWC2_L_DriveMode_Sta, Init_CAN6_SWC2_L_ScrollDown_Sta, Init_CAN6_SWC2_L_ScrollPress_Sta, Init_CAN6_SWC2_L_ScrollUp_Sta, Init_CAN6_SWC2_R_Customize_Sta, Init_CAN6_SWC_ACC_Sta, Init_CAN6_SWC_CANCEL_Sta, Init_CAN6_SWC_Distance_Sta, Init_CAN6_SWC_LKA_Sta, Init_CAN6_SWC_Res_Up_Sta, Init_CAN6_SWC_Set_down_Sta]
    Init_CAN6_SG_SRR1: value-spec=fields=[Init_CAN6_SRR1_Chksum, Init_CAN6_SRR1_LifeCount, Init_CAN6_SRR_BSD_Mute, Init_CAN6_SRR_BSD_SoundL, Init_CAN6_SRR_BSD_SoundR, Init_CAN6_SRR_BSD_Sta, Init_CAN6_SRR_BSD_WarnL, Init_CAN6_SRR_BSD_WarnR, Init_CAN6_SRR_ODA_Mute, Init_CAN6_SRR_ODA_SoundL, Init_CAN6_SRR_ODA_SoundR, Init_CAN6_SRR_ODA_Sta, Init_CAN6_SRR_ODA_WarnL, Init_CAN6_SRR_ODA_WarnR, Init_CAN6_SRR_RCTA_Sta, Init_CAN6_SRR_RCTA_WarnL, Init_CAN6_SRR_RCTA_WarnR]
package /CAN6/ImplementationDataTypes
  12 x impl type, all with category=STRUCTURE:
    DT_CAN6_SG_FCM1
      63 x element, all with category=TYPE_REFERENCE:
        CAN6_ACC_ComfortBandLower: implementation-data-type=uint16
        CAN6_ACC_ComfortBandUpper: implementation-data-type=uint16
        CAN6_ACC_JerkLowerLimit: implementation-data-type=uint8
        CAN6_ACC_JerkUpperLimit: implementation-data-type=uint8
        CAN6_ACC_ObjDist: implementation-data-type=uint16
        CAN6_ACC_ObjDstLvl: implementation-data-type=uint8
        CAN6_ACC_ObjRelSpd: implementation-data-type=uint16
        CAN6_ACC_RequiredAccel: implementation-data-type=uint16
        CAN6_ACC_TakeoverReq: implementation-data-type=uint8
        CAN6_ACC_VehHoldReq: implementation-data-type=uint8
        CAN6_ADAS_ACC_Sta: implementation-data-type=uint8
        CAN6_ADAS_AEBReq: implementation-data-type=uint8
        CAN6_ADAS_AEB_Sta: implementation-data-type=uint8
        CAN6_ADAS_CAM_SpdLim: implementation-data-type=uint8
        CAN6_ADAS_DBSReq: implementation-data-type=uint8
        CAN6_ADAS_FCW_Mute: implementation-data-type=uint8
        CAN6_ADAS_FCW_Sensitivity: implementation-data-type=uint8
        CAN6_ADAS_FCW_Sta: implementation-data-type=uint8
        CAN6_ADAS_FaultSta: implementation-data-type=uint8
        CAN6_ADAS_FltWrnReq: implementation-data-type=uint8
        CAN6_ADAS_ForceIdle: implementation-data-type=uint8
        CAN6_ADAS_ISA_Sta: implementation-data-type=uint8
        CAN6_ADAS_LDW_Mute: implementation-data-type=uint8
        CAN6_ADAS_LDW_Sensitivity: implementation-data-type=uint8
        CAN6_ADAS_LDW_Sta: implementation-data-type=uint8
        CAN6_ADAS_LFC_Hands_Off_Warning: implementation-data-type=uint8
        CAN6_ADAS_LFC_Sta: implementation-data-type=uint8
        CAN6_ADAS_LFC_Warn_Sound: implementation-data-type=uint8
        CAN6_ADAS_LKA_Sta: implementation-data-type=uint8
        CAN6_ADAS_LaneModeL: implementation-data-type=uint8
        CAN6_ADAS_LaneModeR: implementation-data-type=uint8
        CAN6_ADAS_Lane_curveL: implementation-data-type=uint8
        CAN6_ADAS_Lane_curveR: implementation-data-type=uint8
        CAN6_ADAS_LanetypeL: implementation-data-type=uint8
        CAN6_ADAS_LanetypeR: implementation-data-type=uint8
        CAN6_ADAS_SLIF_SpdLim: implementation-data-type=uint8
        CAN6_ADAS_SLIF_Sta: implementation-data-type=uint8
        CAN6_ADAS_ShftPosnReq: implementation-data-type=uint8
        CAN6_ADAS_ShftPosnReq_A: implementation-data-type=uint8
        CAN6_ADAS_VehSpdLim: implementation-data-type=uint8
        CAN6_ADAS_WarningMsg: implementation-data-type=uint8
        CAN6_AEB_VehHoldReq: implementation-data-type=uint8
        CAN6_CameraBlockage: implementation-data-type=uint8
        CAN6_FCM1_Checksum: implementation-data-type=uint8
        CAN6_FCM1_LifeCount: implementation-data-type=uint8
        CAN6_FCM_ACCmode: implementation-data-type=uint8
        CAN6_FCM_LKA_StrToqReq: implementation-data-type=uint16
        CAN6_FCM_LKA_TOIAct: implementation-data-type=uint8
        CAN6_FCM_LKA_TOIFault: implementation-data-type=uint8
        CAN6_ForceLowBeam: implementation-data-type=uint8
        CAN6_HazardWarningReq: implementation-data-type=uint8
        CAN6_ISA_WarningMsg: implementation-data-type=uint8
        CAN6_LKA_HOD_Display_Warning: implementation-data-type=uint8
        CAN6_LKA_HOD_Sound_Warning: implementation-data-type=uint8
        CAN6_LVDA_ACCStatusInformation: implementation-data-type=uint8
        CAN6_LVDA_Disabled: implementation-data-type=uint8
        CAN6_LVDA_Failinfo: implementation-data-type=uint8
        CAN6_LVDA_Mute_Sta: implementation-data-type=uint8
        CAN6_LVDA_Warning: implementation-data-type=uint8
        CAN6_LeftTurnLightReq: implementation-data-type=uint8
        CAN6_RightTurnLightReq: implementation-data-type=uint8
        CAN6_Target_Type: implementation-data-type=uint8
        CAN6_TimeGapLevel: implementation-data-type=uint8
    DT_CAN6_SG_FCM2
      35 x element, all with category=TYPE_REFERENCE:
        CAN6_ADB_FR_CMR_Sta: implementation-data-type=uint8
        CAN6_ADB_ILLAmbtSta: implementation-data-type=uint8
        CAN6_ADB_VehDst10Val: implementation-data-type=uint8
        CAN6_ADB_VehDst{1..9}Val: implementation-data-type=uint8
        CAN6_ADB_VehLtAngl10Val: implementation-data-type=uint16
        CAN6_ADB_VehLtAngl{1..9}Val: implementation-data-type=uint16
        CAN6_ADB_VehNumVal: implementation-data-type=uint8
        CAN6_ADB_VehRtAngl10Val: implementation-data-type=uint16
        CAN6_ADB_VehRtAngl{1..9}Val: implementation-data-type=uint16
        CAN6_FCM2_Checksum: implementation-data-type=uint8
        CAN6_FCM2_LifeCount: implementation-data-type=uint8
    DT_CAN6_SG_FCM3
      16 x element, all with category=TYPE_REFERENCE, implementation-data-type=uint16:
        CAN6_ME_Lane_CurvDervLt
        CAN6_ME_Lane_CurvDervLt2
        CAN6_ME_Lane_CurvDervRt
        CAN6_ME_Lane_CurvDervRt2
        CAN6_ME_Lane_CurvLt
        CAN6_ME_Lane_CurvLt2
        CAN6_ME_Lane_CurvRt
        CAN6_ME_Lane_CurvRt2
        CAN6_ME_Lane_HeadAngLt
        CAN6_ME_Lane_HeadAngLt2
        CAN6_ME_Lane_HeadAngRt
        CAN6_ME_Lane_HeadAngRt2
        CAN6_ME_Lane_PosLt
        CAN6_ME_Lane_PosLt2
        CAN6_ME_Lane_PosRt
        CAN6_ME_Lane_PosRt2
    DT_CAN6_SG_FCM4
      8 x element, all with category=TYPE_REFERENCE:
        CAN6_ADAS_AngCtrlTqWeightGain: implementation-data-type=uint8
        CAN6_ADAS_DesStrWhlAngCtrlCmd: implementation-data-type=uint16
        CAN6_ADAS_DrvInputTqBoostAct: implementation-data-type=uint8
        CAN6_ADAS_DrvInputTqBoostGain: implementation-data-type=uint8
        CAN6_ADAS_MaxAngCtrlOutTqLimit: implementation-data-type=uint16
        CAN6_ADAS_StrWhlAngCtrlStatus: implementation-data-type=uint8
        CAN6_FCM4_Checksum: implementation-data-type=uint8
        CAN6_FCM4_LifeCount: implementation-data-type=uint8
    DT_CAN6_SG_FD6_APS3
      13 x element, all with category=TYPE_REFERENCE:
        CAN6_APS3_LifeCount: implementation-data-type=uint8
        CAN6_APS3_checksum: implementation-data-type=uint8
        CAN6_APSOpenPTG: implementation-data-type=uint8
        CAN6_APS_DecReq: implementation-data-type=uint8
        CAN6_APS_DecReq_A: implementation-data-type=uint8
        CAN6_APS_Req: implementation-data-type=uint8
        CAN6_APS_Sta_System: implementation-data-type=uint8
        CAN6_CAAS_Sta: implementation-data-type=uint8
        CAN6_FDC_VMC_APS_Angle_Target: implementation-data-type=uint16
        CAN6_FDC_VMC_APS_Rq_EPS_Ctrl: implementation-data-type=uint8
        CAN6_FDC_VMC_APS_V_Rq_EPS_Ctrl: implementation-data-type=uint8
        CAN6_SPTGDet: implementation-data-type=uint8
        CAN6_SPTG_Sta: implementation-data-type=uint8
    DT_CAN6_SG_FD6_BCM1
      50 x element, all with category=TYPE_REFERENCE, implementation-data-type=uint8:
        CAN6_AllDoorSW
        CAN6_AntiTheftSeatFold
        CAN6_AntitheftSta
        CAN6_BCM_Buzzer_Req
        CAN6_BCM_DoorLock_Sta
        CAN6_BrakeLamp
        CAN6_CTDCtrl
        CAN6_CTDLockSW
        CAN6_CTDUnlockSW
        CAN6_CrashDetd
        CAN6_Dimmer
        CAN6_DimmerEN
        CAN6_DoorLockIND
        CAN6_DrDoorSW
        CAN6_Fr_ChargingDoorCtrl
        CAN6_Fr_FogLamp
        CAN6_Fr_Wiper_H
        CAN6_Fr_Wiper_L
        CAN6_H_Beam
        CAN6_HazardSW
        CAN6_HoodSW
        CAN6_HornCtrl
        CAN6_LBSD
        CAN6_LDRL
        CAN6_LTurnLP
        CAN6_L_APM_WdwEnable
        CAN6_L_Beam
        CAN6_LockSetting
        CAN6_MirrorCtrl
        CAN6_MirrorDefog
        CAN6_PosLamp
        CAN6_PsDoorSW
        CAN6_RBSD
        CAN6_RDRL
        CAN6_RLDoorSW
        CAN6_RRDoorSW
        CAN6_RTurnLP
        CAN6_ReverseLamp
        CAN6_RoomLampH
        CAN6_RoomLampL
        CAN6_Rr_ChargingDoorCtrl
        CAN6_Rr_Defog
        CAN6_Rr_FogLamp
        CAN6_Rr_Wiper
        CAN6_TailgateHDSW
        CAN6_TailgateRemote
        CAN6_Tailgate_SW
        CAN6_TrunkRel
        CAN6_WasherCtrl
        CAN6_WiperFixMode
    DT_CAN6_SG_FD6_VCU1
      16 x element, all with category=TYPE_REFERENCE, implementation-data-type=uint8:
        CAN6_CC_Crl_Sta
        CAN6_Eng_AGSCloseSta
        CAN6_Eng_ActvDmpDisabSta
        CAN6_Eng_CoastDwSta
        CAN6_Eng_PwrLockSta
        CAN6_HVPwrSta
        CAN6_LVPwrSta
        CAN6_MSA_Crl_Sta
        CAN6_P_Button_Sta
        CAN6_PrkReq
        CAN6_PrkReqValid
        CAN6_PwrSta
        CAN6_ShiftGearPosn
        CAN6_VCU_OPDHold
        CAN6_VehMalfunLevel
        CAN6_XWDMode
    DT_CAN6_SG_FD6_VCU2
      9 x element, all with category=TYPE_REFERENCE:
        CAN6_ACC_CtrlAvail: implementation-data-type=uint8
        CAN6_AccPedal_Override: implementation-data-type=uint8
        CAN6_ActAPSPosn: implementation-data-type=uint8
        CAN6_CS_VCU2_CAN6: implementation-data-type=uint8
        CAN6_DriverTq: implementation-data-type=uint16
        CAN6_Fr_DriverTq: implementation-data-type=uint16
        CAN6_RC_VCU2_CAN6: implementation-data-type=uint8
        CAN6_Rr_DriverTq: implementation-data-type=uint16
        CAN6_VehActPwr: implementation-data-type=uint32
    DT_CAN6_SG_FD6_VMC1
      34 x element, all with category=TYPE_REFERENCE:
        CAN6_AccCalcuPID: implementation-data-type=uint16
        CAN6_CCMSA_SpdWar: implementation-data-type=uint8
        CAN6_DISCReqAcc: implementation-data-type=uint16
        CAN6_DISC_ButtSta: implementation-data-type=uint8
        CAN6_DISC_DISCTargetSpd: implementation-data-type=uint16
        CAN6_DISC_DISCTurn: implementation-data-type=uint8
        CAN6_DISC_Sta: implementation-data-type=uint8
        CAN6_FDC_VMC_LongAccel_Cmd: implementation-data-type=uint8
        CAN6_FeatArbitrFinal: implementation-data-type=uint8
        CAN6_FeatArbitrSta: implementation-data-type=uint8
        CAN6_FeatReqSpd: implementation-data-type=uint16
        CAN6_FeatSetSpdFinal_raw32: implementation-data-type=uint8
        CAN6_FrontRearSlipRatioCtrl: implementation-data-type=uint8
        CAN6_JerkPCT: implementation-data-type=uint8
        CAN6_LatAccCtrl: implementation-data-type=uint8
        CAN6_LateralCtrl: implementation-data-type=uint8
        CAN6_LimitPCT: implementation-data-type=uint8
        CAN6_MeterIndSpeed_raw32: implementation-data-type=uint8
        CAN6_RearWhlSlipRatioCtrl: implementation-data-type=uint8
        CAN6_SPD2ACCAct: implementation-data-type=uint8
        CAN6_SafetyCtrl: implementation-data-type=uint8
        CAN6_SingleWhlSlipRatioCtrl: implementation-data-type=uint8
        CAN6_TimeGapCalcu: implementation-data-type=uint8
        CAN6_VMC_ACCCtrlAvail: implementation-data-type=uint8
        CAN6_VMC_AEBCtrlAvail: implementation-data-type=uint8
        CAN6_VMC_CCCtrlAvail: implementation-data-type=uint8
        CAN6_VMC_MSACtrlAvail: implementation-data-type=uint8
        CAN6_VMC_VCU_ACC_CtrlAvail: implementation-data-type=uint8
        CAN6_VMC_VCU_APSCtrlAvail_flg: implementation-data-type=uint8
        CAN6_VMC_VCU_AccPedal_Override: implementation-data-type=uint8
        CAN6_VMC_VCU_CC_Crl_Sta: implementation-data-type=uint8
        CAN6_VMC_VCU_MSA_Crl_Sta: implementation-data-type=uint8
        CAN6_VehicleSpeed_kph: implementation-data-type=uint16
        CAN6_VehicleSpeed_mph: implementation-data-type=uint16
    DT_CAN6_SG_GW6_CE100_0
      8 x element, all with category=TYPE_REFERENCE, implementation-data-type=uint8:
        CAN6_FDC_BCM_DimSw
        CAN6_FDC_BCM_FWipSw_Sta
        CAN6_FDC_BCM_LLeftSta_Cmd
        CAN6_FDC_BCM_LRightSta_Cmd
        CAN6_FDC_BCM_PassSW_Sta
        CAN6_FDC_BCM_TurnSw_Sta
        CAN6_FDC_VMC_SpdCtrlMode_Sta
        CAN6_FDC_VMC_SpdCtrl_Sta
    DT_CAN6_SG_CGW_GW6_CE100_0
      18 x element, all with category=TYPE_REFERENCE:
        CAN6_IVI_Time_Day: implementation-data-type=uint8
        CAN6_IVI_Time_Hour: implementation-data-type=uint8
        CAN6_IVI_Time_Minute: implementation-data-type=uint8
        CAN6_IVI_Time_Month: implementation-data-type=uint8
        CAN6_IVI_Time_Second: implementation-data-type=uint8
        CAN6_ODOMETER: implementation-data-type=uint32
        CAN6_SWC2_L_ADAS_Sta: implementation-data-type=uint8
        CAN6_SWC2_L_DriveMode_Sta: implementation-data-type=uint8
        CAN6_SWC2_L_ScrollDown_Sta: implementation-data-type=uint8
        CAN6_SWC2_L_ScrollPress_Sta: implementation-data-type=uint8
        CAN6_SWC2_L_ScrollUp_Sta: implementation-data-type=uint8
        CAN6_SWC2_R_Customize_Sta: implementation-data-type=uint8
        CAN6_SWC_ACC_Sta: implementation-data-type=uint8
        CAN6_SWC_CANCEL_Sta: implementation-data-type=uint8
        CAN6_SWC_Distance_Sta: implementation-data-type=uint8
        CAN6_SWC_LKA_Sta: implementation-data-type=uint8
        CAN6_SWC_Res_Up_Sta: implementation-data-type=uint8
        CAN6_SWC_Set_down_Sta: implementation-data-type=uint8
    DT_CAN6_SG_SRR1
      17 x element, all with category=TYPE_REFERENCE, implementation-data-type=uint8:
        CAN6_SRR1_Chksum
        CAN6_SRR1_LifeCount
        CAN6_SRR_BSD_Mute
        CAN6_SRR_BSD_SoundL
        CAN6_SRR_BSD_SoundR
        CAN6_SRR_BSD_Sta
        CAN6_SRR_BSD_WarnL
        CAN6_SRR_BSD_WarnR
        CAN6_SRR_ODA_Mute
        CAN6_SRR_ODA_SoundL
        CAN6_SRR_ODA_SoundR
        CAN6_SRR_ODA_Sta
        CAN6_SRR_ODA_WarnL
        CAN6_SRR_ODA_WarnR
        CAN6_SRR_RCTA_Sta
        CAN6_SRR_RCTA_WarnL
        CAN6_SRR_RCTA_WarnR
