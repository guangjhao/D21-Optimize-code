AUTOSAR XML (schema 4-3-0)
package /CANInterface_ARPkg
  123 x sender receiver interface:
    IF_CAN1_SG_ABM1
      data CAN1_SG_ABM1: type=DT_CAN1_SG_ABM1
    IF_CAN1_SG_EPB1
      data CAN1_SG_EPB1: type=DT_CAN1_SG_EPB1
    IF_CAN1_SG_EPS1
      data CAN1_SG_EPS1: type=DT_CAN1_SG_EPS1
    IF_CAN1_SG_ESC1
      data CAN1_SG_ESC1: type=DT_CAN1_SG_ESC1
    IF_CAN1_SG_ESC5
      data CAN1_SG_ESC5: type=DT_CAN1_SG_ESC5
    IF_CAN1_SG_FD1_APS2
      data CAN1_SG_FD1_APS2: type=DT_CAN1_SG_FD1_APS2
    IF_CAN1_SG_FD1_APS3
      data CAN1_SG_FD1_APS3: type=DT_CAN1_SG_FD1_APS3
    IF_CAN1_SG_FD1_BCM1
      data CAN1_SG_FD1_BCM1: type=DT_CAN1_SG_FD1_BCM1
    IF_CAN1_SG_FD1_THCM1
      data CAN1_SG_FD1_THCM1: type=DT_CAN1_SG_FD1_THCM1
    IF_CAN1_SG_FD1_VCU1
      data CAN1_SG_FD1_VCU1: type=DT_CAN1_SG_FD1_VCU1
    IF_CAN1_SG_FD1_VCU2
      data CAN1_SG_FD1_VCU2: type=DT_CAN1_SG_FD1_VCU2
    IF_CAN1_SG_FD1_VCU3
      data CAN1_SG_FD1_VCU3: type=DT_CAN1_SG_FD1_VCU3
    IF_CAN1_SG_FD1_VMC1
      data CAN1_SG_FD1_VMC1: type=DT_CAN1_SG_FD1_VMC1
    IF_CAN1_SG_FD1_VMC2
      data CAN1_SG_FD1_VMC2: type=DT_CAN1_SG_FD1_VMC2
    IF_CAN1_SG_GW1_CE100_0
      data CAN1_SG_GW1_CE100_0: type=DT_CAN1_SG_GW1_CE100_0
    IF_CAN1_SG_GW1_CE200_0
      data CAN1_SG_GW1_CE200_0: type=DT_CAN1_SG_GW1_CE200_0
    IF_CAN1_SG_VMC_FCM1
      data CAN1_SG_VMC_FCM1: type=DT_CAN1_SG_VMC_FCM1
    IF_CAN1_SG_eBST1
      data CAN1_SG_eBST1: type=DT_CAN1_SG_eBST1
    IF_CAN2_SG_FD2_C20_0
      data CAN2_SG_FD2_C20_0: type=DT_CAN2_SG_FD2_C20_0
    IF_CAN2_SG_FD2_CE100_0
      data CAN2_SG_FD2_CE100_0: type=DT_CAN2_SG_FD2_CE100_0
    IF_CAN2_SG_FD2_CE200_1
      data CAN2_SG_FD2_CE200_1: type=DT_CAN2_SG_FD2_CE200_1
    IF_CAN2_SG_FD2_OTA1
      data CAN2_SG_FD2_OTA1: type=DT_CAN2_SG_FD2_OTA1
    IF_CAN2_SG_FD2_Version
      data CAN2_SG_FD2_Version: type=DT_CAN2_SG_FD2_Version
    IF_CAN2_SG_GW2_C10_0
      data CAN2_SG_GW2_C10_0: type=DT_CAN2_SG_GW2_C10_0
    IF_CAN2_SG_GW2_CE1000_0
      data CAN2_SG_GW2_CE1000_0: type=DT_CAN2_SG_GW2_CE1000_0
    IF_CAN2_SG_GW2_CE100_0
      data CAN2_SG_GW2_CE100_0: type=DT_CAN2_SG_GW2_CE100_0
    IF_CAN2_SG_CGW_GW2_CE100_0
      data CAN2_SG_CGW_GW2_CE100_0: type=DT_CAN2_SG_CGW_GW2_CE100_0
    IF_CAN2_SG_GW2_CE100_1
      data CAN2_SG_GW2_CE100_1: type=DT_CAN2_SG_GW2_CE100_1
    IF_CAN2_SG_CGW_GW2_CE100_1
      data CAN2_SG_CGW_GW2_CE100_1: type=DT_CAN2_SG_CGW_GW2_CE100_1
    IF_CAN2_SG_GW2_CE100_2
      data CAN2_SG_GW2_CE100_2: type=DT_CAN2_SG_GW2_CE100_2
    IF_CAN2_SG_GW2_CE200_0
      data CAN2_SG_GW2_CE200_0: type=DT_CAN2_SG_GW2_CE200_0
    IF_CAN2_SG_CGW_GW2_CE200_0
      data CAN2_SG_CGW_GW2_CE200_0: type=DT_CAN2_SG_CGW_GW2_CE200_0
    IF_CAN2_SG_HMI1
      data CAN2_SG_HMI1: type=DT_CAN2_SG_HMI1
    IF_CAN2_SG_IVI1
      data CAN2_SG_IVI1: type=DT_CAN2_SG_IVI1
    IF_CAN2_SG_IVI2
      data CAN2_SG_IVI2: type=DT_CAN2_SG_IVI2
    IF_CAN2_SG_IVI3
      data CAN2_SG_IVI3: type=DT_CAN2_SG_IVI3
    IF_CAN2_SG_METER1
      data CAN2_SG_METER1: type=DT_CAN2_SG_METER1
    IF_CAN3_SG_BMS1
      data CAN3_SG_BMS1: type=DT_CAN3_SG_BMS1
    IF_CAN3_SG_BMS3
      data CAN3_SG_BMS3: type=DT_CAN3_SG_BMS3
    IF_CAN3_SG_BMS4
      data CAN3_SG_BMS4: type=DT_CAN3_SG_BMS4
    IF_CAN3_SG_BMS5
      data CAN3_SG_BMS5: type=DT_CAN3_SG_BMS5
    IF_CAN3_SG_BMS6
      data CAN3_SG_BMS6: type=DT_CAN3_SG_BMS6
    IF_CAN3_SG_BMS8
      data CAN3_SG_BMS8: type=DT_CAN3_SG_BMS8
    IF_CAN3_SG_CCU1
      data CAN3_SG_CCU1: type=DT_CAN3_SG_CCU1
    IF_CAN3_SG_CCU2
      data CAN3_SG_CCU2: type=DT_CAN3_SG_CCU2
    IF_CAN3_SG_EBM1
      data CAN3_SG_EBM1: type=DT_CAN3_SG_EBM1
    IF_CAN3_SG_FD3_BCM1
      data CAN3_SG_FD3_BCM1: type=DT_CAN3_SG_FD3_BCM1
    IF_CAN3_SG_FD3_C100_0
      data CAN3_SG_FD3_C100_0: type=DT_CAN3_SG_FD3_C100_0
    IF_CAN3_SG_CGW_FD3_C100_0
      data CAN3_SG_CGW_FD3_C100_0: type=DT_CAN3_SG_CGW_FD3_C100_0
    IF_CAN3_SG_FD3_OTA1
      data CAN3_SG_FD3_OTA1: type=DT_CAN3_SG_FD3_OTA1
    IF_CAN3_SG_FD3_V2L1
      data CAN3_SG_FD3_V2L1: type=DT_CAN3_SG_FD3_V2L1
    IF_CAN3_SG_FD3_VCU0
      data CAN3_SG_FD3_VCU0: type=DT_CAN3_SG_FD3_VCU0
    IF_CAN3_SG_FD3_VCU1
      data CAN3_SG_FD3_VCU1: type=DT_CAN3_SG_FD3_VCU1
    IF_CAN3_SG_FD3_VCU1_toNIDEC
      data CAN3_SG_FD3_VCU1_toNIDEC: type=DT_CAN3_SG_FD3_VCU1_toNIDEC
    IF_CAN3_SG_FD3_VCU2
      data CAN3_SG_FD3_VCU2: type=DT_CAN3_SG_FD3_VCU2
    IF_CAN3_SG_FD3_VCU2_toNIDEC
      data CAN3_SG_FD3_VCU2_toNIDEC: type=DT_CAN3_SG_FD3_VCU2_toNIDEC
    IF_CAN3_SG_FD3_VCU4
      data CAN3_SG_FD3_VCU4: type=DT_CAN3_SG_FD3_VCU4
    IF_CAN3_SG_FD3_VCU5
      data CAN3_SG_FD3_VCU5: type=DT_CAN3_SG_FD3_VCU5
    IF_CAN3_SG_GW3_CE100_0
      data CAN3_SG_GW3_CE100_0: type=DT_CAN3_SG_GW3_CE100_0
    IF_CAN3_SG_GW_ESC1_toNIDEC
      data CAN3_SG_GW_ESC1_toNIDEC: type=DT_CAN3_SG_GW_ESC1_toNIDEC
    IF_CAN3_SG_GW_IVI6_toNIDEC
      data CAN3_SG_GW_IVI6_toNIDEC: type=DT_CAN3_SG_GW_IVI6_toNIDEC
    IF_CAN3_SG_MCU_B_F1
      data CAN3_SG_MCU_B_F1: type=DT_CAN3_SG_MCU_B_F1
    IF_CAN3_SG_MCU_B_F2
      data CAN3_SG_MCU_B_F2: type=DT_CAN3_SG_MCU_B_F2
    IF_CAN3_SG_MCU_B_R1
      data CAN3_SG_MCU_B_R1: type=DT_CAN3_SG_MCU_B_R1
    IF_CAN3_SG_MCU_B_R2
      data CAN3_SG_MCU_B_R2: type=DT_CAN3_SG_MCU_B_R2
    IF_CAN3_SG_MCU_N_F1
      data CAN3_SG_MCU_N_F1: type=DT_CAN3_SG_MCU_N_F1
    IF_CAN3_SG_MCU_N_F2
      data CAN3_SG_MCU_N_F2: type=DT_CAN3_SG_MCU_N_F2
    IF_CAN3_SG_MCU_N_F3
      data CAN3_SG_MCU_N_F3: type=DT_CAN3_SG_MCU_N_F3
    IF_CAN3_SG_MCU_N_R1
      data CAN3_SG_MCU_N_R1: type=DT_CAN3_SG_MCU_N_R1
    IF_CAN3_SG_MCU_N_R2
      data CAN3_SG_MCU_N_R2: type=DT_CAN3_SG_MCU_N_R2
    IF_CAN3_SG_MCU_N_R3
      data CAN3_SG_MCU_N_R3: type=DT_CAN3_SG_MCU_N_R3
    IF_CAN3_SG_Shifter1
      data CAN3_SG_Shifter1: type=DT_CAN3_SG_Shifter1
    IF_CAN3_SG_Shifter2
      data CAN3_SG_Shifter2: type=DT_CAN3_SG_Shifter2
    IF_CAN4_SG_BodyZone_DR1
      data CAN4_SG_BodyZone_DR1: type=DT_CAN4_SG_BodyZone_DR1
    IF_CAN4_SG_BodyZone_DR2
      data CAN4_SG_BodyZone_DR2: type=DT_CAN4_SG_BodyZone_DR2
    IF_CAN4_SG_BodyZone_PS1
      data CAN4_SG_BodyZone_PS1: type=DT_CAN4_SG_BodyZone_PS1
    IF_CAN4_SG_BodyZone_PS2
      data CAN4_SG_BodyZone_PS2: type=DT_CAN4_SG_BodyZone_PS2
    IF_CAN4_SG_DKC1
      data CAN4_SG_DKC1: type=DT_CAN4_SG_DKC1
    IF_CAN4_SG_DKC2
      data CAN4_SG_DKC2: type=DT_CAN4_SG_DKC2
    IF_CAN4_SG_FD4_CE100_0
      data CAN4_SG_FD4_CE100_0: type=DT_CAN4_SG_FD4_CE100_0
    IF_CAN4_SG_FD4_CE100_1
      data CAN4_SG_FD4_CE100_1: type=DT_CAN4_SG_FD4_CE100_1
    IF_CAN4_SG_FD4_CE100_2
      data CAN4_SG_FD4_CE100_2: type=DT_CAN4_SG_FD4_CE100_2
    IF_CAN4_SG_FD4_CE200_0
      data CAN4_SG_FD4_CE200_0: type=DT_CAN4_SG_FD4_CE200_0
    IF_CAN4_SG_FD4_OTA1
      data CAN4_SG_FD4_OTA1: type=DT_CAN4_SG_FD4_OTA1
    IF_CAN4_SG_GW4_CE100_0
      data CAN4_SG_GW4_CE100_0: type=DT_CAN4_SG_GW4_CE100_0
    IF_CAN4_SG_CGW_GW4_CE100_0
      data CAN4_SG_CGW_GW4_CE100_0: type=DT_CAN4_SG_CGW_GW4_CE100_0
    IF_CAN4_SG_GW4_CE200_0
      data CAN4_SG_GW4_CE200_0: type=DT_CAN4_SG_GW4_CE200_0
    IF_CAN4_SG_PTG1
      data CAN4_SG_PTG1: type=DT_CAN4_SG_PTG1
    IF_CAN4_SG_ZONE_DR1
      data CAN4_SG_ZONE_DR1: type=DT_CAN4_SG_ZONE_DR1
    IF_CAN4_SG_ZONE_DR_VCU
      data CAN4_SG_ZONE_DR_VCU: type=DT_CAN4_SG_ZONE_DR_VCU
    IF_CAN4_SG_ZONE_FR1
      data CAN4_SG_ZONE_FR1: type=DT_CAN4_SG_ZONE_FR1
    IF_CAN4_SG_ZONE_FR_VCU
      data CAN4_SG_ZONE_FR_VCU: type=DT_CAN4_SG_ZONE_FR_VCU
    IF_CAN4_SG_zGW_APTC1
      data CAN4_SG_zGW_APTC1: type=DT_CAN4_SG_zGW_APTC1
    IF_CAN4_SG_zGW_CANFr1
      data CAN4_SG_zGW_CANFr1: type=DT_CAN4_SG_zGW_CANFr1
    IF_CAN4_SG_zGW_LINDr1
      data CAN4_SG_zGW_LINDr1: type=DT_CAN4_SG_zGW_LINDr1
    IF_CAN4_SG_zGW_LINDr2
      data CAN4_SG_zGW_LINDr2: type=DT_CAN4_SG_zGW_LINDr2
    IF_CAN4_SG_zGW_LINFr1
      data CAN4_SG_zGW_LINFr1: type=DT_CAN4_SG_zGW_LINFr1
    IF_CAN4_SG_zGW_LINFr2
      data CAN4_SG_zGW_LINFr2: type=DT_CAN4_SG_zGW_LINFr2
    IF_CAN4_SG_zGW_SEAT1
      data CAN4_SG_zGW_SEAT1: type=DT_CAN4_SG_zGW_SEAT1
    IF_CAN5_SG_FD5_CE100_0
      data CAN5_SG_FD5_CE100_0: type=DT_CAN5_SG_FD5_CE100_0
    IF_CAN5_SG_FD5_CONN1
      data CAN5_SG_FD5_CONN1: type=DT_CAN5_SG_FD5_CONN1
    IF_CAN5_SG_FD5_Debug1
      data CAN5_SG_FD5_Debug1: type=DT_CAN5_SG_FD5_Debug1
    IF_CAN5_SG_FD5_Debug2
      data CAN5_SG_FD5_Debug2: type=DT_CAN5_SG_FD5_Debug2
    IF_CAN5_SG_FD5_Debug3
      data CAN5_SG_FD5_Debug3: type=DT_CAN5_SG_FD5_Debug3
    IF_CAN5_SG_FD5_OTA1
      data CAN5_SG_FD5_OTA1: type=DT_CAN5_SG_FD5_OTA1
    IF_CAN5_SG_GW5_CE100_0
      data CAN5_SG_GW5_CE100_0: type=DT_CAN5_SG_GW5_CE100_0
    IF_CAN5_SG_CGW_GW5_CE100_0
      data CAN5_SG_CGW_GW5_CE100_0: type=DT_CAN5_SG_CGW_GW5_CE100_0
    IF_CAN5_SG_TBOX1
      data CAN5_SG_TBOX1: type=DT_CAN5_SG_TBOX1
    IF_CAN5_SG_TBOX2
      data CAN5_SG_TBOX2: type=DT_CAN5_SG_TBOX2
    IF_CAN5_SG_TBOX3
      data CAN5_SG_TBOX3: type=DT_CAN5_SG_TBOX3
    IF_CAN6_SG_FCM1
      data CAN6_SG_FCM1: type=DT_CAN6_SG_FCM1
    IF_CAN6_SG_FCM2
      data CAN6_SG_FCM2: type=DT_CAN6_SG_FCM2
    IF_CAN6_SG_FCM3
      data CAN6_SG_FCM3: type=DT_CAN6_SG_FCM3
    IF_CAN6_SG_FCM4
      data CAN6_SG_FCM4: type=DT_CAN6_SG_FCM4
    IF_CAN6_SG_FD6_APS3
      data CAN6_SG_FD6_APS3: type=DT_CAN6_SG_FD6_APS3
    IF_CAN6_SG_FD6_BCM1
      data CAN6_SG_FD6_BCM1: type=DT_CAN6_SG_FD6_BCM1
    IF_CAN6_SG_FD6_VCU1
      data CAN6_SG_FD6_VCU1: type=DT_CAN6_SG_FD6_VCU1
    IF_CAN6_SG_FD6_VCU2
      data CAN6_SG_FD6_VCU2: type=DT_CAN6_SG_FD6_VCU2
    IF_CAN6_SG_FD6_VMC1
      data CAN6_SG_FD6_VMC1: type=DT_CAN6_SG_FD6_VMC1
    IF_CAN6_SG_GW6_CE100_0
      data CAN6_SG_GW6_CE100_0: type=DT_CAN6_SG_GW6_CE100_0
    IF_CAN6_SG_CGW_GW6_CE100_0
      data CAN6_SG_CGW_GW6_CE100_0: type=DT_CAN6_SG_CGW_GW6_CE100_0
    IF_CAN6_SG_SRR1
      data CAN6_SG_SRR1: type=DT_CAN6_SG_SRR1
    IF_CAN7_SG_GW7_C100_0
      data CAN7_SG_GW7_C100_0: type=DT_CAN7_SG_GW7_C100_0
