ASAP2_VERSION 1 31
/begin PROJECT ProjectName "Project Comment Goes Here"
/begin HEADER "Header Comments go here" /end HEADER
/begin MODULE ModuleName "Module Comment Goes Here"
/begin MOD_COMMON "Mod Common Comment Here" BYTE_ORDER MSB_LAST /end MOD_COMMON
/begin RECORD_LAYOUT Scalar_BOOLEAN FNC_VALUES 1 UBYTE COLUMN_DIR DIRECT /end RECORD_LAYOUT
/begin RECORD_LAYOUT Scalar_UBYTE FNC_VALUES 1 UBYTE COLUMN_DIR DIRECT /end RECORD_LAYOUT
/begin RECORD_LAYOUT Scalar_FLOAT32_IEEE FNC_VALUES 1 FLOAT32_IEEE COLUMN_DIR DIRECT /end RECORD_LAYOUT
/begin RECORD_LAYOUT Lookup1D_UBYTE FNC_VALUES 1 UBYTE COLUMN_DIR DIRECT /end RECORD_LAYOUT
/begin RECORD_LAYOUT Lookup1D_X_UBYTE AXIS_PTS_X 1 UBYTE INDEX_INCR DIRECT /end RECORD_LAYOUT
/begin RECORD_LAYOUT Lookup1D_X_ULONG AXIS_PTS_X 1 ULONG INDEX_INCR DIRECT /end RECORD_LAYOUT
/begin RECORD_LAYOUT Lookup1D_SLONG FNC_VALUES 1 SLONG COLUMN_DIR DIRECT /end RECORD_LAYOUT
/begin RECORD_LAYOUT Lookup1D_X_LONG AXIS_PTS_X 1 SLONG INDEX_INCR DIRECT /end RECORD_LAYOUT
/begin RECORD_LAYOUT Lookup1D_FLOAT32_IEEE FNC_VALUES 1 FLOAT32_IEEE COLUMN_DIR DIRECT /end RECORD_LAYOUT
/begin RECORD_LAYOUT Lookup1D_X_FLOAT32_IEEE AXIS_PTS_X 1 FLOAT32_IEEE INDEX_INCR DIRECT /end RECORD_LAYOUT
/begin RECORD_LAYOUT Lookup1D_FLOAT64_IEEE FNC_VALUES 1 FLOAT64_IEEE COLUMN_DIR DIRECT /end RECORD_LAYOUT
/begin RECORD_LAYOUT Lookup1D_X_FLOAT64_IEEE AXIS_PTS_X 1 FLOAT64_IEEE INDEX_INCR DIRECT /end RECORD_LAYOUT
/begin RECORD_LAYOUT Lookup2D_FLOAT32_IEEE FNC_VALUES 1 FLOAT32_IEEE COLUMN_DIR DIRECT /end RECORD_LAYOUT
/begin RECORD_LAYOUT Lookup2D_X_FLOAT32_IEEE AXIS_PTS_X 1 FLOAT32_IEEE INDEX_INCR DIRECT /end RECORD_LAYOUT
/begin CHARACTERISTIC MTQD_FrGenActReduce_Z_Nm "" MAP 0x0000 /* @ECU_Address@MTQD_FrGenActReduce_Z_Nm@ */ Lookup2D_FLOAT32_IEEE 0 SWC_FDC_type_CM_single_Nm -100000.0 0.0
 /begin AXIS_DESCR COM_AXIS VTQD_FrShaftSpd_rpm SWC_FDC_type_CM_single_rpm 22 -100000.0 100000.0 AXIS_PTS_REF ATQD_FrMotActReduce_X_rpm /end AXIS_DESCR
 /begin AXIS_DESCR COM_AXIS NO_INPUT_QUANTITY SWC_FDC_type_CM_single_C 12 -100.0 300.0 AXIS_PTS_REF ATQD_FrMotActReduce_Y_C /end AXIS_DESCR
/end CHARACTERISTIC
/begin AXIS_PTS ATQD_FrMotActReduce_Y_C "" 0x0000 /* @ECU_Address@ATQD_FrMotActReduce_Y_C@ */ NO_INPUT_QUANTITY Lookup2D_X_FLOAT32_IEEE 0 SWC_FDC_type_CM_single_C 12 -100.0 300.0 /end AXIS_PTS
/begin AXIS_PTS ATQD_FrMotActReduce_X_rpm "" 0x0000 /* @ECU_Address@ATQD_FrMotActReduce_X_rpm@ */ VTQD_FrShaftSpd_rpm Lookup2D_X_FLOAT32_IEEE 0 SWC_FDC_type_CM_single_rpm 22 -100000.0 100000.0 /end AXIS_PTS
/begin CHARACTERISTIC MTQD_FrMotActReduce_Z_Nm "" MAP 0x0000 /* @ECU_Address@MTQD_FrMotActReduce_Z_Nm@ */ Lookup2D_FLOAT32_IEEE 0 SWC_FDC_type_CM_single_Nm 0.0 100000.0
 /begin AXIS_DESCR COM_AXIS VTQD_FrShaftSpd_rpm SWC_FDC_type_CM_single_rpm 22 -100000.0 100000.0 AXIS_PTS_REF ATQD_FrMotActReduce_X_rpm /end AXIS_DESCR
 /begin AXIS_DESCR COM_AXIS NO_INPUT_QUANTITY SWC_FDC_type_CM_single_C 12 -100.0 300.0 AXIS_PTS_REF ATQD_FrMotActReduce_Y_C /end AXIS_DESCR
/end CHARACTERISTIC
/begin CHARACTERISTIC MTQD_RrGenActReduce_Z_Nm "" MAP 0x0000 /* @ECU_Address@MTQD_RrGenActReduce_Z_Nm@ */ Lookup2D_FLOAT32_IEEE 0 SWC_FDC_type_CM_single_Nm -100000.0 0.0
 /begin AXIS_DESCR COM_AXIS VTQD_RrShaftSpd_rpm SWC_FDC_type_CM_single_rpm 22 -100000.0 100000.0 AXIS_PTS_REF ATQD_FrMotActReduce_X_rpm /end AXIS_DESCR
 /begin AXIS_DESCR COM_AXIS NO_INPUT_QUANTITY SWC_FDC_type_CM_single_C 12 -100.0 300.0 AXIS_PTS_REF ATQD_FrMotActReduce_Y_C /end AXIS_DESCR
/end CHARACTERISTIC
/begin CHARACTERISTIC MTQD_RrMotActReduce_Z_Nm "" MAP 0x0000 /* @ECU_Address@MTQD_RrMotActReduce_Z_Nm@ */ Lookup2D_FLOAT32_IEEE 0 SWC_FDC_type_CM_single_Nm 0.0 100000.0
 /begin AXIS_DESCR COM_AXIS VTQD_RrShaftSpd_rpm SWC_FDC_type_CM_single_rpm 22 -100000.0 100000.0 AXIS_PTS_REF ATQD_FrMotActReduce_X_rpm /end AXIS_DESCR
 /begin AXIS_DESCR COM_AXIS NO_INPUT_QUANTITY SWC_FDC_type_CM_single_C 12 -100.0 300.0 AXIS_PTS_REF ATQD_FrMotActReduce_Y_C /end AXIS_DESCR
/end CHARACTERISTIC
/begin CHARACTERISTIC MTQD_BOSEnBPSPosn_Y_pct "" CURVE 0x0000 /* @ECU_Address@MTQD_BOSEnBPSPosn_Y_pct@ */ Lookup1D_FLOAT32_IEEE 0 SWC_FDC_type_CM_single_pct -10.0 125.0
 /begin AXIS_DESCR COM_AXIS VTQD_VehActSpd_kph SWC_FDC_type_CM_single_kph 27 -10.0 300.0 AXIS_PTS_REF ATQD_BOSEnBPSPosn_X_kph /end AXIS_DESCR
/end CHARACTERISTIC
/begin AXIS_PTS ATQD_BOSEnBPSPosn_X_kph "" 0x0000 /* @ECU_Address@ATQD_BOSEnBPSPosn_X_kph@ */ VTQD_VehActSpd_kph Lookup1D_X_FLOAT32_IEEE 0 SWC_FDC_type_CM_single_kph 27 -10.0 300.0 /end AXIS_PTS
/begin CHARACTERISTIC MTQD_BOSMap_Z_pct "" MAP 0x0000 /* @ECU_Address@MTQD_BOSMap_Z_pct@ */ Lookup2D_FLOAT32_IEEE 0 SWC_FDC_type_CM_single_pct 0.0 110.0
 /begin AXIS_DESCR COM_AXIS VTQD_TqTargetShaftSpd_rpm SWC_FDC_type_CM_single_rpm 4 -100000.0 100000.0 AXIS_PTS_REF ATQD_BOSMap_X_rpm /end AXIS_DESCR
 /begin AXIS_DESCR COM_AXIS VTQD_ActBPSPosn_pct SWC_FDC_type_CM_single_pct 11 0.0 110.0 AXIS_PTS_REF ATQD_BOSMap_Y_pct /end AXIS_DESCR
/end CHARACTERISTIC
/begin AXIS_PTS ATQD_BOSMap_Y_pct "" 0x0000 /* @ECU_Address@ATQD_BOSMap_Y_pct@ */ VTQD_ActBPSPosn_pct Lookup2D_X_FLOAT32_IEEE 0 SWC_FDC_type_CM_single_pct 11 0.0 110.0 /end AXIS_PTS
/begin AXIS_PTS ATQD_BOSMap_X_rpm "" 0x0000 /* @ECU_Address@ATQD_BOSMap_X_rpm@ */ VTQD_TqTargetShaftSpd_rpm Lookup2D_X_FLOAT32_IEEE 0 SWC_FDC_type_CM_single_rpm 4 -100000.0 100000.0 /end AXIS_PTS
/begin CHARACTERISTIC MTQD_APSCreepBaseTqD_Z_Nm "" MAP 0x0000 /* @ECU_Address@MTQD_APSCreepBaseTqD_Z_Nm@ */ Lookup2D_FLOAT32_IEEE 0 SWC_FDC_type_CM_single_Nm -100000.0 100000.0
 /begin AXIS_DESCR COM_AXIS VTQD_VehActSpd_kph SWC_FDC_type_CM_single_kph 21 -20.0 20.0 AXIS_PTS_REF ATQD_APSCreepBaseTqD_X_kph /end AXIS_DESCR
 /begin AXIS_DESCR COM_AXIS VTQD_CreepCtrlGrade_Deg SWC_FDC_type_CM_single_deg 27 -90.0 90.0 AXIS_PTS_REF ATQD_APSCreepBaseTqD_Y_Deg /end AXIS_DESCR
/end CHARACTERISTIC
/begin AXIS_PTS ATQD_APSCreepBaseTqD_Y_Deg "" 0x0000 /* @ECU_Address@ATQD_APSCreepBaseTqD_Y_Deg@ */ VTQD_CreepCtrlGrade_Deg Lookup2D_X_FLOAT32_IEEE 0 SWC_FDC_type_CM_single_deg 27 -90.0 90.0 /end AXIS_PTS
/begin AXIS_PTS ATQD_APSCreepBaseTqD_X_kph "" 0x0000 /* @ECU_Address@ATQD_APSCreepBaseTqD_X_kph@ */ VTQD_VehActSpd_kph Lookup2D_X_FLOAT32_IEEE 0 SWC_FDC_type_CM_single_kph 21 -20.0 20.0 /end AXIS_PTS
/begin CHARACTERISTIC MTQD_APSCreepBaseTqR_Z_Nm "" MAP 0x0000 /* @ECU_Address@MTQD_APSCreepBaseTqR_Z_Nm@ */ Lookup2D_FLOAT32_IEEE 0 SWC_FDC_type_CM_single_Nm -100000.0 100000.0
 /begin AXIS_DESCR COM_AXIS VTQD_VehActSpd_kph SWC_FDC_type_CM_single_kph 21 -20.0 20.0 AXIS_PTS_REF ATQD_APSCreepBaseTqR_X_kph /end AXIS_DESCR
 /begin AXIS_DESCR COM_AXIS VTQD_CreepCtrlGrade_Deg SWC_FDC_type_CM_single_deg 27 -90.0 90.0 AXIS_PTS_REF ATQD_APSCreepBaseTqR_Y_Deg /end AXIS_DESCR
/end CHARACTERISTIC
/begin AXIS_PTS ATQD_APSCreepBaseTqR_Y_Deg "" 0x0000 /* @ECU_Address@ATQD_APSCreepBaseTqR_Y_Deg@ */ VTQD_CreepCtrlGrade_Deg Lookup2D_X_FLOAT32_IEEE 0 SWC_FDC_type_CM_single_deg 27 -90.0 90.0 /end AXIS_PTS
/begin AXIS_PTS ATQD_APSCreepBaseTqR_X_kph "" 0x0000 /* @ECU_Address@ATQD_APSCreepBaseTqR_X_kph@ */ VTQD_VehActSpd_kph Lookup2D_X_FLOAT32_IEEE 0 SWC_FDC_type_CM_single_kph 21 -20.0 20.0 /end AXIS_PTS
/begin CHARACTERISTIC MTQD_APSCreepIterm_Z_Nm "" MAP 0x0000 /* @ECU_Address@MTQD_APSCreepIterm_Z_Nm@ */ Lookup2D_FLOAT32_IEEE 0 SWC_FDC_type_CM_single_Nm -1000.0 1000.0
 /begin AXIS_DESCR COM_AXIS VTQD_CreepErrSpd_kph SWC_FDC_type_CM_single_kph 41 -100.0 100.0 AXIS_PTS_REF ATQD_APSCreepIterm_X_kph /end AXIS_DESCR
 /begin AXIS_DESCR COM_AXIS VTQD_VehActSpd_kph SWC_FDC_type_CM_single_kph 7 -100.0 100.0 AXIS_PTS_REF ATQD_APSCreepIterm_Y_kph /end AXIS_DESCR
/end CHARACTERISTIC
/begin AXIS_PTS ATQD_APSCreepIterm_Y_kph "" 0x0000 /* @ECU_Address@ATQD_APSCreepIterm_Y_kph@ */ VTQD_VehActSpd_kph Lookup2D_X_FLOAT32_IEEE 0 SWC_FDC_type_CM_single_kph 7 -100.0 100.0 /end AXIS_PTS
/begin AXIS_PTS ATQD_APSCreepIterm_X_kph "" 0x0000 /* @ECU_Address@ATQD_APSCreepIterm_X_kph@ */ VTQD_CreepErrSpd_kph Lookup2D_X_FLOAT32_IEEE 0 SWC_FDC_type_CM_single_kph 41 -100.0 100.0 /end AXIS_PTS
/begin CHARACTERISTIC MTQD_APSCreepPterm_Z_Nm "" MAP 0x0000 /* @ECU_Address@MTQD_APSCreepPterm_Z_Nm@ */ Lookup2D_FLOAT32_IEEE 0 SWC_FDC_type_CM_single_Nm -1000.0 1000.0
 /begin AXIS_DESCR COM_AXIS VTQD_CreepErrSpd_kph SWC_FDC_type_CM_single_kph 18 -100.0 100.0 AXIS_PTS_REF ATQD_APSCreepPterm_X_kph /end AXIS_DESCR
 /begin AXIS_DESCR COM_AXIS VTQD_VehActSpd_kph SWC_FDC_type_CM_single_kph 19 -100.0 100.0 AXIS_PTS_REF ATQD_APSCreepPterm_Y_kph /end AXIS_DESCR
/end CHARACTERISTIC
/begin AXIS_PTS ATQD_APSCreepPterm_Y_kph "" 0x0000 /* @ECU_Address@ATQD_APSCreepPterm_Y_kph@ */ VTQD_VehActSpd_kph Lookup2D_X_FLOAT32_IEEE 0 SWC_FDC_type_CM_single_kph 19 -100.0 100.0 /end AXIS_PTS
/begin AXIS_PTS ATQD_APSCreepPterm_X_kph "" 0x0000 /* @ECU_Address@ATQD_APSCreepPterm_X_kph@ */ VTQD_CreepErrSpd_kph Lookup2D_X_FLOAT32_IEEE 0 SWC_FDC_type_CM_single_kph 18 -100.0 100.0 /end AXIS_PTS
/begin CHARACTERISTIC MTQD_CreepBPSDisPosnR_Y_pct "" CURVE 0x0000 /* @ECU_Address@MTQD_CreepBPSDisPosnR_Y_pct@ */ Lookup1D_FLOAT32_IEEE 0 SWC_FDC_type_CM_single_pct 0.0 125.0
 /begin AXIS_DESCR COM_AXIS NO_INPUT_QUANTITY SWC_FDC_type_CM_single_Deg 21 -180.0 180.0 AXIS_PTS_REF ATQD_CreepBPSDisPosnR_X_Deg /end AXIS_DESCR
/end CHARACTERISTIC
/begin AXIS_PTS ATQD_CreepBPSDisPosnR_X_Deg "" 0x0000 /* @ECU_Address@ATQD_CreepBPSDisPosnR_X_Deg@ */ NO_INPUT_QUANTITY Lookup1D_X_FLOAT32_IEEE 0 SWC_FDC_type_CM_single_Deg 21 -180.0 180.0 /end AXIS_PTS
/begin CHARACTERISTIC MTQD_CreepBPSDisPosn_Y_pct "" CURVE 0x0000 /* @ECU_Address@MTQD_CreepBPSDisPosn_Y_pct@ */ Lookup1D_FLOAT32_IEEE 0 SWC_FDC_type_CM_single_pct 0.0 125.0
 /begin AXIS_DESCR COM_AXIS NO_INPUT_QUANTITY SWC_FDC_type_CM_single_deg 21 -100.0 100.0 AXIS_PTS_REF ATQD_CreepBPSDisPosn_X_Deg /end AXIS_DESCR
/end CHARACTERISTIC
/begin AXIS_PTS ATQD_CreepBPSDisPosn_X_Deg "" 0x0000 /* @ECU_Address@ATQD_CreepBPSDisPosn_X_Deg@ */ NO_INPUT_QUANTITY Lookup1D_X_FLOAT32_IEEE 0 SWC_FDC_type_CM_single_deg 21 -100.0 100.0 /end AXIS_PTS
/begin CHARACTERISTIC MTQD_CreepBPSEnPosnR_Y_pct "" CURVE 0x0000 /* @ECU_Address@MTQD_CreepBPSEnPosnR_Y_pct@ */ Lookup1D_FLOAT32_IEEE 0 SWC_FDC_type_CM_single_pct 0.0 125.0
 /begin AXIS_DESCR COM_AXIS NO_INPUT_QUANTITY SWC_FDC_type_CM_single_Deg 21 -180.0 180.0 AXIS_PTS_REF ATQD_CreepBPSEnPosnR_X_Deg /end AXIS_DESCR
/end CHARACTERISTIC
/begin AXIS_PTS ATQD_CreepBPSEnPosnR_X_Deg "" 0x0000 /* @ECU_Address@ATQD_CreepBPSEnPosnR_X_Deg@ */ NO_INPUT_QUANTITY Lookup1D_X_FLOAT32_IEEE 0 SWC_FDC_type_CM_single_Deg 21 -180.0 180.0 /end AXIS_PTS
/begin CHARACTERISTIC MTQD_CreepBPSEnPosn_Y_pct "" CURVE 0x0000 /* @ECU_Address@MTQD_CreepBPSEnPosn_Y_pct@ */ Lookup1D_FLOAT32_IEEE 0 SWC_FDC_type_CM_single_pct 0.0 125.0
 /begin AXIS_DESCR COM_AXIS NO_INPUT_QUANTITY SWC_FDC_type_CM_single_deg 21 -100.0 100.0 AXIS_PTS_REF ATQD_CreepBPSEnPosn_X_Deg /end AXIS_DESCR
/end CHARACTERISTIC
/begin AXIS_PTS ATQD_CreepBPSEnPosn_X_Deg "" 0x0000 /* @ECU_Address@ATQD_CreepBPSEnPosn_X_Deg@ */ NO_INPUT_QUANTITY Lookup1D_X_FLOAT32_IEEE 0 SWC_FDC_type_CM_single_deg 21 -100.0 100.0 /end AXIS_PTS
/begin CHARACTERISTIC MTQD_CreepBaseTqD_Z_Nm "" MAP 0x0000 /* @ECU_Address@MTQD_CreepBaseTqD_Z_Nm@ */ Lookup2D_FLOAT32_IEEE 0 SWC_FDC_type_CM_single_Nm -100000.0 100000.0
 /begin AXIS_DESCR COM_AXIS VTQD_VehActSpd_kph SWC_FDC_type_CM_single_kph 21 -20.0 20.0 AXIS_PTS_REF ATQD_CreepBaseTqD_X_kph /end AXIS_DESCR
 /begin AXIS_DESCR COM_AXIS VTQD_CreepCtrlGrade_Deg SWC_FDC_type_CM_single_deg 27 -90.0 90.0 AXIS_PTS_REF ATQD_CreepBaseTqD_Y_Deg /end AXIS_DESCR
/end CHARACTERISTIC
/begin AXIS_PTS ATQD_CreepBaseTqD_Y_Deg "" 0x0000 /* @ECU_Address@ATQD_CreepBaseTqD_Y_Deg@ */ VTQD_CreepCtrlGrade_Deg Lookup2D_X_FLOAT32_IEEE 0 SWC_FDC_type_CM_single_deg 27 -90.0 90.0 /end AXIS_PTS
/begin AXIS_PTS ATQD_CreepBaseTqD_X_kph "" 0x0000 /* @ECU_Address@ATQD_CreepBaseTqD_X_kph@ */ VTQD_VehActSpd_kph Lookup2D_X_FLOAT32_IEEE 0 SWC_FDC_type_CM_single_kph 21 -20.0 20.0 /end AXIS_PTS
/begin CHARACTERISTIC MTQD_CreepBaseTqR_Z_Nm "" MAP 0x0000 /* @ECU_Address@MTQD_CreepBaseTqR_Z_Nm@ */ Lookup2D_FLOAT32_IEEE 0 SWC_FDC_type_CM_single_Nm -100000.0 100000.0
 /begin AXIS_DESCR COM_AXIS VTQD_VehActSpd_kph SWC_FDC_type_CM_single_kph 21 -20.0 20.0 AXIS_PTS_REF ATQD_CreepBaseTqR_X_kph /end AXIS_DESCR
 /begin AXIS_DESCR COM_AXIS VTQD_CreepCtrlGrade_Deg SWC_FDC_type_CM_single_deg 27 -90.0 90.0 AXIS_PTS_REF ATQD_CreepBaseTqR_Y_Deg /end AXIS_DESCR
/end CHARACTERISTIC
/begin AXIS_PTS ATQD_CreepBaseTqR_Y_Deg "" 0x0000 /* @ECU_Address@ATQD_CreepBaseTqR_Y_Deg@ */ VTQD_CreepCtrlGrade_Deg Lookup2D_X_FLOAT32_IEEE 0 SWC_FDC_type_CM_single_deg 27 -90.0 90.0 /end AXIS_PTS
/begin AXIS_PTS ATQD_CreepBaseTqR_X_kph "" 0x0000 /* @ECU_Address@ATQD_CreepBaseTqR_X_kph@ */ VTQD_VehActSpd_kph Lookup2D_X_FLOAT32_IEEE 0 SWC_FDC_type_CM_single_kph 21 -20.0 20.0 /end AXIS_PTS
/begin CHARACTERISTIC MTQD_CreepDeltaTq_Y_Nm "" CURVE 0x0000 /* @ECU_Address@MTQD_CreepDeltaTq_Y_Nm@ */ Lookup1D_FLOAT32_IEEE 0 SWC_FDC_type_CM_single_Nm -100000.0 100000.0
 /begin AXIS_DESCR COM_AXIS VTQD_CreepErrSpd_kph SWC_FDC_type_CM_single_kph 41 -30.0 20.0 AXIS_PTS_REF ATQD_CreepDeltaTq_X_kph /end AXIS_DESCR
/end CHARACTERISTIC
/begin AXIS_PTS ATQD_CreepDeltaTq_X_kph "" 0x0000 /* @ECU_Address@ATQD_CreepDeltaTq_X_kph@ */ VTQD_CreepErrSpd_kph Lookup1D_X_FLOAT32_IEEE 0 SWC_FDC_type_CM_single_kph 41 -30.0 20.0 /end AXIS_PTS
/begin CHARACTERISTIC MTQD_CreepIterm_Z_Nm "" MAP 0x0000 /* @ECU_Address@MTQD_CreepIterm_Z_Nm@ */ Lookup2D_FLOAT32_IEEE 0 SWC_FDC_type_CM_single_Nm -1000.0 1000.0
 /begin AXIS_DESCR COM_AXIS VTQD_CreepErrSpd_kph SWC_FDC_type_CM_single_kph 41 -100.0 100.0 AXIS_PTS_REF ATQD_CreepIterm_X_kph /end AXIS_DESCR
 /begin AXIS_DESCR COM_AXIS VTQD_VehActSpd_kph SWC_FDC_type_CM_single_kph 7 -100.0 100.0 AXIS_PTS_REF ATQD_CreepIterm_Y_kph /end AXIS_DESCR
/end CHARACTERISTIC
/begin AXIS_PTS ATQD_CreepIterm_Y_kph "" 0x0000 /* @ECU_Address@ATQD_CreepIterm_Y_kph@ */ VTQD_VehActSpd_kph Lookup2D_X_FLOAT32_IEEE 0 SWC_FDC_type_CM_single_kph 7 -100.0 100.0 /end AXIS_PTS
/begin AXIS_PTS ATQD_CreepIterm_X_kph "" 0x0000 /* @ECU_Address@ATQD_CreepIterm_X_kph@ */ VTQD_CreepErrSpd_kph Lookup2D_X_FLOAT32_IEEE 0 SWC_FDC_type_CM_single_kph 41 -100.0 100.0 /end AXIS_PTS
/begin CHARACTERISTIC MTQD_CreepPreloadTq_Z_Nm "" MAP 0x0000 /* @ECU_Address@MTQD_CreepPreloadTq_Z_Nm@ */ Lookup2D_FLOAT32_IEEE 0 SWC_FDC_type_CM_single_Nm 0.0 100000.0
 /begin AXIS_DESCR COM_AXIS NO_INPUT_QUANTITY SWC_FDC_type_CM_single_kph 13 0.0 300.0 AXIS_PTS_REF ATQD_CreepPreloadTq_X_kph /end AXIS_DESCR
 /begin AXIS_DESCR COM_AXIS VTQD_CreepPreloadTime_s SWC_FDC_type_CM_single_s 27 0.0 100.0 AXIS_PTS_REF ATQD_CreepPreloadTq_Y_s /end AXIS_DESCR
/end CHARACTERISTIC
/begin AXIS_PTS ATQD_CreepPreloadTq_Y_s "" 0x0000 /* @ECU_Address@ATQD_CreepPreloadTq_Y_s@ */ VTQD_CreepPreloadTime_s Lookup2D_X_FLOAT32_IEEE 0 SWC_FDC_type_CM_single_s 27 0.0 100.0 /end AXIS_PTS
/begin AXIS_PTS ATQD_CreepPreloadTq_X_kph "" 0x0000 /* @ECU_Address@ATQD_CreepPreloadTq_X_kph@ */ NO_INPUT_QUANTITY Lookup2D_X_FLOAT32_IEEE 0 SWC_FDC_type_CM_single_kph 13 0.0 300.0 /end AXIS_PTS
/begin CHARACTERISTIC MTQD_CreepPreloadTime_Y_s "" CURVE 0x0000 /* @ECU_Address@MTQD_CreepPreloadTime_Y_s@ */ Lookup1D_FLOAT32_IEEE 0 SWC_FDC_type_CM_single_s 0.0 3600.0
 /begin AXIS_DESCR COM_AXIS VTQD_VehActSpd_kph SWC_FDC_type_CM_single_kph 13 0.0 300.0 AXIS_PTS_REF ATQD_CreepPreloadTime_X_kph /end AXIS_DESCR
/end CHARACTERISTIC
/begin AXIS_PTS ATQD_CreepPreloadTime_X_kph "" 0x0000 /* @ECU_Address@ATQD_CreepPreloadTime_X_kph@ */ VTQD_VehActSpd_kph Lookup1D_X_FLOAT32_IEEE 0 SWC_FDC_type_CM_single_kph 13 0.0 300.0 /end AXIS_PTS
/begin CHARACTERISTIC MTQD_CreepProtTq_Y_Nm "" CURVE 0x0000 /* @ECU_Address@MTQD_CreepProtTq_Y_Nm@ */ Lookup1D_FLOAT32_IEEE 0 SWC_FDC_type_CM_single_pct -100000.0 100000.0
 /begin AXIS_DESCR COM_AXIS NO_INPUT_QUANTITY SWC_FDC_type_CM_single_deg 21 -100.0 100.0 AXIS_PTS_REF ATQD_CreepProtTq_X_Deg /end AXIS_DESCR
/end CHARACTERISTIC
/begin AXIS_PTS ATQD_CreepProtTq_X_Deg "" 0x0000 /* @ECU_Address@ATQD_CreepProtTq_X_Deg@ */ NO_INPUT_QUANTITY Lookup1D_X_FLOAT32_IEEE 0 SWC_FDC_type_CM_single_deg 21 -100.0 100.0 /end AXIS_PTS
/begin CHARACTERISTIC MTQD_CreepPterm_Z_Nm "" MAP 0x0000 /* @ECU_Address@MTQD_CreepPterm_Z_Nm@ */ Lookup2D_FLOAT32_IEEE 0 SWC_FDC_type_CM_single_Nm -1000.0 1000.0
 /begin AXIS_DESCR COM_AXIS VTQD_CreepErrSpd_kph SWC_FDC_type_CM_single_kph 18 -100.0 100.0 AXIS_PTS_REF ATQD_CreepPterm_X_kph /end AXIS_DESCR
 /begin AXIS_DESCR COM_AXIS VTQD_VehActSpd_kph SWC_FDC_type_CM_single_kph 19 -100.0 100.0 AXIS_PTS_REF ATQD_CreepPterm_Y_kph /end AXIS_DESCR
/end CHARACTERISTIC
/begin AXIS_PTS ATQD_CreepPterm_Y_kph "" 0x0000 /* @ECU_Address@ATQD_CreepPterm_Y_kph@ */ VTQD_VehActSpd_kph Lookup2D_X_FLOAT32_IEEE 0 SWC_FDC_type_CM_single_kph 19 -100.0 100.0 /end AXIS_PTS
/begin AXIS_PTS ATQD_CreepPterm_X_kph "" 0x0000 /* @ECU_Address@ATQD_CreepPterm_X_kph@ */ VTQD_CreepErrSpd_kph Lookup2D_X_FLOAT32_IEEE 0 SWC_FDC_type_CM_single_kph 18 -100.0 100.0 /end AXIS_PTS
/begin CHARACTERISTIC MTQD_CreepTargetSpdD_Y_kph "" CURVE 0x0000 /* @ECU_Address@MTQD_CreepTargetSpdD_Y_kph@ */ Lookup1D_FLOAT32_IEEE 0 SWC_FDC_type_CM_single_kph 0.0 255.0
 /begin AXIS_DESCR COM_AXIS VTQD_ActBPSPosn_pct SWC_FDC_type_CM_single_deg 21 -100.0 100.0 AXIS_PTS_REF ATQD_CreepTargetSpdD_X_pct /end AXIS_DESCR
/end CHARACTERISTIC
/begin AXIS_PTS ATQD_CreepTargetSpdD_X_pct "" 0x0000 /* @ECU_Address@ATQD_CreepTargetSpdD_X_pct@ */ VTQD_ActBPSPosn_pct Lookup1D_X_FLOAT32_IEEE 0 SWC_FDC_type_CM_single_deg 21 -100.0 100.0 /end AXIS_PTS
/begin CHARACTERISTIC MTQD_CreepTargetSpdR_Y_kph "" CURVE 0x0000 /* @ECU_Address@MTQD_CreepTargetSpdR_Y_kph@ */ Lookup1D_FLOAT32_IEEE 0 SWC_FDC_type_CM_single_kph 0.0 255.0
 /begin AXIS_DESCR COM_AXIS VTQD_ActBPSPosn_pct SWC_FDC_type_CM_single_deg 21 -100.0 100.0 AXIS_PTS_REF ATQD_CreepTargetSpdR_X_pct /end AXIS_DESCR
/end CHARACTERISTIC
/begin AXIS_PTS ATQD_CreepTargetSpdR_X_pct "" 0x0000 /* @ECU_Address@ATQD_CreepTargetSpdR_X_pct@ */ VTQD_ActBPSPosn_pct Lookup1D_X_FLOAT32_IEEE 0 SWC_FDC_type_CM_single_deg 21 -100.0 100.0 /end AXIS_PTS
/begin CHARACTERISTIC MTQD_OPDHoldEnSpd_Y_kph "" CURVE 0x0000 /* @ECU_Address@MTQD_OPDHoldEnSpd_Y_kph@ */ Lookup1D_FLOAT32_IEEE 0 SWC_FDC_type_CM_single_kph -10.0 300.0
 /begin AXIS_DESCR COM_AXIS NO_INPUT_QUANTITY SWC_FDC_type_CM_single_Deg 13 -180.0 180.0 AXIS_PTS_REF ATQD_OPDHoldEnSpd_X_Deg /end AXIS_DESCR
/end CHARACTERISTIC
/begin AXIS_PTS ATQD_OPDHoldEnSpd_X_Deg "" 0x0000 /* @ECU_Address@ATQD_OPDHoldEnSpd_X_Deg@ */ NO_INPUT_QUANTITY Lookup1D_X_FLOAT32_IEEE 0 SWC_FDC_type_CM_single_Deg 13 -180.0 180.0 /end AXIS_PTS
/begin CHARACTERISTIC MTQD_WhlSkipDisCreep_Y_enum "" CURVE 0x0000 /* @ECU_Address@MTQD_WhlSkipDisCreep_Y_enum@ */ Lookup1D_UBYTE 0 SWC_FDC_type_CM_uint8_enum 0.0 5.0
 /begin AXIS_DESCR COM_AXIS VTQD_ActWhlSkipSta_enum SWC_FDC_type_CM_uint8_enum 16 0.0 255.0 AXIS_PTS_REF ATQD_WhlSkipDisCreep_X_enum /end AXIS_DESCR
/end CHARACTERISTIC
/begin AXIS_PTS ATQD_WhlSkipDisCreep_X_enum "" 0x0000 /* @ECU_Address@ATQD_WhlSkipDisCreep_X_enum@ */ VTQD_ActWhlSkipSta_enum Lookup1D_X_UBYTE 0 SWC_FDC_type_CM_uint8_enum 16 0.0 255.0 /end AXIS_PTS
/begin CHARACTERISTIC MTQD_EscapeModePedTq_Z_Nm "" MAP 0x0000 /* @ECU_Address@MTQD_EscapeModePedTq_Z_Nm@ */ Lookup2D_FLOAT32_IEEE 0 SWC_FDC_type_CM_single_Nm -100000.0 100000.0
 /begin AXIS_DESCR COM_AXIS VTQD_ActAPSPosn_pct SWC_FDC_type_CM_single_pct 7 -10.0 125.0 AXIS_PTS_REF ATQD_EscapeModePedTq_X_pct /end AXIS_DESCR
 /begin AXIS_DESCR COM_AXIS VTQD_MaxShaftSpd_rpm SWC_FDC_type_CM_single_rpm 9 -100000.0 100000.0 AXIS_PTS_REF ATQD_EscapeModePedTq_Y_rpm /end AXIS_DESCR
/end CHARACTERISTIC
/begin AXIS_PTS ATQD_EscapeModePedTq_Y_rpm "" 0x0000 /* @ECU_Address@ATQD_EscapeModePedTq_Y_rpm@ */ VTQD_MaxShaftSpd_rpm Lookup2D_X_FLOAT32_IEEE 0 SWC_FDC_type_CM_single_rpm 9 -100000.0 100000.0 /end AXIS_PTS
/begin AXIS_PTS ATQD_EscapeModePedTq_X_pct "" 0x0000 /* @ECU_Address@ATQD_EscapeModePedTq_X_pct@ */ VTQD_ActAPSPosn_pct Lookup2D_X_FLOAT32_IEEE 0 SWC_FDC_type_CM_single_pct 7 -10.0 125.0 /end AXIS_PTS
/begin CHARACTERISTIC MTQD_PreLoadTq_Y_Nm "" CURVE 0x0000 /* @ECU_Address@MTQD_PreLoadTq_Y_Nm@ */ Lookup1D_FLOAT32_IEEE 0 SWC_FDC_type_CM_single_Nm -100.0 500.0
 /begin AXIS_DESCR COM_AXIS VTQD_PreLoadHoldtime_s SWC_FDC_type_CM_single_s 10 0.0 100.0 AXIS_PTS_REF ATQD_PreLoadTq_X_s /end AXIS_DESCR
/end CHARACTERISTIC
/begin AXIS_PTS ATQD_PreLoadTq_X_s "" 0x0000 /* @ECU_Address@ATQD_PreLoadTq_X_s@ */ VTQD_PreLoadHoldtime_s Lookup1D_X_FLOAT32_IEEE 0 SWC_FDC_type_CM_single_s 10 0.0 100.0 /end AXIS_PTS
/begin CHARACTERISTIC MTQD_OrigPedTqLowLim_Z_Nm "" MAP 0x0000 /* @ECU_Address@MTQD_OrigPedTqLowLim_Z_Nm@ */ Lookup2D_FLOAT32_IEEE 0 SWC_FDC_type_CM_single_Nm -100000.0 100000.0
 /begin AXIS_DESCR COM_AXIS NO_INPUT_QUANTITY SWC_FDC_type_CM_single_Deg 25 0.0 900.0 AXIS_PTS_REF ATQD_OrigPedTqLowLim_X_Deg /end AXIS_DESCR
 /begin AXIS_DESCR COM_AXIS NO_INPUT_QUANTITY SWC_FDC_type_CM_single_pct 25 -125.0 125.0 AXIS_PTS_REF ATQD_OrigPedTqLowLim_Y_pct /end AXIS_DESCR
/end CHARACTERISTIC
/begin AXIS_PTS ATQD_OrigPedTqLowLim_Y_pct "" 0x0000 /* @ECU_Address@ATQD_OrigPedTqLowLim_Y_pct@ */ NO_INPUT_QUANTITY Lookup2D_X_FLOAT32_IEEE 0 SWC_FDC_type_CM_single_pct 25 -125.0 125.0 /end AXIS_PTS
/begin AXIS_PTS ATQD_OrigPedTqLowLim_X_Deg "" 0x0000 /* @ECU_Address@ATQD_OrigPedTqLowLim_X_Deg@ */ NO_INPUT_QUANTITY Lookup2D_X_FLOAT32_IEEE 0 SWC_FDC_type_CM_single_Deg 25 0.0 900.0 /end AXIS_PTS
/begin CHARACTERISTIC MTQD_PedalMapClimbUpLim_Z_Nm "" MAP 0x0000 /* @ECU_Address@MTQD_PedalMapClimbUpLim_Z_Nm@ */ Lookup2D_FLOAT32_IEEE 0 SWC_FDC_type_CM_single_Nm -100000.0 100000.0
 /begin AXIS_DESCR COM_AXIS NO_INPUT_QUANTITY SWC_FDC_type_CM_single_rpm 21 -1000.0 1000.0 AXIS_PTS_REF ATQD_PedalMapClimbUpLim_X_rpm /end AXIS_DESCR
 /begin AXIS_DESCR COM_AXIS VTQD_GRADE_Deg SWC_FDC_type_CM_single_Deg 27 -180.0 180.0 AXIS_PTS_REF ATQD_PedalMapClimbUpLim_Y_Deg /end AXIS_DESCR
/end CHARACTERISTIC
/begin AXIS_PTS ATQD_PedalMapClimbUpLim_Y_Deg "" 0x0000 /* @ECU_Address@ATQD_PedalMapClimbUpLim_Y_Deg@ */ VTQD_GRADE_Deg Lookup2D_X_FLOAT32_IEEE 0 SWC_FDC_type_CM_single_Deg 27 -180.0 180.0 /end AXIS_PTS
/begin AXIS_PTS ATQD_PedalMapClimbUpLim_X_rpm "" 0x0000 /* @ECU_Address@ATQD_PedalMapClimbUpLim_X_rpm@ */ NO_INPUT_QUANTITY Lookup2D_X_FLOAT32_IEEE 0 SWC_FDC_type_CM_single_rpm 21 -1000.0 1000.0 /end AXIS_PTS
/begin CHARACTERISTIC MTQD_SlideRegenTqGain_Z_Nm "" MAP 0x0000 /* @ECU_Address@MTQD_SlideRegenTqGain_Z_Nm@ */ Lookup2D_FLOAT32_IEEE 0 SWC_FDC_type_CM_single_Nm -100000.0 100000.0
 /begin AXIS_DESCR COM_AXIS NO_INPUT_QUANTITY SWC_FDC_type_CM_single_Gps 30 -10.0 10.0 AXIS_PTS_REF ATQD_SlideRegenTqGain_X_Gps /end AXIS_DESCR
 /begin AXIS_DESCR COM_AXIS VTQD_SlideRateDev_pct SWC_FDC_type_CM_single_pct 38 -125.0 125.0 AXIS_PTS_REF ATQD_SlideRegenTqGain_Y_pct /end AXIS_DESCR
/end CHARACTERISTIC
/begin AXIS_PTS ATQD_SlideRegenTqGain_Y_pct "" 0x0000 /* @ECU_Address@ATQD_SlideRegenTqGain_Y_pct@ */ VTQD_SlideRateDev_pct Lookup2D_X_FLOAT32_IEEE 0 SWC_FDC_type_CM_single_pct 38 -125.0 125.0 /end AXIS_PTS
/begin AXIS_PTS ATQD_SlideRegenTqGain_X_Gps "" 0x0000 /* @ECU_Address@ATQD_SlideRegenTqGain_X_Gps@ */ NO_INPUT_QUANTITY Lookup2D_X_FLOAT32_IEEE 0 SWC_FDC_type_CM_single_Gps 30 -10.0 10.0 /end AXIS_PTS
/begin CHARACTERISTIC MTQD_YawTqLowLim_Y_Nm "" CURVE 0x0000 /* @ECU_Address@MTQD_YawTqLowLim_Y_Nm@ */ Lookup1D_FLOAT32_IEEE 0 SWC_FDC_type_CM_single_Nm -100000.0 100000.0
 /begin AXIS_DESCR COM_AXIS VTQD_TqLowLimYawDev_degps SWC_FDC_type_CM_single_degps 24 -150.0 150.0 AXIS_PTS_REF ATQD_YawTqLowLim_X_degps /end AXIS_DESCR
/end CHARACTERISTIC
/begin AXIS_PTS ATQD_YawTqLowLim_X_degps "" 0x0000 /* @ECU_Address@ATQD_YawTqLowLim_X_degps@ */ VTQD_TqLowLimYawDev_degps Lookup1D_X_FLOAT32_IEEE 0 SWC_FDC_type_CM_single_degps 24 -150.0 150.0 /end AXIS_PTS
/begin CHARACTERISTIC MTQD_APSDecReq_Z_mps2 "" MAP 0x0000 /* @ECU_Address@MTQD_APSDecReq_Z_mps2@ */ Lookup2D_FLOAT32_IEEE 0 SWC_FDC_type_CM_single_mps2 -20.0 20.0
 /begin AXIS_DESCR COM_AXIS VTQD_VehActSpd_kph SWC_FDC_type_CM_single_kph 29 -100.0 100.0 AXIS_PTS_REF ATQD_APSDecReq_X_kph /end AXIS_DESCR
 /begin AXIS_DESCR COM_AXIS VTQD_ActOPDHoldAccDev_mps2 SWC_FDC_type_CM_single_mps2 25 -20.0 20.0 AXIS_PTS_REF ATQD_APSDecReq_Y_mps2 /end AXIS_DESCR
/end CHARACTERISTIC
/begin AXIS_PTS ATQD_APSDecReq_Y_mps2 "" 0x0000 /* @ECU_Address@ATQD_APSDecReq_Y_mps2@ */ VTQD_ActOPDHoldAccDev_mps2 Lookup2D_X_FLOAT32_IEEE 0 SWC_FDC_type_CM_single_mps2 25 -20.0 20.0 /end AXIS_PTS
/begin AXIS_PTS ATQD_APSDecReq_X_kph "" 0x0000 /* @ECU_Address@ATQD_APSDecReq_X_kph@ */ VTQD_VehActSpd_kph Lookup2D_X_FLOAT32_IEEE 0 SWC_FDC_type_CM_single_kph 29 -100.0 100.0 /end AXIS_PTS
/begin CHARACTERISTIC MTQD_APSDecReqCMD_Y_mps2 "" CURVE 0x0000 /* @ECU_Address@MTQD_APSDecReqCMD_Y_mps2@ */ Lookup1D_FLOAT32_IEEE 0 SWC_FDC_type_CM_single_mps2 -20.0 20.0
 /begin AXIS_DESCR COM_AXIS VTQD_VehActSpd_kph SWC_FDC_type_CM_single_kph 16 0.0 300.0 AXIS_PTS_REF ATQD_APSDecReqCMD_X_kph /end AXIS_DESCR
/end CHARACTERISTIC
/begin AXIS_PTS ATQD_APSDecReqCMD_X_kph "" 0x0000 /* @ECU_Address@ATQD_APSDecReqCMD_X_kph@ */ VTQD_VehActSpd_kph Lookup1D_X_FLOAT32_IEEE 0 SWC_FDC_type_CM_single_kph 16 0.0 300.0 /end AXIS_PTS
/begin CHARACTERISTIC MTQD_APSDecReqTs_Y_c "" CURVE 0x0000 /* @ECU_Address@MTQD_APSDecReqTs_Y_c@ */ Lookup1D_FLOAT32_IEEE 0 SWC_FDC_type_CM_single_c 0.0 1.0
 /begin AXIS_DESCR COM_AXIS VTQD_ActAPSPosn_pct SWC_FDC_type_CM_single_c 11 -10.0 125.0 AXIS_PTS_REF ATQD_APSDecReqTs_X_pct /end AXIS_DESCR
/end CHARACTERISTIC
/begin AXIS_PTS ATQD_APSDecReqTs_X_pct "" 0x0000 /* @ECU_Address@ATQD_APSDecReqTs_X_pct@ */ VTQD_ActAPSPosn_pct Lookup1D_X_FLOAT32_IEEE 0 SWC_FDC_type_CM_single_c 11 -10.0 125.0 /end AXIS_PTS
/begin CHARACTERISTIC MTQD_APSDecTimeGain_Z_c "" MAP 0x0000 /* @ECU_Address@MTQD_APSDecTimeGain_Z_c@ */ Lookup2D_FLOAT32_IEEE 0 SWC_FDC_type_CM_single_c 0.0 300.0
 /begin AXIS_DESCR COM_AXIS NO_INPUT_QUANTITY SWC_FDC_type_CM_single_Deg 29 -180.0 180.0 AXIS_PTS_REF ATQD_APSDecTimeGain_X_Deg /end AXIS_DESCR
 /begin AXIS_DESCR COM_AXIS VTQD_APSReqTimer_s SWC_FDC_type_CM_single_s 31 0.0 3600.0 AXIS_PTS_REF ATQD_APSDecTimeGain_Y_s /end AXIS_DESCR
/end CHARACTERISTIC
/begin AXIS_PTS ATQD_APSDecTimeGain_Y_s "" 0x0000 /* @ECU_Address@ATQD_APSDecTimeGain_Y_s@ */ VTQD_APSReqTimer_s Lookup2D_X_FLOAT32_IEEE 0 SWC_FDC_type_CM_single_s 31 0.0 3600.0 /end AXIS_PTS
/begin AXIS_PTS ATQD_APSDecTimeGain_X_Deg "" 0x0000 /* @ECU_Address@ATQD_APSDecTimeGain_X_Deg@ */ NO_INPUT_QUANTITY Lookup2D_X_FLOAT32_IEEE 0 SWC_FDC_type_CM_single_Deg 29 -180.0 180.0 /end AXIS_PTS
/begin CHARACTERISTIC MTQD_APSReqLowSpd_Y_kph "" CURVE 0x0000 /* @ECU_Address@MTQD_APSReqLowSpd_Y_kph@ */ Lookup1D_FLOAT32_IEEE 0 SWC_FDC_type_CM_single_kph -10.0 300.0
 /begin AXIS_DESCR COM_AXIS NO_INPUT_QUANTITY SWC_FDC_type_CM_single_Deg 17 -180.0 180.0 AXIS_PTS_REF ATQD_APSReqLowSpd_X_Deg /end AXIS_DESCR
/end CHARACTERISTIC
/begin AXIS_PTS ATQD_APSReqLowSpd_X_Deg "" 0x0000 /* @ECU_Address@ATQD_APSReqLowSpd_X_Deg@ */ NO_INPUT_QUANTITY Lookup1D_X_FLOAT32_IEEE 0 SWC_FDC_type_CM_single_Deg 17 -180.0 180.0 /end AXIS_PTS
/begin CHARACTERISTIC MTQD_AutoHoldReleaseBPS_Y_pct "" CURVE 0x0000 /* @ECU_Address@MTQD_AutoHoldReleaseBPS_Y_pct@ */ Lookup1D_FLOAT32_IEEE 0 SWC_FDC_type_CM_single_pct -10.0 125.0
 /begin AXIS_DESCR COM_AXIS NO_INPUT_QUANTITY SWC_FDC_type_CM_single_Deg 27 -180.0 180.0 AXIS_PTS_REF ATQD_AutoHoldReleaseBPS_X_Deg /end AXIS_DESCR
/end CHARACTERISTIC
/begin AXIS_PTS ATQD_AutoHoldReleaseBPS_X_Deg "" 0x0000 /* @ECU_Address@ATQD_AutoHoldReleaseBPS_X_Deg@ */ NO_INPUT_QUANTITY Lookup1D_X_FLOAT32_IEEE 0 SWC_FDC_type_CM_single_Deg 27 -180.0 180.0 /end AXIS_PTS
/begin CHARACTERISTIC MTQD_OPDHoldDownRelDelay_Y_s "" CURVE 0x0000 /* @ECU_Address@MTQD_OPDHoldDownRelDelay_Y_s@ */ Lookup1D_FLOAT32_IEEE 0 SWC_FDC_type_CM_single_s 0.0 3600.0
 /begin AXIS_DESCR COM_AXIS NO_INPUT_QUANTITY SWC_FDC_type_CM_single_Deg 11 -180.0 180.0 AXIS_PTS_REF ATQD_OPDHoldDownRelDelay_X_Deg /end AXIS_DESCR
/end CHARACTERISTIC
/begin AXIS_PTS ATQD_OPDHoldDownRelDelay_X_Deg "" 0x0000 /* @ECU_Address@ATQD_OPDHoldDownRelDelay_X_Deg@ */ NO_INPUT_QUANTITY Lookup1D_X_FLOAT32_IEEE 0 SWC_FDC_type_CM_single_Deg 11 -180.0 180.0 /end AXIS_PTS
/begin CHARACTERISTIC MTQD_OPDHoldRelDetTime_Y_s "" CURVE 0x0000 /* @ECU_Address@MTQD_OPDHoldRelDetTime_Y_s@ */ Lookup1D_FLOAT32_IEEE 0 SWC_FDC_type_CM_single_s 0.0 3600.0
 /begin AXIS_DESCR COM_AXIS NO_INPUT_QUANTITY SWC_FDC_type_CM_single_Deg 27 -180.0 180.0 AXIS_PTS_REF ATQD_OPDHoldRelDetTime_X_Deg /end AXIS_DESCR
/end CHARACTERISTIC
/begin AXIS_PTS ATQD_OPDHoldRelDetTime_X_Deg "" 0x0000 /* @ECU_Address@ATQD_OPDHoldRelDetTime_X_Deg@ */ NO_INPUT_QUANTITY Lookup1D_X_FLOAT32_IEEE 0 SWC_FDC_type_CM_single_Deg 27 -180.0 180.0 /end AXIS_PTS
/begin CHARACTERISTIC MTQD_OPDHoldReleaseTq_Y_Nm "" CURVE 0x0000 /* @ECU_Address@MTQD_OPDHoldReleaseTq_Y_Nm@ */ Lookup1D_FLOAT32_IEEE 0 SWC_FDC_type_CM_single_Nm -100000.0 100000.0
 /begin AXIS_DESCR COM_AXIS NO_INPUT_QUANTITY SWC_FDC_type_CM_single_Deg 27 -180.0 180.0 AXIS_PTS_REF ATQD_OPDHoldReleaseTq_X_Deg /end AXIS_DESCR
/end CHARACTERISTIC
/begin AXIS_PTS ATQD_OPDHoldReleaseTq_X_Deg "" 0x0000 /* @ECU_Address@ATQD_OPDHoldReleaseTq_X_Deg@ */ NO_INPUT_QUANTITY Lookup1D_X_FLOAT32_IEEE 0 SWC_FDC_type_CM_single_Deg 27 -180.0 180.0 /end AXIS_PTS
/begin CHARACTERISTIC MTQD_WhlSkipDisOPDHold_Y_enum "" CURVE 0x0000 /* @ECU_Address@MTQD_WhlSkipDisOPDHold_Y_enum@ */ Lookup1D_UBYTE 0 SWC_FDC_type_CM_uint8_enum 0.0 5.0
 /begin AXIS_DESCR COM_AXIS VTQD_ActWhlSkipSta_enum SWC_FDC_type_CM_uint8_enum 16 0.0 255.0 AXIS_PTS_REF ATQD_WhlSkipDisOPDHold_X_enum /end AXIS_DESCR
/end CHARACTERISTIC
/begin AXIS_PTS ATQD_WhlSkipDisOPDHold_X_enum "" 0x0000 /* @ECU_Address@ATQD_WhlSkipDisOPDHold_X_enum@ */ VTQD_ActWhlSkipSta_enum Lookup1D_X_UBYTE 0 SWC_FDC_type_CM_uint8_enum 16 0.0 255.0 /end AXIS_PTS
/begin CHARACTERISTIC MTQR_AltRDCActiveFEDUTs_Z_c "" MAP 0x0000 /* @ECU_Address@MTQR_AltRDCActiveFEDUTs_Z_c@ */ Lookup2D_FLOAT32_IEEE 0 SWC_FDC_type_CM_single_c 0.0 1.0
 /begin AXIS_DESCR COM_AXIS NO_INPUT_QUANTITY SWC_FDC_type_CM_single_pct 23 -125.0 125.0 AXIS_PTS_REF ATQR_AltRDCActiveFEDUTs_X_pct /end AXIS_DESCR
 /begin AXIS_DESCR COM_AXIS NO_INPUT_QUANTITY SWC_FDC_type_CM_single_enum 9 0.0 15.0 AXIS_PTS_REF ATQR_AltRDCActiveFEDUTs_Y_enum /end AXIS_DESCR
/end CHARACTERISTIC
/begin AXIS_PTS ATQR_AltRDCActiveFEDUTs_Y_enum "" 0x0000 /* @ECU_Address@ATQR_AltRDCActiveFEDUTs_Y_enum@ */ NO_INPUT_QUANTITY Lookup2D_X_FLOAT32_IEEE 0 SWC_FDC_type_CM_single_enum 9 0.0 15.0 /end AXIS_PTS
/begin AXIS_PTS ATQR_AltRDCActiveFEDUTs_X_pct "" 0x0000 /* @ECU_Address@ATQR_AltRDCActiveFEDUTs_X_pct@ */ NO_INPUT_QUANTITY Lookup2D_X_FLOAT32_IEEE 0 SWC_FDC_type_CM_single_pct 23 -125.0 125.0 /end AXIS_PTS
/begin CHARACTERISTIC MTQR_CreepFEDUTs_Z_c "" MAP 0x0000 /* @ECU_Address@MTQR_CreepFEDUTs_Z_c@ */ Lookup2D_FLOAT32_IEEE 0 SWC_FDC_type_CM_single_c 0.0 1.0
 /begin AXIS_DESCR COM_AXIS NO_INPUT_QUANTITY SWC_FDC_type_CM_single_rpm 9 -100000.0 100000.0 AXIS_PTS_REF ATQR_CreepFEDUTs_X_rpm /end AXIS_DESCR
 /begin AXIS_DESCR COM_AXIS VTQR_FEDUWhlTqReqSmoothDelay_Nm SWC_FDC_type_CM_single_Nm 10 -10000.0 10000.0 AXIS_PTS_REF ATQR_CreepFEDUTs_Y_Nm /end AXIS_DESCR
/end CHARACTERISTIC
/begin AXIS_PTS ATQR_CreepFEDUTs_Y_Nm "" 0x0000 /* @ECU_Address@ATQR_CreepFEDUTs_Y_Nm@ */ VTQR_FEDUWhlTqReqSmoothDelay_Nm Lookup2D_X_FLOAT32_IEEE 0 SWC_FDC_type_CM_single_Nm 10 -10000.0 10000.0 /end AXIS_PTS
/begin AXIS_PTS ATQR_CreepFEDUTs_X_rpm "" 0x0000 /* @ECU_Address@ATQR_CreepFEDUTs_X_rpm@ */ NO_INPUT_QUANTITY Lookup2D_X_FLOAT32_IEEE 0 SWC_FDC_type_CM_single_rpm 9 -100000.0 100000.0 /end AXIS_PTS
/begin CHARACTERISTIC MTQR_FEDUTIPOutTs_Y_c "" CURVE 0x0000 /* @ECU_Address@MTQR_FEDUTIPOutTs_Y_c@ */ Lookup1D_FLOAT32_IEEE 0 SWC_FDC_type_CM_single_c 0.0 1.0
 /begin AXIS_DESCR COM_AXIS NO_INPUT_QUANTITY SWC_FDC_type_CM_single_rpm 24 -100000.0 100000.0 AXIS_PTS_REF ATQR_FEDUTIPOutTs_X_rpm /end AXIS_DESCR
/end CHARACTERISTIC
/begin AXIS_PTS ATQR_FEDUTIPOutTs_X_rpm "" 0x0000 /* @ECU_Address@ATQR_FEDUTIPOutTs_X_rpm@ */ NO_INPUT_QUANTITY Lookup1D_X_FLOAT32_IEEE 0 SWC_FDC_type_CM_single_rpm 24 -100000.0 100000.0 /end AXIS_PTS
/begin CHARACTERISTIC MTQR_VMCFEDUTs_Z_c "" MAP 0x0000 /* @ECU_Address@MTQR_VMCFEDUTs_Z_c@ */ Lookup2D_FLOAT32_IEEE 0 SWC_FDC_type_CM_single_c 0.0 1.0
 /begin AXIS_DESCR COM_AXIS NO_INPUT_QUANTITY SWC_FDC_type_CM_single_rpm 24 -100000.0 100000.0 AXIS_PTS_REF ATQR_VMCFEDUTs_X_rpm /end AXIS_DESCR
 /begin AXIS_DESCR COM_AXIS VTQR_FEDUWhlTqReqSmoothDelay_Nm SWC_FDC_type_CM_single_Nm 18 -10000.0 10000.0 AXIS_PTS_REF ATQR_VMCFEDUTs_Y_Nm /end AXIS_DESCR
/end CHARACTERISTIC
/begin AXIS_PTS ATQR_VMCFEDUTs_Y_Nm "" 0x0000 /* @ECU_Address@ATQR_VMCFEDUTs_Y_Nm@ */ VTQR_FEDUWhlTqReqSmoothDelay_Nm Lookup2D_X_FLOAT32_IEEE 0 SWC_FDC_type_CM_single_Nm 18 -10000.0 10000.0 /end AXIS_PTS
/begin AXIS_PTS ATQR_VMCFEDUTs_X_rpm "" 0x0000 /* @ECU_Address@ATQR_VMCFEDUTs_X_rpm@ */ NO_INPUT_QUANTITY Lookup2D_X_FLOAT32_IEEE 0 SWC_FDC_type_CM_single_rpm 24 -100000.0 100000.0 /end AXIS_PTS
/begin CHARACTERISTIC MTQR_FShaftSpdTqLimCoe_Y_c "" CURVE 0x0000 /* @ECU_Address@MTQR_FShaftSpdTqLimCoe_Y_c@ */ Lookup1D_FLOAT32_IEEE 0 SWC_FDC_type_CM_single_c 0.0 1.0
 /begin AXIS_DESCR COM_AXIS VTQR_ActFShaftSpdDev_rpm SWC_FDC_type_CM_single_rpm 16 0.0 100000.0 AXIS_PTS_REF ATQR_FShaftSpdTqLimCoe_X_rpm /end AXIS_DESCR
/end CHARACTERISTIC
/begin AXIS_PTS ATQR_FShaftSpdTqLimCoe_X_rpm "" 0x0000 /* @ECU_Address@ATQR_FShaftSpdTqLimCoe_X_rpm@ */ VTQR_ActFShaftSpdDev_rpm Lookup1D_X_FLOAT32_IEEE 0 SWC_FDC_type_CM_single_rpm 16 0.0 100000.0 /end AXIS_PTS
/begin CHARACTERISTIC MTQR_FTimerTqLimCoe_Y_c "" CURVE 0x0000 /* @ECU_Address@MTQR_FTimerTqLimCoe_Y_c@ */ Lookup1D_FLOAT32_IEEE 0 SWC_FDC_type_CM_single_c 0.0 1.0
 /begin AXIS_DESCR COM_AXIS VTQR_FShaftSpdDevTime_s SWC_FDC_type_CM_single_s 12 0.0 3600.0 AXIS_PTS_REF ATQR_FTimerTqLimCoe_X_s /end AXIS_DESCR
/end CHARACTERISTIC
/begin AXIS_PTS ATQR_FTimerTqLimCoe_X_s "" 0x0000 /* @ECU_Address@ATQR_FTimerTqLimCoe_X_s@ */ VTQR_FShaftSpdDevTime_s Lookup1D_X_FLOAT32_IEEE 0 SWC_FDC_type_CM_single_s 12 0.0 3600.0 /end AXIS_PTS
/begin CHARACTERISTIC MTQR_AltRDCActiveFEDUInc_Z_Nm "" MAP 0x0000 /* @ECU_Address@MTQR_AltRDCActiveFEDUInc_Z_Nm@ */ Lookup2D_FLOAT32_IEEE 0 SWC_FDC_type_CM_single_Nm -100000.0 100000.0
 /begin AXIS_DESCR COM_AXIS NO_INPUT_QUANTITY SWC_FDC_type_CM_single_pct 23 -125.0 125.0 AXIS_PTS_REF ATQR_AltRDCActiveFEDUInc_X_pct /end AXIS_DESCR
 /begin AXIS_DESCR COM_AXIS NO_INPUT_QUANTITY SWC_FDC_type_CM_single_enum 9 0.0 15.0 AXIS_PTS_REF ATQR_AltRDCActiveFEDUInc_Y_enum /end AXIS_DESCR
/end CHARACTERISTIC
/begin AXIS_PTS ATQR_AltRDCActiveFEDUInc_Y_enum "" 0x0000 /* @ECU_Address@ATQR_AltRDCActiveFEDUInc_Y_enum@ */ NO_INPUT_QUANTITY Lookup2D_X_FLOAT32_IEEE 0 SWC_FDC_type_CM_single_enum 9 0.0 15.0 /end AXIS_PTS
/begin AXIS_PTS ATQR_AltRDCActiveFEDUInc_X_pct "" 0x0000 /* @ECU_Address@ATQR_AltRDCActiveFEDUInc_X_pct@ */ NO_INPUT_QUANTITY Lookup2D_X_FLOAT32_IEEE 0 SWC_FDC_type_CM_single_pct 23 -125.0 125.0 /end AXIS_PTS
/begin CHARACTERISTIC MTQR_CreepFEDUTqDecSR_Z_Nm "" MAP 0x0000 /* @ECU_Address@MTQR_CreepFEDUTqDecSR_Z_Nm@ */ Lookup2D_FLOAT32_IEEE 0 SWC_FDC_type_CM_single_Nm -10000.0 0.0
 /begin AXIS_DESCR COM_AXIS NO_INPUT_QUANTITY SWC_FDC_type_CM_single_rpm 9 -100000.0 100000.0 AXIS_PTS_REF ATQR_CreepFEDUTqIncSR_X_rpm /end AXIS_DESCR
 /begin AXIS_DESCR COM_AXIS VTQR_FEDUWhlTqReqSmoothDelay_Nm SWC_FDC_type_CM_single_Nm 10 -10000.0 10000.0 AXIS_PTS_REF ATQR_CreepFEDUTqIncSR_Y_Nm /end AXIS_DESCR
/end CHARACTERISTIC
/begin AXIS_PTS ATQR_CreepFEDUTqIncSR_Y_Nm "" 0x0000 /* @ECU_Address@ATQR_CreepFEDUTqIncSR_Y_Nm@ */ VTQR_FEDUWhlTqReqSmoothDelay_Nm Lookup2D_X_FLOAT32_IEEE 0 SWC_FDC_type_CM_single_Nm 10 -10000.0 10000.0 /end AXIS_PTS
/begin AXIS_PTS ATQR_CreepFEDUTqIncSR_X_rpm "" 0x0000 /* @ECU_Address@ATQR_CreepFEDUTqIncSR_X_rpm@ */ NO_INPUT_QUANTITY Lookup2D_X_FLOAT32_IEEE 0 SWC_FDC_type_CM_single_rpm 9 -100000.0 100000.0 /end AXIS_PTS
/begin CHARACTERISTIC MTQR_CreepFEDUTqIncSR_Z_Nm "" MAP 0x0000 /* @ECU_Address@MTQR_CreepFEDUTqIncSR_Z_Nm@ */ Lookup2D_FLOAT32_IEEE 0 SWC_FDC_type_CM_single_Nm 0.0 100000.0
 /begin AXIS_DESCR COM_AXIS NO_INPUT_QUANTITY SWC_FDC_type_CM_single_rpm 9 -100000.0 100000.0 AXIS_PTS_REF ATQR_CreepFEDUTqIncSR_X_rpm /end AXIS_DESCR
 /begin AXIS_DESCR COM_AXIS VTQR_FEDUWhlTqReqSmoothDelay_Nm SWC_FDC_type_CM_single_Nm 10 -10000.0 10000.0 AXIS_PTS_REF ATQR_CreepFEDUTqIncSR_Y_Nm /end AXIS_DESCR
/end CHARACTERISTIC
/begin CHARACTERISTIC MTQR_FrPreLoadTqDecSR_Z_Nm "" MAP 0x0000 /* @ECU_Address@MTQR_FrPreLoadTqDecSR_Z_Nm@ */ Lookup2D_FLOAT32_IEEE 0 SWC_FDC_type_CM_single_Nm -100000.0 0.0
 /begin AXIS_DESCR COM_AXIS NO_INPUT_QUANTITY SWC_FDC_type_CM_single_rpm 9 -100000.0 100000.0 AXIS_PTS_REF ATQR_FrPreLoadTqIncSR_X_rpm /end AXIS_DESCR
 /begin AXIS_DESCR COM_AXIS VTQR_FEDUWhlTqReqSmoothDelay_Nm SWC_FDC_type_CM_single_Nm 10 -100000.0 100000.0 AXIS_PTS_REF ATQR_FrPreLoadTqIncSR_Y_Nm /end AXIS_DESCR
/end CHARACTERISTIC
/begin AXIS_PTS ATQR_FrPreLoadTqIncSR_Y_Nm "" 0x0000 /* @ECU_Address@ATQR_FrPreLoadTqIncSR_Y_Nm@ */ VTQR_FEDUWhlTqReqSmoothDelay_Nm Lookup2D_X_FLOAT32_IEEE 0 SWC_FDC_type_CM_single_Nm 10 -100000.0 100000.0 /end AXIS_PTS
/begin AXIS_PTS ATQR_FrPreLoadTqIncSR_X_rpm "" 0x0000 /* @ECU_Address@ATQR_FrPreLoadTqIncSR_X_rpm@ */ NO_INPUT_QUANTITY Lookup2D_X_FLOAT32_IEEE 0 SWC_FDC_type_CM_single_rpm 9 -100000.0 100000.0 /end AXIS_PTS
/begin CHARACTERISTIC MTQR_FrPreLoadTqIncSR_Z_Nm "" MAP 0x0000 /* @ECU_Address@MTQR_FrPreLoadTqIncSR_Z_Nm@ */ Lookup2D_FLOAT32_IEEE 0 SWC_FDC_type_CM_single_Nm 0.0 100000.0
 /begin AXIS_DESCR COM_AXIS NO_INPUT_QUANTITY SWC_FDC_type_CM_single_rpm 9 -100000.0 100000.0 AXIS_PTS_REF ATQR_FrPreLoadTqIncSR_X_rpm /end AXIS_DESCR
 /begin AXIS_DESCR COM_AXIS VTQR_FEDUWhlTqReqSmoothDelay_Nm SWC_FDC_type_CM_single_Nm 10 -100000.0 100000.0 AXIS_PTS_REF ATQR_FrPreLoadTqIncSR_Y_Nm /end AXIS_DESCR
/end CHARACTERISTIC
/begin CHARACTERISTIC MTQR_VMCFEDUTqDecSR_Z_Nm "" MAP 0x0000 /* @ECU_Address@MTQR_VMCFEDUTqDecSR_Z_Nm@ */ Lookup2D_FLOAT32_IEEE 0 SWC_FDC_type_CM_single_Nm -100000.0 100000.0
 /begin AXIS_DESCR COM_AXIS NO_INPUT_QUANTITY SWC_FDC_type_CM_single_rpm 24 -100000.0 100000.0 AXIS_PTS_REF ATQR_VMCFEDUTqIncSR_X_rpm /end AXIS_DESCR
 /begin AXIS_DESCR COM_AXIS VTQR_FEDUWhlTqReqSmoothDelay_Nm SWC_FDC_type_CM_single_Nm 18 -10000.0 10000.0 AXIS_PTS_REF ATQR_VMCFEDUTqIncSR_Y_Nm /end AXIS_DESCR
/end CHARACTERISTIC
/begin AXIS_PTS ATQR_VMCFEDUTqIncSR_Y_Nm "" 0x0000 /* @ECU_Address@ATQR_VMCFEDUTqIncSR_Y_Nm@ */ VTQR_FEDUWhlTqReqSmoothDelay_Nm Lookup2D_X_FLOAT32_IEEE 0 SWC_FDC_type_CM_single_Nm 18 -10000.0 10000.0 /end AXIS_PTS
/begin AXIS_PTS ATQR_VMCFEDUTqIncSR_X_rpm "" 0x0000 /* @ECU_Address@ATQR_VMCFEDUTqIncSR_X_rpm@ */ NO_INPUT_QUANTITY Lookup2D_X_FLOAT32_IEEE 0 SWC_FDC_type_CM_single_rpm 24 -100000.0 100000.0 /end AXIS_PTS
/begin CHARACTERISTIC MTQR_VMCFEDUTqIncSR_Z_Nm "" MAP 0x0000 /* @ECU_Address@MTQR_VMCFEDUTqIncSR_Z_Nm@ */ Lookup2D_FLOAT32_IEEE 0 SWC_FDC_type_CM_single_Nm -100000.0 100000.0
 /begin AXIS_DESCR COM_AXIS NO_INPUT_QUANTITY SWC_FDC_type_CM_single_rpm 24 -100000.0 100000.0 AXIS_PTS_REF ATQR_VMCFEDUTqIncSR_X_rpm /end AXIS_DESCR
 /begin AXIS_DESCR COM_AXIS VTQR_FEDUWhlTqReqSmoothDelay_Nm SWC_FDC_type_CM_single_Nm 18 -10000.0 10000.0 AXIS_PTS_REF ATQR_VMCFEDUTqIncSR_Y_Nm /end AXIS_DESCR
/end CHARACTERISTIC
/begin CHARACTERISTIC MTQR_AltRDCActiveREDUTs_Z_c "" MAP 0x0000 /* @ECU_Address@MTQR_AltRDCActiveREDUTs_Z_c@ */ Lookup2D_FLOAT32_IEEE 0 SWC_FDC_type_CM_single_c 0.0 1.0
 /begin AXIS_DESCR COM_AXIS NO_INPUT_QUANTITY SWC_FDC_type_CM_single_pct 23 -125.0 125.0 AXIS_PTS_REF ATQR_AltRDCActiveREDUTs_X_pct /end AXIS_DESCR
 /begin AXIS_DESCR COM_AXIS NO_INPUT_QUANTITY SWC_FDC_type_CM_single_enum 9 0.0 15.0 AXIS_PTS_REF ATQR_AltRDCActiveREDUTs_Y_enum /end AXIS_DESCR
/end CHARACTERISTIC
/begin AXIS_PTS ATQR_AltRDCActiveREDUTs_Y_enum "" 0x0000 /* @ECU_Address@ATQR_AltRDCActiveREDUTs_Y_enum@ */ NO_INPUT_QUANTITY Lookup2D_X_FLOAT32_IEEE 0 SWC_FDC_type_CM_single_enum 9 0.0 15.0 /end AXIS_PTS
/begin AXIS_PTS ATQR_AltRDCActiveREDUTs_X_pct "" 0x0000 /* @ECU_Address@ATQR_AltRDCActiveREDUTs_X_pct@ */ NO_INPUT_QUANTITY Lookup2D_X_FLOAT32_IEEE 0 SWC_FDC_type_CM_single_pct 23 -125.0 125.0 /end AXIS_PTS
/begin CHARACTERISTIC MTQR_CreepREDUTs_Z_c "" MAP 0x0000 /* @ECU_Address@MTQR_CreepREDUTs_Z_c@ */ Lookup2D_FLOAT32_IEEE 0 SWC_FDC_type_CM_single_c 0.0 1.0
 /begin AXIS_DESCR COM_AXIS NO_INPUT_QUANTITY SWC_FDC_type_CM_single_rpm 9 -100000.0 100000.0 AXIS_PTS_REF ATQR_CreepFEDUTs_X_rpm /end AXIS_DESCR
 /begin AXIS_DESCR COM_AXIS VTQR_REDUWhlTqReqSmoothDelay_Nm SWC_FDC_type_CM_single_Nm 10 -10000.0 10000.0 AXIS_PTS_REF ATQR_CreepFEDUTs_Y_Nm /end AXIS_DESCR
/end CHARACTERISTIC
/begin CHARACTERISTIC MTQR_REDUTIPOutTs_Y_c "" CURVE 0x0000 /* @ECU_Address@MTQR_REDUTIPOutTs_Y_c@ */ Lookup1D_FLOAT32_IEEE 0 SWC_FDC_type_CM_single_c 0.0 1.0
 /begin AXIS_DESCR COM_AXIS NO_INPUT_QUANTITY SWC_FDC_type_CM_single_rpm 24 -100000.0 100000.0 AXIS_PTS_REF ATQR_FEDUTIPOutTs_X_rpm /end AXIS_DESCR
/end CHARACTERISTIC
/begin CHARACTERISTIC MTQR_VMCREDUTs_Z_c "" MAP 0x0000 /* @ECU_Address@MTQR_VMCREDUTs_Z_c@ */ Lookup2D_FLOAT32_IEEE 0 SWC_FDC_type_CM_single_c 0.0 1.0
 /begin AXIS_DESCR COM_AXIS NO_INPUT_QUANTITY SWC_FDC_type_CM_single_rpm 24 -100000.0 100000.0 AXIS_PTS_REF ATQR_VMCFEDUTs_X_rpm /end AXIS_DESCR
 /begin AXIS_DESCR COM_AXIS VTQR_REDUWhlTqReqSmoothDelay_Nm SWC_FDC_type_CM_single_Nm 18 -10000.0 10000.0 AXIS_PTS_REF ATQR_VMCREDUTs_Y_Nm /end AXIS_DESCR
/end CHARACTERISTIC
/begin AXIS_PTS ATQR_VMCREDUTs_Y_Nm "" 0x0000 /* @ECU_Address@ATQR_VMCREDUTs_Y_Nm@ */ VTQR_REDUWhlTqReqSmoothDelay_Nm Lookup2D_X_FLOAT32_IEEE 0 SWC_FDC_type_CM_single_Nm 18 -10000.0 10000.0 /end AXIS_PTS
/begin CHARACTERISTIC MTQR_RShaftSpdTqLimCoe_Y_c "" CURVE 0x0000 /* @ECU_Address@MTQR_RShaftSpdTqLimCoe_Y_c@ */ Lookup1D_FLOAT32_IEEE 0 SWC_FDC_type_CM_single_c 0.0 1.0
 /begin AXIS_DESCR COM_AXIS VTQR_ActRShaftSpdDev_rpm SWC_FDC_type_CM_single_rpm 16 0.0 100000.0 AXIS_PTS_REF ATQR_RShaftSpdTqLimCoe_X_rpm /end AXIS_DESCR
/end CHARACTERISTIC
/begin AXIS_PTS ATQR_RShaftSpdTqLimCoe_X_rpm "" 0x0000 /* @ECU_Address@ATQR_RShaftSpdTqLimCoe_X_rpm@ */ VTQR_ActRShaftSpdDev_rpm Lookup1D_X_FLOAT32_IEEE 0 SWC_FDC_type_CM_single_rpm 16 0.0 100000.0 /end AXIS_PTS
/begin CHARACTERISTIC MTQR_RTimerTqLimCoe_Y_c "" CURVE 0x0000 /* @ECU_Address@MTQR_RTimerTqLimCoe_Y_c@ */ Lookup1D_FLOAT32_IEEE 0 SWC_FDC_type_CM_single_c 0.0 1.0
 /begin AXIS_DESCR COM_AXIS VTQR_RShaftSpdDevTime_s SWC_FDC_type_CM_single_s 12 0.0 3600.0 AXIS_PTS_REF ATQR_RTimerTqLimCoe_X_s /end AXIS_DESCR
/end CHARACTERISTIC
/begin AXIS_PTS ATQR_RTimerTqLimCoe_X_s "" 0x0000 /* @ECU_Address@ATQR_RTimerTqLimCoe_X_s@ */ VTQR_RShaftSpdDevTime_s Lookup1D_X_FLOAT32_IEEE 0 SWC_FDC_type_CM_single_s 12 0.0 3600.0 /end AXIS_PTS
/begin CHARACTERISTIC MTQR_AltRDCActiveREDUInc_Z_Nm "" MAP 0x0000 /* @ECU_Address@MTQR_AltRDCActiveREDUInc_Z_Nm@ */ Lookup2D_FLOAT32_IEEE 0 SWC_FDC_type_CM_single_Nm -100000.0 100000.0
 /begin AXIS_DESCR COM_AXIS NO_INPUT_QUANTITY SWC_FDC_type_CM_single_pct 23 -125.0 125.0 AXIS_PTS_REF ATQR_AltRDCActiveREDUInc_X_pct /end AXIS_DESCR
 /begin AXIS_DESCR COM_AXIS NO_INPUT_QUANTITY SWC_FDC_type_CM_single_enum 9 0.0 15.0 AXIS_PTS_REF ATQR_AltRDCActiveREDUInc_Y_enum /end AXIS_DESCR
/end CHARACTERISTIC
/begin AXIS_PTS ATQR_AltRDCActiveREDUInc_Y_enum "" 0x0000 /* @ECU_Address@ATQR_AltRDCActiveREDUInc_Y_enum@ */ NO_INPUT_QUANTITY Lookup2D_X_FLOAT32_IEEE 0 SWC_FDC_type_CM_single_enum 9 0.0 15.0 /end AXIS_PTS
/begin AXIS_PTS ATQR_AltRDCActiveREDUInc_X_pct "" 0x0000 /* @ECU_Address@ATQR_AltRDCActiveREDUInc_X_pct@ */ NO_INPUT_QUANTITY Lookup2D_X_FLOAT32_IEEE 0 SWC_FDC_type_CM_single_pct 23 -125.0 125.0 /end AXIS_PTS
/begin CHARACTERISTIC MTQR_CreepREDUTqDecSR_Z_Nm "" MAP 0x0000 /* @ECU_Address@MTQR_CreepREDUTqDecSR_Z_Nm@ */ Lookup2D_FLOAT32_IEEE 0 SWC_FDC_type_CM_single_Nm -10000.0 0.0
 /begin AXIS_DESCR COM_AXIS NO_INPUT_QUANTITY SWC_FDC_type_CM_single_rpm 9 -100000.0 100000.0 AXIS_PTS_REF ATQR_CreepFEDUTqIncSR_X_rpm /end AXIS_DESCR
 /begin AXIS_DESCR COM_AXIS VTQR_REDUWhlTqReqSmoothDelay_Nm SWC_FDC_type_CM_single_Nm 10 -10000.0 10000.0 AXIS_PTS_REF ATQR_CreepFEDUTqIncSR_Y_Nm /end AXIS_DESCR
/end CHARACTERISTIC
/begin CHARACTERISTIC MTQR_CreepREDUTqIncSR_Z_Nm "" MAP 0x0000 /* @ECU_Address@MTQR_CreepREDUTqIncSR_Z_Nm@ */ Lookup2D_FLOAT32_IEEE 0 SWC_FDC_type_CM_single_Nm 0.0 100000.0
 /begin AXIS_DESCR COM_AXIS NO_INPUT_QUANTITY SWC_FDC_type_CM_single_rpm 9 -100000.0 100000.0 AXIS_PTS_REF ATQR_CreepFEDUTqIncSR_X_rpm /end AXIS_DESCR
 /begin AXIS_DESCR COM_AXIS VTQR_REDUWhlTqReqSmoothDelay_Nm SWC_FDC_type_CM_single_Nm 10 -10000.0 10000.0 AXIS_PTS_REF ATQR_CreepFEDUTqIncSR_Y_Nm /end AXIS_DESCR
/end CHARACTERISTIC
/begin CHARACTERISTIC MTQR_RrPreLoadTqDecSR_Z_Nm "" MAP 0x0000 /* @ECU_Address@MTQR_RrPreLoadTqDecSR_Z_Nm@ */ Lookup2D_FLOAT32_IEEE 0 SWC_FDC_type_CM_single_Nm -100000.0 0.0
 /begin AXIS_DESCR COM_AXIS NO_INPUT_QUANTITY SWC_FDC_type_CM_single_rpm 9 -100000.0 100000.0 AXIS_PTS_REF ATQR_RrPreLoadTqIncSR_X_rpm /end AXIS_DESCR
 /begin AXIS_DESCR COM_AXIS VTQR_REDUWhlTqReqSmoothDelay_Nm SWC_FDC_type_CM_single_Nm 10 -100000.0 100000.0 AXIS_PTS_REF ATQR_RrPreLoadTqIncSR_Y_Nm /end AXIS_DESCR
/end CHARACTERISTIC
/begin AXIS_PTS ATQR_RrPreLoadTqIncSR_Y_Nm "" 0x0000 /* @ECU_Address@ATQR_RrPreLoadTqIncSR_Y_Nm@ */ VTQR_REDUWhlTqReqSmoothDelay_Nm Lookup2D_X_FLOAT32_IEEE 0 SWC_FDC_type_CM_single_Nm 10 -100000.0 100000.0 /end AXIS_PTS
/begin AXIS_PTS ATQR_RrPreLoadTqIncSR_X_rpm "" 0x0000 /* @ECU_Address@ATQR_RrPreLoadTqIncSR_X_rpm@ */ NO_INPUT_QUANTITY Lookup2D_X_FLOAT32_IEEE 0 SWC_FDC_type_CM_single_rpm 9 -100000.0 100000.0 /end AXIS_PTS
/begin CHARACTERISTIC MTQR_RrPreLoadTqIncSR_Z_Nm "" MAP 0x0000 /* @ECU_Address@MTQR_RrPreLoadTqIncSR_Z_Nm@ */ Lookup2D_FLOAT32_IEEE 0 SWC_FDC_type_CM_single_Nm 0.0 100000.0
 /begin AXIS_DESCR COM_AXIS NO_INPUT_QUANTITY SWC_FDC_type_CM_single_rpm 9 -100000.0 100000.0 AXIS_PTS_REF ATQR_RrPreLoadTqIncSR_X_rpm /end AXIS_DESCR
 /begin AXIS_DESCR COM_AXIS VTQR_REDUWhlTqReqSmoothDelay_Nm SWC_FDC_type_CM_single_Nm 10 -100000.0 100000.0 AXIS_PTS_REF ATQR_RrPreLoadTqIncSR_Y_Nm /end AXIS_DESCR
/end CHARACTERISTIC
/begin CHARACTERISTIC MTQR_VMCREDUTqDecSR_Z_Nm "" MAP 0x0000 /* @ECU_Address@MTQR_VMCREDUTqDecSR_Z_Nm@ */ Lookup2D_FLOAT32_IEEE 0 SWC_FDC_type_CM_single_Nm -100000.0 100000.0
 /begin AXIS_DESCR COM_AXIS NO_INPUT_QUANTITY SWC_FDC_type_CM_single_rpm 24 -100000.0 100000.0 AXIS_PTS_REF ATQR_VMCFEDUTqIncSR_X_rpm /end AXIS_DESCR
 /begin AXIS_DESCR COM_AXIS VTQR_REDUWhlTqReqSmoothDelay_Nm SWC_FDC_type_CM_single_Nm 18 -10000.0 10000.0 AXIS_PTS_REF ATQR_VMCREDUTqIncSR_Y_Nm /end AXIS_DESCR
/end CHARACTERISTIC
/begin AXIS_PTS ATQR_VMCREDUTqIncSR_Y_Nm "" 0x0000 /* @ECU_Address@ATQR_VMCREDUTqIncSR_Y_Nm@ */ VTQR_REDUWhlTqReqSmoothDelay_Nm Lookup2D_X_FLOAT32_IEEE 0 SWC_FDC_type_CM_single_Nm 18 -10000.0 10000.0 /end AXIS_PTS
/begin CHARACTERISTIC MTQR_VMCREDUTqIncSR_Z_Nm "" MAP 0x0000 /* @ECU_Address@MTQR_VMCREDUTqIncSR_Z_Nm@ */ Lookup2D_FLOAT32_IEEE 0 SWC_FDC_type_CM_single_Nm -100000.0 100000.0
 /begin AXIS_DESCR COM_AXIS NO_INPUT_QUANTITY SWC_FDC_type_CM_single_rpm 24 -100000.0 100000.0 AXIS_PTS_REF ATQR_VMCFEDUTqIncSR_X_rpm /end AXIS_DESCR
 /begin AXIS_DESCR COM_AXIS VTQR_REDUWhlTqReqSmoothDelay_Nm SWC_FDC_type_CM_single_Nm 18 -10000.0 10000.0 AXIS_PTS_REF ATQR_VMCREDUTqIncSR_Y_Nm /end AXIS_DESCR
/end CHARACTERISTIC
/begin CHARACTERISTIC KTQD_ACCOvrdCancelPedTqRat_Nm "" VALUE 0x0000 /* @ECU_Address@KTQD_ACCOvrdCancelPedTqRat_Nm@ */ Scalar_FLOAT32_IEEE 0 SWC_FDC_type_CM_single_Nm 0.0 3000.0 /end CHARACTERISTIC
/begin CHARACTERISTIC KTQD_ACCOvrdCancelResPedTq_pct "" VALUE 0x0000 /* @ECU_Address@KTQD_ACCOvrdCancelResPedTq_pct@ */ Scalar_FLOAT32_IEEE 0 SWC_FDC_type_CM_single_pct 0.0 100.0 /end CHARACTERISTIC
/begin CHARACTERISTIC KTQD_ADASHoldDelayEnTime_s "" VALUE 0x0000 /* @ECU_Address@KTQD_ADASHoldDelayEnTime_s@ */ Scalar_FLOAT32_IEEE 0 SWC_FDC_type_CM_single_s 0.0 3600.0 /end CHARACTERISTIC
/begin CHARACTERISTIC KTQD_ADASHoldPreLoadspd_kph "" VALUE 0x0000 /* @ECU_Address@KTQD_ADASHoldPreLoadspd_kph@ */ Scalar_FLOAT32_IEEE 0 SWC_FDC_type_CM_single_kph 0.0 300.0 /end CHARACTERISTIC
/begin CHARACTERISTIC KTQD_AEBEmergBrkSpd_kph "" VALUE 0x0000 /* @ECU_Address@KTQD_AEBEmergBrkSpd_kph@ */ Scalar_FLOAT32_IEEE 0 SWC_FDC_type_CM_single_kph -10.0 255.0 /end CHARACTERISTIC
/begin CHARACTERISTIC KTQD_APSCMDEnCreepSpd_kph "" VALUE 0x0000 /* @ECU_Address@KTQD_APSCMDEnCreepSpd_kph@ */ Scalar_FLOAT32_IEEE 0 SWC_FDC_type_CM_single_kph 0.0 300.0 /end CHARACTERISTIC
/begin CHARACTERISTIC KTQD_APSDecReqMaxTime_s "" VALUE 0x0000 /* @ECU_Address@KTQD_APSDecReqMaxTime_s@ */ Scalar_FLOAT32_IEEE 0 SWC_FDC_type_CM_single_s 0.0 250.0 /end CHARACTERISTIC
/begin CHARACTERISTIC KTQD_APSPreLoadHoldtime_s "" VALUE 0x0000 /* @ECU_Address@KTQD_APSPreLoadHoldtime_s@ */ Scalar_FLOAT32_IEEE 0 SWC_FDC_type_CM_single_s 0.0 10.0 /end CHARACTERISTIC
/begin CHARACTERISTIC KTQD_APSRelDisTqDev_Nm "" VALUE 0x0000 /* @ECU_Address@KTQD_APSRelDisTqDev_Nm@ */ Scalar_FLOAT32_IEEE 0 SWC_FDC_type_CM_single_Nm -10000.0 10000.0 /end CHARACTERISTIC
/begin CHARACTERISTIC KTQD_APSReqDelayTime_s "" VALUE 0x0000 /* @ECU_Address@KTQD_APSReqDelayTime_s@ */ Scalar_FLOAT32_IEEE 0 SWC_FDC_type_CM_single_s 0.0 3600.0 /end CHARACTERISTIC
/begin CHARACTERISTIC KTQD_APSReqDownSpd_kph "" VALUE 0x0000 /* @ECU_Address@KTQD_APSReqDownSpd_kph@ */ Scalar_FLOAT32_IEEE 0 SWC_FDC_type_CM_single_kph -10.0 300.0 /end CHARACTERISTIC
/begin CHARACTERISTIC KTQD_APSReqUpSpd_kph "" VALUE 0x0000 /* @ECU_Address@KTQD_APSReqUpSpd_kph@ */ Scalar_FLOAT32_IEEE 0 SWC_FDC_type_CM_single_kph 0.0 300.0 /end CHARACTERISTIC
/begin CHARACTERISTIC KTQD_APSZeroSpd_kph "" VALUE 0x0000 /* @ECU_Address@KTQD_APSZeroSpd_kph@ */ Scalar_FLOAT32_IEEE 0 SWC_FDC_type_CM_single_kph -10.0 300.0 /end CHARACTERISTIC
/begin CHARACTERISTIC KTQD_AWDFWDSelRRatio_rat "" VALUE 0x0000 /* @ECU_Address@KTQD_AWDFWDSelRRatio_rat@ */ Scalar_FLOAT32_IEEE 0 SWC_FDC_type_CM_single_rat 0.0 1.0 /end CHARACTERISTIC
/begin CHARACTERISTIC KTQD_AWDFrRatio_rat_ovrdval "" VALUE 0x0000 /* @ECU_Address@KTQD_AWDFrRatio_rat_ovrdval@ */ Scalar_FLOAT32_IEEE 0 SWC_FDC_type_CM_single_gain 0.0 1.0 /end CHARACTERISTIC
/begin CHARACTERISTIC KTQD_AWDRWDSelRRatio_rat "" VALUE 0x0000 /* @ECU_Address@KTQD_AWDRWDSelRRatio_rat@ */ Scalar_FLOAT32_IEEE 0 SWC_FDC_type_CM_single_rat 0.0 1.0 /end CHARACTERISTIC
/begin CHARACTERISTIC KTQD_AWDRrRatio_rat_ovrdval "" VALUE 0x0000 /* @ECU_Address@KTQD_AWDRrRatio_rat_ovrdval@ */ Scalar_FLOAT32_IEEE 0 SWC_FDC_type_CM_single_gain 0.0 1.0 /end CHARACTERISTIC
/begin CHARACTERISTIC KTQD_AutoHoldEnSpd_kph "" VALUE 0x0000 /* @ECU_Address@KTQD_AutoHoldEnSpd_kph@ */ Scalar_FLOAT32_IEEE 0 SWC_FDC_type_CM_single_kph -10.0 300.0 /end CHARACTERISTIC
/begin CHARACTERISTIC KTQD_BOSEnPedalTq_Nm "" VALUE 0x0000 /* @ECU_Address@KTQD_BOSEnPedalTq_Nm@ */ Scalar_FLOAT32_IEEE 0 SWC_FDC_type_CM_single_Nm -100000.0 100000.0 /end CHARACTERISTIC
/begin CHARACTERISTIC KTQD_BatapCont_factor "" VALUE 0x0000 /* @ECU_Address@KTQD_BatapCont_factor@ */ Scalar_FLOAT32_IEEE 0 SWC_FDC_type_CM_single_Nm -100000.0 100000.0 /end CHARACTERISTIC
/begin CHARACTERISTIC KTQD_ClimbMin_rpm "" VALUE 0x0000 /* @ECU_Address@KTQD_ClimbMin_rpm@ */ Scalar_FLOAT32_IEEE 0 SWC_FDC_type_CM_single_rpm -100000.0 100000.0 /end CHARACTERISTIC
/begin CHARACTERISTIC KTQD_CreepAPSPosn2Launch_pct "" VALUE 0x0000 /* @ECU_Address@KTQD_CreepAPSPosn2Launch_pct@ */ Scalar_FLOAT32_IEEE 0 SWC_FDC_type_CM_single_pct -125.0 125.0 /end CHARACTERISTIC
/begin CHARACTERISTIC KTQD_CreepDisPedTqSpd_kph "" VALUE 0x0000 /* @ECU_Address@KTQD_CreepDisPedTqSpd_kph@ */ Scalar_FLOAT32_IEEE 0 SWC_FDC_type_CM_single_kph -300.0 300.0 /end CHARACTERISTIC
/begin CHARACTERISTIC KTQD_CreepDisVehSpd_kph "" VALUE 0x0000 /* @ECU_Address@KTQD_CreepDisVehSpd_kph@ */ Scalar_FLOAT32_IEEE 0 SWC_FDC_type_CM_single_kph -10.0 300.0 /end CHARACTERISTIC
/begin CHARACTERISTIC KTQD_CreepDisableSpdofstR_kph "" VALUE 0x0000 /* @ECU_Address@KTQD_CreepDisableSpdofstR_kph@ */ Scalar_FLOAT32_IEEE 0 SWC_FDC_type_CM_single_kph 0.0 300.0 /end CHARACTERISTIC
/begin CHARACTERISTIC KTQD_CreepDisableSpdofst_kph "" VALUE 0x0000 /* @ECU_Address@KTQD_CreepDisableSpdofst_kph@ */ Scalar_FLOAT32_IEEE 0 SWC_FDC_type_CM_single_kph 0.0 300.0 /end CHARACTERISTIC
/begin CHARACTERISTIC KTQD_CreepEnVehSpd_kph "" VALUE 0x0000 /* @ECU_Address@KTQD_CreepEnVehSpd_kph@ */ Scalar_FLOAT32_IEEE 0 SWC_FDC_type_CM_single_kph -10.0 300.0 /end CHARACTERISTIC
/begin CHARACTERISTIC KTQD_CreepEnableSpdR_kph "" VALUE 0x0000 /* @ECU_Address@KTQD_CreepEnableSpdR_kph@ */ Scalar_FLOAT32_IEEE 0 SWC_FDC_type_CM_single_kph 0.0 300.0 /end CHARACTERISTIC
/begin CHARACTERISTIC KTQD_CreepEnableSpd_kph "" VALUE 0x0000 /* @ECU_Address@KTQD_CreepEnableSpd_kph@ */ Scalar_FLOAT32_IEEE 0 SWC_FDC_type_CM_single_kph 0.0 300.0 /end CHARACTERISTIC
/begin CHARACTERISTIC KTQD_CreepGradeLatchSpd_kph "" VALUE 0x0000 /* @ECU_Address@KTQD_CreepGradeLatchSpd_kph@ */ Scalar_FLOAT32_IEEE 0 SWC_FDC_type_CM_single_kph -255.0 255.0 /end CHARACTERISTIC
/begin CHARACTERISTIC KTQD_CreepGradeRecTime_s "" VALUE 0x0000 /* @ECU_Address@KTQD_CreepGradeRecTime_s@ */ Scalar_FLOAT32_IEEE 0 SWC_FDC_type_CM_single_s 0.0 3600.0 /end CHARACTERISTIC
/begin CHARACTERISTIC KTQD_CreepLatchGradeDev_Deg "" VALUE 0x0000 /* @ECU_Address@KTQD_CreepLatchGradeDev_Deg@ */ Scalar_FLOAT32_IEEE 0 SWC_FDC_type_CM_single_deg -100.0 100.0 /end CHARACTERISTIC
/begin CHARACTERISTIC KTQD_CreepLowLimitTq_Nm "" VALUE 0x0000 /* @ECU_Address@KTQD_CreepLowLimitTq_Nm@ */ Scalar_FLOAT32_IEEE 0 SWC_FDC_type_CM_single_Nm -100000.0 0.0 /end CHARACTERISTIC
/begin CHARACTERISTIC KTQD_CreepPrLoadEnSpd_kph "" VALUE 0x0000 /* @ECU_Address@KTQD_CreepPrLoadEnSpd_kph@ */ Scalar_FLOAT32_IEEE 0 SWC_FDC_type_CM_single_kph 0.0 300.0 /end CHARACTERISTIC
/begin CHARACTERISTIC KTQD_CreepUpLimitTq_Nm "" VALUE 0x0000 /* @ECU_Address@KTQD_CreepUpLimitTq_Nm@ */ Scalar_FLOAT32_IEEE 0 SWC_FDC_type_CM_single_Nm 0.0 100000.0 /end CHARACTERISTIC
/begin CHARACTERISTIC KTQD_DCDCCalPwrAvailRsv_kW "" VALUE 0x0000 /* @ECU_Address@KTQD_DCDCCalPwrAvailRsv_kW@ */ Scalar_FLOAT32_IEEE 0 SWC_FDC_type_CM_single_kW 0.0 100000.0 /end CHARACTERISTIC
/begin CHARACTERISTIC KTQD_DriverTqDemN_Nm "" VALUE 0x0000 /* @ECU_Address@KTQD_DriverTqDemN_Nm@ */ Scalar_FLOAT32_IEEE 0 SWC_FDC_type_CM_single_Nm -100000.0 100000.0 /end CHARACTERISTIC
/begin CHARACTERISTIC KTQD_EmergBrkLongAccel_Gps "" VALUE 0x0000 /* @ECU_Address@KTQD_EmergBrkLongAccel_Gps@ */ Scalar_FLOAT32_IEEE 0 SWC_FDC_type_CM_single_Gps -10.0 10.0 /end CHARACTERISTIC
/begin CHARACTERISTIC KTQD_EmergBrkSpd_kph "" VALUE 0x0000 /* @ECU_Address@KTQD_EmergBrkSpd_kph@ */ Scalar_FLOAT32_IEEE 0 SWC_FDC_type_CM_single_kph 0.0 300.0 /end CHARACTERISTIC
/begin CHARACTERISTIC KTQD_EscModeTqLimAccCon_Gps "" VALUE 0x0000 /* @ECU_Address@KTQD_EscModeTqLimAccCon_Gps@ */ Scalar_FLOAT32_IEEE 0 SWC_FDC_type_CM_single_Gps -0.1 2.0 /end CHARACTERISTIC
/begin CHARACTERISTIC KTQD_FrMotorTempHigh_C "" VALUE 0x0000 /* @ECU_Address@KTQD_FrMotorTempHigh_C@ */ Scalar_FLOAT32_IEEE 0 SWC_FDC_type_CM_single_C -100.0 300.0 /end CHARACTERISTIC
/begin CHARACTERISTIC KTQD_FrMotorTempLow_C "" VALUE 0x0000 /* @ECU_Address@KTQD_FrMotorTempLow_C@ */ Scalar_FLOAT32_IEEE 0 SWC_FDC_type_CM_single_C -100.0 300.0 /end CHARACTERISTIC
/begin CHARACTERISTIC KTQD_FrRockAvalMotBaseTq_Nm "" VALUE 0x0000 /* @ECU_Address@KTQD_FrRockAvalMotBaseTq_Nm@ */ Scalar_FLOAT32_IEEE 0 SWC_FDC_type_CM_single_Nm 0.0 100000.0 /end CHARACTERISTIC
/begin CHARACTERISTIC KTQD_FrRockAvalMotTqInc_Nm "" VALUE 0x0000 /* @ECU_Address@KTQD_FrRockAvalMotTqInc_Nm@ */ Scalar_FLOAT32_IEEE 0 SWC_FDC_type_CM_single_Nm 0.0 100000.0 /end CHARACTERISTIC
/begin CHARACTERISTIC KTQD_GRADE_Deg_ovrdval "" VALUE 0x0000 /* @ECU_Address@KTQD_GRADE_Deg_ovrdval@ */ Scalar_FLOAT32_IEEE 0 SWC_FDC_type_CM_single_flg -180.0 180.0 /end CHARACTERISTIC
/begin CHARACTERISTIC KTQD_IVIPedalGRegenLim_pct "" VALUE 0x0000 /* @ECU_Address@KTQD_IVIPedalGRegenLim_pct@ */ Scalar_FLOAT32_IEEE 0 SWC_FDC_type_CM_single_pct -10.0 125.0 /end CHARACTERISTIC
/begin CHARACTERISTIC KTQD_LoSPdBrkRlsTime_s "" VALUE 0x0000 /* @ECU_Address@KTQD_LoSPdBrkRlsTime_s@ */ Scalar_FLOAT32_IEEE 0 SWC_FDC_type_CM_single_s 0.0 3600.0 /end CHARACTERISTIC
/begin CHARACTERISTIC KTQD_LoSpdBrkRlsSpd_kph "" VALUE 0x0000 /* @ECU_Address@KTQD_LoSpdBrkRlsSpd_kph@ */ Scalar_FLOAT32_IEEE 0 SWC_FDC_type_CM_single_kph 0.0 300.0 /end CHARACTERISTIC
/begin CHARACTERISTIC KTQD_LoSpdCtrlBrkPos_pct "" VALUE 0x0000 /* @ECU_Address@KTQD_LoSpdCtrlBrkPos_pct@ */ Scalar_FLOAT32_IEEE 0 SWC_FDC_type_CM_single_pct 0.0 125.0 /end CHARACTERISTIC
/begin CHARACTERISTIC KTQD_LowSkipDisCreepDelay_s "" VALUE 0x0000 /* @ECU_Address@KTQD_LowSkipDisCreepDelay_s@ */ Scalar_FLOAT32_IEEE 0 SWC_FDC_type_CM_single_s 0.0 3600.0 /end CHARACTERISTIC
/begin CHARACTERISTIC KTQD_MALCreepUpLimitTq_Nm "" VALUE 0x0000 /* @ECU_Address@KTQD_MALCreepUpLimitTq_Nm@ */ Scalar_FLOAT32_IEEE 0 SWC_FDC_type_CM_single_Nm -100000.0 100000.0 /end CHARACTERISTIC
/begin CHARACTERISTIC KTQD_NewDistInitRate_rat "" VALUE 0x0000 /* @ECU_Address@KTQD_NewDistInitRate_rat@ */ Scalar_FLOAT32_IEEE 0 SWC_FDC_type_CM_single_rat 0.0 1.0 /end CHARACTERISTIC
/begin CHARACTERISTIC KTQD_OPDCreepDUpLimitTq_Nm "" VALUE 0x0000 /* @ECU_Address@KTQD_OPDCreepDUpLimitTq_Nm@ */ Scalar_FLOAT32_IEEE 0 SWC_FDC_type_CM_single_Nm -100000.0 100000.0 /end CHARACTERISTIC
/begin CHARACTERISTIC KTQD_OPDCreepDisGrade_Deg "" VALUE 0x0000 /* @ECU_Address@KTQD_OPDCreepDisGrade_Deg@ */ Scalar_FLOAT32_IEEE 0 SWC_FDC_type_CM_single_deg -100.0 100.0 /end CHARACTERISTIC
/begin CHARACTERISTIC KTQD_OPDCreepEnGrade_Deg "" VALUE 0x0000 /* @ECU_Address@KTQD_OPDCreepEnGrade_Deg@ */ Scalar_FLOAT32_IEEE 0 SWC_FDC_type_CM_single_deg -100.0 100.0 /end CHARACTERISTIC
/begin CHARACTERISTIC KTQD_OPDCreepTargetSpdD_kph "" VALUE 0x0000 /* @ECU_Address@KTQD_OPDCreepTargetSpdD_kph@ */ Scalar_FLOAT32_IEEE 0 SWC_FDC_type_CM_single_kph -300.0 300.0 /end CHARACTERISTIC
/begin CHARACTERISTIC KTQD_OPDHoldAllowPark_s "" VALUE 0x0000 /* @ECU_Address@KTQD_OPDHoldAllowPark_s@ */ Scalar_FLOAT32_IEEE 0 SWC_FDC_type_CM_single_s 0.0 3600.0 /end CHARACTERISTIC
/begin CHARACTERISTIC KTQD_OPDHoldDetRevSpd_kph "" VALUE 0x0000 /* @ECU_Address@KTQD_OPDHoldDetRevSpd_kph@ */ Scalar_FLOAT32_IEEE 0 SWC_FDC_type_CM_single_kph -300.0 300.0 /end CHARACTERISTIC
/begin CHARACTERISTIC KTQD_OPDHoldDevLowLim_mps2 "" VALUE 0x0000 /* @ECU_Address@KTQD_OPDHoldDevLowLim_mps2@ */ Scalar_FLOAT32_IEEE 0 SWC_FDC_type_CM_single_mps2 -20.0 0.0 /end CHARACTERISTIC
/begin CHARACTERISTIC KTQD_OPDHoldDevUpLim_mps2 "" VALUE 0x0000 /* @ECU_Address@KTQD_OPDHoldDevUpLim_mps2@ */ Scalar_FLOAT32_IEEE 0 SWC_FDC_type_CM_single_mps2 0.0 20.0 /end CHARACTERISTIC
/begin CHARACTERISTIC KTQD_OPDHoldDownEnTime_s "" VALUE 0x0000 /* @ECU_Address@KTQD_OPDHoldDownEnTime_s@ */ Scalar_FLOAT32_IEEE 0 SWC_FDC_type_CM_single_s 0.0 250.0 /end CHARACTERISTIC
/begin CHARACTERISTIC KTQD_OPDHoldLampDelayTime_s "" VALUE 0x0000 /* @ECU_Address@KTQD_OPDHoldLampDelayTime_s@ */ Scalar_FLOAT32_IEEE 0 SWC_FDC_type_CM_single_s 0.0 2.0 /end CHARACTERISTIC
/begin CHARACTERISTIC KTQD_OPDHoldLampDisSpd_kph "" VALUE 0x0000 /* @ECU_Address@KTQD_OPDHoldLampDisSpd_kph@ */ Scalar_FLOAT32_IEEE 0 SWC_FDC_type_CM_single_kph 0.0 300.0 /end CHARACTERISTIC
/begin CHARACTERISTIC KTQD_OPDHoldLampEnSpd_kph "" VALUE 0x0000 /* @ECU_Address@KTQD_OPDHoldLampEnSpd_kph@ */ Scalar_FLOAT32_IEEE 0 SWC_FDC_type_CM_single_kph 0.0 300.0 /end CHARACTERISTIC
/begin CHARACTERISTIC KTQD_OPDHoldLiftRevSpd_kph "" VALUE 0x0000 /* @ECU_Address@KTQD_OPDHoldLiftRevSpd_kph@ */ Scalar_FLOAT32_IEEE 0 SWC_FDC_type_CM_single_kph -300.0 300.0 /end CHARACTERISTIC
/begin CHARACTERISTIC KTQD_OPDHoldPreLoadBound_Nm "" VALUE 0x0000 /* @ECU_Address@KTQD_OPDHoldPreLoadBound_Nm@ */ Scalar_FLOAT32_IEEE 0 SWC_FDC_type_CM_single_Nm -1.0 1000.0 /end CHARACTERISTIC
/begin CHARACTERISTIC KTQD_OPDHoldPreLoadTime_s "" VALUE 0x0000 /* @ECU_Address@KTQD_OPDHoldPreLoadTime_s@ */ Scalar_FLOAT32_IEEE 0 SWC_FDC_type_CM_single_s 0.0 3600.0 /end CHARACTERISTIC
/begin CHARACTERISTIC KTQD_OPDHoldRelDetSpd_kph "" VALUE 0x0000 /* @ECU_Address@KTQD_OPDHoldRelDetSpd_kph@ */ Scalar_FLOAT32_IEEE 0 SWC_FDC_type_CM_single_kph -300.0 300.0 /end CHARACTERISTIC
/begin CHARACTERISTIC KTQD_OPDHoldRelTqGain_Nm "" VALUE 0x0000 /* @ECU_Address@KTQD_OPDHoldRelTqGain_Nm@ */ Scalar_FLOAT32_IEEE 0 SWC_FDC_type_CM_single_Nm -10000.0 100000.0 /end CHARACTERISTIC
/begin CHARACTERISTIC KTQD_OPDHoldSkipDetSpd_kph "" VALUE 0x0000 /* @ECU_Address@KTQD_OPDHoldSkipDetSpd_kph@ */ Scalar_FLOAT32_IEEE 0 SWC_FDC_type_CM_single_kph -255.0 255.0 /end CHARACTERISTIC
/begin CHARACTERISTIC KTQD_PedalMapClimbLowLim_Nm "" VALUE 0x0000 /* @ECU_Address@KTQD_PedalMapClimbLowLim_Nm@ */ Scalar_FLOAT32_IEEE 0 SWC_FDC_type_CM_single_Nm -100000.0 100000.0 /end CHARACTERISTIC
/begin CHARACTERISTIC KTQD_PedalMapRDCLowLim_Nm "" VALUE 0x0000 /* @ECU_Address@KTQD_PedalMapRDCLowLim_Nm@ */ Scalar_FLOAT32_IEEE 0 SWC_FDC_type_CM_single_Nm -100000.0 100000.0 /end CHARACTERISTIC
/begin CHARACTERISTIC KTQD_PedalMapRDCUpLim_Nm "" VALUE 0x0000 /* @ECU_Address@KTQD_PedalMapRDCUpLim_Nm@ */ Scalar_FLOAT32_IEEE 0 SWC_FDC_type_CM_single_Nm -100000.0 100000.0 /end CHARACTERISTIC
/begin CHARACTERISTIC KTQD_PreLoadDisSpd_kph "" VALUE 0x0000 /* @ECU_Address@KTQD_PreLoadDisSpd_kph@ */ Scalar_FLOAT32_IEEE 0 SWC_FDC_type_CM_single_kph -300.0 300.0 /end CHARACTERISTIC
/begin CHARACTERISTIC KTQD_PreLoadTqHold_rpm "" VALUE 0x0000 /* @ECU_Address@KTQD_PreLoadTqHold_rpm@ */ Scalar_FLOAT32_IEEE 0 SWC_FDC_type_CM_single_rpm -3000.0 3000.0 /end CHARACTERISTIC
/begin CHARACTERISTIC KTQD_PreLoadTq_Nm "" VALUE 0x0000 /* @ECU_Address@KTQD_PreLoadTq_Nm@ */ Scalar_FLOAT32_IEEE 0 SWC_FDC_type_CM_single_Nm -100.0 100.0 /end CHARACTERISTIC
/begin CHARACTERISTIC KTQD_PreLoad_Holdtime_s "" VALUE 0x0000 /* @ECU_Address@KTQD_PreLoad_Holdtime_s@ */ Scalar_FLOAT32_IEEE 0 SWC_FDC_type_CM_single_s 0.0 3600.0 /end CHARACTERISTIC
/begin CHARACTERISTIC KTQD_R2DEnOPDHSpdDelayTime_s "" VALUE 0x0000 /* @ECU_Address@KTQD_R2DEnOPDHSpdDelayTime_s@ */ Scalar_FLOAT32_IEEE 0 SWC_FDC_type_CM_single_s 0.0 10.0 /end CHARACTERISTIC
/begin CHARACTERISTIC KTQD_R2DEnOPDHoldSpd_kph "" VALUE 0x0000 /* @ECU_Address@KTQD_R2DEnOPDHoldSpd_kph@ */ Scalar_FLOAT32_IEEE 0 SWC_FDC_type_CM_single_kph -10.0 300.0 /end CHARACTERISTIC
/begin CHARACTERISTIC KTQD_R2DGradeLowLim_Deg "" VALUE 0x0000 /* @ECU_Address@KTQD_R2DGradeLowLim_Deg@ */ Scalar_FLOAT32_IEEE 0 SWC_FDC_type_CM_single_deg -180.0 180.0 /end CHARACTERISTIC
/begin CHARACTERISTIC KTQD_R2DGradeUpLim_Deg "" VALUE 0x0000 /* @ECU_Address@KTQD_R2DGradeUpLim_Deg@ */ Scalar_FLOAT32_IEEE 0 SWC_FDC_type_CM_single_deg -180.0 180.0 /end CHARACTERISTIC
/begin CHARACTERISTIC KTQD_RAPSCreepPreloadSetTime_s "" VALUE 0x0000 /* @ECU_Address@KTQD_RAPSCreepPreloadSetTime_s@ */ Scalar_FLOAT32_IEEE 0 SWC_FDC_type_CM_single_s 0.0 10.0 /end CHARACTERISTIC
/begin CHARACTERISTIC KTQD_RBCCreepRecTq_Nm "" VALUE 0x0000 /* @ECU_Address@KTQD_RBCCreepRecTq_Nm@ */ Scalar_FLOAT32_IEEE 0 SWC_FDC_type_CM_single_Nm -1000.0 1000.0 /end CHARACTERISTIC
/begin CHARACTERISTIC KTQD_RPM2VehSpdTs_c "" VALUE 0x0000 /* @ECU_Address@KTQD_RPM2VehSpdTs_c@ */ Scalar_FLOAT32_IEEE 0 SWC_FDC_type_CM_single_c 0.0 1.0 /end CHARACTERISTIC
/begin CHARACTERISTIC KTQD_RegenOffSpd_kph "" VALUE 0x0000 /* @ECU_Address@KTQD_RegenOffSpd_kph@ */ Scalar_FLOAT32_IEEE 0 SWC_FDC_type_CM_single_kph 0.0 100000.0 /end CHARACTERISTIC
/begin CHARACTERISTIC KTQD_RegenOnSpd_kph "" VALUE 0x0000 /* @ECU_Address@KTQD_RegenOnSpd_kph@ */ Scalar_FLOAT32_IEEE 0 SWC_FDC_type_CM_single_kph 0.0 100000.0 /end CHARACTERISTIC
/begin CHARACTERISTIC KTQD_RgnEnLatchBrkPos_pct "" VALUE 0x0000 /* @ECU_Address@KTQD_RgnEnLatchBrkPos_pct@ */ Scalar_FLOAT32_IEEE 0 SWC_FDC_type_CM_single_pct 0.0 125.0 /end CHARACTERISTIC
/begin CHARACTERISTIC KTQD_RgnEnLatchSlope_Deg "" VALUE 0x0000 /* @ECU_Address@KTQD_RgnEnLatchSlope_Deg@ */ Scalar_FLOAT32_IEEE 0 SWC_FDC_type_CM_single_Deg -180.0 180.0 /end CHARACTERISTIC
/begin CHARACTERISTIC KTQD_RgnEnLatchSpd_kph "" VALUE 0x0000 /* @ECU_Address@KTQD_RgnEnLatchSpd_kph@ */ Scalar_FLOAT32_IEEE 0 SWC_FDC_type_CM_single_kph -300.0 300.0 /end CHARACTERISTIC
/begin CHARACTERISTIC KTQD_RockAvalMotTqReset_pct "" VALUE 0x0000 /* @ECU_Address@KTQD_RockAvalMotTqReset_pct@ */ Scalar_FLOAT32_IEEE 0 SWC_FDC_type_CM_single_pct -10.0 125.0 /end CHARACTERISTIC
/begin CHARACTERISTIC KTQD_RockInitMotTqInc_Nm "" VALUE 0x0000 /* @ECU_Address@KTQD_RockInitMotTqInc_Nm@ */ Scalar_FLOAT32_IEEE 0 SWC_FDC_type_CM_single_Nm 0.0 100000.0 /end CHARACTERISTIC
/begin CHARACTERISTIC KTQD_RockInitTqMotDec_Nm "" VALUE 0x0000 /* @ECU_Address@KTQD_RockInitTqMotDec_Nm@ */ Scalar_FLOAT32_IEEE 0 SWC_FDC_type_CM_single_Nm -100000.0 0.0 /end CHARACTERISTIC
/begin CHARACTERISTIC KTQD_RrEDUTqDistrictMax_gain "" VALUE 0x0000 /* @ECU_Address@KTQD_RrEDUTqDistrictMax_gain@ */ Scalar_FLOAT32_IEEE 0 SWC_FDC_type_CM_single_gain 0.0 1.0 /end CHARACTERISTIC
/begin CHARACTERISTIC KTQD_RrEDUTqDistrictMin_gain "" VALUE 0x0000 /* @ECU_Address@KTQD_RrEDUTqDistrictMin_gain@ */ Scalar_FLOAT32_IEEE 0 SWC_FDC_type_CM_single_gain 0.0 1.0 /end CHARACTERISTIC
/begin CHARACTERISTIC KTQD_RrMotorTempHigh_C "" VALUE 0x0000 /* @ECU_Address@KTQD_RrMotorTempHigh_C@ */ Scalar_FLOAT32_IEEE 0 SWC_FDC_type_CM_single_C -100.0 300.0 /end CHARACTERISTIC
/begin CHARACTERISTIC KTQD_RrMotorTempLow_C "" VALUE 0x0000 /* @ECU_Address@KTQD_RrMotorTempLow_C@ */ Scalar_FLOAT32_IEEE 0 SWC_FDC_type_CM_single_C -100.0 300.0 /end CHARACTERISTIC
/begin CHARACTERISTIC KTQD_RrRockAvalMotBaseTq_Nm "" VALUE 0x0000 /* @ECU_Address@KTQD_RrRockAvalMotBaseTq_Nm@ */ Scalar_FLOAT32_IEEE 0 SWC_FDC_type_CM_single_Nm 0.0 100000.0 /end CHARACTERISTIC
/begin CHARACTERISTIC KTQD_RrRockAvalMotTqInc_Nm "" VALUE 0x0000 /* @ECU_Address@KTQD_RrRockAvalMotTqInc_Nm@ */ Scalar_FLOAT32_IEEE 0 SWC_FDC_type_CM_single_Nm 0.0 100000.0 /end CHARACTERISTIC
/begin CHARACTERISTIC KTQD_SkipRecOPDHoldDelay_s "" VALUE 0x0000 /* @ECU_Address@KTQD_SkipRecOPDHoldDelay_s@ */ Scalar_FLOAT32_IEEE 0 SWC_FDC_type_CM_single_s 0.0 3600.0 /end CHARACTERISTIC
/begin CHARACTERISTIC KTQD_SlideRateDevLowLim_pct "" VALUE 0x0000 /* @ECU_Address@KTQD_SlideRateDevLowLim_pct@ */ Scalar_FLOAT32_IEEE 0 SWC_FDC_type_CM_single_pct -125.0 125.0 /end CHARACTERISTIC
/begin CHARACTERISTIC KTQD_SlideRateDevUpLim_pct "" VALUE 0x0000 /* @ECU_Address@KTQD_SlideRateDevUpLim_pct@ */ Scalar_FLOAT32_IEEE 0 SWC_FDC_type_CM_single_pct -125.0 125.0 /end CHARACTERISTIC
/begin CHARACTERISTIC KTQD_SlideRegEnLimitTq_Nm "" VALUE 0x0000 /* @ECU_Address@KTQD_SlideRegEnLimitTq_Nm@ */ Scalar_FLOAT32_IEEE 0 SWC_FDC_type_CM_single_Nm -100000.0 100000.0 /end CHARACTERISTIC
/begin CHARACTERISTIC KTQD_SlideRegenLowLim_Nm "" VALUE 0x0000 /* @ECU_Address@KTQD_SlideRegenLowLim_Nm@ */ Scalar_FLOAT32_IEEE 0 SWC_FDC_type_CM_single_Nm -100000.0 100000.0 /end CHARACTERISTIC
/begin CHARACTERISTIC KTQD_SmartRegenReq_mps2 "" VALUE 0x0000 /* @ECU_Address@KTQD_SmartRegenReq_mps2@ */ Scalar_FLOAT32_IEEE 0 SWC_FDC_type_CM_single_mps2 -20.0 10.0 /end CHARACTERISTIC
/begin CHARACTERISTIC KTQD_TCSCreepDisSpd_kph "" VALUE 0x0000 /* @ECU_Address@KTQD_TCSCreepDisSpd_kph@ */ Scalar_FLOAT32_IEEE 0 SWC_FDC_type_CM_single_kph -255.0 255.0 /end CHARACTERISTIC
/begin CHARACTERISTIC KTQD_THCMCalPwrAvailRsv_kW "" VALUE 0x0000 /* @ECU_Address@KTQD_THCMCalPwrAvailRsv_kW@ */ Scalar_FLOAT32_IEEE 0 SWC_FDC_type_CM_single_kW 0.0 100000.0 /end CHARACTERISTIC
/begin CHARACTERISTIC KTQD_TargetSlideRate_pct "" VALUE 0x0000 /* @ECU_Address@KTQD_TargetSlideRate_pct@ */ Scalar_FLOAT32_IEEE 0 SWC_FDC_type_CM_single_pct -125.0 125.0 /end CHARACTERISTIC
/begin CHARACTERISTIC KTQD_TireRadius_m "" VALUE 0x0000 /* @ECU_Address@KTQD_TireRadius_m@ */ Scalar_FLOAT32_IEEE 0 SWC_FDC_type_CM_single_m 0.0 100.0 /end CHARACTERISTIC
/begin CHARACTERISTIC KTQD_TotalLowTheldTrq_Nm "" VALUE 0x0000 /* @ECU_Address@KTQD_TotalLowTheldTrq_Nm@ */ Scalar_FLOAT32_IEEE 0 SWC_FDC_type_CM_single_Nm -100000.0 0.0 /end CHARACTERISTIC
/begin CHARACTERISTIC KTQD_TotalUpTheldTrq_Nm "" VALUE 0x0000 /* @ECU_Address@KTQD_TotalUpTheldTrq_Nm@ */ Scalar_FLOAT32_IEEE 0 SWC_FDC_type_CM_single_Nm 0.0 100000.0 /end CHARACTERISTIC
/begin CHARACTERISTIC KTQD_TqDemEnFrTMOutpMotDev_Nm "" VALUE 0x0000 /* @ECU_Address@KTQD_TqDemEnFrTMOutpMotDev_Nm@ */ Scalar_FLOAT32_IEEE 0 SWC_FDC_type_CM_single_Nm 0.0 1000.0 /end CHARACTERISTIC
/begin CHARACTERISTIC KTQD_TqDemEnFrTMOutpRgn_Nm "" VALUE 0x0000 /* @ECU_Address@KTQD_TqDemEnFrTMOutpRgn_Nm@ */ Scalar_FLOAT32_IEEE 0 SWC_FDC_type_CM_single_Nm -3000.0 0.0 /end CHARACTERISTIC
/begin CHARACTERISTIC KTQD_TqDemEnRrTMOutpMot_Nm "" VALUE 0x0000 /* @ECU_Address@KTQD_TqDemEnRrTMOutpMot_Nm@ */ Scalar_FLOAT32_IEEE 0 SWC_FDC_type_CM_single_Nm 0.0 1000.0 /end CHARACTERISTIC
/begin CHARACTERISTIC KTQD_TqDemEnRrTMOutpRgnDev_Nm "" VALUE 0x0000 /* @ECU_Address@KTQD_TqDemEnRrTMOutpRgnDev_Nm@ */ Scalar_FLOAT32_IEEE 0 SWC_FDC_type_CM_single_Nm 0.0 1000.0 /end CHARACTERISTIC
/begin CHARACTERISTIC KTQD_TqDemEnRrTMOutpRgn_Nm "" VALUE 0x0000 /* @ECU_Address@KTQD_TqDemEnRrTMOutpRgn_Nm@ */ Scalar_FLOAT32_IEEE 0 SWC_FDC_type_CM_single_Nm -3000.0 0.0 /end CHARACTERISTIC
/begin CHARACTERISTIC KTQD_VehActSpdNegGain_gain "" VALUE 0x0000 /* @ECU_Address@KTQD_VehActSpdNegGain_gain@ */ Scalar_FLOAT32_IEEE 0 SWC_FDC_type_CM_single_gain -1.0 0.0 /end CHARACTERISTIC
/begin CHARACTERISTIC KTQD_VehActSpdPosGain_gain "" VALUE 0x0000 /* @ECU_Address@KTQD_VehActSpdPosGain_gain@ */ Scalar_FLOAT32_IEEE 0 SWC_FDC_type_CM_single_gain 0.0 1.0 /end CHARACTERISTIC
/begin CHARACTERISTIC KTQR_ACCHoldPdovrdGrade_Deg "" VALUE 0x0000 /* @ECU_Address@KTQR_ACCHoldPdovrdGrade_Deg@ */ Scalar_FLOAT32_IEEE 0 SWC_FDC_type_CM_single_deg -100.0 100.0 /end CHARACTERISTIC
/begin CHARACTERISTIC KTQR_ACCHoldPdovrdInc_Nm "" VALUE 0x0000 /* @ECU_Address@KTQR_ACCHoldPdovrdInc_Nm@ */ Scalar_FLOAT32_IEEE 0 SWC_FDC_type_CM_single_Nm -10000.0 10000.0 /end CHARACTERISTIC
/begin CHARACTERISTIC KTQR_ACCHoldPdovrdVeh_kph "" VALUE 0x0000 /* @ECU_Address@KTQR_ACCHoldPdovrdVeh_kph@ */ Scalar_FLOAT32_IEEE 0 SWC_FDC_type_CM_single_kph -50.0 255.0 /end CHARACTERISTIC
/begin CHARACTERISTIC KTQR_ARegenLatchEnTq_Nm "" VALUE 0x0000 /* @ECU_Address@KTQR_ARegenLatchEnTq_Nm@ */ Scalar_FLOAT32_IEEE 0 SWC_FDC_type_CM_single_Nm -100000.0 100000.0 /end CHARACTERISTIC
/begin CHARACTERISTIC KTQR_DriveModeCMDTqDev_Nm "" VALUE 0x0000 /* @ECU_Address@KTQR_DriveModeCMDTqDev_Nm@ */ Scalar_FLOAT32_IEEE 0 SWC_FDC_type_CM_single_Nm 0.0 1000.0 /end CHARACTERISTIC
/begin CHARACTERISTIC KTQR_DriveModeChangeTq_Nm "" VALUE 0x0000 /* @ECU_Address@KTQR_DriveModeChangeTq_Nm@ */ Scalar_FLOAT32_IEEE 0 SWC_FDC_type_CM_single_Nm 0.0 1000.0 /end CHARACTERISTIC
/begin CHARACTERISTIC KTQR_FShaftSpdDevTs_c "" VALUE 0x0000 /* @ECU_Address@KTQR_FShaftSpdDevTs_c@ */ Scalar_FLOAT32_IEEE 0 SWC_FDC_type_CM_single_c 0.0 1.0 /end CHARACTERISTIC
/begin CHARACTERISTIC KTQR_FShaftSpdTqCoeLimLow_c "" VALUE 0x0000 /* @ECU_Address@KTQR_FShaftSpdTqCoeLimLow_c@ */ Scalar_FLOAT32_IEEE 0 SWC_FDC_type_CM_single_c -0.1 1.0 /end CHARACTERISTIC
/begin CHARACTERISTIC KTQR_FTimerTqCoeLimLow_c "" VALUE 0x0000 /* @ECU_Address@KTQR_FTimerTqCoeLimLow_c@ */ Scalar_FLOAT32_IEEE 0 SWC_FDC_type_CM_single_c -0.1 1.0 /end CHARACTERISTIC
/begin CHARACTERISTIC KTQR_OPDNoZeroTransSpd_kph "" VALUE 0x0000 /* @ECU_Address@KTQR_OPDNoZeroTransSpd_kph@ */ Scalar_FLOAT32_IEEE 0 SWC_FDC_type_CM_single_kph -10.0 300.0 /end CHARACTERISTIC
/begin CHARACTERISTIC KTQR_OPDNoZeroTransTq_Nm "" VALUE 0x0000 /* @ECU_Address@KTQR_OPDNoZeroTransTq_Nm@ */ Scalar_FLOAT32_IEEE 0 SWC_FDC_type_CM_single_Nm -100000.0 100000.0 /end CHARACTERISTIC
/begin CHARACTERISTIC KTQR_PreLoadPreEnTs_c "" VALUE 0x0000 /* @ECU_Address@KTQR_PreLoadPreEnTs_c@ */ Scalar_FLOAT32_IEEE 0 SWC_FDC_type_CM_single_c 0.0 1.0 /end CHARACTERISTIC
/begin CHARACTERISTIC KTQR_PreLoadTs_c "" VALUE 0x0000 /* @ECU_Address@KTQR_PreLoadTs_c@ */ Scalar_FLOAT32_IEEE 0 SWC_FDC_type_CM_single_c 0.0 1.0 /end CHARACTERISTIC
/begin CHARACTERISTIC KTQR_RShaftSpdDevTs_c "" VALUE 0x0000 /* @ECU_Address@KTQR_RShaftSpdDevTs_c@ */ Scalar_FLOAT32_IEEE 0 SWC_FDC_type_CM_single_c 0.0 1.0 /end CHARACTERISTIC
/begin CHARACTERISTIC KTQR_RShaftSpdTqCoeLimLow_c "" VALUE 0x0000 /* @ECU_Address@KTQR_RShaftSpdTqCoeLimLow_c@ */ Scalar_FLOAT32_IEEE 0 SWC_FDC_type_CM_single_c -0.1 1.0 /end CHARACTERISTIC
/begin CHARACTERISTIC KTQR_RTimerTqCoeLimLow_c "" VALUE 0x0000 /* @ECU_Address@KTQR_RTimerTqCoeLimLow_c@ */ Scalar_FLOAT32_IEEE 0 SWC_FDC_type_CM_single_c -0.1 1.0 /end CHARACTERISTIC
/begin CHARACTERISTIC KTQR_ShaftSpdDevTime_s "" VALUE 0x0000 /* @ECU_Address@KTQR_ShaftSpdDevTime_s@ */ Scalar_FLOAT32_IEEE 0 SWC_FDC_type_CM_single_s 0.0 3600.0 /end CHARACTERISTIC
/begin CHARACTERISTIC KTQR_StartTimerShaftDev_rpm "" VALUE 0x0000 /* @ECU_Address@KTQR_StartTimerShaftDev_rpm@ */ Scalar_FLOAT32_IEEE 0 SWC_FDC_type_CM_single_rpm 0.0 100000.0 /end CHARACTERISTIC
/begin CHARACTERISTIC KTQR_TIPOutTsAPS_pct "" VALUE 0x0000 /* @ECU_Address@KTQR_TIPOutTsAPS_pct@ */ Scalar_FLOAT32_IEEE 0 SWC_FDC_type_CM_single_pct 0.0 120.0 /end CHARACTERISTIC
/begin CHARACTERISTIC KTQR_TIPOutTsSpd_kph "" VALUE 0x0000 /* @ECU_Address@KTQR_TIPOutTsSpd_kph@ */ Scalar_FLOAT32_IEEE 0 SWC_FDC_type_CM_single_kph 0.0 255.0 /end CHARACTERISTIC
/begin CHARACTERISTIC KVMC_EstSlopeLongAccelTs_c "" VALUE 0x0000 /* @ECU_Address@KVMC_EstSlopeLongAccelTs_c@ */ Scalar_FLOAT32_IEEE 0 SWC_FDC_type_CM_single_c 0.0 3600.0 /end CHARACTERISTIC
/begin CHARACTERISTIC KVMC_EstSlopeVehSpdTs_c "" VALUE 0x0000 /* @ECU_Address@KVMC_EstSlopeVehSpdTs_c@ */ Scalar_FLOAT32_IEEE 0 SWC_FDC_type_CM_single_c 0.0 3600.0 /end CHARACTERISTIC
/begin CHARACTERISTIC KVMC_FrontRearSlipRatioTHR_kph "" VALUE 0x0000 /* @ECU_Address@KVMC_FrontRearSlipRatioTHR_kph@ */ Scalar_FLOAT32_IEEE 0 SWC_FDC_type_CM_single_kph 0.0 20.0 /end CHARACTERISTIC
/begin CHARACTERISTIC KVMC_LatAccCtrlTHR_Gps "" VALUE 0x0000 /* @ECU_Address@KVMC_LatAccCtrlTHR_Gps@ */ Scalar_FLOAT32_IEEE 0 SWC_FDC_type_CM_single_Gps 0.0 1.0 /end CHARACTERISTIC
/begin CHARACTERISTIC KVMC_RearWhlSlipRatioTHR_kph "" VALUE 0x0000 /* @ECU_Address@KVMC_RearWhlSlipRatioTHR_kph@ */ Scalar_FLOAT32_IEEE 0 SWC_FDC_type_CM_single_kph 0.0 20.0 /end CHARACTERISTIC
/begin CHARACTERISTIC KVMC_ReqBrkInDecSRTime_s "" VALUE 0x0000 /* @ECU_Address@KVMC_ReqBrkInDecSRTime_s@ */ Scalar_FLOAT32_IEEE 0 SWC_FDC_type_CM_single_s 0.005 1.0 /end CHARACTERISTIC
/begin CHARACTERISTIC KVMC_SingleWhlSlipRatioTHR_kph "" VALUE 0x0000 /* @ECU_Address@KVMC_SingleWhlSlipRatioTHR_kph@ */ Scalar_FLOAT32_IEEE 0 SWC_FDC_type_CM_single_kph 0.0 20.0 /end CHARACTERISTIC
/begin CHARACTERISTIC KTQD_ACCOvrdCancelTqCtrl_flg "" VALUE 0x0000 /* @ECU_Address@KTQD_ACCOvrdCancelTqCtrl_flg@ */ Scalar_BOOLEAN 0 SWC_FDC_type_CM_boolean_flg 0.0 1.0 /end CHARACTERISTIC
/begin CHARACTERISTIC KTQD_APSCreepParOvrd_flg "" VALUE 0x0000 /* @ECU_Address@KTQD_APSCreepParOvrd_flg@ */ Scalar_BOOLEAN 0 SWC_FDC_type_CM_boolean_flg 0.0 1.0 /end CHARACTERISTIC
/begin CHARACTERISTIC KTQD_APSDecReqMaxSW_flg "" VALUE 0x0000 /* @ECU_Address@KTQD_APSDecReqMaxSW_flg@ */ Scalar_BOOLEAN 0 SWC_FDC_type_CM_boolean_flg 0.0 1.0 /end CHARACTERISTIC
/begin CHARACTERISTIC KTQD_APSReqDisCreep_flg "" VALUE 0x0000 /* @ECU_Address@KTQD_APSReqDisCreep_flg@ */ Scalar_BOOLEAN 0 SWC_FDC_type_CM_boolean_flg 0.0 1.0 /end CHARACTERISTIC
/begin CHARACTERISTIC KTQD_AWDFrRatio_rat_ovrdflg "" VALUE 0x0000 /* @ECU_Address@KTQD_AWDFrRatio_rat_ovrdflg@ */ Scalar_BOOLEAN 0 SWC_FDC_type_CM_boolean_flg 0.0 1.0 /end CHARACTERISTIC
/begin CHARACTERISTIC KTQD_AWDRrRatio_rat_ovrdflg "" VALUE 0x0000 /* @ECU_Address@KTQD_AWDRrRatio_rat_ovrdflg@ */ Scalar_BOOLEAN 0 SWC_FDC_type_CM_boolean_flg 0.0 1.0 /end CHARACTERISTIC
/begin CHARACTERISTIC KTQD_CreepSlopeLatchSW_flg "" VALUE 0x0000 /* @ECU_Address@KTQD_CreepSlopeLatchSW_flg@ */ Scalar_BOOLEAN 0 SWC_FDC_type_CM_boolean_flg 0.0 1.0 /end CHARACTERISTIC
/begin CHARACTERISTIC KTQD_CreepVehSpdSW_flg "" VALUE 0x0000 /* @ECU_Address@KTQD_CreepVehSpdSW_flg@ */ Scalar_BOOLEAN 0 SWC_FDC_type_CM_boolean_flg 0.0 1.0 /end CHARACTERISTIC
/begin CHARACTERISTIC KTQD_CreepWhlRatioSW_flg "" VALUE 0x0000 /* @ECU_Address@KTQD_CreepWhlRatioSW_flg@ */ Scalar_BOOLEAN 0 SWC_FDC_type_CM_boolean_flg 0.0 1.0 /end CHARACTERISTIC
/begin CHARACTERISTIC KTQD_DrvSelPwrTrainSW_flg "" VALUE 0x0000 /* @ECU_Address@KTQD_DrvSelPwrTrainSW_flg@ */ Scalar_BOOLEAN 0 SWC_FDC_type_CM_boolean_flg 0.0 1.0 /end CHARACTERISTIC
/begin CHARACTERISTIC KTQD_EVDriveModeValid_ovrdflg "" VALUE 0x0000 /* @ECU_Address@KTQD_EVDriveModeValid_ovrdflg@ */ Scalar_BOOLEAN 0 SWC_FDC_type_CM_boolean_flg 0.0 1.0 /end CHARACTERISTIC
/begin CHARACTERISTIC KTQD_EVDriveModeValid_ovrdval "" VALUE 0x0000 /* @ECU_Address@KTQD_EVDriveModeValid_ovrdval@ */ Scalar_BOOLEAN 0 SWC_FDC_type_CM_boolean_flg 0.0 1.0 /end CHARACTERISTIC
/begin CHARACTERISTIC KTQD_FailsafeActiveSW_flg "" VALUE 0x0000 /* @ECU_Address@KTQD_FailsafeActiveSW_flg@ */ Scalar_BOOLEAN 0 SWC_FDC_type_CM_boolean_flg 0.0 1.0 /end CHARACTERISTIC
/begin CHARACTERISTIC KTQD_FrTMMotOutpConSW_flg "" VALUE 0x0000 /* @ECU_Address@KTQD_FrTMMotOutpConSW_flg@ */ Scalar_BOOLEAN 0 SWC_FDC_type_CM_boolean_flg 0.0 1.0 /end CHARACTERISTIC
/begin CHARACTERISTIC KTQD_GRADE_Deg_ovrdflg "" VALUE 0x0000 /* @ECU_Address@KTQD_GRADE_Deg_ovrdflg@ */ Scalar_BOOLEAN 0 SWC_FDC_type_CM_boolean_flg 0.0 1.0 /end CHARACTERISTIC
/begin CHARACTERISTIC KTQD_IVISmartRegenSW_flg "" VALUE 0x0000 /* @ECU_Address@KTQD_IVISmartRegenSW_flg@ */ Scalar_BOOLEAN 0 SWC_FDC_type_CM_boolean_flg 0.0 1.0 /end CHARACTERISTIC
/begin CHARACTERISTIC KTQD_OPDHoldAllowPark_flg "" VALUE 0x0000 /* @ECU_Address@KTQD_OPDHoldAllowPark_flg@ */ Scalar_BOOLEAN 0 SWC_FDC_type_CM_boolean_flg 0.0 1.0 /end CHARACTERISTIC
/begin CHARACTERISTIC KTQD_OPDHoldBrkSW_flg "" VALUE 0x0000 /* @ECU_Address@KTQD_OPDHoldBrkSW_flg@ */ Scalar_BOOLEAN 0 SWC_FDC_type_CM_boolean_flg 0.0 1.0 /end CHARACTERISTIC
/begin CHARACTERISTIC KTQD_OrigPedTqLowLimSW_flg "" VALUE 0x0000 /* @ECU_Address@KTQD_OrigPedTqLowLimSW_flg@ */ Scalar_BOOLEAN 0 SWC_FDC_type_CM_boolean_flg 0.0 1.0 /end CHARACTERISTIC
/begin CHARACTERISTIC KTQD_RrTMRgnOutpConSW_flg "" VALUE 0x0000 /* @ECU_Address@KTQD_RrTMRgnOutpConSW_flg@ */ Scalar_BOOLEAN 0 SWC_FDC_type_CM_boolean_flg 0.0 1.0 /end CHARACTERISTIC
/begin CHARACTERISTIC KTQD_TCSCreepDisSpdSW_flg "" VALUE 0x0000 /* @ECU_Address@KTQD_TCSCreepDisSpdSW_flg@ */ Scalar_BOOLEAN 0 SWC_FDC_type_CM_boolean_flg 0.0 1.0 /end CHARACTERISTIC
/begin CHARACTERISTIC KTQD_TCSCreepSW_flg "" VALUE 0x0000 /* @ECU_Address@KTQD_TCSCreepSW_flg@ */ Scalar_BOOLEAN 0 SWC_FDC_type_CM_boolean_flg 0.0 1.0 /end CHARACTERISTIC
/begin CHARACTERISTIC KTQD_TMPwrAvailDchrg_kW_ovrdflg "" VALUE 0x0000 /* @ECU_Address@KTQD_TMPwrAvailDchrg_kW_ovrdflg@ */ Scalar_BOOLEAN 0 SWC_FDC_type_CM_boolean_flg 0.0 1.0 /end CHARACTERISTIC
/begin CHARACTERISTIC KTQR_ACCHoldPdovrdSW_flg "" VALUE 0x0000 /* @ECU_Address@KTQR_ACCHoldPdovrdSW_flg@ */ Scalar_BOOLEAN 0 SWC_FDC_type_CM_boolean_flg 0.0 1.0 /end CHARACTERISTIC
/begin CHARACTERISTIC KTQR_CreepZeroTransSW_flg "" VALUE 0x0000 /* @ECU_Address@KTQR_CreepZeroTransSW_flg@ */ Scalar_BOOLEAN 0 SWC_FDC_type_CM_boolean_flg 0.0 1.0 /end CHARACTERISTIC
/begin CHARACTERISTIC KTQR_FEDUTrqUpLimSW_flg "" VALUE 0x0000 /* @ECU_Address@KTQR_FEDUTrqUpLimSW_flg@ */ Scalar_BOOLEAN 0 SWC_FDC_type_CM_boolean_flg 0.0 1.0 /end CHARACTERISTIC
/begin CHARACTERISTIC KTQR_REDUTrqUpLimSW_flg "" VALUE 0x0000 /* @ECU_Address@KTQR_REDUTrqUpLimSW_flg@ */ Scalar_BOOLEAN 0 SWC_FDC_type_CM_boolean_flg 0.0 1.0 /end CHARACTERISTIC
/begin CHARACTERISTIC KTQR_RegenTqLimitDecSW_flg "" VALUE 0x0000 /* @ECU_Address@KTQR_RegenTqLimitDecSW_flg@ */ Scalar_BOOLEAN 0 SWC_FDC_type_CM_boolean_flg 0.0 1.0 /end CHARACTERISTIC
/begin CHARACTERISTIC KTQR_RgnShaftSpdProtSW_flg "" VALUE 0x0000 /* @ECU_Address@KTQR_RgnShaftSpdProtSW_flg@ */ Scalar_BOOLEAN 0 SWC_FDC_type_CM_boolean_flg 0.0 1.0 /end CHARACTERISTIC
/begin CHARACTERISTIC KVMC_APSDevelopeSW_flg "" VALUE 0x0000 /* @ECU_Address@KVMC_APSDevelopeSW_flg@ */ Scalar_BOOLEAN 0 SWC_FDC_type_CM_boolean_flg 0.0 1.0 /end CHARACTERISTIC
/begin CHARACTERISTIC KVMC_APSStaSystemOvrd_flg "" VALUE 0x0000 /* @ECU_Address@KVMC_APSStaSystemOvrd_flg@ */ Scalar_BOOLEAN 0 SWC_FDC_type_CM_boolean_flg 0.0 1.0 /end CHARACTERISTIC
/begin CHARACTERISTIC KVMC_SafetyCtrlForACCSW_flg "" VALUE 0x0000 /* @ECU_Address@KVMC_SafetyCtrlForACCSW_flg@ */ Scalar_BOOLEAN 0 SWC_FDC_type_CM_boolean_flg 0.0 1.0 /end CHARACTERISTIC
/begin CHARACTERISTIC KTQD_AWDTqRatioSW_enum "" VALUE 0x0000 /* @ECU_Address@KTQD_AWDTqRatioSW_enum@ */ Scalar_UBYTE 0 SWC_FDC_type_CM_uint8_enum 0.0 15.0 /end CHARACTERISTIC
/begin CHARACTERISTIC KTQD_DriverSelPowerTrain_enum "" VALUE 0x0000 /* @ECU_Address@KTQD_DriverSelPowerTrain_enum@ */ Scalar_UBYTE 0 SWC_FDC_type_CM_uint8_enum 0.0 3.0 /end CHARACTERISTIC
/begin CHARACTERISTIC KTQD_RockModeWhlSkipSta_enum "" VALUE 0x0000 /* @ECU_Address@KTQD_RockModeWhlSkipSta_enum@ */ Scalar_UBYTE 0 SWC_FDC_type_CM_uint8_enum 0.0 15.0 /end CHARACTERISTIC
/begin MEASUREMENT VVMC_HoldTqGxRat_raw32 "" FLOAT32_IEEE SWC_FDC_type_CM_single_raw32 0 0 -100000.0 100000.0 ECU_ADDRESS 0x0000 /* @ECU_Address@VVMC_HoldTqGxRat_raw32@ */ /end MEASUREMENT
/begin MEASUREMENT VVMC_APSDecReq_mps2 "" FLOAT32_IEEE SWC_FDC_type_CM_single_mps2 0 0 0.0 25.4 ECU_ADDRESS 0x0000 /* @ECU_Address@VVMC_APSDecReq_mps2@ */ /end MEASUREMENT
/begin MEASUREMENT VVMC_VehHoldEnSpd_kph "" FLOAT32_IEEE SWC_FDC_type_CM_single_kph 0 0 0.0 255.0 ECU_ADDRESS 0x0000 /* @ECU_Address@VVMC_VehHoldEnSpd_kph@ */ /end MEASUREMENT
/begin MEASUREMENT VVMC_VehHoldEnActAccel_mps2 "" FLOAT32_IEEE SWC_FDC_type_CM_single_mps2 0 0 -15.0 10.55 ECU_ADDRESS 0x0000 /* @ECU_Address@VVMC_VehHoldEnActAccel_mps2@ */ /end MEASUREMENT
/begin MEASUREMENT VVMC_ACCReqSpdMemory_kph "" FLOAT32_IEEE SWC_FDC_type_CM_single_kph 0 0 0.0 300.0 ECU_ADDRESS 0x0000 /* @ECU_Address@VVMC_ACCReqSpdMemory_kph@ */ /end MEASUREMENT
/begin MEASUREMENT VVMC_ReqBrkInDecFixSR_mps3 "" FLOAT32_IEEE SWC_FDC_type_CM_single_mps3 0 0 -20.0 20.0 ECU_ADDRESS 0x0000 /* @ECU_Address@VVMC_ReqBrkInDecFixSR_mps3@ */ /end MEASUREMENT
/begin MEASUREMENT VVMC_MSAOvrdEnTq_Nm "" FLOAT32_IEEE SWC_FDC_type_CM_single_Nm 0 0 -100000.0 100000.0 ECU_ADDRESS 0x0000 /* @ECU_Address@VVMC_MSAOvrdEnTq_Nm@ */ /end MEASUREMENT
/begin MEASUREMENT VVMC_MSATqDownEnTq_Nm "" FLOAT32_IEEE SWC_FDC_type_CM_single_Nm 0 0 -10000.0 10000.0 ECU_ADDRESS 0x0000 /* @ECU_Address@VVMC_MSATqDownEnTq_Nm@ */ /end MEASUREMENT
/begin MEASUREMENT VVMC_CalibratedAccX_G "" FLOAT32_IEEE SWC_FDC_type_CM_single_G 0 0 -65.536 65.536 ECU_ADDRESS 0x0000 /* @ECU_Address@VVMC_CalibratedAccX_G@ */ /end MEASUREMENT
/begin MEASUREMENT VVMC_CalibratedGyroY_Dps "" FLOAT32_IEEE SWC_FDC_type_CM_single_Dps 0 0 -1966.0 1966.0 ECU_ADDRESS 0x0000 /* @ECU_Address@VVMC_CalibratedGyroY_Dps@ */ /end MEASUREMENT
/begin MEASUREMENT VVMC_CalibratedAccY_G "" FLOAT32_IEEE SWC_FDC_type_CM_single_G 0 0 -65.536 65.536 ECU_ADDRESS 0x0000 /* @ECU_Address@VVMC_CalibratedAccY_G@ */ /end MEASUREMENT
/begin MEASUREMENT VVMC_CalibratedAccZ_G "" FLOAT32_IEEE SWC_FDC_type_CM_single_G 0 0 -65.536 65.536 ECU_ADDRESS 0x0000 /* @ECU_Address@VVMC_CalibratedAccZ_G@ */ /end MEASUREMENT
/begin MEASUREMENT VVMC_CalibratedGyroZ_Dps "" FLOAT32_IEEE SWC_FDC_type_CM_single_Dps 0 0 -1966.0 1966.0 ECU_ADDRESS 0x0000 /* @ECU_Address@VVMC_CalibratedGyroZ_Dps@ */ /end MEASUREMENT
/begin MEASUREMENT VVMC_CalibratedGyroX_Dps "" FLOAT32_IEEE SWC_FDC_type_CM_single_Dps 0 0 -1966.0 1966.0 ECU_ADDRESS 0x0000 /* @ECU_Address@VVMC_CalibratedGyroX_Dps@ */ /end MEASUREMENT
/begin MEASUREMENT VVMC_HoldTqCalSpd2Tq_Nm "" FLOAT32_IEEE SWC_FDC_type_CM_single_Nm 0 0 -6000.0 6000.0 ECU_ADDRESS 0x0000 /* @ECU_Address@VVMC_HoldTqCalSpd2Tq_Nm@ */ /end MEASUREMENT
/begin MEASUREMENT VVMC_HoldTqCalSpd2Gx_Gps "" FLOAT32_IEEE SWC_FDC_type_CM_single_Gps 0 0 -2.0 2.0 ECU_ADDRESS 0x0000 /* @ECU_Address@VVMC_HoldTqCalSpd2Gx_Gps@ */ /end MEASUREMENT
/begin MEASUREMENT VVMC_HoldTqCalSpd1Tq_Nm "" FLOAT32_IEEE SWC_FDC_type_CM_single_Nm 0 0 -6000.0 6000.0 ECU_ADDRESS 0x0000 /* @ECU_Address@VVMC_HoldTqCalSpd1Tq_Nm@ */ /end MEASUREMENT
/begin MEASUREMENT VVMC_HoldTqCalSpd1Gx_Gps "" FLOAT32_IEEE SWC_FDC_type_CM_single_Gps 0 0 -2.0 2.0 ECU_ADDRESS 0x0000 /* @ECU_Address@VVMC_HoldTqCalSpd1Gx_Gps@ */ /end MEASUREMENT
/begin MEASUREMENT VVMC_ZeroRgnTqSpdCtrlTq_Nm "" FLOAT32_IEEE SWC_FDC_type_CM_single_Nm 0 0 -10000.0 10000.0 ECU_ADDRESS 0x0000 /* @ECU_Address@VVMC_ZeroRgnTqSpdCtrlTq_Nm@ */ /end MEASUREMENT
/begin MEASUREMENT VVMC_ACCLowSpdTqLimit_Nm "" FLOAT32_IEEE SWC_FDC_type_CM_single_Nm 0 0 -100000.0 100000.0 ECU_ADDRESS 0x0000 /* @ECU_Address@VVMC_ACCLowSpdTqLimit_Nm@ */ /end MEASUREMENT
/begin MEASUREMENT VVMC_ACCLowSpdCtrlEnSpd_kph "" FLOAT32_IEEE SWC_FDC_type_CM_single_kph 0 0 0.0 255.0 ECU_ADDRESS 0x0000 /* @ECU_Address@VVMC_ACCLowSpdCtrlEnSpd_kph@ */ /end MEASUREMENT
/begin MEASUREMENT VVMC_ZeroSpdEnTMSpd_rpm "" FLOAT32_IEEE SWC_FDC_type_CM_single_rpm 0 0 -3000.0 3000.0 ECU_ADDRESS 0x0000 /* @ECU_Address@VVMC_ZeroSpdEnTMSpd_rpm@ */ /end MEASUREMENT
/begin MEASUREMENT VVMC_ACCOvrdMemTq_Nm "" FLOAT32_IEEE SWC_FDC_type_CM_single_Nm 0 0 0.0 10000.0 ECU_ADDRESS 0x0000 /* @ECU_Address@VVMC_ACCOvrdMemTq_Nm@ */ /end MEASUREMENT
/begin MEASUREMENT VVMC_ESCLongAccelFilt_Gps "" FLOAT32_IEEE SWC_FDC_type_CM_single_Gps 0 0 -2.0 2.0 ECU_ADDRESS 0x0000 /* @ECU_Address@VVMC_ESCLongAccelFilt_Gps@ */ /end MEASUREMENT
/begin MEASUREMENT VTQR_CalFEDUTrqUpLim_Nm "" FLOAT32_IEEE SWC_FDC_type_CM_single_Nm 0 0 -100000.0 100000.0 ECU_ADDRESS 0x0000 /* @ECU_Address@VTQR_CalFEDUTrqUpLim_Nm@ */ /end MEASUREMENT
/begin MEASUREMENT VTQR_CoorFEDUTrqUpLim_Nm "" FLOAT32_IEEE SWC_FDC_type_CM_single_Nm 0 0 -100000.0 100000.0 ECU_ADDRESS 0x0000 /* @ECU_Address@VTQR_CoorFEDUTrqUpLim_Nm@ */ /end MEASUREMENT
/begin MEASUREMENT VTQR_LFWheelShaftSpd_rpm "" FLOAT32_IEEE SWC_FDC_type_CM_single_rpm 0 0 0.0 100000.0 ECU_ADDRESS 0x0000 /* @ECU_Address@VTQR_LFWheelShaftSpd_rpm@ */ /end MEASUREMENT
/begin MEASUREMENT VTQR_RFWheelShaftSpd_rpm "" FLOAT32_IEEE SWC_FDC_type_CM_single_rpm 0 0 0.0 100000.0 ECU_ADDRESS 0x0000 /* @ECU_Address@VTQR_RFWheelShaftSpd_rpm@ */ /end MEASUREMENT
/begin MEASUREMENT VTQR_FWheelShaftSpdDev_rpm "" FLOAT32_IEEE SWC_FDC_type_CM_single_rpm 0 0 -100000.0 100000.0 ECU_ADDRESS 0x0000 /* @ECU_Address@VTQR_FWheelShaftSpdDev_rpm@ */ /end MEASUREMENT
/begin MEASUREMENT VTQR_ActFShaftSpdDev_rpm "" FLOAT32_IEEE SWC_FDC_type_CM_single_rpm 0 0 0.0 100000.0 ECU_ADDRESS 0x0000 /* @ECU_Address@VTQR_ActFShaftSpdDev_rpm@ */ /end MEASUREMENT
/begin MEASUREMENT VTQR_InitFShaftSpdTqLimCoe_c "" FLOAT32_IEEE SWC_FDC_type_CM_single_c 0 0 -0.1 1.0 ECU_ADDRESS 0x0000 /* @ECU_Address@VTQR_InitFShaftSpdTqLimCoe_c@ */ /end MEASUREMENT
/begin MEASUREMENT VTQR_FShaftSpdTqLimCoe_c "" FLOAT32_IEEE SWC_FDC_type_CM_single_c 0 0 0.0 1.0 ECU_ADDRESS 0x0000 /* @ECU_Address@VTQR_FShaftSpdTqLimCoe_c@ */ /end MEASUREMENT
/begin MEASUREMENT VTQR_InitFTimerTqLimCoe_c "" FLOAT32_IEEE SWC_FDC_type_CM_single_c 0 0 -0.1 1.0 ECU_ADDRESS 0x0000 /* @ECU_Address@VTQR_InitFTimerTqLimCoe_c@ */ /end MEASUREMENT
/begin MEASUREMENT VTQR_FTimerTqLimCoe_c "" FLOAT32_IEEE SWC_FDC_type_CM_single_c 0 0 0.0 1.0 ECU_ADDRESS 0x0000 /* @ECU_Address@VTQR_FTimerTqLimCoe_c@ */ /end MEASUREMENT
/begin MEASUREMENT VTQR_ActFEDUTrqUpLim_Nm "" FLOAT32_IEEE SWC_FDC_type_CM_single_Nm 0 0 -100000.0 100000.0 ECU_ADDRESS 0x0000 /* @ECU_Address@VTQR_ActFEDUTrqUpLim_Nm@ */ /end MEASUREMENT
/begin MEASUREMENT VTQR_ActFEDUTrqLowLim_Nm "" FLOAT32_IEEE SWC_FDC_type_CM_single_Nm 0 0 -100000.0 100000.0 ECU_ADDRESS 0x0000 /* @ECU_Address@VTQR_ActFEDUTrqLowLim_Nm@ */ /end MEASUREMENT
/begin MEASUREMENT VTQR_RampFEDUWhlTqReq_Nm "" FLOAT32_IEEE SWC_FDC_type_CM_single_Nm 0 0 -100000.0 100000.0 ECU_ADDRESS 0x0000 /* @ECU_Address@VTQR_RampFEDUWhlTqReq_Nm@ */ /end MEASUREMENT
/begin MEASUREMENT VTQR_CalREDUTrqUpLim_Nm "" FLOAT32_IEEE SWC_FDC_type_CM_single_Nm 0 0 -100000.0 100000.0 ECU_ADDRESS 0x0000 /* @ECU_Address@VTQR_CalREDUTrqUpLim_Nm@ */ /end MEASUREMENT
/begin MEASUREMENT VTQR_CoorREDUTrqUpLim_Nm "" FLOAT32_IEEE SWC_FDC_type_CM_single_Nm 0 0 -100000.0 100000.0 ECU_ADDRESS 0x0000 /* @ECU_Address@VTQR_CoorREDUTrqUpLim_Nm@ */ /end MEASUREMENT
/begin MEASUREMENT VTQR_LRWheelShaftSpd_rpm "" FLOAT32_IEEE SWC_FDC_type_CM_single_rpm 0 0 0.0 100000.0 ECU_ADDRESS 0x0000 /* @ECU_Address@VTQR_LRWheelShaftSpd_rpm@ */ /end MEASUREMENT
/begin MEASUREMENT VTQR_RRWheelShaftSpd_rpm "" FLOAT32_IEEE SWC_FDC_type_CM_single_rpm 0 0 0.0 100000.0 ECU_ADDRESS 0x0000 /* @ECU_Address@VTQR_RRWheelShaftSpd_rpm@ */ /end MEASUREMENT
/begin MEASUREMENT VTQR_RWheelShaftSpdDev_rpm "" FLOAT32_IEEE SWC_FDC_type_CM_single_rpm 0 0 -100000.0 100000.0 ECU_ADDRESS 0x0000 /* @ECU_Address@VTQR_RWheelShaftSpdDev_rpm@ */ /end MEASUREMENT
/begin MEASUREMENT VTQR_ActRShaftSpdDev_rpm "" FLOAT32_IEEE SWC_FDC_type_CM_single_rpm 0 0 0.0 100000.0 ECU_ADDRESS 0x0000 /* @ECU_Address@VTQR_ActRShaftSpdDev_rpm@ */ /end MEASUREMENT
/begin MEASUREMENT VTQR_InitRShaftSpdTqLimCoe_c "" FLOAT32_IEEE SWC_FDC_type_CM_single_c 0 0 -0.1 1.0 ECU_ADDRESS 0x0000 /* @ECU_Address@VTQR_InitRShaftSpdTqLimCoe_c@ */ /end MEASUREMENT
/begin MEASUREMENT VTQR_RShaftSpdTqLimCoe_c "" FLOAT32_IEEE SWC_FDC_type_CM_single_c 0 0 0.0 1.0 ECU_ADDRESS 0x0000 /* @ECU_Address@VTQR_RShaftSpdTqLimCoe_c@ */ /end MEASUREMENT
/begin MEASUREMENT VTQR_InitRTimerTqLimCoe_c "" FLOAT32_IEEE SWC_FDC_type_CM_single_c 0 0 -0.1 1.0 ECU_ADDRESS 0x0000 /* @ECU_Address@VTQR_InitRTimerTqLimCoe_c@ */ /end MEASUREMENT
/begin MEASUREMENT VTQR_RTimerTqLimCoe_c "" FLOAT32_IEEE SWC_FDC_type_CM_single_c 0 0 0.0 1.0 ECU_ADDRESS 0x0000 /* @ECU_Address@VTQR_RTimerTqLimCoe_c@ */ /end MEASUREMENT
/begin MEASUREMENT VTQR_ActREDUTrqUpLim_Nm "" FLOAT32_IEEE SWC_FDC_type_CM_single_Nm 0 0 -100000.0 100000.0 ECU_ADDRESS 0x0000 /* @ECU_Address@VTQR_ActREDUTrqUpLim_Nm@ */ /end MEASUREMENT
/begin MEASUREMENT VTQR_ActREDUTrqLowLim_Nm "" FLOAT32_IEEE SWC_FDC_type_CM_single_Nm 0 0 -100000.0 100000.0 ECU_ADDRESS 0x0000 /* @ECU_Address@VTQR_ActREDUTrqLowLim_Nm@ */ /end MEASUREMENT
/begin MEASUREMENT VTQR_RampREDUWhlTqReq_Nm "" FLOAT32_IEEE SWC_FDC_type_CM_single_Nm 0 0 -100000.0 100000.0 ECU_ADDRESS 0x0000 /* @ECU_Address@VTQR_RampREDUWhlTqReq_Nm@ */ /end MEASUREMENT
/begin MEASUREMENT VTQR_RDCActiveFEDUTs_c "" FLOAT32_IEEE SWC_FDC_type_CM_single_c 0 0 0.0 1.0 ECU_ADDRESS 0x0000 /* @ECU_Address@VTQR_RDCActiveFEDUTs_c@ */ /end MEASUREMENT
/begin MEASUREMENT VTQR_CreepFEDUTs_c "" FLOAT32_IEEE SWC_FDC_type_CM_single_c 0 0 0.0 1.0 ECU_ADDRESS 0x0000 /* @ECU_Address@VTQR_CreepFEDUTs_c@ */ /end MEASUREMENT
/begin MEASUREMENT VTQR_VMCFEDUTs_c "" FLOAT32_IEEE SWC_FDC_type_CM_single_c 0 0 0.0 1.0 ECU_ADDRESS 0x0000 /* @ECU_Address@VTQR_VMCFEDUTs_c@ */ /end MEASUREMENT
/begin MEASUREMENT VTQR_FEDUTIPOutTs_c "" FLOAT32_IEEE SWC_FDC_type_CM_single_c 0 0 0.0 1.0 ECU_ADDRESS 0x0000 /* @ECU_Address@VTQR_FEDUTIPOutTs_c@ */ /end MEASUREMENT
/begin MEASUREMENT VTQR_FrActRampTqDem_Nm "" FLOAT32_IEEE SWC_FDC_type_CM_single_Nm 0 0 -100000.0 100000.0 ECU_ADDRESS 0x0000 /* @ECU_Address@VTQR_FrActRampTqDem_Nm@ */ /end MEASUREMENT
/begin MEASUREMENT VTQR_FrTqZeroTransUpBound_Nm "" FLOAT32_IEEE SWC_FDC_type_CM_single_Nm 0 0 -100000.0 100000.0 ECU_ADDRESS 0x0000 /* @ECU_Address@VTQR_FrTqZeroTransUpBound_Nm@ */ /end MEASUREMENT
/begin MEASUREMENT VTQR_FrTqZeroTransLowBound_Nm "" FLOAT32_IEEE SWC_FDC_type_CM_single_Nm 0 0 -100000.0 100000.0 ECU_ADDRESS 0x0000 /* @ECU_Address@VTQR_FrTqZeroTransLowBound_Nm@ */ /end MEASUREMENT
/begin MEASUREMENT VTQR_FrFirstOrderInpTq_Nm "" FLOAT32_IEEE SWC_FDC_type_CM_single_Nm 0 0 -100000.0 100000.0 ECU_ADDRESS 0x0000 /* @ECU_Address@VTQR_FrFirstOrderInpTq_Nm@ */ /end MEASUREMENT
/begin MEASUREMENT VTQR_FEDUTs_c "" FLOAT32_IEEE SWC_FDC_type_CM_single_c 0 0 0.0 1.0 ECU_ADDRESS 0x0000 /* @ECU_Address@VTQR_FEDUTs_c@ */ /end MEASUREMENT
/begin MEASUREMENT VTQR_FrFirstOrderInpTs_c "" FLOAT32_IEEE SWC_FDC_type_CM_single_c 0 0 0.0 1.0 ECU_ADDRESS 0x0000 /* @ECU_Address@VTQR_FrFirstOrderInpTs_c@ */ /end MEASUREMENT
/begin MEASUREMENT VTQR_RDCActiveREDUTs_c "" FLOAT32_IEEE SWC_FDC_type_CM_single_c 0 0 0.0 1.0 ECU_ADDRESS 0x0000 /* @ECU_Address@VTQR_RDCActiveREDUTs_c@ */ /end MEASUREMENT
/begin MEASUREMENT VTQR_CreepREDUTs_c "" FLOAT32_IEEE SWC_FDC_type_CM_single_c 0 0 0.0 1.0 ECU_ADDRESS 0x0000 /* @ECU_Address@VTQR_CreepREDUTs_c@ */ /end MEASUREMENT
/begin MEASUREMENT VTQR_VMCREDUTs_c "" FLOAT32_IEEE SWC_FDC_type_CM_single_c 0 0 0.0 1.0 ECU_ADDRESS 0x0000 /* @ECU_Address@VTQR_VMCREDUTs_c@ */ /end MEASUREMENT
/begin MEASUREMENT VTQR_REDUTIPOutTs_c "" FLOAT32_IEEE SWC_FDC_type_CM_single_c 0 0 0.0 1.0 ECU_ADDRESS 0x0000 /* @ECU_Address@VTQR_REDUTIPOutTs_c@ */ /end MEASUREMENT
/begin MEASUREMENT VTQR_RrActRampTqDem_Nm "" FLOAT32_IEEE SWC_FDC_type_CM_single_Nm 0 0 -100000.0 100000.0 ECU_ADDRESS 0x0000 /* @ECU_Address@VTQR_RrActRampTqDem_Nm@ */ /end MEASUREMENT
/begin MEASUREMENT VTQR_RrTqZeroTransUpBound_Nm "" FLOAT32_IEEE SWC_FDC_type_CM_single_Nm 0 0 -100000.0 100000.0 ECU_ADDRESS 0x0000 /* @ECU_Address@VTQR_RrTqZeroTransUpBound_Nm@ */ /end MEASUREMENT
/begin MEASUREMENT VTQR_RrTqZeroTransLowBound_Nm "" FLOAT32_IEEE SWC_FDC_type_CM_single_Nm 0 0 -100000.0 100000.0 ECU_ADDRESS 0x0000 /* @ECU_Address@VTQR_RrTqZeroTransLowBound_Nm@ */ /end MEASUREMENT
/begin MEASUREMENT VTQR_RrFirstOrderInpTq_Nm "" FLOAT32_IEEE SWC_FDC_type_CM_single_Nm 0 0 -100000.0 100000.0 ECU_ADDRESS 0x0000 /* @ECU_Address@VTQR_RrFirstOrderInpTq_Nm@ */ /end MEASUREMENT
/begin MEASUREMENT VTQR_REDUTs_c "" FLOAT32_IEEE SWC_FDC_type_CM_single_c 0 0 0.0 1.0 ECU_ADDRESS 0x0000 /* @ECU_Address@VTQR_REDUTs_c@ */ /end MEASUREMENT
/begin MEASUREMENT VTQR_RrFirstOrderInpTs_c "" FLOAT32_IEEE SWC_FDC_type_CM_single_c 0 0 0.0 1.0 ECU_ADDRESS 0x0000 /* @ECU_Address@VTQR_RrFirstOrderInpTs_c@ */ /end MEASUREMENT
/begin MEASUREMENT VTQR_VMCFEDUTqDecSR_Nm "" FLOAT32_IEEE SWC_FDC_type_CM_single_Nm 0 0 -100000.0 100000.0 ECU_ADDRESS 0x0000 /* @ECU_Address@VTQR_VMCFEDUTqDecSR_Nm@ */ /end MEASUREMENT
/begin MEASUREMENT VTQR_CreepFEDUTqIncSR_Nm "" FLOAT32_IEEE SWC_FDC_type_CM_single_Nm 0 0 -100000.0 100000.0 ECU_ADDRESS 0x0000 /* @ECU_Address@VTQR_CreepFEDUTqIncSR_Nm@ */ /end MEASUREMENT
/begin MEASUREMENT VTQR_CreepFEDUTqDecSR_Nm "" FLOAT32_IEEE SWC_FDC_type_CM_single_Nm 0 0 -100000.0 100000.0 ECU_ADDRESS 0x0000 /* @ECU_Address@VTQR_CreepFEDUTqDecSR_Nm@ */ /end MEASUREMENT
/begin MEASUREMENT VTQR_FrPreLoadTqIncSR_Nm "" FLOAT32_IEEE SWC_FDC_type_CM_single_Nm 0 0 0.0 100000.0 ECU_ADDRESS 0x0000 /* @ECU_Address@VTQR_FrPreLoadTqIncSR_Nm@ */ /end MEASUREMENT
/begin MEASUREMENT VTQR_FrPreLoadTqDecSR_Nm "" FLOAT32_IEEE SWC_FDC_type_CM_single_Nm 0 0 -100000.0 0.0 ECU_ADDRESS 0x0000 /* @ECU_Address@VTQR_FrPreLoadTqDecSR_Nm@ */ /end MEASUREMENT
/begin MEASUREMENT VTQR_VMCFEDUTqIncSR_Nm "" FLOAT32_IEEE SWC_FDC_type_CM_single_Nm 0 0 -100000.0 100000.0 ECU_ADDRESS 0x0000 /* @ECU_Address@VTQR_VMCFEDUTqIncSR_Nm@ */ /end MEASUREMENT
/begin MEASUREMENT VTQR_FEDURateLimitInc_Nm "" FLOAT32_IEEE SWC_FDC_type_CM_single_Nm 0 0 -100000.0 100000.0 ECU_ADDRESS 0x0000 /* @ECU_Address@VTQR_FEDURateLimitInc_Nm@ */ /end MEASUREMENT
/begin MEASUREMENT VTQR_FEDURateLimitDec_Nm "" FLOAT32_IEEE SWC_FDC_type_CM_single_Nm 0 0 -100000.0 100000.0 ECU_ADDRESS 0x0000 /* @ECU_Address@VTQR_FEDURateLimitDec_Nm@ */ /end MEASUREMENT
/begin MEASUREMENT VTQR_RDCActiveFEDUInc_Nm "" FLOAT32_IEEE SWC_FDC_type_CM_single_Nm 0 0 0.0 100000.0 ECU_ADDRESS 0x0000 /* @ECU_Address@VTQR_RDCActiveFEDUInc_Nm@ */ /end MEASUREMENT
/begin MEASUREMENT VTQR_FrRateLimitInc_Nm "" FLOAT32_IEEE SWC_FDC_type_CM_single_Nm 0 0 -100000.0 100000.0 ECU_ADDRESS 0x0000 /* @ECU_Address@VTQR_FrRateLimitInc_Nm@ */ /end MEASUREMENT
/begin MEASUREMENT VTQR_FrRateLimitDec_Nm "" FLOAT32_IEEE SWC_FDC_type_CM_single_Nm 0 0 -100000.0 100000.0 ECU_ADDRESS 0x0000 /* @ECU_Address@VTQR_FrRateLimitDec_Nm@ */ /end MEASUREMENT
/begin MEASUREMENT VTQR_VMCREDUTqDecSR_Nm "" FLOAT32_IEEE SWC_FDC_type_CM_single_Nm 0 0 -100000.0 100000.0 ECU_ADDRESS 0x0000 /* @ECU_Address@VTQR_VMCREDUTqDecSR_Nm@ */ /end MEASUREMENT
/begin MEASUREMENT VTQR_CreepREDUTqIncSR_Nm "" FLOAT32_IEEE SWC_FDC_type_CM_single_Nm 0 0 -100000.0 100000.0 ECU_ADDRESS 0x0000 /* @ECU_Address@VTQR_CreepREDUTqIncSR_Nm@ */ /end MEASUREMENT
/begin MEASUREMENT VTQR_CreepREDUTqDecSR_Nm "" FLOAT32_IEEE SWC_FDC_type_CM_single_Nm 0 0 -100000.0 100000.0 ECU_ADDRESS 0x0000 /* @ECU_Address@VTQR_CreepREDUTqDecSR_Nm@ */ /end MEASUREMENT
/begin MEASUREMENT VTQR_RrPreLoadTqIncSR_Nm "" FLOAT32_IEEE SWC_FDC_type_CM_single_Nm 0 0 0.0 100000.0 ECU_ADDRESS 0x0000 /* @ECU_Address@VTQR_RrPreLoadTqIncSR_Nm@ */ /end MEASUREMENT
/begin MEASUREMENT VTQR_RrPreLoadTqDecSR_Nm "" FLOAT32_IEEE SWC_FDC_type_CM_single_Nm 0 0 -100000.0 0.0 ECU_ADDRESS 0x0000 /* @ECU_Address@VTQR_RrPreLoadTqDecSR_Nm@ */ /end MEASUREMENT
/begin MEASUREMENT VTQR_VMCREDUTqIncSR_Nm "" FLOAT32_IEEE SWC_FDC_type_CM_single_Nm 0 0 -100000.0 100000.0 ECU_ADDRESS 0x0000 /* @ECU_Address@VTQR_VMCREDUTqIncSR_Nm@ */ /end MEASUREMENT
/begin MEASUREMENT VTQR_OriREDURateLimitInc_Nm "" FLOAT32_IEEE SWC_FDC_type_CM_single_Nm 0 0 -100000.0 100000.0 ECU_ADDRESS 0x0000 /* @ECU_Address@VTQR_OriREDURateLimitInc_Nm@ */ /end MEASUREMENT
/begin MEASUREMENT VTQR_REDURateLimitInc_Nm "" FLOAT32_IEEE SWC_FDC_type_CM_single_Nm 0 0 -100000.0 100000.0 ECU_ADDRESS 0x0000 /* @ECU_Address@VTQR_REDURateLimitInc_Nm@ */ /end MEASUREMENT
/begin MEASUREMENT VTQR_REDURateLimitDec_Nm "" FLOAT32_IEEE SWC_FDC_type_CM_single_Nm 0 0 -100000.0 100000.0 ECU_ADDRESS 0x0000 /* @ECU_Address@VTQR_REDURateLimitDec_Nm@ */ /end MEASUREMENT
/begin MEASUREMENT VTQR_RDCActiveREDUInc_Nm "" FLOAT32_IEEE SWC_FDC_type_CM_single_Nm 0 0 0.0 100000.0 ECU_ADDRESS 0x0000 /* @ECU_Address@VTQR_RDCActiveREDUInc_Nm@ */ /end MEASUREMENT
/begin MEASUREMENT VTQR_RrRateLimitInc_Nm "" FLOAT32_IEEE SWC_FDC_type_CM_single_Nm 0 0 -100000.0 100000.0 ECU_ADDRESS 0x0000 /* @ECU_Address@VTQR_RrRateLimitInc_Nm@ */ /end MEASUREMENT
/begin MEASUREMENT VTQR_RrRateLimitDec_Nm "" FLOAT32_IEEE SWC_FDC_type_CM_single_Nm 0 0 -100000.0 100000.0 ECU_ADDRESS 0x0000 /* @ECU_Address@VTQR_RrRateLimitDec_Nm@ */ /end MEASUREMENT
/begin MEASUREMENT VTQR_FrFirstOrderOutTq_Nm "" FLOAT32_IEEE SWC_FDC_type_CM_single_Nm 0 0 -100000.0 100000.0 ECU_ADDRESS 0x0000 /* @ECU_Address@VTQR_FrFirstOrderOutTq_Nm@ */ /end MEASUREMENT
/begin MEASUREMENT VTQR_RrFirstOrderOutTq_Nm "" FLOAT32_IEEE SWC_FDC_type_CM_single_Nm 0 0 -100000.0 100000.0 ECU_ADDRESS 0x0000 /* @ECU_Address@VTQR_RrFirstOrderOutTq_Nm@ */ /end MEASUREMENT
/begin MEASUREMENT VTQR_FEDUWhlTqReqSmooth_Nm "" FLOAT32_IEEE SWC_FDC_type_CM_single_Nm 0 0 -100000.0 100000.0 ECU_ADDRESS 0x0000 /* @ECU_Address@VTQR_FEDUWhlTqReqSmooth_Nm@ */ /end MEASUREMENT
/begin MEASUREMENT VTQR_REDUWhlTqReqSmooth_Nm "" FLOAT32_IEEE SWC_FDC_type_CM_single_Nm 0 0 -100000.0 100000.0 ECU_ADDRESS 0x0000 /* @ECU_Address@VTQR_REDUWhlTqReqSmooth_Nm@ */ /end MEASUREMENT
/begin MEASUREMENT VTQD_RPM2VehSpd_kph "" FLOAT32_IEEE SWC_FDC_type_CM_single_kph 0 0 0.0 300.0 ECU_ADDRESS 0x0000 /* @ECU_Address@VTQD_RPM2VehSpd_kph@ */ /end MEASUREMENT
/begin MEASUREMENT VTQD_VehActSpdGain_gain "" FLOAT32_IEEE SWC_FDC_type_CM_single_gain 0 0 -1.0 1.0 ECU_ADDRESS 0x0000 /* @ECU_Address@VTQD_VehActSpdGain_gain@ */ /end MEASUREMENT
/begin MEASUREMENT VTQD_VehActSpd_kph "" FLOAT32_IEEE SWC_FDC_type_CM_single_kph 0 0 -150.0 150.0 ECU_ADDRESS 0x0000 /* @ECU_Address@VTQD_VehActSpd_kph@ */ /end MEASUREMENT
/begin MEASUREMENT VTQD_CreepCtrlGrade_Deg "" FLOAT32_IEEE SWC_FDC_type_CM_single_Deg 0 0 -360.0 360.0 ECU_ADDRESS 0x0000 /* @ECU_Address@VTQD_CreepCtrlGrade_Deg@ */ /end MEASUREMENT
/begin MEASUREMENT VTQD_CreepBaseTqR_Nm "" FLOAT32_IEEE SWC_FDC_type_CM_single_Nm 0 0 -100000.0 100000.0 ECU_ADDRESS 0x0000 /* @ECU_Address@VTQD_CreepBaseTqR_Nm@ */ /end MEASUREMENT
/begin MEASUREMENT VTQD_CreepBaseTqD_Nm "" FLOAT32_IEEE SWC_FDC_type_CM_single_Nm 0 0 -100000.0 100000.0 ECU_ADDRESS 0x0000 /* @ECU_Address@VTQD_CreepBaseTqD_Nm@ */ /end MEASUREMENT
/begin MEASUREMENT VTQD_IVIPedalGRegenLim_pct "" FLOAT32_IEEE SWC_FDC_type_CM_single_pct 0 0 -10.0 125.0 ECU_ADDRESS 0x0000 /* @ECU_Address@VTQD_IVIPedalGRegenLim_pct@ */ /end MEASUREMENT
/begin MEASUREMENT VTQD_SmartRegenReq_mps2 "" FLOAT32_IEEE SWC_FDC_type_CM_single_mps2 0 0 -20.0 20.0 ECU_ADDRESS 0x0000 /* @ECU_Address@VTQD_SmartRegenReq_mps2@ */ /end MEASUREMENT
/begin MEASUREMENT VTQD_APSReqLowSpd_kph "" FLOAT32_IEEE SWC_FDC_type_CM_single_kph 0 0 -10.0 300.0 ECU_ADDRESS 0x0000 /* @ECU_Address@VTQD_APSReqLowSpd_kph@ */ /end MEASUREMENT
/begin MEASUREMENT VTQD_AutoHoldReleaseAPS_pct "" FLOAT32_IEEE SWC_FDC_type_CM_single_pct 0 0 -125.0 125.0 ECU_ADDRESS 0x0000 /* @ECU_Address@VTQD_AutoHoldReleaseAPS_pct@ */ /end MEASUREMENT
/begin MEASUREMENT VTQD_OPDHoldEnRelTq_Nm "" FLOAT32_IEEE SWC_FDC_type_CM_single_Nm 0 0 -100000.0 100000.0 ECU_ADDRESS 0x0000 /* @ECU_Address@VTQD_OPDHoldEnRelTq_Nm@ */ /end MEASUREMENT
/begin MEASUREMENT VTQD_OPDHoldReleaseTq_Nm "" FLOAT32_IEEE SWC_FDC_type_CM_single_Nm 0 0 -100000.0 100000.0 ECU_ADDRESS 0x0000 /* @ECU_Address@VTQD_OPDHoldReleaseTq_Nm@ */ /end MEASUREMENT
/begin MEASUREMENT VTQD_OPDHoldActRelTq_Nm "" FLOAT32_IEEE SWC_FDC_type_CM_single_Nm 0 0 -100000.0 100000.0 ECU_ADDRESS 0x0000 /* @ECU_Address@VTQD_OPDHoldActRelTq_Nm@ */ /end MEASUREMENT
/begin MEASUREMENT VTQD_OPDHoldDisRelTq_Nm "" FLOAT32_IEEE SWC_FDC_type_CM_single_Nm 0 0 -100000.0 100000.0 ECU_ADDRESS 0x0000 /* @ECU_Address@VTQD_OPDHoldDisRelTq_Nm@ */ /end MEASUREMENT
/begin MEASUREMENT VTQD_OPDHoldRelDetTime_s "" FLOAT32_IEEE SWC_FDC_type_CM_single_s 0 0 0.0 3600.0 ECU_ADDRESS 0x0000 /* @ECU_Address@VTQD_OPDHoldRelDetTime_s@ */ /end MEASUREMENT
/begin MEASUREMENT VTQD_OPDHoldDownRelDelay_s "" FLOAT32_IEEE SWC_FDC_type_CM_single_s 0 0 0.0 3600.0 ECU_ADDRESS 0x0000 /* @ECU_Address@VTQD_OPDHoldDownRelDelay_s@ */ /end MEASUREMENT
/begin MEASUREMENT VTQD_RollingShaftSpd_rpm "" FLOAT32_IEEE SWC_FDC_type_CM_single_rpm 0 0 -100000.0 100000.0 ECU_ADDRESS 0x0000 /* @ECU_Address@VTQD_RollingShaftSpd_rpm@ */ /end MEASUREMENT
/begin MEASUREMENT VTQD_SlideTqLowLim_Nm "" FLOAT32_IEEE SWC_FDC_type_CM_single_Nm 0 0 -100000.0 100000.0 ECU_ADDRESS 0x0000 /* @ECU_Address@VTQD_SlideTqLowLim_Nm@ */ /end MEASUREMENT
/begin MEASUREMENT VTQD_TqLowLimYawDev_degps "" FLOAT32_IEEE SWC_FDC_type_CM_single_degps 0 0 -150.0 150.0 ECU_ADDRESS 0x0000 /* @ECU_Address@VTQD_TqLowLimYawDev_degps@ */ /end MEASUREMENT
/begin MEASUREMENT VTQD_YawTqLowLim_Nm "" FLOAT32_IEEE SWC_FDC_type_CM_single_Nm 0 0 -100000.0 100000.0 ECU_ADDRESS 0x0000 /* @ECU_Address@VTQD_YawTqLowLim_Nm@ */ /end MEASUREMENT
/begin MEASUREMENT VTQD_PreDecTqLowLim_Nm "" FLOAT32_IEEE SWC_FDC_type_CM_single_Nm 0 0 -100000.0 100000.0 ECU_ADDRESS 0x0000 /* @ECU_Address@VTQD_PreDecTqLowLim_Nm@ */ /end MEASUREMENT
/begin MEASUREMENT VTQD_OrigPedalMapWhlTq_Nm "" FLOAT32_IEEE SWC_FDC_type_CM_single_Nm 0 0 -100000.0 100000.0 ECU_ADDRESS 0x0000 /* @ECU_Address@VTQD_OrigPedalMapWhlTq_Nm@ */ /end MEASUREMENT
/begin MEASUREMENT VTQD_GRADE_Deg "" FLOAT32_IEEE SWC_FDC_type_CM_single_Deg 0 0 -360.0 360.0 ECU_ADDRESS 0x0000 /* @ECU_Address@VTQD_GRADE_Deg@ */ /end MEASUREMENT
/begin MEASUREMENT VTQD_PedalMapClimbUpLim_Nm "" FLOAT32_IEEE SWC_FDC_type_CM_single_Nm 0 0 -100000.0 100000.0 ECU_ADDRESS 0x0000 /* @ECU_Address@VTQD_PedalMapClimbUpLim_Nm@ */ /end MEASUREMENT
/begin MEASUREMENT VTQD_SlideRateDev_pct "" FLOAT32_IEEE SWC_FDC_type_CM_single_pct 0 0 -125.0 125.0 ECU_ADDRESS 0x0000 /* @ECU_Address@VTQD_SlideRateDev_pct@ */ /end MEASUREMENT
/begin MEASUREMENT VTQD_SlideRegenLimTqGain_Nm "" FLOAT32_IEEE SWC_FDC_type_CM_single_Nm 0 0 -100000.0 100000.0 ECU_ADDRESS 0x0000 /* @ECU_Address@VTQD_SlideRegenLimTqGain_Nm@ */ /end MEASUREMENT
/begin MEASUREMENT VTQD_LastSlideRegenLimTq_Nm "" FLOAT32_IEEE SWC_FDC_type_CM_single_Nm 0 0 -100000.0 100000.0 ECU_ADDRESS 0x0000 /* @ECU_Address@VTQD_LastSlideRegenLimTq_Nm@ */ /end MEASUREMENT
/begin MEASUREMENT VTQD_SlideRegenLimTq_Nm "" FLOAT32_IEEE SWC_FDC_type_CM_single_Nm 0 0 -100000.0 100000.0 ECU_ADDRESS 0x0000 /* @ECU_Address@VTQD_SlideRegenLimTq_Nm@ */ /end MEASUREMENT
/begin MEASUREMENT VTQD_BrkRgnLatchTqLim_Nm "" FLOAT32_IEEE SWC_FDC_type_CM_single_Nm 0 0 -100000.0 100000.0 ECU_ADDRESS 0x0000 /* @ECU_Address@VTQD_BrkRgnLatchTqLim_Nm@ */ /end MEASUREMENT
/begin MEASUREMENT VTQD_OrigPedTqLowLim_Nm "" FLOAT32_IEEE SWC_FDC_type_CM_single_Nm 0 0 -100000.0 100000.0 ECU_ADDRESS 0x0000 /* @ECU_Address@VTQD_OrigPedTqLowLim_Nm@ */ /end MEASUREMENT
/begin MEASUREMENT VTQD_ActPedalMapWhlTq_Nm "" FLOAT32_IEEE SWC_FDC_type_CM_single_Nm 0 0 -100000.0 100000.0 ECU_ADDRESS 0x0000 /* @ECU_Address@VTQD_ActPedalMapWhlTq_Nm@ */ /end MEASUREMENT
/begin MEASUREMENT VTQD_PedalMapWhlTq_Nm "" FLOAT32_IEEE SWC_FDC_type_CM_single_Nm 0 0 -100000.0 100000.0 ECU_ADDRESS 0x0000 /* @ECU_Address@VTQD_PedalMapWhlTq_Nm@ */ /end MEASUREMENT
/begin MEASUREMENT VTQD_BOSReduction_gain "" FLOAT32_IEEE SWC_FDC_type_CM_single_gain 0 0 0.0 1.0 ECU_ADDRESS 0x0000 /* @ECU_Address@VTQD_BOSReduction_gain@ */ /end MEASUREMENT
/begin MEASUREMENT VTQD_BOSTq_Nm "" FLOAT32_IEEE SWC_FDC_type_CM_single_Nm 0 0 -100000.0 100000.0 ECU_ADDRESS 0x0000 /* @ECU_Address@VTQD_BOSTq_Nm@ */ /end MEASUREMENT
/begin MEASUREMENT VTQD_BOSEnBPSPosn_pct "" FLOAT32_IEEE SWC_FDC_type_CM_single_pct 0 0 -125.0 125.0 ECU_ADDRESS 0x0000 /* @ECU_Address@VTQD_BOSEnBPSPosn_pct@ */ /end MEASUREMENT
/begin MEASUREMENT VTQD_CreepBPSDisPosnR_pct "" FLOAT32_IEEE SWC_FDC_type_CM_single_pct 0 0 0.0 125.0 ECU_ADDRESS 0x0000 /* @ECU_Address@VTQD_CreepBPSDisPosnR_pct@ */ /end MEASUREMENT
/begin MEASUREMENT VTQD_CreepBPSDisPosn_pct "" FLOAT32_IEEE SWC_FDC_type_CM_single_pct 0 0 0.0 125.0 ECU_ADDRESS 0x0000 /* @ECU_Address@VTQD_CreepBPSDisPosn_pct@ */ /end MEASUREMENT
/begin MEASUREMENT VTQD_MaxShaftSpd_rpm "" FLOAT32_IEEE SWC_FDC_type_CM_single_rpm 0 0 -100000.0 100000.0 ECU_ADDRESS 0x0000 /* @ECU_Address@VTQD_MaxShaftSpd_rpm@ */ /end MEASUREMENT
/begin MEASUREMENT VTQD_EscapeModePedTq_Nm "" FLOAT32_IEEE SWC_FDC_type_CM_single_Nm 0 0 -100000.0 100000.0 ECU_ADDRESS 0x0000 /* @ECU_Address@VTQD_EscapeModePedTq_Nm@ */ /end MEASUREMENT
/begin MEASUREMENT VTQD_PreloadTq_Nm "" FLOAT32_IEEE SWC_FDC_type_CM_single_Nm 0 0 0.0 100000.0 ECU_ADDRESS 0x0000 /* @ECU_Address@VTQD_PreloadTq_Nm@ */ /end MEASUREMENT
/begin MEASUREMENT VTQD_CreepProtTq_Nm "" FLOAT32_IEEE SWC_FDC_type_CM_single_Nm 0 0 -100000.0 100000.0 ECU_ADDRESS 0x0000 /* @ECU_Address@VTQD_CreepProtTq_Nm@ */ /end MEASUREMENT
/begin MEASUREMENT VTQD_CreepPreloadSetTime_s "" FLOAT32_IEEE SWC_FDC_type_CM_single_s 0 0 0.0 3600.0 ECU_ADDRESS 0x0000 /* @ECU_Address@VTQD_CreepPreloadSetTime_s@ */ /end MEASUREMENT
/begin MEASUREMENT VTQD_CreepBPSEnPosnR_pct "" FLOAT32_IEEE SWC_FDC_type_CM_single_pct 0 0 0.0 125.0 ECU_ADDRESS 0x0000 /* @ECU_Address@VTQD_CreepBPSEnPosnR_pct@ */ /end MEASUREMENT
/begin MEASUREMENT VTQD_CreepBPSEnPosn_pct "" FLOAT32_IEEE SWC_FDC_type_CM_single_pct 0 0 0.0 125.0 ECU_ADDRESS 0x0000 /* @ECU_Address@VTQD_CreepBPSEnPosn_pct@ */ /end MEASUREMENT
/begin MEASUREMENT VTQD_OPDHoldEnSpd_kph "" FLOAT32_IEEE SWC_FDC_type_CM_single_kph 0 0 0.0 300.0 ECU_ADDRESS 0x0000 /* @ECU_Address@VTQD_OPDHoldEnSpd_kph@ */ /end MEASUREMENT
/begin MEASUREMENT VTQD_CreepEnSpd_kph "" FLOAT32_IEEE SWC_FDC_type_CM_single_kph 0 0 0.0 300.0 ECU_ADDRESS 0x0000 /* @ECU_Address@VTQD_CreepEnSpd_kph@ */ /end MEASUREMENT
/begin MEASUREMENT VTQD_CreepDisSpd_kph "" FLOAT32_IEEE SWC_FDC_type_CM_single_kph 0 0 0.0 300.0 ECU_ADDRESS 0x0000 /* @ECU_Address@VTQD_CreepDisSpd_kph@ */ /end MEASUREMENT
/begin MEASUREMENT VTQD_APSReqUpSpd_kph "" FLOAT32_IEEE SWC_FDC_type_CM_single_kph 0 0 -10.0 300.0 ECU_ADDRESS 0x0000 /* @ECU_Address@VTQD_APSReqUpSpd_kph@ */ /end MEASUREMENT
/begin MEASUREMENT VTQD_CreepPreloadTq_Nm "" FLOAT32_IEEE SWC_FDC_type_CM_single_Nm 0 0 -100.0 500.0 ECU_ADDRESS 0x0000 /* @ECU_Address@VTQD_CreepPreloadTq_Nm@ */ /end MEASUREMENT
/begin MEASUREMENT VTQD_CreepUpLimitTq_Nm "" FLOAT32_IEEE SWC_FDC_type_CM_single_Nm 0 0 -100000.0 100000.0 ECU_ADDRESS 0x0000 /* @ECU_Address@VTQD_CreepUpLimitTq_Nm@ */ /end MEASUREMENT
/begin MEASUREMENT VTQD_APSCreepBaseTqR_Nm "" FLOAT32_IEEE SWC_FDC_type_CM_single_Nm 0 0 -100000.0 100000.0 ECU_ADDRESS 0x0000 /* @ECU_Address@VTQD_APSCreepBaseTqR_Nm@ */ /end MEASUREMENT
/begin MEASUREMENT VTQD_CreepBaseTqRInp_Nm "" FLOAT32_IEEE SWC_FDC_type_CM_single_Nm 0 0 -100000.0 100000.0 ECU_ADDRESS 0x0000 /* @ECU_Address@VTQD_CreepBaseTqRInp_Nm@ */ /end MEASUREMENT
/begin MEASUREMENT VTQD_APSCreepBaseTqD_Nm "" FLOAT32_IEEE SWC_FDC_type_CM_single_Nm 0 0 -100000.0 100000.0 ECU_ADDRESS 0x0000 /* @ECU_Address@VTQD_APSCreepBaseTqD_Nm@ */ /end MEASUREMENT
/begin MEASUREMENT VTQD_CreepBaseTqDInp_Nm "" FLOAT32_IEEE SWC_FDC_type_CM_single_Nm 0 0 -100000.0 100000.0 ECU_ADDRESS 0x0000 /* @ECU_Address@VTQD_CreepBaseTqDInp_Nm@ */ /end MEASUREMENT
/begin MEASUREMENT VTQD_ActCreepBaseTq_Nm "" FLOAT32_IEEE SWC_FDC_type_CM_single_Nm 0 0 -100000.0 100000.0 ECU_ADDRESS 0x0000 /* @ECU_Address@VTQD_ActCreepBaseTq_Nm@ */ /end MEASUREMENT
/begin MEASUREMENT VTQD_CreepTargetSpdR_kph "" FLOAT32_IEEE SWC_FDC_type_CM_single_kph 0 0 0.0 300.0 ECU_ADDRESS 0x0000 /* @ECU_Address@VTQD_CreepTargetSpdR_kph@ */ /end MEASUREMENT
/begin MEASUREMENT VTQD_CreepTargetSpdD_kph "" FLOAT32_IEEE SWC_FDC_type_CM_single_kph 0 0 0.0 300.0 ECU_ADDRESS 0x0000 /* @ECU_Address@VTQD_CreepTargetSpdD_kph@ */ /end MEASUREMENT
/begin MEASUREMENT VTQD_CreepFinalSpd_kph "" FLOAT32_IEEE SWC_FDC_type_CM_single_kph 0 0 0.0 300.0 ECU_ADDRESS 0x0000 /* @ECU_Address@VTQD_CreepFinalSpd_kph@ */ /end MEASUREMENT
/begin MEASUREMENT VTQD_CreepErrSpd_kph "" FLOAT32_IEEE SWC_FDC_type_CM_single_kph 0 0 0.0 300.0 ECU_ADDRESS 0x0000 /* @ECU_Address@VTQD_CreepErrSpd_kph@ */ /end MEASUREMENT
/begin MEASUREMENT VTQD_APSCreepPterm_c "" FLOAT32_IEEE SWC_FDC_type_CM_single_c 0 0 -1000.0 1000.0 ECU_ADDRESS 0x0000 /* @ECU_Address@VTQD_APSCreepPterm_c@ */ /end MEASUREMENT
/begin MEASUREMENT VTQD_CreepPterm_c "" FLOAT32_IEEE SWC_FDC_type_CM_single_c 0 0 -1000.0 1000.0 ECU_ADDRESS 0x0000 /* @ECU_Address@VTQD_CreepPterm_c@ */ /end MEASUREMENT
/begin MEASUREMENT VTQD_CreepPtermInp_c "" FLOAT32_IEEE SWC_FDC_type_CM_single_c 0 0 -1000.0 1000.0 ECU_ADDRESS 0x0000 /* @ECU_Address@VTQD_CreepPtermInp_c@ */ /end MEASUREMENT
/begin MEASUREMENT VTQD_APSCreepIterm_c "" FLOAT32_IEEE SWC_FDC_type_CM_single_c 0 0 -1000.0 1000.0 ECU_ADDRESS 0x0000 /* @ECU_Address@VTQD_APSCreepIterm_c@ */ /end MEASUREMENT
/begin MEASUREMENT VTQD_CreepIterm_c "" FLOAT32_IEEE SWC_FDC_type_CM_single_c 0 0 -1000.0 1000.0 ECU_ADDRESS 0x0000 /* @ECU_Address@VTQD_CreepIterm_c@ */ /end MEASUREMENT
/begin MEASUREMENT VTQD_CreepItermInp_c "" FLOAT32_IEEE SWC_FDC_type_CM_single_c 0 0 -1000.0 1000.0 ECU_ADDRESS 0x0000 /* @ECU_Address@VTQD_CreepItermInp_c@ */ /end MEASUREMENT
/begin MEASUREMENT VTQD_CreepDeltaTq_Nm "" FLOAT32_IEEE SWC_FDC_type_CM_single_Nm 0 0 -100000.0 100000.0 ECU_ADDRESS 0x0000 /* @ECU_Address@VTQD_CreepDeltaTq_Nm@ */ /end MEASUREMENT
/begin MEASUREMENT VTQD_CreepActWhlTqDem_Nm "" FLOAT32_IEEE SWC_FDC_type_CM_single_Nm 0 0 -100000.0 100000.0 ECU_ADDRESS 0x0000 /* @ECU_Address@VTQD_CreepActWhlTqDem_Nm@ */ /end MEASUREMENT
/begin MEASUREMENT VTQD_CreepWhlTqDem_Nm "" FLOAT32_IEEE SWC_FDC_type_CM_single_Nm 0 0 -100000.0 100000.0 ECU_ADDRESS 0x0000 /* @ECU_Address@VTQD_CreepWhlTqDem_Nm@ */ /end MEASUREMENT
/begin MEASUREMENT VTQD_DriverWhlTqDem_Nm "" FLOAT32_IEEE SWC_FDC_type_CM_single_Nm 0 0 -100000.0 100000.0 ECU_ADDRESS 0x0000 /* @ECU_Address@VTQD_DriverWhlTqDem_Nm@ */ /end MEASUREMENT
/begin MEASUREMENT VTQD_TotalAvailDchrg_kW "" FLOAT32_IEEE SWC_FDC_type_CM_single_kW 0 0 -100000.0 100000.0 ECU_ADDRESS 0x0000 /* @ECU_Address@VTQD_TotalAvailDchrg_kW@ */ /end MEASUREMENT
/begin MEASUREMENT VTQD_TotalWhlTqCapMot_Nm "" FLOAT32_IEEE SWC_FDC_type_CM_single_Nm 0 0 -100000.0 100000.0 ECU_ADDRESS 0x0000 /* @ECU_Address@VTQD_TotalWhlTqCapMot_Nm@ */ /end MEASUREMENT
/begin MEASUREMENT VTQD_TotalWhlTqCapGen_Nm "" FLOAT32_IEEE SWC_FDC_type_CM_single_Nm 0 0 -100000.0 100000.0 ECU_ADDRESS 0x0000 /* @ECU_Address@VTQD_TotalWhlTqCapGen_Nm@ */ /end MEASUREMENT
/begin MEASUREMENT VTQD_NewDistFrWhlTq_Nm "" FLOAT32_IEEE SWC_FDC_type_CM_single_Nm 0 0 -100000.0 100000.0 ECU_ADDRESS 0x0000 /* @ECU_Address@VTQD_NewDistFrWhlTq_Nm@ */ /end MEASUREMENT
/begin MEASUREMENT VTQD_InitNewFrRatio_rat "" FLOAT32_IEEE SWC_FDC_type_CM_single_rat 0 0 0.0 1.0 ECU_ADDRESS 0x0000 /* @ECU_Address@VTQD_InitNewFrRatio_rat@ */ /end MEASUREMENT
/begin MEASUREMENT VTQD_NewFrRatio_rat "" FLOAT32_IEEE SWC_FDC_type_CM_single_rat 0 0 0.0 1.0 ECU_ADDRESS 0x0000 /* @ECU_Address@VTQD_NewFrRatio_rat@ */ /end MEASUREMENT
/begin MEASUREMENT VTQD_NewDistRrWhlTq_Nm "" FLOAT32_IEEE SWC_FDC_type_CM_single_Nm 0 0 -100000.0 100000.0 ECU_ADDRESS 0x0000 /* @ECU_Address@VTQD_NewDistRrWhlTq_Nm@ */ /end MEASUREMENT
/begin MEASUREMENT VTQD_InitNewRrRatio_rat "" FLOAT32_IEEE SWC_FDC_type_CM_single_rat 0 0 0.0 1.0 ECU_ADDRESS 0x0000 /* @ECU_Address@VTQD_InitNewRrRatio_rat@ */ /end MEASUREMENT
/begin MEASUREMENT VTQD_NewRrRatio_rat "" FLOAT32_IEEE SWC_FDC_type_CM_single_rat 0 0 0.0 1.0 ECU_ADDRESS 0x0000 /* @ECU_Address@VTQD_NewRrRatio_rat@ */ /end MEASUREMENT
/begin MEASUREMENT VTQD_FrRockAvalMotTqInc_Nm "" FLOAT32_IEEE SWC_FDC_type_CM_single_Nm 0 0 0.0 100000.0 ECU_ADDRESS 0x0000 /* @ECU_Address@VTQD_FrRockAvalMotTqInc_Nm@ */ /end MEASUREMENT
/begin MEASUREMENT VTQD_FrRockDisAvalMotInpTq_Nm "" FLOAT32_IEEE SWC_FDC_type_CM_single_Nm 0 0 0.0 100000.0 ECU_ADDRESS 0x0000 /* @ECU_Address@VTQD_FrRockDisAvalMotInpTq_Nm@ */ /end MEASUREMENT
/begin MEASUREMENT VTQD_FrMotActReduce_Nm "" FLOAT32_IEEE SWC_FDC_type_CM_single_Nm 0 0 0.0 100000.0 ECU_ADDRESS 0x0000 /* @ECU_Address@VTQD_FrMotActReduce_Nm@ */ /end MEASUREMENT
/begin MEASUREMENT VTQD_FrGenActReduce_Nm "" FLOAT32_IEEE SWC_FDC_type_CM_single_Nm 0 0 0.0 100000.0 ECU_ADDRESS 0x0000 /* @ECU_Address@VTQD_FrGenActReduce_Nm@ */ /end MEASUREMENT
/begin MEASUREMENT VTQD_FAfterTqCMDGain_c "" FLOAT32_IEEE SWC_FDC_type_CM_single_c 0 0 0.0 1.0 ECU_ADDRESS 0x0000 /* @ECU_Address@VTQD_FAfterTqCMDGain_c@ */ /end MEASUREMENT
/begin MEASUREMENT VTQD_RrRockAvalMotTqInc_Nm "" FLOAT32_IEEE SWC_FDC_type_CM_single_Nm 0 0 0.0 100000.0 ECU_ADDRESS 0x0000 /* @ECU_Address@VTQD_RrRockAvalMotTqInc_Nm@ */ /end MEASUREMENT
/begin MEASUREMENT VTQD_RrRockDisAvalMotInpTq_Nm "" FLOAT32_IEEE SWC_FDC_type_CM_single_Nm 0 0 0.0 100000.0 ECU_ADDRESS 0x0000 /* @ECU_Address@VTQD_RrRockDisAvalMotInpTq_Nm@ */ /end MEASUREMENT
/begin MEASUREMENT VTQD_RrMotActReduce_Nm "" FLOAT32_IEEE SWC_FDC_type_CM_single_Nm 0 0 -100000.0 0.0 ECU_ADDRESS 0x0000 /* @ECU_Address@VTQD_RrMotActReduce_Nm@ */ /end MEASUREMENT
/begin MEASUREMENT VTQD_RrGenActReduce_Nm "" FLOAT32_IEEE SWC_FDC_type_CM_single_Nm 0 0 -100000.0 0.0 ECU_ADDRESS 0x0000 /* @ECU_Address@VTQD_RrGenActReduce_Nm@ */ /end MEASUREMENT
/begin MEASUREMENT VTQD_RAfterTqCMDGain_c "" FLOAT32_IEEE SWC_FDC_type_CM_single_c 0 0 0.0 1.0 ECU_ADDRESS 0x0000 /* @ECU_Address@VTQD_RAfterTqCMDGain_c@ */ /end MEASUREMENT
/begin MEASUREMENT VTQD_APSDecReqCMD_mps2 "" FLOAT32_IEEE SWC_FDC_type_CM_single_mps2 0 0 -20.0 20.0 ECU_ADDRESS 0x0000 /* @ECU_Address@VTQD_APSDecReqCMD_mps2@ */ /end MEASUREMENT
/begin MEASUREMENT VTQD_ActOPDHoldAccDev_mps2 "" FLOAT32_IEEE SWC_FDC_type_CM_single_mps2 0 0 -20.0 20.0 ECU_ADDRESS 0x0000 /* @ECU_Address@VTQD_ActOPDHoldAccDev_mps2@ */ /end MEASUREMENT
/begin MEASUREMENT VTQD_MapAPSDecReq_mps2 "" FLOAT32_IEEE SWC_FDC_type_CM_single_mps2 0 0 -20.0 20.0 ECU_ADDRESS 0x0000 /* @ECU_Address@VTQD_MapAPSDecReq_mps2@ */ /end MEASUREMENT
/begin MEASUREMENT VTQD_APSDecTimeGain_c "" FLOAT32_IEEE SWC_FDC_type_CM_single_c 0 0 0.0 10.0 ECU_ADDRESS 0x0000 /* @ECU_Address@VTQD_APSDecTimeGain_c@ */ /end MEASUREMENT
/begin MEASUREMENT VTQD_APSDecReqTs_c "" FLOAT32_IEEE SWC_FDC_type_CM_single_c 0 0 0.0 1.0 ECU_ADDRESS 0x0000 /* @ECU_Address@VTQD_APSDecReqTs_c@ */ /end MEASUREMENT
/begin MEASUREMENT VTQD_APSDecReq_mps2 "" FLOAT32_IEEE SWC_FDC_type_CM_single_mps2 0 0 -20.0 20.0 ECU_ADDRESS 0x0000 /* @ECU_Address@VTQD_APSDecReq_mps2@ */ /end MEASUREMENT
/begin MEASUREMENT VTQD_FitRrDriverRatio_rat "" FLOAT32_IEEE SWC_FDC_type_CM_single_rat 0 0 0.0 1.0 ECU_ADDRESS 0x0000 /* @ECU_Address@VTQD_FitRrDriverRatio_rat@ */ /end MEASUREMENT
/begin MEASUREMENT VTQD_AvailTqNoARgnFr_Nm "" FLOAT32_IEEE SWC_FDC_type_CM_single_Nm 0 0 0.0 100000.0 ECU_ADDRESS 0x0000 /* @ECU_Address@VTQD_AvailTqNoARgnFr_Nm@ */ /end MEASUREMENT
/begin MEASUREMENT VTQD_AvailTqNoARgnRr_Nm "" FLOAT32_IEEE SWC_FDC_type_CM_single_Nm 0 0 0.0 100000.0 ECU_ADDRESS 0x0000 /* @ECU_Address@VTQD_AvailTqNoARgnRr_Nm@ */ /end MEASUREMENT
/begin MEASUREMENT VVMC_APSStaSys_enum "" UBYTE SWC_FDC_type_CM_uint8_enum 0 0 0.0 7.0 ECU_ADDRESS 0x0000 /* @ECU_Address@VVMC_APSStaSys_enum@ */ /end MEASUREMENT
/begin MEASUREMENT VVMC_APSReq_enum "" UBYTE SWC_FDC_type_CM_uint8_enum 0 0 0.0 7.0 ECU_ADDRESS 0x0000 /* @ECU_Address@VVMC_APSReq_enum@ */ /end MEASUREMENT
/begin MEASUREMENT VTQR_FrTqZeroTrans_enum "" UBYTE SWC_FDC_type_CM_uint8_enum 0 0 0.0 2.0 ECU_ADDRESS 0x0000 /* @ECU_Address@VTQR_FrTqZeroTrans_enum@ */ /end MEASUREMENT
/begin MEASUREMENT VTQR_RrTqZeroTrans_enum "" UBYTE SWC_FDC_type_CM_uint8_enum 0 0 0.0 2.0 ECU_ADDRESS 0x0000 /* @ECU_Address@VTQR_RrTqZeroTrans_enum@ */ /end MEASUREMENT
/begin MEASUREMENT VTQD_WhlSkipDisOPDHold_enum "" UBYTE SWC_FDC_type_CM_uint8_enum 0 0 0.0 4.0 ECU_ADDRESS 0x0000 /* @ECU_Address@VTQD_WhlSkipDisOPDHold_enum@ */ /end MEASUREMENT
/begin MEASUREMENT VTQD_APSStaSys_enum "" UBYTE SWC_FDC_type_CM_uint8_enum 0 0 0.0 15.0 ECU_ADDRESS 0x0000 /* @ECU_Address@VTQD_APSStaSys_enum@ */ /end MEASUREMENT
/begin MEASUREMENT VTQD_WhlSkipDisCreep_enum "" UBYTE SWC_FDC_type_CM_uint8_enum 0 0 0.0 5.0 ECU_ADDRESS 0x0000 /* @ECU_Address@VTQD_WhlSkipDisCreep_enum@ */ /end MEASUREMENT
/begin MEASUREMENT VTQD_APSReq_enum "" UBYTE SWC_FDC_type_CM_uint8_enum 0 0 0.0 15.0 ECU_ADDRESS 0x0000 /* @ECU_Address@VTQD_APSReq_enum@ */ /end MEASUREMENT
/begin MEASUREMENT VTQD_TMEnOutpTqSta_enum "" UBYTE SWC_FDC_type_CM_uint8_enum 0 0 0.0 5.0 ECU_ADDRESS 0x0000 /* @ECU_Address@VTQD_TMEnOutpTqSta_enum@ */ /end MEASUREMENT
/begin MEASUREMENT VVMC_ACCShutOffHold_flg "" UBYTE SWC_FDC_type_CM_boolean_flg 0 0 0.0 1.0 ECU_ADDRESS 0x0000 /* @ECU_Address@VVMC_ACCShutOffHold_flg@ */ /end MEASUREMENT
/begin MEASUREMENT VVMC_APSTqCtrlAllow_flg "" UBYTE SWC_FDC_type_CM_boolean_flg 0 0 0.0 1.0 ECU_ADDRESS 0x0000 /* @ECU_Address@VVMC_APSTqCtrlAllow_flg@ */ /end MEASUREMENT
/begin MEASUREMENT VVMC_APSShiftCtrlAllow_flg "" UBYTE SWC_FDC_type_CM_boolean_flg 0 0 0.0 1.0 ECU_ADDRESS 0x0000 /* @ECU_Address@VVMC_APSShiftCtrlAllow_flg@ */ /end MEASUREMENT
/begin MEASUREMENT VVMC_APSDoorCtrlAllow_flg "" UBYTE SWC_FDC_type_CM_boolean_flg 0 0 0.0 1.0 ECU_ADDRESS 0x0000 /* @ECU_Address@VVMC_APSDoorCtrlAllow_flg@ */ /end MEASUREMENT
/begin MEASUREMENT VVMC_ACCSpdCtrl_flg "" UBYTE SWC_FDC_type_CM_boolean_flg 0 0 0.0 1.0 ECU_ADDRESS 0x0000 /* @ECU_Address@VVMC_ACCSpdCtrl_flg@ */ /end MEASUREMENT
/begin MEASUREMENT VVMC_OVRD2ActRampActive_flg "" UBYTE SWC_FDC_type_CM_boolean_flg 0 0 0.0 1.0 ECU_ADDRESS 0x0000 /* @ECU_Address@VVMC_OVRD2ActRampActive_flg@ */ /end MEASUREMENT
/begin MEASUREMENT VVMC_ZeroSpdHoldAllow_flg "" UBYTE SWC_FDC_type_CM_boolean_flg 0 0 0.0 1.0 ECU_ADDRESS 0x0000 /* @ECU_Address@VVMC_ZeroSpdHoldAllow_flg@ */ /end MEASUREMENT
/begin MEASUREMENT VVMC_VehHoldDecCtrlCalSW2_flg "" UBYTE SWC_FDC_type_CM_boolean_flg 0 0 0.0 1.0 ECU_ADDRESS 0x0000 /* @ECU_Address@VVMC_VehHoldDecCtrlCalSW2_flg@ */ /end MEASUREMENT
/begin MEASUREMENT VVMC_AccelTurnHold_flg "" UBYTE SWC_FDC_type_CM_boolean_flg 0 0 0.0 1.0 ECU_ADDRESS 0x0000 /* @ECU_Address@VVMC_AccelTurnHold_flg@ */ /end MEASUREMENT
/begin MEASUREMENT VVMC_VehHoldMCPPass_flg "" UBYTE SWC_FDC_type_CM_boolean_flg 0 0 0.0 1.0 ECU_ADDRESS 0x0000 /* @ECU_Address@VVMC_VehHoldMCPPass_flg@ */ /end MEASUREMENT
/begin MEASUREMENT VVMC_VehHoldDecCtrlBEnd_flg "" UBYTE SWC_FDC_type_CM_boolean_flg 0 0 0.0 1.0 ECU_ADDRESS 0x0000 /* @ECU_Address@VVMC_VehHoldDecCtrlBEnd_flg@ */ /end MEASUREMENT
/begin MEASUREMENT VVMC_VehHoldHTimeNoMCPDet_flg "" UBYTE SWC_FDC_type_CM_boolean_flg 0 0 0.0 1.0 ECU_ADDRESS 0x0000 /* @ECU_Address@VVMC_VehHoldHTimeNoMCPDet_flg@ */ /end MEASUREMENT
/begin MEASUREMENT VVMC_VehHoldDecCtrlHEnd_flg "" UBYTE SWC_FDC_type_CM_boolean_flg 0 0 0.0 1.0 ECU_ADDRESS 0x0000 /* @ECU_Address@VVMC_VehHoldDecCtrlHEnd_flg@ */ /end MEASUREMENT
/begin MEASUREMENT VVMC_HoldDelayAllow_flg "" UBYTE SWC_FDC_type_CM_boolean_flg 0 0 0.0 1.0 ECU_ADDRESS 0x0000 /* @ECU_Address@VVMC_HoldDelayAllow_flg@ */ /end MEASUREMENT
/begin MEASUREMENT VVMC_VHTMSpdPass_flg "" UBYTE SWC_FDC_type_CM_boolean_flg 0 0 0.0 1.0 ECU_ADDRESS 0x0000 /* @ECU_Address@VVMC_VHTMSpdPass_flg@ */ /end MEASUREMENT
/begin MEASUREMENT VVMC_VHJerkPrvtHold_flg "" UBYTE SWC_FDC_type_CM_boolean_flg 0 0 0.0 1.0 ECU_ADDRESS 0x0000 /* @ECU_Address@VVMC_VHJerkPrvtHold_flg@ */ /end MEASUREMENT
/begin MEASUREMENT VVMC_HillUpHoldReqEn_flg "" UBYTE SWC_FDC_type_CM_boolean_flg 0 0 0.0 1.0 ECU_ADDRESS 0x0000 /* @ECU_Address@VVMC_HillUpHoldReqEn_flg@ */ /end MEASUREMENT
/begin MEASUREMENT VVMC_HillUpESCStaEn_flg "" UBYTE SWC_FDC_type_CM_boolean_flg 0 0 0.0 1.0 ECU_ADDRESS 0x0000 /* @ECU_Address@VVMC_HillUpESCStaEn_flg@ */ /end MEASUREMENT
/begin MEASUREMENT VVMC_HoldResTqEn_flg "" UBYTE SWC_FDC_type_CM_boolean_flg 0 0 0.0 1.0 ECU_ADDRESS 0x0000 /* @ECU_Address@VVMC_HoldResTqEn_flg@ */ /end MEASUREMENT
/begin MEASUREMENT VVMC_ACCLowSpdTqCtrl_flg "" UBYTE SWC_FDC_type_CM_boolean_flg 0 0 0.0 1.0 ECU_ADDRESS 0x0000 /* @ECU_Address@VVMC_ACCLowSpdTqCtrl_flg@ */ /end MEASUREMENT
/begin MEASUREMENT VVMC_ReqBrkJoin_flg "" UBYTE SWC_FDC_type_CM_boolean_flg 0 0 0.0 1.0 ECU_ADDRESS 0x0000 /* @ECU_Address@VVMC_ReqBrkJoin_flg@ */ /end MEASUREMENT
/begin MEASUREMENT VVMC_ADSPosGFBPrevent_flg "" UBYTE SWC_FDC_type_CM_boolean_flg 0 0 0.0 1.0 ECU_ADDRESS 0x0000 /* @ECU_Address@VVMC_ADSPosGFBPrevent_flg@ */ /end MEASUREMENT
/begin MEASUREMENT VVMC_ADSPosGFBPrvtLoSpd_flg "" UBYTE SWC_FDC_type_CM_boolean_flg 0 0 0.0 1.0 ECU_ADDRESS 0x0000 /* @ECU_Address@VVMC_ADSPosGFBPrvtLoSpd_flg@ */ /end MEASUREMENT
/begin MEASUREMENT VVMC_ReqBrkJoinSRActive_flg "" UBYTE SWC_FDC_type_CM_boolean_flg 0 0 0.0 1.0 ECU_ADDRESS 0x0000 /* @ECU_Address@VVMC_ReqBrkJoinSRActive_flg@ */ /end MEASUREMENT
/begin MEASUREMENT VVMC_ACCPedalTqEnOvrd_flg "" UBYTE SWC_FDC_type_CM_boolean_flg 0 0 0.0 1.0 ECU_ADDRESS 0x0000 /* @ECU_Address@VVMC_ACCPedalTqEnOvrd_flg@ */ /end MEASUREMENT
/begin MEASUREMENT VVMC_ACCActivePedalOn_flg "" UBYTE SWC_FDC_type_CM_boolean_flg 0 0 0.0 1.0 ECU_ADDRESS 0x0000 /* @ECU_Address@VVMC_ACCActivePedalOn_flg@ */ /end MEASUREMENT
/begin MEASUREMENT VVMC_ACCOvrdBackDrTq_flg "" UBYTE SWC_FDC_type_CM_boolean_flg 0 0 0.0 1.0 ECU_ADDRESS 0x0000 /* @ECU_Address@VVMC_ACCOvrdBackDrTq_flg@ */ /end MEASUREMENT
/begin MEASUREMENT VVMC_ZeroRgnTqSpdCtrl_flg "" UBYTE SWC_FDC_type_CM_boolean_flg 0 0 0.0 1.0 ECU_ADDRESS 0x0000 /* @ECU_Address@VVMC_ZeroRgnTqSpdCtrl_flg@ */ /end MEASUREMENT
/begin MEASUREMENT VVMC_ACCLowSpdFollowESCTq_flg "" UBYTE SWC_FDC_type_CM_boolean_flg 0 0 0.0 1.0 ECU_ADDRESS 0x0000 /* @ECU_Address@VVMC_ACCLowSpdFollowESCTq_flg@ */ /end MEASUREMENT
/begin MEASUREMENT VVMC_RgnProhibited_flg "" UBYTE SWC_FDC_type_CM_boolean_flg 0 0 0.0 1.0 ECU_ADDRESS 0x0000 /* @ECU_Address@VVMC_RgnProhibited_flg@ */ /end MEASUREMENT
/begin MEASUREMENT VVMC_HoldTqAddDis_flg "" UBYTE SWC_FDC_type_CM_boolean_flg 0 0 0.0 1.0 ECU_ADDRESS 0x0000 /* @ECU_Address@VVMC_HoldTqAddDis_flg@ */ /end MEASUREMENT
/begin MEASUREMENT VVMC_HoldTqCalSpd1Det_flg "" UBYTE SWC_FDC_type_CM_boolean_flg 0 0 0.0 1.0 ECU_ADDRESS 0x0000 /* @ECU_Address@VVMC_HoldTqCalSpd1Det_flg@ */ /end MEASUREMENT
/begin MEASUREMENT VVMC_HoldTqCalEn_flg "" UBYTE SWC_FDC_type_CM_boolean_flg 0 0 0.0 1.0 ECU_ADDRESS 0x0000 /* @ECU_Address@VVMC_HoldTqCalEn_flg@ */ /end MEASUREMENT
/begin MEASUREMENT VVMC_HoldNoMCP_flg "" UBYTE SWC_FDC_type_CM_boolean_flg 0 0 0.0 1.0 ECU_ADDRESS 0x0000 /* @ECU_Address@VVMC_HoldNoMCP_flg@ */ /end MEASUREMENT
/begin MEASUREMENT VVMC_ZCNegCtrlEn_flg "" UBYTE SWC_FDC_type_CM_boolean_flg 0 0 0.0 1.0 ECU_ADDRESS 0x0000 /* @ECU_Address@VVMC_ZCNegCtrlEn_flg@ */ /end MEASUREMENT
/begin MEASUREMENT VVMC_ZCPosCtrlEn_flg "" UBYTE SWC_FDC_type_CM_boolean_flg 0 0 0.0 1.0 ECU_ADDRESS 0x0000 /* @ECU_Address@VVMC_ZCPosCtrlEn_flg@ */ /end MEASUREMENT
/begin MEASUREMENT VVMC_CCPedalTqEnOvrd_flg "" UBYTE SWC_FDC_type_CM_boolean_flg 0 0 0.0 1.0 ECU_ADDRESS 0x0000 /* @ECU_Address@VVMC_CCPedalTqEnOvrd_flg@ */ /end MEASUREMENT
/begin MEASUREMENT VVMC_MSAOvrdAllow_flg "" UBYTE SWC_FDC_type_CM_boolean_flg 0 0 0.0 1.0 ECU_ADDRESS 0x0000 /* @ECU_Address@VVMC_MSAOvrdAllow_flg@ */ /end MEASUREMENT
/begin MEASUREMENT VVMC_MSATqDown_flg "" UBYTE SWC_FDC_type_CM_boolean_flg 0 0 0.0 1.0 ECU_ADDRESS 0x0000 /* @ECU_Address@VVMC_MSATqDown_flg@ */ /end MEASUREMENT
/begin MEASUREMENT VVMC_CAASCtrlAvail_flg "" UBYTE SWC_FDC_type_CM_boolean_flg 0 0 0.0 1.0 ECU_ADDRESS 0x0000 /* @ECU_Address@VVMC_CAASCtrlAvail_flg@ */ /end MEASUREMENT
/begin MEASUREMENT VVMC_APSDecReqA_flg "" UBYTE SWC_FDC_type_CM_boolean_flg 0 0 0.0 1.0 ECU_ADDRESS 0x0000 /* @ECU_Address@VVMC_APSDecReqA_flg@ */ /end MEASUREMENT
/begin MEASUREMENT VVMC_ESCActive_flg "" UBYTE SWC_FDC_type_CM_boolean_flg 0 0 0.0 1.0 ECU_ADDRESS 0x0000 /* @ECU_Address@VVMC_ESCActive_flg@ */ /end MEASUREMENT
/begin MEASUREMENT VVMC_RDCDetectEn_flg "" UBYTE SWC_FDC_type_CM_boolean_flg 0 0 0.0 1.0 ECU_ADDRESS 0x0000 /* @ECU_Address@VVMC_RDCDetectEn_flg@ */ /end MEASUREMENT
/begin MEASUREMENT VVMC_AltRDCRec_flg "" UBYTE SWC_FDC_type_CM_boolean_flg 0 0 0.0 1.0 ECU_ADDRESS 0x0000 /* @ECU_Address@VVMC_AltRDCRec_flg@ */ /end MEASUREMENT
/begin MEASUREMENT VVMC_ZCNegDetEn_flg "" UBYTE SWC_FDC_type_CM_boolean_flg 0 0 0.0 1.0 ECU_ADDRESS 0x0000 /* @ECU_Address@VVMC_ZCNegDetEn_flg@ */ /end MEASUREMENT
/begin MEASUREMENT VVMC_ZCPosDetEn_flg "" UBYTE SWC_FDC_type_CM_boolean_flg 0 0 0.0 1.0 ECU_ADDRESS 0x0000 /* @ECU_Address@VVMC_ZCPosDetEn_flg@ */ /end MEASUREMENT
/begin MEASUREMENT VTQR_ADASCancelBRgnRampF_flg "" UBYTE SWC_FDC_type_CM_boolean_flg 0 0 0.0 1.0 ECU_ADDRESS 0x0000 /* @ECU_Address@VTQR_ADASCancelBRgnRampF_flg@ */ /end MEASUREMENT
/begin MEASUREMENT VTQR_FrGearChange_flg "" UBYTE SWC_FDC_type_CM_boolean_flg 0 0 0.0 1.0 ECU_ADDRESS 0x0000 /* @ECU_Address@VTQR_FrGearChange_flg@ */ /end MEASUREMENT
/begin MEASUREMENT VTQR_ADASCancelBRgnRampR_flg "" UBYTE SWC_FDC_type_CM_boolean_flg 0 0 0.0 1.0 ECU_ADDRESS 0x0000 /* @ECU_Address@VTQR_ADASCancelBRgnRampR_flg@ */ /end MEASUREMENT
/begin MEASUREMENT VTQR_RrGearChange_flg "" UBYTE SWC_FDC_type_CM_boolean_flg 0 0 0.0 1.0 ECU_ADDRESS 0x0000 /* @ECU_Address@VTQR_RrGearChange_flg@ */ /end MEASUREMENT
/begin MEASUREMENT VTQR_FrRDCActiveTs_flg "" UBYTE SWC_FDC_type_CM_boolean_flg 0 0 0.0 1.0 ECU_ADDRESS 0x0000 /* @ECU_Address@VTQR_FrRDCActiveTs_flg@ */ /end MEASUREMENT
/begin MEASUREMENT VTQR_RrRDCActiveTs_flg "" UBYTE SWC_FDC_type_CM_boolean_flg 0 0 0.0 1.0 ECU_ADDRESS 0x0000 /* @ECU_Address@VTQR_RrRDCActiveTs_flg@ */ /end MEASUREMENT
/begin MEASUREMENT VTQR_FrDrModChangeReset_flg "" UBYTE SWC_FDC_type_CM_boolean_flg 0 0 0.0 1.0 ECU_ADDRESS 0x0000 /* @ECU_Address@VTQR_FrDrModChangeReset_flg@ */ /end MEASUREMENT
/begin MEASUREMENT VTQR_FrRDCActRateLimitInc_flg "" UBYTE SWC_FDC_type_CM_boolean_flg 0 0 0.0 1.0 ECU_ADDRESS 0x0000 /* @ECU_Address@VTQR_FrRDCActRateLimitInc_flg@ */ /end MEASUREMENT
/begin MEASUREMENT VTQR_RrDrModChangeReset_flg "" UBYTE SWC_FDC_type_CM_boolean_flg 0 0 0.0 1.0 ECU_ADDRESS 0x0000 /* @ECU_Address@VTQR_RrDrModChangeReset_flg@ */ /end MEASUREMENT
/begin MEASUREMENT VTQR_ACCHoldPdovrdInc_flg "" UBYTE SWC_FDC_type_CM_boolean_flg 0 0 0.0 1.0 ECU_ADDRESS 0x0000 /* @ECU_Address@VTQR_ACCHoldPdovrdInc_flg@ */ /end MEASUREMENT
/begin MEASUREMENT VTQR_RrRDCActRateLimitInc_flg "" UBYTE SWC_FDC_type_CM_boolean_flg 0 0 0.0 1.0 ECU_ADDRESS 0x0000 /* @ECU_Address@VTQR_RrRDCActRateLimitInc_flg@ */ /end MEASUREMENT
/begin MEASUREMENT VTQD_IVICreepOnSW_flg "" UBYTE SWC_FDC_type_CM_boolean_flg 0 0 0.0 1.0 ECU_ADDRESS 0x0000 /* @ECU_Address@VTQD_IVICreepOnSW_flg@ */ /end MEASUREMENT
/begin MEASUREMENT VTQD_IVISmartRegenSW_flg "" UBYTE SWC_FDC_type_CM_boolean_flg 0 0 0.0 1.0 ECU_ADDRESS 0x0000 /* @ECU_Address@VTQD_IVISmartRegenSW_flg@ */ /end MEASUREMENT
/begin MEASUREMENT VTQD_OPDHoldEnRelease_flg "" UBYTE SWC_FDC_type_CM_boolean_flg 0 0 0.0 1.0 ECU_ADDRESS 0x0000 /* @ECU_Address@VTQD_OPDHoldEnRelease_flg@ */ /end MEASUREMENT
/begin MEASUREMENT VTQD_OPDHoldDisRelease_flg "" UBYTE SWC_FDC_type_CM_boolean_flg 0 0 0.0 1.0 ECU_ADDRESS 0x0000 /* @ECU_Address@VTQD_OPDHoldDisRelease_flg@ */ /end MEASUREMENT
/begin MEASUREMENT VTQD_AutoHoldRelease_flg "" UBYTE SWC_FDC_type_CM_boolean_flg 0 0 0.0 1.0 ECU_ADDRESS 0x0000 /* @ECU_Address@VTQD_AutoHoldRelease_flg@ */ /end MEASUREMENT
/begin MEASUREMENT VTQD_AntiBlockEnOPDHold_flg "" UBYTE SWC_FDC_type_CM_boolean_flg 0 0 0.0 1.0 ECU_ADDRESS 0x0000 /* @ECU_Address@VTQD_AntiBlockEnOPDHold_flg@ */ /end MEASUREMENT
/begin MEASUREMENT VTQD_OPDHoldDelayForP_flg "" UBYTE SWC_FDC_type_CM_boolean_flg 0 0 0.0 1.0 ECU_ADDRESS 0x0000 /* @ECU_Address@VTQD_OPDHoldDelayForP_flg@ */ /end MEASUREMENT
/begin MEASUREMENT VTQD_APSStasysLow_flg "" UBYTE SWC_FDC_type_CM_boolean_flg 0 0 0.0 1.0 ECU_ADDRESS 0x0000 /* @ECU_Address@VTQD_APSStasysLow_flg@ */ /end MEASUREMENT
/begin MEASUREMENT VTQD_EVDriveModeValid_flg "" UBYTE SWC_FDC_type_CM_boolean_flg 0 0 0.0 1.0 ECU_ADDRESS 0x0000 /* @ECU_Address@VTQD_EVDriveModeValid_flg@ */ /end MEASUREMENT
/begin MEASUREMENT VTQD_RollRegenEnable_flg "" UBYTE SWC_FDC_type_CM_boolean_flg 0 0 0.0 1.0 ECU_ADDRESS 0x0000 /* @ECU_Address@VTQD_RollRegenEnable_flg@ */ /end MEASUREMENT
/begin MEASUREMENT VTQD_SlopeUp_flg "" UBYTE SWC_FDC_type_CM_boolean_flg 0 0 0.0 1.0 ECU_ADDRESS 0x0000 /* @ECU_Address@VTQD_SlopeUp_flg@ */ /end MEASUREMENT
/begin MEASUREMENT VTQD_ActHSAActive_flg "" UBYTE SWC_FDC_type_CM_boolean_flg 0 0 0.0 1.0 ECU_ADDRESS 0x0000 /* @ECU_Address@VTQD_ActHSAActive_flg@ */ /end MEASUREMENT
/begin MEASUREMENT VTQD_HighBPSPosn_flg "" UBYTE SWC_FDC_type_CM_boolean_flg 0 0 0.0 1.0 ECU_ADDRESS 0x0000 /* @ECU_Address@VTQD_HighBPSPosn_flg@ */ /end MEASUREMENT
/begin MEASUREMENT VTQD_TestLoSpdBrkCtrl_flg "" UBYTE SWC_FDC_type_CM_boolean_flg 0 0 0.0 1.0 ECU_ADDRESS 0x0000 /* @ECU_Address@VTQD_TestLoSpdBrkCtrl_flg@ */ /end MEASUREMENT
/begin MEASUREMENT VTQD_LoBrkCtrlReset_flg "" UBYTE SWC_FDC_type_CM_boolean_flg 0 0 0.0 1.0 ECU_ADDRESS 0x0000 /* @ECU_Address@VTQD_LoBrkCtrlReset_flg@ */ /end MEASUREMENT
/begin MEASUREMENT VTQD_WhlQuickSkip_flg "" UBYTE SWC_FDC_type_CM_boolean_flg 0 0 0.0 1.0 ECU_ADDRESS 0x0000 /* @ECU_Address@VTQD_WhlQuickSkip_flg@ */ /end MEASUREMENT
/begin MEASUREMENT VTQD_WhlSpdQuickSkip_flg "" UBYTE SWC_FDC_type_CM_boolean_flg 0 0 0.0 1.0 ECU_ADDRESS 0x0000 /* @ECU_Address@VTQD_WhlSpdQuickSkip_flg@ */ /end MEASUREMENT
/begin MEASUREMENT VTQD_EscapModeTqLim_flg "" UBYTE SWC_FDC_type_CM_boolean_flg 0 0 0.0 1.0 ECU_ADDRESS 0x0000 /* @ECU_Address@VTQD_EscapModeTqLim_flg@ */ /end MEASUREMENT
/begin MEASUREMENT VTQD_OPDHoldPreLoadEn_flg "" UBYTE SWC_FDC_type_CM_boolean_flg 0 0 0.0 1.0 ECU_ADDRESS 0x0000 /* @ECU_Address@VTQD_OPDHoldPreLoadEn_flg@ */ /end MEASUREMENT
/begin MEASUREMENT VTQD_ShiftPreload_flg "" UBYTE SWC_FDC_type_CM_boolean_flg 0 0 0.0 1.0 ECU_ADDRESS 0x0000 /* @ECU_Address@VTQD_ShiftPreload_flg@ */ /end MEASUREMENT
/begin MEASUREMENT VTQD_ADASPreLoadHold_flg "" UBYTE SWC_FDC_type_CM_boolean_flg 0 0 0.0 1.0 ECU_ADDRESS 0x0000 /* @ECU_Address@VTQD_ADASPreLoadHold_flg@ */ /end MEASUREMENT
/begin MEASUREMENT VTQD_ADASPreLoadEn_flg "" UBYTE SWC_FDC_type_CM_boolean_flg 0 0 0.0 1.0 ECU_ADDRESS 0x0000 /* @ECU_Address@VTQD_ADASPreLoadEn_flg@ */ /end MEASUREMENT
/begin MEASUREMENT VTQD_PreLoadPreEn_flg "" UBYTE SWC_FDC_type_CM_boolean_flg 0 0 0.0 1.0 ECU_ADDRESS 0x0000 /* @ECU_Address@VTQD_PreLoadPreEn_flg@ */ /end MEASUREMENT
/begin MEASUREMENT VTQD_LowBPSPosn_flg "" UBYTE SWC_FDC_type_CM_boolean_flg 0 0 0.0 1.0 ECU_ADDRESS 0x0000 /* @ECU_Address@VTQD_LowBPSPosn_flg@ */ /end MEASUREMENT
/begin MEASUREMENT VTQD_RBCActiveRec_flg "" UBYTE SWC_FDC_type_CM_boolean_flg 0 0 0.0 1.0 ECU_ADDRESS 0x0000 /* @ECU_Address@VTQD_RBCActiveRec_flg@ */ /end MEASUREMENT
/begin MEASUREMENT VTQD_RBCActive_flg "" UBYTE SWC_FDC_type_CM_boolean_flg 0 0 0.0 1.0 ECU_ADDRESS 0x0000 /* @ECU_Address@VTQD_RBCActive_flg@ */ /end MEASUREMENT
/begin MEASUREMENT VTQD_OPDCreepGrade_flg "" UBYTE SWC_FDC_type_CM_boolean_flg 0 0 0.0 1.0 ECU_ADDRESS 0x0000 /* @ECU_Address@VTQD_OPDCreepGrade_flg@ */ /end MEASUREMENT
/begin MEASUREMENT VTQD_MediumSkipDisRset_flg "" UBYTE SWC_FDC_type_CM_boolean_flg 0 0 0.0 1.0 ECU_ADDRESS 0x0000 /* @ECU_Address@VTQD_MediumSkipDisRset_flg@ */ /end MEASUREMENT
/begin MEASUREMENT VTQD_HighSkipDisRset_flg "" UBYTE SWC_FDC_type_CM_boolean_flg 0 0 0.0 1.0 ECU_ADDRESS 0x0000 /* @ECU_Address@VTQD_HighSkipDisRset_flg@ */ /end MEASUREMENT
/begin MEASUREMENT VTQD_OPDHoldUpDown_flg "" UBYTE SWC_FDC_type_CM_boolean_flg 0 0 0.0 1.0 ECU_ADDRESS 0x0000 /* @ECU_Address@VTQD_OPDHoldUpDown_flg@ */ /end MEASUREMENT
/begin MEASUREMENT VTQD_APSStasysUp_flg "" UBYTE SWC_FDC_type_CM_boolean_flg 0 0 0.0 1.0 ECU_ADDRESS 0x0000 /* @ECU_Address@VTQD_APSStasysUp_flg@ */ /end MEASUREMENT
/begin MEASUREMENT VTQD_CreepDisable_flg "" UBYTE SWC_FDC_type_CM_boolean_flg 0 0 0.0 1.0 ECU_ADDRESS 0x0000 /* @ECU_Address@VTQD_CreepDisable_flg@ */ /end MEASUREMENT
/begin MEASUREMENT VTQD_CreepEnable_flg "" UBYTE SWC_FDC_type_CM_boolean_flg 0 0 0.0 1.0 ECU_ADDRESS 0x0000 /* @ECU_Address@VTQD_CreepEnable_flg@ */ /end MEASUREMENT
/begin MEASUREMENT VTQD_ActBPSPosnInRange_flg "" UBYTE SWC_FDC_type_CM_boolean_flg 0 0 0.0 1.0 ECU_ADDRESS 0x0000 /* @ECU_Address@VTQD_ActBPSPosnInRange_flg@ */ /end MEASUREMENT
/begin MEASUREMENT VTQD_LowSkipDisRset_flg "" UBYTE SWC_FDC_type_CM_boolean_flg 0 0 0.0 1.0 ECU_ADDRESS 0x0000 /* @ECU_Address@VTQD_LowSkipDisRset_flg@ */ /end MEASUREMENT
/begin MEASUREMENT VTQD_CreepProtTqEn_flg "" UBYTE SWC_FDC_type_CM_boolean_flg 0 0 0.0 1.0 ECU_ADDRESS 0x0000 /* @ECU_Address@VTQD_CreepProtTqEn_flg@ */ /end MEASUREMENT
/begin MEASUREMENT VTQD_RrTMEnOutpTq_flg "" UBYTE SWC_FDC_type_CM_boolean_flg 0 0 0.0 1.0 ECU_ADDRESS 0x0000 /* @ECU_Address@VTQD_RrTMEnOutpTq_flg@ */ /end MEASUREMENT
/begin MEASUREMENT VTQD_FrTMEnOutpTq_flg "" UBYTE SWC_FDC_type_CM_boolean_flg 0 0 0.0 1.0 ECU_ADDRESS 0x0000 /* @ECU_Address@VTQD_FrTMEnOutpTq_flg@ */ /end MEASUREMENT
/begin MEASUREMENT VTQD_FrMotorTempHigh_flg "" UBYTE SWC_FDC_type_CM_boolean_flg 0 0 0.0 1.0 ECU_ADDRESS 0x0000 /* @ECU_Address@VTQD_FrMotorTempHigh_flg@ */ /end MEASUREMENT
/begin MEASUREMENT VTQD_RrMotorTempHigh_flg "" UBYTE SWC_FDC_type_CM_boolean_flg 0 0 0.0 1.0 ECU_ADDRESS 0x0000 /* @ECU_Address@VTQD_RrMotorTempHigh_flg@ */ /end MEASUREMENT
/begin MEASUREMENT VTQD_APSDecReqA_flg "" UBYTE SWC_FDC_type_CM_boolean_flg 0 0 0.0 1.0 ECU_ADDRESS 0x0000 /* @ECU_Address@VTQD_APSDecReqA_flg@ */ /end MEASUREMENT
/begin MEASUREMENT VTQD_APSDecReqMax_flg "" UBYTE SWC_FDC_type_CM_boolean_flg 0 0 0.0 1.0 ECU_ADDRESS 0x0000 /* @ECU_Address@VTQD_APSDecReqMax_flg@ */ /end MEASUREMENT
/begin MEASUREMENT VTQD_ActParkRequest_flg "" UBYTE SWC_FDC_type_CM_boolean_flg 0 0 0.0 1.0 ECU_ADDRESS 0x0000 /* @ECU_Address@VTQD_ActParkRequest_flg@ */ /end MEASUREMENT
/begin MEASUREMENT VTQD_OPDHoldLamp_flg "" UBYTE SWC_FDC_type_CM_boolean_flg 0 0 0.0 1.0 ECU_ADDRESS 0x0000 /* @ECU_Address@VTQD_OPDHoldLamp_flg@ */ /end MEASUREMENT
/begin MEASUREMENT VTQD_HoldtimeEnd_flg "" UBYTE SWC_FDC_type_CM_boolean_flg 0 0 0.0 1.0 ECU_ADDRESS 0x0000 /* @ECU_Address@VTQD_HoldtimeEnd_flg@ */ /end MEASUREMENT
/begin MEASUREMENT VVMC_CalibratedAccXAfter_G "" FLOAT32_IEEE SWC_FDC_type_CM_single_G 0 0 -65.536 65.536 ECU_ADDRESS 0x0000 /* @ECU_Address@VVMC_CalibratedAccXAfter_G@ */ /end MEASUREMENT
/begin MEASUREMENT VVMC_CalibratedGyroYDevAfter_Dps "" FLOAT32_IEEE SWC_FDC_type_CM_single_Dps 0 0 0.0 20.0 ECU_ADDRESS 0x0000 /* @ECU_Address@VVMC_CalibratedGyroYDevAfter_Dps@ */ /end MEASUREMENT
/begin MEASUREMENT VVMC_CalEstSlope1_Deg "" FLOAT32_IEEE SWC_FDC_type_CM_single_Deg 0 0 -180.0 180.0 ECU_ADDRESS 0x0000 /* @ECU_Address@VVMC_CalEstSlope1_Deg@ */ /end MEASUREMENT
/begin MEASUREMENT VVMC_PitchIntegGrade_deg "" FLOAT32_IEEE SWC_FDC_type_CM_single_deg 0 0 -180.0 180.0 ECU_ADDRESS 0x0000 /* @ECU_Address@VVMC_PitchIntegGrade_deg@ */ /end MEASUREMENT
/begin MEASUREMENT VVMC_CalEstSlopeOfstA_Deg "" FLOAT32_IEEE SWC_FDC_type_CM_single_Deg 0 0 -180.0 180.0 ECU_ADDRESS 0x0000 /* @ECU_Address@VVMC_CalEstSlopeOfstA_Deg@ */ /end MEASUREMENT
/begin MEASUREMENT VVMC_BaseGrade_deg "" FLOAT32_IEEE SWC_FDC_type_CM_single_deg 0 0 -180.0 180.0 ECU_ADDRESS 0x0000 /* @ECU_Address@VVMC_BaseGrade_deg@ */ /end MEASUREMENT
/begin MEASUREMENT VVMC_PitchGradeL2H_flg "" UBYTE SWC_FDC_type_CM_boolean_flg 0 0 0.0 1.0 ECU_ADDRESS 0x0000 /* @ECU_Address@VVMC_PitchGradeL2H_flg@ */ /end MEASUREMENT
/begin MEASUREMENT VVMC_GradeShiftDelay_flg "" UBYTE SWC_FDC_type_CM_boolean_flg 0 0 0.0 1.0 ECU_ADDRESS 0x0000 /* @ECU_Address@VVMC_GradeShiftDelay_flg@ */ /end MEASUREMENT
/begin MEASUREMENT VVMC_PitchGradeStopReset_flg "" UBYTE SWC_FDC_type_CM_boolean_flg 0 0 0.0 1.0 ECU_ADDRESS 0x0000 /* @ECU_Address@VVMC_PitchGradeStopReset_flg@ */ /end MEASUREMENT
/begin MEASUREMENT VVMC_PitchGradeHiReset_flg "" UBYTE SWC_FDC_type_CM_boolean_flg 0 0 0.0 1.0 ECU_ADDRESS 0x0000 /* @ECU_Address@VVMC_PitchGradeHiReset_flg@ */ /end MEASUREMENT
/begin MEASUREMENT VVMC_PitchGradeH2L_flg "" UBYTE SWC_FDC_type_CM_boolean_flg 0 0 0.0 1.0 ECU_ADDRESS 0x0000 /* @ECU_Address@VVMC_PitchGradeH2L_flg@ */ /end MEASUREMENT
/begin MEASUREMENT VVMC_VehicleSpeedAftLim_kph "" FLOAT32_IEEE SWC_FDC_type_CM_single_kph 0 0 0.0 300.0 ECU_ADDRESS 0x0000 /* @ECU_Address@VVMC_VehicleSpeedAftLim_kph@ */ /end MEASUREMENT
/begin MEASUREMENT VVMC_EstSlopeCal_Deg "" FLOAT32_IEEE SWC_FDC_type_CM_single_Deg 0 0 -180.0 180.0 ECU_ADDRESS 0x0000 /* @ECU_Address@VVMC_EstSlopeCal_Deg@ */ /end MEASUREMENT
/begin MEASUREMENT VVMC_CalEstPitchAngle_deg "" FLOAT32_IEEE SWC_FDC_type_CM_single_deg 0 0 -90.0 90.0 ECU_ADDRESS 0x0000 /* @ECU_Address@VVMC_CalEstPitchAngle_deg@ */ /end MEASUREMENT
/begin MEASUREMENT VVMC_VehPitchAngleUpdCond_flg "" UBYTE SWC_FDC_type_CM_boolean_flg 0 0 0.0 1.0 ECU_ADDRESS 0x0000 /* @ECU_Address@VVMC_VehPitchAngleUpdCond_flg@ */ /end MEASUREMENT
/begin COMPU_METHOD SWC_FDC_type_CM_single_C "Q = V" RAT_FUNC "%8.6" "C" COEFFS 0 1 0 0 0 1 /end COMPU_METHOD
/begin COMPU_METHOD SWC_FDC_type_CM_single_s "Q = V" RAT_FUNC "%8.6" "s" COEFFS 0 1 0 0 0 1 /end COMPU_METHOD
/begin COMPU_METHOD SWC_FDC_type_CM_single_rpm "Q = V" RAT_FUNC "%8.6" "rpm" COEFFS 0 1 0 0 0 1 /end COMPU_METHOD
/begin COMPU_METHOD SWC_FDC_type_CM_uint8_enum "Q = V" RAT_FUNC "%3.0" "enum" COEFFS 0 1 0 0 0 1 /end COMPU_METHOD
/begin COMPU_METHOD SWC_FDC_type_CM_single_Gps "Q = V" RAT_FUNC "%8.6" "Gps" COEFFS 0 1 0 0 0 1 /end COMPU_METHOD
/begin COMPU_METHOD SWC_FDC_type_CM_single_kph "Q = V" RAT_FUNC "%8.6" "kph" COEFFS 0 1 0 0 0 1 /end COMPU_METHOD
/begin COMPU_METHOD SWC_FDC_type_CM_single_c "Q = V" RAT_FUNC "%8.6" "c" COEFFS 0 1 0 0 0 1 /end COMPU_METHOD
/begin COMPU_METHOD SWC_FDC_type_CM_single_mps2 "Q = V" RAT_FUNC "%8.6" "mps2" COEFFS 0 1 0 0 0 1 /end COMPU_METHOD
/begin COMPU_METHOD SWC_FDC_type_CM_single_pct "Q = V" RAT_FUNC "%8.6" "pct" COEFFS 0 1 0 0 0 1 /end COMPU_METHOD
/begin COMPU_METHOD SWC_FDC_type_CM_single_enum "Q = V" RAT_FUNC "%8.6" "enum" COEFFS 0 1 0 0 0 1 /end COMPU_METHOD
/begin COMPU_METHOD SWC_FDC_type_CM_single_Deg "Q = V" RAT_FUNC "%8.6" "Deg" COEFFS 0 1 0 0 0 1 /end COMPU_METHOD
/begin COMPU_METHOD SWC_FDC_type_CM_single_rat "Q = V" RAT_FUNC "%8.6" "rat" COEFFS 0 1 0 0 0 1 /end COMPU_METHOD
/begin COMPU_METHOD SWC_FDC_type_CM_single_Nm "Q = V" RAT_FUNC "%8.6" "Nm" COEFFS 0 1 0 0 0 1 /end COMPU_METHOD
/begin COMPU_METHOD SWC_FDC_type_CM_single_gain "Q = V" RAT_FUNC "%8.6" "gain" COEFFS 0 1 0 0 0 1 /end COMPU_METHOD
/begin COMPU_METHOD SWC_FDC_type_CM_single_deg "Q = V" RAT_FUNC "%8.6" "deg" COEFFS 0 1 0 0 0 1 /end COMPU_METHOD
/begin COMPU_METHOD SWC_FDC_type_CM_single_Dps "Q = V" RAT_FUNC "%8.6" "Dps" COEFFS 0 1 0 0 0 1 /end COMPU_METHOD
/begin COMPU_METHOD SWC_FDC_type_CM_single_mps3 "Q = V" RAT_FUNC "%8.6" "mps3" COEFFS 0 1 0 0 0 1 /end COMPU_METHOD
/begin COMPU_METHOD SWC_FDC_type_CM_single_degps "Q = V" RAT_FUNC "%8.6" "degps" COEFFS 0 1 0 0 0 1 /end COMPU_METHOD
/begin COMPU_METHOD SWC_FDC_type_CM_single_kW "Q = V" RAT_FUNC "%8.6" "kW" COEFFS 0 1 0 0 0 1 /end COMPU_METHOD
/begin COMPU_METHOD SWC_FDC_type_CM_single_m "Q = V" RAT_FUNC "%8.6" "m" COEFFS 0 1 0 0 0 1 /end COMPU_METHOD
/begin COMPU_METHOD SWC_FDC_type_CM_single_flg "Q = V" RAT_FUNC "%8.6" "flg" COEFFS 0 1 0 0 0 1 /end COMPU_METHOD
/begin COMPU_METHOD SWC_FDC_type_CM_single_raw32 "Q = V" RAT_FUNC "%8.6" "raw32" COEFFS 0 1 0 0 0 1 /end COMPU_METHOD
/begin COMPU_METHOD SWC_FDC_type_CM_boolean_flg "Q = V" RAT_FUNC "%1.0" "flg" COEFFS 0 1 0 0 0 1 /end COMPU_METHOD
/begin COMPU_METHOD SWC_FDC_type_CM_single_G "Q = V" RAT_FUNC "%8.6" "G" COEFFS 0 1 0 0 0 1 /end COMPU_METHOD
/begin GROUP S1849_If_Action_Subsystem2 "SWC_FDC_type/run_SWC_FDC_RxTx_5ms_sys/APP/TQD/TorqueDemand/TorqueModule/AvaliableTqLimit/If Action Subsystem2" /begin REF_MEASUREMENT VTQD_AvailTqNoARgnFr_Nm VTQD_AvailTqNoARgnRr_Nm /end REF_MEASUREMENT /end GROUP
/begin GROUP S1849_RateLimit "SWC_FDC_type/run_SWC_FDC_RxTx_5ms_sys/APP/TQD/TorqueDemand/TorqueModule/AvaliableTqLimit/RateLimit" /begin REF_MEASUREMENT VTQD_FAfterTqCMDGain_c /end REF_MEASUREMENT /end GROUP
/begin GROUP S1849_RateLimit1 "SWC_FDC_type/run_SWC_FDC_RxTx_5ms_sys/APP/TQD/TorqueDemand/TorqueModule/AvaliableTqLimit/RateLimit1" /begin REF_MEASUREMENT VTQD_RAfterTqCMDGain_c /end REF_MEASUREMENT /end GROUP
/begin GROUP S1849_TorqueCapacityCalcalation "SWC_FDC_type/run_SWC_FDC_RxTx_5ms_sys/APP/TQD/TorqueDemand/TorqueModule/AvaliableTqLimit/TorqueCapacityCalcalation"
 /begin SUB_GROUP S1866_CapacityDistribution S1866_Generation S1866_MOTOR_Loss_MAP_ S1866_Motoring S1866_RateLimit S1866_RateLimit1 S1866_TMAvailablePwr_Calculation /end SUB_GROUP
 /begin REF_CHARACTERISTIC KTQD_FrMotorTempHigh_C KTQD_FrMotorTempLow_C KTQD_FrRockAvalMotBaseTq_Nm KTQD_FrRockAvalMotTqInc_Nm KTQD_RockAvalMotTqReset_pct KTQD_RockInitMotTqInc_Nm KTQD_RockInitTqMotDec_Nm KTQD_RrMotorTempHigh_C KTQD_RrMotorTempLow_C KTQD_RrRockAvalMotBaseTq_Nm KTQD_RrRockAvalMotTqInc_Nm MTQD_FrGenActReduce_Z_Nm MTQD_FrMotActReduce_Z_Nm MTQD_RrGenActReduce_Z_Nm MTQD_RrMotActReduce_Z_Nm /end REF_CHARACTERISTIC
 /begin REF_MEASUREMENT VTQD_FrGenActReduce_Nm VTQD_FrMotActReduce_Nm VTQD_FrMotorTempHigh_flg VTQD_FrRockAvalMotTqInc_Nm VTQD_FrRockDisAvalMotInpTq_Nm VTQD_RrGenActReduce_Nm VTQD_RrMotActReduce_Nm VTQD_RrMotorTempHigh_flg VTQD_RrRockAvalMotTqInc_Nm VTQD_RrRockDisAvalMotInpTq_Nm /end REF_MEASUREMENT
/end GROUP
/begin GROUP S1850_BOS "SWC_FDC_type/run_SWC_FDC_RxTx_5ms_sys/APP/TQD/TorqueDemand/TorqueModule/DriverWhlTqDem/BOS" /begin SUB_GROUP S1874_SR_Latch /end SUB_GROUP
 /begin REF_CHARACTERISTIC KTQD_BOSEnPedalTq_Nm KTQD_FailsafeActiveSW_flg MTQD_BOSEnBPSPosn_Y_pct MTQD_BOSMap_Z_pct /end REF_CHARACTERISTIC
 /begin REF_MEASUREMENT VTQD_BOSEnBPSPosn_pct VTQD_BOSReduction_gain VTQD_BOSTq_Nm /end REF_MEASUREMENT
/end GROUP
/begin GROUP S1850_Creep "SWC_FDC_type/run_SWC_FDC_RxTx_5ms_sys/APP/TQD/TorqueDemand/TorqueModule/DriverWhlTqDem/Creep"
 /begin SUB_GROUP S1875_If_Action_Subsystem1 S1875_SR_Latch S1875_SR_Latch2 S1875_SR_Latch4 S1875_SR_Latch5 S1875_SR_Latch6 S1875_SR_Latch7 S1875_Timer /end SUB_GROUP
 /begin REF_CHARACTERISTIC KTQD_APSCMDEnCreepSpd_kph KTQD_APSCreepParOvrd_flg KTQD_APSReqDelayTime_s KTQD_APSReqDisCreep_flg KTQD_CreepAPSPosn2Launch_pct KTQD_CreepDisPedTqSpd_kph KTQD_CreepDisVehSpd_kph KTQD_CreepDisableSpdofstR_kph KTQD_CreepDisableSpdofst_kph KTQD_CreepEnVehSpd_kph KTQD_CreepEnableSpdR_kph KTQD_CreepEnableSpd_kph KTQD_CreepGradeLatchSpd_kph KTQD_CreepGradeRecTime_s KTQD_CreepLatchGradeDev_Deg KTQD_CreepLowLimitTq_Nm KTQD_CreepPrLoadEnSpd_kph KTQD_CreepSlopeLatchSW_flg KTQD_CreepUpLimitTq_Nm KTQD_CreepVehSpdSW_flg KTQD_FailsafeActiveSW_flg KTQD_LowSkipDisCreepDelay_s KTQD_MALCreepUpLimitTq_Nm KTQD_OPDCreepDUpLimitTq_Nm KTQD_OPDCreepDisGrade_Deg KTQD_OPDCreepEnGrade_Deg KTQD_OPDCreepTargetSpdD_kph KTQD_RAPSCreepPreloadSetTime_s KTQD_RBCCreepRecTq_Nm KTQD_RPM2VehSpdTs_c KTQD_TCSCreepDisSpdSW_flg KTQD_TCSCreepDisSpd_kph KTQD_TCSCreepSW_flg KTQD_TireRadius_m KTQD_VehActSpdNegGain_gain KTQD_VehActSpdPosGain_gain MTQD_APSCreepBaseTqD_Z_Nm MTQD_APSCreepBaseTqR_Z_Nm MTQD_APSCreepIterm_Z_Nm MTQD_APSCreepPterm_Z_Nm MTQD_CreepBPSDisPosnR_Y_pct MTQD_CreepBPSDisPosn_Y_pct MTQD_CreepBPSEnPosnR_Y_pct MTQD_CreepBPSEnPosn_Y_pct MTQD_CreepBaseTqD_Z_Nm MTQD_CreepBaseTqR_Z_Nm MTQD_CreepDeltaTq_Y_Nm MTQD_CreepIterm_Z_Nm MTQD_CreepPreloadTime_Y_s MTQD_CreepPreloadTq_Z_Nm MTQD_CreepProtTq_Y_Nm MTQD_CreepPterm_Z_Nm MTQD_CreepTargetSpdD_Y_kph MTQD_CreepTargetSpdR_Y_kph MTQD_OPDHoldEnSpd_Y_kph MTQD_WhlSkipDisCreep_Y_enum /end REF_CHARACTERISTIC
 /begin REF_MEASUREMENT VTQD_APSCreepBaseTqD_Nm VTQD_APSCreepBaseTqR_Nm VTQD_APSCreepIterm_c VTQD_APSCreepPterm_c VTQD_ActBPSPosnInRange_flg VTQD_ActCreepBaseTq_Nm VTQD_CreepActWhlTqDem_Nm VTQD_CreepBPSDisPosnR_pct VTQD_CreepBPSDisPosn_pct VTQD_CreepBPSEnPosnR_pct VTQD_CreepBPSEnPosn_pct VTQD_CreepBaseTqDInp_Nm VTQD_CreepBaseTqD_Nm VTQD_CreepBaseTqRInp_Nm VTQD_CreepBaseTqR_Nm VTQD_CreepCtrlGrade_Deg VTQD_CreepDeltaTq_Nm VTQD_CreepDisSpd_kph VTQD_CreepDisable_flg VTQD_CreepEnSpd_kph VTQD_CreepEnable_flg VTQD_CreepErrSpd_kph VTQD_CreepFinalSpd_kph VTQD_CreepItermInp_c VTQD_CreepIterm_c VTQD_CreepPreloadSetTime_s VTQD_CreepPreloadTq_Nm VTQD_CreepProtTqEn_flg VTQD_CreepProtTq_Nm VTQD_CreepPtermInp_c VTQD_CreepPterm_c VTQD_CreepTargetSpdD_kph VTQD_CreepTargetSpdR_kph VTQD_CreepUpLimitTq_Nm VTQD_CreepWhlTqDem_Nm VTQD_HighBPSPosn_flg VTQD_HighSkipDisRset_flg VTQD_LowBPSPosn_flg VTQD_LowSkipDisRset_flg VTQD_MediumSkipDisRset_flg VTQD_OPDCreepGrade_flg VTQD_OPDHoldEnSpd_kph VTQD_RBCActiveRec_flg VTQD_RBCActive_flg VTQD_RPM2VehSpd_kph VTQD_VehActSpdGain_gain VTQD_VehActSpd_kph VTQD_WhlSkipDisCreep_enum /end REF_MEASUREMENT
/end GROUP
/begin GROUP S1850_DriverTqCoordination "SWC_FDC_type/run_SWC_FDC_RxTx_5ms_sys/APP/TQD/TorqueDemand/TorqueModule/DriverWhlTqDem/DriverTqCoordination"
 /begin SUB_GROUP S1876_New_Preload_Torque S1876_SR_Latch S1876_SR_Latch2 S1876_SR_Latch6 S1876_Timer1 /end SUB_GROUP
 /begin REF_CHARACTERISTIC KTQD_ADASHoldDelayEnTime_s KTQD_ADASHoldPreLoadspd_kph KTQD_AEBEmergBrkSpd_kph KTQD_APSPreLoadHoldtime_s KTQD_APSZeroSpd_kph KTQD_EmergBrkLongAccel_Gps KTQD_EmergBrkSpd_kph KTQD_EscModeTqLimAccCon_Gps KTQD_FailsafeActiveSW_flg KTQD_LoSPdBrkRlsTime_s KTQD_LoSpdBrkRlsSpd_kph KTQD_LoSpdCtrlBrkPos_pct KTQD_OPDHoldPreLoadBound_Nm KTQD_OPDHoldPreLoadTime_s KTQD_PreLoadDisSpd_kph KTQD_PreLoadTqHold_rpm KTQD_PreLoadTq_Nm KTQD_PreLoad_Holdtime_s KTQD_RockModeWhlSkipSta_enum MTQD_EscapeModePedTq_Z_Nm MTQD_PreLoadTq_Y_Nm /end REF_CHARACTERISTIC
 /begin REF_MEASUREMENT VTQD_ADASPreLoadEn_flg VTQD_ADASPreLoadHold_flg VTQD_DriverWhlTqDem_Nm VTQD_EscapModeTqLim_flg VTQD_EscapeModePedTq_Nm VTQD_HoldtimeEnd_flg VTQD_LoBrkCtrlReset_flg VTQD_MaxShaftSpd_rpm VTQD_OPDHoldPreLoadEn_flg VTQD_PreLoadPreEn_flg VTQD_PreloadTq_Nm VTQD_ShiftPreload_flg VTQD_TestLoSpdBrkCtrl_flg VTQD_WhlQuickSkip_flg VTQD_WhlSpdQuickSkip_flg /end REF_MEASUREMENT
/end GROUP
/begin GROUP S1850_PedalMapWhlTq "SWC_FDC_type/run_SWC_FDC_RxTx_5ms_sys/APP/TQD/TorqueDemand/TorqueModule/DriverWhlTqDem/PedalMapWhlTq"
 /begin SUB_GROUP S1877_LHM S1877_NoLHM S1877_Pedal_G_Control_Mode S1877_SR_Latch1 S1877_SR_Latch2 S1877_SR_Latch3 S1877_SR_Latch4 S1877_Triggered_Subsystem /end SUB_GROUP
 /begin REF_CHARACTERISTIC KTQD_ACCOvrdCancelPedTqRat_Nm KTQD_ACCOvrdCancelResPedTq_pct KTQD_ACCOvrdCancelTqCtrl_flg KTQD_ClimbMin_rpm KTQD_EVDriveModeValid_ovrdflg KTQD_EVDriveModeValid_ovrdval KTQD_FailsafeActiveSW_flg KTQD_GRADE_Deg_ovrdflg KTQD_GRADE_Deg_ovrdval KTQD_IVIPedalGRegenLim_pct KTQD_IVISmartRegenSW_flg KTQD_OrigPedTqLowLimSW_flg KTQD_PedalMapClimbLowLim_Nm KTQD_PedalMapRDCLowLim_Nm KTQD_PedalMapRDCUpLim_Nm KTQD_RgnEnLatchBrkPos_pct KTQD_RgnEnLatchSlope_Deg KTQD_RgnEnLatchSpd_kph KTQD_SlideRateDevLowLim_pct KTQD_SlideRateDevUpLim_pct KTQD_SlideRegEnLimitTq_Nm KTQD_SlideRegenLowLim_Nm KTQD_SmartRegenReq_mps2 KTQD_TargetSlideRate_pct MTQD_OrigPedTqLowLim_Z_Nm MTQD_PedalMapClimbUpLim_Z_Nm MTQD_SlideRegenTqGain_Z_Nm MTQD_YawTqLowLim_Y_Nm /end REF_CHARACTERISTIC
 /begin REF_MEASUREMENT VTQD_ActHSAActive_flg VTQD_ActPedalMapWhlTq_Nm VTQD_BrkRgnLatchTqLim_Nm VTQD_EVDriveModeValid_flg VTQD_GRADE_Deg VTQD_IVICreepOnSW_flg VTQD_IVIPedalGRegenLim_pct VTQD_IVISmartRegenSW_flg VTQD_LastSlideRegenLimTq_Nm VTQD_OrigPedTqLowLim_Nm VTQD_OrigPedalMapWhlTq_Nm VTQD_PedalMapClimbUpLim_Nm VTQD_PedalMapWhlTq_Nm VTQD_PreDecTqLowLim_Nm VTQD_SlideRateDev_pct VTQD_SlideRegenLimTqGain_Nm VTQD_SlideRegenLimTq_Nm VTQD_SlideTqLowLim_Nm VTQD_SlopeUp_flg VTQD_SmartRegenReq_mps2 VTQD_TqLowLimYawDev_degps VTQD_YawTqLowLim_Nm /end REF_MEASUREMENT
/end GROUP
/begin GROUP S1850_RollingRegenJudge "SWC_FDC_type/run_SWC_FDC_RxTx_5ms_sys/APP/TQD/TorqueDemand/TorqueModule/DriverWhlTqDem/RollingRegenJudge" /begin REF_CHARACTERISTIC KTQD_RegenOffSpd_kph KTQD_RegenOnSpd_kph /end REF_CHARACTERISTIC /begin REF_MEASUREMENT VTQD_RollRegenEnable_flg VTQD_RollingShaftSpd_rpm /end REF_MEASUREMENT /end GROUP
/begin GROUP S1852_Deceleration_Calculation "SWC_FDC_type/run_SWC_FDC_RxTx_5ms_sys/APP/TQD/TorqueDemand/TorqueModule/OPD Hold/Deceleration Calculation"
 /begin REF_CHARACTERISTIC KTQD_APSDecReqMaxSW_flg KTQD_APSDecReqMaxTime_s KTQD_OPDHoldBrkSW_flg KTQD_OPDHoldDevLowLim_mps2 KTQD_OPDHoldDevUpLim_mps2 MTQD_APSDecReqCMD_Y_mps2 MTQD_APSDecReqTs_Y_c MTQD_APSDecReq_Z_mps2 MTQD_APSDecTimeGain_Z_c /end REF_CHARACTERISTIC
 /begin REF_MEASUREMENT VTQD_APSDecReqCMD_mps2 VTQD_APSDecReqMax_flg VTQD_APSDecReqTs_c VTQD_APSDecReq_mps2 VTQD_APSDecTimeGain_c VTQD_ActOPDHoldAccDev_mps2 VTQD_MapAPSDecReq_mps2 /end REF_MEASUREMENT
/end GROUP
/begin GROUP S1852_OPDHold_Request_ "SWC_FDC_type/run_SWC_FDC_RxTx_5ms_sys/APP/TQD/TorqueDemand/TorqueModule/OPD Hold/OPDHold Request " /begin SUB_GROUP S1988_SR_Latch1 S1988_Timer /end SUB_GROUP
 /begin REF_CHARACTERISTIC KTQD_APSReqDelayTime_s KTQD_APSReqDownSpd_kph KTQD_APSReqUpSpd_kph KTQD_OPDHoldLampDelayTime_s KTQD_OPDHoldLampDisSpd_kph KTQD_OPDHoldLampEnSpd_kph MTQD_APSReqLowSpd_Y_kph /end REF_CHARACTERISTIC
 /begin REF_MEASUREMENT VTQD_APSDecReqA_flg VTQD_APSReqLowSpd_kph VTQD_APSReqUpSpd_kph VTQD_APSReq_enum VTQD_APSStasysLow_flg VTQD_APSStasysUp_flg VTQD_OPDHoldLamp_flg VTQD_OPDHoldUpDown_flg /end REF_MEASUREMENT
/end GROUP
/begin GROUP S1852_Parking_Requeest_Backup "SWC_FDC_type/run_SWC_FDC_RxTx_5ms_sys/APP/TQD/TorqueDemand/TorqueModule/OPD Hold/Parking Requeest Backup" /begin SUB_GROUP S1989_SR_Latch /end SUB_GROUP
 /begin REF_CHARACTERISTIC KTQD_APSReqDelayTime_s KTQD_OPDHoldAllowPark_flg KTQD_OPDHoldAllowPark_s KTQD_OPDHoldBrkSW_flg /end REF_CHARACTERISTIC
 /begin REF_MEASUREMENT VTQD_ActParkRequest_flg /end REF_MEASUREMENT
/end GROUP
/begin GROUP S1852_Release_Condition "SWC_FDC_type/run_SWC_FDC_RxTx_5ms_sys/APP/TQD/TorqueDemand/TorqueModule/OPD Hold/Release Condition" /begin SUB_GROUP S1990_DelayEnable S1990_SR_Latch S1990_SR_Latch1 /end SUB_GROUP
 /begin REF_CHARACTERISTIC KTQD_APSDecReqMaxTime_s KTQD_APSRelDisTqDev_Nm KTQD_OPDHoldDetRevSpd_kph KTQD_OPDHoldDownEnTime_s KTQD_OPDHoldLiftRevSpd_kph KTQD_OPDHoldRelDetSpd_kph KTQD_OPDHoldRelTqGain_Nm MTQD_AutoHoldReleaseBPS_Y_pct MTQD_OPDHoldDownRelDelay_Y_s MTQD_OPDHoldRelDetTime_Y_s MTQD_OPDHoldReleaseTq_Y_Nm /end REF_CHARACTERISTIC
 /begin REF_MEASUREMENT VTQD_AutoHoldReleaseAPS_pct VTQD_AutoHoldRelease_flg VTQD_OPDHoldActRelTq_Nm VTQD_OPDHoldDisRelTq_Nm VTQD_OPDHoldDisRelease_flg VTQD_OPDHoldDownRelDelay_s VTQD_OPDHoldEnRelTq_Nm VTQD_OPDHoldEnRelease_flg VTQD_OPDHoldRelDetTime_s VTQD_OPDHoldReleaseTq_Nm /end REF_MEASUREMENT
/end GROUP
/begin GROUP S1852_System_Status "SWC_FDC_type/run_SWC_FDC_RxTx_5ms_sys/APP/TQD/TorqueDemand/TorqueModule/OPD Hold/System Status"
 /begin SUB_GROUP S1991_DelayEnable S1991_DelayEnable1 S1991_SR_Latch S1991_SR_Latch3 S1991_SR_Latch4 /end SUB_GROUP
 /begin REF_CHARACTERISTIC KTQD_AutoHoldEnSpd_kph KTQD_OPDHoldSkipDetSpd_kph KTQD_R2DEnOPDHSpdDelayTime_s KTQD_R2DEnOPDHoldSpd_kph KTQD_R2DGradeLowLim_Deg KTQD_R2DGradeUpLim_Deg KTQD_SkipRecOPDHoldDelay_s MTQD_WhlSkipDisOPDHold_Y_enum /end REF_CHARACTERISTIC
 /begin REF_MEASUREMENT VTQD_APSStaSys_enum VTQD_AntiBlockEnOPDHold_flg VTQD_OPDHoldDelayForP_flg VTQD_WhlSkipDisOPDHold_enum /end REF_MEASUREMENT
/end GROUP
/begin GROUP S1856_Coordinate_NoSuitbleGear_flg "SWC_FDC_type/run_SWC_FDC_RxTx_5ms_sys/APP/TQD/TorqueDemand/TorqueModule/TqCoordination/Coordinate_NoSuitbleGear_flg" /begin REF_CHARACTERISTIC KTQD_DriverTqDemN_Nm /end REF_CHARACTERISTIC /end GROUP
/begin GROUP S1856_Total_Demand_Capacity_Torque_ "SWC_FDC_type/run_SWC_FDC_RxTx_5ms_sys/APP/TQD/TorqueDemand/TorqueModule/TqCoordination/Total Demand Capacity Torque "
 /begin REF_CHARACTERISTIC KTQD_BatapCont_factor KTQD_DCDCCalPwrAvailRsv_kW KTQD_THCMCalPwrAvailRsv_kW KTQD_TMPwrAvailDchrg_kW_ovrdflg KTQD_TotalLowTheldTrq_Nm KTQD_TotalUpTheldTrq_Nm /end REF_CHARACTERISTIC
 /begin REF_MEASUREMENT VTQD_TotalAvailDchrg_kW VTQD_TotalWhlTqCapGen_Nm VTQD_TotalWhlTqCapMot_Nm /end REF_MEASUREMENT
/end GROUP
/begin GROUP S1857_AWD_Ratio "SWC_FDC_type/run_SWC_FDC_RxTx_5ms_sys/APP/TQD/TorqueDemand/TorqueModule/TqDistribution/AWD_Ratio"
 /begin REF_CHARACTERISTIC KTQD_AWDFWDSelRRatio_rat KTQD_AWDFrRatio_rat_ovrdflg KTQD_AWDFrRatio_rat_ovrdval KTQD_AWDRWDSelRRatio_rat KTQD_AWDRrRatio_rat_ovrdflg KTQD_AWDRrRatio_rat_ovrdval KTQD_AWDTqRatioSW_enum KTQD_CreepWhlRatioSW_flg KTQD_DriverSelPowerTrain_enum KTQD_DrvSelPwrTrainSW_flg KTQD_RrEDUTqDistrictMax_gain KTQD_RrEDUTqDistrictMin_gain /end REF_CHARACTERISTIC
 /begin REF_MEASUREMENT VTQD_FitRrDriverRatio_rat /end REF_MEASUREMENT
/end GROUP
/begin GROUP S1857_New_Torque_Distribution "SWC_FDC_type/run_SWC_FDC_RxTx_5ms_sys/APP/TQD/TorqueDemand/TorqueModule/TqDistribution/New Torque Distribution"
 /begin REF_CHARACTERISTIC KTQD_AWDRrRatio_rat_ovrdflg KTQD_AWDRrRatio_rat_ovrdval KTQD_FrTMMotOutpConSW_flg KTQD_NewDistInitRate_rat KTQD_RrTMRgnOutpConSW_flg KTQD_TqDemEnFrTMOutpMotDev_Nm KTQD_TqDemEnFrTMOutpRgn_Nm KTQD_TqDemEnRrTMOutpMot_Nm KTQD_TqDemEnRrTMOutpRgnDev_Nm KTQD_TqDemEnRrTMOutpRgn_Nm /end REF_CHARACTERISTIC
 /begin REF_MEASUREMENT VTQD_FrTMEnOutpTq_flg VTQD_InitNewFrRatio_rat VTQD_InitNewRrRatio_rat VTQD_NewDistFrWhlTq_Nm VTQD_NewDistRrWhlTq_Nm VTQD_NewFrRatio_rat VTQD_NewRrRatio_rat VTQD_RrTMEnOutpTq_flg VTQD_TMEnOutpTqSta_enum /end REF_MEASUREMENT
/end GROUP
/begin GROUP S2037_SR_Latch "SWC_FDC_type/run_SWC_FDC_RxTx_5ms_sys/APP/TQR/Determine Torque Request/TorqueArbitrament/InverseAndTurnToMotorToq/SR_Latch" /begin REF_MEASUREMENT VTQR_FrGearChange_flg /end REF_MEASUREMENT /end GROUP
/begin GROUP S2037_SR_Latch1 "SWC_FDC_type/run_SWC_FDC_RxTx_5ms_sys/APP/TQR/Determine Torque Request/TorqueArbitrament/InverseAndTurnToMotorToq/SR_Latch1" /begin REF_MEASUREMENT VTQR_RrGearChange_flg /end REF_MEASUREMENT /end GROUP
/begin GROUP S2038_SR_Latch3 "SWC_FDC_type/run_SWC_FDC_RxTx_5ms_sys/APP/TQR/Determine Torque Request/TorqueArbitrament/RampEnableJudge/SR_Latch3" /begin REF_MEASUREMENT VTQR_ADASCancelBRgnRampF_flg /end REF_MEASUREMENT /end GROUP
/begin GROUP S2038_SR_Latch4 "SWC_FDC_type/run_SWC_FDC_RxTx_5ms_sys/APP/TQR/Determine Torque Request/TorqueArbitrament/RampEnableJudge/SR_Latch4" /begin REF_MEASUREMENT VTQR_ADASCancelBRgnRampR_flg /end REF_MEASUREMENT /end GROUP
/begin GROUP S2039_FirstOrderFilter "SWC_FDC_type/run_SWC_FDC_RxTx_5ms_sys/APP/TQR/Determine Torque Request/TorqueArbitrament/TorqueSmooth/FirstOrderFilter" /begin REF_MEASUREMENT VTQR_FrFirstOrderOutTq_Nm /end REF_MEASUREMENT /end GROUP
/begin GROUP S2039_FirstOrderFilter1 "SWC_FDC_type/run_SWC_FDC_RxTx_5ms_sys/APP/TQR/Determine Torque Request/TorqueArbitrament/TorqueSmooth/FirstOrderFilter1" /begin REF_MEASUREMENT VTQR_RrFirstOrderOutTq_Nm /end REF_MEASUREMENT /end GROUP
/begin GROUP S2039_Front_First_order_filter_input_tau_map_and_determination "SWC_FDC_type/run_SWC_FDC_RxTx_5ms_sys/APP/TQR/Determine Torque Request/TorqueArbitrament/TorqueSmooth/Front First order filter input tau map and determination"
 /begin SUB_GROUP S2056_SR_Latch1 S2056_VTQR_ECOFEDUTs_c S2056_VTQR_ESCAPEFEDUTs_c S2056_VTQR_LHMFEDUTs_c S2056_VTQR_NORMALFEDUTs_c S2056_VTQR_SNOWFEDUTs_c S2056_VTQR_SPORTFEDUTs_c S2056_VTQR_TCSFEDUTs_c /end SUB_GROUP
 /begin REF_CHARACTERISTIC KTQR_ARegenLatchEnTq_Nm KTQR_DriveModeCMDTqDev_Nm KTQR_DriveModeChangeTq_Nm KTQR_PreLoadPreEnTs_c KTQR_PreLoadTs_c KTQR_TIPOutTsAPS_pct KTQR_TIPOutTsSpd_kph MTQR_AltRDCActiveFEDUTs_Z_c MTQR_CreepFEDUTs_Z_c MTQR_FEDUTIPOutTs_Y_c MTQR_VMCFEDUTs_Z_c /end REF_CHARACTERISTIC
 /begin REF_MEASUREMENT VTQR_CreepFEDUTs_c VTQR_FEDUTIPOutTs_c VTQR_FEDUTs_c VTQR_FrFirstOrderInpTs_c VTQR_FrRDCActiveTs_flg VTQR_RDCActiveFEDUTs_c VTQR_VMCFEDUTs_c /end REF_MEASUREMENT
/end GROUP
/begin GROUP S2039_Front_Torque_zero_point_transfer_boundary_map "SWC_FDC_type/run_SWC_FDC_RxTx_5ms_sys/APP/TQR/Determine Torque Request/TorqueArbitrament/TorqueSmooth/Front Torque zero point transfer boundary map"
 /begin SUB_GROUP S2057_EcoLow S2057_EcoUP S2057_NormalLow S2057_NormalUP S2057_SportLow S2057_SportUP /end SUB_GROUP
 /begin REF_MEASUREMENT VTQR_FrTqZeroTransLowBound_Nm VTQR_FrTqZeroTransUpBound_Nm /end REF_MEASUREMENT
/end GROUP
/begin GROUP S2039_Front_Torque_zero_point_transfer_status_determination_ "SWC_FDC_type/run_SWC_FDC_RxTx_5ms_sys/APP/TQR/Determine Torque Request/TorqueArbitrament/TorqueSmooth/Front Torque zero point transfer status determination "
 /begin REF_CHARACTERISTIC KTQR_CreepZeroTransSW_flg KTQR_OPDNoZeroTransSpd_kph KTQR_OPDNoZeroTransTq_Nm /end REF_CHARACTERISTIC
 /begin REF_MEASUREMENT VTQR_FrTqZeroTrans_enum /end REF_MEASUREMENT
/end GROUP
/begin GROUP S2039_Front_torque_ramp_limtation_and_determination "SWC_FDC_type/run_SWC_FDC_RxTx_5ms_sys/APP/TQR/Determine Torque Request/TorqueArbitrament/TorqueSmooth/Front torque ramp limtation and determination" /begin SUB_GROUP S2059_SR_Latch S2059_SR_Latch1 S2059_Timer /end SUB_GROUP
 /begin REF_CHARACTERISTIC KTQD_TireRadius_m KTQR_FEDUTrqUpLimSW_flg KTQR_FShaftSpdDevTs_c KTQR_FShaftSpdTqCoeLimLow_c KTQR_FTimerTqCoeLimLow_c KTQR_RgnShaftSpdProtSW_flg KTQR_ShaftSpdDevTime_s KTQR_StartTimerShaftDev_rpm MTQR_FShaftSpdTqLimCoe_Y_c MTQR_FTimerTqLimCoe_Y_c /end REF_CHARACTERISTIC
 /begin REF_MEASUREMENT VTQR_ActFEDUTrqLowLim_Nm VTQR_ActFEDUTrqUpLim_Nm VTQR_ActFShaftSpdDev_rpm VTQR_CalFEDUTrqUpLim_Nm VTQR_CoorFEDUTrqUpLim_Nm VTQR_FShaftSpdTqLimCoe_c VTQR_FTimerTqLimCoe_c VTQR_FWheelShaftSpdDev_rpm VTQR_InitFShaftSpdTqLimCoe_c VTQR_InitFTimerTqLimCoe_c VTQR_LFWheelShaftSpd_rpm VTQR_RFWheelShaftSpd_rpm /end REF_MEASUREMENT
/end GROUP
/begin GROUP S2039_Front_wheel_first_order_filter_input_torque_command_determination "SWC_FDC_type/run_SWC_FDC_RxTx_5ms_sys/APP/TQR/Determine Torque Request/TorqueArbitrament/TorqueSmooth/Front wheel first order filter input torque command determination" /begin REF_MEASUREMENT VTQR_FrActRampTqDem_Nm VTQR_FrFirstOrderInpTq_Nm /end REF_MEASUREMENT /end GROUP
/begin GROUP S2039_Front_wheel_rate_limit_determination "SWC_FDC_type/run_SWC_FDC_RxTx_5ms_sys/APP/TQR/Determine Torque Request/TorqueArbitrament/TorqueSmooth/Front wheel rate limit determination"
 /begin SUB_GROUP S2061_Negative_Rate_limit_Determination S2061_Positive_Rate_limit_Determination S2061_VTQR_ECOFEDURateLimitDec_Nm S2061_VTQR_ECOFEDURateLimitInc_Nm S2061_VTQR_ESCAPEFEDURateLimitDec_Nm S2061_VTQR_ESCAPEFEDURateLimitInc_Nm S2061_VTQR_LHMFEDURateLimitDec_Nm S2061_VTQR_LHMFEDURateLimitInc_Nm S2061_VTQR_NORMALFEDURateLimitDec_Nm S2061_VTQR_NORMALFEDURateLimitInc_Nm S2061_VTQR_SNOWFEDURateLimitDec_Nm S2061_VTQR_SNOWFEDURateLimitInc_Nm S2061_VTQR_SPORTFEDURateLimitDec_Nm S2061_VTQR_SPORTFEDURateLimitInc_Nm S2061_VTQR_TCSFEDURateLimitDec_Nm S2061_VTQR_TCSFEDURateLimitInc_Nm /end SUB_GROUP
 /begin REF_CHARACTERISTIC KTQR_ARegenLatchEnTq_Nm KTQR_DriveModeCMDTqDev_Nm KTQR_DriveModeChangeTq_Nm KTQR_RegenTqLimitDecSW_flg MTQR_AltRDCActiveFEDUInc_Z_Nm MTQR_CreepFEDUTqDecSR_Z_Nm MTQR_CreepFEDUTqIncSR_Z_Nm MTQR_FrPreLoadTqDecSR_Z_Nm MTQR_FrPreLoadTqIncSR_Z_Nm MTQR_VMCFEDUTqDecSR_Z_Nm MTQR_VMCFEDUTqIncSR_Z_Nm /end REF_CHARACTERISTIC
 /begin REF_MEASUREMENT VTQR_CreepFEDUTqDecSR_Nm VTQR_CreepFEDUTqIncSR_Nm VTQR_FEDURateLimitDec_Nm VTQR_FEDURateLimitInc_Nm VTQR_FrDrModChangeReset_flg VTQR_FrPreLoadTqDecSR_Nm VTQR_FrPreLoadTqIncSR_Nm VTQR_FrRDCActRateLimitInc_flg VTQR_FrRateLimitDec_Nm VTQR_FrRateLimitInc_Nm VTQR_RDCActiveFEDUInc_Nm VTQR_VMCFEDUTqDecSR_Nm VTQR_VMCFEDUTqIncSR_Nm /end REF_MEASUREMENT
/end GROUP
/begin GROUP S2039_Limit "SWC_FDC_type/run_SWC_FDC_RxTx_5ms_sys/APP/TQR/Determine Torque Request/TorqueArbitrament/TorqueSmooth/Limit" /begin REF_MEASUREMENT VTQR_RampFEDUWhlTqReq_Nm /end REF_MEASUREMENT /end GROUP
/begin GROUP S2039_Limit2 "SWC_FDC_type/run_SWC_FDC_RxTx_5ms_sys/APP/TQR/Determine Torque Request/TorqueArbitrament/TorqueSmooth/Limit2" /begin REF_MEASUREMENT VTQR_RampREDUWhlTqReq_Nm /end REF_MEASUREMENT /end GROUP
/begin GROUP S2039_RateLimit "SWC_FDC_type/run_SWC_FDC_RxTx_5ms_sys/APP/TQR/Determine Torque Request/TorqueArbitrament/TorqueSmooth/RateLimit" /begin REF_MEASUREMENT VTQR_FEDUWhlTqReqSmooth_Nm /end REF_MEASUREMENT /end GROUP
/begin GROUP S2039_RateLimit1 "SWC_FDC_type/run_SWC_FDC_RxTx_5ms_sys/APP/TQR/Determine Torque Request/TorqueArbitrament/TorqueSmooth/RateLimit1" /begin REF_MEASUREMENT VTQR_REDUWhlTqReqSmooth_Nm /end REF_MEASUREMENT /end GROUP
/begin GROUP S2039_Rear_First_order_filter_input_tau_map_and_determination "SWC_FDC_type/run_SWC_FDC_RxTx_5ms_sys/APP/TQR/Determine Torque Request/TorqueArbitrament/TorqueSmooth/Rear First order filter input tau map and determination"
 /begin SUB_GROUP S2066_SR_Latch1 S2066_VTQR_ECOREDUTs_c S2066_VTQR_ESCAPEREDUTs_c S2066_VTQR_LHMREDUTs_c S2066_VTQR_NORMALREDUTs_c S2066_VTQR_SNOWREDUTs_c S2066_VTQR_SPORTREDUTs_c S2066_VTQR_TCSREDUTs_c /end SUB_GROUP
 /begin REF_CHARACTERISTIC KTQR_ARegenLatchEnTq_Nm KTQR_DriveModeCMDTqDev_Nm KTQR_DriveModeChangeTq_Nm KTQR_PreLoadPreEnTs_c KTQR_PreLoadTs_c KTQR_TIPOutTsAPS_pct KTQR_TIPOutTsSpd_kph MTQR_AltRDCActiveREDUTs_Z_c MTQR_CreepREDUTs_Z_c MTQR_REDUTIPOutTs_Y_c MTQR_VMCREDUTs_Z_c /end REF_CHARACTERISTIC
 /begin REF_MEASUREMENT VTQR_CreepREDUTs_c VTQR_RDCActiveREDUTs_c VTQR_REDUTIPOutTs_c VTQR_REDUTs_c VTQR_RrFirstOrderInpTs_c VTQR_RrRDCActiveTs_flg VTQR_VMCREDUTs_c /end REF_MEASUREMENT
/end GROUP
/begin GROUP S2039_Rear_Torque_zero_point_transfer_boundary_map "SWC_FDC_type/run_SWC_FDC_RxTx_5ms_sys/APP/TQR/Determine Torque Request/TorqueArbitrament/TorqueSmooth/Rear Torque zero point transfer boundary map"
 /begin SUB_GROUP S2067_EcoLow S2067_EcoUP S2067_NormalLow S2067_NormalUP S2067_SportLow S2067_SportUP /end SUB_GROUP
 /begin REF_MEASUREMENT VTQR_RrTqZeroTransLowBound_Nm VTQR_RrTqZeroTransUpBound_Nm /end REF_MEASUREMENT
/end GROUP
/begin GROUP S2039_Rear_Torque_zero_point_transfer_status_determination_ "SWC_FDC_type/run_SWC_FDC_RxTx_5ms_sys/APP/TQR/Determine Torque Request/TorqueArbitrament/TorqueSmooth/Rear Torque zero point transfer status determination "
 /begin REF_CHARACTERISTIC KTQR_CreepZeroTransSW_flg KTQR_OPDNoZeroTransSpd_kph KTQR_OPDNoZeroTransTq_Nm /end REF_CHARACTERISTIC
 /begin REF_MEASUREMENT VTQR_RrTqZeroTrans_enum /end REF_MEASUREMENT
/end GROUP
/begin GROUP S2039_Rear_torque_ramp_limtation_and_determination "SWC_FDC_type/run_SWC_FDC_RxTx_5ms_sys/APP/TQR/Determine Torque Request/TorqueArbitrament/TorqueSmooth/Rear torque ramp limtation and determination" /begin SUB_GROUP S2069_SR_Latch S2069_SR_Latch1 S2069_Timer /end SUB_GROUP
 /begin REF_CHARACTERISTIC KTQD_TireRadius_m KTQR_REDUTrqUpLimSW_flg KTQR_RShaftSpdDevTs_c KTQR_RShaftSpdTqCoeLimLow_c KTQR_RTimerTqCoeLimLow_c KTQR_RgnShaftSpdProtSW_flg KTQR_ShaftSpdDevTime_s KTQR_StartTimerShaftDev_rpm MTQR_RShaftSpdTqLimCoe_Y_c MTQR_RTimerTqLimCoe_Y_c /end REF_CHARACTERISTIC
 /begin REF_MEASUREMENT VTQR_ActREDUTrqLowLim_Nm VTQR_ActREDUTrqUpLim_Nm VTQR_ActRShaftSpdDev_rpm VTQR_CalREDUTrqUpLim_Nm VTQR_CoorREDUTrqUpLim_Nm VTQR_InitRShaftSpdTqLimCoe_c VTQR_InitRTimerTqLimCoe_c VTQR_LRWheelShaftSpd_rpm VTQR_RRWheelShaftSpd_rpm VTQR_RShaftSpdTqLimCoe_c VTQR_RTimerTqLimCoe_c VTQR_RWheelShaftSpdDev_rpm /end REF_MEASUREMENT
/end GROUP
/begin GROUP S2039_Rear_wheel_first_order_filter_input_torque_command_determination "SWC_FDC_type/run_SWC_FDC_RxTx_5ms_sys/APP/TQR/Determine Torque Request/TorqueArbitrament/TorqueSmooth/Rear wheel first order filter input torque command determination" /begin REF_MEASUREMENT VTQR_RrActRampTqDem_Nm VTQR_RrFirstOrderInpTq_Nm /end REF_MEASUREMENT /end GROUP
/begin GROUP S2039_Rear_wheel_rate_limit_determination1 "SWC_FDC_type/run_SWC_FDC_RxTx_5ms_sys/APP/TQR/Determine Torque Request/TorqueArbitrament/TorqueSmooth/Rear wheel rate limit determination1"
 /begin SUB_GROUP S2071_Negative_Rate_limit_Determination S2071_Positive_Rate_limit_Determination S2071_VTQR_ECOREDURateLimitDec_Nm S2071_VTQR_ECOREDURateLimitInc_Nm S2071_VTQR_ESCAPEREDURateLimitDec_Nm S2071_VTQR_ESCAPEREDURateLimitInc_Nm S2071_VTQR_LHMREDURateLimitDec_Nm S2071_VTQR_LHMREDURateLimitInc_Nm S2071_VTQR_NORMALREDURateLimitDec_Nm S2071_VTQR_NORMALREDURateLimitInc_Nm S2071_VTQR_SNOWREDURateLimitDec_Nm S2071_VTQR_SNOWREDURateLimitInc_Nm S2071_VTQR_SPORTREDURateLimitDec_Nm S2071_VTQR_SPORTREDURateLimitInc_Nm S2071_VTQR_TCSREDURateLimitDec_Nm S2071_VTQR_TCSREDURateLimitInc_Nm /end SUB_GROUP
 /begin REF_CHARACTERISTIC KTQR_ACCHoldPdovrdGrade_Deg KTQR_ACCHoldPdovrdInc_Nm KTQR_ACCHoldPdovrdSW_flg KTQR_ACCHoldPdovrdVeh_kph KTQR_ARegenLatchEnTq_Nm KTQR_DriveModeCMDTqDev_Nm KTQR_DriveModeChangeTq_Nm KTQR_RegenTqLimitDecSW_flg MTQR_AltRDCActiveREDUInc_Z_Nm MTQR_CreepREDUTqDecSR_Z_Nm MTQR_CreepREDUTqIncSR_Z_Nm MTQR_RrPreLoadTqDecSR_Z_Nm MTQR_RrPreLoadTqIncSR_Z_Nm MTQR_VMCREDUTqDecSR_Z_Nm MTQR_VMCREDUTqIncSR_Z_Nm /end REF_CHARACTERISTIC
 /begin REF_MEASUREMENT VTQR_ACCHoldPdovrdInc_flg VTQR_CreepREDUTqDecSR_Nm VTQR_CreepREDUTqIncSR_Nm VTQR_OriREDURateLimitInc_Nm VTQR_RDCActiveREDUInc_Nm VTQR_REDURateLimitDec_Nm VTQR_REDURateLimitInc_Nm VTQR_RrDrModChangeReset_flg VTQR_RrPreLoadTqDecSR_Nm VTQR_RrPreLoadTqIncSR_Nm VTQR_RrRDCActRateLimitInc_flg VTQR_RrRateLimitDec_Nm VTQR_RrRateLimitInc_Nm VTQR_VMCREDUTqDecSR_Nm VTQR_VMCREDUTqIncSR_Nm /end REF_MEASUREMENT
/end GROUP
/begin GROUP S2323_FirstOrderFilter6 "SWC_FDC_type/run_SWC_FDC_RxTx_5ms_sys/APP/VMC/VMC/ACC_Function/ACC Torque Source Determination/FirstOrderFilter6" /begin REF_MEASUREMENT VVMC_ESCLongAccelFilt_Gps /end REF_MEASUREMENT /end GROUP
/begin GROUP S2323_SR_Latch "SWC_FDC_type/run_SWC_FDC_RxTx_5ms_sys/APP/VMC/VMC/ACC_Function/ACC Torque Source Determination/SR_Latch" /begin REF_MEASUREMENT VVMC_ACCPedalTqEnOvrd_flg /end REF_MEASUREMENT /end GROUP
/begin GROUP S2323_SR_Latch1 "SWC_FDC_type/run_SWC_FDC_RxTx_5ms_sys/APP/VMC/VMC/ACC_Function/ACC Torque Source Determination/SR_Latch1" /begin REF_MEASUREMENT VVMC_ACCOvrdBackDrTq_flg /end REF_MEASUREMENT /end GROUP
/begin GROUP S2323_SR_Latch2 "SWC_FDC_type/run_SWC_FDC_RxTx_5ms_sys/APP/VMC/VMC/ACC_Function/ACC Torque Source Determination/SR_Latch2" /begin REF_MEASUREMENT VVMC_ACCActivePedalOn_flg /end REF_MEASUREMENT /end GROUP
/begin GROUP S2323_Triggered_Subsystem2 "SWC_FDC_type/run_SWC_FDC_RxTx_5ms_sys/APP/VMC/VMC/ACC_Function/ACC Torque Source Determination/Triggered Subsystem2" /begin REF_MEASUREMENT VVMC_ACCOvrdMemTq_Nm /end REF_MEASUREMENT /end GROUP
/begin GROUP S2324_SR_Latch "SWC_FDC_type/run_SWC_FDC_RxTx_5ms_sys/APP/VMC/VMC/ACC_Function/ACC Wheel Torque Calculation/SR_Latch" /begin REF_MEASUREMENT VVMC_HillUpHoldReqEn_flg /end REF_MEASUREMENT /end GROUP
/begin GROUP S2324_SR_Latch1 "SWC_FDC_type/run_SWC_FDC_RxTx_5ms_sys/APP/VMC/VMC/ACC_Function/ACC Wheel Torque Calculation/SR_Latch1" /begin REF_MEASUREMENT VVMC_HillUpESCStaEn_flg /end REF_MEASUREMENT /end GROUP
/begin GROUP S2324_SR_Latch10 "SWC_FDC_type/run_SWC_FDC_RxTx_5ms_sys/APP/VMC/VMC/ACC_Function/ACC Wheel Torque Calculation/SR_Latch10" /begin REF_MEASUREMENT VVMC_ZCNegDetEn_flg /end REF_MEASUREMENT /end GROUP
/begin GROUP S2324_SR_Latch11 "SWC_FDC_type/run_SWC_FDC_RxTx_5ms_sys/APP/VMC/VMC/ACC_Function/ACC Wheel Torque Calculation/SR_Latch11" /begin REF_MEASUREMENT VVMC_ZCPosDetEn_flg /end REF_MEASUREMENT /end GROUP
/begin GROUP S2324_SR_Latch12 "SWC_FDC_type/run_SWC_FDC_RxTx_5ms_sys/APP/VMC/VMC/ACC_Function/ACC Wheel Torque Calculation/SR_Latch12" /begin REF_MEASUREMENT VVMC_ZCNegCtrlEn_flg /end REF_MEASUREMENT /end GROUP
/begin GROUP S2324_SR_Latch13 "SWC_FDC_type/run_SWC_FDC_RxTx_5ms_sys/APP/VMC/VMC/ACC_Function/ACC Wheel Torque Calculation/SR_Latch13" /begin REF_MEASUREMENT VVMC_ZCPosCtrlEn_flg /end REF_MEASUREMENT /end GROUP
/begin GROUP S2324_SR_Latch14 "SWC_FDC_type/run_SWC_FDC_RxTx_5ms_sys/APP/VMC/VMC/ACC_Function/ACC Wheel Torque Calculation/SR_Latch14" /begin REF_MEASUREMENT VVMC_HoldTqCalEn_flg /end REF_MEASUREMENT /end GROUP
/begin GROUP S2324_SR_Latch15 "SWC_FDC_type/run_SWC_FDC_RxTx_5ms_sys/APP/VMC/VMC/ACC_Function/ACC Wheel Torque Calculation/SR_Latch15" /begin REF_MEASUREMENT VVMC_HoldTqCalSpd1Det_flg /end REF_MEASUREMENT /end GROUP
/begin GROUP S2324_SR_Latch16 "SWC_FDC_type/run_SWC_FDC_RxTx_5ms_sys/APP/VMC/VMC/ACC_Function/ACC Wheel Torque Calculation/SR_Latch16" /begin REF_MEASUREMENT VVMC_HoldTqAddDis_flg /end REF_MEASUREMENT /end GROUP
/begin GROUP S2324_SR_Latch2 "SWC_FDC_type/run_SWC_FDC_RxTx_5ms_sys/APP/VMC/VMC/ACC_Function/ACC Wheel Torque Calculation/SR_Latch2" /begin REF_MEASUREMENT VVMC_HoldNoMCP_flg /end REF_MEASUREMENT /end GROUP
/begin GROUP S2324_SR_Latch3 "SWC_FDC_type/run_SWC_FDC_RxTx_5ms_sys/APP/VMC/VMC/ACC_Function/ACC Wheel Torque Calculation/SR_Latch3" /begin REF_MEASUREMENT VVMC_RgnProhibited_flg /end REF_MEASUREMENT /end GROUP
/begin GROUP S2324_SR_Latch4 "SWC_FDC_type/run_SWC_FDC_RxTx_5ms_sys/APP/VMC/VMC/ACC_Function/ACC Wheel Torque Calculation/SR_Latch4" /begin REF_MEASUREMENT VVMC_ZeroRgnTqSpdCtrl_flg /end REF_MEASUREMENT /end GROUP
/begin GROUP S2324_SR_Latch5 "SWC_FDC_type/run_SWC_FDC_RxTx_5ms_sys/APP/VMC/VMC/ACC_Function/ACC Wheel Torque Calculation/SR_Latch5" /begin REF_MEASUREMENT VVMC_ACCLowSpdFollowESCTq_flg /end REF_MEASUREMENT /end GROUP
/begin GROUP S2324_SR_Latch6 "SWC_FDC_type/run_SWC_FDC_RxTx_5ms_sys/APP/VMC/VMC/ACC_Function/ACC Wheel Torque Calculation/SR_Latch6" /begin REF_MEASUREMENT VVMC_ACCLowSpdTqCtrl_flg /end REF_MEASUREMENT /end GROUP
/begin GROUP S2324_SR_Latch8 "SWC_FDC_type/run_SWC_FDC_RxTx_5ms_sys/APP/VMC/VMC/ACC_Function/ACC Wheel Torque Calculation/SR_Latch8" /begin REF_MEASUREMENT VVMC_HoldResTqEn_flg /end REF_MEASUREMENT /end GROUP
/begin GROUP S2324_Triggered_Subsystem "SWC_FDC_type/run_SWC_FDC_RxTx_5ms_sys/APP/VMC/VMC/ACC_Function/ACC Wheel Torque Calculation/Triggered Subsystem" /begin REF_MEASUREMENT VVMC_ZeroSpdEnTMSpd_rpm /end REF_MEASUREMENT /end GROUP
/begin GROUP S2324_Triggered_Subsystem1 "SWC_FDC_type/run_SWC_FDC_RxTx_5ms_sys/APP/VMC/VMC/ACC_Function/ACC Wheel Torque Calculation/Triggered Subsystem1" /begin REF_MEASUREMENT VVMC_ACCLowSpdCtrlEnSpd_kph VVMC_ACCLowSpdTqLimit_Nm /end REF_MEASUREMENT /end GROUP
/begin GROUP S2324_Triggered_Subsystem4 "SWC_FDC_type/run_SWC_FDC_RxTx_5ms_sys/APP/VMC/VMC/ACC_Function/ACC Wheel Torque Calculation/Triggered Subsystem4" /begin REF_MEASUREMENT VVMC_ZeroRgnTqSpdCtrlTq_Nm /end REF_MEASUREMENT /end GROUP
/begin GROUP S2324_Triggered_Subsystem5 "SWC_FDC_type/run_SWC_FDC_RxTx_5ms_sys/APP/VMC/VMC/ACC_Function/ACC Wheel Torque Calculation/Triggered Subsystem5" /begin REF_MEASUREMENT VVMC_HoldTqCalSpd1Gx_Gps VVMC_HoldTqCalSpd1Tq_Nm /end REF_MEASUREMENT /end GROUP
/begin GROUP S2324_Triggered_Subsystem6 "SWC_FDC_type/run_SWC_FDC_RxTx_5ms_sys/APP/VMC/VMC/ACC_Function/ACC Wheel Torque Calculation/Triggered Subsystem6" /begin REF_MEASUREMENT VVMC_HoldTqCalSpd2Gx_Gps VVMC_HoldTqCalSpd2Tq_Nm /end REF_MEASUREMENT /end GROUP
/begin GROUP S2324_divide "SWC_FDC_type/run_SWC_FDC_RxTx_5ms_sys/APP/VMC/VMC/ACC_Function/ACC Wheel Torque Calculation/divide" /begin REF_MEASUREMENT VVMC_HoldTqGxRat_raw32 /end REF_MEASUREMENT /end GROUP
/begin GROUP S2396_DelayEnable "SWC_FDC_type/run_SWC_FDC_RxTx_5ms_sys/APP/VMC/VMC/APS function/CAAS HandShake/DelayEnable" /begin REF_MEASUREMENT VVMC_CAASCtrlAvail_flg /end REF_MEASUREMENT /end GROUP
/begin GROUP S2398_DelayEnable "SWC_FDC_type/run_SWC_FDC_RxTx_5ms_sys/APP/VMC/VMC/APS function/Hand Shake/DelayEnable" /begin REF_MEASUREMENT VVMC_APSTqCtrlAllow_flg /end REF_MEASUREMENT /end GROUP
/begin GROUP S2398_DelayEnable1 "SWC_FDC_type/run_SWC_FDC_RxTx_5ms_sys/APP/VMC/VMC/APS function/Hand Shake/DelayEnable1" /begin REF_MEASUREMENT VVMC_APSShiftCtrlAllow_flg /end REF_MEASUREMENT /end GROUP
/begin GROUP S2398_DelayEnable2 "SWC_FDC_type/run_SWC_FDC_RxTx_5ms_sys/APP/VMC/VMC/APS function/Hand Shake/DelayEnable2" /begin REF_MEASUREMENT VVMC_APSDoorCtrlAllow_flg /end REF_MEASUREMENT /end GROUP
/begin GROUP S2399_Signal_Determination_VINP_APSDecReqAtest_flg "SWC_FDC_type/run_SWC_FDC_RxTx_5ms_sys/APP/VMC/VMC/APS function/Signal Rounting/Signal Determination VINP_APSDecReqAtest_flg" /begin REF_CHARACTERISTIC KVMC_APSDevelopeSW_flg /end REF_CHARACTERISTIC /begin REF_MEASUREMENT VVMC_APSDecReqA_flg /end REF_MEASUREMENT /end GROUP
/begin GROUP S2399_Signal_Determination_VINP_APSDecReqtest_mps2 "SWC_FDC_type/run_SWC_FDC_RxTx_5ms_sys/APP/VMC/VMC/APS function/Signal Rounting/Signal Determination VINP_APSDecReqtest_mps2" /begin REF_CHARACTERISTIC KVMC_APSDevelopeSW_flg /end REF_CHARACTERISTIC /begin REF_MEASUREMENT VVMC_APSDecReq_mps2 /end REF_MEASUREMENT /end GROUP
/begin GROUP S2399_Signal_Determination_VINP_APSReqtest_enum "SWC_FDC_type/run_SWC_FDC_RxTx_5ms_sys/APP/VMC/VMC/APS function/Signal Rounting/Signal Determination VINP_APSReqtest_enum" /begin REF_CHARACTERISTIC KVMC_APSDevelopeSW_flg /end REF_CHARACTERISTIC /begin REF_MEASUREMENT VVMC_APSReq_enum /end REF_MEASUREMENT /end GROUP
/begin GROUP S2399_Signal_Determination_VINP_APSStaSystemtest_enum "SWC_FDC_type/run_SWC_FDC_RxTx_5ms_sys/APP/VMC/VMC/APS function/Signal Rounting/Signal Determination VINP_APSStaSystemtest_enum" /begin REF_CHARACTERISTIC KVMC_APSDevelopeSW_flg KVMC_APSStaSystemOvrd_flg /end REF_CHARACTERISTIC /begin REF_MEASUREMENT VVMC_APSStaSys_enum /end REF_MEASUREMENT /end GROUP
/begin GROUP S2414_SR_Latch "SWC_FDC_type/run_SWC_FDC_RxTx_5ms_sys/APP/VMC/VMC/CruiseControlFunction/CCTorqueSourceDetermination/SR_Latch" /begin REF_MEASUREMENT VVMC_CCPedalTqEnOvrd_flg /end REF_MEASUREMENT /end GROUP
/begin GROUP S2429_FirstOrderFilter1 "SWC_FDC_type/run_SWC_FDC_RxTx_5ms_sys/APP/VMC/VMC/IMU/IMU sensing result /FirstOrderFilter1" /begin REF_MEASUREMENT VVMC_CalibratedGyroX_Dps /end REF_MEASUREMENT /end GROUP
/begin GROUP S2429_FirstOrderFilter2 "SWC_FDC_type/run_SWC_FDC_RxTx_5ms_sys/APP/VMC/VMC/IMU/IMU sensing result /FirstOrderFilter2" /begin REF_MEASUREMENT VVMC_CalibratedGyroZ_Dps /end REF_MEASUREMENT /end GROUP
/begin GROUP S2429_FirstOrderFilter3 "SWC_FDC_type/run_SWC_FDC_RxTx_5ms_sys/APP/VMC/VMC/IMU/IMU sensing result /FirstOrderFilter3" /begin REF_MEASUREMENT VVMC_CalibratedAccZ_G /end REF_MEASUREMENT /end GROUP
/begin GROUP S2429_FirstOrderFilter4 "SWC_FDC_type/run_SWC_FDC_RxTx_5ms_sys/APP/VMC/VMC/IMU/IMU sensing result /FirstOrderFilter4" /begin REF_MEASUREMENT VVMC_CalibratedAccY_G /end REF_MEASUREMENT /end GROUP
/begin GROUP S2429_FirstOrderFilter5 "SWC_FDC_type/run_SWC_FDC_RxTx_5ms_sys/APP/VMC/VMC/IMU/IMU sensing result /FirstOrderFilter5" /begin REF_MEASUREMENT VVMC_CalibratedGyroY_Dps /end REF_MEASUREMENT /end GROUP
/begin GROUP S2429_FirstOrderFilter6 "SWC_FDC_type/run_SWC_FDC_RxTx_5ms_sys/APP/VMC/VMC/IMU/IMU sensing result /FirstOrderFilter6" /begin REF_MEASUREMENT VVMC_CalibratedAccX_G /end REF_MEASUREMENT /end GROUP
/begin GROUP S2446_FirstOrderFilter3 "SWC_FDC_type/run_SWC_FDC_RxTx_5ms_sys/APP/VMC/VMC/Long Acceleration Calculation/Estimate Slope1/FirstOrderFilter3" /begin REF_MEASUREMENT VVMC_CalibratedAccXAfter_G /end REF_MEASUREMENT /end GROUP
/begin GROUP S2446_FirstOrderFilter5 "SWC_FDC_type/run_SWC_FDC_RxTx_5ms_sys/APP/VMC/VMC/Long Acceleration Calculation/Estimate Slope1/FirstOrderFilter5" /begin REF_MEASUREMENT VVMC_CalEstSlope1_Deg /end REF_MEASUREMENT /end GROUP
/begin GROUP S2446_FirstOrderFilter6 "SWC_FDC_type/run_SWC_FDC_RxTx_5ms_sys/APP/VMC/VMC/Long Acceleration Calculation/Estimate Slope1/FirstOrderFilter6" /begin REF_MEASUREMENT VVMC_PitchIntegGrade_deg /end REF_MEASUREMENT /end GROUP
/begin GROUP S2446_FirstOrderFilter7 "SWC_FDC_type/run_SWC_FDC_RxTx_5ms_sys/APP/VMC/VMC/Long Acceleration Calculation/Estimate Slope1/FirstOrderFilter7" /begin REF_MEASUREMENT VVMC_CalibratedGyroYDevAfter_Dps /end REF_MEASUREMENT /end GROUP
/begin GROUP S2446_FirstOrderFilter8 "SWC_FDC_type/run_SWC_FDC_RxTx_5ms_sys/APP/VMC/VMC/Long Acceleration Calculation/Estimate Slope1/FirstOrderFilter8" /begin REF_MEASUREMENT VVMC_CalEstSlopeOfstA_Deg /end REF_MEASUREMENT /end GROUP
/begin GROUP S2446_SR_Latch "SWC_FDC_type/run_SWC_FDC_RxTx_5ms_sys/APP/VMC/VMC/Long Acceleration Calculation/Estimate Slope1/SR_Latch" /begin REF_MEASUREMENT VVMC_PitchGradeStopReset_flg /end REF_MEASUREMENT /end GROUP
/begin GROUP S2446_SR_Latch1 "SWC_FDC_type/run_SWC_FDC_RxTx_5ms_sys/APP/VMC/VMC/Long Acceleration Calculation/Estimate Slope1/SR_Latch1" /begin REF_MEASUREMENT VVMC_PitchGradeHiReset_flg /end REF_MEASUREMENT /end GROUP
/begin GROUP S2446_SR_Latch2 "SWC_FDC_type/run_SWC_FDC_RxTx_5ms_sys/APP/VMC/VMC/Long Acceleration Calculation/Estimate Slope1/SR_Latch2" /begin REF_MEASUREMENT VVMC_PitchGradeL2H_flg /end REF_MEASUREMENT /end GROUP
/begin GROUP S2446_SR_Latch3 "SWC_FDC_type/run_SWC_FDC_RxTx_5ms_sys/APP/VMC/VMC/Long Acceleration Calculation/Estimate Slope1/SR_Latch3" /begin REF_MEASUREMENT VVMC_PitchGradeH2L_flg /end REF_MEASUREMENT /end GROUP
/begin GROUP S2446_SR_Latch6 "SWC_FDC_type/run_SWC_FDC_RxTx_5ms_sys/APP/VMC/VMC/Long Acceleration Calculation/Estimate Slope1/SR_Latch6" /begin REF_MEASUREMENT VVMC_GradeShiftDelay_flg /end REF_MEASUREMENT /end GROUP
/begin GROUP S2446_Triggered_Subsystem "SWC_FDC_type/run_SWC_FDC_RxTx_5ms_sys/APP/VMC/VMC/Long Acceleration Calculation/Estimate Slope1/Triggered Subsystem" /begin REF_MEASUREMENT VVMC_BaseGrade_deg /end REF_MEASUREMENT /end GROUP
/begin GROUP S2490_SR_Latch5 "SWC_FDC_type/run_SWC_FDC_RxTx_5ms_sys/APP/VMC/VMC/MSA function/MSADemandTorqueCalculation/SR_Latch5" /begin REF_MEASUREMENT VVMC_MSATqDown_flg /end REF_MEASUREMENT /end GROUP
/begin GROUP S2490_Triggered_Subsystem "SWC_FDC_type/run_SWC_FDC_RxTx_5ms_sys/APP/VMC/VMC/MSA function/MSADemandTorqueCalculation/Triggered Subsystem" /begin REF_MEASUREMENT VVMC_MSATqDownEnTq_Nm /end REF_MEASUREMENT /end GROUP
/begin GROUP S2491_SR_Latch1 "SWC_FDC_type/run_SWC_FDC_RxTx_5ms_sys/APP/VMC/VMC/MSA function/MSATorqueSourceDetermination/SR_Latch1" /begin REF_MEASUREMENT VVMC_MSAOvrdAllow_flg /end REF_MEASUREMENT /end GROUP
/begin GROUP S2491_Triggered_Subsystem2 "SWC_FDC_type/run_SWC_FDC_RxTx_5ms_sys/APP/VMC/VMC/MSA function/MSATorqueSourceDetermination/Triggered Subsystem2" /begin REF_MEASUREMENT VVMC_MSAOvrdEnTq_Nm /end REF_MEASUREMENT /end GROUP
/begin GROUP S2524_DelayEnable1 "SWC_FDC_type/run_SWC_FDC_RxTx_5ms_sys/APP/VMC/VMC/RDC Determination/RWD/DelayEnable1" /begin REF_MEASUREMENT VVMC_RDCDetectEn_flg /end REF_MEASUREMENT /end GROUP
/begin GROUP S2524_DelayEnable2 "SWC_FDC_type/run_SWC_FDC_RxTx_5ms_sys/APP/VMC/VMC/RDC Determination/RWD/DelayEnable2" /begin REF_MEASUREMENT VVMC_AltRDCRec_flg /end REF_MEASUREMENT /end GROUP
/begin GROUP S2524_SR_Latch5 "SWC_FDC_type/run_SWC_FDC_RxTx_5ms_sys/APP/VMC/VMC/RDC Determination/RWD/SR_Latch5" /begin REF_MEASUREMENT VVMC_ESCActive_flg /end REF_MEASUREMENT /end GROUP
/begin GROUP S2532_DelayEnable "SWC_FDC_type/run_SWC_FDC_RxTx_5ms_sys/APP/VMC/VMC/SPD2ACC/Required_Acceleration/DelayEnable" /begin REF_MEASUREMENT VVMC_VHTMSpdPass_flg /end REF_MEASUREMENT /end GROUP
/begin GROUP S2532_SR_Latch1 "SWC_FDC_type/run_SWC_FDC_RxTx_5ms_sys/APP/VMC/VMC/SPD2ACC/Required_Acceleration/SR_Latch1" /begin REF_MEASUREMENT VVMC_VehHoldDecCtrlCalSW2_flg /end REF_MEASUREMENT /end GROUP
/begin GROUP S2532_SR_Latch10 "SWC_FDC_type/run_SWC_FDC_RxTx_5ms_sys/APP/VMC/VMC/SPD2ACC/Required_Acceleration/SR_Latch10" /begin REF_MEASUREMENT VVMC_HoldDelayAllow_flg /end REF_MEASUREMENT /end GROUP
/begin GROUP S2532_SR_Latch11 "SWC_FDC_type/run_SWC_FDC_RxTx_5ms_sys/APP/VMC/VMC/SPD2ACC/Required_Acceleration/SR_Latch11" /begin REF_MEASUREMENT VVMC_ACCShutOffHold_flg /end REF_MEASUREMENT /end GROUP
/begin GROUP S2532_SR_Latch12 "SWC_FDC_type/run_SWC_FDC_RxTx_5ms_sys/APP/VMC/VMC/SPD2ACC/Required_Acceleration/SR_Latch12" /begin REF_MEASUREMENT VVMC_VehHoldDecCtrlHEnd_flg /end REF_MEASUREMENT /end GROUP
/begin GROUP S2532_SR_Latch13 "SWC_FDC_type/run_SWC_FDC_RxTx_5ms_sys/APP/VMC/VMC/SPD2ACC/Required_Acceleration/SR_Latch13" /begin REF_MEASUREMENT VVMC_AccelTurnHold_flg /end REF_MEASUREMENT /end GROUP
/begin GROUP S2532_SR_Latch14 "SWC_FDC_type/run_SWC_FDC_RxTx_5ms_sys/APP/VMC/VMC/SPD2ACC/Required_Acceleration/SR_Latch14" /begin REF_MEASUREMENT VVMC_OVRD2ActRampActive_flg /end REF_MEASUREMENT /end GROUP
/begin GROUP S2532_SR_Latch15 "SWC_FDC_type/run_SWC_FDC_RxTx_5ms_sys/APP/VMC/VMC/SPD2ACC/Required_Acceleration/SR_Latch15" /begin REF_MEASUREMENT VVMC_VehHoldHTimeNoMCPDet_flg /end REF_MEASUREMENT /end GROUP
/begin GROUP S2532_SR_Latch16 "SWC_FDC_type/run_SWC_FDC_RxTx_5ms_sys/APP/VMC/VMC/SPD2ACC/Required_Acceleration/SR_Latch16" /begin REF_MEASUREMENT VVMC_ADSPosGFBPrvtLoSpd_flg /end REF_MEASUREMENT /end GROUP
/begin GROUP S2532_SR_Latch17 "SWC_FDC_type/run_SWC_FDC_RxTx_5ms_sys/APP/VMC/VMC/SPD2ACC/Required_Acceleration/SR_Latch17" /begin REF_MEASUREMENT VVMC_VehHoldDecCtrlBEnd_flg /end REF_MEASUREMENT /end GROUP
/begin GROUP S2532_SR_Latch18 "SWC_FDC_type/run_SWC_FDC_RxTx_5ms_sys/APP/VMC/VMC/SPD2ACC/Required_Acceleration/SR_Latch18" /begin REF_MEASUREMENT VVMC_ADSPosGFBPrevent_flg /end REF_MEASUREMENT /end GROUP
/begin GROUP S2532_SR_Latch2 "SWC_FDC_type/run_SWC_FDC_RxTx_5ms_sys/APP/VMC/VMC/SPD2ACC/Required_Acceleration/SR_Latch2" /begin REF_MEASUREMENT VVMC_VehHoldMCPPass_flg /end REF_MEASUREMENT /end GROUP
/begin GROUP S2532_SR_Latch20 "SWC_FDC_type/run_SWC_FDC_RxTx_5ms_sys/APP/VMC/VMC/SPD2ACC/Required_Acceleration/SR_Latch20" /begin REF_MEASUREMENT VVMC_VHJerkPrvtHold_flg /end REF_MEASUREMENT /end GROUP
/begin GROUP S2532_SR_Latch3 "SWC_FDC_type/run_SWC_FDC_RxTx_5ms_sys/APP/VMC/VMC/SPD2ACC/Required_Acceleration/SR_Latch3" /begin REF_MEASUREMENT VVMC_ReqBrkJoin_flg /end REF_MEASUREMENT /end GROUP
/begin GROUP S2532_SR_Latch4 "SWC_FDC_type/run_SWC_FDC_RxTx_5ms_sys/APP/VMC/VMC/SPD2ACC/Required_Acceleration/SR_Latch4" /begin REF_MEASUREMENT VVMC_ACCSpdCtrl_flg /end REF_MEASUREMENT /end GROUP
/begin GROUP S2532_SR_Latch5 "SWC_FDC_type/run_SWC_FDC_RxTx_5ms_sys/APP/VMC/VMC/SPD2ACC/Required_Acceleration/SR_Latch5" /begin REF_MEASUREMENT VVMC_ZeroSpdHoldAllow_flg /end REF_MEASUREMENT /end GROUP
/begin GROUP S2532_SR_Latch9 "SWC_FDC_type/run_SWC_FDC_RxTx_5ms_sys/APP/VMC/VMC/SPD2ACC/Required_Acceleration/SR_Latch9" /begin REF_MEASUREMENT VVMC_ReqBrkJoinSRActive_flg /end REF_MEASUREMENT /end GROUP
/begin GROUP S2532_Triggered_Subsystem "SWC_FDC_type/run_SWC_FDC_RxTx_5ms_sys/APP/VMC/VMC/SPD2ACC/Required_Acceleration/Triggered Subsystem" /begin REF_CHARACTERISTIC KVMC_ReqBrkInDecSRTime_s /end REF_CHARACTERISTIC /begin REF_MEASUREMENT VVMC_ReqBrkInDecFixSR_mps3 /end REF_MEASUREMENT /end GROUP
/begin GROUP S2532_Triggered_Subsystem4 "SWC_FDC_type/run_SWC_FDC_RxTx_5ms_sys/APP/VMC/VMC/SPD2ACC/Required_Acceleration/Triggered Subsystem4" /begin REF_MEASUREMENT VVMC_ACCReqSpdMemory_kph /end REF_MEASUREMENT /end GROUP
/begin GROUP S2532_Triggered_Subsystem6 "SWC_FDC_type/run_SWC_FDC_RxTx_5ms_sys/APP/VMC/VMC/SPD2ACC/Required_Acceleration/Triggered Subsystem6" /begin REF_MEASUREMENT VVMC_VehHoldEnActAccel_mps2 VVMC_VehHoldEnSpd_kph /end REF_MEASUREMENT /end GROUP
/begin GROUP S2586_FirstOrderFilter7 "SWC_FDC_type/run_SWC_FDC_RxTx_5ms_sys/APP/VMC/VMC/SafetyControl/ADB_VehPitchAngleSta/FirstOrderFilter7" /begin REF_MEASUREMENT VVMC_CalEstPitchAngle_deg /end REF_MEASUREMENT /end GROUP
/begin GROUP S2586_SR_Latch4 "SWC_FDC_type/run_SWC_FDC_RxTx_5ms_sys/APP/VMC/VMC/SafetyControl/ADB_VehPitchAngleSta/SR_Latch4" /begin REF_MEASUREMENT VVMC_VehPitchAngleUpdCond_flg /end REF_MEASUREMENT /end GROUP
/begin GROUP S2594_Estimate_Slope "SWC_FDC_type/run_SWC_FDC_RxTx_5ms_sys/APP/VMC/VMC/SafetyControl/LongAccel_EstSlope_FrontRearSlipSpd/Estimate Slope" /begin REF_CHARACTERISTIC KVMC_EstSlopeLongAccelTs_c KVMC_EstSlopeVehSpdTs_c /end REF_CHARACTERISTIC /begin REF_MEASUREMENT VVMC_EstSlopeCal_Deg /end REF_MEASUREMENT /end GROUP
/begin GROUP S2596_FrontRearSlipRatio "SWC_FDC_type/run_SWC_FDC_RxTx_5ms_sys/APP/VMC/VMC/SafetyControl/SafetyControlJudgement/FrontRearSlipRatio" /begin REF_CHARACTERISTIC KVMC_FrontRearSlipRatioTHR_kph /end REF_CHARACTERISTIC /end GROUP
/begin GROUP S2596_LateralAccelerationControl "SWC_FDC_type/run_SWC_FDC_RxTx_5ms_sys/APP/VMC/VMC/SafetyControl/SafetyControlJudgement/LateralAccelerationControl" /begin REF_CHARACTERISTIC KVMC_LatAccCtrlTHR_Gps /end REF_CHARACTERISTIC /end GROUP
/begin GROUP S2596_RearWheelSlipRatio "SWC_FDC_type/run_SWC_FDC_RxTx_5ms_sys/APP/VMC/VMC/SafetyControl/SafetyControlJudgement/RearWheelSlipRatio" /begin REF_CHARACTERISTIC KVMC_RearWhlSlipRatioTHR_kph /end REF_CHARACTERISTIC /end GROUP
/begin GROUP S2596_SafetyControlJudgement "SWC_FDC_type/run_SWC_FDC_RxTx_5ms_sys/APP/VMC/VMC/SafetyControl/SafetyControlJudgement/SafetyControlJudgement" /begin REF_CHARACTERISTIC KVMC_SafetyCtrlForACCSW_flg /end REF_CHARACTERISTIC /end GROUP
/begin GROUP S2596_SingleWheelSlipRatio "SWC_FDC_type/run_SWC_FDC_RxTx_5ms_sys/APP/VMC/VMC/SafetyControl/SafetyControlJudgement/SingleWheelSlipRatio" /begin REF_CHARACTERISTIC KVMC_SingleWhlSlipRatioTHR_kph /end REF_CHARACTERISTIC /end GROUP
/begin GROUP S2597_RateLimit1 "SWC_FDC_type/run_SWC_FDC_RxTx_5ms_sys/APP/VMC/VMC/SafetyControl/VehSpdRollingAverage/RateLimit1" /begin REF_MEASUREMENT VVMC_VehicleSpeedAftLim_kph /end REF_MEASUREMENT /end GROUP
/begin GROUP S1866_TMAvailablePwr_Calculation "SWC_FDC_type/run_SWC_FDC_RxTx_5ms_sys/APP/TQD/TorqueDemand/TorqueModule/AvaliableTqLimit/TorqueCapacityCalcalation/TMAvailablePwr_Calculation"
 /begin REF_CHARACTERISTIC KTQD_DCDCCalPwrAvailRsv_kW KTQD_THCMCalPwrAvailRsv_kW KTQD_TMPwrAvailDchrg_kW_ovrdflg /end REF_CHARACTERISTIC
/end GROUP
/begin GROUP S1875_If_Action_Subsystem1 "SWC_FDC_type/run_SWC_FDC_RxTx_5ms_sys/APP/TQD/TorqueDemand/TorqueModule/DriverWhlTqDem/Creep/If Action Subsystem1" /begin REF_CHARACTERISTIC KTQD_APSCreepParOvrd_flg /end REF_CHARACTERISTIC /end GROUP
/begin GROUP S1876_New_Preload_Torque "SWC_FDC_type/run_SWC_FDC_RxTx_5ms_sys/APP/TQD/TorqueDemand/TorqueModule/DriverWhlTqDem/DriverTqCoordination/New Preload Torque" /begin REF_CHARACTERISTIC KTQD_PreLoadTqHold_rpm /end REF_CHARACTERISTIC /end GROUP
/begin GROUP S1927_Torque_Calculation "SWC_FDC_type/run_SWC_FDC_RxTx_5ms_sys/APP/TQD/TorqueDemand/TorqueModule/DriverWhlTqDem/PedalMapWhlTq/Pedal G-Control Mode/Torque Calculation" /begin REF_CHARACTERISTIC KTQD_APSReqDelayTime_s /end REF_CHARACTERISTIC /end GROUP
/begin GROUP S1940_LUT_D_SnowMode "SWC_FDC_type/run_SWC_FDC_RxTx_5ms_sys/APP/TQD/TorqueDemand/TorqueModule/DriverWhlTqDem/PedalMapWhlTq/NoLHM/ShiftD/LUT_D_SnowMode" /begin REF_CHARACTERISTIC KTQD_PedalMapRDCUpLim_Nm /end REF_CHARACTERISTIC /end GROUP
/begin GROUP S1943_ECO_OnePedal_TqMap "SWC_FDC_type/run_SWC_FDC_RxTx_5ms_sys/APP/TQD/TorqueDemand/TorqueModule/DriverWhlTqDem/PedalMapWhlTq/NoLHM/ShiftD/LUT_D_ECO/ECO_OnePedal_TqMap" /begin REF_CHARACTERISTIC KTQD_APSReqDelayTime_s /end REF_CHARACTERISTIC /end GROUP
/begin GROUP S1945_NRM_OnePedal_TqMap "SWC_FDC_type/run_SWC_FDC_RxTx_5ms_sys/APP/TQD/TorqueDemand/TorqueModule/DriverWhlTqDem/PedalMapWhlTq/NoLHM/ShiftD/LUT_D_Normal/NRM_OnePedal_TqMap" /begin REF_CHARACTERISTIC KTQD_APSReqDelayTime_s /end REF_CHARACTERISTIC /end GROUP
/begin GROUP S1947_Sport_OnePedal_TqMap "SWC_FDC_type/run_SWC_FDC_RxTx_5ms_sys/APP/TQD/TorqueDemand/TorqueModule/DriverWhlTqDem/PedalMapWhlTq/NoLHM/ShiftD/LUT_D_Sport/Sport_OnePedal_TqMap" /begin REF_CHARACTERISTIC KTQD_APSReqDelayTime_s /end REF_CHARACTERISTIC /end GROUP
/end MODULE
/end PROJECT
