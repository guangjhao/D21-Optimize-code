AUTOSAR XML (schema 4-3-0)
package /CANInterface_ARPkg
  sender receiver interface IF_CAN1_SG_FD_VCU1
    data CAN1_SG_FD_VCU1: type=DT_CAN1_SG_FD_VCU1
