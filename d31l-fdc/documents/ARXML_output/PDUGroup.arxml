AUTOSAR XML (schema 4-3-0)
package /PduGroups
  10 x i signal i pdu group:
    FUSION_CAN1_Tx: communication-direction=OUT, communication-mode=CAN_Transmit_All
      i-signal-i-pdus:
        CAN1_FD_APS{1..3}
        CAN1_FD_BCM1
        CAN1_FD_THCM1
        CAN1_FD_VCU{1..4}
        CAN1_XNMm_FUSION
    FUSION_CAN1_Rx: communication-direction=IN, communication-mode=CAN_Receive_All
      i-signal-i-pdus:
        CAN1_ABM1
        CAN1_EPAS1
        CAN1_EPAS2
        CAN1_EPB1
        CAN1_ESC{1..7}
        CAN1_FCM{2..4}
        CAN1_SRR1
        CAN1_XNMm_ABM
        CAN1_XNMm_EPAS
        CAN1_XNMm_ESC
        CAN1_XNMm_FCM
        CAN1_XNMm_SRR_M
        CAN1_XNMm_eBST
    FUSION_CAN2_Tx: communication-direction=OUT, communication-mode=CAN_Transmit_All
      i-signal-i-pdus:
        CAN2_FD_APS{1..3}
        CAN2_FD_BCM1
        CAN2_FD_BCM2
        CAN2_FD_OTA1
        CAN2_FD_THCM1
        CAN2_FD_TPMS1
        CAN2_FD_TPMS2
        CAN2_FD_V2L1
        CAN2_FD_VCU{0..2}
        CAN2_FD_VCU{4..6}
        CAN2_FD_VMC1
        CAN2_XNMm_FUSION
    FUSION_CAN2_Rx: communication-direction=IN, communication-mode=CAN_Receive_All, i-signal-i-pdus=[CAN2_IVI1, CAN2_IVI2, CAN2_IVI6, CAN2_METER1, CAN2_XNMm_HMI, CAN2_XNMm_IVI, CAN2_XNMm_Telltale]
    FUSION_CAN3_Tx: communication-direction=OUT, communication-mode=CAN_Transmit_All
      i-signal-i-pdus:
        CAN3_FD_BCM1
        CAN3_FD_OTA1
        CAN3_FD_THCM1
        CAN3_FD_THCM2
        CAN3_FD_V2L1
        CAN3_FD_VCU{0..2}
        CAN3_XNMm_FUSION
    FUSION_CAN3_Rx: communication-direction=IN, communication-mode=CAN_Receive_All
      i-signal-i-pdus:
        CAN3_BMS{1..4}
        CAN3_BMS6
        CAN3_BMS7
        CAN3_CCU1
        CAN3_CCU2
        CAN3_CCU4
        CAN3_MCU_F1
        CAN3_MCU_F2
        CAN3_MCU_R1
        CAN3_MCU_R2
        CAN3_Shifter1
        CAN3_XNMm_BMS
        CAN3_XNMm_CCU
        CAN3_XNMm_EOP_F
        CAN3_XNMm_EOP_R
        CAN3_XNMm_MCU_F
        CAN3_XNMm_MCU_R
        CAN3_XNMm_Shifter
    FUSION_CAN4_Tx: communication-direction=OUT, communication-mode=CAN_Transmit_All, i-signal-i-pdus=[CAN4_FD4_CE100_2, CAN4_FD_DKC1, CAN4_FD_OTA1, CAN4_FD_THCM1, CAN4_FD_THCM2, CAN4_FD_VCU1, CAN4_XNMm_FUSION]
    FUSION_CAN4_Rx: communication-direction=IN, communication-mode=CAN_Receive_All
      i-signal-i-pdus:
        CAN4_DKC1
        CAN4_DKC2
        CAN4_GW_ZDR_PTG1
        CAN4_GW_ZoneDR{1..4}
        CAN4_GW_ZoneDR6
        CAN4_GW_ZoneFR1
        CAN4_GW_ZoneFR2
        CAN4_XNMm_DKC
        CAN4_XNMm_ZONE_DR
        CAN4_XNMm_ZONE_FR
        CAN4_Zone_Dr_SCP
        CAN4_Zone_Dr_THCM
        CAN4_Zone_Dr_VCU
        CAN4_Zone_Fr_THCM
    FUSION_CAN5_Tx: communication-direction=OUT, communication-mode=CAN_Transmit_All
      i-signal-i-pdus:
        CAN5_FD_BCM1
        CAN5_FD_CONN1
        CAN5_FD_THCM2
        CAN5_FD_VCU0
        CAN5_FD_VCU1
        CAN5_FD_VCU{3..5}
        CAN5_XNMm_FUSION
    FUSION_CAN5_Rx: communication-direction=IN, communication-mode=CAN_Receive_All, i-signal-i-pdus=[CAN5_TBOX1, CAN5_XNMm_TBOX]
