ASAP2_VERSION 1 31
/begin PROJECT ProjectName "Project Comment Goes Here"
/begin HEADER "Header Comments go here" /end HEADER
/begin MODULE ModuleName "Module Comment Goes Here"
/begin MOD_COMMON "Mod Common Comment Here" BYTE_ORDER MSB_LAST /end MOD_COMMON
/begin RECORD_LAYOUT Scalar_BOOLEAN FNC_VALUES 1 UBYTE COLUMN_DIR DIRECT /end RECORD_LAYOUT
/begin RECORD_LAYOUT Scalar_UBYTE FNC_VALUES 1 UBYTE COLUMN_DIR DIRECT /end RECORD_LAYOUT
/begin RECORD_LAYOUT Scalar_UWORD FNC_VALUES 1 UWORD COLUMN_DIR DIRECT /end RECORD_LAYOUT
/begin RECORD_LAYOUT Scalar_FLOAT32_IEEE FNC_VALUES 1 FLOAT32_IEEE COLUMN_DIR DIRECT /end RECORD_LAYOUT
/begin RECORD_LAYOUT Lookup1D_BOOLEAN FNC_VALUES 1 UBYTE COLUMN_DIR DIRECT /end RECORD_LAYOUT
/begin RECORD_LAYOUT Lookup1D_X_BOOLEAN AXIS_PTS_X 1 UBYTE INDEX_INCR DIRECT /end RECORD_LAYOUT
/begin RECORD_LAYOUT Lookup1D_BYTE FNC_VALUES 1 SBYTE COLUMN_DIR DIRECT /end RECORD_LAYOUT
/begin RECORD_LAYOUT Lookup1D_X_BYTE AXIS_PTS_X 1 SBYTE INDEX_INCR DIRECT /end RECORD_LAYOUT
/begin RECORD_LAYOUT Lookup1D_FLOAT32_IEEE FNC_VALUES 1 FLOAT32_IEEE COLUMN_DIR DIRECT /end RECORD_LAYOUT
/begin RECORD_LAYOUT Lookup1D_X_FLOAT32_IEEE AXIS_PTS_X 1 FLOAT32_IEEE INDEX_INCR DIRECT /end RECORD_LAYOUT
/begin RECORD_LAYOUT Lookup2D_UBYTE FNC_VALUES 1 UBYTE COLUMN_DIR DIRECT /end RECORD_LAYOUT
/begin RECORD_LAYOUT Lookup2D_X_UBYTE AXIS_PTS_X 1 UBYTE INDEX_INCR DIRECT /end RECORD_LAYOUT
/begin RECORD_LAYOUT Lookup2D_X_FLOAT32_IEEE AXIS_PTS_X 1 FLOAT32_IEEE INDEX_INCR DIRECT /end RECORD_LAYOUT
/begin CHARACTERISTIC MTHC_dAy_Y_C "" CURVE 0x0000 /* @ECU_Address@MTHC_dAy_Y_C@ */ Lookup1D_FLOAT32_IEEE 0 SWC_FDC_type_CM_single_C -40.0 85.0
 /begin AXIS_DESCR COM_AXIS NO_INPUT_QUANTITY SWC_FDC_type_CM_single_C 10 -40.0 85.0 AXIS_PTS_REF ATHC_dAy_X_C /end AXIS_DESCR
/end CHARACTERISTIC
/begin AXIS_PTS ATHC_dAy_X_C "" 0x0000 /* @ECU_Address@ATHC_dAy_X_C@ */ NO_INPUT_QUANTITY Lookup1D_X_FLOAT32_IEEE 0 SWC_FDC_type_CM_single_C 10 -40.0 85.0 /end AXIS_PTS
/begin CHARACTERISTIC MVMC_EPSForceSelectD21_Z_enum "" MAP 0x0000 /* @ECU_Address@MVMC_EPSForceSelectD21_Z_enum@ */ Lookup2D_UBYTE 0 SWC_FDC_type_CM_uint8_enum 0.0 20.0
 /begin AXIS_DESCR COM_AXIS NO_INPUT_QUANTITY SWC_FDC_type_CM_uint8_enum 3 0.0 20.0 AXIS_PTS_REF AVMC_EPSForceSelectD21_X_enum /end AXIS_DESCR
 /begin AXIS_DESCR COM_AXIS NO_INPUT_QUANTITY SWC_FDC_type_CM_uint8_enum 3 0.0 20.0 AXIS_PTS_REF AVMC_EPSForceSelectD21_Y_enum /end AXIS_DESCR
/end CHARACTERISTIC
/begin AXIS_PTS AVMC_EPSForceSelectD21_Y_enum "" 0x0000 /* @ECU_Address@AVMC_EPSForceSelectD21_Y_enum@ */ NO_INPUT_QUANTITY Lookup2D_X_UBYTE 0 SWC_FDC_type_CM_uint8_enum 3 0.0 20.0 /end AXIS_PTS
/begin AXIS_PTS AVMC_EPSForceSelectD21_X_enum "" 0x0000 /* @ECU_Address@AVMC_EPSForceSelectD21_X_enum@ */ NO_INPUT_QUANTITY Lookup2D_X_UBYTE 0 SWC_FDC_type_CM_uint8_enum 3 0.0 20.0 /end AXIS_PTS
/begin CHARACTERISTIC MVMC_EPSForceSelect_Z_enum "" MAP 0x0000 /* @ECU_Address@MVMC_EPSForceSelect_Z_enum@ */ Lookup2D_UBYTE 0 SWC_FDC_type_CM_uint8_enum 0.0 20.0
 /begin AXIS_DESCR COM_AXIS NO_INPUT_QUANTITY SWC_FDC_type_CM_uint8_enum 5 0.0 20.0 AXIS_PTS_REF AVMC_EPSForceSelect_X_enum /end AXIS_DESCR
 /begin AXIS_DESCR COM_AXIS NO_INPUT_QUANTITY SWC_FDC_type_CM_uint8_enum 3 0.0 20.0 AXIS_PTS_REF AVMC_EPSForceSelect_Y_enum /end AXIS_DESCR
/end CHARACTERISTIC
/begin AXIS_PTS AVMC_EPSForceSelect_Y_enum "" 0x0000 /* @ECU_Address@AVMC_EPSForceSelect_Y_enum@ */ NO_INPUT_QUANTITY Lookup2D_X_UBYTE 0 SWC_FDC_type_CM_uint8_enum 3 0.0 20.0 /end AXIS_PTS
/begin AXIS_PTS AVMC_EPSForceSelect_X_enum "" 0x0000 /* @ECU_Address@AVMC_EPSForceSelect_X_enum@ */ NO_INPUT_QUANTITY Lookup2D_X_UBYTE 0 SWC_FDC_type_CM_uint8_enum 5 0.0 20.0 /end AXIS_PTS
/begin CHARACTERISTIC MVMC_ACCLongSteadyCtrl_Y_kph "" CURVE 0x0000 /* @ECU_Address@MVMC_ACCLongSteadyCtrl_Y_kph@ */ Lookup1D_FLOAT32_IEEE 0 SWC_FDC_type_CM_single_kph 0.0 300.0
 /begin AXIS_DESCR COM_AXIS VVMC_FeatSetSpdForCalcu_kph SWC_FDC_type_CM_single_kph 20 0.0 300.0 AXIS_PTS_REF AVMC_ACCLongSteadyCtrl_X_kph /end AXIS_DESCR
/end CHARACTERISTIC
/begin AXIS_PTS AVMC_ACCLongSteadyCtrl_X_kph "" 0x0000 /* @ECU_Address@AVMC_ACCLongSteadyCtrl_X_kph@ */ VVMC_FeatSetSpdForCalcu_kph Lookup1D_X_FLOAT32_IEEE 0 SWC_FDC_type_CM_single_kph 20 0.0 300.0 /end AXIS_PTS
/begin CHARACTERISTIC MVMC_CCLongSteadyCtrl_Y_kph "" CURVE 0x0000 /* @ECU_Address@MVMC_CCLongSteadyCtrl_Y_kph@ */ Lookup1D_FLOAT32_IEEE 0 SWC_FDC_type_CM_single_kph 0.0 300.0
 /begin AXIS_DESCR COM_AXIS VVMC_FeatSetSpdForCalcu_kph SWC_FDC_type_CM_single_kph 20 0.0 300.0 AXIS_PTS_REF AVMC_CCLongSteadyCtrl_X_kph /end AXIS_DESCR
/end CHARACTERISTIC
/begin AXIS_PTS AVMC_CCLongSteadyCtrl_X_kph "" 0x0000 /* @ECU_Address@AVMC_CCLongSteadyCtrl_X_kph@ */ VVMC_FeatSetSpdForCalcu_kph Lookup1D_X_FLOAT32_IEEE 0 SWC_FDC_type_CM_single_kph 20 0.0 300.0 /end AXIS_PTS
/begin CHARACTERISTIC MVMC_LongAccDeadZone_Y_Gps "" CURVE 0x0000 /* @ECU_Address@MVMC_LongAccDeadZone_Y_Gps@ */ Lookup1D_FLOAT32_IEEE 0 SWC_FDC_type_CM_single_Gps 0.0 10.0
 /begin AXIS_DESCR COM_AXIS NO_INPUT_QUANTITY SWC_FDC_type_CM_single_kph 13 0.0 300.0 AXIS_PTS_REF AVMC_LongAccDeadZone_X_kph /end AXIS_DESCR
/end CHARACTERISTIC
/begin AXIS_PTS AVMC_LongAccDeadZone_X_kph "" 0x0000 /* @ECU_Address@AVMC_LongAccDeadZone_X_kph@ */ NO_INPUT_QUANTITY Lookup1D_X_FLOAT32_IEEE 0 SWC_FDC_type_CM_single_kph 13 0.0 300.0 /end AXIS_PTS
/begin CHARACTERISTIC MVMC_LongAccFiltTsforP2_Y_c "" CURVE 0x0000 /* @ECU_Address@MVMC_LongAccFiltTsforP2_Y_c@ */ Lookup1D_FLOAT32_IEEE 0 SWC_FDC_type_CM_single_c 0.0 5.0
 /begin AXIS_DESCR COM_AXIS NO_INPUT_QUANTITY SWC_FDC_type_CM_single_Gps 13 -10.0 10.0 AXIS_PTS_REF AVMC_LongAccFiltTsforP2_X_Gps /end AXIS_DESCR
/end CHARACTERISTIC
/begin AXIS_PTS AVMC_LongAccFiltTsforP2_X_Gps "" 0x0000 /* @ECU_Address@AVMC_LongAccFiltTsforP2_X_Gps@ */ NO_INPUT_QUANTITY Lookup1D_X_FLOAT32_IEEE 0 SWC_FDC_type_CM_single_Gps 13 -10.0 10.0 /end AXIS_PTS
/begin CHARACTERISTIC MVMC_MSALongSteadyCtrl_Y_kph "" CURVE 0x0000 /* @ECU_Address@MVMC_MSALongSteadyCtrl_Y_kph@ */ Lookup1D_FLOAT32_IEEE 0 SWC_FDC_type_CM_single_kph 0.0 300.0
 /begin AXIS_DESCR COM_AXIS VVMC_FeatSetSpdForCalcu_kph SWC_FDC_type_CM_single_kph 20 0.0 300.0 AXIS_PTS_REF AVMC_MSALongSteadyCtrl_X_kph /end AXIS_DESCR
/end CHARACTERISTIC
/begin AXIS_PTS AVMC_MSALongSteadyCtrl_X_kph "" 0x0000 /* @ECU_Address@AVMC_MSALongSteadyCtrl_X_kph@ */ VVMC_FeatSetSpdForCalcu_kph Lookup1D_X_FLOAT32_IEEE 0 SWC_FDC_type_CM_single_kph 20 0.0 300.0 /end AXIS_PTS
/begin CHARACTERISTIC MVMC_VehPitchAngleSta_Z_enum "" MAP 0x0000 /* @ECU_Address@MVMC_VehPitchAngleSta_Z_enum@ */ Lookup2D_UBYTE 0 SWC_FDC_type_CM_uint8_enum 0.0 6.0
 /begin AXIS_DESCR COM_AXIS VVMC_VehPitchAngleEst_deg SWC_FDC_type_CM_single_deg 13 -10.0 10.0 AXIS_PTS_REF AVMC_VehPitchAngleSta_X_deg /end AXIS_DESCR
 /begin AXIS_DESCR COM_AXIS NO_INPUT_QUANTITY SWC_FDC_type_CM_single_deg 11 -10.0 10.0 AXIS_PTS_REF AVMC_VehPitchAngleSta_Y_deg /end AXIS_DESCR
/end CHARACTERISTIC
/begin AXIS_PTS AVMC_VehPitchAngleSta_Y_deg "" 0x0000 /* @ECU_Address@AVMC_VehPitchAngleSta_Y_deg@ */ NO_INPUT_QUANTITY Lookup2D_X_FLOAT32_IEEE 0 SWC_FDC_type_CM_single_deg 11 -10.0 10.0 /end AXIS_PTS
/begin AXIS_PTS AVMC_VehPitchAngleSta_X_deg "" 0x0000 /* @ECU_Address@AVMC_VehPitchAngleSta_X_deg@ */ VVMC_VehPitchAngleEst_deg Lookup2D_X_FLOAT32_IEEE 0 SWC_FDC_type_CM_single_deg 13 -10.0 10.0 /end AXIS_PTS
/begin CHARACTERISTIC MDHP_HysOffset_Y_pct "" CURVE 0x0000 /* @ECU_Address@MDHP_HysOffset_Y_pct@ */ Lookup1D_FLOAT32_IEEE 0 SWC_FDC_type_CM_single_pct 0.0 120.0
 /begin AXIS_DESCR COM_AXIS NO_INPUT_QUANTITY SWC_FDC_type_CM_single_pct 12 0.0 120.0 AXIS_PTS_REF ADHP_HysOffset_X_pct /end AXIS_DESCR
/end CHARACTERISTIC
/begin AXIS_PTS ADHP_HysOffset_X_pct "" 0x0000 /* @ECU_Address@ADHP_HysOffset_X_pct@ */ NO_INPUT_QUANTITY Lookup1D_X_FLOAT32_IEEE 0 SWC_FDC_type_CM_single_pct 12 0.0 120.0 /end AXIS_PTS
/begin CHARACTERISTIC MPMM_LVBattChktime_Y_s "" CURVE 0x0000 /* @ECU_Address@MPMM_LVBattChktime_Y_s@ */ Lookup1D_FLOAT32_IEEE 0 SWC_FDC_type_CM_single_s 0.0 86400.0
 /begin AXIS_DESCR COM_AXIS NO_INPUT_QUANTITY SWC_FDC_type_CM_single_enum 3 0.0 3.0 AXIS_PTS_REF APMM_LVBattChktime_X_enum /end AXIS_DESCR
/end CHARACTERISTIC
/begin AXIS_PTS APMM_LVBattChktime_X_enum "" 0x0000 /* @ECU_Address@APMM_LVBattChktime_X_enum@ */ NO_INPUT_QUANTITY Lookup1D_X_FLOAT32_IEEE 0 SWC_FDC_type_CM_single_enum 3 0.0 3.0 /end AXIS_PTS
/begin CHARACTERISTIC MPMM_LVChrgLv_Y_Lv "" CURVE 0x0000 /* @ECU_Address@MPMM_LVChrgLv_Y_Lv@ */ Lookup1D_FLOAT32_IEEE 0 SWC_FDC_type_CM_single_Lv 0.0 3.0
 /begin AXIS_DESCR COM_AXIS NO_INPUT_QUANTITY SWC_FDC_type_CM_single_mV 11 0.0 72000.0 AXIS_PTS_REF APMM_LVChrgLv_X_mV /end AXIS_DESCR
/end CHARACTERISTIC
/begin AXIS_PTS APMM_LVChrgLv_X_mV "" 0x0000 /* @ECU_Address@APMM_LVChrgLv_X_mV@ */ NO_INPUT_QUANTITY Lookup1D_X_FLOAT32_IEEE 0 SWC_FDC_type_CM_single_mV 11 0.0 72000.0 /end AXIS_PTS
/begin CHARACTERISTIC MPMM_CoolgFanActCurr_Y_A "" CURVE 0x0000 /* @ECU_Address@MPMM_CoolgFanActCurr_Y_A@ */ Lookup1D_FLOAT32_IEEE 0 SWC_FDC_type_CM_single_A 0.0 3600.0
 /begin AXIS_DESCR COM_AXIS NO_INPUT_QUANTITY SWC_FDC_type_CM_single_pct 5 0.0 100.0 AXIS_PTS_REF APMM_CoolgFanActCurr_X_pct /end AXIS_DESCR
/end CHARACTERISTIC
/begin AXIS_PTS APMM_CoolgFanActCurr_X_pct "" 0x0000 /* @ECU_Address@APMM_CoolgFanActCurr_X_pct@ */ NO_INPUT_QUANTITY Lookup1D_X_FLOAT32_IEEE 0 SWC_FDC_type_CM_single_pct 5 0.0 100.0 /end AXIS_PTS
/begin CHARACTERISTIC MPMM_EWP1Curr_Y_A "" CURVE 0x0000 /* @ECU_Address@MPMM_EWP1Curr_Y_A@ */ Lookup1D_FLOAT32_IEEE 0 SWC_FDC_type_CM_single_A 0.0 3600.0
 /begin AXIS_DESCR COM_AXIS NO_INPUT_QUANTITY SWC_FDC_type_CM_single_C 3 0.0 255.0 AXIS_PTS_REF APMM_EWP1Curr_X_c /end AXIS_DESCR
/end CHARACTERISTIC
/begin AXIS_PTS APMM_EWP1Curr_X_c "" 0x0000 /* @ECU_Address@APMM_EWP1Curr_X_c@ */ NO_INPUT_QUANTITY Lookup1D_X_FLOAT32_IEEE 0 SWC_FDC_type_CM_single_C 3 0.0 255.0 /end AXIS_PTS
/begin CHARACTERISTIC MPMM_EWP3Curr_Y_A "" CURVE 0x0000 /* @ECU_Address@MPMM_EWP3Curr_Y_A@ */ Lookup1D_FLOAT32_IEEE 0 SWC_FDC_type_CM_single_A 0.0 3600.0
 /begin AXIS_DESCR COM_AXIS NO_INPUT_QUANTITY SWC_FDC_type_CM_single_C 3 0.0 255.0 AXIS_PTS_REF APMM_EWP3Curr_X_c /end AXIS_DESCR
/end CHARACTERISTIC
/begin AXIS_PTS APMM_EWP3Curr_X_c "" 0x0000 /* @ECU_Address@APMM_EWP3Curr_X_c@ */ NO_INPUT_QUANTITY Lookup1D_X_FLOAT32_IEEE 0 SWC_FDC_type_CM_single_C 3 0.0 255.0 /end AXIS_PTS
/begin CHARACTERISTIC MPMM_LVBattChrgtime_Y_s "" CURVE 0x0000 /* @ECU_Address@MPMM_LVBattChrgtime_Y_s@ */ Lookup1D_FLOAT32_IEEE 0 SWC_FDC_type_CM_single_s 0.0 86400.0
 /begin AXIS_DESCR COM_AXIS NO_INPUT_QUANTITY SWC_FDC_type_CM_single_enum 3 0.0 3.0 AXIS_PTS_REF APMM_LVBattChrgtime_X_enum /end AXIS_DESCR
/end CHARACTERISTIC
/begin AXIS_PTS APMM_LVBattChrgtime_X_enum "" 0x0000 /* @ECU_Address@APMM_LVBattChrgtime_X_enum@ */ NO_INPUT_QUANTITY Lookup1D_X_FLOAT32_IEEE 0 SWC_FDC_type_CM_single_enum 3 0.0 3.0 /end AXIS_PTS
/begin CHARACTERISTIC MTHC_APTCQA_Y_W "" CURVE 0x0000 /* @ECU_Address@MTHC_APTCQA_Y_W@ */ Lookup1D_FLOAT32_IEEE 0 SWC_FDC_type_CM_single_W 0.0 10000.0
 /begin AXIS_DESCR COM_AXIS NO_INPUT_QUANTITY SWC_FDC_type_CM_single_C 10 -40.0 200.0 AXIS_PTS_REF ATHC_APTCQA_X_C /end AXIS_DESCR
/end CHARACTERISTIC
/begin AXIS_PTS ATHC_APTCQA_X_C "" 0x0000 /* @ECU_Address@ATHC_APTCQA_X_C@ */ NO_INPUT_QUANTITY Lookup1D_X_FLOAT32_IEEE 0 SWC_FDC_type_CM_single_C 10 -40.0 200.0 /end AXIS_PTS
/begin CHARACTERISTIC MTHC_APTCQB_Y_W "" CURVE 0x0000 /* @ECU_Address@MTHC_APTCQB_Y_W@ */ Lookup1D_FLOAT32_IEEE 0 SWC_FDC_type_CM_single_W 0.0 10000.0
 /begin AXIS_DESCR COM_AXIS NO_INPUT_QUANTITY SWC_FDC_type_CM_single_C 10 -40.0 200.0 AXIS_PTS_REF ATHC_APTCQB_X_C /end AXIS_DESCR
/end CHARACTERISTIC
/begin AXIS_PTS ATHC_APTCQB_X_C "" 0x0000 /* @ECU_Address@ATHC_APTCQB_X_C@ */ NO_INPUT_QUANTITY Lookup1D_X_FLOAT32_IEEE 0 SWC_FDC_type_CM_single_C 10 -40.0 200.0 /end AXIS_PTS
/begin CHARACTERISTIC KBCM_ACCSwcPrsTmr_s "" VALUE 0x0000 /* @ECU_Address@KBCM_ACCSwcPrsTmr_s@ */ Scalar_FLOAT32_IEEE 0 SWC_FDC_type_CM_single_s 0.0 10000.0 /end CHARACTERISTIC
/begin CHARACTERISTIC KBCM_RLSLowSpdFilterT_s "" VALUE 0x0000 /* @ECU_Address@KBCM_RLSLowSpdFilterT_s@ */ Scalar_FLOAT32_IEEE 0 SWC_FDC_type_CM_single_s 0.0 10000.0 /end CHARACTERISTIC
/begin CHARACTERISTIC KBCM_SPTGLeftBoundOut_cm "" VALUE 0x0000 /* @ECU_Address@KBCM_SPTGLeftBoundOut_cm@ */ Scalar_FLOAT32_IEEE 0 SWC_FDC_type_CM_single_cm 0.0 255.0 /end CHARACTERISTIC
/begin CHARACTERISTIC KBCM_SPTGLeftBound_cm "" VALUE 0x0000 /* @ECU_Address@KBCM_SPTGLeftBound_cm@ */ Scalar_FLOAT32_IEEE 0 SWC_FDC_type_CM_single_cm 0.0 150.0 /end CHARACTERISTIC
/begin CHARACTERISTIC KBCM_SPTGLowerBoundOut_cm "" VALUE 0x0000 /* @ECU_Address@KBCM_SPTGLowerBoundOut_cm@ */ Scalar_FLOAT32_IEEE 0 SWC_FDC_type_CM_single_cm 0.0 255.0 /end CHARACTERISTIC
/begin CHARACTERISTIC KBCM_SPTGRightBoundOut_cm "" VALUE 0x0000 /* @ECU_Address@KBCM_SPTGRightBoundOut_cm@ */ Scalar_FLOAT32_IEEE 0 SWC_FDC_type_CM_single_cm 0.0 255.0 /end CHARACTERISTIC
/begin CHARACTERISTIC KBCM_SPTGRightBound_cm "" VALUE 0x0000 /* @ECU_Address@KBCM_SPTGRightBound_cm@ */ Scalar_FLOAT32_IEEE 0 SWC_FDC_type_CM_single_cm 0.0 150.0 /end CHARACTERISTIC
/begin CHARACTERISTIC KBCM_SPTGUpperBoundOut_cm "" VALUE 0x0000 /* @ECU_Address@KBCM_SPTGUpperBoundOut_cm@ */ Scalar_FLOAT32_IEEE 0 SWC_FDC_type_CM_single_cm 0.0 255.0 /end CHARACTERISTIC
/begin CHARACTERISTIC KBCM_SPTGUpperBound_cm "" VALUE 0x0000 /* @ECU_Address@KBCM_SPTGUpperBound_cm@ */ Scalar_FLOAT32_IEEE 0 SWC_FDC_type_CM_single_cm 0.0 150.0 /end CHARACTERISTIC
/begin CHARACTERISTIC KBCM_USSDis_cm "" VALUE 0x0000 /* @ECU_Address@KBCM_USSDis_cm@ */ Scalar_FLOAT32_IEEE 0 SWC_FDC_type_CM_single_cm 0.0 150.0 /end CHARACTERISTIC
/begin CHARACTERISTIC KBCM_WaitACCChange_s "" VALUE 0x0000 /* @ECU_Address@KBCM_WaitACCChange_s@ */ Scalar_FLOAT32_IEEE 0 SWC_FDC_type_CM_single_s 0.0 10000.0 /end CHARACTERISTIC
/begin CHARACTERISTIC KDHP_AccPedalDepressed_pct "" VALUE 0x0000 /* @ECU_Address@KDHP_AccPedalDepressed_pct@ */ Scalar_FLOAT32_IEEE 0 SWC_FDC_type_CM_single_deg 0.0 20.0 /end CHARACTERISTIC
/begin CHARACTERISTIC KDHP_AccPedalReleased_pct "" VALUE 0x0000 /* @ECU_Address@KDHP_AccPedalReleased_pct@ */ Scalar_FLOAT32_IEEE 0 SWC_FDC_type_CM_single_deg 0.0 20.0 /end CHARACTERISTIC
/begin CHARACTERISTIC KDHP_AcceleratorLoadScalr_gain "" VALUE 0x0000 /* @ECU_Address@KDHP_AcceleratorLoadScalr_gain@ */ Scalar_FLOAT32_IEEE 0 SWC_FDC_type_CM_single_gain 0.0 3.0 /end CHARACTERISTIC
/begin CHARACTERISTIC KDHP_ActAPSPosn_pct_ovrdval "" VALUE 0x0000 /* @ECU_Address@KDHP_ActAPSPosn_pct_ovrdval@ */ Scalar_FLOAT32_IEEE 0 SWC_FDC_type_CM_single_pct 0.0 120.0 /end CHARACTERISTIC
/begin CHARACTERISTIC KDHP_DeadBand_pct "" VALUE 0x0000 /* @ECU_Address@KDHP_DeadBand_pct@ */ Scalar_FLOAT32_IEEE 0 SWC_FDC_type_CM_single_pct 0.0 100.0 /end CHARACTERISTIC
/begin CHARACTERISTIC KDHP_EAPS11OutWT_gain "" VALUE 0x0000 /* @ECU_Address@KDHP_EAPS11OutWT_gain@ */ Scalar_FLOAT32_IEEE 0 SWC_FDC_type_CM_single_gain 0.0 1.0 /end CHARACTERISTIC
/begin CHARACTERISTIC KDHP_EAPS12DisagreeTime_s "" VALUE 0x0000 /* @ECU_Address@KDHP_EAPS12DisagreeTime_s@ */ Scalar_FLOAT32_IEEE 0 SWC_FDC_type_CM_single_sec 0.0 10.0 /end CHARACTERISTIC
/begin CHARACTERISTIC KDHP_EAPS12Disagree_pct "" VALUE 0x0000 /* @ECU_Address@KDHP_EAPS12Disagree_pct@ */ Scalar_FLOAT32_IEEE 0 SWC_FDC_type_CM_single_pct 0.0 100.0 /end CHARACTERISTIC
/begin CHARACTERISTIC KDHP_EAPS12OutWT_gain "" VALUE 0x0000 /* @ECU_Address@KDHP_EAPS12OutWT_gain@ */ Scalar_FLOAT32_IEEE 0 SWC_FDC_type_CM_single_gain 0.0 1.0 /end CHARACTERISTIC
/begin CHARACTERISTIC KDHP_EAPS1AOutWT_gain "" VALUE 0x0000 /* @ECU_Address@KDHP_EAPS1AOutWT_gain@ */ Scalar_FLOAT32_IEEE 0 SWC_FDC_type_CM_single_gain 0.0 1.0 /end CHARACTERISTIC
/begin CHARACTERISTIC KDHP_EAPS1BADHigh_pct "" VALUE 0x0000 /* @ECU_Address@KDHP_EAPS1BADHigh_pct@ */ Scalar_FLOAT32_IEEE 0 SWC_FDC_type_CM_single_pct 70.0 120.0 /end CHARACTERISTIC
/begin CHARACTERISTIC KDHP_EAPS1BADLow_pct "" VALUE 0x0000 /* @ECU_Address@KDHP_EAPS1BADLow_pct@ */ Scalar_FLOAT32_IEEE 0 SWC_FDC_type_CM_single_pct 0.0 30.0 /end CHARACTERISTIC
/begin CHARACTERISTIC KDHP_EAPS1BADTime_s "" VALUE 0x0000 /* @ECU_Address@KDHP_EAPS1BADTime_s@ */ Scalar_FLOAT32_IEEE 0 SWC_FDC_type_CM_single_sec 0.0 10.0 /end CHARACTERISTIC
/begin CHARACTERISTIC KDHP_EAPS1MINInitLowLim_pct "" VALUE 0x0000 /* @ECU_Address@KDHP_EAPS1MINInitLowLim_pct@ */ Scalar_FLOAT32_IEEE 0 SWC_FDC_type_CM_single_pct 0.0 100.0 /end CHARACTERISTIC
/begin CHARACTERISTIC KDHP_EAPS1MINInitUpLim_pct "" VALUE 0x0000 /* @ECU_Address@KDHP_EAPS1MINInitUpLim_pct@ */ Scalar_FLOAT32_IEEE 0 SWC_FDC_type_CM_single_pct 0.0 100.0 /end CHARACTERISTIC
/begin CHARACTERISTIC KDHP_EAPS1Min_pct_ovrdval "" VALUE 0x0000 /* @ECU_Address@KDHP_EAPS1Min_pct_ovrdval@ */ Scalar_FLOAT32_IEEE 0 SWC_FDC_type_CM_single_pct 0.0 100.0 /end CHARACTERISTIC
/begin CHARACTERISTIC KDHP_EAPS1WT_gain "" VALUE 0x0000 /* @ECU_Address@KDHP_EAPS1WT_gain@ */ Scalar_FLOAT32_IEEE 0 SWC_FDC_type_CM_single_gain 0.0 1.0 /end CHARACTERISTIC
/begin CHARACTERISTIC KDHP_EAPS21OutWT_gain "" VALUE 0x0000 /* @ECU_Address@KDHP_EAPS21OutWT_gain@ */ Scalar_FLOAT32_IEEE 0 SWC_FDC_type_CM_single_gain 0.0 1.0 /end CHARACTERISTIC
/begin CHARACTERISTIC KDHP_EAPS22OutWT_gain "" VALUE 0x0000 /* @ECU_Address@KDHP_EAPS22OutWT_gain@ */ Scalar_FLOAT32_IEEE 0 SWC_FDC_type_CM_single_gain 0.0 1.0 /end CHARACTERISTIC
/begin CHARACTERISTIC KDHP_EAPS2AOutWT_gain "" VALUE 0x0000 /* @ECU_Address@KDHP_EAPS2AOutWT_gain@ */ Scalar_FLOAT32_IEEE 0 SWC_FDC_type_CM_single_gain 0.0 1.0 /end CHARACTERISTIC
/begin CHARACTERISTIC KDHP_EAPS2BADHigh_pct "" VALUE 0x0000 /* @ECU_Address@KDHP_EAPS2BADHigh_pct@ */ Scalar_FLOAT32_IEEE 0 SWC_FDC_type_CM_single_pct 30.0 60.0 /end CHARACTERISTIC
/begin CHARACTERISTIC KDHP_EAPS2BADLow_pct "" VALUE 0x0000 /* @ECU_Address@KDHP_EAPS2BADLow_pct@ */ Scalar_FLOAT32_IEEE 0 SWC_FDC_type_CM_single_pct 0.0 30.0 /end CHARACTERISTIC
/begin CHARACTERISTIC KDHP_EAPS2BADTime_s "" VALUE 0x0000 /* @ECU_Address@KDHP_EAPS2BADTime_s@ */ Scalar_FLOAT32_IEEE 0 SWC_FDC_type_CM_single_sec 0.0 10.0 /end CHARACTERISTIC
/begin CHARACTERISTIC KDHP_EAPS2MINInitLowLim_pct "" VALUE 0x0000 /* @ECU_Address@KDHP_EAPS2MINInitLowLim_pct@ */ Scalar_FLOAT32_IEEE 0 SWC_FDC_type_CM_single_pct 0.0 100.0 /end CHARACTERISTIC
/begin CHARACTERISTIC KDHP_EAPS2MINInitUpLim_pct "" VALUE 0x0000 /* @ECU_Address@KDHP_EAPS2MINInitUpLim_pct@ */ Scalar_FLOAT32_IEEE 0 SWC_FDC_type_CM_single_pct 0.0 100.0 /end CHARACTERISTIC
/begin CHARACTERISTIC KDHP_EAPS2Min_pct_ovrdval "" VALUE 0x0000 /* @ECU_Address@KDHP_EAPS2Min_pct_ovrdval@ */ Scalar_FLOAT32_IEEE 0 SWC_FDC_type_CM_single_pct 0.0 100.0 /end CHARACTERISTIC
/begin CHARACTERISTIC KDHP_EAPS2Offset_pct "" VALUE 0x0000 /* @ECU_Address@KDHP_EAPS2Offset_pct@ */ Scalar_FLOAT32_IEEE 0 SWC_FDC_type_CM_single_pct 0.0 30.0 /end CHARACTERISTIC
/begin CHARACTERISTIC KDHP_EAPS2Scaler_gain "" VALUE 0x0000 /* @ECU_Address@KDHP_EAPS2Scaler_gain@ */ Scalar_FLOAT32_IEEE 0 SWC_FDC_type_CM_single_gain 0.4 3.0 /end CHARACTERISTIC
/begin CHARACTERISTIC KDHP_EAPS2WT_gain "" VALUE 0x0000 /* @ECU_Address@KDHP_EAPS2WT_gain@ */ Scalar_FLOAT32_IEEE 0 SWC_FDC_type_CM_single_gain 0.0 1.0 /end CHARACTERISTIC
/begin CHARACTERISTIC KDHP_EAPSCRBadWDSP_pct "" VALUE 0x0000 /* @ECU_Address@KDHP_EAPSCRBadWDSP_pct@ */ Scalar_FLOAT32_IEEE 0 SWC_FDC_type_CM_single_pct 0.0 120.0 /end CHARACTERISTIC
/begin CHARACTERISTIC KDHP_EAPSLearnDwHigh_pct "" VALUE 0x0000 /* @ECU_Address@KDHP_EAPSLearnDwHigh_pct@ */ Scalar_FLOAT32_IEEE 0 SWC_FDC_type_CM_single_pct 0.0 50.0 /end CHARACTERISTIC
/begin CHARACTERISTIC KDHP_EAPSLearnDwLow_pct "" VALUE 0x0000 /* @ECU_Address@KDHP_EAPSLearnDwLow_pct@ */ Scalar_FLOAT32_IEEE 0 SWC_FDC_type_CM_single_pct 0.0 50.0 /end CHARACTERISTIC
/begin CHARACTERISTIC KDHP_EAPSLearnDwMAX_pct "" VALUE 0x0000 /* @ECU_Address@KDHP_EAPSLearnDwMAX_pct@ */ Scalar_FLOAT32_IEEE 0 SWC_FDC_type_CM_single_pct 0.0 50.0 /end CHARACTERISTIC
/begin CHARACTERISTIC KDHP_EAPSLearnUpHigh_pct "" VALUE 0x0000 /* @ECU_Address@KDHP_EAPSLearnUpHigh_pct@ */ Scalar_FLOAT32_IEEE 0 SWC_FDC_type_CM_single_pct 0.0 100.0 /end CHARACTERISTIC
/begin CHARACTERISTIC KDHP_EAPSLearnUpLow_pct "" VALUE 0x0000 /* @ECU_Address@KDHP_EAPSLearnUpLow_pct@ */ Scalar_FLOAT32_IEEE 0 SWC_FDC_type_CM_single_pct 0.0 100.0 /end CHARACTERISTIC
/begin CHARACTERISTIC KDHP_EAPSLearnUpOffset_pct "" VALUE 0x0000 /* @ECU_Address@KDHP_EAPSLearnUpOffset_pct@ */ Scalar_FLOAT32_IEEE 0 SWC_FDC_type_CM_single_pct 0.0 100.0 /end CHARACTERISTIC
/begin CHARACTERISTIC KDHP_EAPSMINLowerLimit_pct "" VALUE 0x0000 /* @ECU_Address@KDHP_EAPSMINLowerLimit_pct@ */ Scalar_FLOAT32_IEEE 0 SWC_FDC_type_CM_single_pct 0.0 100.0 /end CHARACTERISTIC
/begin CHARACTERISTIC KDHP_EAPSStableThrsh_pct "" VALUE 0x0000 /* @ECU_Address@KDHP_EAPSStableThrsh_pct@ */ Scalar_FLOAT32_IEEE 0 SWC_FDC_type_CM_single_pct 0.0 50.0 /end CHARACTERISTIC
/begin CHARACTERISTIC KDHP_EAPSStableTime_s "" VALUE 0x0000 /* @ECU_Address@KDHP_EAPSStableTime_s@ */ Scalar_FLOAT32_IEEE 0 SWC_FDC_type_CM_single_sec 0.0 10.0 /end CHARACTERISTIC
/begin CHARACTERISTIC KDHP_EPEDPOSNUpLimit_pct "" VALUE 0x0000 /* @ECU_Address@KDHP_EPEDPOSNUpLimit_pct@ */ Scalar_FLOAT32_IEEE 0 SWC_FDC_type_CM_single_pct 0.0 120.0 /end CHARACTERISTIC
/begin CHARACTERISTIC KDHP_GetNRMBaseTime_s "" VALUE 0x0000 /* @ECU_Address@KDHP_GetNRMBaseTime_s@ */ Scalar_FLOAT32_IEEE 0 SWC_FDC_type_CM_single_sec 0.0 10.0 /end CHARACTERISTIC
/begin CHARACTERISTIC KDHP_LVBattHighLimit_V "" VALUE 0x0000 /* @ECU_Address@KDHP_LVBattHighLimit_V@ */ Scalar_FLOAT32_IEEE 0 SWC_FDC_type_CM_single_V 0.0 30.0 /end CHARACTERISTIC
/begin CHARACTERISTIC KDHP_LVBattHigh_V "" VALUE 0x0000 /* @ECU_Address@KDHP_LVBattHigh_V@ */ Scalar_FLOAT32_IEEE 0 SWC_FDC_type_CM_single_V 0.0 30.0 /end CHARACTERISTIC
/begin CHARACTERISTIC KDHP_LVBattLow_V "" VALUE 0x0000 /* @ECU_Address@KDHP_LVBattLow_V@ */ Scalar_FLOAT32_IEEE 0 SWC_FDC_type_CM_single_V 0.0 30.0 /end CHARACTERISTIC
/begin CHARACTERISTIC KDSC_FirstOrderInpTs_s "" VALUE 0x0000 /* @ECU_Address@KDSC_FirstOrderInpTs_s@ */ Scalar_FLOAT32_IEEE 0 SWC_FDC_type_CM_single_sec 0.0 10.0 /end CHARACTERISTIC
/begin CHARACTERISTIC KDSC_SamplingTime_s "" VALUE 0x0000 /* @ECU_Address@KDSC_SamplingTime_s@ */ Scalar_FLOAT32_IEEE 0 SWC_FDC_type_CM_single_sec 0.0 10.0 /end CHARACTERISTIC
/begin CHARACTERISTIC KDSC_TurnAngControlpoint1_deg "" VALUE 0x0000 /* @ECU_Address@KDSC_TurnAngControlpoint1_deg@ */ Scalar_FLOAT32_IEEE 0 SWC_FDC_type_CM_single_deg 0.0 540.0 /end CHARACTERISTIC
/begin CHARACTERISTIC KDSC_TurnAngControlpoint1_kph "" VALUE 0x0000 /* @ECU_Address@KDSC_TurnAngControlpoint1_kph@ */ Scalar_FLOAT32_IEEE 0 SWC_FDC_type_CM_single_kph 0.0 100.0 /end CHARACTERISTIC
/begin CHARACTERISTIC KDSC_TurnAngControlpoint2_deg "" VALUE 0x0000 /* @ECU_Address@KDSC_TurnAngControlpoint2_deg@ */ Scalar_FLOAT32_IEEE 0 SWC_FDC_type_CM_single_deg 0.0 540.0 /end CHARACTERISTIC
/begin CHARACTERISTIC KDSC_TurnAngControlpoint2_kph "" VALUE 0x0000 /* @ECU_Address@KDSC_TurnAngControlpoint2_kph@ */ Scalar_FLOAT32_IEEE 0 SWC_FDC_type_CM_single_kph 0.0 100.0 /end CHARACTERISTIC
/begin CHARACTERISTIC KTHC_APTCQminD_W "" VALUE 0x0000 /* @ECU_Address@KTHC_APTCQminD_W@ */ Scalar_FLOAT32_IEEE 0 SWC_FDC_type_CM_single_W 0.0 19125.0 /end CHARACTERISTIC
/begin CHARACTERISTIC KTHC_APTCQminRe_W "" VALUE 0x0000 /* @ECU_Address@KTHC_APTCQminRe_W@ */ Scalar_FLOAT32_IEEE 0 SWC_FDC_type_CM_single_W 0.0 19125.0 /end CHARACTERISTIC
/begin CHARACTERISTIC KTHC_BatInTempDef_C "" VALUE 0x0000 /* @ECU_Address@KTHC_BatInTempDef_C@ */ Scalar_FLOAT32_IEEE 0 SWC_FDC_type_CM_single_C -40.0 200.0 /end CHARACTERISTIC
/begin CHARACTERISTIC KTHC_CompSpdmaxBC_rpm "" VALUE 0x0000 /* @ECU_Address@KTHC_CompSpdmaxBC_rpm@ */ Scalar_FLOAT32_IEEE 0 SWC_FDC_type_CM_single_rpm 0.0 10000.0 /end CHARACTERISTIC
/begin CHARACTERISTIC KTHC_CompSpdmax_rpm "" VALUE 0x0000 /* @ECU_Address@KTHC_CompSpdmax_rpm@ */ Scalar_FLOAT32_IEEE 0 SWC_FDC_type_CM_single_rpm 0.0 10000.0 /end CHARACTERISTIC
/begin CHARACTERISTIC KTHC_CompSpdmid_rpm "" VALUE 0x0000 /* @ECU_Address@KTHC_CompSpdmid_rpm@ */ Scalar_FLOAT32_IEEE 0 SWC_FDC_type_CM_single_rpm 0.0 10000.0 /end CHARACTERISTIC
/begin CHARACTERISTIC KTHC_CompSpdmin_rpm "" VALUE 0x0000 /* @ECU_Address@KTHC_CompSpdmin_rpm@ */ Scalar_FLOAT32_IEEE 0 SWC_FDC_type_CM_single_rpm 0.0 10000.0 /end CHARACTERISTIC
/begin CHARACTERISTIC KTHC_DTCabin11_C "" VALUE 0x0000 /* @ECU_Address@KTHC_DTCabin11_C@ */ Scalar_FLOAT32_IEEE 0 SWC_FDC_type_CM_single_C -40.0 200.0 /end CHARACTERISTIC
/begin CHARACTERISTIC KTHC_DTambSat1_C "" VALUE 0x0000 /* @ECU_Address@KTHC_DTambSat1_C@ */ Scalar_FLOAT32_IEEE 0 SWC_FDC_type_CM_single_C -40.0 200.0 /end CHARACTERISTIC
/begin CHARACTERISTIC KTHC_DTambSat2_C "" VALUE 0x0000 /* @ECU_Address@KTHC_DTambSat2_C@ */ Scalar_FLOAT32_IEEE 0 SWC_FDC_type_CM_single_C -40.0 200.0 /end CHARACTERISTIC
/begin CHARACTERISTIC KTHC_DTambSat5_C "" VALUE 0x0000 /* @ECU_Address@KTHC_DTambSat5_C@ */ Scalar_FLOAT32_IEEE 0 SWC_FDC_type_CM_single_C -40.0 200.0 /end CHARACTERISTIC
/begin CHARACTERISTIC KTHC_DTambSat_C "" VALUE 0x0000 /* @ECU_Address@KTHC_DTambSat_C@ */ Scalar_FLOAT32_IEEE 0 SWC_FDC_type_CM_single_C -40.0 200.0 /end CHARACTERISTIC
/begin CHARACTERISTIC KTHC_DTambsat3_C "" VALUE 0x0000 /* @ECU_Address@KTHC_DTambsat3_C@ */ Scalar_FLOAT32_IEEE 0 SWC_FDC_type_CM_single_C -40.0 200.0 /end CHARACTERISTIC
/begin CHARACTERISTIC KTHC_DTambsat4_C "" VALUE 0x0000 /* @ECU_Address@KTHC_DTambsat4_C@ */ Scalar_FLOAT32_IEEE 0 SWC_FDC_type_CM_single_C -40.0 200.0 /end CHARACTERISTIC
/begin CHARACTERISTIC KTHC_DTcabin10_C "" VALUE 0x0000 /* @ECU_Address@KTHC_DTcabin10_C@ */ Scalar_FLOAT32_IEEE 0 SWC_FDC_type_CM_single_C -40.0 200.0 /end CHARACTERISTIC
/begin CHARACTERISTIC KTHC_DTcabin12_C "" VALUE 0x0000 /* @ECU_Address@KTHC_DTcabin12_C@ */ Scalar_FLOAT32_IEEE 0 SWC_FDC_type_CM_single_C -40.0 200.0 /end CHARACTERISTIC
/begin CHARACTERISTIC KTHC_DTcabin1_C "" VALUE 0x0000 /* @ECU_Address@KTHC_DTcabin1_C@ */ Scalar_FLOAT32_IEEE 0 SWC_FDC_type_CM_single_C -40.0 200.0 /end CHARACTERISTIC
/begin CHARACTERISTIC KTHC_DTcabin2_C "" VALUE 0x0000 /* @ECU_Address@KTHC_DTcabin2_C@ */ Scalar_FLOAT32_IEEE 0 SWC_FDC_type_CM_single_C -40.0 200.0 /end CHARACTERISTIC
/begin CHARACTERISTIC KTHC_DTcabin3_C "" VALUE 0x0000 /* @ECU_Address@KTHC_DTcabin3_C@ */ Scalar_FLOAT32_IEEE 0 SWC_FDC_type_CM_single_C -40.0 200.0 /end CHARACTERISTIC
/begin CHARACTERISTIC KTHC_DTcabin4_C "" VALUE 0x0000 /* @ECU_Address@KTHC_DTcabin4_C@ */ Scalar_FLOAT32_IEEE 0 SWC_FDC_type_CM_single_C -40.0 200.0 /end CHARACTERISTIC
/begin CHARACTERISTIC KTHC_DTcabin5_C "" VALUE 0x0000 /* @ECU_Address@KTHC_DTcabin5_C@ */ Scalar_FLOAT32_IEEE 0 SWC_FDC_type_CM_single_C -40.0 200.0 /end CHARACTERISTIC
/begin CHARACTERISTIC KTHC_DTcabin6_C "" VALUE 0x0000 /* @ECU_Address@KTHC_DTcabin6_C@ */ Scalar_FLOAT32_IEEE 0 SWC_FDC_type_CM_single_C -40.0 200.0 /end CHARACTERISTIC
/begin CHARACTERISTIC KTHC_DTcabin7_C "" VALUE 0x0000 /* @ECU_Address@KTHC_DTcabin7_C@ */ Scalar_FLOAT32_IEEE 0 SWC_FDC_type_CM_single_C -40.0 200.0 /end CHARACTERISTIC
/begin CHARACTERISTIC KTHC_DTcabin9_C "" VALUE 0x0000 /* @ECU_Address@KTHC_DTcabin9_C@ */ Scalar_FLOAT32_IEEE 0 SWC_FDC_type_CM_single_C -40.0 200.0 /end CHARACTERISTIC
/begin CHARACTERISTIC KTHC_DTcabin_C "" VALUE 0x0000 /* @ECU_Address@KTHC_DTcabin_C@ */ Scalar_FLOAT32_IEEE 0 SWC_FDC_type_CM_single_C -10.0 10.0 /end CHARACTERISTIC
/begin CHARACTERISTIC KTHC_DTh1_C "" VALUE 0x0000 /* @ECU_Address@KTHC_DTh1_C@ */ Scalar_FLOAT32_IEEE 0 SWC_FDC_type_CM_single_C -40.0 200.0 /end CHARACTERISTIC
/begin CHARACTERISTIC KTHC_DTreturn1_C "" VALUE 0x0000 /* @ECU_Address@KTHC_DTreturn1_C@ */ Scalar_FLOAT32_IEEE 0 SWC_FDC_type_CM_single_C -10.0 10.0 /end CHARACTERISTIC
/begin CHARACTERISTIC KTHC_DTreturn2_C "" VALUE 0x0000 /* @ECU_Address@KTHC_DTreturn2_C@ */ Scalar_FLOAT32_IEEE 0 SWC_FDC_type_CM_single_C -40.0 200.0 /end CHARACTERISTIC
/begin CHARACTERISTIC KTHC_DTreturn3_C "" VALUE 0x0000 /* @ECU_Address@KTHC_DTreturn3_C@ */ Scalar_FLOAT32_IEEE 0 SWC_FDC_type_CM_single_C -40.0 200.0 /end CHARACTERISTIC
/begin CHARACTERISTIC KTHC_DTreturn6_C "" VALUE 0x0000 /* @ECU_Address@KTHC_DTreturn6_C@ */ Scalar_FLOAT32_IEEE 0 SWC_FDC_type_CM_single_C -40.0 200.0 /end CHARACTERISTIC
/begin CHARACTERISTIC KTHC_DTreturn7_C "" VALUE 0x0000 /* @ECU_Address@KTHC_DTreturn7_C@ */ Scalar_FLOAT32_IEEE 0 SWC_FDC_type_CM_single_C -40.0 200.0 /end CHARACTERISTIC
/begin CHARACTERISTIC KTHC_DTreturn_C "" VALUE 0x0000 /* @ECU_Address@KTHC_DTreturn_C@ */ Scalar_FLOAT32_IEEE 0 SWC_FDC_type_CM_single_C -10.0 10.0 /end CHARACTERISTIC
/begin CHARACTERISTIC KTHC_DTwBBin_C "" VALUE 0x0000 /* @ECU_Address@KTHC_DTwBBin_C@ */ Scalar_FLOAT32_IEEE 0 SWC_FDC_type_CM_single_C -40.0 200.0 /end CHARACTERISTIC
/begin CHARACTERISTIC KTHC_DTwBMoin1_C "" VALUE 0x0000 /* @ECU_Address@KTHC_DTwBMoin1_C@ */ Scalar_FLOAT32_IEEE 0 SWC_FDC_type_CM_single_C -40.0 200.0 /end CHARACTERISTIC
/begin CHARACTERISTIC KTHC_DTwBMoin2_C "" VALUE 0x0000 /* @ECU_Address@KTHC_DTwBMoin2_C@ */ Scalar_FLOAT32_IEEE 0 SWC_FDC_type_CM_single_C -40.0 200.0 /end CHARACTERISTIC
/begin CHARACTERISTIC KTHC_DTwBMoin3_C "" VALUE 0x0000 /* @ECU_Address@KTHC_DTwBMoin3_C@ */ Scalar_FLOAT32_IEEE 0 SWC_FDC_type_CM_single_C -40.0 200.0 /end CHARACTERISTIC
/begin CHARACTERISTIC KTHC_DcChSetTemp_C "" VALUE 0x0000 /* @ECU_Address@KTHC_DcChSetTemp_C@ */ Scalar_FLOAT32_IEEE 0 SWC_FDC_type_CM_single_C -40.0 200.0 /end CHARACTERISTIC
/begin CHARACTERISTIC KTHC_DriveLevelWPTCBAH1_W "" VALUE 0x0000 /* @ECU_Address@KTHC_DriveLevelWPTCBAH1_W@ */ Scalar_FLOAT32_IEEE 0 SWC_FDC_type_CM_single_W 0.0 10000.0 /end CHARACTERISTIC
/begin CHARACTERISTIC KTHC_DriveLevelWPTCBAH2_W "" VALUE 0x0000 /* @ECU_Address@KTHC_DriveLevelWPTCBAH2_W@ */ Scalar_FLOAT32_IEEE 0 SWC_FDC_type_CM_single_W 0.0 10000.0 /end CHARACTERISTIC
/begin CHARACTERISTIC KTHC_DriveLevelWPTCBAH3_W "" VALUE 0x0000 /* @ECU_Address@KTHC_DriveLevelWPTCBAH3_W@ */ Scalar_FLOAT32_IEEE 0 SWC_FDC_type_CM_single_W 0.0 10000.0 /end CHARACTERISTIC
/begin CHARACTERISTIC KTHC_DriveLevelWPTCBAH4_W "" VALUE 0x0000 /* @ECU_Address@KTHC_DriveLevelWPTCBAH4_W@ */ Scalar_FLOAT32_IEEE 0 SWC_FDC_type_CM_single_W 0.0 10000.0 /end CHARACTERISTIC
/begin CHARACTERISTIC KTHC_DriveT1MinBAH_C "" VALUE 0x0000 /* @ECU_Address@KTHC_DriveT1MinBAH_C@ */ Scalar_FLOAT32_IEEE 0 SWC_FDC_type_CM_single_C -40.0 200.0 /end CHARACTERISTIC
/begin CHARACTERISTIC KTHC_DriveT2MaxBAH_C "" VALUE 0x0000 /* @ECU_Address@KTHC_DriveT2MaxBAH_C@ */ Scalar_FLOAT32_IEEE 0 SWC_FDC_type_CM_single_C -40.0 200.0 /end CHARACTERISTIC
/begin CHARACTERISTIC KTHC_DriveT2MinBAH_C "" VALUE 0x0000 /* @ECU_Address@KTHC_DriveT2MinBAH_C@ */ Scalar_FLOAT32_IEEE 0 SWC_FDC_type_CM_single_C -40.0 200.0 /end CHARACTERISTIC
/begin CHARACTERISTIC KTHC_DriveT3MaxBAH_C "" VALUE 0x0000 /* @ECU_Address@KTHC_DriveT3MaxBAH_C@ */ Scalar_FLOAT32_IEEE 0 SWC_FDC_type_CM_single_C -40.0 200.0 /end CHARACTERISTIC
/begin CHARACTERISTIC KTHC_DriveT3MinBAH_C "" VALUE 0x0000 /* @ECU_Address@KTHC_DriveT3MinBAH_C@ */ Scalar_FLOAT32_IEEE 0 SWC_FDC_type_CM_single_C -40.0 200.0 /end CHARACTERISTIC
/begin CHARACTERISTIC KTHC_DriveT4MaxBAH_C "" VALUE 0x0000 /* @ECU_Address@KTHC_DriveT4MaxBAH_C@ */ Scalar_FLOAT32_IEEE 0 SWC_FDC_type_CM_single_C -40.0 200.0 /end CHARACTERISTIC
/begin CHARACTERISTIC KTHC_ECOTambLV1_C "" VALUE 0x0000 /* @ECU_Address@KTHC_ECOTambLV1_C@ */ Scalar_FLOAT32_IEEE 0 SWC_FDC_type_CM_single_C -40.0 200.0 /end CHARACTERISTIC
/begin CHARACTERISTIC KTHC_ECOTambLV2_C "" VALUE 0x0000 /* @ECU_Address@KTHC_ECOTambLV2_C@ */ Scalar_FLOAT32_IEEE 0 SWC_FDC_type_CM_single_C -40.0 200.0 /end CHARACTERISTIC
/begin CHARACTERISTIC KTHC_ECOTambLV3_C "" VALUE 0x0000 /* @ECU_Address@KTHC_ECOTambLV3_C@ */ Scalar_FLOAT32_IEEE 0 SWC_FDC_type_CM_single_C -40.0 200.0 /end CHARACTERISTIC
/begin CHARACTERISTIC KTHC_ECOTambLV4_C "" VALUE 0x0000 /* @ECU_Address@KTHC_ECOTambLV4_C@ */ Scalar_FLOAT32_IEEE 0 SWC_FDC_type_CM_single_C -40.0 200.0 /end CHARACTERISTIC
/begin CHARACTERISTIC KTHC_ECOTambLV5_C "" VALUE 0x0000 /* @ECU_Address@KTHC_ECOTambLV5_C@ */ Scalar_FLOAT32_IEEE 0 SWC_FDC_type_CM_single_C -40.0 200.0 /end CHARACTERISTIC
/begin CHARACTERISTIC KTHC_ECOTambLV6_C "" VALUE 0x0000 /* @ECU_Address@KTHC_ECOTambLV6_C@ */ Scalar_FLOAT32_IEEE 0 SWC_FDC_type_CM_single_C -40.0 200.0 /end CHARACTERISTIC
/begin CHARACTERISTIC KTHC_ECOTambLV7_C "" VALUE 0x0000 /* @ECU_Address@KTHC_ECOTambLV7_C@ */ Scalar_FLOAT32_IEEE 0 SWC_FDC_type_CM_single_C -40.0 200.0 /end CHARACTERISTIC
/begin CHARACTERISTIC KTHC_ECOTambLV8_C "" VALUE 0x0000 /* @ECU_Address@KTHC_ECOTambLV8_C@ */ Scalar_FLOAT32_IEEE 0 SWC_FDC_type_CM_single_C -40.0 200.0 /end CHARACTERISTIC
/begin CHARACTERISTIC KTHC_ECOalpha1_K "" VALUE 0x0000 /* @ECU_Address@KTHC_ECOalpha1_K@ */ Scalar_FLOAT32_IEEE 0 SWC_FDC_type_CM_single_K -10.0 10.0 /end CHARACTERISTIC
/begin CHARACTERISTIC KTHC_ECOalpha2_K "" VALUE 0x0000 /* @ECU_Address@KTHC_ECOalpha2_K@ */ Scalar_FLOAT32_IEEE 0 SWC_FDC_type_CM_single_K -10.0 10.0 /end CHARACTERISTIC
/begin CHARACTERISTIC KTHC_ECOalpha3_K "" VALUE 0x0000 /* @ECU_Address@KTHC_ECOalpha3_K@ */ Scalar_FLOAT32_IEEE 0 SWC_FDC_type_CM_single_K -10.0 10.0 /end CHARACTERISTIC
/begin CHARACTERISTIC KTHC_ECOalpha4_K "" VALUE 0x0000 /* @ECU_Address@KTHC_ECOalpha4_K@ */ Scalar_FLOAT32_IEEE 0 SWC_FDC_type_CM_single_K -10.0 10.0 /end CHARACTERISTIC
/begin CHARACTERISTIC KTHC_ECOalpha5_K "" VALUE 0x0000 /* @ECU_Address@KTHC_ECOalpha5_K@ */ Scalar_FLOAT32_IEEE 0 SWC_FDC_type_CM_single_K -10.0 10.0 /end CHARACTERISTIC
/begin CHARACTERISTIC KTHC_ECOalpha6_K "" VALUE 0x0000 /* @ECU_Address@KTHC_ECOalpha6_K@ */ Scalar_FLOAT32_IEEE 0 SWC_FDC_type_CM_single_K -10.0 10.0 /end CHARACTERISTIC
/begin CHARACTERISTIC KTHC_ECOalpha7_K "" VALUE 0x0000 /* @ECU_Address@KTHC_ECOalpha7_K@ */ Scalar_FLOAT32_IEEE 0 SWC_FDC_type_CM_single_K -10.0 10.0 /end CHARACTERISTIC
/begin CHARACTERISTIC KTHC_ECOalpha8_K "" VALUE 0x0000 /* @ECU_Address@KTHC_ECOalpha8_K@ */ Scalar_FLOAT32_IEEE 0 SWC_FDC_type_CM_single_K -10.0 10.0 /end CHARACTERISTIC
/begin CHARACTERISTIC KTHC_ECOalpha9_K "" VALUE 0x0000 /* @ECU_Address@KTHC_ECOalpha9_K@ */ Scalar_FLOAT32_IEEE 0 SWC_FDC_type_CM_single_K -10.0 10.0 /end CHARACTERISTIC
/begin CHARACTERISTIC KTHC_ECObeta1_K "" VALUE 0x0000 /* @ECU_Address@KTHC_ECObeta1_K@ */ Scalar_FLOAT32_IEEE 0 SWC_FDC_type_CM_single_K -10.0 10.0 /end CHARACTERISTIC
/begin CHARACTERISTIC KTHC_ECObeta2_K "" VALUE 0x0000 /* @ECU_Address@KTHC_ECObeta2_K@ */ Scalar_FLOAT32_IEEE 0 SWC_FDC_type_CM_single_K -10.0 10.0 /end CHARACTERISTIC
/begin CHARACTERISTIC KTHC_ECObeta3_K "" VALUE 0x0000 /* @ECU_Address@KTHC_ECObeta3_K@ */ Scalar_FLOAT32_IEEE 0 SWC_FDC_type_CM_single_K -10.0 10.0 /end CHARACTERISTIC
/begin CHARACTERISTIC KTHC_ECObeta4_K "" VALUE 0x0000 /* @ECU_Address@KTHC_ECObeta4_K@ */ Scalar_FLOAT32_IEEE 0 SWC_FDC_type_CM_single_K -10.0 10.0 /end CHARACTERISTIC
/begin CHARACTERISTIC KTHC_ECObeta5_K "" VALUE 0x0000 /* @ECU_Address@KTHC_ECObeta5_K@ */ Scalar_FLOAT32_IEEE 0 SWC_FDC_type_CM_single_K -10.0 10.0 /end CHARACTERISTIC
/begin CHARACTERISTIC KTHC_ECObeta6_K "" VALUE 0x0000 /* @ECU_Address@KTHC_ECObeta6_K@ */ Scalar_FLOAT32_IEEE 0 SWC_FDC_type_CM_single_K -10.0 10.0 /end CHARACTERISTIC
/begin CHARACTERISTIC KTHC_ECObeta7_K "" VALUE 0x0000 /* @ECU_Address@KTHC_ECObeta7_K@ */ Scalar_FLOAT32_IEEE 0 SWC_FDC_type_CM_single_K -10.0 10.0 /end CHARACTERISTIC
/begin CHARACTERISTIC KTHC_ECObeta8_K "" VALUE 0x0000 /* @ECU_Address@KTHC_ECObeta8_K@ */ Scalar_FLOAT32_IEEE 0 SWC_FDC_type_CM_single_K -10.0 10.0 /end CHARACTERISTIC
/begin CHARACTERISTIC KTHC_ECObeta9_K "" VALUE 0x0000 /* @ECU_Address@KTHC_ECObeta9_K@ */ Scalar_FLOAT32_IEEE 0 SWC_FDC_type_CM_single_K -10.0 10.0 /end CHARACTERISTIC
/begin CHARACTERISTIC KTHC_EXV1SHSetpoint_K "" VALUE 0x0000 /* @ECU_Address@KTHC_EXV1SHSetpoint_K@ */ Scalar_FLOAT32_IEEE 0 SWC_FDC_type_CM_single_K -10000.0 10000.0 /end CHARACTERISTIC
/begin CHARACTERISTIC KTHC_EXV2SHSetpoint_K "" VALUE 0x0000 /* @ECU_Address@KTHC_EXV2SHSetpoint_K@ */ Scalar_FLOAT32_IEEE 0 SWC_FDC_type_CM_single_K -10000.0 10000.0 /end CHARACTERISTIC
/begin CHARACTERISTIC KTHC_ForceLeaveCool_C "" VALUE 0x0000 /* @ECU_Address@KTHC_ForceLeaveCool_C@ */ Scalar_FLOAT32_IEEE 0 SWC_FDC_type_CM_single_C -40.0 200.0 /end CHARACTERISTIC
/begin CHARACTERISTIC KTHC_ForceLeaveHeat_C "" VALUE 0x0000 /* @ECU_Address@KTHC_ForceLeaveHeat_C@ */ Scalar_FLOAT32_IEEE 0 SWC_FDC_type_CM_single_C -40.0 200.0 /end CHARACTERISTIC
/begin CHARACTERISTIC KTHC_HeatingFactor_C "" VALUE 0x0000 /* @ECU_Address@KTHC_HeatingFactor_C@ */ Scalar_FLOAT32_IEEE 0 SWC_FDC_type_CM_single_C 0.0 10.0 /end CHARACTERISTIC
/begin CHARACTERISTIC KTHC_KiAPTCDcCh_K "" VALUE 0x0000 /* @ECU_Address@KTHC_KiAPTCDcCh_K@ */ Scalar_FLOAT32_IEEE 0 SWC_FDC_type_CM_single_K -10000.0 10000.0 /end CHARACTERISTIC
/begin CHARACTERISTIC KTHC_KiAPTCDeice_K "" VALUE 0x0000 /* @ECU_Address@KTHC_KiAPTCDeice_K@ */ Scalar_FLOAT32_IEEE 0 SWC_FDC_type_CM_single_K -10000.0 10000.0 /end CHARACTERISTIC
/begin CHARACTERISTIC KTHC_KiAPTCTcabinC2_K "" VALUE 0x0000 /* @ECU_Address@KTHC_KiAPTCTcabinC2_K@ */ Scalar_FLOAT32_IEEE 0 SWC_FDC_type_CM_single_K -10000.0 10000.0 /end CHARACTERISTIC
/begin CHARACTERISTIC KTHC_KiAPTCTcabinC_K "" VALUE 0x0000 /* @ECU_Address@KTHC_KiAPTCTcabinC_K@ */ Scalar_FLOAT32_IEEE 0 SWC_FDC_type_CM_single_K -10000.0 10000.0 /end CHARACTERISTIC
/begin CHARACTERISTIC KTHC_KiAPTCTcabinD1_K "" VALUE 0x0000 /* @ECU_Address@KTHC_KiAPTCTcabinD1_K@ */ Scalar_FLOAT32_IEEE 0 SWC_FDC_type_CM_single_K -10000.0 10000.0 /end CHARACTERISTIC
/begin CHARACTERISTIC KTHC_KiAPTCTcabinD2_K "" VALUE 0x0000 /* @ECU_Address@KTHC_KiAPTCTcabinD2_K@ */ Scalar_FLOAT32_IEEE 0 SWC_FDC_type_CM_single_K -10000.0 10000.0 /end CHARACTERISTIC
/begin CHARACTERISTIC KTHC_KiAPTCTcabinD3_K "" VALUE 0x0000 /* @ECU_Address@KTHC_KiAPTCTcabinD3_K@ */ Scalar_FLOAT32_IEEE 0 SWC_FDC_type_CM_single_K -10000.0 10000.0 /end CHARACTERISTIC
/begin CHARACTERISTIC KTHC_KiAPTCTcabinH_K "" VALUE 0x0000 /* @ECU_Address@KTHC_KiAPTCTcabinH_K@ */ Scalar_FLOAT32_IEEE 0 SWC_FDC_type_CM_single_K -10000.0 10000.0 /end CHARACTERISTIC
/begin CHARACTERISTIC KTHC_KiBlowerDeice_K "" VALUE 0x0000 /* @ECU_Address@KTHC_KiBlowerDeice_K@ */ Scalar_FLOAT32_IEEE 0 SWC_FDC_type_CM_single_K -10000.0 10000.0 /end CHARACTERISTIC
/begin CHARACTERISTIC KTHC_KiBlowerTcabinC_K "" VALUE 0x0000 /* @ECU_Address@KTHC_KiBlowerTcabinC_K@ */ Scalar_FLOAT32_IEEE 0 SWC_FDC_type_CM_single_K -10000.0 10000.0 /end CHARACTERISTIC
/begin CHARACTERISTIC KTHC_KiBlowerTcabinD_K "" VALUE 0x0000 /* @ECU_Address@KTHC_KiBlowerTcabinD_K@ */ Scalar_FLOAT32_IEEE 0 SWC_FDC_type_CM_single_K -10000.0 10000.0 /end CHARACTERISTIC
/begin CHARACTERISTIC KTHC_KiBlowerTcabinH_K "" VALUE 0x0000 /* @ECU_Address@KTHC_KiBlowerTcabinH_K@ */ Scalar_FLOAT32_IEEE 0 SWC_FDC_type_CM_single_K -10000.0 10000.0 /end CHARACTERISTIC
/begin CHARACTERISTIC KTHC_KiCompPhigh_K "" VALUE 0x0000 /* @ECU_Address@KTHC_KiCompPhigh_K@ */ Scalar_FLOAT32_IEEE 0 SWC_FDC_type_CM_single_K -10000.0 10000.0 /end CHARACTERISTIC
/begin CHARACTERISTIC KTHC_KiCompPlow1_K "" VALUE 0x0000 /* @ECU_Address@KTHC_KiCompPlow1_K@ */ Scalar_FLOAT32_IEEE 0 SWC_FDC_type_CM_single_K -10000.0 10000.0 /end CHARACTERISTIC
/begin CHARACTERISTIC KTHC_KiCompPlow2_K "" VALUE 0x0000 /* @ECU_Address@KTHC_KiCompPlow2_K@ */ Scalar_FLOAT32_IEEE 0 SWC_FDC_type_CM_single_K -10000.0 10000.0 /end CHARACTERISTIC
/begin CHARACTERISTIC KTHC_KiCompTcabinC1_K "" VALUE 0x0000 /* @ECU_Address@KTHC_KiCompTcabinC1_K@ */ Scalar_FLOAT32_IEEE 0 SWC_FDC_type_CM_single_K -10000.0 10000.0 /end CHARACTERISTIC
/begin CHARACTERISTIC KTHC_KiCompTcabinC_K "" VALUE 0x0000 /* @ECU_Address@KTHC_KiCompTcabinC_K@ */ Scalar_FLOAT32_IEEE 0 SWC_FDC_type_CM_single_K -10000.0 10000.0 /end CHARACTERISTIC
/begin CHARACTERISTIC KTHC_KiCompTcabinD_K "" VALUE 0x0000 /* @ECU_Address@KTHC_KiCompTcabinD_K@ */ Scalar_FLOAT32_IEEE 0 SWC_FDC_type_CM_single_K -10000.0 10000.0 /end CHARACTERISTIC
/begin CHARACTERISTIC KTHC_KiCompTcabinH_K "" VALUE 0x0000 /* @ECU_Address@KTHC_KiCompTcabinH_K@ */ Scalar_FLOAT32_IEEE 0 SWC_FDC_type_CM_single_K -10000.0 10000.0 /end CHARACTERISTIC
/begin CHARACTERISTIC KTHC_KiCompTwinC_K "" VALUE 0x0000 /* @ECU_Address@KTHC_KiCompTwinC_K@ */ Scalar_FLOAT32_IEEE 0 SWC_FDC_type_CM_single_K -10000.0 10000.0 /end CHARACTERISTIC
/begin CHARACTERISTIC KTHC_KiCompTwinD_K "" VALUE 0x0000 /* @ECU_Address@KTHC_KiCompTwinD_K@ */ Scalar_FLOAT32_IEEE 0 SWC_FDC_type_CM_single_K -10000.0 10000.0 /end CHARACTERISTIC
/begin CHARACTERISTIC KTHC_KpAPTCDcCh_K "" VALUE 0x0000 /* @ECU_Address@KTHC_KpAPTCDcCh_K@ */ Scalar_FLOAT32_IEEE 0 SWC_FDC_type_CM_single_K -10000.0 10000.0 /end CHARACTERISTIC
/begin CHARACTERISTIC KTHC_KpAPTCDeice_K "" VALUE 0x0000 /* @ECU_Address@KTHC_KpAPTCDeice_K@ */ Scalar_FLOAT32_IEEE 0 SWC_FDC_type_CM_single_K -10000.0 10000.0 /end CHARACTERISTIC
/begin CHARACTERISTIC KTHC_KpAPTCTcabinC2_K "" VALUE 0x0000 /* @ECU_Address@KTHC_KpAPTCTcabinC2_K@ */ Scalar_FLOAT32_IEEE 0 SWC_FDC_type_CM_single_K -10000.0 10000.0 /end CHARACTERISTIC
/begin CHARACTERISTIC KTHC_KpAPTCTcabinC_K "" VALUE 0x0000 /* @ECU_Address@KTHC_KpAPTCTcabinC_K@ */ Scalar_FLOAT32_IEEE 0 SWC_FDC_type_CM_single_K -10000.0 10000.0 /end CHARACTERISTIC
/begin CHARACTERISTIC KTHC_KpAPTCTcabinD1_K "" VALUE 0x0000 /* @ECU_Address@KTHC_KpAPTCTcabinD1_K@ */ Scalar_FLOAT32_IEEE 0 SWC_FDC_type_CM_single_K -10000.0 10000.0 /end CHARACTERISTIC
/begin CHARACTERISTIC KTHC_KpAPTCTcabinD2_K "" VALUE 0x0000 /* @ECU_Address@KTHC_KpAPTCTcabinD2_K@ */ Scalar_FLOAT32_IEEE 0 SWC_FDC_type_CM_single_K -10000.0 10000.0 /end CHARACTERISTIC
/begin CHARACTERISTIC KTHC_KpAPTCTcabinD3_K "" VALUE 0x0000 /* @ECU_Address@KTHC_KpAPTCTcabinD3_K@ */ Scalar_FLOAT32_IEEE 0 SWC_FDC_type_CM_single_K -10000.0 10000.0 /end CHARACTERISTIC
/begin CHARACTERISTIC KTHC_KpAPTCTcabinH_K "" VALUE 0x0000 /* @ECU_Address@KTHC_KpAPTCTcabinH_K@ */ Scalar_FLOAT32_IEEE 0 SWC_FDC_type_CM_single_K -10000.0 10000.0 /end CHARACTERISTIC
/begin CHARACTERISTIC KTHC_KpBlowerDeice_K "" VALUE 0x0000 /* @ECU_Address@KTHC_KpBlowerDeice_K@ */ Scalar_FLOAT32_IEEE 0 SWC_FDC_type_CM_single_K -10000.0 10000.0 /end CHARACTERISTIC
/begin CHARACTERISTIC KTHC_KpBlowerTcabinC_K "" VALUE 0x0000 /* @ECU_Address@KTHC_KpBlowerTcabinC_K@ */ Scalar_FLOAT32_IEEE 0 SWC_FDC_type_CM_single_K -10000.0 10000.0 /end CHARACTERISTIC
/begin CHARACTERISTIC KTHC_KpBlowerTcabinD_K "" VALUE 0x0000 /* @ECU_Address@KTHC_KpBlowerTcabinD_K@ */ Scalar_FLOAT32_IEEE 0 SWC_FDC_type_CM_single_K -10000.0 10000.0 /end CHARACTERISTIC
/begin CHARACTERISTIC KTHC_KpBlowerTcabinH_K "" VALUE 0x0000 /* @ECU_Address@KTHC_KpBlowerTcabinH_K@ */ Scalar_FLOAT32_IEEE 0 SWC_FDC_type_CM_single_K -10000.0 10000.0 /end CHARACTERISTIC
/begin CHARACTERISTIC KTHC_KpCompPhigh_K "" VALUE 0x0000 /* @ECU_Address@KTHC_KpCompPhigh_K@ */ Scalar_FLOAT32_IEEE 0 SWC_FDC_type_CM_single_K -10000.0 10000.0 /end CHARACTERISTIC
/begin CHARACTERISTIC KTHC_KpCompPlow1_K "" VALUE 0x0000 /* @ECU_Address@KTHC_KpCompPlow1_K@ */ Scalar_FLOAT32_IEEE 0 SWC_FDC_type_CM_single_K -10000.0 10000.0 /end CHARACTERISTIC
/begin CHARACTERISTIC KTHC_KpCompPlow2_K "" VALUE 0x0000 /* @ECU_Address@KTHC_KpCompPlow2_K@ */ Scalar_FLOAT32_IEEE 0 SWC_FDC_type_CM_single_K -10000.0 10000.0 /end CHARACTERISTIC
/begin CHARACTERISTIC KTHC_KpCompTcabinC1_K "" VALUE 0x0000 /* @ECU_Address@KTHC_KpCompTcabinC1_K@ */ Scalar_FLOAT32_IEEE 0 SWC_FDC_type_CM_single_K -10000.0 10000.0 /end CHARACTERISTIC
/begin CHARACTERISTIC KTHC_KpCompTcabinC_K "" VALUE 0x0000 /* @ECU_Address@KTHC_KpCompTcabinC_K@ */ Scalar_FLOAT32_IEEE 0 SWC_FDC_type_CM_single_K -10000.0 10000.0 /end CHARACTERISTIC
/begin CHARACTERISTIC KTHC_KpCompTcabinD_K "" VALUE 0x0000 /* @ECU_Address@KTHC_KpCompTcabinD_K@ */ Scalar_FLOAT32_IEEE 0 SWC_FDC_type_CM_single_K -10000.0 10000.0 /end CHARACTERISTIC
/begin CHARACTERISTIC KTHC_KpCompTcabinH_K "" VALUE 0x0000 /* @ECU_Address@KTHC_KpCompTcabinH_K@ */ Scalar_FLOAT32_IEEE 0 SWC_FDC_type_CM_single_K -10000.0 10000.0 /end CHARACTERISTIC
/begin CHARACTERISTIC KTHC_KpCompTwinC_K "" VALUE 0x0000 /* @ECU_Address@KTHC_KpCompTwinC_K@ */ Scalar_FLOAT32_IEEE 0 SWC_FDC_type_CM_single_K -10000.0 10000.0 /end CHARACTERISTIC
/begin CHARACTERISTIC KTHC_KpCompTwinD_K "" VALUE 0x0000 /* @ECU_Address@KTHC_KpCompTwinD_K@ */ Scalar_FLOAT32_IEEE 0 SWC_FDC_type_CM_single_K -10000.0 10000.0 /end CHARACTERISTIC
/begin CHARACTERISTIC KTHC_KrpmCompPhigh_K "" VALUE 0x0000 /* @ECU_Address@KTHC_KrpmCompPhigh_K@ */ Scalar_FLOAT32_IEEE 0 SWC_FDC_type_CM_single_K -10000.0 10000.0 /end CHARACTERISTIC
/begin CHARACTERISTIC KTHC_KrpmCompPlow1_K "" VALUE 0x0000 /* @ECU_Address@KTHC_KrpmCompPlow1_K@ */ Scalar_FLOAT32_IEEE 0 SWC_FDC_type_CM_single_K -10000.0 10000.0 /end CHARACTERISTIC
/begin CHARACTERISTIC KTHC_KrpmCompPlow2_K "" VALUE 0x0000 /* @ECU_Address@KTHC_KrpmCompPlow2_K@ */ Scalar_FLOAT32_IEEE 0 SWC_FDC_type_CM_single_K -10000.0 10000.0 /end CHARACTERISTIC
/begin CHARACTERISTIC KTHC_KrpmCompTcabinC1_K "" VALUE 0x0000 /* @ECU_Address@KTHC_KrpmCompTcabinC1_K@ */ Scalar_FLOAT32_IEEE 0 SWC_FDC_type_CM_single_K -10000.0 10000.0 /end CHARACTERISTIC
/begin CHARACTERISTIC KTHC_KrpmCompTcabinC_K "" VALUE 0x0000 /* @ECU_Address@KTHC_KrpmCompTcabinC_K@ */ Scalar_FLOAT32_IEEE 0 SWC_FDC_type_CM_single_K -10000.0 10000.0 /end CHARACTERISTIC
/begin CHARACTERISTIC KTHC_KrpmCompTcabinD_K "" VALUE 0x0000 /* @ECU_Address@KTHC_KrpmCompTcabinD_K@ */ Scalar_FLOAT32_IEEE 0 SWC_FDC_type_CM_single_K -10000.0 10000.0 /end CHARACTERISTIC
/begin CHARACTERISTIC KTHC_KrpmCompTcabinH_K "" VALUE 0x0000 /* @ECU_Address@KTHC_KrpmCompTcabinH_K@ */ Scalar_FLOAT32_IEEE 0 SWC_FDC_type_CM_single_K -10000.0 10000.0 /end CHARACTERISTIC
/begin CHARACTERISTIC KTHC_KrpmCompTwinC_K "" VALUE 0x0000 /* @ECU_Address@KTHC_KrpmCompTwinC_K@ */ Scalar_FLOAT32_IEEE 0 SWC_FDC_type_CM_single_K -10000.0 10000.0 /end CHARACTERISTIC
/begin CHARACTERISTIC KTHC_KrpmCompTwinD_K "" VALUE 0x0000 /* @ECU_Address@KTHC_KrpmCompTwinD_K@ */ Scalar_FLOAT32_IEEE 0 SWC_FDC_type_CM_single_K -10000.0 10000.0 /end CHARACTERISTIC
/begin CHARACTERISTIC KTHC_LevelWPTCBAH1_W "" VALUE 0x0000 /* @ECU_Address@KTHC_LevelWPTCBAH1_W@ */ Scalar_FLOAT32_IEEE 0 SWC_FDC_type_CM_single_W 0.0 10000.0 /end CHARACTERISTIC
/begin CHARACTERISTIC KTHC_LevelWPTCBAH2_W "" VALUE 0x0000 /* @ECU_Address@KTHC_LevelWPTCBAH2_W@ */ Scalar_FLOAT32_IEEE 0 SWC_FDC_type_CM_single_W 0.0 10000.0 /end CHARACTERISTIC
/begin CHARACTERISTIC KTHC_LevelWPTCBAH3_W "" VALUE 0x0000 /* @ECU_Address@KTHC_LevelWPTCBAH3_W@ */ Scalar_FLOAT32_IEEE 0 SWC_FDC_type_CM_single_W 0.0 10000.0 /end CHARACTERISTIC
/begin CHARACTERISTIC KTHC_LevelWPTCBAH4_W "" VALUE 0x0000 /* @ECU_Address@KTHC_LevelWPTCBAH4_W@ */ Scalar_FLOAT32_IEEE 0 SWC_FDC_type_CM_single_W 0.0 10000.0 /end CHARACTERISTIC
/begin CHARACTERISTIC KTHC_MotorOutTempDef_C "" VALUE 0x0000 /* @ECU_Address@KTHC_MotorOutTempDef_C@ */ Scalar_FLOAT32_IEEE 0 SWC_FDC_type_CM_single_C -40.0 200.0 /end CHARACTERISTIC
/begin CHARACTERISTIC KTHC_P2MaxHi_kPa "" VALUE 0x0000 /* @ECU_Address@KTHC_P2MaxHi_kPa@ */ Scalar_FLOAT32_IEEE 0 SWC_FDC_type_CM_single_kPa 0.0 10000.0 /end CHARACTERISTIC
/begin CHARACTERISTIC KTHC_P2MinLo_kPa "" VALUE 0x0000 /* @ECU_Address@KTHC_P2MinLo_kPa@ */ Scalar_FLOAT32_IEEE 0 SWC_FDC_type_CM_single_kPa 0.0 10000.0 /end CHARACTERISTIC
/begin CHARACTERISTIC KTHC_P3MaxHi_kPa "" VALUE 0x0000 /* @ECU_Address@KTHC_P3MaxHi_kPa@ */ Scalar_FLOAT32_IEEE 0 SWC_FDC_type_CM_single_kPa 0.0 10000.0 /end CHARACTERISTIC
/begin CHARACTERISTIC KTHC_P3MaxLo_kPa "" VALUE 0x0000 /* @ECU_Address@KTHC_P3MaxLo_kPa@ */ Scalar_FLOAT32_IEEE 0 SWC_FDC_type_CM_single_kPa 0.0 10000.0 /end CHARACTERISTIC
/begin CHARACTERISTIC KTHC_P3MinHi_kPa "" VALUE 0x0000 /* @ECU_Address@KTHC_P3MinHi_kPa@ */ Scalar_FLOAT32_IEEE 0 SWC_FDC_type_CM_single_kPa 0.0 10000.0 /end CHARACTERISTIC
/begin CHARACTERISTIC KTHC_P3MinLo_kPa "" VALUE 0x0000 /* @ECU_Address@KTHC_P3MinLo_kPa@ */ Scalar_FLOAT32_IEEE 0 SWC_FDC_type_CM_single_kPa 0.0 10000.0 /end CHARACTERISTIC
/begin CHARACTERISTIC KTHC_P4MaxHi_kPa "" VALUE 0x0000 /* @ECU_Address@KTHC_P4MaxHi_kPa@ */ Scalar_FLOAT32_IEEE 0 SWC_FDC_type_CM_single_kPa 0.0 10000.0 /end CHARACTERISTIC
/begin CHARACTERISTIC KTHC_P4MaxLo_kPa "" VALUE 0x0000 /* @ECU_Address@KTHC_P4MaxLo_kPa@ */ Scalar_FLOAT32_IEEE 0 SWC_FDC_type_CM_single_kPa 0.0 10000.0 /end CHARACTERISTIC
/begin CHARACTERISTIC KTHC_P4MinHi_kPa "" VALUE 0x0000 /* @ECU_Address@KTHC_P4MinHi_kPa@ */ Scalar_FLOAT32_IEEE 0 SWC_FDC_type_CM_single_kPa 0.0 10000.0 /end CHARACTERISTIC
/begin CHARACTERISTIC KTHC_P4MinLo_kPa "" VALUE 0x0000 /* @ECU_Address@KTHC_P4MinLo_kPa@ */ Scalar_FLOAT32_IEEE 0 SWC_FDC_type_CM_single_kPa 0.0 10000.0 /end CHARACTERISTIC
/begin CHARACTERISTIC KTHC_P5MaxLo_kPa "" VALUE 0x0000 /* @ECU_Address@KTHC_P5MaxLo_kPa@ */ Scalar_FLOAT32_IEEE 0 SWC_FDC_type_CM_single_kPa 0.0 10000.0 /end CHARACTERISTIC
/begin CHARACTERISTIC KTHC_P5MinHi_kPa "" VALUE 0x0000 /* @ECU_Address@KTHC_P5MinHi_kPa@ */ Scalar_FLOAT32_IEEE 0 SWC_FDC_type_CM_single_kPa 0.0 10000.0 /end CHARACTERISTIC
/begin CHARACTERISTIC KTHC_PDeiceMax_kPa "" VALUE 0x0000 /* @ECU_Address@KTHC_PDeiceMax_kPa@ */ Scalar_FLOAT32_IEEE 0 SWC_FDC_type_CM_single_kPa 0.0 3000.0 /end CHARACTERISTIC
/begin CHARACTERISTIC KTHC_PhiDehum_kPa "" VALUE 0x0000 /* @ECU_Address@KTHC_PhiDehum_kPa@ */ Scalar_FLOAT32_IEEE 0 SWC_FDC_type_CM_single_kPa 0.0 10000.0 /end CHARACTERISTIC
/begin CHARACTERISTIC KTHC_PhighSetpoint_kPa "" VALUE 0x0000 /* @ECU_Address@KTHC_PhighSetpoint_kPa@ */ Scalar_FLOAT32_IEEE 0 SWC_FDC_type_CM_single_kPa -10000.0 10000.0 /end CHARACTERISTIC
/begin CHARACTERISTIC KTHC_Plow1Setpoint_kPa "" VALUE 0x0000 /* @ECU_Address@KTHC_Plow1Setpoint_kPa@ */ Scalar_FLOAT32_IEEE 0 SWC_FDC_type_CM_single_kPa 0.0 10000.0 /end CHARACTERISTIC
/begin CHARACTERISTIC KTHC_Plow2Setpoint_kPa "" VALUE 0x0000 /* @ECU_Address@KTHC_Plow2Setpoint_kPa@ */ Scalar_FLOAT32_IEEE 0 SWC_FDC_type_CM_single_kPa 0.0 10000.0 /end CHARACTERISTIC
/begin CHARACTERISTIC KTHC_SotxvProHi_kPa "" VALUE 0x0000 /* @ECU_Address@KTHC_SotxvProHi_kPa@ */ Scalar_FLOAT32_IEEE 0 SWC_FDC_type_CM_single_kPa 0.0 3000.0 /end CHARACTERISTIC
/begin CHARACTERISTIC KTHC_SotxvProLo_kPa "" VALUE 0x0000 /* @ECU_Address@KTHC_SotxvProLo_kPa@ */ Scalar_FLOAT32_IEEE 0 SWC_FDC_type_CM_single_kPa 0.0 3000.0 /end CHARACTERISTIC
/begin CHARACTERISTIC KTHC_T1MaxBC_C "" VALUE 0x0000 /* @ECU_Address@KTHC_T1MaxBC_C@ */ Scalar_FLOAT32_IEEE 0 SWC_FDC_type_CM_single_C -40.0 200.0 /end CHARACTERISTIC
/begin CHARACTERISTIC KTHC_T1MaxCCU_C "" VALUE 0x0000 /* @ECU_Address@KTHC_T1MaxCCU_C@ */ Scalar_FLOAT32_IEEE 0 SWC_FDC_type_CM_single_C -40.0 200.0 /end CHARACTERISTIC
/begin CHARACTERISTIC KTHC_T1MaxLLC_C "" VALUE 0x0000 /* @ECU_Address@KTHC_T1MaxLLC_C@ */ Scalar_FLOAT32_IEEE 0 SWC_FDC_type_CM_single_C -40.0 200.0 /end CHARACTERISTIC
/begin CHARACTERISTIC KTHC_T1MaxMCU_C "" VALUE 0x0000 /* @ECU_Address@KTHC_T1MaxMCU_C@ */ Scalar_FLOAT32_IEEE 0 SWC_FDC_type_CM_single_C -40.0 200.0 /end CHARACTERISTIC
/begin CHARACTERISTIC KTHC_T1MaxMT_C "" VALUE 0x0000 /* @ECU_Address@KTHC_T1MaxMT_C@ */ Scalar_FLOAT32_IEEE 0 SWC_FDC_type_CM_single_C -40.0 200.0 /end CHARACTERISTIC
/begin CHARACTERISTIC KTHC_T1MinBAH_C "" VALUE 0x0000 /* @ECU_Address@KTHC_T1MinBAH_C@ */ Scalar_FLOAT32_IEEE 0 SWC_FDC_type_CM_single_C -40.0 200.0 /end CHARACTERISTIC
/begin CHARACTERISTIC KTHC_T1MinBH_C "" VALUE 0x0000 /* @ECU_Address@KTHC_T1MinBH_C@ */ Scalar_FLOAT32_IEEE 0 SWC_FDC_type_CM_single_C -40.0 200.0 /end CHARACTERISTIC
/begin CHARACTERISTIC KTHC_T2MaxBAH_C "" VALUE 0x0000 /* @ECU_Address@KTHC_T2MaxBAH_C@ */ Scalar_FLOAT32_IEEE 0 SWC_FDC_type_CM_single_C -40.0 200.0 /end CHARACTERISTIC
/begin CHARACTERISTIC KTHC_T2MaxBC_C "" VALUE 0x0000 /* @ECU_Address@KTHC_T2MaxBC_C@ */ Scalar_FLOAT32_IEEE 0 SWC_FDC_type_CM_single_C -40.0 200.0 /end CHARACTERISTIC
/begin CHARACTERISTIC KTHC_T2MaxBH_C "" VALUE 0x0000 /* @ECU_Address@KTHC_T2MaxBH_C@ */ Scalar_FLOAT32_IEEE 0 SWC_FDC_type_CM_single_C -40.0 200.0 /end CHARACTERISTIC
/begin CHARACTERISTIC KTHC_T2MaxCCU_C "" VALUE 0x0000 /* @ECU_Address@KTHC_T2MaxCCU_C@ */ Scalar_FLOAT32_IEEE 0 SWC_FDC_type_CM_single_C -40.0 200.0 /end CHARACTERISTIC
/begin CHARACTERISTIC KTHC_T2MaxLLC_C "" VALUE 0x0000 /* @ECU_Address@KTHC_T2MaxLLC_C@ */ Scalar_FLOAT32_IEEE 0 SWC_FDC_type_CM_single_C -40.0 200.0 /end CHARACTERISTIC
/begin CHARACTERISTIC KTHC_T2MaxMCU_C "" VALUE 0x0000 /* @ECU_Address@KTHC_T2MaxMCU_C@ */ Scalar_FLOAT32_IEEE 0 SWC_FDC_type_CM_single_C -40.0 200.0 /end CHARACTERISTIC
/begin CHARACTERISTIC KTHC_T2MaxMT_C "" VALUE 0x0000 /* @ECU_Address@KTHC_T2MaxMT_C@ */ Scalar_FLOAT32_IEEE 0 SWC_FDC_type_CM_single_C -40.0 200.0 /end CHARACTERISTIC
/begin CHARACTERISTIC KTHC_T2MinBAH_C "" VALUE 0x0000 /* @ECU_Address@KTHC_T2MinBAH_C@ */ Scalar_FLOAT32_IEEE 0 SWC_FDC_type_CM_single_C -40.0 200.0 /end CHARACTERISTIC
/begin CHARACTERISTIC KTHC_T2MinBC_C "" VALUE 0x0000 /* @ECU_Address@KTHC_T2MinBC_C@ */ Scalar_FLOAT32_IEEE 0 SWC_FDC_type_CM_single_C -40.0 200.0 /end CHARACTERISTIC
/begin CHARACTERISTIC KTHC_T2MinBH_C "" VALUE 0x0000 /* @ECU_Address@KTHC_T2MinBH_C@ */ Scalar_FLOAT32_IEEE 0 SWC_FDC_type_CM_single_C -40.0 200.0 /end CHARACTERISTIC
/begin CHARACTERISTIC KTHC_T2MinCCU_C "" VALUE 0x0000 /* @ECU_Address@KTHC_T2MinCCU_C@ */ Scalar_FLOAT32_IEEE 0 SWC_FDC_type_CM_single_C -40.0 200.0 /end CHARACTERISTIC
/begin CHARACTERISTIC KTHC_T2MinLLC_C "" VALUE 0x0000 /* @ECU_Address@KTHC_T2MinLLC_C@ */ Scalar_FLOAT32_IEEE 0 SWC_FDC_type_CM_single_C -40.0 200.0 /end CHARACTERISTIC
/begin CHARACTERISTIC KTHC_T2MinMCU_C "" VALUE 0x0000 /* @ECU_Address@KTHC_T2MinMCU_C@ */ Scalar_FLOAT32_IEEE 0 SWC_FDC_type_CM_single_C -40.0 200.0 /end CHARACTERISTIC
/begin CHARACTERISTIC KTHC_T2MinMT_C "" VALUE 0x0000 /* @ECU_Address@KTHC_T2MinMT_C@ */ Scalar_FLOAT32_IEEE 0 SWC_FDC_type_CM_single_C -40.0 200.0 /end CHARACTERISTIC
/begin CHARACTERISTIC KTHC_T3MaxBAH_C "" VALUE 0x0000 /* @ECU_Address@KTHC_T3MaxBAH_C@ */ Scalar_FLOAT32_IEEE 0 SWC_FDC_type_CM_single_C -40.0 200.0 /end CHARACTERISTIC
/begin CHARACTERISTIC KTHC_T3MaxBC_C "" VALUE 0x0000 /* @ECU_Address@KTHC_T3MaxBC_C@ */ Scalar_FLOAT32_IEEE 0 SWC_FDC_type_CM_single_C -40.0 200.0 /end CHARACTERISTIC
/begin CHARACTERISTIC KTHC_T3MaxBH_C "" VALUE 0x0000 /* @ECU_Address@KTHC_T3MaxBH_C@ */ Scalar_FLOAT32_IEEE 0 SWC_FDC_type_CM_single_C -40.0 200.0 /end CHARACTERISTIC
/begin CHARACTERISTIC KTHC_T3MaxCCU_C "" VALUE 0x0000 /* @ECU_Address@KTHC_T3MaxCCU_C@ */ Scalar_FLOAT32_IEEE 0 SWC_FDC_type_CM_single_C -40.0 200.0 /end CHARACTERISTIC
/begin CHARACTERISTIC KTHC_T3MaxLLC_C "" VALUE 0x0000 /* @ECU_Address@KTHC_T3MaxLLC_C@ */ Scalar_FLOAT32_IEEE 0 SWC_FDC_type_CM_single_C -40.0 200.0 /end CHARACTERISTIC
/begin CHARACTERISTIC KTHC_T3MaxMCU_C "" VALUE 0x0000 /* @ECU_Address@KTHC_T3MaxMCU_C@ */ Scalar_FLOAT32_IEEE 0 SWC_FDC_type_CM_single_C -40.0 200.0 /end CHARACTERISTIC
/begin CHARACTERISTIC KTHC_T3MaxMT_C "" VALUE 0x0000 /* @ECU_Address@KTHC_T3MaxMT_C@ */ Scalar_FLOAT32_IEEE 0 SWC_FDC_type_CM_single_C -40.0 200.0 /end CHARACTERISTIC
/begin CHARACTERISTIC KTHC_T3MinBAH_C "" VALUE 0x0000 /* @ECU_Address@KTHC_T3MinBAH_C@ */ Scalar_FLOAT32_IEEE 0 SWC_FDC_type_CM_single_C -40.0 200.0 /end CHARACTERISTIC
/begin CHARACTERISTIC KTHC_T3MinBC_C "" VALUE 0x0000 /* @ECU_Address@KTHC_T3MinBC_C@ */ Scalar_FLOAT32_IEEE 0 SWC_FDC_type_CM_single_C -40.0 200.0 /end CHARACTERISTIC
/begin CHARACTERISTIC KTHC_T3MinBH_C "" VALUE 0x0000 /* @ECU_Address@KTHC_T3MinBH_C@ */ Scalar_FLOAT32_IEEE 0 SWC_FDC_type_CM_single_C -40.0 200.0 /end CHARACTERISTIC
/begin CHARACTERISTIC KTHC_T3MinCCU_C "" VALUE 0x0000 /* @ECU_Address@KTHC_T3MinCCU_C@ */ Scalar_FLOAT32_IEEE 0 SWC_FDC_type_CM_single_C -40.0 200.0 /end CHARACTERISTIC
/begin CHARACTERISTIC KTHC_T3MinLLC_C "" VALUE 0x0000 /* @ECU_Address@KTHC_T3MinLLC_C@ */ Scalar_FLOAT32_IEEE 0 SWC_FDC_type_CM_single_C -40.0 200.0 /end CHARACTERISTIC
/begin CHARACTERISTIC KTHC_T3MinMCU_C "" VALUE 0x0000 /* @ECU_Address@KTHC_T3MinMCU_C@ */ Scalar_FLOAT32_IEEE 0 SWC_FDC_type_CM_single_C -40.0 200.0 /end CHARACTERISTIC
/begin CHARACTERISTIC KTHC_T3MinMT_C "" VALUE 0x0000 /* @ECU_Address@KTHC_T3MinMT_C@ */ Scalar_FLOAT32_IEEE 0 SWC_FDC_type_CM_single_C -40.0 200.0 /end CHARACTERISTIC
/begin CHARACTERISTIC KTHC_T3winSetpointBC_C "" VALUE 0x0000 /* @ECU_Address@KTHC_T3winSetpointBC_C@ */ Scalar_FLOAT32_IEEE 0 SWC_FDC_type_CM_single_C -40.0 200.0 /end CHARACTERISTIC
/begin CHARACTERISTIC KTHC_T4MaxBAH_C "" VALUE 0x0000 /* @ECU_Address@KTHC_T4MaxBAH_C@ */ Scalar_FLOAT32_IEEE 0 SWC_FDC_type_CM_single_C -40.0 200.0 /end CHARACTERISTIC
/begin CHARACTERISTIC KTHC_T4MaxBC_C "" VALUE 0x0000 /* @ECU_Address@KTHC_T4MaxBC_C@ */ Scalar_FLOAT32_IEEE 0 SWC_FDC_type_CM_single_C -40.0 200.0 /end CHARACTERISTIC
/begin CHARACTERISTIC KTHC_T4MaxBH_C "" VALUE 0x0000 /* @ECU_Address@KTHC_T4MaxBH_C@ */ Scalar_FLOAT32_IEEE 0 SWC_FDC_type_CM_single_C -40.0 200.0 /end CHARACTERISTIC
/begin CHARACTERISTIC KTHC_T4MaxCCU_C "" VALUE 0x0000 /* @ECU_Address@KTHC_T4MaxCCU_C@ */ Scalar_FLOAT32_IEEE 0 SWC_FDC_type_CM_single_C -40.0 200.0 /end CHARACTERISTIC
/begin CHARACTERISTIC KTHC_T4MaxLLC_C "" VALUE 0x0000 /* @ECU_Address@KTHC_T4MaxLLC_C@ */ Scalar_FLOAT32_IEEE 0 SWC_FDC_type_CM_single_C -40.0 200.0 /end CHARACTERISTIC
/begin CHARACTERISTIC KTHC_T4MaxMCU_C "" VALUE 0x0000 /* @ECU_Address@KTHC_T4MaxMCU_C@ */ Scalar_FLOAT32_IEEE 0 SWC_FDC_type_CM_single_C -40.0 200.0 /end CHARACTERISTIC
/begin CHARACTERISTIC KTHC_T4MaxMT_C "" VALUE 0x0000 /* @ECU_Address@KTHC_T4MaxMT_C@ */ Scalar_FLOAT32_IEEE 0 SWC_FDC_type_CM_single_C -40.0 200.0 /end CHARACTERISTIC
/begin CHARACTERISTIC KTHC_T4MinBC_C "" VALUE 0x0000 /* @ECU_Address@KTHC_T4MinBC_C@ */ Scalar_FLOAT32_IEEE 0 SWC_FDC_type_CM_single_C -40.0 200.0 /end CHARACTERISTIC
/begin CHARACTERISTIC KTHC_T4MinBH_C "" VALUE 0x0000 /* @ECU_Address@KTHC_T4MinBH_C@ */ Scalar_FLOAT32_IEEE 0 SWC_FDC_type_CM_single_C -40.0 200.0 /end CHARACTERISTIC
/begin CHARACTERISTIC KTHC_T4MinCCU_C "" VALUE 0x0000 /* @ECU_Address@KTHC_T4MinCCU_C@ */ Scalar_FLOAT32_IEEE 0 SWC_FDC_type_CM_single_C -40.0 200.0 /end CHARACTERISTIC
/begin CHARACTERISTIC KTHC_T4MinLLC_C "" VALUE 0x0000 /* @ECU_Address@KTHC_T4MinLLC_C@ */ Scalar_FLOAT32_IEEE 0 SWC_FDC_type_CM_single_C -40.0 200.0 /end CHARACTERISTIC
/begin CHARACTERISTIC KTHC_T4MinMCU_C "" VALUE 0x0000 /* @ECU_Address@KTHC_T4MinMCU_C@ */ Scalar_FLOAT32_IEEE 0 SWC_FDC_type_CM_single_C -40.0 200.0 /end CHARACTERISTIC
/begin CHARACTERISTIC KTHC_T4MinMT_C "" VALUE 0x0000 /* @ECU_Address@KTHC_T4MinMT_C@ */ Scalar_FLOAT32_IEEE 0 SWC_FDC_type_CM_single_C -40.0 200.0 /end CHARACTERISTIC
/begin CHARACTERISTIC KTHC_T5MaxBH_C "" VALUE 0x0000 /* @ECU_Address@KTHC_T5MaxBH_C@ */ Scalar_FLOAT32_IEEE 0 SWC_FDC_type_CM_single_C -40.0 200.0 /end CHARACTERISTIC
/begin CHARACTERISTIC KTHC_T5MinBC_C "" VALUE 0x0000 /* @ECU_Address@KTHC_T5MinBC_C@ */ Scalar_FLOAT32_IEEE 0 SWC_FDC_type_CM_single_C -40.0 200.0 /end CHARACTERISTIC
/begin CHARACTERISTIC KTHC_T5MinCCU_C "" VALUE 0x0000 /* @ECU_Address@KTHC_T5MinCCU_C@ */ Scalar_FLOAT32_IEEE 0 SWC_FDC_type_CM_single_C -40.0 200.0 /end CHARACTERISTIC
/begin CHARACTERISTIC KTHC_T5MinLLC_C "" VALUE 0x0000 /* @ECU_Address@KTHC_T5MinLLC_C@ */ Scalar_FLOAT32_IEEE 0 SWC_FDC_type_CM_single_C -40.0 200.0 /end CHARACTERISTIC
/begin CHARACTERISTIC KTHC_T5MinMCU_C "" VALUE 0x0000 /* @ECU_Address@KTHC_T5MinMCU_C@ */ Scalar_FLOAT32_IEEE 0 SWC_FDC_type_CM_single_C -40.0 200.0 /end CHARACTERISTIC
/begin CHARACTERISTIC KTHC_T5MinMT_C "" VALUE 0x0000 /* @ECU_Address@KTHC_T5MinMT_C@ */ Scalar_FLOAT32_IEEE 0 SWC_FDC_type_CM_single_C -40.0 200.0 /end CHARACTERISTIC
/begin CHARACTERISTIC KTHC_TBPmax_C "" VALUE 0x0000 /* @ECU_Address@KTHC_TBPmax_C@ */ Scalar_FLOAT32_IEEE 0 SWC_FDC_type_CM_single_C -40.0 200.0 /end CHARACTERISTIC
/begin CHARACTERISTIC KTHC_TBPmin_C "" VALUE 0x0000 /* @ECU_Address@KTHC_TBPmin_C@ */ Scalar_FLOAT32_IEEE 0 SWC_FDC_type_CM_single_C -40.0 200.0 /end CHARACTERISTIC
/begin CHARACTERISTIC KTHC_TDcChgBC_C "" VALUE 0x0000 /* @ECU_Address@KTHC_TDcChgBC_C@ */ Scalar_FLOAT32_IEEE 0 SWC_FDC_type_CM_single_C -40.0 200.0 /end CHARACTERISTIC
/begin CHARACTERISTIC KTHC_TDeice1_C "" VALUE 0x0000 /* @ECU_Address@KTHC_TDeice1_C@ */ Scalar_FLOAT32_IEEE 0 SWC_FDC_type_CM_single_C -40.0 85.0 /end CHARACTERISTIC
/begin CHARACTERISTIC KTHC_TDeice2_C "" VALUE 0x0000 /* @ECU_Address@KTHC_TDeice2_C@ */ Scalar_FLOAT32_IEEE 0 SWC_FDC_type_CM_single_C -40.0 85.0 /end CHARACTERISTIC
/begin CHARACTERISTIC KTHC_TWinmax_C "" VALUE 0x0000 /* @ECU_Address@KTHC_TWinmax_C@ */ Scalar_FLOAT32_IEEE 0 SWC_FDC_type_CM_single_C -40.0 200.0 /end CHARACTERISTIC
/begin CHARACTERISTIC KTHC_TWinmin_C "" VALUE 0x0000 /* @ECU_Address@KTHC_TWinmin_C@ */ Scalar_FLOAT32_IEEE 0 SWC_FDC_type_CM_single_C -40.0 200.0 /end CHARACTERISTIC
/begin CHARACTERISTIC KTHC_TambACmode1_C "" VALUE 0x0000 /* @ECU_Address@KTHC_TambACmode1_C@ */ Scalar_FLOAT32_IEEE 0 SWC_FDC_type_CM_single_C -40.0 200.0 /end CHARACTERISTIC
/begin CHARACTERISTIC KTHC_TambACmode2_C "" VALUE 0x0000 /* @ECU_Address@KTHC_TambACmode2_C@ */ Scalar_FLOAT32_IEEE 0 SWC_FDC_type_CM_single_C -40.0 200.0 /end CHARACTERISTIC
/begin CHARACTERISTIC KTHC_TambACmode3_C "" VALUE 0x0000 /* @ECU_Address@KTHC_TambACmode3_C@ */ Scalar_FLOAT32_IEEE 0 SWC_FDC_type_CM_single_C -40.0 200.0 /end CHARACTERISTIC
/begin CHARACTERISTIC KTHC_TambACmode4_C "" VALUE 0x0000 /* @ECU_Address@KTHC_TambACmode4_C@ */ Scalar_FLOAT32_IEEE 0 SWC_FDC_type_CM_single_C -40.0 200.0 /end CHARACTERISTIC
/begin CHARACTERISTIC KTHC_TambACmode5_C "" VALUE 0x0000 /* @ECU_Address@KTHC_TambACmode5_C@ */ Scalar_FLOAT32_IEEE 0 SWC_FDC_type_CM_single_C -40.0 200.0 /end CHARACTERISTIC
/begin CHARACTERISTIC KTHC_TambACmode6_C "" VALUE 0x0000 /* @ECU_Address@KTHC_TambACmode6_C@ */ Scalar_FLOAT32_IEEE 0 SWC_FDC_type_CM_single_C -40.0 200.0 /end CHARACTERISTIC
/begin CHARACTERISTIC KTHC_TambACmode7_C "" VALUE 0x0000 /* @ECU_Address@KTHC_TambACmode7_C@ */ Scalar_FLOAT32_IEEE 0 SWC_FDC_type_CM_single_C -40.0 200.0 /end CHARACTERISTIC
/begin CHARACTERISTIC KTHC_TambDef_C "" VALUE 0x0000 /* @ECU_Address@KTHC_TambDef_C@ */ Scalar_FLOAT32_IEEE 0 SWC_FDC_type_CM_single_C -40.0 200.0 /end CHARACTERISTIC
/begin CHARACTERISTIC KTHC_TambHPmin_C "" VALUE 0x0000 /* @ECU_Address@KTHC_TambHPmin_C@ */ Scalar_FLOAT32_IEEE 0 SWC_FDC_type_CM_single_C -40.0 85.0 /end CHARACTERISTIC
/begin CHARACTERISTIC KTHC_TambSetLow_C "" VALUE 0x0000 /* @ECU_Address@KTHC_TambSetLow_C@ */ Scalar_FLOAT32_IEEE 0 SWC_FDC_type_CM_single_C -40.0 200.0 /end CHARACTERISTIC
/begin CHARACTERISTIC KTHC_Tambset_C "" VALUE 0x0000 /* @ECU_Address@KTHC_Tambset_C@ */ Scalar_FLOAT32_IEEE 0 SWC_FDC_type_CM_single_C -40.0 200.0 /end CHARACTERISTIC
/begin CHARACTERISTIC KTHC_Tcoolmin_C "" VALUE 0x0000 /* @ECU_Address@KTHC_Tcoolmin_C@ */ Scalar_FLOAT32_IEEE 0 SWC_FDC_type_CM_single_C -40.0 200.0 /end CHARACTERISTIC
/begin CHARACTERISTIC KTHC_Tdefog_C "" VALUE 0x0000 /* @ECU_Address@KTHC_Tdefog_C@ */ Scalar_FLOAT32_IEEE 0 SWC_FDC_type_CM_single_C -40.0 200.0 /end CHARACTERISTIC
/begin CHARACTERISTIC KTHC_Tdeheat1_C "" VALUE 0x0000 /* @ECU_Address@KTHC_Tdeheat1_C@ */ Scalar_FLOAT32_IEEE 0 SWC_FDC_type_CM_single_C -40.0 200.0 /end CHARACTERISTIC
/begin CHARACTERISTIC KTHC_Tdeheat2_C "" VALUE 0x0000 /* @ECU_Address@KTHC_Tdeheat2_C@ */ Scalar_FLOAT32_IEEE 0 SWC_FDC_type_CM_single_C -40.0 200.0 /end CHARACTERISTIC
/begin CHARACTERISTIC KTHC_Tdeice_C "" VALUE 0x0000 /* @ECU_Address@KTHC_Tdeice_C@ */ Scalar_FLOAT32_IEEE 0 SWC_FDC_type_CM_single_C -40.0 200.0 /end CHARACTERISTIC
/begin CHARACTERISTIC KTHC_TductDef_C "" VALUE 0x0000 /* @ECU_Address@KTHC_TductDef_C@ */ Scalar_FLOAT32_IEEE 0 SWC_FDC_type_CM_single_C -40.0 200.0 /end CHARACTERISTIC
/begin CHARACTERISTIC KTHC_Tevap_C "" VALUE 0x0000 /* @ECU_Address@KTHC_Tevap_C@ */ Scalar_FLOAT32_IEEE 0 SWC_FDC_type_CM_single_C -40.0 200.0 /end CHARACTERISTIC
/begin CHARACTERISTIC KTHC_ThiDehum_C "" VALUE 0x0000 /* @ECU_Address@KTHC_ThiDehum_C@ */ Scalar_FLOAT32_IEEE 0 SWC_FDC_type_CM_single_C -40.0 200.0 /end CHARACTERISTIC
/begin CHARACTERISTIC KTHC_Tice_C "" VALUE 0x0000 /* @ECU_Address@KTHC_Tice_C@ */ Scalar_FLOAT32_IEEE 0 SWC_FDC_type_CM_single_C -40.0 200.0 /end CHARACTERISTIC
/begin CHARACTERISTIC KTHC_TventL1_C "" VALUE 0x0000 /* @ECU_Address@KTHC_TventL1_C@ */ Scalar_FLOAT32_IEEE 0 SWC_FDC_type_CM_single_C -40.0 200.0 /end CHARACTERISTIC
/begin CHARACTERISTIC KTHC_TventL2_C "" VALUE 0x0000 /* @ECU_Address@KTHC_TventL2_C@ */ Scalar_FLOAT32_IEEE 0 SWC_FDC_type_CM_single_C -40.0 200.0 /end CHARACTERISTIC
/begin CHARACTERISTIC KTHC_TventL3_C "" VALUE 0x0000 /* @ECU_Address@KTHC_TventL3_C@ */ Scalar_FLOAT32_IEEE 0 SWC_FDC_type_CM_single_C -40.0 200.0 /end CHARACTERISTIC
/begin CHARACTERISTIC KTHC_TventL4_C "" VALUE 0x0000 /* @ECU_Address@KTHC_TventL4_C@ */ Scalar_FLOAT32_IEEE 0 SWC_FDC_type_CM_single_C -40.0 200.0 /end CHARACTERISTIC
/begin CHARACTERISTIC KTHC_TventL5_C "" VALUE 0x0000 /* @ECU_Address@KTHC_TventL5_C@ */ Scalar_FLOAT32_IEEE 0 SWC_FDC_type_CM_single_C -40.0 200.0 /end CHARACTERISTIC
/begin CHARACTERISTIC KTHC_TwOhtOff_C "" VALUE 0x0000 /* @ECU_Address@KTHC_TwOhtOff_C@ */ Scalar_FLOAT32_IEEE 0 SWC_FDC_type_CM_single_C -40.0 85.0 /end CHARACTERISTIC
/begin CHARACTERISTIC KTHC_TwOhtOn_C "" VALUE 0x0000 /* @ECU_Address@KTHC_TwOhtOn_C@ */ Scalar_FLOAT32_IEEE 0 SWC_FDC_type_CM_single_C -40.0 85.0 /end CHARACTERISTIC
/begin CHARACTERISTIC KTHC_TwRcolOff_C "" VALUE 0x0000 /* @ECU_Address@KTHC_TwRcolOff_C@ */ Scalar_FLOAT32_IEEE 0 SWC_FDC_type_CM_single_C -40.0 200.0 /end CHARACTERISTIC
/begin CHARACTERISTIC KTHC_TwRcolOn_C "" VALUE 0x0000 /* @ECU_Address@KTHC_TwRcolOn_C@ */ Scalar_FLOAT32_IEEE 0 SWC_FDC_type_CM_single_C -40.0 200.0 /end CHARACTERISTIC
/begin CHARACTERISTIC KTHC_Twmset_C "" VALUE 0x0000 /* @ECU_Address@KTHC_Twmset_C@ */ Scalar_FLOAT32_IEEE 0 SWC_FDC_type_CM_single_C -40.0 200.0 /end CHARACTERISTIC
/begin CHARACTERISTIC KTHC_VBRearClosed_K "" VALUE 0x0000 /* @ECU_Address@KTHC_VBRearClosed_K@ */ Scalar_FLOAT32_IEEE 0 SWC_FDC_type_CM_single_K 0.0 1.0 /end CHARACTERISTIC
/begin CHARACTERISTIC KTHC_VBlowerDcCh_K "" VALUE 0x0000 /* @ECU_Address@KTHC_VBlowerDcCh_K@ */ Scalar_FLOAT32_IEEE 0 SWC_FDC_type_CM_single_K 0.0 1.0 /end CHARACTERISTIC
/begin CHARACTERISTIC KTHC_VBlowerMin_K "" VALUE 0x0000 /* @ECU_Address@KTHC_VBlowerMin_K@ */ Scalar_FLOAT32_IEEE 0 SWC_FDC_type_CM_single_K 0.0 1.0 /end CHARACTERISTIC
/begin CHARACTERISTIC KTHC_VBstep_K "" VALUE 0x0000 /* @ECU_Address@KTHC_VBstep_K@ */ Scalar_FLOAT32_IEEE 0 SWC_FDC_type_CM_single_K 0.0 1.0 /end CHARACTERISTIC
/begin CHARACTERISTIC KTHC_VGainStep_K "" VALUE 0x0000 /* @ECU_Address@KTHC_VGainStep_K@ */ Scalar_FLOAT32_IEEE 0 SWC_FDC_type_CM_single_K 0.0 1.0 /end CHARACTERISTIC
/begin CHARACTERISTIC KTHC_aDeice_K "" VALUE 0x0000 /* @ECU_Address@KTHC_aDeice_K@ */ Scalar_FLOAT32_IEEE 0 SWC_FDC_type_CM_single_K -10000.0 10000.0 /end CHARACTERISTIC
/begin CHARACTERISTIC KTHC_bDeice_K "" VALUE 0x0000 /* @ECU_Address@KTHC_bDeice_K@ */ Scalar_FLOAT32_IEEE 0 SWC_FDC_type_CM_single_K -10000.0 10000.0 /end CHARACTERISTIC
/begin CHARACTERISTIC KTQD_ACCReqCMdBond_mps2 "" VALUE 0x0000 /* @ECU_Address@KTQD_ACCReqCMdBond_mps2@ */ Scalar_FLOAT32_IEEE 0 SWC_FDC_type_CM_single_mps2 -20.0 20.0 /end CHARACTERISTIC
/begin CHARACTERISTIC KTQD_ADASLowIdleWhlTq_Nm "" VALUE 0x0000 /* @ECU_Address@KTQD_ADASLowIdleWhlTq_Nm@ */ Scalar_FLOAT32_IEEE 0 SWC_FDC_type_CM_single_Nm -100000.0 100000.0 /end CHARACTERISTIC
/begin CHARACTERISTIC KTQD_ActvDmpDisabAPSPosn_pct "" VALUE 0x0000 /* @ECU_Address@KTQD_ActvDmpDisabAPSPosn_pct@ */ Scalar_FLOAT32_IEEE 0 SWC_FDC_type_CM_single_pct -1.0 100.0 /end CHARACTERISTIC
/begin CHARACTERISTIC KTQD_ActvDmpDisabVehSpd_kph "" VALUE 0x0000 /* @ECU_Address@KTQD_ActvDmpDisabVehSpd_kph@ */ Scalar_FLOAT32_IEEE 0 SWC_FDC_type_CM_single_kph -1.0 300.0 /end CHARACTERISTIC
/begin CHARACTERISTIC KTQD_DiagHCrashTimer_s "" VALUE 0x0000 /* @ECU_Address@KTQD_DiagHCrashTimer_s@ */ Scalar_FLOAT32_IEEE 0 SWC_FDC_type_CM_single_sec 0.0 10.0 /end CHARACTERISTIC
/begin CHARACTERISTIC KTQD_EquivAccPedBaseTq_Nm "" VALUE 0x0000 /* @ECU_Address@KTQD_EquivAccPedBaseTq_Nm@ */ Scalar_FLOAT32_IEEE 0 SWC_FDC_type_CM_single_Nm 0.0 5000.0 /end CHARACTERISTIC
/begin CHARACTERISTIC KTQD_EquivAccPedDis_pct "" VALUE 0x0000 /* @ECU_Address@KTQD_EquivAccPedDis_pct@ */ Scalar_FLOAT32_IEEE 0 SWC_FDC_type_CM_single_pct 0.0 100.0 /end CHARACTERISTIC
/begin CHARACTERISTIC KTQD_EquivAccPedEn_pct "" VALUE 0x0000 /* @ECU_Address@KTQD_EquivAccPedEn_pct@ */ Scalar_FLOAT32_IEEE 0 SWC_FDC_type_CM_single_pct 0.0 100.0 /end CHARACTERISTIC
/begin CHARACTERISTIC KTQD_EquivAccPedLowLim_pct "" VALUE 0x0000 /* @ECU_Address@KTQD_EquivAccPedLowLim_pct@ */ Scalar_FLOAT32_IEEE 0 SWC_FDC_type_CM_single_pct 0.0 100.0 /end CHARACTERISTIC
/begin CHARACTERISTIC KTQD_EquivAccPedUpLim_pct "" VALUE 0x0000 /* @ECU_Address@KTQD_EquivAccPedUpLim_pct@ */ Scalar_FLOAT32_IEEE 0 SWC_FDC_type_CM_single_pct 0.0 100.0 /end CHARACTERISTIC
/begin CHARACTERISTIC KTQD_EquivAccPedalDelay_s "" VALUE 0x0000 /* @ECU_Address@KTQD_EquivAccPedalDelay_s@ */ Scalar_FLOAT32_IEEE 0 SWC_FDC_type_CM_single_s 0.0 7200.0 /end CHARACTERISTIC
/begin CHARACTERISTIC KTQD_EquivAccPedalDisSpd_kph "" VALUE 0x0000 /* @ECU_Address@KTQD_EquivAccPedalDisSpd_kph@ */ Scalar_FLOAT32_IEEE 0 SWC_FDC_type_CM_single_kph -1.0 255.0 /end CHARACTERISTIC
/begin CHARACTERISTIC KTQD_FrMCUDmDisSpd_kph "" VALUE 0x0000 /* @ECU_Address@KTQD_FrMCUDmDisSpd_kph@ */ Scalar_FLOAT32_IEEE 0 SWC_FDC_type_CM_single_kph 0.0 300.0 /end CHARACTERISTIC
/begin CHARACTERISTIC KTQD_FrMCUDmEnSpd_kph "" VALUE 0x0000 /* @ECU_Address@KTQD_FrMCUDmEnSpd_kph@ */ Scalar_FLOAT32_IEEE 0 SWC_FDC_type_CM_single_kph 0.0 300.0 /end CHARACTERISTIC
/begin CHARACTERISTIC KTQD_FrTMTotalGearRatio_gain "" VALUE 0x0000 /* @ECU_Address@KTQD_FrTMTotalGearRatio_gain@ */ Scalar_FLOAT32_IEEE 0 SWC_FDC_type_CM_single_gain 1.0 100000.0 /end CHARACTERISTIC
/begin CHARACTERISTIC KTQD_MCUDmEnAccCMD_mps2 "" VALUE 0x0000 /* @ECU_Address@KTQD_MCUDmEnAccCMD_mps2@ */ Scalar_FLOAT32_IEEE 0 SWC_FDC_type_CM_single_mps2 -20.0 20.0 /end CHARACTERISTIC
/begin CHARACTERISTIC KTQD_MCUDmEnFrBrkTq_Nm "" VALUE 0x0000 /* @ECU_Address@KTQD_MCUDmEnFrBrkTq_Nm@ */ Scalar_FLOAT32_IEEE 0 SWC_FDC_type_CM_single_Nm -1000.0 4000.0 /end CHARACTERISTIC
/begin CHARACTERISTIC KTQD_MCUDmEnRrBrkTq_Nm "" VALUE 0x0000 /* @ECU_Address@KTQD_MCUDmEnRrBrkTq_Nm@ */ Scalar_FLOAT32_IEEE 0 SWC_FDC_type_CM_single_Nm -1000.0 4000.0 /end CHARACTERISTIC
/begin CHARACTERISTIC KTQD_NoDiagHCrashTimer_s "" VALUE 0x0000 /* @ECU_Address@KTQD_NoDiagHCrashTimer_s@ */ Scalar_FLOAT32_IEEE 0 SWC_FDC_type_CM_single_sec 0.0 10.0 /end CHARACTERISTIC
/begin CHARACTERISTIC KTQD_PBWTimeout_s "" VALUE 0x0000 /* @ECU_Address@KTQD_PBWTimeout_s@ */ Scalar_FLOAT32_IEEE 0 SWC_FDC_type_CM_single_s 0.0 100.0 /end CHARACTERISTIC
/begin CHARACTERISTIC KTQD_PwrStaTimerforCrash_s "" VALUE 0x0000 /* @ECU_Address@KTQD_PwrStaTimerforCrash_s@ */ Scalar_FLOAT32_IEEE 0 SWC_FDC_type_CM_single_sec 0.0 10.0 /end CHARACTERISTIC
/begin CHARACTERISTIC KTQD_RegenLimHVTempMax_C "" VALUE 0x0000 /* @ECU_Address@KTQD_RegenLimHVTempMax_C@ */ Scalar_FLOAT32_IEEE 0 SWC_FDC_type_CM_single_C -100.0 500.0 /end CHARACTERISTIC
/begin CHARACTERISTIC KTQD_RegenLimHVTempMin_C "" VALUE 0x0000 /* @ECU_Address@KTQD_RegenLimHVTempMin_C@ */ Scalar_FLOAT32_IEEE 0 SWC_FDC_type_CM_single_C -100.0 500.0 /end CHARACTERISTIC
/begin CHARACTERISTIC KTQD_RegenLimIndSOC_pct "" VALUE 0x0000 /* @ECU_Address@KTQD_RegenLimIndSOC_pct@ */ Scalar_FLOAT32_IEEE 0 SWC_FDC_type_CM_single_pct 0.0 100.0 /end CHARACTERISTIC
/begin CHARACTERISTIC KTQD_RelockWaitTime_s "" VALUE 0x0000 /* @ECU_Address@KTQD_RelockWaitTime_s@ */ Scalar_FLOAT32_IEEE 0 SWC_FDC_type_CM_single_s 0.0 100.0 /end CHARACTERISTIC
/begin CHARACTERISTIC KTQD_ReunlockWaitTime_s "" VALUE 0x0000 /* @ECU_Address@KTQD_ReunlockWaitTime_s@ */ Scalar_FLOAT32_IEEE 0 SWC_FDC_type_CM_single_s 0.0 100.0 /end CHARACTERISTIC
/begin CHARACTERISTIC KTQD_RgnLimIndStaDelay_s "" VALUE 0x0000 /* @ECU_Address@KTQD_RgnLimIndStaDelay_s@ */ Scalar_FLOAT32_IEEE 0 SWC_FDC_type_CM_single_s 0.0 3600.0 /end CHARACTERISTIC
/begin CHARACTERISTIC KTQD_RgnModeChgResetAPSDev_pct "" VALUE 0x0000 /* @ECU_Address@KTQD_RgnModeChgResetAPSDev_pct@ */ Scalar_FLOAT32_IEEE 0 SWC_FDC_type_CM_single_pct -10.0 125.0 /end CHARACTERISTIC
/begin CHARACTERISTIC KTQD_RrMCUDmDisSpd_kph "" VALUE 0x0000 /* @ECU_Address@KTQD_RrMCUDmDisSpd_kph@ */ Scalar_FLOAT32_IEEE 0 SWC_FDC_type_CM_single_kph 0.0 300.0 /end CHARACTERISTIC
/begin CHARACTERISTIC KTQD_RrMCUDmEnSpd_kph "" VALUE 0x0000 /* @ECU_Address@KTQD_RrMCUDmEnSpd_kph@ */ Scalar_FLOAT32_IEEE 0 SWC_FDC_type_CM_single_kph 0.0 300.0 /end CHARACTERISTIC
/begin CHARACTERISTIC KTQD_RrTMTotalGearRatio_gain "" VALUE 0x0000 /* @ECU_Address@KTQD_RrTMTotalGearRatio_gain@ */ Scalar_FLOAT32_IEEE 0 SWC_FDC_type_CM_single_gain 1.0 100000.0 /end CHARACTERISTIC
/begin CHARACTERISTIC KTQD_ShiftInitialTime_s "" VALUE 0x0000 /* @ECU_Address@KTQD_ShiftInitialTime_s@ */ Scalar_FLOAT32_IEEE 0 SWC_FDC_type_CM_single_s 0.0 100000.0 /end CHARACTERISTIC
/begin CHARACTERISTIC KTQD_VehSpd2P_kph "" VALUE 0x0000 /* @ECU_Address@KTQD_VehSpd2P_kph@ */ Scalar_FLOAT32_IEEE 0 SWC_FDC_type_CM_single_kph 0.0 150.0 /end CHARACTERISTIC
/begin CHARACTERISTIC KTQD_VehSpdRev_kph "" VALUE 0x0000 /* @ECU_Address@KTQD_VehSpdRev_kph@ */ Scalar_FLOAT32_IEEE 0 SWC_FDC_type_CM_single_kph 0.0 150.0 /end CHARACTERISTIC
/begin CHARACTERISTIC KVMC_ADASAngCtrlTqWtGnLowerLim_pct "" VALUE 0x0000 /* @ECU_Address@KVMC_ADASAngCtrlTqWtGnLowerLim_pct@ */ Scalar_FLOAT32_IEEE 0 SWC_FDC_type_CM_single_pct 0.0 150.0 /end CHARACTERISTIC
/begin CHARACTERISTIC KVMC_ADASAngCtrlTqWtGnUpperLim_pct "" VALUE 0x0000 /* @ECU_Address@KVMC_ADASAngCtrlTqWtGnUpperLim_pct@ */ Scalar_FLOAT32_IEEE 0 SWC_FDC_type_CM_single_pct 0.0 150.0 /end CHARACTERISTIC
/begin CHARACTERISTIC KVMC_APPSpdLimit_ovrdval "" VALUE 0x0000 /* @ECU_Address@KVMC_APPSpdLimit_ovrdval@ */ Scalar_FLOAT32_IEEE 0 SWC_FDC_type_CM_single_flg 0.0 255.0 /end CHARACTERISTIC
/begin CHARACTERISTIC KVMC_AccBWFilterCutOffFreq_raw32 "" VALUE 0x0000 /* @ECU_Address@KVMC_AccBWFilterCutOffFreq_raw32@ */ Scalar_FLOAT32_IEEE 0 SWC_FDC_type_CM_single_raw32 0.0 100.0 /end CHARACTERISTIC
/begin CHARACTERISTIC KVMC_AutoTurnJerkHiGain_pct "" VALUE 0x0000 /* @ECU_Address@KVMC_AutoTurnJerkHiGain_pct@ */ Scalar_FLOAT32_IEEE 0 SWC_FDC_type_CM_single_pct 0.0 10.0 /end CHARACTERISTIC
/begin CHARACTERISTIC KVMC_AutoTurnLimitHiGain_pct "" VALUE 0x0000 /* @ECU_Address@KVMC_AutoTurnLimitHiGain_pct@ */ Scalar_FLOAT32_IEEE 0 SWC_FDC_type_CM_single_pct 0.0 10.0 /end CHARACTERISTIC
/begin CHARACTERISTIC KVMC_CCMSASpdWar_kph "" VALUE 0x0000 /* @ECU_Address@KVMC_CCMSASpdWar_kph@ */ Scalar_FLOAT32_IEEE 0 SWC_FDC_type_CM_single_kph 0.0 250.0 /end CHARACTERISTIC
/begin CHARACTERISTIC KVMC_CalEstPitchAngleTs_raw32 "" VALUE 0x0000 /* @ECU_Address@KVMC_CalEstPitchAngleTs_raw32@ */ Scalar_FLOAT32_IEEE 0 SWC_FDC_type_CM_single_raw32 0.0 100.0 /end CHARACTERISTIC
/begin CHARACTERISTIC KVMC_ExternalSpeedTarget_kph "" VALUE 0x0000 /* @ECU_Address@KVMC_ExternalSpeedTarget_kph@ */ Scalar_FLOAT32_IEEE 0 SWC_FDC_type_CM_single_kph 0.0 255.0 /end CHARACTERISTIC
/begin CHARACTERISTIC KVMC_GradeInvalidValue_deg "" VALUE 0x0000 /* @ECU_Address@KVMC_GradeInvalidValue_deg@ */ Scalar_FLOAT32_IEEE 0 SWC_FDC_type_CM_single_deg -50.0 50.0 /end CHARACTERISTIC
/begin CHARACTERISTIC KVMC_IMUGxFilter4ADB_raw32 "" VALUE 0x0000 /* @ECU_Address@KVMC_IMUGxFilter4ADB_raw32@ */ Scalar_FLOAT32_IEEE 0 SWC_FDC_type_CM_single_raw32 0.0 100.0 /end CHARACTERISTIC
/begin CHARACTERISTIC KVMC_LDWReqExecute2Time_s "" VALUE 0x0000 /* @ECU_Address@KVMC_LDWReqExecute2Time_s@ */ Scalar_FLOAT32_IEEE 0 SWC_FDC_type_CM_single_s 0.0 5.0 /end CHARACTERISTIC
/begin CHARACTERISTIC KVMC_LDWReqExecuteTime_s "" VALUE 0x0000 /* @ECU_Address@KVMC_LDWReqExecuteTime_s@ */ Scalar_FLOAT32_IEEE 0 SWC_FDC_type_CM_single_s 0.0 5.0 /end CHARACTERISTIC
/begin CHARACTERISTIC KVMC_LDWReqRest2Time_s "" VALUE 0x0000 /* @ECU_Address@KVMC_LDWReqRest2Time_s@ */ Scalar_FLOAT32_IEEE 0 SWC_FDC_type_CM_single_s 0.0 5.0 /end CHARACTERISTIC
/begin CHARACTERISTIC KVMC_LDWReqRestTime_s "" VALUE 0x0000 /* @ECU_Address@KVMC_LDWReqRestTime_s@ */ Scalar_FLOAT32_IEEE 0 SWC_FDC_type_CM_single_s 0.0 5.0 /end CHARACTERISTIC
/begin CHARACTERISTIC KVMC_LongAccelSWSpd_kph "" VALUE 0x0000 /* @ECU_Address@KVMC_LongAccelSWSpd_kph@ */ Scalar_FLOAT32_IEEE 0 SWC_FDC_type_CM_single_kph 0.0 255.0 /end CHARACTERISTIC
/begin CHARACTERISTIC KVMC_MeterSpdBWFilter_raw32 "" VALUE 0x0000 /* @ECU_Address@KVMC_MeterSpdBWFilter_raw32@ */ Scalar_FLOAT32_IEEE 0 SWC_FDC_type_CM_single_raw32 0.0 100.0 /end CHARACTERISTIC
/begin CHARACTERISTIC KVMC_PreCheckAllowTime_s "" VALUE 0x0000 /* @ECU_Address@KVMC_PreCheckAllowTime_s@ */ Scalar_FLOAT32_IEEE 0 SWC_FDC_type_CM_single_sec 0.0 10.0 /end CHARACTERISTIC
/begin CHARACTERISTIC KVMC_RollAveEnTime_s "" VALUE 0x0000 /* @ECU_Address@KVMC_RollAveEnTime_s@ */ Scalar_FLOAT32_IEEE 0 SWC_FDC_type_CM_single_sec 0.0 10.0 /end CHARACTERISTIC
/begin CHARACTERISTIC KVMC_SpdBWFilterCutOffFreq_raw32 "" VALUE 0x0000 /* @ECU_Address@KVMC_SpdBWFilterCutOffFreq_raw32@ */ Scalar_FLOAT32_IEEE 0 SWC_FDC_type_CM_single_raw32 0.0 100.0 /end CHARACTERISTIC
/begin CHARACTERISTIC KVMC_Veh2MetSpdHiBand_kph "" VALUE 0x0000 /* @ECU_Address@KVMC_Veh2MetSpdHiBand_kph@ */ Scalar_FLOAT32_IEEE 0 SWC_FDC_type_CM_single_kph 0.0 300.0 /end CHARACTERISTIC
/begin CHARACTERISTIC KVMC_Veh2MetSpdLowBand_kph "" VALUE 0x0000 /* @ECU_Address@KVMC_Veh2MetSpdLowBand_kph@ */ Scalar_FLOAT32_IEEE 0 SWC_FDC_type_CM_single_kph 0.0 300.0 /end CHARACTERISTIC
/begin CHARACTERISTIC KVMC_Veh2MeterSpdFactor_enum "" VALUE 0x0000 /* @ECU_Address@KVMC_Veh2MeterSpdFactor_enum@ */ Scalar_FLOAT32_IEEE 0 SWC_FDC_type_CM_single_enum 0.0 10.0 /end CHARACTERISTIC
/begin CHARACTERISTIC KVMC_Veh2MeterSpdLoBdy_kph "" VALUE 0x0000 /* @ECU_Address@KVMC_Veh2MeterSpdLoBdy_kph@ */ Scalar_FLOAT32_IEEE 0 SWC_FDC_type_CM_single_kph 0.0 10.0 /end CHARACTERISTIC
/begin CHARACTERISTIC KVMC_Veh2MeterSpdLoFactor_enum "" VALUE 0x0000 /* @ECU_Address@KVMC_Veh2MeterSpdLoFactor_enum@ */ Scalar_FLOAT32_IEEE 0 SWC_FDC_type_CM_single_kph 0.0 10.0 /end CHARACTERISTIC
/begin CHARACTERISTIC KVMC_Veh2MeterSpdOffset_enum "" VALUE 0x0000 /* @ECU_Address@KVMC_Veh2MeterSpdOffset_enum@ */ Scalar_FLOAT32_IEEE 0 SWC_FDC_type_CM_single_enum 0.0 10.0 /end CHARACTERISTIC
/begin CHARACTERISTIC KVMC_VehPitchAngleMax_deg "" VALUE 0x0000 /* @ECU_Address@KVMC_VehPitchAngleMax_deg@ */ Scalar_FLOAT32_IEEE 0 SWC_FDC_type_CM_single_deg -10.0 10.0 /end CHARACTERISTIC
/begin CHARACTERISTIC KVMC_VehPitchAngleMin_deg "" VALUE 0x0000 /* @ECU_Address@KVMC_VehPitchAngleMin_deg@ */ Scalar_FLOAT32_IEEE 0 SWC_FDC_type_CM_single_deg -10.0 10.0 /end CHARACTERISTIC
/begin CHARACTERISTIC KVMC_VehSpdBWFilter_raw32 "" VALUE 0x0000 /* @ECU_Address@KVMC_VehSpdBWFilter_raw32@ */ Scalar_FLOAT32_IEEE 0 SWC_FDC_type_CM_single_raw32 0.0 100.0 /end CHARACTERISTIC
/begin CHARACTERISTIC KVMC_VehStandstillSpd_kph "" VALUE 0x0000 /* @ECU_Address@KVMC_VehStandstillSpd_kph@ */ Scalar_FLOAT32_IEEE 0 SWC_FDC_type_CM_single_kph 0.0 10.0 /end CHARACTERISTIC
/begin CHARACTERISTIC KVMC_VehStandstillTimer_s "" VALUE 0x0000 /* @ECU_Address@KVMC_VehStandstillTimer_s@ */ Scalar_FLOAT32_IEEE 0 SWC_FDC_type_CM_single_s 0.0 20.0 /end CHARACTERISTIC
/begin CHARACTERISTIC KTHC_APTCQMaxC_W "" VALUE 0x0000 /* @ECU_Address@KTHC_APTCQMaxC_W@ */ Scalar_UWORD 0 SWC_FDC_type_CM_uint16_W 0.0 10000.0 /end CHARACTERISTIC
/begin CHARACTERISTIC KTHC_APTCQminC_W "" VALUE 0x0000 /* @ECU_Address@KTHC_APTCQminC_W@ */ Scalar_UWORD 0 SWC_FDC_type_CM_uint16_W 0.0 10000.0 /end CHARACTERISTIC
/begin CHARACTERISTIC KTHC_APTCQminRe1_W "" VALUE 0x0000 /* @ECU_Address@KTHC_APTCQminRe1_W@ */ Scalar_UWORD 0 SWC_FDC_type_CM_uint16_W 0.0 10000.0 /end CHARACTERISTIC
/begin CHARACTERISTIC KTHC_APTCQoffT_cnt "" VALUE 0x0000 /* @ECU_Address@KTHC_APTCQoffT_cnt@ */ Scalar_UWORD 0 SWC_FDC_type_CM_uint16_cnt 0.0 65535.0 /end CHARACTERISTIC
/begin CHARACTERISTIC KTHC_APTCQonT_cnt "" VALUE 0x0000 /* @ECU_Address@KTHC_APTCQonT_cnt@ */ Scalar_UWORD 0 SWC_FDC_type_CM_uint16_cnt 0.0 65535.0 /end CHARACTERISTIC
/begin CHARACTERISTIC KTHC_BatCoolT_cnt "" VALUE 0x0000 /* @ECU_Address@KTHC_BatCoolT_cnt@ */ Scalar_UWORD 0 SWC_FDC_type_CM_uint16_cnt 0.0 65535.0 /end CHARACTERISTIC
/begin CHARACTERISTIC KTHC_CompMaxDeice_rpm "" VALUE 0x0000 /* @ECU_Address@KTHC_CompMaxDeice_rpm@ */ Scalar_UWORD 0 SWC_FDC_type_CM_uint16_rpm 0.0 20000.0 /end CHARACTERISTIC
/begin CHARACTERISTIC KTHC_CompMinDeice_rpm "" VALUE 0x0000 /* @ECU_Address@KTHC_CompMinDeice_rpm@ */ Scalar_UWORD 0 SWC_FDC_type_CM_uint16_rpm 0.0 20000.0 /end CHARACTERISTIC
/begin CHARACTERISTIC KTHC_CompSotxvOpLow_rpm "" VALUE 0x0000 /* @ECU_Address@KTHC_CompSotxvOpLow_rpm@ */ Scalar_UWORD 0 SWC_FDC_type_CM_uint16_rpm 0.0 20000.0 /end CHARACTERISTIC
/begin CHARACTERISTIC KTHC_CompSotxvOp_K "" VALUE 0x0000 /* @ECU_Address@KTHC_CompSotxvOp_K@ */ Scalar_UWORD 0 SWC_FDC_type_CM_uint16_K 0.0 10000.0 /end CHARACTERISTIC
/begin CHARACTERISTIC KTHC_CompSpdmaxBC1_rpm "" VALUE 0x0000 /* @ECU_Address@KTHC_CompSpdmaxBC1_rpm@ */ Scalar_UWORD 0 SWC_FDC_type_CM_uint16_rpm 0.0 20000.0 /end CHARACTERISTIC
/begin CHARACTERISTIC KTHC_CompSpdmid1_rpm "" VALUE 0x0000 /* @ECU_Address@KTHC_CompSpdmid1_rpm@ */ Scalar_UWORD 0 SWC_FDC_type_CM_uint16_rpm 0.0 20000.0 /end CHARACTERISTIC
/begin CHARACTERISTIC KTHC_CompSpdmid2_rpm "" VALUE 0x0000 /* @ECU_Address@KTHC_CompSpdmid2_rpm@ */ Scalar_UWORD 0 SWC_FDC_type_CM_uint16_rpm 0.0 20000.0 /end CHARACTERISTIC
/begin CHARACTERISTIC KTHC_CompSpdmid3_rpm "" VALUE 0x0000 /* @ECU_Address@KTHC_CompSpdmid3_rpm@ */ Scalar_UWORD 0 SWC_FDC_type_CM_uint16_rpm 0.0 20000.0 /end CHARACTERISTIC
/begin CHARACTERISTIC KTHC_DAPTCQ1_W "" VALUE 0x0000 /* @ECU_Address@KTHC_DAPTCQ1_W@ */ Scalar_UWORD 0 SWC_FDC_type_CM_uint16_W 0.0 10000.0 /end CHARACTERISTIC
/begin CHARACTERISTIC KTHC_DAPTCQ2_W "" VALUE 0x0000 /* @ECU_Address@KTHC_DAPTCQ2_W@ */ Scalar_UWORD 0 SWC_FDC_type_CM_uint16_W 0.0 10000.0 /end CHARACTERISTIC
/begin CHARACTERISTIC KTHC_DAPTCQ3_W "" VALUE 0x0000 /* @ECU_Address@KTHC_DAPTCQ3_W@ */ Scalar_UWORD 0 SWC_FDC_type_CM_uint16_W 0.0 10000.0 /end CHARACTERISTIC
/begin CHARACTERISTIC KTHC_DTimeCD1_K "" VALUE 0x0000 /* @ECU_Address@KTHC_DTimeCD1_K@ */ Scalar_UWORD 0 SWC_FDC_type_CM_uint16_K 0.0 65535.0 /end CHARACTERISTIC
/begin CHARACTERISTIC KTHC_DTimeCD2_K "" VALUE 0x0000 /* @ECU_Address@KTHC_DTimeCD2_K@ */ Scalar_UWORD 0 SWC_FDC_type_CM_uint16_K 0.0 65535.0 /end CHARACTERISTIC
/begin CHARACTERISTIC KTHC_DTimeCD_K "" VALUE 0x0000 /* @ECU_Address@KTHC_DTimeCD_K@ */ Scalar_UWORD 0 SWC_FDC_type_CM_uint16_K 0.0 65535.0 /end CHARACTERISTIC
/begin CHARACTERISTIC KTHC_DeiceCycTime_K "" VALUE 0x0000 /* @ECU_Address@KTHC_DeiceCycTime_K@ */ Scalar_UWORD 0 SWC_FDC_type_CM_uint16_K 0.0 60000.0 /end CHARACTERISTIC
/begin CHARACTERISTIC KTHC_ECOTambLVT_sec "" VALUE 0x0000 /* @ECU_Address@KTHC_ECOTambLVT_sec@ */ Scalar_UWORD 0 SWC_FDC_type_CM_uint16_sec 0.0 65535.0 /end CHARACTERISTIC
/begin CHARACTERISTIC KTHC_HVBIsoImpedenceLV_Mohm "" VALUE 0x0000 /* @ECU_Address@KTHC_HVBIsoImpedenceLV_Mohm@ */ Scalar_UWORD 0 SWC_FDC_type_CM_uint16_Mohm 0.0 200.0 /end CHARACTERISTIC
/begin CHARACTERISTIC KTHC_SolarDef_W "" VALUE 0x0000 /* @ECU_Address@KTHC_SolarDef_W@ */ Scalar_UWORD 0 SWC_FDC_type_CM_uint16_W 0.0 10000.0 /end CHARACTERISTIC
/begin CHARACTERISTIC KTHC_Time0_K "" VALUE 0x0000 /* @ECU_Address@KTHC_Time0_K@ */ Scalar_UWORD 0 SWC_FDC_type_CM_uint16_K 0.0 30000.0 /end CHARACTERISTIC
/begin CHARACTERISTIC KTHC_TimeD_K "" VALUE 0x0000 /* @ECU_Address@KTHC_TimeD_K@ */ Scalar_UWORD 0 SWC_FDC_type_CM_uint16_K 0.0 65535.0 /end CHARACTERISTIC
/begin CHARACTERISTIC KTHC_TimeDeiceMax_K "" VALUE 0x0000 /* @ECU_Address@KTHC_TimeDeiceMax_K@ */ Scalar_UWORD 0 SWC_FDC_type_CM_uint16_K 0.0 30000.0 /end CHARACTERISTIC
/begin CHARACTERISTIC KTHC_TimeRe1_sec "" VALUE 0x0000 /* @ECU_Address@KTHC_TimeRe1_sec@ */ Scalar_UWORD 0 SWC_FDC_type_CM_uint16_sec 0.0 10000.0 /end CHARACTERISTIC
/begin CHARACTERISTIC KTHC_TimeRe2_sec "" VALUE 0x0000 /* @ECU_Address@KTHC_TimeRe2_sec@ */ Scalar_UWORD 0 SWC_FDC_type_CM_uint16_sec 0.0 10000.0 /end CHARACTERISTIC
/begin CHARACTERISTIC KTHC_Timehu1_K "" VALUE 0x0000 /* @ECU_Address@KTHC_Timehu1_K@ */ Scalar_UWORD 0 SWC_FDC_type_CM_uint16_K 0.0 65535.0 /end CHARACTERISTIC
/begin CHARACTERISTIC KTHC_Timehu2_K "" VALUE 0x0000 /* @ECU_Address@KTHC_Timehu2_K@ */ Scalar_UWORD 0 SWC_FDC_type_CM_uint16_K 0.0 65535.0 /end CHARACTERISTIC
/begin CHARACTERISTIC KTHC_Timewcd_K "" VALUE 0x0000 /* @ECU_Address@KTHC_Timewcd_K@ */ Scalar_UWORD 0 SWC_FDC_type_CM_uint16_K 0.0 65535.0 /end CHARACTERISTIC
/begin CHARACTERISTIC KTHC_WPTCDef_W "" VALUE 0x0000 /* @ECU_Address@KTHC_WPTCDef_W@ */ Scalar_UWORD 0 SWC_FDC_type_CM_uint16_W 0.0 10000.0 /end CHARACTERISTIC
/begin CHARACTERISTIC KTHC_ta_K "" VALUE 0x0000 /* @ECU_Address@KTHC_ta_K@ */ Scalar_UWORD 0 SWC_FDC_type_CM_uint16_K 0.0 30000.0 /end CHARACTERISTIC
/begin CHARACTERISTIC KTHC_tb_K "" VALUE 0x0000 /* @ECU_Address@KTHC_tb_K@ */ Scalar_UWORD 0 SWC_FDC_type_CM_uint16_K 0.0 30000.0 /end CHARACTERISTIC
/begin CHARACTERISTIC KBCM_Antitheft_enum_ovrdflg "" VALUE 0x0000 /* @ECU_Address@KBCM_Antitheft_enum_ovrdflg@ */ Scalar_BOOLEAN 0 SWC_FDC_type_CM_boolean_flg 0.0 1.0 /end CHARACTERISTIC
/begin CHARACTERISTIC KDHP_ActAPSPosn_pct_ovrdflg "" VALUE 0x0000 /* @ECU_Address@KDHP_ActAPSPosn_pct_ovrdflg@ */ Scalar_BOOLEAN 0 SWC_FDC_type_CM_boolean_flg 0.0 1.0 /end CHARACTERISTIC
/begin CHARACTERISTIC KDHP_EAPS1Min_pct_ovrdflg "" VALUE 0x0000 /* @ECU_Address@KDHP_EAPS1Min_pct_ovrdflg@ */ Scalar_BOOLEAN 0 SWC_FDC_type_CM_boolean_flg 0.0 1.0 /end CHARACTERISTIC
/begin CHARACTERISTIC KDHP_EAPS2Min_pct_ovrdflg "" VALUE 0x0000 /* @ECU_Address@KDHP_EAPS2Min_pct_ovrdflg@ */ Scalar_BOOLEAN 0 SWC_FDC_type_CM_boolean_flg 0.0 1.0 /end CHARACTERISTIC
/begin CHARACTERISTIC KTHC_APTCPWMEN_flg "" VALUE 0x0000 /* @ECU_Address@KTHC_APTCPWMEN_flg@ */ Scalar_BOOLEAN 0 SWC_FDC_type_CM_boolean_flg 0.0 1.0 /end CHARACTERISTIC
/begin CHARACTERISTIC KTHC_DehumidityEN_flg "" VALUE 0x0000 /* @ECU_Address@KTHC_DehumidityEN_flg@ */ Scalar_BOOLEAN 0 SWC_FDC_type_CM_boolean_flg 0.0 1.0 /end CHARACTERISTIC
/begin CHARACTERISTIC KTHC_EWPBalanceSW_flg "" VALUE 0x0000 /* @ECU_Address@KTHC_EWPBalanceSW_flg@ */ Scalar_BOOLEAN 0 SWC_FDC_type_CM_boolean_flg 0.0 1.0 /end CHARACTERISTIC
/begin CHARACTERISTIC KTHC_ErrHandleEN_flg "" VALUE 0x0000 /* @ECU_Address@KTHC_ErrHandleEN_flg@ */ Scalar_BOOLEAN 0 SWC_FDC_type_CM_boolean_flg 0.0 1.0 /end CHARACTERISTIC
/begin CHARACTERISTIC KTHC_WoWPTC_flg "" VALUE 0x0000 /* @ECU_Address@KTHC_WoWPTC_flg@ */ Scalar_BOOLEAN 0 SWC_FDC_type_CM_boolean_flg 0.0 1.0 /end CHARACTERISTIC
/begin CHARACTERISTIC KTPM_DiagLearn_flg "" VALUE 0x0000 /* @ECU_Address@KTPM_DiagLearn_flg@ */ Scalar_BOOLEAN 0 SWC_FDC_type_CM_boolean_flg 0.0 1.0 /end CHARACTERISTIC
/begin CHARACTERISTIC KTPM_WhlRotDir_enum_ovrdflg "" VALUE 0x0000 /* @ECU_Address@KTPM_WhlRotDir_enum_ovrdflg@ */ Scalar_BOOLEAN 0 SWC_FDC_type_CM_boolean_flg 0.0 1.0 /end CHARACTERISTIC
/begin CHARACTERISTIC KTQD_AbsoluteMotorSpdDir_flg "" VALUE 0x0000 /* @ECU_Address@KTQD_AbsoluteMotorSpdDir_flg@ */ Scalar_BOOLEAN 0 SWC_FDC_type_CM_boolean_flg 0.0 1.0 /end CHARACTERISTIC
/begin CHARACTERISTIC KTQD_CreepSW_flg_ovrdflg "" VALUE 0x0000 /* @ECU_Address@KTQD_CreepSW_flg_ovrdflg@ */ Scalar_BOOLEAN 0 SWC_FDC_type_CM_boolean_flg 0.0 1.0 /end CHARACTERISTIC
/begin CHARACTERISTIC KTQD_CreepSW_flg_ovrdval "" VALUE 0x0000 /* @ECU_Address@KTQD_CreepSW_flg_ovrdval@ */ Scalar_BOOLEAN 0 SWC_FDC_type_CM_boolean_flg 0.0 1.0 /end CHARACTERISTIC
/begin CHARACTERISTIC KTQD_DriveModeReq_enum_ovrdflg "" VALUE 0x0000 /* @ECU_Address@KTQD_DriveModeReq_enum_ovrdflg@ */ Scalar_BOOLEAN 0 SWC_FDC_type_CM_boolean_flg 0.0 1.0 /end CHARACTERISTIC
/begin CHARACTERISTIC KTQD_FrDmpDisabReq_flg_ovrdflg "" VALUE 0x0000 /* @ECU_Address@KTQD_FrDmpDisabReq_flg_ovrdflg@ */ Scalar_BOOLEAN 0 SWC_FDC_type_CM_boolean_flg 0.0 1.0 /end CHARACTERISTIC
/begin CHARACTERISTIC KTQD_FrDmpDisabReq_flg_ovrdval "" VALUE 0x0000 /* @ECU_Address@KTQD_FrDmpDisabReq_flg_ovrdval@ */ Scalar_BOOLEAN 0 SWC_FDC_type_CM_boolean_flg 0.0 1.0 /end CHARACTERISTIC
/begin CHARACTERISTIC KTQD_LimpHomeAct_flg_ovrdflg "" VALUE 0x0000 /* @ECU_Address@KTQD_LimpHomeAct_flg_ovrdflg@ */ Scalar_BOOLEAN 0 SWC_FDC_type_CM_boolean_flg 0.0 1.0 /end CHARACTERISTIC
/begin CHARACTERISTIC KTQD_LimpHomeAct_flg_ovrdval "" VALUE 0x0000 /* @ECU_Address@KTQD_LimpHomeAct_flg_ovrdval@ */ Scalar_BOOLEAN 0 SWC_FDC_type_CM_boolean_flg 0.0 1.0 /end CHARACTERISTIC
/begin CHARACTERISTIC KTQD_LowIdle_flg_ovrdflg "" VALUE 0x0000 /* @ECU_Address@KTQD_LowIdle_flg_ovrdflg@ */ Scalar_BOOLEAN 0 SWC_FDC_type_CM_boolean_flg 0.0 1.0 /end CHARACTERISTIC
/begin CHARACTERISTIC KTQD_LowIdle_flg_ovrdval "" VALUE 0x0000 /* @ECU_Address@KTQD_LowIdle_flg_ovrdval@ */ Scalar_BOOLEAN 0 SWC_FDC_type_CM_boolean_flg 0.0 1.0 /end CHARACTERISTIC
/begin CHARACTERISTIC KTQD_RegenModeMemo_flg "" VALUE 0x0000 /* @ECU_Address@KTQD_RegenModeMemo_flg@ */ Scalar_BOOLEAN 0 SWC_FDC_type_CM_boolean_flg 0.0 1.0 /end CHARACTERISTIC
/begin CHARACTERISTIC KTQD_RegenMode_enum_ovrdflg "" VALUE 0x0000 /* @ECU_Address@KTQD_RegenMode_enum_ovrdflg@ */ Scalar_BOOLEAN 0 SWC_FDC_type_CM_boolean_flg 0.0 1.0 /end CHARACTERISTIC
/begin CHARACTERISTIC KTQD_RgnModeChgResetSW_flg "" VALUE 0x0000 /* @ECU_Address@KTQD_RgnModeChgResetSW_flg@ */ Scalar_BOOLEAN 0 SWC_FDC_type_CM_boolean_flg 0.0 1.0 /end CHARACTERISTIC
/begin CHARACTERISTIC KTQD_RgnModeChgSW_flg "" VALUE 0x0000 /* @ECU_Address@KTQD_RgnModeChgSW_flg@ */ Scalar_BOOLEAN 0 SWC_FDC_type_CM_boolean_flg 0.0 1.0 /end CHARACTERISTIC
/begin CHARACTERISTIC KTQD_RrDmpDisabReq_flg_ovrdflg "" VALUE 0x0000 /* @ECU_Address@KTQD_RrDmpDisabReq_flg_ovrdflg@ */ Scalar_BOOLEAN 0 SWC_FDC_type_CM_boolean_flg 0.0 1.0 /end CHARACTERISTIC
/begin CHARACTERISTIC KTQD_RrDmpDisabReq_flg_ovrdval "" VALUE 0x0000 /* @ECU_Address@KTQD_RrDmpDisabReq_flg_ovrdval@ */ Scalar_BOOLEAN 0 SWC_FDC_type_CM_boolean_flg 0.0 1.0 /end CHARACTERISTIC
/begin CHARACTERISTIC KTQD_TrailerModeSW_flg_ovrdflg "" VALUE 0x0000 /* @ECU_Address@KTQD_TrailerModeSW_flg_ovrdflg@ */ Scalar_BOOLEAN 0 SWC_FDC_type_CM_boolean_flg 0.0 1.0 /end CHARACTERISTIC
/begin CHARACTERISTIC KTQD_TrailerModeSW_flg_ovrdval "" VALUE 0x0000 /* @ECU_Address@KTQD_TrailerModeSW_flg_ovrdval@ */ Scalar_BOOLEAN 0 SWC_FDC_type_CM_boolean_flg 0.0 1.0 /end CHARACTERISTIC
/begin CHARACTERISTIC KVMC_APPSpdLimit_flg_ovrdflg "" VALUE 0x0000 /* @ECU_Address@KVMC_APPSpdLimit_flg_ovrdflg@ */ Scalar_BOOLEAN 0 SWC_FDC_type_CM_boolean_flg 0.0 1.0 /end CHARACTERISTIC
/begin CHARACTERISTIC KVMC_APPSpdLimit_flg_ovrdval "" VALUE 0x0000 /* @ECU_Address@KVMC_APPSpdLimit_flg_ovrdval@ */ Scalar_BOOLEAN 0 SWC_FDC_type_CM_boolean_flg 0.0 1.0 /end CHARACTERISTIC
/begin CHARACTERISTIC KVMC_APPSpdLimit_ovrdflg "" VALUE 0x0000 /* @ECU_Address@KVMC_APPSpdLimit_ovrdflg@ */ Scalar_BOOLEAN 0 SWC_FDC_type_CM_boolean_flg 0.0 1.0 /end CHARACTERISTIC
/begin CHARACTERISTIC KVMC_APSSWC_flg "" VALUE 0x0000 /* @ECU_Address@KVMC_APSSWC_flg@ */ Scalar_BOOLEAN 0 SWC_FDC_type_CM_boolean_flg 0.0 1.0 /end CHARACTERISTIC
/begin CHARACTERISTIC KVMC_DIDGetDynoModeSW_flg "" VALUE 0x0000 /* @ECU_Address@KVMC_DIDGetDynoModeSW_flg@ */ Scalar_BOOLEAN 0 SWC_FDC_type_CM_boolean_flg 0.0 1.0 /end CHARACTERISTIC
/begin CHARACTERISTIC KVMC_DISCDecCtrlTest_flg "" VALUE 0x0000 /* @ECU_Address@KVMC_DISCDecCtrlTest_flg@ */ Scalar_BOOLEAN 0 SWC_FDC_type_CM_boolean_flg 0.0 1.0 /end CHARACTERISTIC
/begin CHARACTERISTIC KVMC_EstSlopeGxSource_flg "" VALUE 0x0000 /* @ECU_Address@KVMC_EstSlopeGxSource_flg@ */ Scalar_BOOLEAN 0 SWC_FDC_type_CM_boolean_flg 0.0 1.0 /end CHARACTERISTIC
/begin CHARACTERISTIC KVMC_ExternalCtrlAGSV_flg "" VALUE 0x0000 /* @ECU_Address@KVMC_ExternalCtrlAGSV_flg@ */ Scalar_BOOLEAN 0 SWC_FDC_type_CM_boolean_flg 0.0 1.0 /end CHARACTERISTIC
/begin CHARACTERISTIC KVMC_ExternalCtrlSW_flg "" VALUE 0x0000 /* @ECU_Address@KVMC_ExternalCtrlSW_flg@ */ Scalar_BOOLEAN 0 SWC_FDC_type_CM_boolean_flg 0.0 1.0 /end CHARACTERISTIC
/begin CHARACTERISTIC KVMC_GradeSourceSW_flg "" VALUE 0x0000 /* @ECU_Address@KVMC_GradeSourceSW_flg@ */ Scalar_BOOLEAN 0 SWC_FDC_type_CM_boolean_flg 0.0 1.0 /end CHARACTERISTIC
/begin CHARACTERISTIC KVMC_IMUEnaCmd_flg "" VALUE 0x0000 /* @ECU_Address@KVMC_IMUEnaCmd_flg@ */ Scalar_BOOLEAN 0 SWC_FDC_type_CM_boolean_flg 0.0 1.0 /end CHARACTERISTIC
/begin CHARACTERISTIC KVMC_MeterSpdRoundSW_flg "" VALUE 0x0000 /* @ECU_Address@KVMC_MeterSpdRoundSW_flg@ */ Scalar_BOOLEAN 0 SWC_FDC_type_CM_boolean_flg 0.0 1.0 /end CHARACTERISTIC
/begin CHARACTERISTIC KVMC_SafetyCtrlSWC_flg "" VALUE 0x0000 /* @ECU_Address@KVMC_SafetyCtrlSWC_flg@ */ Scalar_BOOLEAN 0 SWC_FDC_type_CM_boolean_flg 0.0 1.0 /end CHARACTERISTIC
/begin CHARACTERISTIC KBCM_Antitheft_enum_ovrdval "" VALUE 0x0000 /* @ECU_Address@KBCM_Antitheft_enum_ovrdval@ */ Scalar_UBYTE 0 SWC_FDC_type_CM_uint8_enum 0.0 3.0 /end CHARACTERISTIC
/begin CHARACTERISTIC KBCM_SPTGTOut_K "" VALUE 0x0000 /* @ECU_Address@KBCM_SPTGTOut_K@ */ Scalar_UBYTE 0 SWC_FDC_type_CM_uint8_K 0.0 255.0 /end CHARACTERISTIC
/begin CHARACTERISTIC KTHC_AGSDefLv_K "" VALUE 0x0000 /* @ECU_Address@KTHC_AGSDefLv_K@ */ Scalar_UBYTE 0 SWC_FDC_type_CM_uint8_K 0.0 240.0 /end CHARACTERISTIC
/begin CHARACTERISTIC KTHC_AGSLv1_K "" VALUE 0x0000 /* @ECU_Address@KTHC_AGSLv1_K@ */ Scalar_UBYTE 0 SWC_FDC_type_CM_uint8_K 0.0 240.0 /end CHARACTERISTIC
/begin CHARACTERISTIC KTHC_AGSLv2_K "" VALUE 0x0000 /* @ECU_Address@KTHC_AGSLv2_K@ */ Scalar_UBYTE 0 SWC_FDC_type_CM_uint8_K 0.0 240.0 /end CHARACTERISTIC
/begin CHARACTERISTIC KTHC_AGSLv3_K "" VALUE 0x0000 /* @ECU_Address@KTHC_AGSLv3_K@ */ Scalar_UBYTE 0 SWC_FDC_type_CM_uint8_K 0.0 240.0 /end CHARACTERISTIC
/begin CHARACTERISTIC KTHC_AGSLv4_K "" VALUE 0x0000 /* @ECU_Address@KTHC_AGSLv4_K@ */ Scalar_UBYTE 0 SWC_FDC_type_CM_uint8_K 0.0 240.0 /end CHARACTERISTIC
/begin CHARACTERISTIC KTHC_AGSLv5_K "" VALUE 0x0000 /* @ECU_Address@KTHC_AGSLv5_K@ */ Scalar_UBYTE 0 SWC_FDC_type_CM_uint8_K 0.0 240.0 /end CHARACTERISTIC
/begin CHARACTERISTIC KTHC_SolarDebounceT_sec "" VALUE 0x0000 /* @ECU_Address@KTHC_SolarDebounceT_sec@ */ Scalar_UBYTE 0 SWC_FDC_type_CM_uint8_sec 0.0 255.0 /end CHARACTERISTIC
/begin CHARACTERISTIC KTHC_TWVRcolPos_pct "" VALUE 0x0000 /* @ECU_Address@KTHC_TWVRcolPos_pct@ */ Scalar_UBYTE 0 SWC_FDC_type_CM_uint8_pct 0.0 100.0 /end CHARACTERISTIC
/begin CHARACTERISTIC KTHC_VehSdAGS100_kph "" VALUE 0x0000 /* @ECU_Address@KTHC_VehSdAGS100_kph@ */ Scalar_UBYTE 0 SWC_FDC_type_CM_uint8_kph 0.0 255.0 /end CHARACTERISTIC
/begin CHARACTERISTIC KTHC_VehSdAGSCtrl_kph "" VALUE 0x0000 /* @ECU_Address@KTHC_VehSdAGSCtrl_kph@ */ Scalar_UBYTE 0 SWC_FDC_type_CM_uint8_kph 0.0 255.0 /end CHARACTERISTIC
/begin CHARACTERISTIC KTHC_VehSdFanOff_kph "" VALUE 0x0000 /* @ECU_Address@KTHC_VehSdFanOff_kph@ */ Scalar_UBYTE 0 SWC_FDC_type_CM_uint8_kph 0.0 255.0 /end CHARACTERISTIC
/begin CHARACTERISTIC KTHC_VehSdFanOn_kph "" VALUE 0x0000 /* @ECU_Address@KTHC_VehSdFanOn_kph@ */ Scalar_UBYTE 0 SWC_FDC_type_CM_uint8_kph 0.0 255.0 /end CHARACTERISTIC
/begin CHARACTERISTIC KTPM_TPMSModelVersion_raw "" VALUE 0x0000 /* @ECU_Address@KTPM_TPMSModelVersion_raw@ */ Scalar_UBYTE 0 SWC_FDC_type_CM_uint8_kph 1.0 255.0 /end CHARACTERISTIC
/begin CHARACTERISTIC KTPM_WhlRotDir_enum_ovrdval "" VALUE 0x0000 /* @ECU_Address@KTPM_WhlRotDir_enum_ovrdval@ */ Scalar_UBYTE 0 SWC_FDC_type_CM_uint8_enum 0.0 2.0 /end CHARACTERISTIC
/begin CHARACTERISTIC KTQD_190MS_cnt "" VALUE 0x0000 /* @ECU_Address@KTQD_190MS_cnt@ */ Scalar_UBYTE 0 SWC_FDC_type_CM_uint8_cnt 0.0 255.0 /end CHARACTERISTIC
/begin CHARACTERISTIC KTQD_210MS_cnt "" VALUE 0x0000 /* @ECU_Address@KTQD_210MS_cnt@ */ Scalar_UBYTE 0 SWC_FDC_type_CM_uint8_cnt 0.0 255.0 /end CHARACTERISTIC
/begin CHARACTERISTIC KTQD_30MS_cnt "" VALUE 0x0000 /* @ECU_Address@KTQD_30MS_cnt@ */ Scalar_UBYTE 0 SWC_FDC_type_CM_uint8_cnt 0.0 255.0 /end CHARACTERISTIC
/begin CHARACTERISTIC KTQD_50MS_cnt "" VALUE 0x0000 /* @ECU_Address@KTQD_50MS_cnt@ */ Scalar_UBYTE 0 SWC_FDC_type_CM_uint8_cnt 0.0 255.0 /end CHARACTERISTIC
/begin CHARACTERISTIC KTQD_CrashPWMCnt_cnt "" VALUE 0x0000 /* @ECU_Address@KTQD_CrashPWMCnt_cnt@ */ Scalar_UBYTE 0 SWC_FDC_type_CM_uint8_cnt 0.0 255.0 /end CHARACTERISTIC
/begin CHARACTERISTIC KTQD_DefaultRegenMode_enum "" VALUE 0x0000 /* @ECU_Address@KTQD_DefaultRegenMode_enum@ */ Scalar_UBYTE 0 SWC_FDC_type_CM_uint8_enum 0.0 6.0 /end CHARACTERISTIC
/begin CHARACTERISTIC KTQD_DriveModeReq_enum_ovrdval "" VALUE 0x0000 /* @ECU_Address@KTQD_DriveModeReq_enum_ovrdval@ */ Scalar_UBYTE 0 SWC_FDC_type_CM_uint8_enum 0.0 3.0 /end CHARACTERISTIC
/begin CHARACTERISTIC KTQD_RegenMode_enum_ovrdval "" VALUE 0x0000 /* @ECU_Address@KTQD_RegenMode_enum_ovrdval@ */ Scalar_UBYTE 0 SWC_FDC_type_CM_uint8_enum 0.0 6.0 /end CHARACTERISTIC
/begin CHARACTERISTIC KVMC_ExternalCtrlSta_enum "" VALUE 0x0000 /* @ECU_Address@KVMC_ExternalCtrlSta_enum@ */ Scalar_UBYTE 0 SWC_FDC_type_CM_uint8_enum 0.0 9.0 /end CHARACTERISTIC
/begin CHARACTERISTIC KVMC_LongAccSource_enum "" VALUE 0x0000 /* @ECU_Address@KVMC_LongAccSource_enum@ */ Scalar_UBYTE 0 SWC_FDC_type_CM_uint8_enum 0.0 15.0 /end CHARACTERISTIC
/begin CHARACTERISTIC KVMC_MeterSpdRollAveLevel_enum "" VALUE 0x0000 /* @ECU_Address@KVMC_MeterSpdRollAveLevel_enum@ */ Scalar_UBYTE 0 SWC_FDC_type_CM_uint8_enum 1.0 100.0 /end CHARACTERISTIC
/begin MEASUREMENT VTPM_IDin_raw32 "" ULONG SWC_FDC_type_CM_uint32_raw32 0 0 0.0 4.294967295E+9 ECU_ADDRESS 0x0000 /* @ECU_Address@VTPM_IDin_raw32@ */ /end MEASUREMENT
/begin MEASUREMENT VDSC_DISCEstSlope_deg "" FLOAT32_IEEE SWC_FDC_type_CM_single_deg 0 0 0.0 40.0 ECU_ADDRESS 0x0000 /* @ECU_Address@VDSC_DISCEstSlope_deg@ */ /end MEASUREMENT
/begin MEASUREMENT VDSC_LowSpd_kph "" FLOAT32_IEEE SWC_FDC_type_CM_single_kph 0 0 0.0 250.0 ECU_ADDRESS 0x0000 /* @ECU_Address@VDSC_LowSpd_kph@ */ /end MEASUREMENT
/begin MEASUREMENT VDSC_TurningSpd_kph "" FLOAT32_IEEE SWC_FDC_type_CM_single_kph 0 0 0.0 250.0 ECU_ADDRESS 0x0000 /* @ECU_Address@VDSC_TurningSpd_kph@ */ /end MEASUREMENT
/begin MEASUREMENT VDSC_TurnLimitSpeed_kph "" FLOAT32_IEEE SWC_FDC_type_CM_single_kph 0 0 0.0 250.0 ECU_ADDRESS 0x0000 /* @ECU_Address@VDSC_TurnLimitSpeed_kph@ */ /end MEASUREMENT
/begin MEASUREMENT VTHC_sigSetTempZon1St_C "" FLOAT32_IEEE SWC_FDC_type_CM_single_C 0 0 17.0 32.0 ECU_ADDRESS 0x0000 /* @ECU_Address@VTHC_sigSetTempZon1St_C@ */ /end MEASUREMENT
/begin MEASUREMENT VVMC_APPSpdLimit_kph "" FLOAT32_IEEE SWC_FDC_type_CM_single_kph 0 0 0.0 255.0 ECU_ADDRESS 0x0000 /* @ECU_Address@VVMC_APPSpdLimit_kph@ */ /end MEASUREMENT
/begin MEASUREMENT VVMC_FeatSetSpdFinal_raw32 "" FLOAT32_IEEE SWC_FDC_type_CM_single_raw32 0 0 0.0 255.0 ECU_ADDRESS 0x0000 /* @ECU_Address@VVMC_FeatSetSpdFinal_raw32@ */ /end MEASUREMENT
/begin MEASUREMENT VVMC_FeatSetSpdForCalcu_kph "" FLOAT32_IEEE SWC_FDC_type_CM_single_kph 0 0 0.0 255.875 ECU_ADDRESS 0x0000 /* @ECU_Address@VVMC_FeatSetSpdForCalcu_kph@ */ /end MEASUREMENT
/begin MEASUREMENT VVMC_FeatReqSpd_kph "" FLOAT32_IEEE SWC_FDC_type_CM_single_kph 0 0 0.0 255.75 ECU_ADDRESS 0x0000 /* @ECU_Address@VVMC_FeatReqSpd_kph@ */ /end MEASUREMENT
/begin MEASUREMENT VVMC_JerkPCT_pct "" FLOAT32_IEEE SWC_FDC_type_CM_single_pct 0 0 0.0 100.0 ECU_ADDRESS 0x0000 /* @ECU_Address@VVMC_JerkPCT_pct@ */ /end MEASUREMENT
/begin MEASUREMENT VVMC_LimitPCT_pct "" FLOAT32_IEEE SWC_FDC_type_CM_single_pct 0 0 0.0 100.0 ECU_ADDRESS 0x0000 /* @ECU_Address@VVMC_LimitPCT_pct@ */ /end MEASUREMENT
/begin MEASUREMENT VVMC_EstSlope_Deg "" FLOAT32_IEEE SWC_FDC_type_CM_single_Deg 0 0 -180.0 180.0 ECU_ADDRESS 0x0000 /* @ECU_Address@VVMC_EstSlope_Deg@ */ /end MEASUREMENT
/begin MEASUREMENT VVMC_SINEGRADE_Gps "" FLOAT32_IEEE SWC_FDC_type_CM_single_Gps 0 0 -20.0 20.0 ECU_ADDRESS 0x0000 /* @ECU_Address@VVMC_SINEGRADE_Gps@ */ /end MEASUREMENT
/begin MEASUREMENT VVMC_LongAccCal1_Gps "" FLOAT32_IEEE SWC_FDC_type_CM_single_Gps 0 0 -20.0 20.0 ECU_ADDRESS 0x0000 /* @ECU_Address@VVMC_LongAccCal1_Gps@ */ /end MEASUREMENT
/begin MEASUREMENT VVMC_LongAccDeadZone_Gps "" FLOAT32_IEEE SWC_FDC_type_CM_single_Gps 0 0 0.0 20.0 ECU_ADDRESS 0x0000 /* @ECU_Address@VVMC_LongAccDeadZone_Gps@ */ /end MEASUREMENT
/begin MEASUREMENT VVMC_LongAccFiltTsforP2_c "" FLOAT32_IEEE SWC_FDC_type_CM_single_c 0 0 0.0 5.0 ECU_ADDRESS 0x0000 /* @ECU_Address@VVMC_LongAccFiltTsforP2_c@ */ /end MEASUREMENT
/begin MEASUREMENT VVMC_LKAStrToqReq_Nm "" FLOAT32_IEEE SWC_FDC_type_CM_single_Nm 0 0 -8.0 8.0 ECU_ADDRESS 0x0000 /* @ECU_Address@VVMC_LKAStrToqReq_Nm@ */ /end MEASUREMENT
/begin MEASUREMENT VVMC_FDCVMCAPSAngleTarget_deg "" FLOAT32_IEEE SWC_FDC_type_CM_single_deg 0 0 -360.0 360.0 ECU_ADDRESS 0x0000 /* @ECU_Address@VVMC_FDCVMCAPSAngleTarget_deg@ */ /end MEASUREMENT
/begin MEASUREMENT VVMC_FDCVMCAngCtrlTqWtGn_pct "" FLOAT32_IEEE SWC_FDC_type_CM_single_pct 0 0 0.0 102.0 ECU_ADDRESS 0x0000 /* @ECU_Address@VVMC_FDCVMCAngCtrlTqWtGn_pct@ */ /end MEASUREMENT
/begin MEASUREMENT VVMC_FDCVMCMaxAngCtrlOutTqLim_Nm "" FLOAT32_IEEE SWC_FDC_type_CM_single_Nm 0 0 0.0 51.1 ECU_ADDRESS 0x0000 /* @ECU_Address@VVMC_FDCVMCMaxAngCtrlOutTqLim_Nm@ */ /end MEASUREMENT
/begin MEASUREMENT VVMC_FDCVMCDrInpTqBstGn_pct "" FLOAT32_IEEE SWC_FDC_type_CM_single_pct 0 0 0.0 102.0 ECU_ADDRESS 0x0000 /* @ECU_Address@VVMC_FDCVMCDrInpTqBstGn_pct@ */ /end MEASUREMENT
/begin MEASUREMENT VVMC_CalMeterSpeed_kph "" FLOAT32_IEEE SWC_FDC_type_CM_single_kph 0 0 0.0 300.0 ECU_ADDRESS 0x0000 /* @ECU_Address@VVMC_CalMeterSpeed_kph@ */ /end MEASUREMENT
/begin MEASUREMENT VVMC_ACCLongSteadyCtrl_kph "" FLOAT32_IEEE SWC_FDC_type_CM_single_kph 0 0 0.0 300.0 ECU_ADDRESS 0x0000 /* @ECU_Address@VVMC_ACCLongSteadyCtrl_kph@ */ /end MEASUREMENT
/begin MEASUREMENT VVMC_CCLongSteadyCtrl_kph "" FLOAT32_IEEE SWC_FDC_type_CM_single_kph 0 0 0.0 300.0 ECU_ADDRESS 0x0000 /* @ECU_Address@VVMC_CCLongSteadyCtrl_kph@ */ /end MEASUREMENT
/begin MEASUREMENT VVMC_MSALongSteadyCtrl_kph "" FLOAT32_IEEE SWC_FDC_type_CM_single_kph 0 0 0.0 300.0 ECU_ADDRESS 0x0000 /* @ECU_Address@VVMC_MSALongSteadyCtrl_kph@ */ /end MEASUREMENT
/begin MEASUREMENT VVMC_MeterIndSpeed_raw32 "" FLOAT32_IEEE SWC_FDC_type_CM_single_raw32 0 0 0.0 254.0 ECU_ADDRESS 0x0000 /* @ECU_Address@VVMC_MeterIndSpeed_raw32@ */ /end MEASUREMENT
/begin MEASUREMENT VVMC_MeterIndSpeedForCalcu_kph "" FLOAT32_IEEE SWC_FDC_type_CM_single_kph 0 0 0.0 254.0 ECU_ADDRESS 0x0000 /* @ECU_Address@VVMC_MeterIndSpeedForCalcu_kph@ */ /end MEASUREMENT
/begin MEASUREMENT VVMC_VehicleSpeed_mph "" FLOAT32_IEEE SWC_FDC_type_CM_single_mph 0 0 0.0 254.0 ECU_ADDRESS 0x0000 /* @ECU_Address@VVMC_VehicleSpeed_mph@ */ /end MEASUREMENT
/begin MEASUREMENT VVMC_VehicleSpeed_kph "" FLOAT32_IEEE SWC_FDC_type_CM_single_kph 0 0 0.0 254.0 ECU_ADDRESS 0x0000 /* @ECU_Address@VVMC_VehicleSpeed_kph@ */ /end MEASUREMENT
/begin MEASUREMENT VTQD_TqTargetShaftSpd_rpm "" FLOAT32_IEEE SWC_FDC_type_CM_single_rpm 0 0 -100000.0 100000.0 ECU_ADDRESS 0x0000 /* @ECU_Address@VTQD_TqTargetShaftSpd_rpm@ */ /end MEASUREMENT
/begin MEASUREMENT VTQD_ActAPSPosn_pct "" FLOAT32_IEEE SWC_FDC_type_CM_single_pct 0 0 0.0 125.0 ECU_ADDRESS 0x0000 /* @ECU_Address@VTQD_ActAPSPosn_pct@ */ /end MEASUREMENT
/begin MEASUREMENT VTQD_ActBPSPosn_pct "" FLOAT32_IEEE SWC_FDC_type_CM_single_pct 0 0 0.0 100.0 ECU_ADDRESS 0x0000 /* @ECU_Address@VTQD_ActBPSPosn_pct@ */ /end MEASUREMENT
/begin MEASUREMENT VTQD_EquivAccPed_pct "" FLOAT32_IEEE SWC_FDC_type_CM_single_pct 0 0 0.0 100.0 ECU_ADDRESS 0x0000 /* @ECU_Address@VTQD_EquivAccPed_pct@ */ /end MEASUREMENT
/begin MEASUREMENT VTQD_SetSpd_kph "" FLOAT32_IEEE SWC_FDC_type_CM_single_kph 0 0 0.0 254.0 ECU_ADDRESS 0x0000 /* @ECU_Address@VTQD_SetSpd_kph@ */ /end MEASUREMENT
/begin MEASUREMENT VTQD_RgnModeChgAPSPosn_pct "" FLOAT32_IEEE SWC_FDC_type_CM_single_pct 0 0 0.0 125.0 ECU_ADDRESS 0x0000 /* @ECU_Address@VTQD_RgnModeChgAPSPosn_pct@ */ /end MEASUREMENT
/begin MEASUREMENT VDHP_EAPS1NRM_pct "" FLOAT32_IEEE SWC_FDC_type_CM_single_pct 0 0 0.0 120.0 ECU_ADDRESS 0x0000 /* @ECU_Address@VDHP_EAPS1NRM_pct@ */ /end MEASUREMENT
/begin MEASUREMENT VDHP_EAPS1MINInit_pct "" FLOAT32_IEEE SWC_FDC_type_CM_single_pct 0 0 0.0 120.0 ECU_ADDRESS 0x0000 /* @ECU_Address@VDHP_EAPS1MINInit_pct@ */ /end MEASUREMENT
/begin MEASUREMENT VDHP_EAPS2NRM_pct "" FLOAT32_IEEE SWC_FDC_type_CM_single_pct 0 0 0.0 120.0 ECU_ADDRESS 0x0000 /* @ECU_Address@VDHP_EAPS2NRM_pct@ */ /end MEASUREMENT
/begin MEASUREMENT VDHP_EAPS1NRMDiff_pct "" FLOAT32_IEEE SWC_FDC_type_CM_single_pct 0 0 0.0 120.0 ECU_ADDRESS 0x0000 /* @ECU_Address@VDHP_EAPS1NRMDiff_pct@ */ /end MEASUREMENT
/begin MEASUREMENT VDHP_EAPS1MIN_pct "" FLOAT32_IEEE SWC_FDC_type_CM_single_pct 0 0 0.0 120.0 ECU_ADDRESS 0x0000 /* @ECU_Address@VDHP_EAPS1MIN_pct@ */ /end MEASUREMENT
/begin MEASUREMENT VDHP_EAPS1DIS_pct "" FLOAT32_IEEE SWC_FDC_type_CM_single_pct 0 0 0.0 120.0 ECU_ADDRESS 0x0000 /* @ECU_Address@VDHP_EAPS1DIS_pct@ */ /end MEASUREMENT
/begin MEASUREMENT VDHP_EAPS2MINInit_pct "" FLOAT32_IEEE SWC_FDC_type_CM_single_pct 0 0 0.0 120.0 ECU_ADDRESS 0x0000 /* @ECU_Address@VDHP_EAPS2MINInit_pct@ */ /end MEASUREMENT
/begin MEASUREMENT VDHP_EAPS2NRMDiff_pct "" FLOAT32_IEEE SWC_FDC_type_CM_single_pct 0 0 0.0 120.0 ECU_ADDRESS 0x0000 /* @ECU_Address@VDHP_EAPS2NRMDiff_pct@ */ /end MEASUREMENT
/begin MEASUREMENT VDHP_EAPS2MIN_pct "" FLOAT32_IEEE SWC_FDC_type_CM_single_pct 0 0 0.0 120.0 ECU_ADDRESS 0x0000 /* @ECU_Address@VDHP_EAPS2MIN_pct@ */ /end MEASUREMENT
/begin MEASUREMENT VDHP_EAPS2DIS_pct "" FLOAT32_IEEE SWC_FDC_type_CM_single_pct 0 0 0.0 120.0 ECU_ADDRESS 0x0000 /* @ECU_Address@VDHP_EAPS2DIS_pct@ */ /end MEASUREMENT
/begin MEASUREMENT VDHP_EAPSWDSP_pct "" FLOAT32_IEEE SWC_FDC_type_CM_single_pct 0 0 0.0 120.0 ECU_ADDRESS 0x0000 /* @ECU_Address@VDHP_EAPSWDSP_pct@ */ /end MEASUREMENT
/begin MEASUREMENT VDHP_EPEDLIND_pct "" FLOAT32_IEEE SWC_FDC_type_CM_single_pct 0 0 0.0 120.0 ECU_ADDRESS 0x0000 /* @ECU_Address@VDHP_EPEDLIND_pct@ */ /end MEASUREMENT
/begin MEASUREMENT VDHP_HysOffset_pct "" FLOAT32_IEEE SWC_FDC_type_CM_single_pct 0 0 0.0 120.0 ECU_ADDRESS 0x0000 /* @ECU_Address@VDHP_HysOffset_pct@ */ /end MEASUREMENT
/begin MEASUREMENT VDHP_ActAPSPosn_pct "" FLOAT32_IEEE SWC_FDC_type_CM_single_pct 0 0 0.0 120.0 ECU_ADDRESS 0x0000 /* @ECU_Address@VDHP_ActAPSPosn_pct@ */ /end MEASUREMENT
/begin MEASUREMENT VPMM_CoolgFanActCurrOut_A "" FLOAT32_IEEE SWC_FDC_type_CM_single_A 0 0 0.0 3600.0 ECU_ADDRESS 0x0000 /* @ECU_Address@VPMM_CoolgFanActCurrOut_A@ */ /end MEASUREMENT
/begin MEASUREMENT VPMM_EWP3CurrOut_A "" FLOAT32_IEEE SWC_FDC_type_CM_single_A 0 0 0.0 3600.0 ECU_ADDRESS 0x0000 /* @ECU_Address@VPMM_EWP3CurrOut_A@ */ /end MEASUREMENT
/begin MEASUREMENT VPMM_EWP1CurrOut_A "" FLOAT32_IEEE SWC_FDC_type_CM_single_A 0 0 0.0 3600.0 ECU_ADDRESS 0x0000 /* @ECU_Address@VPMM_EWP1CurrOut_A@ */ /end MEASUREMENT
/begin MEASUREMENT VPMM_LVBattChrgtimeOut_s "" FLOAT32_IEEE SWC_FDC_type_CM_single_s 0 0 0.0 86400.0 ECU_ADDRESS 0x0000 /* @ECU_Address@VPMM_LVBattChrgtimeOut_s@ */ /end MEASUREMENT
/begin MEASUREMENT VPMM_LVChrgLvOut_enum "" FLOAT32_IEEE SWC_FDC_type_CM_single_enum 0 0 0.0 3.0 ECU_ADDRESS 0x0000 /* @ECU_Address@VPMM_LVChrgLvOut_enum@ */ /end MEASUREMENT
/begin MEASUREMENT VTHC_sigWindDirZon1St_enum "" UBYTE SWC_FDC_type_CM_uint8_enum 0 0 0.0 7.0 ECU_ADDRESS 0x0000 /* @ECU_Address@VTHC_sigWindDirZon1St_enum@ */ /end MEASUREMENT
/begin MEASUREMENT VTHC_FDRecyAutoCmd_enum "" UBYTE SWC_FDC_type_CM_uint8_enum 0 0 0.0 4.0 ECU_ADDRESS 0x0000 /* @ECU_Address@VTHC_FDRecyAutoCmd_enum@ */ /end MEASUREMENT
/begin MEASUREMENT VTHC_ACModeMem_enum "" UBYTE SWC_FDC_type_CM_uint8_enum 0 0 0.0 2.0 ECU_ADDRESS 0x0000 /* @ECU_Address@VTHC_ACModeMem_enum@ */ /end MEASUREMENT
/begin MEASUREMENT VTHC_AirIntenZone1M_enum "" UBYTE SWC_FDC_type_CM_uint8_enum 0 0 0.0 15.0 ECU_ADDRESS 0x0000 /* @ECU_Address@VTHC_AirIntenZone1M_enum@ */ /end MEASUREMENT
/begin MEASUREMENT VVMC_MSACtrlSta_enum "" UBYTE SWC_FDC_type_CM_uint8_enum 0 0 0.0 8.0 ECU_ADDRESS 0x0000 /* @ECU_Address@VVMC_MSACtrlSta_enum@ */ /end MEASUREMENT
/begin MEASUREMENT VVMC_FeatStaConfirm_enum "" UBYTE SWC_FDC_type_CM_uint8_enum 0 0 0.0 98.0 ECU_ADDRESS 0x0000 /* @ECU_Address@VVMC_FeatStaConfirm_enum@ */ /end MEASUREMENT
/begin MEASUREMENT VVMC_FeatArbitrSta_enum "" UBYTE SWC_FDC_type_CM_uint8_enum 0 0 0.0 6.0 ECU_ADDRESS 0x0000 /* @ECU_Address@VVMC_FeatArbitrSta_enum@ */ /end MEASUREMENT
/begin MEASUREMENT VVMC_LKATOIAct_enum "" UBYTE SWC_FDC_type_CM_uint8_enum 0 0 0.0 255.0 ECU_ADDRESS 0x0000 /* @ECU_Address@VVMC_LKATOIAct_enum@ */ /end MEASUREMENT
/begin MEASUREMENT VVMC_ADASACCSta_enum "" UBYTE SWC_FDC_type_CM_uint8_enum 0 0 0.0 7.0 ECU_ADDRESS 0x0000 /* @ECU_Address@VVMC_ADASACCSta_enum@ */ /end MEASUREMENT
/begin MEASUREMENT VVMC_ADASLFCSta_enum "" UBYTE SWC_FDC_type_CM_uint8_enum 0 0 0.0 7.0 ECU_ADDRESS 0x0000 /* @ECU_Address@VVMC_ADASLFCSta_enum@ */ /end MEASUREMENT
/begin MEASUREMENT VVMC_ADASLFCHandsOffWarning_enum "" UBYTE SWC_FDC_type_CM_uint8_enum 0 0 0.0 3.0 ECU_ADDRESS 0x0000 /* @ECU_Address@VVMC_ADASLFCHandsOffWarning_enum@ */ /end MEASUREMENT
/begin MEASUREMENT VVMC_ADASLFCWarnSound_enum "" UBYTE SWC_FDC_type_CM_uint8_enum 0 0 0.0 255.0 ECU_ADDRESS 0x0000 /* @ECU_Address@VVMC_ADASLFCWarnSound_enum@ */ /end MEASUREMENT
/begin MEASUREMENT VVMC_FCMLDWRequest_enum "" UBYTE SWC_FDC_type_CM_uint8_enum 0 0 0.0 3.0 ECU_ADDRESS 0x0000 /* @ECU_Address@VVMC_FCMLDWRequest_enum@ */ /end MEASUREMENT
/begin MEASUREMENT VVMC_ExtraMSACtrlSta_enum "" UBYTE SWC_FDC_type_CM_uint8_enum 0 0 0.0 15.0 ECU_ADDRESS 0x0000 /* @ECU_Address@VVMC_ExtraMSACtrlSta_enum@ */ /end MEASUREMENT
/begin MEASUREMENT VVMC_DMSModeCmd_enum "" UBYTE SWC_FDC_type_CM_uint8_enum 0 0 0.0 15.0 ECU_ADDRESS 0x0000 /* @ECU_Address@VVMC_DMSModeCmd_enum@ */ /end MEASUREMENT
/begin MEASUREMENT VTQD_TMRotateDirction_enum "" UBYTE SWC_FDC_type_CM_uint8_enum 0 0 0.0 2.0 ECU_ADDRESS 0x0000 /* @ECU_Address@VTQD_TMRotateDirction_enum@ */ /end MEASUREMENT
/begin MEASUREMENT VTQD_GearActualPosn_enum "" UBYTE SWC_FDC_type_CM_uint8_enum 0 0 0.0 4.0 ECU_ADDRESS 0x0000 /* @ECU_Address@VTQD_GearActualPosn_enum@ */ /end MEASUREMENT
/begin MEASUREMENT VTQD_ReadRegenMode_enum "" UBYTE SWC_FDC_type_CM_uint8_enum 0 0 0.0 7.0 ECU_ADDRESS 0x0000 /* @ECU_Address@VTQD_ReadRegenMode_enum@ */ /end MEASUREMENT
/begin MEASUREMENT VTQD_ActRgnUserSet_enum "" UBYTE SWC_FDC_type_CM_uint8_enum 0 0 0.0 15.0 ECU_ADDRESS 0x0000 /* @ECU_Address@VTQD_ActRgnUserSet_enum@ */ /end MEASUREMENT
/begin MEASUREMENT VTQD_FDCVCURegenMode_enum "" UBYTE SWC_FDC_type_CM_uint8_enum 0 0 0.0 7.0 ECU_ADDRESS 0x0000 /* @ECU_Address@VTQD_FDCVCURegenMode_enum@ */ /end MEASUREMENT
/begin MEASUREMENT VTQD_RegenMode_enum "" UBYTE SWC_FDC_type_CM_uint8_enum 0 0 0.0 15.0 ECU_ADDRESS 0x0000 /* @ECU_Address@VTQD_RegenMode_enum@ */ /end MEASUREMENT
/begin MEASUREMENT VTQD_RDCActive_enum "" UBYTE SWC_FDC_type_CM_uint8_enum 0 0 0.0 2.0 ECU_ADDRESS 0x0000 /* @ECU_Address@VTQD_RDCActive_enum@ */ /end MEASUREMENT
/begin MEASUREMENT VTQD_EVDriveMode_enum "" UBYTE SWC_FDC_type_CM_uint8_enum 0 0 0.0 3.0 ECU_ADDRESS 0x0000 /* @ECU_Address@VTQD_EVDriveMode_enum@ */ /end MEASUREMENT
/begin MEASUREMENT VTQD_ShiftGearPosn_enum "" UBYTE SWC_FDC_type_CM_uint8_enum 0 0 0.0 7.0 ECU_ADDRESS 0x0000 /* @ECU_Address@VTQD_ShiftGearPosn_enum@ */ /end MEASUREMENT
/begin MEASUREMENT VTQD_fCrash_cnt "" UBYTE SWC_FDC_type_CM_uint8_cnt 0 0 0.0 255.0 ECU_ADDRESS 0x0000 /* @ECU_Address@VTQD_fCrash_cnt@ */ /end MEASUREMENT
/begin MEASUREMENT VTQD_IVIPwrLockSta_enum "" UBYTE SWC_FDC_type_CM_uint8_enum 0 0 0.0 15.0 ECU_ADDRESS 0x0000 /* @ECU_Address@VTQD_IVIPwrLockSta_enum@ */ /end MEASUREMENT
/begin MEASUREMENT VTQD_SaveRegenMode_enum "" UBYTE SWC_FDC_type_CM_uint8_enum 0 0 0.0 7.0 ECU_ADDRESS 0x0000 /* @ECU_Address@VTQD_SaveRegenMode_enum@ */ /end MEASUREMENT
/begin MEASUREMENT VTQD_SpdCtrlMode_enum "" UBYTE SWC_FDC_type_CM_uint8_enum 0 0 0.0 5.0 ECU_ADDRESS 0x0000 /* @ECU_Address@VTQD_SpdCtrlMode_enum@ */ /end MEASUREMENT
/begin MEASUREMENT VTQD_ACCSetSpd_kph "" UBYTE SWC_FDC_type_CM_uint8_kph 0 0 0.0 250.0 ECU_ADDRESS 0x0000 /* @ECU_Address@VTQD_ACCSetSpd_kph@ */ /end MEASUREMENT
/begin MEASUREMENT VTQD_CCSetSpd_kph "" UBYTE SWC_FDC_type_CM_uint8_kph 0 0 0.0 250.0 ECU_ADDRESS 0x0000 /* @ECU_Address@VTQD_CCSetSpd_kph@ */ /end MEASUREMENT
/begin MEASUREMENT VTQD_MSASetSpd_kph "" UBYTE SWC_FDC_type_CM_uint8_kph 0 0 0.0 250.0 ECU_ADDRESS 0x0000 /* @ECU_Address@VTQD_MSASetSpd_kph@ */ /end MEASUREMENT
/begin MEASUREMENT VTQD_ISASetSpd_kph "" UBYTE SWC_FDC_type_CM_uint8_kph 0 0 0.0 250.0 ECU_ADDRESS 0x0000 /* @ECU_Address@VTQD_ISASetSpd_kph@ */ /end MEASUREMENT
/begin MEASUREMENT VDHP_EAPS12RangeSta_enum "" UBYTE SWC_FDC_type_CM_uint8_enum 0 0 0.0 3.0 ECU_ADDRESS 0x0000 /* @ECU_Address@VDHP_EAPS12RangeSta_enum@ */ /end MEASUREMENT
/begin MEASUREMENT VBCM_AntitheftSta_enum "" UBYTE SWC_FDC_type_CM_uint8_enum 0 0 0.0 3.0 ECU_ADDRESS 0x0000 /* @ECU_Address@VBCM_AntitheftSta_enum@ */ /end MEASUREMENT
/begin MEASUREMENT VBCM_TimeGapLevelSta_enum "" UBYTE SWC_FDC_type_CM_uint8_enum 0 0 0.0 255.0 ECU_ADDRESS 0x0000 /* @ECU_Address@VBCM_TimeGapLevelSta_enum@ */ /end MEASUREMENT
/begin MEASUREMENT VBCM_DrvWdwReqAP_enum "" UBYTE SWC_FDC_type_CM_uint8_enum 0 0 0.0 255.0 ECU_ADDRESS 0x0000 /* @ECU_Address@VBCM_DrvWdwReqAP_enum@ */ /end MEASUREMENT
/begin MEASUREMENT VBCM_DrvWdwCtrlCmd_pct "" UBYTE SWC_FDC_type_CM_uint8_pct 0 0 0.0 255.0 ECU_ADDRESS 0x0000 /* @ECU_Address@VBCM_DrvWdwCtrlCmd_pct@ */ /end MEASUREMENT
/begin MEASUREMENT VBCM_PasWdwReqAP_enum "" UBYTE SWC_FDC_type_CM_uint8_enum 0 0 0.0 255.0 ECU_ADDRESS 0x0000 /* @ECU_Address@VBCM_PasWdwReqAP_enum@ */ /end MEASUREMENT
/begin MEASUREMENT VBCM_PasWdwCtrlCmd_pct "" UBYTE SWC_FDC_type_CM_uint8_pct 0 0 0.0 255.0 ECU_ADDRESS 0x0000 /* @ECU_Address@VBCM_PasWdwCtrlCmd_pct@ */ /end MEASUREMENT
/begin MEASUREMENT VBCM_HMIKey1FuncSta_enum "" UBYTE SWC_FDC_type_CM_uint8_enum 0 0 0.0 255.0 ECU_ADDRESS 0x0000 /* @ECU_Address@VBCM_HMIKey1FuncSta_enum@ */ /end MEASUREMENT
/begin MEASUREMENT VBCM_HMIKey2FuncSta_enum "" UBYTE SWC_FDC_type_CM_uint8_enum 0 0 0.0 255.0 ECU_ADDRESS 0x0000 /* @ECU_Address@VBCM_HMIKey2FuncSta_enum@ */ /end MEASUREMENT
/begin MEASUREMENT VBCM_HMIKey3FuncSta_enum "" UBYTE SWC_FDC_type_CM_uint8_enum 0 0 0.0 255.0 ECU_ADDRESS 0x0000 /* @ECU_Address@VBCM_HMIKey3FuncSta_enum@ */ /end MEASUREMENT
/begin MEASUREMENT VBCM_HMIKey4FuncSta_enum "" UBYTE SWC_FDC_type_CM_uint8_enum 0 0 0.0 255.0 ECU_ADDRESS 0x0000 /* @ECU_Address@VBCM_HMIKey4FuncSta_enum@ */ /end MEASUREMENT
/begin MEASUREMENT VBCM_HMIKey5FuncSta_enum "" UBYTE SWC_FDC_type_CM_uint8_enum 0 0 0.0 255.0 ECU_ADDRESS 0x0000 /* @ECU_Address@VBCM_HMIKey5FuncSta_enum@ */ /end MEASUREMENT
/begin MEASUREMENT VBCM_HMIKey6FuncSta_enum "" UBYTE SWC_FDC_type_CM_uint8_enum 0 0 0.0 255.0 ECU_ADDRESS 0x0000 /* @ECU_Address@VBCM_HMIKey6FuncSta_enum@ */ /end MEASUREMENT
/begin MEASUREMENT VBCM_HMIKey7FuncSta_enum "" UBYTE SWC_FDC_type_CM_uint8_enum 0 0 0.0 255.0 ECU_ADDRESS 0x0000 /* @ECU_Address@VBCM_HMIKey7FuncSta_enum@ */ /end MEASUREMENT
/begin MEASUREMENT VBCM_HMIKey8FuncSta_enum "" UBYTE SWC_FDC_type_CM_uint8_enum 0 0 0.0 255.0 ECU_ADDRESS 0x0000 /* @ECU_Address@VBCM_HMIKey8FuncSta_enum@ */ /end MEASUREMENT
/begin MEASUREMENT VBCM_LRRDCtrlCmd_pct "" UBYTE SWC_FDC_type_CM_uint8_pct 0 0 0.0 255.0 ECU_ADDRESS 0x0000 /* @ECU_Address@VBCM_LRRDCtrlCmd_pct@ */ /end MEASUREMENT
/begin MEASUREMENT VBCM_LRLDCtrlCmd_pct "" UBYTE SWC_FDC_type_CM_uint8_pct 0 0 0.0 255.0 ECU_ADDRESS 0x0000 /* @ECU_Address@VBCM_LRLDCtrlCmd_pct@ */ /end MEASUREMENT
/begin MEASUREMENT VBCM_LPasCtrlCmd_pct "" UBYTE SWC_FDC_type_CM_uint8_pct 0 0 0.0 255.0 ECU_ADDRESS 0x0000 /* @ECU_Address@VBCM_LPasCtrlCmd_pct@ */ /end MEASUREMENT
/begin MEASUREMENT VBCM_LDrvCtrlCmd_pct "" UBYTE SWC_FDC_type_CM_uint8_pct 0 0 0.0 255.0 ECU_ADDRESS 0x0000 /* @ECU_Address@VBCM_LDrvCtrlCmd_pct@ */ /end MEASUREMENT
/begin MEASUREMENT VDKC_PressSW2Latch_flg "" UBYTE SWC_FDC_type_CM_boolean_flg 0 0 0.0 1.0 ECU_ADDRESS 0x0000 /* @ECU_Address@VDKC_PressSW2Latch_flg@ */ /end MEASUREMENT
/begin MEASUREMENT VDKC_PressSW1Latch_flg "" UBYTE SWC_FDC_type_CM_boolean_flg 0 0 0.0 1.0 ECU_ADDRESS 0x0000 /* @ECU_Address@VDKC_PressSW1Latch_flg@ */ /end MEASUREMENT
/begin MEASUREMENT VDKC_RemTGCmdFaillEdgeLatch_flg "" UBYTE SWC_FDC_type_CM_boolean_flg 0 0 0.0 1.0 ECU_ADDRESS 0x0000 /* @ECU_Address@VDKC_RemTGCmdFaillEdgeLatch_flg@ */ /end MEASUREMENT
/begin MEASUREMENT VDKC_JudgeKeepUnlockZone_flg "" UBYTE SWC_FDC_type_CM_boolean_flg 0 0 0.0 1.0 ECU_ADDRESS 0x0000 /* @ECU_Address@VDKC_JudgeKeepUnlockZone_flg@ */ /end MEASUREMENT
/begin MEASUREMENT VDKC_BTDisconDebLatch_flg "" UBYTE SWC_FDC_type_CM_boolean_flg 0 0 0.0 1.0 ECU_ADDRESS 0x0000 /* @ECU_Address@VDKC_BTDisconDebLatch_flg@ */ /end MEASUREMENT
/begin MEASUREMENT VDKC_OnReadyKeyMissLatch_flg "" UBYTE SWC_FDC_type_CM_boolean_flg 0 0 0.0 1.0 ECU_ADDRESS 0x0000 /* @ECU_Address@VDKC_OnReadyKeyMissLatch_flg@ */ /end MEASUREMENT
/begin MEASUREMENT VDKC_LidADetGreenCardLatch4s_flg "" UBYTE SWC_FDC_type_CM_boolean_flg 0 0 0.0 1.0 ECU_ADDRESS 0x0000 /* @ECU_Address@VDKC_LidADetGreenCardLatch4s_flg@ */ /end MEASUREMENT
/begin MEASUREMENT VDKC_DrDoorOpenStaLatch4s_flg "" UBYTE SWC_FDC_type_CM_boolean_flg 0 0 0.0 1.0 ECU_ADDRESS 0x0000 /* @ECU_Address@VDKC_DrDoorOpenStaLatch4s_flg@ */ /end MEASUREMENT
/begin MEASUREMENT VDKC_UWBDetChgWelcomeLatch_flg "" UBYTE SWC_FDC_type_CM_boolean_flg 0 0 0.0 1.0 ECU_ADDRESS 0x0000 /* @ECU_Address@VDKC_UWBDetChgWelcomeLatch_flg@ */ /end MEASUREMENT
/begin MEASUREMENT VDKC_UIDBackWPressLacth_flg "" UBYTE SWC_FDC_type_CM_boolean_flg 0 0 0.0 1.0 ECU_ADDRESS 0x0000 /* @ECU_Address@VDKC_UIDBackWPressLacth_flg@ */ /end MEASUREMENT
/begin MEASUREMENT VDKC_UIDForWPressLacth_flg "" UBYTE SWC_FDC_type_CM_boolean_flg 0 0 0.0 1.0 ECU_ADDRESS 0x0000 /* @ECU_Address@VDKC_UIDForWPressLacth_flg@ */ /end MEASUREMENT
/begin MEASUREMENT VDKC_WaitAPMReqEnTrgT_flg "" UBYTE SWC_FDC_type_CM_boolean_flg 0 0 0.0 1.0 ECU_ADDRESS 0x0000 /* @ECU_Address@VDKC_WaitAPMReqEnTrgT_flg@ */ /end MEASUREMENT
/begin MEASUREMENT VDKC_WaitUserReqTrgT_flg "" UBYTE SWC_FDC_type_CM_boolean_flg 0 0 0.0 1.0 ECU_ADDRESS 0x0000 /* @ECU_Address@VDKC_WaitUserReqTrgT_flg@ */ /end MEASUREMENT
/begin MEASUREMENT VTPM_TPMSSensorIDRegStart_flg "" UBYTE SWC_FDC_type_CM_boolean_flg 0 0 0.0 1.0 ECU_ADDRESS 0x0000 /* @ECU_Address@VTPM_TPMSSensorIDRegStart_flg@ */ /end MEASUREMENT
/begin MEASUREMENT VTPM_TPMSResButt_flg "" UBYTE SWC_FDC_type_CM_boolean_flg 0 0 0.0 1.0 ECU_ADDRESS 0x0000 /* @ECU_Address@VTPM_TPMSResButt_flg@ */ /end MEASUREMENT
/begin MEASUREMENT VTPM_TPMSStorge_flg "" UBYTE SWC_FDC_type_CM_boolean_flg 0 0 0.0 1.0 ECU_ADDRESS 0x0000 /* @ECU_Address@VTPM_TPMSStorge_flg@ */ /end MEASUREMENT
/begin MEASUREMENT VTPM_ChkStorge_flg "" UBYTE SWC_FDC_type_CM_boolean_flg 0 0 0.0 1.0 ECU_ADDRESS 0x0000 /* @ECU_Address@VTPM_ChkStorge_flg@ */ /end MEASUREMENT
/begin MEASUREMENT VTHC_CCUSyncSts_flg "" UBYTE SWC_FDC_type_CM_boolean_flg 0 0 0.0 1.0 ECU_ADDRESS 0x0000 /* @ECU_Address@VTHC_CCUSyncSts_flg@ */ /end MEASUREMENT
/begin MEASUREMENT VTHC_sigRecircSt_flg "" UBYTE SWC_FDC_type_CM_boolean_flg 0 0 0.0 1.0 ECU_ADDRESS 0x0000 /* @ECU_Address@VTHC_sigRecircSt_flg@ */ /end MEASUREMENT
/begin MEASUREMENT VTHC_Face_flg "" UBYTE SWC_FDC_type_CM_boolean_flg 0 0 0.0 1.0 ECU_ADDRESS 0x0000 /* @ECU_Address@VTHC_Face_flg@ */ /end MEASUREMENT
/begin MEASUREMENT VTHC_Foot_flg "" UBYTE SWC_FDC_type_CM_boolean_flg 0 0 0.0 1.0 ECU_ADDRESS 0x0000 /* @ECU_Address@VTHC_Foot_flg@ */ /end MEASUREMENT
/begin MEASUREMENT VTHC_Frost_flg "" UBYTE SWC_FDC_type_CM_boolean_flg 0 0 0.0 1.0 ECU_ADDRESS 0x0000 /* @ECU_Address@VTHC_Frost_flg@ */ /end MEASUREMENT
/begin MEASUREMENT VTHC_FaceM_flg "" UBYTE SWC_FDC_type_CM_boolean_flg 0 0 0.0 1.0 ECU_ADDRESS 0x0000 /* @ECU_Address@VTHC_FaceM_flg@ */ /end MEASUREMENT
/begin MEASUREMENT VTHC_FootM_flg "" UBYTE SWC_FDC_type_CM_boolean_flg 0 0 0.0 1.0 ECU_ADDRESS 0x0000 /* @ECU_Address@VTHC_FootM_flg@ */ /end MEASUREMENT
/begin MEASUREMENT VTHC_RecAutoFlg_flg "" UBYTE SWC_FDC_type_CM_boolean_flg 0 0 0.0 1.0 ECU_ADDRESS 0x0000 /* @ECU_Address@VTHC_RecAutoFlg_flg@ */ /end MEASUREMENT
/begin MEASUREMENT VTHC_fdefog_flg "" UBYTE SWC_FDC_type_CM_boolean_flg 0 0 0.0 1.0 ECU_ADDRESS 0x0000 /* @ECU_Address@VTHC_fdefog_flg@ */ /end MEASUREMENT
/begin MEASUREMENT VVMC_APPSpdLimit_flg "" UBYTE SWC_FDC_type_CM_boolean_flg 0 0 0.0 1.0 ECU_ADDRESS 0x0000 /* @ECU_Address@VVMC_APPSpdLimit_flg@ */ /end MEASUREMENT
/begin MEASUREMENT VVMC_IMUEnaCmd_flg "" UBYTE SWC_FDC_type_CM_boolean_flg 0 0 0.0 1.0 ECU_ADDRESS 0x0000 /* @ECU_Address@VVMC_IMUEnaCmd_flg@ */ /end MEASUREMENT
/begin MEASUREMENT VVMC_VMCAEBCtrlAvail_flg "" UBYTE SWC_FDC_type_CM_boolean_flg 0 0 0.0 1.0 ECU_ADDRESS 0x0000 /* @ECU_Address@VVMC_VMCAEBCtrlAvail_flg@ */ /end MEASUREMENT
/begin MEASUREMENT VVMC_VMCACCCtrlAvail_flg "" UBYTE SWC_FDC_type_CM_boolean_flg 0 0 0.0 1.0 ECU_ADDRESS 0x0000 /* @ECU_Address@VVMC_VMCACCCtrlAvail_flg@ */ /end MEASUREMENT
/begin MEASUREMENT VVMC_VMCCCCtrlAvail_flg "" UBYTE SWC_FDC_type_CM_boolean_flg 0 0 0.0 1.0 ECU_ADDRESS 0x0000 /* @ECU_Address@VVMC_VMCCCCtrlAvail_flg@ */ /end MEASUREMENT
/begin MEASUREMENT VVMC_VMCMSACtrlAvail_flg "" UBYTE SWC_FDC_type_CM_boolean_flg 0 0 0.0 1.0 ECU_ADDRESS 0x0000 /* @ECU_Address@VVMC_VMCMSACtrlAvail_flg@ */ /end MEASUREMENT
/begin MEASUREMENT VVMC_SPD2ACCAct_flg "" UBYTE SWC_FDC_type_CM_boolean_flg 0 0 0.0 1.0 ECU_ADDRESS 0x0000 /* @ECU_Address@VVMC_SPD2ACCAct_flg@ */ /end MEASUREMENT
/begin MEASUREMENT VVMC_ACCVehHoldReqRaw_flg "" UBYTE SWC_FDC_type_CM_boolean_flg 0 0 0.0 1.0 ECU_ADDRESS 0x0000 /* @ECU_Address@VVMC_ACCVehHoldReqRaw_flg@ */ /end MEASUREMENT
/begin MEASUREMENT VVMC_LateralCtrl_flg "" UBYTE SWC_FDC_type_CM_boolean_flg 0 0 0.0 1.0 ECU_ADDRESS 0x0000 /* @ECU_Address@VVMC_LateralCtrl_flg@ */ /end MEASUREMENT
/begin MEASUREMENT VVMC_MSAActive_flg "" UBYTE SWC_FDC_type_CM_boolean_flg 0 0 0.0 1.0 ECU_ADDRESS 0x0000 /* @ECU_Address@VVMC_MSAActive_flg@ */ /end MEASUREMENT
/begin MEASUREMENT VVMC_MSASpdWar_flg "" UBYTE SWC_FDC_type_CM_boolean_flg 0 0 0.0 1.0 ECU_ADDRESS 0x0000 /* @ECU_Address@VVMC_MSASpdWar_flg@ */ /end MEASUREMENT
/begin MEASUREMENT VVMC_LFCAOIVehType_flg "" UBYTE SWC_FDC_type_CM_boolean_flg 0 0 0.0 1.0 ECU_ADDRESS 0x0000 /* @ECU_Address@VVMC_LFCAOIVehType_flg@ */ /end MEASUREMENT
/begin MEASUREMENT VVMC_FDCVMCAPSVRqEPSCtrl_flg "" UBYTE SWC_FDC_type_CM_boolean_flg 0 0 0.0 1.0 ECU_ADDRESS 0x0000 /* @ECU_Address@VVMC_FDCVMCAPSVRqEPSCtrl_flg@ */ /end MEASUREMENT
/begin MEASUREMENT VVMC_FDCVMCAPSRqEPSCtrl_flg "" UBYTE SWC_FDC_type_CM_boolean_flg 0 0 0.0 1.0 ECU_ADDRESS 0x0000 /* @ECU_Address@VVMC_FDCVMCAPSRqEPSCtrl_flg@ */ /end MEASUREMENT
/begin MEASUREMENT VVMC_FDCVMCDrInpTqBstAct_flg "" UBYTE SWC_FDC_type_CM_boolean_flg 0 0 0.0 1.0 ECU_ADDRESS 0x0000 /* @ECU_Address@VVMC_FDCVMCDrInpTqBstAct_flg@ */ /end MEASUREMENT
/begin MEASUREMENT VVMC_FCMLDWFault_flg "" UBYTE SWC_FDC_type_CM_boolean_flg 0 0 0.0 1.0 ECU_ADDRESS 0x0000 /* @ECU_Address@VVMC_FCMLDWFault_flg@ */ /end MEASUREMENT
/begin MEASUREMENT VTQD_BrkSwSta_flg "" UBYTE SWC_FDC_type_CM_boolean_flg 0 0 0.0 1.0 ECU_ADDRESS 0x0000 /* @ECU_Address@VTQD_BrkSwSta_flg@ */ /end MEASUREMENT
/begin MEASUREMENT VTQD_EPBCarWashMode_flg "" UBYTE SWC_FDC_type_CM_boolean_flg 0 0 0.0 1.0 ECU_ADDRESS 0x0000 /* @ECU_Address@VTQD_EPBCarWashMode_flg@ */ /end MEASUREMENT
/begin MEASUREMENT VTQD_IVIPwrLock_flg "" UBYTE SWC_FDC_type_CM_boolean_flg 0 0 0.0 1.0 ECU_ADDRESS 0x0000 /* @ECU_Address@VTQD_IVIPwrLock_flg@ */ /end MEASUREMENT
/begin MEASUREMENT VTQD_ParkRequest_flg "" UBYTE SWC_FDC_type_CM_boolean_flg 0 0 0.0 1.0 ECU_ADDRESS 0x0000 /* @ECU_Address@VTQD_ParkRequest_flg@ */ /end MEASUREMENT
/begin MEASUREMENT VTQD_LimpHomeAct_flg "" UBYTE SWC_FDC_type_CM_boolean_flg 0 0 0.0 1.0 ECU_ADDRESS 0x0000 /* @ECU_Address@VTQD_LimpHomeAct_flg@ */ /end MEASUREMENT
/begin MEASUREMENT VTQD_SWCRegenUpSta_flg "" UBYTE SWC_FDC_type_CM_boolean_flg 0 0 0.0 1.0 ECU_ADDRESS 0x0000 /* @ECU_Address@VTQD_SWCRegenUpSta_flg@ */ /end MEASUREMENT
/begin MEASUREMENT VTQD_SWCRegenDownSta_flg "" UBYTE SWC_FDC_type_CM_boolean_flg 0 0 0.0 1.0 ECU_ADDRESS 0x0000 /* @ECU_Address@VTQD_SWCRegenDownSta_flg@ */ /end MEASUREMENT
/begin MEASUREMENT VTQD_TrailerMode_flg "" UBYTE SWC_FDC_type_CM_boolean_flg 0 0 0.0 1.0 ECU_ADDRESS 0x0000 /* @ECU_Address@VTQD_TrailerMode_flg@ */ /end MEASUREMENT
/begin MEASUREMENT VTQD_BCMRgnUserEn_flg "" UBYTE SWC_FDC_type_CM_boolean_flg 0 0 0.0 1.0 ECU_ADDRESS 0x0000 /* @ECU_Address@VTQD_BCMRgnUserEn_flg@ */ /end MEASUREMENT
/begin MEASUREMENT VTQD_LowIdleAccPedal_flg "" UBYTE SWC_FDC_type_CM_boolean_flg 0 0 0.0 1.0 ECU_ADDRESS 0x0000 /* @ECU_Address@VTQD_LowIdleAccPedal_flg@ */ /end MEASUREMENT
/begin MEASUREMENT VTQD_RollRegenDisable_flg "" UBYTE SWC_FDC_type_CM_boolean_flg 0 0 0.0 1.0 ECU_ADDRESS 0x0000 /* @ECU_Address@VTQD_RollRegenDisable_flg@ */ /end MEASUREMENT
/begin MEASUREMENT VTQD_FrMCUDmDisSpd_flg "" UBYTE SWC_FDC_type_CM_boolean_flg 0 0 0.0 1.0 ECU_ADDRESS 0x0000 /* @ECU_Address@VTQD_FrMCUDmDisSpd_flg@ */ /end MEASUREMENT
/begin MEASUREMENT VTQD_FrADASRegMCUDmDis_flg "" UBYTE SWC_FDC_type_CM_boolean_flg 0 0 0.0 1.0 ECU_ADDRESS 0x0000 /* @ECU_Address@VTQD_FrADASRegMCUDmDis_flg@ */ /end MEASUREMENT
/begin MEASUREMENT VTQD_MCUDmpDisabReq_flg "" UBYTE SWC_FDC_type_CM_boolean_flg 0 0 0.0 1.0 ECU_ADDRESS 0x0000 /* @ECU_Address@VTQD_MCUDmpDisabReq_flg@ */ /end MEASUREMENT
/begin MEASUREMENT VTQD_FrActvDmpDisabReq_flg "" UBYTE SWC_FDC_type_CM_boolean_flg 0 0 0.0 1.0 ECU_ADDRESS 0x0000 /* @ECU_Address@VTQD_FrActvDmpDisabReq_flg@ */ /end MEASUREMENT
/begin MEASUREMENT VTQD_RrMCUDmDisSpd_flg "" UBYTE SWC_FDC_type_CM_boolean_flg 0 0 0.0 1.0 ECU_ADDRESS 0x0000 /* @ECU_Address@VTQD_RrMCUDmDisSpd_flg@ */ /end MEASUREMENT
/begin MEASUREMENT VTQD_RrADASRegMCUDmDis_flg "" UBYTE SWC_FDC_type_CM_boolean_flg 0 0 0.0 1.0 ECU_ADDRESS 0x0000 /* @ECU_Address@VTQD_RrADASRegMCUDmDis_flg@ */ /end MEASUREMENT
/begin MEASUREMENT VTQD_RrActvDmpDisabReq_flg "" UBYTE SWC_FDC_type_CM_boolean_flg 0 0 0.0 1.0 ECU_ADDRESS 0x0000 /* @ECU_Address@VTQD_RrActvDmpDisabReq_flg@ */ /end MEASUREMENT
/begin MEASUREMENT VTQD_MCUReady4Ext_flg "" UBYTE SWC_FDC_type_CM_boolean_flg 0 0 0.0 1.0 ECU_ADDRESS 0x0000 /* @ECU_Address@VTQD_MCUReady4Ext_flg@ */ /end MEASUREMENT
/begin MEASUREMENT VTQD_PwrStaTimerReady_flg "" UBYTE SWC_FDC_type_CM_boolean_flg 0 0 0.0 1.0 ECU_ADDRESS 0x0000 /* @ECU_Address@VTQD_PwrStaTimerReady_flg@ */ /end MEASUREMENT
/begin MEASUREMENT VTQD_CrashDetd_flg "" UBYTE SWC_FDC_type_CM_boolean_flg 0 0 0.0 1.0 ECU_ADDRESS 0x0000 /* @ECU_Address@VTQD_CrashDetd_flg@ */ /end MEASUREMENT
/begin MEASUREMENT VTQD_EquivAccPed_flg "" UBYTE SWC_FDC_type_CM_boolean_flg 0 0 0.0 1.0 ECU_ADDRESS 0x0000 /* @ECU_Address@VTQD_EquivAccPed_flg@ */ /end MEASUREMENT
/begin MEASUREMENT VTQD_EquivAccPedalSWSta_flg "" UBYTE SWC_FDC_type_CM_boolean_flg 0 0 0.0 1.0 ECU_ADDRESS 0x0000 /* @ECU_Address@VTQD_EquivAccPedalSWSta_flg@ */ /end MEASUREMENT
/begin MEASUREMENT VTQD_SpdCtrlSta_flg "" UBYTE SWC_FDC_type_CM_boolean_flg 0 0 0.0 1.0 ECU_ADDRESS 0x0000 /* @ECU_Address@VTQD_SpdCtrlSta_flg@ */ /end MEASUREMENT
/begin MEASUREMENT VTQD_RegenLimIndSta_flg "" UBYTE SWC_FDC_type_CM_boolean_flg 0 0 0.0 1.0 ECU_ADDRESS 0x0000 /* @ECU_Address@VTQD_RegenLimIndSta_flg@ */ /end MEASUREMENT
/begin MEASUREMENT VTQD_SetSpdLimWarn_flg "" UBYTE SWC_FDC_type_CM_boolean_flg 0 0 0.0 1.0 ECU_ADDRESS 0x0000 /* @ECU_Address@VTQD_SetSpdLimWarn_flg@ */ /end MEASUREMENT
/begin MEASUREMENT VTQD_TrailerDisOPDSta_flg "" UBYTE SWC_FDC_type_CM_boolean_flg 0 0 0.0 1.0 ECU_ADDRESS 0x0000 /* @ECU_Address@VTQD_TrailerDisOPDSta_flg@ */ /end MEASUREMENT
/begin MEASUREMENT VTQD_CCSpdResetFinish_flg "" UBYTE SWC_FDC_type_CM_boolean_flg 0 0 0.0 1.0 ECU_ADDRESS 0x0000 /* @ECU_Address@VTQD_CCSpdResetFinish_flg@ */ /end MEASUREMENT
/begin MEASUREMENT VTQD_AllowSetSpd_flg "" UBYTE SWC_FDC_type_CM_boolean_flg 0 0 0.0 1.0 ECU_ADDRESS 0x0000 /* @ECU_Address@VTQD_AllowSetSpd_flg@ */ /end MEASUREMENT
/begin MEASUREMENT VTQD_RgnChgReset_flg "" UBYTE SWC_FDC_type_CM_boolean_flg 0 0 0.0 1.0 ECU_ADDRESS 0x0000 /* @ECU_Address@VTQD_RgnChgReset_flg@ */ /end MEASUREMENT
/begin MEASUREMENT VTQD_CreepON_flg "" UBYTE SWC_FDC_type_CM_boolean_flg 0 0 0.0 1.0 ECU_ADDRESS 0x0000 /* @ECU_Address@VTQD_CreepON_flg@ */ /end MEASUREMENT
/begin MEASUREMENT VDHP_EAPS1BAD_flg "" UBYTE SWC_FDC_type_CM_boolean_flg 0 0 0.0 1.0 ECU_ADDRESS 0x0000 /* @ECU_Address@VDHP_EAPS1BAD_flg@ */ /end MEASUREMENT
/begin MEASUREMENT VDHP_EAPCRBAD_flg "" UBYTE SWC_FDC_type_CM_boolean_flg 0 0 0.0 1.0 ECU_ADDRESS 0x0000 /* @ECU_Address@VDHP_EAPCRBAD_flg@ */ /end MEASUREMENT
/begin MEASUREMENT VDHP_EAPS1LearnInRange_flg "" UBYTE SWC_FDC_type_CM_boolean_flg 0 0 0.0 1.0 ECU_ADDRESS 0x0000 /* @ECU_Address@VDHP_EAPS1LearnInRange_flg@ */ /end MEASUREMENT
/begin MEASUREMENT VDHP_EAPS1NRMStable_flg "" UBYTE SWC_FDC_type_CM_boolean_flg 0 0 0.0 1.0 ECU_ADDRESS 0x0000 /* @ECU_Address@VDHP_EAPS1NRMStable_flg@ */ /end MEASUREMENT
/begin MEASUREMENT VDHP_EAPS1LearnDwEnable_flg "" UBYTE SWC_FDC_type_CM_boolean_flg 0 0 0.0 1.0 ECU_ADDRESS 0x0000 /* @ECU_Address@VDHP_EAPS1LearnDwEnable_flg@ */ /end MEASUREMENT
/begin MEASUREMENT VDHP_EAPSLearnUpEnable_flg "" UBYTE SWC_FDC_type_CM_boolean_flg 0 0 0.0 1.0 ECU_ADDRESS 0x0000 /* @ECU_Address@VDHP_EAPSLearnUpEnable_flg@ */ /end MEASUREMENT
/begin MEASUREMENT VDHP_EAPS2BAD_flg "" UBYTE SWC_FDC_type_CM_boolean_flg 0 0 0.0 1.0 ECU_ADDRESS 0x0000 /* @ECU_Address@VDHP_EAPS2BAD_flg@ */ /end MEASUREMENT
/begin MEASUREMENT VDHP_EAPS2LearnInRange_flg "" UBYTE SWC_FDC_type_CM_boolean_flg 0 0 0.0 1.0 ECU_ADDRESS 0x0000 /* @ECU_Address@VDHP_EAPS2LearnInRange_flg@ */ /end MEASUREMENT
/begin MEASUREMENT VDHP_EAPS2NRMStable_flg "" UBYTE SWC_FDC_type_CM_boolean_flg 0 0 0.0 1.0 ECU_ADDRESS 0x0000 /* @ECU_Address@VDHP_EAPS2NRMStable_flg@ */ /end MEASUREMENT
/begin MEASUREMENT VDHP_EAPS2LearnDwEnable_flg "" UBYTE SWC_FDC_type_CM_boolean_flg 0 0 0.0 1.0 ECU_ADDRESS 0x0000 /* @ECU_Address@VDHP_EAPS2LearnDwEnable_flg@ */ /end MEASUREMENT
/begin MEASUREMENT VDHP_PedalIncreasing_flg "" UBYTE SWC_FDC_type_CM_boolean_flg 0 0 0.0 1.0 ECU_ADDRESS 0x0000 /* @ECU_Address@VDHP_PedalIncreasing_flg@ */ /end MEASUREMENT
/begin MEASUREMENT VDHP_LowIdleAccPedal_flg "" UBYTE SWC_FDC_type_CM_boolean_flg 0 0 0.0 1.0 ECU_ADDRESS 0x0000 /* @ECU_Address@VDHP_LowIdleAccPedal_flg@ */ /end MEASUREMENT
/begin MEASUREMENT VDHP_AccPedalSWSta_flg "" UBYTE SWC_FDC_type_CM_boolean_flg 0 0 0.0 1.0 ECU_ADDRESS 0x0000 /* @ECU_Address@VDHP_AccPedalSWSta_flg@ */ /end MEASUREMENT
/begin MEASUREMENT VBCM_WalkOutLkENFunSta_flg "" UBYTE SWC_FDC_type_CM_boolean_flg 0 0 0.0 1.0 ECU_ADDRESS 0x0000 /* @ECU_Address@VBCM_WalkOutLkENFunSta_flg@ */ /end MEASUREMENT
/begin MEASUREMENT VBCM_AutoLockSta_flg "" UBYTE SWC_FDC_type_CM_boolean_flg 0 0 0.0 1.0 ECU_ADDRESS 0x0000 /* @ECU_Address@VBCM_AutoLockSta_flg@ */ /end MEASUREMENT
/begin MEASUREMENT VBCM_AutoUnlockSta_flg "" UBYTE SWC_FDC_type_CM_boolean_flg 0 0 0.0 1.0 ECU_ADDRESS 0x0000 /* @ECU_Address@VBCM_AutoUnlockSta_flg@ */ /end MEASUREMENT
/begin MEASUREMENT VBCM_LRightStaCmd_flg "" UBYTE SWC_FDC_type_CM_boolean_flg 0 0 0.0 1.0 ECU_ADDRESS 0x0000 /* @ECU_Address@VBCM_LRightStaCmd_flg@ */ /end MEASUREMENT
/begin MEASUREMENT VBCM_LLeftStaCmd_flg "" UBYTE SWC_FDC_type_CM_boolean_flg 0 0 0.0 1.0 ECU_ADDRESS 0x0000 /* @ECU_Address@VBCM_LLeftStaCmd_flg@ */ /end MEASUREMENT
/begin MEASUREMENT VBCM_LRRDCtrlCmdReady_flg "" UBYTE SWC_FDC_type_CM_boolean_flg 0 0 0.0 1.0 ECU_ADDRESS 0x0000 /* @ECU_Address@VBCM_LRRDCtrlCmdReady_flg@ */ /end MEASUREMENT
/begin MEASUREMENT VBCM_LRLDCtrlCmdReady_flg "" UBYTE SWC_FDC_type_CM_boolean_flg 0 0 0.0 1.0 ECU_ADDRESS 0x0000 /* @ECU_Address@VBCM_LRLDCtrlCmdReady_flg@ */ /end MEASUREMENT
/begin MEASUREMENT VBCM_LPasCtrlCmdReady_flg "" UBYTE SWC_FDC_type_CM_boolean_flg 0 0 0.0 1.0 ECU_ADDRESS 0x0000 /* @ECU_Address@VBCM_LPasCtrlCmdReady_flg@ */ /end MEASUREMENT
/begin MEASUREMENT VBCM_LDrvCtrlCmdReady_flg "" UBYTE SWC_FDC_type_CM_boolean_flg 0 0 0.0 1.0 ECU_ADDRESS 0x0000 /* @ECU_Address@VBCM_LDrvCtrlCmdReady_flg@ */ /end MEASUREMENT
/begin MEASUREMENT VPMM_DetectDoorOpened_flg "" UBYTE SWC_FDC_type_CM_boolean_flg 0 0 0.0 1.0 ECU_ADDRESS 0x0000 /* @ECU_Address@VPMM_DetectDoorOpened_flg@ */ /end MEASUREMENT
/begin MEASUREMENT VPMM_BrkPedalRisingEdge_flg "" UBYTE SWC_FDC_type_CM_boolean_flg 0 0 0.0 1.0 ECU_ADDRESS 0x0000 /* @ECU_Address@VPMM_BrkPedalRisingEdge_flg@ */ /end MEASUREMENT
/begin MEASUREMENT VPMM_ADCStaChkFail_flg "" UBYTE SWC_FDC_type_CM_boolean_flg 0 0 0.0 1.0 ECU_ADDRESS 0x0000 /* @ECU_Address@VPMM_ADCStaChkFail_flg@ */ /end MEASUREMENT
/begin MEASUREMENT VPMM_AllDoorCloseRisingEdge_flg "" UBYTE SWC_FDC_type_CM_boolean_flg 0 0 0.0 1.0 ECU_ADDRESS 0x0000 /* @ECU_Address@VPMM_AllDoorCloseRisingEdge_flg@ */ /end MEASUREMENT
/begin MEASUREMENT VPMM_ChrgPlugOutFallingEdge_flg "" UBYTE SWC_FDC_type_CM_boolean_flg 0 0 0.0 1.0 ECU_ADDRESS 0x0000 /* @ECU_Address@VPMM_ChrgPlugOutFallingEdge_flg@ */ /end MEASUREMENT
/begin MEASUREMENT VPMM_SeatSWRisingEdge_flg "" UBYTE SWC_FDC_type_CM_boolean_flg 0 0 0.0 1.0 ECU_ADDRESS 0x0000 /* @ECU_Address@VPMM_SeatSWRisingEdge_flg@ */ /end MEASUREMENT
/begin MEASUREMENT VPMM_DetectHVPwrSta_flg "" UBYTE SWC_FDC_type_CM_boolean_flg 0 0 0.0 1.0 ECU_ADDRESS 0x0000 /* @ECU_Address@VPMM_DetectHVPwrSta_flg@ */ /end MEASUREMENT
/begin MEASUREMENT VPMM_ChrgPlugInRisingEdge_flg "" UBYTE SWC_FDC_type_CM_boolean_flg 0 0 0.0 1.0 ECU_ADDRESS 0x0000 /* @ECU_Address@VPMM_ChrgPlugInRisingEdge_flg@ */ /end MEASUREMENT
/begin MEASUREMENT VPMM_DetectIVIPwroffreq_flg "" UBYTE SWC_FDC_type_CM_boolean_flg 0 0 0.0 1.0 ECU_ADDRESS 0x0000 /* @ECU_Address@VPMM_DetectIVIPwroffreq_flg@ */ /end MEASUREMENT
/begin MEASUREMENT VPMM_DetectSchedChg_flg "" UBYTE SWC_FDC_type_CM_boolean_flg 0 0 0.0 1.0 ECU_ADDRESS 0x0000 /* @ECU_Address@VPMM_DetectSchedChg_flg@ */ /end MEASUREMENT
/begin MEASUREMENT VPMM_DetectPWCONTINUE_flg "" UBYTE SWC_FDC_type_CM_boolean_flg 0 0 0.0 1.0 ECU_ADDRESS 0x0000 /* @ECU_Address@VPMM_DetectPWCONTINUE_flg@ */ /end MEASUREMENT
/begin MEASUREMENT VPMM_DetectDoorClosed_flg "" UBYTE SWC_FDC_type_CM_boolean_flg 0 0 0.0 1.0 ECU_ADDRESS 0x0000 /* @ECU_Address@VPMM_DetectDoorClosed_flg@ */ /end MEASUREMENT
/begin MEASUREMENT VVMC_LongAccelCalcuByVehSpdRaw_gps "" FLOAT32_IEEE SWC_FDC_type_CM_single_gps 0 0 -20.0 20.0 ECU_ADDRESS 0x0000 /* @ECU_Address@VVMC_LongAccelCalcuByVehSpdRaw_gps@ */ /end MEASUREMENT
/begin MEASUREMENT VVMC_FrRrSlipSpd_kph "" FLOAT32_IEEE SWC_FDC_type_CM_single_kph 0 0 0.0 255.0 ECU_ADDRESS 0x0000 /* @ECU_Address@VVMC_FrRrSlipSpd_kph@ */ /end MEASUREMENT
/begin MEASUREMENT VVMC_MemVehPitchAngleEst_deg "" FLOAT32_IEEE SWC_FDC_type_CM_single_deg 0 0 -10.0 10.0 ECU_ADDRESS 0x0000 /* @ECU_Address@VVMC_MemVehPitchAngleEst_deg@ */ /end MEASUREMENT
/begin MEASUREMENT VVMC_VehPitchAngleEst_deg "" FLOAT32_IEEE SWC_FDC_type_CM_single_deg 0 0 -10.0 10.0 ECU_ADDRESS 0x0000 /* @ECU_Address@VVMC_VehPitchAngleEst_deg@ */ /end MEASUREMENT
/begin MEASUREMENT VVMC_VehPitchAngleSta_enum "" UBYTE SWC_FDC_type_CM_uint8_enum 0 0 0.0 6.0 ECU_ADDRESS 0x0000 /* @ECU_Address@VVMC_VehPitchAngleSta_enum@ */ /end MEASUREMENT
/begin MEASUREMENT VVMC_RollAveEn_flg "" UBYTE SWC_FDC_type_CM_boolean_flg 0 0 0.0 1.0 ECU_ADDRESS 0x0000 /* @ECU_Address@VVMC_RollAveEn_flg@ */ /end MEASUREMENT
/begin MEASUREMENT VVMC_SafetyCtrl_flg "" UBYTE SWC_FDC_type_CM_boolean_flg 0 0 0.0 1.0 ECU_ADDRESS 0x0000 /* @ECU_Address@VVMC_SafetyCtrl_flg@ */ /end MEASUREMENT
/begin MEASUREMENT VVMC_VehPitchAngleUpd_flg "" UBYTE SWC_FDC_type_CM_boolean_flg 0 0 0.0 1.0 ECU_ADDRESS 0x0000 /* @ECU_Address@VVMC_VehPitchAngleUpd_flg@ */ /end MEASUREMENT
/begin MEASUREMENT VDHP_EPEDLINDMem_pct "" FLOAT32_IEEE SWC_FDC_type_CM_single_pct 0 0 0.0 120.0 ECU_ADDRESS 0x0000 /* @ECU_Address@VDHP_EPEDLINDMem_pct@ */ /end MEASUREMENT
/begin MEASUREMENT VTQD_SaveCreepSW_flg "" UBYTE SWC_FDC_type_CM_boolean_flg 0 0 0.0 1.0 ECU_ADDRESS 0x0000 /* @ECU_Address@VTQD_SaveCreepSW_flg@ */ /end MEASUREMENT
/begin MEASUREMENT VDHP_Dec2IncMemoryReset_flg "" UBYTE SWC_FDC_type_CM_boolean_flg 0 0 0.0 1.0 ECU_ADDRESS 0x0000 /* @ECU_Address@VDHP_Dec2IncMemoryReset_flg@ */ /end MEASUREMENT
/begin MEASUREMENT VDHP_Dec2IncPctMemorize_flg "" UBYTE SWC_FDC_type_CM_boolean_flg 0 0 0.0 1.0 ECU_ADDRESS 0x0000 /* @ECU_Address@VDHP_Dec2IncPctMemorize_flg@ */ /end MEASUREMENT
/begin MEASUREMENT VDHP_Inc2DecMemoryReset_flg "" UBYTE SWC_FDC_type_CM_boolean_flg 0 0 0.0 1.0 ECU_ADDRESS 0x0000 /* @ECU_Address@VDHP_Inc2DecMemoryReset_flg@ */ /end MEASUREMENT
/begin MEASUREMENT VDHP_Inc2DecPctMemorize_flg "" UBYTE SWC_FDC_type_CM_boolean_flg 0 0 0.0 1.0 ECU_ADDRESS 0x0000 /* @ECU_Address@VDHP_Inc2DecPctMemorize_flg@ */ /end MEASUREMENT
/begin COMPU_METHOD SWC_FDC_type_CM_single_C "Q = V" RAT_FUNC "%8.6" "C" COEFFS 0 1 0 0 0 1 /end COMPU_METHOD
/begin COMPU_METHOD SWC_FDC_type_CM_uint8_enum "Q = V" RAT_FUNC "%3.0" "enum" COEFFS 0 1 0 0 0 1 /end COMPU_METHOD
/begin COMPU_METHOD SWC_FDC_type_CM_single_kph "Q = V" RAT_FUNC "%8.6" "kph" COEFFS 0 1 0 0 0 1 /end COMPU_METHOD
/begin COMPU_METHOD SWC_FDC_type_CM_single_Gps "Q = V" RAT_FUNC "%8.6" "Gps" COEFFS 0 1 0 0 0 1 /end COMPU_METHOD
/begin COMPU_METHOD SWC_FDC_type_CM_single_c "Q = V" RAT_FUNC "%8.6" "c" COEFFS 0 1 0 0 0 1 /end COMPU_METHOD
/begin COMPU_METHOD SWC_FDC_type_CM_single_deg "Q = V" RAT_FUNC "%8.6" "deg" COEFFS 0 1 0 0 0 1 /end COMPU_METHOD
/begin COMPU_METHOD SWC_FDC_type_CM_single_pct "Q = V" RAT_FUNC "%8.6" "pct" COEFFS 0 1 0 0 0 1 /end COMPU_METHOD
/begin COMPU_METHOD SWC_FDC_type_CM_single_s "Q = V" RAT_FUNC "%8.6" "s" COEFFS 0 1 0 0 0 1 /end COMPU_METHOD
/begin COMPU_METHOD SWC_FDC_type_CM_single_enum "Q = V" RAT_FUNC "%8.6" "enum" COEFFS 0 1 0 0 0 1 /end COMPU_METHOD
/begin COMPU_METHOD SWC_FDC_type_CM_single_Lv "Q = V" RAT_FUNC "%8.6" "Lv" COEFFS 0 1 0 0 0 1 /end COMPU_METHOD
/begin COMPU_METHOD SWC_FDC_type_CM_single_mV "Q = V" RAT_FUNC "%8.6" "mV" COEFFS 0 1 0 0 0 1 /end COMPU_METHOD
/begin COMPU_METHOD SWC_FDC_type_CM_single_A "Q = V" RAT_FUNC "%8.6" "A" COEFFS 0 1 0 0 0 1 /end COMPU_METHOD
/begin COMPU_METHOD SWC_FDC_type_CM_single_W "Q = V" RAT_FUNC "%8.6" "W" COEFFS 0 1 0 0 0 1 /end COMPU_METHOD
/begin COMPU_METHOD SWC_FDC_type_CM_single_Deg "Q = V" RAT_FUNC "%8.6" "Deg" COEFFS 0 1 0 0 0 1 /end COMPU_METHOD
/begin COMPU_METHOD SWC_FDC_type_CM_single_rpm "Q = V" RAT_FUNC "%8.6" "rpm" COEFFS 0 1 0 0 0 1 /end COMPU_METHOD
/begin COMPU_METHOD SWC_FDC_type_CM_single_Nm "Q = V" RAT_FUNC "%8.6" "Nm" COEFFS 0 1 0 0 0 1 /end COMPU_METHOD
/begin COMPU_METHOD SWC_FDC_type_CM_single_gain "Q = V" RAT_FUNC "%8.6" "gain" COEFFS 0 1 0 0 0 1 /end COMPU_METHOD
/begin COMPU_METHOD SWC_FDC_type_CM_single_gps "Q = V" RAT_FUNC "%8.6" "gps" COEFFS 0 1 0 0 0 1 /end COMPU_METHOD
/begin COMPU_METHOD SWC_FDC_type_CM_single_mps2 "Q = V" RAT_FUNC "%8.6" "mps2" COEFFS 0 1 0 0 0 1 /end COMPU_METHOD
/begin COMPU_METHOD SWC_FDC_type_CM_single_K "Q = V" RAT_FUNC "%8.6" "K" COEFFS 0 1 0 0 0 1 /end COMPU_METHOD
/begin COMPU_METHOD SWC_FDC_type_CM_single_V "Q = V" RAT_FUNC "%8.6" "V" COEFFS 0 1 0 0 0 1 /end COMPU_METHOD
/begin COMPU_METHOD SWC_FDC_type_CM_single_cm "Q = V" RAT_FUNC "%8.6" "cm" COEFFS 0 1 0 0 0 1 /end COMPU_METHOD
/begin COMPU_METHOD SWC_FDC_type_CM_single_sec "Q = V" RAT_FUNC "%8.6" "sec" COEFFS 0 1 0 0 0 1 /end COMPU_METHOD
/begin COMPU_METHOD SWC_FDC_type_CM_single_kPa "Q = V" RAT_FUNC "%8.6" "kPa" COEFFS 0 1 0 0 0 1 /end COMPU_METHOD
/begin COMPU_METHOD SWC_FDC_type_CM_single_flg "Q = V" RAT_FUNC "%8.6" "flg" COEFFS 0 1 0 0 0 1 /end COMPU_METHOD
/begin COMPU_METHOD SWC_FDC_type_CM_single_raw32 "Q = V" RAT_FUNC "%8.6" "raw32" COEFFS 0 1 0 0 0 1 /end COMPU_METHOD
/begin COMPU_METHOD SWC_FDC_type_CM_uint16_cnt "Q = V" RAT_FUNC "%5.0" "cnt" COEFFS 0 1 0 0 0 1 /end COMPU_METHOD
/begin COMPU_METHOD SWC_FDC_type_CM_uint16_sec "Q = V" RAT_FUNC "%5.0" "sec" COEFFS 0 1 0 0 0 1 /end COMPU_METHOD
/begin COMPU_METHOD SWC_FDC_type_CM_uint16_W "Q = V" RAT_FUNC "%5.0" "W" COEFFS 0 1 0 0 0 1 /end COMPU_METHOD
/begin COMPU_METHOD SWC_FDC_type_CM_uint16_rpm "Q = V" RAT_FUNC "%5.0" "rpm" COEFFS 0 1 0 0 0 1 /end COMPU_METHOD
/begin COMPU_METHOD SWC_FDC_type_CM_uint16_K "Q = V" RAT_FUNC "%5.0" "K" COEFFS 0 1 0 0 0 1 /end COMPU_METHOD
/begin COMPU_METHOD SWC_FDC_type_CM_uint16_Mohm "Q = V" RAT_FUNC "%5.0" "Mohm" COEFFS 0 1 0 0 0 1 /end COMPU_METHOD
/begin COMPU_METHOD SWC_FDC_type_CM_boolean_flg "Q = V" RAT_FUNC "%1.0" "flg" COEFFS 0 1 0 0 0 1 /end COMPU_METHOD
/begin COMPU_METHOD SWC_FDC_type_CM_uint8_cnt "Q = V" RAT_FUNC "%3.0" "cnt" COEFFS 0 1 0 0 0 1 /end COMPU_METHOD
/begin COMPU_METHOD SWC_FDC_type_CM_uint8_sec "Q = V" RAT_FUNC "%3.0" "sec" COEFFS 0 1 0 0 0 1 /end COMPU_METHOD
/begin COMPU_METHOD SWC_FDC_type_CM_uint8_K "Q = V" RAT_FUNC "%3.0" "K" COEFFS 0 1 0 0 0 1 /end COMPU_METHOD
/begin COMPU_METHOD SWC_FDC_type_CM_uint8_pct "Q = V" RAT_FUNC "%3.0" "pct" COEFFS 0 1 0 0 0 1 /end COMPU_METHOD
/begin COMPU_METHOD SWC_FDC_type_CM_uint8_kph "Q = V" RAT_FUNC "%3.0" "kph" COEFFS 0 1 0 0 0 1 /end COMPU_METHOD
/begin COMPU_METHOD SWC_FDC_type_CM_uint32_raw32 "Q = V" RAT_FUNC "%10.0" "raw32" COEFFS 0 1 0 0 0 1 /end COMPU_METHOD
/begin COMPU_METHOD SWC_FDC_type_CM_single_mph "Q = V" RAT_FUNC "%8.6" "mph" COEFFS 0 1 0 0 0 1 /end COMPU_METHOD
/begin GROUP S646_THCM_Conctrl "SWC_FDC_type/run_SWC_FDC_RxTx_5ms_sys/APP/THC/ThermalControl/THCM_Conctrl"
 /begin SUB_GROUP S648_AGSandFan S648_APTC S648_BlowerCtrl S648_CompCtrl S648_EWP1 S648_EWP2 S648_EWP3 S648_EXV1Ctrl S648_EXV2Ctrl S648_RadiatorFan S648_SensorErrorHandle1 S648_SensorErrorHandle10 S648_SensorErrorHandle11 S648_SensorErrorHandle12 S648_SensorErrorHandle2 S648_SensorErrorHandle3 S648_SensorErrorHandle4 S648_SensorErrorHandle5 S648_SensorErrorHandle6 S648_SensorErrorHandle7 S648_SensorErrorHandle8 S648_SensorErrorHandle9 S648_Subsystem S648_Subsystem1 S648_Subsystem2 S648_Subsystem3 S648_WPTC /end SUB_GROUP
 /begin REF_CHARACTERISTIC KTHC_APTCQMaxC_W KTHC_APTCQminD_W KTHC_APTCQminRe1_W KTHC_APTCQminRe_W KTHC_BatCoolT_cnt KTHC_BatInTempDef_C KTHC_CompMaxDeice_rpm KTHC_CompMinDeice_rpm KTHC_CompSotxvOpLow_rpm KTHC_CompSotxvOp_K KTHC_CompSpdmaxBC1_rpm KTHC_CompSpdmaxBC_rpm KTHC_CompSpdmax_rpm KTHC_CompSpdmid1_rpm KTHC_CompSpdmid2_rpm KTHC_CompSpdmid3_rpm KTHC_CompSpdmid_rpm KTHC_CompSpdmin_rpm KTHC_DTCabin11_C KTHC_DTambSat1_C KTHC_DTambSat2_C KTHC_DTambSat5_C KTHC_DTambSat_C KTHC_DTambsat3_C KTHC_DTambsat4_C KTHC_DTcabin10_C KTHC_DTcabin12_C KTHC_DTcabin1_C KTHC_DTcabin2_C KTHC_DTcabin3_C KTHC_DTcabin4_C KTHC_DTcabin5_C KTHC_DTcabin6_C KTHC_DTcabin7_C KTHC_DTcabin9_C KTHC_DTcabin_C KTHC_DTh1_C KTHC_DTimeCD1_K KTHC_DTimeCD2_K KTHC_DTimeCD_K KTHC_DTreturn1_C KTHC_DTreturn2_C KTHC_DTreturn3_C KTHC_DTreturn6_C KTHC_DTreturn7_C KTHC_DTreturn_C KTHC_DTwBBin_C KTHC_DTwBMoin1_C KTHC_DTwBMoin2_C KTHC_DTwBMoin3_C KTHC_DehumidityEN_flg KTHC_DeiceCycTime_K KTHC_DriveLevelWPTCBAH1_W KTHC_DriveLevelWPTCBAH2_W KTHC_DriveLevelWPTCBAH3_W KTHC_DriveLevelWPTCBAH4_W KTHC_DriveT1MinBAH_C KTHC_DriveT2MaxBAH_C KTHC_DriveT2MinBAH_C KTHC_DriveT3MaxBAH_C KTHC_DriveT3MinBAH_C KTHC_DriveT4MaxBAH_C KTHC_ECOTambLV1_C KTHC_ECOTambLV2_C KTHC_ECOTambLV3_C KTHC_ECOTambLV4_C KTHC_ECOTambLV5_C KTHC_ECOTambLV6_C KTHC_ECOTambLV7_C KTHC_ECOTambLV8_C KTHC_ECOTambLVT_sec KTHC_ECOalpha1_K KTHC_ECOalpha2_K KTHC_ECOalpha3_K KTHC_ECOalpha4_K KTHC_ECOalpha5_K KTHC_ECOalpha6_K KTHC_ECOalpha7_K KTHC_ECOalpha8_K KTHC_ECOalpha9_K KTHC_ECObeta1_K KTHC_ECObeta2_K KTHC_ECObeta3_K KTHC_ECObeta4_K KTHC_ECObeta5_K KTHC_ECObeta6_K KTHC_ECObeta7_K KTHC_ECObeta8_K KTHC_ECObeta9_K KTHC_EWPBalanceSW_flg KTHC_EXV1SHSetpoint_K KTHC_EXV2SHSetpoint_K KTHC_ErrHandleEN_flg KTHC_ForceLeaveCool_C KTHC_ForceLeaveHeat_C KTHC_HVBIsoImpedenceLV_Mohm KTHC_HeatingFactor_C KTHC_LevelWPTCBAH1_W KTHC_LevelWPTCBAH2_W KTHC_LevelWPTCBAH3_W KTHC_LevelWPTCBAH4_W KTHC_MotorOutTempDef_C KTHC_P2MaxHi_kPa KTHC_P2MinLo_kPa KTHC_P3MaxHi_kPa KTHC_P3MaxLo_kPa KTHC_P3MinHi_kPa KTHC_P3MinLo_kPa KTHC_P4MaxHi_kPa KTHC_P4MaxLo_kPa KTHC_P4MinHi_kPa KTHC_P4MinLo_kPa KTHC_P5MaxLo_kPa KTHC_P5MinHi_kPa KTHC_PDeiceMax_kPa KTHC_PhiDehum_kPa KTHC_Plow2Setpoint_kPa KTHC_SolarDebounceT_sec KTHC_SolarDef_W KTHC_SotxvProHi_kPa KTHC_SotxvProLo_kPa KTHC_T1MaxBC_C KTHC_T1MaxCCU_C KTHC_T1MaxLLC_C KTHC_T1MaxMCU_C KTHC_T1MaxMT_C KTHC_T1MinBAH_C KTHC_T1MinBH_C KTHC_T2MaxBAH_C KTHC_T2MaxBC_C KTHC_T2MaxBH_C KTHC_T2MaxCCU_C KTHC_T2MaxLLC_C KTHC_T2MaxMCU_C KTHC_T2MaxMT_C KTHC_T2MinBAH_C KTHC_T2MinBC_C KTHC_T2MinBH_C KTHC_T2MinCCU_C KTHC_T2MinLLC_C KTHC_T2MinMCU_C KTHC_T2MinMT_C KTHC_T3MaxBAH_C KTHC_T3MaxBC_C KTHC_T3MaxBH_C KTHC_T3MaxCCU_C KTHC_T3MaxLLC_C KTHC_T3MaxMCU_C KTHC_T3MaxMT_C KTHC_T3MinBAH_C KTHC_T3MinBC_C KTHC_T3MinBH_C KTHC_T3MinCCU_C KTHC_T3MinLLC_C KTHC_T3MinMCU_C KTHC_T3MinMT_C KTHC_T3winSetpointBC_C KTHC_T4MaxBAH_C KTHC_T4MaxBC_C KTHC_T4MaxBH_C KTHC_T4MaxCCU_C KTHC_T4MaxLLC_C KTHC_T4MaxMCU_C KTHC_T4MaxMT_C KTHC_T4MinBC_C KTHC_T4MinBH_C KTHC_T4MinCCU_C KTHC_T4MinLLC_C KTHC_T4MinMCU_C KTHC_T4MinMT_C KTHC_T5MaxBH_C KTHC_T5MinBC_C KTHC_T5MinCCU_C KTHC_T5MinLLC_C KTHC_T5MinMCU_C KTHC_T5MinMT_C KTHC_TBPmax_C KTHC_TBPmin_C KTHC_TDcChgBC_C KTHC_TDeice1_C KTHC_TDeice2_C KTHC_TWVRcolPos_pct KTHC_TWinmax_C KTHC_TWinmin_C KTHC_TambACmode1_C KTHC_TambACmode2_C KTHC_TambACmode3_C KTHC_TambACmode4_C KTHC_TambACmode5_C KTHC_TambACmode6_C KTHC_TambACmode7_C KTHC_TambDef_C KTHC_TambHPmin_C KTHC_TambSetLow_C KTHC_Tambset_C KTHC_Tcoolmin_C KTHC_Tdefog_C KTHC_Tdeheat1_C KTHC_Tdeheat2_C KTHC_Tdeice_C KTHC_TductDef_C KTHC_Tevap_C KTHC_ThiDehum_C KTHC_Tice_C KTHC_Time0_K KTHC_TimeD_K KTHC_TimeDeiceMax_K KTHC_TimeRe1_sec KTHC_TimeRe2_sec KTHC_Timehu1_K KTHC_Timehu2_K KTHC_Timewcd_K KTHC_TwOhtOff_C KTHC_TwOhtOn_C KTHC_TwRcolOff_C KTHC_TwRcolOn_C KTHC_Twmset_C KTHC_VehSdAGS100_kph KTHC_VehSdAGSCtrl_kph KTHC_VehSdFanOff_kph KTHC_VehSdFanOn_kph KTHC_WPTCDef_W KTHC_WoWPTC_flg KTHC_aDeice_K KTHC_bDeice_K KTHC_ta_K KTHC_tb_K MTHC_dAy_Y_C /end REF_CHARACTERISTIC
/end GROUP
/begin GROUP S1040_ModelVersion "SWC_FDC_type/run_SWC_FDC_RxTx_5ms_sys/APP/TPM/TPMS/ModelVersion" /begin SUB_GROUP S1041_Subsystem /end SUB_GROUP /begin REF_CHARACTERISTIC KTPM_TPMSModelVersion_raw /end REF_CHARACTERISTIC /end GROUP
/begin GROUP S1040_TPMS "SWC_FDC_type/run_SWC_FDC_RxTx_5ms_sys/APP/TPM/TPMS/TPMS"
 /begin SUB_GROUP S1042_GetFlashWheelTemp S1042_Learn S1042_Send S1042_Subsystem /end SUB_GROUP
 /begin REF_CHARACTERISTIC KTPM_DiagLearn_flg KTPM_WhlRotDir_enum_ovrdflg KTPM_WhlRotDir_enum_ovrdval /end REF_CHARACTERISTIC
 /begin REF_MEASUREMENT VTPM_ChkStorge_flg VTPM_IDin_raw32 VTPM_TPMSResButt_flg VTPM_TPMSSensorIDRegStart_flg VTPM_TPMSStorge_flg /end REF_MEASUREMENT
/end GROUP
/begin GROUP S1274_CrashDetect "SWC_FDC_type/run_SWC_FDC_RxTx_5ms_sys/APP/TQD/TorqueDemand/CrashDetect" /begin SUB_GROUP S1275_SR_Latch /end SUB_GROUP
 /begin REF_CHARACTERISTIC KTQD_190MS_cnt KTQD_210MS_cnt KTQD_30MS_cnt KTQD_50MS_cnt KTQD_CrashPWMCnt_cnt KTQD_DiagHCrashTimer_s KTQD_NoDiagHCrashTimer_s KTQD_PwrStaTimerforCrash_s /end REF_CHARACTERISTIC
 /begin REF_MEASUREMENT VTQD_CrashDetd_flg VTQD_PwrStaTimerReady_flg VTQD_fCrash_cnt /end REF_MEASUREMENT
/end GROUP
/begin GROUP S1274_ShiftModule "SWC_FDC_type/run_SWC_FDC_RxTx_5ms_sys/APP/TQD/TorqueDemand/ShiftModule"
 /begin SUB_GROUP S1276_GearShiftPosn S1276_P_Button_State_Judge S1276_SR_Latch S1276_SR_Latch1 /end SUB_GROUP
 /begin REF_CHARACTERISTIC KTQD_PBWTimeout_s KTQD_RelockWaitTime_s KTQD_ReunlockWaitTime_s KTQD_ShiftInitialTime_s KTQD_VehSpd2P_kph KTQD_VehSpdRev_kph /end REF_CHARACTERISTIC
 /begin REF_MEASUREMENT VTQD_GearActualPosn_enum VTQD_ParkRequest_flg /end REF_MEASUREMENT
/end GROUP
/begin GROUP S1274_Signal_convert "SWC_FDC_type/run_SWC_FDC_RxTx_5ms_sys/APP/TQD/TorqueDemand/Signal_convert"
 /begin SUB_GROUP S1277_New_Wheel_Slide_Rate S1277_OUTPUT_ONLY_ON_or_READY S1277_Regen_Level_Switch_Botton S1277_SR_Latch S1277_SR_Latch8 S1277_SWC2_Subsystem S1277_SWC_Subsystem S1277_Simulation_Sound_Wave_ S1277_VehWeightEst S1277_Wheel_Status_Judgment /end SUB_GROUP
 /begin REF_CHARACTERISTIC KTQD_ACCReqCMdBond_mps2 KTQD_ADASLowIdleWhlTq_Nm KTQD_AbsoluteMotorSpdDir_flg KTQD_ActvDmpDisabAPSPosn_pct KTQD_ActvDmpDisabVehSpd_kph KTQD_CreepSW_flg_ovrdflg KTQD_CreepSW_flg_ovrdval KTQD_DefaultRegenMode_enum KTQD_DriveModeReq_enum_ovrdflg KTQD_DriveModeReq_enum_ovrdval KTQD_EquivAccPedBaseTq_Nm KTQD_EquivAccPedDis_pct KTQD_EquivAccPedEn_pct KTQD_EquivAccPedLowLim_pct KTQD_EquivAccPedUpLim_pct KTQD_EquivAccPedalDelay_s KTQD_EquivAccPedalDisSpd_kph KTQD_FrDmpDisabReq_flg_ovrdflg KTQD_FrDmpDisabReq_flg_ovrdval KTQD_FrMCUDmDisSpd_kph KTQD_FrMCUDmEnSpd_kph KTQD_FrTMTotalGearRatio_gain KTQD_LimpHomeAct_flg_ovrdflg KTQD_LimpHomeAct_flg_ovrdval KTQD_LowIdle_flg_ovrdflg KTQD_LowIdle_flg_ovrdval KTQD_MCUDmEnAccCMD_mps2 KTQD_MCUDmEnFrBrkTq_Nm KTQD_MCUDmEnRrBrkTq_Nm KTQD_RegenLimHVTempMax_C KTQD_RegenLimHVTempMin_C KTQD_RegenLimIndSOC_pct KTQD_RegenModeMemo_flg KTQD_RegenMode_enum_ovrdflg KTQD_RegenMode_enum_ovrdval KTQD_RgnLimIndStaDelay_s KTQD_RgnModeChgResetAPSDev_pct KTQD_RgnModeChgResetSW_flg KTQD_RgnModeChgSW_flg KTQD_RrDmpDisabReq_flg_ovrdflg KTQD_RrDmpDisabReq_flg_ovrdval KTQD_RrMCUDmDisSpd_kph KTQD_RrMCUDmEnSpd_kph KTQD_RrTMTotalGearRatio_gain KTQD_TrailerModeSW_flg_ovrdflg KTQD_TrailerModeSW_flg_ovrdval /end REF_CHARACTERISTIC
 /begin REF_MEASUREMENT VTQD_ACCSetSpd_kph VTQD_ActAPSPosn_pct VTQD_ActBPSPosn_pct VTQD_ActRgnUserSet_enum VTQD_AllowSetSpd_flg VTQD_BCMRgnUserEn_flg VTQD_BrkSwSta_flg VTQD_CCSetSpd_kph VTQD_CCSpdResetFinish_flg VTQD_CreepON_flg VTQD_EPBCarWashMode_flg VTQD_EVDriveMode_enum VTQD_EquivAccPed_flg VTQD_EquivAccPed_pct VTQD_EquivAccPedalSWSta_flg VTQD_FDCVCURegenMode_enum VTQD_FrADASRegMCUDmDis_flg VTQD_FrActvDmpDisabReq_flg VTQD_FrMCUDmDisSpd_flg VTQD_ISASetSpd_kph VTQD_IVIPwrLockSta_enum VTQD_IVIPwrLock_flg VTQD_LimpHomeAct_flg VTQD_LowIdleAccPedal_flg VTQD_MCUDmpDisabReq_flg VTQD_MCUReady4Ext_flg VTQD_MSASetSpd_kph VTQD_RDCActive_enum VTQD_ReadRegenMode_enum VTQD_RegenLimIndSta_flg VTQD_RegenMode_enum VTQD_RgnChgReset_flg VTQD_RgnModeChgAPSPosn_pct VTQD_RollRegenDisable_flg VTQD_RrADASRegMCUDmDis_flg VTQD_RrActvDmpDisabReq_flg VTQD_RrMCUDmDisSpd_flg VTQD_SWCRegenDownSta_flg VTQD_SWCRegenUpSta_flg VTQD_SaveCreepSW_flg VTQD_SaveRegenMode_enum VTQD_SetSpdLimWarn_flg VTQD_SetSpd_kph VTQD_ShiftGearPosn_enum VTQD_SpdCtrlMode_enum VTQD_SpdCtrlSta_flg VTQD_TMRotateDirction_enum VTQD_TqTargetShaftSpd_rpm VTQD_TrailerDisOPDSta_flg VTQD_TrailerMode_flg /end REF_MEASUREMENT
/end GROUP
/begin GROUP S1274_TorqueModule "SWC_FDC_type/run_SWC_FDC_RxTx_5ms_sys/APP/TQD/TorqueDemand/TorqueModule"
 /begin SUB_GROUP S1278_AvaliableTqLimit S1278_DriverWhlTqDem S1278_ExtTqFuncHandShaking S1278_OPD_Hold S1278_Signal_for_ESC S1278_Signals_for_BCM S1278_Signals_for_MCU S1278_TqCoordination S1278_TqDistribution /end SUB_GROUP
/end GROUP
/begin GROUP S1643_TorqueArbitrament "SWC_FDC_type/run_SWC_FDC_RxTx_5ms_sys/APP/TQR/Determine Torque Request/TorqueArbitrament"
 /begin SUB_GROUP S1644_InverseAndTurnToMotorToq S1644_RampEnableJudge S1644_TorqueSmooth /end SUB_GROUP
/end GROUP
/begin GROUP S1910_ACC_Function "SWC_FDC_type/run_SWC_FDC_RxTx_5ms_sys/APP/VMC/VMC/ACC_Function"
 /begin SUB_GROUP S1911_ACC_Control_Allow_Judgement S1911_ACC_Torque_Source_Determination S1911_Hand_Shaking S1911_VVMC_ADASWhlTqCalVehHoldStandstill_Nm /end SUB_GROUP
/end GROUP
/begin GROUP S1910_APS_function "SWC_FDC_type/run_SWC_FDC_RxTx_5ms_sys/APP/VMC/VMC/APS function"
 /begin SUB_GROUP S1912_CAAS_HandShake S1912_Command_Determination1 S1912_Hand_Shake S1912_Signal_Rounting1 S1912_Subsystem /end SUB_GROUP
/end GROUP
/begin GROUP S1910_CruiseControlFunction "SWC_FDC_type/run_SWC_FDC_RxTx_5ms_sys/APP/VMC/VMC/CruiseControlFunction"
 /begin SUB_GROUP S1913_CCActiveDetermination S1913_CCDemandTorqueCalculation S1913_CCTorqueSourceDetermination /end SUB_GROUP
/end GROUP
/begin GROUP S1910_EPSForceSelect "SWC_FDC_type/run_SWC_FDC_RxTx_5ms_sys/APP/VMC/VMC/EPSForceSelect" /begin REF_CHARACTERISTIC MVMC_EPSForceSelectD21_Z_enum MVMC_EPSForceSelect_Z_enum /end REF_CHARACTERISTIC /begin REF_MEASUREMENT VVMC_DMSModeCmd_enum /end REF_MEASUREMENT /end GROUP
/begin GROUP S1910_FeatureSetSpeed "SWC_FDC_type/run_SWC_FDC_RxTx_5ms_sys/APP/VMC/VMC/FeatureSetSpeed"
 /begin REF_CHARACTERISTIC KVMC_APPSpdLimit_flg_ovrdflg KVMC_APPSpdLimit_flg_ovrdval KVMC_APPSpdLimit_ovrdflg KVMC_APPSpdLimit_ovrdval /end REF_CHARACTERISTIC
 /begin REF_MEASUREMENT VVMC_APPSpdLimit_flg VVMC_APPSpdLimit_kph VVMC_FeatSetSpdFinal_raw32 VVMC_FeatSetSpdForCalcu_kph /end REF_MEASUREMENT
/end GROUP
/begin GROUP S1910_IMU "SWC_FDC_type/run_SWC_FDC_RxTx_5ms_sys/APP/VMC/VMC/IMU"
 /begin SUB_GROUP S1916_IMU_memorized_offset_result S1916_IMU_sensing_result_ /end SUB_GROUP
 /begin REF_CHARACTERISTIC KVMC_IMUEnaCmd_flg /end REF_CHARACTERISTIC
 /begin REF_MEASUREMENT VVMC_IMUEnaCmd_flg /end REF_MEASUREMENT
/end GROUP
/begin GROUP S1910_LFCAOIControl "SWC_FDC_type/run_SWC_FDC_RxTx_5ms_sys/APP/VMC/VMC/LFCAOIControl"
 /begin REF_CHARACTERISTIC KVMC_ADASAngCtrlTqWtGnLowerLim_pct KVMC_ADASAngCtrlTqWtGnUpperLim_pct /end REF_CHARACTERISTIC
 /begin REF_MEASUREMENT VVMC_FDCVMCAPSAngleTarget_deg VVMC_FDCVMCAPSRqEPSCtrl_flg VVMC_FDCVMCAPSVRqEPSCtrl_flg VVMC_FDCVMCAngCtrlTqWtGn_pct VVMC_FDCVMCDrInpTqBstAct_flg VVMC_FDCVMCDrInpTqBstGn_pct VVMC_FDCVMCMaxAngCtrlOutTqLim_Nm VVMC_LFCAOIVehType_flg /end REF_MEASUREMENT
/end GROUP
/begin GROUP S1910_Long_Acceleration_Calculation "SWC_FDC_type/run_SWC_FDC_RxTx_5ms_sys/APP/VMC/VMC/Long Acceleration Calculation"
 /begin SUB_GROUP S1918_Degrees_to_Radians1 S1918_FirstOrderFilter S1918_FirstOrderFilter8 S1918_Vehicle_to_Meter_Speed /end SUB_GROUP
 /begin REF_CHARACTERISTIC KVMC_AccBWFilterCutOffFreq_raw32 KVMC_DIDGetDynoModeSW_flg KVMC_GradeInvalidValue_deg KVMC_GradeSourceSW_flg KVMC_LongAccSource_enum KVMC_LongAccelSWSpd_kph KVMC_Veh2MetSpdHiBand_kph KVMC_Veh2MetSpdLowBand_kph MVMC_ACCLongSteadyCtrl_Y_kph MVMC_CCLongSteadyCtrl_Y_kph MVMC_LongAccDeadZone_Y_Gps MVMC_LongAccFiltTsforP2_Y_c MVMC_MSALongSteadyCtrl_Y_kph /end REF_CHARACTERISTIC
 /begin REF_MEASUREMENT VVMC_ACCLongSteadyCtrl_kph VVMC_CCLongSteadyCtrl_kph VVMC_CalMeterSpeed_kph VVMC_EstSlope_Deg VVMC_LongAccCal1_Gps VVMC_LongAccDeadZone_Gps VVMC_LongAccFiltTsforP2_c VVMC_MSALongSteadyCtrl_kph VVMC_SINEGRADE_Gps /end REF_MEASUREMENT
/end GROUP
/begin GROUP S1910_MSA_function "SWC_FDC_type/run_SWC_FDC_RxTx_5ms_sys/APP/VMC/VMC/MSA function"
 /begin SUB_GROUP S1919_Anti_Speed_Limitation S1919_MSAActivationHandshake S1919_MSADemandTorqueCalculation S1919_MSATorqueSourceDetermination /end SUB_GROUP
 /begin REF_CHARACTERISTIC KVMC_CCMSASpdWar_kph /end REF_CHARACTERISTIC
 /begin REF_MEASUREMENT VVMC_ExtraMSACtrlSta_enum VVMC_MSAActive_flg VVMC_MSACtrlSta_enum VVMC_MSASpdWar_flg /end REF_MEASUREMENT
/end GROUP
/begin GROUP S1910_PreConditionCheck "SWC_FDC_type/run_SWC_FDC_RxTx_5ms_sys/APP/VMC/VMC/PreConditionCheck" /begin REF_CHARACTERISTIC KVMC_APSSWC_flg KVMC_PreCheckAllowTime_s /end REF_CHARACTERISTIC
 /begin REF_MEASUREMENT VVMC_VMCACCCtrlAvail_flg VVMC_VMCAEBCtrlAvail_flg VVMC_VMCCCCtrlAvail_flg VVMC_VMCMSACtrlAvail_flg /end REF_MEASUREMENT
/end GROUP
/begin GROUP S1910_RDC_Determination "SWC_FDC_type/run_SWC_FDC_RxTx_5ms_sys/APP/VMC/VMC/RDC Determination" /begin SUB_GROUP S1921_RWD /end SUB_GROUP /end GROUP
/begin GROUP S1910_SPD2ACC "SWC_FDC_type/run_SWC_FDC_RxTx_5ms_sys/APP/VMC/VMC/SPD2ACC" /begin SUB_GROUP S1922_ISO22179 S1922_PID S1922_VVMC_DISReqAcc_mps2 /end SUB_GROUP /begin REF_MEASUREMENT VVMC_SPD2ACCAct_flg /end REF_MEASUREMENT /end GROUP
/begin GROUP S1910_SafetyControl "SWC_FDC_type/run_SWC_FDC_RxTx_5ms_sys/APP/VMC/VMC/SafetyControl"
 /begin SUB_GROUP S1923_Estimate_Slope S1923_FirstOrderFilter S1923_FirstOrderFilter1 S1923_FirstOrderFilter2 S1923_FirstOrderFilter3 S1923_FirstOrderFilter4 S1923_FirstOrderFilter6 S1923_FirstOrderFilter7 S1923_LatAccRollingAverage S1923_SR_Latch4 S1923_SafetyControlJudgement S1923_VehSpdRollingAverage S1923_WheelSpeedRollingAverage /end SUB_GROUP
 /begin REF_CHARACTERISTIC KVMC_AccBWFilterCutOffFreq_raw32 KVMC_CalEstPitchAngleTs_raw32 KVMC_EstSlopeGxSource_flg KVMC_IMUGxFilter4ADB_raw32 KVMC_RollAveEnTime_s KVMC_SafetyCtrlSWC_flg KVMC_SpdBWFilterCutOffFreq_raw32 KVMC_VehPitchAngleMax_deg KVMC_VehPitchAngleMin_deg KVMC_VehSpdBWFilter_raw32 KVMC_VehStandstillSpd_kph KVMC_VehStandstillTimer_s MVMC_VehPitchAngleSta_Z_enum /end REF_CHARACTERISTIC
 /begin REF_MEASUREMENT VVMC_FrRrSlipSpd_kph VVMC_LongAccelCalcuByVehSpdRaw_gps VVMC_MemVehPitchAngleEst_deg VVMC_RollAveEn_flg VVMC_SafetyCtrl_flg VVMC_VehPitchAngleEst_deg VVMC_VehPitchAngleSta_enum VVMC_VehPitchAngleUpd_flg /end REF_MEASUREMENT
/end GROUP
/begin GROUP S1910_Slide_Rate__Calculation "SWC_FDC_type/run_SWC_FDC_RxTx_5ms_sys/APP/VMC/VMC/Slide Rate  Calculation"
 /begin SUB_GROUP S1925_4Wheel_Calculation S1925_Alternative_Wheel_Slide_Calculation S1925_Coordination S1925_Partial_Wheel_Calculation /end SUB_GROUP
/end GROUP
/begin GROUP S1910_SpeedArbitration "SWC_FDC_type/run_SWC_FDC_RxTx_5ms_sys/APP/VMC/VMC/SpeedArbitration" /begin SUB_GROUP S1926_Response_Gain /end SUB_GROUP
 /begin REF_CHARACTERISTIC KVMC_AutoTurnJerkHiGain_pct KVMC_AutoTurnLimitHiGain_pct KVMC_DISCDecCtrlTest_flg KVMC_ExternalCtrlAGSV_flg KVMC_ExternalCtrlSW_flg KVMC_ExternalCtrlSta_enum KVMC_ExternalSpeedTarget_kph /end REF_CHARACTERISTIC
 /begin REF_MEASUREMENT VVMC_FeatArbitrSta_enum VVMC_FeatReqSpd_kph VVMC_FeatStaConfirm_enum VVMC_JerkPCT_pct VVMC_LimitPCT_pct /end REF_MEASUREMENT
/end GROUP
/begin GROUP S1910_SpeedCalculation "SWC_FDC_type/run_SWC_FDC_RxTx_5ms_sys/APP/VMC/VMC/SpeedCalculation" /begin SUB_GROUP S1927_FirstOrderFilter6 /end SUB_GROUP
 /begin REF_CHARACTERISTIC KVMC_MeterSpdBWFilter_raw32 KVMC_MeterSpdRollAveLevel_enum KVMC_MeterSpdRoundSW_flg KVMC_Veh2MeterSpdFactor_enum KVMC_Veh2MeterSpdLoBdy_kph KVMC_Veh2MeterSpdLoFactor_enum KVMC_Veh2MeterSpdOffset_enum /end REF_CHARACTERISTIC
 /begin REF_MEASUREMENT VVMC_MeterIndSpeedForCalcu_kph VVMC_MeterIndSpeed_raw32 VVMC_VehicleSpeed_kph VVMC_VehicleSpeed_mph /end REF_MEASUREMENT
/end GROUP
/begin GROUP S1910_VMC_FCM1 "SWC_FDC_type/run_SWC_FDC_RxTx_5ms_sys/APP/VMC/VMC/VMC_FCM1"
 /begin SUB_GROUP S1928_SR_Latch3 S1928_SR_Latch4 S1928_SR_Latch5 S1928_SR_Latch6 /end SUB_GROUP
 /begin REF_CHARACTERISTIC KVMC_LDWReqExecute2Time_s KVMC_LDWReqExecuteTime_s KVMC_LDWReqRest2Time_s KVMC_LDWReqRestTime_s /end REF_CHARACTERISTIC
 /begin REF_MEASUREMENT VVMC_ACCVehHoldReqRaw_flg VVMC_ADASACCSta_enum VVMC_ADASLFCHandsOffWarning_enum VVMC_ADASLFCSta_enum VVMC_ADASLFCWarnSound_enum VVMC_FCMLDWFault_flg VVMC_FCMLDWRequest_enum VVMC_LKAStrToqReq_Nm VVMC_LKATOIAct_enum VVMC_LateralCtrl_flg /end REF_MEASUREMENT
/end GROUP
/begin GROUP S29_DoorAPM "SWC_FDC_type/run_SWC_FDC_RxTx_5ms_sys/APP/BCM/BCM/APM_Door/DoorAPM" /begin REF_MEASUREMENT VBCM_LDrvCtrlCmdReady_flg VBCM_LDrvCtrlCmd_pct /end REF_MEASUREMENT /end GROUP
/begin GROUP S29_DoorAPM1 "SWC_FDC_type/run_SWC_FDC_RxTx_5ms_sys/APP/BCM/BCM/APM_Door/DoorAPM1" /begin REF_MEASUREMENT VBCM_LPasCtrlCmdReady_flg VBCM_LPasCtrlCmd_pct /end REF_MEASUREMENT /end GROUP
/begin GROUP S29_DoorAPM2 "SWC_FDC_type/run_SWC_FDC_RxTx_5ms_sys/APP/BCM/BCM/APM_Door/DoorAPM2" /begin REF_MEASUREMENT VBCM_LRLDCtrlCmdReady_flg VBCM_LRLDCtrlCmd_pct /end REF_MEASUREMENT /end GROUP
/begin GROUP S29_DoorAPM3 "SWC_FDC_type/run_SWC_FDC_RxTx_5ms_sys/APP/BCM/BCM/APM_Door/DoorAPM3" /begin REF_MEASUREMENT VBCM_LRRDCtrlCmdReady_flg VBCM_LRRDCtrlCmd_pct /end REF_MEASUREMENT /end GROUP
/begin GROUP S31_Antitheft__override "SWC_FDC_type/run_SWC_FDC_RxTx_5ms_sys/APP/BCM/BCM/AntiTheft/Antitheft__override" /begin REF_CHARACTERISTIC KBCM_Antitheft_enum_ovrdflg KBCM_Antitheft_enum_ovrdval /end REF_CHARACTERISTIC /begin REF_MEASUREMENT VBCM_AntitheftSta_enum /end REF_MEASUREMENT /end GROUP
/begin GROUP S41_Key1 "SWC_FDC_type/run_SWC_FDC_RxTx_5ms_sys/APP/BCM/BCM/HMI_Custom_Button/Key1" /begin REF_MEASUREMENT VBCM_HMIKey1FuncSta_enum /end REF_MEASUREMENT /end GROUP
/begin GROUP S41_Key2 "SWC_FDC_type/run_SWC_FDC_RxTx_5ms_sys/APP/BCM/BCM/HMI_Custom_Button/Key2" /begin REF_MEASUREMENT VBCM_HMIKey2FuncSta_enum /end REF_MEASUREMENT /end GROUP
/begin GROUP S41_Key3 "SWC_FDC_type/run_SWC_FDC_RxTx_5ms_sys/APP/BCM/BCM/HMI_Custom_Button/Key3" /begin REF_MEASUREMENT VBCM_HMIKey3FuncSta_enum /end REF_MEASUREMENT /end GROUP
/begin GROUP S41_Key4 "SWC_FDC_type/run_SWC_FDC_RxTx_5ms_sys/APP/BCM/BCM/HMI_Custom_Button/Key4" /begin REF_MEASUREMENT VBCM_HMIKey4FuncSta_enum /end REF_MEASUREMENT /end GROUP
/begin GROUP S41_Key5 "SWC_FDC_type/run_SWC_FDC_RxTx_5ms_sys/APP/BCM/BCM/HMI_Custom_Button/Key5" /begin REF_MEASUREMENT VBCM_HMIKey5FuncSta_enum /end REF_MEASUREMENT /end GROUP
/begin GROUP S41_Key6 "SWC_FDC_type/run_SWC_FDC_RxTx_5ms_sys/APP/BCM/BCM/HMI_Custom_Button/Key6" /begin REF_MEASUREMENT VBCM_HMIKey6FuncSta_enum /end REF_MEASUREMENT /end GROUP
/begin GROUP S41_Key7 "SWC_FDC_type/run_SWC_FDC_RxTx_5ms_sys/APP/BCM/BCM/HMI_Custom_Button/Key7" /begin REF_MEASUREMENT VBCM_HMIKey7FuncSta_enum /end REF_MEASUREMENT /end GROUP
/begin GROUP S41_Key8 "SWC_FDC_type/run_SWC_FDC_RxTx_5ms_sys/APP/BCM/BCM/HMI_Custom_Button/Key8" /begin REF_MEASUREMENT VBCM_HMIKey8FuncSta_enum /end REF_MEASUREMENT /end GROUP
/begin GROUP S43_KeyDetected "SWC_FDC_type/run_SWC_FDC_RxTx_5ms_sys/APP/BCM/BCM/PTG/KeyDetected" /begin SUB_GROUP S134_CheckSignalAvailable /end SUB_GROUP
 /begin REF_CHARACTERISTIC KBCM_SPTGLeftBoundOut_cm KBCM_SPTGLeftBound_cm KBCM_SPTGLowerBoundOut_cm KBCM_SPTGRightBoundOut_cm KBCM_SPTGRightBound_cm KBCM_SPTGUpperBoundOut_cm KBCM_SPTGUpperBound_cm KBCM_USSDis_cm /end REF_CHARACTERISTIC
/end GROUP
/begin GROUP S43_Subsystem1 "SWC_FDC_type/run_SWC_FDC_RxTx_5ms_sys/APP/BCM/BCM/PTG/Subsystem1" /begin REF_CHARACTERISTIC KBCM_SPTGTOut_K /end REF_CHARACTERISTIC /end GROUP
/begin GROUP S43_Subsystem3 "SWC_FDC_type/run_SWC_FDC_RxTx_5ms_sys/APP/BCM/BCM/PTG/Subsystem3" /begin REF_CHARACTERISTIC KBCM_SPTGTOut_K /end REF_CHARACTERISTIC /end GROUP
/begin GROUP S44_ACC "SWC_FDC_type/run_SWC_FDC_RxTx_5ms_sys/APP/BCM/BCM/Personal_Setting/ACC" /begin SUB_GROUP S152_VALUE_TYPE_ACC /end SUB_GROUP /begin REF_CHARACTERISTIC KBCM_ACCSwcPrsTmr_s KBCM_WaitACCChange_s /end REF_CHARACTERISTIC
 /begin REF_MEASUREMENT VBCM_LLeftStaCmd_flg VBCM_LRightStaCmd_flg VBCM_TimeGapLevelSta_enum /end REF_MEASUREMENT
/end GROUP
/begin GROUP S44_AmbLight "SWC_FDC_type/run_SWC_FDC_RxTx_5ms_sys/APP/BCM/BCM/Personal_Setting/AmbLight"
 /begin SUB_GROUP S153_TOGGLE_TYPE_AmbDimEN S153_TOGGLE_TYPE_AmbFunEN S153_TOGGLE_TYPE_AmbLinkDriSta S153_TOGGLE_TYPE_AmbODAEN S153_TOGGLE_TYPE_AmbPwrWarnEN S153_TOGGLE_TYPE_AmbWelEN S153_VALUE_TYPE_AmbBrightnessSta S153_VALUE_TYPE_AmbColorSta /end SUB_GROUP
/end GROUP
/begin GROUP S44_Autolock "SWC_FDC_type/run_SWC_FDC_RxTx_5ms_sys/APP/BCM/BCM/Personal_Setting/Autolock" /begin SUB_GROUP S154_TOGGLE_TYPE_AutoUnlock /end SUB_GROUP /begin REF_MEASUREMENT VBCM_AutoLockSta_flg VBCM_AutoUnlockSta_flg /end REF_MEASUREMENT /end GROUP
/begin GROUP S44_DKC_Lock_Setting "SWC_FDC_type/run_SWC_FDC_RxTx_5ms_sys/APP/BCM/BCM/Personal_Setting/DKC_Lock_Setting" /begin SUB_GROUP S155_TOGGLE_TYPE_WalkInUnlock S155_TOGGLE_TYPE_WalkOutLock /end SUB_GROUP /begin REF_MEASUREMENT VBCM_WalkOutLkENFunSta_flg /end REF_MEASUREMENT /end GROUP
/begin GROUP S44_FlasherSignal "SWC_FDC_type/run_SWC_FDC_RxTx_5ms_sys/APP/BCM/BCM/Personal_Setting/FlasherSignal" /begin SUB_GROUP S156_VALUE_TYPE_FlasherSignal /end SUB_GROUP /end GROUP
/begin GROUP S44_FollowMeHome "SWC_FDC_type/run_SWC_FDC_RxTx_5ms_sys/APP/BCM/BCM/Personal_Setting/FollowMeHome" /begin SUB_GROUP S157_LockSetting /end SUB_GROUP /end GROUP
/begin GROUP S44_LockSetting "SWC_FDC_type/run_SWC_FDC_RxTx_5ms_sys/APP/BCM/BCM/Personal_Setting/LockSetting" /begin SUB_GROUP S158_LockSetting /end SUB_GROUP /end GROUP
/begin GROUP S44_PTG "SWC_FDC_type/run_SWC_FDC_RxTx_5ms_sys/APP/BCM/BCM/Personal_Setting/PTG"
 /begin SUB_GROUP S159_VALUE_TYPE_FlasherSignal S159_VALUE_TYPE_PTGUserSetMaxHeight /end SUB_GROUP
/end GROUP
/begin GROUP S44_RoomLamp "SWC_FDC_type/run_SWC_FDC_RxTx_5ms_sys/APP/BCM/BCM/Personal_Setting/RoomLamp" /begin SUB_GROUP S160_TOGGLE_TYPE_RoomLampMode /end SUB_GROUP /end GROUP
/begin GROUP S44_SPTG "SWC_FDC_type/run_SWC_FDC_RxTx_5ms_sys/APP/BCM/BCM/Personal_Setting/SPTG" /begin SUB_GROUP S161_TOGGLE_TYPE_AmbFunEN /end SUB_GROUP /end GROUP
/begin GROUP S51_RLS_Command_Cut_Filter "SWC_FDC_type/run_SWC_FDC_RxTx_5ms_sys/APP/BCM/BCM/WasherWiper/RLS_Command_Cut_Filter" /begin REF_CHARACTERISTIC KBCM_RLSLowSpdFilterT_s /end REF_CHARACTERISTIC /end GROUP
/begin GROUP S52_Driver_Window "SWC_FDC_type/run_SWC_FDC_RxTx_5ms_sys/APP/BCM/BCM/Window_Control_Sig_Combine/Driver_Window" /begin REF_MEASUREMENT VBCM_DrvWdwCtrlCmd_pct VBCM_DrvWdwReqAP_enum /end REF_MEASUREMENT /end GROUP
/begin GROUP S52_Passenger_Window "SWC_FDC_type/run_SWC_FDC_RxTx_5ms_sys/APP/BCM/BCM/Window_Control_Sig_Combine/Passenger_Window" /begin REF_MEASUREMENT VBCM_PasWdwCtrlCmd_pct VBCM_PasWdwReqAP_enum /end REF_MEASUREMENT /end GROUP
/begin GROUP S317_Calculation "SWC_FDC_type/run_SWC_FDC_RxTx_5ms_sys/APP/DHP/DHP/APS_calaulation/Calculation"
 /begin REF_CHARACTERISTIC KDHP_AccPedalDepressed_pct KDHP_AccPedalReleased_pct KDHP_AcceleratorLoadScalr_gain KDHP_ActAPSPosn_pct_ovrdflg KDHP_ActAPSPosn_pct_ovrdval KDHP_DeadBand_pct KDHP_EAPS11OutWT_gain KDHP_EAPS12OutWT_gain KDHP_EAPS1AOutWT_gain KDHP_EAPS1WT_gain KDHP_EAPS21OutWT_gain KDHP_EAPS22OutWT_gain KDHP_EAPS2AOutWT_gain KDHP_EAPS2WT_gain KDHP_EAPSCRBadWDSP_pct KDHP_EPEDPOSNUpLimit_pct MDHP_HysOffset_Y_pct /end REF_CHARACTERISTIC
 /begin REF_MEASUREMENT VDHP_AccPedalSWSta_flg VDHP_ActAPSPosn_pct VDHP_Dec2IncMemoryReset_flg VDHP_Dec2IncPctMemorize_flg VDHP_EAPS1DIS_pct VDHP_EAPS2DIS_pct VDHP_EAPSWDSP_pct VDHP_EPEDLINDMem_pct VDHP_EPEDLIND_pct VDHP_HysOffset_pct VDHP_Inc2DecMemoryReset_flg VDHP_Inc2DecPctMemorize_flg VDHP_LowIdleAccPedal_flg VDHP_PedalIncreasing_flg /end REF_MEASUREMENT
/end GROUP
/begin GROUP S317_StateJudge "SWC_FDC_type/run_SWC_FDC_RxTx_5ms_sys/APP/DHP/DHP/APS_calaulation/StateJudge"
 /begin REF_CHARACTERISTIC KDHP_EAPS12DisagreeTime_s KDHP_EAPS12Disagree_pct KDHP_EAPS1BADHigh_pct KDHP_EAPS1BADLow_pct KDHP_EAPS1BADTime_s KDHP_EAPS2BADHigh_pct KDHP_EAPS2BADLow_pct KDHP_EAPS2BADTime_s KDHP_EAPS2Offset_pct KDHP_EAPS2Scaler_gain /end REF_CHARACTERISTIC
 /begin REF_MEASUREMENT VDHP_EAPCRBAD_flg VDHP_EAPS12RangeSta_enum VDHP_EAPS1BAD_flg VDHP_EAPS1NRM_pct VDHP_EAPS2BAD_flg VDHP_EAPS2NRM_pct /end REF_MEASUREMENT
/end GROUP
/begin GROUP S317_ZPLearn "SWC_FDC_type/run_SWC_FDC_RxTx_5ms_sys/APP/DHP/DHP/APS_calaulation/ZPLearn" /begin SUB_GROUP S321_Latch1 S321_Latch2 /end SUB_GROUP
 /begin REF_CHARACTERISTIC KDHP_EAPS1MINInitLowLim_pct KDHP_EAPS1MINInitUpLim_pct KDHP_EAPS1Min_pct_ovrdflg KDHP_EAPS1Min_pct_ovrdval KDHP_EAPS2MINInitLowLim_pct KDHP_EAPS2MINInitUpLim_pct KDHP_EAPS2Min_pct_ovrdflg KDHP_EAPS2Min_pct_ovrdval KDHP_EAPSLearnDwHigh_pct KDHP_EAPSLearnDwLow_pct KDHP_EAPSLearnDwMAX_pct KDHP_EAPSLearnUpHigh_pct KDHP_EAPSLearnUpLow_pct KDHP_EAPSLearnUpOffset_pct KDHP_EAPSMINLowerLimit_pct KDHP_EAPSStableThrsh_pct KDHP_EAPSStableTime_s KDHP_GetNRMBaseTime_s KDHP_LVBattHighLimit_V KDHP_LVBattHigh_V KDHP_LVBattLow_V /end REF_CHARACTERISTIC
 /begin REF_MEASUREMENT VDHP_EAPS1LearnDwEnable_flg VDHP_EAPS1LearnInRange_flg VDHP_EAPS1MINInit_pct VDHP_EAPS1MIN_pct VDHP_EAPS1NRMDiff_pct VDHP_EAPS1NRMStable_flg VDHP_EAPS2LearnDwEnable_flg VDHP_EAPS2LearnInRange_flg VDHP_EAPS2MINInit_pct VDHP_EAPS2MIN_pct VDHP_EAPS2NRMDiff_pct VDHP_EAPS2NRMStable_flg VDHP_EAPSLearnUpEnable_flg /end REF_MEASUREMENT
/end GROUP
/begin GROUP S339_SR_Latch11 "SWC_FDC_type/run_SWC_FDC_RxTx_5ms_sys/APP/DKC/Subsystem/DKC_Handler/SR_Latch11" /begin REF_MEASUREMENT VDKC_PressSW2Latch_flg /end REF_MEASUREMENT /end GROUP
/begin GROUP S339_SR_Latch12 "SWC_FDC_type/run_SWC_FDC_RxTx_5ms_sys/APP/DKC/Subsystem/DKC_Handler/SR_Latch12" /begin REF_MEASUREMENT VDKC_RemTGCmdFaillEdgeLatch_flg /end REF_MEASUREMENT /end GROUP
/begin GROUP S339_SR_Latch13 "SWC_FDC_type/run_SWC_FDC_RxTx_5ms_sys/APP/DKC/Subsystem/DKC_Handler/SR_Latch13" /begin REF_MEASUREMENT VDKC_UWBDetChgWelcomeLatch_flg /end REF_MEASUREMENT /end GROUP
/begin GROUP S339_SR_Latch14 "SWC_FDC_type/run_SWC_FDC_RxTx_5ms_sys/APP/DKC/Subsystem/DKC_Handler/SR_Latch14" /begin REF_MEASUREMENT VDKC_LidADetGreenCardLatch4s_flg /end REF_MEASUREMENT /end GROUP
/begin GROUP S339_SR_Latch17 "SWC_FDC_type/run_SWC_FDC_RxTx_5ms_sys/APP/DKC/Subsystem/DKC_Handler/SR_Latch17" /begin REF_MEASUREMENT VDKC_BTDisconDebLatch_flg /end REF_MEASUREMENT /end GROUP
/begin GROUP S339_SR_Latch18 "SWC_FDC_type/run_SWC_FDC_RxTx_5ms_sys/APP/DKC/Subsystem/DKC_Handler/SR_Latch18" /begin REF_MEASUREMENT VDKC_OnReadyKeyMissLatch_flg /end REF_MEASUREMENT /end GROUP
/begin GROUP S339_SR_Latch19 "SWC_FDC_type/run_SWC_FDC_RxTx_5ms_sys/APP/DKC/Subsystem/DKC_Handler/SR_Latch19" /begin REF_MEASUREMENT VDKC_DrDoorOpenStaLatch4s_flg /end REF_MEASUREMENT /end GROUP
/begin GROUP S339_SR_Latch20 "SWC_FDC_type/run_SWC_FDC_RxTx_5ms_sys/APP/DKC/Subsystem/DKC_Handler/SR_Latch20" /begin REF_MEASUREMENT VDKC_JudgeKeepUnlockZone_flg /end REF_MEASUREMENT /end GROUP
/begin GROUP S339_SR_Latch22 "SWC_FDC_type/run_SWC_FDC_RxTx_5ms_sys/APP/DKC/Subsystem/DKC_Handler/SR_Latch22" /begin REF_MEASUREMENT VDKC_WaitUserReqTrgT_flg /end REF_MEASUREMENT /end GROUP
/begin GROUP S339_SR_Latch23 "SWC_FDC_type/run_SWC_FDC_RxTx_5ms_sys/APP/DKC/Subsystem/DKC_Handler/SR_Latch23" /begin REF_MEASUREMENT VDKC_WaitAPMReqEnTrgT_flg /end REF_MEASUREMENT /end GROUP
/begin GROUP S339_SR_Latch24 "SWC_FDC_type/run_SWC_FDC_RxTx_5ms_sys/APP/DKC/Subsystem/DKC_Handler/SR_Latch24" /begin REF_MEASUREMENT VDKC_UIDForWPressLacth_flg /end REF_MEASUREMENT /end GROUP
/begin GROUP S339_SR_Latch25 "SWC_FDC_type/run_SWC_FDC_RxTx_5ms_sys/APP/DKC/Subsystem/DKC_Handler/SR_Latch25" /begin REF_MEASUREMENT VDKC_UIDBackWPressLacth_flg /end REF_MEASUREMENT /end GROUP
/begin GROUP S339_SR_Latch8 "SWC_FDC_type/run_SWC_FDC_RxTx_5ms_sys/APP/DKC/Subsystem/DKC_Handler/SR_Latch8" /begin REF_MEASUREMENT VDKC_PressSW1Latch_flg /end REF_MEASUREMENT /end GROUP
/begin GROUP S514_Subsystem "SWC_FDC_type/run_SWC_FDC_RxTx_5ms_sys/APP/DSC/Subsystem/Subsystem_ComtrolSpd/Subsystem" /begin REF_MEASUREMENT VDSC_TurnLimitSpeed_kph /end REF_MEASUREMENT /end GROUP
/begin GROUP S514_Subsystem_LowSpdControl "SWC_FDC_type/run_SWC_FDC_RxTx_5ms_sys/APP/DSC/Subsystem/Subsystem_ComtrolSpd/Subsystem_LowSpdControl" /begin REF_MEASUREMENT VDSC_LowSpd_kph /end REF_MEASUREMENT /end GROUP
/begin GROUP S514_Subsystem_TurningControl "SWC_FDC_type/run_SWC_FDC_RxTx_5ms_sys/APP/DSC/Subsystem/Subsystem_ComtrolSpd/Subsystem_TurningControl"
 /begin REF_CHARACTERISTIC KDSC_TurnAngControlpoint1_deg KDSC_TurnAngControlpoint1_kph KDSC_TurnAngControlpoint2_deg KDSC_TurnAngControlpoint2_kph /end REF_CHARACTERISTIC
 /begin REF_MEASUREMENT VDSC_TurningSpd_kph /end REF_MEASUREMENT
/end GROUP
/begin GROUP S516_lowpass "SWC_FDC_type/run_SWC_FDC_RxTx_5ms_sys/APP/DSC/Subsystem/Subsystem_EstimateSlope/lowpass" /begin REF_CHARACTERISTIC KDSC_FirstOrderInpTs_s KDSC_SamplingTime_s /end REF_CHARACTERISTIC /end GROUP
/begin GROUP S516_lowpass1 "SWC_FDC_type/run_SWC_FDC_RxTx_5ms_sys/APP/DSC/Subsystem/Subsystem_EstimateSlope/lowpass1" /begin REF_CHARACTERISTIC KDSC_FirstOrderInpTs_s KDSC_SamplingTime_s /end REF_CHARACTERISTIC /end GROUP
/begin GROUP S516_lowpass2 "SWC_FDC_type/run_SWC_FDC_RxTx_5ms_sys/APP/DSC/Subsystem/Subsystem_EstimateSlope/lowpass2" /begin REF_CHARACTERISTIC KDSC_FirstOrderInpTs_s KDSC_SamplingTime_s /end REF_CHARACTERISTIC /begin REF_MEASUREMENT VDSC_DISCEstSlope_deg /end REF_MEASUREMENT /end GROUP
/begin GROUP S560_Hold "SWC_FDC_type/run_SWC_FDC_RxTx_5ms_sys/APP/PMM/PMM/PMMDataConvert/Hold" /begin REF_MEASUREMENT VPMM_DetectDoorOpened_flg /end REF_MEASUREMENT /end GROUP
/begin GROUP S560_Hold1 "SWC_FDC_type/run_SWC_FDC_RxTx_5ms_sys/APP/PMM/PMM/PMMDataConvert/Hold1" /begin REF_MEASUREMENT VPMM_DetectDoorClosed_flg /end REF_MEASUREMENT /end GROUP
/begin GROUP S560_Hold10 "SWC_FDC_type/run_SWC_FDC_RxTx_5ms_sys/APP/PMM/PMM/PMMDataConvert/Hold10" /begin REF_MEASUREMENT VPMM_DetectHVPwrSta_flg /end REF_MEASUREMENT /end GROUP
/begin GROUP S560_Hold2 "SWC_FDC_type/run_SWC_FDC_RxTx_5ms_sys/APP/PMM/PMM/PMMDataConvert/Hold2" /begin REF_MEASUREMENT VPMM_AllDoorCloseRisingEdge_flg /end REF_MEASUREMENT /end GROUP
/begin GROUP S560_Hold3 "SWC_FDC_type/run_SWC_FDC_RxTx_5ms_sys/APP/PMM/PMM/PMMDataConvert/Hold3" /begin REF_MEASUREMENT VPMM_BrkPedalRisingEdge_flg /end REF_MEASUREMENT /end GROUP
/begin GROUP S560_Hold4 "SWC_FDC_type/run_SWC_FDC_RxTx_5ms_sys/APP/PMM/PMM/PMMDataConvert/Hold4" /begin REF_MEASUREMENT VPMM_SeatSWRisingEdge_flg /end REF_MEASUREMENT /end GROUP
/begin GROUP S560_Hold5 "SWC_FDC_type/run_SWC_FDC_RxTx_5ms_sys/APP/PMM/PMM/PMMDataConvert/Hold5" /begin REF_MEASUREMENT VPMM_ChrgPlugOutFallingEdge_flg /end REF_MEASUREMENT /end GROUP
/begin GROUP S560_Hold6 "SWC_FDC_type/run_SWC_FDC_RxTx_5ms_sys/APP/PMM/PMM/PMMDataConvert/Hold6" /begin REF_MEASUREMENT VPMM_ChrgPlugInRisingEdge_flg /end REF_MEASUREMENT /end GROUP
/begin GROUP S560_Hold7 "SWC_FDC_type/run_SWC_FDC_RxTx_5ms_sys/APP/PMM/PMM/PMMDataConvert/Hold7" /begin REF_MEASUREMENT VPMM_DetectIVIPwroffreq_flg /end REF_MEASUREMENT /end GROUP
/begin GROUP S560_Hold8 "SWC_FDC_type/run_SWC_FDC_RxTx_5ms_sys/APP/PMM/PMM/PMMDataConvert/Hold8" /begin REF_MEASUREMENT VPMM_DetectSchedChg_flg /end REF_MEASUREMENT /end GROUP
/begin GROUP S560_Hold9 "SWC_FDC_type/run_SWC_FDC_RxTx_5ms_sys/APP/PMM/PMM/PMMDataConvert/Hold9" /begin REF_MEASUREMENT VPMM_DetectPWCONTINUE_flg /end REF_MEASUREMENT /end GROUP
/begin GROUP S560_SR_Latch "SWC_FDC_type/run_SWC_FDC_RxTx_5ms_sys/APP/PMM/PMM/PMMDataConvert/SR_Latch" /begin REF_MEASUREMENT VPMM_ADCStaChkFail_flg /end REF_MEASUREMENT /end GROUP
/begin GROUP S561_OFF_PMM_Allow_ECU_Sleep_Judge_LVBattChkTimeCal "SWC_FDC_type/run_SWC_FDC_RxTx_5ms_sys/APP/PMM/PMM/PMM_State_Machine/OFF.PMM_Allow_ECU_Sleep_Judge.LVBattChkTimeCal" /begin REF_CHARACTERISTIC MPMM_LVBattChktime_Y_s /end REF_CHARACTERISTIC /end GROUP
/begin GROUP S561_OFF_Silent_Charge_Judge_SilentChrgLvCal "SWC_FDC_type/run_SWC_FDC_RxTx_5ms_sys/APP/PMM/PMM/PMM_State_Machine/OFF.Silent_Charge_Judge.SilentChrgLvCal" /begin REF_CHARACTERISTIC MPMM_LVChrgLv_Y_Lv /end REF_CHARACTERISTIC /begin REF_MEASUREMENT VPMM_LVChrgLvOut_enum /end REF_MEASUREMENT /end GROUP
/begin GROUP S561_OFF_C_CoolgFanActCurrCal "SWC_FDC_type/run_SWC_FDC_RxTx_5ms_sys/APP/PMM/PMM/PMM_State_Machine/OFF_C.CoolgFanActCurrCal" /begin REF_CHARACTERISTIC MPMM_CoolgFanActCurr_Y_A /end REF_CHARACTERISTIC /begin REF_MEASUREMENT VPMM_CoolgFanActCurrOut_A /end REF_MEASUREMENT /end GROUP
/begin GROUP S561_OFF_C_EWP1CurrCal "SWC_FDC_type/run_SWC_FDC_RxTx_5ms_sys/APP/PMM/PMM/PMM_State_Machine/OFF_C.EWP1CurrCal" /begin REF_CHARACTERISTIC MPMM_EWP1Curr_Y_A /end REF_CHARACTERISTIC /begin REF_MEASUREMENT VPMM_EWP1CurrOut_A /end REF_MEASUREMENT /end GROUP
/begin GROUP S561_OFF_C_EWP3CurrCal "SWC_FDC_type/run_SWC_FDC_RxTx_5ms_sys/APP/PMM/PMM/PMM_State_Machine/OFF_C.EWP3CurrCal" /begin REF_CHARACTERISTIC MPMM_EWP3Curr_Y_A /end REF_CHARACTERISTIC /begin REF_MEASUREMENT VPMM_EWP3CurrOut_A /end REF_MEASUREMENT /end GROUP
/begin GROUP S561_OFF_C_LVBattChrgTimeCal "SWC_FDC_type/run_SWC_FDC_RxTx_5ms_sys/APP/PMM/PMM/PMM_State_Machine/OFF_C.LVBattChrgTimeCal" /begin REF_CHARACTERISTIC MPMM_LVBattChrgtime_Y_s /end REF_CHARACTERISTIC /begin REF_MEASUREMENT VPMM_LVBattChrgtimeOut_s /end REF_MEASUREMENT /end GROUP
/begin GROUP S647_Subsystem10 "SWC_FDC_type/run_SWC_FDC_RxTx_5ms_sys/APP/THC/ThermalControl/AC/Subsystem10" /begin REF_MEASUREMENT VTHC_ACModeMem_enum /end REF_MEASUREMENT /end GROUP
/begin GROUP S647_Subsystem11 "SWC_FDC_type/run_SWC_FDC_RxTx_5ms_sys/APP/THC/ThermalControl/AC/Subsystem11" /begin REF_MEASUREMENT VTHC_FaceM_flg /end REF_MEASUREMENT /end GROUP
/begin GROUP S647_Subsystem12 "SWC_FDC_type/run_SWC_FDC_RxTx_5ms_sys/APP/THC/ThermalControl/AC/Subsystem12" /begin REF_MEASUREMENT VTHC_FootM_flg /end REF_MEASUREMENT /end GROUP
/begin GROUP S647_Subsystem13 "SWC_FDC_type/run_SWC_FDC_RxTx_5ms_sys/APP/THC/ThermalControl/AC/Subsystem13" /begin REF_MEASUREMENT VTHC_Face_flg /end REF_MEASUREMENT /end GROUP
/begin GROUP S647_Subsystem14 "SWC_FDC_type/run_SWC_FDC_RxTx_5ms_sys/APP/THC/ThermalControl/AC/Subsystem14" /begin REF_MEASUREMENT VTHC_Foot_flg /end REF_MEASUREMENT /end GROUP
/begin GROUP S647_Subsystem15 "SWC_FDC_type/run_SWC_FDC_RxTx_5ms_sys/APP/THC/ThermalControl/AC/Subsystem15" /begin REF_MEASUREMENT VTHC_fdefog_flg /end REF_MEASUREMENT /end GROUP
/begin GROUP S647_Subsystem16 "SWC_FDC_type/run_SWC_FDC_RxTx_5ms_sys/APP/THC/ThermalControl/AC/Subsystem16" /begin REF_MEASUREMENT VTHC_RecAutoFlg_flg /end REF_MEASUREMENT /end GROUP
/begin GROUP S647_Subsystem17 "SWC_FDC_type/run_SWC_FDC_RxTx_5ms_sys/APP/THC/ThermalControl/AC/Subsystem17" /begin REF_MEASUREMENT VTHC_AirIntenZone1M_enum /end REF_MEASUREMENT /end GROUP
/begin GROUP S647_Subsystem2 "SWC_FDC_type/run_SWC_FDC_RxTx_5ms_sys/APP/THC/ThermalControl/AC/Subsystem2" /begin REF_MEASUREMENT VTHC_CCUSyncSts_flg /end REF_MEASUREMENT /end GROUP
/begin GROUP S647_Subsystem33 "SWC_FDC_type/run_SWC_FDC_RxTx_5ms_sys/APP/THC/ThermalControl/AC/Subsystem33" /begin REF_MEASUREMENT VTHC_sigSetTempZon1St_C /end REF_MEASUREMENT /end GROUP
/begin GROUP S647_Subsystem6 "SWC_FDC_type/run_SWC_FDC_RxTx_5ms_sys/APP/THC/ThermalControl/AC/Subsystem6" /begin REF_MEASUREMENT VTHC_sigWindDirZon1St_enum /end REF_MEASUREMENT /end GROUP
/begin GROUP S647_Subsystem7 "SWC_FDC_type/run_SWC_FDC_RxTx_5ms_sys/APP/THC/ThermalControl/AC/Subsystem7" /begin REF_MEASUREMENT VTHC_sigRecircSt_flg /end REF_MEASUREMENT /end GROUP
/begin GROUP S647_Subsystem8 "SWC_FDC_type/run_SWC_FDC_RxTx_5ms_sys/APP/THC/ThermalControl/AC/Subsystem8" /begin REF_MEASUREMENT VTHC_Frost_flg /end REF_MEASUREMENT /end GROUP
/begin GROUP S647_Subsystem9 "SWC_FDC_type/run_SWC_FDC_RxTx_5ms_sys/APP/THC/ThermalControl/AC/Subsystem9" /begin REF_MEASUREMENT VTHC_FDRecyAutoCmd_enum /end REF_MEASUREMENT /end GROUP
/begin GROUP S648_AGSandFan "SWC_FDC_type/run_SWC_FDC_RxTx_5ms_sys/APP/THC/ThermalControl/THCM_Conctrl/AGSandFan"
 /begin REF_CHARACTERISTIC KTHC_AGSDefLv_K KTHC_AGSLv1_K KTHC_AGSLv2_K KTHC_AGSLv3_K KTHC_AGSLv4_K KTHC_AGSLv5_K KTHC_ErrHandleEN_flg /end REF_CHARACTERISTIC
/end GROUP
/begin GROUP S648_APTC "SWC_FDC_type/run_SWC_FDC_RxTx_5ms_sys/APP/THC/ThermalControl/THCM_Conctrl/APTC"
 /begin SUB_GROUP S881_APTCPWMControl S881_APTCPWMControl1 S881_APTCPWMControl2 S881_Subsystem /end SUB_GROUP
 /begin REF_CHARACTERISTIC KTHC_APTCPWMEN_flg KTHC_APTCQminC_W KTHC_APTCQoffT_cnt KTHC_APTCQonT_cnt KTHC_DAPTCQ1_W KTHC_DAPTCQ2_W KTHC_DAPTCQ3_W KTHC_DcChSetTemp_C KTHC_KiAPTCDcCh_K KTHC_KiAPTCDeice_K KTHC_KiAPTCTcabinC2_K KTHC_KiAPTCTcabinC_K KTHC_KiAPTCTcabinD1_K KTHC_KiAPTCTcabinD2_K KTHC_KiAPTCTcabinD3_K KTHC_KiAPTCTcabinH_K KTHC_KpAPTCDcCh_K KTHC_KpAPTCDeice_K KTHC_KpAPTCTcabinC2_K KTHC_KpAPTCTcabinC_K KTHC_KpAPTCTcabinD1_K KTHC_KpAPTCTcabinD2_K KTHC_KpAPTCTcabinD3_K KTHC_KpAPTCTcabinH_K KTHC_TventL1_C KTHC_TventL2_C KTHC_TventL3_C KTHC_TventL4_C KTHC_TventL5_C MTHC_APTCQA_Y_W MTHC_APTCQB_Y_W /end REF_CHARACTERISTIC
/end GROUP
/begin GROUP S648_BlowerCtrl "SWC_FDC_type/run_SWC_FDC_RxTx_5ms_sys/APP/THC/ThermalControl/THCM_Conctrl/BlowerCtrl" /begin SUB_GROUP S882_Enabled_Subsystem1 /end SUB_GROUP
 /begin REF_CHARACTERISTIC KTHC_KiBlowerDeice_K KTHC_KiBlowerTcabinC_K KTHC_KiBlowerTcabinD_K KTHC_KiBlowerTcabinH_K KTHC_KpBlowerDeice_K KTHC_KpBlowerTcabinC_K KTHC_KpBlowerTcabinD_K KTHC_KpBlowerTcabinH_K KTHC_VBRearClosed_K KTHC_VBlowerDcCh_K KTHC_VBlowerMin_K KTHC_VBstep_K KTHC_VGainStep_K /end REF_CHARACTERISTIC
/end GROUP
/begin GROUP S648_CompCtrl "SWC_FDC_type/run_SWC_FDC_RxTx_5ms_sys/APP/THC/ThermalControl/THCM_Conctrl/CompCtrl" /begin SUB_GROUP S886_Enabled_Subsystem S886_Enabled_Subsystem1 /end SUB_GROUP
 /begin REF_CHARACTERISTIC KTHC_CompSpdmax_rpm KTHC_CompSpdmin_rpm KTHC_KiCompPhigh_K KTHC_KiCompPlow1_K KTHC_KiCompPlow2_K KTHC_KiCompTcabinC1_K KTHC_KiCompTcabinC_K KTHC_KiCompTcabinD_K KTHC_KiCompTcabinH_K KTHC_KiCompTwinC_K KTHC_KiCompTwinD_K KTHC_KpCompPhigh_K KTHC_KpCompPlow1_K KTHC_KpCompPlow2_K KTHC_KpCompTcabinC1_K KTHC_KpCompTcabinC_K KTHC_KpCompTcabinD_K KTHC_KpCompTcabinH_K KTHC_KpCompTwinC_K KTHC_KpCompTwinD_K KTHC_KrpmCompPhigh_K KTHC_KrpmCompPlow1_K KTHC_KrpmCompPlow2_K KTHC_KrpmCompTcabinC1_K KTHC_KrpmCompTcabinC_K KTHC_KrpmCompTcabinD_K KTHC_KrpmCompTcabinH_K KTHC_KrpmCompTwinC_K KTHC_KrpmCompTwinD_K KTHC_PhighSetpoint_kPa KTHC_Plow1Setpoint_kPa KTHC_Plow2Setpoint_kPa /end REF_CHARACTERISTIC
/end GROUP
/begin GROUP S648_RadiatorFan "SWC_FDC_type/run_SWC_FDC_RxTx_5ms_sys/APP/THC/ThermalControl/THCM_Conctrl/RadiatorFan" /begin REF_CHARACTERISTIC KTHC_ErrHandleEN_flg /end REF_CHARACTERISTIC /end GROUP
/begin GROUP S648_SensorErrorHandle1 "SWC_FDC_type/run_SWC_FDC_RxTx_5ms_sys/APP/THC/ThermalControl/THCM_Conctrl/SensorErrorHandle1" /begin REF_CHARACTERISTIC KTHC_ErrHandleEN_flg /end REF_CHARACTERISTIC /end GROUP
/begin GROUP S648_SensorErrorHandle10 "SWC_FDC_type/run_SWC_FDC_RxTx_5ms_sys/APP/THC/ThermalControl/THCM_Conctrl/SensorErrorHandle10" /begin REF_CHARACTERISTIC KTHC_ErrHandleEN_flg /end REF_CHARACTERISTIC /end GROUP
/begin GROUP S648_SensorErrorHandle11 "SWC_FDC_type/run_SWC_FDC_RxTx_5ms_sys/APP/THC/ThermalControl/THCM_Conctrl/SensorErrorHandle11" /begin REF_CHARACTERISTIC KTHC_ErrHandleEN_flg /end REF_CHARACTERISTIC /end GROUP
/begin GROUP S648_SensorErrorHandle12 "SWC_FDC_type/run_SWC_FDC_RxTx_5ms_sys/APP/THC/ThermalControl/THCM_Conctrl/SensorErrorHandle12" /begin REF_CHARACTERISTIC KTHC_ErrHandleEN_flg /end REF_CHARACTERISTIC /end GROUP
/begin GROUP S648_SensorErrorHandle2 "SWC_FDC_type/run_SWC_FDC_RxTx_5ms_sys/APP/THC/ThermalControl/THCM_Conctrl/SensorErrorHandle2" /begin REF_CHARACTERISTIC KTHC_ErrHandleEN_flg /end REF_CHARACTERISTIC /end GROUP
/begin GROUP S648_SensorErrorHandle3 "SWC_FDC_type/run_SWC_FDC_RxTx_5ms_sys/APP/THC/ThermalControl/THCM_Conctrl/SensorErrorHandle3" /begin REF_CHARACTERISTIC KTHC_ErrHandleEN_flg /end REF_CHARACTERISTIC /end GROUP
/begin GROUP S648_Subsystem1 "SWC_FDC_type/run_SWC_FDC_RxTx_5ms_sys/APP/THC/ThermalControl/THCM_Conctrl/Subsystem1" /begin REF_CHARACTERISTIC KTHC_TductDef_C /end REF_CHARACTERISTIC /end GROUP
/begin GROUP S648_WPTC "SWC_FDC_type/run_SWC_FDC_RxTx_5ms_sys/APP/THC/ThermalControl/THCM_Conctrl/WPTC" /begin REF_CHARACTERISTIC KTHC_ErrHandleEN_flg /end REF_CHARACTERISTIC /end GROUP
/begin GROUP S1278_AvaliableTqLimit "SWC_FDC_type/run_SWC_FDC_RxTx_5ms_sys/APP/TQD/TorqueDemand/TorqueModule/AvaliableTqLimit" /begin REF_CHARACTERISTIC KTQD_FrTMTotalGearRatio_gain KTQD_RrTMTotalGearRatio_gain /end REF_CHARACTERISTIC /end GROUP
/begin GROUP S1278_Signal_for_ESC "SWC_FDC_type/run_SWC_FDC_RxTx_5ms_sys/APP/TQD/TorqueDemand/TorqueModule/Signal for ESC" /begin REF_CHARACTERISTIC KTQD_FrTMTotalGearRatio_gain KTQD_RrTMTotalGearRatio_gain /end REF_CHARACTERISTIC /end GROUP
/begin GROUP S1644_InverseAndTurnToMotorToq "SWC_FDC_type/run_SWC_FDC_RxTx_5ms_sys/APP/TQR/Determine Torque Request/TorqueArbitrament/InverseAndTurnToMotorToq" /begin REF_CHARACTERISTIC KTQD_FrTMTotalGearRatio_gain KTQD_RrTMTotalGearRatio_gain /end REF_CHARACTERISTIC /end GROUP
/begin GROUP S1911_VVMC_ADASWhlTqCalVehHoldStandstill_Nm "SWC_FDC_type/run_SWC_FDC_RxTx_5ms_sys/APP/VMC/VMC/ACC_Function/VVMC_ADASWhlTqCalVehHoldStandstill_Nm" /begin REF_CHARACTERISTIC KTQD_FrTMTotalGearRatio_gain KTQD_RrTMTotalGearRatio_gain /end REF_CHARACTERISTIC /end GROUP
/begin GROUP S1913_CCActiveDetermination "SWC_FDC_type/run_SWC_FDC_RxTx_5ms_sys/APP/VMC/VMC/CruiseControlFunction/CCActiveDetermination" /begin REF_CHARACTERISTIC KVMC_CCMSASpdWar_kph /end REF_CHARACTERISTIC /end GROUP
/begin GROUP S1913_CCDemandTorqueCalculation "SWC_FDC_type/run_SWC_FDC_RxTx_5ms_sys/APP/VMC/VMC/CruiseControlFunction/CCDemandTorqueCalculation"
 /begin REF_CHARACTERISTIC KTQD_FrTMTotalGearRatio_gain KTQD_RrTMTotalGearRatio_gain KVMC_Veh2MeterSpdFactor_enum KVMC_Veh2MeterSpdLoBdy_kph KVMC_Veh2MeterSpdLoFactor_enum KVMC_Veh2MeterSpdOffset_enum /end REF_CHARACTERISTIC
/end GROUP
/begin GROUP S1918_Vehicle_to_Meter_Speed "SWC_FDC_type/run_SWC_FDC_RxTx_5ms_sys/APP/VMC/VMC/Long Acceleration Calculation/Vehicle to Meter Speed"
 /begin REF_CHARACTERISTIC KVMC_Veh2MeterSpdFactor_enum KVMC_Veh2MeterSpdLoBdy_kph KVMC_Veh2MeterSpdLoFactor_enum KVMC_Veh2MeterSpdOffset_enum /end REF_CHARACTERISTIC
/end GROUP
/begin GROUP S1919_MSAActivationHandshake "SWC_FDC_type/run_SWC_FDC_RxTx_5ms_sys/APP/VMC/VMC/MSA function/MSAActivationHandshake" /begin REF_CHARACTERISTIC KVMC_CCMSASpdWar_kph /end REF_CHARACTERISTIC /end GROUP
/begin GROUP S1919_MSADemandTorqueCalculation "SWC_FDC_type/run_SWC_FDC_RxTx_5ms_sys/APP/VMC/VMC/MSA function/MSADemandTorqueCalculation"
 /begin REF_CHARACTERISTIC KTQD_FrTMTotalGearRatio_gain KTQD_RrTMTotalGearRatio_gain KVMC_Veh2MeterSpdFactor_enum KVMC_Veh2MeterSpdLoBdy_kph KVMC_Veh2MeterSpdLoFactor_enum KVMC_Veh2MeterSpdOffset_enum /end REF_CHARACTERISTIC
/end GROUP
/begin GROUP S1921_RWD "SWC_FDC_type/run_SWC_FDC_RxTx_5ms_sys/APP/VMC/VMC/RDC Determination/RWD" /begin REF_CHARACTERISTIC KVMC_DIDGetDynoModeSW_flg /end REF_CHARACTERISTIC /end GROUP
/begin GROUP S1922_ISO22179 "SWC_FDC_type/run_SWC_FDC_RxTx_5ms_sys/APP/VMC/VMC/SPD2ACC/ISO22179"
 /begin REF_CHARACTERISTIC KVMC_AutoTurnJerkHiGain_pct KVMC_AutoTurnLimitHiGain_pct KVMC_DISCDecCtrlTest_flg /end REF_CHARACTERISTIC
/end GROUP
/begin GROUP S1922_VVMC_DISReqAcc_mps2 "SWC_FDC_type/run_SWC_FDC_RxTx_5ms_sys/APP/VMC/VMC/SPD2ACC/VVMC_DISReqAcc_mps2"
 /begin REF_CHARACTERISTIC KVMC_Veh2MeterSpdFactor_enum KVMC_Veh2MeterSpdLoBdy_kph KVMC_Veh2MeterSpdLoFactor_enum KVMC_Veh2MeterSpdOffset_enum /end REF_CHARACTERISTIC
/end GROUP
/begin GROUP S1926_Response_Gain "SWC_FDC_type/run_SWC_FDC_RxTx_5ms_sys/APP/VMC/VMC/SpeedArbitration/Response Gain"
 /begin REF_CHARACTERISTIC KVMC_Veh2MeterSpdFactor_enum KVMC_Veh2MeterSpdLoBdy_kph KVMC_Veh2MeterSpdLoFactor_enum KVMC_Veh2MeterSpdOffset_enum /end REF_CHARACTERISTIC
/end GROUP
/begin GROUP S134_CheckSignalAvailable "SWC_FDC_type/run_SWC_FDC_RxTx_5ms_sys/APP/BCM/BCM/PTG/KeyDetected/CheckSignalAvailable" /begin REF_CHARACTERISTIC KBCM_SPTGLowerBoundOut_cm /end REF_CHARACTERISTIC /end GROUP
/begin GROUP S881_APTCPWMControl "SWC_FDC_type/run_SWC_FDC_RxTx_5ms_sys/APP/THC/ThermalControl/THCM_Conctrl/APTC/APTCPWMControl" /begin REF_CHARACTERISTIC KTHC_APTCPWMEN_flg KTHC_APTCQminC_W /end REF_CHARACTERISTIC /end GROUP
/begin GROUP S881_APTCPWMControl1 "SWC_FDC_type/run_SWC_FDC_RxTx_5ms_sys/APP/THC/ThermalControl/THCM_Conctrl/APTC/APTCPWMControl1" /begin REF_CHARACTERISTIC KTHC_APTCPWMEN_flg KTHC_APTCQminC_W /end REF_CHARACTERISTIC /end GROUP
/begin GROUP S881_APTCPWMControl2 "SWC_FDC_type/run_SWC_FDC_RxTx_5ms_sys/APP/THC/ThermalControl/THCM_Conctrl/APTC/APTCPWMControl2" /begin REF_CHARACTERISTIC KTHC_APTCPWMEN_flg KTHC_APTCQminC_W /end REF_CHARACTERISTIC /end GROUP
/begin GROUP S882_Enabled_Subsystem1 "SWC_FDC_type/run_SWC_FDC_RxTx_5ms_sys/APP/THC/ThermalControl/THCM_Conctrl/BlowerCtrl/Enabled Subsystem1" /begin REF_CHARACTERISTIC KTHC_VBlowerDcCh_K KTHC_VBlowerMin_K /end REF_CHARACTERISTIC /end GROUP
/begin GROUP S886_Enabled_Subsystem1 "SWC_FDC_type/run_SWC_FDC_RxTx_5ms_sys/APP/THC/ThermalControl/THCM_Conctrl/CompCtrl/Enabled Subsystem1"
 /begin REF_CHARACTERISTIC KTHC_T1MaxBC_C KTHC_T2MaxBC_C KTHC_T2MinBC_C KTHC_T3MaxBC_C KTHC_T3MinBC_C KTHC_T3winSetpointBC_C KTHC_T4MaxBC_C KTHC_T4MinBC_C KTHC_T5MinBC_C /end REF_CHARACTERISTIC
/end GROUP
/begin GROUP S928_SensorErrorHandle1 "SWC_FDC_type/run_SWC_FDC_RxTx_5ms_sys/APP/THC/ThermalControl/THCM_Conctrl/Subsystem1/SensorErrorHandle1" /begin REF_CHARACTERISTIC KTHC_ErrHandleEN_flg /end REF_CHARACTERISTIC /end GROUP
/begin GROUP S928_SensorErrorHandle2 "SWC_FDC_type/run_SWC_FDC_RxTx_5ms_sys/APP/THC/ThermalControl/THCM_Conctrl/Subsystem1/SensorErrorHandle2" /begin REF_CHARACTERISTIC KTHC_ErrHandleEN_flg /end REF_CHARACTERISTIC /end GROUP
/begin GROUP S928_SensorErrorHandle3 "SWC_FDC_type/run_SWC_FDC_RxTx_5ms_sys/APP/THC/ThermalControl/THCM_Conctrl/Subsystem1/SensorErrorHandle3" /begin REF_CHARACTERISTIC KTHC_ErrHandleEN_flg /end REF_CHARACTERISTIC /end GROUP
/begin GROUP S928_SensorErrorHandle4 "SWC_FDC_type/run_SWC_FDC_RxTx_5ms_sys/APP/THC/ThermalControl/THCM_Conctrl/Subsystem1/SensorErrorHandle4" /begin REF_CHARACTERISTIC KTHC_ErrHandleEN_flg /end REF_CHARACTERISTIC /end GROUP
/begin GROUP S928_SensorErrorHandle5 "SWC_FDC_type/run_SWC_FDC_RxTx_5ms_sys/APP/THC/ThermalControl/THCM_Conctrl/Subsystem1/SensorErrorHandle5" /begin REF_CHARACTERISTIC KTHC_ErrHandleEN_flg /end REF_CHARACTERISTIC /end GROUP
/begin GROUP S928_SensorErrorHandle9 "SWC_FDC_type/run_SWC_FDC_RxTx_5ms_sys/APP/THC/ThermalControl/THCM_Conctrl/Subsystem1/SensorErrorHandle9" /begin REF_CHARACTERISTIC KTHC_ErrHandleEN_flg /end REF_CHARACTERISTIC /end GROUP
/begin GROUP S929_SensorErrorHandle9 "SWC_FDC_type/run_SWC_FDC_RxTx_5ms_sys/APP/THC/ThermalControl/THCM_Conctrl/Subsystem2/SensorErrorHandle9" /begin REF_CHARACTERISTIC KTHC_ErrHandleEN_flg /end REF_CHARACTERISTIC /end GROUP
/begin GROUP S1427_Vehicle_Weight "SWC_FDC_type/run_SWC_FDC_RxTx_5ms_sys/APP/TQD/TorqueDemand/Signal_convert/VehWeightEst/Calaulation/Vehicle Weight" /begin REF_CHARACTERISTIC KTQD_FrTMTotalGearRatio_gain KTQD_RrTMTotalGearRatio_gain /end REF_CHARACTERISTIC /end GROUP
/begin GROUP S1499_Generation "SWC_FDC_type/run_SWC_FDC_RxTx_5ms_sys/APP/TQD/TorqueDemand/TorqueModule/AvaliableTqLimit/TorqueCapacityCalcalation/Generation" /begin REF_CHARACTERISTIC KTQD_FrTMTotalGearRatio_gain KTQD_RrTMTotalGearRatio_gain /end REF_CHARACTERISTIC /end GROUP
/begin GROUP S1499_Motoring "SWC_FDC_type/run_SWC_FDC_RxTx_5ms_sys/APP/TQD/TorqueDemand/TorqueModule/AvaliableTqLimit/TorqueCapacityCalcalation/Motoring" /begin REF_CHARACTERISTIC KTQD_FrTMTotalGearRatio_gain KTQD_RrTMTotalGearRatio_gain /end REF_CHARACTERISTIC /end GROUP
/end MODULE
/end PROJECT
