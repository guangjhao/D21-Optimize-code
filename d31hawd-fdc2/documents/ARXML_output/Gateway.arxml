AUTOSAR XML (schema 4-3-0)
package /Gateway
  gateway Gateway_FUSION: ecu=FUSION
    signal-mappings:
      source-signal=ST_CAN3_BMS_READY, target-signal=ST_CAN1_BMS_READY
      source-signal=ST_CAN3_Rr_TMSpd, target-signal=ST_CAN1_Rr_TMSpd
      source-signal=ST_CAN3_Fr_TMSpd, target-signal=ST_CAN1_Fr_TMSpd
      source-signal=ST_CAN2_Roll_Eng_Mode, target-signal=ST_CAN1_Roll_Eng_Mode
      source-signal=ST_CAN2_ESC_SW_Cmd, target-signal=ST_CAN1_ESC_SW_Cmd
      source-signal=ST_CAN2_TCS_SW_Cmd, target-signal=ST_CAN1_TCS_SW_Cmd
      source-signal=ST_CAN2_Roll_Mode_SW_Cmd, target-signal=ST_CAN1_Roll_Mode_SW_Cmd
      source-signal=ST_CAN6_LVDA_Disabled, target-signal=ST_CAN2_LVDA_Disabled
      source-signal=ST_CAN6_ADAS_CAM_SpdLim, target-signal=ST_CAN2_ADAS_CAM_SpdLim
      source-signal=ST_CAN6_ADAS_ISA_Sta, target-signal=ST_CAN2_ADAS_ISA_Sta
      source-signal=ST_CAN6_ADAS_LFC_Warn_Sound, target-signal=ST_CAN2_ADAS_LFC_Warn_Sound
      source-signal=ST_CAN6_ADAS_AEBReq, target-signal=ST_CAN2_ADAS_AEBReq
      source-signal=ST_CAN6_Target_Type, target-signal=ST_CAN2_Target_Type
      source-signal=ST_CAN6_ACC_ObjDist, target-signal=ST_CAN2_ACC_ObjDist
      source-signal=ST_CAN6_HazardWarningReq, target-signal=ST_CAN2_HazardWarningReq
      source-signal=ST_CAN6_LVDA_Mute_Sta, target-signal=ST_CAN2_LVDA_Mute_Sta
      source-signal=ST_CAN6_ADAS_SLIF_Sta, target-signal=ST_CAN2_ADAS_SLIF_Sta
      source-signal=ST_CAN6_ADAS_LDW_Sensitivity, target-signal=ST_CAN2_ADAS_LDW_Sensitivity
      source-signal=ST_CAN6_ADAS_LKA_Sta, target-signal=ST_CAN2_ADAS_LKA_Sta
      source-signal=ST_CAN6_ACC_ObjDstLvl, target-signal=ST_CAN2_ACC_ObjDstLvl
      source-signal=ST_CAN6_ADAS_LDW_Sta, target-signal=ST_CAN2_ADAS_LDW_Sta
      source-signal=ST_CAN6_ADAS_AEB_Sta, target-signal=ST_CAN2_ADAS_AEB_Sta
      source-signal=ST_CAN6_ADAS_FCW_Sensitivity, target-signal=ST_CAN2_ADAS_FCW_Sensitivity
      source-signal=ST_CAN6_ADAS_SLIF_SpdLim, target-signal=ST_CAN2_ADAS_SLIF_SpdLim
      source-signal=ST_CAN6_ISA_WarningMsg, target-signal=ST_CAN2_ISA_WarningMsg
      source-signal=ST_CAN6_RightTurnLightReq, target-signal=ST_CAN2_RightTurnLightReq
      source-signal=ST_CAN6_LVDA_Warning, target-signal=ST_CAN2_LVDA_Warning
      source-signal=ST_CAN6_LeftTurnLightReq, target-signal=ST_CAN2_LeftTurnLightReq
      source-signal=ST_CAN6_ADAS_WarningMsg, target-signal=ST_CAN2_ADAS_WarningMsg
      source-signal=ST_CAN6_ADAS_LDW_Mute, target-signal=ST_CAN2_ADAS_LDW_Mute
      source-signal=ST_CAN6_ACC_ObjRelSpd, target-signal=ST_CAN2_ACC_ObjRelSpd
      source-signal=ST_CAN6_ADAS_LFC_Hands_Off_Warning, target-signal=ST_CAN2_ADAS_LFC_Hands_Off_Warning
      source-signal=ST_CAN6_LKA_HOD_Sound_Warning, target-signal=ST_CAN2_LKA_HOD_Sound_Warning
      source-signal=ST_CAN6_ADAS_ACC_Sta, target-signal=ST_CAN2_ADAS_ACC_Sta
      source-signal=ST_CAN6_ADAS_FCW_Sta, target-signal=ST_CAN2_ADAS_FCW_Sta
      source-signal=ST_CAN6_ADAS_LaneModeR, target-signal=ST_CAN2_ADAS_LaneModeR
      source-signal=ST_CAN6_ADAS_LaneModeL, target-signal=ST_CAN2_ADAS_LaneModeL
      source-signal=ST_CAN6_ADAS_LFC_Sta, target-signal=ST_CAN2_ADAS_LFC_Sta
      source-signal=ST_CAN6_CameraBlockage, target-signal=ST_CAN2_CameraBlockage
      source-signal=ST_CAN6_LVDA_Failinfo, target-signal=ST_CAN2_LVDA_Failinfo
      source-signal=ST_CAN6_LKA_HOD_Display_Warning, target-signal=ST_CAN2_LKA_HOD_Display_Warning
      source-signal=ST_CAN6_LVDA_ACCStatusInformation, target-signal=ST_CAN2_LVDA_ACCStatusInformation
      source-signal=ST_CAN6_ADAS_FCW_Mute, target-signal=ST_CAN2_ADAS_FCW_Mute
      source-signal=ST_CAN6_ADAS_VehSpdLim, target-signal=ST_CAN2_ADAS_VehSpdLim
      source-signal=ST_CAN6_ForceLowBeam, target-signal=ST_CAN2_ForceLowBeam
      source-signal=ST_CAN6_ADAS_FltWrnReq, target-signal=ST_CAN2_ADAS_FltWrnReq
      source-signal=ST_CAN6_ACC_TakeoverReq, target-signal=ST_CAN2_ACC_TakeoverReq
      source-signal=ST_CAN5_CbnPreACEnaReq, target-signal=ST_CAN2_CbnPreACEnaReq
      source-signal=ST_CAN5_Re_Radio, target-signal=ST_CAN2_Re_Radio
      source-signal=ST_CAN5_TBOX_NET_SIG_STR, target-signal=ST_CAN2_TBOX_NET_SIG_STR
      source-signal=ST_CAN5_TBOX_TEST_STATUS, target-signal=ST_CAN2_TBOX_TEST_STATUS
      source-signal=ST_CAN5_TBOX_SW_VER, target-signal=ST_CAN2_TBOX_SW_VER
      source-signal=ST_CAN5_Charge_Percent_Set, target-signal=ST_CAN2_Charge_Percent_Set
      source-signal=ST_CAN5_TBOX_HW_VER, target-signal=ST_CAN2_TBOX_HW_VER
      source-signal=ST_CAN4_DrSCPSysErrLmp, target-signal=ST_CAN2_DrSCPSysErrLmp
      source-signal=ST_CAN4_DrPMMLVOutPErrLmp, target-signal=ST_CAN2_DrPMMLVOutPErrLmp
      source-signal=ST_CAN4_DrPMMSysErrLmp, target-signal=ST_CAN2_DrPMMSysErrLmp
      source-signal=ST_CAN4_FrPMMLimpHomeActReq, target-signal=ST_CAN2_FrPMMLimpHomeActReq
      source-signal=ST_CAN4_RLB_Warning, target-signal=ST_CAN2_RLB_Warning
      source-signal=ST_CAN4_RDRL_Warning, target-signal=ST_CAN2_RDRL_Warning
      source-signal=ST_CAN4_LADBErr, target-signal=ST_CAN2_LADBErr
      source-signal=ST_CAN4_LL_BeamErr, target-signal=ST_CAN2_LL_BeamErr
      source-signal=ST_CAN4_RADB_Warning, target-signal=ST_CAN2_RADB_Warning
      source-signal=ST_CAN4_FLTurn_Light_Warning, target-signal=ST_CAN2_FLTurn_Light_Warning
      source-signal=ST_CAN4_FRTurn_Light_Warning, target-signal=ST_CAN2_FRTurn_Light_Warning
      source-signal=ST_CAN4_RADB_Hibeam_Indication, target-signal=ST_CAN2_RADB_Hibeam_Indication
      source-signal=ST_CAN4_RH_BeamErr, target-signal=ST_CAN2_RH_BeamErr
      source-signal=ST_CAN4_Lposition_Lamp_Warning, target-signal=ST_CAN2_Lposition_Lamp_Warning
      source-signal=ST_CAN4_LADB_Operation_Status, target-signal=ST_CAN2_LADB_Operation_Status
      source-signal=ST_CAN4_LLB_Warning, target-signal=ST_CAN2_LLB_Warning
      source-signal=ST_CAN4_LADB_Warning, target-signal=ST_CAN2_LADB_Warning
      source-signal=ST_CAN4_LH_BeamErr, target-signal=ST_CAN2_LH_BeamErr
      source-signal=ST_CAN4_LDRL_Warning, target-signal=ST_CAN2_LDRL_Warning
      source-signal=ST_CAN4_Rposition_Lamp_Warning, target-signal=ST_CAN2_Rposition_Lamp_Warning
      source-signal=ST_CAN4_RAHB_Warning, target-signal=ST_CAN2_RAHB_Warning
      source-signal=ST_CAN4_RADB_Operation_Status, target-signal=ST_CAN2_RADB_Operation_Status
      source-signal=ST_CAN4_LADB_Hibeam_Indication, target-signal=ST_CAN2_LADB_Hibeam_Indication
      source-signal=ST_CAN4_FRTurnLPErr, target-signal=ST_CAN2_FRTurnLPErr
      source-signal=ST_CAN4_LAHB_Warning, target-signal=ST_CAN2_LAHB_Warning
      source-signal=ST_CAN4_RL_BeamErr, target-signal=ST_CAN2_RL_BeamErr
      source-signal=ST_CAN4_RADBErr, target-signal=ST_CAN2_RADBErr
      source-signal=ST_CAN4_FLTurnLPErr, target-signal=ST_CAN2_FLTurnLPErr
      source-signal=ST_CAN4_RLTurnLPErr, target-signal=ST_CAN2_RLTurnLPErr
      source-signal=ST_CAN4_RRTurnLPErr, target-signal=ST_CAN2_RRTurnLPErr
      source-signal=ST_CAN4_FrntPTCLeActHeatPwr, target-signal=ST_CAN2_FrntPTCLeActHeatPwr
      source-signal=ST_CAN4_FrntPTCRiActHeatPwr, target-signal=ST_CAN2_FrntPTCRiActHeatPwr
      source-signal=ST_CAN4_FrntPTCRearRiActHeatPwr, target-signal=ST_CAN2_FrntPTCRearRiActHeatPwr
      source-signal=ST_CAN4_FrntPTCRearLeActHeatPwr, target-signal=ST_CAN2_FrntPTCRearLeActHeatPwr
      source-signal=ST_CAN4_SWC_RegenUp, target-signal=ST_CAN2_SWC_RegenUp
      source-signal=ST_CAN4_SWC_LKA_Sta, target-signal=ST_CAN2_SWC_LKA_Sta
      source-signal=ST_CAN4_SWC_Left_Sta, target-signal=ST_CAN2_SWC_Left_Sta
      source-signal=ST_CAN4_RLS_Lamp_Sta, target-signal=ST_CAN2_RLS_Lamp_Sta
      source-signal=ST_CAN4_SWC_ACC_Sta, target-signal=ST_CAN2_SWC_ACC_Sta
      source-signal=ST_CAN4_SWC_RegenDown, target-signal=ST_CAN2_SWC_RegenDown
      source-signal=ST_CAN4_SWC_Right_Sta, target-signal=ST_CAN2_SWC_Right_Sta
      source-signal=ST_CAN4_SWC_Down_Sta, target-signal=ST_CAN2_SWC_Down_Sta
      source-signal=ST_CAN4_SWC_Undefined_Sta, target-signal=ST_CAN2_SWC_Undefined_Sta
      source-signal=ST_CAN4_SWC_Up_Sta, target-signal=ST_CAN2_SWC_Up_Sta
      source-signal=ST_CAN4_SWC_VR_Sta, target-signal=ST_CAN2_SWC_VR_Sta
      source-signal=ST_CAN4_SWC_Trip_Sta, target-signal=ST_CAN2_SWC_Trip_Sta
      source-signal=ST_CAN4_SWC_mode_Sta, target-signal=ST_CAN2_SWC_mode_Sta
      source-signal=ST_CAN4_P_KeyMiss, target-signal=ST_CAN2_P_KeyMiss
      source-signal=ST_CAN4_P_UID_LowPower, target-signal=ST_CAN2_P_UID_LowPower
      source-signal=ST_CAN4_P_Dkey_Show_IVI, target-signal=ST_CAN2_P_Dkey_Show_IVI
      source-signal=ST_CAN4_DKC_KeyType_Sta, target-signal=ST_CAN2_DKC_KeyType_Sta
      source-signal=ST_CAN4_DKC_KeyNum_Sta, target-signal=ST_CAN2_DKC_KeyNum_Sta
      source-signal=ST_CAN4_COMP_ActualPwr, target-signal=ST_CAN2_COMP_ActualPwr
      source-signal=ST_CAN4_ZFR_EChrg_WashMode_Sta, target-signal=ST_CAN2_ZFR_EChrg_WashMode_Sta
      source-signal=ST_CAN4_ZFR_EChrg_Active_Sta, target-signal=ST_CAN2_ZFR_EChrg_Active_Sta
      source-signal=ST_CAN4_ZFR_EChrg_Sys_Sta, target-signal=ST_CAN2_ZFR_EChrg_Sys_Sta
      source-signal=ST_CAN4_ZFR_EChrg_OperationDeny_Cmd, target-signal=ST_CAN2_ZFR_EChrg_OperationDeny_Cmd
      source-signal=ST_CAN4_ZFR_BCM_ChargerDoorSW_Sta, target-signal=ST_CAN2_ZFR_BCM_ChargerDoorSW_Sta
      source-signal=ST_CAN4_ChargeInletLockSta, target-signal=ST_CAN2_ChargeInletLockSta
      source-signal=ST_CAN4_TrailerModeSta, target-signal=ST_CAN2_TrailerModeSta
      source-signal=ST_CAN4_TrailerCheck, target-signal=ST_CAN2_TrailerCheck
      source-signal=ST_CAN4_PSEAT_SW_Ver, target-signal=ST_CAN2_PSEAT_SW_Ver
      source-signal=ST_CAN4_DSEAT_HW_Ver, target-signal=ST_CAN2_DSEAT_HW_Ver
      source-signal=ST_CAN4_DSEAT_SW_Ver, target-signal=ST_CAN2_DSEAT_SW_Ver
      source-signal=ST_CAN4_PSEAT_HW_Ver, target-signal=ST_CAN2_PSEAT_HW_Ver
      source-signal=ST_CAN4_PTG_HW_Ver, target-signal=ST_CAN2_PTG_HW_Ver
      source-signal=ST_CAN4_PTG_SW_Ver, target-signal=ST_CAN2_PTG_SW_Ver
      source-signal=ST_CAN4_SWC2_R_PageSwitch_Sta, target-signal=ST_CAN2_SWC2_R_PageSwitch_Sta
      source-signal=ST_CAN4_SWC2_R_Left_Sta, target-signal=ST_CAN2_SWC2_R_Left_Sta
      source-signal=ST_CAN4_SWC2_L_DriveMode_Sta, target-signal=ST_CAN2_SWC2_L_DriveMode_Sta
      source-signal=ST_CAN4_SWC2_R_ScrollDown_Sta, target-signal=ST_CAN2_SWC2_R_ScrollDown_Sta
      source-signal=ST_CAN4_SWC2_R_Right_Sta, target-signal=ST_CAN2_SWC2_R_Right_Sta
      source-signal=ST_CAN4_SWC2_R_ScrollPress_Sta, target-signal=ST_CAN2_SWC2_R_ScrollPress_Sta
      source-signal=ST_CAN4_SWC2_R_VR_Sta, target-signal=ST_CAN2_SWC2_R_VR_Sta
      source-signal=ST_CAN4_SWC2_R_ScrollUp_Sta, target-signal=ST_CAN2_SWC2_R_ScrollUp_Sta
      source-signal=ST_CAN4_SWC2_R_Customize_Sta, target-signal=ST_CAN2_SWC2_R_Customize_Sta
      source-signal=ST_CAN4_SWC2_L_Home_Sta, target-signal=ST_CAN2_SWC2_L_Home_Sta
      source-signal=ST_CAN4_BD_Door_RHandleClose_Sta, target-signal=ST_CAN2_BD_Door_RHandleClose_Sta
      source-signal=ST_CAN4_BD_Door_FHandleClose_Sta, target-signal=ST_CAN2_BD_Door_FHandleClose_Sta
      source-signal=ST_CAN4_BP_SEAT_RVent_Sta, target-signal=ST_CAN2_BP_SEAT_RVent_Sta
      source-signal=ST_CAN4_BP_SEAT_LVent_Sta, target-signal=ST_CAN2_BP_SEAT_LVent_Sta
      source-signal=ST_CAN4_BP_Door_FHandleClose_Sta, target-signal=ST_CAN2_BP_Door_FHandleClose_Sta
      source-signal=ST_CAN4_BP_SEAT_MRVent_Sta, target-signal=ST_CAN2_BP_SEAT_MRVent_Sta
      source-signal=ST_CAN4_BP_SEAT_MLVent_Sta, target-signal=ST_CAN2_BP_SEAT_MLVent_Sta
      source-signal=ST_CAN4_BP_Door_RHandleClose_Sta, target-signal=ST_CAN2_BP_Door_RHandleClose_Sta
      source-signal=ST_CAN4_BD_DSEAT_MemSet_Sta, target-signal=ST_CAN2_BD_DSEAT_MemSet_Sta
      source-signal=ST_CAN4_BD_DSEAT_heater_Sta, target-signal=ST_CAN2_BD_DSEAT_heater_Sta
      source-signal=ST_CAN4_BD_DSEAT_Anti_Sta, target-signal=ST_CAN2_BD_DSEAT_Anti_Sta
      source-signal=ST_CAN4_BD_DSEAT_Vent_Sta, target-signal=ST_CAN2_BD_DSEAT_Vent_Sta
      source-signal=ST_CAN4_BD_DSEAT_StopKeepMove_Sta, target-signal=ST_CAN2_BD_DSEAT_StopKeepMove_Sta
      source-signal=ST_CAN4_BD_DSEAT_Mode_Sta, target-signal=ST_CAN2_BD_DSEAT_Mode_Sta
      source-signal=ST_CAN4_BD_DSEAT_Error_Sta, target-signal=ST_CAN2_BD_DSEAT_Error_Sta
      source-signal=ST_CAN4_BD_DSEAT_EntryFun_Sta, target-signal=ST_CAN2_BD_DSEAT_EntryFun_Sta
      source-signal=ST_CAN4_BP_PSEAT_heater_Sta, target-signal=ST_CAN2_BP_PSEAT_heater_Sta
      source-signal=ST_CAN4_BP_PTG_Active_Sta, target-signal=ST_CAN2_BP_PTG_Active_Sta
      source-signal=ST_CAN4_BP_PTG_Exist_Sta, target-signal=ST_CAN2_BP_PTG_Exist_Sta
      source-signal=ST_CAN4_BP_PTG_Sys_Sta, target-signal=ST_CAN2_BP_PTG_Sys_Sta
      source-signal=ST_CAN4_BP_PSEAT_Mode_Sta, target-signal=ST_CAN2_BP_PSEAT_Mode_Sta
      source-signal=ST_CAN4_BP_PSEAT_Error_Sta, target-signal=ST_CAN2_BP_PSEAT_Error_Sta
      source-signal=ST_CAN4_BP_PSEAT_Vent_Sta, target-signal=ST_CAN2_BP_PSEAT_Vent_Sta
      source-signal=ST_CAN4_BP_PTG_IsSetHeight_Sta, target-signal=ST_CAN2_BP_PTG_IsSetHeight_Sta
      source-signal=ST_CAN4_L_RLD_Motor_Relay_Error, target-signal=ST_CAN2_L_RLD_Motor_Relay_Error
      source-signal=ST_CAN4_L_Drv_Motor_Relay_Error, target-signal=ST_CAN2_L_Drv_Motor_Relay_Error
      source-signal=ST_CAN4_L_RRD_Motor_Relay_Error, target-signal=ST_CAN2_L_RRD_Motor_Relay_Error
      source-signal=ST_CAN4_L_Pas_Val_Wdw_Opened, target-signal=ST_CAN2_L_Pas_Val_Wdw_Opened
      source-signal=ST_CAN4_L_RLD_Motor_Ripple_Error, target-signal=ST_CAN2_L_RLD_Motor_Ripple_Error
      source-signal=ST_CAN4_L_Drv_Val_Wdw_Opened, target-signal=ST_CAN2_L_Drv_Val_Wdw_Opened
      source-signal=ST_CAN4_L_Pas_Motor_Relay_Error, target-signal=ST_CAN2_L_Pas_Motor_Relay_Error
      source-signal=ST_CAN4_FAPWL_01_LIN_Response_Error, target-signal=ST_CAN2_FAPWL_01_LIN_Response_Error
      source-signal=ST_CAN4_L_RLD_Val_Wdw_Opened, target-signal=ST_CAN2_L_RLD_Val_Wdw_Opened
      source-signal=ST_CAN4_L_RRD_Val_Wdw_Opened, target-signal=ST_CAN2_L_RRD_Val_Wdw_Opened
      source-signal=ST_CAN4_L_Pas_Motor_Ripple_Error, target-signal=ST_CAN2_L_Pas_Motor_Ripple_Error
      source-signal=ST_CAN4_L_Drv_Motor_Ripple_Error, target-signal=ST_CAN2_L_Drv_Motor_Ripple_Error
      source-signal=ST_CAN4_L_RRD_Motor_Ripple_Error, target-signal=ST_CAN2_L_RRD_Motor_Ripple_Error
      source-signal=ST_CAN4_RAPWL_01_LIN_Response_Error, target-signal=ST_CAN2_RAPWL_01_LIN_Response_Error
      source-signal=ST_CAN4_PSEAT_Vent_Sta, target-signal=ST_CAN2_PSEAT_Vent_Sta
      source-signal=ST_CAN4_DSEAT_Anti_Sta, target-signal=ST_CAN2_DSEAT_Anti_Sta
      source-signal=ST_CAN4_DSEAT_Vent_Sta, target-signal=ST_CAN2_DSEAT_Vent_Sta
      source-signal=ST_CAN4_DSEAT_EntryFun_Sta, target-signal=ST_CAN2_DSEAT_EntryFun_Sta
      source-signal=ST_CAN4_PSEAT_Mode, target-signal=ST_CAN2_PSEAT_Mode
      source-signal=ST_CAN4_PSEAT_heater_sta, target-signal=ST_CAN2_PSEAT_heater_sta
      source-signal=ST_CAN4_DSEAT_Error_Sta, target-signal=ST_CAN2_DSEAT_Error_Sta
      source-signal=ST_CAN4_DSEAT_heater_sta, target-signal=ST_CAN2_DSEAT_heater_sta
      source-signal=ST_CAN4_DSEAT_Mode, target-signal=ST_CAN2_DSEAT_Mode
      source-signal=ST_CAN4_PSEAT_Error_Sta, target-signal=ST_CAN2_PSEAT_Error_Sta
      source-signal=ST_CAN4_PTG_Active_Sta, target-signal=ST_CAN2_PTG_Active_Sta
      source-signal=ST_CAN4_PTG_Sys_Sta, target-signal=ST_CAN2_PTG_Sys_Sta
      source-signal=ST_CAN4_PTG_Exist, target-signal=ST_CAN2_PTG_Exist
      source-signal=ST_CAN4_PTG_AutoStaus, target-signal=ST_CAN2_PTG_AutoStaus
      source-signal=ST_CAN4_PTG_Is_Set_Height, target-signal=ST_CAN2_PTG_Is_Set_Height
      source-signal=ST_CAN3_HVBPwrAvailChrg60, target-signal=ST_CAN2_HVBPwrAvailChrg60
      source-signal=ST_CAN3_HVBPwrAvailChrg, target-signal=ST_CAN2_HVBPwrAvailChrg
      source-signal=ST_CAN3_HVBPwrAvailChrg30, target-signal=ST_CAN2_HVBPwrAvailChrg30
      source-signal=ST_CAN3_MCU_B_R_RealPwrKw_Sta, target-signal=ST_CAN2_MCU_B_R_RealPwrKw_Sta
      source-signal=ST_CAN3_MCU_B_F_RealPwrKw_Sta, target-signal=ST_CAN2_MCU_B_F_RealPwrKw_Sta
      source-signal=ST_CAN3_HVBSOH, target-signal=ST_CAN2_HVBSOH
      source-signal=ST_CAN3_HVBFullChrgPwr, target-signal=ST_CAN2_HVBFullChrgPwr
      source-signal=ST_CAN3_HVBattCurr, target-signal=ST_CAN2_HVBattCurr
      source-signal=ST_CAN3_HVBattVolt, target-signal=ST_CAN2_HVBattVolt
      source-signal=ST_CAN3_DCDCAuxCur, target-signal=ST_CAN2_DCDCAuxCur
      source-signal=ST_CAN3_DCDCAuxVolt, target-signal=ST_CAN2_DCDCAuxVolt
      source-signal=ST_CAN3_EBMRLampSta, target-signal=ST_CAN2_EBMRLampSta
      source-signal=ST_CAN3_EBMErrSta, target-signal=ST_CAN2_EBMErrSta
      source-signal=ST_CAN3_HVBattErr, target-signal=ST_CAN2_HVBattErr
      source-signal=ST_CAN3_FireDetErr, target-signal=ST_CAN2_FireDetErr
      source-signal=ST_CAN3_ChrgPlugSta, target-signal=ST_CAN2_ChrgPlugSta
      source-signal=ST_CAN3_HVBOvrTempWarn, target-signal=ST_CAN2_HVBOvrTempWarn
      source-signal=ST_CAN3_HVBChrgErr, target-signal=ST_CAN2_HVBChrgErr
      source-signal=ST_CAN3_HVBContactorSta, target-signal=ST_CAN2_HVBContactorSta
      source-signal=ST_CAN3_DisChrgPlugErr, target-signal=ST_CAN2_DisChrgPlugErr
      source-signal=ST_CAN3_HVBOvrTempErr, target-signal=ST_CAN2_HVBOvrTempErr
      source-signal=ST_CAN3_ExtChrgSta, target-signal=ST_CAN2_ExtChrgSta
      source-signal=ST_CAN3_V2LSta, target-signal=ST_CAN2_V2LSta
      source-signal=ST_CAN3_Shifter_Handle_Cmd, target-signal=ST_CAN2_Shifter_Handle_Cmd
      source-signal=ST_CAN3_Shifter_Fail_sta, target-signal=ST_CAN2_Shifter_Fail_sta
      source-signal=ST_CAN3_OBCACVoltInf, target-signal=ST_CAN2_OBCACVoltInf
      source-signal=ST_CAN3_OBCFaultSta, target-signal=ST_CAN2_OBCFaultSta
      source-signal=ST_CAN3_OBC_AC_Cur_Lim, target-signal=ST_CAN2_OBC_AC_Cur_Lim
      source-signal=ST_CAN3_OBCACCurrInf, target-signal=ST_CAN2_OBCACCurrInf
      source-signal=ST_CAN3_OBCACCSLimit, target-signal=ST_CAN2_OBCACCSLimit
      source-signal=ST_CAN3_EBMSta, target-signal=ST_CAN2_EBMSta
      source-signal=ST_CAN3_MainRlyPosSta, target-signal=ST_CAN2_MainRlyPosSta
      source-signal=ST_CAN3_MainRlyNegSta, target-signal=ST_CAN2_MainRlyNegSta
      source-signal=ST_CAN3_HVBMTempMax, target-signal=ST_CAN2_HVBMTempMax
      source-signal=ST_CAN3_Rr_MCU3_HW_Ver, target-signal=ST_CAN2_Rr_MCU3_HW_Ver
      source-signal=ST_CAN3_Rr_MCU3_SW_Ver, target-signal=ST_CAN2_Rr_MCU3_SW_Ver
      source-signal=ST_CAN3_Fr_MCU_SW_Ver, target-signal=ST_CAN2_Fr_MCU_SW_Ver
      source-signal=ST_CAN3_Fr_MCU_HW_Ver, target-signal=ST_CAN2_Fr_MCU_HW_Ver
      source-signal=ST_CAN3_HVBChrgPwr, target-signal=ST_CAN2_HVBChrgPwr
      source-signal=ST_CAN3_HVBChrgPwrTotal, target-signal=ST_CAN2_HVBChrgPwrTotal
      source-signal=ST_CAN3_ACChrgCurrDis, target-signal=ST_CAN2_ACChrgCurrDis
      source-signal=ST_CAN3_HVBDrvPwr, target-signal=ST_CAN2_HVBDrvPwr
      source-signal=ST_CAN3_RemainChrgTime, target-signal=ST_CAN2_RemainChrgTime
      source-signal=ST_CAN3_HVBattSOCDis, target-signal=ST_CAN2_HVBattSOCDis
      source-signal=ST_CAN3_HVBDrvPwrTotal, target-signal=ST_CAN2_HVBDrvPwrTotal
      source-signal=ST_CAN3_HVBattSOC, target-signal=ST_CAN2_HVBattSOC
      source-signal=ST_CAN3_Fr_MCU_SW_Ver_Nidec, target-signal=ST_CAN2_Fr_MCU_SW_Ver_Nidec
      source-signal=ST_CAN3_Fr_MCU_HW_Ver_Nidec, target-signal=ST_CAN2_Fr_MCU_HW_Ver_Nidec
      source-signal=ST_CAN3_Rr_MCU3_SW_Ver_Nidec, target-signal=ST_CAN2_Rr_MCU3_SW_Ver_Nidec
      source-signal=ST_CAN3_Rr_MCU3_HW_Ver_Nidec, target-signal=ST_CAN2_Rr_MCU3_HW_Ver_Nidec
      source-signal=ST_CAN3_Rr_MotorAvailTq, target-signal=ST_CAN2_Rr_MotorAvailTq
      source-signal=ST_CAN3_Rr_EDURealTMTq, target-signal=ST_CAN2_Rr_EDURealTMTq
      source-signal=ST_CAN3_Rr_MCUTemp, target-signal=ST_CAN2_Rr_MCUTemp
      source-signal=ST_CAN3_Rr_TMTemp, target-signal=ST_CAN2_Rr_TMTemp
      source-signal=ST_CAN3_Rr_TMSpd, target-signal=ST_CAN2_Rr_TMSpd
      source-signal=ST_CAN3_Rr_EDUDrtSta, target-signal=ST_CAN2_Rr_EDUDrtSta
      source-signal=ST_CAN3_Fr_EDURealTMTq, target-signal=ST_CAN2_Fr_EDURealTMTq
      source-signal=ST_CAN3_Fr_MotorAvailTq, target-signal=ST_CAN2_Fr_MotorAvailTq
      source-signal=ST_CAN3_Fr_MCUTemp, target-signal=ST_CAN2_Fr_MCUTemp
      source-signal=ST_CAN3_Fr_TMTemp, target-signal=ST_CAN2_Fr_TMTemp
      source-signal=ST_CAN3_Fr_EDUDrtSta, target-signal=ST_CAN2_Fr_EDUDrtSta
      source-signal=ST_CAN3_Fr_TMSpd, target-signal=ST_CAN2_Fr_TMSpd
      source-signal=ST_CAN3_MCU_B_R_LLCTempWarn_Sta, target-signal=ST_CAN2_MCU_B_R_LLCTempWarn_Sta
      source-signal=ST_CAN3_Rr_TMTempWarn, target-signal=ST_CAN2_Rr_TMTempWarn
      source-signal=ST_CAN3_Rr_MCUTempWarn, target-signal=ST_CAN2_Rr_MCUTempWarn
      source-signal=ST_CAN3_MCU_B_F_LLCTempWarn_Sta, target-signal=ST_CAN2_MCU_B_F_LLCTempWarn_Sta
      source-signal=ST_CAN3_Fr_TMTempWarn, target-signal=ST_CAN2_Fr_TMTempWarn
      source-signal=ST_CAN3_Fr_MCUTempWarn, target-signal=ST_CAN2_Fr_MCUTempWarn
      source-signal=ST_CAN3_Rr_MCUTemp_Nidec, target-signal=ST_CAN2_Rr_MCUTemp_Nidec
      source-signal=ST_CAN3_Rr_MotorAvailTq_Nidec, target-signal=ST_CAN2_Rr_MotorAvailTq_Nidec
      source-signal=ST_CAN3_Rr_EDUDrtSta_Nidec, target-signal=ST_CAN2_Rr_EDUDrtSta_Nidec
      source-signal=ST_CAN3_Rr_TMSpd_Nidec, target-signal=ST_CAN2_Rr_TMSpd_Nidec
      source-signal=ST_CAN3_Rr_EDURealTMTq_Nidec, target-signal=ST_CAN2_Rr_EDURealTMTq_Nidec
      source-signal=ST_CAN3_Rr_TMTemp_Nidec, target-signal=ST_CAN2_Rr_TMTemp_Nidec
      source-signal=ST_CAN3_Fr_TMSpd_Nidec, target-signal=ST_CAN2_Fr_TMSpd_Nidec
      source-signal=ST_CAN3_Fr_MCUTemp_Nidec, target-signal=ST_CAN2_Fr_MCUTemp_Nidec
      source-signal=ST_CAN3_Fr_TMTemp_Nidec, target-signal=ST_CAN2_Fr_TMTemp_Nidec
      source-signal=ST_CAN3_Fr_EDUDrtSta_Nidec, target-signal=ST_CAN2_Fr_EDUDrtSta_Nidec
      source-signal=ST_CAN3_Fr_MotorAvailTq_Nidec, target-signal=ST_CAN2_Fr_MotorAvailTq_Nidec
      source-signal=ST_CAN3_Fr_EDURealTMTq_Nidec, target-signal=ST_CAN2_Fr_EDURealTMTq_Nidec
      source-signal=ST_CAN3_Fr_TMTempWarn_Nidec, target-signal=ST_CAN2_Fr_TMTempWarn_Nidec
      source-signal=ST_CAN3_Fr_MCUTempWarn_Nidec, target-signal=ST_CAN2_Fr_MCUTempWarn_Nidec
      source-signal=ST_CAN3_Rr_TMTempWarn_Nidec, target-signal=ST_CAN2_Rr_TMTempWarn_Nidec
      source-signal=ST_CAN3_Rr_MCUTempWarn_Nidec, target-signal=ST_CAN2_Rr_MCUTempWarn_Nidec
      source-signal=ST_CAN1_ActBrkLamp_Sta, target-signal=ST_CAN2_ActBrkLamp_Sta
      source-signal=ST_CAN1_AVH_Failed, target-signal=ST_CAN2_AVH_Failed
      source-signal=ST_CAN1_ESC_OFF_Status, target-signal=ST_CAN2_ESC_OFF_Status
      source-signal=ST_CAN1_PBA_Active, target-signal=ST_CAN2_PBA_Active
      source-signal=ST_CAN1_PBA_Failed, target-signal=ST_CAN2_PBA_Failed
      source-signal=ST_CAN1_Amber_WnlmpSta, target-signal=ST_CAN2_Amber_WnlmpSta
      source-signal=ST_CAN1_LR_PulseCount_V, target-signal=ST_CAN2_LR_PulseCount_V
      source-signal=ST_CAN1_HBB_Failed, target-signal=ST_CAN2_HBB_Failed
      source-signal=ST_CAN1_BTCS_Active, target-signal=ST_CAN2_BTCS_Active
      source-signal=ST_CAN1_ESS_Active, target-signal=ST_CAN2_ESS_Active
      source-signal=ST_CAN1_LF_PulseCount_V, target-signal=ST_CAN2_LF_PulseCount_V
      source-signal=ST_CAN1_HSA_Failed, target-signal=ST_CAN2_HSA_Failed
      source-signal=ST_CAN1_RF_PulseCount, target-signal=ST_CAN2_RF_PulseCount
      source-signal=ST_CAN1_TCS_Failed, target-signal=ST_CAN2_TCS_Failed
      source-signal=ST_CAN1_ABS_Failed, target-signal=ST_CAN2_ABS_Failed
      source-signal=ST_CAN1_LR_WhlRotDir, target-signal=ST_CAN2_LR_WhlRotDir
      source-signal=ST_CAN1_ESC_WnlmpSta, target-signal=ST_CAN2_ESC_WnlmpSta
      source-signal=ST_CAN1_Red_WnlmpSta, target-signal=ST_CAN2_Red_WnlmpSta
      source-signal=ST_CAN1_LF_WhlRotDir, target-signal=ST_CAN2_LF_WhlRotDir
      source-signal=ST_CAN1_ESC_Off_lmpSta, target-signal=ST_CAN2_ESC_Off_lmpSta
      source-signal=ST_CAN1_HDD_Failed, target-signal=ST_CAN2_HDD_Failed
      source-signal=ST_CAN1_RF_WhlRotDir, target-signal=ST_CAN2_RF_WhlRotDir
      source-signal=ST_CAN1_ABS_WnlmpSta, target-signal=ST_CAN2_ABS_WnlmpSta
      source-signal=ST_CAN1_LF_PulseCount, target-signal=ST_CAN2_LF_PulseCount
      source-signal=ST_CAN1_AVH_Active, target-signal=ST_CAN2_AVH_Active
      source-signal=ST_CAN1_ESC_Failed, target-signal=ST_CAN2_ESC_Failed
      source-signal=ST_CAN1_HDD_Active, target-signal=ST_CAN2_HDD_Active
      source-signal=ST_CAN1_RR_PulseCount, target-signal=ST_CAN2_RR_PulseCount
      source-signal=ST_CAN1_RR_PulseCount_V, target-signal=ST_CAN2_RR_PulseCount_V
      source-signal=ST_CAN1_LR_PulseCount, target-signal=ST_CAN2_LR_PulseCount
      source-signal=ST_CAN1_ESC_BeepReq, target-signal=ST_CAN2_ESC_BeepReq
      source-signal=ST_CAN1_ABS_Active, target-signal=ST_CAN2_ABS_Active
      source-signal=ST_CAN1_HBB_Active, target-signal=ST_CAN2_HBB_Active
      source-signal=ST_CAN1_HSA_Active, target-signal=ST_CAN2_HSA_Active
      source-signal=ST_CAN1_RF_PulseCount_V, target-signal=ST_CAN2_RF_PulseCount_V
      source-signal=ST_CAN1_VehSpeed, target-signal=ST_CAN2_VehSpeed
      source-signal=ST_CAN1_RR_WhlRotDir, target-signal=ST_CAN2_RR_WhlRotDir
      source-signal=ST_CAN1_EBD_Failed, target-signal=ST_CAN2_EBD_Failed
      source-signal=ST_CAN1_eBST_RedWnlmpSta, target-signal=ST_CAN2_eBST_RedWnlmpSta
      source-signal=ST_CAN1_eBST_BeepReq, target-signal=ST_CAN2_eBST_BeepReq
      source-signal=ST_CAN1_LowBrakeFluid_Sta, target-signal=ST_CAN2_LowBrakeFluid_Sta
      source-signal=ST_CAN1_eBST_AmberWnlmpSta, target-signal=ST_CAN2_eBST_AmberWnlmpSta
      source-signal=ST_CAN1_SAS_Angle, target-signal=ST_CAN2_SAS_Angle
      source-signal=ST_CAN1_EpasFailed, target-signal=ST_CAN2_EpasFailed
      source-signal=ST_CAN1_SAS_V, target-signal=ST_CAN2_SAS_V
      source-signal=ST_CAN1_BrkSw_Sta, target-signal=ST_CAN2_BrkSw_Sta
      source-signal=ST_CAN1_BrkSw_V, target-signal=ST_CAN2_BrkSw_V
      source-signal=ST_CAN1_Meter_Ind_VehSpeed, target-signal=ST_CAN2_Meter_Ind_VehSpeed
      source-signal=ST_CAN1_AEBAvail, target-signal=ST_CAN2_AEBAvail
      source-signal=ST_CAN1_ESC_ADAS_Sta, target-signal=ST_CAN2_ESC_ADAS_Sta
      source-signal=ST_CAN1_BrkDiscTempSta, target-signal=ST_CAN2_BrkDiscTempSta
      source-signal=ST_CAN1_DriverSeatBeltCmd, target-signal=ST_CAN2_DriverSeatBeltCmd
      source-signal=ST_CAN1_RDriverSeatBeltCmd, target-signal=ST_CAN2_RDriverSeatBeltCmd
      source-signal=ST_CAN1_ABM_Passenger_ODS_Sta, target-signal=ST_CAN2_ABM_Passenger_ODS_Sta
      source-signal=ST_CAN1_AirBagFailCmd, target-signal=ST_CAN2_AirBagFailCmd
      source-signal=ST_CAN1_ABM_RearPassengerRH_ODS_Sta, target-signal=ST_CAN2_ABM_RearPassengerRH_ODS_Sta
      source-signal=ST_CAN1_ABM_RearPassengerCTR_ODS_Sta, target-signal=ST_CAN2_ABM_RearPassengerCTR_ODS_Sta
      source-signal=ST_CAN1_PsngrSeatBeltCmd, target-signal=ST_CAN2_PsngrSeatBeltCmd
      source-signal=ST_CAN1_PABSwitchCmd, target-signal=ST_CAN2_PABSwitchCmd
      source-signal=ST_CAN1_TRHPsngrSeatBeltCmd, target-signal=ST_CAN2_TRHPsngrSeatBeltCmd
      source-signal=ST_CAN1_RPsngrSeatBeltCmd, target-signal=ST_CAN2_RPsngrSeatBeltCmd
      source-signal=ST_CAN1_TLHPsngrSeatBeltCmd, target-signal=ST_CAN2_TLHPsngrSeatBeltCmd
      source-signal=ST_CAN1_CrashOutputSts, target-signal=ST_CAN2_CrashOutputSts
      source-signal=ST_CAN1_RCenterSeatBeltCmd, target-signal=ST_CAN2_RCenterSeatBeltCmd
      source-signal=ST_CAN1_ABM_RearPassengerLH_ODS_Sta, target-signal=ST_CAN2_ABM_RearPassengerLH_ODS_Sta
      source-signal=ST_CAN5_ReserveChargeOFF_Minute, target-signal=ST_CAN3_ReserveChargeOFF_Minute
      source-signal=ST_CAN5_ReserveChargeOFF_Year, target-signal=ST_CAN3_ReserveChargeOFF_Year
      source-signal=ST_CAN5_Charge_Percent_Set, target-signal=ST_CAN3_Charge_Percent_Set
      source-signal=ST_CAN5_ReserveChargeOn_Year, target-signal=ST_CAN3_ReserveChargeOn_Year
      source-signal=ST_CAN5_ReserveChargeOn_Month, target-signal=ST_CAN3_ReserveChargeOn_Month
      source-signal=ST_CAN5_ReserveChargeOn_Hour, target-signal=ST_CAN3_ReserveChargeOn_Hour
      source-signal=ST_CAN5_ReserveChargeOn_Minute, target-signal=ST_CAN3_ReserveChargeOn_Minute
      source-signal=ST_CAN5_ReserveChargeOFF_Month, target-signal=ST_CAN3_ReserveChargeOFF_Month
      source-signal=ST_CAN5_ReserveChargeOn_Day, target-signal=ST_CAN3_ReserveChargeOn_Day
      source-signal=ST_CAN5_ReserveChargeOFF_Day, target-signal=ST_CAN3_ReserveChargeOFF_Day
      source-signal=ST_CAN5_ReserveChargeOFF_Hour, target-signal=ST_CAN3_ReserveChargeOFF_Hour
      source-signal=ST_CAN4_FrntPTCLeActHeatPwr, target-signal=ST_CAN3_FrntPTCLeActHeatPwr
      source-signal=ST_CAN4_FrntPTCRiActHeatPwr, target-signal=ST_CAN3_FrntPTCRiActHeatPwr
      source-signal=ST_CAN4_FrntPTCRearRiActHeatPwr, target-signal=ST_CAN3_FrntPTCRearRiActHeatPwr
      source-signal=ST_CAN4_FrntPTCRearLeActHeatPwr, target-signal=ST_CAN3_FrntPTCRearLeActHeatPwr
      source-signal=ST_CAN4_COMP_ConVolt, target-signal=ST_CAN3_COMP_ConVolt
      source-signal=ST_CAN4_COMP_ActualPwr, target-signal=ST_CAN3_COMP_ActualPwr
      source-signal=ST_CAN4_PTC1_PowerConsumption, target-signal=ST_CAN3_PTC1_PowerConsumption
      source-signal=ST_CAN4_COMP_ConCur, target-signal=ST_CAN3_COMP_ConCur
      source-signal=ST_CAN4_ChargeInletLockSta, target-signal=ST_CAN3_ChargeInletLockSta
      source-signal=ST_CAN2_IVI_Time_Second, target-signal=ST_CAN3_IVI_Time_Second
      source-signal=ST_CAN2_IVI_Time_Month, target-signal=ST_CAN3_IVI_Time_Month
      source-signal=ST_CAN2_IVI_Time_Hour, target-signal=ST_CAN3_IVI_Time_Hour
      source-signal=ST_CAN2_IVI_Time_Day, target-signal=ST_CAN3_IVI_Time_Day
      source-signal=ST_CAN2_IVI_Time_Minute, target-signal=ST_CAN3_IVI_Time_Minute
      source-signal=ST_CAN2_Sched_Chg_limit, target-signal=ST_CAN3_Sched_Chg_limit
      source-signal=ST_CAN2_SOC_ADJ_BUTT, target-signal=ST_CAN3_SOC_ADJ_BUTT
      source-signal=ST_CAN2_SOC_Limit_Set, target-signal=ST_CAN3_SOC_Limit_Set
      source-signal=ST_CAN2_Sched_Chg_Start, target-signal=ST_CAN3_Sched_Chg_Start
      source-signal=ST_CAN2_SOC_V2LLimit, target-signal=ST_CAN3_SOC_V2LLimit
      source-signal=ST_CAN2_Perd_V2L, target-signal=ST_CAN3_Perd_V2L
      source-signal=ST_CAN2_IVI_Unlock_Chg_req, target-signal=ST_CAN3_IVI_Unlock_Chg_req
      source-signal=ST_CAN2_Sched_Chg_Stop, target-signal=ST_CAN3_Sched_Chg_Stop
      source-signal=ST_CAN2_AC_Chg_Cur_Set, target-signal=ST_CAN3_AC_Chg_Cur_Set
      source-signal=ST_CAN2_Sched_Chg_butt, target-signal=ST_CAN3_Sched_Chg_butt
      source-signal=ST_CAN2_IVI_Req_V2L, target-signal=ST_CAN3_IVI_Req_V2L
      source-signal=ST_CAN2_IVI_Stop_Chg_req, target-signal=ST_CAN3_IVI_Stop_Chg_req
      source-signal=ST_CAN2_IVI_Start_Chg_req, target-signal=ST_CAN3_IVI_Start_Chg_req
      source-signal=ST_CAN1_VehSpeed, target-signal=ST_CAN3_VehSpeed
      source-signal=ST_CAN1_DriverSeatBeltCmd, target-signal=ST_CAN3_DriverSeatBeltCmd
      source-signal=ST_CAN1_CrashOutputSts, target-signal=ST_CAN3_CrashOutputSts
      source-signal=ST_CAN5_TBOX_Remote_PW, target-signal=ST_CAN4_TBOX_Remote_PW
      source-signal=ST_CAN3_ChrgPlugSta, target-signal=ST_CAN4_ChrgPlugSta
      source-signal=ST_CAN3_ExtChrgSta, target-signal=ST_CAN4_ExtChrgSta
      source-signal=ST_CAN3_BMS_Warn_4, target-signal=ST_CAN4_BMS_Warn_4
      source-signal=ST_CAN3_BMS_Warn_5, target-signal=ST_CAN4_BMS_Warn_5
      source-signal=ST_CAN3_V2LSta, target-signal=ST_CAN4_V2LSta
      source-signal=ST_CAN3_ChrgInLockReq, target-signal=ST_CAN4_ChrgInLockReq
      source-signal=ST_CAN3_OBCV2LSta, target-signal=ST_CAN4_OBCV2LSta
      source-signal=ST_CAN2_METER_KPH_Calcu, target-signal=ST_CAN4_METER_KPH_Calcu
      source-signal=ST_CAN2_IVI_DSEAT_StopKeepMove_Sta, target-signal=ST_CAN4_IVI_DSEAT_StopKeepMove_Sta
      source-signal=ST_CAN2_IVI_Time_Second, target-signal=ST_CAN4_IVI_Time_Second
      source-signal=ST_CAN2_IVI_DSEAT_anti_set_Sta, target-signal=ST_CAN4_IVI_DSEAT_anti_set_Sta
      source-signal=ST_CAN2_IVI_Time_Month, target-signal=ST_CAN4_IVI_Time_Month
      source-signal=ST_CAN2_IVI_DSEAT_entryfun_set_Sta, target-signal=ST_CAN4_IVI_DSEAT_entryfun_set_Sta
      source-signal=ST_CAN2_IVI_Time_Check, target-signal=ST_CAN4_IVI_Time_Check
      source-signal=ST_CAN2_IVI_Time_Hour, target-signal=ST_CAN4_IVI_Time_Hour
      source-signal=ST_CAN2_IVI_Located_STA, target-signal=ST_CAN4_IVI_Located_STA
      source-signal=ST_CAN2_SmartEco_Mode_SW, target-signal=ST_CAN4_SmartEco_Mode_SW
      source-signal=ST_CAN2_IVI_Time_Day, target-signal=ST_CAN4_IVI_Time_Day
      source-signal=ST_CAN2_IVI_Time_Minute, target-signal=ST_CAN4_IVI_Time_Minute
      source-signal=ST_CAN2_IVI_Time_Year, target-signal=ST_CAN4_IVI_Time_Year
      source-signal=ST_CAN2_HMI_PSEAT_LevelDown_Cmd, target-signal=ST_CAN4_HMI_PSEAT_LevelDown_Cmd
      source-signal=ST_CAN2_HMI_PSEAT_LevelUp_Cmd, target-signal=ST_CAN4_HMI_PSEAT_LevelUp_Cmd
      source-signal=ST_CAN2_HMI_DSEAT_LevelUp_Cmd, target-signal=ST_CAN4_HMI_DSEAT_LevelUp_Cmd
      source-signal=ST_CAN2_HMI_DSEAT_LevelDown_Cmd, target-signal=ST_CAN4_HMI_DSEAT_LevelDown_Cmd
      source-signal=ST_CAN2_IVI_PSEATHeater_Cmd, target-signal=ST_CAN4_IVI_PSEATHeater_Cmd
      source-signal=ST_CAN2_AVM_parking_excute, target-signal=ST_CAN4_AVM_parking_excute
      source-signal=ST_CAN2_IVI_PTG_Sta_SW, target-signal=ST_CAN4_IVI_PTG_Sta_SW
      source-signal=ST_CAN2_IVI_PTG_Mode_SW, target-signal=ST_CAN4_IVI_PTG_Mode_SW
      source-signal=ST_CAN2_IVI_DSEAT_Height_Cmd, target-signal=ST_CAN4_IVI_DSEAT_Height_Cmd
      source-signal=ST_CAN2_Walkaway_Lock_SW, target-signal=ST_CAN4_Walkaway_Lock_SW
      source-signal=ST_CAN2_Approach_Unlock_SW, target-signal=ST_CAN4_Approach_Unlock_SW
      source-signal=ST_CAN2_IVI_TrailerModeSW_Sta, target-signal=ST_CAN4_IVI_TrailerModeSW_Sta
      source-signal=ST_CAN2_IVI_DSEAT_Slide_Cmd, target-signal=ST_CAN4_IVI_DSEAT_Slide_Cmd
      source-signal=ST_CAN2_OFF_AC_MODE, target-signal=ST_CAN4_OFF_AC_MODE
      source-signal=ST_CAN2_IVI_CarWash_Mode_Cmd, target-signal=ST_CAN4_IVI_CarWash_Mode_Cmd
      source-signal=ST_CAN2_IVI_DSEATHeater_Cmd, target-signal=ST_CAN4_IVI_DSEATHeater_Cmd
      source-signal=ST_CAN2_IVI_PTG_Open_Height, target-signal=ST_CAN4_IVI_PTG_Open_Height
      source-signal=ST_CAN2_IVI_DSEAT_Recline_Cmd, target-signal=ST_CAN4_IVI_DSEAT_Recline_Cmd
      source-signal=ST_CAN2_IVI_PSEAT_Recline_Cmd, target-signal=ST_CAN4_IVI_PSEAT_Recline_Cmd
      source-signal=ST_CAN2_IVI_PSEAT_Slide_Cmd, target-signal=ST_CAN4_IVI_PSEAT_Slide_Cmd
      source-signal=ST_CAN2_DSEAT_entryfun_set, target-signal=ST_CAN4_DSEAT_entryfun_set
      source-signal=ST_CAN2_IVI_ChargePortSW_Sta, target-signal=ST_CAN4_IVI_ChargePortSW_Sta
      source-signal=ST_CAN2_IVI_DSEAT_Memory_OPTCLS_Sta, target-signal=ST_CAN4_IVI_DSEAT_Memory_OPTCLS_Sta
      source-signal=ST_CAN2_IVI_DSEAT_Memory1_Sta, target-signal=ST_CAN4_IVI_DSEAT_Memory1_Sta
      source-signal=ST_CAN2_Distance_unit, target-signal=ST_CAN4_Distance_unit
      source-signal=ST_CAN2_IVI_DSEAT_FroEdge_Height_Cmd, target-signal=ST_CAN4_IVI_DSEAT_FroEdge_Height_Cmd
      source-signal=ST_CAN2_HeadLampSW, target-signal=ST_CAN4_HeadLampSW
      source-signal=ST_CAN2_Light_ShowStop_Req, target-signal=ST_CAN4_Light_ShowStop_Req
      source-signal=ST_CAN2_PSEAT_vent_req, target-signal=ST_CAN4_PSEAT_vent_req
      source-signal=ST_CAN2_WlcmLight_Mode, target-signal=ST_CAN4_WlcmLight_Mode
      source-signal=ST_CAN2_Light_ShowStart_Req, target-signal=ST_CAN4_Light_ShowStart_Req
      source-signal=ST_CAN2_DSEAT_anti_set, target-signal=ST_CAN4_DSEAT_anti_set
      source-signal=ST_CAN2_Hood_Latch_SW, target-signal=ST_CAN4_Hood_Latch_SW
      source-signal=ST_CAN2_IVI_DSEAT_Memory2_Sta, target-signal=ST_CAN4_IVI_DSEAT_Memory2_Sta
      source-signal=ST_CAN2_IVI_TrailerCheckReq_Sta, target-signal=ST_CAN4_IVI_TrailerCheckReq_Sta
      source-signal=ST_CAN2_IVI_ISA_OffsetSpd, target-signal=ST_CAN4_IVI_ISA_OffsetSpd
      source-signal=ST_CAN2_DSEAT_vent_req, target-signal=ST_CAN4_DSEAT_vent_req
      source-signal=ST_CAN2_IVI_PSDManualPower_Sta, target-signal=ST_CAN4_IVI_PSDManualPower_Sta
      source-signal=ST_CAN2_IVI_MLFMost_Cmd, target-signal=ST_CAN4_IVI_MLFMost_Cmd
      source-signal=ST_CAN2_IVI_MRSEATvent_Cmd, target-signal=ST_CAN4_IVI_MRSEATvent_Cmd
      source-signal=ST_CAN2_IVI_MLSEATvent_Cmd, target-signal=ST_CAN4_IVI_MLSEATvent_Cmd
      source-signal=ST_CAN2_IVI_MLSlider_Cmd, target-signal=ST_CAN4_IVI_MLSlider_Cmd
      source-signal=ST_CAN2_IVI_MRZeroGravity_Cmd, target-signal=ST_CAN4_IVI_MRZeroGravity_Cmd
      source-signal=ST_CAN2_IVI_RSEATvent_Cmd, target-signal=ST_CAN4_IVI_RSEATvent_Cmd
      source-signal=ST_CAN2_IVI_MLZeroGravity_Cmd, target-signal=ST_CAN4_IVI_MLZeroGravity_Cmd
      source-signal=ST_CAN2_IVI_MRNapMode_Cmd, target-signal=ST_CAN4_IVI_MRNapMode_Cmd
      source-signal=ST_CAN2_IVI_LSEATvent_Cmd, target-signal=ST_CAN4_IVI_LSEATvent_Cmd
      source-signal=ST_CAN2_IVI_MRFMost_Cmd, target-signal=ST_CAN4_IVI_MRFMost_Cmd
      source-signal=ST_CAN2_IVI_MLRestore_Cmd, target-signal=ST_CAN4_IVI_MLRestore_Cmd
      source-signal=ST_CAN2_IVI_MRRecliner_Cmd, target-signal=ST_CAN4_IVI_MRRecliner_Cmd
      source-signal=ST_CAN2_IVI_MLRecliner_Cmd, target-signal=ST_CAN4_IVI_MLRecliner_Cmd
      source-signal=ST_CAN2_IVI_MRSldRestore_Cmd, target-signal=ST_CAN4_IVI_MRSldRestore_Cmd
      source-signal=ST_CAN2_IVI_MRFootLift_Cmd, target-signal=ST_CAN4_IVI_MRFootLift_Cmd
      source-signal=ST_CAN2_IVI_MRSlider_Cmd, target-signal=ST_CAN4_IVI_MRSlider_Cmd
      source-signal=ST_CAN2_IVI_MLFootLift_Cmd, target-signal=ST_CAN4_IVI_MLFootLift_Cmd
      source-signal=ST_CAN2_IVI_MRRestore_Cmd, target-signal=ST_CAN4_IVI_MRRestore_Cmd
      source-signal=ST_CAN2_IVI_MLNapMode_Cmd, target-signal=ST_CAN4_IVI_MLNapMode_Cmd
      source-signal=ST_CAN2_IVI_MLSldRestore_Cmd, target-signal=ST_CAN4_IVI_MLSldRestore_Cmd
      source-signal=ST_CAN2_IVI_MRSeatLift_Cmd, target-signal=ST_CAN4_IVI_MRSeatLift_Cmd
      source-signal=ST_CAN2_IVI_MLSeatLift_Cmd, target-signal=ST_CAN4_IVI_MLSeatLift_Cmd
      source-signal=ST_CAN1_VehSpeed, target-signal=ST_CAN4_VehSpeed
      source-signal=ST_CAN1_BrkSw_Sta, target-signal=ST_CAN4_BrkSw_Sta
      source-signal=ST_CAN1_BrkPedalPos_Sta, target-signal=ST_CAN4_BrkPedalPos_Sta
      source-signal=ST_CAN1_MCPressure, target-signal=ST_CAN4_MCPressure
      source-signal=ST_CAN1_BrkPedalPos, target-signal=ST_CAN4_BrkPedalPos
      source-signal=ST_CAN1_BrkSw_V, target-signal=ST_CAN4_BrkSw_V
      source-signal=ST_CAN1_MCPressure_V, target-signal=ST_CAN4_MCPressure_V
      source-signal=ST_CAN4_L_RRD_Wdw_PositionSts, target-signal=ST_CAN5_L_RRD_Wdw_PositionSts
      source-signal=ST_CAN4_L_RLD_Wdw_PositionSts, target-signal=ST_CAN5_L_RLD_Wdw_PositionSts
      source-signal=ST_CAN4_L_Pas_Wdw_PositionSts, target-signal=ST_CAN5_L_Pas_Wdw_PositionSts
      source-signal=ST_CAN4_L_Pas_Val_Wdw_Opened, target-signal=ST_CAN5_L_Pas_Val_Wdw_Opened
      source-signal=ST_CAN4_L_Drv_Val_Wdw_Opened, target-signal=ST_CAN5_L_Drv_Val_Wdw_Opened
      source-signal=ST_CAN4_L_Drv_Wdw_PositionSts, target-signal=ST_CAN5_L_Drv_Wdw_PositionSts
      source-signal=ST_CAN4_L_RLD_Val_Wdw_Opened, target-signal=ST_CAN5_L_RLD_Val_Wdw_Opened
      source-signal=ST_CAN4_L_RRD_Val_Wdw_Opened, target-signal=ST_CAN5_L_RRD_Val_Wdw_Opened
      source-signal=ST_CAN4_BP_PTG_Active_Sta, target-signal=ST_CAN5_BP_PTG_Active_Sta
      source-signal=ST_CAN4_BP_PTG_Exist_Sta, target-signal=ST_CAN5_BP_PTG_Exist_Sta
      source-signal=ST_CAN4_BP_PTG_Sys_Sta, target-signal=ST_CAN5_BP_PTG_Sys_Sta
      source-signal=ST_CAN4_PTG_Active_Sta, target-signal=ST_CAN5_PTG_Active_Sta
      source-signal=ST_CAN4_PTG_Sys_Sta, target-signal=ST_CAN5_PTG_Sys_Sta
      source-signal=ST_CAN4_PTG_Exist, target-signal=ST_CAN5_PTG_Exist
      source-signal=ST_CAN1_VehSpeed, target-signal=ST_CAN5_VehSpeed
      source-signal=ST_CAN1_BrkSw_Sta, target-signal=ST_CAN5_BrkSw_Sta
      source-signal=ST_CAN1_CrashOutputSts, target-signal=ST_CAN5_CrashOutputSts
      source-signal=ST_CAN4_SWC_LKA_Sta, target-signal=ST_CAN6_SWC_LKA_Sta
      source-signal=ST_CAN4_SWC2_L_ScrollDown_Sta, target-signal=ST_CAN6_SWC2_L_ScrollDown_Sta
      source-signal=ST_CAN4_SWC2_L_DriveMode_Sta, target-signal=ST_CAN6_SWC2_L_DriveMode_Sta
      source-signal=ST_CAN4_SWC_ACC_Sta, target-signal=ST_CAN6_SWC_ACC_Sta
      source-signal=ST_CAN4_SWC2_L_ScrollPress_Sta, target-signal=ST_CAN6_SWC2_L_ScrollPress_Sta
      source-signal=ST_CAN4_SWC2_L_ScrollUp_Sta, target-signal=ST_CAN6_SWC2_L_ScrollUp_Sta
      source-signal=ST_CAN4_SWC2_L_ADAS_Sta, target-signal=ST_CAN6_SWC2_L_ADAS_Sta
      source-signal=ST_CAN4_SWC2_R_Customize_Sta, target-signal=ST_CAN6_SWC2_R_Customize_Sta
      source-signal=ST_CAN4_SWC_Set_down_Sta, target-signal=ST_CAN6_SWC_Set_down_Sta
      source-signal=ST_CAN4_SWC_Distance_Sta, target-signal=ST_CAN6_SWC_Distance_Sta
      source-signal=ST_CAN4_SWC_Res_Up_Sta, target-signal=ST_CAN6_SWC_Res_Up_Sta
      source-signal=ST_CAN4_SWC_CANCEL_Sta, target-signal=ST_CAN6_SWC_CANCEL_Sta
      source-signal=ST_CAN2_ODOMETER, target-signal=ST_CAN6_ODOMETER
      source-signal=ST_CAN2_IVI_Time_Second, target-signal=ST_CAN6_IVI_Time_Second
      source-signal=ST_CAN2_IVI_Time_Month, target-signal=ST_CAN6_IVI_Time_Month
      source-signal=ST_CAN2_IVI_Time_Hour, target-signal=ST_CAN6_IVI_Time_Hour
      source-signal=ST_CAN2_IVI_Time_Day, target-signal=ST_CAN6_IVI_Time_Day
      source-signal=ST_CAN2_IVI_Time_Minute, target-signal=ST_CAN6_IVI_Time_Minute
      source-signal=ST_CAN1_VehSpeed, target-signal=ST_CAN7_VehSpeed
