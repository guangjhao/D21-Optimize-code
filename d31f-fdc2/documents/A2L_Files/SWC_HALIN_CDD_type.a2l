/******************************************************************************
* ASAP2 file: SWC_HALIN_CDD_type.a2l
* Code generation for model "SWC_HALIN_CDD_type".
* Model version : 1.12
* Simulink Coder version : 9.6 (R2021b) 14-May-2021
* C source code generated on : Tue Jun 10 11:19:09 2025
* Target selection: autosar.tlc
* Embedded hardware selection: ARM Compatible->ARM Cortex-M
* Code generation objectives: Unspecified
* Validation result: Not run
* (add additional file header information here)
******************************************************************************/ ASAP2_VERSION 1 31
/* Version 1.31 */
/begin PROJECT ProjectName "Project Comment Goes Here"
/begin HEADER "Header Comments go here" /end HEADER
/begin MODULE ModuleName "Module Comment Goes Here"
/begin MOD_PAR "MOD PAR Comment Goes Here" /end MOD_PAR
/begin MOD_COMMON "Mod Common Comment Here" BYTE_ORDER MSB_LAST /end MOD_COMMON
/begin RECORD_LAYOUT Scalar_BOOLEAN FNC_VALUES 1 UBYTE COLUMN_DIR DIRECT /end RECORD_LAYOUT
/begin RECORD_LAYOUT Scalar_UBYTE FNC_VALUES 1 UBYTE COLUMN_DIR DIRECT /end RECORD_LAYOUT
/begin RECORD_LAYOUT Scalar_BYTE FNC_VALUES 1 SBYTE COLUMN_DIR DIRECT /end RECORD_LAYOUT
/begin RECORD_LAYOUT Scalar_UWORD FNC_VALUES 1 UWORD COLUMN_DIR DIRECT /end RECORD_LAYOUT
/begin RECORD_LAYOUT Scalar_SWORD FNC_VALUES 1 SWORD COLUMN_DIR DIRECT /end RECORD_LAYOUT
/begin RECORD_LAYOUT Scalar_ULONG FNC_VALUES 1 ULONG COLUMN_DIR DIRECT /end RECORD_LAYOUT
/begin RECORD_LAYOUT Scalar_LONG FNC_VALUES 1 SLONG COLUMN_DIR DIRECT /end RECORD_LAYOUT
/begin RECORD_LAYOUT Scalar_FLOAT32_IEEE FNC_VALUES 1 FLOAT32_IEEE COLUMN_DIR DIRECT /end RECORD_LAYOUT
/begin RECORD_LAYOUT Scalar_FLOAT64_IEEE FNC_VALUES 1 FLOAT64_IEEE COLUMN_DIR DIRECT /end RECORD_LAYOUT
/begin RECORD_LAYOUT Lookup1D_BOOLEAN FNC_VALUES 1 UBYTE COLUMN_DIR DIRECT /end RECORD_LAYOUT
/begin RECORD_LAYOUT Lookup1D_X_BOOLEAN AXIS_PTS_X 1 UBYTE INDEX_INCR DIRECT /end RECORD_LAYOUT
/begin RECORD_LAYOUT Lookup1D_BYTE FNC_VALUES 1 SBYTE COLUMN_DIR DIRECT /end RECORD_LAYOUT
/begin RECORD_LAYOUT Lookup1D_X_BYTE AXIS_PTS_X 1 SBYTE INDEX_INCR DIRECT /end RECORD_LAYOUT
/begin RECORD_LAYOUT Lookup1D_UBYTE FNC_VALUES 1 UBYTE COLUMN_DIR DIRECT /end RECORD_LAYOUT
/begin RECORD_LAYOUT Lookup1D_X_UBYTE AXIS_PTS_X 1 UBYTE INDEX_INCR DIRECT /end RECORD_LAYOUT
/begin RECORD_LAYOUT Lookup1D_UWORD FNC_VALUES 1 UWORD COLUMN_DIR DIRECT /end RECORD_LAYOUT
/begin RECORD_LAYOUT Lookup1D_X_UWORD AXIS_PTS_X 1 UWORD INDEX_INCR DIRECT /end RECORD_LAYOUT
/begin RECORD_LAYOUT Lookup1D_WORD FNC_VALUES 1 SWORD COLUMN_DIR DIRECT /end RECORD_LAYOUT
/begin RECORD_LAYOUT Lookup1D_X_WORD AXIS_PTS_X 1 SWORD INDEX_INCR DIRECT /end RECORD_LAYOUT
/begin RECORD_LAYOUT Lookup1D_ULONG FNC_VALUES 1 ULONG COLUMN_DIR DIRECT /end RECORD_LAYOUT
/begin RECORD_LAYOUT Lookup1D_X_ULONG AXIS_PTS_X 1 ULONG INDEX_INCR DIRECT /end RECORD_LAYOUT
/begin RECORD_LAYOUT Lookup1D_SLONG FNC_VALUES 1 SLONG COLUMN_DIR DIRECT /end RECORD_LAYOUT
/begin RECORD_LAYOUT Lookup1D_X_LONG AXIS_PTS_X 1 SLONG INDEX_INCR DIRECT /end RECORD_LAYOUT
/begin RECORD_LAYOUT Lookup1D_FLOAT32_IEEE FNC_VALUES 1 FLOAT32_IEEE COLUMN_DIR DIRECT /end RECORD_LAYOUT
/begin RECORD_LAYOUT Lookup1D_X_FLOAT32_IEEE AXIS_PTS_X 1 FLOAT32_IEEE INDEX_INCR DIRECT /end RECORD_LAYOUT
/begin RECORD_LAYOUT Lookup1D_FLOAT64_IEEE FNC_VALUES 1 FLOAT64_IEEE COLUMN_DIR DIRECT /end RECORD_LAYOUT
/begin RECORD_LAYOUT Lookup1D_X_FLOAT64_IEEE AXIS_PTS_X 1 FLOAT64_IEEE INDEX_INCR DIRECT /end RECORD_LAYOUT
/begin RECORD_LAYOUT Lookup2D_BOOLEAN FNC_VALUES 1 UBYTE COLUMN_DIR DIRECT /end RECORD_LAYOUT
/begin RECORD_LAYOUT Lookup2D_X_BOOLEAN AXIS_PTS_X 1 UBYTE INDEX_INCR DIRECT /end RECORD_LAYOUT
/begin RECORD_LAYOUT Lookup2D_UBYTE FNC_VALUES 1 UBYTE COLUMN_DIR DIRECT /end RECORD_LAYOUT
/begin RECORD_LAYOUT Lookup2D_X_UBYTE AXIS_PTS_X 1 UBYTE INDEX_INCR DIRECT /end RECORD_LAYOUT
/begin RECORD_LAYOUT Lookup2D_BYTE FNC_VALUES 1 SBYTE COLUMN_DIR DIRECT /end RECORD_LAYOUT
/begin RECORD_LAYOUT Lookup2D_X_BYTE AXIS_PTS_X 1 SBYTE INDEX_INCR DIRECT /end RECORD_LAYOUT
/begin RECORD_LAYOUT Lookup2D_UWORD FNC_VALUES 1 UWORD COLUMN_DIR DIRECT /end RECORD_LAYOUT
/begin RECORD_LAYOUT Lookup2D_X_UWORD AXIS_PTS_X 1 UWORD INDEX_INCR DIRECT /end RECORD_LAYOUT
/begin RECORD_LAYOUT Lookup2D_WORD FNC_VALUES 1 SWORD COLUMN_DIR DIRECT /end RECORD_LAYOUT
/begin RECORD_LAYOUT Lookup2D_X_WORD AXIS_PTS_X 1 SWORD INDEX_INCR DIRECT /end RECORD_LAYOUT
/begin RECORD_LAYOUT Lookup2D_ULONG FNC_VALUES 1 ULONG COLUMN_DIR DIRECT /end RECORD_LAYOUT
/begin RECORD_LAYOUT Lookup2D_X_ULONG AXIS_PTS_X 1 ULONG INDEX_INCR DIRECT /end RECORD_LAYOUT
/begin RECORD_LAYOUT Lookup2D_LONG FNC_VALUES 1 SLONG COLUMN_DIR DIRECT /end RECORD_LAYOUT
/begin RECORD_LAYOUT Lookup2D_X_LONG AXIS_PTS_X 1 SLONG INDEX_INCR DIRECT /end RECORD_LAYOUT
/begin RECORD_LAYOUT Lookup2D_FLOAT32_IEEE FNC_VALUES 1 FLOAT32_IEEE COLUMN_DIR DIRECT /end RECORD_LAYOUT
/begin RECORD_LAYOUT Lookup2D_X_FLOAT32_IEEE AXIS_PTS_X 1 FLOAT32_IEEE INDEX_INCR DIRECT /end RECORD_LAYOUT
/begin RECORD_LAYOUT Lookup2D_FLOAT64_IEEE FNC_VALUES 1 FLOAT64_IEEE COLUMN_DIR DIRECT /end RECORD_LAYOUT
/begin RECORD_LAYOUT Lookup2D_X_FLOAT64_IEEE AXIS_PTS_X 1 FLOAT64_IEEE INDEX_INCR DIRECT /end RECORD_LAYOUT
/begin CHARACTERISTIC KHAL_CANBusOffDebounce_s "" VALUE 0x0000 /* @ECU_Address@KHAL_CANBusOffDebounce_s@ */ Scalar_FLOAT32_IEEE 0 SWC_HALIN_CDD_type_CM_single_sec 0.0 10.0 /end CHARACTERISTIC
/begin CHARACTERISTIC KHAL_RandomNumberY1_enum "" VALUE 0x0000 /* @ECU_Address@KHAL_RandomNumberY1_enum@ */ Scalar_ULONG 0 SWC_HALIN_CDD_type_CM_uint32_enum 0.0 4.294967295E+9 /end CHARACTERISTIC
/begin CHARACTERISTIC KHAL_RandomNumberY2_enum "" VALUE 0x0000 /* @ECU_Address@KHAL_RandomNumberY2_enum@ */ Scalar_ULONG 0 SWC_HALIN_CDD_type_CM_uint32_enum 0.0 4.294967295E+9 /end CHARACTERISTIC
/begin CHARACTERISTIC KHAL_DKCDecryptEnable_flg_ovrdflg "" VALUE 0x0000 /* @ECU_Address@KHAL_DKCDecryptEnable_flg_ovrdflg@ */ Scalar_BOOLEAN 0 SWC_HALIN_CDD_type_CM_boolean_flg 0.0 1.0 /end CHARACTERISTIC
/begin CHARACTERISTIC KHAL_DKCDecryptEnable_flg_ovrdval "" VALUE 0x0000 /* @ECU_Address@KHAL_DKCDecryptEnable_flg_ovrdval@ */ Scalar_BOOLEAN 0 SWC_HALIN_CDD_type_CM_boolean_flg 0.0 1.0 /end CHARACTERISTIC
/begin CHARACTERISTIC KHAL_RandomNumberY_ovrdflg "" VALUE 0x0000 /* @ECU_Address@KHAL_RandomNumberY_ovrdflg@ */ Scalar_BOOLEAN 0 SWC_HALIN_CDD_type_CM_boolean_flg 0.0 1.0 /end CHARACTERISTIC
/begin CHARACTERISTIC KHAL_TPMSRESBUTT_flg_ovrdflg "" VALUE 0x0000 /* @ECU_Address@KHAL_TPMSRESBUTT_flg_ovrdflg@ */ Scalar_BOOLEAN 0 SWC_HALIN_CDD_type_CM_boolean_flg 0.0 1.0 /end CHARACTERISTIC
/begin CHARACTERISTIC KHAL_TPMSRESBUTT_flg_ovrdval "" VALUE 0x0000 /* @ECU_Address@KHAL_TPMSRESBUTT_flg_ovrdval@ */ Scalar_BOOLEAN 0 SWC_HALIN_CDD_type_CM_boolean_flg 0.0 1.0 /end CHARACTERISTIC
/begin CHARACTERISTIC KINP_ReadVinCode_flg "" VALUE 0x0000 /* @ECU_Address@KINP_ReadVinCode_flg@ */ Scalar_BOOLEAN 0 SWC_HALIN_CDD_type_CM_boolean_flg 0.0 1.0 /end CHARACTERISTIC
/begin CHARACTERISTIC KHAL_DefaultRegenMode_enum "" VALUE 0x0000 /* @ECU_Address@KHAL_DefaultRegenMode_enum@ */ Scalar_UBYTE 0 SWC_HALIN_CDD_type_CM_uint8_enum 0.0 6.0 /end CHARACTERISTIC
/begin MEASUREMENT VHAL_WisrBootReason_raw32 "" ULONG SWC_HALIN_CDD_type_CM_uint32_raw32 0 0 0.0 4.294967295E+9 ECU_ADDRESS 0x0000 /* @ECU_Address@VHAL_WisrBootReason_raw32@ */ /end MEASUREMENT
/begin MEASUREMENT VHAL_PmicBootPath_raw32 "" ULONG SWC_HALIN_CDD_type_CM_uint32_raw32 0 0 0.0 4.294967295E+9 ECU_ADDRESS 0x0000 /* @ECU_Address@VHAL_PmicBootPath_raw32@ */ /end MEASUREMENT
/begin MEASUREMENT VHAL_FlashPSAR_sec "" ULONG SWC_HALIN_CDD_type_CM_uint32_sec 0 0 0.0 4.294967295E+9 ECU_ADDRESS 0x0000 /* @ECU_Address@VHAL_FlashPSAR_sec@ */ /end MEASUREMENT
/begin MEASUREMENT VHAL_FlashPSAL_sec "" ULONG SWC_HALIN_CDD_type_CM_uint32_sec 0 0 0.0 4.294967295E+9 ECU_ADDRESS 0x0000 /* @ECU_Address@VHAL_FlashPSAL_sec@ */ /end MEASUREMENT
/begin MEASUREMENT VHAL_FlashIPSAR_sec "" ULONG SWC_HALIN_CDD_type_CM_uint32_sec 0 0 0.0 4.294967295E+9 ECU_ADDRESS 0x0000 /* @ECU_Address@VHAL_FlashIPSAR_sec@ */ /end MEASUREMENT
/begin MEASUREMENT VHAL_FlashIPSAL_sec "" ULONG SWC_HALIN_CDD_type_CM_uint32_sec 0 0 0.0 4.294967295E+9 ECU_ADDRESS 0x0000 /* @ECU_Address@VHAL_FlashIPSAL_sec@ */ /end MEASUREMENT
/begin MEASUREMENT VHAL_FlashCPSAR_sec "" ULONG SWC_HALIN_CDD_type_CM_uint32_sec 0 0 0.0 4.294967295E+9 ECU_ADDRESS 0x0000 /* @ECU_Address@VHAL_FlashCPSAR_sec@ */ /end MEASUREMENT
/begin MEASUREMENT VHAL_FlashCPSAL_sec "" ULONG SWC_HALIN_CDD_type_CM_uint32_sec 0 0 0.0 4.294967295E+9 ECU_ADDRESS 0x0000 /* @ECU_Address@VHAL_FlashCPSAL_sec@ */ /end MEASUREMENT
/begin MEASUREMENT VHAL_FlashPKERNumerator_kphsqr "" ULONG SWC_HALIN_CDD_type_CM_uint32_kphsqr 0 0 0.0 4.294967295E+9 ECU_ADDRESS 0x0000 /* @ECU_Address@VHAL_FlashPKERNumerator_kphsqr@ */ /end MEASUREMENT
/begin MEASUREMENT VHAL_FlashPKELNumerator_kphsqr "" ULONG SWC_HALIN_CDD_type_CM_uint32_kphsqr 0 0 0.0 4.294967295E+9 ECU_ADDRESS 0x0000 /* @ECU_Address@VHAL_FlashPKELNumerator_kphsqr@ */ /end MEASUREMENT
/begin MEASUREMENT VHAL_FlashQTYPSATRIPSR_cnt "" ULONG SWC_HALIN_CDD_type_CM_uint32_cnt 0 0 0.0 4.294967295E+9 ECU_ADDRESS 0x0000 /* @ECU_Address@VHAL_FlashQTYPSATRIPSR_cnt@ */ /end MEASUREMENT
/begin MEASUREMENT VHAL_FlashQTYPSATRIPSL_cnt "" ULONG SWC_HALIN_CDD_type_CM_uint32_cnt 0 0 0.0 4.294967295E+9 ECU_ADDRESS 0x0000 /* @ECU_Address@VHAL_FlashQTYPSATRIPSL_cnt@ */ /end MEASUREMENT
/begin MEASUREMENT VHAL_FlashRESSTIMESOCPSARNGR_s "" ULONG SWC_HALIN_CDD_type_CM_uint32 0 0 0 4294967295 ARRAY_SIZE 8 ECU_ADDRESS 0x0000 /* @ECU_Address@VHAL_FlashRESSTIMESOCPSARNGR_s@ */ /end MEASUREMENT
/begin MEASUREMENT VHAL_FlashRESSTIMESOCPSARNGL_s "" ULONG SWC_HALIN_CDD_type_CM_uint32 0 0 0 4294967295 ARRAY_SIZE 8 ECU_ADDRESS 0x0000 /* @ECU_Address@VHAL_FlashRESSTIMESOCPSARNGL_s@ */ /end MEASUREMENT
/begin MEASUREMENT VHAL_FlashRESSTIMESOCCHGRNGR_s "" ULONG SWC_HALIN_CDD_type_CM_uint32 0 0 0 4294967295 ARRAY_SIZE 8 ECU_ADDRESS 0x0000 /* @ECU_Address@VHAL_FlashRESSTIMESOCCHGRNGR_s@ */ /end MEASUREMENT
/begin MEASUREMENT VHAL_FlashRESSTIMESOCCHGRNGL_s "" ULONG SWC_HALIN_CDD_type_CM_uint32 0 0 0 4294967295 ARRAY_SIZE 8 ECU_ADDRESS 0x0000 /* @ECU_Address@VHAL_FlashRESSTIMESOCCHGRNGL_s@ */ /end MEASUREMENT
/begin MEASUREMENT VHAL_FlashRESSTIMESOCOFFRNGR_s "" ULONG SWC_HALIN_CDD_type_CM_uint32 0 0 0 4294967295 ARRAY_SIZE 8 ECU_ADDRESS 0x0000 /* @ECU_Address@VHAL_FlashRESSTIMESOCOFFRNGR_s@ */ /end MEASUREMENT
/begin MEASUREMENT VHAL_FlashRESSTIMESOCOFFRNGL_s "" ULONG SWC_HALIN_CDD_type_CM_uint32 0 0 0 4294967295 ARRAY_SIZE 8 ECU_ADDRESS 0x0000 /* @ECU_Address@VHAL_FlashRESSTIMESOCOFFRNGL_s@ */ /end MEASUREMENT
/begin MEASUREMENT VHAL_FlashAVGBATTEMPL_sec "" ULONG SWC_HALIN_CDD_type_CM_uint32_sec 0 0 0.0 4.294967295E+9 ECU_ADDRESS 0x0000 /* @ECU_Address@VHAL_FlashAVGBATTEMPL_sec@ */ /end MEASUREMENT
/begin MEASUREMENT VHAL_FlashBattTempPSAR_sec "" ULONG SWC_HALIN_CDD_type_CM_uint32_sec 0 0 0.0 4.294967295E+9 ECU_ADDRESS 0x0000 /* @ECU_Address@VHAL_FlashBattTempPSAR_sec@ */ /end MEASUREMENT
/begin MEASUREMENT VHAL_FlashBattTempPSAL_sec "" ULONG SWC_HALIN_CDD_type_CM_uint32_sec 0 0 0.0 4.294967295E+9 ECU_ADDRESS 0x0000 /* @ECU_Address@VHAL_FlashBattTempPSAL_sec@ */ /end MEASUREMENT
/begin MEASUREMENT VHAL_FlashOVCR_sec "" ULONG SWC_HALIN_CDD_type_CM_uint32_sec 0 0 0.0 4.294967295E+9 ECU_ADDRESS 0x0000 /* @ECU_Address@VHAL_FlashOVCR_sec@ */ /end MEASUREMENT
/begin MEASUREMENT VHAL_FlashOVCL_sec "" ULONG SWC_HALIN_CDD_type_CM_uint32_sec 0 0 0.0 4.294967295E+9 ECU_ADDRESS 0x0000 /* @ECU_Address@VHAL_FlashOVCL_sec@ */ /end MEASUREMENT
/begin MEASUREMENT VHAL_FlashOFFR_sec "" ULONG SWC_HALIN_CDD_type_CM_uint32_sec 0 0 0.0 4.294967295E+9 ECU_ADDRESS 0x0000 /* @ECU_Address@VHAL_FlashOFFR_sec@ */ /end MEASUREMENT
/begin MEASUREMENT VHAL_FlashOFFL_sec "" ULONG SWC_HALIN_CDD_type_CM_uint32_sec 0 0 0.0 4.294967295E+9 ECU_ADDRESS 0x0000 /* @ECU_Address@VHAL_FlashOFFL_sec@ */ /end MEASUREMENT
/begin MEASUREMENT VHAL_FlashChkLFID_raw "" ULONG SWC_HALIN_CDD_type_CM_uint32_raw 0 0 0.0 4.294967295E+9 ECU_ADDRESS 0x0000 /* @ECU_Address@VHAL_FlashChkLFID_raw@ */ /end MEASUREMENT
/begin MEASUREMENT VHAL_FlashChkRFID_raw "" ULONG SWC_HALIN_CDD_type_CM_uint32_raw 0 0 0.0 4.294967295E+9 ECU_ADDRESS 0x0000 /* @ECU_Address@VHAL_FlashChkRFID_raw@ */ /end MEASUREMENT
/begin MEASUREMENT VHAL_FlashChkLRID_raw "" ULONG SWC_HALIN_CDD_type_CM_uint32_raw 0 0 0.0 4.294967295E+9 ECU_ADDRESS 0x0000 /* @ECU_Address@VHAL_FlashChkLRID_raw@ */ /end MEASUREMENT
/begin MEASUREMENT VHAL_FlashChkRRID_raw "" ULONG SWC_HALIN_CDD_type_CM_uint32_raw 0 0 0.0 4.294967295E+9 ECU_ADDRESS 0x0000 /* @ECU_Address@VHAL_FlashChkRRID_raw@ */ /end MEASUREMENT
/begin MEASUREMENT VHAL_FlashLFID_raw "" ULONG SWC_HALIN_CDD_type_CM_uint32_raw 0 0 0.0 4.294967295E+9 ECU_ADDRESS 0x0000 /* @ECU_Address@VHAL_FlashLFID_raw@ */ /end MEASUREMENT
/begin MEASUREMENT VHAL_FlashRFID_raw "" ULONG SWC_HALIN_CDD_type_CM_uint32_raw 0 0 0.0 4.294967295E+9 ECU_ADDRESS 0x0000 /* @ECU_Address@VHAL_FlashRFID_raw@ */ /end MEASUREMENT
/begin MEASUREMENT VHAL_FlashLRID_raw "" ULONG SWC_HALIN_CDD_type_CM_uint32_raw 0 0 0.0 4.294967295E+9 ECU_ADDRESS 0x0000 /* @ECU_Address@VHAL_FlashLRID_raw@ */ /end MEASUREMENT
/begin MEASUREMENT VHAL_FlashRRID_raw "" ULONG SWC_HALIN_CDD_type_CM_uint32_raw 0 0 0.0 4.294967295E+9 ECU_ADDRESS 0x0000 /* @ECU_Address@VHAL_FlashRRID_raw@ */ /end MEASUREMENT
/begin MEASUREMENT VHAL_FlashS1ID_raw "" ULONG SWC_HALIN_CDD_type_CM_uint32_raw 0 0 0.0 4.294967295E+9 ECU_ADDRESS 0x0000 /* @ECU_Address@VHAL_FlashS1ID_raw@ */ /end MEASUREMENT
/begin MEASUREMENT VHAL_FlashS2ID_raw "" ULONG SWC_HALIN_CDD_type_CM_uint32_raw 0 0 0.0 4.294967295E+9 ECU_ADDRESS 0x0000 /* @ECU_Address@VHAL_FlashS2ID_raw@ */ /end MEASUREMENT
/begin MEASUREMENT VHAL_FlashS3ID_raw "" ULONG SWC_HALIN_CDD_type_CM_uint32_raw 0 0 0.0 4.294967295E+9 ECU_ADDRESS 0x0000 /* @ECU_Address@VHAL_FlashS3ID_raw@ */ /end MEASUREMENT
/begin MEASUREMENT VHAL_FlashS4ID_raw "" ULONG SWC_HALIN_CDD_type_CM_uint32_raw 0 0 0.0 4.294967295E+9 ECU_ADDRESS 0x0000 /* @ECU_Address@VHAL_FlashS4ID_raw@ */ /end MEASUREMENT
/begin MEASUREMENT VHAL_AccelPedal1Vol_raw "" FLOAT32_IEEE SWC_HALIN_CDD_type_CM_single_raw 0 0 0.0 10.0 ECU_ADDRESS 0x0000 /* @ECU_Address@VHAL_AccelPedal1Vol_raw@ */ /end MEASUREMENT
/begin MEASUREMENT VHAL_AccelPedal2Vol_raw "" FLOAT32_IEEE SWC_HALIN_CDD_type_CM_single_raw 0 0 0.0 10.0 ECU_ADDRESS 0x0000 /* @ECU_Address@VHAL_AccelPedal2Vol_raw@ */ /end MEASUREMENT
/begin MEASUREMENT VHAL_APSProgressPCT_pct "" FLOAT32_IEEE SWC_HALIN_CDD_type_CM_single_pct 0 0 0.0 100.0 ECU_ADDRESS 0x0000 /* @ECU_Address@VHAL_APSProgressPCT_pct@ */ /end MEASUREMENT
/begin MEASUREMENT VHAL_APSAngleTarget_Deg "" FLOAT32_IEEE SWC_HALIN_CDD_type_CM_single_Deg 0 0 -900.0 900.0 ECU_ADDRESS 0x0000 /* @ECU_Address@VHAL_APSAngleTarget_Deg@ */ /end MEASUREMENT
/begin MEASUREMENT VHAL_APSDecReq_mps2 "" FLOAT32_IEEE SWC_HALIN_CDD_type_CM_single_mps2 0 0 0.0 25.4 ECU_ADDRESS 0x0000 /* @ECU_Address@VHAL_APSDecReq_mps2@ */ /end MEASUREMENT
/begin MEASUREMENT VHAL_APSSpeedCMD_kph "" FLOAT32_IEEE SWC_HALIN_CDD_type_CM_single_kph 0 0 0.0 20.0 ECU_ADDRESS 0x0000 /* @ECU_Address@VHAL_APSSpeedCMD_kph@ */ /end MEASUREMENT
/begin MEASUREMENT VHAL_AccelPedal1Vol_V "" FLOAT32_IEEE SWC_HALIN_CDD_type_CM_single_V 0 0 0.0 10.0 ECU_ADDRESS 0x0000 /* @ECU_Address@VHAL_AccelPedal1Vol_V@ */ /end MEASUREMENT
/begin MEASUREMENT VHAL_AccelPedal2Vol_V "" FLOAT32_IEEE SWC_HALIN_CDD_type_CM_single_V 0 0 0.0 10.0 ECU_ADDRESS 0x0000 /* @ECU_Address@VHAL_AccelPedal2Vol_V@ */ /end MEASUREMENT
/begin MEASUREMENT VHAL_Pedal1Ref5V_V "" FLOAT32_IEEE SWC_HALIN_CDD_type_CM_single_V 0 0 0.0 10.0 ECU_ADDRESS 0x0000 /* @ECU_Address@VHAL_Pedal1Ref5V_V@ */ /end MEASUREMENT
/begin MEASUREMENT VHAL_Pedal2Ref5V_V "" FLOAT32_IEEE SWC_HALIN_CDD_type_CM_single_V 0 0 0.0 10.0 ECU_ADDRESS 0x0000 /* @ECU_Address@VHAL_Pedal2Ref5V_V@ */ /end MEASUREMENT
/begin MEASUREMENT VHAL_EAPS1MINMem_pct "" FLOAT32_IEEE SWC_HALIN_CDD_type_CM_single_pct 0 0 0.0 120.0 ECU_ADDRESS 0x0000 /* @ECU_Address@VHAL_EAPS1MINMem_pct@ */ /end MEASUREMENT
/begin MEASUREMENT VHAL_EAPS2MINMem_pct "" FLOAT32_IEEE SWC_HALIN_CDD_type_CM_single_pct 0 0 0.0 120.0 ECU_ADDRESS 0x0000 /* @ECU_Address@VHAL_EAPS2MINMem_pct@ */ /end MEASUREMENT
/begin MEASUREMENT VHAL_DiagFMHT_s "" FLOAT32_IEEE SWC_HALIN_CDD_type_CM_single_s 0 0 10.0 150.0 ECU_ADDRESS 0x0000 /* @ECU_Address@VHAL_DiagFMHT_s@ */ /end MEASUREMENT
/begin MEASUREMENT VHAL_DiagFLTC_mA "" FLOAT32_IEEE SWC_HALIN_CDD_type_CM_single_mA 0 0 0.0 2550.0 ECU_ADDRESS 0x0000 /* @ECU_Address@VHAL_DiagFLTC_mA@ */ /end MEASUREMENT
/begin MEASUREMENT VHAL_DiagFRTC_mA "" FLOAT32_IEEE SWC_HALIN_CDD_type_CM_single_mA 0 0 0.0 2550.0 ECU_ADDRESS 0x0000 /* @ECU_Address@VHAL_DiagFRTC_mA@ */ /end MEASUREMENT
/begin MEASUREMENT VHAL_DiagRLTC_mA "" FLOAT32_IEEE SWC_HALIN_CDD_type_CM_single_mA 0 0 0.0 2550.0 ECU_ADDRESS 0x0000 /* @ECU_Address@VHAL_DiagRLTC_mA@ */ /end MEASUREMENT
/begin MEASUREMENT VHAL_DiagRRTC_mA "" FLOAT32_IEEE SWC_HALIN_CDD_type_CM_single_mA 0 0 0.0 2550.0 ECU_ADDRESS 0x0000 /* @ECU_Address@VHAL_DiagRRTC_mA@ */ /end MEASUREMENT
/begin MEASUREMENT VHAL_FlashMILDIST_km "" FLOAT32_IEEE SWC_HALIN_CDD_type_CM_single_km 0 0 0.0 65535.0 ECU_ADDRESS 0x0000 /* @ECU_Address@VHAL_FlashMILDIST_km@ */ /end MEASUREMENT
/begin MEASUREMENT VHAL_FlashCLRDIST_km "" FLOAT32_IEEE SWC_HALIN_CDD_type_CM_single_km 0 0 0.0 65535.0 ECU_ADDRESS 0x0000 /* @ECU_Address@VHAL_FlashCLRDIST_km@ */ /end MEASUREMENT
/begin MEASUREMENT VHAL_FlashODOMETER_km "" FLOAT32_IEEE SWC_HALIN_CDD_type_CM_single_km 0 0 0.0 4.294967295E+8 ECU_ADDRESS 0x0000 /* @ECU_Address@VHAL_FlashODOMETER_km@ */ /end MEASUREMENT
/begin MEASUREMENT VHAL_FlashHVBNAH_Ahr "" FLOAT32_IEEE SWC_HALIN_CDD_type_CM_single_Ahr 0 0 -2.147483648E+6 2.147483647E+6 ECU_ADDRESS 0x0000 /* @ECU_Address@VHAL_FlashHVBNAH_Ahr@ */ /end MEASUREMENT
/begin MEASUREMENT VHAL_FlashHVBNE_kWh "" FLOAT32_IEEE SWC_HALIN_CDD_type_CM_single_kWh 0 0 -2.147483648E+6 2.147483647E+6 ECU_ADDRESS 0x0000 /* @ECU_Address@VHAL_FlashHVBNE_kWh@ */ /end MEASUREMENT
/begin MEASUREMENT VHAL_FlashTNBCPSAR_Ahr "" FLOAT32_IEEE SWC_HALIN_CDD_type_CM_single_Ahr 0 0 0.0 4.294967295E+6 ECU_ADDRESS 0x0000 /* @ECU_Address@VHAL_FlashTNBCPSAR_Ahr@ */ /end MEASUREMENT
/begin MEASUREMENT VHAL_FlashTNBCPSAL_Ahr "" FLOAT32_IEEE SWC_HALIN_CDD_type_CM_single_Ahr 0 0 0.0 4.294967295E+8 ECU_ADDRESS 0x0000 /* @ECU_Address@VHAL_FlashTNBCPSAL_Ahr@ */ /end MEASUREMENT
/begin MEASUREMENT VHAL_FlashTNECPSAR_kWh "" FLOAT32_IEEE SWC_HALIN_CDD_type_CM_single_kWh 0 0 0.0 4.294967295E+8 ECU_ADDRESS 0x0000 /* @ECU_Address@VHAL_FlashTNECPSAR_kWh@ */ /end MEASUREMENT
/begin MEASUREMENT VHAL_FlashTNECPSAL_kWh "" FLOAT32_IEEE SWC_HALIN_CDD_type_CM_single_kWh 0 0 0.0 4.294967295E+8 ECU_ADDRESS 0x0000 /* @ECU_Address@VHAL_FlashTNECPSAL_kWh@ */ /end MEASUREMENT
/begin MEASUREMENT VHAL_FlashTEBPSAR_kWh "" FLOAT32_IEEE SWC_HALIN_CDD_type_CM_single_kWh 0 0 0.0 4.294967295E+8 ECU_ADDRESS 0x0000 /* @ECU_Address@VHAL_FlashTEBPSAR_kWh@ */ /end MEASUREMENT
/begin MEASUREMENT VHAL_FlashTEBPSAL_kWh "" FLOAT32_IEEE SWC_HALIN_CDD_type_CM_single_kWh 0 0 0.0 4.294967295E+8 ECU_ADDRESS 0x0000 /* @ECU_Address@VHAL_FlashTEBPSAL_kWh@ */ /end MEASUREMENT
/begin MEASUREMENT VHAL_FlashTGEOVCR_kWh "" FLOAT32_IEEE SWC_HALIN_CDD_type_CM_single_kWh 0 0 0.0 4.294967295E+8 ECU_ADDRESS 0x0000 /* @ECU_Address@VHAL_FlashTGEOVCR_kWh@ */ /end MEASUREMENT
/begin MEASUREMENT VHAL_FlashTGEOVCL_kWh "" FLOAT32_IEEE SWC_HALIN_CDD_type_CM_single_kWh 0 0 0.0 4.294967295E+8 ECU_ADDRESS 0x0000 /* @ECU_Address@VHAL_FlashTGEOVCL_kWh@ */ /end MEASUREMENT
/begin MEASUREMENT VHAL_FlashGECHGOVCDCR_kWh "" FLOAT32_IEEE SWC_HALIN_CDD_type_CM_single_kWh 0 0 0.0 4.294967295E+8 ECU_ADDRESS 0x0000 /* @ECU_Address@VHAL_FlashGECHGOVCDCR_kWh@ */ /end MEASUREMENT
/begin MEASUREMENT VHAL_FlashGECHGOVCDCL_kWh "" FLOAT32_IEEE SWC_HALIN_CDD_type_CM_single_kWh 0 0 0.0 4.294967295E+8 ECU_ADDRESS 0x0000 /* @ECU_Address@VHAL_FlashGECHGOVCDCL_kWh@ */ /end MEASUREMENT
/begin MEASUREMENT VHAL_FlashGECHGOVCACR_kWh "" FLOAT32_IEEE SWC_HALIN_CDD_type_CM_single_kWh 0 0 0.0 4.294967295E+8 ECU_ADDRESS 0x0000 /* @ECU_Address@VHAL_FlashGECHGOVCACR_kWh@ */ /end MEASUREMENT
/begin MEASUREMENT VHAL_FlashGECHGOVCACL_kWh "" FLOAT32_IEEE SWC_HALIN_CDD_type_CM_single_kWh 0 0 0.0 4.294967295E+8 ECU_ADDRESS 0x0000 /* @ECU_Address@VHAL_FlashGECHGOVCACL_kWh@ */ /end MEASUREMENT
/begin MEASUREMENT VHAL_FlashRESSV2XENNONPSAR_kWh "" FLOAT32_IEEE SWC_HALIN_CDD_type_CM_single_kWh 0 0 0.0 4.294967295E+8 ECU_ADDRESS 0x0000 /* @ECU_Address@VHAL_FlashRESSV2XENNONPSAR_kWh@ */ /end MEASUREMENT
/begin MEASUREMENT VHAL_FlashRESSV2XENNONPSAL_kWh "" FLOAT32_IEEE SWC_HALIN_CDD_type_CM_single_kWh 0 0 0.0 4.294967295E+8 ECU_ADDRESS 0x0000 /* @ECU_Address@VHAL_FlashRESSV2XENNONPSAL_kWh@ */ /end MEASUREMENT
/begin MEASUREMENT VHAL_FlashResetCDEODTR_km "" FLOAT32_IEEE SWC_HALIN_CDD_type_CM_single_km 0 0 0.0 4.294967295E+8 ECU_ADDRESS 0x0000 /* @ECU_Address@VHAL_FlashResetCDEODTR_km@ */ /end MEASUREMENT
/begin MEASUREMENT VHAL_FlashAvgBattTempPSAR_C "" FLOAT32_IEEE SWC_HALIN_CDD_type_CM_single_C 0 0 -40.0 215.0 ECU_ADDRESS 0x0000 /* @ECU_Address@VHAL_FlashAvgBattTempPSAR_C@ */ /end MEASUREMENT
/begin MEASUREMENT VHAL_FlashAvgBattTempPSAL_C "" FLOAT32_IEEE SWC_HALIN_CDD_type_CM_single_C 0 0 -40.0 215.0 ECU_ADDRESS 0x0000 /* @ECU_Address@VHAL_FlashAvgBattTempPSAL_C@ */ /end MEASUREMENT
/begin MEASUREMENT VHAL_FlashAvgBattTempOVCR_C "" FLOAT32_IEEE SWC_HALIN_CDD_type_CM_single_C 0 0 -40.0 215.0 ECU_ADDRESS 0x0000 /* @ECU_Address@VHAL_FlashAvgBattTempOVCR_C@ */ /end MEASUREMENT
/begin MEASUREMENT VHAL_FlashAvgBattTempOVCL_C "" FLOAT32_IEEE SWC_HALIN_CDD_type_CM_single_C 0 0 -40.0 215.0 ECU_ADDRESS 0x0000 /* @ECU_Address@VHAL_FlashAvgBattTempOVCL_C@ */ /end MEASUREMENT
/begin MEASUREMENT VHAL_FlashAvgBattTempOFFR_C "" FLOAT32_IEEE SWC_HALIN_CDD_type_CM_single_C 0 0 -40.0 215.0 ECU_ADDRESS 0x0000 /* @ECU_Address@VHAL_FlashAvgBattTempOFFR_C@ */ /end MEASUREMENT
/begin MEASUREMENT VHAL_FlashAvgBattTempOFFL_C "" FLOAT32_IEEE SWC_HALIN_CDD_type_CM_single_C 0 0 -40.0 215.0 ECU_ADDRESS 0x0000 /* @ECU_Address@VHAL_FlashAvgBattTempOFFL_C@ */ /end MEASUREMENT
/begin MEASUREMENT VHAL_FlashETMATOER_kWh "" FLOAT32_IEEE SWC_HALIN_CDD_type_CM_single_kWh 0 0 0.0 4.294967295E+9 ECU_ADDRESS 0x0000 /* @ECU_Address@VHAL_FlashETMATOER_kWh@ */ /end MEASUREMENT
/begin MEASUREMENT VHAL_FlashETMATOEL_kWh "" FLOAT32_IEEE SWC_HALIN_CDD_type_CM_single_kWh 0 0 0.0 4.294967295E+9 ECU_ADDRESS 0x0000 /* @ECU_Address@VHAL_FlashETMATOEL_kWh@ */ /end MEASUREMENT
/begin MEASUREMENT VHAL_FlashETMBTOER_kWh "" FLOAT32_IEEE SWC_HALIN_CDD_type_CM_single_kWh 0 0 0.0 4.294967295E+9 ECU_ADDRESS 0x0000 /* @ECU_Address@VHAL_FlashETMBTOER_kWh@ */ /end MEASUREMENT
/begin MEASUREMENT VHAL_FlashETMBTOEL_kWh "" FLOAT32_IEEE SWC_HALIN_CDD_type_CM_single_kWh 0 0 0.0 4.294967295E+9 ECU_ADDRESS 0x0000 /* @ECU_Address@VHAL_FlashETMBTOEL_kWh@ */ /end MEASUREMENT
/begin MEASUREMENT VHAL_FlashMAXBATTEMPL_C "" FLOAT32_IEEE SWC_HALIN_CDD_type_CM_single_C 0 0 -40.0 215.0 ECU_ADDRESS 0x0000 /* @ECU_Address@VHAL_FlashMAXBATTEMPL_C@ */ /end MEASUREMENT
/begin MEASUREMENT VHAL_FlashMINBATTEMPL_C "" FLOAT32_IEEE SWC_HALIN_CDD_type_CM_single_C 0 0 -40.0 215.0 ECU_ADDRESS 0x0000 /* @ECU_Address@VHAL_FlashMINBATTEMPL_C@ */ /end MEASUREMENT
/begin MEASUREMENT VHAL_FlashAVGBATTEMPL_C "" FLOAT32_IEEE SWC_HALIN_CDD_type_CM_single_C 0 0 -40.0 215.0 ECU_ADDRESS 0x0000 /* @ECU_Address@VHAL_FlashAVGBATTEMPL_C@ */ /end MEASUREMENT
/begin MEASUREMENT VHAL_PowerOffTSet_cnt "" FLOAT32_IEEE SWC_HALIN_CDD_type_CM_single_cnt 0 0 1.0 128.0 ECU_ADDRESS 0x0000 /* @ECU_Address@VHAL_PowerOffTSet_cnt@ */ /end MEASUREMENT
/begin MEASUREMENT VHAL_RemoteACTemp_C "" FLOAT32_IEEE SWC_HALIN_CDD_type_CM_single_C 0 0 17.0 48.5 ECU_ADDRESS 0x0000 /* @ECU_Address@VHAL_RemoteACTemp_C@ */ /end MEASUREMENT
/begin MEASUREMENT VHAL_APSDRLR_cm "" UWORD SWC_HALIN_CDD_type_CM_uint16_cm 0 0 0.0 65535.0 ECU_ADDRESS 0x0000 /* @ECU_Address@VHAL_APSDRLR_cm@ */ /end MEASUREMENT
/begin MEASUREMENT VHAL_APSDRLL_cm "" UWORD SWC_HALIN_CDD_type_CM_uint16_cm 0 0 0.0 65535.0 ECU_ADDRESS 0x0000 /* @ECU_Address@VHAL_APSDRLL_cm@ */ /end MEASUREMENT
/begin MEASUREMENT VHAL_APSDFLR_cm "" UWORD SWC_HALIN_CDD_type_CM_uint16_cm 0 0 0.0 65535.0 ECU_ADDRESS 0x0000 /* @ECU_Address@VHAL_APSDFLR_cm@ */ /end MEASUREMENT
/begin MEASUREMENT VHAL_APSDFLL_cm "" UWORD SWC_HALIN_CDD_type_CM_uint16_cm 0 0 0.0 65535.0 ECU_ADDRESS 0x0000 /* @ECU_Address@VHAL_APSDFLL_cm@ */ /end MEASUREMENT
/begin MEASUREMENT VHAL_AuxBattVolmV_mV "" UWORD SWC_HALIN_CDD_type_CM_uint16_mV 0 0 0.0 65535.0 ECU_ADDRESS 0x0000 /* @ECU_Address@VHAL_AuxBattVolmV_mV@ */ /end MEASUREMENT
/begin MEASUREMENT VHAL_FlashPTGUserHeight1_cnt "" UWORD SWC_HALIN_CDD_type_CM_uint16_cnt 0 0 0.0 65535.0 ECU_ADDRESS 0x0000 /* @ECU_Address@VHAL_FlashPTGUserHeight1_cnt@ */ /end MEASUREMENT
/begin MEASUREMENT VHAL_FlashPTGUserHeight2_cnt "" UWORD SWC_HALIN_CDD_type_CM_uint16_cnt 0 0 0.0 65535.0 ECU_ADDRESS 0x0000 /* @ECU_Address@VHAL_FlashPTGUserHeight2_cnt@ */ /end MEASUREMENT
/begin MEASUREMENT VHAL_FlashPTGUserHeight3_cnt "" UWORD SWC_HALIN_CDD_type_CM_uint16_cnt 0 0 0.0 65535.0 ECU_ADDRESS 0x0000 /* @ECU_Address@VHAL_FlashPTGUserHeight3_cnt@ */ /end MEASUREMENT
/begin MEASUREMENT VHAL_FlashPTGUserHeight4_cnt "" UWORD SWC_HALIN_CDD_type_CM_uint16_cnt 0 0 0.0 65535.0 ECU_ADDRESS 0x0000 /* @ECU_Address@VHAL_FlashPTGUserHeight4_cnt@ */ /end MEASUREMENT
/begin MEASUREMENT VHAL_FlashPTGUserHeight5_cnt "" UWORD SWC_HALIN_CDD_type_CM_uint16_cnt 0 0 0.0 65535.0 ECU_ADDRESS 0x0000 /* @ECU_Address@VHAL_FlashPTGUserHeight5_cnt@ */ /end MEASUREMENT
/begin MEASUREMENT VHAL_FlashPTGUserHeight7_cnt "" UWORD SWC_HALIN_CDD_type_CM_uint16_cnt 0 0 0.0 65535.0 ECU_ADDRESS 0x0000 /* @ECU_Address@VHAL_FlashPTGUserHeight7_cnt@ */ /end MEASUREMENT
/begin MEASUREMENT VHAL_FlashMILTIME_min "" UWORD SWC_HALIN_CDD_type_CM_uint16_min 0 0 0.0 65535.0 ECU_ADDRESS 0x0000 /* @ECU_Address@VHAL_FlashMILTIME_min@ */ /end MEASUREMENT
/begin MEASUREMENT VHAL_FlashCLRTIME_min "" UWORD SWC_HALIN_CDD_type_CM_uint16_min 0 0 0.0 65535.0 ECU_ADDRESS 0x0000 /* @ECU_Address@VHAL_FlashCLRTIME_min@ */ /end MEASUREMENT
/begin MEASUREMENT VHAL_FlashNUMPSATRIPSFLTMEMCLR_cnt "" UWORD SWC_HALIN_CDD_type_CM_uint16_cnt 0 0 0.0 65535.0 ECU_ADDRESS 0x0000 /* @ECU_Address@VHAL_FlashNUMPSATRIPSFLTMEMCLR_cnt@ */ /end MEASUREMENT
/begin MEASUREMENT VHAL_FlashIGNCNTR_cnt "" UWORD SWC_HALIN_CDD_type_CM_uint16_cnt 0 0 0.0 65535.0 ECU_ADDRESS 0x0000 /* @ECU_Address@VHAL_FlashIGNCNTR_cnt@ */ /end MEASUREMENT
/begin MEASUREMENT VHAL_FlashRESSCNTDODRNGR_cnt "" UWORD SWC_HALIN_CDD_type_CM_uint16 0 0 0 65535 ARRAY_SIZE 8 ECU_ADDRESS 0x0000 /* @ECU_Address@VHAL_FlashRESSCNTDODRNGR_cnt@ */ /end MEASUREMENT
/begin MEASUREMENT VHAL_FlashRESSCNTDODRNGL_cnt "" UWORD SWC_HALIN_CDD_type_CM_uint16 0 0 0 65535 ARRAY_SIZE 8 ECU_ADDRESS 0x0000 /* @ECU_Address@VHAL_FlashRESSCNTDODRNGL_cnt@ */ /end MEASUREMENT
/begin MEASUREMENT VHAL_ReDoorLock_enum "" UWORD SWC_HALIN_CDD_type_CM_uint16_enum 0 0 0.0 65535.0 ECU_ADDRESS 0x0000 /* @ECU_Address@VHAL_ReDoorLock_enum@ */ /end MEASUREMENT
/begin MEASUREMENT VHAL_MemOffsetGyroX_raw16 "" SWORD SWC_HALIN_CDD_type_CM_int16_raw16 0 0 -32768.0 32767.0 ECU_ADDRESS 0x0000 /* @ECU_Address@VHAL_MemOffsetGyroX_raw16@ */ /end MEASUREMENT
/begin MEASUREMENT VHAL_MemOffsetGyroY_raw16 "" SWORD SWC_HALIN_CDD_type_CM_int16_raw16 0 0 -32768.0 32767.0 ECU_ADDRESS 0x0000 /* @ECU_Address@VHAL_MemOffsetGyroY_raw16@ */ /end MEASUREMENT
/begin MEASUREMENT VHAL_MemOffsetGyroZ_raw16 "" SWORD SWC_HALIN_CDD_type_CM_int16_raw16 0 0 -32768.0 32767.0 ECU_ADDRESS 0x0000 /* @ECU_Address@VHAL_MemOffsetGyroZ_raw16@ */ /end MEASUREMENT
/begin MEASUREMENT VHAL_MemOffsetAccX_raw16 "" SWORD SWC_HALIN_CDD_type_CM_int16_raw16 0 0 -32768.0 32767.0 ECU_ADDRESS 0x0000 /* @ECU_Address@VHAL_MemOffsetAccX_raw16@ */ /end MEASUREMENT
/begin MEASUREMENT VHAL_MemOffsetAccY_raw16 "" SWORD SWC_HALIN_CDD_type_CM_int16_raw16 0 0 -32768.0 32767.0 ECU_ADDRESS 0x0000 /* @ECU_Address@VHAL_MemOffsetAccY_raw16@ */ /end MEASUREMENT
/begin MEASUREMENT VHAL_MemOffsetAccZ_raw16 "" SWORD SWC_HALIN_CDD_type_CM_int16_raw16 0 0 -32768.0 32767.0 ECU_ADDRESS 0x0000 /* @ECU_Address@VHAL_MemOffsetAccZ_raw16@ */ /end MEASUREMENT
/begin MEASUREMENT VHAL_SensingGyroX_raw16 "" SWORD SWC_HALIN_CDD_type_CM_int16_raw16 0 0 -32768.0 32767.0 ECU_ADDRESS 0x0000 /* @ECU_Address@VHAL_SensingGyroX_raw16@ */ /end MEASUREMENT
/begin MEASUREMENT VHAL_SensingGyroY_raw16 "" SWORD SWC_HALIN_CDD_type_CM_int16_raw16 0 0 -32768.0 32767.0 ECU_ADDRESS 0x0000 /* @ECU_Address@VHAL_SensingGyroY_raw16@ */ /end MEASUREMENT
/begin MEASUREMENT VHAL_SensingGyroZ_raw16 "" SWORD SWC_HALIN_CDD_type_CM_int16_raw16 0 0 -32768.0 32767.0 ECU_ADDRESS 0x0000 /* @ECU_Address@VHAL_SensingGyroZ_raw16@ */ /end MEASUREMENT
/begin MEASUREMENT VHAL_SensingAccX_raw16 "" SWORD SWC_HALIN_CDD_type_CM_int16_raw16 0 0 -32768.0 32767.0 ECU_ADDRESS 0x0000 /* @ECU_Address@VHAL_SensingAccX_raw16@ */ /end MEASUREMENT
/begin MEASUREMENT VHAL_SensingAccY_raw16 "" SWORD SWC_HALIN_CDD_type_CM_int16_raw16 0 0 -32768.0 32767.0 ECU_ADDRESS 0x0000 /* @ECU_Address@VHAL_SensingAccY_raw16@ */ /end MEASUREMENT
/begin MEASUREMENT VHAL_SensingAccZ_raw16 "" SWORD SWC_HALIN_CDD_type_CM_int16_raw16 0 0 -32768.0 32767.0 ECU_ADDRESS 0x0000 /* @ECU_Address@VHAL_SensingAccZ_raw16@ */ /end MEASUREMENT
/begin MEASUREMENT VHAL_AcoreRebootCmd_raw "" UBYTE SWC_HALIN_CDD_type_CM_uint8_raw 0 0 0.0 255.0 ECU_ADDRESS 0x0000 /* @ECU_Address@VHAL_AcoreRebootCmd_raw@ */ /end MEASUREMENT
/begin MEASUREMENT VHAL_CAN1RxErrorCount_raw "" UBYTE SWC_HALIN_CDD_type_CM_uint8_raw 0 0 0.0 255.0 ECU_ADDRESS 0x0000 /* @ECU_Address@VHAL_CAN1RxErrorCount_raw@ */ /end MEASUREMENT
/begin MEASUREMENT VHAL_CAN1TxErrorCount_raw "" UBYTE SWC_HALIN_CDD_type_CM_uint8_raw 0 0 0.0 255.0 ECU_ADDRESS 0x0000 /* @ECU_Address@VHAL_CAN1TxErrorCount_raw@ */ /end MEASUREMENT
/begin MEASUREMENT VHAL_CAN2RxErrorCount_raw "" UBYTE SWC_HALIN_CDD_type_CM_uint8_raw 0 0 0.0 255.0 ECU_ADDRESS 0x0000 /* @ECU_Address@VHAL_CAN2RxErrorCount_raw@ */ /end MEASUREMENT
/begin MEASUREMENT VHAL_CAN2TxErrorCount_raw "" UBYTE SWC_HALIN_CDD_type_CM_uint8_raw 0 0 0.0 255.0 ECU_ADDRESS 0x0000 /* @ECU_Address@VHAL_CAN2TxErrorCount_raw@ */ /end MEASUREMENT
/begin MEASUREMENT VHAL_CAN3RxErrorCount_raw "" UBYTE SWC_HALIN_CDD_type_CM_uint8_raw 0 0 0.0 255.0 ECU_ADDRESS 0x0000 /* @ECU_Address@VHAL_CAN3RxErrorCount_raw@ */ /end MEASUREMENT
/begin MEASUREMENT VHAL_CAN3TxErrorCount_raw "" UBYTE SWC_HALIN_CDD_type_CM_uint8_raw 0 0 0.0 255.0 ECU_ADDRESS 0x0000 /* @ECU_Address@VHAL_CAN3TxErrorCount_raw@ */ /end MEASUREMENT
/begin MEASUREMENT VHAL_CAN4RxErrorCount_raw "" UBYTE SWC_HALIN_CDD_type_CM_uint8_raw 0 0 0.0 255.0 ECU_ADDRESS 0x0000 /* @ECU_Address@VHAL_CAN4RxErrorCount_raw@ */ /end MEASUREMENT
/begin MEASUREMENT VHAL_CAN4TxErrorCount_raw "" UBYTE SWC_HALIN_CDD_type_CM_uint8_raw 0 0 0.0 255.0 ECU_ADDRESS 0x0000 /* @ECU_Address@VHAL_CAN4TxErrorCount_raw@ */ /end MEASUREMENT
/begin MEASUREMENT VHAL_CAN5RxErrorCount_raw "" UBYTE SWC_HALIN_CDD_type_CM_uint8_raw 0 0 0.0 255.0 ECU_ADDRESS 0x0000 /* @ECU_Address@VHAL_CAN5RxErrorCount_raw@ */ /end MEASUREMENT
/begin MEASUREMENT VHAL_CAN5TxErrorCount_raw "" UBYTE SWC_HALIN_CDD_type_CM_uint8_raw 0 0 0.0 255.0 ECU_ADDRESS 0x0000 /* @ECU_Address@VHAL_CAN5TxErrorCount_raw@ */ /end MEASUREMENT
/begin MEASUREMENT VHAL_CAN6RxErrorCount_raw "" UBYTE SWC_HALIN_CDD_type_CM_uint8_raw 0 0 0.0 255.0 ECU_ADDRESS 0x0000 /* @ECU_Address@VHAL_CAN6RxErrorCount_raw@ */ /end MEASUREMENT
/begin MEASUREMENT VHAL_CAN6TxErrorCount_raw "" UBYTE SWC_HALIN_CDD_type_CM_uint8_raw 0 0 0.0 255.0 ECU_ADDRESS 0x0000 /* @ECU_Address@VHAL_CAN6TxErrorCount_raw@ */ /end MEASUREMENT
/begin MEASUREMENT VHAL_PASDRMR_cm "" UBYTE SWC_HALIN_CDD_type_CM_uint8_cm 0 0 0.0 255.0 ECU_ADDRESS 0x0000 /* @ECU_Address@VHAL_PASDRMR_cm@ */ /end MEASUREMENT
/begin MEASUREMENT VHAL_PASDRML_cm "" UBYTE SWC_HALIN_CDD_type_CM_uint8_cm 0 0 0.0 255.0 ECU_ADDRESS 0x0000 /* @ECU_Address@VHAL_PASDRML_cm@ */ /end MEASUREMENT
/begin MEASUREMENT VHAL_PASDRCR_cm "" UBYTE SWC_HALIN_CDD_type_CM_uint8_cm 0 0 0.0 255.0 ECU_ADDRESS 0x0000 /* @ECU_Address@VHAL_PASDRCR_cm@ */ /end MEASUREMENT
/begin MEASUREMENT VHAL_PASDRCL_cm "" UBYTE SWC_HALIN_CDD_type_CM_uint8_cm 0 0 0.0 255.0 ECU_ADDRESS 0x0000 /* @ECU_Address@VHAL_PASDRCL_cm@ */ /end MEASUREMENT
/begin MEASUREMENT VHAL_PASDFMR_cm "" UBYTE SWC_HALIN_CDD_type_CM_uint8_cm 0 0 0.0 255.0 ECU_ADDRESS 0x0000 /* @ECU_Address@VHAL_PASDFMR_cm@ */ /end MEASUREMENT
/begin MEASUREMENT VHAL_PASDFML_cm "" UBYTE SWC_HALIN_CDD_type_CM_uint8_cm 0 0 0.0 255.0 ECU_ADDRESS 0x0000 /* @ECU_Address@VHAL_PASDFML_cm@ */ /end MEASUREMENT
/begin MEASUREMENT VHAL_PASDFCR_cm "" UBYTE SWC_HALIN_CDD_type_CM_uint8_cm 0 0 0.0 255.0 ECU_ADDRESS 0x0000 /* @ECU_Address@VHAL_PASDFCR_cm@ */ /end MEASUREMENT
/begin MEASUREMENT VHAL_PASDFCL_cm "" UBYTE SWC_HALIN_CDD_type_CM_uint8_cm 0 0 0.0 255.0 ECU_ADDRESS 0x0000 /* @ECU_Address@VHAL_PASDFCL_cm@ */ /end MEASUREMENT
/begin MEASUREMENT VHAL_PASAFCL_enum "" UBYTE SWC_HALIN_CDD_type_CM_uint8_enum 0 0 0.0 255.0 ECU_ADDRESS 0x0000 /* @ECU_Address@VHAL_PASAFCL_enum@ */ /end MEASUREMENT
/begin MEASUREMENT VHAL_PASARMR_enum "" UBYTE SWC_HALIN_CDD_type_CM_uint8_enum 0 0 0.0 255.0 ECU_ADDRESS 0x0000 /* @ECU_Address@VHAL_PASARMR_enum@ */ /end MEASUREMENT
/begin MEASUREMENT VHAL_PASARML_enum "" UBYTE SWC_HALIN_CDD_type_CM_uint8_enum 0 0 0.0 255.0 ECU_ADDRESS 0x0000 /* @ECU_Address@VHAL_PASARML_enum@ */ /end MEASUREMENT
/begin MEASUREMENT VHAL_PASARCR_enum "" UBYTE SWC_HALIN_CDD_type_CM_uint8_enum 0 0 0.0 255.0 ECU_ADDRESS 0x0000 /* @ECU_Address@VHAL_PASARCR_enum@ */ /end MEASUREMENT
/begin MEASUREMENT VHAL_PASARCL_enum "" UBYTE SWC_HALIN_CDD_type_CM_uint8_enum 0 0 0.0 255.0 ECU_ADDRESS 0x0000 /* @ECU_Address@VHAL_PASARCL_enum@ */ /end MEASUREMENT
/begin MEASUREMENT VHAL_PASAFMR_enum "" UBYTE SWC_HALIN_CDD_type_CM_uint8_enum 0 0 0.0 255.0 ECU_ADDRESS 0x0000 /* @ECU_Address@VHAL_PASAFMR_enum@ */ /end MEASUREMENT
/begin MEASUREMENT VHAL_PASAFML_enum "" UBYTE SWC_HALIN_CDD_type_CM_uint8_enum 0 0 0.0 255.0 ECU_ADDRESS 0x0000 /* @ECU_Address@VHAL_PASAFML_enum@ */ /end MEASUREMENT
/begin MEASUREMENT VHAL_PASAFCR_enum "" UBYTE SWC_HALIN_CDD_type_CM_uint8_enum 0 0 0.0 255.0 ECU_ADDRESS 0x0000 /* @ECU_Address@VHAL_PASAFCR_enum@ */ /end MEASUREMENT
/begin MEASUREMENT VHAL_Chime_enum "" UBYTE SWC_HALIN_CDD_type_CM_uint8_enum 0 0 0.0 255.0 ECU_ADDRESS 0x0000 /* @ECU_Address@VHAL_Chime_enum@ */ /end MEASUREMENT
/begin MEASUREMENT VHAL_SNSRLayout_enum "" UBYTE SWC_HALIN_CDD_type_CM_uint8_enum 0 0 0.0 255.0 ECU_ADDRESS 0x0000 /* @ECU_Address@VHAL_SNSRLayout_enum@ */ /end MEASUREMENT
/begin MEASUREMENT VHAL_ModOperation_enum "" UBYTE SWC_HALIN_CDD_type_CM_uint8_enum 0 0 0.0 255.0 ECU_ADDRESS 0x0000 /* @ECU_Address@VHAL_ModOperation_enum@ */ /end MEASUREMENT
/begin MEASUREMENT VHAL_APSRQDisplay_enum "" UBYTE SWC_HALIN_CDD_type_CM_uint8_enum 0 0 0.0 255.0 ECU_ADDRESS 0x0000 /* @ECU_Address@VHAL_APSRQDisplay_enum@ */ /end MEASUREMENT
/begin MEASUREMENT VHAL_APSSWVer_enum "" UBYTE SWC_HALIN_CDD_type_CM_uint8_enum 0 0 0.0 255.0 ECU_ADDRESS 0x0000 /* @ECU_Address@VHAL_APSSWVer_enum@ */ /end MEASUREMENT
/begin MEASUREMENT VHAL_APSHWVer_enum "" UBYTE SWC_HALIN_CDD_type_CM_uint8_enum 0 0 0.0 255.0 ECU_ADDRESS 0x0000 /* @ECU_Address@VHAL_APSHWVer_enum@ */ /end MEASUREMENT
/begin MEASUREMENT VHAL_APSExitCondition_enum "" UBYTE SWC_HALIN_CDD_type_CM_uint8_enum 0 0 0.0 255.0 ECU_ADDRESS 0x0000 /* @ECU_Address@VHAL_APSExitCondition_enum@ */ /end MEASUREMENT
/begin MEASUREMENT VHAL_APSStaSystem_enum "" UBYTE SWC_HALIN_CDD_type_CM_uint8_enum 0 0 0.0 7.0 ECU_ADDRESS 0x0000 /* @ECU_Address@VHAL_APSStaSystem_enum@ */ /end MEASUREMENT
/begin MEASUREMENT VHAL_APSReq_enum "" UBYTE SWC_HALIN_CDD_type_CM_uint8_enum 0 0 0.0 7.0 ECU_ADDRESS 0x0000 /* @ECU_Address@VHAL_APSReq_enum@ */ /end MEASUREMENT
/begin MEASUREMENT VHAL_APSShiftPosnReq_enum "" UBYTE SWC_HALIN_CDD_type_CM_uint8_enum 0 0 0.0 15.0 ECU_ADDRESS 0x0000 /* @ECU_Address@VHAL_APSShiftPosnReq_enum@ */ /end MEASUREMENT
/begin MEASUREMENT VHAL_CAASSta_enum "" UBYTE SWC_HALIN_CDD_type_CM_uint8_enum 0 0 0.0 7.0 ECU_ADDRESS 0x0000 /* @ECU_Address@VHAL_CAASSta_enum@ */ /end MEASUREMENT
/begin MEASUREMENT VHAL_APSPwrReq_enum "" UBYTE SWC_HALIN_CDD_type_CM_uint8_enum 0 0 0.0 4.0 ECU_ADDRESS 0x0000 /* @ECU_Address@VHAL_APSPwrReq_enum@ */ /end MEASUREMENT
/begin MEASUREMENT VHAL_RAPSBCMLamp_enum "" UBYTE SWC_HALIN_CDD_type_CM_uint8_enum 0 0 0.0 3.0 ECU_ADDRESS 0x0000 /* @ECU_Address@VHAL_RAPSBCMLamp_enum@ */ /end MEASUREMENT
/begin MEASUREMENT VHAL_RAPSErrWarnSta_enum "" UBYTE SWC_HALIN_CDD_type_CM_uint8_enum 0 0 0.0 7.0 ECU_ADDRESS 0x0000 /* @ECU_Address@VHAL_RAPSErrWarnSta_enum@ */ /end MEASUREMENT
/begin MEASUREMENT VHAL_HWID1_enum "" UBYTE SWC_HALIN_CDD_type_CM_uint8_enum 0 0 0.0 255.0 ECU_ADDRESS 0x0000 /* @ECU_Address@VHAL_HWID1_enum@ */ /end MEASUREMENT
/begin MEASUREMENT VHAL_HWID2_enum "" UBYTE SWC_HALIN_CDD_type_CM_uint8_enum 0 0 0.0 255.0 ECU_ADDRESS 0x0000 /* @ECU_Address@VHAL_HWID2_enum@ */ /end MEASUREMENT
/begin MEASUREMENT VHAL_HWID3_enum "" UBYTE SWC_HALIN_CDD_type_CM_uint8_enum 0 0 0.0 255.0 ECU_ADDRESS 0x0000 /* @ECU_Address@VHAL_HWID3_enum@ */ /end MEASUREMENT
/begin MEASUREMENT VHAL_HWID4_enum "" UBYTE SWC_HALIN_CDD_type_CM_uint8_enum 0 0 0.0 255.0 ECU_ADDRESS 0x0000 /* @ECU_Address@VHAL_HWID4_enum@ */ /end MEASUREMENT
/begin MEASUREMENT VHAL_CarMode1_cnt "" UBYTE SWC_HALIN_CDD_type_CM_uint8_cnt 0 0 0.0 255.0 ECU_ADDRESS 0x0000 /* @ECU_Address@VHAL_CarMode1_cnt@ */ /end MEASUREMENT
/begin MEASUREMENT VHAL_CarModel2_cnt "" UBYTE SWC_HALIN_CDD_type_CM_uint8_cnt 0 0 0.0 255.0 ECU_ADDRESS 0x0000 /* @ECU_Address@VHAL_CarModel2_cnt@ */ /end MEASUREMENT
/begin MEASUREMENT VHAL_CarModel3_cnt "" UBYTE SWC_HALIN_CDD_type_CM_uint8_cnt 0 0 0.0 255.0 ECU_ADDRESS 0x0000 /* @ECU_Address@VHAL_CarModel3_cnt@ */ /end MEASUREMENT
/begin MEASUREMENT VHAL_ECU1_cnt "" UBYTE SWC_HALIN_CDD_type_CM_uint8_cnt 0 0 0.0 255.0 ECU_ADDRESS 0x0000 /* @ECU_Address@VHAL_ECU1_cnt@ */ /end MEASUREMENT
/begin MEASUREMENT VHAL_ECU2_cnt "" UBYTE SWC_HALIN_CDD_type_CM_uint8_cnt 0 0 0.0 255.0 ECU_ADDRESS 0x0000 /* @ECU_Address@VHAL_ECU2_cnt@ */ /end MEASUREMENT
/begin MEASUREMENT VHAL_Major1_cnt "" UBYTE SWC_HALIN_CDD_type_CM_uint8_cnt 0 0 0.0 255.0 ECU_ADDRESS 0x0000 /* @ECU_Address@VHAL_Major1_cnt@ */ /end MEASUREMENT
/begin MEASUREMENT VHAL_Major2_cnt "" UBYTE SWC_HALIN_CDD_type_CM_uint8_cnt 0 0 0.0 255.0 ECU_ADDRESS 0x0000 /* @ECU_Address@VHAL_Major2_cnt@ */ /end MEASUREMENT
/begin MEASUREMENT VHAL_Minor1_cnt "" UBYTE SWC_HALIN_CDD_type_CM_uint8_cnt 0 0 0.0 255.0 ECU_ADDRESS 0x0000 /* @ECU_Address@VHAL_Minor1_cnt@ */ /end MEASUREMENT
/begin MEASUREMENT VHAL_Minor2_cnt "" UBYTE SWC_HALIN_CDD_type_CM_uint8_cnt 0 0 0.0 255.0 ECU_ADDRESS 0x0000 /* @ECU_Address@VHAL_Minor2_cnt@ */ /end MEASUREMENT
/begin MEASUREMENT VHAL_Patch1_cnt "" UBYTE SWC_HALIN_CDD_type_CM_uint8_cnt 0 0 0.0 255.0 ECU_ADDRESS 0x0000 /* @ECU_Address@VHAL_Patch1_cnt@ */ /end MEASUREMENT
/begin MEASUREMENT VHAL_Patch2_cnt "" UBYTE SWC_HALIN_CDD_type_CM_uint8_cnt 0 0 0.0 255.0 ECU_ADDRESS 0x0000 /* @ECU_Address@VHAL_Patch2_cnt@ */ /end MEASUREMENT
/begin MEASUREMENT VHAL_Country1_cnt "" UBYTE SWC_HALIN_CDD_type_CM_uint8_cnt 0 0 0.0 255.0 ECU_ADDRESS 0x0000 /* @ECU_Address@VHAL_Country1_cnt@ */ /end MEASUREMENT
/begin MEASUREMENT VHAL_Country2_cnt "" UBYTE SWC_HALIN_CDD_type_CM_uint8_cnt 0 0 0.0 255.0 ECU_ADDRESS 0x0000 /* @ECU_Address@VHAL_Country2_cnt@ */ /end MEASUREMENT
/begin MEASUREMENT VHAL_Variation_cnt "" UBYTE SWC_HALIN_CDD_type_CM_uint8_cnt 0 0 0.0 255.0 ECU_ADDRESS 0x0000 /* @ECU_Address@VHAL_Variation_cnt@ */ /end MEASUREMENT
/begin MEASUREMENT VHAL_ECUGen1_cnt "" UBYTE SWC_HALIN_CDD_type_CM_uint8_cnt 0 0 0.0 255.0 ECU_ADDRESS 0x0000 /* @ECU_Address@VHAL_ECUGen1_cnt@ */ /end MEASUREMENT
/begin MEASUREMENT VHAL_ECUGen2_cnt "" UBYTE SWC_HALIN_CDD_type_CM_uint8_cnt 0 0 0.0 255.0 ECU_ADDRESS 0x0000 /* @ECU_Address@VHAL_ECUGen2_cnt@ */ /end MEASUREMENT
/begin MEASUREMENT VHAL_DrivingMode_cnt "" UBYTE SWC_HALIN_CDD_type_CM_uint8_cnt 0 0 0.0 255.0 ECU_ADDRESS 0x0000 /* @ECU_Address@VHAL_DrivingMode_cnt@ */ /end MEASUREMENT
/begin MEASUREMENT VHAL_ModelYear_cnt "" UBYTE SWC_HALIN_CDD_type_CM_uint8_cnt 0 0 0.0 255.0 ECU_ADDRESS 0x0000 /* @ECU_Address@VHAL_ModelYear_cnt@ */ /end MEASUREMENT
/begin MEASUREMENT VHAL_Var4_cnt "" UBYTE SWC_HALIN_CDD_type_CM_uint8_cnt 0 0 0.0 255.0 ECU_ADDRESS 0x0000 /* @ECU_Address@VHAL_Var4_cnt@ */ /end MEASUREMENT
/begin MEASUREMENT VHAL_Var5_cnt "" UBYTE SWC_HALIN_CDD_type_CM_uint8_cnt 0 0 0.0 255.0 ECU_ADDRESS 0x0000 /* @ECU_Address@VHAL_Var5_cnt@ */ /end MEASUREMENT
/begin MEASUREMENT VHAL_Dash1_cnt "" UBYTE SWC_HALIN_CDD_type_CM_uint8_cnt 0 0 0.0 255.0 ECU_ADDRESS 0x0000 /* @ECU_Address@VHAL_Dash1_cnt@ */ /end MEASUREMENT
/begin MEASUREMENT VHAL_Change1_cnt "" UBYTE SWC_HALIN_CDD_type_CM_uint8_cnt 0 0 0.0 255.0 ECU_ADDRESS 0x0000 /* @ECU_Address@VHAL_Change1_cnt@ */ /end MEASUREMENT
/begin MEASUREMENT VHAL_Change2_cnt "" UBYTE SWC_HALIN_CDD_type_CM_uint8_cnt 0 0 0.0 255.0 ECU_ADDRESS 0x0000 /* @ECU_Address@VHAL_Change2_cnt@ */ /end MEASUREMENT
/begin MEASUREMENT VHAL_Dash2_cnt "" UBYTE SWC_HALIN_CDD_type_CM_uint8_cnt 0 0 0.0 255.0 ECU_ADDRESS 0x0000 /* @ECU_Address@VHAL_Dash2_cnt@ */ /end MEASUREMENT
/begin MEASUREMENT VHAL_SHA1_cnt "" UBYTE SWC_HALIN_CDD_type_CM_uint8_cnt 0 0 0.0 255.0 ECU_ADDRESS 0x0000 /* @ECU_Address@VHAL_SHA1_cnt@ */ /end MEASUREMENT
/begin MEASUREMENT VHAL_SHA2_cnt "" UBYTE SWC_HALIN_CDD_type_CM_uint8_cnt 0 0 0.0 255.0 ECU_ADDRESS 0x0000 /* @ECU_Address@VHAL_SHA2_cnt@ */ /end MEASUREMENT
/begin MEASUREMENT VHAL_SHA3_cnt "" UBYTE SWC_HALIN_CDD_type_CM_uint8_cnt 0 0 0.0 255.0 ECU_ADDRESS 0x0000 /* @ECU_Address@VHAL_SHA3_cnt@ */ /end MEASUREMENT
/begin MEASUREMENT VHAL_SHA4_cnt "" UBYTE SWC_HALIN_CDD_type_CM_uint8_cnt 0 0 0.0 255.0 ECU_ADDRESS 0x0000 /* @ECU_Address@VHAL_SHA4_cnt@ */ /end MEASUREMENT
/begin MEASUREMENT VHAL_SHA5_cnt "" UBYTE SWC_HALIN_CDD_type_CM_uint8_cnt 0 0 0.0 255.0 ECU_ADDRESS 0x0000 /* @ECU_Address@VHAL_SHA5_cnt@ */ /end MEASUREMENT
/begin MEASUREMENT VHAL_SHA6_cnt "" UBYTE SWC_HALIN_CDD_type_CM_uint8_cnt 0 0 0.0 255.0 ECU_ADDRESS 0x0000 /* @ECU_Address@VHAL_SHA6_cnt@ */ /end MEASUREMENT
/begin MEASUREMENT VHAL_SHA7_cnt "" UBYTE SWC_HALIN_CDD_type_CM_uint8_cnt 0 0 0.0 255.0 ECU_ADDRESS 0x0000 /* @ECU_Address@VHAL_SHA7_cnt@ */ /end MEASUREMENT
/begin MEASUREMENT VHAL_SHA8_cnt "" UBYTE SWC_HALIN_CDD_type_CM_uint8_cnt 0 0 0.0 255.0 ECU_ADDRESS 0x0000 /* @ECU_Address@VHAL_SHA8_cnt@ */ /end MEASUREMENT
/begin MEASUREMENT VHAL_PwrReq_OTA_enum "" UBYTE SWC_HALIN_CDD_type_CM_uint8_OTA_enum 0 0 0.0 255.0 ECU_ADDRESS 0x0000 /* @ECU_Address@VHAL_PwrReq_OTA_enum@ */ /end MEASUREMENT
/begin MEASUREMENT VHAL_AllowMovThd_OTA_enum "" UBYTE SWC_HALIN_CDD_type_CM_uint8_OTA_enum 0 0 0.0 255.0 ECU_ADDRESS 0x0000 /* @ECU_Address@VHAL_AllowMovThd_OTA_enum@ */ /end MEASUREMENT
/begin MEASUREMENT VHAL_FlashDrivetrain_enum "" UBYTE SWC_HALIN_CDD_type_CM_uint8_enum 0 0 0.0 255.0 ECU_ADDRESS 0x0000 /* @ECU_Address@VHAL_FlashDrivetrain_enum@ */ /end MEASUREMENT
/begin MEASUREMENT VHAL_DrivetrainSelect_enum "" UBYTE SWC_HALIN_CDD_type_CM_uint8_enum 0 0 0.0 255.0 ECU_ADDRESS 0x0000 /* @ECU_Address@VHAL_DrivetrainSelect_enum@ */ /end MEASUREMENT
/begin MEASUREMENT VHAL_FlashAntitheft_enum "" UBYTE SWC_HALIN_CDD_type_CM_uint8_enum 0 0 0.0 255.0 ECU_ADDRESS 0x0000 /* @ECU_Address@VHAL_FlashAntitheft_enum@ */ /end MEASUREMENT
/begin MEASUREMENT VHAL_RandomnumberY_raw1 "" UBYTE SWC_HALIN_CDD_type_CM_uint8_raw1 0 0 0.0 255.0 ECU_ADDRESS 0x0000 /* @ECU_Address@VHAL_RandomnumberY_raw1@ */ /end MEASUREMENT
/begin MEASUREMENT VHAL_RandomnumberY_raw2 "" UBYTE SWC_HALIN_CDD_type_CM_uint8_raw2 0 0 0.0 255.0 ECU_ADDRESS 0x0000 /* @ECU_Address@VHAL_RandomnumberY_raw2@ */ /end MEASUREMENT
/begin MEASUREMENT VHAL_RandomnumberY_raw3 "" UBYTE SWC_HALIN_CDD_type_CM_uint8_raw3 0 0 0.0 255.0 ECU_ADDRESS 0x0000 /* @ECU_Address@VHAL_RandomnumberY_raw3@ */ /end MEASUREMENT
/begin MEASUREMENT VHAL_RandomnumberY_raw4 "" UBYTE SWC_HALIN_CDD_type_CM_uint8_raw4 0 0 0.0 255.0 ECU_ADDRESS 0x0000 /* @ECU_Address@VHAL_RandomnumberY_raw4@ */ /end MEASUREMENT
/begin MEASUREMENT VHAL_RandomnumberY_raw5 "" UBYTE SWC_HALIN_CDD_type_CM_uint8_raw5 0 0 0.0 255.0 ECU_ADDRESS 0x0000 /* @ECU_Address@VHAL_RandomnumberY_raw5@ */ /end MEASUREMENT
/begin MEASUREMENT VHAL_RandomnumberY_raw6 "" UBYTE SWC_HALIN_CDD_type_CM_uint8_raw6 0 0 0.0 255.0 ECU_ADDRESS 0x0000 /* @ECU_Address@VHAL_RandomnumberY_raw6@ */ /end MEASUREMENT
/begin MEASUREMENT VHAL_RandomnumberY_raw7 "" UBYTE SWC_HALIN_CDD_type_CM_uint8_raw7 0 0 0.0 255.0 ECU_ADDRESS 0x0000 /* @ECU_Address@VHAL_RandomnumberY_raw7@ */ /end MEASUREMENT
/begin MEASUREMENT VHAL_RandomnumberY_raw8 "" UBYTE SWC_HALIN_CDD_type_CM_uint8_raw8 0 0 0.0 255.0 ECU_ADDRESS 0x0000 /* @ECU_Address@VHAL_RandomnumberY_raw8@ */ /end MEASUREMENT
/begin MEASUREMENT VHAL_FlashACModeSet123_enum "" UBYTE SWC_HALIN_CDD_type_CM_uint8_enum 0 0 0.0 255.0 ECU_ADDRESS 0x0000 /* @ECU_Address@VHAL_FlashACModeSet123_enum@ */ /end MEASUREMENT
/begin MEASUREMENT VHAL_FlashFace_enum "" UBYTE SWC_HALIN_CDD_type_CM_uint8_enum 0 0 0.0 255.0 ECU_ADDRESS 0x0000 /* @ECU_Address@VHAL_FlashFace_enum@ */ /end MEASUREMENT
/begin MEASUREMENT VHAL_FlashFoot_enum "" UBYTE SWC_HALIN_CDD_type_CM_uint8_enum 0 0 0.0 255.0 ECU_ADDRESS 0x0000 /* @ECU_Address@VHAL_FlashFoot_enum@ */ /end MEASUREMENT
/begin MEASUREMENT VHAL_FlashFrost_enum "" UBYTE SWC_HALIN_CDD_type_CM_uint8_enum 0 0 0.0 255.0 ECU_ADDRESS 0x0000 /* @ECU_Address@VHAL_FlashFrost_enum@ */ /end MEASUREMENT
/begin MEASUREMENT VHAL_FlashFaceM_enum "" UBYTE SWC_HALIN_CDD_type_CM_uint8_enum 0 0 0.0 255.0 ECU_ADDRESS 0x0000 /* @ECU_Address@VHAL_FlashFaceM_enum@ */ /end MEASUREMENT
/begin MEASUREMENT VHAL_FlashFootM_enum "" UBYTE SWC_HALIN_CDD_type_CM_uint8_enum 0 0 0.0 255.0 ECU_ADDRESS 0x0000 /* @ECU_Address@VHAL_FlashFootM_enum@ */ /end MEASUREMENT
/begin MEASUREMENT VHAL_FlashCCUSyncSts_enum "" UBYTE SWC_HALIN_CDD_type_CM_uint8_enum 0 0 0.0 255.0 ECU_ADDRESS 0x0000 /* @ECU_Address@VHAL_FlashCCUSyncSts_enum@ */ /end MEASUREMENT
/begin MEASUREMENT VHAL_FlashsigRecircSt_enum "" UBYTE SWC_HALIN_CDD_type_CM_uint8_enum 0 0 0.0 255.0 ECU_ADDRESS 0x0000 /* @ECU_Address@VHAL_FlashsigRecircSt_enum@ */ /end MEASUREMENT
/begin MEASUREMENT VHAL_FlashRecAutoFlg_enum "" UBYTE SWC_HALIN_CDD_type_CM_uint8_enum 0 0 0.0 255.0 ECU_ADDRESS 0x0000 /* @ECU_Address@VHAL_FlashRecAutoFlg_enum@ */ /end MEASUREMENT
/begin MEASUREMENT VHAL_FlashAirIntenZone1M_enum "" UBYTE SWC_HALIN_CDD_type_CM_uint8_enum 0 0 0.0 255.0 ECU_ADDRESS 0x0000 /* @ECU_Address@VHAL_FlashAirIntenZone1M_enum@ */ /end MEASUREMENT
/begin MEASUREMENT VHAL_Flashfdefog_enum "" UBYTE SWC_HALIN_CDD_type_CM_uint8_enum 0 0 0.0 255.0 ECU_ADDRESS 0x0000 /* @ECU_Address@VHAL_Flashfdefog_enum@ */ /end MEASUREMENT
/begin MEASUREMENT VHAL_FlashsigSetTempZon1St_C "" UBYTE SWC_HALIN_CDD_type_CM_uint8_C 0 0 0.0 255.0 ECU_ADDRESS 0x0000 /* @ECU_Address@VHAL_FlashsigSetTempZon1St_C@ */ /end MEASUREMENT
/begin MEASUREMENT VHAL_FlashsigSetTempZon2StM_C "" UBYTE SWC_HALIN_CDD_type_CM_uint8_C 0 0 0.0 255.0 ECU_ADDRESS 0x0000 /* @ECU_Address@VHAL_FlashsigSetTempZon2StM_C@ */ /end MEASUREMENT
/begin MEASUREMENT VHAL_FlashCountAlarm_enum "" UBYTE SWC_HALIN_CDD_type_CM_uint8_enum 0 0 0.0 255.0 ECU_ADDRESS 0x0000 /* @ECU_Address@VHAL_FlashCountAlarm_enum@ */ /end MEASUREMENT
/begin MEASUREMENT VHAL_FlashLockSetting_enum "" UBYTE SWC_HALIN_CDD_type_CM_uint8_enum 0 0 0.0 255.0 ECU_ADDRESS 0x0000 /* @ECU_Address@VHAL_FlashLockSetting_enum@ */ /end MEASUREMENT
/begin MEASUREMENT VHAL_FlashMFRDNBrightReq_pct "" UBYTE SWC_HALIN_CDD_type_CM_uint8_pct 0 0 0.0 255.0 ECU_ADDRESS 0x0000 /* @ECU_Address@VHAL_FlashMFRDNBrightReq_pct@ */ /end MEASUREMENT
/begin MEASUREMENT VHAL_FlashRoomLampMode_enum "" UBYTE SWC_HALIN_CDD_type_CM_uint8_enum 0 0 0.0 255.0 ECU_ADDRESS 0x0000 /* @ECU_Address@VHAL_FlashRoomLampMode_enum@ */ /end MEASUREMENT
/begin MEASUREMENT VHAL_FlashIVIPTGUSStaSW_enum "" UBYTE SWC_HALIN_CDD_type_CM_uint8_enum 0 0 0.0 255.0 ECU_ADDRESS 0x0000 /* @ECU_Address@VHAL_FlashIVIPTGUSStaSW_enum@ */ /end MEASUREMENT
/begin MEASUREMENT VHAL_CurrentNmState_enum "" UBYTE SWC_HALIN_CDD_type_CM_uint8_enum 0 0 0.0 255.0 ECU_ADDRESS 0x0000 /* @ECU_Address@VHAL_CurrentNmState_enum@ */ /end MEASUREMENT
/begin MEASUREMENT VHAL_PmicBootReason_enum "" UBYTE SWC_HALIN_CDD_type_CM_uint8_enum 0 0 0.0 255.0 ECU_ADDRESS 0x0000 /* @ECU_Address@VHAL_PmicBootReason_enum@ */ /end MEASUREMENT
/begin MEASUREMENT VHAL_DIDFlashAutoLock_raw8 "" UBYTE SWC_HALIN_CDD_type_CM_uint8_raw8 0 0 0.0 255.0 ECU_ADDRESS 0x0000 /* @ECU_Address@VHAL_DIDFlashAutoLock_raw8@ */ /end MEASUREMENT
/begin MEASUREMENT VHAL_DIDFlashDRLDis_raw8 "" UBYTE SWC_HALIN_CDD_type_CM_uint8_raw8 0 0 0.0 255.0 ECU_ADDRESS 0x0000 /* @ECU_Address@VHAL_DIDFlashDRLDis_raw8@ */ /end MEASUREMENT
/begin MEASUREMENT VHAL_DIDFlashFMHTimer_raw8 "" UBYTE SWC_HALIN_CDD_type_CM_uint8_raw8 0 0 0.0 255.0 ECU_ADDRESS 0x0000 /* @ECU_Address@VHAL_DIDFlashFMHTimer_raw8@ */ /end MEASUREMENT
/begin MEASUREMENT VHAL_DIDFlashTurnLampFLThreCurr_raw8 "" UBYTE SWC_HALIN_CDD_type_CM_uint8_raw8 0 0 0.0 255.0 ECU_ADDRESS 0x0000 /* @ECU_Address@VHAL_DIDFlashTurnLampFLThreCurr_raw8@ */ /end MEASUREMENT
/begin MEASUREMENT VHAL_DIDFlashTurnLampFRThreCurr_raw8 "" UBYTE SWC_HALIN_CDD_type_CM_uint8_raw8 0 0 0.0 255.0 ECU_ADDRESS 0x0000 /* @ECU_Address@VHAL_DIDFlashTurnLampFRThreCurr_raw8@ */ /end MEASUREMENT
/begin MEASUREMENT VHAL_DIDFlashTurnLampRLThreCurr_raw8 "" UBYTE SWC_HALIN_CDD_type_CM_uint8_raw8 0 0 0.0 255.0 ECU_ADDRESS 0x0000 /* @ECU_Address@VHAL_DIDFlashTurnLampRLThreCurr_raw8@ */ /end MEASUREMENT
/begin MEASUREMENT VHAL_DIDFlashTurnLampRRThreCurr_raw8 "" UBYTE SWC_HALIN_CDD_type_CM_uint8_raw8 0 0 0.0 255.0 ECU_ADDRESS 0x0000 /* @ECU_Address@VHAL_DIDFlashTurnLampRRThreCurr_raw8@ */ /end MEASUREMENT
/begin MEASUREMENT VHAL_ReadRegenMode_enum "" UBYTE SWC_HALIN_CDD_type_CM_uint8_enum 0 0 0.0 255.0 ECU_ADDRESS 0x0000 /* @ECU_Address@VHAL_ReadRegenMode_enum@ */ /end MEASUREMENT
/begin MEASUREMENT VHAL_FlashRegenMode_enum "" UBYTE SWC_HALIN_CDD_type_CM_uint8_enum 0 0 0.0 255.0 ECU_ADDRESS 0x0000 /* @ECU_Address@VHAL_FlashRegenMode_enum@ */ /end MEASUREMENT
/begin MEASUREMENT VHAL_FlashAmbFunEN_enum "" UBYTE SWC_HALIN_CDD_type_CM_uint8_enum 0 0 0.0 255.0 ECU_ADDRESS 0x0000 /* @ECU_Address@VHAL_FlashAmbFunEN_enum@ */ /end MEASUREMENT
/begin MEASUREMENT VHAL_FlashAmbWelEN_enum "" UBYTE SWC_HALIN_CDD_type_CM_uint8_enum 0 0 0.0 255.0 ECU_ADDRESS 0x0000 /* @ECU_Address@VHAL_FlashAmbWelEN_enum@ */ /end MEASUREMENT
/begin MEASUREMENT VHAL_FlashAmbDimEN_enum "" UBYTE SWC_HALIN_CDD_type_CM_uint8_enum 0 0 0.0 255.0 ECU_ADDRESS 0x0000 /* @ECU_Address@VHAL_FlashAmbDimEN_enum@ */ /end MEASUREMENT
/begin MEASUREMENT VHAL_FlashAmbLinkDriSta_enum "" UBYTE SWC_HALIN_CDD_type_CM_uint8_enum 0 0 0.0 255.0 ECU_ADDRESS 0x0000 /* @ECU_Address@VHAL_FlashAmbLinkDriSta_enum@ */ /end MEASUREMENT
/begin MEASUREMENT VHAL_FlashAmbPwrWarnEN_enum "" UBYTE SWC_HALIN_CDD_type_CM_uint8_enum 0 0 0.0 255.0 ECU_ADDRESS 0x0000 /* @ECU_Address@VHAL_FlashAmbPwrWarnEN_enum@ */ /end MEASUREMENT
/begin MEASUREMENT VHAL_FlashAmbODAEN_enum "" UBYTE SWC_HALIN_CDD_type_CM_uint8_enum 0 0 0.0 255.0 ECU_ADDRESS 0x0000 /* @ECU_Address@VHAL_FlashAmbODAEN_enum@ */ /end MEASUREMENT
/begin MEASUREMENT VHAL_FlashAmbColorSta1_enum "" UBYTE SWC_HALIN_CDD_type_CM_uint8_enum 0 0 0.0 255.0 ECU_ADDRESS 0x0000 /* @ECU_Address@VHAL_FlashAmbColorSta1_enum@ */ /end MEASUREMENT
/begin MEASUREMENT VHAL_FlashAmbColorSta2_enum "" UBYTE SWC_HALIN_CDD_type_CM_uint8_enum 0 0 0.0 255.0 ECU_ADDRESS 0x0000 /* @ECU_Address@VHAL_FlashAmbColorSta2_enum@ */ /end MEASUREMENT
/begin MEASUREMENT VHAL_FlashAmbColorSta3_enum "" UBYTE SWC_HALIN_CDD_type_CM_uint8_enum 0 0 0.0 255.0 ECU_ADDRESS 0x0000 /* @ECU_Address@VHAL_FlashAmbColorSta3_enum@ */ /end MEASUREMENT
/begin MEASUREMENT VHAL_FlashAmbColorSta4_enum "" UBYTE SWC_HALIN_CDD_type_CM_uint8_enum 0 0 0.0 255.0 ECU_ADDRESS 0x0000 /* @ECU_Address@VHAL_FlashAmbColorSta4_enum@ */ /end MEASUREMENT
/begin MEASUREMENT VHAL_FlashAmbColorSta5_enum "" UBYTE SWC_HALIN_CDD_type_CM_uint8_enum 0 0 0.0 255.0 ECU_ADDRESS 0x0000 /* @ECU_Address@VHAL_FlashAmbColorSta5_enum@ */ /end MEASUREMENT
/begin MEASUREMENT VHAL_FlashAmbColorSta7_enum "" UBYTE SWC_HALIN_CDD_type_CM_uint8_enum 0 0 0.0 255.0 ECU_ADDRESS 0x0000 /* @ECU_Address@VHAL_FlashAmbColorSta7_enum@ */ /end MEASUREMENT
/begin MEASUREMENT VHAL_FlashAmbBrightnessSta1_enum "" UBYTE SWC_HALIN_CDD_type_CM_uint8_enum 0 0 0.0 255.0 ECU_ADDRESS 0x0000 /* @ECU_Address@VHAL_FlashAmbBrightnessSta1_enum@ */ /end MEASUREMENT
/begin MEASUREMENT VHAL_FlashAmbBrightnessSta2_enum "" UBYTE SWC_HALIN_CDD_type_CM_uint8_enum 0 0 0.0 255.0 ECU_ADDRESS 0x0000 /* @ECU_Address@VHAL_FlashAmbBrightnessSta2_enum@ */ /end MEASUREMENT
/begin MEASUREMENT VHAL_FlashAmbBrightnessSta3_enum "" UBYTE SWC_HALIN_CDD_type_CM_uint8_enum 0 0 0.0 255.0 ECU_ADDRESS 0x0000 /* @ECU_Address@VHAL_FlashAmbBrightnessSta3_enum@ */ /end MEASUREMENT
/begin MEASUREMENT VHAL_FlashAmbBrightnessSta4_enum "" UBYTE SWC_HALIN_CDD_type_CM_uint8_enum 0 0 0.0 255.0 ECU_ADDRESS 0x0000 /* @ECU_Address@VHAL_FlashAmbBrightnessSta4_enum@ */ /end MEASUREMENT
/begin MEASUREMENT VHAL_FlashAmbBrightnessSta5_enum "" UBYTE SWC_HALIN_CDD_type_CM_uint8_enum 0 0 0.0 255.0 ECU_ADDRESS 0x0000 /* @ECU_Address@VHAL_FlashAmbBrightnessSta5_enum@ */ /end MEASUREMENT
/begin MEASUREMENT VHAL_FlashAmbBrightnessSta7_enum "" UBYTE SWC_HALIN_CDD_type_CM_uint8_enum 0 0 0.0 255.0 ECU_ADDRESS 0x0000 /* @ECU_Address@VHAL_FlashAmbBrightnessSta7_enum@ */ /end MEASUREMENT
/begin MEASUREMENT VHAL_FlashTurnSwTSet123_enum "" UBYTE SWC_HALIN_CDD_type_CM_uint8_enum 0 0 0.0 255.0 ECU_ADDRESS 0x0000 /* @ECU_Address@VHAL_FlashTurnSwTSet123_enum@ */ /end MEASUREMENT
/begin MEASUREMENT VHAL_FlashTurnSwTSet457_enum "" UBYTE SWC_HALIN_CDD_type_CM_uint8_enum 0 0 0.0 255.0 ECU_ADDRESS 0x0000 /* @ECU_Address@VHAL_FlashTurnSwTSet457_enum@ */ /end MEASUREMENT
/begin MEASUREMENT VHAL_FlashAirIntZ3Sta_enum "" UBYTE SWC_HALIN_CDD_type_CM_uint8_enum 0 0 0.0 255.0 ECU_ADDRESS 0x0000 /* @ECU_Address@VHAL_FlashAirIntZ3Sta_enum@ */ /end MEASUREMENT
/begin MEASUREMENT VHAL_FlashREVentModeSta_enum "" UBYTE SWC_HALIN_CDD_type_CM_uint8_enum 0 0 0.0 255.0 ECU_ADDRESS 0x0000 /* @ECU_Address@VHAL_FlashREVentModeSta_enum@ */ /end MEASUREMENT
/begin MEASUREMENT VHAL_FlashLEVentModeSta_enum "" UBYTE SWC_HALIN_CDD_type_CM_uint8_enum 0 0 0.0 255.0 ECU_ADDRESS 0x0000 /* @ECU_Address@VHAL_FlashLEVentModeSta_enum@ */ /end MEASUREMENT
/begin MEASUREMENT VHAL_FlashLEVentZSta_enum "" UBYTE SWC_HALIN_CDD_type_CM_uint8_enum 0 0 0.0 255.0 ECU_ADDRESS 0x0000 /* @ECU_Address@VHAL_FlashLEVentZSta_enum@ */ /end MEASUREMENT
/begin MEASUREMENT VHAL_FlashCLEVentZSta_enum "" UBYTE SWC_HALIN_CDD_type_CM_uint8_enum 0 0 0.0 255.0 ECU_ADDRESS 0x0000 /* @ECU_Address@VHAL_FlashCLEVentZSta_enum@ */ /end MEASUREMENT
/begin MEASUREMENT VHAL_FlashREVentZSta_enum "" UBYTE SWC_HALIN_CDD_type_CM_uint8_enum 0 0 0.0 255.0 ECU_ADDRESS 0x0000 /* @ECU_Address@VHAL_FlashREVentZSta_enum@ */ /end MEASUREMENT
/begin MEASUREMENT VHAL_FlashCREVentZSta_enum "" UBYTE SWC_HALIN_CDD_type_CM_uint8_enum 0 0 0.0 255.0 ECU_ADDRESS 0x0000 /* @ECU_Address@VHAL_FlashCREVentZSta_enum@ */ /end MEASUREMENT
/begin MEASUREMENT VHAL_FlashLVentEN_enum "" UBYTE SWC_HALIN_CDD_type_CM_uint8_enum 0 0 0.0 255.0 ECU_ADDRESS 0x0000 /* @ECU_Address@VHAL_FlashLVentEN_enum@ */ /end MEASUREMENT
/begin MEASUREMENT VHAL_FlashLEVentYSta_enum "" UBYTE SWC_HALIN_CDD_type_CM_uint8_enum 0 0 0.0 255.0 ECU_ADDRESS 0x0000 /* @ECU_Address@VHAL_FlashLEVentYSta_enum@ */ /end MEASUREMENT
/begin MEASUREMENT VHAL_FlashCLVentEN_enum "" UBYTE SWC_HALIN_CDD_type_CM_uint8_enum 0 0 0.0 255.0 ECU_ADDRESS 0x0000 /* @ECU_Address@VHAL_FlashCLVentEN_enum@ */ /end MEASUREMENT
/begin MEASUREMENT VHAL_FlashCLEVentYSta_enum "" UBYTE SWC_HALIN_CDD_type_CM_uint8_enum 0 0 0.0 255.0 ECU_ADDRESS 0x0000 /* @ECU_Address@VHAL_FlashCLEVentYSta_enum@ */ /end MEASUREMENT
/begin MEASUREMENT VHAL_FlashRVentEN_enum "" UBYTE SWC_HALIN_CDD_type_CM_uint8_enum 0 0 0.0 255.0 ECU_ADDRESS 0x0000 /* @ECU_Address@VHAL_FlashRVentEN_enum@ */ /end MEASUREMENT
/begin MEASUREMENT VHAL_FlashREVentYSta_enum "" UBYTE SWC_HALIN_CDD_type_CM_uint8_enum 0 0 0.0 255.0 ECU_ADDRESS 0x0000 /* @ECU_Address@VHAL_FlashREVentYSta_enum@ */ /end MEASUREMENT
/begin MEASUREMENT VHAL_FlashCRVentEN_enum "" UBYTE SWC_HALIN_CDD_type_CM_uint8_enum 0 0 0.0 255.0 ECU_ADDRESS 0x0000 /* @ECU_Address@VHAL_FlashCRVentEN_enum@ */ /end MEASUREMENT
/begin MEASUREMENT VHAL_FlashCREVentYSta_enum "" UBYTE SWC_HALIN_CDD_type_CM_uint8_enum 0 0 0.0 255.0 ECU_ADDRESS 0x0000 /* @ECU_Address@VHAL_FlashCREVentYSta_enum@ */ /end MEASUREMENT
/begin MEASUREMENT VHAL_FlashFGSAirIntSta_enum "" UBYTE SWC_HALIN_CDD_type_CM_uint8_enum 0 0 0.0 255.0 ECU_ADDRESS 0x0000 /* @ECU_Address@VHAL_FlashFGSAirIntSta_enum@ */ /end MEASUREMENT
/begin MEASUREMENT VHAL_FlashFGSChSta_enum "" UBYTE SWC_HALIN_CDD_type_CM_uint8_enum 0 0 0.0 255.0 ECU_ADDRESS 0x0000 /* @ECU_Address@VHAL_FlashFGSChSta_enum@ */ /end MEASUREMENT
/begin MEASUREMENT VHAL_FlashFGSIONSWSta_enum "" UBYTE SWC_HALIN_CDD_type_CM_uint8_enum 0 0 0.0 255.0 ECU_ADDRESS 0x0000 /* @ECU_Address@VHAL_FlashFGSIONSWSta_enum@ */ /end MEASUREMENT
/begin MEASUREMENT VHAL_FlashWalkOutLkEN_enum "" UBYTE SWC_HALIN_CDD_type_CM_uint8_enum 0 0 0.0 255.0 ECU_ADDRESS 0x0000 /* @ECU_Address@VHAL_FlashWalkOutLkEN_enum@ */ /end MEASUREMENT
/begin MEASUREMENT VHAL_FlashWalkInUnLkEN_enum "" UBYTE SWC_HALIN_CDD_type_CM_uint8_enum 0 0 0.0 255.0 ECU_ADDRESS 0x0000 /* @ECU_Address@VHAL_FlashWalkInUnLkEN_enum@ */ /end MEASUREMENT
/begin MEASUREMENT VHAL_FlashFollowMeENFun_enum "" UBYTE SWC_HALIN_CDD_type_CM_uint8_enum 0 0 0.0 255.0 ECU_ADDRESS 0x0000 /* @ECU_Address@VHAL_FlashFollowMeENFun_enum@ */ /end MEASUREMENT
/begin MEASUREMENT VHAL_ResetPedalZeroPosReq_enum "" UBYTE SWC_HALIN_CDD_type_CM_uint8_enum 0 0 0.0 255.0 ECU_ADDRESS 0x0000 /* @ECU_Address@VHAL_ResetPedalZeroPosReq_enum@ */ /end MEASUREMENT
/begin MEASUREMENT VHAL_FlashPTGOpenHeight12_enum "" UBYTE SWC_HALIN_CDD_type_CM_uint8_enum 0 0 0.0 255.0 ECU_ADDRESS 0x0000 /* @ECU_Address@VHAL_FlashPTGOpenHeight12_enum@ */ /end MEASUREMENT
/begin MEASUREMENT VHAL_FlashPTGOpenHeight34_enum "" UBYTE SWC_HALIN_CDD_type_CM_uint8_enum 0 0 0.0 255.0 ECU_ADDRESS 0x0000 /* @ECU_Address@VHAL_FlashPTGOpenHeight34_enum@ */ /end MEASUREMENT
/begin MEASUREMENT VHAL_FlashPTGOpenHeight57_enum "" UBYTE SWC_HALIN_CDD_type_CM_uint8_enum 0 0 0.0 255.0 ECU_ADDRESS 0x0000 /* @ECU_Address@VHAL_FlashPTGOpenHeight57_enum@ */ /end MEASUREMENT
/begin MEASUREMENT VHAL_FlashACCLevelSta12_enum "" UBYTE SWC_HALIN_CDD_type_CM_uint8_enum 0 0 0.0 255.0 ECU_ADDRESS 0x0000 /* @ECU_Address@VHAL_FlashACCLevelSta12_enum@ */ /end MEASUREMENT
/begin MEASUREMENT VHAL_FlashACCLevelSta34_enum "" UBYTE SWC_HALIN_CDD_type_CM_uint8_enum 0 0 0.0 255.0 ECU_ADDRESS 0x0000 /* @ECU_Address@VHAL_FlashACCLevelSta34_enum@ */ /end MEASUREMENT
/begin MEASUREMENT VHAL_FlashACCLevelSta57_enum "" UBYTE SWC_HALIN_CDD_type_CM_uint8_enum 0 0 0.0 255.0 ECU_ADDRESS 0x0000 /* @ECU_Address@VHAL_FlashACCLevelSta57_enum@ */ /end MEASUREMENT
/begin MEASUREMENT VHAL_WipRLSCmdHoldTime_s "" UBYTE SWC_HALIN_CDD_type_CM_uint8_s 0 0 0.0 127.0 ECU_ADDRESS 0x0000 /* @ECU_Address@VHAL_WipRLSCmdHoldTime_s@ */ /end MEASUREMENT
/begin MEASUREMENT VHAL_WipRLSCmdCutTime_s "" UBYTE SWC_HALIN_CDD_type_CM_uint8_s 0 0 0.0 127.0 ECU_ADDRESS 0x0000 /* @ECU_Address@VHAL_WipRLSCmdCutTime_s@ */ /end MEASUREMENT
/begin MEASUREMENT VHAL_FlashAutoLock_enum "" UBYTE SWC_HALIN_CDD_type_CM_uint8_enum 0 0 0.0 255.0 ECU_ADDRESS 0x0000 /* @ECU_Address@VHAL_FlashAutoLock_enum@ */ /end MEASUREMENT
/begin MEASUREMENT VHAL_FlashAutoUnlock_enum "" UBYTE SWC_HALIN_CDD_type_CM_uint8_enum 0 0 0.0 255.0 ECU_ADDRESS 0x0000 /* @ECU_Address@VHAL_FlashAutoUnlock_enum@ */ /end MEASUREMENT
/begin MEASUREMENT VHAL_FlashTPMModelVersion_raw "" UBYTE SWC_HALIN_CDD_type_CM_uint8_raw 0 0 0.0 255.0 ECU_ADDRESS 0x0000 /* @ECU_Address@VHAL_FlashTPMModelVersion_raw@ */ /end MEASUREMENT
/begin MEASUREMENT VHAL_FlashTPMModelVersionChkSum_raw "" UBYTE SWC_HALIN_CDD_type_CM_uint8_raw 0 0 0.0 255.0 ECU_ADDRESS 0x0000 /* @ECU_Address@VHAL_FlashTPMModelVersionChkSum_raw@ */ /end MEASUREMENT
/begin MEASUREMENT VHAL_FlashWARMUPS_cnt "" UBYTE SWC_HALIN_CDD_type_CM_uint8_cnt 0 0 0.0 255.0 ECU_ADDRESS 0x0000 /* @ECU_Address@VHAL_FlashWARMUPS_cnt@ */ /end MEASUREMENT
/begin MEASUREMENT VHAL_Flashchkdatavalid_enum "" UBYTE SWC_HALIN_CDD_type_CM_uint8_enum 0 0 0.0 255.0 ECU_ADDRESS 0x0000 /* @ECU_Address@VHAL_Flashchkdatavalid_enum@ */ /end MEASUREMENT
/begin MEASUREMENT VHAL_Flashdatavalid_enum "" UBYTE SWC_HALIN_CDD_type_CM_uint8_enum 0 0 0.0 255.0 ECU_ADDRESS 0x0000 /* @ECU_Address@VHAL_Flashdatavalid_enum@ */ /end MEASUREMENT
/begin MEASUREMENT VHAL_LFWheelPSW_raw8 "" UBYTE SWC_HALIN_CDD_type_CM_uint8_raw8 0 0 0.0 255.0 ECU_ADDRESS 0x0000 /* @ECU_Address@VHAL_LFWheelPSW_raw8@ */ /end MEASUREMENT
/begin MEASUREMENT VHAL_RFWheelPSW_raw8 "" UBYTE SWC_HALIN_CDD_type_CM_uint8_raw8 0 0 0.0 255.0 ECU_ADDRESS 0x0000 /* @ECU_Address@VHAL_RFWheelPSW_raw8@ */ /end MEASUREMENT
/begin MEASUREMENT VHAL_LRWheelPSW_raw8 "" UBYTE SWC_HALIN_CDD_type_CM_uint8_raw8 0 0 0.0 255.0 ECU_ADDRESS 0x0000 /* @ECU_Address@VHAL_LRWheelPSW_raw8@ */ /end MEASUREMENT
/begin MEASUREMENT VHAL_RRWheelPSW_raw8 "" UBYTE SWC_HALIN_CDD_type_CM_uint8_raw8 0 0 0.0 255.0 ECU_ADDRESS 0x0000 /* @ECU_Address@VHAL_RRWheelPSW_raw8@ */ /end MEASUREMENT
/begin MEASUREMENT VHAL_LFPindi_enum "" UBYTE SWC_HALIN_CDD_type_CM_uint8_enum 0 0 0.0 255.0 ECU_ADDRESS 0x0000 /* @ECU_Address@VHAL_LFPindi_enum@ */ /end MEASUREMENT
/begin MEASUREMENT VHAL_RFPindi_enum "" UBYTE SWC_HALIN_CDD_type_CM_uint8_enum 0 0 0.0 255.0 ECU_ADDRESS 0x0000 /* @ECU_Address@VHAL_RFPindi_enum@ */ /end MEASUREMENT
/begin MEASUREMENT VHAL_LRPindi_enum "" UBYTE SWC_HALIN_CDD_type_CM_uint8_enum 0 0 0.0 255.0 ECU_ADDRESS 0x0000 /* @ECU_Address@VHAL_LRPindi_enum@ */ /end MEASUREMENT
/begin MEASUREMENT VHAL_RRPindi_enum "" UBYTE SWC_HALIN_CDD_type_CM_uint8_enum 0 0 0.0 255.0 ECU_ADDRESS 0x0000 /* @ECU_Address@VHAL_RRPindi_enum@ */ /end MEASUREMENT
/begin MEASUREMENT VHAL_LFP20_raw8 "" UBYTE SWC_HALIN_CDD_type_CM_uint8_raw8 0 0 0.0 255.0 ECU_ADDRESS 0x0000 /* @ECU_Address@VHAL_LFP20_raw8@ */ /end MEASUREMENT
/begin MEASUREMENT VHAL_RFP20_raw8 "" UBYTE SWC_HALIN_CDD_type_CM_uint8_raw8 0 0 0.0 255.0 ECU_ADDRESS 0x0000 /* @ECU_Address@VHAL_RFP20_raw8@ */ /end MEASUREMENT
/begin MEASUREMENT VHAL_LRP20_raw8 "" UBYTE SWC_HALIN_CDD_type_CM_uint8_raw8 0 0 0.0 255.0 ECU_ADDRESS 0x0000 /* @ECU_Address@VHAL_LRP20_raw8@ */ /end MEASUREMENT
/begin MEASUREMENT VHAL_RRP20_raw8 "" UBYTE SWC_HALIN_CDD_type_CM_uint8_raw8 0 0 0.0 255.0 ECU_ADDRESS 0x0000 /* @ECU_Address@VHAL_RRP20_raw8@ */ /end MEASUREMENT
/begin MEASUREMENT VHAL_LFWheelPress_raw8 "" UBYTE SWC_HALIN_CDD_type_CM_uint8_raw8 0 0 0.0 255.0 ECU_ADDRESS 0x0000 /* @ECU_Address@VHAL_LFWheelPress_raw8@ */ /end MEASUREMENT
/begin MEASUREMENT VHAL_RFWheelPress_raw8 "" UBYTE SWC_HALIN_CDD_type_CM_uint8_raw8 0 0 0.0 255.0 ECU_ADDRESS 0x0000 /* @ECU_Address@VHAL_RFWheelPress_raw8@ */ /end MEASUREMENT
/begin MEASUREMENT VHAL_LRWheelPress_raw8 "" UBYTE SWC_HALIN_CDD_type_CM_uint8_raw8 0 0 0.0 255.0 ECU_ADDRESS 0x0000 /* @ECU_Address@VHAL_LRWheelPress_raw8@ */ /end MEASUREMENT
/begin MEASUREMENT VHAL_RRWheelPress_raw8 "" UBYTE SWC_HALIN_CDD_type_CM_uint8_raw8 0 0 0.0 255.0 ECU_ADDRESS 0x0000 /* @ECU_Address@VHAL_RRWheelPress_raw8@ */ /end MEASUREMENT
/begin MEASUREMENT VHAL_LFWheelTemp_C "" UBYTE SWC_HALIN_CDD_type_CM_uint8_C 0 0 0.0 255.0 ECU_ADDRESS 0x0000 /* @ECU_Address@VHAL_LFWheelTemp_C@ */ /end MEASUREMENT
/begin MEASUREMENT VHAL_RFWheelTemp_C "" UBYTE SWC_HALIN_CDD_type_CM_uint8_C 0 0 0.0 255.0 ECU_ADDRESS 0x0000 /* @ECU_Address@VHAL_RFWheelTemp_C@ */ /end MEASUREMENT
/begin MEASUREMENT VHAL_LRWheelTemp_C "" UBYTE SWC_HALIN_CDD_type_CM_uint8_C 0 0 0.0 255.0 ECU_ADDRESS 0x0000 /* @ECU_Address@VHAL_LRWheelTemp_C@ */ /end MEASUREMENT
/begin MEASUREMENT VHAL_RRWheelTemp_C "" UBYTE SWC_HALIN_CDD_type_CM_uint8_C 0 0 0.0 255.0 ECU_ADDRESS 0x0000 /* @ECU_Address@VHAL_RRWheelTemp_C@ */ /end MEASUREMENT
/begin MEASUREMENT VHAL_unlearnSfailvalid_enum "" UBYTE SWC_HALIN_CDD_type_CM_uint8_enum 0 0 0.0 255.0 ECU_ADDRESS 0x0000 /* @ECU_Address@VHAL_unlearnSfailvalid_enum@ */ /end MEASUREMENT
/begin MEASUREMENT VHAL_Prepresstempvalid_enum "" UBYTE SWC_HALIN_CDD_type_CM_uint8_enum 0 0 0.0 255.0 ECU_ADDRESS 0x0000 /* @ECU_Address@VHAL_Prepresstempvalid_enum@ */ /end MEASUREMENT
/begin MEASUREMENT VHAL_FlashIDvalid_enum "" UBYTE SWC_HALIN_CDD_type_CM_uint8_enum 0 0 0.0 255.0 ECU_ADDRESS 0x0000 /* @ECU_Address@VHAL_FlashIDvalid_enum@ */ /end MEASUREMENT
/begin MEASUREMENT VHAL_FlashHMIKey1Func_enum "" UBYTE SWC_HALIN_CDD_type_CM_uint8_enum 0 0 0.0 255.0 ECU_ADDRESS 0x0000 /* @ECU_Address@VHAL_FlashHMIKey1Func_enum@ */ /end MEASUREMENT
/begin MEASUREMENT VHAL_FlashHMIKey2Func_enum "" UBYTE SWC_HALIN_CDD_type_CM_uint8_enum 0 0 0.0 255.0 ECU_ADDRESS 0x0000 /* @ECU_Address@VHAL_FlashHMIKey2Func_enum@ */ /end MEASUREMENT
/begin MEASUREMENT VHAL_FlashHMIKey3Func_enum "" UBYTE SWC_HALIN_CDD_type_CM_uint8_enum 0 0 0.0 255.0 ECU_ADDRESS 0x0000 /* @ECU_Address@VHAL_FlashHMIKey3Func_enum@ */ /end MEASUREMENT
/begin MEASUREMENT VHAL_FlashHMIKey4Func_enum "" UBYTE SWC_HALIN_CDD_type_CM_uint8_enum 0 0 0.0 255.0 ECU_ADDRESS 0x0000 /* @ECU_Address@VHAL_FlashHMIKey4Func_enum@ */ /end MEASUREMENT
/begin MEASUREMENT VHAL_FlashHMIKey5Func_enum "" UBYTE SWC_HALIN_CDD_type_CM_uint8_enum 0 0 0.0 255.0 ECU_ADDRESS 0x0000 /* @ECU_Address@VHAL_FlashHMIKey5Func_enum@ */ /end MEASUREMENT
/begin MEASUREMENT VHAL_FlashHMIKey6Func_enum "" UBYTE SWC_HALIN_CDD_type_CM_uint8_enum 0 0 0.0 255.0 ECU_ADDRESS 0x0000 /* @ECU_Address@VHAL_FlashHMIKey6Func_enum@ */ /end MEASUREMENT
/begin MEASUREMENT VHAL_FlashHMIKey7Func_enum "" UBYTE SWC_HALIN_CDD_type_CM_uint8_enum 0 0 0.0 255.0 ECU_ADDRESS 0x0000 /* @ECU_Address@VHAL_FlashHMIKey7Func_enum@ */ /end MEASUREMENT
/begin MEASUREMENT VHAL_FlashHMIKey8Func_enum "" UBYTE SWC_HALIN_CDD_type_CM_uint8_enum 0 0 0.0 255.0 ECU_ADDRESS 0x0000 /* @ECU_Address@VHAL_FlashHMIKey8Func_enum@ */ /end MEASUREMENT
/begin MEASUREMENT VHAL_FlashDIDModelVersion_raw "" UBYTE SWC_HALIN_CDD_type_CM_uint8_raw 0 0 0.0 255.0 ECU_ADDRESS 0x0000 /* @ECU_Address@VHAL_FlashDIDModelVersion_raw@ */ /end MEASUREMENT
/begin MEASUREMENT VHAL_FlashDIDModelVersionChkSum_raw "" UBYTE SWC_HALIN_CDD_type_CM_uint8_raw 0 0 0.0 255.0 ECU_ADDRESS 0x0000 /* @ECU_Address@VHAL_FlashDIDModelVersionChkSum_raw@ */ /end MEASUREMENT
/begin MEASUREMENT VHAL_CbnPreACEnaReq_enum "" UBYTE SWC_HALIN_CDD_type_CM_uint8_enum 0 0 0.0 255.0 ECU_ADDRESS 0x0000 /* @ECU_Address@VHAL_CbnPreACEnaReq_enum@ */ /end MEASUREMENT
/begin MEASUREMENT VHAL_ReOutsideMirror_enum "" UBYTE SWC_HALIN_CDD_type_CM_uint8_enum 0 0 0.0 255.0 ECU_ADDRESS 0x0000 /* @ECU_Address@VHAL_ReOutsideMirror_enum@ */ /end MEASUREMENT
/begin MEASUREMENT VHAL_RePwrReqTbox_enum "" UBYTE SWC_HALIN_CDD_type_CM_uint8_enum 0 0 0.0 255.0 ECU_ADDRESS 0x0000 /* @ECU_Address@VHAL_RePwrReqTbox_enum@ */ /end MEASUREMENT
/begin MEASUREMENT VHAL_TBOXRemotePW_enum "" UBYTE SWC_HALIN_CDD_type_CM_uint8_enum 0 0 0.0 255.0 ECU_ADDRESS 0x0000 /* @ECU_Address@VHAL_TBOXRemotePW_enum@ */ /end MEASUREMENT
/begin MEASUREMENT VHAL_FDCConnDrvWdwCtrlCmd_pct "" UBYTE SWC_HALIN_CDD_type_CM_uint8_pct 0 0 0.0 255.0 ECU_ADDRESS 0x0000 /* @ECU_Address@VHAL_FDCConnDrvWdwCtrlCmd_pct@ */ /end MEASUREMENT
/begin MEASUREMENT VHAL_FDCConnPasWdwCtrlCmd_pct "" UBYTE SWC_HALIN_CDD_type_CM_uint8_pct 0 0 0.0 255.0 ECU_ADDRESS 0x0000 /* @ECU_Address@VHAL_FDCConnPasWdwCtrlCmd_pct@ */ /end MEASUREMENT
/begin MEASUREMENT VHAL_FDCConnRLDWdwCtrlCmd_pct "" UBYTE SWC_HALIN_CDD_type_CM_uint8_pct 0 0 0.0 255.0 ECU_ADDRESS 0x0000 /* @ECU_Address@VHAL_FDCConnRLDWdwCtrlCmd_pct@ */ /end MEASUREMENT
/begin MEASUREMENT VHAL_FDCConnRRDWdwCtrlCmd_pct "" UBYTE SWC_HALIN_CDD_type_CM_uint8_pct 0 0 0.0 255.0 ECU_ADDRESS 0x0000 /* @ECU_Address@VHAL_FDCConnRRDWdwCtrlCmd_pct@ */ /end MEASUREMENT
/begin MEASUREMENT VHAL_EncryptionDATA0631_enum "" UBYTE SWC_HALIN_CDD_type_CM_uint8_enum 0 0 0.0 255.0 ECU_ADDRESS 0x0000 /* @ECU_Address@VHAL_EncryptionDATA0631_enum@ */ /end MEASUREMENT
/begin MEASUREMENT VHAL_EncryptionDATA0632_enum "" UBYTE SWC_HALIN_CDD_type_CM_uint8_enum 0 0 0.0 255.0 ECU_ADDRESS 0x0000 /* @ECU_Address@VHAL_EncryptionDATA0632_enum@ */ /end MEASUREMENT
/begin MEASUREMENT VHAL_EncryptionDATA0633_enum "" UBYTE SWC_HALIN_CDD_type_CM_uint8_enum 0 0 0.0 255.0 ECU_ADDRESS 0x0000 /* @ECU_Address@VHAL_EncryptionDATA0633_enum@ */ /end MEASUREMENT
/begin MEASUREMENT VHAL_EncryptionDATA0634_enum "" UBYTE SWC_HALIN_CDD_type_CM_uint8_enum 0 0 0.0 255.0 ECU_ADDRESS 0x0000 /* @ECU_Address@VHAL_EncryptionDATA0634_enum@ */ /end MEASUREMENT
/begin MEASUREMENT VHAL_EncryptionDATA0635_enum "" UBYTE SWC_HALIN_CDD_type_CM_uint8_enum 0 0 0.0 255.0 ECU_ADDRESS 0x0000 /* @ECU_Address@VHAL_EncryptionDATA0635_enum@ */ /end MEASUREMENT
/begin MEASUREMENT VHAL_EncryptionDATA0636_enum "" UBYTE SWC_HALIN_CDD_type_CM_uint8_enum 0 0 0.0 255.0 ECU_ADDRESS 0x0000 /* @ECU_Address@VHAL_EncryptionDATA0636_enum@ */ /end MEASUREMENT
/begin MEASUREMENT VHAL_EncryptionDATA0637_enum "" UBYTE SWC_HALIN_CDD_type_CM_uint8_enum 0 0 0.0 255.0 ECU_ADDRESS 0x0000 /* @ECU_Address@VHAL_EncryptionDATA0637_enum@ */ /end MEASUREMENT
/begin MEASUREMENT VHAL_EncryptionDATA0638_enum "" UBYTE SWC_HALIN_CDD_type_CM_uint8_enum 0 0 0.0 255.0 ECU_ADDRESS 0x0000 /* @ECU_Address@VHAL_EncryptionDATA0638_enum@ */ /end MEASUREMENT
/begin MEASUREMENT VHAL_DIDFlashUSSConfig_raw8 "" UBYTE SWC_HALIN_CDD_type_CM_uint8 0 0 0 255 ARRAY_SIZE 16 ECU_ADDRESS 0x0000 /* @ECU_Address@VHAL_DIDFlashUSSConfig_raw8@ */ /end MEASUREMENT
/begin MEASUREMENT VHAL_DIDFlashTireSize_raw8 "" UBYTE SWC_HALIN_CDD_type_CM_uint8 0 0 0 255 ARRAY_SIZE 16 ECU_ADDRESS 0x0000 /* @ECU_Address@VHAL_DIDFlashTireSize_raw8@ */ /end MEASUREMENT
/begin MEASUREMENT VHAL_DIDFlashAPSFunConfig_raw8 "" UBYTE SWC_HALIN_CDD_type_CM_uint8 0 0 0 255 ARRAY_SIZE 16 ECU_ADDRESS 0x0000 /* @ECU_Address@VHAL_DIDFlashAPSFunConfig_raw8@ */ /end MEASUREMENT
/begin MEASUREMENT VHAL_DidXWDData_enum "" UBYTE SWC_HALIN_CDD_type_CM_uint8_enum 0 0 0.0 255.0 ECU_ADDRESS 0x0000 /* @ECU_Address@VHAL_DidXWDData_enum@ */ /end MEASUREMENT
/begin MEASUREMENT VINP_VinCodeByte0_enum "" UBYTE SWC_HALIN_CDD_type_CM_uint8_enum 0 0 0.0 255.0 ECU_ADDRESS 0x0000 /* @ECU_Address@VINP_VinCodeByte0_enum@ */ /end MEASUREMENT
/begin MEASUREMENT VINP_VinCodeByte1_enum "" UBYTE SWC_HALIN_CDD_type_CM_uint8_enum 0 0 0.0 255.0 ECU_ADDRESS 0x0000 /* @ECU_Address@VINP_VinCodeByte1_enum@ */ /end MEASUREMENT
/begin MEASUREMENT VINP_VinCodeByte10_enum "" UBYTE SWC_HALIN_CDD_type_CM_uint8_enum 0 0 0.0 255.0 ECU_ADDRESS 0x0000 /* @ECU_Address@VINP_VinCodeByte10_enum@ */ /end MEASUREMENT
/begin MEASUREMENT VINP_VinCodeByte11_enum "" UBYTE SWC_HALIN_CDD_type_CM_uint8_enum 0 0 0.0 255.0 ECU_ADDRESS 0x0000 /* @ECU_Address@VINP_VinCodeByte11_enum@ */ /end MEASUREMENT
/begin MEASUREMENT VINP_VinCodeByte12_enum "" UBYTE SWC_HALIN_CDD_type_CM_uint8_enum 0 0 0.0 255.0 ECU_ADDRESS 0x0000 /* @ECU_Address@VINP_VinCodeByte12_enum@ */ /end MEASUREMENT
/begin MEASUREMENT VINP_VinCodeByte13_enum "" UBYTE SWC_HALIN_CDD_type_CM_uint8_enum 0 0 0.0 255.0 ECU_ADDRESS 0x0000 /* @ECU_Address@VINP_VinCodeByte13_enum@ */ /end MEASUREMENT
/begin MEASUREMENT VINP_VinCodeByte14_enum "" UBYTE SWC_HALIN_CDD_type_CM_uint8_enum 0 0 0.0 255.0 ECU_ADDRESS 0x0000 /* @ECU_Address@VINP_VinCodeByte14_enum@ */ /end MEASUREMENT
/begin MEASUREMENT VINP_VinCodeByte15_enum "" UBYTE SWC_HALIN_CDD_type_CM_uint8_enum 0 0 0.0 255.0 ECU_ADDRESS 0x0000 /* @ECU_Address@VINP_VinCodeByte15_enum@ */ /end MEASUREMENT
/begin MEASUREMENT VINP_VinCodeByte16_enum "" UBYTE SWC_HALIN_CDD_type_CM_uint8_enum 0 0 0.0 255.0 ECU_ADDRESS 0x0000 /* @ECU_Address@VINP_VinCodeByte16_enum@ */ /end MEASUREMENT
/begin MEASUREMENT VINP_VinCodeByte2_enum "" UBYTE SWC_HALIN_CDD_type_CM_uint8_enum 0 0 0.0 255.0 ECU_ADDRESS 0x0000 /* @ECU_Address@VINP_VinCodeByte2_enum@ */ /end MEASUREMENT
/begin MEASUREMENT VINP_VinCodeByte3_enum "" UBYTE SWC_HALIN_CDD_type_CM_uint8_enum 0 0 0.0 255.0 ECU_ADDRESS 0x0000 /* @ECU_Address@VINP_VinCodeByte3_enum@ */ /end MEASUREMENT
/begin MEASUREMENT VINP_VinCodeByte4_enum "" UBYTE SWC_HALIN_CDD_type_CM_uint8_enum 0 0 0.0 255.0 ECU_ADDRESS 0x0000 /* @ECU_Address@VINP_VinCodeByte4_enum@ */ /end MEASUREMENT
/begin MEASUREMENT VINP_VinCodeByte5_enum "" UBYTE SWC_HALIN_CDD_type_CM_uint8_enum 0 0 0.0 255.0 ECU_ADDRESS 0x0000 /* @ECU_Address@VINP_VinCodeByte5_enum@ */ /end MEASUREMENT
/begin MEASUREMENT VINP_VinCodeByte6_enum "" UBYTE SWC_HALIN_CDD_type_CM_uint8_enum 0 0 0.0 255.0 ECU_ADDRESS 0x0000 /* @ECU_Address@VINP_VinCodeByte6_enum@ */ /end MEASUREMENT
/begin MEASUREMENT VINP_VinCodeByte7_enum "" UBYTE SWC_HALIN_CDD_type_CM_uint8_enum 0 0 0.0 255.0 ECU_ADDRESS 0x0000 /* @ECU_Address@VINP_VinCodeByte7_enum@ */ /end MEASUREMENT
/begin MEASUREMENT VINP_VinCodeByte8_enum "" UBYTE SWC_HALIN_CDD_type_CM_uint8_enum 0 0 0.0 255.0 ECU_ADDRESS 0x0000 /* @ECU_Address@VINP_VinCodeByte8_enum@ */ /end MEASUREMENT
/begin MEASUREMENT VINP_VinCodeByte9_enum "" UBYTE SWC_HALIN_CDD_type_CM_uint8_enum 0 0 0.0 255.0 ECU_ADDRESS 0x0000 /* @ECU_Address@VINP_VinCodeByte9_enum@ */ /end MEASUREMENT
/begin MEASUREMENT VHAL_APSFunConfig_raw "" UBYTE SWC_HALIN_CDD_type_CM_uint8 0 0 0 255 ARRAY_SIZE 16 ECU_ADDRESS 0x0000 /* @ECU_Address@VHAL_APSFunConfig_raw@ */ /end MEASUREMENT
/begin MEASUREMENT VHAL_DIDStaAPSFunConfig_raw "" UBYTE SWC_HALIN_CDD_type_CM_uint8_raw 0 0 0.0 255.0 ECU_ADDRESS 0x0000 /* @ECU_Address@VHAL_DIDStaAPSFunConfig_raw@ */ /end MEASUREMENT
/begin MEASUREMENT VHAL_AutoLock_raw "" UBYTE SWC_HALIN_CDD_type_CM_uint8_raw 0 0 0.0 255.0 ECU_ADDRESS 0x0000 /* @ECU_Address@VHAL_AutoLock_raw@ */ /end MEASUREMENT
/begin MEASUREMENT VHAL_DIDStaAutoLock_raw "" UBYTE SWC_HALIN_CDD_type_CM_uint8_raw 0 0 0.0 255.0 ECU_ADDRESS 0x0000 /* @ECU_Address@VHAL_DIDStaAutoLock_raw@ */ /end MEASUREMENT
/begin MEASUREMENT VHAL_AutoWipHSpdEN_raw "" UBYTE SWC_HALIN_CDD_type_CM_uint8_raw 0 0 0.0 255.0 ECU_ADDRESS 0x0000 /* @ECU_Address@VHAL_AutoWipHSpdEN_raw@ */ /end MEASUREMENT
/begin MEASUREMENT VHAL_DIDStaAutoWipHSpdEN_raw "" UBYTE SWC_HALIN_CDD_type_CM_uint8_raw 0 0 0.0 255.0 ECU_ADDRESS 0x0000 /* @ECU_Address@VHAL_DIDStaAutoWipHSpdEN_raw@ */ /end MEASUREMENT
/begin MEASUREMENT VHAL_DKCKey_raw "" UBYTE SWC_HALIN_CDD_type_CM_uint8 0 0 0 255 ARRAY_SIZE 8 ECU_ADDRESS 0x0000 /* @ECU_Address@VHAL_DKCKey_raw@ */ /end MEASUREMENT
/begin MEASUREMENT VHAL_DIDStaDKCKey_raw "" UBYTE SWC_HALIN_CDD_type_CM_uint8_raw 0 0 0.0 255.0 ECU_ADDRESS 0x0000 /* @ECU_Address@VHAL_DIDStaDKCKey_raw@ */ /end MEASUREMENT
/begin MEASUREMENT VHAL_DRLDis_raw "" UBYTE SWC_HALIN_CDD_type_CM_uint8_raw 0 0 0.0 255.0 ECU_ADDRESS 0x0000 /* @ECU_Address@VHAL_DRLDis_raw@ */ /end MEASUREMENT
/begin MEASUREMENT VHAL_DIDStaDRLDis_raw "" UBYTE SWC_HALIN_CDD_type_CM_uint8_raw 0 0 0.0 255.0 ECU_ADDRESS 0x0000 /* @ECU_Address@VHAL_DIDStaDRLDis_raw@ */ /end MEASUREMENT
/begin MEASUREMENT VHAL_DynoMode_raw "" UBYTE SWC_HALIN_CDD_type_CM_uint8_raw 0 0 0.0 255.0 ECU_ADDRESS 0x0000 /* @ECU_Address@VHAL_DynoMode_raw@ */ /end MEASUREMENT
/begin MEASUREMENT VHAL_DIDStaDynoMode_raw "" UBYTE SWC_HALIN_CDD_type_CM_uint8_raw 0 0 0.0 255.0 ECU_ADDRESS 0x0000 /* @ECU_Address@VHAL_DIDStaDynoMode_raw@ */ /end MEASUREMENT
/begin MEASUREMENT VHAL_FMHTimer_raw "" UBYTE SWC_HALIN_CDD_type_CM_uint8_raw 0 0 0.0 255.0 ECU_ADDRESS 0x0000 /* @ECU_Address@VHAL_FMHTimer_raw@ */ /end MEASUREMENT
/begin MEASUREMENT VHAL_DIDStaFMHTimer_raw "" UBYTE SWC_HALIN_CDD_type_CM_uint8_raw 0 0 0.0 255.0 ECU_ADDRESS 0x0000 /* @ECU_Address@VHAL_DIDStaFMHTimer_raw@ */ /end MEASUREMENT
/begin MEASUREMENT VHAL_OBDReq_raw "" UBYTE SWC_HALIN_CDD_type_CM_uint8_raw 0 0 0.0 255.0 ECU_ADDRESS 0x0000 /* @ECU_Address@VHAL_OBDReq_raw@ */ /end MEASUREMENT
/begin MEASUREMENT VHAL_DIDStaOBDReq_raw "" UBYTE SWC_HALIN_CDD_type_CM_uint8_raw 0 0 0.0 255.0 ECU_ADDRESS 0x0000 /* @ECU_Address@VHAL_DIDStaOBDReq_raw@ */ /end MEASUREMENT
/begin MEASUREMENT VHAL_TestGroup_raw "" UBYTE SWC_HALIN_CDD_type_CM_uint8 0 0 0 255 ARRAY_SIZE 12 ECU_ADDRESS 0x0000 /* @ECU_Address@VHAL_TestGroup_raw@ */ /end MEASUREMENT
/begin MEASUREMENT VHAL_DIDStaTestGroup_raw "" UBYTE SWC_HALIN_CDD_type_CM_uint8_raw 0 0 0.0 255.0 ECU_ADDRESS 0x0000 /* @ECU_Address@VHAL_DIDStaTestGroup_raw@ */ /end MEASUREMENT
/begin MEASUREMENT VHAL_TireSize_raw "" UBYTE SWC_HALIN_CDD_type_CM_uint8 0 0 0 255 ARRAY_SIZE 16 ECU_ADDRESS 0x0000 /* @ECU_Address@VHAL_TireSize_raw@ */ /end MEASUREMENT
/begin MEASUREMENT VHAL_DIDStaTireSize_raw "" UBYTE SWC_HALIN_CDD_type_CM_uint8_raw 0 0 0.0 255.0 ECU_ADDRESS 0x0000 /* @ECU_Address@VHAL_DIDStaTireSize_raw@ */ /end MEASUREMENT
/begin MEASUREMENT VHAL_TurnLampFLThreCurr_raw "" UBYTE SWC_HALIN_CDD_type_CM_uint8_raw 0 0 0.0 255.0 ECU_ADDRESS 0x0000 /* @ECU_Address@VHAL_TurnLampFLThreCurr_raw@ */ /end MEASUREMENT
/begin MEASUREMENT VHAL_DIDStaTurnLampFLThreCurr_raw "" UBYTE SWC_HALIN_CDD_type_CM_uint8_raw 0 0 0.0 255.0 ECU_ADDRESS 0x0000 /* @ECU_Address@VHAL_DIDStaTurnLampFLThreCurr_raw@ */ /end MEASUREMENT
/begin MEASUREMENT VHAL_TurnLampFRThreCurr_raw "" UBYTE SWC_HALIN_CDD_type_CM_uint8_raw 0 0 0.0 255.0 ECU_ADDRESS 0x0000 /* @ECU_Address@VHAL_TurnLampFRThreCurr_raw@ */ /end MEASUREMENT
/begin MEASUREMENT VHAL_DIDStaTurnLampFRThreCurr_raw "" UBYTE SWC_HALIN_CDD_type_CM_uint8_raw 0 0 0.0 255.0 ECU_ADDRESS 0x0000 /* @ECU_Address@VHAL_DIDStaTurnLampFRThreCurr_raw@ */ /end MEASUREMENT
/begin MEASUREMENT VHAL_TurnLampRLThreCurr_raw "" UBYTE SWC_HALIN_CDD_type_CM_uint8_raw 0 0 0.0 255.0 ECU_ADDRESS 0x0000 /* @ECU_Address@VHAL_TurnLampRLThreCurr_raw@ */ /end MEASUREMENT
/begin MEASUREMENT VHAL_DIDStaTurnLampRLThreCurr_raw "" UBYTE SWC_HALIN_CDD_type_CM_uint8_raw 0 0 0.0 255.0 ECU_ADDRESS 0x0000 /* @ECU_Address@VHAL_DIDStaTurnLampRLThreCurr_raw@ */ /end MEASUREMENT
/begin MEASUREMENT VHAL_TurnLampRRThreCurr_raw "" UBYTE SWC_HALIN_CDD_type_CM_uint8_raw 0 0 0.0 255.0 ECU_ADDRESS 0x0000 /* @ECU_Address@VHAL_TurnLampRRThreCurr_raw@ */ /end MEASUREMENT
/begin MEASUREMENT VHAL_DIDStaTurnLampRRThreCurr_raw "" UBYTE SWC_HALIN_CDD_type_CM_uint8_raw 0 0 0.0 255.0 ECU_ADDRESS 0x0000 /* @ECU_Address@VHAL_DIDStaTurnLampRRThreCurr_raw@ */ /end MEASUREMENT
/begin MEASUREMENT VHAL_USSConfig_raw "" UBYTE SWC_HALIN_CDD_type_CM_uint8 0 0 0 255 ARRAY_SIZE 16 ECU_ADDRESS 0x0000 /* @ECU_Address@VHAL_USSConfig_raw@ */ /end MEASUREMENT
/begin MEASUREMENT VHAL_DIDStaUSSConfig_raw "" UBYTE SWC_HALIN_CDD_type_CM_uint8_raw 0 0 0.0 255.0 ECU_ADDRESS 0x0000 /* @ECU_Address@VHAL_DIDStaUSSConfig_raw@ */ /end MEASUREMENT
/begin MEASUREMENT VHAL_WipRLSCmdCutFilter_raw "" UBYTE SWC_HALIN_CDD_type_CM_uint8_raw 0 0 0.0 255.0 ECU_ADDRESS 0x0000 /* @ECU_Address@VHAL_WipRLSCmdCutFilter_raw@ */ /end MEASUREMENT
/begin MEASUREMENT VHAL_DIDStaWipRLSCmdCutFilter_raw "" UBYTE SWC_HALIN_CDD_type_CM_uint8_raw 0 0 0.0 255.0 ECU_ADDRESS 0x0000 /* @ECU_Address@VHAL_DIDStaWipRLSCmdCutFilter_raw@ */ /end MEASUREMENT
/begin MEASUREMENT VHAL_WipRLSCmdHoldFilter_raw "" UBYTE SWC_HALIN_CDD_type_CM_uint8_raw 0 0 0.0 255.0 ECU_ADDRESS 0x0000 /* @ECU_Address@VHAL_WipRLSCmdHoldFilter_raw@ */ /end MEASUREMENT
/begin MEASUREMENT VHAL_DIDStaWipRLSCmdHoldFilter_raw "" UBYTE SWC_HALIN_CDD_type_CM_uint8_raw 0 0 0.0 255.0 ECU_ADDRESS 0x0000 /* @ECU_Address@VHAL_DIDStaWipRLSCmdHoldFilter_raw@ */ /end MEASUREMENT
/begin MEASUREMENT VHAL_XWDMode_raw "" UBYTE SWC_HALIN_CDD_type_CM_uint8_raw 0 0 0.0 255.0 ECU_ADDRESS 0x0000 /* @ECU_Address@VHAL_XWDMode_raw@ */ /end MEASUREMENT
/begin MEASUREMENT VHAL_DIDStaXWDMode_raw "" UBYTE SWC_HALIN_CDD_type_CM_uint8_raw 0 0 0.0 255.0 ECU_ADDRESS 0x0000 /* @ECU_Address@VHAL_DIDStaXWDMode_raw@ */ /end MEASUREMENT
/begin MEASUREMENT VHAL_USSStaRMR_flg "" UBYTE SWC_HALIN_CDD_type_CM_boolean_flg 0 0 0.0 1.0 ECU_ADDRESS 0x0000 /* @ECU_Address@VHAL_USSStaRMR_flg@ */ /end MEASUREMENT
/begin MEASUREMENT VHAL_USSStaRML_flg "" UBYTE SWC_HALIN_CDD_type_CM_boolean_flg 0 0 0.0 1.0 ECU_ADDRESS 0x0000 /* @ECU_Address@VHAL_USSStaRML_flg@ */ /end MEASUREMENT
/begin MEASUREMENT VHAL_USSStaRLR_flg "" UBYTE SWC_HALIN_CDD_type_CM_boolean_flg 0 0 0.0 1.0 ECU_ADDRESS 0x0000 /* @ECU_Address@VHAL_USSStaRLR_flg@ */ /end MEASUREMENT
/begin MEASUREMENT VHAL_USSStaRLL_flg "" UBYTE SWC_HALIN_CDD_type_CM_boolean_flg 0 0 0.0 1.0 ECU_ADDRESS 0x0000 /* @ECU_Address@VHAL_USSStaRLL_flg@ */ /end MEASUREMENT
/begin MEASUREMENT VHAL_USSStaRCR_flg "" UBYTE SWC_HALIN_CDD_type_CM_boolean_flg 0 0 0.0 1.0 ECU_ADDRESS 0x0000 /* @ECU_Address@VHAL_USSStaRCR_flg@ */ /end MEASUREMENT
/begin MEASUREMENT VHAL_USSStaRCL_flg "" UBYTE SWC_HALIN_CDD_type_CM_boolean_flg 0 0 0.0 1.0 ECU_ADDRESS 0x0000 /* @ECU_Address@VHAL_USSStaRCL_flg@ */ /end MEASUREMENT
/begin MEASUREMENT VHAL_USSStaFMR_flg "" UBYTE SWC_HALIN_CDD_type_CM_boolean_flg 0 0 0.0 1.0 ECU_ADDRESS 0x0000 /* @ECU_Address@VHAL_USSStaFMR_flg@ */ /end MEASUREMENT
/begin MEASUREMENT VHAL_USSStaFML_flg "" UBYTE SWC_HALIN_CDD_type_CM_boolean_flg 0 0 0.0 1.0 ECU_ADDRESS 0x0000 /* @ECU_Address@VHAL_USSStaFML_flg@ */ /end MEASUREMENT
/begin MEASUREMENT VHAL_USSStaFLR_flg "" UBYTE SWC_HALIN_CDD_type_CM_boolean_flg 0 0 0.0 1.0 ECU_ADDRESS 0x0000 /* @ECU_Address@VHAL_USSStaFLR_flg@ */ /end MEASUREMENT
/begin MEASUREMENT VHAL_USSStaFLL_flg "" UBYTE SWC_HALIN_CDD_type_CM_boolean_flg 0 0 0.0 1.0 ECU_ADDRESS 0x0000 /* @ECU_Address@VHAL_USSStaFLL_flg@ */ /end MEASUREMENT
/begin MEASUREMENT VHAL_USSStaFCR_flg "" UBYTE SWC_HALIN_CDD_type_CM_boolean_flg 0 0 0.0 1.0 ECU_ADDRESS 0x0000 /* @ECU_Address@VHAL_USSStaFCR_flg@ */ /end MEASUREMENT
/begin MEASUREMENT VHAL_USSStaFCL_flg "" UBYTE SWC_HALIN_CDD_type_CM_boolean_flg 0 0 0.0 1.0 ECU_ADDRESS 0x0000 /* @ECU_Address@VHAL_USSStaFCL_flg@ */ /end MEASUREMENT
/begin MEASUREMENT VHAL_StaFSya_flg "" UBYTE SWC_HALIN_CDD_type_CM_boolean_flg 0 0 0.0 1.0 ECU_ADDRESS 0x0000 /* @ECU_Address@VHAL_StaFSya_flg@ */ /end MEASUREMENT
/begin MEASUREMENT VHAL_APSVRqEPASCtrl_flg "" UBYTE SWC_HALIN_CDD_type_CM_boolean_flg 0 0 0.0 1.0 ECU_ADDRESS 0x0000 /* @ECU_Address@VHAL_APSVRqEPASCtrl_flg@ */ /end MEASUREMENT
/begin MEASUREMENT VHAL_APSRqEPASCtrl_flg "" UBYTE SWC_HALIN_CDD_type_CM_boolean_flg 0 0 0.0 1.0 ECU_ADDRESS 0x0000 /* @ECU_Address@VHAL_APSRqEPASCtrl_flg@ */ /end MEASUREMENT
/begin MEASUREMENT VHAL_APSDecReqA_flg "" UBYTE SWC_HALIN_CDD_type_CM_boolean_flg 0 0 0.0 1.0 ECU_ADDRESS 0x0000 /* @ECU_Address@VHAL_APSDecReqA_flg@ */ /end MEASUREMENT
/begin MEASUREMENT VHAL_APSVMCReqA_flg "" UBYTE SWC_HALIN_CDD_type_CM_boolean_flg 0 0 0.0 1.0 ECU_ADDRESS 0x0000 /* @ECU_Address@VHAL_APSVMCReqA_flg@ */ /end MEASUREMENT
/begin MEASUREMENT VHAL_CAASVMCReqA_flg "" UBYTE SWC_HALIN_CDD_type_CM_boolean_flg 0 0 0.0 1.0 ECU_ADDRESS 0x0000 /* @ECU_Address@VHAL_CAASVMCReqA_flg@ */ /end MEASUREMENT
/begin MEASUREMENT VHAL_RAPSBCMLockReq_flg "" UBYTE SWC_HALIN_CDD_type_CM_boolean_flg 0 0 0.0 1.0 ECU_ADDRESS 0x0000 /* @ECU_Address@VHAL_RAPSBCMLockReq_flg@ */ /end MEASUREMENT
/begin MEASUREMENT VHAL_RAPSErrLv1_flg "" UBYTE SWC_HALIN_CDD_type_CM_boolean_flg 0 0 0.0 1.0 ECU_ADDRESS 0x0000 /* @ECU_Address@VHAL_RAPSErrLv1_flg@ */ /end MEASUREMENT
/begin MEASUREMENT VHAL_BrakeSWGPIO_flg "" UBYTE SWC_HALIN_CDD_type_CM_boolean_flg 0 0 0.0 1.0 ECU_ADDRESS 0x0000 /* @ECU_Address@VHAL_BrakeSWGPIO_flg@ */ /end MEASUREMENT
/begin MEASUREMENT VHAL_HoodSW_flg "" UBYTE SWC_HALIN_CDD_type_CM_boolean_flg 0 0 0.0 1.0 ECU_ADDRESS 0x0000 /* @ECU_Address@VHAL_HoodSW_flg@ */ /end MEASUREMENT
/begin MEASUREMENT VHAL_TailgateSW_flg "" UBYTE SWC_HALIN_CDD_type_CM_boolean_flg 0 0 0.0 1.0 ECU_ADDRESS 0x0000 /* @ECU_Address@VHAL_TailgateSW_flg@ */ /end MEASUREMENT
/begin MEASUREMENT VHAL_DrDoorSW_flg "" UBYTE SWC_HALIN_CDD_type_CM_boolean_flg 0 0 0.0 1.0 ECU_ADDRESS 0x0000 /* @ECU_Address@VHAL_DrDoorSW_flg@ */ /end MEASUREMENT
/begin MEASUREMENT VHAL_PsDoorSW_flg "" UBYTE SWC_HALIN_CDD_type_CM_boolean_flg 0 0 0.0 1.0 ECU_ADDRESS 0x0000 /* @ECU_Address@VHAL_PsDoorSW_flg@ */ /end MEASUREMENT
/begin MEASUREMENT VHAL_RRDoorSW_flg "" UBYTE SWC_HALIN_CDD_type_CM_boolean_flg 0 0 0.0 1.0 ECU_ADDRESS 0x0000 /* @ECU_Address@VHAL_RRDoorSW_flg@ */ /end MEASUREMENT
/begin MEASUREMENT VHAL_RLDoorSW_flg "" UBYTE SWC_HALIN_CDD_type_CM_boolean_flg 0 0 0.0 1.0 ECU_ADDRESS 0x0000 /* @ECU_Address@VHAL_RLDoorSW_flg@ */ /end MEASUREMENT
/begin MEASUREMENT VHAL_CentralDoorLockSW_flg "" UBYTE SWC_HALIN_CDD_type_CM_boolean_flg 0 0 0.0 1.0 ECU_ADDRESS 0x0000 /* @ECU_Address@VHAL_CentralDoorLockSW_flg@ */ /end MEASUREMENT
/begin MEASUREMENT VHAL_HazardSW_flg "" UBYTE SWC_HALIN_CDD_type_CM_boolean_flg 0 0 0.0 1.0 ECU_ADDRESS 0x0000 /* @ECU_Address@VHAL_HazardSW_flg@ */ /end MEASUREMENT
/begin MEASUREMENT VHAL_BrakeLampSW_flg "" UBYTE SWC_HALIN_CDD_type_CM_boolean_flg 0 0 0.0 1.0 ECU_ADDRESS 0x0000 /* @ECU_Address@VHAL_BrakeLampSW_flg@ */ /end MEASUREMENT
/begin MEASUREMENT VHAL_TrunkHanSW_flg "" UBYTE SWC_HALIN_CDD_type_CM_boolean_flg 0 0 0.0 1.0 ECU_ADDRESS 0x0000 /* @ECU_Address@VHAL_TrunkHanSW_flg@ */ /end MEASUREMENT
/begin MEASUREMENT VHAL_SeatSW_flg "" UBYTE SWC_HALIN_CDD_type_CM_boolean_flg 0 0 0.0 1.0 ECU_ADDRESS 0x0000 /* @ECU_Address@VHAL_SeatSW_flg@ */ /end MEASUREMENT
/begin MEASUREMENT VHAL_CrashSignalGPIO_flg "" UBYTE SWC_HALIN_CDD_type_CM_boolean_flg 0 0 0.0 1.0 ECU_ADDRESS 0x0000 /* @ECU_Address@VHAL_CrashSignalGPIO_flg@ */ /end MEASUREMENT
/begin MEASUREMENT VHAL_AcoreReadyToSlp_flg "" UBYTE SWC_HALIN_CDD_type_CM_boolean_flg 0 0 0.0 1.0 ECU_ADDRESS 0x0000 /* @ECU_Address@VHAL_AcoreReadyToSlp_flg@ */ /end MEASUREMENT
/begin MEASUREMENT VHAL_EvccAplusPwrUpReq_flg "" UBYTE SWC_HALIN_CDD_type_CM_boolean_flg 0 0 0.0 1.0 ECU_ADDRESS 0x0000 /* @ECU_Address@VHAL_EvccAplusPwrUpReq_flg@ */ /end MEASUREMENT
/begin MEASUREMENT VHAL_FlashACForceOFF_flg "" UBYTE SWC_HALIN_CDD_type_CM_boolean_flg 0 0 0.0 1.0 ECU_ADDRESS 0x0000 /* @ECU_Address@VHAL_FlashACForceOFF_flg@ */ /end MEASUREMENT
/begin MEASUREMENT VHAL_FlashMFSWTri_flg "" UBYTE SWC_HALIN_CDD_type_CM_boolean_flg 0 0 0.0 1.0 ECU_ADDRESS 0x0000 /* @ECU_Address@VHAL_FlashMFSWTri_flg@ */ /end MEASUREMENT
/begin MEASUREMENT VHAL_FlashMirrorFlodPos_flg "" UBYTE SWC_HALIN_CDD_type_CM_boolean_flg 0 0 0.0 1.0 ECU_ADDRESS 0x0000 /* @ECU_Address@VHAL_FlashMirrorFlodPos_flg@ */ /end MEASUREMENT
/begin MEASUREMENT VHAL_FlashFuelDoorPos_flg "" UBYTE SWC_HALIN_CDD_type_CM_boolean_flg 0 0 0.0 1.0 ECU_ADDRESS 0x0000 /* @ECU_Address@VHAL_FlashFuelDoorPos_flg@ */ /end MEASUREMENT
/begin MEASUREMENT VHAL_FlashWiperFixMode_flg "" UBYTE SWC_HALIN_CDD_type_CM_boolean_flg 0 0 0.0 1.0 ECU_ADDRESS 0x0000 /* @ECU_Address@VHAL_FlashWiperFixMode_flg@ */ /end MEASUREMENT
/begin MEASUREMENT VHAL_AnyNMID_flg "" UBYTE SWC_HALIN_CDD_type_CM_boolean_flg 0 0 0.0 1.0 ECU_ADDRESS 0x0000 /* @ECU_Address@VHAL_AnyNMID_flg@ */ /end MEASUREMENT
/begin MEASUREMENT VHAL_NvmProtectSta_flg "" UBYTE SWC_HALIN_CDD_type_CM_boolean_flg 0 0 0.0 1.0 ECU_ADDRESS 0x0000 /* @ECU_Address@VHAL_NvmProtectSta_flg@ */ /end MEASUREMENT
/begin MEASUREMENT VHAL_FlashHoodSW_flg "" UBYTE SWC_HALIN_CDD_type_CM_boolean_flg 0 0 0.0 1.0 ECU_ADDRESS 0x0000 /* @ECU_Address@VHAL_FlashHoodSW_flg@ */ /end MEASUREMENT
/begin MEASUREMENT VHAL_FlashTailgateSW_flg "" UBYTE SWC_HALIN_CDD_type_CM_boolean_flg 0 0 0.0 1.0 ECU_ADDRESS 0x0000 /* @ECU_Address@VHAL_FlashTailgateSW_flg@ */ /end MEASUREMENT
/begin MEASUREMENT VHAL_FlashCTDLockSW_flg "" UBYTE SWC_HALIN_CDD_type_CM_boolean_flg 0 0 0.0 1.0 ECU_ADDRESS 0x0000 /* @ECU_Address@VHAL_FlashCTDLockSW_flg@ */ /end MEASUREMENT
/begin MEASUREMENT VHAL_FlashTailgateHDSW_flg "" UBYTE SWC_HALIN_CDD_type_CM_boolean_flg 0 0 0.0 1.0 ECU_ADDRESS 0x0000 /* @ECU_Address@VHAL_FlashTailgateHDSW_flg@ */ /end MEASUREMENT
/begin MEASUREMENT VHAL_NetworkReqCalled_flg "" UBYTE SWC_HALIN_CDD_type_CM_boolean_flg 0 0 0.0 1.0 ECU_ADDRESS 0x0000 /* @ECU_Address@VHAL_NetworkReqCalled_flg@ */ /end MEASUREMENT
/begin MEASUREMENT VHAL_FlashAPMDoorControlSta_flg "" UBYTE SWC_HALIN_CDD_type_CM_boolean_flg 0 0 0.0 1.0 ECU_ADDRESS 0x0000 /* @ECU_Address@VHAL_FlashAPMDoorControlSta_flg@ */ /end MEASUREMENT
/begin MEASUREMENT VHAL_AcoreRebootCmd_flg "" UBYTE SWC_HALIN_CDD_type_CM_boolean_flg 0 0 0.0 1.0 ECU_ADDRESS 0x0000 /* @ECU_Address@VHAL_AcoreRebootCmd_flg@ */ /end MEASUREMENT
/begin MEASUREMENT VHAL_CAN1BusOff_flg "" UBYTE SWC_HALIN_CDD_type_CM_boolean_flg 0 0 0.0 1.0 ECU_ADDRESS 0x0000 /* @ECU_Address@VHAL_CAN1BusOff_flg@ */ /end MEASUREMENT
/begin MEASUREMENT VHAL_CAN2BusOff_flg "" UBYTE SWC_HALIN_CDD_type_CM_boolean_flg 0 0 0.0 1.0 ECU_ADDRESS 0x0000 /* @ECU_Address@VHAL_CAN2BusOff_flg@ */ /end MEASUREMENT
/begin MEASUREMENT VHAL_CAN3BusOff_flg "" UBYTE SWC_HALIN_CDD_type_CM_boolean_flg 0 0 0.0 1.0 ECU_ADDRESS 0x0000 /* @ECU_Address@VHAL_CAN3BusOff_flg@ */ /end MEASUREMENT
/begin MEASUREMENT VHAL_CAN4BusOff_flg "" UBYTE SWC_HALIN_CDD_type_CM_boolean_flg 0 0 0.0 1.0 ECU_ADDRESS 0x0000 /* @ECU_Address@VHAL_CAN4BusOff_flg@ */ /end MEASUREMENT
/begin MEASUREMENT VHAL_CAN5BusOff_flg "" UBYTE SWC_HALIN_CDD_type_CM_boolean_flg 0 0 0.0 1.0 ECU_ADDRESS 0x0000 /* @ECU_Address@VHAL_CAN5BusOff_flg@ */ /end MEASUREMENT
/begin MEASUREMENT VHAL_CAN6BusOff_flg "" UBYTE SWC_HALIN_CDD_type_CM_boolean_flg 0 0 0.0 1.0 ECU_ADDRESS 0x0000 /* @ECU_Address@VHAL_CAN6BusOff_flg@ */ /end MEASUREMENT
/begin MEASUREMENT VHAL_funAuto_flg "" UBYTE SWC_HALIN_CDD_type_CM_boolean_flg 0 0 0.0 1.0 ECU_ADDRESS 0x0000 /* @ECU_Address@VHAL_funAuto_flg@ */ /end MEASUREMENT
/begin MEASUREMENT VHAL_DiagDRLOFF_flg "" UBYTE SWC_HALIN_CDD_type_CM_boolean_flg 0 0 0.0 1.0 ECU_ADDRESS 0x0000 /* @ECU_Address@VHAL_DiagDRLOFF_flg@ */ /end MEASUREMENT
/begin MEASUREMENT VHAL_FlashfUnlockSingle_flg "" UBYTE SWC_HALIN_CDD_type_CM_boolean_flg 0 0 0.0 1.0 ECU_ADDRESS 0x0000 /* @ECU_Address@VHAL_FlashfUnlockSingle_flg@ */ /end MEASUREMENT
/begin MEASUREMENT VHAL_AutoWipHSpdEN_flg "" UBYTE SWC_HALIN_CDD_type_CM_boolean_flg 0 0 0.0 1.0 ECU_ADDRESS 0x0000 /* @ECU_Address@VHAL_AutoWipHSpdEN_flg@ */ /end MEASUREMENT
/begin MEASUREMENT VHAL_WipRLSCmdHoldEN_flg "" UBYTE SWC_HALIN_CDD_type_CM_boolean_flg 0 0 0.0 1.0 ECU_ADDRESS 0x0000 /* @ECU_Address@VHAL_WipRLSCmdHoldEN_flg@ */ /end MEASUREMENT
/begin MEASUREMENT VHAL_WipRLSCmdCutEN_flg "" UBYTE SWC_HALIN_CDD_type_CM_boolean_flg 0 0 0.0 1.0 ECU_ADDRESS 0x0000 /* @ECU_Address@VHAL_WipRLSCmdCutEN_flg@ */ /end MEASUREMENT
/begin MEASUREMENT VHAL_LFSensorFail_flg "" UBYTE SWC_HALIN_CDD_type_CM_boolean_flg 0 0 0.0 1.0 ECU_ADDRESS 0x0000 /* @ECU_Address@VHAL_LFSensorFail_flg@ */ /end MEASUREMENT
/begin MEASUREMENT VHAL_RFSensorFail_flg "" UBYTE SWC_HALIN_CDD_type_CM_boolean_flg 0 0 0.0 1.0 ECU_ADDRESS 0x0000 /* @ECU_Address@VHAL_RFSensorFail_flg@ */ /end MEASUREMENT
/begin MEASUREMENT VHAL_LRSensorFail_flg "" UBYTE SWC_HALIN_CDD_type_CM_boolean_flg 0 0 0.0 1.0 ECU_ADDRESS 0x0000 /* @ECU_Address@VHAL_LRSensorFail_flg@ */ /end MEASUREMENT
/begin MEASUREMENT VHAL_RRSensorFail_flg "" UBYTE SWC_HALIN_CDD_type_CM_boolean_flg 0 0 0.0 1.0 ECU_ADDRESS 0x0000 /* @ECU_Address@VHAL_RRSensorFail_flg@ */ /end MEASUREMENT
/begin MEASUREMENT VHAL_unlearnSfali_flg "" UBYTE SWC_HALIN_CDD_type_CM_boolean_flg 0 0 0.0 1.0 ECU_ADDRESS 0x0000 /* @ECU_Address@VHAL_unlearnSfali_flg@ */ /end MEASUREMENT
/begin MEASUREMENT VHAL_FlashAutoWipHSpdEN_flg "" UBYTE SWC_HALIN_CDD_type_CM_boolean_flg 0 0 0.0 1.0 ECU_ADDRESS 0x0000 /* @ECU_Address@VHAL_FlashAutoWipHSpdEN_flg@ */ /end MEASUREMENT
/begin MEASUREMENT VHAL_ReRadio_flg "" UBYTE SWC_HALIN_CDD_type_CM_boolean_flg 0 0 0.0 1.0 ECU_ADDRESS 0x0000 /* @ECU_Address@VHAL_ReRadio_flg@ */ /end MEASUREMENT
/begin MEASUREMENT VHAL_RemoteAutoReq_flg "" UBYTE SWC_HALIN_CDD_type_CM_boolean_flg 0 0 0.0 1.0 ECU_ADDRESS 0x0000 /* @ECU_Address@VHAL_RemoteAutoReq_flg@ */ /end MEASUREMENT
/begin MEASUREMENT VHAL_CAN1BusError_flg "" UBYTE SWC_HALIN_CDD_type_CM_boolean_flg 0 0 0.0 1.0 ECU_ADDRESS 0x0000 /* @ECU_Address@VHAL_CAN1BusError_flg@ */ /end MEASUREMENT
/begin MEASUREMENT VHAL_CAN2BusError_flg "" UBYTE SWC_HALIN_CDD_type_CM_boolean_flg 0 0 0.0 1.0 ECU_ADDRESS 0x0000 /* @ECU_Address@VHAL_CAN2BusError_flg@ */ /end MEASUREMENT
/begin MEASUREMENT VHAL_CAN3BusError_flg "" UBYTE SWC_HALIN_CDD_type_CM_boolean_flg 0 0 0.0 1.0 ECU_ADDRESS 0x0000 /* @ECU_Address@VHAL_CAN3BusError_flg@ */ /end MEASUREMENT
/begin MEASUREMENT VHAL_CAN4BusError_flg "" UBYTE SWC_HALIN_CDD_type_CM_boolean_flg 0 0 0.0 1.0 ECU_ADDRESS 0x0000 /* @ECU_Address@VHAL_CAN4BusError_flg@ */ /end MEASUREMENT
/begin MEASUREMENT VHAL_CAN5BusError_flg "" UBYTE SWC_HALIN_CDD_type_CM_boolean_flg 0 0 0.0 1.0 ECU_ADDRESS 0x0000 /* @ECU_Address@VHAL_CAN5BusError_flg@ */ /end MEASUREMENT
/begin MEASUREMENT VHAL_CAN6BusError_flg "" UBYTE SWC_HALIN_CDD_type_CM_boolean_flg 0 0 0.0 1.0 ECU_ADDRESS 0x0000 /* @ECU_Address@VHAL_CAN6BusError_flg@ */ /end MEASUREMENT
/begin MEASUREMENT VHAL_DidXWDSta_flg "" UBYTE SWC_HALIN_CDD_type_CM_boolean_flg 0 0 0.0 1.0 ECU_ADDRESS 0x0000 /* @ECU_Address@VHAL_DidXWDSta_flg@ */ /end MEASUREMENT
/begin MEASUREMENT VHAL_DIDVCUKeyReadSta_flg "" UBYTE SWC_HALIN_CDD_type_CM_boolean_flg 0 0 0.0 1.0 ECU_ADDRESS 0x0000 /* @ECU_Address@VHAL_DIDVCUKeyReadSta_flg@ */ /end MEASUREMENT
/begin MEASUREMENT VHAL_IMUOffsetValSta_flg "" UBYTE SWC_HALIN_CDD_type_CM_boolean_flg 0 0 0.0 1.0 ECU_ADDRESS 0x0000 /* @ECU_Address@VHAL_IMUOffsetValSta_flg@ */ /end MEASUREMENT
/begin MEASUREMENT VHAL_IMUSixAxisValSta_flg "" UBYTE SWC_HALIN_CDD_type_CM_boolean_flg 0 0 0.0 1.0 ECU_ADDRESS 0x0000 /* @ECU_Address@VHAL_IMUSixAxisValSta_flg@ */ /end MEASUREMENT
/begin MEASUREMENT VHAL_TimeSNDKCFbk_cnt "" ULONG SWC_HALIN_CDD_type_CM_uint32_cnt 0 0 0.0 4.294967295E+9 ECU_ADDRESS 0x0000 /* @ECU_Address@VHAL_TimeSNDKCFbk_cnt@ */ /end MEASUREMENT
/begin MEASUREMENT VHAL_UIDBatVoltx1000_V "" UWORD SWC_HALIN_CDD_type_CM_uint16_V 0 0 0.0 65535.0 ECU_ADDRESS 0x0000 /* @ECU_Address@VHAL_UIDBatVoltx1000_V@ */ /end MEASUREMENT
/begin MEASUREMENT VHAL_UWB1Distance_cm "" UWORD SWC_HALIN_CDD_type_CM_uint16_cm 0 0 0.0 65535.0 ECU_ADDRESS 0x0000 /* @ECU_Address@VHAL_UWB1Distance_cm@ */ /end MEASUREMENT
/begin MEASUREMENT VHAL_UWB2Distance_cm "" UWORD SWC_HALIN_CDD_type_CM_uint16_cm 0 0 0.0 65535.0 ECU_ADDRESS 0x0000 /* @ECU_Address@VHAL_UWB2Distance_cm@ */ /end MEASUREMENT
/begin MEASUREMENT VHAL_UWB3Distance_cm "" UWORD SWC_HALIN_CDD_type_CM_uint16_cm 0 0 0.0 65535.0 ECU_ADDRESS 0x0000 /* @ECU_Address@VHAL_UWB3Distance_cm@ */ /end MEASUREMENT
/begin MEASUREMENT VHAL_UWB4Distance_cm "" UWORD SWC_HALIN_CDD_type_CM_uint16_cm 0 0 0.0 65535.0 ECU_ADDRESS 0x0000 /* @ECU_Address@VHAL_UWB4Distance_cm@ */ /end MEASUREMENT
/begin MEASUREMENT VHAL_UWB5Distance_cm "" UWORD SWC_HALIN_CDD_type_CM_uint16_cm 0 0 0.0 65535.0 ECU_ADDRESS 0x0000 /* @ECU_Address@VHAL_UWB5Distance_cm@ */ /end MEASUREMENT
/begin MEASUREMENT VHAL_KeyFobAreaU16_enum "" UWORD SWC_HALIN_CDD_type_CM_uint16_enum 0 0 0.0 65535.0 ECU_ADDRESS 0x0000 /* @ECU_Address@VHAL_KeyFobAreaU16_enum@ */ /end MEASUREMENT
/begin MEASUREMENT VHAL_UWBpositionY_cm "" SWORD SWC_HALIN_CDD_type_CM_int16_cm 0 0 -32728.0 32767.0 ECU_ADDRESS 0x0000 /* @ECU_Address@VHAL_UWBpositionY_cm@ */ /end MEASUREMENT
/begin MEASUREMENT VHAL_UWBpositionX_cm "" SWORD SWC_HALIN_CDD_type_CM_int16_cm 0 0 -32728.0 32767.0 ECU_ADDRESS 0x0000 /* @ECU_Address@VHAL_UWBpositionX_cm@ */ /end MEASUREMENT
/begin MEASUREMENT VHAL_DKCDecReVehData_enum "" UBYTE SWC_HALIN_CDD_type_CM_uint8_enum 0 0 0.0 255.0 ECU_ADDRESS 0x0000 /* @ECU_Address@VHAL_DKCDecReVehData_enum@ */ /end MEASUREMENT
/begin MEASUREMENT VHAL_DKCDecRemotePW_enum "" UBYTE SWC_HALIN_CDD_type_CM_uint8_enum 0 0 0.0 255.0 ECU_ADDRESS 0x0000 /* @ECU_Address@VHAL_DKCDecRemotePW_enum@ */ /end MEASUREMENT
/begin MEASUREMENT VHAL_DKCDecPCommandToBCM_enum "" UBYTE SWC_HALIN_CDD_type_CM_uint8_enum 0 0 0.0 255.0 ECU_ADDRESS 0x0000 /* @ECU_Address@VHAL_DKCDecPCommandToBCM_enum@ */ /end MEASUREMENT
/begin MEASUREMENT VHAL_DKCDecPCommandToPTG_enum "" UBYTE SWC_HALIN_CDD_type_CM_uint8_enum 0 0 0.0 255.0 ECU_ADDRESS 0x0000 /* @ECU_Address@VHAL_DKCDecPCommandToPTG_enum@ */ /end MEASUREMENT
/begin MEASUREMENT VHAL_DKCDecPDKeyAreaLockUnlock_enum "" UBYTE SWC_HALIN_CDD_type_CM_uint8_enum 0 0 0.0 255.0 ECU_ADDRESS 0x0000 /* @ECU_Address@VHAL_DKCDecPDKeyAreaLockUnlock_enum@ */ /end MEASUREMENT
/begin MEASUREMENT VHAL_DKCDecPDKeyAreaPS_enum "" UBYTE SWC_HALIN_CDD_type_CM_uint8_enum 0 0 0.0 255.0 ECU_ADDRESS 0x0000 /* @ECU_Address@VHAL_DKCDecPDKeyAreaPS_enum@ */ /end MEASUREMENT
/begin MEASUREMENT VHAL_DKCDecPDKeyAreaPTG_enum "" UBYTE SWC_HALIN_CDD_type_CM_uint8_enum 0 0 0.0 255.0 ECU_ADDRESS 0x0000 /* @ECU_Address@VHAL_DKCDecPDKeyAreaPTG_enum@ */ /end MEASUREMENT
/begin MEASUREMENT VHAL_DKCDecPDKeyWelcome_enum "" UBYTE SWC_HALIN_CDD_type_CM_uint8_enum 0 0 0.0 255.0 ECU_ADDRESS 0x0000 /* @ECU_Address@VHAL_DKCDecPDKeyWelcome_enum@ */ /end MEASUREMENT
/begin MEASUREMENT VHAL_DKCDecPDkeyShowIVI_enum "" UBYTE SWC_HALIN_CDD_type_CM_uint8_enum 0 0 0.0 255.0 ECU_ADDRESS 0x0000 /* @ECU_Address@VHAL_DKCDecPDkeyShowIVI_enum@ */ /end MEASUREMENT
/begin MEASUREMENT VHAL_DKCDecPKeyMode_enum "" UBYTE SWC_HALIN_CDD_type_CM_uint8_enum 0 0 0.0 255.0 ECU_ADDRESS 0x0000 /* @ECU_Address@VHAL_DKCDecPKeyMode_enum@ */ /end MEASUREMENT
/begin MEASUREMENT VHAL_UIDButtonCmd_enum "" UBYTE SWC_HALIN_CDD_type_CM_uint8_enum 0 0 0.0 255.0 ECU_ADDRESS 0x0000 /* @ECU_Address@VHAL_UIDButtonCmd_enum@ */ /end MEASUREMENT
/begin MEASUREMENT VHAL_BTConnectSta_enum "" UBYTE SWC_HALIN_CDD_type_CM_uint8_enum 0 0 0.0 255.0 ECU_ADDRESS 0x0000 /* @ECU_Address@VHAL_BTConnectSta_enum@ */ /end MEASUREMENT
/begin MEASUREMENT VHAL_UWB1RangingSta_enum "" UBYTE SWC_HALIN_CDD_type_CM_uint8_enum 0 0 0.0 255.0 ECU_ADDRESS 0x0000 /* @ECU_Address@VHAL_UWB1RangingSta_enum@ */ /end MEASUREMENT
/begin MEASUREMENT VHAL_UWB2RangingSta_enum "" UBYTE SWC_HALIN_CDD_type_CM_uint8_enum 0 0 0.0 255.0 ECU_ADDRESS 0x0000 /* @ECU_Address@VHAL_UWB2RangingSta_enum@ */ /end MEASUREMENT
/begin MEASUREMENT VHAL_UWB3RangingSta_enum "" UBYTE SWC_HALIN_CDD_type_CM_uint8_enum 0 0 0.0 255.0 ECU_ADDRESS 0x0000 /* @ECU_Address@VHAL_UWB3RangingSta_enum@ */ /end MEASUREMENT
/begin MEASUREMENT VHAL_UWB4RangingSta_enum "" UBYTE SWC_HALIN_CDD_type_CM_uint8_enum 0 0 0.0 255.0 ECU_ADDRESS 0x0000 /* @ECU_Address@VHAL_UWB4RangingSta_enum@ */ /end MEASUREMENT
/begin MEASUREMENT VHAL_UWB5RangingSta_enum "" UBYTE SWC_HALIN_CDD_type_CM_uint8_enum 0 0 0.0 255.0 ECU_ADDRESS 0x0000 /* @ECU_Address@VHAL_UWB5RangingSta_enum@ */ /end MEASUREMENT
/begin MEASUREMENT VHAL_DKCResultData_raw1 "" UBYTE SWC_HALIN_CDD_type_CM_uint8_raw1 0 0 0.0 255.0 ECU_ADDRESS 0x0000 /* @ECU_Address@VHAL_DKCResultData_raw1@ */ /end MEASUREMENT
/begin MEASUREMENT VHAL_DKCResultData_raw2 "" UBYTE SWC_HALIN_CDD_type_CM_uint8_raw2 0 0 0.0 255.0 ECU_ADDRESS 0x0000 /* @ECU_Address@VHAL_DKCResultData_raw2@ */ /end MEASUREMENT
/begin MEASUREMENT VHAL_DKCResultData_raw10 "" UBYTE SWC_HALIN_CDD_type_CM_uint8_raw10 0 0 0.0 255.0 ECU_ADDRESS 0x0000 /* @ECU_Address@VHAL_DKCResultData_raw10@ */ /end MEASUREMENT
/begin MEASUREMENT VHAL_DKCResultData_raw11 "" UBYTE SWC_HALIN_CDD_type_CM_uint8_raw11 0 0 0.0 255.0 ECU_ADDRESS 0x0000 /* @ECU_Address@VHAL_DKCResultData_raw11@ */ /end MEASUREMENT
/begin MEASUREMENT VHAL_DKCResultData_raw12 "" UBYTE SWC_HALIN_CDD_type_CM_uint8_raw12 0 0 0.0 255.0 ECU_ADDRESS 0x0000 /* @ECU_Address@VHAL_DKCResultData_raw12@ */ /end MEASUREMENT
/begin MEASUREMENT VHAL_DKCResultData_raw14 "" UBYTE SWC_HALIN_CDD_type_CM_uint8_raw14 0 0 0.0 255.0 ECU_ADDRESS 0x0000 /* @ECU_Address@VHAL_DKCResultData_raw14@ */ /end MEASUREMENT
/begin MEASUREMENT VHAL_DKCResultData_raw15 "" UBYTE SWC_HALIN_CDD_type_CM_uint8_raw15 0 0 0.0 255.0 ECU_ADDRESS 0x0000 /* @ECU_Address@VHAL_DKCResultData_raw15@ */ /end MEASUREMENT
/begin MEASUREMENT VHAL_DKCResultData_raw16 "" UBYTE SWC_HALIN_CDD_type_CM_uint8_raw16 0 0 0.0 255.0 ECU_ADDRESS 0x0000 /* @ECU_Address@VHAL_DKCResultData_raw16@ */ /end MEASUREMENT
/begin MEASUREMENT VHAL_DKCResultData_raw13 "" UBYTE SWC_HALIN_CDD_type_CM_uint8_raw13 0 0 0.0 255.0 ECU_ADDRESS 0x0000 /* @ECU_Address@VHAL_DKCResultData_raw13@ */ /end MEASUREMENT
/begin MEASUREMENT VHAL_DKCResultData_raw3 "" UBYTE SWC_HALIN_CDD_type_CM_uint8_raw3 0 0 0.0 255.0 ECU_ADDRESS 0x0000 /* @ECU_Address@VHAL_DKCResultData_raw3@ */ /end MEASUREMENT
/begin MEASUREMENT VHAL_DKCResultData_raw4 "" UBYTE SWC_HALIN_CDD_type_CM_uint8_raw4 0 0 0.0 255.0 ECU_ADDRESS 0x0000 /* @ECU_Address@VHAL_DKCResultData_raw4@ */ /end MEASUREMENT
/begin MEASUREMENT VHAL_DKCResultData_raw5 "" UBYTE SWC_HALIN_CDD_type_CM_uint8_raw5 0 0 0.0 255.0 ECU_ADDRESS 0x0000 /* @ECU_Address@VHAL_DKCResultData_raw5@ */ /end MEASUREMENT
/begin MEASUREMENT VHAL_DKCResultData_raw6 "" UBYTE SWC_HALIN_CDD_type_CM_uint8_raw6 0 0 0.0 255.0 ECU_ADDRESS 0x0000 /* @ECU_Address@VHAL_DKCResultData_raw6@ */ /end MEASUREMENT
/begin MEASUREMENT VHAL_DKCResultData_raw7 "" UBYTE SWC_HALIN_CDD_type_CM_uint8_raw7 0 0 0.0 255.0 ECU_ADDRESS 0x0000 /* @ECU_Address@VHAL_DKCResultData_raw7@ */ /end MEASUREMENT
/begin MEASUREMENT VHAL_DKCResultData_raw8 "" UBYTE SWC_HALIN_CDD_type_CM_uint8_raw8 0 0 0.0 255.0 ECU_ADDRESS 0x0000 /* @ECU_Address@VHAL_DKCResultData_raw8@ */ /end MEASUREMENT
/begin MEASUREMENT VHAL_DKCResultData_raw9 "" UBYTE SWC_HALIN_CDD_type_CM_uint8_raw9 0 0 0.0 255.0 ECU_ADDRESS 0x0000 /* @ECU_Address@VHAL_DKCResultData_raw9@ */ /end MEASUREMENT
/begin MEASUREMENT VHAL_DKCBTRSSI_dB "" SBYTE SWC_HALIN_CDD_type_CM_int8_dB 0 0 -128.0 127.0 ECU_ADDRESS 0x0000 /* @ECU_Address@VHAL_DKCBTRSSI_dB@ */ /end MEASUREMENT
/begin MEASUREMENT VHAL_UWB1Power_dB "" SBYTE SWC_HALIN_CDD_type_CM_int8_dB 0 0 -128.0 127.0 ECU_ADDRESS 0x0000 /* @ECU_Address@VHAL_UWB1Power_dB@ */ /end MEASUREMENT
/begin MEASUREMENT VHAL_UWB2Power_dB "" SBYTE SWC_HALIN_CDD_type_CM_int8_dB 0 0 -128.0 127.0 ECU_ADDRESS 0x0000 /* @ECU_Address@VHAL_UWB2Power_dB@ */ /end MEASUREMENT
/begin MEASUREMENT VHAL_UWB3Power_dB "" SBYTE SWC_HALIN_CDD_type_CM_int8_dB 0 0 -128.0 127.0 ECU_ADDRESS 0x0000 /* @ECU_Address@VHAL_UWB3Power_dB@ */ /end MEASUREMENT
/begin MEASUREMENT VHAL_UWB4Power_dB "" SBYTE SWC_HALIN_CDD_type_CM_int8_dB 0 0 -128.0 127.0 ECU_ADDRESS 0x0000 /* @ECU_Address@VHAL_UWB4Power_dB@ */ /end MEASUREMENT
/begin MEASUREMENT VHAL_UWB5Power_dB "" SBYTE SWC_HALIN_CDD_type_CM_int8_dB 0 0 -128.0 127.0 ECU_ADDRESS 0x0000 /* @ECU_Address@VHAL_UWB5Power_dB@ */ /end MEASUREMENT
/begin MEASUREMENT VHAL_DKCDecPKeyMiss_flg "" UBYTE SWC_HALIN_CDD_type_CM_boolean_flg 0 0 0.0 1.0 ECU_ADDRESS 0x0000 /* @ECU_Address@VHAL_DKCDecPKeyMiss_flg@ */ /end MEASUREMENT
/begin MEASUREMENT VHAL_DKCDecPUIDLowPower_flg "" UBYTE SWC_HALIN_CDD_type_CM_boolean_flg 0 0 0.0 1.0 ECU_ADDRESS 0x0000 /* @ECU_Address@VHAL_DKCDecPUIDLowPower_flg@ */ /end MEASUREMENT
/begin MEASUREMENT VHAL_DKCDecryptionFail_flg "" UBYTE SWC_HALIN_CDD_type_CM_boolean_flg 0 0 0.0 1.0 ECU_ADDRESS 0x0000 /* @ECU_Address@VHAL_DKCDecryptionFail_flg@ */ /end MEASUREMENT
/begin MEASUREMENT VHAL_NFCDoorSta_flg "" UBYTE SWC_HALIN_CDD_type_CM_boolean_flg 0 0 0.0 1.0 ECU_ADDRESS 0x0000 /* @ECU_Address@VHAL_NFCDoorSta_flg@ */ /end MEASUREMENT
/begin MEASUREMENT VHAL_NFCLidASta_flg "" UBYTE SWC_HALIN_CDD_type_CM_boolean_flg 0 0 0.0 1.0 ECU_ADDRESS 0x0000 /* @ECU_Address@VHAL_NFCLidASta_flg@ */ /end MEASUREMENT
/begin MEASUREMENT VHAL_UWBRangingON_flg "" UBYTE SWC_HALIN_CDD_type_CM_boolean_flg 0 0 0.0 1.0 ECU_ADDRESS 0x0000 /* @ECU_Address@VHAL_UWBRangingON_flg@ */ /end MEASUREMENT
/begin MEASUREMENT VHAL_LFID_raw "" ULONG SWC_HALIN_CDD_type_CM_uint32_raw 0 0 0.0 4.294967295E+9 ECU_ADDRESS 0x0000 /* @ECU_Address@VHAL_LFID_raw@ */ /end MEASUREMENT
/begin MEASUREMENT VHAL_RFID_raw "" ULONG SWC_HALIN_CDD_type_CM_uint32_raw 0 0 0.0 4.294967295E+9 ECU_ADDRESS 0x0000 /* @ECU_Address@VHAL_RFID_raw@ */ /end MEASUREMENT
/begin MEASUREMENT VHAL_LRID_raw "" ULONG SWC_HALIN_CDD_type_CM_uint32_raw 0 0 0.0 4.294967295E+9 ECU_ADDRESS 0x0000 /* @ECU_Address@VHAL_LRID_raw@ */ /end MEASUREMENT
/begin MEASUREMENT VHAL_RRID_raw "" ULONG SWC_HALIN_CDD_type_CM_uint32_raw 0 0 0.0 4.294967295E+9 ECU_ADDRESS 0x0000 /* @ECU_Address@VHAL_RRID_raw@ */ /end MEASUREMENT
/begin MEASUREMENT VHAL_ChkLFID_raw "" ULONG SWC_HALIN_CDD_type_CM_uint32_raw 0 0 0.0 4.294967295E+9 ECU_ADDRESS 0x0000 /* @ECU_Address@VHAL_ChkLFID_raw@ */ /end MEASUREMENT
/begin MEASUREMENT VHAL_ChkRFID_raw "" ULONG SWC_HALIN_CDD_type_CM_uint32_raw 0 0 0.0 4.294967295E+9 ECU_ADDRESS 0x0000 /* @ECU_Address@VHAL_ChkRFID_raw@ */ /end MEASUREMENT
/begin MEASUREMENT VHAL_ChkLRID_raw "" ULONG SWC_HALIN_CDD_type_CM_uint32_raw 0 0 0.0 4.294967295E+9 ECU_ADDRESS 0x0000 /* @ECU_Address@VHAL_ChkLRID_raw@ */ /end MEASUREMENT
/begin MEASUREMENT VHAL_ChkRRID_raw "" ULONG SWC_HALIN_CDD_type_CM_uint32_raw 0 0 0.0 4.294967295E+9 ECU_ADDRESS 0x0000 /* @ECU_Address@VHAL_ChkRRID_raw@ */ /end MEASUREMENT
/begin MEASUREMENT VHAL_S1ID_raw "" ULONG SWC_HALIN_CDD_type_CM_uint32_raw 0 0 0.0 4.294967295E+9 ECU_ADDRESS 0x0000 /* @ECU_Address@VHAL_S1ID_raw@ */ /end MEASUREMENT
/begin MEASUREMENT VHAL_S2ID_raw "" ULONG SWC_HALIN_CDD_type_CM_uint32_raw 0 0 0.0 4.294967295E+9 ECU_ADDRESS 0x0000 /* @ECU_Address@VHAL_S2ID_raw@ */ /end MEASUREMENT
/begin MEASUREMENT VHAL_S3ID_raw "" ULONG SWC_HALIN_CDD_type_CM_uint32_raw 0 0 0.0 4.294967295E+9 ECU_ADDRESS 0x0000 /* @ECU_Address@VHAL_S3ID_raw@ */ /end MEASUREMENT
/begin MEASUREMENT VHAL_S4ID_raw "" ULONG SWC_HALIN_CDD_type_CM_uint32_raw 0 0 0.0 4.294967295E+9 ECU_ADDRESS 0x0000 /* @ECU_Address@VHAL_S4ID_raw@ */ /end MEASUREMENT
/begin MEASUREMENT VHAL_TPMSID_raw "" ULONG SWC_HALIN_CDD_type_CM_uint32_raw 0 0 0.0 4.294967295E+9 ECU_ADDRESS 0x0000 /* @ECU_Address@VHAL_TPMSID_raw@ */ /end MEASUREMENT
/begin MEASUREMENT VHAL_TPMSPressure_raw "" UBYTE SWC_HALIN_CDD_type_CM_uint8_raw 0 0 0.0 255.0 ECU_ADDRESS 0x0000 /* @ECU_Address@VHAL_TPMSPressure_raw@ */ /end MEASUREMENT
/begin MEASUREMENT VHAL_TPMSTemp_raw "" UBYTE SWC_HALIN_CDD_type_CM_uint8_raw 0 0 0.0 255.0 ECU_ADDRESS 0x0000 /* @ECU_Address@VHAL_TPMSTemp_raw@ */ /end MEASUREMENT
/begin MEASUREMENT VHAL_TPMSSta_enum "" UBYTE SWC_HALIN_CDD_type_CM_uint8_enum 0 0 0.0 255.0 ECU_ADDRESS 0x0000 /* @ECU_Address@VHAL_TPMSSta_enum@ */ /end MEASUREMENT
/begin MEASUREMENT VHAL_TPMSPressureMi_raw "" UBYTE SWC_HALIN_CDD_type_CM_uint8_raw 0 0 0.0 255.0 ECU_ADDRESS 0x0000 /* @ECU_Address@VHAL_TPMSPressureMi_raw@ */ /end MEASUREMENT
/begin MEASUREMENT VHAL_TPMSCRC_crc "" UBYTE SWC_HALIN_CDD_type_CM_uint8_crc 0 0 0.0 255.0 ECU_ADDRESS 0x0000 /* @ECU_Address@VHAL_TPMSCRC_crc@ */ /end MEASUREMENT
/begin MEASUREMENT VHAL_TPMSCRCCalc_crc "" UBYTE SWC_HALIN_CDD_type_CM_uint8_crc 0 0 0.0 255.0 ECU_ADDRESS 0x0000 /* @ECU_Address@VHAL_TPMSCRCCalc_crc@ */ /end MEASUREMENT
/begin MEASUREMENT VHAL_TPMSSensorIDRegSta_enum "" UBYTE SWC_HALIN_CDD_type_CM_uint8_enum 0 0 0.0 4.0 ECU_ADDRESS 0x0000 /* @ECU_Address@VHAL_TPMSSensorIDRegSta_enum@ */ /end MEASUREMENT
/begin MEASUREMENT VHAL_FlashLFWheelPSW_raw8 "" UBYTE SWC_HALIN_CDD_type_CM_uint8_raw8 0 0 0.0 255.0 ECU_ADDRESS 0x0000 /* @ECU_Address@VHAL_FlashLFWheelPSW_raw8@ */ /end MEASUREMENT
/begin MEASUREMENT VHAL_FlashRFWheelPSW_raw8 "" UBYTE SWC_HALIN_CDD_type_CM_uint8_raw8 0 0 0.0 255.0 ECU_ADDRESS 0x0000 /* @ECU_Address@VHAL_FlashRFWheelPSW_raw8@ */ /end MEASUREMENT
/begin MEASUREMENT VHAL_FlashLRWheelPSW_raw8 "" UBYTE SWC_HALIN_CDD_type_CM_uint8_raw8 0 0 0.0 255.0 ECU_ADDRESS 0x0000 /* @ECU_Address@VHAL_FlashLRWheelPSW_raw8@ */ /end MEASUREMENT
/begin MEASUREMENT VHAL_FlashRRWheelPSW_raw8 "" UBYTE SWC_HALIN_CDD_type_CM_uint8_raw8 0 0 0.0 255.0 ECU_ADDRESS 0x0000 /* @ECU_Address@VHAL_FlashRRWheelPSW_raw8@ */ /end MEASUREMENT
/begin MEASUREMENT VHAL_FlashLFPindi_enum "" UBYTE SWC_HALIN_CDD_type_CM_uint8_enum 0 0 0.0 255.0 ECU_ADDRESS 0x0000 /* @ECU_Address@VHAL_FlashLFPindi_enum@ */ /end MEASUREMENT
/begin MEASUREMENT VHAL_FlashRFPindi_enum "" UBYTE SWC_HALIN_CDD_type_CM_uint8_enum 0 0 0.0 255.0 ECU_ADDRESS 0x0000 /* @ECU_Address@VHAL_FlashRFPindi_enum@ */ /end MEASUREMENT
/begin MEASUREMENT VHAL_FlashLRPindi_enum "" UBYTE SWC_HALIN_CDD_type_CM_uint8_enum 0 0 0.0 255.0 ECU_ADDRESS 0x0000 /* @ECU_Address@VHAL_FlashLRPindi_enum@ */ /end MEASUREMENT
/begin MEASUREMENT VHAL_FlashRRPindi_enum "" UBYTE SWC_HALIN_CDD_type_CM_uint8_enum 0 0 0.0 255.0 ECU_ADDRESS 0x0000 /* @ECU_Address@VHAL_FlashRRPindi_enum@ */ /end MEASUREMENT
/begin MEASUREMENT VHAL_FlashLFP20_raw8 "" UBYTE SWC_HALIN_CDD_type_CM_uint8_raw8 0 0 0.0 255.0 ECU_ADDRESS 0x0000 /* @ECU_Address@VHAL_FlashLFP20_raw8@ */ /end MEASUREMENT
/begin MEASUREMENT VHAL_FlashRFP20_raw8 "" UBYTE SWC_HALIN_CDD_type_CM_uint8_raw8 0 0 0.0 255.0 ECU_ADDRESS 0x0000 /* @ECU_Address@VHAL_FlashRFP20_raw8@ */ /end MEASUREMENT
/begin MEASUREMENT VHAL_FlashLRP20_raw8 "" UBYTE SWC_HALIN_CDD_type_CM_uint8_raw8 0 0 0.0 255.0 ECU_ADDRESS 0x0000 /* @ECU_Address@VHAL_FlashLRP20_raw8@ */ /end MEASUREMENT
/begin MEASUREMENT VHAL_FlashRRP20_raw8 "" UBYTE SWC_HALIN_CDD_type_CM_uint8_raw8 0 0 0.0 255.0 ECU_ADDRESS 0x0000 /* @ECU_Address@VHAL_FlashRRP20_raw8@ */ /end MEASUREMENT
/begin MEASUREMENT VHAL_FlashLFWheelPress_raw8 "" UBYTE SWC_HALIN_CDD_type_CM_uint8_raw8 0 0 0.0 255.0 ECU_ADDRESS 0x0000 /* @ECU_Address@VHAL_FlashLFWheelPress_raw8@ */ /end MEASUREMENT
/begin MEASUREMENT VHAL_FlashRFWheelPress_raw8 "" UBYTE SWC_HALIN_CDD_type_CM_uint8_raw8 0 0 0.0 255.0 ECU_ADDRESS 0x0000 /* @ECU_Address@VHAL_FlashRFWheelPress_raw8@ */ /end MEASUREMENT
/begin MEASUREMENT VHAL_FlashLRWheelPress_raw8 "" UBYTE SWC_HALIN_CDD_type_CM_uint8_raw8 0 0 0.0 255.0 ECU_ADDRESS 0x0000 /* @ECU_Address@VHAL_FlashLRWheelPress_raw8@ */ /end MEASUREMENT
/begin MEASUREMENT VHAL_FlashRRWheelPress_raw8 "" UBYTE SWC_HALIN_CDD_type_CM_uint8_raw8 0 0 0.0 255.0 ECU_ADDRESS 0x0000 /* @ECU_Address@VHAL_FlashRRWheelPress_raw8@ */ /end MEASUREMENT
/begin MEASUREMENT VHAL_FlashLFWheelTemp_C "" UBYTE SWC_HALIN_CDD_type_CM_uint8_C 0 0 0.0 255.0 ECU_ADDRESS 0x0000 /* @ECU_Address@VHAL_FlashLFWheelTemp_C@ */ /end MEASUREMENT
/begin MEASUREMENT VHAL_FlashRFWheelTemp_C "" UBYTE SWC_HALIN_CDD_type_CM_uint8_C 0 0 0.0 255.0 ECU_ADDRESS 0x0000 /* @ECU_Address@VHAL_FlashRFWheelTemp_C@ */ /end MEASUREMENT
/begin MEASUREMENT VHAL_FlashLRWheelTemp_C "" UBYTE SWC_HALIN_CDD_type_CM_uint8_C 0 0 0.0 255.0 ECU_ADDRESS 0x0000 /* @ECU_Address@VHAL_FlashLRWheelTemp_C@ */ /end MEASUREMENT
/begin MEASUREMENT VHAL_FlashRRWheelTemp_C "" UBYTE SWC_HALIN_CDD_type_CM_uint8_C 0 0 0.0 255.0 ECU_ADDRESS 0x0000 /* @ECU_Address@VHAL_FlashRRWheelTemp_C@ */ /end MEASUREMENT
/begin MEASUREMENT VHAL_TPMSStorge_flg "" UBYTE SWC_HALIN_CDD_type_CM_boolean_flg 0 0 0.0 1.0 ECU_ADDRESS 0x0000 /* @ECU_Address@VHAL_TPMSStorge_flg@ */ /end MEASUREMENT
/begin MEASUREMENT VHAL_ChkStorge_flg "" UBYTE SWC_HALIN_CDD_type_CM_boolean_flg 0 0 0.0 1.0 ECU_ADDRESS 0x0000 /* @ECU_Address@VHAL_ChkStorge_flg@ */ /end MEASUREMENT
/begin MEASUREMENT VHAL_FlashLFSensorFail_flg "" UBYTE SWC_HALIN_CDD_type_CM_boolean_flg 0 0 0.0 1.0 ECU_ADDRESS 0x0000 /* @ECU_Address@VHAL_FlashLFSensorFail_flg@ */ /end MEASUREMENT
/begin MEASUREMENT VHAL_FlashRFSensorFail_flg "" UBYTE SWC_HALIN_CDD_type_CM_boolean_flg 0 0 0.0 1.0 ECU_ADDRESS 0x0000 /* @ECU_Address@VHAL_FlashRFSensorFail_flg@ */ /end MEASUREMENT
/begin MEASUREMENT VHAL_FlashLRSensorFail_flg "" UBYTE SWC_HALIN_CDD_type_CM_boolean_flg 0 0 0.0 1.0 ECU_ADDRESS 0x0000 /* @ECU_Address@VHAL_FlashLRSensorFail_flg@ */ /end MEASUREMENT
/begin MEASUREMENT VHAL_FlashRRSensorFail_flg "" UBYTE SWC_HALIN_CDD_type_CM_boolean_flg 0 0 0.0 1.0 ECU_ADDRESS 0x0000 /* @ECU_Address@VHAL_FlashRRSensorFail_flg@ */ /end MEASUREMENT
/begin MEASUREMENT VHAL_Prepresstemptrust_flg "" UBYTE SWC_HALIN_CDD_type_CM_boolean_flg 0 0 0.0 1.0 ECU_ADDRESS 0x0000 /* @ECU_Address@VHAL_Prepresstemptrust_flg@ */ /end MEASUREMENT
/begin MEASUREMENT VHAL_FlashunlearnSfali_flg "" UBYTE SWC_HALIN_CDD_type_CM_boolean_flg 0 0 0.0 1.0 ECU_ADDRESS 0x0000 /* @ECU_Address@VHAL_FlashunlearnSfali_flg@ */ /end MEASUREMENT
/begin MEASUREMENT VHAL_TPMSFAT_flg "" UBYTE SWC_HALIN_CDD_type_CM_boolean_flg 0 0 0.0 1.0 ECU_ADDRESS 0x0000 /* @ECU_Address@VHAL_TPMSFAT_flg@ */ /end MEASUREMENT
/begin MEASUREMENT VHAL_TPMSBattLow_flg "" UBYTE SWC_HALIN_CDD_type_CM_boolean_flg 0 0 0.0 1.0 ECU_ADDRESS 0x0000 /* @ECU_Address@VHAL_TPMSBattLow_flg@ */ /end MEASUREMENT
/begin MEASUREMENT VHAL_TPMSDataIn_flg "" UBYTE SWC_HALIN_CDD_type_CM_boolean_flg 0 0 0.0 1.0 ECU_ADDRESS 0x0000 /* @ECU_Address@VHAL_TPMSDataIn_flg@ */ /end MEASUREMENT
/begin MEASUREMENT VHAL_TPMSTrigger_flg "" UBYTE SWC_HALIN_CDD_type_CM_boolean_flg 0 0 0.0 1.0 ECU_ADDRESS 0x0000 /* @ECU_Address@VHAL_TPMSTrigger_flg@ */ /end MEASUREMENT
/begin COMPU_METHOD SWC_HALIN_CDD_type_CM_single_sec "Q = V" RAT_FUNC "%8.6" "sec" COEFFS 0 1 0 0 0 1 /end COMPU_METHOD
/begin COMPU_METHOD SWC_HALIN_CDD_type_CM_uint32_enum "Q = V" RAT_FUNC "%10.0" "enum" COEFFS 0 1 0 0 0 1 /end COMPU_METHOD
/begin COMPU_METHOD SWC_HALIN_CDD_type_CM_boolean_flg "Q = V" RAT_FUNC "%1.0" "flg" COEFFS 0 1 0 0 0 1 /end COMPU_METHOD
/begin COMPU_METHOD SWC_HALIN_CDD_type_CM_uint8_enum "Q = V" RAT_FUNC "%3.0" "enum" COEFFS 0 1 0 0 0 1 /end COMPU_METHOD
/begin COMPU_METHOD SWC_HALIN_CDD_type_CM_uint32_raw32 "Q = V" RAT_FUNC "%10.0" "raw32" COEFFS 0 1 0 0 0 1 /end COMPU_METHOD
/begin COMPU_METHOD SWC_HALIN_CDD_type_CM_uint32_sec "Q = V" RAT_FUNC "%10.0" "sec" COEFFS 0 1 0 0 0 1 /end COMPU_METHOD
/begin COMPU_METHOD SWC_HALIN_CDD_type_CM_uint32_kphsqr "Q = V" RAT_FUNC "%10.0" "kphsqr" COEFFS 0 1 0 0 0 1 /end COMPU_METHOD
/begin COMPU_METHOD SWC_HALIN_CDD_type_CM_uint32_cnt "Q = V" RAT_FUNC "%10.0" "cnt" COEFFS 0 1 0 0 0 1 /end COMPU_METHOD
/begin COMPU_METHOD SWC_HALIN_CDD_type_CM_uint32 "Q = V" RAT_FUNC "%10.0" "" COEFFS 0 1 0 0 0 1 /end COMPU_METHOD
/begin COMPU_METHOD SWC_HALIN_CDD_type_CM_uint32_raw "Q = V" RAT_FUNC "%10.0" "raw" COEFFS 0 1 0 0 0 1 /end COMPU_METHOD
/begin COMPU_METHOD SWC_HALIN_CDD_type_CM_single_raw "Q = V" RAT_FUNC "%8.6" "raw" COEFFS 0 1 0 0 0 1 /end COMPU_METHOD
/begin COMPU_METHOD SWC_HALIN_CDD_type_CM_single_pct "Q = V" RAT_FUNC "%8.6" "pct" COEFFS 0 1 0 0 0 1 /end COMPU_METHOD
/begin COMPU_METHOD SWC_HALIN_CDD_type_CM_single_Deg "Q = V" RAT_FUNC "%8.6" "Deg" COEFFS 0 1 0 0 0 1 /end COMPU_METHOD
/begin COMPU_METHOD SWC_HALIN_CDD_type_CM_single_mps2 "Q = V" RAT_FUNC "%8.6" "mps2" COEFFS 0 1 0 0 0 1 /end COMPU_METHOD
/begin COMPU_METHOD SWC_HALIN_CDD_type_CM_single_kph "Q = V" RAT_FUNC "%8.6" "kph" COEFFS 0 1 0 0 0 1 /end COMPU_METHOD
/begin COMPU_METHOD SWC_HALIN_CDD_type_CM_single_V "Q = V" RAT_FUNC "%8.6" "V" COEFFS 0 1 0 0 0 1 /end COMPU_METHOD
/begin COMPU_METHOD SWC_HALIN_CDD_type_CM_single_s "Q = V" RAT_FUNC "%8.6" "s" COEFFS 0 1 0 0 0 1 /end COMPU_METHOD
/begin COMPU_METHOD SWC_HALIN_CDD_type_CM_single_mA "Q = V" RAT_FUNC "%8.6" "mA" COEFFS 0 1 0 0 0 1 /end COMPU_METHOD
/begin COMPU_METHOD SWC_HALIN_CDD_type_CM_single_km "Q = V" RAT_FUNC "%8.6" "km" COEFFS 0 1 0 0 0 1 /end COMPU_METHOD
/begin COMPU_METHOD SWC_HALIN_CDD_type_CM_single_Ahr "Q = V" RAT_FUNC "%8.6" "Ahr" COEFFS 0 1 0 0 0 1 /end COMPU_METHOD
/begin COMPU_METHOD SWC_HALIN_CDD_type_CM_single_kWh "Q = V" RAT_FUNC "%8.6" "kWh" COEFFS 0 1 0 0 0 1 /end COMPU_METHOD
/begin COMPU_METHOD SWC_HALIN_CDD_type_CM_single_C "Q = V" RAT_FUNC "%8.6" "C" COEFFS 0 1 0 0 0 1 /end COMPU_METHOD
/begin COMPU_METHOD SWC_HALIN_CDD_type_CM_single_cnt "Q = V" RAT_FUNC "%8.6" "cnt" COEFFS 0 1 0 0 0 1 /end COMPU_METHOD
/begin COMPU_METHOD SWC_HALIN_CDD_type_CM_uint16_cm "Q = V" RAT_FUNC "%5.0" "cm" COEFFS 0 1 0 0 0 1 /end COMPU_METHOD
/begin COMPU_METHOD SWC_HALIN_CDD_type_CM_uint16_mV "Q = V" RAT_FUNC "%5.0" "mV" COEFFS 0 1 0 0 0 1 /end COMPU_METHOD
/begin COMPU_METHOD SWC_HALIN_CDD_type_CM_uint16_cnt "Q = V" RAT_FUNC "%5.0" "cnt" COEFFS 0 1 0 0 0 1 /end COMPU_METHOD
/begin COMPU_METHOD SWC_HALIN_CDD_type_CM_uint16_min "Q = V" RAT_FUNC "%5.0" "min" COEFFS 0 1 0 0 0 1 /end COMPU_METHOD
/begin COMPU_METHOD SWC_HALIN_CDD_type_CM_uint16 "Q = V" RAT_FUNC "%5.0" "" COEFFS 0 1 0 0 0 1 /end COMPU_METHOD
/begin COMPU_METHOD SWC_HALIN_CDD_type_CM_uint16_enum "Q = V" RAT_FUNC "%5.0" "enum" COEFFS 0 1 0 0 0 1 /end COMPU_METHOD
/begin COMPU_METHOD SWC_HALIN_CDD_type_CM_int16_raw16 "Q = V" RAT_FUNC "%5.0" "raw16" COEFFS 0 1 0 0 0 1 /end COMPU_METHOD
/begin COMPU_METHOD SWC_HALIN_CDD_type_CM_uint8_raw "Q = V" RAT_FUNC "%3.0" "raw" COEFFS 0 1 0 0 0 1 /end COMPU_METHOD
/begin COMPU_METHOD SWC_HALIN_CDD_type_CM_uint8_cm "Q = V" RAT_FUNC "%3.0" "cm" COEFFS 0 1 0 0 0 1 /end COMPU_METHOD
/begin COMPU_METHOD SWC_HALIN_CDD_type_CM_uint8_cnt "Q = V" RAT_FUNC "%3.0" "cnt" COEFFS 0 1 0 0 0 1 /end COMPU_METHOD
/begin COMPU_METHOD SWC_HALIN_CDD_type_CM_uint8_OTA_enum "Q = V" RAT_FUNC "%3.0" "OTA_enum" COEFFS 0 1 0 0 0 1 /end COMPU_METHOD
/begin COMPU_METHOD SWC_HALIN_CDD_type_CM_uint8_raw1 "Q = V" RAT_FUNC "%3.0" "raw1" COEFFS 0 1 0 0 0 1 /end COMPU_METHOD
/begin COMPU_METHOD SWC_HALIN_CDD_type_CM_uint8_raw2 "Q = V" RAT_FUNC "%3.0" "raw2" COEFFS 0 1 0 0 0 1 /end COMPU_METHOD
/begin COMPU_METHOD SWC_HALIN_CDD_type_CM_uint8_raw3 "Q = V" RAT_FUNC "%3.0" "raw3" COEFFS 0 1 0 0 0 1 /end COMPU_METHOD
/begin COMPU_METHOD SWC_HALIN_CDD_type_CM_uint8_raw4 "Q = V" RAT_FUNC "%3.0" "raw4" COEFFS 0 1 0 0 0 1 /end COMPU_METHOD
/begin COMPU_METHOD SWC_HALIN_CDD_type_CM_uint8_raw5 "Q = V" RAT_FUNC "%3.0" "raw5" COEFFS 0 1 0 0 0 1 /end COMPU_METHOD
/begin COMPU_METHOD SWC_HALIN_CDD_type_CM_uint8_raw6 "Q = V" RAT_FUNC "%3.0" "raw6" COEFFS 0 1 0 0 0 1 /end COMPU_METHOD
/begin COMPU_METHOD SWC_HALIN_CDD_type_CM_uint8_raw7 "Q = V" RAT_FUNC "%3.0" "raw7" COEFFS 0 1 0 0 0 1 /end COMPU_METHOD
/begin COMPU_METHOD SWC_HALIN_CDD_type_CM_uint8_raw8 "Q = V" RAT_FUNC "%3.0" "raw8" COEFFS 0 1 0 0 0 1 /end COMPU_METHOD
/begin COMPU_METHOD SWC_HALIN_CDD_type_CM_uint8_C "Q = V" RAT_FUNC "%3.0" "C" COEFFS 0 1 0 0 0 1 /end COMPU_METHOD
/begin COMPU_METHOD SWC_HALIN_CDD_type_CM_uint8_pct "Q = V" RAT_FUNC "%3.0" "pct" COEFFS 0 1 0 0 0 1 /end COMPU_METHOD
/begin COMPU_METHOD SWC_HALIN_CDD_type_CM_uint8_s "Q = V" RAT_FUNC "%3.0" "s" COEFFS 0 1 0 0 0 1 /end COMPU_METHOD
/begin COMPU_METHOD SWC_HALIN_CDD_type_CM_uint8 "Q = V" RAT_FUNC "%3.0" "" COEFFS 0 1 0 0 0 1 /end COMPU_METHOD
/begin COMPU_METHOD SWC_HALIN_CDD_type_CM_uint16_V "Q = V" RAT_FUNC "%5.0" "V" COEFFS 0 1 0 0 0 1 /end COMPU_METHOD
/begin COMPU_METHOD SWC_HALIN_CDD_type_CM_int16_cm "Q = V" RAT_FUNC "%5.0" "cm" COEFFS 0 1 0 0 0 1 /end COMPU_METHOD
/begin COMPU_METHOD SWC_HALIN_CDD_type_CM_uint8_raw10 "Q = V" RAT_FUNC "%3.0" "raw10" COEFFS 0 1 0 0 0 1 /end COMPU_METHOD
/begin COMPU_METHOD SWC_HALIN_CDD_type_CM_uint8_raw11 "Q = V" RAT_FUNC "%3.0" "raw11" COEFFS 0 1 0 0 0 1 /end COMPU_METHOD
/begin COMPU_METHOD SWC_HALIN_CDD_type_CM_uint8_raw12 "Q = V" RAT_FUNC "%3.0" "raw12" COEFFS 0 1 0 0 0 1 /end COMPU_METHOD
/begin COMPU_METHOD SWC_HALIN_CDD_type_CM_uint8_raw14 "Q = V" RAT_FUNC "%3.0" "raw14" COEFFS 0 1 0 0 0 1 /end COMPU_METHOD
/begin COMPU_METHOD SWC_HALIN_CDD_type_CM_uint8_raw15 "Q = V" RAT_FUNC "%3.0" "raw15" COEFFS 0 1 0 0 0 1 /end COMPU_METHOD
/begin COMPU_METHOD SWC_HALIN_CDD_type_CM_uint8_raw16 "Q = V" RAT_FUNC "%3.0" "raw16" COEFFS 0 1 0 0 0 1 /end COMPU_METHOD
/begin COMPU_METHOD SWC_HALIN_CDD_type_CM_uint8_raw13 "Q = V" RAT_FUNC "%3.0" "raw13" COEFFS 0 1 0 0 0 1 /end COMPU_METHOD
/begin COMPU_METHOD SWC_HALIN_CDD_type_CM_uint8_raw9 "Q = V" RAT_FUNC "%3.0" "raw9" COEFFS 0 1 0 0 0 1 /end COMPU_METHOD
/begin COMPU_METHOD SWC_HALIN_CDD_type_CM_int8_dB "Q = V" RAT_FUNC "%3.0" "dB" COEFFS 0 1 0 0 0 1 /end COMPU_METHOD
/begin COMPU_METHOD SWC_HALIN_CDD_type_CM_uint8_crc "Q = V" RAT_FUNC "%3.0" "crc" COEFFS 0 1 0 0 0 1 /end COMPU_METHOD
/begin GROUP SWC_HALIN_CDD_type "SWC_HALIN_CDD_type" /* Root */ ROOT /begin SUB_GROUP Root_run_SWC_HALIN_CDD_Rx_5ms_sys /end SUB_GROUP /end GROUP
/begin GROUP Root_run_SWC_HALIN_CDD_Rx_5ms_sys "SWC_HALIN_CDD_type/run_SWC_HALIN_CDD_Rx_5ms_sys" /begin SUB_GROUP S3_DIDGet_Subsystem S3_Halin_CDD S3_Subsystem /end SUB_GROUP /begin REF_CHARACTERISTIC KINP_ReadVinCode_flg /end REF_CHARACTERISTIC
 /begin REF_MEASUREMENT VHAL_AccelPedal1Vol_raw VHAL_AccelPedal2Vol_raw VHAL_AcoreRebootCmd_raw VHAL_CAN1RxErrorCount_raw VHAL_CAN1TxErrorCount_raw VHAL_CAN2RxErrorCount_raw VHAL_CAN2TxErrorCount_raw VHAL_CAN3RxErrorCount_raw VHAL_CAN3TxErrorCount_raw VHAL_CAN4RxErrorCount_raw VHAL_CAN4TxErrorCount_raw VHAL_CAN5RxErrorCount_raw VHAL_CAN5TxErrorCount_raw VHAL_CAN6RxErrorCount_raw VHAL_CAN6TxErrorCount_raw /end REF_MEASUREMENT
/end GROUP
/begin GROUP S3_DIDGet_Subsystem "SWC_HALIN_CDD_type/run_SWC_HALIN_CDD_Rx_5ms_sys/DIDGet_Subsystem"
 /begin REF_MEASUREMENT VHAL_APSFunConfig_raw VHAL_AutoLock_raw VHAL_AutoWipHSpdEN_raw VHAL_DIDStaAPSFunConfig_raw VHAL_DIDStaAutoLock_raw VHAL_DIDStaAutoWipHSpdEN_raw VHAL_DIDStaDKCKey_raw VHAL_DIDStaDRLDis_raw VHAL_DIDStaDynoMode_raw VHAL_DIDStaFMHTimer_raw VHAL_DIDStaOBDReq_raw VHAL_DIDStaTestGroup_raw VHAL_DIDStaTireSize_raw VHAL_DIDStaTurnLampFLThreCurr_raw VHAL_DIDStaTurnLampFRThreCurr_raw VHAL_DIDStaTurnLampRLThreCurr_raw VHAL_DIDStaTurnLampRRThreCurr_raw VHAL_DIDStaUSSConfig_raw VHAL_DIDStaWipRLSCmdCutFilter_raw VHAL_DIDStaWipRLSCmdHoldFilter_raw VHAL_DIDStaXWDMode_raw VHAL_DKCKey_raw VHAL_DRLDis_raw VHAL_DynoMode_raw VHAL_FMHTimer_raw VHAL_OBDReq_raw VHAL_TestGroup_raw VHAL_TireSize_raw VHAL_TurnLampFLThreCurr_raw VHAL_TurnLampFRThreCurr_raw VHAL_TurnLampRLThreCurr_raw VHAL_TurnLampRRThreCurr_raw VHAL_USSConfig_raw VHAL_WipRLSCmdCutFilter_raw VHAL_WipRLSCmdHoldFilter_raw VHAL_XWDMode_raw /end REF_MEASUREMENT
/end GROUP
/begin GROUP S3_Halin_CDD "SWC_HALIN_CDD_type/run_SWC_HALIN_CDD_Rx_5ms_sys/Halin_CDD"
 /begin SUB_GROUP S5_Halin_APM S5_Halin_DKC_A S5_Halin_GPIO S5_Halin_IMU S5_Halin_SYS S5_Halin_TPMS S5_Subsystem7 /end SUB_GROUP
/end GROUP
/begin GROUP S3_Subsystem "SWC_HALIN_CDD_type/run_SWC_HALIN_CDD_Rx_5ms_sys/Subsystem" /begin SUB_GROUP S8_DKC2 /end SUB_GROUP /end GROUP
/begin GROUP S5_Halin_APM "SWC_HALIN_CDD_type/run_SWC_HALIN_CDD_Rx_5ms_sys/Halin_CDD/Halin_APM"
 /begin REF_MEASUREMENT VHAL_APSAngleTarget_Deg VHAL_APSDFLL_cm VHAL_APSDFLR_cm VHAL_APSDRLL_cm VHAL_APSDRLR_cm VHAL_APSDecReqA_flg VHAL_APSDecReq_mps2 VHAL_APSExitCondition_enum VHAL_APSHWVer_enum VHAL_APSProgressPCT_pct VHAL_APSPwrReq_enum VHAL_APSRQDisplay_enum VHAL_APSReq_enum VHAL_APSRqEPASCtrl_flg VHAL_APSSWVer_enum VHAL_APSShiftPosnReq_enum VHAL_APSSpeedCMD_kph VHAL_APSStaSystem_enum VHAL_APSVMCReqA_flg VHAL_APSVRqEPASCtrl_flg VHAL_CAASSta_enum VHAL_CAASVMCReqA_flg VHAL_Chime_enum VHAL_ModOperation_enum VHAL_PASAFCL_enum VHAL_PASAFCR_enum VHAL_PASAFML_enum VHAL_PASAFMR_enum VHAL_PASARCL_enum VHAL_PASARCR_enum VHAL_PASARML_enum VHAL_PASARMR_enum VHAL_PASDFCL_cm VHAL_PASDFCR_cm VHAL_PASDFML_cm VHAL_PASDFMR_cm VHAL_PASDRCL_cm VHAL_PASDRCR_cm VHAL_PASDRML_cm VHAL_PASDRMR_cm VHAL_RAPSBCMLamp_enum VHAL_RAPSBCMLockReq_flg VHAL_RAPSErrLv1_flg VHAL_RAPSErrWarnSta_enum VHAL_SNSRLayout_enum VHAL_StaFSya_flg VHAL_USSStaFCL_flg VHAL_USSStaFCR_flg VHAL_USSStaFLL_flg VHAL_USSStaFLR_flg VHAL_USSStaFML_flg VHAL_USSStaFMR_flg VHAL_USSStaRCL_flg VHAL_USSStaRCR_flg VHAL_USSStaRLL_flg VHAL_USSStaRLR_flg VHAL_USSStaRML_flg VHAL_USSStaRMR_flg /end REF_MEASUREMENT
/end GROUP
/begin GROUP S5_Halin_DKC_A "SWC_HALIN_CDD_type/run_SWC_HALIN_CDD_Rx_5ms_sys/Halin_CDD/Halin_DKC_A"
 /begin REF_CHARACTERISTIC KHAL_DKCDecryptEnable_flg_ovrdflg KHAL_DKCDecryptEnable_flg_ovrdval KHAL_RandomNumberY1_enum KHAL_RandomNumberY2_enum KHAL_RandomNumberY_ovrdflg /end REF_CHARACTERISTIC
 /begin REF_MEASUREMENT VHAL_EncryptionDATA0631_enum VHAL_EncryptionDATA0632_enum VHAL_EncryptionDATA0633_enum VHAL_EncryptionDATA0634_enum VHAL_EncryptionDATA0635_enum VHAL_EncryptionDATA0636_enum VHAL_EncryptionDATA0637_enum VHAL_EncryptionDATA0638_enum /end REF_MEASUREMENT
/end GROUP
/begin GROUP S5_Halin_GPIO "SWC_HALIN_CDD_type/run_SWC_HALIN_CDD_Rx_5ms_sys/Halin_CDD/Halin_GPIO"
 /begin REF_MEASUREMENT VHAL_AccelPedal1Vol_V VHAL_AccelPedal2Vol_V VHAL_BrakeLampSW_flg VHAL_BrakeSWGPIO_flg VHAL_CentralDoorLockSW_flg VHAL_CrashSignalGPIO_flg VHAL_DrDoorSW_flg VHAL_HWID1_enum VHAL_HWID2_enum VHAL_HWID3_enum VHAL_HWID4_enum VHAL_HazardSW_flg VHAL_HoodSW_flg VHAL_PsDoorSW_flg VHAL_RLDoorSW_flg VHAL_RRDoorSW_flg VHAL_SeatSW_flg VHAL_TailgateSW_flg VHAL_TrunkHanSW_flg /end REF_MEASUREMENT
/end GROUP
/begin GROUP S5_Halin_IMU "SWC_HALIN_CDD_type/run_SWC_HALIN_CDD_Rx_5ms_sys/Halin_CDD/Halin_IMU"
 /begin REF_MEASUREMENT VHAL_IMUOffsetValSta_flg VHAL_IMUSixAxisValSta_flg VHAL_MemOffsetAccX_raw16 VHAL_MemOffsetAccY_raw16 VHAL_MemOffsetAccZ_raw16 VHAL_MemOffsetGyroX_raw16 VHAL_MemOffsetGyroY_raw16 VHAL_MemOffsetGyroZ_raw16 VHAL_SensingAccX_raw16 VHAL_SensingAccY_raw16 VHAL_SensingAccZ_raw16 VHAL_SensingGyroX_raw16 VHAL_SensingGyroY_raw16 VHAL_SensingGyroZ_raw16 /end REF_MEASUREMENT
/end GROUP
/begin GROUP S5_Halin_SYS "SWC_HALIN_CDD_type/run_SWC_HALIN_CDD_Rx_5ms_sys/Halin_CDD/Halin_SYS"
 /begin SUB_GROUP S14_FlashAirIntenZone1M_Verify S14_FlashCountAlarm_Verify S14_FlashIVIPTGUSStaSW_Verify S14_FlashMFRDNBrightReq_Verify S14_LatchedFlg S14_LatchedFlg1 S14_LatchedFlg2 S14_LatchedFlg3 S14_LatchedFlg4 S14_LatchedFlg5 S14_RemoteControlSignal S14_convert_out S14_convert_out1 S14_convert_out10 S14_convert_out11 S14_convert_out12 S14_convert_out13 S14_convert_out14 S14_convert_out15 S14_convert_out16 S14_convert_out17 S14_convert_out18 S14_convert_out19 S14_convert_out2 S14_convert_out20 S14_convert_out21 S14_convert_out22 S14_convert_out23 S14_convert_out24 S14_convert_out25 S14_convert_out26 S14_convert_out3 S14_convert_out4 S14_convert_out5 S14_convert_out6 S14_convert_out7 S14_convert_out8 S14_convert_out9 /end SUB_GROUP
 /begin REF_CHARACTERISTIC KHAL_CANBusOffDebounce_s KHAL_DefaultRegenMode_enum /end REF_CHARACTERISTIC
 /begin REF_MEASUREMENT VHAL_AcoreReadyToSlp_flg VHAL_AcoreRebootCmd_flg VHAL_AllowMovThd_OTA_enum VHAL_AnyNMID_flg VHAL_AutoWipHSpdEN_flg VHAL_AuxBattVolmV_mV VHAL_CAN1BusError_flg VHAL_CAN2BusError_flg VHAL_CAN3BusError_flg VHAL_CAN4BusError_flg VHAL_CAN5BusError_flg VHAL_CAN6BusError_flg VHAL_CarMode1_cnt VHAL_CarModel2_cnt VHAL_CarModel3_cnt VHAL_CbnPreACEnaReq_enum VHAL_Change1_cnt VHAL_Change2_cnt VHAL_Country1_cnt VHAL_Country2_cnt VHAL_CurrentNmState_enum VHAL_DIDFlashAPSFunConfig_raw8 VHAL_DIDFlashAutoLock_raw8 VHAL_DIDFlashDRLDis_raw8 VHAL_DIDFlashFMHTimer_raw8 VHAL_DIDFlashTireSize_raw8 VHAL_DIDFlashTurnLampFLThreCurr_raw8 VHAL_DIDFlashTurnLampFRThreCurr_raw8 VHAL_DIDFlashTurnLampRLThreCurr_raw8 VHAL_DIDFlashTurnLampRRThreCurr_raw8 VHAL_DIDFlashUSSConfig_raw8 VHAL_DIDVCUKeyReadSta_flg VHAL_Dash1_cnt VHAL_Dash2_cnt VHAL_DiagDRLOFF_flg VHAL_DiagFLTC_mA VHAL_DiagFMHT_s VHAL_DiagFRTC_mA VHAL_DiagRLTC_mA VHAL_DiagRRTC_mA VHAL_DidXWDData_enum VHAL_DidXWDSta_flg VHAL_DrivetrainSelect_enum VHAL_DrivingMode_cnt VHAL_EAPS1MINMem_pct VHAL_EAPS2MINMem_pct VHAL_ECU1_cnt VHAL_ECU2_cnt VHAL_ECUGen1_cnt VHAL_ECUGen2_cnt VHAL_EvccAplusPwrUpReq_flg VHAL_FDCConnDrvWdwCtrlCmd_pct VHAL_FDCConnPasWdwCtrlCmd_pct VHAL_FDCConnRLDWdwCtrlCmd_pct VHAL_FDCConnRRDWdwCtrlCmd_pct VHAL_FlashACCLevelSta12_enum VHAL_FlashACCLevelSta34_enum VHAL_FlashACCLevelSta57_enum VHAL_FlashACForceOFF_flg VHAL_FlashACModeSet123_enum VHAL_FlashAPMDoorControlSta_flg VHAL_FlashAVGBATTEMPL_sec VHAL_FlashAirIntZ3Sta_enum VHAL_FlashAmbBrightnessSta1_enum VHAL_FlashAmbBrightnessSta2_enum VHAL_FlashAmbBrightnessSta3_enum VHAL_FlashAmbBrightnessSta4_enum VHAL_FlashAmbBrightnessSta5_enum VHAL_FlashAmbBrightnessSta7_enum VHAL_FlashAmbColorSta1_enum VHAL_FlashAmbColorSta2_enum VHAL_FlashAmbColorSta3_enum VHAL_FlashAmbColorSta4_enum VHAL_FlashAmbColorSta5_enum VHAL_FlashAmbColorSta7_enum VHAL_FlashAmbDimEN_enum VHAL_FlashAmbFunEN_enum VHAL_FlashAmbLinkDriSta_enum VHAL_FlashAmbODAEN_enum VHAL_FlashAmbPwrWarnEN_enum VHAL_FlashAmbWelEN_enum VHAL_FlashAntitheft_enum VHAL_FlashAutoLock_enum VHAL_FlashAutoUnlock_enum VHAL_FlashAutoWipHSpdEN_flg VHAL_FlashBattTempPSAL_sec VHAL_FlashBattTempPSAR_sec VHAL_FlashCCUSyncSts_enum VHAL_FlashCLEVentYSta_enum VHAL_FlashCLEVentZSta_enum VHAL_FlashCLRDIST_km VHAL_FlashCLRTIME_min VHAL_FlashCLVentEN_enum VHAL_FlashCPSAL_sec VHAL_FlashCPSAR_sec VHAL_FlashCREVentYSta_enum VHAL_FlashCREVentZSta_enum VHAL_FlashCRVentEN_enum VHAL_FlashCTDLockSW_flg VHAL_FlashChkLFID_raw VHAL_FlashChkLRID_raw VHAL_FlashChkRFID_raw VHAL_FlashChkRRID_raw VHAL_FlashDIDModelVersionChkSum_raw VHAL_FlashDIDModelVersion_raw VHAL_FlashDrivetrain_enum VHAL_FlashETMATOEL_kWh VHAL_FlashETMATOER_kWh VHAL_FlashETMBTOEL_kWh VHAL_FlashETMBTOER_kWh VHAL_FlashFGSAirIntSta_enum VHAL_FlashFGSChSta_enum VHAL_FlashFGSIONSWSta_enum VHAL_FlashFaceM_enum VHAL_FlashFace_enum VHAL_FlashFollowMeENFun_enum VHAL_FlashFootM_enum VHAL_FlashFoot_enum VHAL_FlashFrost_enum VHAL_FlashFuelDoorPos_flg VHAL_FlashHMIKey1Func_enum VHAL_FlashHMIKey2Func_enum VHAL_FlashHMIKey3Func_enum VHAL_FlashHMIKey4Func_enum VHAL_FlashHMIKey5Func_enum VHAL_FlashHMIKey6Func_enum VHAL_FlashHMIKey7Func_enum VHAL_FlashHMIKey8Func_enum VHAL_FlashHoodSW_flg VHAL_FlashIDvalid_enum VHAL_FlashIGNCNTR_cnt VHAL_FlashIPSAL_sec VHAL_FlashIPSAR_sec VHAL_FlashLEVentModeSta_enum VHAL_FlashLEVentYSta_enum VHAL_FlashLEVentZSta_enum VHAL_FlashLFID_raw VHAL_FlashLRID_raw VHAL_FlashLVentEN_enum VHAL_FlashLockSetting_enum VHAL_FlashMFSWTri_flg VHAL_FlashMILDIST_km VHAL_FlashMILTIME_min VHAL_FlashMirrorFlodPos_flg VHAL_FlashNUMPSATRIPSFLTMEMCLR_cnt VHAL_FlashOFFL_sec VHAL_FlashOFFR_sec VHAL_FlashOVCL_sec VHAL_FlashOVCR_sec VHAL_FlashPKELNumerator_kphsqr VHAL_FlashPKERNumerator_kphsqr VHAL_FlashPSAL_sec VHAL_FlashPSAR_sec VHAL_FlashPTGOpenHeight12_enum VHAL_FlashPTGOpenHeight34_enum VHAL_FlashPTGOpenHeight57_enum VHAL_FlashPTGUserHeight1_cnt VHAL_FlashPTGUserHeight2_cnt VHAL_FlashPTGUserHeight3_cnt VHAL_FlashPTGUserHeight4_cnt VHAL_FlashPTGUserHeight5_cnt VHAL_FlashPTGUserHeight7_cnt VHAL_FlashQTYPSATRIPSL_cnt VHAL_FlashQTYPSATRIPSR_cnt VHAL_FlashRESSCNTDODRNGL_cnt VHAL_FlashRESSCNTDODRNGR_cnt VHAL_FlashRESSTIMESOCCHGRNGL_s VHAL_FlashRESSTIMESOCCHGRNGR_s VHAL_FlashRESSTIMESOCOFFRNGL_s VHAL_FlashRESSTIMESOCOFFRNGR_s VHAL_FlashRESSTIMESOCPSARNGL_s VHAL_FlashRESSTIMESOCPSARNGR_s VHAL_FlashREVentModeSta_enum VHAL_FlashREVentYSta_enum VHAL_FlashREVentZSta_enum VHAL_FlashRFID_raw VHAL_FlashRRID_raw VHAL_FlashRVentEN_enum VHAL_FlashRecAutoFlg_enum VHAL_FlashRegenMode_enum VHAL_FlashRoomLampMode_enum VHAL_FlashS1ID_raw VHAL_FlashS2ID_raw VHAL_FlashS3ID_raw VHAL_FlashS4ID_raw VHAL_FlashTPMModelVersionChkSum_raw VHAL_FlashTPMModelVersion_raw VHAL_FlashTailgateHDSW_flg VHAL_FlashTailgateSW_flg VHAL_FlashTurnSwTSet123_enum VHAL_FlashTurnSwTSet457_enum VHAL_FlashWARMUPS_cnt VHAL_FlashWalkInUnLkEN_enum VHAL_FlashWalkOutLkEN_enum VHAL_FlashWiperFixMode_flg VHAL_Flashchkdatavalid_enum VHAL_Flashdatavalid_enum VHAL_FlashfUnlockSingle_flg VHAL_Flashfdefog_enum VHAL_FlashsigRecircSt_enum VHAL_FlashsigSetTempZon1St_C VHAL_FlashsigSetTempZon2StM_C VHAL_LFP20_raw8 VHAL_LFPindi_enum VHAL_LFSensorFail_flg VHAL_LFWheelPSW_raw8 VHAL_LFWheelPress_raw8 VHAL_LFWheelTemp_C VHAL_LRP20_raw8 VHAL_LRPindi_enum VHAL_LRSensorFail_flg VHAL_LRWheelPSW_raw8 VHAL_LRWheelPress_raw8 VHAL_LRWheelTemp_C VHAL_Major1_cnt VHAL_Major2_cnt VHAL_Minor1_cnt VHAL_Minor2_cnt VHAL_ModelYear_cnt VHAL_NetworkReqCalled_flg VHAL_NvmProtectSta_flg VHAL_Patch1_cnt VHAL_Patch2_cnt VHAL_Pedal1Ref5V_V VHAL_Pedal2Ref5V_V VHAL_PmicBootPath_raw32 VHAL_PmicBootReason_enum VHAL_Prepresstempvalid_enum VHAL_PwrReq_OTA_enum VHAL_RFP20_raw8 VHAL_RFPindi_enum VHAL_RFSensorFail_flg VHAL_RFWheelPSW_raw8 VHAL_RFWheelPress_raw8 VHAL_RFWheelTemp_C VHAL_RRP20_raw8 VHAL_RRPindi_enum VHAL_RRSensorFail_flg VHAL_RRWheelPSW_raw8 VHAL_RRWheelPress_raw8 VHAL_RRWheelTemp_C VHAL_RandomnumberY_raw1 VHAL_RandomnumberY_raw2 VHAL_RandomnumberY_raw3 VHAL_RandomnumberY_raw4 VHAL_RandomnumberY_raw5 VHAL_RandomnumberY_raw6 VHAL_RandomnumberY_raw7 VHAL_RandomnumberY_raw8 VHAL_ReDoorLock_enum VHAL_ReOutsideMirror_enum VHAL_RePwrReqTbox_enum VHAL_ReRadio_flg VHAL_ReadRegenMode_enum VHAL_RemoteAutoReq_flg VHAL_ResetPedalZeroPosReq_enum VHAL_SHA1_cnt VHAL_SHA2_cnt VHAL_SHA3_cnt VHAL_SHA4_cnt VHAL_SHA5_cnt VHAL_SHA6_cnt VHAL_SHA7_cnt VHAL_SHA8_cnt VHAL_TBOXRemotePW_enum VHAL_Var4_cnt VHAL_Var5_cnt VHAL_Variation_cnt VHAL_WipRLSCmdCutEN_flg VHAL_WipRLSCmdCutTime_s VHAL_WipRLSCmdHoldEN_flg VHAL_WipRLSCmdHoldTime_s VHAL_WisrBootReason_raw32 VHAL_funAuto_flg VHAL_unlearnSfailvalid_enum VHAL_unlearnSfali_flg /end REF_MEASUREMENT
/end GROUP
/begin GROUP S5_Halin_TPMS "SWC_HALIN_CDD_type/run_SWC_HALIN_CDD_Rx_5ms_sys/Halin_CDD/Halin_TPMS" /begin SUB_GROUP S15_GetID S15_Subsystem /end SUB_GROUP
 /begin REF_MEASUREMENT VHAL_FlashLFSensorFail_flg VHAL_FlashLRSensorFail_flg VHAL_FlashRFSensorFail_flg VHAL_FlashRRSensorFail_flg VHAL_TPMSCRCCalc_crc VHAL_TPMSCRC_crc VHAL_TPMSPressureMi_raw VHAL_TPMSPressure_raw VHAL_TPMSSta_enum VHAL_TPMSTemp_raw /end REF_MEASUREMENT
/end GROUP
/begin GROUP S5_Subsystem7 "SWC_HALIN_CDD_type/run_SWC_HALIN_CDD_Rx_5ms_sys/Halin_CDD/Subsystem7"
 /begin REF_MEASUREMENT VINP_VinCodeByte0_enum VINP_VinCodeByte10_enum VINP_VinCodeByte11_enum VINP_VinCodeByte12_enum VINP_VinCodeByte13_enum VINP_VinCodeByte14_enum VINP_VinCodeByte15_enum VINP_VinCodeByte16_enum VINP_VinCodeByte1_enum VINP_VinCodeByte2_enum VINP_VinCodeByte3_enum VINP_VinCodeByte4_enum VINP_VinCodeByte5_enum VINP_VinCodeByte6_enum VINP_VinCodeByte7_enum VINP_VinCodeByte8_enum VINP_VinCodeByte9_enum /end REF_MEASUREMENT
/end GROUP
/begin GROUP S8_DKC2 "SWC_HALIN_CDD_type/run_SWC_HALIN_CDD_Rx_5ms_sys/Subsystem/DKC2" /begin SUB_GROUP S170_DKC_Decryption_and_Unpack S170_DKC_Signal_Convertor /end SUB_GROUP
 /begin REF_MEASUREMENT VHAL_BTConnectSta_enum VHAL_DKCBTRSSI_dB VHAL_DKCDecPCommandToBCM_enum VHAL_DKCDecPCommandToPTG_enum VHAL_DKCDecPDKeyAreaLockUnlock_enum VHAL_DKCDecPDKeyAreaPS_enum VHAL_DKCDecPDKeyAreaPTG_enum VHAL_DKCDecPDKeyWelcome_enum VHAL_DKCDecPDkeyShowIVI_enum VHAL_DKCDecPKeyMiss_flg VHAL_DKCDecPKeyMode_enum VHAL_DKCDecPUIDLowPower_flg VHAL_DKCDecReVehData_enum VHAL_DKCDecRemotePW_enum VHAL_DKCDecryptionFail_flg VHAL_NFCDoorSta_flg VHAL_NFCLidASta_flg VHAL_TimeSNDKCFbk_cnt VHAL_UIDBatVoltx1000_V VHAL_UIDButtonCmd_enum VHAL_UWB1Distance_cm VHAL_UWB1Power_dB VHAL_UWB1RangingSta_enum VHAL_UWB2Distance_cm VHAL_UWB2Power_dB VHAL_UWB2RangingSta_enum VHAL_UWB3Distance_cm VHAL_UWB3Power_dB VHAL_UWB3RangingSta_enum VHAL_UWB4Distance_cm VHAL_UWB4Power_dB VHAL_UWB4RangingSta_enum VHAL_UWB5Distance_cm VHAL_UWB5Power_dB VHAL_UWB5RangingSta_enum VHAL_UWBRangingON_flg VHAL_UWBpositionX_cm VHAL_UWBpositionY_cm /end REF_MEASUREMENT
/end GROUP
/begin GROUP S14_FlashAirIntenZone1M_Verify "SWC_HALIN_CDD_type/run_SWC_HALIN_CDD_Rx_5ms_sys/Halin_CDD/Halin_SYS/FlashAirIntenZone1M_Verify" /begin REF_MEASUREMENT VHAL_FlashAirIntenZone1M_enum /end REF_MEASUREMENT /end GROUP
/begin GROUP S14_FlashCountAlarm_Verify "SWC_HALIN_CDD_type/run_SWC_HALIN_CDD_Rx_5ms_sys/Halin_CDD/Halin_SYS/FlashCountAlarm_Verify" /begin REF_MEASUREMENT VHAL_FlashCountAlarm_enum /end REF_MEASUREMENT /end GROUP
/begin GROUP S14_FlashIVIPTGUSStaSW_Verify "SWC_HALIN_CDD_type/run_SWC_HALIN_CDD_Rx_5ms_sys/Halin_CDD/Halin_SYS/FlashIVIPTGUSStaSW_Verify" /begin REF_MEASUREMENT VHAL_FlashIVIPTGUSStaSW_enum /end REF_MEASUREMENT /end GROUP
/begin GROUP S14_FlashMFRDNBrightReq_Verify "SWC_HALIN_CDD_type/run_SWC_HALIN_CDD_Rx_5ms_sys/Halin_CDD/Halin_SYS/FlashMFRDNBrightReq_Verify" /begin REF_MEASUREMENT VHAL_FlashMFRDNBrightReq_pct /end REF_MEASUREMENT /end GROUP
/begin GROUP S14_LatchedFlg "SWC_HALIN_CDD_type/run_SWC_HALIN_CDD_Rx_5ms_sys/Halin_CDD/Halin_SYS/LatchedFlg" /begin SUB_GROUP S35_SR_Latch /end SUB_GROUP /end GROUP
/begin GROUP S14_LatchedFlg1 "SWC_HALIN_CDD_type/run_SWC_HALIN_CDD_Rx_5ms_sys/Halin_CDD/Halin_SYS/LatchedFlg1" /begin SUB_GROUP S36_SR_Latch /end SUB_GROUP /end GROUP
/begin GROUP S14_LatchedFlg2 "SWC_HALIN_CDD_type/run_SWC_HALIN_CDD_Rx_5ms_sys/Halin_CDD/Halin_SYS/LatchedFlg2" /begin SUB_GROUP S37_SR_Latch /end SUB_GROUP /end GROUP
/begin GROUP S14_LatchedFlg3 "SWC_HALIN_CDD_type/run_SWC_HALIN_CDD_Rx_5ms_sys/Halin_CDD/Halin_SYS/LatchedFlg3" /begin SUB_GROUP S38_SR_Latch /end SUB_GROUP /end GROUP
/begin GROUP S14_LatchedFlg4 "SWC_HALIN_CDD_type/run_SWC_HALIN_CDD_Rx_5ms_sys/Halin_CDD/Halin_SYS/LatchedFlg4" /begin SUB_GROUP S39_SR_Latch /end SUB_GROUP /end GROUP
/begin GROUP S14_LatchedFlg5 "SWC_HALIN_CDD_type/run_SWC_HALIN_CDD_Rx_5ms_sys/Halin_CDD/Halin_SYS/LatchedFlg5" /begin SUB_GROUP S40_SR_Latch /end SUB_GROUP /end GROUP
/begin GROUP S14_RemoteControlSignal "SWC_HALIN_CDD_type/run_SWC_HALIN_CDD_Rx_5ms_sys/Halin_CDD/Halin_SYS/RemoteControlSignal" /begin SUB_GROUP S41_PowerOffTSet S41_RemoteACTemp /end SUB_GROUP /end GROUP
/begin GROUP S14_convert_out "SWC_HALIN_CDD_type/run_SWC_HALIN_CDD_Rx_5ms_sys/Halin_CDD/Halin_SYS/convert_out" /begin REF_MEASUREMENT VHAL_FlashODOMETER_km /end REF_MEASUREMENT /end GROUP
/begin GROUP S14_convert_out1 "SWC_HALIN_CDD_type/run_SWC_HALIN_CDD_Rx_5ms_sys/Halin_CDD/Halin_SYS/convert_out1" /begin REF_MEASUREMENT VHAL_FlashHVBNAH_Ahr /end REF_MEASUREMENT /end GROUP
/begin GROUP S14_convert_out10 "SWC_HALIN_CDD_type/run_SWC_HALIN_CDD_Rx_5ms_sys/Halin_CDD/Halin_SYS/convert_out10" /begin REF_MEASUREMENT VHAL_FlashTGEOVCR_kWh /end REF_MEASUREMENT /end GROUP
/begin GROUP S14_convert_out11 "SWC_HALIN_CDD_type/run_SWC_HALIN_CDD_Rx_5ms_sys/Halin_CDD/Halin_SYS/convert_out11" /begin REF_MEASUREMENT VHAL_FlashRESSV2XENNONPSAL_kWh /end REF_MEASUREMENT /end GROUP
/begin GROUP S14_convert_out12 "SWC_HALIN_CDD_type/run_SWC_HALIN_CDD_Rx_5ms_sys/Halin_CDD/Halin_SYS/convert_out12" /begin REF_MEASUREMENT VHAL_FlashGECHGOVCDCR_kWh /end REF_MEASUREMENT /end GROUP
/begin GROUP S14_convert_out13 "SWC_HALIN_CDD_type/run_SWC_HALIN_CDD_Rx_5ms_sys/Halin_CDD/Halin_SYS/convert_out13" /begin REF_MEASUREMENT VHAL_FlashGECHGOVCDCL_kWh /end REF_MEASUREMENT /end GROUP
/begin GROUP S14_convert_out14 "SWC_HALIN_CDD_type/run_SWC_HALIN_CDD_Rx_5ms_sys/Halin_CDD/Halin_SYS/convert_out14" /begin REF_MEASUREMENT VHAL_FlashGECHGOVCACR_kWh /end REF_MEASUREMENT /end GROUP
/begin GROUP S14_convert_out15 "SWC_HALIN_CDD_type/run_SWC_HALIN_CDD_Rx_5ms_sys/Halin_CDD/Halin_SYS/convert_out15" /begin REF_MEASUREMENT VHAL_FlashGECHGOVCACL_kWh /end REF_MEASUREMENT /end GROUP
/begin GROUP S14_convert_out16 "SWC_HALIN_CDD_type/run_SWC_HALIN_CDD_Rx_5ms_sys/Halin_CDD/Halin_SYS/convert_out16" /begin REF_MEASUREMENT VHAL_FlashRESSV2XENNONPSAR_kWh /end REF_MEASUREMENT /end GROUP
/begin GROUP S14_convert_out17 "SWC_HALIN_CDD_type/run_SWC_HALIN_CDD_Rx_5ms_sys/Halin_CDD/Halin_SYS/convert_out17" /begin REF_MEASUREMENT VHAL_FlashResetCDEODTR_km /end REF_MEASUREMENT /end GROUP
/begin GROUP S14_convert_out18 "SWC_HALIN_CDD_type/run_SWC_HALIN_CDD_Rx_5ms_sys/Halin_CDD/Halin_SYS/convert_out18" /begin REF_MEASUREMENT VHAL_FlashAvgBattTempPSAR_C /end REF_MEASUREMENT /end GROUP
/begin GROUP S14_convert_out19 "SWC_HALIN_CDD_type/run_SWC_HALIN_CDD_Rx_5ms_sys/Halin_CDD/Halin_SYS/convert_out19" /begin REF_MEASUREMENT VHAL_FlashAvgBattTempPSAL_C /end REF_MEASUREMENT /end GROUP
/begin GROUP S14_convert_out2 "SWC_HALIN_CDD_type/run_SWC_HALIN_CDD_Rx_5ms_sys/Halin_CDD/Halin_SYS/convert_out2" /begin REF_MEASUREMENT VHAL_FlashHVBNE_kWh /end REF_MEASUREMENT /end GROUP
/begin GROUP S14_convert_out20 "SWC_HALIN_CDD_type/run_SWC_HALIN_CDD_Rx_5ms_sys/Halin_CDD/Halin_SYS/convert_out20" /begin REF_MEASUREMENT VHAL_FlashAvgBattTempOVCR_C /end REF_MEASUREMENT /end GROUP
/begin GROUP S14_convert_out21 "SWC_HALIN_CDD_type/run_SWC_HALIN_CDD_Rx_5ms_sys/Halin_CDD/Halin_SYS/convert_out21" /begin REF_MEASUREMENT VHAL_FlashAvgBattTempOVCL_C /end REF_MEASUREMENT /end GROUP
/begin GROUP S14_convert_out22 "SWC_HALIN_CDD_type/run_SWC_HALIN_CDD_Rx_5ms_sys/Halin_CDD/Halin_SYS/convert_out22" /begin REF_MEASUREMENT VHAL_FlashAvgBattTempOFFR_C /end REF_MEASUREMENT /end GROUP
/begin GROUP S14_convert_out23 "SWC_HALIN_CDD_type/run_SWC_HALIN_CDD_Rx_5ms_sys/Halin_CDD/Halin_SYS/convert_out23" /begin REF_MEASUREMENT VHAL_FlashAvgBattTempOFFL_C /end REF_MEASUREMENT /end GROUP
/begin GROUP S14_convert_out24 "SWC_HALIN_CDD_type/run_SWC_HALIN_CDD_Rx_5ms_sys/Halin_CDD/Halin_SYS/convert_out24" /begin REF_MEASUREMENT VHAL_FlashMAXBATTEMPL_C /end REF_MEASUREMENT /end GROUP
/begin GROUP S14_convert_out25 "SWC_HALIN_CDD_type/run_SWC_HALIN_CDD_Rx_5ms_sys/Halin_CDD/Halin_SYS/convert_out25" /begin REF_MEASUREMENT VHAL_FlashMINBATTEMPL_C /end REF_MEASUREMENT /end GROUP
/begin GROUP S14_convert_out26 "SWC_HALIN_CDD_type/run_SWC_HALIN_CDD_Rx_5ms_sys/Halin_CDD/Halin_SYS/convert_out26" /begin REF_MEASUREMENT VHAL_FlashAVGBATTEMPL_C /end REF_MEASUREMENT /end GROUP
/begin GROUP S14_convert_out3 "SWC_HALIN_CDD_type/run_SWC_HALIN_CDD_Rx_5ms_sys/Halin_CDD/Halin_SYS/convert_out3" /begin REF_MEASUREMENT VHAL_FlashTNBCPSAR_Ahr /end REF_MEASUREMENT /end GROUP
/begin GROUP S14_convert_out4 "SWC_HALIN_CDD_type/run_SWC_HALIN_CDD_Rx_5ms_sys/Halin_CDD/Halin_SYS/convert_out4" /begin REF_MEASUREMENT VHAL_FlashTNBCPSAL_Ahr /end REF_MEASUREMENT /end GROUP
/begin GROUP S14_convert_out5 "SWC_HALIN_CDD_type/run_SWC_HALIN_CDD_Rx_5ms_sys/Halin_CDD/Halin_SYS/convert_out5" /begin REF_MEASUREMENT VHAL_FlashTGEOVCL_kWh /end REF_MEASUREMENT /end GROUP
/begin GROUP S14_convert_out6 "SWC_HALIN_CDD_type/run_SWC_HALIN_CDD_Rx_5ms_sys/Halin_CDD/Halin_SYS/convert_out6" /begin REF_MEASUREMENT VHAL_FlashTNECPSAR_kWh /end REF_MEASUREMENT /end GROUP
/begin GROUP S14_convert_out7 "SWC_HALIN_CDD_type/run_SWC_HALIN_CDD_Rx_5ms_sys/Halin_CDD/Halin_SYS/convert_out7" /begin REF_MEASUREMENT VHAL_FlashTNECPSAL_kWh /end REF_MEASUREMENT /end GROUP
/begin GROUP S14_convert_out8 "SWC_HALIN_CDD_type/run_SWC_HALIN_CDD_Rx_5ms_sys/Halin_CDD/Halin_SYS/convert_out8" /begin REF_MEASUREMENT VHAL_FlashTEBPSAR_kWh /end REF_MEASUREMENT /end GROUP
/begin GROUP S14_convert_out9 "SWC_HALIN_CDD_type/run_SWC_HALIN_CDD_Rx_5ms_sys/Halin_CDD/Halin_SYS/convert_out9" /begin REF_MEASUREMENT VHAL_FlashTEBPSAL_kWh /end REF_MEASUREMENT /end GROUP
/begin GROUP S15_GetID "SWC_HALIN_CDD_type/run_SWC_HALIN_CDD_Rx_5ms_sys/Halin_CDD/Halin_TPMS/GetID" /begin REF_CHARACTERISTIC KHAL_TPMSRESBUTT_flg_ovrdflg KHAL_TPMSRESBUTT_flg_ovrdval /end REF_CHARACTERISTIC
 /begin REF_MEASUREMENT VHAL_ChkLFID_raw VHAL_ChkLRID_raw VHAL_ChkRFID_raw VHAL_ChkRRID_raw VHAL_ChkStorge_flg VHAL_FlashLFP20_raw8 VHAL_FlashLFPindi_enum VHAL_FlashLFWheelPSW_raw8 VHAL_FlashLFWheelPress_raw8 VHAL_FlashLFWheelTemp_C VHAL_FlashLRP20_raw8 VHAL_FlashLRPindi_enum VHAL_FlashLRWheelPSW_raw8 VHAL_FlashLRWheelPress_raw8 VHAL_FlashLRWheelTemp_C VHAL_FlashRFP20_raw8 VHAL_FlashRFPindi_enum VHAL_FlashRFWheelPSW_raw8 VHAL_FlashRFWheelPress_raw8 VHAL_FlashRFWheelTemp_C VHAL_FlashRRP20_raw8 VHAL_FlashRRPindi_enum VHAL_FlashRRWheelPSW_raw8 VHAL_FlashRRWheelPress_raw8 VHAL_FlashRRWheelTemp_C VHAL_FlashunlearnSfali_flg VHAL_LFID_raw VHAL_LRID_raw VHAL_Prepresstemptrust_flg VHAL_RFID_raw VHAL_RRID_raw VHAL_S1ID_raw VHAL_S2ID_raw VHAL_S3ID_raw VHAL_S4ID_raw VHAL_TPMSSensorIDRegSta_enum VHAL_TPMSStorge_flg /end REF_MEASUREMENT
/end GROUP
/begin GROUP S15_Subsystem "SWC_HALIN_CDD_type/run_SWC_HALIN_CDD_Rx_5ms_sys/Halin_CDD/Halin_TPMS/Subsystem"
 /begin REF_MEASUREMENT VHAL_TPMSBattLow_flg VHAL_TPMSDataIn_flg VHAL_TPMSFAT_flg VHAL_TPMSID_raw VHAL_TPMSTrigger_flg /end REF_MEASUREMENT
/end GROUP
/begin GROUP S170_DKC_Decryption_and_Unpack "SWC_HALIN_CDD_type/run_SWC_HALIN_CDD_Rx_5ms_sys/Subsystem/DKC2/DKC Decryption and Unpack"
 /begin REF_MEASUREMENT VHAL_DKCResultData_raw1 VHAL_DKCResultData_raw10 VHAL_DKCResultData_raw11 VHAL_DKCResultData_raw12 VHAL_DKCResultData_raw13 VHAL_DKCResultData_raw14 VHAL_DKCResultData_raw15 VHAL_DKCResultData_raw16 VHAL_DKCResultData_raw2 VHAL_DKCResultData_raw3 VHAL_DKCResultData_raw4 VHAL_DKCResultData_raw5 VHAL_DKCResultData_raw6 VHAL_DKCResultData_raw7 VHAL_DKCResultData_raw8 VHAL_DKCResultData_raw9 /end REF_MEASUREMENT
/end GROUP
/begin GROUP S170_DKC_Signal_Convertor "SWC_HALIN_CDD_type/run_SWC_HALIN_CDD_Rx_5ms_sys/Subsystem/DKC2/DKC Signal Convertor" /begin REF_MEASUREMENT VHAL_KeyFobAreaU16_enum /end REF_MEASUREMENT /end GROUP
/begin GROUP S35_SR_Latch "SWC_HALIN_CDD_type/run_SWC_HALIN_CDD_Rx_5ms_sys/Halin_CDD/Halin_SYS/LatchedFlg/SR_Latch" /begin REF_MEASUREMENT VHAL_CAN1BusOff_flg /end REF_MEASUREMENT /end GROUP
/begin GROUP S36_SR_Latch "SWC_HALIN_CDD_type/run_SWC_HALIN_CDD_Rx_5ms_sys/Halin_CDD/Halin_SYS/LatchedFlg1/SR_Latch" /begin REF_MEASUREMENT VHAL_CAN2BusOff_flg /end REF_MEASUREMENT /end GROUP
/begin GROUP S37_SR_Latch "SWC_HALIN_CDD_type/run_SWC_HALIN_CDD_Rx_5ms_sys/Halin_CDD/Halin_SYS/LatchedFlg2/SR_Latch" /begin REF_MEASUREMENT VHAL_CAN3BusOff_flg /end REF_MEASUREMENT /end GROUP
/begin GROUP S38_SR_Latch "SWC_HALIN_CDD_type/run_SWC_HALIN_CDD_Rx_5ms_sys/Halin_CDD/Halin_SYS/LatchedFlg3/SR_Latch" /begin REF_MEASUREMENT VHAL_CAN4BusOff_flg /end REF_MEASUREMENT /end GROUP
/begin GROUP S39_SR_Latch "SWC_HALIN_CDD_type/run_SWC_HALIN_CDD_Rx_5ms_sys/Halin_CDD/Halin_SYS/LatchedFlg4/SR_Latch" /begin REF_MEASUREMENT VHAL_CAN5BusOff_flg /end REF_MEASUREMENT /end GROUP
/begin GROUP S40_SR_Latch "SWC_HALIN_CDD_type/run_SWC_HALIN_CDD_Rx_5ms_sys/Halin_CDD/Halin_SYS/LatchedFlg5/SR_Latch" /begin REF_MEASUREMENT VHAL_CAN6BusOff_flg /end REF_MEASUREMENT /end GROUP
/begin GROUP S41_PowerOffTSet "SWC_HALIN_CDD_type/run_SWC_HALIN_CDD_Rx_5ms_sys/Halin_CDD/Halin_SYS/RemoteControlSignal/PowerOffTSet" /begin SUB_GROUP S146_convert_in /end SUB_GROUP /end GROUP
/begin GROUP S41_RemoteACTemp "SWC_HALIN_CDD_type/run_SWC_HALIN_CDD_Rx_5ms_sys/Halin_CDD/Halin_SYS/RemoteControlSignal/RemoteACTemp" /begin SUB_GROUP S153_convert_in /end SUB_GROUP /end GROUP
/begin GROUP S146_convert_in "SWC_HALIN_CDD_type/run_SWC_HALIN_CDD_Rx_5ms_sys/Halin_CDD/Halin_SYS/RemoteControlSignal/PowerOffTSet/convert_in" /begin REF_MEASUREMENT VHAL_PowerOffTSet_cnt /end REF_MEASUREMENT /end GROUP
/begin GROUP S153_convert_in "SWC_HALIN_CDD_type/run_SWC_HALIN_CDD_Rx_5ms_sys/Halin_CDD/Halin_SYS/RemoteControlSignal/RemoteACTemp/convert_in" /begin REF_MEASUREMENT VHAL_RemoteACTemp_C /end REF_MEASUREMENT /end GROUP
/end MODULE
/end PROJECT
/* (add any file trailer comments here) */
/* EOF SWC_HALIN_CDD_type.a2l */
