AUTOSAR XML (schema 4-3-0)
package /CANInterface_ARPkg
  83 x sender receiver interface:
    IF_CAN1_SG_AC_BTMS_C1000_0
      data CAN1_SG_AC_BTMS_C1000_0: type=DT_CAN1_SG_AC_BTMS_C1000_0
    IF_CAN1_SG_AC_BTMS_C1000_1
      data CAN1_SG_AC_BTMS_C1000_1: type=DT_CAN1_SG_AC_BTMS_C1000_1
    IF_CAN1_SG_AC_BTMS_C1000_2
      data CAN1_SG_AC_BTMS_C1000_2: type=DT_CAN1_SG_AC_BTMS_C1000_2
    IF_CAN1_SG_AC_BTMS_C1000_4
      data CAN1_SG_AC_BTMS_C1000_4: type=DT_CAN1_SG_AC_BTMS_C1000_4
    IF_CAN1_SG_AC_BTMS_C5000_0
      data CAN1_SG_AC_BTMS_C5000_0: type=DT_CAN1_SG_AC_BTMS_C5000_0
    IF_CAN1_SG_ASC1_A
      data CAN1_SG_ASC1_A: type=DT_CAN1_SG_ASC1_A
    IF_CAN1_SG_EBC1
      data CAN1_SG_EBC1: type=DT_CAN1_SG_EBC1
    IF_CAN1_SG_EBC2
      data CAN1_SG_EBC2: type=DT_CAN1_SG_EBC2
    IF_CAN1_SG_EBC5
      data CAN1_SG_EBC5: type=DT_CAN1_SG_EBC5
    IF_CAN1_SG_ECAS_DM1
      data CAN1_SG_ECAS_DM1: type=DT_CAN1_SG_ECAS_DM1
    IF_CAN1_SG_EMC1_EM1
      data CAN1_SG_EMC1_EM1: type=DT_CAN1_SG_EMC1_EM1
    IF_CAN1_SG_FD1_C1000_0
      data CAN1_SG_FD1_C1000_0: type=DT_CAN1_SG_FD1_C1000_0
    IF_CAN1_SG_FD1_C100_0
      data CAN1_SG_FD1_C100_0: type=DT_CAN1_SG_FD1_C100_0
    IF_CAN1_SG_FD1_C100_1
      data CAN1_SG_FD1_C100_1: type=DT_CAN1_SG_FD1_C100_1
    IF_CAN1_SG_FD1_C100_2
      data CAN1_SG_FD1_C100_2: type=DT_CAN1_SG_FD1_C100_2
    IF_CAN1_SG_FD1_C100_3
      data CAN1_SG_FD1_C100_3: type=DT_CAN1_SG_FD1_C100_3
    IF_CAN1_SG_CGW_FD1_C100_3
      data CAN1_SG_CGW_FD1_C100_3: type=DT_CAN1_SG_CGW_FD1_C100_3
    IF_CAN1_SG_FD1_C10_0
      data CAN1_SG_FD1_C10_0: type=DT_CAN1_SG_FD1_C10_0
    IF_CAN1_SG_FD1_C10_1
      data CAN1_SG_FD1_C10_1: type=DT_CAN1_SG_FD1_C10_1
    IF_CAN1_SG_FD1_C200_0
      data CAN1_SG_FD1_C200_0: type=DT_CAN1_SG_FD1_C200_0
    IF_CAN1_SG_FD1_C20_0
      data CAN1_SG_FD1_C20_0: type=DT_CAN1_SG_FD1_C20_0
    IF_CAN1_SG_FD1_C250_0
      data CAN1_SG_FD1_C250_0: type=DT_CAN1_SG_FD1_C250_0
    IF_CAN1_SG_FD1_C5000_0
      data CAN1_SG_FD1_C5000_0: type=DT_CAN1_SG_FD1_C5000_0
    IF_CAN1_SG_FD1_C5000_1
      data CAN1_SG_FD1_C5000_1: type=DT_CAN1_SG_FD1_C5000_1
    IF_CAN1_SG_FD1_C50_0
      data CAN1_SG_FD1_C50_0: type=DT_CAN1_SG_FD1_C50_0
    IF_CAN1_SG_FD1_C50_1
      data CAN1_SG_FD1_C50_1: type=DT_CAN1_SG_FD1_C50_1
    IF_CAN1_SG_FD1_C80_0
      data CAN1_SG_FD1_C80_0: type=DT_CAN1_SG_FD1_C80_0
    IF_CAN1_SG_FD1_CE100_0
      data CAN1_SG_FD1_CE100_0: type=DT_CAN1_SG_FD1_CE100_0
    IF_CAN1_SG_FD1_CE100_1
      data CAN1_SG_FD1_CE100_1: type=DT_CAN1_SG_FD1_CE100_1
    IF_CAN1_SG_FD1_CE100_2
      data CAN1_SG_FD1_CE100_2: type=DT_CAN1_SG_FD1_CE100_2
    IF_CAN1_SG_HRW
      data CAN1_SG_HRW: type=DT_CAN1_SG_HRW
    IF_CAN1_SG_TC1
      data CAN1_SG_TC1: type=DT_CAN1_SG_TC1
    IF_CAN1_SG_TPMS1
      data CAN1_SG_TPMS1: type=DT_CAN1_SG_TPMS1
    IF_CAN1_SG_TPMS2
      data CAN1_SG_TPMS2: type=DT_CAN1_SG_TPMS2
    IF_CAN1_SG_TPMS3
      data CAN1_SG_TPMS3: type=DT_CAN1_SG_TPMS3
    IF_CAN1_SG_VDC1
      data CAN1_SG_VDC1: type=DT_CAN1_SG_VDC1
    IF_CAN2_SG_FD2_C1000_0
      data CAN2_SG_FD2_C1000_0: type=DT_CAN2_SG_FD2_C1000_0
    IF_CAN2_SG_CGW_FD2_C1000_0
      data CAN2_SG_CGW_FD2_C1000_0: type=DT_CAN2_SG_CGW_FD2_C1000_0
    IF_CAN2_SG_FD2_C10_0
      data CAN2_SG_FD2_C10_0: type=DT_CAN2_SG_FD2_C10_0
    IF_CAN2_SG_FD2_C200_0
      data CAN2_SG_FD2_C200_0: type=DT_CAN2_SG_FD2_C200_0
    IF_CAN2_SG_FD2_C500_0
      data CAN2_SG_FD2_C500_0: type=DT_CAN2_SG_FD2_C500_0
    IF_CAN2_SG_FD2_C50_0
      data CAN2_SG_FD2_C50_0: type=DT_CAN2_SG_FD2_C50_0
    IF_CAN2_SG_FD2_CE100_0
      data CAN2_SG_FD2_CE100_0: type=DT_CAN2_SG_FD2_CE100_0
    IF_CAN2_SG_GW2_C100_0
      data CAN2_SG_GW2_C100_0: type=DT_CAN2_SG_GW2_C100_0
    IF_CAN2_SG_CGW_GW2_C100_0
      data CAN2_SG_CGW_GW2_C100_0: type=DT_CAN2_SG_CGW_GW2_C100_0
    IF_CAN2_SG_IVI_C100_0
      data CAN2_SG_IVI_C100_0: type=DT_CAN2_SG_IVI_C100_0
    IF_CAN3_SG_B2TM_Info
      data CAN3_SG_B2TM_Info: type=DT_CAN3_SG_B2TM_Info
    IF_CAN3_SG_B2V_BattInfo1
      data CAN3_SG_B2V_BattInfo1: type=DT_CAN3_SG_B2V_BattInfo1
    IF_CAN3_SG_B2V_CurrentLimit
      data CAN3_SG_B2V_CurrentLimit: type=DT_CAN3_SG_B2V_CurrentLimit
    IF_CAN3_SG_B2V_Fult1_32960
      data CAN3_SG_B2V_Fult1_32960: type=DT_CAN3_SG_B2V_Fult1_32960
    IF_CAN3_SG_B2V_ST1
      data CAN3_SG_B2V_ST1: type=DT_CAN3_SG_B2V_ST1
    IF_CAN3_SG_B2V_ST2
      data CAN3_SG_B2V_ST2: type=DT_CAN3_SG_B2V_ST2
    IF_CAN3_SG_B2V_ST4
      data CAN3_SG_B2V_ST4: type=DT_CAN3_SG_B2V_ST4
    IF_CAN3_SG_B2V_ST5
      data CAN3_SG_B2V_ST5: type=DT_CAN3_SG_B2V_ST5
    IF_CAN3_SG_EWP1
      data CAN3_SG_EWP1: type=DT_CAN3_SG_EWP1
    IF_CAN3_SG_FD3_C100_0
      data CAN3_SG_FD3_C100_0: type=DT_CAN3_SG_FD3_C100_0
    IF_CAN3_SG_FD3_C10_0
      data CAN3_SG_FD3_C10_0: type=DT_CAN3_SG_FD3_C10_0
    IF_CAN3_SG_FD3_C10_1
      data CAN3_SG_FD3_C10_1: type=DT_CAN3_SG_FD3_C10_1
    IF_CAN3_SG_FD3_C200_0
      data CAN3_SG_FD3_C200_0: type=DT_CAN3_SG_FD3_C200_0
    IF_CAN3_SG_FD3_C200_1
      data CAN3_SG_FD3_C200_1: type=DT_CAN3_SG_FD3_C200_1
    IF_CAN3_SG_TM_MCUSta1
      data CAN3_SG_TM_MCUSta1: type=DT_CAN3_SG_TM_MCUSta1
    IF_CAN3_SG_TM_MCUSta2
      data CAN3_SG_TM_MCUSta2: type=DT_CAN3_SG_TM_MCUSta2
    IF_CAN3_SG_TM_MCUSta3
      data CAN3_SG_TM_MCUSta3: type=DT_CAN3_SG_TM_MCUSta3
    IF_CAN4_SG_FD4_C100_0
      data CAN4_SG_FD4_C100_0: type=DT_CAN4_SG_FD4_C100_0
    IF_CAN4_SG_FD4_C10_0
      data CAN4_SG_FD4_C10_0: type=DT_CAN4_SG_FD4_C10_0
    IF_CAN4_SG_FD4_C200_0
      data CAN4_SG_FD4_C200_0: type=DT_CAN4_SG_FD4_C200_0
    IF_CAN4_SG_FD4_CE100_0
      data CAN4_SG_FD4_CE100_0: type=DT_CAN4_SG_FD4_CE100_0
    IF_CAN4_SG_FD4_CE100_1
      data CAN4_SG_FD4_CE100_1: type=DT_CAN4_SG_FD4_CE100_1
    IF_CAN4_SG_ZFR_C100_0
      data CAN4_SG_ZFR_C100_0: type=DT_CAN4_SG_ZFR_C100_0
    IF_CAN4_SG_ZFR_C5000_0
      data CAN4_SG_ZFR_C5000_0: type=DT_CAN4_SG_ZFR_C5000_0
    IF_CAN4_SG_ZFR_CE100_0
      data CAN4_SG_ZFR_CE100_0: type=DT_CAN4_SG_ZFR_CE100_0
    IF_CAN4_SG_ZRR_C5000_0
      data CAN4_SG_ZRR_C5000_0: type=DT_CAN4_SG_ZRR_C5000_0
    IF_CAN4_SG_ZRR_CE100_0
      data CAN4_SG_ZRR_CE100_0: type=DT_CAN4_SG_ZRR_CE100_0
    IF_CAN4_SG_ZRR_CE100_1
      data CAN4_SG_ZRR_CE100_1: type=DT_CAN4_SG_ZRR_CE100_1
    IF_CAN4_SG_zGW_CANRr1_C50_0
      data CAN4_SG_zGW_CANRr1_C50_0: type=DT_CAN4_SG_zGW_CANRr1_C50_0
    IF_CAN5_SG_FD5_C100_0
      data CAN5_SG_FD5_C100_0: type=DT_CAN5_SG_FD5_C100_0
    IF_CAN5_SG_FD5_C200_0
      data CAN5_SG_FD5_C200_0: type=DT_CAN5_SG_FD5_C200_0
    IF_CAN6_SG_FD6_C200_0
      data CAN6_SG_FD6_C200_0: type=DT_CAN6_SG_FD6_C200_0
    IF_CAN7_SG_FD7_C100_0
      data CAN7_SG_FD7_C100_0: type=DT_CAN7_SG_FD7_C100_0
    IF_CAN7_SG_FD7_C10_0
      data CAN7_SG_FD7_C10_0: type=DT_CAN7_SG_FD7_C10_0
    IF_CAN7_SG_FD7_C200_0
      data CAN7_SG_FD7_C200_0: type=DT_CAN7_SG_FD7_C200_0
    IF_CAN7_SG_FD7_C50_0
      data CAN7_SG_FD7_C50_0: type=DT_CAN7_SG_FD7_C50_0
    IF_CAN7_SG_FD7_CE100_0
      data CAN7_SG_FD7_CE100_0: type=DT_CAN7_SG_FD7_CE100_0
