AUTOSAR XML (schema 4-3-0)
package /ECU
  ecu instance TargetECU: associated-com-i-pdu-group=FUSION_Can3_Tx, com-configuration-gw-time-base=0.005, com-configuration-rx-time-base=0.005, com-configuration-tx-time-base=0.005
    can communication controller ChannelName
    lin master LINChannelName: time-base=0.01, time-base-jitter=0.0
      lin-slave-config configured-nad=2, function-id=0, supplier-id=0, variant-id=0:
        ident SlaveNodeName
    can communication connector CANCommunicationConnector: comm-controller=Can3
    lin communication connector LINCommunicationConnector: comm-controller=LINDr1
