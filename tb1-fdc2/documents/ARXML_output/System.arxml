[part 1 of 2: package /SysEnv_ARPkg]
AUTOSAR XML (schema 4-3-0)
package /SysEnv_ARPkg
  system System_FDC: category=SYSTEM_DESCRIPTION, ecu-extract-version=1.0.0, system-version=1.0.0
    119 x system mapping:
      SystemMapping
        sw-impl-mappings:
          12 x swc to impl mapping:
            BswMTest_ImplMapping: component-implementation=Impl_BswMTest_type, component=root_FDC.BswMTest
            SWC_APS_ImplMapping: component-implementation=Impl_SWC_APS_type, component=root_FDC.SWC_APS
            SWC_CDD_ImplMapping: component-implementation=Impl_SWC_CDD_type, component=root_FDC.SWC_CDD
            SWC_DID_ImplMapping: component-implementation=Impl_SWC_DID_type, component=root_FDC.SWC_DID
            SWC_FDC_ImplMapping: component-implementation=Impl_SWC_FDC_type, component=root_FDC.SWC_FDC
            SWC_IMU_ImplMapping: component-implementation=Impl_SWC_IMU_type, component=root_FDC.SWC_IMU
            SWC_NVM_ImplMapping: component-implementation=Impl_SWC_NVM_type, component=root_FDC.SWC_NVM
            SWC_UDS_ImplMapping: component-implementation=Impl_SWC_UDS_type, component=root_FDC.SWC_UDS
            SWC_VES_ImplMapping: component-implementation=Impl_SWC_VES_type, component=root_FDC.SWC_VES
            SWC_UART_ImplMapping: component-implementation=Impl_SWC_UART_type, component=root_FDC.SWC_UART
            SWC_IOEXP_ImplMapping: component-implementation=Impl_SWC_IOEXP_type, component=root_FDC.SWC_IOEXP
            SWC_CGW_ImplMapping: component-implementation=Impl_SWC_CGW_type, component=root_FDC.SWC_CGW
        sw-mappings:
          swc to ecu mapping SWC_ECUMapping: ecu-instance=FUSION
            component:
              root_FDC.SWC_FDC
              root_FDC.SWC_CDD
              root_FDC.SWC_VES
              root_FDC.BswMTest
              root_FDC.SWC_NVM
              root_FDC.SWC_UDS
              root_FDC.SWC_IMU
              root_FDC.SWC_UART
              root_FDC.SWC_DID
              root_FDC.SWC_IOEXP
              root_FDC.SWC_APS
              root_FDC.SWC_CGW
      MAP_P_CAN1_CCVS: sender-receiver-to-signal-group-mapping{communication-direction=OUT, data-element=SWC_FDC.root_FDC.P_CAN1_CCVS.CAN1_SG_CCVS, signal-group=CAN1_SG_CCVS, type-mapping=sender-rec-record-type-mapping=record-element-mappings=[{implementation-record-element=CAN1_BrakeSW, system-signal=CAN1_BrakeSW}, {implementation-record-element=CAN1_VCUVehSpd, system-signal=CAN1_VCUVehSpd}, {implementation-record-element=CAN1_ParkBrakeSW, system-signal=CAN1_ParkBrakeSW}]}
      MAP_P_CAN1_CFGEM1_BAM: sender-receiver-to-signal-group-mapping{communication-direction=OUT, data-element=SWC_FDC.root_FDC.P_CAN1_CFGEM1_BAM.CAN1_SG_CFGEM1_BAM, signal-group=CAN1_SG_CFGEM1_BAM, type-mapping=sender-rec-record-type-mapping=record-element-mappings=[{implementation-record-element=CAN1_CFGEM1BAMPGN, system-signal=CAN1_CFGEM1BAMPGN}, {implementation-record-element=CAN1_CFGEM1Ctrl, system-signal=CAN1_CFGEM1Ctrl}, {implementation-record-element=CAN1_CFGEM1BAMTSize, system-signal=CAN1_CFGEM1BAMTSize}, {implementation-record-element=CAN1_CFGEM1BAMTNum, system-signal=CAN1_CFGEM1BAMTNum}, {implementation-record-element=CAN1_CFGEM1BAMRsv, system-signal=CAN1_CFGEM1BAMRsv}]}
      MAP_P_CAN1_CFGEM1_DT: sender-receiver-to-signal-group-mapping{communication-direction=OUT, data-element=SWC_FDC.root_FDC.P_CAN1_CFGEM1_DT.CAN1_SG_CFGEM1_DT, signal-group=CAN1_SG_CFGEM1_DT, type-mapping=sender-rec-record-type-mapping=record-element-mappings=[{implementation-record-element=CAN1_CFGEM1DT0, system-signal=CAN1_CFGEM1DT0}, {implementation-record-element=CAN1_CFGEM1DT7, system-signal=CAN1_CFGEM1DT7}, {implementation-record-element=CAN1_CFGEM1DT6, system-signal=CAN1_CFGEM1DT6}, {implementation-record-element=CAN1_CFGEM1DT5, system-signal=CAN1_CFGEM1DT5}, {implementation-record-element=CAN1_CFGEM1DT4, system-signal=CAN1_CFGEM1DT4}, {implementation-record-element=CAN1_CFGEM1DT3, system-signal=CAN1_CFGEM1DT3}, {implementation-record-element=CAN1_CFGEM1DT2, system-signal=CAN1_CFGEM1DT2}, {implementation-record-element=CAN1_CFGEM1DT1, system-signal=CAN1_CFGEM1DT1}]}
      MAP_P_CAN1_EEC2: sender-receiver-to-signal-group-mapping{communication-direction=OUT, data-element=SWC_FDC.root_FDC.P_CAN1_EEC2.CAN1_SG_EEC2, signal-group=CAN1_SG_EEC2, type-mapping=sender-rec-record-type-mapping=record-element-mappings=[{implementation-record-element=CAN1_AccPedal1LowSW, system-signal=CAN1_AccPedal1LowSW}, {implementation-record-element=CAN1_EEC2MSGCnt, system-signal=CAN1_EEC2MSGCnt}, {implementation-record-element=CAN1_EEC2MSGCS, system-signal=CAN1_EEC2MSGCS}, {implementation-record-element=CAN1_AccPedalPos1, system-signal=CAN1_AccPedalPos1}]}
      MAP_P_CAN1_EEC3: sender-receiver-to-signal-group-mapping{communication-direction=OUT, data-element=SWC_FDC.root_FDC.P_CAN1_EEC3.CAN1_SG_EEC3, signal-group=CAN1_SG_EEC3, type-mapping=sender-rec-record-type-mapping=record-element-mappings=[{implementation-record-element=CAN1_EMParasLoss, system-signal=CAN1_EMParasLoss}, {implementation-record-element=CAN1_NFricPercTorq, system-signal=CAN1_NFricPercTorq}]}
      MAP_P_CAN1_EMRC1: sender-receiver-to-signal-group-mapping{communication-direction=OUT, data-element=SWC_FDC.root_FDC.P_CAN1_EMRC1.CAN1_SG_EMRC1, signal-group=CAN1_SG_EMRC1, type-mapping=sender-rec-record-type-mapping=record-element-mappings=[{implementation-record-element=CAN1_ActEMOutSftSpd, system-signal=CAN1_ActEMOutSftSpd}, {implementation-record-element=CAN1_SACtrlDev, system-signal=CAN1_SACtrlDev}, {implementation-record-element=CAN1_RetSelNonEng, system-signal=CAN1_RetSelNonEng}, {implementation-record-element=CAN1_EMTrqModeDrvBrk, system-signal=CAN1_EMTrqModeDrvBrk}, {implementation-record-element=CAN1_DrvDemEMRtapTrq, system-signal=CAN1_DrvDemEMRtapTrq}, {implementation-record-element=CAN1_ActMaxAvaEMRecpTrq, system-signal=CAN1_ActMaxAvaEMRecpTrq}, {implementation-record-element=CAN1_ActEMpTrqHrls, system-signal=CAN1_ActEMpTrqHrls}, {implementation-record-element=CAN1_ActEMpTrq, system-signal=CAN1_ActEMpTrq}]}
      MAP_P_CAN1_ETC1: sender-receiver-to-signal-group-mapping{communication-direction=OUT, data-element=SWC_FDC.root_FDC.P_CAN1_ETC1.CAN1_SG_ETC1, signal-group=CAN1_SG_ETC1, type-mapping=sender-rec-record-type-mapping=record-element-mappings=[{implementation-record-element=CAN1_DLEngaged, system-signal=CAN1_DLEngaged}, {implementation-record-element=CAN1_ShiftPgs, system-signal=CAN1_ShiftPgs}]}
      MAP_P_CAN1_ETC2: sender-receiver-to-signal-group-mapping{communication-direction=OUT, data-element=SWC_FDC.root_FDC.P_CAN1_ETC2.CAN1_SG_ETC2, signal-group=CAN1_SG_ETC2, type-mapping=sender-rec-record-type-mapping=sender-rec-record-element-mapping{implementation-record-element=CAN1_ActDriveDirect, system-signal=CAN1_ActDriveDirect}}
      MAP_P_CAN1_FD1_C100_1: sender-receiver-to-signal-group-mapping{communication-direction=OUT, data-element=SWC_FDC.root_FDC.P_CAN1_FD1_C100_1.CAN1_SG_FD1_C100_1, signal-group=CAN1_SG_FD1_C100_1, type-mapping=sender-rec-record-type-mapping=record-element-mappings=[{implementation-record-element=CAN1_FDC_CHA_EBSHBSw_Sta, system-signal=CAN1_FDC_CHA_EBSHBSw_Sta}, {implementation-record-element=CAN1_FDC_CHA_EBSHHSw_Sta, system-signal=CAN1_FDC_CHA_EBSHHSw_Sta}]}
      MAP_P_CAN1_FD1_C100_2: sender-receiver-to-signal-group-mapping{communication-direction=OUT, data-element=SWC_FDC.root_FDC.P_CAN1_FD1_C100_2.CAN1_SG_FD1_C100_2, signal-group=CAN1_SG_FD1_C100_2, type-mapping=sender-rec-record-type-mapping=sender-rec-record-element-mapping{implementation-record-element=CAN1_FDC_CHA_EBSRd4BR_Sta, system-signal=CAN1_FDC_CHA_EBSRd4BR_Sta}}
      MAP_P_CAN1_FD1_C100_3: sender-receiver-to-signal-group-mapping{communication-direction=OUT, data-element=SWC_FDC.root_FDC.P_CAN1_FD1_C100_3.CAN1_SG_FD1_C100_3, signal-group=CAN1_SG_FD1_C100_3, type-mapping=sender-rec-record-type-mapping=record-element-mappings=[{implementation-record-element=CAN1_DCDCEnDemand, system-signal=CAN1_DCDCEnDemand}, {implementation-record-element=CAN1_FDC_CHA_EACEnDemand_Cmd, system-signal=CAN1_FDC_CHA_EACEnDemand_Cmd}, {implementation-record-element=CAN1_EHPSSpdDemand, system-signal=CAN1_EHPSSpdDemand}, {implementation-record-element=CAN1_EHPSEnDemand, system-signal=CAN1_EHPSEnDemand}, {implementation-record-element=CAN1_EACSpdDemand, system-signal=CAN1_EACSpdDemand}]}
      MAP_P_CAN1_FD1_CE100_1: sender-receiver-to-signal-group-mapping{communication-direction=OUT, data-element=SWC_FDC.root_FDC.P_CAN1_FD1_CE100_1.CAN1_SG_FD1_CE100_1, signal-group=CAN1_SG_FD1_CE100_1, type-mapping=sender-rec-record-type-mapping=sender-rec-record-element-mapping{implementation-record-element=CAN1_FDC_BCM_DoorSta_Sta, system-signal=CAN1_FDC_BCM_DoorSta_Sta}}
      MAP_P_CAN1_GW1_C1000_1: sender-receiver-to-signal-group-mapping{communication-direction=OUT, data-element=SWC_FDC.root_FDC.P_CAN1_GW1_C1000_1.CAN1_SG_GW1_C1000_1, signal-group=CAN1_SG_GW1_C1000_1, type-mapping=sender-rec-record-type-mapping=sender-rec-record-element-mapping{implementation-record-element=CAN1_SeatBeltSwitch, system-signal=CAN1_SeatBeltSwitch}}
      MAP_P_CAN1_GW1_C100_4: sender-receiver-to-signal-group-mapping{communication-direction=OUT, data-element=SWC_FDC.root_FDC.P_CAN1_GW1_C100_4.CAN1_SG_GW1_C100_4, signal-group=CAN1_SG_GW1_C100_4, type-mapping=sender-rec-record-type-mapping=record-element-mappings=[{implementation-record-element=CAN1_OpenStatusOfDoor1, system-signal=CAN1_OpenStatusOfDoor1}, {implementation-record-element=CAN1_OpenStatusOfDoor2, system-signal=CAN1_OpenStatusOfDoor2}]}
      MAP_P_CAN1_VCU_PDU_Demand_1: sender-receiver-to-signal-group-mapping{communication-direction=OUT, data-element=SWC_FDC.root_FDC.P_CAN1_VCU_PDU_Demand_1.CAN1_SG_VCU_PDU_Demand_1, signal-group=CAN1_SG_VCU_PDU_Demand_1, type-mapping=sender-rec-record-type-mapping=record-element-mappings=[{implementation-record-element=CAN1_DCDCRlyEn, system-signal=CAN1_DCDCRlyEn}, {implementation-record-element=CAN1_VCULife1, system-signal=CAN1_VCULife1}, {implementation-record-element=CAN1_EHPSRlyEn, system-signal=CAN1_EHPSRlyEn}, {implementation-record-element=CAN1_EACRlyEn, system-signal=CAN1_EACRlyEn}]}
      MAP_P_CAN2_FD2_C200_1: sender-receiver-to-signal-group-mapping{communication-direction=OUT, data-element=SWC_FDC.root_FDC.P_CAN2_FD2_C200_1.CAN2_SG_FD2_C200_1, signal-group=CAN2_SG_FD2_C200_1, type-mapping=sender-rec-record-type-mapping=record-element-mappings=[{implementation-record-element=CAN2_FDC_CHA_CACPresWarn_Sta, system-signal=CAN2_FDC_CHA_CACPresWarn_Sta}, {implementation-record-element=CAN2_FDC_CHA_CACTempWarn_Sta, system-signal=CAN2_FDC_CHA_CACTempWarn_Sta}]}
      MAP_P_CAN2_FD2_C20_0: sender-receiver-to-signal-group-mapping{communication-direction=OUT, data-element=SWC_FDC.root_FDC.P_CAN2_FD2_C20_0.CAN2_SG_FD2_C20_0, signal-group=CAN2_SG_FD2_C20_0, type-mapping=sender-rec-record-type-mapping=record-element-mappings=[{implementation-record-element=CAN2_APS_ExitCondition, system-signal=CAN2_APS_ExitCondition}, {implementation-record-element=CAN2_VMC_VCU_MSA_Crl_Sta, system-signal=CAN2_VMC_VCU_MSA_Crl_Sta}, {implementation-record-element=CAN2_VMC_VCU_CC_Crl_Sta, system-signal=CAN2_VMC_VCU_CC_Crl_Sta}, {implementation-record-element=CAN2_USS_Sta_RMR, system-signal=CAN2_USS_Sta_RMR}, {implementation-record-element=CAN2_USS_Sta_RML, system-signal=CAN2_USS_Sta_RML}, {implementation-record-element=CAN2_USS_Sta_RLR, system-signal=CAN2_USS_Sta_RLR}, {implementation-record-element=CAN2_USS_Sta_RLL, system-signal=CAN2_USS_Sta_RLL}, {implementation-record-element=CAN2_USS_Sta_RCR, system-signal=CAN2_USS_Sta_RCR}, {implementation-record-element=CAN2_USS_Sta_RCL, system-signal=CAN2_USS_Sta_RCL}, {implementation-record-element=CAN2_USS_Sta_FMR, system-signal=CAN2_USS_Sta_FMR}, {implementation-record-element=CAN2_USS_Sta_FML, system-signal=CAN2_USS_Sta_FML}, {implementation-record-element=CAN2_USS_Sta_FLR, system-signal=CAN2_USS_Sta_FLR}, {implementation-record-element=CAN2_USS_Sta_FLL, system-signal=CAN2_USS_Sta_FLL}, {implementation-record-element=CAN2_USS_Sta_FCR, system-signal=CAN2_USS_Sta_FCR}, {implementation-record-element=CAN2_USS_Sta_FCL, system-signal=CAN2_USS_Sta_FCL}, {implementation-record-element=CAN2_PAS_SNSR_Layout, system-signal=CAN2_PAS_SNSR_Layout}, {implementation-record-element=CAN2_PAS_D_RMR, system-signal=CAN2_PAS_D_RMR}, {implementation-record-element=CAN2_PAS_D_RML, system-signal=CAN2_PAS_D_RML}, {implementation-record-element=CAN2_PAS_D_RCR, system-signal=CAN2_PAS_D_RCR}, {implementation-record-element=CAN2_PAS_D_RCL, system-signal=CAN2_PAS_D_RCL}, {implementation-record-element=CAN2_PAS_D_FMR, system-signal=CAN2_PAS_D_FMR}, {implementation-record-element=CAN2_PAS_D_FML, system-signal=CAN2_PAS_D_FML}, {implementation-record-element=CAN2_PAS_D_FCR, system-signal=CAN2_PAS_D_FCR}, {implementation-record-element=CAN2_PAS_D_FCL, system-signal=CAN2_PAS_D_FCL}, {implementation-record-element=CAN2_PAS_Chime, system-signal=CAN2_PAS_Chime}, {implementation-record-element=CAN2_PAS_A_RMR, system-signal=CAN2_PAS_A_RMR}, {implementation-record-element=CAN2_PAS_A_RML, system-signal=CAN2_PAS_A_RML}, {implementation-record-element=CAN2_PAS_A_RCR, system-signal=CAN2_PAS_A_RCR}, {implementation-record-element=CAN2_PAS_A_RCL, system-signal=CAN2_PAS_A_RCL}, {implementation-record-element=CAN2_PAS_A_FMR, system-signal=CAN2_PAS_A_FMR}, {implementation-record-element=CAN2_PAS_A_FML, system-signal=CAN2_PAS_A_FML}, {implementation-record-element=CAN2_PAS_A_FCR, system-signal=CAN2_PAS_A_FCR}, {implementation-record-element=CAN2_PAS_A_FCL, system-signal=CAN2_PAS_A_FCL}, {implementation-record-element=CAN2_FDC_VMC_SpdCtrl_Sta, system-signal=CAN2_FDC_VMC_SpdCtrl_Sta}, {implementation-record-element=CAN2_FDC_VMC_SpdCtrlMode_Sta, system-signal=CAN2_FDC_VMC_SpdCtrlMode_Sta}, {implementation-record-element=CAN2_FDC_VMC_SetSpd_Sta, system-signal=CAN2_FDC_VMC_SetSpd_Sta}, {implementation-record-element=CAN2_FDC_VMC_SetSpdDisp_Sta, system-signal=CAN2_FDC_VMC_SetSpdDisp_Sta}, {implementation-record-element=CAN2_FDC_VCU_SmartEco_Sta, system-signal=CAN2_FDC_VCU_SmartEco_Sta}, {implementation-record-element=CAN2_FDC_VCU_SmartEcoSpdLim_Sta, system-signal=CAN2_FDC_VCU_SmartEcoSpdLim_Sta}, {implementation-record-element=CAN2_FDC_VCU_RegenMode_Sta, system-signal=CAN2_FDC_VCU_RegenMode_Sta}, {implementation-record-element=CAN2_FDC_VCU_RegenLimInd_Sta, system-signal=CAN2_FDC_VCU_RegenLimInd_Sta}, {implementation-record-element=CAN2_CAAS_Sta, system-signal=CAN2_CAAS_Sta}, {implementation-record-element=CAN2_APS_Sta_System, system-signal=CAN2_APS_Sta_System}, {implementation-record-element=CAN2_APS_SW_Ver, system-signal=CAN2_APS_SW_Ver}, {implementation-record-element=CAN2_APS_RQ_Display, system-signal=CAN2_APS_RQ_Display}]}
      MAP_P_CAN2_FD2_CE100_0: sender-receiver-to-signal-group-mapping{communication-direction=OUT, data-element=SWC_FDC.root_FDC.P_CAN2_FD2_CE100_0.CAN2_SG_FD2_CE100_0, signal-group=CAN2_SG_FD2_CE100_0, type-mapping=sender-rec-record-type-mapping=record-element-mappings=[{implementation-record-element=CAN2_APMDoorControlSta, system-signal=CAN2_APMDoorControlSta}, {implementation-record-element=CAN2_sigWindDirZon3St, system-signal=CAN2_sigWindDirZon3St}, {implementation-record-element=CAN2_sigWindDirZon1St, system-signal=CAN2_sigWindDirZon1St}, {implementation-record-element=CAN2_sigSetTempZon3St, system-signal=CAN2_sigSetTempZon3St}, {implementation-record-element=CAN2_sigSetTempZon2St, system-signal=CAN2_sigSetTempZon2St}, {implementation-record-element=CAN2_sigSetTempZon1St, system-signal=CAN2_sigSetTempZon1St}, {implementation-record-element=CAN2_sigRecircSt, system-signal=CAN2_sigRecircSt}, {implementation-record-element=CAN2_sigHvacSt, system-signal=CAN2_sigHvacSt}, {implementation-record-element=CAN2_sigDfrstSt, system-signal=CAN2_sigDfrstSt}, {implementation-record-element=CAN2_sigCbnAirT, system-signal=CAN2_sigCbnAirT}, {implementation-record-element=CAN2_sigAmbAirT, system-signal=CAN2_sigAmbAirT}, {implementation-record-element=CAN2_sigAirIntenZon3St, system-signal=CAN2_sigAirIntenZon3St}, {implementation-record-element=CAN2_sigAirIntenZon1St, system-signal=CAN2_sigAirIntenZon1St}, {implementation-record-element=CAN2_XWDMode, system-signal=CAN2_XWDMode}, {implementation-record-element=CAN2_VehMalfunLevel, system-signal=CAN2_VehMalfunLevel}, {implementation-record-element=CAN2_VCU_OPDHold, system-signal=CAN2_VCU_OPDHold}, {implementation-record-element=CAN2_VCUTailgateSWSta, system-signal=CAN2_VCUTailgateSWSta}, {implementation-record-element=CAN2_VCURRDoorSta, system-signal=CAN2_VCURRDoorSta}, {implementation-record-element=CAN2_VCURLDoorSta, system-signal=CAN2_VCURLDoorSta}, {implementation-record-element=CAN2_VCUHoodSWSta, system-signal=CAN2_VCUHoodSWSta}, {implementation-record-element=CAN2_VCUFRDoorSta, system-signal=CAN2_VCUFRDoorSta}, {implementation-record-element=CAN2_VCUFLDoorSta, system-signal=CAN2_VCUFLDoorSta}, {implementation-record-element=CAN2_VCUBrkSWSta, system-signal=CAN2_VCUBrkSWSta}, {implementation-record-element=CAN2_Tailgate_SW, system-signal=CAN2_Tailgate_SW}, {implementation-record-element=CAN2_SysPwrSta, system-signal=CAN2_SysPwrSta}, {implementation-record-element=CAN2_SysAllowReadySta, system-signal=CAN2_SysAllowReadySta}, {implementation-record-element=CAN2_ShiftGearPosn, system-signal=CAN2_ShiftGearPosn}, {implementation-record-element=CAN2_Rr_FogLamp, system-signal=CAN2_Rr_FogLamp}, {implementation-record-element=CAN2_Rr_Defog, system-signal=CAN2_Rr_Defog}, {implementation-record-element=CAN2_ReverseLamp, system-signal=CAN2_ReverseLamp}, {implementation-record-element=CAN2_Req_V2L_IVI_Popup, system-signal=CAN2_Req_V2L_IVI_Popup}, {implementation-record-element=CAN2_Req_V2LSwOn, system-signal=CAN2_Req_V2LSwOn}, {implementation-record-element=CAN2_Req_Internal_V2L_Status_Lamp, system-signal=CAN2_Req_Internal_V2L_Status_Lamp}, {implementation-record-element=CAN2_RTurnLP, system-signal=CAN2_RTurnLP}, {implementation-record-element=CAN2_RRDoorSW, system-signal=CAN2_RRDoorSW}, {implementation-record-element=CAN2_RLDoorSW, system-signal=CAN2_RLDoorSW}, {implementation-record-element=CAN2_RDRL, system-signal=CAN2_RDRL}, {implementation-record-element=CAN2_RBSD, system-signal=CAN2_RBSD}, {implementation-record-element=CAN2_PwrStaONTOIVIPopT, system-signal=CAN2_PwrStaONTOIVIPopT}, {implementation-record-element=CAN2_PwrStaONTOIVIPopReq, system-signal=CAN2_PwrStaONTOIVIPopReq}, {implementation-record-element=CAN2_PwrStaErr, system-signal=CAN2_PwrStaErr}, {implementation-record-element=CAN2_PwrSta, system-signal=CAN2_PwrSta}, {implementation-record-element=CAN2_PsDoorSW, system-signal=CAN2_PsDoorSW}, {implementation-record-element=CAN2_PosLamp, system-signal=CAN2_PosLamp}, {implementation-record-element=CAN2_PAS_Sta_F_Sys, system-signal=CAN2_PAS_Sta_F_Sys}, {implementation-record-element=CAN2_MeterIndSpeed_raw32, system-signal=CAN2_MeterIndSpeed_raw32}, {implementation-record-element=CAN2_MSA_Crl_Sta, system-signal=CAN2_MSA_Crl_Sta}, {implementation-record-element=CAN2_MCUActDisFail, system-signal=CAN2_MCUActDisFail}, {implementation-record-element=CAN2_LockSetting, system-signal=CAN2_LockSetting}, {implementation-record-element=CAN2_LimphomeAct, system-signal=CAN2_LimphomeAct}, {implementation-record-element=CAN2_L_Beam, system-signal=CAN2_L_Beam}, {implementation-record-element=CAN2_LVSysErr_PwrOutpErr, system-signal=CAN2_LVSysErr_PwrOutpErr}, {implementation-record-element=CAN2_LVChrgFuncStaChk, system-signal=CAN2_LVChrgFuncStaChk}, {implementation-record-element=CAN2_LTurnLP, system-signal=CAN2_LTurnLP}, {implementation-record-element=CAN2_LDRL, system-signal=CAN2_LDRL}, {implementation-record-element=CAN2_LBSD, system-signal=CAN2_LBSD}, {implementation-record-element=CAN2_HoodSW, system-signal=CAN2_HoodSW}, {implementation-record-element=CAN2_HazardSW, system-signal=CAN2_HazardSW}, {implementation-record-element=CAN2_H_Beam, system-signal=CAN2_H_Beam}, {implementation-record-element=CAN2_HVSysErr_RelayErr, system-signal=CAN2_HVSysErr_RelayErr}, {implementation-record-element=CAN2_HVSysErr_PackErr, system-signal=CAN2_HVSysErr_PackErr}, {implementation-record-element=CAN2_HVSysErr_IsolationErr, system-signal=CAN2_HVSysErr_IsolationErr}, {implementation-record-element=CAN2_HVRlyOpFail, system-signal=CAN2_HVRlyOpFail}, {implementation-record-element=CAN2_Fr_FogLamp, system-signal=CAN2_Fr_FogLamp}, {implementation-record-element=CAN2_FollowMe, system-signal=CAN2_FollowMe}, {implementation-record-element=CAN2_FeatSetSpdFinal_raw32, system-signal=CAN2_FeatSetSpdFinal_raw32}, {implementation-record-element=CAN2_FalseNPrevent_Sta, system-signal=CAN2_FalseNPrevent_Sta}, {implementation-record-element=CAN2_FD_Telltale_Fail, system-signal=CAN2_FD_Telltale_Fail}, {implementation-record-element=CAN2_FD_TCS_Indicator, system-signal=CAN2_FD_TCS_Indicator}, {implementation-record-element=CAN2_FD_Steering_Warning, system-signal=CAN2_FD_Steering_Warning}, {implementation-record-element=CAN2_FD_Power_limitation, system-signal=CAN2_FD_Power_limitation}, {implementation-record-element=CAN2_FD_Park_Brake_Warning, system-signal=CAN2_FD_Park_Brake_Warning}, {implementation-record-element=CAN2_FD_HV_Battery_Fault, system-signal=CAN2_FD_HV_Battery_Fault}, {implementation-record-element=CAN2_FD_EPB_Error, system-signal=CAN2_FD_EPB_Error}, {implementation-record-element=CAN2_FD_EDrive_System, system-signal=CAN2_FD_EDrive_System}, {implementation-record-element=CAN2_FD_Battery_Charge_Warning, system-signal=CAN2_FD_Battery_Charge_Warning}, {implementation-record-element=CAN2_FD_ABS_Warning, system-signal=CAN2_FD_ABS_Warning}, {implementation-record-element=CAN2_FDC_VCU_PwrSaveReq_Cmd, system-signal=CAN2_FDC_VCU_PwrSaveReq_Cmd}, {implementation-record-element=CAN2_FDC_THCM_PsVent_Sta, system-signal=CAN2_FDC_THCM_PsVent_Sta}, {implementation-record-element=CAN2_FDC_THCM_PsEVentZ_Sta, system-signal=CAN2_FDC_THCM_PsEVentZ_Sta}, {implementation-record-element=CAN2_FDC_THCM_PsEVentY_Sta, system-signal=CAN2_FDC_THCM_PsEVentY_Sta}, {implementation-record-element=CAN2_FDC_THCM_PsEVentMode_Sta, system-signal=CAN2_FDC_THCM_PsEVentMode_Sta}, {implementation-record-element=CAN2_FDC_THCM_DrVent_Sta, system-signal=CAN2_FDC_THCM_DrVent_Sta}, {implementation-record-element=CAN2_FDC_THCM_DrEVentZ_Sta, system-signal=CAN2_FDC_THCM_DrEVentZ_Sta}, {implementation-record-element=CAN2_FDC_THCM_DrEVentY_Sta, system-signal=CAN2_FDC_THCM_DrEVentY_Sta}, {implementation-record-element=CAN2_FDC_THCM_DrEVentMode_Sta, system-signal=CAN2_FDC_THCM_DrEVentMode_Sta}, {implementation-record-element=CAN2_FDC_THCM_CRVent_Sta, system-signal=CAN2_FDC_THCM_CRVent_Sta}, {implementation-record-element=CAN2_FDC_THCM_CREVentZ_Sta, system-signal=CAN2_FDC_THCM_CREVentZ_Sta}, {implementation-record-element=CAN2_FDC_THCM_CREVentY_Sta, system-signal=CAN2_FDC_THCM_CREVentY_Sta}, {implementation-record-element=CAN2_FDC_THCM_CLVent_Sta, system-signal=CAN2_FDC_THCM_CLVent_Sta}, {implementation-record-element=CAN2_FDC_THCM_CLEVentZ_Sta, system-signal=CAN2_FDC_THCM_CLEVentZ_Sta}, {implementation-record-element=CAN2_FDC_THCM_CLEVentY_Sta, system-signal=CAN2_FDC_THCM_CLEVentY_Sta}, {implementation-record-element=CAN2_EngageP_Fail, system-signal=CAN2_EngageP_Fail}, {implementation-record-element=CAN2_Eng_PwrLockSta, system-signal=CAN2_Eng_PwrLockSta}, {implementation-record-element=CAN2_Eng_CoastDwSta, system-signal=CAN2_Eng_CoastDwSta}, {implementation-record-element=CAN2_Eng_ActvDmpDisabSta, system-signal=CAN2_Eng_ActvDmpDisabSta}, {implementation-record-element=CAN2_EVDriveMode, system-signal=CAN2_EVDriveMode}, {implementation-record-element=CAN2_EDriveSysErr_VCUErr, system-signal=CAN2_EDriveSysErr_VCUErr}, {implementation-record-element=CAN2_EDriveSysErr_ShifterErr, system-signal=CAN2_EDriveSysErr_ShifterErr}, {implementation-record-element=CAN2_EDriveSysErr_MCUErr, system-signal=CAN2_EDriveSysErr_MCUErr}, {implementation-record-element=CAN2_EDriveSysErr_AccPedalErr, system-signal=CAN2_EDriveSysErr_AccPedalErr}, {implementation-record-element=CAN2_DynoModeStaChk, system-signal=CAN2_DynoModeStaChk}, {implementation-record-element=CAN2_Dr_SeatSta, system-signal=CAN2_Dr_SeatSta}, {implementation-record-element=CAN2_DrDoorSW, system-signal=CAN2_DrDoorSW}, {implementation-record-element=CAN2_DoorLockIND, system-signal=CAN2_DoorLockIND}, {implementation-record-element=CAN2_DisengageP_Fail, system-signal=CAN2_DisengageP_Fail}, {implementation-record-element=CAN2_DimmerEN, system-signal=CAN2_DimmerEN}, {implementation-record-element=CAN2_Dimmer, system-signal=CAN2_Dimmer}, {implementation-record-element=CAN2_DemoModeStaChk, system-signal=CAN2_DemoModeStaChk}, {implementation-record-element=CAN2_DISC_Sta, system-signal=CAN2_DISC_Sta}, {implementation-record-element=CAN2_DISC_ButtSta, system-signal=CAN2_DISC_ButtSta}, {implementation-record-element=CAN2_CreepSW_Sta, system-signal=CAN2_CreepSW_Sta}, {implementation-record-element=CAN2_CoastDwModeStaChk, system-signal=CAN2_CoastDwModeStaChk}, {implementation-record-element=CAN2_CC_Crl_Sta, system-signal=CAN2_CC_Crl_Sta}, {implementation-record-element=CAN2_CCU_SyncLampSts, system-signal=CAN2_CCU_SyncLampSts}, {implementation-record-element=CAN2_CCU_RrOnOffLampSts, system-signal=CAN2_CCU_RrOnOffLampSts}, {implementation-record-element=CAN2_CCU_FrtOnOffLampSts, system-signal=CAN2_CCU_FrtOnOffLampSts}, {implementation-record-element=CAN2_CCU_EcoSts, system-signal=CAN2_CCU_EcoSts}, {implementation-record-element=CAN2_CCU_Dispaly_Request, system-signal=CAN2_CCU_Dispaly_Request}, {implementation-record-element=CAN2_CCU_AutoMidLampSts, system-signal=CAN2_CCU_AutoMidLampSts}, {implementation-record-element=CAN2_CCU_AutoLampSts, system-signal=CAN2_CCU_AutoLampSts}, {implementation-record-element=CAN2_CCU_ACMaxLampSts, system-signal=CAN2_CCU_ACMaxLampSts}, {implementation-record-element=CAN2_CCU_ACLampSts, system-signal=CAN2_CCU_ACLampSts}, {implementation-record-element=CAN2_CCMSA_SpdWar, system-signal=CAN2_CCMSA_SpdWar}, {implementation-record-element=CAN2_BrakeLamp, system-signal=CAN2_BrakeLamp}, {implementation-record-element=CAN2_BCM_DoorLock_Sta, system-signal=CAN2_BCM_DoorLock_Sta}, {implementation-record-element=CAN2_AntitheftSta, system-signal=CAN2_AntitheftSta}, {implementation-record-element=CAN2_AllDoorSW, system-signal=CAN2_AllDoorSW}, {implementation-record-element=CAN2_ActAPSPosn, system-signal=CAN2_ActAPSPosn}]}
      MAP_P_CAN2_FD2_CE100_1: sender-receiver-to-signal-group-mapping{communication-direction=OUT, data-element=SWC_FDC.root_FDC.P_CAN2_FD2_CE100_1.CAN2_SG_FD2_CE100_1, signal-group=CAN2_SG_FD2_CE100_1, type-mapping=sender-rec-record-type-mapping=record-element-mappings=[{implementation-record-element=CAN2_FDC_BCM_TgateSWL_Sta, system-signal=CAN2_FDC_BCM_TgateSWL_Sta}, {implementation-record-element=CAN2_FDC_VCU_TUpASta_Sta, system-signal=CAN2_FDC_VCU_TUpASta_Sta}, {implementation-record-element=CAN2_FDC_VCU_DACStatus_Sta, system-signal=CAN2_FDC_VCU_DACStatus_Sta}, {implementation-record-element=CAN2_FDC_BCM_WelcomeDemo_Sta, system-signal=CAN2_FDC_BCM_WelcomeDemo_Sta}, {implementation-record-element=CAN2_FDC_BCM_TgateSWR_Sta, system-signal=CAN2_FDC_BCM_TgateSWR_Sta}]}
      MAP_P_CAN2_FD2_CE200_1: sender-receiver-to-signal-group-mapping{communication-direction=OUT, data-element=SWC_FDC.root_FDC.P_CAN2_FD2_CE200_1.CAN2_SG_FD2_CE200_1, signal-group=CAN2_SG_FD2_CE200_1, type-mapping=sender-rec-record-type-mapping=record-element-mappings=[{implementation-record-element=CAN2_AutoLTips, system-signal=CAN2_AutoLTips}, {implementation-record-element=CAN2_TPMS_Res_Butt_Allow, system-signal=CAN2_TPMS_Res_Butt_Allow}, {implementation-record-element=CAN2_TPMS_Cali_Butt_Allow, system-signal=CAN2_TPMS_Cali_Butt_Allow}, {implementation-record-element=CAN2_T1_TPMS_TPMSWarnIndi, system-signal=CAN2_T1_TPMS_TPMSWarnIndi}, {implementation-record-element=CAN2_T1_TPMS_RFWheelTmpIndi, system-signal=CAN2_T1_TPMS_RFWheelTmpIndi}, {implementation-record-element=CAN2_T1_TPMS_RFWheelTemp, system-signal=CAN2_T1_TPMS_RFWheelTemp}, {implementation-record-element=CAN2_T1_TPMS_RFWheelPress, system-signal=CAN2_T1_TPMS_RFWheelPress}, {implementation-record-element=CAN2_T1_TPMS_RFWheelPSW, system-signal=CAN2_T1_TPMS_RFWheelPSW}, {implementation-record-element=CAN2_T1_TPMS_RFWheelDebug, system-signal=CAN2_T1_TPMS_RFWheelDebug}, {implementation-record-element=CAN2_T1_TPMS_RFSensorFail, system-signal=CAN2_T1_TPMS_RFSensorFail}, {implementation-record-element=CAN2_T1_TPMS_RFPressIndi, system-signal=CAN2_T1_TPMS_RFPressIndi}, {implementation-record-element=CAN2_T1_TPMS_RFBatWarn, system-signal=CAN2_T1_TPMS_RFBatWarn}, {implementation-record-element=CAN2_T1_TPMS_LFWheelTmpIndi, system-signal=CAN2_T1_TPMS_LFWheelTmpIndi}, {implementation-record-element=CAN2_T1_TPMS_LFWheelTemp, system-signal=CAN2_T1_TPMS_LFWheelTemp}, {implementation-record-element=CAN2_T1_TPMS_LFWheelPress, system-signal=CAN2_T1_TPMS_LFWheelPress}, {implementation-record-element=CAN2_T1_TPMS_LFWheelPSW, system-signal=CAN2_T1_TPMS_LFWheelPSW}, {implementation-record-element=CAN2_T1_TPMS_LFWheelDebug, system-signal=CAN2_T1_TPMS_LFWheelDebug}, {implementation-record-element=CAN2_T1_TPMS_LFSensorFail, system-signal=CAN2_T1_TPMS_LFSensorFail}, {implementation-record-element=CAN2_T1_TPMS_LFPressIndi, system-signal=CAN2_T1_TPMS_LFPressIndi}, {implementation-record-element=CAN2_T1_TPMS_LFBatWarn, system-signal=CAN2_T1_TPMS_LFBatWarn}, {implementation-record-element=CAN2_RRWheelTmpIndi, system-signal=CAN2_RRWheelTmpIndi}, {implementation-record-element=CAN2_RRWheelTemp, system-signal=CAN2_RRWheelTemp}, {implementation-record-element=CAN2_RRWheelShield, system-signal=CAN2_RRWheelShield}, {implementation-record-element=CAN2_RRWheelPress, system-signal=CAN2_RRWheelPress}, {implementation-record-element=CAN2_RRWheelPSW, system-signal=CAN2_RRWheelPSW}, {implementation-record-element=CAN2_RRWheelDebug, system-signal=CAN2_RRWheelDebug}, {implementation-record-element=CAN2_RRSensorFail, system-signal=CAN2_RRSensorFail}, {implementation-record-element=CAN2_RRPressIndi, system-signal=CAN2_RRPressIndi}, {implementation-record-element=CAN2_RRBatWarn, system-signal=CAN2_RRBatWarn}, {implementation-record-element=CAN2_RFWheelShield, system-signal=CAN2_RFWheelShield}, {implementation-record-element=CAN2_LRWheelTmpIndi, system-signal=CAN2_LRWheelTmpIndi}, {implementation-record-element=CAN2_LRWheelTemp, system-signal=CAN2_LRWheelTemp}, {implementation-record-element=CAN2_LRWheelShield, system-signal=CAN2_LRWheelShield}, {implementation-record-element=CAN2_LRWheelPress, system-signal=CAN2_LRWheelPress}, {implementation-record-element=CAN2_LRWheelPSW, system-signal=CAN2_LRWheelPSW}, {implementation-record-element=CAN2_LRWheelDebug, system-signal=CAN2_LRWheelDebug}, {implementation-record-element=CAN2_LRSensorFail, system-signal=CAN2_LRSensorFail}, {implementation-record-element=CAN2_LRPressIndi, system-signal=CAN2_LRPressIndi}, {implementation-record-element=CAN2_LRBatWarn, system-signal=CAN2_LRBatWarn}, {implementation-record-element=CAN2_LFWheelShield, system-signal=CAN2_LFWheelShield}, {implementation-record-element=CAN2_FDC_THCM_AirIntZ3_Sta, system-signal=CAN2_FDC_THCM_AirIntZ3_Sta}, {implementation-record-element=CAN2_FDC_THCM_APTCWarning_Sta, system-signal=CAN2_FDC_THCM_APTCWarning_Sta}, {implementation-record-element=CAN2_FDC_THCM_APTCForceOFF_Sta, system-signal=CAN2_FDC_THCM_APTCForceOFF_Sta}, {implementation-record-element=CAN2_FDC_SPTG_SPTGENFun_Sta, system-signal=CAN2_FDC_SPTG_SPTGENFun_Sta}, {implementation-record-element=CAN2_FDC_DKC_UIDLowPower_Sta, system-signal=CAN2_FDC_DKC_UIDLowPower_Sta}, {implementation-record-element=CAN2_FDC_DKC_KeyType_Sta, system-signal=CAN2_FDC_DKC_KeyType_Sta}, {implementation-record-element=CAN2_FDC_DKC_KeyNum_Sta, system-signal=CAN2_FDC_DKC_KeyNum_Sta}, {implementation-record-element=CAN2_FDC_DKC_KeyMiss_Sta, system-signal=CAN2_FDC_DKC_KeyMiss_Sta}, {implementation-record-element=CAN2_FDC_DKC_DkeyShowIVI_Sta, system-signal=CAN2_FDC_DKC_DkeyShowIVI_Sta}, {implementation-record-element=CAN2_FDC_BCM_WalkOutLkEnFun_Sta, system-signal=CAN2_FDC_BCM_WalkOutLkEnFun_Sta}, {implementation-record-element=CAN2_FDC_BCM_WalkInUnLkEnFun_Sta, system-signal=CAN2_FDC_BCM_WalkInUnLkEnFun_Sta}, {implementation-record-element=CAN2_FDC_BCM_UserNow_Sta, system-signal=CAN2_FDC_BCM_UserNow_Sta}, {implementation-record-element=CAN2_FDC_BCM_TurnSwTSetSta_Sta, system-signal=CAN2_FDC_BCM_TurnSwTSetSta_Sta}, {implementation-record-element=CAN2_FDC_BCM_RmLpModeENFun_Sta, system-signal=CAN2_FDC_BCM_RmLpModeENFun_Sta}, {implementation-record-element=CAN2_FDC_BCM_PTGOpenHeight_Sta, system-signal=CAN2_FDC_BCM_PTGOpenHeight_Sta}, {implementation-record-element=CAN2_FDC_BCM_LockAlarm_Cmd, system-signal=CAN2_FDC_BCM_LockAlarm_Cmd}, {implementation-record-element=CAN2_FDC_BCM_Key9Acc_Sta, system-signal=CAN2_FDC_BCM_Key9Acc_Sta}, {implementation-record-element=CAN2_FDC_BCM_Key8Acc_Sta, system-signal=CAN2_FDC_BCM_Key8Acc_Sta}, {implementation-record-element=CAN2_FDC_BCM_Key7Acc_Sta, system-signal=CAN2_FDC_BCM_Key7Acc_Sta}, {implementation-record-element=CAN2_FDC_BCM_Key6Acc_Sta, system-signal=CAN2_FDC_BCM_Key6Acc_Sta}, {implementation-record-element=CAN2_FDC_BCM_Key5Acc_Sta, system-signal=CAN2_FDC_BCM_Key5Acc_Sta}, {implementation-record-element=CAN2_FDC_BCM_Key4Acc_Sta, system-signal=CAN2_FDC_BCM_Key4Acc_Sta}, {implementation-record-element=CAN2_FDC_BCM_Key3Acc_Sta, system-signal=CAN2_FDC_BCM_Key3Acc_Sta}, {implementation-record-element=CAN2_FDC_BCM_Key2Acc_Sta, system-signal=CAN2_FDC_BCM_Key2Acc_Sta}, {implementation-record-element=CAN2_FDC_BCM_Key1Acc_Sta, system-signal=CAN2_FDC_BCM_Key1Acc_Sta}, {implementation-record-element=CAN2_FDC_BCM_Key10Acc_Sta, system-signal=CAN2_FDC_BCM_Key10Acc_Sta}, {implementation-record-element=CAN2_FDC_BCM_FollowMeENFun_Sta, system-signal=CAN2_FDC_BCM_FollowMeENFun_Sta}, {implementation-record-element=CAN2_FDC_BCM_CLWinLockDr_Sta, system-signal=CAN2_FDC_BCM_CLWinLockDr_Sta}, {implementation-record-element=CAN2_FDC_BCM_AmbWelEN_Sta, system-signal=CAN2_FDC_BCM_AmbWelEN_Sta}, {implementation-record-element=CAN2_FDC_BCM_AmbPwrWarnEN_Sta, system-signal=CAN2_FDC_BCM_AmbPwrWarnEN_Sta}, {implementation-record-element=CAN2_FDC_BCM_AmbODAEN_Sta, system-signal=CAN2_FDC_BCM_AmbODAEN_Sta}, {implementation-record-element=CAN2_FDC_BCM_AmbLinkDriSta_Sta, system-signal=CAN2_FDC_BCM_AmbLinkDriSta_Sta}, {implementation-record-element=CAN2_FDC_BCM_AmbFunEN_Sta, system-signal=CAN2_FDC_BCM_AmbFunEN_Sta}, {implementation-record-element=CAN2_FDC_BCM_AmbDimEN_Sta, system-signal=CAN2_FDC_BCM_AmbDimEN_Sta}, {implementation-record-element=CAN2_FDC_BCM_AmbColorSta_Sta, system-signal=CAN2_FDC_BCM_AmbColorSta_Sta}, {implementation-record-element=CAN2_FDC_BCM_AmbBrightSta_Sta, system-signal=CAN2_FDC_BCM_AmbBrightSta_Sta}, {implementation-record-element=CAN2_FDC_BCM_Acc5Sta_Sta, system-signal=CAN2_FDC_BCM_Acc5Sta_Sta}, {implementation-record-element=CAN2_FDC_BCM_Acc4Sta_Sta, system-signal=CAN2_FDC_BCM_Acc4Sta_Sta}, {implementation-record-element=CAN2_FDC_BCM_Acc3Sta_Sta, system-signal=CAN2_FDC_BCM_Acc3Sta_Sta}, {implementation-record-element=CAN2_FDC_BCM_Acc2Sta_Sta, system-signal=CAN2_FDC_BCM_Acc2Sta_Sta}, {implementation-record-element=CAN2_FDC_BCM_Acc1Sta_Sta, system-signal=CAN2_FDC_BCM_Acc1Sta_Sta}, {implementation-record-element=CAN2_CWheelTips, system-signal=CAN2_CWheelTips}]}
      MAP_P_CAN2_FD2_Version: sender-receiver-to-signal-group-mapping{communication-direction=OUT, data-element=SWC_FDC.root_FDC.P_CAN2_FD2_Version.CAN2_SG_FD2_Version, signal-group=CAN2_SG_FD2_Version, type-mapping=sender-rec-record-type-mapping=record-element-mappings=[{implementation-record-element=CAN2_FUSION_HW_Ver1, system-signal=CAN2_FUSION_HW_Ver1}, {implementation-record-element=CAN2_FUSION_SW_dash2, system-signal=CAN2_FUSION_SW_dash2}, {implementation-record-element=CAN2_FUSION_SW_dash1, system-signal=CAN2_FUSION_SW_dash1}, {implementation-record-element=CAN2_FUSION_SW_change2, system-signal=CAN2_FUSION_SW_change2}, {implementation-record-element=CAN2_FUSION_SW_change1, system-signal=CAN2_FUSION_SW_change1}, {implementation-record-element=CAN2_FUSION_SW_Var5, system-signal=CAN2_FUSION_SW_Var5}, {implementation-record-element=CAN2_FUSION_SW_Var4, system-signal=CAN2_FUSION_SW_Var4}, {implementation-record-element=CAN2_FUSION_SW_Var3, system-signal=CAN2_FUSION_SW_Var3}, {implementation-record-element=CAN2_FUSION_SW_Var2, system-signal=CAN2_FUSION_SW_Var2}, {implementation-record-element=CAN2_FUSION_SW_Var1, system-signal=CAN2_FUSION_SW_Var1}, {implementation-record-element=CAN2_FUSION_SW_SHA8, system-signal=CAN2_FUSION_SW_SHA8}, {implementation-record-element=CAN2_FUSION_SW_SHA7, system-signal=CAN2_FUSION_SW_SHA7}, {implementation-record-element=CAN2_FUSION_SW_SHA6, system-signal=CAN2_FUSION_SW_SHA6}, {implementation-record-element=CAN2_FUSION_SW_SHA5, system-signal=CAN2_FUSION_SW_SHA5}, {implementation-record-element=CAN2_FUSION_SW_SHA4, system-signal=CAN2_FUSION_SW_SHA4}, {implementation-record-element=CAN2_FUSION_SW_SHA3, system-signal=CAN2_FUSION_SW_SHA3}, {implementation-record-element=CAN2_FUSION_SW_SHA2, system-signal=CAN2_FUSION_SW_SHA2}, {implementation-record-element=CAN2_FUSION_SW_SHA1, system-signal=CAN2_FUSION_SW_SHA1}, {implementation-record-element=CAN2_FUSION_SW_Patch2, system-signal=CAN2_FUSION_SW_Patch2}, {implementation-record-element=CAN2_FUSION_SW_Patch1, system-signal=CAN2_FUSION_SW_Patch1}, {implementation-record-element=CAN2_FUSION_SW_Minor2, system-signal=CAN2_FUSION_SW_Minor2}, {implementation-record-element=CAN2_FUSION_SW_Minor1, system-signal=CAN2_FUSION_SW_Minor1}, {implementation-record-element=CAN2_FUSION_SW_Major2, system-signal=CAN2_FUSION_SW_Major2}, {implementation-record-element=CAN2_FUSION_SW_Major1, system-signal=CAN2_FUSION_SW_Major1}, {implementation-record-element=CAN2_FUSION_SW_ECUGen2, system-signal=CAN2_FUSION_SW_ECUGen2}, {implementation-record-element=CAN2_FUSION_SW_ECUGen1, system-signal=CAN2_FUSION_SW_ECUGen1}, {implementation-record-element=CAN2_FUSION_SW_Country2, system-signal=CAN2_FUSION_SW_Country2}, {implementation-record-element=CAN2_FUSION_SW_Country1, system-signal=CAN2_FUSION_SW_Country1}, {implementation-record-element=CAN2_FUSION_SW_Controller2, system-signal=CAN2_FUSION_SW_Controller2}, {implementation-record-element=CAN2_FUSION_SW_Controller1, system-signal=CAN2_FUSION_SW_Controller1}, {implementation-record-element=CAN2_FUSION_SW_CarModel3, system-signal=CAN2_FUSION_SW_CarModel3}, {implementation-record-element=CAN2_FUSION_SW_CarModel2, system-signal=CAN2_FUSION_SW_CarModel2}, {implementation-record-element=CAN2_FUSION_SW_CarModel1, system-signal=CAN2_FUSION_SW_CarModel1}, {implementation-record-element=CAN2_FUSION_HW_Ver3, system-signal=CAN2_FUSION_HW_Ver3}, {implementation-record-element=CAN2_FUSION_HW_Ver2, system-signal=CAN2_FUSION_HW_Ver2}]}
      MAP_P_CAN2_GW2_C10_0: sender-receiver-to-signal-group-mapping{communication-direction=OUT, data-element=SWC_FDC.root_FDC.P_CAN2_GW2_C10_0.CAN2_SG_GW2_C10_0, signal-group=CAN2_SG_GW2_C10_0, type-mapping=sender-rec-record-type-mapping=record-element-mappings=[{implementation-record-element=CAN2_ABS_Active, system-signal=CAN2_ABS_Active}, {implementation-record-element=CAN2_VehSpeed, system-signal=CAN2_VehSpeed}, {implementation-record-element=CAN2_Red_WnlmpSta, system-signal=CAN2_Red_WnlmpSta}, {implementation-record-element=CAN2_Meter_Ind_VehSpeed, system-signal=CAN2_Meter_Ind_VehSpeed}, {implementation-record-element=CAN2_HSA_Failed, system-signal=CAN2_HSA_Failed}, {implementation-record-element=CAN2_HSA_Active, system-signal=CAN2_HSA_Active}, {implementation-record-element=CAN2_BrkSw_Sta, system-signal=CAN2_BrkSw_Sta}, {implementation-record-element=CAN2_Amber_WnlmpSta, system-signal=CAN2_Amber_WnlmpSta}, {implementation-record-element=CAN2_AVH_Failed, system-signal=CAN2_AVH_Failed}, {implementation-record-element=CAN2_ABS_WnlmpSta, system-signal=CAN2_ABS_WnlmpSta}, {implementation-record-element=CAN2_ABS_Failed, system-signal=CAN2_ABS_Failed}]}
      MAP_P_CAN3_FD3_BCM1: sender-receiver-to-signal-group-mapping{communication-direction=OUT, data-element=SWC_FDC.root_FDC.P_CAN3_FD3_BCM1.CAN3_SG_FD3_BCM1, signal-group=CAN3_SG_FD3_BCM1, type-mapping=sender-rec-record-type-mapping=record-element-mappings=[{implementation-record-element=CAN3_AllDoorSW, system-signal=CAN3_AllDoorSW}, {implementation-record-element=CAN3_WiperFixMode, system-signal=CAN3_WiperFixMode}, {implementation-record-element=CAN3_WasherCtrl, system-signal=CAN3_WasherCtrl}, {implementation-record-element=CAN3_TrunkRel, system-signal=CAN3_TrunkRel}, {implementation-record-element=CAN3_Tailgate_SW, system-signal=CAN3_Tailgate_SW}, {implementation-record-element=CAN3_TailgateRemote, system-signal=CAN3_TailgateRemote}, {implementation-record-element=CAN3_TailgateHDSW, system-signal=CAN3_TailgateHDSW}, {implementation-record-element=CAN3_Rr_Wiper, system-signal=CAN3_Rr_Wiper}, {implementation-record-element=CAN3_Rr_FogLamp, system-signal=CAN3_Rr_FogLamp}, {implementation-record-element=CAN3_Rr_Defog, system-signal=CAN3_Rr_Defog}, {implementation-record-element=CAN3_Rr_ChargingDoorCtrl, system-signal=CAN3_Rr_ChargingDoorCtrl}, {implementation-record-element=CAN3_RoomLampL, system-signal=CAN3_RoomLampL}, {implementation-record-element=CAN3_RoomLampH, system-signal=CAN3_RoomLampH}, {implementation-record-element=CAN3_ReverseLamp, system-signal=CAN3_ReverseLamp}, {implementation-record-element=CAN3_RTurnLP, system-signal=CAN3_RTurnLP}, {implementation-record-element=CAN3_RRDoorSW, system-signal=CAN3_RRDoorSW}, {implementation-record-element=CAN3_RLDoorSW, system-signal=CAN3_RLDoorSW}, {implementation-record-element=CAN3_RDRL, system-signal=CAN3_RDRL}, {implementation-record-element=CAN3_RBSD, system-signal=CAN3_RBSD}, {implementation-record-element=CAN3_PsDoorSW, system-signal=CAN3_PsDoorSW}, {implementation-record-element=CAN3_PosLamp, system-signal=CAN3_PosLamp}, {implementation-record-element=CAN3_MirrorDefog, system-signal=CAN3_MirrorDefog}, {implementation-record-element=CAN3_MirrorCtrl, system-signal=CAN3_MirrorCtrl}, {implementation-record-element=CAN3_LockSetting, system-signal=CAN3_LockSetting}, {implementation-record-element=CAN3_L_Beam, system-signal=CAN3_L_Beam}, {implementation-record-element=CAN3_L_APM_WdwEnable, system-signal=CAN3_L_APM_WdwEnable}, {implementation-record-element=CAN3_LTurnLP, system-signal=CAN3_LTurnLP}, {implementation-record-element=CAN3_LDRL, system-signal=CAN3_LDRL}, {implementation-record-element=CAN3_LBSD, system-signal=CAN3_LBSD}, {implementation-record-element=CAN3_HornCtrl, system-signal=CAN3_HornCtrl}, {implementation-record-element=CAN3_HoodSW, system-signal=CAN3_HoodSW}, {implementation-record-element=CAN3_HazardSW, system-signal=CAN3_HazardSW}, {implementation-record-element=CAN3_H_Beam, system-signal=CAN3_H_Beam}, {implementation-record-element=CAN3_Fr_Wiper_L, system-signal=CAN3_Fr_Wiper_L}, {implementation-record-element=CAN3_Fr_Wiper_H, system-signal=CAN3_Fr_Wiper_H}, {implementation-record-element=CAN3_Fr_FogLamp, system-signal=CAN3_Fr_FogLamp}, {implementation-record-element=CAN3_Fr_ChargingDoorCtrl, system-signal=CAN3_Fr_ChargingDoorCtrl}, {implementation-record-element=CAN3_DrDoorSW, system-signal=CAN3_DrDoorSW}, {implementation-record-element=CAN3_DoorLockIND, system-signal=CAN3_DoorLockIND}, {implementation-record-element=CAN3_DimmerEN, system-signal=CAN3_DimmerEN}, {implementation-record-element=CAN3_Dimmer, system-signal=CAN3_Dimmer}, {implementation-record-element=CAN3_CrashDetd, system-signal=CAN3_CrashDetd}, {implementation-record-element=CAN3_CTDUnlockSW, system-signal=CAN3_CTDUnlockSW}, {implementation-record-element=CAN3_CTDLockSW, system-signal=CAN3_CTDLockSW}, {implementation-record-element=CAN3_CTDCtrl, system-signal=CAN3_CTDCtrl}, {implementation-record-element=CAN3_BrakeLamp, system-signal=CAN3_BrakeLamp}, {implementation-record-element=CAN3_BCM_DoorLock_Sta, system-signal=CAN3_BCM_DoorLock_Sta}, {implementation-record-element=CAN3_BCM_Buzzer_Req, system-signal=CAN3_BCM_Buzzer_Req}, {implementation-record-element=CAN3_AntitheftSta, system-signal=CAN3_AntitheftSta}, {implementation-record-element=CAN3_AntiTheftSeatFold, system-signal=CAN3_AntiTheftSeatFold}]}
      MAP_P_CAN3_FD3_THCM1: sender-receiver-to-signal-group-mapping{communication-direction=OUT, data-element=SWC_FDC.root_FDC.P_CAN3_FD3_THCM1.CAN3_SG_FD3_THCM1, signal-group=CAN3_SG_FD3_THCM1, type-mapping=sender-rec-record-type-mapping=record-element-mappings=[{implementation-record-element=CAN3_BatteryMode, system-signal=CAN3_BatteryMode}, {implementation-record-element=CAN3_sigWindDirZon3St, system-signal=CAN3_sigWindDirZon3St}, {implementation-record-element=CAN3_sigWindDirZon1St, system-signal=CAN3_sigWindDirZon1St}, {implementation-record-element=CAN3_sigSetTempZon3St, system-signal=CAN3_sigSetTempZon3St}, {implementation-record-element=CAN3_sigSetTempZon2St, system-signal=CAN3_sigSetTempZon2St}, {implementation-record-element=CAN3_sigSetTempZon1St, system-signal=CAN3_sigSetTempZon1St}, {implementation-record-element=CAN3_sigRecircSt, system-signal=CAN3_sigRecircSt}, {implementation-record-element=CAN3_sigHvacSt, system-signal=CAN3_sigHvacSt}, {implementation-record-element=CAN3_sigDfrstSt, system-signal=CAN3_sigDfrstSt}, {implementation-record-element=CAN3_sigClntTHvBattOut, system-signal=CAN3_sigClntTHvBattOut}, {implementation-record-element=CAN3_sigClmtCmprPwrAct, system-signal=CAN3_sigClmtCmprPwrAct}, {implementation-record-element=CAN3_sigCbnSolarRight, system-signal=CAN3_sigCbnSolarRight}, {implementation-record-element=CAN3_sigCbnSolarLeft, system-signal=CAN3_sigCbnSolarLeft}, {implementation-record-element=CAN3_sigCbnPTCPwrAct, system-signal=CAN3_sigCbnPTCPwrAct}, {implementation-record-element=CAN3_sigCbnAirT, system-signal=CAN3_sigCbnAirT}, {implementation-record-element=CAN3_sigAmbAirT, system-signal=CAN3_sigAmbAirT}, {implementation-record-element=CAN3_sigAirIntenZon3St, system-signal=CAN3_sigAirIntenZon3St}, {implementation-record-element=CAN3_sigAirIntenZon1St, system-signal=CAN3_sigAirIntenZon1St}, {implementation-record-element=CAN3_Rr_Coolanttemp, system-signal=CAN3_Rr_Coolanttemp}, {implementation-record-element=CAN3_Rr_Coolantflow, system-signal=CAN3_Rr_Coolantflow}, {implementation-record-element=CAN3_HPThermalRecoveryReq, system-signal=CAN3_HPThermalRecoveryReq}, {implementation-record-element=CAN3_Fr_Coolanttemp, system-signal=CAN3_Fr_Coolanttemp}, {implementation-record-element=CAN3_Fr_Coolantflow, system-signal=CAN3_Fr_Coolantflow}, {implementation-record-element=CAN3_FD_RecyAuto_Cmd, system-signal=CAN3_FD_RecyAuto_Cmd}, {implementation-record-element=CAN3_FD_AGS_Cmd, system-signal=CAN3_FD_AGS_Cmd}, {implementation-record-element=CAN3_EDriveMode, system-signal=CAN3_EDriveMode}, {implementation-record-element=CAN3_CabinMode, system-signal=CAN3_CabinMode}, {implementation-record-element=CAN3_CCU_SyncLampSts, system-signal=CAN3_CCU_SyncLampSts}, {implementation-record-element=CAN3_CCU_RrOnOffLampSts, system-signal=CAN3_CCU_RrOnOffLampSts}, {implementation-record-element=CAN3_CCU_HEATMaxLampSts, system-signal=CAN3_CCU_HEATMaxLampSts}, {implementation-record-element=CAN3_CCU_FrtOnOffLampSts, system-signal=CAN3_CCU_FrtOnOffLampSts}, {implementation-record-element=CAN3_CCU_EcoSts, system-signal=CAN3_CCU_EcoSts}, {implementation-record-element=CAN3_CCU_Dispaly_Request, system-signal=CAN3_CCU_Dispaly_Request}, {implementation-record-element=CAN3_CCU_AutoMidLampSts, system-signal=CAN3_CCU_AutoMidLampSts}, {implementation-record-element=CAN3_CCU_AutoLampSts, system-signal=CAN3_CCU_AutoLampSts}, {implementation-record-element=CAN3_CCU_ACMaxLampSts, system-signal=CAN3_CCU_ACMaxLampSts}, {implementation-record-element=CAN3_CCU_ACLampSts, system-signal=CAN3_CCU_ACLampSts}]}
      MAP_P_CAN3_FD3_THCM2: sender-receiver-to-signal-group-mapping{communication-direction=OUT, data-element=SWC_FDC.root_FDC.P_CAN3_FD3_THCM2.CAN3_SG_FD3_THCM2, signal-group=CAN3_SG_FD3_THCM2, type-mapping=sender-rec-record-type-mapping=record-element-mappings=[{implementation-record-element=CAN3_ACSubMode, system-signal=CAN3_ACSubMode}, {implementation-record-element=CAN3_FD_TWV_Cmd, system-signal=CAN3_FD_TWV_Cmd}, {implementation-record-element=CAN3_FD_SOV3_Cmd, system-signal=CAN3_FD_SOV3_Cmd}, {implementation-record-element=CAN3_FD_SOV2_Cmd, system-signal=CAN3_FD_SOV2_Cmd}, {implementation-record-element=CAN3_FD_SOV1_Cmd, system-signal=CAN3_FD_SOV1_Cmd}, {implementation-record-element=CAN3_FD_SOTXV_Cmd, system-signal=CAN3_FD_SOTXV_Cmd}, {implementation-record-element=CAN3_FD_RrAPTCHeatPwr_Cmd, system-signal=CAN3_FD_RrAPTCHeatPwr_Cmd}, {implementation-record-element=CAN3_FD_FrWPTCHeatPwr_Cmd, system-signal=CAN3_FD_FrWPTCHeatPwr_Cmd}, {implementation-record-element=CAN3_FD_FrRiAPTCHeatPwr_Cmd, system-signal=CAN3_FD_FrRiAPTCHeatPwr_Cmd}, {implementation-record-element=CAN3_FD_FrLeAPTCHeatPwr_Cmd, system-signal=CAN3_FD_FrLeAPTCHeatPwr_Cmd}, {implementation-record-element=CAN3_FD_FWV_Cmd, system-signal=CAN3_FD_FWV_Cmd}, {implementation-record-element=CAN3_FD_EXV2_Cmd, system-signal=CAN3_FD_EXV2_Cmd}, {implementation-record-element=CAN3_FD_EXV1_Cmd, system-signal=CAN3_FD_EXV1_Cmd}, {implementation-record-element=CAN3_FD_EWP3_Cmd, system-signal=CAN3_FD_EWP3_Cmd}, {implementation-record-element=CAN3_FD_EWP2_Cmd, system-signal=CAN3_FD_EWP2_Cmd}, {implementation-record-element=CAN3_FD_EWP1_Cmd, system-signal=CAN3_FD_EWP1_Cmd}, {implementation-record-element=CAN3_FD_Comp_Cmd, system-signal=CAN3_FD_Comp_Cmd}, {implementation-record-element=CAN3_FD_Blower_Cmd, system-signal=CAN3_FD_Blower_Cmd}, {implementation-record-element=CAN3_DeiceModReq, system-signal=CAN3_DeiceModReq}, {implementation-record-element=CAN3_CoolgFanActDuty, system-signal=CAN3_CoolgFanActDuty}, {implementation-record-element=CAN3_CCU_HiVoltageReq, system-signal=CAN3_CCU_HiVoltageReq}, {implementation-record-element=CAN3_CCU_CbnPreSts, system-signal=CAN3_CCU_CbnPreSts}, {implementation-record-element=CAN3_CCU_CbnPreEstimdTi, system-signal=CAN3_CCU_CbnPreEstimdTi}, {implementation-record-element=CAN3_CCU_CbnPreACWkSts, system-signal=CAN3_CCU_CbnPreACWkSts}, {implementation-record-element=CAN3_BatLoopActWtFlw, system-signal=CAN3_BatLoopActWtFlw}, {implementation-record-element=CAN3_APTC_ActFrRiPwr, system-signal=CAN3_APTC_ActFrRiPwr}]}
      MAP_P_CAN3_FD3_V2L1: sender-receiver-to-signal-group-mapping{communication-direction=OUT, data-element=SWC_FDC.root_FDC.P_CAN3_FD3_V2L1.CAN3_SG_FD3_V2L1, signal-group=CAN3_SG_FD3_V2L1, type-mapping=sender-rec-record-type-mapping=record-element-mappings=[{implementation-record-element=CAN3_Req_OBCV2LEna, system-signal=CAN3_Req_OBCV2LEna}, {implementation-record-element=CAN3_Req_V2L_IVI_Popup, system-signal=CAN3_Req_V2L_IVI_Popup}, {implementation-record-element=CAN3_Req_V2LSwOn, system-signal=CAN3_Req_V2LSwOn}]}
      MAP_P_CAN3_FD3_VCU0: sender-receiver-to-signal-group-mapping{communication-direction=OUT, data-element=SWC_FDC.root_FDC.P_CAN3_FD3_VCU0.CAN3_SG_FD3_VCU0, signal-group=CAN3_SG_FD3_VCU0, type-mapping=sender-rec-record-type-mapping=record-element-mappings=[{implementation-record-element=CAN3_EVCCAplusPwrUpReq, system-signal=CAN3_EVCCAplusPwrUpReq}, {implementation-record-element=CAN3_WisrBootReason, system-signal=CAN3_WisrBootReason}, {implementation-record-element=CAN3_VehHVPwrAvail4THCM, system-signal=CAN3_VehHVPwrAvail4THCM}, {implementation-record-element=CAN3_VCURRDoorSta, system-signal=CAN3_VCURRDoorSta}, {implementation-record-element=CAN3_VCURLDoorSta, system-signal=CAN3_VCURLDoorSta}, {implementation-record-element=CAN3_VCUFRDoorSta, system-signal=CAN3_VCUFRDoorSta}, {implementation-record-element=CAN3_VCUFLDoorSta, system-signal=CAN3_VCUFLDoorSta}, {implementation-record-element=CAN3_VCUBrkSWSta, system-signal=CAN3_VCUBrkSWSta}, {implementation-record-element=CAN3_TimerAllowSleep, system-signal=CAN3_TimerAllowSleep}, {implementation-record-element=CAN3_TCountSta, system-signal=CAN3_TCountSta}, {implementation-record-element=CAN3_SysPwrSta, system-signal=CAN3_SysPwrSta}, {implementation-record-element=CAN3_SysAllowReadySta, system-signal=CAN3_SysAllowReadySta}, {implementation-record-element=CAN3_SilentChkAllowSleep, system-signal=CAN3_SilentChkAllowSleep}, {implementation-record-element=CAN3_SchedChgTOSta, system-signal=CAN3_SchedChgTOSta}, {implementation-record-element=CAN3_Rr_TqSource, system-signal=CAN3_Rr_TqSource}, {implementation-record-element=CAN3_PwrUpReq, system-signal=CAN3_PwrUpReq}, {implementation-record-element=CAN3_PwrStaTOSta, system-signal=CAN3_PwrStaTOSta}, {implementation-record-element=CAN3_PwrStaSelect, system-signal=CAN3_PwrStaSelect}, {implementation-record-element=CAN3_PwrStaONTOIVIPopT, system-signal=CAN3_PwrStaONTOIVIPopT}, {implementation-record-element=CAN3_PwrStaONTOIVIPopReq, system-signal=CAN3_PwrStaONTOIVIPopReq}, {implementation-record-element=CAN3_PwrStaConstraint, system-signal=CAN3_PwrStaConstraint}, {implementation-record-element=CAN3_PwrDownReq, system-signal=CAN3_PwrDownReq}, {implementation-record-element=CAN3_PowerUpState, system-signal=CAN3_PowerUpState}, {implementation-record-element=CAN3_PowerUpFault, system-signal=CAN3_PowerUpFault}, {implementation-record-element=CAN3_PowerDownState, system-signal=CAN3_PowerDownState}, {implementation-record-element=CAN3_PowerDownFault, system-signal=CAN3_PowerDownFault}, {implementation-record-element=CAN3_PmicBootReason, system-signal=CAN3_PmicBootReason}, {implementation-record-element=CAN3_PMMAllowECUSleep, system-signal=CAN3_PMMAllowECUSleep}, {implementation-record-element=CAN3_MCUActDisFail, system-signal=CAN3_MCUActDisFail}, {implementation-record-element=CAN3_LVSilentChrgSta, system-signal=CAN3_LVSilentChrgSta}, {implementation-record-element=CAN3_LVSilentChrgReq, system-signal=CAN3_LVSilentChrgReq}, {implementation-record-element=CAN3_LVSilentChrgLv, system-signal=CAN3_LVSilentChrgLv}, {implementation-record-element=CAN3_LVChrgHoldTAct, system-signal=CAN3_LVChrgHoldTAct}, {implementation-record-element=CAN3_LVBattVoltSta, system-signal=CAN3_LVBattVoltSta}, {implementation-record-element=CAN3_LVBattChrgtimeAct, system-signal=CAN3_LVBattChrgtimeAct}, {implementation-record-element=CAN3_HVTHCMSysAvail, system-signal=CAN3_HVTHCMSysAvail}, {implementation-record-element=CAN3_HVRlyOpFail, system-signal=CAN3_HVRlyOpFail}, {implementation-record-element=CAN3_Fr_TqSource, system-signal=CAN3_Fr_TqSource}, {implementation-record-element=CAN3_FUSION_CMM9, system-signal=CAN3_FUSION_CMM9}, {implementation-record-element=CAN3_FUSION_CMM8, system-signal=CAN3_FUSION_CMM8}, {implementation-record-element=CAN3_FUSION_CMM7, system-signal=CAN3_FUSION_CMM7}, {implementation-record-element=CAN3_FUSION_CMM6, system-signal=CAN3_FUSION_CMM6}, {implementation-record-element=CAN3_FUSION_CMM5, system-signal=CAN3_FUSION_CMM5}, {implementation-record-element=CAN3_FUSION_CMM4, system-signal=CAN3_FUSION_CMM4}, {implementation-record-element=CAN3_FUSION_CMM3, system-signal=CAN3_FUSION_CMM3}, {implementation-record-element=CAN3_FUSION_CMM2, system-signal=CAN3_FUSION_CMM2}, {implementation-record-element=CAN3_FUSION_CMM10, system-signal=CAN3_FUSION_CMM10}, {implementation-record-element=CAN3_FUSION_CMM1, system-signal=CAN3_FUSION_CMM1}, {implementation-record-element=CAN3_FDC_VMC_LongAcc_Sta, system-signal=CAN3_FDC_VMC_LongAcc_Sta}, {implementation-record-element=CAN3_FDC_VMC_ActStESCYaw_Sta, system-signal=CAN3_FDC_VMC_ActStESCYaw_Sta}, {implementation-record-element=CAN3_FDC_VCU_VehMalfunLevel_Sta, system-signal=CAN3_FDC_VCU_VehMalfunLevel_Sta}, {implementation-record-element=CAN3_FDC_VCU_VehActSpd_Sta, system-signal=CAN3_FDC_VCU_VehActSpd_Sta}, {implementation-record-element=CAN3_FDC_VCU_SlideRegenLimTq_Sta, system-signal=CAN3_FDC_VCU_SlideRegenLimTq_Sta}, {implementation-record-element=CAN3_FDC_VCU_RegenTqLimitEn_Sta, system-signal=CAN3_FDC_VCU_RegenTqLimitEn_Sta}, {implementation-record-element=CAN3_FDC_VCU_RWDRDCActive_Sta, system-signal=CAN3_FDC_VCU_RWDRDCActive_Sta}, {implementation-record-element=CAN3_FDC_VCU_PwrReq_OTA_Sta, system-signal=CAN3_FDC_VCU_PwrReq_OTA_Sta}, {implementation-record-element=CAN3_FDC_VCU_OTAPwrReqStdChk_Sta, system-signal=CAN3_FDC_VCU_OTAPwrReqStdChk_Sta}, {implementation-record-element=CAN3_FDC_VCU_OTAPwrReqOFFChk_Sta, system-signal=CAN3_FDC_VCU_OTAPwrReqOFFChk_Sta}, {implementation-record-element=CAN3_FDC_VCU_ForceP_Cmd, system-signal=CAN3_FDC_VCU_ForceP_Cmd}, {implementation-record-element=CAN3_FDC_VCU_DTCCarousel_Sta, system-signal=CAN3_FDC_VCU_DTCCarousel_Sta}, {implementation-record-element=CAN3_FDC_VCU_AllowMovThd_OTA_Sta, system-signal=CAN3_FDC_VCU_AllowMovThd_OTA_Sta}, {implementation-record-element=CAN3_FDC_VCU_ActMaxSlideRate_Sta, system-signal=CAN3_FDC_VCU_ActMaxSlideRate_Sta}, {implementation-record-element=CAN3_FDADC12VDetAvg, system-signal=CAN3_FDADC12VDetAvg}, {implementation-record-element=CAN3_FDADC12VDet, system-signal=CAN3_FDADC12VDet}]}
      MAP_P_CAN3_FD3_VCU1: sender-receiver-to-signal-group-mapping{communication-direction=OUT, data-element=SWC_FDC.root_FDC.P_CAN3_FD3_VCU1.CAN3_SG_FD3_VCU1, signal-group=CAN3_SG_FD3_VCU1, type-mapping=sender-rec-record-type-mapping=record-element-mappings=[{implementation-record-element=CAN3_ActiveDischReq, system-signal=CAN3_ActiveDischReq}, {implementation-record-element=CAN3_ShiftGearPosn, system-signal=CAN3_ShiftGearPosn}, {implementation-record-element=CAN3_RC_VCU1, system-signal=CAN3_RC_VCU1}, {implementation-record-element=CAN3_PwrSta, system-signal=CAN3_PwrSta}, {implementation-record-element=CAN3_PrkReqValid, system-signal=CAN3_PrkReqValid}, {implementation-record-element=CAN3_PrkReq, system-signal=CAN3_PrkReq}, {implementation-record-element=CAN3_P_Button_Sta, system-signal=CAN3_P_Button_Sta}, {implementation-record-element=CAN3_MSA_Crl_Sta, system-signal=CAN3_MSA_Crl_Sta}, {implementation-record-element=CAN3_LVChrgFuncStaChk, system-signal=CAN3_LVChrgFuncStaChk}, {implementation-record-element=CAN3_HVSysReadyToCharge, system-signal=CAN3_HVSysReadyToCharge}, {implementation-record-element=CAN3_HVBatCnctReq, system-signal=CAN3_HVBatCnctReq}, {implementation-record-element=CAN3_DynoModeStaChk, system-signal=CAN3_DynoModeStaChk}, {implementation-record-element=CAN3_Dr_SeatSta, system-signal=CAN3_Dr_SeatSta}, {implementation-record-element=CAN3_DemoModeStaChk, system-signal=CAN3_DemoModeStaChk}, {implementation-record-element=CAN3_DCDCVoltSetpoint, system-signal=CAN3_DCDCVoltSetpoint}, {implementation-record-element=CAN3_DCDCEnaReq, system-signal=CAN3_DCDCEnaReq}, {implementation-record-element=CAN3_CoastDwModeStaChk, system-signal=CAN3_CoastDwModeStaChk}, {implementation-record-element=CAN3_CS_VCU1, system-signal=CAN3_CS_VCU1}]}
      MAP_P_CAN3_FD3_VCU1_toNIDEC: sender-receiver-to-signal-group-mapping{communication-direction=OUT, data-element=SWC_FDC.root_FDC.P_CAN3_FD3_VCU1_toNIDEC.CAN3_SG_FD3_VCU1_toNIDEC, signal-group=CAN3_SG_FD3_VCU1_toNIDEC, type-mapping=sender-rec-record-type-mapping=record-element-mappings=[{implementation-record-element=CAN3_ActiveDischReq_toNidec, system-signal=CAN3_ActiveDischReq_toNidec}, {implementation-record-element=CAN3_ShiftGearPosn_toNidec, system-signal=CAN3_ShiftGearPosn_toNidec}, {implementation-record-element=CAN3_Rr_MCUEnaReq_toNidec, system-signal=CAN3_Rr_MCUEnaReq_toNidec}, {implementation-record-element=CAN3_Rr_ActvDmpDisabReq_toNidec, system-signal=CAN3_Rr_ActvDmpDisabReq_toNidec}, {implementation-record-element=CAN3_RC_VCU1_toNidec, system-signal=CAN3_RC_VCU1_toNidec}, {implementation-record-element=CAN3_PwrSta_toNidec, system-signal=CAN3_PwrSta_toNidec}, {implementation-record-element=CAN3_PrkReq_toNidec, system-signal=CAN3_PrkReq_toNidec}, {implementation-record-element=CAN3_MSA_Crl_Sta_toNidec, system-signal=CAN3_MSA_Crl_Sta_toNidec}, {implementation-record-element=CAN3_LVChrgFuncStaChk_toNidec, system-signal=CAN3_LVChrgFuncStaChk_toNidec}, {implementation-record-element=CAN3_HVSysReadyToCharge_toNidec, system-signal=CAN3_HVSysReadyToCharge_toNidec}, {implementation-record-element=CAN3_HVBatCnctReq_toNidec, system-signal=CAN3_HVBatCnctReq_toNidec}, {implementation-record-element=CAN3_Fr_MCUEnaReq_toNidec, system-signal=CAN3_Fr_MCUEnaReq_toNidec}, {implementation-record-element=CAN3_Fr_ActvDmpDisabReq_toNidec, system-signal=CAN3_Fr_ActvDmpDisabReq_toNidec}, {implementation-record-element=CAN3_DynoModeStaChk_toNidec, system-signal=CAN3_DynoModeStaChk_toNidec}, {implementation-record-element=CAN3_Dr_SeatSta_toNidec, system-signal=CAN3_Dr_SeatSta_toNidec}, {implementation-record-element=CAN3_DemoModeStaChk_toNidec, system-signal=CAN3_DemoModeStaChk_toNidec}, {implementation-record-element=CAN3_DCDCVoltSetpoint_toNidec, system-signal=CAN3_DCDCVoltSetpoint_toNidec}, {implementation-record-element=CAN3_DCDCEnaReq_toNidec, system-signal=CAN3_DCDCEnaReq_toNidec}, {implementation-record-element=CAN3_CoastDwModeStaChk_toNidec, system-signal=CAN3_CoastDwModeStaChk_toNidec}, {implementation-record-element=CAN3_CS_VCU1_toNidec, system-signal=CAN3_CS_VCU1_toNidec}]}
      MAP_P_CAN3_FD3_VCU2: sender-receiver-to-signal-group-mapping{communication-direction=OUT, data-element=SWC_FDC.root_FDC.P_CAN3_FD3_VCU2.CAN3_SG_FD3_VCU2, signal-group=CAN3_SG_FD3_VCU2, type-mapping=sender-rec-record-type-mapping=record-element-mappings=[{implementation-record-element=CAN3_CS_VCU2_CAN1, system-signal=CAN3_CS_VCU2_CAN1}, {implementation-record-element=CAN3_Rr_UdcMin, system-signal=CAN3_Rr_UdcMin}, {implementation-record-element=CAN3_Rr_UdcMax, system-signal=CAN3_Rr_UdcMax}, {implementation-record-element=CAN3_Rr_TorqMin, system-signal=CAN3_Rr_TorqMin}, {implementation-record-element=CAN3_Rr_TorqMax, system-signal=CAN3_Rr_TorqMax}, {implementation-record-element=CAN3_Rr_TMTqReq, system-signal=CAN3_Rr_TMTqReq}, {implementation-record-element=CAN3_Rr_MCUEnaReq, system-signal=CAN3_Rr_MCUEnaReq}, {implementation-record-element=CAN3_Rr_IdcMin, system-signal=CAN3_Rr_IdcMin}, {implementation-record-element=CAN3_Rr_IdcMax, system-signal=CAN3_Rr_IdcMax}, {implementation-record-element=CAN3_Rr_ActvDmpDisabReq, system-signal=CAN3_Rr_ActvDmpDisabReq}, {implementation-record-element=CAN3_RC_VCU2_CAN1, system-signal=CAN3_RC_VCU2_CAN1}]}
      MAP_P_CAN3_FD3_VCU2_toNIDEC: sender-receiver-to-signal-group-mapping{communication-direction=OUT, data-element=SWC_FDC.root_FDC.P_CAN3_FD3_VCU2_toNIDEC.CAN3_SG_FD3_VCU2_toNIDEC, signal-group=CAN3_SG_FD3_VCU2_toNIDEC, type-mapping=sender-rec-record-type-mapping=record-element-mappings=[{implementation-record-element=CAN3_CS_VCU2_CAN1_toNidec, system-signal=CAN3_CS_VCU2_CAN1_toNidec}, {implementation-record-element=CAN3_Rr_UdcMin_toNidec, system-signal=CAN3_Rr_UdcMin_toNidec}, {implementation-record-element=CAN3_Rr_UdcMax_toNidec, system-signal=CAN3_Rr_UdcMax_toNidec}, {implementation-record-element=CAN3_Rr_TorqMin_toNidec, system-signal=CAN3_Rr_TorqMin_toNidec}, {implementation-record-element=CAN3_Rr_TorqMax_toNidec, system-signal=CAN3_Rr_TorqMax_toNidec}, {implementation-record-element=CAN3_Rr_TMTqReq_toNidec, system-signal=CAN3_Rr_TMTqReq_toNidec}, {implementation-record-element=CAN3_Rr_IdcMin_toNidec, system-signal=CAN3_Rr_IdcMin_toNidec}, {implementation-record-element=CAN3_Rr_IdcMax_toNidec, system-signal=CAN3_Rr_IdcMax_toNidec}, {implementation-record-element=CAN3_RC_VCU2_CAN1_toNidec, system-signal=CAN3_RC_VCU2_CAN1_toNidec}, {implementation-record-element=CAN3_Fr_UdcMin_toNidec, system-signal=CAN3_Fr_UdcMin_toNidec}, {implementation-record-element=CAN3_Fr_UdcMax_toNidec, system-signal=CAN3_Fr_UdcMax_toNidec}, {implementation-record-element=CAN3_Fr_TorqMin_toNidec, system-signal=CAN3_Fr_TorqMin_toNidec}, {implementation-record-element=CAN3_Fr_TorqMax_toNidec, system-signal=CAN3_Fr_TorqMax_toNidec}, {implementation-record-element=CAN3_Fr_TMTqReq_toNidec, system-signal=CAN3_Fr_TMTqReq_toNidec}, {implementation-record-element=CAN3_Fr_IdcMin_toNidec, system-signal=CAN3_Fr_IdcMin_toNidec}, {implementation-record-element=CAN3_Fr_IdcMax_toNidec, system-signal=CAN3_Fr_IdcMax_toNidec}]}
      MAP_P_CAN3_FD3_VCU5: sender-receiver-to-signal-group-mapping{communication-direction=OUT, data-element=SWC_FDC.root_FDC.P_CAN3_FD3_VCU5.CAN3_SG_FD3_VCU5, signal-group=CAN3_SG_FD3_VCU5, type-mapping=sender-rec-record-type-mapping=record-element-mappings=[{implementation-record-element=CAN3_ActAPSPosn, system-signal=CAN3_ActAPSPosn}, {implementation-record-element=CAN3_Rr_EDUSpdValid, system-signal=CAN3_Rr_EDUSpdValid}, {implementation-record-element=CAN3_Rr_EDUSpd, system-signal=CAN3_Rr_EDUSpd}, {implementation-record-element=CAN3_Fr_EDUSpdValid, system-signal=CAN3_Fr_EDUSpdValid}, {implementation-record-element=CAN3_Fr_EDUSpd, system-signal=CAN3_Fr_EDUSpd}]}
      MAP_P_CAN3_GW3_CE100_0: sender-receiver-to-signal-group-mapping{communication-direction=OUT, data-element=SWC_FDC.root_FDC.P_CAN3_GW3_CE100_0.CAN3_SG_GW3_CE100_0, signal-group=CAN3_SG_GW3_CE100_0, type-mapping=sender-rec-record-type-mapping=record-element-mappings=[{implementation-record-element=CAN3_CrashOutputSts, system-signal=CAN3_CrashOutputSts}, {implementation-record-element=CAN3_VehSpeed, system-signal=CAN3_VehSpeed}, {implementation-record-element=CAN3_DriverSeatBeltCmd, system-signal=CAN3_DriverSeatBeltCmd}]}
      MAP_P_CAN4_FD4_C100_0: sender-receiver-to-signal-group-mapping{communication-direction=OUT, data-element=SWC_FDC.root_FDC.P_CAN4_FD4_C100_0.CAN4_SG_FD4_C100_0, signal-group=CAN4_SG_FD4_C100_0, type-mapping=sender-rec-record-type-mapping=sender-rec-record-element-mapping{implementation-record-element=CAN4_FDC_CHA_EACEnDemand_Cmd, system-signal=CAN4_FDC_CHA_EACEnDemand_Cmd}}
      MAP_P_CAN4_FD4_CE100_0: sender-receiver-to-signal-group-mapping{communication-direction=OUT, data-element=SWC_FDC.root_FDC.P_CAN4_FD4_CE100_0.CAN4_SG_FD4_CE100_0, signal-group=CAN4_SG_FD4_CE100_0, type-mapping=sender-rec-record-type-mapping=record-element-mappings=[{implementation-record-element=CAN4_APS_Sta_System, system-signal=CAN4_APS_Sta_System}, {implementation-record-element=CAN4_WiperFixMode, system-signal=CAN4_WiperFixMode}, {implementation-record-element=CAN4_WasherCtrl, system-signal=CAN4_WasherCtrl}, {implementation-record-element=CAN4_TrunkRel, system-signal=CAN4_TrunkRel}, {implementation-record-element=CAN4_TimeSNDKCFbk, system-signal=CAN4_TimeSNDKCFbk}, {implementation-record-element=CAN4_Tailgate_SW, system-signal=CAN4_Tailgate_SW}, {implementation-record-element=CAN4_TailgateRemote, system-signal=CAN4_TailgateRemote}, {implementation-record-element=CAN4_TailgateHDSW, system-signal=CAN4_TailgateHDSW}, {implementation-record-element=CAN4_ShiftGearPosn, system-signal=CAN4_ShiftGearPosn}, {implementation-record-element=CAN4_Rr_Wiper, system-signal=CAN4_Rr_Wiper}, {implementation-record-element=CAN4_Rr_FogLamp, system-signal=CAN4_Rr_FogLamp}, {implementation-record-element=CAN4_Rr_Defog, system-signal=CAN4_Rr_Defog}, {implementation-record-element=CAN4_Rr_ChargingDoorCtrl, system-signal=CAN4_Rr_ChargingDoorCtrl}, {implementation-record-element=CAN4_RoomLampL, system-signal=CAN4_RoomLampL}, {implementation-record-element=CAN4_RoomLampH, system-signal=CAN4_RoomLampH}, {implementation-record-element=CAN4_ReverseLamp, system-signal=CAN4_ReverseLamp}, {implementation-record-element=CAN4_ReBrakeLPReq, system-signal=CAN4_ReBrakeLPReq}, {implementation-record-element=CAN4_RTurnLP, system-signal=CAN4_RTurnLP}, {implementation-record-element=CAN4_RRDoorSW, system-signal=CAN4_RRDoorSW}, {implementation-record-element=CAN4_RLDoorSW, system-signal=CAN4_RLDoorSW}, {implementation-record-element=CAN4_RDRL, system-signal=CAN4_RDRL}, {implementation-record-element=CAN4_RC_VCU1_CAN4, system-signal=CAN4_RC_VCU1_CAN4}, {implementation-record-element=CAN4_RBSD, system-signal=CAN4_RBSD}, {implementation-record-element=CAN4_PwrSta, system-signal=CAN4_PwrSta}, {implementation-record-element=CAN4_PsDoorSW, system-signal=CAN4_PsDoorSW}, {implementation-record-element=CAN4_PosLamp, system-signal=CAN4_PosLamp}, {implementation-record-element=CAN4_MirrorDefog, system-signal=CAN4_MirrorDefog}, {implementation-record-element=CAN4_MirrorCtrl, system-signal=CAN4_MirrorCtrl}, {implementation-record-element=CAN4_MSA_Crl_Sta, system-signal=CAN4_MSA_Crl_Sta}, {implementation-record-element=CAN4_LockSetting, system-signal=CAN4_LockSetting}, {implementation-record-element=CAN4_LampPwr, system-signal=CAN4_LampPwr}, {implementation-record-element=CAN4_L_Beam, system-signal=CAN4_L_Beam}, {implementation-record-element=CAN4_L_APM_WdwEnable, system-signal=CAN4_L_APM_WdwEnable}, {implementation-record-element=CAN4_LTurnLP, system-signal=CAN4_LTurnLP}, {implementation-record-element=CAN4_LDRL, system-signal=CAN4_LDRL}, {implementation-record-element=CAN4_LBSD, system-signal=CAN4_LBSD}, {implementation-record-element=CAN4_HornCtrl, system-signal=CAN4_HornCtrl}, {implementation-record-element=CAN4_HoodSW, system-signal=CAN4_HoodSW}, {implementation-record-element=CAN4_HazardSW, system-signal=CAN4_HazardSW}, {implementation-record-element=CAN4_H_Beam_ADB, system-signal=CAN4_H_Beam_ADB}, {implementation-record-element=CAN4_H_Beam, system-signal=CAN4_H_Beam}, {implementation-record-element=CAN4_HWResetSta, system-signal=CAN4_HWResetSta}, {implementation-record-element=CAN4_Fr_Wiper_L, system-signal=CAN4_Fr_Wiper_L}, {implementation-record-element=CAN4_Fr_Wiper_H, system-signal=CAN4_Fr_Wiper_H}, {implementation-record-element=CAN4_Fr_FogLamp, system-signal=CAN4_Fr_FogLamp}, {implementation-record-element=CAN4_Fr_ChargingDoorCtrl, system-signal=CAN4_Fr_ChargingDoorCtrl}, {implementation-record-element=CAN4_FD_TBOX_VehData_Sta, system-signal=CAN4_FD_TBOX_VehData_Sta}, {implementation-record-element=CAN4_FD_TBOX_VehData_Err, system-signal=CAN4_FD_TBOX_VehData_Err}, {implementation-record-element=CAN4_FD_TBOX_DTCData_Sta, system-signal=CAN4_FD_TBOX_DTCData_Sta}, {implementation-record-element=CAN4_FD_TBOX_DTCData_Err, system-signal=CAN4_FD_TBOX_DTCData_Err}, {implementation-record-element=CAN4_FD_DKC_VehData_Sta, system-signal=CAN4_FD_DKC_VehData_Sta}, {implementation-record-element=CAN4_FD_DKC_VehData_Err, system-signal=CAN4_FD_DKC_VehData_Err}, {implementation-record-element=CAN4_EquivAccPedalSWSta, system-signal=CAN4_EquivAccPedalSWSta}, {implementation-record-element=CAN4_Dr_SeatSta, system-signal=CAN4_Dr_SeatSta}, {implementation-record-element=CAN4_DrDoorSW, system-signal=CAN4_DrDoorSW}, {implementation-record-element=CAN4_DoorLockIND, system-signal=CAN4_DoorLockIND}, {implementation-record-element=CAN4_DimmerEN, system-signal=CAN4_DimmerEN}, {implementation-record-element=CAN4_Dimmer, system-signal=CAN4_Dimmer}, {implementation-record-element=CAN4_DKCTimeSN, system-signal=CAN4_DKCTimeSN}, {implementation-record-element=CAN4_DKCAuthSta, system-signal=CAN4_DKCAuthSta}, {implementation-record-element=CAN4_CtrlFrPwrStbA1P, system-signal=CAN4_CtrlFrPwrStbA1P}, {implementation-record-element=CAN4_CtrlFrIRC1, system-signal=CAN4_CtrlFrIRC1}, {implementation-record-element=CAN4_CtrlFrEDUINVERTER, system-signal=CAN4_CtrlFrEDUINVERTER}, {implementation-record-element=CAN4_CtrlFrBMSCCUCIR, system-signal=CAN4_CtrlFrBMSCCUCIR}, {implementation-record-element=CAN4_CtrlDrPwrStbA2, system-signal=CAN4_CtrlDrPwrStbA2}, {implementation-record-element=CAN4_CrashDetd, system-signal=CAN4_CrashDetd}, {implementation-record-element=CAN4_CTDUnlockSW, system-signal=CAN4_CTDUnlockSW}, {implementation-record-element=CAN4_CTDLockSW, system-signal=CAN4_CTDLockSW}, {implementation-record-element=CAN4_CTDCtrl, system-signal=CAN4_CTDCtrl}, {implementation-record-element=CAN4_CS_VCU1_CAN4, system-signal=CAN4_CS_VCU1_CAN4}, {implementation-record-element=CAN4_CC_Crl_Sta, system-signal=CAN4_CC_Crl_Sta}, {implementation-record-element=CAN4_BrakeLamp, system-signal=CAN4_BrakeLamp}, {implementation-record-element=CAN4_BCM_DoorLock_Sta, system-signal=CAN4_BCM_DoorLock_Sta}, {implementation-record-element=CAN4_AntitheftSta, system-signal=CAN4_AntitheftSta}, {implementation-record-element=CAN4_AntiTheftSeatFold, system-signal=CAN4_AntiTheftSeatFold}, {implementation-record-element=CAN4_AllDoorSW, system-signal=CAN4_AllDoorSW}]}
      MAP_P_CAN4_FD4_CE100_1: sender-receiver-to-signal-group-mapping{communication-direction=OUT, data-element=SWC_FDC.root_FDC.P_CAN4_FD4_CE100_1.CAN4_SG_FD4_CE100_1, signal-group=CAN4_SG_FD4_CE100_1, type-mapping=sender-rec-record-type-mapping=record-element-mappings=[{implementation-record-element=CAN4_ACSubMode, system-signal=CAN4_ACSubMode}, {implementation-record-element=CAN4_sigWindDirZon3St, system-signal=CAN4_sigWindDirZon3St}, {implementation-record-element=CAN4_sigWindDirZon1St, system-signal=CAN4_sigWindDirZon1St}, {implementation-record-element=CAN4_sigSetTempZon3St, system-signal=CAN4_sigSetTempZon3St}, {implementation-record-element=CAN4_sigSetTempZon2St, system-signal=CAN4_sigSetTempZon2St}, {implementation-record-element=CAN4_sigSetTempZon1St, system-signal=CAN4_sigSetTempZon1St}, {implementation-record-element=CAN4_sigRecircSt, system-signal=CAN4_sigRecircSt}, {implementation-record-element=CAN4_sigHvacSt, system-signal=CAN4_sigHvacSt}, {implementation-record-element=CAN4_sigDfrstSt, system-signal=CAN4_sigDfrstSt}, {implementation-record-element=CAN4_sigClntTHvBattOut, system-signal=CAN4_sigClntTHvBattOut}, {implementation-record-element=CAN4_sigClmtCmprPwrAct, system-signal=CAN4_sigClmtCmprPwrAct}, {implementation-record-element=CAN4_sigCbnSolarRight, system-signal=CAN4_sigCbnSolarRight}, {implementation-record-element=CAN4_sigCbnSolarLeft, system-signal=CAN4_sigCbnSolarLeft}, {implementation-record-element=CAN4_sigCbnPTCPwrAct, system-signal=CAN4_sigCbnPTCPwrAct}, {implementation-record-element=CAN4_sigCbnAirT, system-signal=CAN4_sigCbnAirT}, {implementation-record-element=CAN4_sigAmbAirT, system-signal=CAN4_sigAmbAirT}, {implementation-record-element=CAN4_sigAirIntenZon3St, system-signal=CAN4_sigAirIntenZon3St}, {implementation-record-element=CAN4_sigAirIntenZon1St, system-signal=CAN4_sigAirIntenZon1St}, {implementation-record-element=CAN4_Rr_Coolanttemp, system-signal=CAN4_Rr_Coolanttemp}, {implementation-record-element=CAN4_Rr_Coolantflow, system-signal=CAN4_Rr_Coolantflow}, {implementation-record-element=CAN4_HPThermalRecoveryReq, system-signal=CAN4_HPThermalRecoveryReq}, {implementation-record-element=CAN4_Fr_Coolanttemp, system-signal=CAN4_Fr_Coolanttemp}, {implementation-record-element=CAN4_Fr_Coolantflow, system-signal=CAN4_Fr_Coolantflow}, {implementation-record-element=CAN4_FD_TWV_Cmd, system-signal=CAN4_FD_TWV_Cmd}, {implementation-record-element=CAN4_FD_SOV3_Cmd, system-signal=CAN4_FD_SOV3_Cmd}, {implementation-record-element=CAN4_FD_SOV2_Cmd, system-signal=CAN4_FD_SOV2_Cmd}, {implementation-record-element=CAN4_FD_SOV1_Cmd, system-signal=CAN4_FD_SOV1_Cmd}, {implementation-record-element=CAN4_FD_SOTXV_Cmd, system-signal=CAN4_FD_SOTXV_Cmd}, {implementation-record-element=CAN4_FD_RrAPTCHeatPwr_Cmd, system-signal=CAN4_FD_RrAPTCHeatPwr_Cmd}, {implementation-record-element=CAN4_FD_RecyAuto_Cmd, system-signal=CAN4_FD_RecyAuto_Cmd}, {implementation-record-element=CAN4_FD_FrWPTCHeatPwr_Cmd, system-signal=CAN4_FD_FrWPTCHeatPwr_Cmd}, {implementation-record-element=CAN4_FD_FrRiAPTCHeatPwr_Cmd, system-signal=CAN4_FD_FrRiAPTCHeatPwr_Cmd}, {implementation-record-element=CAN4_FD_FrLeAPTCHeatPwr_Cmd, system-signal=CAN4_FD_FrLeAPTCHeatPwr_Cmd}, {implementation-record-element=CAN4_FD_FWV_Cmd, system-signal=CAN4_FD_FWV_Cmd}, {implementation-record-element=CAN4_FD_EXV2_Cmd, system-signal=CAN4_FD_EXV2_Cmd}, {implementation-record-element=CAN4_FD_EXV1_Cmd, system-signal=CAN4_FD_EXV1_Cmd}, {implementation-record-element=CAN4_FD_EWP3_Cmd, system-signal=CAN4_FD_EWP3_Cmd}, {implementation-record-element=CAN4_FD_EWP2_Cmd, system-signal=CAN4_FD_EWP2_Cmd}, {implementation-record-element=CAN4_FD_EWP1_Cmd, system-signal=CAN4_FD_EWP1_Cmd}, {implementation-record-element=CAN4_FD_Comp_Cmd, system-signal=CAN4_FD_Comp_Cmd}, {implementation-record-element=CAN4_FD_Blower_Cmd, system-signal=CAN4_FD_Blower_Cmd}, {implementation-record-element=CAN4_FDC_THCM_PsVent_Sta, system-signal=CAN4_FDC_THCM_PsVent_Sta}, {implementation-record-element=CAN4_FDC_THCM_PsEVentZ_Sta, system-signal=CAN4_FDC_THCM_PsEVentZ_Sta}, {implementation-record-element=CAN4_FDC_THCM_PsEVentY_Sta, system-signal=CAN4_FDC_THCM_PsEVentY_Sta}, {implementation-record-element=CAN4_FDC_THCM_PsEVentMode_Sta, system-signal=CAN4_FDC_THCM_PsEVentMode_Sta}, {implementation-record-element=CAN4_FDC_THCM_DrVent_Sta, system-signal=CAN4_FDC_THCM_DrVent_Sta}, {implementation-record-element=CAN4_FDC_THCM_DrEVentZ_Sta, system-signal=CAN4_FDC_THCM_DrEVentZ_Sta}, {implementation-record-element=CAN4_FDC_THCM_DrEVentY_Sta, system-signal=CAN4_FDC_THCM_DrEVentY_Sta}, {implementation-record-element=CAN4_FDC_THCM_DrEVentMode_Sta, system-signal=CAN4_FDC_THCM_DrEVentMode_Sta}, {implementation-record-element=CAN4_FDC_THCM_CRVent_Sta, system-signal=CAN4_FDC_THCM_CRVent_Sta}, {implementation-record-element=CAN4_FDC_THCM_CREVentZ_Sta, system-signal=CAN4_FDC_THCM_CREVentZ_Sta}, {implementation-record-element=CAN4_FDC_THCM_CREVentY_Sta, system-signal=CAN4_FDC_THCM_CREVentY_Sta}, {implementation-record-element=CAN4_FDC_THCM_CLVent_Sta, system-signal=CAN4_FDC_THCM_CLVent_Sta}, {implementation-record-element=CAN4_FDC_THCM_CLEVentZ_Sta, system-signal=CAN4_FDC_THCM_CLEVentZ_Sta}, {implementation-record-element=CAN4_FDC_THCM_CLEVentY_Sta, system-signal=CAN4_FDC_THCM_CLEVentY_Sta}, {implementation-record-element=CAN4_EDriveMode, system-signal=CAN4_EDriveMode}, {implementation-record-element=CAN4_DeiceModReq, system-signal=CAN4_DeiceModReq}, {implementation-record-element=CAN4_CoolgFanActDuty, system-signal=CAN4_CoolgFanActDuty}, {implementation-record-element=CAN4_CabinMode, system-signal=CAN4_CabinMode}, {implementation-record-element=CAN4_CCU_SyncLampSts, system-signal=CAN4_CCU_SyncLampSts}, {implementation-record-element=CAN4_CCU_RrOnOffLampSts, system-signal=CAN4_CCU_RrOnOffLampSts}, {implementation-record-element=CAN4_CCU_HiVoltageReq, system-signal=CAN4_CCU_HiVoltageReq}, {implementation-record-element=CAN4_CCU_HEATMaxLampSts, system-signal=CAN4_CCU_HEATMaxLampSts}, {implementation-record-element=CAN4_CCU_FrtOnOffLampSts, system-signal=CAN4_CCU_FrtOnOffLampSts}, {implementation-record-element=CAN4_CCU_EcoSts, system-signal=CAN4_CCU_EcoSts}, {implementation-record-element=CAN4_CCU_Dispaly_Request, system-signal=CAN4_CCU_Dispaly_Request}, {implementation-record-element=CAN4_CCU_CbnPreSts, system-signal=CAN4_CCU_CbnPreSts}, {implementation-record-element=CAN4_CCU_CbnPreEstimdTi, system-signal=CAN4_CCU_CbnPreEstimdTi}, {implementation-record-element=CAN4_CCU_CbnPreACWkSts, system-signal=CAN4_CCU_CbnPreACWkSts}, {implementation-record-element=CAN4_CCU_AutoMidLampSts, system-signal=CAN4_CCU_AutoMidLampSts}, {implementation-record-element=CAN4_CCU_AutoLampSts, system-signal=CAN4_CCU_AutoLampSts}, {implementation-record-element=CAN4_CCU_ACMaxLampSts, system-signal=CAN4_CCU_ACMaxLampSts}, {implementation-record-element=CAN4_CCU_ACLampSts, system-signal=CAN4_CCU_ACLampSts}, {implementation-record-element=CAN4_BatteryMode, system-signal=CAN4_BatteryMode}, {implementation-record-element=CAN4_BatLoopActWtFlw, system-signal=CAN4_BatLoopActWtFlw}, {implementation-record-element=CAN4_APTC_ActFrRiPwr, system-signal=CAN4_APTC_ActFrRiPwr}]}
      MAP_P_CAN4_FD4_CE100_3: sender-receiver-to-signal-group-mapping{communication-direction=OUT, data-element=SWC_FDC.root_FDC.P_CAN4_FD4_CE100_3.CAN4_SG_FD4_CE100_3, signal-group=CAN4_SG_FD4_CE100_3, type-mapping=sender-rec-record-type-mapping=record-element-mappings=[{implementation-record-element=CAN4_FDC_BCM_BBuzzer_Cmd, system-signal=CAN4_FDC_BCM_BBuzzer_Cmd}, {implementation-record-element=CAN4_FDC_BCM_innerBuzzer_Cmd, system-signal=CAN4_FDC_BCM_innerBuzzer_Cmd}, {implementation-record-element=CAN4_FDC_BCM_TurnLpRActive_Cmd, system-signal=CAN4_FDC_BCM_TurnLpRActive_Cmd}, {implementation-record-element=CAN4_FDC_BCM_TurnLpLActive_Cmd, system-signal=CAN4_FDC_BCM_TurnLpLActive_Cmd}, {implementation-record-element=CAN4_FDC_BCM_TgateSWR_Sta, system-signal=CAN4_FDC_BCM_TgateSWR_Sta}, {implementation-record-element=CAN4_FDC_BCM_TgateSWL_Sta, system-signal=CAN4_FDC_BCM_TgateSWL_Sta}, {implementation-record-element=CAN4_FDC_BCM_TgateHDSWR_Sta, system-signal=CAN4_FDC_BCM_TgateHDSWR_Sta}, {implementation-record-element=CAN4_FDC_BCM_TgateHDSWL_Sta, system-signal=CAN4_FDC_BCM_TgateHDSWL_Sta}, {implementation-record-element=CAN4_FDC_BCM_STurnLpRight_Cmd, system-signal=CAN4_FDC_BCM_STurnLpRight_Cmd}, {implementation-record-element=CAN4_FDC_BCM_STurnLpLeft_Cmd, system-signal=CAN4_FDC_BCM_STurnLpLeft_Cmd}, {implementation-record-element=CAN4_FDC_BCM_RrRoomlamp_Cmd, system-signal=CAN4_FDC_BCM_RrRoomlamp_Cmd}, {implementation-record-element=CAN4_FDC_BCM_RrRmLampBright_Cmd, system-signal=CAN4_FDC_BCM_RrRmLampBright_Cmd}, {implementation-record-element=CAN4_FDC_BCM_RrAtmoLamp_Cmd, system-signal=CAN4_FDC_BCM_RrAtmoLamp_Cmd}, {implementation-record-element=CAN4_FDC_BCM_RevBuzzerout_Cmd, system-signal=CAN4_FDC_BCM_RevBuzzerout_Cmd}, {implementation-record-element=CAN4_FDC_BCM_RTgateRel_Cmd, system-signal=CAN4_FDC_BCM_RTgateRel_Cmd}, {implementation-record-element=CAN4_FDC_BCM_RSMLP_Cmd, system-signal=CAN4_FDC_BCM_RSMLP_Cmd}, {implementation-record-element=CAN4_FDC_BCM_LTgateRel_Cmd, system-signal=CAN4_FDC_BCM_LTgateRel_Cmd}, {implementation-record-element=CAN4_FDC_BCM_LSMLP_Cmd, system-signal=CAN4_FDC_BCM_LSMLP_Cmd}, {implementation-record-element=CAN4_FDC_BCM_IBuzzerReq_Sta, system-signal=CAN4_FDC_BCM_IBuzzerReq_Sta}, {implementation-record-element=CAN4_FDC_BCM_FrRoomlamp_Cmd, system-signal=CAN4_FDC_BCM_FrRoomlamp_Cmd}, {implementation-record-element=CAN4_FDC_BCM_FrRmLampBright_Cmd, system-signal=CAN4_FDC_BCM_FrRmLampBright_Cmd}, {implementation-record-element=CAN4_FDC_BCM_FrAtmoLamp_Cmd, system-signal=CAN4_FDC_BCM_FrAtmoLamp_Cmd}, {implementation-record-element=CAN4_FDC_BCM_EmExitLight_Cmd, system-signal=CAN4_FDC_BCM_EmExitLight_Cmd}, {implementation-record-element=CAN4_FDC_BCM_BBuzzerout_Cmd, system-signal=CAN4_FDC_BCM_BBuzzerout_Cmd}]}
      MAP_P_CAN4_FD4_CE200_0: sender-receiver-to-signal-group-mapping{communication-direction=OUT, data-element=SWC_FDC.root_FDC.P_CAN4_FD4_CE200_0.CAN4_SG_FD4_CE200_0, signal-group=CAN4_SG_FD4_CE200_0, type-mapping=sender-rec-record-type-mapping=record-element-mappings=[{implementation-record-element=CAN4_AmbLightBreath1, system-signal=CAN4_AmbLightBreath1}, {implementation-record-element=CAN4_WelcomeLight, system-signal=CAN4_WelcomeLight}, {implementation-record-element=CAN4_FDRHandleLampCmd, system-signal=CAN4_FDRHandleLampCmd}, {implementation-record-element=CAN4_FDLHandleLampCmd, system-signal=CAN4_FDLHandleLampCmd}, {implementation-record-element=CAN4_FDHandleCmd, system-signal=CAN4_FDHandleCmd}, {implementation-record-element=CAN4_FDC_THCM_AirIntZ3_Sta, system-signal=CAN4_FDC_THCM_AirIntZ3_Sta}, {implementation-record-element=CAN4_FDC_THCM_ACTInitial_Cmd, system-signal=CAN4_FDC_THCM_ACTInitial_Cmd}, {implementation-record-element=CAN4_FDC_EChrg_SW_Sta, system-signal=CAN4_FDC_EChrg_SW_Sta}, {implementation-record-element=CAN4_FDC_DKC_SPTGOpen_Cmd, system-signal=CAN4_FDC_DKC_SPTGOpen_Cmd}, {implementation-record-element=CAN4_FDC_DKC_SPTGDet_Cmd, system-signal=CAN4_FDC_DKC_SPTGDet_Cmd}, {implementation-record-element=CAN4_FDC_DKC_DKeyAreaPE_Sta, system-signal=CAN4_FDC_DKC_DKeyAreaPE_Sta}, {implementation-record-element=CAN4_FDC_DKC_CommandToBCM_Cmd, system-signal=CAN4_FDC_DKC_CommandToBCM_Cmd}, {implementation-record-element=CAN4_FDC_BCM_UserNow_Sta, system-signal=CAN4_FDC_BCM_UserNow_Sta}, {implementation-record-element=CAN4_FDC_BCM_UserHeightSet_Sta, system-signal=CAN4_FDC_BCM_UserHeightSet_Sta}, {implementation-record-element=CAN4_FDC_BCM_TurnSw_Sta, system-signal=CAN4_FDC_BCM_TurnSw_Sta}, {implementation-record-element=CAN4_FDC_BCM_TurnSwTSetSta_Sta, system-signal=CAN4_FDC_BCM_TurnSwTSetSta_Sta}, {implementation-record-element=CAN4_FDC_BCM_PassSW_Sta, system-signal=CAN4_FDC_BCM_PassSW_Sta}, {implementation-record-element=CAN4_FDC_BCM_PTGOpenHeight_Sta, system-signal=CAN4_FDC_BCM_PTGOpenHeight_Sta}, {implementation-record-element=CAN4_FDC_BCM_OutMode_Cmd, system-signal=CAN4_FDC_BCM_OutMode_Cmd}, {implementation-record-element=CAN4_FDC_BCM_LockAlarm_Cmd, system-signal=CAN4_FDC_BCM_LockAlarm_Cmd}, {implementation-record-element=CAN4_FDC_BCM_HazardIND_Cmd, system-signal=CAN4_FDC_BCM_HazardIND_Cmd}, {implementation-record-element=CAN4_FDC_BCM_FWipSw_Sta, system-signal=CAN4_FDC_BCM_FWipSw_Sta}, {implementation-record-element=CAN4_FDC_BCM_FWasSw_Sta, system-signal=CAN4_FDC_BCM_FWasSw_Sta}, {implementation-record-element=CAN4_FDC_BCM_DimSw, system-signal=CAN4_FDC_BCM_DimSw}, {implementation-record-element=CAN4_FDC_BCM_ATCtrl_Cmd, system-signal=CAN4_FDC_BCM_ATCtrl_Cmd}, {implementation-record-element=CAN4_BCM_Buzzer_Req, system-signal=CAN4_BCM_Buzzer_Req}, {implementation-record-element=CAN4_AmbLightColor6, system-signal=CAN4_AmbLightColor6}, {implementation-record-element=CAN4_AmbLightColor5, system-signal=CAN4_AmbLightColor5}, {implementation-record-element=CAN4_AmbLightColor4, system-signal=CAN4_AmbLightColor4}, {implementation-record-element=CAN4_AmbLightColor3, system-signal=CAN4_AmbLightColor3}, {implementation-record-element=CAN4_AmbLightColor2, system-signal=CAN4_AmbLightColor2}, {implementation-record-element=CAN4_AmbLightColor1, system-signal=CAN4_AmbLightColor1}, {implementation-record-element=CAN4_AmbLightBrightness6, system-signal=CAN4_AmbLightBrightness6}, {implementation-record-element=CAN4_AmbLightBrightness5, system-signal=CAN4_AmbLightBrightness5}, {implementation-record-element=CAN4_AmbLightBrightness4, system-signal=CAN4_AmbLightBrightness4}, {implementation-record-element=CAN4_AmbLightBrightness3, system-signal=CAN4_AmbLightBrightness3}, {implementation-record-element=CAN4_AmbLightBrightness2, system-signal=CAN4_AmbLightBrightness2}, {implementation-record-element=CAN4_AmbLightBrightness1, system-signal=CAN4_AmbLightBrightness1}, {implementation-record-element=CAN4_AmbLightBreath6, system-signal=CAN4_AmbLightBreath6}, {implementation-record-element=CAN4_AmbLightBreath5, system-signal=CAN4_AmbLightBreath5}, {implementation-record-element=CAN4_AmbLightBreath4, system-signal=CAN4_AmbLightBreath4}, {implementation-record-element=CAN4_AmbLightBreath3, system-signal=CAN4_AmbLightBreath3}, {implementation-record-element=CAN4_AmbLightBreath2, system-signal=CAN4_AmbLightBreath2}]}
      MAP_P_CAN4_GW4_CE100_0: sender-receiver-to-signal-group-mapping{communication-direction=OUT, data-element=SWC_FDC.root_FDC.P_CAN4_GW4_CE100_0.CAN4_SG_GW4_CE100_0, signal-group=CAN4_SG_GW4_CE100_0, type-mapping=sender-rec-record-type-mapping=record-element-mappings=[{implementation-record-element=CAN4_BrkPedalPos, system-signal=CAN4_BrkPedalPos}, {implementation-record-element=CAN4_VehSpeed, system-signal=CAN4_VehSpeed}, {implementation-record-element=CAN4_MCPressure_V, system-signal=CAN4_MCPressure_V}, {implementation-record-element=CAN4_MCPressure, system-signal=CAN4_MCPressure}, {implementation-record-element=CAN4_L_RRD_CtrlCmd, system-signal=CAN4_L_RRD_CtrlCmd}, {implementation-record-element=CAN4_L_RLD_CtrlCmd, system-signal=CAN4_L_RLD_CtrlCmd}, {implementation-record-element=CAN4_L_Pas_CtrlCmd, system-signal=CAN4_L_Pas_CtrlCmd}, {implementation-record-element=CAN4_L_Drv_CtrlCmd, system-signal=CAN4_L_Drv_CtrlCmd}, {implementation-record-element=CAN4_FDC_PTG_inner_SW_2, system-signal=CAN4_FDC_PTG_inner_SW_2}, {implementation-record-element=CAN4_BrkSw_V, system-signal=CAN4_BrkSw_V}, {implementation-record-element=CAN4_BrkSw_Sta, system-signal=CAN4_BrkSw_Sta}, {implementation-record-element=CAN4_BrkPedalPos_Sta, system-signal=CAN4_BrkPedalPos_Sta}]}
      MAP_P_CAN5_FD5_CE100_0: sender-receiver-to-signal-group-mapping{communication-direction=OUT, data-element=SWC_FDC.root_FDC.P_CAN5_FD5_CE100_0.CAN5_SG_FD5_CE100_0, signal-group=CAN5_SG_FD5_CE100_0, type-mapping=sender-rec-record-type-mapping=record-element-mappings=[{implementation-record-element=CAN5_AllDoorSW, system-signal=CAN5_AllDoorSW}, {implementation-record-element=CAN5_VehMalfunLevel, system-signal=CAN5_VehMalfunLevel}, {implementation-record-element=CAN5_Tailgate_SW, system-signal=CAN5_Tailgate_SW}, {implementation-record-element=CAN5_TailgateRemote, system-signal=CAN5_TailgateRemote}, {implementation-record-element=CAN5_TCountSta, system-signal=CAN5_TCountSta}, {implementation-record-element=CAN5_ShiftGearPosn, system-signal=CAN5_ShiftGearPosn}, {implementation-record-element=CAN5_Re_VehThdChkSta, system-signal=CAN5_Re_VehThdChkSta}, {implementation-record-element=CAN5_PwrSta, system-signal=CAN5_PwrSta}, {implementation-record-element=CAN5_LowSOCWarn, system-signal=CAN5_LowSOCWarn}, {implementation-record-element=CAN5_HoodSW, system-signal=CAN5_HoodSW}, {implementation-record-element=CAN5_FD_TBOX_VehData_Sta, system-signal=CAN5_FD_TBOX_VehData_Sta}, {implementation-record-element=CAN5_FD_TBOX_VehData_Err, system-signal=CAN5_FD_TBOX_VehData_Err}, {implementation-record-element=CAN5_FD_TBOX_DTCData_Sta, system-signal=CAN5_FD_TBOX_DTCData_Sta}, {implementation-record-element=CAN5_FD_TBOX_DTCData_Err, system-signal=CAN5_FD_TBOX_DTCData_Err}, {implementation-record-element=CAN5_CCU_CbnPreSts, system-signal=CAN5_CCU_CbnPreSts}, {implementation-record-element=CAN5_CCU_CbnPreEstimdTi, system-signal=CAN5_CCU_CbnPreEstimdTi}, {implementation-record-element=CAN5_CCU_CbnPreACWkSts, system-signal=CAN5_CCU_CbnPreACWkSts}, {implementation-record-element=CAN5_CCU_ACLampSts, system-signal=CAN5_CCU_ACLampSts}, {implementation-record-element=CAN5_BCM_DoorLock_Sta, system-signal=CAN5_BCM_DoorLock_Sta}, {implementation-record-element=CAN5_AntitheftSta, system-signal=CAN5_AntitheftSta}]}
      MAP_P_CAN5_FD5_Debug1: sender-receiver-to-signal-group-mapping{communication-direction=OUT, data-element=SWC_FDC.root_FDC.P_CAN5_FD5_Debug1.CAN5_SG_FD5_Debug1, signal-group=CAN5_SG_FD5_Debug1, type-mapping=sender-rec-record-type-mapping=record-element-mappings=[{implementation-record-element=CAN5_ID1_ALTU, system-signal=CAN5_ID1_ALTU}, {implementation-record-element=CAN5_S4WheelDebug_ALTU, system-signal=CAN5_S4WheelDebug_ALTU}, {implementation-record-element=CAN5_S3WheelDebug_ALTU, system-signal=CAN5_S3WheelDebug_ALTU}, {implementation-record-element=CAN5_S2WheelDebug_ALTU, system-signal=CAN5_S2WheelDebug_ALTU}, {implementation-record-element=CAN5_S1WheelDebug_ALTU, system-signal=CAN5_S1WheelDebug_ALTU}, {implementation-record-element=CAN5_RRSensorMode, system-signal=CAN5_RRSensorMode}, {implementation-record-element=CAN5_RF_FAT_ALTU, system-signal=CAN5_RF_FAT_ALTU}, {implementation-record-element=CAN5_RFSensorMode, system-signal=CAN5_RFSensorMode}, {implementation-record-element=CAN5_LRSensorMode, system-signal=CAN5_LRSensorMode}, {implementation-record-element=CAN5_LFSensorMode, system-signal=CAN5_LFSensorMode}, {implementation-record-element=CAN5_IDin_ALTU, system-signal=CAN5_IDin_ALTU}, {implementation-record-element=CAN5_ID4_message_ALTU, system-signal=CAN5_ID4_message_ALTU}, {implementation-record-element=CAN5_ID4_Loc_ALTU, system-signal=CAN5_ID4_Loc_ALTU}, {implementation-record-element=CAN5_ID4_ALTU, system-signal=CAN5_ID4_ALTU}, {implementation-record-element=CAN5_ID3_message_ALTU, system-signal=CAN5_ID3_message_ALTU}, {implementation-record-element=CAN5_ID3_Loc_ALTU, system-signal=CAN5_ID3_Loc_ALTU}, {implementation-record-element=CAN5_ID3_ALTU, system-signal=CAN5_ID3_ALTU}, {implementation-record-element=CAN5_ID2_message_ALTU, system-signal=CAN5_ID2_message_ALTU}, {implementation-record-element=CAN5_ID2_Loc_ALTU, system-signal=CAN5_ID2_Loc_ALTU}, {implementation-record-element=CAN5_ID2_ALTU, system-signal=CAN5_ID2_ALTU}, {implementation-record-element=CAN5_ID1_message_ALTU, system-signal=CAN5_ID1_message_ALTU}, {implementation-record-element=CAN5_ID1_Loc_ALTU, system-signal=CAN5_ID1_Loc_ALTU}]}
      MAP_P_CAN5_GW5_CE100_0: sender-receiver-to-signal-group-mapping{communication-direction=OUT, data-element=SWC_FDC.root_FDC.P_CAN5_GW5_CE100_0.CAN5_SG_GW5_CE100_0, signal-group=CAN5_SG_GW5_CE100_0, type-mapping=sender-rec-record-type-mapping=record-element-mappings=[{implementation-record-element=CAN5_BrkSw_Sta, system-signal=CAN5_BrkSw_Sta}, {implementation-record-element=CAN5_ZR_PTG_Sys_Sta, system-signal=CAN5_ZR_PTG_Sys_Sta}, {implementation-record-element=CAN5_ZR_PTG_Exist_Sta, system-signal=CAN5_ZR_PTG_Exist_Sta}, {implementation-record-element=CAN5_ZR_PTG_Active_Sta, system-signal=CAN5_ZR_PTG_Active_Sta}, {implementation-record-element=CAN5_ZR_APM_WinRROpened_Sta, system-signal=CAN5_ZR_APM_WinRROpened_Sta}, {implementation-record-element=CAN5_ZR_APM_WinRFOpened_Sta, system-signal=CAN5_ZR_APM_WinRFOpened_Sta}, {implementation-record-element=CAN5_ZL_APM_WinLROpened_Sta, system-signal=CAN5_ZL_APM_WinLROpened_Sta}, {implementation-record-element=CAN5_ZL_APM_WinLFOpened_Sta, system-signal=CAN5_ZL_APM_WinLFOpened_Sta}, {implementation-record-element=CAN5_VehSpeed, system-signal=CAN5_VehSpeed}, {implementation-record-element=CAN5_PTG_Sys_Sta, system-signal=CAN5_PTG_Sys_Sta}, {implementation-record-element=CAN5_PTG_Exist, system-signal=CAN5_PTG_Exist}, {implementation-record-element=CAN5_PTG_Active_Sta, system-signal=CAN5_PTG_Active_Sta}, {implementation-record-element=CAN5_CrashOutputSts, system-signal=CAN5_CrashOutputSts}]}
      MAP_P_CAN7_FD7_CE100_0: sender-receiver-to-signal-group-mapping{communication-direction=OUT, data-element=SWC_FDC.root_FDC.P_CAN7_FD7_CE100_0.CAN7_SG_FD7_CE100_0, signal-group=CAN7_SG_FD7_CE100_0, type-mapping=sender-rec-record-type-mapping=record-element-mappings=[{implementation-record-element=CAN7_FDC_BCM_FDDoorOpen_Sta, system-signal=CAN7_FDC_BCM_FDDoorOpen_Sta}, {implementation-record-element=CAN7_RTurnLP, system-signal=CAN7_RTurnLP}, {implementation-record-element=CAN7_LTurnLP, system-signal=CAN7_LTurnLP}]}
      MAP_P_CAN7_FD7_CE100_1: sender-receiver-to-signal-group-mapping{communication-direction=OUT, data-element=SWC_FDC.root_FDC.P_CAN7_FD7_CE100_1.CAN7_SG_FD7_CE100_1, signal-group=CAN7_SG_FD7_CE100_1, type-mapping=sender-rec-record-type-mapping=record-element-mappings=[{implementation-record-element=CAN7_FDC_BCM_FRClosedoor_Cmd, system-signal=CAN7_FDC_BCM_FRClosedoor_Cmd}, {implementation-record-element=CAN7_FDC_FRDisIntEm_Cmd, system-signal=CAN7_FDC_FRDisIntEm_Cmd}, {implementation-record-element=CAN7_FDC_BCM_PosLamp_Cmd, system-signal=CAN7_FDC_BCM_PosLamp_Cmd}, {implementation-record-element=CAN7_FDC_BCM_FROpendoor_Cmd, system-signal=CAN7_FDC_BCM_FROpendoor_Cmd}, {implementation-record-element=CAN7_FDC_BCM_FROpenClosePB_Cmd, system-signal=CAN7_FDC_BCM_FROpenClosePB_Cmd}, {implementation-record-element=CAN7_FDC_BCM_FRHaltBrake_Sta, system-signal=CAN7_FDC_BCM_FRHaltBrake_Sta}]}
      MAP_R_CAN1_DCDC_Status_1: sender-receiver-to-signal-group-mapping{communication-direction=IN, data-element=SWC_FDC.root_FDC.R_CAN1_DCDC_Status_1.CAN1_SG_DCDC_Status_1, signal-group=CAN1_SG_DCDC_Status_1, type-mapping=sender-rec-record-type-mapping=record-element-mappings=[{implementation-record-element=CAN1_DCDCEnSta, system-signal=CAN1_DCDCEnSta}, {implementation-record-element=CAN1_DCDCTempe, system-signal=CAN1_DCDCTempe}, {implementation-record-element=CAN1_DCDCLifeSig, system-signal=CAN1_DCDCLifeSig}, {implementation-record-element=CAN1_DCDCInVol, system-signal=CAN1_DCDCInVol}, {implementation-record-element=CAN1_DCDCInCurr, system-signal=CAN1_DCDCInCurr}, {implementation-record-element=CAN1_DCDCErrLv, system-signal=CAN1_DCDCErrLv}, {implementation-record-element=CAN1_DCDCErrCode, system-signal=CAN1_DCDCErrCode}]}
      MAP_R_CAN1_DCDC_Status_2: sender-receiver-to-signal-group-mapping{communication-direction=IN, data-element=SWC_FDC.root_FDC.R_CAN1_DCDC_Status_2.CAN1_SG_DCDC_Status_2, signal-group=CAN1_SG_DCDC_Status_2, type-mapping=sender-rec-record-type-mapping=record-element-mappings=[{implementation-record-element=CAN1_DCDCOutCurr, system-signal=CAN1_DCDCOutCurr}, {implementation-record-element=CAN1_DCDCSWVer, system-signal=CAN1_DCDCSWVer}, {implementation-record-element=CAN1_DCDCOutVol, system-signal=CAN1_DCDCOutVol}]}
      MAP_R_CAN1_EAC_Status_1: sender-receiver-to-signal-group-mapping{communication-direction=IN, data-element=SWC_FDC.root_FDC.R_CAN1_EAC_Status_1.CAN1_SG_EAC_Status_1, signal-group=CAN1_SG_EAC_Status_1, type-mapping=sender-rec-record-type-mapping=record-element-mappings=[{implementation-record-element=CAN1_EACEnSta, system-signal=CAN1_EACEnSta}, {implementation-record-element=CAN1_EACMotorTempe, system-signal=CAN1_EACMotorTempe}, {implementation-record-element=CAN1_EACLifeSig, system-signal=CAN1_EACLifeSig}, {implementation-record-element=CAN1_EACInvTempe, system-signal=CAN1_EACInvTempe}, {implementation-record-element=CAN1_EACInVol, system-signal=CAN1_EACInVol}, {implementation-record-element=CAN1_EACHVILSig, system-signal=CAN1_EACHVILSig}, {implementation-record-element=CAN1_EACErrLv, system-signal=CAN1_EACErrLv}, {implementation-record-element=CAN1_EACErrCode, system-signal=CAN1_EACErrCode}]}
      MAP_R_CAN1_EBC1: sender-receiver-to-signal-group-mapping{communication-direction=IN, data-element=SWC_FDC.root_FDC.R_CAN1_EBC1.CAN1_SG_EBC1, signal-group=CAN1_SG_EBC1, type-mapping=sender-rec-record-type-mapping=record-element-mappings=[{implementation-record-element=CAN1_ABSFullyOper, system-signal=CAN1_ABSFullyOper}, {implementation-record-element=CAN1_TrailerABSWarnSig, system-signal=CAN1_TrailerABSWarnSig}, {implementation-record-element=CAN1_TrailerABSSta, system-signal=CAN1_TrailerABSSta}, {implementation-record-element=CAN1_TractCtrlOvrSw, system-signal=CAN1_TractCtrlOvrSw}, {implementation-record-element=CAN1_SACtrlBrakeCtrl, system-signal=CAN1_SACtrlBrakeCtrl}, {implementation-record-element=CAN1_RmAccelEnSw, system-signal=CAN1_RmAccelEnSw}, {implementation-record-element=CAN1_HaltBrakeSw, system-signal=CAN1_HaltBrakeSw}, {implementation-record-element=CAN1_EngRetSel, system-signal=CAN1_EngRetSel}, {implementation-record-element=CAN1_EngDerateSw, system-signal=CAN1_EngDerateSw}, {implementation-record-element=CAN1_EngAuxShutdownSw, system-signal=CAN1_EngAuxShutdownSw}, {implementation-record-element=CAN1_EBSRedWarnLampSta, system-signal=CAN1_EBSRedWarnLampSta}, {implementation-record-element=CAN1_EBSBrakeSw, system-signal=CAN1_EBSBrakeSw}, {implementation-record-element=CAN1_EBSAmWarnLampSta, system-signal=CAN1_EBSAmWarnLampSta}, {implementation-record-element=CAN1_BrakePedalPos, system-signal=CAN1_BrakePedalPos}, {implementation-record-element=CAN1_AntiLBrakABSAct, system-signal=CAN1_AntiLBrakABSAct}, {implementation-record-element=CAN1_AcltrInterlockSw, system-signal=CAN1_AcltrInterlockSw}, {implementation-record-element=CAN1_ATCASRInfoSig, system-signal=CAN1_ATCASRInfoSig}, {implementation-record-element=CAN1_ASROffroadSw, system-signal=CAN1_ASROffroadSw}, {implementation-record-element=CAN1_ASRHillHolderSw, system-signal=CAN1_ASRHillHolderSw}, {implementation-record-element=CAN1_ASREngCtrlAtc, system-signal=CAN1_ASREngCtrlAtc}, {implementation-record-element=CAN1_ASRBrakeCtrlAtc, system-signal=CAN1_ASRBrakeCtrlAtc}, {implementation-record-element=CAN1_ABSOffroadSw, system-signal=CAN1_ABSOffroadSw}]}
      MAP_R_CAN1_EBC2: sender-receiver-to-signal-group-mapping{communication-direction=IN, data-element=SWC_FDC.root_FDC.R_CAN1_EBC2.CAN1_SG_EBC2, signal-group=CAN1_SG_EBC2, type-mapping=sender-rec-record-type-mapping=record-element-mappings=[{implementation-record-element=CAN1_FASpeed, system-signal=CAN1_FASpeed}, {implementation-record-element=CAN1_RelaSpdRA2RWheel, system-signal=CAN1_RelaSpdRA2RWheel}, {implementation-record-element=CAN1_RelaSpdRA2LWheel, system-signal=CAN1_RelaSpdRA2LWheel}, {implementation-record-element=CAN1_RelaSpdRA1RWheel, system-signal=CAN1_RelaSpdRA1RWheel}, {implementation-record-element=CAN1_RelaSpdRA1LWheel, system-signal=CAN1_RelaSpdRA1LWheel}, {implementation-record-element=CAN1_RelaSpdFARWheel, system-signal=CAN1_RelaSpdFARWheel}, {implementation-record-element=CAN1_RelaSpdFALWheel, system-signal=CAN1_RelaSpdFALWheel}]}
      MAP_R_CAN1_EBC5: sender-receiver-to-signal-group-mapping{communication-direction=IN, data-element=SWC_FDC.root_FDC.R_CAN1_EBC5.CAN1_SG_EBC5, signal-group=CAN1_SG_EBC5, type-mapping=sender-rec-record-type-mapping=record-element-mappings=[{implementation-record-element=CAN1_BrkTempeWarn, system-signal=CAN1_BrkTempeWarn}, {implementation-record-element=CAN1_XBRSysSta, system-signal=CAN1_XBRSysSta}, {implementation-record-element=CAN1_XBRActtrlMode, system-signal=CAN1_XBRActtrlMode}, {implementation-record-element=CAN1_XBRAcltnLimit, system-signal=CAN1_XBRAcltnLimit}, {implementation-record-element=CAN1_ParkBrkActuFAct, system-signal=CAN1_ParkBrkActuFAct}, {implementation-record-element=CAN1_HillHolderMode, system-signal=CAN1_HillHolderMode}, {implementation-record-element=CAN1_HaltBrkMode, system-signal=CAN1_HaltBrkMode}, {implementation-record-element=CAN1_FndBrkUse, system-signal=CAN1_FndBrkUse}]}
      MAP_R_CAN1_EHPS_Status_1: sender-receiver-to-signal-group-mapping{communication-direction=IN, data-element=SWC_FDC.root_FDC.R_CAN1_EHPS_Status_1.CAN1_SG_EHPS_Status_1, signal-group=CAN1_SG_EHPS_Status_1, type-mapping=sender-rec-record-type-mapping=record-element-mappings=[{implementation-record-element=CAN1_EHPSEnSta, system-signal=CAN1_EHPSEnSta}, {implementation-record-element=CAN1_EHPSMotorTempe, system-signal=CAN1_EHPSMotorTempe}, {implementation-record-element=CAN1_EHPSLifeSig, system-signal=CAN1_EHPSLifeSig}, {implementation-record-element=CAN1_EHPSInvTemp, system-signal=CAN1_EHPSInvTemp}, {implementation-record-element=CAN1_EHPSInVol, system-signal=CAN1_EHPSInVol}, {implementation-record-element=CAN1_EHPSHVILSig, system-signal=CAN1_EHPSHVILSig}, {implementation-record-element=CAN1_EHPSErrLv, system-signal=CAN1_EHPSErrLv}, {implementation-record-element=CAN1_EHPSErrCode, system-signal=CAN1_EHPSErrCode}]}
      MAP_R_CAN1_EMC1_EM1: sender-receiver-to-signal-group-mapping{communication-direction=IN, data-element=SWC_FDC.root_FDC.R_CAN1_EMC1_EM1.CAN1_SG_EMC1_EM1, signal-group=CAN1_SG_EMC1_EM1, type-mapping=sender-rec-record-type-mapping=record-element-mappings=[{implementation-record-element=CAN1_EM1CS, system-signal=CAN1_EM1CS}, {implementation-record-element=CAN1_EM1ReqTorqLimDriv, system-signal=CAN1_EM1ReqTorqLimDriv}, {implementation-record-element=CAN1_EM1ReqTorqLimBrk, system-signal=CAN1_EM1ReqTorqLimBrk}, {implementation-record-element=CAN1_EM1ReqTorqHRlsDri, system-signal=CAN1_EM1ReqTorqHRlsDri}, {implementation-record-element=CAN1_EM1ReqTorqHRlsBrk, system-signal=CAN1_EM1ReqTorqHRlsBrk}, {implementation-record-element=CAN1_EM1OvrCtrlMPriDriv, system-signal=CAN1_EM1OvrCtrlMPriDriv}, {implementation-record-element=CAN1_EM1OvrCtrlMPriBrk, system-signal=CAN1_EM1OvrCtrlMPriBrk}, {implementation-record-element=CAN1_EM1OvrCtrlMDriv, system-signal=CAN1_EM1OvrCtrlMDriv}, {implementation-record-element=CAN1_EM1OvrCtrlMBrk, system-signal=CAN1_EM1OvrCtrlMBrk}, {implementation-record-element=CAN1_EM1Cnt, system-signal=CAN1_EM1Cnt}]}
      MAP_R_CAN1_EPB1: sender-receiver-to-signal-group-mapping{communication-direction=IN, data-element=SWC_FDC.root_FDC.R_CAN1_EPB1.CAN1_SG_EPB1, signal-group=CAN1_SG_EPB1, type-mapping=sender-rec-record-type-mapping=sender-rec-record-element-mapping{implementation-record-element=CAN1_EPB_ParkingBrake_Sta, system-signal=CAN1_EPB_ParkingBrake_Sta}}
      MAP_R_CAN1_PDU_Status_1: sender-receiver-to-signal-group-mapping{communication-direction=IN, data-element=SWC_FDC.root_FDC.R_CAN1_PDU_Status_1.CAN1_SG_PDU_Status_1, signal-group=CAN1_SG_PDU_Status_1, type-mapping=sender-rec-record-type-mapping=record-element-mappings=[{implementation-record-element=CAN1_HVILSta_T1_PDU, system-signal=CAN1_HVILSta_T1_PDU}, {implementation-record-element=CAN1_PDUSelfChkSta, system-signal=CAN1_PDUSelfChkSta}, {implementation-record-element=CAN1_PDUSWVer, system-signal=CAN1_PDUSWVer}, {implementation-record-element=CAN1_PDUMCUPreRlySta, system-signal=CAN1_PDUMCUPreRlySta}, {implementation-record-element=CAN1_PDUMCUPosRlySta, system-signal=CAN1_PDUMCUPosRlySta}, {implementation-record-element=CAN1_PDUMCUHVLoopSta, system-signal=CAN1_PDUMCUHVLoopSta}, {implementation-record-element=CAN1_PDULifeSig, system-signal=CAN1_PDULifeSig}, {implementation-record-element=CAN1_PDUEHPSRlySta, system-signal=CAN1_PDUEHPSRlySta}, {implementation-record-element=CAN1_PDUEACRlySta, system-signal=CAN1_PDUEACRlySta}, {implementation-record-element=CAN1_PDUDCDCRlySta, system-signal=CAN1_PDUDCDCRlySta}, {implementation-record-element=CAN1_PDUACRlySta, system-signal=CAN1_PDUACRlySta}, {implementation-record-element=CAN1_PDUACPreRlySta, system-signal=CAN1_PDUACPreRlySta}, {implementation-record-element=CAN1_PDUACLoopSta, system-signal=CAN1_PDUACLoopSta}]}
      MAP_R_CAN2_IVI1: sender-receiver-to-signal-group-mapping{communication-direction=IN, data-element=SWC_FDC.root_FDC.R_CAN2_IVI1.CAN2_SG_IVI1, signal-group=CAN2_SG_IVI1, type-mapping=sender-rec-record-type-mapping=record-element-mappings=[{implementation-record-element=CAN2_A2B_Node_sta, system-signal=CAN2_A2B_Node_sta}, {implementation-record-element=CAN2_mFRD_link_Sta, system-signal=CAN2_mFRD_link_Sta}, {implementation-record-element=CAN2_VehACModReq, system-signal=CAN2_VehACModReq}, {implementation-record-element=CAN2_UserSet, system-signal=CAN2_UserSet}, {implementation-record-element=CAN2_Upd_Countdown_Skip, system-signal=CAN2_Upd_Countdown_Skip}, {implementation-record-element=CAN2_Upd_Countdown_Cancel, system-signal=CAN2_Upd_Countdown_Cancel}, {implementation-record-element=CAN2_SmartEco_Mode_SW, system-signal=CAN2_SmartEco_Mode_SW}, {implementation-record-element=CAN2_Sched_OTA_wake, system-signal=CAN2_Sched_OTA_wake}, {implementation-record-element=CAN2_Sched_Chg_St_Time_Min, system-signal=CAN2_Sched_Chg_St_Time_Min}, {implementation-record-element=CAN2_Sched_Chg_St_Time_HR, system-signal=CAN2_Sched_Chg_St_Time_HR}, {implementation-record-element=CAN2_Sched_Chg_End_Time_Min, system-signal=CAN2_Sched_Chg_End_Time_Min}, {implementation-record-element=CAN2_Sched_Chg_End_Time_HR, system-signal=CAN2_Sched_Chg_End_Time_HR}, {implementation-record-element=CAN2_Sched_Chg_Day_Set, system-signal=CAN2_Sched_Chg_Day_Set}, {implementation-record-element=CAN2_Re_Radio_Sta, system-signal=CAN2_Re_Radio_Sta}, {implementation-record-element=CAN2_PW_CONTINUE_USE, system-signal=CAN2_PW_CONTINUE_USE}, {implementation-record-element=CAN2_PW_CLOSE_IMD, system-signal=CAN2_PW_CLOSE_IMD}, {implementation-record-element=CAN2_OpenDrOpenWdo_SW, system-signal=CAN2_OpenDrOpenWdo_SW}, {implementation-record-element=CAN2_OTA_UpdStart_Req, system-signal=CAN2_OTA_UpdStart_Req}, {implementation-record-element=CAN2_OTA_SuspendDL_Req, system-signal=CAN2_OTA_SuspendDL_Req}, {implementation-record-element=CAN2_OTA_DL_Req, system-signal=CAN2_OTA_DL_Req}, {implementation-record-element=CAN2_OTA_CompNTFY_Pres, system-signal=CAN2_OTA_CompNTFY_Pres}, {implementation-record-element=CAN2_OTA_CancelDL_Req, system-signal=CAN2_OTA_CancelDL_Req}, {implementation-record-element=CAN2_LINKtoDrive, system-signal=CAN2_LINKtoDrive}, {implementation-record-element=CAN2_IVI_sigScreenReq_Sta, system-signal=CAN2_IVI_sigScreenReq_Sta}, {implementation-record-element=CAN2_IVI_Time_Year, system-signal=CAN2_IVI_Time_Year}, {implementation-record-element=CAN2_IVI_Time_Second, system-signal=CAN2_IVI_Time_Second}, {implementation-record-element=CAN2_IVI_Time_Month, system-signal=CAN2_IVI_Time_Month}, {implementation-record-element=CAN2_IVI_Time_Minute, system-signal=CAN2_IVI_Time_Minute}, {implementation-record-element=CAN2_IVI_Time_Hour, system-signal=CAN2_IVI_Time_Hour}, {implementation-record-element=CAN2_IVI_Time_Day, system-signal=CAN2_IVI_Time_Day}, {implementation-record-element=CAN2_IVI_Time_Check, system-signal=CAN2_IVI_Time_Check}, {implementation-record-element=CAN2_IVI_SWC_VibMode_Sta, system-signal=CAN2_IVI_SWC_VibMode_Sta}, {implementation-record-element=CAN2_IVI_QuickRefresh_Sta, system-signal=CAN2_IVI_QuickRefresh_Sta}, {implementation-record-element=CAN2_IVI_OTA_Upd_Sta, system-signal=CAN2_IVI_OTA_Upd_Sta}, {implementation-record-element=CAN2_IVI_NAVI_Foreground_Sta, system-signal=CAN2_IVI_NAVI_Foreground_Sta}, {implementation-record-element=CAN2_IVI_Lock_SoundSW_Sta, system-signal=CAN2_IVI_Lock_SoundSW_Sta}, {implementation-record-element=CAN2_IVI_Located_STA, system-signal=CAN2_IVI_Located_STA}, {implementation-record-element=CAN2_IVI_LinkKey_Sta, system-signal=CAN2_IVI_LinkKey_Sta}, {implementation-record-element=CAN2_IVI_LinkAcc_Sta, system-signal=CAN2_IVI_LinkAcc_Sta}, {implementation-record-element=CAN2_IVI_LinkAccReq_Sta, system-signal=CAN2_IVI_LinkAccReq_Sta}, {implementation-record-element=CAN2_IVI_HMI_Undefined_Sta, system-signal=CAN2_IVI_HMI_Undefined_Sta}, {implementation-record-element=CAN2_IVI_FrTrunk_UnlockReq_Sta, system-signal=CAN2_IVI_FrTrunk_UnlockReq_Sta}, {implementation-record-element=CAN2_IVI_DelAccReq_Sta, system-signal=CAN2_IVI_DelAccReq_Sta}, {implementation-record-element=CAN2_IVI_DSEAT_anti_set_Sta, system-signal=CAN2_IVI_DSEAT_anti_set_Sta}, {implementation-record-element=CAN2_IVI_DMS_SW_Sta, system-signal=CAN2_IVI_DMS_SW_Sta}, {implementation-record-element=CAN2_IVI_CreateAccReq_Sta, system-signal=CAN2_IVI_CreateAccReq_Sta}, {implementation-record-element=CAN2_IVI_CLWin_LockDoorSW_Sta, system-signal=CAN2_IVI_CLWin_LockDoorSW_Sta}, {implementation-record-element=CAN2_IVI_AutoTheme_But_Sta, system-signal=CAN2_IVI_AutoTheme_But_Sta}, {implementation-record-element=CAN2_IVI_AirRefresh_ByDMS_Sta, system-signal=CAN2_IVI_AirRefresh_ByDMS_Sta}, {implementation-record-element=CAN2_FCP_MidEvt_BtnAutoReq, system-signal=CAN2_FCP_MidEvt_BtnAutoReq}, {implementation-record-element=CAN2_FCP_FrEvt_BtnSyncReq, system-signal=CAN2_FCP_FrEvt_BtnSyncReq}, {implementation-record-element=CAN2_FCP_FrEvt_BtnAutoReq, system-signal=CAN2_FCP_FrEvt_BtnAutoReq}, {implementation-record-element=CAN2_FCP_FrEvt_BtnACReq, system-signal=CAN2_FCP_FrEvt_BtnACReq}, {implementation-record-element=CAN2_FCP_FrEvt_BtnACMaxReq, system-signal=CAN2_FCP_FrEvt_BtnACMaxReq}, {implementation-record-element=CAN2_BrkAbn_GoReady_SW, system-signal=CAN2_BrkAbn_GoReady_SW}, {implementation-record-element=CAN2_AmbLight_WlcmLight_SW, system-signal=CAN2_AmbLight_WlcmLight_SW}, {implementation-record-element=CAN2_AmbLight_SW, system-signal=CAN2_AmbLight_SW}, {implementation-record-element=CAN2_AmbLight_DimInDark_SW, system-signal=CAN2_AmbLight_DimInDark_SW}, {implementation-record-element=CAN2_AmbLightColorSet, system-signal=CAN2_AmbLightColorSet}, {implementation-record-element=CAN2_AmbLightBrightnessSet, system-signal=CAN2_AmbLightBrightnessSet}, {implementation-record-element=CAN2_AmbLigh_SafetyAlert_SW, system-signal=CAN2_AmbLigh_SafetyAlert_SW}, {implementation-record-element=CAN2_AmbLigh_LowBatAlert_SW, system-signal=CAN2_AmbLigh_LowBatAlert_SW}]}
      MAP_R_CAN2_IVI2: sender-receiver-to-signal-group-mapping{communication-direction=IN, data-element=SWC_FDC.root_FDC.R_CAN2_IVI2.CAN2_SG_IVI2, signal-group=CAN2_SG_IVI2, type-mapping=sender-rec-record-type-mapping=record-element-mappings=[{implementation-record-element=CAN2_AC_Chg_Cur_Set, system-signal=CAN2_AC_Chg_Cur_Set}, {implementation-record-element=CAN2_sigWindDirZon3Req, system-signal=CAN2_sigWindDirZon3Req}, {implementation-record-element=CAN2_sigSetTempZon3Req, system-signal=CAN2_sigSetTempZon3Req}, {implementation-record-element=CAN2_sigSetTempZon2Req, system-signal=CAN2_sigSetTempZon2Req}, {implementation-record-element=CAN2_sigSetTempZon1Req, system-signal=CAN2_sigSetTempZon1Req}, {implementation-record-element=CAN2_sigRecircReq, system-signal=CAN2_sigRecircReq}, {implementation-record-element=CAN2_sigHvacReq, system-signal=CAN2_sigHvacReq}, {implementation-record-element=CAN2_sigHvacRearReq, system-signal=CAN2_sigHvacRearReq}, {implementation-record-element=CAN2_sigHvacFrontReq, system-signal=CAN2_sigHvacFrontReq}, {implementation-record-element=CAN2_sigFootReq, system-signal=CAN2_sigFootReq}, {implementation-record-element=CAN2_sigFaceReq, system-signal=CAN2_sigFaceReq}, {implementation-record-element=CAN2_sigDfrstReq, system-signal=CAN2_sigDfrstReq}, {implementation-record-element=CAN2_sigAirIntenZon3Req, system-signal=CAN2_sigAirIntenZon3Req}, {implementation-record-element=CAN2_sigAirIntenZon1Req, system-signal=CAN2_sigAirIntenZon1Req}, {implementation-record-element=CAN2_WlcmLight_Mode, system-signal=CAN2_WlcmLight_Mode}, {implementation-record-element=CAN2_Wifi_Sta_IVI_TBOX, system-signal=CAN2_Wifi_Sta_IVI_TBOX}, {implementation-record-element=CAN2_Wifi_Reset, system-signal=CAN2_Wifi_Reset}, {implementation-record-element=CAN2_Walkaway_Lock_SW, system-signal=CAN2_Walkaway_Lock_SW}, {implementation-record-element=CAN2_User_p_upload, system-signal=CAN2_User_p_upload}, {implementation-record-element=CAN2_User_p_download, system-signal=CAN2_User_p_download}, {implementation-record-element=CAN2_TurnSwTimeSet, system-signal=CAN2_TurnSwTimeSet}, {implementation-record-element=CAN2_Time_system, system-signal=CAN2_Time_system}, {implementation-record-element=CAN2_Temperature_unit, system-signal=CAN2_Temperature_unit}, {implementation-record-element=CAN2_TPMS_Res_Butt, system-signal=CAN2_TPMS_Res_Butt}, {implementation-record-element=CAN2_TPMS_Cali_Butt, system-signal=CAN2_TPMS_Cali_Butt}, {implementation-record-element=CAN2_TCS_SW_Cmd, system-signal=CAN2_TCS_SW_Cmd}, {implementation-record-element=CAN2_SetUnlockSingle, system-signal=CAN2_SetUnlockSingle}, {implementation-record-element=CAN2_SenstivityPosition, system-signal=CAN2_SenstivityPosition}, {implementation-record-element=CAN2_Sched_Chg_wake, system-signal=CAN2_Sched_Chg_wake}, {implementation-record-element=CAN2_Sched_Chg_limit, system-signal=CAN2_Sched_Chg_limit}, {implementation-record-element=CAN2_Sched_Chg_butt, system-signal=CAN2_Sched_Chg_butt}, {implementation-record-element=CAN2_Sched_Chg_Stop, system-signal=CAN2_Sched_Chg_Stop}, {implementation-record-element=CAN2_Sched_Chg_Start, system-signal=CAN2_Sched_Chg_Start}, {implementation-record-element=CAN2_SOC_V2LLimit, system-signal=CAN2_SOC_V2LLimit}, {implementation-record-element=CAN2_SOC_Limit_Set, system-signal=CAN2_SOC_Limit_Set}, {implementation-record-element=CAN2_SOC_ADJ_BUTT, system-signal=CAN2_SOC_ADJ_BUTT}, {implementation-record-element=CAN2_SLIF_BUTT, system-signal=CAN2_SLIF_BUTT}, {implementation-record-element=CAN2_SLG_Sw, system-signal=CAN2_SLG_Sw}, {implementation-record-element=CAN2_RoomLampMode, system-signal=CAN2_RoomLampMode}, {implementation-record-element=CAN2_Roll_Mode_SW_Cmd, system-signal=CAN2_Roll_Mode_SW_Cmd}, {implementation-record-element=CAN2_Roll_Eng_Mode, system-signal=CAN2_Roll_Eng_Mode}, {implementation-record-element=CAN2_RFogLampSW, system-signal=CAN2_RFogLampSW}, {implementation-record-element=CAN2_RCTA_BUTT, system-signal=CAN2_RCTA_BUTT}, {implementation-record-element=CAN2_Pressure_unit, system-signal=CAN2_Pressure_unit}, {implementation-record-element=CAN2_Perd_V2L, system-signal=CAN2_Perd_V2L}, {implementation-record-element=CAN2_PSEAT_vent_req, system-signal=CAN2_PSEAT_vent_req}, {implementation-record-element=CAN2_OFF_AC_MODE, system-signal=CAN2_OFF_AC_MODE}, {implementation-record-element=CAN2_ODAMute_BUTT, system-signal=CAN2_ODAMute_BUTT}, {implementation-record-element=CAN2_NAVI_Tunnel, system-signal=CAN2_NAVI_Tunnel}, {implementation-record-element=CAN2_NAVI_Tollgate, system-signal=CAN2_NAVI_Tollgate}, {implementation-record-element=CAN2_NAVI_State, system-signal=CAN2_NAVI_State}, {implementation-record-element=CAN2_NAVI_Speed_Limit_A, system-signal=CAN2_NAVI_Speed_Limit_A}, {implementation-record-element=CAN2_NAVI_SpeedLimit, system-signal=CAN2_NAVI_SpeedLimit}, {implementation-record-element=CAN2_NAVI_RoadClass, system-signal=CAN2_NAVI_RoadClass}, {implementation-record-element=CAN2_NAVI_LinkClass, system-signal=CAN2_NAVI_LinkClass}, {implementation-record-element=CAN2_NAVI_ForwardLinkLevel, system-signal=CAN2_NAVI_ForwardLinkLevel}, {implementation-record-element=CAN2_NAVI_Distance_info, system-signal=CAN2_NAVI_Distance_info}, {implementation-record-element=CAN2_NAVI_Direction_STA, system-signal=CAN2_NAVI_Direction_STA}, {implementation-record-element=CAN2_NAVI_Cam_Dist_info, system-signal=CAN2_NAVI_Cam_Dist_info}, {implementation-record-element=CAN2_MFRD_N_Bright_Req, system-signal=CAN2_MFRD_N_Bright_Req}, {implementation-record-element=CAN2_METER_Malfunc_Sta, system-signal=CAN2_METER_Malfunc_Sta}, {implementation-record-element=CAN2_Light_ShowStop_Req, system-signal=CAN2_Light_ShowStop_Req}, {implementation-record-element=CAN2_Light_ShowStart_Req, system-signal=CAN2_Light_ShowStart_Req}, {implementation-record-element=CAN2_L_RRD_ControlCommand, system-signal=CAN2_L_RRD_ControlCommand}, {implementation-record-element=CAN2_L_RLD_ControlCommand, system-signal=CAN2_L_RLD_ControlCommand}, {implementation-record-element=CAN2_L_Pas_ControlCommand, system-signal=CAN2_L_Pas_ControlCommand}, {implementation-record-element=CAN2_L_Drv_ControlCommand, system-signal=CAN2_L_Drv_ControlCommand}, {implementation-record-element=CAN2_LVDAMute_BUTT, system-signal=CAN2_LVDAMute_BUTT}, {implementation-record-element=CAN2_LKA_BUTT, system-signal=CAN2_LKA_BUTT}, {implementation-record-element=CAN2_LDWMute_BUTT, system-signal=CAN2_LDWMute_BUTT}, {implementation-record-element=CAN2_IVI_WI_MAIN_SW, system-signal=CAN2_IVI_WI_MAIN_SW}, {implementation-record-element=CAN2_IVI_Unlock_Chg_req, system-signal=CAN2_IVI_Unlock_Chg_req}, {implementation-record-element=CAN2_IVI_Trigger_req, system-signal=CAN2_IVI_Trigger_req}, {implementation-record-element=CAN2_IVI_TrailerModeSW_Sta, system-signal=CAN2_IVI_TrailerModeSW_Sta}, {implementation-record-element=CAN2_IVI_TrailerCheckReq_Sta, system-signal=CAN2_IVI_TrailerCheckReq_Sta}, {implementation-record-element=CAN2_IVI_Stop_Chg_req, system-signal=CAN2_IVI_Stop_Chg_req}, {implementation-record-element=CAN2_IVI_Status, system-signal=CAN2_IVI_Status}, {implementation-record-element=CAN2_IVI_Start_Chg_req, system-signal=CAN2_IVI_Start_Chg_req}, {implementation-record-element=CAN2_IVI_SetTempZon2_Sta, system-signal=CAN2_IVI_SetTempZon2_Sta}, {implementation-record-element=CAN2_IVI_SetTempZon1_Sta, system-signal=CAN2_IVI_SetTempZon1_Sta}, {implementation-record-element=CAN2_IVI_Screen, system-signal=CAN2_IVI_Screen}, {implementation-record-element=CAN2_IVI_SWC_RUndefined_Sta, system-signal=CAN2_IVI_SWC_RUndefined_Sta}, {implementation-record-element=CAN2_IVI_SWC_LUndefined_Sta, system-signal=CAN2_IVI_SWC_LUndefined_Sta}, {implementation-record-element=CAN2_IVI_SWC_ACCMode_Sta, system-signal=CAN2_IVI_SWC_ACCMode_Sta}, {implementation-record-element=CAN2_IVI_SLIF_Warning_Sta, system-signal=CAN2_IVI_SLIF_Warning_Sta}, {implementation-record-element=CAN2_IVI_Req_V2L, system-signal=CAN2_IVI_Req_V2L}, {implementation-record-element=CAN2_IVI_RR_Def_Req, system-signal=CAN2_IVI_RR_Def_Req}, {implementation-record-element=CAN2_IVI_Pwroff_req, system-signal=CAN2_IVI_Pwroff_req}, {implementation-record-element=CAN2_IVI_PwrLockSW, system-signal=CAN2_IVI_PwrLockSW}, {implementation-record-element=CAN2_IVI_Panel_Y_Coor, system-signal=CAN2_IVI_Panel_Y_Coor}, {implementation-record-element=CAN2_IVI_Panel_X_Coor, system-signal=CAN2_IVI_Panel_X_Coor}, {implementation-record-element=CAN2_IVI_Panel_Act, system-signal=CAN2_IVI_Panel_Act}, {implementation-record-element=CAN2_IVI_PW_Mode_Req, system-signal=CAN2_IVI_PW_Mode_Req}, {implementation-record-element=CAN2_IVI_PTG_USSta_SW, system-signal=CAN2_IVI_PTG_USSta_SW}, {implementation-record-element=CAN2_IVI_PTG_Sta_SW, system-signal=CAN2_IVI_PTG_Sta_SW}, {implementation-record-element=CAN2_IVI_PTG_Open_Height, system-signal=CAN2_IVI_PTG_Open_Height}, {implementation-record-element=CAN2_IVI_PTG_Mode_SW, system-signal=CAN2_IVI_PTG_Mode_SW}, {implementation-record-element=CAN2_IVI_PSEAT_Slide_Cmd, system-signal=CAN2_IVI_PSEAT_Slide_Cmd}, {implementation-record-element=CAN2_IVI_PSEAT_Recline_Cmd, system-signal=CAN2_IVI_PSEAT_Recline_Cmd}, {implementation-record-element=CAN2_IVI_PSEATHeater_Cmd, system-signal=CAN2_IVI_PSEATHeater_Cmd}, {implementation-record-element=CAN2_IVI_Night_Mode_Sta, system-signal=CAN2_IVI_Night_Mode_Sta}, {implementation-record-element=CAN2_IVI_Mute_Sta, system-signal=CAN2_IVI_Mute_Sta}, {implementation-record-element=CAN2_IVI_LVChrgFuncSW, system-signal=CAN2_IVI_LVChrgFuncSW}, {implementation-record-element=CAN2_IVI_ISA_OffsetSpd, system-signal=CAN2_IVI_ISA_OffsetSpd}, {implementation-record-element=CAN2_IVI_DSEAT_Slide_Cmd, system-signal=CAN2_IVI_DSEAT_Slide_Cmd}, {implementation-record-element=CAN2_IVI_DSEAT_Recline_Cmd, system-signal=CAN2_IVI_DSEAT_Recline_Cmd}, {implementation-record-element=CAN2_IVI_DSEAT_Memory_OPTCLS_Sta, system-signal=CAN2_IVI_DSEAT_Memory_OPTCLS_Sta}, {implementation-record-element=CAN2_IVI_DSEAT_Memory2_Sta, system-signal=CAN2_IVI_DSEAT_Memory2_Sta}, {implementation-record-element=CAN2_IVI_DSEAT_Memory1_Sta, system-signal=CAN2_IVI_DSEAT_Memory1_Sta}, {implementation-record-element=CAN2_IVI_DSEAT_Height_Cmd, system-signal=CAN2_IVI_DSEAT_Height_Cmd}, {implementation-record-element=CAN2_IVI_DSEAT_FroEdge_Height_Cmd, system-signal=CAN2_IVI_DSEAT_FroEdge_Height_Cmd}, {implementation-record-element=CAN2_IVI_DSEATHeater_Cmd, system-signal=CAN2_IVI_DSEATHeater_Cmd}, {implementation-record-element=CAN2_IVI_CreepSW_Req, system-signal=CAN2_IVI_CreepSW_Req}, {implementation-record-element=CAN2_IVI_CoastDwSW, system-signal=CAN2_IVI_CoastDwSW}, {implementation-record-element=CAN2_IVI_ChargePortSW_Sta, system-signal=CAN2_IVI_ChargePortSW_Sta}, {implementation-record-element=CAN2_IVI_CfmTo_Rdy, system-signal=CAN2_IVI_CfmTo_Rdy}, {implementation-record-element=CAN2_IVI_AirIntZ3_Cmd, system-signal=CAN2_IVI_AirIntZ3_Cmd}, {implementation-record-element=CAN2_IVI_ActvDmpDisabSW, system-signal=CAN2_IVI_ActvDmpDisabSW}, {implementation-record-element=CAN2_IVI_ACC_Adaptive_Sta, system-signal=CAN2_IVI_ACC_Adaptive_Sta}, {implementation-record-element=CAN2_Hood_Latch_SW, system-signal=CAN2_Hood_Latch_SW}, {implementation-record-element=CAN2_HeadLampSW, system-signal=CAN2_HeadLampSW}, {implementation-record-element=CAN2_GPS_LONG, system-signal=CAN2_GPS_LONG}, {implementation-record-element=CAN2_GPS_LAT, system-signal=CAN2_GPS_LAT}, {implementation-record-element=CAN2_FollowMeSW, system-signal=CAN2_FollowMeSW}, {implementation-record-element=CAN2_FalseNPrevent_SW, system-signal=CAN2_FalseNPrevent_SW}, {implementation-record-element=CAN2_FS_Off_Sw, system-signal=CAN2_FS_Off_Sw}, {implementation-record-element=CAN2_FFogLampSW, system-signal=CAN2_FFogLampSW}, {implementation-record-element=CAN2_FCWMute_BUTT, system-signal=CAN2_FCWMute_BUTT}, {implementation-record-element=CAN2_ESC_SW_Cmd, system-signal=CAN2_ESC_SW_Cmd}, {implementation-record-element=CAN2_Distance_unit, system-signal=CAN2_Distance_unit}, {implementation-record-element=CAN2_DSEAT_vent_req, system-signal=CAN2_DSEAT_vent_req}, {implementation-record-element=CAN2_DSEAT_entryfun_set, system-signal=CAN2_DSEAT_entryfun_set}, {implementation-record-element=CAN2_DSEAT_anti_set, system-signal=CAN2_DSEAT_anti_set}, {implementation-record-element=CAN2_DMS_Warning_Unresponsive, system-signal=CAN2_DMS_Warning_Unresponsive}, {implementation-record-element=CAN2_DMS_Warning_Fatigue, system-signal=CAN2_DMS_Warning_Fatigue}, {implementation-record-element=CAN2_DMS_Warning_Distraction, system-signal=CAN2_DMS_Warning_Distraction}, {implementation-record-element=CAN2_DMS_Status, system-signal=CAN2_DMS_Status}, {implementation-record-element=CAN2_CameraWrn, system-signal=CAN2_CameraWrn}, {implementation-record-element=CAN2_CDL_Unlock_Butt, system-signal=CAN2_CDL_Unlock_Butt}, {implementation-record-element=CAN2_CDL_Lock_Butt, system-signal=CAN2_CDL_Lock_Butt}, {implementation-record-element=CAN2_CAAS_Sw, system-signal=CAN2_CAAS_Sw}, {implementation-record-element=CAN2_BSDMute_BUTT, system-signal=CAN2_BSDMute_BUTT}, {implementation-record-element=CAN2_Approach_Unlock_SW, system-signal=CAN2_Approach_Unlock_SW}, {implementation-record-element=CAN2_AVM_parking_excute, system-signal=CAN2_AVM_parking_excute}, {implementation-record-element=CAN2_AVM_parking_cancel, system-signal=CAN2_AVM_parking_cancel}, {implementation-record-element=CAN2_AVM_Parking_mode, system-signal=CAN2_AVM_Parking_mode}, {implementation-record-element=CAN2_AVM_OFF_Rec_Butt, system-signal=CAN2_AVM_OFF_Rec_Butt}, {implementation-record-element=CAN2_AVM_Err_STA, system-signal=CAN2_AVM_Err_STA}, {implementation-record-element=CAN2_AEB_BUTT, system-signal=CAN2_AEB_BUTT}]}
      MAP_R_CAN2_IVI_P20_0: sender-receiver-to-signal-group-mapping{communication-direction=IN, data-element=SWC_FDC.root_FDC.R_CAN2_IVI_P20_0.CAN2_SG_IVI_P20_0, signal-group=CAN2_SG_IVI_P20_0, type-mapping=sender-rec-record-type-mapping=record-element-mappings=[{implementation-record-element=CAN2_IVI_AmbiLgtSta, system-signal=CAN2_IVI_AmbiLgtSta}, {implementation-record-element=CAN2_IVI_RrRoomlamp_Cmd, system-signal=CAN2_IVI_RrRoomlamp_Cmd}, {implementation-record-element=CAN2_IVI_RrRmLampBright_Cmd, system-signal=CAN2_IVI_RrRmLampBright_Cmd}, {implementation-record-element=CAN2_IVI_RrAtmoLamp_Cmd, system-signal=CAN2_IVI_RrAtmoLamp_Cmd}, {implementation-record-element=CAN2_IVI_Passengerdoor_Sta, system-signal=CAN2_IVI_Passengerdoor_Sta}, {implementation-record-element=CAN2_IVI_Frontindoorlight_Sta, system-signal=CAN2_IVI_Frontindoorlight_Sta}, {implementation-record-element=CAN2_IVI_FrRmLampBright_Cmd, system-signal=CAN2_IVI_FrRmLampBright_Cmd}, {implementation-record-element=CAN2_IVI_FrAtmoLamp_Cmd, system-signal=CAN2_IVI_FrAtmoLamp_Cmd}]}
      MAP_R_CAN2_METER1: sender-receiver-to-signal-group-mapping{communication-direction=IN, data-element=SWC_FDC.root_FDC.R_CAN2_METER1.CAN2_SG_METER1, signal-group=CAN2_SG_METER1, type-mapping=sender-rec-record-type-mapping=record-element-mappings=[{implementation-record-element=CAN2_APCforDTE, system-signal=CAN2_APCforDTE}, {implementation-record-element=CAN2_Trip_B, system-signal=CAN2_Trip_B}, {implementation-record-element=CAN2_Trip_A, system-signal=CAN2_Trip_A}, {implementation-record-element=CAN2_Spd_Crl_Sta, system-signal=CAN2_Spd_Crl_Sta}, {implementation-record-element=CAN2_Spd_Crl_Mode, system-signal=CAN2_Spd_Crl_Mode}, {implementation-record-element=CAN2_ParkBrake, system-signal=CAN2_ParkBrake}, {implementation-record-element=CAN2_ODOMETER, system-signal=CAN2_ODOMETER}, {implementation-record-element=CAN2_METER_MPH_Real, system-signal=CAN2_METER_MPH_Real}, {implementation-record-element=CAN2_METER_MPH_Calcu, system-signal=CAN2_METER_MPH_Calcu}, {implementation-record-element=CAN2_METER_KPH_Real, system-signal=CAN2_METER_KPH_Real}, {implementation-record-element=CAN2_METER_KPH_Calcu, system-signal=CAN2_METER_KPH_Calcu}, {implementation-record-element=CAN2_LEDlitWarnReq, system-signal=CAN2_LEDlitWarnReq}, {implementation-record-element=CAN2_Charge, system-signal=CAN2_Charge}, {implementation-record-element=CAN2_Averaged_vehspeed, system-signal=CAN2_Averaged_vehspeed}, {implementation-record-element=CAN2_AvailableTrip, system-signal=CAN2_AvailableTrip}, {implementation-record-element=CAN2_AVGPwrConsumption, system-signal=CAN2_AVGPwrConsumption}]}
      MAP_R_CAN3_BMS1: sender-receiver-to-signal-group-mapping{communication-direction=IN, data-element=SWC_FDC.root_FDC.R_CAN3_BMS1.CAN3_SG_BMS1, signal-group=CAN3_SG_BMS1, type-mapping=sender-rec-record-type-mapping=record-element-mappings=[{implementation-record-element=CAN3_BMSChckSum_1, system-signal=CAN3_BMSChckSum_1}, {implementation-record-element=CAN3_HVBattVolt, system-signal=CAN3_HVBattVolt}, {implementation-record-element=CAN3_HVBattCurr, system-signal=CAN3_HVBattCurr}, {implementation-record-element=CAN3_HVBPwrAvailDchrg60, system-signal=CAN3_HVBPwrAvailDchrg60}, {implementation-record-element=CAN3_HVBPwrAvailDchrg30, system-signal=CAN3_HVBPwrAvailDchrg30}, {implementation-record-element=CAN3_HVBPwrAvailDchrg, system-signal=CAN3_HVBPwrAvailDchrg}, {implementation-record-element=CAN3_HVBPwrAvailChrg60, system-signal=CAN3_HVBPwrAvailChrg60}, {implementation-record-element=CAN3_HVBPwrAvailChrg30, system-signal=CAN3_HVBPwrAvailChrg30}, {implementation-record-element=CAN3_HVBPwrAvailChrg, system-signal=CAN3_HVBPwrAvailChrg}, {implementation-record-element=CAN3_BMSRolCnct_1, system-signal=CAN3_BMSRolCnct_1}]}
      MAP_R_CAN3_BMS3: sender-receiver-to-signal-group-mapping{communication-direction=IN, data-element=SWC_FDC.root_FDC.R_CAN3_BMS3.CAN3_SG_BMS3, signal-group=CAN3_SG_BMS3, type-mapping=sender-rec-record-type-mapping=record-element-mappings=[{implementation-record-element=CAN3_ACChrgCurrDis, system-signal=CAN3_ACChrgCurrDis}, {implementation-record-element=CAN3_RemainChrgTime, system-signal=CAN3_RemainChrgTime}, {implementation-record-element=CAN3_RechrgCyc, system-signal=CAN3_RechrgCyc}, {implementation-record-element=CAN3_HVBattSOCDis, system-signal=CAN3_HVBattSOCDis}, {implementation-record-element=CAN3_HVBattSOC, system-signal=CAN3_HVBattSOC}, {implementation-record-element=CAN3_HVBattPackVolt, system-signal=CAN3_HVBattPackVolt}, {implementation-record-element=CAN3_HVBattErr, system-signal=CAN3_HVBattErr}, {implementation-record-element=CAN3_HVBSOH, system-signal=CAN3_HVBSOH}, {implementation-record-element=CAN3_HVBIsoImpedenceP, system-signal=CAN3_HVBIsoImpedenceP}, {implementation-record-element=CAN3_HVBIsoImpedenceN, system-signal=CAN3_HVBIsoImpedenceN}, {implementation-record-element=CAN3_HVBFullChrgPwr, system-signal=CAN3_HVBFullChrgPwr}, {implementation-record-element=CAN3_HVBDrvPwrTotal, system-signal=CAN3_HVBDrvPwrTotal}, {implementation-record-element=CAN3_HVBDrvPwr, system-signal=CAN3_HVBDrvPwr}, {implementation-record-element=CAN3_HVBChrgPwrTotal, system-signal=CAN3_HVBChrgPwrTotal}, {implementation-record-element=CAN3_HVBChrgPwr, system-signal=CAN3_HVBChrgPwr}, {implementation-record-element=CAN3_FireDetErr, system-signal=CAN3_FireDetErr}, {implementation-record-element=CAN3_ChrgLampSta, system-signal=CAN3_ChrgLampSta}, {implementation-record-element=CAN3_ChrgCurType, system-signal=CAN3_ChrgCurType}, {implementation-record-element=CAN3_CellType, system-signal=CAN3_CellType}, {implementation-record-element=CAN3_Battsystfail_Num, system-signal=CAN3_Battsystfail_Num}]}
      MAP_R_CAN3_BMS4: sender-receiver-to-signal-group-mapping{communication-direction=IN, data-element=SWC_FDC.root_FDC.R_CAN3_BMS4.CAN3_SG_BMS4, signal-group=CAN3_SG_BMS4, type-mapping=sender-rec-record-type-mapping=record-element-mappings=[{implementation-record-element=CAN3_CellTempAvg, system-signal=CAN3_CellTempAvg}, {implementation-record-element=CAN3_Mtemp20, system-signal=CAN3_Mtemp20}, {implementation-record-element=CAN3_Mtemp19, system-signal=CAN3_Mtemp19}, {implementation-record-element=CAN3_Mtemp18, system-signal=CAN3_Mtemp18}, {implementation-record-element=CAN3_Mtemp17, system-signal=CAN3_Mtemp17}, {implementation-record-element=CAN3_Mtemp16, system-signal=CAN3_Mtemp16}, {implementation-record-element=CAN3_Mtemp15, system-signal=CAN3_Mtemp15}, {implementation-record-element=CAN3_Mtemp14, system-signal=CAN3_Mtemp14}, {implementation-record-element=CAN3_Mtemp13, system-signal=CAN3_Mtemp13}, {implementation-record-element=CAN3_Mtemp12, system-signal=CAN3_Mtemp12}, {implementation-record-element=CAN3_Mtemp11, system-signal=CAN3_Mtemp11}, {implementation-record-element=CAN3_Mtemp10, system-signal=CAN3_Mtemp10}, {implementation-record-element=CAN3_Mtemp09, system-signal=CAN3_Mtemp09}, {implementation-record-element=CAN3_Mtemp08, system-signal=CAN3_Mtemp08}, {implementation-record-element=CAN3_Mtemp07, system-signal=CAN3_Mtemp07}, {implementation-record-element=CAN3_Mtemp06, system-signal=CAN3_Mtemp06}, {implementation-record-element=CAN3_Mtemp05, system-signal=CAN3_Mtemp05}, {implementation-record-element=CAN3_Mtemp04, system-signal=CAN3_Mtemp04}, {implementation-record-element=CAN3_Mtemp03, system-signal=CAN3_Mtemp03}, {implementation-record-element=CAN3_Mtemp02, system-signal=CAN3_Mtemp02}, {implementation-record-element=CAN3_Mtemp01, system-signal=CAN3_Mtemp01}, {implementation-record-element=CAN3_MinCellVolt_Num, system-signal=CAN3_MinCellVolt_Num}, {implementation-record-element=CAN3_MinCellTemp_Num, system-signal=CAN3_MinCellTemp_Num}, {implementation-record-element=CAN3_MaxCellVolt_Num, system-signal=CAN3_MaxCellVolt_Num}, {implementation-record-element=CAN3_MaxCellTemp_Num, system-signal=CAN3_MaxCellTemp_Num}, {implementation-record-element=CAN3_HVBMTempMin, system-signal=CAN3_HVBMTempMin}, {implementation-record-element=CAN3_HVBMTempMax, system-signal=CAN3_HVBMTempMax}, {implementation-record-element=CAN3_HVBCellVoltMin, system-signal=CAN3_HVBCellVoltMin}, {implementation-record-element=CAN3_HVBCellVoltMax, system-signal=CAN3_HVBCellVoltMax}]}
      MAP_R_CAN3_BMS5: sender-receiver-to-signal-group-mapping{communication-direction=IN, data-element=SWC_FDC.root_FDC.R_CAN3_BMS5.CAN3_SG_BMS5, signal-group=CAN3_SG_BMS5, type-mapping=sender-rec-record-type-mapping=record-element-mappings=[{implementation-record-element=CAN3_DCPortNeg_Temp, system-signal=CAN3_DCPortNeg_Temp}, {implementation-record-element=CAN3_ReChargerStaFromEvcc, system-signal=CAN3_ReChargerStaFromEvcc}, {implementation-record-element=CAN3_OBCEna, system-signal=CAN3_OBCEna}, {implementation-record-element=CAN3_OBCDCVoltLm, system-signal=CAN3_OBCDCVoltLm}, {implementation-record-element=CAN3_OBCDCCurLm, system-signal=CAN3_OBCDCCurLm}, {implementation-record-element=CAN3_OBCACCSLimit, system-signal=CAN3_OBCACCSLimit}, {implementation-record-element=CAN3_LVBattDet12V, system-signal=CAN3_LVBattDet12V}, {implementation-record-element=CAN3_HVInVolt, system-signal=CAN3_HVInVolt}, {implementation-record-element=CAN3_DCPortPos_Temp, system-signal=CAN3_DCPortPos_Temp}]}
      MAP_R_CAN3_BMS6: sender-receiver-to-signal-group-mapping{communication-direction=IN, data-element=SWC_FDC.root_FDC.R_CAN3_BMS6.CAN3_SG_BMS6, signal-group=CAN3_SG_BMS6, type-mapping=sender-rec-record-type-mapping=record-element-mappings=[{implementation-record-element=CAN3_BMSChckSum, system-signal=CAN3_BMSChckSum}, {implementation-record-element=CAN3_V2LSta, system-signal=CAN3_V2LSta}, {implementation-record-element=CAN3_SystemUncomErr, system-signal=CAN3_SystemUncomErr}, {implementation-record-element=CAN3_IsoDetSta, system-signal=CAN3_IsoDetSta}, {implementation-record-element=CAN3_HVILSta, system-signal=CAN3_HVILSta}, {implementation-record-element=CAN3_HVBattReady4Pre, system-signal=CAN3_HVBattReady4Pre}, {implementation-record-element=CAN3_HVBUndrVoltErr, system-signal=CAN3_HVBUndrVoltErr}, {implementation-record-element=CAN3_HVBUndrTempWarn, system-signal=CAN3_HVBUndrTempWarn}, {implementation-record-element=CAN3_HVBUndrTempErr, system-signal=CAN3_HVBUndrTempErr}, {implementation-record-element=CAN3_HVBUndrSOCErr, system-signal=CAN3_HVBUndrSOCErr}, {implementation-record-element=CAN3_HVBTempDiffErr, system-signal=CAN3_HVBTempDiffErr}, {implementation-record-element=CAN3_HVBShrtDischrgCurrErr, system-signal=CAN3_HVBShrtDischrgCurrErr}, {implementation-record-element=CAN3_HVBShrtChrgCurrErr, system-signal=CAN3_HVBShrtChrgCurrErr}, {implementation-record-element=CAN3_HVBSOCJumpError, system-signal=CAN3_HVBSOCJumpError}, {implementation-record-element=CAN3_HVBPreheatPrecoolSta, system-signal=CAN3_HVBPreheatPrecoolSta}, {implementation-record-element=CAN3_HVBPrechrgSta, system-signal=CAN3_HVBPrechrgSta}, {implementation-record-element=CAN3_HVBOvrVoltErr, system-signal=CAN3_HVBOvrVoltErr}, {implementation-record-element=CAN3_HVBOvrTempWarn, system-signal=CAN3_HVBOvrTempWarn}, {implementation-record-element=CAN3_HVBOvrTempErr, system-signal=CAN3_HVBOvrTempErr}, {implementation-record-element=CAN3_HVBOvrSOCErr, system-signal=CAN3_HVBOvrSOCErr}, {implementation-record-element=CAN3_HVBOvrDchrgCurErr, system-signal=CAN3_HVBOvrDchrgCurErr}, {implementation-record-element=CAN3_HVBOvrChrgCurrErr, system-signal=CAN3_HVBOvrChrgCurrErr}, {implementation-record-element=CAN3_HVBHVILErr, system-signal=CAN3_HVBHVILErr}, {implementation-record-element=CAN3_HVBContactorSta, system-signal=CAN3_HVBContactorSta}, {implementation-record-element=CAN3_HVBChrgErr, system-signal=CAN3_HVBChrgErr}, {implementation-record-element=CAN3_HVBCellUndrVoltErr, system-signal=CAN3_HVBCellUndrVoltErr}, {implementation-record-element=CAN3_HVBCellUnbalanErr, system-signal=CAN3_HVBCellUnbalanErr}, {implementation-record-element=CAN3_HVBCellUdrVoltWarn, system-signal=CAN3_HVBCellUdrVoltWarn}, {implementation-record-element=CAN3_HVBCellOvrVoltWarn, system-signal=CAN3_HVBCellOvrVoltWarn}, {implementation-record-element=CAN3_HVBCellOvrVoltErr, system-signal=CAN3_HVBCellOvrVoltErr}, {implementation-record-element=CAN3_ExtChrgSta, system-signal=CAN3_ExtChrgSta}, {implementation-record-element=CAN3_DisChrgPlugErr, system-signal=CAN3_DisChrgPlugErr}, {implementation-record-element=CAN3_DCChrgSysShockErr, system-signal=CAN3_DCChrgSysShockErr}, {implementation-record-element=CAN3_ChrgPlugSta, system-signal=CAN3_ChrgPlugSta}, {implementation-record-element=CAN3_ChrgInLockReq, system-signal=CAN3_ChrgInLockReq}, {implementation-record-element=CAN3_CellUnconsistErr, system-signal=CAN3_CellUnconsistErr}, {implementation-record-element=CAN3_BMS_Warn_8, system-signal=CAN3_BMS_Warn_8}, {implementation-record-element=CAN3_BMS_Warn_7, system-signal=CAN3_BMS_Warn_7}, {implementation-record-element=CAN3_BMS_Warn_6, system-signal=CAN3_BMS_Warn_6}, {implementation-record-element=CAN3_BMS_Warn_5, system-signal=CAN3_BMS_Warn_5}, {implementation-record-element=CAN3_BMS_Warn_4, system-signal=CAN3_BMS_Warn_4}, {implementation-record-element=CAN3_BMS_Warn_3, system-signal=CAN3_BMS_Warn_3}, {implementation-record-element=CAN3_BMS_Warn_2, system-signal=CAN3_BMS_Warn_2}, {implementation-record-element=CAN3_BMS_Warn_1, system-signal=CAN3_BMS_Warn_1}, {implementation-record-element=CAN3_BMS_READY, system-signal=CAN3_BMS_READY}, {implementation-record-element=CAN3_BMSRolCnct, system-signal=CAN3_BMSRolCnct}]}
      MAP_R_CAN3_BMS8: sender-receiver-to-signal-group-mapping{communication-direction=IN, data-element=SWC_FDC.root_FDC.R_CAN3_BMS8.CAN3_SG_BMS8, signal-group=CAN3_SG_BMS8, type-mapping=sender-rec-record-type-mapping=record-element-mappings=[{implementation-record-element=CAN3_ACChrgStop, system-signal=CAN3_ACChrgStop}, {implementation-record-element=CAN3_TherRunawayErrMask, system-signal=CAN3_TherRunawayErrMask}, {implementation-record-element=CAN3_MainRlyPosSta, system-signal=CAN3_MainRlyPosSta}, {implementation-record-element=CAN3_MainRlyPosOutterVoltage, system-signal=CAN3_MainRlyPosOutterVoltage}, {implementation-record-element=CAN3_MainRlyPosInnerVoltage, system-signal=CAN3_MainRlyPosInnerVoltage}, {implementation-record-element=CAN3_MainRlyPosDriReq, system-signal=CAN3_MainRlyPosDriReq}, {implementation-record-element=CAN3_MainRlyNegSta, system-signal=CAN3_MainRlyNegSta}, {implementation-record-element=CAN3_MainRlyNegOutterVoltage, system-signal=CAN3_MainRlyNegOutterVoltage}, {implementation-record-element=CAN3_MainRlyNegDriReq, system-signal=CAN3_MainRlyNegDriReq}, {implementation-record-element=CAN3_MainPosstandard, system-signal=CAN3_MainPosstandard}, {implementation-record-element=CAN3_MainChrgRlyPosSta, system-signal=CAN3_MainChrgRlyPosSta}, {implementation-record-element=CAN3_MainChrgRlyPosOutterVoltage, system-signal=CAN3_MainChrgRlyPosOutterVoltage}, {implementation-record-element=CAN3_MainChrgRlyPosDriReq, system-signal=CAN3_MainChrgRlyPosDriReq}, {implementation-record-element=CAN3_MainChrgRlyNegSta, system-signal=CAN3_MainChrgRlyNegSta}, {implementation-record-element=CAN3_MainChrgRlyNegOutterVoltage, system-signal=CAN3_MainChrgRlyNegOutterVoltage}, {implementation-record-element=CAN3_MainChrgRlyNegDriReq, system-signal=CAN3_MainChrgRlyNegDriReq}, {implementation-record-element=CAN3_G0standard, system-signal=CAN3_G0standard}, {implementation-record-element=CAN3_DCChrgVoltage, system-signal=CAN3_DCChrgVoltage}, {implementation-record-element=CAN3_DCChrgStop, system-signal=CAN3_DCChrgStop}, {implementation-record-element=CAN3_DCChrgCurrent, system-signal=CAN3_DCChrgCurrent}, {implementation-record-element=CAN3_CurrentErrorID, system-signal=CAN3_CurrentErrorID}]}
      MAP_R_CAN3_CCU1: sender-receiver-to-signal-group-mapping{communication-direction=IN, data-element=SWC_FDC.root_FDC.R_CAN3_CCU1.CAN3_SG_CCU1, signal-group=CAN3_SG_CCU1, type-mapping=sender-rec-record-type-mapping=record-element-mappings=[{implementation-record-element=CAN3_CS_CCU1, system-signal=CAN3_CS_CCU1}, {implementation-record-element=CAN3_RC_CCU1, system-signal=CAN3_RC_CCU1}, {implementation-record-element=CAN3_OBCWakeup4Plugin, system-signal=CAN3_OBCWakeup4Plugin}, {implementation-record-element=CAN3_OBCV2LVoutUVP, system-signal=CAN3_OBCV2LVoutUVP}, {implementation-record-element=CAN3_OBCV2LVoutOVP, system-signal=CAN3_OBCV2LVoutOVP}, {implementation-record-element=CAN3_OBCV2LVoutOCP, system-signal=CAN3_OBCV2LVoutOCP}, {implementation-record-element=CAN3_OBCV2LVinUVP, system-signal=CAN3_OBCV2LVinUVP}, {implementation-record-element=CAN3_OBCV2LVinOVP, system-signal=CAN3_OBCV2LVinOVP}, {implementation-record-element=CAN3_OBCV2LInsuFault, system-signal=CAN3_OBCV2LInsuFault}, {implementation-record-element=CAN3_OBCV2LINVOTP, system-signal=CAN3_OBCV2LINVOTP}, {implementation-record-element=CAN3_OBCPreCompleted, system-signal=CAN3_OBCPreCompleted}, {implementation-record-element=CAN3_OBCDCVoltInf, system-signal=CAN3_OBCDCVoltInf}, {implementation-record-element=CAN3_OBCDCCurrInf, system-signal=CAN3_OBCDCCurrInf}, {implementation-record-element=CAN3_DCDCPreCompleted, system-signal=CAN3_DCDCPreCompleted}, {implementation-record-element=CAN3_DCDCInVoltInf, system-signal=CAN3_DCDCInVoltInf}, {implementation-record-element=CAN3_DCDCHVCur, system-signal=CAN3_DCDCHVCur}, {implementation-record-element=CAN3_DCDCAuxVolt, system-signal=CAN3_DCDCAuxVolt}, {implementation-record-element=CAN3_DCDCAuxCur, system-signal=CAN3_DCDCAuxCur}]}
      MAP_R_CAN3_CCU2: sender-receiver-to-signal-group-mapping{communication-direction=IN, data-element=SWC_FDC.root_FDC.R_CAN3_CCU2.CAN3_SG_CCU2, signal-group=CAN3_SG_CCU2, type-mapping=sender-rec-record-type-mapping=record-element-mappings=[{implementation-record-element=CAN3_CS_CCU2, system-signal=CAN3_CS_CCU2}, {implementation-record-element=CAN3_RC_CCU2, system-signal=CAN3_RC_CCU2}, {implementation-record-element=CAN3_OBC_AC_Cur_Lim, system-signal=CAN3_OBC_AC_Cur_Lim}, {implementation-record-element=CAN3_OBCV2LSta, system-signal=CAN3_OBCV2LSta}, {implementation-record-element=CAN3_OBCTemp, system-signal=CAN3_OBCTemp}, {implementation-record-element=CAN3_OBCRlySta, system-signal=CAN3_OBCRlySta}, {implementation-record-element=CAN3_OBCReady4Pre, system-signal=CAN3_OBCReady4Pre}, {implementation-record-element=CAN3_OBCPluginSta, system-signal=CAN3_OBCPluginSta}, {implementation-record-element=CAN3_OBCFaultSta, system-signal=CAN3_OBCFaultSta}, {implementation-record-element=CAN3_OBCEnaSta, system-signal=CAN3_OBCEnaSta}, {implementation-record-element=CAN3_OBCDCP, system-signal=CAN3_OBCDCP}, {implementation-record-element=CAN3_OBCACVoltInf, system-signal=CAN3_OBCACVoltInf}, {implementation-record-element=CAN3_OBCACCurrInf, system-signal=CAN3_OBCACCurrInf}, {implementation-record-element=CAN3_DCDCTemp, system-signal=CAN3_DCDCTemp}, {implementation-record-element=CAN3_DCDCReady4Pre, system-signal=CAN3_DCDCReady4Pre}, {implementation-record-element=CAN3_DCDCFaultSta, system-signal=CAN3_DCDCFaultSta}, {implementation-record-element=CAN3_DCDCEnaSta, system-signal=CAN3_DCDCEnaSta}]}
      MAP_R_CAN3_MCU_B_R1: sender-receiver-to-signal-group-mapping{communication-direction=IN, data-element=SWC_FDC.root_FDC.R_CAN3_MCU_B_R1.CAN3_SG_MCU_B_R1, signal-group=CAN3_SG_MCU_B_R1, type-mapping=sender-rec-record-type-mapping=record-element-mappings=[{implementation-record-element=CAN3_MCUWarn_R, system-signal=CAN3_MCUWarn_R}, {implementation-record-element=CAN3_Rr_TMiq, system-signal=CAN3_Rr_TMiq}, {implementation-record-element=CAN3_Rr_TMid, system-signal=CAN3_Rr_TMid}, {implementation-record-element=CAN3_Rr_TMTemp, system-signal=CAN3_Rr_TMTemp}, {implementation-record-element=CAN3_Rr_TMSpd, system-signal=CAN3_Rr_TMSpd}, {implementation-record-element=CAN3_Rr_Reserved_bits, system-signal=CAN3_Rr_Reserved_bits}, {implementation-record-element=CAN3_Rr_RegenAvailTq, system-signal=CAN3_Rr_RegenAvailTq}, {implementation-record-element=CAN3_Rr_MotorAvailTq, system-signal=CAN3_Rr_MotorAvailTq}, {implementation-record-element=CAN3_Rr_MCUTemp, system-signal=CAN3_Rr_MCUTemp}, {implementation-record-element=CAN3_Rr_MCUSysSta, system-signal=CAN3_Rr_MCUSysSta}, {implementation-record-element=CAN3_Rr_MCUReady4Pre, system-signal=CAN3_Rr_MCUReady4Pre}, {implementation-record-element=CAN3_Rr_MCUReady, system-signal=CAN3_Rr_MCUReady}, {implementation-record-element=CAN3_Rr_MCUIGN_sta, system-signal=CAN3_Rr_MCUIGN_sta}, {implementation-record-element=CAN3_Rr_MCUErr, system-signal=CAN3_Rr_MCUErr}, {implementation-record-element=CAN3_Rr_MCUEnaSta, system-signal=CAN3_Rr_MCUEnaSta}, {implementation-record-element=CAN3_Rr_MCUDischrgSta, system-signal=CAN3_Rr_MCUDischrgSta}, {implementation-record-element=CAN3_Rr_MCUDCBusVolt, system-signal=CAN3_Rr_MCUDCBusVolt}, {implementation-record-element=CAN3_Rr_MCUDCBusCurr, system-signal=CAN3_Rr_MCUDCBusCurr}, {implementation-record-element=CAN3_Rr_MCUBAT, system-signal=CAN3_Rr_MCUBAT}, {implementation-record-element=CAN3_Rr_MCU1RolCnt, system-signal=CAN3_Rr_MCU1RolCnt}, {implementation-record-element=CAN3_Rr_MCU1Chksum, system-signal=CAN3_Rr_MCU1Chksum}, {implementation-record-element=CAN3_Rr_EDUTqReqFbk, system-signal=CAN3_Rr_EDUTqReqFbk}, {implementation-record-element=CAN3_Rr_EDURotateDirction, system-signal=CAN3_Rr_EDURotateDirction}, {implementation-record-element=CAN3_Rr_EDURealTMTq, system-signal=CAN3_Rr_EDURealTMTq}, {implementation-record-element=CAN3_Rr_EDUOpratingSta, system-signal=CAN3_Rr_EDUOpratingSta}, {implementation-record-element=CAN3_Rr_EDUDrtSta, system-signal=CAN3_Rr_EDUDrtSta}, {implementation-record-element=CAN3_Rr_ActvDmpDisabSta, system-signal=CAN3_Rr_ActvDmpDisabSta}]}
      MAP_R_CAN3_MCU_B_R2: sender-receiver-to-signal-group-mapping{communication-direction=IN, data-element=SWC_FDC.root_FDC.R_CAN3_MCU_B_R2.CAN3_SG_MCU_B_R2, signal-group=CAN3_SG_MCU_B_R2, type-mapping=sender-rec-record-type-mapping=record-element-mappings=[{implementation-record-element=CAN3_MCU_B_R_FailLv_Sta, system-signal=CAN3_MCU_B_R_FailLv_Sta}, {implementation-record-element=CAN3_Rr_TMTempWarn, system-signal=CAN3_Rr_TMTempWarn}, {implementation-record-element=CAN3_Rr_MCUTempWarn, system-signal=CAN3_Rr_MCUTempWarn}, {implementation-record-element=CAN3_Rr_MCU3_SW_Ver, system-signal=CAN3_Rr_MCU3_SW_Ver}, {implementation-record-element=CAN3_Rr_MCU3_HW_Ver, system-signal=CAN3_Rr_MCU3_HW_Ver}, {implementation-record-element=CAN3_Rr_MCU2RolCnt, system-signal=CAN3_Rr_MCU2RolCnt}, {implementation-record-element=CAN3_Rr_MCU2Chksum, system-signal=CAN3_Rr_MCU2Chksum}, {implementation-record-element=CAN3_Rr_LLCflowReq, system-signal=CAN3_Rr_LLCflowReq}, {implementation-record-element=CAN3_Rr_LLCTemp, system-signal=CAN3_Rr_LLCTemp}, {implementation-record-element=CAN3_Rr_Failcodehistory2, system-signal=CAN3_Rr_Failcodehistory2}, {implementation-record-element=CAN3_Rr_Failcodehistory1, system-signal=CAN3_Rr_Failcodehistory1}, {implementation-record-element=CAN3_Rr_Failcode2, system-signal=CAN3_Rr_Failcode2}, {implementation-record-element=CAN3_Rr_Failcode1, system-signal=CAN3_Rr_Failcode1}, {implementation-record-element=CAN3_Rr_CoolanttempReq, system-signal=CAN3_Rr_CoolanttempReq}, {implementation-record-element=CAN3_MCU_B_R_LLCTempWarn_Sta, system-signal=CAN3_MCU_B_R_LLCTempWarn_Sta}]}
      MAP_R_CAN3_Shifter1: sender-receiver-to-signal-group-mapping{communication-direction=IN, data-element=SWC_FDC.root_FDC.R_CAN3_Shifter1.CAN3_SG_Shifter1, signal-group=CAN3_SG_Shifter1, type-mapping=sender-rec-record-type-mapping=record-element-mappings=[{implementation-record-element=CAN3_Shifter_CRC8, system-signal=CAN3_Shifter_CRC8}, {implementation-record-element=CAN3_Shifter_RC, system-signal=CAN3_Shifter_RC}, {implementation-record-element=CAN3_Shifter_Handle_Cmd, system-signal=CAN3_Shifter_Handle_Cmd}, {implementation-record-element=CAN3_Shifter_Fail_sta, system-signal=CAN3_Shifter_Fail_sta}]}
      MAP_R_CAN4_DKC1: sender-receiver-to-signal-group-mapping{communication-direction=IN, data-element=SWC_FDC.root_FDC.R_CAN4_DKC1.CAN4_SG_DKC1, signal-group=CAN4_SG_DKC1, type-mapping=sender-rec-record-type-mapping=record-element-mappings=[{implementation-record-element=CAN4_DKC_KeyNum_Sta, system-signal=CAN4_DKC_KeyNum_Sta}, {implementation-record-element=CAN4_P_UID_LowPower, system-signal=CAN4_P_UID_LowPower}, {implementation-record-element=CAN4_P_KeyMode, system-signal=CAN4_P_KeyMode}, {implementation-record-element=CAN4_P_KeyMiss, system-signal=CAN4_P_KeyMiss}, {implementation-record-element=CAN4_P_Dkey_Show_IVI, system-signal=CAN4_P_Dkey_Show_IVI}, {implementation-record-element=CAN4_P_DKey_Welcome, system-signal=CAN4_P_DKey_Welcome}, {implementation-record-element=CAN4_P_DKey_Area_PTG, system-signal=CAN4_P_DKey_Area_PTG}, {implementation-record-element=CAN4_P_DKey_Area_PS, system-signal=CAN4_P_DKey_Area_PS}, {implementation-record-element=CAN4_P_DKey_Area_LockUnlock, system-signal=CAN4_P_DKey_Area_LockUnlock}, {implementation-record-element=CAN4_P_CommandToPTG, system-signal=CAN4_P_CommandToPTG}, {implementation-record-element=CAN4_P_CommandToBCM, system-signal=CAN4_P_CommandToBCM}, {implementation-record-element=CAN4_DKC_Re_VehData, system-signal=CAN4_DKC_Re_VehData}, {implementation-record-element=CAN4_DKC_ParkingMode_Cmd, system-signal=CAN4_DKC_ParkingMode_Cmd}, {implementation-record-element=CAN4_DKC_PDkeyAreaRAPS_Sta, system-signal=CAN4_DKC_PDkeyAreaRAPS_Sta}, {implementation-record-element=CAN4_DKC_KeyType_Sta, system-signal=CAN4_DKC_KeyType_Sta}]}
      MAP_R_CAN4_DKC2: sender-receiver-to-signal-group-mapping{communication-direction=IN, data-element=SWC_FDC.root_FDC.R_CAN4_DKC2.CAN4_SG_DKC2, signal-group=CAN4_SG_DKC2, type-mapping=sender-rec-record-type-mapping=record-element-mappings=[{implementation-record-element=CAN4_EncryptionDATA_0_63, system-signal=CAN4_EncryptionDATA_0_63}, {implementation-record-element=CAN4_Random_Number_X, system-signal=CAN4_Random_Number_X}, {implementation-record-element=CAN4_EncryptionDATA_64_127, system-signal=CAN4_EncryptionDATA_64_127}]}
      MAP_R_CAN4_Z24_C1000_0: sender-receiver-to-signal-group-mapping{communication-direction=IN, data-element=SWC_FDC.root_FDC.R_CAN4_Z24_C1000_0.CAN4_SG_Z24_C1000_0, signal-group=CAN4_SG_Z24_C1000_0, type-mapping=sender-rec-record-type-mapping=record-element-mappings=[{implementation-record-element=CAN4_Z24_CHA_AirPressureFC2_Sta, system-signal=CAN4_Z24_CHA_AirPressureFC2_Sta}, {implementation-record-element=CAN4_Z24_CHA_AirPressureRC1_Sta, system-signal=CAN4_Z24_CHA_AirPressureRC1_Sta}, {implementation-record-element=CAN4_Z24_CHA_AirPressurePC3_Sta, system-signal=CAN4_Z24_CHA_AirPressurePC3_Sta}]}
      MAP_R_CAN4_Z24_CE100_0: sender-receiver-to-signal-group-mapping{communication-direction=IN, data-element=SWC_FDC.root_FDC.R_CAN4_Z24_CE100_0.CAN4_SG_Z24_CE100_0, signal-group=CAN4_SG_Z24_CE100_0, type-mapping=sender-rec-record-type-mapping=record-element-mappings=[{implementation-record-element=CAN4_Z24_BCM_EmExitOP_Sta, system-signal=CAN4_Z24_BCM_EmExitOP_Sta}, {implementation-record-element=CAN4_Z24_BCM_innerBuzzer_Sta, system-signal=CAN4_Z24_BCM_innerBuzzer_Sta}, {implementation-record-element=CAN4_Z24_BCM_SeatBeltSW_Sta, system-signal=CAN4_Z24_BCM_SeatBeltSW_Sta}, {implementation-record-element=CAN4_Z24_BCM_RRTurnLampC_Sta, system-signal=CAN4_Z24_BCM_RRTurnLampC_Sta}, {implementation-record-element=CAN4_Z24_BCM_RLTurnLampC_Sta, system-signal=CAN4_Z24_BCM_RLTurnLampC_Sta}, {implementation-record-element=CAN4_Z24_BCM_FWiperProtection_Sta, system-signal=CAN4_Z24_BCM_FWiperProtection_Sta}, {implementation-record-element=CAN4_Z24_BCM_FWiperAS_Sta, system-signal=CAN4_Z24_BCM_FWiperAS_Sta}, {implementation-record-element=CAN4_Z24_BCM_FRTurnLampC_Sta, system-signal=CAN4_Z24_BCM_FRTurnLampC_Sta}, {implementation-record-element=CAN4_Z24_BCM_FLTurnLampC_Sta, system-signal=CAN4_Z24_BCM_FLTurnLampC_Sta}]}
      MAP_R_CAN4_ZONE_DR1: sender-receiver-to-signal-group-mapping{communication-direction=IN, data-element=SWC_FDC.root_FDC.R_CAN4_ZONE_DR1.CAN4_SG_ZONE_DR1, signal-group=CAN4_SG_ZONE_DR1, type-mapping=sender-rec-record-type-mapping=record-element-mappings=[{implementation-record-element=CAN4_ACT1_Actuator_address, system-signal=CAN4_ACT1_Actuator_address}, {implementation-record-element=CAN4_ZDR_THCM_ModeFail_Sta, system-signal=CAN4_ZDR_THCM_ModeFail_Sta}, {implementation-record-element=CAN4_ZDR_THCM_LINACT5_Sta, system-signal=CAN4_ZDR_THCM_LINACT5_Sta}, {implementation-record-element=CAN4_ZDR_THCM_LINACT4_Sta, system-signal=CAN4_ZDR_THCM_LINACT4_Sta}, {implementation-record-element=CAN4_ZDR_THCM_LINACT3_Sta, system-signal=CAN4_ZDR_THCM_LINACT3_Sta}, {implementation-record-element=CAN4_ZDR_THCM_LINACT2_Sta, system-signal=CAN4_ZDR_THCM_LINACT2_Sta}, {implementation-record-element=CAN4_ZDR_THCM_LINACT1_Sta, system-signal=CAN4_ZDR_THCM_LINACT1_Sta}, {implementation-record-element=CAN4_ZDR_THCM_IntakeFail_Sta, system-signal=CAN4_ZDR_THCM_IntakeFail_Sta}, {implementation-record-element=CAN4_WiperZeroPosSW, system-signal=CAN4_WiperZeroPosSW}, {implementation-record-element=CAN4_WiperSWPos, system-signal=CAN4_WiperSWPos}, {implementation-record-element=CAN4_Wip_Speed, system-signal=CAN4_Wip_Speed}, {implementation-record-element=CAN4_RWiperProtection, system-signal=CAN4_RWiperProtection}, {implementation-record-element=CAN4_RWiperAS, system-signal=CAN4_RWiperAS}, {implementation-record-element=CAN4_RRTurnLampC, system-signal=CAN4_RRTurnLampC}, {implementation-record-element=CAN4_RRTurnLPErr, system-signal=CAN4_RRTurnLPErr}, {implementation-record-element=CAN4_RRLockSta, system-signal=CAN4_RRLockSta}, {implementation-record-element=CAN4_RLTurnLampC, system-signal=CAN4_RLTurnLampC}, {implementation-record-element=CAN4_RLTurnLPErr, system-signal=CAN4_RLTurnLPErr}, {implementation-record-element=CAN4_RLS_Exist, system-signal=CAN4_RLS_Exist}, {implementation-record-element=CAN4_RLLockSta, system-signal=CAN4_RLLockSta}, {implementation-record-element=CAN4_PsLockSta, system-signal=CAN4_PsLockSta}, {implementation-record-element=CAN4_MIRROR_FOLD_SW, system-signal=CAN4_MIRROR_FOLD_SW}, {implementation-record-element=CAN4_HornSW, system-signal=CAN4_HornSW}, {implementation-record-element=CAN4_DrLockSta, system-signal=CAN4_DrLockSta}, {implementation-record-element=CAN4_BrakeLampFail, system-signal=CAN4_BrakeLampFail}, {implementation-record-element=CAN4_AutoLightSW, system-signal=CAN4_AutoLightSW}, {implementation-record-element=CAN4_AllLockSta, system-signal=CAN4_AllLockSta}, {implementation-record-element=CAN4_ACT5_Stop_mode, system-signal=CAN4_ACT5_Stop_mode}, {implementation-record-element=CAN4_ACT5_Stall_detection_release, system-signal=CAN4_ACT5_Stall_detection_release}, {implementation-record-element=CAN4_ACT5_Speed_specification, system-signal=CAN4_ACT5_Speed_specification}, {implementation-record-element=CAN4_ACT5_Select_position_specification, system-signal=CAN4_ACT5_Select_position_specification}, {implementation-record-element=CAN4_ACT5_Save_programming_data, system-signal=CAN4_ACT5_Save_programming_data}, {implementation-record-element=CAN4_ACT5_Rotation_direction, system-signal=CAN4_ACT5_Rotation_direction}, {implementation-record-element=CAN4_ACT5_Emergency_run_release, system-signal=CAN4_ACT5_Emergency_run_release}, {implementation-record-element=CAN4_ACT5_Emergency_run_position, system-signal=CAN4_ACT5_Emergency_run_position}, {implementation-record-element=CAN4_ACT5_Clear_Event_Flags, system-signal=CAN4_ACT5_Clear_Event_Flags}, {implementation-record-element=CAN4_ACT5_Applied_holding_current, system-signal=CAN4_ACT5_Applied_holding_current}, {implementation-record-element=CAN4_ACT5_Actuator_start_position, system-signal=CAN4_ACT5_Actuator_start_position}, {implementation-record-element=CAN4_ACT5_Actuator_set_position, system-signal=CAN4_ACT5_Actuator_set_position}, {implementation-record-element=CAN4_ACT5_Actuator_address, system-signal=CAN4_ACT5_Actuator_address}, {implementation-record-element=CAN4_ACT4_Stop_mode, system-signal=CAN4_ACT4_Stop_mode}, {implementation-record-element=CAN4_ACT4_Stall_detection_release, system-signal=CAN4_ACT4_Stall_detection_release}, {implementation-record-element=CAN4_ACT4_Speed_specification, system-signal=CAN4_ACT4_Speed_specification}, {implementation-record-element=CAN4_ACT4_Select_position_specification, system-signal=CAN4_ACT4_Select_position_specification}, {implementation-record-element=CAN4_ACT4_Save_programming_data, system-signal=CAN4_ACT4_Save_programming_data}, {implementation-record-element=CAN4_ACT4_Rotation_direction, system-signal=CAN4_ACT4_Rotation_direction}, {implementation-record-element=CAN4_ACT4_Emergency_run_release, system-signal=CAN4_ACT4_Emergency_run_release}, {implementation-record-element=CAN4_ACT4_Emergency_run_position, system-signal=CAN4_ACT4_Emergency_run_position}, {implementation-record-element=CAN4_ACT4_Clear_Event_Flags, system-signal=CAN4_ACT4_Clear_Event_Flags}, {implementation-record-element=CAN4_ACT4_Applied_holding_current, system-signal=CAN4_ACT4_Applied_holding_current}, {implementation-record-element=CAN4_ACT4_Actuator_start_position, system-signal=CAN4_ACT4_Actuator_start_position}, {implementation-record-element=CAN4_ACT4_Actuator_set_position, system-signal=CAN4_ACT4_Actuator_set_position}, {implementation-record-element=CAN4_ACT4_Actuator_address, system-signal=CAN4_ACT4_Actuator_address}, {implementation-record-element=CAN4_ACT3_Stop_mode, system-signal=CAN4_ACT3_Stop_mode}, {implementation-record-element=CAN4_ACT3_Stall_detection_release, system-signal=CAN4_ACT3_Stall_detection_release}, {implementation-record-element=CAN4_ACT3_Speed_specification, system-signal=CAN4_ACT3_Speed_specification}, {implementation-record-element=CAN4_ACT3_Select_position_specification, system-signal=CAN4_ACT3_Select_position_specification}, {implementation-record-element=CAN4_ACT3_Save_programming_data, system-signal=CAN4_ACT3_Save_programming_data}, {implementation-record-element=CAN4_ACT3_Rotation_direction, system-signal=CAN4_ACT3_Rotation_direction}, {implementation-record-element=CAN4_ACT3_Emergency_run_release, system-signal=CAN4_ACT3_Emergency_run_release}, {implementation-record-element=CAN4_ACT3_Emergency_run_position, system-signal=CAN4_ACT3_Emergency_run_position}, {implementation-record-element=CAN4_ACT3_Clear_Event_Flags, system-signal=CAN4_ACT3_Clear_Event_Flags}, {implementation-record-element=CAN4_ACT3_Applied_holding_current, system-signal=CAN4_ACT3_Applied_holding_current}, {implementation-record-element=CAN4_ACT3_Actuator_start_position, system-signal=CAN4_ACT3_Actuator_start_position}, {implementation-record-element=CAN4_ACT3_Actuator_set_position, system-signal=CAN4_ACT3_Actuator_set_position}, {implementation-record-element=CAN4_ACT3_Actuator_address, system-signal=CAN4_ACT3_Actuator_address}, {implementation-record-element=CAN4_ACT2_Stop_mode, system-signal=CAN4_ACT2_Stop_mode}, {implementation-record-element=CAN4_ACT2_Stall_detection_release, system-signal=CAN4_ACT2_Stall_detection_release}, {implementation-record-element=CAN4_ACT2_Speed_specification, system-signal=CAN4_ACT2_Speed_specification}, {implementation-record-element=CAN4_ACT2_Select_position_specification, system-signal=CAN4_ACT2_Select_position_specification}, {implementation-record-element=CAN4_ACT2_Save_programming_data, system-signal=CAN4_ACT2_Save_programming_data}, {implementation-record-element=CAN4_ACT2_Rotation_direction, system-signal=CAN4_ACT2_Rotation_direction}, {implementation-record-element=CAN4_ACT2_Emergency_run_release, system-signal=CAN4_ACT2_Emergency_run_release}, {implementation-record-element=CAN4_ACT2_Emergency_run_position, system-signal=CAN4_ACT2_Emergency_run_position}, {implementation-record-element=CAN4_ACT2_Clear_Event_Flags, system-signal=CAN4_ACT2_Clear_Event_Flags}, {implementation-record-element=CAN4_ACT2_Applied_holding_current, system-signal=CAN4_ACT2_Applied_holding_current}, {implementation-record-element=CAN4_ACT2_Actuator_start_position, system-signal=CAN4_ACT2_Actuator_start_position}, {implementation-record-element=CAN4_ACT2_Actuator_set_position, system-signal=CAN4_ACT2_Actuator_set_position}, {implementation-record-element=CAN4_ACT2_Actuator_address, system-signal=CAN4_ACT2_Actuator_address}, {implementation-record-element=CAN4_ACT1_Stop_mode, system-signal=CAN4_ACT1_Stop_mode}, {implementation-record-element=CAN4_ACT1_Stall_detection_release, system-signal=CAN4_ACT1_Stall_detection_release}, {implementation-record-element=CAN4_ACT1_Speed_specification, system-signal=CAN4_ACT1_Speed_specification}, {implementation-record-element=CAN4_ACT1_Select_position_specification, system-signal=CAN4_ACT1_Select_position_specification}, {implementation-record-element=CAN4_ACT1_Save_programming_data, system-signal=CAN4_ACT1_Save_programming_data}, {implementation-record-element=CAN4_ACT1_Rotation_direction, system-signal=CAN4_ACT1_Rotation_direction}, {implementation-record-element=CAN4_ACT1_Emergency_run_release, system-signal=CAN4_ACT1_Emergency_run_release}, {implementation-record-element=CAN4_ACT1_Emergency_run_position, system-signal=CAN4_ACT1_Emergency_run_position}, {implementation-record-element=CAN4_ACT1_Clear_Event_Flags, system-signal=CAN4_ACT1_Clear_Event_Flags}, {implementation-record-element=CAN4_ACT1_Applied_holding_current, system-signal=CAN4_ACT1_Applied_holding_current}, {implementation-record-element=CAN4_ACT1_Actuator_start_position, system-signal=CAN4_ACT1_Actuator_start_position}, {implementation-record-element=CAN4_ACT1_Actuator_set_position, system-signal=CAN4_ACT1_Actuator_set_position}]}
