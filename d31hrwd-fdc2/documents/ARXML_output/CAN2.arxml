[part 2 of 2: packages /CAN2/Cluster to /CAN2/ImplementationDataTypes]
AUTOSAR XML (schema 4-3-0)
package /CAN2/Cluster  (continued)
  can cluster CAN2: baudrate=500, can-fd-baudrate=2000  (continued)
    can physical channel CAN2: comm-connectors=ConnCAN2  (continued)
      frame CAN2_IVI1: id 0x490, frame-length=20, can-addressing-mode=STANDARD, can-fd-frame-support=true, can-frame-rx-behavior=CAN-FD, can-frame-tx-behavior=CAN-FD
        pdu CAN2_IVI1: length=20, minimum-delay=0.0, transmission-mode-true-timing={cyclic-timing=time-period=0.5, event-controlled-timing={number-of-repetitions=0, repetition-period=0}}, unused-bit-pattern=0
          mapping CAN2_SG_IVI1: i-signal-group=CAN2_SG_IVI1, start-position=0, transfer-property=TRIGGERED-ON-CHANGE
          signal CAN2_A2B_Node_sta: start 55, 1 bit, big-endian, i-signal-type=PRIMITIVE, init-value=constant-reference=Init_CAN2_A2B_Node_sta, base-type=uint8, implementation-data-type=uint8, transfer-property=TRIGGERED-ON-CHANGE
          signal CAN2_AmbLigh_LowBatAlert_SW: start 33, 1 bit, big-endian, i-signal-type=PRIMITIVE, init-value=constant-reference=Init_CAN2_AmbLigh_LowBatAlert_SW, base-type=uint8, implementation-data-type=uint8, transfer-property=TRIGGERED-ON-CHANGE
          signal CAN2_AmbLigh_SafetyAlert_SW: start 32, 1 bit, big-endian, i-signal-type=PRIMITIVE, init-value=constant-reference=Init_CAN2_AmbLigh_SafetyAlert_SW, base-type=uint8, implementation-data-type=uint8, transfer-property=TRIGGERED-ON-CHANGE
          signal CAN2_AmbLightBrightnessSet: start 54, 7 bit, big-endian, i-signal-type=PRIMITIVE, init-value=constant-reference=Init_CAN2_AmbLightBrightnessSet, base-type=uint8, implementation-data-type=uint8, transfer-property=TRIGGERED-ON-CHANGE
          signal CAN2_AmbLightColorSet: start 46, 7 bit, big-endian, i-signal-type=PRIMITIVE, init-value=constant-reference=Init_CAN2_AmbLightColorSet, base-type=uint8, implementation-data-type=uint8, transfer-property=TRIGGERED-ON-CHANGE
          signal CAN2_AmbLight_DimInDark_SW: start 35, 1 bit, big-endian, i-signal-type=PRIMITIVE, init-value=constant-reference=Init_CAN2_AmbLight_DimInDark_SW, base-type=uint8, implementation-data-type=uint8, transfer-property=TRIGGERED-ON-CHANGE
          signal CAN2_AmbLight_SW: start 36, 1 bit, big-endian, i-signal-type=PRIMITIVE, init-value=constant-reference=Init_CAN2_AmbLight_SW, base-type=uint8, implementation-data-type=uint8, transfer-property=TRIGGERED-ON-CHANGE
          signal CAN2_AmbLight_WlcmLight_SW: start 34, 1 bit, big-endian, i-signal-type=PRIMITIVE, init-value=constant-reference=Init_CAN2_AmbLight_WlcmLight_SW, base-type=uint8, implementation-data-type=uint8, transfer-property=TRIGGERED-ON-CHANGE
          signal CAN2_BrkAbn_GoReady_SW: start 85, 1 bit, big-endian, i-signal-type=PRIMITIVE, init-value=constant-reference=Init_CAN2_BrkAbn_GoReady_SW, base-type=uint8, implementation-data-type=uint8, transfer-property=TRIGGERED-ON-CHANGE
          signal CAN2_FCP_FrEvt_BtnACMaxReq: start 20, 1 bit, big-endian, i-signal-type=PRIMITIVE, init-value=constant-reference=Init_CAN2_FCP_FrEvt_BtnACMaxReq, base-type=uint8, implementation-data-type=uint8, transfer-property=TRIGGERED-ON-CHANGE
          signal CAN2_FCP_FrEvt_BtnACReq: start 19, 1 bit, big-endian, i-signal-type=PRIMITIVE, init-value=constant-reference=Init_CAN2_FCP_FrEvt_BtnACReq, base-type=uint8, implementation-data-type=uint8, transfer-property=TRIGGERED-ON-CHANGE
          signal CAN2_FCP_FrEvt_BtnAutoReq: start 18, 1 bit, big-endian, i-signal-type=PRIMITIVE, init-value=constant-reference=Init_CAN2_FCP_FrEvt_BtnAutoReq, base-type=uint8, implementation-data-type=uint8, transfer-property=TRIGGERED-ON-CHANGE
          signal CAN2_FCP_FrEvt_BtnSyncReq: start 16, 1 bit, big-endian, i-signal-type=PRIMITIVE, init-value=constant-reference=Init_CAN2_FCP_FrEvt_BtnSyncReq, base-type=uint8, implementation-data-type=uint8, transfer-property=TRIGGERED-ON-CHANGE
          signal CAN2_FCP_MidEvt_BtnAutoReq: start 17, 1 bit, big-endian, i-signal-type=PRIMITIVE, init-value=constant-reference=Init_CAN2_FCP_MidEvt_BtnAutoReq, base-type=uint8, implementation-data-type=uint8, transfer-property=TRIGGERED-ON-CHANGE
          signal CAN2_IVI_AirRefresh_ByDMS_Sta: start 151, 1 bit, big-endian, i-signal-type=PRIMITIVE, init-value=constant-reference=Init_CAN2_IVI_AirRefresh_ByDMS_Sta, base-type=uint8, implementation-data-type=uint8, transfer-property=TRIGGERED-ON-CHANGE
          signal CAN2_IVI_AutoTheme_But_Sta: start 154, 1 bit, big-endian, i-signal-type=PRIMITIVE, init-value=constant-reference=Init_CAN2_IVI_AutoTheme_But_Sta, base-type=uint8, implementation-data-type=uint8, transfer-property=TRIGGERED-ON-CHANGE
          signal CAN2_IVI_AutoWipHSpdSW_Cmd: start 11, 1 bit, big-endian, i-signal-type=PRIMITIVE, init-value=constant-reference=Init_CAN2_IVI_AutoWipHSpdSW_Cmd, base-type=uint8, implementation-data-type=uint8, transfer-property=TRIGGERED-ON-CHANGE
          signal CAN2_IVI_CLWin_LockDoorSW_Sta: start 148, 1 bit, big-endian, i-signal-type=PRIMITIVE, init-value=constant-reference=Init_CAN2_IVI_CLWin_LockDoorSW_Sta, base-type=uint8, implementation-data-type=uint8, transfer-property=TRIGGERED-ON-CHANGE
          signal CAN2_IVI_CreateAccReq_Sta: start 127, 3 bit, big-endian, i-signal-type=PRIMITIVE, init-value=constant-reference=Init_CAN2_IVI_CreateAccReq_Sta, base-type=uint8, implementation-data-type=uint8, transfer-property=TRIGGERED-ON-CHANGE
          signal CAN2_IVI_DMS_SW_Sta: start 150, 1 bit, big-endian, i-signal-type=PRIMITIVE, init-value=constant-reference=Init_CAN2_IVI_DMS_SW_Sta, base-type=uint8, implementation-data-type=uint8, transfer-property=TRIGGERED-ON-CHANGE
          signal CAN2_IVI_DSEAT_StopKeepMove_Sta: start 13, 2 bit, big-endian, i-signal-type=PRIMITIVE, init-value=constant-reference=Init_CAN2_IVI_DSEAT_StopKeepMove_Sta, base-type=uint8, implementation-data-type=uint8, transfer-property=TRIGGERED-ON-CHANGE
          signal CAN2_IVI_DSEAT_anti_set_Sta: start 153, 1 bit, big-endian, i-signal-type=PRIMITIVE, init-value=constant-reference=Init_CAN2_IVI_DSEAT_anti_set_Sta, base-type=uint8, implementation-data-type=uint8, transfer-property=TRIGGERED-ON-CHANGE
          signal CAN2_IVI_DSEAT_entryfun_set_Sta: start 10, 1 bit, big-endian, i-signal-type=PRIMITIVE, init-value=constant-reference=Init_CAN2_IVI_DSEAT_entryfun_set_Sta, base-type=uint8, implementation-data-type=uint8, transfer-property=TRIGGERED-ON-CHANGE
          signal CAN2_IVI_DelAccReq_Sta: start 119, 3 bit, big-endian, i-signal-type=PRIMITIVE, init-value=constant-reference=Init_CAN2_IVI_DelAccReq_Sta, base-type=uint8, implementation-data-type=uint8, transfer-property=TRIGGERED-ON-CHANGE
          signal CAN2_IVI_Driving_Lock_SW_Sta: start 5, 1 bit, big-endian, i-signal-type=PRIMITIVE, init-value=constant-reference=Init_CAN2_IVI_Driving_Lock_SW_Sta, base-type=uint8, implementation-data-type=uint8, transfer-property=TRIGGERED-ON-CHANGE
          signal CAN2_IVI_EPS_Force_Cmd: start 15, 2 bit, big-endian, i-signal-type=PRIMITIVE, init-value=constant-reference=Init_CAN2_IVI_EPS_Force_Cmd, base-type=uint8, implementation-data-type=uint8, transfer-property=TRIGGERED-ON-CHANGE
          signal CAN2_IVI_FrTrunk_UnlockReq_Sta: start 147, 1 bit, big-endian, i-signal-type=PRIMITIVE, init-value=constant-reference=Init_CAN2_IVI_FrTrunk_UnlockReq_Sta, base-type=uint8, implementation-data-type=uint8, transfer-property=TRIGGERED-ON-CHANGE
          signal CAN2_IVI_HMI_Undefined_Sta: start 158, 3 bit, big-endian, i-signal-type=PRIMITIVE, init-value=constant-reference=Init_CAN2_IVI_HMI_Undefined_Sta, base-type=uint8, implementation-data-type=uint8, transfer-property=TRIGGERED-ON-CHANGE
          signal CAN2_IVI_LinkAccReq_Sta: start 143, 1 bit, big-endian, i-signal-type=PRIMITIVE, init-value=constant-reference=Init_CAN2_IVI_LinkAccReq_Sta, base-type=uint8, implementation-data-type=uint8, transfer-property=TRIGGERED-ON-CHANGE
          signal CAN2_IVI_LinkAcc_Sta: start 146, 3 bit, big-endian, i-signal-type=PRIMITIVE, init-value=constant-reference=Init_CAN2_IVI_LinkAcc_Sta, base-type=uint8, implementation-data-type=uint8, transfer-property=TRIGGERED-ON-CHANGE
          signal CAN2_IVI_LinkKey_Sta: start 135, 4 bit, big-endian, i-signal-type=PRIMITIVE, init-value=constant-reference=Init_CAN2_IVI_LinkKey_Sta, base-type=uint8, implementation-data-type=uint8, transfer-property=TRIGGERED-ON-CHANGE
          signal CAN2_IVI_Located_STA: start 79, 2 bit, big-endian, i-signal-type=PRIMITIVE, init-value=constant-reference=Init_CAN2_IVI_Located_STA, base-type=uint8, implementation-data-type=uint8, transfer-property=TRIGGERED-ON-CHANGE
          signal CAN2_IVI_Lock_SoundSW_Sta: start 149, 1 bit, big-endian, i-signal-type=PRIMITIVE, init-value=constant-reference=Init_CAN2_IVI_Lock_SoundSW_Sta, base-type=uint8, implementation-data-type=uint8, transfer-property=TRIGGERED-ON-CHANGE
          signal CAN2_IVI_MirrorFolded_SW_Sta: start 7, 1 bit, big-endian, i-signal-type=PRIMITIVE, init-value=constant-reference=Init_CAN2_IVI_MirrorFolded_SW_Sta, base-type=uint8, implementation-data-type=uint8, transfer-property=TRIGGERED-ON-CHANGE
          signal CAN2_IVI_NAVI_Foreground_Sta: start 155, 1 bit, big-endian, i-signal-type=PRIMITIVE, init-value=constant-reference=Init_CAN2_IVI_NAVI_Foreground_Sta, base-type=uint8, implementation-data-type=uint8, transfer-property=TRIGGERED-ON-CHANGE
          signal CAN2_IVI_OTA_Upd_Sta: start 28, 2 bit, big-endian, i-signal-type=PRIMITIVE, init-value=constant-reference=Init_CAN2_IVI_OTA_Upd_Sta, base-type=uint8, implementation-data-type=uint8, transfer-property=TRIGGERED-ON-CHANGE
          signal CAN2_IVI_QuickRefresh_Sta: start 159, 1 bit, big-endian, i-signal-type=PRIMITIVE, init-value=constant-reference=Init_CAN2_IVI_QuickRefresh_Sta, base-type=uint8, implementation-data-type=uint8, transfer-property=TRIGGERED-ON-CHANGE
          signal CAN2_IVI_SWC_VibMode_Sta: start 111, 2 bit, big-endian, i-signal-type=PRIMITIVE, init-value=constant-reference=Init_CAN2_IVI_SWC_VibMode_Sta, base-type=uint8, implementation-data-type=uint8, transfer-property=TRIGGERED-ON-CHANGE
          signal CAN2_IVI_SilentChrg_Alert_Sta: start 3, 1 bit, big-endian, i-signal-type=PRIMITIVE, init-value=constant-reference=Init_CAN2_IVI_SilentChrg_Alert_Sta, base-type=uint8, implementation-data-type=uint8, transfer-property=TRIGGERED-ON-CHANGE
          signal CAN2_IVI_Stopping_Unlock_SW_Sta: start 4, 1 bit, big-endian, i-signal-type=PRIMITIVE, init-value=constant-reference=Init_CAN2_IVI_Stopping_Unlock_SW_Sta, base-type=uint8, implementation-data-type=uint8, transfer-property=TRIGGERED-ON-CHANGE
          signal CAN2_IVI_Theme_Sta: start 1, 2 bit, big-endian, i-signal-type=PRIMITIVE, init-value=constant-reference=Init_CAN2_IVI_Theme_Sta, base-type=uint8, implementation-data-type=uint8, transfer-property=TRIGGERED-ON-CHANGE
          signal CAN2_IVI_Time_Check: start 95, 8 bit, big-endian, i-signal-type=PRIMITIVE, init-value=constant-reference=Init_CAN2_IVI_Time_Check, base-type=uint8, implementation-data-type=uint8, transfer-property=PENDING
          signal CAN2_IVI_Time_Day: start 116, 5 bit, big-endian, i-signal-type=PRIMITIVE, init-value=constant-reference=Init_CAN2_IVI_Time_Day, base-type=uint8, implementation-data-type=uint8, transfer-property=PENDING
          signal CAN2_IVI_Time_Hour: start 124, 5 bit, big-endian, i-signal-type=PRIMITIVE, init-value=constant-reference=Init_CAN2_IVI_Time_Hour, base-type=uint8, implementation-data-type=uint8, transfer-property=PENDING
          signal CAN2_IVI_Time_Minute: start 109, 6 bit, big-endian, i-signal-type=PRIMITIVE, init-value=constant-reference=Init_CAN2_IVI_Time_Minute, base-type=uint8, implementation-data-type=uint8, transfer-property=PENDING
          signal CAN2_IVI_Time_Month: start 131, 4 bit, big-endian, i-signal-type=PRIMITIVE, init-value=constant-reference=Init_CAN2_IVI_Time_Month, base-type=uint8, implementation-data-type=uint8, transfer-property=PENDING
          signal CAN2_IVI_Time_Second: start 101, 6 bit, big-endian, i-signal-type=PRIMITIVE, init-value=constant-reference=Init_CAN2_IVI_Time_Second, base-type=uint8, implementation-data-type=uint8, transfer-property=PENDING
          signal CAN2_IVI_Time_Year: start 142, 7 bit, big-endian, i-signal-type=PRIMITIVE, init-value=constant-reference=Init_CAN2_IVI_Time_Year, base-type=uint8, implementation-data-type=uint8, transfer-property=PENDING
          signal CAN2_IVI_WPTC_SW_Sta: start 6, 1 bit, big-endian, i-signal-type=PRIMITIVE, init-value=constant-reference=Init_CAN2_IVI_WPTC_SW_Sta, base-type=uint8, implementation-data-type=uint8, transfer-property=TRIGGERED-ON-CHANGE
          signal CAN2_IVI_WirelessCharge_Cmd: start 2, 1 bit, big-endian, i-signal-type=PRIMITIVE, init-value=constant-reference=Init_CAN2_IVI_WirelessCharge_Cmd, base-type=uint8, implementation-data-type=uint8, transfer-property=TRIGGERED-ON-CHANGE
          signal CAN2_IVI_sigScreenReq_Sta: start 152, 1 bit, big-endian, i-signal-type=PRIMITIVE, init-value=constant-reference=Init_CAN2_IVI_sigScreenReq_Sta, base-type=uint8, implementation-data-type=uint8, transfer-property=TRIGGERED-ON-CHANGE
          signal CAN2_LINKtoDrive: start 24, 1 bit, big-endian, i-signal-type=PRIMITIVE, init-value=constant-reference=Init_CAN2_LINKtoDrive, base-type=uint8, implementation-data-type=uint8, transfer-property=TRIGGERED-ON-CHANGE
          signal CAN2_OTA_CancelDL_Req: start 26, 1 bit, big-endian, i-signal-type=PRIMITIVE, init-value=constant-reference=Init_CAN2_OTA_CancelDL_Req, base-type=uint8, implementation-data-type=uint8, transfer-property=TRIGGERED-ON-CHANGE
          signal CAN2_OTA_CompNTFY_Pres: start 86, 1 bit, big-endian, i-signal-type=PRIMITIVE, init-value=constant-reference=Init_CAN2_OTA_CompNTFY_Pres, base-type=uint8, implementation-data-type=uint8, transfer-property=TRIGGERED-ON-CHANGE
          signal CAN2_OTA_DL_Req: start 31, 1 bit, big-endian, i-signal-type=PRIMITIVE, init-value=constant-reference=Init_CAN2_OTA_DL_Req, base-type=uint8, implementation-data-type=uint8, transfer-property=TRIGGERED-ON-CHANGE
          signal CAN2_OTA_SuspendDL_Req: start 30, 1 bit, big-endian, i-signal-type=PRIMITIVE, init-value=constant-reference=Init_CAN2_OTA_SuspendDL_Req, base-type=uint8, implementation-data-type=uint8, transfer-property=TRIGGERED-ON-CHANGE
          signal CAN2_OTA_UpdStart_Req: start 29, 1 bit, big-endian, i-signal-type=PRIMITIVE, init-value=constant-reference=Init_CAN2_OTA_UpdStart_Req, base-type=uint8, implementation-data-type=uint8, transfer-property=TRIGGERED-ON-CHANGE
          signal CAN2_OpenDrOpenWdo_SW: start 37, 1 bit, big-endian, i-signal-type=PRIMITIVE, init-value=constant-reference=Init_CAN2_OpenDrOpenWdo_SW, base-type=uint8, implementation-data-type=uint8, transfer-property=TRIGGERED-ON-CHANGE
          signal CAN2_PW_CLOSE_IMD: start 102, 1 bit, big-endian, i-signal-type=PRIMITIVE, init-value=constant-reference=Init_CAN2_PW_CLOSE_IMD, base-type=uint8, implementation-data-type=uint8, transfer-property=TRIGGERED-ON-CHANGE
          signal CAN2_PW_CONTINUE_USE: start 103, 1 bit, big-endian, i-signal-type=PRIMITIVE, init-value=constant-reference=Init_CAN2_PW_CONTINUE_USE, base-type=uint8, implementation-data-type=uint8, transfer-property=TRIGGERED-ON-CHANGE
          signal CAN2_Re_Radio_Sta: start 63, 1 bit, big-endian, i-signal-type=PRIMITIVE, init-value=constant-reference=Init_CAN2_Re_Radio_Sta, base-type=uint8, implementation-data-type=uint8, transfer-property=TRIGGERED-ON-CHANGE
          signal CAN2_Sched_Chg_Day_Set: start 62, 1 bit, big-endian, i-signal-type=PRIMITIVE, init-value=constant-reference=Init_CAN2_Sched_Chg_Day_Set, base-type=uint8, implementation-data-type=uint8, transfer-property=TRIGGERED-ON-CHANGE
          signal CAN2_Sched_Chg_End_Time_HR: start 84, 5 bit, big-endian, i-signal-type=PRIMITIVE, init-value=constant-reference=Init_CAN2_Sched_Chg_End_Time_HR, base-type=uint8, implementation-data-type=uint8, transfer-property=TRIGGERED-ON-CHANGE
          signal CAN2_Sched_Chg_End_Time_Min: start 77, 6 bit, big-endian, i-signal-type=PRIMITIVE, init-value=constant-reference=Init_CAN2_Sched_Chg_End_Time_Min, base-type=uint8, implementation-data-type=uint8, transfer-property=TRIGGERED-ON-CHANGE
          signal CAN2_Sched_Chg_St_Time_HR: start 68, 5 bit, big-endian, i-signal-type=PRIMITIVE, init-value=constant-reference=Init_CAN2_Sched_Chg_St_Time_HR, base-type=uint8, implementation-data-type=uint8, transfer-property=TRIGGERED-ON-CHANGE
          signal CAN2_Sched_Chg_St_Time_Min: start 61, 6 bit, big-endian, i-signal-type=PRIMITIVE, init-value=constant-reference=Init_CAN2_Sched_Chg_St_Time_Min, base-type=uint8, implementation-data-type=uint8, transfer-property=TRIGGERED-ON-CHANGE
          signal CAN2_Sched_OTA_wake: start 47, 1 bit, big-endian, i-signal-type=PRIMITIVE, init-value=constant-reference=Init_CAN2_Sched_OTA_wake, base-type=uint8, implementation-data-type=uint8, transfer-property=TRIGGERED-ON-CHANGE
          signal CAN2_SmartEco_Mode_SW: start 25, 1 bit, big-endian, i-signal-type=PRIMITIVE, init-value=constant-reference=Init_CAN2_SmartEco_Mode_SW, base-type=uint8, implementation-data-type=uint8, transfer-property=TRIGGERED-ON-CHANGE
          signal CAN2_Upd_Countdown_Cancel: start 38, 1 bit, big-endian, i-signal-type=PRIMITIVE, init-value=constant-reference=Init_CAN2_Upd_Countdown_Cancel, base-type=uint8, implementation-data-type=uint8, transfer-property=TRIGGERED-ON-CHANGE
          signal CAN2_Upd_Countdown_Skip: start 39, 1 bit, big-endian, i-signal-type=PRIMITIVE, init-value=constant-reference=Init_CAN2_Upd_Countdown_Skip, base-type=uint8, implementation-data-type=uint8, transfer-property=TRIGGERED-ON-CHANGE
          signal CAN2_UserSet: start 71, 3 bit, big-endian, i-signal-type=PRIMITIVE, init-value=constant-reference=Init_CAN2_UserSet, base-type=uint8, implementation-data-type=uint8, transfer-property=TRIGGERED-ON-CHANGE
          signal CAN2_VehACModReq: start 23, 3 bit, big-endian, i-signal-type=PRIMITIVE, init-value=constant-reference=Init_CAN2_VehACModReq, base-type=uint8, implementation-data-type=uint8, transfer-property=TRIGGERED-ON-CHANGE
          signal CAN2_mFRD_link_Sta: start 87, 1 bit, big-endian, i-signal-type=PRIMITIVE, init-value=constant-reference=Init_CAN2_mFRD_link_Sta, base-type=uint8, implementation-data-type=uint8, transfer-property=TRIGGERED-ON-CHANGE
      frame CAN2_IVI2: id 0x495, frame-length=64, can-addressing-mode=STANDARD, can-fd-frame-support=true, can-frame-rx-behavior=CAN-FD, can-frame-tx-behavior=CAN-FD
        pdu CAN2_IVI2: length=64, minimum-delay=0.0, transmission-mode-true-timing={cyclic-timing=time-period=0.2, event-controlled-timing={number-of-repetitions=0, repetition-period=0}}, unused-bit-pattern=0
          mapping CAN2_SG_IVI2: i-signal-group=CAN2_SG_IVI2, start-position=0, transfer-property=TRIGGERED-ON-CHANGE
          signal CAN2_AC_Chg_Cur_Set: start 462, 7 bit, big-endian, i-signal-type=PRIMITIVE, init-value=constant-reference=Init_CAN2_AC_Chg_Cur_Set, base-type=uint8, implementation-data-type=uint8, transfer-property=TRIGGERED-ON-CHANGE
          signal CAN2_AEB_BUTT: start 209, 2 bit, big-endian, i-signal-type=PRIMITIVE, init-value=constant-reference=Init_CAN2_AEB_BUTT, base-type=uint8, implementation-data-type=uint8, transfer-property=TRIGGERED-ON-CHANGE
          signal CAN2_AVM_Err_STA: start 399, 1 bit, big-endian, i-signal-type=PRIMITIVE, init-value=constant-reference=Init_CAN2_AVM_Err_STA, base-type=uint8, implementation-data-type=uint8, transfer-property=TRIGGERED-ON-CHANGE
          signal CAN2_AVM_OFF_Rec_Butt: start 508, 1 bit, big-endian, i-signal-type=PRIMITIVE, init-value=constant-reference=Init_CAN2_AVM_OFF_Rec_Butt, base-type=uint8, implementation-data-type=uint8, transfer-property=TRIGGERED-ON-CHANGE
          signal CAN2_AVM_Parking_mode: start 407, 4 bit, big-endian, i-signal-type=PRIMITIVE, init-value=constant-reference=Init_CAN2_AVM_Parking_mode, base-type=uint8, implementation-data-type=uint8, transfer-property=TRIGGERED-ON-CHANGE
          signal CAN2_AVM_parking_cancel: start 505, 2 bit, big-endian, i-signal-type=PRIMITIVE, init-value=constant-reference=Init_CAN2_AVM_parking_cancel, base-type=uint8, implementation-data-type=uint8, transfer-property=TRIGGERED-ON-CHANGE
          signal CAN2_AVM_parking_excute: start 507, 2 bit, big-endian, i-signal-type=PRIMITIVE, init-value=constant-reference=Init_CAN2_AVM_parking_excute, base-type=uint8, implementation-data-type=uint8, transfer-property=TRIGGERED-ON-CHANGE
          signal CAN2_Approach_Unlock_SW: start 9, 1 bit, big-endian, i-signal-type=PRIMITIVE, init-value=constant-reference=Init_CAN2_Approach_Unlock_SW, base-type=uint8, implementation-data-type=uint8, transfer-property=TRIGGERED-ON-CHANGE
          signal CAN2_BSDMute_BUTT: start 225, 2 bit, big-endian, i-signal-type=PRIMITIVE, init-value=constant-reference=Init_CAN2_BSDMute_BUTT, base-type=uint8, implementation-data-type=uint8, transfer-property=TRIGGERED-ON-CHANGE
          signal CAN2_CAAS_Sw: start 353, 2 bit, big-endian, i-signal-type=PRIMITIVE, init-value=constant-reference=Init_CAN2_CAAS_Sw, base-type=uint8, implementation-data-type=uint8, transfer-property=TRIGGERED-ON-CHANGE
          signal CAN2_CDL_Lock_Butt: start 469, 1 bit, big-endian, i-signal-type=PRIMITIVE, init-value=constant-reference=Init_CAN2_CDL_Lock_Butt, base-type=uint8, implementation-data-type=uint8, transfer-property=TRIGGERED-ON-CHANGE
          signal CAN2_CDL_Unlock_Butt: start 470, 1 bit, big-endian, i-signal-type=PRIMITIVE, init-value=constant-reference=Init_CAN2_CDL_Unlock_Butt, base-type=uint8, implementation-data-type=uint8, transfer-property=TRIGGERED-ON-CHANGE
          signal CAN2_CameraWrn: start 286, 1 bit, big-endian, i-signal-type=PRIMITIVE, init-value=constant-reference=Init_CAN2_CameraWrn, base-type=uint8, implementation-data-type=uint8, transfer-property=TRIGGERED-ON-CHANGE
          signal CAN2_DMS_Status: start 61, 2 bit, big-endian, i-signal-type=PRIMITIVE, init-value=constant-reference=Init_CAN2_DMS_Status, base-type=uint8, implementation-data-type=uint8, transfer-property=PENDING
          signal CAN2_DMS_Warning_Distraction: start 59, 2 bit, big-endian, i-signal-type=PRIMITIVE, init-value=constant-reference=Init_CAN2_DMS_Warning_Distraction, base-type=uint8, implementation-data-type=uint8, transfer-property=PENDING
          signal CAN2_DMS_Warning_Fatigue: start 57, 2 bit, big-endian, i-signal-type=PRIMITIVE, init-value=constant-reference=Init_CAN2_DMS_Warning_Fatigue, base-type=uint8, implementation-data-type=uint8, transfer-property=PENDING
          signal CAN2_DMS_Warning_Unresponsive: start 62, 1 bit, big-endian, i-signal-type=PRIMITIVE, init-value=constant-reference=Init_CAN2_DMS_Warning_Unresponsive, base-type=uint8, implementation-data-type=uint8, transfer-property=PENDING
          signal CAN2_DSEAT_anti_set: start 355, 1 bit, big-endian, i-signal-type=PRIMITIVE, init-value=constant-reference=Init_CAN2_DSEAT_anti_set, base-type=uint8, implementation-data-type=uint8, transfer-property=TRIGGERED-ON-CHANGE
          signal CAN2_DSEAT_entryfun_set: start 354, 1 bit, big-endian, i-signal-type=PRIMITIVE, init-value=constant-reference=Init_CAN2_DSEAT_entryfun_set, base-type=uint8, implementation-data-type=uint8, transfer-property=TRIGGERED-ON-CHANGE
          signal CAN2_DSEAT_vent_req: start 342, 3 bit, big-endian, i-signal-type=PRIMITIVE, init-value=constant-reference=Init_CAN2_DSEAT_vent_req, base-type=uint8, implementation-data-type=uint8, transfer-property=TRIGGERED-ON-CHANGE
          signal CAN2_Distance_unit: start 243, 1 bit, big-endian, i-signal-type=PRIMITIVE, init-value=constant-reference=Init_CAN2_Distance_unit, base-type=uint8, implementation-data-type=uint8, transfer-property=TRIGGERED-ON-CHANGE
          signal CAN2_ESC_SW_Cmd: start 245, 2 bit, big-endian, i-signal-type=PRIMITIVE, init-value=constant-reference=Init_CAN2_ESC_SW_Cmd, base-type=uint8, implementation-data-type=uint8, transfer-property=TRIGGERED-ON-CHANGE
          signal CAN2_FCWMute_BUTT: start 233, 2 bit, big-endian, i-signal-type=PRIMITIVE, init-value=constant-reference=Init_CAN2_FCWMute_BUTT, base-type=uint8, implementation-data-type=uint8, transfer-property=TRIGGERED-ON-CHANGE
          signal CAN2_FFogLampSW: start 339, 1 bit, big-endian, i-signal-type=PRIMITIVE, init-value=constant-reference=Init_CAN2_FFogLampSW, base-type=uint8, implementation-data-type=uint8, transfer-property=TRIGGERED-ON-CHANGE
          signal CAN2_FS_Off_Sw: start 351, 2 bit, big-endian, i-signal-type=PRIMITIVE, init-value=constant-reference=Init_CAN2_FS_Off_Sw, base-type=uint8, implementation-data-type=uint8, transfer-property=TRIGGERED-ON-CHANGE
          signal CAN2_FalseNPrevent_SW: start 10, 1 bit, big-endian, i-signal-type=PRIMITIVE, init-value=constant-reference=Init_CAN2_FalseNPrevent_SW, base-type=uint8, implementation-data-type=uint8, transfer-property=TRIGGERED-ON-CHANGE
          signal CAN2_FollowMeSW: start 358, 1 bit, big-endian, i-signal-type=PRIMITIVE, init-value=constant-reference=Init_CAN2_FollowMeSW, base-type=uint8, implementation-data-type=uint8, transfer-property=TRIGGERED-ON-CHANGE
          signal CAN2_GPS_LAT: start 167, 32 bit, big-endian, i-signal-type=PRIMITIVE, init-value=constant-reference=Init_CAN2_GPS_LAT, base-type=uint32, implementation-data-type=uint32, transfer-property=TRIGGERED-ON-CHANGE
          signal CAN2_GPS_LONG: start 135, 32 bit, big-endian, i-signal-type=PRIMITIVE, init-value=constant-reference=Init_CAN2_GPS_LONG, base-type=uint32, implementation-data-type=uint32, transfer-property=TRIGGERED-ON-CHANGE
          signal CAN2_HeadLampSW: start 321, 2 bit, big-endian, i-signal-type=PRIMITIVE, init-value=constant-reference=Init_CAN2_HeadLampSW, base-type=uint8, implementation-data-type=uint8, transfer-property=TRIGGERED-ON-CHANGE
          signal CAN2_Hood_Latch_SW: start 393, 2 bit, big-endian, i-signal-type=PRIMITIVE, init-value=constant-reference=Init_CAN2_Hood_Latch_SW, base-type=uint8, implementation-data-type=uint8, transfer-property=TRIGGERED-ON-CHANGE
          signal CAN2_IVI_ACC_Adaptive_Sta: start 454, 1 bit, big-endian, i-signal-type=PRIMITIVE, init-value=constant-reference=Init_CAN2_IVI_ACC_Adaptive_Sta, base-type=uint8, implementation-data-type=uint8, transfer-property=TRIGGERED-ON-CHANGE
          signal CAN2_IVI_AGSCloseSW: start 511, 2 bit, big-endian, i-signal-type=PRIMITIVE, init-value=constant-reference=Init_CAN2_IVI_AGSCloseSW, base-type=uint8, implementation-data-type=uint8, transfer-property=TRIGGERED-ON-CHANGE
          signal CAN2_IVI_ActvDmpDisabSW: start 503, 2 bit, big-endian, i-signal-type=PRIMITIVE, init-value=constant-reference=Init_CAN2_IVI_ActvDmpDisabSW, base-type=uint8, implementation-data-type=uint8, transfer-property=TRIGGERED-ON-CHANGE
          signal CAN2_IVI_AirIntZ3_Cmd: start 34, 3 bit, big-endian, i-signal-type=PRIMITIVE, init-value=constant-reference=Init_CAN2_IVI_AirIntZ3_Cmd, base-type=uint8, implementation-data-type=uint8, transfer-property=TRIGGERED-ON-CHANGE
          signal CAN2_IVI_Backlight_Sta: start 509, 1 bit, big-endian, i-signal-type=PRIMITIVE, init-value=constant-reference=Init_CAN2_IVI_Backlight_Sta, base-type=uint8, implementation-data-type=uint8, transfer-property=TRIGGERED-ON-CHANGE
          signal CAN2_IVI_CarWash_Mode_Cmd: start 63, 1 bit, big-endian, i-signal-type=PRIMITIVE, init-value=constant-reference=Init_CAN2_IVI_CarWash_Mode_Cmd, base-type=uint8, implementation-data-type=uint8, transfer-property=TRIGGERED-ON-CHANGE
          signal CAN2_IVI_CfmTo_Rdy: start 15, 1 bit, big-endian, i-signal-type=PRIMITIVE, init-value=constant-reference=Init_CAN2_IVI_CfmTo_Rdy, base-type=uint8, implementation-data-type=uint8, transfer-property=TRIGGERED-ON-CHANGE
          signal CAN2_IVI_ChargePortSW_Sta: start 479, 1 bit, big-endian, i-signal-type=PRIMITIVE, init-value=constant-reference=Init_CAN2_IVI_ChargePortSW_Sta, base-type=uint8, implementation-data-type=uint8, transfer-property=TRIGGERED-ON-CHANGE
          signal CAN2_IVI_CoastDwSW: start 501, 2 bit, big-endian, i-signal-type=PRIMITIVE, init-value=constant-reference=Init_CAN2_IVI_CoastDwSW, base-type=uint8, implementation-data-type=uint8, transfer-property=TRIGGERED-ON-CHANGE
          signal CAN2_IVI_CreepSW_Req: start 11, 1 bit, big-endian, i-signal-type=PRIMITIVE, init-value=constant-reference=Init_CAN2_IVI_CreepSW_Req, base-type=uint8, implementation-data-type=uint8, transfer-property=TRIGGERED-ON-CHANGE
          signal CAN2_IVI_DMS_Faceblocked_Sta: start 489, 2 bit, big-endian, i-signal-type=PRIMITIVE, init-value=constant-reference=Init_CAN2_IVI_DMS_Faceblocked_Sta, base-type=uint8, implementation-data-type=uint8, transfer-property=TRIGGERED-ON-CHANGE
          signal CAN2_IVI_DMS_NoDriverDetected_Sta: start 491, 2 bit, big-endian, i-signal-type=PRIMITIVE, init-value=constant-reference=Init_CAN2_IVI_DMS_NoDriverDetected_Sta, base-type=uint8, implementation-data-type=uint8, transfer-property=TRIGGERED-ON-CHANGE
          signal CAN2_IVI_DSEATHeater_Cmd: start 23, 3 bit, big-endian, i-signal-type=PRIMITIVE, init-value=constant-reference=Init_CAN2_IVI_DSEATHeater_Cmd, base-type=uint8, implementation-data-type=uint8, transfer-property=TRIGGERED-ON-CHANGE
          signal CAN2_IVI_DSEAT_FroEdge_Height_Cmd: start 51, 2 bit, big-endian, i-signal-type=PRIMITIVE, init-value=constant-reference=Init_CAN2_IVI_DSEAT_FroEdge_Height_Cmd, base-type=uint8, implementation-data-type=uint8, transfer-property=TRIGGERED-ON-CHANGE
          signal CAN2_IVI_DSEAT_Height_Cmd: start 53, 2 bit, big-endian, i-signal-type=PRIMITIVE, init-value=constant-reference=Init_CAN2_IVI_DSEAT_Height_Cmd, base-type=uint8, implementation-data-type=uint8, transfer-property=TRIGGERED-ON-CHANGE
          signal CAN2_IVI_DSEAT_Memory1_Sta: start 27, 1 bit, big-endian, i-signal-type=PRIMITIVE, init-value=constant-reference=Init_CAN2_IVI_DSEAT_Memory1_Sta, base-type=uint8, implementation-data-type=uint8, transfer-property=TRIGGERED-ON-CHANGE
          signal CAN2_IVI_DSEAT_Memory2_Sta: start 26, 1 bit, big-endian, i-signal-type=PRIMITIVE, init-value=constant-reference=Init_CAN2_IVI_DSEAT_Memory2_Sta, base-type=uint8, implementation-data-type=uint8, transfer-property=TRIGGERED-ON-CHANGE
          signal CAN2_IVI_DSEAT_Memory_OPTCLS_Sta: start 42, 1 bit, big-endian, i-signal-type=PRIMITIVE, init-value=constant-reference=Init_CAN2_IVI_DSEAT_Memory_OPTCLS_Sta, base-type=uint8, implementation-data-type=uint8, transfer-property=TRIGGERED-ON-CHANGE
          signal CAN2_IVI_DSEAT_Recline_Cmd: start 55, 2 bit, big-endian, i-signal-type=PRIMITIVE, init-value=constant-reference=Init_CAN2_IVI_DSEAT_Recline_Cmd, base-type=uint8, implementation-data-type=uint8, transfer-property=TRIGGERED-ON-CHANGE
          signal CAN2_IVI_DSEAT_Slide_Cmd: start 25, 2 bit, big-endian, i-signal-type=PRIMITIVE, init-value=constant-reference=Init_CAN2_IVI_DSEAT_Slide_Cmd, base-type=uint8, implementation-data-type=uint8, transfer-property=TRIGGERED-ON-CHANGE
          signal CAN2_IVI_FGSAirInt_Cmd: start 87, 3 bit, big-endian, i-signal-type=PRIMITIVE, init-value=constant-reference=Init_CAN2_IVI_FGSAirInt_Cmd, base-type=uint8, implementation-data-type=uint8, transfer-property=TRIGGERED-ON-CHANGE
          signal CAN2_IVI_FGSCh_Cmd: start 231, 2 bit, big-endian, i-signal-type=PRIMITIVE, init-value=constant-reference=Init_CAN2_IVI_FGSCh_Cmd, base-type=uint8, implementation-data-type=uint8, transfer-property=TRIGGERED-ON-CHANGE
          signal CAN2_IVI_FWipIntTSet_Cmd: start 71, 3 bit, big-endian, i-signal-type=PRIMITIVE, init-value=constant-reference=Init_CAN2_IVI_FWipIntTSet_Cmd, base-type=uint8, implementation-data-type=uint8, transfer-property=TRIGGERED-ON-CHANGE
          signal CAN2_IVI_GPS_Lat_Dir_Sta: start 65, 2 bit, big-endian, i-signal-type=PRIMITIVE, init-value=constant-reference=Init_CAN2_IVI_GPS_Lat_Dir_Sta, base-type=uint8, implementation-data-type=uint8, transfer-property=PENDING
          signal CAN2_IVI_GPS_Long_Dir_Sta: start 67, 2 bit, big-endian, i-signal-type=PRIMITIVE, init-value=constant-reference=Init_CAN2_IVI_GPS_Long_Dir_Sta, base-type=uint8, implementation-data-type=uint8, transfer-property=PENDING
          signal CAN2_IVI_IC_Brightness_Sta: start 486, 7 bit, big-endian, i-signal-type=PRIMITIVE, init-value=constant-reference=Init_CAN2_IVI_IC_Brightness_Sta, base-type=uint8, implementation-data-type=uint8, transfer-property=TRIGGERED-ON-CHANGE
          signal CAN2_IVI_IONSW_Cmd: start 229, 1 bit, big-endian, i-signal-type=PRIMITIVE, init-value=constant-reference=Init_CAN2_IVI_IONSW_Cmd, base-type=uint8, implementation-data-type=uint8, transfer-property=TRIGGERED-ON-CHANGE
          signal CAN2_IVI_ISA_OffsetSpd: start 451, 4 bit, big-endian, i-signal-type=PRIMITIVE, init-value=constant-reference=Init_CAN2_IVI_ISA_OffsetSpd, base-type=uint8, implementation-data-type=uint8, transfer-property=TRIGGERED-ON-CHANGE
          signal CAN2_IVI_LVChrgFuncSW: start 497, 2 bit, big-endian, i-signal-type=PRIMITIVE, init-value=constant-reference=Init_CAN2_IVI_LVChrgFuncSW, base-type=uint8, implementation-data-type=uint8, transfer-property=TRIGGERED-ON-CHANGE
          signal CAN2_IVI_Mute_Sta: start 360, 1 bit, big-endian, i-signal-type=PRIMITIVE, init-value=constant-reference=Init_CAN2_IVI_Mute_Sta, base-type=uint8, implementation-data-type=uint8, transfer-property=TRIGGERED-ON-CHANGE
          signal CAN2_IVI_Night_Mode_Sta: start 364, 1 bit, big-endian, i-signal-type=PRIMITIVE, init-value=constant-reference=Init_CAN2_IVI_Night_Mode_Sta, base-type=uint8, implementation-data-type=uint8, transfer-property=TRIGGERED-ON-CHANGE
          signal CAN2_IVI_Off_Road_Mode_Sta: start 68, 1 bit, big-endian, i-signal-type=PRIMITIVE, init-value=constant-reference=Init_CAN2_IVI_Off_Road_Mode_Sta, base-type=uint8, implementation-data-type=uint8, transfer-property=PENDING
          signal CAN2_IVI_PSEATHeater_Cmd: start 20, 3 bit, big-endian, i-signal-type=PRIMITIVE, init-value=constant-reference=Init_CAN2_IVI_PSEATHeater_Cmd, base-type=uint8, implementation-data-type=uint8, transfer-property=TRIGGERED-ON-CHANGE
          signal CAN2_IVI_PSEAT_Recline_Cmd: start 41, 2 bit, big-endian, i-signal-type=PRIMITIVE, init-value=constant-reference=Init_CAN2_IVI_PSEAT_Recline_Cmd, base-type=uint8, implementation-data-type=uint8, transfer-property=TRIGGERED-ON-CHANGE
          signal CAN2_IVI_PSEAT_Slide_Cmd: start 49, 2 bit, big-endian, i-signal-type=PRIMITIVE, init-value=constant-reference=Init_CAN2_IVI_PSEAT_Slide_Cmd, base-type=uint8, implementation-data-type=uint8, transfer-property=TRIGGERED-ON-CHANGE
          signal CAN2_IVI_PTG_Mode_SW: start 345, 2 bit, big-endian, i-signal-type=PRIMITIVE, init-value=constant-reference=Init_CAN2_IVI_PTG_Mode_SW, base-type=uint8, implementation-data-type=uint8, transfer-property=TRIGGERED-ON-CHANGE
          signal CAN2_IVI_PTG_Open_Height: start 14, 3 bit, big-endian, i-signal-type=PRIMITIVE, init-value=constant-reference=Init_CAN2_IVI_PTG_Open_Height, base-type=uint8, implementation-data-type=uint8, transfer-property=TRIGGERED-ON-CHANGE
          signal CAN2_IVI_PTG_Sta_SW: start 347, 2 bit, big-endian, i-signal-type=PRIMITIVE, init-value=constant-reference=Init_CAN2_IVI_PTG_Sta_SW, base-type=uint8, implementation-data-type=uint8, transfer-property=TRIGGERED-ON-CHANGE
          signal CAN2_IVI_PTG_USSta_SW: start 361, 1 bit, big-endian, i-signal-type=PRIMITIVE, init-value=constant-reference=Init_CAN2_IVI_PTG_USSta_SW, base-type=uint8, implementation-data-type=uint8, transfer-property=TRIGGERED-ON-CHANGE
          signal CAN2_IVI_PW_Mode_Req: start 284, 2 bit, big-endian, i-signal-type=PRIMITIVE, init-value=constant-reference=Init_CAN2_IVI_PW_Mode_Req, base-type=uint8, implementation-data-type=uint8, transfer-property=TRIGGERED-ON-CHANGE
          signal CAN2_IVI_Panel_Act: start 246, 1 bit, big-endian, i-signal-type=PRIMITIVE, init-value=constant-reference=Init_CAN2_IVI_Panel_Act, base-type=uint8, implementation-data-type=uint8, transfer-property=TRIGGERED-ON-CHANGE
          signal CAN2_IVI_Panel_X_Coor: start 303, 12 bit, big-endian, i-signal-type=PRIMITIVE, init-value=constant-reference=Init_CAN2_IVI_Panel_X_Coor, base-type=uint16, implementation-data-type=uint16, transfer-property=PENDING
          signal CAN2_IVI_Panel_Y_Coor: start 307, 12 bit, big-endian, i-signal-type=PRIMITIVE, init-value=constant-reference=Init_CAN2_IVI_Panel_Y_Coor, base-type=uint16, implementation-data-type=uint16, transfer-property=PENDING
          signal CAN2_IVI_PwrLockSW: start 499, 2 bit, big-endian, i-signal-type=PRIMITIVE, init-value=constant-reference=Init_CAN2_IVI_PwrLockSW, base-type=uint8, implementation-data-type=uint8, transfer-property=TRIGGERED-ON-CHANGE
          signal CAN2_IVI_Pwroff_req: start 397, 1 bit, big-endian, i-signal-type=PRIMITIVE, init-value=constant-reference=Init_CAN2_IVI_Pwroff_req, base-type=uint8, implementation-data-type=uint8, transfer-property=TRIGGERED-ON-CHANGE
          signal CAN2_IVI_RR_Def_Req: start 363, 1 bit, big-endian, i-signal-type=PRIMITIVE, init-value=constant-reference=Init_CAN2_IVI_RR_Def_Req, base-type=uint8, implementation-data-type=uint8, transfer-property=TRIGGERED-ON-CHANGE
          signal CAN2_IVI_Req_V2L: start 17, 2 bit, big-endian, i-signal-type=PRIMITIVE, init-value=constant-reference=Init_CAN2_IVI_Req_V2L, base-type=uint8, implementation-data-type=uint8, transfer-property=TRIGGERED-ON-CHANGE
          signal CAN2_IVI_SLIF_Warning_Sta: start 453, 2 bit, big-endian, i-signal-type=PRIMITIVE, init-value=constant-reference=Init_CAN2_IVI_SLIF_Warning_Sta, base-type=uint8, implementation-data-type=uint8, transfer-property=TRIGGERED-ON-CHANGE
          signal CAN2_IVI_SWC_ACCMode_Sta: start 463, 1 bit, big-endian, i-signal-type=PRIMITIVE, init-value=constant-reference=Init_CAN2_IVI_SWC_ACCMode_Sta, base-type=uint8, implementation-data-type=uint8, transfer-property=TRIGGERED-ON-CHANGE
          signal CAN2_IVI_SWC_LUndefined_Sta: start 75, 4 bit, big-endian, i-signal-type=PRIMITIVE, init-value=constant-reference=Init_CAN2_IVI_SWC_LUndefined_Sta, base-type=uint8, implementation-data-type=uint8, transfer-property=TRIGGERED-ON-CHANGE
          signal CAN2_IVI_SWC_RUndefined_Sta: start 79, 4 bit, big-endian, i-signal-type=PRIMITIVE, init-value=constant-reference=Init_CAN2_IVI_SWC_RUndefined_Sta, base-type=uint8, implementation-data-type=uint8, transfer-property=TRIGGERED-ON-CHANGE
          signal CAN2_IVI_Screen: start 269, 6 bit, big-endian, i-signal-type=PRIMITIVE, init-value=constant-reference=Init_CAN2_IVI_Screen, base-type=uint8, implementation-data-type=uint8, transfer-property=TRIGGERED-ON-CHANGE
          signal CAN2_IVI_SetTempZon1_Sta: start 39, 5 bit, big-endian, i-signal-type=PRIMITIVE, init-value=constant-reference=Init_CAN2_IVI_SetTempZon1_Sta, base-type=uint8, implementation-data-type=uint8, transfer-property=TRIGGERED-ON-CHANGE
          signal CAN2_IVI_SetTempZon2_Sta: start 47, 5 bit, big-endian, i-signal-type=PRIMITIVE, init-value=constant-reference=Init_CAN2_IVI_SetTempZon2_Sta, base-type=uint8, implementation-data-type=uint8, transfer-property=TRIGGERED-ON-CHANGE
          signal CAN2_IVI_Start_Chg_req: start 103, 1 bit, big-endian, i-signal-type=PRIMITIVE, init-value=constant-reference=Init_CAN2_IVI_Start_Chg_req, base-type=uint8, implementation-data-type=uint8, transfer-property=TRIGGERED-ON-CHANGE
          signal CAN2_IVI_Status: start 365, 1 bit, big-endian, i-signal-type=PRIMITIVE, init-value=constant-reference=Init_CAN2_IVI_Status, base-type=uint8, implementation-data-type=uint8, transfer-property=TRIGGERED-ON-CHANGE
          signal CAN2_IVI_Stop_Chg_req: start 111, 1 bit, big-endian, i-signal-type=PRIMITIVE, init-value=constant-reference=Init_CAN2_IVI_Stop_Chg_req, base-type=uint8, implementation-data-type=uint8, transfer-property=TRIGGERED-ON-CHANGE
          signal CAN2_IVI_TrailerCheckReq_Sta: start 356, 1 bit, big-endian, i-signal-type=PRIMITIVE, init-value=constant-reference=Init_CAN2_IVI_TrailerCheckReq_Sta, base-type=uint8, implementation-data-type=uint8, transfer-property=TRIGGERED-ON-CHANGE
          signal CAN2_IVI_TrailerModeSW_Sta: start 394, 1 bit, big-endian, i-signal-type=PRIMITIVE, init-value=constant-reference=Init_CAN2_IVI_TrailerModeSW_Sta, base-type=uint8, implementation-data-type=uint8, transfer-property=TRIGGERED-ON-CHANGE
          signal CAN2_IVI_Trigger_req: start 398, 1 bit, big-endian, i-signal-type=PRIMITIVE, init-value=constant-reference=Init_CAN2_IVI_Trigger_req, base-type=uint8, implementation-data-type=uint8, transfer-property=TRIGGERED-ON-CHANGE
          signal CAN2_IVI_Unlock_Chg_req: start 119, 1 bit, big-endian, i-signal-type=PRIMITIVE, init-value=constant-reference=Init_CAN2_IVI_Unlock_Chg_req, base-type=uint8, implementation-data-type=uint8, transfer-property=TRIGGERED-ON-CHANGE
          signal CAN2_IVI_WI_MAIN_SW: start 362, 1 bit, big-endian, i-signal-type=PRIMITIVE, init-value=constant-reference=Init_CAN2_IVI_WI_MAIN_SW, base-type=uint8, implementation-data-type=uint8, transfer-property=TRIGGERED-ON-CHANGE
          signal CAN2_LDWMute_BUTT: start 239, 2 bit, big-endian, i-signal-type=PRIMITIVE, init-value=constant-reference=Init_CAN2_LDWMute_BUTT, base-type=uint8, implementation-data-type=uint8, transfer-property=TRIGGERED-ON-CHANGE
          signal CAN2_LKA_BUTT: start 235, 2 bit, big-endian, i-signal-type=PRIMITIVE, init-value=constant-reference=Init_CAN2_LKA_BUTT, base-type=uint8, implementation-data-type=uint8, transfer-property=TRIGGERED-ON-CHANGE
          signal CAN2_LVDAMute_BUTT: start 367, 2 bit, big-endian, i-signal-type=PRIMITIVE, init-value=constant-reference=Init_CAN2_LVDAMute_BUTT, base-type=uint8, implementation-data-type=uint8, transfer-property=TRIGGERED-ON-CHANGE
          signal CAN2_L_Drv_ControlCommand: start 126, 7 bit, big-endian, i-signal-type=PRIMITIVE, init-value=constant-reference=Init_CAN2_L_Drv_ControlCommand, base-type=uint8, implementation-data-type=uint8, transfer-property=PENDING
          signal CAN2_L_Pas_ControlCommand: start 118, 7 bit, big-endian, i-signal-type=PRIMITIVE, init-value=constant-reference=Init_CAN2_L_Pas_ControlCommand, base-type=uint8, implementation-data-type=uint8, transfer-property=PENDING
          signal CAN2_L_RLD_ControlCommand: start 110, 7 bit, big-endian, i-signal-type=PRIMITIVE, init-value=constant-reference=Init_CAN2_L_RLD_ControlCommand, base-type=uint8, implementation-data-type=uint8, transfer-property=PENDING
          signal CAN2_L_RRD_ControlCommand: start 102, 7 bit, big-endian, i-signal-type=PRIMITIVE, init-value=constant-reference=Init_CAN2_L_RRD_ControlCommand, base-type=uint8, implementation-data-type=uint8, transfer-property=PENDING
          signal CAN2_Light_ShowStart_Req: start 29, 1 bit, big-endian, i-signal-type=PRIMITIVE, init-value=constant-reference=Init_CAN2_Light_ShowStart_Req, base-type=uint8, implementation-data-type=uint8, transfer-property=TRIGGERED-ON-CHANGE
          signal CAN2_Light_ShowStop_Req: start 28, 1 bit, big-endian, i-signal-type=PRIMITIVE, init-value=constant-reference=Init_CAN2_Light_ShowStop_Req, base-type=uint8, implementation-data-type=uint8, transfer-property=TRIGGERED-ON-CHANGE
          signal CAN2_METER_Malfunc_Sta: start 89, 2 bit, big-endian, i-signal-type=PRIMITIVE, init-value=constant-reference=Init_CAN2_METER_Malfunc_Sta, base-type=uint8, implementation-data-type=uint8, transfer-property=TRIGGERED-ON-CHANGE
          signal CAN2_MFRD_N_Bright_Req: start 334, 7 bit, big-endian, i-signal-type=PRIMITIVE, init-value=constant-reference=Init_CAN2_MFRD_N_Bright_Req, base-type=uint8, implementation-data-type=uint8, transfer-property=TRIGGERED-ON-CHANGE
          signal CAN2_NAVI_Cam_Dist_info: start 295, 8 bit, big-endian, i-signal-type=PRIMITIVE, init-value=constant-reference=Init_CAN2_NAVI_Cam_Dist_info, base-type=uint8, implementation-data-type=uint8, transfer-property=PENDING
          signal CAN2_NAVI_Direction_STA: start 279, 8 bit, big-endian, i-signal-type=PRIMITIVE, init-value=constant-reference=Init_CAN2_NAVI_Direction_STA, base-type=uint8, implementation-data-type=uint8, transfer-property=PENDING
          signal CAN2_NAVI_Distance_info: start 375, 24 bit, big-endian, i-signal-type=PRIMITIVE, init-value=constant-reference=Init_CAN2_NAVI_Distance_info, base-type=uint32, implementation-data-type=uint32, transfer-property=PENDING
          signal CAN2_NAVI_ForwardLinkLevel: start 415, 4 bit, big-endian, i-signal-type=PRIMITIVE, init-value=constant-reference=Init_CAN2_NAVI_ForwardLinkLevel, base-type=uint8, implementation-data-type=uint8, transfer-property=TRIGGERED-ON-CHANGE
          signal CAN2_NAVI_LinkClass: start 431, 4 bit, big-endian, i-signal-type=PRIMITIVE, init-value=constant-reference=Init_CAN2_NAVI_LinkClass, base-type=uint8, implementation-data-type=uint8, transfer-property=TRIGGERED-ON-CHANGE
          signal CAN2_NAVI_RoadClass: start 447, 3 bit, big-endian, i-signal-type=PRIMITIVE, init-value=constant-reference=Init_CAN2_NAVI_RoadClass, base-type=uint8, implementation-data-type=uint8, transfer-property=TRIGGERED-ON-CHANGE
          signal CAN2_NAVI_SpeedLimit: start 444, 5 bit, big-endian, i-signal-type=PRIMITIVE, init-value=constant-reference=Init_CAN2_NAVI_SpeedLimit, base-type=uint8, implementation-data-type=uint8, transfer-property=PENDING
          signal CAN2_NAVI_Speed_Limit_A: start 241, 2 bit, big-endian, i-signal-type=PRIMITIVE, init-value=constant-reference=Init_CAN2_NAVI_Speed_Limit_A, base-type=uint8, implementation-data-type=uint8, transfer-property=TRIGGERED-ON-CHANGE
          signal CAN2_NAVI_State: start 323, 2 bit, big-endian, i-signal-type=PRIMITIVE, init-value=constant-reference=Init_CAN2_NAVI_State, base-type=uint8, implementation-data-type=uint8, transfer-property=TRIGGERED-ON-CHANGE
          signal CAN2_NAVI_Tollgate: start 427, 12 bit, big-endian, i-signal-type=PRIMITIVE, init-value=constant-reference=Init_CAN2_NAVI_Tollgate, base-type=uint16, implementation-data-type=uint16, transfer-property=PENDING
          signal CAN2_NAVI_Tunnel: start 411, 12 bit, big-endian, i-signal-type=PRIMITIVE, init-value=constant-reference=Init_CAN2_NAVI_Tunnel, base-type=uint16, implementation-data-type=uint16, transfer-property=PENDING
          signal CAN2_ODAMute_BUTT: start 237, 2 bit, big-endian, i-signal-type=PRIMITIVE, init-value=constant-reference=Init_CAN2_ODAMute_BUTT, base-type=uint8, implementation-data-type=uint8, transfer-property=TRIGGERED-ON-CHANGE
          signal CAN2_OFF_AC_MODE: start 282, 3 bit, big-endian, i-signal-type=PRIMITIVE, init-value=constant-reference=Init_CAN2_OFF_AC_MODE, base-type=uint8, implementation-data-type=uint8, transfer-property=TRIGGERED-ON-CHANGE
          signal CAN2_PSEAT_vent_req: start 338, 3 bit, big-endian, i-signal-type=PRIMITIVE, init-value=constant-reference=Init_CAN2_PSEAT_vent_req, base-type=uint8, implementation-data-type=uint8, transfer-property=TRIGGERED-ON-CHANGE
          signal CAN2_Perd_V2L: start 3, 4 bit, big-endian, i-signal-type=PRIMITIVE, init-value=constant-reference=Init_CAN2_Perd_V2L, base-type=uint8, implementation-data-type=uint8, transfer-property=TRIGGERED-ON-CHANGE
          signal CAN2_Pressure_unit: start 263, 8 bit, big-endian, i-signal-type=PRIMITIVE, init-value=constant-reference=Init_CAN2_Pressure_unit, base-type=uint8, implementation-data-type=uint8, transfer-property=PENDING
          signal CAN2_RCTA_BUTT: start 396, 2 bit, big-endian, i-signal-type=PRIMITIVE, init-value=constant-reference=Init_CAN2_RCTA_BUTT, base-type=uint8, implementation-data-type=uint8, transfer-property=TRIGGERED-ON-CHANGE
          signal CAN2_RFogLampSW: start 343, 1 bit, big-endian, i-signal-type=PRIMITIVE, init-value=constant-reference=Init_CAN2_RFogLampSW, base-type=uint8, implementation-data-type=uint8, transfer-property=TRIGGERED-ON-CHANGE
          signal CAN2_Roll_Eng_Mode: start 478, 1 bit, big-endian, i-signal-type=PRIMITIVE, init-value=constant-reference=Init_CAN2_Roll_Eng_Mode, base-type=uint8, implementation-data-type=uint8, transfer-property=TRIGGERED-ON-CHANGE
          signal CAN2_Roll_Mode_SW_Cmd: start 473, 2 bit, big-endian, i-signal-type=PRIMITIVE, init-value=constant-reference=Init_CAN2_Roll_Mode_SW_Cmd, base-type=uint8, implementation-data-type=uint8, transfer-property=TRIGGERED-ON-CHANGE
          signal CAN2_RoomLampMode: start 455, 1 bit, big-endian, i-signal-type=PRIMITIVE, init-value=constant-reference=Init_CAN2_RoomLampMode, base-type=uint8, implementation-data-type=uint8, transfer-property=TRIGGERED-ON-CHANGE
          signal CAN2_SLG_Sw: start 349, 2 bit, big-endian, i-signal-type=PRIMITIVE, init-value=constant-reference=Init_CAN2_SLG_Sw, base-type=uint8, implementation-data-type=uint8, transfer-property=TRIGGERED-ON-CHANGE
          signal CAN2_SLIF_BUTT: start 477, 2 bit, big-endian, i-signal-type=PRIMITIVE, init-value=constant-reference=Init_CAN2_SLIF_BUTT, base-type=uint8, implementation-data-type=uint8, transfer-property=TRIGGERED-ON-CHANGE
          signal CAN2_SOC_ADJ_BUTT: start 471, 1 bit, big-endian, i-signal-type=PRIMITIVE, init-value=constant-reference=Init_CAN2_SOC_ADJ_BUTT, base-type=uint8, implementation-data-type=uint8, transfer-property=TRIGGERED-ON-CHANGE
          signal CAN2_SOC_Limit_Set: start 468, 5 bit, big-endian, i-signal-type=PRIMITIVE, init-value=constant-reference=Init_CAN2_SOC_Limit_Set, base-type=uint8, implementation-data-type=uint8, transfer-property=PENDING
          signal CAN2_SOC_V2LLimit: start 7, 4 bit, big-endian, i-signal-type=PRIMITIVE, init-value=constant-reference=Init_CAN2_SOC_V2LLimit, base-type=uint8, implementation-data-type=uint8, transfer-property=PENDING
          signal CAN2_Sched_Chg_Start: start 92, 1 bit, big-endian, i-signal-type=PRIMITIVE, init-value=constant-reference=Init_CAN2_Sched_Chg_Start, base-type=uint8, implementation-data-type=uint8, transfer-property=TRIGGERED-ON-CHANGE
          signal CAN2_Sched_Chg_Stop: start 95, 1 bit, big-endian, i-signal-type=PRIMITIVE, init-value=constant-reference=Init_CAN2_Sched_Chg_Stop, base-type=uint8, implementation-data-type=uint8, transfer-property=TRIGGERED-ON-CHANGE
          signal CAN2_Sched_Chg_butt: start 94, 1 bit, big-endian, i-signal-type=PRIMITIVE, init-value=constant-reference=Init_CAN2_Sched_Chg_butt, base-type=uint8, implementation-data-type=uint8, transfer-property=TRIGGERED-ON-CHANGE
          signal CAN2_Sched_Chg_limit: start 84, 5 bit, big-endian, i-signal-type=PRIMITIVE, init-value=constant-reference=Init_CAN2_Sched_Chg_limit, base-type=uint8, implementation-data-type=uint8, transfer-property=PENDING
          signal CAN2_Sched_Chg_wake: start 93, 1 bit, big-endian, i-signal-type=PRIMITIVE, init-value=constant-reference=Init_CAN2_Sched_Chg_wake, base-type=uint8, implementation-data-type=uint8, transfer-property=TRIGGERED-ON-CHANGE
          signal CAN2_SenstivityPosition: start 403, 4 bit, big-endian, i-signal-type=PRIMITIVE, init-value=constant-reference=Init_CAN2_SenstivityPosition, base-type=uint8, implementation-data-type=uint8, transfer-property=TRIGGERED-ON-CHANGE
          signal CAN2_SetUnlockSingle: start 359, 1 bit, big-endian, i-signal-type=PRIMITIVE, init-value=constant-reference=Init_CAN2_SetUnlockSingle, base-type=uint8, implementation-data-type=uint8, transfer-property=TRIGGERED-ON-CHANGE
          signal CAN2_TCS_SW_Cmd: start 475, 2 bit, big-endian, i-signal-type=PRIMITIVE, init-value=constant-reference=Init_CAN2_TCS_SW_Cmd, base-type=uint8, implementation-data-type=uint8, transfer-property=TRIGGERED-ON-CHANGE
          signal CAN2_TPMS_Cali_Butt: start 127, 1 bit, big-endian, i-signal-type=PRIMITIVE, init-value=constant-reference=Init_CAN2_TPMS_Cali_Butt, base-type=uint8, implementation-data-type=uint8, transfer-property=TRIGGERED-ON-CHANGE
          signal CAN2_TPMS_Res_Butt: start 357, 1 bit, big-endian, i-signal-type=PRIMITIVE, init-value=constant-reference=Init_CAN2_TPMS_Res_Butt, base-type=uint8, implementation-data-type=uint8, transfer-property=TRIGGERED-ON-CHANGE
          signal CAN2_Temperature_unit: start 242, 1 bit, big-endian, i-signal-type=PRIMITIVE, init-value=constant-reference=Init_CAN2_Temperature_unit, base-type=uint8, implementation-data-type=uint8, transfer-property=TRIGGERED-ON-CHANGE
          signal CAN2_Time_system: start 255, 8 bit, big-endian, i-signal-type=PRIMITIVE, init-value=constant-reference=Init_CAN2_Time_system, base-type=uint8, implementation-data-type=uint8, transfer-property=TRIGGERED-ON-CHANGE
          signal CAN2_TurnSwTimeSet: start 271, 2 bit, big-endian, i-signal-type=PRIMITIVE, init-value=constant-reference=Init_CAN2_TurnSwTimeSet, base-type=uint8, implementation-data-type=uint8, transfer-property=TRIGGERED-ON-CHANGE
          signal CAN2_User_p_download: start 335, 1 bit, big-endian, i-signal-type=PRIMITIVE, init-value=constant-reference=Init_CAN2_User_p_download, base-type=uint8, implementation-data-type=uint8, transfer-property=TRIGGERED-ON-CHANGE
          signal CAN2_User_p_upload: start 285, 1 bit, big-endian, i-signal-type=PRIMITIVE, init-value=constant-reference=Init_CAN2_User_p_upload, base-type=uint8, implementation-data-type=uint8, transfer-property=TRIGGERED-ON-CHANGE
          signal CAN2_Walkaway_Lock_SW: start 8, 1 bit, big-endian, i-signal-type=PRIMITIVE, init-value=constant-reference=Init_CAN2_Walkaway_Lock_SW, base-type=uint8, implementation-data-type=uint8, transfer-property=TRIGGERED-ON-CHANGE
          signal CAN2_Wifi_Reset: start 287, 1 bit, big-endian, i-signal-type=PRIMITIVE, init-value=constant-reference=Init_CAN2_Wifi_Reset, base-type=uint8, implementation-data-type=uint8, transfer-property=TRIGGERED-ON-CHANGE
          signal CAN2_Wifi_Sta_IVI_TBOX: start 327, 4 bit, big-endian, i-signal-type=PRIMITIVE, init-value=constant-reference=Init_CAN2_Wifi_Sta_IVI_TBOX, base-type=uint8, implementation-data-type=uint8, transfer-property=TRIGGERED-ON-CHANGE
          signal CAN2_WlcmLight_Mode: start 31, 2 bit, big-endian, i-signal-type=PRIMITIVE, init-value=constant-reference=Init_CAN2_WlcmLight_Mode, base-type=uint8, implementation-data-type=uint8, transfer-property=TRIGGERED-ON-CHANGE
          signal CAN2_sigAirIntenZon1Req: start 223, 4 bit, big-endian, i-signal-type=PRIMITIVE, init-value=constant-reference=Init_CAN2_sigAirIntenZon1Req, base-type=uint8, implementation-data-type=uint8, transfer-property=TRIGGERED-ON-CHANGE
          signal CAN2_sigAirIntenZon3Req: start 219, 4 bit, big-endian, i-signal-type=PRIMITIVE, init-value=constant-reference=Init_CAN2_sigAirIntenZon3Req, base-type=uint8, implementation-data-type=uint8, transfer-property=TRIGGERED-ON-CHANGE
          signal CAN2_sigDfrstReq: start 199, 1 bit, big-endian, i-signal-type=PRIMITIVE, init-value=constant-reference=Init_CAN2_sigDfrstReq, base-type=uint8, implementation-data-type=uint8, transfer-property=TRIGGERED-ON-CHANGE
          signal CAN2_sigFaceReq: start 91, 1 bit, big-endian, i-signal-type=PRIMITIVE, init-value=constant-reference=Init_CAN2_sigFaceReq, base-type=uint8, implementation-data-type=uint8, transfer-property=TRIGGERED-ON-CHANGE
          signal CAN2_sigFootReq: start 90, 1 bit, big-endian, i-signal-type=PRIMITIVE, init-value=constant-reference=Init_CAN2_sigFootReq, base-type=uint8, implementation-data-type=uint8, transfer-property=TRIGGERED-ON-CHANGE
          signal CAN2_sigHvacFrontReq: start 198, 1 bit, big-endian, i-signal-type=PRIMITIVE, init-value=constant-reference=Init_CAN2_sigHvacFrontReq, base-type=uint8, implementation-data-type=uint8, transfer-property=TRIGGERED-ON-CHANGE
          signal CAN2_sigHvacRearReq: start 247, 1 bit, big-endian, i-signal-type=PRIMITIVE, init-value=constant-reference=Init_CAN2_sigHvacRearReq, base-type=uint8, implementation-data-type=uint8, transfer-property=TRIGGERED-ON-CHANGE
          signal CAN2_sigHvacReq: start 207, 1 bit, big-endian, i-signal-type=PRIMITIVE, init-value=constant-reference=Init_CAN2_sigHvacReq, base-type=uint8, implementation-data-type=uint8, transfer-property=TRIGGERED-ON-CHANGE
          signal CAN2_sigRecircReq: start 206, 1 bit, big-endian, i-signal-type=PRIMITIVE, init-value=constant-reference=Init_CAN2_sigRecircReq, base-type=uint8, implementation-data-type=uint8, transfer-property=TRIGGERED-ON-CHANGE
          signal CAN2_sigSetTempZon1Req: start 197, 6 bit, big-endian, i-signal-type=PRIMITIVE, init-value=constant-reference=Init_CAN2_sigSetTempZon1Req, base-type=uint8, implementation-data-type=uint8, transfer-property=TRIGGERED-ON-CHANGE
          signal CAN2_sigSetTempZon2Req: start 205, 6 bit, big-endian, i-signal-type=PRIMITIVE, init-value=constant-reference=Init_CAN2_sigSetTempZon2Req, base-type=uint8, implementation-data-type=uint8, transfer-property=TRIGGERED-ON-CHANGE
          signal CAN2_sigSetTempZon3Req: start 215, 6 bit, big-endian, i-signal-type=PRIMITIVE, init-value=constant-reference=Init_CAN2_sigSetTempZon3Req, base-type=uint8, implementation-data-type=uint8, transfer-property=TRIGGERED-ON-CHANGE
          signal CAN2_sigWindDirZon3Req: start 228, 3 bit, big-endian, i-signal-type=PRIMITIVE, init-value=constant-reference=Init_CAN2_sigWindDirZon3Req, base-type=uint8, implementation-data-type=uint8, transfer-property=TRIGGERED-ON-CHANGE
      frame CAN2_IVI3: id 0x497, frame-length=32, can-addressing-mode=STANDARD, can-fd-frame-support=true, can-frame-rx-behavior=CAN-FD, can-frame-tx-behavior=CAN-FD
        pdu CAN2_IVI3: length=32, minimum-delay=0.0, transmission-mode-true-timing={cyclic-timing=time-period=0.5, event-controlled-timing={number-of-repetitions=0, repetition-period=0}}, unused-bit-pattern=0
          mapping CAN2_SG_IVI3: i-signal-group=CAN2_SG_IVI3, start-position=0, transfer-property=TRIGGERED-ON-CHANGE
          signal CAN2_IVI_CLBlower_Y_Sta: start 38, 7 bit, big-endian, i-signal-type=PRIMITIVE, init-value=constant-reference=Init_CAN2_IVI_CLBlower_Y_Sta, base-type=uint8, implementation-data-type=uint8, transfer-property=PENDING
          signal CAN2_IVI_CLBlower_Z_Sta: start 46, 7 bit, big-endian, i-signal-type=PRIMITIVE, init-value=constant-reference=Init_CAN2_IVI_CLBlower_Z_Sta, base-type=uint8, implementation-data-type=uint8, transfer-property=PENDING
          signal CAN2_IVI_CRBlower_Y_Sta: start 54, 7 bit, big-endian, i-signal-type=PRIMITIVE, init-value=constant-reference=Init_CAN2_IVI_CRBlower_Y_Sta, base-type=uint8, implementation-data-type=uint8, transfer-property=PENDING
          signal CAN2_IVI_CRBlower_Z_Sta: start 62, 7 bit, big-endian, i-signal-type=PRIMITIVE, init-value=constant-reference=Init_CAN2_IVI_CRBlower_Z_Sta, base-type=uint8, implementation-data-type=uint8, transfer-property=PENDING
          signal CAN2_IVI_HMI_CustmiFun_Sta: start 111, 4 bit, big-endian, i-signal-type=PRIMITIVE, init-value=constant-reference=Init_CAN2_IVI_HMI_CustmiFun_Sta, base-type=uint8, implementation-data-type=uint8, transfer-property=TRIGGERED-ON-CHANGE
          signal CAN2_IVI_HMI_CustmiKEY_Sta: start 67, 4 bit, big-endian, i-signal-type=PRIMITIVE, init-value=constant-reference=Init_CAN2_IVI_HMI_CustmiKEY_Sta, base-type=uint8, implementation-data-type=uint8, transfer-property=TRIGGERED-ON-CHANGE
          signal CAN2_IVI_LBlower_Mode_Sta: start 71, 2 bit, big-endian, i-signal-type=PRIMITIVE, init-value=constant-reference=Init_CAN2_IVI_LBlower_Mode_Sta, base-type=uint8, implementation-data-type=uint8, transfer-property=TRIGGERED-ON-CHANGE
          signal CAN2_IVI_LBlower_Y_Sta: start 6, 7 bit, big-endian, i-signal-type=PRIMITIVE, init-value=constant-reference=Init_CAN2_IVI_LBlower_Y_Sta, base-type=uint8, implementation-data-type=uint8, transfer-property=PENDING
          signal CAN2_IVI_LBlower_Z_Sta: start 14, 7 bit, big-endian, i-signal-type=PRIMITIVE, init-value=constant-reference=Init_CAN2_IVI_LBlower_Z_Sta, base-type=uint8, implementation-data-type=uint8, transfer-property=PENDING
          signal CAN2_IVI_LSEATvent_Cmd: start 101, 3 bit, big-endian, i-signal-type=PRIMITIVE, init-value=constant-reference=Init_CAN2_IVI_LSEATvent_Cmd, base-type=uint8, implementation-data-type=uint8, transfer-property=TRIGGERED-ON-CHANGE
          signal CAN2_IVI_LeftPSDOpenClose_Cmd: start 115, 1 bit, big-endian, i-signal-type=PRIMITIVE, init-value=constant-reference=Init_CAN2_IVI_LeftPSDOpenClose_Cmd, base-type=uint8, implementation-data-type=uint8, transfer-property=TRIGGERED-ON-CHANGE
          signal CAN2_IVI_MLFMost_Cmd: start 31, 1 bit, big-endian, i-signal-type=PRIMITIVE, init-value=constant-reference=Init_CAN2_IVI_MLFMost_Cmd, base-type=uint8, implementation-data-type=uint8, transfer-property=TRIGGERED-ON-CHANGE
          signal CAN2_IVI_MLFootLift_Cmd: start 75, 2 bit, big-endian, i-signal-type=PRIMITIVE, init-value=constant-reference=Init_CAN2_IVI_MLFootLift_Cmd, base-type=uint8, implementation-data-type=uint8, transfer-property=TRIGGERED-ON-CHANGE
          signal CAN2_IVI_MLNapMode_Cmd: start 23, 1 bit, big-endian, i-signal-type=PRIMITIVE, init-value=constant-reference=Init_CAN2_IVI_MLNapMode_Cmd, base-type=uint8, implementation-data-type=uint8, transfer-property=TRIGGERED-ON-CHANGE
          signal CAN2_IVI_MLRecliner_Cmd: start 79, 2 bit, big-endian, i-signal-type=PRIMITIVE, init-value=constant-reference=Init_CAN2_IVI_MLRecliner_Cmd, base-type=uint8, implementation-data-type=uint8, transfer-property=TRIGGERED-ON-CHANGE
          signal CAN2_IVI_MLRestore_Cmd: start 15, 1 bit, big-endian, i-signal-type=PRIMITIVE, init-value=constant-reference=Init_CAN2_IVI_MLRestore_Cmd, base-type=uint8, implementation-data-type=uint8, transfer-property=TRIGGERED-ON-CHANGE
          signal CAN2_IVI_MLSEATvent_Cmd: start 93, 3 bit, big-endian, i-signal-type=PRIMITIVE, init-value=constant-reference=Init_CAN2_IVI_MLSEATvent_Cmd, base-type=uint8, implementation-data-type=uint8, transfer-property=TRIGGERED-ON-CHANGE
          signal CAN2_IVI_MLSeatLift_Cmd: start 73, 2 bit, big-endian, i-signal-type=PRIMITIVE, init-value=constant-reference=Init_CAN2_IVI_MLSeatLift_Cmd, base-type=uint8, implementation-data-type=uint8, transfer-property=TRIGGERED-ON-CHANGE
          signal CAN2_IVI_MLSldRestore_Cmd: start 7, 1 bit, big-endian, i-signal-type=PRIMITIVE, init-value=constant-reference=Init_CAN2_IVI_MLSldRestore_Cmd, base-type=uint8, implementation-data-type=uint8, transfer-property=TRIGGERED-ON-CHANGE
          signal CAN2_IVI_MLSlider_Cmd: start 77, 2 bit, big-endian, i-signal-type=PRIMITIVE, init-value=constant-reference=Init_CAN2_IVI_MLSlider_Cmd, base-type=uint8, implementation-data-type=uint8, transfer-property=TRIGGERED-ON-CHANGE
          signal CAN2_IVI_MLZeroGravity_Cmd: start 39, 1 bit, big-endian, i-signal-type=PRIMITIVE, init-value=constant-reference=Init_CAN2_IVI_MLZeroGravity_Cmd, base-type=uint8, implementation-data-type=uint8, transfer-property=TRIGGERED-ON-CHANGE
          signal CAN2_IVI_MRFMost_Cmd: start 94, 1 bit, big-endian, i-signal-type=PRIMITIVE, init-value=constant-reference=Init_CAN2_IVI_MRFMost_Cmd, base-type=uint8, implementation-data-type=uint8, transfer-property=TRIGGERED-ON-CHANGE
          signal CAN2_IVI_MRFootLift_Cmd: start 83, 2 bit, big-endian, i-signal-type=PRIMITIVE, init-value=constant-reference=Init_CAN2_IVI_MRFootLift_Cmd, base-type=uint8, implementation-data-type=uint8, transfer-property=TRIGGERED-ON-CHANGE
          signal CAN2_IVI_MRNapMode_Cmd: start 63, 1 bit, big-endian, i-signal-type=PRIMITIVE, init-value=constant-reference=Init_CAN2_IVI_MRNapMode_Cmd, base-type=uint8, implementation-data-type=uint8, transfer-property=TRIGGERED-ON-CHANGE
          signal CAN2_IVI_MRRecliner_Cmd: start 87, 2 bit, big-endian, i-signal-type=PRIMITIVE, init-value=constant-reference=Init_CAN2_IVI_MRRecliner_Cmd, base-type=uint8, implementation-data-type=uint8, transfer-property=TRIGGERED-ON-CHANGE
          signal CAN2_IVI_MRRestore_Cmd: start 55, 1 bit, big-endian, i-signal-type=PRIMITIVE, init-value=constant-reference=Init_CAN2_IVI_MRRestore_Cmd, base-type=uint8, implementation-data-type=uint8, transfer-property=TRIGGERED-ON-CHANGE
          signal CAN2_IVI_MRSEATvent_Cmd: start 90, 3 bit, big-endian, i-signal-type=PRIMITIVE, init-value=constant-reference=Init_CAN2_IVI_MRSEATvent_Cmd, base-type=uint8, implementation-data-type=uint8, transfer-property=TRIGGERED-ON-CHANGE
          signal CAN2_IVI_MRSeatLift_Cmd: start 81, 2 bit, big-endian, i-signal-type=PRIMITIVE, init-value=constant-reference=Init_CAN2_IVI_MRSeatLift_Cmd, base-type=uint8, implementation-data-type=uint8, transfer-property=TRIGGERED-ON-CHANGE
          signal CAN2_IVI_MRSldRestore_Cmd: start 47, 1 bit, big-endian, i-signal-type=PRIMITIVE, init-value=constant-reference=Init_CAN2_IVI_MRSldRestore_Cmd, base-type=uint8, implementation-data-type=uint8, transfer-property=TRIGGERED-ON-CHANGE
          signal CAN2_IVI_MRSlider_Cmd: start 85, 2 bit, big-endian, i-signal-type=PRIMITIVE, init-value=constant-reference=Init_CAN2_IVI_MRSlider_Cmd, base-type=uint8, implementation-data-type=uint8, transfer-property=TRIGGERED-ON-CHANGE
          signal CAN2_IVI_MRZeroGravity_Cmd: start 95, 1 bit, big-endian, i-signal-type=PRIMITIVE, init-value=constant-reference=Init_CAN2_IVI_MRZeroGravity_Cmd, base-type=uint8, implementation-data-type=uint8, transfer-property=TRIGGERED-ON-CHANGE
          signal CAN2_IVI_PSDManualPower_Sta: start 117, 1 bit, big-endian, i-signal-type=PRIMITIVE, init-value=constant-reference=Init_CAN2_IVI_PSDManualPower_Sta, base-type=uint8, implementation-data-type=uint8, transfer-property=TRIGGERED-ON-CHANGE
          signal CAN2_IVI_RBlower_Mode_Sta: start 69, 2 bit, big-endian, i-signal-type=PRIMITIVE, init-value=constant-reference=Init_CAN2_IVI_RBlower_Mode_Sta, base-type=uint8, implementation-data-type=uint8, transfer-property=TRIGGERED-ON-CHANGE
          signal CAN2_IVI_RBlower_Y_Sta: start 22, 7 bit, big-endian, i-signal-type=PRIMITIVE, init-value=constant-reference=Init_CAN2_IVI_RBlower_Y_Sta, base-type=uint8, implementation-data-type=uint8, transfer-property=PENDING
          signal CAN2_IVI_RBlower_Z_Sta: start 30, 7 bit, big-endian, i-signal-type=PRIMITIVE, init-value=constant-reference=Init_CAN2_IVI_RBlower_Z_Sta, base-type=uint8, implementation-data-type=uint8, transfer-property=PENDING
          signal CAN2_IVI_RSEATvent_Cmd: start 98, 3 bit, big-endian, i-signal-type=PRIMITIVE, init-value=constant-reference=Init_CAN2_IVI_RSEATvent_Cmd, base-type=uint8, implementation-data-type=uint8, transfer-property=TRIGGERED-ON-CHANGE
          signal CAN2_IVI_RightPSDOpenClose_Cmd: start 116, 1 bit, big-endian, i-signal-type=PRIMITIVE, init-value=constant-reference=Init_CAN2_IVI_RightPSDOpenClose_Cmd, base-type=uint8, implementation-data-type=uint8, transfer-property=TRIGGERED-ON-CHANGE
          signal CAN2_IVI_RollMod_atCarWash_Sta: start 105, 1 bit, big-endian, i-signal-type=PRIMITIVE, init-value=constant-reference=Init_CAN2_IVI_RollMod_atCarWash_Sta, base-type=uint8, implementation-data-type=uint8, transfer-property=TRIGGERED-ON-CHANGE
          signal CAN2_IVI_SOS_Call_Sta: start 103, 2 bit, big-endian, i-signal-type=PRIMITIVE, init-value=constant-reference=Init_CAN2_IVI_SOS_Call_Sta, base-type=uint8, implementation-data-type=uint8, transfer-property=TRIGGERED-ON-CHANGE
          signal CAN2_IVI_SnowMode_Cmd: start 104, 1 bit, big-endian, i-signal-type=PRIMITIVE, init-value=constant-reference=Init_CAN2_IVI_SnowMode_Cmd, base-type=uint8, implementation-data-type=uint8, transfer-property=TRIGGERED-ON-CHANGE
          signal CAN2_IVI_UserTakeOver_APS_Sta: start 119, 1 bit, big-endian, i-signal-type=PRIMITIVE, init-value=constant-reference=Init_CAN2_IVI_UserTakeOver_APS_Sta, base-type=uint8, implementation-data-type=uint8, transfer-property=TRIGGERED-ON-CHANGE
          signal CAN2_IVI_XWDMode_Cmd: start 107, 2 bit, big-endian, i-signal-type=PRIMITIVE, init-value=constant-reference=Init_CAN2_IVI_XWDMode_Cmd, base-type=uint8, implementation-data-type=uint8, transfer-property=TRIGGERED-ON-CHANGE
          signal CAN2_IVI_Zon1WindDirSWReq_Sta: start 118, 1 bit, big-endian, i-signal-type=PRIMITIVE, init-value=constant-reference=Init_CAN2_IVI_Zon1WindDirSWReq_Sta, base-type=uint8, implementation-data-type=uint8, transfer-property=TRIGGERED-ON-CHANGE
      frame CAN2_METER1: id 0x25A, frame-length=24, can-addressing-mode=STANDARD, can-fd-frame-support=true, can-frame-rx-behavior=CAN-FD, can-frame-tx-behavior=CAN-FD
        pdu CAN2_METER1: length=24, minimum-delay=0.0, transmission-mode-true-timing={cyclic-timing=time-period=0.1, event-controlled-timing={number-of-repetitions=0, repetition-period=0}}, unused-bit-pattern=0
          mapping CAN2_SG_METER1: i-signal-group=CAN2_SG_METER1, start-position=0, transfer-property=TRIGGERED-ON-CHANGE
          signal CAN2_APCforDTE: start 87, 16 bit, big-endian, i-signal-type=PRIMITIVE, init-value=constant-reference=Init_CAN2_APCforDTE, base-type=uint16, implementation-data-type=uint16, transfer-property=PENDING
          signal CAN2_AVGPwrConsumption: start 71, 16 bit, big-endian, i-signal-type=PRIMITIVE, init-value=constant-reference=Init_CAN2_AVGPwrConsumption, base-type=uint16, implementation-data-type=uint16, transfer-property=PENDING
          signal CAN2_AvailableTrip: start 103, 16 bit, big-endian, i-signal-type=PRIMITIVE, init-value=constant-reference=Init_CAN2_AvailableTrip, base-type=uint16, implementation-data-type=uint16, transfer-property=PENDING
          signal CAN2_Averaged_vehspeed: start 49, 10 bit, big-endian, i-signal-type=PRIMITIVE, init-value=constant-reference=Init_CAN2_Averaged_vehspeed, base-type=uint16, implementation-data-type=uint16, transfer-property=PENDING
          signal CAN2_Charge: start 113, 1 bit, big-endian, i-signal-type=PRIMITIVE, init-value=constant-reference=Init_CAN2_Charge, base-type=uint8, implementation-data-type=uint8, transfer-property=TRIGGERED-ON-CHANGE
          signal CAN2_LEDlitWarnReq: start 114, 1 bit, big-endian, i-signal-type=PRIMITIVE, init-value=constant-reference=Init_CAN2_LEDlitWarnReq, base-type=uint8, implementation-data-type=uint8, transfer-property=TRIGGERED-ON-CHANGE
          signal CAN2_METER_KPH_Calcu: start 15, 8 bit, big-endian, i-signal-type=PRIMITIVE, init-value=constant-reference=Init_CAN2_METER_KPH_Calcu, base-type=uint8, implementation-data-type=uint8, transfer-property=PENDING
          signal CAN2_METER_KPH_Real: start 31, 12 bit, big-endian, i-signal-type=PRIMITIVE, init-value=constant-reference=Init_CAN2_METER_KPH_Real, base-type=uint16, implementation-data-type=uint16, transfer-property=PENDING
          signal CAN2_METER_MPH_Calcu: start 23, 8 bit, big-endian, i-signal-type=PRIMITIVE, init-value=constant-reference=Init_CAN2_METER_MPH_Calcu, base-type=uint8, implementation-data-type=uint8, transfer-property=PENDING
          signal CAN2_METER_MPH_Real: start 35, 12 bit, big-endian, i-signal-type=PRIMITIVE, init-value=constant-reference=Init_CAN2_METER_MPH_Real, base-type=uint16, implementation-data-type=uint16, transfer-property=PENDING
          signal CAN2_ODOMETER: start 175, 24 bit, big-endian, i-signal-type=PRIMITIVE, init-value=constant-reference=Init_CAN2_ODOMETER, base-type=uint32, implementation-data-type=uint32, transfer-property=TRIGGERED-ON-CHANGE
          signal CAN2_ParkBrake: start 112, 1 bit, big-endian, i-signal-type=PRIMITIVE, init-value=constant-reference=Init_CAN2_ParkBrake, base-type=uint8, implementation-data-type=uint8, transfer-property=TRIGGERED-ON-CHANGE
          signal CAN2_Spd_Crl_Mode: start 118, 3 bit, big-endian, i-signal-type=PRIMITIVE, init-value=constant-reference=Init_CAN2_Spd_Crl_Mode, base-type=uint8, implementation-data-type=uint8, transfer-property=PENDING
          signal CAN2_Spd_Crl_Sta: start 115, 1 bit, big-endian, i-signal-type=PRIMITIVE, init-value=constant-reference=Init_CAN2_Spd_Crl_Sta, base-type=uint8, implementation-data-type=uint8, transfer-property=PENDING
          signal CAN2_Trip_A: start 151, 24 bit, big-endian, i-signal-type=PRIMITIVE, init-value=constant-reference=Init_CAN2_Trip_A, base-type=uint32, implementation-data-type=uint32, transfer-property=TRIGGERED-ON-CHANGE
          signal CAN2_Trip_B: start 127, 24 bit, big-endian, i-signal-type=PRIMITIVE, init-value=constant-reference=Init_CAN2_Trip_B, base-type=uint32, implementation-data-type=uint32, transfer-property=TRIGGERED-ON-CHANGE
      frame CAN2_NMm_FUSION_TX: id 0x500, frame-length=8, can-addressing-mode=STANDARD, can-fd-frame-support=false, can-frame-rx-behavior=CAN-20, can-frame-tx-behavior=CAN-20
        nm pdu CAN2_NMm_FUSION_TX: length=8, unused-bit-pattern=0
      frame CAN2_NMm_FUSION_RX: id 0x500, frame-length=8, can-addressing-mode=STANDARD, can-fd-frame-support=false, can-frame-rx-behavior=CAN-20, can-frame-tx-behavior=CAN-20
        nm pdu CAN2_NMm_FUSION_RX: length=8, unused-bit-pattern=0
package /CAN2/ConstantSpecification
  1013 x constant specification:
    Init_CAN2_APS_ExitCondition: value-spec=0
    Init_CAN2_APS_RQ_Display: value-spec=0
    Init_CAN2_APS_SW_Ver: value-spec=0
    Init_CAN2_APS_Sta_System: value-spec=0
    Init_CAN2_CAAS_Sta: value-spec=0
    Init_CAN2_DISC_DISCTargetSpd: value-spec=0
    Init_CAN2_FDC_VCU_RegenLimInd_Sta: value-spec=0
    Init_CAN2_FDC_VCU_RegenMode_Sta: value-spec=0
    Init_CAN2_FDC_VCU_SimSound_Cmd: value-spec=2047
    Init_CAN2_FDC_VCU_SmartEcoSpdLim_Sta: value-spec=0
    Init_CAN2_FDC_VCU_SmartEco_Sta: value-spec=0
    Init_CAN2_FDC_VMC_SetSpdDisp_Sta: value-spec=0
    Init_CAN2_FDC_VMC_SetSpd_Sta: value-spec=0
    Init_CAN2_FDC_VMC_SpdCtrlMode_Sta: value-spec=0
    Init_CAN2_FDC_VMC_SpdCtrl_Sta: value-spec=0
    Init_CAN2_PAS_A_FCL: value-spec=0
    Init_CAN2_PAS_A_FCR: value-spec=0
    Init_CAN2_PAS_A_FML: value-spec=0
    Init_CAN2_PAS_A_FMR: value-spec=0
    Init_CAN2_PAS_A_RCL: value-spec=0
    Init_CAN2_PAS_A_RCR: value-spec=0
    Init_CAN2_PAS_A_RML: value-spec=0
    Init_CAN2_PAS_A_RMR: value-spec=0
    Init_CAN2_PAS_Chime: value-spec=0
    Init_CAN2_PAS_D_FCL: value-spec=0
    Init_CAN2_PAS_D_FCR: value-spec=0
    Init_CAN2_PAS_D_FML: value-spec=0
    Init_CAN2_PAS_D_FMR: value-spec=0
    Init_CAN2_PAS_D_RCL: value-spec=0
    Init_CAN2_PAS_D_RCR: value-spec=0
    Init_CAN2_PAS_D_RML: value-spec=0
    Init_CAN2_PAS_D_RMR: value-spec=0
    Init_CAN2_PAS_SNSR_Layout: value-spec=0
    Init_CAN2_USS_Sta_FCL: value-spec=0
    Init_CAN2_USS_Sta_FCR: value-spec=0
    Init_CAN2_USS_Sta_FLL: value-spec=0
    Init_CAN2_USS_Sta_FLR: value-spec=0
    Init_CAN2_USS_Sta_FML: value-spec=0
    Init_CAN2_USS_Sta_FMR: value-spec=0
    Init_CAN2_USS_Sta_RCL: value-spec=0
    Init_CAN2_USS_Sta_RCR: value-spec=0
    Init_CAN2_USS_Sta_RLL: value-spec=0
    Init_CAN2_USS_Sta_RLR: value-spec=0
    Init_CAN2_USS_Sta_RML: value-spec=0
    Init_CAN2_USS_Sta_RMR: value-spec=0
    Init_CAN2_VMC_VCU_CC_Crl_Sta: value-spec=0
    Init_CAN2_VMC_VCU_MSA_Crl_Sta: value-spec=0
    Init_CAN2_APMDoorControlSta: value-spec=0
    Init_CAN2_ActAPSPosn: value-spec=0
    Init_CAN2_AllDoorSW: value-spec=0
    Init_CAN2_AntitheftSta: value-spec=0
    Init_CAN2_BCM_DoorLock_Sta: value-spec=0
    Init_CAN2_BrakeLamp: value-spec=0
    Init_CAN2_CCMSA_SpdWar: value-spec=0
    Init_CAN2_CCU_ACLampSts: value-spec=0
    Init_CAN2_CCU_ACMaxLampSts: value-spec=0
    Init_CAN2_CCU_AutoLampSts: value-spec=0
    Init_CAN2_CCU_AutoMidLampSts: value-spec=0
    Init_CAN2_CCU_Dispaly_Request: value-spec=0
    Init_CAN2_CCU_EcoSts: value-spec=0
    Init_CAN2_CCU_FrtOnOffLampSts: value-spec=0
    Init_CAN2_CCU_RrOnOffLampSts: value-spec=0
    Init_CAN2_CCU_SyncLampSts: value-spec=0
    Init_CAN2_CC_Crl_Sta: value-spec=0
    Init_CAN2_CoastDwModeStaChk: value-spec=0
    Init_CAN2_CreepSW_Sta: value-spec=0
    Init_CAN2_DISC_ButtSta: value-spec=0
    Init_CAN2_DISC_Sta: value-spec=0
    Init_CAN2_DemoModeStaChk: value-spec=0
    Init_CAN2_Dimmer: value-spec=0
    Init_CAN2_DimmerEN: value-spec=0
    Init_CAN2_DisengageP_Fail: value-spec=0
    Init_CAN2_DoorLockIND: value-spec=0
    Init_CAN2_DrDoorSW: value-spec=0
    Init_CAN2_Dr_SeatSta: value-spec=2
    Init_CAN2_DynoModeStaChk: value-spec=0
    Init_CAN2_EDriveSysErr_AccPedalErr: value-spec=0
    Init_CAN2_EDriveSysErr_MCUErr: value-spec=0
    Init_CAN2_EDriveSysErr_ShifterErr: value-spec=0
    Init_CAN2_EDriveSysErr_VCUErr: value-spec=0
    Init_CAN2_EVDriveMode: value-spec=0
    Init_CAN2_Eng_AGSCloseSta: value-spec=0
    Init_CAN2_Eng_ActvDmpDisabSta: value-spec=0
    Init_CAN2_Eng_CoastDwSta: value-spec=0
    Init_CAN2_Eng_PwrLockSta: value-spec=0
    Init_CAN2_EngageP_Fail: value-spec=0
    Init_CAN2_FDC_BCM_AutoWipHSpdEN_Sta: value-spec=0
    Init_CAN2_FDC_BCM_HMIKey{1..8}Func_Sta: value-spec=0
    Init_CAN2_FDC_RAPS_ErrWarn_Sta: value-spec=0
    Init_CAN2_FDC_THCM_CLEVentY_Sta: value-spec=0
    Init_CAN2_FDC_THCM_CLEVentZ_Sta: value-spec=0
    Init_CAN2_FDC_THCM_CLVent_Sta: value-spec=0
    Init_CAN2_FDC_THCM_CREVentY_Sta: value-spec=0
    Init_CAN2_FDC_THCM_CREVentZ_Sta: value-spec=0
    Init_CAN2_FDC_THCM_CRVent_Sta: value-spec=0
    Init_CAN2_FDC_THCM_LEVentMode_Sta: value-spec=0
    Init_CAN2_FDC_THCM_LEVentY_Sta: value-spec=0
    Init_CAN2_FDC_THCM_LEVentZ_Sta: value-spec=0
    Init_CAN2_FDC_THCM_LVent_Sta: value-spec=0
    Init_CAN2_FDC_THCM_PreWPTCHeat_Sta: value-spec=0
    Init_CAN2_FDC_THCM_REVentMode_Sta: value-spec=0
    Init_CAN2_FDC_THCM_REVentY_Sta: value-spec=0
    Init_CAN2_FDC_THCM_REVentZ_Sta: value-spec=0
    Init_CAN2_FDC_THCM_RVent_Sta: value-spec=0
    Init_CAN2_FDC_V2L_IVIV2LDischarg_Cmd: value-spec=0
    Init_CAN2_FDC_VCU_LVChrgFreq_Sta: value-spec=0
    Init_CAN2_FDC_VCU_LVStaDropQuick_Sta: value-spec=0
    Init_CAN2_FDC_VCU_LVStaTooLow_Sta: value-spec=0
    Init_CAN2_FDC_VCU_PwrSaveReq_Cmd: value-spec=0
    Init_CAN2_FDC_VCU_TrailerDisOPD_Sta: value-spec=0
    Init_CAN2_FD_ABS_Warning: value-spec=0
    Init_CAN2_FD_AGS_Cmd: value-spec=0
    Init_CAN2_FD_Battery_Charge_Warning: value-spec=0
    Init_CAN2_FD_EBMErrSta: value-spec=0
    Init_CAN2_FD_EDrive_System: value-spec=0
    Init_CAN2_FD_EPB_Error: value-spec=0
    Init_CAN2_FD_HV_Battery_Fault: value-spec=0
    Init_CAN2_FD_Park_Brake_Warning: value-spec=0
    Init_CAN2_FD_Power_limitation: value-spec=0
    Init_CAN2_FD_Steering_Warning: value-spec=0
    Init_CAN2_FD_TCS_Indicator: value-spec=0
    Init_CAN2_FD_Telltale_Fail: value-spec=0
    Init_CAN2_FalseNPrevent_Sta: value-spec=0
    Init_CAN2_FeatSetSpdFinal_raw32: value-spec=0
    Init_CAN2_FollowMe: value-spec=0
    Init_CAN2_Fr_FogLamp: value-spec=0
    Init_CAN2_HVRlyOpFail: value-spec=0
    Init_CAN2_HVSysErr_IsolationErr: value-spec=0
    Init_CAN2_HVSysErr_PackErr: value-spec=0
    Init_CAN2_HVSysErr_RelayErr: value-spec=0
    Init_CAN2_H_Beam: value-spec=0
    Init_CAN2_HazardSW: value-spec=0
    Init_CAN2_HoodSW: value-spec=0
    Init_CAN2_LBSD: value-spec=0
    Init_CAN2_LDRL: value-spec=0
    Init_CAN2_LTurnLP: value-spec=0
    Init_CAN2_LVChrgFuncStaChk: value-spec=0
    Init_CAN2_LVSilentChrgReq: value-spec=0
    Init_CAN2_LVSilentChrgSta: value-spec=0
    Init_CAN2_LVSysErr_PwrOutpErr: value-spec=0
    Init_CAN2_L_Beam: value-spec=0
    Init_CAN2_LimphomeAct: value-spec=0
    Init_CAN2_LockSetting: value-spec=0
    Init_CAN2_MCUActDisFail: value-spec=0
    Init_CAN2_MSA_Crl_Sta: value-spec=0
    Init_CAN2_MeterIndSpeed_raw32: value-spec=0
    Init_CAN2_PAS_Sta_F_Sys: value-spec=0
    Init_CAN2_PosLamp: value-spec=0
    Init_CAN2_PsDoorSW: value-spec=0
    Init_CAN2_PwrSta: value-spec=7
    Init_CAN2_PwrStaErr: value-spec=0
    Init_CAN2_PwrStaONTOIVIPopReq: value-spec=0
    Init_CAN2_PwrStaONTOIVIPopT: value-spec=0
    Init_CAN2_RBSD: value-spec=0
    Init_CAN2_RDRL: value-spec=0
    Init_CAN2_RLDoorSW: value-spec=0
    Init_CAN2_RRDoorSW: value-spec=0
    Init_CAN2_RTurnLP: value-spec=0
    Init_CAN2_Req_Internal_V2L_Status_Lamp: value-spec=0
    Init_CAN2_Req_V2LSwOn: value-spec=0
    Init_CAN2_Req_V2L_IVI_Popup: value-spec=0
    Init_CAN2_ReverseLamp: value-spec=0
    Init_CAN2_Rr_Defog: value-spec=0
    Init_CAN2_Rr_FogLamp: value-spec=0
    Init_CAN2_ShiftGearPosn: value-spec=1
    Init_CAN2_SysAllowReadySta: value-spec=0
    Init_CAN2_SysPwrSta: value-spec=0
    Init_CAN2_Tailgate_SW: value-spec=0
    Init_CAN2_VCUBrkSWSta: value-spec=0
    Init_CAN2_VCUFLDoorSta: value-spec=0
    Init_CAN2_VCUFRDoorSta: value-spec=0
    Init_CAN2_VCUHoodSWSta: value-spec=0
    Init_CAN2_VCURLDoorSta: value-spec=0
    Init_CAN2_VCURRDoorSta: value-spec=0
    Init_CAN2_VCUTailgateSWSta: value-spec=0
    Init_CAN2_VCU_OPDHold: value-spec=0
    Init_CAN2_VehMalfunLevel: value-spec=0
    Init_CAN2_XWDMode: value-spec=0
    Init_CAN2_sigAirIntenZon1St: value-spec=0
    Init_CAN2_sigAirIntenZon3St: value-spec=0
    Init_CAN2_sigAmbAirT: value-spec=0
    Init_CAN2_sigCbnAirT: value-spec=0
    Init_CAN2_sigDfrstSt: value-spec=0
    Init_CAN2_sigHvacSt: value-spec=0
    Init_CAN2_sigRecircSt: value-spec=0
    Init_CAN2_sigSetTempZon{1..3}St: value-spec=0
    Init_CAN2_sigWindDirZon1St: value-spec=7
    Init_CAN2_sigWindDirZon3St: value-spec=7
    Init_CAN2_AutoLTips: value-spec=0
    Init_CAN2_CWheelTips: value-spec=0
    Init_CAN2_FDC_BCM_Acc{1..5}Sta_Sta: value-spec=0
    Init_CAN2_FDC_BCM_AmbBrightSta_Sta: value-spec=0
    Init_CAN2_FDC_BCM_AmbColorSta_Sta: value-spec=0
    Init_CAN2_FDC_BCM_AmbDimEN_Sta: value-spec=0
    Init_CAN2_FDC_BCM_AmbFunEN_Sta: value-spec=0
    Init_CAN2_FDC_BCM_AmbLinkDriSta_Sta: value-spec=0
    Init_CAN2_FDC_BCM_AmbODAEN_Sta: value-spec=0
    Init_CAN2_FDC_BCM_AmbPwrWarnEN_Sta: value-spec=0
    Init_CAN2_FDC_BCM_AmbWelEN_Sta: value-spec=0
    Init_CAN2_FDC_BCM_AutoLock_Sta: value-spec=0
    Init_CAN2_FDC_BCM_AutoUnlock_Sta: value-spec=0
    Init_CAN2_FDC_BCM_CLWinLockDr_Sta: value-spec=0
    Init_CAN2_FDC_BCM_DSEATentryfset_Sta: value-spec=0
    Init_CAN2_FDC_BCM_FollowMeENFun_Sta: value-spec=0
    Init_CAN2_FDC_BCM_HBeamADB_Cmd: value-spec=0
    Init_CAN2_FDC_BCM_Key10Acc_Sta: value-spec=0
    Init_CAN2_FDC_BCM_Key{1..9}Acc_Sta: value-spec=0
    Init_CAN2_FDC_BCM_LockAlarm_Cmd: value-spec=0
    Init_CAN2_FDC_BCM_PTGOpenHeight_Sta: value-spec=7
    Init_CAN2_FDC_BCM_RmLpModeENFun_Sta: value-spec=0
    Init_CAN2_FDC_BCM_TurnSwTSetSta_Sta: value-spec=3
    Init_CAN2_FDC_BCM_UserNow_Sta: value-spec=0
    Init_CAN2_FDC_BCM_WalkInUnLkEnFun_Sta: value-spec=0
    Init_CAN2_FDC_BCM_WalkOutLkEnFun_Sta: value-spec=0
    Init_CAN2_FDC_DKC_DkeyShowIVI_Sta: value-spec=0
    Init_CAN2_FDC_DKC_KeyMiss_Sta: value-spec=0
    Init_CAN2_FDC_DKC_KeyNum_Sta: value-spec=0
    Init_CAN2_FDC_DKC_KeyType_Sta: value-spec=0
    Init_CAN2_FDC_DKC_UIDLowPower_Sta: value-spec=0
    Init_CAN2_FDC_FGS_AirInt_Sta: value-spec=0
    Init_CAN2_FDC_FGS_FGSCh_Sta: value-spec=0
    Init_CAN2_FDC_FGS_IONSW_Sta: value-spec=0
    Init_CAN2_FDC_SPTG_SPTGENFun_Sta: value-spec=0
    Init_CAN2_FDC_THCM_APTCForceOFF_Sta: value-spec=0
    Init_CAN2_FDC_THCM_APTCWarning_Sta: value-spec=0
    Init_CAN2_FDC_THCM_AirIntZ3_Sta: value-spec=0
    Init_CAN2_LFBatWarn: value-spec=0
    Init_CAN2_LFPressIndi: value-spec=0
    Init_CAN2_LFSensorFail: value-spec=0
    Init_CAN2_LFWheelDebug: value-spec=0
    Init_CAN2_LFWheelPSW: value-spec=0
    Init_CAN2_LFWheelPress: value-spec=0
    Init_CAN2_LFWheelShield: value-spec=0
    Init_CAN2_LFWheelTemp: value-spec=0
    Init_CAN2_LFWheelTmpIndi: value-spec=0
    Init_CAN2_LRBatWarn: value-spec=0
    Init_CAN2_LRPressIndi: value-spec=0
    Init_CAN2_LRSensorFail: value-spec=0
    Init_CAN2_LRWheelDebug: value-spec=0
    Init_CAN2_LRWheelPSW: value-spec=0
    Init_CAN2_LRWheelPress: value-spec=0
    Init_CAN2_LRWheelShield: value-spec=0
    Init_CAN2_LRWheelTemp: value-spec=0
    Init_CAN2_LRWheelTmpIndi: value-spec=0
    Init_CAN2_RFBatWarn: value-spec=0
    Init_CAN2_RFPressIndi: value-spec=0
    Init_CAN2_RFSensorFail: value-spec=0
    Init_CAN2_RFWheelDebug: value-spec=0
    Init_CAN2_RFWheelPSW: value-spec=0
    Init_CAN2_RFWheelPress: value-spec=0
    Init_CAN2_RFWheelShield: value-spec=0
    Init_CAN2_RFWheelTemp: value-spec=0
    Init_CAN2_RFWheelTmpIndi: value-spec=0
    Init_CAN2_RRBatWarn: value-spec=0
    Init_CAN2_RRPressIndi: value-spec=0
    Init_CAN2_RRSensorFail: value-spec=0
    Init_CAN2_RRWheelDebug: value-spec=0
    Init_CAN2_RRWheelPSW: value-spec=0
    Init_CAN2_RRWheelPress: value-spec=0
    Init_CAN2_RRWheelShield: value-spec=0
    Init_CAN2_RRWheelTemp: value-spec=0
    Init_CAN2_RRWheelTmpIndi: value-spec=0
    Init_CAN2_TPMSWarnIndi: value-spec=0
    Init_CAN2_TPMS_Cali_Butt_Allow: value-spec=0
    Init_CAN2_TPMS_Res_Butt_Allow: value-spec=0
    Init_CAN2_OTA_DL_Available: value-spec=0
    Init_CAN2_OTA_DL_Speed: value-spec=0
    Init_CAN2_OTA_Debug_Code: value-spec=0
    Init_CAN2_OTA_Emergency_Sta: value-spec=0
    Init_CAN2_OTA_InVehicle_FW: value-spec=0
    Init_CAN2_OTA_Lock_Req: value-spec=0
    Init_CAN2_OTA_MDA_Status: value-spec=0
    Init_CAN2_OTA_Mode: value-spec=0
    Init_CAN2_OTA_Network_Type: value-spec=0
    Init_CAN2_OTA_Permit_Agreed: value-spec=0
    Init_CAN2_OTA_Progress_Rate: value-spec=0
    Init_CAN2_OTA_Remained_Time: value-spec=0
    Init_CAN2_OTA_TBOXResetReq: value-spec=0
    Init_CAN2_OTA_Update_Available: value-spec=0
    Init_CAN2_OTA_Updating_ECU_8bit: value-spec=0
    Init_CAN2_FUSION_HW_Ver{1..3}: value-spec=0
    Init_CAN2_FUSION_SW_CarModel{1..3}: value-spec=0
    Init_CAN2_FUSION_SW_Controller1: value-spec=0
    Init_CAN2_FUSION_SW_Controller2: value-spec=0
    Init_CAN2_FUSION_SW_Country1: value-spec=0
    Init_CAN2_FUSION_SW_Country2: value-spec=0
    Init_CAN2_FUSION_SW_ECUGen1: value-spec=0
    Init_CAN2_FUSION_SW_ECUGen2: value-spec=0
    Init_CAN2_FUSION_SW_Major1: value-spec=0
    Init_CAN2_FUSION_SW_Major2: value-spec=0
    Init_CAN2_FUSION_SW_Minor1: value-spec=0
    Init_CAN2_FUSION_SW_Minor2: value-spec=0
    Init_CAN2_FUSION_SW_Patch1: value-spec=0
    Init_CAN2_FUSION_SW_Patch2: value-spec=0
    Init_CAN2_FUSION_SW_SHA{1..8}: value-spec=0
    Init_CAN2_FUSION_SW_Var{1..5}: value-spec=0
    Init_CAN2_FUSION_SW_change1: value-spec=0
    Init_CAN2_FUSION_SW_change2: value-spec=0
    Init_CAN2_FUSION_SW_dash1: value-spec=0
    Init_CAN2_FUSION_SW_dash2: value-spec=0
    Init_CAN2_ABM_Passenger_ODS_Sta: value-spec=0
    Init_CAN2_ABM_RearPassengerCTR_ODS_Sta: value-spec=0
    Init_CAN2_ABM_RearPassengerLH_ODS_Sta: value-spec=0
    Init_CAN2_ABM_RearPassengerRH_ODS_Sta: value-spec=0
    Init_CAN2_ABS_Active: value-spec=0
    Init_CAN2_ABS_Failed: value-spec=0
    Init_CAN2_ABS_WnlmpSta: value-spec=0
    Init_CAN2_AEBAvail: value-spec=0
    Init_CAN2_AVH_Active: value-spec=0
    Init_CAN2_AVH_Failed: value-spec=0
    Init_CAN2_AirBagFailCmd: value-spec=0
    Init_CAN2_Amber_WnlmpSta: value-spec=0
    Init_CAN2_BTCS_Active: value-spec=0
    Init_CAN2_BrkDiscTempSta: value-spec=0
    Init_CAN2_BrkSw_Sta: value-spec=0
    Init_CAN2_BrkSw_V: value-spec=0
    Init_CAN2_CrashOutputSts: value-spec=0
    Init_CAN2_DCDCAuxCur: value-spec=0
    Init_CAN2_DCDCAuxVolt: value-spec=0
    Init_CAN2_DrPMMLVOutPErrLmp: value-spec=0
    Init_CAN2_DrPMMSysErrLmp: value-spec=0
    Init_CAN2_DrSCPSysErrLmp: value-spec=0
    Init_CAN2_DriverSeatBeltCmd: value-spec=0
    Init_CAN2_EBD_Failed: value-spec=0
    Init_CAN2_EBMErrSta: value-spec=0
    Init_CAN2_EBMRLampSta: value-spec=0
    Init_CAN2_ESC_ADAS_Sta: value-spec=0
    Init_CAN2_ESC_BeepReq: value-spec=0
    Init_CAN2_ESC_Failed: value-spec=0
    Init_CAN2_ESC_OFF_Status: value-spec=0
    Init_CAN2_ESC_Off_lmpSta: value-spec=0
    Init_CAN2_ESC_WnlmpSta: value-spec=0
    Init_CAN2_ESS_Active: value-spec=0
    Init_CAN2_EpasFailed: value-spec=0
    Init_CAN2_FLTurnLPErr: value-spec=0
    Init_CAN2_FLTurn_Light_Warning: value-spec=0
    Init_CAN2_FRTurnLPErr: value-spec=0
    Init_CAN2_FRTurn_Light_Warning: value-spec=0
    Init_CAN2_FireDetErr: value-spec=0
    Init_CAN2_FrPMMLimpHomeActReq: value-spec=0
    Init_CAN2_HBB_Active: value-spec=0
    Init_CAN2_HBB_Failed: value-spec=0
    Init_CAN2_HDD_Active: value-spec=0
    Init_CAN2_HDD_Failed: value-spec=0
    Init_CAN2_HSA_Active: value-spec=0
    Init_CAN2_HSA_Failed: value-spec=0
    Init_CAN2_HVBattCurr: value-spec=10000
    Init_CAN2_HVBattErr: value-spec=0
    Init_CAN2_HVBattVolt: value-spec=0
    Init_CAN2_LADBErr: value-spec=0
    Init_CAN2_LADB_Hibeam_Indication: value-spec=0
    Init_CAN2_LADB_Operation_Status: value-spec=0
    Init_CAN2_LADB_Warning: value-spec=0
    Init_CAN2_LAHB_Warning: value-spec=0
    Init_CAN2_LDRL_Warning: value-spec=0
    Init_CAN2_LF_PulseCount: value-spec=0
    Init_CAN2_LF_PulseCount_V: value-spec=0
    Init_CAN2_LF_WhlRotDir: value-spec=0
    Init_CAN2_LH_BeamErr: value-spec=0
    Init_CAN2_LLB_Warning: value-spec=0
    Init_CAN2_LL_BeamErr: value-spec=0
    Init_CAN2_LR_PulseCount: value-spec=0
    Init_CAN2_LR_PulseCount_V: value-spec=0
    Init_CAN2_LR_WhlRotDir: value-spec=0
    Init_CAN2_LowBrakeFluid_Sta: value-spec=0
    Init_CAN2_Lposition_Lamp_Warning: value-spec=0
    Init_CAN2_Meter_Ind_VehSpeed: value-spec=0
    Init_CAN2_PABSwitchCmd: value-spec=0
    Init_CAN2_PBA_Active: value-spec=0
    Init_CAN2_PBA_Failed: value-spec=0
    Init_CAN2_PsngrSeatBeltCmd: value-spec=0
    Init_CAN2_RADBErr: value-spec=0
    Init_CAN2_RADB_Hibeam_Indication: value-spec=0
    Init_CAN2_RADB_Operation_Status: value-spec=0
    Init_CAN2_RADB_Warning: value-spec=0
    Init_CAN2_RAHB_Warning: value-spec=0
    Init_CAN2_RCenterSeatBeltCmd: value-spec=0
    Init_CAN2_RDRL_Warning: value-spec=0
    Init_CAN2_RDriverSeatBeltCmd: value-spec=0
    Init_CAN2_RF_PulseCount: value-spec=0
    Init_CAN2_RF_PulseCount_V: value-spec=0
    Init_CAN2_RF_WhlRotDir: value-spec=0
    Init_CAN2_RH_BeamErr: value-spec=0
    Init_CAN2_RLB_Warning: value-spec=0
    Init_CAN2_RLTurnLPErr: value-spec=0
    Init_CAN2_RL_BeamErr: value-spec=0
    Init_CAN2_RPsngrSeatBeltCmd: value-spec=0
    Init_CAN2_RRTurnLPErr: value-spec=0
    Init_CAN2_RR_PulseCount: value-spec=0
    Init_CAN2_RR_PulseCount_V: value-spec=0
    Init_CAN2_RR_WhlRotDir: value-spec=0
    Init_CAN2_Red_WnlmpSta: value-spec=0
    Init_CAN2_Rposition_Lamp_Warning: value-spec=0
    Init_CAN2_SAS_Angle: value-spec=9000
    Init_CAN2_SAS_V: value-spec=0
    Init_CAN2_TCS_Failed: value-spec=0
    Init_CAN2_TLHPsngrSeatBeltCmd: value-spec=0
    Init_CAN2_TRHPsngrSeatBeltCmd: value-spec=0
    Init_CAN2_VehSpeed: value-spec=0
    Init_CAN2_eBST_AmberWnlmpSta: value-spec=0
    Init_CAN2_eBST_BeepReq: value-spec=0
    Init_CAN2_eBST_RedWnlmpSta: value-spec=0
    Init_CAN2_ACChrgCurrDis: value-spec=10000
    Init_CAN2_Charge_Percent_Set: value-spec=100
    Init_CAN2_DSEAT_HW_Ver: value-spec=0
    Init_CAN2_DSEAT_SW_Ver: value-spec=0
    Init_CAN2_Fr_MCU_HW_Ver: value-spec=0
    Init_CAN2_Fr_MCU_HW_Ver_Nidec: value-spec=0
    Init_CAN2_Fr_MCU_SW_Ver: value-spec=0
    Init_CAN2_Fr_MCU_SW_Ver_Nidec: value-spec=0
    Init_CAN2_HVBChrgPwr: value-spec=0
    Init_CAN2_HVBChrgPwrTotal: value-spec=0
    Init_CAN2_HVBDrvPwr: value-spec=0
    Init_CAN2_HVBDrvPwrTotal: value-spec=0
    Init_CAN2_HVBattSOC: value-spec=0
    Init_CAN2_HVBattSOCDis: value-spec=0
    Init_CAN2_PSEAT_HW_Ver: value-spec=0
    Init_CAN2_PSEAT_SW_Ver: value-spec=0
    Init_CAN2_PTG_HW_Ver: value-spec=0
    Init_CAN2_PTG_SW_Ver: value-spec=0
    Init_CAN2_RemainChrgTime: value-spec=0
    Init_CAN2_Rr_MCU3_HW_Ver: value-spec=0
    Init_CAN2_Rr_MCU3_HW_Ver_Nidec: value-spec=0
    Init_CAN2_Rr_MCU3_SW_Ver: value-spec=0
    Init_CAN2_Rr_MCU3_SW_Ver_Nidec: value-spec=0
    Init_CAN2_TBOX_HW_VER: value-spec=0
    Init_CAN2_TBOX_SW_VER: value-spec=0
    Init_CAN2_COMP_ActualPwr: value-spec=8191
    Init_CAN2_CbnPreACEnaReq: value-spec=0
    Init_CAN2_ChargeInletLockSta: value-spec=0
    Init_CAN2_ChrgPlugSta: value-spec=0
    Init_CAN2_DKC_KeyNum_Sta: value-spec=0
    Init_CAN2_DKC_KeyType_Sta: value-spec=0
    Init_CAN2_DisChrgPlugErr: value-spec=0
    Init_CAN2_EBMSta: value-spec=0
    Init_CAN2_ExtChrgSta: value-spec=0
    Init_CAN2_FDC_BCM_DimSw: value-spec=0
    Init_CAN2_FDC_BCM_FWipSw_Sta: value-spec=7
    Init_CAN2_FDC_BCM_TurnSw_Sta: value-spec=3
    Init_CAN2_FrntPTCLeActHeatPwr: value-spec=255
    Init_CAN2_FrntPTCRearLeActHeatPwr: value-spec=255
    Init_CAN2_FrntPTCRearRiActHeatPwr: value-spec=255
    Init_CAN2_FrntPTCRiActHeatPwr: value-spec=255
    Init_CAN2_HVBChrgErr: value-spec=0
    Init_CAN2_HVBContactorSta: value-spec=0
    Init_CAN2_HVBMTempMax: value-spec=40
    Init_CAN2_HVBOvrTempErr: value-spec=0
    Init_CAN2_HVBOvrTempWarn: value-spec=0
    Init_CAN2_MainRlyNegSta: value-spec=0
    Init_CAN2_MainRlyPosSta: value-spec=0
    Init_CAN2_OBCACCSLimit: value-spec=255
    Init_CAN2_OBCACCurrInf: value-spec=40
    Init_CAN2_OBCACVoltInf: value-spec=0
    Init_CAN2_OBCFaultSta: value-spec=0
    Init_CAN2_OBC_AC_Cur_Lim: value-spec=0
    Init_CAN2_P_Dkey_Show_IVI: value-spec=0
    Init_CAN2_P_KeyMiss: value-spec=0
    Init_CAN2_P_UID_LowPower: value-spec=0
    Init_CAN2_RLS_Lamp_Sta: value-spec=0
    Init_CAN2_Re_Radio: value-spec=0
    Init_CAN2_SWC_ACC_Sta: value-spec=0
    Init_CAN2_SWC_Down_Sta: value-spec=0
    Init_CAN2_SWC_LKA_Sta: value-spec=0
    Init_CAN2_SWC_Left_Sta: value-spec=0
    Init_CAN2_SWC_RegenDown: value-spec=0
    Init_CAN2_SWC_RegenUp: value-spec=0
    Init_CAN2_SWC_Right_Sta: value-spec=0
    Init_CAN2_SWC_Trip_Sta: value-spec=0
    Init_CAN2_SWC_Undefined_Sta: value-spec=0
    Init_CAN2_SWC_Up_Sta: value-spec=0
    Init_CAN2_SWC_VR_Sta: value-spec=0
    Init_CAN2_SWC_mode_Sta: value-spec=0
    Init_CAN2_Shifter_Fail_sta: value-spec=0
    Init_CAN2_Shifter_Handle_Cmd: value-spec=0
    Init_CAN2_TBOX_NET_SIG_STR: value-spec=0
    Init_CAN2_TBOX_TEST_STATUS: value-spec=15
    Init_CAN2_TrailerCheck: value-spec=0
    Init_CAN2_TrailerModeSta: value-spec=0
    Init_CAN2_V2LSta: value-spec=0
    Init_CAN2_ZFR_BCM_ChargerDoorSW_Sta: value-spec=0
    Init_CAN2_ZFR_EChrg_Active_Sta: value-spec=0
    Init_CAN2_ZFR_EChrg_OperationDeny_Cmd: value-spec=0
    Init_CAN2_ZFR_EChrg_Sys_Sta: value-spec=0
    Init_CAN2_ZFR_EChrg_WashMode_Sta: value-spec=0
    Init_CAN2_BD_DSEAT_Anti_Sta: value-spec=0
    Init_CAN2_BD_DSEAT_EntryFun_Sta: value-spec=0
    Init_CAN2_BD_DSEAT_Error_Sta: value-spec=0
    Init_CAN2_BD_DSEAT_MemSet_Sta: value-spec=0
    Init_CAN2_BD_DSEAT_Mode_Sta: value-spec=0
    Init_CAN2_BD_DSEAT_StopKeepMove_Sta: value-spec=0
    Init_CAN2_BD_DSEAT_Vent_Sta: value-spec=0
    Init_CAN2_BD_DSEAT_heater_Sta: value-spec=0
    Init_CAN2_BD_Door_FHandleClose_Sta: value-spec=0
    Init_CAN2_BD_Door_RHandleClose_Sta: value-spec=0
    Init_CAN2_BP_Door_FHandleClose_Sta: value-spec=0
    Init_CAN2_BP_Door_RHandleClose_Sta: value-spec=0
    Init_CAN2_BP_PSEAT_Error_Sta: value-spec=0
    Init_CAN2_BP_PSEAT_Mode_Sta: value-spec=0
    Init_CAN2_BP_PSEAT_Vent_Sta: value-spec=0
    Init_CAN2_BP_PSEAT_heater_Sta: value-spec=0
    Init_CAN2_BP_PTG_Active_Sta: value-spec=0
    Init_CAN2_BP_PTG_Exist_Sta: value-spec=0
    Init_CAN2_BP_PTG_IsSetHeight_Sta: value-spec=0
    Init_CAN2_BP_PTG_Sys_Sta: value-spec=3
    Init_CAN2_BP_SEAT_LVent_Sta: value-spec=0
    Init_CAN2_BP_SEAT_MLVent_Sta: value-spec=0
    Init_CAN2_BP_SEAT_MRVent_Sta: value-spec=0
    Init_CAN2_BP_SEAT_RVent_Sta: value-spec=0
    Init_CAN2_FDC_BCM_WinLFOpened_Sta: value-spec=127
    Init_CAN2_FDC_BCM_WinLROpened_Sta: value-spec=127
    Init_CAN2_FDC_BCM_WinRFOpened_Sta: value-spec=127
    Init_CAN2_FDC_BCM_WinRROpened_Sta: value-spec=127
    Init_CAN2_Fr_EDUDrtSta: value-spec=0
    Init_CAN2_Fr_EDURealTMTq: value-spec=10220
    Init_CAN2_Fr_MCUTemp: value-spec=0
    Init_CAN2_Fr_MCUTempWarn: value-spec=3
    Init_CAN2_Fr_MotorAvailTq: value-spec=0
    Init_CAN2_Fr_TMSpd: value-spec=18000
    Init_CAN2_Fr_TMTemp: value-spec=0
    Init_CAN2_Fr_TMTempWarn: value-spec=3
    Init_CAN2_MCU_B_F_LLCTempWarn_Sta: value-spec=0
    Init_CAN2_MCU_B_R_LLCTempWarn_Sta: value-spec=0
    Init_CAN2_Rr_EDUDrtSta: value-spec=0
    Init_CAN2_Rr_EDURealTMTq: value-spec=10220
    Init_CAN2_Rr_MCUTemp: value-spec=0
    Init_CAN2_Rr_MCUTempWarn: value-spec=3
    Init_CAN2_Rr_MotorAvailTq: value-spec=0
    Init_CAN2_Rr_TMSpd: value-spec=18000
    Init_CAN2_Rr_TMTemp: value-spec=0
    Init_CAN2_Rr_TMTempWarn: value-spec=3
    Init_CAN2_SWC2_L_DriveMode_Sta: value-spec=0
    Init_CAN2_SWC2_L_Home_Sta: value-spec=0
    Init_CAN2_SWC2_R_Customize_Sta: value-spec=0
    Init_CAN2_SWC2_R_Left_Sta: value-spec=0
    Init_CAN2_SWC2_R_PageSwitch_Sta: value-spec=0
    Init_CAN2_SWC2_R_Right_Sta: value-spec=0
    Init_CAN2_SWC2_R_ScrollDown_Sta: value-spec=0
    Init_CAN2_SWC2_R_ScrollPress_Sta: value-spec=0
    Init_CAN2_SWC2_R_ScrollUp_Sta: value-spec=0
    Init_CAN2_SWC2_R_VR_Sta: value-spec=0
    Init_CAN2_DSEAT_Anti_Sta: value-spec=0
    Init_CAN2_DSEAT_EntryFun_Sta: value-spec=0
    Init_CAN2_DSEAT_Error_Sta: value-spec=0
    Init_CAN2_DSEAT_Mode: value-spec=0
    Init_CAN2_DSEAT_Vent_Sta: value-spec=0
    Init_CAN2_DSEAT_heater_sta: value-spec=0
    Init_CAN2_FAPWL_01_LIN_Response_Error: value-spec=0
    Init_CAN2_Fr_EDUDrtSta_Nidec: value-spec=0
    Init_CAN2_Fr_EDURealTMTq_Nidec: value-spec=0
    Init_CAN2_Fr_MCUTempWarn_Nidec: value-spec=3
    Init_CAN2_Fr_MCUTemp_Nidec: value-spec=0
    Init_CAN2_Fr_MotorAvailTq_Nidec: value-spec=0
    Init_CAN2_Fr_TMSpd_Nidec: value-spec=17000
    Init_CAN2_Fr_TMTempWarn_Nidec: value-spec=3
    Init_CAN2_Fr_TMTemp_Nidec: value-spec=0
    Init_CAN2_L_Drv_Motor_Relay_Error: value-spec=0
    Init_CAN2_L_Drv_Motor_Ripple_Error: value-spec=0
    Init_CAN2_L_Drv_Val_Wdw_Opened: value-spec=127
    Init_CAN2_L_Pas_Motor_Relay_Error: value-spec=0
    Init_CAN2_L_Pas_Motor_Ripple_Error: value-spec=0
    Init_CAN2_L_Pas_Val_Wdw_Opened: value-spec=127
    Init_CAN2_L_RLD_Motor_Relay_Error: value-spec=0
    Init_CAN2_L_RLD_Motor_Ripple_Error: value-spec=0
    Init_CAN2_L_RLD_Val_Wdw_Opened: value-spec=127
    Init_CAN2_L_RRD_Motor_Relay_Error: value-spec=0
    Init_CAN2_L_RRD_Motor_Ripple_Error: value-spec=0
    Init_CAN2_L_RRD_Val_Wdw_Opened: value-spec=127
    Init_CAN2_PSEAT_Error_Sta: value-spec=0
    Init_CAN2_PSEAT_Mode: value-spec=0
    Init_CAN2_PSEAT_Vent_Sta: value-spec=0
    Init_CAN2_PSEAT_heater_sta: value-spec=0
    Init_CAN2_PTG_Active_Sta: value-spec=0
    Init_CAN2_PTG_AutoStaus: value-spec=0
    Init_CAN2_PTG_Exist: value-spec=0
    Init_CAN2_PTG_Is_Set_Height: value-spec=0
    Init_CAN2_PTG_Sys_Sta: value-spec=3
    Init_CAN2_RAPWL_01_LIN_Response_Error: value-spec=0
    Init_CAN2_Rr_EDUDrtSta_Nidec: value-spec=0
    Init_CAN2_Rr_EDURealTMTq_Nidec: value-spec=1022
    Init_CAN2_Rr_MCUTempWarn_Nidec: value-spec=3
    Init_CAN2_Rr_MCUTemp_Nidec: value-spec=0
    Init_CAN2_Rr_MotorAvailTq_Nidec: value-spec=0
    Init_CAN2_Rr_TMSpd_Nidec: value-spec=17000
    Init_CAN2_Rr_TMTempWarn_Nidec: value-spec=3
    Init_CAN2_Rr_TMTemp_Nidec: value-spec=0
    Init_CAN2_ACC_ObjDist: value-spec=2046
    Init_CAN2_ACC_ObjDstLvl: value-spec=0
    Init_CAN2_ACC_ObjRelSpd: value-spec=0
    Init_CAN2_ACC_TakeoverReq: value-spec=0
    Init_CAN2_ADAS_ACC_Sta: value-spec=0
    Init_CAN2_ADAS_AEBReq: value-spec=0
    Init_CAN2_ADAS_AEB_Sta: value-spec=0
    Init_CAN2_ADAS_CAM_SpdLim: value-spec=0
    Init_CAN2_ADAS_FCW_Mute: value-spec=0
    Init_CAN2_ADAS_FCW_Sensitivity: value-spec=0
    Init_CAN2_ADAS_FCW_Sta: value-spec=0
    Init_CAN2_ADAS_FltWrnReq: value-spec=0
    Init_CAN2_ADAS_ISA_Sta: value-spec=0
    Init_CAN2_ADAS_LDW_Mute: value-spec=0
    Init_CAN2_ADAS_LDW_Sensitivity: value-spec=0
    Init_CAN2_ADAS_LDW_Sta: value-spec=0
    Init_CAN2_ADAS_LFC_Hands_Off_Warning: value-spec=0
    Init_CAN2_ADAS_LFC_Sta: value-spec=0
    Init_CAN2_ADAS_LFC_Warn_Sound: value-spec=0
    Init_CAN2_ADAS_LKA_Sta: value-spec=0
    Init_CAN2_ADAS_LaneModeL: value-spec=0
    Init_CAN2_ADAS_LaneModeR: value-spec=0
    Init_CAN2_ADAS_SLIF_SpdLim: value-spec=0
    Init_CAN2_ADAS_SLIF_Sta: value-spec=0
    Init_CAN2_ADAS_VehSpdLim: value-spec=0
    Init_CAN2_ADAS_WarningMsg: value-spec=0
    Init_CAN2_ActBrkLamp_Sta: value-spec=0
    Init_CAN2_CameraBlockage: value-spec=0
    Init_CAN2_FDC_BCM_TimeGapLevel_Sta: value-spec=0
    Init_CAN2_ForceLowBeam: value-spec=0
    Init_CAN2_HVBFullChrgPwr: value-spec=0
    Init_CAN2_HVBPwrAvailChrg: value-spec=1500
    Init_CAN2_HVBPwrAvailChrg30: value-spec=0
    Init_CAN2_HVBPwrAvailChrg60: value-spec=1500
    Init_CAN2_HVBSOH: value-spec=0
    Init_CAN2_HazardWarningReq: value-spec=0
    Init_CAN2_ISA_WarningMsg: value-spec=0
    Init_CAN2_LKA_HOD_Display_Warning: value-spec=0
    Init_CAN2_LKA_HOD_Sound_Warning: value-spec=0
    Init_CAN2_LVDA_ACCStatusInformation: value-spec=0
    Init_CAN2_LVDA_Disabled: value-spec=0
    Init_CAN2_LVDA_Failinfo: value-spec=0
    Init_CAN2_LVDA_Mute_Sta: value-spec=0
    Init_CAN2_LVDA_Warning: value-spec=0
    Init_CAN2_LeftTurnLightReq: value-spec=0
    Init_CAN2_MCU_B_F_RealPwrKw_Sta: value-spec=5300
    Init_CAN2_MCU_B_R_RealPwrKw_Sta: value-spec=5300
    Init_CAN2_RightTurnLightReq: value-spec=0
    Init_CAN2_Target_Type: value-spec=0
    Init_CAN2_HMI_ACAirIntM_Cmd: value-spec=0
    Init_CAN2_HMI_ACAirIntP_Cmd: value-spec=0
    Init_CAN2_HMI_ACAutoBtn_Cmd: value-spec=0
    Init_CAN2_HMI_ACBtn_Cmd: value-spec=0
    Init_CAN2_HMI_ACFrDefogBtn_Cmd: value-spec=0
    Init_CAN2_HMI_ACRecycleBtn_Cmd: value-spec=0
    Init_CAN2_HMI_ACWindDirM_Cmd: value-spec=0
    Init_CAN2_HMI_ACWindDirP_Cmd: value-spec=0
    Init_CAN2_HMI_AutoInterLight_Cmd: value-spec=0
    Init_CAN2_HMI_BCMPostDefogBtn_Cmd: value-spec=0
    Init_CAN2_HMI_DSEAT_LevelDown_Cmd: value-spec=0
    Init_CAN2_HMI_DSEAT_LevelUp_Cmd: value-spec=0
    Init_CAN2_HMI_Function1_LevelDown_Cmd: value-spec=0
    Init_CAN2_HMI_Function1_LevelUp_Cmd: value-spec=0
    Init_CAN2_HMI_Function2_LevelDown_Cmd: value-spec=0
    Init_CAN2_HMI_Function2_LevelUp_Cmd: value-spec=0
    Init_CAN2_HMI_Function3_LevelDown_Cmd: value-spec=0
    Init_CAN2_HMI_Function3_LevelUp_Cmd: value-spec=0
    Init_CAN2_HMI_Function4_LevelDown_Cmd: value-spec=0
    Init_CAN2_HMI_Function4_LevelUp_Cmd: value-spec=0
    Init_CAN2_HMI_Function5_LevelDown_Cmd: value-spec=0
    Init_CAN2_HMI_Function5_LevelUp_Cmd: value-spec=0
    Init_CAN2_HMI_Function6_LevelDown_Cmd: value-spec=0
    Init_CAN2_HMI_Function6_LevelUp_Cmd: value-spec=0
    Init_CAN2_HMI_PSEAT_LevelDown_Cmd: value-spec=0
    Init_CAN2_HMI_PSEAT_LevelUp_Cmd: value-spec=0
    Init_CAN2_HMI_ZLSetTM_Cmd: value-spec=0
    Init_CAN2_HMI_ZLSetTP_Cmd: value-spec=0
    Init_CAN2_HMI_ZRSetTM_Cmd: value-spec=0
    Init_CAN2_HMI_ZRSetTP_Cmd: value-spec=0
    Init_CAN2_A2B_Node_sta: value-spec=0
    Init_CAN2_AmbLigh_LowBatAlert_SW: value-spec=0
    Init_CAN2_AmbLigh_SafetyAlert_SW: value-spec=0
    Init_CAN2_AmbLightBrightnessSet: value-spec=101
    Init_CAN2_AmbLightColorSet: value-spec=64
    Init_CAN2_AmbLight_DimInDark_SW: value-spec=0
    Init_CAN2_AmbLight_SW: value-spec=0
    Init_CAN2_AmbLight_WlcmLight_SW: value-spec=0
    Init_CAN2_BrkAbn_GoReady_SW: value-spec=0
    Init_CAN2_FCP_FrEvt_BtnACMaxReq: value-spec=0
    Init_CAN2_FCP_FrEvt_BtnACReq: value-spec=0
    Init_CAN2_FCP_FrEvt_BtnAutoReq: value-spec=0
    Init_CAN2_FCP_FrEvt_BtnSyncReq: value-spec=0
    Init_CAN2_FCP_MidEvt_BtnAutoReq: value-spec=0
    Init_CAN2_IVI_AirRefresh_ByDMS_Sta: value-spec=0
    Init_CAN2_IVI_AutoTheme_But_Sta: value-spec=0
    Init_CAN2_IVI_AutoWipHSpdSW_Cmd: value-spec=0
    Init_CAN2_IVI_CLWin_LockDoorSW_Sta: value-spec=0
    Init_CAN2_IVI_CreateAccReq_Sta: value-spec=0
    Init_CAN2_IVI_DMS_SW_Sta: value-spec=0
    Init_CAN2_IVI_DSEAT_StopKeepMove_Sta: value-spec=0
    Init_CAN2_IVI_DSEAT_anti_set_Sta: value-spec=0
    Init_CAN2_IVI_DSEAT_entryfun_set_Sta: value-spec=0
    Init_CAN2_IVI_DelAccReq_Sta: value-spec=0
    Init_CAN2_IVI_Driving_Lock_SW_Sta: value-spec=0
    Init_CAN2_IVI_EPS_Force_Cmd: value-spec=0
    Init_CAN2_IVI_FrTrunk_UnlockReq_Sta: value-spec=0
    Init_CAN2_IVI_HMI_Undefined_Sta: value-spec=0
    Init_CAN2_IVI_LinkAccReq_Sta: value-spec=0
    Init_CAN2_IVI_LinkAcc_Sta: value-spec=0
    Init_CAN2_IVI_LinkKey_Sta: value-spec=0
    Init_CAN2_IVI_Located_STA: value-spec=3
    Init_CAN2_IVI_Lock_SoundSW_Sta: value-spec=0
    Init_CAN2_IVI_MirrorFolded_SW_Sta: value-spec=0
    Init_CAN2_IVI_NAVI_Foreground_Sta: value-spec=0
    Init_CAN2_IVI_OTA_Upd_Sta: value-spec=0
    Init_CAN2_IVI_QuickRefresh_Sta: value-spec=0
    Init_CAN2_IVI_SWC_VibMode_Sta: value-spec=0
    Init_CAN2_IVI_SilentChrg_Alert_Sta: value-spec=0
    Init_CAN2_IVI_Stopping_Unlock_SW_Sta: value-spec=0
    Init_CAN2_IVI_Theme_Sta: value-spec=0
    Init_CAN2_IVI_Time_Check: value-spec=0
    Init_CAN2_IVI_Time_Day: value-spec=0
    Init_CAN2_IVI_Time_Hour: value-spec=0
    Init_CAN2_IVI_Time_Minute: value-spec=0
    Init_CAN2_IVI_Time_Month: value-spec=0
    Init_CAN2_IVI_Time_Second: value-spec=0
    Init_CAN2_IVI_Time_Year: value-spec=0
    Init_CAN2_IVI_WPTC_SW_Sta: value-spec=0
    Init_CAN2_IVI_WirelessCharge_Cmd: value-spec=0
    Init_CAN2_IVI_sigScreenReq_Sta: value-spec=0
    Init_CAN2_LINKtoDrive: value-spec=0
    Init_CAN2_OTA_CancelDL_Req: value-spec=0
    Init_CAN2_OTA_CompNTFY_Pres: value-spec=0
    Init_CAN2_OTA_DL_Req: value-spec=0
    Init_CAN2_OTA_SuspendDL_Req: value-spec=0
    Init_CAN2_OTA_UpdStart_Req: value-spec=0
    Init_CAN2_OpenDrOpenWdo_SW: value-spec=0
    Init_CAN2_PW_CLOSE_IMD: value-spec=0
    Init_CAN2_PW_CONTINUE_USE: value-spec=0
    Init_CAN2_Re_Radio_Sta: value-spec=0
    Init_CAN2_Sched_Chg_Day_Set: value-spec=0
    Init_CAN2_Sched_Chg_End_Time_HR: value-spec=0
    Init_CAN2_Sched_Chg_End_Time_Min: value-spec=0
    Init_CAN2_Sched_Chg_St_Time_HR: value-spec=0
    Init_CAN2_Sched_Chg_St_Time_Min: value-spec=0
    Init_CAN2_Sched_OTA_wake: value-spec=0
    Init_CAN2_SmartEco_Mode_SW: value-spec=0
    Init_CAN2_Upd_Countdown_Cancel: value-spec=0
    Init_CAN2_Upd_Countdown_Skip: value-spec=0
    Init_CAN2_UserSet: value-spec=0
    Init_CAN2_VehACModReq: value-spec=0
    Init_CAN2_mFRD_link_Sta: value-spec=0
    Init_CAN2_AC_Chg_Cur_Set: value-spec=127
    Init_CAN2_AEB_BUTT: value-spec=0
    Init_CAN2_AVM_Err_STA: value-spec=0
    Init_CAN2_AVM_OFF_Rec_Butt: value-spec=0
    Init_CAN2_AVM_Parking_mode: value-spec=0
    Init_CAN2_AVM_parking_cancel: value-spec=0
    Init_CAN2_AVM_parking_excute: value-spec=0
    Init_CAN2_Approach_Unlock_SW: value-spec=0
    Init_CAN2_BSDMute_BUTT: value-spec=0
    Init_CAN2_CAAS_Sw: value-spec=0
    Init_CAN2_CDL_Lock_Butt: value-spec=0
    Init_CAN2_CDL_Unlock_Butt: value-spec=0
    Init_CAN2_CameraWrn: value-spec=0
    Init_CAN2_DMS_Status: value-spec=0
    Init_CAN2_DMS_Warning_Distraction: value-spec=0
    Init_CAN2_DMS_Warning_Fatigue: value-spec=0
    Init_CAN2_DMS_Warning_Unresponsive: value-spec=0
    Init_CAN2_DSEAT_anti_set: value-spec=0
    Init_CAN2_DSEAT_entryfun_set: value-spec=0
    Init_CAN2_DSEAT_vent_req: value-spec=0
    Init_CAN2_Distance_unit: value-spec=0
    Init_CAN2_ESC_SW_Cmd: value-spec=0
    Init_CAN2_FCWMute_BUTT: value-spec=0
    Init_CAN2_FFogLampSW: value-spec=0
    Init_CAN2_FS_Off_Sw: value-spec=0
    Init_CAN2_FalseNPrevent_SW: value-spec=1
    Init_CAN2_FollowMeSW: value-spec=0
    Init_CAN2_GPS_LAT: value-spec=0
    Init_CAN2_GPS_LONG: value-spec=0
    Init_CAN2_HeadLampSW: value-spec=0
    Init_CAN2_Hood_Latch_SW: value-spec=0
    Init_CAN2_IVI_ACC_Adaptive_Sta: value-spec=0
    Init_CAN2_IVI_AGSCloseSW: value-spec=0
    Init_CAN2_IVI_ActvDmpDisabSW: value-spec=0
    Init_CAN2_IVI_AirIntZ3_Cmd: value-spec=0
    Init_CAN2_IVI_Backlight_Sta: value-spec=0
    Init_CAN2_IVI_CarWash_Mode_Cmd: value-spec=0
    Init_CAN2_IVI_CfmTo_Rdy: value-spec=0
    Init_CAN2_IVI_ChargePortSW_Sta: value-spec=0
    Init_CAN2_IVI_CoastDwSW: value-spec=0
    Init_CAN2_IVI_CreepSW_Req: value-spec=0
    Init_CAN2_IVI_DMS_Faceblocked_Sta: value-spec=0
    Init_CAN2_IVI_DMS_NoDriverDetected_Sta: value-spec=0
    Init_CAN2_IVI_DSEATHeater_Cmd: value-spec=0
    Init_CAN2_IVI_DSEAT_FroEdge_Height_Cmd: value-spec=0
    Init_CAN2_IVI_DSEAT_Height_Cmd: value-spec=0
    Init_CAN2_IVI_DSEAT_Memory1_Sta: value-spec=0
    Init_CAN2_IVI_DSEAT_Memory2_Sta: value-spec=0
    Init_CAN2_IVI_DSEAT_Memory_OPTCLS_Sta: value-spec=0
    Init_CAN2_IVI_DSEAT_Recline_Cmd: value-spec=0
    Init_CAN2_IVI_DSEAT_Slide_Cmd: value-spec=0
    Init_CAN2_IVI_FGSAirInt_Cmd: value-spec=0
    Init_CAN2_IVI_FGSCh_Cmd: value-spec=0
    Init_CAN2_IVI_FWipIntTSet_Cmd: value-spec=0
    Init_CAN2_IVI_GPS_Lat_Dir_Sta: value-spec=3
    Init_CAN2_IVI_GPS_Long_Dir_Sta: value-spec=3
    Init_CAN2_IVI_IC_Brightness_Sta: value-spec=127
    Init_CAN2_IVI_IONSW_Cmd: value-spec=0
    Init_CAN2_IVI_ISA_OffsetSpd: value-spec=15
    Init_CAN2_IVI_LVChrgFuncSW: value-spec=0
    Init_CAN2_IVI_Mute_Sta: value-spec=0
    Init_CAN2_IVI_Night_Mode_Sta: value-spec=0
    Init_CAN2_IVI_Off_Road_Mode_Sta: value-spec=0
    Init_CAN2_IVI_PSEATHeater_Cmd: value-spec=0
    Init_CAN2_IVI_PSEAT_Recline_Cmd: value-spec=0
    Init_CAN2_IVI_PSEAT_Slide_Cmd: value-spec=0
    Init_CAN2_IVI_PTG_Mode_SW: value-spec=0
    Init_CAN2_IVI_PTG_Open_Height: value-spec=5
    Init_CAN2_IVI_PTG_Sta_SW: value-spec=0
    Init_CAN2_IVI_PTG_USSta_SW: value-spec=0
    Init_CAN2_IVI_PW_Mode_Req: value-spec=0
    Init_CAN2_IVI_Panel_Act: value-spec=0
    Init_CAN2_IVI_Panel_X_Coor: value-spec=0
    Init_CAN2_IVI_Panel_Y_Coor: value-spec=0
    Init_CAN2_IVI_PwrLockSW: value-spec=0
    Init_CAN2_IVI_Pwroff_req: value-spec=0
    Init_CAN2_IVI_RR_Def_Req: value-spec=0
    Init_CAN2_IVI_Req_V2L: value-spec=0
    Init_CAN2_IVI_SLIF_Warning_Sta: value-spec=3
    Init_CAN2_IVI_SWC_ACCMode_Sta: value-spec=0
    Init_CAN2_IVI_SWC_LUndefined_Sta: value-spec=0
    Init_CAN2_IVI_SWC_RUndefined_Sta: value-spec=0
    Init_CAN2_IVI_Screen: value-spec=0
    Init_CAN2_IVI_SetTempZon1_Sta: value-spec=31
    Init_CAN2_IVI_SetTempZon2_Sta: value-spec=31
    Init_CAN2_IVI_Start_Chg_req: value-spec=0
    Init_CAN2_IVI_Status: value-spec=0
    Init_CAN2_IVI_Stop_Chg_req: value-spec=0
    Init_CAN2_IVI_TrailerCheckReq_Sta: value-spec=0
    Init_CAN2_IVI_TrailerModeSW_Sta: value-spec=0
    Init_CAN2_IVI_Trigger_req: value-spec=0
    Init_CAN2_IVI_Unlock_Chg_req: value-spec=0
    Init_CAN2_IVI_WI_MAIN_SW: value-spec=0
    Init_CAN2_LDWMute_BUTT: value-spec=0
    Init_CAN2_LKA_BUTT: value-spec=0
    Init_CAN2_LVDAMute_BUTT: value-spec=0
    Init_CAN2_L_Drv_ControlCommand: value-spec=127
    Init_CAN2_L_Pas_ControlCommand: value-spec=127
    Init_CAN2_L_RLD_ControlCommand: value-spec=127
    Init_CAN2_L_RRD_ControlCommand: value-spec=127
    Init_CAN2_Light_ShowStart_Req: value-spec=0
    Init_CAN2_Light_ShowStop_Req: value-spec=0
    Init_CAN2_METER_Malfunc_Sta: value-spec=0
    Init_CAN2_MFRD_N_Bright_Req: value-spec=0
    Init_CAN2_NAVI_Cam_Dist_info: value-spec=0
    Init_CAN2_NAVI_Direction_STA: value-spec=0
    Init_CAN2_NAVI_Distance_info: value-spec=0
    Init_CAN2_NAVI_ForwardLinkLevel: value-spec=0
    Init_CAN2_NAVI_LinkClass: value-spec=0
    Init_CAN2_NAVI_RoadClass: value-spec=0
    Init_CAN2_NAVI_SpeedLimit: value-spec=0
    Init_CAN2_NAVI_Speed_Limit_A: value-spec=0
    Init_CAN2_NAVI_State: value-spec=0
    Init_CAN2_NAVI_Tollgate: value-spec=0
    Init_CAN2_NAVI_Tunnel: value-spec=0
    Init_CAN2_ODAMute_BUTT: value-spec=0
    Init_CAN2_OFF_AC_MODE: value-spec=0
    Init_CAN2_PSEAT_vent_req: value-spec=0
    Init_CAN2_Perd_V2L: value-spec=0
    Init_CAN2_Pressure_unit: value-spec=0
    Init_CAN2_RCTA_BUTT: value-spec=0
    Init_CAN2_RFogLampSW: value-spec=0
    Init_CAN2_Roll_Eng_Mode: value-spec=0
    Init_CAN2_Roll_Mode_SW_Cmd: value-spec=0
    Init_CAN2_RoomLampMode: value-spec=0
    Init_CAN2_SLG_Sw: value-spec=0
    Init_CAN2_SLIF_BUTT: value-spec=0
    Init_CAN2_SOC_ADJ_BUTT: value-spec=0
    Init_CAN2_SOC_Limit_Set: value-spec=25
    Init_CAN2_SOC_V2LLimit: value-spec=0
    Init_CAN2_Sched_Chg_Start: value-spec=0
    Init_CAN2_Sched_Chg_Stop: value-spec=0
    Init_CAN2_Sched_Chg_butt: value-spec=0
    Init_CAN2_Sched_Chg_limit: value-spec=25
    Init_CAN2_Sched_Chg_wake: value-spec=0
    Init_CAN2_SenstivityPosition: value-spec=0
    Init_CAN2_SetUnlockSingle: value-spec=0
    Init_CAN2_TCS_SW_Cmd: value-spec=0
    Init_CAN2_TPMS_Cali_Butt: value-spec=0
    Init_CAN2_TPMS_Res_Butt: value-spec=0
    Init_CAN2_Temperature_unit: value-spec=0
    Init_CAN2_Time_system: value-spec=0
    Init_CAN2_TurnSwTimeSet: value-spec=0
    Init_CAN2_User_p_download: value-spec=0
    Init_CAN2_User_p_upload: value-spec=0
    Init_CAN2_Walkaway_Lock_SW: value-spec=0
    Init_CAN2_Wifi_Reset: value-spec=0
    Init_CAN2_Wifi_Sta_IVI_TBOX: value-spec=0
    Init_CAN2_WlcmLight_Mode: value-spec=0
    Init_CAN2_sigAirIntenZon1Req: value-spec=0
    Init_CAN2_sigAirIntenZon3Req: value-spec=0
    Init_CAN2_sigDfrstReq: value-spec=0
    Init_CAN2_sigFaceReq: value-spec=0
    Init_CAN2_sigFootReq: value-spec=0
    Init_CAN2_sigHvacFrontReq: value-spec=0
    Init_CAN2_sigHvacRearReq: value-spec=0
    Init_CAN2_sigHvacReq: value-spec=0
    Init_CAN2_sigRecircReq: value-spec=0
    Init_CAN2_sigSetTempZon1Req: value-spec=31
    Init_CAN2_sigSetTempZon2Req: value-spec=31
    Init_CAN2_sigSetTempZon3Req: value-spec=0
    Init_CAN2_sigWindDirZon3Req: value-spec=7
    Init_CAN2_IVI_CLBlower_Y_Sta: value-spec=127
    Init_CAN2_IVI_CLBlower_Z_Sta: value-spec=127
    Init_CAN2_IVI_CRBlower_Y_Sta: value-spec=127
    Init_CAN2_IVI_CRBlower_Z_Sta: value-spec=127
    Init_CAN2_IVI_HMI_CustmiFun_Sta: value-spec=0
    Init_CAN2_IVI_HMI_CustmiKEY_Sta: value-spec=0
    Init_CAN2_IVI_LBlower_Mode_Sta: value-spec=0
    Init_CAN2_IVI_LBlower_Y_Sta: value-spec=127
    Init_CAN2_IVI_LBlower_Z_Sta: value-spec=127
    Init_CAN2_IVI_LSEATvent_Cmd: value-spec=0
    Init_CAN2_IVI_LeftPSDOpenClose_Cmd: value-spec=0
    Init_CAN2_IVI_MLFMost_Cmd: value-spec=0
    Init_CAN2_IVI_MLFootLift_Cmd: value-spec=0
    Init_CAN2_IVI_MLNapMode_Cmd: value-spec=0
    Init_CAN2_IVI_MLRecliner_Cmd: value-spec=0
    Init_CAN2_IVI_MLRestore_Cmd: value-spec=0
    Init_CAN2_IVI_MLSEATvent_Cmd: value-spec=0
    Init_CAN2_IVI_MLSeatLift_Cmd: value-spec=0
    Init_CAN2_IVI_MLSldRestore_Cmd: value-spec=0
    Init_CAN2_IVI_MLSlider_Cmd: value-spec=0
    Init_CAN2_IVI_MLZeroGravity_Cmd: value-spec=0
    Init_CAN2_IVI_MRFMost_Cmd: value-spec=0
    Init_CAN2_IVI_MRFootLift_Cmd: value-spec=0
    Init_CAN2_IVI_MRNapMode_Cmd: value-spec=0
    Init_CAN2_IVI_MRRecliner_Cmd: value-spec=0
    Init_CAN2_IVI_MRRestore_Cmd: value-spec=0
    Init_CAN2_IVI_MRSEATvent_Cmd: value-spec=0
    Init_CAN2_IVI_MRSeatLift_Cmd: value-spec=0
    Init_CAN2_IVI_MRSldRestore_Cmd: value-spec=0
    Init_CAN2_IVI_MRSlider_Cmd: value-spec=0
    Init_CAN2_IVI_MRZeroGravity_Cmd: value-spec=0
    Init_CAN2_IVI_PSDManualPower_Sta: value-spec=1
    Init_CAN2_IVI_RBlower_Mode_Sta: value-spec=0
    Init_CAN2_IVI_RBlower_Y_Sta: value-spec=127
    Init_CAN2_IVI_RBlower_Z_Sta: value-spec=127
    Init_CAN2_IVI_RSEATvent_Cmd: value-spec=0
    Init_CAN2_IVI_RightPSDOpenClose_Cmd: value-spec=0
    Init_CAN2_IVI_RollMod_atCarWash_Sta: value-spec=0
    Init_CAN2_IVI_SOS_Call_Sta: value-spec=0
    Init_CAN2_IVI_SnowMode_Cmd: value-spec=0
    Init_CAN2_IVI_UserTakeOver_APS_Sta: value-spec=0
    Init_CAN2_IVI_XWDMode_Cmd: value-spec=0
    Init_CAN2_IVI_Zon1WindDirSWReq_Sta: value-spec=0
    Init_CAN2_APCforDTE: value-spec=9999
    Init_CAN2_AVGPwrConsumption: value-spec=9999
    Init_CAN2_AvailableTrip: value-spec=0
    Init_CAN2_Averaged_vehspeed: value-spec=0
    Init_CAN2_Charge: value-spec=0
    Init_CAN2_LEDlitWarnReq: value-spec=0
    Init_CAN2_METER_KPH_Calcu: value-spec=0
    Init_CAN2_METER_KPH_Real: value-spec=0
    Init_CAN2_METER_MPH_Calcu: value-spec=0
    Init_CAN2_METER_MPH_Real: value-spec=0
    Init_CAN2_ODOMETER: value-spec=0
    Init_CAN2_ParkBrake: value-spec=0
    Init_CAN2_Spd_Crl_Mode: value-spec=0
    Init_CAN2_Spd_Crl_Sta: value-spec=0
    Init_CAN2_Trip_A: value-spec=0
    Init_CAN2_Trip_B: value-spec=0
    Init_CAN2_SG_FD2_C20_0: value-spec=fields=[Init_CAN2_APS_ExitCondition, Init_CAN2_APS_RQ_Display, Init_CAN2_APS_SW_Ver, Init_CAN2_APS_Sta_System, Init_CAN2_CAAS_Sta, Init_CAN2_DISC_DISCTargetSpd, Init_CAN2_FDC_VCU_RegenLimInd_Sta, Init_CAN2_FDC_VCU_RegenMode_Sta, Init_CAN2_FDC_VCU_SimSound_Cmd, Init_CAN2_FDC_VCU_SmartEcoSpdLim_Sta, Init_CAN2_FDC_VCU_SmartEco_Sta, Init_CAN2_FDC_VMC_SetSpdDisp_Sta, Init_CAN2_FDC_VMC_SetSpd_Sta, Init_CAN2_FDC_VMC_SpdCtrlMode_Sta, Init_CAN2_FDC_VMC_SpdCtrl_Sta, Init_CAN2_PAS_A_FCL, Init_CAN2_PAS_A_FCR, Init_CAN2_PAS_A_FML, Init_CAN2_PAS_A_FMR, Init_CAN2_PAS_A_RCL, Init_CAN2_PAS_A_RCR, Init_CAN2_PAS_A_RML, Init_CAN2_PAS_A_RMR, Init_CAN2_PAS_Chime, Init_CAN2_PAS_D_FCL, Init_CAN2_PAS_D_FCR, Init_CAN2_PAS_D_FML, Init_CAN2_PAS_D_FMR, Init_CAN2_PAS_D_RCL, Init_CAN2_PAS_D_RCR, Init_CAN2_PAS_D_RML, Init_CAN2_PAS_D_RMR, Init_CAN2_PAS_SNSR_Layout, Init_CAN2_USS_Sta_FCL, Init_CAN2_USS_Sta_FCR, Init_CAN2_USS_Sta_FLL, Init_CAN2_USS_Sta_FLR, Init_CAN2_USS_Sta_FML, Init_CAN2_USS_Sta_FMR, Init_CAN2_USS_Sta_RCL, Init_CAN2_USS_Sta_RCR, Init_CAN2_USS_Sta_RLL, Init_CAN2_USS_Sta_RLR, Init_CAN2_USS_Sta_RML, Init_CAN2_USS_Sta_RMR, Init_CAN2_VMC_VCU_CC_Crl_Sta, Init_CAN2_VMC_VCU_MSA_Crl_Sta]
    Init_CAN2_SG_FD2_CE100_0: value-spec=fields=[Init_CAN2_APMDoorControlSta, Init_CAN2_ActAPSPosn, Init_CAN2_AllDoorSW, Init_CAN2_AntitheftSta, Init_CAN2_BCM_DoorLock_Sta, Init_CAN2_BrakeLamp, Init_CAN2_CCMSA_SpdWar, Init_CAN2_CCU_ACLampSts, Init_CAN2_CCU_ACMaxLampSts, Init_CAN2_CCU_AutoLampSts, Init_CAN2_CCU_AutoMidLampSts, Init_CAN2_CCU_Dispaly_Request, Init_CAN2_CCU_EcoSts, Init_CAN2_CCU_FrtOnOffLampSts, Init_CAN2_CCU_RrOnOffLampSts, Init_CAN2_CCU_SyncLampSts, Init_CAN2_CC_Crl_Sta, Init_CAN2_CoastDwModeStaChk, Init_CAN2_CreepSW_Sta, Init_CAN2_DISC_ButtSta, Init_CAN2_DISC_Sta, Init_CAN2_DemoModeStaChk, Init_CAN2_Dimmer, Init_CAN2_DimmerEN, Init_CAN2_DisengageP_Fail, Init_CAN2_DoorLockIND, Init_CAN2_DrDoorSW, Init_CAN2_Dr_SeatSta, Init_CAN2_DynoModeStaChk, Init_CAN2_EDriveSysErr_AccPedalErr, Init_CAN2_EDriveSysErr_MCUErr, Init_CAN2_EDriveSysErr_ShifterErr, Init_CAN2_EDriveSysErr_VCUErr, Init_CAN2_EVDriveMode, Init_CAN2_Eng_AGSCloseSta, Init_CAN2_Eng_ActvDmpDisabSta, Init_CAN2_Eng_CoastDwSta, Init_CAN2_Eng_PwrLockSta, Init_CAN2_EngageP_Fail, Init_CAN2_FDC_BCM_AutoWipHSpdEN_Sta, Init_CAN2_FDC_BCM_HMIKey1Func_Sta, Init_CAN2_FDC_BCM_HMIKey2Func_Sta, Init_CAN2_FDC_BCM_HMIKey3Func_Sta, Init_CAN2_FDC_BCM_HMIKey4Func_Sta, Init_CAN2_FDC_BCM_HMIKey5Func_Sta, Init_CAN2_FDC_BCM_HMIKey6Func_Sta, Init_CAN2_FDC_BCM_HMIKey7Func_Sta, Init_CAN2_FDC_BCM_HMIKey8Func_Sta, Init_CAN2_FDC_RAPS_ErrWarn_Sta, Init_CAN2_FDC_THCM_CLEVentY_Sta, Init_CAN2_FDC_THCM_CLEVentZ_Sta, Init_CAN2_FDC_THCM_CLVent_Sta, Init_CAN2_FDC_THCM_CREVentY_Sta, Init_CAN2_FDC_THCM_CREVentZ_Sta, Init_CAN2_FDC_THCM_CRVent_Sta, Init_CAN2_FDC_THCM_LEVentMode_Sta, Init_CAN2_FDC_THCM_LEVentY_Sta, Init_CAN2_FDC_THCM_LEVentZ_Sta, Init_CAN2_FDC_THCM_LVent_Sta, Init_CAN2_FDC_THCM_PreWPTCHeat_Sta, Init_CAN2_FDC_THCM_REVentMode_Sta, Init_CAN2_FDC_THCM_REVentY_Sta, Init_CAN2_FDC_THCM_REVentZ_Sta, Init_CAN2_FDC_THCM_RVent_Sta, Init_CAN2_FDC_V2L_IVIV2LDischarg_Cmd, Init_CAN2_FDC_VCU_LVChrgFreq_Sta, Init_CAN2_FDC_VCU_LVStaDropQuick_Sta, Init_CAN2_FDC_VCU_LVStaTooLow_Sta, Init_CAN2_FDC_VCU_PwrSaveReq_Cmd, Init_CAN2_FDC_VCU_TrailerDisOPD_Sta, Init_CAN2_FD_ABS_Warning, Init_CAN2_FD_AGS_Cmd, Init_CAN2_FD_Battery_Charge_Warning, Init_CAN2_FD_EBMErrSta, Init_CAN2_FD_EDrive_System, Init_CAN2_FD_EPB_Error, Init_CAN2_FD_HV_Battery_Fault, Init_CAN2_FD_Park_Brake_Warning, Init_CAN2_FD_Power_limitation, Init_CAN2_FD_Steering_Warning, Init_CAN2_FD_TCS_Indicator, Init_CAN2_FD_Telltale_Fail, Init_CAN2_FalseNPrevent_Sta, Init_CAN2_FeatSetSpdFinal_raw32, Init_CAN2_FollowMe, Init_CAN2_Fr_FogLamp, Init_CAN2_HVRlyOpFail, Init_CAN2_HVSysErr_IsolationErr, Init_CAN2_HVSysErr_PackErr, Init_CAN2_HVSysErr_RelayErr, Init_CAN2_H_Beam, Init_CAN2_HazardSW, Init_CAN2_HoodSW, Init_CAN2_LBSD, Init_CAN2_LDRL, Init_CAN2_LTurnLP, Init_CAN2_LVChrgFuncStaChk, Init_CAN2_LVSilentChrgReq, Init_CAN2_LVSilentChrgSta, Init_CAN2_LVSysErr_PwrOutpErr, Init_CAN2_L_Beam, Init_CAN2_LimphomeAct, Init_CAN2_LockSetting, Init_CAN2_MCUActDisFail, Init_CAN2_MSA_Crl_Sta, Init_CAN2_MeterIndSpeed_raw32, Init_CAN2_PAS_Sta_F_Sys, Init_CAN2_PosLamp, Init_CAN2_PsDoorSW, Init_CAN2_PwrSta, Init_CAN2_PwrStaErr, Init_CAN2_PwrStaONTOIVIPopReq, Init_CAN2_PwrStaONTOIVIPopT, Init_CAN2_RBSD, Init_CAN2_RDRL, Init_CAN2_RLDoorSW, Init_CAN2_RRDoorSW, Init_CAN2_RTurnLP, Init_CAN2_Req_Internal_V2L_Status_Lamp, Init_CAN2_Req_V2LSwOn, Init_CAN2_Req_V2L_IVI_Popup, Init_CAN2_ReverseLamp, Init_CAN2_Rr_Defog, Init_CAN2_Rr_FogLamp, Init_CAN2_ShiftGearPosn, Init_CAN2_SysAllowReadySta, Init_CAN2_SysPwrSta, Init_CAN2_Tailgate_SW, Init_CAN2_VCUBrkSWSta, Init_CAN2_VCUFLDoorSta, Init_CAN2_VCUFRDoorSta, Init_CAN2_VCUHoodSWSta, Init_CAN2_VCURLDoorSta, Init_CAN2_VCURRDoorSta, Init_CAN2_VCUTailgateSWSta, Init_CAN2_VCU_OPDHold, Init_CAN2_VehMalfunLevel, Init_CAN2_XWDMode, Init_CAN2_sigAirIntenZon1St, Init_CAN2_sigAirIntenZon3St, Init_CAN2_sigAmbAirT, Init_CAN2_sigCbnAirT, Init_CAN2_sigDfrstSt, Init_CAN2_sigHvacSt, Init_CAN2_sigRecircSt, Init_CAN2_sigSetTempZon1St, Init_CAN2_sigSetTempZon2St, Init_CAN2_sigSetTempZon3St, Init_CAN2_sigWindDirZon1St, Init_CAN2_sigWindDirZon3St]
    Init_CAN2_SG_FD2_CE200_1: value-spec=fields=[Init_CAN2_AutoLTips, Init_CAN2_CWheelTips, Init_CAN2_FDC_BCM_Acc1Sta_Sta, Init_CAN2_FDC_BCM_Acc2Sta_Sta, Init_CAN2_FDC_BCM_Acc3Sta_Sta, Init_CAN2_FDC_BCM_Acc4Sta_Sta, Init_CAN2_FDC_BCM_Acc5Sta_Sta, Init_CAN2_FDC_BCM_AmbBrightSta_Sta, Init_CAN2_FDC_BCM_AmbColorSta_Sta, Init_CAN2_FDC_BCM_AmbDimEN_Sta, Init_CAN2_FDC_BCM_AmbFunEN_Sta, Init_CAN2_FDC_BCM_AmbLinkDriSta_Sta, Init_CAN2_FDC_BCM_AmbODAEN_Sta, Init_CAN2_FDC_BCM_AmbPwrWarnEN_Sta, Init_CAN2_FDC_BCM_AmbWelEN_Sta, Init_CAN2_FDC_BCM_AutoLock_Sta, Init_CAN2_FDC_BCM_AutoUnlock_Sta, Init_CAN2_FDC_BCM_CLWinLockDr_Sta, Init_CAN2_FDC_BCM_DSEATentryfset_Sta, Init_CAN2_FDC_BCM_FollowMeENFun_Sta, Init_CAN2_FDC_BCM_HBeamADB_Cmd, Init_CAN2_FDC_BCM_Key10Acc_Sta, Init_CAN2_FDC_BCM_Key1Acc_Sta, Init_CAN2_FDC_BCM_Key2Acc_Sta, Init_CAN2_FDC_BCM_Key3Acc_Sta, Init_CAN2_FDC_BCM_Key4Acc_Sta, Init_CAN2_FDC_BCM_Key5Acc_Sta, Init_CAN2_FDC_BCM_Key6Acc_Sta, Init_CAN2_FDC_BCM_Key7Acc_Sta, Init_CAN2_FDC_BCM_Key8Acc_Sta, Init_CAN2_FDC_BCM_Key9Acc_Sta, Init_CAN2_FDC_BCM_LockAlarm_Cmd, Init_CAN2_FDC_BCM_PTGOpenHeight_Sta, Init_CAN2_FDC_BCM_RmLpModeENFun_Sta, Init_CAN2_FDC_BCM_TurnSwTSetSta_Sta, Init_CAN2_FDC_BCM_UserNow_Sta, Init_CAN2_FDC_BCM_WalkInUnLkEnFun_Sta, Init_CAN2_FDC_BCM_WalkOutLkEnFun_Sta, Init_CAN2_FDC_DKC_DkeyShowIVI_Sta, Init_CAN2_FDC_DKC_KeyMiss_Sta, Init_CAN2_FDC_DKC_KeyNum_Sta, Init_CAN2_FDC_DKC_KeyType_Sta, Init_CAN2_FDC_DKC_UIDLowPower_Sta, Init_CAN2_FDC_FGS_AirInt_Sta, Init_CAN2_FDC_FGS_FGSCh_Sta, Init_CAN2_FDC_FGS_IONSW_Sta, Init_CAN2_FDC_SPTG_SPTGENFun_Sta, Init_CAN2_FDC_THCM_APTCForceOFF_Sta, Init_CAN2_FDC_THCM_APTCWarning_Sta, Init_CAN2_FDC_THCM_AirIntZ3_Sta, Init_CAN2_LFBatWarn, Init_CAN2_LFPressIndi, Init_CAN2_LFSensorFail, Init_CAN2_LFWheelDebug, Init_CAN2_LFWheelPSW, Init_CAN2_LFWheelPress, Init_CAN2_LFWheelShield, Init_CAN2_LFWheelTemp, Init_CAN2_LFWheelTmpIndi, Init_CAN2_LRBatWarn, Init_CAN2_LRPressIndi, Init_CAN2_LRSensorFail, Init_CAN2_LRWheelDebug, Init_CAN2_LRWheelPSW, Init_CAN2_LRWheelPress, Init_CAN2_LRWheelShield, Init_CAN2_LRWheelTemp, Init_CAN2_LRWheelTmpIndi, Init_CAN2_RFBatWarn, Init_CAN2_RFPressIndi, Init_CAN2_RFSensorFail, Init_CAN2_RFWheelDebug, Init_CAN2_RFWheelPSW, Init_CAN2_RFWheelPress, Init_CAN2_RFWheelShield, Init_CAN2_RFWheelTemp, Init_CAN2_RFWheelTmpIndi, Init_CAN2_RRBatWarn, Init_CAN2_RRPressIndi, Init_CAN2_RRSensorFail, Init_CAN2_RRWheelDebug, Init_CAN2_RRWheelPSW, Init_CAN2_RRWheelPress, Init_CAN2_RRWheelShield, Init_CAN2_RRWheelTemp, Init_CAN2_RRWheelTmpIndi, Init_CAN2_TPMSWarnIndi, Init_CAN2_TPMS_Cali_Butt_Allow, Init_CAN2_TPMS_Res_Butt_Allow]
    Init_CAN2_SG_FD2_OTA1: value-spec=fields=[Init_CAN2_OTA_DL_Available, Init_CAN2_OTA_DL_Speed, Init_CAN2_OTA_Debug_Code, Init_CAN2_OTA_Emergency_Sta, Init_CAN2_OTA_InVehicle_FW, Init_CAN2_OTA_Lock_Req, Init_CAN2_OTA_MDA_Status, Init_CAN2_OTA_Mode, Init_CAN2_OTA_Network_Type, Init_CAN2_OTA_Permit_Agreed, Init_CAN2_OTA_Progress_Rate, Init_CAN2_OTA_Remained_Time, Init_CAN2_OTA_TBOXResetReq, Init_CAN2_OTA_Update_Available, Init_CAN2_OTA_Updating_ECU_8bit]
    Init_CAN2_SG_FD2_Version: value-spec=fields=[Init_CAN2_FUSION_HW_Ver1, Init_CAN2_FUSION_HW_Ver2, Init_CAN2_FUSION_HW_Ver3, Init_CAN2_FUSION_SW_CarModel1, Init_CAN2_FUSION_SW_CarModel2, Init_CAN2_FUSION_SW_CarModel3, Init_CAN2_FUSION_SW_Controller1, Init_CAN2_FUSION_SW_Controller2, Init_CAN2_FUSION_SW_Country1, Init_CAN2_FUSION_SW_Country2, Init_CAN2_FUSION_SW_ECUGen1, Init_CAN2_FUSION_SW_ECUGen2, Init_CAN2_FUSION_SW_Major1, Init_CAN2_FUSION_SW_Major2, Init_CAN2_FUSION_SW_Minor1, Init_CAN2_FUSION_SW_Minor2, Init_CAN2_FUSION_SW_Patch1, Init_CAN2_FUSION_SW_Patch2, Init_CAN2_FUSION_SW_SHA1, Init_CAN2_FUSION_SW_SHA2, Init_CAN2_FUSION_SW_SHA3, Init_CAN2_FUSION_SW_SHA4, Init_CAN2_FUSION_SW_SHA5, Init_CAN2_FUSION_SW_SHA6, Init_CAN2_FUSION_SW_SHA7, Init_CAN2_FUSION_SW_SHA8, Init_CAN2_FUSION_SW_Var1, Init_CAN2_FUSION_SW_Var2, Init_CAN2_FUSION_SW_Var3, Init_CAN2_FUSION_SW_Var4, Init_CAN2_FUSION_SW_Var5, Init_CAN2_FUSION_SW_change1, Init_CAN2_FUSION_SW_change2, Init_CAN2_FUSION_SW_dash1, Init_CAN2_FUSION_SW_dash2]
    Init_CAN2_SG_GW2_C10_0: value-spec=fields=[Init_CAN2_ABM_Passenger_ODS_Sta, Init_CAN2_ABM_RearPassengerCTR_ODS_Sta, Init_CAN2_ABM_RearPassengerLH_ODS_Sta, Init_CAN2_ABM_RearPassengerRH_ODS_Sta, Init_CAN2_ABS_Active, Init_CAN2_ABS_Failed, Init_CAN2_ABS_WnlmpSta, Init_CAN2_AEBAvail, Init_CAN2_AVH_Active, Init_CAN2_AVH_Failed, Init_CAN2_AirBagFailCmd, Init_CAN2_Amber_WnlmpSta, Init_CAN2_BTCS_Active, Init_CAN2_BrkDiscTempSta, Init_CAN2_BrkSw_Sta, Init_CAN2_BrkSw_V, Init_CAN2_CrashOutputSts, Init_CAN2_DCDCAuxCur, Init_CAN2_DCDCAuxVolt, Init_CAN2_DrPMMLVOutPErrLmp, Init_CAN2_DrPMMSysErrLmp, Init_CAN2_DrSCPSysErrLmp, Init_CAN2_DriverSeatBeltCmd, Init_CAN2_EBD_Failed, Init_CAN2_EBMErrSta, Init_CAN2_EBMRLampSta, Init_CAN2_ESC_ADAS_Sta, Init_CAN2_ESC_BeepReq, Init_CAN2_ESC_Failed, Init_CAN2_ESC_OFF_Status, Init_CAN2_ESC_Off_lmpSta, Init_CAN2_ESC_WnlmpSta, Init_CAN2_ESS_Active, Init_CAN2_EpasFailed, Init_CAN2_FLTurnLPErr, Init_CAN2_FLTurn_Light_Warning, Init_CAN2_FRTurnLPErr, Init_CAN2_FRTurn_Light_Warning, Init_CAN2_FireDetErr, Init_CAN2_FrPMMLimpHomeActReq, Init_CAN2_HBB_Active, Init_CAN2_HBB_Failed, Init_CAN2_HDD_Active, Init_CAN2_HDD_Failed, Init_CAN2_HSA_Active, Init_CAN2_HSA_Failed, Init_CAN2_HVBattCurr, Init_CAN2_HVBattErr, Init_CAN2_HVBattVolt, Init_CAN2_LADBErr, Init_CAN2_LADB_Hibeam_Indication, Init_CAN2_LADB_Operation_Status, Init_CAN2_LADB_Warning, Init_CAN2_LAHB_Warning, Init_CAN2_LDRL_Warning, Init_CAN2_LF_PulseCount, Init_CAN2_LF_PulseCount_V, Init_CAN2_LF_WhlRotDir, Init_CAN2_LH_BeamErr, Init_CAN2_LLB_Warning, Init_CAN2_LL_BeamErr, Init_CAN2_LR_PulseCount, Init_CAN2_LR_PulseCount_V, Init_CAN2_LR_WhlRotDir, Init_CAN2_LowBrakeFluid_Sta, Init_CAN2_Lposition_Lamp_Warning, Init_CAN2_Meter_Ind_VehSpeed, Init_CAN2_PABSwitchCmd, Init_CAN2_PBA_Active, Init_CAN2_PBA_Failed, Init_CAN2_PsngrSeatBeltCmd, Init_CAN2_RADBErr, Init_CAN2_RADB_Hibeam_Indication, Init_CAN2_RADB_Operation_Status, Init_CAN2_RADB_Warning, Init_CAN2_RAHB_Warning, Init_CAN2_RCenterSeatBeltCmd, Init_CAN2_RDRL_Warning, Init_CAN2_RDriverSeatBeltCmd, Init_CAN2_RF_PulseCount, Init_CAN2_RF_PulseCount_V, Init_CAN2_RF_WhlRotDir, Init_CAN2_RH_BeamErr, Init_CAN2_RLB_Warning, Init_CAN2_RLTurnLPErr, Init_CAN2_RL_BeamErr, Init_CAN2_RPsngrSeatBeltCmd, Init_CAN2_RRTurnLPErr, Init_CAN2_RR_PulseCount, Init_CAN2_RR_PulseCount_V, Init_CAN2_RR_WhlRotDir, Init_CAN2_Red_WnlmpSta, Init_CAN2_Rposition_Lamp_Warning, Init_CAN2_SAS_Angle, Init_CAN2_SAS_V, Init_CAN2_TCS_Failed, Init_CAN2_TLHPsngrSeatBeltCmd, Init_CAN2_TRHPsngrSeatBeltCmd, Init_CAN2_VehSpeed, Init_CAN2_eBST_AmberWnlmpSta, Init_CAN2_eBST_BeepReq, Init_CAN2_eBST_RedWnlmpSta]
    Init_CAN2_SG_GW2_CE1000_0: value-spec=fields=[Init_CAN2_ACChrgCurrDis, Init_CAN2_Charge_Percent_Set, Init_CAN2_DSEAT_HW_Ver, Init_CAN2_DSEAT_SW_Ver, Init_CAN2_Fr_MCU_HW_Ver, Init_CAN2_Fr_MCU_HW_Ver_Nidec, Init_CAN2_Fr_MCU_SW_Ver, Init_CAN2_Fr_MCU_SW_Ver_Nidec, Init_CAN2_HVBChrgPwr, Init_CAN2_HVBChrgPwrTotal, Init_CAN2_HVBDrvPwr, Init_CAN2_HVBDrvPwrTotal, Init_CAN2_HVBattSOC, Init_CAN2_HVBattSOCDis, Init_CAN2_PSEAT_HW_Ver, Init_CAN2_PSEAT_SW_Ver, Init_CAN2_PTG_HW_Ver, Init_CAN2_PTG_SW_Ver, Init_CAN2_RemainChrgTime, Init_CAN2_Rr_MCU3_HW_Ver, Init_CAN2_Rr_MCU3_HW_Ver_Nidec, Init_CAN2_Rr_MCU3_SW_Ver, Init_CAN2_Rr_MCU3_SW_Ver_Nidec, Init_CAN2_TBOX_HW_VER, Init_CAN2_TBOX_SW_VER]
    Init_CAN2_SG_GW2_CE100_0: value-spec=fields=[Init_CAN2_FDC_BCM_DimSw, Init_CAN2_FDC_BCM_FWipSw_Sta, Init_CAN2_FDC_BCM_TurnSw_Sta]
    Init_CAN2_SG_CGW_GW2_CE100_0: value-spec=fields=[Init_CAN2_COMP_ActualPwr, Init_CAN2_CbnPreACEnaReq, Init_CAN2_ChargeInletLockSta, Init_CAN2_ChrgPlugSta, Init_CAN2_DKC_KeyNum_Sta, Init_CAN2_DKC_KeyType_Sta, Init_CAN2_DisChrgPlugErr, Init_CAN2_EBMSta, Init_CAN2_ExtChrgSta, Init_CAN2_FrntPTCLeActHeatPwr, Init_CAN2_FrntPTCRearLeActHeatPwr, Init_CAN2_FrntPTCRearRiActHeatPwr, Init_CAN2_FrntPTCRiActHeatPwr, Init_CAN2_HVBChrgErr, Init_CAN2_HVBContactorSta, Init_CAN2_HVBMTempMax, Init_CAN2_HVBOvrTempErr, Init_CAN2_HVBOvrTempWarn, Init_CAN2_MainRlyNegSta, Init_CAN2_MainRlyPosSta, Init_CAN2_OBCACCSLimit, Init_CAN2_OBCACCurrInf, Init_CAN2_OBCACVoltInf, Init_CAN2_OBCFaultSta, Init_CAN2_OBC_AC_Cur_Lim, Init_CAN2_P_Dkey_Show_IVI, Init_CAN2_P_KeyMiss, Init_CAN2_P_UID_LowPower, Init_CAN2_RLS_Lamp_Sta, Init_CAN2_Re_Radio, Init_CAN2_SWC_ACC_Sta, Init_CAN2_SWC_Down_Sta, Init_CAN2_SWC_LKA_Sta, Init_CAN2_SWC_Left_Sta, Init_CAN2_SWC_RegenDown, Init_CAN2_SWC_RegenUp, Init_CAN2_SWC_Right_Sta, Init_CAN2_SWC_Trip_Sta, Init_CAN2_SWC_Undefined_Sta, Init_CAN2_SWC_Up_Sta, Init_CAN2_SWC_VR_Sta, Init_CAN2_SWC_mode_Sta, Init_CAN2_Shifter_Fail_sta, Init_CAN2_Shifter_Handle_Cmd, Init_CAN2_TBOX_NET_SIG_STR, Init_CAN2_TBOX_TEST_STATUS, Init_CAN2_TrailerCheck, Init_CAN2_TrailerModeSta, Init_CAN2_V2LSta, Init_CAN2_ZFR_BCM_ChargerDoorSW_Sta, Init_CAN2_ZFR_EChrg_Active_Sta, Init_CAN2_ZFR_EChrg_OperationDeny_Cmd, Init_CAN2_ZFR_EChrg_Sys_Sta, Init_CAN2_ZFR_EChrg_WashMode_Sta]
    Init_CAN2_SG_GW2_CE100_1: value-spec=fields=[Init_CAN2_FDC_BCM_WinLFOpened_Sta, Init_CAN2_FDC_BCM_WinLROpened_Sta, Init_CAN2_FDC_BCM_WinRFOpened_Sta, Init_CAN2_FDC_BCM_WinRROpened_Sta]
    Init_CAN2_SG_CGW_GW2_CE100_1: value-spec=fields=[Init_CAN2_BD_DSEAT_Anti_Sta, Init_CAN2_BD_DSEAT_EntryFun_Sta, Init_CAN2_BD_DSEAT_Error_Sta, Init_CAN2_BD_DSEAT_MemSet_Sta, Init_CAN2_BD_DSEAT_Mode_Sta, Init_CAN2_BD_DSEAT_StopKeepMove_Sta, Init_CAN2_BD_DSEAT_Vent_Sta, Init_CAN2_BD_DSEAT_heater_Sta, Init_CAN2_BD_Door_FHandleClose_Sta, Init_CAN2_BD_Door_RHandleClose_Sta, Init_CAN2_BP_Door_FHandleClose_Sta, Init_CAN2_BP_Door_RHandleClose_Sta, Init_CAN2_BP_PSEAT_Error_Sta, Init_CAN2_BP_PSEAT_Mode_Sta, Init_CAN2_BP_PSEAT_Vent_Sta, Init_CAN2_BP_PSEAT_heater_Sta, Init_CAN2_BP_PTG_Active_Sta, Init_CAN2_BP_PTG_Exist_Sta, Init_CAN2_BP_PTG_IsSetHeight_Sta, Init_CAN2_BP_PTG_Sys_Sta, Init_CAN2_BP_SEAT_LVent_Sta, Init_CAN2_BP_SEAT_MLVent_Sta, Init_CAN2_BP_SEAT_MRVent_Sta, Init_CAN2_BP_SEAT_RVent_Sta, Init_CAN2_Fr_EDUDrtSta, Init_CAN2_Fr_EDURealTMTq, Init_CAN2_Fr_MCUTemp, Init_CAN2_Fr_MCUTempWarn, Init_CAN2_Fr_MotorAvailTq, Init_CAN2_Fr_TMSpd, Init_CAN2_Fr_TMTemp, Init_CAN2_Fr_TMTempWarn, Init_CAN2_MCU_B_F_LLCTempWarn_Sta, Init_CAN2_MCU_B_R_LLCTempWarn_Sta, Init_CAN2_Rr_EDUDrtSta, Init_CAN2_Rr_EDURealTMTq, Init_CAN2_Rr_MCUTemp, Init_CAN2_Rr_MCUTempWarn, Init_CAN2_Rr_MotorAvailTq, Init_CAN2_Rr_TMSpd, Init_CAN2_Rr_TMTemp, Init_CAN2_Rr_TMTempWarn, Init_CAN2_SWC2_L_DriveMode_Sta, Init_CAN2_SWC2_L_Home_Sta, Init_CAN2_SWC2_R_Customize_Sta, Init_CAN2_SWC2_R_Left_Sta, Init_CAN2_SWC2_R_PageSwitch_Sta, Init_CAN2_SWC2_R_Right_Sta, Init_CAN2_SWC2_R_ScrollDown_Sta, Init_CAN2_SWC2_R_ScrollPress_Sta, Init_CAN2_SWC2_R_ScrollUp_Sta, Init_CAN2_SWC2_R_VR_Sta]
    Init_CAN2_SG_GW2_CE100_2: value-spec=fields=[Init_CAN2_DSEAT_Anti_Sta, Init_CAN2_DSEAT_EntryFun_Sta, Init_CAN2_DSEAT_Error_Sta, Init_CAN2_DSEAT_Mode, Init_CAN2_DSEAT_Vent_Sta, Init_CAN2_DSEAT_heater_sta, Init_CAN2_FAPWL_01_LIN_Response_Error, Init_CAN2_Fr_EDUDrtSta_Nidec, Init_CAN2_Fr_EDURealTMTq_Nidec, Init_CAN2_Fr_MCUTempWarn_Nidec, Init_CAN2_Fr_MCUTemp_Nidec, Init_CAN2_Fr_MotorAvailTq_Nidec, Init_CAN2_Fr_TMSpd_Nidec, Init_CAN2_Fr_TMTempWarn_Nidec, Init_CAN2_Fr_TMTemp_Nidec, Init_CAN2_L_Drv_Motor_Relay_Error, Init_CAN2_L_Drv_Motor_Ripple_Error, Init_CAN2_L_Drv_Val_Wdw_Opened, Init_CAN2_L_Pas_Motor_Relay_Error, Init_CAN2_L_Pas_Motor_Ripple_Error, Init_CAN2_L_Pas_Val_Wdw_Opened, Init_CAN2_L_RLD_Motor_Relay_Error, Init_CAN2_L_RLD_Motor_Ripple_Error, Init_CAN2_L_RLD_Val_Wdw_Opened, Init_CAN2_L_RRD_Motor_Relay_Error, Init_CAN2_L_RRD_Motor_Ripple_Error, Init_CAN2_L_RRD_Val_Wdw_Opened, Init_CAN2_PSEAT_Error_Sta, Init_CAN2_PSEAT_Mode, Init_CAN2_PSEAT_Vent_Sta, Init_CAN2_PSEAT_heater_sta, Init_CAN2_PTG_Active_Sta, Init_CAN2_PTG_AutoStaus, Init_CAN2_PTG_Exist, Init_CAN2_PTG_Is_Set_Height, Init_CAN2_PTG_Sys_Sta, Init_CAN2_RAPWL_01_LIN_Response_Error, Init_CAN2_Rr_EDUDrtSta_Nidec, Init_CAN2_Rr_EDURealTMTq_Nidec, Init_CAN2_Rr_MCUTempWarn_Nidec, Init_CAN2_Rr_MCUTemp_Nidec, Init_CAN2_Rr_MotorAvailTq_Nidec, Init_CAN2_Rr_TMSpd_Nidec, Init_CAN2_Rr_TMTempWarn_Nidec, Init_CAN2_Rr_TMTemp_Nidec]
    Init_CAN2_SG_GW2_CE200_0: value-spec=fields=constant-reference=Init_CAN2_FDC_BCM_TimeGapLevel_Sta
    Init_CAN2_SG_CGW_GW2_CE200_0: value-spec=fields=[Init_CAN2_ACC_ObjDist, Init_CAN2_ACC_ObjDstLvl, Init_CAN2_ACC_ObjRelSpd, Init_CAN2_ACC_TakeoverReq, Init_CAN2_ADAS_ACC_Sta, Init_CAN2_ADAS_AEBReq, Init_CAN2_ADAS_AEB_Sta, Init_CAN2_ADAS_CAM_SpdLim, Init_CAN2_ADAS_FCW_Mute, Init_CAN2_ADAS_FCW_Sensitivity, Init_CAN2_ADAS_FCW_Sta, Init_CAN2_ADAS_FltWrnReq, Init_CAN2_ADAS_ISA_Sta, Init_CAN2_ADAS_LDW_Mute, Init_CAN2_ADAS_LDW_Sensitivity, Init_CAN2_ADAS_LDW_Sta, Init_CAN2_ADAS_LFC_Hands_Off_Warning, Init_CAN2_ADAS_LFC_Sta, Init_CAN2_ADAS_LFC_Warn_Sound, Init_CAN2_ADAS_LKA_Sta, Init_CAN2_ADAS_LaneModeL, Init_CAN2_ADAS_LaneModeR, Init_CAN2_ADAS_SLIF_SpdLim, Init_CAN2_ADAS_SLIF_Sta, Init_CAN2_ADAS_VehSpdLim, Init_CAN2_ADAS_WarningMsg, Init_CAN2_ActBrkLamp_Sta, Init_CAN2_CameraBlockage, Init_CAN2_ForceLowBeam, Init_CAN2_HVBFullChrgPwr, Init_CAN2_HVBPwrAvailChrg, Init_CAN2_HVBPwrAvailChrg30, Init_CAN2_HVBPwrAvailChrg60, Init_CAN2_HVBSOH, Init_CAN2_HazardWarningReq, Init_CAN2_ISA_WarningMsg, Init_CAN2_LKA_HOD_Display_Warning, Init_CAN2_LKA_HOD_Sound_Warning, Init_CAN2_LVDA_ACCStatusInformation, Init_CAN2_LVDA_Disabled, Init_CAN2_LVDA_Failinfo, Init_CAN2_LVDA_Mute_Sta, Init_CAN2_LVDA_Warning, Init_CAN2_LeftTurnLightReq, Init_CAN2_MCU_B_F_RealPwrKw_Sta, Init_CAN2_MCU_B_R_RealPwrKw_Sta, Init_CAN2_RightTurnLightReq, Init_CAN2_Target_Type]
    Init_CAN2_SG_HMI1: value-spec=fields=[Init_CAN2_HMI_ACAirIntM_Cmd, Init_CAN2_HMI_ACAirIntP_Cmd, Init_CAN2_HMI_ACAutoBtn_Cmd, Init_CAN2_HMI_ACBtn_Cmd, Init_CAN2_HMI_ACFrDefogBtn_Cmd, Init_CAN2_HMI_ACRecycleBtn_Cmd, Init_CAN2_HMI_ACWindDirM_Cmd, Init_CAN2_HMI_ACWindDirP_Cmd, Init_CAN2_HMI_AutoInterLight_Cmd, Init_CAN2_HMI_BCMPostDefogBtn_Cmd, Init_CAN2_HMI_DSEAT_LevelDown_Cmd, Init_CAN2_HMI_DSEAT_LevelUp_Cmd, Init_CAN2_HMI_Function1_LevelDown_Cmd, Init_CAN2_HMI_Function1_LevelUp_Cmd, Init_CAN2_HMI_Function2_LevelDown_Cmd, Init_CAN2_HMI_Function2_LevelUp_Cmd, Init_CAN2_HMI_Function3_LevelDown_Cmd, Init_CAN2_HMI_Function3_LevelUp_Cmd, Init_CAN2_HMI_Function4_LevelDown_Cmd, Init_CAN2_HMI_Function4_LevelUp_Cmd, Init_CAN2_HMI_Function5_LevelDown_Cmd, Init_CAN2_HMI_Function5_LevelUp_Cmd, Init_CAN2_HMI_Function6_LevelDown_Cmd, Init_CAN2_HMI_Function6_LevelUp_Cmd, Init_CAN2_HMI_PSEAT_LevelDown_Cmd, Init_CAN2_HMI_PSEAT_LevelUp_Cmd, Init_CAN2_HMI_ZLSetTM_Cmd, Init_CAN2_HMI_ZLSetTP_Cmd, Init_CAN2_HMI_ZRSetTM_Cmd, Init_CAN2_HMI_ZRSetTP_Cmd]
    Init_CAN2_SG_IVI1: value-spec=fields=[Init_CAN2_A2B_Node_sta, Init_CAN2_AmbLigh_LowBatAlert_SW, Init_CAN2_AmbLigh_SafetyAlert_SW, Init_CAN2_AmbLightBrightnessSet, Init_CAN2_AmbLightColorSet, Init_CAN2_AmbLight_DimInDark_SW, Init_CAN2_AmbLight_SW, Init_CAN2_AmbLight_WlcmLight_SW, Init_CAN2_BrkAbn_GoReady_SW, Init_CAN2_FCP_FrEvt_BtnACMaxReq, Init_CAN2_FCP_FrEvt_BtnACReq, Init_CAN2_FCP_FrEvt_BtnAutoReq, Init_CAN2_FCP_FrEvt_BtnSyncReq, Init_CAN2_FCP_MidEvt_BtnAutoReq, Init_CAN2_IVI_AirRefresh_ByDMS_Sta, Init_CAN2_IVI_AutoTheme_But_Sta, Init_CAN2_IVI_AutoWipHSpdSW_Cmd, Init_CAN2_IVI_CLWin_LockDoorSW_Sta, Init_CAN2_IVI_CreateAccReq_Sta, Init_CAN2_IVI_DMS_SW_Sta, Init_CAN2_IVI_DSEAT_StopKeepMove_Sta, Init_CAN2_IVI_DSEAT_anti_set_Sta, Init_CAN2_IVI_DSEAT_entryfun_set_Sta, Init_CAN2_IVI_DelAccReq_Sta, Init_CAN2_IVI_Driving_Lock_SW_Sta, Init_CAN2_IVI_EPS_Force_Cmd, Init_CAN2_IVI_FrTrunk_UnlockReq_Sta, Init_CAN2_IVI_HMI_Undefined_Sta, Init_CAN2_IVI_LinkAccReq_Sta, Init_CAN2_IVI_LinkAcc_Sta, Init_CAN2_IVI_LinkKey_Sta, Init_CAN2_IVI_Located_STA, Init_CAN2_IVI_Lock_SoundSW_Sta, Init_CAN2_IVI_MirrorFolded_SW_Sta, Init_CAN2_IVI_NAVI_Foreground_Sta, Init_CAN2_IVI_OTA_Upd_Sta, Init_CAN2_IVI_QuickRefresh_Sta, Init_CAN2_IVI_SWC_VibMode_Sta, Init_CAN2_IVI_SilentChrg_Alert_Sta, Init_CAN2_IVI_Stopping_Unlock_SW_Sta, Init_CAN2_IVI_Theme_Sta, Init_CAN2_IVI_Time_Check, Init_CAN2_IVI_Time_Day, Init_CAN2_IVI_Time_Hour, Init_CAN2_IVI_Time_Minute, Init_CAN2_IVI_Time_Month, Init_CAN2_IVI_Time_Second, Init_CAN2_IVI_Time_Year, Init_CAN2_IVI_WPTC_SW_Sta, Init_CAN2_IVI_WirelessCharge_Cmd, Init_CAN2_IVI_sigScreenReq_Sta, Init_CAN2_LINKtoDrive, Init_CAN2_OTA_CancelDL_Req, Init_CAN2_OTA_CompNTFY_Pres, Init_CAN2_OTA_DL_Req, Init_CAN2_OTA_SuspendDL_Req, Init_CAN2_OTA_UpdStart_Req, Init_CAN2_OpenDrOpenWdo_SW, Init_CAN2_PW_CLOSE_IMD, Init_CAN2_PW_CONTINUE_USE, Init_CAN2_Re_Radio_Sta, Init_CAN2_Sched_Chg_Day_Set, Init_CAN2_Sched_Chg_End_Time_HR, Init_CAN2_Sched_Chg_End_Time_Min, Init_CAN2_Sched_Chg_St_Time_HR, Init_CAN2_Sched_Chg_St_Time_Min, Init_CAN2_Sched_OTA_wake, Init_CAN2_SmartEco_Mode_SW, Init_CAN2_Upd_Countdown_Cancel, Init_CAN2_Upd_Countdown_Skip, Init_CAN2_UserSet, Init_CAN2_VehACModReq, Init_CAN2_mFRD_link_Sta]
    Init_CAN2_SG_IVI2: value-spec=fields=[Init_CAN2_AC_Chg_Cur_Set, Init_CAN2_AEB_BUTT, Init_CAN2_AVM_Err_STA, Init_CAN2_AVM_OFF_Rec_Butt, Init_CAN2_AVM_Parking_mode, Init_CAN2_AVM_parking_cancel, Init_CAN2_AVM_parking_excute, Init_CAN2_Approach_Unlock_SW, Init_CAN2_BSDMute_BUTT, Init_CAN2_CAAS_Sw, Init_CAN2_CDL_Lock_Butt, Init_CAN2_CDL_Unlock_Butt, Init_CAN2_CameraWrn, Init_CAN2_DMS_Status, Init_CAN2_DMS_Warning_Distraction, Init_CAN2_DMS_Warning_Fatigue, Init_CAN2_DMS_Warning_Unresponsive, Init_CAN2_DSEAT_anti_set, Init_CAN2_DSEAT_entryfun_set, Init_CAN2_DSEAT_vent_req, Init_CAN2_Distance_unit, Init_CAN2_ESC_SW_Cmd, Init_CAN2_FCWMute_BUTT, Init_CAN2_FFogLampSW, Init_CAN2_FS_Off_Sw, Init_CAN2_FalseNPrevent_SW, Init_CAN2_FollowMeSW, Init_CAN2_GPS_LAT, Init_CAN2_GPS_LONG, Init_CAN2_HeadLampSW, Init_CAN2_Hood_Latch_SW, Init_CAN2_IVI_ACC_Adaptive_Sta, Init_CAN2_IVI_AGSCloseSW, Init_CAN2_IVI_ActvDmpDisabSW, Init_CAN2_IVI_AirIntZ3_Cmd, Init_CAN2_IVI_Backlight_Sta, Init_CAN2_IVI_CarWash_Mode_Cmd, Init_CAN2_IVI_CfmTo_Rdy, Init_CAN2_IVI_ChargePortSW_Sta, Init_CAN2_IVI_CoastDwSW, Init_CAN2_IVI_CreepSW_Req, Init_CAN2_IVI_DMS_Faceblocked_Sta, Init_CAN2_IVI_DMS_NoDriverDetected_Sta, Init_CAN2_IVI_DSEATHeater_Cmd, Init_CAN2_IVI_DSEAT_FroEdge_Height_Cmd, Init_CAN2_IVI_DSEAT_Height_Cmd, Init_CAN2_IVI_DSEAT_Memory1_Sta, Init_CAN2_IVI_DSEAT_Memory2_Sta, Init_CAN2_IVI_DSEAT_Memory_OPTCLS_Sta, Init_CAN2_IVI_DSEAT_Recline_Cmd, Init_CAN2_IVI_DSEAT_Slide_Cmd, Init_CAN2_IVI_FGSAirInt_Cmd, Init_CAN2_IVI_FGSCh_Cmd, Init_CAN2_IVI_FWipIntTSet_Cmd, Init_CAN2_IVI_GPS_Lat_Dir_Sta, Init_CAN2_IVI_GPS_Long_Dir_Sta, Init_CAN2_IVI_IC_Brightness_Sta, Init_CAN2_IVI_IONSW_Cmd, Init_CAN2_IVI_ISA_OffsetSpd, Init_CAN2_IVI_LVChrgFuncSW, Init_CAN2_IVI_Mute_Sta, Init_CAN2_IVI_Night_Mode_Sta, Init_CAN2_IVI_Off_Road_Mode_Sta, Init_CAN2_IVI_PSEATHeater_Cmd, Init_CAN2_IVI_PSEAT_Recline_Cmd, Init_CAN2_IVI_PSEAT_Slide_Cmd, Init_CAN2_IVI_PTG_Mode_SW, Init_CAN2_IVI_PTG_Open_Height, Init_CAN2_IVI_PTG_Sta_SW, Init_CAN2_IVI_PTG_USSta_SW, Init_CAN2_IVI_PW_Mode_Req, Init_CAN2_IVI_Panel_Act, Init_CAN2_IVI_Panel_X_Coor, Init_CAN2_IVI_Panel_Y_Coor, Init_CAN2_IVI_PwrLockSW, Init_CAN2_IVI_Pwroff_req, Init_CAN2_IVI_RR_Def_Req, Init_CAN2_IVI_Req_V2L, Init_CAN2_IVI_SLIF_Warning_Sta, Init_CAN2_IVI_SWC_ACCMode_Sta, Init_CAN2_IVI_SWC_LUndefined_Sta, Init_CAN2_IVI_SWC_RUndefined_Sta, Init_CAN2_IVI_Screen, Init_CAN2_IVI_SetTempZon1_Sta, Init_CAN2_IVI_SetTempZon2_Sta, Init_CAN2_IVI_Start_Chg_req, Init_CAN2_IVI_Status, Init_CAN2_IVI_Stop_Chg_req, Init_CAN2_IVI_TrailerCheckReq_Sta, Init_CAN2_IVI_TrailerModeSW_Sta, Init_CAN2_IVI_Trigger_req, Init_CAN2_IVI_Unlock_Chg_req, Init_CAN2_IVI_WI_MAIN_SW, Init_CAN2_LDWMute_BUTT, Init_CAN2_LKA_BUTT, Init_CAN2_LVDAMute_BUTT, Init_CAN2_L_Drv_ControlCommand, Init_CAN2_L_Pas_ControlCommand, Init_CAN2_L_RLD_ControlCommand, Init_CAN2_L_RRD_ControlCommand, Init_CAN2_Light_ShowStart_Req, Init_CAN2_Light_ShowStop_Req, Init_CAN2_METER_Malfunc_Sta, Init_CAN2_MFRD_N_Bright_Req, Init_CAN2_NAVI_Cam_Dist_info, Init_CAN2_NAVI_Direction_STA, Init_CAN2_NAVI_Distance_info, Init_CAN2_NAVI_ForwardLinkLevel, Init_CAN2_NAVI_LinkClass, Init_CAN2_NAVI_RoadClass, Init_CAN2_NAVI_SpeedLimit, Init_CAN2_NAVI_Speed_Limit_A, Init_CAN2_NAVI_State, Init_CAN2_NAVI_Tollgate, Init_CAN2_NAVI_Tunnel, Init_CAN2_ODAMute_BUTT, Init_CAN2_OFF_AC_MODE, Init_CAN2_PSEAT_vent_req, Init_CAN2_Perd_V2L, Init_CAN2_Pressure_unit, Init_CAN2_RCTA_BUTT, Init_CAN2_RFogLampSW, Init_CAN2_Roll_Eng_Mode, Init_CAN2_Roll_Mode_SW_Cmd, Init_CAN2_RoomLampMode, Init_CAN2_SLG_Sw, Init_CAN2_SLIF_BUTT, Init_CAN2_SOC_ADJ_BUTT, Init_CAN2_SOC_Limit_Set, Init_CAN2_SOC_V2LLimit, Init_CAN2_Sched_Chg_Start, Init_CAN2_Sched_Chg_Stop, Init_CAN2_Sched_Chg_butt, Init_CAN2_Sched_Chg_limit, Init_CAN2_Sched_Chg_wake, Init_CAN2_SenstivityPosition, Init_CAN2_SetUnlockSingle, Init_CAN2_TCS_SW_Cmd, Init_CAN2_TPMS_Cali_Butt, Init_CAN2_TPMS_Res_Butt, Init_CAN2_Temperature_unit, Init_CAN2_Time_system, Init_CAN2_TurnSwTimeSet, Init_CAN2_User_p_download, Init_CAN2_User_p_upload, Init_CAN2_Walkaway_Lock_SW, Init_CAN2_Wifi_Reset, Init_CAN2_Wifi_Sta_IVI_TBOX, Init_CAN2_WlcmLight_Mode, Init_CAN2_sigAirIntenZon1Req, Init_CAN2_sigAirIntenZon3Req, Init_CAN2_sigDfrstReq, Init_CAN2_sigFaceReq, Init_CAN2_sigFootReq, Init_CAN2_sigHvacFrontReq, Init_CAN2_sigHvacRearReq, Init_CAN2_sigHvacReq, Init_CAN2_sigRecircReq, Init_CAN2_sigSetTempZon1Req, Init_CAN2_sigSetTempZon2Req, Init_CAN2_sigSetTempZon3Req, Init_CAN2_sigWindDirZon3Req]
    Init_CAN2_SG_IVI3: value-spec=fields=[Init_CAN2_IVI_CLBlower_Y_Sta, Init_CAN2_IVI_CLBlower_Z_Sta, Init_CAN2_IVI_CRBlower_Y_Sta, Init_CAN2_IVI_CRBlower_Z_Sta, Init_CAN2_IVI_HMI_CustmiFun_Sta, Init_CAN2_IVI_HMI_CustmiKEY_Sta, Init_CAN2_IVI_LBlower_Mode_Sta, Init_CAN2_IVI_LBlower_Y_Sta, Init_CAN2_IVI_LBlower_Z_Sta, Init_CAN2_IVI_LSEATvent_Cmd, Init_CAN2_IVI_LeftPSDOpenClose_Cmd, Init_CAN2_IVI_MLFMost_Cmd, Init_CAN2_IVI_MLFootLift_Cmd, Init_CAN2_IVI_MLNapMode_Cmd, Init_CAN2_IVI_MLRecliner_Cmd, Init_CAN2_IVI_MLRestore_Cmd, Init_CAN2_IVI_MLSEATvent_Cmd, Init_CAN2_IVI_MLSeatLift_Cmd, Init_CAN2_IVI_MLSldRestore_Cmd, Init_CAN2_IVI_MLSlider_Cmd, Init_CAN2_IVI_MLZeroGravity_Cmd, Init_CAN2_IVI_MRFMost_Cmd, Init_CAN2_IVI_MRFootLift_Cmd, Init_CAN2_IVI_MRNapMode_Cmd, Init_CAN2_IVI_MRRecliner_Cmd, Init_CAN2_IVI_MRRestore_Cmd, Init_CAN2_IVI_MRSEATvent_Cmd, Init_CAN2_IVI_MRSeatLift_Cmd, Init_CAN2_IVI_MRSldRestore_Cmd, Init_CAN2_IVI_MRSlider_Cmd, Init_CAN2_IVI_MRZeroGravity_Cmd, Init_CAN2_IVI_PSDManualPower_Sta, Init_CAN2_IVI_RBlower_Mode_Sta, Init_CAN2_IVI_RBlower_Y_Sta, Init_CAN2_IVI_RBlower_Z_Sta, Init_CAN2_IVI_RSEATvent_Cmd, Init_CAN2_IVI_RightPSDOpenClose_Cmd, Init_CAN2_IVI_RollMod_atCarWash_Sta, Init_CAN2_IVI_SOS_Call_Sta, Init_CAN2_IVI_SnowMode_Cmd, Init_CAN2_IVI_UserTakeOver_APS_Sta, Init_CAN2_IVI_XWDMode_Cmd, Init_CAN2_IVI_Zon1WindDirSWReq_Sta]
    Init_CAN2_SG_METER1: value-spec=fields=[Init_CAN2_APCforDTE, Init_CAN2_AVGPwrConsumption, Init_CAN2_AvailableTrip, Init_CAN2_Averaged_vehspeed, Init_CAN2_Charge, Init_CAN2_LEDlitWarnReq, Init_CAN2_METER_KPH_Calcu, Init_CAN2_METER_KPH_Real, Init_CAN2_METER_MPH_Calcu, Init_CAN2_METER_MPH_Real, Init_CAN2_ODOMETER, Init_CAN2_ParkBrake, Init_CAN2_Spd_Crl_Mode, Init_CAN2_Spd_Crl_Sta, Init_CAN2_Trip_A, Init_CAN2_Trip_B]
package /CAN2/ImplementationDataTypes
  19 x impl type, all with category=STRUCTURE:
    DT_CAN2_SG_FD2_C20_0
      47 x element, all with category=TYPE_REFERENCE:
        CAN2_APS_ExitCondition: implementation-data-type=uint8
        CAN2_APS_RQ_Display: implementation-data-type=uint8
        CAN2_APS_SW_Ver: implementation-data-type=uint8
        CAN2_APS_Sta_System: implementation-data-type=uint8
        CAN2_CAAS_Sta: implementation-data-type=uint8
        CAN2_DISC_DISCTargetSpd: implementation-data-type=uint16
        CAN2_FDC_VCU_RegenLimInd_Sta: implementation-data-type=uint8
        CAN2_FDC_VCU_RegenMode_Sta: implementation-data-type=uint8
        CAN2_FDC_VCU_SimSound_Cmd: implementation-data-type=uint16
        CAN2_FDC_VCU_SmartEcoSpdLim_Sta: implementation-data-type=uint8
        CAN2_FDC_VCU_SmartEco_Sta: implementation-data-type=uint8
        CAN2_FDC_VMC_SetSpdDisp_Sta: implementation-data-type=uint8
        CAN2_FDC_VMC_SetSpd_Sta: implementation-data-type=uint8
        CAN2_FDC_VMC_SpdCtrlMode_Sta: implementation-data-type=uint8
        CAN2_FDC_VMC_SpdCtrl_Sta: implementation-data-type=uint8
        CAN2_PAS_A_FCL: implementation-data-type=uint8
        CAN2_PAS_A_FCR: implementation-data-type=uint8
        CAN2_PAS_A_FML: implementation-data-type=uint8
        CAN2_PAS_A_FMR: implementation-data-type=uint8
        CAN2_PAS_A_RCL: implementation-data-type=uint8
        CAN2_PAS_A_RCR: implementation-data-type=uint8
        CAN2_PAS_A_RML: implementation-data-type=uint8
        CAN2_PAS_A_RMR: implementation-data-type=uint8
        CAN2_PAS_Chime: implementation-data-type=uint8
        CAN2_PAS_D_FCL: implementation-data-type=uint8
        CAN2_PAS_D_FCR: implementation-data-type=uint8
        CAN2_PAS_D_FML: implementation-data-type=uint8
        CAN2_PAS_D_FMR: implementation-data-type=uint8
        CAN2_PAS_D_RCL: implementation-data-type=uint8
        CAN2_PAS_D_RCR: implementation-data-type=uint8
        CAN2_PAS_D_RML: implementation-data-type=uint8
        CAN2_PAS_D_RMR: implementation-data-type=uint8
        CAN2_PAS_SNSR_Layout: implementation-data-type=uint8
        CAN2_USS_Sta_FCL: implementation-data-type=uint8
        CAN2_USS_Sta_FCR: implementation-data-type=uint8
        CAN2_USS_Sta_FLL: implementation-data-type=uint8
        CAN2_USS_Sta_FLR: implementation-data-type=uint8
        CAN2_USS_Sta_FML: implementation-data-type=uint8
        CAN2_USS_Sta_FMR: implementation-data-type=uint8
        CAN2_USS_Sta_RCL: implementation-data-type=uint8
        CAN2_USS_Sta_RCR: implementation-data-type=uint8
        CAN2_USS_Sta_RLL: implementation-data-type=uint8
        CAN2_USS_Sta_RLR: implementation-data-type=uint8
        CAN2_USS_Sta_RML: implementation-data-type=uint8
        CAN2_USS_Sta_RMR: implementation-data-type=uint8
        CAN2_VMC_VCU_CC_Crl_Sta: implementation-data-type=uint8
        CAN2_VMC_VCU_MSA_Crl_Sta: implementation-data-type=uint8
    DT_CAN2_SG_FD2_CE100_0
      150 x element, all with category=TYPE_REFERENCE:
        CAN2_APMDoorControlSta: implementation-data-type=uint8
        CAN2_ActAPSPosn: implementation-data-type=uint8
        CAN2_AllDoorSW: implementation-data-type=uint8
        CAN2_AntitheftSta: implementation-data-type=uint8
        CAN2_BCM_DoorLock_Sta: implementation-data-type=uint8
        CAN2_BrakeLamp: implementation-data-type=uint8
        CAN2_CCMSA_SpdWar: implementation-data-type=uint8
        CAN2_CCU_ACLampSts: implementation-data-type=uint8
        CAN2_CCU_ACMaxLampSts: implementation-data-type=uint8
        CAN2_CCU_AutoLampSts: implementation-data-type=uint8
        CAN2_CCU_AutoMidLampSts: implementation-data-type=uint8
        CAN2_CCU_Dispaly_Request: implementation-data-type=uint8
        CAN2_CCU_EcoSts: implementation-data-type=uint8
        CAN2_CCU_FrtOnOffLampSts: implementation-data-type=uint8
        CAN2_CCU_RrOnOffLampSts: implementation-data-type=uint8
        CAN2_CCU_SyncLampSts: implementation-data-type=uint8
        CAN2_CC_Crl_Sta: implementation-data-type=uint8
        CAN2_CoastDwModeStaChk: implementation-data-type=uint8
        CAN2_CreepSW_Sta: implementation-data-type=uint8
        CAN2_DISC_ButtSta: implementation-data-type=uint8
        CAN2_DISC_Sta: implementation-data-type=uint8
        CAN2_DemoModeStaChk: implementation-data-type=uint8
        CAN2_Dimmer: implementation-data-type=uint8
        CAN2_DimmerEN: implementation-data-type=uint8
        CAN2_DisengageP_Fail: implementation-data-type=uint8
        CAN2_DoorLockIND: implementation-data-type=uint8
        CAN2_DrDoorSW: implementation-data-type=uint8
        CAN2_Dr_SeatSta: implementation-data-type=uint8
        CAN2_DynoModeStaChk: implementation-data-type=uint8
        CAN2_EDriveSysErr_AccPedalErr: implementation-data-type=uint8
        CAN2_EDriveSysErr_MCUErr: implementation-data-type=uint8
        CAN2_EDriveSysErr_ShifterErr: implementation-data-type=uint8
        CAN2_EDriveSysErr_VCUErr: implementation-data-type=uint8
        CAN2_EVDriveMode: implementation-data-type=uint8
        CAN2_Eng_AGSCloseSta: implementation-data-type=uint8
        CAN2_Eng_ActvDmpDisabSta: implementation-data-type=uint8
        CAN2_Eng_CoastDwSta: implementation-data-type=uint8
        CAN2_Eng_PwrLockSta: implementation-data-type=uint8
        CAN2_EngageP_Fail: implementation-data-type=uint8
        CAN2_FDC_BCM_AutoWipHSpdEN_Sta: implementation-data-type=uint8
        CAN2_FDC_BCM_HMIKey{1..8}Func_Sta: implementation-data-type=uint8
        CAN2_FDC_RAPS_ErrWarn_Sta: implementation-data-type=uint8
        CAN2_FDC_THCM_CLEVentY_Sta: implementation-data-type=uint8
        CAN2_FDC_THCM_CLEVentZ_Sta: implementation-data-type=uint8
        CAN2_FDC_THCM_CLVent_Sta: implementation-data-type=uint8
        CAN2_FDC_THCM_CREVentY_Sta: implementation-data-type=uint8
        CAN2_FDC_THCM_CREVentZ_Sta: implementation-data-type=uint8
        CAN2_FDC_THCM_CRVent_Sta: implementation-data-type=uint8
        CAN2_FDC_THCM_LEVentMode_Sta: implementation-data-type=uint8
        CAN2_FDC_THCM_LEVentY_Sta: implementation-data-type=uint8
        CAN2_FDC_THCM_LEVentZ_Sta: implementation-data-type=uint8
        CAN2_FDC_THCM_LVent_Sta: implementation-data-type=uint8
        CAN2_FDC_THCM_PreWPTCHeat_Sta: implementation-data-type=uint8
        CAN2_FDC_THCM_REVentMode_Sta: implementation-data-type=uint8
        CAN2_FDC_THCM_REVentY_Sta: implementation-data-type=uint8
        CAN2_FDC_THCM_REVentZ_Sta: implementation-data-type=uint8
        CAN2_FDC_THCM_RVent_Sta: implementation-data-type=uint8
        CAN2_FDC_V2L_IVIV2LDischarg_Cmd: implementation-data-type=uint8
        CAN2_FDC_VCU_LVChrgFreq_Sta: implementation-data-type=uint8
        CAN2_FDC_VCU_LVStaDropQuick_Sta: implementation-data-type=uint8
        CAN2_FDC_VCU_LVStaTooLow_Sta: implementation-data-type=uint8
        CAN2_FDC_VCU_PwrSaveReq_Cmd: implementation-data-type=uint8
        CAN2_FDC_VCU_TrailerDisOPD_Sta: implementation-data-type=uint8
        CAN2_FD_ABS_Warning: implementation-data-type=uint8
        CAN2_FD_AGS_Cmd: implementation-data-type=uint8
        CAN2_FD_Battery_Charge_Warning: implementation-data-type=uint8
        CAN2_FD_EBMErrSta: implementation-data-type=uint8
        CAN2_FD_EDrive_System: implementation-data-type=uint8
        CAN2_FD_EPB_Error: implementation-data-type=uint8
        CAN2_FD_HV_Battery_Fault: implementation-data-type=uint8
        CAN2_FD_Park_Brake_Warning: implementation-data-type=uint8
        CAN2_FD_Power_limitation: implementation-data-type=uint8
        CAN2_FD_Steering_Warning: implementation-data-type=uint8
        CAN2_FD_TCS_Indicator: implementation-data-type=uint8
        CAN2_FD_Telltale_Fail: implementation-data-type=uint8
        CAN2_FalseNPrevent_Sta: implementation-data-type=uint8
        CAN2_FeatSetSpdFinal_raw32: implementation-data-type=uint8
        CAN2_FollowMe: implementation-data-type=uint8
        CAN2_Fr_FogLamp: implementation-data-type=uint8
        CAN2_HVRlyOpFail: implementation-data-type=uint8
        CAN2_HVSysErr_IsolationErr: implementation-data-type=uint8
        CAN2_HVSysErr_PackErr: implementation-data-type=uint8
        CAN2_HVSysErr_RelayErr: implementation-data-type=uint8
        CAN2_H_Beam: implementation-data-type=uint8
        CAN2_HazardSW: implementation-data-type=uint8
        CAN2_HoodSW: implementation-data-type=uint8
        CAN2_LBSD: implementation-data-type=uint8
        CAN2_LDRL: implementation-data-type=uint8
        CAN2_LTurnLP: implementation-data-type=uint8
        CAN2_LVChrgFuncStaChk: implementation-data-type=uint8
        CAN2_LVSilentChrgReq: implementation-data-type=uint8
        CAN2_LVSilentChrgSta: implementation-data-type=uint8
        CAN2_LVSysErr_PwrOutpErr: implementation-data-type=uint8
        CAN2_L_Beam: implementation-data-type=uint8
        CAN2_LimphomeAct: implementation-data-type=uint8
        CAN2_LockSetting: implementation-data-type=uint8
        CAN2_MCUActDisFail: implementation-data-type=uint8
        CAN2_MSA_Crl_Sta: implementation-data-type=uint8
        CAN2_MeterIndSpeed_raw32: implementation-data-type=uint8
        CAN2_PAS_Sta_F_Sys: implementation-data-type=uint8
        CAN2_PosLamp: implementation-data-type=uint8
        CAN2_PsDoorSW: implementation-data-type=uint8
        CAN2_PwrSta: implementation-data-type=uint8
        CAN2_PwrStaErr: implementation-data-type=uint8
        CAN2_PwrStaONTOIVIPopReq: implementation-data-type=uint8
        CAN2_PwrStaONTOIVIPopT: implementation-data-type=uint16
        CAN2_RBSD: implementation-data-type=uint8
        CAN2_RDRL: implementation-data-type=uint8
        CAN2_RLDoorSW: implementation-data-type=uint8
        CAN2_RRDoorSW: implementation-data-type=uint8
        CAN2_RTurnLP: implementation-data-type=uint8
        CAN2_Req_Internal_V2L_Status_Lamp: implementation-data-type=uint8
        CAN2_Req_V2LSwOn: implementation-data-type=uint8
        CAN2_Req_V2L_IVI_Popup: implementation-data-type=uint8
        CAN2_ReverseLamp: implementation-data-type=uint8
        CAN2_Rr_Defog: implementation-data-type=uint8
        CAN2_Rr_FogLamp: implementation-data-type=uint8
        CAN2_ShiftGearPosn: implementation-data-type=uint8
        CAN2_SysAllowReadySta: implementation-data-type=uint8
        CAN2_SysPwrSta: implementation-data-type=uint8
        CAN2_Tailgate_SW: implementation-data-type=uint8
        CAN2_VCUBrkSWSta: implementation-data-type=uint8
        CAN2_VCUFLDoorSta: implementation-data-type=uint8
        CAN2_VCUFRDoorSta: implementation-data-type=uint8
        CAN2_VCUHoodSWSta: implementation-data-type=uint8
        CAN2_VCURLDoorSta: implementation-data-type=uint8
        CAN2_VCURRDoorSta: implementation-data-type=uint8
        CAN2_VCUTailgateSWSta: implementation-data-type=uint8
        CAN2_VCU_OPDHold: implementation-data-type=uint8
        CAN2_VehMalfunLevel: implementation-data-type=uint8
        CAN2_XWDMode: implementation-data-type=uint8
        CAN2_sigAirIntenZon1St: implementation-data-type=uint8
        CAN2_sigAirIntenZon3St: implementation-data-type=uint8
        CAN2_sigAmbAirT: implementation-data-type=uint8
        CAN2_sigCbnAirT: implementation-data-type=uint8
        CAN2_sigDfrstSt: implementation-data-type=uint8
        CAN2_sigHvacSt: implementation-data-type=uint8
        CAN2_sigRecircSt: implementation-data-type=uint8
        CAN2_sigSetTempZon{1..3}St: implementation-data-type=uint8
        CAN2_sigWindDirZon1St: implementation-data-type=uint8
        CAN2_sigWindDirZon3St: implementation-data-type=uint8
    DT_CAN2_SG_FD2_CE200_1
      89 x element, all with category=TYPE_REFERENCE, implementation-data-type=uint8:
        CAN2_AutoLTips
        CAN2_CWheelTips
        CAN2_FDC_BCM_Acc{1..5}Sta_Sta
        CAN2_FDC_BCM_AmbBrightSta_Sta
        CAN2_FDC_BCM_AmbColorSta_Sta
        CAN2_FDC_BCM_AmbDimEN_Sta
        CAN2_FDC_BCM_AmbFunEN_Sta
        CAN2_FDC_BCM_AmbLinkDriSta_Sta
        CAN2_FDC_BCM_AmbODAEN_Sta
        CAN2_FDC_BCM_AmbPwrWarnEN_Sta
        CAN2_FDC_BCM_AmbWelEN_Sta
        CAN2_FDC_BCM_AutoLock_Sta
        CAN2_FDC_BCM_AutoUnlock_Sta
        CAN2_FDC_BCM_CLWinLockDr_Sta
        CAN2_FDC_BCM_DSEATentryfset_Sta
        CAN2_FDC_BCM_FollowMeENFun_Sta
        CAN2_FDC_BCM_HBeamADB_Cmd
        CAN2_FDC_BCM_Key10Acc_Sta
        CAN2_FDC_BCM_Key{1..9}Acc_Sta
        CAN2_FDC_BCM_LockAlarm_Cmd
        CAN2_FDC_BCM_PTGOpenHeight_Sta
        CAN2_FDC_BCM_RmLpModeENFun_Sta
        CAN2_FDC_BCM_TurnSwTSetSta_Sta
        CAN2_FDC_BCM_UserNow_Sta
        CAN2_FDC_BCM_WalkInUnLkEnFun_Sta
        CAN2_FDC_BCM_WalkOutLkEnFun_Sta
        CAN2_FDC_DKC_DkeyShowIVI_Sta
        CAN2_FDC_DKC_KeyMiss_Sta
        CAN2_FDC_DKC_KeyNum_Sta
        CAN2_FDC_DKC_KeyType_Sta
        CAN2_FDC_DKC_UIDLowPower_Sta
        CAN2_FDC_FGS_AirInt_Sta
        CAN2_FDC_FGS_FGSCh_Sta
        CAN2_FDC_FGS_IONSW_Sta
        CAN2_FDC_SPTG_SPTGENFun_Sta
        CAN2_FDC_THCM_APTCForceOFF_Sta
        CAN2_FDC_THCM_APTCWarning_Sta
        CAN2_FDC_THCM_AirIntZ3_Sta
        CAN2_LFBatWarn
        CAN2_LFPressIndi
        CAN2_LFSensorFail
        CAN2_LFWheelDebug
        CAN2_LFWheelPSW
        CAN2_LFWheelPress
        CAN2_LFWheelShield
        CAN2_LFWheelTemp
        CAN2_LFWheelTmpIndi
        CAN2_LRBatWarn
        CAN2_LRPressIndi
        CAN2_LRSensorFail
        CAN2_LRWheelDebug
        CAN2_LRWheelPSW
        CAN2_LRWheelPress
        CAN2_LRWheelShield
        CAN2_LRWheelTemp
        CAN2_LRWheelTmpIndi
        CAN2_RFBatWarn
        CAN2_RFPressIndi
        CAN2_RFSensorFail
        CAN2_RFWheelDebug
        CAN2_RFWheelPSW
        CAN2_RFWheelPress
        CAN2_RFWheelShield
        CAN2_RFWheelTemp
        CAN2_RFWheelTmpIndi
        CAN2_RRBatWarn
        CAN2_RRPressIndi
        CAN2_RRSensorFail
        CAN2_RRWheelDebug
        CAN2_RRWheelPSW
        CAN2_RRWheelPress
        CAN2_RRWheelShield
        CAN2_RRWheelTemp
        CAN2_RRWheelTmpIndi
        CAN2_TPMSWarnIndi
        CAN2_TPMS_Cali_Butt_Allow
        CAN2_TPMS_Res_Butt_Allow
    DT_CAN2_SG_FD2_OTA1
      15 x element, all with category=TYPE_REFERENCE:
        CAN2_OTA_DL_Available: implementation-data-type=uint8
        CAN2_OTA_DL_Speed: implementation-data-type=uint32
        CAN2_OTA_Debug_Code: implementation-data-type=uint8
        CAN2_OTA_Emergency_Sta: implementation-data-type=uint8
        CAN2_OTA_InVehicle_FW: implementation-data-type=uint8
        CAN2_OTA_Lock_Req: implementation-data-type=uint8
        CAN2_OTA_MDA_Status: implementation-data-type=uint8
        CAN2_OTA_Mode: implementation-data-type=uint8
        CAN2_OTA_Network_Type: implementation-data-type=uint8
        CAN2_OTA_Permit_Agreed: implementation-data-type=uint8
        CAN2_OTA_Progress_Rate: implementation-data-type=uint8
        CAN2_OTA_Remained_Time: implementation-data-type=uint16
        CAN2_OTA_TBOXResetReq: implementation-data-type=uint8
        CAN2_OTA_Update_Available: implementation-data-type=uint8
        CAN2_OTA_Updating_ECU_8bit: implementation-data-type=uint8
    DT_CAN2_SG_FD2_Version
      35 x element, all with category=TYPE_REFERENCE, implementation-data-type=uint8:
        CAN2_FUSION_HW_Ver{1..3}
        CAN2_FUSION_SW_CarModel{1..3}
        CAN2_FUSION_SW_Controller1
        CAN2_FUSION_SW_Controller2
        CAN2_FUSION_SW_Country1
        CAN2_FUSION_SW_Country2
        CAN2_FUSION_SW_ECUGen1
        CAN2_FUSION_SW_ECUGen2
        CAN2_FUSION_SW_Major1
        CAN2_FUSION_SW_Major2
        CAN2_FUSION_SW_Minor1
        CAN2_FUSION_SW_Minor2
        CAN2_FUSION_SW_Patch1
        CAN2_FUSION_SW_Patch2
        CAN2_FUSION_SW_SHA{1..8}
        CAN2_FUSION_SW_Var{1..5}
        CAN2_FUSION_SW_change1
        CAN2_FUSION_SW_change2
        CAN2_FUSION_SW_dash1
        CAN2_FUSION_SW_dash2
    DT_CAN2_SG_GW2_C10_0
      102 x element, all with category=TYPE_REFERENCE:
        CAN2_ABM_Passenger_ODS_Sta: implementation-data-type=uint8
        CAN2_ABM_RearPassengerCTR_ODS_Sta: implementation-data-type=uint8
        CAN2_ABM_RearPassengerLH_ODS_Sta: implementation-data-type=uint8
        CAN2_ABM_RearPassengerRH_ODS_Sta: implementation-data-type=uint8
        CAN2_ABS_Active: implementation-data-type=uint8
        CAN2_ABS_Failed: implementation-data-type=uint8
        CAN2_ABS_WnlmpSta: implementation-data-type=uint8
        CAN2_AEBAvail: implementation-data-type=uint8
        CAN2_AVH_Active: implementation-data-type=uint8
        CAN2_AVH_Failed: implementation-data-type=uint8
        CAN2_AirBagFailCmd: implementation-data-type=uint8
        CAN2_Amber_WnlmpSta: implementation-data-type=uint8
        CAN2_BTCS_Active: implementation-data-type=uint8
        CAN2_BrkDiscTempSta: implementation-data-type=uint8
        CAN2_BrkSw_Sta: implementation-data-type=uint8
        CAN2_BrkSw_V: implementation-data-type=uint8
        CAN2_CrashOutputSts: implementation-data-type=uint8
        CAN2_DCDCAuxCur: implementation-data-type=uint16
        CAN2_DCDCAuxVolt: implementation-data-type=uint8
        CAN2_DrPMMLVOutPErrLmp: implementation-data-type=uint8
        CAN2_DrPMMSysErrLmp: implementation-data-type=uint8
        CAN2_DrSCPSysErrLmp: implementation-data-type=uint8
        CAN2_DriverSeatBeltCmd: implementation-data-type=uint8
        CAN2_EBD_Failed: implementation-data-type=uint8
        CAN2_EBMErrSta: implementation-data-type=uint8
        CAN2_EBMRLampSta: implementation-data-type=uint8
        CAN2_ESC_ADAS_Sta: implementation-data-type=uint8
        CAN2_ESC_BeepReq: implementation-data-type=uint8
        CAN2_ESC_Failed: implementation-data-type=uint8
        CAN2_ESC_OFF_Status: implementation-data-type=uint8
        CAN2_ESC_Off_lmpSta: implementation-data-type=uint8
        CAN2_ESC_WnlmpSta: implementation-data-type=uint8
        CAN2_ESS_Active: implementation-data-type=uint8
        CAN2_EpasFailed: implementation-data-type=uint8
        CAN2_FLTurnLPErr: implementation-data-type=uint8
        CAN2_FLTurn_Light_Warning: implementation-data-type=uint8
        CAN2_FRTurnLPErr: implementation-data-type=uint8
        CAN2_FRTurn_Light_Warning: implementation-data-type=uint8
        CAN2_FireDetErr: implementation-data-type=uint8
        CAN2_FrPMMLimpHomeActReq: implementation-data-type=uint8
        CAN2_HBB_Active: implementation-data-type=uint8
        CAN2_HBB_Failed: implementation-data-type=uint8
        CAN2_HDD_Active: implementation-data-type=uint8
        CAN2_HDD_Failed: implementation-data-type=uint8
        CAN2_HSA_Active: implementation-data-type=uint8
        CAN2_HSA_Failed: implementation-data-type=uint8
        CAN2_HVBattCurr: implementation-data-type=uint16
        CAN2_HVBattErr: implementation-data-type=uint8
        CAN2_HVBattVolt: implementation-data-type=uint16
        CAN2_LADBErr: implementation-data-type=uint8
        CAN2_LADB_Hibeam_Indication: implementation-data-type=uint8
        CAN2_LADB_Operation_Status: implementation-data-type=uint8
        CAN2_LADB_Warning: implementation-data-type=uint8
        CAN2_LAHB_Warning: implementation-data-type=uint8
        CAN2_LDRL_Warning: implementation-data-type=uint8
        CAN2_LF_PulseCount: implementation-data-type=uint8
        CAN2_LF_PulseCount_V: implementation-data-type=uint8
        CAN2_LF_WhlRotDir: implementation-data-type=uint8
        CAN2_LH_BeamErr: implementation-data-type=uint8
        CAN2_LLB_Warning: implementation-data-type=uint8
        CAN2_LL_BeamErr: implementation-data-type=uint8
        CAN2_LR_PulseCount: implementation-data-type=uint8
        CAN2_LR_PulseCount_V: implementation-data-type=uint8
        CAN2_LR_WhlRotDir: implementation-data-type=uint8
        CAN2_LowBrakeFluid_Sta: implementation-data-type=uint8
        CAN2_Lposition_Lamp_Warning: implementation-data-type=uint8
        CAN2_Meter_Ind_VehSpeed: implementation-data-type=uint16
        CAN2_PABSwitchCmd: implementation-data-type=uint8
        CAN2_PBA_Active: implementation-data-type=uint8
        CAN2_PBA_Failed: implementation-data-type=uint8
        CAN2_PsngrSeatBeltCmd: implementation-data-type=uint8
        CAN2_RADBErr: implementation-data-type=uint8
        CAN2_RADB_Hibeam_Indication: implementation-data-type=uint8
        CAN2_RADB_Operation_Status: implementation-data-type=uint8
        CAN2_RADB_Warning: implementation-data-type=uint8
        CAN2_RAHB_Warning: implementation-data-type=uint8
        CAN2_RCenterSeatBeltCmd: implementation-data-type=uint8
        CAN2_RDRL_Warning: implementation-data-type=uint8
        CAN2_RDriverSeatBeltCmd: implementation-data-type=uint8
        CAN2_RF_PulseCount: implementation-data-type=uint8
        CAN2_RF_PulseCount_V: implementation-data-type=uint8
        CAN2_RF_WhlRotDir: implementation-data-type=uint8
        CAN2_RH_BeamErr: implementation-data-type=uint8
        CAN2_RLB_Warning: implementation-data-type=uint8
        CAN2_RLTurnLPErr: implementation-data-type=uint8
        CAN2_RL_BeamErr: implementation-data-type=uint8
        CAN2_RPsngrSeatBeltCmd: implementation-data-type=uint8
        CAN2_RRTurnLPErr: implementation-data-type=uint8
        CAN2_RR_PulseCount: implementation-data-type=uint8
        CAN2_RR_PulseCount_V: implementation-data-type=uint8
        CAN2_RR_WhlRotDir: implementation-data-type=uint8
        CAN2_Red_WnlmpSta: implementation-data-type=uint8
        CAN2_Rposition_Lamp_Warning: implementation-data-type=uint8
        CAN2_SAS_Angle: implementation-data-type=uint16
        CAN2_SAS_V: implementation-data-type=uint8
        CAN2_TCS_Failed: implementation-data-type=uint8
        CAN2_TLHPsngrSeatBeltCmd: implementation-data-type=uint8
        CAN2_TRHPsngrSeatBeltCmd: implementation-data-type=uint8
        CAN2_VehSpeed: implementation-data-type=uint16
        CAN2_eBST_AmberWnlmpSta: implementation-data-type=uint8
        CAN2_eBST_BeepReq: implementation-data-type=uint8
        CAN2_eBST_RedWnlmpSta: implementation-data-type=uint8
    DT_CAN2_SG_GW2_CE1000_0
      25 x element, all with category=TYPE_REFERENCE:
        CAN2_ACChrgCurrDis: implementation-data-type=uint16
        CAN2_Charge_Percent_Set: implementation-data-type=uint8
        CAN2_DSEAT_HW_Ver: implementation-data-type=uint16
        CAN2_DSEAT_SW_Ver: implementation-data-type=uint16
        CAN2_Fr_MCU_HW_Ver: implementation-data-type=uint16
        CAN2_Fr_MCU_HW_Ver_Nidec: implementation-data-type=uint16
        CAN2_Fr_MCU_SW_Ver: implementation-data-type=uint16
        CAN2_Fr_MCU_SW_Ver_Nidec: implementation-data-type=uint16
        CAN2_HVBChrgPwr: implementation-data-type=uint16
        CAN2_HVBChrgPwrTotal: implementation-data-type=uint32
        CAN2_HVBDrvPwr: implementation-data-type=uint16
        CAN2_HVBDrvPwrTotal: implementation-data-type=uint32
        CAN2_HVBattSOC: implementation-data-type=uint8
        CAN2_HVBattSOCDis: implementation-data-type=uint8
        CAN2_PSEAT_HW_Ver: implementation-data-type=uint16
        CAN2_PSEAT_SW_Ver: implementation-data-type=uint16
        CAN2_PTG_HW_Ver: implementation-data-type=uint8
        CAN2_PTG_SW_Ver: implementation-data-type=uint8
        CAN2_RemainChrgTime: implementation-data-type=uint16
        CAN2_Rr_MCU3_HW_Ver: implementation-data-type=uint16
        CAN2_Rr_MCU3_HW_Ver_Nidec: implementation-data-type=uint16
        CAN2_Rr_MCU3_SW_Ver: implementation-data-type=uint16
        CAN2_Rr_MCU3_SW_Ver_Nidec: implementation-data-type=uint16
        CAN2_TBOX_HW_VER: implementation-data-type=uint32
        CAN2_TBOX_SW_VER: implementation-data-type=uint32
    DT_CAN2_SG_GW2_CE100_0
      element CAN2_FDC_BCM_DimSw: implementation-data-type=uint8
      element CAN2_FDC_BCM_FWipSw_Sta: implementation-data-type=uint8
      element CAN2_FDC_BCM_TurnSw_Sta: implementation-data-type=uint8
    DT_CAN2_SG_CGW_GW2_CE100_0
      54 x element, all with category=TYPE_REFERENCE:
        CAN2_COMP_ActualPwr: implementation-data-type=uint16
        CAN2_CbnPreACEnaReq: implementation-data-type=uint8
        CAN2_ChargeInletLockSta: implementation-data-type=uint8
        CAN2_ChrgPlugSta: implementation-data-type=uint8
        CAN2_DKC_KeyNum_Sta: implementation-data-type=uint8
        CAN2_DKC_KeyType_Sta: implementation-data-type=uint8
        CAN2_DisChrgPlugErr: implementation-data-type=uint8
        CAN2_EBMSta: implementation-data-type=uint8
        CAN2_ExtChrgSta: implementation-data-type=uint8
        CAN2_FrntPTCLeActHeatPwr: implementation-data-type=uint8
        CAN2_FrntPTCRearLeActHeatPwr: implementation-data-type=uint8
        CAN2_FrntPTCRearRiActHeatPwr: implementation-data-type=uint8
        CAN2_FrntPTCRiActHeatPwr: implementation-data-type=uint8
        CAN2_HVBChrgErr: implementation-data-type=uint8
        CAN2_HVBContactorSta: implementation-data-type=uint8
        CAN2_HVBMTempMax: implementation-data-type=uint8
        CAN2_HVBOvrTempErr: implementation-data-type=uint8
        CAN2_HVBOvrTempWarn: implementation-data-type=uint8
        CAN2_MainRlyNegSta: implementation-data-type=uint8
        CAN2_MainRlyPosSta: implementation-data-type=uint8
        CAN2_OBCACCSLimit: implementation-data-type=uint8
        CAN2_OBCACCurrInf: implementation-data-type=uint16
        CAN2_OBCACVoltInf: implementation-data-type=uint16
        CAN2_OBCFaultSta: implementation-data-type=uint8
        CAN2_OBC_AC_Cur_Lim: implementation-data-type=uint8
        CAN2_P_Dkey_Show_IVI: implementation-data-type=uint8
        CAN2_P_KeyMiss: implementation-data-type=uint8
        CAN2_P_UID_LowPower: implementation-data-type=uint8
        CAN2_RLS_Lamp_Sta: implementation-data-type=uint8
        CAN2_Re_Radio: implementation-data-type=uint8
        CAN2_SWC_ACC_Sta: implementation-data-type=uint8
        CAN2_SWC_Down_Sta: implementation-data-type=uint8
        CAN2_SWC_LKA_Sta: implementation-data-type=uint8
        CAN2_SWC_Left_Sta: implementation-data-type=uint8
        CAN2_SWC_RegenDown: implementation-data-type=uint8
        CAN2_SWC_RegenUp: implementation-data-type=uint8
        CAN2_SWC_Right_Sta: implementation-data-type=uint8
        CAN2_SWC_Trip_Sta: implementation-data-type=uint8
        CAN2_SWC_Undefined_Sta: implementation-data-type=uint8
        CAN2_SWC_Up_Sta: implementation-data-type=uint8
        CAN2_SWC_VR_Sta: implementation-data-type=uint8
        CAN2_SWC_mode_Sta: implementation-data-type=uint8
        CAN2_Shifter_Fail_sta: implementation-data-type=uint8
        CAN2_Shifter_Handle_Cmd: implementation-data-type=uint8
        CAN2_TBOX_NET_SIG_STR: implementation-data-type=uint8
        CAN2_TBOX_TEST_STATUS: implementation-data-type=uint8
        CAN2_TrailerCheck: implementation-data-type=uint8
        CAN2_TrailerModeSta: implementation-data-type=uint8
        CAN2_V2LSta: implementation-data-type=uint8
        CAN2_ZFR_BCM_ChargerDoorSW_Sta: implementation-data-type=uint8
        CAN2_ZFR_EChrg_Active_Sta: implementation-data-type=uint8
        CAN2_ZFR_EChrg_OperationDeny_Cmd: implementation-data-type=uint8
        CAN2_ZFR_EChrg_Sys_Sta: implementation-data-type=uint8
        CAN2_ZFR_EChrg_WashMode_Sta: implementation-data-type=uint8
    DT_CAN2_SG_GW2_CE100_1
      4 x element, all with category=TYPE_REFERENCE, implementation-data-type=uint8:
        CAN2_FDC_BCM_WinLFOpened_Sta
        CAN2_FDC_BCM_WinLROpened_Sta
        CAN2_FDC_BCM_WinRFOpened_Sta
        CAN2_FDC_BCM_WinRROpened_Sta
    DT_CAN2_SG_CGW_GW2_CE100_1
      52 x element, all with category=TYPE_REFERENCE:
        CAN2_BD_DSEAT_Anti_Sta: implementation-data-type=uint8
        CAN2_BD_DSEAT_EntryFun_Sta: implementation-data-type=uint8
        CAN2_BD_DSEAT_Error_Sta: implementation-data-type=uint8
        CAN2_BD_DSEAT_MemSet_Sta: implementation-data-type=uint8
        CAN2_BD_DSEAT_Mode_Sta: implementation-data-type=uint8
        CAN2_BD_DSEAT_StopKeepMove_Sta: implementation-data-type=uint8
        CAN2_BD_DSEAT_Vent_Sta: implementation-data-type=uint8
        CAN2_BD_DSEAT_heater_Sta: implementation-data-type=uint8
        CAN2_BD_Door_FHandleClose_Sta: implementation-data-type=uint8
        CAN2_BD_Door_RHandleClose_Sta: implementation-data-type=uint8
        CAN2_BP_Door_FHandleClose_Sta: implementation-data-type=uint8
        CAN2_BP_Door_RHandleClose_Sta: implementation-data-type=uint8
        CAN2_BP_PSEAT_Error_Sta: implementation-data-type=uint8
        CAN2_BP_PSEAT_Mode_Sta: implementation-data-type=uint8
        CAN2_BP_PSEAT_Vent_Sta: implementation-data-type=uint8
        CAN2_BP_PSEAT_heater_Sta: implementation-data-type=uint8
        CAN2_BP_PTG_Active_Sta: implementation-data-type=uint8
        CAN2_BP_PTG_Exist_Sta: implementation-data-type=uint8
        CAN2_BP_PTG_IsSetHeight_Sta: implementation-data-type=uint8
        CAN2_BP_PTG_Sys_Sta: implementation-data-type=uint8
        CAN2_BP_SEAT_LVent_Sta: implementation-data-type=uint8
        CAN2_BP_SEAT_MLVent_Sta: implementation-data-type=uint8
        CAN2_BP_SEAT_MRVent_Sta: implementation-data-type=uint8
        CAN2_BP_SEAT_RVent_Sta: implementation-data-type=uint8
        CAN2_Fr_EDUDrtSta: implementation-data-type=uint8
        CAN2_Fr_EDURealTMTq: implementation-data-type=uint16
        CAN2_Fr_MCUTemp: implementation-data-type=uint16
        CAN2_Fr_MCUTempWarn: implementation-data-type=uint8
        CAN2_Fr_MotorAvailTq: implementation-data-type=uint16
        CAN2_Fr_TMSpd: implementation-data-type=uint16
        CAN2_Fr_TMTemp: implementation-data-type=uint16
        CAN2_Fr_TMTempWarn: implementation-data-type=uint8
        CAN2_MCU_B_F_LLCTempWarn_Sta: implementation-data-type=uint8
        CAN2_MCU_B_R_LLCTempWarn_Sta: implementation-data-type=uint8
        CAN2_Rr_EDUDrtSta: implementation-data-type=uint8
        CAN2_Rr_EDURealTMTq: implementation-data-type=uint16
        CAN2_Rr_MCUTemp: implementation-data-type=uint16
        CAN2_Rr_MCUTempWarn: implementation-data-type=uint8
        CAN2_Rr_MotorAvailTq: implementation-data-type=uint16
        CAN2_Rr_TMSpd: implementation-data-type=uint16
        CAN2_Rr_TMTemp: implementation-data-type=uint16
        CAN2_Rr_TMTempWarn: implementation-data-type=uint8
        CAN2_SWC2_L_DriveMode_Sta: implementation-data-type=uint8
        CAN2_SWC2_L_Home_Sta: implementation-data-type=uint8
        CAN2_SWC2_R_Customize_Sta: implementation-data-type=uint8
        CAN2_SWC2_R_Left_Sta: implementation-data-type=uint8
        CAN2_SWC2_R_PageSwitch_Sta: implementation-data-type=uint8
        CAN2_SWC2_R_Right_Sta: implementation-data-type=uint8
        CAN2_SWC2_R_ScrollDown_Sta: implementation-data-type=uint8
        CAN2_SWC2_R_ScrollPress_Sta: implementation-data-type=uint8
        CAN2_SWC2_R_ScrollUp_Sta: implementation-data-type=uint8
        CAN2_SWC2_R_VR_Sta: implementation-data-type=uint8
    DT_CAN2_SG_GW2_CE100_2
      45 x element, all with category=TYPE_REFERENCE:
        CAN2_DSEAT_Anti_Sta: implementation-data-type=uint8
        CAN2_DSEAT_EntryFun_Sta: implementation-data-type=uint8
        CAN2_DSEAT_Error_Sta: implementation-data-type=uint8
        CAN2_DSEAT_Mode: implementation-data-type=uint8
        CAN2_DSEAT_Vent_Sta: implementation-data-type=uint8
        CAN2_DSEAT_heater_sta: implementation-data-type=uint8
        CAN2_FAPWL_01_LIN_Response_Error: implementation-data-type=uint8
        CAN2_Fr_EDUDrtSta_Nidec: implementation-data-type=uint8
        CAN2_Fr_EDURealTMTq_Nidec: implementation-data-type=uint16
        CAN2_Fr_MCUTempWarn_Nidec: implementation-data-type=uint8
        CAN2_Fr_MCUTemp_Nidec: implementation-data-type=uint16
        CAN2_Fr_MotorAvailTq_Nidec: implementation-data-type=uint16
        CAN2_Fr_TMSpd_Nidec: implementation-data-type=uint16
        CAN2_Fr_TMTempWarn_Nidec: implementation-data-type=uint8
        CAN2_Fr_TMTemp_Nidec: implementation-data-type=uint16
        CAN2_L_Drv_Motor_Relay_Error: implementation-data-type=uint8
        CAN2_L_Drv_Motor_Ripple_Error: implementation-data-type=uint8
        CAN2_L_Drv_Val_Wdw_Opened: implementation-data-type=uint8
        CAN2_L_Pas_Motor_Relay_Error: implementation-data-type=uint8
        CAN2_L_Pas_Motor_Ripple_Error: implementation-data-type=uint8
        CAN2_L_Pas_Val_Wdw_Opened: implementation-data-type=uint8
        CAN2_L_RLD_Motor_Relay_Error: implementation-data-type=uint8
        CAN2_L_RLD_Motor_Ripple_Error: implementation-data-type=uint8
        CAN2_L_RLD_Val_Wdw_Opened: implementation-data-type=uint8
        CAN2_L_RRD_Motor_Relay_Error: implementation-data-type=uint8
        CAN2_L_RRD_Motor_Ripple_Error: implementation-data-type=uint8
        CAN2_L_RRD_Val_Wdw_Opened: implementation-data-type=uint8
        CAN2_PSEAT_Error_Sta: implementation-data-type=uint8
        CAN2_PSEAT_Mode: implementation-data-type=uint8
        CAN2_PSEAT_Vent_Sta: implementation-data-type=uint8
        CAN2_PSEAT_heater_sta: implementation-data-type=uint8
        CAN2_PTG_Active_Sta: implementation-data-type=uint8
        CAN2_PTG_AutoStaus: implementation-data-type=uint8
        CAN2_PTG_Exist: implementation-data-type=uint8
        CAN2_PTG_Is_Set_Height: implementation-data-type=uint8
        CAN2_PTG_Sys_Sta: implementation-data-type=uint8
        CAN2_RAPWL_01_LIN_Response_Error: implementation-data-type=uint8
        CAN2_Rr_EDUDrtSta_Nidec: implementation-data-type=uint8
        CAN2_Rr_EDURealTMTq_Nidec: implementation-data-type=uint16
        CAN2_Rr_MCUTempWarn_Nidec: implementation-data-type=uint8
        CAN2_Rr_MCUTemp_Nidec: implementation-data-type=uint16
        CAN2_Rr_MotorAvailTq_Nidec: implementation-data-type=uint16
        CAN2_Rr_TMSpd_Nidec: implementation-data-type=uint16
        CAN2_Rr_TMTempWarn_Nidec: implementation-data-type=uint8
        CAN2_Rr_TMTemp_Nidec: implementation-data-type=uint16
    DT_CAN2_SG_GW2_CE200_0
      element CAN2_FDC_BCM_TimeGapLevel_Sta: implementation-data-type=uint8
    DT_CAN2_SG_CGW_GW2_CE200_0
      48 x element, all with category=TYPE_REFERENCE:
        CAN2_ACC_ObjDist: implementation-data-type=uint16
        CAN2_ACC_ObjDstLvl: implementation-data-type=uint8
        CAN2_ACC_ObjRelSpd: implementation-data-type=uint16
        CAN2_ACC_TakeoverReq: implementation-data-type=uint8
        CAN2_ADAS_ACC_Sta: implementation-data-type=uint8
        CAN2_ADAS_AEBReq: implementation-data-type=uint8
        CAN2_ADAS_AEB_Sta: implementation-data-type=uint8
        CAN2_ADAS_CAM_SpdLim: implementation-data-type=uint8
        CAN2_ADAS_FCW_Mute: implementation-data-type=uint8
        CAN2_ADAS_FCW_Sensitivity: implementation-data-type=uint8
        CAN2_ADAS_FCW_Sta: implementation-data-type=uint8
        CAN2_ADAS_FltWrnReq: implementation-data-type=uint8
        CAN2_ADAS_ISA_Sta: implementation-data-type=uint8
        CAN2_ADAS_LDW_Mute: implementation-data-type=uint8
        CAN2_ADAS_LDW_Sensitivity: implementation-data-type=uint8
        CAN2_ADAS_LDW_Sta: implementation-data-type=uint8
        CAN2_ADAS_LFC_Hands_Off_Warning: implementation-data-type=uint8
        CAN2_ADAS_LFC_Sta: implementation-data-type=uint8
        CAN2_ADAS_LFC_Warn_Sound: implementation-data-type=uint8
        CAN2_ADAS_LKA_Sta: implementation-data-type=uint8
        CAN2_ADAS_LaneModeL: implementation-data-type=uint8
        CAN2_ADAS_LaneModeR: implementation-data-type=uint8
        CAN2_ADAS_SLIF_SpdLim: implementation-data-type=uint8
        CAN2_ADAS_SLIF_Sta: implementation-data-type=uint8
        CAN2_ADAS_VehSpdLim: implementation-data-type=uint8
        CAN2_ADAS_WarningMsg: implementation-data-type=uint8
        CAN2_ActBrkLamp_Sta: implementation-data-type=uint8
        CAN2_CameraBlockage: implementation-data-type=uint8
        CAN2_ForceLowBeam: implementation-data-type=uint8
        CAN2_HVBFullChrgPwr: implementation-data-type=uint16
        CAN2_HVBPwrAvailChrg: implementation-data-type=uint16
        CAN2_HVBPwrAvailChrg30: implementation-data-type=uint16
        CAN2_HVBPwrAvailChrg60: implementation-data-type=uint16
        CAN2_HVBSOH: implementation-data-type=uint8
        CAN2_HazardWarningReq: implementation-data-type=uint8
        CAN2_ISA_WarningMsg: implementation-data-type=uint8
        CAN2_LKA_HOD_Display_Warning: implementation-data-type=uint8
        CAN2_LKA_HOD_Sound_Warning: implementation-data-type=uint8
        CAN2_LVDA_ACCStatusInformation: implementation-data-type=uint8
        CAN2_LVDA_Disabled: implementation-data-type=uint8
        CAN2_LVDA_Failinfo: implementation-data-type=uint8
        CAN2_LVDA_Mute_Sta: implementation-data-type=uint8
        CAN2_LVDA_Warning: implementation-data-type=uint8
        CAN2_LeftTurnLightReq: implementation-data-type=uint8
        CAN2_MCU_B_F_RealPwrKw_Sta: implementation-data-type=uint16
        CAN2_MCU_B_R_RealPwrKw_Sta: implementation-data-type=uint16
        CAN2_RightTurnLightReq: implementation-data-type=uint8
        CAN2_Target_Type: implementation-data-type=uint8
    DT_CAN2_SG_HMI1
      30 x element, all with category=TYPE_REFERENCE, implementation-data-type=uint8:
        CAN2_HMI_ACAirIntM_Cmd
        CAN2_HMI_ACAirIntP_Cmd
        CAN2_HMI_ACAutoBtn_Cmd
        CAN2_HMI_ACBtn_Cmd
        CAN2_HMI_ACFrDefogBtn_Cmd
        CAN2_HMI_ACRecycleBtn_Cmd
        CAN2_HMI_ACWindDirM_Cmd
        CAN2_HMI_ACWindDirP_Cmd
        CAN2_HMI_AutoInterLight_Cmd
        CAN2_HMI_BCMPostDefogBtn_Cmd
        CAN2_HMI_DSEAT_LevelDown_Cmd
        CAN2_HMI_DSEAT_LevelUp_Cmd
        CAN2_HMI_Function1_LevelDown_Cmd
        CAN2_HMI_Function1_LevelUp_Cmd
        CAN2_HMI_Function2_LevelDown_Cmd
        CAN2_HMI_Function2_LevelUp_Cmd
        CAN2_HMI_Function3_LevelDown_Cmd
        CAN2_HMI_Function3_LevelUp_Cmd
        CAN2_HMI_Function4_LevelDown_Cmd
        CAN2_HMI_Function4_LevelUp_Cmd
        CAN2_HMI_Function5_LevelDown_Cmd
        CAN2_HMI_Function5_LevelUp_Cmd
        CAN2_HMI_Function6_LevelDown_Cmd
        CAN2_HMI_Function6_LevelUp_Cmd
        CAN2_HMI_PSEAT_LevelDown_Cmd
        CAN2_HMI_PSEAT_LevelUp_Cmd
        CAN2_HMI_ZLSetTM_Cmd
        CAN2_HMI_ZLSetTP_Cmd
        CAN2_HMI_ZRSetTM_Cmd
        CAN2_HMI_ZRSetTP_Cmd
    DT_CAN2_SG_IVI1
      73 x element, all with category=TYPE_REFERENCE, implementation-data-type=uint8:
        CAN2_A2B_Node_sta
        CAN2_AmbLigh_LowBatAlert_SW
        CAN2_AmbLigh_SafetyAlert_SW
        CAN2_AmbLightBrightnessSet
        CAN2_AmbLightColorSet
        CAN2_AmbLight_DimInDark_SW
        CAN2_AmbLight_SW
        CAN2_AmbLight_WlcmLight_SW
        CAN2_BrkAbn_GoReady_SW
        CAN2_FCP_FrEvt_BtnACMaxReq
        CAN2_FCP_FrEvt_BtnACReq
        CAN2_FCP_FrEvt_BtnAutoReq
        CAN2_FCP_FrEvt_BtnSyncReq
        CAN2_FCP_MidEvt_BtnAutoReq
        CAN2_IVI_AirRefresh_ByDMS_Sta
        CAN2_IVI_AutoTheme_But_Sta
        CAN2_IVI_AutoWipHSpdSW_Cmd
        CAN2_IVI_CLWin_LockDoorSW_Sta
        CAN2_IVI_CreateAccReq_Sta
        CAN2_IVI_DMS_SW_Sta
        CAN2_IVI_DSEAT_StopKeepMove_Sta
        CAN2_IVI_DSEAT_anti_set_Sta
        CAN2_IVI_DSEAT_entryfun_set_Sta
        CAN2_IVI_DelAccReq_Sta
        CAN2_IVI_Driving_Lock_SW_Sta
        CAN2_IVI_EPS_Force_Cmd
        CAN2_IVI_FrTrunk_UnlockReq_Sta
        CAN2_IVI_HMI_Undefined_Sta
        CAN2_IVI_LinkAccReq_Sta
        CAN2_IVI_LinkAcc_Sta
        CAN2_IVI_LinkKey_Sta
        CAN2_IVI_Located_STA
        CAN2_IVI_Lock_SoundSW_Sta
        CAN2_IVI_MirrorFolded_SW_Sta
        CAN2_IVI_NAVI_Foreground_Sta
        CAN2_IVI_OTA_Upd_Sta
        CAN2_IVI_QuickRefresh_Sta
        CAN2_IVI_SWC_VibMode_Sta
        CAN2_IVI_SilentChrg_Alert_Sta
        CAN2_IVI_Stopping_Unlock_SW_Sta
        CAN2_IVI_Theme_Sta
        CAN2_IVI_Time_Check
        CAN2_IVI_Time_Day
        CAN2_IVI_Time_Hour
        CAN2_IVI_Time_Minute
        CAN2_IVI_Time_Month
        CAN2_IVI_Time_Second
        CAN2_IVI_Time_Year
        CAN2_IVI_WPTC_SW_Sta
        CAN2_IVI_WirelessCharge_Cmd
        CAN2_IVI_sigScreenReq_Sta
        CAN2_LINKtoDrive
        CAN2_OTA_CancelDL_Req
        CAN2_OTA_CompNTFY_Pres
        CAN2_OTA_DL_Req
        CAN2_OTA_SuspendDL_Req
        CAN2_OTA_UpdStart_Req
        CAN2_OpenDrOpenWdo_SW
        CAN2_PW_CLOSE_IMD
        CAN2_PW_CONTINUE_USE
        CAN2_Re_Radio_Sta
        CAN2_Sched_Chg_Day_Set
        CAN2_Sched_Chg_End_Time_HR
        CAN2_Sched_Chg_End_Time_Min
        CAN2_Sched_Chg_St_Time_HR
        CAN2_Sched_Chg_St_Time_Min
        CAN2_Sched_OTA_wake
        CAN2_SmartEco_Mode_SW
        CAN2_Upd_Countdown_Cancel
        CAN2_Upd_Countdown_Skip
        CAN2_UserSet
        CAN2_VehACModReq
        CAN2_mFRD_link_Sta
    DT_CAN2_SG_IVI2
      162 x element, all with category=TYPE_REFERENCE:
        CAN2_AC_Chg_Cur_Set: implementation-data-type=uint8
        CAN2_AEB_BUTT: implementation-data-type=uint8
        CAN2_AVM_Err_STA: implementation-data-type=uint8
        CAN2_AVM_OFF_Rec_Butt: implementation-data-type=uint8
        CAN2_AVM_Parking_mode: implementation-data-type=uint8
        CAN2_AVM_parking_cancel: implementation-data-type=uint8
        CAN2_AVM_parking_excute: implementation-data-type=uint8
        CAN2_Approach_Unlock_SW: implementation-data-type=uint8
        CAN2_BSDMute_BUTT: implementation-data-type=uint8
        CAN2_CAAS_Sw: implementation-data-type=uint8
        CAN2_CDL_Lock_Butt: implementation-data-type=uint8
        CAN2_CDL_Unlock_Butt: implementation-data-type=uint8
        CAN2_CameraWrn: implementation-data-type=uint8
        CAN2_DMS_Status: implementation-data-type=uint8
        CAN2_DMS_Warning_Distraction: implementation-data-type=uint8
        CAN2_DMS_Warning_Fatigue: implementation-data-type=uint8
        CAN2_DMS_Warning_Unresponsive: implementation-data-type=uint8
        CAN2_DSEAT_anti_set: implementation-data-type=uint8
        CAN2_DSEAT_entryfun_set: implementation-data-type=uint8
        CAN2_DSEAT_vent_req: implementation-data-type=uint8
        CAN2_Distance_unit: implementation-data-type=uint8
        CAN2_ESC_SW_Cmd: implementation-data-type=uint8
        CAN2_FCWMute_BUTT: implementation-data-type=uint8
        CAN2_FFogLampSW: implementation-data-type=uint8
        CAN2_FS_Off_Sw: implementation-data-type=uint8
        CAN2_FalseNPrevent_SW: implementation-data-type=uint8
        CAN2_FollowMeSW: implementation-data-type=uint8
        CAN2_GPS_LAT: implementation-data-type=uint32
        CAN2_GPS_LONG: implementation-data-type=uint32
        CAN2_HeadLampSW: implementation-data-type=uint8
        CAN2_Hood_Latch_SW: implementation-data-type=uint8
        CAN2_IVI_ACC_Adaptive_Sta: implementation-data-type=uint8
        CAN2_IVI_AGSCloseSW: implementation-data-type=uint8
        CAN2_IVI_ActvDmpDisabSW: implementation-data-type=uint8
        CAN2_IVI_AirIntZ3_Cmd: implementation-data-type=uint8
        CAN2_IVI_Backlight_Sta: implementation-data-type=uint8
        CAN2_IVI_CarWash_Mode_Cmd: implementation-data-type=uint8
        CAN2_IVI_CfmTo_Rdy: implementation-data-type=uint8
        CAN2_IVI_ChargePortSW_Sta: implementation-data-type=uint8
        CAN2_IVI_CoastDwSW: implementation-data-type=uint8
        CAN2_IVI_CreepSW_Req: implementation-data-type=uint8
        CAN2_IVI_DMS_Faceblocked_Sta: implementation-data-type=uint8
        CAN2_IVI_DMS_NoDriverDetected_Sta: implementation-data-type=uint8
        CAN2_IVI_DSEATHeater_Cmd: implementation-data-type=uint8
        CAN2_IVI_DSEAT_FroEdge_Height_Cmd: implementation-data-type=uint8
        CAN2_IVI_DSEAT_Height_Cmd: implementation-data-type=uint8
        CAN2_IVI_DSEAT_Memory1_Sta: implementation-data-type=uint8
        CAN2_IVI_DSEAT_Memory2_Sta: implementation-data-type=uint8
        CAN2_IVI_DSEAT_Memory_OPTCLS_Sta: implementation-data-type=uint8
        CAN2_IVI_DSEAT_Recline_Cmd: implementation-data-type=uint8
        CAN2_IVI_DSEAT_Slide_Cmd: implementation-data-type=uint8
        CAN2_IVI_FGSAirInt_Cmd: implementation-data-type=uint8
        CAN2_IVI_FGSCh_Cmd: implementation-data-type=uint8
        CAN2_IVI_FWipIntTSet_Cmd: implementation-data-type=uint8
        CAN2_IVI_GPS_Lat_Dir_Sta: implementation-data-type=uint8
        CAN2_IVI_GPS_Long_Dir_Sta: implementation-data-type=uint8
        CAN2_IVI_IC_Brightness_Sta: implementation-data-type=uint8
        CAN2_IVI_IONSW_Cmd: implementation-data-type=uint8
        CAN2_IVI_ISA_OffsetSpd: implementation-data-type=uint8
        CAN2_IVI_LVChrgFuncSW: implementation-data-type=uint8
        CAN2_IVI_Mute_Sta: implementation-data-type=uint8
        CAN2_IVI_Night_Mode_Sta: implementation-data-type=uint8
        CAN2_IVI_Off_Road_Mode_Sta: implementation-data-type=uint8
        CAN2_IVI_PSEATHeater_Cmd: implementation-data-type=uint8
        CAN2_IVI_PSEAT_Recline_Cmd: implementation-data-type=uint8
        CAN2_IVI_PSEAT_Slide_Cmd: implementation-data-type=uint8
        CAN2_IVI_PTG_Mode_SW: implementation-data-type=uint8
        CAN2_IVI_PTG_Open_Height: implementation-data-type=uint8
        CAN2_IVI_PTG_Sta_SW: implementation-data-type=uint8
        CAN2_IVI_PTG_USSta_SW: implementation-data-type=uint8
        CAN2_IVI_PW_Mode_Req: implementation-data-type=uint8
        CAN2_IVI_Panel_Act: implementation-data-type=uint8
        CAN2_IVI_Panel_X_Coor: implementation-data-type=uint16
        CAN2_IVI_Panel_Y_Coor: implementation-data-type=uint16
        CAN2_IVI_PwrLockSW: implementation-data-type=uint8
        CAN2_IVI_Pwroff_req: implementation-data-type=uint8
        CAN2_IVI_RR_Def_Req: implementation-data-type=uint8
        CAN2_IVI_Req_V2L: implementation-data-type=uint8
        CAN2_IVI_SLIF_Warning_Sta: implementation-data-type=uint8
        CAN2_IVI_SWC_ACCMode_Sta: implementation-data-type=uint8
        CAN2_IVI_SWC_LUndefined_Sta: implementation-data-type=uint8
        CAN2_IVI_SWC_RUndefined_Sta: implementation-data-type=uint8
        CAN2_IVI_Screen: implementation-data-type=uint8
        CAN2_IVI_SetTempZon1_Sta: implementation-data-type=uint8
        CAN2_IVI_SetTempZon2_Sta: implementation-data-type=uint8
        CAN2_IVI_Start_Chg_req: implementation-data-type=uint8
        CAN2_IVI_Status: implementation-data-type=uint8
        CAN2_IVI_Stop_Chg_req: implementation-data-type=uint8
        CAN2_IVI_TrailerCheckReq_Sta: implementation-data-type=uint8
        CAN2_IVI_TrailerModeSW_Sta: implementation-data-type=uint8
        CAN2_IVI_Trigger_req: implementation-data-type=uint8
        CAN2_IVI_Unlock_Chg_req: implementation-data-type=uint8
        CAN2_IVI_WI_MAIN_SW: implementation-data-type=uint8
        CAN2_LDWMute_BUTT: implementation-data-type=uint8
        CAN2_LKA_BUTT: implementation-data-type=uint8
        CAN2_LVDAMute_BUTT: implementation-data-type=uint8
        CAN2_L_Drv_ControlCommand: implementation-data-type=uint8
        CAN2_L_Pas_ControlCommand: implementation-data-type=uint8
        CAN2_L_RLD_ControlCommand: implementation-data-type=uint8
        CAN2_L_RRD_ControlCommand: implementation-data-type=uint8
        CAN2_Light_ShowStart_Req: implementation-data-type=uint8
        CAN2_Light_ShowStop_Req: implementation-data-type=uint8
        CAN2_METER_Malfunc_Sta: implementation-data-type=uint8
        CAN2_MFRD_N_Bright_Req: implementation-data-type=uint8
        CAN2_NAVI_Cam_Dist_info: implementation-data-type=uint8
        CAN2_NAVI_Direction_STA: implementation-data-type=uint8
        CAN2_NAVI_Distance_info: implementation-data-type=uint32
        CAN2_NAVI_ForwardLinkLevel: implementation-data-type=uint8
        CAN2_NAVI_LinkClass: implementation-data-type=uint8
        CAN2_NAVI_RoadClass: implementation-data-type=uint8
        CAN2_NAVI_SpeedLimit: implementation-data-type=uint8
        CAN2_NAVI_Speed_Limit_A: implementation-data-type=uint8
        CAN2_NAVI_State: implementation-data-type=uint8
        CAN2_NAVI_Tollgate: implementation-data-type=uint16
        CAN2_NAVI_Tunnel: implementation-data-type=uint16
        CAN2_ODAMute_BUTT: implementation-data-type=uint8
        CAN2_OFF_AC_MODE: implementation-data-type=uint8
        CAN2_PSEAT_vent_req: implementation-data-type=uint8
        CAN2_Perd_V2L: implementation-data-type=uint8
        CAN2_Pressure_unit: implementation-data-type=uint8
        CAN2_RCTA_BUTT: implementation-data-type=uint8
        CAN2_RFogLampSW: implementation-data-type=uint8
        CAN2_Roll_Eng_Mode: implementation-data-type=uint8
        CAN2_Roll_Mode_SW_Cmd: implementation-data-type=uint8
        CAN2_RoomLampMode: implementation-data-type=uint8
        CAN2_SLG_Sw: implementation-data-type=uint8
        CAN2_SLIF_BUTT: implementation-data-type=uint8
        CAN2_SOC_ADJ_BUTT: implementation-data-type=uint8
        CAN2_SOC_Limit_Set: implementation-data-type=uint8
        CAN2_SOC_V2LLimit: implementation-data-type=uint8
        CAN2_Sched_Chg_Start: implementation-data-type=uint8
        CAN2_Sched_Chg_Stop: implementation-data-type=uint8
        CAN2_Sched_Chg_butt: implementation-data-type=uint8
        CAN2_Sched_Chg_limit: implementation-data-type=uint8
        CAN2_Sched_Chg_wake: implementation-data-type=uint8
        CAN2_SenstivityPosition: implementation-data-type=uint8
        CAN2_SetUnlockSingle: implementation-data-type=uint8
        CAN2_TCS_SW_Cmd: implementation-data-type=uint8
        CAN2_TPMS_Cali_Butt: implementation-data-type=uint8
        CAN2_TPMS_Res_Butt: implementation-data-type=uint8
        CAN2_Temperature_unit: implementation-data-type=uint8
        CAN2_Time_system: implementation-data-type=uint8
        CAN2_TurnSwTimeSet: implementation-data-type=uint8
        CAN2_User_p_download: implementation-data-type=uint8
        CAN2_User_p_upload: implementation-data-type=uint8
        CAN2_Walkaway_Lock_SW: implementation-data-type=uint8
        CAN2_Wifi_Reset: implementation-data-type=uint8
        CAN2_Wifi_Sta_IVI_TBOX: implementation-data-type=uint8
        CAN2_WlcmLight_Mode: implementation-data-type=uint8
        CAN2_sigAirIntenZon1Req: implementation-data-type=uint8
        CAN2_sigAirIntenZon3Req: implementation-data-type=uint8
        CAN2_sigDfrstReq: implementation-data-type=uint8
        CAN2_sigFaceReq: implementation-data-type=uint8
        CAN2_sigFootReq: implementation-data-type=uint8
        CAN2_sigHvacFrontReq: implementation-data-type=uint8
        CAN2_sigHvacRearReq: implementation-data-type=uint8
        CAN2_sigHvacReq: implementation-data-type=uint8
        CAN2_sigRecircReq: implementation-data-type=uint8
        CAN2_sigSetTempZon{1..3}Req: implementation-data-type=uint8
        CAN2_sigWindDirZon3Req: implementation-data-type=uint8
    DT_CAN2_SG_IVI3
      43 x element, all with category=TYPE_REFERENCE, implementation-data-type=uint8:
        CAN2_IVI_CLBlower_Y_Sta
        CAN2_IVI_CLBlower_Z_Sta
        CAN2_IVI_CRBlower_Y_Sta
        CAN2_IVI_CRBlower_Z_Sta
        CAN2_IVI_HMI_CustmiFun_Sta
        CAN2_IVI_HMI_CustmiKEY_Sta
        CAN2_IVI_LBlower_Mode_Sta
        CAN2_IVI_LBlower_Y_Sta
        CAN2_IVI_LBlower_Z_Sta
        CAN2_IVI_LSEATvent_Cmd
        CAN2_IVI_LeftPSDOpenClose_Cmd
        CAN2_IVI_MLFMost_Cmd
        CAN2_IVI_MLFootLift_Cmd
        CAN2_IVI_MLNapMode_Cmd
        CAN2_IVI_MLRecliner_Cmd
        CAN2_IVI_MLRestore_Cmd
        CAN2_IVI_MLSEATvent_Cmd
        CAN2_IVI_MLSeatLift_Cmd
        CAN2_IVI_MLSldRestore_Cmd
        CAN2_IVI_MLSlider_Cmd
        CAN2_IVI_MLZeroGravity_Cmd
        CAN2_IVI_MRFMost_Cmd
        CAN2_IVI_MRFootLift_Cmd
        CAN2_IVI_MRNapMode_Cmd
        CAN2_IVI_MRRecliner_Cmd
        CAN2_IVI_MRRestore_Cmd
        CAN2_IVI_MRSEATvent_Cmd
        CAN2_IVI_MRSeatLift_Cmd
        CAN2_IVI_MRSldRestore_Cmd
        CAN2_IVI_MRSlider_Cmd
        CAN2_IVI_MRZeroGravity_Cmd
        CAN2_IVI_PSDManualPower_Sta
        CAN2_IVI_RBlower_Mode_Sta
        CAN2_IVI_RBlower_Y_Sta
        CAN2_IVI_RBlower_Z_Sta
        CAN2_IVI_RSEATvent_Cmd
        CAN2_IVI_RightPSDOpenClose_Cmd
        CAN2_IVI_RollMod_atCarWash_Sta
        CAN2_IVI_SOS_Call_Sta
        CAN2_IVI_SnowMode_Cmd
        CAN2_IVI_UserTakeOver_APS_Sta
        CAN2_IVI_XWDMode_Cmd
        CAN2_IVI_Zon1WindDirSWReq_Sta
    DT_CAN2_SG_METER1
      16 x element, all with category=TYPE_REFERENCE:
        CAN2_APCforDTE: implementation-data-type=uint16
        CAN2_AVGPwrConsumption: implementation-data-type=uint16
        CAN2_AvailableTrip: implementation-data-type=uint16
        CAN2_Averaged_vehspeed: implementation-data-type=uint16
        CAN2_Charge: implementation-data-type=uint8
        CAN2_LEDlitWarnReq: implementation-data-type=uint8
        CAN2_METER_KPH_Calcu: implementation-data-type=uint8
        CAN2_METER_KPH_Real: implementation-data-type=uint16
        CAN2_METER_MPH_Calcu: implementation-data-type=uint8
        CAN2_METER_MPH_Real: implementation-data-type=uint16
        CAN2_ODOMETER: implementation-data-type=uint32
        CAN2_ParkBrake: implementation-data-type=uint8
        CAN2_Spd_Crl_Mode: implementation-data-type=uint8
        CAN2_Spd_Crl_Sta: implementation-data-type=uint8
        CAN2_Trip_A: implementation-data-type=uint32
        CAN2_Trip_B: implementation-data-type=uint32
