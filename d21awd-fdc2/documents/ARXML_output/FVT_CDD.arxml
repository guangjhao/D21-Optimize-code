AUTOSAR XML (schema 4-3-0)
package /FVT_CDD_Interface_ARPkg
  9 x client server interface:
    IF_E2E_CAN3_VCU1
      operation CSOP_Write_CAN3_VCU1
    IF_E2E_CAN3_VCU1_toNIDEC
      operation CSOP_Write_CAN3_VCU1_toNIDEC
    IF_E2E_CAN4_VCU1
      operation CSOP_Write_CAN4_VCU1
    IF_FDCCDD_Inner
      operation CSOP_FDC_AppCallSleep
    IF_HALINCDD
      54 x operation:
        CSOP_apsGetDidRequest
          arg u16_retApsGetDidRequest: type=uint16, direction=OUT, server-argument-impl-policy=USE-ARGUMENT-TYPE
          arg u8_apsIsWriteOp: type=uint8, direction=OUT, server-argument-impl-policy=USE-ARGUMENT-TYPE
        CSOP_dkcGetDidRequest
          arg u16_retDkcGetDidRequest: type=uint16, direction=OUT, server-argument-impl-policy=USE-ARGUMENT-TYPE
          arg u8_dkcIsWriteOp: type=uint8, direction=OUT, server-argument-impl-policy=USE-ARGUMENT-TYPE
        CSOP_zevGetDidRequest
          arg u16_retZevGetDidRequest: type=uint16, direction=OUT, server-argument-impl-policy=USE-ARGUMENT-TYPE
          arg u8_zevIsWriteOp: type=uint8, direction=OUT, server-argument-impl-policy=USE-ARGUMENT-TYPE
        CSOP_tpmGetDidRequest
          arg u16_retTpmGetDidRequest: type=uint16, direction=OUT, server-argument-impl-policy=USE-ARGUMENT-TYPE
          arg u8_tpmIsWriteOp: type=uint8, direction=OUT, server-argument-impl-policy=USE-ARGUMENT-TYPE
        CSOP_bcmGetDidRequest
          arg u16_retBcmGetDidRequest: type=uint16, direction=OUT, server-argument-impl-policy=USE-ARGUMENT-TYPE
          arg u8_bcmIsWriteOp: type=uint8, direction=OUT, server-argument-impl-policy=USE-ARGUMENT-TYPE
        CSOP_vcuGetDidRequest
          arg u16_retVcuGetDidRequest: type=uint16, direction=OUT, server-argument-impl-policy=USE-ARGUMENT-TYPE
          arg u8_vcuIsWriteOp: type=uint8, direction=OUT, server-argument-impl-policy=USE-ARGUMENT-TYPE
        CSOP_dkcIsDidRequested
          arg u32_retDkcIsDidRequested: type=uint32, direction=OUT, server-argument-impl-policy=USE-ARGUMENT-TYPE
        CSOP_zevIsDidRequested
          arg u32_retZevIsDidRequested: type=uint32, direction=OUT, server-argument-impl-policy=USE-ARGUMENT-TYPE
        CSOP_apsIsDidRequested
          arg u32_retApsIsDidRequested: type=uint32, direction=OUT, server-argument-impl-policy=USE-ARGUMENT-TYPE
        CSOP_tpmIsDidRequested
          arg u32_retTpmIsDidRequested: type=uint32, direction=OUT, server-argument-impl-policy=USE-ARGUMENT-TYPE
        CSOP_bcmIsDidRequested
          arg u32_retBcmIsDidRequested: type=uint32, direction=OUT, server-argument-impl-policy=USE-ARGUMENT-TYPE
        CSOP_vcuIsDidRequested
          arg u32_retVcuIsDidRequested: type=uint32, direction=OUT, server-argument-impl-policy=USE-ARGUMENT-TYPE
        CSOP_nmGetCan6TxErrorCount
          arg u8_canChannel: type=uint8, direction=IN, server-argument-impl-policy=USE-ARGUMENT-TYPE
          arg u8_pCan6TxErrorCount: type=uint8, direction=OUT, server-argument-impl-policy=USE-ARGUMENT-TYPE
          arg u8_isGetRx: type=uint8, direction=IN, server-argument-impl-policy=USE-ARGUMENT-TYPE
        CSOP_nmGetCan6RxErrorCount
          arg u8_canChannel: type=uint8, direction=IN, server-argument-impl-policy=USE-ARGUMENT-TYPE
          arg u8_pCan6RxErrorCount: type=uint8, direction=OUT, server-argument-impl-policy=USE-ARGUMENT-TYPE
          arg u8_isGetRx: type=uint8, direction=IN, server-argument-impl-policy=USE-ARGUMENT-TYPE
        CSOP_nmGetCan5TxErrorCount
          arg u8_canChannel: type=uint8, direction=IN, server-argument-impl-policy=USE-ARGUMENT-TYPE
          arg u8_pCan5TxErrorCount: type=uint8, direction=OUT, server-argument-impl-policy=USE-ARGUMENT-TYPE
          arg u8_isGetRx: type=uint8, direction=IN, server-argument-impl-policy=USE-ARGUMENT-TYPE
        CSOP_nmGetCan5RxErrorCount
          arg u8_canChannel: type=uint8, direction=IN, server-argument-impl-policy=USE-ARGUMENT-TYPE
          arg u8_pCan5RxErrorCount: type=uint8, direction=OUT, server-argument-impl-policy=USE-ARGUMENT-TYPE
          arg u8_isGetRx: type=uint8, direction=IN, server-argument-impl-policy=USE-ARGUMENT-TYPE
        CSOP_nmGetCan4TxErrorCount
          arg u8_canChannel: type=uint8, direction=IN, server-argument-impl-policy=USE-ARGUMENT-TYPE
          arg u8_pCan4TxErrorCount: type=uint8, direction=OUT, server-argument-impl-policy=USE-ARGUMENT-TYPE
          arg u8_isGetRx: type=uint8, direction=IN, server-argument-impl-policy=USE-ARGUMENT-TYPE
        CSOP_nmGetCan4RxErrorCount
          arg u8_canChannel: type=uint8, direction=IN, server-argument-impl-policy=USE-ARGUMENT-TYPE
          arg u8_pCan4RxErrorCount: type=uint8, direction=OUT, server-argument-impl-policy=USE-ARGUMENT-TYPE
          arg u8_isGetRx: type=uint8, direction=IN, server-argument-impl-policy=USE-ARGUMENT-TYPE
        CSOP_nmGetCan3TxErrorCount
          arg u8_canChannel: type=uint8, direction=IN, server-argument-impl-policy=USE-ARGUMENT-TYPE
          arg u8_pCan3TxErrorCount: type=uint8, direction=OUT, server-argument-impl-policy=USE-ARGUMENT-TYPE
          arg u8_isGetRx: type=uint8, direction=IN, server-argument-impl-policy=USE-ARGUMENT-TYPE
        CSOP_nmGetCan3RxErrorCount
          arg u8_canChannel: type=uint8, direction=IN, server-argument-impl-policy=USE-ARGUMENT-TYPE
          arg u8_pCan3RxErrorCount: type=uint8, direction=OUT, server-argument-impl-policy=USE-ARGUMENT-TYPE
          arg u8_isGetRx: type=uint8, direction=IN, server-argument-impl-policy=USE-ARGUMENT-TYPE
        CSOP_nmGetCan2TxErrorCount
          arg u8_canChannel: type=uint8, direction=IN, server-argument-impl-policy=USE-ARGUMENT-TYPE
          arg u8_pCan2TxErrorCount: type=uint8, direction=OUT, server-argument-impl-policy=USE-ARGUMENT-TYPE
          arg u8_isGetRx: type=uint8, direction=IN, server-argument-impl-policy=USE-ARGUMENT-TYPE
        CSOP_nmGetCan2RxErrorCount
          arg u8_canChannel: type=uint8, direction=IN, server-argument-impl-policy=USE-ARGUMENT-TYPE
          arg u8_pCan2RxErrorCount: type=uint8, direction=OUT, server-argument-impl-policy=USE-ARGUMENT-TYPE
          arg u8_isGetRx: type=uint8, direction=IN, server-argument-impl-policy=USE-ARGUMENT-TYPE
        CSOP_nmGetCan1TxErrorCount
          arg u8_canChannel: type=uint8, direction=IN, server-argument-impl-policy=USE-ARGUMENT-TYPE
          arg u8_pCan1TxErrorCount: type=uint8, direction=OUT, server-argument-impl-policy=USE-ARGUMENT-TYPE
          arg u8_isGetRx: type=uint8, direction=IN, server-argument-impl-policy=USE-ARGUMENT-TYPE
        CSOP_nmGetCan1RxErrorCount
          arg u8_canChannel: type=uint8, direction=IN, server-argument-impl-policy=USE-ARGUMENT-TYPE
          arg u8_pCan1RxErrorCount: type=uint8, direction=OUT, server-argument-impl-policy=USE-ARGUMENT-TYPE
          arg u8_isGetRx: type=uint8, direction=IN, server-argument-impl-policy=USE-ARGUMENT-TYPE
        CSOP_AnyNmID
          arg u8_AnyNMID: type=uint8, direction=OUT, server-argument-impl-policy=USE-ARGUMENT-TYPE
        CSOP_GetAcoreRebootCmd
          arg u8_AcoreRebootCmd: type=uint8, direction=OUT, server-argument-impl-policy=USE-ARGUMENT-TYPE
        CSOP_ReadPedalZeroPosReq
          arg u8_ReadPedalZeroPosReq: type=uint8, direction=OUT, server-argument-impl-policy=USE-ARGUMENT-TYPE
        CSOP_ResetPedalZeroPosReq
          arg u8_ResetPedalZeroPosReq: type=uint8, direction=OUT, server-argument-impl-policy=USE-ARGUMENT-TYPE
        CSOP_TPMSSensorIDRegGetSta
          arg u8_TPMSSensorIDRegSta: type=uint8, direction=OUT, server-argument-impl-policy=USE-ARGUMENT-TYPE
        CSOP_CAN1BusOff
          arg u8_CAN1BusOff: type=uint8, direction=OUT, server-argument-impl-policy=USE-ARGUMENT-TYPE
        CSOP_CAN2BusOff
          arg u8_CAN2BusOff: type=uint8, direction=OUT, server-argument-impl-policy=USE-ARGUMENT-TYPE
        CSOP_CAN3BusOff
          arg u8_CAN3BusOff: type=uint8, direction=OUT, server-argument-impl-policy=USE-ARGUMENT-TYPE
        CSOP_CAN4BusOff
          arg u8_CAN4BusOff: type=uint8, direction=OUT, server-argument-impl-policy=USE-ARGUMENT-TYPE
        CSOP_CAN5BusOff
          arg u8_CAN5BusOff: type=uint8, direction=OUT, server-argument-impl-policy=USE-ARGUMENT-TYPE
        CSOP_CAN6BusOff
          arg u8_CAN6BusOff: type=uint8, direction=OUT, server-argument-impl-policy=USE-ARGUMENT-TYPE
        CSOP_DIDgetDKCdata
          4 x arg, all with server-argument-impl-policy=USE-ARGUMENT-TYPE:
            u8_DidStaDKC: type=uint8, direction=OUT
            u8Array8_DidDataDKC: type=u8_DKCRandomYArray8_type, direction=OUT
            u16_lengthDIDDKC: type=uint16, direction=IN
            u16_DIDDKC: type=uint16, direction=IN
        CSOP_DIDgetXWDdata
          4 x arg, all with server-argument-impl-policy=USE-ARGUMENT-TYPE:
            u8_DidStaXWD: type=uint8, direction=OUT
            u8_DidDataXWD: type=uint8, direction=OUT
            u16_lengthDIDXWD: type=uint16, direction=IN
            u16_DIDXWD: type=uint16, direction=IN
        CSOP_DKCDecrypt
          arg u8Array16_AESkey: type=u8_DKCArray16_type, direction=IN, server-argument-impl-policy=USE-ARGUMENT-TYPE
          arg u8Array16_RawData: type=u8_DKCArray16_type, direction=IN, server-argument-impl-policy=USE-ARGUMENT-TYPE
          arg u8Array16_ResultData: type=u8_DKCArray16_type, direction=OUT, server-argument-impl-policy=USE-ARGUMENT-TYPE
        CSOP_GetAcoreReadyToSleep
          arg s8_AcoreReadyToSleep: type=sint8, direction=OUT, server-argument-impl-policy=USE-ARGUMENT-TYPE
        CSOP_GetAuxBattVoltage
          arg u16_AuxBattVol100mV: type=uint16, direction=OUT, server-argument-impl-policy=USE-ARGUMENT-TYPE
        CSOP_GetBootReason
          arg u8_BootReason: type=uint8, direction=OUT, server-argument-impl-policy=USE-ARGUMENT-TYPE
        CSOP_GetBootPath
          arg u32_BootPath: type=uint32, direction=OUT, server-argument-impl-policy=USE-ARGUMENT-TYPE
        CSOP_GetEvccAplusPwrUpReq
          arg u8_EvccAplusPwrUpReq: type=uint8, direction=OUT, server-argument-impl-policy=USE-ARGUMENT-TYPE
        CSOP_GetNmState
          arg u8_CurrentNMState: type=uint8, direction=OUT, server-argument-impl-policy=USE-ARGUMENT-TYPE
        CSOP_GetNvmProtectState
          arg u8_NvmProtectSta: type=uint8, direction=OUT, server-argument-impl-policy=USE-ARGUMENT-TYPE
        CSOP_GetSWID
          arg u8Array33_SWID: type=u8_SWIDArray33_type, direction=OUT, server-argument-impl-policy=USE-ARGUMENT-TYPE
        CSOP_GetVinCode
          arg u8Array17_VinCode: type=u8Array17_VinCode_type, direction=OUT, server-argument-impl-policy=USE-ARGUMENT-TYPE
        CSOP_GetVinpAllowMoveThdOta
          arg u8_AllowMovThdOTA: type=uint8, direction=OUT, server-argument-impl-policy=USE-ARGUMENT-TYPE
        CSOP_GetVinpPwrReqOta
          arg u8_PwrReqOTA: type=uint8, direction=OUT, server-argument-impl-policy=USE-ARGUMENT-TYPE
        CSOP_GetWISR
          arg u32_WISR: type=uint32, direction=OUT, server-argument-impl-policy=USE-ARGUMENT-TYPE
        CSOP_HALINCDD_DIRECT
          14 x arg, all with direction=OUT, server-argument-impl-policy=USE-ARGUMENT-TYPE:
            u8_BrakeSW: type=uint8
            u8_BrakeLamp: type=uint8
            f32_Pedal1Vol: type=float32
            f32_Pedal2Vol: type=float32
            f32_Pedal1Ref5V: type=float32
            f32_Pedal2Ref5V: type=float32
            u8_DrDoorSW: type=uint8
            u8_PsDoorSW: type=uint8
            u8_RRDoorSW: type=uint8
            u8_RLDoorSW: type=uint8
            u8_HoodSW: type=uint8
            u8_HazardSW: type=uint8
            u8_SeatSW: type=uint8
            u8_CrashSignal: type=uint8
        CSOP_IPCF_Handler
        CSOP_UDS_Main
        u8Array4_HWID
          arg u8Array4_HWID: type=u8_HWIDArray4_type, direction=OUT, server-argument-impl-policy=USE-ARGUMENT-TYPE
    IF_HALOUTCDD
      7 x operation:
        CSOP_AppNmStateReq
          arg u8_WakeUpReq: type=uint8, direction=IN, server-argument-impl-policy=USE-ARGUMENT-TYPE
          arg u8_SleepReq: type=uint8, direction=IN, server-argument-impl-policy=USE-ARGUMENT-TYPE
        CSOP_SetHazardIND
          arg u8_HazardIND: type=uint8, direction=IN, server-argument-impl-policy=USE-ARGUMENT-TYPE
        CSOP_SetSysPwrStat
          arg u8_SysPwrStat: type=uint8, direction=IN, server-argument-impl-policy=USE-ARGUMENT-TYPE
        CSOP_SleepRequest
          arg u32_SleepyState: type=uint32, direction=IN, server-argument-impl-policy=USE-ARGUMENT-TYPE
          arg u32_Wakeup_Timer_s: type=uint32, direction=IN, server-argument-impl-policy=USE-ARGUMENT-TYPE
        CSOP_TPMSSensorIDRegSetResults
          arg u8Array2_TPMSSensorIDRegResults: type=u8Array2_TPMSSensorIDRegResults_type, direction=IN, server-argument-impl-policy=USE-ARGUMENT-TYPE
        CSOP_ResetPedalZeroPosDone
        CSOP_SetAcoreRebootCmdACK
    IF_VESCDD
      operation CSOP_FrameRawData
        6 x arg, all with direction=OUT, server-argument-impl-policy=USE-ARGUMENT-TYPE:
          channel: type=uint8
          fd: type=uint8
          ext: type=uint8
          id: type=uint32
          dlc: type=uint8
          FrameRawData: type=u8_IpcfDataArray64_type
    IF_WDGCDD
      operation CSOP_Call_WDG_AppStart
      operation CSOP_Call_Watchdog
    IF_WDGCDD_END
      operation CSOP_Call_WDG_AppEnd
  impl type u8_DKCRandomYArray8_type: category=ARRAY
    element u8_DKCRandomY_Data: category=VALUE, array-size=8, array-size-semantics=FIXED-SIZE, base-type=uint8
package /Impl_Types_ARPkg
  6 x impl type, all with category=ARRAY:
    u8Array17_VinCode_type
      element u8_Element: category=VALUE, array-size=17, array-size-semantics=FIXED-SIZE, base-type=uint8
    u8Array2_TPMSSensorIDRegResults_type
      element u8_Element: category=VALUE, array-size=2, array-size-semantics=FIXED-SIZE, base-type=uint8
    u8_DKCArray16_type
      element u8_DKC_Data: category=VALUE, array-size=16, array-size-semantics=FIXED-SIZE, base-type=uint8
    u8_HWIDArray4_type
      element u8_HWID_Data: category=VALUE, array-size=4, array-size-semantics=FIXED-SIZE, base-type=uint8
    u8_IpcfDataArray64_type
      element u8_IpcfDataElement: category=VALUE, array-size=64, array-size-semantics=FIXED-SIZE, base-type=uint8
    u8_SWIDArray33_type
      element u8_SWID_Data: category=VALUE, array-size=33, array-size-semantics=FIXED-SIZE, base-type=uint8
