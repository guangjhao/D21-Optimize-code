/******************************************************************************
* ASAP2 file: SWC_FDC_type.a2l
* Code generation for model "SWC_FDC_type".
* Model version : 1.7
* Simulink Coder version : 9.6 (R2021b) 14-May-2021
* C source code generated on : Mon Jun 2 19:24:46 2025
* Target selection: autosar.tlc
* Embedded hardware selection: ARM Compatible->ARM Cortex-M
* Code generation objectives: Unspecified
* Validation result: Not run
* (add additional file header information here)
******************************************************************************/
/* Version 1.31 */
ASAP2_VERSION 1 31
/begin PROJECT ProjectName "Project Comment Goes Here"
/begin HEADER "Header Comments go here" /end HEADER
/begin MODULE ModuleName "Module Comment Goes Here"
/begin MOD_PAR "MOD PAR Comment Goes Here" /end MOD_PAR
/begin MOD_COMMON "Mod Common Comment Here" BYTE_ORDER MSB_LAST /end MOD_COMMON
/begin RECORD_LAYOUT Scalar_BOOLEAN FNC_VALUES 1 UBYTE COLUMN_DIR DIRECT /end RECORD_LAYOUT
/begin RECORD_LAYOUT Scalar_UBYTE FNC_VALUES 1 UBYTE COLUMN_DIR DIRECT /end RECORD_LAYOUT
/begin RECORD_LAYOUT Scalar_BYTE FNC_VALUES 1 SBYTE COLUMN_DIR DIRECT /end RECORD_LAYOUT
/begin RECORD_LAYOUT Scalar_UWORD FNC_VALUES 1 UWORD COLUMN_DIR DIRECT /end RECORD_LAYOUT
/begin RECORD_LAYOUT Scalar_ULONG FNC_VALUES 1 ULONG COLUMN_DIR DIRECT /end RECORD_LAYOUT
/begin RECORD_LAYOUT Scalar_LONG FNC_VALUES 1 SLONG COLUMN_DIR DIRECT /end RECORD_LAYOUT
/begin RECORD_LAYOUT Scalar_FLOAT32_IEEE FNC_VALUES 1 FLOAT32_IEEE COLUMN_DIR DIRECT /end RECORD_LAYOUT
/begin RECORD_LAYOUT Scalar_FLOAT64_IEEE FNC_VALUES 1 FLOAT64_IEEE COLUMN_DIR DIRECT /end RECORD_LAYOUT
/begin CHARACTERISTIC KACC_DCDCCalPwrAvailRsv_kW "" VALUE 0x0000 /* @ECU_Address@KACC_DCDCCalPwrAvailRsv_kW@ */ Scalar_FLOAT32_IEEE 0 SWC_FDC_type_CM_single_kW 0.0 50.0 /end CHARACTERISTIC
/begin CHARACTERISTIC KACC_HVPwrAvail4THCM_W_ovrdval "" VALUE 0x0000 /* @ECU_Address@KACC_HVPwrAvail4THCM_W_ovrdval@ */ Scalar_FLOAT32_IEEE 0 SWC_FDC_type_CM_single_W 0.0 12650.0 /end CHARACTERISTIC
/begin CHARACTERISTIC KACC_LVBattErrHiThd_V "" VALUE 0x0000 /* @ECU_Address@KACC_LVBattErrHiThd_V@ */ Scalar_FLOAT32_IEEE 0 SWC_FDC_type_CM_single_V 0.0 50.0 /end CHARACTERISTIC
/begin CHARACTERISTIC KACC_LVBattErrLoThd_V "" VALUE 0x0000 /* @ECU_Address@KACC_LVBattErrLoThd_V@ */ Scalar_FLOAT32_IEEE 0 SWC_FDC_type_CM_single_V 0.0 50.0 /end CHARACTERISTIC
/begin CHARACTERISTIC KACC_RsvPwr4DCDCTHCM_ovrdval "" VALUE 0x0000 /* @ECU_Address@KACC_RsvPwr4DCDCTHCM_ovrdval@ */ Scalar_FLOAT32_IEEE 0 SWC_FDC_type_CM_single_W 0.0 100000.0 /end CHARACTERISTIC
/begin CHARACTERISTIC KACC_RsvPwrGain_C "" VALUE 0x0000 /* @ECU_Address@KACC_RsvPwrGain_C@ */ Scalar_FLOAT32_IEEE 0 SWC_FDC_type_CM_single_gain 0.0 1000.0 /end CHARACTERISTIC
/begin CHARACTERISTIC KACC_THCMCalPwrAvailRsv_kW "" VALUE 0x0000 /* @ECU_Address@KACC_THCMCalPwrAvailRsv_kW@ */ Scalar_FLOAT32_IEEE 0 SWC_FDC_type_CM_single_kW 0.0 50.0 /end CHARACTERISTIC
/begin CHARACTERISTIC KACC_THCMMaxPwrAvail_W "" VALUE 0x0000 /* @ECU_Address@KACC_THCMMaxPwrAvail_W@ */ Scalar_FLOAT32_IEEE 0 SWC_FDC_type_CM_single_W 0.0 12650.0 /end CHARACTERISTIC
/begin CHARACTERISTIC KBCM_AmbBreathT_ms "" VALUE 0x0000 /* @ECU_Address@KBCM_AmbBreathT_ms@ */ Scalar_FLOAT32_IEEE 0 SWC_FDC_type_CM_single_ms 0.0 30000.0 /end CHARACTERISTIC
/begin CHARACTERISTIC KBCM_AmbTempT_s "" VALUE 0x0000 /* @ECU_Address@KBCM_AmbTempT_s@ */ Scalar_FLOAT32_IEEE 0 SWC_FDC_type_CM_single_s 0.0 10000.0 /end CHARACTERISTIC
/begin CHARACTERISTIC KBCM_AmbWelModeENWait_s "" VALUE 0x0000 /* @ECU_Address@KBCM_AmbWelModeENWait_s@ */ Scalar_FLOAT32_IEEE 0 SWC_FDC_type_CM_single_s 0.0 10000.0 /end CHARACTERISTIC
/begin CHARACTERISTIC KBCM_CSWLightRstDebT_s "" VALUE 0x0000 /* @ECU_Address@KBCM_CSWLightRstDebT_s@ */ Scalar_FLOAT32_IEEE 0 SWC_FDC_type_CM_single_s 0.0 10000.0 /end CHARACTERISTIC
/begin CHARACTERISTIC KBCM_CSWTurnLPRstT_s "" VALUE 0x0000 /* @ECU_Address@KBCM_CSWTurnLPRstT_s@ */ Scalar_FLOAT32_IEEE 0 SWC_FDC_type_CM_single_s 0.0 10000.0 /end CHARACTERISTIC
/begin CHARACTERISTIC KBCM_CmdKeepT_s "" VALUE 0x0000 /* @ECU_Address@KBCM_CmdKeepT_s@ */ Scalar_FLOAT32_IEEE 0 SWC_FDC_type_CM_single_s 0.0 86400.0 /end CHARACTERISTIC
/begin CHARACTERISTIC KBCM_DiagFMHT_s "" VALUE 0x0000 /* @ECU_Address@KBCM_DiagFMHT_s@ */ Scalar_FLOAT32_IEEE 0 SWC_FDC_type_CM_single_s 0.0 255.0 /end CHARACTERISTIC
/begin CHARACTERISTIC KBCM_DrOpenWdwOT_s "" VALUE 0x0000 /* @ECU_Address@KBCM_DrOpenWdwOT_s@ */ Scalar_FLOAT32_IEEE 0 SWC_FDC_type_CM_single_s 0.0 255.0 /end CHARACTERISTIC
/begin CHARACTERISTIC KBCM_DrOpenWdwReady_s "" VALUE 0x0000 /* @ECU_Address@KBCM_DrOpenWdwReady_s@ */ Scalar_FLOAT32_IEEE 0 SWC_FDC_type_CM_single_s 0.0 255.0 /end CHARACTERISTIC
/begin CHARACTERISTIC KBCM_ESSOffT_ms "" VALUE 0x0000 /* @ECU_Address@KBCM_ESSOffT_ms@ */ Scalar_FLOAT32_IEEE 0 SWC_FDC_type_CM_single_ms 0.0 10000.0 /end CHARACTERISTIC
/begin CHARACTERISTIC KBCM_ESSOnT_ms "" VALUE 0x0000 /* @ECU_Address@KBCM_ESSOnT_ms@ */ Scalar_FLOAT32_IEEE 0 SWC_FDC_type_CM_single_ms 0.0 10000.0 /end CHARACTERISTIC
/begin CHARACTERISTIC KBCM_FDCDKCReDetectT_K "" VALUE 0x0000 /* @ECU_Address@KBCM_FDCDKCReDetectT_K@ */ Scalar_FLOAT32_IEEE 0 SWC_FDC_type_CM_single_K 0.0 10000.0 /end CHARACTERISTIC
/begin CHARACTERISTIC KBCM_FDCDKCUSSFilterT_K "" VALUE 0x0000 /* @ECU_Address@KBCM_FDCDKCUSSFilterT_K@ */ Scalar_FLOAT32_IEEE 0 SWC_FDC_type_CM_single_s 0.0 10000.0 /end CHARACTERISTIC
/begin CHARACTERISTIC KBCM_HandleLampKeepT_s "" VALUE 0x0000 /* @ECU_Address@KBCM_HandleLampKeepT_s@ */ Scalar_FLOAT32_IEEE 0 SWC_FDC_type_CM_single_s 0.0 86400.0 /end CHARACTERISTIC
/begin CHARACTERISTIC KBCM_IVIRstHoldT_ms "" VALUE 0x0000 /* @ECU_Address@KBCM_IVIRstHoldT_ms@ */ Scalar_FLOAT32_IEEE 0 SWC_FDC_type_CM_single_ms 0.0 10000.0 /end CHARACTERISTIC
/begin CHARACTERISTIC KBCM_IVIRstTriggerT_ms "" VALUE 0x0000 /* @ECU_Address@KBCM_IVIRstTriggerT_ms@ */ Scalar_FLOAT32_IEEE 0 SWC_FDC_type_CM_single_ms 0.0 10000.0 /end CHARACTERISTIC
/begin CHARACTERISTIC KBCM_ONDelayT_ms "" VALUE 0x0000 /* @ECU_Address@KBCM_ONDelayT_ms@ */ Scalar_FLOAT32_IEEE 0 SWC_FDC_type_CM_single_ms 0.0 255.0 /end CHARACTERISTIC
/begin CHARACTERISTIC KBCM_ReDetectT_K "" VALUE 0x0000 /* @ECU_Address@KBCM_ReDetectT_K@ */ Scalar_FLOAT32_IEEE 0 SWC_FDC_type_CM_single_K 0.0 10000.0 /end CHARACTERISTIC
/begin CHARACTERISTIC KBCM_RmLampKeep_min "" VALUE 0x0000 /* @ECU_Address@KBCM_RmLampKeep_min@ */ Scalar_FLOAT32_IEEE 0 SWC_FDC_type_CM_single_min 0.0 10000.0 /end CHARACTERISTIC
/begin CHARACTERISTIC KBCM_RmLpKeyInT_s "" VALUE 0x0000 /* @ECU_Address@KBCM_RmLpKeyInT_s@ */ Scalar_FLOAT32_IEEE 0 SWC_FDC_type_CM_single_s 0.0 86400.0 /end CHARACTERISTIC
/begin CHARACTERISTIC KBCM_RmLpKeyMissT_s "" VALUE 0x0000 /* @ECU_Address@KBCM_RmLpKeyMissT_s@ */ Scalar_FLOAT32_IEEE 0 SWC_FDC_type_CM_single_s 0.0 86400.0 /end CHARACTERISTIC
/begin CHARACTERISTIC KBCM_SPTGDetectWaitT_s "" VALUE 0x0000 /* @ECU_Address@KBCM_SPTGDetectWaitT_s@ */ Scalar_FLOAT32_IEEE 0 SWC_FDC_type_CM_single_s 0.0 10000.0 /end CHARACTERISTIC
/begin CHARACTERISTIC KBCM_SPTGLowerBound_cm "" VALUE 0x0000 /* @ECU_Address@KBCM_SPTGLowerBound_cm@ */ Scalar_FLOAT32_IEEE 0 SWC_FDC_type_CM_single_cm 0.0 150.0 /end CHARACTERISTIC
/begin CHARACTERISTIC KBCM_SPTGWaitDKC_sec "" VALUE 0x0000 /* @ECU_Address@KBCM_SPTGWaitDKC_sec@ */ Scalar_FLOAT32_IEEE 0 SWC_FDC_type_CM_single_sec 0.0 255.0 /end CHARACTERISTIC
/begin CHARACTERISTIC KBCM_SPTGZoneDebT_s "" VALUE 0x0000 /* @ECU_Address@KBCM_SPTGZoneDebT_s@ */ Scalar_FLOAT32_IEEE 0 SWC_FDC_type_CM_single_s 0.0 10000.0 /end CHARACTERISTIC
/begin CHARACTERISTIC KBCM_SlpDebounceTime_s "" VALUE 0x0000 /* @ECU_Address@KBCM_SlpDebounceTime_s@ */ Scalar_FLOAT32_IEEE 0 SWC_FDC_type_CM_single_s 0.0 10000.0 /end CHARACTERISTIC
/begin CHARACTERISTIC KBCM_TrunSWKeepTime3_s "" VALUE 0x0000 /* @ECU_Address@KBCM_TrunSWKeepTime3_s@ */ Scalar_FLOAT32_IEEE 0 SWC_FDC_type_CM_single_s 0.0 86400.0 /end CHARACTERISTIC
/begin CHARACTERISTIC KBCM_TrunSWKeepTime5_s "" VALUE 0x0000 /* @ECU_Address@KBCM_TrunSWKeepTime5_s@ */ Scalar_FLOAT32_IEEE 0 SWC_FDC_type_CM_single_s 0.0 86400.0 /end CHARACTERISTIC
/begin CHARACTERISTIC KBCM_TrunSWKeepTime7_s "" VALUE 0x0000 /* @ECU_Address@KBCM_TrunSWKeepTime7_s@ */ Scalar_FLOAT32_IEEE 0 SWC_FDC_type_CM_single_s 0.0 86400.0 /end CHARACTERISTIC
/begin CHARACTERISTIC KBCM_USSFilterT_K "" VALUE 0x0000 /* @ECU_Address@KBCM_USSFilterT_K@ */ Scalar_FLOAT32_IEEE 0 SWC_FDC_type_CM_single_K 0.0 255.0 /end CHARACTERISTIC
/begin CHARACTERISTIC KBCM_WdwManualDetT_s "" VALUE 0x0000 /* @ECU_Address@KBCM_WdwManualDetT_s@ */ Scalar_FLOAT32_IEEE 0 SWC_FDC_type_CM_single_s 0.0 255.0 /end CHARACTERISTIC
/begin CHARACTERISTIC KBCM_WelLockT_s "" VALUE 0x0000 /* @ECU_Address@KBCM_WelLockT_s@ */ Scalar_FLOAT32_IEEE 0 SWC_FDC_type_CM_single_s 0.0 10000.0 /end CHARACTERISTIC
/begin CHARACTERISTIC KBCM_WelcomeT_s "" VALUE 0x0000 /* @ECU_Address@KBCM_WelcomeT_s@ */ Scalar_FLOAT32_IEEE 0 SWC_FDC_type_CM_single_s 0.0 10000.0 /end CHARACTERISTIC
/begin CHARACTERISTIC KDKC_AutoLockTimeout_s "" VALUE 0x0000 /* @ECU_Address@KDKC_AutoLockTimeout_s@ */ Scalar_FLOAT32_IEEE 0 SWC_FDC_type_CM_single_s 0.0 10000.0 /end CHARACTERISTIC
/begin CHARACTERISTIC KDKC_BTDisconJudgeDeb_s "" VALUE 0x0000 /* @ECU_Address@KDKC_BTDisconJudgeDeb_s@ */ Scalar_FLOAT32_IEEE 0 SWC_FDC_type_CM_single_s 0.0 60.0 /end CHARACTERISTIC
/begin CHARACTERISTIC KDKC_BTRSSISampTime_s "" VALUE 0x0000 /* @ECU_Address@KDKC_BTRSSISampTime_s@ */ Scalar_FLOAT32_IEEE 0 SWC_FDC_type_CM_single_s 0.0 10.0 /end CHARACTERISTIC
/begin CHARACTERISTIC KDKC_DKCAllowSleepDelayTime_s "" VALUE 0x0000 /* @ECU_Address@KDKC_DKCAllowSleepDelayTime_s@ */ Scalar_FLOAT32_IEEE 0 SWC_FDC_type_CM_single_s 0.0 60.0 /end CHARACTERISTIC
/begin CHARACTERISTIC KDKC_DKCDecryptionErrorAllow_s "" VALUE 0x0000 /* @ECU_Address@KDKC_DKCDecryptionErrorAllow_s@ */ Scalar_FLOAT32_IEEE 0 SWC_FDC_type_CM_single_s 0.0 1.0 /end CHARACTERISTIC
/begin CHARACTERISTIC KDKC_DKCStandbyWait60sTime_s "" VALUE 0x0000 /* @ECU_Address@KDKC_DKCStandbyWait60sTime_s@ */ Scalar_FLOAT32_IEEE 0 SWC_FDC_type_CM_single_s 0.0 1200.0 /end CHARACTERISTIC
/begin CHARACTERISTIC KDKC_DrDoorOpenStaKeep_s "" VALUE 0x0000 /* @ECU_Address@KDKC_DrDoorOpenStaKeep_s@ */ Scalar_FLOAT32_IEEE 0 SWC_FDC_type_CM_single_s 0.0 10.0 /end CHARACTERISTIC
/begin CHARACTERISTIC KDKC_LatchLidADetGreenCard_s "" VALUE 0x0000 /* @ECU_Address@KDKC_LatchLidADetGreenCard_s@ */ Scalar_FLOAT32_IEEE 0 SWC_FDC_type_CM_single_s 0.0 10.0 /end CHARACTERISTIC
/begin CHARACTERISTIC KDKC_LatchWelcomeModeSta_s "" VALUE 0x0000 /* @ECU_Address@KDKC_LatchWelcomeModeSta_s@ */ Scalar_FLOAT32_IEEE 0 SWC_FDC_type_CM_single_s 0.0 10.0 /end CHARACTERISTIC
/begin CHARACTERISTIC KDKC_LockCmdDelayTime_s "" VALUE 0x0000 /* @ECU_Address@KDKC_LockCmdDelayTime_s@ */ Scalar_FLOAT32_IEEE 0 SWC_FDC_type_CM_single_s 0.0 10.0 /end CHARACTERISTIC
/begin CHARACTERISTIC KDKC_PSAreaTimeout_s "" VALUE 0x0000 /* @ECU_Address@KDKC_PSAreaTimeout_s@ */ Scalar_FLOAT32_IEEE 0 SWC_FDC_type_CM_single_s 0.0 10000.0 /end CHARACTERISTIC
/begin CHARACTERISTIC KDKC_PTGSWCloseTimeout_s "" VALUE 0x0000 /* @ECU_Address@KDKC_PTGSWCloseTimeout_s@ */ Scalar_FLOAT32_IEEE 0 SWC_FDC_type_CM_single_s 0.0 10000.0 /end CHARACTERISTIC
/begin CHARACTERISTIC KDKC_UIDBatSampInterval_s "" VALUE 0x0000 /* @ECU_Address@KDKC_UIDBatSampInterval_s@ */ Scalar_FLOAT32_IEEE 0 SWC_FDC_type_CM_single_s 0.0 60.0 /end CHARACTERISTIC
/begin CHARACTERISTIC KDKC_UnlockCmdDelayTime_s "" VALUE 0x0000 /* @ECU_Address@KDKC_UnlockCmdDelayTime_s@ */ Scalar_FLOAT32_IEEE 0 SWC_FDC_type_CM_single_s 0.0 10.0 /end CHARACTERISTIC
/begin CHARACTERISTIC KDKC_WaitAPMAPSReqTime_s "" VALUE 0x0000 /* @ECU_Address@KDKC_WaitAPMAPSReqTime_s@ */ Scalar_FLOAT32_IEEE 0 SWC_FDC_type_CM_single_s 0.0 10.0 /end CHARACTERISTIC
/begin CHARACTERISTIC KDKC_WaitAPMJudgUserReqTime_s "" VALUE 0x0000 /* @ECU_Address@KDKC_WaitAPMJudgUserReqTime_s@ */ Scalar_FLOAT32_IEEE 0 SWC_FDC_type_CM_single_s 0.0 30.0 /end CHARACTERISTIC
/begin CHARACTERISTIC KDKC_ZONEVaildCmdDelayTime_s "" VALUE 0x0000 /* @ECU_Address@KDKC_ZONEVaildCmdDelayTime_s@ */ Scalar_FLOAT32_IEEE 0 SWC_FDC_type_CM_single_s 0.0 10.0 /end CHARACTERISTIC
/begin CHARACTERISTIC KDSC_ActiveAllowTime_s "" VALUE 0x0000 /* @ECU_Address@KDSC_ActiveAllowTime_s@ */ Scalar_FLOAT32_IEEE 0 SWC_FDC_type_CM_single_sec 0.0 10.0 /end CHARACTERISTIC
/begin CHARACTERISTIC KDSC_BrkDisBand_pct "" VALUE 0x0000 /* @ECU_Address@KDSC_BrkDisBand_pct@ */ Scalar_FLOAT32_IEEE 0 SWC_FDC_type_CM_single_sec 0.0 100.0 /end CHARACTERISTIC
/begin CHARACTERISTIC KDSC_BrkEnBand_pct "" VALUE 0x0000 /* @ECU_Address@KDSC_BrkEnBand_pct@ */ Scalar_FLOAT32_IEEE 0 SWC_FDC_type_CM_single_sec 0.0 100.0 /end CHARACTERISTIC
/begin CHARACTERISTIC KDSC_CGRealAxle_m "" VALUE 0x0000 /* @ECU_Address@KDSC_CGRealAxle_m@ */ Scalar_FLOAT32_IEEE 0 SWC_FDC_type_CM_single_m 0.0 10.0 /end CHARACTERISTIC
/begin CHARACTERISTIC KDSC_LongAccelLimit_g "" VALUE 0x0000 /* @ECU_Address@KDSC_LongAccelLimit_g@ */ Scalar_FLOAT32_IEEE 0 SWC_FDC_type_CM_single_g 0.0 1.0 /end CHARACTERISTIC
/begin CHARACTERISTIC KDSC_MaxSpeed_kph "" VALUE 0x0000 /* @ECU_Address@KDSC_MaxSpeed_kph@ */ Scalar_FLOAT32_IEEE 0 SWC_FDC_type_CM_single_kph 0.0 100.0 /end CHARACTERISTIC
/begin CHARACTERISTIC KDSC_MinSpeed_kph "" VALUE 0x0000 /* @ECU_Address@KDSC_MinSpeed_kph@ */ Scalar_FLOAT32_IEEE 0 SWC_FDC_type_CM_single_kph 0.0 100.0 /end CHARACTERISTIC
/begin CHARACTERISTIC KDSC_SpdRangeHigh_kph "" VALUE 0x0000 /* @ECU_Address@KDSC_SpdRangeHigh_kph@ */ Scalar_FLOAT32_IEEE 0 SWC_FDC_type_CM_single_kph 0.0 100.0 /end CHARACTERISTIC
/begin CHARACTERISTIC KDSC_SpdRangeLow_kph "" VALUE 0x0000 /* @ECU_Address@KDSC_SpdRangeLow_kph@ */ Scalar_FLOAT32_IEEE 0 SWC_FDC_type_CM_single_kph 0.0 100.0 /end CHARACTERISTIC
/begin CHARACTERISTIC KDSC_TriggerTimes "" VALUE 0x0000 /* @ECU_Address@KDSC_TriggerTimes@ */ Scalar_FLOAT32_IEEE 0 SWC_FDC_type_CM_single_sec 0.0 1.0 /end CHARACTERISTIC
/begin CHARACTERISTIC KDSC_TurnAngExit_deg "" VALUE 0x0000 /* @ECU_Address@KDSC_TurnAngExit_deg@ */ Scalar_FLOAT32_IEEE 0 SWC_FDC_type_CM_single_deg 0.0 540.0 /end CHARACTERISTIC
/begin CHARACTERISTIC KDSC_TurnAngLimit_deg "" VALUE 0x0000 /* @ECU_Address@KDSC_TurnAngLimit_deg@ */ Scalar_FLOAT32_IEEE 0 SWC_FDC_type_CM_single_deg 0.0 540.0 /end CHARACTERISTIC
/begin CHARACTERISTIC KNMM_NoNMIdDebounce_s "" VALUE 0x0000 /* @ECU_Address@KNMM_NoNMIdDebounce_s@ */ Scalar_FLOAT32_IEEE 0 SWC_FDC_type_CM_single_s 0.0 10.0 /end CHARACTERISTIC
/begin CHARACTERISTIC KNMM_NrmStaDelay_s "" VALUE 0x0000 /* @ECU_Address@KNMM_NrmStaDelay_s@ */ Scalar_FLOAT32_IEEE 0 SWC_FDC_type_CM_single_s 0.0 600.0 /end CHARACTERISTIC
/begin CHARACTERISTIC KNMM_RdySlpStaDelay_s "" VALUE 0x0000 /* @ECU_Address@KNMM_RdySlpStaDelay_s@ */ Scalar_FLOAT32_IEEE 0 SWC_FDC_type_CM_single_s 0.0 600.0 /end CHARACTERISTIC
/begin CHARACTERISTIC KPMM_APSAllowThd_pct "" VALUE 0x0000 /* @ECU_Address@KPMM_APSAllowThd_pct@ */ Scalar_FLOAT32_IEEE 0 SWC_FDC_type_CM_single_pct 0.0 100.0 /end CHARACTERISTIC
/begin CHARACTERISTIC KPMM_AllDoorClosedHoldTime_s "" VALUE 0x0000 /* @ECU_Address@KPMM_AllDoorClosedHoldTime_s@ */ Scalar_FLOAT32_IEEE 0 SWC_FDC_type_CM_single_s 0.0 600.0 /end CHARACTERISTIC
/begin CHARACTERISTIC KPMM_BattDownFailtime_s "" VALUE 0x0000 /* @ECU_Address@KPMM_BattDownFailtime_s@ */ Scalar_FLOAT32_IEEE 0 SWC_FDC_type_CM_single_s 0.0 600.0 /end CHARACTERISTIC
/begin CHARACTERISTIC KPMM_BattUpFailtime_s "" VALUE 0x0000 /* @ECU_Address@KPMM_BattUpFailtime_s@ */ Scalar_FLOAT32_IEEE 0 SWC_FDC_type_CM_single_s 0.0 600.0 /end CHARACTERISTIC
/begin CHARACTERISTIC KPMM_BattUpResetTO_s "" VALUE 0x0000 /* @ECU_Address@KPMM_BattUpResetTO_s@ */ Scalar_FLOAT32_IEEE 0 SWC_FDC_type_CM_single_s 0.0 60.0 /end CHARACTERISTIC
/begin CHARACTERISTIC KPMM_BattUpRstDlyTO_s "" VALUE 0x0000 /* @ECU_Address@KPMM_BattUpRstDlyTO_s@ */ Scalar_FLOAT32_IEEE 0 SWC_FDC_type_CM_single_s 0.0 60.0 /end CHARACTERISTIC
/begin CHARACTERISTIC KPMM_BrakeSWHoldTime_s "" VALUE 0x0000 /* @ECU_Address@KPMM_BrakeSWHoldTime_s@ */ Scalar_FLOAT32_IEEE 0 SWC_FDC_type_CM_single_s 0.0 600.0 /end CHARACTERISTIC
/begin CHARACTERISTIC KPMM_CANValidChkFailtime_s "" VALUE 0x0000 /* @ECU_Address@KPMM_CANValidChkFailtime_s@ */ Scalar_FLOAT32_IEEE 0 SWC_FDC_type_CM_single_s 0.0 60.0 /end CHARACTERISTIC
/begin CHARACTERISTIC KPMM_ChrgPlugHoldTime_s "" VALUE 0x0000 /* @ECU_Address@KPMM_ChrgPlugHoldTime_s@ */ Scalar_FLOAT32_IEEE 0 SWC_FDC_type_CM_single_s 0.0 600.0 /end CHARACTERISTIC
/begin CHARACTERISTIC KPMM_DCDCDisableFailtime_s "" VALUE 0x0000 /* @ECU_Address@KPMM_DCDCDisableFailtime_s@ */ Scalar_FLOAT32_IEEE 0 SWC_FDC_type_CM_single_s 0.0 600.0 /end CHARACTERISTIC
/begin CHARACTERISTIC KPMM_DCDCEnableFailtime_s "" VALUE 0x0000 /* @ECU_Address@KPMM_DCDCEnableFailtime_s@ */ Scalar_FLOAT32_IEEE 0 SWC_FDC_type_CM_single_s 0.0 600.0 /end CHARACTERISTIC
/begin CHARACTERISTIC KPMM_DCDCVSETLVChrg_V "" VALUE 0x0000 /* @ECU_Address@KPMM_DCDCVSETLVChrg_V@ */ Scalar_FLOAT32_IEEE 0 SWC_FDC_type_CM_single_V 0.0 50.0 /end CHARACTERISTIC
/begin CHARACTERISTIC KPMM_DCDCVSET_V "" VALUE 0x0000 /* @ECU_Address@KPMM_DCDCVSET_V@ */ Scalar_FLOAT32_IEEE 0 SWC_FDC_type_CM_single_V 0.0 50.0 /end CHARACTERISTIC
/begin CHARACTERISTIC KPMM_Delay4IVIWarnAct_s "" VALUE 0x0000 /* @ECU_Address@KPMM_Delay4IVIWarnAct_s@ */ Scalar_FLOAT32_IEEE 0 SWC_FDC_type_CM_single_s 0.0 600.0 /end CHARACTERISTIC
/begin CHARACTERISTIC KPMM_DoorSWHoldTime_s "" VALUE 0x0000 /* @ECU_Address@KPMM_DoorSWHoldTime_s@ */ Scalar_FLOAT32_IEEE 0 SWC_FDC_type_CM_single_s 0.0 600.0 /end CHARACTERISTIC
/begin CHARACTERISTIC KPMM_DriverSafetyChkFailtime_s "" VALUE 0x0000 /* @ECU_Address@KPMM_DriverSafetyChkFailtime_s@ */ Scalar_FLOAT32_IEEE 0 SWC_FDC_type_CM_single_s 0.0 600.0 /end CHARACTERISTIC
/begin CHARACTERISTIC KPMM_FDADC12VDetAccuIntval_s "" VALUE 0x0000 /* @ECU_Address@KPMM_FDADC12VDetAccuIntval_s@ */ Scalar_FLOAT32_IEEE 0 SWC_FDC_type_CM_single_s 0.0 10.0 /end CHARACTERISTIC
/begin CHARACTERISTIC KPMM_FDADC12VDetAccu_s "" VALUE 0x0000 /* @ECU_Address@KPMM_FDADC12VDetAccu_s@ */ Scalar_FLOAT32_IEEE 0 SWC_FDC_type_CM_single_s 0.0 60.0 /end CHARACTERISTIC
/begin CHARACTERISTIC KPMM_FirstLVCheckHoldT_s "" VALUE 0x0000 /* @ECU_Address@KPMM_FirstLVCheckHoldT_s@ */ Scalar_FLOAT32_IEEE 0 SWC_FDC_type_CM_single_s 0.0 60.0 /end CHARACTERISTIC
/begin CHARACTERISTIC KPMM_FrMCUDischrgVolt_V "" VALUE 0x0000 /* @ECU_Address@KPMM_FrMCUDischrgVolt_V@ */ Scalar_FLOAT32_IEEE 0 SWC_FDC_type_CM_single_V 0.0 800.0 /end CHARACTERISTIC
/begin CHARACTERISTIC KPMM_HVBRlyChkFailtime_s "" VALUE 0x0000 /* @ECU_Address@KPMM_HVBRlyChkFailtime_s@ */ Scalar_FLOAT32_IEEE 0 SWC_FDC_type_CM_single_s 0.0 600.0 /end CHARACTERISTIC
/begin CHARACTERISTIC KPMM_HVBSOCOFFCStaChkFailtime_s "" VALUE 0x0000 /* @ECU_Address@KPMM_HVBSOCOFFCStaChkFailtime_s@ */ Scalar_FLOAT32_IEEE 0 SWC_FDC_type_CM_single_s 0.0 600.0 /end CHARACTERISTIC
/begin CHARACTERISTIC KPMM_HVBSOCOffStaChkFailtime_s "" VALUE 0x0000 /* @ECU_Address@KPMM_HVBSOCOffStaChkFailtime_s@ */ Scalar_FLOAT32_IEEE 0 SWC_FDC_type_CM_single_s 0.0 600.0 /end CHARACTERISTIC
/begin CHARACTERISTIC KPMM_HVBattSOCPwrDwnThd_pct "" VALUE 0x0000 /* @ECU_Address@KPMM_HVBattSOCPwrDwnThd_pct@ */ Scalar_FLOAT32_IEEE 0 SWC_FDC_type_CM_single_pct 0.0 100.0 /end CHARACTERISTIC
/begin CHARACTERISTIC KPMM_HVBattSOCThd_pct "" VALUE 0x0000 /* @ECU_Address@KPMM_HVBattSOCThd_pct@ */ Scalar_FLOAT32_IEEE 0 SWC_FDC_type_CM_single_pct 0.0 100.0 /end CHARACTERISTIC
/begin CHARACTERISTIC KPMM_HVPwrStaHoldTime_s "" VALUE 0x0000 /* @ECU_Address@KPMM_HVPwrStaHoldTime_s@ */ Scalar_FLOAT32_IEEE 0 SWC_FDC_type_CM_single_s 0.0 60.0 /end CHARACTERISTIC
/begin CHARACTERISTIC KPMM_HVSOCWarnThd_pct "" VALUE 0x0000 /* @ECU_Address@KPMM_HVSOCWarnThd_pct@ */ Scalar_FLOAT32_IEEE 0 SWC_FDC_type_CM_single_pct 0.0 100.0 /end CHARACTERISTIC
/begin CHARACTERISTIC KPMM_HVSOCWarnTime_s "" VALUE 0x0000 /* @ECU_Address@KPMM_HVSOCWarnTime_s@ */ Scalar_FLOAT32_IEEE 0 SWC_FDC_type_CM_single_s 0.0 3600.0 /end CHARACTERISTIC
/begin CHARACTERISTIC KPMM_HoodOffChkFailtime_s "" VALUE 0x0000 /* @ECU_Address@KPMM_HoodOffChkFailtime_s@ */ Scalar_FLOAT32_IEEE 0 SWC_FDC_type_CM_single_s 0.0 600.0 /end CHARACTERISTIC
/begin CHARACTERISTIC KPMM_IVIPwroffHoldTime_s "" VALUE 0x0000 /* @ECU_Address@KPMM_IVIPwroffHoldTime_s@ */ Scalar_FLOAT32_IEEE 0 SWC_FDC_type_CM_single_s 0.0 600.0 /end CHARACTERISTIC
/begin CHARACTERISTIC KPMM_LVADCErrTO_s "" VALUE 0x0000 /* @ECU_Address@KPMM_LVADCErrTO_s@ */ Scalar_FLOAT32_IEEE 0 SWC_FDC_type_CM_single_s 0.0 5.0 /end CHARACTERISTIC
/begin CHARACTERISTIC KPMM_LVBattChkOKStdT_s "" VALUE 0x0000 /* @ECU_Address@KPMM_LVBattChkOKStdT_s@ */ Scalar_FLOAT32_IEEE 0 SWC_FDC_type_CM_single_s 0.0 86400.0 /end CHARACTERISTIC
/begin CHARACTERISTIC KPMM_LVBattChkWakeholdExt_s "" VALUE 0x0000 /* @ECU_Address@KPMM_LVBattChkWakeholdExt_s@ */ Scalar_FLOAT32_IEEE 0 SWC_FDC_type_CM_single_s 0.0 255.0 /end CHARACTERISTIC
/begin CHARACTERISTIC KPMM_LVBattChkWakehold_s "" VALUE 0x0000 /* @ECU_Address@KPMM_LVBattChkWakehold_s@ */ Scalar_FLOAT32_IEEE 0 SWC_FDC_type_CM_single_s 0.0 600.0 /end CHARACTERISTIC
/begin CHARACTERISTIC KPMM_LVBattOFFSlpThd_mV "" VALUE 0x0000 /* @ECU_Address@KPMM_LVBattOFFSlpThd_mV@ */ Scalar_FLOAT32_IEEE 0 SWC_FDC_type_CM_single_mV 0.0 20000.0 /end CHARACTERISTIC
/begin CHARACTERISTIC KPMM_LVBattThd_V "" VALUE 0x0000 /* @ECU_Address@KPMM_LVBattThd_V@ */ Scalar_FLOAT32_IEEE 0 SWC_FDC_type_CM_single_V 0.0 50.0 /end CHARACTERISTIC
/begin CHARACTERISTIC KPMM_LVChrgHoldT_s "" VALUE 0x0000 /* @ECU_Address@KPMM_LVChrgHoldT_s@ */ Scalar_FLOAT32_IEEE 0 SWC_FDC_type_CM_single_s 0.0 3600.0 /end CHARACTERISTIC
/begin CHARACTERISTIC KPMM_MCUDisChrgFailtime_s "" VALUE 0x0000 /* @ECU_Address@KPMM_MCUDisChrgFailtime_s@ */ Scalar_FLOAT32_IEEE 0 SWC_FDC_type_CM_single_s 0.0 600.0 /end CHARACTERISTIC
/begin CHARACTERISTIC KPMM_MCUDisableFailtime_s "" VALUE 0x0000 /* @ECU_Address@KPMM_MCUDisableFailtime_s@ */ Scalar_FLOAT32_IEEE 0 SWC_FDC_type_CM_single_s 0.0 600.0 /end CHARACTERISTIC
/begin CHARACTERISTIC KPMM_MCUDischrgVolt_V "" VALUE 0x0000 /* @ECU_Address@KPMM_MCUDischrgVolt_V@ */ Scalar_FLOAT32_IEEE 0 SWC_FDC_type_CM_single_V 0.0 60.0 /end CHARACTERISTIC
/begin CHARACTERISTIC KPMM_MLvSafetyFailtime_s "" VALUE 0x0000 /* @ECU_Address@KPMM_MLvSafetyFailtime_s@ */ Scalar_FLOAT32_IEEE 0 SWC_FDC_type_CM_single_s 0.0 600.0 /end CHARACTERISTIC
/begin CHARACTERISTIC KPMM_OBCDisableFailtime_s "" VALUE 0x0000 /* @ECU_Address@KPMM_OBCDisableFailtime_s@ */ Scalar_FLOAT32_IEEE 0 SWC_FDC_type_CM_single_s 0.0 600.0 /end CHARACTERISTIC
/begin CHARACTERISTIC KPMM_OBCPreChgChkFailtime_s "" VALUE 0x0000 /* @ECU_Address@KPMM_OBCPreChgChkFailtime_s@ */ Scalar_FLOAT32_IEEE 0 SWC_FDC_type_CM_single_s 0.0 600.0 /end CHARACTERISTIC
/begin CHARACTERISTIC KPMM_OTAPwrReqOFFChk_s "" VALUE 0x0000 /* @ECU_Address@KPMM_OTAPwrReqOFFChk_s@ */ Scalar_FLOAT32_IEEE 0 SWC_FDC_type_CM_single_s 0.0 86400.0 /end CHARACTERISTIC
/begin CHARACTERISTIC KPMM_OTAPwrReqStdChk_s "" VALUE 0x0000 /* @ECU_Address@KPMM_OTAPwrReqStdChk_s@ */ Scalar_FLOAT32_IEEE 0 SWC_FDC_type_CM_single_s 0.0 86400.0 /end CHARACTERISTIC
/begin CHARACTERISTIC KPMM_OffA2OffTime_s "" VALUE 0x0000 /* @ECU_Address@KPMM_OffA2OffTime_s@ */ Scalar_FLOAT32_IEEE 0 SWC_FDC_type_CM_single_s 0.0 3600.0 /end CHARACTERISTIC
/begin CHARACTERISTIC KPMM_PWCONTINUEHoldTime_s "" VALUE 0x0000 /* @ECU_Address@KPMM_PWCONTINUEHoldTime_s@ */ Scalar_FLOAT32_IEEE 0 SWC_FDC_type_CM_single_s 0.0 600.0 /end CHARACTERISTIC
/begin CHARACTERISTIC KPMM_PluginVehSpdThd_kph "" VALUE 0x0000 /* @ECU_Address@KPMM_PluginVehSpdThd_kph@ */ Scalar_FLOAT32_IEEE 0 SWC_FDC_type_CM_single_kph 0.0 100.0 /end CHARACTERISTIC
/begin CHARACTERISTIC KPMM_PrechrgChkFailtime_s "" VALUE 0x0000 /* @ECU_Address@KPMM_PrechrgChkFailtime_s@ */ Scalar_FLOAT32_IEEE 0 SWC_FDC_type_CM_single_s 0.0 600.0 /end CHARACTERISTIC
/begin CHARACTERISTIC KPMM_PwrStaOFFCTO_s "" VALUE 0x0000 /* @ECU_Address@KPMM_PwrStaOFFCTO_s@ */ Scalar_FLOAT32_IEEE 0 SWC_FDC_type_CM_single_s 0.0 86400.0 /end CHARACTERISTIC
/begin CHARACTERISTIC KPMM_PwrStaONTOPop_s "" VALUE 0x0000 /* @ECU_Address@KPMM_PwrStaONTOPop_s@ */ Scalar_FLOAT32_IEEE 0 SWC_FDC_type_CM_single_s 0.0 86400.0 /end CHARACTERISTIC
/begin CHARACTERISTIC KPMM_PwrStaONTO_s "" VALUE 0x0000 /* @ECU_Address@KPMM_PwrStaONTO_s@ */ Scalar_FLOAT32_IEEE 0 SWC_FDC_type_CM_single_s 0.0 86400.0 /end CHARACTERISTIC
/begin CHARACTERISTIC KPMM_PwrStaStdTO_s "" VALUE 0x0000 /* @ECU_Address@KPMM_PwrStaStdTO_s@ */ Scalar_FLOAT32_IEEE 0 SWC_FDC_type_CM_single_s 0.0 86400.0 /end CHARACTERISTIC
/begin CHARACTERISTIC KPMM_PwrUpChkFailtime_s "" VALUE 0x0000 /* @ECU_Address@KPMM_PwrUpChkFailtime_s@ */ Scalar_FLOAT32_IEEE 0 SWC_FDC_type_CM_single_s 0.0 60.0 /end CHARACTERISTIC
/begin CHARACTERISTIC KPMM_PwrUpVehSpdThd_kph "" VALUE 0x0000 /* @ECU_Address@KPMM_PwrUpVehSpdThd_kph@ */ Scalar_FLOAT32_IEEE 0 SWC_FDC_type_CM_single_kph 0.0 100.0 /end CHARACTERISTIC
/begin CHARACTERISTIC KPMM_RAPSFailTime_s "" VALUE 0x0000 /* @ECU_Address@KPMM_RAPSFailTime_s@ */ Scalar_FLOAT32_IEEE 0 SWC_FDC_type_CM_single_s 0.0 1.0 /end CHARACTERISTIC
/begin CHARACTERISTIC KPMM_RrMCUDischrgVolt_V "" VALUE 0x0000 /* @ECU_Address@KPMM_RrMCUDischrgVolt_V@ */ Scalar_FLOAT32_IEEE 0 SWC_FDC_type_CM_single_V 0.0 800.0 /end CHARACTERISTIC
/begin CHARACTERISTIC KPMM_SafetyChkFailtime_s "" VALUE 0x0000 /* @ECU_Address@KPMM_SafetyChkFailtime_s@ */ Scalar_FLOAT32_IEEE 0 SWC_FDC_type_CM_single_s 0.0 600.0 /end CHARACTERISTIC
/begin CHARACTERISTIC KPMM_SaftyChkHLvTO_s "" VALUE 0x0000 /* @ECU_Address@KPMM_SaftyChkHLvTO_s@ */ Scalar_FLOAT32_IEEE 0 SWC_FDC_type_CM_single_s 0.0 86400.0 /end CHARACTERISTIC
/begin CHARACTERISTIC KPMM_SaftyChkMLvTO_s "" VALUE 0x0000 /* @ECU_Address@KPMM_SaftyChkMLvTO_s@ */ Scalar_FLOAT32_IEEE 0 SWC_FDC_type_CM_single_s 0.0 86400.0 /end CHARACTERISTIC
/begin CHARACTERISTIC KPMM_SchedChgHoldTime_s "" VALUE 0x0000 /* @ECU_Address@KPMM_SchedChgHoldTime_s@ */ Scalar_FLOAT32_IEEE 0 SWC_FDC_type_CM_single_s 0.0 600.0 /end CHARACTERISTIC
/begin CHARACTERISTIC KPMM_Sched_ChgTO_s "" VALUE 0x0000 /* @ECU_Address@KPMM_Sched_ChgTO_s@ */ Scalar_FLOAT32_IEEE 0 SWC_FDC_type_CM_single_s 0.0 86400.0 /end CHARACTERISTIC
/begin CHARACTERISTIC KPMM_SeatSWHoldTime_s "" VALUE 0x0000 /* @ECU_Address@KPMM_SeatSWHoldTime_s@ */ Scalar_FLOAT32_IEEE 0 SWC_FDC_type_CM_single_s 0.0 600.0 /end CHARACTERISTIC
/begin CHARACTERISTIC KPMM_SilentChrgReqTO_s "" VALUE 0x0000 /* @ECU_Address@KPMM_SilentChrgReqTO_s@ */ Scalar_FLOAT32_IEEE 0 SWC_FDC_type_CM_single_s 0.0 60.0 /end CHARACTERISTIC
/begin CHARACTERISTIC KPMM_SysBaseCurr_A "" VALUE 0x0000 /* @ECU_Address@KPMM_SysBaseCurr_A@ */ Scalar_FLOAT32_IEEE 0 SWC_FDC_type_CM_single_A 0.0 3600.0 /end CHARACTERISTIC
/begin CHARACTERISTIC KPMM_SysPwrDownDbns_s "" VALUE 0x0000 /* @ECU_Address@KPMM_SysPwrDownDbns_s@ */ Scalar_FLOAT32_IEEE 0 SWC_FDC_type_CM_single_s 0.0 60.0 /end CHARACTERISTIC
/begin CHARACTERISTIC KPMM_TMSpdMCUDisThrsh_rpm "" VALUE 0x0000 /* @ECU_Address@KPMM_TMSpdMCUDisThrsh_rpm@ */ Scalar_FLOAT32_IEEE 0 SWC_FDC_type_CM_single_rpm -100000.0 100000.0 /end CHARACTERISTIC
/begin CHARACTERISTIC KSYS_SleepTimeBuffer_sec "" VALUE 0x0000 /* @ECU_Address@KSYS_SleepTimeBuffer_sec@ */ Scalar_FLOAT32_IEEE 0 SWC_FDC_type_CM_single_s 0.0 1800.0 /end CHARACTERISTIC
/begin CHARACTERISTIC KTHC_FootColdT_C "" VALUE 0x0000 /* @ECU_Address@KTHC_FootColdT_C@ */ Scalar_FLOAT32_IEEE 0 SWC_FDC_type_CM_single_C 0.0 200.0 /end CHARACTERISTIC
/begin CHARACTERISTIC KTHC_FootColdTdelta_C "" VALUE 0x0000 /* @ECU_Address@KTHC_FootColdTdelta_C@ */ Scalar_FLOAT32_IEEE 0 SWC_FDC_type_CM_single_C 0.0 200.0 /end CHARACTERISTIC
/begin CHARACTERISTIC KTHC_T2Mmaxamb_C "" VALUE 0x0000 /* @ECU_Address@KTHC_T2Mmaxamb_C@ */ Scalar_FLOAT32_IEEE 0 SWC_FDC_type_CM_single_C -40.0 200.0 /end CHARACTERISTIC
/begin CHARACTERISTIC KTHC_T3Mmaxamb_C "" VALUE 0x0000 /* @ECU_Address@KTHC_T3Mmaxamb_C@ */ Scalar_FLOAT32_IEEE 0 SWC_FDC_type_CM_single_C -40.0 200.0 /end CHARACTERISTIC
/begin CHARACTERISTIC KTHC_T3Mminamb_C "" VALUE 0x0000 /* @ECU_Address@KTHC_T3Mminamb_C@ */ Scalar_FLOAT32_IEEE 0 SWC_FDC_type_CM_single_C -40.0 200.0 /end CHARACTERISTIC
/begin CHARACTERISTIC KTHC_T4Mmaxamb_C "" VALUE 0x0000 /* @ECU_Address@KTHC_T4Mmaxamb_C@ */ Scalar_FLOAT32_IEEE 0 SWC_FDC_type_CM_single_C -40.0 200.0 /end CHARACTERISTIC
/begin CHARACTERISTIC KTHC_T4Mminamb_C "" VALUE 0x0000 /* @ECU_Address@KTHC_T4Mminamb_C@ */ Scalar_FLOAT32_IEEE 0 SWC_FDC_type_CM_single_C -40.0 200.0 /end CHARACTERISTIC
/begin CHARACTERISTIC KTHC_T5Mminamb_C "" VALUE 0x0000 /* @ECU_Address@KTHC_T5Mminamb_C@ */ Scalar_FLOAT32_IEEE 0 SWC_FDC_type_CM_single_C -40.0 200.0 /end CHARACTERISTIC
/begin CHARACTERISTIC KTHC_Thilevel1_C "" VALUE 0x0000 /* @ECU_Address@KTHC_Thilevel1_C@ */ Scalar_FLOAT32_IEEE 0 SWC_FDC_type_CM_single_C -40.0 200.0 /end CHARACTERISTIC
/begin CHARACTERISTIC KTHC_Thilevel2_C "" VALUE 0x0000 /* @ECU_Address@KTHC_Thilevel2_C@ */ Scalar_FLOAT32_IEEE 0 SWC_FDC_type_CM_single_C -40.0 200.0 /end CHARACTERISTIC
/begin CHARACTERISTIC KTHC_Tmidlevel_C "" VALUE 0x0000 /* @ECU_Address@KTHC_Tmidlevel_C@ */ Scalar_FLOAT32_IEEE 0 SWC_FDC_type_CM_single_C -40.0 200.0 /end CHARACTERISTIC
/begin CHARACTERISTIC KTHC_Trecymin_C "" VALUE 0x0000 /* @ECU_Address@KTHC_Trecymin_C@ */ Scalar_FLOAT32_IEEE 0 SWC_FDC_type_CM_single_C -40.0 200.0 /end CHARACTERISTIC
/begin CHARACTERISTIC KTQD_RrPreLoadBoundary_Nm "" VALUE 0x0000 /* @ECU_Address@KTQD_RrPreLoadBoundary_Nm@ */ Scalar_FLOAT32_IEEE 0 SWC_FDC_type_CM_single_Nm 0.0 5000.0 /end CHARACTERISTIC
/begin CHARACTERISTIC KDKC_JudBTRSSIStrongDeb_cnt "" VALUE 0x0000 /* @ECU_Address@KDKC_JudBTRSSIStrongDeb_cnt@ */ Scalar_UWORD 0 SWC_FDC_type_CM_uint16_cnt 0.0 65535.0 /end CHARACTERISTIC
/begin CHARACTERISTIC KDKC_JudBTRSSIWeakDeb_cnt "" VALUE 0x0000 /* @ECU_Address@KDKC_JudBTRSSIWeakDeb_cnt@ */ Scalar_UWORD 0 SWC_FDC_type_CM_uint16_cnt 0.0 65535.0 /end CHARACTERISTIC
/begin CHARACTERISTIC KDKC_UIDBatLowVolDeb_cnt "" VALUE 0x0000 /* @ECU_Address@KDKC_UIDBatLowVolDeb_cnt@ */ Scalar_UWORD 0 SWC_FDC_type_CM_uint16_cnt 0.0 65535.0 /end CHARACTERISTIC
/begin CHARACTERISTIC KDKC_UIDBatLowVolx1000Thres_V "" VALUE 0x0000 /* @ECU_Address@KDKC_UIDBatLowVolx1000Thres_V@ */ Scalar_UWORD 0 SWC_FDC_type_CM_uint16_V 0.0 10000.0 /end CHARACTERISTIC
/begin CHARACTERISTIC KDKC_UIDBatOKVolDeb_cnt "" VALUE 0x0000 /* @ECU_Address@KDKC_UIDBatOKVolDeb_cnt@ */ Scalar_UWORD 0 SWC_FDC_type_CM_uint16_cnt 0.0 65535.0 /end CHARACTERISTIC
/begin CHARACTERISTIC KDKC_UIDBatOKVolx1000Thres_V "" VALUE 0x0000 /* @ECU_Address@KDKC_UIDBatOKVolx1000Thres_V@ */ Scalar_UWORD 0 SWC_FDC_type_CM_uint16_V 0.0 10000.0 /end CHARACTERISTIC
/begin CHARACTERISTIC KDKC_UIDBatSampTotal_cnt "" VALUE 0x0000 /* @ECU_Address@KDKC_UIDBatSampTotal_cnt@ */ Scalar_UWORD 0 SWC_FDC_type_CM_uint16_cnt 0.0 65535.0 /end CHARACTERISTIC
/begin CHARACTERISTIC KDKC_UIDBatVoltx1000_V_ovrdval "" VALUE 0x0000 /* @ECU_Address@KDKC_UIDBatVoltx1000_V_ovrdval@ */ Scalar_UWORD 0 SWC_FDC_type_CM_uint16_V 0.0 10000.0 /end CHARACTERISTIC
/begin CHARACTERISTIC KPMM_LVADCDiffThd_mV "" VALUE 0x0000 /* @ECU_Address@KPMM_LVADCDiffThd_mV@ */ Scalar_UWORD 0 SWC_FDC_type_CM_uint16_mV 0.0 65535.0 /end CHARACTERISTIC
/begin CHARACTERISTIC KPMM_LVADCLoThd_mV "" VALUE 0x0000 /* @ECU_Address@KPMM_LVADCLoThd_mV@ */ Scalar_UWORD 0 SWC_FDC_type_CM_uint16_mV 0.0 65535.0 /end CHARACTERISTIC
/begin CHARACTERISTIC KPMM_LVADCUpThd_mV "" VALUE 0x0000 /* @ECU_Address@KPMM_LVADCUpThd_mV@ */ Scalar_UWORD 0 SWC_FDC_type_CM_uint16_mV 0.0 65535.0 /end CHARACTERISTIC
/begin CHARACTERISTIC KTHC_ACMaxMinT_sec "" VALUE 0x0000 /* @ECU_Address@KTHC_ACMaxMinT_sec@ */ Scalar_UWORD 0 SWC_FDC_type_CM_uint16_sec 0.0 65535.0 /end CHARACTERISTIC
/begin CHARACTERISTIC KTHC_AirIntUpdateT_sec "" VALUE 0x0000 /* @ECU_Address@KTHC_AirIntUpdateT_sec@ */ Scalar_UWORD 0 SWC_FDC_type_CM_uint16_sec 0.0 65535.0 /end CHARACTERISTIC
/begin CHARACTERISTIC KTHC_RecyChange_min "" VALUE 0x0000 /* @ECU_Address@KTHC_RecyChange_min@ */ Scalar_UWORD 0 SWC_FDC_type_CM_uint16_min 0.0 65535.0 /end CHARACTERISTIC
/begin CHARACTERISTIC KTHC_RecyHold_min "" VALUE 0x0000 /* @ECU_Address@KTHC_RecyHold_min@ */ Scalar_UWORD 0 SWC_FDC_type_CM_uint16_min 0.0 65535.0 /end CHARACTERISTIC
/begin CHARACTERISTIC KTHC_RecyOutterD_enum "" VALUE 0x0000 /* @ECU_Address@KTHC_RecyOutterD_enum@ */ Scalar_UWORD 0 SWC_FDC_type_CM_uint16_enum 0.0 4.0 /end CHARACTERISTIC
/begin CHARACTERISTIC KACC_HVPwrAvail4THCM_W_ovrdflg "" VALUE 0x0000 /* @ECU_Address@KACC_HVPwrAvail4THCM_W_ovrdflg@ */ Scalar_BOOLEAN 0 SWC_FDC_type_CM_boolean_flg 0.0 1.0 /end CHARACTERISTIC
/begin CHARACTERISTIC KACC_HVTHCMSysAvail_enum_ovrdflg "" VALUE 0x0000 /* @ECU_Address@KACC_HVTHCMSysAvail_enum_ovrdflg@ */ Scalar_BOOLEAN 0 SWC_FDC_type_CM_boolean_flg 0.0 1.0 /end CHARACTERISTIC
/begin CHARACTERISTIC KACC_RsvPwr4DCDCTHCM_ovrdflg "" VALUE 0x0000 /* @ECU_Address@KACC_RsvPwr4DCDCTHCM_ovrdflg@ */ Scalar_BOOLEAN 0 SWC_FDC_type_CM_boolean_flg 0.0 1.0 /end CHARACTERISTIC
/begin CHARACTERISTIC KACC_SysPwrAvailDchrg_ovrdflg "" VALUE 0x0000 /* @ECU_Address@KACC_SysPwrAvailDchrg_ovrdflg@ */ Scalar_BOOLEAN 0 SWC_FDC_type_CM_boolean_flg 0.0 1.0 /end CHARACTERISTIC
/begin CHARACTERISTIC KBCM_APMDoorCtrlSta_flg_ovrdflg "" VALUE 0x0000 /* @ECU_Address@KBCM_APMDoorCtrlSta_flg_ovrdflg@ */ Scalar_BOOLEAN 0 SWC_FDC_type_CM_boolean_flg 0.0 1.0 /end CHARACTERISTIC
/begin CHARACTERISTIC KBCM_APMDoorCtrlSta_flg_ovrdval "" VALUE 0x0000 /* @ECU_Address@KBCM_APMDoorCtrlSta_flg_ovrdval@ */ Scalar_BOOLEAN 0 SWC_FDC_type_CM_boolean_flg 0.0 1.0 /end CHARACTERISTIC
/begin CHARACTERISTIC KBCM_AmbTempCtrlEN_flg "" VALUE 0x0000 /* @ECU_Address@KBCM_AmbTempCtrlEN_flg@ */ Scalar_BOOLEAN 0 SWC_FDC_type_CM_boolean_flg 0.0 1.0 /end CHARACTERISTIC
/begin CHARACTERISTIC KBCM_DelayTSW_flg "" VALUE 0x0000 /* @ECU_Address@KBCM_DelayTSW_flg@ */ Scalar_BOOLEAN 0 SWC_FDC_type_CM_boolean_flg 0.0 1.0 /end CHARACTERISTIC
/begin CHARACTERISTIC KBCM_DiagDRLOFF_flg "" VALUE 0x0000 /* @ECU_Address@KBCM_DiagDRLOFF_flg@ */ Scalar_BOOLEAN 0 SWC_FDC_type_CM_boolean_flg 0.0 1.0 /end CHARACTERISTIC
/begin CHARACTERISTIC KBCM_RightHandDriveEN_flg "" VALUE 0x0000 /* @ECU_Address@KBCM_RightHandDriveEN_flg@ */ Scalar_BOOLEAN 0 SWC_FDC_type_CM_boolean_flg 0.0 1.0 /end CHARACTERISTIC
/begin CHARACTERISTIC KBCM_SPTGLeave_flg "" VALUE 0x0000 /* @ECU_Address@KBCM_SPTGLeave_flg@ */ Scalar_BOOLEAN 0 SWC_FDC_type_CM_boolean_flg 0.0 1.0 /end CHARACTERISTIC
/begin CHARACTERISTIC KBCM_SPTGZoneRejectEN_flg "" VALUE 0x0000 /* @ECU_Address@KBCM_SPTGZoneRejectEN_flg@ */ Scalar_BOOLEAN 0 SWC_FDC_type_CM_boolean_flg 0.0 1.0 /end CHARACTERISTIC
/begin CHARACTERISTIC KBCM_TurnLPErrEN_flg "" VALUE 0x0000 /* @ECU_Address@KBCM_TurnLPErrEN_flg@ */ Scalar_BOOLEAN 0 SWC_FDC_type_CM_boolean_flg 0.0 1.0 /end CHARACTERISTIC
/begin CHARACTERISTIC KDKC_APSStaSystem_enum_ovrdflg "" VALUE 0x0000 /* @ECU_Address@KDKC_APSStaSystem_enum_ovrdflg@ */ Scalar_BOOLEAN 0 SWC_FDC_type_CM_boolean_flg 0.0 1.0 /end CHARACTERISTIC
/begin CHARACTERISTIC KDKC_BTConnectSta_enum_ovrdflg "" VALUE 0x0000 /* @ECU_Address@KDKC_BTConnectSta_enum_ovrdflg@ */ Scalar_BOOLEAN 0 SWC_FDC_type_CM_boolean_flg 0.0 1.0 /end CHARACTERISTIC
/begin CHARACTERISTIC KDKC_DKCBTRSSI_dB_ovrdflg "" VALUE 0x0000 /* @ECU_Address@KDKC_DKCBTRSSI_dB_ovrdflg@ */ Scalar_BOOLEAN 0 SWC_FDC_type_CM_boolean_flg 0.0 1.0 /end CHARACTERISTIC
/begin CHARACTERISTIC KDKC_FDCKeyAllowSleep_flg_ovrdflg "" VALUE 0x0000 /* @ECU_Address@KDKC_FDCKeyAllowSleep_flg_ovrdflg@ */ Scalar_BOOLEAN 0 SWC_FDC_type_CM_boolean_flg 0.0 1.0 /end CHARACTERISTIC
/begin CHARACTERISTIC KDKC_FDCKeyAllowSleep_flg_ovrdval "" VALUE 0x0000 /* @ECU_Address@KDKC_FDCKeyAllowSleep_flg_ovrdval@ */ Scalar_BOOLEAN 0 SWC_FDC_type_CM_boolean_flg 0.0 1.0 /end CHARACTERISTIC
/begin CHARACTERISTIC KDKC_KeyMissStaSW_ovrdflg "" VALUE 0x0000 /* @ECU_Address@KDKC_KeyMissStaSW_ovrdflg@ */ Scalar_BOOLEAN 0 SWC_FDC_type_CM_boolean_flg 0.0 1.0 /end CHARACTERISTIC
/begin CHARACTERISTIC KDKC_KeyMissStaSW_ovrdval "" VALUE 0x0000 /* @ECU_Address@KDKC_KeyMissStaSW_ovrdval@ */ Scalar_BOOLEAN 0 SWC_FDC_type_CM_boolean_flg 0.0 1.0 /end CHARACTERISTIC
/begin CHARACTERISTIC KDKC_KeyModeSw_flg "" VALUE 0x0000 /* @ECU_Address@KDKC_KeyModeSw_flg@ */ Scalar_BOOLEAN 0 SWC_FDC_type_CM_boolean_flg 0.0 1.0 /end CHARACTERISTIC
/begin CHARACTERISTIC KDKC_KeyUWBDetArea_enum_ovrdflg "" VALUE 0x0000 /* @ECU_Address@KDKC_KeyUWBDetArea_enum_ovrdflg@ */ Scalar_BOOLEAN 0 SWC_FDC_type_CM_boolean_flg 0.0 1.0 /end CHARACTERISTIC
/begin CHARACTERISTIC KDKC_KeyUWBDetPTGArea_enum_ovrdflg "" VALUE 0x0000 /* @ECU_Address@KDKC_KeyUWBDetPTGArea_enum_ovrdflg@ */ Scalar_BOOLEAN 0 SWC_FDC_type_CM_boolean_flg 0.0 1.0 /end CHARACTERISTIC
/begin CHARACTERISTIC KDKC_KeyUWBDetRAPSArea_enum_ovrdflg "" VALUE 0x0000 /* @ECU_Address@KDKC_KeyUWBDetRAPSArea_enum_ovrdflg@ */ Scalar_BOOLEAN 0 SWC_FDC_type_CM_boolean_flg 0.0 1.0 /end CHARACTERISTIC
/begin CHARACTERISTIC KDKC_KeyUWBDetSPTGArea_enum_ovrdflg "" VALUE 0x0000 /* @ECU_Address@KDKC_KeyUWBDetSPTGArea_enum_ovrdflg@ */ Scalar_BOOLEAN 0 SWC_FDC_type_CM_boolean_flg 0.0 1.0 /end CHARACTERISTIC
/begin CHARACTERISTIC KDKC_StoreUnlockAreaSW_ovrdflg "" VALUE 0x0000 /* @ECU_Address@KDKC_StoreUnlockAreaSW_ovrdflg@ */ Scalar_BOOLEAN 0 SWC_FDC_type_CM_boolean_flg 0.0 1.0 /end CHARACTERISTIC
/begin CHARACTERISTIC KDKC_StoreUnlockAreaSW_ovrdval "" VALUE 0x0000 /* @ECU_Address@KDKC_StoreUnlockAreaSW_ovrdval@ */ Scalar_BOOLEAN 0 SWC_FDC_type_CM_boolean_flg 0.0 1.0 /end CHARACTERISTIC
/begin CHARACTERISTIC KDKC_UIDBTStaBSWInpSW_ovrdflg "" VALUE 0x0000 /* @ECU_Address@KDKC_UIDBTStaBSWInpSW_ovrdflg@ */ Scalar_BOOLEAN 0 SWC_FDC_type_CM_boolean_flg 0.0 1.0 /end CHARACTERISTIC
/begin CHARACTERISTIC KDKC_UIDBatVoltx1000_V_ovrdflg "" VALUE 0x0000 /* @ECU_Address@KDKC_UIDBatVoltx1000_V_ovrdflg@ */ Scalar_BOOLEAN 0 SWC_FDC_type_CM_boolean_flg 0.0 1.0 /end CHARACTERISTIC
/begin CHARACTERISTIC KDKC_UIDRSSIBSWtInpSW_ovrdflg "" VALUE 0x0000 /* @ECU_Address@KDKC_UIDRSSIBSWtInpSW_ovrdflg@ */ Scalar_BOOLEAN 0 SWC_FDC_type_CM_boolean_flg 0.0 1.0 /end CHARACTERISTIC
/begin CHARACTERISTIC KDKC_UIDVolBSWtInpSW_ovrdflg "" VALUE 0x0000 /* @ECU_Address@KDKC_UIDVolBSWtInpSW_ovrdflg@ */ Scalar_BOOLEAN 0 SWC_FDC_type_CM_boolean_flg 0.0 1.0 /end CHARACTERISTIC
/begin CHARACTERISTIC KDKC_UnavToUnlReqSW_ovrdflg "" VALUE 0x0000 /* @ECU_Address@KDKC_UnavToUnlReqSW_ovrdflg@ */ Scalar_BOOLEAN 0 SWC_FDC_type_CM_boolean_flg 0.0 1.0 /end CHARACTERISTIC
/begin CHARACTERISTIC KDKC_UnavToUnlReqSW_ovrdval "" VALUE 0x0000 /* @ECU_Address@KDKC_UnavToUnlReqSW_ovrdval@ */ Scalar_BOOLEAN 0 SWC_FDC_type_CM_boolean_flg 0.0 1.0 /end CHARACTERISTIC
/begin CHARACTERISTIC KDKC_UserReqRAPSLatch_flg_ovrdflg "" VALUE 0x0000 /* @ECU_Address@KDKC_UserReqRAPSLatch_flg_ovrdflg@ */ Scalar_BOOLEAN 0 SWC_FDC_type_CM_boolean_flg 0.0 1.0 /end CHARACTERISTIC
/begin CHARACTERISTIC KDKC_UserReqRAPSLatch_flg_ovrdval "" VALUE 0x0000 /* @ECU_Address@KDKC_UserReqRAPSLatch_flg_ovrdval@ */ Scalar_BOOLEAN 0 SWC_FDC_type_CM_boolean_flg 0.0 1.0 /end CHARACTERISTIC
/begin CHARACTERISTIC KDSC_AccPedalOvrd_flg "" VALUE 0x0000 /* @ECU_Address@KDSC_AccPedalOvrd_flg@ */ Scalar_BOOLEAN 0 SWC_FDC_type_CM_boolean_flg 0.0 1.0 /end CHARACTERISTIC
/begin CHARACTERISTIC KDSC_BrkPedalOvrd_flg "" VALUE 0x0000 /* @ECU_Address@KDSC_BrkPedalOvrd_flg@ */ Scalar_BOOLEAN 0 SWC_FDC_type_CM_boolean_flg 0.0 1.0 /end CHARACTERISTIC
/begin CHARACTERISTIC KINP_DISCButtReq_flg_ovrdflg "" VALUE 0x0000 /* @ECU_Address@KINP_DISCButtReq_flg_ovrdflg@ */ Scalar_BOOLEAN 0 SWC_FDC_type_CM_boolean_flg 0.0 1.0 /end CHARACTERISTIC
/begin CHARACTERISTIC KINP_DISCButtReq_flg_ovrdval "" VALUE 0x0000 /* @ECU_Address@KINP_DISCButtReq_flg_ovrdval@ */ Scalar_BOOLEAN 0 SWC_FDC_type_CM_boolean_flg 0.0 1.0 /end CHARACTERISTIC
/begin CHARACTERISTIC KPMM_BattUpResetSW_flg "" VALUE 0x0000 /* @ECU_Address@KPMM_BattUpResetSW_flg@ */ Scalar_BOOLEAN 0 SWC_FDC_type_CM_boolean_flg 0.0 1.0 /end CHARACTERISTIC
/begin CHARACTERISTIC KPMM_DrivetrainSelect_enum_ovrdflg "" VALUE 0x0000 /* @ECU_Address@KPMM_DrivetrainSelect_enum_ovrdflg@ */ Scalar_BOOLEAN 0 SWC_FDC_type_CM_boolean_flg 0.0 1.0 /end CHARACTERISTIC
/begin CHARACTERISTIC KPMM_LVChrgCurrMthd_flg "" VALUE 0x0000 /* @ECU_Address@KPMM_LVChrgCurrMthd_flg@ */ Scalar_BOOLEAN 0 SWC_FDC_type_CM_boolean_flg 0.0 1.0 /end CHARACTERISTIC
/begin CHARACTERISTIC KPMM_LVChrgVSetSW_flg "" VALUE 0x0000 /* @ECU_Address@KPMM_LVChrgVSetSW_flg@ */ Scalar_BOOLEAN 0 SWC_FDC_type_CM_boolean_flg 0.0 1.0 /end CHARACTERISTIC
/begin CHARACTERISTIC KPMM_OFFStaByPassLVBatt_flg "" VALUE 0x0000 /* @ECU_Address@KPMM_OFFStaByPassLVBatt_flg@ */ Scalar_BOOLEAN 0 SWC_FDC_type_CM_boolean_flg 0.0 1.0 /end CHARACTERISTIC
/begin CHARACTERISTIC KPMM_SilentChrgReq_flg_ovrdflg "" VALUE 0x0000 /* @ECU_Address@KPMM_SilentChrgReq_flg_ovrdflg@ */ Scalar_BOOLEAN 0 SWC_FDC_type_CM_boolean_flg 0.0 1.0 /end CHARACTERISTIC
/begin CHARACTERISTIC KPMM_SilentChrgReq_flg_ovrdval "" VALUE 0x0000 /* @ECU_Address@KPMM_SilentChrgReq_flg_ovrdval@ */ Scalar_BOOLEAN 0 SWC_FDC_type_CM_boolean_flg 0.0 1.0 /end CHARACTERISTIC
/begin CHARACTERISTIC KTHC_DriverSeatPos_flg "" VALUE 0x0000 /* @ECU_Address@KTHC_DriverSeatPos_flg@ */ Scalar_BOOLEAN 0 SWC_FDC_type_CM_boolean_flg 0.0 1.0 /end CHARACTERISTIC
/begin CHARACTERISTIC KTHC_RefreshEN_flg "" VALUE 0x0000 /* @ECU_Address@KTHC_RefreshEN_flg@ */ Scalar_BOOLEAN 0 SWC_FDC_type_CM_boolean_flg 0.0 1.0 /end CHARACTERISTIC
/begin CHARACTERISTIC KTHC_ScreenUniq_flg "" VALUE 0x0000 /* @ECU_Address@KTHC_ScreenUniq_flg@ */ Scalar_BOOLEAN 0 SWC_FDC_type_CM_boolean_flg 0.0 1.0 /end CHARACTERISTIC
/begin CHARACTERISTIC KTHC_WDZ10Face_flg "" VALUE 0x0000 /* @ECU_Address@KTHC_WDZ10Face_flg@ */ Scalar_BOOLEAN 0 SWC_FDC_type_CM_boolean_flg 0.0 1.0 /end CHARACTERISTIC
/begin CHARACTERISTIC KTHC_WDZ10Foot_flg "" VALUE 0x0000 /* @ECU_Address@KTHC_WDZ10Foot_flg@ */ Scalar_BOOLEAN 0 SWC_FDC_type_CM_boolean_flg 0.0 1.0 /end CHARACTERISTIC
/begin CHARACTERISTIC KTHC_WDZ10Frost_flg "" VALUE 0x0000 /* @ECU_Address@KTHC_WDZ10Frost_flg@ */ Scalar_BOOLEAN 0 SWC_FDC_type_CM_boolean_flg 0.0 1.0 /end CHARACTERISTIC
/begin CHARACTERISTIC KTHC_WDZ1Face_flg "" VALUE 0x0000 /* @ECU_Address@KTHC_WDZ1Face_flg@ */ Scalar_BOOLEAN 0 SWC_FDC_type_CM_boolean_flg 0.0 1.0 /end CHARACTERISTIC
/begin CHARACTERISTIC KTHC_WDZ1Foot_flg "" VALUE 0x0000 /* @ECU_Address@KTHC_WDZ1Foot_flg@ */ Scalar_BOOLEAN 0 SWC_FDC_type_CM_boolean_flg 0.0 1.0 /end CHARACTERISTIC
/begin CHARACTERISTIC KTHC_WDZ1Frost_flg "" VALUE 0x0000 /* @ECU_Address@KTHC_WDZ1Frost_flg@ */ Scalar_BOOLEAN 0 SWC_FDC_type_CM_boolean_flg 0.0 1.0 /end CHARACTERISTIC
/begin CHARACTERISTIC KTHC_WDZ2Face_flg "" VALUE 0x0000 /* @ECU_Address@KTHC_WDZ2Face_flg@ */ Scalar_BOOLEAN 0 SWC_FDC_type_CM_boolean_flg 0.0 1.0 /end CHARACTERISTIC
/begin CHARACTERISTIC KTHC_WDZ2Foot_flg "" VALUE 0x0000 /* @ECU_Address@KTHC_WDZ2Foot_flg@ */ Scalar_BOOLEAN 0 SWC_FDC_type_CM_boolean_flg 0.0 1.0 /end CHARACTERISTIC
/begin CHARACTERISTIC KTHC_WDZ2Frost_flg "" VALUE 0x0000 /* @ECU_Address@KTHC_WDZ2Frost_flg@ */ Scalar_BOOLEAN 0 SWC_FDC_type_CM_boolean_flg 0.0 1.0 /end CHARACTERISTIC
/begin CHARACTERISTIC KTHC_WDZ3Face_flg "" VALUE 0x0000 /* @ECU_Address@KTHC_WDZ3Face_flg@ */ Scalar_BOOLEAN 0 SWC_FDC_type_CM_boolean_flg 0.0 1.0 /end CHARACTERISTIC
/begin CHARACTERISTIC KTHC_WDZ3Foot_flg "" VALUE 0x0000 /* @ECU_Address@KTHC_WDZ3Foot_flg@ */ Scalar_BOOLEAN 0 SWC_FDC_type_CM_boolean_flg 0.0 1.0 /end CHARACTERISTIC
/begin CHARACTERISTIC KTHC_WDZ3Frost_flg "" VALUE 0x0000 /* @ECU_Address@KTHC_WDZ3Frost_flg@ */ Scalar_BOOLEAN 0 SWC_FDC_type_CM_boolean_flg 0.0 1.0 /end CHARACTERISTIC
/begin CHARACTERISTIC KTHC_WDZ4Face_flg "" VALUE 0x0000 /* @ECU_Address@KTHC_WDZ4Face_flg@ */ Scalar_BOOLEAN 0 SWC_FDC_type_CM_boolean_flg 0.0 1.0 /end CHARACTERISTIC
/begin CHARACTERISTIC KTHC_WDZ4Foot_flg "" VALUE 0x0000 /* @ECU_Address@KTHC_WDZ4Foot_flg@ */ Scalar_BOOLEAN 0 SWC_FDC_type_CM_boolean_flg 0.0 1.0 /end CHARACTERISTIC
/begin CHARACTERISTIC KTHC_WDZ4Frost_flg "" VALUE 0x0000 /* @ECU_Address@KTHC_WDZ4Frost_flg@ */ Scalar_BOOLEAN 0 SWC_FDC_type_CM_boolean_flg 0.0 1.0 /end CHARACTERISTIC
/begin CHARACTERISTIC KTHC_WDZ5Face_flg "" VALUE 0x0000 /* @ECU_Address@KTHC_WDZ5Face_flg@ */ Scalar_BOOLEAN 0 SWC_FDC_type_CM_boolean_flg 0.0 1.0 /end CHARACTERISTIC
/begin CHARACTERISTIC KTHC_WDZ5Foot_flg "" VALUE 0x0000 /* @ECU_Address@KTHC_WDZ5Foot_flg@ */ Scalar_BOOLEAN 0 SWC_FDC_type_CM_boolean_flg 0.0 1.0 /end CHARACTERISTIC
/begin CHARACTERISTIC KTHC_WDZ5Frost_flg "" VALUE 0x0000 /* @ECU_Address@KTHC_WDZ5Frost_flg@ */ Scalar_BOOLEAN 0 SWC_FDC_type_CM_boolean_flg 0.0 1.0 /end CHARACTERISTIC
/begin CHARACTERISTIC KTHC_WDZ6Face_flg "" VALUE 0x0000 /* @ECU_Address@KTHC_WDZ6Face_flg@ */ Scalar_BOOLEAN 0 SWC_FDC_type_CM_boolean_flg 0.0 1.0 /end CHARACTERISTIC
/begin CHARACTERISTIC KTHC_WDZ6Foot_flg "" VALUE 0x0000 /* @ECU_Address@KTHC_WDZ6Foot_flg@ */ Scalar_BOOLEAN 0 SWC_FDC_type_CM_boolean_flg 0.0 1.0 /end CHARACTERISTIC
/begin CHARACTERISTIC KTHC_WDZ6Frost_flg "" VALUE 0x0000 /* @ECU_Address@KTHC_WDZ6Frost_flg@ */ Scalar_BOOLEAN 0 SWC_FDC_type_CM_boolean_flg 0.0 1.0 /end CHARACTERISTIC
/begin CHARACTERISTIC KTHC_WDZ7Face_flg "" VALUE 0x0000 /* @ECU_Address@KTHC_WDZ7Face_flg@ */ Scalar_BOOLEAN 0 SWC_FDC_type_CM_boolean_flg 0.0 1.0 /end CHARACTERISTIC
/begin CHARACTERISTIC KTHC_WDZ7Foot_flg "" VALUE 0x0000 /* @ECU_Address@KTHC_WDZ7Foot_flg@ */ Scalar_BOOLEAN 0 SWC_FDC_type_CM_boolean_flg 0.0 1.0 /end CHARACTERISTIC
/begin CHARACTERISTIC KTHC_WDZ7Frost_flg "" VALUE 0x0000 /* @ECU_Address@KTHC_WDZ7Frost_flg@ */ Scalar_BOOLEAN 0 SWC_FDC_type_CM_boolean_flg 0.0 1.0 /end CHARACTERISTIC
/begin CHARACTERISTIC KTHC_WDZ8Face_flg "" VALUE 0x0000 /* @ECU_Address@KTHC_WDZ8Face_flg@ */ Scalar_BOOLEAN 0 SWC_FDC_type_CM_boolean_flg 0.0 1.0 /end CHARACTERISTIC
/begin CHARACTERISTIC KTHC_WDZ8Foot_flg "" VALUE 0x0000 /* @ECU_Address@KTHC_WDZ8Foot_flg@ */ Scalar_BOOLEAN 0 SWC_FDC_type_CM_boolean_flg 0.0 1.0 /end CHARACTERISTIC
/begin CHARACTERISTIC KTHC_WDZ8Frost_flg "" VALUE 0x0000 /* @ECU_Address@KTHC_WDZ8Frost_flg@ */ Scalar_BOOLEAN 0 SWC_FDC_type_CM_boolean_flg 0.0 1.0 /end CHARACTERISTIC
/begin CHARACTERISTIC KTHC_WDZ9Face_flg "" VALUE 0x0000 /* @ECU_Address@KTHC_WDZ9Face_flg@ */ Scalar_BOOLEAN 0 SWC_FDC_type_CM_boolean_flg 0.0 1.0 /end CHARACTERISTIC
/begin CHARACTERISTIC KTHC_WDZ9Foot_flg "" VALUE 0x0000 /* @ECU_Address@KTHC_WDZ9Foot_flg@ */ Scalar_BOOLEAN 0 SWC_FDC_type_CM_boolean_flg 0.0 1.0 /end CHARACTERISTIC
/begin CHARACTERISTIC KTHC_WDZ9Frost_flg "" VALUE 0x0000 /* @ECU_Address@KTHC_WDZ9Frost_flg@ */ Scalar_BOOLEAN 0 SWC_FDC_type_CM_boolean_flg 0.0 1.0 /end CHARACTERISTIC
/begin CHARACTERISTIC KTQD_IVIEscapeModeCmd_flg "" VALUE 0x0000 /* @ECU_Address@KTQD_IVIEscapeModeCmd_flg@ */ Scalar_BOOLEAN 0 SWC_FDC_type_CM_boolean_flg 0.0 1.0 /end CHARACTERISTIC
/begin CHARACTERISTIC KTQD_YawRateSW_flg "" VALUE 0x0000 /* @ECU_Address@KTQD_YawRateSW_flg@ */ Scalar_BOOLEAN 0 SWC_FDC_type_CM_boolean_flg 0.0 1.0 /end CHARACTERISTIC
/begin CHARACTERISTIC KVMC_RDCGySource_flg "" VALUE 0x0000 /* @ECU_Address@KVMC_RDCGySource_flg@ */ Scalar_BOOLEAN 0 SWC_FDC_type_CM_boolean_flg 0.0 1.0 /end CHARACTERISTIC
/begin CHARACTERISTIC KVMC_RDCRzSource_flg "" VALUE 0x0000 /* @ECU_Address@KVMC_RDCRzSource_flg@ */ Scalar_BOOLEAN 0 SWC_FDC_type_CM_boolean_flg 0.0 1.0 /end CHARACTERISTIC
/begin CHARACTERISTIC KVMC_SlideRateGxSource_flg "" VALUE 0x0000 /* @ECU_Address@KVMC_SlideRateGxSource_flg@ */ Scalar_BOOLEAN 0 SWC_FDC_type_CM_boolean_flg 0.0 1.0 /end CHARACTERISTIC
/begin CHARACTERISTIC KDKC_DKCBTRSSI_dB_ovrdval "" VALUE 0x0000 /* @ECU_Address@KDKC_DKCBTRSSI_dB_ovrdval@ */ Scalar_BYTE 0 SWC_FDC_type_CM_int8_dB -128.0 127.0 /end CHARACTERISTIC
/begin CHARACTERISTIC KDKC_JudBTRSSIStrongThres_dB "" VALUE 0x0000 /* @ECU_Address@KDKC_JudBTRSSIStrongThres_dB@ */ Scalar_BYTE 0 SWC_FDC_type_CM_int8_dB -128.0 127.0 /end CHARACTERISTIC
/begin CHARACTERISTIC KDKC_JudBTRSSIWeakThres_dB "" VALUE 0x0000 /* @ECU_Address@KDKC_JudBTRSSIWeakThres_dB@ */ Scalar_BYTE 0 SWC_FDC_type_CM_int8_dB -128.0 127.0 /end CHARACTERISTIC
/begin CHARACTERISTIC KACC_HVTHCMSysAvail_enum_ovrdval "" VALUE 0x0000 /* @ECU_Address@KACC_HVTHCMSysAvail_enum_ovrdval@ */ Scalar_UBYTE 0 SWC_FDC_type_CM_uint8_enum 0.0 3.0 /end CHARACTERISTIC
/begin CHARACTERISTIC KACC_LVBattErrFailtime_s "" VALUE 0x0000 /* @ECU_Address@KACC_LVBattErrFailtime_s@ */ Scalar_UBYTE 0 SWC_FDC_type_CM_uint8_s 0.0 255.0 /end CHARACTERISTIC
/begin CHARACTERISTIC KBCM_ALMBrightnessDark_enum "" VALUE 0x0000 /* @ECU_Address@KBCM_ALMBrightnessDark_enum@ */ Scalar_UBYTE 0 SWC_FDC_type_CM_uint8_enum 0.0 255.0 /end CHARACTERISTIC
/begin CHARACTERISTIC KBCM_AmbBlue_enum "" VALUE 0x0000 /* @ECU_Address@KBCM_AmbBlue_enum@ */ Scalar_UBYTE 0 SWC_FDC_type_CM_uint8_enum 0.0 255.0 /end CHARACTERISTIC
/begin CHARACTERISTIC KBCM_AmbGreen_enum "" VALUE 0x0000 /* @ECU_Address@KBCM_AmbGreen_enum@ */ Scalar_UBYTE 0 SWC_FDC_type_CM_uint8_enum 0.0 255.0 /end CHARACTERISTIC
/begin CHARACTERISTIC KBCM_AmbMidPple_enum "" VALUE 0x0000 /* @ECU_Address@KBCM_AmbMidPple_enum@ */ Scalar_UBYTE 0 SWC_FDC_type_CM_uint8_enum 0.0 255.0 /end CHARACTERISTIC
/begin CHARACTERISTIC KBCM_AmbRed_enum "" VALUE 0x0000 /* @ECU_Address@KBCM_AmbRed_enum@ */ Scalar_UBYTE 0 SWC_FDC_type_CM_uint8_enum 0.0 255.0 /end CHARACTERISTIC
/begin CHARACTERISTIC KBCM_DiagFLTC_mA "" VALUE 0x0000 /* @ECU_Address@KBCM_DiagFLTC_mA@ */ Scalar_UBYTE 0 SWC_FDC_type_CM_uint8_mA 0.0 255.0 /end CHARACTERISTIC
/begin CHARACTERISTIC KBCM_DiagFRTC_mA "" VALUE 0x0000 /* @ECU_Address@KBCM_DiagFRTC_mA@ */ Scalar_UBYTE 0 SWC_FDC_type_CM_uint8_mA 0.0 255.0 /end CHARACTERISTIC
/begin CHARACTERISTIC KBCM_DiagRLTC_mA "" VALUE 0x0000 /* @ECU_Address@KBCM_DiagRLTC_mA@ */ Scalar_UBYTE 0 SWC_FDC_type_CM_uint8_mA 0.0 255.0 /end CHARACTERISTIC
/begin CHARACTERISTIC KBCM_DiagRRTC_mA "" VALUE 0x0000 /* @ECU_Address@KBCM_DiagRRTC_mA@ */ Scalar_UBYTE 0 SWC_FDC_type_CM_uint8_mA 0.0 255.0 /end CHARACTERISTIC
/begin CHARACTERISTIC KBCM_DrAPMRetryTimes_cnt "" VALUE 0x0000 /* @ECU_Address@KBCM_DrAPMRetryTimes_cnt@ */ Scalar_UBYTE 0 SWC_FDC_type_CM_uint8_cnt 0.0 255.0 /end CHARACTERISTIC
/begin CHARACTERISTIC KBCM_RAPSAbnFlashOFFT_ms "" VALUE 0x0000 /* @ECU_Address@KBCM_RAPSAbnFlashOFFT_ms@ */ Scalar_UBYTE 0 SWC_FDC_type_CM_uint8_ms 0.0 255.0 /end CHARACTERISTIC
/begin CHARACTERISTIC KBCM_RAPSAbnFlashONT_ms "" VALUE 0x0000 /* @ECU_Address@KBCM_RAPSAbnFlashONT_ms@ */ Scalar_UBYTE 0 SWC_FDC_type_CM_uint8_ms 0.0 255.0 /end CHARACTERISTIC
/begin CHARACTERISTIC KBCM_SPTGDetectT_sec "" VALUE 0x0000 /* @ECU_Address@KBCM_SPTGDetectT_sec@ */ Scalar_UBYTE 0 SWC_FDC_type_CM_uint8_sec 0.0 255.0 /end CHARACTERISTIC
/begin CHARACTERISTIC KBCM_UserFix_enum "" VALUE 0x0000 /* @ECU_Address@KBCM_UserFix_enum@ */ Scalar_UBYTE 0 SWC_FDC_type_CM_uint8_enum 0.0 255.0 /end CHARACTERISTIC
/begin CHARACTERISTIC KBCM_WaitAPMPwr_K "" VALUE 0x0000 /* @ECU_Address@KBCM_WaitAPMPwr_K@ */ Scalar_UBYTE 0 SWC_FDC_type_CM_uint8_K 0.0 255.0 /end CHARACTERISTIC
/begin CHARACTERISTIC KBCM_WipSensLevelPlus_enum "" VALUE 0x0000 /* @ECU_Address@KBCM_WipSensLevelPlus_enum@ */ Scalar_UBYTE 0 SWC_FDC_type_CM_uint8_enum 0.0 255.0 /end CHARACTERISTIC
/begin CHARACTERISTIC KBCM_WipSensLevel_enum "" VALUE 0x0000 /* @ECU_Address@KBCM_WipSensLevel_enum@ */ Scalar_UBYTE 0 SWC_FDC_type_CM_uint8_enum 0.0 255.0 /end CHARACTERISTIC
/begin CHARACTERISTIC KDKC_APSStaSystem_enum_ovrdval "" VALUE 0x0000 /* @ECU_Address@KDKC_APSStaSystem_enum_ovrdval@ */ Scalar_UBYTE 0 SWC_FDC_type_CM_uint8_enum 0.0 4.0 /end CHARACTERISTIC
/begin CHARACTERISTIC KDKC_BTConnectSta_enum_ovrdval "" VALUE 0x0000 /* @ECU_Address@KDKC_BTConnectSta_enum_ovrdval@ */ Scalar_UBYTE 0 SWC_FDC_type_CM_uint8_enum 0.0 3.0 /end CHARACTERISTIC
/begin CHARACTERISTIC KDKC_InitialTimeErrorAllow_cnt "" VALUE 0x0000 /* @ECU_Address@KDKC_InitialTimeErrorAllow_cnt@ */ Scalar_UBYTE 0 SWC_FDC_type_CM_uint8_cnt 0.0 255.0 /end CHARACTERISTIC
/begin CHARACTERISTIC KDKC_KeyUWBDetArea_enum_ovrdval "" VALUE 0x0000 /* @ECU_Address@KDKC_KeyUWBDetArea_enum_ovrdval@ */ Scalar_UBYTE 0 SWC_FDC_type_CM_uint8_enum 0.0 9.0 /end CHARACTERISTIC
/begin CHARACTERISTIC KDKC_KeyUWBDetPTGArea_enum_ovrdval "" VALUE 0x0000 /* @ECU_Address@KDKC_KeyUWBDetPTGArea_enum_ovrdval@ */ Scalar_UBYTE 0 SWC_FDC_type_CM_uint8_enum 0.0 3.0 /end CHARACTERISTIC
/begin CHARACTERISTIC KDKC_KeyUWBDetRAPSArea_enum_ovrdval "" VALUE 0x0000 /* @ECU_Address@KDKC_KeyUWBDetRAPSArea_enum_ovrdval@ */ Scalar_UBYTE 0 SWC_FDC_type_CM_uint8_enum 0.0 3.0 /end CHARACTERISTIC
/begin CHARACTERISTIC KDKC_KeyUWBDetSPTGArea_enum_ovrdval "" VALUE 0x0000 /* @ECU_Address@KDKC_KeyUWBDetSPTGArea_enum_ovrdval@ */ Scalar_UBYTE 0 SWC_FDC_type_CM_uint8_enum 0.0 3.0 /end CHARACTERISTIC
/begin CHARACTERISTIC KDKC_TimeSNAllowDiff_cnt "" VALUE 0x0000 /* @ECU_Address@KDKC_TimeSNAllowDiff_cnt@ */ Scalar_UBYTE 0 SWC_FDC_type_CM_uint8_cnt 0.0 255.0 /end CHARACTERISTIC
/begin CHARACTERISTIC KPMM_BattUpResetRty_cnt "" VALUE 0x0000 /* @ECU_Address@KPMM_BattUpResetRty_cnt@ */ Scalar_UBYTE 0 SWC_FDC_type_CM_uint8_cnt 0.0 255.0 /end CHARACTERISTIC
/begin CHARACTERISTIC KPMM_DrivetrainSelect_enum_ovrdval "" VALUE 0x0000 /* @ECU_Address@KPMM_DrivetrainSelect_enum_ovrdval@ */ Scalar_UBYTE 0 SWC_FDC_type_CM_uint8_enum 0.0 2.0 /end CHARACTERISTIC
/begin CHARACTERISTIC KPMM_OFFLVBattChkRetry_cnt "" VALUE 0x0000 /* @ECU_Address@KPMM_OFFLVBattChkRetry_cnt@ */ Scalar_UBYTE 0 SWC_FDC_type_CM_uint8_cnt 0.0 100.0 /end CHARACTERISTIC
/begin CHARACTERISTIC KTHC_WindDirUpdateT_min "" VALUE 0x0000 /* @ECU_Address@KTHC_WindDirUpdateT_min@ */ Scalar_UBYTE 0 SWC_FDC_type_CM_uint8_min 0.0 100.0 /end CHARACTERISTIC
/begin CHARACTERISTIC KTQD_BCMUserNowSetting_enum "" VALUE 0x0000 /* @ECU_Address@KTQD_BCMUserNowSetting_enum@ */ Scalar_UBYTE 0 SWC_FDC_type_CM_uint8_enum 0.0 15.0 /end CHARACTERISTIC
/begin MEASUREMENT VDKC_DKCTimeSN_cnt "" ULONG SWC_FDC_type_CM_uint32_cnt 0 0 0.0 4.294967295E+9 ECU_ADDRESS 0x0000 /* @ECU_Address@VDKC_DKCTimeSN_cnt@ */ /end MEASUREMENT
/begin MEASUREMENT VDKC_TimeSNDKCFbk_cnt "" ULONG SWC_FDC_type_CM_uint32_cnt 0 0 0.0 4.294967295E+9 ECU_ADDRESS 0x0000 /* @ECU_Address@VDKC_TimeSNDKCFbk_cnt@ */ /end MEASUREMENT
/begin MEASUREMENT VDSC_DISCTargetSpd_kph "" FLOAT32_IEEE SWC_FDC_type_CM_single_kph 0 0 0.0 250.0 ECU_ADDRESS 0x0000 /* @ECU_Address@VDSC_DISCTargetSpd_kph@ */ /end MEASUREMENT
/begin MEASUREMENT VSYS_FdcSlpTime_sec "" FLOAT32_IEEE SWC_FDC_type_CM_single_sec 0 0 0.0 1.0E+7 ECU_ADDRESS 0x0000 /* @ECU_Address@VSYS_FdcSlpTime_sec@ */ /end MEASUREMENT
/begin MEASUREMENT VTHC_FDFrWPTCHeatPwrCmd_W "" FLOAT32_IEEE SWC_FDC_type_CM_single_W 0 0 0.0 65535.0 ECU_ADDRESS 0x0000 /* @ECU_Address@VTHC_FDFrWPTCHeatPwrCmd_W@ */ /end MEASUREMENT
/begin MEASUREMENT VTHC_CoolgFanActDuty_pct "" FLOAT32_IEEE SWC_FDC_type_CM_single_pct 0 0 0.0 100.0 ECU_ADDRESS 0x0000 /* @ECU_Address@VTHC_CoolgFanActDuty_pct@ */ /end MEASUREMENT
/begin MEASUREMENT VTHC_FDFrLeAPTCHeatPwrCmd_W "" FLOAT32_IEEE SWC_FDC_type_CM_single_W 0 0 0.0 6375.0 ECU_ADDRESS 0x0000 /* @ECU_Address@VTHC_FDFrLeAPTCHeatPwrCmd_W@ */ /end MEASUREMENT
/begin MEASUREMENT VTHC_FDFrRiAPTCHeatPwrCmd_W "" FLOAT32_IEEE SWC_FDC_type_CM_single_W 0 0 0.0 6375.0 ECU_ADDRESS 0x0000 /* @ECU_Address@VTHC_FDFrRiAPTCHeatPwrCmd_W@ */ /end MEASUREMENT
/begin MEASUREMENT VTHC_FDRrAPTCHeatPwrCmd_W "" FLOAT32_IEEE SWC_FDC_type_CM_single_W 0 0 0.0 6375.0 ECU_ADDRESS 0x0000 /* @ECU_Address@VTHC_FDRrAPTCHeatPwrCmd_W@ */ /end MEASUREMENT
/begin MEASUREMENT VTHC_FDBlowerCmd_pct "" FLOAT32_IEEE SWC_FDC_type_CM_single_pct 0 0 0.0 100.0 ECU_ADDRESS 0x0000 /* @ECU_Address@VTHC_FDBlowerCmd_pct@ */ /end MEASUREMENT
/begin MEASUREMENT VTHC_sigSetTempZon2St_C "" FLOAT32_IEEE SWC_FDC_type_CM_single_C 0 0 17.0 32.0 ECU_ADDRESS 0x0000 /* @ECU_Address@VTHC_sigSetTempZon2St_C@ */ /end MEASUREMENT
/begin MEASUREMENT VTHC_sigClntTHvBattOut_C "" FLOAT32_IEEE SWC_FDC_type_CM_single_C 0 0 -40.0 85.0 ECU_ADDRESS 0x0000 /* @ECU_Address@VTHC_sigClntTHvBattOut_C@ */ /end MEASUREMENT
/begin MEASUREMENT VTHC_sigCbnSolarLeft_W "" FLOAT32_IEEE SWC_FDC_type_CM_single_W 0 0 0.0 1265.0 ECU_ADDRESS 0x0000 /* @ECU_Address@VTHC_sigCbnSolarLeft_W@ */ /end MEASUREMENT
/begin MEASUREMENT VTHC_sigClntTHvBattIn_C "" FLOAT32_IEEE SWC_FDC_type_CM_single_C 0 0 -40.0 85.0 ECU_ADDRESS 0x0000 /* @ECU_Address@VTHC_sigClntTHvBattIn_C@ */ /end MEASUREMENT
/begin MEASUREMENT VTHC_sigCbnSolarRight_W "" FLOAT32_IEEE SWC_FDC_type_CM_single_W 0 0 0.0 1265.0 ECU_ADDRESS 0x0000 /* @ECU_Address@VTHC_sigCbnSolarRight_W@ */ /end MEASUREMENT
/begin MEASUREMENT VTHC_sigAmbAirT_C "" FLOAT32_IEEE SWC_FDC_type_CM_single_C 0 0 -40.0 85.0 ECU_ADDRESS 0x0000 /* @ECU_Address@VTHC_sigAmbAirT_C@ */ /end MEASUREMENT
/begin MEASUREMENT VTHC_sigCbnAirT_C "" FLOAT32_IEEE SWC_FDC_type_CM_single_C 0 0 -40.0 85.0 ECU_ADDRESS 0x0000 /* @ECU_Address@VTHC_sigCbnAirT_C@ */ /end MEASUREMENT
/begin MEASUREMENT VTHC_CompP_K "" FLOAT32_IEEE SWC_FDC_type_CM_single_K 0 0 -10000.0 10000.0 ECU_ADDRESS 0x0000 /* @ECU_Address@VTHC_CompP_K@ */ /end MEASUREMENT
/begin MEASUREMENT VTHC_CompI_K "" FLOAT32_IEEE SWC_FDC_type_CM_single_K 0 0 -10000.0 10000.0 ECU_ADDRESS 0x0000 /* @ECU_Address@VTHC_CompI_K@ */ /end MEASUREMENT
/begin MEASUREMENT VTHC_CompU_K "" FLOAT32_IEEE SWC_FDC_type_CM_single_K 0 0 -10000.0 10000.0 ECU_ADDRESS 0x0000 /* @ECU_Address@VTHC_CompU_K@ */ /end MEASUREMENT
/begin MEASUREMENT VTHC_CompDeltaU_K "" FLOAT32_IEEE SWC_FDC_type_CM_single_K 0 0 -10000.0 10000.0 ECU_ADDRESS 0x0000 /* @ECU_Address@VTHC_CompDeltaU_K@ */ /end MEASUREMENT
/begin MEASUREMENT VTHC_Compe_K "" FLOAT32_IEEE SWC_FDC_type_CM_single_K 0 0 -10000.0 10000.0 ECU_ADDRESS 0x0000 /* @ECU_Address@VTHC_Compe_K@ */ /end MEASUREMENT
/begin MEASUREMENT VTHC_Blowere_K "" FLOAT32_IEEE SWC_FDC_type_CM_single_K 0 0 -10000.0 10000.0 ECU_ADDRESS 0x0000 /* @ECU_Address@VTHC_Blowere_K@ */ /end MEASUREMENT
/begin MEASUREMENT VTHC_BlowerP_K "" FLOAT32_IEEE SWC_FDC_type_CM_single_K 0 0 -10000.0 10000.0 ECU_ADDRESS 0x0000 /* @ECU_Address@VTHC_BlowerP_K@ */ /end MEASUREMENT
/begin MEASUREMENT VTHC_BlowerU_K "" FLOAT32_IEEE SWC_FDC_type_CM_single_K 0 0 -10000.0 10000.0 ECU_ADDRESS 0x0000 /* @ECU_Address@VTHC_BlowerU_K@ */ /end MEASUREMENT
/begin MEASUREMENT VTHC_Vbase_pct "" FLOAT32_IEEE SWC_FDC_type_CM_single_pct 0 0 -10000.0 10000.0 ECU_ADDRESS 0x0000 /* @ECU_Address@VTHC_Vbase_pct@ */ /end MEASUREMENT
/begin MEASUREMENT VTHC_BlowerI_K "" FLOAT32_IEEE SWC_FDC_type_CM_single_K 0 0 -10000.0 10000.0 ECU_ADDRESS 0x0000 /* @ECU_Address@VTHC_BlowerI_K@ */ /end MEASUREMENT
/begin MEASUREMENT VTHC_EXV2P_K "" FLOAT32_IEEE SWC_FDC_type_CM_single_K 0 0 -10000.0 10000.0 ECU_ADDRESS 0x0000 /* @ECU_Address@VTHC_EXV2P_K@ */ /end MEASUREMENT
/begin MEASUREMENT VTHC_EXV2I_K "" FLOAT32_IEEE SWC_FDC_type_CM_single_K 0 0 -10000.0 10000.0 ECU_ADDRESS 0x0000 /* @ECU_Address@VTHC_EXV2I_K@ */ /end MEASUREMENT
/begin MEASUREMENT VTHC_EXV2U_K "" FLOAT32_IEEE SWC_FDC_type_CM_single_K 0 0 -10000.0 10000.0 ECU_ADDRESS 0x0000 /* @ECU_Address@VTHC_EXV2U_K@ */ /end MEASUREMENT
/begin MEASUREMENT VTHC_EXV2e_K "" FLOAT32_IEEE SWC_FDC_type_CM_single_K 0 0 -10000.0 10000.0 ECU_ADDRESS 0x0000 /* @ECU_Address@VTHC_EXV2e_K@ */ /end MEASUREMENT
/begin MEASUREMENT VTHC_APTCP_K "" FLOAT32_IEEE SWC_FDC_type_CM_single_K 0 0 -10000.0 10000.0 ECU_ADDRESS 0x0000 /* @ECU_Address@VTHC_APTCP_K@ */ /end MEASUREMENT
/begin MEASUREMENT VTHC_APTCI_K "" FLOAT32_IEEE SWC_FDC_type_CM_single_K 0 0 -10000.0 10000.0 ECU_ADDRESS 0x0000 /* @ECU_Address@VTHC_APTCI_K@ */ /end MEASUREMENT
/begin MEASUREMENT VTHC_APTCU_K "" FLOAT32_IEEE SWC_FDC_type_CM_single_K 0 0 -10000.0 10000.0 ECU_ADDRESS 0x0000 /* @ECU_Address@VTHC_APTCU_K@ */ /end MEASUREMENT
/begin MEASUREMENT VTHC_APTCe_K "" FLOAT32_IEEE SWC_FDC_type_CM_single_K 0 0 -10000.0 10000.0 ECU_ADDRESS 0x0000 /* @ECU_Address@VTHC_APTCe_K@ */ /end MEASUREMENT
/begin MEASUREMENT VTHC_EXV1P_K "" FLOAT32_IEEE SWC_FDC_type_CM_single_K 0 0 -10000.0 10000.0 ECU_ADDRESS 0x0000 /* @ECU_Address@VTHC_EXV1P_K@ */ /end MEASUREMENT
/begin MEASUREMENT VTHC_EXV1I_K "" FLOAT32_IEEE SWC_FDC_type_CM_single_K 0 0 -10000.0 10000.0 ECU_ADDRESS 0x0000 /* @ECU_Address@VTHC_EXV1I_K@ */ /end MEASUREMENT
/begin MEASUREMENT VTHC_EXV1U_K "" FLOAT32_IEEE SWC_FDC_type_CM_single_K 0 0 -10000.0 10000.0 ECU_ADDRESS 0x0000 /* @ECU_Address@VTHC_EXV1U_K@ */ /end MEASUREMENT
/begin MEASUREMENT VTHC_EXV1e_K "" FLOAT32_IEEE SWC_FDC_type_CM_single_K 0 0 -10000.0 10000.0 ECU_ADDRESS 0x0000 /* @ECU_Address@VTHC_EXV1e_K@ */ /end MEASUREMENT
/begin MEASUREMENT VVMC_ACCObjDist_m "" FLOAT32_IEEE SWC_FDC_type_CM_single_m 0 0 0.0 204.6 ECU_ADDRESS 0x0000 /* @ECU_Address@VVMC_ACCObjDist_m@ */ /end MEASUREMENT
/begin MEASUREMENT VVMC_ACCObjRelSpd_mps "" FLOAT32_IEEE SWC_FDC_type_CM_single_mps 0 0 -100.0 104.6 ECU_ADDRESS 0x0000 /* @ECU_Address@VVMC_ACCObjRelSpd_mps@ */ /end MEASUREMENT
/begin MEASUREMENT VVMC_ACCJerkUpperLimit_mps3 "" FLOAT32_IEEE SWC_FDC_type_CM_single_mps3 0 0 -6.0 6.7 ECU_ADDRESS 0x0000 /* @ECU_Address@VVMC_ACCJerkUpperLimit_mps3@ */ /end MEASUREMENT
/begin MEASUREMENT VVMC_ACCComfortBandUpper_mps2 "" FLOAT32_IEEE SWC_FDC_type_CM_single_mps2 0 0 -15.0 10.55 ECU_ADDRESS 0x0000 /* @ECU_Address@VVMC_ACCComfortBandUpper_mps2@ */ /end MEASUREMENT
/begin MEASUREMENT VVMC_ACCJerkLowerLimit_mps3 "" FLOAT32_IEEE SWC_FDC_type_CM_single_mps3 0 0 -6.0 6.7 ECU_ADDRESS 0x0000 /* @ECU_Address@VVMC_ACCJerkLowerLimit_mps3@ */ /end MEASUREMENT
/begin MEASUREMENT VVMC_ACCComfortBandLower_mps2 "" FLOAT32_IEEE SWC_FDC_type_CM_single_mps2 0 0 -15.0 10.55 ECU_ADDRESS 0x0000 /* @ECU_Address@VVMC_ACCComfortBandLower_mps2@ */ /end MEASUREMENT
/begin MEASUREMENT VVMC_ADASVehSpdLim_raw32 "" FLOAT32_IEEE SWC_FDC_type_CM_single_raw32 0 0 0.0 254.0 ECU_ADDRESS 0x0000 /* @ECU_Address@VVMC_ADASVehSpdLim_raw32@ */ /end MEASUREMENT
/begin MEASUREMENT VVMC_ADASLanecurveL_raw32 "" FLOAT32_IEEE SWC_FDC_type_CM_single_raw32 0 0 -0.03 0.03 ECU_ADDRESS 0x0000 /* @ECU_Address@VVMC_ADASLanecurveL_raw32@ */ /end MEASUREMENT
/begin MEASUREMENT VVMC_ADASLanecurveR_raw32 "" FLOAT32_IEEE SWC_FDC_type_CM_single_raw32 0 0 -0.03 0.03 ECU_ADDRESS 0x0000 /* @ECU_Address@VVMC_ADASLanecurveR_raw32@ */ /end MEASUREMENT
/begin MEASUREMENT VACC_VehHVPwrAvail4THCM_W "" FLOAT32_IEEE SWC_FDC_type_CM_single_W 0 0 0.0 12650.0 ECU_ADDRESS 0x0000 /* @ECU_Address@VACC_VehHVPwrAvail4THCM_W@ */ /end MEASUREMENT
/begin MEASUREMENT VACC_RsvPwr4DCDCTHCM_W "" FLOAT32_IEEE SWC_FDC_type_CM_single_W 0 0 0.0 100000.0 ECU_ADDRESS 0x0000 /* @ECU_Address@VACC_RsvPwr4DCDCTHCM_W@ */ /end MEASUREMENT
/begin MEASUREMENT VACC_RsvPwr4DCDCTHCM_kW "" FLOAT32_IEEE SWC_FDC_type_CM_single_kW 0 0 0.0 100000.0 ECU_ADDRESS 0x0000 /* @ECU_Address@VACC_RsvPwr4DCDCTHCM_kW@ */ /end MEASUREMENT
/begin MEASUREMENT VACC_TMPwrAvailDchrg_kW "" FLOAT32_IEEE SWC_FDC_type_CM_single_kW 0 0 0.0 100000.0 ECU_ADDRESS 0x0000 /* @ECU_Address@VACC_TMPwrAvailDchrg_kW@ */ /end MEASUREMENT
/begin MEASUREMENT VTQR_FEDUTMSpdReq_rpm "" FLOAT32_IEEE SWC_FDC_type_CM_single_rpm 0 0 -100000.0 100000.0 ECU_ADDRESS 0x0000 /* @ECU_Address@VTQR_FEDUTMSpdReq_rpm@ */ /end MEASUREMENT
/begin MEASUREMENT VTQR_REDUTMSpdReq_rpm "" FLOAT32_IEEE SWC_FDC_type_CM_single_rpm 0 0 -100000.0 100000.0 ECU_ADDRESS 0x0000 /* @ECU_Address@VTQR_REDUTMSpdReq_rpm@ */ /end MEASUREMENT
/begin MEASUREMENT VDHP_EAPS1RAW_pct "" FLOAT32_IEEE SWC_FDC_type_CM_single_pct 0 0 0.0 120.0 ECU_ADDRESS 0x0000 /* @ECU_Address@VDHP_EAPS1RAW_pct@ */ /end MEASUREMENT
/begin MEASUREMENT VDHP_EAPS2RAW_pct "" FLOAT32_IEEE SWC_FDC_type_CM_single_pct 0 0 0.0 120.0 ECU_ADDRESS 0x0000 /* @ECU_Address@VDHP_EAPS2RAW_pct@ */ /end MEASUREMENT
/begin MEASUREMENT VBCM_RoomLampTmr_s "" FLOAT32_IEEE SWC_FDC_type_CM_single_s 0 0 0.0 86400.0 ECU_ADDRESS 0x0000 /* @ECU_Address@VBCM_RoomLampTmr_s@ */ /end MEASUREMENT
/begin MEASUREMENT VBCM_Dimmer_pct "" FLOAT32_IEEE SWC_FDC_type_CM_single_pct 0 0 0.0 100.0 ECU_ADDRESS 0x0000 /* @ECU_Address@VBCM_Dimmer_pct@ */ /end MEASUREMENT
/begin MEASUREMENT VPMM_TMSpd_rpm "" FLOAT32_IEEE SWC_FDC_type_CM_single_rpm 0 0 -17000.0 17000.0 ECU_ADDRESS 0x0000 /* @ECU_Address@VPMM_TMSpd_rpm@ */ /end MEASUREMENT
/begin MEASUREMENT VPMM_AuxBatVolt_V "" FLOAT32_IEEE SWC_FDC_type_CM_single_V 0 0 0.0 86400.0 ECU_ADDRESS 0x0000 /* @ECU_Address@VPMM_AuxBatVolt_V@ */ /end MEASUREMENT
/begin MEASUREMENT VPMM_MCUDCBusMaxVolt_V "" FLOAT32_IEEE SWC_FDC_type_CM_single_V 0 0 0.0 400.0 ECU_ADDRESS 0x0000 /* @ECU_Address@VPMM_MCUDCBusMaxVolt_V@ */ /end MEASUREMENT
/begin MEASUREMENT VPMM_PowerOffTSet_s "" FLOAT32_IEEE SWC_FDC_type_CM_single_s 0 0 0.0 86400.0 ECU_ADDRESS 0x0000 /* @ECU_Address@VPMM_PowerOffTSet_s@ */ /end MEASUREMENT
/begin MEASUREMENT VPMM_AuxBatVolt_mV "" FLOAT32_IEEE SWC_FDC_type_CM_single_mV 0 0 0.0 86400.0 ECU_ADDRESS 0x0000 /* @ECU_Address@VPMM_AuxBatVolt_mV@ */ /end MEASUREMENT
/begin MEASUREMENT VPMM_DCDCVoltSetpoint_V "" FLOAT32_IEEE SWC_FDC_type_CM_single_V 0 0 0.0 50.0 ECU_ADDRESS 0x0000 /* @ECU_Address@VPMM_DCDCVoltSetpoint_V@ */ /end MEASUREMENT
/begin MEASUREMENT VPMM_FDADC12VDetAvg_mV "" FLOAT32_IEEE SWC_FDC_type_CM_single_mV 0 0 0.0 20000.0 ECU_ADDRESS 0x0000 /* @ECU_Address@VPMM_FDADC12VDetAvg_mV@ */ /end MEASUREMENT
/begin MEASUREMENT VPMM_DCDCVoltSetpointPU_V "" FLOAT32_IEEE SWC_FDC_type_CM_single_V 0 0 0.0 50.0 ECU_ADDRESS 0x0000 /* @ECU_Address@VPMM_DCDCVoltSetpointPU_V@ */ /end MEASUREMENT
/begin MEASUREMENT VPMM_LVBattChktime_s "" FLOAT32_IEEE SWC_FDC_type_CM_single_s 0 0 0.0 86400.0 ECU_ADDRESS 0x0000 /* @ECU_Address@VPMM_LVBattChktime_s@ */ /end MEASUREMENT
/begin MEASUREMENT VPMM_IVIPwrStaONTOPopT_s "" FLOAT32_IEEE SWC_FDC_type_CM_single_s 0 0 0.0 86400.0 ECU_ADDRESS 0x0000 /* @ECU_Address@VPMM_IVIPwrStaONTOPopT_s@ */ /end MEASUREMENT
/begin MEASUREMENT VPMM_LVChrgHoldTtimer_s "" FLOAT32_IEEE SWC_FDC_type_CM_single_s 0 0 0.0 86400.0 ECU_ADDRESS 0x0000 /* @ECU_Address@VPMM_LVChrgHoldTtimer_s@ */ /end MEASUREMENT
/begin MEASUREMENT VPMM_LVBattChrgTimeCnt_s "" FLOAT32_IEEE SWC_FDC_type_CM_single_s 0 0 0.0 86400.0 ECU_ADDRESS 0x0000 /* @ECU_Address@VPMM_LVBattChrgTimeCnt_s@ */ /end MEASUREMENT
/begin MEASUREMENT VDKC_UIDBatVoltx1000_V "" UWORD SWC_FDC_type_CM_uint16_V 0 0 0.0 10000.0 ECU_ADDRESS 0x0000 /* @ECU_Address@VDKC_UIDBatVoltx1000_V@ */ /end MEASUREMENT
/begin MEASUREMENT VDKC_UIDBatVolt_enum "" UWORD SWC_FDC_type_CM_uint16_enum 0 0 0.0 10000.0 ECU_ADDRESS 0x0000 /* @ECU_Address@VDKC_UIDBatVolt_enum@ */ /end MEASUREMENT
/begin MEASUREMENT VDKC_UWB0Distance_enum "" UWORD SWC_FDC_type_CM_uint16_enum 0 0 0.0 2550.0 ECU_ADDRESS 0x0000 /* @ECU_Address@VDKC_UWB0Distance_enum@ */ /end MEASUREMENT
/begin MEASUREMENT VDKC_UWB1Distance_enum "" UWORD SWC_FDC_type_CM_uint16_enum 0 0 0.0 2550.0 ECU_ADDRESS 0x0000 /* @ECU_Address@VDKC_UWB1Distance_enum@ */ /end MEASUREMENT
/begin MEASUREMENT VDKC_UWB2Distance_enum "" UWORD SWC_FDC_type_CM_uint16_enum 0 0 0.0 2550.0 ECU_ADDRESS 0x0000 /* @ECU_Address@VDKC_UWB2Distance_enum@ */ /end MEASUREMENT
/begin MEASUREMENT VDKC_UWB3Distance_enum "" UWORD SWC_FDC_type_CM_uint16_enum 0 0 0.0 2550.0 ECU_ADDRESS 0x0000 /* @ECU_Address@VDKC_UWB3Distance_enum@ */ /end MEASUREMENT
/begin MEASUREMENT VDKC_UWB4Distance_enum "" UWORD SWC_FDC_type_CM_uint16_enum 0 0 0.0 2550.0 ECU_ADDRESS 0x0000 /* @ECU_Address@VDKC_UWB4Distance_enum@ */ /end MEASUREMENT
/begin MEASUREMENT VTHC_FDCompCmd_rpm "" UWORD SWC_FDC_type_CM_uint16_rpm 0 0 0.0 8300.0 ECU_ADDRESS 0x0000 /* @ECU_Address@VTHC_FDCompCmd_rpm@ */ /end MEASUREMENT
/begin MEASUREMENT VTHC_FDEXV1Cmd_step "" UWORD SWC_FDC_type_CM_uint16_step 0 0 0.0 576.0 ECU_ADDRESS 0x0000 /* @ECU_Address@VTHC_FDEXV1Cmd_step@ */ /end MEASUREMENT
/begin MEASUREMENT VTHC_FDEXV2Cmd_step "" UWORD SWC_FDC_type_CM_uint16_step 0 0 0.0 576.0 ECU_ADDRESS 0x0000 /* @ECU_Address@VTHC_FDEXV2Cmd_step@ */ /end MEASUREMENT
/begin MEASUREMENT VDKC_CoordinateX_enum "" SWORD SWC_FDC_type_CM_int16_enum 0 0 -2550.0 2560.0 ECU_ADDRESS 0x0000 /* @ECU_Address@VDKC_CoordinateX_enum@ */ /end MEASUREMENT
/begin MEASUREMENT VDKC_CoordinateY_enum "" SWORD SWC_FDC_type_CM_int16_enum 0 0 -2550.0 2560.0 ECU_ADDRESS 0x0000 /* @ECU_Address@VDKC_CoordinateY_enum@ */ /end MEASUREMENT
/begin MEASUREMENT VDKC_UWB0FPP_enum "" SWORD SWC_FDC_type_CM_int16_enum 0 0 -127.0 128.0 ECU_ADDRESS 0x0000 /* @ECU_Address@VDKC_UWB0FPP_enum@ */ /end MEASUREMENT
/begin MEASUREMENT VDKC_UWB1FPP_enum "" SWORD SWC_FDC_type_CM_int16_enum 0 0 -127.0 128.0 ECU_ADDRESS 0x0000 /* @ECU_Address@VDKC_UWB1FPP_enum@ */ /end MEASUREMENT
/begin MEASUREMENT VDKC_UWB2FPP_enum "" SWORD SWC_FDC_type_CM_int16_enum 0 0 -127.0 128.0 ECU_ADDRESS 0x0000 /* @ECU_Address@VDKC_UWB2FPP_enum@ */ /end MEASUREMENT
/begin MEASUREMENT VDKC_UWB3FPP_enum "" SWORD SWC_FDC_type_CM_int16_enum 0 0 -127.0 128.0 ECU_ADDRESS 0x0000 /* @ECU_Address@VDKC_UWB3FPP_enum@ */ /end MEASUREMENT
/begin MEASUREMENT VDKC_UWB4FPP_enum "" SWORD SWC_FDC_type_CM_int16_enum 0 0 -127.0 128.0 ECU_ADDRESS 0x0000 /* @ECU_Address@VDKC_UWB4FPP_enum@ */ /end MEASUREMENT
/begin MEASUREMENT VDSC_DISCSta_enum "" UBYTE SWC_FDC_type_CM_uint8_enum 0 0 0.0 3.0 ECU_ADDRESS 0x0000 /* @ECU_Address@VDSC_DISCSta_enum@ */ /end MEASUREMENT
/begin MEASUREMENT VDKC_DKCAuthSta_enum "" UBYTE SWC_FDC_type_CM_uint8_enum 0 0 0.0 255.0 ECU_ADDRESS 0x0000 /* @ECU_Address@VDKC_DKCAuthSta_enum@ */ /end MEASUREMENT
/begin MEASUREMENT VDKC_APSStaSystem_enum "" UBYTE SWC_FDC_type_CM_uint8_enum 0 0 0.0 255.0 ECU_ADDRESS 0x0000 /* @ECU_Address@VDKC_APSStaSystem_enum@ */ /end MEASUREMENT
/begin MEASUREMENT VDKC_DkeyRAPSAreaRaw_enum "" UBYTE SWC_FDC_type_CM_uint8_enum 0 0 0.0 255.0 ECU_ADDRESS 0x0000 /* @ECU_Address@VDKC_DkeyRAPSAreaRaw_enum@ */ /end MEASUREMENT
/begin MEASUREMENT VDKC_KeyUWBDetArea_enum "" UBYTE SWC_FDC_type_CM_uint8_enum 0 0 0.0 255.0 ECU_ADDRESS 0x0000 /* @ECU_Address@VDKC_KeyUWBDetArea_enum@ */ /end MEASUREMENT
/begin MEASUREMENT VDKC_BTConnectSta_enum "" UBYTE SWC_FDC_type_CM_uint8_enum 0 0 0.0 255.0 ECU_ADDRESS 0x0000 /* @ECU_Address@VDKC_BTConnectSta_enum@ */ /end MEASUREMENT
/begin MEASUREMENT VDKC_UWBDetRAPSZoneKeep_enum "" UBYTE SWC_FDC_type_CM_uint8_enum 0 0 0.0 255.0 ECU_ADDRESS 0x0000 /* @ECU_Address@VDKC_UWBDetRAPSZoneKeep_enum@ */ /end MEASUREMENT
/begin MEASUREMENT VDKC_DkeyAreaRAPSSta_enum "" UBYTE SWC_FDC_type_CM_uint8_enum 0 0 0.0 255.0 ECU_ADDRESS 0x0000 /* @ECU_Address@VDKC_DkeyAreaRAPSSta_enum@ */ /end MEASUREMENT
/begin MEASUREMENT VDKC_UIDButtonPCmdToBCMRAW_enum "" UBYTE SWC_FDC_type_CM_uint8_enum 0 0 0.0 255.0 ECU_ADDRESS 0x0000 /* @ECU_Address@VDKC_UIDButtonPCmdToBCMRAW_enum@ */ /end MEASUREMENT
/begin MEASUREMENT VDKC_NFCDetPCmdHandSta_enum "" UBYTE SWC_FDC_type_CM_uint8_enum 0 0 0.0 255.0 ECU_ADDRESS 0x0000 /* @ECU_Address@VDKC_NFCDetPCmdHandSta_enum@ */ /end MEASUREMENT
/begin MEASUREMENT VDKC_NFCDetPCmdToBCMRAW_enum "" UBYTE SWC_FDC_type_CM_uint8_enum 0 0 0.0 255.0 ECU_ADDRESS 0x0000 /* @ECU_Address@VDKC_NFCDetPCmdToBCMRAW_enum@ */ /end MEASUREMENT
/begin MEASUREMENT VDKC_AutoLockPCmdHandSta_enum "" UBYTE SWC_FDC_type_CM_uint8_enum 0 0 0.0 255.0 ECU_ADDRESS 0x0000 /* @ECU_Address@VDKC_AutoLockPCmdHandSta_enum@ */ /end MEASUREMENT
/begin MEASUREMENT VDKC_FDCKeyAreaPTG_enum "" UBYTE SWC_FDC_type_CM_uint8_enum 0 0 0.0 255.0 ECU_ADDRESS 0x0000 /* @ECU_Address@VDKC_FDCKeyAreaPTG_enum@ */ /end MEASUREMENT
/begin MEASUREMENT VDKC_TrunkHanPCmdHandSta_enum "" UBYTE SWC_FDC_type_CM_uint8_enum 0 0 0.0 255.0 ECU_ADDRESS 0x0000 /* @ECU_Address@VDKC_TrunkHanPCmdHandSta_enum@ */ /end MEASUREMENT
/begin MEASUREMENT VDKC_UWBDetPSZoneSta_enum "" UBYTE SWC_FDC_type_CM_uint8_enum 0 0 0.0 255.0 ECU_ADDRESS 0x0000 /* @ECU_Address@VDKC_UWBDetPSZoneSta_enum@ */ /end MEASUREMENT
/begin MEASUREMENT VDKC_UWBDetPSZoneKeepSta_enum "" UBYTE SWC_FDC_type_CM_uint8_enum 0 0 0.0 255.0 ECU_ADDRESS 0x0000 /* @ECU_Address@VDKC_UWBDetPSZoneKeepSta_enum@ */ /end MEASUREMENT
/begin MEASUREMENT VDKC_PTGPCmdHandSta_enum "" UBYTE SWC_FDC_type_CM_uint8_enum 0 0 0.0 255.0 ECU_ADDRESS 0x0000 /* @ECU_Address@VDKC_PTGPCmdHandSta_enum@ */ /end MEASUREMENT
/begin MEASUREMENT VDKC_TrunkHanPCmdToBCMRAW_enum "" UBYTE SWC_FDC_type_CM_uint8_enum 0 0 0.0 255.0 ECU_ADDRESS 0x0000 /* @ECU_Address@VDKC_TrunkHanPCmdToBCMRAW_enum@ */ /end MEASUREMENT
/begin MEASUREMENT VDKC_UIDButtonPCmdHandSta_enum "" UBYTE SWC_FDC_type_CM_uint8_enum 0 0 0.0 255.0 ECU_ADDRESS 0x0000 /* @ECU_Address@VDKC_UIDButtonPCmdHandSta_enum@ */ /end MEASUREMENT
/begin MEASUREMENT VDKC_PTGPCmdToBCMRAW_enum "" UBYTE SWC_FDC_type_CM_uint8_enum 0 0 0.0 255.0 ECU_ADDRESS 0x0000 /* @ECU_Address@VDKC_PTGPCmdToBCMRAW_enum@ */ /end MEASUREMENT
/begin MEASUREMENT VDKC_AutoLockPCmdToBCMRAW_enum "" UBYTE SWC_FDC_type_CM_uint8_enum 0 0 0.0 255.0 ECU_ADDRESS 0x0000 /* @ECU_Address@VDKC_AutoLockPCmdToBCMRAW_enum@ */ /end MEASUREMENT
/begin MEASUREMENT VDKC_UWBDetUnLockSta_enum "" UBYTE SWC_FDC_type_CM_uint8_enum 0 0 0.0 255.0 ECU_ADDRESS 0x0000 /* @ECU_Address@VDKC_UWBDetUnLockSta_enum@ */ /end MEASUREMENT
/begin MEASUREMENT VDKC_UWBDetUnlockKeepSta_enum "" UBYTE SWC_FDC_type_CM_uint8_enum 0 0 0.0 255.0 ECU_ADDRESS 0x0000 /* @ECU_Address@VDKC_UWBDetUnlockKeepSta_enum@ */ /end MEASUREMENT
/begin MEASUREMENT VDKC_UWBDetPCmdToBCMRAW_enum "" UBYTE SWC_FDC_type_CM_uint8_enum 0 0 0.0 255.0 ECU_ADDRESS 0x0000 /* @ECU_Address@VDKC_UWBDetPCmdToBCMRAW_enum@ */ /end MEASUREMENT
/begin MEASUREMENT VDKC_FDCPCommandToBCM_enum "" UBYTE SWC_FDC_type_CM_uint8_enum 0 0 0.0 255.0 ECU_ADDRESS 0x0000 /* @ECU_Address@VDKC_FDCPCommandToBCM_enum@ */ /end MEASUREMENT
/begin MEASUREMENT VDKC_PCommandToBCM_enum "" UBYTE SWC_FDC_type_CM_uint8_enum 0 0 0.0 255.0 ECU_ADDRESS 0x0000 /* @ECU_Address@VDKC_PCommandToBCM_enum@ */ /end MEASUREMENT
/begin MEASUREMENT VDKC_NFCJudgePEZoneSta_enum "" UBYTE SWC_FDC_type_CM_uint8_enum 0 0 0.0 255.0 ECU_ADDRESS 0x0000 /* @ECU_Address@VDKC_NFCJudgePEZoneSta_enum@ */ /end MEASUREMENT
/begin MEASUREMENT VDKC_UWBDetPEZoneSta_enum "" UBYTE SWC_FDC_type_CM_uint8_enum 0 0 0.0 255.0 ECU_ADDRESS 0x0000 /* @ECU_Address@VDKC_UWBDetPEZoneSta_enum@ */ /end MEASUREMENT
/begin MEASUREMENT VDKC_UWBDetPEZoneKeepSta_enum "" UBYTE SWC_FDC_type_CM_uint8_enum 0 0 0.0 255.0 ECU_ADDRESS 0x0000 /* @ECU_Address@VDKC_UWBDetPEZoneKeepSta_enum@ */ /end MEASUREMENT
/begin MEASUREMENT VDKC_FDCKeyAreaLockUnlock_enum "" UBYTE SWC_FDC_type_CM_uint8_enum 0 0 0.0 255.0 ECU_ADDRESS 0x0000 /* @ECU_Address@VDKC_FDCKeyAreaLockUnlock_enum@ */ /end MEASUREMENT
/begin MEASUREMENT VDKC_KeyAreaLockUnlock_enum "" UBYTE SWC_FDC_type_CM_uint8_enum 0 0 0.0 255.0 ECU_ADDRESS 0x0000 /* @ECU_Address@VDKC_KeyAreaLockUnlock_enum@ */ /end MEASUREMENT
/begin MEASUREMENT VDKC_NFCJudgePSZoneSta_enum "" UBYTE SWC_FDC_type_CM_uint8_enum 0 0 0.0 255.0 ECU_ADDRESS 0x0000 /* @ECU_Address@VDKC_NFCJudgePSZoneSta_enum@ */ /end MEASUREMENT
/begin MEASUREMENT VDKC_FDCKeyAreaPS_enum "" UBYTE SWC_FDC_type_CM_uint8_enum 0 0 0.0 255.0 ECU_ADDRESS 0x0000 /* @ECU_Address@VDKC_FDCKeyAreaPS_enum@ */ /end MEASUREMENT
/begin MEASUREMENT VDKC_DkeyShowIVISta_enum "" UBYTE SWC_FDC_type_CM_uint8_enum 0 0 0.0 255.0 ECU_ADDRESS 0x0000 /* @ECU_Address@VDKC_DkeyShowIVISta_enum@ */ /end MEASUREMENT
/begin MEASUREMENT VDKC_CAN4PDKeyAreaPS_enum "" UBYTE SWC_FDC_type_CM_uint8_enum 0 0 0.0 255.0 ECU_ADDRESS 0x0000 /* @ECU_Address@VDKC_CAN4PDKeyAreaPS_enum@ */ /end MEASUREMENT
/begin MEASUREMENT VDKC_KeyAreaPS_enum "" UBYTE SWC_FDC_type_CM_uint8_enum 0 0 0.0 255.0 ECU_ADDRESS 0x0000 /* @ECU_Address@VDKC_KeyAreaPS_enum@ */ /end MEASUREMENT
/begin MEASUREMENT VDKC_FDCKeyAreaSPTG_enum "" UBYTE SWC_FDC_type_CM_uint8_enum 0 0 0.0 255.0 ECU_ADDRESS 0x0000 /* @ECU_Address@VDKC_FDCKeyAreaSPTG_enum@ */ /end MEASUREMENT
/begin MEASUREMENT VDKC_KeyAreaSPTGSta_enum "" UBYTE SWC_FDC_type_CM_uint8_enum 0 0 0.0 255.0 ECU_ADDRESS 0x0000 /* @ECU_Address@VDKC_KeyAreaSPTGSta_enum@ */ /end MEASUREMENT
/begin MEASUREMENT VDKC_KeyAreaPTG_enum "" UBYTE SWC_FDC_type_CM_uint8_enum 0 0 0.0 255.0 ECU_ADDRESS 0x0000 /* @ECU_Address@VDKC_KeyAreaPTG_enum@ */ /end MEASUREMENT
/begin MEASUREMENT VDKC_UWB4Invalid_flg "" UBYTE SWC_FDC_type_CM_uint8_flg 0 0 0.0 3.0 ECU_ADDRESS 0x0000 /* @ECU_Address@VDKC_UWB4Invalid_flg@ */ /end MEASUREMENT
/begin MEASUREMENT VDKC_UWB3Invalid_flg "" UBYTE SWC_FDC_type_CM_uint8_flg 0 0 0.0 3.0 ECU_ADDRESS 0x0000 /* @ECU_Address@VDKC_UWB3Invalid_flg@ */ /end MEASUREMENT
/begin MEASUREMENT VDKC_UWB1Invalid_flg "" UBYTE SWC_FDC_type_CM_uint8_flg 0 0 0.0 3.0 ECU_ADDRESS 0x0000 /* @ECU_Address@VDKC_UWB1Invalid_flg@ */ /end MEASUREMENT
/begin MEASUREMENT VDKC_UWB2Invalid_flg "" UBYTE SWC_FDC_type_CM_uint8_flg 0 0 0.0 3.0 ECU_ADDRESS 0x0000 /* @ECU_Address@VDKC_UWB2Invalid_flg@ */ /end MEASUREMENT
/begin MEASUREMENT VDKC_UWB0Invalid_flg "" UBYTE SWC_FDC_type_CM_uint8_flg 0 0 0.0 3.0 ECU_ADDRESS 0x0000 /* @ECU_Address@VDKC_UWB0Invalid_flg@ */ /end MEASUREMENT
/begin MEASUREMENT VDKC_UWBDetPCmdHandSta_enum "" UBYTE SWC_FDC_type_CM_uint8_enum 0 0 0.0 255.0 ECU_ADDRESS 0x0000 /* @ECU_Address@VDKC_UWBDetPCmdHandSta_enum@ */ /end MEASUREMENT
/begin MEASUREMENT VDKC_KeyTypeSta_enum "" UBYTE SWC_FDC_type_CM_uint8_enum 0 0 0.0 255.0 ECU_ADDRESS 0x0000 /* @ECU_Address@VDKC_KeyTypeSta_enum@ */ /end MEASUREMENT
/begin MEASUREMENT VDKC_UWBDetPTGArea_enum "" UBYTE SWC_FDC_type_CM_uint8_enum 0 0 0.0 15.0 ECU_ADDRESS 0x0000 /* @ECU_Address@VDKC_UWBDetPTGArea_enum@ */ /end MEASUREMENT
/begin MEASUREMENT VDKC_ParkingModeCmd_enum "" UBYTE SWC_FDC_type_CM_uint8_enum 0 0 0.0 3.0 ECU_ADDRESS 0x0000 /* @ECU_Address@VDKC_ParkingModeCmd_enum@ */ /end MEASUREMENT
/begin MEASUREMENT VDKC_KeyModeSta_enum "" UBYTE SWC_FDC_type_CM_uint8_enum 0 0 0.0 255.0 ECU_ADDRESS 0x0000 /* @ECU_Address@VDKC_KeyModeSta_enum@ */ /end MEASUREMENT
/begin MEASUREMENT VDKC_FDCKeyWelcomeSta_enum "" UBYTE SWC_FDC_type_CM_uint8_enum 0 0 0.0 255.0 ECU_ADDRESS 0x0000 /* @ECU_Address@VDKC_FDCKeyWelcomeSta_enum@ */ /end MEASUREMENT
/begin MEASUREMENT VDKC_DKeyWelcomeSta_enum "" UBYTE SWC_FDC_type_CM_uint8_enum 0 0 0.0 15.0 ECU_ADDRESS 0x0000 /* @ECU_Address@VDKC_DKeyWelcomeSta_enum@ */ /end MEASUREMENT
/begin MEASUREMENT VDKC_BLERSSI_enum "" UBYTE SWC_FDC_type_CM_uint8_enum 0 0 0.0 255.0 ECU_ADDRESS 0x0000 /* @ECU_Address@VDKC_BLERSSI_enum@ */ /end MEASUREMENT
/begin MEASUREMENT VDKC_UWBDetArea_enum "" UBYTE SWC_FDC_type_CM_uint8_enum 0 0 0.0 15.0 ECU_ADDRESS 0x0000 /* @ECU_Address@VDKC_UWBDetArea_enum@ */ /end MEASUREMENT
/begin MEASUREMENT VDKC_OutputPCMDModule_enum "" UBYTE SWC_FDC_type_CM_uint8_enum 0 0 0.0 15.0 ECU_ADDRESS 0x0000 /* @ECU_Address@VDKC_OutputPCMDModule_enum@ */ /end MEASUREMENT
/begin MEASUREMENT VDKC_RSSIJudgeArea_enum "" UBYTE SWC_FDC_type_CM_uint8_enum 0 0 0.0 255.0 ECU_ADDRESS 0x0000 /* @ECU_Address@VDKC_RSSIJudgeArea_enum@ */ /end MEASUREMENT
/begin MEASUREMENT VNMM_SysNMmSta_enum "" UBYTE SWC_FDC_type_CM_uint8_enum 0 0 0.0 15.0 ECU_ADDRESS 0x0000 /* @ECU_Address@VNMM_SysNMmSta_enum@ */ /end MEASUREMENT
/begin MEASUREMENT VNMM_Awake_enum "" UBYTE SWC_FDC_type_CM_uint8_enum 0 0 0.0 15.0 ECU_ADDRESS 0x0000 /* @ECU_Address@VNMM_Awake_enum@ */ /end MEASUREMENT
/begin MEASUREMENT VNMM_ErrorState_enum "" UBYTE SWC_FDC_type_CM_uint8_enum 0 0 0.0 8.0 ECU_ADDRESS 0x0000 /* @ECU_Address@VNMM_ErrorState_enum@ */ /end MEASUREMENT
/begin MEASUREMENT VNMM_NodeID_enum "" UBYTE SWC_FDC_type_CM_uint8_enum 0 0 0.0 127.0 ECU_ADDRESS 0x0000 /* @ECU_Address@VNMM_NodeID_enum@ */ /end MEASUREMENT
/begin MEASUREMENT VNMM_WakeUp_enum "" UBYTE SWC_FDC_type_CM_uint8_enum 0 0 0.0 15.0 ECU_ADDRESS 0x0000 /* @ECU_Address@VNMM_WakeUp_enum@ */ /end MEASUREMENT
/begin MEASUREMENT VTHC_FDAGSCmd_enum "" UBYTE SWC_FDC_type_CM_uint8_enum 0 0 0.0 255.0 ECU_ADDRESS 0x0000 /* @ECU_Address@VTHC_FDAGSCmd_enum@ */ /end MEASUREMENT
/begin MEASUREMENT VTHC_BatteryMode_enum "" UBYTE SWC_FDC_type_CM_uint8_enum 0 0 0.0 7.0 ECU_ADDRESS 0x0000 /* @ECU_Address@VTHC_BatteryMode_enum@ */ /end MEASUREMENT
/begin MEASUREMENT VTHC_EDriveMode_enum "" UBYTE SWC_FDC_type_CM_uint8_enum 0 0 0.0 3.0 ECU_ADDRESS 0x0000 /* @ECU_Address@VTHC_EDriveMode_enum@ */ /end MEASUREMENT
/begin MEASUREMENT VTHC_CabinMode_enum "" UBYTE SWC_FDC_type_CM_uint8_enum 0 0 0.0 15.0 ECU_ADDRESS 0x0000 /* @ECU_Address@VTHC_CabinMode_enum@ */ /end MEASUREMENT
/begin MEASUREMENT VTHC_sigAirIntenZon1St_enum "" UBYTE SWC_FDC_type_CM_uint8_enum 0 0 0.0 15.0 ECU_ADDRESS 0x0000 /* @ECU_Address@VTHC_sigAirIntenZon1St_enum@ */ /end MEASUREMENT
/begin MEASUREMENT VTHC_ACSubMode_enum "" UBYTE SWC_FDC_type_CM_uint8_enum 0 0 0.0 15.0 ECU_ADDRESS 0x0000 /* @ECU_Address@VTHC_ACSubMode_enum@ */ /end MEASUREMENT
/begin MEASUREMENT VVMC_ADASLKASta_enum "" UBYTE SWC_FDC_type_CM_uint8_enum 0 0 0.0 7.0 ECU_ADDRESS 0x0000 /* @ECU_Address@VVMC_ADASLKASta_enum@ */ /end MEASUREMENT
/begin MEASUREMENT VVMC_ADASAEBReq_enum "" UBYTE SWC_FDC_type_CM_uint8_enum 0 0 0.0 7.0 ECU_ADDRESS 0x0000 /* @ECU_Address@VVMC_ADASAEBReq_enum@ */ /end MEASUREMENT
/begin MEASUREMENT VVMC_ADASDBSReq_enum "" UBYTE SWC_FDC_type_CM_uint8_enum 0 0 0.0 3.0 ECU_ADDRESS 0x0000 /* @ECU_Address@VVMC_ADASDBSReq_enum@ */ /end MEASUREMENT
/begin MEASUREMENT VVMC_TimeGapLevel_enum "" UBYTE SWC_FDC_type_CM_uint8_enum 0 0 0.0 7.0 ECU_ADDRESS 0x0000 /* @ECU_Address@VVMC_TimeGapLevel_enum@ */ /end MEASUREMENT
/begin MEASUREMENT VVMC_ADASShftPosnReq_enum "" UBYTE SWC_FDC_type_CM_uint8_enum 0 0 0.0 7.0 ECU_ADDRESS 0x0000 /* @ECU_Address@VVMC_ADASShftPosnReq_enum@ */ /end MEASUREMENT
/begin MEASUREMENT VVMC_ADASFCWSta_enum "" UBYTE SWC_FDC_type_CM_uint8_enum 0 0 0.0 7.0 ECU_ADDRESS 0x0000 /* @ECU_Address@VVMC_ADASFCWSta_enum@ */ /end MEASUREMENT
/begin MEASUREMENT VVMC_ADASLDWSta_enum "" UBYTE SWC_FDC_type_CM_uint8_enum 0 0 0.0 7.0 ECU_ADDRESS 0x0000 /* @ECU_Address@VVMC_ADASLDWSta_enum@ */ /end MEASUREMENT
/begin MEASUREMENT VVMC_ACCObjDstLvl_enum "" UBYTE SWC_FDC_type_CM_uint8_enum 0 0 0.0 7.0 ECU_ADDRESS 0x0000 /* @ECU_Address@VVMC_ACCObjDstLvl_enum@ */ /end MEASUREMENT
/begin MEASUREMENT VVMC_ForceLowBeam_enum "" UBYTE SWC_FDC_type_CM_uint8_enum 0 0 0.0 1.0 ECU_ADDRESS 0x0000 /* @ECU_Address@VVMC_ForceLowBeam_enum@ */ /end MEASUREMENT
/begin MEASUREMENT VVMC_ADASWarningMsg_enum "" UBYTE SWC_FDC_type_CM_uint8_enum 0 0 0.0 15.0 ECU_ADDRESS 0x0000 /* @ECU_Address@VVMC_ADASWarningMsg_enum@ */ /end MEASUREMENT
/begin MEASUREMENT VVMC_ADASCAMSpdLim_enum "" UBYTE SWC_FDC_type_CM_uint8_enum 0 0 0.0 31.0 ECU_ADDRESS 0x0000 /* @ECU_Address@VVMC_ADASCAMSpdLim_enum@ */ /end MEASUREMENT
/begin MEASUREMENT VVMC_TargetType_enum "" UBYTE SWC_FDC_type_CM_uint8_enum 0 0 0.0 15.0 ECU_ADDRESS 0x0000 /* @ECU_Address@VVMC_TargetType_enum@ */ /end MEASUREMENT
/begin MEASUREMENT VVMC_ADASSLIFSpdLim_enum "" UBYTE SWC_FDC_type_CM_uint8_enum 0 0 0.0 31.0 ECU_ADDRESS 0x0000 /* @ECU_Address@VVMC_ADASSLIFSpdLim_enum@ */ /end MEASUREMENT
/begin MEASUREMENT VVMC_ADASLaneModeL_enum "" UBYTE SWC_FDC_type_CM_uint8_enum 0 0 0.0 7.0 ECU_ADDRESS 0x0000 /* @ECU_Address@VVMC_ADASLaneModeL_enum@ */ /end MEASUREMENT
/begin MEASUREMENT VVMC_ADASLaneModeR_enum "" UBYTE SWC_FDC_type_CM_uint8_enum 0 0 0.0 7.0 ECU_ADDRESS 0x0000 /* @ECU_Address@VVMC_ADASLaneModeR_enum@ */ /end MEASUREMENT
/begin MEASUREMENT VVMC_ADASSLIFSta_enum "" UBYTE SWC_FDC_type_CM_uint8_enum 0 0 0.0 5.0 ECU_ADDRESS 0x0000 /* @ECU_Address@VVMC_ADASSLIFSta_enum@ */ /end MEASUREMENT
/begin MEASUREMENT VVMC_ADASISASta_enum "" UBYTE SWC_FDC_type_CM_uint8_enum 0 0 0.0 3.0 ECU_ADDRESS 0x0000 /* @ECU_Address@VVMC_ADASISASta_enum@ */ /end MEASUREMENT
/begin MEASUREMENT VVMC_LVDAMuteSta_enum "" UBYTE SWC_FDC_type_CM_uint8_enum 0 0 0.0 3.0 ECU_ADDRESS 0x0000 /* @ECU_Address@VVMC_LVDAMuteSta_enum@ */ /end MEASUREMENT
/begin MEASUREMENT VVMC_FCMACCmode_enum "" UBYTE SWC_FDC_type_CM_uint8_enum 0 0 0.0 2.0 ECU_ADDRESS 0x0000 /* @ECU_Address@VVMC_FCMACCmode_enum@ */ /end MEASUREMENT
/begin MEASUREMENT VVMC_ADASLanetypeR_enum "" UBYTE SWC_FDC_type_CM_uint8_enum 0 0 0.0 2.0 ECU_ADDRESS 0x0000 /* @ECU_Address@VVMC_ADASLanetypeR_enum@ */ /end MEASUREMENT
/begin MEASUREMENT VVMC_ADASLanetypeL_enum "" UBYTE SWC_FDC_type_CM_uint8_enum 0 0 0.0 2.0 ECU_ADDRESS 0x0000 /* @ECU_Address@VVMC_ADASLanetypeL_enum@ */ /end MEASUREMENT
/begin MEASUREMENT VVMC_ADASAEBSta_enum "" UBYTE SWC_FDC_type_CM_uint8_enum 0 0 0.0 7.0 ECU_ADDRESS 0x0000 /* @ECU_Address@VVMC_ADASAEBSta_enum@ */ /end MEASUREMENT
/begin MEASUREMENT VACC_HVTHCMSysAvail_enum "" UBYTE SWC_FDC_type_CM_uint8_enum 0 0 0.0 3.0 ECU_ADDRESS 0x0000 /* @ECU_Address@VACC_HVTHCMSysAvail_enum@ */ /end MEASUREMENT
/begin MEASUREMENT VACC_LVBattVoltSta_enum "" UBYTE SWC_FDC_type_CM_uint8_enum 0 0 0.0 3.0 ECU_ADDRESS 0x0000 /* @ECU_Address@VACC_LVBattVoltSta_enum@ */ /end MEASUREMENT
/begin MEASUREMENT VAPM_PASDRMR_cm "" UBYTE SWC_FDC_type_CM_uint8_cm 0 0 0.0 255.0 ECU_ADDRESS 0x0000 /* @ECU_Address@VAPM_PASDRMR_cm@ */ /end MEASUREMENT
/begin MEASUREMENT VAPM_PASDRML_cm "" UBYTE SWC_FDC_type_CM_uint8_cm 0 0 0.0 255.0 ECU_ADDRESS 0x0000 /* @ECU_Address@VAPM_PASDRML_cm@ */ /end MEASUREMENT
/begin MEASUREMENT VTQD_BCMUserNowSetting_enum "" UBYTE SWC_FDC_type_CM_uint8_enum 0 0 0.0 15.0 ECU_ADDRESS 0x0000 /* @ECU_Address@VTQD_BCMUserNowSetting_enum@ */ /end MEASUREMENT
/begin MEASUREMENT VBCM_VIGCommand_enum "" UBYTE SWC_FDC_type_CM_uint8_enum 0 0 0.0 255.0 ECU_ADDRESS 0x0000 /* @ECU_Address@VBCM_VIGCommand_enum@ */ /end MEASUREMENT
/begin MEASUREMENT VBCM_FlashAntitheft_enum "" UBYTE SWC_FDC_type_CM_uint8_enum 0 0 0.0 255.0 ECU_ADDRESS 0x0000 /* @ECU_Address@VBCM_FlashAntitheft_enum@ */ /end MEASUREMENT
/begin MEASUREMENT VBCM_SenstivityPosnCmd_enum "" UBYTE SWC_FDC_type_CM_uint8_enum 0 0 0.0 255.0 ECU_ADDRESS 0x0000 /* @ECU_Address@VBCM_SenstivityPosnCmd_enum@ */ /end MEASUREMENT
/begin MEASUREMENT VBCM_MFRDNBrightReq_pct "" UBYTE SWC_FDC_type_CM_uint8_pct 0 0 0.0 255.0 ECU_ADDRESS 0x0000 /* @ECU_Address@VBCM_MFRDNBrightReq_pct@ */ /end MEASUREMENT
/begin MEASUREMENT VBCM_UserNow_enum "" UBYTE SWC_FDC_type_CM_uint8_enum 0 0 0.0 255.0 ECU_ADDRESS 0x0000 /* @ECU_Address@VBCM_UserNow_enum@ */ /end MEASUREMENT
/begin MEASUREMENT VBCM_WinLROpenedSta_pct "" UBYTE SWC_FDC_type_CM_uint8_pct 0 0 0.0 255.0 ECU_ADDRESS 0x0000 /* @ECU_Address@VBCM_WinLROpenedSta_pct@ */ /end MEASUREMENT
/begin MEASUREMENT VBCM_WinRROpenedSta_pct "" UBYTE SWC_FDC_type_CM_uint8_pct 0 0 0.0 255.0 ECU_ADDRESS 0x0000 /* @ECU_Address@VBCM_WinRROpenedSta_pct@ */ /end MEASUREMENT
/begin MEASUREMENT VBCM_WinLFOpenedSta_pct "" UBYTE SWC_FDC_type_CM_uint8_pct 0 0 0.0 255.0 ECU_ADDRESS 0x0000 /* @ECU_Address@VBCM_WinLFOpenedSta_pct@ */ /end MEASUREMENT
/begin MEASUREMENT VBCM_WinRFOpenedSta_pct "" UBYTE SWC_FDC_type_CM_uint8_pct 0 0 0.0 255.0 ECU_ADDRESS 0x0000 /* @ECU_Address@VBCM_WinRFOpenedSta_pct@ */ /end MEASUREMENT
/begin MEASUREMENT VBCM_DrRWdwCtrlCmd_pct "" UBYTE SWC_FDC_type_CM_uint8_pct 0 0 0.0 255.0 ECU_ADDRESS 0x0000 /* @ECU_Address@VBCM_DrRWdwCtrlCmd_pct@ */ /end MEASUREMENT
/begin MEASUREMENT VBCM_PsRWdwCtrlCmd_pct "" UBYTE SWC_FDC_type_CM_uint8_pct 0 0 0.0 255.0 ECU_ADDRESS 0x0000 /* @ECU_Address@VBCM_PsRWdwCtrlCmd_pct@ */ /end MEASUREMENT
/begin MEASUREMENT VBCM_DrRWdwReqAP_enum "" UBYTE SWC_FDC_type_CM_uint8_enum 0 0 0.0 255.0 ECU_ADDRESS 0x0000 /* @ECU_Address@VBCM_DrRWdwReqAP_enum@ */ /end MEASUREMENT
/begin MEASUREMENT VBCM_PsRWdwReqAP_enum "" UBYTE SWC_FDC_type_CM_uint8_enum 0 0 0.0 255.0 ECU_ADDRESS 0x0000 /* @ECU_Address@VBCM_PsRWdwReqAP_enum@ */ /end MEASUREMENT
/begin MEASUREMENT VBCM_WasherCtrl_enum "" UBYTE SWC_FDC_type_CM_uint8_enum 0 0 0.0 3.0 ECU_ADDRESS 0x0000 /* @ECU_Address@VBCM_WasherCtrl_enum@ */ /end MEASUREMENT
/begin MEASUREMENT VBCM_MirrorCtrl_enum "" UBYTE SWC_FDC_type_CM_uint8_enum 0 0 0.0 2.0 ECU_ADDRESS 0x0000 /* @ECU_Address@VBCM_MirrorCtrl_enum@ */ /end MEASUREMENT
/begin MEASUREMENT VBCM_OutMode_enum "" UBYTE SWC_FDC_type_CM_uint8_enum 0 0 0.0 255.0 ECU_ADDRESS 0x0000 /* @ECU_Address@VBCM_OutMode_enum@ */ /end MEASUREMENT
/begin MEASUREMENT VBCM_WelcomeLight_enum "" UBYTE SWC_FDC_type_CM_uint8_enum 0 0 0.0 255.0 ECU_ADDRESS 0x0000 /* @ECU_Address@VBCM_WelcomeLight_enum@ */ /end MEASUREMENT
/begin MEASUREMENT VBCM_FrChargingDoorCtrl_enum "" UBYTE SWC_FDC_type_CM_uint8_enum 0 0 0.0 2.0 ECU_ADDRESS 0x0000 /* @ECU_Address@VBCM_FrChargingDoorCtrl_enum@ */ /end MEASUREMENT
/begin MEASUREMENT VBCM_RrChargingDoorCtrl_enum "" UBYTE SWC_FDC_type_CM_uint8_enum 0 0 0.0 2.0 ECU_ADDRESS 0x0000 /* @ECU_Address@VBCM_RrChargingDoorCtrl_enum@ */ /end MEASUREMENT
/begin MEASUREMENT VBCM_CTDCtrl_enum "" UBYTE SWC_FDC_type_CM_uint8_enum 0 0 0.0 3.0 ECU_ADDRESS 0x0000 /* @ECU_Address@VBCM_CTDCtrl_enum@ */ /end MEASUREMENT
/begin MEASUREMENT VBCM_ATCtrl_enum "" UBYTE SWC_FDC_type_CM_uint8_enum 0 0 0.0 2.0 ECU_ADDRESS 0x0000 /* @ECU_Address@VBCM_ATCtrl_enum@ */ /end MEASUREMENT
/begin MEASUREMENT VBCM_ATActCtrl_enum "" UBYTE SWC_FDC_type_CM_uint8_enum 0 0 0.0 2.0 ECU_ADDRESS 0x0000 /* @ECU_Address@VBCM_ATActCtrl_enum@ */ /end MEASUREMENT
/begin MEASUREMENT VBCM_TailgateRemote_enum "" UBYTE SWC_FDC_type_CM_uint8_enum 0 0 0.0 2.0 ECU_ADDRESS 0x0000 /* @ECU_Address@VBCM_TailgateRemote_enum@ */ /end MEASUREMENT
/begin MEASUREMENT VBCM_CountAlarm_enum "" UBYTE SWC_FDC_type_CM_uint8_enum 0 0 0.0 15.0 ECU_ADDRESS 0x0000 /* @ECU_Address@VBCM_CountAlarm_enum@ */ /end MEASUREMENT
/begin MEASUREMENT VPMM_DrivetrainSelect_enum "" UBYTE SWC_FDC_type_CM_uint8_enum 0 0 0.0 2.0 ECU_ADDRESS 0x0000 /* @ECU_Address@VPMM_DrivetrainSelect_enum@ */ /end MEASUREMENT
/begin MEASUREMENT VPMM_DrSeatSta_enum "" UBYTE SWC_FDC_type_CM_uint8_enum 0 0 0.0 2.0 ECU_ADDRESS 0x0000 /* @ECU_Address@VPMM_DrSeatSta_enum@ */ /end MEASUREMENT
/begin MEASUREMENT VPMM_PwrReq_OTA_enum "" UBYTE SWC_FDC_type_CM_uint8_OTA_enum 0 0 0.0 255.0 ECU_ADDRESS 0x0000 /* @ECU_Address@VPMM_PwrReq_OTA_enum@ */ /end MEASUREMENT
/begin MEASUREMENT VPMM_OTAPwrReqOFFChkSta_enum "" UBYTE SWC_FDC_type_CM_uint8_enum 0 0 0.0 255.0 ECU_ADDRESS 0x0000 /* @ECU_Address@VPMM_OTAPwrReqOFFChkSta_enum@ */ /end MEASUREMENT
/begin MEASUREMENT VPMM_OTAPwrReqStdChkSta_enum "" UBYTE SWC_FDC_type_CM_uint8_enum 0 0 0.0 255.0 ECU_ADDRESS 0x0000 /* @ECU_Address@VPMM_OTAPwrReqStdChkSta_enum@ */ /end MEASUREMENT
/begin MEASUREMENT VPMM_PwrUpReq_enum "" UBYTE SWC_FDC_type_CM_uint8_enum 0 0 0.0 255.0 ECU_ADDRESS 0x0000 /* @ECU_Address@VPMM_PwrUpReq_enum@ */ /end MEASUREMENT
/begin MEASUREMENT VPMM_ReVehThdChkSta_enum "" UBYTE SWC_FDC_type_CM_uint8_enum 0 0 0.0 255.0 ECU_ADDRESS 0x0000 /* @ECU_Address@VPMM_ReVehThdChkSta_enum@ */ /end MEASUREMENT
/begin MEASUREMENT VPMM_PwrStaConstraint_enum "" UBYTE SWC_FDC_type_CM_uint8_enum 0 0 0.0 255.0 ECU_ADDRESS 0x0000 /* @ECU_Address@VPMM_PwrStaConstraint_enum@ */ /end MEASUREMENT
/begin MEASUREMENT VPMM_TCountSta_enum "" UBYTE SWC_FDC_type_CM_uint8_enum 0 0 0.0 255.0 ECU_ADDRESS 0x0000 /* @ECU_Address@VPMM_TCountSta_enum@ */ /end MEASUREMENT
/begin MEASUREMENT VPMM_LowSOCWarn_enum "" UBYTE SWC_FDC_type_CM_uint8_enum 0 0 0.0 255.0 ECU_ADDRESS 0x0000 /* @ECU_Address@VPMM_LowSOCWarn_enum@ */ /end MEASUREMENT
/begin MEASUREMENT VPMM_PwrDownReq_enum "" UBYTE SWC_FDC_type_CM_uint8_enum 0 0 0.0 255.0 ECU_ADDRESS 0x0000 /* @ECU_Address@VPMM_PwrDownReq_enum@ */ /end MEASUREMENT
/begin MEASUREMENT VPMM_PowerUpState_enum "" UBYTE SWC_FDC_type_CM_uint8_enum 0 0 0.0 255.0 ECU_ADDRESS 0x0000 /* @ECU_Address@VPMM_PowerUpState_enum@ */ /end MEASUREMENT
/begin MEASUREMENT VPMM_PowerDownState_enum "" UBYTE SWC_FDC_type_CM_uint8_enum 0 0 0.0 255.0 ECU_ADDRESS 0x0000 /* @ECU_Address@VPMM_PowerDownState_enum@ */ /end MEASUREMENT
/begin MEASUREMENT VPMM_PowerUpFault_enum "" UBYTE SWC_FDC_type_CM_uint8_enum 0 0 0.0 255.0 ECU_ADDRESS 0x0000 /* @ECU_Address@VPMM_PowerUpFault_enum@ */ /end MEASUREMENT
/begin MEASUREMENT VPMM_PowerDownFault_enum "" UBYTE SWC_FDC_type_CM_uint8_enum 0 0 0.0 255.0 ECU_ADDRESS 0x0000 /* @ECU_Address@VPMM_PowerDownFault_enum@ */ /end MEASUREMENT
/begin MEASUREMENT VPMM_HVSysReadyToCharge_enum "" UBYTE SWC_FDC_type_CM_uint8_enum 0 0 0.0 255.0 ECU_ADDRESS 0x0000 /* @ECU_Address@VPMM_HVSysReadyToCharge_enum@ */ /end MEASUREMENT
/begin MEASUREMENT VPMM_PowerSta_enum "" UBYTE SWC_FDC_type_CM_uint8_enum 0 0 0.0 255.0 ECU_ADDRESS 0x0000 /* @ECU_Address@VPMM_PowerSta_enum@ */ /end MEASUREMENT
/begin MEASUREMENT VPMM_SysPowerMode_enum "" UBYTE SWC_FDC_type_CM_uint8_enum 0 0 0.0 255.0 ECU_ADDRESS 0x0000 /* @ECU_Address@VPMM_SysPowerMode_enum@ */ /end MEASUREMENT
/begin MEASUREMENT VPMM_PwrStaTOSta_enum "" UBYTE SWC_FDC_type_CM_uint8_enum 0 0 0.0 255.0 ECU_ADDRESS 0x0000 /* @ECU_Address@VPMM_PwrStaTOSta_enum@ */ /end MEASUREMENT
/begin MEASUREMENT VPMM_Sched_ChgTOSta_enum "" UBYTE SWC_FDC_type_CM_uint8_ChgTOSta_enum 0 0 0.0 255.0 ECU_ADDRESS 0x0000 /* @ECU_Address@VPMM_Sched_ChgTOSta_enum@ */ /end MEASUREMENT
/begin MEASUREMENT VPMM_LVSilentChrgSta_enum "" UBYTE SWC_FDC_type_CM_uint8_enum 0 0 0.0 255.0 ECU_ADDRESS 0x0000 /* @ECU_Address@VPMM_LVSilentChrgSta_enum@ */ /end MEASUREMENT
/begin MEASUREMENT VPMM_LVSilentChrgLv_enum "" UBYTE SWC_FDC_type_CM_uint8_enum 0 0 0.0 3.0 ECU_ADDRESS 0x0000 /* @ECU_Address@VPMM_LVSilentChrgLv_enum@ */ /end MEASUREMENT
/begin MEASUREMENT VPMM_HWResetSta_enum "" UBYTE SWC_FDC_type_CM_uint8_enum 0 0 0.0 255.0 ECU_ADDRESS 0x0000 /* @ECU_Address@VPMM_HWResetSta_enum@ */ /end MEASUREMENT
/begin MEASUREMENT VPMM_HVChrgPreActionErrSta_enum "" UBYTE SWC_FDC_type_CM_uint8_enum 0 0 0.0 255.0 ECU_ADDRESS 0x0000 /* @ECU_Address@VPMM_HVChrgPreActionErrSta_enum@ */ /end MEASUREMENT
/begin MEASUREMENT VDKC_DKCBTRSSI_dB "" SBYTE SWC_FDC_type_CM_int8_dB 0 0 -128.0 127.0 ECU_ADDRESS 0x0000 /* @ECU_Address@VDKC_DKCBTRSSI_dB@ */ /end MEASUREMENT
/begin MEASUREMENT VDSC_DISCEnableReq_flg "" UBYTE SWC_FDC_type_CM_boolean_flg 0 0 0.0 1.0 ECU_ADDRESS 0x0000 /* @ECU_Address@VDSC_DISCEnableReq_flg@ */ /end MEASUREMENT
/begin MEASUREMENT VDSC_DISCActiveReq_flg "" UBYTE SWC_FDC_type_CM_boolean_flg 0 0 0.0 1.0 ECU_ADDRESS 0x0000 /* @ECU_Address@VDSC_DISCActiveReq_flg@ */ /end MEASUREMENT
/begin MEASUREMENT VDSC_DISCTurnReq_flg "" UBYTE SWC_FDC_type_CM_boolean_flg 0 0 0.0 1.0 ECU_ADDRESS 0x0000 /* @ECU_Address@VDSC_DISCTurnReq_flg@ */ /end MEASUREMENT
/begin MEASUREMENT VDSC_DISCNotTurnReq_flg "" UBYTE SWC_FDC_type_CM_boolean_flg 0 0 0.0 1.0 ECU_ADDRESS 0x0000 /* @ECU_Address@VDSC_DISCNotTurnReq_flg@ */ /end MEASUREMENT
/begin MEASUREMENT VDSC_DISCButtSta_flg "" UBYTE SWC_FDC_type_CM_boolean_flg 0 0 0.0 1.0 ECU_ADDRESS 0x0000 /* @ECU_Address@VDSC_DISCButtSta_flg@ */ /end MEASUREMENT
/begin MEASUREMENT VDSC_TempWarning_flg "" UBYTE SWC_FDC_type_CM_boolean_flg 0 0 0.0 1.0 ECU_ADDRESS 0x0000 /* @ECU_Address@VDSC_TempWarning_flg@ */ /end MEASUREMENT
/begin MEASUREMENT VDSC_DISCTurn_flg "" UBYTE SWC_FDC_type_CM_boolean_flg 0 0 0.0 1.0 ECU_ADDRESS 0x0000 /* @ECU_Address@VDSC_DISCTurn_flg@ */ /end MEASUREMENT
/begin MEASUREMENT VDSC_DISCLow_flg "" UBYTE SWC_FDC_type_CM_boolean_flg 0 0 0.0 1.0 ECU_ADDRESS 0x0000 /* @ECU_Address@VDSC_DISCLow_flg@ */ /end MEASUREMENT
/begin MEASUREMENT VDSC_DISCActing_flg "" UBYTE SWC_FDC_type_CM_boolean_flg 0 0 0.0 1.0 ECU_ADDRESS 0x0000 /* @ECU_Address@VDSC_DISCActing_flg@ */ /end MEASUREMENT
/begin MEASUREMENT VDSC_ModeSwitch_flg "" UBYTE SWC_FDC_type_CM_boolean_flg 0 0 0.0 1.0 ECU_ADDRESS 0x0000 /* @ECU_Address@VDSC_ModeSwitch_flg@ */ /end MEASUREMENT
/begin MEASUREMENT VSYS_NvWriteReq_flg "" UBYTE SWC_FDC_type_CM_boolean_flg 0 0 0.0 1.0 ECU_ADDRESS 0x0000 /* @ECU_Address@VSYS_NvWriteReq_flg@ */ /end MEASUREMENT
/begin MEASUREMENT VSYS_NvWriteReqRisingEdge_flg "" UBYTE SWC_FDC_type_CM_boolean_flg 0 0 0.0 1.0 ECU_ADDRESS 0x0000 /* @ECU_Address@VSYS_NvWriteReqRisingEdge_flg@ */ /end MEASUREMENT
/begin MEASUREMENT VSYS_NvWriteForSleep_flg "" UBYTE SWC_FDC_type_CM_boolean_flg 0 0 0.0 1.0 ECU_ADDRESS 0x0000 /* @ECU_Address@VSYS_NvWriteForSleep_flg@ */ /end MEASUREMENT
/begin MEASUREMENT VSYS_FdcSlpReq_flg "" UBYTE SWC_FDC_type_CM_boolean_flg 0 0 0.0 1.0 ECU_ADDRESS 0x0000 /* @ECU_Address@VSYS_FdcSlpReq_flg@ */ /end MEASUREMENT
/begin MEASUREMENT VSYS_FdcSlpReqRisingEdge_flg "" UBYTE SWC_FDC_type_CM_boolean_flg 0 0 0.0 1.0 ECU_ADDRESS 0x0000 /* @ECU_Address@VSYS_FdcSlpReqRisingEdge_flg@ */ /end MEASUREMENT
/begin MEASUREMENT VSYS_AcoreRebootCmdACK_flg "" UBYTE SWC_FDC_type_CM_boolean_flg 0 0 0.0 1.0 ECU_ADDRESS 0x0000 /* @ECU_Address@VSYS_AcoreRebootCmdACK_flg@ */ /end MEASUREMENT
/begin MEASUREMENT VSYS_AcoreRebootCmdACKLatch_flg "" UBYTE SWC_FDC_type_CM_boolean_flg 0 0 0.0 1.0 ECU_ADDRESS 0x0000 /* @ECU_Address@VSYS_AcoreRebootCmdACKLatch_flg@ */ /end MEASUREMENT
/begin MEASUREMENT VSYS_NvWriteOnChange_flg "" UBYTE SWC_FDC_type_CM_boolean_flg 0 0 0.0 1.0 ECU_ADDRESS 0x0000 /* @ECU_Address@VSYS_NvWriteOnChange_flg@ */ /end MEASUREMENT
/begin MEASUREMENT VDKC_DKCDecryptionError_flg "" UBYTE SWC_FDC_type_CM_boolean_flg 0 0 0.0 1.0 ECU_ADDRESS 0x0000 /* @ECU_Address@VDKC_DKCDecryptionError_flg@ */ /end MEASUREMENT
/begin MEASUREMENT VDKC_DKCTimeSNCorrect_flg "" UBYTE SWC_FDC_type_CM_boolean_flg 0 0 0.0 1.0 ECU_ADDRESS 0x0000 /* @ECU_Address@VDKC_DKCTimeSNCorrect_flg@ */ /end MEASUREMENT
/begin MEASUREMENT VDKC_CANMsgValidZONEDRFR_flg "" UBYTE SWC_FDC_type_CM_boolean_flg 0 0 0.0 1.0 ECU_ADDRESS 0x0000 /* @ECU_Address@VDKC_CANMsgValidZONEDRFR_flg@ */ /end MEASUREMENT
/begin MEASUREMENT VDKC_UIDButtonUnlock_flg "" UBYTE SWC_FDC_type_CM_boolean_flg 0 0 0.0 1.0 ECU_ADDRESS 0x0000 /* @ECU_Address@VDKC_UIDButtonUnlock_flg@ */ /end MEASUREMENT
/begin MEASUREMENT VDKC_UIDButtonLock_flg "" UBYTE SWC_FDC_type_CM_boolean_flg 0 0 0.0 1.0 ECU_ADDRESS 0x0000 /* @ECU_Address@VDKC_UIDButtonLock_flg@ */ /end MEASUREMENT
/begin MEASUREMENT VDKC_UIDButtonFrontHood_flg "" UBYTE SWC_FDC_type_CM_boolean_flg 0 0 0.0 1.0 ECU_ADDRESS 0x0000 /* @ECU_Address@VDKC_UIDButtonFrontHood_flg@ */ /end MEASUREMENT
/begin MEASUREMENT VDKC_UIDButtonStartPress_flg "" UBYTE SWC_FDC_type_CM_boolean_flg 0 0 0.0 1.0 ECU_ADDRESS 0x0000 /* @ECU_Address@VDKC_UIDButtonStartPress_flg@ */ /end MEASUREMENT
/begin MEASUREMENT VDKC_ACCSWSta_flg "" UBYTE SWC_FDC_type_CM_boolean_flg 0 0 0.0 1.0 ECU_ADDRESS 0x0000 /* @ECU_Address@VDKC_ACCSWSta_flg@ */ /end MEASUREMENT
/begin MEASUREMENT VDKC_UserReqRAPTrigger_flg "" UBYTE SWC_FDC_type_CM_boolean_flg 0 0 0.0 1.0 ECU_ADDRESS 0x0000 /* @ECU_Address@VDKC_UserReqRAPTrigger_flg@ */ /end MEASUREMENT
/begin MEASUREMENT VDKC_RAPStopTrigger_flg "" UBYTE SWC_FDC_type_CM_boolean_flg 0 0 0.0 1.0 ECU_ADDRESS 0x0000 /* @ECU_Address@VDKC_RAPStopTrigger_flg@ */ /end MEASUREMENT
/begin MEASUREMENT VDKC_UIDButtonRemTailGate_flg "" UBYTE SWC_FDC_type_CM_boolean_flg 0 0 0.0 1.0 ECU_ADDRESS 0x0000 /* @ECU_Address@VDKC_UIDButtonRemTailGate_flg@ */ /end MEASUREMENT
/begin MEASUREMENT VDKC_UIDButtonChargeCover_flg "" UBYTE SWC_FDC_type_CM_boolean_flg 0 0 0.0 1.0 ECU_ADDRESS 0x0000 /* @ECU_Address@VDKC_UIDButtonChargeCover_flg@ */ /end MEASUREMENT
/begin MEASUREMENT VDKC_UIDButtonCarSearch_flg "" UBYTE SWC_FDC_type_CM_boolean_flg 0 0 0.0 1.0 ECU_ADDRESS 0x0000 /* @ECU_Address@VDKC_UIDButtonCarSearch_flg@ */ /end MEASUREMENT
/begin MEASUREMENT VDKC_DKCPCmdFallingEdge_flg "" UBYTE SWC_FDC_type_CM_boolean_flg 0 0 0.0 1.0 ECU_ADDRESS 0x0000 /* @ECU_Address@VDKC_DKCPCmdFallingEdge_flg@ */ /end MEASUREMENT
/begin MEASUREMENT VDKC_UWBDetWithinUnlockZone_flg "" UBYTE SWC_FDC_type_CM_boolean_flg 0 0 0.0 1.0 ECU_ADDRESS 0x0000 /* @ECU_Address@VDKC_UWBDetWithinUnlockZone_flg@ */ /end MEASUREMENT
/begin MEASUREMENT VDKC_NFCAutoLockTimerLatch_flg "" UBYTE SWC_FDC_type_CM_boolean_flg 0 0 0.0 1.0 ECU_ADDRESS 0x0000 /* @ECU_Address@VDKC_NFCAutoLockTimerLatch_flg@ */ /end MEASUREMENT
/begin MEASUREMENT VDKC_NFCDetJudgeAutoLock_flg "" UBYTE SWC_FDC_type_CM_boolean_flg 0 0 0.0 1.0 ECU_ADDRESS 0x0000 /* @ECU_Address@VDKC_NFCDetJudgeAutoLock_flg@ */ /end MEASUREMENT
/begin MEASUREMENT VDKC_UIDAutoLockTimerLatch_flg "" UBYTE SWC_FDC_type_CM_boolean_flg 0 0 0.0 1.0 ECU_ADDRESS 0x0000 /* @ECU_Address@VDKC_UIDAutoLockTimerLatch_flg@ */ /end MEASUREMENT
/begin MEASUREMENT VDKC_UIDButtJudgeAutoLock_flg "" UBYTE SWC_FDC_type_CM_boolean_flg 0 0 0.0 1.0 ECU_ADDRESS 0x0000 /* @ECU_Address@VDKC_UIDButtJudgeAutoLock_flg@ */ /end MEASUREMENT
/begin MEASUREMENT VDKC_AutoLockReqtoLock_flg "" UBYTE SWC_FDC_type_CM_boolean_flg 0 0 0.0 1.0 ECU_ADDRESS 0x0000 /* @ECU_Address@VDKC_AutoLockReqtoLock_flg@ */ /end MEASUREMENT
/begin MEASUREMENT VDKC_PMMChgToReady_flg "" UBYTE SWC_FDC_type_CM_boolean_flg 0 0 0.0 1.0 ECU_ADDRESS 0x0000 /* @ECU_Address@VDKC_PMMChgToReady_flg@ */ /end MEASUREMENT
/begin MEASUREMENT VDKC_TrunkHandleSW_flg "" UBYTE SWC_FDC_type_CM_boolean_flg 0 0 0.0 1.0 ECU_ADDRESS 0x0000 /* @ECU_Address@VDKC_TrunkHandleSW_flg@ */ /end MEASUREMENT
/begin MEASUREMENT VDKC_PressSW2FallingEdge_flg "" UBYTE SWC_FDC_type_CM_boolean_flg 0 0 0.0 1.0 ECU_ADDRESS 0x0000 /* @ECU_Address@VDKC_PressSW2FallingEdge_flg@ */ /end MEASUREMENT
/begin MEASUREMENT VDKC_PressSW2RisingEdge_flg "" UBYTE SWC_FDC_type_CM_boolean_flg 0 0 0.0 1.0 ECU_ADDRESS 0x0000 /* @ECU_Address@VDKC_PressSW2RisingEdge_flg@ */ /end MEASUREMENT
/begin MEASUREMENT VDKC_PressSW1RisingEdge_flg "" UBYTE SWC_FDC_type_CM_boolean_flg 0 0 0.0 1.0 ECU_ADDRESS 0x0000 /* @ECU_Address@VDKC_PressSW1RisingEdge_flg@ */ /end MEASUREMENT
/begin MEASUREMENT VDKC_PrsSW2TGFalEdgeOutPS_flg "" UBYTE SWC_FDC_type_CM_boolean_flg 0 0 0.0 1.0 ECU_ADDRESS 0x0000 /* @ECU_Address@VDKC_PrsSW2TGFalEdgeOutPS_flg@ */ /end MEASUREMENT
/begin MEASUREMENT VDKC_PrsSW2TGFalEdgeInPS_flg "" UBYTE SWC_FDC_type_CM_boolean_flg 0 0 0.0 1.0 ECU_ADDRESS 0x0000 /* @ECU_Address@VDKC_PrsSW2TGFalEdgeInPS_flg@ */ /end MEASUREMENT
/begin MEASUREMENT VDKC_TGFalEdgeInPS_flg "" UBYTE SWC_FDC_type_CM_boolean_flg 0 0 0.0 1.0 ECU_ADDRESS 0x0000 /* @ECU_Address@VDKC_TGFalEdgeInPS_flg@ */ /end MEASUREMENT
/begin MEASUREMENT VDKC_InnerSW2TimerLatch_flg "" UBYTE SWC_FDC_type_CM_boolean_flg 0 0 0.0 1.0 ECU_ADDRESS 0x0000 /* @ECU_Address@VDKC_InnerSW2TimerLatch_flg@ */ /end MEASUREMENT
/begin MEASUREMENT VDKC_InnerSW2CloseTimeOut_flg "" UBYTE SWC_FDC_type_CM_boolean_flg 0 0 0.0 1.0 ECU_ADDRESS 0x0000 /* @ECU_Address@VDKC_InnerSW2CloseTimeOut_flg@ */ /end MEASUREMENT
/begin MEASUREMENT VDKC_PrsSW2TGNoEdgeTimeOut_flg "" UBYTE SWC_FDC_type_CM_boolean_flg 0 0 0.0 1.0 ECU_ADDRESS 0x0000 /* @ECU_Address@VDKC_PrsSW2TGNoEdgeTimeOut_flg@ */ /end MEASUREMENT
/begin MEASUREMENT VDKC_PressSW1FallingEdge_flg "" UBYTE SWC_FDC_type_CM_boolean_flg 0 0 0.0 1.0 ECU_ADDRESS 0x0000 /* @ECU_Address@VDKC_PressSW1FallingEdge_flg@ */ /end MEASUREMENT
/begin MEASUREMENT VDKC_InnerSW1TimerLatch_flg "" UBYTE SWC_FDC_type_CM_boolean_flg 0 0 0.0 1.0 ECU_ADDRESS 0x0000 /* @ECU_Address@VDKC_InnerSW1TimerLatch_flg@ */ /end MEASUREMENT
/begin MEASUREMENT VDKC_InnerSW1CloseTimeOut_flg "" UBYTE SWC_FDC_type_CM_boolean_flg 0 0 0.0 1.0 ECU_ADDRESS 0x0000 /* @ECU_Address@VDKC_InnerSW1CloseTimeOut_flg@ */ /end MEASUREMENT
/begin MEASUREMENT VDKC_RemTGCmdTimerLatch_flg "" UBYTE SWC_FDC_type_CM_boolean_flg 0 0 0.0 1.0 ECU_ADDRESS 0x0000 /* @ECU_Address@VDKC_RemTGCmdTimerLatch_flg@ */ /end MEASUREMENT
/begin MEASUREMENT VDKC_RemTGCmdCloseTimeOut_flg "" UBYTE SWC_FDC_type_CM_boolean_flg 0 0 0.0 1.0 ECU_ADDRESS 0x0000 /* @ECU_Address@VDKC_RemTGCmdCloseTimeOut_flg@ */ /end MEASUREMENT
/begin MEASUREMENT VDKC_PrsSW1orDKCNoEdgTimOut_flg "" UBYTE SWC_FDC_type_CM_boolean_flg 0 0 0.0 1.0 ECU_ADDRESS 0x0000 /* @ECU_Address@VDKC_PrsSW1orDKCNoEdgTimOut_flg@ */ /end MEASUREMENT
/begin MEASUREMENT VDKC_UWBDetAreaChangeToLock_flg "" UBYTE SWC_FDC_type_CM_boolean_flg 0 0 0.0 1.0 ECU_ADDRESS 0x0000 /* @ECU_Address@VDKC_UWBDetAreaChangeToLock_flg@ */ /end MEASUREMENT
/begin MEASUREMENT VDKC_UWBDetAreaChaToUnlock_flg "" UBYTE SWC_FDC_type_CM_boolean_flg 0 0 0.0 1.0 ECU_ADDRESS 0x0000 /* @ECU_Address@VDKC_UWBDetAreaChaToUnlock_flg@ */ /end MEASUREMENT
/begin MEASUREMENT VDKC_UIDDetRSSIChgToLock_flg "" UBYTE SWC_FDC_type_CM_boolean_flg 0 0 0.0 1.0 ECU_ADDRESS 0x0000 /* @ECU_Address@VDKC_UIDDetRSSIChgToLock_flg@ */ /end MEASUREMENT
/begin MEASUREMENT VDKC_UWBDetKeepUnltoOther_flg "" UBYTE SWC_FDC_type_CM_boolean_flg 0 0 0.0 1.0 ECU_ADDRESS 0x0000 /* @ECU_Address@VDKC_UWBDetKeepUnltoOther_flg@ */ /end MEASUREMENT
/begin MEASUREMENT VDKC_UnlockZoneFallEdge_flg "" UBYTE SWC_FDC_type_CM_boolean_flg 0 0 0.0 1.0 ECU_ADDRESS 0x0000 /* @ECU_Address@VDKC_UnlockZoneFallEdge_flg@ */ /end MEASUREMENT
/begin MEASUREMENT VDKC_StoreUnlockAreaEdge_flg "" UBYTE SWC_FDC_type_CM_boolean_flg 0 0 0.0 1.0 ECU_ADDRESS 0x0000 /* @ECU_Address@VDKC_StoreUnlockAreaEdge_flg@ */ /end MEASUREMENT
/begin MEASUREMENT VDKC_UnavChgToUnlockZone_flg "" UBYTE SWC_FDC_type_CM_boolean_flg 0 0 0.0 1.0 ECU_ADDRESS 0x0000 /* @ECU_Address@VDKC_UnavChgToUnlockZone_flg@ */ /end MEASUREMENT
/begin MEASUREMENT VDKC_GrayChgToUnlockZone_flg "" UBYTE SWC_FDC_type_CM_boolean_flg 0 0 0.0 1.0 ECU_ADDRESS 0x0000 /* @ECU_Address@VDKC_GrayChgToUnlockZone_flg@ */ /end MEASUREMENT
/begin MEASUREMENT VDKC_UnORGrChgToUnlZone_flg "" UBYTE SWC_FDC_type_CM_boolean_flg 0 0 0.0 1.0 ECU_ADDRESS 0x0000 /* @ECU_Address@VDKC_UnORGrChgToUnlZone_flg@ */ /end MEASUREMENT
/begin MEASUREMENT VDKC_UnavToUnlReq_flg "" UBYTE SWC_FDC_type_CM_boolean_flg 0 0 0.0 1.0 ECU_ADDRESS 0x0000 /* @ECU_Address@VDKC_UnavToUnlReq_flg@ */ /end MEASUREMENT
/begin MEASUREMENT VDKC_UnavToUnlReqUnlock_flg "" UBYTE SWC_FDC_type_CM_boolean_flg 0 0 0.0 1.0 ECU_ADDRESS 0x0000 /* @ECU_Address@VDKC_UnavToUnlReqUnlock_flg@ */ /end MEASUREMENT
/begin MEASUREMENT VDKC_PMMCrash_flg "" UBYTE SWC_FDC_type_CM_boolean_flg 0 0 0.0 1.0 ECU_ADDRESS 0x0000 /* @ECU_Address@VDKC_PMMCrash_flg@ */ /end MEASUREMENT
/begin MEASUREMENT VDKC_JudgKeyMissSta_flg "" UBYTE SWC_FDC_type_CM_boolean_flg 0 0 0.0 1.0 ECU_ADDRESS 0x0000 /* @ECU_Address@VDKC_JudgKeyMissSta_flg@ */ /end MEASUREMENT
/begin MEASUREMENT VDKC_KeyMissSta_flg "" UBYTE SWC_FDC_type_CM_boolean_flg 0 0 0.0 1.0 ECU_ADDRESS 0x0000 /* @ECU_Address@VDKC_KeyMissSta_flg@ */ /end MEASUREMENT
/begin MEASUREMENT VDKC_UWBOnOff_flg "" UBYTE SWC_FDC_type_CM_boolean_flg 0 0 0.0 1.0 ECU_ADDRESS 0x0000 /* @ECU_Address@VDKC_UWBOnOff_flg@ */ /end MEASUREMENT
/begin MEASUREMENT VDKC_UIDLowPowerSta_flg "" UBYTE SWC_FDC_type_CM_boolean_flg 0 0 0.0 1.0 ECU_ADDRESS 0x0000 /* @ECU_Address@VDKC_UIDLowPowerSta_flg@ */ /end MEASUREMENT
/begin MEASUREMENT VDKC_DKCCmdHandTimerActive_flg "" UBYTE SWC_FDC_type_CM_boolean_flg 0 0 0.0 1.0 ECU_ADDRESS 0x0000 /* @ECU_Address@VDKC_DKCCmdHandTimerActive_flg@ */ /end MEASUREMENT
/begin MEASUREMENT VDKC_DKCTGTimerActive_flg "" UBYTE SWC_FDC_type_CM_boolean_flg 0 0 0.0 1.0 ECU_ADDRESS 0x0000 /* @ECU_Address@VDKC_DKCTGTimerActive_flg@ */ /end MEASUREMENT
/begin MEASUREMENT VDKC_AutoLeavePSTimerLatch_flg "" UBYTE SWC_FDC_type_CM_boolean_flg 0 0 0.0 1.0 ECU_ADDRESS 0x0000 /* @ECU_Address@VDKC_AutoLeavePSTimerLatch_flg@ */ /end MEASUREMENT
/begin MEASUREMENT VDKC_DKCAutoJudgTimerActive_flg "" UBYTE SWC_FDC_type_CM_boolean_flg 0 0 0.0 1.0 ECU_ADDRESS 0x0000 /* @ECU_Address@VDKC_DKCAutoJudgTimerActive_flg@ */ /end MEASUREMENT
/begin MEASUREMENT VDKC_UWBDetAreaChgWelcome_flg "" UBYTE SWC_FDC_type_CM_boolean_flg 0 0 0.0 1.0 ECU_ADDRESS 0x0000 /* @ECU_Address@VDKC_UWBDetAreaChgWelcome_flg@ */ /end MEASUREMENT
/begin MEASUREMENT VDKC_DKCOtherTimerActive_flg "" UBYTE SWC_FDC_type_CM_boolean_flg 0 0 0.0 1.0 ECU_ADDRESS 0x0000 /* @ECU_Address@VDKC_DKCOtherTimerActive_flg@ */ /end MEASUREMENT
/begin MEASUREMENT VDKC_UIDButtonBackWPress_flg "" UBYTE SWC_FDC_type_CM_boolean_flg 0 0 0.0 1.0 ECU_ADDRESS 0x0000 /* @ECU_Address@VDKC_UIDButtonBackWPress_flg@ */ /end MEASUREMENT
/begin MEASUREMENT VDKC_UIDButtonBackWRelease_flg "" UBYTE SWC_FDC_type_CM_boolean_flg 0 0 0.0 1.0 ECU_ADDRESS 0x0000 /* @ECU_Address@VDKC_UIDButtonBackWRelease_flg@ */ /end MEASUREMENT
/begin MEASUREMENT VDKC_UIDButtonForWPress_flg "" UBYTE SWC_FDC_type_CM_boolean_flg 0 0 0.0 1.0 ECU_ADDRESS 0x0000 /* @ECU_Address@VDKC_UIDButtonForWPress_flg@ */ /end MEASUREMENT
/begin MEASUREMENT VDKC_UIDBackWReset_flg "" UBYTE SWC_FDC_type_CM_boolean_flg 0 0 0.0 1.0 ECU_ADDRESS 0x0000 /* @ECU_Address@VDKC_UIDBackWReset_flg@ */ /end MEASUREMENT
/begin MEASUREMENT VDKC_UIDButtonForWRelease_flg "" UBYTE SWC_FDC_type_CM_boolean_flg 0 0 0.0 1.0 ECU_ADDRESS 0x0000 /* @ECU_Address@VDKC_UIDButtonForWRelease_flg@ */ /end MEASUREMENT
/begin MEASUREMENT VDKC_UIDForWReset_flg "" UBYTE SWC_FDC_type_CM_boolean_flg 0 0 0.0 1.0 ECU_ADDRESS 0x0000 /* @ECU_Address@VDKC_UIDForWReset_flg@ */ /end MEASUREMENT
/begin MEASUREMENT VDKC_RPAStandbyTcTrig_flg "" UBYTE SWC_FDC_type_CM_boolean_flg 0 0 0.0 1.0 ECU_ADDRESS 0x0000 /* @ECU_Address@VDKC_RPAStandbyTcTrig_flg@ */ /end MEASUREMENT
/begin MEASUREMENT VDKC_DKCRAPSTimerActive_flg "" UBYTE SWC_FDC_type_CM_boolean_flg 0 0 0.0 1.0 ECU_ADDRESS 0x0000 /* @ECU_Address@VDKC_DKCRAPSTimerActive_flg@ */ /end MEASUREMENT
/begin MEASUREMENT VDKC_FDCDKCTimerActive_flg "" UBYTE SWC_FDC_type_CM_boolean_flg 0 0 0.0 1.0 ECU_ADDRESS 0x0000 /* @ECU_Address@VDKC_FDCDKCTimerActive_flg@ */ /end MEASUREMENT
/begin MEASUREMENT VDKC_FDCKeyAllowSleep_flg "" UBYTE SWC_FDC_type_CM_boolean_flg 0 0 0.0 1.0 ECU_ADDRESS 0x0000 /* @ECU_Address@VDKC_FDCKeyAllowSleep_flg@ */ /end MEASUREMENT
/begin MEASUREMENT VDKC_FDCDKCAllowSleep_flg "" UBYTE SWC_FDC_type_CM_boolean_flg 0 0 0.0 1.0 ECU_ADDRESS 0x0000 /* @ECU_Address@VDKC_FDCDKCAllowSleep_flg@ */ /end MEASUREMENT
/begin MEASUREMENT VDKC_AllowSleep_flg "" UBYTE SWC_FDC_type_CM_boolean_flg 0 0 0.0 1.0 ECU_ADDRESS 0x0000 /* @ECU_Address@VDKC_AllowSleep_flg@ */ /end MEASUREMENT
/begin MEASUREMENT VDKC_UIDButtonStartRelease_flg "" UBYTE SWC_FDC_type_CM_boolean_flg 0 0 0.0 1.0 ECU_ADDRESS 0x0000 /* @ECU_Address@VDKC_UIDButtonStartRelease_flg@ */ /end MEASUREMENT
/begin MEASUREMENT VDKC_WaitAPMJuUserReqTout_flg "" UBYTE SWC_FDC_type_CM_boolean_flg 0 0 0.0 1.0 ECU_ADDRESS 0x0000 /* @ECU_Address@VDKC_WaitAPMJuUserReqTout_flg@ */ /end MEASUREMENT
/begin MEASUREMENT VDKC_WaitAPMReqTimeout_flg "" UBYTE SWC_FDC_type_CM_boolean_flg 0 0 0.0 1.0 ECU_ADDRESS 0x0000 /* @ECU_Address@VDKC_WaitAPMReqTimeout_flg@ */ /end MEASUREMENT
/begin MEASUREMENT VDKC_RPAWait60sReqTout_flg "" UBYTE SWC_FDC_type_CM_boolean_flg 0 0 0.0 1.0 ECU_ADDRESS 0x0000 /* @ECU_Address@VDKC_RPAWait60sReqTout_flg@ */ /end MEASUREMENT
/begin MEASUREMENT VDKC_NFCJudgeAutoLeavePS_flg "" UBYTE SWC_FDC_type_CM_boolean_flg 0 0 0.0 1.0 ECU_ADDRESS 0x0000 /* @ECU_Address@VDKC_NFCJudgeAutoLeavePS_flg@ */ /end MEASUREMENT
/begin MEASUREMENT VDKC_UIDBatLowVolt_flg "" UBYTE SWC_FDC_type_CM_boolean_flg 0 0 0.0 1.0 ECU_ADDRESS 0x0000 /* @ECU_Address@VDKC_UIDBatLowVolt_flg@ */ /end MEASUREMENT
/begin MEASUREMENT VNMM_NoNMIdDebounced_flg "" UBYTE SWC_FDC_type_CM_boolean_flg 0 0 0.0 1.0 ECU_ADDRESS 0x0000 /* @ECU_Address@VNMM_NoNMIdDebounced_flg@ */ /end MEASUREMENT
/begin MEASUREMENT VNMM_NetworkReqCalled_flg "" UBYTE SWC_FDC_type_CM_boolean_flg 0 0 0.0 1.0 ECU_ADDRESS 0x0000 /* @ECU_Address@VNMM_NetworkReqCalled_flg@ */ /end MEASUREMENT
/begin MEASUREMENT VNMM_HandledAcoreRdySlp_flg "" UBYTE SWC_FDC_type_CM_boolean_flg 0 0 0.0 1.0 ECU_ADDRESS 0x0000 /* @ECU_Address@VNMM_HandledAcoreRdySlp_flg@ */ /end MEASUREMENT
/begin MEASUREMENT VNMM_AppWakeReq_flg "" UBYTE SWC_FDC_type_CM_boolean_flg 0 0 0.0 1.0 ECU_ADDRESS 0x0000 /* @ECU_Address@VNMM_AppWakeReq_flg@ */ /end MEASUREMENT
/begin MEASUREMENT VNMM_AllCANTxReq_flg "" UBYTE SWC_FDC_type_CM_boolean_flg 0 0 0.0 1.0 ECU_ADDRESS 0x0000 /* @ECU_Address@VNMM_AllCANTxReq_flg@ */ /end MEASUREMENT
/begin MEASUREMENT VNMM_NMmTxReq_flg "" UBYTE SWC_FDC_type_CM_boolean_flg 0 0 0.0 1.0 ECU_ADDRESS 0x0000 /* @ECU_Address@VNMM_NMmTxReq_flg@ */ /end MEASUREMENT
/begin MEASUREMENT VNMM_NetworkReq_flg "" UBYTE SWC_FDC_type_CM_boolean_flg 0 0 0.0 1.0 ECU_ADDRESS 0x0000 /* @ECU_Address@VNMM_NetworkReq_flg@ */ /end MEASUREMENT
/begin MEASUREMENT VNMM_CSB_flg "" UBYTE SWC_FDC_type_CM_boolean_flg 0 0 0.0 1.0 ECU_ADDRESS 0x0000 /* @ECU_Address@VNMM_CSB_flg@ */ /end MEASUREMENT
/begin MEASUREMENT VNMM_PNI_flg "" UBYTE SWC_FDC_type_CM_boolean_flg 0 0 0.0 1.0 ECU_ADDRESS 0x0000 /* @ECU_Address@VNMM_PNI_flg@ */ /end MEASUREMENT
/begin MEASUREMENT VNMM_RptMsgReq_flg "" UBYTE SWC_FDC_type_CM_boolean_flg 0 0 0.0 1.0 ECU_ADDRESS 0x0000 /* @ECU_Address@VNMM_RptMsgReq_flg@ */ /end MEASUREMENT
/begin MEASUREMENT VNMM_ActiveWU_flg "" UBYTE SWC_FDC_type_CM_boolean_flg 0 0 0.0 1.0 ECU_ADDRESS 0x0000 /* @ECU_Address@VNMM_ActiveWU_flg@ */ /end MEASUREMENT
/begin MEASUREMENT VTHC_CCUSyncLampSts_flg "" UBYTE SWC_FDC_type_CM_boolean_flg 0 0 0.0 1.0 ECU_ADDRESS 0x0000 /* @ECU_Address@VTHC_CCUSyncLampSts_flg@ */ /end MEASUREMENT
/begin MEASUREMENT VTHC_FDSOTXVCmd_flg "" UBYTE SWC_FDC_type_CM_boolean_flg 0 0 0.0 1.0 ECU_ADDRESS 0x0000 /* @ECU_Address@VTHC_FDSOTXVCmd_flg@ */ /end MEASUREMENT
/begin MEASUREMENT VTHC_CCUACLampSts_flg "" UBYTE SWC_FDC_type_CM_boolean_flg 0 0 0.0 1.0 ECU_ADDRESS 0x0000 /* @ECU_Address@VTHC_CCUACLampSts_flg@ */ /end MEASUREMENT
/begin MEASUREMENT VTHC_CCUAutoLampSts_flg "" UBYTE SWC_FDC_type_CM_boolean_flg 0 0 0.0 1.0 ECU_ADDRESS 0x0000 /* @ECU_Address@VTHC_CCUAutoLampSts_flg@ */ /end MEASUREMENT
/begin MEASUREMENT VTHC_CCUACMaxLampSts_flg "" UBYTE SWC_FDC_type_CM_boolean_flg 0 0 0.0 1.0 ECU_ADDRESS 0x0000 /* @ECU_Address@VTHC_CCUACMaxLampSts_flg@ */ /end MEASUREMENT
/begin MEASUREMENT VTHC_Z1TUP_flg "" UBYTE SWC_FDC_type_CM_boolean_flg 0 0 0.0 1.0 ECU_ADDRESS 0x0000 /* @ECU_Address@VTHC_Z1TUP_flg@ */ /end MEASUREMENT
/begin MEASUREMENT VTHC_Z1TDN_flg "" UBYTE SWC_FDC_type_CM_boolean_flg 0 0 0.0 1.0 ECU_ADDRESS 0x0000 /* @ECU_Address@VTHC_Z1TDN_flg@ */ /end MEASUREMENT
/begin MEASUREMENT VTHC_Z2TUP_flg "" UBYTE SWC_FDC_type_CM_boolean_flg 0 0 0.0 1.0 ECU_ADDRESS 0x0000 /* @ECU_Address@VTHC_Z2TUP_flg@ */ /end MEASUREMENT
/begin MEASUREMENT VTHC_Z2TDN_flg "" UBYTE SWC_FDC_type_CM_boolean_flg 0 0 0.0 1.0 ECU_ADDRESS 0x0000 /* @ECU_Address@VTHC_Z2TDN_flg@ */ /end MEASUREMENT
/begin MEASUREMENT VTHC_ACForceOFF_flg "" UBYTE SWC_FDC_type_CM_boolean_flg 0 0 0.0 1.0 ECU_ADDRESS 0x0000 /* @ECU_Address@VTHC_ACForceOFF_flg@ */ /end MEASUREMENT
/begin MEASUREMENT VVMC_LKATOIFault_flg "" UBYTE SWC_FDC_type_CM_boolean_flg 0 0 0.0 1.0 ECU_ADDRESS 0x0000 /* @ECU_Address@VVMC_LKATOIFault_flg@ */ /end MEASUREMENT
/begin MEASUREMENT VVMC_ADASFaultSta_flg "" UBYTE SWC_FDC_type_CM_boolean_flg 0 0 0.0 1.0 ECU_ADDRESS 0x0000 /* @ECU_Address@VVMC_ADASFaultSta_flg@ */ /end MEASUREMENT
/begin MEASUREMENT VVMC_AEBVehHoldReq_flg "" UBYTE SWC_FDC_type_CM_boolean_flg 0 0 0.0 1.0 ECU_ADDRESS 0x0000 /* @ECU_Address@VVMC_AEBVehHoldReq_flg@ */ /end MEASUREMENT
/begin MEASUREMENT VVMC_ADASShftPosnReqA_flg "" UBYTE SWC_FDC_type_CM_boolean_flg 0 0 0.0 1.0 ECU_ADDRESS 0x0000 /* @ECU_Address@VVMC_ADASShftPosnReqA_flg@ */ /end MEASUREMENT
/begin MEASUREMENT VVMC_ADASForceIdle_flg "" UBYTE SWC_FDC_type_CM_boolean_flg 0 0 0.0 1.0 ECU_ADDRESS 0x0000 /* @ECU_Address@VVMC_ADASForceIdle_flg@ */ /end MEASUREMENT
/begin MEASUREMENT VVMC_HazardWarningReq_flg "" UBYTE SWC_FDC_type_CM_boolean_flg 0 0 0.0 1.0 ECU_ADDRESS 0x0000 /* @ECU_Address@VVMC_HazardWarningReq_flg@ */ /end MEASUREMENT
/begin MEASUREMENT VVMC_RightTurnLightReq_flg "" UBYTE SWC_FDC_type_CM_boolean_flg 0 0 0.0 1.0 ECU_ADDRESS 0x0000 /* @ECU_Address@VVMC_RightTurnLightReq_flg@ */ /end MEASUREMENT
/begin MEASUREMENT VVMC_LeftTurnLightReq_flg "" UBYTE SWC_FDC_type_CM_boolean_flg 0 0 0.0 1.0 ECU_ADDRESS 0x0000 /* @ECU_Address@VVMC_LeftTurnLightReq_flg@ */ /end MEASUREMENT
/begin MEASUREMENT VVMC_ADASFltWrnReq_flg "" UBYTE SWC_FDC_type_CM_boolean_flg 0 0 0.0 1.0 ECU_ADDRESS 0x0000 /* @ECU_Address@VVMC_ADASFltWrnReq_flg@ */ /end MEASUREMENT
/begin MEASUREMENT VVMC_ACCTakeoverReq_flg "" UBYTE SWC_FDC_type_CM_boolean_flg 0 0 0.0 1.0 ECU_ADDRESS 0x0000 /* @ECU_Address@VVMC_ACCTakeoverReq_flg@ */ /end MEASUREMENT
/begin MEASUREMENT VVMC_LKAHODDisplayWarning_flg "" UBYTE SWC_FDC_type_CM_boolean_flg 0 0 0.0 1.0 ECU_ADDRESS 0x0000 /* @ECU_Address@VVMC_LKAHODDisplayWarning_flg@ */ /end MEASUREMENT
/begin MEASUREMENT VVMC_LKAHODSoundWarning_flg "" UBYTE SWC_FDC_type_CM_boolean_flg 0 0 0.0 1.0 ECU_ADDRESS 0x0000 /* @ECU_Address@VVMC_LKAHODSoundWarning_flg@ */ /end MEASUREMENT
/begin MEASUREMENT VVMC_ADASLDWMute_flg "" UBYTE SWC_FDC_type_CM_boolean_flg 0 0 0.0 1.0 ECU_ADDRESS 0x0000 /* @ECU_Address@VVMC_ADASLDWMute_flg@ */ /end MEASUREMENT
/begin MEASUREMENT VVMC_ADASFCWMute_flg "" UBYTE SWC_FDC_type_CM_boolean_flg 0 0 0.0 1.0 ECU_ADDRESS 0x0000 /* @ECU_Address@VVMC_ADASFCWMute_flg@ */ /end MEASUREMENT
/begin MEASUREMENT VVMC_LVDADisabled_flg "" UBYTE SWC_FDC_type_CM_boolean_flg 0 0 0.0 1.0 ECU_ADDRESS 0x0000 /* @ECU_Address@VVMC_LVDADisabled_flg@ */ /end MEASUREMENT
/begin MEASUREMENT VVMC_LVDAFailinfo_flg "" UBYTE SWC_FDC_type_CM_boolean_flg 0 0 0.0 1.0 ECU_ADDRESS 0x0000 /* @ECU_Address@VVMC_LVDAFailinfo_flg@ */ /end MEASUREMENT
/begin MEASUREMENT VVMC_LVDAWarning_flg "" UBYTE SWC_FDC_type_CM_boolean_flg 0 0 0.0 1.0 ECU_ADDRESS 0x0000 /* @ECU_Address@VVMC_LVDAWarning_flg@ */ /end MEASUREMENT
/begin MEASUREMENT VVMC_LVDAACCStatusInformation_flg "" UBYTE SWC_FDC_type_CM_boolean_flg 0 0 0.0 1.0 ECU_ADDRESS 0x0000 /* @ECU_Address@VVMC_LVDAACCStatusInformation_flg@ */ /end MEASUREMENT
/begin MEASUREMENT VVMC_CCMSASpdWar_flg "" UBYTE SWC_FDC_type_CM_boolean_flg 0 0 0.0 1.0 ECU_ADDRESS 0x0000 /* @ECU_Address@VVMC_CCMSASpdWar_flg@ */ /end MEASUREMENT
/begin MEASUREMENT VTQD_IVIEscapeModeCmd_flg "" UBYTE SWC_FDC_type_CM_boolean_flg 0 0 0.0 1.0 ECU_ADDRESS 0x0000 /* @ECU_Address@VTQD_IVIEscapeModeCmd_flg@ */ /end MEASUREMENT
/begin MEASUREMENT VBCM_APMDoorControlSta_flg "" UBYTE SWC_FDC_type_CM_boolean_flg 0 0 0.0 1.0 ECU_ADDRESS 0x0000 /* @ECU_Address@VBCM_APMDoorControlSta_flg@ */ /end MEASUREMENT
/begin MEASUREMENT VBCM_DrDoorSW_flg "" UBYTE SWC_FDC_type_CM_boolean_flg 0 0 0.0 1.0 ECU_ADDRESS 0x0000 /* @ECU_Address@VBCM_DrDoorSW_flg@ */ /end MEASUREMENT
/begin MEASUREMENT VBCM_PsDoorSW_flg "" UBYTE SWC_FDC_type_CM_boolean_flg 0 0 0.0 1.0 ECU_ADDRESS 0x0000 /* @ECU_Address@VBCM_PsDoorSW_flg@ */ /end MEASUREMENT
/begin MEASUREMENT VBCM_AllDoorSW_flg "" UBYTE SWC_FDC_type_CM_boolean_flg 0 0 0.0 1.0 ECU_ADDRESS 0x0000 /* @ECU_Address@VBCM_AllDoorSW_flg@ */ /end MEASUREMENT
/begin MEASUREMENT VBCM_SleepReq_flg "" UBYTE SWC_FDC_type_CM_boolean_flg 0 0 0.0 1.0 ECU_ADDRESS 0x0000 /* @ECU_Address@VBCM_SleepReq_flg@ */ /end MEASUREMENT
/begin MEASUREMENT VBCM_CrashDetd_flg "" UBYTE SWC_FDC_type_CM_boolean_flg 0 0 0.0 1.0 ECU_ADDRESS 0x0000 /* @ECU_Address@VBCM_CrashDetd_flg@ */ /end MEASUREMENT
/begin MEASUREMENT VBCM_DiagHCrash_flg "" UBYTE SWC_FDC_type_CM_boolean_flg 0 0 0.0 1.0 ECU_ADDRESS 0x0000 /* @ECU_Address@VBCM_DiagHCrash_flg@ */ /end MEASUREMENT
/begin MEASUREMENT VBCM_LBeam_flg "" UBYTE SWC_FDC_type_CM_boolean_flg 0 0 0.0 1.0 ECU_ADDRESS 0x0000 /* @ECU_Address@VBCM_LBeam_flg@ */ /end MEASUREMENT
/begin MEASUREMENT VBCM_HazardIND_flg "" UBYTE SWC_FDC_type_CM_boolean_flg 0 0 0.0 1.0 ECU_ADDRESS 0x0000 /* @ECU_Address@VBCM_HazardIND_flg@ */ /end MEASUREMENT
/begin MEASUREMENT VBCM_AutoWipHSpdENSta_flg "" UBYTE SWC_FDC_type_CM_boolean_flg 0 0 0.0 1.0 ECU_ADDRESS 0x0000 /* @ECU_Address@VBCM_AutoWipHSpdENSta_flg@ */ /end MEASUREMENT
/begin MEASUREMENT VBCM_WiperFixMode_flg "" UBYTE SWC_FDC_type_CM_boolean_flg 0 0 0.0 1.0 ECU_ADDRESS 0x0000 /* @ECU_Address@VBCM_WiperFixMode_flg@ */ /end MEASUREMENT
/begin MEASUREMENT VBCM_FrWiperL_flg "" UBYTE SWC_FDC_type_CM_boolean_flg 0 0 0.0 1.0 ECU_ADDRESS 0x0000 /* @ECU_Address@VBCM_FrWiperL_flg@ */ /end MEASUREMENT
/begin MEASUREMENT VBCM_FrWiperH_flg "" UBYTE SWC_FDC_type_CM_boolean_flg 0 0 0.0 1.0 ECU_ADDRESS 0x0000 /* @ECU_Address@VBCM_FrWiperH_flg@ */ /end MEASUREMENT
/begin MEASUREMENT VBCM_RrWiper_flg "" UBYTE SWC_FDC_type_CM_boolean_flg 0 0 0.0 1.0 ECU_ADDRESS 0x0000 /* @ECU_Address@VBCM_RrWiper_flg@ */ /end MEASUREMENT
/begin MEASUREMENT VBCM_TrunkRel_flg "" UBYTE SWC_FDC_type_CM_boolean_flg 0 0 0.0 1.0 ECU_ADDRESS 0x0000 /* @ECU_Address@VBCM_TrunkRel_flg@ */ /end MEASUREMENT
/begin MEASUREMENT VBCM_RoomLampH_flg "" UBYTE SWC_FDC_type_CM_boolean_flg 0 0 0.0 1.0 ECU_ADDRESS 0x0000 /* @ECU_Address@VBCM_RoomLampH_flg@ */ /end MEASUREMENT
/begin MEASUREMENT VBCM_RoomLampL_flg "" UBYTE SWC_FDC_type_CM_boolean_flg 0 0 0.0 1.0 ECU_ADDRESS 0x0000 /* @ECU_Address@VBCM_RoomLampL_flg@ */ /end MEASUREMENT
/begin MEASUREMENT VBCM_MirrorDefog_flg "" UBYTE SWC_FDC_type_CM_boolean_flg 0 0 0.0 1.0 ECU_ADDRESS 0x0000 /* @ECU_Address@VBCM_MirrorDefog_flg@ */ /end MEASUREMENT
/begin MEASUREMENT VBCM_RrDefog_flg "" UBYTE SWC_FDC_type_CM_boolean_flg 0 0 0.0 1.0 ECU_ADDRESS 0x0000 /* @ECU_Address@VBCM_RrDefog_flg@ */ /end MEASUREMENT
/begin MEASUREMENT VBCM_MFSWTri_flg "" UBYTE SWC_FDC_type_CM_boolean_flg 0 0 0.0 1.0 ECU_ADDRESS 0x0000 /* @ECU_Address@VBCM_MFSWTri_flg@ */ /end MEASUREMENT
/begin MEASUREMENT VBCM_MirrorFlodPos_flg "" UBYTE SWC_FDC_type_CM_boolean_flg 0 0 0.0 1.0 ECU_ADDRESS 0x0000 /* @ECU_Address@VBCM_MirrorFlodPos_flg@ */ /end MEASUREMENT
/begin MEASUREMENT VBCM_HazardSW_flg "" UBYTE SWC_FDC_type_CM_boolean_flg 0 0 0.0 1.0 ECU_ADDRESS 0x0000 /* @ECU_Address@VBCM_HazardSW_flg@ */ /end MEASUREMENT
/begin MEASUREMENT VBCM_LTurnLP_flg "" UBYTE SWC_FDC_type_CM_boolean_flg 0 0 0.0 1.0 ECU_ADDRESS 0x0000 /* @ECU_Address@VBCM_LTurnLP_flg@ */ /end MEASUREMENT
/begin MEASUREMENT VBCM_RTurnLP_flg "" UBYTE SWC_FDC_type_CM_boolean_flg 0 0 0.0 1.0 ECU_ADDRESS 0x0000 /* @ECU_Address@VBCM_RTurnLP_flg@ */ /end MEASUREMENT
/begin MEASUREMENT VBCM_BCMBuzzerReq_flg "" UBYTE SWC_FDC_type_CM_boolean_flg 0 0 0.0 1.0 ECU_ADDRESS 0x0000 /* @ECU_Address@VBCM_BCMBuzzerReq_flg@ */ /end MEASUREMENT
/begin MEASUREMENT VBCM_PosLamp_flg "" UBYTE SWC_FDC_type_CM_boolean_flg 0 0 0.0 1.0 ECU_ADDRESS 0x0000 /* @ECU_Address@VBCM_PosLamp_flg@ */ /end MEASUREMENT
/begin MEASUREMENT VBCM_HBeam_flg "" UBYTE SWC_FDC_type_CM_boolean_flg 0 0 0.0 1.0 ECU_ADDRESS 0x0000 /* @ECU_Address@VBCM_HBeam_flg@ */ /end MEASUREMENT
/begin MEASUREMENT VBCM_RrFogLamp_flg "" UBYTE SWC_FDC_type_CM_boolean_flg 0 0 0.0 1.0 ECU_ADDRESS 0x0000 /* @ECU_Address@VBCM_RrFogLamp_flg@ */ /end MEASUREMENT
/begin MEASUREMENT VBCM_BrakeLamp_flg "" UBYTE SWC_FDC_type_CM_boolean_flg 0 0 0.0 1.0 ECU_ADDRESS 0x0000 /* @ECU_Address@VBCM_BrakeLamp_flg@ */ /end MEASUREMENT
/begin MEASUREMENT VBCM_ReverseLamp_flg "" UBYTE SWC_FDC_type_CM_boolean_flg 0 0 0.0 1.0 ECU_ADDRESS 0x0000 /* @ECU_Address@VBCM_ReverseLamp_flg@ */ /end MEASUREMENT
/begin MEASUREMENT VBCM_LDRL_flg "" UBYTE SWC_FDC_type_CM_boolean_flg 0 0 0.0 1.0 ECU_ADDRESS 0x0000 /* @ECU_Address@VBCM_LDRL_flg@ */ /end MEASUREMENT
/begin MEASUREMENT VBCM_RDRL_flg "" UBYTE SWC_FDC_type_CM_boolean_flg 0 0 0.0 1.0 ECU_ADDRESS 0x0000 /* @ECU_Address@VBCM_RDRL_flg@ */ /end MEASUREMENT
/begin MEASUREMENT VBCM_LBSD_flg "" UBYTE SWC_FDC_type_CM_boolean_flg 0 0 0.0 1.0 ECU_ADDRESS 0x0000 /* @ECU_Address@VBCM_LBSD_flg@ */ /end MEASUREMENT
/begin MEASUREMENT VBCM_RBSD_flg "" UBYTE SWC_FDC_type_CM_boolean_flg 0 0 0.0 1.0 ECU_ADDRESS 0x0000 /* @ECU_Address@VBCM_RBSD_flg@ */ /end MEASUREMENT
/begin MEASUREMENT VBCM_showup_flg "" UBYTE SWC_FDC_type_CM_boolean_flg 0 0 0.0 1.0 ECU_ADDRESS 0x0000 /* @ECU_Address@VBCM_showup_flg@ */ /end MEASUREMENT
/begin MEASUREMENT VBCM_FollowMe_flg "" UBYTE SWC_FDC_type_CM_boolean_flg 0 0 0.0 1.0 ECU_ADDRESS 0x0000 /* @ECU_Address@VBCM_FollowMe_flg@ */ /end MEASUREMENT
/begin MEASUREMENT VBCM_DimmerEN_flg "" UBYTE SWC_FDC_type_CM_boolean_flg 0 0 0.0 1.0 ECU_ADDRESS 0x0000 /* @ECU_Address@VBCM_DimmerEN_flg@ */ /end MEASUREMENT
/begin MEASUREMENT VBCM_DoorLockIND_flg "" UBYTE SWC_FDC_type_CM_boolean_flg 0 0 0.0 1.0 ECU_ADDRESS 0x0000 /* @ECU_Address@VBCM_DoorLockIND_flg@ */ /end MEASUREMENT
/begin MEASUREMENT VBCM_fVIGHandle_flg "" UBYTE SWC_FDC_type_CM_boolean_flg 0 0 0.0 1.0 ECU_ADDRESS 0x0000 /* @ECU_Address@VBCM_fVIGHandle_flg@ */ /end MEASUREMENT
/begin MEASUREMENT VBCM_FuelDoorPos_flg "" UBYTE SWC_FDC_type_CM_boolean_flg 0 0 0.0 1.0 ECU_ADDRESS 0x0000 /* @ECU_Address@VBCM_FuelDoorPos_flg@ */ /end MEASUREMENT
/begin MEASUREMENT VBCM_fUnlockSingle_flg "" UBYTE SWC_FDC_type_CM_boolean_flg 0 0 0.0 1.0 ECU_ADDRESS 0x0000 /* @ECU_Address@VBCM_fUnlockSingle_flg@ */ /end MEASUREMENT
/begin MEASUREMENT VBCM_ATAlarm_flg "" UBYTE SWC_FDC_type_CM_boolean_flg 0 0 0.0 1.0 ECU_ADDRESS 0x0000 /* @ECU_Address@VBCM_ATAlarm_flg@ */ /end MEASUREMENT
/begin MEASUREMENT VBCM_HornCtrl_flg "" UBYTE SWC_FDC_type_CM_boolean_flg 0 0 0.0 1.0 ECU_ADDRESS 0x0000 /* @ECU_Address@VBCM_HornCtrl_flg@ */ /end MEASUREMENT
/begin MEASUREMENT VBCM_AntitheftSeatFlod_flg "" UBYTE SWC_FDC_type_CM_boolean_flg 0 0 0.0 1.0 ECU_ADDRESS 0x0000 /* @ECU_Address@VBCM_AntitheftSeatFlod_flg@ */ /end MEASUREMENT
/begin MEASUREMENT VBCM_HoodRelCmd_flg "" UBYTE SWC_FDC_type_CM_boolean_flg 0 0 0.0 1.0 ECU_ADDRESS 0x0000 /* @ECU_Address@VBCM_HoodRelCmd_flg@ */ /end MEASUREMENT
/begin MEASUREMENT VPMM_DetectAntitheftUnlock_flg "" UBYTE SWC_FDC_type_CM_boolean_flg 0 0 0.0 1.0 ECU_ADDRESS 0x0000 /* @ECU_Address@VPMM_DetectAntitheftUnlock_flg@ */ /end MEASUREMENT
/begin MEASUREMENT VPMM_MCUEnable_flg "" UBYTE SWC_FDC_type_CM_boolean_flg 0 0 0.0 1.0 ECU_ADDRESS 0x0000 /* @ECU_Address@VPMM_MCUEnable_flg@ */ /end MEASUREMENT
/begin MEASUREMENT VPMM_MCUReady4Pre_flg "" UBYTE SWC_FDC_type_CM_boolean_flg 0 0 0.0 1.0 ECU_ADDRESS 0x0000 /* @ECU_Address@VPMM_MCUReady4Pre_flg@ */ /end MEASUREMENT
/begin MEASUREMENT VPMM_PreChrgChk_flg "" UBYTE SWC_FDC_type_CM_boolean_flg 0 0 0.0 1.0 ECU_ADDRESS 0x0000 /* @ECU_Address@VPMM_PreChrgChk_flg@ */ /end MEASUREMENT
/begin MEASUREMENT VPMM_AllDoorClosed_flg "" UBYTE SWC_FDC_type_CM_boolean_flg 0 0 0.0 1.0 ECU_ADDRESS 0x0000 /* @ECU_Address@VPMM_AllDoorClosed_flg@ */ /end MEASUREMENT
/begin MEASUREMENT VPMM_MCUReady_flg "" UBYTE SWC_FDC_type_CM_boolean_flg 0 0 0.0 1.0 ECU_ADDRESS 0x0000 /* @ECU_Address@VPMM_MCUReady_flg@ */ /end MEASUREMENT
/begin MEASUREMENT VPMM_SafetyChkHLv_flg "" UBYTE SWC_FDC_type_CM_boolean_flg 0 0 0.0 1.0 ECU_ADDRESS 0x0000 /* @ECU_Address@VPMM_SafetyChkHLv_flg@ */ /end MEASUREMENT
/begin MEASUREMENT VPMM_TMSpdThdSta_flg "" UBYTE SWC_FDC_type_CM_boolean_flg 0 0 0.0 1.0 ECU_ADDRESS 0x0000 /* @ECU_Address@VPMM_TMSpdThdSta_flg@ */ /end MEASUREMENT
/begin MEASUREMENT VPMM_SafetyChkMLv_flg "" UBYTE SWC_FDC_type_CM_boolean_flg 0 0 0.0 1.0 ECU_ADDRESS 0x0000 /* @ECU_Address@VPMM_SafetyChkMLv_flg@ */ /end MEASUREMENT
/begin MEASUREMENT VPMM_LVADCDiffErr_flg "" UBYTE SWC_FDC_type_CM_boolean_flg 0 0 0.0 1.0 ECU_ADDRESS 0x0000 /* @ECU_Address@VPMM_LVADCDiffErr_flg@ */ /end MEASUREMENT
/begin MEASUREMENT VPMM_LVADCHiLoThdErr_flg "" UBYTE SWC_FDC_type_CM_boolean_flg 0 0 0.0 1.0 ECU_ADDRESS 0x0000 /* @ECU_Address@VPMM_LVADCHiLoThdErr_flg@ */ /end MEASUREMENT
/begin MEASUREMENT VPMM_PwrReqRAPSAvail_flg "" UBYTE SWC_FDC_type_CM_boolean_flg 0 0 0.0 1.0 ECU_ADDRESS 0x0000 /* @ECU_Address@VPMM_PwrReqRAPSAvail_flg@ */ /end MEASUREMENT
/begin MEASUREMENT VPMM_BMSWarm_flg "" UBYTE SWC_FDC_type_CM_boolean_flg 0 0 0.0 1.0 ECU_ADDRESS 0x0000 /* @ECU_Address@VPMM_BMSWarm_flg@ */ /end MEASUREMENT
/begin MEASUREMENT VPMM_DetectPDKeyUnlock_flg "" UBYTE SWC_FDC_type_CM_boolean_flg 0 0 0.0 1.0 ECU_ADDRESS 0x0000 /* @ECU_Address@VPMM_DetectPDKeyUnlock_flg@ */ /end MEASUREMENT
/begin MEASUREMENT VPMM_DetectAntitheftLock_flg "" UBYTE SWC_FDC_type_CM_boolean_flg 0 0 0.0 1.0 ECU_ADDRESS 0x0000 /* @ECU_Address@VPMM_DetectAntitheftLock_flg@ */ /end MEASUREMENT
/begin MEASUREMENT VPMM_DetectPDKeyLock_flg "" UBYTE SWC_FDC_type_CM_boolean_flg 0 0 0.0 1.0 ECU_ADDRESS 0x0000 /* @ECU_Address@VPMM_DetectPDKeyLock_flg@ */ /end MEASUREMENT
/begin MEASUREMENT VPMM_DetectPsDoorOpened_flg "" UBYTE SWC_FDC_type_CM_boolean_flg 0 0 0.0 1.0 ECU_ADDRESS 0x0000 /* @ECU_Address@VPMM_DetectPsDoorOpened_flg@ */ /end MEASUREMENT
/begin MEASUREMENT VPMM_DetectRLDoorOpened_flg "" UBYTE SWC_FDC_type_CM_boolean_flg 0 0 0.0 1.0 ECU_ADDRESS 0x0000 /* @ECU_Address@VPMM_DetectRLDoorOpened_flg@ */ /end MEASUREMENT
/begin MEASUREMENT VPMM_DetectRRDoorOpened_flg "" UBYTE SWC_FDC_type_CM_boolean_flg 0 0 0.0 1.0 ECU_ADDRESS 0x0000 /* @ECU_Address@VPMM_DetectRRDoorOpened_flg@ */ /end MEASUREMENT
/begin MEASUREMENT VPMM_DetectSeatEmpty_flg "" UBYTE SWC_FDC_type_CM_boolean_flg 0 0 0.0 1.0 ECU_ADDRESS 0x0000 /* @ECU_Address@VPMM_DetectSeatEmpty_flg@ */ /end MEASUREMENT
/begin MEASUREMENT VPMM_APSFailRisingEdge_flg "" UBYTE SWC_FDC_type_CM_boolean_flg 0 0 0.0 1.0 ECU_ADDRESS 0x0000 /* @ECU_Address@VPMM_APSFailRisingEdge_flg@ */ /end MEASUREMENT
/begin MEASUREMENT VPMM_MCUEnaReq_flg "" UBYTE SWC_FDC_type_CM_boolean_flg 0 0 0.0 1.0 ECU_ADDRESS 0x0000 /* @ECU_Address@VPMM_MCUEnaReq_flg@ */ /end MEASUREMENT
/begin MEASUREMENT VPMM_FrMCUEnaReq_flg "" UBYTE SWC_FDC_type_CM_boolean_flg 0 0 0.0 1.0 ECU_ADDRESS 0x0000 /* @ECU_Address@VPMM_FrMCUEnaReq_flg@ */ /end MEASUREMENT
/begin MEASUREMENT VPMM_RrMCUEnaReq_flg "" UBYTE SWC_FDC_type_CM_boolean_flg 0 0 0.0 1.0 ECU_ADDRESS 0x0000 /* @ECU_Address@VPMM_RrMCUEnaReq_flg@ */ /end MEASUREMENT
/begin MEASUREMENT VPMM_EvccAplusPwrUpReq_flg "" UBYTE SWC_FDC_type_CM_boolean_flg 0 0 0.0 1.0 ECU_ADDRESS 0x0000 /* @ECU_Address@VPMM_EvccAplusPwrUpReq_flg@ */ /end MEASUREMENT
/begin MEASUREMENT VPMM_MCUDischrgFinished_flg "" UBYTE SWC_FDC_type_CM_boolean_flg 0 0 0.0 1.0 ECU_ADDRESS 0x0000 /* @ECU_Address@VPMM_MCUDischrgFinished_flg@ */ /end MEASUREMENT
/begin MEASUREMENT VPMM_ActiveDischargeReq_flg "" UBYTE SWC_FDC_type_CM_boolean_flg 0 0 0.0 1.0 ECU_ADDRESS 0x0000 /* @ECU_Address@VPMM_ActiveDischargeReq_flg@ */ /end MEASUREMENT
/begin MEASUREMENT VPMM_DCDCEnaReq_flg "" UBYTE SWC_FDC_type_CM_boolean_flg 0 0 0.0 1.0 ECU_ADDRESS 0x0000 /* @ECU_Address@VPMM_DCDCEnaReq_flg@ */ /end MEASUREMENT
/begin MEASUREMENT VPMM_HVBatCnctReq_flg "" UBYTE SWC_FDC_type_CM_boolean_flg 0 0 0.0 1.0 ECU_ADDRESS 0x0000 /* @ECU_Address@VPMM_HVBatCnctReq_flg@ */ /end MEASUREMENT
/begin MEASUREMENT VPMM_LVPwrSta_flg "" UBYTE SWC_FDC_type_CM_boolean_flg 0 0 0.0 1.0 ECU_ADDRESS 0x0000 /* @ECU_Address@VPMM_LVPwrSta_flg@ */ /end MEASUREMENT
/begin MEASUREMENT VPMM_HVPwrSta_flg "" UBYTE SWC_FDC_type_CM_boolean_flg 0 0 0.0 1.0 ECU_ADDRESS 0x0000 /* @ECU_Address@VPMM_HVPwrSta_flg@ */ /end MEASUREMENT
/begin MEASUREMENT VPMM_LVSilentChrgReq_flg "" UBYTE SWC_FDC_type_CM_boolean_flg 0 0 0.0 1.0 ECU_ADDRESS 0x0000 /* @ECU_Address@VPMM_LVSilentChrgReq_flg@ */ /end MEASUREMENT
/begin MEASUREMENT VPMM_LVSilentChrgReqStd_flg "" UBYTE SWC_FDC_type_CM_boolean_flg 0 0 0.0 1.0 ECU_ADDRESS 0x0000 /* @ECU_Address@VPMM_LVSilentChrgReqStd_flg@ */ /end MEASUREMENT
/begin MEASUREMENT VPMM_PreOFF_flg "" UBYTE SWC_FDC_type_CM_boolean_flg 0 0 0.0 1.0 ECU_ADDRESS 0x0000 /* @ECU_Address@VPMM_PreOFF_flg@ */ /end MEASUREMENT
/begin MEASUREMENT VPMM_PwrStaONTOPopReq_flg "" UBYTE SWC_FDC_type_CM_boolean_flg 0 0 0.0 1.0 ECU_ADDRESS 0x0000 /* @ECU_Address@VPMM_PwrStaONTOPopReq_flg@ */ /end MEASUREMENT
/begin MEASUREMENT VPMM_PMMAllowECUSleep_flg "" UBYTE SWC_FDC_type_CM_boolean_flg 0 0 0.0 1.0 ECU_ADDRESS 0x0000 /* @ECU_Address@VPMM_PMMAllowECUSleep_flg@ */ /end MEASUREMENT
/begin MEASUREMENT VPMM_SilentChkAllowSleep_flg "" UBYTE SWC_FDC_type_CM_boolean_flg 0 0 0.0 1.0 ECU_ADDRESS 0x0000 /* @ECU_Address@VPMM_SilentChkAllowSleep_flg@ */ /end MEASUREMENT
/begin MEASUREMENT VPMM_TimerAllowSleep_flg "" UBYTE SWC_FDC_type_CM_boolean_flg 0 0 0.0 1.0 ECU_ADDRESS 0x0000 /* @ECU_Address@VPMM_TimerAllowSleep_flg@ */ /end MEASUREMENT
/begin MEASUREMENT VPMM_CtrlDrPwrStbA2_flg "" UBYTE SWC_FDC_type_CM_boolean_flg 0 0 0.0 1.0 ECU_ADDRESS 0x0000 /* @ECU_Address@VPMM_CtrlDrPwrStbA2_flg@ */ /end MEASUREMENT
/begin MEASUREMENT VPMM_CtrlFrBMSCCUCIR_flg "" UBYTE SWC_FDC_type_CM_boolean_flg 0 0 0.0 1.0 ECU_ADDRESS 0x0000 /* @ECU_Address@VPMM_CtrlFrBMSCCUCIR_flg@ */ /end MEASUREMENT
/begin MEASUREMENT VPMM_CtrlFrEDUINVERTER_flg "" UBYTE SWC_FDC_type_CM_boolean_flg 0 0 0.0 1.0 ECU_ADDRESS 0x0000 /* @ECU_Address@VPMM_CtrlFrEDUINVERTER_flg@ */ /end MEASUREMENT
/begin MEASUREMENT VPMM_CtrlFrPwrStbA1P_flg "" UBYTE SWC_FDC_type_CM_boolean_flg 0 0 0.0 1.0 ECU_ADDRESS 0x0000 /* @ECU_Address@VPMM_CtrlFrPwrStbA1P_flg@ */ /end MEASUREMENT
/begin MEASUREMENT VPMM_CtrlFrRC1_flg "" UBYTE SWC_FDC_type_CM_boolean_flg 0 0 0.0 1.0 ECU_ADDRESS 0x0000 /* @ECU_Address@VPMM_CtrlFrRC1_flg@ */ /end MEASUREMENT
/begin MEASUREMENT VPMM_PMMAllowNMSleep_flg "" UBYTE SWC_FDC_type_CM_boolean_flg 0 0 0.0 1.0 ECU_ADDRESS 0x0000 /* @ECU_Address@VPMM_PMMAllowNMSleep_flg@ */ /end MEASUREMENT
/begin MEASUREMENT VPMM_Delay4IVIWarnAct_flg "" UBYTE SWC_FDC_type_CM_boolean_flg 0 0 0.0 1.0 ECU_ADDRESS 0x0000 /* @ECU_Address@VPMM_Delay4IVIWarnAct_flg@ */ /end MEASUREMENT
/begin MEASUREMENT VBCM_ConditionTimer_s "" FLOAT32_IEEE SWC_FDC_type_CM_single_s 0 0 0.0 3600.0 ECU_ADDRESS 0x0000 /* @ECU_Address@VBCM_ConditionTimer_s@ */ /end MEASUREMENT
/begin MEASUREMENT VPMM_HVSOCWarnTimer_s "" FLOAT32_IEEE SWC_FDC_type_CM_single_s 0 0 0.0 3600.0 ECU_ADDRESS 0x0000 /* @ECU_Address@VPMM_HVSOCWarnTimer_s@ */ /end MEASUREMENT
/begin MEASUREMENT VPMM_LVChrgReqCnt_cnt "" FLOAT32_IEEE SWC_FDC_type_CM_single_cnt 0 0 0.0 600.0 ECU_ADDRESS 0x0000 /* @ECU_Address@VPMM_LVChrgReqCnt_cnt@ */ /end MEASUREMENT
/begin MEASUREMENT VPMM_LVBattChrgtime_s "" FLOAT32_IEEE SWC_FDC_type_CM_single_s 0 0 0.0 86400.0 ECU_ADDRESS 0x0000 /* @ECU_Address@VPMM_LVBattChrgtime_s@ */ /end MEASUREMENT
/begin MEASUREMENT VPMM_PwrStaONTimer_s "" FLOAT32_IEEE SWC_FDC_type_CM_single_s 0 0 0.0 3600.0 ECU_ADDRESS 0x0000 /* @ECU_Address@VPMM_PwrStaONTimer_s@ */ /end MEASUREMENT
/begin MEASUREMENT VPMM_FDADC12VDetAccuTimer_s "" FLOAT32_IEEE SWC_FDC_type_CM_single_s 0 0 0.0 300.0 ECU_ADDRESS 0x0000 /* @ECU_Address@VPMM_FDADC12VDetAccuTimer_s@ */ /end MEASUREMENT
/begin MEASUREMENT VPMM_FDADC12VDetAccu_cnt "" FLOAT32_IEEE SWC_FDC_type_CM_single_cnt 0 0 0.0 100.0 ECU_ADDRESS 0x0000 /* @ECU_Address@VPMM_FDADC12VDetAccu_cnt@ */ /end MEASUREMENT
/begin MEASUREMENT VPMM_FirstLVCheckHoldTimer_s "" FLOAT32_IEEE SWC_FDC_type_CM_single_s 0 0 0.0 300.0 ECU_ADDRESS 0x0000 /* @ECU_Address@VPMM_FirstLVCheckHoldTimer_s@ */ /end MEASUREMENT
/begin MEASUREMENT VPMM_PrePwrSta_enum "" UBYTE SWC_FDC_type_CM_uint8_enum 0 0 0.0 255.0 ECU_ADDRESS 0x0000 /* @ECU_Address@VPMM_PrePwrSta_enum@ */ /end MEASUREMENT
/begin MEASUREMENT VPMM_OFFLVBattChkRechk_cnt "" UBYTE SWC_FDC_type_CM_uint8_cnt 0 0 0.0 100.0 ECU_ADDRESS 0x0000 /* @ECU_Address@VPMM_OFFLVBattChkRechk_cnt@ */ /end MEASUREMENT
/begin MEASUREMENT VPMM_BattUpResetRty_cnt "" UBYTE SWC_FDC_type_CM_uint8_cnt 0 0 0.0 255.0 ECU_ADDRESS 0x0000 /* @ECU_Address@VPMM_BattUpResetRty_cnt@ */ /end MEASUREMENT
/begin MEASUREMENT VBCM_AutoCut_flg "" UBYTE SWC_FDC_type_CM_boolean_flg 0 0 0.0 1.0 ECU_ADDRESS 0x0000 /* @ECU_Address@VBCM_AutoCut_flg@ */ /end MEASUREMENT
/begin MEASUREMENT VPMM_OFFCChkHVSOCLoop_flg "" UBYTE SWC_FDC_type_CM_boolean_flg 0 0 0.0 1.0 ECU_ADDRESS 0x0000 /* @ECU_Address@VPMM_OFFCChkHVSOCLoop_flg@ */ /end MEASUREMENT
/begin MEASUREMENT VPMM_FirstEnterOFF_flg "" UBYTE SWC_FDC_type_CM_boolean_flg 0 0 0.0 1.0 ECU_ADDRESS 0x0000 /* @ECU_Address@VPMM_FirstEnterOFF_flg@ */ /end MEASUREMENT
/begin MEASUREMENT VPMM_IVIPwrOffMemory_flg "" UBYTE SWC_FDC_type_CM_boolean_flg 0 0 0.0 1.0 ECU_ADDRESS 0x0000 /* @ECU_Address@VPMM_IVIPwrOffMemory_flg@ */ /end MEASUREMENT
/begin MEASUREMENT VPMM_ContinueUseHold_flg "" UBYTE SWC_FDC_type_CM_boolean_flg 0 0 0.0 1.0 ECU_ADDRESS 0x0000 /* @ECU_Address@VPMM_ContinueUseHold_flg@ */ /end MEASUREMENT
/begin MEASUREMENT VPMM_LVBatStaChk_flg "" UBYTE SWC_FDC_type_CM_boolean_flg 0 0 0.0 1.0 ECU_ADDRESS 0x0000 /* @ECU_Address@VPMM_LVBatStaChk_flg@ */ /end MEASUREMENT
/begin MEASUREMENT VPMM_OFFLVBattChkRechkDone_flg "" UBYTE SWC_FDC_type_CM_boolean_flg 0 0 0.0 1.0 ECU_ADDRESS 0x0000 /* @ECU_Address@VPMM_OFFLVBattChkRechkDone_flg@ */ /end MEASUREMENT
/begin MEASUREMENT VPMM_HardwareRst_flg "" UBYTE SWC_FDC_type_CM_boolean_flg 0 0 0.0 1.0 ECU_ADDRESS 0x0000 /* @ECU_Address@VPMM_HardwareRst_flg@ */ /end MEASUREMENT
/begin MEASUREMENT VPMM_SilentChrgFaultBypass_flg "" UBYTE SWC_FDC_type_CM_boolean_flg 0 0 0.0 1.0 ECU_ADDRESS 0x0000 /* @ECU_Address@VPMM_SilentChrgFaultBypass_flg@ */ /end MEASUREMENT
/begin COMPU_METHOD SWC_FDC_type_CM_single_C "Q = V" RAT_FUNC "%8.6" "C" COEFFS 0 1 0 0 0 1 /end COMPU_METHOD
/begin COMPU_METHOD SWC_FDC_type_CM_uint8_enum "Q = V" RAT_FUNC "%3.0" "enum" COEFFS 0 1 0 0 0 1 /end COMPU_METHOD
/begin COMPU_METHOD SWC_FDC_type_CM_single_kph "Q = V" RAT_FUNC "%8.6" "kph" COEFFS 0 1 0 0 0 1 /end COMPU_METHOD
/begin COMPU_METHOD SWC_FDC_type_CM_single_deg "Q = V" RAT_FUNC "%8.6" "deg" COEFFS 0 1 0 0 0 1 /end COMPU_METHOD
/begin COMPU_METHOD SWC_FDC_type_CM_single_pct "Q = V" RAT_FUNC "%8.6" "pct" COEFFS 0 1 0 0 0 1 /end COMPU_METHOD
/begin COMPU_METHOD SWC_FDC_type_CM_single_s "Q = V" RAT_FUNC "%8.6" "s" COEFFS 0 1 0 0 0 1 /end COMPU_METHOD
/begin COMPU_METHOD SWC_FDC_type_CM_single_mV "Q = V" RAT_FUNC "%8.6" "mV" COEFFS 0 1 0 0 0 1 /end COMPU_METHOD
/begin COMPU_METHOD SWC_FDC_type_CM_single_A "Q = V" RAT_FUNC "%8.6" "A" COEFFS 0 1 0 0 0 1 /end COMPU_METHOD
/begin COMPU_METHOD SWC_FDC_type_CM_single_W "Q = V" RAT_FUNC "%8.6" "W" COEFFS 0 1 0 0 0 1 /end COMPU_METHOD
/begin COMPU_METHOD SWC_FDC_type_CM_single_rpm "Q = V" RAT_FUNC "%8.6" "rpm" COEFFS 0 1 0 0 0 1 /end COMPU_METHOD
/begin COMPU_METHOD SWC_FDC_type_CM_single_Nm "Q = V" RAT_FUNC "%8.6" "Nm" COEFFS 0 1 0 0 0 1 /end COMPU_METHOD
/begin COMPU_METHOD SWC_FDC_type_CM_single_gain "Q = V" RAT_FUNC "%8.6" "gain" COEFFS 0 1 0 0 0 1 /end COMPU_METHOD
/begin COMPU_METHOD SWC_FDC_type_CM_single_mps2 "Q = V" RAT_FUNC "%8.6" "mps2" COEFFS 0 1 0 0 0 1 /end COMPU_METHOD
/begin COMPU_METHOD SWC_FDC_type_CM_single_mps "Q = V" RAT_FUNC "%8.6" "mps" COEFFS 0 1 0 0 0 1 /end COMPU_METHOD
/begin COMPU_METHOD SWC_FDC_type_CM_single_mps3 "Q = V" RAT_FUNC "%8.6" "mps3" COEFFS 0 1 0 0 0 1 /end COMPU_METHOD
/begin COMPU_METHOD SWC_FDC_type_CM_single_K "Q = V" RAT_FUNC "%8.6" "K" COEFFS 0 1 0 0 0 1 /end COMPU_METHOD
/begin COMPU_METHOD SWC_FDC_type_CM_single_kW "Q = V" RAT_FUNC "%8.6" "kW" COEFFS 0 1 0 0 0 1 /end COMPU_METHOD
/begin COMPU_METHOD SWC_FDC_type_CM_single_V "Q = V" RAT_FUNC "%8.6" "V" COEFFS 0 1 0 0 0 1 /end COMPU_METHOD
/begin COMPU_METHOD SWC_FDC_type_CM_single_ms "Q = V" RAT_FUNC "%8.6" "ms" COEFFS 0 1 0 0 0 1 /end COMPU_METHOD
/begin COMPU_METHOD SWC_FDC_type_CM_single_min "Q = V" RAT_FUNC "%8.6" "min" COEFFS 0 1 0 0 0 1 /end COMPU_METHOD
/begin COMPU_METHOD SWC_FDC_type_CM_single_cm "Q = V" RAT_FUNC "%8.6" "cm" COEFFS 0 1 0 0 0 1 /end COMPU_METHOD
/begin COMPU_METHOD SWC_FDC_type_CM_single_sec "Q = V" RAT_FUNC "%8.6" "sec" COEFFS 0 1 0 0 0 1 /end COMPU_METHOD
/begin COMPU_METHOD SWC_FDC_type_CM_single_m "Q = V" RAT_FUNC "%8.6" "m" COEFFS 0 1 0 0 0 1 /end COMPU_METHOD
/begin COMPU_METHOD SWC_FDC_type_CM_single_g "Q = V" RAT_FUNC "%8.6" "g" COEFFS 0 1 0 0 0 1 /end COMPU_METHOD
/begin COMPU_METHOD SWC_FDC_type_CM_single_cnt "Q = V" RAT_FUNC "%8.6" "cnt" COEFFS 0 1 0 0 0 1 /end COMPU_METHOD
/begin COMPU_METHOD SWC_FDC_type_CM_single_raw32 "Q = V" RAT_FUNC "%8.6" "raw32" COEFFS 0 1 0 0 0 1 /end COMPU_METHOD
/begin COMPU_METHOD SWC_FDC_type_CM_uint16_cnt "Q = V" RAT_FUNC "%5.0" "cnt" COEFFS 0 1 0 0 0 1 /end COMPU_METHOD
/begin COMPU_METHOD SWC_FDC_type_CM_uint16_V "Q = V" RAT_FUNC "%5.0" "V" COEFFS 0 1 0 0 0 1 /end COMPU_METHOD
/begin COMPU_METHOD SWC_FDC_type_CM_uint16_mV "Q = V" RAT_FUNC "%5.0" "mV" COEFFS 0 1 0 0 0 1 /end COMPU_METHOD
/begin COMPU_METHOD SWC_FDC_type_CM_uint16_sec "Q = V" RAT_FUNC "%5.0" "sec" COEFFS 0 1 0 0 0 1 /end COMPU_METHOD
/begin COMPU_METHOD SWC_FDC_type_CM_uint16_rpm "Q = V" RAT_FUNC "%5.0" "rpm" COEFFS 0 1 0 0 0 1 /end COMPU_METHOD
/begin COMPU_METHOD SWC_FDC_type_CM_uint16_min "Q = V" RAT_FUNC "%5.0" "min" COEFFS 0 1 0 0 0 1 /end COMPU_METHOD
/begin COMPU_METHOD SWC_FDC_type_CM_uint16_enum "Q = V" RAT_FUNC "%5.0" "enum" COEFFS 0 1 0 0 0 1 /end COMPU_METHOD
/begin COMPU_METHOD SWC_FDC_type_CM_boolean_flg "Q = V" RAT_FUNC "%1.0" "flg" COEFFS 0 1 0 0 0 1 /end COMPU_METHOD
/begin COMPU_METHOD SWC_FDC_type_CM_int8_dB "Q = V" RAT_FUNC "%3.0" "dB" COEFFS 0 1 0 0 0 1 /end COMPU_METHOD
/begin COMPU_METHOD SWC_FDC_type_CM_uint8_s "Q = V" RAT_FUNC "%3.0" "s" COEFFS 0 1 0 0 0 1 /end COMPU_METHOD
/begin COMPU_METHOD SWC_FDC_type_CM_uint8_mA "Q = V" RAT_FUNC "%3.0" "mA" COEFFS 0 1 0 0 0 1 /end COMPU_METHOD
/begin COMPU_METHOD SWC_FDC_type_CM_uint8_cnt "Q = V" RAT_FUNC "%3.0" "cnt" COEFFS 0 1 0 0 0 1 /end COMPU_METHOD
/begin COMPU_METHOD SWC_FDC_type_CM_uint8_ms "Q = V" RAT_FUNC "%3.0" "ms" COEFFS 0 1 0 0 0 1 /end COMPU_METHOD
/begin COMPU_METHOD SWC_FDC_type_CM_uint8_sec "Q = V" RAT_FUNC "%3.0" "sec" COEFFS 0 1 0 0 0 1 /end COMPU_METHOD
/begin COMPU_METHOD SWC_FDC_type_CM_uint8_K "Q = V" RAT_FUNC "%3.0" "K" COEFFS 0 1 0 0 0 1 /end COMPU_METHOD
/begin COMPU_METHOD SWC_FDC_type_CM_uint8_pct "Q = V" RAT_FUNC "%3.0" "pct" COEFFS 0 1 0 0 0 1 /end COMPU_METHOD
/begin COMPU_METHOD SWC_FDC_type_CM_uint8_min "Q = V" RAT_FUNC "%3.0" "min" COEFFS 0 1 0 0 0 1 /end COMPU_METHOD
/begin COMPU_METHOD SWC_FDC_type_CM_uint32_cnt "Q = V" RAT_FUNC "%10.0" "cnt" COEFFS 0 1 0 0 0 1 /end COMPU_METHOD
/begin COMPU_METHOD SWC_FDC_type_CM_uint16_step "Q = V" RAT_FUNC "%5.0" "step" COEFFS 0 1 0 0 0 1 /end COMPU_METHOD
/begin COMPU_METHOD SWC_FDC_type_CM_int16_enum "Q = V" RAT_FUNC "%5.0" "enum" COEFFS 0 1 0 0 0 1 /end COMPU_METHOD
/begin COMPU_METHOD SWC_FDC_type_CM_uint8_flg "Q = V" RAT_FUNC "%3.0" "flg" COEFFS 0 1 0 0 0 1 /end COMPU_METHOD
/begin COMPU_METHOD SWC_FDC_type_CM_uint8_cm "Q = V" RAT_FUNC "%3.0" "cm" COEFFS 0 1 0 0 0 1 /end COMPU_METHOD
/begin COMPU_METHOD SWC_FDC_type_CM_uint8_OTA_enum "Q = V" RAT_FUNC "%3.0" "OTA_enum" COEFFS 0 1 0 0 0 1 /end COMPU_METHOD
/begin COMPU_METHOD SWC_FDC_type_CM_uint8_ChgTOSta_enum "Q = V" RAT_FUNC "%3.0" "ChgTOSta_enum" COEFFS 0 1 0 0 0 1 /end COMPU_METHOD
/begin GROUP SWC_FDC_type "SWC_FDC_type" /* Root */ ROOT /begin SUB_GROUP Root_run_SWC_FDC_RxTx_5ms_sys /end SUB_GROUP /end GROUP
/begin GROUP Root_run_SWC_FDC_RxTx_5ms_sys "SWC_FDC_type/run_SWC_FDC_RxTx_5ms_sys" /begin SUB_GROUP S2_APP /end SUB_GROUP /end GROUP
/begin GROUP S2_APP "SWC_FDC_type/run_SWC_FDC_RxTx_5ms_sys/APP"
 /begin SUB_GROUP S3_ACC S3_APM S3_BCM S3_DHP S3_DKC S3_DSC S3_NMM S3_PMM S3_SYS S3_THC S3_TPM S3_TQD S3_TQR S3_VMC /end SUB_GROUP
/end GROUP
/begin GROUP S3_ACC "SWC_FDC_type/run_SWC_FDC_RxTx_5ms_sys/APP/ACC" /begin SUB_GROUP S5_THCM /end SUB_GROUP /end GROUP
/begin GROUP S3_APM "SWC_FDC_type/run_SWC_FDC_RxTx_5ms_sys/APP/APM" /begin REF_MEASUREMENT VAPM_PASDRML_cm VAPM_PASDRMR_cm /end REF_MEASUREMENT /end GROUP
/begin GROUP S3_BCM "SWC_FDC_type/run_SWC_FDC_RxTx_5ms_sys/APP/BCM" /begin SUB_GROUP S8_BCM /end SUB_GROUP /end GROUP
/begin GROUP S3_DHP "SWC_FDC_type/run_SWC_FDC_RxTx_5ms_sys/APP/DHP" /begin SUB_GROUP S9_DHP /end SUB_GROUP /end GROUP
/begin GROUP S3_DKC "SWC_FDC_type/run_SWC_FDC_RxTx_5ms_sys/APP/DKC" /begin SUB_GROUP S10_Subsystem /end SUB_GROUP /end GROUP
/begin GROUP S3_DSC "SWC_FDC_type/run_SWC_FDC_RxTx_5ms_sys/APP/DSC" /begin SUB_GROUP S11_Subsystem /end SUB_GROUP /end GROUP
/begin GROUP S3_NMM "SWC_FDC_type/run_SWC_FDC_RxTx_5ms_sys/APP/NMM" /begin SUB_GROUP S12_Subsystem /end SUB_GROUP
 /begin REF_MEASUREMENT VNMM_AllCANTxReq_flg VNMM_NMmTxReq_flg VNMM_NetworkReq_flg VNMM_SysNMmSta_enum /end REF_MEASUREMENT
/end GROUP
/begin GROUP S3_PMM "SWC_FDC_type/run_SWC_FDC_RxTx_5ms_sys/APP/PMM" /begin SUB_GROUP S13_PMM /end SUB_GROUP /end GROUP
/begin GROUP S3_SYS "SWC_FDC_type/run_SWC_FDC_RxTx_5ms_sys/APP/SYS" /begin SUB_GROUP S14_FDC_ECU_SLEEP_AND_NVM_HANDLE /end SUB_GROUP /end GROUP
/begin GROUP S3_THC "SWC_FDC_type/run_SWC_FDC_RxTx_5ms_sys/APP/THC" /begin SUB_GROUP S15_ThermalControl /end SUB_GROUP /end GROUP
/begin GROUP S3_TPM "SWC_FDC_type/run_SWC_FDC_RxTx_5ms_sys/APP/TPM" /begin SUB_GROUP S16_TPMS /end SUB_GROUP /end GROUP
/begin GROUP S3_TQD "SWC_FDC_type/run_SWC_FDC_RxTx_5ms_sys/APP/TQD" /begin SUB_GROUP S17_TorqueDemand /end SUB_GROUP /begin REF_CHARACTERISTIC KTQD_BCMUserNowSetting_enum KTQD_IVIEscapeModeCmd_flg /end REF_CHARACTERISTIC /begin REF_MEASUREMENT VTQD_BCMUserNowSetting_enum VTQD_IVIEscapeModeCmd_flg /end REF_MEASUREMENT /end GROUP
/begin GROUP S3_TQR "SWC_FDC_type/run_SWC_FDC_RxTx_5ms_sys/APP/TQR" /begin SUB_GROUP S18_Determine_Torque_Request /end SUB_GROUP /begin REF_CHARACTERISTIC KTQD_IVIEscapeModeCmd_flg /end REF_CHARACTERISTIC /end GROUP
/begin GROUP S3_VMC "SWC_FDC_type/run_SWC_FDC_RxTx_5ms_sys/APP/VMC" /begin SUB_GROUP S19_VMC /end SUB_GROUP /end GROUP
/begin GROUP S5_THCM "SWC_FDC_type/run_SWC_FDC_RxTx_5ms_sys/APP/ACC/THCM"
 /begin SUB_GROUP S22_THCM_Available_Check S22_THCM_Available_Power S22_TMAvailablePwr_Calculation /end SUB_GROUP
 /begin REF_CHARACTERISTIC KACC_LVBattErrFailtime_s KACC_LVBattErrHiThd_V KACC_LVBattErrLoThd_V /end REF_CHARACTERISTIC
 /begin REF_MEASUREMENT VACC_LVBattVoltSta_enum /end REF_MEASUREMENT
/end GROUP
/begin GROUP S8_BCM "SWC_FDC_type/run_SWC_FDC_RxTx_5ms_sys/APP/BCM/BCM"
 /begin SUB_GROUP S27_APM_Door S27_Amb S27_AntiTheft S27_BCM_WAKE_MODULE S27_CSW S27_CenterDoorLock S27_DID_Judgement S27_Dimmer S27_ExteriorLight S27_FlasherSignal S27_HMI_Custom_Button S27_PTG S27_Personal_Setting S27_PowerMirror S27_RearDefogger S27_RoomLamp S27_Tailgate S27_Vehicle_Type_Diff_Fun S27_Verify S27_WasherWiper S27_Window_Control_Sig_Combine /end SUB_GROUP
 /begin REF_CHARACTERISTIC KBCM_CmdKeepT_s KBCM_DelayTSW_flg KBCM_HandleLampKeepT_s KBCM_IVIRstHoldT_ms KBCM_IVIRstTriggerT_ms KBCM_ReDetectT_K KBCM_RmLampKeep_min KBCM_RmLpKeyInT_s KBCM_RmLpKeyMissT_s KBCM_SPTGDetectT_sec KBCM_SPTGLeave_flg KBCM_SPTGWaitDKC_sec /end REF_CHARACTERISTIC
/end GROUP
/begin GROUP S9_DHP "SWC_FDC_type/run_SWC_FDC_RxTx_5ms_sys/APP/DHP/DHP" /begin SUB_GROUP S316_APS_calaulation S316_Signal_convert /end SUB_GROUP /end GROUP
/begin GROUP S10_Subsystem "SWC_FDC_type/run_SWC_FDC_RxTx_5ms_sys/APP/DKC/Subsystem" /begin SUB_GROUP S338_DKC_Handler S338_Subsystem /end SUB_GROUP
 /begin REF_CHARACTERISTIC KDKC_DKCDecryptionErrorAllow_s KDKC_InitialTimeErrorAllow_cnt KDKC_KeyModeSw_flg KDKC_TimeSNAllowDiff_cnt /end REF_CHARACTERISTIC
 /begin REF_MEASUREMENT VDKC_AllowSleep_flg VDKC_CAN4PDKeyAreaPS_enum VDKC_CANMsgValidZONEDRFR_flg VDKC_DKCAuthSta_enum VDKC_DKCDecryptionError_flg VDKC_DKCTimeSNCorrect_flg VDKC_DKCTimeSN_cnt VDKC_TimeSNDKCFbk_cnt /end REF_MEASUREMENT
/end GROUP
/begin GROUP S11_Subsystem "SWC_FDC_type/run_SWC_FDC_RxTx_5ms_sys/APP/DSC/Subsystem"
 /begin SUB_GROUP S512_Subsystem_AutoMode S512_Subsystem_ComtrolSpd S512_Subsystem_ConditionalJudgment S512_Subsystem_EstimateSlope S512_Subsystem_StateSwitch S512_Subsystem_TempWarning /end SUB_GROUP
/end GROUP
/begin GROUP S12_Subsystem "SWC_FDC_type/run_SWC_FDC_RxTx_5ms_sys/APP/NMM/Subsystem" /begin SUB_GROUP S544_CheckIfNoNMIDforTime S544_Latch1 /end SUB_GROUP
 /begin REF_CHARACTERISTIC KNMM_NrmStaDelay_s KNMM_RdySlpStaDelay_s KPMM_HVBattSOCThd_pct /end REF_CHARACTERISTIC
 /begin REF_MEASUREMENT VNMM_ActiveWU_flg VNMM_AppWakeReq_flg VNMM_Awake_enum VNMM_CSB_flg VNMM_ErrorState_enum VNMM_HandledAcoreRdySlp_flg VNMM_NodeID_enum VNMM_PNI_flg VNMM_RptMsgReq_flg VNMM_WakeUp_enum /end REF_MEASUREMENT
/end GROUP
/begin GROUP S13_PMM "SWC_FDC_type/run_SWC_FDC_RxTx_5ms_sys/APP/PMM/PMM"
 /begin SUB_GROUP S549_DCDC_output_volt_setpoint_judgment S549_Hold4 S549_MCU_EnaReq_Control S549_OTA_power_state_constrain S549_PMMDataConvert S549_PMM_State_Machine S549_RAPS_power_request /end SUB_GROUP
 /begin REF_CHARACTERISTIC KPMM_APSAllowThd_pct KPMM_BattDownFailtime_s KPMM_BattUpFailtime_s KPMM_BattUpResetRty_cnt KPMM_BattUpResetSW_flg KPMM_BattUpResetTO_s KPMM_BattUpRstDlyTO_s KPMM_CANValidChkFailtime_s KPMM_DCDCDisableFailtime_s KPMM_DCDCEnableFailtime_s KPMM_DCDCVSET_V KPMM_Delay4IVIWarnAct_s KPMM_DriverSafetyChkFailtime_s KPMM_FDADC12VDetAccuIntval_s KPMM_FDADC12VDetAccu_s KPMM_FirstLVCheckHoldT_s KPMM_HVBRlyChkFailtime_s KPMM_HVBSOCOFFCStaChkFailtime_s KPMM_HVBSOCOffStaChkFailtime_s KPMM_HVBattSOCPwrDwnThd_pct KPMM_HVBattSOCThd_pct KPMM_HVSOCWarnThd_pct KPMM_HVSOCWarnTime_s KPMM_HoodOffChkFailtime_s KPMM_LVADCLoThd_mV KPMM_LVADCUpThd_mV KPMM_LVBattChkOKStdT_s KPMM_LVBattChkWakeholdExt_s KPMM_LVBattChkWakehold_s KPMM_LVBattOFFSlpThd_mV KPMM_LVBattThd_V KPMM_LVChrgCurrMthd_flg KPMM_LVChrgHoldT_s KPMM_MCUDisChrgFailtime_s KPMM_MCUDisableFailtime_s KPMM_MCUDischrgVolt_V KPMM_MLvSafetyFailtime_s KPMM_OBCDisableFailtime_s KPMM_OBCPreChgChkFailtime_s KPMM_OFFLVBattChkRetry_cnt KPMM_OFFStaByPassLVBatt_flg KPMM_OffA2OffTime_s KPMM_PluginVehSpdThd_kph KPMM_PrechrgChkFailtime_s KPMM_PwrStaOFFCTO_s KPMM_PwrStaONTOPop_s KPMM_PwrStaONTO_s KPMM_PwrStaStdTO_s KPMM_PwrUpChkFailtime_s KPMM_PwrUpVehSpdThd_kph KPMM_RAPSFailTime_s KPMM_SafetyChkFailtime_s KPMM_Sched_ChgTO_s KPMM_SilentChrgReqTO_s KPMM_SilentChrgReq_flg_ovrdflg KPMM_SilentChrgReq_flg_ovrdval KPMM_SysBaseCurr_A KPMM_SysPwrDownDbns_s /end REF_CHARACTERISTIC
 /begin REF_MEASUREMENT VPMM_ActiveDischargeReq_flg VPMM_BattUpResetRty_cnt VPMM_ContinueUseHold_flg VPMM_CtrlDrPwrStbA2_flg VPMM_CtrlFrBMSCCUCIR_flg VPMM_CtrlFrEDUINVERTER_flg VPMM_CtrlFrPwrStbA1P_flg VPMM_CtrlFrRC1_flg VPMM_DCDCEnaReq_flg VPMM_DCDCVoltSetpointPU_V VPMM_Delay4IVIWarnAct_flg VPMM_DetectPsDoorOpened_flg VPMM_DetectRLDoorOpened_flg VPMM_DetectRRDoorOpened_flg VPMM_DetectSeatEmpty_flg VPMM_EvccAplusPwrUpReq_flg VPMM_FDADC12VDetAccuTimer_s VPMM_FDADC12VDetAccu_cnt VPMM_FDADC12VDetAvg_mV VPMM_FirstEnterOFF_flg VPMM_FirstLVCheckHoldTimer_s VPMM_HVBatCnctReq_flg VPMM_HVChrgPreActionErrSta_enum VPMM_HVPwrSta_flg VPMM_HVSOCWarnTimer_s VPMM_HVSysReadyToCharge_enum VPMM_HWResetSta_enum VPMM_HardwareRst_flg VPMM_IVIPwrOffMemory_flg VPMM_IVIPwrStaONTOPopT_s VPMM_LVBatStaChk_flg VPMM_LVBattChktime_s VPMM_LVBattChrgTimeCnt_s VPMM_LVBattChrgtime_s VPMM_LVChrgHoldTtimer_s VPMM_LVChrgReqCnt_cnt VPMM_LVPwrSta_flg VPMM_LVSilentChrgLv_enum VPMM_LVSilentChrgReqStd_flg VPMM_LVSilentChrgReq_flg VPMM_LVSilentChrgSta_enum VPMM_LowSOCWarn_enum VPMM_OFFCChkHVSOCLoop_flg VPMM_OFFLVBattChkRechkDone_flg VPMM_OFFLVBattChkRechk_cnt VPMM_PMMAllowECUSleep_flg VPMM_PMMAllowNMSleep_flg VPMM_PowerDownFault_enum VPMM_PowerDownState_enum VPMM_PowerOffTSet_s VPMM_PowerSta_enum VPMM_PowerUpFault_enum VPMM_PowerUpState_enum VPMM_PreOFF_flg VPMM_PrePwrSta_enum VPMM_PwrDownReq_enum VPMM_PwrReq_OTA_enum VPMM_PwrStaConstraint_enum VPMM_PwrStaONTOPopReq_flg VPMM_PwrStaONTimer_s VPMM_PwrStaTOSta_enum VPMM_PwrUpReq_enum VPMM_ReVehThdChkSta_enum VPMM_Sched_ChgTOSta_enum VPMM_SilentChkAllowSleep_flg VPMM_SilentChrgFaultBypass_flg VPMM_SysPowerMode_enum VPMM_TCountSta_enum VPMM_TimerAllowSleep_flg /end REF_MEASUREMENT
/end GROUP
/begin GROUP S14_FDC_ECU_SLEEP_AND_NVM_HANDLE "SWC_FDC_type/run_SWC_FDC_RxTx_5ms_sys/APP/SYS/FDC_ECU_SLEEP_AND_NVM_HANDLE" /begin SUB_GROUP S638_Latch /end SUB_GROUP /begin REF_CHARACTERISTIC KSYS_SleepTimeBuffer_sec /end REF_CHARACTERISTIC
 /begin REF_MEASUREMENT VSYS_AcoreRebootCmdACK_flg VSYS_FdcSlpReqRisingEdge_flg VSYS_FdcSlpReq_flg VSYS_FdcSlpTime_sec VSYS_NvWriteForSleep_flg VSYS_NvWriteOnChange_flg VSYS_NvWriteReqRisingEdge_flg VSYS_NvWriteReq_flg /end REF_MEASUREMENT
/end GROUP
/begin GROUP S15_ThermalControl "SWC_FDC_type/run_SWC_FDC_RxTx_5ms_sys/APP/THC/ThermalControl" /begin SUB_GROUP S646_AC S646_THCM_Conctrl /end SUB_GROUP
 /begin REF_MEASUREMENT VTHC_ACSubMode_enum VTHC_APTCI_K VTHC_APTCP_K VTHC_APTCU_K VTHC_APTCe_K VTHC_BatteryMode_enum VTHC_BlowerI_K VTHC_BlowerP_K VTHC_BlowerU_K VTHC_Blowere_K VTHC_CabinMode_enum VTHC_CompDeltaU_K VTHC_CompI_K VTHC_CompP_K VTHC_CompU_K VTHC_Compe_K VTHC_CoolgFanActDuty_pct VTHC_EDriveMode_enum VTHC_EXV1I_K VTHC_EXV1P_K VTHC_EXV1U_K VTHC_EXV1e_K VTHC_EXV2I_K VTHC_EXV2P_K VTHC_EXV2U_K VTHC_EXV2e_K VTHC_FDAGSCmd_enum VTHC_FDBlowerCmd_pct VTHC_FDCompCmd_rpm VTHC_FDEXV1Cmd_step VTHC_FDEXV2Cmd_step VTHC_FDFrLeAPTCHeatPwrCmd_W VTHC_FDFrRiAPTCHeatPwrCmd_W VTHC_FDFrWPTCHeatPwrCmd_W VTHC_FDRrAPTCHeatPwrCmd_W VTHC_FDSOTXVCmd_flg VTHC_Vbase_pct VTHC_sigAmbAirT_C VTHC_sigCbnAirT_C VTHC_sigCbnSolarLeft_W VTHC_sigCbnSolarRight_W VTHC_sigClntTHvBattIn_C VTHC_sigClntTHvBattOut_C /end REF_MEASUREMENT
/end GROUP
/begin GROUP S16_TPMS "SWC_FDC_type/run_SWC_FDC_RxTx_5ms_sys/APP/TPM/TPMS" /begin SUB_GROUP S1040_ModelVersion S1040_TPMS /end SUB_GROUP /end GROUP
/begin GROUP S17_TorqueDemand "SWC_FDC_type/run_SWC_FDC_RxTx_5ms_sys/APP/TQD/TorqueDemand"
 /begin SUB_GROUP S1274_CrashDetect S1274_ShiftModule S1274_Signal_convert S1274_TorqueModule /end SUB_GROUP
 /begin REF_CHARACTERISTIC KTQD_YawRateSW_flg /end REF_CHARACTERISTIC
/end GROUP
/begin GROUP S18_Determine_Torque_Request "SWC_FDC_type/run_SWC_FDC_RxTx_5ms_sys/APP/TQR/Determine Torque Request" /begin SUB_GROUP S1643_TorqueArbitrament /end SUB_GROUP /begin REF_MEASUREMENT VTQR_FEDUTMSpdReq_rpm VTQR_REDUTMSpdReq_rpm /end REF_MEASUREMENT /end GROUP
/begin GROUP S19_VMC "SWC_FDC_type/run_SWC_FDC_RxTx_5ms_sys/APP/VMC/VMC"
 /begin SUB_GROUP S1910_ACC_Function S1910_APS_function S1910_CruiseControlFunction S1910_EPSForceSelect S1910_FeatureSetSpeed S1910_IMU S1910_LFCAOIControl S1910_Long_Acceleration_Calculation S1910_MSA_function S1910_PreConditionCheck S1910_RDC_Determination S1910_SPD2ACC S1910_SafetyControl S1910_Slide_Rate__Calculation S1910_SpeedArbitration S1910_SpeedCalculation S1910_VMC_FCM1 /end SUB_GROUP
 /begin REF_CHARACTERISTIC KVMC_RDCGySource_flg KVMC_RDCRzSource_flg KVMC_SlideRateGxSource_flg /end REF_CHARACTERISTIC
 /begin REF_MEASUREMENT VVMC_ACCComfortBandLower_mps2 VVMC_ACCComfortBandUpper_mps2 VVMC_ACCJerkLowerLimit_mps3 VVMC_ACCJerkUpperLimit_mps3 VVMC_ACCObjDist_m VVMC_ACCObjDstLvl_enum VVMC_ACCObjRelSpd_mps VVMC_ACCTakeoverReq_flg VVMC_ADASAEBReq_enum VVMC_ADASAEBSta_enum VVMC_ADASCAMSpdLim_enum VVMC_ADASDBSReq_enum VVMC_ADASFCWMute_flg VVMC_ADASFCWSta_enum VVMC_ADASFaultSta_flg VVMC_ADASFltWrnReq_flg VVMC_ADASForceIdle_flg VVMC_ADASISASta_enum VVMC_ADASLDWMute_flg VVMC_ADASLDWSta_enum VVMC_ADASLKASta_enum VVMC_ADASLaneModeL_enum VVMC_ADASLaneModeR_enum VVMC_ADASLanecurveL_raw32 VVMC_ADASLanecurveR_raw32 VVMC_ADASLanetypeL_enum VVMC_ADASLanetypeR_enum VVMC_ADASSLIFSpdLim_enum VVMC_ADASSLIFSta_enum VVMC_ADASShftPosnReqA_flg VVMC_ADASShftPosnReq_enum VVMC_ADASVehSpdLim_raw32 VVMC_ADASWarningMsg_enum VVMC_AEBVehHoldReq_flg VVMC_CCMSASpdWar_flg VVMC_FCMACCmode_enum VVMC_ForceLowBeam_enum VVMC_HazardWarningReq_flg VVMC_LKAHODDisplayWarning_flg VVMC_LKAHODSoundWarning_flg VVMC_LKATOIFault_flg VVMC_LVDAACCStatusInformation_flg VVMC_LVDADisabled_flg VVMC_LVDAFailinfo_flg VVMC_LVDAMuteSta_enum VVMC_LVDAWarning_flg VVMC_LeftTurnLightReq_flg VVMC_RightTurnLightReq_flg VVMC_TargetType_enum VVMC_TimeGapLevel_enum /end REF_MEASUREMENT
/end GROUP
/begin GROUP S22_THCM_Available_Check "SWC_FDC_type/run_SWC_FDC_RxTx_5ms_sys/APP/ACC/THCM/THCM_Available_Check"
 /begin REF_CHARACTERISTIC KACC_HVTHCMSysAvail_enum_ovrdflg KACC_HVTHCMSysAvail_enum_ovrdval /end REF_CHARACTERISTIC
 /begin REF_MEASUREMENT VACC_HVTHCMSysAvail_enum /end REF_MEASUREMENT
/end GROUP
/begin GROUP S22_THCM_Available_Power "SWC_FDC_type/run_SWC_FDC_RxTx_5ms_sys/APP/ACC/THCM/THCM_Available_Power"
 /begin REF_CHARACTERISTIC KACC_HVPwrAvail4THCM_W_ovrdflg KACC_HVPwrAvail4THCM_W_ovrdval KACC_THCMMaxPwrAvail_W /end REF_CHARACTERISTIC
 /begin REF_MEASUREMENT VACC_VehHVPwrAvail4THCM_W /end REF_MEASUREMENT
/end GROUP
/begin GROUP S22_TMAvailablePwr_Calculation "SWC_FDC_type/run_SWC_FDC_RxTx_5ms_sys/APP/ACC/THCM/TMAvailablePwr_Calculation"
 /begin REF_CHARACTERISTIC KACC_DCDCCalPwrAvailRsv_kW KACC_RsvPwr4DCDCTHCM_ovrdflg KACC_RsvPwr4DCDCTHCM_ovrdval KACC_RsvPwrGain_C KACC_SysPwrAvailDchrg_ovrdflg KACC_THCMCalPwrAvailRsv_kW /end REF_CHARACTERISTIC
 /begin REF_MEASUREMENT VACC_RsvPwr4DCDCTHCM_W VACC_RsvPwr4DCDCTHCM_kW VACC_TMPwrAvailDchrg_kW /end REF_MEASUREMENT
/end GROUP
/begin GROUP S27_APM_Door "SWC_FDC_type/run_SWC_FDC_RxTx_5ms_sys/APP/BCM/BCM/APM_Door" /begin SUB_GROUP S29_DoorAPM S29_DoorAPM1 S29_DoorAPM2 S29_DoorAPM3 /end SUB_GROUP
 /begin REF_CHARACTERISTIC KBCM_APMDoorCtrlSta_flg_ovrdflg KBCM_APMDoorCtrlSta_flg_ovrdval KBCM_DrAPMRetryTimes_cnt KBCM_DrOpenWdwOT_s KBCM_DrOpenWdwReady_s KBCM_WaitAPMPwr_K KBCM_WdwManualDetT_s /end REF_CHARACTERISTIC
 /begin REF_MEASUREMENT VBCM_APMDoorControlSta_flg /end REF_MEASUREMENT
/end GROUP
/begin GROUP S27_Amb "SWC_FDC_type/run_SWC_FDC_RxTx_5ms_sys/APP/BCM/BCM/Amb"
 /begin REF_CHARACTERISTIC KBCM_ALMBrightnessDark_enum KBCM_AmbBlue_enum KBCM_AmbBreathT_ms KBCM_AmbGreen_enum KBCM_AmbMidPple_enum KBCM_AmbRed_enum KBCM_AmbTempCtrlEN_flg KBCM_AmbTempT_s KBCM_AmbWelModeENWait_s KBCM_RightHandDriveEN_flg /end REF_CHARACTERISTIC
/end GROUP
/begin GROUP S27_AntiTheft "SWC_FDC_type/run_SWC_FDC_RxTx_5ms_sys/APP/BCM/BCM/AntiTheft" /begin SUB_GROUP S31_Antitheft__override /end SUB_GROUP
 /begin REF_MEASUREMENT VBCM_ATActCtrl_enum VBCM_ATAlarm_flg VBCM_ATCtrl_enum VBCM_AllDoorSW_flg VBCM_AntitheftSeatFlod_flg VBCM_CountAlarm_enum VBCM_DrDoorSW_flg VBCM_HoodRelCmd_flg VBCM_HornCtrl_flg VBCM_PsDoorSW_flg VBCM_TailgateRemote_enum VBCM_VIGCommand_enum /end REF_MEASUREMENT
/end GROUP
/begin GROUP S27_BCM_WAKE_MODULE "SWC_FDC_type/run_SWC_FDC_RxTx_5ms_sys/APP/BCM/BCM/BCM_WAKE_MODULE" /begin REF_CHARACTERISTIC KBCM_SlpDebounceTime_s /end REF_CHARACTERISTIC /begin REF_MEASUREMENT VBCM_ConditionTimer_s VBCM_SleepReq_flg /end REF_MEASUREMENT /end GROUP
/begin GROUP S27_CSW "SWC_FDC_type/run_SWC_FDC_RxTx_5ms_sys/APP/BCM/BCM/CSW"
 /begin REF_CHARACTERISTIC KBCM_CSWLightRstDebT_s KBCM_CSWTurnLPRstT_s KBCM_TrunSWKeepTime3_s KBCM_TrunSWKeepTime5_s KBCM_TrunSWKeepTime7_s KBCM_WipSensLevelPlus_enum KBCM_WipSensLevel_enum /end REF_CHARACTERISTIC
 /begin REF_MEASUREMENT VBCM_SenstivityPosnCmd_enum /end REF_MEASUREMENT
/end GROUP
/begin GROUP S27_CenterDoorLock "SWC_FDC_type/run_SWC_FDC_RxTx_5ms_sys/APP/BCM/BCM/CenterDoorLock"
 /begin REF_MEASUREMENT VBCM_CTDCtrl_enum VBCM_CrashDetd_flg VBCM_DiagHCrash_flg VBCM_DoorLockIND_flg VBCM_FrChargingDoorCtrl_enum VBCM_FuelDoorPos_flg VBCM_RrChargingDoorCtrl_enum VBCM_fUnlockSingle_flg VBCM_fVIGHandle_flg /end REF_MEASUREMENT
/end GROUP
/begin GROUP S27_DID_Judgement "SWC_FDC_type/run_SWC_FDC_RxTx_5ms_sys/APP/BCM/BCM/DID Judgement"
 /begin REF_CHARACTERISTIC KBCM_DiagDRLOFF_flg KBCM_DiagFLTC_mA KBCM_DiagFMHT_s KBCM_DiagFRTC_mA KBCM_DiagRLTC_mA KBCM_DiagRRTC_mA KBCM_TurnLPErrEN_flg /end REF_CHARACTERISTIC
/end GROUP
/begin GROUP S27_Dimmer "SWC_FDC_type/run_SWC_FDC_RxTx_5ms_sys/APP/BCM/BCM/Dimmer" /begin REF_MEASUREMENT VBCM_DimmerEN_flg VBCM_Dimmer_pct VBCM_MFRDNBrightReq_pct /end REF_MEASUREMENT /end GROUP
/begin GROUP S27_ExteriorLight "SWC_FDC_type/run_SWC_FDC_RxTx_5ms_sys/APP/BCM/BCM/ExteriorLight" /begin REF_CHARACTERISTIC KBCM_ONDelayT_ms /end REF_CHARACTERISTIC
 /begin REF_MEASUREMENT VBCM_AutoCut_flg VBCM_BrakeLamp_flg VBCM_FollowMe_flg VBCM_HBeam_flg VBCM_LBSD_flg VBCM_LBeam_flg VBCM_LDRL_flg VBCM_PosLamp_flg VBCM_RBSD_flg VBCM_RDRL_flg VBCM_ReverseLamp_flg VBCM_RrFogLamp_flg VBCM_showup_flg /end REF_MEASUREMENT
/end GROUP
/begin GROUP S27_FlasherSignal "SWC_FDC_type/run_SWC_FDC_RxTx_5ms_sys/APP/BCM/BCM/FlasherSignal"
 /begin REF_CHARACTERISTIC KBCM_ESSOffT_ms KBCM_ESSOnT_ms KBCM_RAPSAbnFlashOFFT_ms KBCM_RAPSAbnFlashONT_ms KBCM_WelLockT_s KBCM_WelcomeT_s /end REF_CHARACTERISTIC
 /begin REF_MEASUREMENT VBCM_BCMBuzzerReq_flg VBCM_HazardIND_flg VBCM_HazardSW_flg VBCM_LTurnLP_flg VBCM_OutMode_enum VBCM_RTurnLP_flg VBCM_WelcomeLight_enum /end REF_MEASUREMENT
/end GROUP
/begin GROUP S27_HMI_Custom_Button "SWC_FDC_type/run_SWC_FDC_RxTx_5ms_sys/APP/BCM/BCM/HMI_Custom_Button"
 /begin SUB_GROUP S41_Key1 S41_Key2 S41_Key3 S41_Key4 S41_Key5 S41_Key6 S41_Key7 S41_Key8 /end SUB_GROUP
/end GROUP
/begin GROUP S27_PTG "SWC_FDC_type/run_SWC_FDC_RxTx_5ms_sys/APP/BCM/BCM/PTG" /begin SUB_GROUP S43_KeyDetected S43_Subsystem1 S43_Subsystem3 /end SUB_GROUP
 /begin REF_CHARACTERISTIC KBCM_FDCDKCReDetectT_K KBCM_FDCDKCUSSFilterT_K KBCM_SPTGDetectWaitT_s KBCM_SPTGLowerBound_cm KBCM_SPTGZoneDebT_s KBCM_SPTGZoneRejectEN_flg KBCM_USSFilterT_K /end REF_CHARACTERISTIC
/end GROUP
/begin GROUP S27_Personal_Setting "SWC_FDC_type/run_SWC_FDC_RxTx_5ms_sys/APP/BCM/BCM/Personal_Setting"
 /begin SUB_GROUP S44_ACC S44_AmbLight S44_Autolock S44_DKC_Lock_Setting S44_FlasherSignal S44_FollowMeHome S44_LockSetting S44_PTG S44_RoomLamp S44_SPTG /end SUB_GROUP
 /begin REF_CHARACTERISTIC KBCM_UserFix_enum /end REF_CHARACTERISTIC
 /begin REF_MEASUREMENT VBCM_UserNow_enum /end REF_MEASUREMENT
/end GROUP
/begin GROUP S27_PowerMirror "SWC_FDC_type/run_SWC_FDC_RxTx_5ms_sys/APP/BCM/BCM/PowerMirror"
 /begin REF_MEASUREMENT VBCM_MFSWTri_flg VBCM_MirrorCtrl_enum VBCM_MirrorFlodPos_flg /end REF_MEASUREMENT
/end GROUP
/begin GROUP S27_RearDefogger "SWC_FDC_type/run_SWC_FDC_RxTx_5ms_sys/APP/BCM/BCM/RearDefogger" /begin REF_MEASUREMENT VBCM_MirrorDefog_flg VBCM_RrDefog_flg /end REF_MEASUREMENT /end GROUP
/begin GROUP S27_RoomLamp "SWC_FDC_type/run_SWC_FDC_RxTx_5ms_sys/APP/BCM/BCM/RoomLamp" /begin REF_MEASUREMENT VBCM_RoomLampH_flg VBCM_RoomLampL_flg VBCM_RoomLampTmr_s /end REF_MEASUREMENT /end GROUP
/begin GROUP S27_Tailgate "SWC_FDC_type/run_SWC_FDC_RxTx_5ms_sys/APP/BCM/BCM/Tailgate" /begin REF_MEASUREMENT VBCM_TrunkRel_flg /end REF_MEASUREMENT /end GROUP
/begin GROUP S27_Vehicle_Type_Diff_Fun "SWC_FDC_type/run_SWC_FDC_RxTx_5ms_sys/APP/BCM/BCM/Vehicle Type Diff Fun" /begin REF_CHARACTERISTIC KBCM_RightHandDriveEN_flg /end REF_CHARACTERISTIC /end GROUP
/begin GROUP S27_Verify "SWC_FDC_type/run_SWC_FDC_RxTx_5ms_sys/APP/BCM/BCM/Verify" /begin REF_MEASUREMENT VBCM_FlashAntitheft_enum /end REF_MEASUREMENT /end GROUP
/begin GROUP S27_WasherWiper "SWC_FDC_type/run_SWC_FDC_RxTx_5ms_sys/APP/BCM/BCM/WasherWiper" /begin SUB_GROUP S51_RLS_Command_Cut_Filter /end SUB_GROUP
 /begin REF_MEASUREMENT VBCM_AutoWipHSpdENSta_flg VBCM_FrWiperH_flg VBCM_FrWiperL_flg VBCM_RrWiper_flg VBCM_WasherCtrl_enum VBCM_WiperFixMode_flg /end REF_MEASUREMENT
/end GROUP
/begin GROUP S27_Window_Control_Sig_Combine "SWC_FDC_type/run_SWC_FDC_RxTx_5ms_sys/APP/BCM/BCM/Window_Control_Sig_Combine" /begin SUB_GROUP S52_Driver_Window S52_Passenger_Window /end SUB_GROUP
 /begin REF_MEASUREMENT VBCM_DrRWdwCtrlCmd_pct VBCM_DrRWdwReqAP_enum VBCM_PsRWdwCtrlCmd_pct VBCM_PsRWdwReqAP_enum VBCM_WinLFOpenedSta_pct VBCM_WinLROpenedSta_pct VBCM_WinRFOpenedSta_pct VBCM_WinRROpenedSta_pct /end REF_MEASUREMENT
/end GROUP
/begin GROUP S316_APS_calaulation "SWC_FDC_type/run_SWC_FDC_RxTx_5ms_sys/APP/DHP/DHP/APS_calaulation" /begin SUB_GROUP S317_Calculation S317_StateJudge S317_ZPLearn /end SUB_GROUP /end GROUP
/begin GROUP S316_Signal_convert "SWC_FDC_type/run_SWC_FDC_RxTx_5ms_sys/APP/DHP/DHP/Signal_convert" /begin REF_MEASUREMENT VDHP_EAPS1RAW_pct VDHP_EAPS2RAW_pct /end REF_MEASUREMENT /end GROUP
/begin GROUP S338_DKC_Handler "SWC_FDC_type/run_SWC_FDC_RxTx_5ms_sys/APP/DKC/Subsystem/DKC_Handler"
 /begin SUB_GROUP S339_SR_Latch11 S339_SR_Latch12 S339_SR_Latch13 S339_SR_Latch14 S339_SR_Latch17 S339_SR_Latch18 S339_SR_Latch19 S339_SR_Latch20 S339_SR_Latch22 S339_SR_Latch23 S339_SR_Latch24 S339_SR_Latch25 S339_SR_Latch8 /end SUB_GROUP
 /begin REF_CHARACTERISTIC KDKC_APSStaSystem_enum_ovrdflg KDKC_APSStaSystem_enum_ovrdval KDKC_AutoLockTimeout_s KDKC_BTConnectSta_enum_ovrdflg KDKC_BTConnectSta_enum_ovrdval KDKC_BTDisconJudgeDeb_s KDKC_BTRSSISampTime_s KDKC_DKCAllowSleepDelayTime_s KDKC_DKCBTRSSI_dB_ovrdflg KDKC_DKCBTRSSI_dB_ovrdval KDKC_DKCStandbyWait60sTime_s KDKC_DrDoorOpenStaKeep_s KDKC_FDCKeyAllowSleep_flg_ovrdflg KDKC_FDCKeyAllowSleep_flg_ovrdval KDKC_JudBTRSSIStrongDeb_cnt KDKC_JudBTRSSIStrongThres_dB KDKC_JudBTRSSIWeakDeb_cnt KDKC_JudBTRSSIWeakThres_dB KDKC_KeyMissStaSW_ovrdflg KDKC_KeyMissStaSW_ovrdval KDKC_KeyUWBDetArea_enum_ovrdflg KDKC_KeyUWBDetArea_enum_ovrdval KDKC_KeyUWBDetPTGArea_enum_ovrdflg KDKC_KeyUWBDetPTGArea_enum_ovrdval KDKC_KeyUWBDetRAPSArea_enum_ovrdflg KDKC_KeyUWBDetRAPSArea_enum_ovrdval KDKC_KeyUWBDetSPTGArea_enum_ovrdflg KDKC_KeyUWBDetSPTGArea_enum_ovrdval KDKC_LatchLidADetGreenCard_s KDKC_LatchWelcomeModeSta_s KDKC_LockCmdDelayTime_s KDKC_PSAreaTimeout_s KDKC_PTGSWCloseTimeout_s KDKC_StoreUnlockAreaSW_ovrdflg KDKC_StoreUnlockAreaSW_ovrdval KDKC_UIDBTStaBSWInpSW_ovrdflg KDKC_UIDBatLowVolDeb_cnt KDKC_UIDBatLowVolx1000Thres_V KDKC_UIDBatOKVolDeb_cnt KDKC_UIDBatOKVolx1000Thres_V KDKC_UIDBatSampInterval_s KDKC_UIDBatSampTotal_cnt KDKC_UIDBatVoltx1000_V_ovrdflg KDKC_UIDBatVoltx1000_V_ovrdval KDKC_UIDRSSIBSWtInpSW_ovrdflg KDKC_UIDVolBSWtInpSW_ovrdflg KDKC_UnavToUnlReqSW_ovrdflg KDKC_UnavToUnlReqSW_ovrdval KDKC_UnlockCmdDelayTime_s KDKC_UserReqRAPSLatch_flg_ovrdflg KDKC_UserReqRAPSLatch_flg_ovrdval KDKC_WaitAPMAPSReqTime_s KDKC_WaitAPMJudgUserReqTime_s KDKC_ZONEVaildCmdDelayTime_s /end REF_CHARACTERISTIC
 /begin REF_MEASUREMENT VDKC_ACCSWSta_flg VDKC_APSStaSystem_enum VDKC_AutoLeavePSTimerLatch_flg VDKC_AutoLockPCmdHandSta_enum VDKC_AutoLockPCmdToBCMRAW_enum VDKC_AutoLockReqtoLock_flg VDKC_BLERSSI_enum VDKC_BTConnectSta_enum VDKC_CoordinateX_enum VDKC_CoordinateY_enum VDKC_DKCAutoJudgTimerActive_flg VDKC_DKCBTRSSI_dB VDKC_DKCCmdHandTimerActive_flg VDKC_DKCOtherTimerActive_flg VDKC_DKCPCmdFallingEdge_flg VDKC_DKCRAPSTimerActive_flg VDKC_DKCTGTimerActive_flg VDKC_DkeyAreaRAPSSta_enum VDKC_DkeyRAPSAreaRaw_enum VDKC_DkeyShowIVISta_enum VDKC_FDCDKCTimerActive_flg VDKC_FDCKeyAllowSleep_flg VDKC_FDCKeyAreaLockUnlock_enum VDKC_FDCKeyAreaPS_enum VDKC_FDCKeyAreaPTG_enum VDKC_FDCKeyAreaSPTG_enum VDKC_FDCKeyWelcomeSta_enum VDKC_FDCPCommandToBCM_enum VDKC_GrayChgToUnlockZone_flg VDKC_InnerSW1CloseTimeOut_flg VDKC_InnerSW1TimerLatch_flg VDKC_InnerSW2CloseTimeOut_flg VDKC_InnerSW2TimerLatch_flg VDKC_JudgKeyMissSta_flg VDKC_KeyMissSta_flg VDKC_KeyModeSta_enum VDKC_KeyTypeSta_enum VDKC_KeyUWBDetArea_enum VDKC_NFCAutoLockTimerLatch_flg VDKC_NFCDetJudgeAutoLock_flg VDKC_NFCDetPCmdHandSta_enum VDKC_NFCDetPCmdToBCMRAW_enum VDKC_NFCJudgeAutoLeavePS_flg VDKC_NFCJudgePEZoneSta_enum VDKC_NFCJudgePSZoneSta_enum VDKC_OutputPCMDModule_enum VDKC_PMMChgToReady_flg VDKC_PMMCrash_flg VDKC_PTGPCmdHandSta_enum VDKC_PTGPCmdToBCMRAW_enum VDKC_ParkingModeCmd_enum VDKC_PressSW1FallingEdge_flg VDKC_PressSW1RisingEdge_flg VDKC_PressSW2FallingEdge_flg VDKC_PressSW2RisingEdge_flg VDKC_PrsSW1orDKCNoEdgTimOut_flg VDKC_PrsSW2TGFalEdgeInPS_flg VDKC_PrsSW2TGFalEdgeOutPS_flg VDKC_PrsSW2TGNoEdgeTimeOut_flg VDKC_RAPStopTrigger_flg VDKC_RPAStandbyTcTrig_flg VDKC_RPAWait60sReqTout_flg VDKC_RSSIJudgeArea_enum VDKC_RemTGCmdCloseTimeOut_flg VDKC_RemTGCmdTimerLatch_flg VDKC_StoreUnlockAreaEdge_flg VDKC_TGFalEdgeInPS_flg VDKC_TrunkHanPCmdHandSta_enum VDKC_TrunkHanPCmdToBCMRAW_enum VDKC_TrunkHandleSW_flg VDKC_UIDAutoLockTimerLatch_flg VDKC_UIDBackWReset_flg VDKC_UIDBatLowVolt_flg VDKC_UIDBatVolt_enum VDKC_UIDBatVoltx1000_V VDKC_UIDButtJudgeAutoLock_flg VDKC_UIDButtonBackWPress_flg VDKC_UIDButtonBackWRelease_flg VDKC_UIDButtonCarSearch_flg VDKC_UIDButtonChargeCover_flg VDKC_UIDButtonForWPress_flg VDKC_UIDButtonForWRelease_flg VDKC_UIDButtonFrontHood_flg VDKC_UIDButtonLock_flg VDKC_UIDButtonPCmdHandSta_enum VDKC_UIDButtonPCmdToBCMRAW_enum VDKC_UIDButtonRemTailGate_flg VDKC_UIDButtonStartPress_flg VDKC_UIDButtonStartRelease_flg VDKC_UIDButtonUnlock_flg VDKC_UIDDetRSSIChgToLock_flg VDKC_UIDForWReset_flg VDKC_UIDLowPowerSta_flg VDKC_UWB0Distance_enum VDKC_UWB0FPP_enum VDKC_UWB0Invalid_flg VDKC_UWB1Distance_enum VDKC_UWB1FPP_enum VDKC_UWB1Invalid_flg VDKC_UWB2Distance_enum VDKC_UWB2FPP_enum VDKC_UWB2Invalid_flg VDKC_UWB3Distance_enum VDKC_UWB3FPP_enum VDKC_UWB3Invalid_flg VDKC_UWB4Distance_enum VDKC_UWB4FPP_enum VDKC_UWB4Invalid_flg VDKC_UWBDetAreaChaToUnlock_flg VDKC_UWBDetAreaChangeToLock_flg VDKC_UWBDetAreaChgWelcome_flg VDKC_UWBDetArea_enum VDKC_UWBDetKeepUnltoOther_flg VDKC_UWBDetPCmdHandSta_enum VDKC_UWBDetPCmdToBCMRAW_enum VDKC_UWBDetPEZoneKeepSta_enum VDKC_UWBDetPEZoneSta_enum VDKC_UWBDetPSZoneKeepSta_enum VDKC_UWBDetPSZoneSta_enum VDKC_UWBDetPTGArea_enum VDKC_UWBDetRAPSZoneKeep_enum VDKC_UWBDetUnLockSta_enum VDKC_UWBDetUnlockKeepSta_enum VDKC_UWBDetWithinUnlockZone_flg VDKC_UWBOnOff_flg VDKC_UnORGrChgToUnlZone_flg VDKC_UnavChgToUnlockZone_flg VDKC_UnavToUnlReqUnlock_flg VDKC_UnavToUnlReq_flg VDKC_UnlockZoneFallEdge_flg VDKC_UserReqRAPTrigger_flg VDKC_WaitAPMJuUserReqTout_flg VDKC_WaitAPMReqTimeout_flg /end REF_MEASUREMENT
/end GROUP
/begin GROUP S338_Subsystem "SWC_FDC_type/run_SWC_FDC_RxTx_5ms_sys/APP/DKC/Subsystem/Subsystem"
 /begin REF_MEASUREMENT VDKC_DKeyWelcomeSta_enum VDKC_FDCDKCAllowSleep_flg VDKC_KeyAreaLockUnlock_enum VDKC_KeyAreaPS_enum VDKC_KeyAreaPTG_enum VDKC_KeyAreaSPTGSta_enum VDKC_PCommandToBCM_enum /end REF_MEASUREMENT
/end GROUP
/begin GROUP S512_Subsystem_AutoMode "SWC_FDC_type/run_SWC_FDC_RxTx_5ms_sys/APP/DSC/Subsystem/Subsystem_AutoMode" /begin REF_CHARACTERISTIC KINP_DISCButtReq_flg_ovrdflg KINP_DISCButtReq_flg_ovrdval /end REF_CHARACTERISTIC /begin REF_MEASUREMENT VDSC_DISCButtSta_flg /end REF_MEASUREMENT /end GROUP
/begin GROUP S512_Subsystem_ComtrolSpd "SWC_FDC_type/run_SWC_FDC_RxTx_5ms_sys/APP/DSC/Subsystem/Subsystem_ComtrolSpd"
 /begin SUB_GROUP S514_Subsystem S514_Subsystem_LowSpdControl S514_Subsystem_TurningControl /end SUB_GROUP
 /begin REF_CHARACTERISTIC KDSC_SpdRangeHigh_kph KDSC_SpdRangeLow_kph KDSC_TriggerTimes /end REF_CHARACTERISTIC
 /begin REF_MEASUREMENT VDSC_DISCTargetSpd_kph VDSC_ModeSwitch_flg /end REF_MEASUREMENT
/end GROUP
/begin GROUP S512_Subsystem_ConditionalJudgment "SWC_FDC_type/run_SWC_FDC_RxTx_5ms_sys/APP/DSC/Subsystem/Subsystem_ConditionalJudgment"
 /begin REF_CHARACTERISTIC KDSC_AccPedalOvrd_flg KDSC_ActiveAllowTime_s KDSC_BrkDisBand_pct KDSC_BrkEnBand_pct KDSC_BrkPedalOvrd_flg KDSC_MaxSpeed_kph KDSC_MinSpeed_kph KDSC_TurnAngExit_deg KDSC_TurnAngLimit_deg /end REF_CHARACTERISTIC
 /begin REF_MEASUREMENT VDSC_DISCActiveReq_flg VDSC_DISCEnableReq_flg VDSC_DISCNotTurnReq_flg VDSC_DISCTurnReq_flg /end REF_MEASUREMENT
/end GROUP
/begin GROUP S512_Subsystem_EstimateSlope "SWC_FDC_type/run_SWC_FDC_RxTx_5ms_sys/APP/DSC/Subsystem/Subsystem_EstimateSlope" /begin SUB_GROUP S516_lowpass S516_lowpass1 S516_lowpass2 /end SUB_GROUP /begin REF_CHARACTERISTIC KDSC_CGRealAxle_m KDSC_LongAccelLimit_g /end REF_CHARACTERISTIC /end GROUP
/begin GROUP S512_Subsystem_StateSwitch "SWC_FDC_type/run_SWC_FDC_RxTx_5ms_sys/APP/DSC/Subsystem/Subsystem_StateSwitch"
 /begin REF_MEASUREMENT VDSC_DISCActing_flg VDSC_DISCLow_flg VDSC_DISCSta_enum VDSC_DISCTurn_flg /end REF_MEASUREMENT
/end GROUP
/begin GROUP S512_Subsystem_TempWarning "SWC_FDC_type/run_SWC_FDC_RxTx_5ms_sys/APP/DSC/Subsystem/Subsystem_TempWarning" /begin REF_MEASUREMENT VDSC_TempWarning_flg /end REF_MEASUREMENT /end GROUP
/begin GROUP S544_CheckIfNoNMIDforTime "SWC_FDC_type/run_SWC_FDC_RxTx_5ms_sys/APP/NMM/Subsystem/CheckIfNoNMIDforTime" /begin REF_CHARACTERISTIC KNMM_NoNMIdDebounce_s /end REF_CHARACTERISTIC /begin REF_MEASUREMENT VNMM_NoNMIdDebounced_flg /end REF_MEASUREMENT /end GROUP
/begin GROUP S544_Latch1 "SWC_FDC_type/run_SWC_FDC_RxTx_5ms_sys/APP/NMM/Subsystem/Latch1" /begin REF_MEASUREMENT VNMM_NetworkReqCalled_flg /end REF_MEASUREMENT /end GROUP
/begin GROUP S549_DCDC_output_volt_setpoint_judgment "SWC_FDC_type/run_SWC_FDC_RxTx_5ms_sys/APP/PMM/PMM/DCDC output volt setpoint judgment" /begin REF_CHARACTERISTIC KPMM_DCDCVSETLVChrg_V KPMM_LVChrgVSetSW_flg /end REF_CHARACTERISTIC /begin REF_MEASUREMENT VPMM_DCDCVoltSetpoint_V /end REF_MEASUREMENT /end GROUP
/begin GROUP S549_Hold4 "SWC_FDC_type/run_SWC_FDC_RxTx_5ms_sys/APP/PMM/PMM/Hold4" /begin REF_MEASUREMENT VPMM_APSFailRisingEdge_flg /end REF_MEASUREMENT /end GROUP
/begin GROUP S549_MCU_EnaReq_Control "SWC_FDC_type/run_SWC_FDC_RxTx_5ms_sys/APP/PMM/PMM/MCU_EnaReq_Control" /begin REF_CHARACTERISTIC KTQD_RrPreLoadBoundary_Nm /end REF_CHARACTERISTIC
 /begin REF_MEASUREMENT VPMM_FrMCUEnaReq_flg VPMM_MCUEnaReq_flg VPMM_RrMCUEnaReq_flg /end REF_MEASUREMENT
/end GROUP
/begin GROUP S549_OTA_power_state_constrain "SWC_FDC_type/run_SWC_FDC_RxTx_5ms_sys/APP/PMM/PMM/OTA power state constrain" /begin REF_CHARACTERISTIC KPMM_OTAPwrReqOFFChk_s KPMM_OTAPwrReqStdChk_s /end REF_CHARACTERISTIC /begin REF_MEASUREMENT VPMM_OTAPwrReqOFFChkSta_enum VPMM_OTAPwrReqStdChkSta_enum /end REF_MEASUREMENT /end GROUP
/begin GROUP S549_PMMDataConvert "SWC_FDC_type/run_SWC_FDC_RxTx_5ms_sys/APP/PMM/PMM/PMMDataConvert"
 /begin SUB_GROUP S560_Hold S560_Hold1 S560_Hold10 S560_Hold2 S560_Hold3 S560_Hold4 S560_Hold5 S560_Hold6 S560_Hold7 S560_Hold8 S560_Hold9 S560_SR_Latch /end SUB_GROUP
 /begin REF_CHARACTERISTIC KPMM_AllDoorClosedHoldTime_s KPMM_BrakeSWHoldTime_s KPMM_ChrgPlugHoldTime_s KPMM_DoorSWHoldTime_s KPMM_DrivetrainSelect_enum_ovrdflg KPMM_DrivetrainSelect_enum_ovrdval KPMM_FrMCUDischrgVolt_V KPMM_HVPwrStaHoldTime_s KPMM_IVIPwroffHoldTime_s KPMM_LVADCDiffThd_mV KPMM_LVADCErrTO_s KPMM_LVADCLoThd_mV KPMM_LVADCUpThd_mV KPMM_PWCONTINUEHoldTime_s KPMM_RrMCUDischrgVolt_V KPMM_SaftyChkHLvTO_s KPMM_SaftyChkMLvTO_s KPMM_SchedChgHoldTime_s KPMM_SeatSWHoldTime_s KPMM_TMSpdMCUDisThrsh_rpm /end REF_CHARACTERISTIC
 /begin REF_MEASUREMENT VPMM_AllDoorClosed_flg VPMM_AuxBatVolt_V VPMM_AuxBatVolt_mV VPMM_BMSWarm_flg VPMM_DetectAntitheftLock_flg VPMM_DetectAntitheftUnlock_flg VPMM_DetectPDKeyLock_flg VPMM_DetectPDKeyUnlock_flg VPMM_DrSeatSta_enum VPMM_DrivetrainSelect_enum VPMM_LVADCDiffErr_flg VPMM_LVADCHiLoThdErr_flg VPMM_MCUDCBusMaxVolt_V VPMM_MCUDischrgFinished_flg VPMM_MCUEnable_flg VPMM_MCUReady4Pre_flg VPMM_MCUReady_flg VPMM_PreChrgChk_flg VPMM_SafetyChkHLv_flg VPMM_SafetyChkMLv_flg VPMM_TMSpdThdSta_flg VPMM_TMSpd_rpm /end REF_MEASUREMENT
/end GROUP
/begin GROUP S549_RAPS_power_request "SWC_FDC_type/run_SWC_FDC_RxTx_5ms_sys/APP/PMM/PMM/RAPS power request" /begin REF_MEASUREMENT VPMM_PwrReqRAPSAvail_flg /end REF_MEASUREMENT /end GROUP
/begin GROUP S549_PMM_State_Machine "SWC_FDC_type/run_SWC_FDC_RxTx_5ms_sys/APP/PMM/PMM/PMM_State_Machine"
 /begin SUB_GROUP S561_OFF_C_CoolgFanActCurrCal S561_OFF_C_EWP1CurrCal S561_OFF_C_EWP3CurrCal S561_OFF_C_LVBattChrgTimeCal S561_OFF_PMM_Allow_ECU_Sleep_Judge_LVBattChkTimeCal S561_OFF_Silent_Charge_Judge_SilentChrgLvCal /end SUB_GROUP
/end GROUP
/begin GROUP S638_Latch "SWC_FDC_type/run_SWC_FDC_RxTx_5ms_sys/APP/SYS/FDC_ECU_SLEEP_AND_NVM_HANDLE/Latch" /begin REF_MEASUREMENT VSYS_AcoreRebootCmdACKLatch_flg /end REF_MEASUREMENT /end GROUP
/begin GROUP S646_AC "SWC_FDC_type/run_SWC_FDC_RxTx_5ms_sys/APP/THC/ThermalControl/AC"
 /begin SUB_GROUP S647_Subsystem10 S647_Subsystem11 S647_Subsystem12 S647_Subsystem13 S647_Subsystem14 S647_Subsystem15 S647_Subsystem16 S647_Subsystem17 S647_Subsystem2 S647_Subsystem33 S647_Subsystem6 S647_Subsystem7 S647_Subsystem8 S647_Subsystem9 /end SUB_GROUP
 /begin REF_CHARACTERISTIC KTHC_ACMaxMinT_sec KTHC_AirIntUpdateT_sec KTHC_DriverSeatPos_flg KTHC_FootColdT_C KTHC_FootColdTdelta_C KTHC_RecyChange_min KTHC_RecyHold_min KTHC_RecyOutterD_enum KTHC_RefreshEN_flg KTHC_ScreenUniq_flg KTHC_T2Mmaxamb_C KTHC_T3Mmaxamb_C KTHC_T3Mminamb_C KTHC_T4Mmaxamb_C KTHC_T4Mminamb_C KTHC_T5Mminamb_C KTHC_Thilevel1_C KTHC_Thilevel2_C KTHC_Tmidlevel_C KTHC_Trecymin_C KTHC_WDZ10Face_flg KTHC_WDZ10Foot_flg KTHC_WDZ10Frost_flg KTHC_WDZ1Face_flg KTHC_WDZ1Foot_flg KTHC_WDZ1Frost_flg KTHC_WDZ2Face_flg KTHC_WDZ2Foot_flg KTHC_WDZ2Frost_flg KTHC_WDZ3Face_flg KTHC_WDZ3Foot_flg KTHC_WDZ3Frost_flg KTHC_WDZ4Face_flg KTHC_WDZ4Foot_flg KTHC_WDZ4Frost_flg KTHC_WDZ5Face_flg KTHC_WDZ5Foot_flg KTHC_WDZ5Frost_flg KTHC_WDZ6Face_flg KTHC_WDZ6Foot_flg KTHC_WDZ6Frost_flg KTHC_WDZ7Face_flg KTHC_WDZ7Foot_flg KTHC_WDZ7Frost_flg KTHC_WDZ8Face_flg KTHC_WDZ8Foot_flg KTHC_WDZ8Frost_flg KTHC_WDZ9Face_flg KTHC_WDZ9Foot_flg KTHC_WDZ9Frost_flg KTHC_WindDirUpdateT_min /end REF_CHARACTERISTIC
 /begin REF_MEASUREMENT VTHC_ACForceOFF_flg VTHC_CCUACLampSts_flg VTHC_CCUACMaxLampSts_flg VTHC_CCUAutoLampSts_flg VTHC_CCUSyncLampSts_flg VTHC_Z1TDN_flg VTHC_Z1TUP_flg VTHC_Z2TDN_flg VTHC_Z2TUP_flg VTHC_sigAirIntenZon1St_enum VTHC_sigSetTempZon2St_C /end REF_MEASUREMENT
/end GROUP
/begin GROUP S646_THCM_Conctrl "SWC_FDC_type/run_SWC_FDC_RxTx_5ms_sys/APP/THC/ThermalControl/THCM_Conctrl" /begin REF_CHARACTERISTIC KTHC_Trecymin_C /end REF_CHARACTERISTIC /end GROUP
/begin GROUP S43_KeyDetected "SWC_FDC_type/run_SWC_FDC_RxTx_5ms_sys/APP/BCM/BCM/PTG/KeyDetected" /begin REF_CHARACTERISTIC KBCM_SPTGLowerBound_cm /end REF_CHARACTERISTIC /end GROUP
/begin GROUP S514_Subsystem_LowSpdControl "SWC_FDC_type/run_SWC_FDC_RxTx_5ms_sys/APP/DSC/Subsystem/Subsystem_ComtrolSpd/Subsystem_LowSpdControl" /begin REF_CHARACTERISTIC KDSC_MaxSpeed_kph KDSC_SpdRangeHigh_kph /end REF_CHARACTERISTIC /end GROUP
/begin GROUP S514_Subsystem_TurningControl "SWC_FDC_type/run_SWC_FDC_RxTx_5ms_sys/APP/DSC/Subsystem/Subsystem_ComtrolSpd/Subsystem_TurningControl"
 /begin REF_CHARACTERISTIC KDSC_SpdRangeHigh_kph KDSC_SpdRangeLow_kph KDSC_TurnAngLimit_deg /end REF_CHARACTERISTIC
/end GROUP
/begin GROUP S648_APTC "SWC_FDC_type/run_SWC_FDC_RxTx_5ms_sys/APP/THC/ThermalControl/THCM_Conctrl/APTC" /begin REF_CHARACTERISTIC KTHC_Trecymin_C /end REF_CHARACTERISTIC /end GROUP
/begin GROUP S134_CheckSignalAvailable "SWC_FDC_type/run_SWC_FDC_RxTx_5ms_sys/APP/BCM/BCM/PTG/KeyDetected/CheckSignalAvailable" /begin REF_CHARACTERISTIC KBCM_SPTGLowerBound_cm /end REF_CHARACTERISTIC /end GROUP
/begin GROUP S881_Subsystem "SWC_FDC_type/run_SWC_FDC_RxTx_5ms_sys/APP/THC/ThermalControl/THCM_Conctrl/APTC/Subsystem" /begin REF_CHARACTERISTIC KTHC_DriverSeatPos_flg /end REF_CHARACTERISTIC /end GROUP
/begin GROUP S1483_DriverTqCoordination "SWC_FDC_type/run_SWC_FDC_RxTx_5ms_sys/APP/TQD/TorqueDemand/TorqueModule/DriverWhlTqDem/DriverTqCoordination" /begin REF_CHARACTERISTIC KTQD_RrPreLoadBoundary_Nm /end REF_CHARACTERISTIC /end GROUP
/end MODULE
/end PROJECT
/* (add any file trailer comments here) */ /* EOF SWC_FDC_type.a2l */
