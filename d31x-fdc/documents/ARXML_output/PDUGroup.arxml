AUTOSAR XML (schema 4-3-0)
package /PduGroups
  13 x i signal i pdu group:
    FUSION_CAN1_Tx: communication-direction=OUT, communication-mode=CAN_Transmit_All
      i-signal-i-pdus:
        CAN1_FD1_APS2
        CAN1_FD1_APS3
        CAN1_FD1_BCM1
        CAN1_FD1_THCM1
        CAN1_FD1_VCU{1..3}
        CAN1_FD1_VMC1
        CAN1_FD1_VMC2
        CAN1_GW1_CE100_0
        CAN1_GW1_CE200_0
        CAN1_VMC_FCM1
    FUSION_CAN1_Rx: communication-direction=IN, communication-mode=CAN_Receive_All, i-signal-i-pdus=[CAN1_ABM1, CAN1_EPB1, CAN1_EPS1, CAN1_ESC1, CAN1_ESC5, CAN1_eBST1]
    FUSION_CAN2_Tx: communication-direction=OUT, communication-mode=CAN_Transmit_All
      i-signal-i-pdus:
        CAN2_FD2_C20_0
        CAN2_FD2_CE100_0
        CAN2_FD2_CE200_1
        CAN2_FD2_OTA1
        CAN2_FD2_Version
        CAN2_GW2_C10_0
        CAN2_GW2_CE1000_0
        CAN2_GW2_CE100_{0..2}
        CAN2_GW2_CE200_0
    FUSION_CAN2_Rx: communication-direction=IN, communication-mode=CAN_Receive_All, i-signal-i-pdus=[CAN2_HMI1, CAN2_IVI1, CAN2_IVI2, CAN2_IVI3, CAN2_METER1]
    FUSION_CAN3_Tx: communication-direction=OUT, communication-mode=CAN_Transmit_All
      i-signal-i-pdus:
        CAN3_FD3_BCM1
        CAN3_FD3_OTA1
        CAN3_FD3_THCM1
        CAN3_FD3_THCM2
        CAN3_FD3_V2L1
        CAN3_FD3_VCU0
        CAN3_FD3_VCU1
        CAN3_FD3_VCU1_toNIDEC
        CAN3_FD3_VCU2
        CAN3_FD3_VCU2_toNIDEC
        CAN3_FD3_VCU4
        CAN3_FD3_VCU5
        CAN3_GW3_CE100_0
        CAN3_GW_ESC1_toNIDEC
        CAN3_GW_IVI6_toNIDEC
    FUSION_CAN3_Rx: communication-direction=IN, communication-mode=CAN_Receive_All
      i-signal-i-pdus:
        CAN3_BMS1
        CAN3_BMS{3..6}
        CAN3_BMS8
        CAN3_CCU1
        CAN3_CCU2
        CAN3_EBM1
        CAN3_MCU_B_F1
        CAN3_MCU_B_F2
        CAN3_MCU_B_R1
        CAN3_MCU_B_R2
        CAN3_MCU_N_F{1..3}
        CAN3_MCU_N_R{1..3}
        CAN3_Shifter1
        CAN3_Shifter2
    FUSION_CAN4_Tx: communication-direction=OUT, communication-mode=CAN_Transmit_All
      i-signal-i-pdus:
        CAN4_FD4_CE100_{0..2}
        CAN4_FD4_CE200_0
        CAN4_FD4_OTA1
        CAN4_GW4_CE100_0
        CAN4_GW4_CE200_0
    FUSION_CAN4_Rx: communication-direction=IN, communication-mode=CAN_Receive_All
      i-signal-i-pdus:
        CAN4_BodyZone_DR1
        CAN4_BodyZone_DR2
        CAN4_BodyZone_PS1
        CAN4_BodyZone_PS2
        CAN4_DKC1
        CAN4_DKC2
        CAN4_PTG1
        CAN4_ZONE_DR1
        CAN4_ZONE_DR_VCU
        CAN4_ZONE_FR1
        CAN4_ZONE_FR_VCU
        CAN4_zGW_APTC1
        CAN4_zGW_CANFr1
        CAN4_zGW_LINDr1
        CAN4_zGW_LINDr2
        CAN4_zGW_LINFr1
        CAN4_zGW_LINFr2
        CAN4_zGW_SEAT1
    FUSION_CAN5_Tx: communication-direction=OUT, communication-mode=CAN_Transmit_All
      i-signal-i-pdus:
        CAN5_FD5_CE100_0
        CAN5_FD5_CONN1
        CAN5_FD5_Debug{1..3}
        CAN5_FD5_OTA1
        CAN5_GW5_CE100_0
    FUSION_CAN5_Rx: communication-direction=IN, communication-mode=CAN_Receive_All, i-signal-i-pdus=[CAN5_TBOX1, CAN5_TBOX2, CAN5_TBOX3]
    FUSION_CAN6_Tx: communication-direction=OUT, communication-mode=CAN_Transmit_All, i-signal-i-pdus=[CAN6_FD6_APS3, CAN6_FD6_BCM1, CAN6_FD6_VCU1, CAN6_FD6_VCU2, CAN6_FD6_VMC1, CAN6_GW6_CE100_0]
    FUSION_CAN6_Rx: communication-direction=IN, communication-mode=CAN_Receive_All, i-signal-i-pdus=[CAN6_FCM1, CAN6_FCM2, CAN6_FCM3, CAN6_FCM4, CAN6_SRR1]
    FUSION_CAN7_Tx: communication-direction=OUT, communication-mode=CAN_Transmit_All, i-signal-i-pdus=CAN7_GW7_C100_0
