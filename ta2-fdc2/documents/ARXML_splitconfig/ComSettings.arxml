[part 2 of 2: package /Com]
AUTOSAR XML (schema 4-0-3)
package /Com  (continued)
  module config Com: implementation-config-variant=VARIANT-POST-BUILD  (continued)
    ComConfig: ComConfigurationId=0  (continued)
      80 x ComSignalGroup, all with ComInvalidNotification=(unset), ComSignalGroupArrayAccess=0:
        GRCAN1_SG_AC_BTMS_C1000_0_404541651R: ComFirstTimeout=0.005, ComNotification=CAN1_SG_AC_BTMS_C1000_0_ComNotification, ComRxDataTimeoutAction=SUBSTITUTE, ComSignalGroupDirection=RECEIVE, ComTimeout=2.5, ComTimeoutNotification=CAN1_SG_AC_BTMS_C1000_0_ComTimeoutNotification, ComTransferProperty=PENDING, ComHandleId=0, ComSystemTemplateSignalGroupRef=CAN1_SG_AC_BTMS_C1000_0
          6 x ComGroupSignal, all with ComSignalEndianness=LITTLE_ENDIAN, ComSignalInitValue=0, ComSignalLength=(unset), ComTimeoutSubstitutionValue=0x0, ComTransferProperty=TRIGGERED_ON_CHANGE:
            CAN1_ACAmbTemp_404541651R: ComBitPosition=32, ComBitSize=16, ComSignalType=UINT16, ComHandleId=0, ComSystemTemplateSystemSignalRef=CAN1_ACAmbTemp
            CAN1_ACCabinTemp_404541651R: ComBitPosition=16, ComBitSize=16, ComSignalType=UINT16, ComHandleId=1, ComSystemTemplateSystemSignalRef=CAN1_ACCabinTemp
            CAN1_THCM_Reserve1_Sta_404541651R: ComBitPosition=0, ComBitSize=8, ComSignalType=UINT8, ComHandleId=2, ComSystemTemplateSystemSignalRef=CAN1_THCM_Reserve1_Sta
            CAN1_THCM_Reserve2_Sta_404541651R: ComBitPosition=8, ComBitSize=8, ComSignalType=UINT8, ComHandleId=3, ComSystemTemplateSystemSignalRef=CAN1_THCM_Reserve2_Sta
            CAN1_THCM_Reserve3_Sta_404541651R: ComBitPosition=48, ComBitSize=8, ComSignalType=UINT8, ComHandleId=4, ComSystemTemplateSystemSignalRef=CAN1_THCM_Reserve3_Sta
            CAN1_THCM_Reserve4_Sta_404541651R: ComBitPosition=56, ComBitSize=8, ComSignalType=UINT8, ComHandleId=5, ComSystemTemplateSystemSignalRef=CAN1_THCM_Reserve4_Sta
        GRCAN1_SG_AC_BTMS_C1000_1_404541907R: ComFirstTimeout=0.005, ComNotification=CAN1_SG_AC_BTMS_C1000_1_ComNotification, ComRxDataTimeoutAction=SUBSTITUTE, ComSignalGroupDirection=RECEIVE, ComTimeout=2.5, ComTimeoutNotification=CAN1_SG_AC_BTMS_C1000_1_ComTimeoutNotification, ComTransferProperty=PENDING, ComHandleId=1, ComSystemTemplateSignalGroupRef=CAN1_SG_AC_BTMS_C1000_1
          13 x ComGroupSignal, all with ComSignalEndianness=LITTLE_ENDIAN, ComSignalInitValue=0, ComSignalLength=(unset), ComSignalType=UINT8, ComTransferProperty=TRIGGERED_ON_CHANGE:
            CAN1_ACFanSpdSta_404541907R: ComBitPosition=50, ComBitSize=2, ComTimeoutSubstitutionValue=0x0, ComHandleId=6, ComSystemTemplateSystemSignalRef=CAN1_ACFanSpdSta
            CAN1_ACMODESta_404541907R: ComBitPosition=6, ComBitSize=2, ComTimeoutSubstitutionValue=0x0, ComHandleId=7, ComSystemTemplateSystemSignalRef=CAN1_ACMODESta
            CAN1_ACPwrSta_404541907R: ComBitPosition=54, ComBitSize=1, ComTimeoutSubstitutionValue=0x0, ComHandleId=8, ComSystemTemplateSystemSignalRef=CAN1_ACPwrSta
            CAN1_THCM_Outcycle_Sta_404541907R: ComBitPosition=14, ComBitSize=2, ComTimeoutSubstitutionValue=0x3, ComHandleId=9, ComSystemTemplateSystemSignalRef=CAN1_THCM_Outcycle_Sta
            CAN1_THCM_Reserve10_Sta_404541907R: ComBitPosition=16, ComBitSize=8, ComTimeoutSubstitutionValue=0x0, ComHandleId=10, ComSystemTemplateSystemSignalRef=CAN1_THCM_Reserve10_Sta
            CAN1_THCM_Reserve11_Sta_404541907R: ComBitPosition=48, ComBitSize=2, ComTimeoutSubstitutionValue=0x0, ComHandleId=11, ComSystemTemplateSystemSignalRef=CAN1_THCM_Reserve11_Sta
            CAN1_THCM_Reserve12_Sta_404541907R: ComBitPosition=52, ComBitSize=2, ComTimeoutSubstitutionValue=0x0, ComHandleId=12, ComSystemTemplateSystemSignalRef=CAN1_THCM_Reserve12_Sta
            CAN1_THCM_Reserve13_Sta_404541907R: ComBitPosition=55, ComBitSize=1, ComTimeoutSubstitutionValue=0x0, ComHandleId=13, ComSystemTemplateSystemSignalRef=CAN1_THCM_Reserve13_Sta
            CAN1_THCM_Reserve5_Sta_404541907R: ComBitPosition=0, ComBitSize=6, ComTimeoutSubstitutionValue=0x0, ComHandleId=14, ComSystemTemplateSystemSignalRef=CAN1_THCM_Reserve5_Sta
            CAN1_THCM_Reserve6_Sta_404541907R: ComBitPosition=56, ComBitSize=8, ComTimeoutSubstitutionValue=0x0, ComHandleId=15, ComSystemTemplateSystemSignalRef=CAN1_THCM_Reserve6_Sta
            CAN1_THCM_Reserve7_Sta_404541907R: ComBitPosition=40, ComBitSize=8, ComTimeoutSubstitutionValue=0x0, ComHandleId=16, ComSystemTemplateSystemSignalRef=CAN1_THCM_Reserve7_Sta
            CAN1_THCM_Reserve8_Sta_404541907R: ComBitPosition=32, ComBitSize=8, ComTimeoutSubstitutionValue=0x0, ComHandleId=17, ComSystemTemplateSystemSignalRef=CAN1_THCM_Reserve8_Sta
            CAN1_THCM_Reserve9_Sta_404541907R: ComBitPosition=24, ComBitSize=8, ComTimeoutSubstitutionValue=0x0, ComHandleId=18, ComSystemTemplateSystemSignalRef=CAN1_THCM_Reserve9_Sta
        GRCAN1_SG_AC_BTMS_C1000_2_419406361R: ComFirstTimeout=0.005, ComNotification=CAN1_SG_AC_BTMS_C1000_2_ComNotification, ComRxDataTimeoutAction=SUBSTITUTE, ComSignalGroupDirection=RECEIVE, ComTimeout=2.5, ComTimeoutNotification=CAN1_SG_AC_BTMS_C1000_2_ComTimeoutNotification, ComTransferProperty=PENDING, ComHandleId=2, ComSystemTemplateSignalGroupRef=CAN1_SG_AC_BTMS_C1000_2
          CAN1_THCM_Faultlv_Sta_419406361R (ComGroupSignal):
            ComBitPosition = 40
            ComBitSize = 2
            ComSignalEndianness = LITTLE_ENDIAN
            ComSignalInitValue = 0
            ComSignalLength = (unset)
            ComSignalType = UINT8
            ComTimeoutSubstitutionValue = 0x0
            ComTransferProperty = TRIGGERED_ON_CHANGE
            ComHandleId = 19
            ComSystemTemplateSystemSignalRef = CAN1_THCM_Faultlv_Sta
        GRCAN1_SG_AC_BTMS_C1000_4_419414330R: ComFirstTimeout=0.005, ComNotification=CAN1_SG_AC_BTMS_C1000_4_ComNotification, ComRxDataTimeoutAction=SUBSTITUTE, ComSignalGroupDirection=RECEIVE, ComTimeout=2.5, ComTimeoutNotification=CAN1_SG_AC_BTMS_C1000_4_ComTimeoutNotification, ComTransferProperty=PENDING, ComHandleId=3, ComSystemTemplateSignalGroupRef=CAN1_SG_AC_BTMS_C1000_4
          7 x ComGroupSignal, all with ComSignalEndianness=BIG_ENDIAN, ComSignalInitValue=0, ComSignalLength=(unset), ComTimeoutSubstitutionValue=0x0, ComTransferProperty=TRIGGERED_ON_CHANGE:
            CAN1_TM2BFaultCode_419414330R: ComBitPosition=61, ComBitSize=6, ComSignalType=UINT8, ComHandleId=20, ComSystemTemplateSystemSignalRef=CAN1_TM2BFaultCode
            CAN1_TM2BFaultLv_419414330R: ComBitPosition=63, ComBitSize=2, ComSignalType=UINT8, ComHandleId=21, ComSystemTemplateSystemSignalRef=CAN1_TM2BFaultLv
            CAN1_TM2BInletTemp_419414330R: ComBitPosition=23, ComBitSize=8, ComSignalType=UINT8, ComHandleId=22, ComSystemTemplateSystemSignalRef=CAN1_TM2BInletTemp
            CAN1_TM2BOutletTemp_419414330R: ComBitPosition=15, ComBitSize=8, ComSignalType=UINT8, ComHandleId=23, ComSystemTemplateSystemSignalRef=CAN1_TM2BOutletTemp
            CAN1_TM2BRQPower_419414330R: ComBitPosition=39, ComBitSize=16, ComSignalType=UINT16, ComHandleId=24, ComSystemTemplateSystemSignalRef=CAN1_TM2BRQPower
            CAN1_TM2BTMSHVRlySta_419414330R: ComBitPosition=3, ComBitSize=2, ComSignalType=UINT8, ComHandleId=25, ComSystemTemplateSystemSignalRef=CAN1_TM2BTMSHVRlySta
            CAN1_TM2BWorkStatus_419414330R: ComBitPosition=1, ComBitSize=2, ComSignalType=UINT8, ComHandleId=26, ComSystemTemplateSystemSignalRef=CAN1_TM2BWorkStatus
        GRCAN1_SG_AC_BTMS_C5000_0_404542163R: ComFirstTimeout=0.005, ComNotification=CAN1_SG_AC_BTMS_C5000_0_ComNotification, ComRxDataTimeoutAction=SUBSTITUTE, ComSignalGroupDirection=RECEIVE, ComTimeout=12.5, ComTimeoutNotification=CAN1_SG_AC_BTMS_C5000_0_ComTimeoutNotification, ComTransferProperty=PENDING, ComHandleId=4, ComSystemTemplateSignalGroupRef=CAN1_SG_AC_BTMS_C5000_0
          CAN1_ACTempSetSta_404542163R (ComGroupSignal):
            ComBitPosition = 24
            ComBitSize = 8
            ComSignalEndianness = LITTLE_ENDIAN
            ComSignalInitValue = 0
            ComSignalLength = (unset)
            ComSignalType = UINT8
            ComTimeoutSubstitutionValue = 0x0
            ComTransferProperty = TRIGGERED_ON_CHANGE
            ComHandleId = 27
            ComSystemTemplateSystemSignalRef = CAN1_ACTempSetSta
        GRCAN1_SG_ASC1_A_217995823R: ComFirstTimeout=0.005, ComNotification=CAN1_SG_ASC1_A_ComNotification, ComRxDataTimeoutAction=SUBSTITUTE, ComSignalGroupDirection=RECEIVE, ComTimeout=0.25, ComTimeoutNotification=CAN1_SG_ASC1_A_ComTimeoutNotification, ComTransferProperty=PENDING, ComHandleId=5, ComSystemTemplateSignalGroupRef=CAN1_SG_ASC1_A
          CAN1_ASC1KneelingInfo_217995823R (ComGroupSignal):
            ComBitPosition = 24
            ComBitSize = 4
            ComSignalEndianness = LITTLE_ENDIAN
            ComSignalInitValue = 0
            ComSignalLength = (unset)
            ComSignalType = UINT8
            ComTimeoutSubstitutionValue = 0x0
            ComTransferProperty = TRIGGERED_ON_CHANGE
            ComHandleId = 28
            ComSystemTemplateSystemSignalRef = CAN1_ASC1KneelingInfo
        GRCAN1_SG_EBC1_418382091R: ComFirstTimeout=0.005, ComNotification=CAN1_SG_EBC1_ComNotification, ComRxDataTimeoutAction=SUBSTITUTE, ComSignalGroupDirection=RECEIVE, ComTimeout=0.25, ComTimeoutNotification=CAN1_SG_EBC1_ComTimeoutNotification, ComTransferProperty=PENDING, ComHandleId=6, ComSystemTemplateSignalGroupRef=CAN1_SG_EBC1
          22 x ComGroupSignal, all with ComSignalEndianness=LITTLE_ENDIAN, ComSignalInitValue=0, ComSignalLength=(unset), ComSignalType=UINT8, ComTransferProperty=TRIGGERED_ON_CHANGE:
            CAN1_ABSFullyOper_418382091R: ComBitPosition=40, ComBitSize=2, ComTimeoutSubstitutionValue=0x3, ComHandleId=29, ComSystemTemplateSystemSignalRef=CAN1_ABSFullyOper
            CAN1_ABSOffroadSw_418382091R: ComBitPosition=16, ComBitSize=2, ComTimeoutSubstitutionValue=0x3, ComHandleId=30, ComSystemTemplateSystemSignalRef=CAN1_ABSOffroadSw
            CAN1_ASRBrakeCtrlAtc_418382091R: ComBitPosition=2, ComBitSize=2, ComTimeoutSubstitutionValue=0x3, ComHandleId=31, ComSystemTemplateSystemSignalRef=CAN1_ASRBrakeCtrlAtc
            CAN1_ASREngCtrlAtc_418382091R: ComBitPosition=0, ComBitSize=2, ComTimeoutSubstitutionValue=0x3, ComHandleId=32, ComSystemTemplateSystemSignalRef=CAN1_ASREngCtrlAtc
            CAN1_ASRHillHolderSw_418382091R: ComBitPosition=20, ComBitSize=2, ComTimeoutSubstitutionValue=0x3, ComHandleId=33, ComSystemTemplateSystemSignalRef=CAN1_ASRHillHolderSw
            CAN1_ASROffroadSw_418382091R: ComBitPosition=18, ComBitSize=2, ComTimeoutSubstitutionValue=0x3, ComHandleId=34, ComSystemTemplateSystemSignalRef=CAN1_ASROffroadSw
            CAN1_ATCASRInfoSig_418382091R: ComBitPosition=46, ComBitSize=2, ComTimeoutSubstitutionValue=0x3, ComHandleId=35, ComSystemTemplateSystemSignalRef=CAN1_ATCASRInfoSig
            CAN1_AcltrInterlockSw_418382091R: ComBitPosition=24, ComBitSize=2, ComTimeoutSubstitutionValue=0x3, ComHandleId=36, ComSystemTemplateSystemSignalRef=CAN1_AcltrInterlockSw
            CAN1_AntiLBrakABSAct_418382091R: ComBitPosition=4, ComBitSize=2, ComTimeoutSubstitutionValue=0x3, ComHandleId=37, ComSystemTemplateSystemSignalRef=CAN1_AntiLBrakABSAct
            CAN1_BrakePedalPos_418382091R: ComBitPosition=8, ComBitSize=8, ComTimeoutSubstitutionValue=0x0, ComHandleId=38, ComSystemTemplateSystemSignalRef=CAN1_BrakePedalPos
            CAN1_EBSAmWarnLampSta_418382091R: ComBitPosition=44, ComBitSize=2, ComTimeoutSubstitutionValue=0x0, ComHandleId=39, ComSystemTemplateSystemSignalRef=CAN1_EBSAmWarnLampSta
            CAN1_EBSBrakeSw_418382091R: ComBitPosition=6, ComBitSize=2, ComTimeoutSubstitutionValue=0x3, ComHandleId=40, ComSystemTemplateSystemSignalRef=CAN1_EBSBrakeSw
            CAN1_EBSRedWarnLampSta_418382091R: ComBitPosition=42, ComBitSize=2, ComTimeoutSubstitutionValue=0x0, ComHandleId=41, ComSystemTemplateSystemSignalRef=CAN1_EBSRedWarnLampSta
            CAN1_EngAuxShutdownSw_418382091R: ComBitPosition=28, ComBitSize=2, ComTimeoutSubstitutionValue=0x3, ComHandleId=42, ComSystemTemplateSystemSignalRef=CAN1_EngAuxShutdownSw
            CAN1_EngDerateSw_418382091R: ComBitPosition=26, ComBitSize=2, ComTimeoutSubstitutionValue=0x3, ComHandleId=43, ComSystemTemplateSystemSignalRef=CAN1_EngDerateSw
            CAN1_EngRetSel_418382091R: ComBitPosition=32, ComBitSize=8, ComTimeoutSubstitutionValue=0x0, ComHandleId=44, ComSystemTemplateSystemSignalRef=CAN1_EngRetSel
            CAN1_HaltBrakeSw_418382091R: ComBitPosition=58, ComBitSize=2, ComTimeoutSubstitutionValue=0x3, ComHandleId=45, ComSystemTemplateSystemSignalRef=CAN1_HaltBrakeSw
            CAN1_RmAccelEnSw_418382091R: ComBitPosition=30, ComBitSize=2, ComTimeoutSubstitutionValue=0x3, ComHandleId=46, ComSystemTemplateSystemSignalRef=CAN1_RmAccelEnSw
            CAN1_SACtrlBrakeCtrl_418382091R: ComBitPosition=48, ComBitSize=8, ComTimeoutSubstitutionValue=0x0, ComHandleId=47, ComSystemTemplateSystemSignalRef=CAN1_SACtrlBrakeCtrl
            CAN1_TractCtrlOvrSw_418382091R: ComBitPosition=22, ComBitSize=2, ComTimeoutSubstitutionValue=0x3, ComHandleId=48, ComSystemTemplateSystemSignalRef=CAN1_TractCtrlOvrSw
            CAN1_TrailerABSSta_418382091R: ComBitPosition=60, ComBitSize=2, ComTimeoutSubstitutionValue=0x3, ComHandleId=49, ComSystemTemplateSystemSignalRef=CAN1_TrailerABSSta
            CAN1_TrailerABSWarnSig_418382091R: ComBitPosition=62, ComBitSize=2, ComTimeoutSubstitutionValue=0x3, ComHandleId=50, ComSystemTemplateSystemSignalRef=CAN1_TrailerABSWarnSig
        GRCAN1_SG_EBC2_419348235R: ComFirstTimeout=0.005, ComNotification=CAN1_SG_EBC2_ComNotification, ComRxDataTimeoutAction=SUBSTITUTE, ComSignalGroupDirection=RECEIVE, ComTimeout=0.25, ComTimeoutNotification=CAN1_SG_EBC2_ComTimeoutNotification, ComTransferProperty=PENDING, ComHandleId=7, ComSystemTemplateSignalGroupRef=CAN1_SG_EBC2
          7 x ComGroupSignal, all with ComSignalEndianness=LITTLE_ENDIAN, ComSignalInitValue=0, ComSignalLength=(unset), ComTransferProperty=TRIGGERED_ON_CHANGE:
            CAN1_FASpeed_419348235R: ComBitPosition=0, ComBitSize=16, ComSignalType=UINT16, ComTimeoutSubstitutionValue=0xFB00, ComHandleId=51, ComSystemTemplateSystemSignalRef=CAN1_FASpeed
            CAN1_RelaSpdFALWheel_419348235R: ComBitPosition=16, ComBitSize=8, ComSignalType=UINT8, ComTimeoutSubstitutionValue=0x0, ComHandleId=52, ComSystemTemplateSystemSignalRef=CAN1_RelaSpdFALWheel
            CAN1_RelaSpdFARWheel_419348235R: ComBitPosition=24, ComBitSize=8, ComSignalType=UINT8, ComTimeoutSubstitutionValue=0x0, ComHandleId=53, ComSystemTemplateSystemSignalRef=CAN1_RelaSpdFARWheel
            CAN1_RelaSpdRA1LWheel_419348235R: ComBitPosition=32, ComBitSize=8, ComSignalType=UINT8, ComTimeoutSubstitutionValue=0x0, ComHandleId=54, ComSystemTemplateSystemSignalRef=CAN1_RelaSpdRA1LWheel
            CAN1_RelaSpdRA1RWheel_419348235R: ComBitPosition=40, ComBitSize=8, ComSignalType=UINT8, ComTimeoutSubstitutionValue=0x0, ComHandleId=55, ComSystemTemplateSystemSignalRef=CAN1_RelaSpdRA1RWheel
            CAN1_RelaSpdRA2LWheel_419348235R: ComBitPosition=48, ComBitSize=8, ComSignalType=UINT8, ComTimeoutSubstitutionValue=0x0, ComHandleId=56, ComSystemTemplateSystemSignalRef=CAN1_RelaSpdRA2LWheel
            CAN1_RelaSpdRA2RWheel_419348235R: ComBitPosition=56, ComBitSize=8, ComSignalType=UINT8, ComTimeoutSubstitutionValue=0x0, ComHandleId=57, ComSystemTemplateSystemSignalRef=CAN1_RelaSpdRA2RWheel
        GRCAN1_SG_EBC5_419283979R: ComFirstTimeout=0.005, ComNotification=CAN1_SG_EBC5_ComNotification, ComRxDataTimeoutAction=SUBSTITUTE, ComSignalGroupDirection=RECEIVE, ComTimeout=0.25, ComTimeoutNotification=CAN1_SG_EBC5_ComTimeoutNotification, ComTransferProperty=PENDING, ComHandleId=8, ComSystemTemplateSignalGroupRef=CAN1_SG_EBC5
          10 x ComGroupSignal, all with ComSignalEndianness=LITTLE_ENDIAN, ComSignalInitValue=0, ComSignalLength=(unset), ComSignalType=UINT8, ComTransferProperty=TRIGGERED_ON_CHANGE:
            CAN1_BrkTempeWarn_419283979R: ComBitPosition=0, ComBitSize=2, ComTimeoutSubstitutionValue=0x3, ComHandleId=58, ComSystemTemplateSystemSignalRef=CAN1_BrkTempeWarn
            CAN1_EmhBrkAct_419283979R: ComBitPosition=26, ComBitSize=2, ComTimeoutSubstitutionValue=0x3, ComHandleId=59, ComSystemTemplateSystemSignalRef=CAN1_EmhBrkAct
            CAN1_FndBrkUse_419283979R: ComBitPosition=8, ComBitSize=2, ComTimeoutSubstitutionValue=0x3, ComHandleId=60, ComSystemTemplateSystemSignalRef=CAN1_FndBrkUse
            CAN1_HaltBrkMode_419283979R: ComBitPosition=2, ComBitSize=3, ComTimeoutSubstitutionValue=0x7, ComHandleId=61, ComSystemTemplateSystemSignalRef=CAN1_HaltBrkMode
            CAN1_HillHolderMode_419283979R: ComBitPosition=5, ComBitSize=3, ComTimeoutSubstitutionValue=0x7, ComHandleId=62, ComSystemTemplateSystemSignalRef=CAN1_HillHolderMode
            CAN1_ParkBrkActuFAct_419283979R: ComBitPosition=24, ComBitSize=2, ComTimeoutSubstitutionValue=0x3, ComHandleId=63, ComSystemTemplateSystemSignalRef=CAN1_ParkBrkActuFAct
            CAN1_RailroadMode_419283979R: ComBitPosition=28, ComBitSize=2, ComTimeoutSubstitutionValue=0x3, ComHandleId=64, ComSystemTemplateSystemSignalRef=CAN1_RailroadMode
            CAN1_XBRAcltnLimit_419283979R: ComBitPosition=16, ComBitSize=8, ComTimeoutSubstitutionValue=0x0, ComHandleId=65, ComSystemTemplateSystemSignalRef=CAN1_XBRAcltnLimit
            CAN1_XBRActtrlMode_419283979R: ComBitPosition=12, ComBitSize=4, ComTimeoutSubstitutionValue=0xF, ComHandleId=66, ComSystemTemplateSystemSignalRef=CAN1_XBRActtrlMode
            CAN1_XBRSysSta_419283979R: ComBitPosition=10, ComBitSize=2, ComTimeoutSubstitutionValue=0x3, ComHandleId=67, ComSystemTemplateSystemSignalRef=CAN1_XBRSysSta
        GRCAN1_SG_ECAS_DM1_419351087R: ComFirstTimeout=0.005, ComNotification=CAN1_SG_ECAS_DM1_ComNotification, ComRxDataTimeoutAction=SUBSTITUTE, ComSignalGroupDirection=RECEIVE, ComTimeout=0.5, ComTimeoutNotification=CAN1_SG_ECAS_DM1_ComTimeoutNotification, ComTransferProperty=TRIGGERED_ON_CHANGE, ComHandleId=9, ComSystemTemplateSignalGroupRef=CAN1_SG_ECAS_DM1
          CAN1_ECASAWarmLampSta_419351087R (ComGroupSignal):
            ComBitPosition = 2
            ComBitSize = 2
            ComSignalEndianness = LITTLE_ENDIAN
            ComSignalInitValue = 0
            ComSignalLength = (unset)
            ComSignalType = UINT8
            ComTimeoutSubstitutionValue = 0x2
            ComTransferProperty = TRIGGERED_ON_CHANGE
            ComHandleId = 68
            ComSystemTemplateSystemSignalRef = CAN1_ECASAWarmLampSta
        GRCAN1_SG_EMC1_EM1_217050891R: ComFirstTimeout=0.005, ComNotification=CAN1_SG_EMC1_EM1_ComNotification, ComRxDataTimeoutAction=SUBSTITUTE, ComSignalGroupDirection=RECEIVE, ComTimeout=0.25, ComTimeoutNotification=CAN1_SG_EMC1_EM1_ComTimeoutNotification, ComTransferProperty=PENDING, ComHandleId=10, ComSystemTemplateSignalGroupRef=CAN1_SG_EMC1_EM1
          10 x ComGroupSignal, all with ComSignalEndianness=LITTLE_ENDIAN, ComSignalInitValue=0, ComSignalLength=(unset), ComSignalType=UINT8, ComTimeoutSubstitutionValue=0x0, ComTransferProperty=TRIGGERED_ON_CHANGE:
            CAN1_EM1CS_217050891R: ComBitPosition=60, ComBitSize=4, ComHandleId=69, ComSystemTemplateSystemSignalRef=CAN1_EM1CS
            CAN1_EM1Cnt_217050891R: ComBitPosition=56, ComBitSize=4, ComHandleId=70, ComSystemTemplateSystemSignalRef=CAN1_EM1Cnt
            CAN1_EM1OvrCtrlMBrk_217050891R: ComBitPosition=4, ComBitSize=2, ComHandleId=71, ComSystemTemplateSystemSignalRef=CAN1_EM1OvrCtrlMBrk
            CAN1_EM1OvrCtrlMDriv_217050891R: ComBitPosition=0, ComBitSize=2, ComHandleId=72, ComSystemTemplateSystemSignalRef=CAN1_EM1OvrCtrlMDriv
            CAN1_EM1OvrCtrlMPriBrk_217050891R: ComBitPosition=6, ComBitSize=2, ComHandleId=73, ComSystemTemplateSystemSignalRef=CAN1_EM1OvrCtrlMPriBrk
            CAN1_EM1OvrCtrlMPriDriv_217050891R: ComBitPosition=2, ComBitSize=2, ComHandleId=74, ComSystemTemplateSystemSignalRef=CAN1_EM1OvrCtrlMPriDriv
            CAN1_EM1ReqTorqHRlsBrk_217050891R: ComBitPosition=52, ComBitSize=4, ComHandleId=75, ComSystemTemplateSystemSignalRef=CAN1_EM1ReqTorqHRlsBrk
            CAN1_EM1ReqTorqHRlsDri_217050891R: ComBitPosition=48, ComBitSize=4, ComHandleId=76, ComSystemTemplateSystemSignalRef=CAN1_EM1ReqTorqHRlsDri
            CAN1_EM1ReqTorqLimBrk_217050891R: ComBitPosition=16, ComBitSize=8, ComHandleId=77, ComSystemTemplateSystemSignalRef=CAN1_EM1ReqTorqLimBrk
            CAN1_EM1ReqTorqLimDriv_217050891R: ComBitPosition=8, ComBitSize=8, ComHandleId=78, ComSystemTemplateSystemSignalRef=CAN1_EM1ReqTorqLimDriv
        GRCAN1_SG_HRW_150892043R: ComFirstTimeout=0.005, ComNotification=CAN1_SG_HRW_ComNotification, ComRxDataTimeoutAction=SUBSTITUTE, ComSignalGroupDirection=RECEIVE, ComTimeout=0.05, ComTimeoutNotification=CAN1_SG_HRW_ComTimeoutNotification, ComTransferProperty=PENDING, ComHandleId=11, ComSystemTemplateSignalGroupRef=CAN1_SG_HRW
          4 x ComGroupSignal, all with ComBitSize=16, ComSignalEndianness=LITTLE_ENDIAN, ComSignalInitValue=0, ComSignalLength=(unset), ComSignalType=UINT16, ComTimeoutSubstitutionValue=0xFB00, ComTransferProperty=TRIGGERED_ON_CHANGE:
            CAN1_WhlSpeed_FL_150892043R: ComBitPosition=0, ComHandleId=79, ComSystemTemplateSystemSignalRef=CAN1_WhlSpeed_FL
            CAN1_WhlSpeed_FR_150892043R: ComBitPosition=16, ComHandleId=80, ComSystemTemplateSystemSignalRef=CAN1_WhlSpeed_FR
            CAN1_WhlSpeed_RL_150892043R: ComBitPosition=32, ComHandleId=81, ComSystemTemplateSystemSignalRef=CAN1_WhlSpeed_RL
            CAN1_WhlSpeed_RR_150892043R: ComBitPosition=48, ComHandleId=82, ComSystemTemplateSystemSignalRef=CAN1_WhlSpeed_RR
        GRCAN1_SG_TC1_201392901R: ComFirstTimeout=0.005, ComNotification=CAN1_SG_TC1_ComNotification, ComRxDataTimeoutAction=SUBSTITUTE, ComSignalGroupDirection=RECEIVE, ComTimeout=0.125, ComTimeoutNotification=CAN1_SG_TC1_ComTimeoutNotification, ComTransferProperty=PENDING, ComHandleId=12, ComSystemTemplateSignalGroupRef=CAN1_SG_TC1
          5 x ComGroupSignal, all with ComSignalEndianness=LITTLE_ENDIAN, ComSignalInitValue=0, ComSignalLength=(unset), ComSignalType=UINT8, ComTimeoutSubstitutionValue=0x0, ComTransferProperty=TRIGGERED_ON_CHANGE:
            CAN1_DrivDirF_201392901R: ComBitPosition=42, ComBitSize=2, ComHandleId=83, ComSystemTemplateSystemSignalRef=CAN1_DrivDirF
            CAN1_DrivDirN_201392901R: ComBitPosition=40, ComBitSize=2, ComHandleId=84, ComSystemTemplateSystemSignalRef=CAN1_DrivDirN
            CAN1_DrivDirR_201392901R: ComBitPosition=44, ComBitSize=2, ComHandleId=85, ComSystemTemplateSystemSignalRef=CAN1_DrivDirR
            CAN1_LifeCnt_201392901R: ComBitPosition=46, ComBitSize=2, ComHandleId=86, ComSystemTemplateSystemSignalRef=CAN1_LifeCnt
            CAN1_TransReqGear_201392901R: ComBitPosition=16, ComBitSize=8, ComHandleId=87, ComSystemTemplateSystemSignalRef=CAN1_TransReqGear
        GRCAN1_SG_TPMS1_418517043R: ComFirstTimeout=0.005, ComNotification=CAN1_SG_TPMS1_ComNotification, ComRxDataTimeoutAction=SUBSTITUTE, ComSignalGroupDirection=RECEIVE, ComTimeout=2.5, ComTimeoutNotification=CAN1_SG_TPMS1_ComTimeoutNotification, ComTransferProperty=PENDING, ComHandleId=13, ComSystemTemplateSignalGroupRef=CAN1_SG_TPMS1
          25 x ComGroupSignal, all with ComSignalEndianness=LITTLE_ENDIAN, ComSignalInitValue=0, ComSignalLength=(unset), ComSignalType=UINT8, ComTransferProperty=TRIGGERED_ON_CHANGE:
            CAN1_LBIBatWarn_418517043R: ComBitPosition=29, ComBitSize=1, ComTimeoutSubstitutionValue=0x0, ComHandleId=88, ComSystemTemplateSystemSignalRef=CAN1_LBIBatWarn
            CAN1_LBIPressIndi_418517043R: ComBitPosition=10, ComBitSize=2, ComTimeoutSubstitutionValue=0x3, ComHandleId=89, ComSystemTemplateSystemSignalRef=CAN1_LBIPressIndi
            CAN1_LBISensorFail_418517043R: ComBitPosition=23, ComBitSize=1, ComTimeoutSubstitutionValue=0x0, ComHandleId=90, ComSystemTemplateSystemSignalRef=CAN1_LBISensorFail
            CAN1_LBIWheelTmpIndi_418517043R: ComBitPosition=17, ComBitSize=1, ComTimeoutSubstitutionValue=0x0, ComHandleId=91, ComSystemTemplateSystemSignalRef=CAN1_LBIWheelTmpIndi
            CAN1_LBOBatWarn_418517043R: ComBitPosition=27, ComBitSize=1, ComTimeoutSubstitutionValue=0x0, ComHandleId=92, ComSystemTemplateSystemSignalRef=CAN1_LBOBatWarn
            CAN1_LBOPressIndi_418517043R: ComBitPosition=6, ComBitSize=2, ComTimeoutSubstitutionValue=0x3, ComHandleId=93, ComSystemTemplateSystemSignalRef=CAN1_LBOPressIndi
            CAN1_LBOSensorFail_418517043R: ComBitPosition=21, ComBitSize=1, ComTimeoutSubstitutionValue=0x0, ComHandleId=94, ComSystemTemplateSystemSignalRef=CAN1_LBOSensorFail
            CAN1_LBOWheelTmpIndi_418517043R: ComBitPosition=15, ComBitSize=1, ComTimeoutSubstitutionValue=0x0, ComHandleId=95, ComSystemTemplateSystemSignalRef=CAN1_LBOWheelTmpIndi
            CAN1_LFBatWarn_418517043R: ComBitPosition=25, ComBitSize=1, ComTimeoutSubstitutionValue=0x0, ComHandleId=96, ComSystemTemplateSystemSignalRef=CAN1_LFBatWarn
            CAN1_LFPressIndi_418517043R: ComBitPosition=2, ComBitSize=2, ComTimeoutSubstitutionValue=0x3, ComHandleId=97, ComSystemTemplateSystemSignalRef=CAN1_LFPressIndi
            CAN1_LFSensorFail_418517043R: ComBitPosition=19, ComBitSize=1, ComTimeoutSubstitutionValue=0x0, ComHandleId=98, ComSystemTemplateSystemSignalRef=CAN1_LFSensorFail
            CAN1_LFWheelTmpIndi_418517043R: ComBitPosition=13, ComBitSize=1, ComTimeoutSubstitutionValue=0x0, ComHandleId=99, ComSystemTemplateSystemSignalRef=CAN1_LFWheelTmpIndi
            CAN1_RBIBatWarn_418517043R: ComBitPosition=28, ComBitSize=1, ComTimeoutSubstitutionValue=0x0, ComHandleId=100, ComSystemTemplateSystemSignalRef=CAN1_RBIBatWarn
            CAN1_RBIPressIndi_418517043R: ComBitPosition=8, ComBitSize=2, ComTimeoutSubstitutionValue=0x3, ComHandleId=101, ComSystemTemplateSystemSignalRef=CAN1_RBIPressIndi
            CAN1_RBISensorFail_418517043R: ComBitPosition=22, ComBitSize=1, ComTimeoutSubstitutionValue=0x0, ComHandleId=102, ComSystemTemplateSystemSignalRef=CAN1_RBISensorFail
            CAN1_RBIWheelTmpIndi_418517043R: ComBitPosition=16, ComBitSize=1, ComTimeoutSubstitutionValue=0x0, ComHandleId=103, ComSystemTemplateSystemSignalRef=CAN1_RBIWheelTmpIndi
            CAN1_RBOBatWarn_418517043R: ComBitPosition=26, ComBitSize=1, ComTimeoutSubstitutionValue=0x0, ComHandleId=104, ComSystemTemplateSystemSignalRef=CAN1_RBOBatWarn
            CAN1_RBOPressIndi_418517043R: ComBitPosition=4, ComBitSize=2, ComTimeoutSubstitutionValue=0x3, ComHandleId=105, ComSystemTemplateSystemSignalRef=CAN1_RBOPressIndi
            CAN1_RBOSensorFail_418517043R: ComBitPosition=20, ComBitSize=1, ComTimeoutSubstitutionValue=0x0, ComHandleId=106, ComSystemTemplateSystemSignalRef=CAN1_RBOSensorFail
            CAN1_RBOWheelTmpIndi_418517043R: ComBitPosition=14, ComBitSize=1, ComTimeoutSubstitutionValue=0x0, ComHandleId=107, ComSystemTemplateSystemSignalRef=CAN1_RBOWheelTmpIndi
            CAN1_RFBatWarn_418517043R: ComBitPosition=24, ComBitSize=1, ComTimeoutSubstitutionValue=0x0, ComHandleId=108, ComSystemTemplateSystemSignalRef=CAN1_RFBatWarn
            CAN1_RFPressIndi_418517043R: ComBitPosition=0, ComBitSize=2, ComTimeoutSubstitutionValue=0x3, ComHandleId=109, ComSystemTemplateSystemSignalRef=CAN1_RFPressIndi
            CAN1_RFSensorFail_418517043R: ComBitPosition=18, ComBitSize=1, ComTimeoutSubstitutionValue=0x0, ComHandleId=110, ComSystemTemplateSystemSignalRef=CAN1_RFSensorFail
            CAN1_RFWheelTmpIndi_418517043R: ComBitPosition=12, ComBitSize=1, ComTimeoutSubstitutionValue=0x0, ComHandleId=111, ComSystemTemplateSystemSignalRef=CAN1_RFWheelTmpIndi
            CAN1_TPMSWarnIndi_418517043R: ComBitPosition=31, ComBitSize=2, ComTimeoutSubstitutionValue=0x3, ComHandleId=112, ComSystemTemplateSystemSignalRef=CAN1_TPMSWarnIndi
        GRCAN1_SG_TPMS2_418517299R: ComFirstTimeout=0.005, ComNotification=CAN1_SG_TPMS2_ComNotification, ComRxDataTimeoutAction=SUBSTITUTE, ComSignalGroupDirection=RECEIVE, ComTimeout=2.5, ComTimeoutNotification=CAN1_SG_TPMS2_ComTimeoutNotification, ComTransferProperty=PENDING, ComHandleId=14, ComSystemTemplateSignalGroupRef=CAN1_SG_TPMS2
          6 x ComGroupSignal, all with ComBitSize=8, ComSignalEndianness=LITTLE_ENDIAN, ComSignalInitValue=0, ComSignalLength=(unset), ComSignalType=UINT8, ComTimeoutSubstitutionValue=0xFF, ComTransferProperty=TRIGGERED_ON_CHANGE:
            CAN1_LBIWheelPress_418517299R: ComBitPosition=47, ComHandleId=113, ComSystemTemplateSystemSignalRef=CAN1_LBIWheelPress
            CAN1_LBOWheelPress_418517299R: ComBitPosition=38, ComHandleId=114, ComSystemTemplateSystemSignalRef=CAN1_LBOWheelPress
            CAN1_LFWheelPress_418517299R: ComBitPosition=11, ComHandleId=115, ComSystemTemplateSystemSignalRef=CAN1_LFWheelPress
            CAN1_RBIWheelPress_418517299R: ComBitPosition=29, ComHandleId=116, ComSystemTemplateSystemSignalRef=CAN1_RBIWheelPress
            CAN1_RBOWheelPress_418517299R: ComBitPosition=20, ComHandleId=117, ComSystemTemplateSystemSignalRef=CAN1_RBOWheelPress
            CAN1_RFWheelPress_418517299R: ComBitPosition=2, ComHandleId=118, ComSystemTemplateSystemSignalRef=CAN1_RFWheelPress
        GRCAN1_SG_TPMS3_418517555R: ComFirstTimeout=0.005, ComNotification=CAN1_SG_TPMS3_ComNotification, ComRxDataTimeoutAction=SUBSTITUTE, ComSignalGroupDirection=RECEIVE, ComTimeout=2.5, ComTimeoutNotification=CAN1_SG_TPMS3_ComTimeoutNotification, ComTransferProperty=PENDING, ComHandleId=15, ComSystemTemplateSignalGroupRef=CAN1_SG_TPMS3
          6 x ComGroupSignal, all with ComBitSize=8, ComSignalEndianness=LITTLE_ENDIAN, ComSignalInitValue=0, ComSignalLength=(unset), ComSignalType=UINT8, ComTimeoutSubstitutionValue=0x0, ComTransferProperty=TRIGGERED_ON_CHANGE:
            CAN1_LBIWheelTemp_418517555R: ComBitPosition=40, ComHandleId=119, ComSystemTemplateSystemSignalRef=CAN1_LBIWheelTemp
            CAN1_LBOWheelTemp_418517555R: ComBitPosition=24, ComHandleId=120, ComSystemTemplateSystemSignalRef=CAN1_LBOWheelTemp
            CAN1_LFWheelTemp_418517555R: ComBitPosition=8, ComHandleId=121, ComSystemTemplateSystemSignalRef=CAN1_LFWheelTemp
            CAN1_RBIWheelTemp_418517555R: ComBitPosition=32, ComHandleId=122, ComSystemTemplateSystemSignalRef=CAN1_RBIWheelTemp
            CAN1_RBOWheelTemp_418517555R: ComBitPosition=16, ComHandleId=123, ComSystemTemplateSystemSignalRef=CAN1_RBOWheelTemp
            CAN1_RFWheelTemp_418517555R: ComBitPosition=0, ComHandleId=124, ComSystemTemplateSystemSignalRef=CAN1_RFWheelTemp
        GRCAN1_SG_VDC1_419319563R: ComFirstTimeout=0.005, ComNotification=CAN1_SG_VDC1_ComNotification, ComRxDataTimeoutAction=SUBSTITUTE, ComSignalGroupDirection=RECEIVE, ComTimeout=0.25, ComTimeoutNotification=CAN1_SG_VDC1_ComTimeoutNotification, ComTransferProperty=PENDING, ComHandleId=16, ComSystemTemplateSignalGroupRef=CAN1_SG_VDC1
          CAN1_VDCBrakeLightReq_419319563R (ComGroupSignal):
            ComBitPosition = 4
            ComBitSize = 2
            ComSignalEndianness = LITTLE_ENDIAN
            ComSignalInitValue = 0
            ComSignalLength = (unset)
            ComSignalType = UINT8
            ComTimeoutSubstitutionValue = 0x0
            ComTransferProperty = TRIGGERED_ON_CHANGE
            ComHandleId = 125
            ComSystemTemplateSystemSignalRef = CAN1_VDCBrakeLightReq
        GRCAN2_SG_IVI_C100_0_419140446R: ComFirstTimeout=0.005, ComNotification=CAN2_SG_IVI_C100_0_ComNotification, ComRxDataTimeoutAction=SUBSTITUTE, ComSignalGroupDirection=RECEIVE, ComTimeout=0.25, ComTimeoutNotification=CAN2_SG_IVI_C100_0_ComTimeoutNotification, ComTransferProperty=PENDING, ComHandleId=17, ComSystemTemplateSignalGroupRef=CAN2_SG_IVI_C100_0
          10 x ComGroupSignal, all with ComSignalInitValue=0, ComSignalLength=(unset), ComSignalType=UINT8, ComTimeoutSubstitutionValue=0x0, ComTransferProperty=TRIGGERED_ON_CHANGE:
            CAN2_IVI_ACCoolTempSetdownReq_Cmd_419140446R: ComBitPosition=7, ComBitSize=8, ComSignalEndianness=BIG_ENDIAN, ComHandleId=126, ComSystemTemplateSystemSignalRef=CAN2_IVI_ACCoolTempSetdownReq_Cmd
            CAN2_IVI_ACCoolTempSetupReq_Cmd_419140446R: ComBitPosition=48, ComBitSize=8, ComSignalEndianness=LITTLE_ENDIAN, ComHandleId=127, ComSystemTemplateSystemSignalRef=CAN2_IVI_ACCoolTempSetupReq_Cmd
            CAN2_IVI_ACFanSpdReq_Cmd_419140446R: ComBitPosition=18, ComBitSize=2, ComSignalEndianness=LITTLE_ENDIAN, ComHandleId=128, ComSystemTemplateSystemSignalRef=CAN2_IVI_ACFanSpdReq_Cmd
            CAN2_IVI_ACHeatTempSetDownReq_Cmd_419140446R: ComBitPosition=32, ComBitSize=8, ComSignalEndianness=LITTLE_ENDIAN, ComHandleId=129, ComSystemTemplateSystemSignalRef=CAN2_IVI_ACHeatTempSetDownReq_Cmd
            CAN2_IVI_ACHeatTempSetUPReq_Cmd_419140446R: ComBitPosition=40, ComBitSize=8, ComSignalEndianness=LITTLE_ENDIAN, ComHandleId=130, ComSystemTemplateSystemSignalRef=CAN2_IVI_ACHeatTempSetUPReq_Cmd
            CAN2_IVI_ACMODEReq_Cmd_419140446R: ComBitPosition=16, ComBitSize=2, ComSignalEndianness=LITTLE_ENDIAN, ComHandleId=131, ComSystemTemplateSystemSignalRef=CAN2_IVI_ACMODEReq_Cmd
            CAN2_IVI_ACOutCycleReq_Cmd_419140446R: ComBitPosition=58, ComBitSize=2, ComSignalEndianness=LITTLE_ENDIAN, ComHandleId=132, ComSystemTemplateSystemSignalRef=CAN2_IVI_ACOutCycleReq_Cmd
            CAN2_IVI_ACPwrReq_Cmd_419140446R: ComBitPosition=22, ComBitSize=1, ComSignalEndianness=LITTLE_ENDIAN, ComHandleId=133, ComSystemTemplateSystemSignalRef=CAN2_IVI_ACPwrReq_Cmd
            CAN2_IVI_ACRemoteReq_Cmd_419140446R: ComBitPosition=56, ComBitSize=2, ComSignalEndianness=LITTLE_ENDIAN, ComHandleId=134, ComSystemTemplateSystemSignalRef=CAN2_IVI_ACRemoteReq_Cmd
            CAN2_IVI_ACTempSet_Cmd_419140446R: ComBitPosition=24, ComBitSize=8, ComSignalEndianness=LITTLE_ENDIAN, ComHandleId=135, ComSystemTemplateSystemSignalRef=CAN2_IVI_ACTempSet_Cmd
        GRCAN3_SG_B2TM_Info_419382772R: ComFirstTimeout=0.005, ComNotification=CAN3_SG_B2TM_Info_ComNotification, ComRxDataTimeoutAction=SUBSTITUTE, ComSignalGroupDirection=RECEIVE, ComTimeout=2.5, ComTimeoutNotification=CAN3_SG_B2TM_Info_ComTimeoutNotification, ComTransferProperty=PENDING, ComHandleId=18, ComSystemTemplateSignalGroupRef=CAN3_SG_B2TM_Info
          8 x ComGroupSignal, all with ComSignalEndianness=BIG_ENDIAN, ComSignalInitValue=0, ComSignalLength=(unset), ComTransferProperty=TRIGGERED_ON_CHANGE:
            CAN3_B2TChgSta_419382772R: ComBitPosition=5, ComBitSize=2, ComSignalType=UINT8, ComTimeoutSubstitutionValue=0x2, ComHandleId=136, ComSystemTemplateSystemSignalRef=CAN3_B2TChgSta
            CAN3_B2THVCmd_419382772R: ComBitPosition=3, ComBitSize=2, ComSignalType=UINT8, ComTimeoutSubstitutionValue=0x2, ComHandleId=137, ComSystemTemplateSystemSignalRef=CAN3_B2THVCmd
            CAN3_B2THVRlySta_419382772R: ComBitPosition=7, ComBitSize=2, ComSignalType=UINT8, ComTimeoutSubstitutionValue=0x2, ComHandleId=138, ComSystemTemplateSystemSignalRef=CAN3_B2THVRlySta
            CAN3_B2TMCRC_419382772R: ComBitPosition=63, ComBitSize=8, ComSignalType=UINT8, ComTimeoutSubstitutionValue=0x0, ComHandleId=139, ComSystemTemplateSystemSignalRef=CAN3_B2TMCRC
            CAN3_B2TMLifeSig_419382772R: ComBitPosition=55, ComBitSize=8, ComSignalType=UINT8, ComTimeoutSubstitutionValue=0x0, ComHandleId=140, ComSystemTemplateSystemSignalRef=CAN3_B2TMLifeSig
            CAN3_B2TPackVol_419382772R: ComBitPosition=15, ComBitSize=16, ComSignalType=UINT16, ComTimeoutSubstitutionValue=0x0, ComHandleId=141, ComSystemTemplateSystemSignalRef=CAN3_B2TPackVol
            CAN3_B2TSetModeA_419382772R: ComBitPosition=1, ComBitSize=2, ComSignalType=UINT8, ComTimeoutSubstitutionValue=0x0, ComHandleId=142, ComSystemTemplateSystemSignalRef=CAN3_B2TSetModeA
            CAN3_B2TSetTemp_419382772R: ComBitPosition=39, ComBitSize=8, ComSignalType=UINT8, ComTimeoutSubstitutionValue=0x0, ComHandleId=143, ComSystemTemplateSystemSignalRef=CAN3_B2TSetTemp
        GRCAN3_SG_B2V_BattInfo1_417525747R: ComFirstTimeout=0.005, ComNotification=CAN3_SG_B2V_BattInfo1_ComNotification, ComRxDataTimeoutAction=SUBSTITUTE, ComSignalGroupDirection=RECEIVE, ComTimeout=2.5, ComTimeoutNotification=CAN3_SG_B2V_BattInfo1_ComTimeoutNotification, ComTransferProperty=PENDING, ComHandleId=19, ComSystemTemplateSignalGroupRef=CAN3_SG_B2V_BattInfo1
          4 x ComGroupSignal, all with ComSignalEndianness=LITTLE_ENDIAN, ComSignalInitValue=0, ComSignalLength=(unset), ComTimeoutSubstitutionValue=0x0, ComTransferProperty=TRIGGERED_ON_CHANGE:
            CAN3_B2VBI1BattType_417525747R: ComBitPosition=48, ComBitSize=4, ComSignalType=UINT8, ComHandleId=144, ComSystemTemplateSystemSignalRef=CAN3_B2VBI1BattType
            CAN3_B2VBI1RateCap_417525747R: ComBitPosition=0, ComBitSize=16, ComSignalType=UINT16, ComHandleId=145, ComSystemTemplateSystemSignalRef=CAN3_B2VBI1RateCap
            CAN3_B2VBI1RateHVolt_417525747R: ComBitPosition=16, ComBitSize=16, ComSignalType=UINT16, ComHandleId=146, ComSystemTemplateSystemSignalRef=CAN3_B2VBI1RateHVolt
            CAN3_B2VBI1RatePower_417525747R: ComBitPosition=32, ComBitSize=16, ComSignalType=UINT16, ComHandleId=147, ComSystemTemplateSystemSignalRef=CAN3_B2VBI1RatePower
        GRCAN3_SG_B2V_CurrentLimit_415559667R: ComFirstTimeout=0.005, ComNotification=CAN3_SG_B2V_CurrentLimit_ComNotification, ComRxDataTimeoutAction=SUBSTITUTE, ComSignalGroupDirection=RECEIVE, ComTimeout=0.5, ComTimeoutNotification=CAN3_SG_B2V_CurrentLimit_ComTimeoutNotification, ComTransferProperty=PENDING, ComHandleId=20, ComSystemTemplateSignalGroupRef=CAN3_SG_B2V_CurrentLimit
          CAN3_B2VAPlsDischgCurr_415559667R (ComGroupSignal):
            ComBitPosition = 0
            ComBitSize = 16
            ComSignalEndianness = LITTLE_ENDIAN
            ComSignalInitValue = 0
            ComSignalLength = (unset)
            ComSignalType = UINT16
            ComTimeoutSubstitutionValue = 0x0
            ComTransferProperty = TRIGGERED_ON_CHANGE
            ComHandleId = 148
            ComSystemTemplateSystemSignalRef = CAN3_B2VAPlsDischgCurr
          CAN3_B2VAvaPlsChgCurr_415559667R (ComGroupSignal):
            ComBitPosition = 16
            ComBitSize = 16
            ComSignalEndianness = LITTLE_ENDIAN
            ComSignalInitValue = 0
            ComSignalLength = (unset)
            ComSignalType = UINT16
            ComTimeoutSubstitutionValue = 0x0
            ComTransferProperty = TRIGGERED_ON_CHANGE
            ComHandleId = 149
            ComSystemTemplateSystemSignalRef = CAN3_B2VAvaPlsChgCurr
        GRCAN3_SG_B2V_Fult1_32960_411168755R: ComFirstTimeout=0.005, ComNotification=CAN3_SG_B2V_Fult1_32960_ComNotification, ComRxDataTimeoutAction=SUBSTITUTE, ComSignalGroupDirection=RECEIVE, ComTimeout=1.25, ComTimeoutNotification=CAN3_SG_B2V_Fult1_32960_ComTimeoutNotification, ComTransferProperty=PENDING, ComHandleId=21, ComSystemTemplateSignalGroupRef=CAN3_SG_B2V_Fult1_32960
          CAN3_B2VHVILFault_411168755R (ComGroupSignal):
            ComBitPosition = 26
            ComBitSize = 1
            ComSignalEndianness = LITTLE_ENDIAN
            ComSignalInitValue = 0
            ComSignalLength = (unset)
            ComSignalType = UINT8
            ComTimeoutSubstitutionValue = 0x0
            ComTransferProperty = TRIGGERED_ON_CHANGE
            ComHandleId = 150
            ComSystemTemplateSystemSignalRef = CAN3_B2VHVILFault
        GRCAN3_SG_B2V_ST1_411299827R: ComFirstTimeout=0.005, ComNotification=CAN3_SG_B2V_ST1_ComNotification, ComRxDataTimeoutAction=SUBSTITUTE, ComSignalGroupDirection=RECEIVE, ComTimeout=0.25, ComTimeoutNotification=CAN3_SG_B2V_ST1_ComTimeoutNotification, ComTransferProperty=PENDING, ComHandleId=22, ComSystemTemplateSignalGroupRef=CAN3_SG_B2V_ST1
          26 x ComGroupSignal, all with ComSignalEndianness=LITTLE_ENDIAN, ComSignalInitValue=0, ComSignalLength=(unset), ComTransferProperty=TRIGGERED_ON_CHANGE:
            CAN3_B2VACChgConnSta_411299827R: ComBitPosition=38, ComBitSize=1, ComSignalType=UINT8, ComTimeoutSubstitutionValue=0x0, ComHandleId=151, ComSystemTemplateSystemSignalRef=CAN3_B2VACChgConnSta
            CAN3_B2VACChgNegRlySta_411299827R: ComBitPosition=24, ComBitSize=2, ComSignalType=UINT8, ComTimeoutSubstitutionValue=0x3, ComHandleId=152, ComSystemTemplateSystemSignalRef=CAN3_B2VACChgNegRlySta
            CAN3_B2VACChgPosRlySta_411299827R: ComBitPosition=22, ComBitSize=2, ComSignalType=UINT8, ComTimeoutSubstitutionValue=0x3, ComHandleId=153, ComSystemTemplateSystemSignalRef=CAN3_B2VACChgPosRlySta
            CAN3_B2VAux1RlySta_411299827R: ComBitPosition=26, ComBitSize=2, ComSignalType=UINT8, ComTimeoutSubstitutionValue=0x3, ComHandleId=154, ComSystemTemplateSystemSignalRef=CAN3_B2VAux1RlySta
            CAN3_B2VAux2RlySta_411299827R: ComBitPosition=28, ComBitSize=2, ComSignalType=UINT8, ComTimeoutSubstitutionValue=0x3, ComHandleId=155, ComSystemTemplateSystemSignalRef=CAN3_B2VAux2RlySta
            CAN3_B2VAux3RlySta_411299827R: ComBitPosition=30, ComBitSize=2, ComSignalType=UINT8, ComTimeoutSubstitutionValue=0x3, ComHandleId=156, ComSystemTemplateSystemSignalRef=CAN3_B2VAux3RlySta
            CAN3_B2VBMUBalSta_411299827R: ComBitPosition=34, ComBitSize=1, ComSignalType=UINT8, ComTimeoutSubstitutionValue=0x0, ComHandleId=157, ComSystemTemplateSystemSignalRef=CAN3_B2VBMUBalSta
            CAN3_B2VBMUHVSta_411299827R: ComBitPosition=32, ComBitSize=2, ComSignalType=UINT8, ComTimeoutSubstitutionValue=0x0, ComHandleId=158, ComSystemTemplateSystemSignalRef=CAN3_B2VBMUHVSta
            CAN3_B2VChgMode_411299827R: ComBitPosition=39, ComBitSize=2, ComSignalType=UINT8, ComTimeoutSubstitutionValue=0x0, ComHandleId=159, ComSystemTemplateSystemSignalRef=CAN3_B2VChgMode
            CAN3_B2VChgSta_411299827R: ComBitPosition=41, ComBitSize=2, ComSignalType=UINT8, ComTimeoutSubstitutionValue=0x0, ComHandleId=160, ComSystemTemplateSystemSignalRef=CAN3_B2VChgSta
            CAN3_B2VCoolingSta_411299827R: ComBitPosition=44, ComBitSize=2, ComSignalType=UINT8, ComTimeoutSubstitutionValue=0x0, ComHandleId=161, ComSystemTemplateSystemSignalRef=CAN3_B2VCoolingSta
            CAN3_B2VDCChgConnSta_411299827R: ComBitPosition=35, ComBitSize=2, ComSignalType=UINT8, ComTimeoutSubstitutionValue=0x3, ComHandleId=162, ComSystemTemplateSystemSignalRef=CAN3_B2VDCChgConnSta
            CAN3_B2VDCChgN1RlySta_411299827R: ComBitPosition=8, ComBitSize=2, ComSignalType=UINT8, ComTimeoutSubstitutionValue=0x3, ComHandleId=163, ComSystemTemplateSystemSignalRef=CAN3_B2VDCChgN1RlySta
            CAN3_B2VDCChgN2RlySta_411299827R: ComBitPosition=12, ComBitSize=2, ComSignalType=UINT8, ComTimeoutSubstitutionValue=0x3, ComHandleId=164, ComSystemTemplateSystemSignalRef=CAN3_B2VDCChgN2RlySta
            CAN3_B2VDCChgP1RlySta_411299827R: ComBitPosition=6, ComBitSize=2, ComSignalType=UINT8, ComTimeoutSubstitutionValue=0x3, ComHandleId=165, ComSystemTemplateSystemSignalRef=CAN3_B2VDCChgP1RlySta
            CAN3_B2VDCChgP2RlySta_411299827R: ComBitPosition=10, ComBitSize=2, ComSignalType=UINT8, ComTimeoutSubstitutionValue=0x3, ComHandleId=166, ComSystemTemplateSystemSignalRef=CAN3_B2VDCChgP2RlySta
            CAN3_B2VHeatNegRelaySta_411299827R: ComBitPosition=16, ComBitSize=2, ComSignalType=UINT8, ComTimeoutSubstitutionValue=0x3, ComHandleId=167, ComSystemTemplateSystemSignalRef=CAN3_B2VHeatNegRelaySta
            CAN3_B2VHeatPosRlySta_411299827R: ComBitPosition=14, ComBitSize=2, ComSignalType=UINT8, ComTimeoutSubstitutionValue=0x3, ComHandleId=168, ComSystemTemplateSystemSignalRef=CAN3_B2VHeatPosRlySta
            CAN3_B2VHeatingSta_411299827R: ComBitPosition=43, ComBitSize=1, ComSignalType=UINT8, ComTimeoutSubstitutionValue=0x0, ComHandleId=169, ComSystemTemplateSystemSignalRef=CAN3_B2VHeatingSta
            CAN3_B2VMainNegRlySta_411299827R: ComBitPosition=2, ComBitSize=2, ComSignalType=UINT8, ComTimeoutSubstitutionValue=0x3, ComHandleId=170, ComSystemTemplateSystemSignalRef=CAN3_B2VMainNegRlySta
            CAN3_B2VMainPosRlySta_411299827R: ComBitPosition=0, ComBitSize=2, ComSignalType=UINT8, ComTimeoutSubstitutionValue=0x3, ComHandleId=171, ComSystemTemplateSystemSignalRef=CAN3_B2VMainPosRlySta
            CAN3_B2VPChgPosRlySta_411299827R: ComBitPosition=18, ComBitSize=2, ComSignalType=UINT8, ComTimeoutSubstitutionValue=0x3, ComHandleId=172, ComSystemTemplateSystemSignalRef=CAN3_B2VPChgPosRlySta
            CAN3_B2VPChrgConnSta_411299827R: ComBitPosition=37, ComBitSize=1, ComSignalType=UINT8, ComTimeoutSubstitutionValue=0x0, ComHandleId=173, ComSystemTemplateSystemSignalRef=CAN3_B2VPChrgConnSta
            CAN3_B2VPChrgNegRlySta_411299827R: ComBitPosition=20, ComBitSize=2, ComSignalType=UINT8, ComTimeoutSubstitutionValue=0x3, ComHandleId=174, ComSystemTemplateSystemSignalRef=CAN3_B2VPChrgNegRlySta
            CAN3_B2VPrechgRelaySta_411299827R: ComBitPosition=4, ComBitSize=2, ComSignalType=UINT8, ComTimeoutSubstitutionValue=0x3, ComHandleId=175, ComSystemTemplateSystemSignalRef=CAN3_B2VPrechgRelaySta
            CAN3_B2VST1RChrgCy_411299827R: ComBitPosition=46, ComBitSize=18, ComSignalType=UINT32, ComTimeoutSubstitutionValue=0x0, ComHandleId=176, ComSystemTemplateSystemSignalRef=CAN3_B2VST1RChrgCy
        GRCAN3_SG_B2V_ST2_411365363R: ComFirstTimeout=0.005, ComNotification=CAN3_SG_B2V_ST2_ComNotification, ComRxDataTimeoutAction=SUBSTITUTE, ComSignalGroupDirection=RECEIVE, ComTimeout=0.5, ComTimeoutNotification=CAN3_SG_B2V_ST2_ComTimeoutNotification, ComTransferProperty=PENDING, ComHandleId=23, ComSystemTemplateSignalGroupRef=CAN3_SG_B2V_ST2
          8 x ComGroupSignal, all with ComSignalEndianness=LITTLE_ENDIAN, ComSignalInitValue=0, ComSignalLength=(unset), ComTransferProperty=TRIGGERED_ON_CHANGE:
            CAN3_B2VFaultCode_411365363R: ComBitPosition=48, ComBitSize=8, ComSignalType=UINT8, ComTimeoutSubstitutionValue=0x0, ComHandleId=177, ComSystemTemplateSystemSignalRef=CAN3_B2VFaultCode
            CAN3_B2VFaultLv_411365363R: ComBitPosition=56, ComBitSize=2, ComSignalType=UINT8, ComTimeoutSubstitutionValue=0x0, ComHandleId=178, ComSystemTemplateSystemSignalRef=CAN3_B2VFaultLv
            CAN3_B2VPackCurr_411365363R: ComBitPosition=16, ComBitSize=16, ComSignalType=UINT16, ComTimeoutSubstitutionValue=0x0, ComHandleId=179, ComSystemTemplateSystemSignalRef=CAN3_B2VPackCurr
            CAN3_B2VPackInsideVol_411365363R: ComBitPosition=32, ComBitSize=16, ComSignalType=UINT16, ComTimeoutSubstitutionValue=0x0, ComHandleId=180, ComSystemTemplateSystemSignalRef=CAN3_B2VPackInsideVol
            CAN3_B2VRqHVPwrOff_411365363R: ComBitPosition=58, ComBitSize=2, ComSignalType=UINT8, ComTimeoutSubstitutionValue=0x3, ComHandleId=181, ComSystemTemplateSystemSignalRef=CAN3_B2VRqHVPwrOff
            CAN3_B2VSOC_411365363R: ComBitPosition=0, ComBitSize=8, ComSignalType=UINT8, ComTimeoutSubstitutionValue=0x0, ComHandleId=182, ComSystemTemplateSystemSignalRef=CAN3_B2VSOC
            CAN3_B2VSOH_411365363R: ComBitPosition=8, ComBitSize=8, ComSignalType=UINT8, ComTimeoutSubstitutionValue=0x0, ComHandleId=183, ComSystemTemplateSystemSignalRef=CAN3_B2VSOH
            CAN3_B2VST2LifeSig_411365363R: ComBitPosition=60, ComBitSize=4, ComSignalType=UINT8, ComTimeoutSubstitutionValue=0x0, ComHandleId=184, ComSystemTemplateSystemSignalRef=CAN3_B2VST2LifeSig
        GRCAN3_SG_B2V_ST4_411496435R: ComFirstTimeout=0.005, ComNotification=CAN3_SG_B2V_ST4_ComNotification, ComRxDataTimeoutAction=SUBSTITUTE, ComSignalGroupDirection=RECEIVE, ComTimeout=1.25, ComTimeoutNotification=CAN3_SG_B2V_ST4_ComTimeoutNotification, ComTransferProperty=PENDING, ComHandleId=24, ComSystemTemplateSignalGroupRef=CAN3_SG_B2V_ST4
          7 x ComGroupSignal, all with ComBitSize=8, ComSignalEndianness=LITTLE_ENDIAN, ComSignalInitValue=0, ComSignalLength=(unset), ComSignalType=UINT8, ComTransferProperty=TRIGGERED_ON_CHANGE:
            CAN3_B2VCellAvgTemp_411496435R: ComBitPosition=16, ComTimeoutSubstitutionValue=0x0, ComHandleId=185, ComSystemTemplateSystemSignalRef=CAN3_B2VCellAvgTemp
            CAN3_B2VMaxTempCSCSN_411496435R: ComBitPosition=24, ComTimeoutSubstitutionValue=0xFF, ComHandleId=186, ComSystemTemplateSystemSignalRef=CAN3_B2VMaxTempCSCSN
            CAN3_B2VMaxTempPos_411496435R: ComBitPosition=32, ComTimeoutSubstitutionValue=0x0, ComHandleId=187, ComSystemTemplateSystemSignalRef=CAN3_B2VMaxTempPos
            CAN3_B2VMinTempCSCSN_411496435R: ComBitPosition=40, ComTimeoutSubstitutionValue=0xFF, ComHandleId=188, ComSystemTemplateSystemSignalRef=CAN3_B2VMinTempCSCSN
            CAN3_B2VMinTempPos_411496435R: ComBitPosition=48, ComTimeoutSubstitutionValue=0x0, ComHandleId=189, ComSystemTemplateSystemSignalRef=CAN3_B2VMinTempPos
            CAN3_B2VPackMaxTemp_411496435R: ComBitPosition=0, ComTimeoutSubstitutionValue=0x0, ComHandleId=190, ComSystemTemplateSystemSignalRef=CAN3_B2VPackMaxTemp
            CAN3_B2VPackMinTemp_411496435R: ComBitPosition=8, ComTimeoutSubstitutionValue=0x0, ComHandleId=191, ComSystemTemplateSystemSignalRef=CAN3_B2VPackMinTemp
        GRCAN3_SG_B2V_ST5_411561971R: ComFirstTimeout=0.005, ComNotification=CAN3_SG_B2V_ST5_ComNotification, ComRxDataTimeoutAction=SUBSTITUTE, ComSignalGroupDirection=RECEIVE, ComTimeout=1.25, ComTimeoutNotification=CAN3_SG_B2V_ST5_ComTimeoutNotification, ComTransferProperty=PENDING, ComHandleId=25, ComSystemTemplateSignalGroupRef=CAN3_SG_B2V_ST5
          CAN3_B2VCellMinVol_411561971R (ComGroupSignal):
            ComBitPosition = 16
            ComBitSize = 16
            ComSignalEndianness = LITTLE_ENDIAN
            ComSignalInitValue = 0
            ComSignalLength = (unset)
            ComSignalType = UINT16
            ComTimeoutSubstitutionValue = 0x0
            ComTransferProperty = TRIGGERED_ON_CHANGE
            ComHandleId = 192
            ComSystemTemplateSystemSignalRef = CAN3_B2VCellMinVol
        GRCAN3_SG_EWP1_419425849R: ComFirstTimeout=0.005, ComNotification=CAN3_SG_EWP1_ComNotification, ComRxDataTimeoutAction=SUBSTITUTE, ComSignalGroupDirection=RECEIVE, ComTimeout=0.5, ComTimeoutNotification=CAN3_SG_EWP1_ComTimeoutNotification, ComTransferProperty=PENDING, ComHandleId=26, ComSystemTemplateSignalGroupRef=CAN3_SG_EWP1
          CAN3_EWPPEFault_419425849R (ComGroupSignal):
            ComBitPosition = 24
            ComBitSize = 8
            ComSignalEndianness = LITTLE_ENDIAN
            ComSignalInitValue = 0
            ComSignalLength = (unset)
            ComSignalType = UINT8
            ComTimeoutSubstitutionValue = 0x0
            ComTransferProperty = TRIGGERED_ON_CHANGE
            ComHandleId = 193
            ComSystemTemplateSystemSignalRef = CAN3_EWPPEFault
        GRCAN3_SG_TM_MCUSta1_218038277R: ComFirstTimeout=0.005, ComNotification=CAN3_SG_TM_MCUSta1_ComNotification, ComRxDataTimeoutAction=SUBSTITUTE, ComSignalGroupDirection=RECEIVE, ComTimeout=0.025, ComTimeoutNotification=CAN3_SG_TM_MCUSta1_ComTimeoutNotification, ComTransferProperty=PENDING, ComHandleId=27, ComSystemTemplateSignalGroupRef=CAN3_SG_TM_MCUSta1
          6 x ComGroupSignal, all with ComSignalEndianness=LITTLE_ENDIAN, ComSignalLength=(unset), ComTimeoutSubstitutionValue=0x0, ComTransferProperty=TRIGGERED_ON_CHANGE:
            CAN3_AtvDisChgEnFbk_218038277R: ComBitPosition=53, ComBitSize=1, ComSignalInitValue=0, ComSignalType=UINT8, ComHandleId=194, ComSystemTemplateSystemSignalRef=CAN3_AtvDisChgEnFbk
            CAN3_MCUCtrlMdSta_218038277R: ComBitPosition=50, ComBitSize=2, ComSignalInitValue=2, ComSignalType=UINT8, ComHandleId=195, ComSystemTemplateSystemSignalRef=CAN3_MCUCtrlMdSta
            CAN3_MCUIGBTEnFbk_218038277R: ComBitPosition=54, ComBitSize=1, ComSignalInitValue=0, ComSignalType=UINT8, ComHandleId=196, ComSystemTemplateSystemSignalRef=CAN3_MCUIGBTEnFbk
            CAN3_MCUMsgSta1LCnt_218038277R: ComBitPosition=60, ComBitSize=4, ComSignalInitValue=0, ComSignalType=UINT8, ComHandleId=197, ComSystemTemplateSystemSignalRef=CAN3_MCUMsgSta1LCnt
            CAN3_MotorSpd_218038277R: ComBitPosition=0, ComBitSize=16, ComSignalInitValue=15000, ComSignalType=UINT16, ComHandleId=198, ComSystemTemplateSystemSignalRef=CAN3_MotorSpd
            CAN3_MotorTrq_218038277R: ComBitPosition=16, ComBitSize=16, ComSignalInitValue=5000, ComSignalType=UINT16, ComHandleId=199, ComSystemTemplateSystemSignalRef=CAN3_MotorTrq
        GRCAN3_SG_TM_MCUSta2_218038533R: ComFirstTimeout=0.005, ComNotification=CAN3_SG_TM_MCUSta2_ComNotification, ComRxDataTimeoutAction=SUBSTITUTE, ComSignalGroupDirection=RECEIVE, ComTimeout=0.125, ComTimeoutNotification=CAN3_SG_TM_MCUSta2_ComTimeoutNotification, ComTransferProperty=PENDING, ComHandleId=28, ComSystemTemplateSignalGroupRef=CAN3_SG_TM_MCUSta2
          6 x ComGroupSignal, all with ComSignalEndianness=LITTLE_ENDIAN, ComSignalLength=(unset), ComTransferProperty=TRIGGERED_ON_CHANGE:
            CAN3_MCUFailGrade_218038533R: ComBitPosition=48, ComBitSize=4, ComSignalInitValue=0, ComSignalType=UINT8, ComTimeoutSubstitutionValue=0x1, ComHandleId=200, ComSystemTemplateSystemSignalRef=CAN3_MCUFailGrade
            CAN3_MCUMsgSta2LCnt_218038533R: ComBitPosition=60, ComBitSize=4, ComSignalInitValue=0, ComSignalType=UINT8, ComTimeoutSubstitutionValue=0x0, ComHandleId=201, ComSystemTemplateSystemSignalRef=CAN3_MCUMsgSta2LCnt
            CAN3_MCUTemp_218038533R: ComBitPosition=8, ComBitSize=8, ComSignalInitValue=40, ComSignalType=UINT8, ComTimeoutSubstitutionValue=0x0, ComHandleId=202, ComSystemTemplateSystemSignalRef=CAN3_MCUTemp
            CAN3_MCUTrqLimHi_218038533R: ComBitPosition=16, ComBitSize=16, ComSignalInitValue=0, ComSignalType=UINT16, ComTimeoutSubstitutionValue=0x0, ComHandleId=203, ComSystemTemplateSystemSignalRef=CAN3_MCUTrqLimHi
            CAN3_MCUTrqLimLo_218038533R: ComBitPosition=32, ComBitSize=16, ComSignalInitValue=5000, ComSignalType=UINT16, ComTimeoutSubstitutionValue=0x0, ComHandleId=204, ComSystemTemplateSystemSignalRef=CAN3_MCUTrqLimLo
            CAN3_MotorTemp_218038533R: ComBitPosition=0, ComBitSize=8, ComSignalInitValue=40, ComSignalType=UINT8, ComTimeoutSubstitutionValue=0x0, ComHandleId=205, ComSystemTemplateSystemSignalRef=CAN3_MotorTemp
        GRCAN3_SG_TM_MCUSta3_218038789R: ComFirstTimeout=0.005, ComNotification=CAN3_SG_TM_MCUSta3_ComNotification, ComRxDataTimeoutAction=SUBSTITUTE, ComSignalGroupDirection=RECEIVE, ComTimeout=0.25, ComTimeoutNotification=CAN3_SG_TM_MCUSta3_ComTimeoutNotification, ComTransferProperty=PENDING, ComHandleId=29, ComSystemTemplateSignalGroupRef=CAN3_SG_TM_MCUSta3
          3 x ComGroupSignal, all with ComSignalEndianness=LITTLE_ENDIAN, ComSignalLength=(unset), ComTimeoutSubstitutionValue=0x0, ComTransferProperty=TRIGGERED_ON_CHANGE:
            CAN3_MCUDCCur_218038789R: ComBitPosition=16, ComBitSize=16, ComSignalInitValue=1000, ComSignalType=UINT16, ComHandleId=206, ComSystemTemplateSystemSignalRef=CAN3_MCUDCCur
            CAN3_MCUDCVol_218038789R: ComBitPosition=32, ComBitSize=16, ComSignalInitValue=0, ComSignalType=UINT16, ComHandleId=207, ComSystemTemplateSystemSignalRef=CAN3_MCUDCVol
            CAN3_MCUFailCode_218038789R: ComBitPosition=0, ComBitSize=8, ComSignalInitValue=0, ComSignalType=UINT8, ComHandleId=208, ComSystemTemplateSystemSignalRef=CAN3_MCUFailCode
        GRCAN4_SG_ZFR_C100_0_515R: ComFirstTimeout=0.005, ComNotification=CAN4_SG_ZFR_C100_0_ComNotification, ComRxDataTimeoutAction=SUBSTITUTE, ComSignalGroupDirection=RECEIVE, ComTimeout=0.25, ComTimeoutNotification=CAN4_SG_ZFR_C100_0_ComTimeoutNotification, ComTransferProperty=PENDING, ComHandleId=30, ComSystemTemplateSignalGroupRef=CAN4_SG_ZFR_C100_0
          CAN4_ParkBrakeSW_515R (ComGroupSignal):
            ComBitPosition = 7
            ComBitSize = 2
            ComSignalEndianness = BIG_ENDIAN
            ComSignalInitValue = 0
            ComSignalLength = (unset)
            ComSignalType = UINT8
            ComTimeoutSubstitutionValue = 0x3
            ComTransferProperty = TRIGGERED_ON_CHANGE
            ComHandleId = 209
            ComSystemTemplateSystemSignalRef = CAN4_ParkBrakeSW
        GRCAN4_SG_ZFR_C5000_0_513R: ComFirstTimeout=0.005, ComNotification=CAN4_SG_ZFR_C5000_0_ComNotification, ComRxDataTimeoutAction=SUBSTITUTE, ComSignalGroupDirection=RECEIVE, ComTimeout=12.5, ComTimeoutNotification=CAN4_SG_ZFR_C5000_0_ComTimeoutNotification, ComTransferProperty=PENDING, ComHandleId=31, ComSystemTemplateSignalGroupRef=CAN4_SG_ZFR_C5000_0
          CAN4_ZFR_CHASSIS_LiningWearFL_Sta_513R (ComGroupSignal):
            ComBitPosition = 7
            ComBitSize = 1
            ComSignalEndianness = BIG_ENDIAN
            ComSignalInitValue = 0
            ComSignalLength = (unset)
            ComSignalType = UINT8
            ComTimeoutSubstitutionValue = 0x0
            ComTransferProperty = TRIGGERED_ON_CHANGE
            ComHandleId = 210
            ComSystemTemplateSystemSignalRef = CAN4_ZFR_CHASSIS_LiningWearFL_Sta
          CAN4_ZFR_CHASSIS_LiningWearFR_Sta_513R (ComGroupSignal):
            ComBitPosition = 6
            ComBitSize = 1
            ComSignalEndianness = BIG_ENDIAN
            ComSignalInitValue = 0
            ComSignalLength = (unset)
            ComSignalType = UINT8
            ComTimeoutSubstitutionValue = 0x0
            ComTransferProperty = TRIGGERED_ON_CHANGE
            ComHandleId = 211
            ComSystemTemplateSystemSignalRef = CAN4_ZFR_CHASSIS_LiningWearFR_Sta
        GRCAN4_SG_ZFR_CE100_0_517R: ComFirstTimeout=0.005, ComNotification=CAN4_SG_ZFR_CE100_0_ComNotification, ComRxDataTimeoutAction=SUBSTITUTE, ComSignalGroupDirection=RECEIVE, ComTimeout=0.25, ComTimeoutNotification=CAN4_SG_ZFR_CE100_0_ComTimeoutNotification, ComTransferProperty=TRIGGERED_ON_CHANGE, ComHandleId=32, ComSystemTemplateSignalGroupRef=CAN4_SG_ZFR_CE100_0
          37 x ComGroupSignal, all with ComSignalEndianness=BIG_ENDIAN, ComSignalLength=(unset), ComSignalType=UINT8:
            CAN4_AirPressureFC2_517R: ComBitPosition=79, ComBitSize=8, ComSignalInitValue=0, ComTimeoutSubstitutionValue=0xFB, ComTransferProperty=PENDING, ComHandleId=212, ComSystemTemplateSystemSignalRef=CAN4_AirPressureFC2
            CAN4_ZFR_BCM_AutoLightSW_Sta_517R: ComBitPosition=39, ComBitSize=1, ComSignalInitValue=0, ComTimeoutSubstitutionValue=0x0, ComTransferProperty=TRIGGERED_ON_CHANGE, ComHandleId=213, ComSystemTemplateSystemSignalRef=CAN4_ZFR_BCM_AutoLightSW_Sta
            CAN4_ZFR_BCM_BSD_Dimmer_Sta_517R: ComBitPosition=63, ComBitSize=7, ComSignalInitValue=0, ComTimeoutSubstitutionValue=0x7F, ComTransferProperty=TRIGGERED_ON_CHANGE, ComHandleId=214, ComSystemTemplateSystemSignalRef=CAN4_ZFR_BCM_BSD_Dimmer_Sta
            CAN4_ZFR_BCM_BacklightDuty_Sta_517R: ComBitPosition=71, ComBitSize=7, ComSignalInitValue=0, ComTimeoutSubstitutionValue=0x7F, ComTransferProperty=PENDING, ComHandleId=215, ComSystemTemplateSystemSignalRef=CAN4_ZFR_BCM_BacklightDuty_Sta
            CAN4_ZFR_BCM_Brake_Sta_517R: ComBitPosition=6, ComBitSize=1, ComSignalInitValue=0, ComTimeoutSubstitutionValue=0x0, ComTransferProperty=TRIGGERED_ON_CHANGE, ComHandleId=216, ComSystemTemplateSystemSignalRef=CAN4_ZFR_BCM_Brake_Sta
            CAN4_ZFR_BCM_DVRMidDoor_Sta_517R: ComBitPosition=9, ComBitSize=1, ComSignalInitValue=0, ComTimeoutSubstitutionValue=0x0, ComTransferProperty=TRIGGERED_ON_CHANGE, ComHandleId=217, ComSystemTemplateSystemSignalRef=CAN4_ZFR_BCM_DVRMidDoor_Sta
            CAN4_ZFR_BCM_DVRSignalL_Sta_517R: ComBitPosition=4, ComBitSize=1, ComSignalInitValue=0, ComTimeoutSubstitutionValue=0x0, ComTransferProperty=TRIGGERED_ON_CHANGE, ComHandleId=218, ComSystemTemplateSystemSignalRef=CAN4_ZFR_BCM_DVRSignalL_Sta
            CAN4_ZFR_BCM_DVRSignalR_Sta_517R: ComBitPosition=5, ComBitSize=1, ComSignalInitValue=0, ComTimeoutSubstitutionValue=0x0, ComTransferProperty=TRIGGERED_ON_CHANGE, ComHandleId=219, ComSystemTemplateSystemSignalRef=CAN4_ZFR_BCM_DVRSignalR_Sta
            CAN4_ZFR_BCM_DVRSignalReverse_Sta_517R: ComBitPosition=32, ComBitSize=1, ComSignalInitValue=0, ComTimeoutSubstitutionValue=0x0, ComTransferProperty=TRIGGERED_ON_CHANGE, ComHandleId=220, ComSystemTemplateSystemSignalRef=CAN4_ZFR_BCM_DVRSignalReverse_Sta
            CAN4_ZFR_BCM_HBeamSW_Sta_517R: ComBitPosition=16, ComBitSize=1, ComSignalInitValue=0, ComTimeoutSubstitutionValue=0x0, ComTransferProperty=TRIGGERED_ON_CHANGE, ComHandleId=221, ComSystemTemplateSystemSignalRef=CAN4_ZFR_BCM_HBeamSW_Sta
            CAN4_ZFR_BCM_HBeam_Sta_517R: ComBitPosition=18, ComBitSize=1, ComSignalInitValue=0, ComTimeoutSubstitutionValue=0x0, ComTransferProperty=TRIGGERED_ON_CHANGE, ComHandleId=222, ComSystemTemplateSystemSignalRef=CAN4_ZFR_BCM_HBeam_Sta
            CAN4_ZFR_BCM_HeadLpSW_Sta_517R: ComBitPosition=37, ComBitSize=1, ComSignalInitValue=0, ComTimeoutSubstitutionValue=0x0, ComTransferProperty=TRIGGERED_ON_CHANGE, ComHandleId=223, ComSystemTemplateSystemSignalRef=CAN4_ZFR_BCM_HeadLpSW_Sta
            CAN4_ZFR_BCM_HornSW_Sta_517R: ComBitPosition=33, ComBitSize=1, ComSignalInitValue=0, ComTimeoutSubstitutionValue=0x0, ComTransferProperty=TRIGGERED_ON_CHANGE, ComHandleId=224, ComSystemTemplateSystemSignalRef=CAN4_ZFR_BCM_HornSW_Sta
            CAN4_ZFR_BCM_LBSDR_Sta_517R: ComBitPosition=15, ComBitSize=1, ComSignalInitValue=0, ComTimeoutSubstitutionValue=0x0, ComTransferProperty=TRIGGERED_ON_CHANGE, ComHandleId=225, ComSystemTemplateSystemSignalRef=CAN4_ZFR_BCM_LBSDR_Sta
            CAN4_ZFR_BCM_LBSDY_Sta_517R: ComBitPosition=1, ComBitSize=1, ComSignalInitValue=0, ComTimeoutSubstitutionValue=0x0, ComTransferProperty=TRIGGERED_ON_CHANGE, ComHandleId=226, ComSystemTemplateSystemSignalRef=CAN4_ZFR_BCM_LBSDY_Sta
            CAN4_ZFR_BCM_LBeam_Sta_517R: ComBitPosition=17, ComBitSize=1, ComSignalInitValue=0, ComTimeoutSubstitutionValue=0x0, ComTransferProperty=TRIGGERED_ON_CHANGE, ComHandleId=227, ComSystemTemplateSystemSignalRef=CAN4_ZFR_BCM_LBeam_Sta
            CAN4_ZFR_BCM_LDRL_Sta_517R: ComBitPosition=21, ComBitSize=1, ComSignalInitValue=0, ComTimeoutSubstitutionValue=0x0, ComTransferProperty=TRIGGERED_ON_CHANGE, ComHandleId=228, ComSystemTemplateSystemSignalRef=CAN4_ZFR_BCM_LDRL_Sta
            CAN4_ZFR_BCM_LFTurnLpC_Sta_517R: ComBitPosition=55, ComBitSize=8, ComSignalInitValue=255, ComTimeoutSubstitutionValue=0xFF, ComTransferProperty=TRIGGERED_ON_CHANGE, ComHandleId=229, ComSystemTemplateSystemSignalRef=CAN4_ZFR_BCM_LFTurnLpC_Sta
            CAN4_ZFR_BCM_LFTurnLp_Sta_517R: ComBitPosition=23, ComBitSize=1, ComSignalInitValue=0, ComTimeoutSubstitutionValue=0x0, ComTransferProperty=TRIGGERED_ON_CHANGE, ComHandleId=230, ComSystemTemplateSystemSignalRef=CAN4_ZFR_BCM_LFTurnLp_Sta
            CAN4_ZFR_BCM_LightSensorV_Sta_517R: ComBitPosition=31, ComBitSize=8, ComSignalInitValue=0, ComTimeoutSubstitutionValue=0x0, ComTransferProperty=TRIGGERED_ON_CHANGE, ComHandleId=231, ComSystemTemplateSystemSignalRef=CAN4_ZFR_BCM_LightSensorV_Sta
            CAN4_ZFR_BCM_PLamp_Sta_517R: ComBitPosition=19, ComBitSize=1, ComSignalInitValue=0, ComTimeoutSubstitutionValue=0x0, ComTransferProperty=TRIGGERED_ON_CHANGE, ComHandleId=232, ComSystemTemplateSystemSignalRef=CAN4_ZFR_BCM_PLamp_Sta
            CAN4_ZFR_BCM_PosLpSW_Sta_517R: ComBitPosition=38, ComBitSize=1, ComSignalInitValue=0, ComTimeoutSubstitutionValue=0x0, ComTransferProperty=TRIGGERED_ON_CHANGE, ComHandleId=233, ComSystemTemplateSystemSignalRef=CAN4_ZFR_BCM_PosLpSW_Sta
            CAN4_ZFR_BCM_RBSDR_Sta_517R: ComBitPosition=0, ComBitSize=1, ComSignalInitValue=0, ComTimeoutSubstitutionValue=0x0, ComTransferProperty=TRIGGERED_ON_CHANGE, ComHandleId=234, ComSystemTemplateSystemSignalRef=CAN4_ZFR_BCM_RBSDR_Sta
            CAN4_ZFR_BCM_RBSDY_Sta_517R: ComBitPosition=2, ComBitSize=1, ComSignalInitValue=0, ComTimeoutSubstitutionValue=0x0, ComTransferProperty=TRIGGERED_ON_CHANGE, ComHandleId=235, ComSystemTemplateSystemSignalRef=CAN4_ZFR_BCM_RBSDY_Sta
            CAN4_ZFR_BCM_RDRL_Sta_517R: ComBitPosition=22, ComBitSize=1, ComSignalInitValue=0, ComTimeoutSubstitutionValue=0x0, ComTransferProperty=TRIGGERED_ON_CHANGE, ComHandleId=236, ComSystemTemplateSystemSignalRef=CAN4_ZFR_BCM_RDRL_Sta
            CAN4_ZFR_BCM_RFTurnLpC_Sta_517R: ComBitPosition=47, ComBitSize=8, ComSignalInitValue=255, ComTimeoutSubstitutionValue=0xFF, ComTransferProperty=TRIGGERED_ON_CHANGE, ComHandleId=237, ComSystemTemplateSystemSignalRef=CAN4_ZFR_BCM_RFTurnLpC_Sta
            CAN4_ZFR_BCM_RFTurnLp_Sta_517R: ComBitPosition=8, ComBitSize=1, ComSignalInitValue=0, ComTimeoutSubstitutionValue=0x0, ComTransferProperty=TRIGGERED_ON_CHANGE, ComHandleId=238, ComSystemTemplateSystemSignalRef=CAN4_ZFR_BCM_RFTurnLp_Sta
            CAN4_ZFR_BCM_RFogLp_SW_Sta_517R: ComBitPosition=14, ComBitSize=1, ComSignalInitValue=0, ComTimeoutSubstitutionValue=0x0, ComTransferProperty=TRIGGERED_ON_CHANGE, ComHandleId=239, ComSystemTemplateSystemSignalRef=CAN4_ZFR_BCM_RFogLp_SW_Sta
            CAN4_ZFR_BCM_Seatbelt_Sta_517R: ComBitPosition=7, ComBitSize=1, ComSignalInitValue=0, ComTimeoutSubstitutionValue=0x0, ComTransferProperty=TRIGGERED_ON_CHANGE, ComHandleId=240, ComSystemTemplateSystemSignalRef=CAN4_ZFR_BCM_Seatbelt_Sta
            CAN4_ZFR_BCM_TurnBuzzer_Sta_517R: ComBitPosition=3, ComBitSize=1, ComSignalInitValue=0, ComTimeoutSubstitutionValue=0x0, ComTransferProperty=TRIGGERED_ON_CHANGE, ComHandleId=241, ComSystemTemplateSystemSignalRef=CAN4_ZFR_BCM_TurnBuzzer_Sta
            CAN4_ZFR_BCM_WasherSW_Sta_517R: ComBitPosition=34, ComBitSize=1, ComSignalInitValue=0, ComTimeoutSubstitutionValue=0x0, ComTransferProperty=TRIGGERED_ON_CHANGE, ComHandleId=242, ComSystemTemplateSystemSignalRef=CAN4_ZFR_BCM_WasherSW_Sta
            CAN4_ZFR_BCM_Washer_Sta_517R: ComBitPosition=13, ComBitSize=1, ComSignalInitValue=0, ComTimeoutSubstitutionValue=0x0, ComTransferProperty=TRIGGERED_ON_CHANGE, ComHandleId=243, ComSystemTemplateSystemSignalRef=CAN4_ZFR_BCM_Washer_Sta
            CAN4_ZFR_BCM_WiperAS_Sta_517R: ComBitPosition=12, ComBitSize=1, ComSignalInitValue=0, ComTimeoutSubstitutionValue=0x0, ComTransferProperty=TRIGGERED_ON_CHANGE, ComHandleId=244, ComSystemTemplateSystemSignalRef=CAN4_ZFR_BCM_WiperAS_Sta
            CAN4_ZFR_BCM_WiperHSW_Sta_517R: ComBitPosition=36, ComBitSize=1, ComSignalInitValue=0, ComTimeoutSubstitutionValue=0x0, ComTransferProperty=TRIGGERED_ON_CHANGE, ComHandleId=245, ComSystemTemplateSystemSignalRef=CAN4_ZFR_BCM_WiperHSW_Sta
            CAN4_ZFR_BCM_WiperH_Sta_517R: ComBitPosition=10, ComBitSize=1, ComSignalInitValue=0, ComTimeoutSubstitutionValue=0x0, ComTransferProperty=TRIGGERED_ON_CHANGE, ComHandleId=246, ComSystemTemplateSystemSignalRef=CAN4_ZFR_BCM_WiperH_Sta
            CAN4_ZFR_BCM_WiperLSW_Sta_517R: ComBitPosition=35, ComBitSize=1, ComSignalInitValue=0, ComTimeoutSubstitutionValue=0x0, ComTransferProperty=TRIGGERED_ON_CHANGE, ComHandleId=247, ComSystemTemplateSystemSignalRef=CAN4_ZFR_BCM_WiperLSW_Sta
            CAN4_ZFR_BCM_WiperL_Sta_517R: ComBitPosition=11, ComBitSize=1, ComSignalInitValue=0, ComTimeoutSubstitutionValue=0x0, ComTransferProperty=TRIGGERED_ON_CHANGE, ComHandleId=248, ComSystemTemplateSystemSignalRef=CAN4_ZFR_BCM_WiperL_Sta
        GRCAN4_SG_ZRR_C5000_0_514R: ComFirstTimeout=0.005, ComNotification=CAN4_SG_ZRR_C5000_0_ComNotification, ComRxDataTimeoutAction=SUBSTITUTE, ComSignalGroupDirection=RECEIVE, ComTimeout=12.5, ComTimeoutNotification=CAN4_SG_ZRR_C5000_0_ComTimeoutNotification, ComTransferProperty=PENDING, ComHandleId=33, ComSystemTemplateSignalGroupRef=CAN4_SG_ZRR_C5000_0
          CAN4_ZRR_CHASSIS_LiningWearRL_Sta_514R (ComGroupSignal):
            ComBitPosition = 6
            ComBitSize = 1
            ComSignalEndianness = BIG_ENDIAN
            ComSignalInitValue = 0
            ComSignalLength = (unset)
            ComSignalType = UINT8
            ComTimeoutSubstitutionValue = 0x0
            ComTransferProperty = TRIGGERED_ON_CHANGE
            ComHandleId = 249
            ComSystemTemplateSystemSignalRef = CAN4_ZRR_CHASSIS_LiningWearRL_Sta
          CAN4_ZRR_CHASSIS_LiningWearRR_Sta_514R (ComGroupSignal):
            ComBitPosition = 7
            ComBitSize = 1
            ComSignalEndianness = BIG_ENDIAN
            ComSignalInitValue = 0
            ComSignalLength = (unset)
            ComSignalType = UINT8
            ComTimeoutSubstitutionValue = 0x0
            ComTransferProperty = TRIGGERED_ON_CHANGE
            ComHandleId = 250
            ComSystemTemplateSystemSignalRef = CAN4_ZRR_CHASSIS_LiningWearRR_Sta
        GRCAN4_SG_ZRR_CE100_0_419319532R: ComFirstTimeout=0.005, ComNotification=CAN4_SG_ZRR_CE100_0_ComNotification, ComRxDataTimeoutAction=SUBSTITUTE, ComSignalGroupDirection=RECEIVE, ComTimeout=0.25, ComTimeoutNotification=CAN4_SG_ZRR_CE100_0_ComTimeoutNotification, ComTransferProperty=TRIGGERED_ON_CHANGE, ComHandleId=34, ComSystemTemplateSignalGroupRef=CAN4_SG_ZRR_CE100_0
          CAN4_ZRR_BCM_AllDoor_Sta_419319532R (ComGroupSignal):
            ComBitPosition = 0
            ComBitSize = 4
            ComSignalEndianness = LITTLE_ENDIAN
            ComSignalInitValue = 0
            ComSignalLength = (unset)
            ComSignalType = UINT8
            ComTimeoutSubstitutionValue = 0x0
            ComTransferProperty = TRIGGERED_ON_CHANGE
            ComHandleId = 251
            ComSystemTemplateSystemSignalRef = CAN4_ZRR_BCM_AllDoor_Sta
        GRCAN4_SG_ZRR_CE100_1_518R: ComFirstTimeout=0.005, ComNotification=CAN4_SG_ZRR_CE100_1_ComNotification, ComRxDataTimeoutAction=SUBSTITUTE, ComSignalGroupDirection=RECEIVE, ComTimeout=0.25, ComTimeoutNotification=CAN4_SG_ZRR_CE100_1_ComTimeoutNotification, ComTransferProperty=TRIGGERED_ON_CHANGE, ComHandleId=35, ComSystemTemplateSignalGroupRef=CAN4_SG_ZRR_CE100_1
          30 x ComGroupSignal, all with ComSignalEndianness=BIG_ENDIAN, ComSignalInitValue=0, ComSignalLength=(unset), ComSignalType=UINT8:
            CAN4_AirPressurePC3_518R: ComBitPosition=47, ComBitSize=8, ComTimeoutSubstitutionValue=0x0, ComTransferProperty=PENDING, ComHandleId=252, ComSystemTemplateSystemSignalRef=CAN4_AirPressurePC3
            CAN4_AirPressureRC1_518R: ComBitPosition=55, ComBitSize=8, ComTimeoutSubstitutionValue=0xFB, ComTransferProperty=PENDING, ComHandleId=253, ComSystemTemplateSystemSignalRef=CAN4_AirPressureRC1
            CAN4_FDC_CHASSIS_VCUEACPress_Sta_518R: ComBitPosition=71, ComBitSize=1, ComTimeoutSubstitutionValue=0x0, ComTransferProperty=PENDING, ComHandleId=254, ComSystemTemplateSystemSignalRef=CAN4_FDC_CHASSIS_VCUEACPress_Sta
            CAN4_ZRR_BCM_BrakeLp_Sta_518R: ComBitPosition=13, ComBitSize=1, ComTimeoutSubstitutionValue=0x0, ComTransferProperty=TRIGGERED_ON_CHANGE, ComHandleId=255, ComSystemTemplateSystemSignalRef=CAN4_ZRR_BCM_BrakeLp_Sta
            CAN4_ZRR_BCM_CallingSW_Sta_518R: ComBitPosition=8, ComBitSize=1, ComTimeoutSubstitutionValue=0x0, ComTransferProperty=TRIGGERED_ON_CHANGE, ComHandleId=256, ComSystemTemplateSystemSignalRef=CAN4_ZRR_BCM_CallingSW_Sta
            CAN4_ZRR_BCM_EmLight_Sta_518R: ComBitPosition=63, ComBitSize=1, ComTimeoutSubstitutionValue=0x0, ComTransferProperty=PENDING, ComHandleId=257, ComSystemTemplateSystemSignalRef=CAN4_ZRR_BCM_EmLight_Sta
            CAN4_ZRR_BCM_EmSV_Sta_518R: ComBitPosition=7, ComBitSize=1, ComTimeoutSubstitutionValue=0x0, ComTransferProperty=TRIGGERED_ON_CHANGE, ComHandleId=258, ComSystemTemplateSystemSignalRef=CAN4_ZRR_BCM_EmSV_Sta
            CAN4_ZRR_BCM_FDCloseSV_Sta_518R: ComBitPosition=2, ComBitSize=1, ComTimeoutSubstitutionValue=0x0, ComTransferProperty=TRIGGERED_ON_CHANGE, ComHandleId=259, ComSystemTemplateSystemSignalRef=CAN4_ZRR_BCM_FDCloseSV_Sta
            CAN4_ZRR_BCM_FDOpenSV_Sta_518R: ComBitPosition=1, ComBitSize=1, ComTimeoutSubstitutionValue=0x0, ComTransferProperty=TRIGGERED_ON_CHANGE, ComHandleId=260, ComSystemTemplateSystemSignalRef=CAN4_ZRR_BCM_FDOpenSV_Sta
            CAN4_ZRR_BCM_FDoorAP_Sta_518R: ComBitPosition=5, ComBitSize=1, ComTimeoutSubstitutionValue=0x0, ComTransferProperty=TRIGGERED_ON_CHANGE, ComHandleId=261, ComSystemTemplateSystemSignalRef=CAN4_ZRR_BCM_FDoorAP_Sta
            CAN4_ZRR_BCM_LRTurnLpC_Sta_518R: ComBitPosition=31, ComBitSize=8, ComTimeoutSubstitutionValue=0xFF, ComTransferProperty=TRIGGERED_ON_CHANGE, ComHandleId=262, ComSystemTemplateSystemSignalRef=CAN4_ZRR_BCM_LRTurnLpC_Sta
            CAN4_ZRR_BCM_LRTurnLp_Sta_518R: ComBitPosition=9, ComBitSize=1, ComTimeoutSubstitutionValue=0x0, ComTransferProperty=TRIGGERED_ON_CHANGE, ComHandleId=263, ComSystemTemplateSystemSignalRef=CAN4_ZRR_BCM_LRTurnLp_Sta
            CAN4_ZRR_BCM_MDCloseSV_Sta_518R: ComBitPosition=4, ComBitSize=1, ComTimeoutSubstitutionValue=0x0, ComTransferProperty=TRIGGERED_ON_CHANGE, ComHandleId=264, ComSystemTemplateSystemSignalRef=CAN4_ZRR_BCM_MDCloseSV_Sta
            CAN4_ZRR_BCM_MDOpenSV_Sta_518R: ComBitPosition=3, ComBitSize=1, ComTimeoutSubstitutionValue=0x0, ComTransferProperty=TRIGGERED_ON_CHANGE, ComHandleId=265, ComSystemTemplateSystemSignalRef=CAN4_ZRR_BCM_MDOpenSV_Sta
            CAN4_ZRR_BCM_MDoorAP_Sta_518R: ComBitPosition=6, ComBitSize=1, ComTimeoutSubstitutionValue=0x0, ComTransferProperty=TRIGGERED_ON_CHANGE, ComHandleId=266, ComSystemTemplateSystemSignalRef=CAN4_ZRR_BCM_MDoorAP_Sta
            CAN4_ZRR_BCM_PLamp_Sta_518R: ComBitPosition=14, ComBitSize=1, ComTimeoutSubstitutionValue=0x0, ComTransferProperty=TRIGGERED_ON_CHANGE, ComHandleId=267, ComSystemTemplateSystemSignalRef=CAN4_ZRR_BCM_PLamp_Sta
            CAN4_ZRR_BCM_RFLamp_Sta_518R: ComBitPosition=12, ComBitSize=1, ComTimeoutSubstitutionValue=0x0, ComTransferProperty=TRIGGERED_ON_CHANGE, ComHandleId=268, ComSystemTemplateSystemSignalRef=CAN4_ZRR_BCM_RFLamp_Sta
            CAN4_ZRR_BCM_RRTurnLpC_Sta_518R: ComBitPosition=23, ComBitSize=8, ComTimeoutSubstitutionValue=0xFF, ComTransferProperty=TRIGGERED_ON_CHANGE, ComHandleId=269, ComSystemTemplateSystemSignalRef=CAN4_ZRR_BCM_RRTurnLpC_Sta
            CAN4_ZRR_BCM_RRTurnLp_Sta_518R: ComBitPosition=10, ComBitSize=1, ComTimeoutSubstitutionValue=0x0, ComTransferProperty=TRIGGERED_ON_CHANGE, ComHandleId=270, ComSystemTemplateSystemSignalRef=CAN4_ZRR_BCM_RRTurnLp_Sta
            CAN4_ZRR_BCM_ReverseBuz_Sta_518R: ComBitPosition=0, ComBitSize=1, ComTimeoutSubstitutionValue=0x0, ComTransferProperty=TRIGGERED_ON_CHANGE, ComHandleId=271, ComSystemTemplateSystemSignalRef=CAN4_ZRR_BCM_ReverseBuz_Sta
            CAN4_ZRR_BCM_ReverseLp_Sta_518R: ComBitPosition=15, ComBitSize=1, ComTimeoutSubstitutionValue=0x0, ComTransferProperty=TRIGGERED_ON_CHANGE, ComHandleId=272, ComSystemTemplateSystemSignalRef=CAN4_ZRR_BCM_ReverseLp_Sta
            CAN4_ZRR_BCM_RoomLpAmb_Sta_518R: ComBitPosition=33, ComBitSize=1, ComTimeoutSubstitutionValue=0x0, ComTransferProperty=TRIGGERED_ON_CHANGE, ComHandleId=273, ComSystemTemplateSystemSignalRef=CAN4_ZRR_BCM_RoomLpAmb_Sta
            CAN4_ZRR_BCM_SLTLp_Sta_518R: ComBitPosition=37, ComBitSize=1, ComTimeoutSubstitutionValue=0x0, ComTransferProperty=TRIGGERED_ON_CHANGE, ComHandleId=274, ComSystemTemplateSystemSignalRef=CAN4_ZRR_BCM_SLTLp_Sta
            CAN4_ZRR_BCM_SMKL_Sta_518R: ComBitPosition=34, ComBitSize=1, ComTimeoutSubstitutionValue=0x0, ComTransferProperty=TRIGGERED_ON_CHANGE, ComHandleId=275, ComSystemTemplateSystemSignalRef=CAN4_ZRR_BCM_SMKL_Sta
            CAN4_ZRR_BCM_SMKR_Sta_518R: ComBitPosition=35, ComBitSize=1, ComTimeoutSubstitutionValue=0x0, ComTransferProperty=TRIGGERED_ON_CHANGE, ComHandleId=276, ComSystemTemplateSystemSignalRef=CAN4_ZRR_BCM_SMKR_Sta
            CAN4_ZRR_BCM_SRTLp_Sta_518R: ComBitPosition=36, ComBitSize=1, ComTimeoutSubstitutionValue=0x0, ComTransferProperty=TRIGGERED_ON_CHANGE, ComHandleId=277, ComSystemTemplateSystemSignalRef=CAN4_ZRR_BCM_SRTLp_Sta
            CAN4_ZRR_BCM_STOPSW2_Sta_518R: ComBitPosition=39, ComBitSize=1, ComTimeoutSubstitutionValue=0x0, ComTransferProperty=TRIGGERED_ON_CHANGE, ComHandleId=278, ComSystemTemplateSystemSignalRef=CAN4_ZRR_BCM_STOPSW2_Sta
            CAN4_ZRR_BCM_STOPSW_Sta_518R: ComBitPosition=38, ComBitSize=1, ComTimeoutSubstitutionValue=0x0, ComTransferProperty=TRIGGERED_ON_CHANGE, ComHandleId=279, ComSystemTemplateSystemSignalRef=CAN4_ZRR_BCM_STOPSW_Sta
            CAN4_ZRR_BCM_StopLight_Sta_518R: ComBitPosition=32, ComBitSize=1, ComTimeoutSubstitutionValue=0x0, ComTransferProperty=TRIGGERED_ON_CHANGE, ComHandleId=280, ComSystemTemplateSystemSignalRef=CAN4_ZRR_BCM_StopLight_Sta
            CAN4_ZRR_BCM_TurnBuzzer_Sta_518R: ComBitPosition=11, ComBitSize=1, ComTimeoutSubstitutionValue=0x0, ComTransferProperty=TRIGGERED_ON_CHANGE, ComHandleId=281, ComSystemTemplateSystemSignalRef=CAN4_ZRR_BCM_TurnBuzzer_Sta
        GRCAN4_SG_zGW_CANRr1_C50_0_522R: ComFirstTimeout=0.005, ComNotification=CAN4_SG_zGW_CANRr1_C50_0_ComNotification, ComRxDataTimeoutAction=SUBSTITUTE, ComSignalGroupDirection=RECEIVE, ComTimeout=0.125, ComTimeoutNotification=CAN4_SG_zGW_CANRr1_C50_0_ComTimeoutNotification, ComTransferProperty=PENDING, ComHandleId=36, ComSystemTemplateSignalGroupRef=CAN4_SG_zGW_CANRr1_C50_0
          25 x ComGroupSignal, all with ComSignalEndianness=LITTLE_ENDIAN, ComSignalInitValue=0, ComSignalLength=(unset), ComTransferProperty=TRIGGERED_ON_CHANGE:
            CAN4_DCDC_En_Sta_522R: ComBitPosition=75, ComBitSize=2, ComSignalType=UINT8, ComTimeoutSubstitutionValue=0x0, ComHandleId=282, ComSystemTemplateSystemSignalRef=CAN4_DCDC_En_Sta
            CAN4_DCDC_ErrLv_Sta_522R: ComBitPosition=72, ComBitSize=3, ComSignalType=UINT8, ComTimeoutSubstitutionValue=0x5, ComHandleId=283, ComSystemTemplateSystemSignalRef=CAN4_DCDC_ErrLv_Sta
            CAN4_DCDC_LifeSig_Sta_522R: ComBitPosition=88, ComBitSize=8, ComSignalType=UINT8, ComTimeoutSubstitutionValue=0x0, ComHandleId=284, ComSystemTemplateSystemSignalRef=CAN4_DCDC_LifeSig_Sta
            CAN4_DCDC_OutVol_Sta_522R: ComBitPosition=32, ComBitSize=16, ComSignalType=UINT16, ComTimeoutSubstitutionValue=0x0, ComHandleId=285, ComSystemTemplateSystemSignalRef=CAN4_DCDC_OutVol_Sta
            CAN4_DCDC_Temp_Sta_522R: ComBitPosition=16, ComBitSize=8, ComSignalType=UINT8, ComTimeoutSubstitutionValue=0x0, ComHandleId=286, ComSystemTemplateSystemSignalRef=CAN4_DCDC_Temp_Sta
            CAN4_EAC_En_Sta_522R: ComBitPosition=69, ComBitSize=2, ComSignalType=UINT8, ComTimeoutSubstitutionValue=0x0, ComHandleId=287, ComSystemTemplateSystemSignalRef=CAN4_EAC_En_Sta
            CAN4_EAC_ErrLv_Sta_522R: ComBitPosition=24, ComBitSize=3, ComSignalType=UINT8, ComTimeoutSubstitutionValue=0x5, ComHandleId=288, ComSystemTemplateSystemSignalRef=CAN4_EAC_ErrLv_Sta
            CAN4_EAC_InvTemp_Sta_522R: ComBitPosition=0, ComBitSize=8, ComSignalType=UINT8, ComTimeoutSubstitutionValue=0x0, ComHandleId=289, ComSystemTemplateSystemSignalRef=CAN4_EAC_InvTemp_Sta
            CAN4_EAC_LifeSig_Sta_522R: ComBitPosition=80, ComBitSize=8, ComSignalType=UINT8, ComTimeoutSubstitutionValue=0x0, ComHandleId=290, ComSystemTemplateSystemSignalRef=CAN4_EAC_LifeSig_Sta
            CAN4_EHPS_En_Sta_522R: ComBitPosition=67, ComBitSize=2, ComSignalType=UINT8, ComTimeoutSubstitutionValue=0x0, ComHandleId=291, ComSystemTemplateSystemSignalRef=CAN4_EHPS_En_Sta
            CAN4_EHPS_ErrLv_Sta_522R: ComBitPosition=64, ComBitSize=3, ComSignalType=UINT8, ComTimeoutSubstitutionValue=0x5, ComHandleId=292, ComSystemTemplateSystemSignalRef=CAN4_EHPS_ErrLv_Sta
            CAN4_EHPS_InvTemp_Sta_522R: ComBitPosition=8, ComBitSize=8, ComSignalType=UINT8, ComTimeoutSubstitutionValue=0x0, ComHandleId=293, ComSystemTemplateSystemSignalRef=CAN4_EHPS_InvTemp_Sta
            CAN4_EHPS_LifeSig_Sta_522R: ComBitPosition=112, ComBitSize=8, ComSignalType=UINT8, ComTimeoutSubstitutionValue=0x0, ComHandleId=294, ComSystemTemplateSystemSignalRef=CAN4_EHPS_LifeSig_Sta
            CAN4_EHPS_MotorSpd_Sta_522R: ComBitPosition=96, ComBitSize=16, ComSignalType=UINT16, ComTimeoutSubstitutionValue=0x0, ComHandleId=295, ComSystemTemplateSystemSignalRef=CAN4_EHPS_MotorSpd_Sta
            CAN4_PDU_ACRly_Sta_522R: ComBitPosition=56, ComBitSize=2, ComSignalType=UINT8, ComTimeoutSubstitutionValue=0x0, ComHandleId=296, ComSystemTemplateSystemSignalRef=CAN4_PDU_ACRly_Sta
            CAN4_PDU_DCDCEACEHPSHVLoop_Sta_522R: ComBitPosition=27, ComBitSize=2, ComSignalType=UINT8, ComTimeoutSubstitutionValue=0x0, ComHandleId=297, ComSystemTemplateSystemSignalRef=CAN4_PDU_DCDCEACEHPSHVLoop_Sta
            CAN4_PDU_DCDCEACEHPSPreRly_Sta_522R: ComBitPosition=29, ComBitSize=2, ComSignalType=UINT8, ComTimeoutSubstitutionValue=0x0, ComHandleId=298, ComSystemTemplateSystemSignalRef=CAN4_PDU_DCDCEACEHPSPreRly_Sta
            CAN4_PDU_DCDCEACEHPSRly_Sta_522R: ComBitPosition=60, ComBitSize=2, ComSignalType=UINT8, ComTimeoutSubstitutionValue=0x0, ComHandleId=299, ComSystemTemplateSystemSignalRef=CAN4_PDU_DCDCEACEHPSRly_Sta
            CAN4_PDU_DeFogTMSRly_Sta_522R: ComBitPosition=58, ComBitSize=2, ComSignalType=UINT8, ComTimeoutSubstitutionValue=0x0, ComHandleId=300, ComSystemTemplateSystemSignalRef=CAN4_PDU_DeFogTMSRly_Sta
            CAN4_PDU_HVIL_Sta_522R: ComBitPosition=62, ComBitSize=2, ComSignalType=UINT8, ComTimeoutSubstitutionValue=0x0, ComHandleId=301, ComSystemTemplateSystemSignalRef=CAN4_PDU_HVIL_Sta
            CAN4_PDU_LifeSig_Sta_522R: ComBitPosition=120, ComBitSize=8, ComSignalType=UINT8, ComTimeoutSubstitutionValue=0x0, ComHandleId=302, ComSystemTemplateSystemSignalRef=CAN4_PDU_LifeSig_Sta
            CAN4_PDU_MCUHVLoop_Sta_522R: ComBitPosition=54, ComBitSize=2, ComSignalType=UINT8, ComTimeoutSubstitutionValue=0x0, ComHandleId=303, ComSystemTemplateSystemSignalRef=CAN4_PDU_MCUHVLoop_Sta
            CAN4_PDU_MCUPosRly_Sta_522R: ComBitPosition=52, ComBitSize=2, ComSignalType=UINT8, ComTimeoutSubstitutionValue=0x0, ComHandleId=304, ComSystemTemplateSystemSignalRef=CAN4_PDU_MCUPosRly_Sta
            CAN4_PDU_MCUPreRly_Sta_522R: ComBitPosition=50, ComBitSize=2, ComSignalType=UINT8, ComTimeoutSubstitutionValue=0x0, ComHandleId=305, ComSystemTemplateSystemSignalRef=CAN4_PDU_MCUPreRly_Sta
            CAN4_PDU_SelfChk_Sta_522R: ComBitPosition=48, ComBitSize=2, ComSignalType=UINT8, ComTimeoutSubstitutionValue=0x3, ComHandleId=306, ComSystemTemplateSystemSignalRef=CAN4_PDU_SelfChk_Sta
        GRCAN1_SG_FD1_C1000_0_419343920T: ComSignalGroupDirection=SEND, ComTransferProperty=PENDING, ComHandleId=0, ComSystemTemplateSignalGroupRef=CAN1_SG_FD1_C1000_0
          3 x ComGroupSignal, all with ComBitSize=8, ComSignalEndianness=LITTLE_ENDIAN, ComSignalInitValue=0, ComSignalLength=(unset), ComSignalType=UINT8, ComTimeoutSubstitutionValue=(unset), ComTransferProperty=TRIGGERED_ON_CHANGE:
            CAN1_AirPressureFC2_419343920T: ComBitPosition=24, ComHandleId=0, ComSystemTemplateSystemSignalRef=CAN1_AirPressureFC2
            CAN1_AirPressurePC3_419343920T: ComBitPosition=8, ComHandleId=1, ComSystemTemplateSystemSignalRef=CAN1_AirPressurePC3
            CAN1_AirPressureRC1_419343920T: ComBitPosition=16, ComHandleId=2, ComSystemTemplateSystemSignalRef=CAN1_AirPressureRC1
        GRCAN1_SG_FD1_C100_0_419318275T: ComSignalGroupDirection=SEND, ComTransferProperty=PENDING, ComHandleId=1, ComSystemTemplateSignalGroupRef=CAN1_SG_FD1_C100_0
          CAN1_VCUEBSRd4BR_419318275T (ComGroupSignal):
            ComBitPosition = 8
            ComBitSize = 2
            ComSignalEndianness = LITTLE_ENDIAN
            ComSignalInitValue = 0
            ComSignalLength = (unset)
            ComSignalType = UINT8
            ComTimeoutSubstitutionValue = (unset)
            ComTransferProperty = TRIGGERED_ON_CHANGE
            ComHandleId = 3
            ComSystemTemplateSystemSignalRef = CAN1_VCUEBSRd4BR
        GRCAN1_SG_FD1_C100_1_419389483T: ComSignalGroupDirection=SEND, ComTransferProperty=PENDING, ComHandleId=2, ComSystemTemplateSignalGroupRef=CAN1_SG_FD1_C100_1
          CAN1_VCUEBSHBSw_419389483T (ComGroupSignal):
            ComBitPosition = 6
            ComBitSize = 2
            ComSignalEndianness = LITTLE_ENDIAN
            ComSignalInitValue = 0
            ComSignalLength = (unset)
            ComSignalType = UINT8
            ComTimeoutSubstitutionValue = (unset)
            ComTransferProperty = TRIGGERED_ON_CHANGE
            ComHandleId = 4
            ComSystemTemplateSystemSignalRef = CAN1_VCUEBSHBSw
          CAN1_VCUEBSHHSw_419389483T (ComGroupSignal):
            ComBitPosition = 4
            ComBitSize = 2
            ComSignalEndianness = LITTLE_ENDIAN
            ComSignalInitValue = 0
            ComSignalLength = (unset)
            ComSignalType = UINT8
            ComTimeoutSubstitutionValue = (unset)
            ComTransferProperty = TRIGGERED_ON_CHANGE
            ComHandleId = 5
            ComSystemTemplateSystemSignalRef = CAN1_VCUEBSHHSw
        GRCAN1_SG_FD1_C100_2_435160528T: ComSignalGroupDirection=SEND, ComTransferProperty=PENDING, ComHandleId=3, ComSystemTemplateSignalGroupRef=CAN1_SG_FD1_C100_2
          11 x ComGroupSignal, all with ComSignalEndianness=LITTLE_ENDIAN, ComSignalInitValue=0, ComSignalLength=(unset), ComTimeoutSubstitutionValue=(unset), ComTransferProperty=TRIGGERED_ON_CHANGE:
            CAN1_GearFlashInd_435160528T: ComBitPosition=2, ComBitSize=1, ComSignalType=UINT8, ComHandleId=6, ComSystemTemplateSystemSignalRef=CAN1_GearFlashInd
            CAN1_LVBattLow_435160528T: ComBitPosition=52, ComBitSize=2, ComSignalType=UINT8, ComHandleId=7, ComSystemTemplateSystemSignalRef=CAN1_LVBattLow
            CAN1_PweLmtInd_435160528T: ComBitPosition=3, ComBitSize=1, ComSignalType=UINT8, ComHandleId=8, ComSystemTemplateSystemSignalRef=CAN1_PweLmtInd
            CAN1_VCUBCMBuzzReq_435160528T: ComBitPosition=55, ComBitSize=1, ComSignalType=UINT8, ComHandleId=9, ComSystemTemplateSystemSignalRef=CAN1_VCUBCMBuzzReq
            CAN1_VCUDTCCurrCode_435160528T: ComBitPosition=12, ComBitSize=20, ComSignalType=UINT32, ComHandleId=10, ComSystemTemplateSystemSignalRef=CAN1_VCUDTCCurrCode
            CAN1_VCUDTCCurrSta_435160528T: ComBitPosition=8, ComBitSize=2, ComSignalType=UINT8, ComHandleId=11, ComSystemTemplateSystemSignalRef=CAN1_VCUDTCCurrSta
            CAN1_VCUDTCHisCode_435160528T: ComBitPosition=32, ComBitSize=20, ComSignalType=UINT32, ComHandleId=12, ComSystemTemplateSystemSignalRef=CAN1_VCUDTCHisCode
            CAN1_VCUDTCHisSta_435160528T: ComBitPosition=10, ComBitSize=2, ComSignalType=UINT8, ComHandleId=13, ComSystemTemplateSystemSignalRef=CAN1_VCUDTCHisSta
            CAN1_VCUKeyStatus_435160528T: ComBitPosition=0, ComBitSize=2, ComSignalType=UINT8, ComHandleId=14, ComSystemTemplateSystemSignalRef=CAN1_VCUKeyStatus
            CAN1_VCUWarnInd_435160528T: ComBitPosition=4, ComBitSize=3, ComSignalType=UINT8, ComHandleId=15, ComSystemTemplateSystemSignalRef=CAN1_VCUWarnInd
            CAN1_VCUnoPBInd_435160528T: ComBitPosition=54, ComBitSize=1, ComSignalType=UINT8, ComHandleId=16, ComSystemTemplateSystemSignalRef=CAN1_VCUnoPBInd
        GRCAN1_SG_FD1_C100_3_419361024T: ComSignalGroupDirection=SEND, ComTransferProperty=PENDING, ComHandleId=4, ComSystemTemplateSignalGroupRef=CAN1_SG_FD1_C100_3
          3 x ComGroupSignal, all with ComSignalEndianness=LITTLE_ENDIAN, ComSignalInitValue=0, ComSignalLength=(unset), ComTimeoutSubstitutionValue=(unset), ComTransferProperty=TRIGGERED_ON_CHANGE:
            CAN1_BrakeSW_419361024T: ComBitPosition=28, ComBitSize=2, ComSignalType=UINT8, ComHandleId=17, ComSystemTemplateSystemSignalRef=CAN1_BrakeSW
            CAN1_ParkBrakeSW_419361024T: ComBitPosition=2, ComBitSize=2, ComSignalType=UINT8, ComHandleId=18, ComSystemTemplateSystemSignalRef=CAN1_ParkBrakeSW
            CAN1_VCUVehSpd_419361024T: ComBitPosition=8, ComBitSize=16, ComSignalType=UINT16, ComHandleId=19, ComSystemTemplateSystemSignalRef=CAN1_VCUVehSpd
        GRCAN1_SG_FD1_C10_0_207737041T: ComSignalGroupDirection=SEND, ComTransferProperty=PENDING, ComHandleId=5, ComSystemTemplateSignalGroupRef=CAN1_SG_FD1_C10_0
          CAN1_VehActDriveDirect_207737041T (ComGroupSignal):
            ComBitPosition = 0
            ComBitSize = 2
            ComSignalEndianness = LITTLE_ENDIAN
            ComSignalInitValue = 0
            ComSignalLength = (unset)
            ComSignalType = UINT8
            ComTimeoutSubstitutionValue = (unset)
            ComTransferProperty = TRIGGERED_ON_CHANGE
            ComHandleId = 20
            ComSystemTemplateSystemSignalRef = CAN1_VehActDriveDirect
        GRCAN1_SG_FD1_C10_1_419373295T: ComSignalGroupDirection=SEND, ComTransferProperty=PENDING, ComHandleId=6, ComSystemTemplateSignalGroupRef=CAN1_SG_FD1_C10_1
          8 x ComGroupSignal, all with ComSignalEndianness=LITTLE_ENDIAN, ComSignalLength=(unset), ComTimeoutSubstitutionValue=(unset), ComTransferProperty=TRIGGERED_ON_CHANGE:
            CAN1_ActEMOutSftSpd_419373295T: ComBitPosition=16, ComBitSize=16, ComSignalInitValue=0, ComSignalType=UINT16, ComHandleId=21, ComSystemTemplateSystemSignalRef=CAN1_ActEMOutSftSpd
            CAN1_ActEMpTrq_419373295T: ComBitPosition=8, ComBitSize=8, ComSignalInitValue=0, ComSignalType=UINT8, ComHandleId=22, ComSystemTemplateSystemSignalRef=CAN1_ActEMpTrq
            CAN1_ActEMpTrqHrls_419373295T: ComBitPosition=4, ComBitSize=4, ComSignalInitValue=0, ComSignalType=UINT8, ComHandleId=23, ComSystemTemplateSystemSignalRef=CAN1_ActEMpTrqHrls
            CAN1_ActMaxAvaEMRecpTrq_419373295T: ComBitPosition=56, ComBitSize=8, ComSignalInitValue=125, ComSignalType=UINT8, ComHandleId=24, ComSystemTemplateSystemSignalRef=CAN1_ActMaxAvaEMRecpTrq
            CAN1_DrvDemEMRtapTrq_419373295T: ComBitPosition=32, ComBitSize=8, ComSignalInitValue=125, ComSignalType=UINT8, ComHandleId=25, ComSystemTemplateSystemSignalRef=CAN1_DrvDemEMRtapTrq
            CAN1_EMTrqModeDrvBrk_419373295T: ComBitPosition=0, ComBitSize=4, ComSignalInitValue=0, ComSignalType=UINT8, ComHandleId=26, ComSystemTemplateSystemSignalRef=CAN1_EMTrqModeDrvBrk
            CAN1_RetSelNonEng_419373295T: ComBitPosition=48, ComBitSize=8, ComSignalInitValue=125, ComSignalType=UINT8, ComHandleId=27, ComSystemTemplateSystemSignalRef=CAN1_RetSelNonEng
            CAN1_SACtrlDev_419373295T: ComBitPosition=40, ComBitSize=8, ComSignalInitValue=0, ComSignalType=UINT8, ComHandleId=28, ComSystemTemplateSystemSignalRef=CAN1_SACtrlDev
        GRCAN1_SG_FD1_C200_0_418382831T: ComSignalGroupDirection=SEND, ComTransferProperty=PENDING, ComHandleId=7, ComSystemTemplateSignalGroupRef=CAN1_SG_FD1_C200_0
          CAN1_SysPowerMode_418382831T (ComGroupSignal):
            ComBitPosition = 0
            ComBitSize = 4
            ComSignalEndianness = LITTLE_ENDIAN
            ComSignalInitValue = 0
            ComSignalLength = (unset)
            ComSignalType = UINT8
            ComTimeoutSubstitutionValue = (unset)
            ComTransferProperty = TRIGGERED_ON_CHANGE
            ComHandleId = 29
            ComSystemTemplateSystemSignalRef = CAN1_SysPowerMode
        GRCAN1_SG_FD1_C20_0_207802577T: ComSignalGroupDirection=SEND, ComTransferProperty=PENDING, ComHandleId=8, ComSystemTemplateSignalGroupRef=CAN1_SG_FD1_C20_0
          4 x ComGroupSignal, all with ComSignalEndianness=LITTLE_ENDIAN, ComSignalLength=(unset), ComSignalType=UINT16, ComTimeoutSubstitutionValue=(unset), ComTransferProperty=TRIGGERED_ON_CHANGE:
            CAN1_DCCurr_207802577T: ComBitPosition=0, ComBitSize=16, ComSignalInitValue=32768, ComHandleId=30, ComSystemTemplateSystemSignalRef=CAN1_DCCurr
            CAN1_DCVol_207802577T: ComBitPosition=16, ComBitSize=12, ComSignalInitValue=0, ComHandleId=31, ComSystemTemplateSystemSignalRef=CAN1_DCVol
            CAN1_MaxTorqAvail_207802577T: ComBitPosition=28, ComBitSize=12, ComSignalInitValue=125, ComHandleId=32, ComSystemTemplateSystemSignalRef=CAN1_MaxTorqAvail
            CAN1_MinTorqAvail_207802577T: ComBitPosition=40, ComBitSize=12, ComSignalInitValue=125, ComHandleId=33, ComSystemTemplateSystemSignalRef=CAN1_MinTorqAvail
        GRCAN1_SG_FD1_C250_0_419356655T: ComSignalGroupDirection=SEND, ComTransferProperty=PENDING, ComHandleId=9, ComSystemTemplateSignalGroupRef=CAN1_SG_FD1_C250_0
          CAN1_EMParasLoss_419356655T (ComGroupSignal):
            ComBitPosition = 32
            ComBitSize = 8
            ComSignalEndianness = LITTLE_ENDIAN
            ComSignalInitValue = 125
            ComSignalLength = (unset)
            ComSignalType = UINT8
            ComTimeoutSubstitutionValue = (unset)
            ComTransferProperty = TRIGGERED_ON_CHANGE
            ComHandleId = 34
            ComSystemTemplateSystemSignalRef = CAN1_EMParasLoss
          CAN1_NFricPercTorq_419356655T (ComGroupSignal):
            ComBitPosition = 0
            ComBitSize = 8
            ComSignalEndianness = LITTLE_ENDIAN
            ComSignalInitValue = 125
            ComSignalLength = (unset)
            ComSignalType = UINT8
            ComTimeoutSubstitutionValue = (unset)
            ComTransferProperty = TRIGGERED_ON_CHANGE
            ComHandleId = 35
            ComSystemTemplateSystemSignalRef = CAN1_NFricPercTorq
        GRCAN1_SG_FD1_C5000_0_419357167T: ComSignalGroupDirection=SEND, ComTransferProperty=PENDING, ComHandleId=10, ComSystemTemplateSignalGroupRef=CAN1_SG_FD1_C5000_0
          14 x ComGroupSignal, all with ComSignalEndianness=LITTLE_ENDIAN, ComSignalInitValue=0, ComSignalLength=(unset), ComTimeoutSubstitutionValue=(unset), ComTransferProperty=TRIGGERED_ON_CHANGE:
            CAN1_RC1MaxRetSpdP2_419357167T: ComBitPosition=40, ComBitSize=16, ComSignalType=UINT16, ComHandleId=36, ComSystemTemplateSystemSignalRef=CAN1_RC1MaxRetSpdP2
            CAN1_RC1PctTrqIdleP1_419357167T: ComBitPosition=32, ComBitSize=8, ComSignalType=UINT8, ComHandleId=37, ComSystemTemplateSystemSignalRef=CAN1_RC1PctTrqIdleP1
            CAN1_RC1PctTrqMaxSpdP2_419357167T: ComBitPosition=56, ComBitSize=8, ComSignalType=UINT8, ComHandleId=38, ComSystemTemplateSystemSignalRef=CAN1_RC1PctTrqMaxSpdP2
            CAN1_RC1PctTrqP3_419357167T: ComBitPosition=80, ComBitSize=8, ComSignalType=UINT8, ComHandleId=39, ComSystemTemplateSystemSignalRef=CAN1_RC1PctTrqP3
            CAN1_RC1PctTrqP4_419357167T: ComBitPosition=104, ComBitSize=8, ComSignalType=UINT8, ComHandleId=40, ComSystemTemplateSystemSignalRef=CAN1_RC1PctTrqP4
            CAN1_RC1PctTrqPekTrqP5_419357167T: ComBitPosition=144, ComBitSize=8, ComSignalType=UINT8, ComHandleId=41, ComSystemTemplateSystemSignalRef=CAN1_RC1PctTrqPekTrqP5
            CAN1_RC1RefRetTrq_419357167T: ComBitPosition=128, ComBitSize=16, ComSignalType=UINT16, ComHandleId=42, ComSystemTemplateSystemSignalRef=CAN1_RC1RefRetTrq
            CAN1_RC1RetCtrlMth_419357167T: ComBitPosition=8, ComBitSize=8, ComSignalType=UINT8, ComHandleId=43, ComSystemTemplateSystemSignalRef=CAN1_RC1RetCtrlMth
            CAN1_RC1RetLocat_419357167T: ComBitPosition=4, ComBitSize=4, ComSignalType=UINT8, ComHandleId=44, ComSystemTemplateSystemSignalRef=CAN1_RC1RetLocat
            CAN1_RC1RetSpdIdleP1_419357167T: ComBitPosition=16, ComBitSize=16, ComSignalType=UINT16, ComHandleId=45, ComSystemTemplateSystemSignalRef=CAN1_RC1RetSpdIdleP1
            CAN1_RC1RetSpdP3_419357167T: ComBitPosition=64, ComBitSize=16, ComSignalType=UINT16, ComHandleId=46, ComSystemTemplateSystemSignalRef=CAN1_RC1RetSpdP3
            CAN1_RC1RetSpdP4_419357167T: ComBitPosition=88, ComBitSize=16, ComSignalType=UINT16, ComHandleId=47, ComSystemTemplateSystemSignalRef=CAN1_RC1RetSpdP4
            CAN1_RC1RetSpdPekTrqP5_419357167T: ComBitPosition=112, ComBitSize=16, ComSignalType=UINT16, ComHandleId=48, ComSystemTemplateSystemSignalRef=CAN1_RC1RetSpdPekTrqP5
            CAN1_RC1RetType_419357167T: ComBitPosition=0, ComBitSize=4, ComSignalType=UINT8, ComHandleId=49, ComSystemTemplateSystemSignalRef=CAN1_RC1RetType
        GRCAN1_SG_FD1_C5000_1_419357679T: ComSignalGroupDirection=SEND, ComTransferProperty=PENDING, ComHandleId=11, ComSystemTemplateSignalGroupRef=CAN1_SG_FD1_C5000_1
          27 x ComGroupSignal, all with ComSignalEndianness=LITTLE_ENDIAN, ComSignalInitValue=0, ComSignalLength=(unset), ComTimeoutSubstitutionValue=(unset), ComTransferProperty=TRIGGERED_ON_CHANGE:
            CAN1_EMDefTrqLmt_419357679T: ComBitPosition=256, ComBitSize=16, ComSignalType=UINT16, ComHandleId=50, ComSystemTemplateSystemSignalRef=CAN1_EMDefTrqLmt
            CAN1_EMEMRefTorq_419357679T: ComBitPosition=152, ComBitSize=16, ComSignalType=UINT16, ComHandleId=51, ComSystemTemplateSystemSignalRef=CAN1_EMEMRefTorq
            CAN1_EMEMSpdP2_419357679T: ComBitPosition=24, ComBitSize=16, ComSignalType=UINT16, ComHandleId=52, ComSystemTemplateSystemSignalRef=CAN1_EMEMSpdP2
            CAN1_EMEMSpdP3_419357679T: ComBitPosition=48, ComBitSize=16, ComSignalType=UINT16, ComHandleId=53, ComSystemTemplateSystemSignalRef=CAN1_EMEMSpdP3
            CAN1_EMEMSpdP4_419357679T: ComBitPosition=72, ComBitSize=16, ComSignalType=UINT16, ComHandleId=54, ComSystemTemplateSystemSignalRef=CAN1_EMEMSpdP4
            CAN1_EMEMSpdP5_419357679T: ComBitPosition=96, ComBitSize=16, ComSignalType=UINT16, ComHandleId=55, ComSystemTemplateSystemSignalRef=CAN1_EMEMSpdP5
            CAN1_EMExtRSCtrlUpLmt_419357679T: ComBitPosition=224, ComBitSize=16, ComSignalType=UINT16, ComHandleId=56, ComSystemTemplateSystemSignalRef=CAN1_EMExtRSCtrlUpLmt
            CAN1_EMGainEndSpdGvn_419357679T: ComBitPosition=136, ComBitSize=16, ComSignalType=UINT16, ComHandleId=57, ComSystemTemplateSystemSignalRef=CAN1_EMGainEndSpdGvn
            CAN1_EMMaxMEngOvrSP7_419357679T: ComBitPosition=168, ComBitSize=16, ComSignalType=UINT16, ComHandleId=58, ComSystemTemplateSystemSignalRef=CAN1_EMMaxMEngOvrSP7
            CAN1_EMMaxMOvrTLmt_419357679T: ComBitPosition=184, ComBitSize=8, ComSignalType=UINT8, ComHandleId=59, ComSystemTemplateSystemSignalRef=CAN1_EMMaxMOvrTLmt
            CAN1_EMMomOfInertia_419357679T: ComBitPosition=240, ComBitSize=16, ComSignalType=UINT16, ComHandleId=60, ComSystemTemplateSystemSignalRef=CAN1_EMMomOfInertia
            CAN1_EMPercTorqIdleP1_419357679T: ComBitPosition=16, ComBitSize=8, ComSignalType=UINT8, ComHandleId=61, ComSystemTemplateSystemSignalRef=CAN1_EMPercTorqIdleP1
            CAN1_EMPercTorqP2_419357679T: ComBitPosition=40, ComBitSize=8, ComSignalType=UINT8, ComHandleId=62, ComSystemTemplateSystemSignalRef=CAN1_EMPercTorqP2
            CAN1_EMPercTorqP3_419357679T: ComBitPosition=64, ComBitSize=8, ComSignalType=UINT8, ComHandleId=63, ComSystemTemplateSystemSignalRef=CAN1_EMPercTorqP3
            CAN1_EMPercTorqP4_419357679T: ComBitPosition=88, ComBitSize=8, ComSignalType=UINT8, ComHandleId=64, ComSystemTemplateSystemSignalRef=CAN1_EMPercTorqP4
            CAN1_EMPercTorqP5_419357679T: ComBitPosition=112, ComBitSize=8, ComSignalType=UINT8, ComHandleId=65, ComSystemTemplateSystemSignalRef=CAN1_EMPercTorqP5
            CAN1_EMReqSpdCtrlLoLmt_419357679T: ComBitPosition=192, ComBitSize=8, ComSignalType=UINT8, ComHandleId=66, ComSystemTemplateSystemSignalRef=CAN1_EMReqSpdCtrlLoLmt
            CAN1_EMReqSpdCtrlUpLmt_419357679T: ComBitPosition=200, ComBitSize=8, ComSignalType=UINT8, ComHandleId=67, ComSystemTemplateSystemSignalRef=CAN1_EMReqSpdCtrlUpLmt
            CAN1_EMReqTrqCtrlLoLmt_419357679T: ComBitPosition=208, ComBitSize=8, ComSignalType=UINT8, ComHandleId=68, ComSystemTemplateSystemSignalRef=CAN1_EMReqTrqCtrlLoLmt
            CAN1_EMReqTrqCtrlUpLmt_419357679T: ComBitPosition=216, ComBitSize=8, ComSignalType=UINT8, ComHandleId=69, ComSystemTemplateSystemSignalRef=CAN1_EMReqTrqCtrlUpLmt
            CAN1_EMSpdHIdleP6_419357679T: ComBitPosition=120, ComBitSize=16, ComSignalType=UINT16, ComHandleId=70, ComSystemTemplateSystemSignalRef=CAN1_EMSpdHIdleP6
            CAN1_EMSpdIdleP1_419357679T: ComBitPosition=0, ComBitSize=16, ComSignalType=UINT16, ComHandleId=71, ComSystemTemplateSystemSignalRef=CAN1_EMSpdIdleP1
            CAN1_EMSupTSC1CtrlPG1_419357679T: ComBitPosition=280, ComBitSize=8, ComSignalType=UINT8, ComHandleId=72, ComSystemTemplateSystemSignalRef=CAN1_EMSupTSC1CtrlPG1
            CAN1_EMSupTSC1CtrlPG2_419357679T: ComBitPosition=288, ComBitSize=8, ComSignalType=UINT8, ComHandleId=73, ComSystemTemplateSystemSignalRef=CAN1_EMSupTSC1CtrlPG2
            CAN1_EMSupTSC1CtrlPG3_419357679T: ComBitPosition=296, ComBitSize=8, ComSignalType=UINT8, ComHandleId=74, ComSystemTemplateSystemSignalRef=CAN1_EMSupTSC1CtrlPG3
            CAN1_EMSupTSC1CtrlPG4_419357679T: ComBitPosition=304, ComBitSize=8, ComSignalType=UINT8, ComHandleId=75, ComSystemTemplateSystemSignalRef=CAN1_EMSupTSC1CtrlPG4
            CAN1_EMSupVarRTSC1MSG_419357679T: ComBitPosition=272, ComBitSize=8, ComSignalType=UINT8, ComHandleId=76, ComSystemTemplateSystemSignalRef=CAN1_EMSupVarRTSC1MSG
        GRCAN1_SG_FD1_C50_0_418383107T: ComSignalGroupDirection=SEND, ComTransferProperty=PENDING, ComHandleId=12, ComSystemTemplateSignalGroupRef=CAN1_SG_FD1_C50_0
          CAN1_ActDriveDirect_418383107T (ComGroupSignal):
            ComBitPosition = 24
            ComBitSize = 8
            ComSignalEndianness = LITTLE_ENDIAN
            ComSignalInitValue = 0
            ComSignalLength = (unset)
            ComSignalType = UINT8
            ComTimeoutSubstitutionValue = (unset)
            ComTransferProperty = TRIGGERED_ON_CHANGE
            ComHandleId = 77
            ComSystemTemplateSystemSignalRef = CAN1_ActDriveDirect
        GRCAN1_SG_FD1_C50_1_217056000T: ComSignalGroupDirection=SEND, ComTransferProperty=PENDING, ComHandleId=13, ComSystemTemplateSignalGroupRef=CAN1_SG_FD1_C50_1
          4 x ComGroupSignal, all with ComSignalEndianness=LITTLE_ENDIAN, ComSignalInitValue=0, ComSignalLength=(unset), ComSignalType=UINT8, ComTimeoutSubstitutionValue=(unset), ComTransferProperty=TRIGGERED_ON_CHANGE:
            CAN1_AccPedal1LowSW_217056000T: ComBitPosition=0, ComBitSize=2, ComHandleId=78, ComSystemTemplateSystemSignalRef=CAN1_AccPedal1LowSW
            CAN1_AccPedalPos1_217056000T: ComBitPosition=8, ComBitSize=8, ComHandleId=79, ComSystemTemplateSystemSignalRef=CAN1_AccPedalPos1
            CAN1_EEC2MSGCS_217056000T: ComBitPosition=60, ComBitSize=4, ComHandleId=80, ComSystemTemplateSystemSignalRef=CAN1_EEC2MSGCS
            CAN1_EEC2MSGCnt_217056000T: ComBitPosition=56, ComBitSize=4, ComHandleId=81, ComSystemTemplateSystemSignalRef=CAN1_EEC2MSGCnt
        GRCAN1_SG_FD1_C80_0_418382339T: ComSignalGroupDirection=SEND, ComTransferProperty=PENDING, ComHandleId=14, ComSystemTemplateSignalGroupRef=CAN1_SG_FD1_C80_0
          CAN1_DLEngaged_418382339T (ComGroupSignal):
            ComBitPosition = 0
            ComBitSize = 2
            ComSignalEndianness = LITTLE_ENDIAN
            ComSignalInitValue = 0
            ComSignalLength = (unset)
            ComSignalType = UINT8
            ComTimeoutSubstitutionValue = (unset)
            ComTransferProperty = TRIGGERED_ON_CHANGE
            ComHandleId = 82
            ComSystemTemplateSystemSignalRef = CAN1_DLEngaged
          CAN1_ShiftPgs_418382339T (ComGroupSignal):
            ComBitPosition = 4
            ComBitSize = 2
            ComSignalEndianness = LITTLE_ENDIAN
            ComSignalInitValue = 0
            ComSignalLength = (unset)
            ComSignalType = UINT8
            ComTimeoutSubstitutionValue = (unset)
            ComTransferProperty = TRIGGERED_ON_CHANGE
            ComHandleId = 83
            ComSystemTemplateSystemSignalRef = CAN1_ShiftPgs
        GRCAN1_SG_FD1_CE100_0_418119663T: ComSignalGroupDirection=SEND, ComTransferProperty=TRIGGERED, ComHandleId=15, ComSystemTemplateSignalGroupRef=CAN1_SG_FD1_CE100_0
          8 x ComGroupSignal, all with ComBitSize=8, ComSignalEndianness=LITTLE_ENDIAN, ComSignalInitValue=0, ComSignalLength=(unset), ComSignalType=UINT8, ComTimeoutSubstitutionValue=(unset), ComTransferProperty=TRIGGERED_ON_CHANGE:
            CAN1_CFGEM1DT0_418119663T: ComBitPosition=0, ComHandleId=84, ComSystemTemplateSystemSignalRef=CAN1_CFGEM1DT0
            CAN1_CFGEM1DT1_418119663T: ComBitPosition=8, ComHandleId=85, ComSystemTemplateSystemSignalRef=CAN1_CFGEM1DT1
            CAN1_CFGEM1DT2_418119663T: ComBitPosition=16, ComHandleId=86, ComSystemTemplateSystemSignalRef=CAN1_CFGEM1DT2
            CAN1_CFGEM1DT3_418119663T: ComBitPosition=24, ComHandleId=87, ComSystemTemplateSystemSignalRef=CAN1_CFGEM1DT3
            CAN1_CFGEM1DT4_418119663T: ComBitPosition=32, ComHandleId=88, ComSystemTemplateSystemSignalRef=CAN1_CFGEM1DT4
            CAN1_CFGEM1DT5_418119663T: ComBitPosition=40, ComHandleId=89, ComSystemTemplateSystemSignalRef=CAN1_CFGEM1DT5
            CAN1_CFGEM1DT6_418119663T: ComBitPosition=48, ComHandleId=90, ComSystemTemplateSystemSignalRef=CAN1_CFGEM1DT6
            CAN1_CFGEM1DT7_418119663T: ComBitPosition=56, ComHandleId=91, ComSystemTemplateSystemSignalRef=CAN1_CFGEM1DT7
        GRCAN1_SG_FD1_CE100_1_418185199T: ComSignalGroupDirection=SEND, ComTransferProperty=TRIGGERED, ComHandleId=16, ComSystemTemplateSignalGroupRef=CAN1_SG_FD1_CE100_1
          5 x ComGroupSignal, all with ComSignalEndianness=LITTLE_ENDIAN, ComSignalInitValue=0, ComSignalLength=(unset), ComTimeoutSubstitutionValue=(unset), ComTransferProperty=TRIGGERED_ON_CHANGE:
            CAN1_CFGEM1BAMPGN_418185199T: ComBitPosition=40, ComBitSize=24, ComSignalType=UINT32, ComHandleId=92, ComSystemTemplateSystemSignalRef=CAN1_CFGEM1BAMPGN
            CAN1_CFGEM1BAMRsv_418185199T: ComBitPosition=32, ComBitSize=8, ComSignalType=UINT8, ComHandleId=93, ComSystemTemplateSystemSignalRef=CAN1_CFGEM1BAMRsv
            CAN1_CFGEM1BAMTNum_418185199T: ComBitPosition=24, ComBitSize=8, ComSignalType=UINT8, ComHandleId=94, ComSystemTemplateSystemSignalRef=CAN1_CFGEM1BAMTNum
            CAN1_CFGEM1BAMTSize_418185199T: ComBitPosition=8, ComBitSize=16, ComSignalType=UINT16, ComHandleId=95, ComSystemTemplateSystemSignalRef=CAN1_CFGEM1BAMTSize
            CAN1_CFGEM1Ctrl_418185199T: ComBitPosition=0, ComBitSize=8, ComSignalType=UINT8, ComHandleId=96, ComSystemTemplateSystemSignalRef=CAN1_CFGEM1Ctrl
        GRCAN1_SG_FD1_CE100_2_419038649T: ComSignalGroupDirection=SEND, ComTransferProperty=TRIGGERED_ON_CHANGE, ComHandleId=17, ComSystemTemplateSignalGroupRef=CAN1_SG_FD1_CE100_2
          4 x ComGroupSignal, all with ComBitSize=1, ComSignalEndianness=LITTLE_ENDIAN, ComSignalInitValue=0, ComSignalLength=(unset), ComSignalType=UINT8, ComTimeoutSubstitutionValue=(unset), ComTransferProperty=TRIGGERED_ON_CHANGE:
            CAN1_FDC_BCM_DVRSignalL_Cmd_419038649T: ComBitPosition=13, ComHandleId=97, ComSystemTemplateSystemSignalRef=CAN1_FDC_BCM_DVRSignalL_Cmd
            CAN1_FDC_BCM_DVRSignalR_Cmd_419038649T: ComBitPosition=14, ComHandleId=98, ComSystemTemplateSystemSignalRef=CAN1_FDC_BCM_DVRSignalR_Cmd
            CAN1_FDC_BCM_LTurnLp_Cmd_419038649T: ComBitPosition=6, ComHandleId=99, ComSystemTemplateSystemSignalRef=CAN1_FDC_BCM_LTurnLp_Cmd
            CAN1_FDC_BCM_RTurnLp_Cmd_419038649T: ComBitPosition=44, ComHandleId=100, ComSystemTemplateSystemSignalRef=CAN1_FDC_BCM_RTurnLp_Cmd
        GRCAN2_SG_FD2_C1000_0_526T: ComSignalGroupDirection=SEND, ComTransferProperty=PENDING, ComHandleId=18, ComSystemTemplateSignalGroupRef=CAN2_SG_FD2_C1000_0
          40 x ComGroupSignal, all with ComSignalEndianness=BIG_ENDIAN, ComSignalInitValue=0, ComSignalLength=(unset), ComSignalType=UINT8, ComTimeoutSubstitutionValue=(unset), ComTransferProperty=TRIGGERED_ON_CHANGE:
            CAN2_ACMODESta_526T: ComBitPosition=29, ComBitSize=2, ComHandleId=101, ComSystemTemplateSystemSignalRef=CAN2_ACMODESta
            CAN2_LBIBatWarn_526T: ComBitPosition=48, ComBitSize=1, ComHandleId=102, ComSystemTemplateSystemSignalRef=CAN2_LBIBatWarn
            CAN2_LBIPressIndi_526T: ComBitPosition=23, ComBitSize=2, ComHandleId=103, ComSystemTemplateSystemSignalRef=CAN2_LBIPressIndi
            CAN2_LBISensorFail_526T: ComBitPosition=24, ComBitSize=1, ComHandleId=104, ComSystemTemplateSystemSignalRef=CAN2_LBISensorFail
            CAN2_LBIWheelPress_526T: ComBitPosition=95, ComBitSize=8, ComHandleId=105, ComSystemTemplateSystemSignalRef=CAN2_LBIWheelPress
            CAN2_LBIWheelTemp_526T: ComBitPosition=39, ComBitSize=8, ComHandleId=106, ComSystemTemplateSystemSignalRef=CAN2_LBIWheelTemp
            CAN2_LBIWheelTmpIndi_526T: ComBitPosition=41, ComBitSize=1, ComHandleId=107, ComSystemTemplateSystemSignalRef=CAN2_LBIWheelTmpIndi
            CAN2_LBOBatWarn_526T: ComBitPosition=85, ComBitSize=1, ComHandleId=108, ComSystemTemplateSystemSignalRef=CAN2_LBOBatWarn
            CAN2_LBOPressIndi_526T: ComBitPosition=31, ComBitSize=2, ComHandleId=109, ComSystemTemplateSystemSignalRef=CAN2_LBOPressIndi
            CAN2_LBOSensorFail_526T: ComBitPosition=26, ComBitSize=1, ComHandleId=110, ComSystemTemplateSystemSignalRef=CAN2_LBOSensorFail
            CAN2_LBOWheelPress_526T: ComBitPosition=143, ComBitSize=8, ComHandleId=111, ComSystemTemplateSystemSignalRef=CAN2_LBOWheelPress
            CAN2_LBOWheelTemp_526T: ComBitPosition=135, ComBitSize=8, ComHandleId=112, ComSystemTemplateSystemSignalRef=CAN2_LBOWheelTemp
            CAN2_LBOWheelTmpIndi_526T: ComBitPosition=51, ComBitSize=1, ComHandleId=113, ComSystemTemplateSystemSignalRef=CAN2_LBOWheelTmpIndi
            CAN2_LFBatWarn_526T: ComBitPosition=46, ComBitSize=1, ComHandleId=114, ComSystemTemplateSystemSignalRef=CAN2_LFBatWarn
            CAN2_LFPressIndi_526T: ComBitPosition=19, ComBitSize=2, ComHandleId=115, ComSystemTemplateSystemSignalRef=CAN2_LFPressIndi
            CAN2_LFSensorFail_526T: ComBitPosition=43, ComBitSize=1, ComHandleId=116, ComSystemTemplateSystemSignalRef=CAN2_LFSensorFail
            CAN2_LFWheelPress_526T: ComBitPosition=71, ComBitSize=8, ComHandleId=117, ComSystemTemplateSystemSignalRef=CAN2_LFWheelPress
            CAN2_LFWheelTemp_526T: ComBitPosition=119, ComBitSize=8, ComHandleId=118, ComSystemTemplateSystemSignalRef=CAN2_LFWheelTemp
            CAN2_LFWheelTmpIndi_526T: ComBitPosition=55, ComBitSize=1, ComHandleId=119, ComSystemTemplateSystemSignalRef=CAN2_LFWheelTmpIndi
            CAN2_RBIBatWarn_526T: ComBitPosition=84, ComBitSize=1, ComHandleId=120, ComSystemTemplateSystemSignalRef=CAN2_RBIBatWarn
            CAN2_RBIPressIndi_526T: ComBitPosition=53, ComBitSize=2, ComHandleId=121, ComSystemTemplateSystemSignalRef=CAN2_RBIPressIndi
            CAN2_RBISensorFail_526T: ComBitPosition=25, ComBitSize=1, ComHandleId=122, ComSystemTemplateSystemSignalRef=CAN2_RBISensorFail
            CAN2_RBIWheelPress_526T: ComBitPosition=103, ComBitSize=8, ComHandleId=123, ComSystemTemplateSystemSignalRef=CAN2_RBIWheelPress
            CAN2_RBIWheelTmpIndi_526T: ComBitPosition=40, ComBitSize=1, ComHandleId=124, ComSystemTemplateSystemSignalRef=CAN2_RBIWheelTmpIndi
            CAN2_RBOBatWarn_526T: ComBitPosition=50, ComBitSize=1, ComHandleId=125, ComSystemTemplateSystemSignalRef=CAN2_RBOBatWarn
            CAN2_RBOPressIndi_526T: ComBitPosition=17, ComBitSize=2, ComHandleId=126, ComSystemTemplateSystemSignalRef=CAN2_RBOPressIndi
            CAN2_RBOSensorFail_526T: ComBitPosition=27, ComBitSize=1, ComHandleId=127, ComSystemTemplateSystemSignalRef=CAN2_RBOSensorFail
            CAN2_RBOWheelPress_526T: ComBitPosition=63, ComBitSize=8, ComHandleId=128, ComSystemTemplateSystemSignalRef=CAN2_RBOWheelPress
            CAN2_RBOWheelTemp_526T: ComBitPosition=127, ComBitSize=8, ComHandleId=129, ComSystemTemplateSystemSignalRef=CAN2_RBOWheelTemp
            CAN2_RBOWheelTmpIndi_526T: ComBitPosition=49, ComBitSize=1, ComHandleId=130, ComSystemTemplateSystemSignalRef=CAN2_RBOWheelTmpIndi
            CAN2_RFBatWarn_526T: ComBitPosition=47, ComBitSize=1, ComHandleId=131, ComSystemTemplateSystemSignalRef=CAN2_RFBatWarn
            CAN2_RFPressIndi_526T: ComBitPosition=21, ComBitSize=2, ComHandleId=132, ComSystemTemplateSystemSignalRef=CAN2_RFPressIndi
            CAN2_RFSensorFail_526T: ComBitPosition=42, ComBitSize=1, ComHandleId=133, ComSystemTemplateSystemSignalRef=CAN2_RFSensorFail
            CAN2_RFWheelPress_526T: ComBitPosition=79, ComBitSize=8, ComHandleId=134, ComSystemTemplateSystemSignalRef=CAN2_RFWheelPress
            CAN2_RFWheelTemp_526T: ComBitPosition=111, ComBitSize=8, ComHandleId=135, ComSystemTemplateSystemSignalRef=CAN2_RFWheelTemp
            CAN2_RFWheelTmpIndi_526T: ComBitPosition=54, ComBitSize=1, ComHandleId=136, ComSystemTemplateSystemSignalRef=CAN2_RFWheelTmpIndi
            CAN2_THCM_Faultlv_Sta_526T: ComBitPosition=45, ComBitSize=2, ComHandleId=137, ComSystemTemplateSystemSignalRef=CAN2_THCM_Faultlv_Sta
            CAN2_TPMSWarnIndi_526T: ComBitPosition=87, ComBitSize=2, ComHandleId=138, ComSystemTemplateSystemSignalRef=CAN2_TPMSWarnIndi
            CAN2_VCUVehAcclLimit_526T: ComBitPosition=15, ComBitSize=8, ComHandleId=139, ComSystemTemplateSystemSignalRef=CAN2_VCUVehAcclLimit
            CAN2_VCUVehSpdlimit_526T: ComBitPosition=7, ComBitSize=8, ComHandleId=140, ComSystemTemplateSystemSignalRef=CAN2_VCUVehSpdlimit
        GRCAN2_SG_FD2_C10_0_207737041T: ComSignalGroupDirection=SEND, ComTransferProperty=PENDING, ComHandleId=19, ComSystemTemplateSignalGroupRef=CAN2_SG_FD2_C10_0
          13 x ComGroupSignal, all with ComSignalEndianness=LITTLE_ENDIAN, ComSignalInitValue=0, ComSignalLength=(unset), ComTimeoutSubstitutionValue=(unset), ComTransferProperty=TRIGGERED_ON_CHANGE:
            CAN2_ActDriveMode_207737041T: ComBitPosition=2, ComBitSize=2, ComSignalType=UINT8, ComHandleId=141, ComSystemTemplateSystemSignalRef=CAN2_ActDriveMode
            CAN2_CeTraxSysReady_207737041T: ComBitPosition=36, ComBitSize=1, ComSignalType=UINT8, ComHandleId=142, ComSystemTemplateSystemSignalRef=CAN2_CeTraxSysReady
            CAN2_CreeperSta_207737041T: ComBitPosition=39, ComBitSize=2, ComSignalType=UINT8, ComHandleId=143, ComSystemTemplateSystemSignalRef=CAN2_CreeperSta
            CAN2_EBrakeTorqLow_207737041T: ComBitPosition=38, ComBitSize=1, ComSignalType=UINT8, ComHandleId=144, ComSystemTemplateSystemSignalRef=CAN2_EBrakeTorqLow
            CAN2_EMotorOverSpd_207737041T: ComBitPosition=48, ComBitSize=2, ComSignalType=UINT8, ComHandleId=145, ComSystemTemplateSystemSignalRef=CAN2_EMotorOverSpd
            CAN2_EMotorPerformance_207737041T: ComBitPosition=24, ComBitSize=12, ComSignalType=UINT16, ComHandleId=146, ComSystemTemplateSystemSignalRef=CAN2_EMotorPerformance
            CAN2_EMotorSpd_207737041T: ComBitPosition=8, ComBitSize=16, ComSignalType=UINT16, ComHandleId=147, ComSystemTemplateSystemSignalRef=CAN2_EMotorSpd
            CAN2_EVECU1MSGCS_207737041T: ComBitPosition=60, ComBitSize=4, ComSignalType=UINT8, ComHandleId=148, ComSystemTemplateSystemSignalRef=CAN2_EVECU1MSGCS
            CAN2_EVECU1MSGCnt_207737041T: ComBitPosition=56, ComBitSize=4, ComSignalType=UINT8, ComHandleId=149, ComSystemTemplateSystemSignalRef=CAN2_EVECU1MSGCnt
            CAN2_RecuperHighSta_207737041T: ComBitPosition=43, ComBitSize=1, ComSignalType=UINT8, ComHandleId=150, ComSystemTemplateSystemSignalRef=CAN2_RecuperHighSta
            CAN2_TUpASta_207737041T: ComBitPosition=41, ComBitSize=2, ComSignalType=UINT8, ComHandleId=151, ComSystemTemplateSystemSignalRef=CAN2_TUpASta
            CAN2_VehActDriveDirect_207737041T: ComBitPosition=0, ComBitSize=2, ComSignalType=UINT8, ComHandleId=152, ComSystemTemplateSystemSignalRef=CAN2_VehActDriveDirect
            CAN2_WheelSlipdet_207737041T: ComBitPosition=4, ComBitSize=4, ComSignalType=UINT8, ComHandleId=153, ComSystemTemplateSystemSignalRef=CAN2_WheelSlipdet
        GRCAN2_SG_FD2_C200_0_527T: ComSignalGroupDirection=SEND, ComTransferProperty=PENDING, ComHandleId=20, ComSystemTemplateSignalGroupRef=CAN2_SG_FD2_C200_0
          3 x ComGroupSignal, all with ComSignalEndianness=BIG_ENDIAN, ComSignalInitValue=0, ComSignalLength=(unset), ComSignalType=UINT8, ComTimeoutSubstitutionValue=(unset), ComTransferProperty=TRIGGERED_ON_CHANGE:
            CAN2_CACPresWarn_527T: ComBitPosition=5, ComBitSize=1, ComHandleId=154, ComSystemTemplateSystemSignalRef=CAN2_CACPresWarn
            CAN2_FDC_VCU_VCUDRM_Sta_527T: ComBitPosition=7, ComBitSize=2, ComHandleId=155, ComSystemTemplateSystemSignalRef=CAN2_FDC_VCU_VCUDRM_Sta
            CAN2_SysPowerMode_527T: ComBitPosition=4, ComBitSize=4, ComHandleId=156, ComSystemTemplateSystemSignalRef=CAN2_SysPowerMode
        GRCAN2_SG_FD2_C500_0_419038487T: ComSignalGroupDirection=SEND, ComTransferProperty=PENDING, ComHandleId=21, ComSystemTemplateSignalGroupRef=CAN2_SG_FD2_C500_0
          3 x ComGroupSignal, all with ComSignalEndianness=LITTLE_ENDIAN, ComSignalInitValue=0, ComSignalLength=(unset), ComTimeoutSubstitutionValue=(unset), ComTransferProperty=TRIGGERED_ON_CHANGE:
            CAN2_IGNKeySta_419038487T: ComBitPosition=18, ComBitSize=2, ComSignalType=UINT8, ComHandleId=157, ComSystemTemplateSystemSignalRef=CAN2_IGNKeySta
            CAN2_VCU_VehicleSpd_419038487T: ComBitPosition=48, ComBitSize=16, ComSignalType=UINT16, ComHandleId=158, ComSystemTemplateSystemSignalRef=CAN2_VCU_VehicleSpd
            CAN2_VSPFunc_419038487T: ComBitPosition=0, ComBitSize=8, ComSignalType=UINT8, ComHandleId=159, ComSystemTemplateSystemSignalRef=CAN2_VSPFunc
        GRCAN2_SG_FD2_C50_0_218051930T: ComSignalGroupDirection=SEND, ComTransferProperty=PENDING, ComHandleId=22, ComSystemTemplateSignalGroupRef=CAN2_SG_FD2_C50_0
          9 x ComGroupSignal, all with ComSignalEndianness=LITTLE_ENDIAN, ComSignalInitValue=0, ComSignalLength=(unset), ComSignalType=UINT8, ComTimeoutSubstitutionValue=(unset), ComTransferProperty=TRIGGERED_ON_CHANGE:
            CAN2_EVEHCMSGCS_218051930T: ComBitPosition=60, ComBitSize=4, ComHandleId=160, ComSystemTemplateSystemSignalRef=CAN2_EVEHCMSGCS
            CAN2_EVEHCMSGCnt_218051930T: ComBitPosition=56, ComBitSize=4, ComHandleId=161, ComSystemTemplateSystemSignalRef=CAN2_EVEHCMSGCnt
            CAN2_EVSysRls_218051930T: ComBitPosition=12, ComBitSize=2, ComHandleId=162, ComSystemTemplateSystemSignalRef=CAN2_EVSysRls
            CAN2_ElecSysRdy_218051930T: ComBitPosition=14, ComBitSize=2, ComHandleId=163, ComSystemTemplateSystemSignalRef=CAN2_ElecSysRdy
            CAN2_ExtAccLimReq_218051930T: ComBitPosition=24, ComBitSize=8, ComHandleId=164, ComSystemTemplateSystemSignalRef=CAN2_ExtAccLimReq
            CAN2_ExtDischgReq_218051930T: ComBitPosition=38, ComBitSize=2, ComHandleId=165, ComSystemTemplateSystemSignalRef=CAN2_ExtDischgReq
            CAN2_ExtDriveMReq_218051930T: ComBitPosition=32, ComBitSize=4, ComHandleId=166, ComSystemTemplateSystemSignalRef=CAN2_ExtDriveMReq
            CAN2_ExtWorkshopMReq_218051930T: ComBitPosition=36, ComBitSize=2, ComHandleId=167, ComSystemTemplateSystemSignalRef=CAN2_ExtWorkshopMReq
            CAN2_RecuperLimOrReq_218051930T: ComBitPosition=16, ComBitSize=8, ComHandleId=168, ComSystemTemplateSystemSignalRef=CAN2_RecuperLimOrReq
        GRCAN2_SG_FD2_CE100_0_521T: ComSignalGroupDirection=SEND, ComTransferProperty=TRIGGERED_ON_CHANGE, ComHandleId=23, ComSystemTemplateSignalGroupRef=CAN2_SG_FD2_CE100_0
          52 x ComGroupSignal, all with ComSignalEndianness=BIG_ENDIAN, ComSignalInitValue=0, ComSignalLength=(unset), ComSignalType=UINT8, ComTimeoutSubstitutionValue=(unset):
            CAN2_FDC_BCM_BSD_Buzzer_Cmd_521T: ComBitPosition=39, ComBitSize=1, ComTransferProperty=TRIGGERED_ON_CHANGE, ComHandleId=169, ComSystemTemplateSystemSignalRef=CAN2_FDC_BCM_BSD_Buzzer_Cmd
            CAN2_FDC_BCM_Brake_Cmd_521T: ComBitPosition=30, ComBitSize=1, ComTransferProperty=TRIGGERED_ON_CHANGE, ComHandleId=170, ComSystemTemplateSystemSignalRef=CAN2_FDC_BCM_Brake_Cmd
            CAN2_FDC_BCM_CallBell_Cmd_521T: ComBitPosition=20, ComBitSize=1, ComTransferProperty=TRIGGERED_ON_CHANGE, ComHandleId=171, ComSystemTemplateSystemSignalRef=CAN2_FDC_BCM_CallBell_Cmd
            CAN2_FDC_BCM_DVRSignalL_Cmd_521T: ComBitPosition=52, ComBitSize=1, ComTransferProperty=PENDING, ComHandleId=172, ComSystemTemplateSystemSignalRef=CAN2_FDC_BCM_DVRSignalL_Cmd
            CAN2_FDC_BCM_DVRSignalR_Cmd_521T: ComBitPosition=51, ComBitSize=1, ComTransferProperty=PENDING, ComHandleId=173, ComSystemTemplateSystemSignalRef=CAN2_FDC_BCM_DVRSignalR_Cmd
            CAN2_FDC_BCM_EmExitSW_Sta_521T: ComBitPosition=9, ComBitSize=1, ComTransferProperty=TRIGGERED_ON_CHANGE, ComHandleId=174, ComSystemTemplateSystemSignalRef=CAN2_FDC_BCM_EmExitSW_Sta
            CAN2_FDC_BCM_EmSV_Cmd_521T: ComBitPosition=6, ComBitSize=1, ComTransferProperty=TRIGGERED_ON_CHANGE, ComHandleId=175, ComSystemTemplateSystemSignalRef=CAN2_FDC_BCM_EmSV_Cmd
            CAN2_FDC_BCM_FDCloseSV_Cmd_521T: ComBitPosition=3, ComBitSize=1, ComTransferProperty=TRIGGERED_ON_CHANGE, ComHandleId=176, ComSystemTemplateSystemSignalRef=CAN2_FDC_BCM_FDCloseSV_Cmd
            CAN2_FDC_BCM_FDOpenSV_Cmd_521T: ComBitPosition=2, ComBitSize=1, ComTransferProperty=TRIGGERED_ON_CHANGE, ComHandleId=177, ComSystemTemplateSystemSignalRef=CAN2_FDC_BCM_FDOpenSV_Cmd
            CAN2_FDC_BCM_FDoor_Sta_521T: ComBitPosition=45, ComBitSize=1, ComTransferProperty=TRIGGERED_ON_CHANGE, ComHandleId=178, ComSystemTemplateSystemSignalRef=CAN2_FDC_BCM_FDoor_Sta
            CAN2_FDC_BCM_FRoomLpSet_Sta_521T: ComBitPosition=79, ComBitSize=7, ComTransferProperty=TRIGGERED_ON_CHANGE, ComHandleId=179, ComSystemTemplateSystemSignalRef=CAN2_FDC_BCM_FRoomLpSet_Sta
            CAN2_FDC_BCM_HBeam_Cmd_521T: ComBitPosition=40, ComBitSize=1, ComTransferProperty=TRIGGERED_ON_CHANGE, ComHandleId=180, ComSystemTemplateSystemSignalRef=CAN2_FDC_BCM_HBeam_Cmd
            CAN2_FDC_BCM_HazardSW_Sta_521T: ComBitPosition=15, ComBitSize=1, ComTransferProperty=TRIGGERED_ON_CHANGE, ComHandleId=181, ComSystemTemplateSystemSignalRef=CAN2_FDC_BCM_HazardSW_Sta
            CAN2_FDC_BCM_HelpIND_Cmd_521T: ComBitPosition=12, ComBitSize=1, ComTransferProperty=TRIGGERED_ON_CHANGE, ComHandleId=182, ComSystemTemplateSystemSignalRef=CAN2_FDC_BCM_HelpIND_Cmd
            CAN2_FDC_BCM_InnerBuzzerMode_Sta_521T: ComBitPosition=23, ComBitSize=3, ComTransferProperty=TRIGGERED_ON_CHANGE, ComHandleId=183, ComSystemTemplateSystemSignalRef=CAN2_FDC_BCM_InnerBuzzerMode_Sta
            CAN2_FDC_BCM_InnerBuzzer_Cmd_521T: ComBitPosition=8, ComBitSize=1, ComTransferProperty=TRIGGERED_ON_CHANGE, ComHandleId=184, ComSystemTemplateSystemSignalRef=CAN2_FDC_BCM_InnerBuzzer_Cmd
            CAN2_FDC_BCM_InnerCallBell_Cmd_521T: ComBitPosition=19, ComBitSize=1, ComTransferProperty=TRIGGERED_ON_CHANGE, ComHandleId=185, ComSystemTemplateSystemSignalRef=CAN2_FDC_BCM_InnerCallBell_Cmd
            CAN2_FDC_BCM_LBSDR_Cmd_521T: ComBitPosition=35, ComBitSize=1, ComTransferProperty=TRIGGERED_ON_CHANGE, ComHandleId=186, ComSystemTemplateSystemSignalRef=CAN2_FDC_BCM_LBSDR_Cmd
            CAN2_FDC_BCM_LBSDY_Cmd_521T: ComBitPosition=36, ComBitSize=1, ComTransferProperty=TRIGGERED_ON_CHANGE, ComHandleId=187, ComSystemTemplateSystemSignalRef=CAN2_FDC_BCM_LBSDY_Cmd
            CAN2_FDC_BCM_LBeam_Cmd_521T: ComBitPosition=55, ComBitSize=1, ComTransferProperty=TRIGGERED_ON_CHANGE, ComHandleId=188, ComSystemTemplateSystemSignalRef=CAN2_FDC_BCM_LBeam_Cmd
            CAN2_FDC_BCM_LDRL_Cmd_521T: ComBitPosition=42, ComBitSize=1, ComTransferProperty=TRIGGERED_ON_CHANGE, ComHandleId=189, ComSystemTemplateSystemSignalRef=CAN2_FDC_BCM_LDRL_Cmd
            CAN2_FDC_BCM_LTurnLp_Cmd_521T: ComBitPosition=54, ComBitSize=1, ComTransferProperty=PENDING, ComHandleId=190, ComSystemTemplateSystemSignalRef=CAN2_FDC_BCM_LTurnLp_Cmd
            CAN2_FDC_BCM_LTurnSW_Sta_521T: ComBitPosition=13, ComBitSize=1, ComTransferProperty=TRIGGERED_ON_CHANGE, ComHandleId=191, ComSystemTemplateSystemSignalRef=CAN2_FDC_BCM_LTurnSW_Sta
            CAN2_FDC_BCM_MDCloseSV_Cmd_521T: ComBitPosition=5, ComBitSize=1, ComTransferProperty=TRIGGERED_ON_CHANGE, ComHandleId=192, ComSystemTemplateSystemSignalRef=CAN2_FDC_BCM_MDCloseSV_Cmd
            CAN2_FDC_BCM_MDOpenSV_Cmd_521T: ComBitPosition=4, ComBitSize=1, ComTransferProperty=TRIGGERED_ON_CHANGE, ComHandleId=193, ComSystemTemplateSystemSignalRef=CAN2_FDC_BCM_MDOpenSV_Cmd
            CAN2_FDC_BCM_MDoor_Sta_521T: ComBitPosition=44, ComBitSize=1, ComTransferProperty=TRIGGERED_ON_CHANGE, ComHandleId=194, ComSystemTemplateSystemSignalRef=CAN2_FDC_BCM_MDoor_Sta
            CAN2_FDC_BCM_MRoomLpSet_Sta_521T: ComBitPosition=63, ComBitSize=7, ComTransferProperty=PENDING, ComHandleId=195, ComSystemTemplateSystemSignalRef=CAN2_FDC_BCM_MRoomLpSet_Sta
            CAN2_FDC_BCM_OutDoorOpenSW_Sta_521T: ComBitPosition=1, ComBitSize=2, ComTransferProperty=TRIGGERED_ON_CHANGE, ComHandleId=196, ComSystemTemplateSystemSignalRef=CAN2_FDC_BCM_OutDoorOpenSW_Sta
            CAN2_FDC_BCM_PLamp_Cmd_521T: ComBitPosition=41, ComBitSize=1, ComTransferProperty=TRIGGERED_ON_CHANGE, ComHandleId=197, ComSystemTemplateSystemSignalRef=CAN2_FDC_BCM_PLamp_Cmd
            CAN2_FDC_BCM_RBSDR_Cmd_521T: ComBitPosition=37, ComBitSize=1, ComTransferProperty=TRIGGERED_ON_CHANGE, ComHandleId=198, ComSystemTemplateSystemSignalRef=CAN2_FDC_BCM_RBSDR_Cmd
            CAN2_FDC_BCM_RBSDY_Cmd_521T: ComBitPosition=38, ComBitSize=1, ComTransferProperty=TRIGGERED_ON_CHANGE, ComHandleId=199, ComSystemTemplateSystemSignalRef=CAN2_FDC_BCM_RBSDY_Cmd
            CAN2_FDC_BCM_RDRL_Cmd_521T: ComBitPosition=43, ComBitSize=1, ComTransferProperty=TRIGGERED_ON_CHANGE, ComHandleId=200, ComSystemTemplateSystemSignalRef=CAN2_FDC_BCM_RDRL_Cmd
            CAN2_FDC_BCM_RDoor_Sta_521T: ComBitPosition=46, ComBitSize=1, ComTransferProperty=TRIGGERED_ON_CHANGE, ComHandleId=201, ComSystemTemplateSystemSignalRef=CAN2_FDC_BCM_RDoor_Sta
            CAN2_FDC_BCM_RFLamp_Cmd_521T: ComBitPosition=31, ComBitSize=1, ComTransferProperty=TRIGGERED_ON_CHANGE, ComHandleId=202, ComSystemTemplateSystemSignalRef=CAN2_FDC_BCM_RFLamp_Cmd
            CAN2_FDC_BCM_RGear_Sta_521T: ComBitPosition=47, ComBitSize=1, ComTransferProperty=TRIGGERED_ON_CHANGE, ComHandleId=203, ComSystemTemplateSystemSignalRef=CAN2_FDC_BCM_RGear_Sta
            CAN2_FDC_BCM_RRoomLpSet_Sta_521T: ComBitPosition=71, ComBitSize=7, ComTransferProperty=TRIGGERED_ON_CHANGE, ComHandleId=204, ComSystemTemplateSystemSignalRef=CAN2_FDC_BCM_RRoomLpSet_Sta
            CAN2_FDC_BCM_RTurnLp_Cmd_521T: ComBitPosition=53, ComBitSize=1, ComTransferProperty=PENDING, ComHandleId=205, ComSystemTemplateSystemSignalRef=CAN2_FDC_BCM_RTurnLp_Cmd
            CAN2_FDC_BCM_RTurnSW_Sta_521T: ComBitPosition=14, ComBitSize=1, ComTransferProperty=TRIGGERED_ON_CHANGE, ComHandleId=206, ComSystemTemplateSystemSignalRef=CAN2_FDC_BCM_RTurnSW_Sta
            CAN2_FDC_BCM_RoomLpAmbSet_Sta_521T: ComBitPosition=10, ComBitSize=1, ComTransferProperty=TRIGGERED_ON_CHANGE, ComHandleId=207, ComSystemTemplateSystemSignalRef=CAN2_FDC_BCM_RoomLpAmbSet_Sta
            CAN2_FDC_BCM_RoomLpAmb_Cmd_521T: ComBitPosition=25, ComBitSize=1, ComTransferProperty=TRIGGERED_ON_CHANGE, ComHandleId=208, ComSystemTemplateSystemSignalRef=CAN2_FDC_BCM_RoomLpAmb_Cmd
            CAN2_FDC_BCM_RoomLpSet_Sta_521T: ComBitPosition=11, ComBitSize=1, ComTransferProperty=TRIGGERED_ON_CHANGE, ComHandleId=209, ComSystemTemplateSystemSignalRef=CAN2_FDC_BCM_RoomLpSet_Sta
            CAN2_FDC_BCM_SLTLp_Cmd_521T: ComBitPosition=29, ComBitSize=1, ComTransferProperty=TRIGGERED_ON_CHANGE, ComHandleId=210, ComSystemTemplateSystemSignalRef=CAN2_FDC_BCM_SLTLp_Cmd
            CAN2_FDC_BCM_SMKL_Cmd_521T: ComBitPosition=26, ComBitSize=1, ComTransferProperty=TRIGGERED_ON_CHANGE, ComHandleId=211, ComSystemTemplateSystemSignalRef=CAN2_FDC_BCM_SMKL_Cmd
            CAN2_FDC_BCM_SMKR_Cmd_521T: ComBitPosition=27, ComBitSize=1, ComTransferProperty=TRIGGERED_ON_CHANGE, ComHandleId=212, ComSystemTemplateSystemSignalRef=CAN2_FDC_BCM_SMKR_Cmd
            CAN2_FDC_BCM_SRTLp_Cmd_521T: ComBitPosition=28, ComBitSize=1, ComTransferProperty=TRIGGERED_ON_CHANGE, ComHandleId=213, ComSystemTemplateSystemSignalRef=CAN2_FDC_BCM_SRTLp_Cmd
            CAN2_FDC_BCM_STOPBALL_Cmd_521T: ComBitPosition=18, ComBitSize=1, ComTransferProperty=TRIGGERED_ON_CHANGE, ComHandleId=214, ComSystemTemplateSystemSignalRef=CAN2_FDC_BCM_STOPBALL_Cmd
            CAN2_FDC_BCM_Stop_IND_Cmd_521T: ComBitPosition=24, ComBitSize=1, ComTransferProperty=TRIGGERED_ON_CHANGE, ComHandleId=215, ComSystemTemplateSystemSignalRef=CAN2_FDC_BCM_Stop_IND_Cmd
            CAN2_FDC_BCM_TurnBuzzerEN_Sta_521T: ComBitPosition=7, ComBitSize=1, ComTransferProperty=TRIGGERED_ON_CHANGE, ComHandleId=216, ComSystemTemplateSystemSignalRef=CAN2_FDC_BCM_TurnBuzzerEN_Sta
            CAN2_FDC_BCM_TurnLpPattern_Sta_521T: ComBitPosition=17, ComBitSize=2, ComTransferProperty=TRIGGERED_ON_CHANGE, ComHandleId=217, ComSystemTemplateSystemSignalRef=CAN2_FDC_BCM_TurnLpPattern_Sta
            CAN2_FDC_BCM_Washer_Cmd_521T: ComBitPosition=34, ComBitSize=1, ComTransferProperty=TRIGGERED_ON_CHANGE, ComHandleId=218, ComSystemTemplateSystemSignalRef=CAN2_FDC_BCM_Washer_Cmd
            CAN2_FDC_BCM_WiperH_Cmd_521T: ComBitPosition=32, ComBitSize=1, ComTransferProperty=TRIGGERED_ON_CHANGE, ComHandleId=219, ComSystemTemplateSystemSignalRef=CAN2_FDC_BCM_WiperH_Cmd
            CAN2_FDC_BCM_WiperL_Cmd_521T: ComBitPosition=33, ComBitSize=1, ComTransferProperty=TRIGGERED_ON_CHANGE, ComHandleId=220, ComSystemTemplateSystemSignalRef=CAN2_FDC_BCM_WiperL_Cmd
        GRCAN2_SG_GW2_C100_0_523T: ComSignalGroupDirection=SEND, ComTransferProperty=PENDING, ComHandleId=24, ComSystemTemplateSignalGroupRef=CAN2_SG_GW2_C100_0
          43 x ComGroupSignal, all with ComSignalEndianness=BIG_ENDIAN, ComSignalInitValue=0, ComSignalLength=(unset), ComTimeoutSubstitutionValue=(unset), ComTransferProperty=TRIGGERED_ON_CHANGE:
            CAN2_ABSFullyOper_523T: ComBitPosition=109, ComBitSize=2, ComSignalType=UINT8, ComHandleId=221, ComSystemTemplateSystemSignalRef=CAN2_ABSFullyOper
            CAN2_ACTempSetSta_523T: ComBitPosition=79, ComBitSize=8, ComSignalType=UINT8, ComHandleId=222, ComSystemTemplateSystemSignalRef=CAN2_ACTempSetSta
            CAN2_ASC1KneelingInfo_523T: ComBitPosition=183, ComBitSize=4, ComSignalType=UINT8, ComHandleId=223, ComSystemTemplateSystemSignalRef=CAN2_ASC1KneelingInfo
            CAN2_ASRBrakeCtrlAtc_523T: ComBitPosition=65, ComBitSize=2, ComSignalType=UINT8, ComHandleId=224, ComSystemTemplateSystemSignalRef=CAN2_ASRBrakeCtrlAtc
            CAN2_ASREngCtrlAtc_523T: ComBitPosition=111, ComBitSize=2, ComSignalType=UINT8, ComHandleId=225, ComSystemTemplateSystemSignalRef=CAN2_ASREngCtrlAtc
            CAN2_AirPressureRC1_523T: ComBitPosition=207, ComBitSize=8, ComSignalType=UINT8, ComHandleId=226, ComSystemTemplateSystemSignalRef=CAN2_AirPressureRC1
            CAN2_B2THVRlySta_523T: ComBitPosition=11, ComBitSize=2, ComSignalType=UINT8, ComHandleId=227, ComSystemTemplateSystemSignalRef=CAN2_B2THVRlySta
            CAN2_B2VBI1BattType_523T: ComBitPosition=15, ComBitSize=4, ComSignalType=UINT8, ComHandleId=228, ComSystemTemplateSystemSignalRef=CAN2_B2VBI1BattType
            CAN2_B2VBI1RateCap_523T: ComBitPosition=23, ComBitSize=16, ComSignalType=UINT16, ComHandleId=229, ComSystemTemplateSystemSignalRef=CAN2_B2VBI1RateCap
            CAN2_B2VBI1RateHVolt_523T: ComBitPosition=39, ComBitSize=16, ComSignalType=UINT16, ComHandleId=230, ComSystemTemplateSystemSignalRef=CAN2_B2VBI1RateHVolt
            CAN2_B2VBI1RatePower_523T: ComBitPosition=55, ComBitSize=16, ComSignalType=UINT16, ComHandleId=231, ComSystemTemplateSystemSignalRef=CAN2_B2VBI1RatePower
            CAN2_B2VChgMode_523T: ComBitPosition=9, ComBitSize=2, ComSignalType=UINT8, ComHandleId=232, ComSystemTemplateSystemSignalRef=CAN2_B2VChgMode
            CAN2_B2VChgSta_523T: ComBitPosition=71, ComBitSize=2, ComSignalType=UINT8, ComHandleId=233, ComSystemTemplateSystemSignalRef=CAN2_B2VChgSta
            CAN2_B2VDCChgConnSta_523T: ComBitPosition=69, ComBitSize=2, ComSignalType=UINT8, ComHandleId=234, ComSystemTemplateSystemSignalRef=CAN2_B2VDCChgConnSta
            CAN2_B2VFaultCode_523T: ComBitPosition=95, ComBitSize=8, ComSignalType=UINT8, ComHandleId=235, ComSystemTemplateSystemSignalRef=CAN2_B2VFaultCode
            CAN2_B2VPChrgConnSta_523T: ComBitPosition=67, ComBitSize=1, ComSignalType=UINT8, ComHandleId=236, ComSystemTemplateSystemSignalRef=CAN2_B2VPChrgConnSta
            CAN2_B2VSOC_523T: ComBitPosition=87, ComBitSize=8, ComSignalType=UINT8, ComHandleId=237, ComSystemTemplateSystemSignalRef=CAN2_B2VSOC
            CAN2_B2VSOH_523T: ComBitPosition=7, ComBitSize=8, ComSignalType=UINT8, ComHandleId=238, ComSystemTemplateSystemSignalRef=CAN2_B2VSOH
            CAN2_CACTempWarn_523T: ComBitPosition=177, ComBitSize=1, ComSignalType=UINT8, ComHandleId=239, ComSystemTemplateSystemSignalRef=CAN2_CACTempWarn
            CAN2_DACStatus_523T: ComBitPosition=231, ComBitSize=2, ComSignalType=UINT8, ComHandleId=240, ComSystemTemplateSystemSignalRef=CAN2_DACStatus
            CAN2_DCDC_En_Sta_523T: ComBitPosition=213, ComBitSize=2, ComSignalType=UINT8, ComHandleId=241, ComSystemTemplateSystemSignalRef=CAN2_DCDC_En_Sta
            CAN2_EBSAmWarnLampSta_523T: ComBitPosition=107, ComBitSize=2, ComSignalType=UINT8, ComHandleId=242, ComSystemTemplateSystemSignalRef=CAN2_EBSAmWarnLampSta
            CAN2_EBSBrakeSw_523T: ComBitPosition=215, ComBitSize=2, ComSignalType=UINT8, ComHandleId=243, ComSystemTemplateSystemSignalRef=CAN2_EBSBrakeSw
            CAN2_EBSRedWarnLampSta_523T: ComBitPosition=105, ComBitSize=2, ComSignalType=UINT8, ComHandleId=244, ComSystemTemplateSystemSignalRef=CAN2_EBSRedWarnLampSta
            CAN2_ECASAWarmLampSta_523T: ComBitPosition=179, ComBitSize=2, ComSignalType=UINT8, ComHandleId=245, ComSystemTemplateSystemSignalRef=CAN2_ECASAWarmLampSta
            CAN2_EHPS_ErrLv_Sta_523T: ComBitPosition=191, ComBitSize=3, ComSignalType=UINT8, ComHandleId=246, ComSystemTemplateSystemSignalRef=CAN2_EHPS_ErrLv_Sta
            CAN2_GearFlashInd_523T: ComBitPosition=66, ComBitSize=1, ComSignalType=UINT8, ComHandleId=247, ComSystemTemplateSystemSignalRef=CAN2_GearFlashInd
            CAN2_LVBattLow_523T: ComBitPosition=223, ComBitSize=2, ComSignalType=UINT8, ComHandleId=248, ComSystemTemplateSystemSignalRef=CAN2_LVBattLow
            CAN2_MCUFailGrade_523T: ComBitPosition=188, ComBitSize=4, ComSignalType=UINT8, ComHandleId=249, ComSystemTemplateSystemSignalRef=CAN2_MCUFailGrade
            CAN2_ParkBrakeSW_523T: ComBitPosition=211, ComBitSize=2, ComSignalType=UINT8, ComHandleId=250, ComSystemTemplateSystemSignalRef=CAN2_ParkBrakeSW
            CAN2_PweLmtInd_523T: ComBitPosition=221, ComBitSize=1, ComSignalType=UINT8, ComHandleId=251, ComSystemTemplateSystemSignalRef=CAN2_PweLmtInd
            CAN2_TransReqGear_523T: ComBitPosition=103, ComBitSize=8, ComSignalType=UINT8, ComHandleId=252, ComSystemTemplateSystemSignalRef=CAN2_TransReqGear
            CAN2_VCUWarnInd_523T: ComBitPosition=220, ComBitSize=3, ComSignalType=UINT8, ComHandleId=253, ComSystemTemplateSystemSignalRef=CAN2_VCUWarnInd
            CAN2_VCUnoPBInd_523T: ComBitPosition=217, ComBitSize=1, ComSignalType=UINT8, ComHandleId=254, ComSystemTemplateSystemSignalRef=CAN2_VCUnoPBInd
            CAN2_VDCBrakeLightReq_523T: ComBitPosition=229, ComBitSize=2, ComSignalType=UINT8, ComHandleId=255, ComSystemTemplateSystemSignalRef=CAN2_VDCBrakeLightReq
            CAN2_WhlSpeed_FL_523T: ComBitPosition=119, ComBitSize=16, ComSignalType=UINT16, ComHandleId=256, ComSystemTemplateSystemSignalRef=CAN2_WhlSpeed_FL
            CAN2_WhlSpeed_FR_523T: ComBitPosition=135, ComBitSize=16, ComSignalType=UINT16, ComHandleId=257, ComSystemTemplateSystemSignalRef=CAN2_WhlSpeed_FR
            CAN2_WhlSpeed_RL_523T: ComBitPosition=151, ComBitSize=16, ComSignalType=UINT16, ComHandleId=258, ComSystemTemplateSystemSignalRef=CAN2_WhlSpeed_RL
            CAN2_WhlSpeed_RR_523T: ComBitPosition=167, ComBitSize=16, ComSignalType=UINT16, ComHandleId=259, ComSystemTemplateSystemSignalRef=CAN2_WhlSpeed_RR
            CAN2_ZFR_CHASSIS_LiningWearFL_Sta_523T: ComBitPosition=176, ComBitSize=1, ComSignalType=UINT8, ComHandleId=260, ComSystemTemplateSystemSignalRef=CAN2_ZFR_CHASSIS_LiningWearFL_Sta
            CAN2_ZFR_CHASSIS_LiningWearFR_Sta_523T: ComBitPosition=184, ComBitSize=1, ComSignalType=UINT8, ComHandleId=261, ComSystemTemplateSystemSignalRef=CAN2_ZFR_CHASSIS_LiningWearFR_Sta
            CAN2_ZRR_CHASSIS_LiningWearRL_Sta_523T: ComBitPosition=209, ComBitSize=1, ComSignalType=UINT8, ComHandleId=262, ComSystemTemplateSystemSignalRef=CAN2_ZRR_CHASSIS_LiningWearRL_Sta
            CAN2_ZRR_CHASSIS_LiningWearRR_Sta_523T: ComBitPosition=208, ComBitSize=1, ComSignalType=UINT8, ComHandleId=263, ComSystemTemplateSystemSignalRef=CAN2_ZRR_CHASSIS_LiningWearRR_Sta
        GRCAN3_SG_FD3_C100_0_402846703T: ComSignalGroupDirection=SEND, ComTransferProperty=PENDING, ComHandleId=25, ComSystemTemplateSignalGroupRef=CAN3_SG_FD3_C100_0
          24 x ComGroupSignal, all with ComSignalEndianness=LITTLE_ENDIAN, ComSignalInitValue=0, ComSignalLength=(unset), ComSignalType=UINT8, ComTimeoutSubstitutionValue=(unset), ComTransferProperty=TRIGGERED_ON_CHANGE:
            CAN3_V2BACPosRlyFlt_402846703T: ComBitPosition=30, ComBitSize=2, ComHandleId=264, ComSystemTemplateSystemSignalRef=CAN3_V2BACPosRlyFlt
            CAN3_V2BACPosRlySta_402846703T: ComBitPosition=28, ComBitSize=2, ComHandleId=265, ComSystemTemplateSystemSignalRef=CAN3_V2BACPosRlySta
            CAN3_V2BAirPosRlyFlt_402846703T: ComBitPosition=34, ComBitSize=2, ComHandleId=266, ComSystemTemplateSystemSignalRef=CAN3_V2BAirPosRlyFlt
            CAN3_V2BAirPosRlySta_402846703T: ComBitPosition=32, ComBitSize=2, ComHandleId=267, ComSystemTemplateSystemSignalRef=CAN3_V2BAirPosRlySta
            CAN3_V2BAux1OnOff_402846703T: ComBitPosition=10, ComBitSize=2, ComHandleId=268, ComSystemTemplateSystemSignalRef=CAN3_V2BAux1OnOff
            CAN3_V2BAux1RlyFlt_402846703T: ComBitPosition=46, ComBitSize=2, ComHandleId=269, ComSystemTemplateSystemSignalRef=CAN3_V2BAux1RlyFlt
            CAN3_V2BAux1RlySta_402846703T: ComBitPosition=44, ComBitSize=2, ComHandleId=270, ComSystemTemplateSystemSignalRef=CAN3_V2BAux1RlySta
            CAN3_V2BAux2OnOff_402846703T: ComBitPosition=12, ComBitSize=2, ComHandleId=271, ComSystemTemplateSystemSignalRef=CAN3_V2BAux2OnOff
            CAN3_V2BAux2RlyFlt_402846703T: ComBitPosition=50, ComBitSize=2, ComHandleId=272, ComSystemTemplateSystemSignalRef=CAN3_V2BAux2RlyFlt
            CAN3_V2BAux2RlySta_402846703T: ComBitPosition=48, ComBitSize=2, ComHandleId=273, ComSystemTemplateSystemSignalRef=CAN3_V2BAux2RlySta
            CAN3_V2BAux3OnOff_402846703T: ComBitPosition=14, ComBitSize=2, ComHandleId=274, ComSystemTemplateSystemSignalRef=CAN3_V2BAux3OnOff
            CAN3_V2BAux3RlyFlt_402846703T: ComBitPosition=54, ComBitSize=2, ComHandleId=275, ComSystemTemplateSystemSignalRef=CAN3_V2BAux3RlyFlt
            CAN3_V2BAux3RlySta_402846703T: ComBitPosition=52, ComBitSize=2, ComHandleId=276, ComSystemTemplateSystemSignalRef=CAN3_V2BAux3RlySta
            CAN3_V2BAux4ReyFlt_402846703T: ComBitPosition=58, ComBitSize=2, ComHandleId=277, ComSystemTemplateSystemSignalRef=CAN3_V2BAux4ReyFlt
            CAN3_V2BAux4RlySta_402846703T: ComBitPosition=56, ComBitSize=2, ComHandleId=278, ComSystemTemplateSystemSignalRef=CAN3_V2BAux4RlySta
            CAN3_V2BDCDCPosRlyFlt_402846703T: ComBitPosition=42, ComBitSize=2, ComHandleId=279, ComSystemTemplateSystemSignalRef=CAN3_V2BDCDCPosRlyFlt
            CAN3_V2BDCDCPosRlySta_402846703T: ComBitPosition=40, ComBitSize=2, ComHandleId=280, ComSystemTemplateSystemSignalRef=CAN3_V2BDCDCPosRlySta
            CAN3_V2BHVOnOff_402846703T: ComBitPosition=8, ComBitSize=2, ComHandleId=281, ComSystemTemplateSystemSignalRef=CAN3_V2BHVOnOff
            CAN3_V2BLifeSig_402846703T: ComBitPosition=0, ComBitSize=8, ComHandleId=282, ComSystemTemplateSystemSignalRef=CAN3_V2BLifeSig
            CAN3_V2BMainPosRlyFlt_402846703T: ComBitPosition=26, ComBitSize=2, ComHandleId=283, ComSystemTemplateSystemSignalRef=CAN3_V2BMainPosRlyFlt
            CAN3_V2BMainPosRlySta_402846703T: ComBitPosition=24, ComBitSize=2, ComHandleId=284, ComSystemTemplateSystemSignalRef=CAN3_V2BMainPosRlySta
            CAN3_V2BOilPosRlyFlt_402846703T: ComBitPosition=38, ComBitSize=2, ComHandleId=285, ComSystemTemplateSystemSignalRef=CAN3_V2BOilPosRlyFlt
            CAN3_V2BOilPosRlySta_402846703T: ComBitPosition=36, ComBitSize=2, ComHandleId=286, ComSystemTemplateSystemSignalRef=CAN3_V2BOilPosRlySta
            CAN3_V2BVehSpd_402846703T: ComBitPosition=16, ComBitSize=8, ComHandleId=287, ComSystemTemplateSystemSignalRef=CAN3_V2BVehSpd
        GRCAN3_SG_FD3_C10_0_217121232T: ComSignalGroupDirection=SEND, ComTransferProperty=PENDING, ComHandleId=26, ComSystemTemplateSignalGroupRef=CAN3_SG_FD3_C10_0
          5 x ComGroupSignal, all with ComSignalEndianness=LITTLE_ENDIAN, ComSignalInitValue=0, ComSignalLength=(unset), ComSignalType=UINT8, ComTimeoutSubstitutionValue=(unset), ComTransferProperty=TRIGGERED_ON_CHANGE:
            CAN3_DCDCRlyEn_217121232T: ComBitPosition=22, ComBitSize=2, ComHandleId=288, ComSystemTemplateSystemSignalRef=CAN3_DCDCRlyEn
            CAN3_EACRlyEn_217121232T: ComBitPosition=20, ComBitSize=2, ComHandleId=289, ComSystemTemplateSystemSignalRef=CAN3_EACRlyEn
            CAN3_EHPSRlyEn_217121232T: ComBitPosition=18, ComBitSize=2, ComHandleId=290, ComSystemTemplateSystemSignalRef=CAN3_EHPSRlyEn
            CAN3_MCUHVPwrOnOffReq_217121232T: ComBitPosition=8, ComBitSize=2, ComHandleId=291, ComSystemTemplateSystemSignalRef=CAN3_MCUHVPwrOnOffReq
            CAN3_VCULife1_217121232T: ComBitPosition=56, ComBitSize=8, ComHandleId=292, ComSystemTemplateSystemSignalRef=CAN3_VCULife1
        GRCAN3_SG_FD3_C10_1_218039791T: ComSignalGroupDirection=SEND, ComTransferProperty=PENDING, ComHandleId=27, ComSystemTemplateSignalGroupRef=CAN3_SG_FD3_C10_1
          12 x ComGroupSignal, all with ComSignalEndianness=LITTLE_ENDIAN, ComSignalInitValue=0, ComSignalLength=(unset), ComTimeoutSubstitutionValue=(unset), ComTransferProperty=TRIGGERED_ON_CHANGE:
            CAN3_VCUMCUCtrlMd_218039791T: ComBitPosition=2, ComBitSize=2, ComSignalType=UINT8, ComHandleId=293, ComSystemTemplateSystemSignalRef=CAN3_VCUMCUCtrlMd
            CAN3_VCUMCUDemCS_218039791T: ComBitPosition=20, ComBitSize=4, ComSignalType=UINT8, ComHandleId=294, ComSystemTemplateSystemSignalRef=CAN3_VCUMCUDemCS
            CAN3_VCUMCUDemHiPosVal_218039791T: ComBitPosition=8, ComBitSize=8, ComSignalType=UINT8, ComHandleId=295, ComSystemTemplateSystemSignalRef=CAN3_VCUMCUDemHiPosVal
            CAN3_VCUMCUDemLoNegVal_218039791T: ComBitPosition=24, ComBitSize=8, ComSignalType=UINT8, ComHandleId=296, ComSystemTemplateSystemSignalRef=CAN3_VCUMCUDemLoNegVal
            CAN3_VCUMCUDemRC_218039791T: ComBitPosition=16, ComBitSize=4, ComSignalType=UINT8, ComHandleId=297, ComSystemTemplateSystemSignalRef=CAN3_VCUMCUDemRC
            CAN3_VCUMCUDemSpd_218039791T: ComBitPosition=48, ComBitSize=16, ComSignalType=UINT16, ComHandleId=298, ComSystemTemplateSystemSignalRef=CAN3_VCUMCUDemSpd
            CAN3_VCUMCUDemTrq_218039791T: ComBitPosition=32, ComBitSize=16, ComSignalType=UINT16, ComHandleId=299, ComSystemTemplateSystemSignalRef=CAN3_VCUMCUDemTrq
            CAN3_VCUMCUEn_218039791T: ComBitPosition=0, ComBitSize=1, ComSignalType=UINT8, ComHandleId=300, ComSystemTemplateSystemSignalRef=CAN3_VCUMCUEn
            CAN3_VCUMCUFailRst_218039791T: ComBitPosition=1, ComBitSize=1, ComSignalType=UINT8, ComHandleId=301, ComSystemTemplateSystemSignalRef=CAN3_VCUMCUFailRst
            CAN3_VCUMCUFootBrk_218039791T: ComBitPosition=6, ComBitSize=1, ComSignalType=UINT8, ComHandleId=302, ComSystemTemplateSystemSignalRef=CAN3_VCUMCUFootBrk
            CAN3_VCUMCUGearSta_218039791T: ComBitPosition=4, ComBitSize=2, ComSignalType=UINT8, ComHandleId=303, ComSystemTemplateSystemSignalRef=CAN3_VCUMCUGearSta
            CAN3_VCUMCUHandBrk_218039791T: ComBitPosition=7, ComBitSize=1, ComSignalType=UINT8, ComHandleId=304, ComSystemTemplateSystemSignalRef=CAN3_VCUMCUHandBrk
        GRCAN3_SG_FD3_C200_0_418382831T: ComSignalGroupDirection=SEND, ComTransferProperty=PENDING, ComHandleId=28, ComSystemTemplateSignalGroupRef=CAN3_SG_FD3_C200_0
          10 x ComGroupSignal, all with ComSignalEndianness=LITTLE_ENDIAN, ComSignalInitValue=0, ComSignalLength=(unset), ComSignalType=UINT8, ComTimeoutSubstitutionValue=(unset), ComTransferProperty=TRIGGERED_ON_CHANGE:
            CAN3_ChrgFault_418382831T: ComBitPosition=24, ComBitSize=4, ComHandleId=305, ComSystemTemplateSystemSignalRef=CAN3_ChrgFault
            CAN3_ChrgState_418382831T: ComBitPosition=20, ComBitSize=4, ComHandleId=306, ComSystemTemplateSystemSignalRef=CAN3_ChrgState
            CAN3_PowerDownFault_418382831T: ComBitPosition=16, ComBitSize=4, ComHandleId=307, ComSystemTemplateSystemSignalRef=CAN3_PowerDownFault
            CAN3_PowerDownState_418382831T: ComBitPosition=12, ComBitSize=4, ComHandleId=308, ComSystemTemplateSystemSignalRef=CAN3_PowerDownState
            CAN3_PowerUpFault_418382831T: ComBitPosition=8, ComBitSize=4, ComHandleId=309, ComSystemTemplateSystemSignalRef=CAN3_PowerUpFault
            CAN3_PowerUpState_418382831T: ComBitPosition=4, ComBitSize=4, ComHandleId=310, ComSystemTemplateSystemSignalRef=CAN3_PowerUpState
            CAN3_SysPowerMode_418382831T: ComBitPosition=0, ComBitSize=4, ComHandleId=311, ComSystemTemplateSystemSignalRef=CAN3_SysPowerMode
            CAN3_VCUIGNSta_418382831T: ComBitPosition=32, ComBitSize=2, ComHandleId=312, ComSystemTemplateSystemSignalRef=CAN3_VCUIGNSta
            CAN3_VCUIRCSta_418382831T: ComBitPosition=34, ComBitSize=2, ComHandleId=313, ComSystemTemplateSystemSignalRef=CAN3_VCUIRCSta
            CAN3_VCUPSSSta_418382831T: ComBitPosition=36, ComBitSize=2, ComHandleId=314, ComSystemTemplateSystemSignalRef=CAN3_VCUPSSSta
        GRCAN3_SG_FD3_C200_1_418382319T: ComSignalGroupDirection=SEND, ComTransferProperty=PENDING, ComHandleId=29, ComSystemTemplateSignalGroupRef=CAN3_SG_FD3_C200_1
          CAN3_FDC_THCM_EWPPEReq_Cmd_418382319T (ComGroupSignal):
            ComBitPosition = 0
            ComBitSize = 8
            ComSignalEndianness = LITTLE_ENDIAN
            ComSignalInitValue = 0
            ComSignalLength = (unset)
            ComSignalType = UINT8
            ComTimeoutSubstitutionValue = (unset)
            ComTransferProperty = TRIGGERED_ON_CHANGE
            ComHandleId = 315
            ComSystemTemplateSystemSignalRef = CAN3_FDC_THCM_EWPPEReq_Cmd
        GRCAN4_SG_FD4_C100_0_217121744T: ComSignalGroupDirection=SEND, ComTransferProperty=PENDING, ComHandleId=30, ComSystemTemplateSignalGroupRef=CAN4_SG_FD4_C100_0
          6 x ComGroupSignal, all with ComSignalEndianness=LITTLE_ENDIAN, ComSignalLength=(unset), ComTimeoutSubstitutionValue=(unset), ComTransferProperty=TRIGGERED_ON_CHANGE:
            CAN4_DCDCEnDemand_217121744T: ComBitPosition=16, ComBitSize=8, ComSignalInitValue=0, ComSignalType=UINT8, ComHandleId=316, ComSystemTemplateSystemSignalRef=CAN4_DCDCEnDemand
            CAN4_EACSpdDemand_217121744T: ComBitPosition=40, ComBitSize=16, ComSignalInitValue=10000, ComSignalType=UINT16, ComHandleId=317, ComSystemTemplateSystemSignalRef=CAN4_EACSpdDemand
            CAN4_FDC_CHA_EACEnDemand_Cmd_217121744T: ComBitPosition=8, ComBitSize=8, ComSignalInitValue=0, ComSignalType=UINT8, ComHandleId=318, ComSystemTemplateSystemSignalRef=CAN4_FDC_CHA_EACEnDemand_Cmd
            CAN4_FDC_EHPS_EnDemand_Cmd_217121744T: ComBitPosition=0, ComBitSize=8, ComSignalInitValue=0, ComSignalType=UINT8, ComHandleId=319, ComSystemTemplateSystemSignalRef=CAN4_FDC_EHPS_EnDemand_Cmd
            CAN4_FDC_EHPS_SpdDemand_Cmd_217121744T: ComBitPosition=24, ComBitSize=16, ComSignalInitValue=0, ComSignalType=UINT16, ComHandleId=320, ComSystemTemplateSystemSignalRef=CAN4_FDC_EHPS_SpdDemand_Cmd
            CAN4_VCULife2_217121744T: ComBitPosition=56, ComBitSize=8, ComSignalInitValue=0, ComSignalType=UINT8, ComHandleId=321, ComSystemTemplateSystemSignalRef=CAN4_VCULife2
        GRCAN4_SG_FD4_C10_0_217121232T: ComSignalGroupDirection=SEND, ComTransferProperty=PENDING, ComHandleId=31, ComSystemTemplateSignalGroupRef=CAN4_SG_FD4_C10_0
          5 x ComGroupSignal, all with ComSignalEndianness=LITTLE_ENDIAN, ComSignalInitValue=0, ComSignalLength=(unset), ComSignalType=UINT8, ComTimeoutSubstitutionValue=(unset), ComTransferProperty=TRIGGERED_ON_CHANGE:
            CAN4_ACHVPwrOnOffReq_217121232T: ComBitPosition=24, ComBitSize=2, ComHandleId=322, ComSystemTemplateSystemSignalRef=CAN4_ACHVPwrOnOffReq
            CAN4_MCUHVPwrOnOffReq_217121232T: ComBitPosition=8, ComBitSize=2, ComHandleId=323, ComSystemTemplateSystemSignalRef=CAN4_MCUHVPwrOnOffReq
            CAN4_VCULife1_217121232T: ComBitPosition=56, ComBitSize=8, ComHandleId=324, ComSystemTemplateSystemSignalRef=CAN4_VCULife1
            CAN4_VCU_DCDCEACEHPSRlyEn_cmd_217121232T: ComBitPosition=12, ComBitSize=2, ComHandleId=325, ComSystemTemplateSystemSignalRef=CAN4_VCU_DCDCEACEHPSRlyEn_cmd
            CAN4_VCU_DeFogTMSRlyEn_cmd_217121232T: ComBitPosition=10, ComBitSize=2, ComHandleId=326, ComSystemTemplateSystemSignalRef=CAN4_VCU_DeFogTMSRlyEn_cmd
        GRCAN4_SG_FD4_C200_0_418382831T: ComSignalGroupDirection=SEND, ComTransferProperty=PENDING, ComHandleId=32, ComSystemTemplateSignalGroupRef=CAN4_SG_FD4_C200_0
          3 x ComGroupSignal, all with ComSignalEndianness=LITTLE_ENDIAN, ComSignalInitValue=0, ComSignalLength=(unset), ComSignalType=UINT8, ComTimeoutSubstitutionValue=(unset), ComTransferProperty=TRIGGERED_ON_CHANGE:
            CAN4_SysPowerMode_418382831T: ComBitPosition=0, ComBitSize=4, ComHandleId=327, ComSystemTemplateSystemSignalRef=CAN4_SysPowerMode
            CAN4_VCUIGNSta_418382831T: ComBitPosition=32, ComBitSize=2, ComHandleId=328, ComSystemTemplateSystemSignalRef=CAN4_VCUIGNSta
            CAN4_VCUIRCSta_418382831T: ComBitPosition=34, ComBitSize=2, ComHandleId=329, ComSystemTemplateSystemSignalRef=CAN4_VCUIRCSta
        GRCAN4_SG_FD4_CE100_0_521T: ComSignalGroupDirection=SEND, ComTransferProperty=TRIGGERED_ON_CHANGE, ComHandleId=33, ComSystemTemplateSignalGroupRef=CAN4_SG_FD4_CE100_0
          43 x ComGroupSignal, all with ComSignalEndianness=BIG_ENDIAN, ComSignalInitValue=0, ComSignalLength=(unset), ComSignalType=UINT8, ComTimeoutSubstitutionValue=(unset):
            CAN4_FDC_BCM_BSD_Buzzer_Cmd_521T: ComBitPosition=39, ComBitSize=1, ComTransferProperty=TRIGGERED_ON_CHANGE, ComHandleId=330, ComSystemTemplateSystemSignalRef=CAN4_FDC_BCM_BSD_Buzzer_Cmd
            CAN4_FDC_BCM_Brake_Cmd_521T: ComBitPosition=30, ComBitSize=1, ComTransferProperty=TRIGGERED_ON_CHANGE, ComHandleId=331, ComSystemTemplateSystemSignalRef=CAN4_FDC_BCM_Brake_Cmd
            CAN4_FDC_BCM_CallBell_Cmd_521T: ComBitPosition=20, ComBitSize=1, ComTransferProperty=TRIGGERED_ON_CHANGE, ComHandleId=332, ComSystemTemplateSystemSignalRef=CAN4_FDC_BCM_CallBell_Cmd
            CAN4_FDC_BCM_DVRSignalL_Cmd_521T: ComBitPosition=52, ComBitSize=1, ComTransferProperty=PENDING, ComHandleId=333, ComSystemTemplateSystemSignalRef=CAN4_FDC_BCM_DVRSignalL_Cmd
            CAN4_FDC_BCM_DVRSignalR_Cmd_521T: ComBitPosition=51, ComBitSize=1, ComTransferProperty=PENDING, ComHandleId=334, ComSystemTemplateSystemSignalRef=CAN4_FDC_BCM_DVRSignalR_Cmd
            CAN4_FDC_BCM_EmExitSW_Sta_521T: ComBitPosition=9, ComBitSize=1, ComTransferProperty=TRIGGERED_ON_CHANGE, ComHandleId=335, ComSystemTemplateSystemSignalRef=CAN4_FDC_BCM_EmExitSW_Sta
            CAN4_FDC_BCM_EmSV_Cmd_521T: ComBitPosition=6, ComBitSize=1, ComTransferProperty=TRIGGERED_ON_CHANGE, ComHandleId=336, ComSystemTemplateSystemSignalRef=CAN4_FDC_BCM_EmSV_Cmd
            CAN4_FDC_BCM_FDCloseSV_Cmd_521T: ComBitPosition=3, ComBitSize=1, ComTransferProperty=TRIGGERED_ON_CHANGE, ComHandleId=337, ComSystemTemplateSystemSignalRef=CAN4_FDC_BCM_FDCloseSV_Cmd
            CAN4_FDC_BCM_FDOpenSV_Cmd_521T: ComBitPosition=2, ComBitSize=1, ComTransferProperty=TRIGGERED_ON_CHANGE, ComHandleId=338, ComSystemTemplateSystemSignalRef=CAN4_FDC_BCM_FDOpenSV_Cmd
            CAN4_FDC_BCM_FDoor_Sta_521T: ComBitPosition=45, ComBitSize=1, ComTransferProperty=TRIGGERED_ON_CHANGE, ComHandleId=339, ComSystemTemplateSystemSignalRef=CAN4_FDC_BCM_FDoor_Sta
            CAN4_FDC_BCM_HBeam_Cmd_521T: ComBitPosition=40, ComBitSize=1, ComTransferProperty=TRIGGERED_ON_CHANGE, ComHandleId=340, ComSystemTemplateSystemSignalRef=CAN4_FDC_BCM_HBeam_Cmd
            CAN4_FDC_BCM_InnerBuzzerMode_Sta_521T: ComBitPosition=23, ComBitSize=3, ComTransferProperty=TRIGGERED_ON_CHANGE, ComHandleId=341, ComSystemTemplateSystemSignalRef=CAN4_FDC_BCM_InnerBuzzerMode_Sta
            CAN4_FDC_BCM_InnerBuzzer_Cmd_521T: ComBitPosition=8, ComBitSize=1, ComTransferProperty=TRIGGERED_ON_CHANGE, ComHandleId=342, ComSystemTemplateSystemSignalRef=CAN4_FDC_BCM_InnerBuzzer_Cmd
            CAN4_FDC_BCM_InnerCallBell_Cmd_521T: ComBitPosition=19, ComBitSize=1, ComTransferProperty=TRIGGERED_ON_CHANGE, ComHandleId=343, ComSystemTemplateSystemSignalRef=CAN4_FDC_BCM_InnerCallBell_Cmd
            CAN4_FDC_BCM_LBSDR_Cmd_521T: ComBitPosition=35, ComBitSize=1, ComTransferProperty=TRIGGERED_ON_CHANGE, ComHandleId=344, ComSystemTemplateSystemSignalRef=CAN4_FDC_BCM_LBSDR_Cmd
            CAN4_FDC_BCM_LBSDY_Cmd_521T: ComBitPosition=36, ComBitSize=1, ComTransferProperty=TRIGGERED_ON_CHANGE, ComHandleId=345, ComSystemTemplateSystemSignalRef=CAN4_FDC_BCM_LBSDY_Cmd
            CAN4_FDC_BCM_LBeam_Cmd_521T: ComBitPosition=55, ComBitSize=1, ComTransferProperty=TRIGGERED_ON_CHANGE, ComHandleId=346, ComSystemTemplateSystemSignalRef=CAN4_FDC_BCM_LBeam_Cmd
            CAN4_FDC_BCM_LDRL_Cmd_521T: ComBitPosition=42, ComBitSize=1, ComTransferProperty=TRIGGERED_ON_CHANGE, ComHandleId=347, ComSystemTemplateSystemSignalRef=CAN4_FDC_BCM_LDRL_Cmd
            CAN4_FDC_BCM_LTurnLp_Cmd_521T: ComBitPosition=54, ComBitSize=1, ComTransferProperty=PENDING, ComHandleId=348, ComSystemTemplateSystemSignalRef=CAN4_FDC_BCM_LTurnLp_Cmd
            CAN4_FDC_BCM_MDCloseSV_Cmd_521T: ComBitPosition=5, ComBitSize=1, ComTransferProperty=TRIGGERED_ON_CHANGE, ComHandleId=349, ComSystemTemplateSystemSignalRef=CAN4_FDC_BCM_MDCloseSV_Cmd
            CAN4_FDC_BCM_MDOpenSV_Cmd_521T: ComBitPosition=4, ComBitSize=1, ComTransferProperty=TRIGGERED_ON_CHANGE, ComHandleId=350, ComSystemTemplateSystemSignalRef=CAN4_FDC_BCM_MDOpenSV_Cmd
            CAN4_FDC_BCM_MDoor_Sta_521T: ComBitPosition=44, ComBitSize=1, ComTransferProperty=TRIGGERED_ON_CHANGE, ComHandleId=351, ComSystemTemplateSystemSignalRef=CAN4_FDC_BCM_MDoor_Sta
            CAN4_FDC_BCM_OutDoorOpenSW_Sta_521T: ComBitPosition=1, ComBitSize=2, ComTransferProperty=TRIGGERED_ON_CHANGE, ComHandleId=352, ComSystemTemplateSystemSignalRef=CAN4_FDC_BCM_OutDoorOpenSW_Sta
            CAN4_FDC_BCM_PLamp_Cmd_521T: ComBitPosition=41, ComBitSize=1, ComTransferProperty=TRIGGERED_ON_CHANGE, ComHandleId=353, ComSystemTemplateSystemSignalRef=CAN4_FDC_BCM_PLamp_Cmd
            CAN4_FDC_BCM_RBSDR_Cmd_521T: ComBitPosition=37, ComBitSize=1, ComTransferProperty=TRIGGERED_ON_CHANGE, ComHandleId=354, ComSystemTemplateSystemSignalRef=CAN4_FDC_BCM_RBSDR_Cmd
            CAN4_FDC_BCM_RBSDY_Cmd_521T: ComBitPosition=38, ComBitSize=1, ComTransferProperty=TRIGGERED_ON_CHANGE, ComHandleId=355, ComSystemTemplateSystemSignalRef=CAN4_FDC_BCM_RBSDY_Cmd
            CAN4_FDC_BCM_RDRL_Cmd_521T: ComBitPosition=43, ComBitSize=1, ComTransferProperty=TRIGGERED_ON_CHANGE, ComHandleId=356, ComSystemTemplateSystemSignalRef=CAN4_FDC_BCM_RDRL_Cmd
            CAN4_FDC_BCM_RDoor_Sta_521T: ComBitPosition=46, ComBitSize=1, ComTransferProperty=TRIGGERED_ON_CHANGE, ComHandleId=357, ComSystemTemplateSystemSignalRef=CAN4_FDC_BCM_RDoor_Sta
            CAN4_FDC_BCM_RFLamp_Cmd_521T: ComBitPosition=31, ComBitSize=1, ComTransferProperty=TRIGGERED_ON_CHANGE, ComHandleId=358, ComSystemTemplateSystemSignalRef=CAN4_FDC_BCM_RFLamp_Cmd
            CAN4_FDC_BCM_RGear_Sta_521T: ComBitPosition=47, ComBitSize=1, ComTransferProperty=TRIGGERED_ON_CHANGE, ComHandleId=359, ComSystemTemplateSystemSignalRef=CAN4_FDC_BCM_RGear_Sta
            CAN4_FDC_BCM_RTurnLp_Cmd_521T: ComBitPosition=53, ComBitSize=1, ComTransferProperty=PENDING, ComHandleId=360, ComSystemTemplateSystemSignalRef=CAN4_FDC_BCM_RTurnLp_Cmd
            CAN4_FDC_BCM_RoomLpAmb_Cmd_521T: ComBitPosition=25, ComBitSize=1, ComTransferProperty=TRIGGERED_ON_CHANGE, ComHandleId=361, ComSystemTemplateSystemSignalRef=CAN4_FDC_BCM_RoomLpAmb_Cmd
            CAN4_FDC_BCM_SLTLp_Cmd_521T: ComBitPosition=29, ComBitSize=1, ComTransferProperty=TRIGGERED_ON_CHANGE, ComHandleId=362, ComSystemTemplateSystemSignalRef=CAN4_FDC_BCM_SLTLp_Cmd
            CAN4_FDC_BCM_SMKL_Cmd_521T: ComBitPosition=26, ComBitSize=1, ComTransferProperty=TRIGGERED_ON_CHANGE, ComHandleId=363, ComSystemTemplateSystemSignalRef=CAN4_FDC_BCM_SMKL_Cmd
            CAN4_FDC_BCM_SMKR_Cmd_521T: ComBitPosition=27, ComBitSize=1, ComTransferProperty=TRIGGERED_ON_CHANGE, ComHandleId=364, ComSystemTemplateSystemSignalRef=CAN4_FDC_BCM_SMKR_Cmd
            CAN4_FDC_BCM_SRTLp_Cmd_521T: ComBitPosition=28, ComBitSize=1, ComTransferProperty=TRIGGERED_ON_CHANGE, ComHandleId=365, ComSystemTemplateSystemSignalRef=CAN4_FDC_BCM_SRTLp_Cmd
            CAN4_FDC_BCM_STOPBALL_Cmd_521T: ComBitPosition=18, ComBitSize=1, ComTransferProperty=TRIGGERED_ON_CHANGE, ComHandleId=366, ComSystemTemplateSystemSignalRef=CAN4_FDC_BCM_STOPBALL_Cmd
            CAN4_FDC_BCM_Stop_IND_Cmd_521T: ComBitPosition=24, ComBitSize=1, ComTransferProperty=TRIGGERED_ON_CHANGE, ComHandleId=367, ComSystemTemplateSystemSignalRef=CAN4_FDC_BCM_Stop_IND_Cmd
            CAN4_FDC_BCM_TurnLpPattern_Sta_521T: ComBitPosition=17, ComBitSize=2, ComTransferProperty=TRIGGERED_ON_CHANGE, ComHandleId=368, ComSystemTemplateSystemSignalRef=CAN4_FDC_BCM_TurnLpPattern_Sta
            CAN4_FDC_BCM_Washer_Cmd_521T: ComBitPosition=34, ComBitSize=1, ComTransferProperty=TRIGGERED_ON_CHANGE, ComHandleId=369, ComSystemTemplateSystemSignalRef=CAN4_FDC_BCM_Washer_Cmd
            CAN4_FDC_BCM_WiperH_Cmd_521T: ComBitPosition=32, ComBitSize=1, ComTransferProperty=TRIGGERED_ON_CHANGE, ComHandleId=370, ComSystemTemplateSystemSignalRef=CAN4_FDC_BCM_WiperH_Cmd
            CAN4_FDC_BCM_WiperL_Cmd_521T: ComBitPosition=33, ComBitSize=1, ComTransferProperty=TRIGGERED_ON_CHANGE, ComHandleId=371, ComSystemTemplateSystemSignalRef=CAN4_FDC_BCM_WiperL_Cmd
            CAN4_VCUKeyStatus_521T: ComBitPosition=11, ComBitSize=2, ComTransferProperty=PENDING, ComHandleId=372, ComSystemTemplateSystemSignalRef=CAN4_VCUKeyStatus
        GRCAN4_SG_FD4_CE100_1_528T: ComSignalGroupDirection=SEND, ComTransferProperty=TRIGGERED_ON_CHANGE, ComHandleId=34, ComSystemTemplateSignalGroupRef=CAN4_SG_FD4_CE100_1
          4 x ComGroupSignal, all with ComSignalEndianness=BIG_ENDIAN, ComSignalInitValue=0, ComSignalLength=(unset), ComSignalType=UINT8, ComTimeoutSubstitutionValue=(unset):
            CAN4_FDC_BCM_FRoomLp_Cmd_528T: ComBitPosition=39, ComBitSize=7, ComTransferProperty=PENDING, ComHandleId=373, ComSystemTemplateSystemSignalRef=CAN4_FDC_BCM_FRoomLp_Cmd
            CAN4_FDC_BCM_MRoomLp_Cmd_528T: ComBitPosition=47, ComBitSize=7, ComTransferProperty=PENDING, ComHandleId=374, ComSystemTemplateSystemSignalRef=CAN4_FDC_BCM_MRoomLp_Cmd
            CAN4_FDC_BCM_RRoomLp_Cmd_528T: ComBitPosition=7, ComBitSize=7, ComTransferProperty=PENDING, ComHandleId=375, ComSystemTemplateSystemSignalRef=CAN4_FDC_BCM_RRoomLp_Cmd
            CAN4_FDC_THCM_CoolFanReq_Cmd_528T: ComBitPosition=15, ComBitSize=8, ComTransferProperty=TRIGGERED_ON_CHANGE, ComHandleId=376, ComSystemTemplateSystemSignalRef=CAN4_FDC_THCM_CoolFanReq_Cmd
        GRCAN5_SG_FD5_C100_0_418597072T: ComSignalGroupDirection=SEND, ComTransferProperty=PENDING, ComHandleId=35, ComSystemTemplateSignalGroupRef=CAN5_SG_FD5_C100_0
          3 x ComGroupSignal, all with ComSignalEndianness=LITTLE_ENDIAN, ComSignalInitValue=0, ComSignalLength=(unset), ComSignalType=UINT8, ComTimeoutSubstitutionValue=(unset), ComTransferProperty=TRIGGERED_ON_CHANGE:
            CAN5_AlcLockSta_418597072T: ComBitPosition=24, ComBitSize=2, ComHandleId=377, ComSystemTemplateSystemSignalRef=CAN5_AlcLockSta
            CAN5_B2VAPlusSta_418597072T: ComBitPosition=26, ComBitSize=1, ComHandleId=378, ComSystemTemplateSystemSignalRef=CAN5_B2VAPlusSta
            CAN5_VCUHVILSta_418597072T: ComBitPosition=9, ComBitSize=1, ComHandleId=379, ComSystemTemplateSystemSignalRef=CAN5_VCUHVILSta
        GRCAN5_SG_FD5_C200_0_525T: ComSignalGroupDirection=SEND, ComTransferProperty=PENDING, ComHandleId=36, ComSystemTemplateSignalGroupRef=CAN5_SG_FD5_C200_0
          CAN5_SysPowerMode_525T (ComGroupSignal):
            ComBitPosition = 0
            ComBitSize = 4
            ComSignalEndianness = LITTLE_ENDIAN
            ComSignalInitValue = 0
            ComSignalLength = (unset)
            ComSignalType = UINT8
            ComTimeoutSubstitutionValue = (unset)
            ComTransferProperty = TRIGGERED_ON_CHANGE
            ComHandleId = 380
            ComSystemTemplateSystemSignalRef = CAN5_SysPowerMode
        GRCAN6_SG_FD6_C200_0_524T: ComSignalGroupDirection=SEND, ComTransferProperty=PENDING, ComHandleId=37, ComSystemTemplateSignalGroupRef=CAN6_SG_FD6_C200_0
          CAN6_SysPowerMode_524T (ComGroupSignal):
            ComBitPosition = 0
            ComBitSize = 4
            ComSignalEndianness = LITTLE_ENDIAN
            ComSignalInitValue = 0
            ComSignalLength = (unset)
            ComSignalType = UINT8
            ComTimeoutSubstitutionValue = (unset)
            ComTransferProperty = TRIGGERED_ON_CHANGE
            ComHandleId = 381
            ComSystemTemplateSystemSignalRef = CAN6_SysPowerMode
        GRCAN7_SG_FD7_C100_0_435160528T: ComSignalGroupDirection=SEND, ComTransferProperty=PENDING, ComHandleId=38, ComSystemTemplateSignalGroupRef=CAN7_SG_FD7_C100_0
          CAN7_VCUKeyStatus_435160528T (ComGroupSignal):
            ComBitPosition = 0
            ComBitSize = 2
            ComSignalEndianness = LITTLE_ENDIAN
            ComSignalInitValue = 0
            ComSignalLength = (unset)
            ComSignalType = UINT8
            ComTimeoutSubstitutionValue = (unset)
            ComTransferProperty = TRIGGERED_ON_CHANGE
            ComHandleId = 382
            ComSystemTemplateSystemSignalRef = CAN7_VCUKeyStatus
        GRCAN7_SG_FD7_C10_0_207737041T: ComSignalGroupDirection=SEND, ComTransferProperty=PENDING, ComHandleId=39, ComSystemTemplateSignalGroupRef=CAN7_SG_FD7_C10_0
          CAN7_EMotorSpd_207737041T (ComGroupSignal):
            ComBitPosition = 8
            ComBitSize = 16
            ComSignalEndianness = LITTLE_ENDIAN
            ComSignalInitValue = 0
            ComSignalLength = (unset)
            ComSignalType = UINT16
            ComTimeoutSubstitutionValue = (unset)
            ComTransferProperty = TRIGGERED_ON_CHANGE
            ComHandleId = 383
            ComSystemTemplateSystemSignalRef = CAN7_EMotorSpd
        GRCAN7_SG_FD7_C200_0_418382831T: ComSignalGroupDirection=SEND, ComTransferProperty=PENDING, ComHandleId=40, ComSystemTemplateSignalGroupRef=CAN7_SG_FD7_C200_0
          CAN7_SysPowerMode_418382831T (ComGroupSignal):
            ComBitPosition = 0
            ComBitSize = 4
            ComSignalEndianness = LITTLE_ENDIAN
            ComSignalInitValue = 0
            ComSignalLength = (unset)
            ComSignalType = UINT8
            ComTimeoutSubstitutionValue = (unset)
            ComTransferProperty = TRIGGERED_ON_CHANGE
            ComHandleId = 384
            ComSystemTemplateSystemSignalRef = CAN7_SysPowerMode
        GRCAN7_SG_FD7_C50_0_217056000T: ComSignalGroupDirection=SEND, ComTransferProperty=PENDING, ComHandleId=41, ComSystemTemplateSignalGroupRef=CAN7_SG_FD7_C50_0
          CAN7_AccPedalPos1_217056000T (ComGroupSignal):
            ComBitPosition = 8
            ComBitSize = 8
            ComSignalEndianness = LITTLE_ENDIAN
            ComSignalInitValue = 0
            ComSignalLength = (unset)
            ComSignalType = UINT8
            ComTimeoutSubstitutionValue = (unset)
            ComTransferProperty = TRIGGERED_ON_CHANGE
            ComHandleId = 385
            ComSystemTemplateSystemSignalRef = CAN7_AccPedalPos1
        GRCAN7_SG_FD7_CE100_0_419038649T: ComSignalGroupDirection=SEND, ComTransferProperty=TRIGGERED_ON_CHANGE, ComHandleId=42, ComSystemTemplateSignalGroupRef=CAN7_SG_FD7_CE100_0
          7 x ComGroupSignal, all with ComBitSize=1, ComSignalEndianness=LITTLE_ENDIAN, ComSignalInitValue=0, ComSignalLength=(unset), ComSignalType=UINT8, ComTimeoutSubstitutionValue=(unset), ComTransferProperty=TRIGGERED_ON_CHANGE:
            CAN7_FDC_BCM_DVRSignalL_Cmd_419038649T: ComBitPosition=13, ComHandleId=386, ComSystemTemplateSystemSignalRef=CAN7_FDC_BCM_DVRSignalL_Cmd
            CAN7_FDC_BCM_DVRSignalR_Cmd_419038649T: ComBitPosition=14, ComHandleId=387, ComSystemTemplateSystemSignalRef=CAN7_FDC_BCM_DVRSignalR_Cmd
            CAN7_FDC_BCM_FDoor_Sta_419038649T: ComBitPosition=0, ComHandleId=388, ComSystemTemplateSystemSignalRef=CAN7_FDC_BCM_FDoor_Sta
            CAN7_FDC_BCM_HBeam_Cmd_419038649T: ComBitPosition=3, ComHandleId=389, ComSystemTemplateSystemSignalRef=CAN7_FDC_BCM_HBeam_Cmd
            CAN7_FDC_BCM_LBeam_Cmd_419038649T: ComBitPosition=4, ComHandleId=390, ComSystemTemplateSystemSignalRef=CAN7_FDC_BCM_LBeam_Cmd
            CAN7_FDC_BCM_MDoor_Sta_419038649T: ComBitPosition=1, ComHandleId=391, ComSystemTemplateSystemSignalRef=CAN7_FDC_BCM_MDoor_Sta
            CAN7_FDC_BCM_PLamp_Cmd_419038649T: ComBitPosition=7, ComHandleId=392, ComSystemTemplateSystemSignalRef=CAN7_FDC_BCM_PLamp_Cmd
      ComTimeBase: ComGwTimeBase=0.005, ComRxTimeBase=0.005, ComTxTimeBase=0.005
    ComDefensiveProgramming:
      ComDefProgEnabled = 0
      ComInvariantAssertEnabled = 0
      ComPostcondAssertEnabled = 0
      ComPrecondAssertEnabled = 0
      ComStaticAssertEnabled = 0
      ComUnreachAssertEnabled = 0
    ComGeneral: ComEnableMDTForCyclicTransmission=1, ComEnableSignalGroupArrayApi=1, ComSupportedIPduGroups=32, ComVersionInfoApi=1
      VendorSpecific:
        ComBasedTransformerSupportRx = 1
        ComBasedTransformerSupportTx = 1
        ComCallOutFuncPtrArraySizeMax = INDEX_UINT16
        ComCbkRxAckPtrArraySizeMax = INDEX_UINT16
        ComCbkRxTOutArraySizeMax = INDEX_UINT16
        ComCbkTxAckPtrArraySizeMax = INDEX_UINT16
        ComCbkTxTOutArraySizeMax = INDEX_UINT16
        ComCheckValueSizeEnable = 0
        ComClearUpdateBitTxTransmitEnable = 1
        ComClearUpdateBitTxTriggerTransmitEnable = 1
        ComClearUpdateBitTxTxConfirmationEnable = 1
        ComConfigurationArraySizeMax = INDEX_UINT32
        ComConstCfgAddress = 0
        ComConstCfgAddressEnable = 0
        ComDeferTx2MainFunc = 0
        ComFilterOneEveryNOccuranceMax = SIZE_16_BIT
        ComFilterOneEveryNPeriodOffSMax = SIZE_16_BIT
        ComFilterReceiverEnable = 1
        ComHandleSmallerRxPdus = TRUNCATE_DATA_NOTIFY_ALL
        ComRamSizeMax = INDEX_UINT16
        ComRelocatableCfgEnable = 1
        ComReportToDetEnable = 1
        ComRxBigEndianEnable = 1
        ComRxDataTimeoutAction = RX_DATA_TIMEOUT_ACTION_CONFIG
        ComRxDynLengthIPduEnable = 1
        ComRxFirstTimeoutFactorSize = SIZE_16_BIT
        ComRxLittleEndianEnable = 1
        ComRxSigConfDeferredEnable = 1
        ComRxSigConfImmediateEnable = 1
        ComRxTimeoutFactorSize = SIZE_16_BIT
        ComRxTpAPIEnable = 0
        ComSigGwRxFilterEnable = 0
        ComSignalGroupArrayLengthParamEnable = 1
        ComSignalGwEnable = 1
        ComTmsEnable = 1
        ComTransfPropTriggeredEnable = 1
        ComTransfPropTriggeredOCEnable = 1
        ComTransfPropWithoutRepEnable = 1
        ComTriggerTxCallOutEnable = 1
        ComTxBigEndianEnable = 1
        ComTxDynLengthIPduEnable = 1
        ComTxGroupSignalNoLock = 1
        ComTxIpduMDTFactorSize = SIZE_16_BIT
        ComTxLittleEndianEnable = 1
        ComTxModeBehaviour = AUTOSAR
        ComTxModeDirectEnable = 1
        ComTxModeMixedDirectEnable = 1
        ComTxModeMixedNTimesEnable = 1
        ComTxModeNTimesEnable = 1
        ComTxModePeriodicEnable = 1
        ComTxModeRepetitionPeriodFactorS = SIZE_16_BIT
        ComTxModeTimeOffsetFactorSize = SIZE_16_BIT
        ComTxModeTimePeriodFactorSize = SIZE_16_BIT
        ComTxSigConfDeferredEnable = 1
        ComTxSigConfImmediateEnable = 1
        ComTxTimeoutFactorSize = SIZE_16_BIT
        ComTxTpAPIEnable = 0
        ComTxZeroSignalEnable = 0
        ComUpdateBitRxConfig = UPDATE_BIT_INDIVIDUAL
        ComUpdateBitTxConfig = UPDATE_BIT_INDIVIDUAL
        Com_TxF_MaskNewDiffersMaskOld_En = 1
