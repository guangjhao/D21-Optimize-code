ASAP2_VERSION 1 31
/begin PROJECT ProjectName "Project Comment Goes Here"
/begin HEADER "Header Comments go here" /end HEADER
/begin MODULE ModuleName "Module Comment Goes Here"
/begin MOD_COMMON "Mod Common Comment Here" BYTE_ORDER MSB_LAST /end MOD_COMMON
/begin RECORD_LAYOUT Scalar_BOOLEAN FNC_VALUES 1 UBYTE COLUMN_DIR DIRECT /end RECORD_LAYOUT
/begin RECORD_LAYOUT Scalar_UBYTE FNC_VALUES 1 UBYTE COLUMN_DIR DIRECT /end RECORD_LAYOUT
/begin RECORD_LAYOUT Scalar_BYTE FNC_VALUES 1 SBYTE COLUMN_DIR DIRECT /end RECORD_LAYOUT
/begin RECORD_LAYOUT Scalar_UWORD FNC_VALUES 1 UWORD COLUMN_DIR DIRECT /end RECORD_LAYOUT
/begin RECORD_LAYOUT Scalar_SWORD FNC_VALUES 1 SWORD COLUMN_DIR DIRECT /end RECORD_LAYOUT
/begin RECORD_LAYOUT Scalar_ULONG FNC_VALUES 1 ULONG COLUMN_DIR DIRECT /end RECORD_LAYOUT
/begin RECORD_LAYOUT Scalar_FLOAT32_IEEE FNC_VALUES 1 FLOAT32_IEEE COLUMN_DIR DIRECT /end RECORD_LAYOUT
/begin RECORD_LAYOUT Lookup1D_X_UBYTE AXIS_PTS_X 1 UBYTE INDEX_INCR DIRECT /end RECORD_LAYOUT
/begin RECORD_LAYOUT Lookup1D_UWORD FNC_VALUES 1 UWORD COLUMN_DIR DIRECT /end RECORD_LAYOUT
/begin RECORD_LAYOUT Lookup1D_X_UWORD AXIS_PTS_X 1 UWORD INDEX_INCR DIRECT /end RECORD_LAYOUT
/begin RECORD_LAYOUT Lookup1D_WORD FNC_VALUES 1 SWORD COLUMN_DIR DIRECT /end RECORD_LAYOUT
/begin RECORD_LAYOUT Lookup1D_X_WORD AXIS_PTS_X 1 SWORD INDEX_INCR DIRECT /end RECORD_LAYOUT
/begin RECORD_LAYOUT Lookup1D_ULONG FNC_VALUES 1 ULONG COLUMN_DIR DIRECT /end RECORD_LAYOUT
/begin RECORD_LAYOUT Lookup1D_X_ULONG AXIS_PTS_X 1 ULONG INDEX_INCR DIRECT /end RECORD_LAYOUT
/begin RECORD_LAYOUT Lookup1D_SLONG FNC_VALUES 1 SLONG COLUMN_DIR DIRECT /end RECORD_LAYOUT
/begin RECORD_LAYOUT Lookup1D_X_LONG AXIS_PTS_X 1 SLONG INDEX_INCR DIRECT /end RECORD_LAYOUT
/begin RECORD_LAYOUT Lookup1D_FLOAT32_IEEE FNC_VALUES 1 FLOAT32_IEEE COLUMN_DIR DIRECT /end RECORD_LAYOUT
/begin RECORD_LAYOUT Lookup1D_X_FLOAT32_IEEE AXIS_PTS_X 1 FLOAT32_IEEE INDEX_INCR DIRECT /end RECORD_LAYOUT
/begin RECORD_LAYOUT Lookup1D_FLOAT64_IEEE FNC_VALUES 1 FLOAT64_IEEE COLUMN_DIR DIRECT /end RECORD_LAYOUT
/begin RECORD_LAYOUT Lookup1D_X_FLOAT64_IEEE AXIS_PTS_X 1 FLOAT64_IEEE INDEX_INCR DIRECT /end RECORD_LAYOUT
/begin RECORD_LAYOUT Lookup2D_BOOLEAN FNC_VALUES 1 UBYTE COLUMN_DIR DIRECT /end RECORD_LAYOUT
/begin RECORD_LAYOUT Lookup2D_X_BOOLEAN AXIS_PTS_X 1 UBYTE INDEX_INCR DIRECT /end RECORD_LAYOUT
/begin CHARACTERISTIC KINP_AccelPedal1Vol_V_defval "" VALUE 0x0000 /* @ECU_Address@KINP_AccelPedal1Vol_V_defval@ */ Scalar_FLOAT32_IEEE 0 SWC_INP_type_CM_single_V 0.0 10.0 /end CHARACTERISTIC
/begin CHARACTERISTIC KINP_AccelPedal1Vol_V_limlow "" VALUE 0x0000 /* @ECU_Address@KINP_AccelPedal1Vol_V_limlow@ */ Scalar_FLOAT32_IEEE 0 SWC_INP_type_CM_single_V 0.0 10.0 /end CHARACTERISTIC
/begin CHARACTERISTIC KINP_AccelPedal1Vol_V_limupr "" VALUE 0x0000 /* @ECU_Address@KINP_AccelPedal1Vol_V_limupr@ */ Scalar_FLOAT32_IEEE 0 SWC_INP_type_CM_single_V 0.0 10.0 /end CHARACTERISTIC
/begin CHARACTERISTIC KINP_AccelPedal1Vol_V_ovrdval "" VALUE 0x0000 /* @ECU_Address@KINP_AccelPedal1Vol_V_ovrdval@ */ Scalar_FLOAT32_IEEE 0 SWC_INP_type_CM_single_V 0.0 10.0 /end CHARACTERISTIC
/begin CHARACTERISTIC KINP_AccelPedal1Vol_V_srvcval "" VALUE 0x0000 /* @ECU_Address@KINP_AccelPedal1Vol_V_srvcval@ */ Scalar_FLOAT32_IEEE 0 SWC_INP_type_CM_single_V 0.0 10.0 /end CHARACTERISTIC
/begin CHARACTERISTIC KINP_AccelPedal1Vol_V_tcfilt "" VALUE 0x0000 /* @ECU_Address@KINP_AccelPedal1Vol_V_tcfilt@ */ Scalar_FLOAT32_IEEE 0 SWC_INP_type_CM_single_tc 0.0 1.0 /end CHARACTERISTIC
/begin CHARACTERISTIC KINP_AccelPedal2Vol_V_defval "" VALUE 0x0000 /* @ECU_Address@KINP_AccelPedal2Vol_V_defval@ */ Scalar_FLOAT32_IEEE 0 SWC_INP_type_CM_single_V 0.0 10.0 /end CHARACTERISTIC
/begin CHARACTERISTIC KINP_AccelPedal2Vol_V_limlow "" VALUE 0x0000 /* @ECU_Address@KINP_AccelPedal2Vol_V_limlow@ */ Scalar_FLOAT32_IEEE 0 SWC_INP_type_CM_single_V 0.0 10.0 /end CHARACTERISTIC
/begin CHARACTERISTIC KINP_AccelPedal2Vol_V_limupr "" VALUE 0x0000 /* @ECU_Address@KINP_AccelPedal2Vol_V_limupr@ */ Scalar_FLOAT32_IEEE 0 SWC_INP_type_CM_single_V 0.0 10.0 /end CHARACTERISTIC
/begin CHARACTERISTIC KINP_AccelPedal2Vol_V_ovrdval "" VALUE 0x0000 /* @ECU_Address@KINP_AccelPedal2Vol_V_ovrdval@ */ Scalar_FLOAT32_IEEE 0 SWC_INP_type_CM_single_V 0.0 10.0 /end CHARACTERISTIC
/begin CHARACTERISTIC KINP_AccelPedal2Vol_V_srvcval "" VALUE 0x0000 /* @ECU_Address@KINP_AccelPedal2Vol_V_srvcval@ */ Scalar_FLOAT32_IEEE 0 SWC_INP_type_CM_single_V 0.0 10.0 /end CHARACTERISTIC
/begin CHARACTERISTIC KINP_AccelPedal2Vol_V_tcfilt "" VALUE 0x0000 /* @ECU_Address@KINP_AccelPedal2Vol_V_tcfilt@ */ Scalar_FLOAT32_IEEE 0 SWC_INP_type_CM_single_tc 0.0 1.0 /end CHARACTERISTIC
/begin CHARACTERISTIC KINP_Pedal1Ref5V_V_ovrdval "" VALUE 0x0000 /* @ECU_Address@KINP_Pedal1Ref5V_V_ovrdval@ */ Scalar_FLOAT32_IEEE 0 SWC_INP_type_CM_single_V 0.0 10.0 /end CHARACTERISTIC
/begin CHARACTERISTIC KINP_Pedal2Ref5V_V_ovrdval "" VALUE 0x0000 /* @ECU_Address@KINP_Pedal2Ref5V_V_ovrdval@ */ Scalar_FLOAT32_IEEE 0 SWC_INP_type_CM_single_V 0.0 10.0 /end CHARACTERISTIC
/begin CHARACTERISTIC KINP_LFID_raw_ovrdval "" VALUE 0x0000 /* @ECU_Address@KINP_LFID_raw_ovrdval@ */ Scalar_ULONG 0 SWC_INP_type_CM_uint32_raw 0.0 4.294967295E+9 /end CHARACTERISTIC
/begin CHARACTERISTIC KINP_LFID_raw_ovrflg "" VALUE 0x0000 /* @ECU_Address@KINP_LFID_raw_ovrflg@ */ Scalar_ULONG 0 SWC_INP_type_CM_uint32_raw 0.0 4.294967295E+9 /end CHARACTERISTIC
/begin CHARACTERISTIC KINP_LRID_raw_ovrdval "" VALUE 0x0000 /* @ECU_Address@KINP_LRID_raw_ovrdval@ */ Scalar_ULONG 0 SWC_INP_type_CM_uint32_raw 0.0 4.294967295E+9 /end CHARACTERISTIC
/begin CHARACTERISTIC KINP_RFID_raw_ovrdval "" VALUE 0x0000 /* @ECU_Address@KINP_RFID_raw_ovrdval@ */ Scalar_ULONG 0 SWC_INP_type_CM_uint32_raw 0.0 4.294967295E+9 /end CHARACTERISTIC
/begin CHARACTERISTIC KINP_RRID_raw_ovrdval "" VALUE 0x0000 /* @ECU_Address@KINP_RRID_raw_ovrdval@ */ Scalar_ULONG 0 SWC_INP_type_CM_uint32_raw 0.0 4.294967295E+9 /end CHARACTERISTIC
/begin CHARACTERISTIC KINP_TPMSID_raw_ovrdval "" VALUE 0x0000 /* @ECU_Address@KINP_TPMSID_raw_ovrdval@ */ Scalar_ULONG 0 SWC_INP_type_CM_uint32_raw 0.0 4.294967295E+9 /end CHARACTERISTIC
/begin CHARACTERISTIC KINP_MemOffsetAccX_raw16_ovrdval "" VALUE 0x0000 /* @ECU_Address@KINP_MemOffsetAccX_raw16_ovrdval@ */ Scalar_SWORD 0 SWC_INP_type_CM_int16_raw16 -32768.0 32767.0 /end CHARACTERISTIC
/begin CHARACTERISTIC KINP_MemOffsetAccY_raw16_ovrdval "" VALUE 0x0000 /* @ECU_Address@KINP_MemOffsetAccY_raw16_ovrdval@ */ Scalar_SWORD 0 SWC_INP_type_CM_int16_raw16 -32768.0 32767.0 /end CHARACTERISTIC
/begin CHARACTERISTIC KINP_MemOffsetAccZ_raw16_ovrdval "" VALUE 0x0000 /* @ECU_Address@KINP_MemOffsetAccZ_raw16_ovrdval@ */ Scalar_SWORD 0 SWC_INP_type_CM_int16_raw16 -32768.0 32767.0 /end CHARACTERISTIC
/begin CHARACTERISTIC KINP_MemOffsetGyroX_raw16_ovrdval "" VALUE 0x0000 /* @ECU_Address@KINP_MemOffsetGyroX_raw16_ovrdval@ */ Scalar_SWORD 0 SWC_INP_type_CM_int16_raw16 -32768.0 32767.0 /end CHARACTERISTIC
/begin CHARACTERISTIC KINP_MemOffsetGyroY_raw16_ovrdval "" VALUE 0x0000 /* @ECU_Address@KINP_MemOffsetGyroY_raw16_ovrdval@ */ Scalar_SWORD 0 SWC_INP_type_CM_int16_raw16 -32768.0 32767.0 /end CHARACTERISTIC
/begin CHARACTERISTIC KINP_MemOffsetGyroZ_raw16_ovrdval "" VALUE 0x0000 /* @ECU_Address@KINP_MemOffsetGyroZ_raw16_ovrdval@ */ Scalar_SWORD 0 SWC_INP_type_CM_int16_raw16 -32768.0 32767.0 /end CHARACTERISTIC
/begin CHARACTERISTIC KINP_SensingAccX_raw16_ovrdval "" VALUE 0x0000 /* @ECU_Address@KINP_SensingAccX_raw16_ovrdval@ */ Scalar_SWORD 0 SWC_INP_type_CM_int16_raw16 -32768.0 32767.0 /end CHARACTERISTIC
/begin CHARACTERISTIC KINP_SensingAccY_raw16_ovrdval "" VALUE 0x0000 /* @ECU_Address@KINP_SensingAccY_raw16_ovrdval@ */ Scalar_SWORD 0 SWC_INP_type_CM_int16_raw16 -32768.0 32767.0 /end CHARACTERISTIC
/begin CHARACTERISTIC KINP_SensingAccZ_raw16_ovrdval "" VALUE 0x0000 /* @ECU_Address@KINP_SensingAccZ_raw16_ovrdval@ */ Scalar_SWORD 0 SWC_INP_type_CM_int16_raw16 -32768.0 32767.0 /end CHARACTERISTIC
/begin CHARACTERISTIC KINP_SensingGyroX_raw16_ovrdval "" VALUE 0x0000 /* @ECU_Address@KINP_SensingGyroX_raw16_ovrdval@ */ Scalar_SWORD 0 SWC_INP_type_CM_int16_raw16 -32768.0 32767.0 /end CHARACTERISTIC
/begin CHARACTERISTIC KINP_SensingGyroY_raw16_ovrdval "" VALUE 0x0000 /* @ECU_Address@KINP_SensingGyroY_raw16_ovrdval@ */ Scalar_SWORD 0 SWC_INP_type_CM_int16_raw16 -32768.0 32767.0 /end CHARACTERISTIC
/begin CHARACTERISTIC KINP_SensingGyroZ_raw16_ovrdval "" VALUE 0x0000 /* @ECU_Address@KINP_SensingGyroZ_raw16_ovrdval@ */ Scalar_SWORD 0 SWC_INP_type_CM_int16_raw16 -32768.0 32767.0 /end CHARACTERISTIC
/begin CHARACTERISTIC KINP_AuxBattVolmV_mV_ovrdval "" VALUE 0x0000 /* @ECU_Address@KINP_AuxBattVolmV_mV_ovrdval@ */ Scalar_UWORD 0 SWC_INP_type_CM_uint16_mV 0.0 65535.0 /end CHARACTERISTIC
/begin CHARACTERISTIC KINP_KeyFobAreaU16_enum_ovrdval "" VALUE 0x0000 /* @ECU_Address@KINP_KeyFobAreaU16_enum_ovrdval@ */ Scalar_UWORD 0 SWC_INP_type_CM_uint16_enum 0.0 65535.0 /end CHARACTERISTIC
/begin CHARACTERISTIC KINP_UIDBatVoltx1000_V_ovrdval "" VALUE 0x0000 /* @ECU_Address@KINP_UIDBatVoltx1000_V_ovrdval@ */ Scalar_UWORD 0 SWC_INP_type_CM_uint16_V 0.0 65535.0 /end CHARACTERISTIC
/begin CHARACTERISTIC KINP_AccelPedal1Vol_V_ovrdflg "" VALUE 0x0000 /* @ECU_Address@KINP_AccelPedal1Vol_V_ovrdflg@ */ Scalar_BOOLEAN 0 SWC_INP_type_CM_boolean_flg 0.0 1.0 /end CHARACTERISTIC
/begin CHARACTERISTIC KINP_AccelPedal1Vol_V_srvcflg "" VALUE 0x0000 /* @ECU_Address@KINP_AccelPedal1Vol_V_srvcflg@ */ Scalar_BOOLEAN 0 SWC_INP_type_CM_boolean_flg 0.0 1.0 /end CHARACTERISTIC
/begin CHARACTERISTIC KINP_AccelPedal2Vol_V_ovrdflg "" VALUE 0x0000 /* @ECU_Address@KINP_AccelPedal2Vol_V_ovrdflg@ */ Scalar_BOOLEAN 0 SWC_INP_type_CM_boolean_flg 0.0 1.0 /end CHARACTERISTIC
/begin CHARACTERISTIC KINP_AccelPedal2Vol_V_srvcflg "" VALUE 0x0000 /* @ECU_Address@KINP_AccelPedal2Vol_V_srvcflg@ */ Scalar_BOOLEAN 0 SWC_INP_type_CM_boolean_flg 0.0 1.0 /end CHARACTERISTIC
/begin CHARACTERISTIC KINP_AcoreReadyToSlp_flg_ovrdflg "" VALUE 0x0000 /* @ECU_Address@KINP_AcoreReadyToSlp_flg_ovrdflg@ */ Scalar_BOOLEAN 0 SWC_INP_type_CM_boolean_flg 0.0 1.0 /end CHARACTERISTIC
/begin CHARACTERISTIC KINP_AcoreReadyToSlp_flg_ovrdval "" VALUE 0x0000 /* @ECU_Address@KINP_AcoreReadyToSlp_flg_ovrdval@ */ Scalar_BOOLEAN 0 SWC_INP_type_CM_boolean_flg 0.0 1.0 /end CHARACTERISTIC
/begin CHARACTERISTIC KINP_AlcoholPass_flg_inverse "" VALUE 0x0000 /* @ECU_Address@KINP_AlcoholPass_flg_inverse@ */ Scalar_BOOLEAN 0 SWC_INP_type_CM_boolean_flg 0.0 1.0 /end CHARACTERISTIC
/begin CHARACTERISTIC KINP_AlcoholPass_flg_ovrdflg "" VALUE 0x0000 /* @ECU_Address@KINP_AlcoholPass_flg_ovrdflg@ */ Scalar_BOOLEAN 0 SWC_INP_type_CM_boolean_flg 0.0 1.0 /end CHARACTERISTIC
/begin CHARACTERISTIC KINP_AlcoholPass_flg_ovrdval "" VALUE 0x0000 /* @ECU_Address@KINP_AlcoholPass_flg_ovrdval@ */ Scalar_BOOLEAN 0 SWC_INP_type_CM_boolean_flg 0.0 1.0 /end CHARACTERISTIC
/begin CHARACTERISTIC KINP_AlcoholPass_flg_srvcflg "" VALUE 0x0000 /* @ECU_Address@KINP_AlcoholPass_flg_srvcflg@ */ Scalar_BOOLEAN 0 SWC_INP_type_CM_boolean_flg 0.0 1.0 /end CHARACTERISTIC
/begin CHARACTERISTIC KINP_AlcoholPass_flg_srvcval "" VALUE 0x0000 /* @ECU_Address@KINP_AlcoholPass_flg_srvcval@ */ Scalar_BOOLEAN 0 SWC_INP_type_CM_boolean_flg 0.0 1.0 /end CHARACTERISTIC
/begin CHARACTERISTIC KINP_AuxBattVolmV_mV_ovrdflg "" VALUE 0x0000 /* @ECU_Address@KINP_AuxBattVolmV_mV_ovrdflg@ */ Scalar_BOOLEAN 0 SWC_INP_type_CM_boolean_flg 0.0 1.0 /end CHARACTERISTIC
/begin CHARACTERISTIC KINP_BTConnectSta_enum_ovrdflg "" VALUE 0x0000 /* @ECU_Address@KINP_BTConnectSta_enum_ovrdflg@ */ Scalar_BOOLEAN 0 SWC_INP_type_CM_boolean_flg 0.0 1.0 /end CHARACTERISTIC
/begin CHARACTERISTIC KINP_BmsAplus_flg_inverse "" VALUE 0x0000 /* @ECU_Address@KINP_BmsAplus_flg_inverse@ */ Scalar_BOOLEAN 0 SWC_INP_type_CM_boolean_flg 0.0 1.0 /end CHARACTERISTIC
/begin CHARACTERISTIC KINP_BmsAplus_flg_ovrdflg "" VALUE 0x0000 /* @ECU_Address@KINP_BmsAplus_flg_ovrdflg@ */ Scalar_BOOLEAN 0 SWC_INP_type_CM_boolean_flg 0.0 1.0 /end CHARACTERISTIC
/begin CHARACTERISTIC KINP_BmsAplus_flg_ovrdval "" VALUE 0x0000 /* @ECU_Address@KINP_BmsAplus_flg_ovrdval@ */ Scalar_BOOLEAN 0 SWC_INP_type_CM_boolean_flg 0.0 1.0 /end CHARACTERISTIC
/begin CHARACTERISTIC KINP_BmsAplus_flg_srvcflg "" VALUE 0x0000 /* @ECU_Address@KINP_BmsAplus_flg_srvcflg@ */ Scalar_BOOLEAN 0 SWC_INP_type_CM_boolean_flg 0.0 1.0 /end CHARACTERISTIC
/begin CHARACTERISTIC KINP_BmsAplus_flg_srvcval "" VALUE 0x0000 /* @ECU_Address@KINP_BmsAplus_flg_srvcval@ */ Scalar_BOOLEAN 0 SWC_INP_type_CM_boolean_flg 0.0 1.0 /end CHARACTERISTIC
/begin CHARACTERISTIC KINP_BrakeLampSW_flg_inverse "" VALUE 0x0000 /* @ECU_Address@KINP_BrakeLampSW_flg_inverse@ */ Scalar_BOOLEAN 0 SWC_INP_type_CM_boolean_flg 0.0 1.0 /end CHARACTERISTIC
/begin CHARACTERISTIC KINP_BrakeLampSW_flg_ovrdflg "" VALUE 0x0000 /* @ECU_Address@KINP_BrakeLampSW_flg_ovrdflg@ */ Scalar_BOOLEAN 0 SWC_INP_type_CM_boolean_flg 0.0 1.0 /end CHARACTERISTIC
/begin CHARACTERISTIC KINP_BrakeLampSW_flg_ovrdval "" VALUE 0x0000 /* @ECU_Address@KINP_BrakeLampSW_flg_ovrdval@ */ Scalar_BOOLEAN 0 SWC_INP_type_CM_boolean_flg 0.0 1.0 /end CHARACTERISTIC
/begin CHARACTERISTIC KINP_BrakeLampSW_flg_srvcflg "" VALUE 0x0000 /* @ECU_Address@KINP_BrakeLampSW_flg_srvcflg@ */ Scalar_BOOLEAN 0 SWC_INP_type_CM_boolean_flg 0.0 1.0 /end CHARACTERISTIC
/begin CHARACTERISTIC KINP_BrakeLampSW_flg_srvcval "" VALUE 0x0000 /* @ECU_Address@KINP_BrakeLampSW_flg_srvcval@ */ Scalar_BOOLEAN 0 SWC_INP_type_CM_boolean_flg 0.0 1.0 /end CHARACTERISTIC
/begin CHARACTERISTIC KINP_BrakeSWGPIO_flg_inverse "" VALUE 0x0000 /* @ECU_Address@KINP_BrakeSWGPIO_flg_inverse@ */ Scalar_BOOLEAN 0 SWC_INP_type_CM_boolean_flg 0.0 1.0 /end CHARACTERISTIC
/begin CHARACTERISTIC KINP_BrakeSWGPIO_flg_ovrdflg "" VALUE 0x0000 /* @ECU_Address@KINP_BrakeSWGPIO_flg_ovrdflg@ */ Scalar_BOOLEAN 0 SWC_INP_type_CM_boolean_flg 0.0 1.0 /end CHARACTERISTIC
/begin CHARACTERISTIC KINP_BrakeSWGPIO_flg_ovrdval "" VALUE 0x0000 /* @ECU_Address@KINP_BrakeSWGPIO_flg_ovrdval@ */ Scalar_BOOLEAN 0 SWC_INP_type_CM_boolean_flg 0.0 1.0 /end CHARACTERISTIC
/begin CHARACTERISTIC KINP_BrakeSWGPIO_flg_srvcflg "" VALUE 0x0000 /* @ECU_Address@KINP_BrakeSWGPIO_flg_srvcflg@ */ Scalar_BOOLEAN 0 SWC_INP_type_CM_boolean_flg 0.0 1.0 /end CHARACTERISTIC
/begin CHARACTERISTIC KINP_BrakeSWGPIO_flg_srvcval "" VALUE 0x0000 /* @ECU_Address@KINP_BrakeSWGPIO_flg_srvcval@ */ Scalar_BOOLEAN 0 SWC_INP_type_CM_boolean_flg 0.0 1.0 /end CHARACTERISTIC
/begin CHARACTERISTIC KINP_CAN1BusOff_flg_ovrdflg "" VALUE 0x0000 /* @ECU_Address@KINP_CAN1BusOff_flg_ovrdflg@ */ Scalar_BOOLEAN 0 SWC_INP_type_CM_boolean_flg 0.0 1.0 /end CHARACTERISTIC
/begin CHARACTERISTIC KINP_CAN1BusOff_flg_ovrdval "" VALUE 0x0000 /* @ECU_Address@KINP_CAN1BusOff_flg_ovrdval@ */ Scalar_BOOLEAN 0 SWC_INP_type_CM_boolean_flg 0.0 1.0 /end CHARACTERISTIC
/begin CHARACTERISTIC KINP_CAN2BusOff_flg_ovrdflg "" VALUE 0x0000 /* @ECU_Address@KINP_CAN2BusOff_flg_ovrdflg@ */ Scalar_BOOLEAN 0 SWC_INP_type_CM_boolean_flg 0.0 1.0 /end CHARACTERISTIC
/begin CHARACTERISTIC KINP_CAN2BusOff_flg_ovrdval "" VALUE 0x0000 /* @ECU_Address@KINP_CAN2BusOff_flg_ovrdval@ */ Scalar_BOOLEAN 0 SWC_INP_type_CM_boolean_flg 0.0 1.0 /end CHARACTERISTIC
/begin CHARACTERISTIC KINP_CAN3BusOff_flg_ovrdflg "" VALUE 0x0000 /* @ECU_Address@KINP_CAN3BusOff_flg_ovrdflg@ */ Scalar_BOOLEAN 0 SWC_INP_type_CM_boolean_flg 0.0 1.0 /end CHARACTERISTIC
/begin CHARACTERISTIC KINP_CAN3BusOff_flg_ovrdval "" VALUE 0x0000 /* @ECU_Address@KINP_CAN3BusOff_flg_ovrdval@ */ Scalar_BOOLEAN 0 SWC_INP_type_CM_boolean_flg 0.0 1.0 /end CHARACTERISTIC
/begin CHARACTERISTIC KINP_CAN4BusOff_flg_ovrdflg "" VALUE 0x0000 /* @ECU_Address@KINP_CAN4BusOff_flg_ovrdflg@ */ Scalar_BOOLEAN 0 SWC_INP_type_CM_boolean_flg 0.0 1.0 /end CHARACTERISTIC
/begin CHARACTERISTIC KINP_CAN4BusOff_flg_ovrdval "" VALUE 0x0000 /* @ECU_Address@KINP_CAN4BusOff_flg_ovrdval@ */ Scalar_BOOLEAN 0 SWC_INP_type_CM_boolean_flg 0.0 1.0 /end CHARACTERISTIC
/begin CHARACTERISTIC KINP_CAN5BusOff_flg_ovrdflg "" VALUE 0x0000 /* @ECU_Address@KINP_CAN5BusOff_flg_ovrdflg@ */ Scalar_BOOLEAN 0 SWC_INP_type_CM_boolean_flg 0.0 1.0 /end CHARACTERISTIC
/begin CHARACTERISTIC KINP_CAN5BusOff_flg_ovrdval "" VALUE 0x0000 /* @ECU_Address@KINP_CAN5BusOff_flg_ovrdval@ */ Scalar_BOOLEAN 0 SWC_INP_type_CM_boolean_flg 0.0 1.0 /end CHARACTERISTIC
/begin CHARACTERISTIC KINP_CAN6BusOff_flg_ovrdflg "" VALUE 0x0000 /* @ECU_Address@KINP_CAN6BusOff_flg_ovrdflg@ */ Scalar_BOOLEAN 0 SWC_INP_type_CM_boolean_flg 0.0 1.0 /end CHARACTERISTIC
/begin CHARACTERISTIC KINP_CAN6BusOff_flg_ovrdval "" VALUE 0x0000 /* @ECU_Address@KINP_CAN6BusOff_flg_ovrdval@ */ Scalar_BOOLEAN 0 SWC_INP_type_CM_boolean_flg 0.0 1.0 /end CHARACTERISTIC
/begin CHARACTERISTIC KINP_CANMsgInvalidACBTMSC10000_flg_ovrdflg "" VALUE 0x0000 /* @ECU_Address@KINP_CANMsgInvalidACBTMSC10000_flg_ovrdflg@ */ Scalar_BOOLEAN 0 SWC_INP_type_CM_boolean_flg 0.0 1.0 /end CHARACTERISTIC
/begin CHARACTERISTIC KINP_CANMsgInvalidACBTMSC10000_flg_ovrdval "" VALUE 0x0000 /* @ECU_Address@KINP_CANMsgInvalidACBTMSC10000_flg_ovrdval@ */ Scalar_BOOLEAN 0 SWC_INP_type_CM_boolean_flg 0.0 1.0 /end CHARACTERISTIC
/begin CHARACTERISTIC KINP_CANMsgInvalidACBTMSC10001_flg_ovrdflg "" VALUE 0x0000 /* @ECU_Address@KINP_CANMsgInvalidACBTMSC10001_flg_ovrdflg@ */ Scalar_BOOLEAN 0 SWC_INP_type_CM_boolean_flg 0.0 1.0 /end CHARACTERISTIC
/begin CHARACTERISTIC KINP_CANMsgInvalidACBTMSC10001_flg_ovrdval "" VALUE 0x0000 /* @ECU_Address@KINP_CANMsgInvalidACBTMSC10001_flg_ovrdval@ */ Scalar_BOOLEAN 0 SWC_INP_type_CM_boolean_flg 0.0 1.0 /end CHARACTERISTIC
/begin CHARACTERISTIC KINP_CANMsgInvalidACBTMSC10004_flg_ovrdflg "" VALUE 0x0000 /* @ECU_Address@KINP_CANMsgInvalidACBTMSC10004_flg_ovrdflg@ */ Scalar_BOOLEAN 0 SWC_INP_type_CM_boolean_flg 0.0 1.0 /end CHARACTERISTIC
/begin CHARACTERISTIC KINP_CANMsgInvalidACBTMSC10004_flg_ovrdval "" VALUE 0x0000 /* @ECU_Address@KINP_CANMsgInvalidACBTMSC10004_flg_ovrdval@ */ Scalar_BOOLEAN 0 SWC_INP_type_CM_boolean_flg 0.0 1.0 /end CHARACTERISTIC
/begin CHARACTERISTIC KINP_CANMsgInvalidACBTMSC50000_flg_ovrdflg "" VALUE 0x0000 /* @ECU_Address@KINP_CANMsgInvalidACBTMSC50000_flg_ovrdflg@ */ Scalar_BOOLEAN 0 SWC_INP_type_CM_boolean_flg 0.0 1.0 /end CHARACTERISTIC
/begin CHARACTERISTIC KINP_CANMsgInvalidACBTMSC50000_flg_ovrdval "" VALUE 0x0000 /* @ECU_Address@KINP_CANMsgInvalidACBTMSC50000_flg_ovrdval@ */ Scalar_BOOLEAN 0 SWC_INP_type_CM_boolean_flg 0.0 1.0 /end CHARACTERISTIC
/begin CHARACTERISTIC KINP_CANMsgInvalidASC1A_flg_ovrdflg "" VALUE 0x0000 /* @ECU_Address@KINP_CANMsgInvalidASC1A_flg_ovrdflg@ */ Scalar_BOOLEAN 0 SWC_INP_type_CM_boolean_flg 0.0 1.0 /end CHARACTERISTIC
/begin CHARACTERISTIC KINP_CANMsgInvalidASC1A_flg_ovrdval "" VALUE 0x0000 /* @ECU_Address@KINP_CANMsgInvalidASC1A_flg_ovrdval@ */ Scalar_BOOLEAN 0 SWC_INP_type_CM_boolean_flg 0.0 1.0 /end CHARACTERISTIC
/begin CHARACTERISTIC KINP_CANMsgInvalidB2TMInfo_flg_ovrdflg "" VALUE 0x0000 /* @ECU_Address@KINP_CANMsgInvalidB2TMInfo_flg_ovrdflg@ */ Scalar_BOOLEAN 0 SWC_INP_type_CM_boolean_flg 0.0 1.0 /end CHARACTERISTIC
/begin CHARACTERISTIC KINP_CANMsgInvalidB2TMInfo_flg_ovrdval "" VALUE 0x0000 /* @ECU_Address@KINP_CANMsgInvalidB2TMInfo_flg_ovrdval@ */ Scalar_BOOLEAN 0 SWC_INP_type_CM_boolean_flg 0.0 1.0 /end CHARACTERISTIC
/begin CHARACTERISTIC KINP_CANMsgInvalidB2VBattInfo1_flg_ovrdflg "" VALUE 0x0000 /* @ECU_Address@KINP_CANMsgInvalidB2VBattInfo1_flg_ovrdflg@ */ Scalar_BOOLEAN 0 SWC_INP_type_CM_boolean_flg 0.0 1.0 /end CHARACTERISTIC
/begin CHARACTERISTIC KINP_CANMsgInvalidB2VBattInfo1_flg_ovrdval "" VALUE 0x0000 /* @ECU_Address@KINP_CANMsgInvalidB2VBattInfo1_flg_ovrdval@ */ Scalar_BOOLEAN 0 SWC_INP_type_CM_boolean_flg 0.0 1.0 /end CHARACTERISTIC
/begin CHARACTERISTIC KINP_CANMsgInvalidB2VCurrentLimit_flg_ovrdflg "" VALUE 0x0000 /* @ECU_Address@KINP_CANMsgInvalidB2VCurrentLimit_flg_ovrdflg@ */ Scalar_BOOLEAN 0 SWC_INP_type_CM_boolean_flg 0.0 1.0 /end CHARACTERISTIC
/begin CHARACTERISTIC KINP_CANMsgInvalidB2VCurrentLimit_flg_ovrdval "" VALUE 0x0000 /* @ECU_Address@KINP_CANMsgInvalidB2VCurrentLimit_flg_ovrdval@ */ Scalar_BOOLEAN 0 SWC_INP_type_CM_boolean_flg 0.0 1.0 /end CHARACTERISTIC
/begin CHARACTERISTIC KINP_CANMsgInvalidB2VFult132960_flg_ovrdflg "" VALUE 0x0000 /* @ECU_Address@KINP_CANMsgInvalidB2VFult132960_flg_ovrdflg@ */ Scalar_BOOLEAN 0 SWC_INP_type_CM_boolean_flg 0.0 1.0 /end CHARACTERISTIC
/begin CHARACTERISTIC KINP_CANMsgInvalidB2VFult132960_flg_ovrdval "" VALUE 0x0000 /* @ECU_Address@KINP_CANMsgInvalidB2VFult132960_flg_ovrdval@ */ Scalar_BOOLEAN 0 SWC_INP_type_CM_boolean_flg 0.0 1.0 /end CHARACTERISTIC
/begin CHARACTERISTIC KINP_CANMsgInvalidB2VST1_flg_ovrdflg "" VALUE 0x0000 /* @ECU_Address@KINP_CANMsgInvalidB2VST1_flg_ovrdflg@ */ Scalar_BOOLEAN 0 SWC_INP_type_CM_boolean_flg 0.0 1.0 /end CHARACTERISTIC
/begin CHARACTERISTIC KINP_CANMsgInvalidB2VST1_flg_ovrdval "" VALUE 0x0000 /* @ECU_Address@KINP_CANMsgInvalidB2VST1_flg_ovrdval@ */ Scalar_BOOLEAN 0 SWC_INP_type_CM_boolean_flg 0.0 1.0 /end CHARACTERISTIC
/begin CHARACTERISTIC KINP_CANMsgInvalidB2VST2_flg_ovrdflg "" VALUE 0x0000 /* @ECU_Address@KINP_CANMsgInvalidB2VST2_flg_ovrdflg@ */ Scalar_BOOLEAN 0 SWC_INP_type_CM_boolean_flg 0.0 1.0 /end CHARACTERISTIC
/begin CHARACTERISTIC KINP_CANMsgInvalidB2VST2_flg_ovrdval "" VALUE 0x0000 /* @ECU_Address@KINP_CANMsgInvalidB2VST2_flg_ovrdval@ */ Scalar_BOOLEAN 0 SWC_INP_type_CM_boolean_flg 0.0 1.0 /end CHARACTERISTIC
/begin CHARACTERISTIC KINP_CANMsgInvalidB2VST4_flg_ovrdflg "" VALUE 0x0000 /* @ECU_Address@KINP_CANMsgInvalidB2VST4_flg_ovrdflg@ */ Scalar_BOOLEAN 0 SWC_INP_type_CM_boolean_flg 0.0 1.0 /end CHARACTERISTIC
/begin CHARACTERISTIC KINP_CANMsgInvalidB2VST4_flg_ovrdval "" VALUE 0x0000 /* @ECU_Address@KINP_CANMsgInvalidB2VST4_flg_ovrdval@ */ Scalar_BOOLEAN 0 SWC_INP_type_CM_boolean_flg 0.0 1.0 /end CHARACTERISTIC
/begin CHARACTERISTIC KINP_CANMsgInvalidB2VST5_flg_ovrdflg "" VALUE 0x0000 /* @ECU_Address@KINP_CANMsgInvalidB2VST5_flg_ovrdflg@ */ Scalar_BOOLEAN 0 SWC_INP_type_CM_boolean_flg 0.0 1.0 /end CHARACTERISTIC
/begin CHARACTERISTIC KINP_CANMsgInvalidB2VST5_flg_ovrdval "" VALUE 0x0000 /* @ECU_Address@KINP_CANMsgInvalidB2VST5_flg_ovrdval@ */ Scalar_BOOLEAN 0 SWC_INP_type_CM_boolean_flg 0.0 1.0 /end CHARACTERISTIC
/begin CHARACTERISTIC KINP_CANMsgInvalidEBC1_flg_ovrdflg "" VALUE 0x0000 /* @ECU_Address@KINP_CANMsgInvalidEBC1_flg_ovrdflg@ */ Scalar_BOOLEAN 0 SWC_INP_type_CM_boolean_flg 0.0 1.0 /end CHARACTERISTIC
/begin CHARACTERISTIC KINP_CANMsgInvalidEBC1_flg_ovrdval "" VALUE 0x0000 /* @ECU_Address@KINP_CANMsgInvalidEBC1_flg_ovrdval@ */ Scalar_BOOLEAN 0 SWC_INP_type_CM_boolean_flg 0.0 1.0 /end CHARACTERISTIC
/begin CHARACTERISTIC KINP_CANMsgInvalidEBC2_flg_ovrdflg "" VALUE 0x0000 /* @ECU_Address@KINP_CANMsgInvalidEBC2_flg_ovrdflg@ */ Scalar_BOOLEAN 0 SWC_INP_type_CM_boolean_flg 0.0 1.0 /end CHARACTERISTIC
/begin CHARACTERISTIC KINP_CANMsgInvalidEBC2_flg_ovrdval "" VALUE 0x0000 /* @ECU_Address@KINP_CANMsgInvalidEBC2_flg_ovrdval@ */ Scalar_BOOLEAN 0 SWC_INP_type_CM_boolean_flg 0.0 1.0 /end CHARACTERISTIC
/begin CHARACTERISTIC KINP_CANMsgInvalidEBC5_flg_ovrdflg "" VALUE 0x0000 /* @ECU_Address@KINP_CANMsgInvalidEBC5_flg_ovrdflg@ */ Scalar_BOOLEAN 0 SWC_INP_type_CM_boolean_flg 0.0 1.0 /end CHARACTERISTIC
/begin CHARACTERISTIC KINP_CANMsgInvalidEBC5_flg_ovrdval "" VALUE 0x0000 /* @ECU_Address@KINP_CANMsgInvalidEBC5_flg_ovrdval@ */ Scalar_BOOLEAN 0 SWC_INP_type_CM_boolean_flg 0.0 1.0 /end CHARACTERISTIC
/begin CHARACTERISTIC KINP_CANMsgInvalidECASDM1_flg_ovrdflg "" VALUE 0x0000 /* @ECU_Address@KINP_CANMsgInvalidECASDM1_flg_ovrdflg@ */ Scalar_BOOLEAN 0 SWC_INP_type_CM_boolean_flg 0.0 1.0 /end CHARACTERISTIC
/begin CHARACTERISTIC KINP_CANMsgInvalidECASDM1_flg_ovrdval "" VALUE 0x0000 /* @ECU_Address@KINP_CANMsgInvalidECASDM1_flg_ovrdval@ */ Scalar_BOOLEAN 0 SWC_INP_type_CM_boolean_flg 0.0 1.0 /end CHARACTERISTIC
/begin CHARACTERISTIC KINP_CANMsgInvalidEMC1EM1_flg_ovrdflg "" VALUE 0x0000 /* @ECU_Address@KINP_CANMsgInvalidEMC1EM1_flg_ovrdflg@ */ Scalar_BOOLEAN 0 SWC_INP_type_CM_boolean_flg 0.0 1.0 /end CHARACTERISTIC
/begin CHARACTERISTIC KINP_CANMsgInvalidEMC1EM1_flg_ovrdval "" VALUE 0x0000 /* @ECU_Address@KINP_CANMsgInvalidEMC1EM1_flg_ovrdval@ */ Scalar_BOOLEAN 0 SWC_INP_type_CM_boolean_flg 0.0 1.0 /end CHARACTERISTIC
/begin CHARACTERISTIC KINP_CANMsgInvalidEWP1_flg_ovrdflg "" VALUE 0x0000 /* @ECU_Address@KINP_CANMsgInvalidEWP1_flg_ovrdflg@ */ Scalar_BOOLEAN 0 SWC_INP_type_CM_boolean_flg 0.0 1.0 /end CHARACTERISTIC
/begin CHARACTERISTIC KINP_CANMsgInvalidEWP1_flg_ovrdval "" VALUE 0x0000 /* @ECU_Address@KINP_CANMsgInvalidEWP1_flg_ovrdval@ */ Scalar_BOOLEAN 0 SWC_INP_type_CM_boolean_flg 0.0 1.0 /end CHARACTERISTIC
/begin CHARACTERISTIC KINP_CANMsgInvalidHRW_flg_ovrdflg "" VALUE 0x0000 /* @ECU_Address@KINP_CANMsgInvalidHRW_flg_ovrdflg@ */ Scalar_BOOLEAN 0 SWC_INP_type_CM_boolean_flg 0.0 1.0 /end CHARACTERISTIC
/begin CHARACTERISTIC KINP_CANMsgInvalidHRW_flg_ovrdval "" VALUE 0x0000 /* @ECU_Address@KINP_CANMsgInvalidHRW_flg_ovrdval@ */ Scalar_BOOLEAN 0 SWC_INP_type_CM_boolean_flg 0.0 1.0 /end CHARACTERISTIC
/begin CHARACTERISTIC KINP_CANMsgInvalidIVIC1000_flg_ovrdflg "" VALUE 0x0000 /* @ECU_Address@KINP_CANMsgInvalidIVIC1000_flg_ovrdflg@ */ Scalar_BOOLEAN 0 SWC_INP_type_CM_boolean_flg 0.0 1.0 /end CHARACTERISTIC
/begin CHARACTERISTIC KINP_CANMsgInvalidIVIC1000_flg_ovrdval "" VALUE 0x0000 /* @ECU_Address@KINP_CANMsgInvalidIVIC1000_flg_ovrdval@ */ Scalar_BOOLEAN 0 SWC_INP_type_CM_boolean_flg 0.0 1.0 /end CHARACTERISTIC
/begin CHARACTERISTIC KINP_CANMsgInvalidTC1_flg_ovrdflg "" VALUE 0x0000 /* @ECU_Address@KINP_CANMsgInvalidTC1_flg_ovrdflg@ */ Scalar_BOOLEAN 0 SWC_INP_type_CM_boolean_flg 0.0 1.0 /end CHARACTERISTIC
/begin CHARACTERISTIC KINP_CANMsgInvalidTC1_flg_ovrdval "" VALUE 0x0000 /* @ECU_Address@KINP_CANMsgInvalidTC1_flg_ovrdval@ */ Scalar_BOOLEAN 0 SWC_INP_type_CM_boolean_flg 0.0 1.0 /end CHARACTERISTIC
/begin CHARACTERISTIC KINP_CANMsgInvalidTMMCUSta1_flg_ovrdflg "" VALUE 0x0000 /* @ECU_Address@KINP_CANMsgInvalidTMMCUSta1_flg_ovrdflg@ */ Scalar_BOOLEAN 0 SWC_INP_type_CM_boolean_flg 0.0 1.0 /end CHARACTERISTIC
/begin CHARACTERISTIC KINP_CANMsgInvalidTMMCUSta1_flg_ovrdval "" VALUE 0x0000 /* @ECU_Address@KINP_CANMsgInvalidTMMCUSta1_flg_ovrdval@ */ Scalar_BOOLEAN 0 SWC_INP_type_CM_boolean_flg 0.0 1.0 /end CHARACTERISTIC
/begin CHARACTERISTIC KINP_CANMsgInvalidTMMCUSta2_flg_ovrdflg "" VALUE 0x0000 /* @ECU_Address@KINP_CANMsgInvalidTMMCUSta2_flg_ovrdflg@ */ Scalar_BOOLEAN 0 SWC_INP_type_CM_boolean_flg 0.0 1.0 /end CHARACTERISTIC
/begin CHARACTERISTIC KINP_CANMsgInvalidTMMCUSta2_flg_ovrdval "" VALUE 0x0000 /* @ECU_Address@KINP_CANMsgInvalidTMMCUSta2_flg_ovrdval@ */ Scalar_BOOLEAN 0 SWC_INP_type_CM_boolean_flg 0.0 1.0 /end CHARACTERISTIC
/begin CHARACTERISTIC KINP_CANMsgInvalidTMMCUSta3_flg_ovrdflg "" VALUE 0x0000 /* @ECU_Address@KINP_CANMsgInvalidTMMCUSta3_flg_ovrdflg@ */ Scalar_BOOLEAN 0 SWC_INP_type_CM_boolean_flg 0.0 1.0 /end CHARACTERISTIC
/begin CHARACTERISTIC KINP_CANMsgInvalidTMMCUSta3_flg_ovrdval "" VALUE 0x0000 /* @ECU_Address@KINP_CANMsgInvalidTMMCUSta3_flg_ovrdval@ */ Scalar_BOOLEAN 0 SWC_INP_type_CM_boolean_flg 0.0 1.0 /end CHARACTERISTIC
/begin CHARACTERISTIC KINP_CANMsgInvalidZFRC1000_flg_ovrdflg "" VALUE 0x0000 /* @ECU_Address@KINP_CANMsgInvalidZFRC1000_flg_ovrdflg@ */ Scalar_BOOLEAN 0 SWC_INP_type_CM_boolean_flg 0.0 1.0 /end CHARACTERISTIC
/begin CHARACTERISTIC KINP_CANMsgInvalidZFRC1000_flg_ovrdval "" VALUE 0x0000 /* @ECU_Address@KINP_CANMsgInvalidZFRC1000_flg_ovrdval@ */ Scalar_BOOLEAN 0 SWC_INP_type_CM_boolean_flg 0.0 1.0 /end CHARACTERISTIC
/begin CHARACTERISTIC KINP_CANMsgInvalidZFRCE1000_flg_ovrdflg "" VALUE 0x0000 /* @ECU_Address@KINP_CANMsgInvalidZFRCE1000_flg_ovrdflg@ */ Scalar_BOOLEAN 0 SWC_INP_type_CM_boolean_flg 0.0 1.0 /end CHARACTERISTIC
/begin CHARACTERISTIC KINP_CANMsgInvalidZFRCE1000_flg_ovrdval "" VALUE 0x0000 /* @ECU_Address@KINP_CANMsgInvalidZFRCE1000_flg_ovrdval@ */ Scalar_BOOLEAN 0 SWC_INP_type_CM_boolean_flg 0.0 1.0 /end CHARACTERISTIC
/begin CHARACTERISTIC KINP_CANMsgInvalidZRRCE1000_flg_ovrdflg "" VALUE 0x0000 /* @ECU_Address@KINP_CANMsgInvalidZRRCE1000_flg_ovrdflg@ */ Scalar_BOOLEAN 0 SWC_INP_type_CM_boolean_flg 0.0 1.0 /end CHARACTERISTIC
/begin CHARACTERISTIC KINP_CANMsgInvalidZRRCE1000_flg_ovrdval "" VALUE 0x0000 /* @ECU_Address@KINP_CANMsgInvalidZRRCE1000_flg_ovrdval@ */ Scalar_BOOLEAN 0 SWC_INP_type_CM_boolean_flg 0.0 1.0 /end CHARACTERISTIC
/begin CHARACTERISTIC KINP_CANMsgInvalidZRRCE1001_flg_ovrdflg "" VALUE 0x0000 /* @ECU_Address@KINP_CANMsgInvalidZRRCE1001_flg_ovrdflg@ */ Scalar_BOOLEAN 0 SWC_INP_type_CM_boolean_flg 0.0 1.0 /end CHARACTERISTIC
/begin CHARACTERISTIC KINP_CANMsgInvalidZRRCE1001_flg_ovrdval "" VALUE 0x0000 /* @ECU_Address@KINP_CANMsgInvalidZRRCE1001_flg_ovrdval@ */ Scalar_BOOLEAN 0 SWC_INP_type_CM_boolean_flg 0.0 1.0 /end CHARACTERISTIC
/begin CHARACTERISTIC KINP_CANMsgInvalidzGWCANRr1C500_flg_ovrdflg "" VALUE 0x0000 /* @ECU_Address@KINP_CANMsgInvalidzGWCANRr1C500_flg_ovrdflg@ */ Scalar_BOOLEAN 0 SWC_INP_type_CM_boolean_flg 0.0 1.0 /end CHARACTERISTIC
/begin CHARACTERISTIC KINP_CANMsgInvalidzGWCANRr1C500_flg_ovrdval "" VALUE 0x0000 /* @ECU_Address@KINP_CANMsgInvalidzGWCANRr1C500_flg_ovrdval@ */ Scalar_BOOLEAN 0 SWC_INP_type_CM_boolean_flg 0.0 1.0 /end CHARACTERISTIC
/begin CHARACTERISTIC KINP_ClearDTCcmd_flg_ovrdflg "" VALUE 0x0000 /* @ECU_Address@KINP_ClearDTCcmd_flg_ovrdflg@ */ Scalar_BOOLEAN 0 SWC_INP_type_CM_boolean_flg 0.0 1.0 /end CHARACTERISTIC
/begin CHARACTERISTIC KINP_ClearDTCcmd_flg_ovrdval "" VALUE 0x0000 /* @ECU_Address@KINP_ClearDTCcmd_flg_ovrdval@ */ Scalar_BOOLEAN 0 SWC_INP_type_CM_boolean_flg 0.0 1.0 /end CHARACTERISTIC
/begin CHARACTERISTIC KINP_CrashSignalGPIO_flg_inverse "" VALUE 0x0000 /* @ECU_Address@KINP_CrashSignalGPIO_flg_inverse@ */ Scalar_BOOLEAN 0 SWC_INP_type_CM_boolean_flg 0.0 1.0 /end CHARACTERISTIC
/begin CHARACTERISTIC KINP_CrashSignalGPIO_flg_ovrdflg "" VALUE 0x0000 /* @ECU_Address@KINP_CrashSignalGPIO_flg_ovrdflg@ */ Scalar_BOOLEAN 0 SWC_INP_type_CM_boolean_flg 0.0 1.0 /end CHARACTERISTIC
/begin CHARACTERISTIC KINP_CrashSignalGPIO_flg_ovrdval "" VALUE 0x0000 /* @ECU_Address@KINP_CrashSignalGPIO_flg_ovrdval@ */ Scalar_BOOLEAN 0 SWC_INP_type_CM_boolean_flg 0.0 1.0 /end CHARACTERISTIC
/begin CHARACTERISTIC KINP_CrashSignalGPIO_flg_srvcflg "" VALUE 0x0000 /* @ECU_Address@KINP_CrashSignalGPIO_flg_srvcflg@ */ Scalar_BOOLEAN 0 SWC_INP_type_CM_boolean_flg 0.0 1.0 /end CHARACTERISTIC
/begin CHARACTERISTIC KINP_CrashSignalGPIO_flg_srvcval "" VALUE 0x0000 /* @ECU_Address@KINP_CrashSignalGPIO_flg_srvcval@ */ Scalar_BOOLEAN 0 SWC_INP_type_CM_boolean_flg 0.0 1.0 /end CHARACTERISTIC
/begin CHARACTERISTIC KINP_DKCBTRSSI_dB_ovrdflg "" VALUE 0x0000 /* @ECU_Address@KINP_DKCBTRSSI_dB_ovrdflg@ */ Scalar_BOOLEAN 0 SWC_INP_type_CM_boolean_flg 0.0 1.0 /end CHARACTERISTIC
/begin CHARACTERISTIC KINP_EmergencyExitSW_flg_inverse "" VALUE 0x0000 /* @ECU_Address@KINP_EmergencyExitSW_flg_inverse@ */ Scalar_BOOLEAN 0 SWC_INP_type_CM_boolean_flg 0.0 1.0 /end CHARACTERISTIC
/begin CHARACTERISTIC KINP_EmergencyExitSW_flg_ovrdflg "" VALUE 0x0000 /* @ECU_Address@KINP_EmergencyExitSW_flg_ovrdflg@ */ Scalar_BOOLEAN 0 SWC_INP_type_CM_boolean_flg 0.0 1.0 /end CHARACTERISTIC
/begin CHARACTERISTIC KINP_EmergencyExitSW_flg_ovrdval "" VALUE 0x0000 /* @ECU_Address@KINP_EmergencyExitSW_flg_ovrdval@ */ Scalar_BOOLEAN 0 SWC_INP_type_CM_boolean_flg 0.0 1.0 /end CHARACTERISTIC
/begin CHARACTERISTIC KINP_EmergencyExitSW_flg_srvcflg "" VALUE 0x0000 /* @ECU_Address@KINP_EmergencyExitSW_flg_srvcflg@ */ Scalar_BOOLEAN 0 SWC_INP_type_CM_boolean_flg 0.0 1.0 /end CHARACTERISTIC
/begin CHARACTERISTIC KINP_EmergencyExitSW_flg_srvcval "" VALUE 0x0000 /* @ECU_Address@KINP_EmergencyExitSW_flg_srvcval@ */ Scalar_BOOLEAN 0 SWC_INP_type_CM_boolean_flg 0.0 1.0 /end CHARACTERISTIC
/begin CHARACTERISTIC KINP_EvccAplusPwrUpReq_flg_ovrdflg "" VALUE 0x0000 /* @ECU_Address@KINP_EvccAplusPwrUpReq_flg_ovrdflg@ */ Scalar_BOOLEAN 0 SWC_INP_type_CM_boolean_flg 0.0 1.0 /end CHARACTERISTIC
/begin CHARACTERISTIC KINP_EvccAplusPwrUpReq_flg_ovrdval "" VALUE 0x0000 /* @ECU_Address@KINP_EvccAplusPwrUpReq_flg_ovrdval@ */ Scalar_BOOLEAN 0 SWC_INP_type_CM_boolean_flg 0.0 1.0 /end CHARACTERISTIC
/begin CHARACTERISTIC KINP_FrontDoorSW_flg_inverse "" VALUE 0x0000 /* @ECU_Address@KINP_FrontDoorSW_flg_inverse@ */ Scalar_BOOLEAN 0 SWC_INP_type_CM_boolean_flg 0.0 1.0 /end CHARACTERISTIC
/begin CHARACTERISTIC KINP_FrontDoorSW_flg_ovrdflg "" VALUE 0x0000 /* @ECU_Address@KINP_FrontDoorSW_flg_ovrdflg@ */ Scalar_BOOLEAN 0 SWC_INP_type_CM_boolean_flg 0.0 1.0 /end CHARACTERISTIC
/begin CHARACTERISTIC KINP_FrontDoorSW_flg_ovrdval "" VALUE 0x0000 /* @ECU_Address@KINP_FrontDoorSW_flg_ovrdval@ */ Scalar_BOOLEAN 0 SWC_INP_type_CM_boolean_flg 0.0 1.0 /end CHARACTERISTIC
/begin CHARACTERISTIC KINP_FrontDoorSW_flg_srvcflg "" VALUE 0x0000 /* @ECU_Address@KINP_FrontDoorSW_flg_srvcflg@ */ Scalar_BOOLEAN 0 SWC_INP_type_CM_boolean_flg 0.0 1.0 /end CHARACTERISTIC
/begin CHARACTERISTIC KINP_FrontDoorSW_flg_srvcval "" VALUE 0x0000 /* @ECU_Address@KINP_FrontDoorSW_flg_srvcval@ */ Scalar_BOOLEAN 0 SWC_INP_type_CM_boolean_flg 0.0 1.0 /end CHARACTERISTIC
/begin CHARACTERISTIC KINP_HazardSW_flg_inverse "" VALUE 0x0000 /* @ECU_Address@KINP_HazardSW_flg_inverse@ */ Scalar_BOOLEAN 0 SWC_INP_type_CM_boolean_flg 0.0 1.0 /end CHARACTERISTIC
/begin CHARACTERISTIC KINP_HazardSW_flg_ovrdflg "" VALUE 0x0000 /* @ECU_Address@KINP_HazardSW_flg_ovrdflg@ */ Scalar_BOOLEAN 0 SWC_INP_type_CM_boolean_flg 0.0 1.0 /end CHARACTERISTIC
/begin CHARACTERISTIC KINP_HazardSW_flg_ovrdval "" VALUE 0x0000 /* @ECU_Address@KINP_HazardSW_flg_ovrdval@ */ Scalar_BOOLEAN 0 SWC_INP_type_CM_boolean_flg 0.0 1.0 /end CHARACTERISTIC
/begin CHARACTERISTIC KINP_HazardSW_flg_srvcflg "" VALUE 0x0000 /* @ECU_Address@KINP_HazardSW_flg_srvcflg@ */ Scalar_BOOLEAN 0 SWC_INP_type_CM_boolean_flg 0.0 1.0 /end CHARACTERISTIC
/begin CHARACTERISTIC KINP_HazardSW_flg_srvcval "" VALUE 0x0000 /* @ECU_Address@KINP_HazardSW_flg_srvcval@ */ Scalar_BOOLEAN 0 SWC_INP_type_CM_boolean_flg 0.0 1.0 /end CHARACTERISTIC
/begin CHARACTERISTIC KINP_KeyFobAreaU16_enum_ovrdflg "" VALUE 0x0000 /* @ECU_Address@KINP_KeyFobAreaU16_enum_ovrdflg@ */ Scalar_BOOLEAN 0 SWC_INP_type_CM_boolean_flg 0.0 1.0 /end CHARACTERISTIC
/begin CHARACTERISTIC KINP_LeftTurnSW_flg_inverse "" VALUE 0x0000 /* @ECU_Address@KINP_LeftTurnSW_flg_inverse@ */ Scalar_BOOLEAN 0 SWC_INP_type_CM_boolean_flg 0.0 1.0 /end CHARACTERISTIC
/begin CHARACTERISTIC KINP_LeftTurnSW_flg_ovrdflg "" VALUE 0x0000 /* @ECU_Address@KINP_LeftTurnSW_flg_ovrdflg@ */ Scalar_BOOLEAN 0 SWC_INP_type_CM_boolean_flg 0.0 1.0 /end CHARACTERISTIC
/begin CHARACTERISTIC KINP_LeftTurnSW_flg_ovrdval "" VALUE 0x0000 /* @ECU_Address@KINP_LeftTurnSW_flg_ovrdval@ */ Scalar_BOOLEAN 0 SWC_INP_type_CM_boolean_flg 0.0 1.0 /end CHARACTERISTIC
/begin CHARACTERISTIC KINP_LeftTurnSW_flg_srvcflg "" VALUE 0x0000 /* @ECU_Address@KINP_LeftTurnSW_flg_srvcflg@ */ Scalar_BOOLEAN 0 SWC_INP_type_CM_boolean_flg 0.0 1.0 /end CHARACTERISTIC
/begin CHARACTERISTIC KINP_LeftTurnSW_flg_srvcval "" VALUE 0x0000 /* @ECU_Address@KINP_LeftTurnSW_flg_srvcval@ */ Scalar_BOOLEAN 0 SWC_INP_type_CM_boolean_flg 0.0 1.0 /end CHARACTERISTIC
/begin CHARACTERISTIC KINP_MemOffsetAccX_raw16_ovrdflg "" VALUE 0x0000 /* @ECU_Address@KINP_MemOffsetAccX_raw16_ovrdflg@ */ Scalar_BOOLEAN 0 SWC_INP_type_CM_boolean_flg 0.0 1.0 /end CHARACTERISTIC
/begin CHARACTERISTIC KINP_MemOffsetAccY_raw16_ovrdflg "" VALUE 0x0000 /* @ECU_Address@KINP_MemOffsetAccY_raw16_ovrdflg@ */ Scalar_BOOLEAN 0 SWC_INP_type_CM_boolean_flg 0.0 1.0 /end CHARACTERISTIC
/begin CHARACTERISTIC KINP_MemOffsetAccZ_raw16_ovrdflg "" VALUE 0x0000 /* @ECU_Address@KINP_MemOffsetAccZ_raw16_ovrdflg@ */ Scalar_BOOLEAN 0 SWC_INP_type_CM_boolean_flg 0.0 1.0 /end CHARACTERISTIC
/begin CHARACTERISTIC KINP_MemOffsetGyroX_raw16_ovrdflg "" VALUE 0x0000 /* @ECU_Address@KINP_MemOffsetGyroX_raw16_ovrdflg@ */ Scalar_BOOLEAN 0 SWC_INP_type_CM_boolean_flg 0.0 1.0 /end CHARACTERISTIC
/begin CHARACTERISTIC KINP_MemOffsetGyroY_raw16_ovrdflg "" VALUE 0x0000 /* @ECU_Address@KINP_MemOffsetGyroY_raw16_ovrdflg@ */ Scalar_BOOLEAN 0 SWC_INP_type_CM_boolean_flg 0.0 1.0 /end CHARACTERISTIC
/begin CHARACTERISTIC KINP_MemOffsetGyroZ_raw16_ovrdflg "" VALUE 0x0000 /* @ECU_Address@KINP_MemOffsetGyroZ_raw16_ovrdflg@ */ Scalar_BOOLEAN 0 SWC_INP_type_CM_boolean_flg 0.0 1.0 /end CHARACTERISTIC
/begin CHARACTERISTIC KINP_MidDoorSW_flg_inverse "" VALUE 0x0000 /* @ECU_Address@KINP_MidDoorSW_flg_inverse@ */ Scalar_BOOLEAN 0 SWC_INP_type_CM_boolean_flg 0.0 1.0 /end CHARACTERISTIC
/begin CHARACTERISTIC KINP_MidDoorSW_flg_ovrdflg "" VALUE 0x0000 /* @ECU_Address@KINP_MidDoorSW_flg_ovrdflg@ */ Scalar_BOOLEAN 0 SWC_INP_type_CM_boolean_flg 0.0 1.0 /end CHARACTERISTIC
/begin CHARACTERISTIC KINP_MidDoorSW_flg_ovrdval "" VALUE 0x0000 /* @ECU_Address@KINP_MidDoorSW_flg_ovrdval@ */ Scalar_BOOLEAN 0 SWC_INP_type_CM_boolean_flg 0.0 1.0 /end CHARACTERISTIC
/begin CHARACTERISTIC KINP_MidDoorSW_flg_srvcflg "" VALUE 0x0000 /* @ECU_Address@KINP_MidDoorSW_flg_srvcflg@ */ Scalar_BOOLEAN 0 SWC_INP_type_CM_boolean_flg 0.0 1.0 /end CHARACTERISTIC
/begin CHARACTERISTIC KINP_MidDoorSW_flg_srvcval "" VALUE 0x0000 /* @ECU_Address@KINP_MidDoorSW_flg_srvcval@ */ Scalar_BOOLEAN 0 SWC_INP_type_CM_boolean_flg 0.0 1.0 /end CHARACTERISTIC
/begin CHARACTERISTIC KINP_NFCDoorSta_flg_ovrdflg "" VALUE 0x0000 /* @ECU_Address@KINP_NFCDoorSta_flg_ovrdflg@ */ Scalar_BOOLEAN 0 SWC_INP_type_CM_boolean_flg 0.0 1.0 /end CHARACTERISTIC
/begin CHARACTERISTIC KINP_NFCDoorSta_flg_ovrdval "" VALUE 0x0000 /* @ECU_Address@KINP_NFCDoorSta_flg_ovrdval@ */ Scalar_BOOLEAN 0 SWC_INP_type_CM_boolean_flg 0.0 1.0 /end CHARACTERISTIC
/begin CHARACTERISTIC KINP_NFCLidASta_flg_ovrdflg "" VALUE 0x0000 /* @ECU_Address@KINP_NFCLidASta_flg_ovrdflg@ */ Scalar_BOOLEAN 0 SWC_INP_type_CM_boolean_flg 0.0 1.0 /end CHARACTERISTIC
/begin CHARACTERISTIC KINP_NFCLidASta_flg_ovrdval "" VALUE 0x0000 /* @ECU_Address@KINP_NFCLidASta_flg_ovrdval@ */ Scalar_BOOLEAN 0 SWC_INP_type_CM_boolean_flg 0.0 1.0 /end CHARACTERISTIC
/begin CHARACTERISTIC KINP_NetworkReqCalled_flg_ovrdflg "" VALUE 0x0000 /* @ECU_Address@KINP_NetworkReqCalled_flg_ovrdflg@ */ Scalar_BOOLEAN 0 SWC_INP_type_CM_boolean_flg 0.0 1.0 /end CHARACTERISTIC
/begin CHARACTERISTIC KINP_NetworkReqCalled_flg_ovrdval "" VALUE 0x0000 /* @ECU_Address@KINP_NetworkReqCalled_flg_ovrdval@ */ Scalar_BOOLEAN 0 SWC_INP_type_CM_boolean_flg 0.0 1.0 /end CHARACTERISTIC
/begin CHARACTERISTIC KINP_OSDoorSwClose_flg_inverse "" VALUE 0x0000 /* @ECU_Address@KINP_OSDoorSwClose_flg_inverse@ */ Scalar_BOOLEAN 0 SWC_INP_type_CM_boolean_flg 0.0 1.0 /end CHARACTERISTIC
/begin CHARACTERISTIC KINP_OSDoorSwClose_flg_ovrdflg "" VALUE 0x0000 /* @ECU_Address@KINP_OSDoorSwClose_flg_ovrdflg@ */ Scalar_BOOLEAN 0 SWC_INP_type_CM_boolean_flg 0.0 1.0 /end CHARACTERISTIC
/begin CHARACTERISTIC KINP_OSDoorSwClose_flg_ovrdval "" VALUE 0x0000 /* @ECU_Address@KINP_OSDoorSwClose_flg_ovrdval@ */ Scalar_BOOLEAN 0 SWC_INP_type_CM_boolean_flg 0.0 1.0 /end CHARACTERISTIC
/begin CHARACTERISTIC KINP_OSDoorSwClose_flg_srvcflg "" VALUE 0x0000 /* @ECU_Address@KINP_OSDoorSwClose_flg_srvcflg@ */ Scalar_BOOLEAN 0 SWC_INP_type_CM_boolean_flg 0.0 1.0 /end CHARACTERISTIC
/begin CHARACTERISTIC KINP_OSDoorSwClose_flg_srvcval "" VALUE 0x0000 /* @ECU_Address@KINP_OSDoorSwClose_flg_srvcval@ */ Scalar_BOOLEAN 0 SWC_INP_type_CM_boolean_flg 0.0 1.0 /end CHARACTERISTIC
/begin CHARACTERISTIC KINP_OSDoorSwOpen_flg_inverse "" VALUE 0x0000 /* @ECU_Address@KINP_OSDoorSwOpen_flg_inverse@ */ Scalar_BOOLEAN 0 SWC_INP_type_CM_boolean_flg 0.0 1.0 /end CHARACTERISTIC
/begin CHARACTERISTIC KINP_OSDoorSwOpen_flg_ovrdflg "" VALUE 0x0000 /* @ECU_Address@KINP_OSDoorSwOpen_flg_ovrdflg@ */ Scalar_BOOLEAN 0 SWC_INP_type_CM_boolean_flg 0.0 1.0 /end CHARACTERISTIC
/begin CHARACTERISTIC KINP_OSDoorSwOpen_flg_ovrdval "" VALUE 0x0000 /* @ECU_Address@KINP_OSDoorSwOpen_flg_ovrdval@ */ Scalar_BOOLEAN 0 SWC_INP_type_CM_boolean_flg 0.0 1.0 /end CHARACTERISTIC
/begin CHARACTERISTIC KINP_OSDoorSwOpen_flg_srvcflg "" VALUE 0x0000 /* @ECU_Address@KINP_OSDoorSwOpen_flg_srvcflg@ */ Scalar_BOOLEAN 0 SWC_INP_type_CM_boolean_flg 0.0 1.0 /end CHARACTERISTIC
/begin CHARACTERISTIC KINP_OSDoorSwOpen_flg_srvcval "" VALUE 0x0000 /* @ECU_Address@KINP_OSDoorSwOpen_flg_srvcval@ */ Scalar_BOOLEAN 0 SWC_INP_type_CM_boolean_flg 0.0 1.0 /end CHARACTERISTIC
/begin CHARACTERISTIC KINP_Pedal1Ref5V_V_ovrdflg "" VALUE 0x0000 /* @ECU_Address@KINP_Pedal1Ref5V_V_ovrdflg@ */ Scalar_BOOLEAN 0 SWC_INP_type_CM_boolean_flg 0.0 1.0 /end CHARACTERISTIC
/begin CHARACTERISTIC KINP_Pedal2Ref5V_V_ovrdflg "" VALUE 0x0000 /* @ECU_Address@KINP_Pedal2Ref5V_V_ovrdflg@ */ Scalar_BOOLEAN 0 SWC_INP_type_CM_boolean_flg 0.0 1.0 /end CHARACTERISTIC
/begin CHARACTERISTIC KINP_SensingAccX_raw16_ovrdflg "" VALUE 0x0000 /* @ECU_Address@KINP_SensingAccX_raw16_ovrdflg@ */ Scalar_BOOLEAN 0 SWC_INP_type_CM_boolean_flg 0.0 1.0 /end CHARACTERISTIC
/begin CHARACTERISTIC KINP_SensingAccY_raw16_ovrdflg "" VALUE 0x0000 /* @ECU_Address@KINP_SensingAccY_raw16_ovrdflg@ */ Scalar_BOOLEAN 0 SWC_INP_type_CM_boolean_flg 0.0 1.0 /end CHARACTERISTIC
/begin CHARACTERISTIC KINP_SensingAccZ_raw16_ovrdflg "" VALUE 0x0000 /* @ECU_Address@KINP_SensingAccZ_raw16_ovrdflg@ */ Scalar_BOOLEAN 0 SWC_INP_type_CM_boolean_flg 0.0 1.0 /end CHARACTERISTIC
/begin CHARACTERISTIC KINP_SensingGyroX_raw16_ovrdflg "" VALUE 0x0000 /* @ECU_Address@KINP_SensingGyroX_raw16_ovrdflg@ */ Scalar_BOOLEAN 0 SWC_INP_type_CM_boolean_flg 0.0 1.0 /end CHARACTERISTIC
/begin CHARACTERISTIC KINP_SensingGyroY_raw16_ovrdflg "" VALUE 0x0000 /* @ECU_Address@KINP_SensingGyroY_raw16_ovrdflg@ */ Scalar_BOOLEAN 0 SWC_INP_type_CM_boolean_flg 0.0 1.0 /end CHARACTERISTIC
/begin CHARACTERISTIC KINP_SensingGyroZ_raw16_ovrdflg "" VALUE 0x0000 /* @ECU_Address@KINP_SensingGyroZ_raw16_ovrdflg@ */ Scalar_BOOLEAN 0 SWC_INP_type_CM_boolean_flg 0.0 1.0 /end CHARACTERISTIC
/begin CHARACTERISTIC KINP_TPMSBattLow_flg_ovrdval "" VALUE 0x0000 /* @ECU_Address@KINP_TPMSBattLow_flg_ovrdval@ */ Scalar_BOOLEAN 0 SWC_INP_type_CM_boolean_flg 0.0 1.0 /end CHARACTERISTIC
/begin CHARACTERISTIC KINP_TPMSBattLow_flg_ovrflg "" VALUE 0x0000 /* @ECU_Address@KINP_TPMSBattLow_flg_ovrflg@ */ Scalar_BOOLEAN 0 SWC_INP_type_CM_boolean_flg 0.0 1.0 /end CHARACTERISTIC
/begin CHARACTERISTIC KINP_TPMSCRCCalc_crc_ovrdflg "" VALUE 0x0000 /* @ECU_Address@KINP_TPMSCRCCalc_crc_ovrdflg@ */ Scalar_BOOLEAN 0 SWC_INP_type_CM_boolean_flg 0.0 1.0 /end CHARACTERISTIC
/begin CHARACTERISTIC KINP_TPMSCRC_crc_ovrdflg "" VALUE 0x0000 /* @ECU_Address@KINP_TPMSCRC_crc_ovrdflg@ */ Scalar_BOOLEAN 0 SWC_INP_type_CM_boolean_flg 0.0 1.0 /end CHARACTERISTIC
/begin CHARACTERISTIC KINP_TPMSDataIn_flg_ovrdflg "" VALUE 0x0000 /* @ECU_Address@KINP_TPMSDataIn_flg_ovrdflg@ */ Scalar_BOOLEAN 0 SWC_INP_type_CM_boolean_flg 0.0 1.0 /end CHARACTERISTIC
/begin CHARACTERISTIC KINP_TPMSDataIn_flg_ovrdval "" VALUE 0x0000 /* @ECU_Address@KINP_TPMSDataIn_flg_ovrdval@ */ Scalar_BOOLEAN 0 SWC_INP_type_CM_boolean_flg 0.0 1.0 /end CHARACTERISTIC
/begin CHARACTERISTIC KINP_TPMSFAT_flg_ovrdval "" VALUE 0x0000 /* @ECU_Address@KINP_TPMSFAT_flg_ovrdval@ */ Scalar_BOOLEAN 0 SWC_INP_type_CM_boolean_flg 0.0 1.0 /end CHARACTERISTIC
/begin CHARACTERISTIC KINP_TPMSFAT_flg_ovrflg "" VALUE 0x0000 /* @ECU_Address@KINP_TPMSFAT_flg_ovrflg@ */ Scalar_BOOLEAN 0 SWC_INP_type_CM_boolean_flg 0.0 1.0 /end CHARACTERISTIC
/begin CHARACTERISTIC KINP_TPMSID_raw_ovrdflg "" VALUE 0x0000 /* @ECU_Address@KINP_TPMSID_raw_ovrdflg@ */ Scalar_BOOLEAN 0 SWC_INP_type_CM_boolean_flg 0.0 1.0 /end CHARACTERISTIC
/begin CHARACTERISTIC KINP_TPMSPressureMi_raw_ovrdflg "" VALUE 0x0000 /* @ECU_Address@KINP_TPMSPressureMi_raw_ovrdflg@ */ Scalar_BOOLEAN 0 SWC_INP_type_CM_boolean_flg 0.0 1.0 /end CHARACTERISTIC
/begin CHARACTERISTIC KINP_TPMSSta_enum_ovrdflg "" VALUE 0x0000 /* @ECU_Address@KINP_TPMSSta_enum_ovrdflg@ */ Scalar_BOOLEAN 0 SWC_INP_type_CM_boolean_flg 0.0 1.0 /end CHARACTERISTIC
/begin CHARACTERISTIC KINP_TPMSStorge_flg_ovrdval "" VALUE 0x0000 /* @ECU_Address@KINP_TPMSStorge_flg_ovrdval@ */ Scalar_BOOLEAN 0 SWC_INP_type_CM_boolean_flg 0.0 1.0 /end CHARACTERISTIC
/begin CHARACTERISTIC KINP_TPMSStorge_flg_ovrflg "" VALUE 0x0000 /* @ECU_Address@KINP_TPMSStorge_flg_ovrflg@ */ Scalar_BOOLEAN 0 SWC_INP_type_CM_boolean_flg 0.0 1.0 /end CHARACTERISTIC
/begin CHARACTERISTIC KINP_TPMSTemp_raw_ovrdflg "" VALUE 0x0000 /* @ECU_Address@KINP_TPMSTemp_raw_ovrdflg@ */ Scalar_BOOLEAN 0 SWC_INP_type_CM_boolean_flg 0.0 1.0 /end CHARACTERISTIC
/begin CHARACTERISTIC KINP_UIDBatVoltx1000_V_ovrdflg "" VALUE 0x0000 /* @ECU_Address@KINP_UIDBatVoltx1000_V_ovrdflg@ */ Scalar_BOOLEAN 0 SWC_INP_type_CM_boolean_flg 0.0 1.0 /end CHARACTERISTIC
/begin CHARACTERISTIC KINP_UIDButtonCmd_enum_ovrdflg "" VALUE 0x0000 /* @ECU_Address@KINP_UIDButtonCmd_enum_ovrdflg@ */ Scalar_BOOLEAN 0 SWC_INP_type_CM_boolean_flg 0.0 1.0 /end CHARACTERISTIC
/begin CHARACTERISTIC KINP_DKCBTRSSI_dB_ovrdval "" VALUE 0x0000 /* @ECU_Address@KINP_DKCBTRSSI_dB_ovrdval@ */ Scalar_BYTE 0 SWC_INP_type_CM_int8_dB -128.0 127.0 /end CHARACTERISTIC
/begin CHARACTERISTIC KINP_AccelPedal1Vol_V_fftdec "" VALUE 0x0000 /* @ECU_Address@KINP_AccelPedal1Vol_V_fftdec@ */ Scalar_UBYTE 0 SWC_INP_type_CM_uint8_cnt 0.0 255.0 /end CHARACTERISTIC
/begin CHARACTERISTIC KINP_AccelPedal1Vol_V_fftinc "" VALUE 0x0000 /* @ECU_Address@KINP_AccelPedal1Vol_V_fftinc@ */ Scalar_UBYTE 0 SWC_INP_type_CM_uint8_cnt 0.0 255.0 /end CHARACTERISTIC
/begin CHARACTERISTIC KINP_AccelPedal1Vol_V_fftlim "" VALUE 0x0000 /* @ECU_Address@KINP_AccelPedal1Vol_V_fftlim@ */ Scalar_UBYTE 0 SWC_INP_type_CM_uint8_cnt 0.0 255.0 /end CHARACTERISTIC
/begin CHARACTERISTIC KINP_AccelPedal2Vol_V_fftdec "" VALUE 0x0000 /* @ECU_Address@KINP_AccelPedal2Vol_V_fftdec@ */ Scalar_UBYTE 0 SWC_INP_type_CM_uint8_cnt 0.0 255.0 /end CHARACTERISTIC
/begin CHARACTERISTIC KINP_AccelPedal2Vol_V_fftinc "" VALUE 0x0000 /* @ECU_Address@KINP_AccelPedal2Vol_V_fftinc@ */ Scalar_UBYTE 0 SWC_INP_type_CM_uint8_cnt 0.0 255.0 /end CHARACTERISTIC
/begin CHARACTERISTIC KINP_AccelPedal2Vol_V_fftlim "" VALUE 0x0000 /* @ECU_Address@KINP_AccelPedal2Vol_V_fftlim@ */ Scalar_UBYTE 0 SWC_INP_type_CM_uint8_cnt 0.0 255.0 /end CHARACTERISTIC
/begin CHARACTERISTIC KINP_AlcoholPass_flg_debdec "" VALUE 0x0000 /* @ECU_Address@KINP_AlcoholPass_flg_debdec@ */ Scalar_UBYTE 0 SWC_INP_type_CM_uint8_cnt 0.0 255.0 /end CHARACTERISTIC
/begin CHARACTERISTIC KINP_AlcoholPass_flg_debinc "" VALUE 0x0000 /* @ECU_Address@KINP_AlcoholPass_flg_debinc@ */ Scalar_UBYTE 0 SWC_INP_type_CM_uint8_cnt 0.0 255.0 /end CHARACTERISTIC
/begin CHARACTERISTIC KINP_AlcoholPass_flg_deblim "" VALUE 0x0000 /* @ECU_Address@KINP_AlcoholPass_flg_deblim@ */ Scalar_UBYTE 0 SWC_INP_type_CM_uint8_cnt 0.0 255.0 /end CHARACTERISTIC
/begin CHARACTERISTIC KINP_AllowMovThd_OTA_enum_ovrdflg "" VALUE 0x0000 /* @ECU_Address@KINP_AllowMovThd_OTA_enum_ovrdflg@ */ Scalar_UBYTE 0 SWC_INP_type_CM_uint8_flg 0.0 1.0 /end CHARACTERISTIC
/begin CHARACTERISTIC KINP_AllowMovThd_OTA_enum_ovrdval "" VALUE 0x0000 /* @ECU_Address@KINP_AllowMovThd_OTA_enum_ovrdval@ */ Scalar_UBYTE 0 SWC_INP_type_CM_uint8_enum 0.0 255.0 /end CHARACTERISTIC
/begin CHARACTERISTIC KINP_BTConnectSta_enum_ovrdval "" VALUE 0x0000 /* @ECU_Address@KINP_BTConnectSta_enum_ovrdval@ */ Scalar_UBYTE 0 SWC_INP_type_CM_uint8_enum 0.0 255.0 /end CHARACTERISTIC
/begin CHARACTERISTIC KINP_BmsAplus_flg_debdec "" VALUE 0x0000 /* @ECU_Address@KINP_BmsAplus_flg_debdec@ */ Scalar_UBYTE 0 SWC_INP_type_CM_uint8_cnt 0.0 255.0 /end CHARACTERISTIC
/begin CHARACTERISTIC KINP_BmsAplus_flg_debinc "" VALUE 0x0000 /* @ECU_Address@KINP_BmsAplus_flg_debinc@ */ Scalar_UBYTE 0 SWC_INP_type_CM_uint8_cnt 0.0 255.0 /end CHARACTERISTIC
/begin CHARACTERISTIC KINP_BmsAplus_flg_deblim "" VALUE 0x0000 /* @ECU_Address@KINP_BmsAplus_flg_deblim@ */ Scalar_UBYTE 0 SWC_INP_type_CM_uint8_cnt 0.0 255.0 /end CHARACTERISTIC
/begin CHARACTERISTIC KINP_BrakeLampSW_flg_debdec "" VALUE 0x0000 /* @ECU_Address@KINP_BrakeLampSW_flg_debdec@ */ Scalar_UBYTE 0 SWC_INP_type_CM_uint8_cnt 0.0 255.0 /end CHARACTERISTIC
/begin CHARACTERISTIC KINP_BrakeLampSW_flg_debinc "" VALUE 0x0000 /* @ECU_Address@KINP_BrakeLampSW_flg_debinc@ */ Scalar_UBYTE 0 SWC_INP_type_CM_uint8_cnt 0.0 255.0 /end CHARACTERISTIC
/begin CHARACTERISTIC KINP_BrakeLampSW_flg_deblim "" VALUE 0x0000 /* @ECU_Address@KINP_BrakeLampSW_flg_deblim@ */ Scalar_UBYTE 0 SWC_INP_type_CM_uint8_cnt 0.0 255.0 /end CHARACTERISTIC
/begin CHARACTERISTIC KINP_BrakeSWGPIO_flg_debdec "" VALUE 0x0000 /* @ECU_Address@KINP_BrakeSWGPIO_flg_debdec@ */ Scalar_UBYTE 0 SWC_INP_type_CM_uint8_cnt 0.0 255.0 /end CHARACTERISTIC
/begin CHARACTERISTIC KINP_BrakeSWGPIO_flg_debinc "" VALUE 0x0000 /* @ECU_Address@KINP_BrakeSWGPIO_flg_debinc@ */ Scalar_UBYTE 0 SWC_INP_type_CM_uint8_cnt 0.0 255.0 /end CHARACTERISTIC
/begin CHARACTERISTIC KINP_BrakeSWGPIO_flg_deblim "" VALUE 0x0000 /* @ECU_Address@KINP_BrakeSWGPIO_flg_deblim@ */ Scalar_UBYTE 0 SWC_INP_type_CM_uint8_cnt 0.0 255.0 /end CHARACTERISTIC
/begin CHARACTERISTIC KINP_CrashSignalGPIO_flg_debdec "" VALUE 0x0000 /* @ECU_Address@KINP_CrashSignalGPIO_flg_debdec@ */ Scalar_UBYTE 0 SWC_INP_type_CM_uint8_cnt 0.0 255.0 /end CHARACTERISTIC
/begin CHARACTERISTIC KINP_CrashSignalGPIO_flg_debinc "" VALUE 0x0000 /* @ECU_Address@KINP_CrashSignalGPIO_flg_debinc@ */ Scalar_UBYTE 0 SWC_INP_type_CM_uint8_cnt 0.0 255.0 /end CHARACTERISTIC
/begin CHARACTERISTIC KINP_CrashSignalGPIO_flg_deblim "" VALUE 0x0000 /* @ECU_Address@KINP_CrashSignalGPIO_flg_deblim@ */ Scalar_UBYTE 0 SWC_INP_type_CM_uint8_cnt 0.0 255.0 /end CHARACTERISTIC
/begin CHARACTERISTIC KINP_EmergencyExitSW_flg_debdec "" VALUE 0x0000 /* @ECU_Address@KINP_EmergencyExitSW_flg_debdec@ */ Scalar_UBYTE 0 SWC_INP_type_CM_uint8_cnt 0.0 255.0 /end CHARACTERISTIC
/begin CHARACTERISTIC KINP_EmergencyExitSW_flg_debinc "" VALUE 0x0000 /* @ECU_Address@KINP_EmergencyExitSW_flg_debinc@ */ Scalar_UBYTE 0 SWC_INP_type_CM_uint8_cnt 0.0 255.0 /end CHARACTERISTIC
/begin CHARACTERISTIC KINP_EmergencyExitSW_flg_deblim "" VALUE 0x0000 /* @ECU_Address@KINP_EmergencyExitSW_flg_deblim@ */ Scalar_UBYTE 0 SWC_INP_type_CM_uint8_cnt 0.0 255.0 /end CHARACTERISTIC
/begin CHARACTERISTIC KINP_FrontDoorSW_flg_debdec "" VALUE 0x0000 /* @ECU_Address@KINP_FrontDoorSW_flg_debdec@ */ Scalar_UBYTE 0 SWC_INP_type_CM_uint8_cnt 0.0 255.0 /end CHARACTERISTIC
/begin CHARACTERISTIC KINP_FrontDoorSW_flg_debinc "" VALUE 0x0000 /* @ECU_Address@KINP_FrontDoorSW_flg_debinc@ */ Scalar_UBYTE 0 SWC_INP_type_CM_uint8_cnt 0.0 255.0 /end CHARACTERISTIC
/begin CHARACTERISTIC KINP_FrontDoorSW_flg_deblim "" VALUE 0x0000 /* @ECU_Address@KINP_FrontDoorSW_flg_deblim@ */ Scalar_UBYTE 0 SWC_INP_type_CM_uint8_cnt 0.0 255.0 /end CHARACTERISTIC
/begin CHARACTERISTIC KINP_HazardSW_flg_debdec "" VALUE 0x0000 /* @ECU_Address@KINP_HazardSW_flg_debdec@ */ Scalar_UBYTE 0 SWC_INP_type_CM_uint8_cnt 0.0 255.0 /end CHARACTERISTIC
/begin CHARACTERISTIC KINP_HazardSW_flg_debinc "" VALUE 0x0000 /* @ECU_Address@KINP_HazardSW_flg_debinc@ */ Scalar_UBYTE 0 SWC_INP_type_CM_uint8_cnt 0.0 255.0 /end CHARACTERISTIC
/begin CHARACTERISTIC KINP_HazardSW_flg_deblim "" VALUE 0x0000 /* @ECU_Address@KINP_HazardSW_flg_deblim@ */ Scalar_UBYTE 0 SWC_INP_type_CM_uint8_cnt 0.0 255.0 /end CHARACTERISTIC
/begin CHARACTERISTIC KINP_LeftTurnSW_flg_debdec "" VALUE 0x0000 /* @ECU_Address@KINP_LeftTurnSW_flg_debdec@ */ Scalar_UBYTE 0 SWC_INP_type_CM_uint8_cnt 0.0 255.0 /end CHARACTERISTIC
/begin CHARACTERISTIC KINP_LeftTurnSW_flg_debinc "" VALUE 0x0000 /* @ECU_Address@KINP_LeftTurnSW_flg_debinc@ */ Scalar_UBYTE 0 SWC_INP_type_CM_uint8_cnt 0.0 255.0 /end CHARACTERISTIC
/begin CHARACTERISTIC KINP_LeftTurnSW_flg_deblim "" VALUE 0x0000 /* @ECU_Address@KINP_LeftTurnSW_flg_deblim@ */ Scalar_UBYTE 0 SWC_INP_type_CM_uint8_cnt 0.0 255.0 /end CHARACTERISTIC
/begin CHARACTERISTIC KINP_MidDoorSW_flg_debdec "" VALUE 0x0000 /* @ECU_Address@KINP_MidDoorSW_flg_debdec@ */ Scalar_UBYTE 0 SWC_INP_type_CM_uint8_cnt 0.0 255.0 /end CHARACTERISTIC
/begin CHARACTERISTIC KINP_MidDoorSW_flg_debinc "" VALUE 0x0000 /* @ECU_Address@KINP_MidDoorSW_flg_debinc@ */ Scalar_UBYTE 0 SWC_INP_type_CM_uint8_cnt 0.0 255.0 /end CHARACTERISTIC
/begin CHARACTERISTIC KINP_MidDoorSW_flg_deblim "" VALUE 0x0000 /* @ECU_Address@KINP_MidDoorSW_flg_deblim@ */ Scalar_UBYTE 0 SWC_INP_type_CM_uint8_cnt 0.0 255.0 /end CHARACTERISTIC
/begin CHARACTERISTIC KINP_OSDoorSwClose_flg_debdec "" VALUE 0x0000 /* @ECU_Address@KINP_OSDoorSwClose_flg_debdec@ */ Scalar_UBYTE 0 SWC_INP_type_CM_uint8_cnt 0.0 255.0 /end CHARACTERISTIC
/begin CHARACTERISTIC KINP_OSDoorSwClose_flg_debinc "" VALUE 0x0000 /* @ECU_Address@KINP_OSDoorSwClose_flg_debinc@ */ Scalar_UBYTE 0 SWC_INP_type_CM_uint8_cnt 0.0 255.0 /end CHARACTERISTIC
/begin CHARACTERISTIC KINP_OSDoorSwClose_flg_deblim "" VALUE 0x0000 /* @ECU_Address@KINP_OSDoorSwClose_flg_deblim@ */ Scalar_UBYTE 0 SWC_INP_type_CM_uint8_cnt 0.0 255.0 /end CHARACTERISTIC
/begin CHARACTERISTIC KINP_OSDoorSwOpen_flg_debdec "" VALUE 0x0000 /* @ECU_Address@KINP_OSDoorSwOpen_flg_debdec@ */ Scalar_UBYTE 0 SWC_INP_type_CM_uint8_cnt 0.0 255.0 /end CHARACTERISTIC
/begin CHARACTERISTIC KINP_OSDoorSwOpen_flg_debinc "" VALUE 0x0000 /* @ECU_Address@KINP_OSDoorSwOpen_flg_debinc@ */ Scalar_UBYTE 0 SWC_INP_type_CM_uint8_cnt 0.0 255.0 /end CHARACTERISTIC
/begin CHARACTERISTIC KINP_OSDoorSwOpen_flg_deblim "" VALUE 0x0000 /* @ECU_Address@KINP_OSDoorSwOpen_flg_deblim@ */ Scalar_UBYTE 0 SWC_INP_type_CM_uint8_cnt 0.0 255.0 /end CHARACTERISTIC
/begin CHARACTERISTIC KINP_PwrReq_OTA_enum_ovrdflg "" VALUE 0x0000 /* @ECU_Address@KINP_PwrReq_OTA_enum_ovrdflg@ */ Scalar_UBYTE 0 SWC_INP_type_CM_uint8_flg 0.0 1.0 /end CHARACTERISTIC
/begin CHARACTERISTIC KINP_PwrReq_OTA_enum_ovrdval "" VALUE 0x0000 /* @ECU_Address@KINP_PwrReq_OTA_enum_ovrdval@ */ Scalar_UBYTE 0 SWC_INP_type_CM_uint8_enum 0.0 255.0 /end CHARACTERISTIC
/begin CHARACTERISTIC KINP_TPMSCRCCalc_crc_ovrdval "" VALUE 0x0000 /* @ECU_Address@KINP_TPMSCRCCalc_crc_ovrdval@ */ Scalar_UBYTE 0 SWC_INP_type_CM_uint8_crc 0.0 255.0 /end CHARACTERISTIC
/begin CHARACTERISTIC KINP_TPMSCRC_crc_ovrdval "" VALUE 0x0000 /* @ECU_Address@KINP_TPMSCRC_crc_ovrdval@ */ Scalar_UBYTE 0 SWC_INP_type_CM_uint8_crc 0.0 255.0 /end CHARACTERISTIC
/begin CHARACTERISTIC KINP_TPMSPressureMi_raw_ovrdval "" VALUE 0x0000 /* @ECU_Address@KINP_TPMSPressureMi_raw_ovrdval@ */ Scalar_UBYTE 0 SWC_INP_type_CM_uint8_raw 0.0 255.0 /end CHARACTERISTIC
/begin CHARACTERISTIC KINP_TPMSPressure_raw_ovrdflg "" VALUE 0x0000 /* @ECU_Address@KINP_TPMSPressure_raw_ovrdflg@ */ Scalar_UBYTE 0 SWC_INP_type_CM_uint8_flg 0.0 1.0 /end CHARACTERISTIC
/begin CHARACTERISTIC KINP_TPMSPressure_raw_ovrdval "" VALUE 0x0000 /* @ECU_Address@KINP_TPMSPressure_raw_ovrdval@ */ Scalar_UBYTE 0 SWC_INP_type_CM_uint8_raw 0.0 255.0 /end CHARACTERISTIC
/begin CHARACTERISTIC KINP_TPMSSta_enum_ovrdval "" VALUE 0x0000 /* @ECU_Address@KINP_TPMSSta_enum_ovrdval@ */ Scalar_UBYTE 0 SWC_INP_type_CM_uint8_enum 0.0 255.0 /end CHARACTERISTIC
/begin CHARACTERISTIC KINP_TPMSTemp_raw_ovrdval "" VALUE 0x0000 /* @ECU_Address@KINP_TPMSTemp_raw_ovrdval@ */ Scalar_UBYTE 0 SWC_INP_type_CM_uint8_raw 0.0 255.0 /end CHARACTERISTIC
/begin CHARACTERISTIC KINP_UIDButtonCmd_enum_ovrdval "" VALUE 0x0000 /* @ECU_Address@KINP_UIDButtonCmd_enum_ovrdval@ */ Scalar_UBYTE 0 SWC_INP_type_CM_uint8_enum 0.0 255.0 /end CHARACTERISTIC
/begin MEASUREMENT VINP_TPMSID_raw "" ULONG SWC_INP_type_CM_uint32_raw 0 0 0.0 4.294967295E+9 ECU_ADDRESS 0x0000 /* @ECU_Address@VINP_TPMSID_raw@ */ /end MEASUREMENT
/begin MEASUREMENT VINP_LFID_raw "" ULONG SWC_INP_type_CM_uint32_raw 0 0 0.0 4.294967295E+9 ECU_ADDRESS 0x0000 /* @ECU_Address@VINP_LFID_raw@ */ /end MEASUREMENT
/begin MEASUREMENT VINP_RFID_raw "" ULONG SWC_INP_type_CM_uint32_raw 0 0 0.0 4.294967295E+9 ECU_ADDRESS 0x0000 /* @ECU_Address@VINP_RFID_raw@ */ /end MEASUREMENT
/begin MEASUREMENT VINP_LRID_raw "" ULONG SWC_INP_type_CM_uint32_raw 0 0 0.0 4.294967295E+9 ECU_ADDRESS 0x0000 /* @ECU_Address@VINP_LRID_raw@ */ /end MEASUREMENT
/begin MEASUREMENT VINP_RRID_raw "" ULONG SWC_INP_type_CM_uint32_raw 0 0 0.0 4.294967295E+9 ECU_ADDRESS 0x0000 /* @ECU_Address@VINP_RRID_raw@ */ /end MEASUREMENT
/begin MEASUREMENT VINP_Pedal1Ref5V_V "" FLOAT32_IEEE SWC_INP_type_CM_single_V 0 0 0.0 10.0 ECU_ADDRESS 0x0000 /* @ECU_Address@VINP_Pedal1Ref5V_V@ */ /end MEASUREMENT
/begin MEASUREMENT VINP_Pedal2Ref5V_V "" FLOAT32_IEEE SWC_INP_type_CM_single_V 0 0 0.0 10.0 ECU_ADDRESS 0x0000 /* @ECU_Address@VINP_Pedal2Ref5V_V@ */ /end MEASUREMENT
/begin MEASUREMENT VINP_ACAmbTemp_C "" FLOAT32_IEEE SWC_INP_type_CM_single_C 0 0 -20.0 1735.0 ECU_ADDRESS 0x0000 /* @ECU_Address@VINP_ACAmbTemp_C@ */ /end MEASUREMENT
/begin MEASUREMENT VINP_ACTempSetSta_C "" FLOAT32_IEEE SWC_INP_type_CM_single_C 0 0 -40.0 215.0 ECU_ADDRESS 0x0000 /* @ECU_Address@VINP_ACTempSetSta_C@ */ /end MEASUREMENT
/begin MEASUREMENT VINP_BrakePedalPos_pct "" FLOAT32_IEEE SWC_INP_type_CM_single_pct 0 0 0.0 100.0 ECU_ADDRESS 0x0000 /* @ECU_Address@VINP_BrakePedalPos_pct@ */ /end MEASUREMENT
/begin MEASUREMENT VINP_EngRetSel_pct "" FLOAT32_IEEE SWC_INP_type_CM_single_pct 0 0 0.0 100.0 ECU_ADDRESS 0x0000 /* @ECU_Address@VINP_EngRetSel_pct@ */ /end MEASUREMENT
/begin MEASUREMENT VINP_SACtrlBrakeCtrl_SA "" FLOAT32_IEEE SWC_INP_type_CM_single_SA 0 0 0.0 255.0 ECU_ADDRESS 0x0000 /* @ECU_Address@VINP_SACtrlBrakeCtrl_SA@ */ /end MEASUREMENT
/begin MEASUREMENT VINP_FASpeed_kph "" FLOAT32_IEEE SWC_INP_type_CM_single_kph 0 0 0.0 255.9961 ECU_ADDRESS 0x0000 /* @ECU_Address@VINP_FASpeed_kph@ */ /end MEASUREMENT
/begin MEASUREMENT VINP_RelaSpdFALWheel_kph "" FLOAT32_IEEE SWC_INP_type_CM_single_kph 0 0 -7.8125 7.8125 ECU_ADDRESS 0x0000 /* @ECU_Address@VINP_RelaSpdFALWheel_kph@ */ /end MEASUREMENT
/begin MEASUREMENT VINP_RelaSpdFARWheel_kph "" FLOAT32_IEEE SWC_INP_type_CM_single_kph 0 0 -7.8125 7.8125 ECU_ADDRESS 0x0000 /* @ECU_Address@VINP_RelaSpdFARWheel_kph@ */ /end MEASUREMENT
/begin MEASUREMENT VINP_XBRAcltnLimit_mps2 "" FLOAT32_IEEE SWC_INP_type_CM_single_mps2 0 0 -12.5 12.5 ECU_ADDRESS 0x0000 /* @ECU_Address@VINP_XBRAcltnLimit_mps2@ */ /end MEASUREMENT
/begin MEASUREMENT VINP_EM1ReqTorqHRlsBrk_pct "" FLOAT32_IEEE SWC_INP_type_CM_single_pct 0 0 0.0 15.0 ECU_ADDRESS 0x0000 /* @ECU_Address@VINP_EM1ReqTorqHRlsBrk_pct@ */ /end MEASUREMENT
/begin MEASUREMENT VINP_EM1ReqTorqHRlsDri_pct "" FLOAT32_IEEE SWC_INP_type_CM_single_pct 0 0 0.0 15.0 ECU_ADDRESS 0x0000 /* @ECU_Address@VINP_EM1ReqTorqHRlsDri_pct@ */ /end MEASUREMENT
/begin MEASUREMENT VINP_EM1ReqTorqLimBrk_pct "" FLOAT32_IEEE SWC_INP_type_CM_single_pct 0 0 -125.0 125.0 ECU_ADDRESS 0x0000 /* @ECU_Address@VINP_EM1ReqTorqLimBrk_pct@ */ /end MEASUREMENT
/begin MEASUREMENT VINP_EM1ReqTorqLimDriv_pct "" FLOAT32_IEEE SWC_INP_type_CM_single_pct 0 0 -125.0 125.0 ECU_ADDRESS 0x0000 /* @ECU_Address@VINP_EM1ReqTorqLimDriv_pct@ */ /end MEASUREMENT
/begin MEASUREMENT VINP_WhlSpeedFL_kph "" FLOAT32_IEEE SWC_INP_type_CM_single_kph 0 0 0.0 255.9961 ECU_ADDRESS 0x0000 /* @ECU_Address@VINP_WhlSpeedFL_kph@ */ /end MEASUREMENT
/begin MEASUREMENT VINP_B2VAPlsDischgCurr_A "" FLOAT32_IEEE SWC_INP_type_CM_single_A 0 0 0.0 6553.5 ECU_ADDRESS 0x0000 /* @ECU_Address@VINP_B2VAPlsDischgCurr_A@ */ /end MEASUREMENT
/begin MEASUREMENT VINP_B2VAvaPlsChgCurr_A "" FLOAT32_IEEE SWC_INP_type_CM_single_A 0 0 0.0 6553.5 ECU_ADDRESS 0x0000 /* @ECU_Address@VINP_B2VAvaPlsChgCurr_A@ */ /end MEASUREMENT
/begin MEASUREMENT VINP_B2VPackCurr_A "" FLOAT32_IEEE SWC_INP_type_CM_single_A 0 0 -1000.0 1000.0 ECU_ADDRESS 0x0000 /* @ECU_Address@VINP_B2VPackCurr_A@ */ /end MEASUREMENT
/begin MEASUREMENT VINP_B2VPackInsideVol_V "" FLOAT32_IEEE SWC_INP_type_CM_single_V 0 0 0.0 1000.0 ECU_ADDRESS 0x0000 /* @ECU_Address@VINP_B2VPackInsideVol_V@ */ /end MEASUREMENT
/begin MEASUREMENT VINP_B2VSOC_pct "" FLOAT32_IEEE SWC_INP_type_CM_single_pct 0 0 0.0 100.0 ECU_ADDRESS 0x0000 /* @ECU_Address@VINP_B2VSOC_pct@ */ /end MEASUREMENT
/begin MEASUREMENT VINP_B2VCellMinVol_V "" FLOAT32_IEEE SWC_INP_type_CM_single_V 0 0 0.0 65.535 ECU_ADDRESS 0x0000 /* @ECU_Address@VINP_B2VCellMinVol_V@ */ /end MEASUREMENT
/begin MEASUREMENT VINP_MotorSpd_rpm "" FLOAT32_IEEE SWC_INP_type_CM_single_rpm 0 0 -15000.0 15000.0 ECU_ADDRESS 0x0000 /* @ECU_Address@VINP_MotorSpd_rpm@ */ /end MEASUREMENT
/begin MEASUREMENT VINP_MotorTrq_Nm "" FLOAT32_IEEE SWC_INP_type_CM_single_Nm 0 0 -5000.0 5000.0 ECU_ADDRESS 0x0000 /* @ECU_Address@VINP_MotorTrq_Nm@ */ /end MEASUREMENT
/begin MEASUREMENT VINP_MCUTemp_C "" FLOAT32_IEEE SWC_INP_type_CM_single_C 0 0 -40.0 215.0 ECU_ADDRESS 0x0000 /* @ECU_Address@VINP_MCUTemp_C@ */ /end MEASUREMENT
/begin MEASUREMENT VINP_MCUTrqLimHi_Nm "" FLOAT32_IEEE SWC_INP_type_CM_single_Nm 0 0 0.0 5000.0 ECU_ADDRESS 0x0000 /* @ECU_Address@VINP_MCUTrqLimHi_Nm@ */ /end MEASUREMENT
/begin MEASUREMENT VINP_MCUTrqLimLo_Nm "" FLOAT32_IEEE SWC_INP_type_CM_single_Nm 0 0 -5000.0 0.0 ECU_ADDRESS 0x0000 /* @ECU_Address@VINP_MCUTrqLimLo_Nm@ */ /end MEASUREMENT
/begin MEASUREMENT VINP_MotorTemp_C "" FLOAT32_IEEE SWC_INP_type_CM_single_C 0 0 -40.0 215.0 ECU_ADDRESS 0x0000 /* @ECU_Address@VINP_MotorTemp_C@ */ /end MEASUREMENT
/begin MEASUREMENT VINP_MCUDCCur_A "" FLOAT32_IEEE SWC_INP_type_CM_single_A 0 0 -1000.0 1000.0 ECU_ADDRESS 0x0000 /* @ECU_Address@VINP_MCUDCCur_A@ */ /end MEASUREMENT
/begin MEASUREMENT VINP_MCUDCVol_V "" FLOAT32_IEEE SWC_INP_type_CM_single_V 0 0 0.0 1000.0 ECU_ADDRESS 0x0000 /* @ECU_Address@VINP_MCUDCVol_V@ */ /end MEASUREMENT
/begin MEASUREMENT VINP_ZFRBCMLFTurnLpCSta_A "" FLOAT32_IEEE SWC_INP_type_CM_single_A 0 0 0.0 6.375 ECU_ADDRESS 0x0000 /* @ECU_Address@VINP_ZFRBCMLFTurnLpCSta_A@ */ /end MEASUREMENT
/begin MEASUREMENT VINP_ZFRBCMLightSensorVSta_V "" FLOAT32_IEEE SWC_INP_type_CM_single_V 0 0 0.0 4.998 ECU_ADDRESS 0x0000 /* @ECU_Address@VINP_ZFRBCMLightSensorVSta_V@ */ /end MEASUREMENT
/begin MEASUREMENT VINP_ZFRBCMRFTurnLpCSta_A "" FLOAT32_IEEE SWC_INP_type_CM_single_A 0 0 0.0 6.375 ECU_ADDRESS 0x0000 /* @ECU_Address@VINP_ZFRBCMRFTurnLpCSta_A@ */ /end MEASUREMENT
/begin MEASUREMENT VINP_AirPressurePC3_kPa "" FLOAT32_IEEE SWC_INP_type_CM_single_kPa 0 0 0.0 2000.0 ECU_ADDRESS 0x0000 /* @ECU_Address@VINP_AirPressurePC3_kPa@ */ /end MEASUREMENT
/begin MEASUREMENT VINP_AirPressureRC1_kPa "" FLOAT32_IEEE SWC_INP_type_CM_single_kPa 0 0 0.0 2008.0 ECU_ADDRESS 0x0000 /* @ECU_Address@VINP_AirPressureRC1_kPa@ */ /end MEASUREMENT
/begin MEASUREMENT VINP_ZRRBCMLRTurnLpCSta_A "" FLOAT32_IEEE SWC_INP_type_CM_single_A 0 0 0.0 6.375 ECU_ADDRESS 0x0000 /* @ECU_Address@VINP_ZRRBCMLRTurnLpCSta_A@ */ /end MEASUREMENT
/begin MEASUREMENT VINP_ZRRBCMRRTurnLpCSta_A "" FLOAT32_IEEE SWC_INP_type_CM_single_A 0 0 0.0 6.375 ECU_ADDRESS 0x0000 /* @ECU_Address@VINP_ZRRBCMRRTurnLpCSta_A@ */ /end MEASUREMENT
/begin MEASUREMENT VINP_DCDCOutVolSta_V "" FLOAT32_IEEE SWC_INP_type_CM_single_V 0 0 0.0 1000.0 ECU_ADDRESS 0x0000 /* @ECU_Address@VINP_DCDCOutVolSta_V@ */ /end MEASUREMENT
/begin MEASUREMENT VINP_DCDCTempSta_C "" FLOAT32_IEEE SWC_INP_type_CM_single_C 0 0 -40.0 200.0 ECU_ADDRESS 0x0000 /* @ECU_Address@VINP_DCDCTempSta_C@ */ /end MEASUREMENT
/begin MEASUREMENT VINP_EACInvTempSta_C "" FLOAT32_IEEE SWC_INP_type_CM_single_C 0 0 -40.0 150.0 ECU_ADDRESS 0x0000 /* @ECU_Address@VINP_EACInvTempSta_C@ */ /end MEASUREMENT
/begin MEASUREMENT VINP_EHPSInvTempSta_C "" FLOAT32_IEEE SWC_INP_type_CM_single_C 0 0 -40.0 150.0 ECU_ADDRESS 0x0000 /* @ECU_Address@VINP_EHPSInvTempSta_C@ */ /end MEASUREMENT
/begin MEASUREMENT VINP_EHPSMotorSpdSta_rpm "" FLOAT32_IEEE SWC_INP_type_CM_single_rpm 0 0 -5000.0 5000.0 ECU_ADDRESS 0x0000 /* @ECU_Address@VINP_EHPSMotorSpdSta_rpm@ */ /end MEASUREMENT
/begin MEASUREMENT VINP_AirPressureFC2_kPa "" FLOAT32_IEEE SWC_INP_type_CM_single_kPa 0 0 0.0 2008.0 ECU_ADDRESS 0x0000 /* @ECU_Address@VINP_AirPressureFC2_kPa@ */ /end MEASUREMENT
/begin MEASUREMENT VINP_AuxBattVolmV_mV "" UWORD SWC_INP_type_CM_uint16_mV 0 0 0.0 65535.0 ECU_ADDRESS 0x0000 /* @ECU_Address@VINP_AuxBattVolmV_mV@ */ /end MEASUREMENT
/begin MEASUREMENT VINP_KeyFobAreaU16_enum "" UWORD SWC_INP_type_CM_uint16_enum 0 0 0.0 65535.0 ECU_ADDRESS 0x0000 /* @ECU_Address@VINP_KeyFobAreaU16_enum@ */ /end MEASUREMENT
/begin MEASUREMENT VINP_UIDBatVoltx1000_V "" UWORD SWC_INP_type_CM_uint16_V 0 0 0.0 65535.0 ECU_ADDRESS 0x0000 /* @ECU_Address@VINP_UIDBatVoltx1000_V@ */ /end MEASUREMENT
/begin MEASUREMENT VINP_MemOffsetGyroX_raw16 "" SWORD SWC_INP_type_CM_int16_raw16 0 0 -32768.0 32767.0 ECU_ADDRESS 0x0000 /* @ECU_Address@VINP_MemOffsetGyroX_raw16@ */ /end MEASUREMENT
/begin MEASUREMENT VINP_MemOffsetGyroY_raw16 "" SWORD SWC_INP_type_CM_int16_raw16 0 0 -32768.0 32767.0 ECU_ADDRESS 0x0000 /* @ECU_Address@VINP_MemOffsetGyroY_raw16@ */ /end MEASUREMENT
/begin MEASUREMENT VINP_MemOffsetGyroZ_raw16 "" SWORD SWC_INP_type_CM_int16_raw16 0 0 -32768.0 32767.0 ECU_ADDRESS 0x0000 /* @ECU_Address@VINP_MemOffsetGyroZ_raw16@ */ /end MEASUREMENT
/begin MEASUREMENT VINP_MemOffsetAccX_raw16 "" SWORD SWC_INP_type_CM_int16_raw16 0 0 -32768.0 32767.0 ECU_ADDRESS 0x0000 /* @ECU_Address@VINP_MemOffsetAccX_raw16@ */ /end MEASUREMENT
/begin MEASUREMENT VINP_MemOffsetAccY_raw16 "" SWORD SWC_INP_type_CM_int16_raw16 0 0 -32768.0 32767.0 ECU_ADDRESS 0x0000 /* @ECU_Address@VINP_MemOffsetAccY_raw16@ */ /end MEASUREMENT
/begin MEASUREMENT VINP_MemOffsetAccZ_raw16 "" SWORD SWC_INP_type_CM_int16_raw16 0 0 -32768.0 32767.0 ECU_ADDRESS 0x0000 /* @ECU_Address@VINP_MemOffsetAccZ_raw16@ */ /end MEASUREMENT
/begin MEASUREMENT VINP_SensingGyroX_raw16 "" SWORD SWC_INP_type_CM_int16_raw16 0 0 -32768.0 32767.0 ECU_ADDRESS 0x0000 /* @ECU_Address@VINP_SensingGyroX_raw16@ */ /end MEASUREMENT
/begin MEASUREMENT VINP_SensingGyroY_raw16 "" SWORD SWC_INP_type_CM_int16_raw16 0 0 -32768.0 32767.0 ECU_ADDRESS 0x0000 /* @ECU_Address@VINP_SensingGyroY_raw16@ */ /end MEASUREMENT
/begin MEASUREMENT VINP_SensingGyroZ_raw16 "" SWORD SWC_INP_type_CM_int16_raw16 0 0 -32768.0 32767.0 ECU_ADDRESS 0x0000 /* @ECU_Address@VINP_SensingGyroZ_raw16@ */ /end MEASUREMENT
/begin MEASUREMENT VINP_SensingAccX_raw16 "" SWORD SWC_INP_type_CM_int16_raw16 0 0 -32768.0 32767.0 ECU_ADDRESS 0x0000 /* @ECU_Address@VINP_SensingAccX_raw16@ */ /end MEASUREMENT
/begin MEASUREMENT VINP_SensingAccY_raw16 "" SWORD SWC_INP_type_CM_int16_raw16 0 0 -32768.0 32767.0 ECU_ADDRESS 0x0000 /* @ECU_Address@VINP_SensingAccY_raw16@ */ /end MEASUREMENT
/begin MEASUREMENT VINP_SensingAccZ_raw16 "" SWORD SWC_INP_type_CM_int16_raw16 0 0 -32768.0 32767.0 ECU_ADDRESS 0x0000 /* @ECU_Address@VINP_SensingAccZ_raw16@ */ /end MEASUREMENT
/begin MEASUREMENT VINP_PwrReq_OTA_enum "" UBYTE SWC_INP_type_CM_uint8_OTA_enum 0 0 0.0 255.0 ECU_ADDRESS 0x0000 /* @ECU_Address@VINP_PwrReq_OTA_enum@ */ /end MEASUREMENT
/begin MEASUREMENT VINP_AllowMovThd_OTA_enum "" UBYTE SWC_INP_type_CM_uint8_OTA_enum 0 0 0.0 255.0 ECU_ADDRESS 0x0000 /* @ECU_Address@VINP_AllowMovThd_OTA_enum@ */ /end MEASUREMENT
/begin MEASUREMENT VINP_ACFanSpdSta_enum "" UBYTE SWC_INP_type_CM_uint8_enum 0 0 0.0 3.0 ECU_ADDRESS 0x0000 /* @ECU_Address@VINP_ACFanSpdSta_enum@ */ /end MEASUREMENT
/begin MEASUREMENT VINP_TM2BFaultCode_enum "" UBYTE SWC_INP_type_CM_uint8_enum 0 0 0.0 63.0 ECU_ADDRESS 0x0000 /* @ECU_Address@VINP_TM2BFaultCode_enum@ */ /end MEASUREMENT
/begin MEASUREMENT VINP_ASC1KneelingInfo_enum "" UBYTE SWC_INP_type_CM_uint8_enum 0 0 0.0 15.0 ECU_ADDRESS 0x0000 /* @ECU_Address@VINP_ASC1KneelingInfo_enum@ */ /end MEASUREMENT
/begin MEASUREMENT VINP_ABSFullyOper_enum "" UBYTE SWC_INP_type_CM_uint8_enum 0 0 0.0 3.0 ECU_ADDRESS 0x0000 /* @ECU_Address@VINP_ABSFullyOper_enum@ */ /end MEASUREMENT
/begin MEASUREMENT VINP_ABSOffroadSw_enum "" UBYTE SWC_INP_type_CM_uint8_enum 0 0 0.0 3.0 ECU_ADDRESS 0x0000 /* @ECU_Address@VINP_ABSOffroadSw_enum@ */ /end MEASUREMENT
/begin MEASUREMENT VINP_ASRBrakeCtrlAtc_enum "" UBYTE SWC_INP_type_CM_uint8_enum 0 0 0.0 3.0 ECU_ADDRESS 0x0000 /* @ECU_Address@VINP_ASRBrakeCtrlAtc_enum@ */ /end MEASUREMENT
/begin MEASUREMENT VINP_ASREngCtrlAtc_enum "" UBYTE SWC_INP_type_CM_uint8_enum 0 0 0.0 3.0 ECU_ADDRESS 0x0000 /* @ECU_Address@VINP_ASREngCtrlAtc_enum@ */ /end MEASUREMENT
/begin MEASUREMENT VINP_ASRHillHolderSw_enum "" UBYTE SWC_INP_type_CM_uint8_enum 0 0 0.0 3.0 ECU_ADDRESS 0x0000 /* @ECU_Address@VINP_ASRHillHolderSw_enum@ */ /end MEASUREMENT
/begin MEASUREMENT VINP_ASROffroadSw_enum "" UBYTE SWC_INP_type_CM_uint8_enum 0 0 0.0 3.0 ECU_ADDRESS 0x0000 /* @ECU_Address@VINP_ASROffroadSw_enum@ */ /end MEASUREMENT
/begin MEASUREMENT VINP_ATCASRInfoSig_enum "" UBYTE SWC_INP_type_CM_uint8_enum 0 0 0.0 3.0 ECU_ADDRESS 0x0000 /* @ECU_Address@VINP_ATCASRInfoSig_enum@ */ /end MEASUREMENT
/begin MEASUREMENT VINP_AcltrInterlockSw_enum "" UBYTE SWC_INP_type_CM_uint8_enum 0 0 0.0 3.0 ECU_ADDRESS 0x0000 /* @ECU_Address@VINP_AcltrInterlockSw_enum@ */ /end MEASUREMENT
/begin MEASUREMENT VINP_AntiLBrakABSAct_enum "" UBYTE SWC_INP_type_CM_uint8_enum 0 0 0.0 3.0 ECU_ADDRESS 0x0000 /* @ECU_Address@VINP_AntiLBrakABSAct_enum@ */ /end MEASUREMENT
/begin MEASUREMENT VINP_EBSAmWarnLampSta_enum "" UBYTE SWC_INP_type_CM_uint8_enum 0 0 0.0 3.0 ECU_ADDRESS 0x0000 /* @ECU_Address@VINP_EBSAmWarnLampSta_enum@ */ /end MEASUREMENT
/begin MEASUREMENT VINP_EBSBrakeSw_enum "" UBYTE SWC_INP_type_CM_uint8_enum 0 0 0.0 3.0 ECU_ADDRESS 0x0000 /* @ECU_Address@VINP_EBSBrakeSw_enum@ */ /end MEASUREMENT
/begin MEASUREMENT VINP_EBSRedWarnLampSta_enum "" UBYTE SWC_INP_type_CM_uint8_enum 0 0 0.0 3.0 ECU_ADDRESS 0x0000 /* @ECU_Address@VINP_EBSRedWarnLampSta_enum@ */ /end MEASUREMENT
/begin MEASUREMENT VINP_EngAuxShutdownSw_enum "" UBYTE SWC_INP_type_CM_uint8_enum 0 0 0.0 3.0 ECU_ADDRESS 0x0000 /* @ECU_Address@VINP_EngAuxShutdownSw_enum@ */ /end MEASUREMENT
/begin MEASUREMENT VINP_EngDerateSw_enum "" UBYTE SWC_INP_type_CM_uint8_enum 0 0 0.0 3.0 ECU_ADDRESS 0x0000 /* @ECU_Address@VINP_EngDerateSw_enum@ */ /end MEASUREMENT
/begin MEASUREMENT VINP_HaltBrakeSw_enum "" UBYTE SWC_INP_type_CM_uint8_enum 0 0 0.0 3.0 ECU_ADDRESS 0x0000 /* @ECU_Address@VINP_HaltBrakeSw_enum@ */ /end MEASUREMENT
/begin MEASUREMENT VINP_RmAccelEnSw_enum "" UBYTE SWC_INP_type_CM_uint8_enum 0 0 0.0 3.0 ECU_ADDRESS 0x0000 /* @ECU_Address@VINP_RmAccelEnSw_enum@ */ /end MEASUREMENT
/begin MEASUREMENT VINP_TractCtrlOvrSw_enum "" UBYTE SWC_INP_type_CM_uint8_enum 0 0 0.0 3.0 ECU_ADDRESS 0x0000 /* @ECU_Address@VINP_TractCtrlOvrSw_enum@ */ /end MEASUREMENT
/begin MEASUREMENT VINP_TrailerABSSta_enum "" UBYTE SWC_INP_type_CM_uint8_enum 0 0 0.0 3.0 ECU_ADDRESS 0x0000 /* @ECU_Address@VINP_TrailerABSSta_enum@ */ /end MEASUREMENT
/begin MEASUREMENT VINP_TrailerABSWarnSig_enum "" UBYTE SWC_INP_type_CM_uint8_enum 0 0 0.0 3.0 ECU_ADDRESS 0x0000 /* @ECU_Address@VINP_TrailerABSWarnSig_enum@ */ /end MEASUREMENT
/begin MEASUREMENT VINP_BrkTempeWarn_enum "" UBYTE SWC_INP_type_CM_uint8_enum 0 0 0.0 3.0 ECU_ADDRESS 0x0000 /* @ECU_Address@VINP_BrkTempeWarn_enum@ */ /end MEASUREMENT
/begin MEASUREMENT VINP_FndBrkUse_enum "" UBYTE SWC_INP_type_CM_uint8_enum 0 0 0.0 3.0 ECU_ADDRESS 0x0000 /* @ECU_Address@VINP_FndBrkUse_enum@ */ /end MEASUREMENT
/begin MEASUREMENT VINP_HaltBrkMode_enum "" UBYTE SWC_INP_type_CM_uint8_enum 0 0 0.0 7.0 ECU_ADDRESS 0x0000 /* @ECU_Address@VINP_HaltBrkMode_enum@ */ /end MEASUREMENT
/begin MEASUREMENT VINP_HillHolderMode_enum "" UBYTE SWC_INP_type_CM_uint8_enum 0 0 0.0 7.0 ECU_ADDRESS 0x0000 /* @ECU_Address@VINP_HillHolderMode_enum@ */ /end MEASUREMENT
/begin MEASUREMENT VINP_ParkBrkActuFAct_enum "" UBYTE SWC_INP_type_CM_uint8_enum 0 0 0.0 3.0 ECU_ADDRESS 0x0000 /* @ECU_Address@VINP_ParkBrkActuFAct_enum@ */ /end MEASUREMENT
/begin MEASUREMENT VINP_XBRActtrlMode_enum "" UBYTE SWC_INP_type_CM_uint8_enum 0 0 0.0 15.0 ECU_ADDRESS 0x0000 /* @ECU_Address@VINP_XBRActtrlMode_enum@ */ /end MEASUREMENT
/begin MEASUREMENT VINP_XBRSysSta_enum "" UBYTE SWC_INP_type_CM_uint8_enum 0 0 0.0 3.0 ECU_ADDRESS 0x0000 /* @ECU_Address@VINP_XBRSysSta_enum@ */ /end MEASUREMENT
/begin MEASUREMENT VINP_ECASAWarmLampSta_enum "" UBYTE SWC_INP_type_CM_uint8_enum 0 0 0.0 3.0 ECU_ADDRESS 0x0000 /* @ECU_Address@VINP_ECASAWarmLampSta_enum@ */ /end MEASUREMENT
/begin MEASUREMENT VINP_EM1CS_enum "" UBYTE SWC_INP_type_CM_uint8_enum 0 0 0.0 7.0 ECU_ADDRESS 0x0000 /* @ECU_Address@VINP_EM1CS_enum@ */ /end MEASUREMENT
/begin MEASUREMENT VINP_EM1Cnt_enum "" UBYTE SWC_INP_type_CM_uint8_enum 0 0 0.0 7.0 ECU_ADDRESS 0x0000 /* @ECU_Address@VINP_EM1Cnt_enum@ */ /end MEASUREMENT
/begin MEASUREMENT VINP_EM1OvrCtrlMBrk_enum "" UBYTE SWC_INP_type_CM_uint8_enum 0 0 0.0 3.0 ECU_ADDRESS 0x0000 /* @ECU_Address@VINP_EM1OvrCtrlMBrk_enum@ */ /end MEASUREMENT
/begin MEASUREMENT VINP_EM1OvrCtrlMDriv_enum "" UBYTE SWC_INP_type_CM_uint8_enum 0 0 0.0 3.0 ECU_ADDRESS 0x0000 /* @ECU_Address@VINP_EM1OvrCtrlMDriv_enum@ */ /end MEASUREMENT
/begin MEASUREMENT VINP_EM1OvrCtrlMPriBrk_enum "" UBYTE SWC_INP_type_CM_uint8_enum 0 0 0.0 3.0 ECU_ADDRESS 0x0000 /* @ECU_Address@VINP_EM1OvrCtrlMPriBrk_enum@ */ /end MEASUREMENT
/begin MEASUREMENT VINP_DrivDirF_enum "" UBYTE SWC_INP_type_CM_uint8_enum 0 0 0.0 3.0 ECU_ADDRESS 0x0000 /* @ECU_Address@VINP_DrivDirF_enum@ */ /end MEASUREMENT
/begin MEASUREMENT VINP_TransReqGear_enum "" UBYTE SWC_INP_type_CM_uint8_enum 0 0 0.0 255.0 ECU_ADDRESS 0x0000 /* @ECU_Address@VINP_TransReqGear_enum@ */ /end MEASUREMENT
/begin MEASUREMENT VINP_IVIACFanSpdReqCmd_enum "" UBYTE SWC_INP_type_CM_uint8_enum 0 0 0.0 3.0 ECU_ADDRESS 0x0000 /* @ECU_Address@VINP_IVIACFanSpdReqCmd_enum@ */ /end MEASUREMENT
/begin MEASUREMENT VINP_B2THVRlySta_enum "" UBYTE SWC_INP_type_CM_uint8_enum 0 0 0.0 3.0 ECU_ADDRESS 0x0000 /* @ECU_Address@VINP_B2THVRlySta_enum@ */ /end MEASUREMENT
/begin MEASUREMENT VINP_B2VBI1BattType_enum "" UBYTE SWC_INP_type_CM_uint8_enum 0 0 0.0 15.0 ECU_ADDRESS 0x0000 /* @ECU_Address@VINP_B2VBI1BattType_enum@ */ /end MEASUREMENT
/begin MEASUREMENT VINP_B2VACChgNegRlySta_enum "" UBYTE SWC_INP_type_CM_uint8_enum 0 0 0.0 3.0 ECU_ADDRESS 0x0000 /* @ECU_Address@VINP_B2VACChgNegRlySta_enum@ */ /end MEASUREMENT
/begin MEASUREMENT VINP_B2VACChgPosRlySta_enum "" UBYTE SWC_INP_type_CM_uint8_enum 0 0 0.0 3.0 ECU_ADDRESS 0x0000 /* @ECU_Address@VINP_B2VACChgPosRlySta_enum@ */ /end MEASUREMENT
/begin MEASUREMENT VINP_B2VBMUHVSta_enum "" UBYTE SWC_INP_type_CM_uint8_enum 0 0 0.0 3.0 ECU_ADDRESS 0x0000 /* @ECU_Address@VINP_B2VBMUHVSta_enum@ */ /end MEASUREMENT
/begin MEASUREMENT VINP_B2VChgMode_enum "" UBYTE SWC_INP_type_CM_uint8_enum 0 0 0.0 3.0 ECU_ADDRESS 0x0000 /* @ECU_Address@VINP_B2VChgMode_enum@ */ /end MEASUREMENT
/begin MEASUREMENT VINP_B2VChgSta_enum "" UBYTE SWC_INP_type_CM_uint8_enum 0 0 0.0 3.0 ECU_ADDRESS 0x0000 /* @ECU_Address@VINP_B2VChgSta_enum@ */ /end MEASUREMENT
/begin MEASUREMENT VINP_B2VDCChgConnSta_enum "" UBYTE SWC_INP_type_CM_uint8_enum 0 0 0.0 3.0 ECU_ADDRESS 0x0000 /* @ECU_Address@VINP_B2VDCChgConnSta_enum@ */ /end MEASUREMENT
/begin MEASUREMENT VINP_B2VDCChgN1RlySta_enum "" UBYTE SWC_INP_type_CM_uint8_enum 0 0 0.0 3.0 ECU_ADDRESS 0x0000 /* @ECU_Address@VINP_B2VDCChgN1RlySta_enum@ */ /end MEASUREMENT
/begin MEASUREMENT VINP_B2VDCChgP1RlySta_enum "" UBYTE SWC_INP_type_CM_uint8_enum 0 0 0.0 3.0 ECU_ADDRESS 0x0000 /* @ECU_Address@VINP_B2VDCChgP1RlySta_enum@ */ /end MEASUREMENT
/begin MEASUREMENT VINP_B2VMainNegRlySta_enum "" UBYTE SWC_INP_type_CM_uint8_enum 0 0 0.0 3.0 ECU_ADDRESS 0x0000 /* @ECU_Address@VINP_B2VMainNegRlySta_enum@ */ /end MEASUREMENT
/begin MEASUREMENT VINP_B2VFaultCode_enum "" UBYTE SWC_INP_type_CM_uint8_enum 0 0 0.0 255.0 ECU_ADDRESS 0x0000 /* @ECU_Address@VINP_B2VFaultCode_enum@ */ /end MEASUREMENT
/begin MEASUREMENT VINP_B2VFaultLv_enum "" UBYTE SWC_INP_type_CM_uint8_enum 0 0 0.0 3.0 ECU_ADDRESS 0x0000 /* @ECU_Address@VINP_B2VFaultLv_enum@ */ /end MEASUREMENT
/begin MEASUREMENT VINP_B2VRqHVPwrOff_enum "" UBYTE SWC_INP_type_CM_uint8_enum 0 0 0.0 3.0 ECU_ADDRESS 0x0000 /* @ECU_Address@VINP_B2VRqHVPwrOff_enum@ */ /end MEASUREMENT
/begin MEASUREMENT VINP_B2VMinTempPos_enum "" UBYTE SWC_INP_type_CM_uint8_enum 0 0 0.0 255.0 ECU_ADDRESS 0x0000 /* @ECU_Address@VINP_B2VMinTempPos_enum@ */ /end MEASUREMENT
/begin MEASUREMENT VINP_EWPPEFault_enum "" UBYTE SWC_INP_type_CM_uint8_enum 0 0 0.0 255.0 ECU_ADDRESS 0x0000 /* @ECU_Address@VINP_EWPPEFault_enum@ */ /end MEASUREMENT
/begin MEASUREMENT VINP_MCUCtrlMdSta_enum "" UBYTE SWC_INP_type_CM_uint8_enum 0 0 0.0 3.0 ECU_ADDRESS 0x0000 /* @ECU_Address@VINP_MCUCtrlMdSta_enum@ */ /end MEASUREMENT
/begin MEASUREMENT VINP_MCUFailGrade_enum "" UBYTE SWC_INP_type_CM_uint8_enum 0 0 0.0 15.0 ECU_ADDRESS 0x0000 /* @ECU_Address@VINP_MCUFailGrade_enum@ */ /end MEASUREMENT
/begin MEASUREMENT VINP_MCUFailCode_enum "" UBYTE SWC_INP_type_CM_uint8_enum 0 0 0.0 255.0 ECU_ADDRESS 0x0000 /* @ECU_Address@VINP_MCUFailCode_enum@ */ /end MEASUREMENT
/begin MEASUREMENT VINP_ParkBrakeSW_enum "" UBYTE SWC_INP_type_CM_uint8_enum 0 0 0.0 3.0 ECU_ADDRESS 0x0000 /* @ECU_Address@VINP_ParkBrakeSW_enum@ */ /end MEASUREMENT
/begin MEASUREMENT VINP_ZRRBCMAllDoorSta_enum "" UBYTE SWC_INP_type_CM_uint8_enum 0 0 0.0 15.0 ECU_ADDRESS 0x0000 /* @ECU_Address@VINP_ZRRBCMAllDoorSta_enum@ */ /end MEASUREMENT
/begin MEASUREMENT VINP_DCDCEnSta_enum "" UBYTE SWC_INP_type_CM_uint8_enum 0 0 0.0 3.0 ECU_ADDRESS 0x0000 /* @ECU_Address@VINP_DCDCEnSta_enum@ */ /end MEASUREMENT
/begin MEASUREMENT VINP_DCDCErrLvSta_enum "" UBYTE SWC_INP_type_CM_uint8_enum 0 0 0.0 7.0 ECU_ADDRESS 0x0000 /* @ECU_Address@VINP_DCDCErrLvSta_enum@ */ /end MEASUREMENT
/begin MEASUREMENT VINP_EACEnSta_enum "" UBYTE SWC_INP_type_CM_uint8_enum 0 0 0.0 3.0 ECU_ADDRESS 0x0000 /* @ECU_Address@VINP_EACEnSta_enum@ */ /end MEASUREMENT
/begin MEASUREMENT VINP_EACErrLvSta_enum "" UBYTE SWC_INP_type_CM_uint8_enum 0 0 0.0 7.0 ECU_ADDRESS 0x0000 /* @ECU_Address@VINP_EACErrLvSta_enum@ */ /end MEASUREMENT
/begin MEASUREMENT VINP_EHPSEnSta_enum "" UBYTE SWC_INP_type_CM_uint8_enum 0 0 0.0 3.0 ECU_ADDRESS 0x0000 /* @ECU_Address@VINP_EHPSEnSta_enum@ */ /end MEASUREMENT
/begin MEASUREMENT VINP_EHPSErrLvSta_enum "" UBYTE SWC_INP_type_CM_uint8_enum 0 0 0.0 7.0 ECU_ADDRESS 0x0000 /* @ECU_Address@VINP_EHPSErrLvSta_enum@ */ /end MEASUREMENT
/begin MEASUREMENT VINP_PDUACRlySta_enum "" UBYTE SWC_INP_type_CM_uint8_enum 0 0 0.0 3.0 ECU_ADDRESS 0x0000 /* @ECU_Address@VINP_PDUACRlySta_enum@ */ /end MEASUREMENT
/begin MEASUREMENT VINP_PDUDCDCEACEHPSHVLoopSta_enum "" UBYTE SWC_INP_type_CM_uint8_enum 0 0 0.0 3.0 ECU_ADDRESS 0x0000 /* @ECU_Address@VINP_PDUDCDCEACEHPSHVLoopSta_enum@ */ /end MEASUREMENT
/begin MEASUREMENT VINP_PDUDCDCEACEHPSPreRlySta_enum "" UBYTE SWC_INP_type_CM_uint8_enum 0 0 0.0 3.0 ECU_ADDRESS 0x0000 /* @ECU_Address@VINP_PDUDCDCEACEHPSPreRlySta_enum@ */ /end MEASUREMENT
/begin MEASUREMENT VINP_PDUDCDCEACEHPSRlySta_enum "" UBYTE SWC_INP_type_CM_uint8_enum 0 0 0.0 3.0 ECU_ADDRESS 0x0000 /* @ECU_Address@VINP_PDUDCDCEACEHPSRlySta_enum@ */ /end MEASUREMENT
/begin MEASUREMENT VINP_PDUHVILSta_enum "" UBYTE SWC_INP_type_CM_uint8_enum 0 0 0.0 3.0 ECU_ADDRESS 0x0000 /* @ECU_Address@VINP_PDUHVILSta_enum@ */ /end MEASUREMENT
/begin MEASUREMENT VINP_PDUMCUHVLoopSta_enum "" UBYTE SWC_INP_type_CM_uint8_enum 0 0 0.0 3.0 ECU_ADDRESS 0x0000 /* @ECU_Address@VINP_PDUMCUHVLoopSta_enum@ */ /end MEASUREMENT
/begin MEASUREMENT VINP_PDUMCUPosRlySta_enum "" UBYTE SWC_INP_type_CM_uint8_enum 0 0 0.0 3.0 ECU_ADDRESS 0x0000 /* @ECU_Address@VINP_PDUMCUPosRlySta_enum@ */ /end MEASUREMENT
/begin MEASUREMENT VINP_PDUMCUPreRlySta_enum "" UBYTE SWC_INP_type_CM_uint8_enum 0 0 0.0 3.0 ECU_ADDRESS 0x0000 /* @ECU_Address@VINP_PDUMCUPreRlySta_enum@ */ /end MEASUREMENT
/begin MEASUREMENT VINP_PDUSelfChkSta_enum "" UBYTE SWC_INP_type_CM_uint8_enum 0 0 0.0 3.0 ECU_ADDRESS 0x0000 /* @ECU_Address@VINP_PDUSelfChkSta_enum@ */ /end MEASUREMENT
/begin MEASUREMENT VINP_UIDButtonCmd_enum "" UBYTE SWC_INP_type_CM_uint8_enum 0 0 0.0 255.0 ECU_ADDRESS 0x0000 /* @ECU_Address@VINP_UIDButtonCmd_enum@ */ /end MEASUREMENT
/begin MEASUREMENT VINP_BTConnectSta_enum "" UBYTE SWC_INP_type_CM_uint8_enum 0 0 0.0 255.0 ECU_ADDRESS 0x0000 /* @ECU_Address@VINP_BTConnectSta_enum@ */ /end MEASUREMENT
/begin MEASUREMENT VINP_TPMSPressure_raw "" UBYTE SWC_INP_type_CM_uint8_raw 0 0 0.0 255.0 ECU_ADDRESS 0x0000 /* @ECU_Address@VINP_TPMSPressure_raw@ */ /end MEASUREMENT
/begin MEASUREMENT VINP_TPMSTemp_raw "" UBYTE SWC_INP_type_CM_uint8_raw 0 0 0.0 255.0 ECU_ADDRESS 0x0000 /* @ECU_Address@VINP_TPMSTemp_raw@ */ /end MEASUREMENT
/begin MEASUREMENT VINP_TPMSSta_enum "" UBYTE SWC_INP_type_CM_uint8_enum 0 0 0.0 255.0 ECU_ADDRESS 0x0000 /* @ECU_Address@VINP_TPMSSta_enum@ */ /end MEASUREMENT
/begin MEASUREMENT VINP_TPMSPressureMi_raw "" UBYTE SWC_INP_type_CM_uint8_raw 0 0 0.0 255.0 ECU_ADDRESS 0x0000 /* @ECU_Address@VINP_TPMSPressureMi_raw@ */ /end MEASUREMENT
/begin MEASUREMENT VINP_TPMSCRC_crc "" UBYTE SWC_INP_type_CM_uint8_crc 0 0 0.0 255.0 ECU_ADDRESS 0x0000 /* @ECU_Address@VINP_TPMSCRC_crc@ */ /end MEASUREMENT
/begin MEASUREMENT VINP_TPMSCRCCalc_crc "" UBYTE SWC_INP_type_CM_uint8_crc 0 0 0.0 255.0 ECU_ADDRESS 0x0000 /* @ECU_Address@VINP_TPMSCRCCalc_crc@ */ /end MEASUREMENT
/begin MEASUREMENT VINP_DKCBTRSSI_dB "" SBYTE SWC_INP_type_CM_int8_dB 0 0 -128.0 127.0 ECU_ADDRESS 0x0000 /* @ECU_Address@VINP_DKCBTRSSI_dB@ */ /end MEASUREMENT
/begin MEASUREMENT VINP_AcoreReadyToSlp_flg "" UBYTE SWC_INP_type_CM_boolean_flg 0 0 0.0 1.0 ECU_ADDRESS 0x0000 /* @ECU_Address@VINP_AcoreReadyToSlp_flg@ */ /end MEASUREMENT
/begin MEASUREMENT VINP_EvccAplusPwrUpReq_flg "" UBYTE SWC_INP_type_CM_boolean_flg 0 0 0.0 1.0 ECU_ADDRESS 0x0000 /* @ECU_Address@VINP_EvccAplusPwrUpReq_flg@ */ /end MEASUREMENT
/begin MEASUREMENT VINP_NetworkReqCalled_flg "" UBYTE SWC_INP_type_CM_boolean_flg 0 0 0.0 1.0 ECU_ADDRESS 0x0000 /* @ECU_Address@VINP_NetworkReqCalled_flg@ */ /end MEASUREMENT
/begin MEASUREMENT VINP_CAN1BusOff_flg "" UBYTE SWC_INP_type_CM_boolean_flg 0 0 0.0 1.0 ECU_ADDRESS 0x0000 /* @ECU_Address@VINP_CAN1BusOff_flg@ */ /end MEASUREMENT
/begin MEASUREMENT VINP_CAN2BusOff_flg "" UBYTE SWC_INP_type_CM_boolean_flg 0 0 0.0 1.0 ECU_ADDRESS 0x0000 /* @ECU_Address@VINP_CAN2BusOff_flg@ */ /end MEASUREMENT
/begin MEASUREMENT VINP_CAN3BusOff_flg "" UBYTE SWC_INP_type_CM_boolean_flg 0 0 0.0 1.0 ECU_ADDRESS 0x0000 /* @ECU_Address@VINP_CAN3BusOff_flg@ */ /end MEASUREMENT
/begin MEASUREMENT VINP_CAN4BusOff_flg "" UBYTE SWC_INP_type_CM_boolean_flg 0 0 0.0 1.0 ECU_ADDRESS 0x0000 /* @ECU_Address@VINP_CAN4BusOff_flg@ */ /end MEASUREMENT
/begin MEASUREMENT VINP_CAN5BusOff_flg "" UBYTE SWC_INP_type_CM_boolean_flg 0 0 0.0 1.0 ECU_ADDRESS 0x0000 /* @ECU_Address@VINP_CAN5BusOff_flg@ */ /end MEASUREMENT
/begin MEASUREMENT VINP_CAN6BusOff_flg "" UBYTE SWC_INP_type_CM_boolean_flg 0 0 0.0 1.0 ECU_ADDRESS 0x0000 /* @ECU_Address@VINP_CAN6BusOff_flg@ */ /end MEASUREMENT
/begin MEASUREMENT VINP_CANMsgValidIVIC1000_flg "" UBYTE SWC_INP_type_CM_boolean_flg 0 0 0.0 1.0 ECU_ADDRESS 0x0000 /* @ECU_Address@VINP_CANMsgValidIVIC1000_flg@ */ /end MEASUREMENT
/begin MEASUREMENT VINP_CANMsgValidB2TMInfo_flg "" UBYTE SWC_INP_type_CM_boolean_flg 0 0 0.0 1.0 ECU_ADDRESS 0x0000 /* @ECU_Address@VINP_CANMsgValidB2TMInfo_flg@ */ /end MEASUREMENT
/begin MEASUREMENT VINP_CANMsgValidTMMCUSta1_flg "" UBYTE SWC_INP_type_CM_boolean_flg 0 0 0.0 1.0 ECU_ADDRESS 0x0000 /* @ECU_Address@VINP_CANMsgValidTMMCUSta1_flg@ */ /end MEASUREMENT
/begin MEASUREMENT VINP_CANMsgValidTMMCUSta2_flg "" UBYTE SWC_INP_type_CM_boolean_flg 0 0 0.0 1.0 ECU_ADDRESS 0x0000 /* @ECU_Address@VINP_CANMsgValidTMMCUSta2_flg@ */ /end MEASUREMENT
/begin MEASUREMENT VINP_CANMsgValidTMMCUSta3_flg "" UBYTE SWC_INP_type_CM_boolean_flg 0 0 0.0 1.0 ECU_ADDRESS 0x0000 /* @ECU_Address@VINP_CANMsgValidTMMCUSta3_flg@ */ /end MEASUREMENT
/begin MEASUREMENT VINP_CANMsgValidB2VBattInfo1_flg "" UBYTE SWC_INP_type_CM_boolean_flg 0 0 0.0 1.0 ECU_ADDRESS 0x0000 /* @ECU_Address@VINP_CANMsgValidB2VBattInfo1_flg@ */ /end MEASUREMENT
/begin MEASUREMENT VINP_CANMsgValidB2VCurrentLimit_flg "" UBYTE SWC_INP_type_CM_boolean_flg 0 0 0.0 1.0 ECU_ADDRESS 0x0000 /* @ECU_Address@VINP_CANMsgValidB2VCurrentLimit_flg@ */ /end MEASUREMENT
/begin MEASUREMENT VINP_CANMsgValidB2VFult132960_flg "" UBYTE SWC_INP_type_CM_boolean_flg 0 0 0.0 1.0 ECU_ADDRESS 0x0000 /* @ECU_Address@VINP_CANMsgValidB2VFult132960_flg@ */ /end MEASUREMENT
/begin MEASUREMENT VINP_CANMsgValidB2VST1_flg "" UBYTE SWC_INP_type_CM_boolean_flg 0 0 0.0 1.0 ECU_ADDRESS 0x0000 /* @ECU_Address@VINP_CANMsgValidB2VST1_flg@ */ /end MEASUREMENT
/begin MEASUREMENT VINP_CANMsgValidB2VST2_flg "" UBYTE SWC_INP_type_CM_boolean_flg 0 0 0.0 1.0 ECU_ADDRESS 0x0000 /* @ECU_Address@VINP_CANMsgValidB2VST2_flg@ */ /end MEASUREMENT
/begin MEASUREMENT VINP_CANMsgValidB2VST4_flg "" UBYTE SWC_INP_type_CM_boolean_flg 0 0 0.0 1.0 ECU_ADDRESS 0x0000 /* @ECU_Address@VINP_CANMsgValidB2VST4_flg@ */ /end MEASUREMENT
/begin MEASUREMENT VINP_CANMsgValidB2VST5_flg "" UBYTE SWC_INP_type_CM_boolean_flg 0 0 0.0 1.0 ECU_ADDRESS 0x0000 /* @ECU_Address@VINP_CANMsgValidB2VST5_flg@ */ /end MEASUREMENT
/begin MEASUREMENT VINP_CANMsgValidEWP1_flg "" UBYTE SWC_INP_type_CM_boolean_flg 0 0 0.0 1.0 ECU_ADDRESS 0x0000 /* @ECU_Address@VINP_CANMsgValidEWP1_flg@ */ /end MEASUREMENT
/begin MEASUREMENT VINP_B2VHVILFault_flg "" UBYTE SWC_INP_type_CM_boolean_flg 0 0 0.0 1.0 ECU_ADDRESS 0x0000 /* @ECU_Address@VINP_B2VHVILFault_flg@ */ /end MEASUREMENT
/begin MEASUREMENT VINP_B2VACChgConnSta_flg "" UBYTE SWC_INP_type_CM_boolean_flg 0 0 0.0 1.0 ECU_ADDRESS 0x0000 /* @ECU_Address@VINP_B2VACChgConnSta_flg@ */ /end MEASUREMENT
/begin MEASUREMENT VINP_AtvDisChgEnFbk_flg "" UBYTE SWC_INP_type_CM_boolean_flg 0 0 0.0 1.0 ECU_ADDRESS 0x0000 /* @ECU_Address@VINP_AtvDisChgEnFbk_flg@ */ /end MEASUREMENT
/begin MEASUREMENT VINP_MCUIGBTEnFbk_flg "" UBYTE SWC_INP_type_CM_boolean_flg 0 0 0.0 1.0 ECU_ADDRESS 0x0000 /* @ECU_Address@VINP_MCUIGBTEnFbk_flg@ */ /end MEASUREMENT
/begin MEASUREMENT VINP_CANMsgValidZFRC1000_flg "" UBYTE SWC_INP_type_CM_boolean_flg 0 0 0.0 1.0 ECU_ADDRESS 0x0000 /* @ECU_Address@VINP_CANMsgValidZFRC1000_flg@ */ /end MEASUREMENT
/begin MEASUREMENT VINP_CANMsgValidZFRCE1000_flg "" UBYTE SWC_INP_type_CM_boolean_flg 0 0 0.0 1.0 ECU_ADDRESS 0x0000 /* @ECU_Address@VINP_CANMsgValidZFRCE1000_flg@ */ /end MEASUREMENT
/begin MEASUREMENT VINP_CANMsgValidZRRCE1000_flg "" UBYTE SWC_INP_type_CM_boolean_flg 0 0 0.0 1.0 ECU_ADDRESS 0x0000 /* @ECU_Address@VINP_CANMsgValidZRRCE1000_flg@ */ /end MEASUREMENT
/begin MEASUREMENT VINP_CANMsgValidZRRCE1001_flg "" UBYTE SWC_INP_type_CM_boolean_flg 0 0 0.0 1.0 ECU_ADDRESS 0x0000 /* @ECU_Address@VINP_CANMsgValidZRRCE1001_flg@ */ /end MEASUREMENT
/begin MEASUREMENT VINP_CANMsgValidzGWCANRr1C500_flg "" UBYTE SWC_INP_type_CM_boolean_flg 0 0 0.0 1.0 ECU_ADDRESS 0x0000 /* @ECU_Address@VINP_CANMsgValidzGWCANRr1C500_flg@ */ /end MEASUREMENT
/begin MEASUREMENT VINP_ZFRBCMHBeamSWSta_flg "" UBYTE SWC_INP_type_CM_boolean_flg 0 0 0.0 1.0 ECU_ADDRESS 0x0000 /* @ECU_Address@VINP_ZFRBCMHBeamSWSta_flg@ */ /end MEASUREMENT
/begin MEASUREMENT VINP_ZFRBCMHeadLpSWSta_flg "" UBYTE SWC_INP_type_CM_boolean_flg 0 0 0.0 1.0 ECU_ADDRESS 0x0000 /* @ECU_Address@VINP_ZFRBCMHeadLpSWSta_flg@ */ /end MEASUREMENT
/begin MEASUREMENT VINP_ZFRBCMPLampSta_flg "" UBYTE SWC_INP_type_CM_boolean_flg 0 0 0.0 1.0 ECU_ADDRESS 0x0000 /* @ECU_Address@VINP_ZFRBCMPLampSta_flg@ */ /end MEASUREMENT
/begin MEASUREMENT VINP_ZFRBCMRFogLpSWSta_flg "" UBYTE SWC_INP_type_CM_boolean_flg 0 0 0.0 1.0 ECU_ADDRESS 0x0000 /* @ECU_Address@VINP_ZFRBCMRFogLpSWSta_flg@ */ /end MEASUREMENT
/begin MEASUREMENT VINP_ZFRBCMSeatbeltSta_flg "" UBYTE SWC_INP_type_CM_boolean_flg 0 0 0.0 1.0 ECU_ADDRESS 0x0000 /* @ECU_Address@VINP_ZFRBCMSeatbeltSta_flg@ */ /end MEASUREMENT
/begin MEASUREMENT VINP_ZFRBCMWasherSWSta_flg "" UBYTE SWC_INP_type_CM_boolean_flg 0 0 0.0 1.0 ECU_ADDRESS 0x0000 /* @ECU_Address@VINP_ZFRBCMWasherSWSta_flg@ */ /end MEASUREMENT
/begin MEASUREMENT VINP_ZFRBCMWiperASSta_flg "" UBYTE SWC_INP_type_CM_boolean_flg 0 0 0.0 1.0 ECU_ADDRESS 0x0000 /* @ECU_Address@VINP_ZFRBCMWiperASSta_flg@ */ /end MEASUREMENT
/begin MEASUREMENT VINP_ZFRBCMWiperHSWSta_flg "" UBYTE SWC_INP_type_CM_boolean_flg 0 0 0.0 1.0 ECU_ADDRESS 0x0000 /* @ECU_Address@VINP_ZFRBCMWiperHSWSta_flg@ */ /end MEASUREMENT
/begin MEASUREMENT VINP_ZFRBCMWiperLSWSta_flg "" UBYTE SWC_INP_type_CM_boolean_flg 0 0 0.0 1.0 ECU_ADDRESS 0x0000 /* @ECU_Address@VINP_ZFRBCMWiperLSWSta_flg@ */ /end MEASUREMENT
/begin MEASUREMENT VINP_FDCCHASSISVCUEACPressSta_flg "" UBYTE SWC_INP_type_CM_boolean_flg 0 0 0.0 1.0 ECU_ADDRESS 0x0000 /* @ECU_Address@VINP_FDCCHASSISVCUEACPressSta_flg@ */ /end MEASUREMENT
/begin MEASUREMENT VINP_ZRRBCMCallingSWSta_flg "" UBYTE SWC_INP_type_CM_boolean_flg 0 0 0.0 1.0 ECU_ADDRESS 0x0000 /* @ECU_Address@VINP_ZRRBCMCallingSWSta_flg@ */ /end MEASUREMENT
/begin MEASUREMENT VINP_ZRRBCMPLampSta_flg "" UBYTE SWC_INP_type_CM_boolean_flg 0 0 0.0 1.0 ECU_ADDRESS 0x0000 /* @ECU_Address@VINP_ZRRBCMPLampSta_flg@ */ /end MEASUREMENT
/begin MEASUREMENT VINP_ZRRBCMSTOPSW2Sta_flg "" UBYTE SWC_INP_type_CM_boolean_flg 0 0 0.0 1.0 ECU_ADDRESS 0x0000 /* @ECU_Address@VINP_ZRRBCMSTOPSW2Sta_flg@ */ /end MEASUREMENT
/begin MEASUREMENT VINP_ZRRBCMSTOPSWSta_flg "" UBYTE SWC_INP_type_CM_boolean_flg 0 0 0.0 1.0 ECU_ADDRESS 0x0000 /* @ECU_Address@VINP_ZRRBCMSTOPSWSta_flg@ */ /end MEASUREMENT
/begin MEASUREMENT VINP_ZFRBCMAutoLightSWSta_flg "" UBYTE SWC_INP_type_CM_boolean_flg 0 0 0.0 1.0 ECU_ADDRESS 0x0000 /* @ECU_Address@VINP_ZFRBCMAutoLightSWSta_flg@ */ /end MEASUREMENT
/begin MEASUREMENT VINP_ZFRBCMBrakeSta_flg "" UBYTE SWC_INP_type_CM_boolean_flg 0 0 0.0 1.0 ECU_ADDRESS 0x0000 /* @ECU_Address@VINP_ZFRBCMBrakeSta_flg@ */ /end MEASUREMENT
/begin MEASUREMENT VINP_ClearDTCcmd_flg "" UBYTE SWC_INP_type_CM_boolean_flg 0 0 0.0 1.0 ECU_ADDRESS 0x0000 /* @ECU_Address@VINP_ClearDTCcmd_flg@ */ /end MEASUREMENT
/begin MEASUREMENT VINP_NFCDoorSta_flg "" UBYTE SWC_INP_type_CM_boolean_flg 0 0 0.0 1.0 ECU_ADDRESS 0x0000 /* @ECU_Address@VINP_NFCDoorSta_flg@ */ /end MEASUREMENT
/begin MEASUREMENT VINP_NFCLidASta_flg "" UBYTE SWC_INP_type_CM_boolean_flg 0 0 0.0 1.0 ECU_ADDRESS 0x0000 /* @ECU_Address@VINP_NFCLidASta_flg@ */ /end MEASUREMENT
/begin MEASUREMENT VINP_TPMSDataIn_flg "" UBYTE SWC_INP_type_CM_boolean_flg 0 0 0.0 1.0 ECU_ADDRESS 0x0000 /* @ECU_Address@VINP_TPMSDataIn_flg@ */ /end MEASUREMENT
/begin MEASUREMENT VINP_TPMSFAT_flg "" UBYTE SWC_INP_type_CM_boolean_flg 0 0 0.0 1.0 ECU_ADDRESS 0x0000 /* @ECU_Address@VINP_TPMSFAT_flg@ */ /end MEASUREMENT
/begin MEASUREMENT VINP_TPMSBattLow_flg "" UBYTE SWC_INP_type_CM_boolean_flg 0 0 0.0 1.0 ECU_ADDRESS 0x0000 /* @ECU_Address@VINP_TPMSBattLow_flg@ */ /end MEASUREMENT
/begin MEASUREMENT VINP_TPMSStorge_flg "" UBYTE SWC_INP_type_CM_boolean_flg 0 0 0.0 1.0 ECU_ADDRESS 0x0000 /* @ECU_Address@VINP_TPMSStorge_flg@ */ /end MEASUREMENT
/begin COMPU_METHOD SWC_INP_type_CM_single_C "Q = V" RAT_FUNC "%8.6" "C" COEFFS 0 1 0 0 0 1 /end COMPU_METHOD
/begin COMPU_METHOD SWC_INP_type_CM_single_mps2 "Q = V" RAT_FUNC "%8.6" "mps2" COEFFS 0 1 0 0 0 1 /end COMPU_METHOD
/begin COMPU_METHOD SWC_INP_type_CM_single_pct "Q = V" RAT_FUNC "%8.6" "pct" COEFFS 0 1 0 0 0 1 /end COMPU_METHOD
/begin COMPU_METHOD SWC_INP_type_CM_single_kph "Q = V" RAT_FUNC "%8.6" "kph" COEFFS 0 1 0 0 0 1 /end COMPU_METHOD
/begin COMPU_METHOD SWC_INP_type_CM_single_V "Q = V" RAT_FUNC "%8.6" "V" COEFFS 0 1 0 0 0 1 /end COMPU_METHOD
/begin COMPU_METHOD SWC_INP_type_CM_single_tc "Q = V" RAT_FUNC "%8.6" "tc" COEFFS 0 1 0 0 0 1 /end COMPU_METHOD
/begin COMPU_METHOD SWC_INP_type_CM_single_kPa "Q = V" RAT_FUNC "%8.6" "kPa" COEFFS 0 1 0 0 0 1 /end COMPU_METHOD
/begin COMPU_METHOD SWC_INP_type_CM_single_A "Q = V" RAT_FUNC "%8.6" "A" COEFFS 0 1 0 0 0 1 /end COMPU_METHOD
/begin COMPU_METHOD SWC_INP_type_CM_single_rpm "Q = V" RAT_FUNC "%8.6" "rpm" COEFFS 0 1 0 0 0 1 /end COMPU_METHOD
/begin COMPU_METHOD SWC_INP_type_CM_single_Nm "Q = V" RAT_FUNC "%8.6" "Nm" COEFFS 0 1 0 0 0 1 /end COMPU_METHOD
/begin COMPU_METHOD SWC_INP_type_CM_single_SA "Q = V" RAT_FUNC "%8.6" "SA" COEFFS 0 1 0 0 0 1 /end COMPU_METHOD
/begin COMPU_METHOD SWC_INP_type_CM_uint32_raw "Q = V" RAT_FUNC "%10.0" "raw" COEFFS 0 1 0 0 0 1 /end COMPU_METHOD
/begin COMPU_METHOD SWC_INP_type_CM_int16_raw16 "Q = V" RAT_FUNC "%5.0" "raw16" COEFFS 0 1 0 0 0 1 /end COMPU_METHOD
/begin COMPU_METHOD SWC_INP_type_CM_uint16_mV "Q = V" RAT_FUNC "%5.0" "mV" COEFFS 0 1 0 0 0 1 /end COMPU_METHOD
/begin COMPU_METHOD SWC_INP_type_CM_uint16_enum "Q = V" RAT_FUNC "%5.0" "enum" COEFFS 0 1 0 0 0 1 /end COMPU_METHOD
/begin COMPU_METHOD SWC_INP_type_CM_uint16_V "Q = V" RAT_FUNC "%5.0" "V" COEFFS 0 1 0 0 0 1 /end COMPU_METHOD
/begin COMPU_METHOD SWC_INP_type_CM_boolean_flg "Q = V" RAT_FUNC "%1.0" "flg" COEFFS 0 1 0 0 0 1 /end COMPU_METHOD
/begin COMPU_METHOD SWC_INP_type_CM_int8_dB "Q = V" RAT_FUNC "%3.0" "dB" COEFFS 0 1 0 0 0 1 /end COMPU_METHOD
/begin COMPU_METHOD SWC_INP_type_CM_uint8_enum "Q = V" RAT_FUNC "%3.0" "enum" COEFFS 0 1 0 0 0 1 /end COMPU_METHOD
/begin COMPU_METHOD SWC_INP_type_CM_uint8_cnt "Q = V" RAT_FUNC "%3.0" "cnt" COEFFS 0 1 0 0 0 1 /end COMPU_METHOD
/begin COMPU_METHOD SWC_INP_type_CM_uint8_flg "Q = V" RAT_FUNC "%3.0" "flg" COEFFS 0 1 0 0 0 1 /end COMPU_METHOD
/begin COMPU_METHOD SWC_INP_type_CM_uint8_crc "Q = V" RAT_FUNC "%3.0" "crc" COEFFS 0 1 0 0 0 1 /end COMPU_METHOD
/begin COMPU_METHOD SWC_INP_type_CM_uint8_raw "Q = V" RAT_FUNC "%3.0" "raw" COEFFS 0 1 0 0 0 1 /end COMPU_METHOD
/begin COMPU_METHOD SWC_INP_type_CM_uint8_OTA_enum "Q = V" RAT_FUNC "%3.0" "OTA_enum" COEFFS 0 1 0 0 0 1 /end COMPU_METHOD
/begin GROUP S6_CreateBus "SWC_INP_type/run_SWC_INP_5ms_sys/INP/CAN1/CreateBus"
 /begin REF_MEASUREMENT VINP_ABSFullyOper_enum VINP_ABSOffroadSw_enum VINP_ACAmbTemp_C VINP_ACFanSpdSta_enum VINP_ACTempSetSta_C VINP_ASC1KneelingInfo_enum VINP_ASRBrakeCtrlAtc_enum VINP_ASREngCtrlAtc_enum VINP_ASRHillHolderSw_enum VINP_ASROffroadSw_enum VINP_ATCASRInfoSig_enum VINP_AcltrInterlockSw_enum VINP_AntiLBrakABSAct_enum VINP_BrakePedalPos_pct VINP_BrkTempeWarn_enum VINP_DrivDirF_enum VINP_EBSAmWarnLampSta_enum VINP_EBSBrakeSw_enum VINP_EBSRedWarnLampSta_enum VINP_ECASAWarmLampSta_enum VINP_EM1CS_enum VINP_EM1Cnt_enum VINP_EM1OvrCtrlMBrk_enum VINP_EM1OvrCtrlMDriv_enum VINP_EM1OvrCtrlMPriBrk_enum VINP_EM1ReqTorqHRlsBrk_pct VINP_EM1ReqTorqHRlsDri_pct VINP_EM1ReqTorqLimBrk_pct VINP_EM1ReqTorqLimDriv_pct VINP_EngAuxShutdownSw_enum VINP_EngDerateSw_enum VINP_EngRetSel_pct VINP_FASpeed_kph VINP_FndBrkUse_enum VINP_HaltBrakeSw_enum VINP_HaltBrkMode_enum VINP_HillHolderMode_enum VINP_ParkBrkActuFAct_enum VINP_RelaSpdFALWheel_kph VINP_RelaSpdFARWheel_kph VINP_RmAccelEnSw_enum VINP_SACtrlBrakeCtrl_SA VINP_TM2BFaultCode_enum VINP_TractCtrlOvrSw_enum VINP_TrailerABSSta_enum VINP_TrailerABSWarnSig_enum VINP_TransReqGear_enum VINP_WhlSpeedFL_kph VINP_XBRAcltnLimit_mps2 VINP_XBRActtrlMode_enum VINP_XBRSysSta_enum /end REF_MEASUREMENT
/end GROUP
/begin GROUP S6_SignalCheck "SWC_INP_type/run_SWC_INP_5ms_sys/INP/CAN1/SignalCheck"
 /begin SUB_GROUP S76_AC_BTMS_C1000_0 S76_AC_BTMS_C1000_1 S76_AC_BTMS_C1000_4 S76_AC_BTMS_C5000_0 S76_ASC1_A S76_EBC1 S76_EBC2 S76_EBC5 S76_ECAS_DM1 S76_EMC1_EM1 S76_HRW S76_TC1 /end SUB_GROUP
/end GROUP
/begin GROUP S7_CommunicationCheck "SWC_INP_type/run_SWC_INP_5ms_sys/INP/CAN2/CommunicationCheck" /begin SUB_GROUP S392_CANMsgInvalidIVIC1000 /end SUB_GROUP /begin REF_MEASUREMENT VINP_CANMsgValidIVIC1000_flg /end REF_MEASUREMENT /end GROUP
/begin GROUP S7_CreateBus "SWC_INP_type/run_SWC_INP_5ms_sys/INP/CAN2/CreateBus" /begin REF_MEASUREMENT VINP_IVIACFanSpdReqCmd_enum /end REF_MEASUREMENT /end GROUP
/begin GROUP S7_SignalCheck "SWC_INP_type/run_SWC_INP_5ms_sys/INP/CAN2/SignalCheck" /begin SUB_GROUP S394_IVI_C100_0 /end SUB_GROUP /end GROUP
/begin GROUP S8_CommunicationCheck "SWC_INP_type/run_SWC_INP_5ms_sys/INP/CAN3/CommunicationCheck"
 /begin SUB_GROUP S405_CANMsgInvalidB2TMInfo S405_CANMsgInvalidB2VBattInfo1 S405_CANMsgInvalidB2VCurrentLimit S405_CANMsgInvalidB2VFult132960 S405_CANMsgInvalidB2VST1 S405_CANMsgInvalidB2VST2 S405_CANMsgInvalidB2VST4 S405_CANMsgInvalidB2VST5 S405_CANMsgInvalidEWP1 S405_CANMsgInvalidTMMCUSta1 S405_CANMsgInvalidTMMCUSta2 S405_CANMsgInvalidTMMCUSta3 /end SUB_GROUP
 /begin REF_MEASUREMENT VINP_CANMsgValidB2TMInfo_flg VINP_CANMsgValidB2VBattInfo1_flg VINP_CANMsgValidB2VCurrentLimit_flg VINP_CANMsgValidB2VFult132960_flg VINP_CANMsgValidB2VST1_flg VINP_CANMsgValidB2VST2_flg VINP_CANMsgValidB2VST4_flg VINP_CANMsgValidB2VST5_flg VINP_CANMsgValidEWP1_flg VINP_CANMsgValidTMMCUSta1_flg VINP_CANMsgValidTMMCUSta2_flg VINP_CANMsgValidTMMCUSta3_flg /end REF_MEASUREMENT
/end GROUP
/begin GROUP S8_CreateBus "SWC_INP_type/run_SWC_INP_5ms_sys/INP/CAN3/CreateBus"
 /begin REF_MEASUREMENT VINP_AtvDisChgEnFbk_flg VINP_B2THVRlySta_enum VINP_B2VACChgConnSta_flg VINP_B2VACChgNegRlySta_enum VINP_B2VACChgPosRlySta_enum VINP_B2VAPlsDischgCurr_A VINP_B2VAvaPlsChgCurr_A VINP_B2VBI1BattType_enum VINP_B2VBMUHVSta_enum VINP_B2VCellMinVol_V VINP_B2VChgMode_enum VINP_B2VChgSta_enum VINP_B2VDCChgConnSta_enum VINP_B2VDCChgN1RlySta_enum VINP_B2VDCChgP1RlySta_enum VINP_B2VFaultCode_enum VINP_B2VFaultLv_enum VINP_B2VHVILFault_flg VINP_B2VMainNegRlySta_enum VINP_B2VMinTempPos_enum VINP_B2VPackCurr_A VINP_B2VPackInsideVol_V VINP_B2VRqHVPwrOff_enum VINP_B2VSOC_pct VINP_EWPPEFault_enum VINP_MCUCtrlMdSta_enum VINP_MCUDCCur_A VINP_MCUDCVol_V VINP_MCUFailCode_enum VINP_MCUFailGrade_enum VINP_MCUIGBTEnFbk_flg VINP_MCUTemp_C VINP_MCUTrqLimHi_Nm VINP_MCUTrqLimLo_Nm VINP_MotorSpd_rpm VINP_MotorTemp_C VINP_MotorTrq_Nm /end REF_MEASUREMENT
/end GROUP
/begin GROUP S8_SignalCheck "SWC_INP_type/run_SWC_INP_5ms_sys/INP/CAN3/SignalCheck"
 /begin SUB_GROUP S407_B2TM_Info S407_B2V_BattInfo1 S407_B2V_CurrentLimit S407_B2V_Fult1_32960 S407_B2V_ST1 S407_B2V_ST2 S407_B2V_ST4 S407_B2V_ST5 S407_EWP1 S407_TM_MCUSta1 S407_TM_MCUSta2 S407_TM_MCUSta3 /end SUB_GROUP
/end GROUP
/begin GROUP S9_CommunicationCheck "SWC_INP_type/run_SWC_INP_5ms_sys/INP/CAN4/CommunicationCheck"
 /begin SUB_GROUP S653_CANMsgInvalidZFRC1000 S653_CANMsgInvalidZFRCE1000 S653_CANMsgInvalidZRRCE1000 S653_CANMsgInvalidZRRCE1001 S653_CANMsgInvalidzGWCANRr1C500 /end SUB_GROUP
 /begin REF_MEASUREMENT VINP_CANMsgValidZFRC1000_flg VINP_CANMsgValidZFRCE1000_flg VINP_CANMsgValidZRRCE1000_flg VINP_CANMsgValidZRRCE1001_flg VINP_CANMsgValidzGWCANRr1C500_flg /end REF_MEASUREMENT
/end GROUP
/begin GROUP S9_CreateBus "SWC_INP_type/run_SWC_INP_5ms_sys/INP/CAN4/CreateBus"
 /begin REF_MEASUREMENT VINP_AirPressureFC2_kPa VINP_AirPressurePC3_kPa VINP_AirPressureRC1_kPa VINP_DCDCEnSta_enum VINP_DCDCErrLvSta_enum VINP_DCDCOutVolSta_V VINP_DCDCTempSta_C VINP_EACEnSta_enum VINP_EACErrLvSta_enum VINP_EACInvTempSta_C VINP_EHPSEnSta_enum VINP_EHPSErrLvSta_enum VINP_EHPSInvTempSta_C VINP_EHPSMotorSpdSta_rpm VINP_FDCCHASSISVCUEACPressSta_flg VINP_PDUACRlySta_enum VINP_PDUDCDCEACEHPSHVLoopSta_enum VINP_PDUDCDCEACEHPSPreRlySta_enum VINP_PDUDCDCEACEHPSRlySta_enum VINP_PDUHVILSta_enum VINP_PDUMCUHVLoopSta_enum VINP_PDUMCUPosRlySta_enum VINP_PDUMCUPreRlySta_enum VINP_PDUSelfChkSta_enum VINP_ParkBrakeSW_enum VINP_ZFRBCMAutoLightSWSta_flg VINP_ZFRBCMBrakeSta_flg VINP_ZFRBCMHBeamSWSta_flg VINP_ZFRBCMHeadLpSWSta_flg VINP_ZFRBCMLFTurnLpCSta_A VINP_ZFRBCMLightSensorVSta_V VINP_ZFRBCMPLampSta_flg VINP_ZFRBCMRFTurnLpCSta_A VINP_ZFRBCMRFogLpSWSta_flg VINP_ZFRBCMSeatbeltSta_flg VINP_ZFRBCMWasherSWSta_flg VINP_ZFRBCMWiperASSta_flg VINP_ZFRBCMWiperHSWSta_flg VINP_ZFRBCMWiperLSWSta_flg VINP_ZRRBCMAllDoorSta_enum VINP_ZRRBCMCallingSWSta_flg VINP_ZRRBCMLRTurnLpCSta_A VINP_ZRRBCMPLampSta_flg VINP_ZRRBCMRRTurnLpCSta_A VINP_ZRRBCMSTOPSW2Sta_flg VINP_ZRRBCMSTOPSWSta_flg /end REF_MEASUREMENT
/end GROUP
/begin GROUP S9_SignalCheck "SWC_INP_type/run_SWC_INP_5ms_sys/INP/CAN4/SignalCheck"
 /begin SUB_GROUP S655_ZFR_C100_0 S655_ZFR_CE100_0 S655_ZRR_CE100_0 S655_ZRR_CE100_1 S655_zGW_CANRr1_C50_0 /end SUB_GROUP
/end GROUP
/begin GROUP S10_Subsystem13 "SWC_INP_type/run_SWC_INP_5ms_sys/INP/DDM/Subsystem13" /begin REF_CHARACTERISTIC KINP_ClearDTCcmd_flg_ovrdflg KINP_ClearDTCcmd_flg_ovrdval /end REF_CHARACTERISTIC /begin REF_MEASUREMENT VINP_ClearDTCcmd_flg /end REF_MEASUREMENT /end GROUP
/begin GROUP S11_Subsystem1 "SWC_INP_type/run_SWC_INP_5ms_sys/INP/DKC/Subsystem1" /begin REF_CHARACTERISTIC KINP_NFCLidASta_flg_ovrdflg KINP_NFCLidASta_flg_ovrdval /end REF_CHARACTERISTIC /begin REF_MEASUREMENT VINP_NFCLidASta_flg /end REF_MEASUREMENT /end GROUP
/begin GROUP S11_Subsystem10 "SWC_INP_type/run_SWC_INP_5ms_sys/INP/DKC/Subsystem10" /begin REF_CHARACTERISTIC KINP_NFCDoorSta_flg_ovrdflg KINP_NFCDoorSta_flg_ovrdval /end REF_CHARACTERISTIC /begin REF_MEASUREMENT VINP_NFCDoorSta_flg /end REF_MEASUREMENT /end GROUP
/begin GROUP S11_Subsystem2 "SWC_INP_type/run_SWC_INP_5ms_sys/INP/DKC/Subsystem2"
 /begin REF_CHARACTERISTIC KINP_KeyFobAreaU16_enum_ovrdflg KINP_KeyFobAreaU16_enum_ovrdval /end REF_CHARACTERISTIC
 /begin REF_MEASUREMENT VINP_KeyFobAreaU16_enum /end REF_MEASUREMENT
/end GROUP
/begin GROUP S11_Subsystem3 "SWC_INP_type/run_SWC_INP_5ms_sys/INP/DKC/Subsystem3"
 /begin REF_CHARACTERISTIC KINP_UIDButtonCmd_enum_ovrdflg KINP_UIDButtonCmd_enum_ovrdval /end REF_CHARACTERISTIC
 /begin REF_MEASUREMENT VINP_UIDButtonCmd_enum /end REF_MEASUREMENT
/end GROUP
/begin GROUP S11_Subsystem4 "SWC_INP_type/run_SWC_INP_5ms_sys/INP/DKC/Subsystem4"
 /begin REF_CHARACTERISTIC KINP_BTConnectSta_enum_ovrdflg KINP_BTConnectSta_enum_ovrdval /end REF_CHARACTERISTIC
 /begin REF_MEASUREMENT VINP_BTConnectSta_enum /end REF_MEASUREMENT
/end GROUP
/begin GROUP S11_Subsystem5 "SWC_INP_type/run_SWC_INP_5ms_sys/INP/DKC/Subsystem5"
 /begin REF_CHARACTERISTIC KINP_UIDBatVoltx1000_V_ovrdflg KINP_UIDBatVoltx1000_V_ovrdval /end REF_CHARACTERISTIC
 /begin REF_MEASUREMENT VINP_UIDBatVoltx1000_V /end REF_MEASUREMENT
/end GROUP
/begin GROUP S11_Subsystem6 "SWC_INP_type/run_SWC_INP_5ms_sys/INP/DKC/Subsystem6" /begin REF_CHARACTERISTIC KINP_DKCBTRSSI_dB_ovrdflg KINP_DKCBTRSSI_dB_ovrdval /end REF_CHARACTERISTIC /begin REF_MEASUREMENT VINP_DKCBTRSSI_dB /end REF_MEASUREMENT /end GROUP
/begin GROUP S12_Analog "SWC_INP_type/run_SWC_INP_5ms_sys/INP/GPIO/Analog" /begin SUB_GROUP S919_AccelPedal1Vol_V S919_AccelPedal2Vol_V /end SUB_GROUP /end GROUP
/begin GROUP S12_Digital "SWC_INP_type/run_SWC_INP_5ms_sys/INP/GPIO/Digital"
 /begin SUB_GROUP S920_AlcoholPass S920_BmsAplus S920_BrakeLampSW S920_BrakeSWGPIO S920_CrashSignalGPIO S920_EmergencyExitSW S920_FrontDoorSW S920_HazardSW S920_LeftTurnSW S920_MidDoorSW S920_OSDoorSwClose S920_OSDoorSwOpen S920_PushButton S920_RightTurnSW S920_SeatSW S920_TailgateSW S920_TrunkHanSW /end SUB_GROUP
/end GROUP
/begin GROUP S13_Subsystem1 "SWC_INP_type/run_SWC_INP_5ms_sys/INP/IMU/Subsystem1"
 /begin REF_CHARACTERISTIC KINP_MemOffsetGyroY_raw16_ovrdflg KINP_MemOffsetGyroY_raw16_ovrdval /end REF_CHARACTERISTIC
 /begin REF_MEASUREMENT VINP_MemOffsetGyroY_raw16 /end REF_MEASUREMENT
/end GROUP
/begin GROUP S13_Subsystem10 "SWC_INP_type/run_SWC_INP_5ms_sys/INP/IMU/Subsystem10"
 /begin REF_CHARACTERISTIC KINP_SensingAccZ_raw16_ovrdflg KINP_SensingAccZ_raw16_ovrdval /end REF_CHARACTERISTIC
 /begin REF_MEASUREMENT VINP_SensingAccZ_raw16 /end REF_MEASUREMENT
/end GROUP
/begin GROUP S13_Subsystem11 "SWC_INP_type/run_SWC_INP_5ms_sys/INP/IMU/Subsystem11"
 /begin REF_CHARACTERISTIC KINP_SensingAccY_raw16_ovrdflg KINP_SensingAccY_raw16_ovrdval /end REF_CHARACTERISTIC
 /begin REF_MEASUREMENT VINP_SensingAccY_raw16 /end REF_MEASUREMENT
/end GROUP
/begin GROUP S13_Subsystem15 "SWC_INP_type/run_SWC_INP_5ms_sys/INP/IMU/Subsystem15"
 /begin REF_CHARACTERISTIC KINP_MemOffsetGyroX_raw16_ovrdflg KINP_MemOffsetGyroX_raw16_ovrdval /end REF_CHARACTERISTIC
 /begin REF_MEASUREMENT VINP_MemOffsetGyroX_raw16 /end REF_MEASUREMENT
/end GROUP
/begin GROUP S13_Subsystem2 "SWC_INP_type/run_SWC_INP_5ms_sys/INP/IMU/Subsystem2"
 /begin REF_CHARACTERISTIC KINP_MemOffsetAccX_raw16_ovrdflg KINP_MemOffsetAccX_raw16_ovrdval /end REF_CHARACTERISTIC
 /begin REF_MEASUREMENT VINP_MemOffsetAccX_raw16 /end REF_MEASUREMENT
/end GROUP
/begin GROUP S13_Subsystem3 "SWC_INP_type/run_SWC_INP_5ms_sys/INP/IMU/Subsystem3"
 /begin REF_CHARACTERISTIC KINP_MemOffsetGyroZ_raw16_ovrdflg KINP_MemOffsetGyroZ_raw16_ovrdval /end REF_CHARACTERISTIC
 /begin REF_MEASUREMENT VINP_MemOffsetGyroZ_raw16 /end REF_MEASUREMENT
/end GROUP
/begin GROUP S13_Subsystem4 "SWC_INP_type/run_SWC_INP_5ms_sys/INP/IMU/Subsystem4"
 /begin REF_CHARACTERISTIC KINP_MemOffsetAccZ_raw16_ovrdflg KINP_MemOffsetAccZ_raw16_ovrdval /end REF_CHARACTERISTIC
 /begin REF_MEASUREMENT VINP_MemOffsetAccZ_raw16 /end REF_MEASUREMENT
/end GROUP
/begin GROUP S13_Subsystem5 "SWC_INP_type/run_SWC_INP_5ms_sys/INP/IMU/Subsystem5"
 /begin REF_CHARACTERISTIC KINP_MemOffsetAccY_raw16_ovrdflg KINP_MemOffsetAccY_raw16_ovrdval /end REF_CHARACTERISTIC
 /begin REF_MEASUREMENT VINP_MemOffsetAccY_raw16 /end REF_MEASUREMENT
/end GROUP
/begin GROUP S13_Subsystem6 "SWC_INP_type/run_SWC_INP_5ms_sys/INP/IMU/Subsystem6"
 /begin REF_CHARACTERISTIC KINP_SensingGyroY_raw16_ovrdflg KINP_SensingGyroY_raw16_ovrdval /end REF_CHARACTERISTIC
 /begin REF_MEASUREMENT VINP_SensingGyroY_raw16 /end REF_MEASUREMENT
/end GROUP
/begin GROUP S13_Subsystem7 "SWC_INP_type/run_SWC_INP_5ms_sys/INP/IMU/Subsystem7"
 /begin REF_CHARACTERISTIC KINP_SensingGyroX_raw16_ovrdflg KINP_SensingGyroX_raw16_ovrdval /end REF_CHARACTERISTIC
 /begin REF_MEASUREMENT VINP_SensingGyroX_raw16 /end REF_MEASUREMENT
/end GROUP
/begin GROUP S13_Subsystem8 "SWC_INP_type/run_SWC_INP_5ms_sys/INP/IMU/Subsystem8"
 /begin REF_CHARACTERISTIC KINP_SensingAccX_raw16_ovrdflg KINP_SensingAccX_raw16_ovrdval /end REF_CHARACTERISTIC
 /begin REF_MEASUREMENT VINP_SensingAccX_raw16 /end REF_MEASUREMENT
/end GROUP
/begin GROUP S13_Subsystem9 "SWC_INP_type/run_SWC_INP_5ms_sys/INP/IMU/Subsystem9"
 /begin REF_CHARACTERISTIC KINP_SensingGyroZ_raw16_ovrdflg KINP_SensingGyroZ_raw16_ovrdval /end REF_CHARACTERISTIC
 /begin REF_MEASUREMENT VINP_SensingGyroZ_raw16 /end REF_MEASUREMENT
/end GROUP
/begin GROUP S14_Subsystem "SWC_INP_type/run_SWC_INP_5ms_sys/INP/SYS/Subsystem" /begin REF_CHARACTERISTIC KINP_AuxBattVolmV_mV_ovrdflg KINP_AuxBattVolmV_mV_ovrdval /end REF_CHARACTERISTIC /begin REF_MEASUREMENT VINP_AuxBattVolmV_mV /end REF_MEASUREMENT /end GROUP
/begin GROUP S14_Subsystem1 "SWC_INP_type/run_SWC_INP_5ms_sys/INP/SYS/Subsystem1"
 /begin REF_CHARACTERISTIC KINP_NetworkReqCalled_flg_ovrdflg KINP_NetworkReqCalled_flg_ovrdval /end REF_CHARACTERISTIC
 /begin REF_MEASUREMENT VINP_NetworkReqCalled_flg /end REF_MEASUREMENT
/end GROUP
/begin GROUP S14_Subsystem10 "SWC_INP_type/run_SWC_INP_5ms_sys/INP/SYS/Subsystem10" /begin REF_CHARACTERISTIC KINP_CAN3BusOff_flg_ovrdflg KINP_CAN3BusOff_flg_ovrdval /end REF_CHARACTERISTIC /begin REF_MEASUREMENT VINP_CAN3BusOff_flg /end REF_MEASUREMENT /end GROUP
/begin GROUP S14_Subsystem11 "SWC_INP_type/run_SWC_INP_5ms_sys/INP/SYS/Subsystem11" /begin REF_CHARACTERISTIC KINP_CAN6BusOff_flg_ovrdflg KINP_CAN6BusOff_flg_ovrdval /end REF_CHARACTERISTIC /begin REF_MEASUREMENT VINP_CAN6BusOff_flg /end REF_MEASUREMENT /end GROUP
/begin GROUP S14_Subsystem12 "SWC_INP_type/run_SWC_INP_5ms_sys/INP/SYS/Subsystem12" /begin REF_CHARACTERISTIC KINP_CAN4BusOff_flg_ovrdflg KINP_CAN4BusOff_flg_ovrdval /end REF_CHARACTERISTIC /begin REF_MEASUREMENT VINP_CAN4BusOff_flg /end REF_MEASUREMENT /end GROUP
/begin GROUP S14_Subsystem13 "SWC_INP_type/run_SWC_INP_5ms_sys/INP/SYS/Subsystem13" /begin REF_CHARACTERISTIC KINP_CAN5BusOff_flg_ovrdflg KINP_CAN5BusOff_flg_ovrdval /end REF_CHARACTERISTIC /begin REF_MEASUREMENT VINP_CAN5BusOff_flg /end REF_MEASUREMENT /end GROUP
/begin GROUP S14_Subsystem2 "SWC_INP_type/run_SWC_INP_5ms_sys/INP/SYS/Subsystem2" /begin REF_CHARACTERISTIC KINP_Pedal1Ref5V_V_ovrdflg KINP_Pedal1Ref5V_V_ovrdval /end REF_CHARACTERISTIC /begin REF_MEASUREMENT VINP_Pedal1Ref5V_V /end REF_MEASUREMENT /end GROUP
/begin GROUP S14_Subsystem3 "SWC_INP_type/run_SWC_INP_5ms_sys/INP/SYS/Subsystem3" /begin REF_CHARACTERISTIC KINP_Pedal2Ref5V_V_ovrdflg KINP_Pedal2Ref5V_V_ovrdval /end REF_CHARACTERISTIC /begin REF_MEASUREMENT VINP_Pedal2Ref5V_V /end REF_MEASUREMENT /end GROUP
/begin GROUP S14_Subsystem4 "SWC_INP_type/run_SWC_INP_5ms_sys/INP/SYS/Subsystem4" /begin REF_CHARACTERISTIC KINP_PwrReq_OTA_enum_ovrdflg KINP_PwrReq_OTA_enum_ovrdval /end REF_CHARACTERISTIC /begin REF_MEASUREMENT VINP_PwrReq_OTA_enum /end REF_MEASUREMENT /end GROUP
/begin GROUP S14_Subsystem5 "SWC_INP_type/run_SWC_INP_5ms_sys/INP/SYS/Subsystem5"
 /begin REF_CHARACTERISTIC KINP_AllowMovThd_OTA_enum_ovrdflg KINP_AllowMovThd_OTA_enum_ovrdval /end REF_CHARACTERISTIC
 /begin REF_MEASUREMENT VINP_AllowMovThd_OTA_enum /end REF_MEASUREMENT
/end GROUP
/begin GROUP S14_Subsystem6 "SWC_INP_type/run_SWC_INP_5ms_sys/INP/SYS/Subsystem6"
 /begin REF_CHARACTERISTIC KINP_EvccAplusPwrUpReq_flg_ovrdflg KINP_EvccAplusPwrUpReq_flg_ovrdval /end REF_CHARACTERISTIC
 /begin REF_MEASUREMENT VINP_EvccAplusPwrUpReq_flg /end REF_MEASUREMENT
/end GROUP
/begin GROUP S14_Subsystem7 "SWC_INP_type/run_SWC_INP_5ms_sys/INP/SYS/Subsystem7"
 /begin REF_CHARACTERISTIC KINP_AcoreReadyToSlp_flg_ovrdflg KINP_AcoreReadyToSlp_flg_ovrdval /end REF_CHARACTERISTIC
 /begin REF_MEASUREMENT VINP_AcoreReadyToSlp_flg /end REF_MEASUREMENT
/end GROUP
/begin GROUP S14_Subsystem8 "SWC_INP_type/run_SWC_INP_5ms_sys/INP/SYS/Subsystem8" /begin REF_CHARACTERISTIC KINP_CAN1BusOff_flg_ovrdflg KINP_CAN1BusOff_flg_ovrdval /end REF_CHARACTERISTIC /begin REF_MEASUREMENT VINP_CAN1BusOff_flg /end REF_MEASUREMENT /end GROUP
/begin GROUP S14_Subsystem9 "SWC_INP_type/run_SWC_INP_5ms_sys/INP/SYS/Subsystem9" /begin REF_CHARACTERISTIC KINP_CAN2BusOff_flg_ovrdflg KINP_CAN2BusOff_flg_ovrdval /end REF_CHARACTERISTIC /begin REF_MEASUREMENT VINP_CAN2BusOff_flg /end REF_MEASUREMENT /end GROUP
/begin GROUP S15_Subsystem "SWC_INP_type/run_SWC_INP_5ms_sys/INP/TPMS/Subsystem" /begin REF_CHARACTERISTIC KINP_TPMSDataIn_flg_ovrdflg KINP_TPMSDataIn_flg_ovrdval /end REF_CHARACTERISTIC /begin REF_MEASUREMENT VINP_TPMSDataIn_flg /end REF_MEASUREMENT /end GROUP
/begin GROUP S15_Subsystem1 "SWC_INP_type/run_SWC_INP_5ms_sys/INP/TPMS/Subsystem1" /begin REF_CHARACTERISTIC KINP_TPMSID_raw_ovrdflg KINP_TPMSID_raw_ovrdval /end REF_CHARACTERISTIC /begin REF_MEASUREMENT VINP_TPMSID_raw /end REF_MEASUREMENT /end GROUP
/begin GROUP S15_Subsystem10 "SWC_INP_type/run_SWC_INP_5ms_sys/INP/TPMS/Subsystem10" /begin REF_CHARACTERISTIC KINP_TPMSStorge_flg_ovrdval KINP_TPMSStorge_flg_ovrflg /end REF_CHARACTERISTIC /begin REF_MEASUREMENT VINP_TPMSStorge_flg /end REF_MEASUREMENT /end GROUP
/begin GROUP S15_Subsystem11 "SWC_INP_type/run_SWC_INP_5ms_sys/INP/TPMS/Subsystem11" /begin REF_CHARACTERISTIC KINP_LFID_raw_ovrdval KINP_LFID_raw_ovrflg /end REF_CHARACTERISTIC /begin REF_MEASUREMENT VINP_LFID_raw /end REF_MEASUREMENT /end GROUP
/begin GROUP S15_Subsystem12 "SWC_INP_type/run_SWC_INP_5ms_sys/INP/TPMS/Subsystem12" /begin REF_CHARACTERISTIC KINP_RFID_raw_ovrdval /end REF_CHARACTERISTIC /begin REF_MEASUREMENT VINP_RFID_raw /end REF_MEASUREMENT /end GROUP
/begin GROUP S15_Subsystem13 "SWC_INP_type/run_SWC_INP_5ms_sys/INP/TPMS/Subsystem13" /begin REF_CHARACTERISTIC KINP_LRID_raw_ovrdval /end REF_CHARACTERISTIC /begin REF_MEASUREMENT VINP_LRID_raw /end REF_MEASUREMENT /end GROUP
/begin GROUP S15_Subsystem14 "SWC_INP_type/run_SWC_INP_5ms_sys/INP/TPMS/Subsystem14" /begin REF_CHARACTERISTIC KINP_RRID_raw_ovrdval /end REF_CHARACTERISTIC /begin REF_MEASUREMENT VINP_RRID_raw /end REF_MEASUREMENT /end GROUP
/begin GROUP S15_Subsystem2 "SWC_INP_type/run_SWC_INP_5ms_sys/INP/TPMS/Subsystem2"
 /begin REF_CHARACTERISTIC KINP_TPMSPressure_raw_ovrdflg KINP_TPMSPressure_raw_ovrdval /end REF_CHARACTERISTIC
 /begin REF_MEASUREMENT VINP_TPMSPressure_raw /end REF_MEASUREMENT
/end GROUP
/begin GROUP S15_Subsystem3 "SWC_INP_type/run_SWC_INP_5ms_sys/INP/TPMS/Subsystem3" /begin REF_CHARACTERISTIC KINP_TPMSTemp_raw_ovrdflg KINP_TPMSTemp_raw_ovrdval /end REF_CHARACTERISTIC /begin REF_MEASUREMENT VINP_TPMSTemp_raw /end REF_MEASUREMENT /end GROUP
/begin GROUP S15_Subsystem4 "SWC_INP_type/run_SWC_INP_5ms_sys/INP/TPMS/Subsystem4" /begin REF_CHARACTERISTIC KINP_TPMSSta_enum_ovrdflg KINP_TPMSSta_enum_ovrdval /end REF_CHARACTERISTIC /begin REF_MEASUREMENT VINP_TPMSSta_enum /end REF_MEASUREMENT /end GROUP
/begin GROUP S15_Subsystem5 "SWC_INP_type/run_SWC_INP_5ms_sys/INP/TPMS/Subsystem5"
 /begin REF_CHARACTERISTIC KINP_TPMSPressureMi_raw_ovrdflg KINP_TPMSPressureMi_raw_ovrdval /end REF_CHARACTERISTIC
 /begin REF_MEASUREMENT VINP_TPMSPressureMi_raw /end REF_MEASUREMENT
/end GROUP
/begin GROUP S15_Subsystem6 "SWC_INP_type/run_SWC_INP_5ms_sys/INP/TPMS/Subsystem6" /begin REF_CHARACTERISTIC KINP_TPMSCRC_crc_ovrdflg KINP_TPMSCRC_crc_ovrdval /end REF_CHARACTERISTIC /begin REF_MEASUREMENT VINP_TPMSCRC_crc /end REF_MEASUREMENT /end GROUP
/begin GROUP S15_Subsystem7 "SWC_INP_type/run_SWC_INP_5ms_sys/INP/TPMS/Subsystem7" /begin REF_CHARACTERISTIC KINP_TPMSCRCCalc_crc_ovrdflg KINP_TPMSCRCCalc_crc_ovrdval /end REF_CHARACTERISTIC /begin REF_MEASUREMENT VINP_TPMSCRCCalc_crc /end REF_MEASUREMENT /end GROUP
/begin GROUP S15_Subsystem8 "SWC_INP_type/run_SWC_INP_5ms_sys/INP/TPMS/Subsystem8" /begin REF_CHARACTERISTIC KINP_TPMSFAT_flg_ovrdval KINP_TPMSFAT_flg_ovrflg /end REF_CHARACTERISTIC /begin REF_MEASUREMENT VINP_TPMSFAT_flg /end REF_MEASUREMENT /end GROUP
/begin GROUP S15_Subsystem9 "SWC_INP_type/run_SWC_INP_5ms_sys/INP/TPMS/Subsystem9" /begin REF_CHARACTERISTIC KINP_TPMSBattLow_flg_ovrdval KINP_TPMSBattLow_flg_ovrflg /end REF_CHARACTERISTIC /begin REF_MEASUREMENT VINP_TPMSBattLow_flg /end REF_MEASUREMENT /end GROUP
/begin GROUP S74_CANMsgInvalidACBTMSC10000 "SWC_INP_type/run_SWC_INP_5ms_sys/INP/CAN1/CommunicationCheck/CANMsgInvalidACBTMSC10000"
 /begin REF_CHARACTERISTIC KINP_CANMsgInvalidACBTMSC10000_flg_ovrdflg KINP_CANMsgInvalidACBTMSC10000_flg_ovrdval /end REF_CHARACTERISTIC
/end GROUP
/begin GROUP S74_CANMsgInvalidACBTMSC10001 "SWC_INP_type/run_SWC_INP_5ms_sys/INP/CAN1/CommunicationCheck/CANMsgInvalidACBTMSC10001"
 /begin REF_CHARACTERISTIC KINP_CANMsgInvalidACBTMSC10001_flg_ovrdflg KINP_CANMsgInvalidACBTMSC10001_flg_ovrdval /end REF_CHARACTERISTIC
/end GROUP
/begin GROUP S74_CANMsgInvalidACBTMSC10004 "SWC_INP_type/run_SWC_INP_5ms_sys/INP/CAN1/CommunicationCheck/CANMsgInvalidACBTMSC10004"
 /begin REF_CHARACTERISTIC KINP_CANMsgInvalidACBTMSC10004_flg_ovrdflg KINP_CANMsgInvalidACBTMSC10004_flg_ovrdval /end REF_CHARACTERISTIC
/end GROUP
/begin GROUP S74_CANMsgInvalidACBTMSC50000 "SWC_INP_type/run_SWC_INP_5ms_sys/INP/CAN1/CommunicationCheck/CANMsgInvalidACBTMSC50000"
 /begin REF_CHARACTERISTIC KINP_CANMsgInvalidACBTMSC50000_flg_ovrdflg KINP_CANMsgInvalidACBTMSC50000_flg_ovrdval /end REF_CHARACTERISTIC
/end GROUP
/begin GROUP S74_CANMsgInvalidASC1A "SWC_INP_type/run_SWC_INP_5ms_sys/INP/CAN1/CommunicationCheck/CANMsgInvalidASC1A"
 /begin REF_CHARACTERISTIC KINP_CANMsgInvalidASC1A_flg_ovrdflg KINP_CANMsgInvalidASC1A_flg_ovrdval /end REF_CHARACTERISTIC
/end GROUP
/begin GROUP S74_CANMsgInvalidEBC1 "SWC_INP_type/run_SWC_INP_5ms_sys/INP/CAN1/CommunicationCheck/CANMsgInvalidEBC1"
 /begin REF_CHARACTERISTIC KINP_CANMsgInvalidEBC1_flg_ovrdflg KINP_CANMsgInvalidEBC1_flg_ovrdval /end REF_CHARACTERISTIC
/end GROUP
/begin GROUP S74_CANMsgInvalidEBC2 "SWC_INP_type/run_SWC_INP_5ms_sys/INP/CAN1/CommunicationCheck/CANMsgInvalidEBC2"
 /begin REF_CHARACTERISTIC KINP_CANMsgInvalidEBC2_flg_ovrdflg KINP_CANMsgInvalidEBC2_flg_ovrdval /end REF_CHARACTERISTIC
/end GROUP
/begin GROUP S74_CANMsgInvalidEBC5 "SWC_INP_type/run_SWC_INP_5ms_sys/INP/CAN1/CommunicationCheck/CANMsgInvalidEBC5"
 /begin REF_CHARACTERISTIC KINP_CANMsgInvalidEBC5_flg_ovrdflg KINP_CANMsgInvalidEBC5_flg_ovrdval /end REF_CHARACTERISTIC
/end GROUP
/begin GROUP S74_CANMsgInvalidECASDM1 "SWC_INP_type/run_SWC_INP_5ms_sys/INP/CAN1/CommunicationCheck/CANMsgInvalidECASDM1"
 /begin REF_CHARACTERISTIC KINP_CANMsgInvalidECASDM1_flg_ovrdflg KINP_CANMsgInvalidECASDM1_flg_ovrdval /end REF_CHARACTERISTIC
/end GROUP
/begin GROUP S74_CANMsgInvalidEMC1EM1 "SWC_INP_type/run_SWC_INP_5ms_sys/INP/CAN1/CommunicationCheck/CANMsgInvalidEMC1EM1"
 /begin REF_CHARACTERISTIC KINP_CANMsgInvalidEMC1EM1_flg_ovrdflg KINP_CANMsgInvalidEMC1EM1_flg_ovrdval /end REF_CHARACTERISTIC
/end GROUP
/begin GROUP S74_CANMsgInvalidHRW "SWC_INP_type/run_SWC_INP_5ms_sys/INP/CAN1/CommunicationCheck/CANMsgInvalidHRW"
 /begin REF_CHARACTERISTIC KINP_CANMsgInvalidHRW_flg_ovrdflg KINP_CANMsgInvalidHRW_flg_ovrdval /end REF_CHARACTERISTIC
/end GROUP
/begin GROUP S74_CANMsgInvalidTC1 "SWC_INP_type/run_SWC_INP_5ms_sys/INP/CAN1/CommunicationCheck/CANMsgInvalidTC1"
 /begin REF_CHARACTERISTIC KINP_CANMsgInvalidTC1_flg_ovrdflg KINP_CANMsgInvalidTC1_flg_ovrdval /end REF_CHARACTERISTIC
/end GROUP
/begin GROUP S76_AC_BTMS_C1000_0 "SWC_INP_type/run_SWC_INP_5ms_sys/INP/CAN1/SignalCheck/AC_BTMS_C1000_0" /begin SUB_GROUP S125_ACAmbTemp /end SUB_GROUP /end GROUP
/begin GROUP S76_AC_BTMS_C1000_1 "SWC_INP_type/run_SWC_INP_5ms_sys/INP/CAN1/SignalCheck/AC_BTMS_C1000_1" /begin SUB_GROUP S126_ACFanSpdSta /end SUB_GROUP /end GROUP
/begin GROUP S76_AC_BTMS_C1000_4 "SWC_INP_type/run_SWC_INP_5ms_sys/INP/CAN1/SignalCheck/AC_BTMS_C1000_4" /begin SUB_GROUP S127_TM2BFaultCode /end SUB_GROUP /end GROUP
/begin GROUP S76_AC_BTMS_C5000_0 "SWC_INP_type/run_SWC_INP_5ms_sys/INP/CAN1/SignalCheck/AC_BTMS_C5000_0" /begin SUB_GROUP S128_ACTempSetSta /end SUB_GROUP /end GROUP
/begin GROUP S76_ASC1_A "SWC_INP_type/run_SWC_INP_5ms_sys/INP/CAN1/SignalCheck/ASC1_A" /begin SUB_GROUP S129_ASC1KneelingInfo /end SUB_GROUP /end GROUP
/begin GROUP S76_EBC1 "SWC_INP_type/run_SWC_INP_5ms_sys/INP/CAN1/SignalCheck/EBC1"
 /begin SUB_GROUP S130_ABSFullyOper S130_ABSOffroadSw S130_ASRBrakeCtrlAtc S130_ASREngCtrlAtc S130_ASRHillHolderSw S130_ASROffroadSw S130_ATCASRInfoSig S130_AcltrInterlockSw S130_AntiLBrakABSAct S130_BrakePedalPos S130_EBSAmWarnLampSta S130_EBSBrakeSw S130_EBSRedWarnLampSta S130_EngAuxShutdownSw S130_EngDerateSw S130_EngRetSel S130_HaltBrakeSw S130_RmAccelEnSw S130_SACtrlBrakeCtrl S130_TractCtrlOvrSw S130_TrailerABSSta S130_TrailerABSWarnSig /end SUB_GROUP
/end GROUP
/begin GROUP S76_EBC2 "SWC_INP_type/run_SWC_INP_5ms_sys/INP/CAN1/SignalCheck/EBC2" /begin SUB_GROUP S131_FASpeed S131_RelaSpdFALWheel S131_RelaSpdFARWheel /end SUB_GROUP /end GROUP
/begin GROUP S76_EBC5 "SWC_INP_type/run_SWC_INP_5ms_sys/INP/CAN1/SignalCheck/EBC5"
 /begin SUB_GROUP S132_BrkTempeWarn S132_FndBrkUse S132_HaltBrkMode S132_HillHolderMode S132_ParkBrkActuFAct S132_XBRAcltnLimit S132_XBRActtrlMode S132_XBRSysSta /end SUB_GROUP
/end GROUP
/begin GROUP S76_ECAS_DM1 "SWC_INP_type/run_SWC_INP_5ms_sys/INP/CAN1/SignalCheck/ECAS_DM1" /begin SUB_GROUP S133_ECASAWarmLampSta /end SUB_GROUP /end GROUP
/begin GROUP S76_EMC1_EM1 "SWC_INP_type/run_SWC_INP_5ms_sys/INP/CAN1/SignalCheck/EMC1_EM1"
 /begin SUB_GROUP S134_EM1CS S134_EM1Cnt S134_EM1OvrCtrlMBrk S134_EM1OvrCtrlMDriv S134_EM1OvrCtrlMPriBrk S134_EM1ReqTorqHRlsBrk S134_EM1ReqTorqHRlsDri S134_EM1ReqTorqLimBrk S134_EM1ReqTorqLimDriv /end SUB_GROUP
/end GROUP
/begin GROUP S76_HRW "SWC_INP_type/run_SWC_INP_5ms_sys/INP/CAN1/SignalCheck/HRW" /begin SUB_GROUP S135_WhlSpeedFL /end SUB_GROUP /end GROUP
/begin GROUP S76_TC1 "SWC_INP_type/run_SWC_INP_5ms_sys/INP/CAN1/SignalCheck/TC1" /begin SUB_GROUP S136_DrivDirF S136_TransReqGear /end SUB_GROUP /end GROUP
/begin GROUP S392_CANMsgInvalidIVIC1000 "SWC_INP_type/run_SWC_INP_5ms_sys/INP/CAN2/CommunicationCheck/CANMsgInvalidIVIC1000"
 /begin REF_CHARACTERISTIC KINP_CANMsgInvalidIVIC1000_flg_ovrdflg KINP_CANMsgInvalidIVIC1000_flg_ovrdval /end REF_CHARACTERISTIC
/end GROUP
/begin GROUP S394_IVI_C100_0 "SWC_INP_type/run_SWC_INP_5ms_sys/INP/CAN2/SignalCheck/IVI_C100_0" /begin SUB_GROUP S399_IVIACFanSpdReqCmd /end SUB_GROUP /end GROUP
/begin GROUP S405_CANMsgInvalidB2TMInfo "SWC_INP_type/run_SWC_INP_5ms_sys/INP/CAN3/CommunicationCheck/CANMsgInvalidB2TMInfo"
 /begin REF_CHARACTERISTIC KINP_CANMsgInvalidB2TMInfo_flg_ovrdflg KINP_CANMsgInvalidB2TMInfo_flg_ovrdval /end REF_CHARACTERISTIC
/end GROUP
/begin GROUP S405_CANMsgInvalidB2VBattInfo1 "SWC_INP_type/run_SWC_INP_5ms_sys/INP/CAN3/CommunicationCheck/CANMsgInvalidB2VBattInfo1"
 /begin REF_CHARACTERISTIC KINP_CANMsgInvalidB2VBattInfo1_flg_ovrdflg KINP_CANMsgInvalidB2VBattInfo1_flg_ovrdval /end REF_CHARACTERISTIC
/end GROUP
/begin GROUP S405_CANMsgInvalidB2VCurrentLimit "SWC_INP_type/run_SWC_INP_5ms_sys/INP/CAN3/CommunicationCheck/CANMsgInvalidB2VCurrentLimit"
 /begin REF_CHARACTERISTIC KINP_CANMsgInvalidB2VCurrentLimit_flg_ovrdflg KINP_CANMsgInvalidB2VCurrentLimit_flg_ovrdval /end REF_CHARACTERISTIC
/end GROUP
/begin GROUP S405_CANMsgInvalidB2VFult132960 "SWC_INP_type/run_SWC_INP_5ms_sys/INP/CAN3/CommunicationCheck/CANMsgInvalidB2VFult132960"
 /begin REF_CHARACTERISTIC KINP_CANMsgInvalidB2VFult132960_flg_ovrdflg KINP_CANMsgInvalidB2VFult132960_flg_ovrdval /end REF_CHARACTERISTIC
/end GROUP
/begin GROUP S405_CANMsgInvalidB2VST1 "SWC_INP_type/run_SWC_INP_5ms_sys/INP/CAN3/CommunicationCheck/CANMsgInvalidB2VST1"
 /begin REF_CHARACTERISTIC KINP_CANMsgInvalidB2VST1_flg_ovrdflg KINP_CANMsgInvalidB2VST1_flg_ovrdval /end REF_CHARACTERISTIC
/end GROUP
/begin GROUP S405_CANMsgInvalidB2VST2 "SWC_INP_type/run_SWC_INP_5ms_sys/INP/CAN3/CommunicationCheck/CANMsgInvalidB2VST2"
 /begin REF_CHARACTERISTIC KINP_CANMsgInvalidB2VST2_flg_ovrdflg KINP_CANMsgInvalidB2VST2_flg_ovrdval /end REF_CHARACTERISTIC
/end GROUP
/begin GROUP S405_CANMsgInvalidB2VST4 "SWC_INP_type/run_SWC_INP_5ms_sys/INP/CAN3/CommunicationCheck/CANMsgInvalidB2VST4"
 /begin REF_CHARACTERISTIC KINP_CANMsgInvalidB2VST4_flg_ovrdflg KINP_CANMsgInvalidB2VST4_flg_ovrdval /end REF_CHARACTERISTIC
/end GROUP
/begin GROUP S405_CANMsgInvalidB2VST5 "SWC_INP_type/run_SWC_INP_5ms_sys/INP/CAN3/CommunicationCheck/CANMsgInvalidB2VST5"
 /begin REF_CHARACTERISTIC KINP_CANMsgInvalidB2VST5_flg_ovrdflg KINP_CANMsgInvalidB2VST5_flg_ovrdval /end REF_CHARACTERISTIC
/end GROUP
/begin GROUP S405_CANMsgInvalidEWP1 "SWC_INP_type/run_SWC_INP_5ms_sys/INP/CAN3/CommunicationCheck/CANMsgInvalidEWP1"
 /begin REF_CHARACTERISTIC KINP_CANMsgInvalidEWP1_flg_ovrdflg KINP_CANMsgInvalidEWP1_flg_ovrdval /end REF_CHARACTERISTIC
/end GROUP
/begin GROUP S405_CANMsgInvalidTMMCUSta1 "SWC_INP_type/run_SWC_INP_5ms_sys/INP/CAN3/CommunicationCheck/CANMsgInvalidTMMCUSta1"
 /begin REF_CHARACTERISTIC KINP_CANMsgInvalidTMMCUSta1_flg_ovrdflg KINP_CANMsgInvalidTMMCUSta1_flg_ovrdval /end REF_CHARACTERISTIC
/end GROUP
/begin GROUP S405_CANMsgInvalidTMMCUSta2 "SWC_INP_type/run_SWC_INP_5ms_sys/INP/CAN3/CommunicationCheck/CANMsgInvalidTMMCUSta2"
 /begin REF_CHARACTERISTIC KINP_CANMsgInvalidTMMCUSta2_flg_ovrdflg KINP_CANMsgInvalidTMMCUSta2_flg_ovrdval /end REF_CHARACTERISTIC
/end GROUP
/begin GROUP S405_CANMsgInvalidTMMCUSta3 "SWC_INP_type/run_SWC_INP_5ms_sys/INP/CAN3/CommunicationCheck/CANMsgInvalidTMMCUSta3"
 /begin REF_CHARACTERISTIC KINP_CANMsgInvalidTMMCUSta3_flg_ovrdflg KINP_CANMsgInvalidTMMCUSta3_flg_ovrdval /end REF_CHARACTERISTIC
/end GROUP
/begin GROUP S407_B2TM_Info "SWC_INP_type/run_SWC_INP_5ms_sys/INP/CAN3/SignalCheck/B2TM_Info" /begin SUB_GROUP S456_B2THVRlySta /end SUB_GROUP /end GROUP
/begin GROUP S407_B2V_BattInfo1 "SWC_INP_type/run_SWC_INP_5ms_sys/INP/CAN3/SignalCheck/B2V_BattInfo1" /begin SUB_GROUP S457_B2VBI1BattType /end SUB_GROUP /end GROUP
/begin GROUP S407_B2V_CurrentLimit "SWC_INP_type/run_SWC_INP_5ms_sys/INP/CAN3/SignalCheck/B2V_CurrentLimit" /begin SUB_GROUP S458_B2VAPlsDischgCurr S458_B2VAvaPlsChgCurr /end SUB_GROUP /end GROUP
/begin GROUP S407_B2V_Fult1_32960 "SWC_INP_type/run_SWC_INP_5ms_sys/INP/CAN3/SignalCheck/B2V_Fult1_32960" /begin SUB_GROUP S459_B2VHVILFault /end SUB_GROUP /end GROUP
/begin GROUP S407_B2V_ST1 "SWC_INP_type/run_SWC_INP_5ms_sys/INP/CAN3/SignalCheck/B2V_ST1"
 /begin SUB_GROUP S460_B2VACChgConnSta S460_B2VACChgNegRlySta S460_B2VACChgPosRlySta S460_B2VBMUHVSta S460_B2VChgMode S460_B2VChgSta S460_B2VDCChgConnSta S460_B2VDCChgN1RlySta S460_B2VDCChgP1RlySta S460_B2VMainNegRlySta /end SUB_GROUP
/end GROUP
/begin GROUP S407_B2V_ST2 "SWC_INP_type/run_SWC_INP_5ms_sys/INP/CAN3/SignalCheck/B2V_ST2"
 /begin SUB_GROUP S461_B2VFaultCode S461_B2VFaultLv S461_B2VPackCurr S461_B2VPackInsideVol S461_B2VRqHVPwrOff S461_B2VSOC /end SUB_GROUP
/end GROUP
/begin GROUP S407_B2V_ST4 "SWC_INP_type/run_SWC_INP_5ms_sys/INP/CAN3/SignalCheck/B2V_ST4" /begin SUB_GROUP S462_B2VMinTempPos /end SUB_GROUP /end GROUP
/begin GROUP S407_B2V_ST5 "SWC_INP_type/run_SWC_INP_5ms_sys/INP/CAN3/SignalCheck/B2V_ST5" /begin SUB_GROUP S463_B2VCellMinVol /end SUB_GROUP /end GROUP
/begin GROUP S407_EWP1 "SWC_INP_type/run_SWC_INP_5ms_sys/INP/CAN3/SignalCheck/EWP1" /begin SUB_GROUP S464_EWPPEFault /end SUB_GROUP /end GROUP
/begin GROUP S407_TM_MCUSta1 "SWC_INP_type/run_SWC_INP_5ms_sys/INP/CAN3/SignalCheck/TM_MCUSta1"
 /begin SUB_GROUP S465_AtvDisChgEnFbk S465_MCUCtrlMdSta S465_MCUIGBTEnFbk S465_MotorSpd S465_MotorTrq /end SUB_GROUP
/end GROUP
/begin GROUP S407_TM_MCUSta2 "SWC_INP_type/run_SWC_INP_5ms_sys/INP/CAN3/SignalCheck/TM_MCUSta2"
 /begin SUB_GROUP S466_MCUFailGrade S466_MCUTemp S466_MCUTrqLimHi S466_MCUTrqLimLo S466_MotorTemp /end SUB_GROUP
/end GROUP
/begin GROUP S407_TM_MCUSta3 "SWC_INP_type/run_SWC_INP_5ms_sys/INP/CAN3/SignalCheck/TM_MCUSta3" /begin SUB_GROUP S467_MCUDCCur S467_MCUDCVol S467_MCUFailCode /end SUB_GROUP /end GROUP
/begin GROUP S653_CANMsgInvalidZFRC1000 "SWC_INP_type/run_SWC_INP_5ms_sys/INP/CAN4/CommunicationCheck/CANMsgInvalidZFRC1000"
 /begin REF_CHARACTERISTIC KINP_CANMsgInvalidZFRC1000_flg_ovrdflg KINP_CANMsgInvalidZFRC1000_flg_ovrdval /end REF_CHARACTERISTIC
/end GROUP
/begin GROUP S653_CANMsgInvalidZFRCE1000 "SWC_INP_type/run_SWC_INP_5ms_sys/INP/CAN4/CommunicationCheck/CANMsgInvalidZFRCE1000"
 /begin REF_CHARACTERISTIC KINP_CANMsgInvalidZFRCE1000_flg_ovrdflg KINP_CANMsgInvalidZFRCE1000_flg_ovrdval /end REF_CHARACTERISTIC
/end GROUP
/begin GROUP S653_CANMsgInvalidZRRCE1000 "SWC_INP_type/run_SWC_INP_5ms_sys/INP/CAN4/CommunicationCheck/CANMsgInvalidZRRCE1000"
 /begin REF_CHARACTERISTIC KINP_CANMsgInvalidZRRCE1000_flg_ovrdflg KINP_CANMsgInvalidZRRCE1000_flg_ovrdval /end REF_CHARACTERISTIC
/end GROUP
/begin GROUP S653_CANMsgInvalidZRRCE1001 "SWC_INP_type/run_SWC_INP_5ms_sys/INP/CAN4/CommunicationCheck/CANMsgInvalidZRRCE1001"
 /begin REF_CHARACTERISTIC KINP_CANMsgInvalidZRRCE1001_flg_ovrdflg KINP_CANMsgInvalidZRRCE1001_flg_ovrdval /end REF_CHARACTERISTIC
/end GROUP
/begin GROUP S653_CANMsgInvalidzGWCANRr1C500 "SWC_INP_type/run_SWC_INP_5ms_sys/INP/CAN4/CommunicationCheck/CANMsgInvalidzGWCANRr1C500"
 /begin REF_CHARACTERISTIC KINP_CANMsgInvalidzGWCANRr1C500_flg_ovrdflg KINP_CANMsgInvalidzGWCANRr1C500_flg_ovrdval /end REF_CHARACTERISTIC
/end GROUP
/begin GROUP S655_ZFR_C100_0 "SWC_INP_type/run_SWC_INP_5ms_sys/INP/CAN4/SignalCheck/ZFR_C100_0" /begin SUB_GROUP S676_ParkBrakeSW /end SUB_GROUP /end GROUP
/begin GROUP S655_ZFR_CE100_0 "SWC_INP_type/run_SWC_INP_5ms_sys/INP/CAN4/SignalCheck/ZFR_CE100_0"
 /begin SUB_GROUP S677_AirPressureFC2 S677_ZFRBCMAutoLightSWSta S677_ZFRBCMBrakeSta S677_ZFRBCMHBeamSWSta S677_ZFRBCMHeadLpSWSta S677_ZFRBCMLFTurnLpCSta S677_ZFRBCMLightSensorVSta S677_ZFRBCMPLampSta S677_ZFRBCMRFTurnLpCSta S677_ZFRBCMRFogLpSWSta S677_ZFRBCMSeatbeltSta S677_ZFRBCMWasherSWSta S677_ZFRBCMWiperASSta S677_ZFRBCMWiperHSWSta S677_ZFRBCMWiperLSWSta /end SUB_GROUP
/end GROUP
/begin GROUP S655_ZRR_CE100_0 "SWC_INP_type/run_SWC_INP_5ms_sys/INP/CAN4/SignalCheck/ZRR_CE100_0" /begin SUB_GROUP S678_ZRRBCMAllDoorSta /end SUB_GROUP /end GROUP
/begin GROUP S655_ZRR_CE100_1 "SWC_INP_type/run_SWC_INP_5ms_sys/INP/CAN4/SignalCheck/ZRR_CE100_1"
 /begin SUB_GROUP S679_AirPressurePC3 S679_AirPressureRC1 S679_FDCCHASSISVCUEACPressSta S679_ZRRBCMCallingSWSta S679_ZRRBCMLRTurnLpCSta S679_ZRRBCMPLampSta S679_ZRRBCMRRTurnLpCSta S679_ZRRBCMSTOPSW2Sta S679_ZRRBCMSTOPSWSta /end SUB_GROUP
/end GROUP
/begin GROUP S655_zGW_CANRr1_C50_0 "SWC_INP_type/run_SWC_INP_5ms_sys/INP/CAN4/SignalCheck/zGW_CANRr1_C50_0"
 /begin SUB_GROUP S680_DCDCEnSta S680_DCDCErrLvSta S680_DCDCOutVolSta S680_DCDCTempSta S680_EACEnSta S680_EACErrLvSta S680_EACInvTempSta S680_EHPSEnSta S680_EHPSErrLvSta S680_EHPSInvTempSta S680_EHPSMotorSpdSta S680_PDUACRlySta S680_PDUDCDCEACEHPSHVLoopSta S680_PDUDCDCEACEHPSPreRlySta S680_PDUDCDCEACEHPSRlySta S680_PDUHVILSta S680_PDUMCUHVLoopSta S680_PDUMCUPosRlySta S680_PDUMCUPreRlySta S680_PDUSelfChkSta /end SUB_GROUP
/end GROUP
/begin GROUP S919_AccelPedal1Vol_V "SWC_INP_type/run_SWC_INP_5ms_sys/INP/GPIO/Analog/AccelPedal1Vol_V" /begin SUB_GROUP S921_ad_signal_process /end SUB_GROUP
 /begin REF_CHARACTERISTIC KINP_AccelPedal1Vol_V_defval KINP_AccelPedal1Vol_V_fftdec KINP_AccelPedal1Vol_V_fftinc KINP_AccelPedal1Vol_V_fftlim KINP_AccelPedal1Vol_V_limlow KINP_AccelPedal1Vol_V_limupr KINP_AccelPedal1Vol_V_ovrdflg KINP_AccelPedal1Vol_V_ovrdval KINP_AccelPedal1Vol_V_srvcflg KINP_AccelPedal1Vol_V_srvcval KINP_AccelPedal1Vol_V_tcfilt /end REF_CHARACTERISTIC
/end GROUP
/begin GROUP S919_AccelPedal2Vol_V "SWC_INP_type/run_SWC_INP_5ms_sys/INP/GPIO/Analog/AccelPedal2Vol_V" /begin SUB_GROUP S922_ad_signal_process /end SUB_GROUP
 /begin REF_CHARACTERISTIC KINP_AccelPedal2Vol_V_defval KINP_AccelPedal2Vol_V_fftdec KINP_AccelPedal2Vol_V_fftinc KINP_AccelPedal2Vol_V_fftlim KINP_AccelPedal2Vol_V_limlow KINP_AccelPedal2Vol_V_limupr KINP_AccelPedal2Vol_V_ovrdflg KINP_AccelPedal2Vol_V_ovrdval KINP_AccelPedal2Vol_V_srvcflg KINP_AccelPedal2Vol_V_srvcval KINP_AccelPedal2Vol_V_tcfilt /end REF_CHARACTERISTIC
/end GROUP
/begin GROUP S920_AlcoholPass "SWC_INP_type/run_SWC_INP_5ms_sys/INP/GPIO/Digital/AlcoholPass"
 /begin REF_CHARACTERISTIC KINP_AlcoholPass_flg_debdec KINP_AlcoholPass_flg_debinc KINP_AlcoholPass_flg_deblim KINP_AlcoholPass_flg_inverse KINP_AlcoholPass_flg_ovrdflg KINP_AlcoholPass_flg_ovrdval KINP_AlcoholPass_flg_srvcflg KINP_AlcoholPass_flg_srvcval /end REF_CHARACTERISTIC
/end GROUP
/begin GROUP S920_BmsAplus "SWC_INP_type/run_SWC_INP_5ms_sys/INP/GPIO/Digital/BmsAplus"
 /begin REF_CHARACTERISTIC KINP_BmsAplus_flg_debdec KINP_BmsAplus_flg_debinc KINP_BmsAplus_flg_deblim KINP_BmsAplus_flg_inverse KINP_BmsAplus_flg_ovrdflg KINP_BmsAplus_flg_ovrdval KINP_BmsAplus_flg_srvcflg KINP_BmsAplus_flg_srvcval /end REF_CHARACTERISTIC
/end GROUP
/begin GROUP S920_BrakeLampSW "SWC_INP_type/run_SWC_INP_5ms_sys/INP/GPIO/Digital/BrakeLampSW"
 /begin REF_CHARACTERISTIC KINP_BrakeLampSW_flg_debdec KINP_BrakeLampSW_flg_debinc KINP_BrakeLampSW_flg_deblim KINP_BrakeLampSW_flg_inverse KINP_BrakeLampSW_flg_ovrdflg KINP_BrakeLampSW_flg_ovrdval KINP_BrakeLampSW_flg_srvcflg KINP_BrakeLampSW_flg_srvcval /end REF_CHARACTERISTIC
/end GROUP
/begin GROUP S920_BrakeSWGPIO "SWC_INP_type/run_SWC_INP_5ms_sys/INP/GPIO/Digital/BrakeSWGPIO"
 /begin REF_CHARACTERISTIC KINP_BrakeSWGPIO_flg_debdec KINP_BrakeSWGPIO_flg_debinc KINP_BrakeSWGPIO_flg_deblim KINP_BrakeSWGPIO_flg_inverse KINP_BrakeSWGPIO_flg_ovrdflg KINP_BrakeSWGPIO_flg_ovrdval KINP_BrakeSWGPIO_flg_srvcflg KINP_BrakeSWGPIO_flg_srvcval /end REF_CHARACTERISTIC
/end GROUP
/begin GROUP S920_CrashSignalGPIO "SWC_INP_type/run_SWC_INP_5ms_sys/INP/GPIO/Digital/CrashSignalGPIO"
 /begin REF_CHARACTERISTIC KINP_CrashSignalGPIO_flg_debdec KINP_CrashSignalGPIO_flg_debinc KINP_CrashSignalGPIO_flg_deblim KINP_CrashSignalGPIO_flg_inverse KINP_CrashSignalGPIO_flg_ovrdflg KINP_CrashSignalGPIO_flg_ovrdval KINP_CrashSignalGPIO_flg_srvcflg KINP_CrashSignalGPIO_flg_srvcval /end REF_CHARACTERISTIC
/end GROUP
/begin GROUP S920_EmergencyExitSW "SWC_INP_type/run_SWC_INP_5ms_sys/INP/GPIO/Digital/EmergencyExitSW"
 /begin REF_CHARACTERISTIC KINP_EmergencyExitSW_flg_debdec KINP_EmergencyExitSW_flg_debinc KINP_EmergencyExitSW_flg_deblim KINP_EmergencyExitSW_flg_inverse KINP_EmergencyExitSW_flg_ovrdflg KINP_EmergencyExitSW_flg_ovrdval KINP_EmergencyExitSW_flg_srvcflg KINP_EmergencyExitSW_flg_srvcval /end REF_CHARACTERISTIC
/end GROUP
/begin GROUP S920_FrontDoorSW "SWC_INP_type/run_SWC_INP_5ms_sys/INP/GPIO/Digital/FrontDoorSW"
 /begin REF_CHARACTERISTIC KINP_FrontDoorSW_flg_debdec KINP_FrontDoorSW_flg_debinc KINP_FrontDoorSW_flg_deblim KINP_FrontDoorSW_flg_inverse KINP_FrontDoorSW_flg_ovrdflg KINP_FrontDoorSW_flg_ovrdval KINP_FrontDoorSW_flg_srvcflg KINP_FrontDoorSW_flg_srvcval /end REF_CHARACTERISTIC
/end GROUP
/begin GROUP S920_HazardSW "SWC_INP_type/run_SWC_INP_5ms_sys/INP/GPIO/Digital/HazardSW"
 /begin REF_CHARACTERISTIC KINP_HazardSW_flg_debdec KINP_HazardSW_flg_debinc KINP_HazardSW_flg_deblim KINP_HazardSW_flg_inverse KINP_HazardSW_flg_ovrdflg KINP_HazardSW_flg_ovrdval KINP_HazardSW_flg_srvcflg KINP_HazardSW_flg_srvcval /end REF_CHARACTERISTIC
/end GROUP
/begin GROUP S920_LeftTurnSW "SWC_INP_type/run_SWC_INP_5ms_sys/INP/GPIO/Digital/LeftTurnSW"
 /begin REF_CHARACTERISTIC KINP_LeftTurnSW_flg_debdec KINP_LeftTurnSW_flg_debinc KINP_LeftTurnSW_flg_deblim KINP_LeftTurnSW_flg_inverse KINP_LeftTurnSW_flg_ovrdflg KINP_LeftTurnSW_flg_ovrdval KINP_LeftTurnSW_flg_srvcflg KINP_LeftTurnSW_flg_srvcval /end REF_CHARACTERISTIC
/end GROUP
/begin GROUP S920_MidDoorSW "SWC_INP_type/run_SWC_INP_5ms_sys/INP/GPIO/Digital/MidDoorSW"
 /begin REF_CHARACTERISTIC KINP_MidDoorSW_flg_debdec KINP_MidDoorSW_flg_debinc KINP_MidDoorSW_flg_deblim KINP_MidDoorSW_flg_inverse KINP_MidDoorSW_flg_ovrdflg KINP_MidDoorSW_flg_ovrdval KINP_MidDoorSW_flg_srvcflg KINP_MidDoorSW_flg_srvcval /end REF_CHARACTERISTIC
/end GROUP
/begin GROUP S920_OSDoorSwClose "SWC_INP_type/run_SWC_INP_5ms_sys/INP/GPIO/Digital/OSDoorSwClose"
 /begin REF_CHARACTERISTIC KINP_OSDoorSwClose_flg_debdec KINP_OSDoorSwClose_flg_debinc KINP_OSDoorSwClose_flg_deblim KINP_OSDoorSwClose_flg_inverse KINP_OSDoorSwClose_flg_ovrdflg KINP_OSDoorSwClose_flg_ovrdval KINP_OSDoorSwClose_flg_srvcflg KINP_OSDoorSwClose_flg_srvcval /end REF_CHARACTERISTIC
/end GROUP
/begin GROUP S920_OSDoorSwOpen "SWC_INP_type/run_SWC_INP_5ms_sys/INP/GPIO/Digital/OSDoorSwOpen"
 /begin REF_CHARACTERISTIC KINP_OSDoorSwOpen_flg_debdec KINP_OSDoorSwOpen_flg_debinc KINP_OSDoorSwOpen_flg_deblim KINP_OSDoorSwOpen_flg_inverse KINP_OSDoorSwOpen_flg_ovrdflg KINP_OSDoorSwOpen_flg_ovrdval KINP_OSDoorSwOpen_flg_srvcflg KINP_OSDoorSwOpen_flg_srvcval /end REF_CHARACTERISTIC
/end GROUP
/end MODULE
/end PROJECT
