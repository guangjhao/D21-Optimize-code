[part 1 of 2: package /Com]
AUTOSAR XML (schema 4-0-3)
package /Com
  module config Com: implementation-config-variant=VARIANT-POST-BUILD
    ComConfig: ComConfigurationId=0
      76 x ComGwMapping:
        GMCAN1_WhlSpeed_FL_150892043R_CAN1_SG_HRW_150892043R
          CAN2_WhlSpeed_FL_523T_CAN2_SG_GW2_C100_0_523T (ComGwDestination)
            CAN2_WhlSpeed_FL_523T_CAN2_SG_GW2_C100_0_523T (ComGwSignal): ComGwSignalRef=CAN2_WhlSpeed_FL_523T
          ComGwSource
            ComGwSource (ComGwSignal): ComGwSignalRef=CAN1_WhlSpeed_FL_150892043R
        GMCAN1_WhlSpeed_FR_150892043R_CAN1_SG_HRW_150892043R
          CAN2_WhlSpeed_FR_523T_CAN2_SG_GW2_C100_0_523T (ComGwDestination)
            CAN2_WhlSpeed_FR_523T_CAN2_SG_GW2_C100_0_523T (ComGwSignal): ComGwSignalRef=CAN2_WhlSpeed_FR_523T
          ComGwSource
            ComGwSource (ComGwSignal): ComGwSignalRef=CAN1_WhlSpeed_FR_150892043R
        GMCAN1_WhlSpeed_RL_150892043R_CAN1_SG_HRW_150892043R
          CAN2_WhlSpeed_RL_523T_CAN2_SG_GW2_C100_0_523T (ComGwDestination)
            CAN2_WhlSpeed_RL_523T_CAN2_SG_GW2_C100_0_523T (ComGwSignal): ComGwSignalRef=CAN2_WhlSpeed_RL_523T
          ComGwSource
            ComGwSource (ComGwSignal): ComGwSignalRef=CAN1_WhlSpeed_RL_150892043R
        GMCAN1_WhlSpeed_RR_150892043R_CAN1_SG_HRW_150892043R
          CAN2_WhlSpeed_RR_523T_CAN2_SG_GW2_C100_0_523T (ComGwDestination)
            CAN2_WhlSpeed_RR_523T_CAN2_SG_GW2_C100_0_523T (ComGwSignal): ComGwSignalRef=CAN2_WhlSpeed_RR_523T
          ComGwSource
            ComGwSource (ComGwSignal): ComGwSignalRef=CAN1_WhlSpeed_RR_150892043R
        GMCAN1_TransReqGear_201392901R_CAN1_SG_TC1_201392901R
          CAN2_TransReqGear_523T_CAN2_SG_GW2_C100_0_523T (ComGwDestination)
            CAN2_TransReqGear_523T_CAN2_SG_GW2_C100_0_523T (ComGwSignal): ComGwSignalRef=CAN2_TransReqGear_523T
          ComGwSource
            ComGwSource (ComGwSignal): ComGwSignalRef=CAN1_TransReqGear_201392901R
        GMCAN1_ASC1KneelingInfo_217995823R_CAN1_SG_ASC1_A_217995823R
          CAN2_ASC1KneelingInfo_523T_CAN2_SG_GW2_C100_0_523T (ComGwDestination)
            CAN2_ASC1KneelingInfo_523T_CAN2_SG_GW2_C100_0_523T (ComGwSignal): ComGwSignalRef=CAN2_ASC1KneelingInfo_523T
          ComGwSource
            ComGwSource (ComGwSignal): ComGwSignalRef=CAN1_ASC1KneelingInfo_217995823R
        GMCAN1_ACTempSetSta_404542163R_CAN1_SG_AC_BTMS_C5000_0_404542163R
          CAN2_ACTempSetSta_523T_CAN2_SG_GW2_C100_0_523T (ComGwDestination)
            CAN2_ACTempSetSta_523T_CAN2_SG_GW2_C100_0_523T (ComGwSignal): ComGwSignalRef=CAN2_ACTempSetSta_523T
          ComGwSource
            ComGwSource (ComGwSignal): ComGwSignalRef=CAN1_ACTempSetSta_404542163R
        GMCAN1_EBSBrakeSw_418382091R_CAN1_SG_EBC1_418382091R
          CAN2_EBSBrakeSw_523T_CAN2_SG_GW2_C100_0_523T (ComGwDestination)
            CAN2_EBSBrakeSw_523T_CAN2_SG_GW2_C100_0_523T (ComGwSignal): ComGwSignalRef=CAN2_EBSBrakeSw_523T
          ComGwSource
            ComGwSource (ComGwSignal): ComGwSignalRef=CAN1_EBSBrakeSw_418382091R
        GMCAN1_ASREngCtrlAtc_418382091R_CAN1_SG_EBC1_418382091R
          CAN2_ASREngCtrlAtc_523T_CAN2_SG_GW2_C100_0_523T (ComGwDestination)
            CAN2_ASREngCtrlAtc_523T_CAN2_SG_GW2_C100_0_523T (ComGwSignal): ComGwSignalRef=CAN2_ASREngCtrlAtc_523T
          ComGwSource
            ComGwSource (ComGwSignal): ComGwSignalRef=CAN1_ASREngCtrlAtc_418382091R
        GMCAN1_ABSFullyOper_418382091R_CAN1_SG_EBC1_418382091R
          CAN2_ABSFullyOper_523T_CAN2_SG_GW2_C100_0_523T (ComGwDestination)
            CAN2_ABSFullyOper_523T_CAN2_SG_GW2_C100_0_523T (ComGwSignal): ComGwSignalRef=CAN2_ABSFullyOper_523T
          ComGwSource
            ComGwSource (ComGwSignal): ComGwSignalRef=CAN1_ABSFullyOper_418382091R
        GMCAN1_EBSAmWarnLampSta_418382091R_CAN1_SG_EBC1_418382091R
          CAN2_EBSAmWarnLampSta_523T_CAN2_SG_GW2_C100_0_523T (ComGwDestination)
            CAN2_EBSAmWarnLampSta_523T_CAN2_SG_GW2_C100_0_523T (ComGwSignal): ComGwSignalRef=CAN2_EBSAmWarnLampSta_523T
          ComGwSource
            ComGwSource (ComGwSignal): ComGwSignalRef=CAN1_EBSAmWarnLampSta_418382091R
        GMCAN1_ASRBrakeCtrlAtc_418382091R_CAN1_SG_EBC1_418382091R
          CAN2_ASRBrakeCtrlAtc_523T_CAN2_SG_GW2_C100_0_523T (ComGwDestination)
            CAN2_ASRBrakeCtrlAtc_523T_CAN2_SG_GW2_C100_0_523T (ComGwSignal): ComGwSignalRef=CAN2_ASRBrakeCtrlAtc_523T
          ComGwSource
            ComGwSource (ComGwSignal): ComGwSignalRef=CAN1_ASRBrakeCtrlAtc_418382091R
        GMCAN1_EBSRedWarnLampSta_418382091R_CAN1_SG_EBC1_418382091R
          CAN2_EBSRedWarnLampSta_523T_CAN2_SG_GW2_C100_0_523T (ComGwDestination)
            CAN2_EBSRedWarnLampSta_523T_CAN2_SG_GW2_C100_0_523T (ComGwSignal): ComGwSignalRef=CAN2_EBSRedWarnLampSta_523T
          ComGwSource
            ComGwSource (ComGwSignal): ComGwSignalRef=CAN1_EBSRedWarnLampSta_418382091R
        GMCAN1_VDCBrakeLightReq_419319563R_CAN1_SG_VDC1_419319563R
          CAN2_VDCBrakeLightReq_523T_CAN2_SG_GW2_C100_0_523T (ComGwDestination)
            CAN2_VDCBrakeLightReq_523T_CAN2_SG_GW2_C100_0_523T (ComGwSignal): ComGwSignalRef=CAN2_VDCBrakeLightReq_523T
          ComGwSource
            ComGwSource (ComGwSignal): ComGwSignalRef=CAN1_VDCBrakeLightReq_419319563R
        GMCAN1_ECASAWarmLampSta_419351087R_CAN1_SG_ECAS_DM1_419351087R
          CAN2_ECASAWarmLampSta_523T_CAN2_SG_GW2_C100_0_523T (ComGwDestination)
            CAN2_ECASAWarmLampSta_523T_CAN2_SG_GW2_C100_0_523T (ComGwSignal): ComGwSignalRef=CAN2_ECASAWarmLampSta_523T
          ComGwSource
            ComGwSource (ComGwSignal): ComGwSignalRef=CAN1_ECASAWarmLampSta_419351087R
        GMCAN1_ACMODESta_404541907R_CAN1_SG_AC_BTMS_C1000_1_404541907R
          CAN2_ACMODESta_526T_CAN2_SG_FD2_C1000_0_526T (ComGwDestination)
            CAN2_ACMODESta_526T_CAN2_SG_FD2_C1000_0_526T (ComGwSignal): ComGwSignalRef=CAN2_ACMODESta_526T
          ComGwSource
            ComGwSource (ComGwSignal): ComGwSignalRef=CAN1_ACMODESta_404541907R
        GMCAN1_LFSensorFail_418517043R_CAN1_SG_TPMS1_418517043R
          CAN2_LFSensorFail_526T_CAN2_SG_FD2_C1000_0_526T (ComGwDestination)
            CAN2_LFSensorFail_526T_CAN2_SG_FD2_C1000_0_526T (ComGwSignal): ComGwSignalRef=CAN2_LFSensorFail_526T
          ComGwSource
            ComGwSource (ComGwSignal): ComGwSignalRef=CAN1_LFSensorFail_418517043R
        GMCAN1_RBOBatWarn_418517043R_CAN1_SG_TPMS1_418517043R
          CAN2_RBOBatWarn_526T_CAN2_SG_FD2_C1000_0_526T (ComGwDestination)
            CAN2_RBOBatWarn_526T_CAN2_SG_FD2_C1000_0_526T (ComGwSignal): ComGwSignalRef=CAN2_RBOBatWarn_526T
          ComGwSource
            ComGwSource (ComGwSignal): ComGwSignalRef=CAN1_RBOBatWarn_418517043R
        GMCAN1_RBIWheelTmpIndi_418517043R_CAN1_SG_TPMS1_418517043R
          CAN2_RBIWheelTmpIndi_526T_CAN2_SG_FD2_C1000_0_526T (ComGwDestination)
            CAN2_RBIWheelTmpIndi_526T_CAN2_SG_FD2_C1000_0_526T (ComGwSignal): ComGwSignalRef=CAN2_RBIWheelTmpIndi_526T
          ComGwSource
            ComGwSource (ComGwSignal): ComGwSignalRef=CAN1_RBIWheelTmpIndi_418517043R
        GMCAN1_LFWheelTmpIndi_418517043R_CAN1_SG_TPMS1_418517043R
          CAN2_LFWheelTmpIndi_526T_CAN2_SG_FD2_C1000_0_526T (ComGwDestination)
            CAN2_LFWheelTmpIndi_526T_CAN2_SG_FD2_C1000_0_526T (ComGwSignal): ComGwSignalRef=CAN2_LFWheelTmpIndi_526T
          ComGwSource
            ComGwSource (ComGwSignal): ComGwSignalRef=CAN1_LFWheelTmpIndi_418517043R
        GMCAN1_LBIPressIndi_418517043R_CAN1_SG_TPMS1_418517043R
          CAN2_LBIPressIndi_526T_CAN2_SG_FD2_C1000_0_526T (ComGwDestination)
            CAN2_LBIPressIndi_526T_CAN2_SG_FD2_C1000_0_526T (ComGwSignal): ComGwSignalRef=CAN2_LBIPressIndi_526T
          ComGwSource
            ComGwSource (ComGwSignal): ComGwSignalRef=CAN1_LBIPressIndi_418517043R
        GMCAN1_RBIBatWarn_418517043R_CAN1_SG_TPMS1_418517043R
          CAN2_RBIBatWarn_526T_CAN2_SG_FD2_C1000_0_526T (ComGwDestination)
            CAN2_RBIBatWarn_526T_CAN2_SG_FD2_C1000_0_526T (ComGwSignal): ComGwSignalRef=CAN2_RBIBatWarn_526T
          ComGwSource
            ComGwSource (ComGwSignal): ComGwSignalRef=CAN1_RBIBatWarn_418517043R
        GMCAN1_LFBatWarn_418517043R_CAN1_SG_TPMS1_418517043R
          CAN2_LFBatWarn_526T_CAN2_SG_FD2_C1000_0_526T (ComGwDestination)
            CAN2_LFBatWarn_526T_CAN2_SG_FD2_C1000_0_526T (ComGwSignal): ComGwSignalRef=CAN2_LFBatWarn_526T
          ComGwSource
            ComGwSource (ComGwSignal): ComGwSignalRef=CAN1_LFBatWarn_418517043R
        GMCAN1_RBIPressIndi_418517043R_CAN1_SG_TPMS1_418517043R
          CAN2_RBIPressIndi_526T_CAN2_SG_FD2_C1000_0_526T (ComGwDestination)
            CAN2_RBIPressIndi_526T_CAN2_SG_FD2_C1000_0_526T (ComGwSignal): ComGwSignalRef=CAN2_RBIPressIndi_526T
          ComGwSource
            ComGwSource (ComGwSignal): ComGwSignalRef=CAN1_RBIPressIndi_418517043R
        GMCAN1_LBOPressIndi_418517043R_CAN1_SG_TPMS1_418517043R
          CAN2_LBOPressIndi_526T_CAN2_SG_FD2_C1000_0_526T (ComGwDestination)
            CAN2_LBOPressIndi_526T_CAN2_SG_FD2_C1000_0_526T (ComGwSignal): ComGwSignalRef=CAN2_LBOPressIndi_526T
          ComGwSource
            ComGwSource (ComGwSignal): ComGwSignalRef=CAN1_LBOPressIndi_418517043R
        GMCAN1_RBISensorFail_418517043R_CAN1_SG_TPMS1_418517043R
          CAN2_RBISensorFail_526T_CAN2_SG_FD2_C1000_0_526T (ComGwDestination)
            CAN2_RBISensorFail_526T_CAN2_SG_FD2_C1000_0_526T (ComGwSignal): ComGwSignalRef=CAN2_RBISensorFail_526T
          ComGwSource
            ComGwSource (ComGwSignal): ComGwSignalRef=CAN1_RBISensorFail_418517043R
        GMCAN1_LBIBatWarn_418517043R_CAN1_SG_TPMS1_418517043R
          CAN2_LBIBatWarn_526T_CAN2_SG_FD2_C1000_0_526T (ComGwDestination)
            CAN2_LBIBatWarn_526T_CAN2_SG_FD2_C1000_0_526T (ComGwSignal): ComGwSignalRef=CAN2_LBIBatWarn_526T
          ComGwSource
            ComGwSource (ComGwSignal): ComGwSignalRef=CAN1_LBIBatWarn_418517043R
        GMCAN1_LBOBatWarn_418517043R_CAN1_SG_TPMS1_418517043R
          CAN2_LBOBatWarn_526T_CAN2_SG_FD2_C1000_0_526T (ComGwDestination)
            CAN2_LBOBatWarn_526T_CAN2_SG_FD2_C1000_0_526T (ComGwSignal): ComGwSignalRef=CAN2_LBOBatWarn_526T
          ComGwSource
            ComGwSource (ComGwSignal): ComGwSignalRef=CAN1_LBOBatWarn_418517043R
        GMCAN1_RBOSensorFail_418517043R_CAN1_SG_TPMS1_418517043R
          CAN2_RBOSensorFail_526T_CAN2_SG_FD2_C1000_0_526T (ComGwDestination)
            CAN2_RBOSensorFail_526T_CAN2_SG_FD2_C1000_0_526T (ComGwSignal): ComGwSignalRef=CAN2_RBOSensorFail_526T
          ComGwSource
            ComGwSource (ComGwSignal): ComGwSignalRef=CAN1_RBOSensorFail_418517043R
        GMCAN1_LBISensorFail_418517043R_CAN1_SG_TPMS1_418517043R
          CAN2_LBISensorFail_526T_CAN2_SG_FD2_C1000_0_526T (ComGwDestination)
            CAN2_LBISensorFail_526T_CAN2_SG_FD2_C1000_0_526T (ComGwSignal): ComGwSignalRef=CAN2_LBISensorFail_526T
          ComGwSource
            ComGwSource (ComGwSignal): ComGwSignalRef=CAN1_LBISensorFail_418517043R
        GMCAN1_RBOPressIndi_418517043R_CAN1_SG_TPMS1_418517043R
          CAN2_RBOPressIndi_526T_CAN2_SG_FD2_C1000_0_526T (ComGwDestination)
            CAN2_RBOPressIndi_526T_CAN2_SG_FD2_C1000_0_526T (ComGwSignal): ComGwSignalRef=CAN2_RBOPressIndi_526T
          ComGwSource
            ComGwSource (ComGwSignal): ComGwSignalRef=CAN1_RBOPressIndi_418517043R
        GMCAN1_LBOSensorFail_418517043R_CAN1_SG_TPMS1_418517043R
          CAN2_LBOSensorFail_526T_CAN2_SG_FD2_C1000_0_526T (ComGwDestination)
            CAN2_LBOSensorFail_526T_CAN2_SG_FD2_C1000_0_526T (ComGwSignal): ComGwSignalRef=CAN2_LBOSensorFail_526T
          ComGwSource
            ComGwSource (ComGwSignal): ComGwSignalRef=CAN1_LBOSensorFail_418517043R
        GMCAN1_RFWheelTmpIndi_418517043R_CAN1_SG_TPMS1_418517043R
          CAN2_RFWheelTmpIndi_526T_CAN2_SG_FD2_C1000_0_526T (ComGwDestination)
            CAN2_RFWheelTmpIndi_526T_CAN2_SG_FD2_C1000_0_526T (ComGwSignal): ComGwSignalRef=CAN2_RFWheelTmpIndi_526T
          ComGwSource
            ComGwSource (ComGwSignal): ComGwSignalRef=CAN1_RFWheelTmpIndi_418517043R
        GMCAN1_RFSensorFail_418517043R_CAN1_SG_TPMS1_418517043R
          CAN2_RFSensorFail_526T_CAN2_SG_FD2_C1000_0_526T (ComGwDestination)
            CAN2_RFSensorFail_526T_CAN2_SG_FD2_C1000_0_526T (ComGwSignal): ComGwSignalRef=CAN2_RFSensorFail_526T
          ComGwSource
            ComGwSource (ComGwSignal): ComGwSignalRef=CAN1_RFSensorFail_418517043R
        GMCAN1_RFBatWarn_418517043R_CAN1_SG_TPMS1_418517043R
          CAN2_RFBatWarn_526T_CAN2_SG_FD2_C1000_0_526T (ComGwDestination)
            CAN2_RFBatWarn_526T_CAN2_SG_FD2_C1000_0_526T (ComGwSignal): ComGwSignalRef=CAN2_RFBatWarn_526T
          ComGwSource
            ComGwSource (ComGwSignal): ComGwSignalRef=CAN1_RFBatWarn_418517043R
        GMCAN1_LBOWheelTmpIndi_418517043R_CAN1_SG_TPMS1_418517043R
          CAN2_LBOWheelTmpIndi_526T_CAN2_SG_FD2_C1000_0_526T (ComGwDestination)
            CAN2_LBOWheelTmpIndi_526T_CAN2_SG_FD2_C1000_0_526T (ComGwSignal): ComGwSignalRef=CAN2_LBOWheelTmpIndi_526T
          ComGwSource
            ComGwSource (ComGwSignal): ComGwSignalRef=CAN1_LBOWheelTmpIndi_418517043R
        GMCAN1_LBIWheelTmpIndi_418517043R_CAN1_SG_TPMS1_418517043R
          CAN2_LBIWheelTmpIndi_526T_CAN2_SG_FD2_C1000_0_526T (ComGwDestination)
            CAN2_LBIWheelTmpIndi_526T_CAN2_SG_FD2_C1000_0_526T (ComGwSignal): ComGwSignalRef=CAN2_LBIWheelTmpIndi_526T
          ComGwSource
            ComGwSource (ComGwSignal): ComGwSignalRef=CAN1_LBIWheelTmpIndi_418517043R
        GMCAN1_TPMSWarnIndi_418517043R_CAN1_SG_TPMS1_418517043R
          CAN2_TPMSWarnIndi_526T_CAN2_SG_FD2_C1000_0_526T (ComGwDestination)
            CAN2_TPMSWarnIndi_526T_CAN2_SG_FD2_C1000_0_526T (ComGwSignal): ComGwSignalRef=CAN2_TPMSWarnIndi_526T
          ComGwSource
            ComGwSource (ComGwSignal): ComGwSignalRef=CAN1_TPMSWarnIndi_418517043R
        GMCAN1_LFPressIndi_418517043R_CAN1_SG_TPMS1_418517043R
          CAN2_LFPressIndi_526T_CAN2_SG_FD2_C1000_0_526T (ComGwDestination)
            CAN2_LFPressIndi_526T_CAN2_SG_FD2_C1000_0_526T (ComGwSignal): ComGwSignalRef=CAN2_LFPressIndi_526T
          ComGwSource
            ComGwSource (ComGwSignal): ComGwSignalRef=CAN1_LFPressIndi_418517043R
        GMCAN1_RFPressIndi_418517043R_CAN1_SG_TPMS1_418517043R
          CAN2_RFPressIndi_526T_CAN2_SG_FD2_C1000_0_526T (ComGwDestination)
            CAN2_RFPressIndi_526T_CAN2_SG_FD2_C1000_0_526T (ComGwSignal): ComGwSignalRef=CAN2_RFPressIndi_526T
          ComGwSource
            ComGwSource (ComGwSignal): ComGwSignalRef=CAN1_RFPressIndi_418517043R
        GMCAN1_RBOWheelTmpIndi_418517043R_CAN1_SG_TPMS1_418517043R
          CAN2_RBOWheelTmpIndi_526T_CAN2_SG_FD2_C1000_0_526T (ComGwDestination)
            CAN2_RBOWheelTmpIndi_526T_CAN2_SG_FD2_C1000_0_526T (ComGwSignal): ComGwSignalRef=CAN2_RBOWheelTmpIndi_526T
          ComGwSource
            ComGwSource (ComGwSignal): ComGwSignalRef=CAN1_RBOWheelTmpIndi_418517043R
        GMCAN1_RFWheelPress_418517299R_CAN1_SG_TPMS2_418517299R
          CAN2_RFWheelPress_526T_CAN2_SG_FD2_C1000_0_526T (ComGwDestination)
            CAN2_RFWheelPress_526T_CAN2_SG_FD2_C1000_0_526T (ComGwSignal): ComGwSignalRef=CAN2_RFWheelPress_526T
          ComGwSource
            ComGwSource (ComGwSignal): ComGwSignalRef=CAN1_RFWheelPress_418517299R
        GMCAN1_LFWheelPress_418517299R_CAN1_SG_TPMS2_418517299R
          CAN2_LFWheelPress_526T_CAN2_SG_FD2_C1000_0_526T (ComGwDestination)
            CAN2_LFWheelPress_526T_CAN2_SG_FD2_C1000_0_526T (ComGwSignal): ComGwSignalRef=CAN2_LFWheelPress_526T
          ComGwSource
            ComGwSource (ComGwSignal): ComGwSignalRef=CAN1_LFWheelPress_418517299R
        GMCAN1_RBOWheelPress_418517299R_CAN1_SG_TPMS2_418517299R
          CAN2_RBOWheelPress_526T_CAN2_SG_FD2_C1000_0_526T (ComGwDestination)
            CAN2_RBOWheelPress_526T_CAN2_SG_FD2_C1000_0_526T (ComGwSignal): ComGwSignalRef=CAN2_RBOWheelPress_526T
          ComGwSource
            ComGwSource (ComGwSignal): ComGwSignalRef=CAN1_RBOWheelPress_418517299R
        GMCAN1_LBOWheelPress_418517299R_CAN1_SG_TPMS2_418517299R
          CAN2_LBOWheelPress_526T_CAN2_SG_FD2_C1000_0_526T (ComGwDestination)
            CAN2_LBOWheelPress_526T_CAN2_SG_FD2_C1000_0_526T (ComGwSignal): ComGwSignalRef=CAN2_LBOWheelPress_526T
          ComGwSource
            ComGwSource (ComGwSignal): ComGwSignalRef=CAN1_LBOWheelPress_418517299R
        GMCAN1_LBIWheelPress_418517299R_CAN1_SG_TPMS2_418517299R
          CAN2_LBIWheelPress_526T_CAN2_SG_FD2_C1000_0_526T (ComGwDestination)
            CAN2_LBIWheelPress_526T_CAN2_SG_FD2_C1000_0_526T (ComGwSignal): ComGwSignalRef=CAN2_LBIWheelPress_526T
          ComGwSource
            ComGwSource (ComGwSignal): ComGwSignalRef=CAN1_LBIWheelPress_418517299R
        GMCAN1_RBIWheelPress_418517299R_CAN1_SG_TPMS2_418517299R
          CAN2_RBIWheelPress_526T_CAN2_SG_FD2_C1000_0_526T (ComGwDestination)
            CAN2_RBIWheelPress_526T_CAN2_SG_FD2_C1000_0_526T (ComGwSignal): ComGwSignalRef=CAN2_RBIWheelPress_526T
          ComGwSource
            ComGwSource (ComGwSignal): ComGwSignalRef=CAN1_RBIWheelPress_418517299R
        GMCAN1_LBOWheelTemp_418517555R_CAN1_SG_TPMS3_418517555R
          CAN2_LBOWheelTemp_526T_CAN2_SG_FD2_C1000_0_526T (ComGwDestination)
            CAN2_LBOWheelTemp_526T_CAN2_SG_FD2_C1000_0_526T (ComGwSignal): ComGwSignalRef=CAN2_LBOWheelTemp_526T
          ComGwSource
            ComGwSource (ComGwSignal): ComGwSignalRef=CAN1_LBOWheelTemp_418517555R
        GMCAN1_LFWheelTemp_418517555R_CAN1_SG_TPMS3_418517555R
          CAN2_LFWheelTemp_526T_CAN2_SG_FD2_C1000_0_526T (ComGwDestination)
            CAN2_LFWheelTemp_526T_CAN2_SG_FD2_C1000_0_526T (ComGwSignal): ComGwSignalRef=CAN2_LFWheelTemp_526T
          ComGwSource
            ComGwSource (ComGwSignal): ComGwSignalRef=CAN1_LFWheelTemp_418517555R
        GMCAN1_RFWheelTemp_418517555R_CAN1_SG_TPMS3_418517555R
          CAN2_RFWheelTemp_526T_CAN2_SG_FD2_C1000_0_526T (ComGwDestination)
            CAN2_RFWheelTemp_526T_CAN2_SG_FD2_C1000_0_526T (ComGwSignal): ComGwSignalRef=CAN2_RFWheelTemp_526T
          ComGwSource
            ComGwSource (ComGwSignal): ComGwSignalRef=CAN1_RFWheelTemp_418517555R
        GMCAN1_LBIWheelTemp_418517555R_CAN1_SG_TPMS3_418517555R
          CAN2_LBIWheelTemp_526T_CAN2_SG_FD2_C1000_0_526T (ComGwDestination)
            CAN2_LBIWheelTemp_526T_CAN2_SG_FD2_C1000_0_526T (ComGwSignal): ComGwSignalRef=CAN2_LBIWheelTemp_526T
          ComGwSource
            ComGwSource (ComGwSignal): ComGwSignalRef=CAN1_LBIWheelTemp_418517555R
        GMCAN1_RBOWheelTemp_418517555R_CAN1_SG_TPMS3_418517555R
          CAN2_RBOWheelTemp_526T_CAN2_SG_FD2_C1000_0_526T (ComGwDestination)
            CAN2_RBOWheelTemp_526T_CAN2_SG_FD2_C1000_0_526T (ComGwSignal): ComGwSignalRef=CAN2_RBOWheelTemp_526T
          ComGwSource
            ComGwSource (ComGwSignal): ComGwSignalRef=CAN1_RBOWheelTemp_418517555R
        GMCAN1_THCM_Faultlv_Sta_419406361R_CAN1_SG_AC_BTMS_C1000_2_419406361R
          CAN2_THCM_Faultlv_Sta_526T_CAN2_SG_FD2_C1000_0_526T (ComGwDestination)
            CAN2_THCM_Faultlv_Sta_526T_CAN2_SG_FD2_C1000_0_526T (ComGwSignal): ComGwSignalRef=CAN2_THCM_Faultlv_Sta_526T
          ComGwSource
            ComGwSource (ComGwSignal): ComGwSignalRef=CAN1_THCM_Faultlv_Sta_419406361R
        GMCAN3_MCUFailGrade_218038533R_CAN3_SG_TM_MCUSta2_218038533R
          CAN2_MCUFailGrade_523T_CAN2_SG_GW2_C100_0_523T (ComGwDestination)
            CAN2_MCUFailGrade_523T_CAN2_SG_GW2_C100_0_523T (ComGwSignal): ComGwSignalRef=CAN2_MCUFailGrade_523T
          ComGwSource
            ComGwSource (ComGwSignal): ComGwSignalRef=CAN3_MCUFailGrade_218038533R
        GMCAN3_B2VChgMode_411299827R_CAN3_SG_B2V_ST1_411299827R
          CAN2_B2VChgMode_523T_CAN2_SG_GW2_C100_0_523T (ComGwDestination)
            CAN2_B2VChgMode_523T_CAN2_SG_GW2_C100_0_523T (ComGwSignal): ComGwSignalRef=CAN2_B2VChgMode_523T
          ComGwSource
            ComGwSource (ComGwSignal): ComGwSignalRef=CAN3_B2VChgMode_411299827R
        GMCAN3_B2VDCChgConnSta_411299827R_CAN3_SG_B2V_ST1_411299827R
          CAN2_B2VDCChgConnSta_523T_CAN2_SG_GW2_C100_0_523T (ComGwDestination)
            CAN2_B2VDCChgConnSta_523T_CAN2_SG_GW2_C100_0_523T (ComGwSignal): ComGwSignalRef=CAN2_B2VDCChgConnSta_523T
          ComGwSource
            ComGwSource (ComGwSignal): ComGwSignalRef=CAN3_B2VDCChgConnSta_411299827R
        GMCAN3_B2VPChrgConnSta_411299827R_CAN3_SG_B2V_ST1_411299827R
          CAN2_B2VPChrgConnSta_523T_CAN2_SG_GW2_C100_0_523T (ComGwDestination)
            CAN2_B2VPChrgConnSta_523T_CAN2_SG_GW2_C100_0_523T (ComGwSignal): ComGwSignalRef=CAN2_B2VPChrgConnSta_523T
          ComGwSource
            ComGwSource (ComGwSignal): ComGwSignalRef=CAN3_B2VPChrgConnSta_411299827R
        GMCAN3_B2VChgSta_411299827R_CAN3_SG_B2V_ST1_411299827R
          CAN2_B2VChgSta_523T_CAN2_SG_GW2_C100_0_523T (ComGwDestination)
            CAN2_B2VChgSta_523T_CAN2_SG_GW2_C100_0_523T (ComGwSignal): ComGwSignalRef=CAN2_B2VChgSta_523T
          ComGwSource
            ComGwSource (ComGwSignal): ComGwSignalRef=CAN3_B2VChgSta_411299827R
        GMCAN3_B2VSOC_411365363R_CAN3_SG_B2V_ST2_411365363R
          CAN2_B2VSOC_523T_CAN2_SG_GW2_C100_0_523T (ComGwDestination)
            CAN2_B2VSOC_523T_CAN2_SG_GW2_C100_0_523T (ComGwSignal): ComGwSignalRef=CAN2_B2VSOC_523T
          ComGwSource
            ComGwSource (ComGwSignal): ComGwSignalRef=CAN3_B2VSOC_411365363R
        GMCAN3_B2VSOH_411365363R_CAN3_SG_B2V_ST2_411365363R
          CAN2_B2VSOH_523T_CAN2_SG_GW2_C100_0_523T (ComGwDestination)
            CAN2_B2VSOH_523T_CAN2_SG_GW2_C100_0_523T (ComGwSignal): ComGwSignalRef=CAN2_B2VSOH_523T
          ComGwSource
            ComGwSource (ComGwSignal): ComGwSignalRef=CAN3_B2VSOH_411365363R
        GMCAN3_B2VFaultCode_411365363R_CAN3_SG_B2V_ST2_411365363R
          CAN2_B2VFaultCode_523T_CAN2_SG_GW2_C100_0_523T (ComGwDestination)
            CAN2_B2VFaultCode_523T_CAN2_SG_GW2_C100_0_523T (ComGwSignal): ComGwSignalRef=CAN2_B2VFaultCode_523T
          ComGwSource
            ComGwSource (ComGwSignal): ComGwSignalRef=CAN3_B2VFaultCode_411365363R
        GMCAN3_B2VBI1RateHVolt_417525747R_CAN3_SG_B2V_BattInfo1_417525747R
          CAN2_B2VBI1RateHVolt_523T_CAN2_SG_GW2_C100_0_523T (ComGwDestination)
            CAN2_B2VBI1RateHVolt_523T_CAN2_SG_GW2_C100_0_523T (ComGwSignal): ComGwSignalRef=CAN2_B2VBI1RateHVolt_523T
          ComGwSource
            ComGwSource (ComGwSignal): ComGwSignalRef=CAN3_B2VBI1RateHVolt_417525747R
        GMCAN3_B2VBI1BattType_417525747R_CAN3_SG_B2V_BattInfo1_417525747R
          CAN2_B2VBI1BattType_523T_CAN2_SG_GW2_C100_0_523T (ComGwDestination)
            CAN2_B2VBI1BattType_523T_CAN2_SG_GW2_C100_0_523T (ComGwSignal): ComGwSignalRef=CAN2_B2VBI1BattType_523T
          ComGwSource
            ComGwSource (ComGwSignal): ComGwSignalRef=CAN3_B2VBI1BattType_417525747R
        GMCAN3_B2VBI1RateCap_417525747R_CAN3_SG_B2V_BattInfo1_417525747R
          CAN2_B2VBI1RateCap_523T_CAN2_SG_GW2_C100_0_523T (ComGwDestination)
            CAN2_B2VBI1RateCap_523T_CAN2_SG_GW2_C100_0_523T (ComGwSignal): ComGwSignalRef=CAN2_B2VBI1RateCap_523T
          ComGwSource
            ComGwSource (ComGwSignal): ComGwSignalRef=CAN3_B2VBI1RateCap_417525747R
        GMCAN3_B2VBI1RatePower_417525747R_CAN3_SG_B2V_BattInfo1_417525747R
          CAN2_B2VBI1RatePower_523T_CAN2_SG_GW2_C100_0_523T (ComGwDestination)
            CAN2_B2VBI1RatePower_523T_CAN2_SG_GW2_C100_0_523T (ComGwSignal): ComGwSignalRef=CAN2_B2VBI1RatePower_523T
          ComGwSource
            ComGwSource (ComGwSignal): ComGwSignalRef=CAN3_B2VBI1RatePower_417525747R
        GMCAN3_B2THVRlySta_419382772R_CAN3_SG_B2TM_Info_419382772R
          CAN2_B2THVRlySta_523T_CAN2_SG_GW2_C100_0_523T (ComGwDestination)
            CAN2_B2THVRlySta_523T_CAN2_SG_GW2_C100_0_523T (ComGwSignal): ComGwSignalRef=CAN2_B2THVRlySta_523T
          ComGwSource
            ComGwSource (ComGwSignal): ComGwSignalRef=CAN3_B2THVRlySta_419382772R
        GMCAN4_AirPressureFC2_517R_CAN4_SG_ZFR_CE100_0_517R
          CAN1_AirPressureFC2_419343920T_CAN1_SG_FD1_C1000_0_419343920T (ComGwDestination)
            CAN1_AirPressureFC2_419343920T_CAN1_SG_FD1_C1000_0_419343920T (ComGwSignal): ComGwSignalRef=CAN1_AirPressureFC2_419343920T
          ComGwSource
            ComGwSource (ComGwSignal): ComGwSignalRef=CAN4_AirPressureFC2_517R
        GMCAN4_AirPressureRC1_518R_CAN4_SG_ZRR_CE100_1_518R
          CAN1_AirPressureRC1_419343920T_CAN1_SG_FD1_C1000_0_419343920T (ComGwDestination)
            CAN1_AirPressureRC1_419343920T_CAN1_SG_FD1_C1000_0_419343920T (ComGwSignal): ComGwSignalRef=CAN1_AirPressureRC1_419343920T
          CAN2_AirPressureRC1_523T_CAN2_SG_GW2_C100_0_523T (ComGwDestination)
            CAN2_AirPressureRC1_523T_CAN2_SG_GW2_C100_0_523T (ComGwSignal): ComGwSignalRef=CAN2_AirPressureRC1_523T
          ComGwSource
            ComGwSource (ComGwSignal): ComGwSignalRef=CAN4_AirPressureRC1_518R
        GMCAN4_AirPressurePC3_518R_CAN4_SG_ZRR_CE100_1_518R
          CAN1_AirPressurePC3_419343920T_CAN1_SG_FD1_C1000_0_419343920T (ComGwDestination)
            CAN1_AirPressurePC3_419343920T_CAN1_SG_FD1_C1000_0_419343920T (ComGwSignal): ComGwSignalRef=CAN1_AirPressurePC3_419343920T
          ComGwSource
            ComGwSource (ComGwSignal): ComGwSignalRef=CAN4_AirPressurePC3_518R
        GMCAN4_ParkBrakeSW_515R_CAN4_SG_ZFR_C100_0_515R
          CAN1_ParkBrakeSW_419361024T_CAN1_SG_FD1_C100_3_419361024T (ComGwDestination)
            CAN1_ParkBrakeSW_419361024T_CAN1_SG_FD1_C100_3_419361024T (ComGwSignal): ComGwSignalRef=CAN1_ParkBrakeSW_419361024T
          CAN2_ParkBrakeSW_523T_CAN2_SG_GW2_C100_0_523T (ComGwDestination)
            CAN2_ParkBrakeSW_523T_CAN2_SG_GW2_C100_0_523T (ComGwSignal): ComGwSignalRef=CAN2_ParkBrakeSW_523T
          ComGwSource
            ComGwSource (ComGwSignal): ComGwSignalRef=CAN4_ParkBrakeSW_515R
        GMCAN4_ZFR_CHASSIS_LiningWearFL_Sta_513R_CAN4_SG_ZFR_C5000_0_513R
          CAN2_ZFR_CHASSIS_LiningWearFL_Sta_523T_CAN2_SG_GW2_C100_0_523T (ComGwDestination)
            CAN2_ZFR_CHASSIS_LiningWearFL_Sta_523T_CAN2_SG_GW2_C100_0_523T (ComGwSignal): ComGwSignalRef=CAN2_ZFR_CHASSIS_LiningWearFL_Sta_523T
          ComGwSource
            ComGwSource (ComGwSignal): ComGwSignalRef=CAN4_ZFR_CHASSIS_LiningWearFL_Sta_513R
        GMCAN4_ZFR_CHASSIS_LiningWearFR_Sta_513R_CAN4_SG_ZFR_C5000_0_513R
          CAN2_ZFR_CHASSIS_LiningWearFR_Sta_523T_CAN2_SG_GW2_C100_0_523T (ComGwDestination)
            CAN2_ZFR_CHASSIS_LiningWearFR_Sta_523T_CAN2_SG_GW2_C100_0_523T (ComGwSignal): ComGwSignalRef=CAN2_ZFR_CHASSIS_LiningWearFR_Sta_523T
          ComGwSource
            ComGwSource (ComGwSignal): ComGwSignalRef=CAN4_ZFR_CHASSIS_LiningWearFR_Sta_513R
        GMCAN4_ZRR_CHASSIS_LiningWearRL_Sta_514R_CAN4_SG_ZRR_C5000_0_514R
          CAN2_ZRR_CHASSIS_LiningWearRL_Sta_523T_CAN2_SG_GW2_C100_0_523T (ComGwDestination)
            CAN2_ZRR_CHASSIS_LiningWearRL_Sta_523T_CAN2_SG_GW2_C100_0_523T (ComGwSignal): ComGwSignalRef=CAN2_ZRR_CHASSIS_LiningWearRL_Sta_523T
          ComGwSource
            ComGwSource (ComGwSignal): ComGwSignalRef=CAN4_ZRR_CHASSIS_LiningWearRL_Sta_514R
        GMCAN4_ZRR_CHASSIS_LiningWearRR_Sta_514R_CAN4_SG_ZRR_C5000_0_514R
          CAN2_ZRR_CHASSIS_LiningWearRR_Sta_523T_CAN2_SG_GW2_C100_0_523T (ComGwDestination)
            CAN2_ZRR_CHASSIS_LiningWearRR_Sta_523T_CAN2_SG_GW2_C100_0_523T (ComGwSignal): ComGwSignalRef=CAN2_ZRR_CHASSIS_LiningWearRR_Sta_523T
          ComGwSource
            ComGwSource (ComGwSignal): ComGwSignalRef=CAN4_ZRR_CHASSIS_LiningWearRR_Sta_514R
        GMCAN4_EHPS_ErrLv_Sta_522R_CAN4_SG_zGW_CANRr1_C50_0_522R
          CAN2_EHPS_ErrLv_Sta_523T_CAN2_SG_GW2_C100_0_523T (ComGwDestination)
            CAN2_EHPS_ErrLv_Sta_523T_CAN2_SG_GW2_C100_0_523T (ComGwSignal): ComGwSignalRef=CAN2_EHPS_ErrLv_Sta_523T
          ComGwSource
            ComGwSource (ComGwSignal): ComGwSignalRef=CAN4_EHPS_ErrLv_Sta_522R
        GMCAN4_DCDC_En_Sta_522R_CAN4_SG_zGW_CANRr1_C50_0_522R
          CAN2_DCDC_En_Sta_523T_CAN2_SG_GW2_C100_0_523T (ComGwDestination)
            CAN2_DCDC_En_Sta_523T_CAN2_SG_GW2_C100_0_523T (ComGwSignal): ComGwSignalRef=CAN2_DCDC_En_Sta_523T
          ComGwSource
            ComGwSource (ComGwSignal): ComGwSignalRef=CAN4_DCDC_En_Sta_522R
      80 x ComIPdu, all with ComIPduSignalProcessing=IMMEDIATE, ComIPduType=NORMAL, ComMainFunctionRef=(unset):
        PDCAN1_AC_BTMS_C1000_0_404541651R: ComIPduDirection=RECEIVE, ComIPduHandleId=0, ComIPduGroupRef=FUSION_CAN1_Rx, ComIPduSignalGroupRef=GRCAN1_SG_AC_BTMS_C1000_0_404541651R, ComPduIdRef=CAN1_AC_BTMS_C1000_0_404541651R
          ComIPduCounter: ComIPduCounterSize=(unset), ComIPduCounterStartPosition=(unset)
          ComIPduReplication: ComIPduReplicationQuorum=(unset)
          ComTxIPdu: ComTxIPduClearUpdateBit=Transmit, ComTxIPduUnusedAreasDefault=0
        PDCAN1_AC_BTMS_C1000_1_404541907R: ComIPduDirection=RECEIVE, ComIPduHandleId=1, ComIPduGroupRef=FUSION_CAN1_Rx, ComIPduSignalGroupRef=GRCAN1_SG_AC_BTMS_C1000_1_404541907R, ComPduIdRef=CAN1_AC_BTMS_C1000_1_404541907R
          ComIPduCounter: ComIPduCounterSize=(unset), ComIPduCounterStartPosition=(unset)
          ComIPduReplication: ComIPduReplicationQuorum=(unset)
          ComTxIPdu: ComTxIPduClearUpdateBit=Transmit, ComTxIPduUnusedAreasDefault=0
        PDCAN1_AC_BTMS_C1000_2_419406361R: ComIPduDirection=RECEIVE, ComIPduHandleId=2, ComIPduGroupRef=FUSION_CAN1_Rx, ComIPduSignalGroupRef=GRCAN1_SG_AC_BTMS_C1000_2_419406361R, ComPduIdRef=CAN1_AC_BTMS_C1000_2_419406361R
          ComIPduCounter: ComIPduCounterSize=(unset), ComIPduCounterStartPosition=(unset)
          ComIPduReplication: ComIPduReplicationQuorum=(unset)
          ComTxIPdu: ComTxIPduClearUpdateBit=Transmit, ComTxIPduUnusedAreasDefault=0
        PDCAN1_AC_BTMS_C1000_4_419414330R: ComIPduDirection=RECEIVE, ComIPduHandleId=3, ComIPduGroupRef=FUSION_CAN1_Rx, ComIPduSignalGroupRef=GRCAN1_SG_AC_BTMS_C1000_4_419414330R, ComPduIdRef=CAN1_AC_BTMS_C1000_4_419414330R
          ComIPduCounter: ComIPduCounterSize=(unset), ComIPduCounterStartPosition=(unset)
          ComIPduReplication: ComIPduReplicationQuorum=(unset)
          ComTxIPdu: ComTxIPduClearUpdateBit=Transmit, ComTxIPduUnusedAreasDefault=0
        PDCAN1_AC_BTMS_C5000_0_404542163R: ComIPduDirection=RECEIVE, ComIPduHandleId=4, ComIPduGroupRef=FUSION_CAN1_Rx, ComIPduSignalGroupRef=GRCAN1_SG_AC_BTMS_C5000_0_404542163R, ComPduIdRef=CAN1_AC_BTMS_C5000_0_404542163R
          ComIPduCounter: ComIPduCounterSize=(unset), ComIPduCounterStartPosition=(unset)
          ComIPduReplication: ComIPduReplicationQuorum=(unset)
          ComTxIPdu: ComTxIPduClearUpdateBit=Transmit, ComTxIPduUnusedAreasDefault=0
        PDCAN1_ASC1_A_217995823R: ComIPduDirection=RECEIVE, ComIPduHandleId=5, ComIPduGroupRef=FUSION_CAN1_Rx, ComIPduSignalGroupRef=GRCAN1_SG_ASC1_A_217995823R, ComPduIdRef=CAN1_ASC1_A_217995823R
          ComIPduCounter: ComIPduCounterSize=(unset), ComIPduCounterStartPosition=(unset)
          ComIPduReplication: ComIPduReplicationQuorum=(unset)
          ComTxIPdu: ComTxIPduClearUpdateBit=Transmit, ComTxIPduUnusedAreasDefault=0
        PDCAN1_EBC1_418382091R: ComIPduDirection=RECEIVE, ComIPduHandleId=6, ComIPduGroupRef=FUSION_CAN1_Rx, ComIPduSignalGroupRef=GRCAN1_SG_EBC1_418382091R, ComPduIdRef=CAN1_EBC1_418382091R
          ComIPduCounter: ComIPduCounterSize=(unset), ComIPduCounterStartPosition=(unset)
          ComIPduReplication: ComIPduReplicationQuorum=(unset)
          ComTxIPdu: ComTxIPduClearUpdateBit=Transmit, ComTxIPduUnusedAreasDefault=0
        PDCAN1_EBC2_419348235R: ComIPduDirection=RECEIVE, ComIPduHandleId=7, ComIPduGroupRef=FUSION_CAN1_Rx, ComIPduSignalGroupRef=GRCAN1_SG_EBC2_419348235R, ComPduIdRef=CAN1_EBC2_419348235R
          ComIPduCounter: ComIPduCounterSize=(unset), ComIPduCounterStartPosition=(unset)
          ComIPduReplication: ComIPduReplicationQuorum=(unset)
          ComTxIPdu: ComTxIPduClearUpdateBit=Transmit, ComTxIPduUnusedAreasDefault=0
        PDCAN1_EBC5_419283979R: ComIPduDirection=RECEIVE, ComIPduHandleId=8, ComIPduGroupRef=FUSION_CAN1_Rx, ComIPduSignalGroupRef=GRCAN1_SG_EBC5_419283979R, ComPduIdRef=CAN1_EBC5_419283979R
          ComIPduCounter: ComIPduCounterSize=(unset), ComIPduCounterStartPosition=(unset)
          ComIPduReplication: ComIPduReplicationQuorum=(unset)
          ComTxIPdu: ComTxIPduClearUpdateBit=Transmit, ComTxIPduUnusedAreasDefault=0
        PDCAN1_ECAS_DM1_419351087R: ComIPduDirection=RECEIVE, ComIPduHandleId=9, ComIPduGroupRef=FUSION_CAN1_Rx, ComIPduSignalGroupRef=GRCAN1_SG_ECAS_DM1_419351087R, ComPduIdRef=CAN1_ECAS_DM1_419351087R
          ComIPduCounter: ComIPduCounterSize=(unset), ComIPduCounterStartPosition=(unset)
          ComIPduReplication: ComIPduReplicationQuorum=(unset)
          ComTxIPdu: ComTxIPduClearUpdateBit=Transmit, ComTxIPduUnusedAreasDefault=0
        PDCAN1_EMC1_EM1_217050891R: ComIPduDirection=RECEIVE, ComIPduHandleId=10, ComIPduGroupRef=FUSION_CAN1_Rx, ComIPduSignalGroupRef=GRCAN1_SG_EMC1_EM1_217050891R, ComPduIdRef=CAN1_EMC1_EM1_217050891R
          ComIPduCounter: ComIPduCounterSize=(unset), ComIPduCounterStartPosition=(unset)
          ComIPduReplication: ComIPduReplicationQuorum=(unset)
          ComTxIPdu: ComTxIPduClearUpdateBit=Transmit, ComTxIPduUnusedAreasDefault=0
        PDCAN1_HRW_150892043R: ComIPduDirection=RECEIVE, ComIPduHandleId=11, ComIPduGroupRef=FUSION_CAN1_Rx, ComIPduSignalGroupRef=GRCAN1_SG_HRW_150892043R, ComPduIdRef=CAN1_HRW_150892043R
          ComIPduCounter: ComIPduCounterSize=(unset), ComIPduCounterStartPosition=(unset)
          ComIPduReplication: ComIPduReplicationQuorum=(unset)
          ComTxIPdu: ComTxIPduClearUpdateBit=Transmit, ComTxIPduUnusedAreasDefault=0
        PDCAN1_TC1_201392901R: ComIPduDirection=RECEIVE, ComIPduHandleId=12, ComIPduGroupRef=FUSION_CAN1_Rx, ComIPduSignalGroupRef=GRCAN1_SG_TC1_201392901R, ComPduIdRef=CAN1_TC1_201392901R
          ComIPduCounter: ComIPduCounterSize=(unset), ComIPduCounterStartPosition=(unset)
          ComIPduReplication: ComIPduReplicationQuorum=(unset)
          ComTxIPdu: ComTxIPduClearUpdateBit=Transmit, ComTxIPduUnusedAreasDefault=0
        PDCAN1_TPMS1_418517043R: ComIPduDirection=RECEIVE, ComIPduHandleId=13, ComIPduGroupRef=FUSION_CAN1_Rx, ComIPduSignalGroupRef=GRCAN1_SG_TPMS1_418517043R, ComPduIdRef=CAN1_TPMS1_418517043R
          ComIPduCounter: ComIPduCounterSize=(unset), ComIPduCounterStartPosition=(unset)
          ComIPduReplication: ComIPduReplicationQuorum=(unset)
          ComTxIPdu: ComTxIPduClearUpdateBit=Transmit, ComTxIPduUnusedAreasDefault=0
        PDCAN1_TPMS2_418517299R: ComIPduDirection=RECEIVE, ComIPduHandleId=14, ComIPduGroupRef=FUSION_CAN1_Rx, ComIPduSignalGroupRef=GRCAN1_SG_TPMS2_418517299R, ComPduIdRef=CAN1_TPMS2_418517299R
          ComIPduCounter: ComIPduCounterSize=(unset), ComIPduCounterStartPosition=(unset)
          ComIPduReplication: ComIPduReplicationQuorum=(unset)
          ComTxIPdu: ComTxIPduClearUpdateBit=Transmit, ComTxIPduUnusedAreasDefault=0
        PDCAN1_TPMS3_418517555R: ComIPduDirection=RECEIVE, ComIPduHandleId=15, ComIPduGroupRef=FUSION_CAN1_Rx, ComIPduSignalGroupRef=GRCAN1_SG_TPMS3_418517555R, ComPduIdRef=CAN1_TPMS3_418517555R
          ComIPduCounter: ComIPduCounterSize=(unset), ComIPduCounterStartPosition=(unset)
          ComIPduReplication: ComIPduReplicationQuorum=(unset)
          ComTxIPdu: ComTxIPduClearUpdateBit=Transmit, ComTxIPduUnusedAreasDefault=0
        PDCAN1_VDC1_419319563R: ComIPduDirection=RECEIVE, ComIPduHandleId=16, ComIPduGroupRef=FUSION_CAN1_Rx, ComIPduSignalGroupRef=GRCAN1_SG_VDC1_419319563R, ComPduIdRef=CAN1_VDC1_419319563R
          ComIPduCounter: ComIPduCounterSize=(unset), ComIPduCounterStartPosition=(unset)
          ComIPduReplication: ComIPduReplicationQuorum=(unset)
          ComTxIPdu: ComTxIPduClearUpdateBit=Transmit, ComTxIPduUnusedAreasDefault=0
        PDCAN2_IVI_C100_0_419140446R: ComIPduDirection=RECEIVE, ComIPduHandleId=17, ComIPduGroupRef=FUSION_CAN2_Rx, ComIPduSignalGroupRef=GRCAN2_SG_IVI_C100_0_419140446R, ComPduIdRef=CAN2_IVI_C100_0_419140446R
          ComIPduCounter: ComIPduCounterSize=(unset), ComIPduCounterStartPosition=(unset)
          ComIPduReplication: ComIPduReplicationQuorum=(unset)
          ComTxIPdu: ComTxIPduClearUpdateBit=Transmit, ComTxIPduUnusedAreasDefault=0
        PDCAN3_B2TM_Info_419382772R: ComIPduDirection=RECEIVE, ComIPduHandleId=18, ComIPduGroupRef=FUSION_CAN3_Rx, ComIPduSignalGroupRef=GRCAN3_SG_B2TM_Info_419382772R, ComPduIdRef=CAN3_B2TM_Info_419382772R
          ComIPduCounter: ComIPduCounterSize=(unset), ComIPduCounterStartPosition=(unset)
          ComIPduReplication: ComIPduReplicationQuorum=(unset)
          ComTxIPdu: ComTxIPduClearUpdateBit=Transmit, ComTxIPduUnusedAreasDefault=0
        PDCAN3_B2V_BattInfo1_417525747R: ComIPduDirection=RECEIVE, ComIPduHandleId=19, ComIPduGroupRef=FUSION_CAN3_Rx, ComIPduSignalGroupRef=GRCAN3_SG_B2V_BattInfo1_417525747R, ComPduIdRef=CAN3_B2V_BattInfo1_417525747R
          ComIPduCounter: ComIPduCounterSize=(unset), ComIPduCounterStartPosition=(unset)
          ComIPduReplication: ComIPduReplicationQuorum=(unset)
          ComTxIPdu: ComTxIPduClearUpdateBit=Transmit, ComTxIPduUnusedAreasDefault=0
        PDCAN3_B2V_CurrentLimit_415559667R: ComIPduDirection=RECEIVE, ComIPduHandleId=20, ComIPduGroupRef=FUSION_CAN3_Rx, ComIPduSignalGroupRef=GRCAN3_SG_B2V_CurrentLimit_415559667R, ComPduIdRef=CAN3_B2V_CurrentLimit_415559667R
          ComIPduCounter: ComIPduCounterSize=(unset), ComIPduCounterStartPosition=(unset)
          ComIPduReplication: ComIPduReplicationQuorum=(unset)
          ComTxIPdu: ComTxIPduClearUpdateBit=Transmit, ComTxIPduUnusedAreasDefault=0
        PDCAN3_B2V_Fult1_32960_411168755R: ComIPduDirection=RECEIVE, ComIPduHandleId=21, ComIPduGroupRef=FUSION_CAN3_Rx, ComIPduSignalGroupRef=GRCAN3_SG_B2V_Fult1_32960_411168755R, ComPduIdRef=CAN3_B2V_Fult1_32960_411168755R
          ComIPduCounter: ComIPduCounterSize=(unset), ComIPduCounterStartPosition=(unset)
          ComIPduReplication: ComIPduReplicationQuorum=(unset)
          ComTxIPdu: ComTxIPduClearUpdateBit=Transmit, ComTxIPduUnusedAreasDefault=0
        PDCAN3_B2V_ST1_411299827R: ComIPduDirection=RECEIVE, ComIPduHandleId=22, ComIPduGroupRef=FUSION_CAN3_Rx, ComIPduSignalGroupRef=GRCAN3_SG_B2V_ST1_411299827R, ComPduIdRef=CAN3_B2V_ST1_411299827R
          ComIPduCounter: ComIPduCounterSize=(unset), ComIPduCounterStartPosition=(unset)
          ComIPduReplication: ComIPduReplicationQuorum=(unset)
          ComTxIPdu: ComTxIPduClearUpdateBit=Transmit, ComTxIPduUnusedAreasDefault=0
        PDCAN3_B2V_ST2_411365363R: ComIPduDirection=RECEIVE, ComIPduHandleId=23, ComIPduGroupRef=FUSION_CAN3_Rx, ComIPduSignalGroupRef=GRCAN3_SG_B2V_ST2_411365363R, ComPduIdRef=CAN3_B2V_ST2_411365363R
          ComIPduCounter: ComIPduCounterSize=(unset), ComIPduCounterStartPosition=(unset)
          ComIPduReplication: ComIPduReplicationQuorum=(unset)
          ComTxIPdu: ComTxIPduClearUpdateBit=Transmit, ComTxIPduUnusedAreasDefault=0
        PDCAN3_B2V_ST4_411496435R: ComIPduDirection=RECEIVE, ComIPduHandleId=24, ComIPduGroupRef=FUSION_CAN3_Rx, ComIPduSignalGroupRef=GRCAN3_SG_B2V_ST4_411496435R, ComPduIdRef=CAN3_B2V_ST4_411496435R
          ComIPduCounter: ComIPduCounterSize=(unset), ComIPduCounterStartPosition=(unset)
          ComIPduReplication: ComIPduReplicationQuorum=(unset)
          ComTxIPdu: ComTxIPduClearUpdateBit=Transmit, ComTxIPduUnusedAreasDefault=0
        PDCAN3_B2V_ST5_411561971R: ComIPduDirection=RECEIVE, ComIPduHandleId=25, ComIPduGroupRef=FUSION_CAN3_Rx, ComIPduSignalGroupRef=GRCAN3_SG_B2V_ST5_411561971R, ComPduIdRef=CAN3_B2V_ST5_411561971R
          ComIPduCounter: ComIPduCounterSize=(unset), ComIPduCounterStartPosition=(unset)
          ComIPduReplication: ComIPduReplicationQuorum=(unset)
          ComTxIPdu: ComTxIPduClearUpdateBit=Transmit, ComTxIPduUnusedAreasDefault=0
        PDCAN3_EWP1_419425849R: ComIPduDirection=RECEIVE, ComIPduHandleId=26, ComIPduGroupRef=FUSION_CAN3_Rx, ComIPduSignalGroupRef=GRCAN3_SG_EWP1_419425849R, ComPduIdRef=CAN3_EWP1_419425849R
          ComIPduCounter: ComIPduCounterSize=(unset), ComIPduCounterStartPosition=(unset)
          ComIPduReplication: ComIPduReplicationQuorum=(unset)
          ComTxIPdu: ComTxIPduClearUpdateBit=Transmit, ComTxIPduUnusedAreasDefault=0
        PDCAN3_TM_MCUSta1_218038277R: ComIPduDirection=RECEIVE, ComIPduHandleId=27, ComIPduGroupRef=FUSION_CAN3_Rx, ComIPduSignalGroupRef=GRCAN3_SG_TM_MCUSta1_218038277R, ComPduIdRef=CAN3_TM_MCUSta1_218038277R
          ComIPduCounter: ComIPduCounterSize=(unset), ComIPduCounterStartPosition=(unset)
          ComIPduReplication: ComIPduReplicationQuorum=(unset)
          ComTxIPdu: ComTxIPduClearUpdateBit=Transmit, ComTxIPduUnusedAreasDefault=0
        PDCAN3_TM_MCUSta2_218038533R: ComIPduDirection=RECEIVE, ComIPduHandleId=28, ComIPduGroupRef=FUSION_CAN3_Rx, ComIPduSignalGroupRef=GRCAN3_SG_TM_MCUSta2_218038533R, ComPduIdRef=CAN3_TM_MCUSta2_218038533R
          ComIPduCounter: ComIPduCounterSize=(unset), ComIPduCounterStartPosition=(unset)
          ComIPduReplication: ComIPduReplicationQuorum=(unset)
          ComTxIPdu: ComTxIPduClearUpdateBit=Transmit, ComTxIPduUnusedAreasDefault=0
        PDCAN3_TM_MCUSta3_218038789R: ComIPduDirection=RECEIVE, ComIPduHandleId=29, ComIPduGroupRef=FUSION_CAN3_Rx, ComIPduSignalGroupRef=GRCAN3_SG_TM_MCUSta3_218038789R, ComPduIdRef=CAN3_TM_MCUSta3_218038789R
          ComIPduCounter: ComIPduCounterSize=(unset), ComIPduCounterStartPosition=(unset)
          ComIPduReplication: ComIPduReplicationQuorum=(unset)
          ComTxIPdu: ComTxIPduClearUpdateBit=Transmit, ComTxIPduUnusedAreasDefault=0
        PDCAN4_ZFR_C100_0_515R: ComIPduDirection=RECEIVE, ComIPduHandleId=30, ComIPduGroupRef=FUSION_CAN4_Rx, ComIPduSignalGroupRef=GRCAN4_SG_ZFR_C100_0_515R, ComPduIdRef=CAN4_ZFR_C100_0_515R
          ComIPduCounter: ComIPduCounterSize=(unset), ComIPduCounterStartPosition=(unset)
          ComIPduReplication: ComIPduReplicationQuorum=(unset)
          ComTxIPdu: ComTxIPduClearUpdateBit=Transmit, ComTxIPduUnusedAreasDefault=0
        PDCAN4_ZFR_C5000_0_513R: ComIPduDirection=RECEIVE, ComIPduHandleId=31, ComIPduGroupRef=FUSION_CAN4_Rx, ComIPduSignalGroupRef=GRCAN4_SG_ZFR_C5000_0_513R, ComPduIdRef=CAN4_ZFR_C5000_0_513R
          ComIPduCounter: ComIPduCounterSize=(unset), ComIPduCounterStartPosition=(unset)
          ComIPduReplication: ComIPduReplicationQuorum=(unset)
          ComTxIPdu: ComTxIPduClearUpdateBit=Transmit, ComTxIPduUnusedAreasDefault=0
        PDCAN4_ZFR_CE100_0_517R: ComIPduDirection=RECEIVE, ComIPduHandleId=32, ComIPduGroupRef=FUSION_CAN4_Rx, ComIPduSignalGroupRef=GRCAN4_SG_ZFR_CE100_0_517R, ComPduIdRef=CAN4_ZFR_CE100_0_517R
          ComIPduCounter: ComIPduCounterSize=(unset), ComIPduCounterStartPosition=(unset)
          ComIPduReplication: ComIPduReplicationQuorum=(unset)
          ComTxIPdu: ComTxIPduClearUpdateBit=Transmit, ComTxIPduUnusedAreasDefault=0
        PDCAN4_ZRR_C5000_0_514R: ComIPduDirection=RECEIVE, ComIPduHandleId=33, ComIPduGroupRef=FUSION_CAN4_Rx, ComIPduSignalGroupRef=GRCAN4_SG_ZRR_C5000_0_514R, ComPduIdRef=CAN4_ZRR_C5000_0_514R
          ComIPduCounter: ComIPduCounterSize=(unset), ComIPduCounterStartPosition=(unset)
          ComIPduReplication: ComIPduReplicationQuorum=(unset)
          ComTxIPdu: ComTxIPduClearUpdateBit=Transmit, ComTxIPduUnusedAreasDefault=0
        PDCAN4_ZRR_CE100_0_419319532R: ComIPduDirection=RECEIVE, ComIPduHandleId=34, ComIPduGroupRef=FUSION_CAN4_Rx, ComIPduSignalGroupRef=GRCAN4_SG_ZRR_CE100_0_419319532R, ComPduIdRef=CAN4_ZRR_CE100_0_419319532R
          ComIPduCounter: ComIPduCounterSize=(unset), ComIPduCounterStartPosition=(unset)
          ComIPduReplication: ComIPduReplicationQuorum=(unset)
          ComTxIPdu: ComTxIPduClearUpdateBit=Transmit, ComTxIPduUnusedAreasDefault=0
        PDCAN4_ZRR_CE100_1_518R: ComIPduDirection=RECEIVE, ComIPduHandleId=35, ComIPduGroupRef=FUSION_CAN4_Rx, ComIPduSignalGroupRef=GRCAN4_SG_ZRR_CE100_1_518R, ComPduIdRef=CAN4_ZRR_CE100_1_518R
          ComIPduCounter: ComIPduCounterSize=(unset), ComIPduCounterStartPosition=(unset)
          ComIPduReplication: ComIPduReplicationQuorum=(unset)
          ComTxIPdu: ComTxIPduClearUpdateBit=Transmit, ComTxIPduUnusedAreasDefault=0
        PDCAN4_zGW_CANRr1_C50_0_522R: ComIPduDirection=RECEIVE, ComIPduHandleId=36, ComIPduGroupRef=FUSION_CAN4_Rx, ComIPduSignalGroupRef=GRCAN4_SG_zGW_CANRr1_C50_0_522R, ComPduIdRef=CAN4_zGW_CANRr1_C50_0_522R
          ComIPduCounter: ComIPduCounterSize=(unset), ComIPduCounterStartPosition=(unset)
          ComIPduReplication: ComIPduReplicationQuorum=(unset)
          ComTxIPdu: ComTxIPduClearUpdateBit=Transmit, ComTxIPduUnusedAreasDefault=0
        PDCAN1_FD1_C1000_0_419343920T: ComIPduDirection=SEND, ComIPduHandleId=0, ComIPduGroupRef=FUSION_CAN1_Tx, ComIPduSignalGroupRef=GRCAN1_SG_FD1_C1000_0_419343920T, ComPduIdRef=CAN1_FD1_C1000_0_419343920T
          ComIPduCounter: ComIPduCounterSize=(unset), ComIPduCounterStartPosition=(unset)
          ComIPduReplication: ComIPduReplicationQuorum=(unset)
          ComTxIPdu: ComMinimumDelayTime=0.0, ComTxIPduClearUpdateBit=Transmit, ComTxIPduUnusedAreasDefault=0
            ComTxModeTrue
              ComTxMode: ComTxModeMode=PERIODIC, ComTxModeNumberOfRepetitions=1, ComTxModeRepetitionPeriod=1.0, ComTxModeTimeOffset=0.0, ComTxModeTimePeriod=1.0
        PDCAN1_FD1_C100_0_419318275T: ComIPduDirection=SEND, ComIPduHandleId=1, ComIPduGroupRef=FUSION_CAN1_Tx, ComIPduSignalGroupRef=GRCAN1_SG_FD1_C100_0_419318275T, ComPduIdRef=CAN1_FD1_C100_0_419318275T
          ComIPduCounter: ComIPduCounterSize=(unset), ComIPduCounterStartPosition=(unset)
          ComIPduReplication: ComIPduReplicationQuorum=(unset)
          ComTxIPdu: ComMinimumDelayTime=0.0, ComTxIPduClearUpdateBit=Transmit, ComTxIPduUnusedAreasDefault=0
            ComTxModeTrue
              ComTxMode: ComTxModeMode=PERIODIC, ComTxModeNumberOfRepetitions=1, ComTxModeRepetitionPeriod=1.0, ComTxModeTimeOffset=0.0, ComTxModeTimePeriod=0.1
        PDCAN1_FD1_C100_1_419389483T: ComIPduDirection=SEND, ComIPduHandleId=2, ComIPduGroupRef=FUSION_CAN1_Tx, ComIPduSignalGroupRef=GRCAN1_SG_FD1_C100_1_419389483T, ComPduIdRef=CAN1_FD1_C100_1_419389483T
          ComIPduCounter: ComIPduCounterSize=(unset), ComIPduCounterStartPosition=(unset)
          ComIPduReplication: ComIPduReplicationQuorum=(unset)
          ComTxIPdu: ComMinimumDelayTime=0.0, ComTxIPduClearUpdateBit=Transmit, ComTxIPduUnusedAreasDefault=0
            ComTxModeTrue
              ComTxMode: ComTxModeMode=PERIODIC, ComTxModeNumberOfRepetitions=1, ComTxModeRepetitionPeriod=1.0, ComTxModeTimeOffset=0.0, ComTxModeTimePeriod=0.1
        PDCAN1_FD1_C100_2_435160528T: ComIPduDirection=SEND, ComIPduHandleId=3, ComIPduGroupRef=FUSION_CAN1_Tx, ComIPduSignalGroupRef=GRCAN1_SG_FD1_C100_2_435160528T, ComPduIdRef=CAN1_FD1_C100_2_435160528T
          ComIPduCounter: ComIPduCounterSize=(unset), ComIPduCounterStartPosition=(unset)
          ComIPduReplication: ComIPduReplicationQuorum=(unset)
          ComTxIPdu: ComMinimumDelayTime=0.0, ComTxIPduClearUpdateBit=Transmit, ComTxIPduUnusedAreasDefault=0
            ComTxModeTrue
              ComTxMode: ComTxModeMode=PERIODIC, ComTxModeNumberOfRepetitions=1, ComTxModeRepetitionPeriod=1.0, ComTxModeTimeOffset=0.0, ComTxModeTimePeriod=0.1
        PDCAN1_FD1_C100_3_419361024T: ComIPduDirection=SEND, ComIPduHandleId=4, ComIPduGroupRef=FUSION_CAN1_Tx, ComIPduSignalGroupRef=GRCAN1_SG_FD1_C100_3_419361024T, ComPduIdRef=CAN1_FD1_C100_3_419361024T
          ComIPduCounter: ComIPduCounterSize=(unset), ComIPduCounterStartPosition=(unset)
          ComIPduReplication: ComIPduReplicationQuorum=(unset)
          ComTxIPdu: ComMinimumDelayTime=0.0, ComTxIPduClearUpdateBit=Transmit, ComTxIPduUnusedAreasDefault=0
            ComTxModeTrue
              ComTxMode: ComTxModeMode=PERIODIC, ComTxModeNumberOfRepetitions=1, ComTxModeRepetitionPeriod=1.0, ComTxModeTimeOffset=0.0, ComTxModeTimePeriod=0.1
        PDCAN1_FD1_C10_0_207737041T: ComIPduDirection=SEND, ComIPduHandleId=5, ComIPduGroupRef=FUSION_CAN1_Tx, ComIPduSignalGroupRef=GRCAN1_SG_FD1_C10_0_207737041T, ComPduIdRef=CAN1_FD1_C10_0_207737041T
          ComIPduCounter: ComIPduCounterSize=(unset), ComIPduCounterStartPosition=(unset)
          ComIPduReplication: ComIPduReplicationQuorum=(unset)
          ComTxIPdu: ComMinimumDelayTime=0.0, ComTxIPduClearUpdateBit=Transmit, ComTxIPduUnusedAreasDefault=0
            ComTxModeTrue
              ComTxMode: ComTxModeMode=PERIODIC, ComTxModeNumberOfRepetitions=1, ComTxModeRepetitionPeriod=1.0, ComTxModeTimeOffset=0.0, ComTxModeTimePeriod=0.01
        PDCAN1_FD1_C10_1_419373295T: ComIPduDirection=SEND, ComIPduHandleId=6, ComIPduGroupRef=FUSION_CAN1_Tx, ComIPduSignalGroupRef=GRCAN1_SG_FD1_C10_1_419373295T, ComPduIdRef=CAN1_FD1_C10_1_419373295T
          ComIPduCounter: ComIPduCounterSize=(unset), ComIPduCounterStartPosition=(unset)
          ComIPduReplication: ComIPduReplicationQuorum=(unset)
          ComTxIPdu: ComMinimumDelayTime=0.0, ComTxIPduClearUpdateBit=Transmit, ComTxIPduUnusedAreasDefault=0
            ComTxModeTrue
              ComTxMode: ComTxModeMode=PERIODIC, ComTxModeNumberOfRepetitions=1, ComTxModeRepetitionPeriod=1.0, ComTxModeTimeOffset=0.0, ComTxModeTimePeriod=0.01
        PDCAN1_FD1_C200_0_418382831T: ComIPduDirection=SEND, ComIPduHandleId=7, ComIPduGroupRef=FUSION_CAN1_Tx, ComIPduSignalGroupRef=GRCAN1_SG_FD1_C200_0_418382831T, ComPduIdRef=CAN1_FD1_C200_0_418382831T
          ComIPduCounter: ComIPduCounterSize=(unset), ComIPduCounterStartPosition=(unset)
          ComIPduReplication: ComIPduReplicationQuorum=(unset)
          ComTxIPdu: ComMinimumDelayTime=0.0, ComTxIPduClearUpdateBit=Transmit, ComTxIPduUnusedAreasDefault=0
            ComTxModeTrue
              ComTxMode: ComTxModeMode=PERIODIC, ComTxModeNumberOfRepetitions=1, ComTxModeRepetitionPeriod=1.0, ComTxModeTimeOffset=0.0, ComTxModeTimePeriod=0.2
        PDCAN1_FD1_C20_0_207802577T: ComIPduDirection=SEND, ComIPduHandleId=8, ComIPduGroupRef=FUSION_CAN1_Tx, ComIPduSignalGroupRef=GRCAN1_SG_FD1_C20_0_207802577T, ComPduIdRef=CAN1_FD1_C20_0_207802577T
          ComIPduCounter: ComIPduCounterSize=(unset), ComIPduCounterStartPosition=(unset)
          ComIPduReplication: ComIPduReplicationQuorum=(unset)
          ComTxIPdu: ComMinimumDelayTime=0.0, ComTxIPduClearUpdateBit=Transmit, ComTxIPduUnusedAreasDefault=0
            ComTxModeTrue
              ComTxMode: ComTxModeMode=PERIODIC, ComTxModeNumberOfRepetitions=1, ComTxModeRepetitionPeriod=1.0, ComTxModeTimeOffset=0.0, ComTxModeTimePeriod=0.02
        PDCAN1_FD1_C250_0_419356655T: ComIPduDirection=SEND, ComIPduHandleId=9, ComIPduGroupRef=FUSION_CAN1_Tx, ComIPduSignalGroupRef=GRCAN1_SG_FD1_C250_0_419356655T, ComPduIdRef=CAN1_FD1_C250_0_419356655T
          ComIPduCounter: ComIPduCounterSize=(unset), ComIPduCounterStartPosition=(unset)
          ComIPduReplication: ComIPduReplicationQuorum=(unset)
          ComTxIPdu: ComMinimumDelayTime=0.0, ComTxIPduClearUpdateBit=Transmit, ComTxIPduUnusedAreasDefault=0
            ComTxModeTrue
              ComTxMode: ComTxModeMode=PERIODIC, ComTxModeNumberOfRepetitions=1, ComTxModeRepetitionPeriod=1.0, ComTxModeTimeOffset=0.0, ComTxModeTimePeriod=0.25
        PDCAN1_FD1_C5000_0_419357167T: ComIPduDirection=SEND, ComIPduHandleId=10, ComIPduGroupRef=FUSION_CAN1_Tx, ComIPduSignalGroupRef=GRCAN1_SG_FD1_C5000_0_419357167T, ComPduIdRef=CAN1_FD1_C5000_0_419357167T
          ComIPduCounter: ComIPduCounterSize=(unset), ComIPduCounterStartPosition=(unset)
          ComIPduReplication: ComIPduReplicationQuorum=(unset)
          ComTxIPdu: ComMinimumDelayTime=0.0, ComTxIPduClearUpdateBit=Transmit, ComTxIPduUnusedAreasDefault=0
            ComTxModeTrue
              ComTxMode: ComTxModeMode=PERIODIC, ComTxModeNumberOfRepetitions=1, ComTxModeRepetitionPeriod=1.0, ComTxModeTimeOffset=0.0, ComTxModeTimePeriod=5.0
        PDCAN1_FD1_C5000_1_419357679T: ComIPduDirection=SEND, ComIPduHandleId=11, ComIPduGroupRef=FUSION_CAN1_Tx, ComIPduSignalGroupRef=GRCAN1_SG_FD1_C5000_1_419357679T, ComPduIdRef=CAN1_FD1_C5000_1_419357679T
          ComIPduCounter: ComIPduCounterSize=(unset), ComIPduCounterStartPosition=(unset)
          ComIPduReplication: ComIPduReplicationQuorum=(unset)
          ComTxIPdu: ComMinimumDelayTime=0.0, ComTxIPduClearUpdateBit=Transmit, ComTxIPduUnusedAreasDefault=0
            ComTxModeTrue
              ComTxMode: ComTxModeMode=PERIODIC, ComTxModeNumberOfRepetitions=1, ComTxModeRepetitionPeriod=1.0, ComTxModeTimeOffset=0.0, ComTxModeTimePeriod=5.0
        PDCAN1_FD1_C50_0_418383107T: ComIPduDirection=SEND, ComIPduHandleId=12, ComIPduGroupRef=FUSION_CAN1_Tx, ComIPduSignalGroupRef=GRCAN1_SG_FD1_C50_0_418383107T, ComPduIdRef=CAN1_FD1_C50_0_418383107T
          ComIPduCounter: ComIPduCounterSize=(unset), ComIPduCounterStartPosition=(unset)
          ComIPduReplication: ComIPduReplicationQuorum=(unset)
          ComTxIPdu: ComMinimumDelayTime=0.0, ComTxIPduClearUpdateBit=Transmit, ComTxIPduUnusedAreasDefault=0
            ComTxModeTrue
              ComTxMode: ComTxModeMode=PERIODIC, ComTxModeNumberOfRepetitions=1, ComTxModeRepetitionPeriod=1.0, ComTxModeTimeOffset=0.0, ComTxModeTimePeriod=0.05
        PDCAN1_FD1_C50_1_217056000T: ComIPduDirection=SEND, ComIPduHandleId=13, ComIPduGroupRef=FUSION_CAN1_Tx, ComIPduSignalGroupRef=GRCAN1_SG_FD1_C50_1_217056000T, ComPduIdRef=CAN1_FD1_C50_1_217056000T
          ComIPduCounter: ComIPduCounterSize=(unset), ComIPduCounterStartPosition=(unset)
          ComIPduReplication: ComIPduReplicationQuorum=(unset)
          ComTxIPdu: ComMinimumDelayTime=0.0, ComTxIPduClearUpdateBit=Transmit, ComTxIPduUnusedAreasDefault=0
            ComTxModeTrue
              ComTxMode: ComTxModeMode=PERIODIC, ComTxModeNumberOfRepetitions=1, ComTxModeRepetitionPeriod=1.0, ComTxModeTimeOffset=0.0, ComTxModeTimePeriod=0.05
        PDCAN1_FD1_C80_0_418382339T: ComIPduDirection=SEND, ComIPduHandleId=14, ComIPduGroupRef=FUSION_CAN1_Tx, ComIPduSignalGroupRef=GRCAN1_SG_FD1_C80_0_418382339T, ComPduIdRef=CAN1_FD1_C80_0_418382339T
          ComIPduCounter: ComIPduCounterSize=(unset), ComIPduCounterStartPosition=(unset)
          ComIPduReplication: ComIPduReplicationQuorum=(unset)
          ComTxIPdu: ComMinimumDelayTime=0.0, ComTxIPduClearUpdateBit=Transmit, ComTxIPduUnusedAreasDefault=0
            ComTxModeTrue
              ComTxMode: ComTxModeMode=PERIODIC, ComTxModeNumberOfRepetitions=1, ComTxModeRepetitionPeriod=1.0, ComTxModeTimeOffset=0.0, ComTxModeTimePeriod=0.08
        PDCAN1_FD1_CE100_0_418119663T: ComIPduDirection=SEND, ComIPduHandleId=15, ComIPduGroupRef=FUSION_CAN1_Tx, ComIPduSignalGroupRef=GRCAN1_SG_FD1_CE100_0_418119663T, ComPduIdRef=CAN1_FD1_CE100_0_418119663T
          ComIPduCounter: ComIPduCounterSize=(unset), ComIPduCounterStartPosition=(unset)
          ComIPduReplication: ComIPduReplicationQuorum=(unset)
          ComTxIPdu: ComMinimumDelayTime=0.0, ComTxIPduClearUpdateBit=Transmit, ComTxIPduUnusedAreasDefault=0
            ComTxModeTrue
              ComTxMode: ComTxModeMode=DIRECT, ComTxModeNumberOfRepetitions=0, ComTxModeRepetitionPeriod=1.0, ComTxModeTimeOffset=0.0, ComTxModeTimePeriod=0.0
        PDCAN1_FD1_CE100_1_418185199T: ComIPduDirection=SEND, ComIPduHandleId=16, ComIPduGroupRef=FUSION_CAN1_Tx, ComIPduSignalGroupRef=GRCAN1_SG_FD1_CE100_1_418185199T, ComPduIdRef=CAN1_FD1_CE100_1_418185199T
          ComIPduCounter: ComIPduCounterSize=(unset), ComIPduCounterStartPosition=(unset)
          ComIPduReplication: ComIPduReplicationQuorum=(unset)
          ComTxIPdu: ComMinimumDelayTime=0.0, ComTxIPduClearUpdateBit=Transmit, ComTxIPduUnusedAreasDefault=0
            ComTxModeTrue
              ComTxMode: ComTxModeMode=DIRECT, ComTxModeNumberOfRepetitions=0, ComTxModeRepetitionPeriod=1.0, ComTxModeTimeOffset=0.0, ComTxModeTimePeriod=0.0
        PDCAN1_FD1_CE100_2_419038649T: ComIPduDirection=SEND, ComIPduHandleId=17, ComIPduGroupRef=FUSION_CAN1_Tx, ComIPduSignalGroupRef=GRCAN1_SG_FD1_CE100_2_419038649T, ComPduIdRef=CAN1_FD1_CE100_2_419038649T
          ComIPduCounter: ComIPduCounterSize=(unset), ComIPduCounterStartPosition=(unset)
          ComIPduReplication: ComIPduReplicationQuorum=(unset)
          ComTxIPdu: ComMinimumDelayTime=0.0, ComTxIPduClearUpdateBit=Transmit, ComTxIPduUnusedAreasDefault=0
            ComTxModeTrue
              ComTxMode: ComTxModeMode=MIXED, ComTxModeNumberOfRepetitions=0, ComTxModeRepetitionPeriod=1.0, ComTxModeTimeOffset=0.0, ComTxModeTimePeriod=0.1
        PDCAN2_FD2_C1000_0_526T: ComIPduDirection=SEND, ComIPduHandleId=18, ComIPduGroupRef=FUSION_CAN2_Tx, ComIPduSignalGroupRef=GRCAN2_SG_FD2_C1000_0_526T, ComPduIdRef=CAN2_FD2_C1000_0_526T
          ComIPduCounter: ComIPduCounterSize=(unset), ComIPduCounterStartPosition=(unset)
          ComIPduReplication: ComIPduReplicationQuorum=(unset)
          ComTxIPdu: ComMinimumDelayTime=0.0, ComTxIPduClearUpdateBit=Transmit, ComTxIPduUnusedAreasDefault=0
            ComTxModeTrue
              ComTxMode: ComTxModeMode=PERIODIC, ComTxModeNumberOfRepetitions=1, ComTxModeRepetitionPeriod=1.0, ComTxModeTimeOffset=0.0, ComTxModeTimePeriod=1.0
        PDCAN2_FD2_C10_0_207737041T: ComIPduDirection=SEND, ComIPduHandleId=19, ComIPduGroupRef=FUSION_CAN2_Tx, ComIPduSignalGroupRef=GRCAN2_SG_FD2_C10_0_207737041T, ComPduIdRef=CAN2_FD2_C10_0_207737041T
          ComIPduCounter: ComIPduCounterSize=(unset), ComIPduCounterStartPosition=(unset)
          ComIPduReplication: ComIPduReplicationQuorum=(unset)
          ComTxIPdu: ComMinimumDelayTime=0.0, ComTxIPduClearUpdateBit=Transmit, ComTxIPduUnusedAreasDefault=0
            ComTxModeTrue
              ComTxMode: ComTxModeMode=PERIODIC, ComTxModeNumberOfRepetitions=1, ComTxModeRepetitionPeriod=1.0, ComTxModeTimeOffset=0.0, ComTxModeTimePeriod=0.01
        PDCAN2_FD2_C200_0_527T: ComIPduDirection=SEND, ComIPduHandleId=20, ComIPduGroupRef=FUSION_CAN2_Tx, ComIPduSignalGroupRef=GRCAN2_SG_FD2_C200_0_527T, ComPduIdRef=CAN2_FD2_C200_0_527T
          ComIPduCounter: ComIPduCounterSize=(unset), ComIPduCounterStartPosition=(unset)
          ComIPduReplication: ComIPduReplicationQuorum=(unset)
          ComTxIPdu: ComMinimumDelayTime=0.0, ComTxIPduClearUpdateBit=Transmit, ComTxIPduUnusedAreasDefault=0
            ComTxModeTrue
              ComTxMode: ComTxModeMode=PERIODIC, ComTxModeNumberOfRepetitions=1, ComTxModeRepetitionPeriod=1.0, ComTxModeTimeOffset=0.0, ComTxModeTimePeriod=0.2
        PDCAN2_FD2_C500_0_419038487T: ComIPduDirection=SEND, ComIPduHandleId=21, ComIPduGroupRef=FUSION_CAN2_Tx, ComIPduSignalGroupRef=GRCAN2_SG_FD2_C500_0_419038487T, ComPduIdRef=CAN2_FD2_C500_0_419038487T
          ComIPduCounter: ComIPduCounterSize=(unset), ComIPduCounterStartPosition=(unset)
          ComIPduReplication: ComIPduReplicationQuorum=(unset)
          ComTxIPdu: ComMinimumDelayTime=0.0, ComTxIPduClearUpdateBit=Transmit, ComTxIPduUnusedAreasDefault=0
            ComTxModeTrue
              ComTxMode: ComTxModeMode=PERIODIC, ComTxModeNumberOfRepetitions=1, ComTxModeRepetitionPeriod=1.0, ComTxModeTimeOffset=0.0, ComTxModeTimePeriod=0.5
        PDCAN2_FD2_C50_0_218051930T: ComIPduDirection=SEND, ComIPduHandleId=22, ComIPduGroupRef=FUSION_CAN2_Tx, ComIPduSignalGroupRef=GRCAN2_SG_FD2_C50_0_218051930T, ComPduIdRef=CAN2_FD2_C50_0_218051930T
          ComIPduCounter: ComIPduCounterSize=(unset), ComIPduCounterStartPosition=(unset)
          ComIPduReplication: ComIPduReplicationQuorum=(unset)
          ComTxIPdu: ComMinimumDelayTime=0.0, ComTxIPduClearUpdateBit=Transmit, ComTxIPduUnusedAreasDefault=0
            ComTxModeTrue
              ComTxMode: ComTxModeMode=PERIODIC, ComTxModeNumberOfRepetitions=1, ComTxModeRepetitionPeriod=1.0, ComTxModeTimeOffset=0.0, ComTxModeTimePeriod=0.05
        PDCAN2_FD2_CE100_0_521T: ComIPduDirection=SEND, ComIPduHandleId=23, ComIPduGroupRef=FUSION_CAN2_Tx, ComIPduSignalGroupRef=GRCAN2_SG_FD2_CE100_0_521T, ComPduIdRef=CAN2_FD2_CE100_0_521T
          ComIPduCounter: ComIPduCounterSize=(unset), ComIPduCounterStartPosition=(unset)
          ComIPduReplication: ComIPduReplicationQuorum=(unset)
          ComTxIPdu: ComMinimumDelayTime=0.0, ComTxIPduClearUpdateBit=Transmit, ComTxIPduUnusedAreasDefault=0
            ComTxModeTrue
              ComTxMode: ComTxModeMode=MIXED, ComTxModeNumberOfRepetitions=0, ComTxModeRepetitionPeriod=1.0, ComTxModeTimeOffset=0.0, ComTxModeTimePeriod=0.1
        PDCAN2_GW2_C100_0_523T: ComIPduDirection=SEND, ComIPduHandleId=24, ComIPduGroupRef=FUSION_CAN2_Tx, ComIPduSignalGroupRef=GRCAN2_SG_GW2_C100_0_523T, ComPduIdRef=CAN2_GW2_C100_0_523T
          ComIPduCounter: ComIPduCounterSize=(unset), ComIPduCounterStartPosition=(unset)
          ComIPduReplication: ComIPduReplicationQuorum=(unset)
          ComTxIPdu: ComMinimumDelayTime=0.0, ComTxIPduClearUpdateBit=Transmit, ComTxIPduUnusedAreasDefault=0
            ComTxModeTrue
              ComTxMode: ComTxModeMode=PERIODIC, ComTxModeNumberOfRepetitions=1, ComTxModeRepetitionPeriod=1.0, ComTxModeTimeOffset=0.0, ComTxModeTimePeriod=0.1
        PDCAN3_FD3_C100_0_402846703T: ComIPduDirection=SEND, ComIPduHandleId=25, ComIPduGroupRef=FUSION_CAN3_Tx, ComIPduSignalGroupRef=GRCAN3_SG_FD3_C100_0_402846703T, ComPduIdRef=CAN3_FD3_C100_0_402846703T
          ComIPduCounter: ComIPduCounterSize=(unset), ComIPduCounterStartPosition=(unset)
          ComIPduReplication: ComIPduReplicationQuorum=(unset)
          ComTxIPdu: ComMinimumDelayTime=0.0, ComTxIPduClearUpdateBit=Transmit, ComTxIPduUnusedAreasDefault=0
            ComTxModeTrue
              ComTxMode: ComTxModeMode=PERIODIC, ComTxModeNumberOfRepetitions=1, ComTxModeRepetitionPeriod=1.0, ComTxModeTimeOffset=0.0, ComTxModeTimePeriod=0.1
        PDCAN3_FD3_C10_0_217121232T: ComIPduDirection=SEND, ComIPduHandleId=26, ComIPduGroupRef=FUSION_CAN3_Tx, ComIPduSignalGroupRef=GRCAN3_SG_FD3_C10_0_217121232T, ComPduIdRef=CAN3_FD3_C10_0_217121232T
          ComIPduCounter: ComIPduCounterSize=(unset), ComIPduCounterStartPosition=(unset)
          ComIPduReplication: ComIPduReplicationQuorum=(unset)
          ComTxIPdu: ComMinimumDelayTime=0.0, ComTxIPduClearUpdateBit=Transmit, ComTxIPduUnusedAreasDefault=0
            ComTxModeTrue
              ComTxMode: ComTxModeMode=PERIODIC, ComTxModeNumberOfRepetitions=1, ComTxModeRepetitionPeriod=1.0, ComTxModeTimeOffset=0.0, ComTxModeTimePeriod=0.01
        PDCAN3_FD3_C10_1_218039791T: ComIPduDirection=SEND, ComIPduHandleId=27, ComIPduGroupRef=FUSION_CAN3_Tx, ComIPduSignalGroupRef=GRCAN3_SG_FD3_C10_1_218039791T, ComPduIdRef=CAN3_FD3_C10_1_218039791T
          ComIPduCounter: ComIPduCounterSize=(unset), ComIPduCounterStartPosition=(unset)
          ComIPduReplication: ComIPduReplicationQuorum=(unset)
          ComTxIPdu: ComMinimumDelayTime=0.0, ComTxIPduClearUpdateBit=Transmit, ComTxIPduUnusedAreasDefault=0
            ComTxModeTrue
              ComTxMode: ComTxModeMode=PERIODIC, ComTxModeNumberOfRepetitions=1, ComTxModeRepetitionPeriod=1.0, ComTxModeTimeOffset=0.0, ComTxModeTimePeriod=0.01
        PDCAN3_FD3_C200_0_418382831T: ComIPduDirection=SEND, ComIPduHandleId=28, ComIPduGroupRef=FUSION_CAN3_Tx, ComIPduSignalGroupRef=GRCAN3_SG_FD3_C200_0_418382831T, ComPduIdRef=CAN3_FD3_C200_0_418382831T
          ComIPduCounter: ComIPduCounterSize=(unset), ComIPduCounterStartPosition=(unset)
          ComIPduReplication: ComIPduReplicationQuorum=(unset)
          ComTxIPdu: ComMinimumDelayTime=0.0, ComTxIPduClearUpdateBit=Transmit, ComTxIPduUnusedAreasDefault=0
            ComTxModeTrue
              ComTxMode: ComTxModeMode=PERIODIC, ComTxModeNumberOfRepetitions=1, ComTxModeRepetitionPeriod=1.0, ComTxModeTimeOffset=0.0, ComTxModeTimePeriod=0.2
        PDCAN3_FD3_C200_1_418382319T: ComIPduDirection=SEND, ComIPduHandleId=29, ComIPduGroupRef=FUSION_CAN3_Tx, ComIPduSignalGroupRef=GRCAN3_SG_FD3_C200_1_418382319T, ComPduIdRef=CAN3_FD3_C200_1_418382319T
          ComIPduCounter: ComIPduCounterSize=(unset), ComIPduCounterStartPosition=(unset)
          ComIPduReplication: ComIPduReplicationQuorum=(unset)
          ComTxIPdu: ComMinimumDelayTime=0.0, ComTxIPduClearUpdateBit=Transmit, ComTxIPduUnusedAreasDefault=0
            ComTxModeTrue
              ComTxMode: ComTxModeMode=PERIODIC, ComTxModeNumberOfRepetitions=1, ComTxModeRepetitionPeriod=1.0, ComTxModeTimeOffset=0.0, ComTxModeTimePeriod=0.2
        PDCAN4_FD4_C100_0_217121744T: ComIPduDirection=SEND, ComIPduHandleId=30, ComIPduGroupRef=FUSION_CAN4_Tx, ComIPduSignalGroupRef=GRCAN4_SG_FD4_C100_0_217121744T, ComPduIdRef=CAN4_FD4_C100_0_217121744T
          ComIPduCounter: ComIPduCounterSize=(unset), ComIPduCounterStartPosition=(unset)
          ComIPduReplication: ComIPduReplicationQuorum=(unset)
          ComTxIPdu: ComMinimumDelayTime=0.0, ComTxIPduClearUpdateBit=Transmit, ComTxIPduUnusedAreasDefault=0
            ComTxModeTrue
              ComTxMode: ComTxModeMode=PERIODIC, ComTxModeNumberOfRepetitions=1, ComTxModeRepetitionPeriod=1.0, ComTxModeTimeOffset=0.0, ComTxModeTimePeriod=0.1
        PDCAN4_FD4_C10_0_217121232T: ComIPduDirection=SEND, ComIPduHandleId=31, ComIPduGroupRef=FUSION_CAN4_Tx, ComIPduSignalGroupRef=GRCAN4_SG_FD4_C10_0_217121232T, ComPduIdRef=CAN4_FD4_C10_0_217121232T
          ComIPduCounter: ComIPduCounterSize=(unset), ComIPduCounterStartPosition=(unset)
          ComIPduReplication: ComIPduReplicationQuorum=(unset)
          ComTxIPdu: ComMinimumDelayTime=0.0, ComTxIPduClearUpdateBit=Transmit, ComTxIPduUnusedAreasDefault=0
            ComTxModeTrue
              ComTxMode: ComTxModeMode=PERIODIC, ComTxModeNumberOfRepetitions=1, ComTxModeRepetitionPeriod=1.0, ComTxModeTimeOffset=0.0, ComTxModeTimePeriod=0.01
        PDCAN4_FD4_C200_0_418382831T: ComIPduDirection=SEND, ComIPduHandleId=32, ComIPduGroupRef=FUSION_CAN4_Tx, ComIPduSignalGroupRef=GRCAN4_SG_FD4_C200_0_418382831T, ComPduIdRef=CAN4_FD4_C200_0_418382831T
          ComIPduCounter: ComIPduCounterSize=(unset), ComIPduCounterStartPosition=(unset)
          ComIPduReplication: ComIPduReplicationQuorum=(unset)
          ComTxIPdu: ComMinimumDelayTime=0.0, ComTxIPduClearUpdateBit=Transmit, ComTxIPduUnusedAreasDefault=0
            ComTxModeTrue
              ComTxMode: ComTxModeMode=PERIODIC, ComTxModeNumberOfRepetitions=1, ComTxModeRepetitionPeriod=1.0, ComTxModeTimeOffset=0.0, ComTxModeTimePeriod=0.2
        PDCAN4_FD4_CE100_0_521T: ComIPduDirection=SEND, ComIPduHandleId=33, ComIPduGroupRef=FUSION_CAN4_Tx, ComIPduSignalGroupRef=GRCAN4_SG_FD4_CE100_0_521T, ComPduIdRef=CAN4_FD4_CE100_0_521T
          ComIPduCounter: ComIPduCounterSize=(unset), ComIPduCounterStartPosition=(unset)
          ComIPduReplication: ComIPduReplicationQuorum=(unset)
          ComTxIPdu: ComMinimumDelayTime=0.0, ComTxIPduClearUpdateBit=Transmit, ComTxIPduUnusedAreasDefault=0
            ComTxModeTrue
              ComTxMode: ComTxModeMode=MIXED, ComTxModeNumberOfRepetitions=0, ComTxModeRepetitionPeriod=1.0, ComTxModeTimeOffset=0.0, ComTxModeTimePeriod=0.1
        PDCAN4_FD4_CE100_1_528T: ComIPduDirection=SEND, ComIPduHandleId=34, ComIPduGroupRef=FUSION_CAN4_Tx, ComIPduSignalGroupRef=GRCAN4_SG_FD4_CE100_1_528T, ComPduIdRef=CAN4_FD4_CE100_1_528T
          ComIPduCounter: ComIPduCounterSize=(unset), ComIPduCounterStartPosition=(unset)
          ComIPduReplication: ComIPduReplicationQuorum=(unset)
          ComTxIPdu: ComMinimumDelayTime=0.0, ComTxIPduClearUpdateBit=Transmit, ComTxIPduUnusedAreasDefault=0
            ComTxModeTrue
              ComTxMode: ComTxModeMode=MIXED, ComTxModeNumberOfRepetitions=0, ComTxModeRepetitionPeriod=1.0, ComTxModeTimeOffset=0.0, ComTxModeTimePeriod=0.1
        PDCAN5_FD5_C100_0_418597072T: ComIPduDirection=SEND, ComIPduHandleId=35, ComIPduGroupRef=FUSION_CAN5_Tx, ComIPduSignalGroupRef=GRCAN5_SG_FD5_C100_0_418597072T, ComPduIdRef=CAN5_FD5_C100_0_418597072T
          ComIPduCounter: ComIPduCounterSize=(unset), ComIPduCounterStartPosition=(unset)
          ComIPduReplication: ComIPduReplicationQuorum=(unset)
          ComTxIPdu: ComMinimumDelayTime=0.0, ComTxIPduClearUpdateBit=Transmit, ComTxIPduUnusedAreasDefault=0
            ComTxModeTrue
              ComTxMode: ComTxModeMode=PERIODIC, ComTxModeNumberOfRepetitions=1, ComTxModeRepetitionPeriod=1.0, ComTxModeTimeOffset=0.0, ComTxModeTimePeriod=0.1
        PDCAN5_FD5_C200_0_525T: ComIPduDirection=SEND, ComIPduHandleId=36, ComIPduGroupRef=FUSION_CAN5_Tx, ComIPduSignalGroupRef=GRCAN5_SG_FD5_C200_0_525T, ComPduIdRef=CAN5_FD5_C200_0_525T
          ComIPduCounter: ComIPduCounterSize=(unset), ComIPduCounterStartPosition=(unset)
          ComIPduReplication: ComIPduReplicationQuorum=(unset)
          ComTxIPdu: ComMinimumDelayTime=0.0, ComTxIPduClearUpdateBit=Transmit, ComTxIPduUnusedAreasDefault=0
            ComTxModeTrue
              ComTxMode: ComTxModeMode=PERIODIC, ComTxModeNumberOfRepetitions=1, ComTxModeRepetitionPeriod=1.0, ComTxModeTimeOffset=0.0, ComTxModeTimePeriod=0.2
        PDCAN6_FD6_C200_0_524T: ComIPduDirection=SEND, ComIPduHandleId=37, ComIPduGroupRef=FUSION_CAN6_Tx, ComIPduSignalGroupRef=GRCAN6_SG_FD6_C200_0_524T, ComPduIdRef=CAN6_FD6_C200_0_524T
          ComIPduCounter: ComIPduCounterSize=(unset), ComIPduCounterStartPosition=(unset)
          ComIPduReplication: ComIPduReplicationQuorum=(unset)
          ComTxIPdu: ComMinimumDelayTime=0.0, ComTxIPduClearUpdateBit=Transmit, ComTxIPduUnusedAreasDefault=0
            ComTxModeTrue
              ComTxMode: ComTxModeMode=PERIODIC, ComTxModeNumberOfRepetitions=1, ComTxModeRepetitionPeriod=1.0, ComTxModeTimeOffset=0.0, ComTxModeTimePeriod=0.2
        PDCAN7_FD7_C100_0_435160528T: ComIPduDirection=SEND, ComIPduHandleId=38, ComIPduGroupRef=FUSION_CAN7_Tx, ComIPduSignalGroupRef=GRCAN7_SG_FD7_C100_0_435160528T, ComPduIdRef=CAN7_FD7_C100_0_435160528T
          ComIPduCounter: ComIPduCounterSize=(unset), ComIPduCounterStartPosition=(unset)
          ComIPduReplication: ComIPduReplicationQuorum=(unset)
          ComTxIPdu: ComMinimumDelayTime=0.0, ComTxIPduClearUpdateBit=Transmit, ComTxIPduUnusedAreasDefault=0
            ComTxModeTrue
              ComTxMode: ComTxModeMode=PERIODIC, ComTxModeNumberOfRepetitions=1, ComTxModeRepetitionPeriod=1.0, ComTxModeTimeOffset=0.0, ComTxModeTimePeriod=0.1
        PDCAN7_FD7_C10_0_207737041T: ComIPduDirection=SEND, ComIPduHandleId=39, ComIPduGroupRef=FUSION_CAN7_Tx, ComIPduSignalGroupRef=GRCAN7_SG_FD7_C10_0_207737041T, ComPduIdRef=CAN7_FD7_C10_0_207737041T
          ComIPduCounter: ComIPduCounterSize=(unset), ComIPduCounterStartPosition=(unset)
          ComIPduReplication: ComIPduReplicationQuorum=(unset)
          ComTxIPdu: ComMinimumDelayTime=0.0, ComTxIPduClearUpdateBit=Transmit, ComTxIPduUnusedAreasDefault=0
            ComTxModeTrue
              ComTxMode: ComTxModeMode=PERIODIC, ComTxModeNumberOfRepetitions=1, ComTxModeRepetitionPeriod=1.0, ComTxModeTimeOffset=0.0, ComTxModeTimePeriod=0.01
        PDCAN7_FD7_C200_0_418382831T: ComIPduDirection=SEND, ComIPduHandleId=40, ComIPduGroupRef=FUSION_CAN7_Tx, ComIPduSignalGroupRef=GRCAN7_SG_FD7_C200_0_418382831T, ComPduIdRef=CAN7_FD7_C200_0_418382831T
          ComIPduCounter: ComIPduCounterSize=(unset), ComIPduCounterStartPosition=(unset)
          ComIPduReplication: ComIPduReplicationQuorum=(unset)
          ComTxIPdu: ComMinimumDelayTime=0.0, ComTxIPduClearUpdateBit=Transmit, ComTxIPduUnusedAreasDefault=0
            ComTxModeTrue
              ComTxMode: ComTxModeMode=PERIODIC, ComTxModeNumberOfRepetitions=1, ComTxModeRepetitionPeriod=1.0, ComTxModeTimeOffset=0.0, ComTxModeTimePeriod=0.2
        PDCAN7_FD7_C50_0_217056000T: ComIPduDirection=SEND, ComIPduHandleId=41, ComIPduGroupRef=FUSION_CAN7_Tx, ComIPduSignalGroupRef=GRCAN7_SG_FD7_C50_0_217056000T, ComPduIdRef=CAN7_FD7_C50_0_217056000T
          ComIPduCounter: ComIPduCounterSize=(unset), ComIPduCounterStartPosition=(unset)
          ComIPduReplication: ComIPduReplicationQuorum=(unset)
          ComTxIPdu: ComMinimumDelayTime=0.0, ComTxIPduClearUpdateBit=Transmit, ComTxIPduUnusedAreasDefault=0
            ComTxModeTrue
              ComTxMode: ComTxModeMode=PERIODIC, ComTxModeNumberOfRepetitions=1, ComTxModeRepetitionPeriod=1.0, ComTxModeTimeOffset=0.0, ComTxModeTimePeriod=0.05
        PDCAN7_FD7_CE100_0_419038649T: ComIPduDirection=SEND, ComIPduHandleId=42, ComIPduGroupRef=FUSION_CAN7_Tx, ComIPduSignalGroupRef=GRCAN7_SG_FD7_CE100_0_419038649T, ComPduIdRef=CAN7_FD7_CE100_0_419038649T
          ComIPduCounter: ComIPduCounterSize=(unset), ComIPduCounterStartPosition=(unset)
          ComIPduReplication: ComIPduReplicationQuorum=(unset)
          ComTxIPdu: ComMinimumDelayTime=0.0, ComTxIPduClearUpdateBit=Transmit, ComTxIPduUnusedAreasDefault=0
            ComTxModeTrue
              ComTxMode: ComTxModeMode=MIXED, ComTxModeNumberOfRepetitions=0, ComTxModeRepetitionPeriod=1.0, ComTxModeTimeOffset=0.0, ComTxModeTimePeriod=0.1
