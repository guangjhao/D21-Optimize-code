[part 3 of 3: packages /CAN3/ConstantSpecification to /CAN3/ImplementationDataTypes]
AUTOSAR XML (schema 4-3-0)
package /CAN3/ConstantSpecification
  742 x constant specification:
    Init_CAN3_BMSChckSum_1: value-spec=0
    Init_CAN3_BMSRolCnct_1: value-spec=0
    Init_CAN3_HVBPwrAvailChrg: value-spec=1500
    Init_CAN3_HVBPwrAvailChrg30: value-spec=0
    Init_CAN3_HVBPwrAvailChrg60: value-spec=1500
    Init_CAN3_HVBPwrAvailDchrg: value-spec=1500
    Init_CAN3_HVBPwrAvailDchrg30: value-spec=1500
    Init_CAN3_HVBPwrAvailDchrg60: value-spec=1500
    Init_CAN3_HVBattCurr: value-spec=10000
    Init_CAN3_HVBattVolt: value-spec=0
    Init_CAN3_ACChrgCurrDis: value-spec=10000
    Init_CAN3_BMS_HVBattCellBalance_Sta: value-spec=0
    Init_CAN3_BMS_HVBattSOCDiff_Sta: value-spec=0
    Init_CAN3_BMS_SOC_UseLimit_Sta: value-spec=0
    Init_CAN3_Battsystfail_Num: value-spec=0
    Init_CAN3_CellType: value-spec=0
    Init_CAN3_ChrgCurType: value-spec=0
    Init_CAN3_ChrgLampSta: value-spec=0
    Init_CAN3_FireDetErr: value-spec=0
    Init_CAN3_HVBChrgPwr: value-spec=0
    Init_CAN3_HVBChrgPwrTotal: value-spec=0
    Init_CAN3_HVBDrvPwr: value-spec=0
    Init_CAN3_HVBDrvPwrTotal: value-spec=0
    Init_CAN3_HVBFullChrgPwr: value-spec=0
    Init_CAN3_HVBIsoImpedenceN: value-spec=0
    Init_CAN3_HVBIsoImpedenceP: value-spec=0
    Init_CAN3_HVBSOH: value-spec=0
    Init_CAN3_HVBattErr: value-spec=0
    Init_CAN3_HVBattPackVolt: value-spec=0
    Init_CAN3_HVBattSOC: value-spec=0
    Init_CAN3_HVBattSOCDis: value-spec=0
    Init_CAN3_RechrgCyc: value-spec=0
    Init_CAN3_RemainChrgTime: value-spec=0
    Init_CAN3_CellTempAvg: value-spec=40
    Init_CAN3_HVBCellVoltMax: value-spec=0
    Init_CAN3_HVBCellVoltMin: value-spec=0
    Init_CAN3_HVBMTempMax: value-spec=40
    Init_CAN3_HVBMTempMin: value-spec=40
    Init_CAN3_MaxCellTemp_Num: value-spec=0
    Init_CAN3_MaxCellVolt_Num: value-spec=0
    Init_CAN3_MinCellTemp_Num: value-spec=0
    Init_CAN3_MinCellVolt_Num: value-spec=0
    Init_CAN3_Mtemp{01..24}: value-spec=0
    Init_CAN3_DCPortNeg_Temp: value-spec=255
    Init_CAN3_DCPortPos_Temp: value-spec=255
    Init_CAN3_HVInVolt: value-spec=0
    Init_CAN3_LVBattDet12V: value-spec=0
    Init_CAN3_OBCACCSLimit: value-spec=255
    Init_CAN3_OBCDCCurLm: value-spec=255
    Init_CAN3_OBCDCVoltLm: value-spec=0
    Init_CAN3_OBCEna: value-spec=0
    Init_CAN3_ReChargerStaFromEvcc: value-spec=0
    Init_CAN3_BMSChckSum: value-spec=0
    Init_CAN3_BMSRolCnct: value-spec=0
    Init_CAN3_BMS_READY: value-spec=0
    Init_CAN3_BMS_Warn_{1..8}: value-spec=0
    Init_CAN3_CellUnconsistErr: value-spec=0
    Init_CAN3_ChrgInLockReq: value-spec=0
    Init_CAN3_ChrgPlugSta: value-spec=0
    Init_CAN3_DCChrgSysShockErr: value-spec=0
    Init_CAN3_DisChrgPlugErr: value-spec=0
    Init_CAN3_ExtChrgSta: value-spec=0
    Init_CAN3_HVBCellOvrVoltErr: value-spec=0
    Init_CAN3_HVBCellOvrVoltWarn: value-spec=0
    Init_CAN3_HVBCellUdrVoltWarn: value-spec=0
    Init_CAN3_HVBCellUnbalanErr: value-spec=0
    Init_CAN3_HVBCellUndrVoltErr: value-spec=0
    Init_CAN3_HVBChrgErr: value-spec=0
    Init_CAN3_HVBContactorSta: value-spec=0
    Init_CAN3_HVBHVILErr: value-spec=0
    Init_CAN3_HVBOvrChrgCurrErr: value-spec=0
    Init_CAN3_HVBOvrDchrgCurErr: value-spec=0
    Init_CAN3_HVBOvrSOCErr: value-spec=0
    Init_CAN3_HVBOvrTempErr: value-spec=0
    Init_CAN3_HVBOvrTempWarn: value-spec=0
    Init_CAN3_HVBOvrVoltErr: value-spec=0
    Init_CAN3_HVBPrechrgSta: value-spec=0
    Init_CAN3_HVBPreheatPrecoolSta: value-spec=0
    Init_CAN3_HVBSOCJumpError: value-spec=0
    Init_CAN3_HVBShrtChrgCurrErr: value-spec=0
    Init_CAN3_HVBShrtDischrgCurrErr: value-spec=0
    Init_CAN3_HVBTempDiffErr: value-spec=0
    Init_CAN3_HVBUndrSOCErr: value-spec=0
    Init_CAN3_HVBUndrTempErr: value-spec=0
    Init_CAN3_HVBUndrTempWarn: value-spec=0
    Init_CAN3_HVBUndrVoltErr: value-spec=0
    Init_CAN3_HVBattReady4Pre: value-spec=0
    Init_CAN3_HVILSta: value-spec=0
    Init_CAN3_IsoDetSta: value-spec=0
    Init_CAN3_SystemUncomErr: value-spec=0
    Init_CAN3_V2LSta: value-spec=0
    Init_CAN3_ACChrgStop: value-spec=0
    Init_CAN3_BMS_HVBChrgCap_Sta: value-spec=0
    Init_CAN3_BMS_HVBDchrgCap_Sta: value-spec=0
    Init_CAN3_CurrentErrorID: value-spec=0
    Init_CAN3_DCChrgCurrent: value-spec=0
    Init_CAN3_DCChrgStop: value-spec=0
    Init_CAN3_DCChrgVoltage: value-spec=0
    Init_CAN3_G0standard: value-spec=0
    Init_CAN3_MainChrgRlyNegDriReq: value-spec=0
    Init_CAN3_MainChrgRlyNegOutterVoltage: value-spec=0
    Init_CAN3_MainChrgRlyNegSta: value-spec=0
    Init_CAN3_MainChrgRlyPosDriReq: value-spec=0
    Init_CAN3_MainChrgRlyPosOutterVoltage: value-spec=0
    Init_CAN3_MainChrgRlyPosSta: value-spec=0
    Init_CAN3_MainPosstandard: value-spec=0
    Init_CAN3_MainRlyNegDriReq: value-spec=0
    Init_CAN3_MainRlyNegOutterVoltage: value-spec=0
    Init_CAN3_MainRlyNegSta: value-spec=0
    Init_CAN3_MainRlyPosDriReq: value-spec=0
    Init_CAN3_MainRlyPosInnerVoltage: value-spec=0
    Init_CAN3_MainRlyPosOutterVoltage: value-spec=0
    Init_CAN3_MainRlyPosSta: value-spec=0
    Init_CAN3_TherRunawayErrMask: value-spec=0
    Init_CAN3_CS_CCU1: value-spec=0
    Init_CAN3_DCDCAuxCur: value-spec=0
    Init_CAN3_DCDCAuxVolt: value-spec=0
    Init_CAN3_DCDCHVCur: value-spec=0
    Init_CAN3_DCDCInVoltInf: value-spec=0
    Init_CAN3_DCDCPreCompleted: value-spec=0
    Init_CAN3_OBCDCCurrInf: value-spec=255
    Init_CAN3_OBCDCVoltInf: value-spec=0
    Init_CAN3_OBCPreCompleted: value-spec=0
    Init_CAN3_OBCV2LINVOTP: value-spec=0
    Init_CAN3_OBCV2LInsuFault: value-spec=0
    Init_CAN3_OBCV2LVinOVP: value-spec=0
    Init_CAN3_OBCV2LVinUVP: value-spec=0
    Init_CAN3_OBCV2LVoutOCP: value-spec=0
    Init_CAN3_OBCV2LVoutOVP: value-spec=0
    Init_CAN3_OBCV2LVoutUVP: value-spec=0
    Init_CAN3_OBCWakeup4Plugin: value-spec=0
    Init_CAN3_RC_CCU1: value-spec=0
    Init_CAN3_CS_CCU2: value-spec=0
    Init_CAN3_DCDCEnaSta: value-spec=0
    Init_CAN3_DCDCFaultSta: value-spec=0
    Init_CAN3_DCDCReady4Pre: value-spec=0
    Init_CAN3_DCDCTemp: value-spec=64
    Init_CAN3_OBCACCurrInf: value-spec=40
    Init_CAN3_OBCACVoltInf: value-spec=0
    Init_CAN3_OBCDCP: value-spec=350
    Init_CAN3_OBCEnaSta: value-spec=0
    Init_CAN3_OBCFaultSta: value-spec=0
    Init_CAN3_OBCPluginSta: value-spec=0
    Init_CAN3_OBCReady4Pre: value-spec=0
    Init_CAN3_OBCRlySta: value-spec=0
    Init_CAN3_OBCTemp: value-spec=160
    Init_CAN3_OBCV2LSta: value-spec=0
    Init_CAN3_OBC_AC_Cur_Lim: value-spec=0
    Init_CAN3_RC_CCU2: value-spec=0
    Init_CAN3_EBM1_CS: value-spec=0
    Init_CAN3_EBM1_RC: value-spec=0
    Init_CAN3_EBMErrSta: value-spec=0
    Init_CAN3_EBMRLampSta: value-spec=0
    Init_CAN3_EBMSta: value-spec=0
    Init_CAN3_AllDoorSW: value-spec=0
    Init_CAN3_AntiTheftSeatFold: value-spec=0
    Init_CAN3_AntitheftSta: value-spec=0
    Init_CAN3_BCM_Buzzer_Req: value-spec=0
    Init_CAN3_BCM_DoorLock_Sta: value-spec=0
    Init_CAN3_BrakeLamp: value-spec=0
    Init_CAN3_CTDCtrl: value-spec=0
    Init_CAN3_CTDLockSW: value-spec=0
    Init_CAN3_CTDUnlockSW: value-spec=0
    Init_CAN3_CrashDetd: value-spec=0
    Init_CAN3_Dimmer: value-spec=0
    Init_CAN3_DimmerEN: value-spec=0
    Init_CAN3_DoorLockIND: value-spec=0
    Init_CAN3_DrDoorSW: value-spec=0
    Init_CAN3_Fr_ChargingDoorCtrl: value-spec=0
    Init_CAN3_Fr_FogLamp: value-spec=0
    Init_CAN3_Fr_Wiper_H: value-spec=0
    Init_CAN3_Fr_Wiper_L: value-spec=0
    Init_CAN3_H_Beam: value-spec=0
    Init_CAN3_HazardSW: value-spec=0
    Init_CAN3_HoodSW: value-spec=0
    Init_CAN3_HornCtrl: value-spec=0
    Init_CAN3_LBSD: value-spec=0
    Init_CAN3_LDRL: value-spec=0
    Init_CAN3_LTurnLP: value-spec=0
    Init_CAN3_L_APM_WdwEnable: value-spec=0
    Init_CAN3_L_Beam: value-spec=0
    Init_CAN3_LockSetting: value-spec=0
    Init_CAN3_MirrorCtrl: value-spec=0
    Init_CAN3_MirrorDefog: value-spec=0
    Init_CAN3_PosLamp: value-spec=0
    Init_CAN3_PsDoorSW: value-spec=0
    Init_CAN3_RBSD: value-spec=0
    Init_CAN3_RDRL: value-spec=0
    Init_CAN3_RLDoorSW: value-spec=0
    Init_CAN3_RRDoorSW: value-spec=0
    Init_CAN3_RTurnLP: value-spec=0
    Init_CAN3_ReverseLamp: value-spec=0
    Init_CAN3_RoomLampH: value-spec=0
    Init_CAN3_RoomLampL: value-spec=0
    Init_CAN3_Rr_ChargingDoorCtrl: value-spec=0
    Init_CAN3_Rr_Defog: value-spec=0
    Init_CAN3_Rr_FogLamp: value-spec=0
    Init_CAN3_Rr_Wiper: value-spec=0
    Init_CAN3_TailgateHDSW: value-spec=0
    Init_CAN3_TailgateRemote: value-spec=0
    Init_CAN3_Tailgate_SW: value-spec=0
    Init_CAN3_TrunkRel: value-spec=0
    Init_CAN3_WasherCtrl: value-spec=0
    Init_CAN3_WiperFixMode: value-spec=0
    Init_CAN3_OTA_DL_Available: value-spec=0
    Init_CAN3_OTA_DL_Speed: value-spec=0
    Init_CAN3_OTA_Debug_Code: value-spec=0
    Init_CAN3_OTA_Emergency_Sta: value-spec=0
    Init_CAN3_OTA_InVehicle_FW: value-spec=0
    Init_CAN3_OTA_Lock_Req: value-spec=0
    Init_CAN3_OTA_MDA_Status: value-spec=0
    Init_CAN3_OTA_Mode: value-spec=0
    Init_CAN3_OTA_Network_Type: value-spec=0
    Init_CAN3_OTA_Permit_Agreed: value-spec=0
    Init_CAN3_OTA_Progress_Rate: value-spec=0
    Init_CAN3_OTA_Remained_Time: value-spec=0
    Init_CAN3_OTA_TBOXResetReq: value-spec=0
    Init_CAN3_OTA_Update_Available: value-spec=0
    Init_CAN3_OTA_Updating_ECU_8bit: value-spec=0
    Init_CAN3_BatteryMode: value-spec=0
    Init_CAN3_CCU_ACLampSts: value-spec=0
    Init_CAN3_CCU_ACMaxLampSts: value-spec=0
    Init_CAN3_CCU_AutoLampSts: value-spec=0
    Init_CAN3_CCU_AutoMidLampSts: value-spec=0
    Init_CAN3_CCU_Dispaly_Request: value-spec=0
    Init_CAN3_CCU_EcoSts: value-spec=0
    Init_CAN3_CCU_FrtOnOffLampSts: value-spec=0
    Init_CAN3_CCU_HEATMaxLampSts: value-spec=0
    Init_CAN3_CCU_RrOnOffLampSts: value-spec=0
    Init_CAN3_CCU_SyncLampSts: value-spec=0
    Init_CAN3_CabinMode: value-spec=15
    Init_CAN3_EDriveMode: value-spec=0
    Init_CAN3_FD_AGS_Cmd: value-spec=0
    Init_CAN3_FD_RecyAuto_Cmd: value-spec=7
    Init_CAN3_Fr_Coolantflow: value-spec=0
    Init_CAN3_Fr_Coolanttemp: value-spec=40
    Init_CAN3_HPThermalRecoveryReq: value-spec=0
    Init_CAN3_Rr_Coolantflow: value-spec=0
    Init_CAN3_Rr_Coolanttemp: value-spec=40
    Init_CAN3_sigAirIntenZon1St: value-spec=0
    Init_CAN3_sigAirIntenZon3St: value-spec=0
    Init_CAN3_sigAmbAirT: value-spec=0
    Init_CAN3_sigCbnAirT: value-spec=0
    Init_CAN3_sigCbnPTCPwrAct: value-spec=0
    Init_CAN3_sigCbnSolarLeft: value-spec=253
    Init_CAN3_sigCbnSolarRight: value-spec=253
    Init_CAN3_sigClmtCmprPwrAct: value-spec=0
    Init_CAN3_sigClntTHvBattOut: value-spec=120
    Init_CAN3_sigDfrstSt: value-spec=0
    Init_CAN3_sigHvacSt: value-spec=0
    Init_CAN3_sigRecircSt: value-spec=0
    Init_CAN3_sigSetTempZon{1..3}St: value-spec=0
    Init_CAN3_sigWindDirZon1St: value-spec=7
    Init_CAN3_sigWindDirZon3St: value-spec=7
    Init_CAN3_ACSubMode: value-spec=0
    Init_CAN3_APTC_ActFrRiPwr: value-spec=0
    Init_CAN3_BatLoopActWtFlw: value-spec=0
    Init_CAN3_CCU_CbnPreACWkSts: value-spec=0
    Init_CAN3_CCU_CbnPreEstimdTi: value-spec=0
    Init_CAN3_CCU_CbnPreSts: value-spec=0
    Init_CAN3_CCU_HiVoltageReq: value-spec=0
    Init_CAN3_CoolgFanActDuty: value-spec=0
    Init_CAN3_DeiceModReq: value-spec=0
    Init_CAN3_FD_Blower_Cmd: value-spec=0
    Init_CAN3_FD_Comp_Cmd: value-spec=0
    Init_CAN3_FD_EWP{1..3}_Cmd: value-spec=0
    Init_CAN3_FD_EXV1_Cmd: value-spec=0
    Init_CAN3_FD_EXV2_Cmd: value-spec=0
    Init_CAN3_FD_FWV_Cmd: value-spec=0
    Init_CAN3_FD_FrLeAPTCHeatPwr_Cmd: value-spec=0
    Init_CAN3_FD_FrRiAPTCHeatPwr_Cmd: value-spec=0
    Init_CAN3_FD_FrWPTCHeatPwr_Cmd: value-spec=0
    Init_CAN3_FD_RrAPTCHeatPwr_Cmd: value-spec=0
    Init_CAN3_FD_SOTXV_Cmd: value-spec=0
    Init_CAN3_FD_SOV{1..3}_Cmd: value-spec=0
    Init_CAN3_FD_TWV_Cmd: value-spec=0
    Init_CAN3_FDC_V2L_OBCExtrV2L_Cmd: value-spec=0
    Init_CAN3_FDC_V2L_OBCIntrV2L_Cmd: value-spec=0
    Init_CAN3_Req_OBCV2LEna: value-spec=0
    Init_CAN3_Req_V2LSwOn: value-spec=0
    Init_CAN3_Req_V2L_IVI_Popup: value-spec=0
    Init_CAN3_EVCCAplusPwrUpReq: value-spec=0
    Init_CAN3_FDADC12VDet: value-spec=0
    Init_CAN3_FDADC12VDetAvg: value-spec=0
    Init_CAN3_FDC_SYS_PmicBootPath: value-spec=0
    Init_CAN3_FDC_VCU_ActMaxSlideRate_Sta: value-spec=15000
    Init_CAN3_FDC_VCU_AllowMovThd_OTA_Sta: value-spec=0
    Init_CAN3_FDC_VCU_BrakeSigMatrix_Sta: value-spec=0
    Init_CAN3_FDC_VCU_BrkPedalPosSta_Sta: value-spec=0
    Init_CAN3_FDC_VCU_CANBrkSW2Sta_Sta: value-spec=0
    Init_CAN3_FDC_VCU_DTCCarousel_Sta: value-spec=0
    Init_CAN3_FDC_VCU_EAPS1Min_Sta: value-spec=0
    Init_CAN3_FDC_VCU_EAPS1Raw_Sta: value-spec=0
    Init_CAN3_FDC_VCU_EAPS2Min_Sta: value-spec=0
    Init_CAN3_FDC_VCU_EAPS2Raw_Sta: value-spec=0
    Init_CAN3_FDC_VCU_ForceP_Cmd: value-spec=0
    Init_CAN3_FDC_VCU_LVChrgFreqCnt_Sta: value-spec=0
    Init_CAN3_FDC_VCU_LVStaDropQukCnt_Sta: value-spec=0
    Init_CAN3_FDC_VCU_LowIdleAccPedal_Sta: value-spec=0
    Init_CAN3_FDC_VCU_OTAPwrReqOFFChk_Sta: value-spec=0
    Init_CAN3_FDC_VCU_OTAPwrReqStdChk_Sta: value-spec=0
    Init_CAN3_FDC_VCU_PwrReq_OTA_Sta: value-spec=0
    Init_CAN3_FDC_VCU_RWDRDCActive_Sta: value-spec=0
    Init_CAN3_FDC_VCU_RegenTqLimitEn_Sta: value-spec=0
    Init_CAN3_FDC_VCU_SlideRegenLimTq_Sta: value-spec=10600
    Init_CAN3_FDC_VCU_VehActSpd_Sta: value-spec=30000
    Init_CAN3_FDC_VCU_VehMalfunLevel_Sta: value-spec=0
    Init_CAN3_FDC_VMC_ActStESCYaw_Sta: value-spec=30000
    Init_CAN3_FDC_VMC_LongAcc_Sta: value-spec=20000
    Init_CAN3_FUSION_CMM1: value-spec=0
    Init_CAN3_FUSION_CMM10: value-spec=0
    Init_CAN3_FUSION_CMM{2..9}: value-spec=0
    Init_CAN3_Fr_TqSource: value-spec=0
    Init_CAN3_HVRlyOpFail: value-spec=0
    Init_CAN3_HVTHCMSysAvail: value-spec=0
    Init_CAN3_LVBattChrgtimeAct: value-spec=0
    Init_CAN3_LVBattVoltSta: value-spec=0
    Init_CAN3_LVChrgHoldTAct: value-spec=0
    Init_CAN3_LVSilentChrgLv: value-spec=0
    Init_CAN3_LVSilentChrgReq: value-spec=0
    Init_CAN3_LVSilentChrgSta: value-spec=0
    Init_CAN3_MCUActDisFail: value-spec=0
    Init_CAN3_PMMAllowECUSleep: value-spec=0
    Init_CAN3_PmicBootReason: value-spec=0
    Init_CAN3_PowerDownFault: value-spec=0
    Init_CAN3_PowerDownState: value-spec=0
    Init_CAN3_PowerUpFault: value-spec=0
    Init_CAN3_PowerUpState: value-spec=0
    Init_CAN3_PwrDownReq: value-spec=0
    Init_CAN3_PwrStaConstraint: value-spec=0
    Init_CAN3_PwrStaONTOIVIPopReq: value-spec=0
    Init_CAN3_PwrStaONTOIVIPopT: value-spec=0
    Init_CAN3_PwrStaSelect: value-spec=0
    Init_CAN3_PwrStaTOSta: value-spec=0
    Init_CAN3_PwrUpReq: value-spec=0
    Init_CAN3_Rr_TqSource: value-spec=0
    Init_CAN3_SchedChgTOSta: value-spec=0
    Init_CAN3_SilentChkAllowSleep: value-spec=0
    Init_CAN3_SysAllowReadySta: value-spec=0
    Init_CAN3_SysPwrSta: value-spec=0
    Init_CAN3_TCountSta: value-spec=0
    Init_CAN3_TimerAllowSleep: value-spec=0
    Init_CAN3_VCUBrkSWSta: value-spec=0
    Init_CAN3_VCUFLDoorSta: value-spec=0
    Init_CAN3_VCUFRDoorSta: value-spec=0
    Init_CAN3_VCURLDoorSta: value-spec=0
    Init_CAN3_VCURRDoorSta: value-spec=0
    Init_CAN3_VehHVPwrAvail4THCM: value-spec=0
    Init_CAN3_WisrBootReason: value-spec=0
    Init_CAN3_ActiveDischReq: value-spec=0
    Init_CAN3_CS_VCU1: value-spec=0
    Init_CAN3_CoastDwModeStaChk: value-spec=0
    Init_CAN3_DCDCEnaReq: value-spec=0
    Init_CAN3_DCDCVoltSetpoint: value-spec=0
    Init_CAN3_DemoModeStaChk: value-spec=0
    Init_CAN3_Dr_SeatSta: value-spec=2
    Init_CAN3_DynoModeStaChk: value-spec=0
    Init_CAN3_HVBatCnctReq: value-spec=0
    Init_CAN3_HVSysReadyToCharge: value-spec=0
    Init_CAN3_LVChrgFuncStaChk: value-spec=0
    Init_CAN3_MSA_Crl_Sta: value-spec=0
    Init_CAN3_P_Button_Sta: value-spec=0
    Init_CAN3_PrkReq: value-spec=0
    Init_CAN3_PrkReqValid: value-spec=0
    Init_CAN3_PwrSta: value-spec=7
    Init_CAN3_RC_VCU1: value-spec=0
    Init_CAN3_ShiftGearPosn: value-spec=1
    Init_CAN3_ActiveDischReq_toNidec: value-spec=0
    Init_CAN3_CS_VCU1_toNidec: value-spec=0
    Init_CAN3_CoastDwModeStaChk_toNidec: value-spec=0
    Init_CAN3_DCDCEnaReq_toNidec: value-spec=0
    Init_CAN3_DCDCVoltSetpoint_toNidec: value-spec=0
    Init_CAN3_DemoModeStaChk_toNidec: value-spec=0
    Init_CAN3_Dr_SeatSta_toNidec: value-spec=2
    Init_CAN3_DynoModeStaChk_toNidec: value-spec=0
    Init_CAN3_Fr_ActvDmpDisabReq_toNidec: value-spec=0
    Init_CAN3_Fr_MCUEnaReq_toNidec: value-spec=0
    Init_CAN3_HVBatCnctReq_toNidec: value-spec=0
    Init_CAN3_HVSysReadyToCharge_toNidec: value-spec=0
    Init_CAN3_LVChrgFuncStaChk_toNidec: value-spec=0
    Init_CAN3_MSA_Crl_Sta_toNidec: value-spec=0
    Init_CAN3_PrkReq_toNidec: value-spec=0
    Init_CAN3_PwrSta_toNidec: value-spec=7
    Init_CAN3_RC_VCU1_toNidec: value-spec=0
    Init_CAN3_Rr_ActvDmpDisabReq_toNidec: value-spec=0
    Init_CAN3_Rr_MCUEnaReq_toNidec: value-spec=0
    Init_CAN3_ShiftGearPosn_toNidec: value-spec=1
    Init_CAN3_CS_VCU2_CAN1: value-spec=0
    Init_CAN3_Fr_ActvDmpDisabReq: value-spec=0
    Init_CAN3_Fr_IdcMax: value-spec=0
    Init_CAN3_Fr_IdcMin: value-spec=0
    Init_CAN3_Fr_MCUEnaReq: value-spec=0
    Init_CAN3_Fr_TMTqReq: value-spec=5300
    Init_CAN3_Fr_TorqMax: value-spec=0
    Init_CAN3_Fr_TorqMin: value-spec=0
    Init_CAN3_Fr_UdcMax: value-spec=0
    Init_CAN3_Fr_UdcMin: value-spec=0
    Init_CAN3_RC_VCU2_CAN1: value-spec=0
    Init_CAN3_Rr_ActvDmpDisabReq: value-spec=0
    Init_CAN3_Rr_IdcMax: value-spec=0
    Init_CAN3_Rr_IdcMin: value-spec=0
    Init_CAN3_Rr_MCUEnaReq: value-spec=0
    Init_CAN3_Rr_TMTqReq: value-spec=5300
    Init_CAN3_Rr_TorqMax: value-spec=0
    Init_CAN3_Rr_TorqMin: value-spec=0
    Init_CAN3_Rr_UdcMax: value-spec=0
    Init_CAN3_Rr_UdcMin: value-spec=0
    Init_CAN3_CS_VCU2_CAN1_toNidec: value-spec=0
    Init_CAN3_Fr_IdcMax_toNidec: value-spec=0
    Init_CAN3_Fr_IdcMin_toNidec: value-spec=0
    Init_CAN3_Fr_TMTqReq_toNidec: value-spec=530
    Init_CAN3_Fr_TorqMax_toNidec: value-spec=0
    Init_CAN3_Fr_TorqMin_toNidec: value-spec=0
    Init_CAN3_Fr_UdcMax_toNidec: value-spec=0
    Init_CAN3_Fr_UdcMin_toNidec: value-spec=0
    Init_CAN3_RC_VCU2_CAN1_toNidec: value-spec=0
    Init_CAN3_Rr_IdcMax_toNidec: value-spec=0
    Init_CAN3_Rr_IdcMin_toNidec: value-spec=0
    Init_CAN3_Rr_TMTqReq_toNidec: value-spec=530
    Init_CAN3_Rr_TorqMax_toNidec: value-spec=0
    Init_CAN3_Rr_TorqMin_toNidec: value-spec=0
    Init_CAN3_Rr_UdcMax_toNidec: value-spec=0
    Init_CAN3_Rr_UdcMin_toNidec: value-spec=0
    Init_CAN3_Fr_SpdMax: value-spec=0
    Init_CAN3_Fr_SpdMin: value-spec=0
    Init_CAN3_Fr_TMCtrlMode_Req: value-spec=0
    Init_CAN3_Fr_TMSpdReq: value-spec=0
    Init_CAN3_Rr_SpdMax: value-spec=0
    Init_CAN3_Rr_SpdMin: value-spec=0
    Init_CAN3_Rr_TMCtrlMode_Req: value-spec=0
    Init_CAN3_Rr_TMSpdReq: value-spec=0
    Init_CAN3_ActAPSPosn: value-spec=0
    Init_CAN3_Fr_EDUSpd: value-spec=2000
    Init_CAN3_Fr_EDUSpdValid: value-spec=0
    Init_CAN3_Rr_EDUSpd: value-spec=2000
    Init_CAN3_Rr_EDUSpdValid: value-spec=0
    Init_CAN3_AC_Chg_Cur_Set: value-spec=127
    Init_CAN3_COMP_ActualPwr: value-spec=8191
    Init_CAN3_COMP_ConCur: value-spec=0
    Init_CAN3_COMP_ConVolt: value-spec=0
    Init_CAN3_ChargeInletLockSta: value-spec=0
    Init_CAN3_Charge_Percent_Set: value-spec=100
    Init_CAN3_CrashOutputSts: value-spec=0
    Init_CAN3_DriverSeatBeltCmd: value-spec=0
    Init_CAN3_IVI_Req_V2L: value-spec=0
    Init_CAN3_IVI_Start_Chg_req: value-spec=0
    Init_CAN3_IVI_Stop_Chg_req: value-spec=0
    Init_CAN3_IVI_Time_Day: value-spec=0
    Init_CAN3_IVI_Time_Hour: value-spec=0
    Init_CAN3_IVI_Time_Minute: value-spec=0
    Init_CAN3_IVI_Time_Month: value-spec=0
    Init_CAN3_IVI_Time_Second: value-spec=0
    Init_CAN3_IVI_Unlock_Chg_req: value-spec=0
    Init_CAN3_PTC1_PowerConsumption: value-spec=0
    Init_CAN3_Perd_V2L: value-spec=0
    Init_CAN3_ReserveChargeOFF_Day: value-spec=0
    Init_CAN3_ReserveChargeOFF_Hour: value-spec=0
    Init_CAN3_ReserveChargeOFF_Minute: value-spec=0
    Init_CAN3_ReserveChargeOFF_Month: value-spec=0
    Init_CAN3_ReserveChargeOFF_Year: value-spec=0
    Init_CAN3_ReserveChargeOn_Day: value-spec=0
    Init_CAN3_ReserveChargeOn_Hour: value-spec=0
    Init_CAN3_ReserveChargeOn_Minute: value-spec=0
    Init_CAN3_ReserveChargeOn_Month: value-spec=0
    Init_CAN3_ReserveChargeOn_Year: value-spec=0
    Init_CAN3_SOC_ADJ_BUTT: value-spec=0
    Init_CAN3_SOC_Limit_Set: value-spec=25
    Init_CAN3_SOC_V2LLimit: value-spec=0
    Init_CAN3_Sched_Chg_Start: value-spec=0
    Init_CAN3_Sched_Chg_Stop: value-spec=0
    Init_CAN3_Sched_Chg_butt: value-spec=0
    Init_CAN3_Sched_Chg_limit: value-spec=25
    Init_CAN3_VehSpeed: value-spec=0
    Init_CAN3_VehSpeed_toNidec: value-spec=0
    Init_CAN3_IVI_Time_Day_toNidec: value-spec=0
    Init_CAN3_IVI_Time_Hour_toNidec: value-spec=0
    Init_CAN3_IVI_Time_Minute_toNidec: value-spec=0
    Init_CAN3_IVI_Time_Month_toNidec: value-spec=0
    Init_CAN3_IVI_Time_Second_toNidec: value-spec=0
    Init_CAN3_Fr_ActvDmpDisabSta: value-spec=0
    Init_CAN3_Fr_EDUDrtSta: value-spec=0
    Init_CAN3_Fr_EDUOpratingSta: value-spec=0
    Init_CAN3_Fr_EDURealTMTq: value-spec=10220
    Init_CAN3_Fr_EDURotateDirction: value-spec=0
    Init_CAN3_Fr_EDUTqReqFbk: value-spec=1022
    Init_CAN3_Fr_MCU1Chksum: value-spec=0
    Init_CAN3_Fr_MCU1RolCnt: value-spec=0
    Init_CAN3_Fr_MCUBAT: value-spec=0
    Init_CAN3_Fr_MCUDCBusCurr: value-spec=0
    Init_CAN3_Fr_MCUDCBusVolt: value-spec=0
    Init_CAN3_Fr_MCUDischrgSta: value-spec=0
    Init_CAN3_Fr_MCUEnaSta: value-spec=0
    Init_CAN3_Fr_MCUErr: value-spec=0
    Init_CAN3_Fr_MCUIGN_sta: value-spec=0
    Init_CAN3_Fr_MCUReady: value-spec=0
    Init_CAN3_Fr_MCUReady4Pre: value-spec=0
    Init_CAN3_Fr_MCUSysSta: value-spec=0
    Init_CAN3_Fr_MCUTemp: value-spec=0
    Init_CAN3_Fr_MotorAvailTq: value-spec=0
    Init_CAN3_Fr_RegenAvailTq: value-spec=0
    Init_CAN3_Fr_Reserved_bits: value-spec=0
    Init_CAN3_Fr_TMSpd: value-spec=18000
    Init_CAN3_Fr_TMTemp: value-spec=0
    Init_CAN3_Fr_TMid: value-spec=0
    Init_CAN3_Fr_TMiq: value-spec=0
    Init_CAN3_MCUWarn_F: value-spec=7
    Init_CAN3_MCU_B_F_IGBTDdeTemp_Sta: value-spec=40
    Init_CAN3_MCU_B_F_RealPwrKw_Sta: value-spec=5300
    Init_CAN3_Fr_CoolanttempReq: value-spec=40
    Init_CAN3_Fr_Failcode1: value-spec=0
    Init_CAN3_Fr_Failcode2: value-spec=0
    Init_CAN3_Fr_Failcodehistory1: value-spec=0
    Init_CAN3_Fr_Failcodehistory2: value-spec=0
    Init_CAN3_Fr_LLCTemp: value-spec=0
    Init_CAN3_Fr_LLCflowReq: value-spec=0
    Init_CAN3_Fr_MCU2Chksum: value-spec=0
    Init_CAN3_Fr_MCU2RolCnt: value-spec=0
    Init_CAN3_Fr_MCUTempWarn: value-spec=3
    Init_CAN3_Fr_MCU_HW_Ver: value-spec=0
    Init_CAN3_Fr_MCU_SW_Ver: value-spec=0
    Init_CAN3_Fr_TMTempWarn: value-spec=3
    Init_CAN3_MCU_B_F_FailLv_Sta: value-spec=0
    Init_CAN3_MCU_B_F_KL302TqCnt_Sta: value-spec=0
    Init_CAN3_MCU_B_F_LLCTempWarn_Sta: value-spec=0
    Init_CAN3_MCUWarn_R: value-spec=7
    Init_CAN3_MCU_B_R_IGBTDdeTemp_Sta: value-spec=40
    Init_CAN3_MCU_B_R_RealPwrKw_Sta: value-spec=5300
    Init_CAN3_Rr_ActvDmpDisabSta: value-spec=0
    Init_CAN3_Rr_EDUDrtSta: value-spec=0
    Init_CAN3_Rr_EDUOpratingSta: value-spec=0
    Init_CAN3_Rr_EDURealTMTq: value-spec=10220
    Init_CAN3_Rr_EDURotateDirction: value-spec=0
    Init_CAN3_Rr_EDUTqReqFbk: value-spec=1022
    Init_CAN3_Rr_MCU1Chksum: value-spec=0
    Init_CAN3_Rr_MCU1RolCnt: value-spec=0
    Init_CAN3_Rr_MCUBAT: value-spec=0
    Init_CAN3_Rr_MCUDCBusCurr: value-spec=15000
    Init_CAN3_Rr_MCUDCBusVolt: value-spec=0
    Init_CAN3_Rr_MCUDischrgSta: value-spec=0
    Init_CAN3_Rr_MCUEnaSta: value-spec=0
    Init_CAN3_Rr_MCUErr: value-spec=0
    Init_CAN3_Rr_MCUIGN_sta: value-spec=0
    Init_CAN3_Rr_MCUReady: value-spec=0
    Init_CAN3_Rr_MCUReady4Pre: value-spec=0
    Init_CAN3_Rr_MCUSysSta: value-spec=0
    Init_CAN3_Rr_MCUTemp: value-spec=0
    Init_CAN3_Rr_MotorAvailTq: value-spec=0
    Init_CAN3_Rr_RegenAvailTq: value-spec=0
    Init_CAN3_Rr_Reserved_bits: value-spec=0
    Init_CAN3_Rr_TMSpd: value-spec=18000
    Init_CAN3_Rr_TMTemp: value-spec=0
    Init_CAN3_Rr_TMid: value-spec=15000
    Init_CAN3_Rr_TMiq: value-spec=15000
    Init_CAN3_MCU_B_R_FailLv_Sta: value-spec=0
    Init_CAN3_MCU_B_R_KL302TqCnt_Sta: value-spec=0
    Init_CAN3_MCU_B_R_LLCTempWarn_Sta: value-spec=0
    Init_CAN3_Rr_CoolanttempReq: value-spec=40
    Init_CAN3_Rr_Failcode1: value-spec=0
    Init_CAN3_Rr_Failcode2: value-spec=0
    Init_CAN3_Rr_Failcodehistory1: value-spec=0
    Init_CAN3_Rr_Failcodehistory2: value-spec=0
    Init_CAN3_Rr_LLCTemp: value-spec=40
    Init_CAN3_Rr_LLCflowReq: value-spec=0
    Init_CAN3_Rr_MCU2Chksum: value-spec=0
    Init_CAN3_Rr_MCU2RolCnt: value-spec=0
    Init_CAN3_Rr_MCU3_HW_Ver: value-spec=0
    Init_CAN3_Rr_MCU3_SW_Ver: value-spec=0
    Init_CAN3_Rr_MCUTempWarn: value-spec=3
    Init_CAN3_Rr_TMTempWarn: value-spec=3
    Init_CAN3_Fr_ActvDmpDisabSta_Nidec: value-spec=0
    Init_CAN3_Fr_EDUDrtSta_Nidec: value-spec=0
    Init_CAN3_Fr_EDUOpratingSta_Nidec: value-spec=0
    Init_CAN3_Fr_EDURealTMTq_Nidec: value-spec=0
    Init_CAN3_Fr_EDURotateDirction_Nidec: value-spec=0
    Init_CAN3_Fr_EDUTqReqFbk_Nidec: value-spec=1022
    Init_CAN3_Fr_MCU1Chksum_Nidec: value-spec=0
    Init_CAN3_Fr_MCU1RolCnt_Nidec: value-spec=0
    Init_CAN3_Fr_MCUBAT_Nidec: value-spec=0
    Init_CAN3_Fr_MCUDCBusCurr_Nidec: value-spec=0
    Init_CAN3_Fr_MCUDCBusVolt_Nidec: value-spec=0
    Init_CAN3_Fr_MCUDischrgSta_Nidec: value-spec=0
    Init_CAN3_Fr_MCUEnaSta_Nidec: value-spec=0
    Init_CAN3_Fr_MCUErr_Nidec: value-spec=0
    Init_CAN3_Fr_MCUIGN_sta_Nidec: value-spec=0
    Init_CAN3_Fr_MCUReady4Pre_Nidec: value-spec=0
    Init_CAN3_Fr_MCUReady_Nidec: value-spec=0
    Init_CAN3_Fr_MCUSysSta_Nidec: value-spec=0
    Init_CAN3_Fr_MCUTemp_Nidec: value-spec=0
    Init_CAN3_Fr_MotorAvailTq_Nidec: value-spec=0
    Init_CAN3_Fr_RegenAvailTq_Nidec: value-spec=0
    Init_CAN3_Fr_Reserved_bits_Nidec: value-spec=0
    Init_CAN3_Fr_TMSpd_Nidec: value-spec=17000
    Init_CAN3_Fr_TMTemp_Nidec: value-spec=0
    Init_CAN3_Fr_TMid_Nidec: value-spec=0
    Init_CAN3_Fr_TMiq_Nidec: value-spec=0
    Init_CAN3_MCUWarn_F_Nidec: value-spec=7
    Init_CAN3_Fr_CoolanttempReq_Nidec: value-spec=40
    Init_CAN3_Fr_EOP_SpdSet_Nidec: value-spec=0
    Init_CAN3_Fr_Failcode1_Nidec: value-spec=0
    Init_CAN3_Fr_Failcode2_Nidec: value-spec=0
    Init_CAN3_Fr_Failcodehistory1_Nidec: value-spec=0
    Init_CAN3_Fr_Failcodehistory2_Nidec: value-spec=0
    Init_CAN3_Fr_LLCTemp_Nidec: value-spec=0
    Init_CAN3_Fr_LLCflowReq_Nidec: value-spec=0
    Init_CAN3_Fr_MCU2Chksum_Nidec: value-spec=0
    Init_CAN3_Fr_MCU2RolCnt_Nidec: value-spec=0
    Init_CAN3_Fr_MCUTempWarn_Nidec: value-spec=3
    Init_CAN3_Fr_TMTempWarn_Nidec: value-spec=3
    Init_CAN3_MCU_F_ResetCnt_Sta: value-spec=0
    Init_CAN3_Fr_MCU_HW_Ver_Nidec: value-spec=0
    Init_CAN3_Fr_MCU_SW_Ver_Nidec: value-spec=0
    Init_CAN3_MCUWarn_R_Nidec: value-spec=7
    Init_CAN3_Rr_ActvDmpDisabSta_Nidec: value-spec=0
    Init_CAN3_Rr_EDUDrtSta_Nidec: value-spec=0
    Init_CAN3_Rr_EDUOpratingSta_Nidec: value-spec=0
    Init_CAN3_Rr_EDURealTMTq_Nidec: value-spec=1022
    Init_CAN3_Rr_EDURotateDirction_Nidec: value-spec=0
    Init_CAN3_Rr_EDUTqReqFbk_Nidec: value-spec=1022
    Init_CAN3_Rr_MCU1Chksum_Nidec: value-spec=0
    Init_CAN3_Rr_MCU1RolCnt_Nidec: value-spec=0
    Init_CAN3_Rr_MCUBAT_Nidec: value-spec=0
    Init_CAN3_Rr_MCUDCBusCurr_Nidec: value-spec=15000
    Init_CAN3_Rr_MCUDCBusVolt_Nidec: value-spec=0
    Init_CAN3_Rr_MCUDischrgSta_Nidec: value-spec=0
    Init_CAN3_Rr_MCUEnaSta_Nidec: value-spec=0
    Init_CAN3_Rr_MCUErr_Nidec: value-spec=0
    Init_CAN3_Rr_MCUIGN_sta_Nidec: value-spec=0
    Init_CAN3_Rr_MCUReady4Pre_Nidec: value-spec=0
    Init_CAN3_Rr_MCUReady_Nidec: value-spec=0
    Init_CAN3_Rr_MCUSysSta_Nidec: value-spec=0
    Init_CAN3_Rr_MCUTemp_Nidec: value-spec=0
    Init_CAN3_Rr_MotorAvailTq_Nidec: value-spec=0
    Init_CAN3_Rr_RegenAvailTq_Nidec: value-spec=0
    Init_CAN3_Rr_Reserved_bits_Nidec: value-spec=0
    Init_CAN3_Rr_TMSpd_Nidec: value-spec=17000
    Init_CAN3_Rr_TMTemp_Nidec: value-spec=0
    Init_CAN3_Rr_TMid_Nidec: value-spec=15000
    Init_CAN3_Rr_TMiq_Nidec: value-spec=15000
    Init_CAN3_MCU_R_ResetCnt_Sta: value-spec=0
    Init_CAN3_Rr_CoolanttempReq_Nidec: value-spec=40
    Init_CAN3_Rr_EOP_SpdSet_Nidec: value-spec=0
    Init_CAN3_Rr_Failcode1_Nidec: value-spec=0
    Init_CAN3_Rr_Failcode2_Nidec: value-spec=0
    Init_CAN3_Rr_Failcodehistory1_Nidec: value-spec=0
    Init_CAN3_Rr_Failcodehistory2_Nidec: value-spec=0
    Init_CAN3_Rr_LLCTemp_Nidec: value-spec=40
    Init_CAN3_Rr_LLCflowReq_Nidec: value-spec=0
    Init_CAN3_Rr_MCU2Chksum_Nidec: value-spec=0
    Init_CAN3_Rr_MCU2RolCnt_Nidec: value-spec=0
    Init_CAN3_Rr_MCUTempWarn_Nidec: value-spec=3
    Init_CAN3_Rr_TMTempWarn_Nidec: value-spec=3
    Init_CAN3_Rr_MCU3_HW_Ver_Nidec: value-spec=0
    Init_CAN3_Rr_MCU3_SW_Ver_Nidec: value-spec=0
    Init_CAN3_Shifter_CRC8: value-spec=0
    Init_CAN3_Shifter_Fail_sta: value-spec=0
    Init_CAN3_Shifter_Handle_Cmd: value-spec=0
    Init_CAN3_Shifter_RC: value-spec=0
    Init_CAN3_CSW2_DimSw_Sta: value-spec=0
    Init_CAN3_CSW2_FWasSw_Sta: value-spec=0
    Init_CAN3_CSW2_FWipSw_Sta: value-spec=0
    Init_CAN3_CSW2_PassSW_Sta: value-spec=0
    Init_CAN3_CSW2_RWipWasSw_Sta: value-spec=0
    Init_CAN3_CSW2_TurnSw_Sta: value-spec=0
    Init_CAN3_SG_BMS1: value-spec=fields=[Init_CAN3_BMSChckSum_1, Init_CAN3_BMSRolCnct_1, Init_CAN3_HVBPwrAvailChrg, Init_CAN3_HVBPwrAvailChrg30, Init_CAN3_HVBPwrAvailChrg60, Init_CAN3_HVBPwrAvailDchrg, Init_CAN3_HVBPwrAvailDchrg30, Init_CAN3_HVBPwrAvailDchrg60, Init_CAN3_HVBattCurr, Init_CAN3_HVBattVolt]
    Init_CAN3_SG_BMS3: value-spec=fields=[Init_CAN3_ACChrgCurrDis, Init_CAN3_BMS_HVBattCellBalance_Sta, Init_CAN3_BMS_HVBattSOCDiff_Sta, Init_CAN3_BMS_SOC_UseLimit_Sta, Init_CAN3_Battsystfail_Num, Init_CAN3_CellType, Init_CAN3_ChrgCurType, Init_CAN3_ChrgLampSta, Init_CAN3_FireDetErr, Init_CAN3_HVBChrgPwr, Init_CAN3_HVBChrgPwrTotal, Init_CAN3_HVBDrvPwr, Init_CAN3_HVBDrvPwrTotal, Init_CAN3_HVBFullChrgPwr, Init_CAN3_HVBIsoImpedenceN, Init_CAN3_HVBIsoImpedenceP, Init_CAN3_HVBSOH, Init_CAN3_HVBattErr, Init_CAN3_HVBattPackVolt, Init_CAN3_HVBattSOC, Init_CAN3_HVBattSOCDis, Init_CAN3_RechrgCyc, Init_CAN3_RemainChrgTime]
    Init_CAN3_SG_BMS4: value-spec=fields=[Init_CAN3_CellTempAvg, Init_CAN3_HVBCellVoltMax, Init_CAN3_HVBCellVoltMin, Init_CAN3_HVBMTempMax, Init_CAN3_HVBMTempMin, Init_CAN3_MaxCellTemp_Num, Init_CAN3_MaxCellVolt_Num, Init_CAN3_MinCellTemp_Num, Init_CAN3_MinCellVolt_Num, Init_CAN3_Mtemp01, Init_CAN3_Mtemp02, Init_CAN3_Mtemp03, Init_CAN3_Mtemp04, Init_CAN3_Mtemp05, Init_CAN3_Mtemp06, Init_CAN3_Mtemp07, Init_CAN3_Mtemp08, Init_CAN3_Mtemp09, Init_CAN3_Mtemp10, Init_CAN3_Mtemp11, Init_CAN3_Mtemp12, Init_CAN3_Mtemp13, Init_CAN3_Mtemp14, Init_CAN3_Mtemp15, Init_CAN3_Mtemp16, Init_CAN3_Mtemp17, Init_CAN3_Mtemp18, Init_CAN3_Mtemp19, Init_CAN3_Mtemp20, Init_CAN3_Mtemp21, Init_CAN3_Mtemp22, Init_CAN3_Mtemp23, Init_CAN3_Mtemp24]
    Init_CAN3_SG_BMS5: value-spec=fields=[Init_CAN3_DCPortNeg_Temp, Init_CAN3_DCPortPos_Temp, Init_CAN3_HVInVolt, Init_CAN3_LVBattDet12V, Init_CAN3_OBCACCSLimit, Init_CAN3_OBCDCCurLm, Init_CAN3_OBCDCVoltLm, Init_CAN3_OBCEna, Init_CAN3_ReChargerStaFromEvcc]
    Init_CAN3_SG_BMS6: value-spec=fields=[Init_CAN3_BMSChckSum, Init_CAN3_BMSRolCnct, Init_CAN3_BMS_READY, Init_CAN3_BMS_Warn_1, Init_CAN3_BMS_Warn_2, Init_CAN3_BMS_Warn_3, Init_CAN3_BMS_Warn_4, Init_CAN3_BMS_Warn_5, Init_CAN3_BMS_Warn_6, Init_CAN3_BMS_Warn_7, Init_CAN3_BMS_Warn_8, Init_CAN3_CellUnconsistErr, Init_CAN3_ChrgInLockReq, Init_CAN3_ChrgPlugSta, Init_CAN3_DCChrgSysShockErr, Init_CAN3_DisChrgPlugErr, Init_CAN3_ExtChrgSta, Init_CAN3_HVBCellOvrVoltErr, Init_CAN3_HVBCellOvrVoltWarn, Init_CAN3_HVBCellUdrVoltWarn, Init_CAN3_HVBCellUnbalanErr, Init_CAN3_HVBCellUndrVoltErr, Init_CAN3_HVBChrgErr, Init_CAN3_HVBContactorSta, Init_CAN3_HVBHVILErr, Init_CAN3_HVBOvrChrgCurrErr, Init_CAN3_HVBOvrDchrgCurErr, Init_CAN3_HVBOvrSOCErr, Init_CAN3_HVBOvrTempErr, Init_CAN3_HVBOvrTempWarn, Init_CAN3_HVBOvrVoltErr, Init_CAN3_HVBPrechrgSta, Init_CAN3_HVBPreheatPrecoolSta, Init_CAN3_HVBSOCJumpError, Init_CAN3_HVBShrtChrgCurrErr, Init_CAN3_HVBShrtDischrgCurrErr, Init_CAN3_HVBTempDiffErr, Init_CAN3_HVBUndrSOCErr, Init_CAN3_HVBUndrTempErr, Init_CAN3_HVBUndrTempWarn, Init_CAN3_HVBUndrVoltErr, Init_CAN3_HVBattReady4Pre, Init_CAN3_HVILSta, Init_CAN3_IsoDetSta, Init_CAN3_SystemUncomErr, Init_CAN3_V2LSta]
    Init_CAN3_SG_BMS8: value-spec=fields=[Init_CAN3_ACChrgStop, Init_CAN3_BMS_HVBChrgCap_Sta, Init_CAN3_BMS_HVBDchrgCap_Sta, Init_CAN3_CurrentErrorID, Init_CAN3_DCChrgCurrent, Init_CAN3_DCChrgStop, Init_CAN3_DCChrgVoltage, Init_CAN3_G0standard, Init_CAN3_MainChrgRlyNegDriReq, Init_CAN3_MainChrgRlyNegOutterVoltage, Init_CAN3_MainChrgRlyNegSta, Init_CAN3_MainChrgRlyPosDriReq, Init_CAN3_MainChrgRlyPosOutterVoltage, Init_CAN3_MainChrgRlyPosSta, Init_CAN3_MainPosstandard, Init_CAN3_MainRlyNegDriReq, Init_CAN3_MainRlyNegOutterVoltage, Init_CAN3_MainRlyNegSta, Init_CAN3_MainRlyPosDriReq, Init_CAN3_MainRlyPosInnerVoltage, Init_CAN3_MainRlyPosOutterVoltage, Init_CAN3_MainRlyPosSta, Init_CAN3_TherRunawayErrMask]
    Init_CAN3_SG_CCU1: value-spec=fields=[Init_CAN3_CS_CCU1, Init_CAN3_DCDCAuxCur, Init_CAN3_DCDCAuxVolt, Init_CAN3_DCDCHVCur, Init_CAN3_DCDCInVoltInf, Init_CAN3_DCDCPreCompleted, Init_CAN3_OBCDCCurrInf, Init_CAN3_OBCDCVoltInf, Init_CAN3_OBCPreCompleted, Init_CAN3_OBCV2LINVOTP, Init_CAN3_OBCV2LInsuFault, Init_CAN3_OBCV2LVinOVP, Init_CAN3_OBCV2LVinUVP, Init_CAN3_OBCV2LVoutOCP, Init_CAN3_OBCV2LVoutOVP, Init_CAN3_OBCV2LVoutUVP, Init_CAN3_OBCWakeup4Plugin, Init_CAN3_RC_CCU1]
    Init_CAN3_SG_CCU2: value-spec=fields=[Init_CAN3_CS_CCU2, Init_CAN3_DCDCEnaSta, Init_CAN3_DCDCFaultSta, Init_CAN3_DCDCReady4Pre, Init_CAN3_DCDCTemp, Init_CAN3_OBCACCurrInf, Init_CAN3_OBCACVoltInf, Init_CAN3_OBCDCP, Init_CAN3_OBCEnaSta, Init_CAN3_OBCFaultSta, Init_CAN3_OBCPluginSta, Init_CAN3_OBCReady4Pre, Init_CAN3_OBCRlySta, Init_CAN3_OBCTemp, Init_CAN3_OBCV2LSta, Init_CAN3_OBC_AC_Cur_Lim, Init_CAN3_RC_CCU2]
    Init_CAN3_SG_EBM1: value-spec=fields=[Init_CAN3_EBM1_CS, Init_CAN3_EBM1_RC, Init_CAN3_EBMErrSta, Init_CAN3_EBMRLampSta, Init_CAN3_EBMSta]
    Init_CAN3_SG_FD3_BCM1: value-spec=fields=[Init_CAN3_AllDoorSW, Init_CAN3_AntiTheftSeatFold, Init_CAN3_AntitheftSta, Init_CAN3_BCM_Buzzer_Req, Init_CAN3_BCM_DoorLock_Sta, Init_CAN3_BrakeLamp, Init_CAN3_CTDCtrl, Init_CAN3_CTDLockSW, Init_CAN3_CTDUnlockSW, Init_CAN3_CrashDetd, Init_CAN3_Dimmer, Init_CAN3_DimmerEN, Init_CAN3_DoorLockIND, Init_CAN3_DrDoorSW, Init_CAN3_Fr_ChargingDoorCtrl, Init_CAN3_Fr_FogLamp, Init_CAN3_Fr_Wiper_H, Init_CAN3_Fr_Wiper_L, Init_CAN3_H_Beam, Init_CAN3_HazardSW, Init_CAN3_HoodSW, Init_CAN3_HornCtrl, Init_CAN3_LBSD, Init_CAN3_LDRL, Init_CAN3_LTurnLP, Init_CAN3_L_APM_WdwEnable, Init_CAN3_L_Beam, Init_CAN3_LockSetting, Init_CAN3_MirrorCtrl, Init_CAN3_MirrorDefog, Init_CAN3_PosLamp, Init_CAN3_PsDoorSW, Init_CAN3_RBSD, Init_CAN3_RDRL, Init_CAN3_RLDoorSW, Init_CAN3_RRDoorSW, Init_CAN3_RTurnLP, Init_CAN3_ReverseLamp, Init_CAN3_RoomLampH, Init_CAN3_RoomLampL, Init_CAN3_Rr_ChargingDoorCtrl, Init_CAN3_Rr_Defog, Init_CAN3_Rr_FogLamp, Init_CAN3_Rr_Wiper, Init_CAN3_TailgateHDSW, Init_CAN3_TailgateRemote, Init_CAN3_Tailgate_SW, Init_CAN3_TrunkRel, Init_CAN3_WasherCtrl, Init_CAN3_WiperFixMode]
    Init_CAN3_SG_FD3_OTA1: value-spec=fields=[Init_CAN3_OTA_DL_Available, Init_CAN3_OTA_DL_Speed, Init_CAN3_OTA_Debug_Code, Init_CAN3_OTA_Emergency_Sta, Init_CAN3_OTA_InVehicle_FW, Init_CAN3_OTA_Lock_Req, Init_CAN3_OTA_MDA_Status, Init_CAN3_OTA_Mode, Init_CAN3_OTA_Network_Type, Init_CAN3_OTA_Permit_Agreed, Init_CAN3_OTA_Progress_Rate, Init_CAN3_OTA_Remained_Time, Init_CAN3_OTA_TBOXResetReq, Init_CAN3_OTA_Update_Available, Init_CAN3_OTA_Updating_ECU_8bit]
    Init_CAN3_SG_FD3_THCM1: value-spec=fields=[Init_CAN3_BatteryMode, Init_CAN3_CCU_ACLampSts, Init_CAN3_CCU_ACMaxLampSts, Init_CAN3_CCU_AutoLampSts, Init_CAN3_CCU_AutoMidLampSts, Init_CAN3_CCU_Dispaly_Request, Init_CAN3_CCU_EcoSts, Init_CAN3_CCU_FrtOnOffLampSts, Init_CAN3_CCU_HEATMaxLampSts, Init_CAN3_CCU_RrOnOffLampSts, Init_CAN3_CCU_SyncLampSts, Init_CAN3_CabinMode, Init_CAN3_EDriveMode, Init_CAN3_FD_AGS_Cmd, Init_CAN3_FD_RecyAuto_Cmd, Init_CAN3_Fr_Coolantflow, Init_CAN3_Fr_Coolanttemp, Init_CAN3_HPThermalRecoveryReq, Init_CAN3_Rr_Coolantflow, Init_CAN3_Rr_Coolanttemp, Init_CAN3_sigAirIntenZon1St, Init_CAN3_sigAirIntenZon3St, Init_CAN3_sigAmbAirT, Init_CAN3_sigCbnAirT, Init_CAN3_sigCbnPTCPwrAct, Init_CAN3_sigCbnSolarLeft, Init_CAN3_sigCbnSolarRight, Init_CAN3_sigClmtCmprPwrAct, Init_CAN3_sigClntTHvBattOut, Init_CAN3_sigDfrstSt, Init_CAN3_sigHvacSt, Init_CAN3_sigRecircSt, Init_CAN3_sigSetTempZon1St, Init_CAN3_sigSetTempZon2St, Init_CAN3_sigSetTempZon3St, Init_CAN3_sigWindDirZon1St, Init_CAN3_sigWindDirZon3St]
    Init_CAN3_SG_FD3_THCM2: value-spec=fields=[Init_CAN3_ACSubMode, Init_CAN3_APTC_ActFrRiPwr, Init_CAN3_BatLoopActWtFlw, Init_CAN3_CCU_CbnPreACWkSts, Init_CAN3_CCU_CbnPreEstimdTi, Init_CAN3_CCU_CbnPreSts, Init_CAN3_CCU_HiVoltageReq, Init_CAN3_CoolgFanActDuty, Init_CAN3_DeiceModReq, Init_CAN3_FD_Blower_Cmd, Init_CAN3_FD_Comp_Cmd, Init_CAN3_FD_EWP1_Cmd, Init_CAN3_FD_EWP2_Cmd, Init_CAN3_FD_EWP3_Cmd, Init_CAN3_FD_EXV1_Cmd, Init_CAN3_FD_EXV2_Cmd, Init_CAN3_FD_FWV_Cmd, Init_CAN3_FD_FrLeAPTCHeatPwr_Cmd, Init_CAN3_FD_FrRiAPTCHeatPwr_Cmd, Init_CAN3_FD_FrWPTCHeatPwr_Cmd, Init_CAN3_FD_RrAPTCHeatPwr_Cmd, Init_CAN3_FD_SOTXV_Cmd, Init_CAN3_FD_SOV1_Cmd, Init_CAN3_FD_SOV2_Cmd, Init_CAN3_FD_SOV3_Cmd, Init_CAN3_FD_TWV_Cmd]
    Init_CAN3_SG_FD3_V2L1: value-spec=fields=[Init_CAN3_FDC_V2L_OBCExtrV2L_Cmd, Init_CAN3_FDC_V2L_OBCIntrV2L_Cmd, Init_CAN3_Req_OBCV2LEna, Init_CAN3_Req_V2LSwOn, Init_CAN3_Req_V2L_IVI_Popup]
    Init_CAN3_SG_FD3_VCU0: value-spec=fields=[Init_CAN3_EVCCAplusPwrUpReq, Init_CAN3_FDADC12VDet, Init_CAN3_FDADC12VDetAvg, Init_CAN3_FDC_SYS_PmicBootPath, Init_CAN3_FDC_VCU_ActMaxSlideRate_Sta, Init_CAN3_FDC_VCU_AllowMovThd_OTA_Sta, Init_CAN3_FDC_VCU_BrakeSigMatrix_Sta, Init_CAN3_FDC_VCU_BrkPedalPosSta_Sta, Init_CAN3_FDC_VCU_CANBrkSW2Sta_Sta, Init_CAN3_FDC_VCU_DTCCarousel_Sta, Init_CAN3_FDC_VCU_EAPS1Min_Sta, Init_CAN3_FDC_VCU_EAPS1Raw_Sta, Init_CAN3_FDC_VCU_EAPS2Min_Sta, Init_CAN3_FDC_VCU_EAPS2Raw_Sta, Init_CAN3_FDC_VCU_ForceP_Cmd, Init_CAN3_FDC_VCU_LVChrgFreqCnt_Sta, Init_CAN3_FDC_VCU_LVStaDropQukCnt_Sta, Init_CAN3_FDC_VCU_LowIdleAccPedal_Sta, Init_CAN3_FDC_VCU_OTAPwrReqOFFChk_Sta, Init_CAN3_FDC_VCU_OTAPwrReqStdChk_Sta, Init_CAN3_FDC_VCU_PwrReq_OTA_Sta, Init_CAN3_FDC_VCU_RWDRDCActive_Sta, Init_CAN3_FDC_VCU_RegenTqLimitEn_Sta, Init_CAN3_FDC_VCU_SlideRegenLimTq_Sta, Init_CAN3_FDC_VCU_VehActSpd_Sta, Init_CAN3_FDC_VCU_VehMalfunLevel_Sta, Init_CAN3_FDC_VMC_ActStESCYaw_Sta, Init_CAN3_FDC_VMC_LongAcc_Sta, Init_CAN3_FUSION_CMM1, Init_CAN3_FUSION_CMM10, Init_CAN3_FUSION_CMM2, Init_CAN3_FUSION_CMM3, Init_CAN3_FUSION_CMM4, Init_CAN3_FUSION_CMM5, Init_CAN3_FUSION_CMM6, Init_CAN3_FUSION_CMM7, Init_CAN3_FUSION_CMM8, Init_CAN3_FUSION_CMM9, Init_CAN3_Fr_TqSource, Init_CAN3_HVRlyOpFail, Init_CAN3_HVTHCMSysAvail, Init_CAN3_LVBattChrgtimeAct, Init_CAN3_LVBattVoltSta, Init_CAN3_LVChrgHoldTAct, Init_CAN3_LVSilentChrgLv, Init_CAN3_LVSilentChrgReq, Init_CAN3_LVSilentChrgSta, Init_CAN3_MCUActDisFail, Init_CAN3_PMMAllowECUSleep, Init_CAN3_PmicBootReason, Init_CAN3_PowerDownFault, Init_CAN3_PowerDownState, Init_CAN3_PowerUpFault, Init_CAN3_PowerUpState, Init_CAN3_PwrDownReq, Init_CAN3_PwrStaConstraint, Init_CAN3_PwrStaONTOIVIPopReq, Init_CAN3_PwrStaONTOIVIPopT, Init_CAN3_PwrStaSelect, Init_CAN3_PwrStaTOSta, Init_CAN3_PwrUpReq, Init_CAN3_Rr_TqSource, Init_CAN3_SchedChgTOSta, Init_CAN3_SilentChkAllowSleep, Init_CAN3_SysAllowReadySta, Init_CAN3_SysPwrSta, Init_CAN3_TCountSta, Init_CAN3_TimerAllowSleep, Init_CAN3_VCUBrkSWSta, Init_CAN3_VCUFLDoorSta, Init_CAN3_VCUFRDoorSta, Init_CAN3_VCURLDoorSta, Init_CAN3_VCURRDoorSta, Init_CAN3_VehHVPwrAvail4THCM, Init_CAN3_WisrBootReason]
    Init_CAN3_SG_FD3_VCU1: value-spec=fields=[Init_CAN3_ActiveDischReq, Init_CAN3_CS_VCU1, Init_CAN3_CoastDwModeStaChk, Init_CAN3_DCDCEnaReq, Init_CAN3_DCDCVoltSetpoint, Init_CAN3_DemoModeStaChk, Init_CAN3_Dr_SeatSta, Init_CAN3_DynoModeStaChk, Init_CAN3_HVBatCnctReq, Init_CAN3_HVSysReadyToCharge, Init_CAN3_LVChrgFuncStaChk, Init_CAN3_MSA_Crl_Sta, Init_CAN3_P_Button_Sta, Init_CAN3_PrkReq, Init_CAN3_PrkReqValid, Init_CAN3_PwrSta, Init_CAN3_RC_VCU1, Init_CAN3_ShiftGearPosn]
    Init_CAN3_SG_FD3_VCU1_toNIDEC: value-spec=fields=[Init_CAN3_ActiveDischReq_toNidec, Init_CAN3_CS_VCU1_toNidec, Init_CAN3_CoastDwModeStaChk_toNidec, Init_CAN3_DCDCEnaReq_toNidec, Init_CAN3_DCDCVoltSetpoint_toNidec, Init_CAN3_DemoModeStaChk_toNidec, Init_CAN3_Dr_SeatSta_toNidec, Init_CAN3_DynoModeStaChk_toNidec, Init_CAN3_Fr_ActvDmpDisabReq_toNidec, Init_CAN3_Fr_MCUEnaReq_toNidec, Init_CAN3_HVBatCnctReq_toNidec, Init_CAN3_HVSysReadyToCharge_toNidec, Init_CAN3_LVChrgFuncStaChk_toNidec, Init_CAN3_MSA_Crl_Sta_toNidec, Init_CAN3_PrkReq_toNidec, Init_CAN3_PwrSta_toNidec, Init_CAN3_RC_VCU1_toNidec, Init_CAN3_Rr_ActvDmpDisabReq_toNidec, Init_CAN3_Rr_MCUEnaReq_toNidec, Init_CAN3_ShiftGearPosn_toNidec]
    Init_CAN3_SG_FD3_VCU2: value-spec=fields=[Init_CAN3_CS_VCU2_CAN1, Init_CAN3_Fr_ActvDmpDisabReq, Init_CAN3_Fr_IdcMax, Init_CAN3_Fr_IdcMin, Init_CAN3_Fr_MCUEnaReq, Init_CAN3_Fr_TMTqReq, Init_CAN3_Fr_TorqMax, Init_CAN3_Fr_TorqMin, Init_CAN3_Fr_UdcMax, Init_CAN3_Fr_UdcMin, Init_CAN3_RC_VCU2_CAN1, Init_CAN3_Rr_ActvDmpDisabReq, Init_CAN3_Rr_IdcMax, Init_CAN3_Rr_IdcMin, Init_CAN3_Rr_MCUEnaReq, Init_CAN3_Rr_TMTqReq, Init_CAN3_Rr_TorqMax, Init_CAN3_Rr_TorqMin, Init_CAN3_Rr_UdcMax, Init_CAN3_Rr_UdcMin]
    Init_CAN3_SG_FD3_VCU2_toNIDEC: value-spec=fields=[Init_CAN3_CS_VCU2_CAN1_toNidec, Init_CAN3_Fr_IdcMax_toNidec, Init_CAN3_Fr_IdcMin_toNidec, Init_CAN3_Fr_TMTqReq_toNidec, Init_CAN3_Fr_TorqMax_toNidec, Init_CAN3_Fr_TorqMin_toNidec, Init_CAN3_Fr_UdcMax_toNidec, Init_CAN3_Fr_UdcMin_toNidec, Init_CAN3_RC_VCU2_CAN1_toNidec, Init_CAN3_Rr_IdcMax_toNidec, Init_CAN3_Rr_IdcMin_toNidec, Init_CAN3_Rr_TMTqReq_toNidec, Init_CAN3_Rr_TorqMax_toNidec, Init_CAN3_Rr_TorqMin_toNidec, Init_CAN3_Rr_UdcMax_toNidec, Init_CAN3_Rr_UdcMin_toNidec]
    Init_CAN3_SG_FD3_VCU4: value-spec=fields=[Init_CAN3_Fr_SpdMax, Init_CAN3_Fr_SpdMin, Init_CAN3_Fr_TMCtrlMode_Req, Init_CAN3_Fr_TMSpdReq, Init_CAN3_Rr_SpdMax, Init_CAN3_Rr_SpdMin, Init_CAN3_Rr_TMCtrlMode_Req, Init_CAN3_Rr_TMSpdReq]
    Init_CAN3_SG_FD3_VCU5: value-spec=fields=[Init_CAN3_ActAPSPosn, Init_CAN3_Fr_EDUSpd, Init_CAN3_Fr_EDUSpdValid, Init_CAN3_Rr_EDUSpd, Init_CAN3_Rr_EDUSpdValid]
    Init_CAN3_SG_GW3_CE100_0: value-spec=fields=[Init_CAN3_AC_Chg_Cur_Set, Init_CAN3_COMP_ActualPwr, Init_CAN3_COMP_ConCur, Init_CAN3_COMP_ConVolt, Init_CAN3_ChargeInletLockSta, Init_CAN3_Charge_Percent_Set, Init_CAN3_CrashOutputSts, Init_CAN3_DriverSeatBeltCmd, Init_CAN3_IVI_Req_V2L, Init_CAN3_IVI_Start_Chg_req, Init_CAN3_IVI_Stop_Chg_req, Init_CAN3_IVI_Time_Day, Init_CAN3_IVI_Time_Hour, Init_CAN3_IVI_Time_Minute, Init_CAN3_IVI_Time_Month, Init_CAN3_IVI_Time_Second, Init_CAN3_IVI_Unlock_Chg_req, Init_CAN3_PTC1_PowerConsumption, Init_CAN3_Perd_V2L, Init_CAN3_ReserveChargeOFF_Day, Init_CAN3_ReserveChargeOFF_Hour, Init_CAN3_ReserveChargeOFF_Minute, Init_CAN3_ReserveChargeOFF_Month, Init_CAN3_ReserveChargeOFF_Year, Init_CAN3_ReserveChargeOn_Day, Init_CAN3_ReserveChargeOn_Hour, Init_CAN3_ReserveChargeOn_Minute, Init_CAN3_ReserveChargeOn_Month, Init_CAN3_ReserveChargeOn_Year, Init_CAN3_SOC_ADJ_BUTT, Init_CAN3_SOC_Limit_Set, Init_CAN3_SOC_V2LLimit, Init_CAN3_Sched_Chg_Start, Init_CAN3_Sched_Chg_Stop, Init_CAN3_Sched_Chg_butt, Init_CAN3_Sched_Chg_limit, Init_CAN3_VehSpeed]
    Init_CAN3_SG_GW_ESC1_toNIDEC: value-spec=fields=constant-reference=Init_CAN3_VehSpeed_toNidec
    Init_CAN3_SG_GW_IVI6_toNIDEC: value-spec=fields=[Init_CAN3_IVI_Time_Day_toNidec, Init_CAN3_IVI_Time_Hour_toNidec, Init_CAN3_IVI_Time_Minute_toNidec, Init_CAN3_IVI_Time_Month_toNidec, Init_CAN3_IVI_Time_Second_toNidec]
    Init_CAN3_SG_MCU_B_F1: value-spec=fields=[Init_CAN3_Fr_ActvDmpDisabSta, Init_CAN3_Fr_EDUDrtSta, Init_CAN3_Fr_EDUOpratingSta, Init_CAN3_Fr_EDURealTMTq, Init_CAN3_Fr_EDURotateDirction, Init_CAN3_Fr_EDUTqReqFbk, Init_CAN3_Fr_MCU1Chksum, Init_CAN3_Fr_MCU1RolCnt, Init_CAN3_Fr_MCUBAT, Init_CAN3_Fr_MCUDCBusCurr, Init_CAN3_Fr_MCUDCBusVolt, Init_CAN3_Fr_MCUDischrgSta, Init_CAN3_Fr_MCUEnaSta, Init_CAN3_Fr_MCUErr, Init_CAN3_Fr_MCUIGN_sta, Init_CAN3_Fr_MCUReady, Init_CAN3_Fr_MCUReady4Pre, Init_CAN3_Fr_MCUSysSta, Init_CAN3_Fr_MCUTemp, Init_CAN3_Fr_MotorAvailTq, Init_CAN3_Fr_RegenAvailTq, Init_CAN3_Fr_Reserved_bits, Init_CAN3_Fr_TMSpd, Init_CAN3_Fr_TMTemp, Init_CAN3_Fr_TMid, Init_CAN3_Fr_TMiq, Init_CAN3_MCUWarn_F, Init_CAN3_MCU_B_F_IGBTDdeTemp_Sta, Init_CAN3_MCU_B_F_RealPwrKw_Sta]
    Init_CAN3_SG_MCU_B_F2: value-spec=fields=[Init_CAN3_Fr_CoolanttempReq, Init_CAN3_Fr_Failcode1, Init_CAN3_Fr_Failcode2, Init_CAN3_Fr_Failcodehistory1, Init_CAN3_Fr_Failcodehistory2, Init_CAN3_Fr_LLCTemp, Init_CAN3_Fr_LLCflowReq, Init_CAN3_Fr_MCU2Chksum, Init_CAN3_Fr_MCU2RolCnt, Init_CAN3_Fr_MCUTempWarn, Init_CAN3_Fr_MCU_HW_Ver, Init_CAN3_Fr_MCU_SW_Ver, Init_CAN3_Fr_TMTempWarn, Init_CAN3_MCU_B_F_FailLv_Sta, Init_CAN3_MCU_B_F_KL302TqCnt_Sta, Init_CAN3_MCU_B_F_LLCTempWarn_Sta]
    Init_CAN3_SG_MCU_B_R1: value-spec=fields=[Init_CAN3_MCUWarn_R, Init_CAN3_MCU_B_R_IGBTDdeTemp_Sta, Init_CAN3_MCU_B_R_RealPwrKw_Sta, Init_CAN3_Rr_ActvDmpDisabSta, Init_CAN3_Rr_EDUDrtSta, Init_CAN3_Rr_EDUOpratingSta, Init_CAN3_Rr_EDURealTMTq, Init_CAN3_Rr_EDURotateDirction, Init_CAN3_Rr_EDUTqReqFbk, Init_CAN3_Rr_MCU1Chksum, Init_CAN3_Rr_MCU1RolCnt, Init_CAN3_Rr_MCUBAT, Init_CAN3_Rr_MCUDCBusCurr, Init_CAN3_Rr_MCUDCBusVolt, Init_CAN3_Rr_MCUDischrgSta, Init_CAN3_Rr_MCUEnaSta, Init_CAN3_Rr_MCUErr, Init_CAN3_Rr_MCUIGN_sta, Init_CAN3_Rr_MCUReady, Init_CAN3_Rr_MCUReady4Pre, Init_CAN3_Rr_MCUSysSta, Init_CAN3_Rr_MCUTemp, Init_CAN3_Rr_MotorAvailTq, Init_CAN3_Rr_RegenAvailTq, Init_CAN3_Rr_Reserved_bits, Init_CAN3_Rr_TMSpd, Init_CAN3_Rr_TMTemp, Init_CAN3_Rr_TMid, Init_CAN3_Rr_TMiq]
    Init_CAN3_SG_MCU_B_R2: value-spec=fields=[Init_CAN3_MCU_B_R_FailLv_Sta, Init_CAN3_MCU_B_R_KL302TqCnt_Sta, Init_CAN3_MCU_B_R_LLCTempWarn_Sta, Init_CAN3_Rr_CoolanttempReq, Init_CAN3_Rr_Failcode1, Init_CAN3_Rr_Failcode2, Init_CAN3_Rr_Failcodehistory1, Init_CAN3_Rr_Failcodehistory2, Init_CAN3_Rr_LLCTemp, Init_CAN3_Rr_LLCflowReq, Init_CAN3_Rr_MCU2Chksum, Init_CAN3_Rr_MCU2RolCnt, Init_CAN3_Rr_MCU3_HW_Ver, Init_CAN3_Rr_MCU3_SW_Ver, Init_CAN3_Rr_MCUTempWarn, Init_CAN3_Rr_TMTempWarn]
    Init_CAN3_SG_MCU_N_F1: value-spec=fields=[Init_CAN3_Fr_ActvDmpDisabSta_Nidec, Init_CAN3_Fr_EDUDrtSta_Nidec, Init_CAN3_Fr_EDUOpratingSta_Nidec, Init_CAN3_Fr_EDURealTMTq_Nidec, Init_CAN3_Fr_EDURotateDirction_Nidec, Init_CAN3_Fr_EDUTqReqFbk_Nidec, Init_CAN3_Fr_MCU1Chksum_Nidec, Init_CAN3_Fr_MCU1RolCnt_Nidec, Init_CAN3_Fr_MCUBAT_Nidec, Init_CAN3_Fr_MCUDCBusCurr_Nidec, Init_CAN3_Fr_MCUDCBusVolt_Nidec, Init_CAN3_Fr_MCUDischrgSta_Nidec, Init_CAN3_Fr_MCUEnaSta_Nidec, Init_CAN3_Fr_MCUErr_Nidec, Init_CAN3_Fr_MCUIGN_sta_Nidec, Init_CAN3_Fr_MCUReady4Pre_Nidec, Init_CAN3_Fr_MCUReady_Nidec, Init_CAN3_Fr_MCUSysSta_Nidec, Init_CAN3_Fr_MCUTemp_Nidec, Init_CAN3_Fr_MotorAvailTq_Nidec, Init_CAN3_Fr_RegenAvailTq_Nidec, Init_CAN3_Fr_Reserved_bits_Nidec, Init_CAN3_Fr_TMSpd_Nidec, Init_CAN3_Fr_TMTemp_Nidec, Init_CAN3_Fr_TMid_Nidec, Init_CAN3_Fr_TMiq_Nidec, Init_CAN3_MCUWarn_F_Nidec]
    Init_CAN3_SG_MCU_N_F2: value-spec=fields=[Init_CAN3_Fr_CoolanttempReq_Nidec, Init_CAN3_Fr_EOP_SpdSet_Nidec, Init_CAN3_Fr_Failcode1_Nidec, Init_CAN3_Fr_Failcode2_Nidec, Init_CAN3_Fr_Failcodehistory1_Nidec, Init_CAN3_Fr_Failcodehistory2_Nidec, Init_CAN3_Fr_LLCTemp_Nidec, Init_CAN3_Fr_LLCflowReq_Nidec, Init_CAN3_Fr_MCU2Chksum_Nidec, Init_CAN3_Fr_MCU2RolCnt_Nidec, Init_CAN3_Fr_MCUTempWarn_Nidec, Init_CAN3_Fr_TMTempWarn_Nidec, Init_CAN3_MCU_F_ResetCnt_Sta]
    Init_CAN3_SG_MCU_N_F3: value-spec=fields=[Init_CAN3_Fr_MCU_HW_Ver_Nidec, Init_CAN3_Fr_MCU_SW_Ver_Nidec]
    Init_CAN3_SG_MCU_N_R1: value-spec=fields=[Init_CAN3_MCUWarn_R_Nidec, Init_CAN3_Rr_ActvDmpDisabSta_Nidec, Init_CAN3_Rr_EDUDrtSta_Nidec, Init_CAN3_Rr_EDUOpratingSta_Nidec, Init_CAN3_Rr_EDURealTMTq_Nidec, Init_CAN3_Rr_EDURotateDirction_Nidec, Init_CAN3_Rr_EDUTqReqFbk_Nidec, Init_CAN3_Rr_MCU1Chksum_Nidec, Init_CAN3_Rr_MCU1RolCnt_Nidec, Init_CAN3_Rr_MCUBAT_Nidec, Init_CAN3_Rr_MCUDCBusCurr_Nidec, Init_CAN3_Rr_MCUDCBusVolt_Nidec, Init_CAN3_Rr_MCUDischrgSta_Nidec, Init_CAN3_Rr_MCUEnaSta_Nidec, Init_CAN3_Rr_MCUErr_Nidec, Init_CAN3_Rr_MCUIGN_sta_Nidec, Init_CAN3_Rr_MCUReady4Pre_Nidec, Init_CAN3_Rr_MCUReady_Nidec, Init_CAN3_Rr_MCUSysSta_Nidec, Init_CAN3_Rr_MCUTemp_Nidec, Init_CAN3_Rr_MotorAvailTq_Nidec, Init_CAN3_Rr_RegenAvailTq_Nidec, Init_CAN3_Rr_Reserved_bits_Nidec, Init_CAN3_Rr_TMSpd_Nidec, Init_CAN3_Rr_TMTemp_Nidec, Init_CAN3_Rr_TMid_Nidec, Init_CAN3_Rr_TMiq_Nidec]
    Init_CAN3_SG_MCU_N_R2: value-spec=fields=[Init_CAN3_MCU_R_ResetCnt_Sta, Init_CAN3_Rr_CoolanttempReq_Nidec, Init_CAN3_Rr_EOP_SpdSet_Nidec, Init_CAN3_Rr_Failcode1_Nidec, Init_CAN3_Rr_Failcode2_Nidec, Init_CAN3_Rr_Failcodehistory1_Nidec, Init_CAN3_Rr_Failcodehistory2_Nidec, Init_CAN3_Rr_LLCTemp_Nidec, Init_CAN3_Rr_LLCflowReq_Nidec, Init_CAN3_Rr_MCU2Chksum_Nidec, Init_CAN3_Rr_MCU2RolCnt_Nidec, Init_CAN3_Rr_MCUTempWarn_Nidec, Init_CAN3_Rr_TMTempWarn_Nidec]
    Init_CAN3_SG_MCU_N_R3: value-spec=fields=[Init_CAN3_Rr_MCU3_HW_Ver_Nidec, Init_CAN3_Rr_MCU3_SW_Ver_Nidec]
    Init_CAN3_SG_Shifter1: value-spec=fields=[Init_CAN3_Shifter_CRC8, Init_CAN3_Shifter_Fail_sta, Init_CAN3_Shifter_Handle_Cmd, Init_CAN3_Shifter_RC]
    Init_CAN3_SG_Shifter2: value-spec=fields=[Init_CAN3_CSW2_DimSw_Sta, Init_CAN3_CSW2_FWasSw_Sta, Init_CAN3_CSW2_FWipSw_Sta, Init_CAN3_CSW2_PassSW_Sta, Init_CAN3_CSW2_RWipWasSw_Sta, Init_CAN3_CSW2_TurnSw_Sta]
package /CAN3/ImplementationDataTypes
  36 x impl type, all with category=STRUCTURE:
    DT_CAN3_SG_BMS1
      10 x element, all with category=TYPE_REFERENCE:
        CAN3_BMSChckSum_1: implementation-data-type=uint8
        CAN3_BMSRolCnct_1: implementation-data-type=uint8
        CAN3_HVBPwrAvailChrg: implementation-data-type=uint16
        CAN3_HVBPwrAvailChrg30: implementation-data-type=uint16
        CAN3_HVBPwrAvailChrg60: implementation-data-type=uint16
        CAN3_HVBPwrAvailDchrg: implementation-data-type=uint16
        CAN3_HVBPwrAvailDchrg30: implementation-data-type=uint16
        CAN3_HVBPwrAvailDchrg60: implementation-data-type=uint16
        CAN3_HVBattCurr: implementation-data-type=uint16
        CAN3_HVBattVolt: implementation-data-type=uint16
    DT_CAN3_SG_BMS3
      23 x element, all with category=TYPE_REFERENCE:
        CAN3_ACChrgCurrDis: implementation-data-type=uint16
        CAN3_BMS_HVBattCellBalance_Sta: implementation-data-type=uint8
        CAN3_BMS_HVBattSOCDiff_Sta: implementation-data-type=uint8
        CAN3_BMS_SOC_UseLimit_Sta: implementation-data-type=uint8
        CAN3_Battsystfail_Num: implementation-data-type=uint8
        CAN3_CellType: implementation-data-type=uint8
        CAN3_ChrgCurType: implementation-data-type=uint8
        CAN3_ChrgLampSta: implementation-data-type=uint8
        CAN3_FireDetErr: implementation-data-type=uint8
        CAN3_HVBChrgPwr: implementation-data-type=uint16
        CAN3_HVBChrgPwrTotal: implementation-data-type=uint32
        CAN3_HVBDrvPwr: implementation-data-type=uint16
        CAN3_HVBDrvPwrTotal: implementation-data-type=uint32
        CAN3_HVBFullChrgPwr: implementation-data-type=uint16
        CAN3_HVBIsoImpedenceN: implementation-data-type=uint16
        CAN3_HVBIsoImpedenceP: implementation-data-type=uint16
        CAN3_HVBSOH: implementation-data-type=uint8
        CAN3_HVBattErr: implementation-data-type=uint8
        CAN3_HVBattPackVolt: implementation-data-type=uint16
        CAN3_HVBattSOC: implementation-data-type=uint8
        CAN3_HVBattSOCDis: implementation-data-type=uint8
        CAN3_RechrgCyc: implementation-data-type=uint32
        CAN3_RemainChrgTime: implementation-data-type=uint16
    DT_CAN3_SG_BMS4
      33 x element, all with category=TYPE_REFERENCE:
        CAN3_CellTempAvg: implementation-data-type=uint8
        CAN3_HVBCellVoltMax: implementation-data-type=uint16
        CAN3_HVBCellVoltMin: implementation-data-type=uint16
        CAN3_HVBMTempMax: implementation-data-type=uint8
        CAN3_HVBMTempMin: implementation-data-type=uint8
        CAN3_MaxCellTemp_Num: implementation-data-type=uint8
        CAN3_MaxCellVolt_Num: implementation-data-type=uint8
        CAN3_MinCellTemp_Num: implementation-data-type=uint8
        CAN3_MinCellVolt_Num: implementation-data-type=uint8
        CAN3_Mtemp{01..24}: implementation-data-type=uint8
    DT_CAN3_SG_BMS5
      9 x element, all with category=TYPE_REFERENCE:
        CAN3_DCPortNeg_Temp: implementation-data-type=uint8
        CAN3_DCPortPos_Temp: implementation-data-type=uint8
        CAN3_HVInVolt: implementation-data-type=uint16
        CAN3_LVBattDet12V: implementation-data-type=uint8
        CAN3_OBCACCSLimit: implementation-data-type=uint8
        CAN3_OBCDCCurLm: implementation-data-type=uint16
        CAN3_OBCDCVoltLm: implementation-data-type=uint16
        CAN3_OBCEna: implementation-data-type=uint8
        CAN3_ReChargerStaFromEvcc: implementation-data-type=uint8
    DT_CAN3_SG_BMS6
      46 x element, all with category=TYPE_REFERENCE, implementation-data-type=uint8:
        CAN3_BMSChckSum
        CAN3_BMSRolCnct
        CAN3_BMS_READY
        CAN3_BMS_Warn_{1..8}
        CAN3_CellUnconsistErr
        CAN3_ChrgInLockReq
        CAN3_ChrgPlugSta
        CAN3_DCChrgSysShockErr
        CAN3_DisChrgPlugErr
        CAN3_ExtChrgSta
        CAN3_HVBCellOvrVoltErr
        CAN3_HVBCellOvrVoltWarn
        CAN3_HVBCellUdrVoltWarn
        CAN3_HVBCellUnbalanErr
        CAN3_HVBCellUndrVoltErr
        CAN3_HVBChrgErr
        CAN3_HVBContactorSta
        CAN3_HVBHVILErr
        CAN3_HVBOvrChrgCurrErr
        CAN3_HVBOvrDchrgCurErr
        CAN3_HVBOvrSOCErr
        CAN3_HVBOvrTempErr
        CAN3_HVBOvrTempWarn
        CAN3_HVBOvrVoltErr
        CAN3_HVBPrechrgSta
        CAN3_HVBPreheatPrecoolSta
        CAN3_HVBSOCJumpError
        CAN3_HVBShrtChrgCurrErr
        CAN3_HVBShrtDischrgCurrErr
        CAN3_HVBTempDiffErr
        CAN3_HVBUndrSOCErr
        CAN3_HVBUndrTempErr
        CAN3_HVBUndrTempWarn
        CAN3_HVBUndrVoltErr
        CAN3_HVBattReady4Pre
        CAN3_HVILSta
        CAN3_IsoDetSta
        CAN3_SystemUncomErr
        CAN3_V2LSta
    DT_CAN3_SG_BMS8
      23 x element, all with category=TYPE_REFERENCE:
        CAN3_ACChrgStop: implementation-data-type=uint8
        CAN3_BMS_HVBChrgCap_Sta: implementation-data-type=uint32
        CAN3_BMS_HVBDchrgCap_Sta: implementation-data-type=uint32
        CAN3_CurrentErrorID: implementation-data-type=uint16
        CAN3_DCChrgCurrent: implementation-data-type=uint32
        CAN3_DCChrgStop: implementation-data-type=uint8
        CAN3_DCChrgVoltage: implementation-data-type=uint16
        CAN3_G0standard: implementation-data-type=uint16
        CAN3_MainChrgRlyNegDriReq: implementation-data-type=uint8
        CAN3_MainChrgRlyNegOutterVoltage: implementation-data-type=uint16
        CAN3_MainChrgRlyNegSta: implementation-data-type=uint8
        CAN3_MainChrgRlyPosDriReq: implementation-data-type=uint8
        CAN3_MainChrgRlyPosOutterVoltage: implementation-data-type=uint16
        CAN3_MainChrgRlyPosSta: implementation-data-type=uint8
        CAN3_MainPosstandard: implementation-data-type=uint16
        CAN3_MainRlyNegDriReq: implementation-data-type=uint8
        CAN3_MainRlyNegOutterVoltage: implementation-data-type=uint16
        CAN3_MainRlyNegSta: implementation-data-type=uint8
        CAN3_MainRlyPosDriReq: implementation-data-type=uint8
        CAN3_MainRlyPosInnerVoltage: implementation-data-type=uint16
        CAN3_MainRlyPosOutterVoltage: implementation-data-type=uint16
        CAN3_MainRlyPosSta: implementation-data-type=uint8
        CAN3_TherRunawayErrMask: implementation-data-type=uint32
    DT_CAN3_SG_CCU1
      18 x element, all with category=TYPE_REFERENCE:
        CAN3_CS_CCU1: implementation-data-type=uint8
        CAN3_DCDCAuxCur: implementation-data-type=uint16
        CAN3_DCDCAuxVolt: implementation-data-type=uint8
        CAN3_DCDCHVCur: implementation-data-type=uint16
        CAN3_DCDCInVoltInf: implementation-data-type=uint16
        CAN3_DCDCPreCompleted: implementation-data-type=uint8
        CAN3_OBCDCCurrInf: implementation-data-type=uint16
        CAN3_OBCDCVoltInf: implementation-data-type=uint16
        CAN3_OBCPreCompleted: implementation-data-type=uint8
        CAN3_OBCV2LINVOTP: implementation-data-type=uint8
        CAN3_OBCV2LInsuFault: implementation-data-type=uint8
        CAN3_OBCV2LVinOVP: implementation-data-type=uint8
        CAN3_OBCV2LVinUVP: implementation-data-type=uint8
        CAN3_OBCV2LVoutOCP: implementation-data-type=uint8
        CAN3_OBCV2LVoutOVP: implementation-data-type=uint8
        CAN3_OBCV2LVoutUVP: implementation-data-type=uint8
        CAN3_OBCWakeup4Plugin: implementation-data-type=uint8
        CAN3_RC_CCU1: implementation-data-type=uint8
    DT_CAN3_SG_CCU2
      17 x element, all with category=TYPE_REFERENCE:
        CAN3_CS_CCU2: implementation-data-type=uint8
        CAN3_DCDCEnaSta: implementation-data-type=uint8
        CAN3_DCDCFaultSta: implementation-data-type=uint8
        CAN3_DCDCReady4Pre: implementation-data-type=uint8
        CAN3_DCDCTemp: implementation-data-type=uint8
        CAN3_OBCACCurrInf: implementation-data-type=uint16
        CAN3_OBCACVoltInf: implementation-data-type=uint16
        CAN3_OBCDCP: implementation-data-type=uint16
        CAN3_OBCEnaSta: implementation-data-type=uint8
        CAN3_OBCFaultSta: implementation-data-type=uint8
        CAN3_OBCPluginSta: implementation-data-type=uint8
        CAN3_OBCReady4Pre: implementation-data-type=uint8
        CAN3_OBCRlySta: implementation-data-type=uint8
        CAN3_OBCTemp: implementation-data-type=uint16
        CAN3_OBCV2LSta: implementation-data-type=uint8
        CAN3_OBC_AC_Cur_Lim: implementation-data-type=uint8
        CAN3_RC_CCU2: implementation-data-type=uint8
    DT_CAN3_SG_EBM1
      5 x element, all with category=TYPE_REFERENCE, implementation-data-type=uint8:
        CAN3_EBM1_CS
        CAN3_EBM1_RC
        CAN3_EBMErrSta
        CAN3_EBMRLampSta
        CAN3_EBMSta
    DT_CAN3_SG_FD3_BCM1
      50 x element, all with category=TYPE_REFERENCE, implementation-data-type=uint8:
        CAN3_AllDoorSW
        CAN3_AntiTheftSeatFold
        CAN3_AntitheftSta
        CAN3_BCM_Buzzer_Req
        CAN3_BCM_DoorLock_Sta
        CAN3_BrakeLamp
        CAN3_CTDCtrl
        CAN3_CTDLockSW
        CAN3_CTDUnlockSW
        CAN3_CrashDetd
        CAN3_Dimmer
        CAN3_DimmerEN
        CAN3_DoorLockIND
        CAN3_DrDoorSW
        CAN3_Fr_ChargingDoorCtrl
        CAN3_Fr_FogLamp
        CAN3_Fr_Wiper_H
        CAN3_Fr_Wiper_L
        CAN3_H_Beam
        CAN3_HazardSW
        CAN3_HoodSW
        CAN3_HornCtrl
        CAN3_LBSD
        CAN3_LDRL
        CAN3_LTurnLP
        CAN3_L_APM_WdwEnable
        CAN3_L_Beam
        CAN3_LockSetting
        CAN3_MirrorCtrl
        CAN3_MirrorDefog
        CAN3_PosLamp
        CAN3_PsDoorSW
        CAN3_RBSD
        CAN3_RDRL
        CAN3_RLDoorSW
        CAN3_RRDoorSW
        CAN3_RTurnLP
        CAN3_ReverseLamp
        CAN3_RoomLampH
        CAN3_RoomLampL
        CAN3_Rr_ChargingDoorCtrl
        CAN3_Rr_Defog
        CAN3_Rr_FogLamp
        CAN3_Rr_Wiper
        CAN3_TailgateHDSW
        CAN3_TailgateRemote
        CAN3_Tailgate_SW
        CAN3_TrunkRel
        CAN3_WasherCtrl
        CAN3_WiperFixMode
    DT_CAN3_SG_FD3_OTA1
      15 x element, all with category=TYPE_REFERENCE:
        CAN3_OTA_DL_Available: implementation-data-type=uint8
        CAN3_OTA_DL_Speed: implementation-data-type=uint32
        CAN3_OTA_Debug_Code: implementation-data-type=uint8
        CAN3_OTA_Emergency_Sta: implementation-data-type=uint8
        CAN3_OTA_InVehicle_FW: implementation-data-type=uint8
        CAN3_OTA_Lock_Req: implementation-data-type=uint8
        CAN3_OTA_MDA_Status: implementation-data-type=uint8
        CAN3_OTA_Mode: implementation-data-type=uint8
        CAN3_OTA_Network_Type: implementation-data-type=uint8
        CAN3_OTA_Permit_Agreed: implementation-data-type=uint8
        CAN3_OTA_Progress_Rate: implementation-data-type=uint8
        CAN3_OTA_Remained_Time: implementation-data-type=uint16
        CAN3_OTA_TBOXResetReq: implementation-data-type=uint8
        CAN3_OTA_Update_Available: implementation-data-type=uint8
        CAN3_OTA_Updating_ECU_8bit: implementation-data-type=uint8
    DT_CAN3_SG_FD3_THCM1
      37 x element, all with category=TYPE_REFERENCE:
        CAN3_BatteryMode: implementation-data-type=uint8
        CAN3_CCU_ACLampSts: implementation-data-type=uint8
        CAN3_CCU_ACMaxLampSts: implementation-data-type=uint8
        CAN3_CCU_AutoLampSts: implementation-data-type=uint8
        CAN3_CCU_AutoMidLampSts: implementation-data-type=uint8
        CAN3_CCU_Dispaly_Request: implementation-data-type=uint8
        CAN3_CCU_EcoSts: implementation-data-type=uint8
        CAN3_CCU_FrtOnOffLampSts: implementation-data-type=uint8
        CAN3_CCU_HEATMaxLampSts: implementation-data-type=uint8
        CAN3_CCU_RrOnOffLampSts: implementation-data-type=uint8
        CAN3_CCU_SyncLampSts: implementation-data-type=uint8
        CAN3_CabinMode: implementation-data-type=uint8
        CAN3_EDriveMode: implementation-data-type=uint8
        CAN3_FD_AGS_Cmd: implementation-data-type=uint8
        CAN3_FD_RecyAuto_Cmd: implementation-data-type=uint8
        CAN3_Fr_Coolantflow: implementation-data-type=uint8
        CAN3_Fr_Coolanttemp: implementation-data-type=uint16
        CAN3_HPThermalRecoveryReq: implementation-data-type=uint8
        CAN3_Rr_Coolantflow: implementation-data-type=uint8
        CAN3_Rr_Coolanttemp: implementation-data-type=uint16
        CAN3_sigAirIntenZon1St: implementation-data-type=uint8
        CAN3_sigAirIntenZon3St: implementation-data-type=uint8
        CAN3_sigAmbAirT: implementation-data-type=uint8
        CAN3_sigCbnAirT: implementation-data-type=uint8
        CAN3_sigCbnPTCPwrAct: implementation-data-type=uint8
        CAN3_sigCbnSolarLeft: implementation-data-type=uint8
        CAN3_sigCbnSolarRight: implementation-data-type=uint8
        CAN3_sigClmtCmprPwrAct: implementation-data-type=uint8
        CAN3_sigClntTHvBattOut: implementation-data-type=uint8
        CAN3_sigDfrstSt: implementation-data-type=uint8
        CAN3_sigHvacSt: implementation-data-type=uint8
        CAN3_sigRecircSt: implementation-data-type=uint8
        CAN3_sigSetTempZon{1..3}St: implementation-data-type=uint8
        CAN3_sigWindDirZon1St: implementation-data-type=uint8
        CAN3_sigWindDirZon3St: implementation-data-type=uint8
    DT_CAN3_SG_FD3_THCM2
      26 x element, all with category=TYPE_REFERENCE:
        CAN3_ACSubMode: implementation-data-type=uint8
        CAN3_APTC_ActFrRiPwr: implementation-data-type=uint8
        CAN3_BatLoopActWtFlw: implementation-data-type=uint8
        CAN3_CCU_CbnPreACWkSts: implementation-data-type=uint8
        CAN3_CCU_CbnPreEstimdTi: implementation-data-type=uint8
        CAN3_CCU_CbnPreSts: implementation-data-type=uint8
        CAN3_CCU_HiVoltageReq: implementation-data-type=uint8
        CAN3_CoolgFanActDuty: implementation-data-type=uint8
        CAN3_DeiceModReq: implementation-data-type=uint8
        CAN3_FD_Blower_Cmd: implementation-data-type=uint8
        CAN3_FD_Comp_Cmd: implementation-data-type=uint16
        CAN3_FD_EWP{1..3}_Cmd: implementation-data-type=uint8
        CAN3_FD_EXV1_Cmd: implementation-data-type=uint16
        CAN3_FD_EXV2_Cmd: implementation-data-type=uint16
        CAN3_FD_FWV_Cmd: implementation-data-type=uint8
        CAN3_FD_FrLeAPTCHeatPwr_Cmd: implementation-data-type=uint8
        CAN3_FD_FrRiAPTCHeatPwr_Cmd: implementation-data-type=uint8
        CAN3_FD_FrWPTCHeatPwr_Cmd: implementation-data-type=uint16
        CAN3_FD_RrAPTCHeatPwr_Cmd: implementation-data-type=uint8
        CAN3_FD_SOTXV_Cmd: implementation-data-type=uint8
        CAN3_FD_SOV{1..3}_Cmd: implementation-data-type=uint8
        CAN3_FD_TWV_Cmd: implementation-data-type=uint8
    DT_CAN3_SG_FD3_V2L1
      5 x element, all with category=TYPE_REFERENCE, implementation-data-type=uint8:
        CAN3_FDC_V2L_OBCExtrV2L_Cmd
        CAN3_FDC_V2L_OBCIntrV2L_Cmd
        CAN3_Req_OBCV2LEna
        CAN3_Req_V2LSwOn
        CAN3_Req_V2L_IVI_Popup
    DT_CAN3_SG_FD3_VCU0
      75 x element, all with category=TYPE_REFERENCE:
        CAN3_EVCCAplusPwrUpReq: implementation-data-type=uint8
        CAN3_FDADC12VDet: implementation-data-type=uint8
        CAN3_FDADC12VDetAvg: implementation-data-type=uint8
        CAN3_FDC_SYS_PmicBootPath: implementation-data-type=uint32
        CAN3_FDC_VCU_ActMaxSlideRate_Sta: implementation-data-type=uint16
        CAN3_FDC_VCU_AllowMovThd_OTA_Sta: implementation-data-type=uint8
        CAN3_FDC_VCU_BrakeSigMatrix_Sta: implementation-data-type=uint8
        CAN3_FDC_VCU_BrkPedalPosSta_Sta: implementation-data-type=uint8
        CAN3_FDC_VCU_CANBrkSW2Sta_Sta: implementation-data-type=uint8
        CAN3_FDC_VCU_DTCCarousel_Sta: implementation-data-type=uint8
        CAN3_FDC_VCU_EAPS1Min_Sta: implementation-data-type=uint8
        CAN3_FDC_VCU_EAPS1Raw_Sta: implementation-data-type=uint8
        CAN3_FDC_VCU_EAPS2Min_Sta: implementation-data-type=uint8
        CAN3_FDC_VCU_EAPS2Raw_Sta: implementation-data-type=uint8
        CAN3_FDC_VCU_ForceP_Cmd: implementation-data-type=uint8
        CAN3_FDC_VCU_LVChrgFreqCnt_Sta: implementation-data-type=uint8
        CAN3_FDC_VCU_LVStaDropQukCnt_Sta: implementation-data-type=uint8
        CAN3_FDC_VCU_LowIdleAccPedal_Sta: implementation-data-type=uint8
        CAN3_FDC_VCU_OTAPwrReqOFFChk_Sta: implementation-data-type=uint8
        CAN3_FDC_VCU_OTAPwrReqStdChk_Sta: implementation-data-type=uint8
        CAN3_FDC_VCU_PwrReq_OTA_Sta: implementation-data-type=uint8
        CAN3_FDC_VCU_RWDRDCActive_Sta: implementation-data-type=uint8
        CAN3_FDC_VCU_RegenTqLimitEn_Sta: implementation-data-type=uint8
        CAN3_FDC_VCU_SlideRegenLimTq_Sta: implementation-data-type=uint16
        CAN3_FDC_VCU_VehActSpd_Sta: implementation-data-type=uint16
        CAN3_FDC_VCU_VehMalfunLevel_Sta: implementation-data-type=uint8
        CAN3_FDC_VMC_ActStESCYaw_Sta: implementation-data-type=uint16
        CAN3_FDC_VMC_LongAcc_Sta: implementation-data-type=uint16
        CAN3_FUSION_CMM1: implementation-data-type=uint8
        CAN3_FUSION_CMM10: implementation-data-type=uint8
        CAN3_FUSION_CMM{2..9}: implementation-data-type=uint8
        CAN3_Fr_TqSource: implementation-data-type=uint8
        CAN3_HVRlyOpFail: implementation-data-type=uint8
        CAN3_HVTHCMSysAvail: implementation-data-type=uint8
        CAN3_LVBattChrgtimeAct: implementation-data-type=uint16
        CAN3_LVBattVoltSta: implementation-data-type=uint8
        CAN3_LVChrgHoldTAct: implementation-data-type=uint16
        CAN3_LVSilentChrgLv: implementation-data-type=uint8
        CAN3_LVSilentChrgReq: implementation-data-type=uint8
        CAN3_LVSilentChrgSta: implementation-data-type=uint8
        CAN3_MCUActDisFail: implementation-data-type=uint8
        CAN3_PMMAllowECUSleep: implementation-data-type=uint8
        CAN3_PmicBootReason: implementation-data-type=uint8
        CAN3_PowerDownFault: implementation-data-type=uint8
        CAN3_PowerDownState: implementation-data-type=uint8
        CAN3_PowerUpFault: implementation-data-type=uint8
        CAN3_PowerUpState: implementation-data-type=uint8
        CAN3_PwrDownReq: implementation-data-type=uint8
        CAN3_PwrStaConstraint: implementation-data-type=uint8
        CAN3_PwrStaONTOIVIPopReq: implementation-data-type=uint8
        CAN3_PwrStaONTOIVIPopT: implementation-data-type=uint16
        CAN3_PwrStaSelect: implementation-data-type=uint8
        CAN3_PwrStaTOSta: implementation-data-type=uint8
        CAN3_PwrUpReq: implementation-data-type=uint8
        CAN3_Rr_TqSource: implementation-data-type=uint8
        CAN3_SchedChgTOSta: implementation-data-type=uint8
        CAN3_SilentChkAllowSleep: implementation-data-type=uint8
        CAN3_SysAllowReadySta: implementation-data-type=uint8
        CAN3_SysPwrSta: implementation-data-type=uint8
        CAN3_TCountSta: implementation-data-type=uint8
        CAN3_TimerAllowSleep: implementation-data-type=uint8
        CAN3_VCUBrkSWSta: implementation-data-type=uint8
        CAN3_VCUFLDoorSta: implementation-data-type=uint8
        CAN3_VCUFRDoorSta: implementation-data-type=uint8
        CAN3_VCURLDoorSta: implementation-data-type=uint8
        CAN3_VCURRDoorSta: implementation-data-type=uint8
        CAN3_VehHVPwrAvail4THCM: implementation-data-type=uint8
        CAN3_WisrBootReason: implementation-data-type=uint32
    DT_CAN3_SG_FD3_VCU1
      18 x element, all with category=TYPE_REFERENCE, implementation-data-type=uint8:
        CAN3_ActiveDischReq
        CAN3_CS_VCU1
        CAN3_CoastDwModeStaChk
        CAN3_DCDCEnaReq
        CAN3_DCDCVoltSetpoint
        CAN3_DemoModeStaChk
        CAN3_Dr_SeatSta
        CAN3_DynoModeStaChk
        CAN3_HVBatCnctReq
        CAN3_HVSysReadyToCharge
        CAN3_LVChrgFuncStaChk
        CAN3_MSA_Crl_Sta
        CAN3_P_Button_Sta
        CAN3_PrkReq
        CAN3_PrkReqValid
        CAN3_PwrSta
        CAN3_RC_VCU1
        CAN3_ShiftGearPosn
    DT_CAN3_SG_FD3_VCU1_toNIDEC
      20 x element, all with category=TYPE_REFERENCE, implementation-data-type=uint8:
        CAN3_ActiveDischReq_toNidec
        CAN3_CS_VCU1_toNidec
        CAN3_CoastDwModeStaChk_toNidec
        CAN3_DCDCEnaReq_toNidec
        CAN3_DCDCVoltSetpoint_toNidec
        CAN3_DemoModeStaChk_toNidec
        CAN3_Dr_SeatSta_toNidec
        CAN3_DynoModeStaChk_toNidec
        CAN3_Fr_ActvDmpDisabReq_toNidec
        CAN3_Fr_MCUEnaReq_toNidec
        CAN3_HVBatCnctReq_toNidec
        CAN3_HVSysReadyToCharge_toNidec
        CAN3_LVChrgFuncStaChk_toNidec
        CAN3_MSA_Crl_Sta_toNidec
        CAN3_PrkReq_toNidec
        CAN3_PwrSta_toNidec
        CAN3_RC_VCU1_toNidec
        CAN3_Rr_ActvDmpDisabReq_toNidec
        CAN3_Rr_MCUEnaReq_toNidec
        CAN3_ShiftGearPosn_toNidec
    DT_CAN3_SG_FD3_VCU2
      20 x element, all with category=TYPE_REFERENCE:
        CAN3_CS_VCU2_CAN1: implementation-data-type=uint8
        CAN3_Fr_ActvDmpDisabReq: implementation-data-type=uint8
        CAN3_Fr_IdcMax: implementation-data-type=uint16
        CAN3_Fr_IdcMin: implementation-data-type=uint16
        CAN3_Fr_MCUEnaReq: implementation-data-type=uint8
        CAN3_Fr_TMTqReq: implementation-data-type=uint16
        CAN3_Fr_TorqMax: implementation-data-type=uint16
        CAN3_Fr_TorqMin: implementation-data-type=uint16
        CAN3_Fr_UdcMax: implementation-data-type=uint16
        CAN3_Fr_UdcMin: implementation-data-type=uint16
        CAN3_RC_VCU2_CAN1: implementation-data-type=uint8
        CAN3_Rr_ActvDmpDisabReq: implementation-data-type=uint8
        CAN3_Rr_IdcMax: implementation-data-type=uint16
        CAN3_Rr_IdcMin: implementation-data-type=uint16
        CAN3_Rr_MCUEnaReq: implementation-data-type=uint8
        CAN3_Rr_TMTqReq: implementation-data-type=uint16
        CAN3_Rr_TorqMax: implementation-data-type=uint16
        CAN3_Rr_TorqMin: implementation-data-type=uint16
        CAN3_Rr_UdcMax: implementation-data-type=uint16
        CAN3_Rr_UdcMin: implementation-data-type=uint16
    DT_CAN3_SG_FD3_VCU2_toNIDEC
      16 x element, all with category=TYPE_REFERENCE:
        CAN3_CS_VCU2_CAN1_toNidec: implementation-data-type=uint8
        CAN3_Fr_IdcMax_toNidec: implementation-data-type=uint16
        CAN3_Fr_IdcMin_toNidec: implementation-data-type=uint16
        CAN3_Fr_TMTqReq_toNidec: implementation-data-type=uint16
        CAN3_Fr_TorqMax_toNidec: implementation-data-type=uint16
        CAN3_Fr_TorqMin_toNidec: implementation-data-type=uint16
        CAN3_Fr_UdcMax_toNidec: implementation-data-type=uint16
        CAN3_Fr_UdcMin_toNidec: implementation-data-type=uint16
        CAN3_RC_VCU2_CAN1_toNidec: implementation-data-type=uint8
        CAN3_Rr_IdcMax_toNidec: implementation-data-type=uint16
        CAN3_Rr_IdcMin_toNidec: implementation-data-type=uint16
        CAN3_Rr_TMTqReq_toNidec: implementation-data-type=uint16
        CAN3_Rr_TorqMax_toNidec: implementation-data-type=uint16
        CAN3_Rr_TorqMin_toNidec: implementation-data-type=uint16
        CAN3_Rr_UdcMax_toNidec: implementation-data-type=uint16
        CAN3_Rr_UdcMin_toNidec: implementation-data-type=uint16
    DT_CAN3_SG_FD3_VCU4
      8 x element, all with category=TYPE_REFERENCE:
        CAN3_Fr_SpdMax: implementation-data-type=uint16
        CAN3_Fr_SpdMin: implementation-data-type=uint16
        CAN3_Fr_TMCtrlMode_Req: implementation-data-type=uint8
        CAN3_Fr_TMSpdReq: implementation-data-type=uint16
        CAN3_Rr_SpdMax: implementation-data-type=uint16
        CAN3_Rr_SpdMin: implementation-data-type=uint16
        CAN3_Rr_TMCtrlMode_Req: implementation-data-type=uint8
        CAN3_Rr_TMSpdReq: implementation-data-type=uint16
    DT_CAN3_SG_FD3_VCU5
      5 x element, all with category=TYPE_REFERENCE:
        CAN3_ActAPSPosn: implementation-data-type=uint8
        CAN3_Fr_EDUSpd: implementation-data-type=uint16
        CAN3_Fr_EDUSpdValid: implementation-data-type=uint8
        CAN3_Rr_EDUSpd: implementation-data-type=uint16
        CAN3_Rr_EDUSpdValid: implementation-data-type=uint8
    DT_CAN3_SG_GW3_CE100_0
      37 x element, all with category=TYPE_REFERENCE:
        CAN3_AC_Chg_Cur_Set: implementation-data-type=uint8
        CAN3_COMP_ActualPwr: implementation-data-type=uint16
        CAN3_COMP_ConCur: implementation-data-type=uint16
        CAN3_COMP_ConVolt: implementation-data-type=uint16
        CAN3_ChargeInletLockSta: implementation-data-type=uint8
        CAN3_Charge_Percent_Set: implementation-data-type=uint8
        CAN3_CrashOutputSts: implementation-data-type=uint8
        CAN3_DriverSeatBeltCmd: implementation-data-type=uint8
        CAN3_IVI_Req_V2L: implementation-data-type=uint8
        CAN3_IVI_Start_Chg_req: implementation-data-type=uint8
        CAN3_IVI_Stop_Chg_req: implementation-data-type=uint8
        CAN3_IVI_Time_Day: implementation-data-type=uint8
        CAN3_IVI_Time_Hour: implementation-data-type=uint8
        CAN3_IVI_Time_Minute: implementation-data-type=uint8
        CAN3_IVI_Time_Month: implementation-data-type=uint8
        CAN3_IVI_Time_Second: implementation-data-type=uint8
        CAN3_IVI_Unlock_Chg_req: implementation-data-type=uint8
        CAN3_PTC1_PowerConsumption: implementation-data-type=uint8
        CAN3_Perd_V2L: implementation-data-type=uint8
        CAN3_ReserveChargeOFF_Day: implementation-data-type=uint8
        CAN3_ReserveChargeOFF_Hour: implementation-data-type=uint8
        CAN3_ReserveChargeOFF_Minute: implementation-data-type=uint8
        CAN3_ReserveChargeOFF_Month: implementation-data-type=uint8
        CAN3_ReserveChargeOFF_Year: implementation-data-type=uint8
        CAN3_ReserveChargeOn_Day: implementation-data-type=uint8
        CAN3_ReserveChargeOn_Hour: implementation-data-type=uint8
        CAN3_ReserveChargeOn_Minute: implementation-data-type=uint8
        CAN3_ReserveChargeOn_Month: implementation-data-type=uint8
        CAN3_ReserveChargeOn_Year: implementation-data-type=uint8
        CAN3_SOC_ADJ_BUTT: implementation-data-type=uint8
        CAN3_SOC_Limit_Set: implementation-data-type=uint8
        CAN3_SOC_V2LLimit: implementation-data-type=uint8
        CAN3_Sched_Chg_Start: implementation-data-type=uint8
        CAN3_Sched_Chg_Stop: implementation-data-type=uint8
        CAN3_Sched_Chg_butt: implementation-data-type=uint8
        CAN3_Sched_Chg_limit: implementation-data-type=uint8
        CAN3_VehSpeed: implementation-data-type=uint16
    DT_CAN3_SG_GW_ESC1_toNIDEC
      element CAN3_VehSpeed_toNidec: implementation-data-type=uint16
    DT_CAN3_SG_GW_IVI6_toNIDEC
      5 x element, all with category=TYPE_REFERENCE, implementation-data-type=uint8:
        CAN3_IVI_Time_Day_toNidec
        CAN3_IVI_Time_Hour_toNidec
        CAN3_IVI_Time_Minute_toNidec
        CAN3_IVI_Time_Month_toNidec
        CAN3_IVI_Time_Second_toNidec
    DT_CAN3_SG_MCU_B_F1
      29 x element, all with category=TYPE_REFERENCE:
        CAN3_Fr_ActvDmpDisabSta: implementation-data-type=uint8
        CAN3_Fr_EDUDrtSta: implementation-data-type=uint8
        CAN3_Fr_EDUOpratingSta: implementation-data-type=uint8
        CAN3_Fr_EDURealTMTq: implementation-data-type=uint16
        CAN3_Fr_EDURotateDirction: implementation-data-type=uint8
        CAN3_Fr_EDUTqReqFbk: implementation-data-type=uint16
        CAN3_Fr_MCU1Chksum: implementation-data-type=uint8
        CAN3_Fr_MCU1RolCnt: implementation-data-type=uint8
        CAN3_Fr_MCUBAT: implementation-data-type=uint8
        CAN3_Fr_MCUDCBusCurr: implementation-data-type=uint16
        CAN3_Fr_MCUDCBusVolt: implementation-data-type=uint16
        CAN3_Fr_MCUDischrgSta: implementation-data-type=uint8
        CAN3_Fr_MCUEnaSta: implementation-data-type=uint8
        CAN3_Fr_MCUErr: implementation-data-type=uint8
        CAN3_Fr_MCUIGN_sta: implementation-data-type=uint8
        CAN3_Fr_MCUReady: implementation-data-type=uint8
        CAN3_Fr_MCUReady4Pre: implementation-data-type=uint8
        CAN3_Fr_MCUSysSta: implementation-data-type=uint8
        CAN3_Fr_MCUTemp: implementation-data-type=uint16
        CAN3_Fr_MotorAvailTq: implementation-data-type=uint16
        CAN3_Fr_RegenAvailTq: implementation-data-type=uint16
        CAN3_Fr_Reserved_bits: implementation-data-type=uint8
        CAN3_Fr_TMSpd: implementation-data-type=uint16
        CAN3_Fr_TMTemp: implementation-data-type=uint16
        CAN3_Fr_TMid: implementation-data-type=uint16
        CAN3_Fr_TMiq: implementation-data-type=uint16
        CAN3_MCUWarn_F: implementation-data-type=uint8
        CAN3_MCU_B_F_IGBTDdeTemp_Sta: implementation-data-type=uint16
        CAN3_MCU_B_F_RealPwrKw_Sta: implementation-data-type=uint16
    DT_CAN3_SG_MCU_B_F2
      16 x element, all with category=TYPE_REFERENCE:
        CAN3_Fr_CoolanttempReq: implementation-data-type=uint16
        CAN3_Fr_Failcode1: implementation-data-type=uint8
        CAN3_Fr_Failcode2: implementation-data-type=uint8
        CAN3_Fr_Failcodehistory1: implementation-data-type=uint8
        CAN3_Fr_Failcodehistory2: implementation-data-type=uint8
        CAN3_Fr_LLCTemp: implementation-data-type=uint16
        CAN3_Fr_LLCflowReq: implementation-data-type=uint8
        CAN3_Fr_MCU2Chksum: implementation-data-type=uint8
        CAN3_Fr_MCU2RolCnt: implementation-data-type=uint8
        CAN3_Fr_MCUTempWarn: implementation-data-type=uint8
        CAN3_Fr_MCU_HW_Ver: implementation-data-type=uint16
        CAN3_Fr_MCU_SW_Ver: implementation-data-type=uint16
        CAN3_Fr_TMTempWarn: implementation-data-type=uint8
        CAN3_MCU_B_F_FailLv_Sta: implementation-data-type=uint8
        CAN3_MCU_B_F_KL302TqCnt_Sta: implementation-data-type=uint8
        CAN3_MCU_B_F_LLCTempWarn_Sta: implementation-data-type=uint8
    DT_CAN3_SG_MCU_B_R1
      29 x element, all with category=TYPE_REFERENCE:
        CAN3_MCUWarn_R: implementation-data-type=uint8
        CAN3_MCU_B_R_IGBTDdeTemp_Sta: implementation-data-type=uint16
        CAN3_MCU_B_R_RealPwrKw_Sta: implementation-data-type=uint16
        CAN3_Rr_ActvDmpDisabSta: implementation-data-type=uint8
        CAN3_Rr_EDUDrtSta: implementation-data-type=uint8
        CAN3_Rr_EDUOpratingSta: implementation-data-type=uint8
        CAN3_Rr_EDURealTMTq: implementation-data-type=uint16
        CAN3_Rr_EDURotateDirction: implementation-data-type=uint8
        CAN3_Rr_EDUTqReqFbk: implementation-data-type=uint16
        CAN3_Rr_MCU1Chksum: implementation-data-type=uint8
        CAN3_Rr_MCU1RolCnt: implementation-data-type=uint8
        CAN3_Rr_MCUBAT: implementation-data-type=uint8
        CAN3_Rr_MCUDCBusCurr: implementation-data-type=uint16
        CAN3_Rr_MCUDCBusVolt: implementation-data-type=uint16
        CAN3_Rr_MCUDischrgSta: implementation-data-type=uint8
        CAN3_Rr_MCUEnaSta: implementation-data-type=uint8
        CAN3_Rr_MCUErr: implementation-data-type=uint8
        CAN3_Rr_MCUIGN_sta: implementation-data-type=uint8
        CAN3_Rr_MCUReady: implementation-data-type=uint8
        CAN3_Rr_MCUReady4Pre: implementation-data-type=uint8
        CAN3_Rr_MCUSysSta: implementation-data-type=uint8
        CAN3_Rr_MCUTemp: implementation-data-type=uint16
        CAN3_Rr_MotorAvailTq: implementation-data-type=uint16
        CAN3_Rr_RegenAvailTq: implementation-data-type=uint16
        CAN3_Rr_Reserved_bits: implementation-data-type=uint8
        CAN3_Rr_TMSpd: implementation-data-type=uint16
        CAN3_Rr_TMTemp: implementation-data-type=uint16
        CAN3_Rr_TMid: implementation-data-type=uint16
        CAN3_Rr_TMiq: implementation-data-type=uint16
    DT_CAN3_SG_MCU_B_R2
      16 x element, all with category=TYPE_REFERENCE:
        CAN3_MCU_B_R_FailLv_Sta: implementation-data-type=uint8
        CAN3_MCU_B_R_KL302TqCnt_Sta: implementation-data-type=uint8
        CAN3_MCU_B_R_LLCTempWarn_Sta: implementation-data-type=uint8
        CAN3_Rr_CoolanttempReq: implementation-data-type=uint16
        CAN3_Rr_Failcode1: implementation-data-type=uint8
        CAN3_Rr_Failcode2: implementation-data-type=uint8
        CAN3_Rr_Failcodehistory1: implementation-data-type=uint8
        CAN3_Rr_Failcodehistory2: implementation-data-type=uint8
        CAN3_Rr_LLCTemp: implementation-data-type=uint16
        CAN3_Rr_LLCflowReq: implementation-data-type=uint8
        CAN3_Rr_MCU2Chksum: implementation-data-type=uint8
        CAN3_Rr_MCU2RolCnt: implementation-data-type=uint8
        CAN3_Rr_MCU3_HW_Ver: implementation-data-type=uint16
        CAN3_Rr_MCU3_SW_Ver: implementation-data-type=uint16
        CAN3_Rr_MCUTempWarn: implementation-data-type=uint8
        CAN3_Rr_TMTempWarn: implementation-data-type=uint8
    DT_CAN3_SG_MCU_N_F1
      27 x element, all with category=TYPE_REFERENCE:
        CAN3_Fr_ActvDmpDisabSta_Nidec: implementation-data-type=uint8
        CAN3_Fr_EDUDrtSta_Nidec: implementation-data-type=uint8
        CAN3_Fr_EDUOpratingSta_Nidec: implementation-data-type=uint8
        CAN3_Fr_EDURealTMTq_Nidec: implementation-data-type=uint16
        CAN3_Fr_EDURotateDirction_Nidec: implementation-data-type=uint8
        CAN3_Fr_EDUTqReqFbk_Nidec: implementation-data-type=uint16
        CAN3_Fr_MCU1Chksum_Nidec: implementation-data-type=uint8
        CAN3_Fr_MCU1RolCnt_Nidec: implementation-data-type=uint8
        CAN3_Fr_MCUBAT_Nidec: implementation-data-type=uint8
        CAN3_Fr_MCUDCBusCurr_Nidec: implementation-data-type=uint16
        CAN3_Fr_MCUDCBusVolt_Nidec: implementation-data-type=uint16
        CAN3_Fr_MCUDischrgSta_Nidec: implementation-data-type=uint8
        CAN3_Fr_MCUEnaSta_Nidec: implementation-data-type=uint8
        CAN3_Fr_MCUErr_Nidec: implementation-data-type=uint8
        CAN3_Fr_MCUIGN_sta_Nidec: implementation-data-type=uint8
        CAN3_Fr_MCUReady4Pre_Nidec: implementation-data-type=uint8
        CAN3_Fr_MCUReady_Nidec: implementation-data-type=uint8
        CAN3_Fr_MCUSysSta_Nidec: implementation-data-type=uint8
        CAN3_Fr_MCUTemp_Nidec: implementation-data-type=uint16
        CAN3_Fr_MotorAvailTq_Nidec: implementation-data-type=uint16
        CAN3_Fr_RegenAvailTq_Nidec: implementation-data-type=uint16
        CAN3_Fr_Reserved_bits_Nidec: implementation-data-type=uint8
        CAN3_Fr_TMSpd_Nidec: implementation-data-type=uint16
        CAN3_Fr_TMTemp_Nidec: implementation-data-type=uint16
        CAN3_Fr_TMid_Nidec: implementation-data-type=uint16
        CAN3_Fr_TMiq_Nidec: implementation-data-type=uint16
        CAN3_MCUWarn_F_Nidec: implementation-data-type=uint8
    DT_CAN3_SG_MCU_N_F2
      13 x element, all with category=TYPE_REFERENCE:
        CAN3_Fr_CoolanttempReq_Nidec: implementation-data-type=uint16
        CAN3_Fr_EOP_SpdSet_Nidec: implementation-data-type=uint16
        CAN3_Fr_Failcode1_Nidec: implementation-data-type=uint8
        CAN3_Fr_Failcode2_Nidec: implementation-data-type=uint8
        CAN3_Fr_Failcodehistory1_Nidec: implementation-data-type=uint8
        CAN3_Fr_Failcodehistory2_Nidec: implementation-data-type=uint8
        CAN3_Fr_LLCTemp_Nidec: implementation-data-type=uint16
        CAN3_Fr_LLCflowReq_Nidec: implementation-data-type=uint8
        CAN3_Fr_MCU2Chksum_Nidec: implementation-data-type=uint8
        CAN3_Fr_MCU2RolCnt_Nidec: implementation-data-type=uint8
        CAN3_Fr_MCUTempWarn_Nidec: implementation-data-type=uint8
        CAN3_Fr_TMTempWarn_Nidec: implementation-data-type=uint8
        CAN3_MCU_F_ResetCnt_Sta: implementation-data-type=uint8
    DT_CAN3_SG_MCU_N_F3
      element CAN3_Fr_MCU_HW_Ver_Nidec: implementation-data-type=uint16
      element CAN3_Fr_MCU_SW_Ver_Nidec: implementation-data-type=uint16
    DT_CAN3_SG_MCU_N_R1
      27 x element, all with category=TYPE_REFERENCE:
        CAN3_MCUWarn_R_Nidec: implementation-data-type=uint8
        CAN3_Rr_ActvDmpDisabSta_Nidec: implementation-data-type=uint8
        CAN3_Rr_EDUDrtSta_Nidec: implementation-data-type=uint8
        CAN3_Rr_EDUOpratingSta_Nidec: implementation-data-type=uint8
        CAN3_Rr_EDURealTMTq_Nidec: implementation-data-type=uint16
        CAN3_Rr_EDURotateDirction_Nidec: implementation-data-type=uint8
        CAN3_Rr_EDUTqReqFbk_Nidec: implementation-data-type=uint16
        CAN3_Rr_MCU1Chksum_Nidec: implementation-data-type=uint8
        CAN3_Rr_MCU1RolCnt_Nidec: implementation-data-type=uint8
        CAN3_Rr_MCUBAT_Nidec: implementation-data-type=uint8
        CAN3_Rr_MCUDCBusCurr_Nidec: implementation-data-type=uint16
        CAN3_Rr_MCUDCBusVolt_Nidec: implementation-data-type=uint16
        CAN3_Rr_MCUDischrgSta_Nidec: implementation-data-type=uint8
        CAN3_Rr_MCUEnaSta_Nidec: implementation-data-type=uint8
        CAN3_Rr_MCUErr_Nidec: implementation-data-type=uint8
        CAN3_Rr_MCUIGN_sta_Nidec: implementation-data-type=uint8
        CAN3_Rr_MCUReady4Pre_Nidec: implementation-data-type=uint8
        CAN3_Rr_MCUReady_Nidec: implementation-data-type=uint8
        CAN3_Rr_MCUSysSta_Nidec: implementation-data-type=uint8
        CAN3_Rr_MCUTemp_Nidec: implementation-data-type=uint16
        CAN3_Rr_MotorAvailTq_Nidec: implementation-data-type=uint16
        CAN3_Rr_RegenAvailTq_Nidec: implementation-data-type=uint16
        CAN3_Rr_Reserved_bits_Nidec: implementation-data-type=uint8
        CAN3_Rr_TMSpd_Nidec: implementation-data-type=uint16
        CAN3_Rr_TMTemp_Nidec: implementation-data-type=uint16
        CAN3_Rr_TMid_Nidec: implementation-data-type=uint16
        CAN3_Rr_TMiq_Nidec: implementation-data-type=uint16
    DT_CAN3_SG_MCU_N_R2
      13 x element, all with category=TYPE_REFERENCE:
        CAN3_MCU_R_ResetCnt_Sta: implementation-data-type=uint8
        CAN3_Rr_CoolanttempReq_Nidec: implementation-data-type=uint16
        CAN3_Rr_EOP_SpdSet_Nidec: implementation-data-type=uint16
        CAN3_Rr_Failcode1_Nidec: implementation-data-type=uint8
        CAN3_Rr_Failcode2_Nidec: implementation-data-type=uint8
        CAN3_Rr_Failcodehistory1_Nidec: implementation-data-type=uint8
        CAN3_Rr_Failcodehistory2_Nidec: implementation-data-type=uint8
        CAN3_Rr_LLCTemp_Nidec: implementation-data-type=uint16
        CAN3_Rr_LLCflowReq_Nidec: implementation-data-type=uint8
        CAN3_Rr_MCU2Chksum_Nidec: implementation-data-type=uint8
        CAN3_Rr_MCU2RolCnt_Nidec: implementation-data-type=uint8
        CAN3_Rr_MCUTempWarn_Nidec: implementation-data-type=uint8
        CAN3_Rr_TMTempWarn_Nidec: implementation-data-type=uint8
    DT_CAN3_SG_MCU_N_R3
      element CAN3_Rr_MCU3_HW_Ver_Nidec: implementation-data-type=uint16
      element CAN3_Rr_MCU3_SW_Ver_Nidec: implementation-data-type=uint16
    DT_CAN3_SG_Shifter1
      4 x element, all with category=TYPE_REFERENCE, implementation-data-type=uint8:
        CAN3_Shifter_CRC8
        CAN3_Shifter_Fail_sta
        CAN3_Shifter_Handle_Cmd
        CAN3_Shifter_RC
    DT_CAN3_SG_Shifter2
      6 x element, all with category=TYPE_REFERENCE, implementation-data-type=uint8:
        CAN3_CSW2_DimSw_Sta
        CAN3_CSW2_FWasSw_Sta
        CAN3_CSW2_FWipSw_Sta
        CAN3_CSW2_PassSW_Sta
        CAN3_CSW2_RWipWasSw_Sta
        CAN3_CSW2_TurnSw_Sta
