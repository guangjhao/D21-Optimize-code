AUTOSAR XML (schema 4-3-0)
package /CANInterface_ARPkg
  96 x sender receiver interface:
    IF_CAN1_SG_ABM1
      data CAN1_SG_ABM1: type=DT_CAN1_SG_ABM1
    IF_CAN1_SG_EPAS1
      data CAN1_SG_EPAS1: type=DT_CAN1_SG_EPAS1
    IF_CAN1_SG_EPAS2
      data CAN1_SG_EPAS2: type=DT_CAN1_SG_EPAS2
    IF_CAN1_SG_EPB1
      data CAN1_SG_EPB1: type=DT_CAN1_SG_EPB1
    IF_CAN1_SG_ESC1
      data CAN1_SG_ESC1: type=DT_CAN1_SG_ESC1
    IF_CAN1_SG_ESC2
      data CAN1_SG_ESC2: type=DT_CAN1_SG_ESC2
    IF_CAN1_SG_ESC3
      data CAN1_SG_ESC3: type=DT_CAN1_SG_ESC3
    IF_CAN1_SG_ESC4
      data CAN1_SG_ESC4: type=DT_CAN1_SG_ESC4
    IF_CAN1_SG_ESC5
      data CAN1_SG_ESC5: type=DT_CAN1_SG_ESC5
    IF_CAN1_SG_ESC6
      data CAN1_SG_ESC6: type=DT_CAN1_SG_ESC6
    IF_CAN1_SG_ESC7
      data CAN1_SG_ESC7: type=DT_CAN1_SG_ESC7
    IF_CAN1_SG_FCM2
      data CAN1_SG_FCM2: type=DT_CAN1_SG_FCM2
    IF_CAN1_SG_FCM3
      data CAN1_SG_FCM3: type=DT_CAN1_SG_FCM3
    IF_CAN1_SG_FCM4
      data CAN1_SG_FCM4: type=DT_CAN1_SG_FCM4
    IF_CAN1_SG_FD_APS1
      data CAN1_SG_FD_APS1: type=DT_CAN1_SG_FD_APS1
    IF_CAN1_SG_FD_APS2
      data CAN1_SG_FD_APS2: type=DT_CAN1_SG_FD_APS2
    IF_CAN1_SG_FD_APS3
      data CAN1_SG_FD_APS3: type=DT_CAN1_SG_FD_APS3
    IF_CAN1_SG_FD_BCM1
      data CAN1_SG_FD_BCM1: type=DT_CAN1_SG_FD_BCM1
    IF_CAN1_SG_FD_THCM1
      data CAN1_SG_FD_THCM1: type=DT_CAN1_SG_FD_THCM1
    IF_CAN1_SG_FD_VCU1
      data CAN1_SG_FD_VCU1: type=DT_CAN1_SG_FD_VCU1
    IF_CAN1_SG_FD_VCU2
      data CAN1_SG_FD_VCU2: type=DT_CAN1_SG_FD_VCU2
    IF_CAN1_SG_FD_VCU3
      data CAN1_SG_FD_VCU3: type=DT_CAN1_SG_FD_VCU3
    IF_CAN1_SG_FD_VCU4
      data CAN1_SG_FD_VCU4: type=DT_CAN1_SG_FD_VCU4
    IF_CAN1_SG_SRR1
      data CAN1_SG_SRR1: type=DT_CAN1_SG_SRR1
    IF_CAN2_SG_FD_APS1
      data CAN2_SG_FD_APS1: type=DT_CAN2_SG_FD_APS1
    IF_CAN2_SG_FD_APS2
      data CAN2_SG_FD_APS2: type=DT_CAN2_SG_FD_APS2
    IF_CAN2_SG_FD_APS3
      data CAN2_SG_FD_APS3: type=DT_CAN2_SG_FD_APS3
    IF_CAN2_SG_FD_BCM1
      data CAN2_SG_FD_BCM1: type=DT_CAN2_SG_FD_BCM1
    IF_CAN2_SG_FD_BCM2
      data CAN2_SG_FD_BCM2: type=DT_CAN2_SG_FD_BCM2
    IF_CAN2_SG_FD_OTA1
      data CAN2_SG_FD_OTA1: type=DT_CAN2_SG_FD_OTA1
    IF_CAN2_SG_FD_THCM1
      data CAN2_SG_FD_THCM1: type=DT_CAN2_SG_FD_THCM1
    IF_CAN2_SG_FD_TPMS1
      data CAN2_SG_FD_TPMS1: type=DT_CAN2_SG_FD_TPMS1
    IF_CAN2_SG_FD_TPMS2
      data CAN2_SG_FD_TPMS2: type=DT_CAN2_SG_FD_TPMS2
    IF_CAN2_SG_FD_V2L1
      data CAN2_SG_FD_V2L1: type=DT_CAN2_SG_FD_V2L1
    IF_CAN2_SG_FD_VCU0
      data CAN2_SG_FD_VCU0: type=DT_CAN2_SG_FD_VCU0
    IF_CAN2_SG_FD_VCU1
      data CAN2_SG_FD_VCU1: type=DT_CAN2_SG_FD_VCU1
    IF_CAN2_SG_FD_VCU2
      data CAN2_SG_FD_VCU2: type=DT_CAN2_SG_FD_VCU2
    IF_CAN2_SG_FD_VCU4
      data CAN2_SG_FD_VCU4: type=DT_CAN2_SG_FD_VCU4
    IF_CAN2_SG_FD_VCU5
      data CAN2_SG_FD_VCU5: type=DT_CAN2_SG_FD_VCU5
    IF_CAN2_SG_FD_VCU6
      data CAN2_SG_FD_VCU6: type=DT_CAN2_SG_FD_VCU6
    IF_CAN2_SG_FD_VMC1
      data CAN2_SG_FD_VMC1: type=DT_CAN2_SG_FD_VMC1
    IF_CAN2_SG_IVI1
      data CAN2_SG_IVI1: type=DT_CAN2_SG_IVI1
    IF_CAN2_SG_IVI2
      data CAN2_SG_IVI2: type=DT_CAN2_SG_IVI2
    IF_CAN2_SG_IVI6
      data CAN2_SG_IVI6: type=DT_CAN2_SG_IVI6
    IF_CAN2_SG_METER1
      data CAN2_SG_METER1: type=DT_CAN2_SG_METER1
    IF_CAN3_SG_BMS1
      data CAN3_SG_BMS1: type=DT_CAN3_SG_BMS1
    IF_CAN3_SG_BMS2
      data CAN3_SG_BMS2: type=DT_CAN3_SG_BMS2
    IF_CAN3_SG_BMS3
      data CAN3_SG_BMS3: type=DT_CAN3_SG_BMS3
    IF_CAN3_SG_BMS4
      data CAN3_SG_BMS4: type=DT_CAN3_SG_BMS4
    IF_CAN3_SG_BMS6
      data CAN3_SG_BMS6: type=DT_CAN3_SG_BMS6
    IF_CAN3_SG_BMS7
      data CAN3_SG_BMS7: type=DT_CAN3_SG_BMS7
    IF_CAN3_SG_CCU1
      data CAN3_SG_CCU1: type=DT_CAN3_SG_CCU1
    IF_CAN3_SG_CCU2
      data CAN3_SG_CCU2: type=DT_CAN3_SG_CCU2
    IF_CAN3_SG_CCU4
      data CAN3_SG_CCU4: type=DT_CAN3_SG_CCU4
    IF_CAN3_SG_FD_BCM1
      data CAN3_SG_FD_BCM1: type=DT_CAN3_SG_FD_BCM1
    IF_CAN3_SG_FD_OTA1
      data CAN3_SG_FD_OTA1: type=DT_CAN3_SG_FD_OTA1
    IF_CAN3_SG_FD_THCM1
      data CAN3_SG_FD_THCM1: type=DT_CAN3_SG_FD_THCM1
    IF_CAN3_SG_FD_THCM2
      data CAN3_SG_FD_THCM2: type=DT_CAN3_SG_FD_THCM2
    IF_CAN3_SG_FD_V2L1
      data CAN3_SG_FD_V2L1: type=DT_CAN3_SG_FD_V2L1
    IF_CAN3_SG_FD_VCU0
      data CAN3_SG_FD_VCU0: type=DT_CAN3_SG_FD_VCU0
    IF_CAN3_SG_FD_VCU1
      data CAN3_SG_FD_VCU1: type=DT_CAN3_SG_FD_VCU1
    IF_CAN3_SG_FD_VCU2
      data CAN3_SG_FD_VCU2: type=DT_CAN3_SG_FD_VCU2
    IF_CAN3_SG_MCU_F1
      data CAN3_SG_MCU_F1: type=DT_CAN3_SG_MCU_F1
    IF_CAN3_SG_MCU_F2
      data CAN3_SG_MCU_F2: type=DT_CAN3_SG_MCU_F2
    IF_CAN3_SG_MCU_R1
      data CAN3_SG_MCU_R1: type=DT_CAN3_SG_MCU_R1
    IF_CAN3_SG_MCU_R2
      data CAN3_SG_MCU_R2: type=DT_CAN3_SG_MCU_R2
    IF_CAN3_SG_Shifter1
      data CAN3_SG_Shifter1: type=DT_CAN3_SG_Shifter1
    IF_CAN4_SG_DKC1
      data CAN4_SG_DKC1: type=DT_CAN4_SG_DKC1
    IF_CAN4_SG_DKC2
      data CAN4_SG_DKC2: type=DT_CAN4_SG_DKC2
    IF_CAN4_SG_FD4_CE100_2
      data CAN4_SG_FD4_CE100_2: type=DT_CAN4_SG_FD4_CE100_2
    IF_CAN4_SG_FD_DKC1
      data CAN4_SG_FD_DKC1: type=DT_CAN4_SG_FD_DKC1
    IF_CAN4_SG_FD_OTA1
      data CAN4_SG_FD_OTA1: type=DT_CAN4_SG_FD_OTA1
    IF_CAN4_SG_FD_THCM1
      data CAN4_SG_FD_THCM1: type=DT_CAN4_SG_FD_THCM1
    IF_CAN4_SG_FD_THCM2
      data CAN4_SG_FD_THCM2: type=DT_CAN4_SG_FD_THCM2
    IF_CAN4_SG_FD_VCU1
      data CAN4_SG_FD_VCU1: type=DT_CAN4_SG_FD_VCU1
    IF_CAN4_SG_GW_ZDR_PTG1
      data CAN4_SG_GW_ZDR_PTG1: type=DT_CAN4_SG_GW_ZDR_PTG1
    IF_CAN4_SG_GW_ZoneDR1
      data CAN4_SG_GW_ZoneDR1: type=DT_CAN4_SG_GW_ZoneDR1
    IF_CAN4_SG_GW_ZoneDR2
      data CAN4_SG_GW_ZoneDR2: type=DT_CAN4_SG_GW_ZoneDR2
    IF_CAN4_SG_GW_ZoneDR3
      data CAN4_SG_GW_ZoneDR3: type=DT_CAN4_SG_GW_ZoneDR3
    IF_CAN4_SG_GW_ZoneDR4
      data CAN4_SG_GW_ZoneDR4: type=DT_CAN4_SG_GW_ZoneDR4
    IF_CAN4_SG_GW_ZoneDR6
      data CAN4_SG_GW_ZoneDR6: type=DT_CAN4_SG_GW_ZoneDR6
    IF_CAN4_SG_GW_ZoneFR1
      data CAN4_SG_GW_ZoneFR1: type=DT_CAN4_SG_GW_ZoneFR1
    IF_CAN4_SG_GW_ZoneFR2
      data CAN4_SG_GW_ZoneFR2: type=DT_CAN4_SG_GW_ZoneFR2
    IF_CAN4_SG_Zone_Dr_SCP
      data CAN4_SG_Zone_Dr_SCP: type=DT_CAN4_SG_Zone_Dr_SCP
    IF_CAN4_SG_Zone_Dr_THCM
      data CAN4_SG_Zone_Dr_THCM: type=DT_CAN4_SG_Zone_Dr_THCM
    IF_CAN4_SG_Zone_Dr_VCU
      data CAN4_SG_Zone_Dr_VCU: type=DT_CAN4_SG_Zone_Dr_VCU
    IF_CAN4_SG_Zone_Fr_THCM
      data CAN4_SG_Zone_Fr_THCM: type=DT_CAN4_SG_Zone_Fr_THCM
    IF_CAN5_SG_FD_BCM1
      data CAN5_SG_FD_BCM1: type=DT_CAN5_SG_FD_BCM1
    IF_CAN5_SG_FD_CONN1
      data CAN5_SG_FD_CONN1: type=DT_CAN5_SG_FD_CONN1
    IF_CAN5_SG_FD_THCM2
      data CAN5_SG_FD_THCM2: type=DT_CAN5_SG_FD_THCM2
    IF_CAN5_SG_FD_VCU0
      data CAN5_SG_FD_VCU0: type=DT_CAN5_SG_FD_VCU0
    IF_CAN5_SG_FD_VCU1
      data CAN5_SG_FD_VCU1: type=DT_CAN5_SG_FD_VCU1
    IF_CAN5_SG_FD_VCU3
      data CAN5_SG_FD_VCU3: type=DT_CAN5_SG_FD_VCU3
    IF_CAN5_SG_FD_VCU4
      data CAN5_SG_FD_VCU4: type=DT_CAN5_SG_FD_VCU4
    IF_CAN5_SG_FD_VCU5
      data CAN5_SG_FD_VCU5: type=DT_CAN5_SG_FD_VCU5
    IF_CAN5_SG_TBOX1
      data CAN5_SG_TBOX1: type=DT_CAN5_SG_TBOX1
