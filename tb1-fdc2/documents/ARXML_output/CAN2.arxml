[part 2 of 3: package /CAN2/Cluster]
AUTOSAR XML (schema 4-3-0)
package /CAN2/Cluster
  can cluster CAN2: baudrate=500, can-fd-baudrate=2000
    can physical channel CAN2: comm-connectors=ConnCAN2
      frame CAN2_DiagFuncReqFT: id 0x7D0, frame-length=8, can-addressing-mode=STANDARD, can-fd-frame-support=true, can-frame-rx-behavior=CAN-FD, can-frame-tx-behavior=CAN-FD
        n pdu CAN2_DiagFuncReqFT: length=8
      frame CAN2_DiagPhysReqToIVI: id 0x6A0, frame-length=8, can-addressing-mode=STANDARD, can-fd-frame-support=true, can-frame-rx-behavior=CAN-FD, can-frame-tx-behavior=CAN-FD
        n pdu CAN2_DiagPhysReqToIVI: length=8
      frame CAN2_DiagRespFromIVI: id 0x620, frame-length=8, can-addressing-mode=STANDARD, can-fd-frame-support=true, can-frame-rx-behavior=CAN-FD, can-frame-tx-behavior=CAN-FD
        n pdu CAN2_DiagRespFromIVI: length=8
      frame CAN2_FD2_C200_1: id 0x18F001EF, frame-length=8, can-addressing-mode=EXTENDED, can-fd-frame-support=false, can-frame-rx-behavior=CAN-20, can-frame-tx-behavior=CAN-20
        pdu CAN2_FD2_C200_1: length=8, minimum-delay=0.0, transmission-mode-true-timing=cyclic-timing=time-period=0.1, unused-bit-pattern=0
          mapping CAN2_SG_FD2_C200_1: i-signal-group=CAN2_SG_FD2_C200_1, start-position=0, transfer-property=PENDING
          signal CAN2_FDC_CHA_CACPresWarn_Sta: start 9, 1 bit, little-endian, i-signal-type=PRIMITIVE, init-value=constant-reference=Init_CAN2_FDC_CHA_CACPresWarn_Sta, base-type=uint8, implementation-data-type=uint8, transfer-property=PENDING
          signal CAN2_FDC_CHA_CACTempWarn_Sta: start 48, 1 bit, big-endian, i-signal-type=PRIMITIVE, init-value=constant-reference=Init_CAN2_FDC_CHA_CACTempWarn_Sta, base-type=uint8, implementation-data-type=uint8, transfer-property=PENDING
      frame CAN2_FD2_C20_0: id 0x210, frame-length=32, can-addressing-mode=STANDARD, can-fd-frame-support=true, can-frame-rx-behavior=CAN-FD, can-frame-tx-behavior=CAN-FD
        pdu CAN2_FD2_C20_0: length=32, minimum-delay=0.0, transmission-mode-true-timing=cyclic-timing=time-period=0.02, unused-bit-pattern=0
          mapping CAN2_SG_FD2_C20_0: i-signal-group=CAN2_SG_FD2_C20_0, start-position=0, transfer-property=PENDING
          signal CAN2_APS_ExitCondition: start 151, 8 bit, big-endian, i-signal-type=PRIMITIVE, init-value=constant-reference=Init_CAN2_APS_ExitCondition, base-type=uint8, implementation-data-type=uint8, transfer-property=PENDING
          signal CAN2_APS_RQ_Display: start 207, 8 bit, big-endian, i-signal-type=PRIMITIVE, init-value=constant-reference=Init_CAN2_APS_RQ_Display, base-type=uint8, implementation-data-type=uint8, transfer-property=PENDING
          signal CAN2_APS_SW_Ver: start 167, 8 bit, big-endian, i-signal-type=PRIMITIVE, init-value=constant-reference=Init_CAN2_APS_SW_Ver, base-type=uint8, implementation-data-type=uint8, transfer-property=PENDING
          signal CAN2_APS_Sta_System: start 250, 3 bit, big-endian, i-signal-type=PRIMITIVE, init-value=constant-reference=Init_CAN2_APS_Sta_System, base-type=uint8, implementation-data-type=uint8, transfer-property=PENDING
          signal CAN2_CAAS_Sta: start 253, 3 bit, big-endian, i-signal-type=PRIMITIVE, init-value=constant-reference=Init_CAN2_CAAS_Sta, base-type=uint8, implementation-data-type=uint8, transfer-property=PENDING
          signal CAN2_FDC_VCU_RegenLimInd_Sta: start 71, 1 bit, big-endian, i-signal-type=PRIMITIVE, init-value=constant-reference=Init_CAN2_FDC_VCU_RegenLimInd_Sta, base-type=uint8, implementation-data-type=uint8, transfer-property=PENDING
          signal CAN2_FDC_VCU_RegenMode_Sta: start 74, 3 bit, big-endian, i-signal-type=PRIMITIVE, init-value=constant-reference=Init_CAN2_FDC_VCU_RegenMode_Sta, base-type=uint8, implementation-data-type=uint8, transfer-property=PENDING
          signal CAN2_FDC_VCU_SmartEcoSpdLim_Sta: start 67, 1 bit, big-endian, i-signal-type=PRIMITIVE, init-value=constant-reference=Init_CAN2_FDC_VCU_SmartEcoSpdLim_Sta, base-type=uint8, implementation-data-type=uint8, transfer-property=PENDING
          signal CAN2_FDC_VCU_SmartEco_Sta: start 75, 1 bit, big-endian, i-signal-type=PRIMITIVE, init-value=constant-reference=Init_CAN2_FDC_VCU_SmartEco_Sta, base-type=uint8, implementation-data-type=uint8, transfer-property=PENDING
          signal CAN2_FDC_VMC_SetSpdDisp_Sta: start 55, 8 bit, big-endian, i-signal-type=PRIMITIVE, init-value=constant-reference=Init_CAN2_FDC_VMC_SetSpdDisp_Sta, base-type=uint8, implementation-data-type=uint8, transfer-property=PENDING
          signal CAN2_FDC_VMC_SetSpd_Sta: start 63, 8 bit, big-endian, i-signal-type=PRIMITIVE, init-value=constant-reference=Init_CAN2_FDC_VMC_SetSpd_Sta, base-type=uint8, implementation-data-type=uint8, transfer-property=PENDING
          signal CAN2_FDC_VMC_SpdCtrlMode_Sta: start 10, 3 bit, big-endian, i-signal-type=PRIMITIVE, init-value=constant-reference=Init_CAN2_FDC_VMC_SpdCtrlMode_Sta, base-type=uint8, implementation-data-type=uint8, transfer-property=PENDING
          signal CAN2_FDC_VMC_SpdCtrl_Sta: start 11, 1 bit, big-endian, i-signal-type=PRIMITIVE, init-value=constant-reference=Init_CAN2_FDC_VMC_SpdCtrl_Sta, base-type=uint8, implementation-data-type=uint8, transfer-property=PENDING
          signal CAN2_PAS_A_FCL: start 219, 4 bit, big-endian, i-signal-type=PRIMITIVE, init-value=constant-reference=Init_CAN2_PAS_A_FCL, base-type=uint8, implementation-data-type=uint8, transfer-property=PENDING
          signal CAN2_PAS_A_FCR: start 23, 4 bit, big-endian, i-signal-type=PRIMITIVE, init-value=constant-reference=Init_CAN2_PAS_A_FCR, base-type=uint8, implementation-data-type=uint8, transfer-property=PENDING
          signal CAN2_PAS_A_FML: start 19, 4 bit, big-endian, i-signal-type=PRIMITIVE, init-value=constant-reference=Init_CAN2_PAS_A_FML, base-type=uint8, implementation-data-type=uint8, transfer-property=PENDING
          signal CAN2_PAS_A_FMR: start 31, 4 bit, big-endian, i-signal-type=PRIMITIVE, init-value=constant-reference=Init_CAN2_PAS_A_FMR, base-type=uint8, implementation-data-type=uint8, transfer-property=PENDING
          signal CAN2_PAS_A_RCL: start 27, 4 bit, big-endian, i-signal-type=PRIMITIVE, init-value=constant-reference=Init_CAN2_PAS_A_RCL, base-type=uint8, implementation-data-type=uint8, transfer-property=PENDING
          signal CAN2_PAS_A_RCR: start 39, 4 bit, big-endian, i-signal-type=PRIMITIVE, init-value=constant-reference=Init_CAN2_PAS_A_RCR, base-type=uint8, implementation-data-type=uint8, transfer-property=PENDING
          signal CAN2_PAS_A_RML: start 35, 4 bit, big-endian, i-signal-type=PRIMITIVE, init-value=constant-reference=Init_CAN2_PAS_A_RML, base-type=uint8, implementation-data-type=uint8, transfer-property=PENDING
          signal CAN2_PAS_A_RMR: start 47, 4 bit, big-endian, i-signal-type=PRIMITIVE, init-value=constant-reference=Init_CAN2_PAS_A_RMR, base-type=uint8, implementation-data-type=uint8, transfer-property=PENDING
          signal CAN2_PAS_Chime: start 223, 4 bit, big-endian, i-signal-type=PRIMITIVE, init-value=constant-reference=Init_CAN2_PAS_Chime, base-type=uint8, implementation-data-type=uint8, transfer-property=PENDING
          signal CAN2_PAS_D_FCL: start 119, 8 bit, big-endian, i-signal-type=PRIMITIVE, init-value=constant-reference=Init_CAN2_PAS_D_FCL, base-type=uint8, implementation-data-type=uint8, transfer-property=PENDING
          signal CAN2_PAS_D_FCR: start 127, 8 bit, big-endian, i-signal-type=PRIMITIVE, init-value=constant-reference=Init_CAN2_PAS_D_FCR, base-type=uint8, implementation-data-type=uint8, transfer-property=PENDING
          signal CAN2_PAS_D_FML: start 135, 8 bit, big-endian, i-signal-type=PRIMITIVE, init-value=constant-reference=Init_CAN2_PAS_D_FML, base-type=uint8, implementation-data-type=uint8, transfer-property=PENDING
          signal CAN2_PAS_D_FMR: start 143, 8 bit, big-endian, i-signal-type=PRIMITIVE, init-value=constant-reference=Init_CAN2_PAS_D_FMR, base-type=uint8, implementation-data-type=uint8, transfer-property=PENDING
          signal CAN2_PAS_D_RCL: start 175, 8 bit, big-endian, i-signal-type=PRIMITIVE, init-value=constant-reference=Init_CAN2_PAS_D_RCL, base-type=uint8, implementation-data-type=uint8, transfer-property=PENDING
          signal CAN2_PAS_D_RCR: start 183, 8 bit, big-endian, i-signal-type=PRIMITIVE, init-value=constant-reference=Init_CAN2_PAS_D_RCR, base-type=uint8, implementation-data-type=uint8, transfer-property=PENDING
          signal CAN2_PAS_D_RML: start 191, 8 bit, big-endian, i-signal-type=PRIMITIVE, init-value=constant-reference=Init_CAN2_PAS_D_RML, base-type=uint8, implementation-data-type=uint8, transfer-property=PENDING
          signal CAN2_PAS_D_RMR: start 199, 8 bit, big-endian, i-signal-type=PRIMITIVE, init-value=constant-reference=Init_CAN2_PAS_D_RMR, base-type=uint8, implementation-data-type=uint8, transfer-property=PENDING
          signal CAN2_PAS_SNSR_Layout: start 43, 4 bit, big-endian, i-signal-type=PRIMITIVE, init-value=constant-reference=Init_CAN2_PAS_SNSR_Layout, base-type=uint8, implementation-data-type=uint8, transfer-property=PENDING
          signal CAN2_USS_Sta_FCL: start 7, 1 bit, big-endian, i-signal-type=PRIMITIVE, init-value=constant-reference=Init_CAN2_USS_Sta_FCL, base-type=uint8, implementation-data-type=uint8, transfer-property=PENDING
          signal CAN2_USS_Sta_FCR: start 6, 1 bit, big-endian, i-signal-type=PRIMITIVE, init-value=constant-reference=Init_CAN2_USS_Sta_FCR, base-type=uint8, implementation-data-type=uint8, transfer-property=PENDING
          signal CAN2_USS_Sta_FLL: start 5, 1 bit, big-endian, i-signal-type=PRIMITIVE, init-value=constant-reference=Init_CAN2_USS_Sta_FLL, base-type=uint8, implementation-data-type=uint8, transfer-property=PENDING
          signal CAN2_USS_Sta_FLR: start 4, 1 bit, big-endian, i-signal-type=PRIMITIVE, init-value=constant-reference=Init_CAN2_USS_Sta_FLR, base-type=uint8, implementation-data-type=uint8, transfer-property=PENDING
          signal CAN2_USS_Sta_FML: start 3, 1 bit, big-endian, i-signal-type=PRIMITIVE, init-value=constant-reference=Init_CAN2_USS_Sta_FML, base-type=uint8, implementation-data-type=uint8, transfer-property=PENDING
          signal CAN2_USS_Sta_FMR: start 2, 1 bit, big-endian, i-signal-type=PRIMITIVE, init-value=constant-reference=Init_CAN2_USS_Sta_FMR, base-type=uint8, implementation-data-type=uint8, transfer-property=PENDING
          signal CAN2_USS_Sta_RCL: start 1, 1 bit, big-endian, i-signal-type=PRIMITIVE, init-value=constant-reference=Init_CAN2_USS_Sta_RCL, base-type=uint8, implementation-data-type=uint8, transfer-property=PENDING
          signal CAN2_USS_Sta_RCR: start 0, 1 bit, big-endian, i-signal-type=PRIMITIVE, init-value=constant-reference=Init_CAN2_USS_Sta_RCR, base-type=uint8, implementation-data-type=uint8, transfer-property=PENDING
          signal CAN2_USS_Sta_RLL: start 15, 1 bit, big-endian, i-signal-type=PRIMITIVE, init-value=constant-reference=Init_CAN2_USS_Sta_RLL, base-type=uint8, implementation-data-type=uint8, transfer-property=PENDING
          signal CAN2_USS_Sta_RLR: start 14, 1 bit, big-endian, i-signal-type=PRIMITIVE, init-value=constant-reference=Init_CAN2_USS_Sta_RLR, base-type=uint8, implementation-data-type=uint8, transfer-property=PENDING
          signal CAN2_USS_Sta_RML: start 13, 1 bit, big-endian, i-signal-type=PRIMITIVE, init-value=constant-reference=Init_CAN2_USS_Sta_RML, base-type=uint8, implementation-data-type=uint8, transfer-property=PENDING
          signal CAN2_USS_Sta_RMR: start 12, 1 bit, big-endian, i-signal-type=PRIMITIVE, init-value=constant-reference=Init_CAN2_USS_Sta_RMR, base-type=uint8, implementation-data-type=uint8, transfer-property=PENDING
          signal CAN2_VMC_VCU_CC_Crl_Sta: start 66, 3 bit, big-endian, i-signal-type=PRIMITIVE, init-value=constant-reference=Init_CAN2_VMC_VCU_CC_Crl_Sta, base-type=uint8, implementation-data-type=uint8, transfer-property=PENDING
          signal CAN2_VMC_VCU_MSA_Crl_Sta: start 70, 3 bit, big-endian, i-signal-type=PRIMITIVE, init-value=constant-reference=Init_CAN2_VMC_VCU_MSA_Crl_Sta, base-type=uint8, implementation-data-type=uint8, transfer-property=PENDING
      frame CAN2_FD2_CE100_0: id 0x117, frame-length=64, can-addressing-mode=STANDARD, can-fd-frame-support=true, can-frame-rx-behavior=CAN-FD, can-frame-tx-behavior=CAN-FD
        pdu CAN2_FD2_CE100_0: length=64, minimum-delay=0.0, transmission-mode-true-timing={cyclic-timing=time-period=0.1, event-controlled-timing={number-of-repetitions=0, repetition-period=0}}, unused-bit-pattern=0
          mapping CAN2_SG_FD2_CE100_0: i-signal-group=CAN2_SG_FD2_CE100_0, start-position=0, transfer-property=TRIGGERED-ON-CHANGE
          signal CAN2_APMDoorControlSta: start 219, 1 bit, big-endian, i-signal-type=PRIMITIVE, init-value=constant-reference=Init_CAN2_APMDoorControlSta, base-type=uint8, implementation-data-type=uint8, transfer-property=PENDING
          signal CAN2_ActAPSPosn: start 175, 8 bit, big-endian, i-signal-type=PRIMITIVE, init-value=constant-reference=Init_CAN2_ActAPSPosn, base-type=uint8, implementation-data-type=uint8, transfer-property=PENDING
          signal CAN2_AllDoorSW: start 205, 1 bit, big-endian, i-signal-type=PRIMITIVE, init-value=constant-reference=Init_CAN2_AllDoorSW, base-type=uint8, implementation-data-type=uint8, transfer-property=TRIGGERED-ON-CHANGE
          signal CAN2_AntitheftSta: start 244, 2 bit, big-endian, i-signal-type=PRIMITIVE, init-value=constant-reference=Init_CAN2_AntitheftSta, base-type=uint8, implementation-data-type=uint8, transfer-property=TRIGGERED-ON-CHANGE
          signal CAN2_BCM_DoorLock_Sta: start 240, 1 bit, big-endian, i-signal-type=PRIMITIVE, init-value=constant-reference=Init_CAN2_BCM_DoorLock_Sta, base-type=uint8, implementation-data-type=uint8, transfer-property=TRIGGERED-ON-CHANGE
          signal CAN2_BrakeLamp: start 236, 1 bit, big-endian, i-signal-type=PRIMITIVE, init-value=constant-reference=Init_CAN2_BrakeLamp, base-type=uint8, implementation-data-type=uint8, transfer-property=TRIGGERED-ON-CHANGE
          signal CAN2_CCMSA_SpdWar: start 167, 1 bit, big-endian, i-signal-type=PRIMITIVE, init-value=constant-reference=Init_CAN2_CCMSA_SpdWar, base-type=uint8, implementation-data-type=uint8, transfer-property=PENDING
          signal CAN2_CCU_ACLampSts: start 45, 1 bit, big-endian, i-signal-type=PRIMITIVE, init-value=constant-reference=Init_CAN2_CCU_ACLampSts, base-type=uint8, implementation-data-type=uint8, transfer-property=PENDING
          signal CAN2_CCU_ACMaxLampSts: start 40, 1 bit, big-endian, i-signal-type=PRIMITIVE, init-value=constant-reference=Init_CAN2_CCU_ACMaxLampSts, base-type=uint8, implementation-data-type=uint8, transfer-property=PENDING
          signal CAN2_CCU_AutoLampSts: start 41, 1 bit, big-endian, i-signal-type=PRIMITIVE, init-value=constant-reference=Init_CAN2_CCU_AutoLampSts, base-type=uint8, implementation-data-type=uint8, transfer-property=PENDING
          signal CAN2_CCU_AutoMidLampSts: start 42, 1 bit, big-endian, i-signal-type=PRIMITIVE, init-value=constant-reference=Init_CAN2_CCU_AutoMidLampSts, base-type=uint8, implementation-data-type=uint8, transfer-property=PENDING
          signal CAN2_CCU_Dispaly_Request: start 44, 1 bit, big-endian, i-signal-type=PRIMITIVE, init-value=constant-reference=Init_CAN2_CCU_Dispaly_Request, base-type=uint8, implementation-data-type=uint8, transfer-property=PENDING
          signal CAN2_CCU_EcoSts: start 43, 1 bit, big-endian, i-signal-type=PRIMITIVE, init-value=constant-reference=Init_CAN2_CCU_EcoSts, base-type=uint8, implementation-data-type=uint8, transfer-property=PENDING
          signal CAN2_CCU_FrtOnOffLampSts: start 51, 1 bit, big-endian, i-signal-type=PRIMITIVE, init-value=constant-reference=Init_CAN2_CCU_FrtOnOffLampSts, base-type=uint8, implementation-data-type=uint8, transfer-property=PENDING
          signal CAN2_CCU_RrOnOffLampSts: start 55, 1 bit, big-endian, i-signal-type=PRIMITIVE, init-value=constant-reference=Init_CAN2_CCU_RrOnOffLampSts, base-type=uint8, implementation-data-type=uint8, transfer-property=PENDING
          signal CAN2_CCU_SyncLampSts: start 71, 1 bit, big-endian, i-signal-type=PRIMITIVE, init-value=constant-reference=Init_CAN2_CCU_SyncLampSts, base-type=uint8, implementation-data-type=uint8, transfer-property=PENDING
          signal CAN2_CC_Crl_Sta: start 26, 3 bit, big-endian, i-signal-type=PRIMITIVE, init-value=constant-reference=Init_CAN2_CC_Crl_Sta, base-type=uint8, implementation-data-type=uint8, transfer-property=TRIGGERED-ON-CHANGE
          signal CAN2_CoastDwModeStaChk: start 17, 2 bit, big-endian, i-signal-type=PRIMITIVE, init-value=constant-reference=Init_CAN2_CoastDwModeStaChk, base-type=uint8, implementation-data-type=uint8, transfer-property=PENDING
          signal CAN2_CreepSW_Sta: start 23, 1 bit, big-endian, i-signal-type=PRIMITIVE, init-value=constant-reference=Init_CAN2_CreepSW_Sta, base-type=uint8, implementation-data-type=uint8, transfer-property=TRIGGERED-ON-CHANGE
          signal CAN2_DISC_ButtSta: start 143, 1 bit, big-endian, i-signal-type=PRIMITIVE, init-value=constant-reference=Init_CAN2_DISC_ButtSta, base-type=uint8, implementation-data-type=uint8, transfer-property=PENDING
          signal CAN2_DISC_Sta: start 159, 2 bit, big-endian, i-signal-type=PRIMITIVE, init-value=constant-reference=Init_CAN2_DISC_Sta, base-type=uint8, implementation-data-type=uint8, transfer-property=PENDING
          signal CAN2_DemoModeStaChk: start 31, 2 bit, big-endian, i-signal-type=PRIMITIVE, init-value=constant-reference=Init_CAN2_DemoModeStaChk, base-type=uint8, implementation-data-type=uint8, transfer-property=PENDING
          signal CAN2_Dimmer: start 254, 7 bit, big-endian, i-signal-type=PRIMITIVE, init-value=constant-reference=Init_CAN2_Dimmer, base-type=uint8, implementation-data-type=uint8, transfer-property=TRIGGERED-ON-CHANGE
          signal CAN2_DimmerEN: start 15, 1 bit, big-endian, i-signal-type=PRIMITIVE, init-value=constant-reference=Init_CAN2_DimmerEN, base-type=uint8, implementation-data-type=uint8, transfer-property=TRIGGERED-ON-CHANGE
          signal CAN2_DisengageP_Fail: start 21, 1 bit, big-endian, i-signal-type=PRIMITIVE, init-value=constant-reference=Init_CAN2_DisengageP_Fail, base-type=uint8, implementation-data-type=uint8, transfer-property=TRIGGERED-ON-CHANGE
          signal CAN2_DoorLockIND: start 204, 1 bit, big-endian, i-signal-type=PRIMITIVE, init-value=constant-reference=Init_CAN2_DoorLockIND, base-type=uint8, implementation-data-type=uint8, transfer-property=TRIGGERED-ON-CHANGE
          signal CAN2_DrDoorSW: start 225, 1 bit, big-endian, i-signal-type=PRIMITIVE, init-value=constant-reference=Init_CAN2_DrDoorSW, base-type=uint8, implementation-data-type=uint8, transfer-property=TRIGGERED-ON-CHANGE
          signal CAN2_Dr_SeatSta: start 239, 2 bit, big-endian, i-signal-type=PRIMITIVE, init-value=constant-reference=Init_CAN2_Dr_SeatSta, base-type=uint8, implementation-data-type=uint8, transfer-property=TRIGGERED-ON-CHANGE
          signal CAN2_DynoModeStaChk: start 19, 2 bit, big-endian, i-signal-type=PRIMITIVE, init-value=constant-reference=Init_CAN2_DynoModeStaChk, base-type=uint8, implementation-data-type=uint8, transfer-property=PENDING
          signal CAN2_EDriveSysErr_AccPedalErr: start 141, 1 bit, big-endian, i-signal-type=PRIMITIVE, init-value=constant-reference=Init_CAN2_EDriveSysErr_AccPedalErr, base-type=uint8, implementation-data-type=uint8, transfer-property=TRIGGERED-ON-CHANGE
          signal CAN2_EDriveSysErr_MCUErr: start 203, 1 bit, big-endian, i-signal-type=PRIMITIVE, init-value=constant-reference=Init_CAN2_EDriveSysErr_MCUErr, base-type=uint8, implementation-data-type=uint8, transfer-property=TRIGGERED-ON-CHANGE
          signal CAN2_EDriveSysErr_ShifterErr: start 223, 1 bit, big-endian, i-signal-type=PRIMITIVE, init-value=constant-reference=Init_CAN2_EDriveSysErr_ShifterErr, base-type=uint8, implementation-data-type=uint8, transfer-property=TRIGGERED-ON-CHANGE
          signal CAN2_EDriveSysErr_VCUErr: start 142, 1 bit, big-endian, i-signal-type=PRIMITIVE, init-value=constant-reference=Init_CAN2_EDriveSysErr_VCUErr, base-type=uint8, implementation-data-type=uint8, transfer-property=TRIGGERED-ON-CHANGE
          signal CAN2_EVDriveMode: start 157, 2 bit, big-endian, i-signal-type=PRIMITIVE, init-value=constant-reference=Init_CAN2_EVDriveMode, base-type=uint8, implementation-data-type=uint8, transfer-property=TRIGGERED-ON-CHANGE
          signal CAN2_Eng_ActvDmpDisabSta: start 153, 2 bit, big-endian, i-signal-type=PRIMITIVE, init-value=constant-reference=Init_CAN2_Eng_ActvDmpDisabSta, base-type=uint8, implementation-data-type=uint8, transfer-property=TRIGGERED-ON-CHANGE
          signal CAN2_Eng_CoastDwSta: start 155, 2 bit, big-endian, i-signal-type=PRIMITIVE, init-value=constant-reference=Init_CAN2_Eng_CoastDwSta, base-type=uint8, implementation-data-type=uint8, transfer-property=TRIGGERED-ON-CHANGE
          signal CAN2_Eng_PwrLockSta: start 185, 2 bit, big-endian, i-signal-type=PRIMITIVE, init-value=constant-reference=Init_CAN2_Eng_PwrLockSta, base-type=uint8, implementation-data-type=uint8, transfer-property=TRIGGERED-ON-CHANGE
          signal CAN2_EngageP_Fail: start 22, 1 bit, big-endian, i-signal-type=PRIMITIVE, init-value=constant-reference=Init_CAN2_EngageP_Fail, base-type=uint8, implementation-data-type=uint8, transfer-property=TRIGGERED-ON-CHANGE
          signal CAN2_FDC_THCM_CLEVentY_Sta: start 271, 7 bit, big-endian, i-signal-type=PRIMITIVE, init-value=constant-reference=Init_CAN2_FDC_THCM_CLEVentY_Sta, base-type=uint8, implementation-data-type=uint8, transfer-property=PENDING
          signal CAN2_FDC_THCM_CLEVentZ_Sta: start 303, 7 bit, big-endian, i-signal-type=PRIMITIVE, init-value=constant-reference=Init_CAN2_FDC_THCM_CLEVentZ_Sta, base-type=uint8, implementation-data-type=uint8, transfer-property=PENDING
          signal CAN2_FDC_THCM_CLVent_Sta: start 256, 1 bit, big-endian, i-signal-type=PRIMITIVE, init-value=constant-reference=Init_CAN2_FDC_THCM_CLVent_Sta, base-type=uint8, implementation-data-type=uint8, transfer-property=TRIGGERED-ON-CHANGE
          signal CAN2_FDC_THCM_CREVentY_Sta: start 279, 7 bit, big-endian, i-signal-type=PRIMITIVE, init-value=constant-reference=Init_CAN2_FDC_THCM_CREVentY_Sta, base-type=uint8, implementation-data-type=uint8, transfer-property=PENDING
          signal CAN2_FDC_THCM_CREVentZ_Sta: start 311, 7 bit, big-endian, i-signal-type=PRIMITIVE, init-value=constant-reference=Init_CAN2_FDC_THCM_CREVentZ_Sta, base-type=uint8, implementation-data-type=uint8, transfer-property=PENDING
          signal CAN2_FDC_THCM_CRVent_Sta: start 272, 1 bit, big-endian, i-signal-type=PRIMITIVE, init-value=constant-reference=Init_CAN2_FDC_THCM_CRVent_Sta, base-type=uint8, implementation-data-type=uint8, transfer-property=TRIGGERED-ON-CHANGE
          signal CAN2_FDC_THCM_DrEVentMode_Sta: start 13, 3 bit, big-endian, i-signal-type=PRIMITIVE, init-value=constant-reference=Init_CAN2_FDC_THCM_DrEVentMode_Sta, base-type=uint8, implementation-data-type=uint8, transfer-property=TRIGGERED-ON-CHANGE
          signal CAN2_FDC_THCM_DrEVentY_Sta: start 7, 7 bit, big-endian, i-signal-type=PRIMITIVE, init-value=constant-reference=Init_CAN2_FDC_THCM_DrEVentY_Sta, base-type=uint8, implementation-data-type=uint8, transfer-property=PENDING
          signal CAN2_FDC_THCM_DrEVentZ_Sta: start 287, 7 bit, big-endian, i-signal-type=PRIMITIVE, init-value=constant-reference=Init_CAN2_FDC_THCM_DrEVentZ_Sta, base-type=uint8, implementation-data-type=uint8, transfer-property=PENDING
          signal CAN2_FDC_THCM_DrVent_Sta: start 0, 1 bit, big-endian, i-signal-type=PRIMITIVE, init-value=constant-reference=Init_CAN2_FDC_THCM_DrVent_Sta, base-type=uint8, implementation-data-type=uint8, transfer-property=TRIGGERED-ON-CHANGE
          signal CAN2_FDC_THCM_PsEVentMode_Sta: start 10, 3 bit, big-endian, i-signal-type=PRIMITIVE, init-value=constant-reference=Init_CAN2_FDC_THCM_PsEVentMode_Sta, base-type=uint8, implementation-data-type=uint8, transfer-property=TRIGGERED-ON-CHANGE
          signal CAN2_FDC_THCM_PsEVentY_Sta: start 263, 7 bit, big-endian, i-signal-type=PRIMITIVE, init-value=constant-reference=Init_CAN2_FDC_THCM_PsEVentY_Sta, base-type=uint8, implementation-data-type=uint8, transfer-property=PENDING
          signal CAN2_FDC_THCM_PsEVentZ_Sta: start 295, 7 bit, big-endian, i-signal-type=PRIMITIVE, init-value=constant-reference=Init_CAN2_FDC_THCM_PsEVentZ_Sta, base-type=uint8, implementation-data-type=uint8, transfer-property=PENDING
          signal CAN2_FDC_THCM_PsVent_Sta: start 264, 1 bit, big-endian, i-signal-type=PRIMITIVE, init-value=constant-reference=Init_CAN2_FDC_THCM_PsVent_Sta, base-type=uint8, implementation-data-type=uint8, transfer-property=TRIGGERED-ON-CHANGE
          signal CAN2_FDC_VCU_PwrSaveReq_Cmd: start 14, 1 bit, big-endian, i-signal-type=PRIMITIVE, init-value=constant-reference=Init_CAN2_FDC_VCU_PwrSaveReq_Cmd, base-type=uint8, implementation-data-type=uint8, transfer-property=TRIGGERED-ON-CHANGE
          signal CAN2_FD_ABS_Warning: start 183, 2 bit, big-endian, i-signal-type=PRIMITIVE, init-value=constant-reference=Init_CAN2_FD_ABS_Warning, base-type=uint8, implementation-data-type=uint8, transfer-property=TRIGGERED-ON-CHANGE
          signal CAN2_FD_Battery_Charge_Warning: start 181, 2 bit, big-endian, i-signal-type=PRIMITIVE, init-value=constant-reference=Init_CAN2_FD_Battery_Charge_Warning, base-type=uint8, implementation-data-type=uint8, transfer-property=TRIGGERED-ON-CHANGE
          signal CAN2_FD_EDrive_System: start 179, 2 bit, big-endian, i-signal-type=PRIMITIVE, init-value=constant-reference=Init_CAN2_FD_EDrive_System, base-type=uint8, implementation-data-type=uint8, transfer-property=TRIGGERED-ON-CHANGE
          signal CAN2_FD_EPB_Error: start 177, 2 bit, big-endian, i-signal-type=PRIMITIVE, init-value=constant-reference=Init_CAN2_FD_EPB_Error, base-type=uint8, implementation-data-type=uint8, transfer-property=TRIGGERED-ON-CHANGE
          signal CAN2_FD_HV_Battery_Fault: start 191, 2 bit, big-endian, i-signal-type=PRIMITIVE, init-value=constant-reference=Init_CAN2_FD_HV_Battery_Fault, base-type=uint8, implementation-data-type=uint8, transfer-property=TRIGGERED-ON-CHANGE
          signal CAN2_FD_Park_Brake_Warning: start 189, 2 bit, big-endian, i-signal-type=PRIMITIVE, init-value=constant-reference=Init_CAN2_FD_Park_Brake_Warning, base-type=uint8, implementation-data-type=uint8, transfer-property=TRIGGERED-ON-CHANGE
          signal CAN2_FD_Power_limitation: start 187, 2 bit, big-endian, i-signal-type=PRIMITIVE, init-value=constant-reference=Init_CAN2_FD_Power_limitation, base-type=uint8, implementation-data-type=uint8, transfer-property=TRIGGERED-ON-CHANGE
          signal CAN2_FD_Steering_Warning: start 161, 2 bit, big-endian, i-signal-type=PRIMITIVE, init-value=constant-reference=Init_CAN2_FD_Steering_Warning, base-type=uint8, implementation-data-type=uint8, transfer-property=TRIGGERED-ON-CHANGE
          signal CAN2_FD_TCS_Indicator: start 163, 2 bit, big-endian, i-signal-type=PRIMITIVE, init-value=constant-reference=Init_CAN2_FD_TCS_Indicator, base-type=uint8, implementation-data-type=uint8, transfer-property=TRIGGERED-ON-CHANGE
          signal CAN2_FD_Telltale_Fail: start 164, 1 bit, big-endian, i-signal-type=PRIMITIVE, init-value=constant-reference=Init_CAN2_FD_Telltale_Fail, base-type=uint8, implementation-data-type=uint8, transfer-property=TRIGGERED-ON-CHANGE
          signal CAN2_FalseNPrevent_Sta: start 20, 1 bit, big-endian, i-signal-type=PRIMITIVE, init-value=constant-reference=Init_CAN2_FalseNPrevent_Sta, base-type=uint8, implementation-data-type=uint8, transfer-property=TRIGGERED-ON-CHANGE
          signal CAN2_FeatSetSpdFinal_raw32: start 199, 8 bit, big-endian, i-signal-type=PRIMITIVE, init-value=constant-reference=Init_CAN2_FeatSetSpdFinal_raw32, base-type=uint8, implementation-data-type=uint8, transfer-property=TRIGGERED-ON-CHANGE
          signal CAN2_FollowMe: start 242, 1 bit, big-endian, i-signal-type=PRIMITIVE, init-value=constant-reference=Init_CAN2_FollowMe, base-type=uint8, implementation-data-type=uint8, transfer-property=PENDING
          signal CAN2_Fr_FogLamp: start 237, 1 bit, big-endian, i-signal-type=PRIMITIVE, init-value=constant-reference=Init_CAN2_Fr_FogLamp, base-type=uint8, implementation-data-type=uint8, transfer-property=TRIGGERED-ON-CHANGE
          signal CAN2_HVRlyOpFail: start 125, 1 bit, big-endian, i-signal-type=PRIMITIVE, init-value=constant-reference=Init_CAN2_HVRlyOpFail, base-type=uint8, implementation-data-type=uint8, transfer-property=TRIGGERED-ON-CHANGE
          signal CAN2_HVSysErr_IsolationErr: start 210, 1 bit, big-endian, i-signal-type=PRIMITIVE, init-value=constant-reference=Init_CAN2_HVSysErr_IsolationErr, base-type=uint8, implementation-data-type=uint8, transfer-property=TRIGGERED-ON-CHANGE
          signal CAN2_HVSysErr_PackErr: start 211, 1 bit, big-endian, i-signal-type=PRIMITIVE, init-value=constant-reference=Init_CAN2_HVSysErr_PackErr, base-type=uint8, implementation-data-type=uint8, transfer-property=TRIGGERED-ON-CHANGE
          signal CAN2_HVSysErr_RelayErr: start 212, 1 bit, big-endian, i-signal-type=PRIMITIVE, init-value=constant-reference=Init_CAN2_HVSysErr_RelayErr, base-type=uint8, implementation-data-type=uint8, transfer-property=TRIGGERED-ON-CHANGE
          signal CAN2_H_Beam: start 226, 1 bit, big-endian, i-signal-type=PRIMITIVE, init-value=constant-reference=Init_CAN2_H_Beam, base-type=uint8, implementation-data-type=uint8, transfer-property=TRIGGERED-ON-CHANGE
          signal CAN2_HazardSW: start 227, 1 bit, big-endian, i-signal-type=PRIMITIVE, init-value=constant-reference=Init_CAN2_HazardSW, base-type=uint8, implementation-data-type=uint8, transfer-property=TRIGGERED-ON-CHANGE
          signal CAN2_HoodSW: start 213, 1 bit, big-endian, i-signal-type=PRIMITIVE, init-value=constant-reference=Init_CAN2_HoodSW, base-type=uint8, implementation-data-type=uint8, transfer-property=TRIGGERED-ON-CHANGE
          signal CAN2_LBSD: start 230, 1 bit, big-endian, i-signal-type=PRIMITIVE, init-value=constant-reference=Init_CAN2_LBSD, base-type=uint8, implementation-data-type=uint8, transfer-property=TRIGGERED-ON-CHANGE
          signal CAN2_LDRL: start 233, 1 bit, big-endian, i-signal-type=PRIMITIVE, init-value=constant-reference=Init_CAN2_LDRL, base-type=uint8, implementation-data-type=uint8, transfer-property=TRIGGERED-ON-CHANGE
          signal CAN2_LTurnLP: start 246, 1 bit, big-endian, i-signal-type=PRIMITIVE, init-value=constant-reference=Init_CAN2_LTurnLP, base-type=uint8, implementation-data-type=uint8, transfer-property=TRIGGERED-ON-CHANGE
          signal CAN2_LVChrgFuncStaChk: start 39, 2 bit, big-endian, i-signal-type=PRIMITIVE, init-value=constant-reference=Init_CAN2_LVChrgFuncStaChk, base-type=uint8, implementation-data-type=uint8, transfer-property=PENDING
          signal CAN2_LVSysErr_PwrOutpErr: start 208, 1 bit, big-endian, i-signal-type=PRIMITIVE, init-value=constant-reference=Init_CAN2_LVSysErr_PwrOutpErr, base-type=uint8, implementation-data-type=uint8, transfer-property=TRIGGERED-ON-CHANGE
          signal CAN2_L_Beam: start 224, 1 bit, big-endian, i-signal-type=PRIMITIVE, init-value=constant-reference=Init_CAN2_L_Beam, base-type=uint8, implementation-data-type=uint8, transfer-property=TRIGGERED-ON-CHANGE
          signal CAN2_LimphomeAct: start 207, 1 bit, big-endian, i-signal-type=PRIMITIVE, init-value=constant-reference=Init_CAN2_LimphomeAct, base-type=uint8, implementation-data-type=uint8, transfer-property=TRIGGERED-ON-CHANGE
          signal CAN2_LockSetting: start 247, 1 bit, big-endian, i-signal-type=PRIMITIVE, init-value=constant-reference=Init_CAN2_LockSetting, base-type=uint8, implementation-data-type=uint8, transfer-property=TRIGGERED-ON-CHANGE
          signal CAN2_MCUActDisFail: start 115, 1 bit, big-endian, i-signal-type=PRIMITIVE, init-value=constant-reference=Init_CAN2_MCUActDisFail, base-type=uint8, implementation-data-type=uint8, transfer-property=TRIGGERED-ON-CHANGE
          signal CAN2_MSA_Crl_Sta: start 29, 3 bit, big-endian, i-signal-type=PRIMITIVE, init-value=constant-reference=Init_CAN2_MSA_Crl_Sta, base-type=uint8, implementation-data-type=uint8, transfer-property=TRIGGERED-ON-CHANGE
          signal CAN2_MeterIndSpeed_raw32: start 151, 8 bit, big-endian, i-signal-type=PRIMITIVE, init-value=constant-reference=Init_CAN2_MeterIndSpeed_raw32, base-type=uint8, implementation-data-type=uint8, transfer-property=PENDING
          signal CAN2_PAS_Sta_F_Sys: start 214, 1 bit, big-endian, i-signal-type=PRIMITIVE, init-value=constant-reference=Init_CAN2_PAS_Sta_F_Sys, base-type=uint8, implementation-data-type=uint8, transfer-property=PENDING
          signal CAN2_PosLamp: start 232, 1 bit, big-endian, i-signal-type=PRIMITIVE, init-value=constant-reference=Init_CAN2_PosLamp, base-type=uint8, implementation-data-type=uint8, transfer-property=TRIGGERED-ON-CHANGE
          signal CAN2_PsDoorSW: start 229, 1 bit, big-endian, i-signal-type=PRIMITIVE, init-value=constant-reference=Init_CAN2_PsDoorSW, base-type=uint8, implementation-data-type=uint8, transfer-property=TRIGGERED-ON-CHANGE
          signal CAN2_PwrSta: start 34, 3 bit, big-endian, i-signal-type=PRIMITIVE, init-value=constant-reference=Init_CAN2_PwrSta, base-type=uint8, implementation-data-type=uint8, transfer-property=TRIGGERED-ON-CHANGE
          signal CAN2_PwrStaErr: start 209, 1 bit, big-endian, i-signal-type=PRIMITIVE, init-value=constant-reference=Init_CAN2_PwrStaErr, base-type=uint8, implementation-data-type=uint8, transfer-property=TRIGGERED-ON-CHANGE
          signal CAN2_PwrStaONTOIVIPopReq: start 114, 1 bit, big-endian, i-signal-type=PRIMITIVE, init-value=constant-reference=Init_CAN2_PwrStaONTOIVIPopReq, base-type=uint8, implementation-data-type=uint8, transfer-property=TRIGGERED-ON-CHANGE
          signal CAN2_PwrStaONTOIVIPopT: start 123, 12 bit, big-endian, i-signal-type=PRIMITIVE, init-value=constant-reference=Init_CAN2_PwrStaONTOIVIPopT, base-type=uint16, implementation-data-type=uint16, transfer-property=TRIGGERED-ON-CHANGE
          signal CAN2_RBSD: start 241, 1 bit, big-endian, i-signal-type=PRIMITIVE, init-value=constant-reference=Init_CAN2_RBSD, base-type=uint8, implementation-data-type=uint8, transfer-property=TRIGGERED-ON-CHANGE
          signal CAN2_RDRL: start 234, 1 bit, big-endian, i-signal-type=PRIMITIVE, init-value=constant-reference=Init_CAN2_RDRL, base-type=uint8, implementation-data-type=uint8, transfer-property=TRIGGERED-ON-CHANGE
          signal CAN2_RLDoorSW: start 231, 1 bit, big-endian, i-signal-type=PRIMITIVE, init-value=constant-reference=Init_CAN2_RLDoorSW, base-type=uint8, implementation-data-type=uint8, transfer-property=TRIGGERED-ON-CHANGE
          signal CAN2_RRDoorSW: start 206, 1 bit, big-endian, i-signal-type=PRIMITIVE, init-value=constant-reference=Init_CAN2_RRDoorSW, base-type=uint8, implementation-data-type=uint8, transfer-property=TRIGGERED-ON-CHANGE
          signal CAN2_RTurnLP: start 245, 1 bit, big-endian, i-signal-type=PRIMITIVE, init-value=constant-reference=Init_CAN2_RTurnLP, base-type=uint8, implementation-data-type=uint8, transfer-property=TRIGGERED-ON-CHANGE
          signal CAN2_Req_Internal_V2L_Status_Lamp: start 217, 2 bit, big-endian, i-signal-type=PRIMITIVE, init-value=constant-reference=Init_CAN2_Req_Internal_V2L_Status_Lamp, base-type=uint8, implementation-data-type=uint8, transfer-property=PENDING
          signal CAN2_Req_V2LSwOn: start 140, 1 bit, big-endian, i-signal-type=PRIMITIVE, init-value=constant-reference=Init_CAN2_Req_V2LSwOn, base-type=uint8, implementation-data-type=uint8, transfer-property=TRIGGERED-ON-CHANGE
          signal CAN2_Req_V2L_IVI_Popup: start 139, 4 bit, big-endian, i-signal-type=PRIMITIVE, init-value=constant-reference=Init_CAN2_Req_V2L_IVI_Popup, base-type=uint8, implementation-data-type=uint8, transfer-property=TRIGGERED-ON-CHANGE
          signal CAN2_ReverseLamp: start 235, 1 bit, big-endian, i-signal-type=PRIMITIVE, init-value=constant-reference=Init_CAN2_ReverseLamp, base-type=uint8, implementation-data-type=uint8, transfer-property=TRIGGERED-ON-CHANGE
          signal CAN2_Rr_Defog: start 215, 1 bit, big-endian, i-signal-type=PRIMITIVE, init-value=constant-reference=Init_CAN2_Rr_Defog, base-type=uint8, implementation-data-type=uint8, transfer-property=TRIGGERED-ON-CHANGE
          signal CAN2_Rr_FogLamp: start 228, 1 bit, big-endian, i-signal-type=PRIMITIVE, init-value=constant-reference=Init_CAN2_Rr_FogLamp, base-type=uint8, implementation-data-type=uint8, transfer-property=TRIGGERED-ON-CHANGE
          signal CAN2_ShiftGearPosn: start 37, 3 bit, big-endian, i-signal-type=PRIMITIVE, init-value=constant-reference=Init_CAN2_ShiftGearPosn, base-type=uint8, implementation-data-type=uint8, transfer-property=TRIGGERED-ON-CHANGE
          signal CAN2_SysAllowReadySta: start 124, 1 bit, big-endian, i-signal-type=PRIMITIVE, init-value=constant-reference=Init_CAN2_SysAllowReadySta, base-type=uint8, implementation-data-type=uint8, transfer-property=TRIGGERED-ON-CHANGE
          signal CAN2_SysPwrSta: start 119, 4 bit, big-endian, i-signal-type=PRIMITIVE, init-value=constant-reference=Init_CAN2_SysPwrSta, base-type=uint8, implementation-data-type=uint8, transfer-property=TRIGGERED-ON-CHANGE
          signal CAN2_Tailgate_SW: start 255, 1 bit, big-endian, i-signal-type=PRIMITIVE, init-value=constant-reference=Init_CAN2_Tailgate_SW, base-type=uint8, implementation-data-type=uint8, transfer-property=TRIGGERED-ON-CHANGE
          signal CAN2_VCUBrkSWSta: start 87, 2 bit, big-endian, i-signal-type=PRIMITIVE, init-value=constant-reference=Init_CAN2_VCUBrkSWSta, base-type=uint8, implementation-data-type=uint8, transfer-property=TRIGGERED-ON-CHANGE
          signal CAN2_VCUFLDoorSta: start 113, 1 bit, big-endian, i-signal-type=PRIMITIVE, init-value=constant-reference=Init_CAN2_VCUFLDoorSta, base-type=uint8, implementation-data-type=uint8, transfer-property=TRIGGERED-ON-CHANGE
          signal CAN2_VCUFRDoorSta: start 112, 1 bit, big-endian, i-signal-type=PRIMITIVE, init-value=constant-reference=Init_CAN2_VCUFRDoorSta, base-type=uint8, implementation-data-type=uint8, transfer-property=TRIGGERED-ON-CHANGE
          signal CAN2_VCUHoodSWSta: start 166, 1 bit, big-endian, i-signal-type=PRIMITIVE, init-value=constant-reference=Init_CAN2_VCUHoodSWSta, base-type=uint8, implementation-data-type=uint8, transfer-property=TRIGGERED-ON-CHANGE
          signal CAN2_VCURLDoorSta: start 127, 1 bit, big-endian, i-signal-type=PRIMITIVE, init-value=constant-reference=Init_CAN2_VCURLDoorSta, base-type=uint8, implementation-data-type=uint8, transfer-property=TRIGGERED-ON-CHANGE
          signal CAN2_VCURRDoorSta: start 126, 1 bit, big-endian, i-signal-type=PRIMITIVE, init-value=constant-reference=Init_CAN2_VCURRDoorSta, base-type=uint8, implementation-data-type=uint8, transfer-property=TRIGGERED-ON-CHANGE
          signal CAN2_VCUTailgateSWSta: start 165, 1 bit, big-endian, i-signal-type=PRIMITIVE, init-value=constant-reference=Init_CAN2_VCUTailgateSWSta, base-type=uint8, implementation-data-type=uint8, transfer-property=TRIGGERED-ON-CHANGE
          signal CAN2_VCU_OPDHold: start 218, 1 bit, big-endian, i-signal-type=PRIMITIVE, init-value=constant-reference=Init_CAN2_VCU_OPDHold, base-type=uint8, implementation-data-type=uint8, transfer-property=PENDING
          signal CAN2_VehMalfunLevel: start 202, 3 bit, big-endian, i-signal-type=PRIMITIVE, init-value=constant-reference=Init_CAN2_VehMalfunLevel, base-type=uint8, implementation-data-type=uint8, transfer-property=TRIGGERED-ON-CHANGE
          signal CAN2_XWDMode: start 47, 2 bit, big-endian, i-signal-type=PRIMITIVE, init-value=constant-reference=Init_CAN2_XWDMode, base-type=uint8, implementation-data-type=uint8, transfer-property=TRIGGERED-ON-CHANGE
          signal CAN2_sigAirIntenZon1St: start 63, 4 bit, big-endian, i-signal-type=PRIMITIVE, init-value=constant-reference=Init_CAN2_sigAirIntenZon1St, base-type=uint8, implementation-data-type=uint8, transfer-property=PENDING
          signal CAN2_sigAirIntenZon3St: start 59, 4 bit, big-endian, i-signal-type=PRIMITIVE, init-value=constant-reference=Init_CAN2_sigAirIntenZon3St, base-type=uint8, implementation-data-type=uint8, transfer-property=PENDING
          signal CAN2_sigAmbAirT: start 103, 8 bit, big-endian, i-signal-type=PRIMITIVE, init-value=constant-reference=Init_CAN2_sigAmbAirT, base-type=uint8, implementation-data-type=uint8, transfer-property=PENDING
          signal CAN2_sigCbnAirT: start 95, 8 bit, big-endian, i-signal-type=PRIMITIVE, init-value=constant-reference=Init_CAN2_sigCbnAirT, base-type=uint8, implementation-data-type=uint8, transfer-property=PENDING
          signal CAN2_sigDfrstSt: start 70, 1 bit, big-endian, i-signal-type=PRIMITIVE, init-value=constant-reference=Init_CAN2_sigDfrstSt, base-type=uint8, implementation-data-type=uint8, transfer-property=PENDING
          signal CAN2_sigHvacSt: start 78, 1 bit, big-endian, i-signal-type=PRIMITIVE, init-value=constant-reference=Init_CAN2_sigHvacSt, base-type=uint8, implementation-data-type=uint8, transfer-property=PENDING
          signal CAN2_sigRecircSt: start 79, 1 bit, big-endian, i-signal-type=PRIMITIVE, init-value=constant-reference=Init_CAN2_sigRecircSt, base-type=uint8, implementation-data-type=uint8, transfer-property=PENDING
          signal CAN2_sigSetTempZon1St: start 85, 6 bit, big-endian, i-signal-type=PRIMITIVE, init-value=constant-reference=Init_CAN2_sigSetTempZon1St, base-type=uint8, implementation-data-type=uint8, transfer-property=PENDING
          signal CAN2_sigSetTempZon2St: start 77, 6 bit, big-endian, i-signal-type=PRIMITIVE, init-value=constant-reference=Init_CAN2_sigSetTempZon2St, base-type=uint8, implementation-data-type=uint8, transfer-property=PENDING
          signal CAN2_sigSetTempZon3St: start 69, 6 bit, big-endian, i-signal-type=PRIMITIVE, init-value=constant-reference=Init_CAN2_sigSetTempZon3St, base-type=uint8, implementation-data-type=uint8, transfer-property=PENDING
          signal CAN2_sigWindDirZon1St: start 54, 3 bit, big-endian, i-signal-type=PRIMITIVE, init-value=constant-reference=Init_CAN2_sigWindDirZon1St, base-type=uint8, implementation-data-type=uint8, transfer-property=PENDING
          signal CAN2_sigWindDirZon3St: start 50, 3 bit, big-endian, i-signal-type=PRIMITIVE, init-value=constant-reference=Init_CAN2_sigWindDirZon3St, base-type=uint8, implementation-data-type=uint8, transfer-property=PENDING
      frame CAN2_FD2_CE100_1: id 0x202, frame-length=32, can-addressing-mode=STANDARD, can-fd-frame-support=true, can-frame-rx-behavior=CAN-FD, can-frame-tx-behavior=CAN-FD
        pdu CAN2_FD2_CE100_1: length=32, minimum-delay=0.0, transmission-mode-true-timing={cyclic-timing=time-period=0.1, event-controlled-timing={number-of-repetitions=0, repetition-period=0}}, unused-bit-pattern=0
          mapping CAN2_SG_FD2_CE100_1: i-signal-group=CAN2_SG_FD2_CE100_1, start-position=0, transfer-property=TRIGGERED-ON-CHANGE
          signal CAN2_FDC_BCM_TgateSWL_Sta: start 2, 1 bit, big-endian, i-signal-type=PRIMITIVE, init-value=constant-reference=Init_CAN2_FDC_BCM_TgateSWL_Sta, base-type=uint8, implementation-data-type=uint8, transfer-property=TRIGGERED-ON-CHANGE
          signal CAN2_FDC_BCM_TgateSWR_Sta: start 1, 1 bit, big-endian, i-signal-type=PRIMITIVE, init-value=constant-reference=Init_CAN2_FDC_BCM_TgateSWR_Sta, base-type=uint8, implementation-data-type=uint8, transfer-property=TRIGGERED-ON-CHANGE
          signal CAN2_FDC_BCM_WelcomeDemo_Sta: start 3, 1 bit, big-endian, i-signal-type=PRIMITIVE, init-value=constant-reference=Init_CAN2_FDC_BCM_WelcomeDemo_Sta, base-type=uint8, implementation-data-type=uint8, transfer-property=PENDING
          signal CAN2_FDC_VCU_DACStatus_Sta: start 7, 2 bit, big-endian, i-signal-type=PRIMITIVE, init-value=constant-reference=Init_CAN2_FDC_VCU_DACStatus_Sta, base-type=uint8, implementation-data-type=uint8, transfer-property=PENDING
          signal CAN2_FDC_VCU_TUpASta_Sta: start 5, 2 bit, big-endian, i-signal-type=PRIMITIVE, init-value=constant-reference=Init_CAN2_FDC_VCU_TUpASta_Sta, base-type=uint8, implementation-data-type=uint8, transfer-property=PENDING
      frame CAN2_FD2_CE200_1: id 0x435, frame-length=32, can-addressing-mode=STANDARD, can-fd-frame-support=true, can-frame-rx-behavior=CAN-FD, can-frame-tx-behavior=CAN-FD
        pdu CAN2_FD2_CE200_1: length=32, minimum-delay=0.0, transmission-mode-true-timing={cyclic-timing=time-period=0.2, event-controlled-timing={number-of-repetitions=0, repetition-period=0}}, unused-bit-pattern=0
          mapping CAN2_SG_FD2_CE200_1: i-signal-group=CAN2_SG_FD2_CE200_1, start-position=0, transfer-property=TRIGGERED-ON-CHANGE
          signal CAN2_AutoLTips: start 19, 2 bit, big-endian, i-signal-type=PRIMITIVE, init-value=constant-reference=Init_CAN2_AutoLTips, base-type=uint8, implementation-data-type=uint8, transfer-property=TRIGGERED-ON-CHANGE
          signal CAN2_CWheelTips: start 17, 2 bit, big-endian, i-signal-type=PRIMITIVE, init-value=constant-reference=Init_CAN2_CWheelTips, base-type=uint8, implementation-data-type=uint8, transfer-property=TRIGGERED-ON-CHANGE
          signal CAN2_FDC_BCM_Acc1Sta_Sta: start 183, 2 bit, big-endian, i-signal-type=PRIMITIVE, init-value=constant-reference=Init_CAN2_FDC_BCM_Acc1Sta_Sta, base-type=uint8, implementation-data-type=uint8, transfer-property=TRIGGERED-ON-CHANGE
          signal CAN2_FDC_BCM_Acc2Sta_Sta: start 191, 2 bit, big-endian, i-signal-type=PRIMITIVE, init-value=constant-reference=Init_CAN2_FDC_BCM_Acc2Sta_Sta, base-type=uint8, implementation-data-type=uint8, transfer-property=TRIGGERED-ON-CHANGE
          signal CAN2_FDC_BCM_Acc3Sta_Sta: start 199, 2 bit, big-endian, i-signal-type=PRIMITIVE, init-value=constant-reference=Init_CAN2_FDC_BCM_Acc3Sta_Sta, base-type=uint8, implementation-data-type=uint8, transfer-property=TRIGGERED-ON-CHANGE
          signal CAN2_FDC_BCM_Acc4Sta_Sta: start 207, 2 bit, big-endian, i-signal-type=PRIMITIVE, init-value=constant-reference=Init_CAN2_FDC_BCM_Acc4Sta_Sta, base-type=uint8, implementation-data-type=uint8, transfer-property=TRIGGERED-ON-CHANGE
          signal CAN2_FDC_BCM_Acc5Sta_Sta: start 215, 2 bit, big-endian, i-signal-type=PRIMITIVE, init-value=constant-reference=Init_CAN2_FDC_BCM_Acc5Sta_Sta, base-type=uint8, implementation-data-type=uint8, transfer-property=TRIGGERED-ON-CHANGE
          signal CAN2_FDC_BCM_AmbBrightSta_Sta: start 158, 7 bit, big-endian, i-signal-type=PRIMITIVE, init-value=constant-reference=Init_CAN2_FDC_BCM_AmbBrightSta_Sta, base-type=uint8, implementation-data-type=uint8, transfer-property=TRIGGERED-ON-CHANGE
          signal CAN2_FDC_BCM_AmbColorSta_Sta: start 165, 6 bit, big-endian, i-signal-type=PRIMITIVE, init-value=constant-reference=Init_CAN2_FDC_BCM_AmbColorSta_Sta, base-type=uint8, implementation-data-type=uint8, transfer-property=TRIGGERED-ON-CHANGE
          signal CAN2_FDC_BCM_AmbDimEN_Sta: start 166, 1 bit, big-endian, i-signal-type=PRIMITIVE, init-value=constant-reference=Init_CAN2_FDC_BCM_AmbDimEN_Sta, base-type=uint8, implementation-data-type=uint8, transfer-property=TRIGGERED-ON-CHANGE
          signal CAN2_FDC_BCM_AmbFunEN_Sta: start 167, 1 bit, big-endian, i-signal-type=PRIMITIVE, init-value=constant-reference=Init_CAN2_FDC_BCM_AmbFunEN_Sta, base-type=uint8, implementation-data-type=uint8, transfer-property=TRIGGERED-ON-CHANGE
          signal CAN2_FDC_BCM_AmbLinkDriSta_Sta: start 171, 1 bit, big-endian, i-signal-type=PRIMITIVE, init-value=constant-reference=Init_CAN2_FDC_BCM_AmbLinkDriSta_Sta, base-type=uint8, implementation-data-type=uint8, transfer-property=TRIGGERED-ON-CHANGE
          signal CAN2_FDC_BCM_AmbODAEN_Sta: start 224, 1 bit, big-endian, i-signal-type=PRIMITIVE, init-value=constant-reference=Init_CAN2_FDC_BCM_AmbODAEN_Sta, base-type=uint8, implementation-data-type=uint8, transfer-property=TRIGGERED-ON-CHANGE
          signal CAN2_FDC_BCM_AmbPwrWarnEN_Sta: start 225, 1 bit, big-endian, i-signal-type=PRIMITIVE, init-value=constant-reference=Init_CAN2_FDC_BCM_AmbPwrWarnEN_Sta, base-type=uint8, implementation-data-type=uint8, transfer-property=TRIGGERED-ON-CHANGE
          signal CAN2_FDC_BCM_AmbWelEN_Sta: start 159, 1 bit, big-endian, i-signal-type=PRIMITIVE, init-value=constant-reference=Init_CAN2_FDC_BCM_AmbWelEN_Sta, base-type=uint8, implementation-data-type=uint8, transfer-property=TRIGGERED-ON-CHANGE
          signal CAN2_FDC_BCM_CLWinLockDr_Sta: start 245, 1 bit, big-endian, i-signal-type=PRIMITIVE, init-value=constant-reference=Init_CAN2_FDC_BCM_CLWinLockDr_Sta, base-type=uint8, implementation-data-type=uint8, transfer-property=TRIGGERED-ON-CHANGE
          signal CAN2_FDC_BCM_FollowMeENFun_Sta: start 218, 1 bit, big-endian, i-signal-type=PRIMITIVE, init-value=constant-reference=Init_CAN2_FDC_BCM_FollowMeENFun_Sta, base-type=uint8, implementation-data-type=uint8, transfer-property=TRIGGERED-ON-CHANGE
          signal CAN2_FDC_BCM_Key10Acc_Sta: start 213, 3 bit, big-endian, i-signal-type=PRIMITIVE, init-value=constant-reference=Init_CAN2_FDC_BCM_Key10Acc_Sta, base-type=uint8, implementation-data-type=uint8, transfer-property=TRIGGERED-ON-CHANGE
          signal CAN2_FDC_BCM_Key1Acc_Sta: start 178, 3 bit, big-endian, i-signal-type=PRIMITIVE, init-value=constant-reference=Init_CAN2_FDC_BCM_Key1Acc_Sta, base-type=uint8, implementation-data-type=uint8, transfer-property=TRIGGERED-ON-CHANGE
          signal CAN2_FDC_BCM_Key2Acc_Sta: start 181, 3 bit, big-endian, i-signal-type=PRIMITIVE, init-value=constant-reference=Init_CAN2_FDC_BCM_Key2Acc_Sta, base-type=uint8, implementation-data-type=uint8, transfer-property=TRIGGERED-ON-CHANGE
          signal CAN2_FDC_BCM_Key3Acc_Sta: start 186, 3 bit, big-endian, i-signal-type=PRIMITIVE, init-value=constant-reference=Init_CAN2_FDC_BCM_Key3Acc_Sta, base-type=uint8, implementation-data-type=uint8, transfer-property=TRIGGERED-ON-CHANGE
          signal CAN2_FDC_BCM_Key4Acc_Sta: start 189, 3 bit, big-endian, i-signal-type=PRIMITIVE, init-value=constant-reference=Init_CAN2_FDC_BCM_Key4Acc_Sta, base-type=uint8, implementation-data-type=uint8, transfer-property=TRIGGERED-ON-CHANGE
          signal CAN2_FDC_BCM_Key5Acc_Sta: start 194, 3 bit, big-endian, i-signal-type=PRIMITIVE, init-value=constant-reference=Init_CAN2_FDC_BCM_Key5Acc_Sta, base-type=uint8, implementation-data-type=uint8, transfer-property=TRIGGERED-ON-CHANGE
          signal CAN2_FDC_BCM_Key6Acc_Sta: start 197, 3 bit, big-endian, i-signal-type=PRIMITIVE, init-value=constant-reference=Init_CAN2_FDC_BCM_Key6Acc_Sta, base-type=uint8, implementation-data-type=uint8, transfer-property=TRIGGERED-ON-CHANGE
          signal CAN2_FDC_BCM_Key7Acc_Sta: start 202, 3 bit, big-endian, i-signal-type=PRIMITIVE, init-value=constant-reference=Init_CAN2_FDC_BCM_Key7Acc_Sta, base-type=uint8, implementation-data-type=uint8, transfer-property=TRIGGERED-ON-CHANGE
          signal CAN2_FDC_BCM_Key8Acc_Sta: start 205, 3 bit, big-endian, i-signal-type=PRIMITIVE, init-value=constant-reference=Init_CAN2_FDC_BCM_Key8Acc_Sta, base-type=uint8, implementation-data-type=uint8, transfer-property=TRIGGERED-ON-CHANGE
          signal CAN2_FDC_BCM_Key9Acc_Sta: start 210, 3 bit, big-endian, i-signal-type=PRIMITIVE, init-value=constant-reference=Init_CAN2_FDC_BCM_Key9Acc_Sta, base-type=uint8, implementation-data-type=uint8, transfer-property=TRIGGERED-ON-CHANGE
          signal CAN2_FDC_BCM_LockAlarm_Cmd: start 217, 2 bit, big-endian, i-signal-type=PRIMITIVE, init-value=constant-reference=Init_CAN2_FDC_BCM_LockAlarm_Cmd, base-type=uint8, implementation-data-type=uint8, transfer-property=TRIGGERED-ON-CHANGE
          signal CAN2_FDC_BCM_PTGOpenHeight_Sta: start 174, 3 bit, big-endian, i-signal-type=PRIMITIVE, init-value=constant-reference=Init_CAN2_FDC_BCM_PTGOpenHeight_Sta, base-type=uint8, implementation-data-type=uint8, transfer-property=TRIGGERED-ON-CHANGE
          signal CAN2_FDC_BCM_RmLpModeENFun_Sta: start 219, 1 bit, big-endian, i-signal-type=PRIMITIVE, init-value=constant-reference=Init_CAN2_FDC_BCM_RmLpModeENFun_Sta, base-type=uint8, implementation-data-type=uint8, transfer-property=TRIGGERED-ON-CHANGE
          signal CAN2_FDC_BCM_TurnSwTSetSta_Sta: start 227, 2 bit, big-endian, i-signal-type=PRIMITIVE, init-value=constant-reference=Init_CAN2_FDC_BCM_TurnSwTSetSta_Sta, base-type=uint8, implementation-data-type=uint8, transfer-property=TRIGGERED-ON-CHANGE
          signal CAN2_FDC_BCM_UserNow_Sta: start 170, 3 bit, big-endian, i-signal-type=PRIMITIVE, init-value=constant-reference=Init_CAN2_FDC_BCM_UserNow_Sta, base-type=uint8, implementation-data-type=uint8, transfer-property=TRIGGERED-ON-CHANGE
          signal CAN2_FDC_BCM_WalkInUnLkEnFun_Sta: start 220, 1 bit, big-endian, i-signal-type=PRIMITIVE, init-value=constant-reference=Init_CAN2_FDC_BCM_WalkInUnLkEnFun_Sta, base-type=uint8, implementation-data-type=uint8, transfer-property=TRIGGERED-ON-CHANGE
          signal CAN2_FDC_BCM_WalkOutLkEnFun_Sta: start 221, 1 bit, big-endian, i-signal-type=PRIMITIVE, init-value=constant-reference=Init_CAN2_FDC_BCM_WalkOutLkEnFun_Sta, base-type=uint8, implementation-data-type=uint8, transfer-property=TRIGGERED-ON-CHANGE
          signal CAN2_FDC_DKC_DkeyShowIVI_Sta: start 235, 4 bit, big-endian, i-signal-type=PRIMITIVE, init-value=constant-reference=Init_CAN2_FDC_DKC_DkeyShowIVI_Sta, base-type=uint8, implementation-data-type=uint8, transfer-property=TRIGGERED-ON-CHANGE
          signal CAN2_FDC_DKC_KeyMiss_Sta: start 223, 1 bit, big-endian, i-signal-type=PRIMITIVE, init-value=constant-reference=Init_CAN2_FDC_DKC_KeyMiss_Sta, base-type=uint8, implementation-data-type=uint8, transfer-property=TRIGGERED-ON-CHANGE
          signal CAN2_FDC_DKC_KeyNum_Sta: start 243, 4 bit, big-endian, i-signal-type=PRIMITIVE, init-value=constant-reference=Init_CAN2_FDC_DKC_KeyNum_Sta, base-type=uint8, implementation-data-type=uint8, transfer-property=TRIGGERED-ON-CHANGE
          signal CAN2_FDC_DKC_KeyType_Sta: start 255, 2 bit, big-endian, i-signal-type=PRIMITIVE, init-value=constant-reference=Init_CAN2_FDC_DKC_KeyType_Sta, base-type=uint8, implementation-data-type=uint8, transfer-property=TRIGGERED-ON-CHANGE
          signal CAN2_FDC_DKC_UIDLowPower_Sta: start 236, 1 bit, big-endian, i-signal-type=PRIMITIVE, init-value=constant-reference=Init_CAN2_FDC_DKC_UIDLowPower_Sta, base-type=uint8, implementation-data-type=uint8, transfer-property=TRIGGERED-ON-CHANGE
          signal CAN2_FDC_SPTG_SPTGENFun_Sta: start 222, 1 bit, big-endian, i-signal-type=PRIMITIVE, init-value=constant-reference=Init_CAN2_FDC_SPTG_SPTGENFun_Sta, base-type=uint8, implementation-data-type=uint8, transfer-property=TRIGGERED-ON-CHANGE
          signal CAN2_FDC_THCM_APTCForceOFF_Sta: start 244, 1 bit, big-endian, i-signal-type=PRIMITIVE, init-value=constant-reference=Init_CAN2_FDC_THCM_APTCForceOFF_Sta, base-type=uint8, implementation-data-type=uint8, transfer-property=TRIGGERED-ON-CHANGE
          signal CAN2_FDC_THCM_APTCWarning_Sta: start 175, 1 bit, big-endian, i-signal-type=PRIMITIVE, init-value=constant-reference=Init_CAN2_FDC_THCM_APTCWarning_Sta, base-type=uint8, implementation-data-type=uint8, transfer-property=TRIGGERED-ON-CHANGE
          signal CAN2_FDC_THCM_AirIntZ3_Sta: start 250, 3 bit, big-endian, i-signal-type=PRIMITIVE, init-value=constant-reference=Init_CAN2_FDC_THCM_AirIntZ3_Sta, base-type=uint8, implementation-data-type=uint8, transfer-property=TRIGGERED-ON-CHANGE
          signal CAN2_LFWheelShield: start 231, 1 bit, big-endian, i-signal-type=PRIMITIVE, init-value=constant-reference=Init_CAN2_LFWheelShield, base-type=uint8, implementation-data-type=uint8, transfer-property=TRIGGERED-ON-CHANGE
          signal CAN2_LRBatWarn: start 99, 1 bit, big-endian, i-signal-type=PRIMITIVE, init-value=constant-reference=Init_CAN2_LRBatWarn, base-type=uint8, implementation-data-type=uint8, transfer-property=TRIGGERED-ON-CHANGE
          signal CAN2_LRPressIndi: start 119, 2 bit, big-endian, i-signal-type=PRIMITIVE, init-value=constant-reference=Init_CAN2_LRPressIndi, base-type=uint8, implementation-data-type=uint8, transfer-property=TRIGGERED-ON-CHANGE
          signal CAN2_LRSensorFail: start 111, 1 bit, big-endian, i-signal-type=PRIMITIVE, init-value=constant-reference=Init_CAN2_LRSensorFail, base-type=uint8, implementation-data-type=uint8, transfer-property=TRIGGERED-ON-CHANGE
          signal CAN2_LRWheelDebug: start 103, 1 bit, big-endian, i-signal-type=PRIMITIVE, init-value=constant-reference=Init_CAN2_LRWheelDebug, base-type=uint8, implementation-data-type=uint8, transfer-property=TRIGGERED-ON-CHANGE
          signal CAN2_LRWheelPSW: start 151, 8 bit, big-endian, i-signal-type=PRIMITIVE, init-value=constant-reference=Init_CAN2_LRWheelPSW, base-type=uint8, implementation-data-type=uint8, transfer-property=TRIGGERED-ON-CHANGE
          signal CAN2_LRWheelPress: start 63, 8 bit, big-endian, i-signal-type=PRIMITIVE, init-value=constant-reference=Init_CAN2_LRWheelPress, base-type=uint8, implementation-data-type=uint8, transfer-property=TRIGGERED-ON-CHANGE
          signal CAN2_LRWheelShield: start 230, 1 bit, big-endian, i-signal-type=PRIMITIVE, init-value=constant-reference=Init_CAN2_LRWheelShield, base-type=uint8, implementation-data-type=uint8, transfer-property=TRIGGERED-ON-CHANGE
          signal CAN2_LRWheelTemp: start 31, 8 bit, big-endian, i-signal-type=PRIMITIVE, init-value=constant-reference=Init_CAN2_LRWheelTemp, base-type=uint8, implementation-data-type=uint8, transfer-property=TRIGGERED-ON-CHANGE
          signal CAN2_LRWheelTmpIndi: start 107, 1 bit, big-endian, i-signal-type=PRIMITIVE, init-value=constant-reference=Init_CAN2_LRWheelTmpIndi, base-type=uint8, implementation-data-type=uint8, transfer-property=TRIGGERED-ON-CHANGE
          signal CAN2_RFWheelShield: start 229, 1 bit, big-endian, i-signal-type=PRIMITIVE, init-value=constant-reference=Init_CAN2_RFWheelShield, base-type=uint8, implementation-data-type=uint8, transfer-property=TRIGGERED-ON-CHANGE
          signal CAN2_RRBatWarn: start 98, 1 bit, big-endian, i-signal-type=PRIMITIVE, init-value=constant-reference=Init_CAN2_RRBatWarn, base-type=uint8, implementation-data-type=uint8, transfer-property=TRIGGERED-ON-CHANGE
          signal CAN2_RRPressIndi: start 117, 2 bit, big-endian, i-signal-type=PRIMITIVE, init-value=constant-reference=Init_CAN2_RRPressIndi, base-type=uint8, implementation-data-type=uint8, transfer-property=TRIGGERED-ON-CHANGE
          signal CAN2_RRSensorFail: start 110, 1 bit, big-endian, i-signal-type=PRIMITIVE, init-value=constant-reference=Init_CAN2_RRSensorFail, base-type=uint8, implementation-data-type=uint8, transfer-property=TRIGGERED-ON-CHANGE
          signal CAN2_RRWheelDebug: start 102, 1 bit, big-endian, i-signal-type=PRIMITIVE, init-value=constant-reference=Init_CAN2_RRWheelDebug, base-type=uint8, implementation-data-type=uint8, transfer-property=TRIGGERED-ON-CHANGE
          signal CAN2_RRWheelPSW: start 127, 8 bit, big-endian, i-signal-type=PRIMITIVE, init-value=constant-reference=Init_CAN2_RRWheelPSW, base-type=uint8, implementation-data-type=uint8, transfer-property=TRIGGERED-ON-CHANGE
          signal CAN2_RRWheelPress: start 71, 8 bit, big-endian, i-signal-type=PRIMITIVE, init-value=constant-reference=Init_CAN2_RRWheelPress, base-type=uint8, implementation-data-type=uint8, transfer-property=TRIGGERED-ON-CHANGE
          signal CAN2_RRWheelShield: start 228, 1 bit, big-endian, i-signal-type=PRIMITIVE, init-value=constant-reference=Init_CAN2_RRWheelShield, base-type=uint8, implementation-data-type=uint8, transfer-property=TRIGGERED-ON-CHANGE
          signal CAN2_RRWheelTemp: start 39, 8 bit, big-endian, i-signal-type=PRIMITIVE, init-value=constant-reference=Init_CAN2_RRWheelTemp, base-type=uint8, implementation-data-type=uint8, transfer-property=TRIGGERED-ON-CHANGE
          signal CAN2_RRWheelTmpIndi: start 106, 1 bit, big-endian, i-signal-type=PRIMITIVE, init-value=constant-reference=Init_CAN2_RRWheelTmpIndi, base-type=uint8, implementation-data-type=uint8, transfer-property=TRIGGERED-ON-CHANGE
          signal CAN2_T1_TPMS_LFBatWarn: start 97, 1 bit, big-endian, i-signal-type=PRIMITIVE, init-value=constant-reference=Init_CAN2_T1_TPMS_LFBatWarn, base-type=uint8, implementation-data-type=uint8, transfer-property=TRIGGERED-ON-CHANGE
          signal CAN2_T1_TPMS_LFPressIndi: start 115, 2 bit, big-endian, i-signal-type=PRIMITIVE, init-value=constant-reference=Init_CAN2_T1_TPMS_LFPressIndi, base-type=uint8, implementation-data-type=uint8, transfer-property=TRIGGERED-ON-CHANGE
          signal CAN2_T1_TPMS_LFSensorFail: start 109, 1 bit, big-endian, i-signal-type=PRIMITIVE, init-value=constant-reference=Init_CAN2_T1_TPMS_LFSensorFail, base-type=uint8, implementation-data-type=uint8, transfer-property=TRIGGERED-ON-CHANGE
          signal CAN2_T1_TPMS_LFWheelDebug: start 101, 1 bit, big-endian, i-signal-type=PRIMITIVE, init-value=constant-reference=Init_CAN2_T1_TPMS_LFWheelDebug, base-type=uint8, implementation-data-type=uint8, transfer-property=TRIGGERED-ON-CHANGE
          signal CAN2_T1_TPMS_LFWheelPSW: start 143, 8 bit, big-endian, i-signal-type=PRIMITIVE, init-value=constant-reference=Init_CAN2_T1_TPMS_LFWheelPSW, base-type=uint8, implementation-data-type=uint8, transfer-property=TRIGGERED-ON-CHANGE
          signal CAN2_T1_TPMS_LFWheelPress: start 79, 8 bit, big-endian, i-signal-type=PRIMITIVE, init-value=constant-reference=Init_CAN2_T1_TPMS_LFWheelPress, base-type=uint8, implementation-data-type=uint8, transfer-property=TRIGGERED-ON-CHANGE
          signal CAN2_T1_TPMS_LFWheelTemp: start 47, 8 bit, big-endian, i-signal-type=PRIMITIVE, init-value=constant-reference=Init_CAN2_T1_TPMS_LFWheelTemp, base-type=uint8, implementation-data-type=uint8, transfer-property=TRIGGERED-ON-CHANGE
          signal CAN2_T1_TPMS_LFWheelTmpIndi: start 105, 1 bit, big-endian, i-signal-type=PRIMITIVE, init-value=constant-reference=Init_CAN2_T1_TPMS_LFWheelTmpIndi, base-type=uint8, implementation-data-type=uint8, transfer-property=TRIGGERED-ON-CHANGE
          signal CAN2_T1_TPMS_RFBatWarn: start 96, 1 bit, big-endian, i-signal-type=PRIMITIVE, init-value=constant-reference=Init_CAN2_T1_TPMS_RFBatWarn, base-type=uint8, implementation-data-type=uint8, transfer-property=TRIGGERED-ON-CHANGE
          signal CAN2_T1_TPMS_RFPressIndi: start 113, 2 bit, big-endian, i-signal-type=PRIMITIVE, init-value=constant-reference=Init_CAN2_T1_TPMS_RFPressIndi, base-type=uint8, implementation-data-type=uint8, transfer-property=TRIGGERED-ON-CHANGE
          signal CAN2_T1_TPMS_RFSensorFail: start 108, 1 bit, big-endian, i-signal-type=PRIMITIVE, init-value=constant-reference=Init_CAN2_T1_TPMS_RFSensorFail, base-type=uint8, implementation-data-type=uint8, transfer-property=TRIGGERED-ON-CHANGE
          signal CAN2_T1_TPMS_RFWheelDebug: start 100, 1 bit, big-endian, i-signal-type=PRIMITIVE, init-value=constant-reference=Init_CAN2_T1_TPMS_RFWheelDebug, base-type=uint8, implementation-data-type=uint8, transfer-property=TRIGGERED-ON-CHANGE
          signal CAN2_T1_TPMS_RFWheelPSW: start 135, 8 bit, big-endian, i-signal-type=PRIMITIVE, init-value=constant-reference=Init_CAN2_T1_TPMS_RFWheelPSW, base-type=uint8, implementation-data-type=uint8, transfer-property=TRIGGERED-ON-CHANGE
          signal CAN2_T1_TPMS_RFWheelPress: start 87, 8 bit, big-endian, i-signal-type=PRIMITIVE, init-value=constant-reference=Init_CAN2_T1_TPMS_RFWheelPress, base-type=uint8, implementation-data-type=uint8, transfer-property=TRIGGERED-ON-CHANGE
          signal CAN2_T1_TPMS_RFWheelTemp: start 55, 8 bit, big-endian, i-signal-type=PRIMITIVE, init-value=constant-reference=Init_CAN2_T1_TPMS_RFWheelTemp, base-type=uint8, implementation-data-type=uint8, transfer-property=TRIGGERED-ON-CHANGE
          signal CAN2_T1_TPMS_RFWheelTmpIndi: start 104, 1 bit, big-endian, i-signal-type=PRIMITIVE, init-value=constant-reference=Init_CAN2_T1_TPMS_RFWheelTmpIndi, base-type=uint8, implementation-data-type=uint8, transfer-property=TRIGGERED-ON-CHANGE
          signal CAN2_T1_TPMS_TPMSWarnIndi: start 23, 2 bit, big-endian, i-signal-type=PRIMITIVE, init-value=constant-reference=Init_CAN2_T1_TPMS_TPMSWarnIndi, base-type=uint8, implementation-data-type=uint8, transfer-property=TRIGGERED-ON-CHANGE
          signal CAN2_TPMS_Cali_Butt_Allow: start 20, 1 bit, big-endian, i-signal-type=PRIMITIVE, init-value=constant-reference=Init_CAN2_TPMS_Cali_Butt_Allow, base-type=uint8, implementation-data-type=uint8, transfer-property=TRIGGERED-ON-CHANGE
          signal CAN2_TPMS_Res_Butt_Allow: start 21, 1 bit, big-endian, i-signal-type=PRIMITIVE, init-value=constant-reference=Init_CAN2_TPMS_Res_Butt_Allow, base-type=uint8, implementation-data-type=uint8, transfer-property=TRIGGERED-ON-CHANGE
      frame CAN2_FD2_OTA1: id 0x438, frame-length=12, can-addressing-mode=STANDARD, can-fd-frame-support=true, can-frame-rx-behavior=CAN-FD, can-frame-tx-behavior=CAN-FD
        pdu CAN2_FD2_OTA1: length=12, minimum-delay=0.0, transmission-mode-true-timing={cyclic-timing=time-period=0.2, event-controlled-timing={number-of-repetitions=0, repetition-period=0}}, unused-bit-pattern=0
          mapping CAN2_SG_FD2_OTA1: i-signal-group=CAN2_SG_FD2_OTA1, start-position=0, transfer-property=TRIGGERED-ON-CHANGE
          signal CAN2_OTA_DL_Available: start 8, 1 bit, big-endian, i-signal-type=PRIMITIVE, init-value=constant-reference=Init_CAN2_OTA_DL_Available, base-type=uint8, implementation-data-type=uint8, transfer-property=TRIGGERED-ON-CHANGE
          signal CAN2_OTA_DL_Speed: start 27, 20 bit, big-endian, i-signal-type=PRIMITIVE, init-value=constant-reference=Init_CAN2_OTA_DL_Speed, base-type=uint32, implementation-data-type=uint32, transfer-property=TRIGGERED-ON-CHANGE
          signal CAN2_OTA_Debug_Code: start 79, 8 bit, big-endian, i-signal-type=PRIMITIVE, init-value=constant-reference=Init_CAN2_OTA_Debug_Code, base-type=uint8, implementation-data-type=uint8, transfer-property=PENDING
          signal CAN2_OTA_Emergency_Sta: start 61, 2 bit, big-endian, i-signal-type=PRIMITIVE, init-value=constant-reference=Init_CAN2_OTA_Emergency_Sta, base-type=uint8, implementation-data-type=uint8, transfer-property=TRIGGERED-ON-CHANGE
          signal CAN2_OTA_InVehicle_FW: start 29, 2 bit, big-endian, i-signal-type=PRIMITIVE, init-value=constant-reference=Init_CAN2_OTA_InVehicle_FW, base-type=uint8, implementation-data-type=uint8, transfer-property=TRIGGERED-ON-CHANGE
          signal CAN2_OTA_Lock_Req: start 31, 1 bit, big-endian, i-signal-type=PRIMITIVE, init-value=constant-reference=Init_CAN2_OTA_Lock_Req, base-type=uint8, implementation-data-type=uint8, transfer-property=TRIGGERED-ON-CHANGE
          signal CAN2_OTA_MDA_Status: start 52, 5 bit, big-endian, i-signal-type=PRIMITIVE, init-value=constant-reference=Init_CAN2_OTA_MDA_Status, base-type=uint8, implementation-data-type=uint8, transfer-property=TRIGGERED-ON-CHANGE
          signal CAN2_OTA_Mode: start 9, 1 bit, big-endian, i-signal-type=PRIMITIVE, init-value=constant-reference=Init_CAN2_OTA_Mode, base-type=uint8, implementation-data-type=uint8, transfer-property=TRIGGERED-ON-CHANGE
          signal CAN2_OTA_Network_Type: start 11, 2 bit, big-endian, i-signal-type=PRIMITIVE, init-value=constant-reference=Init_CAN2_OTA_Network_Type, base-type=uint8, implementation-data-type=uint8, transfer-property=TRIGGERED-ON-CHANGE
          signal CAN2_OTA_Permit_Agreed: start 63, 1 bit, big-endian, i-signal-type=PRIMITIVE, init-value=constant-reference=Init_CAN2_OTA_Permit_Agreed, base-type=uint8, implementation-data-type=uint8, transfer-property=PENDING
          signal CAN2_OTA_Progress_Rate: start 7, 8 bit, big-endian, i-signal-type=PRIMITIVE, init-value=constant-reference=Init_CAN2_OTA_Progress_Rate, base-type=uint8, implementation-data-type=uint8, transfer-property=TRIGGERED-ON-CHANGE
          signal CAN2_OTA_Remained_Time: start 58, 11 bit, big-endian, i-signal-type=PRIMITIVE, init-value=constant-reference=Init_CAN2_OTA_Remained_Time, base-type=uint16, implementation-data-type=uint16, transfer-property=PENDING
          signal CAN2_OTA_TBOXResetReq: start 30, 1 bit, big-endian, i-signal-type=PRIMITIVE, init-value=constant-reference=Init_CAN2_OTA_TBOXResetReq, base-type=uint8, implementation-data-type=uint8, transfer-property=TRIGGERED-ON-CHANGE
          signal CAN2_OTA_Update_Available: start 62, 1 bit, big-endian, i-signal-type=PRIMITIVE, init-value=constant-reference=Init_CAN2_OTA_Update_Available, base-type=uint8, implementation-data-type=uint8, transfer-property=TRIGGERED-ON-CHANGE
          signal CAN2_OTA_Updating_ECU_8bit: start 23, 8 bit, big-endian, i-signal-type=PRIMITIVE, init-value=constant-reference=Init_CAN2_OTA_Updating_ECU_8bit, base-type=uint8, implementation-data-type=uint8, transfer-property=TRIGGERED-ON-CHANGE
      frame CAN2_FD2_Version: id 0x3C3, frame-length=48, can-addressing-mode=STANDARD, can-fd-frame-support=true, can-frame-rx-behavior=CAN-FD, can-frame-tx-behavior=CAN-FD
        pdu CAN2_FD2_Version: length=48, minimum-delay=0.0, transmission-mode-true-timing=cyclic-timing=time-period=5, unused-bit-pattern=0
          mapping CAN2_SG_FD2_Version: i-signal-group=CAN2_SG_FD2_Version, start-position=0, transfer-property=PENDING
          signal CAN2_FUSION_HW_Ver1: start 7, 8 bit, big-endian, i-signal-type=PRIMITIVE, init-value=constant-reference=Init_CAN2_FUSION_HW_Ver1, base-type=uint8, implementation-data-type=uint8, transfer-property=PENDING
          signal CAN2_FUSION_HW_Ver2: start 15, 8 bit, big-endian, i-signal-type=PRIMITIVE, init-value=constant-reference=Init_CAN2_FUSION_HW_Ver2, base-type=uint8, implementation-data-type=uint8, transfer-property=PENDING
          signal CAN2_FUSION_HW_Ver3: start 23, 8 bit, big-endian, i-signal-type=PRIMITIVE, init-value=constant-reference=Init_CAN2_FUSION_HW_Ver3, base-type=uint8, implementation-data-type=uint8, transfer-property=PENDING
          signal CAN2_FUSION_SW_CarModel1: start 31, 8 bit, big-endian, i-signal-type=PRIMITIVE, init-value=constant-reference=Init_CAN2_FUSION_SW_CarModel1, base-type=uint8, implementation-data-type=uint8, transfer-property=PENDING
          signal CAN2_FUSION_SW_CarModel2: start 39, 8 bit, big-endian, i-signal-type=PRIMITIVE, init-value=constant-reference=Init_CAN2_FUSION_SW_CarModel2, base-type=uint8, implementation-data-type=uint8, transfer-property=PENDING
          signal CAN2_FUSION_SW_CarModel3: start 47, 8 bit, big-endian, i-signal-type=PRIMITIVE, init-value=constant-reference=Init_CAN2_FUSION_SW_CarModel3, base-type=uint8, implementation-data-type=uint8, transfer-property=PENDING
          signal CAN2_FUSION_SW_Controller1: start 55, 8 bit, big-endian, i-signal-type=PRIMITIVE, init-value=constant-reference=Init_CAN2_FUSION_SW_Controller1, base-type=uint8, implementation-data-type=uint8, transfer-property=PENDING
          signal CAN2_FUSION_SW_Controller2: start 63, 8 bit, big-endian, i-signal-type=PRIMITIVE, init-value=constant-reference=Init_CAN2_FUSION_SW_Controller2, base-type=uint8, implementation-data-type=uint8, transfer-property=PENDING
          signal CAN2_FUSION_SW_Country1: start 119, 8 bit, big-endian, i-signal-type=PRIMITIVE, init-value=constant-reference=Init_CAN2_FUSION_SW_Country1, base-type=uint8, implementation-data-type=uint8, transfer-property=PENDING
          signal CAN2_FUSION_SW_Country2: start 127, 8 bit, big-endian, i-signal-type=PRIMITIVE, init-value=constant-reference=Init_CAN2_FUSION_SW_Country2, base-type=uint8, implementation-data-type=uint8, transfer-property=PENDING
          signal CAN2_FUSION_SW_ECUGen1: start 143, 8 bit, big-endian, i-signal-type=PRIMITIVE, init-value=constant-reference=Init_CAN2_FUSION_SW_ECUGen1, base-type=uint8, implementation-data-type=uint8, transfer-property=PENDING
          signal CAN2_FUSION_SW_ECUGen2: start 151, 8 bit, big-endian, i-signal-type=PRIMITIVE, init-value=constant-reference=Init_CAN2_FUSION_SW_ECUGen2, base-type=uint8, implementation-data-type=uint8, transfer-property=PENDING
          signal CAN2_FUSION_SW_Major1: start 71, 8 bit, big-endian, i-signal-type=PRIMITIVE, init-value=constant-reference=Init_CAN2_FUSION_SW_Major1, base-type=uint8, implementation-data-type=uint8, transfer-property=PENDING
          signal CAN2_FUSION_SW_Major2: start 79, 8 bit, big-endian, i-signal-type=PRIMITIVE, init-value=constant-reference=Init_CAN2_FUSION_SW_Major2, base-type=uint8, implementation-data-type=uint8, transfer-property=PENDING
          signal CAN2_FUSION_SW_Minor1: start 87, 8 bit, big-endian, i-signal-type=PRIMITIVE, init-value=constant-reference=Init_CAN2_FUSION_SW_Minor1, base-type=uint8, implementation-data-type=uint8, transfer-property=PENDING
          signal CAN2_FUSION_SW_Minor2: start 95, 8 bit, big-endian, i-signal-type=PRIMITIVE, init-value=constant-reference=Init_CAN2_FUSION_SW_Minor2, base-type=uint8, implementation-data-type=uint8, transfer-property=PENDING
          signal CAN2_FUSION_SW_Patch1: start 103, 8 bit, big-endian, i-signal-type=PRIMITIVE, init-value=constant-reference=Init_CAN2_FUSION_SW_Patch1, base-type=uint8, implementation-data-type=uint8, transfer-property=PENDING
          signal CAN2_FUSION_SW_Patch2: start 111, 8 bit, big-endian, i-signal-type=PRIMITIVE, init-value=constant-reference=Init_CAN2_FUSION_SW_Patch2, base-type=uint8, implementation-data-type=uint8, transfer-property=PENDING
          signal CAN2_FUSION_SW_SHA1: start 223, 8 bit, big-endian, i-signal-type=PRIMITIVE, init-value=constant-reference=Init_CAN2_FUSION_SW_SHA1, base-type=uint8, implementation-data-type=uint8, transfer-property=PENDING
          signal CAN2_FUSION_SW_SHA2: start 231, 8 bit, big-endian, i-signal-type=PRIMITIVE, init-value=constant-reference=Init_CAN2_FUSION_SW_SHA2, base-type=uint8, implementation-data-type=uint8, transfer-property=PENDING
          signal CAN2_FUSION_SW_SHA3: start 239, 8 bit, big-endian, i-signal-type=PRIMITIVE, init-value=constant-reference=Init_CAN2_FUSION_SW_SHA3, base-type=uint8, implementation-data-type=uint8, transfer-property=PENDING
          signal CAN2_FUSION_SW_SHA4: start 247, 8 bit, big-endian, i-signal-type=PRIMITIVE, init-value=constant-reference=Init_CAN2_FUSION_SW_SHA4, base-type=uint8, implementation-data-type=uint8, transfer-property=PENDING
          signal CAN2_FUSION_SW_SHA5: start 255, 8 bit, big-endian, i-signal-type=PRIMITIVE, init-value=constant-reference=Init_CAN2_FUSION_SW_SHA5, base-type=uint8, implementation-data-type=uint8, transfer-property=PENDING
          signal CAN2_FUSION_SW_SHA6: start 263, 8 bit, big-endian, i-signal-type=PRIMITIVE, init-value=constant-reference=Init_CAN2_FUSION_SW_SHA6, base-type=uint8, implementation-data-type=uint8, transfer-property=PENDING
          signal CAN2_FUSION_SW_SHA7: start 271, 8 bit, big-endian, i-signal-type=PRIMITIVE, init-value=constant-reference=Init_CAN2_FUSION_SW_SHA7, base-type=uint8, implementation-data-type=uint8, transfer-property=PENDING
          signal CAN2_FUSION_SW_SHA8: start 279, 8 bit, big-endian, i-signal-type=PRIMITIVE, init-value=constant-reference=Init_CAN2_FUSION_SW_SHA8, base-type=uint8, implementation-data-type=uint8, transfer-property=PENDING
          signal CAN2_FUSION_SW_Var1: start 135, 8 bit, big-endian, i-signal-type=PRIMITIVE, init-value=constant-reference=Init_CAN2_FUSION_SW_Var1, base-type=uint8, implementation-data-type=uint8, transfer-property=PENDING
          signal CAN2_FUSION_SW_Var2: start 159, 8 bit, big-endian, i-signal-type=PRIMITIVE, init-value=constant-reference=Init_CAN2_FUSION_SW_Var2, base-type=uint8, implementation-data-type=uint8, transfer-property=PENDING
          signal CAN2_FUSION_SW_Var3: start 167, 8 bit, big-endian, i-signal-type=PRIMITIVE, init-value=constant-reference=Init_CAN2_FUSION_SW_Var3, base-type=uint8, implementation-data-type=uint8, transfer-property=PENDING
          signal CAN2_FUSION_SW_Var4: start 175, 8 bit, big-endian, i-signal-type=PRIMITIVE, init-value=constant-reference=Init_CAN2_FUSION_SW_Var4, base-type=uint8, implementation-data-type=uint8, transfer-property=PENDING
          signal CAN2_FUSION_SW_Var5: start 183, 8 bit, big-endian, i-signal-type=PRIMITIVE, init-value=constant-reference=Init_CAN2_FUSION_SW_Var5, base-type=uint8, implementation-data-type=uint8, transfer-property=PENDING
          signal CAN2_FUSION_SW_change1: start 199, 8 bit, big-endian, i-signal-type=PRIMITIVE, init-value=constant-reference=Init_CAN2_FUSION_SW_change1, base-type=uint8, implementation-data-type=uint8, transfer-property=PENDING
          signal CAN2_FUSION_SW_change2: start 207, 8 bit, big-endian, i-signal-type=PRIMITIVE, init-value=constant-reference=Init_CAN2_FUSION_SW_change2, base-type=uint8, implementation-data-type=uint8, transfer-property=PENDING
          signal CAN2_FUSION_SW_dash1: start 191, 8 bit, big-endian, i-signal-type=PRIMITIVE, init-value=constant-reference=Init_CAN2_FUSION_SW_dash1, base-type=uint8, implementation-data-type=uint8, transfer-property=PENDING
          signal CAN2_FUSION_SW_dash2: start 215, 8 bit, big-endian, i-signal-type=PRIMITIVE, init-value=constant-reference=Init_CAN2_FUSION_SW_dash2, base-type=uint8, implementation-data-type=uint8, transfer-property=PENDING
      frame CAN2_GW2_C10_0: id 0x1B3, frame-length=32, can-addressing-mode=STANDARD, can-fd-frame-support=true, can-frame-rx-behavior=CAN-FD, can-frame-tx-behavior=CAN-FD
        pdu CAN2_GW2_C10_0: length=32, minimum-delay=0.0, transmission-mode-true-timing=cyclic-timing=time-period=0.01, unused-bit-pattern=0
          mapping CAN2_SG_GW2_C10_0: i-signal-group=CAN2_SG_GW2_C10_0, start-position=0, transfer-property=PENDING
          mapping CAN2_SG_CGW_GW2_C10_0: i-signal-group=CAN2_SG_CGW_GW2_C10_0, start-position=0, transfer-property=PENDING
          signal CAN2_ABS_Active: start 123, 1 bit, big-endian, i-signal-type=PRIMITIVE, init-value=constant-reference=Init_CAN2_ABS_Active, base-type=uint8, implementation-data-type=uint8, transfer-property=PENDING
          signal CAN2_ABS_Failed: start 117, 1 bit, big-endian, i-signal-type=PRIMITIVE, init-value=constant-reference=Init_CAN2_ABS_Failed, base-type=uint8, implementation-data-type=uint8, transfer-property=PENDING
          signal CAN2_ABS_WnlmpSta: start 109, 1 bit, big-endian, i-signal-type=PRIMITIVE, init-value=constant-reference=Init_CAN2_ABS_WnlmpSta, base-type=uint8, implementation-data-type=uint8, transfer-property=PENDING
          signal CAN2_AVH_Failed: start 107, 1 bit, big-endian, i-signal-type=PRIMITIVE, init-value=constant-reference=Init_CAN2_AVH_Failed, base-type=uint8, implementation-data-type=uint8, transfer-property=PENDING
          signal CAN2_Amber_WnlmpSta: start 112, 1 bit, big-endian, i-signal-type=PRIMITIVE, init-value=constant-reference=Init_CAN2_Amber_WnlmpSta, base-type=uint8, implementation-data-type=uint8, transfer-property=PENDING
          signal CAN2_BrkSw_Sta: start 121, 1 bit, big-endian, i-signal-type=PRIMITIVE, init-value=constant-reference=Init_CAN2_BrkSw_Sta, base-type=uint8, implementation-data-type=uint8, transfer-property=PENDING
          signal CAN2_DCDCAuxCur: start 51, 12 bit, big-endian, i-signal-type=PRIMITIVE, init-value=constant-reference=Init_CAN2_DCDCAuxCur, base-type=uint16, implementation-data-type=uint16, transfer-property=PENDING
          signal CAN2_DCDCAuxVolt: start 167, 8 bit, big-endian, i-signal-type=PRIMITIVE, init-value=constant-reference=Init_CAN2_DCDCAuxVolt, base-type=uint8, implementation-data-type=uint8, transfer-property=PENDING
          signal CAN2_DrPMMLVOutPErrLmp: start 206, 1 bit, big-endian, i-signal-type=PRIMITIVE, init-value=constant-reference=Init_CAN2_DrPMMLVOutPErrLmp, base-type=uint8, implementation-data-type=uint8, transfer-property=PENDING
          signal CAN2_DrPMMSysErrLmp: start 207, 1 bit, big-endian, i-signal-type=PRIMITIVE, init-value=constant-reference=Init_CAN2_DrPMMSysErrLmp, base-type=uint8, implementation-data-type=uint8, transfer-property=PENDING
          signal CAN2_DrSCPSysErrLmp: start 205, 1 bit, big-endian, i-signal-type=PRIMITIVE, init-value=constant-reference=Init_CAN2_DrSCPSysErrLmp, base-type=uint8, implementation-data-type=uint8, transfer-property=PENDING
          signal CAN2_FLTurn_Light_Warning: start 178, 1 bit, big-endian, i-signal-type=PRIMITIVE, init-value=constant-reference=Init_CAN2_FLTurn_Light_Warning, base-type=uint8, implementation-data-type=uint8, transfer-property=PENDING
          signal CAN2_FRTurn_Light_Warning: start 186, 1 bit, big-endian, i-signal-type=PRIMITIVE, init-value=constant-reference=Init_CAN2_FRTurn_Light_Warning, base-type=uint8, implementation-data-type=uint8, transfer-property=PENDING
          signal CAN2_FireDetErr: start 220, 1 bit, big-endian, i-signal-type=PRIMITIVE, init-value=constant-reference=Init_CAN2_FireDetErr, base-type=uint8, implementation-data-type=uint8, transfer-property=PENDING
          signal CAN2_FrPMMLimpHomeActReq: start 204, 1 bit, big-endian, i-signal-type=PRIMITIVE, init-value=constant-reference=Init_CAN2_FrPMMLimpHomeActReq, base-type=uint8, implementation-data-type=uint8, transfer-property=PENDING
          signal CAN2_HSA_Active: start 126, 1 bit, big-endian, i-signal-type=PRIMITIVE, init-value=constant-reference=Init_CAN2_HSA_Active, base-type=uint8, implementation-data-type=uint8, transfer-property=PENDING
          signal CAN2_HSA_Failed: start 106, 1 bit, big-endian, i-signal-type=PRIMITIVE, init-value=constant-reference=Init_CAN2_HSA_Failed, base-type=uint8, implementation-data-type=uint8, transfer-property=PENDING
          signal CAN2_HVBattCurr: start 150, 15 bit, big-endian, i-signal-type=PRIMITIVE, init-value=constant-reference=Init_CAN2_HVBattCurr, base-type=uint16, implementation-data-type=uint16, transfer-property=PENDING
          signal CAN2_HVBattErr: start 218, 1 bit, big-endian, i-signal-type=PRIMITIVE, init-value=constant-reference=Init_CAN2_HVBattErr, base-type=uint8, implementation-data-type=uint8, transfer-property=PENDING
          signal CAN2_HVBattVolt: start 132, 13 bit, big-endian, i-signal-type=PRIMITIVE, init-value=constant-reference=Init_CAN2_HVBattVolt, base-type=uint16, implementation-data-type=uint16, transfer-property=PENDING
          signal CAN2_LADB_Hibeam_Indication: start 183, 1 bit, big-endian, i-signal-type=PRIMITIVE, init-value=constant-reference=Init_CAN2_LADB_Hibeam_Indication, base-type=uint8, implementation-data-type=uint8, transfer-property=PENDING
          signal CAN2_LADB_Operation_Status: start 182, 1 bit, big-endian, i-signal-type=PRIMITIVE, init-value=constant-reference=Init_CAN2_LADB_Operation_Status, base-type=uint8, implementation-data-type=uint8, transfer-property=PENDING
          signal CAN2_LADB_Warning: start 181, 1 bit, big-endian, i-signal-type=PRIMITIVE, init-value=constant-reference=Init_CAN2_LADB_Warning, base-type=uint8, implementation-data-type=uint8, transfer-property=PENDING
          signal CAN2_LAHB_Warning: start 179, 1 bit, big-endian, i-signal-type=PRIMITIVE, init-value=constant-reference=Init_CAN2_LAHB_Warning, base-type=uint8, implementation-data-type=uint8, transfer-property=PENDING
          signal CAN2_LDRL_Warning: start 177, 1 bit, big-endian, i-signal-type=PRIMITIVE, init-value=constant-reference=Init_CAN2_LDRL_Warning, base-type=uint8, implementation-data-type=uint8, transfer-property=PENDING
          signal CAN2_LLB_Warning: start 180, 1 bit, big-endian, i-signal-type=PRIMITIVE, init-value=constant-reference=Init_CAN2_LLB_Warning, base-type=uint8, implementation-data-type=uint8, transfer-property=PENDING
          signal CAN2_Lposition_Lamp_Warning: start 176, 1 bit, big-endian, i-signal-type=PRIMITIVE, init-value=constant-reference=Init_CAN2_Lposition_Lamp_Warning, base-type=uint8, implementation-data-type=uint8, transfer-property=PENDING
          signal CAN2_Meter_Ind_VehSpeed: start 27, 12 bit, big-endian, i-signal-type=PRIMITIVE, init-value=constant-reference=Init_CAN2_Meter_Ind_VehSpeed, base-type=uint16, implementation-data-type=uint16, transfer-property=PENDING
          signal CAN2_RADB_Hibeam_Indication: start 191, 1 bit, big-endian, i-signal-type=PRIMITIVE, init-value=constant-reference=Init_CAN2_RADB_Hibeam_Indication, base-type=uint8, implementation-data-type=uint8, transfer-property=PENDING
          signal CAN2_RADB_Operation_Status: start 190, 1 bit, big-endian, i-signal-type=PRIMITIVE, init-value=constant-reference=Init_CAN2_RADB_Operation_Status, base-type=uint8, implementation-data-type=uint8, transfer-property=PENDING
          signal CAN2_RADB_Warning: start 189, 1 bit, big-endian, i-signal-type=PRIMITIVE, init-value=constant-reference=Init_CAN2_RADB_Warning, base-type=uint8, implementation-data-type=uint8, transfer-property=PENDING
          signal CAN2_RAHB_Warning: start 187, 1 bit, big-endian, i-signal-type=PRIMITIVE, init-value=constant-reference=Init_CAN2_RAHB_Warning, base-type=uint8, implementation-data-type=uint8, transfer-property=PENDING
          signal CAN2_RDRL_Warning: start 185, 1 bit, big-endian, i-signal-type=PRIMITIVE, init-value=constant-reference=Init_CAN2_RDRL_Warning, base-type=uint8, implementation-data-type=uint8, transfer-property=PENDING
          signal CAN2_RLB_Warning: start 188, 1 bit, big-endian, i-signal-type=PRIMITIVE, init-value=constant-reference=Init_CAN2_RLB_Warning, base-type=uint8, implementation-data-type=uint8, transfer-property=PENDING
          signal CAN2_Red_WnlmpSta: start 122, 1 bit, big-endian, i-signal-type=PRIMITIVE, init-value=constant-reference=Init_CAN2_Red_WnlmpSta, base-type=uint8, implementation-data-type=uint8, transfer-property=PENDING
          signal CAN2_Rposition_Lamp_Warning: start 184, 1 bit, big-endian, i-signal-type=PRIMITIVE, init-value=constant-reference=Init_CAN2_Rposition_Lamp_Warning, base-type=uint8, implementation-data-type=uint8, transfer-property=PENDING
          signal CAN2_VehSpeed: start 23, 12 bit, big-endian, i-signal-type=PRIMITIVE, init-value=constant-reference=Init_CAN2_VehSpeed, base-type=uint16, implementation-data-type=uint16, transfer-property=PENDING
      frame CAN2_GW2_CE1000_0: id 0x337, frame-length=48, can-addressing-mode=STANDARD, can-fd-frame-support=true, can-frame-rx-behavior=CAN-FD, can-frame-tx-behavior=CAN-FD
        pdu CAN2_GW2_CE1000_0: length=48, minimum-delay=0.0, transmission-mode-true-timing={cyclic-timing=time-period=1, event-controlled-timing={number-of-repetitions=0, repetition-period=0}}, unused-bit-pattern=0
          mapping CAN2_SG_GW2_CE1000_0: i-signal-group=CAN2_SG_GW2_CE1000_0, start-position=0, transfer-property=TRIGGERED-ON-CHANGE
          signal CAN2_ACChrgCurrDis: start 94, 15 bit, big-endian, i-signal-type=PRIMITIVE, init-value=constant-reference=Init_CAN2_ACChrgCurrDis, base-type=uint16, implementation-data-type=uint16, transfer-property=PENDING
          signal CAN2_Charge_Percent_Set: start 111, 8 bit, big-endian, i-signal-type=PRIMITIVE, init-value=constant-reference=Init_CAN2_Charge_Percent_Set, base-type=uint8, implementation-data-type=uint8, transfer-property=TRIGGERED-ON-CHANGE
          signal CAN2_HVBChrgPwr: start 57, 10 bit, big-endian, i-signal-type=PRIMITIVE, init-value=constant-reference=Init_CAN2_HVBChrgPwr, base-type=uint16, implementation-data-type=uint16, transfer-property=PENDING
          signal CAN2_HVBattSOC: start 127, 8 bit, big-endian, i-signal-type=PRIMITIVE, init-value=constant-reference=Init_CAN2_HVBattSOC, base-type=uint8, implementation-data-type=uint8, transfer-property=PENDING
          signal CAN2_HVBattSOCDis: start 119, 8 bit, big-endian, i-signal-type=PRIMITIVE, init-value=constant-reference=Init_CAN2_HVBattSOCDis, base-type=uint8, implementation-data-type=uint8, transfer-property=PENDING
          signal CAN2_RemainChrgTime: start 75, 12 bit, big-endian, i-signal-type=PRIMITIVE, init-value=constant-reference=Init_CAN2_RemainChrgTime, base-type=uint16, implementation-data-type=uint16, transfer-property=PENDING
          signal CAN2_Rr_MCU3_HW_Ver: start 199, 16 bit, big-endian, i-signal-type=PRIMITIVE, init-value=constant-reference=Init_CAN2_Rr_MCU3_HW_Ver, base-type=uint16, implementation-data-type=uint16, transfer-property=PENDING
          signal CAN2_Rr_MCU3_HW_Ver_Nidec: start 263, 16 bit, big-endian, i-signal-type=PRIMITIVE, init-value=constant-reference=Init_CAN2_Rr_MCU3_HW_Ver_Nidec, base-type=uint16, implementation-data-type=uint16, transfer-property=PENDING
          signal CAN2_Rr_MCU3_SW_Ver: start 215, 16 bit, big-endian, i-signal-type=PRIMITIVE, init-value=constant-reference=Init_CAN2_Rr_MCU3_SW_Ver, base-type=uint16, implementation-data-type=uint16, transfer-property=PENDING
          signal CAN2_Rr_MCU3_SW_Ver_Nidec: start 279, 16 bit, big-endian, i-signal-type=PRIMITIVE, init-value=constant-reference=Init_CAN2_Rr_MCU3_SW_Ver_Nidec, base-type=uint16, implementation-data-type=uint16, transfer-property=PENDING
          signal CAN2_TBOX_HW_VER: start 135, 32 bit, big-endian, i-signal-type=PRIMITIVE, init-value=constant-reference=Init_CAN2_TBOX_HW_VER, base-type=uint32, implementation-data-type=uint32, transfer-property=PENDING
          signal CAN2_TBOX_SW_VER: start 167, 32 bit, big-endian, i-signal-type=PRIMITIVE, init-value=constant-reference=Init_CAN2_TBOX_SW_VER, base-type=uint32, implementation-data-type=uint32, transfer-property=PENDING
          signal CAN2_TimeSyncFromBS_Day: start 20, 5 bit, big-endian, i-signal-type=PRIMITIVE, init-value=constant-reference=Init_CAN2_TimeSyncFromBS_Day, base-type=uint8, implementation-data-type=uint8, transfer-property=PENDING
          signal CAN2_TimeSyncFromBS_Hour: start 28, 5 bit, big-endian, i-signal-type=PRIMITIVE, init-value=constant-reference=Init_CAN2_TimeSyncFromBS_Hour, base-type=uint8, implementation-data-type=uint8, transfer-property=PENDING
          signal CAN2_TimeSyncFromBS_Minute: start 37, 6 bit, big-endian, i-signal-type=PRIMITIVE, init-value=constant-reference=Init_CAN2_TimeSyncFromBS_Minute, base-type=uint8, implementation-data-type=uint8, transfer-property=PENDING
          signal CAN2_TimeSyncFromBS_Month: start 11, 4 bit, big-endian, i-signal-type=PRIMITIVE, init-value=constant-reference=Init_CAN2_TimeSyncFromBS_Month, base-type=uint8, implementation-data-type=uint8, transfer-property=PENDING
          signal CAN2_TimeSyncFromBS_Second: start 45, 6 bit, big-endian, i-signal-type=PRIMITIVE, init-value=constant-reference=Init_CAN2_TimeSyncFromBS_Second, base-type=uint8, implementation-data-type=uint8, transfer-property=PENDING
          signal CAN2_TimeSyncFromBS_Year: start 6, 7 bit, big-endian, i-signal-type=PRIMITIVE, init-value=constant-reference=Init_CAN2_TimeSyncFromBS_Year, base-type=uint8, implementation-data-type=uint8, transfer-property=PENDING
      frame CAN2_GW2_CE100_0: id 0x1C2, frame-length=32, can-addressing-mode=STANDARD, can-fd-frame-support=true, can-frame-rx-behavior=CAN-FD, can-frame-tx-behavior=CAN-FD
        pdu CAN2_GW2_CE100_0: length=32, minimum-delay=0.0, transmission-mode-true-timing={cyclic-timing=time-period=0.1, event-controlled-timing={number-of-repetitions=0, repetition-period=0}}, unused-bit-pattern=0
          mapping CAN2_SG_GW2_CE100_0: i-signal-group=CAN2_SG_GW2_CE100_0, start-position=0, transfer-property=TRIGGERED-ON-CHANGE
          signal CAN2_COMP_ActualPwr: start 180, 13 bit, big-endian, i-signal-type=PRIMITIVE, init-value=constant-reference=Init_CAN2_COMP_ActualPwr, base-type=uint16, implementation-data-type=uint16, transfer-property=PENDING
          signal CAN2_CbnPreACEnaReq: start 229, 2 bit, big-endian, i-signal-type=PRIMITIVE, init-value=constant-reference=Init_CAN2_CbnPreACEnaReq, base-type=uint8, implementation-data-type=uint8, transfer-property=TRIGGERED-ON-CHANGE
          signal CAN2_ChargeInletLockSta: start 151, 1 bit, big-endian, i-signal-type=PRIMITIVE, init-value=constant-reference=Init_CAN2_ChargeInletLockSta, base-type=uint8, implementation-data-type=uint8, transfer-property=TRIGGERED-ON-CHANGE
          signal CAN2_ChrgPlugSta: start 25, 2 bit, big-endian, i-signal-type=PRIMITIVE, init-value=constant-reference=Init_CAN2_ChrgPlugSta, base-type=uint8, implementation-data-type=uint8, transfer-property=TRIGGERED-ON-CHANGE
          signal CAN2_DKC_KeyNum_Sta: start 123, 4 bit, big-endian, i-signal-type=PRIMITIVE, init-value=constant-reference=Init_CAN2_DKC_KeyNum_Sta, base-type=uint8, implementation-data-type=uint8, transfer-property=TRIGGERED-ON-CHANGE
          signal CAN2_DKC_KeyType_Sta: start 125, 2 bit, big-endian, i-signal-type=PRIMITIVE, init-value=constant-reference=Init_CAN2_DKC_KeyType_Sta, base-type=uint8, implementation-data-type=uint8, transfer-property=TRIGGERED-ON-CHANGE
          signal CAN2_DisChrgPlugErr: start 29, 2 bit, big-endian, i-signal-type=PRIMITIVE, init-value=constant-reference=Init_CAN2_DisChrgPlugErr, base-type=uint8, implementation-data-type=uint8, transfer-property=TRIGGERED-ON-CHANGE
          signal CAN2_ExtChrgSta: start 27, 2 bit, big-endian, i-signal-type=PRIMITIVE, init-value=constant-reference=Init_CAN2_ExtChrgSta, base-type=uint8, implementation-data-type=uint8, transfer-property=TRIGGERED-ON-CHANGE
          signal CAN2_FDC_BCM_DimSw: start 104, 1 bit, big-endian, i-signal-type=PRIMITIVE, init-value=constant-reference=Init_CAN2_FDC_BCM_DimSw, base-type=uint8, implementation-data-type=uint8, transfer-property=TRIGGERED-ON-CHANGE
          signal CAN2_FDC_BCM_FWipSw_Sta: start 109, 3 bit, big-endian, i-signal-type=PRIMITIVE, init-value=constant-reference=Init_CAN2_FDC_BCM_FWipSw_Sta, base-type=uint8, implementation-data-type=uint8, transfer-property=TRIGGERED-ON-CHANGE
          signal CAN2_FDC_BCM_TurnSw_Sta: start 106, 2 bit, big-endian, i-signal-type=PRIMITIVE, init-value=constant-reference=Init_CAN2_FDC_BCM_TurnSw_Sta, base-type=uint8, implementation-data-type=uint8, transfer-property=TRIGGERED-ON-CHANGE
          signal CAN2_FrntPTCLeActHeatPwr: start 79, 8 bit, big-endian, i-signal-type=PRIMITIVE, init-value=constant-reference=Init_CAN2_FrntPTCLeActHeatPwr, base-type=uint8, implementation-data-type=uint8, transfer-property=PENDING
          signal CAN2_FrntPTCRearLeActHeatPwr: start 95, 8 bit, big-endian, i-signal-type=PRIMITIVE, init-value=constant-reference=Init_CAN2_FrntPTCRearLeActHeatPwr, base-type=uint8, implementation-data-type=uint8, transfer-property=PENDING
          signal CAN2_FrntPTCRearRiActHeatPwr: start 103, 8 bit, big-endian, i-signal-type=PRIMITIVE, init-value=constant-reference=Init_CAN2_FrntPTCRearRiActHeatPwr, base-type=uint8, implementation-data-type=uint8, transfer-property=PENDING
          signal CAN2_FrntPTCRiActHeatPwr: start 87, 8 bit, big-endian, i-signal-type=PRIMITIVE, init-value=constant-reference=Init_CAN2_FrntPTCRiActHeatPwr, base-type=uint8, implementation-data-type=uint8, transfer-property=PENDING
          signal CAN2_HVBChrgErr: start 23, 8 bit, big-endian, i-signal-type=PRIMITIVE, init-value=constant-reference=Init_CAN2_HVBChrgErr, base-type=uint8, implementation-data-type=uint8, transfer-property=TRIGGERED-ON-CHANGE
          signal CAN2_HVBContactorSta: start 111, 1 bit, big-endian, i-signal-type=PRIMITIVE, init-value=constant-reference=Init_CAN2_HVBContactorSta, base-type=uint8, implementation-data-type=uint8, transfer-property=TRIGGERED-ON-CHANGE
          signal CAN2_HVBMTempMax: start 239, 8 bit, big-endian, i-signal-type=PRIMITIVE, init-value=constant-reference=Init_CAN2_HVBMTempMax, base-type=uint8, implementation-data-type=uint8, transfer-property=PENDING
          signal CAN2_HVBOvrTempErr: start 39, 1 bit, big-endian, i-signal-type=PRIMITIVE, init-value=constant-reference=Init_CAN2_HVBOvrTempErr, base-type=uint8, implementation-data-type=uint8, transfer-property=TRIGGERED-ON-CHANGE
          signal CAN2_HVBOvrTempWarn: start 36, 2 bit, big-endian, i-signal-type=PRIMITIVE, init-value=constant-reference=Init_CAN2_HVBOvrTempWarn, base-type=uint8, implementation-data-type=uint8, transfer-property=TRIGGERED-ON-CHANGE
          signal CAN2_MainRlyNegSta: start 207, 8 bit, big-endian, i-signal-type=PRIMITIVE, init-value=constant-reference=Init_CAN2_MainRlyNegSta, base-type=uint8, implementation-data-type=uint8, transfer-property=TRIGGERED-ON-CHANGE
          signal CAN2_MainRlyPosSta: start 199, 8 bit, big-endian, i-signal-type=PRIMITIVE, init-value=constant-reference=Init_CAN2_MainRlyPosSta, base-type=uint8, implementation-data-type=uint8, transfer-property=TRIGGERED-ON-CHANGE
          signal CAN2_OBCACCSLimit: start 15, 8 bit, big-endian, i-signal-type=PRIMITIVE, init-value=constant-reference=Init_CAN2_OBCACCSLimit, base-type=uint8, implementation-data-type=uint8, transfer-property=TRIGGERED-ON-CHANGE
          signal CAN2_OBCACCurrInf: start 57, 10 bit, big-endian, i-signal-type=PRIMITIVE, init-value=constant-reference=Init_CAN2_OBCACCurrInf, base-type=uint16, implementation-data-type=uint16, transfer-property=PENDING
          signal CAN2_OBCACVoltInf: start 55, 12 bit, big-endian, i-signal-type=PRIMITIVE, init-value=constant-reference=Init_CAN2_OBCACVoltInf, base-type=uint16, implementation-data-type=uint16, transfer-property=PENDING
          signal CAN2_OBCFaultSta: start 59, 2 bit, big-endian, i-signal-type=PRIMITIVE, init-value=constant-reference=Init_CAN2_OBCFaultSta, base-type=uint8, implementation-data-type=uint8, transfer-property=TRIGGERED-ON-CHANGE
          signal CAN2_OBC_AC_Cur_Lim: start 38, 2 bit, big-endian, i-signal-type=PRIMITIVE, init-value=constant-reference=Init_CAN2_OBC_AC_Cur_Lim, base-type=uint8, implementation-data-type=uint8, transfer-property=TRIGGERED-ON-CHANGE
          signal CAN2_PTCActuPwrHSC6: start 167, 16 bit, big-endian, i-signal-type=PRIMITIVE, init-value=constant-reference=Init_CAN2_PTCActuPwrHSC6, base-type=uint16, implementation-data-type=uint16, transfer-property=PENDING
          signal CAN2_P_Dkey_Show_IVI: start 215, 4 bit, big-endian, i-signal-type=PRIMITIVE, init-value=constant-reference=Init_CAN2_P_Dkey_Show_IVI, base-type=uint8, implementation-data-type=uint8, transfer-property=TRIGGERED-ON-CHANGE
          signal CAN2_P_KeyMiss: start 211, 1 bit, big-endian, i-signal-type=PRIMITIVE, init-value=constant-reference=Init_CAN2_P_KeyMiss, base-type=uint8, implementation-data-type=uint8, transfer-property=TRIGGERED-ON-CHANGE
          signal CAN2_P_UID_LowPower: start 231, 1 bit, big-endian, i-signal-type=PRIMITIVE, init-value=constant-reference=Init_CAN2_P_UID_LowPower, base-type=uint8, implementation-data-type=uint8, transfer-property=TRIGGERED-ON-CHANGE
          signal CAN2_RLS_Lamp_Sta: start 110, 1 bit, big-endian, i-signal-type=PRIMITIVE, init-value=constant-reference=Init_CAN2_RLS_Lamp_Sta, base-type=uint8, implementation-data-type=uint8, transfer-property=TRIGGERED-ON-CHANGE
          signal CAN2_Re_Radio: start 181, 1 bit, big-endian, i-signal-type=PRIMITIVE, init-value=constant-reference=Init_CAN2_Re_Radio, base-type=uint8, implementation-data-type=uint8, transfer-property=TRIGGERED-ON-CHANGE
          signal CAN2_SWC_ACC_Sta: start 119, 1 bit, big-endian, i-signal-type=PRIMITIVE, init-value=constant-reference=Init_CAN2_SWC_ACC_Sta, base-type=uint8, implementation-data-type=uint8, transfer-property=TRIGGERED-ON-CHANGE
          signal CAN2_SWC_Down_Sta: start 118, 1 bit, big-endian, i-signal-type=PRIMITIVE, init-value=constant-reference=Init_CAN2_SWC_Down_Sta, base-type=uint8, implementation-data-type=uint8, transfer-property=TRIGGERED-ON-CHANGE
          signal CAN2_SWC_LKA_Sta: start 127, 1 bit, big-endian, i-signal-type=PRIMITIVE, init-value=constant-reference=Init_CAN2_SWC_LKA_Sta, base-type=uint8, implementation-data-type=uint8, transfer-property=TRIGGERED-ON-CHANGE
          signal CAN2_SWC_Left_Sta: start 116, 1 bit, big-endian, i-signal-type=PRIMITIVE, init-value=constant-reference=Init_CAN2_SWC_Left_Sta, base-type=uint8, implementation-data-type=uint8, transfer-property=TRIGGERED-ON-CHANGE
          signal CAN2_SWC_RegenDown: start 230, 1 bit, big-endian, i-signal-type=PRIMITIVE, init-value=constant-reference=Init_CAN2_SWC_RegenDown, base-type=uint8, implementation-data-type=uint8, transfer-property=TRIGGERED-ON-CHANGE
          signal CAN2_SWC_RegenUp: start 117, 1 bit, big-endian, i-signal-type=PRIMITIVE, init-value=constant-reference=Init_CAN2_SWC_RegenUp, base-type=uint8, implementation-data-type=uint8, transfer-property=TRIGGERED-ON-CHANGE
          signal CAN2_SWC_Right_Sta: start 114, 1 bit, big-endian, i-signal-type=PRIMITIVE, init-value=constant-reference=Init_CAN2_SWC_Right_Sta, base-type=uint8, implementation-data-type=uint8, transfer-property=TRIGGERED-ON-CHANGE
          signal CAN2_SWC_Trip_Sta: start 113, 1 bit, big-endian, i-signal-type=PRIMITIVE, init-value=constant-reference=Init_CAN2_SWC_Trip_Sta, base-type=uint8, implementation-data-type=uint8, transfer-property=TRIGGERED-ON-CHANGE
          signal CAN2_SWC_Undefined_Sta: start 135, 1 bit, big-endian, i-signal-type=PRIMITIVE, init-value=constant-reference=Init_CAN2_SWC_Undefined_Sta, base-type=uint8, implementation-data-type=uint8, transfer-property=TRIGGERED-ON-CHANGE
          signal CAN2_SWC_Up_Sta: start 112, 1 bit, big-endian, i-signal-type=PRIMITIVE, init-value=constant-reference=Init_CAN2_SWC_Up_Sta, base-type=uint8, implementation-data-type=uint8, transfer-property=TRIGGERED-ON-CHANGE
          signal CAN2_SWC_VR_Sta: start 143, 1 bit, big-endian, i-signal-type=PRIMITIVE, init-value=constant-reference=Init_CAN2_SWC_VR_Sta, base-type=uint8, implementation-data-type=uint8, transfer-property=TRIGGERED-ON-CHANGE
          signal CAN2_SWC_mode_Sta: start 115, 1 bit, big-endian, i-signal-type=PRIMITIVE, init-value=constant-reference=Init_CAN2_SWC_mode_Sta, base-type=uint8, implementation-data-type=uint8, transfer-property=TRIGGERED-ON-CHANGE
          signal CAN2_Shifter_Fail_sta: start 34, 3 bit, big-endian, i-signal-type=PRIMITIVE, init-value=constant-reference=Init_CAN2_Shifter_Fail_sta, base-type=uint8, implementation-data-type=uint8, transfer-property=TRIGGERED-ON-CHANGE
          signal CAN2_Shifter_Handle_Cmd: start 47, 8 bit, big-endian, i-signal-type=PRIMITIVE, init-value=constant-reference=Init_CAN2_Shifter_Handle_Cmd, base-type=uint8, implementation-data-type=uint8, transfer-property=TRIGGERED-ON-CHANGE
          signal CAN2_TBOX_NET_SIG_STR: start 219, 4 bit, big-endian, i-signal-type=PRIMITIVE, init-value=constant-reference=Init_CAN2_TBOX_NET_SIG_STR, base-type=uint8, implementation-data-type=uint8, transfer-property=TRIGGERED-ON-CHANGE
          signal CAN2_TBOX_TEST_STATUS: start 227, 4 bit, big-endian, i-signal-type=PRIMITIVE, init-value=constant-reference=Init_CAN2_TBOX_TEST_STATUS, base-type=uint8, implementation-data-type=uint8, transfer-property=TRIGGERED-ON-CHANGE
          signal CAN2_TrailerCheck: start 253, 1 bit, big-endian, i-signal-type=PRIMITIVE, init-value=constant-reference=Init_CAN2_TrailerCheck, base-type=uint8, implementation-data-type=uint8, transfer-property=TRIGGERED-ON-CHANGE
          signal CAN2_TrailerModeSta: start 255, 2 bit, big-endian, i-signal-type=PRIMITIVE, init-value=constant-reference=Init_CAN2_TrailerModeSta, base-type=uint8, implementation-data-type=uint8, transfer-property=TRIGGERED-ON-CHANGE
          signal CAN2_V2LSta: start 31, 2 bit, big-endian, i-signal-type=PRIMITIVE, init-value=constant-reference=Init_CAN2_V2LSta, base-type=uint8, implementation-data-type=uint8, transfer-property=TRIGGERED-ON-CHANGE
          signal CAN2_ZFR_BCM_ChargerDoorSW_Sta: start 126, 1 bit, big-endian, i-signal-type=PRIMITIVE, init-value=constant-reference=Init_CAN2_ZFR_BCM_ChargerDoorSW_Sta, base-type=uint8, implementation-data-type=uint8, transfer-property=TRIGGERED-ON-CHANGE
          signal CAN2_ZFR_EChrg_Active_Sta: start 210, 3 bit, big-endian, i-signal-type=PRIMITIVE, init-value=constant-reference=Init_CAN2_ZFR_EChrg_Active_Sta, base-type=uint8, implementation-data-type=uint8, transfer-property=TRIGGERED-ON-CHANGE
          signal CAN2_ZFR_EChrg_Sys_Sta: start 183, 2 bit, big-endian, i-signal-type=PRIMITIVE, init-value=constant-reference=Init_CAN2_ZFR_EChrg_Sys_Sta, base-type=uint8, implementation-data-type=uint8, transfer-property=TRIGGERED-ON-CHANGE
      frame CAN2_GW2_CE100_1: id 0x357, frame-length=32, can-addressing-mode=STANDARD, can-fd-frame-support=true, can-frame-rx-behavior=CAN-FD, can-frame-tx-behavior=CAN-FD
        pdu CAN2_GW2_CE100_1: length=32, minimum-delay=0.0, transmission-mode-true-timing={cyclic-timing=time-period=0.1, event-controlled-timing={number-of-repetitions=0, repetition-period=0}}, unused-bit-pattern=0
          mapping CAN2_SG_GW2_CE100_1: i-signal-group=CAN2_SG_GW2_CE100_1, start-position=0, transfer-property=TRIGGERED-ON-CHANGE
          signal CAN2_Fr_EDUDrtSta: start 193, 1 bit, big-endian, i-signal-type=PRIMITIVE, init-value=constant-reference=Init_CAN2_Fr_EDUDrtSta, base-type=uint8, implementation-data-type=uint8, transfer-property=PENDING
          signal CAN2_Fr_EDURealTMTq: start 231, 16 bit, big-endian, i-signal-type=PRIMITIVE, init-value=constant-reference=Init_CAN2_Fr_EDURealTMTq, base-type=uint16, implementation-data-type=uint16, transfer-property=PENDING
          signal CAN2_Fr_MCUTemp: start 176, 9 bit, big-endian, i-signal-type=PRIMITIVE, init-value=constant-reference=Init_CAN2_Fr_MCUTemp, base-type=uint16, implementation-data-type=uint16, transfer-property=PENDING
          signal CAN2_Fr_MCUTempWarn: start 215, 2 bit, big-endian, i-signal-type=PRIMITIVE, init-value=constant-reference=Init_CAN2_Fr_MCUTempWarn, base-type=uint8, implementation-data-type=uint8, transfer-property=PENDING
          signal CAN2_Fr_MotorAvailTq: start 211, 12 bit, big-endian, i-signal-type=PRIMITIVE, init-value=constant-reference=Init_CAN2_Fr_MotorAvailTq, base-type=uint16, implementation-data-type=uint16, transfer-property=PENDING
          signal CAN2_Fr_TMSpd: start 247, 16 bit, big-endian, i-signal-type=PRIMITIVE, init-value=constant-reference=Init_CAN2_Fr_TMSpd, base-type=uint16, implementation-data-type=uint16, transfer-property=PENDING
          signal CAN2_Fr_TMTemp: start 192, 9 bit, big-endian, i-signal-type=PRIMITIVE, init-value=constant-reference=Init_CAN2_Fr_TMTemp, base-type=uint16, implementation-data-type=uint16, transfer-property=PENDING
          signal CAN2_Fr_TMTempWarn: start 195, 2 bit, big-endian, i-signal-type=PRIMITIVE, init-value=constant-reference=Init_CAN2_Fr_TMTempWarn, base-type=uint8, implementation-data-type=uint8, transfer-property=PENDING
          signal CAN2_MCU_B_R_LLCTempWarn_Sta: start 133, 2 bit, big-endian, i-signal-type=PRIMITIVE, init-value=constant-reference=Init_CAN2_MCU_B_R_LLCTempWarn_Sta, base-type=uint8, implementation-data-type=uint8, transfer-property=TRIGGERED-ON-CHANGE
          signal CAN2_Rr_EDUDrtSta: start 113, 1 bit, big-endian, i-signal-type=PRIMITIVE, init-value=constant-reference=Init_CAN2_Rr_EDUDrtSta, base-type=uint8, implementation-data-type=uint8, transfer-property=PENDING
          signal CAN2_Rr_EDURealTMTq: start 151, 16 bit, big-endian, i-signal-type=PRIMITIVE, init-value=constant-reference=Init_CAN2_Rr_EDURealTMTq, base-type=uint16, implementation-data-type=uint16, transfer-property=PENDING
          signal CAN2_Rr_MCUTemp: start 96, 9 bit, big-endian, i-signal-type=PRIMITIVE, init-value=constant-reference=Init_CAN2_Rr_MCUTemp, base-type=uint16, implementation-data-type=uint16, transfer-property=PENDING
          signal CAN2_Rr_MCUTempWarn: start 135, 2 bit, big-endian, i-signal-type=PRIMITIVE, init-value=constant-reference=Init_CAN2_Rr_MCUTempWarn, base-type=uint8, implementation-data-type=uint8, transfer-property=PENDING
          signal CAN2_Rr_MotorAvailTq: start 131, 12 bit, big-endian, i-signal-type=PRIMITIVE, init-value=constant-reference=Init_CAN2_Rr_MotorAvailTq, base-type=uint16, implementation-data-type=uint16, transfer-property=PENDING
          signal CAN2_Rr_TMSpd: start 167, 16 bit, big-endian, i-signal-type=PRIMITIVE, init-value=constant-reference=Init_CAN2_Rr_TMSpd, base-type=uint16, implementation-data-type=uint16, transfer-property=PENDING
          signal CAN2_Rr_TMTemp: start 112, 9 bit, big-endian, i-signal-type=PRIMITIVE, init-value=constant-reference=Init_CAN2_Rr_TMTemp, base-type=uint16, implementation-data-type=uint16, transfer-property=PENDING
          signal CAN2_Rr_TMTempWarn: start 115, 2 bit, big-endian, i-signal-type=PRIMITIVE, init-value=constant-reference=Init_CAN2_Rr_TMTempWarn, base-type=uint8, implementation-data-type=uint8, transfer-property=PENDING
          signal CAN2_SWC2_L_DriveMode_Sta: start 71, 1 bit, big-endian, i-signal-type=PRIMITIVE, init-value=constant-reference=Init_CAN2_SWC2_L_DriveMode_Sta, base-type=uint8, implementation-data-type=uint8, transfer-property=TRIGGERED-ON-CHANGE
          signal CAN2_SWC2_L_Home_Sta: start 67, 1 bit, big-endian, i-signal-type=PRIMITIVE, init-value=constant-reference=Init_CAN2_SWC2_L_Home_Sta, base-type=uint8, implementation-data-type=uint8, transfer-property=TRIGGERED-ON-CHANGE
          signal CAN2_SWC2_R_Customize_Sta: start 47, 1 bit, big-endian, i-signal-type=PRIMITIVE, init-value=constant-reference=Init_CAN2_SWC2_R_Customize_Sta, base-type=uint8, implementation-data-type=uint8, transfer-property=TRIGGERED-ON-CHANGE
          signal CAN2_SWC2_R_Left_Sta: start 23, 1 bit, big-endian, i-signal-type=PRIMITIVE, init-value=constant-reference=Init_CAN2_SWC2_R_Left_Sta, base-type=uint8, implementation-data-type=uint8, transfer-property=TRIGGERED-ON-CHANGE
          signal CAN2_SWC2_R_PageSwitch_Sta: start 55, 1 bit, big-endian, i-signal-type=PRIMITIVE, init-value=constant-reference=Init_CAN2_SWC2_R_PageSwitch_Sta, base-type=uint8, implementation-data-type=uint8, transfer-property=TRIGGERED-ON-CHANGE
          signal CAN2_SWC2_R_Right_Sta: start 22, 1 bit, big-endian, i-signal-type=PRIMITIVE, init-value=constant-reference=Init_CAN2_SWC2_R_Right_Sta, base-type=uint8, implementation-data-type=uint8, transfer-property=TRIGGERED-ON-CHANGE
          signal CAN2_SWC2_R_ScrollDown_Sta: start 30, 1 bit, big-endian, i-signal-type=PRIMITIVE, init-value=constant-reference=Init_CAN2_SWC2_R_ScrollDown_Sta, base-type=uint8, implementation-data-type=uint8, transfer-property=TRIGGERED-ON-CHANGE
          signal CAN2_SWC2_R_ScrollPress_Sta: start 39, 1 bit, big-endian, i-signal-type=PRIMITIVE, init-value=constant-reference=Init_CAN2_SWC2_R_ScrollPress_Sta, base-type=uint8, implementation-data-type=uint8, transfer-property=TRIGGERED-ON-CHANGE
          signal CAN2_SWC2_R_ScrollUp_Sta: start 31, 1 bit, big-endian, i-signal-type=PRIMITIVE, init-value=constant-reference=Init_CAN2_SWC2_R_ScrollUp_Sta, base-type=uint8, implementation-data-type=uint8, transfer-property=TRIGGERED-ON-CHANGE
          signal CAN2_SWC2_R_VR_Sta: start 63, 1 bit, big-endian, i-signal-type=PRIMITIVE, init-value=constant-reference=Init_CAN2_SWC2_R_VR_Sta, base-type=uint8, implementation-data-type=uint8, transfer-property=TRIGGERED-ON-CHANGE
      frame CAN2_GW2_CE100_2: id 0x359, frame-length=32, can-addressing-mode=STANDARD, can-fd-frame-support=true, can-frame-rx-behavior=CAN-FD, can-frame-tx-behavior=CAN-FD
        pdu CAN2_GW2_CE100_2: length=32, minimum-delay=0.0, transmission-mode-true-timing={cyclic-timing=time-period=0.1, event-controlled-timing={number-of-repetitions=0, repetition-period=0}}, unused-bit-pattern=0
          mapping CAN2_SG_GW2_CE100_2: i-signal-group=CAN2_SG_GW2_CE100_2, start-position=0, transfer-property=TRIGGERED-ON-CHANGE
          signal CAN2_FAPWL_01_LIN_Response_Error: start 71, 1 bit, big-endian, i-signal-type=PRIMITIVE, init-value=constant-reference=Init_CAN2_FAPWL_01_LIN_Response_Error, base-type=uint8, implementation-data-type=uint8, transfer-property=TRIGGERED-ON-CHANGE
          signal CAN2_L_Drv_Motor_Relay_Error: start 27, 1 bit, big-endian, i-signal-type=PRIMITIVE, init-value=constant-reference=Init_CAN2_L_Drv_Motor_Relay_Error, base-type=uint8, implementation-data-type=uint8, transfer-property=TRIGGERED-ON-CHANGE
          signal CAN2_L_Drv_Motor_Ripple_Error: start 39, 1 bit, big-endian, i-signal-type=PRIMITIVE, init-value=constant-reference=Init_CAN2_L_Drv_Motor_Ripple_Error, base-type=uint8, implementation-data-type=uint8, transfer-property=TRIGGERED-ON-CHANGE
          signal CAN2_L_Drv_Val_Wdw_Opened: start 38, 7 bit, big-endian, i-signal-type=PRIMITIVE, init-value=constant-reference=Init_CAN2_L_Drv_Val_Wdw_Opened, base-type=uint8, implementation-data-type=uint8, transfer-property=PENDING
          signal CAN2_L_Pas_Motor_Relay_Error: start 26, 1 bit, big-endian, i-signal-type=PRIMITIVE, init-value=constant-reference=Init_CAN2_L_Pas_Motor_Relay_Error, base-type=uint8, implementation-data-type=uint8, transfer-property=TRIGGERED-ON-CHANGE
          signal CAN2_L_Pas_Motor_Ripple_Error: start 47, 1 bit, big-endian, i-signal-type=PRIMITIVE, init-value=constant-reference=Init_CAN2_L_Pas_Motor_Ripple_Error, base-type=uint8, implementation-data-type=uint8, transfer-property=TRIGGERED-ON-CHANGE
          signal CAN2_L_Pas_Val_Wdw_Opened: start 46, 7 bit, big-endian, i-signal-type=PRIMITIVE, init-value=constant-reference=Init_CAN2_L_Pas_Val_Wdw_Opened, base-type=uint8, implementation-data-type=uint8, transfer-property=PENDING
          signal CAN2_L_RLD_Motor_Relay_Error: start 25, 1 bit, big-endian, i-signal-type=PRIMITIVE, init-value=constant-reference=Init_CAN2_L_RLD_Motor_Relay_Error, base-type=uint8, implementation-data-type=uint8, transfer-property=TRIGGERED-ON-CHANGE
          signal CAN2_L_RLD_Motor_Ripple_Error: start 55, 1 bit, big-endian, i-signal-type=PRIMITIVE, init-value=constant-reference=Init_CAN2_L_RLD_Motor_Ripple_Error, base-type=uint8, implementation-data-type=uint8, transfer-property=TRIGGERED-ON-CHANGE
          signal CAN2_L_RLD_Val_Wdw_Opened: start 54, 7 bit, big-endian, i-signal-type=PRIMITIVE, init-value=constant-reference=Init_CAN2_L_RLD_Val_Wdw_Opened, base-type=uint8, implementation-data-type=uint8, transfer-property=PENDING
          signal CAN2_L_RRD_Motor_Relay_Error: start 24, 1 bit, big-endian, i-signal-type=PRIMITIVE, init-value=constant-reference=Init_CAN2_L_RRD_Motor_Relay_Error, base-type=uint8, implementation-data-type=uint8, transfer-property=TRIGGERED-ON-CHANGE
          signal CAN2_L_RRD_Motor_Ripple_Error: start 63, 1 bit, big-endian, i-signal-type=PRIMITIVE, init-value=constant-reference=Init_CAN2_L_RRD_Motor_Ripple_Error, base-type=uint8, implementation-data-type=uint8, transfer-property=TRIGGERED-ON-CHANGE
          signal CAN2_L_RRD_Val_Wdw_Opened: start 62, 7 bit, big-endian, i-signal-type=PRIMITIVE, init-value=constant-reference=Init_CAN2_L_RRD_Val_Wdw_Opened, base-type=uint8, implementation-data-type=uint8, transfer-property=PENDING
          signal CAN2_RAPWL_01_LIN_Response_Error: start 67, 1 bit, big-endian, i-signal-type=PRIMITIVE, init-value=constant-reference=Init_CAN2_RAPWL_01_LIN_Response_Error, base-type=uint8, implementation-data-type=uint8, transfer-property=TRIGGERED-ON-CHANGE
          signal CAN2_Rr_EDUDrtSta_Nidec: start 113, 1 bit, big-endian, i-signal-type=PRIMITIVE, init-value=constant-reference=Init_CAN2_Rr_EDUDrtSta_Nidec, base-type=uint8, implementation-data-type=uint8, transfer-property=PENDING
          signal CAN2_Rr_EDURealTMTq_Nidec: start 147, 12 bit, big-endian, i-signal-type=PRIMITIVE, init-value=constant-reference=Init_CAN2_Rr_EDURealTMTq_Nidec, base-type=uint16, implementation-data-type=uint16, transfer-property=PENDING
          signal CAN2_Rr_MCUTempWarn_Nidec: start 151, 2 bit, big-endian, i-signal-type=PRIMITIVE, init-value=constant-reference=Init_CAN2_Rr_MCUTempWarn_Nidec, base-type=uint8, implementation-data-type=uint8, transfer-property=PENDING
          signal CAN2_Rr_MCUTemp_Nidec: start 96, 9 bit, big-endian, i-signal-type=PRIMITIVE, init-value=constant-reference=Init_CAN2_Rr_MCUTemp_Nidec, base-type=uint16, implementation-data-type=uint16, transfer-property=PENDING
          signal CAN2_Rr_MotorAvailTq_Nidec: start 131, 12 bit, big-endian, i-signal-type=PRIMITIVE, init-value=constant-reference=Init_CAN2_Rr_MotorAvailTq_Nidec, base-type=uint16, implementation-data-type=uint16, transfer-property=PENDING
          signal CAN2_Rr_TMSpd_Nidec: start 167, 16 bit, big-endian, i-signal-type=PRIMITIVE, init-value=constant-reference=Init_CAN2_Rr_TMSpd_Nidec, base-type=uint16, implementation-data-type=uint16, transfer-property=PENDING
          signal CAN2_Rr_TMTempWarn_Nidec: start 149, 2 bit, big-endian, i-signal-type=PRIMITIVE, init-value=constant-reference=Init_CAN2_Rr_TMTempWarn_Nidec, base-type=uint8, implementation-data-type=uint8, transfer-property=PENDING
          signal CAN2_Rr_TMTemp_Nidec: start 112, 9 bit, big-endian, i-signal-type=PRIMITIVE, init-value=constant-reference=Init_CAN2_Rr_TMTemp_Nidec, base-type=uint16, implementation-data-type=uint16, transfer-property=PENDING
      frame CAN2_IVI1: id 0x490, frame-length=20, can-addressing-mode=STANDARD, can-fd-frame-support=true, can-frame-rx-behavior=CAN-FD, can-frame-tx-behavior=CAN-FD
        pdu CAN2_IVI1: length=20, minimum-delay=0.0, transmission-mode-true-timing={cyclic-timing=time-period=0.5, event-controlled-timing={number-of-repetitions=0, repetition-period=0}}, unused-bit-pattern=0
          mapping CAN2_SG_IVI1: i-signal-group=CAN2_SG_IVI1, start-position=0, transfer-property=TRIGGERED-ON-CHANGE
          signal CAN2_A2B_Node_sta: start 55, 1 bit, big-endian, i-signal-type=PRIMITIVE, init-value=constant-reference=Init_CAN2_A2B_Node_sta, base-type=uint8, implementation-data-type=uint8, transfer-property=TRIGGERED-ON-CHANGE
          signal CAN2_AmbLigh_LowBatAlert_SW: start 33, 1 bit, big-endian, i-signal-type=PRIMITIVE, init-value=constant-reference=Init_CAN2_AmbLigh_LowBatAlert_SW, base-type=uint8, implementation-data-type=uint8, transfer-property=TRIGGERED-ON-CHANGE
          signal CAN2_AmbLigh_SafetyAlert_SW: start 32, 1 bit, big-endian, i-signal-type=PRIMITIVE, init-value=constant-reference=Init_CAN2_AmbLigh_SafetyAlert_SW, base-type=uint8, implementation-data-type=uint8, transfer-property=TRIGGERED-ON-CHANGE
          signal CAN2_AmbLightBrightnessSet: start 54, 7 bit, big-endian, i-signal-type=PRIMITIVE, init-value=constant-reference=Init_CAN2_AmbLightBrightnessSet, base-type=uint8, implementation-data-type=uint8, transfer-property=TRIGGERED-ON-CHANGE
          signal CAN2_AmbLightColorSet: start 46, 7 bit, big-endian, i-signal-type=PRIMITIVE, init-value=constant-reference=Init_CAN2_AmbLightColorSet, base-type=uint8, implementation-data-type=uint8, transfer-property=TRIGGERED-ON-CHANGE
          signal CAN2_AmbLight_DimInDark_SW: start 35, 1 bit, big-endian, i-signal-type=PRIMITIVE, init-value=constant-reference=Init_CAN2_AmbLight_DimInDark_SW, base-type=uint8, implementation-data-type=uint8, transfer-property=TRIGGERED-ON-CHANGE
          signal CAN2_AmbLight_SW: start 36, 1 bit, big-endian, i-signal-type=PRIMITIVE, init-value=constant-reference=Init_CAN2_AmbLight_SW, base-type=uint8, implementation-data-type=uint8, transfer-property=TRIGGERED-ON-CHANGE
          signal CAN2_AmbLight_WlcmLight_SW: start 34, 1 bit, big-endian, i-signal-type=PRIMITIVE, init-value=constant-reference=Init_CAN2_AmbLight_WlcmLight_SW, base-type=uint8, implementation-data-type=uint8, transfer-property=TRIGGERED-ON-CHANGE
          signal CAN2_BrkAbn_GoReady_SW: start 85, 1 bit, big-endian, i-signal-type=PRIMITIVE, init-value=constant-reference=Init_CAN2_BrkAbn_GoReady_SW, base-type=uint8, implementation-data-type=uint8, transfer-property=TRIGGERED-ON-CHANGE
          signal CAN2_FCP_FrEvt_BtnACMaxReq: start 20, 1 bit, big-endian, i-signal-type=PRIMITIVE, init-value=constant-reference=Init_CAN2_FCP_FrEvt_BtnACMaxReq, base-type=uint8, implementation-data-type=uint8, transfer-property=TRIGGERED-ON-CHANGE
          signal CAN2_FCP_FrEvt_BtnACReq: start 19, 1 bit, big-endian, i-signal-type=PRIMITIVE, init-value=constant-reference=Init_CAN2_FCP_FrEvt_BtnACReq, base-type=uint8, implementation-data-type=uint8, transfer-property=TRIGGERED-ON-CHANGE
          signal CAN2_FCP_FrEvt_BtnAutoReq: start 18, 1 bit, big-endian, i-signal-type=PRIMITIVE, init-value=constant-reference=Init_CAN2_FCP_FrEvt_BtnAutoReq, base-type=uint8, implementation-data-type=uint8, transfer-property=TRIGGERED-ON-CHANGE
          signal CAN2_FCP_FrEvt_BtnSyncReq: start 16, 1 bit, big-endian, i-signal-type=PRIMITIVE, init-value=constant-reference=Init_CAN2_FCP_FrEvt_BtnSyncReq, base-type=uint8, implementation-data-type=uint8, transfer-property=TRIGGERED-ON-CHANGE
          signal CAN2_FCP_MidEvt_BtnAutoReq: start 17, 1 bit, big-endian, i-signal-type=PRIMITIVE, init-value=constant-reference=Init_CAN2_FCP_MidEvt_BtnAutoReq, base-type=uint8, implementation-data-type=uint8, transfer-property=TRIGGERED-ON-CHANGE
          signal CAN2_IVI_AirRefresh_ByDMS_Sta: start 151, 1 bit, big-endian, i-signal-type=PRIMITIVE, init-value=constant-reference=Init_CAN2_IVI_AirRefresh_ByDMS_Sta, base-type=uint8, implementation-data-type=uint8, transfer-property=TRIGGERED-ON-CHANGE
          signal CAN2_IVI_AutoTheme_But_Sta: start 154, 1 bit, big-endian, i-signal-type=PRIMITIVE, init-value=constant-reference=Init_CAN2_IVI_AutoTheme_But_Sta, base-type=uint8, implementation-data-type=uint8, transfer-property=TRIGGERED-ON-CHANGE
          signal CAN2_IVI_CLWin_LockDoorSW_Sta: start 148, 1 bit, big-endian, i-signal-type=PRIMITIVE, init-value=constant-reference=Init_CAN2_IVI_CLWin_LockDoorSW_Sta, base-type=uint8, implementation-data-type=uint8, transfer-property=TRIGGERED-ON-CHANGE
          signal CAN2_IVI_CreateAccReq_Sta: start 127, 3 bit, big-endian, i-signal-type=PRIMITIVE, init-value=constant-reference=Init_CAN2_IVI_CreateAccReq_Sta, base-type=uint8, implementation-data-type=uint8, transfer-property=TRIGGERED-ON-CHANGE
          signal CAN2_IVI_DMS_SW_Sta: start 150, 1 bit, big-endian, i-signal-type=PRIMITIVE, init-value=constant-reference=Init_CAN2_IVI_DMS_SW_Sta, base-type=uint8, implementation-data-type=uint8, transfer-property=TRIGGERED-ON-CHANGE
          signal CAN2_IVI_DSEAT_anti_set_Sta: start 153, 1 bit, big-endian, i-signal-type=PRIMITIVE, init-value=constant-reference=Init_CAN2_IVI_DSEAT_anti_set_Sta, base-type=uint8, implementation-data-type=uint8, transfer-property=TRIGGERED-ON-CHANGE
          signal CAN2_IVI_DelAccReq_Sta: start 119, 3 bit, big-endian, i-signal-type=PRIMITIVE, init-value=constant-reference=Init_CAN2_IVI_DelAccReq_Sta, base-type=uint8, implementation-data-type=uint8, transfer-property=TRIGGERED-ON-CHANGE
          signal CAN2_IVI_FrTrunk_UnlockReq_Sta: start 147, 1 bit, big-endian, i-signal-type=PRIMITIVE, init-value=constant-reference=Init_CAN2_IVI_FrTrunk_UnlockReq_Sta, base-type=uint8, implementation-data-type=uint8, transfer-property=TRIGGERED-ON-CHANGE
          signal CAN2_IVI_HMI_Undefined_Sta: start 158, 3 bit, big-endian, i-signal-type=PRIMITIVE, init-value=constant-reference=Init_CAN2_IVI_HMI_Undefined_Sta, base-type=uint8, implementation-data-type=uint8, transfer-property=TRIGGERED-ON-CHANGE
          signal CAN2_IVI_LinkAccReq_Sta: start 143, 1 bit, big-endian, i-signal-type=PRIMITIVE, init-value=constant-reference=Init_CAN2_IVI_LinkAccReq_Sta, base-type=uint8, implementation-data-type=uint8, transfer-property=TRIGGERED-ON-CHANGE
          signal CAN2_IVI_LinkAcc_Sta: start 146, 3 bit, big-endian, i-signal-type=PRIMITIVE, init-value=constant-reference=Init_CAN2_IVI_LinkAcc_Sta, base-type=uint8, implementation-data-type=uint8, transfer-property=TRIGGERED-ON-CHANGE
          signal CAN2_IVI_LinkKey_Sta: start 135, 4 bit, big-endian, i-signal-type=PRIMITIVE, init-value=constant-reference=Init_CAN2_IVI_LinkKey_Sta, base-type=uint8, implementation-data-type=uint8, transfer-property=TRIGGERED-ON-CHANGE
          signal CAN2_IVI_Located_STA: start 79, 2 bit, big-endian, i-signal-type=PRIMITIVE, init-value=constant-reference=Init_CAN2_IVI_Located_STA, base-type=uint8, implementation-data-type=uint8, transfer-property=TRIGGERED-ON-CHANGE
          signal CAN2_IVI_Lock_SoundSW_Sta: start 149, 1 bit, big-endian, i-signal-type=PRIMITIVE, init-value=constant-reference=Init_CAN2_IVI_Lock_SoundSW_Sta, base-type=uint8, implementation-data-type=uint8, transfer-property=TRIGGERED-ON-CHANGE
          signal CAN2_IVI_NAVI_Foreground_Sta: start 155, 1 bit, big-endian, i-signal-type=PRIMITIVE, init-value=constant-reference=Init_CAN2_IVI_NAVI_Foreground_Sta, base-type=uint8, implementation-data-type=uint8, transfer-property=TRIGGERED-ON-CHANGE
          signal CAN2_IVI_OTA_Upd_Sta: start 28, 2 bit, big-endian, i-signal-type=PRIMITIVE, init-value=constant-reference=Init_CAN2_IVI_OTA_Upd_Sta, base-type=uint8, implementation-data-type=uint8, transfer-property=TRIGGERED-ON-CHANGE
          signal CAN2_IVI_QuickRefresh_Sta: start 159, 1 bit, big-endian, i-signal-type=PRIMITIVE, init-value=constant-reference=Init_CAN2_IVI_QuickRefresh_Sta, base-type=uint8, implementation-data-type=uint8, transfer-property=TRIGGERED-ON-CHANGE
          signal CAN2_IVI_SWC_VibMode_Sta: start 111, 2 bit, big-endian, i-signal-type=PRIMITIVE, init-value=constant-reference=Init_CAN2_IVI_SWC_VibMode_Sta, base-type=uint8, implementation-data-type=uint8, transfer-property=TRIGGERED-ON-CHANGE
          signal CAN2_IVI_Time_Check: start 95, 8 bit, big-endian, i-signal-type=PRIMITIVE, init-value=constant-reference=Init_CAN2_IVI_Time_Check, base-type=uint8, implementation-data-type=uint8, transfer-property=PENDING
          signal CAN2_IVI_Time_Day: start 116, 5 bit, big-endian, i-signal-type=PRIMITIVE, init-value=constant-reference=Init_CAN2_IVI_Time_Day, base-type=uint8, implementation-data-type=uint8, transfer-property=PENDING
          signal CAN2_IVI_Time_Hour: start 124, 5 bit, big-endian, i-signal-type=PRIMITIVE, init-value=constant-reference=Init_CAN2_IVI_Time_Hour, base-type=uint8, implementation-data-type=uint8, transfer-property=PENDING
          signal CAN2_IVI_Time_Minute: start 109, 6 bit, big-endian, i-signal-type=PRIMITIVE, init-value=constant-reference=Init_CAN2_IVI_Time_Minute, base-type=uint8, implementation-data-type=uint8, transfer-property=PENDING
          signal CAN2_IVI_Time_Month: start 131, 4 bit, big-endian, i-signal-type=PRIMITIVE, init-value=constant-reference=Init_CAN2_IVI_Time_Month, base-type=uint8, implementation-data-type=uint8, transfer-property=PENDING
          signal CAN2_IVI_Time_Second: start 101, 6 bit, big-endian, i-signal-type=PRIMITIVE, init-value=constant-reference=Init_CAN2_IVI_Time_Second, base-type=uint8, implementation-data-type=uint8, transfer-property=PENDING
          signal CAN2_IVI_Time_Year: start 142, 7 bit, big-endian, i-signal-type=PRIMITIVE, init-value=constant-reference=Init_CAN2_IVI_Time_Year, base-type=uint8, implementation-data-type=uint8, transfer-property=PENDING
          signal CAN2_IVI_sigScreenReq_Sta: start 152, 1 bit, big-endian, i-signal-type=PRIMITIVE, init-value=constant-reference=Init_CAN2_IVI_sigScreenReq_Sta, base-type=uint8, implementation-data-type=uint8, transfer-property=TRIGGERED-ON-CHANGE
          signal CAN2_LINKtoDrive: start 24, 1 bit, big-endian, i-signal-type=PRIMITIVE, init-value=constant-reference=Init_CAN2_LINKtoDrive, base-type=uint8, implementation-data-type=uint8, transfer-property=TRIGGERED-ON-CHANGE
          signal CAN2_OTA_CancelDL_Req: start 26, 1 bit, big-endian, i-signal-type=PRIMITIVE, init-value=constant-reference=Init_CAN2_OTA_CancelDL_Req, base-type=uint8, implementation-data-type=uint8, transfer-property=TRIGGERED-ON-CHANGE
          signal CAN2_OTA_CompNTFY_Pres: start 86, 1 bit, big-endian, i-signal-type=PRIMITIVE, init-value=constant-reference=Init_CAN2_OTA_CompNTFY_Pres, base-type=uint8, implementation-data-type=uint8, transfer-property=TRIGGERED-ON-CHANGE
          signal CAN2_OTA_DL_Req: start 31, 1 bit, big-endian, i-signal-type=PRIMITIVE, init-value=constant-reference=Init_CAN2_OTA_DL_Req, base-type=uint8, implementation-data-type=uint8, transfer-property=TRIGGERED-ON-CHANGE
          signal CAN2_OTA_SuspendDL_Req: start 30, 1 bit, big-endian, i-signal-type=PRIMITIVE, init-value=constant-reference=Init_CAN2_OTA_SuspendDL_Req, base-type=uint8, implementation-data-type=uint8, transfer-property=TRIGGERED-ON-CHANGE
          signal CAN2_OTA_UpdStart_Req: start 29, 1 bit, big-endian, i-signal-type=PRIMITIVE, init-value=constant-reference=Init_CAN2_OTA_UpdStart_Req, base-type=uint8, implementation-data-type=uint8, transfer-property=TRIGGERED-ON-CHANGE
          signal CAN2_OpenDrOpenWdo_SW: start 37, 1 bit, big-endian, i-signal-type=PRIMITIVE, init-value=constant-reference=Init_CAN2_OpenDrOpenWdo_SW, base-type=uint8, implementation-data-type=uint8, transfer-property=TRIGGERED-ON-CHANGE
          signal CAN2_PW_CLOSE_IMD: start 102, 1 bit, big-endian, i-signal-type=PRIMITIVE, init-value=constant-reference=Init_CAN2_PW_CLOSE_IMD, base-type=uint8, implementation-data-type=uint8, transfer-property=TRIGGERED-ON-CHANGE
          signal CAN2_PW_CONTINUE_USE: start 103, 1 bit, big-endian, i-signal-type=PRIMITIVE, init-value=constant-reference=Init_CAN2_PW_CONTINUE_USE, base-type=uint8, implementation-data-type=uint8, transfer-property=TRIGGERED-ON-CHANGE
          signal CAN2_Re_Radio_Sta: start 63, 1 bit, big-endian, i-signal-type=PRIMITIVE, init-value=constant-reference=Init_CAN2_Re_Radio_Sta, base-type=uint8, implementation-data-type=uint8, transfer-property=TRIGGERED-ON-CHANGE
          signal CAN2_Sched_Chg_Day_Set: start 62, 1 bit, big-endian, i-signal-type=PRIMITIVE, init-value=constant-reference=Init_CAN2_Sched_Chg_Day_Set, base-type=uint8, implementation-data-type=uint8, transfer-property=TRIGGERED-ON-CHANGE
          signal CAN2_Sched_Chg_End_Time_HR: start 84, 5 bit, big-endian, i-signal-type=PRIMITIVE, init-value=constant-reference=Init_CAN2_Sched_Chg_End_Time_HR, base-type=uint8, implementation-data-type=uint8, transfer-property=TRIGGERED-ON-CHANGE
          signal CAN2_Sched_Chg_End_Time_Min: start 77, 6 bit, big-endian, i-signal-type=PRIMITIVE, init-value=constant-reference=Init_CAN2_Sched_Chg_End_Time_Min, base-type=uint8, implementation-data-type=uint8, transfer-property=TRIGGERED-ON-CHANGE
          signal CAN2_Sched_Chg_St_Time_HR: start 68, 5 bit, big-endian, i-signal-type=PRIMITIVE, init-value=constant-reference=Init_CAN2_Sched_Chg_St_Time_HR, base-type=uint8, implementation-data-type=uint8, transfer-property=TRIGGERED-ON-CHANGE
          signal CAN2_Sched_Chg_St_Time_Min: start 61, 6 bit, big-endian, i-signal-type=PRIMITIVE, init-value=constant-reference=Init_CAN2_Sched_Chg_St_Time_Min, base-type=uint8, implementation-data-type=uint8, transfer-property=TRIGGERED-ON-CHANGE
          signal CAN2_Sched_OTA_wake: start 47, 1 bit, big-endian, i-signal-type=PRIMITIVE, init-value=constant-reference=Init_CAN2_Sched_OTA_wake, base-type=uint8, implementation-data-type=uint8, transfer-property=TRIGGERED-ON-CHANGE
          signal CAN2_SmartEco_Mode_SW: start 25, 1 bit, big-endian, i-signal-type=PRIMITIVE, init-value=constant-reference=Init_CAN2_SmartEco_Mode_SW, base-type=uint8, implementation-data-type=uint8, transfer-property=TRIGGERED-ON-CHANGE
          signal CAN2_Upd_Countdown_Cancel: start 38, 1 bit, big-endian, i-signal-type=PRIMITIVE, init-value=constant-reference=Init_CAN2_Upd_Countdown_Cancel, base-type=uint8, implementation-data-type=uint8, transfer-property=TRIGGERED-ON-CHANGE
          signal CAN2_Upd_Countdown_Skip: start 39, 1 bit, big-endian, i-signal-type=PRIMITIVE, init-value=constant-reference=Init_CAN2_Upd_Countdown_Skip, base-type=uint8, implementation-data-type=uint8, transfer-property=TRIGGERED-ON-CHANGE
          signal CAN2_UserSet: start 71, 3 bit, big-endian, i-signal-type=PRIMITIVE, init-value=constant-reference=Init_CAN2_UserSet, base-type=uint8, implementation-data-type=uint8, transfer-property=TRIGGERED-ON-CHANGE
          signal CAN2_VehACModReq: start 23, 3 bit, big-endian, i-signal-type=PRIMITIVE, init-value=constant-reference=Init_CAN2_VehACModReq, base-type=uint8, implementation-data-type=uint8, transfer-property=TRIGGERED-ON-CHANGE
          signal CAN2_mFRD_link_Sta: start 87, 1 bit, big-endian, i-signal-type=PRIMITIVE, init-value=constant-reference=Init_CAN2_mFRD_link_Sta, base-type=uint8, implementation-data-type=uint8, transfer-property=TRIGGERED-ON-CHANGE
      frame CAN2_IVI2: id 0x495, frame-length=64, can-addressing-mode=STANDARD, can-fd-frame-support=true, can-frame-rx-behavior=CAN-FD, can-frame-tx-behavior=CAN-FD
        pdu CAN2_IVI2: length=64, minimum-delay=0.0, transmission-mode-true-timing={cyclic-timing=time-period=0.2, event-controlled-timing={number-of-repetitions=0, repetition-period=0}}, unused-bit-pattern=0
          mapping CAN2_SG_IVI2: i-signal-group=CAN2_SG_IVI2, start-position=0, transfer-property=TRIGGERED-ON-CHANGE
          signal CAN2_AC_Chg_Cur_Set: start 462, 7 bit, big-endian, i-signal-type=PRIMITIVE, init-value=constant-reference=Init_CAN2_AC_Chg_Cur_Set, base-type=uint8, implementation-data-type=uint8, transfer-property=TRIGGERED-ON-CHANGE
          signal CAN2_AEB_BUTT: start 209, 2 bit, big-endian, i-signal-type=PRIMITIVE, init-value=constant-reference=Init_CAN2_AEB_BUTT, base-type=uint8, implementation-data-type=uint8, transfer-property=TRIGGERED-ON-CHANGE
          signal CAN2_AVM_Err_STA: start 399, 1 bit, big-endian, i-signal-type=PRIMITIVE, init-value=constant-reference=Init_CAN2_AVM_Err_STA, base-type=uint8, implementation-data-type=uint8, transfer-property=TRIGGERED-ON-CHANGE
          signal CAN2_AVM_OFF_Rec_Butt: start 508, 1 bit, big-endian, i-signal-type=PRIMITIVE, init-value=constant-reference=Init_CAN2_AVM_OFF_Rec_Butt, base-type=uint8, implementation-data-type=uint8, transfer-property=TRIGGERED-ON-CHANGE
          signal CAN2_AVM_Parking_mode: start 407, 4 bit, big-endian, i-signal-type=PRIMITIVE, init-value=constant-reference=Init_CAN2_AVM_Parking_mode, base-type=uint8, implementation-data-type=uint8, transfer-property=TRIGGERED-ON-CHANGE
          signal CAN2_AVM_parking_cancel: start 505, 2 bit, big-endian, i-signal-type=PRIMITIVE, init-value=constant-reference=Init_CAN2_AVM_parking_cancel, base-type=uint8, implementation-data-type=uint8, transfer-property=TRIGGERED-ON-CHANGE
          signal CAN2_AVM_parking_excute: start 507, 2 bit, big-endian, i-signal-type=PRIMITIVE, init-value=constant-reference=Init_CAN2_AVM_parking_excute, base-type=uint8, implementation-data-type=uint8, transfer-property=TRIGGERED-ON-CHANGE
          signal CAN2_Approach_Unlock_SW: start 9, 1 bit, big-endian, i-signal-type=PRIMITIVE, init-value=constant-reference=Init_CAN2_Approach_Unlock_SW, base-type=uint8, implementation-data-type=uint8, transfer-property=TRIGGERED-ON-CHANGE
          signal CAN2_BSDMute_BUTT: start 225, 2 bit, big-endian, i-signal-type=PRIMITIVE, init-value=constant-reference=Init_CAN2_BSDMute_BUTT, base-type=uint8, implementation-data-type=uint8, transfer-property=TRIGGERED-ON-CHANGE
          signal CAN2_CAAS_Sw: start 353, 2 bit, big-endian, i-signal-type=PRIMITIVE, init-value=constant-reference=Init_CAN2_CAAS_Sw, base-type=uint8, implementation-data-type=uint8, transfer-property=TRIGGERED-ON-CHANGE
          signal CAN2_CDL_Lock_Butt: start 469, 1 bit, big-endian, i-signal-type=PRIMITIVE, init-value=constant-reference=Init_CAN2_CDL_Lock_Butt, base-type=uint8, implementation-data-type=uint8, transfer-property=TRIGGERED-ON-CHANGE
          signal CAN2_CDL_Unlock_Butt: start 470, 1 bit, big-endian, i-signal-type=PRIMITIVE, init-value=constant-reference=Init_CAN2_CDL_Unlock_Butt, base-type=uint8, implementation-data-type=uint8, transfer-property=TRIGGERED-ON-CHANGE
          signal CAN2_CameraWrn: start 286, 1 bit, big-endian, i-signal-type=PRIMITIVE, init-value=constant-reference=Init_CAN2_CameraWrn, base-type=uint8, implementation-data-type=uint8, transfer-property=TRIGGERED-ON-CHANGE
          signal CAN2_DMS_Status: start 61, 2 bit, big-endian, i-signal-type=PRIMITIVE, init-value=constant-reference=Init_CAN2_DMS_Status, base-type=uint8, implementation-data-type=uint8, transfer-property=PENDING
          signal CAN2_DMS_Warning_Distraction: start 59, 2 bit, big-endian, i-signal-type=PRIMITIVE, init-value=constant-reference=Init_CAN2_DMS_Warning_Distraction, base-type=uint8, implementation-data-type=uint8, transfer-property=PENDING
          signal CAN2_DMS_Warning_Fatigue: start 57, 2 bit, big-endian, i-signal-type=PRIMITIVE, init-value=constant-reference=Init_CAN2_DMS_Warning_Fatigue, base-type=uint8, implementation-data-type=uint8, transfer-property=PENDING
          signal CAN2_DMS_Warning_Unresponsive: start 62, 1 bit, big-endian, i-signal-type=PRIMITIVE, init-value=constant-reference=Init_CAN2_DMS_Warning_Unresponsive, base-type=uint8, implementation-data-type=uint8, transfer-property=PENDING
          signal CAN2_DSEAT_anti_set: start 355, 1 bit, big-endian, i-signal-type=PRIMITIVE, init-value=constant-reference=Init_CAN2_DSEAT_anti_set, base-type=uint8, implementation-data-type=uint8, transfer-property=TRIGGERED-ON-CHANGE
          signal CAN2_DSEAT_entryfun_set: start 354, 1 bit, big-endian, i-signal-type=PRIMITIVE, init-value=constant-reference=Init_CAN2_DSEAT_entryfun_set, base-type=uint8, implementation-data-type=uint8, transfer-property=TRIGGERED-ON-CHANGE
          signal CAN2_DSEAT_vent_req: start 342, 3 bit, big-endian, i-signal-type=PRIMITIVE, init-value=constant-reference=Init_CAN2_DSEAT_vent_req, base-type=uint8, implementation-data-type=uint8, transfer-property=TRIGGERED-ON-CHANGE
          signal CAN2_Distance_unit: start 243, 1 bit, big-endian, i-signal-type=PRIMITIVE, init-value=constant-reference=Init_CAN2_Distance_unit, base-type=uint8, implementation-data-type=uint8, transfer-property=TRIGGERED-ON-CHANGE
          signal CAN2_ESC_SW_Cmd: start 245, 2 bit, big-endian, i-signal-type=PRIMITIVE, init-value=constant-reference=Init_CAN2_ESC_SW_Cmd, base-type=uint8, implementation-data-type=uint8, transfer-property=TRIGGERED-ON-CHANGE
          signal CAN2_FCWMute_BUTT: start 233, 2 bit, big-endian, i-signal-type=PRIMITIVE, init-value=constant-reference=Init_CAN2_FCWMute_BUTT, base-type=uint8, implementation-data-type=uint8, transfer-property=TRIGGERED-ON-CHANGE
          signal CAN2_FFogLampSW: start 339, 1 bit, big-endian, i-signal-type=PRIMITIVE, init-value=constant-reference=Init_CAN2_FFogLampSW, base-type=uint8, implementation-data-type=uint8, transfer-property=TRIGGERED-ON-CHANGE
          signal CAN2_FS_Off_Sw: start 351, 2 bit, big-endian, i-signal-type=PRIMITIVE, init-value=constant-reference=Init_CAN2_FS_Off_Sw, base-type=uint8, implementation-data-type=uint8, transfer-property=TRIGGERED-ON-CHANGE
          signal CAN2_FalseNPrevent_SW: start 10, 1 bit, big-endian, i-signal-type=PRIMITIVE, init-value=constant-reference=Init_CAN2_FalseNPrevent_SW, base-type=uint8, implementation-data-type=uint8, transfer-property=TRIGGERED-ON-CHANGE
          signal CAN2_FollowMeSW: start 358, 1 bit, big-endian, i-signal-type=PRIMITIVE, init-value=constant-reference=Init_CAN2_FollowMeSW, base-type=uint8, implementation-data-type=uint8, transfer-property=TRIGGERED-ON-CHANGE
          signal CAN2_GPS_LAT: start 167, 32 bit, big-endian, i-signal-type=PRIMITIVE, init-value=constant-reference=Init_CAN2_GPS_LAT, base-type=uint32, implementation-data-type=uint32, transfer-property=PENDING
          signal CAN2_GPS_LONG: start 135, 32 bit, big-endian, i-signal-type=PRIMITIVE, init-value=constant-reference=Init_CAN2_GPS_LONG, base-type=uint32, implementation-data-type=uint32, transfer-property=PENDING
          signal CAN2_HeadLampSW: start 321, 2 bit, big-endian, i-signal-type=PRIMITIVE, init-value=constant-reference=Init_CAN2_HeadLampSW, base-type=uint8, implementation-data-type=uint8, transfer-property=TRIGGERED-ON-CHANGE
          signal CAN2_Hood_Latch_SW: start 393, 2 bit, big-endian, i-signal-type=PRIMITIVE, init-value=constant-reference=Init_CAN2_Hood_Latch_SW, base-type=uint8, implementation-data-type=uint8, transfer-property=TRIGGERED-ON-CHANGE
          signal CAN2_IVI_ACC_Adaptive_Sta: start 454, 1 bit, big-endian, i-signal-type=PRIMITIVE, init-value=constant-reference=Init_CAN2_IVI_ACC_Adaptive_Sta, base-type=uint8, implementation-data-type=uint8, transfer-property=TRIGGERED-ON-CHANGE
          signal CAN2_IVI_ActvDmpDisabSW: start 503, 2 bit, big-endian, i-signal-type=PRIMITIVE, init-value=constant-reference=Init_CAN2_IVI_ActvDmpDisabSW, base-type=uint8, implementation-data-type=uint8, transfer-property=TRIGGERED-ON-CHANGE
          signal CAN2_IVI_AirIntZ3_Cmd: start 34, 3 bit, big-endian, i-signal-type=PRIMITIVE, init-value=constant-reference=Init_CAN2_IVI_AirIntZ3_Cmd, base-type=uint8, implementation-data-type=uint8, transfer-property=TRIGGERED-ON-CHANGE
          signal CAN2_IVI_CfmTo_Rdy: start 15, 1 bit, big-endian, i-signal-type=PRIMITIVE, init-value=constant-reference=Init_CAN2_IVI_CfmTo_Rdy, base-type=uint8, implementation-data-type=uint8, transfer-property=TRIGGERED-ON-CHANGE
          signal CAN2_IVI_ChargePortSW_Sta: start 479, 1 bit, big-endian, i-signal-type=PRIMITIVE, init-value=constant-reference=Init_CAN2_IVI_ChargePortSW_Sta, base-type=uint8, implementation-data-type=uint8, transfer-property=TRIGGERED-ON-CHANGE
          signal CAN2_IVI_CoastDwSW: start 501, 2 bit, big-endian, i-signal-type=PRIMITIVE, init-value=constant-reference=Init_CAN2_IVI_CoastDwSW, base-type=uint8, implementation-data-type=uint8, transfer-property=TRIGGERED-ON-CHANGE
          signal CAN2_IVI_CreepSW_Req: start 11, 1 bit, big-endian, i-signal-type=PRIMITIVE, init-value=constant-reference=Init_CAN2_IVI_CreepSW_Req, base-type=uint8, implementation-data-type=uint8, transfer-property=TRIGGERED-ON-CHANGE
          signal CAN2_IVI_DSEATHeater_Cmd: start 23, 3 bit, big-endian, i-signal-type=PRIMITIVE, init-value=constant-reference=Init_CAN2_IVI_DSEATHeater_Cmd, base-type=uint8, implementation-data-type=uint8, transfer-property=TRIGGERED-ON-CHANGE
          signal CAN2_IVI_DSEAT_FroEdge_Height_Cmd: start 51, 2 bit, big-endian, i-signal-type=PRIMITIVE, init-value=constant-reference=Init_CAN2_IVI_DSEAT_FroEdge_Height_Cmd, base-type=uint8, implementation-data-type=uint8, transfer-property=TRIGGERED-ON-CHANGE
          signal CAN2_IVI_DSEAT_Height_Cmd: start 53, 2 bit, big-endian, i-signal-type=PRIMITIVE, init-value=constant-reference=Init_CAN2_IVI_DSEAT_Height_Cmd, base-type=uint8, implementation-data-type=uint8, transfer-property=TRIGGERED-ON-CHANGE
          signal CAN2_IVI_DSEAT_Memory1_Sta: start 27, 1 bit, big-endian, i-signal-type=PRIMITIVE, init-value=constant-reference=Init_CAN2_IVI_DSEAT_Memory1_Sta, base-type=uint8, implementation-data-type=uint8, transfer-property=TRIGGERED-ON-CHANGE
          signal CAN2_IVI_DSEAT_Memory2_Sta: start 26, 1 bit, big-endian, i-signal-type=PRIMITIVE, init-value=constant-reference=Init_CAN2_IVI_DSEAT_Memory2_Sta, base-type=uint8, implementation-data-type=uint8, transfer-property=TRIGGERED-ON-CHANGE
          signal CAN2_IVI_DSEAT_Memory_OPTCLS_Sta: start 42, 1 bit, big-endian, i-signal-type=PRIMITIVE, init-value=constant-reference=Init_CAN2_IVI_DSEAT_Memory_OPTCLS_Sta, base-type=uint8, implementation-data-type=uint8, transfer-property=TRIGGERED-ON-CHANGE
          signal CAN2_IVI_DSEAT_Recline_Cmd: start 55, 2 bit, big-endian, i-signal-type=PRIMITIVE, init-value=constant-reference=Init_CAN2_IVI_DSEAT_Recline_Cmd, base-type=uint8, implementation-data-type=uint8, transfer-property=TRIGGERED-ON-CHANGE
          signal CAN2_IVI_DSEAT_Slide_Cmd: start 25, 2 bit, big-endian, i-signal-type=PRIMITIVE, init-value=constant-reference=Init_CAN2_IVI_DSEAT_Slide_Cmd, base-type=uint8, implementation-data-type=uint8, transfer-property=TRIGGERED-ON-CHANGE
          signal CAN2_IVI_ISA_OffsetSpd: start 451, 4 bit, big-endian, i-signal-type=PRIMITIVE, init-value=constant-reference=Init_CAN2_IVI_ISA_OffsetSpd, base-type=uint8, implementation-data-type=uint8, transfer-property=TRIGGERED-ON-CHANGE
          signal CAN2_IVI_LVChrgFuncSW: start 497, 2 bit, big-endian, i-signal-type=PRIMITIVE, init-value=constant-reference=Init_CAN2_IVI_LVChrgFuncSW, base-type=uint8, implementation-data-type=uint8, transfer-property=TRIGGERED-ON-CHANGE
          signal CAN2_IVI_Mute_Sta: start 360, 1 bit, big-endian, i-signal-type=PRIMITIVE, init-value=constant-reference=Init_CAN2_IVI_Mute_Sta, base-type=uint8, implementation-data-type=uint8, transfer-property=TRIGGERED-ON-CHANGE
          signal CAN2_IVI_Night_Mode_Sta: start 364, 1 bit, big-endian, i-signal-type=PRIMITIVE, init-value=constant-reference=Init_CAN2_IVI_Night_Mode_Sta, base-type=uint8, implementation-data-type=uint8, transfer-property=TRIGGERED-ON-CHANGE
          signal CAN2_IVI_PSEATHeater_Cmd: start 20, 3 bit, big-endian, i-signal-type=PRIMITIVE, init-value=constant-reference=Init_CAN2_IVI_PSEATHeater_Cmd, base-type=uint8, implementation-data-type=uint8, transfer-property=TRIGGERED-ON-CHANGE
          signal CAN2_IVI_PSEAT_Recline_Cmd: start 41, 2 bit, big-endian, i-signal-type=PRIMITIVE, init-value=constant-reference=Init_CAN2_IVI_PSEAT_Recline_Cmd, base-type=uint8, implementation-data-type=uint8, transfer-property=TRIGGERED-ON-CHANGE
          signal CAN2_IVI_PSEAT_Slide_Cmd: start 49, 2 bit, big-endian, i-signal-type=PRIMITIVE, init-value=constant-reference=Init_CAN2_IVI_PSEAT_Slide_Cmd, base-type=uint8, implementation-data-type=uint8, transfer-property=TRIGGERED-ON-CHANGE
          signal CAN2_IVI_PTG_Mode_SW: start 345, 2 bit, big-endian, i-signal-type=PRIMITIVE, init-value=constant-reference=Init_CAN2_IVI_PTG_Mode_SW, base-type=uint8, implementation-data-type=uint8, transfer-property=TRIGGERED-ON-CHANGE
          signal CAN2_IVI_PTG_Open_Height: start 14, 3 bit, big-endian, i-signal-type=PRIMITIVE, init-value=constant-reference=Init_CAN2_IVI_PTG_Open_Height, base-type=uint8, implementation-data-type=uint8, transfer-property=TRIGGERED-ON-CHANGE
          signal CAN2_IVI_PTG_Sta_SW: start 347, 2 bit, big-endian, i-signal-type=PRIMITIVE, init-value=constant-reference=Init_CAN2_IVI_PTG_Sta_SW, base-type=uint8, implementation-data-type=uint8, transfer-property=TRIGGERED-ON-CHANGE
          signal CAN2_IVI_PTG_USSta_SW: start 361, 1 bit, big-endian, i-signal-type=PRIMITIVE, init-value=constant-reference=Init_CAN2_IVI_PTG_USSta_SW, base-type=uint8, implementation-data-type=uint8, transfer-property=TRIGGERED-ON-CHANGE
          signal CAN2_IVI_PW_Mode_Req: start 284, 2 bit, big-endian, i-signal-type=PRIMITIVE, init-value=constant-reference=Init_CAN2_IVI_PW_Mode_Req, base-type=uint8, implementation-data-type=uint8, transfer-property=TRIGGERED-ON-CHANGE
          signal CAN2_IVI_Panel_Act: start 246, 1 bit, big-endian, i-signal-type=PRIMITIVE, init-value=constant-reference=Init_CAN2_IVI_Panel_Act, base-type=uint8, implementation-data-type=uint8, transfer-property=TRIGGERED-ON-CHANGE
          signal CAN2_IVI_Panel_X_Coor: start 303, 12 bit, big-endian, i-signal-type=PRIMITIVE, init-value=constant-reference=Init_CAN2_IVI_Panel_X_Coor, base-type=uint16, implementation-data-type=uint16, transfer-property=PENDING
          signal CAN2_IVI_Panel_Y_Coor: start 307, 12 bit, big-endian, i-signal-type=PRIMITIVE, init-value=constant-reference=Init_CAN2_IVI_Panel_Y_Coor, base-type=uint16, implementation-data-type=uint16, transfer-property=PENDING
          signal CAN2_IVI_PwrLockSW: start 499, 2 bit, big-endian, i-signal-type=PRIMITIVE, init-value=constant-reference=Init_CAN2_IVI_PwrLockSW, base-type=uint8, implementation-data-type=uint8, transfer-property=TRIGGERED-ON-CHANGE
          signal CAN2_IVI_Pwroff_req: start 397, 1 bit, big-endian, i-signal-type=PRIMITIVE, init-value=constant-reference=Init_CAN2_IVI_Pwroff_req, base-type=uint8, implementation-data-type=uint8, transfer-property=TRIGGERED-ON-CHANGE
          signal CAN2_IVI_RR_Def_Req: start 363, 1 bit, big-endian, i-signal-type=PRIMITIVE, init-value=constant-reference=Init_CAN2_IVI_RR_Def_Req, base-type=uint8, implementation-data-type=uint8, transfer-property=TRIGGERED-ON-CHANGE
          signal CAN2_IVI_Req_V2L: start 17, 2 bit, big-endian, i-signal-type=PRIMITIVE, init-value=constant-reference=Init_CAN2_IVI_Req_V2L, base-type=uint8, implementation-data-type=uint8, transfer-property=TRIGGERED-ON-CHANGE
          signal CAN2_IVI_SLIF_Warning_Sta: start 453, 2 bit, big-endian, i-signal-type=PRIMITIVE, init-value=constant-reference=Init_CAN2_IVI_SLIF_Warning_Sta, base-type=uint8, implementation-data-type=uint8, transfer-property=TRIGGERED-ON-CHANGE
          signal CAN2_IVI_SWC_ACCMode_Sta: start 463, 1 bit, big-endian, i-signal-type=PRIMITIVE, init-value=constant-reference=Init_CAN2_IVI_SWC_ACCMode_Sta, base-type=uint8, implementation-data-type=uint8, transfer-property=TRIGGERED-ON-CHANGE
          signal CAN2_IVI_SWC_LUndefined_Sta: start 75, 4 bit, big-endian, i-signal-type=PRIMITIVE, init-value=constant-reference=Init_CAN2_IVI_SWC_LUndefined_Sta, base-type=uint8, implementation-data-type=uint8, transfer-property=TRIGGERED-ON-CHANGE
          signal CAN2_IVI_SWC_RUndefined_Sta: start 79, 4 bit, big-endian, i-signal-type=PRIMITIVE, init-value=constant-reference=Init_CAN2_IVI_SWC_RUndefined_Sta, base-type=uint8, implementation-data-type=uint8, transfer-property=TRIGGERED-ON-CHANGE
          signal CAN2_IVI_Screen: start 269, 6 bit, big-endian, i-signal-type=PRIMITIVE, init-value=constant-reference=Init_CAN2_IVI_Screen, base-type=uint8, implementation-data-type=uint8, transfer-property=TRIGGERED-ON-CHANGE
          signal CAN2_IVI_SetTempZon1_Sta: start 39, 5 bit, big-endian, i-signal-type=PRIMITIVE, init-value=constant-reference=Init_CAN2_IVI_SetTempZon1_Sta, base-type=uint8, implementation-data-type=uint8, transfer-property=TRIGGERED-ON-CHANGE
          signal CAN2_IVI_SetTempZon2_Sta: start 47, 5 bit, big-endian, i-signal-type=PRIMITIVE, init-value=constant-reference=Init_CAN2_IVI_SetTempZon2_Sta, base-type=uint8, implementation-data-type=uint8, transfer-property=TRIGGERED-ON-CHANGE
          signal CAN2_IVI_Start_Chg_req: start 103, 1 bit, big-endian, i-signal-type=PRIMITIVE, init-value=constant-reference=Init_CAN2_IVI_Start_Chg_req, base-type=uint8, implementation-data-type=uint8, transfer-property=TRIGGERED-ON-CHANGE
          signal CAN2_IVI_Status: start 365, 1 bit, big-endian, i-signal-type=PRIMITIVE, init-value=constant-reference=Init_CAN2_IVI_Status, base-type=uint8, implementation-data-type=uint8, transfer-property=TRIGGERED-ON-CHANGE
          signal CAN2_IVI_Stop_Chg_req: start 111, 1 bit, big-endian, i-signal-type=PRIMITIVE, init-value=constant-reference=Init_CAN2_IVI_Stop_Chg_req, base-type=uint8, implementation-data-type=uint8, transfer-property=TRIGGERED-ON-CHANGE
          signal CAN2_IVI_TrailerCheckReq_Sta: start 356, 1 bit, big-endian, i-signal-type=PRIMITIVE, init-value=constant-reference=Init_CAN2_IVI_TrailerCheckReq_Sta, base-type=uint8, implementation-data-type=uint8, transfer-property=TRIGGERED-ON-CHANGE
          signal CAN2_IVI_TrailerModeSW_Sta: start 394, 1 bit, big-endian, i-signal-type=PRIMITIVE, init-value=constant-reference=Init_CAN2_IVI_TrailerModeSW_Sta, base-type=uint8, implementation-data-type=uint8, transfer-property=TRIGGERED-ON-CHANGE
          signal CAN2_IVI_Trigger_req: start 398, 1 bit, big-endian, i-signal-type=PRIMITIVE, init-value=constant-reference=Init_CAN2_IVI_Trigger_req, base-type=uint8, implementation-data-type=uint8, transfer-property=TRIGGERED-ON-CHANGE
          signal CAN2_IVI_Unlock_Chg_req: start 119, 1 bit, big-endian, i-signal-type=PRIMITIVE, init-value=constant-reference=Init_CAN2_IVI_Unlock_Chg_req, base-type=uint8, implementation-data-type=uint8, transfer-property=TRIGGERED-ON-CHANGE
          signal CAN2_IVI_WI_MAIN_SW: start 362, 1 bit, big-endian, i-signal-type=PRIMITIVE, init-value=constant-reference=Init_CAN2_IVI_WI_MAIN_SW, base-type=uint8, implementation-data-type=uint8, transfer-property=TRIGGERED-ON-CHANGE
          signal CAN2_LDWMute_BUTT: start 239, 2 bit, big-endian, i-signal-type=PRIMITIVE, init-value=constant-reference=Init_CAN2_LDWMute_BUTT, base-type=uint8, implementation-data-type=uint8, transfer-property=TRIGGERED-ON-CHANGE
          signal CAN2_LKA_BUTT: start 235, 2 bit, big-endian, i-signal-type=PRIMITIVE, init-value=constant-reference=Init_CAN2_LKA_BUTT, base-type=uint8, implementation-data-type=uint8, transfer-property=TRIGGERED-ON-CHANGE
          signal CAN2_LVDAMute_BUTT: start 367, 2 bit, big-endian, i-signal-type=PRIMITIVE, init-value=constant-reference=Init_CAN2_LVDAMute_BUTT, base-type=uint8, implementation-data-type=uint8, transfer-property=TRIGGERED-ON-CHANGE
          signal CAN2_L_Drv_ControlCommand: start 126, 7 bit, big-endian, i-signal-type=PRIMITIVE, init-value=constant-reference=Init_CAN2_L_Drv_ControlCommand, base-type=uint8, implementation-data-type=uint8, transfer-property=PENDING
          signal CAN2_L_Pas_ControlCommand: start 118, 7 bit, big-endian, i-signal-type=PRIMITIVE, init-value=constant-reference=Init_CAN2_L_Pas_ControlCommand, base-type=uint8, implementation-data-type=uint8, transfer-property=PENDING
          signal CAN2_L_RLD_ControlCommand: start 110, 7 bit, big-endian, i-signal-type=PRIMITIVE, init-value=constant-reference=Init_CAN2_L_RLD_ControlCommand, base-type=uint8, implementation-data-type=uint8, transfer-property=PENDING
          signal CAN2_L_RRD_ControlCommand: start 102, 7 bit, big-endian, i-signal-type=PRIMITIVE, init-value=constant-reference=Init_CAN2_L_RRD_ControlCommand, base-type=uint8, implementation-data-type=uint8, transfer-property=PENDING
          signal CAN2_Light_ShowStart_Req: start 29, 1 bit, big-endian, i-signal-type=PRIMITIVE, init-value=constant-reference=Init_CAN2_Light_ShowStart_Req, base-type=uint8, implementation-data-type=uint8, transfer-property=TRIGGERED-ON-CHANGE
          signal CAN2_Light_ShowStop_Req: start 28, 1 bit, big-endian, i-signal-type=PRIMITIVE, init-value=constant-reference=Init_CAN2_Light_ShowStop_Req, base-type=uint8, implementation-data-type=uint8, transfer-property=TRIGGERED-ON-CHANGE
          signal CAN2_METER_Malfunc_Sta: start 89, 2 bit, big-endian, i-signal-type=PRIMITIVE, init-value=constant-reference=Init_CAN2_METER_Malfunc_Sta, base-type=uint8, implementation-data-type=uint8, transfer-property=TRIGGERED-ON-CHANGE
          signal CAN2_MFRD_N_Bright_Req: start 334, 7 bit, big-endian, i-signal-type=PRIMITIVE, init-value=constant-reference=Init_CAN2_MFRD_N_Bright_Req, base-type=uint8, implementation-data-type=uint8, transfer-property=TRIGGERED-ON-CHANGE
          signal CAN2_NAVI_Cam_Dist_info: start 295, 8 bit, big-endian, i-signal-type=PRIMITIVE, init-value=constant-reference=Init_CAN2_NAVI_Cam_Dist_info, base-type=uint8, implementation-data-type=uint8, transfer-property=PENDING
          signal CAN2_NAVI_Direction_STA: start 279, 8 bit, big-endian, i-signal-type=PRIMITIVE, init-value=constant-reference=Init_CAN2_NAVI_Direction_STA, base-type=uint8, implementation-data-type=uint8, transfer-property=PENDING
          signal CAN2_NAVI_Distance_info: start 375, 24 bit, big-endian, i-signal-type=PRIMITIVE, init-value=constant-reference=Init_CAN2_NAVI_Distance_info, base-type=uint32, implementation-data-type=uint32, transfer-property=PENDING
          signal CAN2_NAVI_ForwardLinkLevel: start 415, 4 bit, big-endian, i-signal-type=PRIMITIVE, init-value=constant-reference=Init_CAN2_NAVI_ForwardLinkLevel, base-type=uint8, implementation-data-type=uint8, transfer-property=TRIGGERED-ON-CHANGE
          signal CAN2_NAVI_LinkClass: start 431, 4 bit, big-endian, i-signal-type=PRIMITIVE, init-value=constant-reference=Init_CAN2_NAVI_LinkClass, base-type=uint8, implementation-data-type=uint8, transfer-property=TRIGGERED-ON-CHANGE
          signal CAN2_NAVI_RoadClass: start 447, 3 bit, big-endian, i-signal-type=PRIMITIVE, init-value=constant-reference=Init_CAN2_NAVI_RoadClass, base-type=uint8, implementation-data-type=uint8, transfer-property=TRIGGERED-ON-CHANGE
          signal CAN2_NAVI_SpeedLimit: start 444, 5 bit, big-endian, i-signal-type=PRIMITIVE, init-value=constant-reference=Init_CAN2_NAVI_SpeedLimit, base-type=uint8, implementation-data-type=uint8, transfer-property=PENDING
          signal CAN2_NAVI_Speed_Limit_A: start 241, 2 bit, big-endian, i-signal-type=PRIMITIVE, init-value=constant-reference=Init_CAN2_NAVI_Speed_Limit_A, base-type=uint8, implementation-data-type=uint8, transfer-property=TRIGGERED-ON-CHANGE
          signal CAN2_NAVI_State: start 323, 2 bit, big-endian, i-signal-type=PRIMITIVE, init-value=constant-reference=Init_CAN2_NAVI_State, base-type=uint8, implementation-data-type=uint8, transfer-property=TRIGGERED-ON-CHANGE
          signal CAN2_NAVI_Tollgate: start 427, 12 bit, big-endian, i-signal-type=PRIMITIVE, init-value=constant-reference=Init_CAN2_NAVI_Tollgate, base-type=uint16, implementation-data-type=uint16, transfer-property=PENDING
          signal CAN2_NAVI_Tunnel: start 411, 12 bit, big-endian, i-signal-type=PRIMITIVE, init-value=constant-reference=Init_CAN2_NAVI_Tunnel, base-type=uint16, implementation-data-type=uint16, transfer-property=PENDING
          signal CAN2_ODAMute_BUTT: start 237, 2 bit, big-endian, i-signal-type=PRIMITIVE, init-value=constant-reference=Init_CAN2_ODAMute_BUTT, base-type=uint8, implementation-data-type=uint8, transfer-property=TRIGGERED-ON-CHANGE
          signal CAN2_OFF_AC_MODE: start 282, 3 bit, big-endian, i-signal-type=PRIMITIVE, init-value=constant-reference=Init_CAN2_OFF_AC_MODE, base-type=uint8, implementation-data-type=uint8, transfer-property=TRIGGERED-ON-CHANGE
          signal CAN2_PSEAT_vent_req: start 338, 3 bit, big-endian, i-signal-type=PRIMITIVE, init-value=constant-reference=Init_CAN2_PSEAT_vent_req, base-type=uint8, implementation-data-type=uint8, transfer-property=TRIGGERED-ON-CHANGE
          signal CAN2_Perd_V2L: start 3, 4 bit, big-endian, i-signal-type=PRIMITIVE, init-value=constant-reference=Init_CAN2_Perd_V2L, base-type=uint8, implementation-data-type=uint8, transfer-property=TRIGGERED-ON-CHANGE
          signal CAN2_Pressure_unit: start 263, 8 bit, big-endian, i-signal-type=PRIMITIVE, init-value=constant-reference=Init_CAN2_Pressure_unit, base-type=uint8, implementation-data-type=uint8, transfer-property=PENDING
          signal CAN2_RCTA_BUTT: start 396, 2 bit, big-endian, i-signal-type=PRIMITIVE, init-value=constant-reference=Init_CAN2_RCTA_BUTT, base-type=uint8, implementation-data-type=uint8, transfer-property=TRIGGERED-ON-CHANGE
          signal CAN2_RFogLampSW: start 343, 1 bit, big-endian, i-signal-type=PRIMITIVE, init-value=constant-reference=Init_CAN2_RFogLampSW, base-type=uint8, implementation-data-type=uint8, transfer-property=TRIGGERED-ON-CHANGE
          signal CAN2_Roll_Eng_Mode: start 478, 1 bit, big-endian, i-signal-type=PRIMITIVE, init-value=constant-reference=Init_CAN2_Roll_Eng_Mode, base-type=uint8, implementation-data-type=uint8, transfer-property=TRIGGERED-ON-CHANGE
          signal CAN2_Roll_Mode_SW_Cmd: start 473, 2 bit, big-endian, i-signal-type=PRIMITIVE, init-value=constant-reference=Init_CAN2_Roll_Mode_SW_Cmd, base-type=uint8, implementation-data-type=uint8, transfer-property=TRIGGERED-ON-CHANGE
          signal CAN2_RoomLampMode: start 455, 1 bit, big-endian, i-signal-type=PRIMITIVE, init-value=constant-reference=Init_CAN2_RoomLampMode, base-type=uint8, implementation-data-type=uint8, transfer-property=TRIGGERED-ON-CHANGE
          signal CAN2_SLG_Sw: start 349, 2 bit, big-endian, i-signal-type=PRIMITIVE, init-value=constant-reference=Init_CAN2_SLG_Sw, base-type=uint8, implementation-data-type=uint8, transfer-property=TRIGGERED-ON-CHANGE
          signal CAN2_SLIF_BUTT: start 477, 2 bit, big-endian, i-signal-type=PRIMITIVE, init-value=constant-reference=Init_CAN2_SLIF_BUTT, base-type=uint8, implementation-data-type=uint8, transfer-property=TRIGGERED-ON-CHANGE
          signal CAN2_SOC_ADJ_BUTT: start 471, 1 bit, big-endian, i-signal-type=PRIMITIVE, init-value=constant-reference=Init_CAN2_SOC_ADJ_BUTT, base-type=uint8, implementation-data-type=uint8, transfer-property=TRIGGERED-ON-CHANGE
          signal CAN2_SOC_Limit_Set: start 468, 5 bit, big-endian, i-signal-type=PRIMITIVE, init-value=constant-reference=Init_CAN2_SOC_Limit_Set, base-type=uint8, implementation-data-type=uint8, transfer-property=PENDING
          signal CAN2_SOC_V2LLimit: start 7, 4 bit, big-endian, i-signal-type=PRIMITIVE, init-value=constant-reference=Init_CAN2_SOC_V2LLimit, base-type=uint8, implementation-data-type=uint8, transfer-property=PENDING
          signal CAN2_Sched_Chg_Start: start 92, 1 bit, big-endian, i-signal-type=PRIMITIVE, init-value=constant-reference=Init_CAN2_Sched_Chg_Start, base-type=uint8, implementation-data-type=uint8, transfer-property=TRIGGERED-ON-CHANGE
          signal CAN2_Sched_Chg_Stop: start 95, 1 bit, big-endian, i-signal-type=PRIMITIVE, init-value=constant-reference=Init_CAN2_Sched_Chg_Stop, base-type=uint8, implementation-data-type=uint8, transfer-property=TRIGGERED-ON-CHANGE
          signal CAN2_Sched_Chg_butt: start 94, 1 bit, big-endian, i-signal-type=PRIMITIVE, init-value=constant-reference=Init_CAN2_Sched_Chg_butt, base-type=uint8, implementation-data-type=uint8, transfer-property=TRIGGERED-ON-CHANGE
          signal CAN2_Sched_Chg_limit: start 84, 5 bit, big-endian, i-signal-type=PRIMITIVE, init-value=constant-reference=Init_CAN2_Sched_Chg_limit, base-type=uint8, implementation-data-type=uint8, transfer-property=PENDING
          signal CAN2_Sched_Chg_wake: start 93, 1 bit, big-endian, i-signal-type=PRIMITIVE, init-value=constant-reference=Init_CAN2_Sched_Chg_wake, base-type=uint8, implementation-data-type=uint8, transfer-property=TRIGGERED-ON-CHANGE
          signal CAN2_SenstivityPosition: start 403, 4 bit, big-endian, i-signal-type=PRIMITIVE, init-value=constant-reference=Init_CAN2_SenstivityPosition, base-type=uint8, implementation-data-type=uint8, transfer-property=TRIGGERED-ON-CHANGE
          signal CAN2_SetUnlockSingle: start 359, 1 bit, big-endian, i-signal-type=PRIMITIVE, init-value=constant-reference=Init_CAN2_SetUnlockSingle, base-type=uint8, implementation-data-type=uint8, transfer-property=TRIGGERED-ON-CHANGE
          signal CAN2_TCS_SW_Cmd: start 475, 2 bit, big-endian, i-signal-type=PRIMITIVE, init-value=constant-reference=Init_CAN2_TCS_SW_Cmd, base-type=uint8, implementation-data-type=uint8, transfer-property=TRIGGERED-ON-CHANGE
          signal CAN2_TPMS_Cali_Butt: start 127, 1 bit, big-endian, i-signal-type=PRIMITIVE, init-value=constant-reference=Init_CAN2_TPMS_Cali_Butt, base-type=uint8, implementation-data-type=uint8, transfer-property=TRIGGERED-ON-CHANGE
          signal CAN2_TPMS_Res_Butt: start 357, 1 bit, big-endian, i-signal-type=PRIMITIVE, init-value=constant-reference=Init_CAN2_TPMS_Res_Butt, base-type=uint8, implementation-data-type=uint8, transfer-property=TRIGGERED-ON-CHANGE
          signal CAN2_Temperature_unit: start 242, 1 bit, big-endian, i-signal-type=PRIMITIVE, init-value=constant-reference=Init_CAN2_Temperature_unit, base-type=uint8, implementation-data-type=uint8, transfer-property=TRIGGERED-ON-CHANGE
          signal CAN2_Time_system: start 255, 8 bit, big-endian, i-signal-type=PRIMITIVE, init-value=constant-reference=Init_CAN2_Time_system, base-type=uint8, implementation-data-type=uint8, transfer-property=TRIGGERED-ON-CHANGE
          signal CAN2_TurnSwTimeSet: start 271, 2 bit, big-endian, i-signal-type=PRIMITIVE, init-value=constant-reference=Init_CAN2_TurnSwTimeSet, base-type=uint8, implementation-data-type=uint8, transfer-property=TRIGGERED-ON-CHANGE
          signal CAN2_User_p_download: start 335, 1 bit, big-endian, i-signal-type=PRIMITIVE, init-value=constant-reference=Init_CAN2_User_p_download, base-type=uint8, implementation-data-type=uint8, transfer-property=TRIGGERED-ON-CHANGE
          signal CAN2_User_p_upload: start 285, 1 bit, big-endian, i-signal-type=PRIMITIVE, init-value=constant-reference=Init_CAN2_User_p_upload, base-type=uint8, implementation-data-type=uint8, transfer-property=TRIGGERED-ON-CHANGE
          signal CAN2_Walkaway_Lock_SW: start 8, 1 bit, big-endian, i-signal-type=PRIMITIVE, init-value=constant-reference=Init_CAN2_Walkaway_Lock_SW, base-type=uint8, implementation-data-type=uint8, transfer-property=TRIGGERED-ON-CHANGE
          signal CAN2_Wifi_Reset: start 287, 1 bit, big-endian, i-signal-type=PRIMITIVE, init-value=constant-reference=Init_CAN2_Wifi_Reset, base-type=uint8, implementation-data-type=uint8, transfer-property=TRIGGERED-ON-CHANGE
          signal CAN2_Wifi_Sta_IVI_TBOX: start 327, 4 bit, big-endian, i-signal-type=PRIMITIVE, init-value=constant-reference=Init_CAN2_Wifi_Sta_IVI_TBOX, base-type=uint8, implementation-data-type=uint8, transfer-property=TRIGGERED-ON-CHANGE
          signal CAN2_WlcmLight_Mode: start 31, 2 bit, big-endian, i-signal-type=PRIMITIVE, init-value=constant-reference=Init_CAN2_WlcmLight_Mode, base-type=uint8, implementation-data-type=uint8, transfer-property=TRIGGERED-ON-CHANGE
          signal CAN2_sigAirIntenZon1Req: start 223, 4 bit, big-endian, i-signal-type=PRIMITIVE, init-value=constant-reference=Init_CAN2_sigAirIntenZon1Req, base-type=uint8, implementation-data-type=uint8, transfer-property=TRIGGERED-ON-CHANGE
          signal CAN2_sigAirIntenZon3Req: start 219, 4 bit, big-endian, i-signal-type=PRIMITIVE, init-value=constant-reference=Init_CAN2_sigAirIntenZon3Req, base-type=uint8, implementation-data-type=uint8, transfer-property=TRIGGERED-ON-CHANGE
          signal CAN2_sigDfrstReq: start 199, 1 bit, big-endian, i-signal-type=PRIMITIVE, init-value=constant-reference=Init_CAN2_sigDfrstReq, base-type=uint8, implementation-data-type=uint8, transfer-property=TRIGGERED-ON-CHANGE
          signal CAN2_sigFaceReq: start 91, 1 bit, big-endian, i-signal-type=PRIMITIVE, init-value=constant-reference=Init_CAN2_sigFaceReq, base-type=uint8, implementation-data-type=uint8, transfer-property=TRIGGERED-ON-CHANGE
          signal CAN2_sigFootReq: start 90, 1 bit, big-endian, i-signal-type=PRIMITIVE, init-value=constant-reference=Init_CAN2_sigFootReq, base-type=uint8, implementation-data-type=uint8, transfer-property=TRIGGERED-ON-CHANGE
          signal CAN2_sigHvacFrontReq: start 198, 1 bit, big-endian, i-signal-type=PRIMITIVE, init-value=constant-reference=Init_CAN2_sigHvacFrontReq, base-type=uint8, implementation-data-type=uint8, transfer-property=TRIGGERED-ON-CHANGE
          signal CAN2_sigHvacRearReq: start 247, 1 bit, big-endian, i-signal-type=PRIMITIVE, init-value=constant-reference=Init_CAN2_sigHvacRearReq, base-type=uint8, implementation-data-type=uint8, transfer-property=TRIGGERED-ON-CHANGE
          signal CAN2_sigHvacReq: start 207, 1 bit, big-endian, i-signal-type=PRIMITIVE, init-value=constant-reference=Init_CAN2_sigHvacReq, base-type=uint8, implementation-data-type=uint8, transfer-property=TRIGGERED-ON-CHANGE
          signal CAN2_sigRecircReq: start 206, 1 bit, big-endian, i-signal-type=PRIMITIVE, init-value=constant-reference=Init_CAN2_sigRecircReq, base-type=uint8, implementation-data-type=uint8, transfer-property=TRIGGERED-ON-CHANGE
          signal CAN2_sigSetTempZon1Req: start 197, 6 bit, big-endian, i-signal-type=PRIMITIVE, init-value=constant-reference=Init_CAN2_sigSetTempZon1Req, base-type=uint8, implementation-data-type=uint8, transfer-property=TRIGGERED-ON-CHANGE
          signal CAN2_sigSetTempZon2Req: start 205, 6 bit, big-endian, i-signal-type=PRIMITIVE, init-value=constant-reference=Init_CAN2_sigSetTempZon2Req, base-type=uint8, implementation-data-type=uint8, transfer-property=TRIGGERED-ON-CHANGE
          signal CAN2_sigSetTempZon3Req: start 215, 6 bit, big-endian, i-signal-type=PRIMITIVE, init-value=constant-reference=Init_CAN2_sigSetTempZon3Req, base-type=uint8, implementation-data-type=uint8, transfer-property=TRIGGERED-ON-CHANGE
          signal CAN2_sigWindDirZon3Req: start 228, 3 bit, big-endian, i-signal-type=PRIMITIVE, init-value=constant-reference=Init_CAN2_sigWindDirZon3Req, base-type=uint8, implementation-data-type=uint8, transfer-property=TRIGGERED-ON-CHANGE
      frame CAN2_IVI3: id 0x497, frame-length=32, can-addressing-mode=STANDARD, can-fd-frame-support=true, can-frame-rx-behavior=CAN-FD, can-frame-tx-behavior=CAN-FD
        pdu CAN2_IVI3: length=32, minimum-delay=0.0, transmission-mode-true-timing={cyclic-timing=time-period=0.5, event-controlled-timing={number-of-repetitions=0, repetition-period=0}}, unused-bit-pattern=0
          mapping CAN2_SG_IVI3: i-signal-group=CAN2_SG_IVI3, start-position=0, transfer-property=TRIGGERED-ON-CHANGE
          signal CAN2_IVI_CLBlower_Y_Sta: start 38, 7 bit, big-endian, i-signal-type=PRIMITIVE, init-value=constant-reference=Init_CAN2_IVI_CLBlower_Y_Sta, base-type=uint8, implementation-data-type=uint8, transfer-property=PENDING
          signal CAN2_IVI_CLBlower_Z_Sta: start 46, 7 bit, big-endian, i-signal-type=PRIMITIVE, init-value=constant-reference=Init_CAN2_IVI_CLBlower_Z_Sta, base-type=uint8, implementation-data-type=uint8, transfer-property=PENDING
          signal CAN2_IVI_CRBlower_Y_Sta: start 54, 7 bit, big-endian, i-signal-type=PRIMITIVE, init-value=constant-reference=Init_CAN2_IVI_CRBlower_Y_Sta, base-type=uint8, implementation-data-type=uint8, transfer-property=PENDING
          signal CAN2_IVI_CRBlower_Z_Sta: start 62, 7 bit, big-endian, i-signal-type=PRIMITIVE, init-value=constant-reference=Init_CAN2_IVI_CRBlower_Z_Sta, base-type=uint8, implementation-data-type=uint8, transfer-property=PENDING
          signal CAN2_IVI_DrBlower_Mode_Sta: start 71, 2 bit, big-endian, i-signal-type=PRIMITIVE, init-value=constant-reference=Init_CAN2_IVI_DrBlower_Mode_Sta, base-type=uint8, implementation-data-type=uint8, transfer-property=TRIGGERED-ON-CHANGE
          signal CAN2_IVI_DrBlower_Y_Sta: start 6, 7 bit, big-endian, i-signal-type=PRIMITIVE, init-value=constant-reference=Init_CAN2_IVI_DrBlower_Y_Sta, base-type=uint8, implementation-data-type=uint8, transfer-property=PENDING
          signal CAN2_IVI_DrBlower_Z_Sta: start 14, 7 bit, big-endian, i-signal-type=PRIMITIVE, init-value=constant-reference=Init_CAN2_IVI_DrBlower_Z_Sta, base-type=uint8, implementation-data-type=uint8, transfer-property=PENDING
          signal CAN2_IVI_LSEATvent_Cmd: start 101, 3 bit, big-endian, i-signal-type=PRIMITIVE, init-value=constant-reference=Init_CAN2_IVI_LSEATvent_Cmd, base-type=uint8, implementation-data-type=uint8, transfer-property=TRIGGERED-ON-CHANGE
          signal CAN2_IVI_MLFMost_Cmd: start 31, 1 bit, big-endian, i-signal-type=PRIMITIVE, init-value=constant-reference=Init_CAN2_IVI_MLFMost_Cmd, base-type=uint8, implementation-data-type=uint8, transfer-property=TRIGGERED-ON-CHANGE
          signal CAN2_IVI_MLFootLift_Cmd: start 75, 2 bit, big-endian, i-signal-type=PRIMITIVE, init-value=constant-reference=Init_CAN2_IVI_MLFootLift_Cmd, base-type=uint8, implementation-data-type=uint8, transfer-property=TRIGGERED-ON-CHANGE
          signal CAN2_IVI_MLNapMode_Cmd: start 23, 1 bit, big-endian, i-signal-type=PRIMITIVE, init-value=constant-reference=Init_CAN2_IVI_MLNapMode_Cmd, base-type=uint8, implementation-data-type=uint8, transfer-property=TRIGGERED-ON-CHANGE
          signal CAN2_IVI_MLRecliner_Cmd: start 79, 2 bit, big-endian, i-signal-type=PRIMITIVE, init-value=constant-reference=Init_CAN2_IVI_MLRecliner_Cmd, base-type=uint8, implementation-data-type=uint8, transfer-property=TRIGGERED-ON-CHANGE
          signal CAN2_IVI_MLRestore_Cmd: start 15, 1 bit, big-endian, i-signal-type=PRIMITIVE, init-value=constant-reference=Init_CAN2_IVI_MLRestore_Cmd, base-type=uint8, implementation-data-type=uint8, transfer-property=TRIGGERED-ON-CHANGE
          signal CAN2_IVI_MLSEATvent_Cmd: start 93, 3 bit, big-endian, i-signal-type=PRIMITIVE, init-value=constant-reference=Init_CAN2_IVI_MLSEATvent_Cmd, base-type=uint8, implementation-data-type=uint8, transfer-property=TRIGGERED-ON-CHANGE
          signal CAN2_IVI_MLSeatLift_Cmd: start 73, 2 bit, big-endian, i-signal-type=PRIMITIVE, init-value=constant-reference=Init_CAN2_IVI_MLSeatLift_Cmd, base-type=uint8, implementation-data-type=uint8, transfer-property=TRIGGERED-ON-CHANGE
          signal CAN2_IVI_MLSldRestore_Cmd: start 7, 1 bit, big-endian, i-signal-type=PRIMITIVE, init-value=constant-reference=Init_CAN2_IVI_MLSldRestore_Cmd, base-type=uint8, implementation-data-type=uint8, transfer-property=TRIGGERED-ON-CHANGE
          signal CAN2_IVI_MLSlider_Cmd: start 77, 2 bit, big-endian, i-signal-type=PRIMITIVE, init-value=constant-reference=Init_CAN2_IVI_MLSlider_Cmd, base-type=uint8, implementation-data-type=uint8, transfer-property=TRIGGERED-ON-CHANGE
          signal CAN2_IVI_MLZeroGravity_Cmd: start 39, 1 bit, big-endian, i-signal-type=PRIMITIVE, init-value=constant-reference=Init_CAN2_IVI_MLZeroGravity_Cmd, base-type=uint8, implementation-data-type=uint8, transfer-property=TRIGGERED-ON-CHANGE
          signal CAN2_IVI_MRFMost_Cmd: start 94, 1 bit, big-endian, i-signal-type=PRIMITIVE, init-value=constant-reference=Init_CAN2_IVI_MRFMost_Cmd, base-type=uint8, implementation-data-type=uint8, transfer-property=TRIGGERED-ON-CHANGE
          signal CAN2_IVI_MRFootLift_Cmd: start 83, 2 bit, big-endian, i-signal-type=PRIMITIVE, init-value=constant-reference=Init_CAN2_IVI_MRFootLift_Cmd, base-type=uint8, implementation-data-type=uint8, transfer-property=TRIGGERED-ON-CHANGE
          signal CAN2_IVI_MRNapMode_Cmd: start 63, 1 bit, big-endian, i-signal-type=PRIMITIVE, init-value=constant-reference=Init_CAN2_IVI_MRNapMode_Cmd, base-type=uint8, implementation-data-type=uint8, transfer-property=TRIGGERED-ON-CHANGE
          signal CAN2_IVI_MRRecliner_Cmd: start 87, 2 bit, big-endian, i-signal-type=PRIMITIVE, init-value=constant-reference=Init_CAN2_IVI_MRRecliner_Cmd, base-type=uint8, implementation-data-type=uint8, transfer-property=TRIGGERED-ON-CHANGE
          signal CAN2_IVI_MRRestore_Cmd: start 55, 1 bit, big-endian, i-signal-type=PRIMITIVE, init-value=constant-reference=Init_CAN2_IVI_MRRestore_Cmd, base-type=uint8, implementation-data-type=uint8, transfer-property=TRIGGERED-ON-CHANGE
          signal CAN2_IVI_MRSEATvent_Cmd: start 90, 3 bit, big-endian, i-signal-type=PRIMITIVE, init-value=constant-reference=Init_CAN2_IVI_MRSEATvent_Cmd, base-type=uint8, implementation-data-type=uint8, transfer-property=TRIGGERED-ON-CHANGE
          signal CAN2_IVI_MRSeatLift_Cmd: start 81, 2 bit, big-endian, i-signal-type=PRIMITIVE, init-value=constant-reference=Init_CAN2_IVI_MRSeatLift_Cmd, base-type=uint8, implementation-data-type=uint8, transfer-property=TRIGGERED-ON-CHANGE
          signal CAN2_IVI_MRSldRestore_Cmd: start 47, 1 bit, big-endian, i-signal-type=PRIMITIVE, init-value=constant-reference=Init_CAN2_IVI_MRSldRestore_Cmd, base-type=uint8, implementation-data-type=uint8, transfer-property=TRIGGERED-ON-CHANGE
          signal CAN2_IVI_MRSlider_Cmd: start 85, 2 bit, big-endian, i-signal-type=PRIMITIVE, init-value=constant-reference=Init_CAN2_IVI_MRSlider_Cmd, base-type=uint8, implementation-data-type=uint8, transfer-property=TRIGGERED-ON-CHANGE
          signal CAN2_IVI_MRZeroGravity_Cmd: start 95, 1 bit, big-endian, i-signal-type=PRIMITIVE, init-value=constant-reference=Init_CAN2_IVI_MRZeroGravity_Cmd, base-type=uint8, implementation-data-type=uint8, transfer-property=TRIGGERED-ON-CHANGE
          signal CAN2_IVI_PsBlower_Mode_Sta: start 69, 2 bit, big-endian, i-signal-type=PRIMITIVE, init-value=constant-reference=Init_CAN2_IVI_PsBlower_Mode_Sta, base-type=uint8, implementation-data-type=uint8, transfer-property=TRIGGERED-ON-CHANGE
          signal CAN2_IVI_PsBlower_Y_Sta: start 22, 7 bit, big-endian, i-signal-type=PRIMITIVE, init-value=constant-reference=Init_CAN2_IVI_PsBlower_Y_Sta, base-type=uint8, implementation-data-type=uint8, transfer-property=PENDING
          signal CAN2_IVI_PsBlower_Z_Sta: start 30, 7 bit, big-endian, i-signal-type=PRIMITIVE, init-value=constant-reference=Init_CAN2_IVI_PsBlower_Z_Sta, base-type=uint8, implementation-data-type=uint8, transfer-property=PENDING
          signal CAN2_IVI_RSEATvent_Cmd: start 98, 3 bit, big-endian, i-signal-type=PRIMITIVE, init-value=constant-reference=Init_CAN2_IVI_RSEATvent_Cmd, base-type=uint8, implementation-data-type=uint8, transfer-property=TRIGGERED-ON-CHANGE
      frame CAN2_IVI_P20_0: id 0x201, frame-length=64, can-addressing-mode=STANDARD, can-fd-frame-support=true, can-frame-rx-behavior=CAN-FD, can-frame-tx-behavior=CAN-FD
        pdu CAN2_IVI_P20_0: length=64, minimum-delay=0.0, transmission-mode-true-timing=cyclic-timing=time-period=0.02, unused-bit-pattern=0
          mapping CAN2_SG_IVI_P20_0: i-signal-group=CAN2_SG_IVI_P20_0, start-position=0, transfer-property=PENDING
          signal CAN2_IVI_AmbiLgtSta: start 7, 1 bit, big-endian, i-signal-type=PRIMITIVE, init-value=constant-reference=Init_CAN2_IVI_AmbiLgtSta, base-type=uint8, implementation-data-type=uint8, transfer-property=PENDING
          signal CAN2_IVI_FrAtmoLamp_Cmd: start 1, 1 bit, big-endian, i-signal-type=PRIMITIVE, init-value=constant-reference=Init_CAN2_IVI_FrAtmoLamp_Cmd, base-type=uint8, implementation-data-type=uint8, transfer-property=PENDING
          signal CAN2_IVI_FrRmLampBright_Cmd: start 15, 4 bit, big-endian, i-signal-type=PRIMITIVE, init-value=constant-reference=Init_CAN2_IVI_FrRmLampBright_Cmd, base-type=uint8, implementation-data-type=uint8, transfer-property=PENDING
          signal CAN2_IVI_Frontindoorlight_Sta: start 11, 1 bit, big-endian, i-signal-type=PRIMITIVE, init-value=constant-reference=Init_CAN2_IVI_Frontindoorlight_Sta, base-type=uint8, implementation-data-type=uint8, transfer-property=PENDING
          signal CAN2_IVI_Passengerdoor_Sta: start 10, 1 bit, big-endian, i-signal-type=PRIMITIVE, init-value=constant-reference=Init_CAN2_IVI_Passengerdoor_Sta, base-type=uint8, implementation-data-type=uint8, transfer-property=PENDING
          signal CAN2_IVI_RrAtmoLamp_Cmd: start 2, 1 bit, big-endian, i-signal-type=PRIMITIVE, init-value=constant-reference=Init_CAN2_IVI_RrAtmoLamp_Cmd, base-type=uint8, implementation-data-type=uint8, transfer-property=PENDING
          signal CAN2_IVI_RrRmLampBright_Cmd: start 6, 4 bit, big-endian, i-signal-type=PRIMITIVE, init-value=constant-reference=Init_CAN2_IVI_RrRmLampBright_Cmd, base-type=uint8, implementation-data-type=uint8, transfer-property=PENDING
          signal CAN2_IVI_RrRoomlamp_Cmd: start 0, 1 bit, big-endian, i-signal-type=PRIMITIVE, init-value=constant-reference=Init_CAN2_IVI_RrRoomlamp_Cmd, base-type=uint8, implementation-data-type=uint8, transfer-property=PENDING
      frame CAN2_METER1: id 0x25A, frame-length=24, can-addressing-mode=STANDARD, can-fd-frame-support=true, can-frame-rx-behavior=CAN-FD, can-frame-tx-behavior=CAN-FD
        pdu CAN2_METER1: length=24, minimum-delay=0.0, transmission-mode-true-timing={cyclic-timing=time-period=0.1, event-controlled-timing={number-of-repetitions=0, repetition-period=0}}, unused-bit-pattern=0
          mapping CAN2_SG_METER1: i-signal-group=CAN2_SG_METER1, start-position=0, transfer-property=TRIGGERED-ON-CHANGE
          signal CAN2_APCforDTE: start 87, 16 bit, big-endian, i-signal-type=PRIMITIVE, init-value=constant-reference=Init_CAN2_APCforDTE, base-type=uint16, implementation-data-type=uint16, transfer-property=PENDING
          signal CAN2_AVGPwrConsumption: start 71, 16 bit, big-endian, i-signal-type=PRIMITIVE, init-value=constant-reference=Init_CAN2_AVGPwrConsumption, base-type=uint16, implementation-data-type=uint16, transfer-property=PENDING
          signal CAN2_AvailableTrip: start 103, 16 bit, big-endian, i-signal-type=PRIMITIVE, init-value=constant-reference=Init_CAN2_AvailableTrip, base-type=uint16, implementation-data-type=uint16, transfer-property=PENDING
          signal CAN2_Averaged_vehspeed: start 49, 10 bit, big-endian, i-signal-type=PRIMITIVE, init-value=constant-reference=Init_CAN2_Averaged_vehspeed, base-type=uint16, implementation-data-type=uint16, transfer-property=PENDING
          signal CAN2_Charge: start 113, 1 bit, big-endian, i-signal-type=PRIMITIVE, init-value=constant-reference=Init_CAN2_Charge, base-type=uint8, implementation-data-type=uint8, transfer-property=TRIGGERED-ON-CHANGE
          signal CAN2_LEDlitWarnReq: start 114, 1 bit, big-endian, i-signal-type=PRIMITIVE, init-value=constant-reference=Init_CAN2_LEDlitWarnReq, base-type=uint8, implementation-data-type=uint8, transfer-property=TRIGGERED-ON-CHANGE
          signal CAN2_METER_KPH_Calcu: start 15, 8 bit, big-endian, i-signal-type=PRIMITIVE, init-value=constant-reference=Init_CAN2_METER_KPH_Calcu, base-type=uint8, implementation-data-type=uint8, transfer-property=PENDING
          signal CAN2_METER_KPH_Real: start 31, 12 bit, big-endian, i-signal-type=PRIMITIVE, init-value=constant-reference=Init_CAN2_METER_KPH_Real, base-type=uint16, implementation-data-type=uint16, transfer-property=PENDING
          signal CAN2_METER_MPH_Calcu: start 23, 8 bit, big-endian, i-signal-type=PRIMITIVE, init-value=constant-reference=Init_CAN2_METER_MPH_Calcu, base-type=uint8, implementation-data-type=uint8, transfer-property=PENDING
          signal CAN2_METER_MPH_Real: start 35, 12 bit, big-endian, i-signal-type=PRIMITIVE, init-value=constant-reference=Init_CAN2_METER_MPH_Real, base-type=uint16, implementation-data-type=uint16, transfer-property=PENDING
          signal CAN2_ODOMETER: start 175, 24 bit, big-endian, i-signal-type=PRIMITIVE, init-value=constant-reference=Init_CAN2_ODOMETER, base-type=uint32, implementation-data-type=uint32, transfer-property=TRIGGERED-ON-CHANGE
          signal CAN2_ParkBrake: start 112, 1 bit, big-endian, i-signal-type=PRIMITIVE, init-value=constant-reference=Init_CAN2_ParkBrake, base-type=uint8, implementation-data-type=uint8, transfer-property=TRIGGERED-ON-CHANGE
          signal CAN2_Spd_Crl_Mode: start 118, 3 bit, big-endian, i-signal-type=PRIMITIVE, init-value=constant-reference=Init_CAN2_Spd_Crl_Mode, base-type=uint8, implementation-data-type=uint8, transfer-property=PENDING
          signal CAN2_Spd_Crl_Sta: start 115, 1 bit, big-endian, i-signal-type=PRIMITIVE, init-value=constant-reference=Init_CAN2_Spd_Crl_Sta, base-type=uint8, implementation-data-type=uint8, transfer-property=PENDING
          signal CAN2_Trip_A: start 151, 24 bit, big-endian, i-signal-type=PRIMITIVE, init-value=constant-reference=Init_CAN2_Trip_A, base-type=uint32, implementation-data-type=uint32, transfer-property=TRIGGERED-ON-CHANGE
          signal CAN2_Trip_B: start 127, 24 bit, big-endian, i-signal-type=PRIMITIVE, init-value=constant-reference=Init_CAN2_Trip_B, base-type=uint32, implementation-data-type=uint32, transfer-property=TRIGGERED-ON-CHANGE
      frame CAN2_NMm_FUSION_TX: id 0x500, frame-length=8, can-addressing-mode=STANDARD, can-fd-frame-support=false, can-frame-rx-behavior=CAN-20, can-frame-tx-behavior=CAN-20
        nm pdu CAN2_NMm_FUSION_TX: length=8, unused-bit-pattern=0
      frame CAN2_NMm_FUSION_RX: id 0x500, frame-length=8, can-addressing-mode=STANDARD, can-fd-frame-support=false, can-frame-rx-behavior=CAN-20, can-frame-tx-behavior=CAN-20
        nm pdu CAN2_NMm_FUSION_RX: length=8, unused-bit-pattern=0
