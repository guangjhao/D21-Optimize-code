VERSION ""

NS_ :

BS_:

BU_: FUSION ZONE_FR ZONE_DR DKC BodyZone_DR BodyZone_PS DataCenter ZONE_ML ZONE_MR

BO_ 550 zGW_LINDr1: 32 ZONE_DR
 SG_ RLS_LIN_Resp_Err : 175|1@0+ (1,0) [0|1] "" FUSION
 SG_ RLS_LightSnrErr : 255|1@0+ (1,0) [0|1] "" FUSION
 SG_ RLS_RainSnrErr : 254|1@0+ (1,0) [0|1] "" FUSION
 SG_ CSW_resp_error : 253|1@0+ (1,0) [0|1] "" FUSION
 SG_ RLS_Lamp_Sta : 147|1@0+ (1,0) [0|1] "" FUSION
 SG_ RLS_RainSnrWiperCmd : 146|3@0+ (1,0) [0|7] "" FUSION
 SG_ CSW_FWipSw_Sta : 165|3@0+ (1,0) [0|7] "" FUSION
 SG_ CSW_TurnSw_Sta : 63|2@0+ (1,0) [0|3] "" FUSION
 SG_ CSW_RWasSW_Sta : 61|2@0+ (1,0) [0|3] "" FUSION
 SG_ CSW_FWasSw_Sta : 59|2@0+ (1,0) [0|3] "" FUSION
 SG_ CSW_PassSW_Sta : 252|1@0+ (1,0) [0|1] "" FUSION
 SG_ CSW_DimSw : 251|1@0+ (1,0) [0|1] "" FUSION
 SG_ CSW_RWipIntSw_Sta : 57|2@0+ (1,0) [0|3] "" FUSION
 SG_ SWC_Drivemode_Sta : 135|2@0+ (1,0) [0|1] "" FUSION
 SG_ SWC_CANCEL_Sta : 133|1@0+ (1,0) [0|1] "" FUSION
 SG_ SWC_ACC_Sta : 132|1@0+ (1,0) [0|1] "" FUSION
 SG_ SWC_A_Resp_Err : 131|1@0+ (1,0) [0|1] "" FUSION
 SG_ SWC_Distance_Sta : 130|1@0+ (1,0) [0|1] "" FUSION
 SG_ SWC_Down_Sta : 129|1@0+ (1,0) [0|1] "" FUSION
 SG_ SWC_RegenUp : 128|1@0+ (1,0) [0|1] "" FUSION
 SG_ SWC_Left_Sta : 143|1@0+ (1,0) [0|1] "" FUSION
 SG_ SWC_mode_Sta : 142|1@0+ (1,0) [0|1] "" FUSION
 SG_ SWC_resp_error : 141|1@0+ (1,0) [0|1] "" FUSION
 SG_ SWC_Res_Up_Sta : 140|1@0+ (1,0) [0|1] "" FUSION
 SG_ SWC_RegenDown : 139|1@0+ (1,0) [0|1] "" FUSION
 SG_ SWC_Right_Sta : 138|1@0+ (1,0) [0|1] "" FUSION
 SG_ SWC_Set_down_Sta : 137|1@0+ (1,0) [0|1] "" FUSION
 SG_ SWC_Trip_Sta : 136|1@0+ (1,0) [0|1] "" FUSION
 SG_ SWC_Up_Sta : 151|1@0+ (1,0) [0|1] "" FUSION
 SG_ SWC_VR_Sta : 150|1@0+ (1,0) [0|1] "" FUSION
 SG_ SWC_Undefined_Sta : 149|1@0+ (1,0) [0|1] "" FUSION
 SG_ SWC_LKA_Sta : 148|1@0+ (1,0) [0|1] "" FUSION
 SG_ L_Pas_Wdw_Obs_InhibitSts : 159|1@0+ (1,0) [0|1] "" FUSION
 SG_ L_Drv_Wdw_RRD_Switch : 157|3@0+ (1,0) [0|7] "" FUSION
 SG_ L_Drv_Wdw_RLD_Switch : 154|3@0+ (1,0) [0|7] "" FUSION
 SG_ L_Pas_Wdw_OD_Sts : 167|1@0+ (1,0) [0|1] "" FUSION
 SG_ L_Pas_Wdw_Init : 166|1@0+ (1,0) [0|1] "" FUSION
 SG_ L_Pas_OverHeat_Protect : 158|1@0+ (1,0) [0|1] "" FUSION
 SG_ L_Pas_Motor_Relay_Error : 54|1@0+ (1,0) [0|1] "" FUSION
 SG_ L_Pas_Motor_Ripple_Error : 55|1@0+ (1,0) [0|1] "" FUSION
 SG_ L_Drv_Wdw_Pas_Switch : 162|3@0+ (1,0) [0|7] "" FUSION
 SG_ L_Pas_Val_Wdw_Opened : 174|7@0+ (1,0) [0|100] "%" FUSION
 SG_ L_Pas_Wdw_PositionSts : 183|2@0+ (1,0) [0|3] "" FUSION
 SG_ L_Pas_Wdw_LocalSwitch : 181|3@0+ (1,0) [0|7] "" FUSION
 SG_ L_Pas_Wdw_Running_Sts : 178|3@0+ (1,0) [0|7] "" FUSION
 SG_ L_Power_Status : 191|2@0+ (1,0) [0|3] "" FUSION
 SG_ FAPWL_01_LIN_Response_Error : 189|1@0+ (1,0) [0|1] "" FUSION
 SG_ L_Drv_Wdw_Obs_InhibitSts : 188|1@0+ (1,0) [0|1] "" FUSION
 SG_ L_Drv_Wdw_OD_Sts : 187|1@0+ (1,0) [0|1] "" FUSION
 SG_ L_Drv_Wdw_Init : 186|1@0+ (1,0) [0|1] "" FUSION
 SG_ L_Drv_OverHeat_Protect : 185|1@0+ (1,0) [0|1] "" FUSION
 SG_ L_Drv_Motor_Relay_Error : 184|1@0+ (1,0) [0|1] "" FUSION
 SG_ L_Drv_Motor_Ripple_Error : 199|1@0+ (1,0) [0|1] "" FUSION
 SG_ L_Drv_Val_Wdw_Opened : 198|7@0+ (1,0) [0|100] "%" FUSION
 SG_ L_Drv_Wdw_PositionSts : 207|2@0+ (1,0) [0|3] "" FUSION
 SG_ L_Drv_Wdw_LocalSwitch : 205|3@0+ (1,0) [0|7] "" FUSION
 SG_ L_Drv_Wdw_Running_Sts : 202|3@0+ (1,0) [0|7] "" FUSION
 SG_ L_RLD_Wdw_Init : 215|1@0+ (1,0) [0|1] "" FUSION
 SG_ L_RRD_Val_Wdw_Opened : 214|7@0+ (1,0) [0|100] "%" FUSION
 SG_ L_RRD_Wdw_PositionSts : 223|2@0+ (1,0) [0|3] "" FUSION
 SG_ L_RRD_Wdw_Obs_InhibitSts : 221|1@0+ (1,0) [0|1] "" FUSION
 SG_ L_RRD_Wdw_OD_Sts : 220|1@0+ (1,0) [0|1] "" FUSION
 SG_ L_RRD_Wdw_Init : 219|1@0+ (1,0) [0|1] "" FUSION
 SG_ L_RRD_OverHeat_Protect : 218|1@0+ (1,0) [0|1] "" FUSION
 SG_ L_RRD_Motor_Relay_Error : 217|1@0+ (1,0) [0|1] "" FUSION
 SG_ L_RRD_Motor_Ripple_Error : 216|1@0+ (1,0) [0|1] "" FUSION
 SG_ L_RRD_Wdw_LocalSwitch : 231|3@0+ (1,0) [0|7] "" FUSION
 SG_ L_RRD_Wdw_Running_Sts : 228|3@0+ (1,0) [0|7] "" FUSION
 SG_ RAPWL_01_LIN_Response_Error : 225|1@0+ (1,0) [0|1] "" FUSION
 SG_ L_RLD_Wdw_Obs_InhibitSts : 224|1@0+ (1,0) [0|1] "" FUSION
 SG_ L_RLD_Wdw_OD_Sts : 239|1@0+ (1,0) [0|1] "" FUSION
 SG_ L_RLD_Val_Wdw_Opened : 238|7@0+ (1,0) [0|100] "%" FUSION
 SG_ L_RLD_OverHeat_Protect : 247|1@0+ (1,0) [0|1] "" FUSION
 SG_ L_RLD_Motor_Relay_Error : 246|1@0+ (1,0) [0|1] "" FUSION
 SG_ L_RLD_Motor_Ripple_Error : 245|1@0+ (1,0) [0|1] "" FUSION
 SG_ L_RLD_Wdw_PositionSts : 244|2@0+ (1,0) [0|3] "" FUSION
 SG_ L_RLD_Wdw_LocalSwitch : 242|3@0+ (1,0) [0|7] "" FUSION
 SG_ L_RLD_Wdw_Running_Sts : 250|3@0+ (1,0) [0|7] "" FUSION
 SG_ SWC2_R_Right_Sta : 39|1@0+ (1,0) [0|1] "" FUSION
 SG_ SWC2_R_ScrollUp_Sta : 38|1@0+ (1,0) [0|1] "" FUSION
 SG_ SWC2_R_ScrollPress_Sta : 37|1@0+ (1,0) [0|1] "" FUSION
 SG_ SWC2_R_ScrollDown_Sta : 36|1@0+ (1,0) [0|1] "" FUSION
 SG_ SWC2_R_Left_Sta : 35|1@0+ (1,0) [0|1] "" FUSION
 SG_ SWC2_R_VR_Sta : 34|1@0+ (1,0) [0|1] "" FUSION
 SG_ SWC2_R_PageSwitch_Sta : 33|1@0+ (1,0) [0|1] "" FUSION
 SG_ SWC2_R_Customize_Sta : 32|1@0+ (1,0) [0|1] "" FUSION
 SG_ SWC2_L_Left_Sta : 47|1@0+ (1,0) [0|1] "" FUSION
 SG_ SWC2_L_ScrollUp_Sta : 46|1@0+ (1,0) [0|1] "" FUSION
 SG_ SWC2_L_ScrollPress_Sta : 45|1@0+ (1,0) [0|1] "" FUSION
 SG_ SWC2_L_ScrollDown_Sta : 44|1@0+ (1,0) [0|1] "" FUSION
 SG_ SWC2_L_Right_Sta : 43|1@0+ (1,0) [0|1] "" FUSION
 SG_ SWC2_L_RegenUp_Sta : 42|1@0+ (1,0) [0|1] "" FUSION
 SG_ SWC2_L_ADAS_Sta : 41|1@0+ (1,0) [0|1] "" FUSION
 SG_ SWC2_L_Home_Sta : 40|1@0+ (1,0) [0|1] "" FUSION
 SG_ SWC2_ResponseError : 53|1@0+ (1,0) [0|1] "" FUSION
 SG_ SWC2_R_RegenDown_Sta : 52|1@0+ (1,0) [0|1] "" FUSION
 SG_ SWC2_L_DriveMode_Sta : 51|1@0+ (1,0) [0|1] "" FUSION
 SG_ HVPO_OtltCvrStsRw_Sta : 5|6@0+ (1.587302,0) [0|100.000026] "%" FUSION

BO_ 805 ZONE_DR1: 48 ZONE_DR
 SG_ ACT5_Stop_mode : 71|2@0+ (1,0) [0|3] "" FUSION
 SG_ ACT5_Rotation_direction : 69|2@0+ (1,0) [0|3] "" FUSION
 SG_ ACT5_Emergency_run_position : 67|2@0+ (1,0) [0|3] "" FUSION
 SG_ ACT5_Emergency_run_release : 65|2@0+ (1,0) [0|3] "" FUSION
 SG_ ACT5_Actuator_start_position : 79|16@0+ (1,0) [0|65535] "" FUSION
 SG_ ACT5_Actuator_set_position : 95|16@0+ (1,0) [0|65535] "" FUSION
 SG_ ACT5_Speed_specification : 111|4@0+ (1,0) [0|5] "" FUSION
 SG_ ACT5_Select_position_specification : 107|2@0+ (1,0) [0|3] "" FUSION
 SG_ ACT5_Applied_holding_current : 105|2@0+ (1,0) [0|3] "" FUSION
 SG_ ACT5_Clear_Event_Flags : 119|4@0+ (1,0) [0|15] "" FUSION
 SG_ ACT5_Stall_detection_release : 115|2@0+ (1,0) [0|3] "" FUSION
 SG_ ACT5_Save_programming_data : 113|2@0+ (1,0) [0|3] "" FUSION
 SG_ ACT5_Actuator_address : 127|8@0+ (1,0) [1|126] "" FUSION
 SG_ ACT4_Stop_mode : 135|2@0+ (1,0) [0|3] "" FUSION
 SG_ ACT4_Rotation_direction : 133|2@0+ (1,0) [0|3] "" FUSION
 SG_ ACT4_Emergency_run_position : 131|2@0+ (1,0) [0|3] "" FUSION
 SG_ ACT4_Emergency_run_release : 129|2@0+ (1,0) [0|3] "" FUSION
 SG_ ACT4_Actuator_start_position : 143|16@0+ (1,0) [0|65535] "" FUSION
 SG_ ACT4_Actuator_set_position : 159|16@0+ (1,0) [0|65535] "" FUSION
 SG_ ACT4_Speed_specification : 175|4@0+ (1,0) [0|5] "" FUSION
 SG_ ACT4_Select_position_specification : 171|2@0+ (1,0) [0|3] "" FUSION
 SG_ ACT4_Applied_holding_current : 169|2@0+ (1,0) [0|3] "" FUSION
 SG_ ACT4_Clear_Event_Flags : 183|4@0+ (1,0) [0|15] "" FUSION
 SG_ ACT4_Stall_detection_release : 179|2@0+ (1,0) [0|3] "" FUSION
 SG_ ACT4_Save_programming_data : 177|2@0+ (1,0) [0|3] "" FUSION
 SG_ ACT4_Actuator_address : 191|8@0+ (1,0) [1|126] "" FUSION
 SG_ ACT3_Stop_mode : 199|2@0+ (1,0) [0|3] "" FUSION
 SG_ ACT3_Rotation_direction : 197|2@0+ (1,0) [0|3] "" FUSION
 SG_ ACT3_Emergency_run_position : 195|2@0+ (1,0) [0|3] "" FUSION
 SG_ ACT3_Emergency_run_release : 193|2@0+ (1,0) [0|3] "" FUSION
 SG_ ACT3_Actuator_start_position : 207|16@0+ (1,0) [0|65535] "" FUSION
 SG_ ACT3_Actuator_set_position : 223|16@0+ (1,0) [0|65535] "" FUSION
 SG_ ACT3_Speed_specification : 239|4@0+ (1,0) [0|5] "" FUSION
 SG_ ACT3_Select_position_specification : 235|2@0+ (1,0) [0|3] "" FUSION
 SG_ ACT3_Applied_holding_current : 233|2@0+ (1,0) [0|3] "" FUSION
 SG_ ACT3_Clear_Event_Flags : 247|4@0+ (1,0) [0|15] "" FUSION
 SG_ ACT3_Stall_detection_release : 243|2@0+ (1,0) [0|3] "" FUSION
 SG_ ACT3_Save_programming_data : 241|2@0+ (1,0) [0|3] "" FUSION
 SG_ ACT3_Actuator_address : 255|8@0+ (1,0) [1|126] "" FUSION
 SG_ ACT2_Stop_mode : 263|2@0+ (1,0) [0|3] "" FUSION
 SG_ ACT2_Rotation_direction : 261|2@0+ (1,0) [0|3] "" FUSION
 SG_ ACT2_Emergency_run_position : 259|2@0+ (1,0) [0|3] "" FUSION
 SG_ ACT2_Emergency_run_release : 257|2@0+ (1,0) [0|3] "" FUSION
 SG_ ACT2_Actuator_start_position : 271|16@0+ (1,0) [0|65535] "" FUSION
 SG_ ACT2_Actuator_set_position : 287|16@0+ (1,0) [0|65535] "" FUSION
 SG_ ACT2_Speed_specification : 303|4@0+ (1,0) [0|5] "" FUSION
 SG_ ACT2_Select_position_specification : 299|2@0+ (1,0) [0|3] "" FUSION
 SG_ ACT2_Applied_holding_current : 297|2@0+ (1,0) [0|3] "" FUSION
 SG_ ACT2_Clear_Event_Flags : 311|4@0+ (1,0) [0|15] "" FUSION
 SG_ ACT2_Stall_detection_release : 307|2@0+ (1,0) [0|3] "" FUSION
 SG_ ACT2_Save_programming_data : 305|2@0+ (1,0) [0|3] "" FUSION
 SG_ ACT2_Actuator_address : 319|8@0+ (1,0) [1|126] "" FUSION
 SG_ ACT1_Stop_mode : 327|2@0+ (1,0) [0|3] "" FUSION
 SG_ ACT1_Rotation_direction : 325|2@0+ (1,0) [0|3] "" FUSION
 SG_ ACT1_Emergency_run_position : 323|2@0+ (1,0) [0|3] "" FUSION
 SG_ ACT1_Emergency_run_release : 321|2@0+ (1,0) [0|3] "" FUSION
 SG_ ACT1_Actuator_start_position : 335|16@0+ (1,0) [0|65535] "" FUSION
 SG_ ACT1_Actuator_set_position : 351|16@0+ (1,0) [0|65535] "" FUSION
 SG_ ACT1_Speed_specification : 367|4@0+ (1,0) [0|5] "" FUSION
 SG_ ACT1_Select_position_specification : 363|2@0+ (1,0) [0|3] "" FUSION
 SG_ ACT1_Applied_holding_current : 361|2@0+ (1,0) [0|3] "" FUSION
 SG_ ACT1_Clear_Event_Flags : 375|4@0+ (1,0) [0|15] "" FUSION
 SG_ ACT1_Stall_detection_release : 371|2@0+ (1,0) [0|3] "" FUSION
 SG_ ACT1_Save_programming_data : 369|2@0+ (1,0) [0|3] "" FUSION
 SG_ ACT1_Actuator_address : 383|8@0+ (1,0) [1|126] "" FUSION
 SG_ HornSW : 30|1@0+ (1,0) [0|1] "" FUSION
 SG_ AllLockSta : 25|1@0+ (1,0) [0|1] "" FUSION
 SG_ AutoLightSW : 35|1@0+ (1,0) [0|1] "" FUSION
 SG_ BrakeLampFail : 29|1@0+ (1,0) [0|1] "" FUSION
 SG_ DrLockSta : 24|1@0+ (1,0) [0|1] "" FUSION
 SG_ WiperSWPos : 47|8@0+ (1,0) [0|255] "" FUSION
 SG_ RRTurnLampC : 55|8@0+ (10,0) [0|2550] "mA" FUSION
 SG_ RLTurnLampC : 63|8@0+ (10,0) [0|2550] "mA" FUSION
 SG_ Wip_Speed : 33|2@0+ (1,0) [0|3] "" FUSION
 SG_ MIRROR_FOLD_SW : 26|1@0+ (1,0) [0|1] "" FUSION
 SG_ PsLockSta : 38|1@0+ (1,0) [0|1] "" FUSION
 SG_ RLLockSta : 37|1@0+ (1,0) [0|1] "" FUSION
 SG_ RLS_Exist : 39|1@0+ (1,0) [0|1] "" FUSION
 SG_ RRLockSta : 36|1@0+ (1,0) [0|1] "" FUSION
 SG_ RWiperAS : 27|1@0+ (1,0) [0|1] "" FUSION
 SG_ RWiperProtection : 28|1@0+ (1,0) [0|1] "" FUSION
 SG_ WiperZeroPosSW : 34|1@0+ (1,0) [0|1] "" FUSION
 SG_ RLTurnLPErr : 23|1@0+ (1,0) [0|1] "" FUSION
 SG_ RRTurnLPErr : 22|1@0+ (1,0) [0|1] "" FUSION
 SG_ ZDR_THCM_IntakeFail_Sta : 15|2@0+ (1,0) [0|2] "" FUSION
 SG_ ZDR_THCM_LINACT1_Sta : 11|2@0+ (1,0) [0|2] "" FUSION
 SG_ ZDR_THCM_LINACT2_Sta : 9|2@0+ (1,0) [0|2] "" FUSION
 SG_ ZDR_THCM_LINACT3_Sta : 21|2@0+ (1,0) [0|2] "" FUSION
 SG_ ZDR_THCM_LINACT4_Sta : 19|2@0+ (1,0) [0|2] "" FUSION
 SG_ ZDR_THCM_LINACT5_Sta : 17|2@0+ (1,0) [0|2] "" FUSION
 SG_ ZDR_THCM_ModeFail_Sta : 13|2@0+ (1,0) [0|2] "" FUSION

BO_ 552 zGW_LINFr1: 32 ZONE_FR
 SG_ AGS_Actual_Position : 7|8@0+ (1,0) [0|240] "" FUSION
 SG_ AGS_Low_Voltage_Error : 15|1@0+ (1,0) [0|1] "" FUSION
 SG_ AGS_Temperature_Error : 14|1@0+ (1,0) [0|1] "" FUSION
 SG_ AGS_Sensor_Error : 13|1@0+ (1,0) [0|1] "" FUSION
 SG_ AGS_Electrical_Error : 12|1@0+ (1,0) [0|1] "" FUSION
 SG_ AGS_Calibration_Indicated : 11|1@0+ (1,0) [0|1] "" FUSION
 SG_ AGS_Calibration_Active : 10|1@0+ (1,0) [0|1] "" FUSION
 SG_ AGS_Actuator_Fault : 8|1@0+ (1,0) [0|1] "" FUSION
 SG_ AGS_Actuator_Blocked : 9|1@0+ (1,0) [0|1] "" FUSION
 SG_ AGS_LINResponse_Error : 23|1@0+ (1,0) [0|1] "" FUSION
 SG_ ION_IONErr_Sta : 81|2@0+ (1,0) [0|3] "" FUSION
 SG_ ION_IONRespErr_Sta : 83|1@0+ (1,0) [0|1] "" FUSION
 SG_ ION_ION_Sta : 82|1@0+ (1,0) [0|1] "" FUSION
 SG_ FGS_LifeHole3_Sta : 64|9@0+ (1,0) [0|360] "hr" FUSION
 SG_ FGS_LifeHole2_Sta : 48|9@0+ (1,0) [0|360] "hr" FUSION
 SG_ FGS_LifeHole1_Sta : 32|9@0+ (1,0) [0|360] "hr" FUSION
 SG_ FGS_Channel3TypeRsp_Sta : 71|4@0+ (1,0) [0|15] "" FUSION
 SG_ FGS_Channel2TypeRsp_Sta : 55|4@0+ (1,0) [0|15] "" FUSION
 SG_ FGS_Channel1TypeRsp_Sta : 39|4@0+ (1,0) [0|15] "" FUSION
 SG_ FGS_BlowerErr_Sta : 33|1@0+ (1,0) [0|1] "" FUSION
 SG_ FGS_IntenRsp_Sta : 19|4@0+ (1,0) [0|15] "" FUSION
 SG_ FGS_MotorErr_Sta : 49|1@0+ (1,0) [0|1] "" FUSION
 SG_ FGS_TypRsp_Sta : 22|3@0+ (1,0) [0|7] "" FUSION
 SG_ FGS_LINResponseErr_Sta : 87|1@0+ (1,0) [0|1] "" FUSION
 SG_ FGS_StsRsp_Sta : 86|1@0+ (1,0) [0|1] "" FUSION
 SG_ FGS_Channel_Type_Sta : 31|6@0+ (1,0) [0|63] "" FUSION
 SG_ FGS_Channel_Index_Sta : 25|2@0+ (1,0) [0|3] "" FUSION

BO_ 796 ZONE_FR1: 64 ZONE_FR
 SG_ BMSReqRlngCtrHSC6 : 7|4@0+ (1,0) [0|15] "" FUSION
 SG_ BMSReqTapPosHSC6 : 3|4@0+ (1,0) [0|15] "" FUSION
 SG_ BMSReqPwrHSC6 : 15|16@0+ (1,0) [0|65535] "" FUSION
 SG_ BMSReqPWMHSC6 : 31|7@0+ (1,0) [0|100] "" FUSION
 SG_ BMSInptClntTemHSC6 : 24|9@0+ (0.5,-40) [-40|200] "" FUSION
 SG_ BMSChksmHSC6 : 47|8@0+ (1,0) [0|255] "" FUSION
 SG_ BMSReqMdHSC6 : 71|2@0+ (1,0) [0|3] "" FUSION
 SG_ BMSEnbPTCHSC6 : 69|1@0+ (1,0) [0|1] "" FUSION
 SG_ FRTurnLampC : 151|8@0+ (10,0) [0|2550] "mA" FUSION
 SG_ FLTurnLampC : 159|8@0+ (10,0) [0|2550] "mA" FUSION
 SG_ ChargeInletLockSta : 55|1@0+ (1,0) [0|1] "" FUSION
 SG_ FWiperAS : 175|1@0+ (1,0) [0|1] "" FUSION
 SG_ FWiperProtection : 174|1@0+ (1,0) [0|1] "" FUSION
 SG_ BDC_1_ReqMovePos : 143|8@0+ (0.392,0) [0|99.96] "" FUSION
 SG_ BDC_1_MoveEnable : 173|1@0+ (1,0) [0|1] "" FUSION
 SG_ CCV4_MoveEnable : 168|1@0+ (1,0) [0|1] "" FUSION
 SG_ CCV4_ReqMovePos : 169|1@0+ (1,0) [0|1] "" FUSION
 SG_ CCM_SpdCmd : 54|15@0+ (0.5,0) [0|8300] "RPM" FUSION
 SG_ BMSPackVol_h6HSC6 : 67|12@0+ (0.25,0) [0|1023.75] "V" FUSION
 SG_ CompProEN : 68|1@0+ (1,0) [0|1] "" FUSION
 SG_ EXV_Cmd_Set_Rq : 87|16@0+ (1,0) [0|65535] "" FUSION
 SG_ EXV2_Cmd_Set_Rq : 103|16@0+ (1,0) [0|65535] "" FUSION
 SG_ EWP3_RPM_Target_EWP_Rq : 135|8@0+ (1,0) [0|254] "" FUSION
 SG_ EWP2_RPM_Target_EWP_Rq : 127|8@0+ (1,0) [0|254] "" FUSION
 SG_ EWP1_RPM_Target_EWP_Rq : 119|8@0+ (1,0) [0|254] "" FUSION
 SG_ EXV2_Cmd_Init_Rq : 162|3@0+ (1,0) [0|7] "" FUSION
 SG_ EXV_Cmd_Init_Rq : 165|3@0+ (1,0) [0|7] "" FUSION
 SG_ EWP1_Default_Operation_EWP_Rq : 170|1@0+ (1,0) [0|1] "" FUSION
 SG_ EWP2_Default_Operation_EWP_Rq : 171|1@0+ (1,0) [0|1] "" FUSION
 SG_ EWP3_Default_Operation_EWP_Rq : 172|1@0+ (1,0) [0|1] "" FUSION
 SG_ EXV2_Cmd_Move_Enbl : 167|1@0+ (1,0) [0|1] "" FUSION
 SG_ EXV_Cmd_Move_Enbl : 166|1@0+ (1,0) [0|1] "" FUSION
 SG_ AGS_Position_Request : 183|8@0+ (1,0) [0|255] "" FUSION
 SG_ AGS_Calibration_Enabled : 191|1@0+ (1,0) [0|1] "" FUSION
 SG_ TrailerModeSta : 189|2@0+ (1,0) [0|3] "" FUSION
 SG_ TrailerCheck : 190|1@0+ (1,0) [0|1] "" FUSION
 SG_ ZFR_BCM_ChargerDoorSW_Sta : 187|1@0+ (1,0) [0|1] "" FUSION
 SG_ FLPosLPErr : 197|1@0+ (1,0) [0|1] "" FUSION
 SG_ FLTurnLPErr : 198|1@0+ (1,0) [0|1] "" FUSION
 SG_ FLTurn_Light_Warning : 203|1@0+ (1,0) [0|1] "" FUSION
 SG_ FRPosLPErr : 213|1@0+ (1,0) [0|1] "" FUSION
 SG_ FRTurnLPErr : 214|1@0+ (1,0) [0|1] "" FUSION
 SG_ FRTurn_Light_Warning : 219|1@0+ (1,0) [0|1] "" FUSION
 SG_ LADBErr : 194|1@0+ (1,0) [0|1] "" FUSION
 SG_ LADB_Hibeam_Indication : 192|1@0+ (1,0) [0|1] "" FUSION
 SG_ LADB_Operation_Status : 207|1@0+ (1,0) [0|1] "" FUSION
 SG_ LADB_Warning : 206|1@0+ (1,0) [0|1] "" FUSION
 SG_ LAHB_Warning : 204|1@0+ (1,0) [0|1] "" FUSION
 SG_ LDRLErr : 193|1@0+ (1,0) [0|1] "" FUSION
 SG_ LDRL_Warning : 202|1@0+ (1,0) [0|1] "" FUSION
 SG_ LH_BeamErr : 195|1@0+ (1,0) [0|1] "" FUSION
 SG_ LLB_Warning : 205|1@0+ (1,0) [0|1] "" FUSION
 SG_ LL_BeamErr : 196|1@0+ (1,0) [0|1] "" FUSION
 SG_ Lposition_Lamp_Warning : 199|1@0+ (1,0) [0|1] "" FUSION
 SG_ RADBErr : 210|1@0+ (1,0) [0|1] "" FUSION
 SG_ RADB_Hibeam_Indication : 208|1@0+ (1,0) [0|1] "" FUSION
 SG_ RADB_Operation_Status : 223|1@0+ (1,0) [0|1] "" FUSION
 SG_ RADB_Warning : 222|1@0+ (1,0) [0|1] "" FUSION
 SG_ RAHB_Warning : 220|1@0+ (1,0) [0|1] "" FUSION
 SG_ RDRLErr : 209|1@0+ (1,0) [0|1] "" FUSION
 SG_ RDRL_Warning : 218|1@0+ (1,0) [0|1] "" FUSION
 SG_ RH_BeamErr : 211|1@0+ (1,0) [0|1] "" FUSION
 SG_ RLB_Warning : 221|1@0+ (1,0) [0|1] "" FUSION
 SG_ RL_BeamErr : 212|1@0+ (1,0) [0|1] "" FUSION
 SG_ Rposition_Lamp_Warning : 215|1@0+ (1,0) [0|1] "" FUSION
 SG_ ZFR_THCM_CLEVentActY_Sta : 262|7@0+ (1,0) [0|127] "%" FUSION
 SG_ ZFR_THCM_CLEVentActZ_Sta : 270|7@0+ (1,0) [0|127] "%" FUSION
 SG_ ZFR_THCM_CREVentActY_Sta : 278|7@0+ (1,0) [0|127] "%" FUSION
 SG_ ZFR_THCM_CREVentActZ_Sta : 286|7@0+ (1,0) [0|127] "%" FUSION
 SG_ ZFR_THCM_LEVentActY_Sta : 230|7@0+ (1,0) [0|127] "%" FUSION
 SG_ ZFR_THCM_LEVentActZ_Sta : 238|7@0+ (1,0) [0|127] "%" FUSION
 SG_ ZFR_THCM_REVentActY_Sta : 246|7@0+ (1,0) [0|127] "%" FUSION
 SG_ ZFR_THCM_REVentActZ_Sta : 254|7@0+ (1,0) [0|127] "%" FUSION
 SG_ ZFR_EChrg_Active_Sta : 186|3@0+ (1,0) [0|7] "" FUSION
 SG_ ZFR_EChrg_Sys_Sta : 201|2@0+ (1,0) [0|3] "" FUSION
 SG_ ZFR_EChrg_OperationDeny_Cmd : 302|2@0+ (1,0) [0|3] "" FUSION
 SG_ ZFR_SYS_HWMismatchFW_Sta : 263|1@0+ (1,0) [0|1] "" FUSION
 SG_ ZFR_BCM_HRLTurnLPNormal_Sta : 271|1@0+ (1,0) [0|1] "" FUSION
 SG_ ZFR_BCM_HRRTurnLPHNormal_Sta : 279|1@0+ (1,0) [0|1] "" FUSION
 SG_ ZFR_EChrg_WashMode_Sta : 287|1@0+ (1,0) [0|1] "" FUSION
 SG_ ZFR_THCM_EACV1Stallpos_Sta : 359|16@0+ (1,0) [0|65535] "" FUSION
 SG_ ZFR_THCM_EACV2Stallpos_Sta : 375|16@0+ (1,0) [0|65535] "" FUSION
 SG_ ZFR_THCM_EACV3Stallpos_Sta : 391|16@0+ (1,0) [0|65535] "" FUSION
 SG_ ZFR_THCM_EACV4Stallpos_Sta : 407|16@0+ (1,0) [0|65535] "" FUSION
 SG_ ZFR_THCM_EACV5Stallpos_Sta : 423|16@0+ (1,0) [0|65535] "" FUSION
 SG_ ZFR_THCM_EACV6Stallpos_Sta : 439|16@0+ (1,0) [0|65535] "" FUSION
 SG_ ZFR_THCM_EACV7Stallpos_Sta : 455|16@0+ (1,0) [0|65535] "" FUSION
 SG_ ZFR_THCM_EACV8Stallpos_Sta : 471|16@0+ (1,0) [0|65535] "" FUSION

BO_ 593 DKC1: 8 DKC
 SG_ P_CommandToBCM : 7|4@0+ (1,0) [0|15] "" FUSION
 SG_ P_DKey_Welcome : 3|4@0+ (1,0) [0|15] "" FUSION
 SG_ P_DKey_Area_LockUnlock : 15|2@0+ (1,0) [0|3] "" FUSION
 SG_ P_DKey_Area_PS : 13|2@0+ (1,0) [0|3] "" FUSION
 SG_ P_UID_LowPower : 11|1@0+ (1,0) [0|1] "" FUSION
 SG_ P_CommandToPTG : 10|3@0+ (1,0) [0|5] "" FUSION
 SG_ P_Dkey_Show_IVI : 23|4@0+ (1,0) [0|15] "" FUSION
 SG_ P_KeyMode : 19|4@0+ (1,0) [0|15] "" FUSION
 SG_ P_DKey_Area_PTG : 31|2@0+ (1,0) [0|3] "" FUSION
 SG_ P_KeyMiss : 29|1@0+ (1,0) [0|1] "" FUSION
 SG_ DKC_Re_VehData : 39|4@0+ (1,0) [0|15] "" FUSION
 SG_ DKC_P_UID_BatVolt : 41|10@0+ (10,0) [0|3500] "mV" FUSION
 SG_ DKC_P_BLE_RSSI : 63|8@0+ (1,0) [0|255] "" FUSION
 SG_ DKC_ParkingMode_Cmd : 46|3@0+ (1,0) [0|4] "" FUSION
 SG_ DKC_PDkeyAreaRAPS_Sta : 43|2@0+ (1,0) [0|3] "" FUSION
 SG_ DKC_KeyNum_Sta : 35|4@0+ (1,0) [0|15] "" FUSION
 SG_ DKC_KeyType_Sta : 25|2@0+ (1,0) [0|3] "" FUSION

BO_ 594 DKC2: 24 DKC
 SG_ Random_Number_X : 7|64@0+ (1,0) [0|1.8446744073709551E19] "" FUSION
 SG_ EncryptionDATA_64_127 : 71|64@0+ (1,0) [0|1.8446744073709551E19] "" FUSION
 SG_ EncryptionDATA_0_63 : 135|64@0+ (1,0) [0|1.8446744073709551E19] "" FUSION

BO_ 596 zGW_LINFr2: 32 ZONE_FR
 SG_ EXV_Rsp_Pos : 7|16@0+ (1,0) [0|576] "" FUSION
 SG_ EXV_Rsp_Fault_Stat : 23|4@0+ (1,0) [0|15] "" FUSION
 SG_ EXV_Rsp_CurInit_Stat : 19|2@0+ (1,0) [0|3] "" FUSION
 SG_ EXV_Rsp_OvrTemp_Warn : 17|2@0+ (1,0) [0|3] "" FUSION
 SG_ EXV_Rsp_Volt_Stat : 31|2@0+ (1,0) [0|3] "" FUSION
 SG_ EXV_RsErr_EXV : 29|1@0+ (1,0) [0|1] "" FUSION
 SG_ EXV_Rsp_Run_Stat : 28|1@0+ (1,0) [0|1] "" FUSION
 SG_ EWP1_RsErr_EWP : 26|1@0+ (1,0) [0|1] "" FUSION
 SG_ EWP1_SupVolt_Error : 25|2@0+ (1,0) [0|2] "" FUSION
 SG_ EWP1_RPM_Target_Stat : 39|8@0+ (1,0) [0|255] "" FUSION
 SG_ EWP1_RPM_ActlVal_Stat : 47|8@0+ (1,0) [0|255] "" FUSION
 SG_ EWP1_Curr_Stat : 55|8@0+ (0.1,0) [0|25.5] "A" FUSION
 SG_ EWP1_Block_Error : 63|2@0+ (1,0) [0|3] "" FUSION
 SG_ EWP1_DryRun_Error : 61|2@0+ (1,0) [0|3] "" FUSION
 SG_ EWP1_OverCurr_Error : 59|2@0+ (1,0) [0|3] "" FUSION
 SG_ EWP1_OverTemp_Error : 57|2@0+ (1,0) [0|2] "" FUSION
 SG_ EWP1_Temp_Stat : 71|8@0+ (1,-50) [-50|205] "Deg" FUSION
 SG_ EWP1_Volt_Stat : 79|8@0+ (0.1,0) [0|25.5] "V" FUSION
 SG_ EWP2_Volt_Stat : 87|8@0+ (0.1,0) [0|25.5] "V" FUSION
 SG_ EWP2_Temp_Stat : 95|8@0+ (1,-50) [-50|205] "Deg" FUSION
 SG_ EWP2_RPM_Target_Stat : 103|8@0+ (1,0) [0|255] "" FUSION
 SG_ EWP2_RPM_ActlVal_Stat : 111|8@0+ (1,0) [0|255] "" FUSION
 SG_ EWP2_Curr_Stat : 119|8@0+ (0.1,0) [0|25.5] "A" FUSION
 SG_ EWP2_Block_Error : 127|2@0+ (1,0) [0|3] "" FUSION
 SG_ EWP2_DryRun_Error : 125|2@0+ (1,0) [0|3] "" FUSION
 SG_ EWP2_OverCurr_Error : 123|2@0+ (1,0) [0|3] "" FUSION
 SG_ EWP2_OverTemp_Error : 121|2@0+ (1,0) [0|2] "" FUSION
 SG_ EWP2_SupVolt_Error : 135|2@0+ (1,0) [0|2] "" FUSION
 SG_ EWP2_RsErr_EWP : 133|1@0+ (1,0) [0|1] "" FUSION
 SG_ EWP3_Block_Error : 131|2@0+ (1,0) [0|3] "" FUSION
 SG_ EWP3_DryRun_Error : 129|2@0+ (1,0) [0|3] "" FUSION
 SG_ EWP3_RPM_Target_Stat : 143|8@0+ (1,0) [0|255] "" FUSION
 SG_ EWP3_RPM_ActlVal_Stat : 151|8@0+ (1,0) [0|255] "" FUSION
 SG_ EWP3_Curr_Stat : 159|8@0+ (0.1,0) [0|25.5] "A" FUSION
 SG_ EWP3_OverCurr_Error : 167|2@0+ (1,0) [0|3] "" FUSION
 SG_ EWP3_OverTemp_Error : 165|2@0+ (1,0) [0|2] "" FUSION
 SG_ EWP3_SupVolt_Error : 163|2@0+ (1,0) [0|2] "" FUSION
 SG_ EWP3_RsErr_EWP : 161|1@0+ (1,0) [0|1] "" FUSION
 SG_ EWP3_Temp_Stat : 175|8@0+ (1,-50) [-50|205] "Deg" FUSION
 SG_ EWP3_Volt_Stat : 183|8@0+ (0.1,0) [0|25.5] "V" FUSION
 SG_ EXV2_Rsp_Pos : 191|16@0+ (1,0) [0|576] "" FUSION
 SG_ EXV2_Rsp_Fault_Stat : 207|4@0+ (1,0) [0|15] "" FUSION
 SG_ EXV2_Rsp_CurInit_Stat : 203|2@0+ (1,0) [0|3] "" FUSION
 SG_ EXV2_Rsp_OvrTemp_Warn : 201|2@0+ (1,0) [0|3] "" FUSION
 SG_ EXV2_Rsp_Volt_Stat : 215|2@0+ (1,0) [0|3] "" FUSION
 SG_ EXV2_RsErr_EXV : 213|1@0+ (1,0) [0|1] "" FUSION
 SG_ EXV2_Rsp_Run_Stat : 212|1@0+ (1,0) [0|1] "" FUSION
 SG_ CCV4_Fault_Signal : 211|4@0+ (1,0) [0|15] "" FUSION
 SG_ BDC_1_Rsp_Comm_Err : 223|1@0+ (1,0) [0|1] "" FUSION
 SG_ CCV4_TempWarn : 222|1@0+ (1,0) [0|1] "" FUSION
 SG_ CCV4_Rsp_Comm_Err : 221|1@0+ (1,0) [0|1] "" FUSION
 SG_ CCV4_MotorStatus : 220|1@0+ (1,0) [0|1] "" FUSION
 SG_ CCV4_RespPos : 219|2@0+ (1,0) [0|3] "" FUSION
 SG_ CCV4_voltageErr : 217|2@0+ (1,0) [0|3] "" FUSION
 SG_ BDC_1_Fault_Signal : 231|4@0+ (1,0) [0|15] "" FUSION
 SG_ BDC_1_voltageErr : 227|2@0+ (1,0) [0|3] "" FUSION
 SG_ BDC_1_TempWarn : 225|1@0+ (1,0) [0|1] "" FUSION
 SG_ BDC_1_MotorStatus : 224|1@0+ (1,0) [0|1] "" FUSION
 SG_ BDC_1_RespPos : 239|8@0+ (0.392,0) [0|99.96] "" FUSION

CM_ BO_ 550 "Routing from LIN_DR1,2,3";
CM_ BO_ 552 "Routing from LIN_FR1";
CM_ BO_ 596 "Routing from LIN_FR2";
CM_ SG_ 550 RLS_LightSnrErr "LightSensorError";
CM_ SG_ 550 RLS_RainSnrErr "RainSensorError";
CM_ SG_ 550 RLS_Lamp_Sta "Lampstatus";
CM_ SG_ 550 RLS_RainSnrWiperCmd "RainSensorWiperCommand";
CM_ SG_ 550 CSW_TurnSw_Sta "CSW_TurnSw_Sta_CANbus (ZONE_DR BCM)";
CM_ SG_ 550 CSW_RWasSW_Sta "CSW_RWasherSW_Sta";
CM_ SG_ 550 CSW_FWasSw_Sta "CSW_FWasherSW_Sta";
CM_ SG_ 550 CSW_PassSW_Sta "CSW_PassSW_Sta";
CM_ SG_ 550 CSW_DimSw "CSW_DimSw";
CM_ SG_ 550 CSW_RWipIntSw_Sta "CSW_RWipSW_Sta";
CM_ SG_ 550 SWC_CANCEL_Sta "CANCEL Button Status";
CM_ SG_ 550 SWC_ACC_Sta "ACC Button Status";
CM_ SG_ 550 SWC_Distance_Sta "Distance Button Status";
CM_ SG_ 550 SWC_Down_Sta "DOWN Button Status";
CM_ SG_ 550 SWC_RegenUp "Regen Up";
CM_ SG_ 550 SWC_Left_Sta "Seek Backward track/radio";
CM_ SG_ 550 SWC_mode_Sta "Mode Button Status";
CM_ SG_ 550 SWC_Res_Up_Sta "Res up Button Status";
CM_ SG_ 550 SWC_RegenDown "Regen Down";
CM_ SG_ 550 SWC_Right_Sta "Seek Forward track/radio";
CM_ SG_ 550 SWC_Set_down_Sta "SET down Button Status";
CM_ SG_ 550 SWC_Trip_Sta "Trip Button Status";
CM_ SG_ 550 SWC_Up_Sta "UP Button Status";
CM_ SG_ 550 SWC_VR_Sta "VR Button Status";
CM_ SG_ 550 SWC_Undefined_Sta "Undefined button Status";
CM_ SG_ 550 SWC_LKA_Sta "LKA Button Status";
CM_ SG_ 550 L_Pas_Wdw_Obs_InhibitSts "Obstacle inhibit status";
CM_ SG_ 550 L_Drv_Wdw_RRD_Switch "Passager switch status of Rear Right window";
CM_ SG_ 550 L_Drv_Wdw_RLD_Switch "Passager switch status of Rear Left window";
CM_ SG_ 550 L_Pas_Wdw_OD_Sts "Obstacle detection status";
CM_ SG_ 550 L_Pas_Wdw_Init "ECU Initialization";
CM_ SG_ 550 L_Pas_OverHeat_Protect "OverHeat Protect";
CM_ SG_ 550 L_Pas_Motor_Relay_Error "Motor relay Error";
CM_ SG_ 550 L_Pas_Motor_Ripple_Error "Motor ripple Error";
CM_ SG_ 550 L_Drv_Wdw_Pas_Switch "Passager switch status of driver window";
CM_ SG_ 550 L_Pas_Val_Wdw_Opened "Window Opened Value";
CM_ SG_ 550 L_Pas_Wdw_PositionSts "Position status of passager window";
CM_ SG_ 550 L_Pas_Wdw_LocalSwitch "Local switch status of passager window";
CM_ SG_ 550 L_Pas_Wdw_Running_Sts "Running status of passager window";
CM_ SG_ 550 L_Power_Status "Power_Status";
CM_ SG_ 550 FAPWL_01_LIN_Response_Error "LIN Communication ERROR";
CM_ SG_ 550 L_Drv_Wdw_Obs_InhibitSts "Obstacle inhibit status";
CM_ SG_ 550 L_Drv_Wdw_OD_Sts "Obstacle detection status";
CM_ SG_ 550 L_Drv_Wdw_Init "ECU Initialization";
CM_ SG_ 550 L_Drv_OverHeat_Protect "OverHeat Protect";
CM_ SG_ 550 L_Drv_Motor_Relay_Error "Motor relay Error";
CM_ SG_ 550 L_Drv_Motor_Ripple_Error "Motor ripple Error";
CM_ SG_ 550 L_Drv_Val_Wdw_Opened "Window Opened Value";
CM_ SG_ 550 L_Drv_Wdw_PositionSts "Position status of driver window";
CM_ SG_ 550 L_Drv_Wdw_LocalSwitch "Local switch status of driver window";
CM_ SG_ 550 L_Drv_Wdw_Running_Sts "Running status of driver window";
CM_ SG_ 550 L_RLD_Wdw_Init "ECU Initialization";
CM_ SG_ 550 L_RRD_Val_Wdw_Opened "Window Opened Value";
CM_ SG_ 550 L_RRD_Wdw_PositionSts "Position status of Rear Right window";
CM_ SG_ 550 L_RRD_Wdw_Obs_InhibitSts "Obstacle inhibit status";
CM_ SG_ 550 L_RRD_Wdw_OD_Sts "Obstacle detection status";
CM_ SG_ 550 L_RRD_Wdw_Init "ECU Initialization";
CM_ SG_ 550 L_RRD_OverHeat_Protect "OverHeat Protect";
CM_ SG_ 550 L_RRD_Motor_Relay_Error "Motor relay Error";
CM_ SG_ 550 L_RRD_Motor_Ripple_Error "Motor ripple Error";
CM_ SG_ 550 L_RRD_Wdw_LocalSwitch "Local switch status of Rear Right window";
CM_ SG_ 550 L_RRD_Wdw_Running_Sts "Running status of Rear Right window";
CM_ SG_ 550 RAPWL_01_LIN_Response_Error "LIN Communication ERROR";
CM_ SG_ 550 L_RLD_Wdw_Obs_InhibitSts "Obstacle inhibit status";
CM_ SG_ 550 L_RLD_Wdw_OD_Sts "Obstacle detection status";
CM_ SG_ 550 L_RLD_Val_Wdw_Opened "Window Opened Value";
CM_ SG_ 550 L_RLD_OverHeat_Protect "OverHeat Protect";
CM_ SG_ 550 L_RLD_Motor_Relay_Error "Motor relay Error";
CM_ SG_ 550 L_RLD_Motor_Ripple_Error "Motor ripple Error";
CM_ SG_ 550 L_RLD_Wdw_PositionSts "Position status of Rear Left window";
CM_ SG_ 550 L_RLD_Wdw_LocalSwitch "Local switch status of Rear Left window";
CM_ SG_ 550 L_RLD_Wdw_Running_Sts "Running status of Rear Left window";
CM_ SG_ 550 SWC2_R_Right_Sta "R Right Status SWC gen2";
CM_ SG_ 550 SWC2_R_ScrollUp_Sta "R Scroll Up Status SWC gen2";
CM_ SG_ 550 SWC2_R_ScrollPress_Sta "R Scroll Press Status SWC gen2";
CM_ SG_ 550 SWC2_R_ScrollDown_Sta "R Scroll Down Status SWC gen2";
CM_ SG_ 550 SWC2_R_Left_Sta "R Left Status SWC gen2";
CM_ SG_ 550 SWC2_R_VR_Sta "R VR Status SWC gen2";
CM_ SG_ 550 SWC2_R_PageSwitch_Sta "R PageSwitch Status SWC gen2";
CM_ SG_ 550 SWC2_R_Customize_Sta "R Customize Status SWC gen2";
CM_ SG_ 550 SWC2_L_Left_Sta "L Left Status SWC gen2";
CM_ SG_ 550 SWC2_L_ScrollUp_Sta "L Scroll Up Status SWC gen2";
CM_ SG_ 550 SWC2_L_ScrollPress_Sta "L Scroll press Status SWC gen2";
CM_ SG_ 550 SWC2_L_ScrollDown_Sta "L Scroll Down Status SWC gen2";
CM_ SG_ 550 SWC2_L_Right_Sta "L Right Status SWC gen2";
CM_ SG_ 550 SWC2_L_RegenUp_Sta "L Regen Up Status SWC gen2";
CM_ SG_ 550 SWC2_L_ADAS_Sta "L ADAS Status SWC gen2";
CM_ SG_ 550 SWC2_L_Home_Sta "L Home Status SWC gen2";
CM_ SG_ 550 SWC2_ResponseError "ResponseError SWC gen2";
CM_ SG_ 550 SWC2_R_RegenDown_Sta "R Regen Down Status SWC gen2";
CM_ SG_ 550 SWC2_L_DriveMode_Sta "L Drive Mode Status SWC gen2";
CM_ SG_ 550 HVPO_OtltCvrStsRw_Sta "High Voltage Power Outlet Cover Status Raw";
CM_ SG_ 805 HornSW "Horn Switch status";
CM_ SG_ 805 AllLockSta "All Door Lock";
CM_ SG_ 805 AutoLightSW "LightActivation";
CM_ SG_ 805 BrakeLampFail "BrakeLamp Failed";
CM_ SG_ 805 DrLockSta "Driver Side Door Lock Staus";
CM_ SG_ 805 WiperSWPos "WiperSwitchPosition";
CM_ SG_ 805 RRTurnLampC "Rear Right TurnLamp Current";
CM_ SG_ 805 RLTurnLampC "Rear Left TurnLamp Current";
CM_ SG_ 805 Wip_Speed "Wip_Speed";
CM_ SG_ 805 MIRROR_FOLD_SW "MIRROR_FOLD_SW";
CM_ SG_ 805 PsLockSta "Passenger Side Door Lock Status";
CM_ SG_ 805 RLLockSta "Rear Left Door Lock Status";
CM_ SG_ 805 RLS_Exist "RLS_Exist";
CM_ SG_ 805 RRLockSta "Rear Right Door Lock Status";
CM_ SG_ 805 RWiperAS "Rear Wiper AS";
CM_ SG_ 805 RWiperProtection "Rear Wiper Protection";
CM_ SG_ 805 WiperZeroPosSW "WiperZeroPositionSwitch";
CM_ SG_ 805 RLTurnLPErr "Rear Left Turn Lamp Err";
CM_ SG_ 805 RRTurnLPErr "Rear Right Turn Lamp Err";
CM_ SG_ 805 ZDR_THCM_IntakeFail_Sta "Intake Motor Fail Signal";
CM_ SG_ 805 ZDR_THCM_LINACT1_Sta "LIN ACT1 Fail Signal";
CM_ SG_ 805 ZDR_THCM_LINACT2_Sta "LIN ACT2 Fail Signal";
CM_ SG_ 805 ZDR_THCM_LINACT3_Sta "LIN ACT3 Fail Signal";
CM_ SG_ 805 ZDR_THCM_LINACT4_Sta "LIN ACT4 Fail Signal";
CM_ SG_ 805 ZDR_THCM_LINACT5_Sta "LIN ACT5 Fail Signal";
CM_ SG_ 805 ZDR_THCM_ModeFail_Sta "Mode Motor Fail Signal";
CM_ SG_ 552 AGS_Actual_Position "Position feedback from the actuator";
CM_ SG_ 552 AGS_Low_Voltage_Error "Feedback for over/under voltage error";
CM_ SG_ 552 AGS_Temperature_Error "Feedback for overtemprature error";
CM_ SG_ 552 AGS_Sensor_Error "Feedback of Shutter position sensor fault";
CM_ SG_ 552 AGS_Electrical_Error "Feedback of electrical error";
CM_ SG_ 552 AGS_Calibration_Indicated "Feedback of Shutter calibration indicated";
CM_ SG_ 552 AGS_Calibration_Active "Feedback of  Shutter calibration active";
CM_ SG_ 552 AGS_Actuator_Fault "Feedback of Shutter actuator fault";
CM_ SG_ 552 AGS_Actuator_Blocked "Feedback of Shutter blocked";
CM_ SG_ 552 AGS_LINResponse_Error "Feedback of Response error bit";
CM_ SG_ 552 ION_IONErr_Sta "ION_IONErr_Sta";
CM_ SG_ 552 ION_IONRespErr_Sta "ION_IONRespErr_Sta";
CM_ SG_ 552 ION_ION_Sta "ION_ION_Sta";
CM_ SG_ 552 FGS_LifeHole3_Sta "Channel 3 air fragrance  available time.";
CM_ SG_ 552 FGS_LifeHole2_Sta "Channel 2 air fragrance  available time.";
CM_ SG_ 552 FGS_LifeHole1_Sta "Channel 1 air fragrance  available time.";
CM_ SG_ 552 FGS_Channel3TypeRsp_Sta "The signal indicates the type of channel 3";
CM_ SG_ 552 FGS_Channel2TypeRsp_Sta "The signal indicates the type of channel 2";
CM_ SG_ 552 FGS_Channel1TypeRsp_Sta "The signal indicates the type of channel 1";
CM_ SG_ 552 FGS_BlowerErr_Sta "This signal indicates Blower failure";
CM_ SG_ 552 FGS_IntenRsp_Sta "The signal indicates the wind content level of FGS";
CM_ SG_ 552 FGS_MotorErr_Sta "This signal indicates Motor failure";
CM_ SG_ 552 FGS_TypRsp_Sta "The signal indicates the channel of FG";
CM_ SG_ 552 FGS_LINResponseErr_Sta "This signal indicates if FG is in LIN error status or not.
If theLIN slave detects the response error,LIN Error signal should be set";
CM_ SG_ 552 FGS_StsRsp_Sta "The signal indicate FG working status";
CM_ SG_ 552 FGS_Channel_Type_Sta "The signal indicates the type of channel";
CM_ SG_ 552 FGS_Channel_Index_Sta "The signal indicates the index channel of FGS";
CM_ SG_ 796 FRTurnLampC "Front Right TurnLamp Current";
CM_ SG_ 796 FLTurnLampC "Front Left TurnLamp Current";
CM_ SG_ 796 ChargeInletLockSta "Charge Inlet lock signal status";
CM_ SG_ 796 FWiperAS "Front Wiper Auto Stop";
CM_ SG_ 796 FWiperProtection "Front Wiper Protection";
CM_ SG_ 796 CCM_SpdCmd "Target Speed of Compressor";
CM_ SG_ 796 CompProEN "Compressor protect enable";
CM_ SG_ 796 AGS_Position_Request "AGS Position Request from Zone FR to AGS";
CM_ SG_ 796 AGS_Calibration_Enabled "Command for start calibration sequence (rising edge)";
CM_ SG_ 796 TrailerModeSta "Trailer Mode Status";
CM_ SG_ 796 TrailerCheck "Trailer Mode Check";
CM_ SG_ 796 ZFR_BCM_ChargerDoorSW_Sta "Charger Door Switch Status";
CM_ SG_ 796 FLPosLPErr "Front Left PositionLamp Error";
CM_ SG_ 796 FLTurnLPErr "Front Left Turn Lamp Error";
CM_ SG_ 796 FLTurn_Light_Warning "FLTurn Light_Warning";
CM_ SG_ 796 FRPosLPErr "Front Right PositionLamp Error";
CM_ SG_ 796 FRTurnLPErr "Front Right Turn Lamp Error";
CM_ SG_ 796 FRTurn_Light_Warning "FRTurn Light_Warning";
CM_ SG_ 796 LADBErr "Left ADB Error";
CM_ SG_ 796 LADB_Hibeam_Indication "LADB_Hibeam_Indication";
CM_ SG_ 796 LADB_Operation_Status "LADB_Operation_Status";
CM_ SG_ 796 LADB_Warning "LADB_Warning";
CM_ SG_ 796 LAHB_Warning "LAHB_Warning";
CM_ SG_ 796 LDRLErr "Left DRL Error";
CM_ SG_ 796 LDRL_Warning "LDRL_Warning";
CM_ SG_ 796 LH_BeamErr "Left High Beam Error";
CM_ SG_ 796 LLB_Warning "LLB_Warning";
CM_ SG_ 796 LL_BeamErr "Left Low Beam Error";
CM_ SG_ 796 Lposition_Lamp_Warning "LPosition Lamp_Warning";
CM_ SG_ 796 RADBErr "Right ADB Error";
CM_ SG_ 796 RADB_Hibeam_Indication "RADB_Hibeam_Indication";
CM_ SG_ 796 RADB_Operation_Status "RADB_Operation_Status";
CM_ SG_ 796 RADB_Warning "RADB_Warning";
CM_ SG_ 796 RAHB_Warning "RAHB_Warning";
CM_ SG_ 796 RDRLErr "Right DRL Error";
CM_ SG_ 796 RDRL_Warning "RDRL_Warning";
CM_ SG_ 796 RH_BeamErr "Right High Beam Error";
CM_ SG_ 796 RLB_Warning "RLB_Warning";
CM_ SG_ 796 RL_BeamErr "Right Low Beam Error";
CM_ SG_ 796 Rposition_Lamp_Warning "RPosition Lamp_Warning";
CM_ SG_ 796 ZFR_THCM_CLEVentActY_Sta "Act Y Status of Electric Vent on CTR-LH";
CM_ SG_ 796 ZFR_THCM_CLEVentActZ_Sta "Act Z Status of Electric Vent on CTR-LH";
CM_ SG_ 796 ZFR_THCM_CREVentActY_Sta "Act Y Status of Electric Vent on CTR-RH";
CM_ SG_ 796 ZFR_THCM_CREVentActZ_Sta "Act Z Status of Electric Vent on CTR-RH";
CM_ SG_ 796 ZFR_THCM_LEVentActY_Sta "Act Y Status of Electric Vent on LH";
CM_ SG_ 796 ZFR_THCM_LEVentActZ_Sta "Act Z Status of Electric Vent on LH";
CM_ SG_ 796 ZFR_THCM_REVentActY_Sta "Act Y Status of Electric Vent on RH";
CM_ SG_ 796 ZFR_THCM_REVentActZ_Sta "Act Z Status of Electric Vent on RH";
CM_ SG_ 796 ZFR_EChrg_Active_Sta "EChrgPort active State";
CM_ SG_ 796 ZFR_EChrg_Sys_Sta "EChrgPort system State";
CM_ SG_ 796 ZFR_EChrg_OperationDeny_Cmd "EChrgPort operation deny";
CM_ SG_ 796 ZFR_SYS_HWMismatchFW_Sta "HW mismatched FW";
CM_ SG_ 796 ZFR_BCM_HRLTurnLPNormal_Sta "Left Rear Turn Lamp Normal flag";
CM_ SG_ 796 ZFR_BCM_HRRTurnLPHNormal_Sta "Right Rear Turn Lamp Normal flag";
CM_ SG_ 796 ZFR_EChrg_WashMode_Sta "EChrgPort Wash mode";
CM_ SG_ 796 ZFR_THCM_EACV1Stallpos_Sta "ZFR_THCM_EVAC1Stallpos_Sta";
CM_ SG_ 796 ZFR_THCM_EACV2Stallpos_Sta "ZFR_THCM_EVAC2Stallpos_Sta";
CM_ SG_ 796 ZFR_THCM_EACV3Stallpos_Sta "ZFR_THCM_EVAC3Stallpos_Sta";
CM_ SG_ 796 ZFR_THCM_EACV4Stallpos_Sta "ZFR_THCM_EVAC4Stallpos_Sta";
CM_ SG_ 796 ZFR_THCM_EACV5Stallpos_Sta "ZFR_THCM_EVAC5Stallpos_Sta";
CM_ SG_ 796 ZFR_THCM_EACV6Stallpos_Sta "ZFR_THCM_EVAC6Stallpos_Sta";
CM_ SG_ 796 ZFR_THCM_EACV7Stallpos_Sta "ZFR_THCM_EVAC7Stallpos_Sta";
CM_ SG_ 796 ZFR_THCM_EACV8Stallpos_Sta "ZFR_THCM_EVAC8Stallpos_Sta";
CM_ SG_ 593 P_CommandToBCM "DKC command to BCM";
CM_ SG_ 593 P_DKey_Welcome "Digital key Welcome Area";
CM_ SG_ 593 P_DKey_Area_LockUnlock "Digital key  Lock and Unlock Area";
CM_ SG_ 593 P_DKey_Area_PS "Digital key PS Area";
CM_ SG_ 593 P_UID_LowPower "DKC UID low battery display";
CM_ SG_ 593 P_CommandToPTG "DKC command to PTG";
CM_ SG_ 593 P_Dkey_Show_IVI "Digital key IVI Show";
CM_ SG_ 593 P_KeyMode "DKC Key control Mode";
CM_ SG_ 593 P_DKey_Area_PTG "Digital key PTG Area";
CM_ SG_ 593 P_KeyMiss "DKC Key Miss";
CM_ SG_ 593 DKC_Re_VehData "Request for Remote VehData by DKC";
CM_ SG_ 593 DKC_P_UID_BatVolt "DKC UID battery voltage";
CM_ SG_ 593 DKC_P_BLE_RSSI "DKC BLE RSSI value";
CM_ SG_ 593 DKC_ParkingMode_Cmd "DKC Parking Mode";
CM_ SG_ 593 DKC_PDkeyAreaRAPS_Sta "DKC RAPS Area";
CM_ SG_ 593 DKC_KeyNum_Sta "DKC current key number";
CM_ SG_ 593 DKC_KeyType_Sta "DKC current key type";
CM_ SG_ 594 Random_Number_X "DKC Random Number X";
CM_ SG_ 594 EncryptionDATA_64_127 "DKC Encryption DATA 64_127";
CM_ SG_ 594 EncryptionDATA_0_63 "DKC Encryption DATA 0-63";
BA_DEF_ BO_ "GenMsgSendType" ENUM "Cycle","NoMsgSendType","IfActive","Event","CA","CE";
BA_DEF_ BO_ "GenMsgNrOfRepetition" INT 0 0;
BA_DEF_ BO_ "GenMsgILSupport" ENUM "No","Yes";
BA_DEF_ BO_ "GenMsgCycleTime" INT 0 0;
BA_DEF_ BO_ "DiagResponse" ENUM "No","Yes";
BA_DEF_ BO_ "DiagRequest" ENUM "No","Yes";
BA_DEF_ BO_ "NmMessage" ENUM "No","Yes";
BA_DEF_ BO_ "VFrameFormat" ENUM "StandardCAN","ExtendedCAN","reserved","reserved","reserved","reserved","reserved","reserved","reserved","reserved","reserved","reserved","reserved","reserved","StandardCAN_FD","ExtendedCAN_FD";
BA_DEF_ BO_ "DataID" STRING ;
BA_DEF_ BO_ "DoIPLogicalAddress" STRING ;
BA_DEF_ BO_ "CANFD_BRS" ENUM "0","1";
BA_DEF_ BO_ "GenMsgRequestable" INT 0 1;
BA_DEF_ SG_ "GenSigInvalidValue" HEX 0 0;
BA_DEF_ SG_ "GenSigStartValue" HEX 0 0;
BA_DEF_ SG_ "GenSigInactiveValue" HEX 0 0;
BA_DEF_ SG_ "GenSigRoutingTimeoutValue_String" STRING ;
BA_DEF_ SG_ "DataCenterDataType" STRING ;
BA_DEF_ SG_ "GenSigRoutingTimeoutValue" HEX 0 0;
BA_DEF_ SG_ "GenSigSendType" ENUM "Cycle","OnWrite","OnWriteWithRepetition","OnChange","OnChangeWithRepetition","IfActive","IfActiveWithRepetition","NoSigSendType","vector_leerstring";
BA_DEF_ SG_ "SigType" ENUM "Default","Range","RangeSigned","ASCII","Discrete","Control","ReferencePGN","DTC","StringDelimiter","StringLength","StringLengthControl","MessageCounter","MessageChecksum";
BA_DEF_ SG_ "GenSigILSupport" ENUM "No","Yes";
BA_DEF_DEF_ "GenMsgSendType" "Cycle";
BA_DEF_DEF_ "GenMsgNrOfRepetition" 0;
BA_DEF_DEF_ "GenMsgILSupport" "Yes";
BA_DEF_DEF_ "GenMsgCycleTime" 100;
BA_DEF_DEF_ "DiagResponse" "No";
BA_DEF_DEF_ "DiagRequest" "No";
BA_DEF_DEF_ "NmMessage" "No";
BA_DEF_DEF_ "VFrameFormat" "StandardCAN";
BA_DEF_DEF_ "DataID" "";
BA_DEF_DEF_ "DoIPLogicalAddress" "";
BA_DEF_DEF_ "CANFD_BRS" "1";
BA_DEF_DEF_ "GenMsgRequestable" 1;
BA_DEF_DEF_ "GenSigInvalidValue" 0;
BA_DEF_DEF_ "GenSigStartValue" 0;
BA_DEF_DEF_ "GenSigInactiveValue" 0;
BA_DEF_DEF_ "GenSigRoutingTimeoutValue_String" "";
BA_DEF_DEF_ "DataCenterDataType" "";
BA_DEF_DEF_ "GenSigRoutingTimeoutValue" 0;
BA_DEF_DEF_ "GenSigSendType" "Cycle";
BA_DEF_DEF_ "SigType" "Default";
BA_DEF_DEF_ "GenSigILSupport" "Yes";
BA_ "GenMsgNrOfRepetition" BO_ 550 1;
BA_ "GenMsgCycleTime" BO_ 550 200;
BA_ "GenMsgSendType" BO_ 550 5;
BA_ "VFrameFormat" BO_ 550 14;
BA_ "GenMsgNrOfRepetition" BO_ 805 1;
BA_ "GenMsgSendType" BO_ 805 5;
BA_ "VFrameFormat" BO_ 805 14;
BA_ "VFrameFormat" BO_ 552 14;
BA_ "GenMsgNrOfRepetition" BO_ 796 1;
BA_ "GenMsgSendType" BO_ 796 5;
BA_ "VFrameFormat" BO_ 796 14;
BA_ "GenMsgNrOfRepetition" BO_ 593 1;
BA_ "GenMsgSendType" BO_ 593 5;
BA_ "VFrameFormat" BO_ 593 14;
BA_ "GenMsgNrOfRepetition" BO_ 594 1;
BA_ "GenMsgSendType" BO_ 594 5;
BA_ "VFrameFormat" BO_ 594 14;
BA_ "VFrameFormat" BO_ 596 14;
BA_ "GenSigRoutingTimeoutValue_String" SG_ 550 RLS_LIN_Resp_Err "0x1";
BA_ "GenSigRoutingTimeoutValue" SG_ 550 RLS_LIN_Resp_Err 1;
BA_ "GenSigSendType" SG_ 550 RLS_LIN_Resp_Err 3;
BA_ "GenSigSendType" SG_ 550 RLS_LightSnrErr 3;
BA_ "GenSigSendType" SG_ 550 RLS_RainSnrErr 3;
BA_ "GenSigRoutingTimeoutValue_String" SG_ 550 CSW_resp_error "0x1";
BA_ "GenSigRoutingTimeoutValue" SG_ 550 CSW_resp_error 1;
BA_ "GenSigSendType" SG_ 550 CSW_resp_error 3;
BA_ "GenSigSendType" SG_ 550 RLS_Lamp_Sta 3;
BA_ "GenSigSendType" SG_ 550 RLS_RainSnrWiperCmd 3;
BA_ "GenSigInvalidValue" SG_ 550 CSW_FWipSw_Sta 7;
BA_ "GenSigRoutingTimeoutValue_String" SG_ 550 CSW_FWipSw_Sta "0x7";
BA_ "GenSigRoutingTimeoutValue" SG_ 550 CSW_FWipSw_Sta 7;
BA_ "GenSigSendType" SG_ 550 CSW_FWipSw_Sta 3;
BA_ "GenSigInvalidValue" SG_ 550 CSW_TurnSw_Sta 3;
BA_ "GenSigRoutingTimeoutValue_String" SG_ 550 CSW_TurnSw_Sta "0x3";
BA_ "GenSigRoutingTimeoutValue" SG_ 550 CSW_TurnSw_Sta 3;
BA_ "GenSigSendType" SG_ 550 CSW_TurnSw_Sta 3;
BA_ "GenSigInvalidValue" SG_ 550 CSW_RWasSW_Sta 3;
BA_ "GenSigRoutingTimeoutValue_String" SG_ 550 CSW_RWasSW_Sta "0x3";
BA_ "GenSigRoutingTimeoutValue" SG_ 550 CSW_RWasSW_Sta 3;
BA_ "GenSigSendType" SG_ 550 CSW_RWasSW_Sta 3;
BA_ "GenSigInvalidValue" SG_ 550 CSW_FWasSw_Sta 3;
BA_ "GenSigRoutingTimeoutValue_String" SG_ 550 CSW_FWasSw_Sta "0x3";
BA_ "GenSigRoutingTimeoutValue" SG_ 550 CSW_FWasSw_Sta 3;
BA_ "GenSigSendType" SG_ 550 CSW_FWasSw_Sta 3;
BA_ "GenSigSendType" SG_ 550 CSW_PassSW_Sta 3;
BA_ "GenSigSendType" SG_ 550 CSW_DimSw 3;
BA_ "GenSigInvalidValue" SG_ 550 CSW_RWipIntSw_Sta 3;
BA_ "GenSigRoutingTimeoutValue_String" SG_ 550 CSW_RWipIntSw_Sta "0x3";
BA_ "GenSigRoutingTimeoutValue" SG_ 550 CSW_RWipIntSw_Sta 3;
BA_ "GenSigSendType" SG_ 550 CSW_RWipIntSw_Sta 3;
BA_ "GenSigSendType" SG_ 550 SWC_Drivemode_Sta 3;
BA_ "GenSigSendType" SG_ 550 SWC_CANCEL_Sta 3;
BA_ "GenSigSendType" SG_ 550 SWC_ACC_Sta 3;
BA_ "GenSigRoutingTimeoutValue_String" SG_ 550 SWC_A_Resp_Err "0x1";
BA_ "GenSigRoutingTimeoutValue" SG_ 550 SWC_A_Resp_Err 1;
BA_ "GenSigSendType" SG_ 550 SWC_A_Resp_Err 3;
BA_ "GenSigSendType" SG_ 550 SWC_Distance_Sta 3;
BA_ "GenSigSendType" SG_ 550 SWC_Down_Sta 3;
BA_ "GenSigSendType" SG_ 550 SWC_RegenUp 3;
BA_ "GenSigSendType" SG_ 550 SWC_Left_Sta 3;
BA_ "GenSigSendType" SG_ 550 SWC_mode_Sta 3;
BA_ "GenSigSendType" SG_ 550 SWC_resp_error 3;
BA_ "GenSigSendType" SG_ 550 SWC_Res_Up_Sta 3;
BA_ "GenSigSendType" SG_ 550 SWC_RegenDown 3;
BA_ "GenSigSendType" SG_ 550 SWC_Right_Sta 3;
BA_ "GenSigSendType" SG_ 550 SWC_Set_down_Sta 3;
BA_ "GenSigSendType" SG_ 550 SWC_Trip_Sta 3;
BA_ "GenSigSendType" SG_ 550 SWC_Up_Sta 3;
BA_ "GenSigSendType" SG_ 550 SWC_VR_Sta 3;
BA_ "GenSigSendType" SG_ 550 SWC_Undefined_Sta 3;
BA_ "GenSigSendType" SG_ 550 SWC_LKA_Sta 3;
BA_ "GenSigSendType" SG_ 550 L_Pas_Wdw_Obs_InhibitSts 3;
BA_ "GenSigSendType" SG_ 550 L_Drv_Wdw_RRD_Switch 3;
BA_ "GenSigSendType" SG_ 550 L_Drv_Wdw_RLD_Switch 3;
BA_ "GenSigSendType" SG_ 550 L_Pas_Wdw_OD_Sts 3;
BA_ "GenSigSendType" SG_ 550 L_Pas_Wdw_Init 3;
BA_ "GenSigSendType" SG_ 550 L_Pas_OverHeat_Protect 3;
BA_ "GenSigSendType" SG_ 550 L_Pas_Motor_Relay_Error 3;
BA_ "GenSigSendType" SG_ 550 L_Pas_Motor_Ripple_Error 3;
BA_ "GenSigSendType" SG_ 550 L_Drv_Wdw_Pas_Switch 3;
BA_ "GenSigInvalidValue" SG_ 550 L_Pas_Val_Wdw_Opened 127;
BA_ "GenSigStartValue" SG_ 550 L_Pas_Val_Wdw_Opened 127;
BA_ "GenSigRoutingTimeoutValue_String" SG_ 550 L_Pas_Val_Wdw_Opened "0x7F";
BA_ "GenSigInactiveValue" SG_ 550 L_Pas_Val_Wdw_Opened 127;
BA_ "GenSigRoutingTimeoutValue" SG_ 550 L_Pas_Val_Wdw_Opened 127;
BA_ "DataCenterDataType" SG_ 550 L_Pas_Val_Wdw_Opened "Varchar(10)";
BA_ "GenSigInvalidValue" SG_ 550 L_Pas_Wdw_PositionSts 3;
BA_ "GenSigStartValue" SG_ 550 L_Pas_Wdw_PositionSts 3;
BA_ "GenSigRoutingTimeoutValue_String" SG_ 550 L_Pas_Wdw_PositionSts "0x3";
BA_ "GenSigInactiveValue" SG_ 550 L_Pas_Wdw_PositionSts 3;
BA_ "GenSigRoutingTimeoutValue" SG_ 550 L_Pas_Wdw_PositionSts 3;
BA_ "GenSigSendType" SG_ 550 L_Pas_Wdw_PositionSts 3;
BA_ "DataCenterDataType" SG_ 550 L_Pas_Wdw_PositionSts "Varchar(20)";
BA_ "GenSigSendType" SG_ 550 L_Pas_Wdw_LocalSwitch 3;
BA_ "GenSigSendType" SG_ 550 L_Pas_Wdw_Running_Sts 3;
BA_ "GenSigSendType" SG_ 550 L_Power_Status 3;
BA_ "GenSigRoutingTimeoutValue_String" SG_ 550 FAPWL_01_LIN_Response_Error "0x1";
BA_ "GenSigRoutingTimeoutValue" SG_ 550 FAPWL_01_LIN_Response_Error 1;
BA_ "GenSigSendType" SG_ 550 FAPWL_01_LIN_Response_Error 3;
BA_ "GenSigSendType" SG_ 550 L_Drv_Wdw_Obs_InhibitSts 3;
BA_ "GenSigSendType" SG_ 550 L_Drv_Wdw_OD_Sts 3;
BA_ "GenSigSendType" SG_ 550 L_Drv_Wdw_Init 3;
BA_ "GenSigSendType" SG_ 550 L_Drv_OverHeat_Protect 3;
BA_ "GenSigSendType" SG_ 550 L_Drv_Motor_Relay_Error 3;
BA_ "GenSigSendType" SG_ 550 L_Drv_Motor_Ripple_Error 3;
BA_ "GenSigInvalidValue" SG_ 550 L_Drv_Val_Wdw_Opened 127;
BA_ "GenSigStartValue" SG_ 550 L_Drv_Val_Wdw_Opened 127;
BA_ "GenSigRoutingTimeoutValue_String" SG_ 550 L_Drv_Val_Wdw_Opened "0x7F";
BA_ "GenSigInactiveValue" SG_ 550 L_Drv_Val_Wdw_Opened 127;
BA_ "GenSigRoutingTimeoutValue" SG_ 550 L_Drv_Val_Wdw_Opened 127;
BA_ "DataCenterDataType" SG_ 550 L_Drv_Val_Wdw_Opened "Varchar(10)";
BA_ "GenSigInvalidValue" SG_ 550 L_Drv_Wdw_PositionSts 3;
BA_ "GenSigStartValue" SG_ 550 L_Drv_Wdw_PositionSts 3;
BA_ "GenSigRoutingTimeoutValue_String" SG_ 550 L_Drv_Wdw_PositionSts "0x3";
BA_ "GenSigInactiveValue" SG_ 550 L_Drv_Wdw_PositionSts 3;
BA_ "GenSigRoutingTimeoutValue" SG_ 550 L_Drv_Wdw_PositionSts 3;
BA_ "GenSigSendType" SG_ 550 L_Drv_Wdw_PositionSts 3;
BA_ "DataCenterDataType" SG_ 550 L_Drv_Wdw_PositionSts "Varchar(20)";
BA_ "GenSigSendType" SG_ 550 L_Drv_Wdw_LocalSwitch 3;
BA_ "GenSigSendType" SG_ 550 L_Drv_Wdw_Running_Sts 3;
BA_ "GenSigSendType" SG_ 550 L_RLD_Wdw_Init 3;
BA_ "GenSigInvalidValue" SG_ 550 L_RRD_Val_Wdw_Opened 127;
BA_ "GenSigStartValue" SG_ 550 L_RRD_Val_Wdw_Opened 127;
BA_ "GenSigRoutingTimeoutValue_String" SG_ 550 L_RRD_Val_Wdw_Opened "0x7F";
BA_ "GenSigInactiveValue" SG_ 550 L_RRD_Val_Wdw_Opened 127;
BA_ "GenSigRoutingTimeoutValue" SG_ 550 L_RRD_Val_Wdw_Opened 127;
BA_ "DataCenterDataType" SG_ 550 L_RRD_Val_Wdw_Opened "Varchar(10)";
BA_ "GenSigInvalidValue" SG_ 550 L_RRD_Wdw_PositionSts 3;
BA_ "GenSigStartValue" SG_ 550 L_RRD_Wdw_PositionSts 3;
BA_ "GenSigRoutingTimeoutValue_String" SG_ 550 L_RRD_Wdw_PositionSts "0x3";
BA_ "GenSigInactiveValue" SG_ 550 L_RRD_Wdw_PositionSts 3;
BA_ "GenSigRoutingTimeoutValue" SG_ 550 L_RRD_Wdw_PositionSts 3;
BA_ "GenSigSendType" SG_ 550 L_RRD_Wdw_PositionSts 3;
BA_ "DataCenterDataType" SG_ 550 L_RRD_Wdw_PositionSts "Varchar(20)";
BA_ "GenSigSendType" SG_ 550 L_RRD_Wdw_Obs_InhibitSts 3;
BA_ "GenSigSendType" SG_ 550 L_RRD_Wdw_OD_Sts 3;
BA_ "GenSigSendType" SG_ 550 L_RRD_Wdw_Init 3;
BA_ "GenSigSendType" SG_ 550 L_RRD_OverHeat_Protect 3;
BA_ "GenSigSendType" SG_ 550 L_RRD_Motor_Relay_Error 3;
BA_ "GenSigSendType" SG_ 550 L_RRD_Motor_Ripple_Error 3;
BA_ "GenSigSendType" SG_ 550 L_RRD_Wdw_LocalSwitch 3;
BA_ "GenSigSendType" SG_ 550 L_RRD_Wdw_Running_Sts 3;
BA_ "GenSigRoutingTimeoutValue_String" SG_ 550 RAPWL_01_LIN_Response_Error "0x1";
BA_ "GenSigRoutingTimeoutValue" SG_ 550 RAPWL_01_LIN_Response_Error 1;
BA_ "GenSigSendType" SG_ 550 RAPWL_01_LIN_Response_Error 3;
BA_ "GenSigSendType" SG_ 550 L_RLD_Wdw_Obs_InhibitSts 3;
BA_ "GenSigSendType" SG_ 550 L_RLD_Wdw_OD_Sts 3;
BA_ "GenSigInvalidValue" SG_ 550 L_RLD_Val_Wdw_Opened 127;
BA_ "GenSigStartValue" SG_ 550 L_RLD_Val_Wdw_Opened 127;
BA_ "GenSigRoutingTimeoutValue_String" SG_ 550 L_RLD_Val_Wdw_Opened "0x7F";
BA_ "GenSigInactiveValue" SG_ 550 L_RLD_Val_Wdw_Opened 127;
BA_ "GenSigRoutingTimeoutValue" SG_ 550 L_RLD_Val_Wdw_Opened 127;
BA_ "DataCenterDataType" SG_ 550 L_RLD_Val_Wdw_Opened "Varchar(10)";
BA_ "GenSigSendType" SG_ 550 L_RLD_OverHeat_Protect 3;
BA_ "GenSigSendType" SG_ 550 L_RLD_Motor_Relay_Error 3;
BA_ "GenSigSendType" SG_ 550 L_RLD_Motor_Ripple_Error 3;
BA_ "GenSigInvalidValue" SG_ 550 L_RLD_Wdw_PositionSts 3;
BA_ "GenSigStartValue" SG_ 550 L_RLD_Wdw_PositionSts 3;
BA_ "GenSigRoutingTimeoutValue_String" SG_ 550 L_RLD_Wdw_PositionSts "0x3";
BA_ "GenSigInactiveValue" SG_ 550 L_RLD_Wdw_PositionSts 3;
BA_ "GenSigRoutingTimeoutValue" SG_ 550 L_RLD_Wdw_PositionSts 3;
BA_ "GenSigSendType" SG_ 550 L_RLD_Wdw_PositionSts 3;
BA_ "DataCenterDataType" SG_ 550 L_RLD_Wdw_PositionSts "Varchar(20)";
BA_ "GenSigSendType" SG_ 550 L_RLD_Wdw_LocalSwitch 3;
BA_ "GenSigSendType" SG_ 550 L_RLD_Wdw_Running_Sts 3;
BA_ "GenSigSendType" SG_ 550 SWC2_R_Right_Sta 3;
BA_ "GenSigSendType" SG_ 550 SWC2_R_ScrollUp_Sta 3;
BA_ "GenSigSendType" SG_ 550 SWC2_R_ScrollPress_Sta 3;
BA_ "GenSigSendType" SG_ 550 SWC2_R_ScrollDown_Sta 3;
BA_ "GenSigSendType" SG_ 550 SWC2_R_Left_Sta 3;
BA_ "GenSigSendType" SG_ 550 SWC2_R_VR_Sta 3;
BA_ "GenSigSendType" SG_ 550 SWC2_R_PageSwitch_Sta 3;
BA_ "GenSigSendType" SG_ 550 SWC2_R_Customize_Sta 3;
BA_ "GenSigRoutingTimeoutValue_String" SG_ 550 SWC2_L_Left_Sta "0x0";
BA_ "GenSigSendType" SG_ 550 SWC2_L_Left_Sta 3;
BA_ "GenSigSendType" SG_ 550 SWC2_L_ScrollUp_Sta 3;
BA_ "GenSigSendType" SG_ 550 SWC2_L_ScrollPress_Sta 3;
BA_ "GenSigSendType" SG_ 550 SWC2_L_ScrollDown_Sta 3;
BA_ "GenSigRoutingTimeoutValue_String" SG_ 550 SWC2_L_Right_Sta "0x0";
BA_ "GenSigSendType" SG_ 550 SWC2_L_Right_Sta 3;
BA_ "GenSigSendType" SG_ 550 SWC2_L_RegenUp_Sta 3;
BA_ "GenSigSendType" SG_ 550 SWC2_L_ADAS_Sta 3;
BA_ "GenSigSendType" SG_ 550 SWC2_L_Home_Sta 3;
BA_ "GenSigRoutingTimeoutValue_String" SG_ 550 SWC2_ResponseError "0x1";
BA_ "GenSigRoutingTimeoutValue" SG_ 550 SWC2_ResponseError 1;
BA_ "GenSigSendType" SG_ 550 SWC2_ResponseError 3;
BA_ "GenSigSendType" SG_ 550 SWC2_R_RegenDown_Sta 3;
BA_ "GenSigSendType" SG_ 550 SWC2_L_DriveMode_Sta 3;
BA_ "GenSigRoutingTimeoutValue_String" SG_ 550 HVPO_OtltCvrStsRw_Sta "0x0";
BA_ "GenSigStartValue" SG_ 805 ACT5_Actuator_address 1;
BA_ "GenSigStartValue" SG_ 805 ACT4_Actuator_address 1;
BA_ "GenSigStartValue" SG_ 805 ACT3_Actuator_address 1;
BA_ "GenSigStartValue" SG_ 805 ACT2_Actuator_address 1;
BA_ "GenSigStartValue" SG_ 805 ACT1_Actuator_address 1;
BA_ "GenSigSendType" SG_ 805 HornSW 3;
BA_ "GenSigSendType" SG_ 805 AllLockSta 3;
BA_ "GenSigSendType" SG_ 805 AutoLightSW 3;
BA_ "GenSigSendType" SG_ 805 BrakeLampFail 3;
BA_ "GenSigSendType" SG_ 805 DrLockSta 3;
BA_ "GenSigInvalidValue" SG_ 805 WiperSWPos 255;
BA_ "GenSigStartValue" SG_ 805 WiperSWPos 255;
BA_ "GenSigRoutingTimeoutValue_String" SG_ 805 WiperSWPos "0xFF";
BA_ "GenSigInactiveValue" SG_ 805 WiperSWPos 255;
BA_ "GenSigRoutingTimeoutValue" SG_ 805 WiperSWPos 255;
BA_ "GenSigSendType" SG_ 805 WiperSWPos 3;
BA_ "GenSigInvalidValue" SG_ 805 RRTurnLampC 255;
BA_ "GenSigStartValue" SG_ 805 RRTurnLampC 255;
BA_ "GenSigRoutingTimeoutValue_String" SG_ 805 RRTurnLampC "0xFF";
BA_ "GenSigInactiveValue" SG_ 805 RRTurnLampC 255;
BA_ "GenSigRoutingTimeoutValue" SG_ 805 RRTurnLampC 255;
BA_ "GenSigSendType" SG_ 805 RRTurnLampC 3;
BA_ "GenSigInvalidValue" SG_ 805 RLTurnLampC 255;
BA_ "GenSigStartValue" SG_ 805 RLTurnLampC 255;
BA_ "GenSigRoutingTimeoutValue_String" SG_ 805 RLTurnLampC "0xFF";
BA_ "GenSigInactiveValue" SG_ 805 RLTurnLampC 255;
BA_ "GenSigRoutingTimeoutValue" SG_ 805 RLTurnLampC 255;
BA_ "GenSigSendType" SG_ 805 RLTurnLampC 3;
BA_ "GenSigSendType" SG_ 805 Wip_Speed 3;
BA_ "GenSigSendType" SG_ 805 MIRROR_FOLD_SW 3;
BA_ "GenSigSendType" SG_ 805 PsLockSta 3;
BA_ "GenSigSendType" SG_ 805 RLLockSta 3;
BA_ "GenSigSendType" SG_ 805 RLS_Exist 3;
BA_ "GenSigSendType" SG_ 805 RRLockSta 3;
BA_ "GenSigSendType" SG_ 805 RWiperAS 3;
BA_ "GenSigSendType" SG_ 805 RWiperProtection 3;
BA_ "GenSigSendType" SG_ 805 WiperZeroPosSW 3;
BA_ "GenSigRoutingTimeoutValue_String" SG_ 805 RLTurnLPErr "0x1";
BA_ "GenSigRoutingTimeoutValue" SG_ 805 RLTurnLPErr 1;
BA_ "GenSigSendType" SG_ 805 RLTurnLPErr 3;
BA_ "GenSigRoutingTimeoutValue_String" SG_ 805 RRTurnLPErr "0x1";
BA_ "GenSigRoutingTimeoutValue" SG_ 805 RRTurnLPErr 1;
BA_ "GenSigSendType" SG_ 805 RRTurnLPErr 3;
BA_ "GenSigSendType" SG_ 805 ZDR_THCM_IntakeFail_Sta 3;
BA_ "GenSigSendType" SG_ 805 ZDR_THCM_LINACT1_Sta 3;
BA_ "GenSigSendType" SG_ 805 ZDR_THCM_LINACT2_Sta 3;
BA_ "GenSigSendType" SG_ 805 ZDR_THCM_LINACT3_Sta 3;
BA_ "GenSigSendType" SG_ 805 ZDR_THCM_LINACT4_Sta 3;
BA_ "GenSigSendType" SG_ 805 ZDR_THCM_LINACT5_Sta 3;
BA_ "GenSigSendType" SG_ 805 ZDR_THCM_ModeFail_Sta 3;
BA_ "GenSigInvalidValue" SG_ 552 AGS_Actual_Position 127;
BA_ "GenSigStartValue" SG_ 552 AGS_Actual_Position 127;
BA_ "GenSigRoutingTimeoutValue_String" SG_ 552 AGS_Actual_Position "0x7F";
BA_ "GenSigRoutingTimeoutValue" SG_ 552 AGS_Actual_Position 127;
BA_ "GenSigRoutingTimeoutValue_String" SG_ 552 AGS_LINResponse_Error "0x1";
BA_ "GenSigRoutingTimeoutValue" SG_ 552 AGS_LINResponse_Error 1;
BA_ "GenSigRoutingTimeoutValue_String" SG_ 552 ION_IONRespErr_Sta "0x1";
BA_ "GenSigRoutingTimeoutValue" SG_ 552 ION_IONRespErr_Sta 1;
BA_ "GenSigInvalidValue" SG_ 552 FGS_LifeHole3_Sta 511;
BA_ "GenSigRoutingTimeoutValue_String" SG_ 552 FGS_LifeHole3_Sta "0x1FF";
BA_ "GenSigRoutingTimeoutValue" SG_ 552 FGS_LifeHole3_Sta 511;
BA_ "GenSigInvalidValue" SG_ 552 FGS_LifeHole2_Sta 511;
BA_ "GenSigRoutingTimeoutValue_String" SG_ 552 FGS_LifeHole2_Sta "0x1FF";
BA_ "GenSigRoutingTimeoutValue" SG_ 552 FGS_LifeHole2_Sta 511;
BA_ "GenSigInvalidValue" SG_ 552 FGS_LifeHole1_Sta 511;
BA_ "GenSigRoutingTimeoutValue_String" SG_ 552 FGS_LifeHole1_Sta "0x1FF";
BA_ "GenSigRoutingTimeoutValue" SG_ 552 FGS_LifeHole1_Sta 511;
BA_ "GenSigInvalidValue" SG_ 552 FGS_Channel3TypeRsp_Sta 15;
BA_ "GenSigRoutingTimeoutValue_String" SG_ 552 FGS_Channel3TypeRsp_Sta "0xF";
BA_ "GenSigRoutingTimeoutValue" SG_ 552 FGS_Channel3TypeRsp_Sta 15;
BA_ "GenSigInvalidValue" SG_ 552 FGS_Channel2TypeRsp_Sta 15;
BA_ "GenSigRoutingTimeoutValue_String" SG_ 552 FGS_Channel2TypeRsp_Sta "0xF";
BA_ "GenSigRoutingTimeoutValue" SG_ 552 FGS_Channel2TypeRsp_Sta 15;
BA_ "GenSigInvalidValue" SG_ 552 FGS_Channel1TypeRsp_Sta 15;
BA_ "GenSigRoutingTimeoutValue_String" SG_ 552 FGS_Channel1TypeRsp_Sta "0xF";
BA_ "GenSigRoutingTimeoutValue" SG_ 552 FGS_Channel1TypeRsp_Sta 15;
BA_ "GenSigInvalidValue" SG_ 552 FGS_BlowerErr_Sta 1;
BA_ "GenSigRoutingTimeoutValue_String" SG_ 552 FGS_BlowerErr_Sta "0x1";
BA_ "GenSigRoutingTimeoutValue" SG_ 552 FGS_BlowerErr_Sta 1;
BA_ "GenSigInvalidValue" SG_ 552 FGS_IntenRsp_Sta 15;
BA_ "GenSigRoutingTimeoutValue_String" SG_ 552 FGS_IntenRsp_Sta "0xF";
BA_ "GenSigRoutingTimeoutValue" SG_ 552 FGS_IntenRsp_Sta 15;
BA_ "GenSigInvalidValue" SG_ 552 FGS_MotorErr_Sta 1;
BA_ "GenSigRoutingTimeoutValue_String" SG_ 552 FGS_MotorErr_Sta "0x1";
BA_ "GenSigRoutingTimeoutValue" SG_ 552 FGS_MotorErr_Sta 1;
BA_ "GenSigRoutingTimeoutValue_String" SG_ 552 FGS_TypRsp_Sta "0x0";
BA_ "GenSigInvalidValue" SG_ 552 FGS_LINResponseErr_Sta 1;
BA_ "GenSigRoutingTimeoutValue_String" SG_ 552 FGS_LINResponseErr_Sta "0x1";
BA_ "GenSigRoutingTimeoutValue" SG_ 552 FGS_LINResponseErr_Sta 1;
BA_ "GenSigRoutingTimeoutValue_String" SG_ 552 FGS_StsRsp_Sta "0x0";
BA_ "GenSigRoutingTimeoutValue_String" SG_ 552 FGS_Channel_Type_Sta "0x0";
BA_ "GenSigRoutingTimeoutValue_String" SG_ 552 FGS_Channel_Index_Sta "0x0";
BA_ "GenSigInvalidValue" SG_ 796 FRTurnLampC 255;
BA_ "GenSigStartValue" SG_ 796 FRTurnLampC 255;
BA_ "GenSigRoutingTimeoutValue_String" SG_ 796 FRTurnLampC "0xFF";
BA_ "GenSigInactiveValue" SG_ 796 FRTurnLampC 255;
BA_ "GenSigRoutingTimeoutValue" SG_ 796 FRTurnLampC 255;
BA_ "GenSigSendType" SG_ 796 FRTurnLampC 3;
BA_ "GenSigInvalidValue" SG_ 796 FLTurnLampC 255;
BA_ "GenSigStartValue" SG_ 796 FLTurnLampC 255;
BA_ "GenSigRoutingTimeoutValue_String" SG_ 796 FLTurnLampC "0xFF";
BA_ "GenSigInactiveValue" SG_ 796 FLTurnLampC 255;
BA_ "GenSigRoutingTimeoutValue" SG_ 796 FLTurnLampC 255;
BA_ "GenSigSendType" SG_ 796 FLTurnLampC 3;
BA_ "GenSigSendType" SG_ 796 ChargeInletLockSta 3;
BA_ "DataCenterDataType" SG_ 796 ChargeInletLockSta "Varchar(7)";
BA_ "GenSigSendType" SG_ 796 FWiperAS 3;
BA_ "GenSigSendType" SG_ 796 FWiperProtection 3;
BA_ "GenSigInvalidValue" SG_ 796 CCM_SpdCmd 32767;
BA_ "GenSigRoutingTimeoutValue_String" SG_ 796 CCM_SpdCmd "0x7FFF";
BA_ "GenSigRoutingTimeoutValue" SG_ 796 CCM_SpdCmd 32767;
BA_ "GenSigStartValue" SG_ 796 BMSPackVol_h6HSC6 4095;
BA_ "GenSigInvalidValue" SG_ 796 EXV_Cmd_Set_Rq 65535;
BA_ "GenSigStartValue" SG_ 796 EXV_Cmd_Set_Rq 65535;
BA_ "GenSigRoutingTimeoutValue_String" SG_ 796 EXV_Cmd_Set_Rq "0xFFFF";
BA_ "GenSigInactiveValue" SG_ 796 EXV_Cmd_Set_Rq 65535;
BA_ "GenSigRoutingTimeoutValue" SG_ 796 EXV_Cmd_Set_Rq 65535;
BA_ "GenSigInvalidValue" SG_ 796 EXV2_Cmd_Set_Rq 65535;
BA_ "GenSigStartValue" SG_ 796 EXV2_Cmd_Set_Rq 65535;
BA_ "GenSigRoutingTimeoutValue_String" SG_ 796 EXV2_Cmd_Set_Rq "0xFFFF";
BA_ "GenSigInactiveValue" SG_ 796 EXV2_Cmd_Set_Rq 65535;
BA_ "GenSigRoutingTimeoutValue" SG_ 796 EXV2_Cmd_Set_Rq 65535;
BA_ "GenSigInvalidValue" SG_ 796 EWP3_RPM_Target_EWP_Rq 255;
BA_ "GenSigRoutingTimeoutValue_String" SG_ 796 EWP3_RPM_Target_EWP_Rq "0xFF";
BA_ "GenSigRoutingTimeoutValue" SG_ 796 EWP3_RPM_Target_EWP_Rq 255;
BA_ "GenSigInvalidValue" SG_ 796 EWP2_RPM_Target_EWP_Rq 255;
BA_ "GenSigRoutingTimeoutValue_String" SG_ 796 EWP2_RPM_Target_EWP_Rq "0xFF";
BA_ "GenSigRoutingTimeoutValue" SG_ 796 EWP2_RPM_Target_EWP_Rq 255;
BA_ "GenSigInvalidValue" SG_ 796 EWP1_RPM_Target_EWP_Rq 255;
BA_ "GenSigRoutingTimeoutValue_String" SG_ 796 EWP1_RPM_Target_EWP_Rq "0xFF";
BA_ "GenSigRoutingTimeoutValue" SG_ 796 EWP1_RPM_Target_EWP_Rq 255;
BA_ "GenSigInvalidValue" SG_ 796 EXV2_Cmd_Init_Rq 7;
BA_ "GenSigStartValue" SG_ 796 EXV2_Cmd_Init_Rq 7;
BA_ "GenSigRoutingTimeoutValue_String" SG_ 796 EXV2_Cmd_Init_Rq "0x7";
BA_ "GenSigInactiveValue" SG_ 796 EXV2_Cmd_Init_Rq 7;
BA_ "GenSigRoutingTimeoutValue" SG_ 796 EXV2_Cmd_Init_Rq 7;
BA_ "GenSigInvalidValue" SG_ 796 EXV_Cmd_Init_Rq 7;
BA_ "GenSigStartValue" SG_ 796 EXV_Cmd_Init_Rq 7;
BA_ "GenSigRoutingTimeoutValue_String" SG_ 796 EXV_Cmd_Init_Rq "0x7";
BA_ "GenSigInactiveValue" SG_ 796 EXV_Cmd_Init_Rq 7;
BA_ "GenSigRoutingTimeoutValue" SG_ 796 EXV_Cmd_Init_Rq 7;
BA_ "GenSigInvalidValue" SG_ 796 AGS_Position_Request 255;
BA_ "GenSigStartValue" SG_ 796 AGS_Position_Request 255;
BA_ "GenSigRoutingTimeoutValue_String" SG_ 796 AGS_Position_Request "0xFF";
BA_ "GenSigInactiveValue" SG_ 796 AGS_Position_Request 255;
BA_ "GenSigRoutingTimeoutValue" SG_ 796 AGS_Position_Request 255;
BA_ "GenSigSendType" SG_ 796 TrailerModeSta 3;
BA_ "GenSigSendType" SG_ 796 TrailerCheck 3;
BA_ "GenSigRoutingTimeoutValue_String" SG_ 796 ZFR_BCM_ChargerDoorSW_Sta "0x0";
BA_ "GenSigSendType" SG_ 796 ZFR_BCM_ChargerDoorSW_Sta 3;
BA_ "GenSigRoutingTimeoutValue_String" SG_ 796 FLPosLPErr "0x1";
BA_ "GenSigRoutingTimeoutValue" SG_ 796 FLPosLPErr 1;
BA_ "GenSigSendType" SG_ 796 FLPosLPErr 3;
BA_ "GenSigRoutingTimeoutValue_String" SG_ 796 FLTurnLPErr "0x1";
BA_ "GenSigRoutingTimeoutValue" SG_ 796 FLTurnLPErr 1;
BA_ "GenSigSendType" SG_ 796 FLTurnLPErr 3;
BA_ "GenSigRoutingTimeoutValue_String" SG_ 796 FLTurn_Light_Warning "0x0";
BA_ "GenSigRoutingTimeoutValue_String" SG_ 796 FRPosLPErr "0x1";
BA_ "GenSigRoutingTimeoutValue" SG_ 796 FRPosLPErr 1;
BA_ "GenSigSendType" SG_ 796 FRPosLPErr 3;
BA_ "GenSigRoutingTimeoutValue_String" SG_ 796 FRTurnLPErr "0x1";
BA_ "GenSigRoutingTimeoutValue" SG_ 796 FRTurnLPErr 1;
BA_ "GenSigSendType" SG_ 796 FRTurnLPErr 3;
BA_ "GenSigRoutingTimeoutValue_String" SG_ 796 FRTurn_Light_Warning "0x0";
BA_ "GenSigRoutingTimeoutValue_String" SG_ 796 LADBErr "0x1";
BA_ "GenSigRoutingTimeoutValue" SG_ 796 LADBErr 1;
BA_ "GenSigSendType" SG_ 796 LADBErr 3;
BA_ "GenSigRoutingTimeoutValue_String" SG_ 796 LADB_Hibeam_Indication "0x0";
BA_ "GenSigRoutingTimeoutValue_String" SG_ 796 LADB_Operation_Status "0x0";
BA_ "GenSigRoutingTimeoutValue_String" SG_ 796 LADB_Warning "0x0";
BA_ "GenSigRoutingTimeoutValue_String" SG_ 796 LAHB_Warning "0x0";
BA_ "GenSigRoutingTimeoutValue_String" SG_ 796 LDRLErr "0x1";
BA_ "GenSigRoutingTimeoutValue" SG_ 796 LDRLErr 1;
BA_ "GenSigSendType" SG_ 796 LDRLErr 3;
BA_ "GenSigRoutingTimeoutValue_String" SG_ 796 LDRL_Warning "0x0";
BA_ "GenSigRoutingTimeoutValue_String" SG_ 796 LH_BeamErr "0x1";
BA_ "GenSigRoutingTimeoutValue" SG_ 796 LH_BeamErr 1;
BA_ "GenSigSendType" SG_ 796 LH_BeamErr 3;
BA_ "GenSigRoutingTimeoutValue_String" SG_ 796 LLB_Warning "0x0";
BA_ "GenSigRoutingTimeoutValue_String" SG_ 796 LL_BeamErr "0x1";
BA_ "GenSigRoutingTimeoutValue" SG_ 796 LL_BeamErr 1;
BA_ "GenSigSendType" SG_ 796 LL_BeamErr 3;
BA_ "GenSigRoutingTimeoutValue_String" SG_ 796 Lposition_Lamp_Warning "0x0";
BA_ "GenSigRoutingTimeoutValue_String" SG_ 796 RADBErr "0x1";
BA_ "GenSigRoutingTimeoutValue" SG_ 796 RADBErr 1;
BA_ "GenSigSendType" SG_ 796 RADBErr 3;
BA_ "GenSigRoutingTimeoutValue_String" SG_ 796 RADB_Hibeam_Indication "0x0";
BA_ "GenSigRoutingTimeoutValue_String" SG_ 796 RADB_Operation_Status "0x0";
BA_ "GenSigRoutingTimeoutValue_String" SG_ 796 RADB_Warning "0x0";
BA_ "GenSigRoutingTimeoutValue_String" SG_ 796 RAHB_Warning "0x0";
BA_ "GenSigRoutingTimeoutValue_String" SG_ 796 RDRLErr "0x1";
BA_ "GenSigRoutingTimeoutValue" SG_ 796 RDRLErr 1;
BA_ "GenSigSendType" SG_ 796 RDRLErr 3;
BA_ "GenSigRoutingTimeoutValue_String" SG_ 796 RDRL_Warning "0x0";
BA_ "GenSigRoutingTimeoutValue_String" SG_ 796 RH_BeamErr "0x1";
BA_ "GenSigRoutingTimeoutValue" SG_ 796 RH_BeamErr 1;
BA_ "GenSigSendType" SG_ 796 RH_BeamErr 3;
BA_ "GenSigRoutingTimeoutValue_String" SG_ 796 RLB_Warning "0x0";
BA_ "GenSigRoutingTimeoutValue_String" SG_ 796 RL_BeamErr "0x1";
BA_ "GenSigRoutingTimeoutValue" SG_ 796 RL_BeamErr 1;
BA_ "GenSigSendType" SG_ 796 RL_BeamErr 3;
BA_ "GenSigRoutingTimeoutValue_String" SG_ 796 Rposition_Lamp_Warning "0x0";
BA_ "GenSigInvalidValue" SG_ 796 ZFR_THCM_CLEVentActY_Sta 127;
BA_ "GenSigRoutingTimeoutValue_String" SG_ 796 ZFR_THCM_CLEVentActY_Sta "0x7F";
BA_ "GenSigRoutingTimeoutValue" SG_ 796 ZFR_THCM_CLEVentActY_Sta 127;
BA_ "GenSigInvalidValue" SG_ 796 ZFR_THCM_CLEVentActZ_Sta 127;
BA_ "GenSigRoutingTimeoutValue_String" SG_ 796 ZFR_THCM_CLEVentActZ_Sta "0x7F";
BA_ "GenSigRoutingTimeoutValue" SG_ 796 ZFR_THCM_CLEVentActZ_Sta 127;
BA_ "GenSigInvalidValue" SG_ 796 ZFR_THCM_CREVentActY_Sta 127;
BA_ "GenSigRoutingTimeoutValue_String" SG_ 796 ZFR_THCM_CREVentActY_Sta "0x7F";
BA_ "GenSigRoutingTimeoutValue" SG_ 796 ZFR_THCM_CREVentActY_Sta 127;
BA_ "GenSigInvalidValue" SG_ 796 ZFR_THCM_CREVentActZ_Sta 127;
BA_ "GenSigRoutingTimeoutValue_String" SG_ 796 ZFR_THCM_CREVentActZ_Sta "0x7F";
BA_ "GenSigRoutingTimeoutValue" SG_ 796 ZFR_THCM_CREVentActZ_Sta 127;
BA_ "GenSigInvalidValue" SG_ 796 ZFR_THCM_LEVentActY_Sta 127;
BA_ "GenSigRoutingTimeoutValue_String" SG_ 796 ZFR_THCM_LEVentActY_Sta "0x7F";
BA_ "GenSigRoutingTimeoutValue" SG_ 796 ZFR_THCM_LEVentActY_Sta 127;
BA_ "GenSigInvalidValue" SG_ 796 ZFR_THCM_LEVentActZ_Sta 127;
BA_ "GenSigRoutingTimeoutValue_String" SG_ 796 ZFR_THCM_LEVentActZ_Sta "0x7F";
BA_ "GenSigRoutingTimeoutValue" SG_ 796 ZFR_THCM_LEVentActZ_Sta 127;
BA_ "GenSigInvalidValue" SG_ 796 ZFR_THCM_REVentActY_Sta 127;
BA_ "GenSigRoutingTimeoutValue_String" SG_ 796 ZFR_THCM_REVentActY_Sta "0x7F";
BA_ "GenSigRoutingTimeoutValue" SG_ 796 ZFR_THCM_REVentActY_Sta 127;
BA_ "GenSigInvalidValue" SG_ 796 ZFR_THCM_REVentActZ_Sta 127;
BA_ "GenSigRoutingTimeoutValue_String" SG_ 796 ZFR_THCM_REVentActZ_Sta "0x7F";
BA_ "GenSigRoutingTimeoutValue" SG_ 796 ZFR_THCM_REVentActZ_Sta 127;
BA_ "GenSigRoutingTimeoutValue_String" SG_ 796 ZFR_EChrg_Active_Sta "0x0";
BA_ "GenSigSendType" SG_ 796 ZFR_EChrg_Active_Sta 3;
BA_ "GenSigInvalidValue" SG_ 796 ZFR_EChrg_Sys_Sta 3;
BA_ "GenSigRoutingTimeoutValue_String" SG_ 796 ZFR_EChrg_Sys_Sta "0x3";
BA_ "GenSigRoutingTimeoutValue" SG_ 796 ZFR_EChrg_Sys_Sta 3;
BA_ "GenSigSendType" SG_ 796 ZFR_EChrg_Sys_Sta 3;
BA_ "GenSigRoutingTimeoutValue_String" SG_ 796 ZFR_EChrg_OperationDeny_Cmd "0x0";
BA_ "GenSigSendType" SG_ 796 ZFR_EChrg_OperationDeny_Cmd 3;
BA_ "GenSigRoutingTimeoutValue_String" SG_ 796 ZFR_SYS_HWMismatchFW_Sta "0x0";
BA_ "GenSigRoutingTimeoutValue_String" SG_ 796 ZFR_BCM_HRLTurnLPNormal_Sta "0x0";
BA_ "GenSigSendType" SG_ 796 ZFR_BCM_HRLTurnLPNormal_Sta 3;
BA_ "GenSigRoutingTimeoutValue_String" SG_ 796 ZFR_BCM_HRRTurnLPHNormal_Sta "0x0";
BA_ "GenSigSendType" SG_ 796 ZFR_BCM_HRRTurnLPHNormal_Sta 3;
BA_ "GenSigRoutingTimeoutValue_String" SG_ 796 ZFR_EChrg_WashMode_Sta "0x0";
BA_ "GenSigSendType" SG_ 796 ZFR_EChrg_WashMode_Sta 3;
BA_ "GenSigRoutingTimeoutValue_String" SG_ 796 ZFR_THCM_EACV1Stallpos_Sta "0x0";
BA_ "GenSigRoutingTimeoutValue_String" SG_ 796 ZFR_THCM_EACV2Stallpos_Sta "0x0";
BA_ "GenSigRoutingTimeoutValue_String" SG_ 796 ZFR_THCM_EACV3Stallpos_Sta "0x0";
BA_ "GenSigRoutingTimeoutValue_String" SG_ 796 ZFR_THCM_EACV4Stallpos_Sta "0x0";
BA_ "GenSigRoutingTimeoutValue_String" SG_ 796 ZFR_THCM_EACV5Stallpos_Sta "0x0";
BA_ "GenSigRoutingTimeoutValue_String" SG_ 796 ZFR_THCM_EACV6Stallpos_Sta "0x0";
BA_ "GenSigRoutingTimeoutValue_String" SG_ 796 ZFR_THCM_EACV7Stallpos_Sta "0x0";
BA_ "GenSigRoutingTimeoutValue_String" SG_ 796 ZFR_THCM_EACV8Stallpos_Sta "0x0";
BA_ "GenSigSendType" SG_ 593 P_CommandToBCM 3;
BA_ "GenSigSendType" SG_ 593 P_UID_LowPower 3;
BA_ "DataCenterDataType" SG_ 593 P_UID_LowPower "Varchar(10)";
BA_ "GenSigInvalidValue" SG_ 593 P_CommandToPTG 5;
BA_ "GenSigSendType" SG_ 593 P_KeyMode 3;
BA_ "DataCenterDataType" SG_ 593 P_KeyMode "Varchar(15)";
BA_ "GenSigSendType" SG_ 593 DKC_Re_VehData 3;
BA_ "DataCenterDataType" SG_ 593 DKC_P_UID_BatVolt "float";
BA_ "DataCenterDataType" SG_ 593 DKC_P_BLE_RSSI "float";
BA_ "GenSigSendType" SG_ 593 DKC_ParkingMode_Cmd 3;
BA_ "GenSigRoutingTimeoutValue_String" SG_ 593 DKC_PDkeyAreaRAPS_Sta "0x0";
BA_ "GenSigSendType" SG_ 593 DKC_PDkeyAreaRAPS_Sta 3;
BA_ "GenSigInvalidValue" SG_ 593 DKC_KeyNum_Sta 15;
BA_ "GenSigRoutingTimeoutValue_String" SG_ 593 DKC_KeyNum_Sta "0x0";
BA_ "GenSigSendType" SG_ 593 DKC_KeyNum_Sta 3;
BA_ "GenSigSendType" SG_ 593 DKC_KeyType_Sta 3;
BA_ "GenSigSendType" SG_ 594 EncryptionDATA_64_127 3;
BA_ "GenSigSendType" SG_ 594 EncryptionDATA_0_63 3;
BA_ "DataCenterDataType" SG_ 596 EXV_Rsp_Fault_Stat "Varchar(30)";
BA_ "DataCenterDataType" SG_ 596 EXV_Rsp_OvrTemp_Warn "Varchar(30)";
BA_ "DataCenterDataType" SG_ 596 EXV_Rsp_Volt_Stat "Varchar(20)";
BA_ "DataCenterDataType" SG_ 596 EXV_RsErr_EXV "Varchar(20)";
BA_ "DataCenterDataType" SG_ 596 EWP1_RsErr_EWP "Varchar(10)";
BA_ "DataCenterDataType" SG_ 596 EWP1_SupVolt_Error "Varchar(10)";
BA_ "GenSigInvalidValue" SG_ 596 EWP1_RPM_Target_Stat 255;
BA_ "GenSigRoutingTimeoutValue_String" SG_ 596 EWP1_RPM_Target_Stat "0xFF";
BA_ "GenSigRoutingTimeoutValue" SG_ 596 EWP1_RPM_Target_Stat 255;
BA_ "GenSigInvalidValue" SG_ 596 EWP1_RPM_ActlVal_Stat 255;
BA_ "GenSigRoutingTimeoutValue_String" SG_ 596 EWP1_RPM_ActlVal_Stat "0xFF";
BA_ "GenSigRoutingTimeoutValue" SG_ 596 EWP1_RPM_ActlVal_Stat 255;
BA_ "GenSigInvalidValue" SG_ 596 EWP1_Curr_Stat 255;
BA_ "GenSigRoutingTimeoutValue_String" SG_ 596 EWP1_Curr_Stat "0xFF";
BA_ "GenSigRoutingTimeoutValue" SG_ 596 EWP1_Curr_Stat 255;
BA_ "DataCenterDataType" SG_ 596 EWP1_Curr_Stat "Varchar(10)";
BA_ "GenSigInvalidValue" SG_ 596 EWP1_Block_Error 3;
BA_ "GenSigRoutingTimeoutValue_String" SG_ 596 EWP1_Block_Error "0x3";
BA_ "GenSigRoutingTimeoutValue" SG_ 596 EWP1_Block_Error 3;
BA_ "DataCenterDataType" SG_ 596 EWP1_Block_Error "Varchar(10)";
BA_ "GenSigInvalidValue" SG_ 596 EWP1_DryRun_Error 3;
BA_ "GenSigRoutingTimeoutValue_String" SG_ 596 EWP1_DryRun_Error "0x3";
BA_ "GenSigRoutingTimeoutValue" SG_ 596 EWP1_DryRun_Error 3;
BA_ "DataCenterDataType" SG_ 596 EWP1_DryRun_Error "Varchar(10)";
BA_ "GenSigInvalidValue" SG_ 596 EWP1_OverCurr_Error 3;
BA_ "GenSigRoutingTimeoutValue_String" SG_ 596 EWP1_OverCurr_Error "0x3";
BA_ "GenSigRoutingTimeoutValue" SG_ 596 EWP1_OverCurr_Error 3;
BA_ "DataCenterDataType" SG_ 596 EWP1_OverCurr_Error "Varchar(10)";
BA_ "DataCenterDataType" SG_ 596 EWP1_OverTemp_Error "Varchar(20)";
BA_ "GenSigInvalidValue" SG_ 596 EWP1_Temp_Stat 255;
BA_ "GenSigRoutingTimeoutValue_String" SG_ 596 EWP1_Temp_Stat "0xFF";
BA_ "GenSigRoutingTimeoutValue" SG_ 596 EWP1_Temp_Stat 255;
BA_ "GenSigInvalidValue" SG_ 596 EWP1_Volt_Stat 255;
BA_ "GenSigRoutingTimeoutValue_String" SG_ 596 EWP1_Volt_Stat "0xFF";
BA_ "GenSigRoutingTimeoutValue" SG_ 596 EWP1_Volt_Stat 255;
BA_ "DataCenterDataType" SG_ 596 EWP1_Volt_Stat "Varchar(10)";
BA_ "GenSigInvalidValue" SG_ 596 EWP2_Volt_Stat 255;
BA_ "GenSigRoutingTimeoutValue_String" SG_ 596 EWP2_Volt_Stat "0xFF";
BA_ "GenSigRoutingTimeoutValue" SG_ 596 EWP2_Volt_Stat 255;
BA_ "DataCenterDataType" SG_ 596 EWP2_Volt_Stat "Varchar(10)";
BA_ "GenSigInvalidValue" SG_ 596 EWP2_Temp_Stat 255;
BA_ "GenSigRoutingTimeoutValue_String" SG_ 596 EWP2_Temp_Stat "0xFF";
BA_ "GenSigRoutingTimeoutValue" SG_ 596 EWP2_Temp_Stat 255;
BA_ "GenSigInvalidValue" SG_ 596 EWP2_RPM_Target_Stat 255;
BA_ "GenSigRoutingTimeoutValue_String" SG_ 596 EWP2_RPM_Target_Stat "0xFF";
BA_ "GenSigRoutingTimeoutValue" SG_ 596 EWP2_RPM_Target_Stat 255;
BA_ "GenSigInvalidValue" SG_ 596 EWP2_RPM_ActlVal_Stat 255;
BA_ "GenSigRoutingTimeoutValue_String" SG_ 596 EWP2_RPM_ActlVal_Stat "0xFF";
BA_ "GenSigRoutingTimeoutValue" SG_ 596 EWP2_RPM_ActlVal_Stat 255;
BA_ "GenSigInvalidValue" SG_ 596 EWP2_Curr_Stat 255;
BA_ "GenSigRoutingTimeoutValue_String" SG_ 596 EWP2_Curr_Stat "0xFF";
BA_ "GenSigRoutingTimeoutValue" SG_ 596 EWP2_Curr_Stat 255;
BA_ "DataCenterDataType" SG_ 596 EWP2_Curr_Stat "Varchar(10)";
BA_ "GenSigInvalidValue" SG_ 596 EWP2_Block_Error 3;
BA_ "GenSigRoutingTimeoutValue_String" SG_ 596 EWP2_Block_Error "0x3";
BA_ "GenSigRoutingTimeoutValue" SG_ 596 EWP2_Block_Error 3;
BA_ "DataCenterDataType" SG_ 596 EWP2_Block_Error "Varchar(10)";
BA_ "GenSigInvalidValue" SG_ 596 EWP2_DryRun_Error 3;
BA_ "GenSigRoutingTimeoutValue_String" SG_ 596 EWP2_DryRun_Error "0x3";
BA_ "GenSigRoutingTimeoutValue" SG_ 596 EWP2_DryRun_Error 3;
BA_ "DataCenterDataType" SG_ 596 EWP2_DryRun_Error "Varchar(10)";
BA_ "GenSigInvalidValue" SG_ 596 EWP2_OverCurr_Error 3;
BA_ "GenSigRoutingTimeoutValue_String" SG_ 596 EWP2_OverCurr_Error "0x3";
BA_ "GenSigRoutingTimeoutValue" SG_ 596 EWP2_OverCurr_Error 3;
BA_ "DataCenterDataType" SG_ 596 EWP2_OverCurr_Error "Varchar(10)";
BA_ "DataCenterDataType" SG_ 596 EWP2_OverTemp_Error "Varchar(5)";
BA_ "DataCenterDataType" SG_ 596 EWP2_SupVolt_Error "Varchar(10)";
BA_ "DataCenterDataType" SG_ 596 EWP2_RsErr_EWP "Varchar(10)";
BA_ "GenSigInvalidValue" SG_ 596 EWP3_Block_Error 3;
BA_ "GenSigRoutingTimeoutValue_String" SG_ 596 EWP3_Block_Error "0x3";
BA_ "GenSigRoutingTimeoutValue" SG_ 596 EWP3_Block_Error 3;
BA_ "DataCenterDataType" SG_ 596 EWP3_Block_Error "Varchar(10)";
BA_ "GenSigInvalidValue" SG_ 596 EWP3_DryRun_Error 3;
BA_ "GenSigRoutingTimeoutValue_String" SG_ 596 EWP3_DryRun_Error "0x3";
BA_ "GenSigRoutingTimeoutValue" SG_ 596 EWP3_DryRun_Error 3;
BA_ "DataCenterDataType" SG_ 596 EWP3_DryRun_Error "Varchar(10)";
BA_ "GenSigInvalidValue" SG_ 596 EWP3_RPM_Target_Stat 255;
BA_ "GenSigRoutingTimeoutValue_String" SG_ 596 EWP3_RPM_Target_Stat "0xFF";
BA_ "GenSigRoutingTimeoutValue" SG_ 596 EWP3_RPM_Target_Stat 255;
BA_ "GenSigInvalidValue" SG_ 596 EWP3_RPM_ActlVal_Stat 255;
BA_ "GenSigRoutingTimeoutValue_String" SG_ 596 EWP3_RPM_ActlVal_Stat "0xFF";
BA_ "GenSigRoutingTimeoutValue" SG_ 596 EWP3_RPM_ActlVal_Stat 255;
BA_ "GenSigInvalidValue" SG_ 596 EWP3_Curr_Stat 255;
BA_ "GenSigRoutingTimeoutValue_String" SG_ 596 EWP3_Curr_Stat "0xFF";
BA_ "GenSigRoutingTimeoutValue" SG_ 596 EWP3_Curr_Stat 255;
BA_ "DataCenterDataType" SG_ 596 EWP3_Curr_Stat "Varchar(10)";
BA_ "GenSigInvalidValue" SG_ 596 EWP3_OverCurr_Error 3;
BA_ "GenSigRoutingTimeoutValue_String" SG_ 596 EWP3_OverCurr_Error "0x3";
BA_ "GenSigRoutingTimeoutValue" SG_ 596 EWP3_OverCurr_Error 3;
BA_ "DataCenterDataType" SG_ 596 EWP3_OverCurr_Error "Varchar(5)";
BA_ "DataCenterDataType" SG_ 596 EWP3_OverTemp_Error "Varchar(5)";
BA_ "DataCenterDataType" SG_ 596 EWP3_SupVolt_Error "Varchar(10)";
BA_ "DataCenterDataType" SG_ 596 EWP3_RsErr_EWP "Varchar(10)";
BA_ "GenSigInvalidValue" SG_ 596 EWP3_Temp_Stat 255;
BA_ "GenSigRoutingTimeoutValue_String" SG_ 596 EWP3_Temp_Stat "0xFF";
BA_ "GenSigRoutingTimeoutValue" SG_ 596 EWP3_Temp_Stat 255;
BA_ "GenSigInvalidValue" SG_ 596 EWP3_Volt_Stat 255;
BA_ "GenSigRoutingTimeoutValue_String" SG_ 596 EWP3_Volt_Stat "0xFF";
BA_ "GenSigRoutingTimeoutValue" SG_ 596 EWP3_Volt_Stat 255;
BA_ "DataCenterDataType" SG_ 596 EWP3_Volt_Stat "Varchar(10)";
BA_ "DataCenterDataType" SG_ 596 EXV2_Rsp_Fault_Stat "Varchar(30)";
BA_ "DataCenterDataType" SG_ 596 EXV2_Rsp_OvrTemp_Warn "Varchar(30)";
BA_ "DataCenterDataType" SG_ 596 EXV2_Rsp_Volt_Stat "Varchar(30)";
BA_ "DataCenterDataType" SG_ 596 EXV2_RsErr_EXV "Varchar(30)";
BA_ "DataCenterDataType" SG_ 596 CCV4_Fault_Signal "Varchar(30)";
BA_ "DataCenterDataType" SG_ 596 CCV4_TempWarn "Varchar(30)";
BA_ "DataCenterDataType" SG_ 596 CCV4_Rsp_Comm_Err "Varchar(30)";
BA_ "DataCenterDataType" SG_ 596 CCV4_voltageErr "Varchar(15)";
VAL_ 550 RLS_LIN_Resp_Err 1 "Error" 0 "Normal";
VAL_ 550 RLS_LightSnrErr 1 "LS error" 0 "LS no error";
VAL_ 550 RLS_RainSnrErr 1 "RS error" 0 "RS no error";
VAL_ 550 CSW_resp_error 1 "Error" 0 "Normal";
VAL_ 550 RLS_Lamp_Sta 1 "Lamps ON" 0 "Lamps OFF";
VAL_ 550 RLS_RainSnrWiperCmd 7 "Failure" 3 "High Speed" 2 "Low Speed" 0 "Off";
VAL_ 550 CSW_FWipSw_Sta 7 "invalid" 3 "High" 2 "Low" 1 "Auto" 0 "OFF";
VAL_ 550 CSW_TurnSw_Sta 3 "invalid" 2 "Right" 1 "Left" 0 "OFF";
VAL_ 550 CSW_RWasSW_Sta 3 "invalid" 1 "Press" 0 "Release";
VAL_ 550 CSW_FWasSw_Sta 3 "invalid" 2 "Mist" 1 "ON" 0 "OFF";
VAL_ 550 CSW_PassSW_Sta 1 "Press" 0 "Release";
VAL_ 550 CSW_DimSw 1 "On" 0 "Off";
VAL_ 550 CSW_RWipIntSw_Sta 3 "Invalid" 2 "Low" 1 "int" 0 "off";
VAL_ 550 SWC_Drivemode_Sta 1 "Press" 0 "Release";
VAL_ 550 SWC_CANCEL_Sta 1 "Press" 0 "Release";
VAL_ 550 SWC_ACC_Sta 1 "Press" 0 "Release";
VAL_ 550 SWC_A_Resp_Err 1 "Error" 0 "Normal";
VAL_ 550 SWC_Distance_Sta 1 "Press" 0 "Release";
VAL_ 550 SWC_Down_Sta 1 "Press" 0 "Release";
VAL_ 550 SWC_RegenUp 1 "Press" 0 "Release";
VAL_ 550 SWC_Left_Sta 1 "Press" 0 "Release";
VAL_ 550 SWC_mode_Sta 1 "Press" 0 "Release";
VAL_ 550 SWC_resp_error 1 "Error" 0 "Normal";
VAL_ 550 SWC_Res_Up_Sta 1 "Press" 0 "Release";
VAL_ 550 SWC_RegenDown 1 "Press" 0 "Release";
VAL_ 550 SWC_Right_Sta 1 "Press" 0 "Release";
VAL_ 550 SWC_Set_down_Sta 1 "Press" 0 "Release";
VAL_ 550 SWC_Trip_Sta 1 "Press" 0 "Release";
VAL_ 550 SWC_Up_Sta 1 "Press" 0 "Release";
VAL_ 550 SWC_VR_Sta 1 "Press" 0 "Release";
VAL_ 550 SWC_Undefined_Sta 1 "Press" 0 "Release";
VAL_ 550 SWC_LKA_Sta 1 "Press" 0 "Release";
VAL_ 550 L_Pas_Wdw_Obs_InhibitSts 1 "Obs Inhibit status" 0 "Not Obs Inhibit status";
VAL_ 550 L_Drv_Wdw_RRD_Switch 7 "Error" 6 "Reserved" 5 "Reserved" 4 "Auto Down" 3 "Auto Up" 2 "Manual Down" 1 "Manual Up" 0 "Inactive";
VAL_ 550 L_Drv_Wdw_RLD_Switch 7 "Error" 6 "Reserved" 5 "Reserved" 4 "Auto Down" 3 "Auto Up" 2 "Manual Down" 1 "Manual Up" 0 "Inactive";
VAL_ 550 L_Pas_Wdw_OD_Sts 1 "In Anti-pinch status" 0 "Non anti-pinch status";
VAL_ 550 L_Pas_Wdw_Init 1 "Window init complete" 0 "Window init incomplete";
VAL_ 550 L_Pas_OverHeat_Protect 1 "Active" 0 "Inactive";
VAL_ 550 L_Pas_Motor_Relay_Error 1 "Error" 0 "Normal";
VAL_ 550 L_Pas_Motor_Ripple_Error 1 "Error" 0 "Normal";
VAL_ 550 L_Drv_Wdw_Pas_Switch 7 "Error" 6 "Reserved" 5 "Reserved" 4 "Auto Down" 3 "Auto Up" 2 "Manual Down" 1 "Manual Up" 0 "Inactive";
VAL_ 550 L_Pas_Val_Wdw_Opened 127 "Invalid";
VAL_ 550 L_Pas_Wdw_PositionSts 3 "Invalid" 2 "Complete Close" 1 "Complete Open" 0 "Middle position";
VAL_ 550 L_Pas_Wdw_LocalSwitch 7 "Error" 6 "Reserved" 5 "Reserved" 4 "Auto Down" 3 "Auto Up" 2 "Manual Down" 1 "Manual Up" 0 "Inactive";
VAL_ 550 L_Pas_Wdw_Running_Sts 7 "Reserved" 5 "Reserved" 4 "Auto Down" 3 "Auto Up" 2 "Manual Down" 1 "Manual Up" 0 "Window stop";
VAL_ 550 L_Power_Status 3 "Voltage>16V" 2 "Voltage<9V" 1 "9V<Voltage<16V" 0 "Default";
VAL_ 550 FAPWL_01_LIN_Response_Error 1 "Error" 0 "Normal";
VAL_ 550 L_Drv_Wdw_Obs_InhibitSts 1 "Obs Inhibit status" 0 "Not Obs Inhibit status";
VAL_ 550 L_Drv_Wdw_OD_Sts 1 "In Anti-pinch status" 0 "Non anti-pinch status";
VAL_ 550 L_Drv_Wdw_Init 1 "Window init complete" 0 "Window init incomplete";
VAL_ 550 L_Drv_OverHeat_Protect 1 "Active" 0 "Inactive";
VAL_ 550 L_Drv_Motor_Relay_Error 1 "Error" 0 "Normal";
VAL_ 550 L_Drv_Motor_Ripple_Error 1 "Error" 0 "Normal";
VAL_ 550 L_Drv_Val_Wdw_Opened 127 "Invalid";
VAL_ 550 L_Drv_Wdw_PositionSts 3 "Invalid" 2 "Complete Close" 1 "Complete Open" 0 "Middle position";
VAL_ 550 L_Drv_Wdw_LocalSwitch 7 "Error" 6 "Reserved" 5 "Reserved" 4 "Auto Down" 3 "Auto Up" 2 "Manual Down" 1 "Manual Up" 0 "Inactive";
VAL_ 550 L_Drv_Wdw_Running_Sts 7 "Reserved" 5 "Reserved" 4 "Auto Down" 3 "Auto Up" 2 "Manual Down" 1 "Manual Up" 0 "Window stop";
VAL_ 550 L_RLD_Wdw_Init 1 "Window init complete" 0 "Window init incomplete";
VAL_ 550 L_RRD_Val_Wdw_Opened 127 "Invalid";
VAL_ 550 L_RRD_Wdw_PositionSts 3 "Invalid" 2 "Complete Close" 1 "Complete Open" 0 "Middle position";
VAL_ 550 L_RRD_Wdw_Obs_InhibitSts 1 "Obs Inhibit status" 0 "Not Obs Inhibit status";
VAL_ 550 L_RRD_Wdw_OD_Sts 1 "In Anti-pinch status" 0 "Non anti-pinch status";
VAL_ 550 L_RRD_Wdw_Init 1 "Window init complete" 0 "Window init incomplete";
VAL_ 550 L_RRD_OverHeat_Protect 1 "Active" 0 "Inactive";
VAL_ 550 L_RRD_Motor_Relay_Error 1 "Error" 0 "Normal";
VAL_ 550 L_RRD_Motor_Ripple_Error 1 "Error" 0 "Normal";
VAL_ 550 L_RRD_Wdw_LocalSwitch 7 "Error" 6 "Reserved" 5 "Reserved" 4 "Auto Down" 3 "Auto Up" 2 "Manual Down" 1 "Manual Up" 0 "Inactive";
VAL_ 550 L_RRD_Wdw_Running_Sts 7 "Reserved" 5 "Reserved" 4 "Auto Down" 3 "Auto Up" 2 "Manual Down" 1 "Manual Up" 0 "Window stop";
VAL_ 550 RAPWL_01_LIN_Response_Error 1 "Error" 0 "Normal";
VAL_ 550 L_RLD_Wdw_Obs_InhibitSts 1 "Obs Inhibit status" 0 "Not Obs Inhibit status";
VAL_ 550 L_RLD_Wdw_OD_Sts 1 "In Anti-pinch status" 0 "Non anti-pinch status";
VAL_ 550 L_RLD_Val_Wdw_Opened 127 "Invalid";
VAL_ 550 L_RLD_OverHeat_Protect 1 "Active" 0 "Inactive";
VAL_ 550 L_RLD_Motor_Relay_Error 1 "Error" 0 "Normal";
VAL_ 550 L_RLD_Motor_Ripple_Error 1 "Error" 0 "Normal";
VAL_ 550 L_RLD_Wdw_PositionSts 3 "Invalid" 2 "Complete Close" 1 "Complete Open" 0 "Middle position";
VAL_ 550 L_RLD_Wdw_LocalSwitch 7 "Error" 6 "Reserved" 5 "Reserved" 4 "Auto Down" 3 "Auto Up" 2 "Manual Down" 1 "Manual Up" 0 "Inactive";
VAL_ 550 L_RLD_Wdw_Running_Sts 7 "Reserved" 5 "Reserved" 4 "Auto Down" 3 "Auto Up" 2 "Manual Down" 1 "Manual Up" 0 "Window stop";
VAL_ 550 SWC2_R_Right_Sta 1 "Press" 0 "Release";
VAL_ 550 SWC2_R_ScrollUp_Sta 1 "Press" 0 "Release";
VAL_ 550 SWC2_R_ScrollPress_Sta 1 "Press" 0 "Release";
VAL_ 550 SWC2_R_ScrollDown_Sta 1 "Press" 0 "Release";
VAL_ 550 SWC2_R_Left_Sta 1 "Press" 0 "Release";
VAL_ 550 SWC2_R_VR_Sta 1 "Press" 0 "Release";
VAL_ 550 SWC2_R_PageSwitch_Sta 1 "Press" 0 "Release";
VAL_ 550 SWC2_R_Customize_Sta 1 "Press" 0 "Release";
VAL_ 550 SWC2_L_Left_Sta 1 "Press" 0 "Release";
VAL_ 550 SWC2_L_ScrollUp_Sta 1 "Press" 0 "Release";
VAL_ 550 SWC2_L_ScrollPress_Sta 1 "Press" 0 "Release";
VAL_ 550 SWC2_L_ScrollDown_Sta 1 "Press" 0 "Release";
VAL_ 550 SWC2_L_Right_Sta 1 "Press" 0 "Release";
VAL_ 550 SWC2_L_RegenUp_Sta 1 "Press" 0 "Release";
VAL_ 550 SWC2_L_ADAS_Sta 1 "Press" 0 "Release";
VAL_ 550 SWC2_L_Home_Sta 1 "Press" 0 "Release";
VAL_ 550 SWC2_ResponseError 1 "Error" 0 "Normal";
VAL_ 550 SWC2_R_RegenDown_Sta 1 "Press" 0 "Release";
VAL_ 550 SWC2_L_DriveMode_Sta 1 "Press" 0 "Release";
VAL_ 805 ACT5_Stop_mode 1 "Stop" 0 "Normal";
VAL_ 805 ACT5_Speed_specification 5 "AutoSpeed" 4 "Speed_4" 3 "Speed_3" 2 "Speed_2" 1 "Speed_1";
VAL_ 805 ACT5_Select_position_specification 1 "Start_Position" 0 "Set_Position";
VAL_ 805 ACT5_Clear_Event_Flags 14 "AllEventClear" 0 "NotClear";
VAL_ 805 ACT4_Stop_mode 1 "Stop" 0 "Normal";
VAL_ 805 ACT4_Speed_specification 5 "AutoSpeed" 4 "Speed_4" 3 "Speed_3" 2 "Speed_2" 1 "Speed_1";
VAL_ 805 ACT4_Select_position_specification 1 "Start_Position" 0 "Set_Position";
VAL_ 805 ACT4_Clear_Event_Flags 14 "AllEventClear" 0 "NotClear";
VAL_ 805 ACT3_Stop_mode 1 "Stop" 0 "Normal";
VAL_ 805 ACT3_Speed_specification 5 "AutoSpeed" 4 "Speed_4" 3 "Speed_3" 2 "Speed_2" 1 "Speed_1";
VAL_ 805 ACT3_Select_position_specification 1 "Start_Position" 0 "Set_Position";
VAL_ 805 ACT3_Clear_Event_Flags 14 "AllEventClear" 0 "NotClear";
VAL_ 805 ACT2_Stop_mode 1 "Stop" 0 "Normal";
VAL_ 805 ACT2_Speed_specification 5 "AutoSpeed" 4 "Speed_4" 3 "Speed_3" 2 "Speed_2" 1 "Speed_1";
VAL_ 805 ACT2_Select_position_specification 1 "Start_Position" 0 "Set_Position";
VAL_ 805 ACT2_Clear_Event_Flags 14 "AllEventClear" 0 "NotClear";
VAL_ 805 ACT1_Stop_mode 1 "Stop" 0 "Normal";
VAL_ 805 ACT1_Speed_specification 5 "AutoSpeed" 4 "Speed_4" 3 "Speed_3" 2 "Speed_2" 1 "Speed_1";
VAL_ 805 ACT1_Select_position_specification 1 "Start_Position" 0 "Set_Position";
VAL_ 805 ACT1_Clear_Event_Flags 14 "AllEventClear" 0 "NotClear";
VAL_ 805 HornSW 1 "Press" 0 "Release";
VAL_ 805 AllLockSta 1 "Lock" 0 "Unlcok";
VAL_ 805 AutoLightSW 1 "EnableAutolamps" 0 "DisableAutolamps";
VAL_ 805 BrakeLampFail 1 "Fail" 0 "Normal";
VAL_ 805 DrLockSta 1 "Lock" 0 "Unlcok";
VAL_ 805 WiperSWPos 255 "Invalid" 8 "wash mode" 4 "wiper in HS mode(manual)" 2 "wiper in LS mode(manual)" 1 "wiper in Auto mode" 16 "mist mode" 0 "wiper off";
VAL_ 805 RRTurnLampC 255 "Invalid";
VAL_ 805 RLTurnLampC 255 "Invalid";
VAL_ 805 Wip_Speed 3 "High speed" 2 "Low speed" 1 "Intermittent" 0 "OFF";
VAL_ 805 MIRROR_FOLD_SW 1 "Press" 0 "Release";
VAL_ 805 PsLockSta 1 "Lock" 0 "Unlcok";
VAL_ 805 RLLockSta 1 "Lock" 0 "Unlcok";
VAL_ 805 RLS_Exist 1 "Exist" 0 "Not Exist";
VAL_ 805 RRLockSta 1 "Lock" 0 "Unlcok";
VAL_ 805 RWiperAS 1 "Not at Stop Position" 0 "Stop Position";
VAL_ 805 RWiperProtection 1 "In protection" 0 "Not in Protectio";
VAL_ 805 WiperZeroPosSW 1 "Wiper is not in zero position" 0 "Wiper is in zero position";
VAL_ 805 RLTurnLPErr 1 "Error" 0 "Normal";
VAL_ 805 RRTurnLPErr 1 "Error" 0 "Normal";
VAL_ 805 ZDR_THCM_IntakeFail_Sta 2 "NG" 1 "OK" 0 "Checking";
VAL_ 805 ZDR_THCM_LINACT1_Sta 2 "NG" 1 "OK" 0 "Checking";
VAL_ 805 ZDR_THCM_LINACT2_Sta 2 "NG" 1 "OK" 0 "Checking";
VAL_ 805 ZDR_THCM_LINACT3_Sta 2 "NG" 1 "OK" 0 "Checking";
VAL_ 805 ZDR_THCM_LINACT4_Sta 2 "NG" 1 "OK" 0 "Checking";
VAL_ 805 ZDR_THCM_LINACT5_Sta 2 "NG" 1 "OK" 0 "Checking";
VAL_ 805 ZDR_THCM_ModeFail_Sta 2 "NG" 1 "OK" 0 "Checking";
VAL_ 552 AGS_Actual_Position 240 "90^Deg" 208 "78^Deg" 176 "66^Deg" 144 "54^Deg" 112 "42^Deg" 80 "30^Deg" 48 "18^Deg" 16 "6^Deg" 224 "84^Deg" 192 "72^Deg" 160 "60^Deg" 128 "48^Deg" 96 "36^Deg" 64 "24^Deg" 32 "12^Deg" 0 "0^Deg";
VAL_ 552 AGS_Low_Voltage_Error 1 "ERROR" 0 "NO_Voltage_ERROR";
VAL_ 552 AGS_Temperature_Error 1 "ERROR" 0 "NO_ERROR";
VAL_ 552 AGS_Sensor_Error 1 "ERROR" 0 "NO_ERROR";
VAL_ 552 AGS_Electrical_Error 1 "ERROR" 0 "NO_ERROR";
VAL_ 552 AGS_Calibration_Indicated 1 "CALIBRATION_REQ" 0 "NO_CALIBRATION";
VAL_ 552 AGS_Calibration_Active 1 "Caliberation_Process_active" 0 "Caliberation_process_inactive";
VAL_ 552 AGS_Actuator_Fault 1 "ERROR" 0 "NO_ERROR";
VAL_ 552 AGS_Actuator_Blocked 1 "ERROR" 0 "NO_ERROR";
VAL_ 552 AGS_LINResponse_Error 1 "ERROR" 0 "NO_ERROR";
VAL_ 552 ION_IONErr_Sta 3 "AirClngErrSts_OpenCircuit" 2 "AirClngErrSts_ShortCircuit" 1 "AirClngErrSts_Err" 0 "AirClngErrSts_NoErr";
VAL_ 552 ION_IONRespErr_Sta 1 "Error" 0 "Normal";
VAL_ 552 ION_ION_Sta 1 "ON" 0 "OFF";
VAL_ 552 FGS_LifeHole3_Sta 511 "Invalid" 361 "~0x1FE Reserved";
VAL_ 552 FGS_LifeHole2_Sta 511 "Invalid" 361 "~0x1FE Reserved";
VAL_ 552 FGS_LifeHole1_Sta 511 "Invalid" 361 "~0x1FE Reserved";
VAL_ 552 FGS_Channel3TypeRsp_Sta 15 "Invalid" 14 "Reserved" 13 "Reserved" 12 "Reserved" 11 "Reserved" 10 "Reserved" 9 "Reserved" 8 "Reserved" 7 "Type 7" 6 "Type 6" 5 "Type 5" 4 "Type 4" 3 "Type 3" 2 "Type 2" 1 "Type 1" 0 "Inactive";
VAL_ 552 FGS_Channel2TypeRsp_Sta 15 "Invalid" 14 "Reserved" 13 "Reserved" 12 "Reserved" 11 "Reserved" 10 "Reserved" 9 "Reserved" 8 "Reserved" 7 "Type 7" 6 "Type 6" 5 "Type 5" 4 "Type 4" 3 "Type 3" 2 "Type 2" 1 "Type 1" 0 "Inactive";
VAL_ 552 FGS_Channel1TypeRsp_Sta 15 "Invalid" 14 "Reserved" 13 "Reserved" 12 "Reserved" 11 "Reserved" 10 "Reserved" 9 "Reserved" 8 "Reserved" 7 "Type 7" 6 "Type 6" 5 "Type 5" 4 "Type 4" 3 "Type 3" 2 "Type 2" 1 "Type 1" 0 "Inactive";
VAL_ 552 FGS_BlowerErr_Sta 1 "Error" 0 "No Error";
VAL_ 552 FGS_IntenRsp_Sta 15 "Invalid" 14 "Reserved" 13 "Reserved" 12 "Reserved" 11 "Reserved" 10 "Reserved" 9 "Reserved" 8 "Reserved" 7 "Reserved" 6 "Reserved" 5 "Reserved" 4 "Level 4" 3 "Level 3" 2 "Level 2" 1 "Level 1" 0 "Inactive";
VAL_ 552 FGS_MotorErr_Sta 1 "Error" 0 "No Error";
VAL_ 552 FGS_TypRsp_Sta 7 "Reserved" 6 "Reserved" 5 "Reserved" 4 "Reserved" 3 "Channel 3" 2 "Channel 2" 1 "Channel 1" 0 "Inactive";
VAL_ 552 FGS_LINResponseErr_Sta 1 "Error" 0 "No Error";
VAL_ 552 FGS_StsRsp_Sta 1 "ON" 0 "OFF";
VAL_ 552 FGS_Channel_Index_Sta 3 "Channel 3" 2 "Channel 2" 1 "Channel 1" 0 "Inactive";
VAL_ 796 BMSReqTapPosHSC6 7 "7 Tap" 6 "6 Tap" 5 "5 Tap" 4 "4 Tap" 3 "3 Tap" 2 "2 Tap" 1 "1 Tap" 0 "0 Tap";
VAL_ 796 BMSReqMdHSC6 3 "PWM Control" 2 "Tap Position Control" 1 "Power Control" 0 "No Request";
VAL_ 796 BMSEnbPTCHSC6 1 "On" 0 "Off";
VAL_ 796 FRTurnLampC 255 "Invalid";
VAL_ 796 FLTurnLampC 255 "Invalid";
VAL_ 796 ChargeInletLockSta 1 "Lock" 0 "Unlock";
VAL_ 796 FWiperAS 1 "Not at Stop Position" 0 "Stop Position";
VAL_ 796 FWiperProtection 1 "In protection" 0 "Not in Protection";
VAL_ 796 BDC_1_MoveEnable 1 "ReqMotorMove" 0 "NoReq";
VAL_ 796 CCV4_MoveEnable 1 "ReqMotorMove" 0 "NoReq";
VAL_ 796 CCV4_ReqMovePos 1 "Open Port 1 to Port 4, Port 2 to port 3" 0 "Open Port 1 to Port 2, Port 3 to port 4";
VAL_ 796 CompProEN 1 "Enable" 0 "Disable";
VAL_ 796 EXV_Cmd_Set_Rq 65535 "Invalid";
VAL_ 796 EXV2_Cmd_Set_Rq 65535 "Invalid";
VAL_ 796 EWP3_RPM_Target_EWP_Rq 255 "Invalid" 254 "max speed rpm" 253 "max speed rpm" 252 "max speed rpm" 251 "max speed rpm" 250 "linearly changed from min speed to max speed" 249 "linearly changed from min speed to max speed" 248 "linearly changed from min speed to max speed" 247 "linearly changed from min speed to max speed" 246 "linearly changed from min speed to max speed" 245 "linearly changed from min speed to max speed" 244 "linearly changed from min speed to max speed" 243 "linearly changed from min speed to max speed" 242 "linearly changed from min speed to max speed" 241 "linearly changed from min speed to max speed" 240 "linearly changed from min speed to max speed" 239 "linearly changed from min speed to max speed" 238 "linearly changed from min speed to max speed" 237 "linearly changed from min speed to max speed" 236 "linearly changed from min speed to max speed" 235 "linearly changed from min speed to max speed" 234 "linearly changed from min speed to max speed" 233 "linearly changed from min speed to max speed" 232 "linearly changed from min speed to max speed" 231 "linearly changed from min speed to max speed" 230 "linearly changed from min speed to max speed" 229 "linearly changed from min speed to max speed" 228 "linearly changed from min speed to max speed" 227 "linearly changed from min speed to max speed" 226 "linearly changed from min speed to max speed" 225 "linearly changed from min speed to max speed" 224 "linearly changed from min speed to max speed" 223 "linearly changed from min speed to max speed" 222 "linearly changed from min speed to max speed" 221 "linearly changed from min speed to max speed" 220 "linearly changed from min speed to max speed" 219 "linearly changed from min speed to max speed" 218 "linearly changed from min speed to max speed" 217 "linearly changed from min speed to max speed" 216 "linearly changed from min speed to max speed" 215 "linearly changed from min speed to max speed" 214 "linearly changed from min speed to max speed" 213 "linearly changed from min speed to max speed" 212 "linearly changed from min speed to max speed" 211 "linearly changed from min speed to max speed" 210 "linearly changed from min speed to max speed" 209 "linearly changed from min speed to max speed" 208 "linearly changed from min speed to max speed" 207 "linearly changed from min speed to max speed" 206 "linearly changed from min speed to max speed" 205 "linearly changed from min speed to max speed" 204 "linearly changed from min speed to max speed" 203 "linearly changed from min speed to max speed" 202 "linearly changed from min speed to max speed" 201 "linearly changed from min speed to max speed" 200 "linearly changed from min speed to max speed" 199 "linearly changed from min speed to max speed" 198 "linearly changed from min speed to max speed" 197 "linearly changed from min speed to max speed" 196 "linearly changed from min speed to max speed" 195 "linearly changed from min speed to max speed" 194 "linearly changed from min speed to max speed" 193 "linearly changed from min speed to max speed" 192 "linearly changed from min speed to max speed" 191 "linearly changed from min speed to max speed" 190 "linearly changed from min speed to max speed" 189 "linearly changed from min speed to max speed" 188 "linearly changed from min speed to max speed" 187 "linearly changed from min speed to max speed" 186 "linearly changed from min speed to max speed" 185 "linearly changed from min speed to max speed" 184 "linearly changed from min speed to max speed" 183 "linearly changed from min speed to max speed" 182 "linearly changed from min speed to max speed" 181 "linearly changed from min speed to max speed" 180 "linearly changed from min speed to max speed" 179 "linearly changed from min speed to max speed" 178 "linearly changed from min speed to max speed" 177 "linearly changed from min speed to max speed" 176 "linearly changed from min speed to max speed" 175 "linearly changed from min speed to max speed" 174 "linearly changed from min speed to max speed" 173 "linearly changed from min speed to max speed" 172 "linearly changed from min speed to max speed" 171 "linearly changed from min speed to max speed" 170 "linearly changed from min speed to max speed" 169 "linearly changed from min speed to max speed" 168 "linearly changed from min speed to max speed" 167 "linearly changed from min speed to max speed" 166 "linearly changed from min speed to max speed" 165 "linearly changed from min speed to max speed" 164 "linearly changed from min speed to max speed" 163 "linearly changed from min speed to max speed" 162 "linearly changed from min speed to max speed" 161 "linearly changed from min speed to max speed" 160 "linearly changed from min speed to max speed" 159 "linearly changed from min speed to max speed" 158 "linearly changed from min speed to max speed" 157 "linearly changed from min speed to max speed" 156 "linearly changed from min speed to max speed" 155 "linearly changed from min speed to max speed" 154 "linearly changed from min speed to max speed" 153 "linearly changed from min speed to max speed" 152 "linearly changed from min speed to max speed" 151 "linearly changed from min speed to max speed" 150 "linearly changed from min speed to max speed" 149 "linearly changed from min speed to max speed" 148 "linearly changed from min speed to max speed" 147 "linearly changed from min speed to max speed" 146 "linearly changed from min speed to max speed" 145 "linearly changed from min speed to max speed" 144 "linearly changed from min speed to max speed" 143 "linearly changed from min speed to max speed" 142 "linearly changed from min speed to max speed" 141 "linearly changed from min speed to max speed" 140 "linearly changed from min speed to max speed" 139 "linearly changed from min speed to max speed" 138 "linearly changed from min speed to max speed" 137 "linearly changed from min speed to max speed" 136 "linearly changed from min speed to max speed" 135 "linearly changed from min speed to max speed" 134 "linearly changed from min speed to max speed" 133 "linearly changed from min speed to max speed" 132 "linearly changed from min speed to max speed" 131 "linearly changed from min speed to max speed" 130 "linearly changed from min speed to max speed" 129 "linearly changed from min speed to max speed" 128 "linearly changed from min speed to max speed" 127 "linearly changed from min speed to max speed" 126 "linearly changed from min speed to max speed" 125 "linearly changed from min speed to max speed" 124 "linearly changed from min speed to max speed" 123 "linearly changed from min speed to max speed" 122 "linearly changed from min speed to max speed" 121 "linearly changed from min speed to max speed" 120 "linearly changed from min speed to max speed" 119 "linearly changed from min speed to max speed" 118 "linearly changed from min speed to max speed" 117 "linearly changed from min speed to max speed" 116 "linearly changed from min speed to max speed" 115 "linearly changed from min speed to max speed" 114 "linearly changed from min speed to max speed" 113 "linearly changed from min speed to max speed" 112 "linearly changed from min speed to max speed" 111 "linearly changed from min speed to max speed" 110 "linearly changed from min speed to max speed" 109 "linearly changed from min speed to max speed" 108 "linearly changed from min speed to max speed" 107 "linearly changed from min speed to max speed" 106 "linearly changed from min speed to max speed" 105 "linearly changed from min speed to max speed" 104 "linearly changed from min speed to max speed" 103 "linearly changed from min speed to max speed" 102 "linearly changed from min speed to max speed" 101 "linearly changed from min speed to max speed" 100 "linearly changed from min speed to max speed" 99 "linearly changed from min speed to max speed" 98 "linearly changed from min speed to max speed" 97 "linearly changed from min speed to max speed" 96 "linearly changed from min speed to max speed" 95 "linearly changed from min speed to max speed" 94 "linearly changed from min speed to max speed" 93 "linearly changed from min speed to max speed" 92 "linearly changed from min speed to max speed" 91 "linearly changed from min speed to max speed" 90 "linearly changed from min speed to max speed" 89 "linearly changed from min speed to max speed" 88 "linearly changed from min speed to max speed" 87 "linearly changed from min speed to max speed" 86 "linearly changed from min speed to max speed" 85 "linearly changed from min speed to max speed" 84 "linearly changed from min speed to max speed" 83 "linearly changed from min speed to max speed" 82 "linearly changed from min speed to max speed" 81 "linearly changed from min speed to max speed" 80 "linearly changed from min speed to max speed" 79 "linearly changed from min speed to max speed" 78 "linearly changed from min speed to max speed" 77 "linearly changed from min speed to max speed" 76 "linearly changed from min speed to max speed" 75 "linearly changed from min speed to max speed" 74 "linearly changed from min speed to max speed" 73 "linearly changed from min speed to max speed" 72 "linearly changed from min speed to max speed" 71 "linearly changed from min speed to max speed" 70 "linearly changed from min speed to max speed" 69 "linearly changed from min speed to max speed" 68 "linearly changed from min speed to max speed" 67 "linearly changed from min speed to max speed" 66 "linearly changed from min speed to max speed" 65 "linearly changed from min speed to max speed" 64 "linearly changed from min speed to max speed" 63 "linearly changed from min speed to max speed" 62 "linearly changed from min speed to max speed" 61 "linearly changed from min speed to max speed" 60 "linearly changed from min speed to max speed" 59 "linearly changed from min speed to max speed" 58 "linearly changed from min speed to max speed" 57 "linearly changed from min speed to max speed" 56 "linearly changed from min speed to max speed" 55 "linearly changed from min speed to max speed" 54 "linearly changed from min speed to max speed" 53 "linearly changed from min speed to max speed" 52 "linearly changed from min speed to max speed" 51 "linearly changed from min speed to max speed" 50 "linearly changed from min speed to max speed" 49 "min speed rpm" 48 "min speed rpm" 47 "min speed rpm" 46 "min speed rpm" 45 "min speed rpm" 44 "min speed rpm" 43 "min speed rpm" 42 "min speed rpm" 41 "min speed rpm" 40 "min speed rpm" 39 "min speed rpm" 38 "min speed rpm" 37 "min speed rpm" 36 "min speed rpm" 35 "min speed rpm" 34 "min speed rpm" 33 "min speed rpm" 32 "min speed rpm" 31 "min speed rpm" 30 "min speed rpm" 29 "min speed rpm" 28 "min speed rpm" 27 "min speed rpm" 26 "min speed rpm" 25 "min speed rpm" 24 "min speed rpm" 23 "min speed rpm" 22 "min speed rpm" 21 "min speed rpm" 20 "min speed rpm" 19 "min speed rpm" 18 "min speed rpm" 17 "min speed rpm" 16 "min speed rpm" 15 "min speed rpm" 14 "min speed rpm" 13 "min speed rpm" 12 "min speed rpm" 11 "min speed rpm" 10 "min speed rpm" 9 "min speed rpm" 8 "min speed rpm" 7 "min speed rpm" 6 "min speed rpm" 5 "min speed rpm" 4 "min speed rpm" 3 "0 rpm" 2 "0 rpm" 1 "0 rpm" 0 "0 rpm";
VAL_ 796 EWP2_RPM_Target_EWP_Rq 255 "Invalid" 254 "max speed rpm" 253 "max speed rpm" 252 "max speed rpm" 251 "max speed rpm" 250 "linearly changed from min speed to max speed" 249 "linearly changed from min speed to max speed" 248 "linearly changed from min speed to max speed" 247 "linearly changed from min speed to max speed" 246 "linearly changed from min speed to max speed" 245 "linearly changed from min speed to max speed" 244 "linearly changed from min speed to max speed" 243 "linearly changed from min speed to max speed" 242 "linearly changed from min speed to max speed" 241 "linearly changed from min speed to max speed" 240 "linearly changed from min speed to max speed" 239 "linearly changed from min speed to max speed" 238 "linearly changed from min speed to max speed" 237 "linearly changed from min speed to max speed" 236 "linearly changed from min speed to max speed" 235 "linearly changed from min speed to max speed" 234 "linearly changed from min speed to max speed" 233 "linearly changed from min speed to max speed" 232 "linearly changed from min speed to max speed" 231 "linearly changed from min speed to max speed" 230 "linearly changed from min speed to max speed" 229 "linearly changed from min speed to max speed" 228 "linearly changed from min speed to max speed" 227 "linearly changed from min speed to max speed" 226 "linearly changed from min speed to max speed" 225 "linearly changed from min speed to max speed" 224 "linearly changed from min speed to max speed" 223 "linearly changed from min speed to max speed" 222 "linearly changed from min speed to max speed" 221 "linearly changed from min speed to max speed" 220 "linearly changed from min speed to max speed" 219 "linearly changed from min speed to max speed" 218 "linearly changed from min speed to max speed" 217 "linearly changed from min speed to max speed" 216 "linearly changed from min speed to max speed" 215 "linearly changed from min speed to max speed" 214 "linearly changed from min speed to max speed" 213 "linearly changed from min speed to max speed" 212 "linearly changed from min speed to max speed" 211 "linearly changed from min speed to max speed" 210 "linearly changed from min speed to max speed" 209 "linearly changed from min speed to max speed" 208 "linearly changed from min speed to max speed" 207 "linearly changed from min speed to max speed" 206 "linearly changed from min speed to max speed" 205 "linearly changed from min speed to max speed" 204 "linearly changed from min speed to max speed" 203 "linearly changed from min speed to max speed" 202 "linearly changed from min speed to max speed" 201 "linearly changed from min speed to max speed" 200 "linearly changed from min speed to max speed" 199 "linearly changed from min speed to max speed" 198 "linearly changed from min speed to max speed" 197 "linearly changed from min speed to max speed" 196 "linearly changed from min speed to max speed" 195 "linearly changed from min speed to max speed" 194 "linearly changed from min speed to max speed" 193 "linearly changed from min speed to max speed" 192 "linearly changed from min speed to max speed" 191 "linearly changed from min speed to max speed" 190 "linearly changed from min speed to max speed" 189 "linearly changed from min speed to max speed" 188 "linearly changed from min speed to max speed" 187 "linearly changed from min speed to max speed" 186 "linearly changed from min speed to max speed" 185 "linearly changed from min speed to max speed" 184 "linearly changed from min speed to max speed" 183 "linearly changed from min speed to max speed" 182 "linearly changed from min speed to max speed" 181 "linearly changed from min speed to max speed" 180 "linearly changed from min speed to max speed" 179 "linearly changed from min speed to max speed" 178 "linearly changed from min speed to max speed" 177 "linearly changed from min speed to max speed" 176 "linearly changed from min speed to max speed" 175 "linearly changed from min speed to max speed" 174 "linearly changed from min speed to max speed" 173 "linearly changed from min speed to max speed" 172 "linearly changed from min speed to max speed" 171 "linearly changed from min speed to max speed" 170 "linearly changed from min speed to max speed" 169 "linearly changed from min speed to max speed" 168 "linearly changed from min speed to max speed" 167 "linearly changed from min speed to max speed" 166 "linearly changed from min speed to max speed" 165 "linearly changed from min speed to max speed" 164 "linearly changed from min speed to max speed" 163 "linearly changed from min speed to max speed" 162 "linearly changed from min speed to max speed" 161 "linearly changed from min speed to max speed" 160 "linearly changed from min speed to max speed" 159 "linearly changed from min speed to max speed" 158 "linearly changed from min speed to max speed" 157 "linearly changed from min speed to max speed" 156 "linearly changed from min speed to max speed" 155 "linearly changed from min speed to max speed" 154 "linearly changed from min speed to max speed" 153 "linearly changed from min speed to max speed" 152 "linearly changed from min speed to max speed" 151 "linearly changed from min speed to max speed" 150 "linearly changed from min speed to max speed" 149 "linearly changed from min speed to max speed" 148 "linearly changed from min speed to max speed" 147 "linearly changed from min speed to max speed" 146 "linearly changed from min speed to max speed" 145 "linearly changed from min speed to max speed" 144 "linearly changed from min speed to max speed" 143 "linearly changed from min speed to max speed" 142 "linearly changed from min speed to max speed" 141 "linearly changed from min speed to max speed" 140 "linearly changed from min speed to max speed" 139 "linearly changed from min speed to max speed" 138 "linearly changed from min speed to max speed" 137 "linearly changed from min speed to max speed" 136 "linearly changed from min speed to max speed" 135 "linearly changed from min speed to max speed" 134 "linearly changed from min speed to max speed" 133 "linearly changed from min speed to max speed" 132 "linearly changed from min speed to max speed" 131 "linearly changed from min speed to max speed" 130 "linearly changed from min speed to max speed" 129 "linearly changed from min speed to max speed" 128 "linearly changed from min speed to max speed" 127 "linearly changed from min speed to max speed" 126 "linearly changed from min speed to max speed" 125 "linearly changed from min speed to max speed" 124 "linearly changed from min speed to max speed" 123 "linearly changed from min speed to max speed" 122 "linearly changed from min speed to max speed" 121 "linearly changed from min speed to max speed" 120 "linearly changed from min speed to max speed" 119 "linearly changed from min speed to max speed" 118 "linearly changed from min speed to max speed" 117 "linearly changed from min speed to max speed" 116 "linearly changed from min speed to max speed" 115 "linearly changed from min speed to max speed" 114 "linearly changed from min speed to max speed" 113 "linearly changed from min speed to max speed" 112 "linearly changed from min speed to max speed" 111 "linearly changed from min speed to max speed" 110 "linearly changed from min speed to max speed" 109 "linearly changed from min speed to max speed" 108 "linearly changed from min speed to max speed" 107 "linearly changed from min speed to max speed" 106 "linearly changed from min speed to max speed" 105 "linearly changed from min speed to max speed" 104 "linearly changed from min speed to max speed" 103 "linearly changed from min speed to max speed" 102 "linearly changed from min speed to max speed" 101 "linearly changed from min speed to max speed" 100 "linearly changed from min speed to max speed" 99 "linearly changed from min speed to max speed" 98 "linearly changed from min speed to max speed" 97 "linearly changed from min speed to max speed" 96 "linearly changed from min speed to max speed" 95 "linearly changed from min speed to max speed" 94 "linearly changed from min speed to max speed" 93 "linearly changed from min speed to max speed" 92 "linearly changed from min speed to max speed" 91 "linearly changed from min speed to max speed" 90 "linearly changed from min speed to max speed" 89 "linearly changed from min speed to max speed" 88 "linearly changed from min speed to max speed" 87 "linearly changed from min speed to max speed" 86 "linearly changed from min speed to max speed" 85 "linearly changed from min speed to max speed" 84 "linearly changed from min speed to max speed" 83 "linearly changed from min speed to max speed" 82 "linearly changed from min speed to max speed" 81 "linearly changed from min speed to max speed" 80 "linearly changed from min speed to max speed" 79 "linearly changed from min speed to max speed" 78 "linearly changed from min speed to max speed" 77 "linearly changed from min speed to max speed" 76 "linearly changed from min speed to max speed" 75 "linearly changed from min speed to max speed" 74 "linearly changed from min speed to max speed" 73 "linearly changed from min speed to max speed" 72 "linearly changed from min speed to max speed" 71 "linearly changed from min speed to max speed" 70 "linearly changed from min speed to max speed" 69 "linearly changed from min speed to max speed" 68 "linearly changed from min speed to max speed" 67 "linearly changed from min speed to max speed" 66 "linearly changed from min speed to max speed" 65 "linearly changed from min speed to max speed" 64 "linearly changed from min speed to max speed" 63 "linearly changed from min speed to max speed" 62 "linearly changed from min speed to max speed" 61 "linearly changed from min speed to max speed" 60 "linearly changed from min speed to max speed" 59 "linearly changed from min speed to max speed" 58 "linearly changed from min speed to max speed" 57 "linearly changed from min speed to max speed" 56 "linearly changed from min speed to max speed" 55 "linearly changed from min speed to max speed" 54 "linearly changed from min speed to max speed" 53 "linearly changed from min speed to max speed" 52 "linearly changed from min speed to max speed" 51 "linearly changed from min speed to max speed" 50 "linearly changed from min speed to max speed" 49 "min speed rpm" 48 "min speed rpm" 47 "min speed rpm" 46 "min speed rpm" 45 "min speed rpm" 44 "min speed rpm" 43 "min speed rpm" 42 "min speed rpm" 41 "min speed rpm" 40 "min speed rpm" 39 "min speed rpm" 38 "min speed rpm" 37 "min speed rpm" 36 "min speed rpm" 35 "min speed rpm" 34 "min speed rpm" 33 "min speed rpm" 32 "min speed rpm" 31 "min speed rpm" 30 "min speed rpm" 29 "min speed rpm" 28 "min speed rpm" 27 "min speed rpm" 26 "min speed rpm" 25 "min speed rpm" 24 "min speed rpm" 23 "min speed rpm" 22 "min speed rpm" 21 "min speed rpm" 20 "min speed rpm" 19 "min speed rpm" 18 "min speed rpm" 17 "min speed rpm" 16 "min speed rpm" 15 "min speed rpm" 14 "min speed rpm" 13 "min speed rpm" 12 "min speed rpm" 11 "min speed rpm" 10 "min speed rpm" 9 "min speed rpm" 8 "min speed rpm" 7 "min speed rpm" 6 "min speed rpm" 5 "min speed rpm" 4 "min speed rpm" 3 "0 rpm" 2 "0 rpm" 1 "0 rpm" 0 "0 rpm";
VAL_ 796 EWP1_RPM_Target_EWP_Rq 255 "Invalid" 254 "max speed rpm" 253 "max speed rpm" 252 "max speed rpm" 251 "max speed rpm" 250 "linearly changed from min speed to max speed" 249 "linearly changed from min speed to max speed" 248 "linearly changed from min speed to max speed" 247 "linearly changed from min speed to max speed" 246 "linearly changed from min speed to max speed" 245 "linearly changed from min speed to max speed" 244 "linearly changed from min speed to max speed" 243 "linearly changed from min speed to max speed" 242 "linearly changed from min speed to max speed" 241 "linearly changed from min speed to max speed" 240 "linearly changed from min speed to max speed" 239 "linearly changed from min speed to max speed" 238 "linearly changed from min speed to max speed" 237 "linearly changed from min speed to max speed" 236 "linearly changed from min speed to max speed" 235 "linearly changed from min speed to max speed" 234 "linearly changed from min speed to max speed" 233 "linearly changed from min speed to max speed" 232 "linearly changed from min speed to max speed" 231 "linearly changed from min speed to max speed" 230 "linearly changed from min speed to max speed" 229 "linearly changed from min speed to max speed" 228 "linearly changed from min speed to max speed" 227 "linearly changed from min speed to max speed" 226 "linearly changed from min speed to max speed" 225 "linearly changed from min speed to max speed" 224 "linearly changed from min speed to max speed" 223 "linearly changed from min speed to max speed" 222 "linearly changed from min speed to max speed" 221 "linearly changed from min speed to max speed" 220 "linearly changed from min speed to max speed" 219 "linearly changed from min speed to max speed" 218 "linearly changed from min speed to max speed" 217 "linearly changed from min speed to max speed" 216 "linearly changed from min speed to max speed" 215 "linearly changed from min speed to max speed" 214 "linearly changed from min speed to max speed" 213 "linearly changed from min speed to max speed" 212 "linearly changed from min speed to max speed" 211 "linearly changed from min speed to max speed" 210 "linearly changed from min speed to max speed" 209 "linearly changed from min speed to max speed" 208 "linearly changed from min speed to max speed" 207 "linearly changed from min speed to max speed" 206 "linearly changed from min speed to max speed" 205 "linearly changed from min speed to max speed" 204 "linearly changed from min speed to max speed" 203 "linearly changed from min speed to max speed" 202 "linearly changed from min speed to max speed" 201 "linearly changed from min speed to max speed" 200 "linearly changed from min speed to max speed" 199 "linearly changed from min speed to max speed" 198 "linearly changed from min speed to max speed" 197 "linearly changed from min speed to max speed" 196 "linearly changed from min speed to max speed" 195 "linearly changed from min speed to max speed" 194 "linearly changed from min speed to max speed" 193 "linearly changed from min speed to max speed" 192 "linearly changed from min speed to max speed" 191 "linearly changed from min speed to max speed" 190 "linearly changed from min speed to max speed" 189 "linearly changed from min speed to max speed" 188 "linearly changed from min speed to max speed" 187 "linearly changed from min speed to max speed" 186 "linearly changed from min speed to max speed" 185 "linearly changed from min speed to max speed" 184 "linearly changed from min speed to max speed" 183 "linearly changed from min speed to max speed" 182 "linearly changed from min speed to max speed" 181 "linearly changed from min speed to max speed" 180 "linearly changed from min speed to max speed" 179 "linearly changed from min speed to max speed" 178 "linearly changed from min speed to max speed" 177 "linearly changed from min speed to max speed" 176 "linearly changed from min speed to max speed" 175 "linearly changed from min speed to max speed" 174 "linearly changed from min speed to max speed" 173 "linearly changed from min speed to max speed" 172 "linearly changed from min speed to max speed" 171 "linearly changed from min speed to max speed" 170 "linearly changed from min speed to max speed" 169 "linearly changed from min speed to max speed" 168 "linearly changed from min speed to max speed" 167 "linearly changed from min speed to max speed" 166 "linearly changed from min speed to max speed" 165 "linearly changed from min speed to max speed" 164 "linearly changed from min speed to max speed" 163 "linearly changed from min speed to max speed" 162 "linearly changed from min speed to max speed" 161 "linearly changed from min speed to max speed" 160 "linearly changed from min speed to max speed" 159 "linearly changed from min speed to max speed" 158 "linearly changed from min speed to max speed" 157 "linearly changed from min speed to max speed" 156 "linearly changed from min speed to max speed" 155 "linearly changed from min speed to max speed" 154 "linearly changed from min speed to max speed" 153 "linearly changed from min speed to max speed" 152 "linearly changed from min speed to max speed" 151 "linearly changed from min speed to max speed" 150 "linearly changed from min speed to max speed" 149 "linearly changed from min speed to max speed" 148 "linearly changed from min speed to max speed" 147 "linearly changed from min speed to max speed" 146 "linearly changed from min speed to max speed" 145 "linearly changed from min speed to max speed" 144 "linearly changed from min speed to max speed" 143 "linearly changed from min speed to max speed" 142 "linearly changed from min speed to max speed" 141 "linearly changed from min speed to max speed" 140 "linearly changed from min speed to max speed" 139 "linearly changed from min speed to max speed" 138 "linearly changed from min speed to max speed" 137 "linearly changed from min speed to max speed" 136 "linearly changed from min speed to max speed" 135 "linearly changed from min speed to max speed" 134 "linearly changed from min speed to max speed" 133 "linearly changed from min speed to max speed" 132 "linearly changed from min speed to max speed" 131 "linearly changed from min speed to max speed" 130 "linearly changed from min speed to max speed" 129 "linearly changed from min speed to max speed" 128 "linearly changed from min speed to max speed" 127 "linearly changed from min speed to max speed" 126 "linearly changed from min speed to max speed" 125 "linearly changed from min speed to max speed" 124 "linearly changed from min speed to max speed" 123 "linearly changed from min speed to max speed" 122 "linearly changed from min speed to max speed" 121 "linearly changed from min speed to max speed" 120 "linearly changed from min speed to max speed" 119 "linearly changed from min speed to max speed" 118 "linearly changed from min speed to max speed" 117 "linearly changed from min speed to max speed" 116 "linearly changed from min speed to max speed" 115 "linearly changed from min speed to max speed" 114 "linearly changed from min speed to max speed" 113 "linearly changed from min speed to max speed" 112 "linearly changed from min speed to max speed" 111 "linearly changed from min speed to max speed" 110 "linearly changed from min speed to max speed" 109 "linearly changed from min speed to max speed" 108 "linearly changed from min speed to max speed" 107 "linearly changed from min speed to max speed" 106 "linearly changed from min speed to max speed" 105 "linearly changed from min speed to max speed" 104 "linearly changed from min speed to max speed" 103 "linearly changed from min speed to max speed" 102 "linearly changed from min speed to max speed" 101 "linearly changed from min speed to max speed" 100 "linearly changed from min speed to max speed" 99 "linearly changed from min speed to max speed" 98 "linearly changed from min speed to max speed" 97 "linearly changed from min speed to max speed" 96 "linearly changed from min speed to max speed" 95 "linearly changed from min speed to max speed" 94 "linearly changed from min speed to max speed" 93 "linearly changed from min speed to max speed" 92 "linearly changed from min speed to max speed" 91 "linearly changed from min speed to max speed" 90 "linearly changed from min speed to max speed" 89 "linearly changed from min speed to max speed" 88 "linearly changed from min speed to max speed" 87 "linearly changed from min speed to max speed" 86 "linearly changed from min speed to max speed" 85 "linearly changed from min speed to max speed" 84 "linearly changed from min speed to max speed" 83 "linearly changed from min speed to max speed" 82 "linearly changed from min speed to max speed" 81 "linearly changed from min speed to max speed" 80 "linearly changed from min speed to max speed" 79 "linearly changed from min speed to max speed" 78 "linearly changed from min speed to max speed" 77 "linearly changed from min speed to max speed" 76 "linearly changed from min speed to max speed" 75 "linearly changed from min speed to max speed" 74 "linearly changed from min speed to max speed" 73 "linearly changed from min speed to max speed" 72 "linearly changed from min speed to max speed" 71 "linearly changed from min speed to max speed" 70 "linearly changed from min speed to max speed" 69 "linearly changed from min speed to max speed" 68 "linearly changed from min speed to max speed" 67 "linearly changed from min speed to max speed" 66 "linearly changed from min speed to max speed" 65 "linearly changed from min speed to max speed" 64 "linearly changed from min speed to max speed" 63 "linearly changed from min speed to max speed" 62 "linearly changed from min speed to max speed" 61 "linearly changed from min speed to max speed" 60 "linearly changed from min speed to max speed" 59 "linearly changed from min speed to max speed" 58 "linearly changed from min speed to max speed" 57 "linearly changed from min speed to max speed" 56 "linearly changed from min speed to max speed" 55 "linearly changed from min speed to max speed" 54 "linearly changed from min speed to max speed" 53 "linearly changed from min speed to max speed" 52 "linearly changed from min speed to max speed" 51 "linearly changed from min speed to max speed" 50 "linearly changed from min speed to max speed" 49 "min speed rpm" 48 "min speed rpm" 47 "min speed rpm" 46 "min speed rpm" 45 "min speed rpm" 44 "min speed rpm" 43 "min speed rpm" 42 "min speed rpm" 41 "min speed rpm" 40 "min speed rpm" 39 "min speed rpm" 38 "min speed rpm" 37 "min speed rpm" 36 "min speed rpm" 35 "min speed rpm" 34 "min speed rpm" 33 "min speed rpm" 32 "min speed rpm" 31 "min speed rpm" 30 "min speed rpm" 29 "min speed rpm" 28 "min speed rpm" 27 "min speed rpm" 26 "min speed rpm" 25 "min speed rpm" 24 "min speed rpm" 23 "min speed rpm" 22 "min speed rpm" 21 "min speed rpm" 20 "min speed rpm" 19 "min speed rpm" 18 "min speed rpm" 17 "min speed rpm" 16 "min speed rpm" 15 "min speed rpm" 14 "min speed rpm" 13 "min speed rpm" 12 "min speed rpm" 11 "min speed rpm" 10 "min speed rpm" 9 "min speed rpm" 8 "min speed rpm" 7 "min speed rpm" 6 "min speed rpm" 5 "min speed rpm" 4 "min speed rpm" 3 "0 rpm" 2 "0 rpm" 1 "0 rpm" 0 "0 rpm";
VAL_ 796 EXV2_Cmd_Init_Rq 7 "Invalid" 6 "not defined" 5 "not defined" 4 "not defined" 3 "not defined" 2 "waiting for Sequence to finish" 1 "start Init-Sequence" 0 "No Request";
VAL_ 796 EXV_Cmd_Init_Rq 7 "Invalid" 6 "not defined" 5 "not defined" 4 "not defined" 3 "not defined" 2 "waiting for Sequence to finish" 1 "start Init-Sequence" 0 "No Request";
VAL_ 796 EWP1_Default_Operation_EWP_Rq 1 "Default Operation" 0 "Default Sleep";
VAL_ 796 EWP2_Default_Operation_EWP_Rq 1 "Default Operation" 0 "Default Sleep";
VAL_ 796 EWP3_Default_Operation_EWP_Rq 1 "Default Operation" 0 "Default Sleep";
VAL_ 796 EXV2_Cmd_Move_Enbl 1 "Move to Commanded Position" 0 "Ignore Commanded Position";
VAL_ 796 EXV_Cmd_Move_Enbl 1 "Move to Commanded Position" 0 "Ignore Commanded Position";
VAL_ 796 AGS_Position_Request 255 "Invalid" 208 "78^deg" 80 "30^deg" 112 "42^deg" 144 "54^deg" 176 "66^deg" 240 "90^deg" 16 "6^deg" 48 "18^deg" 32 "12^deg" 64 "24^deg" 96 "36^deg" 128 "48^deg" 224 "84^deg" 0 "0^deg" 160 "60^deg" 192 "72^deg";
VAL_ 796 AGS_Calibration_Enabled 1 "CALIB_ENABLE" 0 "NO_CALIB";
VAL_ 796 TrailerModeSta 3 "YELLOW" 2 "RED" 1 "GREEN" 0 "OFF";
VAL_ 796 TrailerCheck 1 "Complete" 0 "Detecting";
VAL_ 796 ZFR_BCM_ChargerDoorSW_Sta 1 "Open" 0 "Close";
VAL_ 796 FLPosLPErr 1 "Error" 0 "Normal";
VAL_ 796 FLTurnLPErr 1 "Error" 0 "Normal";
VAL_ 796 FLTurn_Light_Warning 1 "On" 0 "Off";
VAL_ 796 FRPosLPErr 1 "Error" 0 "Normal";
VAL_ 796 FRTurnLPErr 1 "Error" 0 "Normal";
VAL_ 796 FRTurn_Light_Warning 1 "On" 0 "Off";
VAL_ 796 LADBErr 1 "Error" 0 "Normal";
VAL_ 796 LADB_Hibeam_Indication 1 "On" 0 "Off";
VAL_ 796 LADB_Operation_Status 1 "On" 0 "Off";
VAL_ 796 LADB_Warning 1 "On" 0 "Off";
VAL_ 796 LAHB_Warning 1 "On" 0 "Off";
VAL_ 796 LDRLErr 1 "Error" 0 "Normal";
VAL_ 796 LDRL_Warning 1 "On" 0 "Off";
VAL_ 796 LH_BeamErr 1 "Error" 0 "Normal";
VAL_ 796 LLB_Warning 1 "On" 0 "Off";
VAL_ 796 LL_BeamErr 1 "Error" 0 "Normal";
VAL_ 796 Lposition_Lamp_Warning 1 "On" 0 "Off";
VAL_ 796 RADBErr 1 "Error" 0 "Normal";
VAL_ 796 RADB_Hibeam_Indication 1 "On" 0 "Off";
VAL_ 796 RADB_Operation_Status 1 "On" 0 "Off";
VAL_ 796 RADB_Warning 1 "On" 0 "Off";
VAL_ 796 RAHB_Warning 1 "On" 0 "Off";
VAL_ 796 RDRLErr 1 "Error" 0 "Normal";
VAL_ 796 RDRL_Warning 1 "On" 0 "Off";
VAL_ 796 RH_BeamErr 1 "Error" 0 "Normal";
VAL_ 796 RLB_Warning 1 "On" 0 "Off";
VAL_ 796 RL_BeamErr 1 "Error" 0 "Normal";
VAL_ 796 Rposition_Lamp_Warning 1 "On" 0 "Off";
VAL_ 796 ZFR_THCM_CLEVentActY_Sta 127 "Invalid" 126 "OFF";
VAL_ 796 ZFR_THCM_CLEVentActZ_Sta 127 "Invalid" 126 "OFF";
VAL_ 796 ZFR_THCM_CREVentActY_Sta 127 "Invalid" 126 "OFF";
VAL_ 796 ZFR_THCM_CREVentActZ_Sta 127 "Invalid" 126 "OFF";
VAL_ 796 ZFR_THCM_LEVentActY_Sta 127 "Invalid" 126 "OFF";
VAL_ 796 ZFR_THCM_LEVentActZ_Sta 127 "Invalid" 126 "OFF";
VAL_ 796 ZFR_THCM_REVentActY_Sta 127 "Invalid" 126 "OFF";
VAL_ 796 ZFR_THCM_REVentActZ_Sta 127 "Invalid" 126 "OFF";
VAL_ 796 ZFR_EChrg_Active_Sta 7 "Pinch Reverse" 6 "Stoped Halfway" 5 "Ready to Act" 4 "Power Closing" 3 "Power Opening" 2 "Fully Opened" 1 "Fully Closed" 0 "Signal Not Available";
VAL_ 796 ZFR_EChrg_Sys_Sta 3 "Signal Not Available" 2 "Abnormal" 1 "Normal" 0 "Uninitialized";
VAL_ 796 ZFR_EChrg_OperationDeny_Cmd 2 "Close deny" 1 "Open deny" 0 "Normal";
VAL_ 796 ZFR_BCM_HRLTurnLPNormal_Sta 1 "Normal" 0 "Error";
VAL_ 796 ZFR_BCM_HRRTurnLPHNormal_Sta 1 "Normal" 0 "Error";
VAL_ 796 ZFR_EChrg_WashMode_Sta 1 "Active" 0 "Not active";
VAL_ 593 P_CommandToBCM 15 "Invalid" 11 "UWB Unlock" 10 "UWB Lock" 9 "NFC Command" 8 "Car Search Mute" 7 "Forced to lift anti-theft" 6 "HandleTailgate Open/Close" 5 "Failed to Lock Tailgate" 4 "Car Search" 3 "Remote Tailgate Open/Close" 2 "Unlock" 1 "Lock" 0 "Default";
VAL_ 593 P_DKey_Welcome 3 "UnsedandReserved" 2 "Out the welcome zone" 1 "In the welcom zone" 0 "Unavaliable";
VAL_ 593 P_DKey_Area_LockUnlock 3 "UnusedandReserved" 2 "In to Unlock Zone" 1 "In to Lock Zone" 0 "Unavailable";
VAL_ 593 P_DKey_Area_PS 3 "UnsedandReserved" 2 "Out of PS Zone" 1 "In to PS Zone" 0 "Unavaliable";
VAL_ 593 P_UID_LowPower 1 "On" 0 "Off";
VAL_ 593 P_CommandToPTG 5 "invalid" 4 "PTG-legal Key in Indoor and Outdoor(ID identical)" 3 "PTG-legal Key in Indoor and Outdoor(ID different)" 2 "PTG-legal Key in Indoor" 1 "PTG-legal Key in Outdoor" 0 "Default";
VAL_ 593 P_Dkey_Show_IVI 7 "invalid" 6 "IVI PHONE Green" 5 "IVI PHONE Red" 4 "IVI UID Green" 3 "IVI UID Red" 2 "IVI NFC Card Green" 1 "IVI NFC Card Red" 0 "Default";
VAL_ 593 P_KeyMode 6 "Invalid" 5 "NFC" 4 "PHONE (BLE)" 3 "PHONE (UWB)" 2 "UID (BLE)" 1 "UID (UWB)" 0 "Default";
VAL_ 593 P_DKey_Area_PTG 3 "UnsedandReserved" 2 "Out of SPTG Zone" 1 "In to SPTG Zone" 0 "Unavaliable";
VAL_ 593 P_KeyMiss 1 "Key Miss" 0 "Default";
VAL_ 593 DKC_Re_VehData 1 "Request" 0 "No Request";
VAL_ 593 DKC_ParkingMode_Cmd 4 "remote vehicle reverse" 3 "remote vehicle forward" 2 "remote parking" 1 "Standby (Ready)" 0 "Disable";
VAL_ 593 DKC_PDkeyAreaRAPS_Sta 2 "Out of RAPS Zone" 1 "In to RAPS Zone" 0 "Unavailable";
VAL_ 593 DKC_KeyNum_Sta 15 "Invalid" 14 "Key 14" 13 "Key 13" 12 "Key 12" 11 "Key 11" 10 "Key 10" 9 "Key 9" 8 "Key 8" 7 "Key 7" 6 "Key 6" 5 "Key 5" 4 "Key 4" 3 "Key 3" 2 "Key 2" 1 "Key 1" 0 "No Request";
VAL_ 593 DKC_KeyType_Sta 3 "Invalid" 2 "NFC" 1 "UID" 0 "No Request";
VAL_ 596 EXV_Rsp_Fault_Stat 15 "not defined" 14 "not defined" 13 "not defined" 12 "not defined" 11 "not defined" 10 "not defined" 9 "not defined" 8 "not defined" 7 "not defined" 6 "not defined" 5 "not defined" 4 "not defined" 3 "Over temperature shutdown" 2 "Motor-Coil open load" 1 "Motor-Coil shorted" 0 "Actuator Not Faulted";
VAL_ 596 EXV_Rsp_CurInit_Stat 3 "Unused and Undefined" 2 "Initialized" 1 "Initialization in Process" 0 "Not Initialized";
VAL_ 596 EXV_Rsp_OvrTemp_Warn 3 "not defined" 2 "not defined" 1 "High Temperature Warning" 0 "Ok";
VAL_ 596 EXV_Rsp_Volt_Stat 3 "not defined" 2 "Under voltage" 1 "Overvoltage" 0 "Voltage Range ok";
VAL_ 596 EXV_RsErr_EXV 1 "Comm Error detected" 0 "No Comm Error";
VAL_ 596 EXV_Rsp_Run_Stat 1 "Actuator is moving" 0 "Actuator is not moving";
VAL_ 596 EWP1_RsErr_EWP 1 "ERROR" 0 "NO ERROR";
VAL_ 596 EWP1_SupVolt_Error 2 "SNA" 1 "ERROR" 0 "NO ERROR";
VAL_ 596 EWP1_RPM_Target_Stat 255 "Invalid" 254 "max speed rpm" 253 "max speed rpm" 252 "max speed rpm" 251 "max speed rpm" 250 "linearly changed from min speed to max speed" 249 "linearly changed from min speed to max speed" 248 "linearly changed from min speed to max speed" 247 "linearly changed from min speed to max speed" 246 "linearly changed from min speed to max speed" 245 "linearly changed from min speed to max speed" 244 "linearly changed from min speed to max speed" 243 "linearly changed from min speed to max speed" 242 "linearly changed from min speed to max speed" 241 "linearly changed from min speed to max speed" 240 "linearly changed from min speed to max speed" 239 "linearly changed from min speed to max speed" 238 "linearly changed from min speed to max speed" 237 "linearly changed from min speed to max speed" 236 "linearly changed from min speed to max speed" 235 "linearly changed from min speed to max speed" 234 "linearly changed from min speed to max speed" 233 "linearly changed from min speed to max speed" 232 "linearly changed from min speed to max speed" 231 "linearly changed from min speed to max speed" 230 "linearly changed from min speed to max speed" 229 "linearly changed from min speed to max speed" 228 "linearly changed from min speed to max speed" 227 "linearly changed from min speed to max speed" 226 "linearly changed from min speed to max speed" 225 "linearly changed from min speed to max speed" 224 "linearly changed from min speed to max speed" 223 "linearly changed from min speed to max speed" 222 "linearly changed from min speed to max speed" 221 "linearly changed from min speed to max speed" 220 "linearly changed from min speed to max speed" 219 "linearly changed from min speed to max speed" 218 "linearly changed from min speed to max speed" 217 "linearly changed from min speed to max speed" 216 "linearly changed from min speed to max speed" 215 "linearly changed from min speed to max speed" 214 "linearly changed from min speed to max speed" 213 "linearly changed from min speed to max speed" 212 "linearly changed from min speed to max speed" 211 "linearly changed from min speed to max speed" 210 "linearly changed from min speed to max speed" 209 "linearly changed from min speed to max speed" 208 "linearly changed from min speed to max speed" 207 "linearly changed from min speed to max speed" 206 "linearly changed from min speed to max speed" 205 "linearly changed from min speed to max speed" 204 "linearly changed from min speed to max speed" 203 "linearly changed from min speed to max speed" 202 "linearly changed from min speed to max speed" 201 "linearly changed from min speed to max speed" 200 "linearly changed from min speed to max speed" 199 "linearly changed from min speed to max speed" 198 "linearly changed from min speed to max speed" 197 "linearly changed from min speed to max speed" 196 "linearly changed from min speed to max speed" 195 "linearly changed from min speed to max speed" 194 "linearly changed from min speed to max speed" 193 "linearly changed from min speed to max speed" 192 "linearly changed from min speed to max speed" 191 "linearly changed from min speed to max speed" 190 "linearly changed from min speed to max speed" 189 "linearly changed from min speed to max speed" 188 "linearly changed from min speed to max speed" 187 "linearly changed from min speed to max speed" 186 "linearly changed from min speed to max speed" 185 "linearly changed from min speed to max speed" 184 "linearly changed from min speed to max speed" 183 "linearly changed from min speed to max speed" 182 "linearly changed from min speed to max speed" 181 "linearly changed from min speed to max speed" 180 "linearly changed from min speed to max speed" 179 "linearly changed from min speed to max speed" 178 "linearly changed from min speed to max speed" 177 "linearly changed from min speed to max speed" 176 "linearly changed from min speed to max speed" 175 "linearly changed from min speed to max speed" 174 "linearly changed from min speed to max speed" 173 "linearly changed from min speed to max speed" 172 "linearly changed from min speed to max speed" 171 "linearly changed from min speed to max speed" 170 "linearly changed from min speed to max speed" 169 "linearly changed from min speed to max speed" 168 "linearly changed from min speed to max speed" 167 "linearly changed from min speed to max speed" 166 "linearly changed from min speed to max speed" 165 "linearly changed from min speed to max speed" 164 "linearly changed from min speed to max speed" 163 "linearly changed from min speed to max speed" 162 "linearly changed from min speed to max speed" 161 "linearly changed from min speed to max speed" 160 "linearly changed from min speed to max speed" 159 "linearly changed from min speed to max speed" 158 "linearly changed from min speed to max speed" 157 "linearly changed from min speed to max speed" 156 "linearly changed from min speed to max speed" 155 "linearly changed from min speed to max speed" 154 "linearly changed from min speed to max speed" 153 "linearly changed from min speed to max speed" 152 "linearly changed from min speed to max speed" 151 "linearly changed from min speed to max speed" 150 "linearly changed from min speed to max speed" 149 "linearly changed from min speed to max speed" 148 "linearly changed from min speed to max speed" 147 "linearly changed from min speed to max speed" 146 "linearly changed from min speed to max speed" 145 "linearly changed from min speed to max speed" 144 "linearly changed from min speed to max speed" 143 "linearly changed from min speed to max speed" 142 "linearly changed from min speed to max speed" 141 "linearly changed from min speed to max speed" 140 "linearly changed from min speed to max speed" 139 "linearly changed from min speed to max speed" 138 "linearly changed from min speed to max speed" 137 "linearly changed from min speed to max speed" 136 "linearly changed from min speed to max speed" 135 "linearly changed from min speed to max speed" 134 "linearly changed from min speed to max speed" 133 "linearly changed from min speed to max speed" 132 "linearly changed from min speed to max speed" 131 "linearly changed from min speed to max speed" 130 "linearly changed from min speed to max speed" 129 "linearly changed from min speed to max speed" 128 "linearly changed from min speed to max speed" 127 "linearly changed from min speed to max speed" 126 "linearly changed from min speed to max speed" 125 "linearly changed from min speed to max speed" 124 "linearly changed from min speed to max speed" 123 "linearly changed from min speed to max speed" 122 "linearly changed from min speed to max speed" 121 "linearly changed from min speed to max speed" 120 "linearly changed from min speed to max speed" 119 "linearly changed from min speed to max speed" 118 "linearly changed from min speed to max speed" 117 "linearly changed from min speed to max speed" 116 "linearly changed from min speed to max speed" 115 "linearly changed from min speed to max speed" 114 "linearly changed from min speed to max speed" 113 "linearly changed from min speed to max speed" 112 "linearly changed from min speed to max speed" 111 "linearly changed from min speed to max speed" 110 "linearly changed from min speed to max speed" 109 "linearly changed from min speed to max speed" 108 "linearly changed from min speed to max speed" 107 "linearly changed from min speed to max speed" 106 "linearly changed from min speed to max speed" 105 "linearly changed from min speed to max speed" 104 "linearly changed from min speed to max speed" 103 "linearly changed from min speed to max speed" 102 "linearly changed from min speed to max speed" 101 "linearly changed from min speed to max speed" 100 "linearly changed from min speed to max speed" 99 "linearly changed from min speed to max speed" 98 "linearly changed from min speed to max speed" 97 "linearly changed from min speed to max speed" 96 "linearly changed from min speed to max speed" 95 "linearly changed from min speed to max speed" 94 "linearly changed from min speed to max speed" 93 "linearly changed from min speed to max speed" 92 "linearly changed from min speed to max speed" 91 "linearly changed from min speed to max speed" 90 "linearly changed from min speed to max speed" 89 "linearly changed from min speed to max speed" 88 "linearly changed from min speed to max speed" 87 "linearly changed from min speed to max speed" 86 "linearly changed from min speed to max speed" 85 "linearly changed from min speed to max speed" 84 "linearly changed from min speed to max speed" 83 "linearly changed from min speed to max speed" 82 "linearly changed from min speed to max speed" 81 "linearly changed from min speed to max speed" 80 "linearly changed from min speed to max speed" 79 "linearly changed from min speed to max speed" 78 "linearly changed from min speed to max speed" 77 "linearly changed from min speed to max speed" 76 "linearly changed from min speed to max speed" 75 "linearly changed from min speed to max speed" 74 "linearly changed from min speed to max speed" 73 "linearly changed from min speed to max speed" 72 "linearly changed from min speed to max speed" 71 "linearly changed from min speed to max speed" 70 "linearly changed from min speed to max speed" 69 "linearly changed from min speed to max speed" 68 "linearly changed from min speed to max speed" 67 "linearly changed from min speed to max speed" 66 "linearly changed from min speed to max speed" 65 "linearly changed from min speed to max speed" 64 "linearly changed from min speed to max speed" 63 "linearly changed from min speed to max speed" 62 "linearly changed from min speed to max speed" 61 "linearly changed from min speed to max speed" 60 "linearly changed from min speed to max speed" 59 "linearly changed from min speed to max speed" 58 "linearly changed from min speed to max speed" 57 "linearly changed from min speed to max speed" 56 "linearly changed from min speed to max speed" 55 "linearly changed from min speed to max speed" 54 "linearly changed from min speed to max speed" 53 "linearly changed from min speed to max speed" 52 "linearly changed from min speed to max speed" 51 "linearly changed from min speed to max speed" 50 "linearly changed from min speed to max speed" 49 "min speed rpm" 48 "min speed rpm" 47 "min speed rpm" 46 "min speed rpm" 45 "min speed rpm" 44 "min speed rpm" 43 "min speed rpm" 42 "min speed rpm" 41 "min speed rpm" 40 "min speed rpm" 39 "min speed rpm" 38 "min speed rpm" 37 "min speed rpm" 36 "min speed rpm" 35 "min speed rpm" 34 "min speed rpm" 33 "min speed rpm" 32 "min speed rpm" 31 "min speed rpm" 30 "min speed rpm" 29 "min speed rpm" 28 "min speed rpm" 27 "min speed rpm" 26 "min speed rpm" 25 "min speed rpm" 24 "min speed rpm" 23 "min speed rpm" 22 "min speed rpm" 21 "min speed rpm" 20 "min speed rpm" 19 "min speed rpm" 18 "min speed rpm" 17 "min speed rpm" 16 "min speed rpm" 15 "min speed rpm" 14 "min speed rpm" 13 "min speed rpm" 12 "min speed rpm" 11 "min speed rpm" 10 "min speed rpm" 9 "min speed rpm" 8 "min speed rpm" 7 "min speed rpm" 6 "min speed rpm" 5 "min speed rpm" 4 "min speed rpm" 3 "0 rpm" 2 "0 rpm" 1 "0 rpm" 0 "0 rpm";
VAL_ 596 EWP1_RPM_ActlVal_Stat 255 "Invalid" 254 "max speed rpm" 253 "max speed rpm" 252 "max speed rpm" 251 "max speed rpm" 250 "linearly changed from min speed to max speed" 249 "linearly changed from min speed to max speed" 248 "linearly changed from min speed to max speed" 247 "linearly changed from min speed to max speed" 246 "linearly changed from min speed to max speed" 245 "linearly changed from min speed to max speed" 244 "linearly changed from min speed to max speed" 243 "linearly changed from min speed to max speed" 242 "linearly changed from min speed to max speed" 241 "linearly changed from min speed to max speed" 240 "linearly changed from min speed to max speed" 239 "linearly changed from min speed to max speed" 238 "linearly changed from min speed to max speed" 237 "linearly changed from min speed to max speed" 236 "linearly changed from min speed to max speed" 235 "linearly changed from min speed to max speed" 234 "linearly changed from min speed to max speed" 233 "linearly changed from min speed to max speed" 232 "linearly changed from min speed to max speed" 231 "linearly changed from min speed to max speed" 230 "linearly changed from min speed to max speed" 229 "linearly changed from min speed to max speed" 228 "linearly changed from min speed to max speed" 227 "linearly changed from min speed to max speed" 226 "linearly changed from min speed to max speed" 225 "linearly changed from min speed to max speed" 224 "linearly changed from min speed to max speed" 223 "linearly changed from min speed to max speed" 222 "linearly changed from min speed to max speed" 221 "linearly changed from min speed to max speed" 220 "linearly changed from min speed to max speed" 219 "linearly changed from min speed to max speed" 218 "linearly changed from min speed to max speed" 217 "linearly changed from min speed to max speed" 216 "linearly changed from min speed to max speed" 215 "linearly changed from min speed to max speed" 214 "linearly changed from min speed to max speed" 213 "linearly changed from min speed to max speed" 212 "linearly changed from min speed to max speed" 211 "linearly changed from min speed to max speed" 210 "linearly changed from min speed to max speed" 209 "linearly changed from min speed to max speed" 208 "linearly changed from min speed to max speed" 207 "linearly changed from min speed to max speed" 206 "linearly changed from min speed to max speed" 205 "linearly changed from min speed to max speed" 204 "linearly changed from min speed to max speed" 203 "linearly changed from min speed to max speed" 202 "linearly changed from min speed to max speed" 201 "linearly changed from min speed to max speed" 200 "linearly changed from min speed to max speed" 199 "linearly changed from min speed to max speed" 198 "linearly changed from min speed to max speed" 197 "linearly changed from min speed to max speed" 196 "linearly changed from min speed to max speed" 195 "linearly changed from min speed to max speed" 194 "linearly changed from min speed to max speed" 193 "linearly changed from min speed to max speed" 192 "linearly changed from min speed to max speed" 191 "linearly changed from min speed to max speed" 190 "linearly changed from min speed to max speed" 189 "linearly changed from min speed to max speed" 188 "linearly changed from min speed to max speed" 187 "linearly changed from min speed to max speed" 186 "linearly changed from min speed to max speed" 185 "linearly changed from min speed to max speed" 184 "linearly changed from min speed to max speed" 183 "linearly changed from min speed to max speed" 182 "linearly changed from min speed to max speed" 181 "linearly changed from min speed to max speed" 180 "linearly changed from min speed to max speed" 179 "linearly changed from min speed to max speed" 178 "linearly changed from min speed to max speed" 177 "linearly changed from min speed to max speed" 176 "linearly changed from min speed to max speed" 175 "linearly changed from min speed to max speed" 174 "linearly changed from min speed to max speed" 173 "linearly changed from min speed to max speed" 172 "linearly changed from min speed to max speed" 171 "linearly changed from min speed to max speed" 170 "linearly changed from min speed to max speed" 169 "linearly changed from min speed to max speed" 168 "linearly changed from min speed to max speed" 167 "linearly changed from min speed to max speed" 166 "linearly changed from min speed to max speed" 165 "linearly changed from min speed to max speed" 164 "linearly changed from min speed to max speed" 163 "linearly changed from min speed to max speed" 162 "linearly changed from min speed to max speed" 161 "linearly changed from min speed to max speed" 160 "linearly changed from min speed to max speed" 159 "linearly changed from min speed to max speed" 158 "linearly changed from min speed to max speed" 157 "linearly changed from min speed to max speed" 156 "linearly changed from min speed to max speed" 155 "linearly changed from min speed to max speed" 154 "linearly changed from min speed to max speed" 153 "linearly changed from min speed to max speed" 152 "linearly changed from min speed to max speed" 151 "linearly changed from min speed to max speed" 150 "linearly changed from min speed to max speed" 149 "linearly changed from min speed to max speed" 148 "linearly changed from min speed to max speed" 147 "linearly changed from min speed to max speed" 146 "linearly changed from min speed to max speed" 145 "linearly changed from min speed to max speed" 144 "linearly changed from min speed to max speed" 143 "linearly changed from min speed to max speed" 142 "linearly changed from min speed to max speed" 141 "linearly changed from min speed to max speed" 140 "linearly changed from min speed to max speed" 139 "linearly changed from min speed to max speed" 138 "linearly changed from min speed to max speed" 137 "linearly changed from min speed to max speed" 136 "linearly changed from min speed to max speed" 135 "linearly changed from min speed to max speed" 134 "linearly changed from min speed to max speed" 133 "linearly changed from min speed to max speed" 132 "linearly changed from min speed to max speed" 131 "linearly changed from min speed to max speed" 130 "linearly changed from min speed to max speed" 129 "linearly changed from min speed to max speed" 128 "linearly changed from min speed to max speed" 127 "linearly changed from min speed to max speed" 126 "linearly changed from min speed to max speed" 125 "linearly changed from min speed to max speed" 124 "linearly changed from min speed to max speed" 123 "linearly changed from min speed to max speed" 122 "linearly changed from min speed to max speed" 121 "linearly changed from min speed to max speed" 120 "linearly changed from min speed to max speed" 119 "linearly changed from min speed to max speed" 118 "linearly changed from min speed to max speed" 117 "linearly changed from min speed to max speed" 116 "linearly changed from min speed to max speed" 115 "linearly changed from min speed to max speed" 114 "linearly changed from min speed to max speed" 113 "linearly changed from min speed to max speed" 112 "linearly changed from min speed to max speed" 111 "linearly changed from min speed to max speed" 110 "linearly changed from min speed to max speed" 109 "linearly changed from min speed to max speed" 108 "linearly changed from min speed to max speed" 107 "linearly changed from min speed to max speed" 106 "linearly changed from min speed to max speed" 105 "linearly changed from min speed to max speed" 104 "linearly changed from min speed to max speed" 103 "linearly changed from min speed to max speed" 102 "linearly changed from min speed to max speed" 101 "linearly changed from min speed to max speed" 100 "linearly changed from min speed to max speed" 99 "linearly changed from min speed to max speed" 98 "linearly changed from min speed to max speed" 97 "linearly changed from min speed to max speed" 96 "linearly changed from min speed to max speed" 95 "linearly changed from min speed to max speed" 94 "linearly changed from min speed to max speed" 93 "linearly changed from min speed to max speed" 92 "linearly changed from min speed to max speed" 91 "linearly changed from min speed to max speed" 90 "linearly changed from min speed to max speed" 89 "linearly changed from min speed to max speed" 88 "linearly changed from min speed to max speed" 87 "linearly changed from min speed to max speed" 86 "linearly changed from min speed to max speed" 85 "linearly changed from min speed to max speed" 84 "linearly changed from min speed to max speed" 83 "linearly changed from min speed to max speed" 82 "linearly changed from min speed to max speed" 81 "linearly changed from min speed to max speed" 80 "linearly changed from min speed to max speed" 79 "linearly changed from min speed to max speed" 78 "linearly changed from min speed to max speed" 77 "linearly changed from min speed to max speed" 76 "linearly changed from min speed to max speed" 75 "linearly changed from min speed to max speed" 74 "linearly changed from min speed to max speed" 73 "linearly changed from min speed to max speed" 72 "linearly changed from min speed to max speed" 71 "linearly changed from min speed to max speed" 70 "linearly changed from min speed to max speed" 69 "linearly changed from min speed to max speed" 68 "linearly changed from min speed to max speed" 67 "linearly changed from min speed to max speed" 66 "linearly changed from min speed to max speed" 65 "linearly changed from min speed to max speed" 64 "linearly changed from min speed to max speed" 63 "linearly changed from min speed to max speed" 62 "linearly changed from min speed to max speed" 61 "linearly changed from min speed to max speed" 60 "linearly changed from min speed to max speed" 59 "linearly changed from min speed to max speed" 58 "linearly changed from min speed to max speed" 57 "linearly changed from min speed to max speed" 56 "linearly changed from min speed to max speed" 55 "linearly changed from min speed to max speed" 54 "linearly changed from min speed to max speed" 53 "linearly changed from min speed to max speed" 52 "linearly changed from min speed to max speed" 51 "linearly changed from min speed to max speed" 50 "linearly changed from min speed to max speed" 49 "min speed rpm" 48 "min speed rpm" 47 "min speed rpm" 46 "min speed rpm" 45 "min speed rpm" 44 "min speed rpm" 43 "min speed rpm" 42 "min speed rpm" 41 "min speed rpm" 40 "min speed rpm" 39 "min speed rpm" 38 "min speed rpm" 37 "min speed rpm" 36 "min speed rpm" 35 "min speed rpm" 34 "min speed rpm" 33 "min speed rpm" 32 "min speed rpm" 31 "min speed rpm" 30 "min speed rpm" 29 "min speed rpm" 28 "min speed rpm" 27 "min speed rpm" 26 "min speed rpm" 25 "min speed rpm" 24 "min speed rpm" 23 "min speed rpm" 22 "min speed rpm" 21 "min speed rpm" 20 "min speed rpm" 19 "min speed rpm" 18 "min speed rpm" 17 "min speed rpm" 16 "min speed rpm" 15 "min speed rpm" 14 "min speed rpm" 13 "min speed rpm" 12 "min speed rpm" 11 "min speed rpm" 10 "min speed rpm" 9 "min speed rpm" 8 "min speed rpm" 7 "min speed rpm" 6 "min speed rpm" 5 "min speed rpm" 4 "min speed rpm" 3 "0 rpm" 2 "0 rpm" 1 "0 rpm" 0 "0 rpm";
VAL_ 596 EWP1_Curr_Stat 255 "invalid";
VAL_ 596 EWP1_Block_Error 3 "Invalid" 2 "SNA" 1 "ERROR" 0 "NO ERROR";
VAL_ 596 EWP1_DryRun_Error 3 "Invalid" 2 "SNA" 1 "ERROR" 0 "NO ERROR";
VAL_ 596 EWP1_OverCurr_Error 3 "Invalid" 2 "SNA" 1 "ERROR" 0 "NO ERROR";
VAL_ 596 EWP1_OverTemp_Error 2 "OverTempDegrade" 1 "ERROR" 0 "NO ERROR";
VAL_ 596 EWP1_Temp_Stat 255 "Invalid";
VAL_ 596 EWP1_Volt_Stat 255 "Invalid";
VAL_ 596 EWP2_Volt_Stat 255 "Invalid";
VAL_ 596 EWP2_Temp_Stat 255 "Invalid";
VAL_ 596 EWP2_RPM_Target_Stat 255 "Invalid" 254 "max speed rpm" 253 "max speed rpm" 252 "max speed rpm" 251 "max speed rpm" 250 "linearly changed from min speed to max speed" 249 "linearly changed from min speed to max speed" 248 "linearly changed from min speed to max speed" 247 "linearly changed from min speed to max speed" 246 "linearly changed from min speed to max speed" 245 "linearly changed from min speed to max speed" 244 "linearly changed from min speed to max speed" 243 "linearly changed from min speed to max speed" 242 "linearly changed from min speed to max speed" 241 "linearly changed from min speed to max speed" 240 "linearly changed from min speed to max speed" 239 "linearly changed from min speed to max speed" 238 "linearly changed from min speed to max speed" 237 "linearly changed from min speed to max speed" 236 "linearly changed from min speed to max speed" 235 "linearly changed from min speed to max speed" 234 "linearly changed from min speed to max speed" 233 "linearly changed from min speed to max speed" 232 "linearly changed from min speed to max speed" 231 "linearly changed from min speed to max speed" 230 "linearly changed from min speed to max speed" 229 "linearly changed from min speed to max speed" 228 "linearly changed from min speed to max speed" 227 "linearly changed from min speed to max speed" 226 "linearly changed from min speed to max speed" 225 "linearly changed from min speed to max speed" 224 "linearly changed from min speed to max speed" 223 "linearly changed from min speed to max speed" 222 "linearly changed from min speed to max speed" 221 "linearly changed from min speed to max speed" 220 "linearly changed from min speed to max speed" 219 "linearly changed from min speed to max speed" 218 "linearly changed from min speed to max speed" 217 "linearly changed from min speed to max speed" 216 "linearly changed from min speed to max speed" 215 "linearly changed from min speed to max speed" 214 "linearly changed from min speed to max speed" 213 "linearly changed from min speed to max speed" 212 "linearly changed from min speed to max speed" 211 "linearly changed from min speed to max speed" 210 "linearly changed from min speed to max speed" 209 "linearly changed from min speed to max speed" 208 "linearly changed from min speed to max speed" 207 "linearly changed from min speed to max speed" 206 "linearly changed from min speed to max speed" 205 "linearly changed from min speed to max speed" 204 "linearly changed from min speed to max speed" 203 "linearly changed from min speed to max speed" 202 "linearly changed from min speed to max speed" 201 "linearly changed from min speed to max speed" 200 "linearly changed from min speed to max speed" 199 "linearly changed from min speed to max speed" 198 "linearly changed from min speed to max speed" 197 "linearly changed from min speed to max speed" 196 "linearly changed from min speed to max speed" 195 "linearly changed from min speed to max speed" 194 "linearly changed from min speed to max speed" 193 "linearly changed from min speed to max speed" 192 "linearly changed from min speed to max speed" 191 "linearly changed from min speed to max speed" 190 "linearly changed from min speed to max speed" 189 "linearly changed from min speed to max speed" 188 "linearly changed from min speed to max speed" 187 "linearly changed from min speed to max speed" 186 "linearly changed from min speed to max speed" 185 "linearly changed from min speed to max speed" 184 "linearly changed from min speed to max speed" 183 "linearly changed from min speed to max speed" 182 "linearly changed from min speed to max speed" 181 "linearly changed from min speed to max speed" 180 "linearly changed from min speed to max speed" 179 "linearly changed from min speed to max speed" 178 "linearly changed from min speed to max speed" 177 "linearly changed from min speed to max speed" 176 "linearly changed from min speed to max speed" 175 "linearly changed from min speed to max speed" 174 "linearly changed from min speed to max speed" 173 "linearly changed from min speed to max speed" 172 "linearly changed from min speed to max speed" 171 "linearly changed from min speed to max speed" 170 "linearly changed from min speed to max speed" 169 "linearly changed from min speed to max speed" 168 "linearly changed from min speed to max speed" 167 "linearly changed from min speed to max speed" 166 "linearly changed from min speed to max speed" 165 "linearly changed from min speed to max speed" 164 "linearly changed from min speed to max speed" 163 "linearly changed from min speed to max speed" 162 "linearly changed from min speed to max speed" 161 "linearly changed from min speed to max speed" 160 "linearly changed from min speed to max speed" 159 "linearly changed from min speed to max speed" 158 "linearly changed from min speed to max speed" 157 "linearly changed from min speed to max speed" 156 "linearly changed from min speed to max speed" 155 "linearly changed from min speed to max speed" 154 "linearly changed from min speed to max speed" 153 "linearly changed from min speed to max speed" 152 "linearly changed from min speed to max speed" 151 "linearly changed from min speed to max speed" 150 "linearly changed from min speed to max speed" 149 "linearly changed from min speed to max speed" 148 "linearly changed from min speed to max speed" 147 "linearly changed from min speed to max speed" 146 "linearly changed from min speed to max speed" 145 "linearly changed from min speed to max speed" 144 "linearly changed from min speed to max speed" 143 "linearly changed from min speed to max speed" 142 "linearly changed from min speed to max speed" 141 "linearly changed from min speed to max speed" 140 "linearly changed from min speed to max speed" 139 "linearly changed from min speed to max speed" 138 "linearly changed from min speed to max speed" 137 "linearly changed from min speed to max speed" 136 "linearly changed from min speed to max speed" 135 "linearly changed from min speed to max speed" 134 "linearly changed from min speed to max speed" 133 "linearly changed from min speed to max speed" 132 "linearly changed from min speed to max speed" 131 "linearly changed from min speed to max speed" 130 "linearly changed from min speed to max speed" 129 "linearly changed from min speed to max speed" 128 "linearly changed from min speed to max speed" 127 "linearly changed from min speed to max speed" 126 "linearly changed from min speed to max speed" 125 "linearly changed from min speed to max speed" 124 "linearly changed from min speed to max speed" 123 "linearly changed from min speed to max speed" 122 "linearly changed from min speed to max speed" 121 "linearly changed from min speed to max speed" 120 "linearly changed from min speed to max speed" 119 "linearly changed from min speed to max speed" 118 "linearly changed from min speed to max speed" 117 "linearly changed from min speed to max speed" 116 "linearly changed from min speed to max speed" 115 "linearly changed from min speed to max speed" 114 "linearly changed from min speed to max speed" 113 "linearly changed from min speed to max speed" 112 "linearly changed from min speed to max speed" 111 "linearly changed from min speed to max speed" 110 "linearly changed from min speed to max speed" 109 "linearly changed from min speed to max speed" 108 "linearly changed from min speed to max speed" 107 "linearly changed from min speed to max speed" 106 "linearly changed from min speed to max speed" 105 "linearly changed from min speed to max speed" 104 "linearly changed from min speed to max speed" 103 "linearly changed from min speed to max speed" 102 "linearly changed from min speed to max speed" 101 "linearly changed from min speed to max speed" 100 "linearly changed from min speed to max speed" 99 "linearly changed from min speed to max speed" 98 "linearly changed from min speed to max speed" 97 "linearly changed from min speed to max speed" 96 "linearly changed from min speed to max speed" 95 "linearly changed from min speed to max speed" 94 "linearly changed from min speed to max speed" 93 "linearly changed from min speed to max speed" 92 "linearly changed from min speed to max speed" 91 "linearly changed from min speed to max speed" 90 "linearly changed from min speed to max speed" 89 "linearly changed from min speed to max speed" 88 "linearly changed from min speed to max speed" 87 "linearly changed from min speed to max speed" 86 "linearly changed from min speed to max speed" 85 "linearly changed from min speed to max speed" 84 "linearly changed from min speed to max speed" 83 "linearly changed from min speed to max speed" 82 "linearly changed from min speed to max speed" 81 "linearly changed from min speed to max speed" 80 "linearly changed from min speed to max speed" 79 "linearly changed from min speed to max speed" 78 "linearly changed from min speed to max speed" 77 "linearly changed from min speed to max speed" 76 "linearly changed from min speed to max speed" 75 "linearly changed from min speed to max speed" 74 "linearly changed from min speed to max speed" 73 "linearly changed from min speed to max speed" 72 "linearly changed from min speed to max speed" 71 "linearly changed from min speed to max speed" 70 "linearly changed from min speed to max speed" 69 "linearly changed from min speed to max speed" 68 "linearly changed from min speed to max speed" 67 "linearly changed from min speed to max speed" 66 "linearly changed from min speed to max speed" 65 "linearly changed from min speed to max speed" 64 "linearly changed from min speed to max speed" 63 "linearly changed from min speed to max speed" 62 "linearly changed from min speed to max speed" 61 "linearly changed from min speed to max speed" 60 "linearly changed from min speed to max speed" 59 "linearly changed from min speed to max speed" 58 "linearly changed from min speed to max speed" 57 "linearly changed from min speed to max speed" 56 "linearly changed from min speed to max speed" 55 "linearly changed from min speed to max speed" 54 "linearly changed from min speed to max speed" 53 "linearly changed from min speed to max speed" 52 "linearly changed from min speed to max speed" 51 "linearly changed from min speed to max speed" 50 "linearly changed from min speed to max speed" 49 "min speed rpm" 48 "min speed rpm" 47 "min speed rpm" 46 "min speed rpm" 45 "min speed rpm" 44 "min speed rpm" 43 "min speed rpm" 42 "min speed rpm" 41 "min speed rpm" 40 "min speed rpm" 39 "min speed rpm" 38 "min speed rpm" 37 "min speed rpm" 36 "min speed rpm" 35 "min speed rpm" 34 "min speed rpm" 33 "min speed rpm" 32 "min speed rpm" 31 "min speed rpm" 30 "min speed rpm" 29 "min speed rpm" 28 "min speed rpm" 27 "min speed rpm" 26 "min speed rpm" 25 "min speed rpm" 24 "min speed rpm" 23 "min speed rpm" 22 "min speed rpm" 21 "min speed rpm" 20 "min speed rpm" 19 "min speed rpm" 18 "min speed rpm" 17 "min speed rpm" 16 "min speed rpm" 15 "min speed rpm" 14 "min speed rpm" 13 "min speed rpm" 12 "min speed rpm" 11 "min speed rpm" 10 "min speed rpm" 9 "min speed rpm" 8 "min speed rpm" 7 "min speed rpm" 6 "min speed rpm" 5 "min speed rpm" 4 "min speed rpm" 3 "0 rpm" 2 "0 rpm" 1 "0 rpm" 0 "0 rpm";
VAL_ 596 EWP2_RPM_ActlVal_Stat 255 "Invalid" 254 "max speed rpm" 253 "max speed rpm" 252 "max speed rpm" 251 "max speed rpm" 250 "linearly changed from min speed to max speed" 249 "linearly changed from min speed to max speed" 248 "linearly changed from min speed to max speed" 247 "linearly changed from min speed to max speed" 246 "linearly changed from min speed to max speed" 245 "linearly changed from min speed to max speed" 244 "linearly changed from min speed to max speed" 243 "linearly changed from min speed to max speed" 242 "linearly changed from min speed to max speed" 241 "linearly changed from min speed to max speed" 240 "linearly changed from min speed to max speed" 239 "linearly changed from min speed to max speed" 238 "linearly changed from min speed to max speed" 237 "linearly changed from min speed to max speed" 236 "linearly changed from min speed to max speed" 235 "linearly changed from min speed to max speed" 234 "linearly changed from min speed to max speed" 233 "linearly changed from min speed to max speed" 232 "linearly changed from min speed to max speed" 231 "linearly changed from min speed to max speed" 230 "linearly changed from min speed to max speed" 229 "linearly changed from min speed to max speed" 228 "linearly changed from min speed to max speed" 227 "linearly changed from min speed to max speed" 226 "linearly changed from min speed to max speed" 225 "linearly changed from min speed to max speed" 224 "linearly changed from min speed to max speed" 223 "linearly changed from min speed to max speed" 222 "linearly changed from min speed to max speed" 221 "linearly changed from min speed to max speed" 220 "linearly changed from min speed to max speed" 219 "linearly changed from min speed to max speed" 218 "linearly changed from min speed to max speed" 217 "linearly changed from min speed to max speed" 216 "linearly changed from min speed to max speed" 215 "linearly changed from min speed to max speed" 214 "linearly changed from min speed to max speed" 213 "linearly changed from min speed to max speed" 212 "linearly changed from min speed to max speed" 211 "linearly changed from min speed to max speed" 210 "linearly changed from min speed to max speed" 209 "linearly changed from min speed to max speed" 208 "linearly changed from min speed to max speed" 207 "linearly changed from min speed to max speed" 206 "linearly changed from min speed to max speed" 205 "linearly changed from min speed to max speed" 204 "linearly changed from min speed to max speed" 203 "linearly changed from min speed to max speed" 202 "linearly changed from min speed to max speed" 201 "linearly changed from min speed to max speed" 200 "linearly changed from min speed to max speed" 199 "linearly changed from min speed to max speed" 198 "linearly changed from min speed to max speed" 197 "linearly changed from min speed to max speed" 196 "linearly changed from min speed to max speed" 195 "linearly changed from min speed to max speed" 194 "linearly changed from min speed to max speed" 193 "linearly changed from min speed to max speed" 192 "linearly changed from min speed to max speed" 191 "linearly changed from min speed to max speed" 190 "linearly changed from min speed to max speed" 189 "linearly changed from min speed to max speed" 188 "linearly changed from min speed to max speed" 187 "linearly changed from min speed to max speed" 186 "linearly changed from min speed to max speed" 185 "linearly changed from min speed to max speed" 184 "linearly changed from min speed to max speed" 183 "linearly changed from min speed to max speed" 182 "linearly changed from min speed to max speed" 181 "linearly changed from min speed to max speed" 180 "linearly changed from min speed to max speed" 179 "linearly changed from min speed to max speed" 178 "linearly changed from min speed to max speed" 177 "linearly changed from min speed to max speed" 176 "linearly changed from min speed to max speed" 175 "linearly changed from min speed to max speed" 174 "linearly changed from min speed to max speed" 173 "linearly changed from min speed to max speed" 172 "linearly changed from min speed to max speed" 171 "linearly changed from min speed to max speed" 170 "linearly changed from min speed to max speed" 169 "linearly changed from min speed to max speed" 168 "linearly changed from min speed to max speed" 167 "linearly changed from min speed to max speed" 166 "linearly changed from min speed to max speed" 165 "linearly changed from min speed to max speed" 164 "linearly changed from min speed to max speed" 163 "linearly changed from min speed to max speed" 162 "linearly changed from min speed to max speed" 161 "linearly changed from min speed to max speed" 160 "linearly changed from min speed to max speed" 159 "linearly changed from min speed to max speed" 158 "linearly changed from min speed to max speed" 157 "linearly changed from min speed to max speed" 156 "linearly changed from min speed to max speed" 155 "linearly changed from min speed to max speed" 154 "linearly changed from min speed to max speed" 153 "linearly changed from min speed to max speed" 152 "linearly changed from min speed to max speed" 151 "linearly changed from min speed to max speed" 150 "linearly changed from min speed to max speed" 149 "linearly changed from min speed to max speed" 148 "linearly changed from min speed to max speed" 147 "linearly changed from min speed to max speed" 146 "linearly changed from min speed to max speed" 145 "linearly changed from min speed to max speed" 144 "linearly changed from min speed to max speed" 143 "linearly changed from min speed to max speed" 142 "linearly changed from min speed to max speed" 141 "linearly changed from min speed to max speed" 140 "linearly changed from min speed to max speed" 139 "linearly changed from min speed to max speed" 138 "linearly changed from min speed to max speed" 137 "linearly changed from min speed to max speed" 136 "linearly changed from min speed to max speed" 135 "linearly changed from min speed to max speed" 134 "linearly changed from min speed to max speed" 133 "linearly changed from min speed to max speed" 132 "linearly changed from min speed to max speed" 131 "linearly changed from min speed to max speed" 130 "linearly changed from min speed to max speed" 129 "linearly changed from min speed to max speed" 128 "linearly changed from min speed to max speed" 127 "linearly changed from min speed to max speed" 126 "linearly changed from min speed to max speed" 125 "linearly changed from min speed to max speed" 124 "linearly changed from min speed to max speed" 123 "linearly changed from min speed to max speed" 122 "linearly changed from min speed to max speed" 121 "linearly changed from min speed to max speed" 120 "linearly changed from min speed to max speed" 119 "linearly changed from min speed to max speed" 118 "linearly changed from min speed to max speed" 117 "linearly changed from min speed to max speed" 116 "linearly changed from min speed to max speed" 115 "linearly changed from min speed to max speed" 114 "linearly changed from min speed to max speed" 113 "linearly changed from min speed to max speed" 112 "linearly changed from min speed to max speed" 111 "linearly changed from min speed to max speed" 110 "linearly changed from min speed to max speed" 109 "linearly changed from min speed to max speed" 108 "linearly changed from min speed to max speed" 107 "linearly changed from min speed to max speed" 106 "linearly changed from min speed to max speed" 105 "linearly changed from min speed to max speed" 104 "linearly changed from min speed to max speed" 103 "linearly changed from min speed to max speed" 102 "linearly changed from min speed to max speed" 101 "linearly changed from min speed to max speed" 100 "linearly changed from min speed to max speed" 99 "linearly changed from min speed to max speed" 98 "linearly changed from min speed to max speed" 97 "linearly changed from min speed to max speed" 96 "linearly changed from min speed to max speed" 95 "linearly changed from min speed to max speed" 94 "linearly changed from min speed to max speed" 93 "linearly changed from min speed to max speed" 92 "linearly changed from min speed to max speed" 91 "linearly changed from min speed to max speed" 90 "linearly changed from min speed to max speed" 89 "linearly changed from min speed to max speed" 88 "linearly changed from min speed to max speed" 87 "linearly changed from min speed to max speed" 86 "linearly changed from min speed to max speed" 85 "linearly changed from min speed to max speed" 84 "linearly changed from min speed to max speed" 83 "linearly changed from min speed to max speed" 82 "linearly changed from min speed to max speed" 81 "linearly changed from min speed to max speed" 80 "linearly changed from min speed to max speed" 79 "linearly changed from min speed to max speed" 78 "linearly changed from min speed to max speed" 77 "linearly changed from min speed to max speed" 76 "linearly changed from min speed to max speed" 75 "linearly changed from min speed to max speed" 74 "linearly changed from min speed to max speed" 73 "linearly changed from min speed to max speed" 72 "linearly changed from min speed to max speed" 71 "linearly changed from min speed to max speed" 70 "linearly changed from min speed to max speed" 69 "linearly changed from min speed to max speed" 68 "linearly changed from min speed to max speed" 67 "linearly changed from min speed to max speed" 66 "linearly changed from min speed to max speed" 65 "linearly changed from min speed to max speed" 64 "linearly changed from min speed to max speed" 63 "linearly changed from min speed to max speed" 62 "linearly changed from min speed to max speed" 61 "linearly changed from min speed to max speed" 60 "linearly changed from min speed to max speed" 59 "linearly changed from min speed to max speed" 58 "linearly changed from min speed to max speed" 57 "linearly changed from min speed to max speed" 56 "linearly changed from min speed to max speed" 55 "linearly changed from min speed to max speed" 54 "linearly changed from min speed to max speed" 53 "linearly changed from min speed to max speed" 52 "linearly changed from min speed to max speed" 51 "linearly changed from min speed to max speed" 50 "linearly changed from min speed to max speed" 49 "min speed rpm" 48 "min speed rpm" 47 "min speed rpm" 46 "min speed rpm" 45 "min speed rpm" 44 "min speed rpm" 43 "min speed rpm" 42 "min speed rpm" 41 "min speed rpm" 40 "min speed rpm" 39 "min speed rpm" 38 "min speed rpm" 37 "min speed rpm" 36 "min speed rpm" 35 "min speed rpm" 34 "min speed rpm" 33 "min speed rpm" 32 "min speed rpm" 31 "min speed rpm" 30 "min speed rpm" 29 "min speed rpm" 28 "min speed rpm" 27 "min speed rpm" 26 "min speed rpm" 25 "min speed rpm" 24 "min speed rpm" 23 "min speed rpm" 22 "min speed rpm" 21 "min speed rpm" 20 "min speed rpm" 19 "min speed rpm" 18 "min speed rpm" 17 "min speed rpm" 16 "min speed rpm" 15 "min speed rpm" 14 "min speed rpm" 13 "min speed rpm" 12 "min speed rpm" 11 "min speed rpm" 10 "min speed rpm" 9 "min speed rpm" 8 "min speed rpm" 7 "min speed rpm" 6 "min speed rpm" 5 "min speed rpm" 4 "min speed rpm" 3 "0 rpm" 2 "0 rpm" 1 "0 rpm" 0 "0 rpm";
VAL_ 596 EWP2_Curr_Stat 255 "Invalid";
VAL_ 596 EWP2_Block_Error 3 "Invalid" 2 "SNA" 1 "ERROR" 0 "NO ERROR";
VAL_ 596 EWP2_DryRun_Error 3 "Invalid" 2 "SNA" 1 "ERROR" 0 "NO ERROR";
VAL_ 596 EWP2_OverCurr_Error 3 "Invalid" 2 "SNA" 1 "ERROR" 0 "NO ERROR";
VAL_ 596 EWP2_SupVolt_Error 2 "SNA" 1 "ERROR" 0 "NO ERROR";
VAL_ 596 EWP2_RsErr_EWP 1 "ERROR" 0 "NO ERROR";
VAL_ 596 EWP3_Block_Error 3 "Invalid" 2 "SNA" 1 "ERROR" 0 "NO ERROR";
VAL_ 596 EWP3_DryRun_Error 3 "Invalid" 2 "SNA" 1 "ERROR" 0 "NO ERROR";
VAL_ 596 EWP3_RPM_Target_Stat 255 "Invalid" 254 "max speed rpm" 253 "max speed rpm" 252 "max speed rpm" 251 "max speed rpm" 250 "linearly changed from min speed to max speed" 249 "linearly changed from min speed to max speed" 248 "linearly changed from min speed to max speed" 247 "linearly changed from min speed to max speed" 246 "linearly changed from min speed to max speed" 245 "linearly changed from min speed to max speed" 244 "linearly changed from min speed to max speed" 243 "linearly changed from min speed to max speed" 242 "linearly changed from min speed to max speed" 241 "linearly changed from min speed to max speed" 240 "linearly changed from min speed to max speed" 239 "linearly changed from min speed to max speed" 238 "linearly changed from min speed to max speed" 237 "linearly changed from min speed to max speed" 236 "linearly changed from min speed to max speed" 235 "linearly changed from min speed to max speed" 234 "linearly changed from min speed to max speed" 233 "linearly changed from min speed to max speed" 232 "linearly changed from min speed to max speed" 231 "linearly changed from min speed to max speed" 230 "linearly changed from min speed to max speed" 229 "linearly changed from min speed to max speed" 228 "linearly changed from min speed to max speed" 227 "linearly changed from min speed to max speed" 226 "linearly changed from min speed to max speed" 225 "linearly changed from min speed to max speed" 224 "linearly changed from min speed to max speed" 223 "linearly changed from min speed to max speed" 222 "linearly changed from min speed to max speed" 221 "linearly changed from min speed to max speed" 220 "linearly changed from min speed to max speed" 219 "linearly changed from min speed to max speed" 218 "linearly changed from min speed to max speed" 217 "linearly changed from min speed to max speed" 216 "linearly changed from min speed to max speed" 215 "linearly changed from min speed to max speed" 214 "linearly changed from min speed to max speed" 213 "linearly changed from min speed to max speed" 212 "linearly changed from min speed to max speed" 211 "linearly changed from min speed to max speed" 210 "linearly changed from min speed to max speed" 209 "linearly changed from min speed to max speed" 208 "linearly changed from min speed to max speed" 207 "linearly changed from min speed to max speed" 206 "linearly changed from min speed to max speed" 205 "linearly changed from min speed to max speed" 204 "linearly changed from min speed to max speed" 203 "linearly changed from min speed to max speed" 202 "linearly changed from min speed to max speed" 201 "linearly changed from min speed to max speed" 200 "linearly changed from min speed to max speed" 199 "linearly changed from min speed to max speed" 198 "linearly changed from min speed to max speed" 197 "linearly changed from min speed to max speed" 196 "linearly changed from min speed to max speed" 195 "linearly changed from min speed to max speed" 194 "linearly changed from min speed to max speed" 193 "linearly changed from min speed to max speed" 192 "linearly changed from min speed to max speed" 191 "linearly changed from min speed to max speed" 190 "linearly changed from min speed to max speed" 189 "linearly changed from min speed to max speed" 188 "linearly changed from min speed to max speed" 187 "linearly changed from min speed to max speed" 186 "linearly changed from min speed to max speed" 185 "linearly changed from min speed to max speed" 184 "linearly changed from min speed to max speed" 183 "linearly changed from min speed to max speed" 182 "linearly changed from min speed to max speed" 181 "linearly changed from min speed to max speed" 180 "linearly changed from min speed to max speed" 179 "linearly changed from min speed to max speed" 178 "linearly changed from min speed to max speed" 177 "linearly changed from min speed to max speed" 176 "linearly changed from min speed to max speed" 175 "linearly changed from min speed to max speed" 174 "linearly changed from min speed to max speed" 173 "linearly changed from min speed to max speed" 172 "linearly changed from min speed to max speed" 171 "linearly changed from min speed to max speed" 170 "linearly changed from min speed to max speed" 169 "linearly changed from min speed to max speed" 168 "linearly changed from min speed to max speed" 167 "linearly changed from min speed to max speed" 166 "linearly changed from min speed to max speed" 165 "linearly changed from min speed to max speed" 164 "linearly changed from min speed to max speed" 163 "linearly changed from min speed to max speed" 162 "linearly changed from min speed to max speed" 161 "linearly changed from min speed to max speed" 160 "linearly changed from min speed to max speed" 159 "linearly changed from min speed to max speed" 158 "linearly changed from min speed to max speed" 157 "linearly changed from min speed to max speed" 156 "linearly changed from min speed to max speed" 155 "linearly changed from min speed to max speed" 154 "linearly changed from min speed to max speed" 153 "linearly changed from min speed to max speed" 152 "linearly changed from min speed to max speed" 151 "linearly changed from min speed to max speed" 150 "linearly changed from min speed to max speed" 149 "linearly changed from min speed to max speed" 148 "linearly changed from min speed to max speed" 147 "linearly changed from min speed to max speed" 146 "linearly changed from min speed to max speed" 145 "linearly changed from min speed to max speed" 144 "linearly changed from min speed to max speed" 143 "linearly changed from min speed to max speed" 142 "linearly changed from min speed to max speed" 141 "linearly changed from min speed to max speed" 140 "linearly changed from min speed to max speed" 139 "linearly changed from min speed to max speed" 138 "linearly changed from min speed to max speed" 137 "linearly changed from min speed to max speed" 136 "linearly changed from min speed to max speed" 135 "linearly changed from min speed to max speed" 134 "linearly changed from min speed to max speed" 133 "linearly changed from min speed to max speed" 132 "linearly changed from min speed to max speed" 131 "linearly changed from min speed to max speed" 130 "linearly changed from min speed to max speed" 129 "linearly changed from min speed to max speed" 128 "linearly changed from min speed to max speed" 127 "linearly changed from min speed to max speed" 126 "linearly changed from min speed to max speed" 125 "linearly changed from min speed to max speed" 124 "linearly changed from min speed to max speed" 123 "linearly changed from min speed to max speed" 122 "linearly changed from min speed to max speed" 121 "linearly changed from min speed to max speed" 120 "linearly changed from min speed to max speed" 119 "linearly changed from min speed to max speed" 118 "linearly changed from min speed to max speed" 117 "linearly changed from min speed to max speed" 116 "linearly changed from min speed to max speed" 115 "linearly changed from min speed to max speed" 114 "linearly changed from min speed to max speed" 113 "linearly changed from min speed to max speed" 112 "linearly changed from min speed to max speed" 111 "linearly changed from min speed to max speed" 110 "linearly changed from min speed to max speed" 109 "linearly changed from min speed to max speed" 108 "linearly changed from min speed to max speed" 107 "linearly changed from min speed to max speed" 106 "linearly changed from min speed to max speed" 105 "linearly changed from min speed to max speed" 104 "linearly changed from min speed to max speed" 103 "linearly changed from min speed to max speed" 102 "linearly changed from min speed to max speed" 101 "linearly changed from min speed to max speed" 100 "linearly changed from min speed to max speed" 99 "linearly changed from min speed to max speed" 98 "linearly changed from min speed to max speed" 97 "linearly changed from min speed to max speed" 96 "linearly changed from min speed to max speed" 95 "linearly changed from min speed to max speed" 94 "linearly changed from min speed to max speed" 93 "linearly changed from min speed to max speed" 92 "linearly changed from min speed to max speed" 91 "linearly changed from min speed to max speed" 90 "linearly changed from min speed to max speed" 89 "linearly changed from min speed to max speed" 88 "linearly changed from min speed to max speed" 87 "linearly changed from min speed to max speed" 86 "linearly changed from min speed to max speed" 85 "linearly changed from min speed to max speed" 84 "linearly changed from min speed to max speed" 83 "linearly changed from min speed to max speed" 82 "linearly changed from min speed to max speed" 81 "linearly changed from min speed to max speed" 80 "linearly changed from min speed to max speed" 79 "linearly changed from min speed to max speed" 78 "linearly changed from min speed to max speed" 77 "linearly changed from min speed to max speed" 76 "linearly changed from min speed to max speed" 75 "linearly changed from min speed to max speed" 74 "linearly changed from min speed to max speed" 73 "linearly changed from min speed to max speed" 72 "linearly changed from min speed to max speed" 71 "linearly changed from min speed to max speed" 70 "linearly changed from min speed to max speed" 69 "linearly changed from min speed to max speed" 68 "linearly changed from min speed to max speed" 67 "linearly changed from min speed to max speed" 66 "linearly changed from min speed to max speed" 65 "linearly changed from min speed to max speed" 64 "linearly changed from min speed to max speed" 63 "linearly changed from min speed to max speed" 62 "linearly changed from min speed to max speed" 61 "linearly changed from min speed to max speed" 60 "linearly changed from min speed to max speed" 59 "linearly changed from min speed to max speed" 58 "linearly changed from min speed to max speed" 57 "linearly changed from min speed to max speed" 56 "linearly changed from min speed to max speed" 55 "linearly changed from min speed to max speed" 54 "linearly changed from min speed to max speed" 53 "linearly changed from min speed to max speed" 52 "linearly changed from min speed to max speed" 51 "linearly changed from min speed to max speed" 50 "linearly changed from min speed to max speed" 49 "min speed rpm" 48 "min speed rpm" 47 "min speed rpm" 46 "min speed rpm" 45 "min speed rpm" 44 "min speed rpm" 43 "min speed rpm" 42 "min speed rpm" 41 "min speed rpm" 40 "min speed rpm" 39 "min speed rpm" 38 "min speed rpm" 37 "min speed rpm" 36 "min speed rpm" 35 "min speed rpm" 34 "min speed rpm" 33 "min speed rpm" 32 "min speed rpm" 31 "min speed rpm" 30 "min speed rpm" 29 "min speed rpm" 28 "min speed rpm" 27 "min speed rpm" 26 "min speed rpm" 25 "min speed rpm" 24 "min speed rpm" 23 "min speed rpm" 22 "min speed rpm" 21 "min speed rpm" 20 "min speed rpm" 19 "min speed rpm" 18 "min speed rpm" 17 "min speed rpm" 16 "min speed rpm" 15 "min speed rpm" 14 "min speed rpm" 13 "min speed rpm" 12 "min speed rpm" 11 "min speed rpm" 10 "min speed rpm" 9 "min speed rpm" 8 "min speed rpm" 7 "min speed rpm" 6 "min speed rpm" 5 "min speed rpm" 4 "min speed rpm" 3 "0 rpm" 2 "0 rpm" 1 "0 rpm" 0 "0 rpm";
VAL_ 596 EWP3_RPM_ActlVal_Stat 255 "Invalid" 254 "max speed rpm" 253 "max speed rpm" 252 "max speed rpm" 251 "max speed rpm" 250 "linearly changed from min speed to max speed" 249 "linearly changed from min speed to max speed" 248 "linearly changed from min speed to max speed" 247 "linearly changed from min speed to max speed" 246 "linearly changed from min speed to max speed" 245 "linearly changed from min speed to max speed" 244 "linearly changed from min speed to max speed" 243 "linearly changed from min speed to max speed" 242 "linearly changed from min speed to max speed" 241 "linearly changed from min speed to max speed" 240 "linearly changed from min speed to max speed" 239 "linearly changed from min speed to max speed" 238 "linearly changed from min speed to max speed" 237 "linearly changed from min speed to max speed" 236 "linearly changed from min speed to max speed" 235 "linearly changed from min speed to max speed" 234 "linearly changed from min speed to max speed" 233 "linearly changed from min speed to max speed" 232 "linearly changed from min speed to max speed" 231 "linearly changed from min speed to max speed" 230 "linearly changed from min speed to max speed" 229 "linearly changed from min speed to max speed" 228 "linearly changed from min speed to max speed" 227 "linearly changed from min speed to max speed" 226 "linearly changed from min speed to max speed" 225 "linearly changed from min speed to max speed" 224 "linearly changed from min speed to max speed" 223 "linearly changed from min speed to max speed" 222 "linearly changed from min speed to max speed" 221 "linearly changed from min speed to max speed" 220 "linearly changed from min speed to max speed" 219 "linearly changed from min speed to max speed" 218 "linearly changed from min speed to max speed" 217 "linearly changed from min speed to max speed" 216 "linearly changed from min speed to max speed" 215 "linearly changed from min speed to max speed" 214 "linearly changed from min speed to max speed" 213 "linearly changed from min speed to max speed" 212 "linearly changed from min speed to max speed" 211 "linearly changed from min speed to max speed" 210 "linearly changed from min speed to max speed" 209 "linearly changed from min speed to max speed" 208 "linearly changed from min speed to max speed" 207 "linearly changed from min speed to max speed" 206 "linearly changed from min speed to max speed" 205 "linearly changed from min speed to max speed" 204 "linearly changed from min speed to max speed" 203 "linearly changed from min speed to max speed" 202 "linearly changed from min speed to max speed" 201 "linearly changed from min speed to max speed" 200 "linearly changed from min speed to max speed" 199 "linearly changed from min speed to max speed" 198 "linearly changed from min speed to max speed" 197 "linearly changed from min speed to max speed" 196 "linearly changed from min speed to max speed" 195 "linearly changed from min speed to max speed" 194 "linearly changed from min speed to max speed" 193 "linearly changed from min speed to max speed" 192 "linearly changed from min speed to max speed" 191 "linearly changed from min speed to max speed" 190 "linearly changed from min speed to max speed" 189 "linearly changed from min speed to max speed" 188 "linearly changed from min speed to max speed" 187 "linearly changed from min speed to max speed" 186 "linearly changed from min speed to max speed" 185 "linearly changed from min speed to max speed" 184 "linearly changed from min speed to max speed" 183 "linearly changed from min speed to max speed" 182 "linearly changed from min speed to max speed" 181 "linearly changed from min speed to max speed" 180 "linearly changed from min speed to max speed" 179 "linearly changed from min speed to max speed" 178 "linearly changed from min speed to max speed" 177 "linearly changed from min speed to max speed" 176 "linearly changed from min speed to max speed" 175 "linearly changed from min speed to max speed" 174 "linearly changed from min speed to max speed" 173 "linearly changed from min speed to max speed" 172 "linearly changed from min speed to max speed" 171 "linearly changed from min speed to max speed" 170 "linearly changed from min speed to max speed" 169 "linearly changed from min speed to max speed" 168 "linearly changed from min speed to max speed" 167 "linearly changed from min speed to max speed" 166 "linearly changed from min speed to max speed" 165 "linearly changed from min speed to max speed" 164 "linearly changed from min speed to max speed" 163 "linearly changed from min speed to max speed" 162 "linearly changed from min speed to max speed" 161 "linearly changed from min speed to max speed" 160 "linearly changed from min speed to max speed" 159 "linearly changed from min speed to max speed" 158 "linearly changed from min speed to max speed" 157 "linearly changed from min speed to max speed" 156 "linearly changed from min speed to max speed" 155 "linearly changed from min speed to max speed" 154 "linearly changed from min speed to max speed" 153 "linearly changed from min speed to max speed" 152 "linearly changed from min speed to max speed" 151 "linearly changed from min speed to max speed" 150 "linearly changed from min speed to max speed" 149 "linearly changed from min speed to max speed" 148 "linearly changed from min speed to max speed" 147 "linearly changed from min speed to max speed" 146 "linearly changed from min speed to max speed" 145 "linearly changed from min speed to max speed" 144 "linearly changed from min speed to max speed" 143 "linearly changed from min speed to max speed" 142 "linearly changed from min speed to max speed" 141 "linearly changed from min speed to max speed" 140 "linearly changed from min speed to max speed" 139 "linearly changed from min speed to max speed" 138 "linearly changed from min speed to max speed" 137 "linearly changed from min speed to max speed" 136 "linearly changed from min speed to max speed" 135 "linearly changed from min speed to max speed" 134 "linearly changed from min speed to max speed" 133 "linearly changed from min speed to max speed" 132 "linearly changed from min speed to max speed" 131 "linearly changed from min speed to max speed" 130 "linearly changed from min speed to max speed" 129 "linearly changed from min speed to max speed" 128 "linearly changed from min speed to max speed" 127 "linearly changed from min speed to max speed" 126 "linearly changed from min speed to max speed" 125 "linearly changed from min speed to max speed" 124 "linearly changed from min speed to max speed" 123 "linearly changed from min speed to max speed" 122 "linearly changed from min speed to max speed" 121 "linearly changed from min speed to max speed" 120 "linearly changed from min speed to max speed" 119 "linearly changed from min speed to max speed" 118 "linearly changed from min speed to max speed" 117 "linearly changed from min speed to max speed" 116 "linearly changed from min speed to max speed" 115 "linearly changed from min speed to max speed" 114 "linearly changed from min speed to max speed" 113 "linearly changed from min speed to max speed" 112 "linearly changed from min speed to max speed" 111 "linearly changed from min speed to max speed" 110 "linearly changed from min speed to max speed" 109 "linearly changed from min speed to max speed" 108 "linearly changed from min speed to max speed" 107 "linearly changed from min speed to max speed" 106 "linearly changed from min speed to max speed" 105 "linearly changed from min speed to max speed" 104 "linearly changed from min speed to max speed" 103 "linearly changed from min speed to max speed" 102 "linearly changed from min speed to max speed" 101 "linearly changed from min speed to max speed" 100 "linearly changed from min speed to max speed" 99 "linearly changed from min speed to max speed" 98 "linearly changed from min speed to max speed" 97 "linearly changed from min speed to max speed" 96 "linearly changed from min speed to max speed" 95 "linearly changed from min speed to max speed" 94 "linearly changed from min speed to max speed" 93 "linearly changed from min speed to max speed" 92 "linearly changed from min speed to max speed" 91 "linearly changed from min speed to max speed" 90 "linearly changed from min speed to max speed" 89 "linearly changed from min speed to max speed" 88 "linearly changed from min speed to max speed" 87 "linearly changed from min speed to max speed" 86 "linearly changed from min speed to max speed" 85 "linearly changed from min speed to max speed" 84 "linearly changed from min speed to max speed" 83 "linearly changed from min speed to max speed" 82 "linearly changed from min speed to max speed" 81 "linearly changed from min speed to max speed" 80 "linearly changed from min speed to max speed" 79 "linearly changed from min speed to max speed" 78 "linearly changed from min speed to max speed" 77 "linearly changed from min speed to max speed" 76 "linearly changed from min speed to max speed" 75 "linearly changed from min speed to max speed" 74 "linearly changed from min speed to max speed" 73 "linearly changed from min speed to max speed" 72 "linearly changed from min speed to max speed" 71 "linearly changed from min speed to max speed" 70 "linearly changed from min speed to max speed" 69 "linearly changed from min speed to max speed" 68 "linearly changed from min speed to max speed" 67 "linearly changed from min speed to max speed" 66 "linearly changed from min speed to max speed" 65 "linearly changed from min speed to max speed" 64 "linearly changed from min speed to max speed" 63 "linearly changed from min speed to max speed" 62 "linearly changed from min speed to max speed" 61 "linearly changed from min speed to max speed" 60 "linearly changed from min speed to max speed" 59 "linearly changed from min speed to max speed" 58 "linearly changed from min speed to max speed" 57 "linearly changed from min speed to max speed" 56 "linearly changed from min speed to max speed" 55 "linearly changed from min speed to max speed" 54 "linearly changed from min speed to max speed" 53 "linearly changed from min speed to max speed" 52 "linearly changed from min speed to max speed" 51 "linearly changed from min speed to max speed" 50 "linearly changed from min speed to max speed" 49 "min speed rpm" 48 "min speed rpm" 47 "min speed rpm" 46 "min speed rpm" 45 "min speed rpm" 44 "min speed rpm" 43 "min speed rpm" 42 "min speed rpm" 41 "min speed rpm" 40 "min speed rpm" 39 "min speed rpm" 38 "min speed rpm" 37 "min speed rpm" 36 "min speed rpm" 35 "min speed rpm" 34 "min speed rpm" 33 "min speed rpm" 32 "min speed rpm" 31 "min speed rpm" 30 "min speed rpm" 29 "min speed rpm" 28 "min speed rpm" 27 "min speed rpm" 26 "min speed rpm" 25 "min speed rpm" 24 "min speed rpm" 23 "min speed rpm" 22 "min speed rpm" 21 "min speed rpm" 20 "min speed rpm" 19 "min speed rpm" 18 "min speed rpm" 17 "min speed rpm" 16 "min speed rpm" 15 "min speed rpm" 14 "min speed rpm" 13 "min speed rpm" 12 "min speed rpm" 11 "min speed rpm" 10 "min speed rpm" 9 "min speed rpm" 8 "min speed rpm" 7 "min speed rpm" 6 "min speed rpm" 5 "min speed rpm" 4 "min speed rpm" 3 "0 rpm" 2 "0 rpm" 1 "0 rpm" 0 "0 rpm";
VAL_ 596 EWP3_Curr_Stat 255 "invalid";
VAL_ 596 EWP3_OverCurr_Error 3 "Invalid" 2 "SNA" 1 "ERROR" 0 "NO ERROR";
VAL_ 596 EWP3_SupVolt_Error 2 "SNA" 1 "ERROR" 0 "NO ERROR";
VAL_ 596 EWP3_RsErr_EWP 1 "ERROR" 0 "NO ERROR";
VAL_ 596 EWP3_Temp_Stat 255 "Invalid";
VAL_ 596 EWP3_Volt_Stat 255 "Invalid";
VAL_ 596 EXV2_Rsp_Fault_Stat 15 "not defined" 14 "not defined" 13 "not defined" 12 "not defined" 11 "not defined" 10 "not defined" 9 "not defined" 8 "not defined" 7 "not defined" 6 "not defined" 5 "not defined" 4 "not defined" 3 "Over temperature shutdown" 2 "Motor-Coil open load" 1 "Motor-Coil shorted" 0 "Actuator Not Faulted";
VAL_ 596 EXV2_Rsp_CurInit_Stat 3 "Unused and Undefined" 2 "Initialized" 1 "Initialization in Process" 0 "Not Initialized";
VAL_ 596 EXV2_Rsp_OvrTemp_Warn 3 "not defined" 2 "not defined" 1 "High Temperature Warning" 0 "Ok";
VAL_ 596 EXV2_Rsp_Volt_Stat 3 "not defined" 2 "Under voltage" 1 "Overvoltage" 0 "Voltage Range ok";
VAL_ 596 EXV2_RsErr_EXV 1 "Comm Error detected" 0 "No Comm Error";
VAL_ 596 EXV2_Rsp_Run_Stat 1 "Actuator is moving" 0 "Actuator is not moving";
VAL_ 596 CCV4_Fault_Signal 4 "Coil Short Detected" 3 "OverTemp Shutdown" 2 "Stall Detected" 1 "Coil_Open Detected" 0 "No Fault";
VAL_ 596 BDC_1_Rsp_Comm_Err 1 "LIN Communication Error" 0 "No Error";
VAL_ 596 CCV4_TempWarn 1 "Temperature Warning" 0 "No Error";
VAL_ 596 CCV4_Rsp_Comm_Err 1 "LIN Communication Error" 0 "No Error";
VAL_ 596 CCV4_MotorStatus 1 "Motor Running" 0 "Motor Stop";
VAL_ 596 CCV4_RespPos 3 "Valve is opening" 2 "Valve is closing" 1 "Open Port 1 to Port 4, Port 2 to port 3" 0 "Open Port 1 to Port 2, Port 3 to port 4";
VAL_ 596 CCV4_voltageErr 2 "lackvoltage" 1 "overvoltage" 0 "No Error";
VAL_ 596 BDC_1_Fault_Signal 4 "Coil Short Detected" 3 "OverTemp Shutdown" 2 "Stall Detected" 1 "Coil_Open Detected" 0 "No Fault";
VAL_ 596 BDC_1_voltageErr 2 "lackvoltage" 1 "overvoltage" 0 "No Error";
VAL_ 596 BDC_1_TempWarn 1 "Temperature Warning" 0 "No Error";
VAL_ 596 BDC_1_MotorStatus 1 "Motor Running" 0 "Motor Stop";
