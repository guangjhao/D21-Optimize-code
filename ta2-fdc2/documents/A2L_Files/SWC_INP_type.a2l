/******************************************************************************
* ASAP2 file: SWC_INP_type.a2l
* Code generation for model "SWC_INP_type".
* Model version : 1.10
* Simulink Coder version : 9.6 (R2021b) 14-May-2021
* C source code generated on : Wed May 14 10:49:08 2025
* Target selection: autosar.tlc
* Embedded hardware selection: ARM Compatible->ARM Cortex-M
* Code generation objectives: Unspecified
* Validation result: Not run
* (add additional file header information here)
******************************************************************************/
/* Version 1.31 */
ASAP2_VERSION 1 31
/begin PROJECT ProjectName "Project Comment Goes Here"
/begin HEADER "Header Comments go here" /end HEADER
/begin MODULE ModuleName "Module Comment Goes Here"
/begin MOD_PAR "MOD PAR Comment Goes Here" /end MOD_PAR
/begin MOD_COMMON "Mod Common Comment Here" BYTE_ORDER MSB_LAST /end MOD_COMMON
/begin RECORD_LAYOUT Scalar_BOOLEAN FNC_VALUES 1 UBYTE COLUMN_DIR DIRECT /end RECORD_LAYOUT
/begin RECORD_LAYOUT Scalar_UBYTE FNC_VALUES 1 UBYTE COLUMN_DIR DIRECT /end RECORD_LAYOUT
/begin RECORD_LAYOUT Scalar_UWORD FNC_VALUES 1 UWORD COLUMN_DIR DIRECT /end RECORD_LAYOUT
/begin RECORD_LAYOUT Scalar_LONG FNC_VALUES 1 SLONG COLUMN_DIR DIRECT /end RECORD_LAYOUT
/begin RECORD_LAYOUT Scalar_FLOAT32_IEEE FNC_VALUES 1 FLOAT32_IEEE COLUMN_DIR DIRECT /end RECORD_LAYOUT
/begin RECORD_LAYOUT Scalar_FLOAT64_IEEE FNC_VALUES 1 FLOAT64_IEEE COLUMN_DIR DIRECT /end RECORD_LAYOUT
/begin RECORD_LAYOUT Lookup1D_BOOLEAN FNC_VALUES 1 UBYTE COLUMN_DIR DIRECT /end RECORD_LAYOUT
/begin RECORD_LAYOUT Lookup1D_X_BOOLEAN AXIS_PTS_X 1 UBYTE INDEX_INCR DIRECT /end RECORD_LAYOUT
/begin RECORD_LAYOUT Lookup1D_BYTE FNC_VALUES 1 SBYTE COLUMN_DIR DIRECT /end RECORD_LAYOUT
/begin RECORD_LAYOUT Lookup1D_X_BYTE AXIS_PTS_X 1 SBYTE INDEX_INCR DIRECT /end RECORD_LAYOUT
/begin RECORD_LAYOUT Lookup1D_UBYTE FNC_VALUES 1 UBYTE COLUMN_DIR DIRECT /end RECORD_LAYOUT
/begin CHARACTERISTIC KINP_APSAngleTarget_Deg_ovrdval "" VALUE 0x0000 /* @ECU_Address@KINP_APSAngleTarget_Deg_ovrdval@ */ Scalar_FLOAT32_IEEE 0 SWC_INP_type_CM_single_Deg -900.0 900.0 /end CHARACTERISTIC
/begin CHARACTERISTIC KINP_APSDecReq_mps2_ovrdval "" VALUE 0x0000 /* @ECU_Address@KINP_APSDecReq_mps2_ovrdval@ */ Scalar_FLOAT32_IEEE 0 SWC_INP_type_CM_single_mps2 0.0 25.4 /end CHARACTERISTIC
/begin CHARACTERISTIC KINP_APSProgressPCT_pct_ovrdval "" VALUE 0x0000 /* @ECU_Address@KINP_APSProgressPCT_pct_ovrdval@ */ Scalar_FLOAT32_IEEE 0 SWC_INP_type_CM_single_pct 0.0 100.0 /end CHARACTERISTIC
/begin CHARACTERISTIC KINP_APSSpeedCMD_kph_ovrdval "" VALUE 0x0000 /* @ECU_Address@KINP_APSSpeedCMD_kph_ovrdval@ */ Scalar_FLOAT32_IEEE 0 SWC_INP_type_CM_single_kph 0.0 20.0 /end CHARACTERISTIC
/begin CHARACTERISTIC KINP_APSDFLL_cm_ovrdval "" VALUE 0x0000 /* @ECU_Address@KINP_APSDFLL_cm_ovrdval@ */ Scalar_UWORD 0 SWC_INP_type_CM_uint16_cm 0.0 65535.0 /end CHARACTERISTIC
/begin CHARACTERISTIC KINP_APSDFLR_cm_ovrdval "" VALUE 0x0000 /* @ECU_Address@KINP_APSDFLR_cm_ovrdval@ */ Scalar_UWORD 0 SWC_INP_type_CM_uint16_cm 0.0 65535.0 /end CHARACTERISTIC
/begin CHARACTERISTIC KINP_APSDRLL_cm_ovrdval "" VALUE 0x0000 /* @ECU_Address@KINP_APSDRLL_cm_ovrdval@ */ Scalar_UWORD 0 SWC_INP_type_CM_uint16_cm 0.0 65535.0 /end CHARACTERISTIC
/begin CHARACTERISTIC KINP_APSDRLR_cm_ovrdval "" VALUE 0x0000 /* @ECU_Address@KINP_APSDRLR_cm_ovrdval@ */ Scalar_UWORD 0 SWC_INP_type_CM_uint16_cm 0.0 65535.0 /end CHARACTERISTIC
/begin CHARACTERISTIC KINP_APSAngleTarget_Deg_ovrdflg "" VALUE 0x0000 /* @ECU_Address@KINP_APSAngleTarget_Deg_ovrdflg@ */ Scalar_BOOLEAN 0 SWC_INP_type_CM_boolean_flg 0.0 1.0 /end CHARACTERISTIC
/begin CHARACTERISTIC KINP_APSDFLL_cm_ovrdflg "" VALUE 0x0000 /* @ECU_Address@KINP_APSDFLL_cm_ovrdflg@ */ Scalar_BOOLEAN 0 SWC_INP_type_CM_boolean_flg 0.0 1.0 /end CHARACTERISTIC
/begin CHARACTERISTIC KINP_APSDFLR_cm_ovrdflg "" VALUE 0x0000 /* @ECU_Address@KINP_APSDFLR_cm_ovrdflg@ */ Scalar_BOOLEAN 0 SWC_INP_type_CM_boolean_flg 0.0 1.0 /end CHARACTERISTIC
/begin CHARACTERISTIC KINP_APSDRLL_cm_ovrdflg "" VALUE 0x0000 /* @ECU_Address@KINP_APSDRLL_cm_ovrdflg@ */ Scalar_BOOLEAN 0 SWC_INP_type_CM_boolean_flg 0.0 1.0 /end CHARACTERISTIC
/begin CHARACTERISTIC KINP_APSDRLR_cm_ovrdflg "" VALUE 0x0000 /* @ECU_Address@KINP_APSDRLR_cm_ovrdflg@ */ Scalar_BOOLEAN 0 SWC_INP_type_CM_boolean_flg 0.0 1.0 /end CHARACTERISTIC
/begin CHARACTERISTIC KINP_APSDecReqA_flg_ovrdflg "" VALUE 0x0000 /* @ECU_Address@KINP_APSDecReqA_flg_ovrdflg@ */ Scalar_BOOLEAN 0 SWC_INP_type_CM_boolean_flg 0.0 1.0 /end CHARACTERISTIC
/begin CHARACTERISTIC KINP_APSDecReqA_flg_ovrdval "" VALUE 0x0000 /* @ECU_Address@KINP_APSDecReqA_flg_ovrdval@ */ Scalar_BOOLEAN 0 SWC_INP_type_CM_boolean_flg 0.0 1.0 /end CHARACTERISTIC
/begin CHARACTERISTIC KINP_APSDecReq_mps2_ovrdflg "" VALUE 0x0000 /* @ECU_Address@KINP_APSDecReq_mps2_ovrdflg@ */ Scalar_BOOLEAN 0 SWC_INP_type_CM_boolean_flg 0.0 1.0 /end CHARACTERISTIC
/begin CHARACTERISTIC KINP_APSExitCondition_enum_ovrdflg "" VALUE 0x0000 /* @ECU_Address@KINP_APSExitCondition_enum_ovrdflg@ */ Scalar_BOOLEAN 0 SWC_INP_type_CM_boolean_flg 0.0 1.0 /end CHARACTERISTIC
/begin CHARACTERISTIC KINP_APSHWVer_enum_ovrdflg "" VALUE 0x0000 /* @ECU_Address@KINP_APSHWVer_enum_ovrdflg@ */ Scalar_BOOLEAN 0 SWC_INP_type_CM_boolean_flg 0.0 1.0 /end CHARACTERISTIC
/begin CHARACTERISTIC KINP_APSProgressPCT_pct_ovrdflg "" VALUE 0x0000 /* @ECU_Address@KINP_APSProgressPCT_pct_ovrdflg@ */ Scalar_BOOLEAN 0 SWC_INP_type_CM_boolean_flg 0.0 1.0 /end CHARACTERISTIC
/begin CHARACTERISTIC KINP_APSPwrReq_enum_ovrdflg "" VALUE 0x0000 /* @ECU_Address@KINP_APSPwrReq_enum_ovrdflg@ */ Scalar_BOOLEAN 0 SWC_INP_type_CM_boolean_flg 0.0 1.0 /end CHARACTERISTIC
/begin CHARACTERISTIC KINP_APSRQDisplay_enum_ovrdflg "" VALUE 0x0000 /* @ECU_Address@KINP_APSRQDisplay_enum_ovrdflg@ */ Scalar_BOOLEAN 0 SWC_INP_type_CM_boolean_flg 0.0 1.0 /end CHARACTERISTIC
/begin CHARACTERISTIC KINP_APSReq_enum_ovrdflg "" VALUE 0x0000 /* @ECU_Address@KINP_APSReq_enum_ovrdflg@ */ Scalar_BOOLEAN 0 SWC_INP_type_CM_boolean_flg 0.0 1.0 /end CHARACTERISTIC
/begin CHARACTERISTIC KINP_APSRqEPASCtrl_flg_ovrdflg "" VALUE 0x0000 /* @ECU_Address@KINP_APSRqEPASCtrl_flg_ovrdflg@ */ Scalar_BOOLEAN 0 SWC_INP_type_CM_boolean_flg 0.0 1.0 /end CHARACTERISTIC
/begin CHARACTERISTIC KINP_APSRqEPASCtrl_flg_ovrdval "" VALUE 0x0000 /* @ECU_Address@KINP_APSRqEPASCtrl_flg_ovrdval@ */ Scalar_BOOLEAN 0 SWC_INP_type_CM_boolean_flg 0.0 1.0 /end CHARACTERISTIC
/begin CHARACTERISTIC KINP_APSSWVer_enum_ovrdflg "" VALUE 0x0000 /* @ECU_Address@KINP_APSSWVer_enum_ovrdflg@ */ Scalar_BOOLEAN 0 SWC_INP_type_CM_boolean_flg 0.0 1.0 /end CHARACTERISTIC
/begin CHARACTERISTIC KINP_APSShiftPosnReq_enum_ovrflg "" VALUE 0x0000 /* @ECU_Address@KINP_APSShiftPosnReq_enum_ovrflg@ */ Scalar_BOOLEAN 0 SWC_INP_type_CM_boolean_flg 0.0 1.0 /end CHARACTERISTIC
/begin CHARACTERISTIC KINP_APSSpeedCMD_kph_ovrflg "" VALUE 0x0000 /* @ECU_Address@KINP_APSSpeedCMD_kph_ovrflg@ */ Scalar_BOOLEAN 0 SWC_INP_type_CM_boolean_flg 0.0 1.0 /end CHARACTERISTIC
/begin CHARACTERISTIC KINP_APSStaSystem_enum_ovrdflg "" VALUE 0x0000 /* @ECU_Address@KINP_APSStaSystem_enum_ovrdflg@ */ Scalar_BOOLEAN 0 SWC_INP_type_CM_boolean_flg 0.0 1.0 /end CHARACTERISTIC
/begin CHARACTERISTIC KINP_APSVMCReqA_flg_ovrdval "" VALUE 0x0000 /* @ECU_Address@KINP_APSVMCReqA_flg_ovrdval@ */ Scalar_BOOLEAN 0 SWC_INP_type_CM_boolean_flg 0.0 1.0 /end CHARACTERISTIC
/begin CHARACTERISTIC KINP_APSVMCReqA_flg_ovrflg "" VALUE 0x0000 /* @ECU_Address@KINP_APSVMCReqA_flg_ovrflg@ */ Scalar_BOOLEAN 0 SWC_INP_type_CM_boolean_flg 0.0 1.0 /end CHARACTERISTIC
/begin CHARACTERISTIC KINP_APSVRqEPASCtrl_flg_ovrdflg "" VALUE 0x0000 /* @ECU_Address@KINP_APSVRqEPASCtrl_flg_ovrdflg@ */ Scalar_BOOLEAN 0 SWC_INP_type_CM_boolean_flg 0.0 1.0 /end CHARACTERISTIC
/begin CHARACTERISTIC KINP_APSVRqEPASCtrl_flg_ovrdval "" VALUE 0x0000 /* @ECU_Address@KINP_APSVRqEPASCtrl_flg_ovrdval@ */ Scalar_BOOLEAN 0 SWC_INP_type_CM_boolean_flg 0.0 1.0 /end CHARACTERISTIC
/begin CHARACTERISTIC KINP_CAASSta_enum_ovrdflg "" VALUE 0x0000 /* @ECU_Address@KINP_CAASSta_enum_ovrdflg@ */ Scalar_BOOLEAN 0 SWC_INP_type_CM_boolean_flg 0.0 1.0 /end CHARACTERISTIC
/begin CHARACTERISTIC KINP_CAASVMCReqA_flg_ovrdval "" VALUE 0x0000 /* @ECU_Address@KINP_CAASVMCReqA_flg_ovrdval@ */ Scalar_BOOLEAN 0 SWC_INP_type_CM_boolean_flg 0.0 1.0 /end CHARACTERISTIC
/begin CHARACTERISTIC KINP_CAASVMCReqA_flg_ovrflg "" VALUE 0x0000 /* @ECU_Address@KINP_CAASVMCReqA_flg_ovrflg@ */ Scalar_BOOLEAN 0 SWC_INP_type_CM_boolean_flg 0.0 1.0 /end CHARACTERISTIC
/begin CHARACTERISTIC KINP_Chime_enum_ovrdflg "" VALUE 0x0000 /* @ECU_Address@KINP_Chime_enum_ovrdflg@ */ Scalar_BOOLEAN 0 SWC_INP_type_CM_boolean_flg 0.0 1.0 /end CHARACTERISTIC
/begin CHARACTERISTIC KINP_ModOperation_enum_ovrdflg "" VALUE 0x0000 /* @ECU_Address@KINP_ModOperation_enum_ovrdflg@ */ Scalar_BOOLEAN 0 SWC_INP_type_CM_boolean_flg 0.0 1.0 /end CHARACTERISTIC
/begin CHARACTERISTIC KINP_NewNMSpec_flg "" VALUE 0x0000 /* @ECU_Address@KINP_NewNMSpec_flg@ */ Scalar_BOOLEAN 0 SWC_INP_type_CM_boolean_flg 0.0 1.0 /end CHARACTERISTIC
/begin CHARACTERISTIC KINP_PASAFCL_enum_ovrdflg "" VALUE 0x0000 /* @ECU_Address@KINP_PASAFCL_enum_ovrdflg@ */ Scalar_BOOLEAN 0 SWC_INP_type_CM_boolean_flg 0.0 1.0 /end CHARACTERISTIC
/begin CHARACTERISTIC KINP_PASAFCR_enum_ovrdflg "" VALUE 0x0000 /* @ECU_Address@KINP_PASAFCR_enum_ovrdflg@ */ Scalar_BOOLEAN 0 SWC_INP_type_CM_boolean_flg 0.0 1.0 /end CHARACTERISTIC
/begin CHARACTERISTIC KINP_PASAFML_enum_ovrdflg "" VALUE 0x0000 /* @ECU_Address@KINP_PASAFML_enum_ovrdflg@ */ Scalar_BOOLEAN 0 SWC_INP_type_CM_boolean_flg 0.0 1.0 /end CHARACTERISTIC
/begin CHARACTERISTIC KINP_PASAFMR_enum_ovrdflg "" VALUE 0x0000 /* @ECU_Address@KINP_PASAFMR_enum_ovrdflg@ */ Scalar_BOOLEAN 0 SWC_INP_type_CM_boolean_flg 0.0 1.0 /end CHARACTERISTIC
/begin CHARACTERISTIC KINP_PASARCL_enum_ovrdflg "" VALUE 0x0000 /* @ECU_Address@KINP_PASARCL_enum_ovrdflg@ */ Scalar_BOOLEAN 0 SWC_INP_type_CM_boolean_flg 0.0 1.0 /end CHARACTERISTIC
/begin CHARACTERISTIC KINP_PASARCR_enum_ovrdflg "" VALUE 0x0000 /* @ECU_Address@KINP_PASARCR_enum_ovrdflg@ */ Scalar_BOOLEAN 0 SWC_INP_type_CM_boolean_flg 0.0 1.0 /end CHARACTERISTIC
/begin CHARACTERISTIC KINP_PASARML_enum_ovrdflg "" VALUE 0x0000 /* @ECU_Address@KINP_PASARML_enum_ovrdflg@ */ Scalar_BOOLEAN 0 SWC_INP_type_CM_boolean_flg 0.0 1.0 /end CHARACTERISTIC
/begin CHARACTERISTIC KINP_PASARMR_enum_ovrdflg "" VALUE 0x0000 /* @ECU_Address@KINP_PASARMR_enum_ovrdflg@ */ Scalar_BOOLEAN 0 SWC_INP_type_CM_boolean_flg 0.0 1.0 /end CHARACTERISTIC
/begin CHARACTERISTIC KINP_PASDFCL_cm_ovrdflg "" VALUE 0x0000 /* @ECU_Address@KINP_PASDFCL_cm_ovrdflg@ */ Scalar_BOOLEAN 0 SWC_INP_type_CM_boolean_flg 0.0 1.0 /end CHARACTERISTIC
/begin CHARACTERISTIC KINP_PASDFCR_cm_ovrdflg "" VALUE 0x0000 /* @ECU_Address@KINP_PASDFCR_cm_ovrdflg@ */ Scalar_BOOLEAN 0 SWC_INP_type_CM_boolean_flg 0.0 1.0 /end CHARACTERISTIC
/begin CHARACTERISTIC KINP_PASDFML_cm_ovrdflg "" VALUE 0x0000 /* @ECU_Address@KINP_PASDFML_cm_ovrdflg@ */ Scalar_BOOLEAN 0 SWC_INP_type_CM_boolean_flg 0.0 1.0 /end CHARACTERISTIC
/begin CHARACTERISTIC KINP_PASDFMR_cm_ovrdflg "" VALUE 0x0000 /* @ECU_Address@KINP_PASDFMR_cm_ovrdflg@ */ Scalar_BOOLEAN 0 SWC_INP_type_CM_boolean_flg 0.0 1.0 /end CHARACTERISTIC
/begin CHARACTERISTIC KINP_PASDRCL_cm_ovrdflg "" VALUE 0x0000 /* @ECU_Address@KINP_PASDRCL_cm_ovrdflg@ */ Scalar_BOOLEAN 0 SWC_INP_type_CM_boolean_flg 0.0 1.0 /end CHARACTERISTIC
/begin CHARACTERISTIC KINP_PASDRCR_cm_ovrdflg "" VALUE 0x0000 /* @ECU_Address@KINP_PASDRCR_cm_ovrdflg@ */ Scalar_BOOLEAN 0 SWC_INP_type_CM_boolean_flg 0.0 1.0 /end CHARACTERISTIC
/begin CHARACTERISTIC KINP_PASDRML_cm_ovrdflg "" VALUE 0x0000 /* @ECU_Address@KINP_PASDRML_cm_ovrdflg@ */ Scalar_BOOLEAN 0 SWC_INP_type_CM_boolean_flg 0.0 1.0 /end CHARACTERISTIC
/begin CHARACTERISTIC KINP_PASDRMR_cm_ovrdflg "" VALUE 0x0000 /* @ECU_Address@KINP_PASDRMR_cm_ovrdflg@ */ Scalar_BOOLEAN 0 SWC_INP_type_CM_boolean_flg 0.0 1.0 /end CHARACTERISTIC
/begin CHARACTERISTIC KINP_RAPSBCMLamp_enum_ovrdflg "" VALUE 0x0000 /* @ECU_Address@KINP_RAPSBCMLamp_enum_ovrdflg@ */ Scalar_BOOLEAN 0 SWC_INP_type_CM_boolean_flg 0.0 1.0 /end CHARACTERISTIC
/begin CHARACTERISTIC KINP_RAPSBCMLockReq_flg_ovrdval "" VALUE 0x0000 /* @ECU_Address@KINP_RAPSBCMLockReq_flg_ovrdval@ */ Scalar_BOOLEAN 0 SWC_INP_type_CM_boolean_flg 0.0 1.0 /end CHARACTERISTIC
/begin CHARACTERISTIC KINP_RAPSBCMLockReq_flg_ovrflg "" VALUE 0x0000 /* @ECU_Address@KINP_RAPSBCMLockReq_flg_ovrflg@ */ Scalar_BOOLEAN 0 SWC_INP_type_CM_boolean_flg 0.0 1.0 /end CHARACTERISTIC
/begin CHARACTERISTIC KINP_RAPSErrLv1_flg_ovrdval "" VALUE 0x0000 /* @ECU_Address@KINP_RAPSErrLv1_flg_ovrdval@ */ Scalar_BOOLEAN 0 SWC_INP_type_CM_boolean_flg 0.0 1.0 /end CHARACTERISTIC
/begin CHARACTERISTIC KINP_RAPSErrLv1_flg_ovrflg "" VALUE 0x0000 /* @ECU_Address@KINP_RAPSErrLv1_flg_ovrflg@ */ Scalar_BOOLEAN 0 SWC_INP_type_CM_boolean_flg 0.0 1.0 /end CHARACTERISTIC
/begin CHARACTERISTIC KINP_RAPSErrWarnSta_enum_ovrdflg "" VALUE 0x0000 /* @ECU_Address@KINP_RAPSErrWarnSta_enum_ovrdflg@ */ Scalar_BOOLEAN 0 SWC_INP_type_CM_boolean_flg 0.0 1.0 /end CHARACTERISTIC
/begin CHARACTERISTIC KINP_SNSRLayout_enum_ovrdflg "" VALUE 0x0000 /* @ECU_Address@KINP_SNSRLayout_enum_ovrdflg@ */ Scalar_BOOLEAN 0 SWC_INP_type_CM_boolean_flg 0.0 1.0 /end CHARACTERISTIC
/begin CHARACTERISTIC KINP_SOCDisUsed_flg "" VALUE 0x0000 /* @ECU_Address@KINP_SOCDisUsed_flg@ */ Scalar_BOOLEAN 0 SWC_INP_type_CM_boolean_flg 0.0 1.0 /end CHARACTERISTIC
/begin CHARACTERISTIC KINP_StaFSya_flg_ovrdflg "" VALUE 0x0000 /* @ECU_Address@KINP_StaFSya_flg_ovrdflg@ */ Scalar_BOOLEAN 0 SWC_INP_type_CM_boolean_flg 0.0 1.0 /end CHARACTERISTIC
/begin CHARACTERISTIC KINP_StaFSya_flg_ovrdval "" VALUE 0x0000 /* @ECU_Address@KINP_StaFSya_flg_ovrdval@ */ Scalar_BOOLEAN 0 SWC_INP_type_CM_boolean_flg 0.0 1.0 /end CHARACTERISTIC
/begin CHARACTERISTIC KINP_USSStaFCL_flg_ovrdflg "" VALUE 0x0000 /* @ECU_Address@KINP_USSStaFCL_flg_ovrdflg@ */ Scalar_BOOLEAN 0 SWC_INP_type_CM_boolean_flg 0.0 1.0 /end CHARACTERISTIC
/begin CHARACTERISTIC KINP_USSStaFCL_flg_ovrdval "" VALUE 0x0000 /* @ECU_Address@KINP_USSStaFCL_flg_ovrdval@ */ Scalar_BOOLEAN 0 SWC_INP_type_CM_boolean_flg 0.0 1.0 /end CHARACTERISTIC
/begin CHARACTERISTIC KINP_USSStaFCR_flg_ovrdflg "" VALUE 0x0000 /* @ECU_Address@KINP_USSStaFCR_flg_ovrdflg@ */ Scalar_BOOLEAN 0 SWC_INP_type_CM_boolean_flg 0.0 1.0 /end CHARACTERISTIC
/begin CHARACTERISTIC KINP_USSStaFCR_flg_ovrdval "" VALUE 0x0000 /* @ECU_Address@KINP_USSStaFCR_flg_ovrdval@ */ Scalar_BOOLEAN 0 SWC_INP_type_CM_boolean_flg 0.0 1.0 /end CHARACTERISTIC
/begin CHARACTERISTIC KINP_USSStaFLL_flg_ovrdflg "" VALUE 0x0000 /* @ECU_Address@KINP_USSStaFLL_flg_ovrdflg@ */ Scalar_BOOLEAN 0 SWC_INP_type_CM_boolean_flg 0.0 1.0 /end CHARACTERISTIC
/begin CHARACTERISTIC KINP_USSStaFLL_flg_ovrdval "" VALUE 0x0000 /* @ECU_Address@KINP_USSStaFLL_flg_ovrdval@ */ Scalar_BOOLEAN 0 SWC_INP_type_CM_boolean_flg 0.0 1.0 /end CHARACTERISTIC
/begin CHARACTERISTIC KINP_USSStaFLR_flg_ovrdflg "" VALUE 0x0000 /* @ECU_Address@KINP_USSStaFLR_flg_ovrdflg@ */ Scalar_BOOLEAN 0 SWC_INP_type_CM_boolean_flg 0.0 1.0 /end CHARACTERISTIC
/begin CHARACTERISTIC KINP_USSStaFLR_flg_ovrdval "" VALUE 0x0000 /* @ECU_Address@KINP_USSStaFLR_flg_ovrdval@ */ Scalar_BOOLEAN 0 SWC_INP_type_CM_boolean_flg 0.0 1.0 /end CHARACTERISTIC
/begin CHARACTERISTIC KINP_USSStaFML_flg_ovrdflg "" VALUE 0x0000 /* @ECU_Address@KINP_USSStaFML_flg_ovrdflg@ */ Scalar_BOOLEAN 0 SWC_INP_type_CM_boolean_flg 0.0 1.0 /end CHARACTERISTIC
/begin CHARACTERISTIC KINP_USSStaFML_flg_ovrdval "" VALUE 0x0000 /* @ECU_Address@KINP_USSStaFML_flg_ovrdval@ */ Scalar_BOOLEAN 0 SWC_INP_type_CM_boolean_flg 0.0 1.0 /end CHARACTERISTIC
/begin CHARACTERISTIC KINP_USSStaFMR_flg_ovrdflg "" VALUE 0x0000 /* @ECU_Address@KINP_USSStaFMR_flg_ovrdflg@ */ Scalar_BOOLEAN 0 SWC_INP_type_CM_boolean_flg 0.0 1.0 /end CHARACTERISTIC
/begin CHARACTERISTIC KINP_USSStaFMR_flg_ovrdval "" VALUE 0x0000 /* @ECU_Address@KINP_USSStaFMR_flg_ovrdval@ */ Scalar_BOOLEAN 0 SWC_INP_type_CM_boolean_flg 0.0 1.0 /end CHARACTERISTIC
/begin CHARACTERISTIC KINP_USSStaRCL_flg_ovrdflg "" VALUE 0x0000 /* @ECU_Address@KINP_USSStaRCL_flg_ovrdflg@ */ Scalar_BOOLEAN 0 SWC_INP_type_CM_boolean_flg 0.0 1.0 /end CHARACTERISTIC
/begin CHARACTERISTIC KINP_USSStaRCL_flg_ovrdval "" VALUE 0x0000 /* @ECU_Address@KINP_USSStaRCL_flg_ovrdval@ */ Scalar_BOOLEAN 0 SWC_INP_type_CM_boolean_flg 0.0 1.0 /end CHARACTERISTIC
/begin CHARACTERISTIC KINP_USSStaRCR_flg_ovrdflg "" VALUE 0x0000 /* @ECU_Address@KINP_USSStaRCR_flg_ovrdflg@ */ Scalar_BOOLEAN 0 SWC_INP_type_CM_boolean_flg 0.0 1.0 /end CHARACTERISTIC
/begin CHARACTERISTIC KINP_USSStaRCR_flg_ovrdval "" VALUE 0x0000 /* @ECU_Address@KINP_USSStaRCR_flg_ovrdval@ */ Scalar_BOOLEAN 0 SWC_INP_type_CM_boolean_flg 0.0 1.0 /end CHARACTERISTIC
/begin CHARACTERISTIC KINP_USSStaRLL_flg_ovrdflg "" VALUE 0x0000 /* @ECU_Address@KINP_USSStaRLL_flg_ovrdflg@ */ Scalar_BOOLEAN 0 SWC_INP_type_CM_boolean_flg 0.0 1.0 /end CHARACTERISTIC
/begin CHARACTERISTIC KINP_USSStaRLL_flg_ovrdval "" VALUE 0x0000 /* @ECU_Address@KINP_USSStaRLL_flg_ovrdval@ */ Scalar_BOOLEAN 0 SWC_INP_type_CM_boolean_flg 0.0 1.0 /end CHARACTERISTIC
/begin CHARACTERISTIC KINP_USSStaRLR_flg_ovrdflg "" VALUE 0x0000 /* @ECU_Address@KINP_USSStaRLR_flg_ovrdflg@ */ Scalar_BOOLEAN 0 SWC_INP_type_CM_boolean_flg 0.0 1.0 /end CHARACTERISTIC
/begin CHARACTERISTIC KINP_USSStaRLR_flg_ovrdval "" VALUE 0x0000 /* @ECU_Address@KINP_USSStaRLR_flg_ovrdval@ */ Scalar_BOOLEAN 0 SWC_INP_type_CM_boolean_flg 0.0 1.0 /end CHARACTERISTIC
/begin CHARACTERISTIC KINP_USSStaRML_flg_ovrdflg "" VALUE 0x0000 /* @ECU_Address@KINP_USSStaRML_flg_ovrdflg@ */ Scalar_BOOLEAN 0 SWC_INP_type_CM_boolean_flg 0.0 1.0 /end CHARACTERISTIC
/begin CHARACTERISTIC KINP_USSStaRML_flg_ovrdval "" VALUE 0x0000 /* @ECU_Address@KINP_USSStaRML_flg_ovrdval@ */ Scalar_BOOLEAN 0 SWC_INP_type_CM_boolean_flg 0.0 1.0 /end CHARACTERISTIC
/begin CHARACTERISTIC KINP_USSStaRMR_flg_ovrdflg "" VALUE 0x0000 /* @ECU_Address@KINP_USSStaRMR_flg_ovrdflg@ */ Scalar_BOOLEAN 0 SWC_INP_type_CM_boolean_flg 0.0 1.0 /end CHARACTERISTIC
/begin CHARACTERISTIC KINP_USSStaRMR_flg_ovrdval "" VALUE 0x0000 /* @ECU_Address@KINP_USSStaRMR_flg_ovrdval@ */ Scalar_BOOLEAN 0 SWC_INP_type_CM_boolean_flg 0.0 1.0 /end CHARACTERISTIC
/begin CHARACTERISTIC KINP_APSExitCondition_enum_ovrdval "" VALUE 0x0000 /* @ECU_Address@KINP_APSExitCondition_enum_ovrdval@ */ Scalar_UBYTE 0 SWC_INP_type_CM_uint8_enum 0.0 255.0 /end CHARACTERISTIC
/begin CHARACTERISTIC KINP_APSHWVer_enum_ovrdval "" VALUE 0x0000 /* @ECU_Address@KINP_APSHWVer_enum_ovrdval@ */ Scalar_UBYTE 0 SWC_INP_type_CM_uint8_enum 0.0 255.0 /end CHARACTERISTIC
/begin CHARACTERISTIC KINP_APSPwrReq_enum_ovrdval "" VALUE 0x0000 /* @ECU_Address@KINP_APSPwrReq_enum_ovrdval@ */ Scalar_UBYTE 0 SWC_INP_type_CM_uint8_enum 0.0 4.0 /end CHARACTERISTIC
/begin CHARACTERISTIC KINP_APSRQDisplay_enum_ovrdval "" VALUE 0x0000 /* @ECU_Address@KINP_APSRQDisplay_enum_ovrdval@ */ Scalar_UBYTE 0 SWC_INP_type_CM_uint8_enum 0.0 255.0 /end CHARACTERISTIC
/begin CHARACTERISTIC KINP_APSReq_enum_ovrdval "" VALUE 0x0000 /* @ECU_Address@KINP_APSReq_enum_ovrdval@ */ Scalar_UBYTE 0 SWC_INP_type_CM_uint8_enum 0.0 7.0 /end CHARACTERISTIC
/begin CHARACTERISTIC KINP_APSSWVer_enum_ovrdval "" VALUE 0x0000 /* @ECU_Address@KINP_APSSWVer_enum_ovrdval@ */ Scalar_UBYTE 0 SWC_INP_type_CM_uint8_enum 0.0 255.0 /end CHARACTERISTIC
/begin CHARACTERISTIC KINP_APSShiftPosnReq_enum_ovrdval "" VALUE 0x0000 /* @ECU_Address@KINP_APSShiftPosnReq_enum_ovrdval@ */ Scalar_UBYTE 0 SWC_INP_type_CM_uint8_enum 0.0 15.0 /end CHARACTERISTIC
/begin CHARACTERISTIC KINP_APSStaSystem_enum_ovrdval "" VALUE 0x0000 /* @ECU_Address@KINP_APSStaSystem_enum_ovrdval@ */ Scalar_UBYTE 0 SWC_INP_type_CM_uint8_enum 0.0 7.0 /end CHARACTERISTIC
/begin CHARACTERISTIC KINP_CAASSta_enum_ovrdval "" VALUE 0x0000 /* @ECU_Address@KINP_CAASSta_enum_ovrdval@ */ Scalar_UBYTE 0 SWC_INP_type_CM_uint8_enum 0.0 7.0 /end CHARACTERISTIC
/begin CHARACTERISTIC KINP_Chime_enum_ovrdval "" VALUE 0x0000 /* @ECU_Address@KINP_Chime_enum_ovrdval@ */ Scalar_UBYTE 0 SWC_INP_type_CM_uint8_enum 0.0 255.0 /end CHARACTERISTIC
/begin CHARACTERISTIC KINP_ModOperation_enum_ovrdval "" VALUE 0x0000 /* @ECU_Address@KINP_ModOperation_enum_ovrdval@ */ Scalar_UBYTE 0 SWC_INP_type_CM_uint8_enum 0.0 255.0 /end CHARACTERISTIC
/begin CHARACTERISTIC KINP_PASAFCL_enum_ovrdval "" VALUE 0x0000 /* @ECU_Address@KINP_PASAFCL_enum_ovrdval@ */ Scalar_UBYTE 0 SWC_INP_type_CM_uint8_enum 0.0 255.0 /end CHARACTERISTIC
/begin CHARACTERISTIC KINP_PASAFCR_enum_ovrdval "" VALUE 0x0000 /* @ECU_Address@KINP_PASAFCR_enum_ovrdval@ */ Scalar_UBYTE 0 SWC_INP_type_CM_uint8_enum 0.0 255.0 /end CHARACTERISTIC
/begin CHARACTERISTIC KINP_PASAFML_enum_ovrdval "" VALUE 0x0000 /* @ECU_Address@KINP_PASAFML_enum_ovrdval@ */ Scalar_UBYTE 0 SWC_INP_type_CM_uint8_enum 0.0 255.0 /end CHARACTERISTIC
/begin CHARACTERISTIC KINP_PASAFMR_enum_ovrdval "" VALUE 0x0000 /* @ECU_Address@KINP_PASAFMR_enum_ovrdval@ */ Scalar_UBYTE 0 SWC_INP_type_CM_uint8_enum 0.0 255.0 /end CHARACTERISTIC
/begin CHARACTERISTIC KINP_PASARCL_enum_ovrdval "" VALUE 0x0000 /* @ECU_Address@KINP_PASARCL_enum_ovrdval@ */ Scalar_UBYTE 0 SWC_INP_type_CM_uint8_enum 0.0 255.0 /end CHARACTERISTIC
/begin CHARACTERISTIC KINP_PASARCR_enum_ovrdval "" VALUE 0x0000 /* @ECU_Address@KINP_PASARCR_enum_ovrdval@ */ Scalar_UBYTE 0 SWC_INP_type_CM_uint8_enum 0.0 255.0 /end CHARACTERISTIC
/begin CHARACTERISTIC KINP_PASARML_enum_ovrdval "" VALUE 0x0000 /* @ECU_Address@KINP_PASARML_enum_ovrdval@ */ Scalar_UBYTE 0 SWC_INP_type_CM_uint8_enum 0.0 255.0 /end CHARACTERISTIC
/begin CHARACTERISTIC KINP_PASARMR_enum_ovrdval "" VALUE 0x0000 /* @ECU_Address@KINP_PASARMR_enum_ovrdval@ */ Scalar_UBYTE 0 SWC_INP_type_CM_uint8_enum 0.0 255.0 /end CHARACTERISTIC
/begin CHARACTERISTIC KINP_PASDFCL_cm_ovrdval "" VALUE 0x0000 /* @ECU_Address@KINP_PASDFCL_cm_ovrdval@ */ Scalar_UBYTE 0 SWC_INP_type_CM_uint8_cm 0.0 255.0 /end CHARACTERISTIC
/begin CHARACTERISTIC KINP_PASDFCR_cm_ovrdval "" VALUE 0x0000 /* @ECU_Address@KINP_PASDFCR_cm_ovrdval@ */ Scalar_UBYTE 0 SWC_INP_type_CM_uint8_cm 0.0 255.0 /end CHARACTERISTIC
/begin CHARACTERISTIC KINP_PASDFML_cm_ovrdval "" VALUE 0x0000 /* @ECU_Address@KINP_PASDFML_cm_ovrdval@ */ Scalar_UBYTE 0 SWC_INP_type_CM_uint8_cm 0.0 255.0 /end CHARACTERISTIC
/begin CHARACTERISTIC KINP_PASDFMR_cm_ovrdval "" VALUE 0x0000 /* @ECU_Address@KINP_PASDFMR_cm_ovrdval@ */ Scalar_UBYTE 0 SWC_INP_type_CM_uint8_cm 0.0 255.0 /end CHARACTERISTIC
/begin CHARACTERISTIC KINP_PASDRCL_cm_ovrdval "" VALUE 0x0000 /* @ECU_Address@KINP_PASDRCL_cm_ovrdval@ */ Scalar_UBYTE 0 SWC_INP_type_CM_uint8_cm 0.0 255.0 /end CHARACTERISTIC
/begin CHARACTERISTIC KINP_PASDRCR_cm_ovrdval "" VALUE 0x0000 /* @ECU_Address@KINP_PASDRCR_cm_ovrdval@ */ Scalar_UBYTE 0 SWC_INP_type_CM_uint8_cm 0.0 255.0 /end CHARACTERISTIC
/begin CHARACTERISTIC KINP_PASDRML_cm_ovrdval "" VALUE 0x0000 /* @ECU_Address@KINP_PASDRML_cm_ovrdval@ */ Scalar_UBYTE 0 SWC_INP_type_CM_uint8_cm 0.0 255.0 /end CHARACTERISTIC
/begin CHARACTERISTIC KINP_PASDRMR_cm_ovrdval "" VALUE 0x0000 /* @ECU_Address@KINP_PASDRMR_cm_ovrdval@ */ Scalar_UBYTE 0 SWC_INP_type_CM_uint8_cm 0.0 255.0 /end CHARACTERISTIC
/begin CHARACTERISTIC KINP_RAPSBCMLamp_enum_ovrdval "" VALUE 0x0000 /* @ECU_Address@KINP_RAPSBCMLamp_enum_ovrdval@ */ Scalar_UBYTE 0 SWC_INP_type_CM_uint8_enum 0.0 3.0 /end CHARACTERISTIC
/begin CHARACTERISTIC KINP_RAPSErrWarnSta_enum_ovrdval "" VALUE 0x0000 /* @ECU_Address@KINP_RAPSErrWarnSta_enum_ovrdval@ */ Scalar_UBYTE 0 SWC_INP_type_CM_uint8_enum 0.0 7.0 /end CHARACTERISTIC
/begin CHARACTERISTIC KINP_SNSRLayout_enum_ovrdval "" VALUE 0x0000 /* @ECU_Address@KINP_SNSRLayout_enum_ovrdval@ */ Scalar_UBYTE 0 SWC_INP_type_CM_uint8_enum 0.0 255.0 /end CHARACTERISTIC
/begin CHARACTERISTIC KINP_SWCType_enum "" VALUE 0x0000 /* @ECU_Address@KINP_SWCType_enum@ */ Scalar_UBYTE 0 SWC_INP_type_CM_uint8_enum 0.0 255.0 /end CHARACTERISTIC
/begin CHARACTERISTIC KINP_VehicleType_enum "" VALUE 0x0000 /* @ECU_Address@KINP_VehicleType_enum@ */ Scalar_UBYTE 0 SWC_INP_type_CM_uint8_enum 0.0 255.0 /end CHARACTERISTIC
/begin MEASUREMENT VINP_FlashRESSTIMESOCPSARNGR_s "" ULONG SWC_INP_type_CM_uint32 0 0 0 4294967295 ARRAY_SIZE 8 ECU_ADDRESS 0x0000 /* @ECU_Address@VINP_FlashRESSTIMESOCPSARNGR_s@ */ /end MEASUREMENT
/begin MEASUREMENT VINP_FlashRESSTIMESOCPSARNGL_s "" ULONG SWC_INP_type_CM_uint32 0 0 0 4294967295 ARRAY_SIZE 8 ECU_ADDRESS 0x0000 /* @ECU_Address@VINP_FlashRESSTIMESOCPSARNGL_s@ */ /end MEASUREMENT
/begin MEASUREMENT VINP_FlashRESSTIMESOCCHGRNGR_s "" ULONG SWC_INP_type_CM_uint32 0 0 0 4294967295 ARRAY_SIZE 8 ECU_ADDRESS 0x0000 /* @ECU_Address@VINP_FlashRESSTIMESOCCHGRNGR_s@ */ /end MEASUREMENT
/begin MEASUREMENT VINP_FlashRESSTIMESOCCHGRNGL_s "" ULONG SWC_INP_type_CM_uint32 0 0 0 4294967295 ARRAY_SIZE 8 ECU_ADDRESS 0x0000 /* @ECU_Address@VINP_FlashRESSTIMESOCCHGRNGL_s@ */ /end MEASUREMENT
/begin MEASUREMENT VINP_FlashRESSTIMESOCOFFRNGR_s "" ULONG SWC_INP_type_CM_uint32 0 0 0 4294967295 ARRAY_SIZE 8 ECU_ADDRESS 0x0000 /* @ECU_Address@VINP_FlashRESSTIMESOCOFFRNGR_s@ */ /end MEASUREMENT
/begin MEASUREMENT VINP_FlashRESSTIMESOCOFFRNGL_s "" ULONG SWC_INP_type_CM_uint32 0 0 0 4294967295 ARRAY_SIZE 8 ECU_ADDRESS 0x0000 /* @ECU_Address@VINP_FlashRESSTIMESOCOFFRNGL_s@ */ /end MEASUREMENT
/begin MEASUREMENT VINP_WisrBootReason_raw32 "" ULONG SWC_INP_type_CM_uint32_raw32 0 0 0.0 4.294967295E+9 ECU_ADDRESS 0x0000 /* @ECU_Address@VINP_WisrBootReason_raw32@ */ /end MEASUREMENT
/begin MEASUREMENT VINP_FlashPSAR_sec "" ULONG SWC_INP_type_CM_uint32_sec 0 0 0.0 4.294967295E+9 ECU_ADDRESS 0x0000 /* @ECU_Address@VINP_FlashPSAR_sec@ */ /end MEASUREMENT
/begin MEASUREMENT VINP_FlashPSAL_sec "" ULONG SWC_INP_type_CM_uint32_sec 0 0 0.0 4.294967295E+9 ECU_ADDRESS 0x0000 /* @ECU_Address@VINP_FlashPSAL_sec@ */ /end MEASUREMENT
/begin MEASUREMENT VINP_FlashIPSAR_sec "" ULONG SWC_INP_type_CM_uint32_sec 0 0 0.0 4.294967295E+9 ECU_ADDRESS 0x0000 /* @ECU_Address@VINP_FlashIPSAR_sec@ */ /end MEASUREMENT
/begin MEASUREMENT VINP_FlashIPSAL_sec "" ULONG SWC_INP_type_CM_uint32_sec 0 0 0.0 4.294967295E+9 ECU_ADDRESS 0x0000 /* @ECU_Address@VINP_FlashIPSAL_sec@ */ /end MEASUREMENT
/begin MEASUREMENT VINP_FlashCPSAR_sec "" ULONG SWC_INP_type_CM_uint32_sec 0 0 0.0 4.294967295E+9 ECU_ADDRESS 0x0000 /* @ECU_Address@VINP_FlashCPSAR_sec@ */ /end MEASUREMENT
/begin MEASUREMENT VINP_FlashCPSAL_sec "" ULONG SWC_INP_type_CM_uint32_sec 0 0 0.0 4.294967295E+9 ECU_ADDRESS 0x0000 /* @ECU_Address@VINP_FlashCPSAL_sec@ */ /end MEASUREMENT
/begin MEASUREMENT VINP_FlashPKERNumerator_kphsqr "" ULONG SWC_INP_type_CM_uint32_kphsqr 0 0 0.0 4.294967295E+9 ECU_ADDRESS 0x0000 /* @ECU_Address@VINP_FlashPKERNumerator_kphsqr@ */ /end MEASUREMENT
/begin MEASUREMENT VINP_FlashPKELNumerator_kphsqr "" ULONG SWC_INP_type_CM_uint32_kphsqr 0 0 0.0 4.294967295E+9 ECU_ADDRESS 0x0000 /* @ECU_Address@VINP_FlashPKELNumerator_kphsqr@ */ /end MEASUREMENT
/begin MEASUREMENT VINP_FlashQTYPSATRIPSR_cnt "" ULONG SWC_INP_type_CM_uint32_cnt 0 0 0.0 4.294967295E+9 ECU_ADDRESS 0x0000 /* @ECU_Address@VINP_FlashQTYPSATRIPSR_cnt@ */ /end MEASUREMENT
/begin MEASUREMENT VINP_FlashQTYPSATRIPSL_cnt "" ULONG SWC_INP_type_CM_uint32_cnt 0 0 0.0 4.294967295E+9 ECU_ADDRESS 0x0000 /* @ECU_Address@VINP_FlashQTYPSATRIPSL_cnt@ */ /end MEASUREMENT
/begin MEASUREMENT VINP_FlashAVGBATTEMPL_sec "" ULONG SWC_INP_type_CM_uint32_sec 0 0 0.0 4.294967295E+9 ECU_ADDRESS 0x0000 /* @ECU_Address@VINP_FlashAVGBATTEMPL_sec@ */ /end MEASUREMENT
/begin MEASUREMENT VINP_FlashBattTempPSAR_sec "" ULONG SWC_INP_type_CM_uint32_sec 0 0 0.0 4.294967295E+9 ECU_ADDRESS 0x0000 /* @ECU_Address@VINP_FlashBattTempPSAR_sec@ */ /end MEASUREMENT
/begin MEASUREMENT VINP_FlashBattTempPSAL_sec "" ULONG SWC_INP_type_CM_uint32_sec 0 0 0.0 4.294967295E+9 ECU_ADDRESS 0x0000 /* @ECU_Address@VINP_FlashBattTempPSAL_sec@ */ /end MEASUREMENT
/begin MEASUREMENT VINP_FlashOVCR_sec "" ULONG SWC_INP_type_CM_uint32_sec 0 0 0.0 4.294967295E+9 ECU_ADDRESS 0x0000 /* @ECU_Address@VINP_FlashOVCR_sec@ */ /end MEASUREMENT
/begin MEASUREMENT VINP_FlashOVCL_sec "" ULONG SWC_INP_type_CM_uint32_sec 0 0 0.0 4.294967295E+9 ECU_ADDRESS 0x0000 /* @ECU_Address@VINP_FlashOVCL_sec@ */ /end MEASUREMENT
/begin MEASUREMENT VINP_FlashOFFR_sec "" ULONG SWC_INP_type_CM_uint32_sec 0 0 0.0 4.294967295E+9 ECU_ADDRESS 0x0000 /* @ECU_Address@VINP_FlashOFFR_sec@ */ /end MEASUREMENT
/begin MEASUREMENT VINP_FlashOFFL_sec "" ULONG SWC_INP_type_CM_uint32_sec 0 0 0.0 4.294967295E+9 ECU_ADDRESS 0x0000 /* @ECU_Address@VINP_FlashOFFL_sec@ */ /end MEASUREMENT
/begin MEASUREMENT VINP_PmicBootPath_raw32 "" ULONG SWC_INP_type_CM_uint32_raw32 0 0 0.0 4.294967295E+9 ECU_ADDRESS 0x0000 /* @ECU_Address@VINP_PmicBootPath_raw32@ */ /end MEASUREMENT
/begin MEASUREMENT VINP_TimeSNDKCFbk_cnt "" ULONG SWC_INP_type_CM_uint32_cnt 0 0 0.0 4.294967295E+9 ECU_ADDRESS 0x0000 /* @ECU_Address@VINP_TimeSNDKCFbk_cnt@ */ /end MEASUREMENT
/begin MEASUREMENT VINP_ChkLFID_raw "" ULONG SWC_INP_type_CM_uint32_raw 0 0 0.0 4.294967295E+9 ECU_ADDRESS 0x0000 /* @ECU_Address@VINP_ChkLFID_raw@ */ /end MEASUREMENT
/begin MEASUREMENT VINP_ChkRFID_raw "" ULONG SWC_INP_type_CM_uint32_raw 0 0 0.0 4.294967295E+9 ECU_ADDRESS 0x0000 /* @ECU_Address@VINP_ChkRFID_raw@ */ /end MEASUREMENT
/begin MEASUREMENT VINP_ChkLRID_raw "" ULONG SWC_INP_type_CM_uint32_raw 0 0 0.0 4.294967295E+9 ECU_ADDRESS 0x0000 /* @ECU_Address@VINP_ChkLRID_raw@ */ /end MEASUREMENT
/begin MEASUREMENT VINP_ChkRRID_raw "" ULONG SWC_INP_type_CM_uint32_raw 0 0 0.0 4.294967295E+9 ECU_ADDRESS 0x0000 /* @ECU_Address@VINP_ChkRRID_raw@ */ /end MEASUREMENT
/begin MEASUREMENT VINP_S1ID_raw "" ULONG SWC_INP_type_CM_uint32_raw 0 0 0.0 4.294967295E+9 ECU_ADDRESS 0x0000 /* @ECU_Address@VINP_S1ID_raw@ */ /end MEASUREMENT
/begin MEASUREMENT VINP_S2ID_raw "" ULONG SWC_INP_type_CM_uint32_raw 0 0 0.0 4.294967295E+9 ECU_ADDRESS 0x0000 /* @ECU_Address@VINP_S2ID_raw@ */ /end MEASUREMENT
/begin MEASUREMENT VINP_S3ID_raw "" ULONG SWC_INP_type_CM_uint32_raw 0 0 0.0 4.294967295E+9 ECU_ADDRESS 0x0000 /* @ECU_Address@VINP_S3ID_raw@ */ /end MEASUREMENT
/begin MEASUREMENT VINP_S4ID_raw "" ULONG SWC_INP_type_CM_uint32_raw 0 0 0.0 4.294967295E+9 ECU_ADDRESS 0x0000 /* @ECU_Address@VINP_S4ID_raw@ */ /end MEASUREMENT
/begin MEASUREMENT VINP_EAPS1MINMem_pct "" FLOAT32_IEEE SWC_INP_type_CM_single_pct 0 0 0.0 120.0 ECU_ADDRESS 0x0000 /* @ECU_Address@VINP_EAPS1MINMem_pct@ */ /end MEASUREMENT
/begin MEASUREMENT VINP_EAPS2MINMem_pct "" FLOAT32_IEEE SWC_INP_type_CM_single_pct 0 0 0.0 120.0 ECU_ADDRESS 0x0000 /* @ECU_Address@VINP_EAPS2MINMem_pct@ */ /end MEASUREMENT
/begin MEASUREMENT VINP_DiagFMHT_s "" FLOAT32_IEEE SWC_INP_type_CM_single_s 0 0 10.0 150.0 ECU_ADDRESS 0x0000 /* @ECU_Address@VINP_DiagFMHT_s@ */ /end MEASUREMENT
/begin MEASUREMENT VINP_DiagFLTC_mA "" FLOAT32_IEEE SWC_INP_type_CM_single_mA 0 0 0.0 2550.0 ECU_ADDRESS 0x0000 /* @ECU_Address@VINP_DiagFLTC_mA@ */ /end MEASUREMENT
/begin MEASUREMENT VINP_DiagFRTC_mA "" FLOAT32_IEEE SWC_INP_type_CM_single_mA 0 0 0.0 2550.0 ECU_ADDRESS 0x0000 /* @ECU_Address@VINP_DiagFRTC_mA@ */ /end MEASUREMENT
/begin MEASUREMENT VINP_DiagRLTC_mA "" FLOAT32_IEEE SWC_INP_type_CM_single_mA 0 0 0.0 2550.0 ECU_ADDRESS 0x0000 /* @ECU_Address@VINP_DiagRLTC_mA@ */ /end MEASUREMENT
/begin MEASUREMENT VINP_DiagRRTC_mA "" FLOAT32_IEEE SWC_INP_type_CM_single_mA 0 0 0.0 2550.0 ECU_ADDRESS 0x0000 /* @ECU_Address@VINP_DiagRRTC_mA@ */ /end MEASUREMENT
/begin MEASUREMENT VINP_FlashMILDIST_km "" FLOAT32_IEEE SWC_INP_type_CM_single_km 0 0 0.0 65535.0 ECU_ADDRESS 0x0000 /* @ECU_Address@VINP_FlashMILDIST_km@ */ /end MEASUREMENT
/begin MEASUREMENT VINP_FlashCLRDIST_km "" FLOAT32_IEEE SWC_INP_type_CM_single_km 0 0 0.0 65535.0 ECU_ADDRESS 0x0000 /* @ECU_Address@VINP_FlashCLRDIST_km@ */ /end MEASUREMENT
/begin MEASUREMENT VINP_FlashODOMETER_km "" FLOAT32_IEEE SWC_INP_type_CM_single_km 0 0 0.0 4.294967295E+8 ECU_ADDRESS 0x0000 /* @ECU_Address@VINP_FlashODOMETER_km@ */ /end MEASUREMENT
/begin MEASUREMENT VINP_FlashHVBNAH_Ahr "" FLOAT32_IEEE SWC_INP_type_CM_single_Ahr 0 0 -2.147483648E+6 2.147483647E+6 ECU_ADDRESS 0x0000 /* @ECU_Address@VINP_FlashHVBNAH_Ahr@ */ /end MEASUREMENT
/begin MEASUREMENT VINP_FlashHVBNE_kWh "" FLOAT32_IEEE SWC_INP_type_CM_single_kWh 0 0 -2.147483648E+6 2.147483647E+6 ECU_ADDRESS 0x0000 /* @ECU_Address@VINP_FlashHVBNE_kWh@ */ /end MEASUREMENT
/begin MEASUREMENT VINP_FlashTNBCPSAR_Ahr "" FLOAT32_IEEE SWC_INP_type_CM_single_Ahr 0 0 0.0 4.294967295E+6 ECU_ADDRESS 0x0000 /* @ECU_Address@VINP_FlashTNBCPSAR_Ahr@ */ /end MEASUREMENT
/begin MEASUREMENT VINP_FlashTNBCPSAL_Ahr "" FLOAT32_IEEE SWC_INP_type_CM_single_Ahr 0 0 0.0 4.294967295E+8 ECU_ADDRESS 0x0000 /* @ECU_Address@VINP_FlashTNBCPSAL_Ahr@ */ /end MEASUREMENT
/begin MEASUREMENT VINP_FlashTNECPSAR_kWh "" FLOAT32_IEEE SWC_INP_type_CM_single_kWh 0 0 0.0 4.294967295E+8 ECU_ADDRESS 0x0000 /* @ECU_Address@VINP_FlashTNECPSAR_kWh@ */ /end MEASUREMENT
/begin MEASUREMENT VINP_FlashTNECPSAL_kWh "" FLOAT32_IEEE SWC_INP_type_CM_single_kWh 0 0 0.0 4.294967295E+8 ECU_ADDRESS 0x0000 /* @ECU_Address@VINP_FlashTNECPSAL_kWh@ */ /end MEASUREMENT
/begin MEASUREMENT VINP_FlashTEBPSAR_kWh "" FLOAT32_IEEE SWC_INP_type_CM_single_kWh 0 0 0.0 4.294967295E+8 ECU_ADDRESS 0x0000 /* @ECU_Address@VINP_FlashTEBPSAR_kWh@ */ /end MEASUREMENT
/begin MEASUREMENT VINP_FlashTEBPSAL_kWh "" FLOAT32_IEEE SWC_INP_type_CM_single_kWh 0 0 0.0 4.294967295E+8 ECU_ADDRESS 0x0000 /* @ECU_Address@VINP_FlashTEBPSAL_kWh@ */ /end MEASUREMENT
/begin MEASUREMENT VINP_FlashTGEOVCR_kWh "" FLOAT32_IEEE SWC_INP_type_CM_single_kWh 0 0 0.0 4.294967295E+8 ECU_ADDRESS 0x0000 /* @ECU_Address@VINP_FlashTGEOVCR_kWh@ */ /end MEASUREMENT
/begin MEASUREMENT VINP_FlashTGEOVCL_kWh "" FLOAT32_IEEE SWC_INP_type_CM_single_kWh 0 0 0.0 4.294967295E+8 ECU_ADDRESS 0x0000 /* @ECU_Address@VINP_FlashTGEOVCL_kWh@ */ /end MEASUREMENT
/begin MEASUREMENT VINP_FlashGECHGOVCDCR_kWh "" FLOAT32_IEEE SWC_INP_type_CM_single_kWh 0 0 0.0 4.294967295E+8 ECU_ADDRESS 0x0000 /* @ECU_Address@VINP_FlashGECHGOVCDCR_kWh@ */ /end MEASUREMENT
/begin MEASUREMENT VINP_FlashGECHGOVCDCL_kWh "" FLOAT32_IEEE SWC_INP_type_CM_single_kWh 0 0 0.0 4.294967295E+8 ECU_ADDRESS 0x0000 /* @ECU_Address@VINP_FlashGECHGOVCDCL_kWh@ */ /end MEASUREMENT
/begin MEASUREMENT VINP_FlashGECHGOVCACR_kWh "" FLOAT32_IEEE SWC_INP_type_CM_single_kWh 0 0 0.0 4.294967295E+8 ECU_ADDRESS 0x0000 /* @ECU_Address@VINP_FlashGECHGOVCACR_kWh@ */ /end MEASUREMENT
/begin MEASUREMENT VINP_FlashGECHGOVCACL_kWh "" FLOAT32_IEEE SWC_INP_type_CM_single_kWh 0 0 0.0 4.294967295E+8 ECU_ADDRESS 0x0000 /* @ECU_Address@VINP_FlashGECHGOVCACL_kWh@ */ /end MEASUREMENT
/begin MEASUREMENT VINP_FlashRESSV2XENNONPSAR_kWh "" FLOAT32_IEEE SWC_INP_type_CM_single_kWh 0 0 0.0 4.294967295E+8 ECU_ADDRESS 0x0000 /* @ECU_Address@VINP_FlashRESSV2XENNONPSAR_kWh@ */ /end MEASUREMENT
/begin MEASUREMENT VINP_FlashRESSV2XENNONPSAL_kWh "" FLOAT32_IEEE SWC_INP_type_CM_single_kWh 0 0 0.0 4.294967295E+8 ECU_ADDRESS 0x0000 /* @ECU_Address@VINP_FlashRESSV2XENNONPSAL_kWh@ */ /end MEASUREMENT
/begin MEASUREMENT VINP_FlashResetCDEODTR_km "" FLOAT32_IEEE SWC_INP_type_CM_single_km 0 0 0.0 4.294967295E+8 ECU_ADDRESS 0x0000 /* @ECU_Address@VINP_FlashResetCDEODTR_km@ */ /end MEASUREMENT
/begin MEASUREMENT VINP_FlashAvgBattTempPSAR_C "" FLOAT32_IEEE SWC_INP_type_CM_single_C 0 0 -40.0 215.0 ECU_ADDRESS 0x0000 /* @ECU_Address@VINP_FlashAvgBattTempPSAR_C@ */ /end MEASUREMENT
/begin MEASUREMENT VINP_FlashAvgBattTempPSAL_C "" FLOAT32_IEEE SWC_INP_type_CM_single_C 0 0 -40.0 215.0 ECU_ADDRESS 0x0000 /* @ECU_Address@VINP_FlashAvgBattTempPSAL_C@ */ /end MEASUREMENT
/begin MEASUREMENT VINP_FlashAvgBattTempOVCR_C "" FLOAT32_IEEE SWC_INP_type_CM_single_C 0 0 -40.0 215.0 ECU_ADDRESS 0x0000 /* @ECU_Address@VINP_FlashAvgBattTempOVCR_C@ */ /end MEASUREMENT
/begin MEASUREMENT VINP_FlashAvgBattTempOVCL_C "" FLOAT32_IEEE SWC_INP_type_CM_single_C 0 0 -40.0 215.0 ECU_ADDRESS 0x0000 /* @ECU_Address@VINP_FlashAvgBattTempOVCL_C@ */ /end MEASUREMENT
/begin MEASUREMENT VINP_FlashAvgBattTempOFFR_C "" FLOAT32_IEEE SWC_INP_type_CM_single_C 0 0 -40.0 215.0 ECU_ADDRESS 0x0000 /* @ECU_Address@VINP_FlashAvgBattTempOFFR_C@ */ /end MEASUREMENT
/begin MEASUREMENT VINP_FlashAvgBattTempOFFL_C "" FLOAT32_IEEE SWC_INP_type_CM_single_C 0 0 -40.0 215.0 ECU_ADDRESS 0x0000 /* @ECU_Address@VINP_FlashAvgBattTempOFFL_C@ */ /end MEASUREMENT
/begin MEASUREMENT VINP_FlashETMATOER_kWh "" FLOAT32_IEEE SWC_INP_type_CM_single_kWh 0 0 0.0 4.294967295E+9 ECU_ADDRESS 0x0000 /* @ECU_Address@VINP_FlashETMATOER_kWh@ */ /end MEASUREMENT
/begin MEASUREMENT VINP_FlashETMATOEL_kWh "" FLOAT32_IEEE SWC_INP_type_CM_single_kWh 0 0 0.0 4.294967295E+9 ECU_ADDRESS 0x0000 /* @ECU_Address@VINP_FlashETMATOEL_kWh@ */ /end MEASUREMENT
/begin MEASUREMENT VINP_FlashETMBTOER_kWh "" FLOAT32_IEEE SWC_INP_type_CM_single_kWh 0 0 0.0 4.294967295E+9 ECU_ADDRESS 0x0000 /* @ECU_Address@VINP_FlashETMBTOER_kWh@ */ /end MEASUREMENT
/begin MEASUREMENT VINP_FlashETMBTOEL_kWh "" FLOAT32_IEEE SWC_INP_type_CM_single_kWh 0 0 0.0 4.294967295E+9 ECU_ADDRESS 0x0000 /* @ECU_Address@VINP_FlashETMBTOEL_kWh@ */ /end MEASUREMENT
/begin MEASUREMENT VINP_FlashMAXBATTEMPL_C "" FLOAT32_IEEE SWC_INP_type_CM_single_C 0 0 -40.0 215.0 ECU_ADDRESS 0x0000 /* @ECU_Address@VINP_FlashMAXBATTEMPL_C@ */ /end MEASUREMENT
/begin MEASUREMENT VINP_FlashMINBATTEMPL_C "" FLOAT32_IEEE SWC_INP_type_CM_single_C 0 0 -40.0 215.0 ECU_ADDRESS 0x0000 /* @ECU_Address@VINP_FlashMINBATTEMPL_C@ */ /end MEASUREMENT
/begin MEASUREMENT VINP_FlashAVGBATTEMPL_C "" FLOAT32_IEEE SWC_INP_type_CM_single_C 0 0 -40.0 215.0 ECU_ADDRESS 0x0000 /* @ECU_Address@VINP_FlashAVGBATTEMPL_C@ */ /end MEASUREMENT
/begin MEASUREMENT VINP_AccelPedal1Vol_V "" FLOAT32_IEEE SWC_INP_type_CM_single_V 0 0 0.0 10.0 ECU_ADDRESS 0x0000 /* @ECU_Address@VINP_AccelPedal1Vol_V@ */ /end MEASUREMENT
/begin MEASUREMENT VINP_AccelPedal2Vol_V "" FLOAT32_IEEE SWC_INP_type_CM_single_V 0 0 0.0 10.0 ECU_ADDRESS 0x0000 /* @ECU_Address@VINP_AccelPedal2Vol_V@ */ /end MEASUREMENT
/begin MEASUREMENT VINP_APSProgressPCT_pct "" FLOAT32_IEEE SWC_INP_type_CM_single_pct 0 0 0.0 100.0 ECU_ADDRESS 0x0000 /* @ECU_Address@VINP_APSProgressPCT_pct@ */ /end MEASUREMENT
/begin MEASUREMENT VINP_APSAngleTarget_Deg "" FLOAT32_IEEE SWC_INP_type_CM_single_Deg 0 0 -900.0 900.0 ECU_ADDRESS 0x0000 /* @ECU_Address@VINP_APSAngleTarget_Deg@ */ /end MEASUREMENT
/begin MEASUREMENT VINP_APSDecReq_mps2 "" FLOAT32_IEEE SWC_INP_type_CM_single_mps2 0 0 0.0 25.4 ECU_ADDRESS 0x0000 /* @ECU_Address@VINP_APSDecReq_mps2@ */ /end MEASUREMENT
/begin MEASUREMENT VINP_APSSpeedCMD_kph "" FLOAT32_IEEE SWC_INP_type_CM_single_kph 0 0 0.0 20.0 ECU_ADDRESS 0x0000 /* @ECU_Address@VINP_APSSpeedCMD_kph@ */ /end MEASUREMENT
/begin MEASUREMENT VINP_FlashRESSCNTDODRNGR_cnt "" UWORD SWC_INP_type_CM_uint16 0 0 0 65535 ARRAY_SIZE 8 ECU_ADDRESS 0x0000 /* @ECU_Address@VINP_FlashRESSCNTDODRNGR_cnt@ */ /end MEASUREMENT
/begin MEASUREMENT VINP_FlashRESSCNTDODRNGL_cnt "" UWORD SWC_INP_type_CM_uint16 0 0 0 65535 ARRAY_SIZE 8 ECU_ADDRESS 0x0000 /* @ECU_Address@VINP_FlashRESSCNTDODRNGL_cnt@ */ /end MEASUREMENT
/begin MEASUREMENT VINP_FlashPTGUserHeight1_cnt "" UWORD SWC_INP_type_CM_uint16_cnt 0 0 0.0 65535.0 ECU_ADDRESS 0x0000 /* @ECU_Address@VINP_FlashPTGUserHeight1_cnt@ */ /end MEASUREMENT
/begin MEASUREMENT VINP_FlashPTGUserHeight2_cnt "" UWORD SWC_INP_type_CM_uint16_cnt 0 0 0.0 65535.0 ECU_ADDRESS 0x0000 /* @ECU_Address@VINP_FlashPTGUserHeight2_cnt@ */ /end MEASUREMENT
/begin MEASUREMENT VINP_FlashPTGUserHeight3_cnt "" UWORD SWC_INP_type_CM_uint16_cnt 0 0 0.0 65535.0 ECU_ADDRESS 0x0000 /* @ECU_Address@VINP_FlashPTGUserHeight3_cnt@ */ /end MEASUREMENT
/begin MEASUREMENT VINP_FlashPTGUserHeight4_cnt "" UWORD SWC_INP_type_CM_uint16_cnt 0 0 0.0 65535.0 ECU_ADDRESS 0x0000 /* @ECU_Address@VINP_FlashPTGUserHeight4_cnt@ */ /end MEASUREMENT
/begin MEASUREMENT VINP_FlashPTGUserHeight5_cnt "" UWORD SWC_INP_type_CM_uint16_cnt 0 0 0.0 65535.0 ECU_ADDRESS 0x0000 /* @ECU_Address@VINP_FlashPTGUserHeight5_cnt@ */ /end MEASUREMENT
/begin MEASUREMENT VINP_FlashPTGUserHeight7_cnt "" UWORD SWC_INP_type_CM_uint16_cnt 0 0 0.0 65535.0 ECU_ADDRESS 0x0000 /* @ECU_Address@VINP_FlashPTGUserHeight7_cnt@ */ /end MEASUREMENT
/begin MEASUREMENT VINP_FlashMILTIME_min "" UWORD SWC_INP_type_CM_uint16_min 0 0 0.0 65535.0 ECU_ADDRESS 0x0000 /* @ECU_Address@VINP_FlashMILTIME_min@ */ /end MEASUREMENT
/begin MEASUREMENT VINP_FlashCLRTIME_min "" UWORD SWC_INP_type_CM_uint16_min 0 0 0.0 65535.0 ECU_ADDRESS 0x0000 /* @ECU_Address@VINP_FlashCLRTIME_min@ */ /end MEASUREMENT
/begin MEASUREMENT VINP_FlashNUMPSATRIPSFLTMEMCLR_cnt "" UWORD SWC_INP_type_CM_uint16_cnt 0 0 0.0 65535.0 ECU_ADDRESS 0x0000 /* @ECU_Address@VINP_FlashNUMPSATRIPSFLTMEMCLR_cnt@ */ /end MEASUREMENT
/begin MEASUREMENT VINP_FlashIGNCNTR_cnt "" UWORD SWC_INP_type_CM_uint16_cnt 0 0 0.0 65535.0 ECU_ADDRESS 0x0000 /* @ECU_Address@VINP_FlashIGNCNTR_cnt@ */ /end MEASUREMENT
/begin MEASUREMENT VINP_APSDRLR_cm "" UWORD SWC_INP_type_CM_uint16_cm 0 0 0.0 65535.0 ECU_ADDRESS 0x0000 /* @ECU_Address@VINP_APSDRLR_cm@ */ /end MEASUREMENT
/begin MEASUREMENT VINP_APSDRLL_cm "" UWORD SWC_INP_type_CM_uint16_cm 0 0 0.0 65535.0 ECU_ADDRESS 0x0000 /* @ECU_Address@VINP_APSDRLL_cm@ */ /end MEASUREMENT
/begin MEASUREMENT VINP_APSDFLR_cm "" UWORD SWC_INP_type_CM_uint16_cm 0 0 0.0 65535.0 ECU_ADDRESS 0x0000 /* @ECU_Address@VINP_APSDFLR_cm@ */ /end MEASUREMENT
/begin MEASUREMENT VINP_APSDFLL_cm "" UWORD SWC_INP_type_CM_uint16_cm 0 0 0.0 65535.0 ECU_ADDRESS 0x0000 /* @ECU_Address@VINP_APSDFLL_cm@ */ /end MEASUREMENT
/begin MEASUREMENT VINP_VinCode_cnt "" UBYTE SWC_INP_type_CM_uint8 0 0 0 255 ARRAY_SIZE 17 ECU_ADDRESS 0x0000 /* @ECU_Address@VINP_VinCode_cnt@ */ /end MEASUREMENT
/begin MEASUREMENT VINP_USSConfig_raw8 "" UBYTE SWC_INP_type_CM_uint8 0 0 0 255 ARRAY_SIZE 16 ECU_ADDRESS 0x0000 /* @ECU_Address@VINP_USSConfig_raw8@ */ /end MEASUREMENT
/begin MEASUREMENT VINP_TireSize_raw8 "" UBYTE SWC_INP_type_CM_uint8 0 0 0 255 ARRAY_SIZE 16 ECU_ADDRESS 0x0000 /* @ECU_Address@VINP_TireSize_raw8@ */ /end MEASUREMENT
/begin MEASUREMENT VINP_APSFunConfig_raw8 "" UBYTE SWC_INP_type_CM_uint8 0 0 0 255 ARRAY_SIZE 16 ECU_ADDRESS 0x0000 /* @ECU_Address@VINP_APSFunConfig_raw8@ */ /end MEASUREMENT
/begin MEASUREMENT VINP_DrivetrainSelect_enum "" UBYTE SWC_INP_type_CM_uint8_enum 0 0 0.0 255.0 ECU_ADDRESS 0x0000 /* @ECU_Address@VINP_DrivetrainSelect_enum@ */ /end MEASUREMENT
/begin MEASUREMENT VINP_FlashAntitheft_enum "" UBYTE SWC_INP_type_CM_uint8_enum 0 0 0.0 255.0 ECU_ADDRESS 0x0000 /* @ECU_Address@VINP_FlashAntitheft_enum@ */ /end MEASUREMENT
/begin MEASUREMENT VINP_RandomnumberY_raw1 "" UBYTE SWC_INP_type_CM_uint8_raw1 0 0 0.0 255.0 ECU_ADDRESS 0x0000 /* @ECU_Address@VINP_RandomnumberY_raw1@ */ /end MEASUREMENT
/begin MEASUREMENT VINP_RandomnumberY_raw2 "" UBYTE SWC_INP_type_CM_uint8_raw2 0 0 0.0 255.0 ECU_ADDRESS 0x0000 /* @ECU_Address@VINP_RandomnumberY_raw2@ */ /end MEASUREMENT
/begin MEASUREMENT VINP_RandomnumberY_raw3 "" UBYTE SWC_INP_type_CM_uint8_raw3 0 0 0.0 255.0 ECU_ADDRESS 0x0000 /* @ECU_Address@VINP_RandomnumberY_raw3@ */ /end MEASUREMENT
/begin MEASUREMENT VINP_RandomnumberY_raw4 "" UBYTE SWC_INP_type_CM_uint8_raw4 0 0 0.0 255.0 ECU_ADDRESS 0x0000 /* @ECU_Address@VINP_RandomnumberY_raw4@ */ /end MEASUREMENT
/begin MEASUREMENT VINP_RandomnumberY_raw5 "" UBYTE SWC_INP_type_CM_uint8_raw5 0 0 0.0 255.0 ECU_ADDRESS 0x0000 /* @ECU_Address@VINP_RandomnumberY_raw5@ */ /end MEASUREMENT
/begin MEASUREMENT VINP_RandomnumberY_raw6 "" UBYTE SWC_INP_type_CM_uint8_raw6 0 0 0.0 255.0 ECU_ADDRESS 0x0000 /* @ECU_Address@VINP_RandomnumberY_raw6@ */ /end MEASUREMENT
/begin MEASUREMENT VINP_RandomnumberY_raw7 "" UBYTE SWC_INP_type_CM_uint8_raw7 0 0 0.0 255.0 ECU_ADDRESS 0x0000 /* @ECU_Address@VINP_RandomnumberY_raw7@ */ /end MEASUREMENT
/begin MEASUREMENT VINP_RandomnumberY_raw8 "" UBYTE SWC_INP_type_CM_uint8_raw8 0 0 0.0 255.0 ECU_ADDRESS 0x0000 /* @ECU_Address@VINP_RandomnumberY_raw8@ */ /end MEASUREMENT
/begin MEASUREMENT VINP_FlashACModeMem_enum "" UBYTE SWC_INP_type_CM_uint8_enum 0 0 0.0 255.0 ECU_ADDRESS 0x0000 /* @ECU_Address@VINP_FlashACModeMem_enum@ */ /end MEASUREMENT
/begin MEASUREMENT VINP_FlashFace_enum "" UBYTE SWC_INP_type_CM_uint8_enum 0 0 0.0 255.0 ECU_ADDRESS 0x0000 /* @ECU_Address@VINP_FlashFace_enum@ */ /end MEASUREMENT
/begin MEASUREMENT VINP_FlashFoot_enum "" UBYTE SWC_INP_type_CM_uint8_enum 0 0 0.0 255.0 ECU_ADDRESS 0x0000 /* @ECU_Address@VINP_FlashFoot_enum@ */ /end MEASUREMENT
/begin MEASUREMENT VINP_FlashFrost_enum "" UBYTE SWC_INP_type_CM_uint8_enum 0 0 0.0 255.0 ECU_ADDRESS 0x0000 /* @ECU_Address@VINP_FlashFrost_enum@ */ /end MEASUREMENT
/begin MEASUREMENT VINP_FlashFaceM_enum "" UBYTE SWC_INP_type_CM_uint8_enum 0 0 0.0 255.0 ECU_ADDRESS 0x0000 /* @ECU_Address@VINP_FlashFaceM_enum@ */ /end MEASUREMENT
/begin MEASUREMENT VINP_FlashFootM_enum "" UBYTE SWC_INP_type_CM_uint8_enum 0 0 0.0 255.0 ECU_ADDRESS 0x0000 /* @ECU_Address@VINP_FlashFootM_enum@ */ /end MEASUREMENT
/begin MEASUREMENT VINP_FlashCCUSyncSts_enum "" UBYTE SWC_INP_type_CM_uint8_enum 0 0 0.0 255.0 ECU_ADDRESS 0x0000 /* @ECU_Address@VINP_FlashCCUSyncSts_enum@ */ /end MEASUREMENT
/begin MEASUREMENT VINP_FlashsigRecircSt_enum "" UBYTE SWC_INP_type_CM_uint8_enum 0 0 0.0 255.0 ECU_ADDRESS 0x0000 /* @ECU_Address@VINP_FlashsigRecircSt_enum@ */ /end MEASUREMENT
/begin MEASUREMENT VINP_FlashRecAutoFlg_enum "" UBYTE SWC_INP_type_CM_uint8_enum 0 0 0.0 255.0 ECU_ADDRESS 0x0000 /* @ECU_Address@VINP_FlashRecAutoFlg_enum@ */ /end MEASUREMENT
/begin MEASUREMENT VINP_FlashAirIntenZone1M_enum "" UBYTE SWC_INP_type_CM_uint8_enum 0 0 0.0 255.0 ECU_ADDRESS 0x0000 /* @ECU_Address@VINP_FlashAirIntenZone1M_enum@ */ /end MEASUREMENT
/begin MEASUREMENT VINP_Flashfdefog_enum "" UBYTE SWC_INP_type_CM_uint8_enum 0 0 0.0 255.0 ECU_ADDRESS 0x0000 /* @ECU_Address@VINP_Flashfdefog_enum@ */ /end MEASUREMENT
/begin MEASUREMENT VINP_FlashsigSetTempZon1St_C "" UBYTE SWC_INP_type_CM_uint8_C 0 0 0.0 255.0 ECU_ADDRESS 0x0000 /* @ECU_Address@VINP_FlashsigSetTempZon1St_C@ */ /end MEASUREMENT
/begin MEASUREMENT VINP_FlashsigSetTempZon2StM_C "" UBYTE SWC_INP_type_CM_uint8_C 0 0 0.0 255.0 ECU_ADDRESS 0x0000 /* @ECU_Address@VINP_FlashsigSetTempZon2StM_C@ */ /end MEASUREMENT
/begin MEASUREMENT VINP_FlashCountAlarm_enum "" UBYTE SWC_INP_type_CM_uint8_enum 0 0 0.0 255.0 ECU_ADDRESS 0x0000 /* @ECU_Address@VINP_FlashCountAlarm_enum@ */ /end MEASUREMENT
/begin MEASUREMENT VINP_FlashLockSetting_enum "" UBYTE SWC_INP_type_CM_uint8_enum 0 0 0.0 255.0 ECU_ADDRESS 0x0000 /* @ECU_Address@VINP_FlashLockSetting_enum@ */ /end MEASUREMENT
/begin MEASUREMENT VINP_FlashMFRDNBrightReq_pct "" UBYTE SWC_INP_type_CM_uint8_pct 0 0 0.0 255.0 ECU_ADDRESS 0x0000 /* @ECU_Address@VINP_FlashMFRDNBrightReq_pct@ */ /end MEASUREMENT
/begin MEASUREMENT VINP_FlashRoomLampMode_enum "" UBYTE SWC_INP_type_CM_uint8_enum 0 0 0.0 255.0 ECU_ADDRESS 0x0000 /* @ECU_Address@VINP_FlashRoomLampMode_enum@ */ /end MEASUREMENT
/begin MEASUREMENT VINP_FlashIVIPTGUSStaSW_enum "" UBYTE SWC_INP_type_CM_uint8_enum 0 0 0.0 255.0 ECU_ADDRESS 0x0000 /* @ECU_Address@VINP_FlashIVIPTGUSStaSW_enum@ */ /end MEASUREMENT
/begin MEASUREMENT VINP_CurrentNmState_enum "" UBYTE SWC_INP_type_CM_uint8_enum 0 0 0.0 255.0 ECU_ADDRESS 0x0000 /* @ECU_Address@VINP_CurrentNmState_enum@ */ /end MEASUREMENT
/begin MEASUREMENT VINP_PmicBootReason_enum "" UBYTE SWC_INP_type_CM_uint8_enum 0 0 0.0 255.0 ECU_ADDRESS 0x0000 /* @ECU_Address@VINP_PmicBootReason_enum@ */ /end MEASUREMENT
/begin MEASUREMENT VINP_FlashRegenMode_enum "" UBYTE SWC_INP_type_CM_uint8_enum 0 0 0.0 255.0 ECU_ADDRESS 0x0000 /* @ECU_Address@VINP_FlashRegenMode_enum@ */ /end MEASUREMENT
/begin MEASUREMENT VINP_FlashAmbFunEN_enum "" UBYTE SWC_INP_type_CM_uint8_enum 0 0 0.0 255.0 ECU_ADDRESS 0x0000 /* @ECU_Address@VINP_FlashAmbFunEN_enum@ */ /end MEASUREMENT
/begin MEASUREMENT VINP_FlashAmbWelEN_enum "" UBYTE SWC_INP_type_CM_uint8_enum 0 0 0.0 255.0 ECU_ADDRESS 0x0000 /* @ECU_Address@VINP_FlashAmbWelEN_enum@ */ /end MEASUREMENT
/begin MEASUREMENT VINP_FlashAmbDimEN_enum "" UBYTE SWC_INP_type_CM_uint8_enum 0 0 0.0 255.0 ECU_ADDRESS 0x0000 /* @ECU_Address@VINP_FlashAmbDimEN_enum@ */ /end MEASUREMENT
/begin MEASUREMENT VINP_FlashAmbLinkDriSta_enum "" UBYTE SWC_INP_type_CM_uint8_enum 0 0 0.0 255.0 ECU_ADDRESS 0x0000 /* @ECU_Address@VINP_FlashAmbLinkDriSta_enum@ */ /end MEASUREMENT
/begin MEASUREMENT VINP_FlashAmbPwrWarnEN_enum "" UBYTE SWC_INP_type_CM_uint8_enum 0 0 0.0 255.0 ECU_ADDRESS 0x0000 /* @ECU_Address@VINP_FlashAmbPwrWarnEN_enum@ */ /end MEASUREMENT
/begin MEASUREMENT VINP_FlashAmbODAEN_enum "" UBYTE SWC_INP_type_CM_uint8_enum 0 0 0.0 255.0 ECU_ADDRESS 0x0000 /* @ECU_Address@VINP_FlashAmbODAEN_enum@ */ /end MEASUREMENT
/begin MEASUREMENT VINP_FlashAmbColorSta1_enum "" UBYTE SWC_INP_type_CM_uint8_enum 0 0 0.0 255.0 ECU_ADDRESS 0x0000 /* @ECU_Address@VINP_FlashAmbColorSta1_enum@ */ /end MEASUREMENT
/begin MEASUREMENT VINP_FlashAmbColorSta2_enum "" UBYTE SWC_INP_type_CM_uint8_enum 0 0 0.0 255.0 ECU_ADDRESS 0x0000 /* @ECU_Address@VINP_FlashAmbColorSta2_enum@ */ /end MEASUREMENT
/begin MEASUREMENT VINP_FlashAmbColorSta3_enum "" UBYTE SWC_INP_type_CM_uint8_enum 0 0 0.0 255.0 ECU_ADDRESS 0x0000 /* @ECU_Address@VINP_FlashAmbColorSta3_enum@ */ /end MEASUREMENT
/begin MEASUREMENT VINP_FlashAmbColorSta4_enum "" UBYTE SWC_INP_type_CM_uint8_enum 0 0 0.0 255.0 ECU_ADDRESS 0x0000 /* @ECU_Address@VINP_FlashAmbColorSta4_enum@ */ /end MEASUREMENT
/begin MEASUREMENT VINP_FlashAmbColorSta5_enum "" UBYTE SWC_INP_type_CM_uint8_enum 0 0 0.0 255.0 ECU_ADDRESS 0x0000 /* @ECU_Address@VINP_FlashAmbColorSta5_enum@ */ /end MEASUREMENT
/begin MEASUREMENT VINP_FlashAmbColorSta7_enum "" UBYTE SWC_INP_type_CM_uint8_enum 0 0 0.0 255.0 ECU_ADDRESS 0x0000 /* @ECU_Address@VINP_FlashAmbColorSta7_enum@ */ /end MEASUREMENT
/begin MEASUREMENT VINP_FlashAmbBrightnessSta1_enum "" UBYTE SWC_INP_type_CM_uint8_enum 0 0 0.0 255.0 ECU_ADDRESS 0x0000 /* @ECU_Address@VINP_FlashAmbBrightnessSta1_enum@ */ /end MEASUREMENT
/begin MEASUREMENT VINP_FlashAmbBrightnessSta2_enum "" UBYTE SWC_INP_type_CM_uint8_enum 0 0 0.0 255.0 ECU_ADDRESS 0x0000 /* @ECU_Address@VINP_FlashAmbBrightnessSta2_enum@ */ /end MEASUREMENT
/begin MEASUREMENT VINP_FlashAmbBrightnessSta3_enum "" UBYTE SWC_INP_type_CM_uint8_enum 0 0 0.0 255.0 ECU_ADDRESS 0x0000 /* @ECU_Address@VINP_FlashAmbBrightnessSta3_enum@ */ /end MEASUREMENT
/begin MEASUREMENT VINP_FlashAmbBrightnessSta4_enum "" UBYTE SWC_INP_type_CM_uint8_enum 0 0 0.0 255.0 ECU_ADDRESS 0x0000 /* @ECU_Address@VINP_FlashAmbBrightnessSta4_enum@ */ /end MEASUREMENT
/begin MEASUREMENT VINP_FlashAmbBrightnessSta5_enum "" UBYTE SWC_INP_type_CM_uint8_enum 0 0 0.0 255.0 ECU_ADDRESS 0x0000 /* @ECU_Address@VINP_FlashAmbBrightnessSta5_enum@ */ /end MEASUREMENT
/begin MEASUREMENT VINP_FlashAmbBrightnessSta7_enum "" UBYTE SWC_INP_type_CM_uint8_enum 0 0 0.0 255.0 ECU_ADDRESS 0x0000 /* @ECU_Address@VINP_FlashAmbBrightnessSta7_enum@ */ /end MEASUREMENT
/begin MEASUREMENT VINP_FlashTurnSwTSet123_enum "" UBYTE SWC_INP_type_CM_uint8_enum 0 0 0.0 255.0 ECU_ADDRESS 0x0000 /* @ECU_Address@VINP_FlashTurnSwTSet123_enum@ */ /end MEASUREMENT
/begin MEASUREMENT VINP_FlashTurnSwTSet457_enum "" UBYTE SWC_INP_type_CM_uint8_enum 0 0 0.0 255.0 ECU_ADDRESS 0x0000 /* @ECU_Address@VINP_FlashTurnSwTSet457_enum@ */ /end MEASUREMENT
/begin MEASUREMENT VINP_FlashAirIntZ3Sta_enum "" UBYTE SWC_INP_type_CM_uint8_enum 0 0 0.0 255.0 ECU_ADDRESS 0x0000 /* @ECU_Address@VINP_FlashAirIntZ3Sta_enum@ */ /end MEASUREMENT
/begin MEASUREMENT VINP_FlashPsEVentModeSta_enum "" UBYTE SWC_INP_type_CM_uint8_enum 0 0 0.0 255.0 ECU_ADDRESS 0x0000 /* @ECU_Address@VINP_FlashPsEVentModeSta_enum@ */ /end MEASUREMENT
/begin MEASUREMENT VINP_FlashDrEVentModeSta_enum "" UBYTE SWC_INP_type_CM_uint8_enum 0 0 0.0 255.0 ECU_ADDRESS 0x0000 /* @ECU_Address@VINP_FlashDrEVentModeSta_enum@ */ /end MEASUREMENT
/begin MEASUREMENT VINP_FlashDrEVentZSta_enum "" UBYTE SWC_INP_type_CM_uint8_enum 0 0 0.0 255.0 ECU_ADDRESS 0x0000 /* @ECU_Address@VINP_FlashDrEVentZSta_enum@ */ /end MEASUREMENT
/begin MEASUREMENT VINP_FlashCLEVentZSta_enum "" UBYTE SWC_INP_type_CM_uint8_enum 0 0 0.0 255.0 ECU_ADDRESS 0x0000 /* @ECU_Address@VINP_FlashCLEVentZSta_enum@ */ /end MEASUREMENT
/begin MEASUREMENT VINP_FlashPsEVentZSta_enum "" UBYTE SWC_INP_type_CM_uint8_enum 0 0 0.0 255.0 ECU_ADDRESS 0x0000 /* @ECU_Address@VINP_FlashPsEVentZSta_enum@ */ /end MEASUREMENT
/begin MEASUREMENT VINP_FlashCREVentZSta_enum "" UBYTE SWC_INP_type_CM_uint8_enum 0 0 0.0 255.0 ECU_ADDRESS 0x0000 /* @ECU_Address@VINP_FlashCREVentZSta_enum@ */ /end MEASUREMENT
/begin MEASUREMENT VINP_FlashDrVentEN_enum "" UBYTE SWC_INP_type_CM_uint8_enum 0 0 0.0 255.0 ECU_ADDRESS 0x0000 /* @ECU_Address@VINP_FlashDrVentEN_enum@ */ /end MEASUREMENT
/begin MEASUREMENT VINP_FlashDrEVentYSta_enum "" UBYTE SWC_INP_type_CM_uint8_enum 0 0 0.0 255.0 ECU_ADDRESS 0x0000 /* @ECU_Address@VINP_FlashDrEVentYSta_enum@ */ /end MEASUREMENT
/begin MEASUREMENT VINP_FlashCLVentEN_enum "" UBYTE SWC_INP_type_CM_uint8_enum 0 0 0.0 255.0 ECU_ADDRESS 0x0000 /* @ECU_Address@VINP_FlashCLVentEN_enum@ */ /end MEASUREMENT
/begin MEASUREMENT VINP_FlashCLEVentYSta_enum "" UBYTE SWC_INP_type_CM_uint8_enum 0 0 0.0 255.0 ECU_ADDRESS 0x0000 /* @ECU_Address@VINP_FlashCLEVentYSta_enum@ */ /end MEASUREMENT
/begin MEASUREMENT VINP_FlashPsVentEN_enum "" UBYTE SWC_INP_type_CM_uint8_enum 0 0 0.0 255.0 ECU_ADDRESS 0x0000 /* @ECU_Address@VINP_FlashPsVentEN_enum@ */ /end MEASUREMENT
/begin MEASUREMENT VINP_FlashPsEVentYSta_enum "" UBYTE SWC_INP_type_CM_uint8_enum 0 0 0.0 255.0 ECU_ADDRESS 0x0000 /* @ECU_Address@VINP_FlashPsEVentYSta_enum@ */ /end MEASUREMENT
/begin MEASUREMENT VINP_FlashCRVentEN_enum "" UBYTE SWC_INP_type_CM_uint8_enum 0 0 0.0 255.0 ECU_ADDRESS 0x0000 /* @ECU_Address@VINP_FlashCRVentEN_enum@ */ /end MEASUREMENT
/begin MEASUREMENT VINP_FlashCREVentYSta_enum "" UBYTE SWC_INP_type_CM_uint8_enum 0 0 0.0 255.0 ECU_ADDRESS 0x0000 /* @ECU_Address@VINP_FlashCREVentYSta_enum@ */ /end MEASUREMENT
/begin MEASUREMENT VINP_FlashFGSAirIntSta_enum "" UBYTE SWC_INP_type_CM_uint8_enum 0 0 0.0 255.0 ECU_ADDRESS 0x0000 /* @ECU_Address@VINP_FlashFGSAirIntSta_enum@ */ /end MEASUREMENT
/begin MEASUREMENT VINP_FlashFGSChSta_enum "" UBYTE SWC_INP_type_CM_uint8_enum 0 0 0.0 255.0 ECU_ADDRESS 0x0000 /* @ECU_Address@VINP_FlashFGSChSta_enum@ */ /end MEASUREMENT
/begin MEASUREMENT VINP_FlashFGSIONSWSta_enum "" UBYTE SWC_INP_type_CM_uint8_enum 0 0 0.0 255.0 ECU_ADDRESS 0x0000 /* @ECU_Address@VINP_FlashFGSIONSWSta_enum@ */ /end MEASUREMENT
/begin MEASUREMENT VINP_FlashWalkOutLkEN_enum "" UBYTE SWC_INP_type_CM_uint8_enum 0 0 0.0 255.0 ECU_ADDRESS 0x0000 /* @ECU_Address@VINP_FlashWalkOutLkEN_enum@ */ /end MEASUREMENT
/begin MEASUREMENT VINP_FlashWalkInUnLkEN_enum "" UBYTE SWC_INP_type_CM_uint8_enum 0 0 0.0 255.0 ECU_ADDRESS 0x0000 /* @ECU_Address@VINP_FlashWalkInUnLkEN_enum@ */ /end MEASUREMENT
/begin MEASUREMENT VINP_FlashFollowMeENFun_enum "" UBYTE SWC_INP_type_CM_uint8_enum 0 0 0.0 255.0 ECU_ADDRESS 0x0000 /* @ECU_Address@VINP_FlashFollowMeENFun_enum@ */ /end MEASUREMENT
/begin MEASUREMENT VINP_ResetPedalZeroPosReq_enum "" UBYTE SWC_INP_type_CM_uint8_enum 0 0 0.0 255.0 ECU_ADDRESS 0x0000 /* @ECU_Address@VINP_ResetPedalZeroPosReq_enum@ */ /end MEASUREMENT
/begin MEASUREMENT VINP_FlashPTGOpenHeight12_enum "" UBYTE SWC_INP_type_CM_uint8_enum 0 0 0.0 255.0 ECU_ADDRESS 0x0000 /* @ECU_Address@VINP_FlashPTGOpenHeight12_enum@ */ /end MEASUREMENT
/begin MEASUREMENT VINP_FlashPTGOpenHeight34_enum "" UBYTE SWC_INP_type_CM_uint8_enum 0 0 0.0 255.0 ECU_ADDRESS 0x0000 /* @ECU_Address@VINP_FlashPTGOpenHeight34_enum@ */ /end MEASUREMENT
/begin MEASUREMENT VINP_FlashPTGOpenHeight57_enum "" UBYTE SWC_INP_type_CM_uint8_enum 0 0 0.0 255.0 ECU_ADDRESS 0x0000 /* @ECU_Address@VINP_FlashPTGOpenHeight57_enum@ */ /end MEASUREMENT
/begin MEASUREMENT VINP_FlashACCLevelSta12_enum "" UBYTE SWC_INP_type_CM_uint8_enum 0 0 0.0 255.0 ECU_ADDRESS 0x0000 /* @ECU_Address@VINP_FlashACCLevelSta12_enum@ */ /end MEASUREMENT
/begin MEASUREMENT VINP_FlashACCLevelSta34_enum "" UBYTE SWC_INP_type_CM_uint8_enum 0 0 0.0 255.0 ECU_ADDRESS 0x0000 /* @ECU_Address@VINP_FlashACCLevelSta34_enum@ */ /end MEASUREMENT
/begin MEASUREMENT VINP_FlashACCLevelSta57_enum "" UBYTE SWC_INP_type_CM_uint8_enum 0 0 0.0 255.0 ECU_ADDRESS 0x0000 /* @ECU_Address@VINP_FlashACCLevelSta57_enum@ */ /end MEASUREMENT
/begin MEASUREMENT VINP_WipRLSCmdHoldTime_s "" UBYTE SWC_INP_type_CM_uint8_s 0 0 0.0 127.0 ECU_ADDRESS 0x0000 /* @ECU_Address@VINP_WipRLSCmdHoldTime_s@ */ /end MEASUREMENT
/begin MEASUREMENT VINP_WipRLSCmdCutTime_s "" UBYTE SWC_INP_type_CM_uint8_s 0 0 0.0 127.0 ECU_ADDRESS 0x0000 /* @ECU_Address@VINP_WipRLSCmdCutTime_s@ */ /end MEASUREMENT
/begin MEASUREMENT VINP_FlashAutoLock_enum "" UBYTE SWC_INP_type_CM_uint8_enum 0 0 0.0 255.0 ECU_ADDRESS 0x0000 /* @ECU_Address@VINP_FlashAutoLock_enum@ */ /end MEASUREMENT
/begin MEASUREMENT VINP_FlashAutoUnlock_enum "" UBYTE SWC_INP_type_CM_uint8_enum 0 0 0.0 255.0 ECU_ADDRESS 0x0000 /* @ECU_Address@VINP_FlashAutoUnlock_enum@ */ /end MEASUREMENT
/begin MEASUREMENT VINP_VehicleType_enum "" UBYTE SWC_INP_type_CM_uint8_enum 0 0 0.0 255.0 ECU_ADDRESS 0x0000 /* @ECU_Address@VINP_VehicleType_enum@ */ /end MEASUREMENT
/begin MEASUREMENT VINP_SWCType_enum "" UBYTE SWC_INP_type_CM_uint8_enum 0 0 0.0 255.0 ECU_ADDRESS 0x0000 /* @ECU_Address@VINP_SWCType_enum@ */ /end MEASUREMENT
/begin MEASUREMENT VINP_ECUGen1_cnt "" UBYTE SWC_INP_type_CM_uint8_cnt 0 0 0.0 255.0 ECU_ADDRESS 0x0000 /* @ECU_Address@VINP_ECUGen1_cnt@ */ /end MEASUREMENT
/begin MEASUREMENT VINP_ECUGen2_cnt "" UBYTE SWC_INP_type_CM_uint8_cnt 0 0 0.0 255.0 ECU_ADDRESS 0x0000 /* @ECU_Address@VINP_ECUGen2_cnt@ */ /end MEASUREMENT
/begin MEASUREMENT VINP_FlashWARMUPS_cnt "" UBYTE SWC_INP_type_CM_uint8_cnt 0 0 0.0 255.0 ECU_ADDRESS 0x0000 /* @ECU_Address@VINP_FlashWARMUPS_cnt@ */ /end MEASUREMENT
/begin MEASUREMENT VINP_FlashHMIKey1Func_enum "" UBYTE SWC_INP_type_CM_uint8_enum 0 0 0.0 255.0 ECU_ADDRESS 0x0000 /* @ECU_Address@VINP_FlashHMIKey1Func_enum@ */ /end MEASUREMENT
/begin MEASUREMENT VINP_FlashHMIKey2Func_enum "" UBYTE SWC_INP_type_CM_uint8_enum 0 0 0.0 255.0 ECU_ADDRESS 0x0000 /* @ECU_Address@VINP_FlashHMIKey2Func_enum@ */ /end MEASUREMENT
/begin MEASUREMENT VINP_FlashHMIKey3Func_enum "" UBYTE SWC_INP_type_CM_uint8_enum 0 0 0.0 255.0 ECU_ADDRESS 0x0000 /* @ECU_Address@VINP_FlashHMIKey3Func_enum@ */ /end MEASUREMENT
/begin MEASUREMENT VINP_FlashHMIKey4Func_enum "" UBYTE SWC_INP_type_CM_uint8_enum 0 0 0.0 255.0 ECU_ADDRESS 0x0000 /* @ECU_Address@VINP_FlashHMIKey4Func_enum@ */ /end MEASUREMENT
/begin MEASUREMENT VINP_FlashHMIKey5Func_enum "" UBYTE SWC_INP_type_CM_uint8_enum 0 0 0.0 255.0 ECU_ADDRESS 0x0000 /* @ECU_Address@VINP_FlashHMIKey5Func_enum@ */ /end MEASUREMENT
/begin MEASUREMENT VINP_FlashHMIKey6Func_enum "" UBYTE SWC_INP_type_CM_uint8_enum 0 0 0.0 255.0 ECU_ADDRESS 0x0000 /* @ECU_Address@VINP_FlashHMIKey6Func_enum@ */ /end MEASUREMENT
/begin MEASUREMENT VINP_FlashHMIKey7Func_enum "" UBYTE SWC_INP_type_CM_uint8_enum 0 0 0.0 255.0 ECU_ADDRESS 0x0000 /* @ECU_Address@VINP_FlashHMIKey7Func_enum@ */ /end MEASUREMENT
/begin MEASUREMENT VINP_FlashHMIKey8Func_enum "" UBYTE SWC_INP_type_CM_uint8_enum 0 0 0.0 255.0 ECU_ADDRESS 0x0000 /* @ECU_Address@VINP_FlashHMIKey8Func_enum@ */ /end MEASUREMENT
/begin MEASUREMENT VINP_FlashTPMModelVersion_raw "" UBYTE SWC_INP_type_CM_uint8_raw 0 0 0.0 255.0 ECU_ADDRESS 0x0000 /* @ECU_Address@VINP_FlashTPMModelVersion_raw@ */ /end MEASUREMENT
/begin MEASUREMENT VINP_FlashTPMModelVersionChkSum_raw "" UBYTE SWC_INP_type_CM_uint8_raw 0 0 0.0 255.0 ECU_ADDRESS 0x0000 /* @ECU_Address@VINP_FlashTPMModelVersionChkSum_raw@ */ /end MEASUREMENT
/begin MEASUREMENT VINP_FlashDIDModelVersion_raw "" UBYTE SWC_INP_type_CM_uint8_raw 0 0 0.0 255.0 ECU_ADDRESS 0x0000 /* @ECU_Address@VINP_FlashDIDModelVersion_raw@ */ /end MEASUREMENT
/begin MEASUREMENT VINP_FlashDIDModelVersionChkSum_raw "" UBYTE SWC_INP_type_CM_uint8_raw 0 0 0.0 255.0 ECU_ADDRESS 0x0000 /* @ECU_Address@VINP_FlashDIDModelVersionChkSum_raw@ */ /end MEASUREMENT
/begin MEASUREMENT VINP_FlashAirIntenZone1MSet2_enum "" UBYTE SWC_INP_type_CM_uint8_enum 0 0 0.0 255.0 ECU_ADDRESS 0x0000 /* @ECU_Address@VINP_FlashAirIntenZone1MSet2_enum@ */ /end MEASUREMENT
/begin MEASUREMENT VINP_FlashAirIntenZone1MSet3_enum "" UBYTE SWC_INP_type_CM_uint8_enum 0 0 0.0 255.0 ECU_ADDRESS 0x0000 /* @ECU_Address@VINP_FlashAirIntenZone1MSet3_enum@ */ /end MEASUREMENT
/begin MEASUREMENT VINP_FlashAirIntenZone1MSet4_enum "" UBYTE SWC_INP_type_CM_uint8_enum 0 0 0.0 255.0 ECU_ADDRESS 0x0000 /* @ECU_Address@VINP_FlashAirIntenZone1MSet4_enum@ */ /end MEASUREMENT
/begin MEASUREMENT VINP_FlashAirIntenZone1MSet5_enum "" UBYTE SWC_INP_type_CM_uint8_enum 0 0 0.0 255.0 ECU_ADDRESS 0x0000 /* @ECU_Address@VINP_FlashAirIntenZone1MSet5_enum@ */ /end MEASUREMENT
/begin MEASUREMENT VINP_FlashAirIntenZone1MSet7_enum "" UBYTE SWC_INP_type_CM_uint8_enum 0 0 0.0 255.0 ECU_ADDRESS 0x0000 /* @ECU_Address@VINP_FlashAirIntenZone1MSet7_enum@ */ /end MEASUREMENT
/begin MEASUREMENT VINP_FlashAirIntenZone3MSet2_enum "" UBYTE SWC_INP_type_CM_uint8_enum 0 0 0.0 255.0 ECU_ADDRESS 0x0000 /* @ECU_Address@VINP_FlashAirIntenZone3MSet2_enum@ */ /end MEASUREMENT
/begin MEASUREMENT VINP_FlashAirIntenZone3MSet3_enum "" UBYTE SWC_INP_type_CM_uint8_enum 0 0 0.0 255.0 ECU_ADDRESS 0x0000 /* @ECU_Address@VINP_FlashAirIntenZone3MSet3_enum@ */ /end MEASUREMENT
/begin MEASUREMENT VINP_FlashAirIntenZone3MSet4_enum "" UBYTE SWC_INP_type_CM_uint8_enum 0 0 0.0 255.0 ECU_ADDRESS 0x0000 /* @ECU_Address@VINP_FlashAirIntenZone3MSet4_enum@ */ /end MEASUREMENT
/begin MEASUREMENT VINP_FlashAirIntenZone3MSet5_enum "" UBYTE SWC_INP_type_CM_uint8_enum 0 0 0.0 255.0 ECU_ADDRESS 0x0000 /* @ECU_Address@VINP_FlashAirIntenZone3MSet5_enum@ */ /end MEASUREMENT
/begin MEASUREMENT VINP_FlashAirIntenZone3MSet7_enum "" UBYTE SWC_INP_type_CM_uint8_enum 0 0 0.0 255.0 ECU_ADDRESS 0x0000 /* @ECU_Address@VINP_FlashAirIntenZone3MSet7_enum@ */ /end MEASUREMENT
/begin MEASUREMENT VINP_FlashFGSChStaSet457_enum "" UBYTE SWC_INP_type_CM_uint8_enum 0 0 0.0 255.0 ECU_ADDRESS 0x0000 /* @ECU_Address@VINP_FlashFGSChStaSet457_enum@ */ /end MEASUREMENT
/begin MEASUREMENT VINP_FlashFGSAirIntStaSet457_enum "" UBYTE SWC_INP_type_CM_uint8_enum 0 0 0.0 255.0 ECU_ADDRESS 0x0000 /* @ECU_Address@VINP_FlashFGSAirIntStaSet457_enum@ */ /end MEASUREMENT
/begin MEASUREMENT VINP_FlashDrEVentModeStaSet457_enum "" UBYTE SWC_INP_type_CM_uint8_enum 0 0 0.0 255.0 ECU_ADDRESS 0x0000 /* @ECU_Address@VINP_FlashDrEVentModeStaSet457_enum@ */ /end MEASUREMENT
/begin MEASUREMENT VINP_FlashPsEVentModeStaSet457_enum "" UBYTE SWC_INP_type_CM_uint8_enum 0 0 0.0 255.0 ECU_ADDRESS 0x0000 /* @ECU_Address@VINP_FlashPsEVentModeStaSet457_enum@ */ /end MEASUREMENT
/begin MEASUREMENT VINP_FlashDrEVentZStaSet2_enum "" UBYTE SWC_INP_type_CM_uint8_enum 0 0 0.0 255.0 ECU_ADDRESS 0x0000 /* @ECU_Address@VINP_FlashDrEVentZStaSet2_enum@ */ /end MEASUREMENT
/begin MEASUREMENT VINP_FlashDrEVentZStaSet3_enum "" UBYTE SWC_INP_type_CM_uint8_enum 0 0 0.0 255.0 ECU_ADDRESS 0x0000 /* @ECU_Address@VINP_FlashDrEVentZStaSet3_enum@ */ /end MEASUREMENT
/begin MEASUREMENT VINP_FlashDrEVentZStaSet4_enum "" UBYTE SWC_INP_type_CM_uint8_enum 0 0 0.0 255.0 ECU_ADDRESS 0x0000 /* @ECU_Address@VINP_FlashDrEVentZStaSet4_enum@ */ /end MEASUREMENT
/begin MEASUREMENT VINP_FlashDrEVentZStaSet5_enum "" UBYTE SWC_INP_type_CM_uint8_enum 0 0 0.0 255.0 ECU_ADDRESS 0x0000 /* @ECU_Address@VINP_FlashDrEVentZStaSet5_enum@ */ /end MEASUREMENT
/begin MEASUREMENT VINP_FlashDrEVentZStaSet7_enum "" UBYTE SWC_INP_type_CM_uint8_enum 0 0 0.0 255.0 ECU_ADDRESS 0x0000 /* @ECU_Address@VINP_FlashDrEVentZStaSet7_enum@ */ /end MEASUREMENT
/begin MEASUREMENT VINP_FlashCLEVentZStaSet2_enum "" UBYTE SWC_INP_type_CM_uint8_enum 0 0 0.0 255.0 ECU_ADDRESS 0x0000 /* @ECU_Address@VINP_FlashCLEVentZStaSet2_enum@ */ /end MEASUREMENT
/begin MEASUREMENT VINP_FlashCLEVentZStaSet3_enum "" UBYTE SWC_INP_type_CM_uint8_enum 0 0 0.0 255.0 ECU_ADDRESS 0x0000 /* @ECU_Address@VINP_FlashCLEVentZStaSet3_enum@ */ /end MEASUREMENT
/begin MEASUREMENT VINP_FlashCLEVentZStaSet4_enum "" UBYTE SWC_INP_type_CM_uint8_enum 0 0 0.0 255.0 ECU_ADDRESS 0x0000 /* @ECU_Address@VINP_FlashCLEVentZStaSet4_enum@ */ /end MEASUREMENT
/begin MEASUREMENT VINP_FlashCLEVentZStaSet5_enum "" UBYTE SWC_INP_type_CM_uint8_enum 0 0 0.0 255.0 ECU_ADDRESS 0x0000 /* @ECU_Address@VINP_FlashCLEVentZStaSet5_enum@ */ /end MEASUREMENT
/begin MEASUREMENT VINP_FlashCLEVentZStaSet7_enum "" UBYTE SWC_INP_type_CM_uint8_enum 0 0 0.0 255.0 ECU_ADDRESS 0x0000 /* @ECU_Address@VINP_FlashCLEVentZStaSet7_enum@ */ /end MEASUREMENT
/begin MEASUREMENT VINP_FlashPsEVentZStaSet2_enum "" UBYTE SWC_INP_type_CM_uint8_enum 0 0 0.0 255.0 ECU_ADDRESS 0x0000 /* @ECU_Address@VINP_FlashPsEVentZStaSet2_enum@ */ /end MEASUREMENT
/begin MEASUREMENT VINP_FlashPsEVentZStaSet3_enum "" UBYTE SWC_INP_type_CM_uint8_enum 0 0 0.0 255.0 ECU_ADDRESS 0x0000 /* @ECU_Address@VINP_FlashPsEVentZStaSet3_enum@ */ /end MEASUREMENT
/begin MEASUREMENT VINP_FlashPsEVentZStaSet4_enum "" UBYTE SWC_INP_type_CM_uint8_enum 0 0 0.0 255.0 ECU_ADDRESS 0x0000 /* @ECU_Address@VINP_FlashPsEVentZStaSet4_enum@ */ /end MEASUREMENT
/begin MEASUREMENT VINP_FlashPsEVentZStaSet5_enum "" UBYTE SWC_INP_type_CM_uint8_enum 0 0 0.0 255.0 ECU_ADDRESS 0x0000 /* @ECU_Address@VINP_FlashPsEVentZStaSet5_enum@ */ /end MEASUREMENT
/begin MEASUREMENT VINP_FlashPsEVentZStaSet7_enum "" UBYTE SWC_INP_type_CM_uint8_enum 0 0 0.0 255.0 ECU_ADDRESS 0x0000 /* @ECU_Address@VINP_FlashPsEVentZStaSet7_enum@ */ /end MEASUREMENT
/begin MEASUREMENT VINP_FlashCREVentZStaSet2_enum "" UBYTE SWC_INP_type_CM_uint8_enum 0 0 0.0 255.0 ECU_ADDRESS 0x0000 /* @ECU_Address@VINP_FlashCREVentZStaSet2_enum@ */ /end MEASUREMENT
/begin MEASUREMENT VINP_FlashCREVentZStaSet3_enum "" UBYTE SWC_INP_type_CM_uint8_enum 0 0 0.0 255.0 ECU_ADDRESS 0x0000 /* @ECU_Address@VINP_FlashCREVentZStaSet3_enum@ */ /end MEASUREMENT
/begin MEASUREMENT VINP_FlashCREVentZStaSet4_enum "" UBYTE SWC_INP_type_CM_uint8_enum 0 0 0.0 255.0 ECU_ADDRESS 0x0000 /* @ECU_Address@VINP_FlashCREVentZStaSet4_enum@ */ /end MEASUREMENT
/begin MEASUREMENT VINP_FlashCREVentZStaSet5_enum "" UBYTE SWC_INP_type_CM_uint8_enum 0 0 0.0 255.0 ECU_ADDRESS 0x0000 /* @ECU_Address@VINP_FlashCREVentZStaSet5_enum@ */ /end MEASUREMENT
/begin MEASUREMENT VINP_FlashCREVentZStaSet7_enum "" UBYTE SWC_INP_type_CM_uint8_enum 0 0 0.0 255.0 ECU_ADDRESS 0x0000 /* @ECU_Address@VINP_FlashCREVentZStaSet7_enum@ */ /end MEASUREMENT
/begin MEASUREMENT VINP_FlashDrEVentYStaSet2_enum "" UBYTE SWC_INP_type_CM_uint8_enum 0 0 0.0 255.0 ECU_ADDRESS 0x0000 /* @ECU_Address@VINP_FlashDrEVentYStaSet2_enum@ */ /end MEASUREMENT
/begin MEASUREMENT VINP_FlashDrEVentYStaSet3_enum "" UBYTE SWC_INP_type_CM_uint8_enum 0 0 0.0 255.0 ECU_ADDRESS 0x0000 /* @ECU_Address@VINP_FlashDrEVentYStaSet3_enum@ */ /end MEASUREMENT
/begin MEASUREMENT VINP_FlashDrEVentYStaSet4_enum "" UBYTE SWC_INP_type_CM_uint8_enum 0 0 0.0 255.0 ECU_ADDRESS 0x0000 /* @ECU_Address@VINP_FlashDrEVentYStaSet4_enum@ */ /end MEASUREMENT
/begin MEASUREMENT VINP_FlashDrEVentYStaSet5_enum "" UBYTE SWC_INP_type_CM_uint8_enum 0 0 0.0 255.0 ECU_ADDRESS 0x0000 /* @ECU_Address@VINP_FlashDrEVentYStaSet5_enum@ */ /end MEASUREMENT
/begin MEASUREMENT VINP_FlashDrEVentYStaSet7_enum "" UBYTE SWC_INP_type_CM_uint8_enum 0 0 0.0 255.0 ECU_ADDRESS 0x0000 /* @ECU_Address@VINP_FlashDrEVentYStaSet7_enum@ */ /end MEASUREMENT
/begin MEASUREMENT VINP_FlashCLEVentYStaSet2_enum "" UBYTE SWC_INP_type_CM_uint8_enum 0 0 0.0 255.0 ECU_ADDRESS 0x0000 /* @ECU_Address@VINP_FlashCLEVentYStaSet2_enum@ */ /end MEASUREMENT
/begin MEASUREMENT VINP_FlashCLEVentYStaSet3_enum "" UBYTE SWC_INP_type_CM_uint8_enum 0 0 0.0 255.0 ECU_ADDRESS 0x0000 /* @ECU_Address@VINP_FlashCLEVentYStaSet3_enum@ */ /end MEASUREMENT
/begin MEASUREMENT VINP_FlashCLEVentYStaSet4_enum "" UBYTE SWC_INP_type_CM_uint8_enum 0 0 0.0 255.0 ECU_ADDRESS 0x0000 /* @ECU_Address@VINP_FlashCLEVentYStaSet4_enum@ */ /end MEASUREMENT
/begin MEASUREMENT VINP_FlashCLEVentYStaSet5_enum "" UBYTE SWC_INP_type_CM_uint8_enum 0 0 0.0 255.0 ECU_ADDRESS 0x0000 /* @ECU_Address@VINP_FlashCLEVentYStaSet5_enum@ */ /end MEASUREMENT
/begin MEASUREMENT VINP_FlashCLEVentYStaSet7_enum "" UBYTE SWC_INP_type_CM_uint8_enum 0 0 0.0 255.0 ECU_ADDRESS 0x0000 /* @ECU_Address@VINP_FlashCLEVentYStaSet7_enum@ */ /end MEASUREMENT
/begin MEASUREMENT VINP_FlashPsEVentYStaSet2_enum "" UBYTE SWC_INP_type_CM_uint8_enum 0 0 0.0 255.0 ECU_ADDRESS 0x0000 /* @ECU_Address@VINP_FlashPsEVentYStaSet2_enum@ */ /end MEASUREMENT
/begin MEASUREMENT VINP_FlashPsEVentYStaSet3_enum "" UBYTE SWC_INP_type_CM_uint8_enum 0 0 0.0 255.0 ECU_ADDRESS 0x0000 /* @ECU_Address@VINP_FlashPsEVentYStaSet3_enum@ */ /end MEASUREMENT
/begin MEASUREMENT VINP_FlashPsEVentYStaSet4_enum "" UBYTE SWC_INP_type_CM_uint8_enum 0 0 0.0 255.0 ECU_ADDRESS 0x0000 /* @ECU_Address@VINP_FlashPsEVentYStaSet4_enum@ */ /end MEASUREMENT
/begin MEASUREMENT VINP_FlashPsEVentYStaSet5_enum "" UBYTE SWC_INP_type_CM_uint8_enum 0 0 0.0 255.0 ECU_ADDRESS 0x0000 /* @ECU_Address@VINP_FlashPsEVentYStaSet5_enum@ */ /end MEASUREMENT
/begin MEASUREMENT VINP_FlashPsEVentYStaSet7_enum "" UBYTE SWC_INP_type_CM_uint8_enum 0 0 0.0 255.0 ECU_ADDRESS 0x0000 /* @ECU_Address@VINP_FlashPsEVentYStaSet7_enum@ */ /end MEASUREMENT
/begin MEASUREMENT VINP_FlashCREVentYStaSet2_enum "" UBYTE SWC_INP_type_CM_uint8_enum 0 0 0.0 255.0 ECU_ADDRESS 0x0000 /* @ECU_Address@VINP_FlashCREVentYStaSet2_enum@ */ /end MEASUREMENT
/begin MEASUREMENT VINP_FlashCREVentYStaSet3_enum "" UBYTE SWC_INP_type_CM_uint8_enum 0 0 0.0 255.0 ECU_ADDRESS 0x0000 /* @ECU_Address@VINP_FlashCREVentYStaSet3_enum@ */ /end MEASUREMENT
/begin MEASUREMENT VINP_FlashCREVentYStaSet4_enum "" UBYTE SWC_INP_type_CM_uint8_enum 0 0 0.0 255.0 ECU_ADDRESS 0x0000 /* @ECU_Address@VINP_FlashCREVentYStaSet4_enum@ */ /end MEASUREMENT
/begin MEASUREMENT VINP_FlashCREVentYStaSet5_enum "" UBYTE SWC_INP_type_CM_uint8_enum 0 0 0.0 255.0 ECU_ADDRESS 0x0000 /* @ECU_Address@VINP_FlashCREVentYStaSet5_enum@ */ /end MEASUREMENT
/begin MEASUREMENT VINP_FlashCREVentYStaSet7_enum "" UBYTE SWC_INP_type_CM_uint8_enum 0 0 0.0 255.0 ECU_ADDRESS 0x0000 /* @ECU_Address@VINP_FlashCREVentYStaSet7_enum@ */ /end MEASUREMENT
/begin MEASUREMENT VINP_FlashACModeSet457_enum "" UBYTE SWC_INP_type_CM_uint8_enum 0 0 0.0 255.0 ECU_ADDRESS 0x0000 /* @ECU_Address@VINP_FlashACModeSet457_enum@ */ /end MEASUREMENT
/begin MEASUREMENT VINP_FlashSettempZon1Set2_enum "" UBYTE SWC_INP_type_CM_uint8_enum 0 0 0.0 255.0 ECU_ADDRESS 0x0000 /* @ECU_Address@VINP_FlashSettempZon1Set2_enum@ */ /end MEASUREMENT
/begin MEASUREMENT VINP_FlashSettempZon1Set3_enum "" UBYTE SWC_INP_type_CM_uint8_enum 0 0 0.0 255.0 ECU_ADDRESS 0x0000 /* @ECU_Address@VINP_FlashSettempZon1Set3_enum@ */ /end MEASUREMENT
/begin MEASUREMENT VINP_FlashSettempZon1Set4_enum "" UBYTE SWC_INP_type_CM_uint8_enum 0 0 0.0 255.0 ECU_ADDRESS 0x0000 /* @ECU_Address@VINP_FlashSettempZon1Set4_enum@ */ /end MEASUREMENT
/begin MEASUREMENT VINP_FlashSettempZon1Set5_enum "" UBYTE SWC_INP_type_CM_uint8_enum 0 0 0.0 255.0 ECU_ADDRESS 0x0000 /* @ECU_Address@VINP_FlashSettempZon1Set5_enum@ */ /end MEASUREMENT
/begin MEASUREMENT VINP_FlashSettempZon1Set7_enum "" UBYTE SWC_INP_type_CM_uint8_enum 0 0 0.0 255.0 ECU_ADDRESS 0x0000 /* @ECU_Address@VINP_FlashSettempZon1Set7_enum@ */ /end MEASUREMENT
/begin MEASUREMENT VINP_DrivingMode_cnt "" UBYTE SWC_INP_type_CM_uint8_cnt 0 0 0.0 255.0 ECU_ADDRESS 0x0000 /* @ECU_Address@VINP_DrivingMode_cnt@ */ /end MEASUREMENT
/begin MEASUREMENT VINP_ModelYear_cnt "" UBYTE SWC_INP_type_CM_uint8_cnt 0 0 0.0 255.0 ECU_ADDRESS 0x0000 /* @ECU_Address@VINP_ModelYear_cnt@ */ /end MEASUREMENT
/begin MEASUREMENT VINP_HWID2_enum "" UBYTE SWC_INP_type_CM_uint8_enum 0 0 0.0 255.0 ECU_ADDRESS 0x0000 /* @ECU_Address@VINP_HWID2_enum@ */ /end MEASUREMENT
/begin MEASUREMENT VINP_HWID3_enum "" UBYTE SWC_INP_type_CM_uint8_enum 0 0 0.0 255.0 ECU_ADDRESS 0x0000 /* @ECU_Address@VINP_HWID3_enum@ */ /end MEASUREMENT
/begin MEASUREMENT VINP_HWID4_enum "" UBYTE SWC_INP_type_CM_uint8_enum 0 0 0.0 255.0 ECU_ADDRESS 0x0000 /* @ECU_Address@VINP_HWID4_enum@ */ /end MEASUREMENT
/begin MEASUREMENT VINP_HWID1_enum "" UBYTE SWC_INP_type_CM_uint8_enum 0 0 0.0 255.0 ECU_ADDRESS 0x0000 /* @ECU_Address@VINP_HWID1_enum@ */ /end MEASUREMENT
/begin MEASUREMENT VINP_PASDRMR_cm "" UBYTE SWC_INP_type_CM_uint8_cm 0 0 0.0 255.0 ECU_ADDRESS 0x0000 /* @ECU_Address@VINP_PASDRMR_cm@ */ /end MEASUREMENT
/begin MEASUREMENT VINP_PASDRML_cm "" UBYTE SWC_INP_type_CM_uint8_cm 0 0 0.0 255.0 ECU_ADDRESS 0x0000 /* @ECU_Address@VINP_PASDRML_cm@ */ /end MEASUREMENT
/begin MEASUREMENT VINP_PASDRCR_cm "" UBYTE SWC_INP_type_CM_uint8_cm 0 0 0.0 255.0 ECU_ADDRESS 0x0000 /* @ECU_Address@VINP_PASDRCR_cm@ */ /end MEASUREMENT
/begin MEASUREMENT VINP_PASDRCL_cm "" UBYTE SWC_INP_type_CM_uint8_cm 0 0 0.0 255.0 ECU_ADDRESS 0x0000 /* @ECU_Address@VINP_PASDRCL_cm@ */ /end MEASUREMENT
/begin MEASUREMENT VINP_PASDFMR_cm "" UBYTE SWC_INP_type_CM_uint8_cm 0 0 0.0 255.0 ECU_ADDRESS 0x0000 /* @ECU_Address@VINP_PASDFMR_cm@ */ /end MEASUREMENT
/begin MEASUREMENT VINP_PASDFML_cm "" UBYTE SWC_INP_type_CM_uint8_cm 0 0 0.0 255.0 ECU_ADDRESS 0x0000 /* @ECU_Address@VINP_PASDFML_cm@ */ /end MEASUREMENT
/begin MEASUREMENT VINP_PASDFCR_cm "" UBYTE SWC_INP_type_CM_uint8_cm 0 0 0.0 255.0 ECU_ADDRESS 0x0000 /* @ECU_Address@VINP_PASDFCR_cm@ */ /end MEASUREMENT
/begin MEASUREMENT VINP_PASDFCL_cm "" UBYTE SWC_INP_type_CM_uint8_cm 0 0 0.0 255.0 ECU_ADDRESS 0x0000 /* @ECU_Address@VINP_PASDFCL_cm@ */ /end MEASUREMENT
/begin MEASUREMENT VINP_PASAFCL_enum "" UBYTE SWC_INP_type_CM_uint8_enum 0 0 0.0 255.0 ECU_ADDRESS 0x0000 /* @ECU_Address@VINP_PASAFCL_enum@ */ /end MEASUREMENT
/begin MEASUREMENT VINP_PASARMR_enum "" UBYTE SWC_INP_type_CM_uint8_enum 0 0 0.0 255.0 ECU_ADDRESS 0x0000 /* @ECU_Address@VINP_PASARMR_enum@ */ /end MEASUREMENT
/begin MEASUREMENT VINP_PASARML_enum "" UBYTE SWC_INP_type_CM_uint8_enum 0 0 0.0 255.0 ECU_ADDRESS 0x0000 /* @ECU_Address@VINP_PASARML_enum@ */ /end MEASUREMENT
/begin MEASUREMENT VINP_PASARCR_enum "" UBYTE SWC_INP_type_CM_uint8_enum 0 0 0.0 255.0 ECU_ADDRESS 0x0000 /* @ECU_Address@VINP_PASARCR_enum@ */ /end MEASUREMENT
/begin MEASUREMENT VINP_PASARCL_enum "" UBYTE SWC_INP_type_CM_uint8_enum 0 0 0.0 255.0 ECU_ADDRESS 0x0000 /* @ECU_Address@VINP_PASARCL_enum@ */ /end MEASUREMENT
/begin MEASUREMENT VINP_PASAFMR_enum "" UBYTE SWC_INP_type_CM_uint8_enum 0 0 0.0 255.0 ECU_ADDRESS 0x0000 /* @ECU_Address@VINP_PASAFMR_enum@ */ /end MEASUREMENT
/begin MEASUREMENT VINP_PASAFML_enum "" UBYTE SWC_INP_type_CM_uint8_enum 0 0 0.0 255.0 ECU_ADDRESS 0x0000 /* @ECU_Address@VINP_PASAFML_enum@ */ /end MEASUREMENT
/begin MEASUREMENT VINP_PASAFCR_enum "" UBYTE SWC_INP_type_CM_uint8_enum 0 0 0.0 255.0 ECU_ADDRESS 0x0000 /* @ECU_Address@VINP_PASAFCR_enum@ */ /end MEASUREMENT
/begin MEASUREMENT VINP_Chime_enum "" UBYTE SWC_INP_type_CM_uint8_enum 0 0 0.0 255.0 ECU_ADDRESS 0x0000 /* @ECU_Address@VINP_Chime_enum@ */ /end MEASUREMENT
/begin MEASUREMENT VINP_SNSRLayout_enum "" UBYTE SWC_INP_type_CM_uint8_enum 0 0 0.0 255.0 ECU_ADDRESS 0x0000 /* @ECU_Address@VINP_SNSRLayout_enum@ */ /end MEASUREMENT
/begin MEASUREMENT VINP_ModOperation_enum "" UBYTE SWC_INP_type_CM_uint8_enum 0 0 0.0 255.0 ECU_ADDRESS 0x0000 /* @ECU_Address@VINP_ModOperation_enum@ */ /end MEASUREMENT
/begin MEASUREMENT VINP_APSRQDisplay_enum "" UBYTE SWC_INP_type_CM_uint8_enum 0 0 0.0 255.0 ECU_ADDRESS 0x0000 /* @ECU_Address@VINP_APSRQDisplay_enum@ */ /end MEASUREMENT
/begin MEASUREMENT VINP_APSSWVer_enum "" UBYTE SWC_INP_type_CM_uint8_enum 0 0 0.0 255.0 ECU_ADDRESS 0x0000 /* @ECU_Address@VINP_APSSWVer_enum@ */ /end MEASUREMENT
/begin MEASUREMENT VINP_APSHWVer_enum "" UBYTE SWC_INP_type_CM_uint8_enum 0 0 0.0 255.0 ECU_ADDRESS 0x0000 /* @ECU_Address@VINP_APSHWVer_enum@ */ /end MEASUREMENT
/begin MEASUREMENT VINP_APSExitCondition_enum "" UBYTE SWC_INP_type_CM_uint8_enum 0 0 0.0 255.0 ECU_ADDRESS 0x0000 /* @ECU_Address@VINP_APSExitCondition_enum@ */ /end MEASUREMENT
/begin MEASUREMENT VINP_APSStaSystem_enum "" UBYTE SWC_INP_type_CM_uint8_enum 0 0 0.0 7.0 ECU_ADDRESS 0x0000 /* @ECU_Address@VINP_APSStaSystem_enum@ */ /end MEASUREMENT
/begin MEASUREMENT VINP_APSReq_enum "" UBYTE SWC_INP_type_CM_uint8_enum 0 0 0.0 7.0 ECU_ADDRESS 0x0000 /* @ECU_Address@VINP_APSReq_enum@ */ /end MEASUREMENT
/begin MEASUREMENT VINP_APSShiftPosnReq_enum "" UBYTE SWC_INP_type_CM_uint8_enum 0 0 0.0 15.0 ECU_ADDRESS 0x0000 /* @ECU_Address@VINP_APSShiftPosnReq_enum@ */ /end MEASUREMENT
/begin MEASUREMENT VINP_CAASSta_enum "" UBYTE SWC_INP_type_CM_uint8_enum 0 0 0.0 7.0 ECU_ADDRESS 0x0000 /* @ECU_Address@VINP_CAASSta_enum@ */ /end MEASUREMENT
/begin MEASUREMENT VINP_APSPwrReq_enum "" UBYTE SWC_INP_type_CM_uint8_enum 0 0 0.0 4.0 ECU_ADDRESS 0x0000 /* @ECU_Address@VINP_APSPwrReq_enum@ */ /end MEASUREMENT
/begin MEASUREMENT VINP_RAPSBCMLamp_enum "" UBYTE SWC_INP_type_CM_uint8_enum 0 0 0.0 3.0 ECU_ADDRESS 0x0000 /* @ECU_Address@VINP_RAPSBCMLamp_enum@ */ /end MEASUREMENT
/begin MEASUREMENT VINP_RAPSErrWarnSta_enum "" UBYTE SWC_INP_type_CM_uint8_enum 0 0 0.0 7.0 ECU_ADDRESS 0x0000 /* @ECU_Address@VINP_RAPSErrWarnSta_enum@ */ /end MEASUREMENT
/begin MEASUREMENT VINP_DKCDecReVehData_enum "" UBYTE SWC_INP_type_CM_uint8_enum 0 0 0.0 255.0 ECU_ADDRESS 0x0000 /* @ECU_Address@VINP_DKCDecReVehData_enum@ */ /end MEASUREMENT
/begin MEASUREMENT VINP_DKCDecRemotePW_enum "" UBYTE SWC_INP_type_CM_uint8_enum 0 0 0.0 255.0 ECU_ADDRESS 0x0000 /* @ECU_Address@VINP_DKCDecRemotePW_enum@ */ /end MEASUREMENT
/begin MEASUREMENT VINP_DKCDecPCommandToBCM_enum "" UBYTE SWC_INP_type_CM_uint8_enum 0 0 0.0 255.0 ECU_ADDRESS 0x0000 /* @ECU_Address@VINP_DKCDecPCommandToBCM_enum@ */ /end MEASUREMENT
/begin MEASUREMENT VINP_DKCDecPCommandToPTG_enum "" UBYTE SWC_INP_type_CM_uint8_enum 0 0 0.0 255.0 ECU_ADDRESS 0x0000 /* @ECU_Address@VINP_DKCDecPCommandToPTG_enum@ */ /end MEASUREMENT
/begin MEASUREMENT VINP_DKCDecPDKeyAreaLockUnlock_enum "" UBYTE SWC_INP_type_CM_uint8_enum 0 0 0.0 255.0 ECU_ADDRESS 0x0000 /* @ECU_Address@VINP_DKCDecPDKeyAreaLockUnlock_enum@ */ /end MEASUREMENT
/begin MEASUREMENT VINP_DKCDecPDKeyAreaPS_enum "" UBYTE SWC_INP_type_CM_uint8_enum 0 0 0.0 255.0 ECU_ADDRESS 0x0000 /* @ECU_Address@VINP_DKCDecPDKeyAreaPS_enum@ */ /end MEASUREMENT
/begin MEASUREMENT VINP_DKCDecPDKeyAreaPTG_enum "" UBYTE SWC_INP_type_CM_uint8_enum 0 0 0.0 255.0 ECU_ADDRESS 0x0000 /* @ECU_Address@VINP_DKCDecPDKeyAreaPTG_enum@ */ /end MEASUREMENT
/begin MEASUREMENT VINP_DKCDecPDKeyWelcome_enum "" UBYTE SWC_INP_type_CM_uint8_enum 0 0 0.0 255.0 ECU_ADDRESS 0x0000 /* @ECU_Address@VINP_DKCDecPDKeyWelcome_enum@ */ /end MEASUREMENT
/begin MEASUREMENT VINP_DKCDecPDkeyShowIVI_enum "" UBYTE SWC_INP_type_CM_uint8_enum 0 0 0.0 255.0 ECU_ADDRESS 0x0000 /* @ECU_Address@VINP_DKCDecPDkeyShowIVI_enum@ */ /end MEASUREMENT
/begin MEASUREMENT VINP_DKCDecPKeyMode_enum "" UBYTE SWC_INP_type_CM_uint8_enum 0 0 0.0 255.0 ECU_ADDRESS 0x0000 /* @ECU_Address@VINP_DKCDecPKeyMode_enum@ */ /end MEASUREMENT
/begin MEASUREMENT VINP_FlashLFWheelPSW_raw8 "" UBYTE SWC_INP_type_CM_uint8_raw8 0 0 0.0 255.0 ECU_ADDRESS 0x0000 /* @ECU_Address@VINP_FlashLFWheelPSW_raw8@ */ /end MEASUREMENT
/begin MEASUREMENT VINP_FlashRFWheelPSW_raw8 "" UBYTE SWC_INP_type_CM_uint8_raw8 0 0 0.0 255.0 ECU_ADDRESS 0x0000 /* @ECU_Address@VINP_FlashRFWheelPSW_raw8@ */ /end MEASUREMENT
/begin MEASUREMENT VINP_FlashLRWheelPSW_raw8 "" UBYTE SWC_INP_type_CM_uint8_raw8 0 0 0.0 255.0 ECU_ADDRESS 0x0000 /* @ECU_Address@VINP_FlashLRWheelPSW_raw8@ */ /end MEASUREMENT
/begin MEASUREMENT VINP_FlashRRWheelPSW_raw8 "" UBYTE SWC_INP_type_CM_uint8_raw8 0 0 0.0 255.0 ECU_ADDRESS 0x0000 /* @ECU_Address@VINP_FlashRRWheelPSW_raw8@ */ /end MEASUREMENT
/begin MEASUREMENT VINP_FlashLFPindi_enum "" UBYTE SWC_INP_type_CM_uint8_enum 0 0 0.0 255.0 ECU_ADDRESS 0x0000 /* @ECU_Address@VINP_FlashLFPindi_enum@ */ /end MEASUREMENT
/begin MEASUREMENT VINP_FlashRFPindi_enum "" UBYTE SWC_INP_type_CM_uint8_enum 0 0 0.0 255.0 ECU_ADDRESS 0x0000 /* @ECU_Address@VINP_FlashRFPindi_enum@ */ /end MEASUREMENT
/begin MEASUREMENT VINP_FlashLRPindi_enum "" UBYTE SWC_INP_type_CM_uint8_enum 0 0 0.0 255.0 ECU_ADDRESS 0x0000 /* @ECU_Address@VINP_FlashLRPindi_enum@ */ /end MEASUREMENT
/begin MEASUREMENT VINP_FlashRRPindi_enum "" UBYTE SWC_INP_type_CM_uint8_enum 0 0 0.0 255.0 ECU_ADDRESS 0x0000 /* @ECU_Address@VINP_FlashRRPindi_enum@ */ /end MEASUREMENT
/begin MEASUREMENT VINP_FlashLFP20_raw8 "" UBYTE SWC_INP_type_CM_uint8_raw8 0 0 0.0 255.0 ECU_ADDRESS 0x0000 /* @ECU_Address@VINP_FlashLFP20_raw8@ */ /end MEASUREMENT
/begin MEASUREMENT VINP_FlashRFP20_raw8 "" UBYTE SWC_INP_type_CM_uint8_raw8 0 0 0.0 255.0 ECU_ADDRESS 0x0000 /* @ECU_Address@VINP_FlashRFP20_raw8@ */ /end MEASUREMENT
/begin MEASUREMENT VINP_FlashLRP20_raw8 "" UBYTE SWC_INP_type_CM_uint8_raw8 0 0 0.0 255.0 ECU_ADDRESS 0x0000 /* @ECU_Address@VINP_FlashLRP20_raw8@ */ /end MEASUREMENT
/begin MEASUREMENT VINP_FlashRRP20_raw8 "" UBYTE SWC_INP_type_CM_uint8_raw8 0 0 0.0 255.0 ECU_ADDRESS 0x0000 /* @ECU_Address@VINP_FlashRRP20_raw8@ */ /end MEASUREMENT
/begin MEASUREMENT VINP_FlashLFWheelPress_raw8 "" UBYTE SWC_INP_type_CM_uint8_raw8 0 0 0.0 255.0 ECU_ADDRESS 0x0000 /* @ECU_Address@VINP_FlashLFWheelPress_raw8@ */ /end MEASUREMENT
/begin MEASUREMENT VINP_FlashRFWheelPress_raw8 "" UBYTE SWC_INP_type_CM_uint8_raw8 0 0 0.0 255.0 ECU_ADDRESS 0x0000 /* @ECU_Address@VINP_FlashRFWheelPress_raw8@ */ /end MEASUREMENT
/begin MEASUREMENT VINP_FlashLRWheelPress_raw8 "" UBYTE SWC_INP_type_CM_uint8_raw8 0 0 0.0 255.0 ECU_ADDRESS 0x0000 /* @ECU_Address@VINP_FlashLRWheelPress_raw8@ */ /end MEASUREMENT
/begin MEASUREMENT VINP_FlashRRWheelPress_raw8 "" UBYTE SWC_INP_type_CM_uint8_raw8 0 0 0.0 255.0 ECU_ADDRESS 0x0000 /* @ECU_Address@VINP_FlashRRWheelPress_raw8@ */ /end MEASUREMENT
/begin MEASUREMENT VINP_FlashLFWheelTemp_C "" UBYTE SWC_INP_type_CM_uint8_C 0 0 0.0 255.0 ECU_ADDRESS 0x0000 /* @ECU_Address@VINP_FlashLFWheelTemp_C@ */ /end MEASUREMENT
/begin MEASUREMENT VINP_FlashRFWheelTemp_C "" UBYTE SWC_INP_type_CM_uint8_C 0 0 0.0 255.0 ECU_ADDRESS 0x0000 /* @ECU_Address@VINP_FlashRFWheelTemp_C@ */ /end MEASUREMENT
/begin MEASUREMENT VINP_FlashLRWheelTemp_C "" UBYTE SWC_INP_type_CM_uint8_C 0 0 0.0 255.0 ECU_ADDRESS 0x0000 /* @ECU_Address@VINP_FlashLRWheelTemp_C@ */ /end MEASUREMENT
/begin MEASUREMENT VINP_FlashRRWheelTemp_C "" UBYTE SWC_INP_type_CM_uint8_C 0 0 0.0 255.0 ECU_ADDRESS 0x0000 /* @ECU_Address@VINP_FlashRRWheelTemp_C@ */ /end MEASUREMENT
/begin MEASUREMENT VINP_TPMSSensorIDRegSta_enum "" UBYTE SWC_INP_type_CM_uint8_enum 0 0 0.0 4.0 ECU_ADDRESS 0x0000 /* @ECU_Address@VINP_TPMSSensorIDRegSta_enum@ */ /end MEASUREMENT
/begin MEASUREMENT VINP_ReadFlashCorrect_flg "" UBYTE SWC_INP_type_CM_boolean_flg 0 0 0.0 1.0 ECU_ADDRESS 0x0000 /* @ECU_Address@VINP_ReadFlashCorrect_flg@ */ /end MEASUREMENT
/begin MEASUREMENT VINP_FlashACForceOFF_flg "" UBYTE SWC_INP_type_CM_boolean_flg 0 0 0.0 1.0 ECU_ADDRESS 0x0000 /* @ECU_Address@VINP_FlashACForceOFF_flg@ */ /end MEASUREMENT
/begin MEASUREMENT VINP_FlashMFSWTri_flg "" UBYTE SWC_INP_type_CM_boolean_flg 0 0 0.0 1.0 ECU_ADDRESS 0x0000 /* @ECU_Address@VINP_FlashMFSWTri_flg@ */ /end MEASUREMENT
/begin MEASUREMENT VINP_FlashMirrorFlodPos_flg "" UBYTE SWC_INP_type_CM_boolean_flg 0 0 0.0 1.0 ECU_ADDRESS 0x0000 /* @ECU_Address@VINP_FlashMirrorFlodPos_flg@ */ /end MEASUREMENT
/begin MEASUREMENT VINP_FlashFuelDoorPos_flg "" UBYTE SWC_INP_type_CM_boolean_flg 0 0 0.0 1.0 ECU_ADDRESS 0x0000 /* @ECU_Address@VINP_FlashFuelDoorPos_flg@ */ /end MEASUREMENT
/begin MEASUREMENT VINP_FlashWiperFixMode_flg "" UBYTE SWC_INP_type_CM_boolean_flg 0 0 0.0 1.0 ECU_ADDRESS 0x0000 /* @ECU_Address@VINP_FlashWiperFixMode_flg@ */ /end MEASUREMENT
/begin MEASUREMENT VINP_AnyNMID_flg "" UBYTE SWC_INP_type_CM_boolean_flg 0 0 0.0 1.0 ECU_ADDRESS 0x0000 /* @ECU_Address@VINP_AnyNMID_flg@ */ /end MEASUREMENT
/begin MEASUREMENT VINP_NvmProtectSta_flg "" UBYTE SWC_INP_type_CM_boolean_flg 0 0 0.0 1.0 ECU_ADDRESS 0x0000 /* @ECU_Address@VINP_NvmProtectSta_flg@ */ /end MEASUREMENT
/begin MEASUREMENT VINP_FlashHoodSW_flg "" UBYTE SWC_INP_type_CM_boolean_flg 0 0 0.0 1.0 ECU_ADDRESS 0x0000 /* @ECU_Address@VINP_FlashHoodSW_flg@ */ /end MEASUREMENT
/begin MEASUREMENT VINP_FlashTailgateSW_flg "" UBYTE SWC_INP_type_CM_boolean_flg 0 0 0.0 1.0 ECU_ADDRESS 0x0000 /* @ECU_Address@VINP_FlashTailgateSW_flg@ */ /end MEASUREMENT
/begin MEASUREMENT VINP_FlashCTDLockSW_flg "" UBYTE SWC_INP_type_CM_boolean_flg 0 0 0.0 1.0 ECU_ADDRESS 0x0000 /* @ECU_Address@VINP_FlashCTDLockSW_flg@ */ /end MEASUREMENT
/begin MEASUREMENT VINP_FlashTailgateHDSW_flg "" UBYTE SWC_INP_type_CM_boolean_flg 0 0 0.0 1.0 ECU_ADDRESS 0x0000 /* @ECU_Address@VINP_FlashTailgateHDSW_flg@ */ /end MEASUREMENT
/begin MEASUREMENT VINP_FlashAPMDoorControlSta_flg "" UBYTE SWC_INP_type_CM_boolean_flg 0 0 0.0 1.0 ECU_ADDRESS 0x0000 /* @ECU_Address@VINP_FlashAPMDoorControlSta_flg@ */ /end MEASUREMENT
/begin MEASUREMENT VINP_AcoreRebootCmd_flg "" UBYTE SWC_INP_type_CM_boolean_flg 0 0 0.0 1.0 ECU_ADDRESS 0x0000 /* @ECU_Address@VINP_AcoreRebootCmd_flg@ */ /end MEASUREMENT
/begin MEASUREMENT VINP_DIDGetDynoMode_flg "" UBYTE SWC_INP_type_CM_boolean_flg 0 0 0.0 1.0 ECU_ADDRESS 0x0000 /* @ECU_Address@VINP_DIDGetDynoMode_flg@ */ /end MEASUREMENT
/begin MEASUREMENT VINP_funAuto_flg "" UBYTE SWC_INP_type_CM_boolean_flg 0 0 0.0 1.0 ECU_ADDRESS 0x0000 /* @ECU_Address@VINP_funAuto_flg@ */ /end MEASUREMENT
/begin MEASUREMENT VINP_DiagDRLOFF_flg "" UBYTE SWC_INP_type_CM_boolean_flg 0 0 0.0 1.0 ECU_ADDRESS 0x0000 /* @ECU_Address@VINP_DiagDRLOFF_flg@ */ /end MEASUREMENT
/begin MEASUREMENT VINP_FlashfUnlockSingle_flg "" UBYTE SWC_INP_type_CM_boolean_flg 0 0 0.0 1.0 ECU_ADDRESS 0x0000 /* @ECU_Address@VINP_FlashfUnlockSingle_flg@ */ /end MEASUREMENT
/begin MEASUREMENT VINP_NewNMSpec_flg "" UBYTE SWC_INP_type_CM_boolean_flg 0 0 0.0 1.0 ECU_ADDRESS 0x0000 /* @ECU_Address@VINP_NewNMSpec_flg@ */ /end MEASUREMENT
/begin MEASUREMENT VINP_AutoWipHSpdEN_flg "" UBYTE SWC_INP_type_CM_boolean_flg 0 0 0.0 1.0 ECU_ADDRESS 0x0000 /* @ECU_Address@VINP_AutoWipHSpdEN_flg@ */ /end MEASUREMENT
/begin MEASUREMENT VINP_WipRLSCmdHoldEN_flg "" UBYTE SWC_INP_type_CM_boolean_flg 0 0 0.0 1.0 ECU_ADDRESS 0x0000 /* @ECU_Address@VINP_WipRLSCmdHoldEN_flg@ */ /end MEASUREMENT
/begin MEASUREMENT VINP_WipRLSCmdCutEN_flg "" UBYTE SWC_INP_type_CM_boolean_flg 0 0 0.0 1.0 ECU_ADDRESS 0x0000 /* @ECU_Address@VINP_WipRLSCmdCutEN_flg@ */ /end MEASUREMENT
/begin MEASUREMENT VINP_FlashAutoWipHSpdEN_flg "" UBYTE SWC_INP_type_CM_boolean_flg 0 0 0.0 1.0 ECU_ADDRESS 0x0000 /* @ECU_Address@VINP_FlashAutoWipHSpdEN_flg@ */ /end MEASUREMENT
/begin MEASUREMENT VINP_SOCDisUsed_flg "" UBYTE SWC_INP_type_CM_boolean_flg 0 0 0.0 1.0 ECU_ADDRESS 0x0000 /* @ECU_Address@VINP_SOCDisUsed_flg@ */ /end MEASUREMENT
/begin MEASUREMENT VINP_FlashJugKeepUnLZone_flg "" UBYTE SWC_INP_type_CM_boolean_flg 0 0 0.0 1.0 ECU_ADDRESS 0x0000 /* @ECU_Address@VINP_FlashJugKeepUnLZone_flg@ */ /end MEASUREMENT
/begin MEASUREMENT VINP_CANMsgValidACBTMSC10000_flg "" UBYTE SWC_INP_type_CM_boolean_flg 0 0 0.0 1.0 ECU_ADDRESS 0x0000 /* @ECU_Address@VINP_CANMsgValidACBTMSC10000_flg@ */ /end MEASUREMENT
/begin MEASUREMENT VINP_CANMsgValidEMC1EM1_flg "" UBYTE SWC_INP_type_CM_boolean_flg 0 0 0.0 1.0 ECU_ADDRESS 0x0000 /* @ECU_Address@VINP_CANMsgValidEMC1EM1_flg@ */ /end MEASUREMENT
/begin MEASUREMENT VINP_CANMsgValidHRW_flg "" UBYTE SWC_INP_type_CM_boolean_flg 0 0 0.0 1.0 ECU_ADDRESS 0x0000 /* @ECU_Address@VINP_CANMsgValidHRW_flg@ */ /end MEASUREMENT
/begin MEASUREMENT VINP_CANMsgValidTC1_flg "" UBYTE SWC_INP_type_CM_boolean_flg 0 0 0.0 1.0 ECU_ADDRESS 0x0000 /* @ECU_Address@VINP_CANMsgValidTC1_flg@ */ /end MEASUREMENT
/begin MEASUREMENT VINP_CANMsgValidACBTMSC10001_flg "" UBYTE SWC_INP_type_CM_boolean_flg 0 0 0.0 1.0 ECU_ADDRESS 0x0000 /* @ECU_Address@VINP_CANMsgValidACBTMSC10001_flg@ */ /end MEASUREMENT
/begin MEASUREMENT VINP_CANMsgValidACBTMSC10004_flg "" UBYTE SWC_INP_type_CM_boolean_flg 0 0 0.0 1.0 ECU_ADDRESS 0x0000 /* @ECU_Address@VINP_CANMsgValidACBTMSC10004_flg@ */ /end MEASUREMENT
/begin MEASUREMENT VINP_CANMsgValidACBTMSC50000_flg "" UBYTE SWC_INP_type_CM_boolean_flg 0 0 0.0 1.0 ECU_ADDRESS 0x0000 /* @ECU_Address@VINP_CANMsgValidACBTMSC50000_flg@ */ /end MEASUREMENT
/begin MEASUREMENT VINP_CANMsgValidASC1A_flg "" UBYTE SWC_INP_type_CM_boolean_flg 0 0 0.0 1.0 ECU_ADDRESS 0x0000 /* @ECU_Address@VINP_CANMsgValidASC1A_flg@ */ /end MEASUREMENT
/begin MEASUREMENT VINP_CANMsgValidEBC1_flg "" UBYTE SWC_INP_type_CM_boolean_flg 0 0 0.0 1.0 ECU_ADDRESS 0x0000 /* @ECU_Address@VINP_CANMsgValidEBC1_flg@ */ /end MEASUREMENT
/begin MEASUREMENT VINP_CANMsgValidEBC2_flg "" UBYTE SWC_INP_type_CM_boolean_flg 0 0 0.0 1.0 ECU_ADDRESS 0x0000 /* @ECU_Address@VINP_CANMsgValidEBC2_flg@ */ /end MEASUREMENT
/begin MEASUREMENT VINP_CANMsgValidEBC5_flg "" UBYTE SWC_INP_type_CM_boolean_flg 0 0 0.0 1.0 ECU_ADDRESS 0x0000 /* @ECU_Address@VINP_CANMsgValidEBC5_flg@ */ /end MEASUREMENT
/begin MEASUREMENT VINP_CANMsgValidECASDM1_flg "" UBYTE SWC_INP_type_CM_boolean_flg 0 0 0.0 1.0 ECU_ADDRESS 0x0000 /* @ECU_Address@VINP_CANMsgValidECASDM1_flg@ */ /end MEASUREMENT
/begin MEASUREMENT VINP_PushButton_flg "" UBYTE SWC_INP_type_CM_boolean_flg 0 0 0.0 1.0 ECU_ADDRESS 0x0000 /* @ECU_Address@VINP_PushButton_flg@ */ /end MEASUREMENT
/begin MEASUREMENT VINP_AlcoholPass_flg "" UBYTE SWC_INP_type_CM_boolean_flg 0 0 0.0 1.0 ECU_ADDRESS 0x0000 /* @ECU_Address@VINP_AlcoholPass_flg@ */ /end MEASUREMENT
/begin MEASUREMENT VINP_OSDoorSwClose_flg "" UBYTE SWC_INP_type_CM_boolean_flg 0 0 0.0 1.0 ECU_ADDRESS 0x0000 /* @ECU_Address@VINP_OSDoorSwClose_flg@ */ /end MEASUREMENT
/begin MEASUREMENT VINP_BmsAplus_flg "" UBYTE SWC_INP_type_CM_boolean_flg 0 0 0.0 1.0 ECU_ADDRESS 0x0000 /* @ECU_Address@VINP_BmsAplus_flg@ */ /end MEASUREMENT
/begin MEASUREMENT VINP_BrakeSWGPIO_flg "" UBYTE SWC_INP_type_CM_boolean_flg 0 0 0.0 1.0 ECU_ADDRESS 0x0000 /* @ECU_Address@VINP_BrakeSWGPIO_flg@ */ /end MEASUREMENT
/begin MEASUREMENT VINP_EmergencyExitSW_flg "" UBYTE SWC_INP_type_CM_boolean_flg 0 0 0.0 1.0 ECU_ADDRESS 0x0000 /* @ECU_Address@VINP_EmergencyExitSW_flg@ */ /end MEASUREMENT
/begin MEASUREMENT VINP_TailgateSW_flg "" UBYTE SWC_INP_type_CM_boolean_flg 0 0 0.0 1.0 ECU_ADDRESS 0x0000 /* @ECU_Address@VINP_TailgateSW_flg@ */ /end MEASUREMENT
/begin MEASUREMENT VINP_LeftTurnSW_flg "" UBYTE SWC_INP_type_CM_boolean_flg 0 0 0.0 1.0 ECU_ADDRESS 0x0000 /* @ECU_Address@VINP_LeftTurnSW_flg@ */ /end MEASUREMENT
/begin MEASUREMENT VINP_RightTurnSW_flg "" UBYTE SWC_INP_type_CM_boolean_flg 0 0 0.0 1.0 ECU_ADDRESS 0x0000 /* @ECU_Address@VINP_RightTurnSW_flg@ */ /end MEASUREMENT
/begin MEASUREMENT VINP_FrontDoorSW_flg "" UBYTE SWC_INP_type_CM_boolean_flg 0 0 0.0 1.0 ECU_ADDRESS 0x0000 /* @ECU_Address@VINP_FrontDoorSW_flg@ */ /end MEASUREMENT
/begin MEASUREMENT VINP_MidDoorSW_flg "" UBYTE SWC_INP_type_CM_boolean_flg 0 0 0.0 1.0 ECU_ADDRESS 0x0000 /* @ECU_Address@VINP_MidDoorSW_flg@ */ /end MEASUREMENT
/begin MEASUREMENT VINP_OSDoorSwOpen_flg "" UBYTE SWC_INP_type_CM_boolean_flg 0 0 0.0 1.0 ECU_ADDRESS 0x0000 /* @ECU_Address@VINP_OSDoorSwOpen_flg@ */ /end MEASUREMENT
/begin MEASUREMENT VINP_HazardSW_flg "" UBYTE SWC_INP_type_CM_boolean_flg 0 0 0.0 1.0 ECU_ADDRESS 0x0000 /* @ECU_Address@VINP_HazardSW_flg@ */ /end MEASUREMENT
/begin MEASUREMENT VINP_BrakeLampSW_flg "" UBYTE SWC_INP_type_CM_boolean_flg 0 0 0.0 1.0 ECU_ADDRESS 0x0000 /* @ECU_Address@VINP_BrakeLampSW_flg@ */ /end MEASUREMENT
/begin MEASUREMENT VINP_TrunkHanSW_flg "" UBYTE SWC_INP_type_CM_boolean_flg 0 0 0.0 1.0 ECU_ADDRESS 0x0000 /* @ECU_Address@VINP_TrunkHanSW_flg@ */ /end MEASUREMENT
/begin MEASUREMENT VINP_SeatSW_flg "" UBYTE SWC_INP_type_CM_boolean_flg 0 0 0.0 1.0 ECU_ADDRESS 0x0000 /* @ECU_Address@VINP_SeatSW_flg@ */ /end MEASUREMENT
/begin MEASUREMENT VINP_AccelPedal1VolValid_flg "" UBYTE SWC_INP_type_CM_boolean_flg 0 0 0.0 1.0 ECU_ADDRESS 0x0000 /* @ECU_Address@VINP_AccelPedal1VolValid_flg@ */ /end MEASUREMENT
/begin MEASUREMENT VINP_AccelPedal2VolValid_flg "" UBYTE SWC_INP_type_CM_boolean_flg 0 0 0.0 1.0 ECU_ADDRESS 0x0000 /* @ECU_Address@VINP_AccelPedal2VolValid_flg@ */ /end MEASUREMENT
/begin MEASUREMENT VINP_CrashSignalGPIO_flg "" UBYTE SWC_INP_type_CM_boolean_flg 0 0 0.0 1.0 ECU_ADDRESS 0x0000 /* @ECU_Address@VINP_CrashSignalGPIO_flg@ */ /end MEASUREMENT
/begin MEASUREMENT VINP_USSStaRMR_flg "" UBYTE SWC_INP_type_CM_boolean_flg 0 0 0.0 1.0 ECU_ADDRESS 0x0000 /* @ECU_Address@VINP_USSStaRMR_flg@ */ /end MEASUREMENT
/begin MEASUREMENT VINP_USSStaRML_flg "" UBYTE SWC_INP_type_CM_boolean_flg 0 0 0.0 1.0 ECU_ADDRESS 0x0000 /* @ECU_Address@VINP_USSStaRML_flg@ */ /end MEASUREMENT
/begin MEASUREMENT VINP_USSStaRLR_flg "" UBYTE SWC_INP_type_CM_boolean_flg 0 0 0.0 1.0 ECU_ADDRESS 0x0000 /* @ECU_Address@VINP_USSStaRLR_flg@ */ /end MEASUREMENT
/begin MEASUREMENT VINP_USSStaRLL_flg "" UBYTE SWC_INP_type_CM_boolean_flg 0 0 0.0 1.0 ECU_ADDRESS 0x0000 /* @ECU_Address@VINP_USSStaRLL_flg@ */ /end MEASUREMENT
/begin MEASUREMENT VINP_USSStaRCR_flg "" UBYTE SWC_INP_type_CM_boolean_flg 0 0 0.0 1.0 ECU_ADDRESS 0x0000 /* @ECU_Address@VINP_USSStaRCR_flg@ */ /end MEASUREMENT
/begin MEASUREMENT VINP_USSStaRCL_flg "" UBYTE SWC_INP_type_CM_boolean_flg 0 0 0.0 1.0 ECU_ADDRESS 0x0000 /* @ECU_Address@VINP_USSStaRCL_flg@ */ /end MEASUREMENT
/begin MEASUREMENT VINP_USSStaFMR_flg "" UBYTE SWC_INP_type_CM_boolean_flg 0 0 0.0 1.0 ECU_ADDRESS 0x0000 /* @ECU_Address@VINP_USSStaFMR_flg@ */ /end MEASUREMENT
/begin MEASUREMENT VINP_USSStaFML_flg "" UBYTE SWC_INP_type_CM_boolean_flg 0 0 0.0 1.0 ECU_ADDRESS 0x0000 /* @ECU_Address@VINP_USSStaFML_flg@ */ /end MEASUREMENT
/begin MEASUREMENT VINP_USSStaFLR_flg "" UBYTE SWC_INP_type_CM_boolean_flg 0 0 0.0 1.0 ECU_ADDRESS 0x0000 /* @ECU_Address@VINP_USSStaFLR_flg@ */ /end MEASUREMENT
/begin MEASUREMENT VINP_USSStaFLL_flg "" UBYTE SWC_INP_type_CM_boolean_flg 0 0 0.0 1.0 ECU_ADDRESS 0x0000 /* @ECU_Address@VINP_USSStaFLL_flg@ */ /end MEASUREMENT
/begin MEASUREMENT VINP_USSStaFCR_flg "" UBYTE SWC_INP_type_CM_boolean_flg 0 0 0.0 1.0 ECU_ADDRESS 0x0000 /* @ECU_Address@VINP_USSStaFCR_flg@ */ /end MEASUREMENT
/begin MEASUREMENT VINP_USSStaFCL_flg "" UBYTE SWC_INP_type_CM_boolean_flg 0 0 0.0 1.0 ECU_ADDRESS 0x0000 /* @ECU_Address@VINP_USSStaFCL_flg@ */ /end MEASUREMENT
/begin MEASUREMENT VINP_StaFSya_flg "" UBYTE SWC_INP_type_CM_boolean_flg 0 0 0.0 1.0 ECU_ADDRESS 0x0000 /* @ECU_Address@VINP_StaFSya_flg@ */ /end MEASUREMENT
/begin MEASUREMENT VINP_APSVRqEPASCtrl_flg "" UBYTE SWC_INP_type_CM_boolean_flg 0 0 0.0 1.0 ECU_ADDRESS 0x0000 /* @ECU_Address@VINP_APSVRqEPASCtrl_flg@ */ /end MEASUREMENT
/begin MEASUREMENT VINP_APSRqEPASCtrl_flg "" UBYTE SWC_INP_type_CM_boolean_flg 0 0 0.0 1.0 ECU_ADDRESS 0x0000 /* @ECU_Address@VINP_APSRqEPASCtrl_flg@ */ /end MEASUREMENT
/begin MEASUREMENT VINP_APSDecReqA_flg "" UBYTE SWC_INP_type_CM_boolean_flg 0 0 0.0 1.0 ECU_ADDRESS 0x0000 /* @ECU_Address@VINP_APSDecReqA_flg@ */ /end MEASUREMENT
/begin MEASUREMENT VINP_APSVMCReqA_flg "" UBYTE SWC_INP_type_CM_boolean_flg 0 0 0.0 1.0 ECU_ADDRESS 0x0000 /* @ECU_Address@VINP_APSVMCReqA_flg@ */ /end MEASUREMENT
/begin MEASUREMENT VINP_CAASVMCReqA_flg "" UBYTE SWC_INP_type_CM_boolean_flg 0 0 0.0 1.0 ECU_ADDRESS 0x0000 /* @ECU_Address@VINP_CAASVMCReqA_flg@ */ /end MEASUREMENT
/begin MEASUREMENT VINP_RAPSBCMLockReq_flg "" UBYTE SWC_INP_type_CM_boolean_flg 0 0 0.0 1.0 ECU_ADDRESS 0x0000 /* @ECU_Address@VINP_RAPSBCMLockReq_flg@ */ /end MEASUREMENT
/begin MEASUREMENT VINP_RAPSErrLv1_flg "" UBYTE SWC_INP_type_CM_boolean_flg 0 0 0.0 1.0 ECU_ADDRESS 0x0000 /* @ECU_Address@VINP_RAPSErrLv1_flg@ */ /end MEASUREMENT
/begin MEASUREMENT VINP_DKCDecPKeyMiss_flg "" UBYTE SWC_INP_type_CM_boolean_flg 0 0 0.0 1.0 ECU_ADDRESS 0x0000 /* @ECU_Address@VINP_DKCDecPKeyMiss_flg@ */ /end MEASUREMENT
/begin MEASUREMENT VINP_DKCDecPUIDLowPower_flg "" UBYTE SWC_INP_type_CM_boolean_flg 0 0 0.0 1.0 ECU_ADDRESS 0x0000 /* @ECU_Address@VINP_DKCDecPUIDLowPower_flg@ */ /end MEASUREMENT
/begin MEASUREMENT VINP_DKCDecryptionFail_flg "" UBYTE SWC_INP_type_CM_boolean_flg 0 0 0.0 1.0 ECU_ADDRESS 0x0000 /* @ECU_Address@VINP_DKCDecryptionFail_flg@ */ /end MEASUREMENT
/begin MEASUREMENT VINP_ChkStorge_flg "" UBYTE SWC_INP_type_CM_boolean_flg 0 0 0.0 1.0 ECU_ADDRESS 0x0000 /* @ECU_Address@VINP_ChkStorge_flg@ */ /end MEASUREMENT
/begin MEASUREMENT VINP_FlashLFSensorFail_flg "" UBYTE SWC_INP_type_CM_boolean_flg 0 0 0.0 1.0 ECU_ADDRESS 0x0000 /* @ECU_Address@VINP_FlashLFSensorFail_flg@ */ /end MEASUREMENT
/begin MEASUREMENT VINP_FlashRFSensorFail_flg "" UBYTE SWC_INP_type_CM_boolean_flg 0 0 0.0 1.0 ECU_ADDRESS 0x0000 /* @ECU_Address@VINP_FlashRFSensorFail_flg@ */ /end MEASUREMENT
/begin MEASUREMENT VINP_FlashLRSensorFail_flg "" UBYTE SWC_INP_type_CM_boolean_flg 0 0 0.0 1.0 ECU_ADDRESS 0x0000 /* @ECU_Address@VINP_FlashLRSensorFail_flg@ */ /end MEASUREMENT
/begin MEASUREMENT VINP_FlashRRSensorFail_flg "" UBYTE SWC_INP_type_CM_boolean_flg 0 0 0.0 1.0 ECU_ADDRESS 0x0000 /* @ECU_Address@VINP_FlashRRSensorFail_flg@ */ /end MEASUREMENT
/begin MEASUREMENT VINP_FlashunlearnSfali_flg "" UBYTE SWC_INP_type_CM_boolean_flg 0 0 0.0 1.0 ECU_ADDRESS 0x0000 /* @ECU_Address@VINP_FlashunlearnSfali_flg@ */ /end MEASUREMENT
/begin MEASUREMENT VINP_Prepresstemptrust_flg "" UBYTE SWC_INP_type_CM_boolean_flg 0 0 0.0 1.0 ECU_ADDRESS 0x0000 /* @ECU_Address@VINP_Prepresstemptrust_flg@ */ /end MEASUREMENT
/begin MEASUREMENT VINP_TPMSTrigger_flg "" UBYTE SWC_INP_type_CM_boolean_flg 0 0 0.0 1.0 ECU_ADDRESS 0x0000 /* @ECU_Address@VINP_TPMSTrigger_flg@ */ /end MEASUREMENT
/begin COMPU_METHOD SWC_INP_type_CM_single_C "Q = V" RAT_FUNC "%8.6" "C" COEFFS 0 1 0 0 0 1 /end COMPU_METHOD
/begin COMPU_METHOD SWC_INP_type_CM_single_Deg "Q = V" RAT_FUNC "%8.6" "Deg" COEFFS 0 1 0 0 0 1 /end COMPU_METHOD
/begin COMPU_METHOD SWC_INP_type_CM_single_mps2 "Q = V" RAT_FUNC "%8.6" "mps2" COEFFS 0 1 0 0 0 1 /end COMPU_METHOD
/begin COMPU_METHOD SWC_INP_type_CM_single_pct "Q = V" RAT_FUNC "%8.6" "pct" COEFFS 0 1 0 0 0 1 /end COMPU_METHOD
/begin COMPU_METHOD SWC_INP_type_CM_single_kph "Q = V" RAT_FUNC "%8.6" "kph" COEFFS 0 1 0 0 0 1 /end COMPU_METHOD
/begin COMPU_METHOD SWC_INP_type_CM_single_V "Q = V" RAT_FUNC "%8.6" "V" COEFFS 0 1 0 0 0 1 /end COMPU_METHOD
/begin COMPU_METHOD SWC_INP_type_CM_uint32_raw "Q = V" RAT_FUNC "%10.0" "raw" COEFFS 0 1 0 0 0 1 /end COMPU_METHOD
/begin COMPU_METHOD SWC_INP_type_CM_uint16_cm "Q = V" RAT_FUNC "%5.0" "cm" COEFFS 0 1 0 0 0 1 /end COMPU_METHOD
/begin COMPU_METHOD SWC_INP_type_CM_boolean_flg "Q = V" RAT_FUNC "%1.0" "flg" COEFFS 0 1 0 0 0 1 /end COMPU_METHOD
/begin COMPU_METHOD SWC_INP_type_CM_uint8_enum "Q = V" RAT_FUNC "%3.0" "enum" COEFFS 0 1 0 0 0 1 /end COMPU_METHOD
/begin COMPU_METHOD SWC_INP_type_CM_uint8_cnt "Q = V" RAT_FUNC "%3.0" "cnt" COEFFS 0 1 0 0 0 1 /end COMPU_METHOD
/begin COMPU_METHOD SWC_INP_type_CM_uint8_cm "Q = V" RAT_FUNC "%3.0" "cm" COEFFS 0 1 0 0 0 1 /end COMPU_METHOD
/begin COMPU_METHOD SWC_INP_type_CM_uint8_raw "Q = V" RAT_FUNC "%3.0" "raw" COEFFS 0 1 0 0 0 1 /end COMPU_METHOD
/begin COMPU_METHOD SWC_INP_type_CM_uint32 "Q = V" RAT_FUNC "%10.0" "" COEFFS 0 1 0 0 0 1 /end COMPU_METHOD
/begin COMPU_METHOD SWC_INP_type_CM_uint32_raw32 "Q = V" RAT_FUNC "%10.0" "raw32" COEFFS 0 1 0 0 0 1 /end COMPU_METHOD
/begin COMPU_METHOD SWC_INP_type_CM_uint32_sec "Q = V" RAT_FUNC "%10.0" "sec" COEFFS 0 1 0 0 0 1 /end COMPU_METHOD
/begin COMPU_METHOD SWC_INP_type_CM_uint32_kphsqr "Q = V" RAT_FUNC "%10.0" "kphsqr" COEFFS 0 1 0 0 0 1 /end COMPU_METHOD
/begin COMPU_METHOD SWC_INP_type_CM_uint32_cnt "Q = V" RAT_FUNC "%10.0" "cnt" COEFFS 0 1 0 0 0 1 /end COMPU_METHOD
/begin COMPU_METHOD SWC_INP_type_CM_single_s "Q = V" RAT_FUNC "%8.6" "s" COEFFS 0 1 0 0 0 1 /end COMPU_METHOD
/begin COMPU_METHOD SWC_INP_type_CM_single_mA "Q = V" RAT_FUNC "%8.6" "mA" COEFFS 0 1 0 0 0 1 /end COMPU_METHOD
/begin COMPU_METHOD SWC_INP_type_CM_single_km "Q = V" RAT_FUNC "%8.6" "km" COEFFS 0 1 0 0 0 1 /end COMPU_METHOD
/begin COMPU_METHOD SWC_INP_type_CM_single_Ahr "Q = V" RAT_FUNC "%8.6" "Ahr" COEFFS 0 1 0 0 0 1 /end COMPU_METHOD
/begin COMPU_METHOD SWC_INP_type_CM_single_kWh "Q = V" RAT_FUNC "%8.6" "kWh" COEFFS 0 1 0 0 0 1 /end COMPU_METHOD
/begin COMPU_METHOD SWC_INP_type_CM_uint16 "Q = V" RAT_FUNC "%5.0" "" COEFFS 0 1 0 0 0 1 /end COMPU_METHOD
/begin COMPU_METHOD SWC_INP_type_CM_uint16_cnt "Q = V" RAT_FUNC "%5.0" "cnt" COEFFS 0 1 0 0 0 1 /end COMPU_METHOD
/begin COMPU_METHOD SWC_INP_type_CM_uint16_min "Q = V" RAT_FUNC "%5.0" "min" COEFFS 0 1 0 0 0 1 /end COMPU_METHOD
/begin COMPU_METHOD SWC_INP_type_CM_uint8 "Q = V" RAT_FUNC "%3.0" "" COEFFS 0 1 0 0 0 1 /end COMPU_METHOD
/begin COMPU_METHOD SWC_INP_type_CM_uint8_raw1 "Q = V" RAT_FUNC "%3.0" "raw1" COEFFS 0 1 0 0 0 1 /end COMPU_METHOD
/begin COMPU_METHOD SWC_INP_type_CM_uint8_raw2 "Q = V" RAT_FUNC "%3.0" "raw2" COEFFS 0 1 0 0 0 1 /end COMPU_METHOD
/begin COMPU_METHOD SWC_INP_type_CM_uint8_raw3 "Q = V" RAT_FUNC "%3.0" "raw3" COEFFS 0 1 0 0 0 1 /end COMPU_METHOD
/begin COMPU_METHOD SWC_INP_type_CM_uint8_raw4 "Q = V" RAT_FUNC "%3.0" "raw4" COEFFS 0 1 0 0 0 1 /end COMPU_METHOD
/begin COMPU_METHOD SWC_INP_type_CM_uint8_raw5 "Q = V" RAT_FUNC "%3.0" "raw5" COEFFS 0 1 0 0 0 1 /end COMPU_METHOD
/begin COMPU_METHOD SWC_INP_type_CM_uint8_raw6 "Q = V" RAT_FUNC "%3.0" "raw6" COEFFS 0 1 0 0 0 1 /end COMPU_METHOD
/begin COMPU_METHOD SWC_INP_type_CM_uint8_raw7 "Q = V" RAT_FUNC "%3.0" "raw7" COEFFS 0 1 0 0 0 1 /end COMPU_METHOD
/begin COMPU_METHOD SWC_INP_type_CM_uint8_raw8 "Q = V" RAT_FUNC "%3.0" "raw8" COEFFS 0 1 0 0 0 1 /end COMPU_METHOD
/begin COMPU_METHOD SWC_INP_type_CM_uint8_C "Q = V" RAT_FUNC "%3.0" "C" COEFFS 0 1 0 0 0 1 /end COMPU_METHOD
/begin COMPU_METHOD SWC_INP_type_CM_uint8_pct "Q = V" RAT_FUNC "%3.0" "pct" COEFFS 0 1 0 0 0 1 /end COMPU_METHOD
/begin COMPU_METHOD SWC_INP_type_CM_uint8_s "Q = V" RAT_FUNC "%3.0" "s" COEFFS 0 1 0 0 0 1 /end COMPU_METHOD
/begin GROUP SWC_INP_type "SWC_INP_type" /* Root */ ROOT /begin SUB_GROUP Root_run_SWC_INP_5ms_sys /end SUB_GROUP /end GROUP
/begin GROUP Root_run_SWC_INP_5ms_sys "SWC_INP_type/run_SWC_INP_5ms_sys" /begin SUB_GROUP S2_INP /end SUB_GROUP /end GROUP
/begin GROUP S2_INP "SWC_INP_type/run_SWC_INP_5ms_sys/INP"
 /begin SUB_GROUP S3_APM S3_CAN1 S3_CAN2 S3_CAN3 S3_CAN4 S3_DDM S3_DKC S3_GPIO S3_IMU S3_SYS S3_TPMS /end SUB_GROUP
/end GROUP
/begin GROUP S3_APM "SWC_INP_type/run_SWC_INP_5ms_sys/INP/APM"
 /begin SUB_GROUP S5_Subsystem S5_Subsystem1 S5_Subsystem10 S5_Subsystem11 S5_Subsystem12 S5_Subsystem13 S5_Subsystem14 S5_Subsystem15 S5_Subsystem16 S5_Subsystem17 S5_Subsystem18 S5_Subsystem19 S5_Subsystem2 S5_Subsystem20 S5_Subsystem21 S5_Subsystem22 S5_Subsystem23 S5_Subsystem24 S5_Subsystem25 S5_Subsystem26 S5_Subsystem27 S5_Subsystem28 S5_Subsystem29 S5_Subsystem3 S5_Subsystem30 S5_Subsystem31 S5_Subsystem32 S5_Subsystem33 S5_Subsystem34 S5_Subsystem35 S5_Subsystem36 S5_Subsystem37 S5_Subsystem38 S5_Subsystem39 S5_Subsystem4 S5_Subsystem40 S5_Subsystem41 S5_Subsystem42 S5_Subsystem43 S5_Subsystem44 S5_Subsystem45 S5_Subsystem46 S5_Subsystem47 S5_Subsystem48 S5_Subsystem49 S5_Subsystem5 S5_Subsystem50 S5_Subsystem51 S5_Subsystem52 S5_Subsystem53 S5_Subsystem54 S5_Subsystem55 S5_Subsystem56 S5_Subsystem57 S5_Subsystem6 S5_Subsystem7 S5_Subsystem8 S5_Subsystem9 /end SUB_GROUP
/end GROUP
/begin GROUP S3_CAN1 "SWC_INP_type/run_SWC_INP_5ms_sys/INP/CAN1" /begin SUB_GROUP S6_CommunicationCheck S6_CreateBus S6_SignalCheck /end SUB_GROUP /end GROUP
/begin GROUP S3_CAN2 "SWC_INP_type/run_SWC_INP_5ms_sys/INP/CAN2" /begin SUB_GROUP S7_CommunicationCheck S7_CreateBus S7_SignalCheck /end SUB_GROUP /end GROUP
/begin GROUP S3_CAN3 "SWC_INP_type/run_SWC_INP_5ms_sys/INP/CAN3" /begin SUB_GROUP S8_CommunicationCheck S8_CreateBus S8_SignalCheck /end SUB_GROUP /end GROUP
/begin GROUP S3_CAN4 "SWC_INP_type/run_SWC_INP_5ms_sys/INP/CAN4" /begin SUB_GROUP S9_CommunicationCheck S9_CreateBus S9_SignalCheck /end SUB_GROUP /end GROUP
/begin GROUP S3_DDM "SWC_INP_type/run_SWC_INP_5ms_sys/INP/DDM" /begin SUB_GROUP S10_Subsystem13 /end SUB_GROUP /end GROUP
/begin GROUP S3_DKC "SWC_INP_type/run_SWC_INP_5ms_sys/INP/DKC"
 /begin SUB_GROUP S11_Subsystem1 S11_Subsystem10 S11_Subsystem2 S11_Subsystem3 S11_Subsystem4 S11_Subsystem5 S11_Subsystem6 /end SUB_GROUP
 /begin REF_MEASUREMENT VINP_DKCDecPCommandToBCM_enum VINP_DKCDecPCommandToPTG_enum VINP_DKCDecPDKeyAreaLockUnlock_enum VINP_DKCDecPDKeyAreaPS_enum VINP_DKCDecPDKeyAreaPTG_enum VINP_DKCDecPDKeyWelcome_enum VINP_DKCDecPDkeyShowIVI_enum VINP_DKCDecPKeyMiss_flg VINP_DKCDecPKeyMode_enum VINP_DKCDecPUIDLowPower_flg VINP_DKCDecReVehData_enum VINP_DKCDecRemotePW_enum VINP_DKCDecryptionFail_flg VINP_TimeSNDKCFbk_cnt /end REF_MEASUREMENT
/end GROUP
/begin GROUP S3_GPIO "SWC_INP_type/run_SWC_INP_5ms_sys/INP/GPIO" /begin SUB_GROUP S12_Analog S12_Digital /end SUB_GROUP
 /begin REF_MEASUREMENT VINP_AccelPedal1VolValid_flg VINP_AccelPedal1Vol_V VINP_AccelPedal2VolValid_flg VINP_AccelPedal2Vol_V VINP_AlcoholPass_flg VINP_BmsAplus_flg VINP_BrakeLampSW_flg VINP_BrakeSWGPIO_flg VINP_CrashSignalGPIO_flg VINP_EmergencyExitSW_flg VINP_FrontDoorSW_flg VINP_HWID1_enum VINP_HWID2_enum VINP_HWID3_enum VINP_HWID4_enum VINP_HazardSW_flg VINP_LeftTurnSW_flg VINP_MidDoorSW_flg VINP_OSDoorSwClose_flg VINP_OSDoorSwOpen_flg VINP_PushButton_flg VINP_RightTurnSW_flg VINP_SeatSW_flg VINP_TailgateSW_flg VINP_TrunkHanSW_flg /end REF_MEASUREMENT
/end GROUP
/begin GROUP S3_IMU "SWC_INP_type/run_SWC_INP_5ms_sys/INP/IMU"
 /begin SUB_GROUP S13_Subsystem1 S13_Subsystem10 S13_Subsystem11 S13_Subsystem15 S13_Subsystem2 S13_Subsystem3 S13_Subsystem4 S13_Subsystem5 S13_Subsystem6 S13_Subsystem7 S13_Subsystem8 S13_Subsystem9 /end SUB_GROUP
/end GROUP
/begin GROUP S3_SYS "SWC_INP_type/run_SWC_INP_5ms_sys/INP/SYS"
 /begin SUB_GROUP S14_Subsystem S14_Subsystem1 S14_Subsystem10 S14_Subsystem11 S14_Subsystem12 S14_Subsystem13 S14_Subsystem2 S14_Subsystem3 S14_Subsystem4 S14_Subsystem5 S14_Subsystem6 S14_Subsystem7 S14_Subsystem8 S14_Subsystem9 /end SUB_GROUP
 /begin REF_CHARACTERISTIC KINP_NewNMSpec_flg KINP_SOCDisUsed_flg KINP_SWCType_enum KINP_VehicleType_enum /end REF_CHARACTERISTIC
 /begin REF_MEASUREMENT VINP_APSFunConfig_raw8 VINP_AcoreRebootCmd_flg VINP_AnyNMID_flg VINP_AutoWipHSpdEN_flg VINP_CurrentNmState_enum VINP_DIDGetDynoMode_flg VINP_DiagDRLOFF_flg VINP_DiagFLTC_mA VINP_DiagFMHT_s VINP_DiagFRTC_mA VINP_DiagRLTC_mA VINP_DiagRRTC_mA VINP_DrivetrainSelect_enum VINP_DrivingMode_cnt VINP_EAPS1MINMem_pct VINP_EAPS2MINMem_pct VINP_ECUGen1_cnt VINP_ECUGen2_cnt VINP_FlashACCLevelSta12_enum VINP_FlashACCLevelSta34_enum VINP_FlashACCLevelSta57_enum VINP_FlashACForceOFF_flg VINP_FlashACModeMem_enum VINP_FlashACModeSet457_enum VINP_FlashAPMDoorControlSta_flg VINP_FlashAVGBATTEMPL_C VINP_FlashAVGBATTEMPL_sec VINP_FlashAirIntZ3Sta_enum VINP_FlashAirIntenZone1MSet2_enum VINP_FlashAirIntenZone1MSet3_enum VINP_FlashAirIntenZone1MSet4_enum VINP_FlashAirIntenZone1MSet5_enum VINP_FlashAirIntenZone1MSet7_enum VINP_FlashAirIntenZone1M_enum VINP_FlashAirIntenZone3MSet2_enum VINP_FlashAirIntenZone3MSet3_enum VINP_FlashAirIntenZone3MSet4_enum VINP_FlashAirIntenZone3MSet5_enum VINP_FlashAirIntenZone3MSet7_enum VINP_FlashAmbBrightnessSta1_enum VINP_FlashAmbBrightnessSta2_enum VINP_FlashAmbBrightnessSta3_enum VINP_FlashAmbBrightnessSta4_enum VINP_FlashAmbBrightnessSta5_enum VINP_FlashAmbBrightnessSta7_enum VINP_FlashAmbColorSta1_enum VINP_FlashAmbColorSta2_enum VINP_FlashAmbColorSta3_enum VINP_FlashAmbColorSta4_enum VINP_FlashAmbColorSta5_enum VINP_FlashAmbColorSta7_enum VINP_FlashAmbDimEN_enum VINP_FlashAmbFunEN_enum VINP_FlashAmbLinkDriSta_enum VINP_FlashAmbODAEN_enum VINP_FlashAmbPwrWarnEN_enum VINP_FlashAmbWelEN_enum VINP_FlashAntitheft_enum VINP_FlashAutoLock_enum VINP_FlashAutoUnlock_enum VINP_FlashAutoWipHSpdEN_flg VINP_FlashAvgBattTempOFFL_C VINP_FlashAvgBattTempOFFR_C VINP_FlashAvgBattTempOVCL_C VINP_FlashAvgBattTempOVCR_C VINP_FlashAvgBattTempPSAL_C VINP_FlashAvgBattTempPSAR_C VINP_FlashBattTempPSAL_sec VINP_FlashBattTempPSAR_sec VINP_FlashCCUSyncSts_enum VINP_FlashCLEVentYStaSet2_enum VINP_FlashCLEVentYStaSet3_enum VINP_FlashCLEVentYStaSet4_enum VINP_FlashCLEVentYStaSet5_enum VINP_FlashCLEVentYStaSet7_enum VINP_FlashCLEVentYSta_enum VINP_FlashCLEVentZStaSet2_enum VINP_FlashCLEVentZStaSet3_enum VINP_FlashCLEVentZStaSet4_enum VINP_FlashCLEVentZStaSet5_enum VINP_FlashCLEVentZStaSet7_enum VINP_FlashCLEVentZSta_enum VINP_FlashCLRDIST_km VINP_FlashCLRTIME_min VINP_FlashCLVentEN_enum VINP_FlashCPSAL_sec VINP_FlashCPSAR_sec VINP_FlashCREVentYStaSet2_enum VINP_FlashCREVentYStaSet3_enum VINP_FlashCREVentYStaSet4_enum VINP_FlashCREVentYStaSet5_enum VINP_FlashCREVentYStaSet7_enum VINP_FlashCREVentYSta_enum VINP_FlashCREVentZStaSet2_enum VINP_FlashCREVentZStaSet3_enum VINP_FlashCREVentZStaSet4_enum VINP_FlashCREVentZStaSet5_enum VINP_FlashCREVentZStaSet7_enum VINP_FlashCREVentZSta_enum VINP_FlashCRVentEN_enum VINP_FlashCTDLockSW_flg VINP_FlashCountAlarm_enum VINP_FlashDIDModelVersionChkSum_raw VINP_FlashDIDModelVersion_raw VINP_FlashDrEVentModeStaSet457_enum VINP_FlashDrEVentModeSta_enum VINP_FlashDrEVentYStaSet2_enum VINP_FlashDrEVentYStaSet3_enum VINP_FlashDrEVentYStaSet4_enum VINP_FlashDrEVentYStaSet5_enum VINP_FlashDrEVentYStaSet7_enum VINP_FlashDrEVentYSta_enum VINP_FlashDrEVentZStaSet2_enum VINP_FlashDrEVentZStaSet3_enum VINP_FlashDrEVentZStaSet4_enum VINP_FlashDrEVentZStaSet5_enum VINP_FlashDrEVentZStaSet7_enum VINP_FlashDrEVentZSta_enum VINP_FlashDrVentEN_enum VINP_FlashETMATOEL_kWh VINP_FlashETMATOER_kWh VINP_FlashETMBTOEL_kWh VINP_FlashETMBTOER_kWh VINP_FlashFGSAirIntStaSet457_enum VINP_FlashFGSAirIntSta_enum VINP_FlashFGSChStaSet457_enum VINP_FlashFGSChSta_enum VINP_FlashFGSIONSWSta_enum VINP_FlashFaceM_enum VINP_FlashFace_enum VINP_FlashFollowMeENFun_enum VINP_FlashFootM_enum VINP_FlashFoot_enum VINP_FlashFrost_enum VINP_FlashFuelDoorPos_flg VINP_FlashGECHGOVCACL_kWh VINP_FlashGECHGOVCACR_kWh VINP_FlashGECHGOVCDCL_kWh VINP_FlashGECHGOVCDCR_kWh VINP_FlashHMIKey1Func_enum VINP_FlashHMIKey2Func_enum VINP_FlashHMIKey3Func_enum VINP_FlashHMIKey4Func_enum VINP_FlashHMIKey5Func_enum VINP_FlashHMIKey6Func_enum VINP_FlashHMIKey7Func_enum VINP_FlashHMIKey8Func_enum VINP_FlashHVBNAH_Ahr VINP_FlashHVBNE_kWh VINP_FlashHoodSW_flg VINP_FlashIGNCNTR_cnt VINP_FlashIPSAL_sec VINP_FlashIPSAR_sec VINP_FlashIVIPTGUSStaSW_enum VINP_FlashJugKeepUnLZone_flg VINP_FlashLockSetting_enum VINP_FlashMAXBATTEMPL_C VINP_FlashMFRDNBrightReq_pct VINP_FlashMFSWTri_flg VINP_FlashMILDIST_km VINP_FlashMILTIME_min VINP_FlashMINBATTEMPL_C VINP_FlashMirrorFlodPos_flg VINP_FlashNUMPSATRIPSFLTMEMCLR_cnt VINP_FlashODOMETER_km VINP_FlashOFFL_sec VINP_FlashOFFR_sec VINP_FlashOVCL_sec VINP_FlashOVCR_sec VINP_FlashPKELNumerator_kphsqr VINP_FlashPKERNumerator_kphsqr VINP_FlashPSAL_sec VINP_FlashPSAR_sec VINP_FlashPTGOpenHeight12_enum VINP_FlashPTGOpenHeight34_enum VINP_FlashPTGOpenHeight57_enum VINP_FlashPTGUserHeight1_cnt VINP_FlashPTGUserHeight2_cnt VINP_FlashPTGUserHeight3_cnt VINP_FlashPTGUserHeight4_cnt VINP_FlashPTGUserHeight5_cnt VINP_FlashPTGUserHeight7_cnt VINP_FlashPsEVentModeStaSet457_enum VINP_FlashPsEVentModeSta_enum VINP_FlashPsEVentYStaSet2_enum VINP_FlashPsEVentYStaSet3_enum VINP_FlashPsEVentYStaSet4_enum VINP_FlashPsEVentYStaSet5_enum VINP_FlashPsEVentYStaSet7_enum VINP_FlashPsEVentYSta_enum VINP_FlashPsEVentZStaSet2_enum VINP_FlashPsEVentZStaSet3_enum VINP_FlashPsEVentZStaSet4_enum VINP_FlashPsEVentZStaSet5_enum VINP_FlashPsEVentZStaSet7_enum VINP_FlashPsEVentZSta_enum VINP_FlashPsVentEN_enum VINP_FlashQTYPSATRIPSL_cnt VINP_FlashQTYPSATRIPSR_cnt VINP_FlashRESSCNTDODRNGL_cnt VINP_FlashRESSCNTDODRNGR_cnt VINP_FlashRESSTIMESOCCHGRNGL_s VINP_FlashRESSTIMESOCCHGRNGR_s VINP_FlashRESSTIMESOCOFFRNGL_s VINP_FlashRESSTIMESOCOFFRNGR_s VINP_FlashRESSTIMESOCPSARNGL_s VINP_FlashRESSTIMESOCPSARNGR_s VINP_FlashRESSV2XENNONPSAL_kWh VINP_FlashRESSV2XENNONPSAR_kWh VINP_FlashRecAutoFlg_enum VINP_FlashRegenMode_enum VINP_FlashResetCDEODTR_km VINP_FlashRoomLampMode_enum VINP_FlashSettempZon1Set2_enum VINP_FlashSettempZon1Set3_enum VINP_FlashSettempZon1Set4_enum VINP_FlashSettempZon1Set5_enum VINP_FlashSettempZon1Set7_enum VINP_FlashTEBPSAL_kWh VINP_FlashTEBPSAR_kWh VINP_FlashTGEOVCL_kWh VINP_FlashTGEOVCR_kWh VINP_FlashTNBCPSAL_Ahr VINP_FlashTNBCPSAR_Ahr VINP_FlashTNECPSAL_kWh VINP_FlashTNECPSAR_kWh VINP_FlashTPMModelVersionChkSum_raw VINP_FlashTPMModelVersion_raw VINP_FlashTailgateHDSW_flg VINP_FlashTailgateSW_flg VINP_FlashTurnSwTSet123_enum VINP_FlashTurnSwTSet457_enum VINP_FlashWARMUPS_cnt VINP_FlashWalkInUnLkEN_enum VINP_FlashWalkOutLkEN_enum VINP_FlashWiperFixMode_flg VINP_FlashfUnlockSingle_flg VINP_Flashfdefog_enum VINP_FlashsigRecircSt_enum VINP_FlashsigSetTempZon1St_C VINP_FlashsigSetTempZon2StM_C VINP_ModelYear_cnt VINP_NewNMSpec_flg VINP_NvmProtectSta_flg VINP_PmicBootPath_raw32 VINP_PmicBootReason_enum VINP_RandomnumberY_raw1 VINP_RandomnumberY_raw2 VINP_RandomnumberY_raw3 VINP_RandomnumberY_raw4 VINP_RandomnumberY_raw5 VINP_RandomnumberY_raw6 VINP_RandomnumberY_raw7 VINP_RandomnumberY_raw8 VINP_ReadFlashCorrect_flg VINP_ResetPedalZeroPosReq_enum VINP_SOCDisUsed_flg VINP_SWCType_enum VINP_TireSize_raw8 VINP_USSConfig_raw8 VINP_VehicleType_enum VINP_VinCode_cnt VINP_WipRLSCmdCutEN_flg VINP_WipRLSCmdCutTime_s VINP_WipRLSCmdHoldEN_flg VINP_WipRLSCmdHoldTime_s VINP_WisrBootReason_raw32 VINP_funAuto_flg /end REF_MEASUREMENT
/end GROUP
/begin GROUP S3_TPMS "SWC_INP_type/run_SWC_INP_5ms_sys/INP/TPMS"
 /begin SUB_GROUP S15_Subsystem S15_Subsystem1 S15_Subsystem10 S15_Subsystem11 S15_Subsystem12 S15_Subsystem13 S15_Subsystem14 S15_Subsystem2 S15_Subsystem3 S15_Subsystem4 S15_Subsystem5 S15_Subsystem6 S15_Subsystem7 S15_Subsystem8 S15_Subsystem9 /end SUB_GROUP
 /begin REF_MEASUREMENT VINP_ChkLFID_raw VINP_ChkLRID_raw VINP_ChkRFID_raw VINP_ChkRRID_raw VINP_ChkStorge_flg VINP_FlashLFP20_raw8 VINP_FlashLFPindi_enum VINP_FlashLFSensorFail_flg VINP_FlashLFWheelPSW_raw8 VINP_FlashLFWheelPress_raw8 VINP_FlashLFWheelTemp_C VINP_FlashLRP20_raw8 VINP_FlashLRPindi_enum VINP_FlashLRSensorFail_flg VINP_FlashLRWheelPSW_raw8 VINP_FlashLRWheelPress_raw8 VINP_FlashLRWheelTemp_C VINP_FlashRFP20_raw8 VINP_FlashRFPindi_enum VINP_FlashRFSensorFail_flg VINP_FlashRFWheelPSW_raw8 VINP_FlashRFWheelPress_raw8 VINP_FlashRFWheelTemp_C VINP_FlashRRP20_raw8 VINP_FlashRRPindi_enum VINP_FlashRRSensorFail_flg VINP_FlashRRWheelPSW_raw8 VINP_FlashRRWheelPress_raw8 VINP_FlashRRWheelTemp_C VINP_FlashunlearnSfali_flg VINP_Prepresstemptrust_flg VINP_S1ID_raw VINP_S2ID_raw VINP_S3ID_raw VINP_S4ID_raw VINP_TPMSSensorIDRegSta_enum VINP_TPMSTrigger_flg /end REF_MEASUREMENT
/end GROUP
/begin GROUP S5_Subsystem "SWC_INP_type/run_SWC_INP_5ms_sys/INP/APM/Subsystem" /begin REF_CHARACTERISTIC KINP_PASDRMR_cm_ovrdflg KINP_PASDRMR_cm_ovrdval /end REF_CHARACTERISTIC /begin REF_MEASUREMENT VINP_PASDRMR_cm /end REF_MEASUREMENT /end GROUP
/begin GROUP S5_Subsystem1 "SWC_INP_type/run_SWC_INP_5ms_sys/INP/APM/Subsystem1" /begin REF_CHARACTERISTIC KINP_PASDRML_cm_ovrdflg KINP_PASDRML_cm_ovrdval /end REF_CHARACTERISTIC /begin REF_MEASUREMENT VINP_PASDRML_cm /end REF_MEASUREMENT /end GROUP
/begin GROUP S5_Subsystem10 "SWC_INP_type/run_SWC_INP_5ms_sys/INP/APM/Subsystem10" /begin REF_CHARACTERISTIC KINP_APSDFLR_cm_ovrdflg KINP_APSDFLR_cm_ovrdval /end REF_CHARACTERISTIC /begin REF_MEASUREMENT VINP_APSDFLR_cm /end REF_MEASUREMENT /end GROUP
/begin GROUP S5_Subsystem11 "SWC_INP_type/run_SWC_INP_5ms_sys/INP/APM/Subsystem11" /begin REF_CHARACTERISTIC KINP_APSDFLL_cm_ovrdflg KINP_APSDFLL_cm_ovrdval /end REF_CHARACTERISTIC /begin REF_MEASUREMENT VINP_APSDFLL_cm /end REF_MEASUREMENT /end GROUP
/begin GROUP S5_Subsystem12 "SWC_INP_type/run_SWC_INP_5ms_sys/INP/APM/Subsystem12" /begin REF_CHARACTERISTIC KINP_PASAFCL_enum_ovrdflg KINP_PASAFCL_enum_ovrdval /end REF_CHARACTERISTIC /begin REF_MEASUREMENT VINP_PASAFCL_enum /end REF_MEASUREMENT /end GROUP
/begin GROUP S5_Subsystem13 "SWC_INP_type/run_SWC_INP_5ms_sys/INP/APM/Subsystem13" /begin REF_CHARACTERISTIC KINP_PASARMR_enum_ovrdflg KINP_PASARMR_enum_ovrdval /end REF_CHARACTERISTIC /begin REF_MEASUREMENT VINP_PASARMR_enum /end REF_MEASUREMENT /end GROUP
/begin GROUP S5_Subsystem14 "SWC_INP_type/run_SWC_INP_5ms_sys/INP/APM/Subsystem14" /begin REF_CHARACTERISTIC KINP_PASARML_enum_ovrdflg KINP_PASARML_enum_ovrdval /end REF_CHARACTERISTIC /begin REF_MEASUREMENT VINP_PASARML_enum /end REF_MEASUREMENT /end GROUP
/begin GROUP S5_Subsystem15 "SWC_INP_type/run_SWC_INP_5ms_sys/INP/APM/Subsystem15" /begin REF_CHARACTERISTIC KINP_PASARCR_enum_ovrdflg KINP_PASARCR_enum_ovrdval /end REF_CHARACTERISTIC /begin REF_MEASUREMENT VINP_PASARCR_enum /end REF_MEASUREMENT /end GROUP
/begin GROUP S5_Subsystem16 "SWC_INP_type/run_SWC_INP_5ms_sys/INP/APM/Subsystem16" /begin REF_CHARACTERISTIC KINP_PASARCL_enum_ovrdflg KINP_PASARCL_enum_ovrdval /end REF_CHARACTERISTIC /begin REF_MEASUREMENT VINP_PASARCL_enum /end REF_MEASUREMENT /end GROUP
/begin GROUP S5_Subsystem17 "SWC_INP_type/run_SWC_INP_5ms_sys/INP/APM/Subsystem17" /begin REF_CHARACTERISTIC KINP_PASAFMR_enum_ovrdflg KINP_PASAFMR_enum_ovrdval /end REF_CHARACTERISTIC /begin REF_MEASUREMENT VINP_PASAFMR_enum /end REF_MEASUREMENT /end GROUP
/begin GROUP S5_Subsystem18 "SWC_INP_type/run_SWC_INP_5ms_sys/INP/APM/Subsystem18" /begin REF_CHARACTERISTIC KINP_PASAFML_enum_ovrdflg KINP_PASAFML_enum_ovrdval /end REF_CHARACTERISTIC /begin REF_MEASUREMENT VINP_PASAFML_enum /end REF_MEASUREMENT /end GROUP
/begin GROUP S5_Subsystem19 "SWC_INP_type/run_SWC_INP_5ms_sys/INP/APM/Subsystem19" /begin REF_CHARACTERISTIC KINP_PASAFCR_enum_ovrdflg KINP_PASAFCR_enum_ovrdval /end REF_CHARACTERISTIC /begin REF_MEASUREMENT VINP_PASAFCR_enum /end REF_MEASUREMENT /end GROUP
/begin GROUP S5_Subsystem2 "SWC_INP_type/run_SWC_INP_5ms_sys/INP/APM/Subsystem2" /begin REF_CHARACTERISTIC KINP_PASDRCR_cm_ovrdflg KINP_PASDRCR_cm_ovrdval /end REF_CHARACTERISTIC /begin REF_MEASUREMENT VINP_PASDRCR_cm /end REF_MEASUREMENT /end GROUP
/begin GROUP S5_Subsystem20 "SWC_INP_type/run_SWC_INP_5ms_sys/INP/APM/Subsystem20" /begin REF_CHARACTERISTIC KINP_USSStaRMR_flg_ovrdflg KINP_USSStaRMR_flg_ovrdval /end REF_CHARACTERISTIC /begin REF_MEASUREMENT VINP_USSStaRMR_flg /end REF_MEASUREMENT /end GROUP
/begin GROUP S5_Subsystem21 "SWC_INP_type/run_SWC_INP_5ms_sys/INP/APM/Subsystem21" /begin REF_CHARACTERISTIC KINP_USSStaRML_flg_ovrdflg KINP_USSStaRML_flg_ovrdval /end REF_CHARACTERISTIC /begin REF_MEASUREMENT VINP_USSStaRML_flg /end REF_MEASUREMENT /end GROUP
/begin GROUP S5_Subsystem22 "SWC_INP_type/run_SWC_INP_5ms_sys/INP/APM/Subsystem22" /begin REF_CHARACTERISTIC KINP_USSStaRLR_flg_ovrdflg KINP_USSStaRLR_flg_ovrdval /end REF_CHARACTERISTIC /begin REF_MEASUREMENT VINP_USSStaRLR_flg /end REF_MEASUREMENT /end GROUP
/begin GROUP S5_Subsystem23 "SWC_INP_type/run_SWC_INP_5ms_sys/INP/APM/Subsystem23" /begin REF_CHARACTERISTIC KINP_USSStaRLL_flg_ovrdflg KINP_USSStaRLL_flg_ovrdval /end REF_CHARACTERISTIC /begin REF_MEASUREMENT VINP_USSStaRLL_flg /end REF_MEASUREMENT /end GROUP
/begin GROUP S5_Subsystem24 "SWC_INP_type/run_SWC_INP_5ms_sys/INP/APM/Subsystem24" /begin REF_CHARACTERISTIC KINP_USSStaRCR_flg_ovrdflg KINP_USSStaRCR_flg_ovrdval /end REF_CHARACTERISTIC /begin REF_MEASUREMENT VINP_USSStaRCR_flg /end REF_MEASUREMENT /end GROUP
/begin GROUP S5_Subsystem25 "SWC_INP_type/run_SWC_INP_5ms_sys/INP/APM/Subsystem25" /begin REF_CHARACTERISTIC KINP_USSStaRCL_flg_ovrdflg KINP_USSStaRCL_flg_ovrdval /end REF_CHARACTERISTIC /begin REF_MEASUREMENT VINP_USSStaRCL_flg /end REF_MEASUREMENT /end GROUP
/begin GROUP S5_Subsystem26 "SWC_INP_type/run_SWC_INP_5ms_sys/INP/APM/Subsystem26" /begin REF_CHARACTERISTIC KINP_USSStaFMR_flg_ovrdflg KINP_USSStaFMR_flg_ovrdval /end REF_CHARACTERISTIC /begin REF_MEASUREMENT VINP_USSStaFMR_flg /end REF_MEASUREMENT /end GROUP
/begin GROUP S5_Subsystem27 "SWC_INP_type/run_SWC_INP_5ms_sys/INP/APM/Subsystem27" /begin REF_CHARACTERISTIC KINP_USSStaFML_flg_ovrdflg KINP_USSStaFML_flg_ovrdval /end REF_CHARACTERISTIC /begin REF_MEASUREMENT VINP_USSStaFML_flg /end REF_MEASUREMENT /end GROUP
/begin GROUP S5_Subsystem28 "SWC_INP_type/run_SWC_INP_5ms_sys/INP/APM/Subsystem28" /begin REF_CHARACTERISTIC KINP_USSStaFLR_flg_ovrdflg KINP_USSStaFLR_flg_ovrdval /end REF_CHARACTERISTIC /begin REF_MEASUREMENT VINP_USSStaFLR_flg /end REF_MEASUREMENT /end GROUP
/begin GROUP S5_Subsystem29 "SWC_INP_type/run_SWC_INP_5ms_sys/INP/APM/Subsystem29" /begin REF_CHARACTERISTIC KINP_USSStaFLL_flg_ovrdflg KINP_USSStaFLL_flg_ovrdval /end REF_CHARACTERISTIC /begin REF_MEASUREMENT VINP_USSStaFLL_flg /end REF_MEASUREMENT /end GROUP
/begin GROUP S5_Subsystem3 "SWC_INP_type/run_SWC_INP_5ms_sys/INP/APM/Subsystem3" /begin REF_CHARACTERISTIC KINP_PASDRCL_cm_ovrdflg KINP_PASDRCL_cm_ovrdval /end REF_CHARACTERISTIC /begin REF_MEASUREMENT VINP_PASDRCL_cm /end REF_MEASUREMENT /end GROUP
/begin GROUP S5_Subsystem30 "SWC_INP_type/run_SWC_INP_5ms_sys/INP/APM/Subsystem30" /begin REF_CHARACTERISTIC KINP_USSStaFCR_flg_ovrdflg KINP_USSStaFCR_flg_ovrdval /end REF_CHARACTERISTIC /begin REF_MEASUREMENT VINP_USSStaFCR_flg /end REF_MEASUREMENT /end GROUP
/begin GROUP S5_Subsystem31 "SWC_INP_type/run_SWC_INP_5ms_sys/INP/APM/Subsystem31" /begin REF_CHARACTERISTIC KINP_USSStaFCL_flg_ovrdflg KINP_USSStaFCL_flg_ovrdval /end REF_CHARACTERISTIC /begin REF_MEASUREMENT VINP_USSStaFCL_flg /end REF_MEASUREMENT /end GROUP
/begin GROUP S5_Subsystem32 "SWC_INP_type/run_SWC_INP_5ms_sys/INP/APM/Subsystem32" /begin REF_CHARACTERISTIC KINP_Chime_enum_ovrdflg KINP_Chime_enum_ovrdval /end REF_CHARACTERISTIC /begin REF_MEASUREMENT VINP_Chime_enum /end REF_MEASUREMENT /end GROUP
/begin GROUP S5_Subsystem33 "SWC_INP_type/run_SWC_INP_5ms_sys/INP/APM/Subsystem33" /begin REF_CHARACTERISTIC KINP_SNSRLayout_enum_ovrdflg KINP_SNSRLayout_enum_ovrdval /end REF_CHARACTERISTIC /begin REF_MEASUREMENT VINP_SNSRLayout_enum /end REF_MEASUREMENT /end GROUP
/begin GROUP S5_Subsystem34 "SWC_INP_type/run_SWC_INP_5ms_sys/INP/APM/Subsystem34" /begin REF_CHARACTERISTIC KINP_StaFSya_flg_ovrdflg KINP_StaFSya_flg_ovrdval /end REF_CHARACTERISTIC /begin REF_MEASUREMENT VINP_StaFSya_flg /end REF_MEASUREMENT /end GROUP
/begin GROUP S5_Subsystem35 "SWC_INP_type/run_SWC_INP_5ms_sys/INP/APM/Subsystem35"
 /begin REF_CHARACTERISTIC KINP_ModOperation_enum_ovrdflg KINP_ModOperation_enum_ovrdval /end REF_CHARACTERISTIC
 /begin REF_MEASUREMENT VINP_ModOperation_enum /end REF_MEASUREMENT
/end GROUP
/begin GROUP S5_Subsystem36 "SWC_INP_type/run_SWC_INP_5ms_sys/INP/APM/Subsystem36" /begin REF_CHARACTERISTIC KINP_APSVMCReqA_flg_ovrdval KINP_APSVMCReqA_flg_ovrflg /end REF_CHARACTERISTIC /begin REF_MEASUREMENT VINP_APSVMCReqA_flg /end REF_MEASUREMENT /end GROUP
/begin GROUP S5_Subsystem37 "SWC_INP_type/run_SWC_INP_5ms_sys/INP/APM/Subsystem37"
 /begin REF_CHARACTERISTIC KINP_APSShiftPosnReq_enum_ovrdval KINP_APSShiftPosnReq_enum_ovrflg /end REF_CHARACTERISTIC
 /begin REF_MEASUREMENT VINP_APSShiftPosnReq_enum /end REF_MEASUREMENT
/end GROUP
/begin GROUP S5_Subsystem38 "SWC_INP_type/run_SWC_INP_5ms_sys/INP/APM/Subsystem38" /begin REF_CHARACTERISTIC KINP_APSSpeedCMD_kph_ovrdval KINP_APSSpeedCMD_kph_ovrflg /end REF_CHARACTERISTIC /begin REF_MEASUREMENT VINP_APSSpeedCMD_kph /end REF_MEASUREMENT /end GROUP
/begin GROUP S5_Subsystem39 "SWC_INP_type/run_SWC_INP_5ms_sys/INP/APM/Subsystem39" /begin REF_CHARACTERISTIC KINP_CAASVMCReqA_flg_ovrdval KINP_CAASVMCReqA_flg_ovrflg /end REF_CHARACTERISTIC /begin REF_MEASUREMENT VINP_CAASVMCReqA_flg /end REF_MEASUREMENT /end GROUP
/begin GROUP S5_Subsystem4 "SWC_INP_type/run_SWC_INP_5ms_sys/INP/APM/Subsystem4" /begin REF_CHARACTERISTIC KINP_PASDFMR_cm_ovrdflg KINP_PASDFMR_cm_ovrdval /end REF_CHARACTERISTIC /begin REF_MEASUREMENT VINP_PASDFMR_cm /end REF_MEASUREMENT /end GROUP
/begin GROUP S5_Subsystem40 "SWC_INP_type/run_SWC_INP_5ms_sys/INP/APM/Subsystem40"
 /begin REF_CHARACTERISTIC KINP_APSProgressPCT_pct_ovrdflg KINP_APSProgressPCT_pct_ovrdval /end REF_CHARACTERISTIC
 /begin REF_MEASUREMENT VINP_APSProgressPCT_pct /end REF_MEASUREMENT
/end GROUP
/begin GROUP S5_Subsystem41 "SWC_INP_type/run_SWC_INP_5ms_sys/INP/APM/Subsystem41"
 /begin REF_CHARACTERISTIC KINP_APSRQDisplay_enum_ovrdflg KINP_APSRQDisplay_enum_ovrdval /end REF_CHARACTERISTIC
 /begin REF_MEASUREMENT VINP_APSRQDisplay_enum /end REF_MEASUREMENT
/end GROUP
/begin GROUP S5_Subsystem42 "SWC_INP_type/run_SWC_INP_5ms_sys/INP/APM/Subsystem42" /begin REF_CHARACTERISTIC KINP_APSSWVer_enum_ovrdflg KINP_APSSWVer_enum_ovrdval /end REF_CHARACTERISTIC /begin REF_MEASUREMENT VINP_APSSWVer_enum /end REF_MEASUREMENT /end GROUP
/begin GROUP S5_Subsystem43 "SWC_INP_type/run_SWC_INP_5ms_sys/INP/APM/Subsystem43" /begin REF_CHARACTERISTIC KINP_APSHWVer_enum_ovrdflg KINP_APSHWVer_enum_ovrdval /end REF_CHARACTERISTIC /begin REF_MEASUREMENT VINP_APSHWVer_enum /end REF_MEASUREMENT /end GROUP
/begin GROUP S5_Subsystem44 "SWC_INP_type/run_SWC_INP_5ms_sys/INP/APM/Subsystem44"
 /begin REF_CHARACTERISTIC KINP_APSExitCondition_enum_ovrdflg KINP_APSExitCondition_enum_ovrdval /end REF_CHARACTERISTIC
 /begin REF_MEASUREMENT VINP_APSExitCondition_enum /end REF_MEASUREMENT
/end GROUP
/begin GROUP S5_Subsystem45 "SWC_INP_type/run_SWC_INP_5ms_sys/INP/APM/Subsystem45"
 /begin REF_CHARACTERISTIC KINP_APSAngleTarget_Deg_ovrdflg KINP_APSAngleTarget_Deg_ovrdval /end REF_CHARACTERISTIC
 /begin REF_MEASUREMENT VINP_APSAngleTarget_Deg /end REF_MEASUREMENT
/end GROUP
/begin GROUP S5_Subsystem46 "SWC_INP_type/run_SWC_INP_5ms_sys/INP/APM/Subsystem46"
 /begin REF_CHARACTERISTIC KINP_APSStaSystem_enum_ovrdflg KINP_APSStaSystem_enum_ovrdval /end REF_CHARACTERISTIC
 /begin REF_MEASUREMENT VINP_APSStaSystem_enum /end REF_MEASUREMENT
/end GROUP
/begin GROUP S5_Subsystem47 "SWC_INP_type/run_SWC_INP_5ms_sys/INP/APM/Subsystem47"
 /begin REF_CHARACTERISTIC KINP_APSVRqEPASCtrl_flg_ovrdflg KINP_APSVRqEPASCtrl_flg_ovrdval /end REF_CHARACTERISTIC
 /begin REF_MEASUREMENT VINP_APSVRqEPASCtrl_flg /end REF_MEASUREMENT
/end GROUP
/begin GROUP S5_Subsystem48 "SWC_INP_type/run_SWC_INP_5ms_sys/INP/APM/Subsystem48"
 /begin REF_CHARACTERISTIC KINP_APSRqEPASCtrl_flg_ovrdflg KINP_APSRqEPASCtrl_flg_ovrdval /end REF_CHARACTERISTIC
 /begin REF_MEASUREMENT VINP_APSRqEPASCtrl_flg /end REF_MEASUREMENT
/end GROUP
/begin GROUP S5_Subsystem49 "SWC_INP_type/run_SWC_INP_5ms_sys/INP/APM/Subsystem49" /begin REF_CHARACTERISTIC KINP_APSReq_enum_ovrdflg KINP_APSReq_enum_ovrdval /end REF_CHARACTERISTIC /begin REF_MEASUREMENT VINP_APSReq_enum /end REF_MEASUREMENT /end GROUP
/begin GROUP S5_Subsystem5 "SWC_INP_type/run_SWC_INP_5ms_sys/INP/APM/Subsystem5" /begin REF_CHARACTERISTIC KINP_PASDFML_cm_ovrdflg KINP_PASDFML_cm_ovrdval /end REF_CHARACTERISTIC /begin REF_MEASUREMENT VINP_PASDFML_cm /end REF_MEASUREMENT /end GROUP
/begin GROUP S5_Subsystem50 "SWC_INP_type/run_SWC_INP_5ms_sys/INP/APM/Subsystem50" /begin REF_CHARACTERISTIC KINP_APSDecReq_mps2_ovrdflg KINP_APSDecReq_mps2_ovrdval /end REF_CHARACTERISTIC /begin REF_MEASUREMENT VINP_APSDecReq_mps2 /end REF_MEASUREMENT /end GROUP
/begin GROUP S5_Subsystem51 "SWC_INP_type/run_SWC_INP_5ms_sys/INP/APM/Subsystem51" /begin REF_CHARACTERISTIC KINP_APSDecReqA_flg_ovrdflg KINP_APSDecReqA_flg_ovrdval /end REF_CHARACTERISTIC /begin REF_MEASUREMENT VINP_APSDecReqA_flg /end REF_MEASUREMENT /end GROUP
/begin GROUP S5_Subsystem52 "SWC_INP_type/run_SWC_INP_5ms_sys/INP/APM/Subsystem52" /begin REF_CHARACTERISTIC KINP_CAASSta_enum_ovrdflg KINP_CAASSta_enum_ovrdval /end REF_CHARACTERISTIC /begin REF_MEASUREMENT VINP_CAASSta_enum /end REF_MEASUREMENT /end GROUP
/begin GROUP S5_Subsystem53 "SWC_INP_type/run_SWC_INP_5ms_sys/INP/APM/Subsystem53" /begin REF_CHARACTERISTIC KINP_APSPwrReq_enum_ovrdflg KINP_APSPwrReq_enum_ovrdval /end REF_CHARACTERISTIC /begin REF_MEASUREMENT VINP_APSPwrReq_enum /end REF_MEASUREMENT /end GROUP
/begin GROUP S5_Subsystem54 "SWC_INP_type/run_SWC_INP_5ms_sys/INP/APM/Subsystem54"
 /begin REF_CHARACTERISTIC KINP_RAPSBCMLamp_enum_ovrdflg KINP_RAPSBCMLamp_enum_ovrdval /end REF_CHARACTERISTIC
 /begin REF_MEASUREMENT VINP_RAPSBCMLamp_enum /end REF_MEASUREMENT
/end GROUP
/begin GROUP S5_Subsystem55 "SWC_INP_type/run_SWC_INP_5ms_sys/INP/APM/Subsystem55"
 /begin REF_CHARACTERISTIC KINP_RAPSBCMLockReq_flg_ovrdval KINP_RAPSBCMLockReq_flg_ovrflg /end REF_CHARACTERISTIC
 /begin REF_MEASUREMENT VINP_RAPSBCMLockReq_flg /end REF_MEASUREMENT
/end GROUP
/begin GROUP S5_Subsystem56 "SWC_INP_type/run_SWC_INP_5ms_sys/INP/APM/Subsystem56" /begin REF_CHARACTERISTIC KINP_RAPSErrLv1_flg_ovrdval KINP_RAPSErrLv1_flg_ovrflg /end REF_CHARACTERISTIC /begin REF_MEASUREMENT VINP_RAPSErrLv1_flg /end REF_MEASUREMENT /end GROUP
/begin GROUP S5_Subsystem57 "SWC_INP_type/run_SWC_INP_5ms_sys/INP/APM/Subsystem57"
 /begin REF_CHARACTERISTIC KINP_RAPSErrWarnSta_enum_ovrdflg KINP_RAPSErrWarnSta_enum_ovrdval /end REF_CHARACTERISTIC
 /begin REF_MEASUREMENT VINP_RAPSErrWarnSta_enum /end REF_MEASUREMENT
/end GROUP
/begin GROUP S5_Subsystem6 "SWC_INP_type/run_SWC_INP_5ms_sys/INP/APM/Subsystem6" /begin REF_CHARACTERISTIC KINP_PASDFCR_cm_ovrdflg KINP_PASDFCR_cm_ovrdval /end REF_CHARACTERISTIC /begin REF_MEASUREMENT VINP_PASDFCR_cm /end REF_MEASUREMENT /end GROUP
/begin GROUP S5_Subsystem7 "SWC_INP_type/run_SWC_INP_5ms_sys/INP/APM/Subsystem7" /begin REF_CHARACTERISTIC KINP_PASDFCL_cm_ovrdflg KINP_PASDFCL_cm_ovrdval /end REF_CHARACTERISTIC /begin REF_MEASUREMENT VINP_PASDFCL_cm /end REF_MEASUREMENT /end GROUP
/begin GROUP S5_Subsystem8 "SWC_INP_type/run_SWC_INP_5ms_sys/INP/APM/Subsystem8" /begin REF_CHARACTERISTIC KINP_APSDRLR_cm_ovrdflg KINP_APSDRLR_cm_ovrdval /end REF_CHARACTERISTIC /begin REF_MEASUREMENT VINP_APSDRLR_cm /end REF_MEASUREMENT /end GROUP
/begin GROUP S5_Subsystem9 "SWC_INP_type/run_SWC_INP_5ms_sys/INP/APM/Subsystem9" /begin REF_CHARACTERISTIC KINP_APSDRLL_cm_ovrdflg KINP_APSDRLL_cm_ovrdval /end REF_CHARACTERISTIC /begin REF_MEASUREMENT VINP_APSDRLL_cm /end REF_MEASUREMENT /end GROUP
/begin GROUP S6_CommunicationCheck "SWC_INP_type/run_SWC_INP_5ms_sys/INP/CAN1/CommunicationCheck"
 /begin SUB_GROUP S74_CANMsgInvalidACBTMSC10000 S74_CANMsgInvalidACBTMSC10001 S74_CANMsgInvalidACBTMSC10004 S74_CANMsgInvalidACBTMSC50000 S74_CANMsgInvalidASC1A S74_CANMsgInvalidEBC1 S74_CANMsgInvalidEBC2 S74_CANMsgInvalidEBC5 S74_CANMsgInvalidECASDM1 S74_CANMsgInvalidEMC1EM1 S74_CANMsgInvalidHRW S74_CANMsgInvalidTC1 /end SUB_GROUP
 /begin REF_MEASUREMENT VINP_CANMsgValidACBTMSC10000_flg VINP_CANMsgValidACBTMSC10001_flg VINP_CANMsgValidACBTMSC10004_flg VINP_CANMsgValidACBTMSC50000_flg VINP_CANMsgValidASC1A_flg VINP_CANMsgValidEBC1_flg VINP_CANMsgValidEBC2_flg VINP_CANMsgValidEBC5_flg VINP_CANMsgValidECASDM1_flg VINP_CANMsgValidEMC1EM1_flg VINP_CANMsgValidHRW_flg VINP_CANMsgValidTC1_flg /end REF_MEASUREMENT
/end GROUP
/end MODULE
/end PROJECT
/* (add any file trailer comments here) */ /* EOF SWC_INP_type.a2l */
