[part 1 of 3: package /CAN2/ISignalGroup]
AUTOSAR XML (schema 4-3-0)
package /CAN2/ISignalGroup
  18 x i signal group:
    CAN2_SG_FD2_C200_1: i-signal=[CAN2_FDC_CHA_CACPresWarn_Sta, CAN2_FDC_CHA_CACTempWarn_Sta], system-signal-group=CAN2_SG_FD2_C200_1
    CAN2_SG_FD2_C20_0: i-signal=[CAN2_APS_ExitCondition, CAN2_APS_RQ_Display, CAN2_APS_SW_Ver, CAN2_APS_Sta_System, CAN2_CAAS_Sta, CAN2_FDC_VCU_RegenLimInd_Sta, CAN2_FDC_VCU_RegenMode_Sta, CAN2_FDC_VCU_SmartEcoSpdLim_Sta, CAN2_FDC_VCU_SmartEco_Sta, CAN2_FDC_VMC_SetSpdDisp_Sta, CAN2_FDC_VMC_SetSpd_Sta, CAN2_FDC_VMC_SpdCtrlMode_Sta, CAN2_FDC_VMC_SpdCtrl_Sta, CAN2_PAS_A_FCL, CAN2_PAS_A_FCR, CAN2_PAS_A_FML, CAN2_PAS_A_FMR, CAN2_PAS_A_RCL, CAN2_PAS_A_RCR, CAN2_PAS_A_RML, CAN2_PAS_A_RMR, CAN2_PAS_Chime, CAN2_PAS_D_FCL, CAN2_PAS_D_FCR, CAN2_PAS_D_FML, CAN2_PAS_D_FMR, CAN2_PAS_D_RCL, CAN2_PAS_D_RCR, CAN2_PAS_D_RML, CAN2_PAS_D_RMR, CAN2_PAS_SNSR_Layout, CAN2_USS_Sta_FCL, CAN2_USS_Sta_FCR, CAN2_USS_Sta_FLL, CAN2_USS_Sta_FLR, CAN2_USS_Sta_FML, CAN2_USS_Sta_FMR, CAN2_USS_Sta_RCL, CAN2_USS_Sta_RCR, CAN2_USS_Sta_RLL, CAN2_USS_Sta_RLR, CAN2_USS_Sta_RML, CAN2_USS_Sta_RMR, CAN2_VMC_VCU_CC_Crl_Sta, CAN2_VMC_VCU_MSA_Crl_Sta], system-signal-group=CAN2_SG_FD2_C20_0
    CAN2_SG_FD2_CE100_0: i-signal=[CAN2_APMDoorControlSta, CAN2_ActAPSPosn, CAN2_AllDoorSW, CAN2_AntitheftSta, CAN2_BCM_DoorLock_Sta, CAN2_BrakeLamp, CAN2_CCMSA_SpdWar, CAN2_CCU_ACLampSts, CAN2_CCU_ACMaxLampSts, CAN2_CCU_AutoLampSts, CAN2_CCU_AutoMidLampSts, CAN2_CCU_Dispaly_Request, CAN2_CCU_EcoSts, CAN2_CCU_FrtOnOffLampSts, CAN2_CCU_RrOnOffLampSts, CAN2_CCU_SyncLampSts, CAN2_CC_Crl_Sta, CAN2_CoastDwModeStaChk, CAN2_CreepSW_Sta, CAN2_DISC_ButtSta, CAN2_DISC_Sta, CAN2_DemoModeStaChk, CAN2_Dimmer, CAN2_DimmerEN, CAN2_DisengageP_Fail, CAN2_DoorLockIND, CAN2_DrDoorSW, CAN2_Dr_SeatSta, CAN2_DynoModeStaChk, CAN2_EDriveSysErr_AccPedalErr, CAN2_EDriveSysErr_MCUErr, CAN2_EDriveSysErr_ShifterErr, CAN2_EDriveSysErr_VCUErr, CAN2_EVDriveMode, CAN2_Eng_ActvDmpDisabSta, CAN2_Eng_CoastDwSta, CAN2_Eng_PwrLockSta, CAN2_EngageP_Fail, CAN2_FDC_THCM_CLEVentY_Sta, CAN2_FDC_THCM_CLEVentZ_Sta, CAN2_FDC_THCM_CLVent_Sta, CAN2_FDC_THCM_CREVentY_Sta, CAN2_FDC_THCM_CREVentZ_Sta, CAN2_FDC_THCM_CRVent_Sta, CAN2_FDC_THCM_DrEVentMode_Sta, CAN2_FDC_THCM_DrEVentY_Sta, CAN2_FDC_THCM_DrEVentZ_Sta, CAN2_FDC_THCM_DrVent_Sta, CAN2_FDC_THCM_PsEVentMode_Sta, CAN2_FDC_THCM_PsEVentY_Sta, CAN2_FDC_THCM_PsEVentZ_Sta, CAN2_FDC_THCM_PsVent_Sta, CAN2_FDC_VCU_PwrSaveReq_Cmd, CAN2_FD_ABS_Warning, CAN2_FD_Battery_Charge_Warning, CAN2_FD_EDrive_System, CAN2_FD_EPB_Error, CAN2_FD_HV_Battery_Fault, CAN2_FD_Park_Brake_Warning, CAN2_FD_Power_limitation, CAN2_FD_Steering_Warning, CAN2_FD_TCS_Indicator, CAN2_FD_Telltale_Fail, CAN2_FalseNPrevent_Sta, CAN2_FeatSetSpdFinal_raw32, CAN2_FollowMe, CAN2_Fr_FogLamp, CAN2_HVRlyOpFail, CAN2_HVSysErr_IsolationErr, CAN2_HVSysErr_PackErr, CAN2_HVSysErr_RelayErr, CAN2_H_Beam, CAN2_HazardSW, CAN2_HoodSW, CAN2_LBSD, CAN2_LDRL, CAN2_LTurnLP, CAN2_LVChrgFuncStaChk, CAN2_LVSysErr_PwrOutpErr, CAN2_L_Beam, CAN2_LimphomeAct, CAN2_LockSetting, CAN2_MCUActDisFail, CAN2_MSA_Crl_Sta, CAN2_MeterIndSpeed_raw32, CAN2_PAS_Sta_F_Sys, CAN2_PosLamp, CAN2_PsDoorSW, CAN2_PwrSta, CAN2_PwrStaErr, CAN2_PwrStaONTOIVIPopReq, CAN2_PwrStaONTOIVIPopT, CAN2_RBSD, CAN2_RDRL, CAN2_RLDoorSW, CAN2_RRDoorSW, CAN2_RTurnLP, CAN2_Req_Internal_V2L_Status_Lamp, CAN2_Req_V2LSwOn, CAN2_Req_V2L_IVI_Popup, CAN2_ReverseLamp, CAN2_Rr_Defog, CAN2_Rr_FogLamp, CAN2_ShiftGearPosn, CAN2_SysAllowReadySta, CAN2_SysPwrSta, CAN2_Tailgate_SW, CAN2_VCUBrkSWSta, CAN2_VCUFLDoorSta, CAN2_VCUFRDoorSta, CAN2_VCUHoodSWSta, CAN2_VCURLDoorSta, CAN2_VCURRDoorSta, CAN2_VCUTailgateSWSta, CAN2_VCU_OPDHold, CAN2_VehMalfunLevel, CAN2_XWDMode, CAN2_sigAirIntenZon1St, CAN2_sigAirIntenZon3St, CAN2_sigAmbAirT, CAN2_sigCbnAirT, CAN2_sigDfrstSt, CAN2_sigHvacSt, CAN2_sigRecircSt, CAN2_sigSetTempZon1St, CAN2_sigSetTempZon2St, CAN2_sigSetTempZon3St, CAN2_sigWindDirZon1St, CAN2_sigWindDirZon3St], system-signal-group=CAN2_SG_FD2_CE100_0
    CAN2_SG_FD2_CE100_1: i-signal=[CAN2_FDC_BCM_TgateSWL_Sta, CAN2_FDC_BCM_TgateSWR_Sta, CAN2_FDC_BCM_WelcomeDemo_Sta, CAN2_FDC_VCU_DACStatus_Sta, CAN2_FDC_VCU_TUpASta_Sta], system-signal-group=CAN2_SG_FD2_CE100_1
    CAN2_SG_FD2_CE200_1: i-signal=[CAN2_AutoLTips, CAN2_CWheelTips, CAN2_FDC_BCM_Acc1Sta_Sta, CAN2_FDC_BCM_Acc2Sta_Sta, CAN2_FDC_BCM_Acc3Sta_Sta, CAN2_FDC_BCM_Acc4Sta_Sta, CAN2_FDC_BCM_Acc5Sta_Sta, CAN2_FDC_BCM_AmbBrightSta_Sta, CAN2_FDC_BCM_AmbColorSta_Sta, CAN2_FDC_BCM_AmbDimEN_Sta, CAN2_FDC_BCM_AmbFunEN_Sta, CAN2_FDC_BCM_AmbLinkDriSta_Sta, CAN2_FDC_BCM_AmbODAEN_Sta, CAN2_FDC_BCM_AmbPwrWarnEN_Sta, CAN2_FDC_BCM_AmbWelEN_Sta, CAN2_FDC_BCM_CLWinLockDr_Sta, CAN2_FDC_BCM_FollowMeENFun_Sta, CAN2_FDC_BCM_Key10Acc_Sta, CAN2_FDC_BCM_Key1Acc_Sta, CAN2_FDC_BCM_Key2Acc_Sta, CAN2_FDC_BCM_Key3Acc_Sta, CAN2_FDC_BCM_Key4Acc_Sta, CAN2_FDC_BCM_Key5Acc_Sta, CAN2_FDC_BCM_Key6Acc_Sta, CAN2_FDC_BCM_Key7Acc_Sta, CAN2_FDC_BCM_Key8Acc_Sta, CAN2_FDC_BCM_Key9Acc_Sta, CAN2_FDC_BCM_LockAlarm_Cmd, CAN2_FDC_BCM_PTGOpenHeight_Sta, CAN2_FDC_BCM_RmLpModeENFun_Sta, CAN2_FDC_BCM_TurnSwTSetSta_Sta, CAN2_FDC_BCM_UserNow_Sta, CAN2_FDC_BCM_WalkInUnLkEnFun_Sta, CAN2_FDC_BCM_WalkOutLkEnFun_Sta, CAN2_FDC_DKC_DkeyShowIVI_Sta, CAN2_FDC_DKC_KeyMiss_Sta, CAN2_FDC_DKC_KeyNum_Sta, CAN2_FDC_DKC_KeyType_Sta, CAN2_FDC_DKC_UIDLowPower_Sta, CAN2_FDC_SPTG_SPTGENFun_Sta, CAN2_FDC_THCM_APTCForceOFF_Sta, CAN2_FDC_THCM_APTCWarning_Sta, CAN2_FDC_THCM_AirIntZ3_Sta, CAN2_LFWheelShield, CAN2_LRBatWarn, CAN2_LRPressIndi, CAN2_LRSensorFail, CAN2_LRWheelDebug, CAN2_LRWheelPSW, CAN2_LRWheelPress, CAN2_LRWheelShield, CAN2_LRWheelTemp, CAN2_LRWheelTmpIndi, CAN2_RFWheelShield, CAN2_RRBatWarn, CAN2_RRPressIndi, CAN2_RRSensorFail, CAN2_RRWheelDebug, CAN2_RRWheelPSW, CAN2_RRWheelPress, CAN2_RRWheelShield, CAN2_RRWheelTemp, CAN2_RRWheelTmpIndi, CAN2_T1_TPMS_LFBatWarn, CAN2_T1_TPMS_LFPressIndi, CAN2_T1_TPMS_LFSensorFail, CAN2_T1_TPMS_LFWheelDebug, CAN2_T1_TPMS_LFWheelPSW, CAN2_T1_TPMS_LFWheelPress, CAN2_T1_TPMS_LFWheelTemp, CAN2_T1_TPMS_LFWheelTmpIndi, CAN2_T1_TPMS_RFBatWarn, CAN2_T1_TPMS_RFPressIndi, CAN2_T1_TPMS_RFSensorFail, CAN2_T1_TPMS_RFWheelDebug, CAN2_T1_TPMS_RFWheelPSW, CAN2_T1_TPMS_RFWheelPress, CAN2_T1_TPMS_RFWheelTemp, CAN2_T1_TPMS_RFWheelTmpIndi, CAN2_T1_TPMS_TPMSWarnIndi, CAN2_TPMS_Cali_Butt_Allow, CAN2_TPMS_Res_Butt_Allow], system-signal-group=CAN2_SG_FD2_CE200_1
    CAN2_SG_FD2_OTA1: i-signal=[CAN2_OTA_DL_Available, CAN2_OTA_DL_Speed, CAN2_OTA_Debug_Code, CAN2_OTA_Emergency_Sta, CAN2_OTA_InVehicle_FW, CAN2_OTA_Lock_Req, CAN2_OTA_MDA_Status, CAN2_OTA_Mode, CAN2_OTA_Network_Type, CAN2_OTA_Permit_Agreed, CAN2_OTA_Progress_Rate, CAN2_OTA_Remained_Time, CAN2_OTA_TBOXResetReq, CAN2_OTA_Update_Available, CAN2_OTA_Updating_ECU_8bit], system-signal-group=CAN2_SG_FD2_OTA1
    CAN2_SG_FD2_Version: i-signal=[CAN2_FUSION_HW_Ver1, CAN2_FUSION_HW_Ver2, CAN2_FUSION_HW_Ver3, CAN2_FUSION_SW_CarModel1, CAN2_FUSION_SW_CarModel2, CAN2_FUSION_SW_CarModel3, CAN2_FUSION_SW_Controller1, CAN2_FUSION_SW_Controller2, CAN2_FUSION_SW_Country1, CAN2_FUSION_SW_Country2, CAN2_FUSION_SW_ECUGen1, CAN2_FUSION_SW_ECUGen2, CAN2_FUSION_SW_Major1, CAN2_FUSION_SW_Major2, CAN2_FUSION_SW_Minor1, CAN2_FUSION_SW_Minor2, CAN2_FUSION_SW_Patch1, CAN2_FUSION_SW_Patch2, CAN2_FUSION_SW_SHA1, CAN2_FUSION_SW_SHA2, CAN2_FUSION_SW_SHA3, CAN2_FUSION_SW_SHA4, CAN2_FUSION_SW_SHA5, CAN2_FUSION_SW_SHA6, CAN2_FUSION_SW_SHA7, CAN2_FUSION_SW_SHA8, CAN2_FUSION_SW_Var1, CAN2_FUSION_SW_Var2, CAN2_FUSION_SW_Var3, CAN2_FUSION_SW_Var4, CAN2_FUSION_SW_Var5, CAN2_FUSION_SW_change1, CAN2_FUSION_SW_change2, CAN2_FUSION_SW_dash1, CAN2_FUSION_SW_dash2], system-signal-group=CAN2_SG_FD2_Version
    CAN2_SG_GW2_C10_0: i-signal=[CAN2_ABS_Active, CAN2_ABS_Failed, CAN2_ABS_WnlmpSta, CAN2_AVH_Failed, CAN2_Amber_WnlmpSta, CAN2_BrkSw_Sta, CAN2_HSA_Active, CAN2_HSA_Failed, CAN2_Meter_Ind_VehSpeed, CAN2_Red_WnlmpSta, CAN2_VehSpeed], system-signal-group=CAN2_SG_GW2_C10_0
    CAN2_SG_CGW_GW2_C10_0: i-signal=[CAN2_DCDCAuxCur, CAN2_DCDCAuxVolt, CAN2_DrPMMLVOutPErrLmp, CAN2_DrPMMSysErrLmp, CAN2_DrSCPSysErrLmp, CAN2_FLTurn_Light_Warning, CAN2_FRTurn_Light_Warning, CAN2_FireDetErr, CAN2_FrPMMLimpHomeActReq, CAN2_HVBattCurr, CAN2_HVBattErr, CAN2_HVBattVolt, CAN2_LADB_Hibeam_Indication, CAN2_LADB_Operation_Status, CAN2_LADB_Warning, CAN2_LAHB_Warning, CAN2_LDRL_Warning, CAN2_LLB_Warning, CAN2_Lposition_Lamp_Warning, CAN2_RADB_Hibeam_Indication, CAN2_RADB_Operation_Status, CAN2_RADB_Warning, CAN2_RAHB_Warning, CAN2_RDRL_Warning, CAN2_RLB_Warning, CAN2_Rposition_Lamp_Warning], system-signal-group=CAN2_SG_CGW_GW2_C10_0
    CAN2_SG_GW2_CE1000_0: i-signal=[CAN2_ACChrgCurrDis, CAN2_Charge_Percent_Set, CAN2_HVBChrgPwr, CAN2_HVBattSOC, CAN2_HVBattSOCDis, CAN2_RemainChrgTime, CAN2_Rr_MCU3_HW_Ver, CAN2_Rr_MCU3_HW_Ver_Nidec, CAN2_Rr_MCU3_SW_Ver, CAN2_Rr_MCU3_SW_Ver_Nidec, CAN2_TBOX_HW_VER, CAN2_TBOX_SW_VER, CAN2_TimeSyncFromBS_Day, CAN2_TimeSyncFromBS_Hour, CAN2_TimeSyncFromBS_Minute, CAN2_TimeSyncFromBS_Month, CAN2_TimeSyncFromBS_Second, CAN2_TimeSyncFromBS_Year], system-signal-group=CAN2_SG_GW2_CE1000_0
    CAN2_SG_GW2_CE100_0: i-signal=[CAN2_COMP_ActualPwr, CAN2_CbnPreACEnaReq, CAN2_ChargeInletLockSta, CAN2_ChrgPlugSta, CAN2_DKC_KeyNum_Sta, CAN2_DKC_KeyType_Sta, CAN2_DisChrgPlugErr, CAN2_ExtChrgSta, CAN2_FDC_BCM_DimSw, CAN2_FDC_BCM_FWipSw_Sta, CAN2_FDC_BCM_TurnSw_Sta, CAN2_FrntPTCLeActHeatPwr, CAN2_FrntPTCRearLeActHeatPwr, CAN2_FrntPTCRearRiActHeatPwr, CAN2_FrntPTCRiActHeatPwr, CAN2_HVBChrgErr, CAN2_HVBContactorSta, CAN2_HVBMTempMax, CAN2_HVBOvrTempErr, CAN2_HVBOvrTempWarn, CAN2_MainRlyNegSta, CAN2_MainRlyPosSta, CAN2_OBCACCSLimit, CAN2_OBCACCurrInf, CAN2_OBCACVoltInf, CAN2_OBCFaultSta, CAN2_OBC_AC_Cur_Lim, CAN2_PTCActuPwrHSC6, CAN2_P_Dkey_Show_IVI, CAN2_P_KeyMiss, CAN2_P_UID_LowPower, CAN2_RLS_Lamp_Sta, CAN2_Re_Radio, CAN2_SWC_ACC_Sta, CAN2_SWC_Down_Sta, CAN2_SWC_LKA_Sta, CAN2_SWC_Left_Sta, CAN2_SWC_RegenDown, CAN2_SWC_RegenUp, CAN2_SWC_Right_Sta, CAN2_SWC_Trip_Sta, CAN2_SWC_Undefined_Sta, CAN2_SWC_Up_Sta, CAN2_SWC_VR_Sta, CAN2_SWC_mode_Sta, CAN2_Shifter_Fail_sta, CAN2_Shifter_Handle_Cmd, CAN2_TBOX_NET_SIG_STR, CAN2_TBOX_TEST_STATUS, CAN2_TrailerCheck, CAN2_TrailerModeSta, CAN2_V2LSta, CAN2_ZFR_BCM_ChargerDoorSW_Sta, CAN2_ZFR_EChrg_Active_Sta, CAN2_ZFR_EChrg_Sys_Sta], system-signal-group=CAN2_SG_GW2_CE100_0
    CAN2_SG_GW2_CE100_1: i-signal=[CAN2_Fr_EDUDrtSta, CAN2_Fr_EDURealTMTq, CAN2_Fr_MCUTemp, CAN2_Fr_MCUTempWarn, CAN2_Fr_MotorAvailTq, CAN2_Fr_TMSpd, CAN2_Fr_TMTemp, CAN2_Fr_TMTempWarn, CAN2_MCU_B_R_LLCTempWarn_Sta, CAN2_Rr_EDUDrtSta, CAN2_Rr_EDURealTMTq, CAN2_Rr_MCUTemp, CAN2_Rr_MCUTempWarn, CAN2_Rr_MotorAvailTq, CAN2_Rr_TMSpd, CAN2_Rr_TMTemp, CAN2_Rr_TMTempWarn, CAN2_SWC2_L_DriveMode_Sta, CAN2_SWC2_L_Home_Sta, CAN2_SWC2_R_Customize_Sta, CAN2_SWC2_R_Left_Sta, CAN2_SWC2_R_PageSwitch_Sta, CAN2_SWC2_R_Right_Sta, CAN2_SWC2_R_ScrollDown_Sta, CAN2_SWC2_R_ScrollPress_Sta, CAN2_SWC2_R_ScrollUp_Sta, CAN2_SWC2_R_VR_Sta], system-signal-group=CAN2_SG_GW2_CE100_1
    CAN2_SG_GW2_CE100_2: i-signal=[CAN2_FAPWL_01_LIN_Response_Error, CAN2_L_Drv_Motor_Relay_Error, CAN2_L_Drv_Motor_Ripple_Error, CAN2_L_Drv_Val_Wdw_Opened, CAN2_L_Pas_Motor_Relay_Error, CAN2_L_Pas_Motor_Ripple_Error, CAN2_L_Pas_Val_Wdw_Opened, CAN2_L_RLD_Motor_Relay_Error, CAN2_L_RLD_Motor_Ripple_Error, CAN2_L_RLD_Val_Wdw_Opened, CAN2_L_RRD_Motor_Relay_Error, CAN2_L_RRD_Motor_Ripple_Error, CAN2_L_RRD_Val_Wdw_Opened, CAN2_RAPWL_01_LIN_Response_Error, CAN2_Rr_EDUDrtSta_Nidec, CAN2_Rr_EDURealTMTq_Nidec, CAN2_Rr_MCUTempWarn_Nidec, CAN2_Rr_MCUTemp_Nidec, CAN2_Rr_MotorAvailTq_Nidec, CAN2_Rr_TMSpd_Nidec, CAN2_Rr_TMTempWarn_Nidec, CAN2_Rr_TMTemp_Nidec], system-signal-group=CAN2_SG_GW2_CE100_2
    CAN2_SG_IVI1: i-signal=[CAN2_A2B_Node_sta, CAN2_AmbLigh_LowBatAlert_SW, CAN2_AmbLigh_SafetyAlert_SW, CAN2_AmbLightBrightnessSet, CAN2_AmbLightColorSet, CAN2_AmbLight_DimInDark_SW, CAN2_AmbLight_SW, CAN2_AmbLight_WlcmLight_SW, CAN2_BrkAbn_GoReady_SW, CAN2_FCP_FrEvt_BtnACMaxReq, CAN2_FCP_FrEvt_BtnACReq, CAN2_FCP_FrEvt_BtnAutoReq, CAN2_FCP_FrEvt_BtnSyncReq, CAN2_FCP_MidEvt_BtnAutoReq, CAN2_IVI_AirRefresh_ByDMS_Sta, CAN2_IVI_AutoTheme_But_Sta, CAN2_IVI_CLWin_LockDoorSW_Sta, CAN2_IVI_CreateAccReq_Sta, CAN2_IVI_DMS_SW_Sta, CAN2_IVI_DSEAT_anti_set_Sta, CAN2_IVI_DelAccReq_Sta, CAN2_IVI_FrTrunk_UnlockReq_Sta, CAN2_IVI_HMI_Undefined_Sta, CAN2_IVI_LinkAccReq_Sta, CAN2_IVI_LinkAcc_Sta, CAN2_IVI_LinkKey_Sta, CAN2_IVI_Located_STA, CAN2_IVI_Lock_SoundSW_Sta, CAN2_IVI_NAVI_Foreground_Sta, CAN2_IVI_OTA_Upd_Sta, CAN2_IVI_QuickRefresh_Sta, CAN2_IVI_SWC_VibMode_Sta, CAN2_IVI_Time_Check, CAN2_IVI_Time_Day, CAN2_IVI_Time_Hour, CAN2_IVI_Time_Minute, CAN2_IVI_Time_Month, CAN2_IVI_Time_Second, CAN2_IVI_Time_Year, CAN2_IVI_sigScreenReq_Sta, CAN2_LINKtoDrive, CAN2_OTA_CancelDL_Req, CAN2_OTA_CompNTFY_Pres, CAN2_OTA_DL_Req, CAN2_OTA_SuspendDL_Req, CAN2_OTA_UpdStart_Req, CAN2_OpenDrOpenWdo_SW, CAN2_PW_CLOSE_IMD, CAN2_PW_CONTINUE_USE, CAN2_Re_Radio_Sta, CAN2_Sched_Chg_Day_Set, CAN2_Sched_Chg_End_Time_HR, CAN2_Sched_Chg_End_Time_Min, CAN2_Sched_Chg_St_Time_HR, CAN2_Sched_Chg_St_Time_Min, CAN2_Sched_OTA_wake, CAN2_SmartEco_Mode_SW, CAN2_Upd_Countdown_Cancel, CAN2_Upd_Countdown_Skip, CAN2_UserSet, CAN2_VehACModReq, CAN2_mFRD_link_Sta], system-signal-group=CAN2_SG_IVI1
    CAN2_SG_IVI2: i-signal=[CAN2_AC_Chg_Cur_Set, CAN2_AEB_BUTT, CAN2_AVM_Err_STA, CAN2_AVM_OFF_Rec_Butt, CAN2_AVM_Parking_mode, CAN2_AVM_parking_cancel, CAN2_AVM_parking_excute, CAN2_Approach_Unlock_SW, CAN2_BSDMute_BUTT, CAN2_CAAS_Sw, CAN2_CDL_Lock_Butt, CAN2_CDL_Unlock_Butt, CAN2_CameraWrn, CAN2_DMS_Status, CAN2_DMS_Warning_Distraction, CAN2_DMS_Warning_Fatigue, CAN2_DMS_Warning_Unresponsive, CAN2_DSEAT_anti_set, CAN2_DSEAT_entryfun_set, CAN2_DSEAT_vent_req, CAN2_Distance_unit, CAN2_ESC_SW_Cmd, CAN2_FCWMute_BUTT, CAN2_FFogLampSW, CAN2_FS_Off_Sw, CAN2_FalseNPrevent_SW, CAN2_FollowMeSW, CAN2_GPS_LAT, CAN2_GPS_LONG, CAN2_HeadLampSW, CAN2_Hood_Latch_SW, CAN2_IVI_ACC_Adaptive_Sta, CAN2_IVI_ActvDmpDisabSW, CAN2_IVI_AirIntZ3_Cmd, CAN2_IVI_CfmTo_Rdy, CAN2_IVI_ChargePortSW_Sta, CAN2_IVI_CoastDwSW, CAN2_IVI_CreepSW_Req, CAN2_IVI_DSEATHeater_Cmd, CAN2_IVI_DSEAT_FroEdge_Height_Cmd, CAN2_IVI_DSEAT_Height_Cmd, CAN2_IVI_DSEAT_Memory1_Sta, CAN2_IVI_DSEAT_Memory2_Sta, CAN2_IVI_DSEAT_Memory_OPTCLS_Sta, CAN2_IVI_DSEAT_Recline_Cmd, CAN2_IVI_DSEAT_Slide_Cmd, CAN2_IVI_ISA_OffsetSpd, CAN2_IVI_LVChrgFuncSW, CAN2_IVI_Mute_Sta, CAN2_IVI_Night_Mode_Sta, CAN2_IVI_PSEATHeater_Cmd, CAN2_IVI_PSEAT_Recline_Cmd, CAN2_IVI_PSEAT_Slide_Cmd, CAN2_IVI_PTG_Mode_SW, CAN2_IVI_PTG_Open_Height, CAN2_IVI_PTG_Sta_SW, CAN2_IVI_PTG_USSta_SW, CAN2_IVI_PW_Mode_Req, CAN2_IVI_Panel_Act, CAN2_IVI_Panel_X_Coor, CAN2_IVI_Panel_Y_Coor, CAN2_IVI_PwrLockSW, CAN2_IVI_Pwroff_req, CAN2_IVI_RR_Def_Req, CAN2_IVI_Req_V2L, CAN2_IVI_SLIF_Warning_Sta, CAN2_IVI_SWC_ACCMode_Sta, CAN2_IVI_SWC_LUndefined_Sta, CAN2_IVI_SWC_RUndefined_Sta, CAN2_IVI_Screen, CAN2_IVI_SetTempZon1_Sta, CAN2_IVI_SetTempZon2_Sta, CAN2_IVI_Start_Chg_req, CAN2_IVI_Status, CAN2_IVI_Stop_Chg_req, CAN2_IVI_TrailerCheckReq_Sta, CAN2_IVI_TrailerModeSW_Sta, CAN2_IVI_Trigger_req, CAN2_IVI_Unlock_Chg_req, CAN2_IVI_WI_MAIN_SW, CAN2_LDWMute_BUTT, CAN2_LKA_BUTT, CAN2_LVDAMute_BUTT, CAN2_L_Drv_ControlCommand, CAN2_L_Pas_ControlCommand, CAN2_L_RLD_ControlCommand, CAN2_L_RRD_ControlCommand, CAN2_Light_ShowStart_Req, CAN2_Light_ShowStop_Req, CAN2_METER_Malfunc_Sta, CAN2_MFRD_N_Bright_Req, CAN2_NAVI_Cam_Dist_info, CAN2_NAVI_Direction_STA, CAN2_NAVI_Distance_info, CAN2_NAVI_ForwardLinkLevel, CAN2_NAVI_LinkClass, CAN2_NAVI_RoadClass, CAN2_NAVI_SpeedLimit, CAN2_NAVI_Speed_Limit_A, CAN2_NAVI_State, CAN2_NAVI_Tollgate, CAN2_NAVI_Tunnel, CAN2_ODAMute_BUTT, CAN2_OFF_AC_MODE, CAN2_PSEAT_vent_req, CAN2_Perd_V2L, CAN2_Pressure_unit, CAN2_RCTA_BUTT, CAN2_RFogLampSW, CAN2_Roll_Eng_Mode, CAN2_Roll_Mode_SW_Cmd, CAN2_RoomLampMode, CAN2_SLG_Sw, CAN2_SLIF_BUTT, CAN2_SOC_ADJ_BUTT, CAN2_SOC_Limit_Set, CAN2_SOC_V2LLimit, CAN2_Sched_Chg_Start, CAN2_Sched_Chg_Stop, CAN2_Sched_Chg_butt, CAN2_Sched_Chg_limit, CAN2_Sched_Chg_wake, CAN2_SenstivityPosition, CAN2_SetUnlockSingle, CAN2_TCS_SW_Cmd, CAN2_TPMS_Cali_Butt, CAN2_TPMS_Res_Butt, CAN2_Temperature_unit, CAN2_Time_system, CAN2_TurnSwTimeSet, CAN2_User_p_download, CAN2_User_p_upload, CAN2_Walkaway_Lock_SW, CAN2_Wifi_Reset, CAN2_Wifi_Sta_IVI_TBOX, CAN2_WlcmLight_Mode, CAN2_sigAirIntenZon1Req, CAN2_sigAirIntenZon3Req, CAN2_sigDfrstReq, CAN2_sigFaceReq, CAN2_sigFootReq, CAN2_sigHvacFrontReq, CAN2_sigHvacRearReq, CAN2_sigHvacReq, CAN2_sigRecircReq, CAN2_sigSetTempZon1Req, CAN2_sigSetTempZon2Req, CAN2_sigSetTempZon3Req, CAN2_sigWindDirZon3Req], system-signal-group=CAN2_SG_IVI2
    CAN2_SG_IVI3: i-signal=[CAN2_IVI_CLBlower_Y_Sta, CAN2_IVI_CLBlower_Z_Sta, CAN2_IVI_CRBlower_Y_Sta, CAN2_IVI_CRBlower_Z_Sta, CAN2_IVI_DrBlower_Mode_Sta, CAN2_IVI_DrBlower_Y_Sta, CAN2_IVI_DrBlower_Z_Sta, CAN2_IVI_LSEATvent_Cmd, CAN2_IVI_MLFMost_Cmd, CAN2_IVI_MLFootLift_Cmd, CAN2_IVI_MLNapMode_Cmd, CAN2_IVI_MLRecliner_Cmd, CAN2_IVI_MLRestore_Cmd, CAN2_IVI_MLSEATvent_Cmd, CAN2_IVI_MLSeatLift_Cmd, CAN2_IVI_MLSldRestore_Cmd, CAN2_IVI_MLSlider_Cmd, CAN2_IVI_MLZeroGravity_Cmd, CAN2_IVI_MRFMost_Cmd, CAN2_IVI_MRFootLift_Cmd, CAN2_IVI_MRNapMode_Cmd, CAN2_IVI_MRRecliner_Cmd, CAN2_IVI_MRRestore_Cmd, CAN2_IVI_MRSEATvent_Cmd, CAN2_IVI_MRSeatLift_Cmd, CAN2_IVI_MRSldRestore_Cmd, CAN2_IVI_MRSlider_Cmd, CAN2_IVI_MRZeroGravity_Cmd, CAN2_IVI_PsBlower_Mode_Sta, CAN2_IVI_PsBlower_Y_Sta, CAN2_IVI_PsBlower_Z_Sta, CAN2_IVI_RSEATvent_Cmd], system-signal-group=CAN2_SG_IVI3
    CAN2_SG_IVI_P20_0: i-signal=[CAN2_IVI_AmbiLgtSta, CAN2_IVI_FrAtmoLamp_Cmd, CAN2_IVI_FrRmLampBright_Cmd, CAN2_IVI_Frontindoorlight_Sta, CAN2_IVI_Passengerdoor_Sta, CAN2_IVI_RrAtmoLamp_Cmd, CAN2_IVI_RrRmLampBright_Cmd, CAN2_IVI_RrRoomlamp_Cmd], system-signal-group=CAN2_SG_IVI_P20_0
    CAN2_SG_METER1: i-signal=[CAN2_APCforDTE, CAN2_AVGPwrConsumption, CAN2_AvailableTrip, CAN2_Averaged_vehspeed, CAN2_Charge, CAN2_LEDlitWarnReq, CAN2_METER_KPH_Calcu, CAN2_METER_KPH_Real, CAN2_METER_MPH_Calcu, CAN2_METER_MPH_Real, CAN2_ODOMETER, CAN2_ParkBrake, CAN2_Spd_Crl_Mode, CAN2_Spd_Crl_Sta, CAN2_Trip_A, CAN2_Trip_B], system-signal-group=CAN2_SG_METER1
