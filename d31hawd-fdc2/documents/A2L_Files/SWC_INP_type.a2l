ASAP2_VERSION 1 31
/begin PROJECT ProjectName "Project Comment Goes Here"
/begin HEADER "Header Comments go here" /end HEADER
/begin MODULE ModuleName "Module Comment Goes Here"
/begin MOD_COMMON "Mod Common Comment Here" BYTE_ORDER MSB_LAST /end MOD_COMMON
/begin RECORD_LAYOUT Scalar_BOOLEAN FNC_VALUES 1 UBYTE COLUMN_DIR DIRECT /end RECORD_LAYOUT
/begin RECORD_LAYOUT Scalar_UBYTE FNC_VALUES 1 UBYTE COLUMN_DIR DIRECT /end RECORD_LAYOUT
/begin RECORD_LAYOUT Scalar_ULONG FNC_VALUES 1 ULONG COLUMN_DIR DIRECT /end RECORD_LAYOUT
/begin RECORD_LAYOUT Scalar_FLOAT32_IEEE FNC_VALUES 1 FLOAT32_IEEE COLUMN_DIR DIRECT /end RECORD_LAYOUT
/begin RECORD_LAYOUT Lookup1D_X_WORD AXIS_PTS_X 1 SWORD INDEX_INCR DIRECT /end RECORD_LAYOUT
/begin RECORD_LAYOUT Lookup1D_ULONG FNC_VALUES 1 ULONG COLUMN_DIR DIRECT /end RECORD_LAYOUT
/begin RECORD_LAYOUT Lookup1D_X_ULONG AXIS_PTS_X 1 ULONG INDEX_INCR DIRECT /end RECORD_LAYOUT
/begin RECORD_LAYOUT Lookup1D_SLONG FNC_VALUES 1 SLONG COLUMN_DIR DIRECT /end RECORD_LAYOUT
/begin RECORD_LAYOUT Lookup1D_X_LONG AXIS_PTS_X 1 SLONG INDEX_INCR DIRECT /end RECORD_LAYOUT
/begin RECORD_LAYOUT Lookup1D_FLOAT32_IEEE FNC_VALUES 1 FLOAT32_IEEE COLUMN_DIR DIRECT /end RECORD_LAYOUT
/begin RECORD_LAYOUT Lookup1D_X_FLOAT32_IEEE AXIS_PTS_X 1 FLOAT32_IEEE INDEX_INCR DIRECT /end RECORD_LAYOUT
/begin CHARACTERISTIC KINP_ACChgCurSet_A_defval "" VALUE 0x0000 /* @ECU_Address@KINP_ACChgCurSet_A_defval@ */ Scalar_FLOAT32_IEEE 0 SWC_INP_type_CM_single_A 5.0 132.0 /end CHARACTERISTIC
/begin CHARACTERISTIC KINP_ACChgCurSet_A_ovrdval "" VALUE 0x0000 /* @ECU_Address@KINP_ACChgCurSet_A_ovrdval@ */ Scalar_FLOAT32_IEEE 0 SWC_INP_type_CM_single_A 5.0 132.0 /end CHARACTERISTIC
/begin CHARACTERISTIC KINP_BrkPedalPos_pct_defval "" VALUE 0x0000 /* @ECU_Address@KINP_BrkPedalPos_pct_defval@ */ Scalar_FLOAT32_IEEE 0 SWC_INP_type_CM_single_pct 0.0 100.0 /end CHARACTERISTIC
/begin CHARACTERISTIC KINP_BrkPedalPos_pct_ovrdval "" VALUE 0x0000 /* @ECU_Address@KINP_BrkPedalPos_pct_ovrdval@ */ Scalar_FLOAT32_IEEE 0 SWC_INP_type_CM_single_pct 0.0 100.0 /end CHARACTERISTIC
/begin CHARACTERISTIC KINP_FrntAxlTrqReqBrk_Nm_defval "" VALUE 0x0000 /* @ECU_Address@KINP_FrntAxlTrqReqBrk_Nm_defval@ */ Scalar_FLOAT32_IEEE 0 SWC_INP_type_CM_single_Nm -5300.0 0.0 /end CHARACTERISTIC
/begin CHARACTERISTIC KINP_FrntAxlTrqReqBrk_Nm_ovrdval "" VALUE 0x0000 /* @ECU_Address@KINP_FrntAxlTrqReqBrk_Nm_ovrdval@ */ Scalar_FLOAT32_IEEE 0 SWC_INP_type_CM_single_Nm -5300.0 0.0 /end CHARACTERISTIC
/begin CHARACTERISTIC KINP_GPSLAT_s_defval "" VALUE 0x0000 /* @ECU_Address@KINP_GPSLAT_s_defval@ */ Scalar_FLOAT32_IEEE 0 SWC_INP_type_CM_single_s 0.0 4.294967295E+9 /end CHARACTERISTIC
/begin CHARACTERISTIC KINP_GPSLAT_s_ovrdval "" VALUE 0x0000 /* @ECU_Address@KINP_GPSLAT_s_ovrdval@ */ Scalar_FLOAT32_IEEE 0 SWC_INP_type_CM_single_s 0.0 4.294967295E+9 /end CHARACTERISTIC
/begin CHARACTERISTIC KINP_IVICLBlowerYSta_pct_defval "" VALUE 0x0000 /* @ECU_Address@KINP_IVICLBlowerYSta_pct_defval@ */ Scalar_FLOAT32_IEEE 0 SWC_INP_type_CM_single_pct 0.0 127.0 /end CHARACTERISTIC
/begin CHARACTERISTIC KINP_IVICLBlowerYSta_pct_ovrdval "" VALUE 0x0000 /* @ECU_Address@KINP_IVICLBlowerYSta_pct_ovrdval@ */ Scalar_FLOAT32_IEEE 0 SWC_INP_type_CM_single_pct 0.0 127.0 /end CHARACTERISTIC
/begin CHARACTERISTIC KINP_IVICLBlowerZSta_pct_defval "" VALUE 0x0000 /* @ECU_Address@KINP_IVICLBlowerZSta_pct_defval@ */ Scalar_FLOAT32_IEEE 0 SWC_INP_type_CM_single_pct 0.0 127.0 /end CHARACTERISTIC
/begin CHARACTERISTIC KINP_IVICLBlowerZSta_pct_ovrdval "" VALUE 0x0000 /* @ECU_Address@KINP_IVICLBlowerZSta_pct_ovrdval@ */ Scalar_FLOAT32_IEEE 0 SWC_INP_type_CM_single_pct 0.0 127.0 /end CHARACTERISTIC
/begin CHARACTERISTIC KINP_IVICRBlowerYSta_pct_defval "" VALUE 0x0000 /* @ECU_Address@KINP_IVICRBlowerYSta_pct_defval@ */ Scalar_FLOAT32_IEEE 0 SWC_INP_type_CM_single_pct 0.0 127.0 /end CHARACTERISTIC
/begin CHARACTERISTIC KINP_IVICRBlowerYSta_pct_ovrdval "" VALUE 0x0000 /* @ECU_Address@KINP_IVICRBlowerYSta_pct_ovrdval@ */ Scalar_FLOAT32_IEEE 0 SWC_INP_type_CM_single_pct 0.0 127.0 /end CHARACTERISTIC
/begin CHARACTERISTIC KINP_IVICRBlowerZSta_pct_defval "" VALUE 0x0000 /* @ECU_Address@KINP_IVICRBlowerZSta_pct_defval@ */ Scalar_FLOAT32_IEEE 0 SWC_INP_type_CM_single_pct 0.0 127.0 /end CHARACTERISTIC
/begin CHARACTERISTIC KINP_IVICRBlowerZSta_pct_ovrdval "" VALUE 0x0000 /* @ECU_Address@KINP_IVICRBlowerZSta_pct_ovrdval@ */ Scalar_FLOAT32_IEEE 0 SWC_INP_type_CM_single_pct 0.0 127.0 /end CHARACTERISTIC
/begin CHARACTERISTIC KINP_IVILBlowerYSta_pct_defval "" VALUE 0x0000 /* @ECU_Address@KINP_IVILBlowerYSta_pct_defval@ */ Scalar_FLOAT32_IEEE 0 SWC_INP_type_CM_single_pct 0.0 127.0 /end CHARACTERISTIC
/begin CHARACTERISTIC KINP_IVILBlowerYSta_pct_ovrdval "" VALUE 0x0000 /* @ECU_Address@KINP_IVILBlowerYSta_pct_ovrdval@ */ Scalar_FLOAT32_IEEE 0 SWC_INP_type_CM_single_pct 0.0 127.0 /end CHARACTERISTIC
/begin CHARACTERISTIC KINP_IVILBlowerZSta_pct_defval "" VALUE 0x0000 /* @ECU_Address@KINP_IVILBlowerZSta_pct_defval@ */ Scalar_FLOAT32_IEEE 0 SWC_INP_type_CM_single_pct 0.0 127.0 /end CHARACTERISTIC
/begin CHARACTERISTIC KINP_IVILBlowerZSta_pct_ovrdval "" VALUE 0x0000 /* @ECU_Address@KINP_IVILBlowerZSta_pct_ovrdval@ */ Scalar_FLOAT32_IEEE 0 SWC_INP_type_CM_single_pct 0.0 127.0 /end CHARACTERISTIC
/begin CHARACTERISTIC KINP_IVIRBlowerYSta_pct_defval "" VALUE 0x0000 /* @ECU_Address@KINP_IVIRBlowerYSta_pct_defval@ */ Scalar_FLOAT32_IEEE 0 SWC_INP_type_CM_single_pct 0.0 127.0 /end CHARACTERISTIC
/begin CHARACTERISTIC KINP_IVIRBlowerYSta_pct_ovrdval "" VALUE 0x0000 /* @ECU_Address@KINP_IVIRBlowerYSta_pct_ovrdval@ */ Scalar_FLOAT32_IEEE 0 SWC_INP_type_CM_single_pct 0.0 127.0 /end CHARACTERISTIC
/begin CHARACTERISTIC KINP_IVITimeDay_DAY_defval "" VALUE 0x0000 /* @ECU_Address@KINP_IVITimeDay_DAY_defval@ */ Scalar_FLOAT32_IEEE 0 SWC_INP_type_CM_single_DAY 0.0 31.0 /end CHARACTERISTIC
/begin CHARACTERISTIC KINP_IVITimeDay_DAY_ovrdval "" VALUE 0x0000 /* @ECU_Address@KINP_IVITimeDay_DAY_ovrdval@ */ Scalar_FLOAT32_IEEE 0 SWC_INP_type_CM_single_DAY 0.0 31.0 /end CHARACTERISTIC
/begin CHARACTERISTIC KINP_IVITimeHour_hr_defval "" VALUE 0x0000 /* @ECU_Address@KINP_IVITimeHour_hr_defval@ */ Scalar_FLOAT32_IEEE 0 SWC_INP_type_CM_single_hr 0.0 31.0 /end CHARACTERISTIC
/begin CHARACTERISTIC KINP_IVITimeHour_hr_ovrdval "" VALUE 0x0000 /* @ECU_Address@KINP_IVITimeHour_hr_ovrdval@ */ Scalar_FLOAT32_IEEE 0 SWC_INP_type_CM_single_hr 0.0 31.0 /end CHARACTERISTIC
/begin CHARACTERISTIC KINP_IVITimeMinute_min_defval "" VALUE 0x0000 /* @ECU_Address@KINP_IVITimeMinute_min_defval@ */ Scalar_FLOAT32_IEEE 0 SWC_INP_type_CM_single_min 0.0 63.0 /end CHARACTERISTIC
/begin CHARACTERISTIC KINP_IVITimeMinute_min_ovrdval "" VALUE 0x0000 /* @ECU_Address@KINP_IVITimeMinute_min_ovrdval@ */ Scalar_FLOAT32_IEEE 0 SWC_INP_type_CM_single_min 0.0 63.0 /end CHARACTERISTIC
/begin CHARACTERISTIC KINP_IVITimeMonth_MONTH_defval "" VALUE 0x0000 /* @ECU_Address@KINP_IVITimeMonth_MONTH_defval@ */ Scalar_FLOAT32_IEEE 0 SWC_INP_type_CM_single_MONTH 0.0 12.0 /end CHARACTERISTIC
/begin CHARACTERISTIC KINP_IVITimeMonth_MONTH_ovrdval "" VALUE 0x0000 /* @ECU_Address@KINP_IVITimeMonth_MONTH_ovrdval@ */ Scalar_FLOAT32_IEEE 0 SWC_INP_type_CM_single_MONTH 0.0 12.0 /end CHARACTERISTIC
/begin CHARACTERISTIC KINP_IVITimeSecond_s_defval "" VALUE 0x0000 /* @ECU_Address@KINP_IVITimeSecond_s_defval@ */ Scalar_FLOAT32_IEEE 0 SWC_INP_type_CM_single_s 0.0 63.0 /end CHARACTERISTIC
/begin CHARACTERISTIC KINP_IVITimeSecond_s_ovrdval "" VALUE 0x0000 /* @ECU_Address@KINP_IVITimeSecond_s_ovrdval@ */ Scalar_FLOAT32_IEEE 0 SWC_INP_type_CM_single_s 0.0 63.0 /end CHARACTERISTIC
/begin CHARACTERISTIC KINP_IVITimeYear_YEAR_defval "" VALUE 0x0000 /* @ECU_Address@KINP_IVITimeYear_YEAR_defval@ */ Scalar_FLOAT32_IEEE 0 SWC_INP_type_CM_single_YEAR 2000.0 2127.0 /end CHARACTERISTIC
/begin CHARACTERISTIC KINP_IVITimeYear_YEAR_ovrdval "" VALUE 0x0000 /* @ECU_Address@KINP_IVITimeYear_YEAR_ovrdval@ */ Scalar_FLOAT32_IEEE 0 SWC_INP_type_CM_single_YEAR 2000.0 2127.0 /end CHARACTERISTIC
/begin CHARACTERISTIC KINP_LDrvControlCommand_pct_defval "" VALUE 0x0000 /* @ECU_Address@KINP_LDrvControlCommand_pct_defval@ */ Scalar_FLOAT32_IEEE 0 SWC_INP_type_CM_single_pct 0.0 127.0 /end CHARACTERISTIC
/begin CHARACTERISTIC KINP_LDrvControlCommand_pct_ovrdval "" VALUE 0x0000 /* @ECU_Address@KINP_LDrvControlCommand_pct_ovrdval@ */ Scalar_FLOAT32_IEEE 0 SWC_INP_type_CM_single_pct 0.0 127.0 /end CHARACTERISTIC
/begin CHARACTERISTIC KINP_LPasControlCommand_pct_defval "" VALUE 0x0000 /* @ECU_Address@KINP_LPasControlCommand_pct_defval@ */ Scalar_FLOAT32_IEEE 0 SWC_INP_type_CM_single_pct 0.0 127.0 /end CHARACTERISTIC
/begin CHARACTERISTIC KINP_LPasControlCommand_pct_ovrdval "" VALUE 0x0000 /* @ECU_Address@KINP_LPasControlCommand_pct_ovrdval@ */ Scalar_FLOAT32_IEEE 0 SWC_INP_type_CM_single_pct 0.0 127.0 /end CHARACTERISTIC
/begin CHARACTERISTIC KINP_LRLDControlCommand_pct_defval "" VALUE 0x0000 /* @ECU_Address@KINP_LRLDControlCommand_pct_defval@ */ Scalar_FLOAT32_IEEE 0 SWC_INP_type_CM_single_pct 0.0 127.0 /end CHARACTERISTIC
/begin CHARACTERISTIC KINP_LRLDControlCommand_pct_ovrdval "" VALUE 0x0000 /* @ECU_Address@KINP_LRLDControlCommand_pct_ovrdval@ */ Scalar_FLOAT32_IEEE 0 SWC_INP_type_CM_single_pct 0.0 127.0 /end CHARACTERISTIC
/begin CHARACTERISTIC KINP_LRRDControlCommand_pct_defval "" VALUE 0x0000 /* @ECU_Address@KINP_LRRDControlCommand_pct_defval@ */ Scalar_FLOAT32_IEEE 0 SWC_INP_type_CM_single_pct 0.0 127.0 /end CHARACTERISTIC
/begin CHARACTERISTIC KINP_LRRDControlCommand_pct_ovrdval "" VALUE 0x0000 /* @ECU_Address@KINP_LRRDControlCommand_pct_ovrdval@ */ Scalar_FLOAT32_IEEE 0 SWC_INP_type_CM_single_pct 0.0 127.0 /end CHARACTERISTIC
/begin CHARACTERISTIC KINP_LatAccel_Gps_defval "" VALUE 0x0000 /* @ECU_Address@KINP_LatAccel_Gps_defval@ */ Scalar_FLOAT32_IEEE 0 SWC_INP_type_CM_single_Gps -1.27 1.27 /end CHARACTERISTIC
/begin CHARACTERISTIC KINP_LatAccel_Gps_ovrdval "" VALUE 0x0000 /* @ECU_Address@KINP_LatAccel_Gps_ovrdval@ */ Scalar_FLOAT32_IEEE 0 SWC_INP_type_CM_single_Gps -1.27 1.27 /end CHARACTERISTIC
/begin CHARACTERISTIC KINP_LongAccel_Gps_defval "" VALUE 0x0000 /* @ECU_Address@KINP_LongAccel_Gps_defval@ */ Scalar_FLOAT32_IEEE 0 SWC_INP_type_CM_single_Gps -1.27 1.27 /end CHARACTERISTIC
/begin CHARACTERISTIC KINP_LongAccel_Gps_ovrdval "" VALUE 0x0000 /* @ECU_Address@KINP_LongAccel_Gps_ovrdval@ */ Scalar_FLOAT32_IEEE 0 SWC_INP_type_CM_single_Gps -1.27 1.27 /end CHARACTERISTIC
/begin CHARACTERISTIC KINP_MCPressure_bar_defval "" VALUE 0x0000 /* @ECU_Address@KINP_MCPressure_bar_defval@ */ Scalar_FLOAT32_IEEE 0 SWC_INP_type_CM_single_bar -9.7 195.0 /end CHARACTERISTIC
/begin CHARACTERISTIC KINP_MCPressure_bar_ovrdval "" VALUE 0x0000 /* @ECU_Address@KINP_MCPressure_bar_ovrdval@ */ Scalar_FLOAT32_IEEE 0 SWC_INP_type_CM_single_bar -9.7 195.0 /end CHARACTERISTIC
/begin CHARACTERISTIC KINP_MFRDNBrightReq_pct_defval "" VALUE 0x0000 /* @ECU_Address@KINP_MFRDNBrightReq_pct_defval@ */ Scalar_FLOAT32_IEEE 0 SWC_INP_type_CM_single_pct 0.0 100.0 /end CHARACTERISTIC
/begin CHARACTERISTIC KINP_MFRDNBrightReq_pct_ovrdval "" VALUE 0x0000 /* @ECU_Address@KINP_MFRDNBrightReq_pct_ovrdval@ */ Scalar_FLOAT32_IEEE 0 SWC_INP_type_CM_single_pct 0.0 100.0 /end CHARACTERISTIC
/begin CHARACTERISTIC KINP_MeterIndVehSpeed_kph_defval "" VALUE 0x0000 /* @ECU_Address@KINP_MeterIndVehSpeed_kph_defval@ */ Scalar_FLOAT32_IEEE 0 SWC_INP_type_CM_single_kph 0.0 300.0 /end CHARACTERISTIC
/begin CHARACTERISTIC KINP_MeterIndVehSpeed_kph_ovrdval "" VALUE 0x0000 /* @ECU_Address@KINP_MeterIndVehSpeed_kph_ovrdval@ */ Scalar_FLOAT32_IEEE 0 SWC_INP_type_CM_single_kph 0.0 300.0 /end CHARACTERISTIC
/begin CHARACTERISTIC KINP_RearAxlTrqReqBrk_Nm_defval "" VALUE 0x0000 /* @ECU_Address@KINP_RearAxlTrqReqBrk_Nm_defval@ */ Scalar_FLOAT32_IEEE 0 SWC_INP_type_CM_single_Nm -5300.0 0.0 /end CHARACTERISTIC
/begin CHARACTERISTIC KINP_RearAxlTrqReqBrk_Nm_ovrdval "" VALUE 0x0000 /* @ECU_Address@KINP_RearAxlTrqReqBrk_Nm_ovrdval@ */ Scalar_FLOAT32_IEEE 0 SWC_INP_type_CM_single_Nm -5300.0 0.0 /end CHARACTERISTIC
/begin CHARACTERISTIC KINP_SOCLimitSet_pct_defval "" VALUE 0x0000 /* @ECU_Address@KINP_SOCLimitSet_pct_defval@ */ Scalar_FLOAT32_IEEE 0 SWC_INP_type_CM_single_pct 50.0 100.0 /end CHARACTERISTIC
/begin CHARACTERISTIC KINP_SOCLimitSet_pct_ovrdval "" VALUE 0x0000 /* @ECU_Address@KINP_SOCLimitSet_pct_ovrdval@ */ Scalar_FLOAT32_IEEE 0 SWC_INP_type_CM_single_pct 50.0 100.0 /end CHARACTERISTIC
/begin CHARACTERISTIC KINP_SOCV2LLimit_pct_defval "" VALUE 0x0000 /* @ECU_Address@KINP_SOCV2LLimit_pct_defval@ */ Scalar_FLOAT32_IEEE 0 SWC_INP_type_CM_single_pct 0.0 15.0 /end CHARACTERISTIC
/begin CHARACTERISTIC KINP_SOCV2LLimit_pct_ovrdval "" VALUE 0x0000 /* @ECU_Address@KINP_SOCV2LLimit_pct_ovrdval@ */ Scalar_FLOAT32_IEEE 0 SWC_INP_type_CM_single_pct 0.0 15.0 /end CHARACTERISTIC
/begin CHARACTERISTIC KINP_SchedChglimit_pct_defval "" VALUE 0x0000 /* @ECU_Address@KINP_SchedChglimit_pct_defval@ */ Scalar_FLOAT32_IEEE 0 SWC_INP_type_CM_single_pct 50.0 100.0 /end CHARACTERISTIC
/begin CHARACTERISTIC KINP_SchedChglimit_pct_ovrdval "" VALUE 0x0000 /* @ECU_Address@KINP_SchedChglimit_pct_ovrdval@ */ Scalar_FLOAT32_IEEE 0 SWC_INP_type_CM_single_pct 50.0 100.0 /end CHARACTERISTIC
/begin CHARACTERISTIC KINP_VehSpeed_kph_defval "" VALUE 0x0000 /* @ECU_Address@KINP_VehSpeed_kph_defval@ */ Scalar_FLOAT32_IEEE 0 SWC_INP_type_CM_single_kph 0.0 255.875 /end CHARACTERISTIC
/begin CHARACTERISTIC KINP_VehSpeed_kph_ovrdval "" VALUE 0x0000 /* @ECU_Address@KINP_VehSpeed_kph_ovrdval@ */ Scalar_FLOAT32_IEEE 0 SWC_INP_type_CM_single_kph 0.0 255.875 /end CHARACTERISTIC
/begin CHARACTERISTIC KINP_YawRate_degps_defval "" VALUE 0x0000 /* @ECU_Address@KINP_YawRate_degps_defval@ */ Scalar_FLOAT32_IEEE 0 SWC_INP_type_CM_single_degps -100.0 100.0 /end CHARACTERISTIC
/begin CHARACTERISTIC KINP_YawRate_degps_ovrdval "" VALUE 0x0000 /* @ECU_Address@KINP_YawRate_degps_ovrdval@ */ Scalar_FLOAT32_IEEE 0 SWC_INP_type_CM_single_degps -100.0 100.0 /end CHARACTERISTIC
/begin CHARACTERISTIC KINP_sigSetTempZon1Req_C_defval "" VALUE 0x0000 /* @ECU_Address@KINP_sigSetTempZon1Req_C_defval@ */ Scalar_FLOAT32_IEEE 0 SWC_INP_type_CM_single_C 17.0 32.0 /end CHARACTERISTIC
/begin CHARACTERISTIC KINP_sigSetTempZon1Req_C_ovrdval "" VALUE 0x0000 /* @ECU_Address@KINP_sigSetTempZon1Req_C_ovrdval@ */ Scalar_FLOAT32_IEEE 0 SWC_INP_type_CM_single_C 17.0 32.0 /end CHARACTERISTIC
/begin CHARACTERISTIC KINP_sigSetTempZon2Req_C_defval "" VALUE 0x0000 /* @ECU_Address@KINP_sigSetTempZon2Req_C_defval@ */ Scalar_FLOAT32_IEEE 0 SWC_INP_type_CM_single_C 17.0 32.0 /end CHARACTERISTIC
/begin CHARACTERISTIC KINP_sigSetTempZon2Req_C_ovrdval "" VALUE 0x0000 /* @ECU_Address@KINP_sigSetTempZon2Req_C_ovrdval@ */ Scalar_FLOAT32_IEEE 0 SWC_INP_type_CM_single_C 17.0 32.0 /end CHARACTERISTIC
/begin CHARACTERISTIC KINP_GPSLONG_enum_defval "" VALUE 0x0000 /* @ECU_Address@KINP_GPSLONG_enum_defval@ */ Scalar_ULONG 0 SWC_INP_type_CM_uint32_enum 0.0 4.294967295E+9 /end CHARACTERISTIC
/begin CHARACTERISTIC KINP_GPSLONG_enum_ovrdval "" VALUE 0x0000 /* @ECU_Address@KINP_GPSLONG_enum_ovrdval@ */ Scalar_ULONG 0 SWC_INP_type_CM_uint32_enum 0.0 4.294967295E+9 /end CHARACTERISTIC
/begin CHARACTERISTIC KINP_ACCAvail_flg_defval "" VALUE 0x0000 /* @ECU_Address@KINP_ACCAvail_flg_defval@ */ Scalar_BOOLEAN 0 SWC_INP_type_CM_boolean_flg 0.0 1.0 /end CHARACTERISTIC
/begin CHARACTERISTIC KINP_ACCAvail_flg_ovrdflg "" VALUE 0x0000 /* @ECU_Address@KINP_ACCAvail_flg_ovrdflg@ */ Scalar_BOOLEAN 0 SWC_INP_type_CM_boolean_flg 0.0 1.0 /end CHARACTERISTIC
/begin CHARACTERISTIC KINP_ACCAvail_flg_ovrdval "" VALUE 0x0000 /* @ECU_Address@KINP_ACCAvail_flg_ovrdval@ */ Scalar_BOOLEAN 0 SWC_INP_type_CM_boolean_flg 0.0 1.0 /end CHARACTERISTIC
/begin CHARACTERISTIC KINP_ACChgCurSet_A_ovrdflg "" VALUE 0x0000 /* @ECU_Address@KINP_ACChgCurSet_A_ovrdflg@ */ Scalar_BOOLEAN 0 SWC_INP_type_CM_boolean_flg 0.0 1.0 /end CHARACTERISTIC
/begin CHARACTERISTIC KINP_AEBAvail_flg_defval "" VALUE 0x0000 /* @ECU_Address@KINP_AEBAvail_flg_defval@ */ Scalar_BOOLEAN 0 SWC_INP_type_CM_boolean_flg 0.0 1.0 /end CHARACTERISTIC
/begin CHARACTERISTIC KINP_AEBAvail_flg_ovrdflg "" VALUE 0x0000 /* @ECU_Address@KINP_AEBAvail_flg_ovrdflg@ */ Scalar_BOOLEAN 0 SWC_INP_type_CM_boolean_flg 0.0 1.0 /end CHARACTERISTIC
/begin CHARACTERISTIC KINP_AEBAvail_flg_ovrdval "" VALUE 0x0000 /* @ECU_Address@KINP_AEBAvail_flg_ovrdval@ */ Scalar_BOOLEAN 0 SWC_INP_type_CM_boolean_flg 0.0 1.0 /end CHARACTERISTIC
/begin CHARACTERISTIC KINP_AVMErrSTA_flg_defval "" VALUE 0x0000 /* @ECU_Address@KINP_AVMErrSTA_flg_defval@ */ Scalar_BOOLEAN 0 SWC_INP_type_CM_boolean_flg 0.0 1.0 /end CHARACTERISTIC
/begin CHARACTERISTIC KINP_AVMErrSTA_flg_ovrdflg "" VALUE 0x0000 /* @ECU_Address@KINP_AVMErrSTA_flg_ovrdflg@ */ Scalar_BOOLEAN 0 SWC_INP_type_CM_boolean_flg 0.0 1.0 /end CHARACTERISTIC
/begin CHARACTERISTIC KINP_AVMErrSTA_flg_ovrdval "" VALUE 0x0000 /* @ECU_Address@KINP_AVMErrSTA_flg_ovrdval@ */ Scalar_BOOLEAN 0 SWC_INP_type_CM_boolean_flg 0.0 1.0 /end CHARACTERISTIC
/begin CHARACTERISTIC KINP_AVMOFFRecButt_flg_defval "" VALUE 0x0000 /* @ECU_Address@KINP_AVMOFFRecButt_flg_defval@ */ Scalar_BOOLEAN 0 SWC_INP_type_CM_boolean_flg 0.0 1.0 /end CHARACTERISTIC
/begin CHARACTERISTIC KINP_AVMOFFRecButt_flg_ovrdflg "" VALUE 0x0000 /* @ECU_Address@KINP_AVMOFFRecButt_flg_ovrdflg@ */ Scalar_BOOLEAN 0 SWC_INP_type_CM_boolean_flg 0.0 1.0 /end CHARACTERISTIC
/begin CHARACTERISTIC KINP_AVMOFFRecButt_flg_ovrdval "" VALUE 0x0000 /* @ECU_Address@KINP_AVMOFFRecButt_flg_ovrdval@ */ Scalar_BOOLEAN 0 SWC_INP_type_CM_boolean_flg 0.0 1.0 /end CHARACTERISTIC
/begin CHARACTERISTIC KINP_AVMParkingmode_enum_ovrdflg "" VALUE 0x0000 /* @ECU_Address@KINP_AVMParkingmode_enum_ovrdflg@ */ Scalar_BOOLEAN 0 SWC_INP_type_CM_boolean_flg 0.0 1.0 /end CHARACTERISTIC
/begin CHARACTERISTIC KINP_AVMparkingcancel_enum_ovrdflg "" VALUE 0x0000 /* @ECU_Address@KINP_AVMparkingcancel_enum_ovrdflg@ */ Scalar_BOOLEAN 0 SWC_INP_type_CM_boolean_flg 0.0 1.0 /end CHARACTERISTIC
/begin CHARACTERISTIC KINP_AVMparkingexcute_enum_ovrdflg "" VALUE 0x0000 /* @ECU_Address@KINP_AVMparkingexcute_enum_ovrdflg@ */ Scalar_BOOLEAN 0 SWC_INP_type_CM_boolean_flg 0.0 1.0 /end CHARACTERISTIC
/begin CHARACTERISTIC KINP_ActBrkLampSta_flg_defval "" VALUE 0x0000 /* @ECU_Address@KINP_ActBrkLampSta_flg_defval@ */ Scalar_BOOLEAN 0 SWC_INP_type_CM_boolean_flg 0.0 1.0 /end CHARACTERISTIC
/begin CHARACTERISTIC KINP_ActBrkLampSta_flg_ovrdflg "" VALUE 0x0000 /* @ECU_Address@KINP_ActBrkLampSta_flg_ovrdflg@ */ Scalar_BOOLEAN 0 SWC_INP_type_CM_boolean_flg 0.0 1.0 /end CHARACTERISTIC
/begin CHARACTERISTIC KINP_ActBrkLampSta_flg_ovrdval "" VALUE 0x0000 /* @ECU_Address@KINP_ActBrkLampSta_flg_ovrdval@ */ Scalar_BOOLEAN 0 SWC_INP_type_CM_boolean_flg 0.0 1.0 /end CHARACTERISTIC
/begin CHARACTERISTIC KINP_AmbLighLowBatAlertSW_flg_defval "" VALUE 0x0000 /* @ECU_Address@KINP_AmbLighLowBatAlertSW_flg_defval@ */ Scalar_BOOLEAN 0 SWC_INP_type_CM_boolean_flg 0.0 1.0 /end CHARACTERISTIC
/begin CHARACTERISTIC KINP_AmbLighLowBatAlertSW_flg_ovrdflg "" VALUE 0x0000 /* @ECU_Address@KINP_AmbLighLowBatAlertSW_flg_ovrdflg@ */ Scalar_BOOLEAN 0 SWC_INP_type_CM_boolean_flg 0.0 1.0 /end CHARACTERISTIC
/begin CHARACTERISTIC KINP_AmbLighLowBatAlertSW_flg_ovrdval "" VALUE 0x0000 /* @ECU_Address@KINP_AmbLighLowBatAlertSW_flg_ovrdval@ */ Scalar_BOOLEAN 0 SWC_INP_type_CM_boolean_flg 0.0 1.0 /end CHARACTERISTIC
/begin CHARACTERISTIC KINP_AmbLighSafetyAlertSW_flg_defval "" VALUE 0x0000 /* @ECU_Address@KINP_AmbLighSafetyAlertSW_flg_defval@ */ Scalar_BOOLEAN 0 SWC_INP_type_CM_boolean_flg 0.0 1.0 /end CHARACTERISTIC
/begin CHARACTERISTIC KINP_AmbLighSafetyAlertSW_flg_ovrdflg "" VALUE 0x0000 /* @ECU_Address@KINP_AmbLighSafetyAlertSW_flg_ovrdflg@ */ Scalar_BOOLEAN 0 SWC_INP_type_CM_boolean_flg 0.0 1.0 /end CHARACTERISTIC
/begin CHARACTERISTIC KINP_AmbLighSafetyAlertSW_flg_ovrdval "" VALUE 0x0000 /* @ECU_Address@KINP_AmbLighSafetyAlertSW_flg_ovrdval@ */ Scalar_BOOLEAN 0 SWC_INP_type_CM_boolean_flg 0.0 1.0 /end CHARACTERISTIC
/begin CHARACTERISTIC KINP_AmbLightBrightnessSet_enum_ovrdflg "" VALUE 0x0000 /* @ECU_Address@KINP_AmbLightBrightnessSet_enum_ovrdflg@ */ Scalar_BOOLEAN 0 SWC_INP_type_CM_boolean_flg 0.0 1.0 /end CHARACTERISTIC
/begin CHARACTERISTIC KINP_AmbLightColorSet_enum_ovrdflg "" VALUE 0x0000 /* @ECU_Address@KINP_AmbLightColorSet_enum_ovrdflg@ */ Scalar_BOOLEAN 0 SWC_INP_type_CM_boolean_flg 0.0 1.0 /end CHARACTERISTIC
/begin CHARACTERISTIC KINP_AmbLightDimInDarkSW_flg_defval "" VALUE 0x0000 /* @ECU_Address@KINP_AmbLightDimInDarkSW_flg_defval@ */ Scalar_BOOLEAN 0 SWC_INP_type_CM_boolean_flg 0.0 1.0 /end CHARACTERISTIC
/begin CHARACTERISTIC KINP_AmbLightDimInDarkSW_flg_ovrdflg "" VALUE 0x0000 /* @ECU_Address@KINP_AmbLightDimInDarkSW_flg_ovrdflg@ */ Scalar_BOOLEAN 0 SWC_INP_type_CM_boolean_flg 0.0 1.0 /end CHARACTERISTIC
/begin CHARACTERISTIC KINP_AmbLightDimInDarkSW_flg_ovrdval "" VALUE 0x0000 /* @ECU_Address@KINP_AmbLightDimInDarkSW_flg_ovrdval@ */ Scalar_BOOLEAN 0 SWC_INP_type_CM_boolean_flg 0.0 1.0 /end CHARACTERISTIC
/begin CHARACTERISTIC KINP_AmbLightSW_flg_defval "" VALUE 0x0000 /* @ECU_Address@KINP_AmbLightSW_flg_defval@ */ Scalar_BOOLEAN 0 SWC_INP_type_CM_boolean_flg 0.0 1.0 /end CHARACTERISTIC
/begin CHARACTERISTIC KINP_AmbLightSW_flg_ovrdflg "" VALUE 0x0000 /* @ECU_Address@KINP_AmbLightSW_flg_ovrdflg@ */ Scalar_BOOLEAN 0 SWC_INP_type_CM_boolean_flg 0.0 1.0 /end CHARACTERISTIC
/begin CHARACTERISTIC KINP_AmbLightSW_flg_ovrdval "" VALUE 0x0000 /* @ECU_Address@KINP_AmbLightSW_flg_ovrdval@ */ Scalar_BOOLEAN 0 SWC_INP_type_CM_boolean_flg 0.0 1.0 /end CHARACTERISTIC
/begin CHARACTERISTIC KINP_AmbLightWlcmLightSW_flg_defval "" VALUE 0x0000 /* @ECU_Address@KINP_AmbLightWlcmLightSW_flg_defval@ */ Scalar_BOOLEAN 0 SWC_INP_type_CM_boolean_flg 0.0 1.0 /end CHARACTERISTIC
/begin CHARACTERISTIC KINP_AmbLightWlcmLightSW_flg_ovrdflg "" VALUE 0x0000 /* @ECU_Address@KINP_AmbLightWlcmLightSW_flg_ovrdflg@ */ Scalar_BOOLEAN 0 SWC_INP_type_CM_boolean_flg 0.0 1.0 /end CHARACTERISTIC
/begin CHARACTERISTIC KINP_AmbLightWlcmLightSW_flg_ovrdval "" VALUE 0x0000 /* @ECU_Address@KINP_AmbLightWlcmLightSW_flg_ovrdval@ */ Scalar_BOOLEAN 0 SWC_INP_type_CM_boolean_flg 0.0 1.0 /end CHARACTERISTIC
/begin CHARACTERISTIC KINP_ApproachUnlockSW_flg_defval "" VALUE 0x0000 /* @ECU_Address@KINP_ApproachUnlockSW_flg_defval@ */ Scalar_BOOLEAN 0 SWC_INP_type_CM_boolean_flg 0.0 1.0 /end CHARACTERISTIC
/begin CHARACTERISTIC KINP_ApproachUnlockSW_flg_ovrdflg "" VALUE 0x0000 /* @ECU_Address@KINP_ApproachUnlockSW_flg_ovrdflg@ */ Scalar_BOOLEAN 0 SWC_INP_type_CM_boolean_flg 0.0 1.0 /end CHARACTERISTIC
/begin CHARACTERISTIC KINP_ApproachUnlockSW_flg_ovrdval "" VALUE 0x0000 /* @ECU_Address@KINP_ApproachUnlockSW_flg_ovrdval@ */ Scalar_BOOLEAN 0 SWC_INP_type_CM_boolean_flg 0.0 1.0 /end CHARACTERISTIC
/begin CHARACTERISTIC KINP_BrkDiscTempSta_flg_defval "" VALUE 0x0000 /* @ECU_Address@KINP_BrkDiscTempSta_flg_defval@ */ Scalar_BOOLEAN 0 SWC_INP_type_CM_boolean_flg 0.0 1.0 /end CHARACTERISTIC
/begin CHARACTERISTIC KINP_BrkDiscTempSta_flg_ovrdflg "" VALUE 0x0000 /* @ECU_Address@KINP_BrkDiscTempSta_flg_ovrdflg@ */ Scalar_BOOLEAN 0 SWC_INP_type_CM_boolean_flg 0.0 1.0 /end CHARACTERISTIC
/begin CHARACTERISTIC KINP_BrkDiscTempSta_flg_ovrdval "" VALUE 0x0000 /* @ECU_Address@KINP_BrkDiscTempSta_flg_ovrdval@ */ Scalar_BOOLEAN 0 SWC_INP_type_CM_boolean_flg 0.0 1.0 /end CHARACTERISTIC
/begin CHARACTERISTIC KINP_BrkPedalPosSta_flg_defval "" VALUE 0x0000 /* @ECU_Address@KINP_BrkPedalPosSta_flg_defval@ */ Scalar_BOOLEAN 0 SWC_INP_type_CM_boolean_flg 0.0 1.0 /end CHARACTERISTIC
/begin CHARACTERISTIC KINP_BrkPedalPosSta_flg_ovrdflg "" VALUE 0x0000 /* @ECU_Address@KINP_BrkPedalPosSta_flg_ovrdflg@ */ Scalar_BOOLEAN 0 SWC_INP_type_CM_boolean_flg 0.0 1.0 /end CHARACTERISTIC
/begin CHARACTERISTIC KINP_BrkPedalPosSta_flg_ovrdval "" VALUE 0x0000 /* @ECU_Address@KINP_BrkPedalPosSta_flg_ovrdval@ */ Scalar_BOOLEAN 0 SWC_INP_type_CM_boolean_flg 0.0 1.0 /end CHARACTERISTIC
/begin CHARACTERISTIC KINP_BrkPedalPos_pct_ovrdflg "" VALUE 0x0000 /* @ECU_Address@KINP_BrkPedalPos_pct_ovrdflg@ */ Scalar_BOOLEAN 0 SWC_INP_type_CM_boolean_flg 0.0 1.0 /end CHARACTERISTIC
/begin CHARACTERISTIC KINP_BrkSwSta_flg_defval "" VALUE 0x0000 /* @ECU_Address@KINP_BrkSwSta_flg_defval@ */ Scalar_BOOLEAN 0 SWC_INP_type_CM_boolean_flg 0.0 1.0 /end CHARACTERISTIC
/begin CHARACTERISTIC KINP_BrkSwSta_flg_ovrdflg "" VALUE 0x0000 /* @ECU_Address@KINP_BrkSwSta_flg_ovrdflg@ */ Scalar_BOOLEAN 0 SWC_INP_type_CM_boolean_flg 0.0 1.0 /end CHARACTERISTIC
/begin CHARACTERISTIC KINP_BrkSwSta_flg_ovrdval "" VALUE 0x0000 /* @ECU_Address@KINP_BrkSwSta_flg_ovrdval@ */ Scalar_BOOLEAN 0 SWC_INP_type_CM_boolean_flg 0.0 1.0 /end CHARACTERISTIC
/begin CHARACTERISTIC KINP_BrkSwV_flg_defval "" VALUE 0x0000 /* @ECU_Address@KINP_BrkSwV_flg_defval@ */ Scalar_BOOLEAN 0 SWC_INP_type_CM_boolean_flg 0.0 1.0 /end CHARACTERISTIC
/begin CHARACTERISTIC KINP_BrkSwV_flg_ovrdflg "" VALUE 0x0000 /* @ECU_Address@KINP_BrkSwV_flg_ovrdflg@ */ Scalar_BOOLEAN 0 SWC_INP_type_CM_boolean_flg 0.0 1.0 /end CHARACTERISTIC
/begin CHARACTERISTIC KINP_BrkSwV_flg_ovrdval "" VALUE 0x0000 /* @ECU_Address@KINP_BrkSwV_flg_ovrdval@ */ Scalar_BOOLEAN 0 SWC_INP_type_CM_boolean_flg 0.0 1.0 /end CHARACTERISTIC
/begin CHARACTERISTIC KINP_CAASSw_enum_ovrdflg "" VALUE 0x0000 /* @ECU_Address@KINP_CAASSw_enum_ovrdflg@ */ Scalar_BOOLEAN 0 SWC_INP_type_CM_boolean_flg 0.0 1.0 /end CHARACTERISTIC
/begin CHARACTERISTIC KINP_CDLLockButt_flg_defval "" VALUE 0x0000 /* @ECU_Address@KINP_CDLLockButt_flg_defval@ */ Scalar_BOOLEAN 0 SWC_INP_type_CM_boolean_flg 0.0 1.0 /end CHARACTERISTIC
/begin CHARACTERISTIC KINP_CDLLockButt_flg_ovrdflg "" VALUE 0x0000 /* @ECU_Address@KINP_CDLLockButt_flg_ovrdflg@ */ Scalar_BOOLEAN 0 SWC_INP_type_CM_boolean_flg 0.0 1.0 /end CHARACTERISTIC
/begin CHARACTERISTIC KINP_CDLLockButt_flg_ovrdval "" VALUE 0x0000 /* @ECU_Address@KINP_CDLLockButt_flg_ovrdval@ */ Scalar_BOOLEAN 0 SWC_INP_type_CM_boolean_flg 0.0 1.0 /end CHARACTERISTIC
/begin CHARACTERISTIC KINP_CDLUnlockButt_flg_defval "" VALUE 0x0000 /* @ECU_Address@KINP_CDLUnlockButt_flg_defval@ */ Scalar_BOOLEAN 0 SWC_INP_type_CM_boolean_flg 0.0 1.0 /end CHARACTERISTIC
/begin CHARACTERISTIC KINP_CDLUnlockButt_flg_ovrdflg "" VALUE 0x0000 /* @ECU_Address@KINP_CDLUnlockButt_flg_ovrdflg@ */ Scalar_BOOLEAN 0 SWC_INP_type_CM_boolean_flg 0.0 1.0 /end CHARACTERISTIC
/begin CHARACTERISTIC KINP_CDLUnlockButt_flg_ovrdval "" VALUE 0x0000 /* @ECU_Address@KINP_CDLUnlockButt_flg_ovrdval@ */ Scalar_BOOLEAN 0 SWC_INP_type_CM_boolean_flg 0.0 1.0 /end CHARACTERISTIC
/begin CHARACTERISTIC KINP_DSEATantiset_flg_defval "" VALUE 0x0000 /* @ECU_Address@KINP_DSEATantiset_flg_defval@ */ Scalar_BOOLEAN 0 SWC_INP_type_CM_boolean_flg 0.0 1.0 /end CHARACTERISTIC
/begin CHARACTERISTIC KINP_DSEATantiset_flg_ovrdflg "" VALUE 0x0000 /* @ECU_Address@KINP_DSEATantiset_flg_ovrdflg@ */ Scalar_BOOLEAN 0 SWC_INP_type_CM_boolean_flg 0.0 1.0 /end CHARACTERISTIC
/begin CHARACTERISTIC KINP_DSEATantiset_flg_ovrdval "" VALUE 0x0000 /* @ECU_Address@KINP_DSEATantiset_flg_ovrdval@ */ Scalar_BOOLEAN 0 SWC_INP_type_CM_boolean_flg 0.0 1.0 /end CHARACTERISTIC
/begin CHARACTERISTIC KINP_DSEATentryfunset_flg_defval "" VALUE 0x0000 /* @ECU_Address@KINP_DSEATentryfunset_flg_defval@ */ Scalar_BOOLEAN 0 SWC_INP_type_CM_boolean_flg 0.0 1.0 /end CHARACTERISTIC
/begin CHARACTERISTIC KINP_DSEATentryfunset_flg_ovrdflg "" VALUE 0x0000 /* @ECU_Address@KINP_DSEATentryfunset_flg_ovrdflg@ */ Scalar_BOOLEAN 0 SWC_INP_type_CM_boolean_flg 0.0 1.0 /end CHARACTERISTIC
/begin CHARACTERISTIC KINP_DSEATentryfunset_flg_ovrdval "" VALUE 0x0000 /* @ECU_Address@KINP_DSEATentryfunset_flg_ovrdval@ */ Scalar_BOOLEAN 0 SWC_INP_type_CM_boolean_flg 0.0 1.0 /end CHARACTERISTIC
/begin CHARACTERISTIC KINP_DSEATventreq_enum_ovrdflg "" VALUE 0x0000 /* @ECU_Address@KINP_DSEATventreq_enum_ovrdflg@ */ Scalar_BOOLEAN 0 SWC_INP_type_CM_boolean_flg 0.0 1.0 /end CHARACTERISTIC
/begin CHARACTERISTIC KINP_Distanceunit_flg_defval "" VALUE 0x0000 /* @ECU_Address@KINP_Distanceunit_flg_defval@ */ Scalar_BOOLEAN 0 SWC_INP_type_CM_boolean_flg 0.0 1.0 /end CHARACTERISTIC
/begin CHARACTERISTIC KINP_Distanceunit_flg_ovrdflg "" VALUE 0x0000 /* @ECU_Address@KINP_Distanceunit_flg_ovrdflg@ */ Scalar_BOOLEAN 0 SWC_INP_type_CM_boolean_flg 0.0 1.0 /end CHARACTERISTIC
/begin CHARACTERISTIC KINP_Distanceunit_flg_ovrdval "" VALUE 0x0000 /* @ECU_Address@KINP_Distanceunit_flg_ovrdval@ */ Scalar_BOOLEAN 0 SWC_INP_type_CM_boolean_flg 0.0 1.0 /end CHARACTERISTIC
/begin CHARACTERISTIC KINP_ESC5CSErr_flg_defval "" VALUE 0x0000 /* @ECU_Address@KINP_ESC5CSErr_flg_defval@ */ Scalar_BOOLEAN 0 SWC_INP_type_CM_boolean_flg 0.0 1.0 /end CHARACTERISTIC
/begin CHARACTERISTIC KINP_ESC5CSErr_flg_ovrdflg "" VALUE 0x0000 /* @ECU_Address@KINP_ESC5CSErr_flg_ovrdflg@ */ Scalar_BOOLEAN 0 SWC_INP_type_CM_boolean_flg 0.0 1.0 /end CHARACTERISTIC
/begin CHARACTERISTIC KINP_ESC5CSErr_flg_ovrdval "" VALUE 0x0000 /* @ECU_Address@KINP_ESC5CSErr_flg_ovrdval@ */ Scalar_BOOLEAN 0 SWC_INP_type_CM_boolean_flg 0.0 1.0 /end CHARACTERISTIC
/begin CHARACTERISTIC KINP_ESC5CS_enum_ovrdflg "" VALUE 0x0000 /* @ECU_Address@KINP_ESC5CS_enum_ovrdflg@ */ Scalar_BOOLEAN 0 SWC_INP_type_CM_boolean_flg 0.0 1.0 /end CHARACTERISTIC
/begin CHARACTERISTIC KINP_ESC5RCErr_flg_defval "" VALUE 0x0000 /* @ECU_Address@KINP_ESC5RCErr_flg_defval@ */ Scalar_BOOLEAN 0 SWC_INP_type_CM_boolean_flg 0.0 1.0 /end CHARACTERISTIC
/begin CHARACTERISTIC KINP_ESC5RCErr_flg_ovrdflg "" VALUE 0x0000 /* @ECU_Address@KINP_ESC5RCErr_flg_ovrdflg@ */ Scalar_BOOLEAN 0 SWC_INP_type_CM_boolean_flg 0.0 1.0 /end CHARACTERISTIC
/begin CHARACTERISTIC KINP_ESC5RCErr_flg_ovrdval "" VALUE 0x0000 /* @ECU_Address@KINP_ESC5RCErr_flg_ovrdval@ */ Scalar_BOOLEAN 0 SWC_INP_type_CM_boolean_flg 0.0 1.0 /end CHARACTERISTIC
/begin CHARACTERISTIC KINP_ESC5RC_enum_ovrdflg "" VALUE 0x0000 /* @ECU_Address@KINP_ESC5RC_enum_ovrdflg@ */ Scalar_BOOLEAN 0 SWC_INP_type_CM_boolean_flg 0.0 1.0 /end CHARACTERISTIC
/begin CHARACTERISTIC KINP_ESCADASSta_enum_ovrdflg "" VALUE 0x0000 /* @ECU_Address@KINP_ESCADASSta_enum_ovrdflg@ */ Scalar_BOOLEAN 0 SWC_INP_type_CM_boolean_flg 0.0 1.0 /end CHARACTERISTIC
/begin CHARACTERISTIC KINP_ESCAPSSta_enum_ovrdflg "" VALUE 0x0000 /* @ECU_Address@KINP_ESCAPSSta_enum_ovrdflg@ */ Scalar_BOOLEAN 0 SWC_INP_type_CM_boolean_flg 0.0 1.0 /end CHARACTERISTIC
/begin CHARACTERISTIC KINP_ESCSWCmd_enum_ovrdflg "" VALUE 0x0000 /* @ECU_Address@KINP_ESCSWCmd_enum_ovrdflg@ */ Scalar_BOOLEAN 0 SWC_INP_type_CM_boolean_flg 0.0 1.0 /end CHARACTERISTIC
/begin CHARACTERISTIC KINP_ESCStandstill_flg_defval "" VALUE 0x0000 /* @ECU_Address@KINP_ESCStandstill_flg_defval@ */ Scalar_BOOLEAN 0 SWC_INP_type_CM_boolean_flg 0.0 1.0 /end CHARACTERISTIC
/begin CHARACTERISTIC KINP_ESCStandstill_flg_ovrdflg "" VALUE 0x0000 /* @ECU_Address@KINP_ESCStandstill_flg_ovrdflg@ */ Scalar_BOOLEAN 0 SWC_INP_type_CM_boolean_flg 0.0 1.0 /end CHARACTERISTIC
/begin CHARACTERISTIC KINP_ESCStandstill_flg_ovrdval "" VALUE 0x0000 /* @ECU_Address@KINP_ESCStandstill_flg_ovrdval@ */ Scalar_BOOLEAN 0 SWC_INP_type_CM_boolean_flg 0.0 1.0 /end CHARACTERISTIC
/begin CHARACTERISTIC KINP_FCPFrEvtBtnACMaxReq_flg_defval "" VALUE 0x0000 /* @ECU_Address@KINP_FCPFrEvtBtnACMaxReq_flg_defval@ */ Scalar_BOOLEAN 0 SWC_INP_type_CM_boolean_flg 0.0 1.0 /end CHARACTERISTIC
/begin CHARACTERISTIC KINP_FCPFrEvtBtnACMaxReq_flg_ovrdflg "" VALUE 0x0000 /* @ECU_Address@KINP_FCPFrEvtBtnACMaxReq_flg_ovrdflg@ */ Scalar_BOOLEAN 0 SWC_INP_type_CM_boolean_flg 0.0 1.0 /end CHARACTERISTIC
/begin CHARACTERISTIC KINP_FCPFrEvtBtnACMaxReq_flg_ovrdval "" VALUE 0x0000 /* @ECU_Address@KINP_FCPFrEvtBtnACMaxReq_flg_ovrdval@ */ Scalar_BOOLEAN 0 SWC_INP_type_CM_boolean_flg 0.0 1.0 /end CHARACTERISTIC
/begin CHARACTERISTIC KINP_FCPFrEvtBtnACReq_flg_defval "" VALUE 0x0000 /* @ECU_Address@KINP_FCPFrEvtBtnACReq_flg_defval@ */ Scalar_BOOLEAN 0 SWC_INP_type_CM_boolean_flg 0.0 1.0 /end CHARACTERISTIC
/begin CHARACTERISTIC KINP_FCPFrEvtBtnACReq_flg_ovrdflg "" VALUE 0x0000 /* @ECU_Address@KINP_FCPFrEvtBtnACReq_flg_ovrdflg@ */ Scalar_BOOLEAN 0 SWC_INP_type_CM_boolean_flg 0.0 1.0 /end CHARACTERISTIC
/begin CHARACTERISTIC KINP_FCPFrEvtBtnACReq_flg_ovrdval "" VALUE 0x0000 /* @ECU_Address@KINP_FCPFrEvtBtnACReq_flg_ovrdval@ */ Scalar_BOOLEAN 0 SWC_INP_type_CM_boolean_flg 0.0 1.0 /end CHARACTERISTIC
/begin CHARACTERISTIC KINP_FCPFrEvtBtnAutoReq_flg_defval "" VALUE 0x0000 /* @ECU_Address@KINP_FCPFrEvtBtnAutoReq_flg_defval@ */ Scalar_BOOLEAN 0 SWC_INP_type_CM_boolean_flg 0.0 1.0 /end CHARACTERISTIC
/begin CHARACTERISTIC KINP_FCPFrEvtBtnAutoReq_flg_ovrdflg "" VALUE 0x0000 /* @ECU_Address@KINP_FCPFrEvtBtnAutoReq_flg_ovrdflg@ */ Scalar_BOOLEAN 0 SWC_INP_type_CM_boolean_flg 0.0 1.0 /end CHARACTERISTIC
/begin CHARACTERISTIC KINP_FCPFrEvtBtnAutoReq_flg_ovrdval "" VALUE 0x0000 /* @ECU_Address@KINP_FCPFrEvtBtnAutoReq_flg_ovrdval@ */ Scalar_BOOLEAN 0 SWC_INP_type_CM_boolean_flg 0.0 1.0 /end CHARACTERISTIC
/begin CHARACTERISTIC KINP_FCPFrEvtBtnSyncReq_flg_defval "" VALUE 0x0000 /* @ECU_Address@KINP_FCPFrEvtBtnSyncReq_flg_defval@ */ Scalar_BOOLEAN 0 SWC_INP_type_CM_boolean_flg 0.0 1.0 /end CHARACTERISTIC
/begin CHARACTERISTIC KINP_FCPFrEvtBtnSyncReq_flg_ovrdflg "" VALUE 0x0000 /* @ECU_Address@KINP_FCPFrEvtBtnSyncReq_flg_ovrdflg@ */ Scalar_BOOLEAN 0 SWC_INP_type_CM_boolean_flg 0.0 1.0 /end CHARACTERISTIC
/begin CHARACTERISTIC KINP_FCPFrEvtBtnSyncReq_flg_ovrdval "" VALUE 0x0000 /* @ECU_Address@KINP_FCPFrEvtBtnSyncReq_flg_ovrdval@ */ Scalar_BOOLEAN 0 SWC_INP_type_CM_boolean_flg 0.0 1.0 /end CHARACTERISTIC
/begin CHARACTERISTIC KINP_FSOffSw_enum_ovrdflg "" VALUE 0x0000 /* @ECU_Address@KINP_FSOffSw_enum_ovrdflg@ */ Scalar_BOOLEAN 0 SWC_INP_type_CM_boolean_flg 0.0 1.0 /end CHARACTERISTIC
/begin CHARACTERISTIC KINP_FollowMeSW_flg_defval "" VALUE 0x0000 /* @ECU_Address@KINP_FollowMeSW_flg_defval@ */ Scalar_BOOLEAN 0 SWC_INP_type_CM_boolean_flg 0.0 1.0 /end CHARACTERISTIC
/begin CHARACTERISTIC KINP_FollowMeSW_flg_ovrdflg "" VALUE 0x0000 /* @ECU_Address@KINP_FollowMeSW_flg_ovrdflg@ */ Scalar_BOOLEAN 0 SWC_INP_type_CM_boolean_flg 0.0 1.0 /end CHARACTERISTIC
/begin CHARACTERISTIC KINP_FollowMeSW_flg_ovrdval "" VALUE 0x0000 /* @ECU_Address@KINP_FollowMeSW_flg_ovrdval@ */ Scalar_BOOLEAN 0 SWC_INP_type_CM_boolean_flg 0.0 1.0 /end CHARACTERISTIC
/begin CHARACTERISTIC KINP_FrRBCActive_flg_defval "" VALUE 0x0000 /* @ECU_Address@KINP_FrRBCActive_flg_defval@ */ Scalar_BOOLEAN 0 SWC_INP_type_CM_boolean_flg 0.0 1.0 /end CHARACTERISTIC
/begin CHARACTERISTIC KINP_FrRBCActive_flg_ovrdflg "" VALUE 0x0000 /* @ECU_Address@KINP_FrRBCActive_flg_ovrdflg@ */ Scalar_BOOLEAN 0 SWC_INP_type_CM_boolean_flg 0.0 1.0 /end CHARACTERISTIC
/begin CHARACTERISTIC KINP_FrRBCActive_flg_ovrdval "" VALUE 0x0000 /* @ECU_Address@KINP_FrRBCActive_flg_ovrdval@ */ Scalar_BOOLEAN 0 SWC_INP_type_CM_boolean_flg 0.0 1.0 /end CHARACTERISTIC
/begin CHARACTERISTIC KINP_FrntAxlTrqReqBrk_Nm_ovrdflg "" VALUE 0x0000 /* @ECU_Address@KINP_FrntAxlTrqReqBrk_Nm_ovrdflg@ */ Scalar_BOOLEAN 0 SWC_INP_type_CM_boolean_flg 0.0 1.0 /end CHARACTERISTIC
/begin CHARACTERISTIC KINP_GPSLAT_s_ovrdflg "" VALUE 0x0000 /* @ECU_Address@KINP_GPSLAT_s_ovrdflg@ */ Scalar_BOOLEAN 0 SWC_INP_type_CM_boolean_flg 0.0 1.0 /end CHARACTERISTIC
/begin CHARACTERISTIC KINP_GPSLONG_enum_ovrdflg "" VALUE 0x0000 /* @ECU_Address@KINP_GPSLONG_enum_ovrdflg@ */ Scalar_BOOLEAN 0 SWC_INP_type_CM_boolean_flg 0.0 1.0 /end CHARACTERISTIC
/begin CHARACTERISTIC KINP_HMIACAirIntMCmd_flg_defval "" VALUE 0x0000 /* @ECU_Address@KINP_HMIACAirIntMCmd_flg_defval@ */ Scalar_BOOLEAN 0 SWC_INP_type_CM_boolean_flg 0.0 1.0 /end CHARACTERISTIC
/begin CHARACTERISTIC KINP_HMIACAirIntMCmd_flg_ovrdflg "" VALUE 0x0000 /* @ECU_Address@KINP_HMIACAirIntMCmd_flg_ovrdflg@ */ Scalar_BOOLEAN 0 SWC_INP_type_CM_boolean_flg 0.0 1.0 /end CHARACTERISTIC
/begin CHARACTERISTIC KINP_HMIACAirIntMCmd_flg_ovrdval "" VALUE 0x0000 /* @ECU_Address@KINP_HMIACAirIntMCmd_flg_ovrdval@ */ Scalar_BOOLEAN 0 SWC_INP_type_CM_boolean_flg 0.0 1.0 /end CHARACTERISTIC
/begin CHARACTERISTIC KINP_HMIACAirIntPCmd_flg_defval "" VALUE 0x0000 /* @ECU_Address@KINP_HMIACAirIntPCmd_flg_defval@ */ Scalar_BOOLEAN 0 SWC_INP_type_CM_boolean_flg 0.0 1.0 /end CHARACTERISTIC
/begin CHARACTERISTIC KINP_HMIACAirIntPCmd_flg_ovrdflg "" VALUE 0x0000 /* @ECU_Address@KINP_HMIACAirIntPCmd_flg_ovrdflg@ */ Scalar_BOOLEAN 0 SWC_INP_type_CM_boolean_flg 0.0 1.0 /end CHARACTERISTIC
/begin CHARACTERISTIC KINP_HMIACAirIntPCmd_flg_ovrdval "" VALUE 0x0000 /* @ECU_Address@KINP_HMIACAirIntPCmd_flg_ovrdval@ */ Scalar_BOOLEAN 0 SWC_INP_type_CM_boolean_flg 0.0 1.0 /end CHARACTERISTIC
/begin CHARACTERISTIC KINP_HMIACAutoBtnCmd_flg_defval "" VALUE 0x0000 /* @ECU_Address@KINP_HMIACAutoBtnCmd_flg_defval@ */ Scalar_BOOLEAN 0 SWC_INP_type_CM_boolean_flg 0.0 1.0 /end CHARACTERISTIC
/begin CHARACTERISTIC KINP_HMIACAutoBtnCmd_flg_ovrdflg "" VALUE 0x0000 /* @ECU_Address@KINP_HMIACAutoBtnCmd_flg_ovrdflg@ */ Scalar_BOOLEAN 0 SWC_INP_type_CM_boolean_flg 0.0 1.0 /end CHARACTERISTIC
/begin CHARACTERISTIC KINP_HMIACAutoBtnCmd_flg_ovrdval "" VALUE 0x0000 /* @ECU_Address@KINP_HMIACAutoBtnCmd_flg_ovrdval@ */ Scalar_BOOLEAN 0 SWC_INP_type_CM_boolean_flg 0.0 1.0 /end CHARACTERISTIC
/begin CHARACTERISTIC KINP_HMIACBtnCmd_flg_defval "" VALUE 0x0000 /* @ECU_Address@KINP_HMIACBtnCmd_flg_defval@ */ Scalar_BOOLEAN 0 SWC_INP_type_CM_boolean_flg 0.0 1.0 /end CHARACTERISTIC
/begin CHARACTERISTIC KINP_HMIACBtnCmd_flg_ovrdflg "" VALUE 0x0000 /* @ECU_Address@KINP_HMIACBtnCmd_flg_ovrdflg@ */ Scalar_BOOLEAN 0 SWC_INP_type_CM_boolean_flg 0.0 1.0 /end CHARACTERISTIC
/begin CHARACTERISTIC KINP_HMIACBtnCmd_flg_ovrdval "" VALUE 0x0000 /* @ECU_Address@KINP_HMIACBtnCmd_flg_ovrdval@ */ Scalar_BOOLEAN 0 SWC_INP_type_CM_boolean_flg 0.0 1.0 /end CHARACTERISTIC
/begin CHARACTERISTIC KINP_HMIACFrDefogBtnCmd_flg_defval "" VALUE 0x0000 /* @ECU_Address@KINP_HMIACFrDefogBtnCmd_flg_defval@ */ Scalar_BOOLEAN 0 SWC_INP_type_CM_boolean_flg 0.0 1.0 /end CHARACTERISTIC
/begin CHARACTERISTIC KINP_HMIACFrDefogBtnCmd_flg_ovrdflg "" VALUE 0x0000 /* @ECU_Address@KINP_HMIACFrDefogBtnCmd_flg_ovrdflg@ */ Scalar_BOOLEAN 0 SWC_INP_type_CM_boolean_flg 0.0 1.0 /end CHARACTERISTIC
/begin CHARACTERISTIC KINP_HMIACFrDefogBtnCmd_flg_ovrdval "" VALUE 0x0000 /* @ECU_Address@KINP_HMIACFrDefogBtnCmd_flg_ovrdval@ */ Scalar_BOOLEAN 0 SWC_INP_type_CM_boolean_flg 0.0 1.0 /end CHARACTERISTIC
/begin CHARACTERISTIC KINP_HMIACRecycleBtnCmd_flg_defval "" VALUE 0x0000 /* @ECU_Address@KINP_HMIACRecycleBtnCmd_flg_defval@ */ Scalar_BOOLEAN 0 SWC_INP_type_CM_boolean_flg 0.0 1.0 /end CHARACTERISTIC
/begin CHARACTERISTIC KINP_HMIACRecycleBtnCmd_flg_ovrdflg "" VALUE 0x0000 /* @ECU_Address@KINP_HMIACRecycleBtnCmd_flg_ovrdflg@ */ Scalar_BOOLEAN 0 SWC_INP_type_CM_boolean_flg 0.0 1.0 /end CHARACTERISTIC
/begin CHARACTERISTIC KINP_HMIACRecycleBtnCmd_flg_ovrdval "" VALUE 0x0000 /* @ECU_Address@KINP_HMIACRecycleBtnCmd_flg_ovrdval@ */ Scalar_BOOLEAN 0 SWC_INP_type_CM_boolean_flg 0.0 1.0 /end CHARACTERISTIC
/begin CHARACTERISTIC KINP_HMIACWindDirMCmd_flg_defval "" VALUE 0x0000 /* @ECU_Address@KINP_HMIACWindDirMCmd_flg_defval@ */ Scalar_BOOLEAN 0 SWC_INP_type_CM_boolean_flg 0.0 1.0 /end CHARACTERISTIC
/begin CHARACTERISTIC KINP_HMIACWindDirMCmd_flg_ovrdflg "" VALUE 0x0000 /* @ECU_Address@KINP_HMIACWindDirMCmd_flg_ovrdflg@ */ Scalar_BOOLEAN 0 SWC_INP_type_CM_boolean_flg 0.0 1.0 /end CHARACTERISTIC
/begin CHARACTERISTIC KINP_HMIACWindDirMCmd_flg_ovrdval "" VALUE 0x0000 /* @ECU_Address@KINP_HMIACWindDirMCmd_flg_ovrdval@ */ Scalar_BOOLEAN 0 SWC_INP_type_CM_boolean_flg 0.0 1.0 /end CHARACTERISTIC
/begin CHARACTERISTIC KINP_HMIACWindDirPCmd_flg_defval "" VALUE 0x0000 /* @ECU_Address@KINP_HMIACWindDirPCmd_flg_defval@ */ Scalar_BOOLEAN 0 SWC_INP_type_CM_boolean_flg 0.0 1.0 /end CHARACTERISTIC
/begin CHARACTERISTIC KINP_HMIACWindDirPCmd_flg_ovrdflg "" VALUE 0x0000 /* @ECU_Address@KINP_HMIACWindDirPCmd_flg_ovrdflg@ */ Scalar_BOOLEAN 0 SWC_INP_type_CM_boolean_flg 0.0 1.0 /end CHARACTERISTIC
/begin CHARACTERISTIC KINP_HMIACWindDirPCmd_flg_ovrdval "" VALUE 0x0000 /* @ECU_Address@KINP_HMIACWindDirPCmd_flg_ovrdval@ */ Scalar_BOOLEAN 0 SWC_INP_type_CM_boolean_flg 0.0 1.0 /end CHARACTERISTIC
/begin CHARACTERISTIC KINP_HMIAutoInterLightCmd_flg_defval "" VALUE 0x0000 /* @ECU_Address@KINP_HMIAutoInterLightCmd_flg_defval@ */ Scalar_BOOLEAN 0 SWC_INP_type_CM_boolean_flg 0.0 1.0 /end CHARACTERISTIC
/begin CHARACTERISTIC KINP_HMIAutoInterLightCmd_flg_ovrdflg "" VALUE 0x0000 /* @ECU_Address@KINP_HMIAutoInterLightCmd_flg_ovrdflg@ */ Scalar_BOOLEAN 0 SWC_INP_type_CM_boolean_flg 0.0 1.0 /end CHARACTERISTIC
/begin CHARACTERISTIC KINP_HMIAutoInterLightCmd_flg_ovrdval "" VALUE 0x0000 /* @ECU_Address@KINP_HMIAutoInterLightCmd_flg_ovrdval@ */ Scalar_BOOLEAN 0 SWC_INP_type_CM_boolean_flg 0.0 1.0 /end CHARACTERISTIC
/begin CHARACTERISTIC KINP_HMIBCMPostDefogBtnCmd_flg_defval "" VALUE 0x0000 /* @ECU_Address@KINP_HMIBCMPostDefogBtnCmd_flg_defval@ */ Scalar_BOOLEAN 0 SWC_INP_type_CM_boolean_flg 0.0 1.0 /end CHARACTERISTIC
/begin CHARACTERISTIC KINP_HMIBCMPostDefogBtnCmd_flg_ovrdflg "" VALUE 0x0000 /* @ECU_Address@KINP_HMIBCMPostDefogBtnCmd_flg_ovrdflg@ */ Scalar_BOOLEAN 0 SWC_INP_type_CM_boolean_flg 0.0 1.0 /end CHARACTERISTIC
/begin CHARACTERISTIC KINP_HMIBCMPostDefogBtnCmd_flg_ovrdval "" VALUE 0x0000 /* @ECU_Address@KINP_HMIBCMPostDefogBtnCmd_flg_ovrdval@ */ Scalar_BOOLEAN 0 SWC_INP_type_CM_boolean_flg 0.0 1.0 /end CHARACTERISTIC
/begin CHARACTERISTIC KINP_HMIZLSetTMCmd_flg_defval "" VALUE 0x0000 /* @ECU_Address@KINP_HMIZLSetTMCmd_flg_defval@ */ Scalar_BOOLEAN 0 SWC_INP_type_CM_boolean_flg 0.0 1.0 /end CHARACTERISTIC
/begin CHARACTERISTIC KINP_HMIZLSetTMCmd_flg_ovrdflg "" VALUE 0x0000 /* @ECU_Address@KINP_HMIZLSetTMCmd_flg_ovrdflg@ */ Scalar_BOOLEAN 0 SWC_INP_type_CM_boolean_flg 0.0 1.0 /end CHARACTERISTIC
/begin CHARACTERISTIC KINP_HMIZLSetTMCmd_flg_ovrdval "" VALUE 0x0000 /* @ECU_Address@KINP_HMIZLSetTMCmd_flg_ovrdval@ */ Scalar_BOOLEAN 0 SWC_INP_type_CM_boolean_flg 0.0 1.0 /end CHARACTERISTIC
/begin CHARACTERISTIC KINP_HMIZLSetTPCmd_flg_defval "" VALUE 0x0000 /* @ECU_Address@KINP_HMIZLSetTPCmd_flg_defval@ */ Scalar_BOOLEAN 0 SWC_INP_type_CM_boolean_flg 0.0 1.0 /end CHARACTERISTIC
/begin CHARACTERISTIC KINP_HMIZLSetTPCmd_flg_ovrdflg "" VALUE 0x0000 /* @ECU_Address@KINP_HMIZLSetTPCmd_flg_ovrdflg@ */ Scalar_BOOLEAN 0 SWC_INP_type_CM_boolean_flg 0.0 1.0 /end CHARACTERISTIC
/begin CHARACTERISTIC KINP_HMIZLSetTPCmd_flg_ovrdval "" VALUE 0x0000 /* @ECU_Address@KINP_HMIZLSetTPCmd_flg_ovrdval@ */ Scalar_BOOLEAN 0 SWC_INP_type_CM_boolean_flg 0.0 1.0 /end CHARACTERISTIC
/begin CHARACTERISTIC KINP_HMIZRSetTMCmd_flg_defval "" VALUE 0x0000 /* @ECU_Address@KINP_HMIZRSetTMCmd_flg_defval@ */ Scalar_BOOLEAN 0 SWC_INP_type_CM_boolean_flg 0.0 1.0 /end CHARACTERISTIC
/begin CHARACTERISTIC KINP_HMIZRSetTMCmd_flg_ovrdflg "" VALUE 0x0000 /* @ECU_Address@KINP_HMIZRSetTMCmd_flg_ovrdflg@ */ Scalar_BOOLEAN 0 SWC_INP_type_CM_boolean_flg 0.0 1.0 /end CHARACTERISTIC
/begin CHARACTERISTIC KINP_HMIZRSetTMCmd_flg_ovrdval "" VALUE 0x0000 /* @ECU_Address@KINP_HMIZRSetTMCmd_flg_ovrdval@ */ Scalar_BOOLEAN 0 SWC_INP_type_CM_boolean_flg 0.0 1.0 /end CHARACTERISTIC
/begin CHARACTERISTIC KINP_HMIZRSetTPCmd_flg_defval "" VALUE 0x0000 /* @ECU_Address@KINP_HMIZRSetTPCmd_flg_defval@ */ Scalar_BOOLEAN 0 SWC_INP_type_CM_boolean_flg 0.0 1.0 /end CHARACTERISTIC
/begin CHARACTERISTIC KINP_HMIZRSetTPCmd_flg_ovrdflg "" VALUE 0x0000 /* @ECU_Address@KINP_HMIZRSetTPCmd_flg_ovrdflg@ */ Scalar_BOOLEAN 0 SWC_INP_type_CM_boolean_flg 0.0 1.0 /end CHARACTERISTIC
/begin CHARACTERISTIC KINP_HMIZRSetTPCmd_flg_ovrdval "" VALUE 0x0000 /* @ECU_Address@KINP_HMIZRSetTPCmd_flg_ovrdval@ */ Scalar_BOOLEAN 0 SWC_INP_type_CM_boolean_flg 0.0 1.0 /end CHARACTERISTIC
/begin CHARACTERISTIC KINP_HeadLampSW_enum_ovrdflg "" VALUE 0x0000 /* @ECU_Address@KINP_HeadLampSW_enum_ovrdflg@ */ Scalar_BOOLEAN 0 SWC_INP_type_CM_boolean_flg 0.0 1.0 /end CHARACTERISTIC
/begin CHARACTERISTIC KINP_HoodLatchSW_enum_ovrdflg "" VALUE 0x0000 /* @ECU_Address@KINP_HoodLatchSW_enum_ovrdflg@ */ Scalar_BOOLEAN 0 SWC_INP_type_CM_boolean_flg 0.0 1.0 /end CHARACTERISTIC
/begin CHARACTERISTIC KINP_IVIACCAdaptiveSta_flg_defval "" VALUE 0x0000 /* @ECU_Address@KINP_IVIACCAdaptiveSta_flg_defval@ */ Scalar_BOOLEAN 0 SWC_INP_type_CM_boolean_flg 0.0 1.0 /end CHARACTERISTIC
/begin CHARACTERISTIC KINP_IVIACCAdaptiveSta_flg_ovrdflg "" VALUE 0x0000 /* @ECU_Address@KINP_IVIACCAdaptiveSta_flg_ovrdflg@ */ Scalar_BOOLEAN 0 SWC_INP_type_CM_boolean_flg 0.0 1.0 /end CHARACTERISTIC
/begin CHARACTERISTIC KINP_IVIACCAdaptiveSta_flg_ovrdval "" VALUE 0x0000 /* @ECU_Address@KINP_IVIACCAdaptiveSta_flg_ovrdval@ */ Scalar_BOOLEAN 0 SWC_INP_type_CM_boolean_flg 0.0 1.0 /end CHARACTERISTIC
/begin CHARACTERISTIC KINP_IVIAirIntZ3Cmd_enum_ovrdflg "" VALUE 0x0000 /* @ECU_Address@KINP_IVIAirIntZ3Cmd_enum_ovrdflg@ */ Scalar_BOOLEAN 0 SWC_INP_type_CM_boolean_flg 0.0 1.0 /end CHARACTERISTIC
/begin CHARACTERISTIC KINP_IVIAutoWipHSpdSWCmd_flg_defval "" VALUE 0x0000 /* @ECU_Address@KINP_IVIAutoWipHSpdSWCmd_flg_defval@ */ Scalar_BOOLEAN 0 SWC_INP_type_CM_boolean_flg 0.0 1.0 /end CHARACTERISTIC
/begin CHARACTERISTIC KINP_IVIAutoWipHSpdSWCmd_flg_ovrdflg "" VALUE 0x0000 /* @ECU_Address@KINP_IVIAutoWipHSpdSWCmd_flg_ovrdflg@ */ Scalar_BOOLEAN 0 SWC_INP_type_CM_boolean_flg 0.0 1.0 /end CHARACTERISTIC
/begin CHARACTERISTIC KINP_IVIAutoWipHSpdSWCmd_flg_ovrdval "" VALUE 0x0000 /* @ECU_Address@KINP_IVIAutoWipHSpdSWCmd_flg_ovrdval@ */ Scalar_BOOLEAN 0 SWC_INP_type_CM_boolean_flg 0.0 1.0 /end CHARACTERISTIC
/begin CHARACTERISTIC KINP_IVICLBlowerYSta_pct_ovrdflg "" VALUE 0x0000 /* @ECU_Address@KINP_IVICLBlowerYSta_pct_ovrdflg@ */ Scalar_BOOLEAN 0 SWC_INP_type_CM_boolean_flg 0.0 1.0 /end CHARACTERISTIC
/begin CHARACTERISTIC KINP_IVICLBlowerZSta_pct_ovrdflg "" VALUE 0x0000 /* @ECU_Address@KINP_IVICLBlowerZSta_pct_ovrdflg@ */ Scalar_BOOLEAN 0 SWC_INP_type_CM_boolean_flg 0.0 1.0 /end CHARACTERISTIC
/begin CHARACTERISTIC KINP_IVICLWinLockDoorSWSta_flg_defval "" VALUE 0x0000 /* @ECU_Address@KINP_IVICLWinLockDoorSWSta_flg_defval@ */ Scalar_BOOLEAN 0 SWC_INP_type_CM_boolean_flg 0.0 1.0 /end CHARACTERISTIC
/begin CHARACTERISTIC KINP_IVICLWinLockDoorSWSta_flg_ovrdflg "" VALUE 0x0000 /* @ECU_Address@KINP_IVICLWinLockDoorSWSta_flg_ovrdflg@ */ Scalar_BOOLEAN 0 SWC_INP_type_CM_boolean_flg 0.0 1.0 /end CHARACTERISTIC
/begin CHARACTERISTIC KINP_IVICLWinLockDoorSWSta_flg_ovrdval "" VALUE 0x0000 /* @ECU_Address@KINP_IVICLWinLockDoorSWSta_flg_ovrdval@ */ Scalar_BOOLEAN 0 SWC_INP_type_CM_boolean_flg 0.0 1.0 /end CHARACTERISTIC
/begin CHARACTERISTIC KINP_IVICRBlowerYSta_pct_ovrdflg "" VALUE 0x0000 /* @ECU_Address@KINP_IVICRBlowerYSta_pct_ovrdflg@ */ Scalar_BOOLEAN 0 SWC_INP_type_CM_boolean_flg 0.0 1.0 /end CHARACTERISTIC
/begin CHARACTERISTIC KINP_IVICRBlowerZSta_pct_ovrdflg "" VALUE 0x0000 /* @ECU_Address@KINP_IVICRBlowerZSta_pct_ovrdflg@ */ Scalar_BOOLEAN 0 SWC_INP_type_CM_boolean_flg 0.0 1.0 /end CHARACTERISTIC
/begin CHARACTERISTIC KINP_IVICarWashModeCmd_flg_defval "" VALUE 0x0000 /* @ECU_Address@KINP_IVICarWashModeCmd_flg_defval@ */ Scalar_BOOLEAN 0 SWC_INP_type_CM_boolean_flg 0.0 1.0 /end CHARACTERISTIC
/begin CHARACTERISTIC KINP_IVICarWashModeCmd_flg_ovrdflg "" VALUE 0x0000 /* @ECU_Address@KINP_IVICarWashModeCmd_flg_ovrdflg@ */ Scalar_BOOLEAN 0 SWC_INP_type_CM_boolean_flg 0.0 1.0 /end CHARACTERISTIC
/begin CHARACTERISTIC KINP_IVICarWashModeCmd_flg_ovrdval "" VALUE 0x0000 /* @ECU_Address@KINP_IVICarWashModeCmd_flg_ovrdval@ */ Scalar_BOOLEAN 0 SWC_INP_type_CM_boolean_flg 0.0 1.0 /end CHARACTERISTIC
/begin CHARACTERISTIC KINP_IVIChargePortSWSta_flg_defval "" VALUE 0x0000 /* @ECU_Address@KINP_IVIChargePortSWSta_flg_defval@ */ Scalar_BOOLEAN 0 SWC_INP_type_CM_boolean_flg 0.0 1.0 /end CHARACTERISTIC
/begin CHARACTERISTIC KINP_IVIChargePortSWSta_flg_ovrdflg "" VALUE 0x0000 /* @ECU_Address@KINP_IVIChargePortSWSta_flg_ovrdflg@ */ Scalar_BOOLEAN 0 SWC_INP_type_CM_boolean_flg 0.0 1.0 /end CHARACTERISTIC
/begin CHARACTERISTIC KINP_IVIChargePortSWSta_flg_ovrdval "" VALUE 0x0000 /* @ECU_Address@KINP_IVIChargePortSWSta_flg_ovrdval@ */ Scalar_BOOLEAN 0 SWC_INP_type_CM_boolean_flg 0.0 1.0 /end CHARACTERISTIC
/begin CHARACTERISTIC KINP_IVICreateAccReqSta_enum_ovrdflg "" VALUE 0x0000 /* @ECU_Address@KINP_IVICreateAccReqSta_enum_ovrdflg@ */ Scalar_BOOLEAN 0 SWC_INP_type_CM_boolean_flg 0.0 1.0 /end CHARACTERISTIC
/begin CHARACTERISTIC KINP_IVICreepSWReq_flg_defval "" VALUE 0x0000 /* @ECU_Address@KINP_IVICreepSWReq_flg_defval@ */ Scalar_BOOLEAN 0 SWC_INP_type_CM_boolean_flg 0.0 1.0 /end CHARACTERISTIC
/begin CHARACTERISTIC KINP_IVICreepSWReq_flg_ovrdflg "" VALUE 0x0000 /* @ECU_Address@KINP_IVICreepSWReq_flg_ovrdflg@ */ Scalar_BOOLEAN 0 SWC_INP_type_CM_boolean_flg 0.0 1.0 /end CHARACTERISTIC
/begin CHARACTERISTIC KINP_IVICreepSWReq_flg_ovrdval "" VALUE 0x0000 /* @ECU_Address@KINP_IVICreepSWReq_flg_ovrdval@ */ Scalar_BOOLEAN 0 SWC_INP_type_CM_boolean_flg 0.0 1.0 /end CHARACTERISTIC
/begin CHARACTERISTIC KINP_IVIDSEATFroEdgeHeightCmd_enum_ovrdflg "" VALUE 0x0000 /* @ECU_Address@KINP_IVIDSEATFroEdgeHeightCmd_enum_ovrdflg@ */ Scalar_BOOLEAN 0 SWC_INP_type_CM_boolean_flg 0.0 1.0 /end CHARACTERISTIC
/begin CHARACTERISTIC KINP_IVIDSEATHeaterCmd_enum_ovrdflg "" VALUE 0x0000 /* @ECU_Address@KINP_IVIDSEATHeaterCmd_enum_ovrdflg@ */ Scalar_BOOLEAN 0 SWC_INP_type_CM_boolean_flg 0.0 1.0 /end CHARACTERISTIC
/begin CHARACTERISTIC KINP_IVIDSEATHeightCmd_enum_ovrdflg "" VALUE 0x0000 /* @ECU_Address@KINP_IVIDSEATHeightCmd_enum_ovrdflg@ */ Scalar_BOOLEAN 0 SWC_INP_type_CM_boolean_flg 0.0 1.0 /end CHARACTERISTIC
/begin CHARACTERISTIC KINP_IVIDSEATMemory1Sta_flg_defval "" VALUE 0x0000 /* @ECU_Address@KINP_IVIDSEATMemory1Sta_flg_defval@ */ Scalar_BOOLEAN 0 SWC_INP_type_CM_boolean_flg 0.0 1.0 /end CHARACTERISTIC
/begin CHARACTERISTIC KINP_IVIDSEATMemory1Sta_flg_ovrdflg "" VALUE 0x0000 /* @ECU_Address@KINP_IVIDSEATMemory1Sta_flg_ovrdflg@ */ Scalar_BOOLEAN 0 SWC_INP_type_CM_boolean_flg 0.0 1.0 /end CHARACTERISTIC
/begin CHARACTERISTIC KINP_IVIDSEATMemory1Sta_flg_ovrdval "" VALUE 0x0000 /* @ECU_Address@KINP_IVIDSEATMemory1Sta_flg_ovrdval@ */ Scalar_BOOLEAN 0 SWC_INP_type_CM_boolean_flg 0.0 1.0 /end CHARACTERISTIC
/begin CHARACTERISTIC KINP_IVIDSEATMemory2Sta_flg_defval "" VALUE 0x0000 /* @ECU_Address@KINP_IVIDSEATMemory2Sta_flg_defval@ */ Scalar_BOOLEAN 0 SWC_INP_type_CM_boolean_flg 0.0 1.0 /end CHARACTERISTIC
/begin CHARACTERISTIC KINP_IVIDSEATMemory2Sta_flg_ovrdflg "" VALUE 0x0000 /* @ECU_Address@KINP_IVIDSEATMemory2Sta_flg_ovrdflg@ */ Scalar_BOOLEAN 0 SWC_INP_type_CM_boolean_flg 0.0 1.0 /end CHARACTERISTIC
/begin CHARACTERISTIC KINP_IVIDSEATMemory2Sta_flg_ovrdval "" VALUE 0x0000 /* @ECU_Address@KINP_IVIDSEATMemory2Sta_flg_ovrdval@ */ Scalar_BOOLEAN 0 SWC_INP_type_CM_boolean_flg 0.0 1.0 /end CHARACTERISTIC
/begin CHARACTERISTIC KINP_IVIDSEATMemoryOPTCLSSta_flg_defval "" VALUE 0x0000 /* @ECU_Address@KINP_IVIDSEATMemoryOPTCLSSta_flg_defval@ */ Scalar_BOOLEAN 0 SWC_INP_type_CM_boolean_flg 0.0 1.0 /end CHARACTERISTIC
/begin CHARACTERISTIC KINP_IVIDSEATMemoryOPTCLSSta_flg_ovrdflg "" VALUE 0x0000 /* @ECU_Address@KINP_IVIDSEATMemoryOPTCLSSta_flg_ovrdflg@ */ Scalar_BOOLEAN 0 SWC_INP_type_CM_boolean_flg 0.0 1.0 /end CHARACTERISTIC
/begin CHARACTERISTIC KINP_IVIDSEATMemoryOPTCLSSta_flg_ovrdval "" VALUE 0x0000 /* @ECU_Address@KINP_IVIDSEATMemoryOPTCLSSta_flg_ovrdval@ */ Scalar_BOOLEAN 0 SWC_INP_type_CM_boolean_flg 0.0 1.0 /end CHARACTERISTIC
/begin CHARACTERISTIC KINP_IVIDSEATReclineCmd_enum_ovrdflg "" VALUE 0x0000 /* @ECU_Address@KINP_IVIDSEATReclineCmd_enum_ovrdflg@ */ Scalar_BOOLEAN 0 SWC_INP_type_CM_boolean_flg 0.0 1.0 /end CHARACTERISTIC
/begin CHARACTERISTIC KINP_IVIDSEATSlideCmd_enum_ovrdflg "" VALUE 0x0000 /* @ECU_Address@KINP_IVIDSEATSlideCmd_enum_ovrdflg@ */ Scalar_BOOLEAN 0 SWC_INP_type_CM_boolean_flg 0.0 1.0 /end CHARACTERISTIC
/begin CHARACTERISTIC KINP_IVIDelAccReqSta_enum_ovrdflg "" VALUE 0x0000 /* @ECU_Address@KINP_IVIDelAccReqSta_enum_ovrdflg@ */ Scalar_BOOLEAN 0 SWC_INP_type_CM_boolean_flg 0.0 1.0 /end CHARACTERISTIC
/begin CHARACTERISTIC KINP_IVIDrivingLockSWSta_flg_defval "" VALUE 0x0000 /* @ECU_Address@KINP_IVIDrivingLockSWSta_flg_defval@ */ Scalar_BOOLEAN 0 SWC_INP_type_CM_boolean_flg 0.0 1.0 /end CHARACTERISTIC
/begin CHARACTERISTIC KINP_IVIDrivingLockSWSta_flg_ovrdflg "" VALUE 0x0000 /* @ECU_Address@KINP_IVIDrivingLockSWSta_flg_ovrdflg@ */ Scalar_BOOLEAN 0 SWC_INP_type_CM_boolean_flg 0.0 1.0 /end CHARACTERISTIC
/begin CHARACTERISTIC KINP_IVIDrivingLockSWSta_flg_ovrdval "" VALUE 0x0000 /* @ECU_Address@KINP_IVIDrivingLockSWSta_flg_ovrdval@ */ Scalar_BOOLEAN 0 SWC_INP_type_CM_boolean_flg 0.0 1.0 /end CHARACTERISTIC
/begin CHARACTERISTIC KINP_IVIEPSForceCmd_enum_ovrdflg "" VALUE 0x0000 /* @ECU_Address@KINP_IVIEPSForceCmd_enum_ovrdflg@ */ Scalar_BOOLEAN 0 SWC_INP_type_CM_boolean_flg 0.0 1.0 /end CHARACTERISTIC
/begin CHARACTERISTIC KINP_IVIFGSAirIntCmd_enum_ovrdflg "" VALUE 0x0000 /* @ECU_Address@KINP_IVIFGSAirIntCmd_enum_ovrdflg@ */ Scalar_BOOLEAN 0 SWC_INP_type_CM_boolean_flg 0.0 1.0 /end CHARACTERISTIC
/begin CHARACTERISTIC KINP_IVIFGSChCmd_enum_ovrdflg "" VALUE 0x0000 /* @ECU_Address@KINP_IVIFGSChCmd_enum_ovrdflg@ */ Scalar_BOOLEAN 0 SWC_INP_type_CM_boolean_flg 0.0 1.0 /end CHARACTERISTIC
/begin CHARACTERISTIC KINP_IVIFrTrunkUnlockReqSta_flg_defval "" VALUE 0x0000 /* @ECU_Address@KINP_IVIFrTrunkUnlockReqSta_flg_defval@ */ Scalar_BOOLEAN 0 SWC_INP_type_CM_boolean_flg 0.0 1.0 /end CHARACTERISTIC
/begin CHARACTERISTIC KINP_IVIFrTrunkUnlockReqSta_flg_ovrdflg "" VALUE 0x0000 /* @ECU_Address@KINP_IVIFrTrunkUnlockReqSta_flg_ovrdflg@ */ Scalar_BOOLEAN 0 SWC_INP_type_CM_boolean_flg 0.0 1.0 /end CHARACTERISTIC
/begin CHARACTERISTIC KINP_IVIFrTrunkUnlockReqSta_flg_ovrdval "" VALUE 0x0000 /* @ECU_Address@KINP_IVIFrTrunkUnlockReqSta_flg_ovrdval@ */ Scalar_BOOLEAN 0 SWC_INP_type_CM_boolean_flg 0.0 1.0 /end CHARACTERISTIC
/begin CHARACTERISTIC KINP_IVIHMICustmiFunSta_enum_ovrdflg "" VALUE 0x0000 /* @ECU_Address@KINP_IVIHMICustmiFunSta_enum_ovrdflg@ */ Scalar_BOOLEAN 0 SWC_INP_type_CM_boolean_flg 0.0 1.0 /end CHARACTERISTIC
/begin CHARACTERISTIC KINP_IVIHMICustmiKEYSta_enum_ovrdflg "" VALUE 0x0000 /* @ECU_Address@KINP_IVIHMICustmiKEYSta_enum_ovrdflg@ */ Scalar_BOOLEAN 0 SWC_INP_type_CM_boolean_flg 0.0 1.0 /end CHARACTERISTIC
/begin CHARACTERISTIC KINP_IVIIONSWCmd_flg_defval "" VALUE 0x0000 /* @ECU_Address@KINP_IVIIONSWCmd_flg_defval@ */ Scalar_BOOLEAN 0 SWC_INP_type_CM_boolean_flg 0.0 1.0 /end CHARACTERISTIC
/begin CHARACTERISTIC KINP_IVIIONSWCmd_flg_ovrdflg "" VALUE 0x0000 /* @ECU_Address@KINP_IVIIONSWCmd_flg_ovrdflg@ */ Scalar_BOOLEAN 0 SWC_INP_type_CM_boolean_flg 0.0 1.0 /end CHARACTERISTIC
/begin CHARACTERISTIC KINP_IVIIONSWCmd_flg_ovrdval "" VALUE 0x0000 /* @ECU_Address@KINP_IVIIONSWCmd_flg_ovrdval@ */ Scalar_BOOLEAN 0 SWC_INP_type_CM_boolean_flg 0.0 1.0 /end CHARACTERISTIC
/begin CHARACTERISTIC KINP_IVIISAOffsetSpd_enum_ovrdflg "" VALUE 0x0000 /* @ECU_Address@KINP_IVIISAOffsetSpd_enum_ovrdflg@ */ Scalar_BOOLEAN 0 SWC_INP_type_CM_boolean_flg 0.0 1.0 /end CHARACTERISTIC
/begin CHARACTERISTIC KINP_IVILBlowerModeSta_enum_ovrdflg "" VALUE 0x0000 /* @ECU_Address@KINP_IVILBlowerModeSta_enum_ovrdflg@ */ Scalar_BOOLEAN 0 SWC_INP_type_CM_boolean_flg 0.0 1.0 /end CHARACTERISTIC
/begin CHARACTERISTIC KINP_IVILBlowerYSta_pct_ovrdflg "" VALUE 0x0000 /* @ECU_Address@KINP_IVILBlowerYSta_pct_ovrdflg@ */ Scalar_BOOLEAN 0 SWC_INP_type_CM_boolean_flg 0.0 1.0 /end CHARACTERISTIC
/begin CHARACTERISTIC KINP_IVILBlowerZSta_pct_ovrdflg "" VALUE 0x0000 /* @ECU_Address@KINP_IVILBlowerZSta_pct_ovrdflg@ */ Scalar_BOOLEAN 0 SWC_INP_type_CM_boolean_flg 0.0 1.0 /end CHARACTERISTIC
/begin CHARACTERISTIC KINP_IVILSEATventCmd_enum_ovrdflg "" VALUE 0x0000 /* @ECU_Address@KINP_IVILSEATventCmd_enum_ovrdflg@ */ Scalar_BOOLEAN 0 SWC_INP_type_CM_boolean_flg 0.0 1.0 /end CHARACTERISTIC
/begin CHARACTERISTIC KINP_IVILinkAccReqSta_flg_defval "" VALUE 0x0000 /* @ECU_Address@KINP_IVILinkAccReqSta_flg_defval@ */ Scalar_BOOLEAN 0 SWC_INP_type_CM_boolean_flg 0.0 1.0 /end CHARACTERISTIC
/begin CHARACTERISTIC KINP_IVILinkAccReqSta_flg_ovrdflg "" VALUE 0x0000 /* @ECU_Address@KINP_IVILinkAccReqSta_flg_ovrdflg@ */ Scalar_BOOLEAN 0 SWC_INP_type_CM_boolean_flg 0.0 1.0 /end CHARACTERISTIC
/begin CHARACTERISTIC KINP_IVILinkAccReqSta_flg_ovrdval "" VALUE 0x0000 /* @ECU_Address@KINP_IVILinkAccReqSta_flg_ovrdval@ */ Scalar_BOOLEAN 0 SWC_INP_type_CM_boolean_flg 0.0 1.0 /end CHARACTERISTIC
/begin CHARACTERISTIC KINP_IVILinkAccSta_enum_ovrdflg "" VALUE 0x0000 /* @ECU_Address@KINP_IVILinkAccSta_enum_ovrdflg@ */ Scalar_BOOLEAN 0 SWC_INP_type_CM_boolean_flg 0.0 1.0 /end CHARACTERISTIC
/begin CHARACTERISTIC KINP_IVILinkKeySta_enum_ovrdflg "" VALUE 0x0000 /* @ECU_Address@KINP_IVILinkKeySta_enum_ovrdflg@ */ Scalar_BOOLEAN 0 SWC_INP_type_CM_boolean_flg 0.0 1.0 /end CHARACTERISTIC
/begin CHARACTERISTIC KINP_IVILocatedSTA_enum_ovrdflg "" VALUE 0x0000 /* @ECU_Address@KINP_IVILocatedSTA_enum_ovrdflg@ */ Scalar_BOOLEAN 0 SWC_INP_type_CM_boolean_flg 0.0 1.0 /end CHARACTERISTIC
/begin CHARACTERISTIC KINP_IVILockSoundSWSta_flg_defval "" VALUE 0x0000 /* @ECU_Address@KINP_IVILockSoundSWSta_flg_defval@ */ Scalar_BOOLEAN 0 SWC_INP_type_CM_boolean_flg 0.0 1.0 /end CHARACTERISTIC
/begin CHARACTERISTIC KINP_IVILockSoundSWSta_flg_ovrdflg "" VALUE 0x0000 /* @ECU_Address@KINP_IVILockSoundSWSta_flg_ovrdflg@ */ Scalar_BOOLEAN 0 SWC_INP_type_CM_boolean_flg 0.0 1.0 /end CHARACTERISTIC
/begin CHARACTERISTIC KINP_IVILockSoundSWSta_flg_ovrdval "" VALUE 0x0000 /* @ECU_Address@KINP_IVILockSoundSWSta_flg_ovrdval@ */ Scalar_BOOLEAN 0 SWC_INP_type_CM_boolean_flg 0.0 1.0 /end CHARACTERISTIC
/begin CHARACTERISTIC KINP_IVIMLFMostCmd_flg_defval "" VALUE 0x0000 /* @ECU_Address@KINP_IVIMLFMostCmd_flg_defval@ */ Scalar_BOOLEAN 0 SWC_INP_type_CM_boolean_flg 0.0 1.0 /end CHARACTERISTIC
/begin CHARACTERISTIC KINP_IVIMLFMostCmd_flg_ovrdflg "" VALUE 0x0000 /* @ECU_Address@KINP_IVIMLFMostCmd_flg_ovrdflg@ */ Scalar_BOOLEAN 0 SWC_INP_type_CM_boolean_flg 0.0 1.0 /end CHARACTERISTIC
/begin CHARACTERISTIC KINP_IVIMLFMostCmd_flg_ovrdval "" VALUE 0x0000 /* @ECU_Address@KINP_IVIMLFMostCmd_flg_ovrdval@ */ Scalar_BOOLEAN 0 SWC_INP_type_CM_boolean_flg 0.0 1.0 /end CHARACTERISTIC
/begin CHARACTERISTIC KINP_IVIMLFootLiftCmd_enum_ovrdflg "" VALUE 0x0000 /* @ECU_Address@KINP_IVIMLFootLiftCmd_enum_ovrdflg@ */ Scalar_BOOLEAN 0 SWC_INP_type_CM_boolean_flg 0.0 1.0 /end CHARACTERISTIC
/begin CHARACTERISTIC KINP_IVIMLNapModeCmd_flg_defval "" VALUE 0x0000 /* @ECU_Address@KINP_IVIMLNapModeCmd_flg_defval@ */ Scalar_BOOLEAN 0 SWC_INP_type_CM_boolean_flg 0.0 1.0 /end CHARACTERISTIC
/begin CHARACTERISTIC KINP_IVIMLNapModeCmd_flg_ovrdflg "" VALUE 0x0000 /* @ECU_Address@KINP_IVIMLNapModeCmd_flg_ovrdflg@ */ Scalar_BOOLEAN 0 SWC_INP_type_CM_boolean_flg 0.0 1.0 /end CHARACTERISTIC
/begin CHARACTERISTIC KINP_IVIMLNapModeCmd_flg_ovrdval "" VALUE 0x0000 /* @ECU_Address@KINP_IVIMLNapModeCmd_flg_ovrdval@ */ Scalar_BOOLEAN 0 SWC_INP_type_CM_boolean_flg 0.0 1.0 /end CHARACTERISTIC
/begin CHARACTERISTIC KINP_IVIMLReclinerCmd_enum_ovrdflg "" VALUE 0x0000 /* @ECU_Address@KINP_IVIMLReclinerCmd_enum_ovrdflg@ */ Scalar_BOOLEAN 0 SWC_INP_type_CM_boolean_flg 0.0 1.0 /end CHARACTERISTIC
/begin CHARACTERISTIC KINP_IVIMLRestoreCmd_flg_defval "" VALUE 0x0000 /* @ECU_Address@KINP_IVIMLRestoreCmd_flg_defval@ */ Scalar_BOOLEAN 0 SWC_INP_type_CM_boolean_flg 0.0 1.0 /end CHARACTERISTIC
/begin CHARACTERISTIC KINP_IVIMLRestoreCmd_flg_ovrdflg "" VALUE 0x0000 /* @ECU_Address@KINP_IVIMLRestoreCmd_flg_ovrdflg@ */ Scalar_BOOLEAN 0 SWC_INP_type_CM_boolean_flg 0.0 1.0 /end CHARACTERISTIC
/begin CHARACTERISTIC KINP_IVIMLRestoreCmd_flg_ovrdval "" VALUE 0x0000 /* @ECU_Address@KINP_IVIMLRestoreCmd_flg_ovrdval@ */ Scalar_BOOLEAN 0 SWC_INP_type_CM_boolean_flg 0.0 1.0 /end CHARACTERISTIC
/begin CHARACTERISTIC KINP_IVIMLSEATventCmd_enum_ovrdflg "" VALUE 0x0000 /* @ECU_Address@KINP_IVIMLSEATventCmd_enum_ovrdflg@ */ Scalar_BOOLEAN 0 SWC_INP_type_CM_boolean_flg 0.0 1.0 /end CHARACTERISTIC
/begin CHARACTERISTIC KINP_IVIMLSeatLiftCmd_enum_ovrdflg "" VALUE 0x0000 /* @ECU_Address@KINP_IVIMLSeatLiftCmd_enum_ovrdflg@ */ Scalar_BOOLEAN 0 SWC_INP_type_CM_boolean_flg 0.0 1.0 /end CHARACTERISTIC
/begin CHARACTERISTIC KINP_IVIMLSldRestoreCmd_flg_defval "" VALUE 0x0000 /* @ECU_Address@KINP_IVIMLSldRestoreCmd_flg_defval@ */ Scalar_BOOLEAN 0 SWC_INP_type_CM_boolean_flg 0.0 1.0 /end CHARACTERISTIC
/begin CHARACTERISTIC KINP_IVIMLSldRestoreCmd_flg_ovrdflg "" VALUE 0x0000 /* @ECU_Address@KINP_IVIMLSldRestoreCmd_flg_ovrdflg@ */ Scalar_BOOLEAN 0 SWC_INP_type_CM_boolean_flg 0.0 1.0 /end CHARACTERISTIC
/begin CHARACTERISTIC KINP_IVIMLSldRestoreCmd_flg_ovrdval "" VALUE 0x0000 /* @ECU_Address@KINP_IVIMLSldRestoreCmd_flg_ovrdval@ */ Scalar_BOOLEAN 0 SWC_INP_type_CM_boolean_flg 0.0 1.0 /end CHARACTERISTIC
/begin CHARACTERISTIC KINP_IVIMLSliderCmd_enum_ovrdflg "" VALUE 0x0000 /* @ECU_Address@KINP_IVIMLSliderCmd_enum_ovrdflg@ */ Scalar_BOOLEAN 0 SWC_INP_type_CM_boolean_flg 0.0 1.0 /end CHARACTERISTIC
/begin CHARACTERISTIC KINP_IVIMLZeroGravityCmd_flg_defval "" VALUE 0x0000 /* @ECU_Address@KINP_IVIMLZeroGravityCmd_flg_defval@ */ Scalar_BOOLEAN 0 SWC_INP_type_CM_boolean_flg 0.0 1.0 /end CHARACTERISTIC
/begin CHARACTERISTIC KINP_IVIMLZeroGravityCmd_flg_ovrdflg "" VALUE 0x0000 /* @ECU_Address@KINP_IVIMLZeroGravityCmd_flg_ovrdflg@ */ Scalar_BOOLEAN 0 SWC_INP_type_CM_boolean_flg 0.0 1.0 /end CHARACTERISTIC
/begin CHARACTERISTIC KINP_IVIMLZeroGravityCmd_flg_ovrdval "" VALUE 0x0000 /* @ECU_Address@KINP_IVIMLZeroGravityCmd_flg_ovrdval@ */ Scalar_BOOLEAN 0 SWC_INP_type_CM_boolean_flg 0.0 1.0 /end CHARACTERISTIC
/begin CHARACTERISTIC KINP_IVIMRFMostCmd_flg_defval "" VALUE 0x0000 /* @ECU_Address@KINP_IVIMRFMostCmd_flg_defval@ */ Scalar_BOOLEAN 0 SWC_INP_type_CM_boolean_flg 0.0 1.0 /end CHARACTERISTIC
/begin CHARACTERISTIC KINP_IVIMRFMostCmd_flg_ovrdflg "" VALUE 0x0000 /* @ECU_Address@KINP_IVIMRFMostCmd_flg_ovrdflg@ */ Scalar_BOOLEAN 0 SWC_INP_type_CM_boolean_flg 0.0 1.0 /end CHARACTERISTIC
/begin CHARACTERISTIC KINP_IVIMRFMostCmd_flg_ovrdval "" VALUE 0x0000 /* @ECU_Address@KINP_IVIMRFMostCmd_flg_ovrdval@ */ Scalar_BOOLEAN 0 SWC_INP_type_CM_boolean_flg 0.0 1.0 /end CHARACTERISTIC
/begin CHARACTERISTIC KINP_IVIMRFootLiftCmd_enum_ovrdflg "" VALUE 0x0000 /* @ECU_Address@KINP_IVIMRFootLiftCmd_enum_ovrdflg@ */ Scalar_BOOLEAN 0 SWC_INP_type_CM_boolean_flg 0.0 1.0 /end CHARACTERISTIC
/begin CHARACTERISTIC KINP_IVIMRNapModeCmd_flg_defval "" VALUE 0x0000 /* @ECU_Address@KINP_IVIMRNapModeCmd_flg_defval@ */ Scalar_BOOLEAN 0 SWC_INP_type_CM_boolean_flg 0.0 1.0 /end CHARACTERISTIC
/begin CHARACTERISTIC KINP_IVIMRNapModeCmd_flg_ovrdflg "" VALUE 0x0000 /* @ECU_Address@KINP_IVIMRNapModeCmd_flg_ovrdflg@ */ Scalar_BOOLEAN 0 SWC_INP_type_CM_boolean_flg 0.0 1.0 /end CHARACTERISTIC
/begin CHARACTERISTIC KINP_IVIMRNapModeCmd_flg_ovrdval "" VALUE 0x0000 /* @ECU_Address@KINP_IVIMRNapModeCmd_flg_ovrdval@ */ Scalar_BOOLEAN 0 SWC_INP_type_CM_boolean_flg 0.0 1.0 /end CHARACTERISTIC
/begin CHARACTERISTIC KINP_IVIMRReclinerCmd_enum_ovrdflg "" VALUE 0x0000 /* @ECU_Address@KINP_IVIMRReclinerCmd_enum_ovrdflg@ */ Scalar_BOOLEAN 0 SWC_INP_type_CM_boolean_flg 0.0 1.0 /end CHARACTERISTIC
/begin CHARACTERISTIC KINP_IVIMRRestoreCmd_flg_defval "" VALUE 0x0000 /* @ECU_Address@KINP_IVIMRRestoreCmd_flg_defval@ */ Scalar_BOOLEAN 0 SWC_INP_type_CM_boolean_flg 0.0 1.0 /end CHARACTERISTIC
/begin CHARACTERISTIC KINP_IVIMRRestoreCmd_flg_ovrdflg "" VALUE 0x0000 /* @ECU_Address@KINP_IVIMRRestoreCmd_flg_ovrdflg@ */ Scalar_BOOLEAN 0 SWC_INP_type_CM_boolean_flg 0.0 1.0 /end CHARACTERISTIC
/begin CHARACTERISTIC KINP_IVIMRRestoreCmd_flg_ovrdval "" VALUE 0x0000 /* @ECU_Address@KINP_IVIMRRestoreCmd_flg_ovrdval@ */ Scalar_BOOLEAN 0 SWC_INP_type_CM_boolean_flg 0.0 1.0 /end CHARACTERISTIC
/begin CHARACTERISTIC KINP_IVIMRSEATventCmd_enum_ovrdflg "" VALUE 0x0000 /* @ECU_Address@KINP_IVIMRSEATventCmd_enum_ovrdflg@ */ Scalar_BOOLEAN 0 SWC_INP_type_CM_boolean_flg 0.0 1.0 /end CHARACTERISTIC
/begin CHARACTERISTIC KINP_IVIMRSeatLiftCmd_enum_ovrdflg "" VALUE 0x0000 /* @ECU_Address@KINP_IVIMRSeatLiftCmd_enum_ovrdflg@ */ Scalar_BOOLEAN 0 SWC_INP_type_CM_boolean_flg 0.0 1.0 /end CHARACTERISTIC
/begin CHARACTERISTIC KINP_IVIMRSldRestoreCmd_flg_defval "" VALUE 0x0000 /* @ECU_Address@KINP_IVIMRSldRestoreCmd_flg_defval@ */ Scalar_BOOLEAN 0 SWC_INP_type_CM_boolean_flg 0.0 1.0 /end CHARACTERISTIC
/begin CHARACTERISTIC KINP_IVIMRSldRestoreCmd_flg_ovrdflg "" VALUE 0x0000 /* @ECU_Address@KINP_IVIMRSldRestoreCmd_flg_ovrdflg@ */ Scalar_BOOLEAN 0 SWC_INP_type_CM_boolean_flg 0.0 1.0 /end CHARACTERISTIC
/begin CHARACTERISTIC KINP_IVIMRSldRestoreCmd_flg_ovrdval "" VALUE 0x0000 /* @ECU_Address@KINP_IVIMRSldRestoreCmd_flg_ovrdval@ */ Scalar_BOOLEAN 0 SWC_INP_type_CM_boolean_flg 0.0 1.0 /end CHARACTERISTIC
/begin CHARACTERISTIC KINP_IVIMRSliderCmd_enum_ovrdflg "" VALUE 0x0000 /* @ECU_Address@KINP_IVIMRSliderCmd_enum_ovrdflg@ */ Scalar_BOOLEAN 0 SWC_INP_type_CM_boolean_flg 0.0 1.0 /end CHARACTERISTIC
/begin CHARACTERISTIC KINP_IVIMRZeroGravityCmd_flg_defval "" VALUE 0x0000 /* @ECU_Address@KINP_IVIMRZeroGravityCmd_flg_defval@ */ Scalar_BOOLEAN 0 SWC_INP_type_CM_boolean_flg 0.0 1.0 /end CHARACTERISTIC
/begin CHARACTERISTIC KINP_IVIMRZeroGravityCmd_flg_ovrdflg "" VALUE 0x0000 /* @ECU_Address@KINP_IVIMRZeroGravityCmd_flg_ovrdflg@ */ Scalar_BOOLEAN 0 SWC_INP_type_CM_boolean_flg 0.0 1.0 /end CHARACTERISTIC
/begin CHARACTERISTIC KINP_IVIMRZeroGravityCmd_flg_ovrdval "" VALUE 0x0000 /* @ECU_Address@KINP_IVIMRZeroGravityCmd_flg_ovrdval@ */ Scalar_BOOLEAN 0 SWC_INP_type_CM_boolean_flg 0.0 1.0 /end CHARACTERISTIC
/begin CHARACTERISTIC KINP_IVIMirrorFoldedSWSta_flg_defval "" VALUE 0x0000 /* @ECU_Address@KINP_IVIMirrorFoldedSWSta_flg_defval@ */ Scalar_BOOLEAN 0 SWC_INP_type_CM_boolean_flg 0.0 1.0 /end CHARACTERISTIC
/begin CHARACTERISTIC KINP_IVIMirrorFoldedSWSta_flg_ovrdflg "" VALUE 0x0000 /* @ECU_Address@KINP_IVIMirrorFoldedSWSta_flg_ovrdflg@ */ Scalar_BOOLEAN 0 SWC_INP_type_CM_boolean_flg 0.0 1.0 /end CHARACTERISTIC
/begin CHARACTERISTIC KINP_IVIMirrorFoldedSWSta_flg_ovrdval "" VALUE 0x0000 /* @ECU_Address@KINP_IVIMirrorFoldedSWSta_flg_ovrdval@ */ Scalar_BOOLEAN 0 SWC_INP_type_CM_boolean_flg 0.0 1.0 /end CHARACTERISTIC
/begin CHARACTERISTIC KINP_IVINightModeSta_flg_defval "" VALUE 0x0000 /* @ECU_Address@KINP_IVINightModeSta_flg_defval@ */ Scalar_BOOLEAN 0 SWC_INP_type_CM_boolean_flg 0.0 1.0 /end CHARACTERISTIC
/begin CHARACTERISTIC KINP_IVINightModeSta_flg_ovrdflg "" VALUE 0x0000 /* @ECU_Address@KINP_IVINightModeSta_flg_ovrdflg@ */ Scalar_BOOLEAN 0 SWC_INP_type_CM_boolean_flg 0.0 1.0 /end CHARACTERISTIC
/begin CHARACTERISTIC KINP_IVINightModeSta_flg_ovrdval "" VALUE 0x0000 /* @ECU_Address@KINP_IVINightModeSta_flg_ovrdval@ */ Scalar_BOOLEAN 0 SWC_INP_type_CM_boolean_flg 0.0 1.0 /end CHARACTERISTIC
/begin CHARACTERISTIC KINP_IVIPSEATHeaterCmd_enum_ovrdflg "" VALUE 0x0000 /* @ECU_Address@KINP_IVIPSEATHeaterCmd_enum_ovrdflg@ */ Scalar_BOOLEAN 0 SWC_INP_type_CM_boolean_flg 0.0 1.0 /end CHARACTERISTIC
/begin CHARACTERISTIC KINP_IVIPSEATReclineCmd_enum_ovrdflg "" VALUE 0x0000 /* @ECU_Address@KINP_IVIPSEATReclineCmd_enum_ovrdflg@ */ Scalar_BOOLEAN 0 SWC_INP_type_CM_boolean_flg 0.0 1.0 /end CHARACTERISTIC
/begin CHARACTERISTIC KINP_IVIPSEATSlideCmd_enum_ovrdflg "" VALUE 0x0000 /* @ECU_Address@KINP_IVIPSEATSlideCmd_enum_ovrdflg@ */ Scalar_BOOLEAN 0 SWC_INP_type_CM_boolean_flg 0.0 1.0 /end CHARACTERISTIC
/begin CHARACTERISTIC KINP_IVIPTGModeSW_enum_ovrdflg "" VALUE 0x0000 /* @ECU_Address@KINP_IVIPTGModeSW_enum_ovrdflg@ */ Scalar_BOOLEAN 0 SWC_INP_type_CM_boolean_flg 0.0 1.0 /end CHARACTERISTIC
/begin CHARACTERISTIC KINP_IVIPTGOpenHeight_enum_ovrdflg "" VALUE 0x0000 /* @ECU_Address@KINP_IVIPTGOpenHeight_enum_ovrdflg@ */ Scalar_BOOLEAN 0 SWC_INP_type_CM_boolean_flg 0.0 1.0 /end CHARACTERISTIC
/begin CHARACTERISTIC KINP_IVIPTGStaSW_enum_ovrdflg "" VALUE 0x0000 /* @ECU_Address@KINP_IVIPTGStaSW_enum_ovrdflg@ */ Scalar_BOOLEAN 0 SWC_INP_type_CM_boolean_flg 0.0 1.0 /end CHARACTERISTIC
/begin CHARACTERISTIC KINP_IVIPTGUSStaSW_flg_defval "" VALUE 0x0000 /* @ECU_Address@KINP_IVIPTGUSStaSW_flg_defval@ */ Scalar_BOOLEAN 0 SWC_INP_type_CM_boolean_flg 0.0 1.0 /end CHARACTERISTIC
/begin CHARACTERISTIC KINP_IVIPTGUSStaSW_flg_ovrdflg "" VALUE 0x0000 /* @ECU_Address@KINP_IVIPTGUSStaSW_flg_ovrdflg@ */ Scalar_BOOLEAN 0 SWC_INP_type_CM_boolean_flg 0.0 1.0 /end CHARACTERISTIC
/begin CHARACTERISTIC KINP_IVIPTGUSStaSW_flg_ovrdval "" VALUE 0x0000 /* @ECU_Address@KINP_IVIPTGUSStaSW_flg_ovrdval@ */ Scalar_BOOLEAN 0 SWC_INP_type_CM_boolean_flg 0.0 1.0 /end CHARACTERISTIC
/begin CHARACTERISTIC KINP_IVIPWModeReq_enum_ovrdflg "" VALUE 0x0000 /* @ECU_Address@KINP_IVIPWModeReq_enum_ovrdflg@ */ Scalar_BOOLEAN 0 SWC_INP_type_CM_boolean_flg 0.0 1.0 /end CHARACTERISTIC
/begin CHARACTERISTIC KINP_IVIPwrLockSW_enum_ovrdflg "" VALUE 0x0000 /* @ECU_Address@KINP_IVIPwrLockSW_enum_ovrdflg@ */ Scalar_BOOLEAN 0 SWC_INP_type_CM_boolean_flg 0.0 1.0 /end CHARACTERISTIC
/begin CHARACTERISTIC KINP_IVIPwroffreq_flg_defval "" VALUE 0x0000 /* @ECU_Address@KINP_IVIPwroffreq_flg_defval@ */ Scalar_BOOLEAN 0 SWC_INP_type_CM_boolean_flg 0.0 1.0 /end CHARACTERISTIC
/begin CHARACTERISTIC KINP_IVIPwroffreq_flg_ovrdflg "" VALUE 0x0000 /* @ECU_Address@KINP_IVIPwroffreq_flg_ovrdflg@ */ Scalar_BOOLEAN 0 SWC_INP_type_CM_boolean_flg 0.0 1.0 /end CHARACTERISTIC
/begin CHARACTERISTIC KINP_IVIPwroffreq_flg_ovrdval "" VALUE 0x0000 /* @ECU_Address@KINP_IVIPwroffreq_flg_ovrdval@ */ Scalar_BOOLEAN 0 SWC_INP_type_CM_boolean_flg 0.0 1.0 /end CHARACTERISTIC
/begin CHARACTERISTIC KINP_IVIRBlowerModeSta_enum_ovrdflg "" VALUE 0x0000 /* @ECU_Address@KINP_IVIRBlowerModeSta_enum_ovrdflg@ */ Scalar_BOOLEAN 0 SWC_INP_type_CM_boolean_flg 0.0 1.0 /end CHARACTERISTIC
/begin CHARACTERISTIC KINP_IVIRBlowerYSta_pct_ovrdflg "" VALUE 0x0000 /* @ECU_Address@KINP_IVIRBlowerYSta_pct_ovrdflg@ */ Scalar_BOOLEAN 0 SWC_INP_type_CM_boolean_flg 0.0 1.0 /end CHARACTERISTIC
/begin CHARACTERISTIC KINP_IVIRRDefReq_flg_defval "" VALUE 0x0000 /* @ECU_Address@KINP_IVIRRDefReq_flg_defval@ */ Scalar_BOOLEAN 0 SWC_INP_type_CM_boolean_flg 0.0 1.0 /end CHARACTERISTIC
/begin CHARACTERISTIC KINP_IVIRRDefReq_flg_ovrdflg "" VALUE 0x0000 /* @ECU_Address@KINP_IVIRRDefReq_flg_ovrdflg@ */ Scalar_BOOLEAN 0 SWC_INP_type_CM_boolean_flg 0.0 1.0 /end CHARACTERISTIC
/begin CHARACTERISTIC KINP_IVIRRDefReq_flg_ovrdval "" VALUE 0x0000 /* @ECU_Address@KINP_IVIRRDefReq_flg_ovrdval@ */ Scalar_BOOLEAN 0 SWC_INP_type_CM_boolean_flg 0.0 1.0 /end CHARACTERISTIC
/begin CHARACTERISTIC KINP_IVIReqV2L_enum_ovrdflg "" VALUE 0x0000 /* @ECU_Address@KINP_IVIReqV2L_enum_ovrdflg@ */ Scalar_BOOLEAN 0 SWC_INP_type_CM_boolean_flg 0.0 1.0 /end CHARACTERISTIC
/begin CHARACTERISTIC KINP_IVISWCRUndefinedSta_enum_ovrdflg "" VALUE 0x0000 /* @ECU_Address@KINP_IVISWCRUndefinedSta_enum_ovrdflg@ */ Scalar_BOOLEAN 0 SWC_INP_type_CM_boolean_flg 0.0 1.0 /end CHARACTERISTIC
/begin CHARACTERISTIC KINP_IVISWCVibModeSta_enum_ovrdflg "" VALUE 0x0000 /* @ECU_Address@KINP_IVISWCVibModeSta_enum_ovrdflg@ */ Scalar_BOOLEAN 0 SWC_INP_type_CM_boolean_flg 0.0 1.0 /end CHARACTERISTIC
/begin CHARACTERISTIC KINP_IVIScreen_enum_ovrdflg "" VALUE 0x0000 /* @ECU_Address@KINP_IVIScreen_enum_ovrdflg@ */ Scalar_BOOLEAN 0 SWC_INP_type_CM_boolean_flg 0.0 1.0 /end CHARACTERISTIC
/begin CHARACTERISTIC KINP_IVISilentChrgAlertSta_flg_defval "" VALUE 0x0000 /* @ECU_Address@KINP_IVISilentChrgAlertSta_flg_defval@ */ Scalar_BOOLEAN 0 SWC_INP_type_CM_boolean_flg 0.0 1.0 /end CHARACTERISTIC
/begin CHARACTERISTIC KINP_IVISilentChrgAlertSta_flg_ovrdflg "" VALUE 0x0000 /* @ECU_Address@KINP_IVISilentChrgAlertSta_flg_ovrdflg@ */ Scalar_BOOLEAN 0 SWC_INP_type_CM_boolean_flg 0.0 1.0 /end CHARACTERISTIC
/begin CHARACTERISTIC KINP_IVISilentChrgAlertSta_flg_ovrdval "" VALUE 0x0000 /* @ECU_Address@KINP_IVISilentChrgAlertSta_flg_ovrdval@ */ Scalar_BOOLEAN 0 SWC_INP_type_CM_boolean_flg 0.0 1.0 /end CHARACTERISTIC
/begin CHARACTERISTIC KINP_IVIStartChgreq_flg_defval "" VALUE 0x0000 /* @ECU_Address@KINP_IVIStartChgreq_flg_defval@ */ Scalar_BOOLEAN 0 SWC_INP_type_CM_boolean_flg 0.0 1.0 /end CHARACTERISTIC
/begin CHARACTERISTIC KINP_IVIStartChgreq_flg_ovrdflg "" VALUE 0x0000 /* @ECU_Address@KINP_IVIStartChgreq_flg_ovrdflg@ */ Scalar_BOOLEAN 0 SWC_INP_type_CM_boolean_flg 0.0 1.0 /end CHARACTERISTIC
/begin CHARACTERISTIC KINP_IVIStartChgreq_flg_ovrdval "" VALUE 0x0000 /* @ECU_Address@KINP_IVIStartChgreq_flg_ovrdval@ */ Scalar_BOOLEAN 0 SWC_INP_type_CM_boolean_flg 0.0 1.0 /end CHARACTERISTIC
/begin CHARACTERISTIC KINP_IVIStatus_flg_defval "" VALUE 0x0000 /* @ECU_Address@KINP_IVIStatus_flg_defval@ */ Scalar_BOOLEAN 0 SWC_INP_type_CM_boolean_flg 0.0 1.0 /end CHARACTERISTIC
/begin CHARACTERISTIC KINP_IVIStatus_flg_ovrdflg "" VALUE 0x0000 /* @ECU_Address@KINP_IVIStatus_flg_ovrdflg@ */ Scalar_BOOLEAN 0 SWC_INP_type_CM_boolean_flg 0.0 1.0 /end CHARACTERISTIC
/begin CHARACTERISTIC KINP_IVIStatus_flg_ovrdval "" VALUE 0x0000 /* @ECU_Address@KINP_IVIStatus_flg_ovrdval@ */ Scalar_BOOLEAN 0 SWC_INP_type_CM_boolean_flg 0.0 1.0 /end CHARACTERISTIC
/begin CHARACTERISTIC KINP_IVIStopChgreq_flg_defval "" VALUE 0x0000 /* @ECU_Address@KINP_IVIStopChgreq_flg_defval@ */ Scalar_BOOLEAN 0 SWC_INP_type_CM_boolean_flg 0.0 1.0 /end CHARACTERISTIC
/begin CHARACTERISTIC KINP_IVIStopChgreq_flg_ovrdflg "" VALUE 0x0000 /* @ECU_Address@KINP_IVIStopChgreq_flg_ovrdflg@ */ Scalar_BOOLEAN 0 SWC_INP_type_CM_boolean_flg 0.0 1.0 /end CHARACTERISTIC
/begin CHARACTERISTIC KINP_IVIStopChgreq_flg_ovrdval "" VALUE 0x0000 /* @ECU_Address@KINP_IVIStopChgreq_flg_ovrdval@ */ Scalar_BOOLEAN 0 SWC_INP_type_CM_boolean_flg 0.0 1.0 /end CHARACTERISTIC
/begin CHARACTERISTIC KINP_IVIStoppingUnlockSWSta_flg_defval "" VALUE 0x0000 /* @ECU_Address@KINP_IVIStoppingUnlockSWSta_flg_defval@ */ Scalar_BOOLEAN 0 SWC_INP_type_CM_boolean_flg 0.0 1.0 /end CHARACTERISTIC
/begin CHARACTERISTIC KINP_IVIStoppingUnlockSWSta_flg_ovrdflg "" VALUE 0x0000 /* @ECU_Address@KINP_IVIStoppingUnlockSWSta_flg_ovrdflg@ */ Scalar_BOOLEAN 0 SWC_INP_type_CM_boolean_flg 0.0 1.0 /end CHARACTERISTIC
/begin CHARACTERISTIC KINP_IVIStoppingUnlockSWSta_flg_ovrdval "" VALUE 0x0000 /* @ECU_Address@KINP_IVIStoppingUnlockSWSta_flg_ovrdval@ */ Scalar_BOOLEAN 0 SWC_INP_type_CM_boolean_flg 0.0 1.0 /end CHARACTERISTIC
/begin CHARACTERISTIC KINP_IVITimeCheck_enum_ovrdflg "" VALUE 0x0000 /* @ECU_Address@KINP_IVITimeCheck_enum_ovrdflg@ */ Scalar_BOOLEAN 0 SWC_INP_type_CM_boolean_flg 0.0 1.0 /end CHARACTERISTIC
/begin CHARACTERISTIC KINP_IVITimeDay_DAY_ovrdflg "" VALUE 0x0000 /* @ECU_Address@KINP_IVITimeDay_DAY_ovrdflg@ */ Scalar_BOOLEAN 0 SWC_INP_type_CM_boolean_flg 0.0 1.0 /end CHARACTERISTIC
/begin CHARACTERISTIC KINP_IVITimeHour_hr_ovrdflg "" VALUE 0x0000 /* @ECU_Address@KINP_IVITimeHour_hr_ovrdflg@ */ Scalar_BOOLEAN 0 SWC_INP_type_CM_boolean_flg 0.0 1.0 /end CHARACTERISTIC
/begin CHARACTERISTIC KINP_IVITimeMinute_min_ovrdflg "" VALUE 0x0000 /* @ECU_Address@KINP_IVITimeMinute_min_ovrdflg@ */ Scalar_BOOLEAN 0 SWC_INP_type_CM_boolean_flg 0.0 1.0 /end CHARACTERISTIC
/begin CHARACTERISTIC KINP_IVITimeMonth_MONTH_ovrdflg "" VALUE 0x0000 /* @ECU_Address@KINP_IVITimeMonth_MONTH_ovrdflg@ */ Scalar_BOOLEAN 0 SWC_INP_type_CM_boolean_flg 0.0 1.0 /end CHARACTERISTIC
/begin CHARACTERISTIC KINP_IVITimeSecond_s_ovrdflg "" VALUE 0x0000 /* @ECU_Address@KINP_IVITimeSecond_s_ovrdflg@ */ Scalar_BOOLEAN 0 SWC_INP_type_CM_boolean_flg 0.0 1.0 /end CHARACTERISTIC
/begin CHARACTERISTIC KINP_IVITimeYear_YEAR_ovrdflg "" VALUE 0x0000 /* @ECU_Address@KINP_IVITimeYear_YEAR_ovrdflg@ */ Scalar_BOOLEAN 0 SWC_INP_type_CM_boolean_flg 0.0 1.0 /end CHARACTERISTIC
/begin CHARACTERISTIC KINP_IVITrailerCheckReqSta_flg_defval "" VALUE 0x0000 /* @ECU_Address@KINP_IVITrailerCheckReqSta_flg_defval@ */ Scalar_BOOLEAN 0 SWC_INP_type_CM_boolean_flg 0.0 1.0 /end CHARACTERISTIC
/begin CHARACTERISTIC KINP_IVITrailerCheckReqSta_flg_ovrdflg "" VALUE 0x0000 /* @ECU_Address@KINP_IVITrailerCheckReqSta_flg_ovrdflg@ */ Scalar_BOOLEAN 0 SWC_INP_type_CM_boolean_flg 0.0 1.0 /end CHARACTERISTIC
/begin CHARACTERISTIC KINP_IVITrailerCheckReqSta_flg_ovrdval "" VALUE 0x0000 /* @ECU_Address@KINP_IVITrailerCheckReqSta_flg_ovrdval@ */ Scalar_BOOLEAN 0 SWC_INP_type_CM_boolean_flg 0.0 1.0 /end CHARACTERISTIC
/begin CHARACTERISTIC KINP_IVITrailerModeSWSta_flg_defval "" VALUE 0x0000 /* @ECU_Address@KINP_IVITrailerModeSWSta_flg_defval@ */ Scalar_BOOLEAN 0 SWC_INP_type_CM_boolean_flg 0.0 1.0 /end CHARACTERISTIC
/begin CHARACTERISTIC KINP_IVITrailerModeSWSta_flg_ovrdflg "" VALUE 0x0000 /* @ECU_Address@KINP_IVITrailerModeSWSta_flg_ovrdflg@ */ Scalar_BOOLEAN 0 SWC_INP_type_CM_boolean_flg 0.0 1.0 /end CHARACTERISTIC
/begin CHARACTERISTIC KINP_IVITrailerModeSWSta_flg_ovrdval "" VALUE 0x0000 /* @ECU_Address@KINP_IVITrailerModeSWSta_flg_ovrdval@ */ Scalar_BOOLEAN 0 SWC_INP_type_CM_boolean_flg 0.0 1.0 /end CHARACTERISTIC
/begin CHARACTERISTIC KINP_IVITriggerreq_flg_defval "" VALUE 0x0000 /* @ECU_Address@KINP_IVITriggerreq_flg_defval@ */ Scalar_BOOLEAN 0 SWC_INP_type_CM_boolean_flg 0.0 1.0 /end CHARACTERISTIC
/begin CHARACTERISTIC KINP_IVITriggerreq_flg_ovrdflg "" VALUE 0x0000 /* @ECU_Address@KINP_IVITriggerreq_flg_ovrdflg@ */ Scalar_BOOLEAN 0 SWC_INP_type_CM_boolean_flg 0.0 1.0 /end CHARACTERISTIC
/begin CHARACTERISTIC KINP_IVITriggerreq_flg_ovrdval "" VALUE 0x0000 /* @ECU_Address@KINP_IVITriggerreq_flg_ovrdval@ */ Scalar_BOOLEAN 0 SWC_INP_type_CM_boolean_flg 0.0 1.0 /end CHARACTERISTIC
/begin CHARACTERISTIC KINP_IVIUnlockChgreq_flg_defval "" VALUE 0x0000 /* @ECU_Address@KINP_IVIUnlockChgreq_flg_defval@ */ Scalar_BOOLEAN 0 SWC_INP_type_CM_boolean_flg 0.0 1.0 /end CHARACTERISTIC
/begin CHARACTERISTIC KINP_IVIUnlockChgreq_flg_ovrdflg "" VALUE 0x0000 /* @ECU_Address@KINP_IVIUnlockChgreq_flg_ovrdflg@ */ Scalar_BOOLEAN 0 SWC_INP_type_CM_boolean_flg 0.0 1.0 /end CHARACTERISTIC
/begin CHARACTERISTIC KINP_IVIUnlockChgreq_flg_ovrdval "" VALUE 0x0000 /* @ECU_Address@KINP_IVIUnlockChgreq_flg_ovrdval@ */ Scalar_BOOLEAN 0 SWC_INP_type_CM_boolean_flg 0.0 1.0 /end CHARACTERISTIC
/begin CHARACTERISTIC KINP_IVIWIMAINSW_flg_defval "" VALUE 0x0000 /* @ECU_Address@KINP_IVIWIMAINSW_flg_defval@ */ Scalar_BOOLEAN 0 SWC_INP_type_CM_boolean_flg 0.0 1.0 /end CHARACTERISTIC
/begin CHARACTERISTIC KINP_IVIWIMAINSW_flg_ovrdflg "" VALUE 0x0000 /* @ECU_Address@KINP_IVIWIMAINSW_flg_ovrdflg@ */ Scalar_BOOLEAN 0 SWC_INP_type_CM_boolean_flg 0.0 1.0 /end CHARACTERISTIC
/begin CHARACTERISTIC KINP_IVIWIMAINSW_flg_ovrdval "" VALUE 0x0000 /* @ECU_Address@KINP_IVIWIMAINSW_flg_ovrdval@ */ Scalar_BOOLEAN 0 SWC_INP_type_CM_boolean_flg 0.0 1.0 /end CHARACTERISTIC
/begin CHARACTERISTIC KINP_IVIWPTCSWSta_flg_defval "" VALUE 0x0000 /* @ECU_Address@KINP_IVIWPTCSWSta_flg_defval@ */ Scalar_BOOLEAN 0 SWC_INP_type_CM_boolean_flg 0.0 1.0 /end CHARACTERISTIC
/begin CHARACTERISTIC KINP_IVIWPTCSWSta_flg_ovrdflg "" VALUE 0x0000 /* @ECU_Address@KINP_IVIWPTCSWSta_flg_ovrdflg@ */ Scalar_BOOLEAN 0 SWC_INP_type_CM_boolean_flg 0.0 1.0 /end CHARACTERISTIC
/begin CHARACTERISTIC KINP_IVIWPTCSWSta_flg_ovrdval "" VALUE 0x0000 /* @ECU_Address@KINP_IVIWPTCSWSta_flg_ovrdval@ */ Scalar_BOOLEAN 0 SWC_INP_type_CM_boolean_flg 0.0 1.0 /end CHARACTERISTIC
/begin CHARACTERISTIC KINP_IVIsigScreenReqSta_flg_defval "" VALUE 0x0000 /* @ECU_Address@KINP_IVIsigScreenReqSta_flg_defval@ */ Scalar_BOOLEAN 0 SWC_INP_type_CM_boolean_flg 0.0 1.0 /end CHARACTERISTIC
/begin CHARACTERISTIC KINP_IVIsigScreenReqSta_flg_ovrdflg "" VALUE 0x0000 /* @ECU_Address@KINP_IVIsigScreenReqSta_flg_ovrdflg@ */ Scalar_BOOLEAN 0 SWC_INP_type_CM_boolean_flg 0.0 1.0 /end CHARACTERISTIC
/begin CHARACTERISTIC KINP_IVIsigScreenReqSta_flg_ovrdval "" VALUE 0x0000 /* @ECU_Address@KINP_IVIsigScreenReqSta_flg_ovrdval@ */ Scalar_BOOLEAN 0 SWC_INP_type_CM_boolean_flg 0.0 1.0 /end CHARACTERISTIC
/begin CHARACTERISTIC KINP_LDrvControlCommand_pct_ovrdflg "" VALUE 0x0000 /* @ECU_Address@KINP_LDrvControlCommand_pct_ovrdflg@ */ Scalar_BOOLEAN 0 SWC_INP_type_CM_boolean_flg 0.0 1.0 /end CHARACTERISTIC
/begin CHARACTERISTIC KINP_LINKtoDrive_flg_defval "" VALUE 0x0000 /* @ECU_Address@KINP_LINKtoDrive_flg_defval@ */ Scalar_BOOLEAN 0 SWC_INP_type_CM_boolean_flg 0.0 1.0 /end CHARACTERISTIC
/begin CHARACTERISTIC KINP_LINKtoDrive_flg_ovrdflg "" VALUE 0x0000 /* @ECU_Address@KINP_LINKtoDrive_flg_ovrdflg@ */ Scalar_BOOLEAN 0 SWC_INP_type_CM_boolean_flg 0.0 1.0 /end CHARACTERISTIC
/begin CHARACTERISTIC KINP_LINKtoDrive_flg_ovrdval "" VALUE 0x0000 /* @ECU_Address@KINP_LINKtoDrive_flg_ovrdval@ */ Scalar_BOOLEAN 0 SWC_INP_type_CM_boolean_flg 0.0 1.0 /end CHARACTERISTIC
/begin CHARACTERISTIC KINP_LPasControlCommand_pct_ovrdflg "" VALUE 0x0000 /* @ECU_Address@KINP_LPasControlCommand_pct_ovrdflg@ */ Scalar_BOOLEAN 0 SWC_INP_type_CM_boolean_flg 0.0 1.0 /end CHARACTERISTIC
/begin CHARACTERISTIC KINP_LRLDControlCommand_pct_ovrdflg "" VALUE 0x0000 /* @ECU_Address@KINP_LRLDControlCommand_pct_ovrdflg@ */ Scalar_BOOLEAN 0 SWC_INP_type_CM_boolean_flg 0.0 1.0 /end CHARACTERISTIC
/begin CHARACTERISTIC KINP_LRRDControlCommand_pct_ovrdflg "" VALUE 0x0000 /* @ECU_Address@KINP_LRRDControlCommand_pct_ovrdflg@ */ Scalar_BOOLEAN 0 SWC_INP_type_CM_boolean_flg 0.0 1.0 /end CHARACTERISTIC
/begin CHARACTERISTIC KINP_LatAccelV_flg_defval "" VALUE 0x0000 /* @ECU_Address@KINP_LatAccelV_flg_defval@ */ Scalar_BOOLEAN 0 SWC_INP_type_CM_boolean_flg 0.0 1.0 /end CHARACTERISTIC
/begin CHARACTERISTIC KINP_LatAccelV_flg_ovrdflg "" VALUE 0x0000 /* @ECU_Address@KINP_LatAccelV_flg_ovrdflg@ */ Scalar_BOOLEAN 0 SWC_INP_type_CM_boolean_flg 0.0 1.0 /end CHARACTERISTIC
/begin CHARACTERISTIC KINP_LatAccelV_flg_ovrdval "" VALUE 0x0000 /* @ECU_Address@KINP_LatAccelV_flg_ovrdval@ */ Scalar_BOOLEAN 0 SWC_INP_type_CM_boolean_flg 0.0 1.0 /end CHARACTERISTIC
/begin CHARACTERISTIC KINP_LatAccel_Gps_ovrdflg "" VALUE 0x0000 /* @ECU_Address@KINP_LatAccel_Gps_ovrdflg@ */ Scalar_BOOLEAN 0 SWC_INP_type_CM_boolean_flg 0.0 1.0 /end CHARACTERISTIC
/begin CHARACTERISTIC KINP_LightShowStartReq_flg_defval "" VALUE 0x0000 /* @ECU_Address@KINP_LightShowStartReq_flg_defval@ */ Scalar_BOOLEAN 0 SWC_INP_type_CM_boolean_flg 0.0 1.0 /end CHARACTERISTIC
/begin CHARACTERISTIC KINP_LightShowStartReq_flg_ovrdflg "" VALUE 0x0000 /* @ECU_Address@KINP_LightShowStartReq_flg_ovrdflg@ */ Scalar_BOOLEAN 0 SWC_INP_type_CM_boolean_flg 0.0 1.0 /end CHARACTERISTIC
/begin CHARACTERISTIC KINP_LightShowStartReq_flg_ovrdval "" VALUE 0x0000 /* @ECU_Address@KINP_LightShowStartReq_flg_ovrdval@ */ Scalar_BOOLEAN 0 SWC_INP_type_CM_boolean_flg 0.0 1.0 /end CHARACTERISTIC
/begin CHARACTERISTIC KINP_LightShowStopReq_flg_defval "" VALUE 0x0000 /* @ECU_Address@KINP_LightShowStopReq_flg_defval@ */ Scalar_BOOLEAN 0 SWC_INP_type_CM_boolean_flg 0.0 1.0 /end CHARACTERISTIC
/begin CHARACTERISTIC KINP_LightShowStopReq_flg_ovrdflg "" VALUE 0x0000 /* @ECU_Address@KINP_LightShowStopReq_flg_ovrdflg@ */ Scalar_BOOLEAN 0 SWC_INP_type_CM_boolean_flg 0.0 1.0 /end CHARACTERISTIC
/begin CHARACTERISTIC KINP_LightShowStopReq_flg_ovrdval "" VALUE 0x0000 /* @ECU_Address@KINP_LightShowStopReq_flg_ovrdval@ */ Scalar_BOOLEAN 0 SWC_INP_type_CM_boolean_flg 0.0 1.0 /end CHARACTERISTIC
/begin CHARACTERISTIC KINP_LongAccelV_flg_defval "" VALUE 0x0000 /* @ECU_Address@KINP_LongAccelV_flg_defval@ */ Scalar_BOOLEAN 0 SWC_INP_type_CM_boolean_flg 0.0 1.0 /end CHARACTERISTIC
/begin CHARACTERISTIC KINP_LongAccelV_flg_ovrdflg "" VALUE 0x0000 /* @ECU_Address@KINP_LongAccelV_flg_ovrdflg@ */ Scalar_BOOLEAN 0 SWC_INP_type_CM_boolean_flg 0.0 1.0 /end CHARACTERISTIC
/begin CHARACTERISTIC KINP_LongAccelV_flg_ovrdval "" VALUE 0x0000 /* @ECU_Address@KINP_LongAccelV_flg_ovrdval@ */ Scalar_BOOLEAN 0 SWC_INP_type_CM_boolean_flg 0.0 1.0 /end CHARACTERISTIC
/begin CHARACTERISTIC KINP_LongAccel_Gps_ovrdflg "" VALUE 0x0000 /* @ECU_Address@KINP_LongAccel_Gps_ovrdflg@ */ Scalar_BOOLEAN 0 SWC_INP_type_CM_boolean_flg 0.0 1.0 /end CHARACTERISTIC
/begin CHARACTERISTIC KINP_LowBrakeFluidSta_flg_defval "" VALUE 0x0000 /* @ECU_Address@KINP_LowBrakeFluidSta_flg_defval@ */ Scalar_BOOLEAN 0 SWC_INP_type_CM_boolean_flg 0.0 1.0 /end CHARACTERISTIC
/begin CHARACTERISTIC KINP_LowBrakeFluidSta_flg_ovrdflg "" VALUE 0x0000 /* @ECU_Address@KINP_LowBrakeFluidSta_flg_ovrdflg@ */ Scalar_BOOLEAN 0 SWC_INP_type_CM_boolean_flg 0.0 1.0 /end CHARACTERISTIC
/begin CHARACTERISTIC KINP_LowBrakeFluidSta_flg_ovrdval "" VALUE 0x0000 /* @ECU_Address@KINP_LowBrakeFluidSta_flg_ovrdval@ */ Scalar_BOOLEAN 0 SWC_INP_type_CM_boolean_flg 0.0 1.0 /end CHARACTERISTIC
/begin CHARACTERISTIC KINP_MCPressureV_flg_defval "" VALUE 0x0000 /* @ECU_Address@KINP_MCPressureV_flg_defval@ */ Scalar_BOOLEAN 0 SWC_INP_type_CM_boolean_flg 0.0 1.0 /end CHARACTERISTIC
/begin CHARACTERISTIC KINP_MCPressureV_flg_ovrdflg "" VALUE 0x0000 /* @ECU_Address@KINP_MCPressureV_flg_ovrdflg@ */ Scalar_BOOLEAN 0 SWC_INP_type_CM_boolean_flg 0.0 1.0 /end CHARACTERISTIC
/begin CHARACTERISTIC KINP_MCPressureV_flg_ovrdval "" VALUE 0x0000 /* @ECU_Address@KINP_MCPressureV_flg_ovrdval@ */ Scalar_BOOLEAN 0 SWC_INP_type_CM_boolean_flg 0.0 1.0 /end CHARACTERISTIC
/begin CHARACTERISTIC KINP_MCPressure_bar_ovrdflg "" VALUE 0x0000 /* @ECU_Address@KINP_MCPressure_bar_ovrdflg@ */ Scalar_BOOLEAN 0 SWC_INP_type_CM_boolean_flg 0.0 1.0 /end CHARACTERISTIC
/begin CHARACTERISTIC KINP_MFRDNBrightReq_pct_ovrdflg "" VALUE 0x0000 /* @ECU_Address@KINP_MFRDNBrightReq_pct_ovrdflg@ */ Scalar_BOOLEAN 0 SWC_INP_type_CM_boolean_flg 0.0 1.0 /end CHARACTERISTIC
/begin CHARACTERISTIC KINP_MeterIndVehSpeed_kph_ovrdflg "" VALUE 0x0000 /* @ECU_Address@KINP_MeterIndVehSpeed_kph_ovrdflg@ */ Scalar_BOOLEAN 0 SWC_INP_type_CM_boolean_flg 0.0 1.0 /end CHARACTERISTIC
/begin CHARACTERISTIC KINP_OFFACMODE_enum_ovrdflg "" VALUE 0x0000 /* @ECU_Address@KINP_OFFACMODE_enum_ovrdflg@ */ Scalar_BOOLEAN 0 SWC_INP_type_CM_boolean_flg 0.0 1.0 /end CHARACTERISTIC
/begin CHARACTERISTIC KINP_OpenDrOpenWdoSW_flg_defval "" VALUE 0x0000 /* @ECU_Address@KINP_OpenDrOpenWdoSW_flg_defval@ */ Scalar_BOOLEAN 0 SWC_INP_type_CM_boolean_flg 0.0 1.0 /end CHARACTERISTIC
/begin CHARACTERISTIC KINP_OpenDrOpenWdoSW_flg_ovrdflg "" VALUE 0x0000 /* @ECU_Address@KINP_OpenDrOpenWdoSW_flg_ovrdflg@ */ Scalar_BOOLEAN 0 SWC_INP_type_CM_boolean_flg 0.0 1.0 /end CHARACTERISTIC
/begin CHARACTERISTIC KINP_OpenDrOpenWdoSW_flg_ovrdval "" VALUE 0x0000 /* @ECU_Address@KINP_OpenDrOpenWdoSW_flg_ovrdval@ */ Scalar_BOOLEAN 0 SWC_INP_type_CM_boolean_flg 0.0 1.0 /end CHARACTERISTIC
/begin CHARACTERISTIC KINP_PSEATventreq_enum_ovrdflg "" VALUE 0x0000 /* @ECU_Address@KINP_PSEATventreq_enum_ovrdflg@ */ Scalar_BOOLEAN 0 SWC_INP_type_CM_boolean_flg 0.0 1.0 /end CHARACTERISTIC
/begin CHARACTERISTIC KINP_PWCONTINUEUSE_flg_defval "" VALUE 0x0000 /* @ECU_Address@KINP_PWCONTINUEUSE_flg_defval@ */ Scalar_BOOLEAN 0 SWC_INP_type_CM_boolean_flg 0.0 1.0 /end CHARACTERISTIC
/begin CHARACTERISTIC KINP_PWCONTINUEUSE_flg_ovrdflg "" VALUE 0x0000 /* @ECU_Address@KINP_PWCONTINUEUSE_flg_ovrdflg@ */ Scalar_BOOLEAN 0 SWC_INP_type_CM_boolean_flg 0.0 1.0 /end CHARACTERISTIC
/begin CHARACTERISTIC KINP_PWCONTINUEUSE_flg_ovrdval "" VALUE 0x0000 /* @ECU_Address@KINP_PWCONTINUEUSE_flg_ovrdval@ */ Scalar_BOOLEAN 0 SWC_INP_type_CM_boolean_flg 0.0 1.0 /end CHARACTERISTIC
/begin CHARACTERISTIC KINP_PerdV2L_enum_ovrdflg "" VALUE 0x0000 /* @ECU_Address@KINP_PerdV2L_enum_ovrdflg@ */ Scalar_BOOLEAN 0 SWC_INP_type_CM_boolean_flg 0.0 1.0 /end CHARACTERISTIC
/begin CHARACTERISTIC KINP_RDCActive_enum_ovrdflg "" VALUE 0x0000 /* @ECU_Address@KINP_RDCActive_enum_ovrdflg@ */ Scalar_BOOLEAN 0 SWC_INP_type_CM_boolean_flg 0.0 1.0 /end CHARACTERISTIC
/begin CHARACTERISTIC KINP_RFogLampSW_flg_defval "" VALUE 0x0000 /* @ECU_Address@KINP_RFogLampSW_flg_defval@ */ Scalar_BOOLEAN 0 SWC_INP_type_CM_boolean_flg 0.0 1.0 /end CHARACTERISTIC
/begin CHARACTERISTIC KINP_RFogLampSW_flg_ovrdflg "" VALUE 0x0000 /* @ECU_Address@KINP_RFogLampSW_flg_ovrdflg@ */ Scalar_BOOLEAN 0 SWC_INP_type_CM_boolean_flg 0.0 1.0 /end CHARACTERISTIC
/begin CHARACTERISTIC KINP_RFogLampSW_flg_ovrdval "" VALUE 0x0000 /* @ECU_Address@KINP_RFogLampSW_flg_ovrdval@ */ Scalar_BOOLEAN 0 SWC_INP_type_CM_boolean_flg 0.0 1.0 /end CHARACTERISTIC
/begin CHARACTERISTIC KINP_RearAxlTrqReqBrk_Nm_ovrdflg "" VALUE 0x0000 /* @ECU_Address@KINP_RearAxlTrqReqBrk_Nm_ovrdflg@ */ Scalar_BOOLEAN 0 SWC_INP_type_CM_boolean_flg 0.0 1.0 /end CHARACTERISTIC
/begin CHARACTERISTIC KINP_RollModeSWCmd_enum_ovrdflg "" VALUE 0x0000 /* @ECU_Address@KINP_RollModeSWCmd_enum_ovrdflg@ */ Scalar_BOOLEAN 0 SWC_INP_type_CM_boolean_flg 0.0 1.0 /end CHARACTERISTIC
/begin CHARACTERISTIC KINP_RoomLampMode_flg_defval "" VALUE 0x0000 /* @ECU_Address@KINP_RoomLampMode_flg_defval@ */ Scalar_BOOLEAN 0 SWC_INP_type_CM_boolean_flg 0.0 1.0 /end CHARACTERISTIC
/begin CHARACTERISTIC KINP_RoomLampMode_flg_ovrdflg "" VALUE 0x0000 /* @ECU_Address@KINP_RoomLampMode_flg_ovrdflg@ */ Scalar_BOOLEAN 0 SWC_INP_type_CM_boolean_flg 0.0 1.0 /end CHARACTERISTIC
/begin CHARACTERISTIC KINP_RoomLampMode_flg_ovrdval "" VALUE 0x0000 /* @ECU_Address@KINP_RoomLampMode_flg_ovrdval@ */ Scalar_BOOLEAN 0 SWC_INP_type_CM_boolean_flg 0.0 1.0 /end CHARACTERISTIC
/begin CHARACTERISTIC KINP_RrRBCActive_flg_defval "" VALUE 0x0000 /* @ECU_Address@KINP_RrRBCActive_flg_defval@ */ Scalar_BOOLEAN 0 SWC_INP_type_CM_boolean_flg 0.0 1.0 /end CHARACTERISTIC
/begin CHARACTERISTIC KINP_RrRBCActive_flg_ovrdflg "" VALUE 0x0000 /* @ECU_Address@KINP_RrRBCActive_flg_ovrdflg@ */ Scalar_BOOLEAN 0 SWC_INP_type_CM_boolean_flg 0.0 1.0 /end CHARACTERISTIC
/begin CHARACTERISTIC KINP_RrRBCActive_flg_ovrdval "" VALUE 0x0000 /* @ECU_Address@KINP_RrRBCActive_flg_ovrdval@ */ Scalar_BOOLEAN 0 SWC_INP_type_CM_boolean_flg 0.0 1.0 /end CHARACTERISTIC
/begin CHARACTERISTIC KINP_SOCADJBUTT_flg_defval "" VALUE 0x0000 /* @ECU_Address@KINP_SOCADJBUTT_flg_defval@ */ Scalar_BOOLEAN 0 SWC_INP_type_CM_boolean_flg 0.0 1.0 /end CHARACTERISTIC
/begin CHARACTERISTIC KINP_SOCADJBUTT_flg_ovrdflg "" VALUE 0x0000 /* @ECU_Address@KINP_SOCADJBUTT_flg_ovrdflg@ */ Scalar_BOOLEAN 0 SWC_INP_type_CM_boolean_flg 0.0 1.0 /end CHARACTERISTIC
/begin CHARACTERISTIC KINP_SOCADJBUTT_flg_ovrdval "" VALUE 0x0000 /* @ECU_Address@KINP_SOCADJBUTT_flg_ovrdval@ */ Scalar_BOOLEAN 0 SWC_INP_type_CM_boolean_flg 0.0 1.0 /end CHARACTERISTIC
/begin CHARACTERISTIC KINP_SOCLimitSet_pct_ovrdflg "" VALUE 0x0000 /* @ECU_Address@KINP_SOCLimitSet_pct_ovrdflg@ */ Scalar_BOOLEAN 0 SWC_INP_type_CM_boolean_flg 0.0 1.0 /end CHARACTERISTIC
/begin CHARACTERISTIC KINP_SOCV2LLimit_pct_ovrdflg "" VALUE 0x0000 /* @ECU_Address@KINP_SOCV2LLimit_pct_ovrdflg@ */ Scalar_BOOLEAN 0 SWC_INP_type_CM_boolean_flg 0.0 1.0 /end CHARACTERISTIC
/begin CHARACTERISTIC KINP_SchedChgStart_flg_defval "" VALUE 0x0000 /* @ECU_Address@KINP_SchedChgStart_flg_defval@ */ Scalar_BOOLEAN 0 SWC_INP_type_CM_boolean_flg 0.0 1.0 /end CHARACTERISTIC
/begin CHARACTERISTIC KINP_SchedChgStart_flg_ovrdflg "" VALUE 0x0000 /* @ECU_Address@KINP_SchedChgStart_flg_ovrdflg@ */ Scalar_BOOLEAN 0 SWC_INP_type_CM_boolean_flg 0.0 1.0 /end CHARACTERISTIC
/begin CHARACTERISTIC KINP_SchedChgStart_flg_ovrdval "" VALUE 0x0000 /* @ECU_Address@KINP_SchedChgStart_flg_ovrdval@ */ Scalar_BOOLEAN 0 SWC_INP_type_CM_boolean_flg 0.0 1.0 /end CHARACTERISTIC
/begin CHARACTERISTIC KINP_SchedChgStop_flg_defval "" VALUE 0x0000 /* @ECU_Address@KINP_SchedChgStop_flg_defval@ */ Scalar_BOOLEAN 0 SWC_INP_type_CM_boolean_flg 0.0 1.0 /end CHARACTERISTIC
/begin CHARACTERISTIC KINP_SchedChgStop_flg_ovrdflg "" VALUE 0x0000 /* @ECU_Address@KINP_SchedChgStop_flg_ovrdflg@ */ Scalar_BOOLEAN 0 SWC_INP_type_CM_boolean_flg 0.0 1.0 /end CHARACTERISTIC
/begin CHARACTERISTIC KINP_SchedChgStop_flg_ovrdval "" VALUE 0x0000 /* @ECU_Address@KINP_SchedChgStop_flg_ovrdval@ */ Scalar_BOOLEAN 0 SWC_INP_type_CM_boolean_flg 0.0 1.0 /end CHARACTERISTIC
/begin CHARACTERISTIC KINP_SchedChgbutt_flg_defval "" VALUE 0x0000 /* @ECU_Address@KINP_SchedChgbutt_flg_defval@ */ Scalar_BOOLEAN 0 SWC_INP_type_CM_boolean_flg 0.0 1.0 /end CHARACTERISTIC
/begin CHARACTERISTIC KINP_SchedChgbutt_flg_ovrdflg "" VALUE 0x0000 /* @ECU_Address@KINP_SchedChgbutt_flg_ovrdflg@ */ Scalar_BOOLEAN 0 SWC_INP_type_CM_boolean_flg 0.0 1.0 /end CHARACTERISTIC
/begin CHARACTERISTIC KINP_SchedChgbutt_flg_ovrdval "" VALUE 0x0000 /* @ECU_Address@KINP_SchedChgbutt_flg_ovrdval@ */ Scalar_BOOLEAN 0 SWC_INP_type_CM_boolean_flg 0.0 1.0 /end CHARACTERISTIC
/begin CHARACTERISTIC KINP_SchedChglimit_pct_ovrdflg "" VALUE 0x0000 /* @ECU_Address@KINP_SchedChglimit_pct_ovrdflg@ */ Scalar_BOOLEAN 0 SWC_INP_type_CM_boolean_flg 0.0 1.0 /end CHARACTERISTIC
/begin CHARACTERISTIC KINP_SchedChgwake_flg_defval "" VALUE 0x0000 /* @ECU_Address@KINP_SchedChgwake_flg_defval@ */ Scalar_BOOLEAN 0 SWC_INP_type_CM_boolean_flg 0.0 1.0 /end CHARACTERISTIC
/begin CHARACTERISTIC KINP_SchedChgwake_flg_ovrdflg "" VALUE 0x0000 /* @ECU_Address@KINP_SchedChgwake_flg_ovrdflg@ */ Scalar_BOOLEAN 0 SWC_INP_type_CM_boolean_flg 0.0 1.0 /end CHARACTERISTIC
/begin CHARACTERISTIC KINP_SchedChgwake_flg_ovrdval "" VALUE 0x0000 /* @ECU_Address@KINP_SchedChgwake_flg_ovrdval@ */ Scalar_BOOLEAN 0 SWC_INP_type_CM_boolean_flg 0.0 1.0 /end CHARACTERISTIC
/begin CHARACTERISTIC KINP_SenstivityPosition_enum_ovrdflg "" VALUE 0x0000 /* @ECU_Address@KINP_SenstivityPosition_enum_ovrdflg@ */ Scalar_BOOLEAN 0 SWC_INP_type_CM_boolean_flg 0.0 1.0 /end CHARACTERISTIC
/begin CHARACTERISTIC KINP_SetUnlockSingle_flg_defval "" VALUE 0x0000 /* @ECU_Address@KINP_SetUnlockSingle_flg_defval@ */ Scalar_BOOLEAN 0 SWC_INP_type_CM_boolean_flg 0.0 1.0 /end CHARACTERISTIC
/begin CHARACTERISTIC KINP_SetUnlockSingle_flg_ovrdflg "" VALUE 0x0000 /* @ECU_Address@KINP_SetUnlockSingle_flg_ovrdflg@ */ Scalar_BOOLEAN 0 SWC_INP_type_CM_boolean_flg 0.0 1.0 /end CHARACTERISTIC
/begin CHARACTERISTIC KINP_SetUnlockSingle_flg_ovrdval "" VALUE 0x0000 /* @ECU_Address@KINP_SetUnlockSingle_flg_ovrdval@ */ Scalar_BOOLEAN 0 SWC_INP_type_CM_boolean_flg 0.0 1.0 /end CHARACTERISTIC
/begin CHARACTERISTIC KINP_SmartEcoModeSW_flg_defval "" VALUE 0x0000 /* @ECU_Address@KINP_SmartEcoModeSW_flg_defval@ */ Scalar_BOOLEAN 0 SWC_INP_type_CM_boolean_flg 0.0 1.0 /end CHARACTERISTIC
/begin CHARACTERISTIC KINP_SmartEcoModeSW_flg_ovrdflg "" VALUE 0x0000 /* @ECU_Address@KINP_SmartEcoModeSW_flg_ovrdflg@ */ Scalar_BOOLEAN 0 SWC_INP_type_CM_boolean_flg 0.0 1.0 /end CHARACTERISTIC
/begin CHARACTERISTIC KINP_SmartEcoModeSW_flg_ovrdval "" VALUE 0x0000 /* @ECU_Address@KINP_SmartEcoModeSW_flg_ovrdval@ */ Scalar_BOOLEAN 0 SWC_INP_type_CM_boolean_flg 0.0 1.0 /end CHARACTERISTIC
/begin CHARACTERISTIC KINP_TCSActive_flg_defval "" VALUE 0x0000 /* @ECU_Address@KINP_TCSActive_flg_defval@ */ Scalar_BOOLEAN 0 SWC_INP_type_CM_boolean_flg 0.0 1.0 /end CHARACTERISTIC
/begin CHARACTERISTIC KINP_TCSActive_flg_ovrdflg "" VALUE 0x0000 /* @ECU_Address@KINP_TCSActive_flg_ovrdflg@ */ Scalar_BOOLEAN 0 SWC_INP_type_CM_boolean_flg 0.0 1.0 /end CHARACTERISTIC
/begin CHARACTERISTIC KINP_TCSActive_flg_ovrdval "" VALUE 0x0000 /* @ECU_Address@KINP_TCSActive_flg_ovrdval@ */ Scalar_BOOLEAN 0 SWC_INP_type_CM_boolean_flg 0.0 1.0 /end CHARACTERISTIC
/begin CHARACTERISTIC KINP_TCSFailed_flg_defval "" VALUE 0x0000 /* @ECU_Address@KINP_TCSFailed_flg_defval@ */ Scalar_BOOLEAN 0 SWC_INP_type_CM_boolean_flg 0.0 1.0 /end CHARACTERISTIC
/begin CHARACTERISTIC KINP_TCSFailed_flg_ovrdflg "" VALUE 0x0000 /* @ECU_Address@KINP_TCSFailed_flg_ovrdflg@ */ Scalar_BOOLEAN 0 SWC_INP_type_CM_boolean_flg 0.0 1.0 /end CHARACTERISTIC
/begin CHARACTERISTIC KINP_TCSFailed_flg_ovrdval "" VALUE 0x0000 /* @ECU_Address@KINP_TCSFailed_flg_ovrdval@ */ Scalar_BOOLEAN 0 SWC_INP_type_CM_boolean_flg 0.0 1.0 /end CHARACTERISTIC
/begin CHARACTERISTIC KINP_TCSSWCmd_enum_ovrdflg "" VALUE 0x0000 /* @ECU_Address@KINP_TCSSWCmd_enum_ovrdflg@ */ Scalar_BOOLEAN 0 SWC_INP_type_CM_boolean_flg 0.0 1.0 /end CHARACTERISTIC
/begin CHARACTERISTIC KINP_TPMSCaliButt_flg_defval "" VALUE 0x0000 /* @ECU_Address@KINP_TPMSCaliButt_flg_defval@ */ Scalar_BOOLEAN 0 SWC_INP_type_CM_boolean_flg 0.0 1.0 /end CHARACTERISTIC
/begin CHARACTERISTIC KINP_TPMSCaliButt_flg_ovrdflg "" VALUE 0x0000 /* @ECU_Address@KINP_TPMSCaliButt_flg_ovrdflg@ */ Scalar_BOOLEAN 0 SWC_INP_type_CM_boolean_flg 0.0 1.0 /end CHARACTERISTIC
/begin CHARACTERISTIC KINP_TPMSCaliButt_flg_ovrdval "" VALUE 0x0000 /* @ECU_Address@KINP_TPMSCaliButt_flg_ovrdval@ */ Scalar_BOOLEAN 0 SWC_INP_type_CM_boolean_flg 0.0 1.0 /end CHARACTERISTIC
/begin CHARACTERISTIC KINP_TPMSResButt_flg_defval "" VALUE 0x0000 /* @ECU_Address@KINP_TPMSResButt_flg_defval@ */ Scalar_BOOLEAN 0 SWC_INP_type_CM_boolean_flg 0.0 1.0 /end CHARACTERISTIC
/begin CHARACTERISTIC KINP_TPMSResButt_flg_ovrdflg "" VALUE 0x0000 /* @ECU_Address@KINP_TPMSResButt_flg_ovrdflg@ */ Scalar_BOOLEAN 0 SWC_INP_type_CM_boolean_flg 0.0 1.0 /end CHARACTERISTIC
/begin CHARACTERISTIC KINP_TPMSResButt_flg_ovrdval "" VALUE 0x0000 /* @ECU_Address@KINP_TPMSResButt_flg_ovrdval@ */ Scalar_BOOLEAN 0 SWC_INP_type_CM_boolean_flg 0.0 1.0 /end CHARACTERISTIC
/begin CHARACTERISTIC KINP_TurnSwTimeSet_enum_ovrdflg "" VALUE 0x0000 /* @ECU_Address@KINP_TurnSwTimeSet_enum_ovrdflg@ */ Scalar_BOOLEAN 0 SWC_INP_type_CM_boolean_flg 0.0 1.0 /end CHARACTERISTIC
/begin CHARACTERISTIC KINP_UserSet_enum_ovrdflg "" VALUE 0x0000 /* @ECU_Address@KINP_UserSet_enum_ovrdflg@ */ Scalar_BOOLEAN 0 SWC_INP_type_CM_boolean_flg 0.0 1.0 /end CHARACTERISTIC
/begin CHARACTERISTIC KINP_VehSpeed_kph_ovrdflg "" VALUE 0x0000 /* @ECU_Address@KINP_VehSpeed_kph_ovrdflg@ */ Scalar_BOOLEAN 0 SWC_INP_type_CM_boolean_flg 0.0 1.0 /end CHARACTERISTIC
/begin CHARACTERISTIC KINP_WalkawayLockSW_flg_defval "" VALUE 0x0000 /* @ECU_Address@KINP_WalkawayLockSW_flg_defval@ */ Scalar_BOOLEAN 0 SWC_INP_type_CM_boolean_flg 0.0 1.0 /end CHARACTERISTIC
/begin CHARACTERISTIC KINP_WalkawayLockSW_flg_ovrdflg "" VALUE 0x0000 /* @ECU_Address@KINP_WalkawayLockSW_flg_ovrdflg@ */ Scalar_BOOLEAN 0 SWC_INP_type_CM_boolean_flg 0.0 1.0 /end CHARACTERISTIC
/begin CHARACTERISTIC KINP_WalkawayLockSW_flg_ovrdval "" VALUE 0x0000 /* @ECU_Address@KINP_WalkawayLockSW_flg_ovrdval@ */ Scalar_BOOLEAN 0 SWC_INP_type_CM_boolean_flg 0.0 1.0 /end CHARACTERISTIC
/begin CHARACTERISTIC KINP_WlcmLightMode_enum_ovrdflg "" VALUE 0x0000 /* @ECU_Address@KINP_WlcmLightMode_enum_ovrdflg@ */ Scalar_BOOLEAN 0 SWC_INP_type_CM_boolean_flg 0.0 1.0 /end CHARACTERISTIC
/begin CHARACTERISTIC KINP_YawRateV_flg_defval "" VALUE 0x0000 /* @ECU_Address@KINP_YawRateV_flg_defval@ */ Scalar_BOOLEAN 0 SWC_INP_type_CM_boolean_flg 0.0 1.0 /end CHARACTERISTIC
/begin CHARACTERISTIC KINP_YawRateV_flg_ovrdflg "" VALUE 0x0000 /* @ECU_Address@KINP_YawRateV_flg_ovrdflg@ */ Scalar_BOOLEAN 0 SWC_INP_type_CM_boolean_flg 0.0 1.0 /end CHARACTERISTIC
/begin CHARACTERISTIC KINP_YawRateV_flg_ovrdval "" VALUE 0x0000 /* @ECU_Address@KINP_YawRateV_flg_ovrdval@ */ Scalar_BOOLEAN 0 SWC_INP_type_CM_boolean_flg 0.0 1.0 /end CHARACTERISTIC
/begin CHARACTERISTIC KINP_YawRate_degps_ovrdflg "" VALUE 0x0000 /* @ECU_Address@KINP_YawRate_degps_ovrdflg@ */ Scalar_BOOLEAN 0 SWC_INP_type_CM_boolean_flg 0.0 1.0 /end CHARACTERISTIC
/begin CHARACTERISTIC KINP_eBSTAmberWnlmpSta_flg_defval "" VALUE 0x0000 /* @ECU_Address@KINP_eBSTAmberWnlmpSta_flg_defval@ */ Scalar_BOOLEAN 0 SWC_INP_type_CM_boolean_flg 0.0 1.0 /end CHARACTERISTIC
/begin CHARACTERISTIC KINP_eBSTAmberWnlmpSta_flg_ovrdflg "" VALUE 0x0000 /* @ECU_Address@KINP_eBSTAmberWnlmpSta_flg_ovrdflg@ */ Scalar_BOOLEAN 0 SWC_INP_type_CM_boolean_flg 0.0 1.0 /end CHARACTERISTIC
/begin CHARACTERISTIC KINP_eBSTAmberWnlmpSta_flg_ovrdval "" VALUE 0x0000 /* @ECU_Address@KINP_eBSTAmberWnlmpSta_flg_ovrdval@ */ Scalar_BOOLEAN 0 SWC_INP_type_CM_boolean_flg 0.0 1.0 /end CHARACTERISTIC
/begin CHARACTERISTIC KINP_eBSTBeepReq_flg_defval "" VALUE 0x0000 /* @ECU_Address@KINP_eBSTBeepReq_flg_defval@ */ Scalar_BOOLEAN 0 SWC_INP_type_CM_boolean_flg 0.0 1.0 /end CHARACTERISTIC
/begin CHARACTERISTIC KINP_eBSTBeepReq_flg_ovrdflg "" VALUE 0x0000 /* @ECU_Address@KINP_eBSTBeepReq_flg_ovrdflg@ */ Scalar_BOOLEAN 0 SWC_INP_type_CM_boolean_flg 0.0 1.0 /end CHARACTERISTIC
/begin CHARACTERISTIC KINP_eBSTBeepReq_flg_ovrdval "" VALUE 0x0000 /* @ECU_Address@KINP_eBSTBeepReq_flg_ovrdval@ */ Scalar_BOOLEAN 0 SWC_INP_type_CM_boolean_flg 0.0 1.0 /end CHARACTERISTIC
/begin CHARACTERISTIC KINP_eBSTRedWnlmpSta_flg_defval "" VALUE 0x0000 /* @ECU_Address@KINP_eBSTRedWnlmpSta_flg_defval@ */ Scalar_BOOLEAN 0 SWC_INP_type_CM_boolean_flg 0.0 1.0 /end CHARACTERISTIC
/begin CHARACTERISTIC KINP_eBSTRedWnlmpSta_flg_ovrdflg "" VALUE 0x0000 /* @ECU_Address@KINP_eBSTRedWnlmpSta_flg_ovrdflg@ */ Scalar_BOOLEAN 0 SWC_INP_type_CM_boolean_flg 0.0 1.0 /end CHARACTERISTIC
/begin CHARACTERISTIC KINP_eBSTRedWnlmpSta_flg_ovrdval "" VALUE 0x0000 /* @ECU_Address@KINP_eBSTRedWnlmpSta_flg_ovrdval@ */ Scalar_BOOLEAN 0 SWC_INP_type_CM_boolean_flg 0.0 1.0 /end CHARACTERISTIC
/begin CHARACTERISTIC KINP_sigAirIntenZon1Req_enum_ovrdflg "" VALUE 0x0000 /* @ECU_Address@KINP_sigAirIntenZon1Req_enum_ovrdflg@ */ Scalar_BOOLEAN 0 SWC_INP_type_CM_boolean_flg 0.0 1.0 /end CHARACTERISTIC
/begin CHARACTERISTIC KINP_sigDfrstReq_flg_defval "" VALUE 0x0000 /* @ECU_Address@KINP_sigDfrstReq_flg_defval@ */ Scalar_BOOLEAN 0 SWC_INP_type_CM_boolean_flg 0.0 1.0 /end CHARACTERISTIC
/begin CHARACTERISTIC KINP_sigDfrstReq_flg_ovrdflg "" VALUE 0x0000 /* @ECU_Address@KINP_sigDfrstReq_flg_ovrdflg@ */ Scalar_BOOLEAN 0 SWC_INP_type_CM_boolean_flg 0.0 1.0 /end CHARACTERISTIC
/begin CHARACTERISTIC KINP_sigDfrstReq_flg_ovrdval "" VALUE 0x0000 /* @ECU_Address@KINP_sigDfrstReq_flg_ovrdval@ */ Scalar_BOOLEAN 0 SWC_INP_type_CM_boolean_flg 0.0 1.0 /end CHARACTERISTIC
/begin CHARACTERISTIC KINP_sigFaceReq_flg_defval "" VALUE 0x0000 /* @ECU_Address@KINP_sigFaceReq_flg_defval@ */ Scalar_BOOLEAN 0 SWC_INP_type_CM_boolean_flg 0.0 1.0 /end CHARACTERISTIC
/begin CHARACTERISTIC KINP_sigFaceReq_flg_ovrdflg "" VALUE 0x0000 /* @ECU_Address@KINP_sigFaceReq_flg_ovrdflg@ */ Scalar_BOOLEAN 0 SWC_INP_type_CM_boolean_flg 0.0 1.0 /end CHARACTERISTIC
/begin CHARACTERISTIC KINP_sigFaceReq_flg_ovrdval "" VALUE 0x0000 /* @ECU_Address@KINP_sigFaceReq_flg_ovrdval@ */ Scalar_BOOLEAN 0 SWC_INP_type_CM_boolean_flg 0.0 1.0 /end CHARACTERISTIC
/begin CHARACTERISTIC KINP_sigFootReq_flg_defval "" VALUE 0x0000 /* @ECU_Address@KINP_sigFootReq_flg_defval@ */ Scalar_BOOLEAN 0 SWC_INP_type_CM_boolean_flg 0.0 1.0 /end CHARACTERISTIC
/begin CHARACTERISTIC KINP_sigFootReq_flg_ovrdflg "" VALUE 0x0000 /* @ECU_Address@KINP_sigFootReq_flg_ovrdflg@ */ Scalar_BOOLEAN 0 SWC_INP_type_CM_boolean_flg 0.0 1.0 /end CHARACTERISTIC
/begin CHARACTERISTIC KINP_sigFootReq_flg_ovrdval "" VALUE 0x0000 /* @ECU_Address@KINP_sigFootReq_flg_ovrdval@ */ Scalar_BOOLEAN 0 SWC_INP_type_CM_boolean_flg 0.0 1.0 /end CHARACTERISTIC
/begin CHARACTERISTIC KINP_sigRecircReq_flg_defval "" VALUE 0x0000 /* @ECU_Address@KINP_sigRecircReq_flg_defval@ */ Scalar_BOOLEAN 0 SWC_INP_type_CM_boolean_flg 0.0 1.0 /end CHARACTERISTIC
/begin CHARACTERISTIC KINP_sigRecircReq_flg_ovrdflg "" VALUE 0x0000 /* @ECU_Address@KINP_sigRecircReq_flg_ovrdflg@ */ Scalar_BOOLEAN 0 SWC_INP_type_CM_boolean_flg 0.0 1.0 /end CHARACTERISTIC
/begin CHARACTERISTIC KINP_sigRecircReq_flg_ovrdval "" VALUE 0x0000 /* @ECU_Address@KINP_sigRecircReq_flg_ovrdval@ */ Scalar_BOOLEAN 0 SWC_INP_type_CM_boolean_flg 0.0 1.0 /end CHARACTERISTIC
/begin CHARACTERISTIC KINP_sigSetTempZon1Req_C_ovrdflg "" VALUE 0x0000 /* @ECU_Address@KINP_sigSetTempZon1Req_C_ovrdflg@ */ Scalar_BOOLEAN 0 SWC_INP_type_CM_boolean_flg 0.0 1.0 /end CHARACTERISTIC
/begin CHARACTERISTIC KINP_sigSetTempZon2Req_C_ovrdflg "" VALUE 0x0000 /* @ECU_Address@KINP_sigSetTempZon2Req_C_ovrdflg@ */ Scalar_BOOLEAN 0 SWC_INP_type_CM_boolean_flg 0.0 1.0 /end CHARACTERISTIC
/begin CHARACTERISTIC KINP_AVMParkingmode_enum_defval "" VALUE 0x0000 /* @ECU_Address@KINP_AVMParkingmode_enum_defval@ */ Scalar_UBYTE 0 SWC_INP_type_CM_uint8_enum 0.0 15.0 /end CHARACTERISTIC
/begin CHARACTERISTIC KINP_AVMParkingmode_enum_ovrdval "" VALUE 0x0000 /* @ECU_Address@KINP_AVMParkingmode_enum_ovrdval@ */ Scalar_UBYTE 0 SWC_INP_type_CM_uint8_enum 0.0 15.0 /end CHARACTERISTIC
/begin CHARACTERISTIC KINP_AVMparkingcancel_enum_defval "" VALUE 0x0000 /* @ECU_Address@KINP_AVMparkingcancel_enum_defval@ */ Scalar_UBYTE 0 SWC_INP_type_CM_uint8_enum 0.0 3.0 /end CHARACTERISTIC
/begin CHARACTERISTIC KINP_AVMparkingcancel_enum_ovrdval "" VALUE 0x0000 /* @ECU_Address@KINP_AVMparkingcancel_enum_ovrdval@ */ Scalar_UBYTE 0 SWC_INP_type_CM_uint8_enum 0.0 3.0 /end CHARACTERISTIC
/begin CHARACTERISTIC KINP_AVMparkingexcute_enum_defval "" VALUE 0x0000 /* @ECU_Address@KINP_AVMparkingexcute_enum_defval@ */ Scalar_UBYTE 0 SWC_INP_type_CM_uint8_enum 0.0 3.0 /end CHARACTERISTIC
/begin CHARACTERISTIC KINP_AVMparkingexcute_enum_ovrdval "" VALUE 0x0000 /* @ECU_Address@KINP_AVMparkingexcute_enum_ovrdval@ */ Scalar_UBYTE 0 SWC_INP_type_CM_uint8_enum 0.0 3.0 /end CHARACTERISTIC
/begin CHARACTERISTIC KINP_AmbLightBrightnessSet_enum_defval "" VALUE 0x0000 /* @ECU_Address@KINP_AmbLightBrightnessSet_enum_defval@ */ Scalar_UBYTE 0 SWC_INP_type_CM_uint8_enum 0.0 127.0 /end CHARACTERISTIC
/begin CHARACTERISTIC KINP_AmbLightBrightnessSet_enum_ovrdval "" VALUE 0x0000 /* @ECU_Address@KINP_AmbLightBrightnessSet_enum_ovrdval@ */ Scalar_UBYTE 0 SWC_INP_type_CM_uint8_enum 0.0 127.0 /end CHARACTERISTIC
/begin CHARACTERISTIC KINP_AmbLightColorSet_enum_defval "" VALUE 0x0000 /* @ECU_Address@KINP_AmbLightColorSet_enum_defval@ */ Scalar_UBYTE 0 SWC_INP_type_CM_uint8_enum 0.0 127.0 /end CHARACTERISTIC
/begin CHARACTERISTIC KINP_AmbLightColorSet_enum_ovrdval "" VALUE 0x0000 /* @ECU_Address@KINP_AmbLightColorSet_enum_ovrdval@ */ Scalar_UBYTE 0 SWC_INP_type_CM_uint8_enum 0.0 127.0 /end CHARACTERISTIC
/begin CHARACTERISTIC KINP_CAASSw_enum_defval "" VALUE 0x0000 /* @ECU_Address@KINP_CAASSw_enum_defval@ */ Scalar_UBYTE 0 SWC_INP_type_CM_uint8_enum 0.0 3.0 /end CHARACTERISTIC
/begin CHARACTERISTIC KINP_CAASSw_enum_ovrdval "" VALUE 0x0000 /* @ECU_Address@KINP_CAASSw_enum_ovrdval@ */ Scalar_UBYTE 0 SWC_INP_type_CM_uint8_enum 0.0 3.0 /end CHARACTERISTIC
/begin CHARACTERISTIC KINP_DSEATventreq_enum_defval "" VALUE 0x0000 /* @ECU_Address@KINP_DSEATventreq_enum_defval@ */ Scalar_UBYTE 0 SWC_INP_type_CM_uint8_enum 0.0 7.0 /end CHARACTERISTIC
/begin CHARACTERISTIC KINP_DSEATventreq_enum_ovrdval "" VALUE 0x0000 /* @ECU_Address@KINP_DSEATventreq_enum_ovrdval@ */ Scalar_UBYTE 0 SWC_INP_type_CM_uint8_enum 0.0 7.0 /end CHARACTERISTIC
/begin CHARACTERISTIC KINP_ESC5CS_enum_defval "" VALUE 0x0000 /* @ECU_Address@KINP_ESC5CS_enum_defval@ */ Scalar_UBYTE 0 SWC_INP_type_CM_uint8_enum 0.0 255.0 /end CHARACTERISTIC
/begin CHARACTERISTIC KINP_ESC5CS_enum_ovrdval "" VALUE 0x0000 /* @ECU_Address@KINP_ESC5CS_enum_ovrdval@ */ Scalar_UBYTE 0 SWC_INP_type_CM_uint8_enum 0.0 255.0 /end CHARACTERISTIC
/begin CHARACTERISTIC KINP_ESC5RC_enum_defval "" VALUE 0x0000 /* @ECU_Address@KINP_ESC5RC_enum_defval@ */ Scalar_UBYTE 0 SWC_INP_type_CM_uint8_enum 0.0 14.0 /end CHARACTERISTIC
/begin CHARACTERISTIC KINP_ESC5RC_enum_ovrdval "" VALUE 0x0000 /* @ECU_Address@KINP_ESC5RC_enum_ovrdval@ */ Scalar_UBYTE 0 SWC_INP_type_CM_uint8_enum 0.0 14.0 /end CHARACTERISTIC
/begin CHARACTERISTIC KINP_ESCADASSta_enum_defval "" VALUE 0x0000 /* @ECU_Address@KINP_ESCADASSta_enum_defval@ */ Scalar_UBYTE 0 SWC_INP_type_CM_uint8_enum 0.0 6.0 /end CHARACTERISTIC
/begin CHARACTERISTIC KINP_ESCADASSta_enum_ovrdval "" VALUE 0x0000 /* @ECU_Address@KINP_ESCADASSta_enum_ovrdval@ */ Scalar_UBYTE 0 SWC_INP_type_CM_uint8_enum 0.0 6.0 /end CHARACTERISTIC
/begin CHARACTERISTIC KINP_ESCAPSSta_enum_defval "" VALUE 0x0000 /* @ECU_Address@KINP_ESCAPSSta_enum_defval@ */ Scalar_UBYTE 0 SWC_INP_type_CM_uint8_enum 0.0 5.0 /end CHARACTERISTIC
/begin CHARACTERISTIC KINP_ESCAPSSta_enum_ovrdval "" VALUE 0x0000 /* @ECU_Address@KINP_ESCAPSSta_enum_ovrdval@ */ Scalar_UBYTE 0 SWC_INP_type_CM_uint8_enum 0.0 5.0 /end CHARACTERISTIC
/begin CHARACTERISTIC KINP_ESCSWCmd_enum_defval "" VALUE 0x0000 /* @ECU_Address@KINP_ESCSWCmd_enum_defval@ */ Scalar_UBYTE 0 SWC_INP_type_CM_uint8_enum 0.0 3.0 /end CHARACTERISTIC
/begin CHARACTERISTIC KINP_ESCSWCmd_enum_ovrdval "" VALUE 0x0000 /* @ECU_Address@KINP_ESCSWCmd_enum_ovrdval@ */ Scalar_UBYTE 0 SWC_INP_type_CM_uint8_enum 0.0 3.0 /end CHARACTERISTIC
/begin CHARACTERISTIC KINP_FSOffSw_enum_defval "" VALUE 0x0000 /* @ECU_Address@KINP_FSOffSw_enum_defval@ */ Scalar_UBYTE 0 SWC_INP_type_CM_uint8_enum 0.0 3.0 /end CHARACTERISTIC
/begin CHARACTERISTIC KINP_FSOffSw_enum_ovrdval "" VALUE 0x0000 /* @ECU_Address@KINP_FSOffSw_enum_ovrdval@ */ Scalar_UBYTE 0 SWC_INP_type_CM_uint8_enum 0.0 3.0 /end CHARACTERISTIC
/begin CHARACTERISTIC KINP_HeadLampSW_enum_defval "" VALUE 0x0000 /* @ECU_Address@KINP_HeadLampSW_enum_defval@ */ Scalar_UBYTE 0 SWC_INP_type_CM_uint8_enum 0.0 3.0 /end CHARACTERISTIC
/begin CHARACTERISTIC KINP_HeadLampSW_enum_ovrdval "" VALUE 0x0000 /* @ECU_Address@KINP_HeadLampSW_enum_ovrdval@ */ Scalar_UBYTE 0 SWC_INP_type_CM_uint8_enum 0.0 3.0 /end CHARACTERISTIC
/begin CHARACTERISTIC KINP_HoodLatchSW_enum_defval "" VALUE 0x0000 /* @ECU_Address@KINP_HoodLatchSW_enum_defval@ */ Scalar_UBYTE 0 SWC_INP_type_CM_uint8_enum 0.0 3.0 /end CHARACTERISTIC
/begin CHARACTERISTIC KINP_HoodLatchSW_enum_ovrdval "" VALUE 0x0000 /* @ECU_Address@KINP_HoodLatchSW_enum_ovrdval@ */ Scalar_UBYTE 0 SWC_INP_type_CM_uint8_enum 0.0 3.0 /end CHARACTERISTIC
/begin CHARACTERISTIC KINP_IVIAirIntZ3Cmd_enum_defval "" VALUE 0x0000 /* @ECU_Address@KINP_IVIAirIntZ3Cmd_enum_defval@ */ Scalar_UBYTE 0 SWC_INP_type_CM_uint8_enum 0.0 7.0 /end CHARACTERISTIC
/begin CHARACTERISTIC KINP_IVIAirIntZ3Cmd_enum_ovrdval "" VALUE 0x0000 /* @ECU_Address@KINP_IVIAirIntZ3Cmd_enum_ovrdval@ */ Scalar_UBYTE 0 SWC_INP_type_CM_uint8_enum 0.0 7.0 /end CHARACTERISTIC
/begin CHARACTERISTIC KINP_IVICreateAccReqSta_enum_defval "" VALUE 0x0000 /* @ECU_Address@KINP_IVICreateAccReqSta_enum_defval@ */ Scalar_UBYTE 0 SWC_INP_type_CM_uint8_enum 0.0 7.0 /end CHARACTERISTIC
/begin CHARACTERISTIC KINP_IVICreateAccReqSta_enum_ovrdval "" VALUE 0x0000 /* @ECU_Address@KINP_IVICreateAccReqSta_enum_ovrdval@ */ Scalar_UBYTE 0 SWC_INP_type_CM_uint8_enum 0.0 7.0 /end CHARACTERISTIC
/begin CHARACTERISTIC KINP_IVIDSEATFroEdgeHeightCmd_enum_defval "" VALUE 0x0000 /* @ECU_Address@KINP_IVIDSEATFroEdgeHeightCmd_enum_defval@ */ Scalar_UBYTE 0 SWC_INP_type_CM_uint8_enum 0.0 3.0 /end CHARACTERISTIC
/begin CHARACTERISTIC KINP_IVIDSEATFroEdgeHeightCmd_enum_ovrdval "" VALUE 0x0000 /* @ECU_Address@KINP_IVIDSEATFroEdgeHeightCmd_enum_ovrdval@ */ Scalar_UBYTE 0 SWC_INP_type_CM_uint8_enum 0.0 3.0 /end CHARACTERISTIC
/begin CHARACTERISTIC KINP_IVIDSEATHeaterCmd_enum_defval "" VALUE 0x0000 /* @ECU_Address@KINP_IVIDSEATHeaterCmd_enum_defval@ */ Scalar_UBYTE 0 SWC_INP_type_CM_uint8_enum 0.0 7.0 /end CHARACTERISTIC
/begin CHARACTERISTIC KINP_IVIDSEATHeaterCmd_enum_ovrdval "" VALUE 0x0000 /* @ECU_Address@KINP_IVIDSEATHeaterCmd_enum_ovrdval@ */ Scalar_UBYTE 0 SWC_INP_type_CM_uint8_enum 0.0 7.0 /end CHARACTERISTIC
/begin CHARACTERISTIC KINP_IVIDSEATHeightCmd_enum_defval "" VALUE 0x0000 /* @ECU_Address@KINP_IVIDSEATHeightCmd_enum_defval@ */ Scalar_UBYTE 0 SWC_INP_type_CM_uint8_enum 0.0 3.0 /end CHARACTERISTIC
/begin CHARACTERISTIC KINP_IVIDSEATHeightCmd_enum_ovrdval "" VALUE 0x0000 /* @ECU_Address@KINP_IVIDSEATHeightCmd_enum_ovrdval@ */ Scalar_UBYTE 0 SWC_INP_type_CM_uint8_enum 0.0 3.0 /end CHARACTERISTIC
/begin CHARACTERISTIC KINP_IVIDSEATReclineCmd_enum_defval "" VALUE 0x0000 /* @ECU_Address@KINP_IVIDSEATReclineCmd_enum_defval@ */ Scalar_UBYTE 0 SWC_INP_type_CM_uint8_enum 0.0 3.0 /end CHARACTERISTIC
/begin CHARACTERISTIC KINP_IVIDSEATReclineCmd_enum_ovrdval "" VALUE 0x0000 /* @ECU_Address@KINP_IVIDSEATReclineCmd_enum_ovrdval@ */ Scalar_UBYTE 0 SWC_INP_type_CM_uint8_enum 0.0 3.0 /end CHARACTERISTIC
/begin CHARACTERISTIC KINP_IVIDSEATSlideCmd_enum_defval "" VALUE 0x0000 /* @ECU_Address@KINP_IVIDSEATSlideCmd_enum_defval@ */ Scalar_UBYTE 0 SWC_INP_type_CM_uint8_enum 0.0 3.0 /end CHARACTERISTIC
/begin CHARACTERISTIC KINP_IVIDSEATSlideCmd_enum_ovrdval "" VALUE 0x0000 /* @ECU_Address@KINP_IVIDSEATSlideCmd_enum_ovrdval@ */ Scalar_UBYTE 0 SWC_INP_type_CM_uint8_enum 0.0 3.0 /end CHARACTERISTIC
/begin CHARACTERISTIC KINP_IVIDelAccReqSta_enum_defval "" VALUE 0x0000 /* @ECU_Address@KINP_IVIDelAccReqSta_enum_defval@ */ Scalar_UBYTE 0 SWC_INP_type_CM_uint8_enum 0.0 7.0 /end CHARACTERISTIC
/begin CHARACTERISTIC KINP_IVIDelAccReqSta_enum_ovrdval "" VALUE 0x0000 /* @ECU_Address@KINP_IVIDelAccReqSta_enum_ovrdval@ */ Scalar_UBYTE 0 SWC_INP_type_CM_uint8_enum 0.0 7.0 /end CHARACTERISTIC
/begin CHARACTERISTIC KINP_IVIEPSForceCmd_enum_defval "" VALUE 0x0000 /* @ECU_Address@KINP_IVIEPSForceCmd_enum_defval@ */ Scalar_UBYTE 0 SWC_INP_type_CM_uint8_enum 0.0 3.0 /end CHARACTERISTIC
/begin CHARACTERISTIC KINP_IVIEPSForceCmd_enum_ovrdval "" VALUE 0x0000 /* @ECU_Address@KINP_IVIEPSForceCmd_enum_ovrdval@ */ Scalar_UBYTE 0 SWC_INP_type_CM_uint8_enum 0.0 3.0 /end CHARACTERISTIC
/begin CHARACTERISTIC KINP_IVIFGSAirIntCmd_enum_defval "" VALUE 0x0000 /* @ECU_Address@KINP_IVIFGSAirIntCmd_enum_defval@ */ Scalar_UBYTE 0 SWC_INP_type_CM_uint8_enum 0.0 7.0 /end CHARACTERISTIC
/begin CHARACTERISTIC KINP_IVIFGSAirIntCmd_enum_ovrdval "" VALUE 0x0000 /* @ECU_Address@KINP_IVIFGSAirIntCmd_enum_ovrdval@ */ Scalar_UBYTE 0 SWC_INP_type_CM_uint8_enum 0.0 7.0 /end CHARACTERISTIC
/begin CHARACTERISTIC KINP_IVIFGSChCmd_enum_defval "" VALUE 0x0000 /* @ECU_Address@KINP_IVIFGSChCmd_enum_defval@ */ Scalar_UBYTE 0 SWC_INP_type_CM_uint8_enum 0.0 3.0 /end CHARACTERISTIC
/begin CHARACTERISTIC KINP_IVIFGSChCmd_enum_ovrdval "" VALUE 0x0000 /* @ECU_Address@KINP_IVIFGSChCmd_enum_ovrdval@ */ Scalar_UBYTE 0 SWC_INP_type_CM_uint8_enum 0.0 3.0 /end CHARACTERISTIC
/begin CHARACTERISTIC KINP_IVIHMICustmiFunSta_enum_defval "" VALUE 0x0000 /* @ECU_Address@KINP_IVIHMICustmiFunSta_enum_defval@ */ Scalar_UBYTE 0 SWC_INP_type_CM_uint8_enum 0.0 15.0 /end CHARACTERISTIC
/begin CHARACTERISTIC KINP_IVIHMICustmiFunSta_enum_ovrdval "" VALUE 0x0000 /* @ECU_Address@KINP_IVIHMICustmiFunSta_enum_ovrdval@ */ Scalar_UBYTE 0 SWC_INP_type_CM_uint8_enum 0.0 15.0 /end CHARACTERISTIC
/begin CHARACTERISTIC KINP_IVIHMICustmiKEYSta_enum_defval "" VALUE 0x0000 /* @ECU_Address@KINP_IVIHMICustmiKEYSta_enum_defval@ */ Scalar_UBYTE 0 SWC_INP_type_CM_uint8_enum 0.0 15.0 /end CHARACTERISTIC
/begin CHARACTERISTIC KINP_IVIHMICustmiKEYSta_enum_ovrdval "" VALUE 0x0000 /* @ECU_Address@KINP_IVIHMICustmiKEYSta_enum_ovrdval@ */ Scalar_UBYTE 0 SWC_INP_type_CM_uint8_enum 0.0 15.0 /end CHARACTERISTIC
/begin CHARACTERISTIC KINP_IVIISAOffsetSpd_enum_defval "" VALUE 0x0000 /* @ECU_Address@KINP_IVIISAOffsetSpd_enum_defval@ */ Scalar_UBYTE 0 SWC_INP_type_CM_uint8_enum 0.0 14.0 /end CHARACTERISTIC
/begin CHARACTERISTIC KINP_IVIISAOffsetSpd_enum_ovrdval "" VALUE 0x0000 /* @ECU_Address@KINP_IVIISAOffsetSpd_enum_ovrdval@ */ Scalar_UBYTE 0 SWC_INP_type_CM_uint8_enum 0.0 14.0 /end CHARACTERISTIC
/begin CHARACTERISTIC KINP_IVILBlowerModeSta_enum_defval "" VALUE 0x0000 /* @ECU_Address@KINP_IVILBlowerModeSta_enum_defval@ */ Scalar_UBYTE 0 SWC_INP_type_CM_uint8_enum 0.0 3.0 /end CHARACTERISTIC
/begin CHARACTERISTIC KINP_IVILBlowerModeSta_enum_ovrdval "" VALUE 0x0000 /* @ECU_Address@KINP_IVILBlowerModeSta_enum_ovrdval@ */ Scalar_UBYTE 0 SWC_INP_type_CM_uint8_enum 0.0 3.0 /end CHARACTERISTIC
/begin CHARACTERISTIC KINP_IVILSEATventCmd_enum_defval "" VALUE 0x0000 /* @ECU_Address@KINP_IVILSEATventCmd_enum_defval@ */ Scalar_UBYTE 0 SWC_INP_type_CM_uint8_enum 0.0 7.0 /end CHARACTERISTIC
/begin CHARACTERISTIC KINP_IVILSEATventCmd_enum_ovrdval "" VALUE 0x0000 /* @ECU_Address@KINP_IVILSEATventCmd_enum_ovrdval@ */ Scalar_UBYTE 0 SWC_INP_type_CM_uint8_enum 0.0 7.0 /end CHARACTERISTIC
/begin CHARACTERISTIC KINP_IVILinkAccSta_enum_defval "" VALUE 0x0000 /* @ECU_Address@KINP_IVILinkAccSta_enum_defval@ */ Scalar_UBYTE 0 SWC_INP_type_CM_uint8_enum 0.0 7.0 /end CHARACTERISTIC
/begin CHARACTERISTIC KINP_IVILinkAccSta_enum_ovrdval "" VALUE 0x0000 /* @ECU_Address@KINP_IVILinkAccSta_enum_ovrdval@ */ Scalar_UBYTE 0 SWC_INP_type_CM_uint8_enum 0.0 7.0 /end CHARACTERISTIC
/begin CHARACTERISTIC KINP_IVILinkKeySta_enum_defval "" VALUE 0x0000 /* @ECU_Address@KINP_IVILinkKeySta_enum_defval@ */ Scalar_UBYTE 0 SWC_INP_type_CM_uint8_enum 0.0 15.0 /end CHARACTERISTIC
/begin CHARACTERISTIC KINP_IVILinkKeySta_enum_ovrdval "" VALUE 0x0000 /* @ECU_Address@KINP_IVILinkKeySta_enum_ovrdval@ */ Scalar_UBYTE 0 SWC_INP_type_CM_uint8_enum 0.0 15.0 /end CHARACTERISTIC
/begin CHARACTERISTIC KINP_IVILocatedSTA_enum_defval "" VALUE 0x0000 /* @ECU_Address@KINP_IVILocatedSTA_enum_defval@ */ Scalar_UBYTE 0 SWC_INP_type_CM_uint8_enum 0.0 3.0 /end CHARACTERISTIC
/begin CHARACTERISTIC KINP_IVILocatedSTA_enum_ovrdval "" VALUE 0x0000 /* @ECU_Address@KINP_IVILocatedSTA_enum_ovrdval@ */ Scalar_UBYTE 0 SWC_INP_type_CM_uint8_enum 0.0 3.0 /end CHARACTERISTIC
/begin CHARACTERISTIC KINP_IVIMLFootLiftCmd_enum_defval "" VALUE 0x0000 /* @ECU_Address@KINP_IVIMLFootLiftCmd_enum_defval@ */ Scalar_UBYTE 0 SWC_INP_type_CM_uint8_enum 0.0 3.0 /end CHARACTERISTIC
/begin CHARACTERISTIC KINP_IVIMLFootLiftCmd_enum_ovrdval "" VALUE 0x0000 /* @ECU_Address@KINP_IVIMLFootLiftCmd_enum_ovrdval@ */ Scalar_UBYTE 0 SWC_INP_type_CM_uint8_enum 0.0 3.0 /end CHARACTERISTIC
/begin CHARACTERISTIC KINP_IVIMLReclinerCmd_enum_defval "" VALUE 0x0000 /* @ECU_Address@KINP_IVIMLReclinerCmd_enum_defval@ */ Scalar_UBYTE 0 SWC_INP_type_CM_uint8_enum 0.0 3.0 /end CHARACTERISTIC
/begin CHARACTERISTIC KINP_IVIMLReclinerCmd_enum_ovrdval "" VALUE 0x0000 /* @ECU_Address@KINP_IVIMLReclinerCmd_enum_ovrdval@ */ Scalar_UBYTE 0 SWC_INP_type_CM_uint8_enum 0.0 3.0 /end CHARACTERISTIC
/begin CHARACTERISTIC KINP_IVIMLSEATventCmd_enum_defval "" VALUE 0x0000 /* @ECU_Address@KINP_IVIMLSEATventCmd_enum_defval@ */ Scalar_UBYTE 0 SWC_INP_type_CM_uint8_enum 0.0 7.0 /end CHARACTERISTIC
/begin CHARACTERISTIC KINP_IVIMLSEATventCmd_enum_ovrdval "" VALUE 0x0000 /* @ECU_Address@KINP_IVIMLSEATventCmd_enum_ovrdval@ */ Scalar_UBYTE 0 SWC_INP_type_CM_uint8_enum 0.0 7.0 /end CHARACTERISTIC
/begin CHARACTERISTIC KINP_IVIMLSeatLiftCmd_enum_defval "" VALUE 0x0000 /* @ECU_Address@KINP_IVIMLSeatLiftCmd_enum_defval@ */ Scalar_UBYTE 0 SWC_INP_type_CM_uint8_enum 0.0 3.0 /end CHARACTERISTIC
/begin CHARACTERISTIC KINP_IVIMLSeatLiftCmd_enum_ovrdval "" VALUE 0x0000 /* @ECU_Address@KINP_IVIMLSeatLiftCmd_enum_ovrdval@ */ Scalar_UBYTE 0 SWC_INP_type_CM_uint8_enum 0.0 3.0 /end CHARACTERISTIC
/begin CHARACTERISTIC KINP_IVIMLSliderCmd_enum_defval "" VALUE 0x0000 /* @ECU_Address@KINP_IVIMLSliderCmd_enum_defval@ */ Scalar_UBYTE 0 SWC_INP_type_CM_uint8_enum 0.0 3.0 /end CHARACTERISTIC
/begin CHARACTERISTIC KINP_IVIMLSliderCmd_enum_ovrdval "" VALUE 0x0000 /* @ECU_Address@KINP_IVIMLSliderCmd_enum_ovrdval@ */ Scalar_UBYTE 0 SWC_INP_type_CM_uint8_enum 0.0 3.0 /end CHARACTERISTIC
/begin CHARACTERISTIC KINP_IVIMRFootLiftCmd_enum_defval "" VALUE 0x0000 /* @ECU_Address@KINP_IVIMRFootLiftCmd_enum_defval@ */ Scalar_UBYTE 0 SWC_INP_type_CM_uint8_enum 0.0 3.0 /end CHARACTERISTIC
/begin CHARACTERISTIC KINP_IVIMRFootLiftCmd_enum_ovrdval "" VALUE 0x0000 /* @ECU_Address@KINP_IVIMRFootLiftCmd_enum_ovrdval@ */ Scalar_UBYTE 0 SWC_INP_type_CM_uint8_enum 0.0 3.0 /end CHARACTERISTIC
/begin CHARACTERISTIC KINP_IVIMRReclinerCmd_enum_defval "" VALUE 0x0000 /* @ECU_Address@KINP_IVIMRReclinerCmd_enum_defval@ */ Scalar_UBYTE 0 SWC_INP_type_CM_uint8_enum 0.0 3.0 /end CHARACTERISTIC
/begin CHARACTERISTIC KINP_IVIMRReclinerCmd_enum_ovrdval "" VALUE 0x0000 /* @ECU_Address@KINP_IVIMRReclinerCmd_enum_ovrdval@ */ Scalar_UBYTE 0 SWC_INP_type_CM_uint8_enum 0.0 3.0 /end CHARACTERISTIC
/begin CHARACTERISTIC KINP_IVIMRSEATventCmd_enum_defval "" VALUE 0x0000 /* @ECU_Address@KINP_IVIMRSEATventCmd_enum_defval@ */ Scalar_UBYTE 0 SWC_INP_type_CM_uint8_enum 0.0 7.0 /end CHARACTERISTIC
/begin CHARACTERISTIC KINP_IVIMRSEATventCmd_enum_ovrdval "" VALUE 0x0000 /* @ECU_Address@KINP_IVIMRSEATventCmd_enum_ovrdval@ */ Scalar_UBYTE 0 SWC_INP_type_CM_uint8_enum 0.0 7.0 /end CHARACTERISTIC
/begin CHARACTERISTIC KINP_IVIMRSeatLiftCmd_enum_defval "" VALUE 0x0000 /* @ECU_Address@KINP_IVIMRSeatLiftCmd_enum_defval@ */ Scalar_UBYTE 0 SWC_INP_type_CM_uint8_enum 0.0 3.0 /end CHARACTERISTIC
/begin CHARACTERISTIC KINP_IVIMRSeatLiftCmd_enum_ovrdval "" VALUE 0x0000 /* @ECU_Address@KINP_IVIMRSeatLiftCmd_enum_ovrdval@ */ Scalar_UBYTE 0 SWC_INP_type_CM_uint8_enum 0.0 3.0 /end CHARACTERISTIC
/begin CHARACTERISTIC KINP_IVIMRSliderCmd_enum_defval "" VALUE 0x0000 /* @ECU_Address@KINP_IVIMRSliderCmd_enum_defval@ */ Scalar_UBYTE 0 SWC_INP_type_CM_uint8_enum 0.0 3.0 /end CHARACTERISTIC
/begin CHARACTERISTIC KINP_IVIMRSliderCmd_enum_ovrdval "" VALUE 0x0000 /* @ECU_Address@KINP_IVIMRSliderCmd_enum_ovrdval@ */ Scalar_UBYTE 0 SWC_INP_type_CM_uint8_enum 0.0 3.0 /end CHARACTERISTIC
/begin CHARACTERISTIC KINP_IVIPSEATHeaterCmd_enum_defval "" VALUE 0x0000 /* @ECU_Address@KINP_IVIPSEATHeaterCmd_enum_defval@ */ Scalar_UBYTE 0 SWC_INP_type_CM_uint8_enum 0.0 7.0 /end CHARACTERISTIC
/begin CHARACTERISTIC KINP_IVIPSEATHeaterCmd_enum_ovrdval "" VALUE 0x0000 /* @ECU_Address@KINP_IVIPSEATHeaterCmd_enum_ovrdval@ */ Scalar_UBYTE 0 SWC_INP_type_CM_uint8_enum 0.0 7.0 /end CHARACTERISTIC
/begin CHARACTERISTIC KINP_IVIPSEATReclineCmd_enum_defval "" VALUE 0x0000 /* @ECU_Address@KINP_IVIPSEATReclineCmd_enum_defval@ */ Scalar_UBYTE 0 SWC_INP_type_CM_uint8_enum 0.0 3.0 /end CHARACTERISTIC
/begin CHARACTERISTIC KINP_IVIPSEATReclineCmd_enum_ovrdval "" VALUE 0x0000 /* @ECU_Address@KINP_IVIPSEATReclineCmd_enum_ovrdval@ */ Scalar_UBYTE 0 SWC_INP_type_CM_uint8_enum 0.0 3.0 /end CHARACTERISTIC
/begin CHARACTERISTIC KINP_IVIPSEATSlideCmd_enum_defval "" VALUE 0x0000 /* @ECU_Address@KINP_IVIPSEATSlideCmd_enum_defval@ */ Scalar_UBYTE 0 SWC_INP_type_CM_uint8_enum 0.0 3.0 /end CHARACTERISTIC
/begin CHARACTERISTIC KINP_IVIPSEATSlideCmd_enum_ovrdval "" VALUE 0x0000 /* @ECU_Address@KINP_IVIPSEATSlideCmd_enum_ovrdval@ */ Scalar_UBYTE 0 SWC_INP_type_CM_uint8_enum 0.0 3.0 /end CHARACTERISTIC
/begin CHARACTERISTIC KINP_IVIPTGModeSW_enum_defval "" VALUE 0x0000 /* @ECU_Address@KINP_IVIPTGModeSW_enum_defval@ */ Scalar_UBYTE 0 SWC_INP_type_CM_uint8_enum 0.0 3.0 /end CHARACTERISTIC
/begin CHARACTERISTIC KINP_IVIPTGModeSW_enum_ovrdval "" VALUE 0x0000 /* @ECU_Address@KINP_IVIPTGModeSW_enum_ovrdval@ */ Scalar_UBYTE 0 SWC_INP_type_CM_uint8_enum 0.0 3.0 /end CHARACTERISTIC
/begin CHARACTERISTIC KINP_IVIPTGOpenHeight_enum_defval "" VALUE 0x0000 /* @ECU_Address@KINP_IVIPTGOpenHeight_enum_defval@ */ Scalar_UBYTE 0 SWC_INP_type_CM_uint8_enum 0.0 7.0 /end CHARACTERISTIC
/begin CHARACTERISTIC KINP_IVIPTGOpenHeight_enum_ovrdval "" VALUE 0x0000 /* @ECU_Address@KINP_IVIPTGOpenHeight_enum_ovrdval@ */ Scalar_UBYTE 0 SWC_INP_type_CM_uint8_enum 0.0 7.0 /end CHARACTERISTIC
/begin CHARACTERISTIC KINP_IVIPTGStaSW_enum_defval "" VALUE 0x0000 /* @ECU_Address@KINP_IVIPTGStaSW_enum_defval@ */ Scalar_UBYTE 0 SWC_INP_type_CM_uint8_enum 0.0 3.0 /end CHARACTERISTIC
/begin CHARACTERISTIC KINP_IVIPTGStaSW_enum_ovrdval "" VALUE 0x0000 /* @ECU_Address@KINP_IVIPTGStaSW_enum_ovrdval@ */ Scalar_UBYTE 0 SWC_INP_type_CM_uint8_enum 0.0 3.0 /end CHARACTERISTIC
/begin CHARACTERISTIC KINP_IVIPWModeReq_enum_defval "" VALUE 0x0000 /* @ECU_Address@KINP_IVIPWModeReq_enum_defval@ */ Scalar_UBYTE 0 SWC_INP_type_CM_uint8_enum 0.0 3.0 /end CHARACTERISTIC
/begin CHARACTERISTIC KINP_IVIPWModeReq_enum_ovrdval "" VALUE 0x0000 /* @ECU_Address@KINP_IVIPWModeReq_enum_ovrdval@ */ Scalar_UBYTE 0 SWC_INP_type_CM_uint8_enum 0.0 3.0 /end CHARACTERISTIC
/begin CHARACTERISTIC KINP_IVIPwrLockSW_enum_defval "" VALUE 0x0000 /* @ECU_Address@KINP_IVIPwrLockSW_enum_defval@ */ Scalar_UBYTE 0 SWC_INP_type_CM_uint8_enum 0.0 3.0 /end CHARACTERISTIC
/begin CHARACTERISTIC KINP_IVIPwrLockSW_enum_ovrdval "" VALUE 0x0000 /* @ECU_Address@KINP_IVIPwrLockSW_enum_ovrdval@ */ Scalar_UBYTE 0 SWC_INP_type_CM_uint8_enum 0.0 3.0 /end CHARACTERISTIC
/begin CHARACTERISTIC KINP_IVIRBlowerModeSta_enum_defval "" VALUE 0x0000 /* @ECU_Address@KINP_IVIRBlowerModeSta_enum_defval@ */ Scalar_UBYTE 0 SWC_INP_type_CM_uint8_enum 0.0 3.0 /end CHARACTERISTIC
/begin CHARACTERISTIC KINP_IVIRBlowerModeSta_enum_ovrdval "" VALUE 0x0000 /* @ECU_Address@KINP_IVIRBlowerModeSta_enum_ovrdval@ */ Scalar_UBYTE 0 SWC_INP_type_CM_uint8_enum 0.0 3.0 /end CHARACTERISTIC
/begin CHARACTERISTIC KINP_IVIReqV2L_enum_defval "" VALUE 0x0000 /* @ECU_Address@KINP_IVIReqV2L_enum_defval@ */ Scalar_UBYTE 0 SWC_INP_type_CM_uint8_enum 0.0 2.0 /end CHARACTERISTIC
/begin CHARACTERISTIC KINP_IVIReqV2L_enum_ovrdval "" VALUE 0x0000 /* @ECU_Address@KINP_IVIReqV2L_enum_ovrdval@ */ Scalar_UBYTE 0 SWC_INP_type_CM_uint8_enum 0.0 2.0 /end CHARACTERISTIC
/begin CHARACTERISTIC KINP_IVISWCRUndefinedSta_enum_defval "" VALUE 0x0000 /* @ECU_Address@KINP_IVISWCRUndefinedSta_enum_defval@ */ Scalar_UBYTE 0 SWC_INP_type_CM_uint8_enum 0.0 15.0 /end CHARACTERISTIC
/begin CHARACTERISTIC KINP_IVISWCRUndefinedSta_enum_ovrdval "" VALUE 0x0000 /* @ECU_Address@KINP_IVISWCRUndefinedSta_enum_ovrdval@ */ Scalar_UBYTE 0 SWC_INP_type_CM_uint8_enum 0.0 15.0 /end CHARACTERISTIC
/begin CHARACTERISTIC KINP_IVISWCVibModeSta_enum_defval "" VALUE 0x0000 /* @ECU_Address@KINP_IVISWCVibModeSta_enum_defval@ */ Scalar_UBYTE 0 SWC_INP_type_CM_uint8_enum 0.0 3.0 /end CHARACTERISTIC
/begin CHARACTERISTIC KINP_IVISWCVibModeSta_enum_ovrdval "" VALUE 0x0000 /* @ECU_Address@KINP_IVISWCVibModeSta_enum_ovrdval@ */ Scalar_UBYTE 0 SWC_INP_type_CM_uint8_enum 0.0 3.0 /end CHARACTERISTIC
/begin CHARACTERISTIC KINP_IVIScreen_enum_defval "" VALUE 0x0000 /* @ECU_Address@KINP_IVIScreen_enum_defval@ */ Scalar_UBYTE 0 SWC_INP_type_CM_uint8_enum 0.0 62.0 /end CHARACTERISTIC
/begin CHARACTERISTIC KINP_IVIScreen_enum_ovrdval "" VALUE 0x0000 /* @ECU_Address@KINP_IVIScreen_enum_ovrdval@ */ Scalar_UBYTE 0 SWC_INP_type_CM_uint8_enum 0.0 62.0 /end CHARACTERISTIC
/begin CHARACTERISTIC KINP_IVITimeCheck_enum_defval "" VALUE 0x0000 /* @ECU_Address@KINP_IVITimeCheck_enum_defval@ */ Scalar_UBYTE 0 SWC_INP_type_CM_uint8_enum 0.0 255.0 /end CHARACTERISTIC
/begin CHARACTERISTIC KINP_IVITimeCheck_enum_ovrdval "" VALUE 0x0000 /* @ECU_Address@KINP_IVITimeCheck_enum_ovrdval@ */ Scalar_UBYTE 0 SWC_INP_type_CM_uint8_enum 0.0 255.0 /end CHARACTERISTIC
/begin CHARACTERISTIC KINP_OFFACMODE_enum_defval "" VALUE 0x0000 /* @ECU_Address@KINP_OFFACMODE_enum_defval@ */ Scalar_UBYTE 0 SWC_INP_type_CM_uint8_enum 0.0 7.0 /end CHARACTERISTIC
/begin CHARACTERISTIC KINP_OFFACMODE_enum_ovrdval "" VALUE 0x0000 /* @ECU_Address@KINP_OFFACMODE_enum_ovrdval@ */ Scalar_UBYTE 0 SWC_INP_type_CM_uint8_enum 0.0 7.0 /end CHARACTERISTIC
/begin CHARACTERISTIC KINP_PSEATventreq_enum_defval "" VALUE 0x0000 /* @ECU_Address@KINP_PSEATventreq_enum_defval@ */ Scalar_UBYTE 0 SWC_INP_type_CM_uint8_enum 0.0 7.0 /end CHARACTERISTIC
/begin CHARACTERISTIC KINP_PSEATventreq_enum_ovrdval "" VALUE 0x0000 /* @ECU_Address@KINP_PSEATventreq_enum_ovrdval@ */ Scalar_UBYTE 0 SWC_INP_type_CM_uint8_enum 0.0 7.0 /end CHARACTERISTIC
/begin CHARACTERISTIC KINP_PerdV2L_enum_defval "" VALUE 0x0000 /* @ECU_Address@KINP_PerdV2L_enum_defval@ */ Scalar_UBYTE 0 SWC_INP_type_CM_uint8_enum 0.0 15.0 /end CHARACTERISTIC
/begin CHARACTERISTIC KINP_PerdV2L_enum_ovrdval "" VALUE 0x0000 /* @ECU_Address@KINP_PerdV2L_enum_ovrdval@ */ Scalar_UBYTE 0 SWC_INP_type_CM_uint8_enum 0.0 15.0 /end CHARACTERISTIC
/begin CHARACTERISTIC KINP_RDCActive_enum_defval "" VALUE 0x0000 /* @ECU_Address@KINP_RDCActive_enum_defval@ */ Scalar_UBYTE 0 SWC_INP_type_CM_uint8_enum 0.0 2.0 /end CHARACTERISTIC
/begin CHARACTERISTIC KINP_RDCActive_enum_ovrdval "" VALUE 0x0000 /* @ECU_Address@KINP_RDCActive_enum_ovrdval@ */ Scalar_UBYTE 0 SWC_INP_type_CM_uint8_enum 0.0 2.0 /end CHARACTERISTIC
/begin CHARACTERISTIC KINP_RollModeSWCmd_enum_defval "" VALUE 0x0000 /* @ECU_Address@KINP_RollModeSWCmd_enum_defval@ */ Scalar_UBYTE 0 SWC_INP_type_CM_uint8_enum 0.0 3.0 /end CHARACTERISTIC
/begin CHARACTERISTIC KINP_RollModeSWCmd_enum_ovrdval "" VALUE 0x0000 /* @ECU_Address@KINP_RollModeSWCmd_enum_ovrdval@ */ Scalar_UBYTE 0 SWC_INP_type_CM_uint8_enum 0.0 3.0 /end CHARACTERISTIC
/begin CHARACTERISTIC KINP_SenstivityPosition_enum_defval "" VALUE 0x0000 /* @ECU_Address@KINP_SenstivityPosition_enum_defval@ */ Scalar_UBYTE 0 SWC_INP_type_CM_uint8_enum 0.0 15.0 /end CHARACTERISTIC
/begin CHARACTERISTIC KINP_SenstivityPosition_enum_ovrdval "" VALUE 0x0000 /* @ECU_Address@KINP_SenstivityPosition_enum_ovrdval@ */ Scalar_UBYTE 0 SWC_INP_type_CM_uint8_enum 0.0 15.0 /end CHARACTERISTIC
/begin CHARACTERISTIC KINP_TCSSWCmd_enum_defval "" VALUE 0x0000 /* @ECU_Address@KINP_TCSSWCmd_enum_defval@ */ Scalar_UBYTE 0 SWC_INP_type_CM_uint8_enum 0.0 3.0 /end CHARACTERISTIC
/begin CHARACTERISTIC KINP_TCSSWCmd_enum_ovrdval "" VALUE 0x0000 /* @ECU_Address@KINP_TCSSWCmd_enum_ovrdval@ */ Scalar_UBYTE 0 SWC_INP_type_CM_uint8_enum 0.0 3.0 /end CHARACTERISTIC
/begin CHARACTERISTIC KINP_TurnSwTimeSet_enum_defval "" VALUE 0x0000 /* @ECU_Address@KINP_TurnSwTimeSet_enum_defval@ */ Scalar_UBYTE 0 SWC_INP_type_CM_uint8_enum 0.0 3.0 /end CHARACTERISTIC
/begin CHARACTERISTIC KINP_TurnSwTimeSet_enum_ovrdval "" VALUE 0x0000 /* @ECU_Address@KINP_TurnSwTimeSet_enum_ovrdval@ */ Scalar_UBYTE 0 SWC_INP_type_CM_uint8_enum 0.0 3.0 /end CHARACTERISTIC
/begin CHARACTERISTIC KINP_UserSet_enum_defval "" VALUE 0x0000 /* @ECU_Address@KINP_UserSet_enum_defval@ */ Scalar_UBYTE 0 SWC_INP_type_CM_uint8_enum 0.0 7.0 /end CHARACTERISTIC
/begin CHARACTERISTIC KINP_UserSet_enum_ovrdval "" VALUE 0x0000 /* @ECU_Address@KINP_UserSet_enum_ovrdval@ */ Scalar_UBYTE 0 SWC_INP_type_CM_uint8_enum 0.0 7.0 /end CHARACTERISTIC
/begin CHARACTERISTIC KINP_WlcmLightMode_enum_defval "" VALUE 0x0000 /* @ECU_Address@KINP_WlcmLightMode_enum_defval@ */ Scalar_UBYTE 0 SWC_INP_type_CM_uint8_enum 0.0 3.0 /end CHARACTERISTIC
/begin CHARACTERISTIC KINP_WlcmLightMode_enum_ovrdval "" VALUE 0x0000 /* @ECU_Address@KINP_WlcmLightMode_enum_ovrdval@ */ Scalar_UBYTE 0 SWC_INP_type_CM_uint8_enum 0.0 3.0 /end CHARACTERISTIC
/begin CHARACTERISTIC KINP_sigAirIntenZon1Req_enum_defval "" VALUE 0x0000 /* @ECU_Address@KINP_sigAirIntenZon1Req_enum_defval@ */ Scalar_UBYTE 0 SWC_INP_type_CM_uint8_enum 0.0 15.0 /end CHARACTERISTIC
/begin CHARACTERISTIC KINP_sigAirIntenZon1Req_enum_ovrdval "" VALUE 0x0000 /* @ECU_Address@KINP_sigAirIntenZon1Req_enum_ovrdval@ */ Scalar_UBYTE 0 SWC_INP_type_CM_uint8_enum 0.0 15.0 /end CHARACTERISTIC
/begin COMPU_METHOD SWC_INP_type_CM_single_A "Q = V" RAT_FUNC "%8.6" "A" COEFFS 0 1 0 0 0 1 /end COMPU_METHOD
/begin COMPU_METHOD SWC_INP_type_CM_single_pct "Q = V" RAT_FUNC "%8.6" "pct" COEFFS 0 1 0 0 0 1 /end COMPU_METHOD
/begin COMPU_METHOD SWC_INP_type_CM_single_Nm "Q = V" RAT_FUNC "%8.6" "Nm" COEFFS 0 1 0 0 0 1 /end COMPU_METHOD
/begin COMPU_METHOD SWC_INP_type_CM_single_kph "Q = V" RAT_FUNC "%8.6" "kph" COEFFS 0 1 0 0 0 1 /end COMPU_METHOD
/begin COMPU_METHOD SWC_INP_type_CM_single_C "Q = V" RAT_FUNC "%8.6" "C" COEFFS 0 1 0 0 0 1 /end COMPU_METHOD
/begin COMPU_METHOD SWC_INP_type_CM_single_s "Q = V" RAT_FUNC "%8.6" "s" COEFFS 0 1 0 0 0 1 /end COMPU_METHOD
/begin COMPU_METHOD SWC_INP_type_CM_single_DAY "Q = V" RAT_FUNC "%8.6" "DAY" COEFFS 0 1 0 0 0 1 /end COMPU_METHOD
/begin COMPU_METHOD SWC_INP_type_CM_single_hr "Q = V" RAT_FUNC "%8.6" "hr" COEFFS 0 1 0 0 0 1 /end COMPU_METHOD
/begin COMPU_METHOD SWC_INP_type_CM_single_min "Q = V" RAT_FUNC "%8.6" "min" COEFFS 0 1 0 0 0 1 /end COMPU_METHOD
/begin COMPU_METHOD SWC_INP_type_CM_single_MONTH "Q = V" RAT_FUNC "%8.6" "MONTH" COEFFS 0 1 0 0 0 1 /end COMPU_METHOD
/begin COMPU_METHOD SWC_INP_type_CM_single_YEAR "Q = V" RAT_FUNC "%8.6" "YEAR" COEFFS 0 1 0 0 0 1 /end COMPU_METHOD
/begin COMPU_METHOD SWC_INP_type_CM_single_Gps "Q = V" RAT_FUNC "%8.6" "Gps" COEFFS 0 1 0 0 0 1 /end COMPU_METHOD
/begin COMPU_METHOD SWC_INP_type_CM_single_bar "Q = V" RAT_FUNC "%8.6" "bar" COEFFS 0 1 0 0 0 1 /end COMPU_METHOD
/begin COMPU_METHOD SWC_INP_type_CM_single_degps "Q = V" RAT_FUNC "%8.6" "degps" COEFFS 0 1 0 0 0 1 /end COMPU_METHOD
/begin COMPU_METHOD SWC_INP_type_CM_uint32_enum "Q = V" RAT_FUNC "%10.0" "enum" COEFFS 0 1 0 0 0 1 /end COMPU_METHOD
/begin COMPU_METHOD SWC_INP_type_CM_boolean_flg "Q = V" RAT_FUNC "%1.0" "flg" COEFFS 0 1 0 0 0 1 /end COMPU_METHOD
/begin COMPU_METHOD SWC_INP_type_CM_uint8_enum "Q = V" RAT_FUNC "%3.0" "enum" COEFFS 0 1 0 0 0 1 /end COMPU_METHOD
/begin GROUP S106_TCSActive "SWC_INP_type/run_SWC_INP_5ms_sys/INP/CAN1/SignalCheck/ESC1/TCSActive"
 /begin REF_CHARACTERISTIC KINP_TCSActive_flg_defval KINP_TCSActive_flg_ovrdflg KINP_TCSActive_flg_ovrdval /end REF_CHARACTERISTIC
/end GROUP
/begin GROUP S106_TCSFailed "SWC_INP_type/run_SWC_INP_5ms_sys/INP/CAN1/SignalCheck/ESC1/TCSFailed"
 /begin REF_CHARACTERISTIC KINP_TCSFailed_flg_defval KINP_TCSFailed_flg_ovrdflg KINP_TCSFailed_flg_ovrdval /end REF_CHARACTERISTIC
/end GROUP
/begin GROUP S106_VehSpeed "SWC_INP_type/run_SWC_INP_5ms_sys/INP/CAN1/SignalCheck/ESC1/VehSpeed"
 /begin REF_CHARACTERISTIC KINP_VehSpeed_kph_defval KINP_VehSpeed_kph_ovrdflg KINP_VehSpeed_kph_ovrdval /end REF_CHARACTERISTIC
/end GROUP
/begin GROUP S107_ACCAvail "SWC_INP_type/run_SWC_INP_5ms_sys/INP/CAN1/SignalCheck/ESC5/ACCAvail"
 /begin REF_CHARACTERISTIC KINP_ACCAvail_flg_defval KINP_ACCAvail_flg_ovrdflg KINP_ACCAvail_flg_ovrdval /end REF_CHARACTERISTIC
/end GROUP
/begin GROUP S107_AEBAvail "SWC_INP_type/run_SWC_INP_5ms_sys/INP/CAN1/SignalCheck/ESC5/AEBAvail"
 /begin REF_CHARACTERISTIC KINP_AEBAvail_flg_defval KINP_AEBAvail_flg_ovrdflg KINP_AEBAvail_flg_ovrdval /end REF_CHARACTERISTIC
/end GROUP
/begin GROUP S107_ActBrkLampSta "SWC_INP_type/run_SWC_INP_5ms_sys/INP/CAN1/SignalCheck/ESC5/ActBrkLampSta"
 /begin REF_CHARACTERISTIC KINP_ActBrkLampSta_flg_defval KINP_ActBrkLampSta_flg_ovrdflg KINP_ActBrkLampSta_flg_ovrdval /end REF_CHARACTERISTIC
/end GROUP
/begin GROUP S107_BrkDiscTempSta "SWC_INP_type/run_SWC_INP_5ms_sys/INP/CAN1/SignalCheck/ESC5/BrkDiscTempSta"
 /begin REF_CHARACTERISTIC KINP_BrkDiscTempSta_flg_defval KINP_BrkDiscTempSta_flg_ovrdflg KINP_BrkDiscTempSta_flg_ovrdval /end REF_CHARACTERISTIC
/end GROUP
/begin GROUP S107_BrkPedalPos "SWC_INP_type/run_SWC_INP_5ms_sys/INP/CAN1/SignalCheck/ESC5/BrkPedalPos"
 /begin REF_CHARACTERISTIC KINP_BrkPedalPos_pct_defval KINP_BrkPedalPos_pct_ovrdflg KINP_BrkPedalPos_pct_ovrdval /end REF_CHARACTERISTIC
/end GROUP
/begin GROUP S107_BrkPedalPosSta "SWC_INP_type/run_SWC_INP_5ms_sys/INP/CAN1/SignalCheck/ESC5/BrkPedalPosSta"
 /begin REF_CHARACTERISTIC KINP_BrkPedalPosSta_flg_defval KINP_BrkPedalPosSta_flg_ovrdflg KINP_BrkPedalPosSta_flg_ovrdval /end REF_CHARACTERISTIC
/end GROUP
/begin GROUP S107_BrkSwSta "SWC_INP_type/run_SWC_INP_5ms_sys/INP/CAN1/SignalCheck/ESC5/BrkSwSta"
 /begin REF_CHARACTERISTIC KINP_BrkSwSta_flg_defval KINP_BrkSwSta_flg_ovrdflg KINP_BrkSwSta_flg_ovrdval /end REF_CHARACTERISTIC
/end GROUP
/begin GROUP S107_BrkSwV "SWC_INP_type/run_SWC_INP_5ms_sys/INP/CAN1/SignalCheck/ESC5/BrkSwV"
 /begin REF_CHARACTERISTIC KINP_BrkSwV_flg_defval KINP_BrkSwV_flg_ovrdflg KINP_BrkSwV_flg_ovrdval /end REF_CHARACTERISTIC
/end GROUP
/begin GROUP S107_ESC5CS "SWC_INP_type/run_SWC_INP_5ms_sys/INP/CAN1/SignalCheck/ESC5/ESC5CS"
 /begin REF_CHARACTERISTIC KINP_ESC5CS_enum_defval KINP_ESC5CS_enum_ovrdflg KINP_ESC5CS_enum_ovrdval /end REF_CHARACTERISTIC
/end GROUP
/begin GROUP S107_ESC5CSErr "SWC_INP_type/run_SWC_INP_5ms_sys/INP/CAN1/SignalCheck/ESC5/ESC5CSErr"
 /begin REF_CHARACTERISTIC KINP_ESC5CSErr_flg_defval KINP_ESC5CSErr_flg_ovrdflg KINP_ESC5CSErr_flg_ovrdval /end REF_CHARACTERISTIC
/end GROUP
/begin GROUP S107_ESC5RC "SWC_INP_type/run_SWC_INP_5ms_sys/INP/CAN1/SignalCheck/ESC5/ESC5RC"
 /begin REF_CHARACTERISTIC KINP_ESC5RC_enum_defval KINP_ESC5RC_enum_ovrdflg KINP_ESC5RC_enum_ovrdval /end REF_CHARACTERISTIC
/end GROUP
/begin GROUP S107_ESC5RCErr "SWC_INP_type/run_SWC_INP_5ms_sys/INP/CAN1/SignalCheck/ESC5/ESC5RCErr"
 /begin REF_CHARACTERISTIC KINP_ESC5RCErr_flg_defval KINP_ESC5RCErr_flg_ovrdflg KINP_ESC5RCErr_flg_ovrdval /end REF_CHARACTERISTIC
/end GROUP
/begin GROUP S107_ESCADASSta "SWC_INP_type/run_SWC_INP_5ms_sys/INP/CAN1/SignalCheck/ESC5/ESCADASSta"
 /begin REF_CHARACTERISTIC KINP_ESCADASSta_enum_defval KINP_ESCADASSta_enum_ovrdflg KINP_ESCADASSta_enum_ovrdval /end REF_CHARACTERISTIC
/end GROUP
/begin GROUP S107_ESCAPSSta "SWC_INP_type/run_SWC_INP_5ms_sys/INP/CAN1/SignalCheck/ESC5/ESCAPSSta"
 /begin REF_CHARACTERISTIC KINP_ESCAPSSta_enum_defval KINP_ESCAPSSta_enum_ovrdflg KINP_ESCAPSSta_enum_ovrdval /end REF_CHARACTERISTIC
/end GROUP
/begin GROUP S107_ESCStandstill "SWC_INP_type/run_SWC_INP_5ms_sys/INP/CAN1/SignalCheck/ESC5/ESCStandstill"
 /begin REF_CHARACTERISTIC KINP_ESCStandstill_flg_defval KINP_ESCStandstill_flg_ovrdflg KINP_ESCStandstill_flg_ovrdval /end REF_CHARACTERISTIC
/end GROUP
/begin GROUP S107_FrRBCActive "SWC_INP_type/run_SWC_INP_5ms_sys/INP/CAN1/SignalCheck/ESC5/FrRBCActive"
 /begin REF_CHARACTERISTIC KINP_FrRBCActive_flg_defval KINP_FrRBCActive_flg_ovrdflg KINP_FrRBCActive_flg_ovrdval /end REF_CHARACTERISTIC
/end GROUP
/begin GROUP S107_FrntAxlTrqReqBrk "SWC_INP_type/run_SWC_INP_5ms_sys/INP/CAN1/SignalCheck/ESC5/FrntAxlTrqReqBrk"
 /begin REF_CHARACTERISTIC KINP_FrntAxlTrqReqBrk_Nm_defval KINP_FrntAxlTrqReqBrk_Nm_ovrdflg KINP_FrntAxlTrqReqBrk_Nm_ovrdval /end REF_CHARACTERISTIC
/end GROUP
/begin GROUP S107_LatAccel "SWC_INP_type/run_SWC_INP_5ms_sys/INP/CAN1/SignalCheck/ESC5/LatAccel"
 /begin REF_CHARACTERISTIC KINP_LatAccel_Gps_defval KINP_LatAccel_Gps_ovrdflg KINP_LatAccel_Gps_ovrdval /end REF_CHARACTERISTIC
/end GROUP
/begin GROUP S107_LatAccelV "SWC_INP_type/run_SWC_INP_5ms_sys/INP/CAN1/SignalCheck/ESC5/LatAccelV"
 /begin REF_CHARACTERISTIC KINP_LatAccelV_flg_defval KINP_LatAccelV_flg_ovrdflg KINP_LatAccelV_flg_ovrdval /end REF_CHARACTERISTIC
/end GROUP
/begin GROUP S107_LongAccel "SWC_INP_type/run_SWC_INP_5ms_sys/INP/CAN1/SignalCheck/ESC5/LongAccel"
 /begin REF_CHARACTERISTIC KINP_LongAccel_Gps_defval KINP_LongAccel_Gps_ovrdflg KINP_LongAccel_Gps_ovrdval /end REF_CHARACTERISTIC
/end GROUP
/begin GROUP S107_LongAccelV "SWC_INP_type/run_SWC_INP_5ms_sys/INP/CAN1/SignalCheck/ESC5/LongAccelV"
 /begin REF_CHARACTERISTIC KINP_LongAccelV_flg_defval KINP_LongAccelV_flg_ovrdflg KINP_LongAccelV_flg_ovrdval /end REF_CHARACTERISTIC
/end GROUP
/begin GROUP S107_MCPressure "SWC_INP_type/run_SWC_INP_5ms_sys/INP/CAN1/SignalCheck/ESC5/MCPressure"
 /begin REF_CHARACTERISTIC KINP_MCPressure_bar_defval KINP_MCPressure_bar_ovrdflg KINP_MCPressure_bar_ovrdval /end REF_CHARACTERISTIC
/end GROUP
/begin GROUP S107_MCPressureV "SWC_INP_type/run_SWC_INP_5ms_sys/INP/CAN1/SignalCheck/ESC5/MCPressureV"
 /begin REF_CHARACTERISTIC KINP_MCPressureV_flg_defval KINP_MCPressureV_flg_ovrdflg KINP_MCPressureV_flg_ovrdval /end REF_CHARACTERISTIC
/end GROUP
/begin GROUP S107_MeterIndVehSpeed "SWC_INP_type/run_SWC_INP_5ms_sys/INP/CAN1/SignalCheck/ESC5/MeterIndVehSpeed"
 /begin REF_CHARACTERISTIC KINP_MeterIndVehSpeed_kph_defval KINP_MeterIndVehSpeed_kph_ovrdflg KINP_MeterIndVehSpeed_kph_ovrdval /end REF_CHARACTERISTIC
/end GROUP
/begin GROUP S107_RDCActive "SWC_INP_type/run_SWC_INP_5ms_sys/INP/CAN1/SignalCheck/ESC5/RDCActive"
 /begin REF_CHARACTERISTIC KINP_RDCActive_enum_defval KINP_RDCActive_enum_ovrdflg KINP_RDCActive_enum_ovrdval /end REF_CHARACTERISTIC
/end GROUP
/begin GROUP S107_RearAxlTrqReqBrk "SWC_INP_type/run_SWC_INP_5ms_sys/INP/CAN1/SignalCheck/ESC5/RearAxlTrqReqBrk"
 /begin REF_CHARACTERISTIC KINP_RearAxlTrqReqBrk_Nm_defval KINP_RearAxlTrqReqBrk_Nm_ovrdflg KINP_RearAxlTrqReqBrk_Nm_ovrdval /end REF_CHARACTERISTIC
/end GROUP
/begin GROUP S107_RrRBCActive "SWC_INP_type/run_SWC_INP_5ms_sys/INP/CAN1/SignalCheck/ESC5/RrRBCActive"
 /begin REF_CHARACTERISTIC KINP_RrRBCActive_flg_defval KINP_RrRBCActive_flg_ovrdflg KINP_RrRBCActive_flg_ovrdval /end REF_CHARACTERISTIC
/end GROUP
/begin GROUP S107_YawRate "SWC_INP_type/run_SWC_INP_5ms_sys/INP/CAN1/SignalCheck/ESC5/YawRate"
 /begin REF_CHARACTERISTIC KINP_YawRate_degps_defval KINP_YawRate_degps_ovrdflg KINP_YawRate_degps_ovrdval /end REF_CHARACTERISTIC
/end GROUP
/begin GROUP S107_YawRateV "SWC_INP_type/run_SWC_INP_5ms_sys/INP/CAN1/SignalCheck/ESC5/YawRateV"
 /begin REF_CHARACTERISTIC KINP_YawRateV_flg_defval KINP_YawRateV_flg_ovrdflg KINP_YawRateV_flg_ovrdval /end REF_CHARACTERISTIC
/end GROUP
/begin GROUP S108_LowBrakeFluidSta "SWC_INP_type/run_SWC_INP_5ms_sys/INP/CAN1/SignalCheck/eBST1/LowBrakeFluidSta"
 /begin REF_CHARACTERISTIC KINP_LowBrakeFluidSta_flg_defval KINP_LowBrakeFluidSta_flg_ovrdflg KINP_LowBrakeFluidSta_flg_ovrdval /end REF_CHARACTERISTIC
/end GROUP
/begin GROUP S108_eBSTAmberWnlmpSta "SWC_INP_type/run_SWC_INP_5ms_sys/INP/CAN1/SignalCheck/eBST1/eBSTAmberWnlmpSta"
 /begin REF_CHARACTERISTIC KINP_eBSTAmberWnlmpSta_flg_defval KINP_eBSTAmberWnlmpSta_flg_ovrdflg KINP_eBSTAmberWnlmpSta_flg_ovrdval /end REF_CHARACTERISTIC
/end GROUP
/begin GROUP S108_eBSTBeepReq "SWC_INP_type/run_SWC_INP_5ms_sys/INP/CAN1/SignalCheck/eBST1/eBSTBeepReq"
 /begin REF_CHARACTERISTIC KINP_eBSTBeepReq_flg_defval KINP_eBSTBeepReq_flg_ovrdflg KINP_eBSTBeepReq_flg_ovrdval /end REF_CHARACTERISTIC
/end GROUP
/begin GROUP S108_eBSTRedWnlmpSta "SWC_INP_type/run_SWC_INP_5ms_sys/INP/CAN1/SignalCheck/eBST1/eBSTRedWnlmpSta"
 /begin REF_CHARACTERISTIC KINP_eBSTRedWnlmpSta_flg_defval KINP_eBSTRedWnlmpSta_flg_ovrdflg KINP_eBSTRedWnlmpSta_flg_ovrdval /end REF_CHARACTERISTIC
/end GROUP
/begin GROUP S772_HMIACAirIntMCmd "SWC_INP_type/run_SWC_INP_5ms_sys/INP/CAN2/SignalCheck/HMI1/HMIACAirIntMCmd"
 /begin REF_CHARACTERISTIC KINP_HMIACAirIntMCmd_flg_defval KINP_HMIACAirIntMCmd_flg_ovrdflg KINP_HMIACAirIntMCmd_flg_ovrdval /end REF_CHARACTERISTIC
/end GROUP
/begin GROUP S772_HMIACAirIntPCmd "SWC_INP_type/run_SWC_INP_5ms_sys/INP/CAN2/SignalCheck/HMI1/HMIACAirIntPCmd"
 /begin REF_CHARACTERISTIC KINP_HMIACAirIntPCmd_flg_defval KINP_HMIACAirIntPCmd_flg_ovrdflg KINP_HMIACAirIntPCmd_flg_ovrdval /end REF_CHARACTERISTIC
/end GROUP
/begin GROUP S772_HMIACAutoBtnCmd "SWC_INP_type/run_SWC_INP_5ms_sys/INP/CAN2/SignalCheck/HMI1/HMIACAutoBtnCmd"
 /begin REF_CHARACTERISTIC KINP_HMIACAutoBtnCmd_flg_defval KINP_HMIACAutoBtnCmd_flg_ovrdflg KINP_HMIACAutoBtnCmd_flg_ovrdval /end REF_CHARACTERISTIC
/end GROUP
/begin GROUP S772_HMIACBtnCmd "SWC_INP_type/run_SWC_INP_5ms_sys/INP/CAN2/SignalCheck/HMI1/HMIACBtnCmd"
 /begin REF_CHARACTERISTIC KINP_HMIACBtnCmd_flg_defval KINP_HMIACBtnCmd_flg_ovrdflg KINP_HMIACBtnCmd_flg_ovrdval /end REF_CHARACTERISTIC
/end GROUP
/begin GROUP S772_HMIACFrDefogBtnCmd "SWC_INP_type/run_SWC_INP_5ms_sys/INP/CAN2/SignalCheck/HMI1/HMIACFrDefogBtnCmd"
 /begin REF_CHARACTERISTIC KINP_HMIACFrDefogBtnCmd_flg_defval KINP_HMIACFrDefogBtnCmd_flg_ovrdflg KINP_HMIACFrDefogBtnCmd_flg_ovrdval /end REF_CHARACTERISTIC
/end GROUP
/begin GROUP S772_HMIACRecycleBtnCmd "SWC_INP_type/run_SWC_INP_5ms_sys/INP/CAN2/SignalCheck/HMI1/HMIACRecycleBtnCmd"
 /begin REF_CHARACTERISTIC KINP_HMIACRecycleBtnCmd_flg_defval KINP_HMIACRecycleBtnCmd_flg_ovrdflg KINP_HMIACRecycleBtnCmd_flg_ovrdval /end REF_CHARACTERISTIC
/end GROUP
/begin GROUP S772_HMIACWindDirMCmd "SWC_INP_type/run_SWC_INP_5ms_sys/INP/CAN2/SignalCheck/HMI1/HMIACWindDirMCmd"
 /begin REF_CHARACTERISTIC KINP_HMIACWindDirMCmd_flg_defval KINP_HMIACWindDirMCmd_flg_ovrdflg KINP_HMIACWindDirMCmd_flg_ovrdval /end REF_CHARACTERISTIC
/end GROUP
/begin GROUP S772_HMIACWindDirPCmd "SWC_INP_type/run_SWC_INP_5ms_sys/INP/CAN2/SignalCheck/HMI1/HMIACWindDirPCmd"
 /begin REF_CHARACTERISTIC KINP_HMIACWindDirPCmd_flg_defval KINP_HMIACWindDirPCmd_flg_ovrdflg KINP_HMIACWindDirPCmd_flg_ovrdval /end REF_CHARACTERISTIC
/end GROUP
/begin GROUP S772_HMIAutoInterLightCmd "SWC_INP_type/run_SWC_INP_5ms_sys/INP/CAN2/SignalCheck/HMI1/HMIAutoInterLightCmd"
 /begin REF_CHARACTERISTIC KINP_HMIAutoInterLightCmd_flg_defval KINP_HMIAutoInterLightCmd_flg_ovrdflg KINP_HMIAutoInterLightCmd_flg_ovrdval /end REF_CHARACTERISTIC
/end GROUP
/begin GROUP S772_HMIBCMPostDefogBtnCmd "SWC_INP_type/run_SWC_INP_5ms_sys/INP/CAN2/SignalCheck/HMI1/HMIBCMPostDefogBtnCmd"
 /begin REF_CHARACTERISTIC KINP_HMIBCMPostDefogBtnCmd_flg_defval KINP_HMIBCMPostDefogBtnCmd_flg_ovrdflg KINP_HMIBCMPostDefogBtnCmd_flg_ovrdval /end REF_CHARACTERISTIC
/end GROUP
/begin GROUP S772_HMIZLSetTMCmd "SWC_INP_type/run_SWC_INP_5ms_sys/INP/CAN2/SignalCheck/HMI1/HMIZLSetTMCmd"
 /begin REF_CHARACTERISTIC KINP_HMIZLSetTMCmd_flg_defval KINP_HMIZLSetTMCmd_flg_ovrdflg KINP_HMIZLSetTMCmd_flg_ovrdval /end REF_CHARACTERISTIC
/end GROUP
/begin GROUP S772_HMIZLSetTPCmd "SWC_INP_type/run_SWC_INP_5ms_sys/INP/CAN2/SignalCheck/HMI1/HMIZLSetTPCmd"
 /begin REF_CHARACTERISTIC KINP_HMIZLSetTPCmd_flg_defval KINP_HMIZLSetTPCmd_flg_ovrdflg KINP_HMIZLSetTPCmd_flg_ovrdval /end REF_CHARACTERISTIC
/end GROUP
/begin GROUP S772_HMIZRSetTMCmd "SWC_INP_type/run_SWC_INP_5ms_sys/INP/CAN2/SignalCheck/HMI1/HMIZRSetTMCmd"
 /begin REF_CHARACTERISTIC KINP_HMIZRSetTMCmd_flg_defval KINP_HMIZRSetTMCmd_flg_ovrdflg KINP_HMIZRSetTMCmd_flg_ovrdval /end REF_CHARACTERISTIC
/end GROUP
/begin GROUP S772_HMIZRSetTPCmd "SWC_INP_type/run_SWC_INP_5ms_sys/INP/CAN2/SignalCheck/HMI1/HMIZRSetTPCmd"
 /begin REF_CHARACTERISTIC KINP_HMIZRSetTPCmd_flg_defval KINP_HMIZRSetTPCmd_flg_ovrdflg KINP_HMIZRSetTPCmd_flg_ovrdval /end REF_CHARACTERISTIC
/end GROUP
/begin GROUP S773_AmbLighLowBatAlertSW "SWC_INP_type/run_SWC_INP_5ms_sys/INP/CAN2/SignalCheck/IVI1/AmbLighLowBatAlertSW"
 /begin REF_CHARACTERISTIC KINP_AmbLighLowBatAlertSW_flg_defval KINP_AmbLighLowBatAlertSW_flg_ovrdflg KINP_AmbLighLowBatAlertSW_flg_ovrdval /end REF_CHARACTERISTIC
/end GROUP
/begin GROUP S773_AmbLighSafetyAlertSW "SWC_INP_type/run_SWC_INP_5ms_sys/INP/CAN2/SignalCheck/IVI1/AmbLighSafetyAlertSW"
 /begin REF_CHARACTERISTIC KINP_AmbLighSafetyAlertSW_flg_defval KINP_AmbLighSafetyAlertSW_flg_ovrdflg KINP_AmbLighSafetyAlertSW_flg_ovrdval /end REF_CHARACTERISTIC
/end GROUP
/begin GROUP S773_AmbLightBrightnessSet "SWC_INP_type/run_SWC_INP_5ms_sys/INP/CAN2/SignalCheck/IVI1/AmbLightBrightnessSet"
 /begin REF_CHARACTERISTIC KINP_AmbLightBrightnessSet_enum_defval KINP_AmbLightBrightnessSet_enum_ovrdflg KINP_AmbLightBrightnessSet_enum_ovrdval /end REF_CHARACTERISTIC
/end GROUP
/begin GROUP S773_AmbLightColorSet "SWC_INP_type/run_SWC_INP_5ms_sys/INP/CAN2/SignalCheck/IVI1/AmbLightColorSet"
 /begin REF_CHARACTERISTIC KINP_AmbLightColorSet_enum_defval KINP_AmbLightColorSet_enum_ovrdflg KINP_AmbLightColorSet_enum_ovrdval /end REF_CHARACTERISTIC
/end GROUP
/begin GROUP S773_AmbLightDimInDarkSW "SWC_INP_type/run_SWC_INP_5ms_sys/INP/CAN2/SignalCheck/IVI1/AmbLightDimInDarkSW"
 /begin REF_CHARACTERISTIC KINP_AmbLightDimInDarkSW_flg_defval KINP_AmbLightDimInDarkSW_flg_ovrdflg KINP_AmbLightDimInDarkSW_flg_ovrdval /end REF_CHARACTERISTIC
/end GROUP
/begin GROUP S773_AmbLightSW "SWC_INP_type/run_SWC_INP_5ms_sys/INP/CAN2/SignalCheck/IVI1/AmbLightSW"
 /begin REF_CHARACTERISTIC KINP_AmbLightSW_flg_defval KINP_AmbLightSW_flg_ovrdflg KINP_AmbLightSW_flg_ovrdval /end REF_CHARACTERISTIC
/end GROUP
/begin GROUP S773_AmbLightWlcmLightSW "SWC_INP_type/run_SWC_INP_5ms_sys/INP/CAN2/SignalCheck/IVI1/AmbLightWlcmLightSW"
 /begin REF_CHARACTERISTIC KINP_AmbLightWlcmLightSW_flg_defval KINP_AmbLightWlcmLightSW_flg_ovrdflg KINP_AmbLightWlcmLightSW_flg_ovrdval /end REF_CHARACTERISTIC
/end GROUP
/begin GROUP S773_FCPFrEvtBtnACMaxReq "SWC_INP_type/run_SWC_INP_5ms_sys/INP/CAN2/SignalCheck/IVI1/FCPFrEvtBtnACMaxReq"
 /begin REF_CHARACTERISTIC KINP_FCPFrEvtBtnACMaxReq_flg_defval KINP_FCPFrEvtBtnACMaxReq_flg_ovrdflg KINP_FCPFrEvtBtnACMaxReq_flg_ovrdval /end REF_CHARACTERISTIC
/end GROUP
/begin GROUP S773_FCPFrEvtBtnACReq "SWC_INP_type/run_SWC_INP_5ms_sys/INP/CAN2/SignalCheck/IVI1/FCPFrEvtBtnACReq"
 /begin REF_CHARACTERISTIC KINP_FCPFrEvtBtnACReq_flg_defval KINP_FCPFrEvtBtnACReq_flg_ovrdflg KINP_FCPFrEvtBtnACReq_flg_ovrdval /end REF_CHARACTERISTIC
/end GROUP
/begin GROUP S773_FCPFrEvtBtnAutoReq "SWC_INP_type/run_SWC_INP_5ms_sys/INP/CAN2/SignalCheck/IVI1/FCPFrEvtBtnAutoReq"
 /begin REF_CHARACTERISTIC KINP_FCPFrEvtBtnAutoReq_flg_defval KINP_FCPFrEvtBtnAutoReq_flg_ovrdflg KINP_FCPFrEvtBtnAutoReq_flg_ovrdval /end REF_CHARACTERISTIC
/end GROUP
/begin GROUP S773_FCPFrEvtBtnSyncReq "SWC_INP_type/run_SWC_INP_5ms_sys/INP/CAN2/SignalCheck/IVI1/FCPFrEvtBtnSyncReq"
 /begin REF_CHARACTERISTIC KINP_FCPFrEvtBtnSyncReq_flg_defval KINP_FCPFrEvtBtnSyncReq_flg_ovrdflg KINP_FCPFrEvtBtnSyncReq_flg_ovrdval /end REF_CHARACTERISTIC
/end GROUP
/begin GROUP S773_IVIAutoWipHSpdSWCmd "SWC_INP_type/run_SWC_INP_5ms_sys/INP/CAN2/SignalCheck/IVI1/IVIAutoWipHSpdSWCmd"
 /begin REF_CHARACTERISTIC KINP_IVIAutoWipHSpdSWCmd_flg_defval KINP_IVIAutoWipHSpdSWCmd_flg_ovrdflg KINP_IVIAutoWipHSpdSWCmd_flg_ovrdval /end REF_CHARACTERISTIC
/end GROUP
/begin GROUP S773_IVICLWinLockDoorSWSta "SWC_INP_type/run_SWC_INP_5ms_sys/INP/CAN2/SignalCheck/IVI1/IVICLWinLockDoorSWSta"
 /begin REF_CHARACTERISTIC KINP_IVICLWinLockDoorSWSta_flg_defval KINP_IVICLWinLockDoorSWSta_flg_ovrdflg KINP_IVICLWinLockDoorSWSta_flg_ovrdval /end REF_CHARACTERISTIC
/end GROUP
/begin GROUP S773_IVICreateAccReqSta "SWC_INP_type/run_SWC_INP_5ms_sys/INP/CAN2/SignalCheck/IVI1/IVICreateAccReqSta"
 /begin REF_CHARACTERISTIC KINP_IVICreateAccReqSta_enum_defval KINP_IVICreateAccReqSta_enum_ovrdflg KINP_IVICreateAccReqSta_enum_ovrdval /end REF_CHARACTERISTIC
/end GROUP
/begin GROUP S773_IVIDelAccReqSta "SWC_INP_type/run_SWC_INP_5ms_sys/INP/CAN2/SignalCheck/IVI1/IVIDelAccReqSta"
 /begin REF_CHARACTERISTIC KINP_IVIDelAccReqSta_enum_defval KINP_IVIDelAccReqSta_enum_ovrdflg KINP_IVIDelAccReqSta_enum_ovrdval /end REF_CHARACTERISTIC
/end GROUP
/begin GROUP S773_IVIDrivingLockSWSta "SWC_INP_type/run_SWC_INP_5ms_sys/INP/CAN2/SignalCheck/IVI1/IVIDrivingLockSWSta"
 /begin REF_CHARACTERISTIC KINP_IVIDrivingLockSWSta_flg_defval KINP_IVIDrivingLockSWSta_flg_ovrdflg KINP_IVIDrivingLockSWSta_flg_ovrdval /end REF_CHARACTERISTIC
/end GROUP
/begin GROUP S773_IVIEPSForceCmd "SWC_INP_type/run_SWC_INP_5ms_sys/INP/CAN2/SignalCheck/IVI1/IVIEPSForceCmd"
 /begin REF_CHARACTERISTIC KINP_IVIEPSForceCmd_enum_defval KINP_IVIEPSForceCmd_enum_ovrdflg KINP_IVIEPSForceCmd_enum_ovrdval /end REF_CHARACTERISTIC
/end GROUP
/begin GROUP S773_IVIFrTrunkUnlockReqSta "SWC_INP_type/run_SWC_INP_5ms_sys/INP/CAN2/SignalCheck/IVI1/IVIFrTrunkUnlockReqSta"
 /begin REF_CHARACTERISTIC KINP_IVIFrTrunkUnlockReqSta_flg_defval KINP_IVIFrTrunkUnlockReqSta_flg_ovrdflg KINP_IVIFrTrunkUnlockReqSta_flg_ovrdval /end REF_CHARACTERISTIC
/end GROUP
/begin GROUP S773_IVILinkAccReqSta "SWC_INP_type/run_SWC_INP_5ms_sys/INP/CAN2/SignalCheck/IVI1/IVILinkAccReqSta"
 /begin REF_CHARACTERISTIC KINP_IVILinkAccReqSta_flg_defval KINP_IVILinkAccReqSta_flg_ovrdflg KINP_IVILinkAccReqSta_flg_ovrdval /end REF_CHARACTERISTIC
/end GROUP
/begin GROUP S773_IVILinkAccSta "SWC_INP_type/run_SWC_INP_5ms_sys/INP/CAN2/SignalCheck/IVI1/IVILinkAccSta"
 /begin REF_CHARACTERISTIC KINP_IVILinkAccSta_enum_defval KINP_IVILinkAccSta_enum_ovrdflg KINP_IVILinkAccSta_enum_ovrdval /end REF_CHARACTERISTIC
/end GROUP
/begin GROUP S773_IVILinkKeySta "SWC_INP_type/run_SWC_INP_5ms_sys/INP/CAN2/SignalCheck/IVI1/IVILinkKeySta"
 /begin REF_CHARACTERISTIC KINP_IVILinkKeySta_enum_defval KINP_IVILinkKeySta_enum_ovrdflg KINP_IVILinkKeySta_enum_ovrdval /end REF_CHARACTERISTIC
/end GROUP
/begin GROUP S773_IVILocatedSTA "SWC_INP_type/run_SWC_INP_5ms_sys/INP/CAN2/SignalCheck/IVI1/IVILocatedSTA"
 /begin REF_CHARACTERISTIC KINP_IVILocatedSTA_enum_defval KINP_IVILocatedSTA_enum_ovrdflg KINP_IVILocatedSTA_enum_ovrdval /end REF_CHARACTERISTIC
/end GROUP
/begin GROUP S773_IVILockSoundSWSta "SWC_INP_type/run_SWC_INP_5ms_sys/INP/CAN2/SignalCheck/IVI1/IVILockSoundSWSta"
 /begin REF_CHARACTERISTIC KINP_IVILockSoundSWSta_flg_defval KINP_IVILockSoundSWSta_flg_ovrdflg KINP_IVILockSoundSWSta_flg_ovrdval /end REF_CHARACTERISTIC
/end GROUP
/begin GROUP S773_IVIMirrorFoldedSWSta "SWC_INP_type/run_SWC_INP_5ms_sys/INP/CAN2/SignalCheck/IVI1/IVIMirrorFoldedSWSta"
 /begin REF_CHARACTERISTIC KINP_IVIMirrorFoldedSWSta_flg_defval KINP_IVIMirrorFoldedSWSta_flg_ovrdflg KINP_IVIMirrorFoldedSWSta_flg_ovrdval /end REF_CHARACTERISTIC
/end GROUP
/begin GROUP S773_IVISWCVibModeSta "SWC_INP_type/run_SWC_INP_5ms_sys/INP/CAN2/SignalCheck/IVI1/IVISWCVibModeSta"
 /begin REF_CHARACTERISTIC KINP_IVISWCVibModeSta_enum_defval KINP_IVISWCVibModeSta_enum_ovrdflg KINP_IVISWCVibModeSta_enum_ovrdval /end REF_CHARACTERISTIC
/end GROUP
/begin GROUP S773_IVISilentChrgAlertSta "SWC_INP_type/run_SWC_INP_5ms_sys/INP/CAN2/SignalCheck/IVI1/IVISilentChrgAlertSta"
 /begin REF_CHARACTERISTIC KINP_IVISilentChrgAlertSta_flg_defval KINP_IVISilentChrgAlertSta_flg_ovrdflg KINP_IVISilentChrgAlertSta_flg_ovrdval /end REF_CHARACTERISTIC
/end GROUP
/begin GROUP S773_IVIStoppingUnlockSWSta "SWC_INP_type/run_SWC_INP_5ms_sys/INP/CAN2/SignalCheck/IVI1/IVIStoppingUnlockSWSta"
 /begin REF_CHARACTERISTIC KINP_IVIStoppingUnlockSWSta_flg_defval KINP_IVIStoppingUnlockSWSta_flg_ovrdflg KINP_IVIStoppingUnlockSWSta_flg_ovrdval /end REF_CHARACTERISTIC
/end GROUP
/begin GROUP S773_IVITimeCheck "SWC_INP_type/run_SWC_INP_5ms_sys/INP/CAN2/SignalCheck/IVI1/IVITimeCheck"
 /begin REF_CHARACTERISTIC KINP_IVITimeCheck_enum_defval KINP_IVITimeCheck_enum_ovrdflg KINP_IVITimeCheck_enum_ovrdval /end REF_CHARACTERISTIC
/end GROUP
/begin GROUP S773_IVITimeDay "SWC_INP_type/run_SWC_INP_5ms_sys/INP/CAN2/SignalCheck/IVI1/IVITimeDay"
 /begin REF_CHARACTERISTIC KINP_IVITimeDay_DAY_defval KINP_IVITimeDay_DAY_ovrdflg KINP_IVITimeDay_DAY_ovrdval /end REF_CHARACTERISTIC
/end GROUP
/begin GROUP S773_IVITimeHour "SWC_INP_type/run_SWC_INP_5ms_sys/INP/CAN2/SignalCheck/IVI1/IVITimeHour"
 /begin REF_CHARACTERISTIC KINP_IVITimeHour_hr_defval KINP_IVITimeHour_hr_ovrdflg KINP_IVITimeHour_hr_ovrdval /end REF_CHARACTERISTIC
/end GROUP
/begin GROUP S773_IVITimeMinute "SWC_INP_type/run_SWC_INP_5ms_sys/INP/CAN2/SignalCheck/IVI1/IVITimeMinute"
 /begin REF_CHARACTERISTIC KINP_IVITimeMinute_min_defval KINP_IVITimeMinute_min_ovrdflg KINP_IVITimeMinute_min_ovrdval /end REF_CHARACTERISTIC
/end GROUP
/begin GROUP S773_IVITimeMonth "SWC_INP_type/run_SWC_INP_5ms_sys/INP/CAN2/SignalCheck/IVI1/IVITimeMonth"
 /begin REF_CHARACTERISTIC KINP_IVITimeMonth_MONTH_defval KINP_IVITimeMonth_MONTH_ovrdflg KINP_IVITimeMonth_MONTH_ovrdval /end REF_CHARACTERISTIC
/end GROUP
/begin GROUP S773_IVITimeSecond "SWC_INP_type/run_SWC_INP_5ms_sys/INP/CAN2/SignalCheck/IVI1/IVITimeSecond"
 /begin REF_CHARACTERISTIC KINP_IVITimeSecond_s_defval KINP_IVITimeSecond_s_ovrdflg KINP_IVITimeSecond_s_ovrdval /end REF_CHARACTERISTIC
/end GROUP
/begin GROUP S773_IVITimeYear "SWC_INP_type/run_SWC_INP_5ms_sys/INP/CAN2/SignalCheck/IVI1/IVITimeYear"
 /begin REF_CHARACTERISTIC KINP_IVITimeYear_YEAR_defval KINP_IVITimeYear_YEAR_ovrdflg KINP_IVITimeYear_YEAR_ovrdval /end REF_CHARACTERISTIC
/end GROUP
/begin GROUP S773_IVIWPTCSWSta "SWC_INP_type/run_SWC_INP_5ms_sys/INP/CAN2/SignalCheck/IVI1/IVIWPTCSWSta"
 /begin REF_CHARACTERISTIC KINP_IVIWPTCSWSta_flg_defval KINP_IVIWPTCSWSta_flg_ovrdflg KINP_IVIWPTCSWSta_flg_ovrdval /end REF_CHARACTERISTIC
/end GROUP
/begin GROUP S773_IVIsigScreenReqSta "SWC_INP_type/run_SWC_INP_5ms_sys/INP/CAN2/SignalCheck/IVI1/IVIsigScreenReqSta"
 /begin REF_CHARACTERISTIC KINP_IVIsigScreenReqSta_flg_defval KINP_IVIsigScreenReqSta_flg_ovrdflg KINP_IVIsigScreenReqSta_flg_ovrdval /end REF_CHARACTERISTIC
/end GROUP
/begin GROUP S773_LINKtoDrive "SWC_INP_type/run_SWC_INP_5ms_sys/INP/CAN2/SignalCheck/IVI1/LINKtoDrive"
 /begin REF_CHARACTERISTIC KINP_LINKtoDrive_flg_defval KINP_LINKtoDrive_flg_ovrdflg KINP_LINKtoDrive_flg_ovrdval /end REF_CHARACTERISTIC
/end GROUP
/begin GROUP S773_OpenDrOpenWdoSW "SWC_INP_type/run_SWC_INP_5ms_sys/INP/CAN2/SignalCheck/IVI1/OpenDrOpenWdoSW"
 /begin REF_CHARACTERISTIC KINP_OpenDrOpenWdoSW_flg_defval KINP_OpenDrOpenWdoSW_flg_ovrdflg KINP_OpenDrOpenWdoSW_flg_ovrdval /end REF_CHARACTERISTIC
/end GROUP
/begin GROUP S773_PWCONTINUEUSE "SWC_INP_type/run_SWC_INP_5ms_sys/INP/CAN2/SignalCheck/IVI1/PWCONTINUEUSE"
 /begin REF_CHARACTERISTIC KINP_PWCONTINUEUSE_flg_defval KINP_PWCONTINUEUSE_flg_ovrdflg KINP_PWCONTINUEUSE_flg_ovrdval /end REF_CHARACTERISTIC
/end GROUP
/begin GROUP S773_SmartEcoModeSW "SWC_INP_type/run_SWC_INP_5ms_sys/INP/CAN2/SignalCheck/IVI1/SmartEcoModeSW"
 /begin REF_CHARACTERISTIC KINP_SmartEcoModeSW_flg_defval KINP_SmartEcoModeSW_flg_ovrdflg KINP_SmartEcoModeSW_flg_ovrdval /end REF_CHARACTERISTIC
/end GROUP
/begin GROUP S773_UserSet "SWC_INP_type/run_SWC_INP_5ms_sys/INP/CAN2/SignalCheck/IVI1/UserSet"
 /begin REF_CHARACTERISTIC KINP_UserSet_enum_defval KINP_UserSet_enum_ovrdflg KINP_UserSet_enum_ovrdval /end REF_CHARACTERISTIC
/end GROUP
/begin GROUP S774_ACChgCurSet "SWC_INP_type/run_SWC_INP_5ms_sys/INP/CAN2/SignalCheck/IVI2/ACChgCurSet"
 /begin REF_CHARACTERISTIC KINP_ACChgCurSet_A_defval KINP_ACChgCurSet_A_ovrdflg KINP_ACChgCurSet_A_ovrdval /end REF_CHARACTERISTIC
/end GROUP
/begin GROUP S774_AVMErrSTA "SWC_INP_type/run_SWC_INP_5ms_sys/INP/CAN2/SignalCheck/IVI2/AVMErrSTA"
 /begin REF_CHARACTERISTIC KINP_AVMErrSTA_flg_defval KINP_AVMErrSTA_flg_ovrdflg KINP_AVMErrSTA_flg_ovrdval /end REF_CHARACTERISTIC
/end GROUP
/begin GROUP S774_AVMOFFRecButt "SWC_INP_type/run_SWC_INP_5ms_sys/INP/CAN2/SignalCheck/IVI2/AVMOFFRecButt"
 /begin REF_CHARACTERISTIC KINP_AVMOFFRecButt_flg_defval KINP_AVMOFFRecButt_flg_ovrdflg KINP_AVMOFFRecButt_flg_ovrdval /end REF_CHARACTERISTIC
/end GROUP
/begin GROUP S774_AVMParkingmode "SWC_INP_type/run_SWC_INP_5ms_sys/INP/CAN2/SignalCheck/IVI2/AVMParkingmode"
 /begin REF_CHARACTERISTIC KINP_AVMParkingmode_enum_defval KINP_AVMParkingmode_enum_ovrdflg KINP_AVMParkingmode_enum_ovrdval /end REF_CHARACTERISTIC
/end GROUP
/begin GROUP S774_AVMparkingcancel "SWC_INP_type/run_SWC_INP_5ms_sys/INP/CAN2/SignalCheck/IVI2/AVMparkingcancel"
 /begin REF_CHARACTERISTIC KINP_AVMparkingcancel_enum_defval KINP_AVMparkingcancel_enum_ovrdflg KINP_AVMparkingcancel_enum_ovrdval /end REF_CHARACTERISTIC
/end GROUP
/begin GROUP S774_AVMparkingexcute "SWC_INP_type/run_SWC_INP_5ms_sys/INP/CAN2/SignalCheck/IVI2/AVMparkingexcute"
 /begin REF_CHARACTERISTIC KINP_AVMparkingexcute_enum_defval KINP_AVMparkingexcute_enum_ovrdflg KINP_AVMparkingexcute_enum_ovrdval /end REF_CHARACTERISTIC
/end GROUP
/begin GROUP S774_ApproachUnlockSW "SWC_INP_type/run_SWC_INP_5ms_sys/INP/CAN2/SignalCheck/IVI2/ApproachUnlockSW"
 /begin REF_CHARACTERISTIC KINP_ApproachUnlockSW_flg_defval KINP_ApproachUnlockSW_flg_ovrdflg KINP_ApproachUnlockSW_flg_ovrdval /end REF_CHARACTERISTIC
/end GROUP
/begin GROUP S774_CAASSw "SWC_INP_type/run_SWC_INP_5ms_sys/INP/CAN2/SignalCheck/IVI2/CAASSw"
 /begin REF_CHARACTERISTIC KINP_CAASSw_enum_defval KINP_CAASSw_enum_ovrdflg KINP_CAASSw_enum_ovrdval /end REF_CHARACTERISTIC
/end GROUP
/begin GROUP S774_CDLLockButt "SWC_INP_type/run_SWC_INP_5ms_sys/INP/CAN2/SignalCheck/IVI2/CDLLockButt"
 /begin REF_CHARACTERISTIC KINP_CDLLockButt_flg_defval KINP_CDLLockButt_flg_ovrdflg KINP_CDLLockButt_flg_ovrdval /end REF_CHARACTERISTIC
/end GROUP
/begin GROUP S774_CDLUnlockButt "SWC_INP_type/run_SWC_INP_5ms_sys/INP/CAN2/SignalCheck/IVI2/CDLUnlockButt"
 /begin REF_CHARACTERISTIC KINP_CDLUnlockButt_flg_defval KINP_CDLUnlockButt_flg_ovrdflg KINP_CDLUnlockButt_flg_ovrdval /end REF_CHARACTERISTIC
/end GROUP
/begin GROUP S774_DSEATantiset "SWC_INP_type/run_SWC_INP_5ms_sys/INP/CAN2/SignalCheck/IVI2/DSEATantiset"
 /begin REF_CHARACTERISTIC KINP_DSEATantiset_flg_defval KINP_DSEATantiset_flg_ovrdflg KINP_DSEATantiset_flg_ovrdval /end REF_CHARACTERISTIC
/end GROUP
/begin GROUP S774_DSEATentryfunset "SWC_INP_type/run_SWC_INP_5ms_sys/INP/CAN2/SignalCheck/IVI2/DSEATentryfunset"
 /begin REF_CHARACTERISTIC KINP_DSEATentryfunset_flg_defval KINP_DSEATentryfunset_flg_ovrdflg KINP_DSEATentryfunset_flg_ovrdval /end REF_CHARACTERISTIC
/end GROUP
/begin GROUP S774_DSEATventreq "SWC_INP_type/run_SWC_INP_5ms_sys/INP/CAN2/SignalCheck/IVI2/DSEATventreq"
 /begin REF_CHARACTERISTIC KINP_DSEATventreq_enum_defval KINP_DSEATventreq_enum_ovrdflg KINP_DSEATventreq_enum_ovrdval /end REF_CHARACTERISTIC
/end GROUP
/begin GROUP S774_Distanceunit "SWC_INP_type/run_SWC_INP_5ms_sys/INP/CAN2/SignalCheck/IVI2/Distanceunit"
 /begin REF_CHARACTERISTIC KINP_Distanceunit_flg_defval KINP_Distanceunit_flg_ovrdflg KINP_Distanceunit_flg_ovrdval /end REF_CHARACTERISTIC
/end GROUP
/begin GROUP S774_ESCSWCmd "SWC_INP_type/run_SWC_INP_5ms_sys/INP/CAN2/SignalCheck/IVI2/ESCSWCmd"
 /begin REF_CHARACTERISTIC KINP_ESCSWCmd_enum_defval KINP_ESCSWCmd_enum_ovrdflg KINP_ESCSWCmd_enum_ovrdval /end REF_CHARACTERISTIC
/end GROUP
/begin GROUP S774_FSOffSw "SWC_INP_type/run_SWC_INP_5ms_sys/INP/CAN2/SignalCheck/IVI2/FSOffSw"
 /begin REF_CHARACTERISTIC KINP_FSOffSw_enum_defval KINP_FSOffSw_enum_ovrdflg KINP_FSOffSw_enum_ovrdval /end REF_CHARACTERISTIC
/end GROUP
/begin GROUP S774_FollowMeSW "SWC_INP_type/run_SWC_INP_5ms_sys/INP/CAN2/SignalCheck/IVI2/FollowMeSW"
 /begin REF_CHARACTERISTIC KINP_FollowMeSW_flg_defval KINP_FollowMeSW_flg_ovrdflg KINP_FollowMeSW_flg_ovrdval /end REF_CHARACTERISTIC
/end GROUP
/begin GROUP S774_GPSLAT "SWC_INP_type/run_SWC_INP_5ms_sys/INP/CAN2/SignalCheck/IVI2/GPSLAT"
 /begin REF_CHARACTERISTIC KINP_GPSLAT_s_defval KINP_GPSLAT_s_ovrdflg KINP_GPSLAT_s_ovrdval /end REF_CHARACTERISTIC
/end GROUP
/begin GROUP S774_GPSLONG "SWC_INP_type/run_SWC_INP_5ms_sys/INP/CAN2/SignalCheck/IVI2/GPSLONG"
 /begin REF_CHARACTERISTIC KINP_GPSLONG_enum_defval KINP_GPSLONG_enum_ovrdflg KINP_GPSLONG_enum_ovrdval /end REF_CHARACTERISTIC
/end GROUP
/begin GROUP S774_HeadLampSW "SWC_INP_type/run_SWC_INP_5ms_sys/INP/CAN2/SignalCheck/IVI2/HeadLampSW"
 /begin REF_CHARACTERISTIC KINP_HeadLampSW_enum_defval KINP_HeadLampSW_enum_ovrdflg KINP_HeadLampSW_enum_ovrdval /end REF_CHARACTERISTIC
/end GROUP
/begin GROUP S774_HoodLatchSW "SWC_INP_type/run_SWC_INP_5ms_sys/INP/CAN2/SignalCheck/IVI2/HoodLatchSW"
 /begin REF_CHARACTERISTIC KINP_HoodLatchSW_enum_defval KINP_HoodLatchSW_enum_ovrdflg KINP_HoodLatchSW_enum_ovrdval /end REF_CHARACTERISTIC
/end GROUP
/begin GROUP S774_IVIACCAdaptiveSta "SWC_INP_type/run_SWC_INP_5ms_sys/INP/CAN2/SignalCheck/IVI2/IVIACCAdaptiveSta"
 /begin REF_CHARACTERISTIC KINP_IVIACCAdaptiveSta_flg_defval KINP_IVIACCAdaptiveSta_flg_ovrdflg KINP_IVIACCAdaptiveSta_flg_ovrdval /end REF_CHARACTERISTIC
/end GROUP
/begin GROUP S774_IVIAirIntZ3Cmd "SWC_INP_type/run_SWC_INP_5ms_sys/INP/CAN2/SignalCheck/IVI2/IVIAirIntZ3Cmd"
 /begin REF_CHARACTERISTIC KINP_IVIAirIntZ3Cmd_enum_defval KINP_IVIAirIntZ3Cmd_enum_ovrdflg KINP_IVIAirIntZ3Cmd_enum_ovrdval /end REF_CHARACTERISTIC
/end GROUP
/begin GROUP S774_IVICarWashModeCmd "SWC_INP_type/run_SWC_INP_5ms_sys/INP/CAN2/SignalCheck/IVI2/IVICarWashModeCmd"
 /begin REF_CHARACTERISTIC KINP_IVICarWashModeCmd_flg_defval KINP_IVICarWashModeCmd_flg_ovrdflg KINP_IVICarWashModeCmd_flg_ovrdval /end REF_CHARACTERISTIC
/end GROUP
/begin GROUP S774_IVIChargePortSWSta "SWC_INP_type/run_SWC_INP_5ms_sys/INP/CAN2/SignalCheck/IVI2/IVIChargePortSWSta"
 /begin REF_CHARACTERISTIC KINP_IVIChargePortSWSta_flg_defval KINP_IVIChargePortSWSta_flg_ovrdflg KINP_IVIChargePortSWSta_flg_ovrdval /end REF_CHARACTERISTIC
/end GROUP
/begin GROUP S774_IVICreepSWReq "SWC_INP_type/run_SWC_INP_5ms_sys/INP/CAN2/SignalCheck/IVI2/IVICreepSWReq"
 /begin REF_CHARACTERISTIC KINP_IVICreepSWReq_flg_defval KINP_IVICreepSWReq_flg_ovrdflg KINP_IVICreepSWReq_flg_ovrdval /end REF_CHARACTERISTIC
/end GROUP
/begin GROUP S774_IVIDSEATFroEdgeHeightCmd "SWC_INP_type/run_SWC_INP_5ms_sys/INP/CAN2/SignalCheck/IVI2/IVIDSEATFroEdgeHeightCmd"
 /begin REF_CHARACTERISTIC KINP_IVIDSEATFroEdgeHeightCmd_enum_defval KINP_IVIDSEATFroEdgeHeightCmd_enum_ovrdflg KINP_IVIDSEATFroEdgeHeightCmd_enum_ovrdval /end REF_CHARACTERISTIC
/end GROUP
/begin GROUP S774_IVIDSEATHeaterCmd "SWC_INP_type/run_SWC_INP_5ms_sys/INP/CAN2/SignalCheck/IVI2/IVIDSEATHeaterCmd"
 /begin REF_CHARACTERISTIC KINP_IVIDSEATHeaterCmd_enum_defval KINP_IVIDSEATHeaterCmd_enum_ovrdflg KINP_IVIDSEATHeaterCmd_enum_ovrdval /end REF_CHARACTERISTIC
/end GROUP
/begin GROUP S774_IVIDSEATHeightCmd "SWC_INP_type/run_SWC_INP_5ms_sys/INP/CAN2/SignalCheck/IVI2/IVIDSEATHeightCmd"
 /begin REF_CHARACTERISTIC KINP_IVIDSEATHeightCmd_enum_defval KINP_IVIDSEATHeightCmd_enum_ovrdflg KINP_IVIDSEATHeightCmd_enum_ovrdval /end REF_CHARACTERISTIC
/end GROUP
/begin GROUP S774_IVIDSEATMemory1Sta "SWC_INP_type/run_SWC_INP_5ms_sys/INP/CAN2/SignalCheck/IVI2/IVIDSEATMemory1Sta"
 /begin REF_CHARACTERISTIC KINP_IVIDSEATMemory1Sta_flg_defval KINP_IVIDSEATMemory1Sta_flg_ovrdflg KINP_IVIDSEATMemory1Sta_flg_ovrdval /end REF_CHARACTERISTIC
/end GROUP
/begin GROUP S774_IVIDSEATMemory2Sta "SWC_INP_type/run_SWC_INP_5ms_sys/INP/CAN2/SignalCheck/IVI2/IVIDSEATMemory2Sta"
 /begin REF_CHARACTERISTIC KINP_IVIDSEATMemory2Sta_flg_defval KINP_IVIDSEATMemory2Sta_flg_ovrdflg KINP_IVIDSEATMemory2Sta_flg_ovrdval /end REF_CHARACTERISTIC
/end GROUP
/begin GROUP S774_IVIDSEATMemoryOPTCLSSta "SWC_INP_type/run_SWC_INP_5ms_sys/INP/CAN2/SignalCheck/IVI2/IVIDSEATMemoryOPTCLSSta"
 /begin REF_CHARACTERISTIC KINP_IVIDSEATMemoryOPTCLSSta_flg_defval KINP_IVIDSEATMemoryOPTCLSSta_flg_ovrdflg KINP_IVIDSEATMemoryOPTCLSSta_flg_ovrdval /end REF_CHARACTERISTIC
/end GROUP
/begin GROUP S774_IVIDSEATReclineCmd "SWC_INP_type/run_SWC_INP_5ms_sys/INP/CAN2/SignalCheck/IVI2/IVIDSEATReclineCmd"
 /begin REF_CHARACTERISTIC KINP_IVIDSEATReclineCmd_enum_defval KINP_IVIDSEATReclineCmd_enum_ovrdflg KINP_IVIDSEATReclineCmd_enum_ovrdval /end REF_CHARACTERISTIC
/end GROUP
/begin GROUP S774_IVIDSEATSlideCmd "SWC_INP_type/run_SWC_INP_5ms_sys/INP/CAN2/SignalCheck/IVI2/IVIDSEATSlideCmd"
 /begin REF_CHARACTERISTIC KINP_IVIDSEATSlideCmd_enum_defval KINP_IVIDSEATSlideCmd_enum_ovrdflg KINP_IVIDSEATSlideCmd_enum_ovrdval /end REF_CHARACTERISTIC
/end GROUP
/begin GROUP S774_IVIFGSAirIntCmd "SWC_INP_type/run_SWC_INP_5ms_sys/INP/CAN2/SignalCheck/IVI2/IVIFGSAirIntCmd"
 /begin REF_CHARACTERISTIC KINP_IVIFGSAirIntCmd_enum_defval KINP_IVIFGSAirIntCmd_enum_ovrdflg KINP_IVIFGSAirIntCmd_enum_ovrdval /end REF_CHARACTERISTIC
/end GROUP
/begin GROUP S774_IVIFGSChCmd "SWC_INP_type/run_SWC_INP_5ms_sys/INP/CAN2/SignalCheck/IVI2/IVIFGSChCmd"
 /begin REF_CHARACTERISTIC KINP_IVIFGSChCmd_enum_defval KINP_IVIFGSChCmd_enum_ovrdflg KINP_IVIFGSChCmd_enum_ovrdval /end REF_CHARACTERISTIC
/end GROUP
/begin GROUP S774_IVIIONSWCmd "SWC_INP_type/run_SWC_INP_5ms_sys/INP/CAN2/SignalCheck/IVI2/IVIIONSWCmd"
 /begin REF_CHARACTERISTIC KINP_IVIIONSWCmd_flg_defval KINP_IVIIONSWCmd_flg_ovrdflg KINP_IVIIONSWCmd_flg_ovrdval /end REF_CHARACTERISTIC
/end GROUP
/begin GROUP S774_IVIISAOffsetSpd "SWC_INP_type/run_SWC_INP_5ms_sys/INP/CAN2/SignalCheck/IVI2/IVIISAOffsetSpd"
 /begin REF_CHARACTERISTIC KINP_IVIISAOffsetSpd_enum_defval KINP_IVIISAOffsetSpd_enum_ovrdflg KINP_IVIISAOffsetSpd_enum_ovrdval /end REF_CHARACTERISTIC
/end GROUP
/begin GROUP S774_IVINightModeSta "SWC_INP_type/run_SWC_INP_5ms_sys/INP/CAN2/SignalCheck/IVI2/IVINightModeSta"
 /begin REF_CHARACTERISTIC KINP_IVINightModeSta_flg_defval KINP_IVINightModeSta_flg_ovrdflg KINP_IVINightModeSta_flg_ovrdval /end REF_CHARACTERISTIC
/end GROUP
/begin GROUP S774_IVIPSEATHeaterCmd "SWC_INP_type/run_SWC_INP_5ms_sys/INP/CAN2/SignalCheck/IVI2/IVIPSEATHeaterCmd"
 /begin REF_CHARACTERISTIC KINP_IVIPSEATHeaterCmd_enum_defval KINP_IVIPSEATHeaterCmd_enum_ovrdflg KINP_IVIPSEATHeaterCmd_enum_ovrdval /end REF_CHARACTERISTIC
/end GROUP
/begin GROUP S774_IVIPSEATReclineCmd "SWC_INP_type/run_SWC_INP_5ms_sys/INP/CAN2/SignalCheck/IVI2/IVIPSEATReclineCmd"
 /begin REF_CHARACTERISTIC KINP_IVIPSEATReclineCmd_enum_defval KINP_IVIPSEATReclineCmd_enum_ovrdflg KINP_IVIPSEATReclineCmd_enum_ovrdval /end REF_CHARACTERISTIC
/end GROUP
/begin GROUP S774_IVIPSEATSlideCmd "SWC_INP_type/run_SWC_INP_5ms_sys/INP/CAN2/SignalCheck/IVI2/IVIPSEATSlideCmd"
 /begin REF_CHARACTERISTIC KINP_IVIPSEATSlideCmd_enum_defval KINP_IVIPSEATSlideCmd_enum_ovrdflg KINP_IVIPSEATSlideCmd_enum_ovrdval /end REF_CHARACTERISTIC
/end GROUP
/begin GROUP S774_IVIPTGModeSW "SWC_INP_type/run_SWC_INP_5ms_sys/INP/CAN2/SignalCheck/IVI2/IVIPTGModeSW"
 /begin REF_CHARACTERISTIC KINP_IVIPTGModeSW_enum_defval KINP_IVIPTGModeSW_enum_ovrdflg KINP_IVIPTGModeSW_enum_ovrdval /end REF_CHARACTERISTIC
/end GROUP
/begin GROUP S774_IVIPTGOpenHeight "SWC_INP_type/run_SWC_INP_5ms_sys/INP/CAN2/SignalCheck/IVI2/IVIPTGOpenHeight"
 /begin REF_CHARACTERISTIC KINP_IVIPTGOpenHeight_enum_defval KINP_IVIPTGOpenHeight_enum_ovrdflg KINP_IVIPTGOpenHeight_enum_ovrdval /end REF_CHARACTERISTIC
/end GROUP
/begin GROUP S774_IVIPTGStaSW "SWC_INP_type/run_SWC_INP_5ms_sys/INP/CAN2/SignalCheck/IVI2/IVIPTGStaSW"
 /begin REF_CHARACTERISTIC KINP_IVIPTGStaSW_enum_defval KINP_IVIPTGStaSW_enum_ovrdflg KINP_IVIPTGStaSW_enum_ovrdval /end REF_CHARACTERISTIC
/end GROUP
/begin GROUP S774_IVIPTGUSStaSW "SWC_INP_type/run_SWC_INP_5ms_sys/INP/CAN2/SignalCheck/IVI2/IVIPTGUSStaSW"
 /begin REF_CHARACTERISTIC KINP_IVIPTGUSStaSW_flg_defval KINP_IVIPTGUSStaSW_flg_ovrdflg KINP_IVIPTGUSStaSW_flg_ovrdval /end REF_CHARACTERISTIC
/end GROUP
/begin GROUP S774_IVIPWModeReq "SWC_INP_type/run_SWC_INP_5ms_sys/INP/CAN2/SignalCheck/IVI2/IVIPWModeReq"
 /begin REF_CHARACTERISTIC KINP_IVIPWModeReq_enum_defval KINP_IVIPWModeReq_enum_ovrdflg KINP_IVIPWModeReq_enum_ovrdval /end REF_CHARACTERISTIC
/end GROUP
/begin GROUP S774_IVIPwrLockSW "SWC_INP_type/run_SWC_INP_5ms_sys/INP/CAN2/SignalCheck/IVI2/IVIPwrLockSW"
 /begin REF_CHARACTERISTIC KINP_IVIPwrLockSW_enum_defval KINP_IVIPwrLockSW_enum_ovrdflg KINP_IVIPwrLockSW_enum_ovrdval /end REF_CHARACTERISTIC
/end GROUP
/begin GROUP S774_IVIPwroffreq "SWC_INP_type/run_SWC_INP_5ms_sys/INP/CAN2/SignalCheck/IVI2/IVIPwroffreq"
 /begin REF_CHARACTERISTIC KINP_IVIPwroffreq_flg_defval KINP_IVIPwroffreq_flg_ovrdflg KINP_IVIPwroffreq_flg_ovrdval /end REF_CHARACTERISTIC
/end GROUP
/begin GROUP S774_IVIRRDefReq "SWC_INP_type/run_SWC_INP_5ms_sys/INP/CAN2/SignalCheck/IVI2/IVIRRDefReq"
 /begin REF_CHARACTERISTIC KINP_IVIRRDefReq_flg_defval KINP_IVIRRDefReq_flg_ovrdflg KINP_IVIRRDefReq_flg_ovrdval /end REF_CHARACTERISTIC
/end GROUP
/begin GROUP S774_IVIReqV2L "SWC_INP_type/run_SWC_INP_5ms_sys/INP/CAN2/SignalCheck/IVI2/IVIReqV2L"
 /begin REF_CHARACTERISTIC KINP_IVIReqV2L_enum_defval KINP_IVIReqV2L_enum_ovrdflg KINP_IVIReqV2L_enum_ovrdval /end REF_CHARACTERISTIC
/end GROUP
/begin GROUP S774_IVISWCRUndefinedSta "SWC_INP_type/run_SWC_INP_5ms_sys/INP/CAN2/SignalCheck/IVI2/IVISWCRUndefinedSta"
 /begin REF_CHARACTERISTIC KINP_IVISWCRUndefinedSta_enum_defval KINP_IVISWCRUndefinedSta_enum_ovrdflg KINP_IVISWCRUndefinedSta_enum_ovrdval /end REF_CHARACTERISTIC
/end GROUP
/begin GROUP S774_IVIScreen "SWC_INP_type/run_SWC_INP_5ms_sys/INP/CAN2/SignalCheck/IVI2/IVIScreen"
 /begin REF_CHARACTERISTIC KINP_IVIScreen_enum_defval KINP_IVIScreen_enum_ovrdflg KINP_IVIScreen_enum_ovrdval /end REF_CHARACTERISTIC
/end GROUP
/begin GROUP S774_IVIStartChgreq "SWC_INP_type/run_SWC_INP_5ms_sys/INP/CAN2/SignalCheck/IVI2/IVIStartChgreq"
 /begin REF_CHARACTERISTIC KINP_IVIStartChgreq_flg_defval KINP_IVIStartChgreq_flg_ovrdflg KINP_IVIStartChgreq_flg_ovrdval /end REF_CHARACTERISTIC
/end GROUP
/begin GROUP S774_IVIStatus "SWC_INP_type/run_SWC_INP_5ms_sys/INP/CAN2/SignalCheck/IVI2/IVIStatus"
 /begin REF_CHARACTERISTIC KINP_IVIStatus_flg_defval KINP_IVIStatus_flg_ovrdflg KINP_IVIStatus_flg_ovrdval /end REF_CHARACTERISTIC
/end GROUP
/begin GROUP S774_IVIStopChgreq "SWC_INP_type/run_SWC_INP_5ms_sys/INP/CAN2/SignalCheck/IVI2/IVIStopChgreq"
 /begin REF_CHARACTERISTIC KINP_IVIStopChgreq_flg_defval KINP_IVIStopChgreq_flg_ovrdflg KINP_IVIStopChgreq_flg_ovrdval /end REF_CHARACTERISTIC
/end GROUP
/begin GROUP S774_IVITrailerCheckReqSta "SWC_INP_type/run_SWC_INP_5ms_sys/INP/CAN2/SignalCheck/IVI2/IVITrailerCheckReqSta"
 /begin REF_CHARACTERISTIC KINP_IVITrailerCheckReqSta_flg_defval KINP_IVITrailerCheckReqSta_flg_ovrdflg KINP_IVITrailerCheckReqSta_flg_ovrdval /end REF_CHARACTERISTIC
/end GROUP
/begin GROUP S774_IVITrailerModeSWSta "SWC_INP_type/run_SWC_INP_5ms_sys/INP/CAN2/SignalCheck/IVI2/IVITrailerModeSWSta"
 /begin REF_CHARACTERISTIC KINP_IVITrailerModeSWSta_flg_defval KINP_IVITrailerModeSWSta_flg_ovrdflg KINP_IVITrailerModeSWSta_flg_ovrdval /end REF_CHARACTERISTIC
/end GROUP
/begin GROUP S774_IVITriggerreq "SWC_INP_type/run_SWC_INP_5ms_sys/INP/CAN2/SignalCheck/IVI2/IVITriggerreq"
 /begin REF_CHARACTERISTIC KINP_IVITriggerreq_flg_defval KINP_IVITriggerreq_flg_ovrdflg KINP_IVITriggerreq_flg_ovrdval /end REF_CHARACTERISTIC
/end GROUP
/begin GROUP S774_IVIUnlockChgreq "SWC_INP_type/run_SWC_INP_5ms_sys/INP/CAN2/SignalCheck/IVI2/IVIUnlockChgreq"
 /begin REF_CHARACTERISTIC KINP_IVIUnlockChgreq_flg_defval KINP_IVIUnlockChgreq_flg_ovrdflg KINP_IVIUnlockChgreq_flg_ovrdval /end REF_CHARACTERISTIC
/end GROUP
/begin GROUP S774_IVIWIMAINSW "SWC_INP_type/run_SWC_INP_5ms_sys/INP/CAN2/SignalCheck/IVI2/IVIWIMAINSW"
 /begin REF_CHARACTERISTIC KINP_IVIWIMAINSW_flg_defval KINP_IVIWIMAINSW_flg_ovrdflg KINP_IVIWIMAINSW_flg_ovrdval /end REF_CHARACTERISTIC
/end GROUP
/begin GROUP S774_LDrvControlCommand "SWC_INP_type/run_SWC_INP_5ms_sys/INP/CAN2/SignalCheck/IVI2/LDrvControlCommand"
 /begin REF_CHARACTERISTIC KINP_LDrvControlCommand_pct_defval KINP_LDrvControlCommand_pct_ovrdflg KINP_LDrvControlCommand_pct_ovrdval /end REF_CHARACTERISTIC
/end GROUP
/begin GROUP S774_LPasControlCommand "SWC_INP_type/run_SWC_INP_5ms_sys/INP/CAN2/SignalCheck/IVI2/LPasControlCommand"
 /begin REF_CHARACTERISTIC KINP_LPasControlCommand_pct_defval KINP_LPasControlCommand_pct_ovrdflg KINP_LPasControlCommand_pct_ovrdval /end REF_CHARACTERISTIC
/end GROUP
/begin GROUP S774_LRLDControlCommand "SWC_INP_type/run_SWC_INP_5ms_sys/INP/CAN2/SignalCheck/IVI2/LRLDControlCommand"
 /begin REF_CHARACTERISTIC KINP_LRLDControlCommand_pct_defval KINP_LRLDControlCommand_pct_ovrdflg KINP_LRLDControlCommand_pct_ovrdval /end REF_CHARACTERISTIC
/end GROUP
/begin GROUP S774_LRRDControlCommand "SWC_INP_type/run_SWC_INP_5ms_sys/INP/CAN2/SignalCheck/IVI2/LRRDControlCommand"
 /begin REF_CHARACTERISTIC KINP_LRRDControlCommand_pct_defval KINP_LRRDControlCommand_pct_ovrdflg KINP_LRRDControlCommand_pct_ovrdval /end REF_CHARACTERISTIC
/end GROUP
/begin GROUP S774_LightShowStartReq "SWC_INP_type/run_SWC_INP_5ms_sys/INP/CAN2/SignalCheck/IVI2/LightShowStartReq"
 /begin REF_CHARACTERISTIC KINP_LightShowStartReq_flg_defval KINP_LightShowStartReq_flg_ovrdflg KINP_LightShowStartReq_flg_ovrdval /end REF_CHARACTERISTIC
/end GROUP
/begin GROUP S774_LightShowStopReq "SWC_INP_type/run_SWC_INP_5ms_sys/INP/CAN2/SignalCheck/IVI2/LightShowStopReq"
 /begin REF_CHARACTERISTIC KINP_LightShowStopReq_flg_defval KINP_LightShowStopReq_flg_ovrdflg KINP_LightShowStopReq_flg_ovrdval /end REF_CHARACTERISTIC
/end GROUP
/begin GROUP S774_MFRDNBrightReq "SWC_INP_type/run_SWC_INP_5ms_sys/INP/CAN2/SignalCheck/IVI2/MFRDNBrightReq"
 /begin REF_CHARACTERISTIC KINP_MFRDNBrightReq_pct_defval KINP_MFRDNBrightReq_pct_ovrdflg KINP_MFRDNBrightReq_pct_ovrdval /end REF_CHARACTERISTIC
/end GROUP
/begin GROUP S774_OFFACMODE "SWC_INP_type/run_SWC_INP_5ms_sys/INP/CAN2/SignalCheck/IVI2/OFFACMODE"
 /begin REF_CHARACTERISTIC KINP_OFFACMODE_enum_defval KINP_OFFACMODE_enum_ovrdflg KINP_OFFACMODE_enum_ovrdval /end REF_CHARACTERISTIC
/end GROUP
/begin GROUP S774_PSEATventreq "SWC_INP_type/run_SWC_INP_5ms_sys/INP/CAN2/SignalCheck/IVI2/PSEATventreq"
 /begin REF_CHARACTERISTIC KINP_PSEATventreq_enum_defval KINP_PSEATventreq_enum_ovrdflg KINP_PSEATventreq_enum_ovrdval /end REF_CHARACTERISTIC
/end GROUP
/begin GROUP S774_PerdV2L "SWC_INP_type/run_SWC_INP_5ms_sys/INP/CAN2/SignalCheck/IVI2/PerdV2L"
 /begin REF_CHARACTERISTIC KINP_PerdV2L_enum_defval KINP_PerdV2L_enum_ovrdflg KINP_PerdV2L_enum_ovrdval /end REF_CHARACTERISTIC
/end GROUP
/begin GROUP S774_RFogLampSW "SWC_INP_type/run_SWC_INP_5ms_sys/INP/CAN2/SignalCheck/IVI2/RFogLampSW"
 /begin REF_CHARACTERISTIC KINP_RFogLampSW_flg_defval KINP_RFogLampSW_flg_ovrdflg KINP_RFogLampSW_flg_ovrdval /end REF_CHARACTERISTIC
/end GROUP
/begin GROUP S774_RollModeSWCmd "SWC_INP_type/run_SWC_INP_5ms_sys/INP/CAN2/SignalCheck/IVI2/RollModeSWCmd"
 /begin REF_CHARACTERISTIC KINP_RollModeSWCmd_enum_defval KINP_RollModeSWCmd_enum_ovrdflg KINP_RollModeSWCmd_enum_ovrdval /end REF_CHARACTERISTIC
/end GROUP
/begin GROUP S774_RoomLampMode "SWC_INP_type/run_SWC_INP_5ms_sys/INP/CAN2/SignalCheck/IVI2/RoomLampMode"
 /begin REF_CHARACTERISTIC KINP_RoomLampMode_flg_defval KINP_RoomLampMode_flg_ovrdflg KINP_RoomLampMode_flg_ovrdval /end REF_CHARACTERISTIC
/end GROUP
/begin GROUP S774_SOCADJBUTT "SWC_INP_type/run_SWC_INP_5ms_sys/INP/CAN2/SignalCheck/IVI2/SOCADJBUTT"
 /begin REF_CHARACTERISTIC KINP_SOCADJBUTT_flg_defval KINP_SOCADJBUTT_flg_ovrdflg KINP_SOCADJBUTT_flg_ovrdval /end REF_CHARACTERISTIC
/end GROUP
/begin GROUP S774_SOCLimitSet "SWC_INP_type/run_SWC_INP_5ms_sys/INP/CAN2/SignalCheck/IVI2/SOCLimitSet"
 /begin REF_CHARACTERISTIC KINP_SOCLimitSet_pct_defval KINP_SOCLimitSet_pct_ovrdflg KINP_SOCLimitSet_pct_ovrdval /end REF_CHARACTERISTIC
/end GROUP
/begin GROUP S774_SOCV2LLimit "SWC_INP_type/run_SWC_INP_5ms_sys/INP/CAN2/SignalCheck/IVI2/SOCV2LLimit"
 /begin REF_CHARACTERISTIC KINP_SOCV2LLimit_pct_defval KINP_SOCV2LLimit_pct_ovrdflg KINP_SOCV2LLimit_pct_ovrdval /end REF_CHARACTERISTIC
/end GROUP
/begin GROUP S774_SchedChgStart "SWC_INP_type/run_SWC_INP_5ms_sys/INP/CAN2/SignalCheck/IVI2/SchedChgStart"
 /begin REF_CHARACTERISTIC KINP_SchedChgStart_flg_defval KINP_SchedChgStart_flg_ovrdflg KINP_SchedChgStart_flg_ovrdval /end REF_CHARACTERISTIC
/end GROUP
/begin GROUP S774_SchedChgStop "SWC_INP_type/run_SWC_INP_5ms_sys/INP/CAN2/SignalCheck/IVI2/SchedChgStop"
 /begin REF_CHARACTERISTIC KINP_SchedChgStop_flg_defval KINP_SchedChgStop_flg_ovrdflg KINP_SchedChgStop_flg_ovrdval /end REF_CHARACTERISTIC
/end GROUP
/begin GROUP S774_SchedChgbutt "SWC_INP_type/run_SWC_INP_5ms_sys/INP/CAN2/SignalCheck/IVI2/SchedChgbutt"
 /begin REF_CHARACTERISTIC KINP_SchedChgbutt_flg_defval KINP_SchedChgbutt_flg_ovrdflg KINP_SchedChgbutt_flg_ovrdval /end REF_CHARACTERISTIC
/end GROUP
/begin GROUP S774_SchedChglimit "SWC_INP_type/run_SWC_INP_5ms_sys/INP/CAN2/SignalCheck/IVI2/SchedChglimit"
 /begin REF_CHARACTERISTIC KINP_SchedChglimit_pct_defval KINP_SchedChglimit_pct_ovrdflg KINP_SchedChglimit_pct_ovrdval /end REF_CHARACTERISTIC
/end GROUP
/begin GROUP S774_SchedChgwake "SWC_INP_type/run_SWC_INP_5ms_sys/INP/CAN2/SignalCheck/IVI2/SchedChgwake"
 /begin REF_CHARACTERISTIC KINP_SchedChgwake_flg_defval KINP_SchedChgwake_flg_ovrdflg KINP_SchedChgwake_flg_ovrdval /end REF_CHARACTERISTIC
/end GROUP
/begin GROUP S774_SenstivityPosition "SWC_INP_type/run_SWC_INP_5ms_sys/INP/CAN2/SignalCheck/IVI2/SenstivityPosition"
 /begin REF_CHARACTERISTIC KINP_SenstivityPosition_enum_defval KINP_SenstivityPosition_enum_ovrdflg KINP_SenstivityPosition_enum_ovrdval /end REF_CHARACTERISTIC
/end GROUP
/begin GROUP S774_SetUnlockSingle "SWC_INP_type/run_SWC_INP_5ms_sys/INP/CAN2/SignalCheck/IVI2/SetUnlockSingle"
 /begin REF_CHARACTERISTIC KINP_SetUnlockSingle_flg_defval KINP_SetUnlockSingle_flg_ovrdflg KINP_SetUnlockSingle_flg_ovrdval /end REF_CHARACTERISTIC
/end GROUP
/begin GROUP S774_TCSSWCmd "SWC_INP_type/run_SWC_INP_5ms_sys/INP/CAN2/SignalCheck/IVI2/TCSSWCmd"
 /begin REF_CHARACTERISTIC KINP_TCSSWCmd_enum_defval KINP_TCSSWCmd_enum_ovrdflg KINP_TCSSWCmd_enum_ovrdval /end REF_CHARACTERISTIC
/end GROUP
/begin GROUP S774_TPMSCaliButt "SWC_INP_type/run_SWC_INP_5ms_sys/INP/CAN2/SignalCheck/IVI2/TPMSCaliButt"
 /begin REF_CHARACTERISTIC KINP_TPMSCaliButt_flg_defval KINP_TPMSCaliButt_flg_ovrdflg KINP_TPMSCaliButt_flg_ovrdval /end REF_CHARACTERISTIC
/end GROUP
/begin GROUP S774_TPMSResButt "SWC_INP_type/run_SWC_INP_5ms_sys/INP/CAN2/SignalCheck/IVI2/TPMSResButt"
 /begin REF_CHARACTERISTIC KINP_TPMSResButt_flg_defval KINP_TPMSResButt_flg_ovrdflg KINP_TPMSResButt_flg_ovrdval /end REF_CHARACTERISTIC
/end GROUP
/begin GROUP S774_TurnSwTimeSet "SWC_INP_type/run_SWC_INP_5ms_sys/INP/CAN2/SignalCheck/IVI2/TurnSwTimeSet"
 /begin REF_CHARACTERISTIC KINP_TurnSwTimeSet_enum_defval KINP_TurnSwTimeSet_enum_ovrdflg KINP_TurnSwTimeSet_enum_ovrdval /end REF_CHARACTERISTIC
/end GROUP
/begin GROUP S774_WalkawayLockSW "SWC_INP_type/run_SWC_INP_5ms_sys/INP/CAN2/SignalCheck/IVI2/WalkawayLockSW"
 /begin REF_CHARACTERISTIC KINP_WalkawayLockSW_flg_defval KINP_WalkawayLockSW_flg_ovrdflg KINP_WalkawayLockSW_flg_ovrdval /end REF_CHARACTERISTIC
/end GROUP
/begin GROUP S774_WlcmLightMode "SWC_INP_type/run_SWC_INP_5ms_sys/INP/CAN2/SignalCheck/IVI2/WlcmLightMode"
 /begin REF_CHARACTERISTIC KINP_WlcmLightMode_enum_defval KINP_WlcmLightMode_enum_ovrdflg KINP_WlcmLightMode_enum_ovrdval /end REF_CHARACTERISTIC
/end GROUP
/begin GROUP S774_sigAirIntenZon1Req "SWC_INP_type/run_SWC_INP_5ms_sys/INP/CAN2/SignalCheck/IVI2/sigAirIntenZon1Req"
 /begin REF_CHARACTERISTIC KINP_sigAirIntenZon1Req_enum_defval KINP_sigAirIntenZon1Req_enum_ovrdflg KINP_sigAirIntenZon1Req_enum_ovrdval /end REF_CHARACTERISTIC
/end GROUP
/begin GROUP S774_sigDfrstReq "SWC_INP_type/run_SWC_INP_5ms_sys/INP/CAN2/SignalCheck/IVI2/sigDfrstReq"
 /begin REF_CHARACTERISTIC KINP_sigDfrstReq_flg_defval KINP_sigDfrstReq_flg_ovrdflg KINP_sigDfrstReq_flg_ovrdval /end REF_CHARACTERISTIC
/end GROUP
/begin GROUP S774_sigFaceReq "SWC_INP_type/run_SWC_INP_5ms_sys/INP/CAN2/SignalCheck/IVI2/sigFaceReq"
 /begin REF_CHARACTERISTIC KINP_sigFaceReq_flg_defval KINP_sigFaceReq_flg_ovrdflg KINP_sigFaceReq_flg_ovrdval /end REF_CHARACTERISTIC
/end GROUP
/begin GROUP S774_sigFootReq "SWC_INP_type/run_SWC_INP_5ms_sys/INP/CAN2/SignalCheck/IVI2/sigFootReq"
 /begin REF_CHARACTERISTIC KINP_sigFootReq_flg_defval KINP_sigFootReq_flg_ovrdflg KINP_sigFootReq_flg_ovrdval /end REF_CHARACTERISTIC
/end GROUP
/begin GROUP S774_sigRecircReq "SWC_INP_type/run_SWC_INP_5ms_sys/INP/CAN2/SignalCheck/IVI2/sigRecircReq"
 /begin REF_CHARACTERISTIC KINP_sigRecircReq_flg_defval KINP_sigRecircReq_flg_ovrdflg KINP_sigRecircReq_flg_ovrdval /end REF_CHARACTERISTIC
/end GROUP
/begin GROUP S774_sigSetTempZon1Req "SWC_INP_type/run_SWC_INP_5ms_sys/INP/CAN2/SignalCheck/IVI2/sigSetTempZon1Req"
 /begin REF_CHARACTERISTIC KINP_sigSetTempZon1Req_C_defval KINP_sigSetTempZon1Req_C_ovrdflg KINP_sigSetTempZon1Req_C_ovrdval /end REF_CHARACTERISTIC
/end GROUP
/begin GROUP S774_sigSetTempZon2Req "SWC_INP_type/run_SWC_INP_5ms_sys/INP/CAN2/SignalCheck/IVI2/sigSetTempZon2Req"
 /begin REF_CHARACTERISTIC KINP_sigSetTempZon2Req_C_defval KINP_sigSetTempZon2Req_C_ovrdflg KINP_sigSetTempZon2Req_C_ovrdval /end REF_CHARACTERISTIC
/end GROUP
/begin GROUP S775_IVICLBlowerYSta "SWC_INP_type/run_SWC_INP_5ms_sys/INP/CAN2/SignalCheck/IVI3/IVICLBlowerYSta"
 /begin REF_CHARACTERISTIC KINP_IVICLBlowerYSta_pct_defval KINP_IVICLBlowerYSta_pct_ovrdflg KINP_IVICLBlowerYSta_pct_ovrdval /end REF_CHARACTERISTIC
/end GROUP
/begin GROUP S775_IVICLBlowerZSta "SWC_INP_type/run_SWC_INP_5ms_sys/INP/CAN2/SignalCheck/IVI3/IVICLBlowerZSta"
 /begin REF_CHARACTERISTIC KINP_IVICLBlowerZSta_pct_defval KINP_IVICLBlowerZSta_pct_ovrdflg KINP_IVICLBlowerZSta_pct_ovrdval /end REF_CHARACTERISTIC
/end GROUP
/begin GROUP S775_IVICRBlowerYSta "SWC_INP_type/run_SWC_INP_5ms_sys/INP/CAN2/SignalCheck/IVI3/IVICRBlowerYSta"
 /begin REF_CHARACTERISTIC KINP_IVICRBlowerYSta_pct_defval KINP_IVICRBlowerYSta_pct_ovrdflg KINP_IVICRBlowerYSta_pct_ovrdval /end REF_CHARACTERISTIC
/end GROUP
/begin GROUP S775_IVICRBlowerZSta "SWC_INP_type/run_SWC_INP_5ms_sys/INP/CAN2/SignalCheck/IVI3/IVICRBlowerZSta"
 /begin REF_CHARACTERISTIC KINP_IVICRBlowerZSta_pct_defval KINP_IVICRBlowerZSta_pct_ovrdflg KINP_IVICRBlowerZSta_pct_ovrdval /end REF_CHARACTERISTIC
/end GROUP
/begin GROUP S775_IVIHMICustmiFunSta "SWC_INP_type/run_SWC_INP_5ms_sys/INP/CAN2/SignalCheck/IVI3/IVIHMICustmiFunSta"
 /begin REF_CHARACTERISTIC KINP_IVIHMICustmiFunSta_enum_defval KINP_IVIHMICustmiFunSta_enum_ovrdflg KINP_IVIHMICustmiFunSta_enum_ovrdval /end REF_CHARACTERISTIC
/end GROUP
/begin GROUP S775_IVIHMICustmiKEYSta "SWC_INP_type/run_SWC_INP_5ms_sys/INP/CAN2/SignalCheck/IVI3/IVIHMICustmiKEYSta"
 /begin REF_CHARACTERISTIC KINP_IVIHMICustmiKEYSta_enum_defval KINP_IVIHMICustmiKEYSta_enum_ovrdflg KINP_IVIHMICustmiKEYSta_enum_ovrdval /end REF_CHARACTERISTIC
/end GROUP
/begin GROUP S775_IVILBlowerModeSta "SWC_INP_type/run_SWC_INP_5ms_sys/INP/CAN2/SignalCheck/IVI3/IVILBlowerModeSta"
 /begin REF_CHARACTERISTIC KINP_IVILBlowerModeSta_enum_defval KINP_IVILBlowerModeSta_enum_ovrdflg KINP_IVILBlowerModeSta_enum_ovrdval /end REF_CHARACTERISTIC
/end GROUP
/begin GROUP S775_IVILBlowerYSta "SWC_INP_type/run_SWC_INP_5ms_sys/INP/CAN2/SignalCheck/IVI3/IVILBlowerYSta"
 /begin REF_CHARACTERISTIC KINP_IVILBlowerYSta_pct_defval KINP_IVILBlowerYSta_pct_ovrdflg KINP_IVILBlowerYSta_pct_ovrdval /end REF_CHARACTERISTIC
/end GROUP
/begin GROUP S775_IVILBlowerZSta "SWC_INP_type/run_SWC_INP_5ms_sys/INP/CAN2/SignalCheck/IVI3/IVILBlowerZSta"
 /begin REF_CHARACTERISTIC KINP_IVILBlowerZSta_pct_defval KINP_IVILBlowerZSta_pct_ovrdflg KINP_IVILBlowerZSta_pct_ovrdval /end REF_CHARACTERISTIC
/end GROUP
/begin GROUP S775_IVILSEATventCmd "SWC_INP_type/run_SWC_INP_5ms_sys/INP/CAN2/SignalCheck/IVI3/IVILSEATventCmd"
 /begin REF_CHARACTERISTIC KINP_IVILSEATventCmd_enum_defval KINP_IVILSEATventCmd_enum_ovrdflg KINP_IVILSEATventCmd_enum_ovrdval /end REF_CHARACTERISTIC
/end GROUP
/begin GROUP S775_IVIMLFMostCmd "SWC_INP_type/run_SWC_INP_5ms_sys/INP/CAN2/SignalCheck/IVI3/IVIMLFMostCmd"
 /begin REF_CHARACTERISTIC KINP_IVIMLFMostCmd_flg_defval KINP_IVIMLFMostCmd_flg_ovrdflg KINP_IVIMLFMostCmd_flg_ovrdval /end REF_CHARACTERISTIC
/end GROUP
/begin GROUP S775_IVIMLFootLiftCmd "SWC_INP_type/run_SWC_INP_5ms_sys/INP/CAN2/SignalCheck/IVI3/IVIMLFootLiftCmd"
 /begin REF_CHARACTERISTIC KINP_IVIMLFootLiftCmd_enum_defval KINP_IVIMLFootLiftCmd_enum_ovrdflg KINP_IVIMLFootLiftCmd_enum_ovrdval /end REF_CHARACTERISTIC
/end GROUP
/begin GROUP S775_IVIMLNapModeCmd "SWC_INP_type/run_SWC_INP_5ms_sys/INP/CAN2/SignalCheck/IVI3/IVIMLNapModeCmd"
 /begin REF_CHARACTERISTIC KINP_IVIMLNapModeCmd_flg_defval KINP_IVIMLNapModeCmd_flg_ovrdflg KINP_IVIMLNapModeCmd_flg_ovrdval /end REF_CHARACTERISTIC
/end GROUP
/begin GROUP S775_IVIMLReclinerCmd "SWC_INP_type/run_SWC_INP_5ms_sys/INP/CAN2/SignalCheck/IVI3/IVIMLReclinerCmd"
 /begin REF_CHARACTERISTIC KINP_IVIMLReclinerCmd_enum_defval KINP_IVIMLReclinerCmd_enum_ovrdflg KINP_IVIMLReclinerCmd_enum_ovrdval /end REF_CHARACTERISTIC
/end GROUP
/begin GROUP S775_IVIMLRestoreCmd "SWC_INP_type/run_SWC_INP_5ms_sys/INP/CAN2/SignalCheck/IVI3/IVIMLRestoreCmd"
 /begin REF_CHARACTERISTIC KINP_IVIMLRestoreCmd_flg_defval KINP_IVIMLRestoreCmd_flg_ovrdflg KINP_IVIMLRestoreCmd_flg_ovrdval /end REF_CHARACTERISTIC
/end GROUP
/begin GROUP S775_IVIMLSEATventCmd "SWC_INP_type/run_SWC_INP_5ms_sys/INP/CAN2/SignalCheck/IVI3/IVIMLSEATventCmd"
 /begin REF_CHARACTERISTIC KINP_IVIMLSEATventCmd_enum_defval KINP_IVIMLSEATventCmd_enum_ovrdflg KINP_IVIMLSEATventCmd_enum_ovrdval /end REF_CHARACTERISTIC
/end GROUP
/begin GROUP S775_IVIMLSeatLiftCmd "SWC_INP_type/run_SWC_INP_5ms_sys/INP/CAN2/SignalCheck/IVI3/IVIMLSeatLiftCmd"
 /begin REF_CHARACTERISTIC KINP_IVIMLSeatLiftCmd_enum_defval KINP_IVIMLSeatLiftCmd_enum_ovrdflg KINP_IVIMLSeatLiftCmd_enum_ovrdval /end REF_CHARACTERISTIC
/end GROUP
/begin GROUP S775_IVIMLSldRestoreCmd "SWC_INP_type/run_SWC_INP_5ms_sys/INP/CAN2/SignalCheck/IVI3/IVIMLSldRestoreCmd"
 /begin REF_CHARACTERISTIC KINP_IVIMLSldRestoreCmd_flg_defval KINP_IVIMLSldRestoreCmd_flg_ovrdflg KINP_IVIMLSldRestoreCmd_flg_ovrdval /end REF_CHARACTERISTIC
/end GROUP
/begin GROUP S775_IVIMLSliderCmd "SWC_INP_type/run_SWC_INP_5ms_sys/INP/CAN2/SignalCheck/IVI3/IVIMLSliderCmd"
 /begin REF_CHARACTERISTIC KINP_IVIMLSliderCmd_enum_defval KINP_IVIMLSliderCmd_enum_ovrdflg KINP_IVIMLSliderCmd_enum_ovrdval /end REF_CHARACTERISTIC
/end GROUP
/begin GROUP S775_IVIMLZeroGravityCmd "SWC_INP_type/run_SWC_INP_5ms_sys/INP/CAN2/SignalCheck/IVI3/IVIMLZeroGravityCmd"
 /begin REF_CHARACTERISTIC KINP_IVIMLZeroGravityCmd_flg_defval KINP_IVIMLZeroGravityCmd_flg_ovrdflg KINP_IVIMLZeroGravityCmd_flg_ovrdval /end REF_CHARACTERISTIC
/end GROUP
/begin GROUP S775_IVIMRFMostCmd "SWC_INP_type/run_SWC_INP_5ms_sys/INP/CAN2/SignalCheck/IVI3/IVIMRFMostCmd"
 /begin REF_CHARACTERISTIC KINP_IVIMRFMostCmd_flg_defval KINP_IVIMRFMostCmd_flg_ovrdflg KINP_IVIMRFMostCmd_flg_ovrdval /end REF_CHARACTERISTIC
/end GROUP
/begin GROUP S775_IVIMRFootLiftCmd "SWC_INP_type/run_SWC_INP_5ms_sys/INP/CAN2/SignalCheck/IVI3/IVIMRFootLiftCmd"
 /begin REF_CHARACTERISTIC KINP_IVIMRFootLiftCmd_enum_defval KINP_IVIMRFootLiftCmd_enum_ovrdflg KINP_IVIMRFootLiftCmd_enum_ovrdval /end REF_CHARACTERISTIC
/end GROUP
/begin GROUP S775_IVIMRNapModeCmd "SWC_INP_type/run_SWC_INP_5ms_sys/INP/CAN2/SignalCheck/IVI3/IVIMRNapModeCmd"
 /begin REF_CHARACTERISTIC KINP_IVIMRNapModeCmd_flg_defval KINP_IVIMRNapModeCmd_flg_ovrdflg KINP_IVIMRNapModeCmd_flg_ovrdval /end REF_CHARACTERISTIC
/end GROUP
/begin GROUP S775_IVIMRReclinerCmd "SWC_INP_type/run_SWC_INP_5ms_sys/INP/CAN2/SignalCheck/IVI3/IVIMRReclinerCmd"
 /begin REF_CHARACTERISTIC KINP_IVIMRReclinerCmd_enum_defval KINP_IVIMRReclinerCmd_enum_ovrdflg KINP_IVIMRReclinerCmd_enum_ovrdval /end REF_CHARACTERISTIC
/end GROUP
/begin GROUP S775_IVIMRRestoreCmd "SWC_INP_type/run_SWC_INP_5ms_sys/INP/CAN2/SignalCheck/IVI3/IVIMRRestoreCmd"
 /begin REF_CHARACTERISTIC KINP_IVIMRRestoreCmd_flg_defval KINP_IVIMRRestoreCmd_flg_ovrdflg KINP_IVIMRRestoreCmd_flg_ovrdval /end REF_CHARACTERISTIC
/end GROUP
/begin GROUP S775_IVIMRSEATventCmd "SWC_INP_type/run_SWC_INP_5ms_sys/INP/CAN2/SignalCheck/IVI3/IVIMRSEATventCmd"
 /begin REF_CHARACTERISTIC KINP_IVIMRSEATventCmd_enum_defval KINP_IVIMRSEATventCmd_enum_ovrdflg KINP_IVIMRSEATventCmd_enum_ovrdval /end REF_CHARACTERISTIC
/end GROUP
/begin GROUP S775_IVIMRSeatLiftCmd "SWC_INP_type/run_SWC_INP_5ms_sys/INP/CAN2/SignalCheck/IVI3/IVIMRSeatLiftCmd"
 /begin REF_CHARACTERISTIC KINP_IVIMRSeatLiftCmd_enum_defval KINP_IVIMRSeatLiftCmd_enum_ovrdflg KINP_IVIMRSeatLiftCmd_enum_ovrdval /end REF_CHARACTERISTIC
/end GROUP
/begin GROUP S775_IVIMRSldRestoreCmd "SWC_INP_type/run_SWC_INP_5ms_sys/INP/CAN2/SignalCheck/IVI3/IVIMRSldRestoreCmd"
 /begin REF_CHARACTERISTIC KINP_IVIMRSldRestoreCmd_flg_defval KINP_IVIMRSldRestoreCmd_flg_ovrdflg KINP_IVIMRSldRestoreCmd_flg_ovrdval /end REF_CHARACTERISTIC
/end GROUP
/begin GROUP S775_IVIMRSliderCmd "SWC_INP_type/run_SWC_INP_5ms_sys/INP/CAN2/SignalCheck/IVI3/IVIMRSliderCmd"
 /begin REF_CHARACTERISTIC KINP_IVIMRSliderCmd_enum_defval KINP_IVIMRSliderCmd_enum_ovrdflg KINP_IVIMRSliderCmd_enum_ovrdval /end REF_CHARACTERISTIC
/end GROUP
/begin GROUP S775_IVIMRZeroGravityCmd "SWC_INP_type/run_SWC_INP_5ms_sys/INP/CAN2/SignalCheck/IVI3/IVIMRZeroGravityCmd"
 /begin REF_CHARACTERISTIC KINP_IVIMRZeroGravityCmd_flg_defval KINP_IVIMRZeroGravityCmd_flg_ovrdflg KINP_IVIMRZeroGravityCmd_flg_ovrdval /end REF_CHARACTERISTIC
/end GROUP
/begin GROUP S775_IVIRBlowerModeSta "SWC_INP_type/run_SWC_INP_5ms_sys/INP/CAN2/SignalCheck/IVI3/IVIRBlowerModeSta"
 /begin REF_CHARACTERISTIC KINP_IVIRBlowerModeSta_enum_defval KINP_IVIRBlowerModeSta_enum_ovrdflg KINP_IVIRBlowerModeSta_enum_ovrdval /end REF_CHARACTERISTIC
/end GROUP
/begin GROUP S775_IVIRBlowerYSta "SWC_INP_type/run_SWC_INP_5ms_sys/INP/CAN2/SignalCheck/IVI3/IVIRBlowerYSta"
 /begin REF_CHARACTERISTIC KINP_IVIRBlowerYSta_pct_defval KINP_IVIRBlowerYSta_pct_ovrdflg KINP_IVIRBlowerYSta_pct_ovrdval /end REF_CHARACTERISTIC
/end GROUP
/end MODULE
/end PROJECT
