AUTOSAR XML (schema 4-3-0)
package /CAN6/ISignalGroup
  i signal group CAN6_SG_FD6_C200_0: i-signal=CAN6_SysPowerMode, system-signal-group=CAN6_SG_FD6_C200_0
package /CAN6/Cluster
  can cluster CAN6: baudrate=500, can-fd-baudrate=2000
    can physical channel CAN6: comm-connectors=ConnCAN6
      frame CAN6_DiagFuncReqFT: id 0x7D0, frame-length=8, can-addressing-mode=STANDARD, can-fd-frame-support=false, can-frame-rx-behavior=CAN-20, can-frame-tx-behavior=CAN-20
        n pdu CAN6_DiagFuncReqFT: length=8
      frame CAN6_FD6_C200_0: id 0x20C, frame-length=32, can-addressing-mode=STANDARD, can-fd-frame-support=true, can-frame-rx-behavior=CAN-FD, can-frame-tx-behavior=CAN-FD
        pdu CAN6_FD6_C200_0: length=32, minimum-delay=0.0, transmission-mode-true-timing=cyclic-timing=time-period=0.2, unused-bit-pattern=0
          mapping CAN6_SG_FD6_C200_0: i-signal-group=CAN6_SG_FD6_C200_0, start-position=0, transfer-property=PENDING
          signal CAN6_SysPowerMode: start 0, 4 bit, little-endian, i-signal-type=PRIMITIVE, init-value=constant-reference=Init_CAN6_SysPowerMode, base-type=uint8, implementation-data-type=uint8, transfer-property=PENDING
      frame CAN6_NMm_FUSION_TX: id 0x500, frame-length=8, can-addressing-mode=STANDARD, can-fd-frame-support=false, can-frame-rx-behavior=CAN-20, can-frame-tx-behavior=CAN-20
        nm pdu CAN6_NMm_FUSION_TX: length=8, unused-bit-pattern=0
      frame CAN6_NMm_FUSION_RX: id 0x500, frame-length=8, can-addressing-mode=STANDARD, can-fd-frame-support=false, can-frame-rx-behavior=CAN-20, can-frame-tx-behavior=CAN-20
        nm pdu CAN6_NMm_FUSION_RX: length=8, unused-bit-pattern=0
package /CAN6/ConstantSpecification
  constant specification Init_CAN6_SysPowerMode: value-spec=0
  constant specification Init_CAN6_SG_FD6_C200_0: value-spec=fields=constant-reference=Init_CAN6_SysPowerMode
package /CAN6/ImplementationDataTypes
  impl type DT_CAN6_SG_FD6_C200_0: category=STRUCTURE
    element CAN6_SysPowerMode: implementation-data-type=uint8
