/******************************************************************************
* ASAP2 file: SWC_HALOUT_type.a2l
* Code generation for model "SWC_HALOUT_type".
* Model version : 1.10
* Simulink Coder version : 9.6 (R2021b) 14-May-2021
* C source code generated on : Tue May 13 16:41:01 2025
* Target selection: autosar.tlc
* Embedded hardware selection: ARM Compatible->ARM Cortex-M
* Code generation objectives: Unspecified
* Validation result: Not run
* (add additional file header information here)
******************************************************************************/ ASAP2_VERSION 1 31
/* Version 1.31 */
/begin PROJECT ProjectName "Project Comment Goes Here"
/begin HEADER "Header Comments go here" /end HEADER
/begin MODULE ModuleName "Module Comment Goes Here"
/begin MOD_COMMON "Mod Common Comment Here" BYTE_ORDER MSB_LAST ALIGNMENT_BYTE 1 ALIGNMENT_WORD 2 ALIGNMENT_LONG 2 ALIGNMENT_FLOAT32_IEEE 2 ALIGNMENT_FLOAT64_IEEE 4 /end MOD_COMMON
/begin IF_DATA XCP
 /begin PROTOCOL_LAYER
  /begin PROTOCOL_LAYER 0x0100 /* XCP protocol layer version 1.0 */ 2000 /* T1 [ms] */ 2000 /* T2 [ms] */ 2000 /* T3 [ms] */ 2000 /* T4 [ms] */ 2000 /* T5 [ms] */ 0005 /* T6 [ms] */ 0005 /* T7 [ms] */ 0x08 /* MAX_CTO */ 0x0008 /* MAX_DTO */ BYTE_ORDER_MSB_LAST ADDRESS_GRANULARITY_BYTE /* SEED_AND_KEY_EXTERNAL_FUNCTION "stm32f1_seed_key.dll" */ OPTIONAL_CMD GET_COMM_MODE_INFO OPTIONAL_CMD GET_ID OPTIONAL_CMD SET_REQUEST OPTIONAL_CMD GET_SEED OPTIONAL_CMD UNLOCK OPTIONAL_CMD SET_MTA OPTIONAL_CMD UPLOAD OPTIONAL_CMD SHORT_UPLOAD OPTIONAL_CMD BUILD_CHECKSUM OPTIONAL_CMD TRANSPORT_LAYER_CMD OPTIONAL_CMD USER_CMD OPTIONAL_CMD DOWNLOAD OPTIONAL_CMD DOWNLOAD_NEXT OPTIONAL_CMD SET_CAL_PAGE OPTIONAL_CMD GET_CAL_PAGE OPTIONAL_CMD GET_PAG_PROCESSOR_INFO OPTIONAL_CMD SET_DAQ_PTR OPTIONAL_CMD WRITE_DAQ OPTIONAL_CMD SET_DAQ_LIST_MODE OPTIONAL_CMD GET_DAQ_LIST_MODE OPTIONAL_CMD START_STOP_DAQ_LIST OPTIONAL_CMD START_STOP_SYNCH OPTIONAL_CMD GET_DAQ_CLOCK OPTIONAL_CMD READ_DAQ OPTIONAL_CMD GET_DAQ_PROCESSOR_INFO OPTIONAL_CMD GET_DAQ_RESOLUTION_INFO OPTIONAL_CMD GET_DAQ_LIST_INFO OPTIONAL_CMD GET_DAQ_EVENT_INFO OPTIONAL_CMD FREE_DAQ OPTIONAL_CMD ALLOC_DAQ OPTIONAL_CMD ALLOC_ODT OPTIONAL_CMD ALLOC_ODT_ENTRY OPTIONAL_CMD PROGRAM_START OPTIONAL_CMD PROGRAM OPTIONAL_CMD PROGRAM_CLEAR OPTIONAL_CMD PROGRAM_RESET OPTIONAL_CMD PROGRAM_NEXT OPTIONAL_CMD COPY_CAL_PAGE OPTIONAL_CMD MODIFY_BITS
   /begin COMMUNICATION_MODE_SUPPORTED /begin BLOCK SLAVE MASTER 0xff 100 /end BLOCK /end COMMUNICATION_MODE_SUPPORTED
  /end PROTOCOL_LAYER
  /begin DAQ STATIC /* DAQ_CONFIG_TYPE */ 0x03 /* MAX_DAQ */ 0x03 /* MAX_EVENT_CHANNEL */ 0x00 /* MIN_DAQ */ OPTIMISATION_TYPE_DEFAULT /* OPTIMISATION_TYPE */ ADDRESS_EXTENSION_FREE /* ADDRESS_EXTENSION */ IDENTIFICATION_FIELD_TYPE_ABSOLUTE /* IDENTIFICATION_FIELD */ GRANULARITY_ODT_ENTRY_SIZE_DAQ_BYTE /* GRANULARITY_ODT_ENTRY_SIZE_DAQ */ 0x08 /* MAX_ODT_ENTRY_SIZE_DAQ */ NO_OVERLOAD_INDICATION PRESCALER_SUPPORTED
   /begin TIMESTAMP_SUPPORTED 1 /* TIMESTAMP_TICKS */ SIZE_WORD /* TIMESTAMP_SIZE */ UNIT_1MS /* TIMESTAMP_UNIT */ /end TIMESTAMP_SUPPORTED
   /begin DAQ_LIST 0 DAQ_LIST_TYPE DAQ MAX_ODT 16 MAX_ODT_ENTRIES 7 FIRST_PID 0 EVENT_FIXED 0 /end DAQ_LIST
   /begin DAQ_LIST 1 DAQ_LIST_TYPE DAQ MAX_ODT 16 MAX_ODT_ENTRIES 7 FIRST_PID 16 EVENT_FIXED 1 /end DAQ_LIST
   /begin DAQ_LIST 2 DAQ_LIST_TYPE DAQ MAX_ODT 16 MAX_ODT_ENTRIES 7 FIRST_PID 32 EVENT_FIXED 2 /end DAQ_LIST
   /begin EVENT "10ms" "10ms" 0 DAQ_STIM 0xff 10 6 0 /end EVENT
   /begin EVENT "20ms" "20ms" 1 DAQ_STIM 0xff 20 6 0 /end EVENT
   /begin EVENT "100ms" "100ms" 2 DAQ_STIM 0xff 10 7 0 /end EVENT
  /end DAQ
  /begin PAG 0x02 /* MAX_SEGMENTS */ FREEZE_SUPPORTED /end PAG
  /begin PGM PGM_MODE_ABSOLUTE 3 /* MAX_SECTORS */ 0x08 /* MAX_CTO_PGM */ /begin SECTOR "sector 0" 0 0x0 0x1000 2 2 0 /end SECTOR /begin SECTOR "sector 1" 1 0x1000 0x2000 1 1 0 /end SECTOR /begin SECTOR "sector 2" 2 0x3000 0x3000 0 0 0 /end SECTOR COMMUNICATION_MODE_SUPPORTED BLOCK SLAVE MASTER 0xff /* MAX_BS_PGM */ 100 /* MIN_ST_PGM */ /end PGM
  /begin XCP_ON_CAN 0x0100 /* XCP on CAN version */ CAN_ID_MASTER 0x0667 /* CMD/STIM */ CAN_ID_SLAVE 0x07E1 /* RES/ERR/EV/SERV */ BAUDRATE 500000 /* BAUDRATE */ SAMPLE_POINT 75 /* SAMPLE POINT */ SAMPLE_RATE SINGLE /* SAMPLE RATE */ BTL_CYCLES 0 /* BTL CYCLES */ SJW 2 /* SJW */ SYNC_EDGE SINGLE /* SYNC EDGE */ /begin DAQ_LIST_CAN_ID 0 FIXED 0x630 /end DAQ_LIST_CAN_ID /begin DAQ_LIST_CAN_ID 1 FIXED 0x632 /end DAQ_LIST_CAN_ID /begin DAQ_LIST_CAN_ID 2 FIXED 0x633 /end DAQ_LIST_CAN_ID /end XCP_ON_CAN
  /* /end IF_DATA */ /* /begin IF_DATA CANAPE_ADDRESS_UPDATE */ /* /end IF_DATA */
  /begin MOD_PAR "MOD PAR Comment Goes Here" VERSION "V0.1" ADDR_EPK 0x0 EPK "" SUPPLIER "FVT" CUSTOMER "FVT internal + Demosample" CUSTOMER_NO "NONE Demo" USER "ETAS-PGA/EAP - Dm" PHONE_NO "0" ECU "S32G274A / CAN " CPU_TYPE "S32G274A" NO_OF_INTERFACES 1 /* CODE (ROM) */
   /begin MEMORY_SEGMENT APP_CODE "" CODE FLASH INTERN 0x34200000 /* Address */ 0x00080000 /* Size */ -1 -1 -1 -1 -1 /* no mirrored segments */
    /begin IF_DATA XCP
     /begin SEGMENT 0x00 /* segment logical number */ 0x01 /* number of pages */ 0x00 /* address extension */ 0x00 /* Compression method */ 0x00 /* Encryption method */
      /begin CHECKSUM XCP_ADD_14 /* checksum through external function */ MAX_BLOCK_SIZE 0x00000800 /* maximum block size */ /end CHECKSUM
      /begin PAGE 0x00 /* page number */ ECU_ACCESS_WITH_XCP_ONLY XCP_READ_ACCESS_WITH_ECU_ONLY XCP_WRITE_ACCESS_NOT_ALLOWED /end PAGE
     /end SEGMENT
    /end IF_DATA
   /end MEMORY_SEGMENT
   /begin MEMORY_SEGMENT APP_CODE "" RESERVED RAM INTERN 0x34500000 /* Address */ 0x00100000 /* Size */ -1 -1 -1 -1 -1 /* no mirrored segments */ /end MEMORY_SEGMENT
   /* REFERENCE PAGE (ROM) */
   /begin MEMORY_SEGMENT APP_CALIBDATA "" DATA FLASH INTERN 0x34420000 /* REFERENCE PAGE START ADDRESS */ 0x00020000 /* REFERENCE PAGE SIZE */ -1 -1 -1 -1 -1
    /begin IF_DATA XCP
     /begin SEGMENT 0x01 /* segment logical number */ 0x01 /* number of pages */ 0x00 /* address extension */ 0x00 /* Compression method */ 0x00 /* Encryption method */
      /begin CHECKSUM XCP_ADD_14 /* checksum through external function */ MAX_BLOCK_SIZE 0x00000800 /* maximum block size */ /end CHECKSUM
      /begin PAGE 0x00 /* page number */ ECU_ACCESS_WITH_XCP_ONLY XCP_READ_ACCESS_WITH_ECU_ONLY XCP_WRITE_ACCESS_WITH_ECU_ONLY INIT_SEGMENT 0x00 /end PAGE
      /begin ADDRESS_MAPPING 0x34420000 /* from */ 0x34420000 /* to */ 0x00020000 /* length */ /end ADDRESS_MAPPING
     /end SEGMENT
    /end IF_DATA
   /end MEMORY_SEGMENT
   /* VARIABLE PAGE (RAM) */
   /begin MEMORY_SEGMENT DATA_BSS "" RESERVED RAM INTERN 0x34280000 /* REFERENCE PAGE START ADDRESS */ 0x00180000 /* REFERENCE PAGE SIZE */ -1 -1 -1 -1 -1 /end MEMORY_SEGMENT
   /begin MEMORY_SEGMENT RAM_CORE1_CALIBDATA "" VARIABLES /* CALIBRATION_VARIABLES */ RAM INTERN 0x34400000 /* VARIABLE PAGE START ADDRESS */ 0x00020000 /* VARIABLE PAGE SIZE */ -1 -1 -1 -1 -1 /end MEMORY_SEGMENT
  /end MOD_PAR
  /begin RECORD_LAYOUT Scalar_BOOLEAN FNC_VALUES 1 UBYTE COLUMN_DIR DIRECT /end RECORD_LAYOUT
  /begin RECORD_LAYOUT Scalar_UBYTE FNC_VALUES 1 UBYTE COLUMN_DIR DIRECT /end RECORD_LAYOUT
  /begin RECORD_LAYOUT Scalar_BYTE FNC_VALUES 1 SBYTE COLUMN_DIR DIRECT /end RECORD_LAYOUT
  /begin RECORD_LAYOUT Scalar_UWORD FNC_VALUES 1 UWORD COLUMN_DIR DIRECT /end RECORD_LAYOUT
  /begin RECORD_LAYOUT Scalar_SWORD FNC_VALUES 1 SWORD COLUMN_DIR DIRECT /end RECORD_LAYOUT
  /begin RECORD_LAYOUT Scalar_ULONG FNC_VALUES 1 ULONG COLUMN_DIR DIRECT /end RECORD_LAYOUT
  /begin RECORD_LAYOUT Scalar_LONG FNC_VALUES 1 SLONG COLUMN_DIR DIRECT /end RECORD_LAYOUT
  /begin RECORD_LAYOUT Scalar_FLOAT32_IEEE FNC_VALUES 1 FLOAT32_IEEE COLUMN_DIR DIRECT /end RECORD_LAYOUT
  /begin RECORD_LAYOUT Scalar_FLOAT64_IEEE FNC_VALUES 1 FLOAT64_IEEE COLUMN_DIR DIRECT /end RECORD_LAYOUT
  /begin RECORD_LAYOUT Lookup1D_BOOLEAN FNC_VALUES 1 UBYTE COLUMN_DIR DIRECT /end RECORD_LAYOUT
  /begin RECORD_LAYOUT Lookup1D_X_BOOLEAN AXIS_PTS_X 1 UBYTE INDEX_INCR DIRECT /end RECORD_LAYOUT
  /begin RECORD_LAYOUT Lookup1D_BYTE FNC_VALUES 1 SBYTE COLUMN_DIR DIRECT /end RECORD_LAYOUT
  /begin RECORD_LAYOUT Lookup1D_X_BYTE AXIS_PTS_X 1 SBYTE INDEX_INCR DIRECT /end RECORD_LAYOUT
  /begin RECORD_LAYOUT Lookup1D_UBYTE FNC_VALUES 1 UBYTE COLUMN_DIR DIRECT /end RECORD_LAYOUT
  /begin RECORD_LAYOUT Lookup1D_X_UBYTE AXIS_PTS_X 1 UBYTE INDEX_INCR DIRECT /end RECORD_LAYOUT
  /begin RECORD_LAYOUT Lookup1D_UWORD FNC_VALUES 1 UWORD COLUMN_DIR DIRECT /end RECORD_LAYOUT
  /begin RECORD_LAYOUT Lookup1D_X_UWORD AXIS_PTS_X 1 UWORD INDEX_INCR DIRECT /end RECORD_LAYOUT
  /begin RECORD_LAYOUT Lookup1D_WORD FNC_VALUES 1 SWORD COLUMN_DIR DIRECT /end RECORD_LAYOUT
  /begin RECORD_LAYOUT Lookup1D_X_WORD AXIS_PTS_X 1 SWORD INDEX_INCR DIRECT /end RECORD_LAYOUT
  /begin RECORD_LAYOUT Lookup1D_ULONG FNC_VALUES 1 ULONG COLUMN_DIR DIRECT /end RECORD_LAYOUT
  /begin RECORD_LAYOUT Lookup1D_X_ULONG AXIS_PTS_X 1 ULONG INDEX_INCR DIRECT /end RECORD_LAYOUT
  /begin RECORD_LAYOUT Lookup1D_SLONG FNC_VALUES 1 SLONG COLUMN_DIR DIRECT /end RECORD_LAYOUT
  /begin RECORD_LAYOUT Lookup1D_X_LONG AXIS_PTS_X 1 SLONG INDEX_INCR DIRECT /end RECORD_LAYOUT
  /begin RECORD_LAYOUT Lookup1D_FLOAT32_IEEE FNC_VALUES 1 FLOAT32_IEEE COLUMN_DIR DIRECT /end RECORD_LAYOUT
  /begin RECORD_LAYOUT Lookup1D_X_FLOAT32_IEEE AXIS_PTS_X 1 FLOAT32_IEEE INDEX_INCR DIRECT /end RECORD_LAYOUT
  /begin RECORD_LAYOUT Lookup1D_FLOAT64_IEEE FNC_VALUES 1 FLOAT64_IEEE COLUMN_DIR DIRECT /end RECORD_LAYOUT
  /begin RECORD_LAYOUT Lookup1D_X_FLOAT64_IEEE AXIS_PTS_X 1 FLOAT64_IEEE INDEX_INCR DIRECT /end RECORD_LAYOUT
  /begin RECORD_LAYOUT Lookup2D_BOOLEAN FNC_VALUES 1 UBYTE COLUMN_DIR DIRECT /end RECORD_LAYOUT
  /begin RECORD_LAYOUT Lookup2D_X_BOOLEAN AXIS_PTS_X 1 UBYTE INDEX_INCR DIRECT /end RECORD_LAYOUT
  /begin RECORD_LAYOUT Lookup2D_UBYTE FNC_VALUES 1 UBYTE COLUMN_DIR DIRECT /end RECORD_LAYOUT
  /begin RECORD_LAYOUT Lookup2D_X_UBYTE AXIS_PTS_X 1 UBYTE INDEX_INCR DIRECT /end RECORD_LAYOUT
  /begin RECORD_LAYOUT Lookup2D_BYTE FNC_VALUES 1 SBYTE COLUMN_DIR DIRECT /end RECORD_LAYOUT
  /begin RECORD_LAYOUT Lookup2D_X_BYTE AXIS_PTS_X 1 SBYTE INDEX_INCR DIRECT /end RECORD_LAYOUT
  /begin RECORD_LAYOUT Lookup2D_UWORD FNC_VALUES 1 UWORD COLUMN_DIR DIRECT /end RECORD_LAYOUT
  /begin RECORD_LAYOUT Lookup2D_X_UWORD AXIS_PTS_X 1 UWORD INDEX_INCR DIRECT /end RECORD_LAYOUT
  /begin RECORD_LAYOUT Lookup2D_WORD FNC_VALUES 1 SWORD COLUMN_DIR DIRECT /end RECORD_LAYOUT
  /begin RECORD_LAYOUT Lookup2D_X_WORD AXIS_PTS_X 1 SWORD INDEX_INCR DIRECT /end RECORD_LAYOUT
  /begin RECORD_LAYOUT Lookup2D_ULONG FNC_VALUES 1 ULONG COLUMN_DIR DIRECT /end RECORD_LAYOUT
  /begin RECORD_LAYOUT Lookup2D_X_ULONG AXIS_PTS_X 1 ULONG INDEX_INCR DIRECT /end RECORD_LAYOUT
  /begin RECORD_LAYOUT Lookup2D_LONG FNC_VALUES 1 SLONG COLUMN_DIR DIRECT /end RECORD_LAYOUT
  /begin RECORD_LAYOUT Lookup2D_X_LONG AXIS_PTS_X 1 SLONG INDEX_INCR DIRECT /end RECORD_LAYOUT
  /begin RECORD_LAYOUT Lookup2D_FLOAT32_IEEE FNC_VALUES 1 FLOAT32_IEEE COLUMN_DIR DIRECT /end RECORD_LAYOUT
  /begin RECORD_LAYOUT Lookup2D_X_FLOAT32_IEEE AXIS_PTS_X 1 FLOAT32_IEEE INDEX_INCR DIRECT /end RECORD_LAYOUT
  /begin RECORD_LAYOUT Lookup2D_FLOAT64_IEEE FNC_VALUES 1 FLOAT64_IEEE COLUMN_DIR DIRECT /end RECORD_LAYOUT
  /begin RECORD_LAYOUT Lookup2D_X_FLOAT64_IEEE AXIS_PTS_X 1 FLOAT64_IEEE INDEX_INCR DIRECT /end RECORD_LAYOUT
  /begin CHARACTERISTIC KHAL_CAN1TxReq_flg "" VALUE 0x0000 /* @ECU_Address@KHAL_CAN1TxReq_flg@ */ Scalar_BOOLEAN 0 SWC_HALOUT_type_CM_boolean_flg 0.0 1.0 /end CHARACTERISTIC
  /begin CHARACTERISTIC KHAL_CAN2TxReq_flg "" VALUE 0x0000 /* @ECU_Address@KHAL_CAN2TxReq_flg@ */ Scalar_BOOLEAN 0 SWC_HALOUT_type_CM_boolean_flg 0.0 1.0 /end CHARACTERISTIC
  /begin CHARACTERISTIC KHAL_CAN3TxReq_flg "" VALUE 0x0000 /* @ECU_Address@KHAL_CAN3TxReq_flg@ */ Scalar_BOOLEAN 0 SWC_HALOUT_type_CM_boolean_flg 0.0 1.0 /end CHARACTERISTIC
  /begin CHARACTERISTIC KHAL_CAN4TxReq_flg "" VALUE 0x0000 /* @ECU_Address@KHAL_CAN4TxReq_flg@ */ Scalar_BOOLEAN 0 SWC_HALOUT_type_CM_boolean_flg 0.0 1.0 /end CHARACTERISTIC
  /begin CHARACTERISTIC KHAL_CAN5TxReq_flg "" VALUE 0x0000 /* @ECU_Address@KHAL_CAN5TxReq_flg@ */ Scalar_BOOLEAN 0 SWC_HALOUT_type_CM_boolean_flg 0.0 1.0 /end CHARACTERISTIC
  /begin CHARACTERISTIC KHAL_CAN6TxReq_flg "" VALUE 0x0000 /* @ECU_Address@KHAL_CAN6TxReq_flg@ */ Scalar_BOOLEAN 0 SWC_HALOUT_type_CM_boolean_flg 0.0 1.0 /end CHARACTERISTIC
  /begin CHARACTERISTIC KHAL_CAN7TxReq_flg "" VALUE 0x0000 /* @ECU_Address@KHAL_CAN7TxReq_flg@ */ Scalar_BOOLEAN 0 SWC_HALOUT_type_CM_boolean_flg 0.0 1.0 /end CHARACTERISTIC
  /begin COMPU_METHOD /* Name of CompuMethod */ SWC_HALOUT_type_CM_boolean_flg "Q = V" /* Conversion Type */ RAT_FUNC /* Format */ "%1.0" /* Units */ "flg" /* Coefficients */ COEFFS 0 1 0 0 0 1 /end COMPU_METHOD
  /begin GROUP SWC_HALOUT_type "SWC_HALOUT_type" /* Root */ ROOT /begin SUB_GROUP Root_run_SWC_HALOUT_Tx_5ms_sys /end SUB_GROUP /end GROUP
  /begin GROUP Root_run_SWC_HALOUT_Tx_5ms_sys "SWC_HALOUT_type/run_SWC_HALOUT_Tx_5ms_sys" /begin SUB_GROUP S17_HAL_OUT /end SUB_GROUP /end GROUP
  /begin GROUP S17_HAL_OUT "SWC_HALOUT_type/run_SWC_HALOUT_Tx_5ms_sys/HAL_OUT"
   /begin REF_CHARACTERISTIC KHAL_CAN1TxReq_flg KHAL_CAN2TxReq_flg KHAL_CAN3TxReq_flg KHAL_CAN4TxReq_flg KHAL_CAN5TxReq_flg KHAL_CAN6TxReq_flg KHAL_CAN7TxReq_flg /end REF_CHARACTERISTIC
  /end GROUP
 /end PROTOCOL_LAYER
/end IF_DATA
/end MODULE
/end PROJECT
/* (add any file trailer comments here) */
/* EOF SWC_HALOUT_type.a2l */
