AUTOSAR XML (schema 4-3-0)
standard types defined: boolean, float32, float64, sint16, sint16_least, sint32, sint32_least, sint8, sint8_least, uint16, uint16_least, uint32, uint32_least, uint64, uint8, uint8_least, void, Std_ReturnType
package /AUTOSAR_MemMap/SwAddrMethods
  88 x sw addr method:
    CAL: memory-allocation-keyword-policy=ADDR-METHOD-SHORT-NAME-AND-ALIGNMENT, section-initialization-policy=INIT, section-type=CALPRM
    CALIB: memory-allocation-keyword-policy=ADDR-METHOD-SHORT-NAME-AND-ALIGNMENT, section-initialization-policy=INIT, section-type=CALPRM
    CALIB_ASIL_A: memory-allocation-keyword-policy=ADDR-METHOD-SHORT-NAME-AND-ALIGNMENT, options=safetyAsilA, section-initialization-policy=INIT, section-type=CALPRM
    CALIB_ASIL_B: memory-allocation-keyword-policy=ADDR-METHOD-SHORT-NAME-AND-ALIGNMENT, options=safetyAsilB, section-initialization-policy=INIT, section-type=CALPRM
    CALIB_ASIL_C: memory-allocation-keyword-policy=ADDR-METHOD-SHORT-NAME-AND-ALIGNMENT, options=safetyAsilC, section-initialization-policy=INIT, section-type=CALPRM
    CALIB_ASIL_D: memory-allocation-keyword-policy=ADDR-METHOD-SHORT-NAME-AND-ALIGNMENT, options=safetyAsilD, section-initialization-policy=INIT, section-type=CALPRM
    CALLOUT_CODE: memory-allocation-keyword-policy=ADDR-METHOD-SHORT-NAME, section-type=CODE
    CALLOUT_CODE_ASIL_A: memory-allocation-keyword-policy=ADDR-METHOD-SHORT-NAME, options=safetyAsilA, section-type=CODE
    CALLOUT_CODE_ASIL_A_LOCAL: memory-allocation-keyword-policy=ADDR-METHOD-SHORT-NAME, options=[safetyAsilA, coreLocal], section-type=CODE
    CALLOUT_CODE_ASIL_B: memory-allocation-keyword-policy=ADDR-METHOD-SHORT-NAME, options=safetyAsilB, section-type=CODE
    CALLOUT_CODE_ASIL_B_LOCAL: memory-allocation-keyword-policy=ADDR-METHOD-SHORT-NAME, options=[safetyAsilB, coreLocal], section-type=CODE
    CALLOUT_CODE_ASIL_C: memory-allocation-keyword-policy=ADDR-METHOD-SHORT-NAME, options=safetyAsilC, section-type=CODE
    CALLOUT_CODE_ASIL_C_LOCAL: memory-allocation-keyword-policy=ADDR-METHOD-SHORT-NAME, options=[safetyAsilC, coreLocal], section-type=CODE
    CALLOUT_CODE_ASIL_D: memory-allocation-keyword-policy=ADDR-METHOD-SHORT-NAME, options=safetyAsilD, section-type=CODE
    CALLOUT_CODE_ASIL_D_LOCAL: memory-allocation-keyword-policy=ADDR-METHOD-SHORT-NAME, options=[safetyAsilD, coreLocal], section-type=CODE
    CALLOUT_CODE_LOCAL: memory-allocation-keyword-policy=ADDR-METHOD-SHORT-NAME, options=coreLocal, section-type=CODE
    CODE: memory-allocation-keyword-policy=ADDR-METHOD-SHORT-NAME, section-type=CODE
    CODE_ASIL_A: memory-allocation-keyword-policy=ADDR-METHOD-SHORT-NAME, options=safetyAsilA, section-type=CODE
    CODE_ASIL_A_LOCAL: memory-allocation-keyword-policy=ADDR-METHOD-SHORT-NAME, options=[safetyAsilA, coreLocal], section-type=CODE
    CODE_ASIL_B: memory-allocation-keyword-policy=ADDR-METHOD-SHORT-NAME, options=safetyAsilB, section-type=CODE
    CODE_ASIL_B_LOCAL: memory-allocation-keyword-policy=ADDR-METHOD-SHORT-NAME, options=[safetyAsilB, coreLocal], section-type=CODE
    CODE_ASIL_C: memory-allocation-keyword-policy=ADDR-METHOD-SHORT-NAME, options=safetyAsilC, section-type=CODE
    CODE_ASIL_C_LOCAL: memory-allocation-keyword-policy=ADDR-METHOD-SHORT-NAME, options=[safetyAsilC, coreLocal], section-type=CODE
    CODE_ASIL_D: memory-allocation-keyword-policy=ADDR-METHOD-SHORT-NAME, options=safetyAsilD, section-type=CODE
    CODE_ASIL_D_LOCAL: memory-allocation-keyword-policy=ADDR-METHOD-SHORT-NAME, options=[safetyAsilD, coreLocal], section-type=CODE
    CODE_LOCAL: memory-allocation-keyword-policy=ADDR-METHOD-SHORT-NAME, options=coreLocal, section-type=CODE
    CONFIG_DATA: memory-allocation-keyword-policy=ADDR-METHOD-SHORT-NAME-AND-ALIGNMENT, section-type=CONFIG-DATA
    CONFIG_DATA_ASIL_A: memory-allocation-keyword-policy=ADDR-METHOD-SHORT-NAME-AND-ALIGNMENT, options=safetyAsilA, section-type=CONFIG-DATA
    CONFIG_DATA_ASIL_B: memory-allocation-keyword-policy=ADDR-METHOD-SHORT-NAME-AND-ALIGNMENT, options=safetyAsilB, section-type=CONFIG-DATA
    CONFIG_DATA_ASIL_C: memory-allocation-keyword-policy=ADDR-METHOD-SHORT-NAME-AND-ALIGNMENT, options=safetyAsilC, section-type=CONFIG-DATA
    CONFIG_DATA_ASIL_D: memory-allocation-keyword-policy=ADDR-METHOD-SHORT-NAME-AND-ALIGNMENT, options=safetyAsilD, section-type=CONFIG-DATA
    CONST: memory-allocation-keyword-policy=ADDR-METHOD-SHORT-NAME-AND-ALIGNMENT, section-type=CONST
    CONST_ASIL_A: memory-allocation-keyword-policy=ADDR-METHOD-SHORT-NAME-AND-ALIGNMENT, options=safetyAsilA, section-type=CONST
    CONST_ASIL_B: memory-allocation-keyword-policy=ADDR-METHOD-SHORT-NAME-AND-ALIGNMENT, options=safetyAsilB, section-type=CONST
    CONST_ASIL_C: memory-allocation-keyword-policy=ADDR-METHOD-SHORT-NAME-AND-ALIGNMENT, options=safetyAsilC, section-type=CONST
    CONST_ASIL_D: memory-allocation-keyword-policy=ADDR-METHOD-SHORT-NAME-AND-ALIGNMENT, options=safetyAsilD, section-type=CONST
    VAR: memory-allocation-keyword-policy=ADDR-METHOD-SHORT-NAME-AND-ALIGNMENT, section-initialization-policy=INIT, section-type=VAR
    VAR_CLEARED: memory-allocation-keyword-policy=ADDR-METHOD-SHORT-NAME-AND-ALIGNMENT, section-initialization-policy=CLEARED, section-type=VAR
    VAR_CLEARED_ASIL_A: memory-allocation-keyword-policy=ADDR-METHOD-SHORT-NAME-AND-ALIGNMENT, options=safetyAsilA, section-initialization-policy=CLEARED, section-type=VAR
    VAR_CLEARED_ASIL_A_LOCAL: memory-allocation-keyword-policy=ADDR-METHOD-SHORT-NAME-AND-ALIGNMENT, options=[safetyAsilA, coreLocal], section-initialization-policy=CLEARED, section-type=VAR
    VAR_CLEARED_ASIL_B: memory-allocation-keyword-policy=ADDR-METHOD-SHORT-NAME-AND-ALIGNMENT, options=safetyAsilB, section-initialization-policy=CLEARED, section-type=VAR
    VAR_CLEARED_ASIL_B_LOCAL: memory-allocation-keyword-policy=ADDR-METHOD-SHORT-NAME-AND-ALIGNMENT, options=[safetyAsilB, coreLocal], section-initialization-policy=CLEARED, section-type=VAR
    VAR_CLEARED_ASIL_C: memory-allocation-keyword-policy=ADDR-METHOD-SHORT-NAME-AND-ALIGNMENT, options=safetyAsilC, section-initialization-policy=CLEARED, section-type=VAR
    VAR_CLEARED_ASIL_C_LOCAL: memory-allocation-keyword-policy=ADDR-METHOD-SHORT-NAME-AND-ALIGNMENT, options=[safetyAsilC, coreLocal], section-initialization-policy=CLEARED, section-type=VAR
    VAR_CLEARED_ASIL_D: memory-allocation-keyword-policy=ADDR-METHOD-SHORT-NAME-AND-ALIGNMENT, options=safetyAsilD, section-initialization-policy=CLEARED, section-type=VAR
    VAR_CLEARED_ASIL_D_LOCAL: memory-allocation-keyword-policy=ADDR-METHOD-SHORT-NAME-AND-ALIGNMENT, options=[safetyAsilD, coreLocal], section-initialization-policy=CLEARED, section-type=VAR
    VAR_CLEARED_LOCAL: memory-allocation-keyword-policy=ADDR-METHOD-SHORT-NAME-AND-ALIGNMENT, options=coreLocal, section-initialization-policy=CLEARED, section-type=VAR
    VAR_FAST: memory-allocation-keyword-policy=ADDR-METHOD-SHORT-NAME-AND-ALIGNMENT, section-initialization-policy=INIT, section-type=VAR-FAST
    VAR_FAST_ASIL_A: memory-allocation-keyword-policy=ADDR-METHOD-SHORT-NAME-AND-ALIGNMENT, options=safetyAsilA, section-initialization-policy=INIT, section-type=VAR-FAST
    VAR_FAST_ASIL_A_LOCAL: memory-allocation-keyword-policy=ADDR-METHOD-SHORT-NAME-AND-ALIGNMENT, options=[safetyAsilA, coreLocal], section-initialization-policy=INIT, section-type=VAR-FAST
    VAR_FAST_ASIL_B: memory-allocation-keyword-policy=ADDR-METHOD-SHORT-NAME-AND-ALIGNMENT, options=safetyAsilB, section-initialization-policy=INIT, section-type=VAR-FAST
    VAR_FAST_ASIL_B_LOCAL: memory-allocation-keyword-policy=ADDR-METHOD-SHORT-NAME-AND-ALIGNMENT, options=[safetyAsilB, coreLocal], section-initialization-policy=INIT, section-type=VAR-FAST
    VAR_FAST_ASIL_C: memory-allocation-keyword-policy=ADDR-METHOD-SHORT-NAME-AND-ALIGNMENT, options=safetyAsilC, section-initialization-policy=INIT, section-type=VAR-FAST
    VAR_FAST_ASIL_C_LOCAL: memory-allocation-keyword-policy=ADDR-METHOD-SHORT-NAME-AND-ALIGNMENT, options=[safetyAsilC, coreLocal], section-initialization-policy=INIT, section-type=VAR-FAST
    VAR_FAST_ASIL_D: memory-allocation-keyword-policy=ADDR-METHOD-SHORT-NAME-AND-ALIGNMENT, options=safetyAsilD, section-initialization-policy=INIT, section-type=VAR-FAST
    VAR_FAST_ASIL_D_LOCAL: memory-allocation-keyword-policy=ADDR-METHOD-SHORT-NAME-AND-ALIGNMENT, options=[safetyAsilD, coreLocal], section-initialization-policy=INIT, section-type=VAR-FAST
    VAR_FAST_LOCAL: memory-allocation-keyword-policy=ADDR-METHOD-SHORT-NAME-AND-ALIGNMENT, options=coreLocal, section-initialization-policy=INIT, section-type=VAR-FAST
    VAR_INIT: memory-allocation-keyword-policy=ADDR-METHOD-SHORT-NAME-AND-ALIGNMENT, section-initialization-policy=INIT, section-type=VAR
    VAR_INIT_ASIL_A: memory-allocation-keyword-policy=ADDR-METHOD-SHORT-NAME-AND-ALIGNMENT, options=safetyAsilA, section-initialization-policy=INIT, section-type=VAR
    VAR_INIT_ASIL_A_LOCAL: memory-allocation-keyword-policy=ADDR-METHOD-SHORT-NAME-AND-ALIGNMENT, options=[safetyAsilA, coreLocal], section-initialization-policy=INIT, section-type=VAR
    VAR_INIT_ASIL_B: memory-allocation-keyword-policy=ADDR-METHOD-SHORT-NAME-AND-ALIGNMENT, options=safetyAsilB, section-initialization-policy=INIT, section-type=VAR
    VAR_INIT_ASIL_B_LOCAL: memory-allocation-keyword-policy=ADDR-METHOD-SHORT-NAME-AND-ALIGNMENT, options=[safetyAsilB, coreLocal], section-initialization-policy=INIT, section-type=VAR
    VAR_INIT_ASIL_C: memory-allocation-keyword-policy=ADDR-METHOD-SHORT-NAME-AND-ALIGNMENT, options=safetyAsilC, section-initialization-policy=INIT, section-type=VAR
    VAR_INIT_ASIL_C_LOCAL: memory-allocation-keyword-policy=ADDR-METHOD-SHORT-NAME-AND-ALIGNMENT, options=[safetyAsilC, coreLocal], section-initialization-policy=INIT, section-type=VAR
    VAR_INIT_ASIL_D: memory-allocation-keyword-policy=ADDR-METHOD-SHORT-NAME-AND-ALIGNMENT, options=safetyAsilD, section-initialization-policy=INIT, section-type=VAR
    VAR_INIT_ASIL_D_LOCAL: memory-allocation-keyword-policy=ADDR-METHOD-SHORT-NAME-AND-ALIGNMENT, options=[safetyAsilD, coreLocal], section-initialization-policy=INIT, section-type=VAR
    VAR_INIT_LOCAL: memory-allocation-keyword-policy=ADDR-METHOD-SHORT-NAME-AND-ALIGNMENT, options=coreLocal, section-initialization-policy=INIT, section-type=VAR
    VAR_NOINIT: memory-allocation-keyword-policy=ADDR-METHOD-SHORT-NAME-AND-ALIGNMENT, section-initialization-policy=NO-INIT, section-type=VAR
    VAR_NO_INIT: memory-allocation-keyword-policy=ADDR-METHOD-SHORT-NAME-AND-ALIGNMENT, section-initialization-policy=NO-INIT, section-type=VAR
    VAR_NO_INIT_ASIL_A: memory-allocation-keyword-policy=ADDR-METHOD-SHORT-NAME-AND-ALIGNMENT, options=safetyAsilA, section-initialization-policy=NO-INIT, section-type=VAR
    VAR_NO_INIT_ASIL_B: memory-allocation-keyword-policy=ADDR-METHOD-SHORT-NAME-AND-ALIGNMENT, options=safetyAsilB, section-initialization-policy=NO-INIT, section-type=VAR
    VAR_NO_INIT_ASIL_C: memory-allocation-keyword-policy=ADDR-METHOD-SHORT-NAME-AND-ALIGNMENT, options=safetyAsilC, section-initialization-policy=NO-INIT, section-type=VAR
    VAR_NO_INIT_ASIL_D: memory-allocation-keyword-policy=ADDR-METHOD-SHORT-NAME-AND-ALIGNMENT, options=safetyAsilD, section-initialization-policy=NO-INIT, section-type=VAR
    VAR_POWER_ON_CLEARED: memory-allocation-keyword-policy=ADDR-METHOD-SHORT-NAME-AND-ALIGNMENT, section-initialization-policy=POWER-ON-CLEARED, section-type=VAR
    VAR_POWER_ON_CLEARED_ASIL_A: memory-allocation-keyword-policy=ADDR-METHOD-SHORT-NAME-AND-ALIGNMENT, options=safetyAsilA, section-initialization-policy=POWER-ON-CLEARED, section-type=VAR
    VAR_POWER_ON_CLEARED_ASIL_B: memory-allocation-keyword-policy=ADDR-METHOD-SHORT-NAME-AND-ALIGNMENT, options=safetyAsilB, section-initialization-policy=POWER-ON-CLEARED, section-type=VAR
    VAR_POWER_ON_CLEARED_ASIL_C: memory-allocation-keyword-policy=ADDR-METHOD-SHORT-NAME-AND-ALIGNMENT, options=safetyAsilC, section-initialization-policy=POWER-ON-CLEARED, section-type=VAR
    VAR_POWER_ON_CLEARED_ASIL_D: memory-allocation-keyword-policy=ADDR-METHOD-SHORT-NAME-AND-ALIGNMENT, options=safetyAsilD, section-initialization-policy=POWER-ON-CLEARED, section-type=VAR
    VAR_POWER_ON_INIT: memory-allocation-keyword-policy=ADDR-METHOD-SHORT-NAME-AND-ALIGNMENT, section-initialization-policy=POWER-ON-INIT, section-type=VAR
    VAR_POWER_ON_INIT_ASIL_A: memory-allocation-keyword-policy=ADDR-METHOD-SHORT-NAME-AND-ALIGNMENT, options=safetyAsilA, section-initialization-policy=POWER-ON-INIT, section-type=VAR
    VAR_POWER_ON_INIT_ASIL_B: memory-allocation-keyword-policy=ADDR-METHOD-SHORT-NAME-AND-ALIGNMENT, options=safetyAsilB, section-initialization-policy=POWER-ON-INIT, section-type=VAR
    VAR_POWER_ON_INIT_ASIL_C: memory-allocation-keyword-policy=ADDR-METHOD-SHORT-NAME-AND-ALIGNMENT, options=safetyAsilC, section-initialization-policy=POWER-ON-INIT, section-type=VAR
    VAR_POWER_ON_INIT_ASIL_D: memory-allocation-keyword-policy=ADDR-METHOD-SHORT-NAME-AND-ALIGNMENT, options=safetyAsilD, section-initialization-policy=POWER-ON-INIT, section-type=VAR
    VAR_SAVED_ZONE: memory-allocation-keyword-policy=ADDR-METHOD-SHORT-NAME-AND-ALIGNMENT, section-initialization-policy=NO-INIT, section-type=VAR
    VAR_SAVED_ZONE_ASIL_A: memory-allocation-keyword-policy=ADDR-METHOD-SHORT-NAME-AND-ALIGNMENT, options=safetyAsilA, section-initialization-policy=NO-INIT, section-type=VAR
    VAR_SAVED_ZONE_ASIL_B: memory-allocation-keyword-policy=ADDR-METHOD-SHORT-NAME-AND-ALIGNMENT, options=safetyAsilB, section-initialization-policy=NO-INIT, section-type=VAR
    VAR_SAVED_ZONE_ASIL_C: memory-allocation-keyword-policy=ADDR-METHOD-SHORT-NAME-AND-ALIGNMENT, options=safetyAsilC, section-initialization-policy=NO-INIT, section-type=VAR
    VAR_SAVED_ZONE_ASIL_D: memory-allocation-keyword-policy=ADDR-METHOD-SHORT-NAME-AND-ALIGNMENT, options=safetyAsilD, section-initialization-policy=NO-INIT, section-type=VAR
package /AUTOSAR_Platform/CompuMethods
  compu method boolean_Literals: 0=FALSE, 1=TRUE
package /AUTOSAR_Platform/ImplementationDataTypes
  11 x impl type:
    ConstVoidPtr: category=DATA_REFERENCE, sw-pointer-target-props={target-category=VALUE, base-type=void, sw-impl-policy=CONST}, type-emitter=BSW
    VoidPtr: category=DATA_REFERENCE, sw-pointer-target-props={target-category=VALUE, base-type=void}, type-emitter=BSW
    u8_Array16_type: category=ARRAY
      element u8_Array16: category=VALUE, array-size=16, array-size-semantics=FIXED-SIZE, base-type=uint8
    u8_Array8_type: category=ARRAY
      element u8_Array8: category=VALUE, array-size=8, array-size-semantics=FIXED-SIZE, base-type=uint8
    u16_Array8_type: category=ARRAY
      element u16_Array8: category=VALUE, array-size=8, array-size-semantics=FIXED-SIZE, base-type=uint16
    u32_Array8_type: category=ARRAY
      element u32_Array8: category=VALUE, array-size=8, array-size-semantics=FIXED-SIZE, base-type=uint32
    u8_Array17_type: category=ARRAY
      element u8_Array17: category=VALUE, array-size=17, array-size-semantics=FIXED-SIZE, base-type=uint8
    u8_Array20_type: category=ARRAY
      element u8_Array20: category=VALUE, array-size=20, array-size-semantics=FIXED-SIZE, base-type=uint8
    u8_Array12_type: category=ARRAY
      element u8_Array12: category=VALUE, array-size=12, array-size-semantics=FIXED-SIZE, base-type=uint8
    u16_Array3_type: category=ARRAY
      element u16_Array3: category=VALUE, array-size=3, array-size-semantics=FIXED-SIZE, base-type=uint16
    bool_Array3_type: category=ARRAY
      element bool_Array3: category=VALUE, array-size=3, array-size-semantics=FIXED-SIZE, base-type=boolean
package /AUTOSAR_Std/ImplementationDataTypes
  impl type Std_VersionInfoType: category=STRUCTURE, type-emitter=BSW
    5 x element, all with category=TYPE_REFERENCE:
      vendorID: implementation-data-type=uint16
      moduleID: implementation-data-type=uint16
      sw_major_version: implementation-data-type=uint8
      sw_minor_version: implementation-data-type=uint8
      sw_patch_version: implementation-data-type=uint8
