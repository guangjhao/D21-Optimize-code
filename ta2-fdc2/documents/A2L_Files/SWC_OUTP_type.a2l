ASAP2_VERSION 1 31
/begin PROJECT ProjectName "Project Comment Goes Here"
/begin HEADER "Header Comments go here" /end HEADER
/begin MODULE ModuleName "Module Comment Goes Here"
/begin MOD_COMMON "Mod Common Comment Here" BYTE_ORDER MSB_LAST /end MOD_COMMON
/begin RECORD_LAYOUT Scalar_BOOLEAN FNC_VALUES 1 UBYTE COLUMN_DIR DIRECT /end RECORD_LAYOUT
/begin RECORD_LAYOUT Scalar_UBYTE FNC_VALUES 1 UBYTE COLUMN_DIR DIRECT /end RECORD_LAYOUT
/begin RECORD_LAYOUT Scalar_UWORD FNC_VALUES 1 UWORD COLUMN_DIR DIRECT /end RECORD_LAYOUT
/begin RECORD_LAYOUT Scalar_ULONG FNC_VALUES 1 ULONG COLUMN_DIR DIRECT /end RECORD_LAYOUT
/begin RECORD_LAYOUT Scalar_FLOAT32_IEEE FNC_VALUES 1 FLOAT32_IEEE COLUMN_DIR DIRECT /end RECORD_LAYOUT
/begin RECORD_LAYOUT Lookup2D_X_UWORD AXIS_PTS_X 1 UWORD INDEX_INCR DIRECT /end RECORD_LAYOUT
/begin RECORD_LAYOUT Lookup2D_WORD FNC_VALUES 1 SWORD COLUMN_DIR DIRECT /end RECORD_LAYOUT
/begin RECORD_LAYOUT Lookup2D_X_WORD AXIS_PTS_X 1 SWORD INDEX_INCR DIRECT /end RECORD_LAYOUT
/begin RECORD_LAYOUT Lookup2D_ULONG FNC_VALUES 1 ULONG COLUMN_DIR DIRECT /end RECORD_LAYOUT
/begin CHARACTERISTIC KOUTP_CoolFanReq_pct_maxval "" VALUE 0x0000 /* @ECU_Address@KOUTP_CoolFanReq_pct_maxval@ */ Scalar_FLOAT32_IEEE 0 SWC_OUTP_type_CM_single_pct -65535.0 65535.0 /end CHARACTERISTIC
/begin CHARACTERISTIC KOUTP_CoolFanReq_pct_minval "" VALUE 0x0000 /* @ECU_Address@KOUTP_CoolFanReq_pct_minval@ */ Scalar_FLOAT32_IEEE 0 SWC_OUTP_type_CM_single_pct -65535.0 65535.0 /end CHARACTERISTIC
/begin CHARACTERISTIC KOUTP_CoolFanReq_pct_ovrdval "" VALUE 0x0000 /* @ECU_Address@KOUTP_CoolFanReq_pct_ovrdval@ */ Scalar_FLOAT32_IEEE 0 SWC_OUTP_type_CM_single_pct -65535.0 65535.0 /end CHARACTERISTIC
/begin CHARACTERISTIC KOUTP_EWPPEReq_rpm_maxval "" VALUE 0x0000 /* @ECU_Address@KOUTP_EWPPEReq_rpm_maxval@ */ Scalar_FLOAT32_IEEE 0 SWC_OUTP_type_CM_single_rpm -65535.0 65535.0 /end CHARACTERISTIC
/begin CHARACTERISTIC KOUTP_EWPPEReq_rpm_minval "" VALUE 0x0000 /* @ECU_Address@KOUTP_EWPPEReq_rpm_minval@ */ Scalar_FLOAT32_IEEE 0 SWC_OUTP_type_CM_single_rpm -65535.0 65535.0 /end CHARACTERISTIC
/begin CHARACTERISTIC KOUTP_EWPPEReq_rpm_ovrdval "" VALUE 0x0000 /* @ECU_Address@KOUTP_EWPPEReq_rpm_ovrdval@ */ Scalar_FLOAT32_IEEE 0 SWC_OUTP_type_CM_single_rpm -65535.0 65535.0 /end CHARACTERISTIC
/begin CHARACTERISTIC KOUTP_FdcSlpTime_sec_maxval "" VALUE 0x0000 /* @ECU_Address@KOUTP_FdcSlpTime_sec_maxval@ */ Scalar_FLOAT32_IEEE 0 SWC_OUTP_type_CM_single_sec -65535.0 1.0E+7 /end CHARACTERISTIC
/begin CHARACTERISTIC KOUTP_FdcSlpTime_sec_minval "" VALUE 0x0000 /* @ECU_Address@KOUTP_FdcSlpTime_sec_minval@ */ Scalar_FLOAT32_IEEE 0 SWC_OUTP_type_CM_single_sec -65535.0 1.0E+7 /end CHARACTERISTIC
/begin CHARACTERISTIC KOUTP_FdcSlpTime_sec_ovrdval "" VALUE 0x0000 /* @ECU_Address@KOUTP_FdcSlpTime_sec_ovrdval@ */ Scalar_FLOAT32_IEEE 0 SWC_OUTP_type_CM_single_sec -65535.0 1.0E+7 /end CHARACTERISTIC
/begin CHARACTERISTIC KOUTP_LFWheelTemp_C_maxval "" VALUE 0x0000 /* @ECU_Address@KOUTP_LFWheelTemp_C_maxval@ */ Scalar_FLOAT32_IEEE 0 SWC_OUTP_type_CM_single_C -65535.0 65535.0 /end CHARACTERISTIC
/begin CHARACTERISTIC KOUTP_LFWheelTemp_C_minval "" VALUE 0x0000 /* @ECU_Address@KOUTP_LFWheelTemp_C_minval@ */ Scalar_FLOAT32_IEEE 0 SWC_OUTP_type_CM_single_C -65535.0 65535.0 /end CHARACTERISTIC
/begin CHARACTERISTIC KOUTP_LFWheelTemp_C_ovrdval "" VALUE 0x0000 /* @ECU_Address@KOUTP_LFWheelTemp_C_ovrdval@ */ Scalar_FLOAT32_IEEE 0 SWC_OUTP_type_CM_single_C -65535.0 65535.0 /end CHARACTERISTIC
/begin CHARACTERISTIC KOUTP_LRWheelTemp_C_maxval "" VALUE 0x0000 /* @ECU_Address@KOUTP_LRWheelTemp_C_maxval@ */ Scalar_FLOAT32_IEEE 0 SWC_OUTP_type_CM_single_C -65535.0 65535.0 /end CHARACTERISTIC
/begin CHARACTERISTIC KOUTP_LRWheelTemp_C_minval "" VALUE 0x0000 /* @ECU_Address@KOUTP_LRWheelTemp_C_minval@ */ Scalar_FLOAT32_IEEE 0 SWC_OUTP_type_CM_single_C -65535.0 65535.0 /end CHARACTERISTIC
/begin CHARACTERISTIC KOUTP_LRWheelTemp_C_ovrdval "" VALUE 0x0000 /* @ECU_Address@KOUTP_LRWheelTemp_C_ovrdval@ */ Scalar_FLOAT32_IEEE 0 SWC_OUTP_type_CM_single_C -65535.0 65535.0 /end CHARACTERISTIC
/begin CHARACTERISTIC KOUTP_RFWheelTemp_C_maxval "" VALUE 0x0000 /* @ECU_Address@KOUTP_RFWheelTemp_C_maxval@ */ Scalar_FLOAT32_IEEE 0 SWC_OUTP_type_CM_single_C -65535.0 65535.0 /end CHARACTERISTIC
/begin CHARACTERISTIC KOUTP_RFWheelTemp_C_minval "" VALUE 0x0000 /* @ECU_Address@KOUTP_RFWheelTemp_C_minval@ */ Scalar_FLOAT32_IEEE 0 SWC_OUTP_type_CM_single_C -65535.0 65535.0 /end CHARACTERISTIC
/begin CHARACTERISTIC KOUTP_RFWheelTemp_C_ovrdval "" VALUE 0x0000 /* @ECU_Address@KOUTP_RFWheelTemp_C_ovrdval@ */ Scalar_FLOAT32_IEEE 0 SWC_OUTP_type_CM_single_C -65535.0 65535.0 /end CHARACTERISTIC
/begin CHARACTERISTIC KOUTP_CFGEM1BAMPGN_raw_maxval "" VALUE 0x0000 /* @ECU_Address@KOUTP_CFGEM1BAMPGN_raw_maxval@ */ Scalar_ULONG 0 SWC_OUTP_type_CM_uint32_enum 0.0 4.294967295E+9 /end CHARACTERISTIC
/begin CHARACTERISTIC KOUTP_CFGEM1BAMPGN_raw_minval "" VALUE 0x0000 /* @ECU_Address@KOUTP_CFGEM1BAMPGN_raw_minval@ */ Scalar_ULONG 0 SWC_OUTP_type_CM_uint32_enum 0.0 4.294967295E+9 /end CHARACTERISTIC
/begin CHARACTERISTIC KOUTP_CFGEM1BAMPGN_raw_ovrdval "" VALUE 0x0000 /* @ECU_Address@KOUTP_CFGEM1BAMPGN_raw_ovrdval@ */ Scalar_ULONG 0 SWC_OUTP_type_CM_uint32_raw 0.0 4.294967295E+9 /end CHARACTERISTIC
/begin CHARACTERISTIC KOUTP_FlashS1ID_raw_maxval "" VALUE 0x0000 /* @ECU_Address@KOUTP_FlashS1ID_raw_maxval@ */ Scalar_ULONG 0 SWC_OUTP_type_CM_uint32_raw32 0.0 4.294967295E+9 /end CHARACTERISTIC
/begin CHARACTERISTIC KOUTP_FlashS1ID_raw_minval "" VALUE 0x0000 /* @ECU_Address@KOUTP_FlashS1ID_raw_minval@ */ Scalar_ULONG 0 SWC_OUTP_type_CM_uint32_raw32 0.0 4.294967295E+9 /end CHARACTERISTIC
/begin CHARACTERISTIC KOUTP_FlashS1ID_raw_ovrdval "" VALUE 0x0000 /* @ECU_Address@KOUTP_FlashS1ID_raw_ovrdval@ */ Scalar_ULONG 0 SWC_OUTP_type_CM_uint32_raw 0.0 4.294967295E+9 /end CHARACTERISTIC
/begin CHARACTERISTIC KOUTP_FlashS2ID_raw_maxval "" VALUE 0x0000 /* @ECU_Address@KOUTP_FlashS2ID_raw_maxval@ */ Scalar_ULONG 0 SWC_OUTP_type_CM_uint32_raw32 0.0 4.294967295E+9 /end CHARACTERISTIC
/begin CHARACTERISTIC KOUTP_FlashS2ID_raw_minval "" VALUE 0x0000 /* @ECU_Address@KOUTP_FlashS2ID_raw_minval@ */ Scalar_ULONG 0 SWC_OUTP_type_CM_uint32_raw32 0.0 4.294967295E+9 /end CHARACTERISTIC
/begin CHARACTERISTIC KOUTP_FlashS2ID_raw_ovrdval "" VALUE 0x0000 /* @ECU_Address@KOUTP_FlashS2ID_raw_ovrdval@ */ Scalar_ULONG 0 SWC_OUTP_type_CM_uint32_raw 0.0 4.294967295E+9 /end CHARACTERISTIC
/begin CHARACTERISTIC KOUTP_FlashS3ID_raw_maxval "" VALUE 0x0000 /* @ECU_Address@KOUTP_FlashS3ID_raw_maxval@ */ Scalar_ULONG 0 SWC_OUTP_type_CM_uint32_raw32 0.0 4.294967295E+9 /end CHARACTERISTIC
/begin CHARACTERISTIC KOUTP_FlashS3ID_raw_minval "" VALUE 0x0000 /* @ECU_Address@KOUTP_FlashS3ID_raw_minval@ */ Scalar_ULONG 0 SWC_OUTP_type_CM_uint32_raw32 0.0 4.294967295E+9 /end CHARACTERISTIC
/begin CHARACTERISTIC KOUTP_FlashS3ID_raw_ovrdval "" VALUE 0x0000 /* @ECU_Address@KOUTP_FlashS3ID_raw_ovrdval@ */ Scalar_ULONG 0 SWC_OUTP_type_CM_uint32_raw 0.0 4.294967295E+9 /end CHARACTERISTIC
/begin CHARACTERISTIC KOUTP_FlashS4ID_raw_maxval "" VALUE 0x0000 /* @ECU_Address@KOUTP_FlashS4ID_raw_maxval@ */ Scalar_ULONG 0 SWC_OUTP_type_CM_uint32_raw32 0.0 4.294967295E+9 /end CHARACTERISTIC
/begin CHARACTERISTIC KOUTP_FlashS4ID_raw_minval "" VALUE 0x0000 /* @ECU_Address@KOUTP_FlashS4ID_raw_minval@ */ Scalar_ULONG 0 SWC_OUTP_type_CM_uint32_raw32 0.0 4.294967295E+9 /end CHARACTERISTIC
/begin CHARACTERISTIC KOUTP_FlashS4ID_raw_ovrdval "" VALUE 0x0000 /* @ECU_Address@KOUTP_FlashS4ID_raw_ovrdval@ */ Scalar_ULONG 0 SWC_OUTP_type_CM_uint32_raw 0.0 4.294967295E+9 /end CHARACTERISTIC
/begin CHARACTERISTIC KOUTP_IDin_raw32_maxval "" VALUE 0x0000 /* @ECU_Address@KOUTP_IDin_raw32_maxval@ */ Scalar_ULONG 0 SWC_OUTP_type_CM_uint32_raw32 0.0 4.294967295E+9 /end CHARACTERISTIC
/begin CHARACTERISTIC KOUTP_IDin_raw32_minval "" VALUE 0x0000 /* @ECU_Address@KOUTP_IDin_raw32_minval@ */ Scalar_ULONG 0 SWC_OUTP_type_CM_uint32_raw32 0.0 4.294967295E+9 /end CHARACTERISTIC
/begin CHARACTERISTIC KOUTP_IDin_raw32_ovrdval "" VALUE 0x0000 /* @ECU_Address@KOUTP_IDin_raw32_ovrdval@ */ Scalar_ULONG 0 SWC_OUTP_type_CM_uint32_raw32 0.0 4.294967295E+9 /end CHARACTERISTIC
/begin CHARACTERISTIC KOUTP_PmicBootPath_raw32_maxval "" VALUE 0x0000 /* @ECU_Address@KOUTP_PmicBootPath_raw32_maxval@ */ Scalar_ULONG 0 SWC_OUTP_type_CM_uint32_cnt 0.0 4.294967295E+9 /end CHARACTERISTIC
/begin CHARACTERISTIC KOUTP_PmicBootPath_raw32_minval "" VALUE 0x0000 /* @ECU_Address@KOUTP_PmicBootPath_raw32_minval@ */ Scalar_ULONG 0 SWC_OUTP_type_CM_uint32_cnt 0.0 4.294967295E+9 /end CHARACTERISTIC
/begin CHARACTERISTIC KOUTP_PmicBootPath_raw32_ovrdval "" VALUE 0x0000 /* @ECU_Address@KOUTP_PmicBootPath_raw32_ovrdval@ */ Scalar_ULONG 0 SWC_OUTP_type_CM_uint32_raw32 0.0 4.294967295E+9 /end CHARACTERISTIC
/begin CHARACTERISTIC KOUTP_WisrBootReason_raw32_maxval "" VALUE 0x0000 /* @ECU_Address@KOUTP_WisrBootReason_raw32_maxval@ */ Scalar_ULONG 0 SWC_OUTP_type_CM_uint32_cnt 0.0 4.294967295E+9 /end CHARACTERISTIC
/begin CHARACTERISTIC KOUTP_WisrBootReason_raw32_minval "" VALUE 0x0000 /* @ECU_Address@KOUTP_WisrBootReason_raw32_minval@ */ Scalar_ULONG 0 SWC_OUTP_type_CM_uint32_cnt 0.0 4.294967295E+9 /end CHARACTERISTIC
/begin CHARACTERISTIC KOUTP_WisrBootReason_raw32_ovrdval "" VALUE 0x0000 /* @ECU_Address@KOUTP_WisrBootReason_raw32_ovrdval@ */ Scalar_ULONG 0 SWC_OUTP_type_CM_uint32_raw32 0.0 4.294967295E+9 /end CHARACTERISTIC
/begin CHARACTERISTIC KOUTP_CFGEM1BAMTSize_raw_maxval "" VALUE 0x0000 /* @ECU_Address@KOUTP_CFGEM1BAMTSize_raw_maxval@ */ Scalar_UWORD 0 SWC_OUTP_type_CM_uint16_enum 0.0 65535.0 /end CHARACTERISTIC
/begin CHARACTERISTIC KOUTP_CFGEM1BAMTSize_raw_minval "" VALUE 0x0000 /* @ECU_Address@KOUTP_CFGEM1BAMTSize_raw_minval@ */ Scalar_UWORD 0 SWC_OUTP_type_CM_uint16_enum 0.0 65535.0 /end CHARACTERISTIC
/begin CHARACTERISTIC KOUTP_CFGEM1BAMTSize_raw_ovrdval "" VALUE 0x0000 /* @ECU_Address@KOUTP_CFGEM1BAMTSize_raw_ovrdval@ */ Scalar_UWORD 0 SWC_OUTP_type_CM_uint16_raw 0.0 65535.0 /end CHARACTERISTIC
/begin CHARACTERISTIC KOUTP_ALFin_flg_maxval "" VALUE 0x0000 /* @ECU_Address@KOUTP_ALFin_flg_maxval@ */ Scalar_BOOLEAN 0 SWC_OUTP_type_CM_boolean_flg 0.0 1.0 /end CHARACTERISTIC
/begin CHARACTERISTIC KOUTP_ALFin_flg_minval "" VALUE 0x0000 /* @ECU_Address@KOUTP_ALFin_flg_minval@ */ Scalar_BOOLEAN 0 SWC_OUTP_type_CM_boolean_flg 0.0 1.0 /end CHARACTERISTIC
/begin CHARACTERISTIC KOUTP_ALFin_flg_ovrdflg "" VALUE 0x0000 /* @ECU_Address@KOUTP_ALFin_flg_ovrdflg@ */ Scalar_BOOLEAN 0 SWC_OUTP_type_CM_boolean_flg 0.0 1.0 /end CHARACTERISTIC
/begin CHARACTERISTIC KOUTP_ALFin_flg_ovrdval "" VALUE 0x0000 /* @ECU_Address@KOUTP_ALFin_flg_ovrdval@ */ Scalar_BOOLEAN 0 SWC_OUTP_type_CM_boolean_flg 0.0 1.0 /end CHARACTERISTIC
/begin CHARACTERISTIC KOUTP_AcoreRebootCmdACK_flg_maxval "" VALUE 0x0000 /* @ECU_Address@KOUTP_AcoreRebootCmdACK_flg_maxval@ */ Scalar_BOOLEAN 0 SWC_OUTP_type_CM_boolean_flg 0.0 1.0 /end CHARACTERISTIC
/begin CHARACTERISTIC KOUTP_AcoreRebootCmdACK_flg_minval "" VALUE 0x0000 /* @ECU_Address@KOUTP_AcoreRebootCmdACK_flg_minval@ */ Scalar_BOOLEAN 0 SWC_OUTP_type_CM_boolean_flg 0.0 1.0 /end CHARACTERISTIC
/begin CHARACTERISTIC KOUTP_AcoreRebootCmdACK_flg_ovrdflg "" VALUE 0x0000 /* @ECU_Address@KOUTP_AcoreRebootCmdACK_flg_ovrdflg@ */ Scalar_BOOLEAN 0 SWC_OUTP_type_CM_boolean_flg 0.0 1.0 /end CHARACTERISTIC
/begin CHARACTERISTIC KOUTP_AcoreRebootCmdACK_flg_ovrdval "" VALUE 0x0000 /* @ECU_Address@KOUTP_AcoreRebootCmdACK_flg_ovrdval@ */ Scalar_BOOLEAN 0 SWC_OUTP_type_CM_boolean_flg 0.0 1.0 /end CHARACTERISTIC
/begin CHARACTERISTIC KOUTP_AfterrunningMode_flg_maxval "" VALUE 0x0000 /* @ECU_Address@KOUTP_AfterrunningMode_flg_maxval@ */ Scalar_BOOLEAN 0 SWC_OUTP_type_CM_boolean_flg 0.0 1.0 /end CHARACTERISTIC
/begin CHARACTERISTIC KOUTP_AfterrunningMode_flg_minval "" VALUE 0x0000 /* @ECU_Address@KOUTP_AfterrunningMode_flg_minval@ */ Scalar_BOOLEAN 0 SWC_OUTP_type_CM_boolean_flg 0.0 1.0 /end CHARACTERISTIC
/begin CHARACTERISTIC KOUTP_AfterrunningMode_flg_ovrdflg "" VALUE 0x0000 /* @ECU_Address@KOUTP_AfterrunningMode_flg_ovrdflg@ */ Scalar_BOOLEAN 0 SWC_OUTP_type_CM_boolean_flg 0.0 1.0 /end CHARACTERISTIC
/begin CHARACTERISTIC KOUTP_AfterrunningMode_flg_ovrdval "" VALUE 0x0000 /* @ECU_Address@KOUTP_AfterrunningMode_flg_ovrdval@ */ Scalar_BOOLEAN 0 SWC_OUTP_type_CM_boolean_flg 0.0 1.0 /end CHARACTERISTIC
/begin CHARACTERISTIC KOUTP_AutoLTips_enum_ovrdflg "" VALUE 0x0000 /* @ECU_Address@KOUTP_AutoLTips_enum_ovrdflg@ */ Scalar_BOOLEAN 0 SWC_OUTP_type_CM_boolean_flg 0.0 1.0 /end CHARACTERISTIC
/begin CHARACTERISTIC KOUTP_CFGEM1BAMPGN_raw_ovrdflg "" VALUE 0x0000 /* @ECU_Address@KOUTP_CFGEM1BAMPGN_raw_ovrdflg@ */ Scalar_BOOLEAN 0 SWC_OUTP_type_CM_boolean_flg 0.0 1.0 /end CHARACTERISTIC
/begin CHARACTERISTIC KOUTP_CFGEM1BAMRsv_raw_ovrdflg "" VALUE 0x0000 /* @ECU_Address@KOUTP_CFGEM1BAMRsv_raw_ovrdflg@ */ Scalar_BOOLEAN 0 SWC_OUTP_type_CM_boolean_flg 0.0 1.0 /end CHARACTERISTIC
/begin CHARACTERISTIC KOUTP_CFGEM1BAMTNum_raw_ovrdflg "" VALUE 0x0000 /* @ECU_Address@KOUTP_CFGEM1BAMTNum_raw_ovrdflg@ */ Scalar_BOOLEAN 0 SWC_OUTP_type_CM_boolean_flg 0.0 1.0 /end CHARACTERISTIC
/begin CHARACTERISTIC KOUTP_CFGEM1BAMTSize_raw_ovrdflg "" VALUE 0x0000 /* @ECU_Address@KOUTP_CFGEM1BAMTSize_raw_ovrdflg@ */ Scalar_BOOLEAN 0 SWC_OUTP_type_CM_boolean_flg 0.0 1.0 /end CHARACTERISTIC
/begin CHARACTERISTIC KOUTP_CFGEM1Ctrl_raw_ovrdflg "" VALUE 0x0000 /* @ECU_Address@KOUTP_CFGEM1Ctrl_raw_ovrdflg@ */ Scalar_BOOLEAN 0 SWC_OUTP_type_CM_boolean_flg 0.0 1.0 /end CHARACTERISTIC
/begin CHARACTERISTIC KOUTP_CWheelTips_enum_ovrdflg "" VALUE 0x0000 /* @ECU_Address@KOUTP_CWheelTips_enum_ovrdflg@ */ Scalar_BOOLEAN 0 SWC_OUTP_type_CM_boolean_flg 0.0 1.0 /end CHARACTERISTIC
/begin CHARACTERISTIC KOUTP_CarModel1_cnt_ovrdflg "" VALUE 0x0000 /* @ECU_Address@KOUTP_CarModel1_cnt_ovrdflg@ */ Scalar_BOOLEAN 0 SWC_OUTP_type_CM_boolean_flg 0.0 1.0 /end CHARACTERISTIC
/begin CHARACTERISTIC KOUTP_CarModel2_cnt_ovrdflg "" VALUE 0x0000 /* @ECU_Address@KOUTP_CarModel2_cnt_ovrdflg@ */ Scalar_BOOLEAN 0 SWC_OUTP_type_CM_boolean_flg 0.0 1.0 /end CHARACTERISTIC
/begin CHARACTERISTIC KOUTP_CarModel3_cnt_ovrdflg "" VALUE 0x0000 /* @ECU_Address@KOUTP_CarModel3_cnt_ovrdflg@ */ Scalar_BOOLEAN 0 SWC_OUTP_type_CM_boolean_flg 0.0 1.0 /end CHARACTERISTIC
/begin CHARACTERISTIC KOUTP_Change1_cnt_ovrdflg "" VALUE 0x0000 /* @ECU_Address@KOUTP_Change1_cnt_ovrdflg@ */ Scalar_BOOLEAN 0 SWC_OUTP_type_CM_boolean_flg 0.0 1.0 /end CHARACTERISTIC
/begin CHARACTERISTIC KOUTP_Change2_cnt_ovrdflg "" VALUE 0x0000 /* @ECU_Address@KOUTP_Change2_cnt_ovrdflg@ */ Scalar_BOOLEAN 0 SWC_OUTP_type_CM_boolean_flg 0.0 1.0 /end CHARACTERISTIC
/begin CHARACTERISTIC KOUTP_ChkStorge_flg_maxval "" VALUE 0x0000 /* @ECU_Address@KOUTP_ChkStorge_flg_maxval@ */ Scalar_BOOLEAN 0 SWC_OUTP_type_CM_boolean_flg 0.0 1.0 /end CHARACTERISTIC
/begin CHARACTERISTIC KOUTP_ChkStorge_flg_minval "" VALUE 0x0000 /* @ECU_Address@KOUTP_ChkStorge_flg_minval@ */ Scalar_BOOLEAN 0 SWC_OUTP_type_CM_boolean_flg 0.0 1.0 /end CHARACTERISTIC
/begin CHARACTERISTIC KOUTP_ChkStorge_flg_ovrdflg "" VALUE 0x0000 /* @ECU_Address@KOUTP_ChkStorge_flg_ovrdflg@ */ Scalar_BOOLEAN 0 SWC_OUTP_type_CM_boolean_flg 0.0 1.0 /end CHARACTERISTIC
/begin CHARACTERISTIC KOUTP_ChkStorge_flg_ovrdval "" VALUE 0x0000 /* @ECU_Address@KOUTP_ChkStorge_flg_ovrdval@ */ Scalar_BOOLEAN 0 SWC_OUTP_type_CM_boolean_flg 0.0 1.0 /end CHARACTERISTIC
/begin CHARACTERISTIC KOUTP_Chkfin_flg_maxval "" VALUE 0x0000 /* @ECU_Address@KOUTP_Chkfin_flg_maxval@ */ Scalar_BOOLEAN 0 SWC_OUTP_type_CM_boolean_flg 0.0 1.0 /end CHARACTERISTIC
/begin CHARACTERISTIC KOUTP_Chkfin_flg_minval "" VALUE 0x0000 /* @ECU_Address@KOUTP_Chkfin_flg_minval@ */ Scalar_BOOLEAN 0 SWC_OUTP_type_CM_boolean_flg 0.0 1.0 /end CHARACTERISTIC
/begin CHARACTERISTIC KOUTP_Chkfin_flg_ovrdflg "" VALUE 0x0000 /* @ECU_Address@KOUTP_Chkfin_flg_ovrdflg@ */ Scalar_BOOLEAN 0 SWC_OUTP_type_CM_boolean_flg 0.0 1.0 /end CHARACTERISTIC
/begin CHARACTERISTIC KOUTP_Chkfin_flg_ovrdval "" VALUE 0x0000 /* @ECU_Address@KOUTP_Chkfin_flg_ovrdval@ */ Scalar_BOOLEAN 0 SWC_OUTP_type_CM_boolean_flg 0.0 1.0 /end CHARACTERISTIC
/begin CHARACTERISTIC KOUTP_CoolFanReq_pct_ovrdflg "" VALUE 0x0000 /* @ECU_Address@KOUTP_CoolFanReq_pct_ovrdflg@ */ Scalar_BOOLEAN 0 SWC_OUTP_type_CM_boolean_flg 0.0 1.0 /end CHARACTERISTIC
/begin CHARACTERISTIC KOUTP_Country1_cnt_ovrdflg "" VALUE 0x0000 /* @ECU_Address@KOUTP_Country1_cnt_ovrdflg@ */ Scalar_BOOLEAN 0 SWC_OUTP_type_CM_boolean_flg 0.0 1.0 /end CHARACTERISTIC
/begin CHARACTERISTIC KOUTP_Country2_cnt_ovrdflg "" VALUE 0x0000 /* @ECU_Address@KOUTP_Country2_cnt_ovrdflg@ */ Scalar_BOOLEAN 0 SWC_OUTP_type_CM_boolean_flg 0.0 1.0 /end CHARACTERISTIC
/begin CHARACTERISTIC KOUTP_CurrentNmState_enum_ovrdflg "" VALUE 0x0000 /* @ECU_Address@KOUTP_CurrentNmState_enum_ovrdflg@ */ Scalar_BOOLEAN 0 SWC_OUTP_type_CM_boolean_flg 0.0 1.0 /end CHARACTERISTIC
/begin CHARACTERISTIC KOUTP_DTbyte0_raw_ovrdflg "" VALUE 0x0000 /* @ECU_Address@KOUTP_DTbyte0_raw_ovrdflg@ */ Scalar_BOOLEAN 0 SWC_OUTP_type_CM_boolean_flg 0.0 1.0 /end CHARACTERISTIC
/begin CHARACTERISTIC KOUTP_DTbyte1_raw_ovrdflg "" VALUE 0x0000 /* @ECU_Address@KOUTP_DTbyte1_raw_ovrdflg@ */ Scalar_BOOLEAN 0 SWC_OUTP_type_CM_boolean_flg 0.0 1.0 /end CHARACTERISTIC
/begin CHARACTERISTIC KOUTP_DTbyte2_raw_ovrdflg "" VALUE 0x0000 /* @ECU_Address@KOUTP_DTbyte2_raw_ovrdflg@ */ Scalar_BOOLEAN 0 SWC_OUTP_type_CM_boolean_flg 0.0 1.0 /end CHARACTERISTIC
/begin CHARACTERISTIC KOUTP_DTbyte3_raw_ovrdflg "" VALUE 0x0000 /* @ECU_Address@KOUTP_DTbyte3_raw_ovrdflg@ */ Scalar_BOOLEAN 0 SWC_OUTP_type_CM_boolean_flg 0.0 1.0 /end CHARACTERISTIC
/begin CHARACTERISTIC KOUTP_DTbyte4_raw_ovrdflg "" VALUE 0x0000 /* @ECU_Address@KOUTP_DTbyte4_raw_ovrdflg@ */ Scalar_BOOLEAN 0 SWC_OUTP_type_CM_boolean_flg 0.0 1.0 /end CHARACTERISTIC
/begin CHARACTERISTIC KOUTP_DTbyte5_raw_ovrdflg "" VALUE 0x0000 /* @ECU_Address@KOUTP_DTbyte5_raw_ovrdflg@ */ Scalar_BOOLEAN 0 SWC_OUTP_type_CM_boolean_flg 0.0 1.0 /end CHARACTERISTIC
/begin CHARACTERISTIC KOUTP_DTbyte6_raw_ovrdflg "" VALUE 0x0000 /* @ECU_Address@KOUTP_DTbyte6_raw_ovrdflg@ */ Scalar_BOOLEAN 0 SWC_OUTP_type_CM_boolean_flg 0.0 1.0 /end CHARACTERISTIC
/begin CHARACTERISTIC KOUTP_DTbyte7_raw_ovrdflg "" VALUE 0x0000 /* @ECU_Address@KOUTP_DTbyte7_raw_ovrdflg@ */ Scalar_BOOLEAN 0 SWC_OUTP_type_CM_boolean_flg 0.0 1.0 /end CHARACTERISTIC
/begin CHARACTERISTIC KOUTP_Dash1_cnt_ovrdflg "" VALUE 0x0000 /* @ECU_Address@KOUTP_Dash1_cnt_ovrdflg@ */ Scalar_BOOLEAN 0 SWC_OUTP_type_CM_boolean_flg 0.0 1.0 /end CHARACTERISTIC
/begin CHARACTERISTIC KOUTP_Dash2_cnt_ovrdflg "" VALUE 0x0000 /* @ECU_Address@KOUTP_Dash2_cnt_ovrdflg@ */ Scalar_BOOLEAN 0 SWC_OUTP_type_CM_boolean_flg 0.0 1.0 /end CHARACTERISTIC
/begin CHARACTERISTIC KOUTP_DrivingMode_cnt_ovrdflg "" VALUE 0x0000 /* @ECU_Address@KOUTP_DrivingMode_cnt_ovrdflg@ */ Scalar_BOOLEAN 0 SWC_OUTP_type_CM_boolean_flg 0.0 1.0 /end CHARACTERISTIC
/begin CHARACTERISTIC KOUTP_ECU1_cnt_ovrdflg "" VALUE 0x0000 /* @ECU_Address@KOUTP_ECU1_cnt_ovrdflg@ */ Scalar_BOOLEAN 0 SWC_OUTP_type_CM_boolean_flg 0.0 1.0 /end CHARACTERISTIC
/begin CHARACTERISTIC KOUTP_ECU2_cnt_ovrdflg "" VALUE 0x0000 /* @ECU_Address@KOUTP_ECU2_cnt_ovrdflg@ */ Scalar_BOOLEAN 0 SWC_OUTP_type_CM_boolean_flg 0.0 1.0 /end CHARACTERISTIC
/begin CHARACTERISTIC KOUTP_ECUGen1_cnt_ovrdflg "" VALUE 0x0000 /* @ECU_Address@KOUTP_ECUGen1_cnt_ovrdflg@ */ Scalar_BOOLEAN 0 SWC_OUTP_type_CM_boolean_flg 0.0 1.0 /end CHARACTERISTIC
/begin CHARACTERISTIC KOUTP_ECUGen2_cnt_ovrdflg "" VALUE 0x0000 /* @ECU_Address@KOUTP_ECUGen2_cnt_ovrdflg@ */ Scalar_BOOLEAN 0 SWC_OUTP_type_CM_boolean_flg 0.0 1.0 /end CHARACTERISTIC
/begin CHARACTERISTIC KOUTP_EWPPEReq_rpm_ovrdflg "" VALUE 0x0000 /* @ECU_Address@KOUTP_EWPPEReq_rpm_ovrdflg@ */ Scalar_BOOLEAN 0 SWC_OUTP_type_CM_boolean_flg 0.0 1.0 /end CHARACTERISTIC
/begin CHARACTERISTIC KOUTP_EmergencyShutDown_flg_maxval "" VALUE 0x0000 /* @ECU_Address@KOUTP_EmergencyShutDown_flg_maxval@ */ Scalar_BOOLEAN 0 SWC_OUTP_type_CM_boolean_flg 0.0 1.0 /end CHARACTERISTIC
/begin CHARACTERISTIC KOUTP_EmergencyShutDown_flg_minval "" VALUE 0x0000 /* @ECU_Address@KOUTP_EmergencyShutDown_flg_minval@ */ Scalar_BOOLEAN 0 SWC_OUTP_type_CM_boolean_flg 0.0 1.0 /end CHARACTERISTIC
/begin CHARACTERISTIC KOUTP_EmergencyShutDown_flg_ovrdflg "" VALUE 0x0000 /* @ECU_Address@KOUTP_EmergencyShutDown_flg_ovrdflg@ */ Scalar_BOOLEAN 0 SWC_OUTP_type_CM_boolean_flg 0.0 1.0 /end CHARACTERISTIC
/begin CHARACTERISTIC KOUTP_EmergencyShutDown_flg_ovrdval "" VALUE 0x0000 /* @ECU_Address@KOUTP_EmergencyShutDown_flg_ovrdval@ */ Scalar_BOOLEAN 0 SWC_OUTP_type_CM_boolean_flg 0.0 1.0 /end CHARACTERISTIC
/begin CHARACTERISTIC KOUTP_FAT_flg_maxval "" VALUE 0x0000 /* @ECU_Address@KOUTP_FAT_flg_maxval@ */ Scalar_BOOLEAN 0 SWC_OUTP_type_CM_boolean_flg 0.0 1.0 /end CHARACTERISTIC
/begin CHARACTERISTIC KOUTP_FAT_flg_minval "" VALUE 0x0000 /* @ECU_Address@KOUTP_FAT_flg_minval@ */ Scalar_BOOLEAN 0 SWC_OUTP_type_CM_boolean_flg 0.0 1.0 /end CHARACTERISTIC
/begin CHARACTERISTIC KOUTP_FAT_flg_ovrdflg "" VALUE 0x0000 /* @ECU_Address@KOUTP_FAT_flg_ovrdflg@ */ Scalar_BOOLEAN 0 SWC_OUTP_type_CM_boolean_flg 0.0 1.0 /end CHARACTERISTIC
/begin CHARACTERISTIC KOUTP_FAT_flg_ovrdval "" VALUE 0x0000 /* @ECU_Address@KOUTP_FAT_flg_ovrdval@ */ Scalar_BOOLEAN 0 SWC_OUTP_type_CM_boolean_flg 0.0 1.0 /end CHARACTERISTIC
/begin CHARACTERISTIC KOUTP_FdcSlpReqRisingEdge_flg_maxval "" VALUE 0x0000 /* @ECU_Address@KOUTP_FdcSlpReqRisingEdge_flg_maxval@ */ Scalar_BOOLEAN 0 SWC_OUTP_type_CM_boolean_flg 0.0 1.0 /end CHARACTERISTIC
/begin CHARACTERISTIC KOUTP_FdcSlpReqRisingEdge_flg_minval "" VALUE 0x0000 /* @ECU_Address@KOUTP_FdcSlpReqRisingEdge_flg_minval@ */ Scalar_BOOLEAN 0 SWC_OUTP_type_CM_boolean_flg 0.0 1.0 /end CHARACTERISTIC
/begin CHARACTERISTIC KOUTP_FdcSlpReqRisingEdge_flg_ovrdflg "" VALUE 0x0000 /* @ECU_Address@KOUTP_FdcSlpReqRisingEdge_flg_ovrdflg@ */ Scalar_BOOLEAN 0 SWC_OUTP_type_CM_boolean_flg 0.0 1.0 /end CHARACTERISTIC
/begin CHARACTERISTIC KOUTP_FdcSlpReqRisingEdge_flg_ovrdval "" VALUE 0x0000 /* @ECU_Address@KOUTP_FdcSlpReqRisingEdge_flg_ovrdval@ */ Scalar_BOOLEAN 0 SWC_OUTP_type_CM_boolean_flg 0.0 1.0 /end CHARACTERISTIC
/begin CHARACTERISTIC KOUTP_FdcSlpTime_sec_ovrdflg "" VALUE 0x0000 /* @ECU_Address@KOUTP_FdcSlpTime_sec_ovrdflg@ */ Scalar_BOOLEAN 0 SWC_OUTP_type_CM_boolean_flg 0.0 1.0 /end CHARACTERISTIC
/begin CHARACTERISTIC KOUTP_FlashIDvalid_enum_ovrdflg "" VALUE 0x0000 /* @ECU_Address@KOUTP_FlashIDvalid_enum_ovrdflg@ */ Scalar_BOOLEAN 0 SWC_OUTP_type_CM_boolean_flg 0.0 1.0 /end CHARACTERISTIC
/begin CHARACTERISTIC KOUTP_FlashS1ID_raw_ovrdflg "" VALUE 0x0000 /* @ECU_Address@KOUTP_FlashS1ID_raw_ovrdflg@ */ Scalar_BOOLEAN 0 SWC_OUTP_type_CM_boolean_flg 0.0 1.0 /end CHARACTERISTIC
/begin CHARACTERISTIC KOUTP_FlashS2ID_raw_ovrdflg "" VALUE 0x0000 /* @ECU_Address@KOUTP_FlashS2ID_raw_ovrdflg@ */ Scalar_BOOLEAN 0 SWC_OUTP_type_CM_boolean_flg 0.0 1.0 /end CHARACTERISTIC
/begin CHARACTERISTIC KOUTP_FlashS3ID_raw_ovrdflg "" VALUE 0x0000 /* @ECU_Address@KOUTP_FlashS3ID_raw_ovrdflg@ */ Scalar_BOOLEAN 0 SWC_OUTP_type_CM_boolean_flg 0.0 1.0 /end CHARACTERISTIC
/begin CHARACTERISTIC KOUTP_FlashS4ID_raw_ovrdflg "" VALUE 0x0000 /* @ECU_Address@KOUTP_FlashS4ID_raw_ovrdflg@ */ Scalar_BOOLEAN 0 SWC_OUTP_type_CM_boolean_flg 0.0 1.0 /end CHARACTERISTIC
/begin CHARACTERISTIC KOUTP_Flashchkdatavalid_enum_ovrdflg "" VALUE 0x0000 /* @ECU_Address@KOUTP_Flashchkdatavalid_enum_ovrdflg@ */ Scalar_BOOLEAN 0 SWC_OUTP_type_CM_boolean_flg 0.0 1.0 /end CHARACTERISTIC
/begin CHARACTERISTIC KOUTP_Flashdatavalid_enum_ovrdflg "" VALUE 0x0000 /* @ECU_Address@KOUTP_Flashdatavalid_enum_ovrdflg@ */ Scalar_BOOLEAN 0 SWC_OUTP_type_CM_boolean_flg 0.0 1.0 /end CHARACTERISTIC
/begin CHARACTERISTIC KOUTP_HWVer1_cnt_ovrdflg "" VALUE 0x0000 /* @ECU_Address@KOUTP_HWVer1_cnt_ovrdflg@ */ Scalar_BOOLEAN 0 SWC_OUTP_type_CM_boolean_flg 0.0 1.0 /end CHARACTERISTIC
/begin CHARACTERISTIC KOUTP_HWVer2_cnt_ovrdflg "" VALUE 0x0000 /* @ECU_Address@KOUTP_HWVer2_cnt_ovrdflg@ */ Scalar_BOOLEAN 0 SWC_OUTP_type_CM_boolean_flg 0.0 1.0 /end CHARACTERISTIC
/begin CHARACTERISTIC KOUTP_HWVer3_cnt_ovrdflg "" VALUE 0x0000 /* @ECU_Address@KOUTP_HWVer3_cnt_ovrdflg@ */ Scalar_BOOLEAN 0 SWC_OUTP_type_CM_boolean_flg 0.0 1.0 /end CHARACTERISTIC
/begin CHARACTERISTIC KOUTP_ID1messageALTU_raw8_ovrdflg "" VALUE 0x0000 /* @ECU_Address@KOUTP_ID1messageALTU_raw8_ovrdflg@ */ Scalar_BOOLEAN 0 SWC_OUTP_type_CM_boolean_flg 0.0 1.0 /end CHARACTERISTIC
/begin CHARACTERISTIC KOUTP_ID2messageALTU_raw8_ovrdflg "" VALUE 0x0000 /* @ECU_Address@KOUTP_ID2messageALTU_raw8_ovrdflg@ */ Scalar_BOOLEAN 0 SWC_OUTP_type_CM_boolean_flg 0.0 1.0 /end CHARACTERISTIC
/begin CHARACTERISTIC KOUTP_ID3messageALTU_raw8_ovrdflg "" VALUE 0x0000 /* @ECU_Address@KOUTP_ID3messageALTU_raw8_ovrdflg@ */ Scalar_BOOLEAN 0 SWC_OUTP_type_CM_boolean_flg 0.0 1.0 /end CHARACTERISTIC
/begin CHARACTERISTIC KOUTP_ID4messageALTU_raw8_ovrdflg "" VALUE 0x0000 /* @ECU_Address@KOUTP_ID4messageALTU_raw8_ovrdflg@ */ Scalar_BOOLEAN 0 SWC_OUTP_type_CM_boolean_flg 0.0 1.0 /end CHARACTERISTIC
/begin CHARACTERISTIC KOUTP_IDin_raw32_ovrdflg "" VALUE 0x0000 /* @ECU_Address@KOUTP_IDin_raw32_ovrdflg@ */ Scalar_BOOLEAN 0 SWC_OUTP_type_CM_boolean_flg 0.0 1.0 /end CHARACTERISTIC
/begin CHARACTERISTIC KOUTP_Keystatus_enum_ovrdflg "" VALUE 0x0000 /* @ECU_Address@KOUTP_Keystatus_enum_ovrdflg@ */ Scalar_BOOLEAN 0 SWC_OUTP_type_CM_boolean_flg 0.0 1.0 /end CHARACTERISTIC
/begin CHARACTERISTIC KOUTP_LFBatWarn_flg_maxval "" VALUE 0x0000 /* @ECU_Address@KOUTP_LFBatWarn_flg_maxval@ */ Scalar_BOOLEAN 0 SWC_OUTP_type_CM_boolean_flg 0.0 1.0 /end CHARACTERISTIC
/begin CHARACTERISTIC KOUTP_LFBatWarn_flg_minval "" VALUE 0x0000 /* @ECU_Address@KOUTP_LFBatWarn_flg_minval@ */ Scalar_BOOLEAN 0 SWC_OUTP_type_CM_boolean_flg 0.0 1.0 /end CHARACTERISTIC
/begin CHARACTERISTIC KOUTP_LFBatWarn_flg_ovrdflg "" VALUE 0x0000 /* @ECU_Address@KOUTP_LFBatWarn_flg_ovrdflg@ */ Scalar_BOOLEAN 0 SWC_OUTP_type_CM_boolean_flg 0.0 1.0 /end CHARACTERISTIC
/begin CHARACTERISTIC KOUTP_LFBatWarn_flg_ovrdval "" VALUE 0x0000 /* @ECU_Address@KOUTP_LFBatWarn_flg_ovrdval@ */ Scalar_BOOLEAN 0 SWC_OUTP_type_CM_boolean_flg 0.0 1.0 /end CHARACTERISTIC
/begin CHARACTERISTIC KOUTP_LFP20_raw8_ovrdflg "" VALUE 0x0000 /* @ECU_Address@KOUTP_LFP20_raw8_ovrdflg@ */ Scalar_BOOLEAN 0 SWC_OUTP_type_CM_boolean_flg 0.0 1.0 /end CHARACTERISTIC
/begin CHARACTERISTIC KOUTP_LFPindi_enum_ovrdflg "" VALUE 0x0000 /* @ECU_Address@KOUTP_LFPindi_enum_ovrdflg@ */ Scalar_BOOLEAN 0 SWC_OUTP_type_CM_boolean_flg 0.0 1.0 /end CHARACTERISTIC
/begin CHARACTERISTIC KOUTP_LFPressIndi_enum_ovrdflg "" VALUE 0x0000 /* @ECU_Address@KOUTP_LFPressIndi_enum_ovrdflg@ */ Scalar_BOOLEAN 0 SWC_OUTP_type_CM_boolean_flg 0.0 1.0 /end CHARACTERISTIC
/begin CHARACTERISTIC KOUTP_LFSensorFail_flg_maxval "" VALUE 0x0000 /* @ECU_Address@KOUTP_LFSensorFail_flg_maxval@ */ Scalar_BOOLEAN 0 SWC_OUTP_type_CM_boolean_flg 0.0 1.0 /end CHARACTERISTIC
/begin CHARACTERISTIC KOUTP_LFSensorFail_flg_minval "" VALUE 0x0000 /* @ECU_Address@KOUTP_LFSensorFail_flg_minval@ */ Scalar_BOOLEAN 0 SWC_OUTP_type_CM_boolean_flg 0.0 1.0 /end CHARACTERISTIC
/begin CHARACTERISTIC KOUTP_LFSensorFail_flg_ovrdflg "" VALUE 0x0000 /* @ECU_Address@KOUTP_LFSensorFail_flg_ovrdflg@ */ Scalar_BOOLEAN 0 SWC_OUTP_type_CM_boolean_flg 0.0 1.0 /end CHARACTERISTIC
/begin CHARACTERISTIC KOUTP_LFSensorFail_flg_ovrdval "" VALUE 0x0000 /* @ECU_Address@KOUTP_LFSensorFail_flg_ovrdval@ */ Scalar_BOOLEAN 0 SWC_OUTP_type_CM_boolean_flg 0.0 1.0 /end CHARACTERISTIC
/begin CHARACTERISTIC KOUTP_LFSensorMode_flg_maxval "" VALUE 0x0000 /* @ECU_Address@KOUTP_LFSensorMode_flg_maxval@ */ Scalar_BOOLEAN 0 SWC_OUTP_type_CM_boolean_flg 0.0 1.0 /end CHARACTERISTIC
/begin CHARACTERISTIC KOUTP_LFSensorMode_flg_minval "" VALUE 0x0000 /* @ECU_Address@KOUTP_LFSensorMode_flg_minval@ */ Scalar_BOOLEAN 0 SWC_OUTP_type_CM_boolean_flg 0.0 1.0 /end CHARACTERISTIC
/begin CHARACTERISTIC KOUTP_LFSensorMode_flg_ovrdflg "" VALUE 0x0000 /* @ECU_Address@KOUTP_LFSensorMode_flg_ovrdflg@ */ Scalar_BOOLEAN 0 SWC_OUTP_type_CM_boolean_flg 0.0 1.0 /end CHARACTERISTIC
/begin CHARACTERISTIC KOUTP_LFSensorMode_flg_ovrdval "" VALUE 0x0000 /* @ECU_Address@KOUTP_LFSensorMode_flg_ovrdval@ */ Scalar_BOOLEAN 0 SWC_OUTP_type_CM_boolean_flg 0.0 1.0 /end CHARACTERISTIC
/begin CHARACTERISTIC KOUTP_LFWheelDebug_flg_maxval "" VALUE 0x0000 /* @ECU_Address@KOUTP_LFWheelDebug_flg_maxval@ */ Scalar_BOOLEAN 0 SWC_OUTP_type_CM_boolean_flg 0.0 1.0 /end CHARACTERISTIC
/begin CHARACTERISTIC KOUTP_LFWheelDebug_flg_minval "" VALUE 0x0000 /* @ECU_Address@KOUTP_LFWheelDebug_flg_minval@ */ Scalar_BOOLEAN 0 SWC_OUTP_type_CM_boolean_flg 0.0 1.0 /end CHARACTERISTIC
/begin CHARACTERISTIC KOUTP_LFWheelDebug_flg_ovrdflg "" VALUE 0x0000 /* @ECU_Address@KOUTP_LFWheelDebug_flg_ovrdflg@ */ Scalar_BOOLEAN 0 SWC_OUTP_type_CM_boolean_flg 0.0 1.0 /end CHARACTERISTIC
/begin CHARACTERISTIC KOUTP_LFWheelDebug_flg_ovrdval "" VALUE 0x0000 /* @ECU_Address@KOUTP_LFWheelDebug_flg_ovrdval@ */ Scalar_BOOLEAN 0 SWC_OUTP_type_CM_boolean_flg 0.0 1.0 /end CHARACTERISTIC
/begin CHARACTERISTIC KOUTP_LFWheelPSW_raw8_ovrdflg "" VALUE 0x0000 /* @ECU_Address@KOUTP_LFWheelPSW_raw8_ovrdflg@ */ Scalar_BOOLEAN 0 SWC_OUTP_type_CM_boolean_flg 0.0 1.0 /end CHARACTERISTIC
/begin CHARACTERISTIC KOUTP_LFWheelPress_raw8_ovrdflg "" VALUE 0x0000 /* @ECU_Address@KOUTP_LFWheelPress_raw8_ovrdflg@ */ Scalar_BOOLEAN 0 SWC_OUTP_type_CM_boolean_flg 0.0 1.0 /end CHARACTERISTIC
/begin CHARACTERISTIC KOUTP_LFWheelTemp_C_ovrdflg "" VALUE 0x0000 /* @ECU_Address@KOUTP_LFWheelTemp_C_ovrdflg@ */ Scalar_BOOLEAN 0 SWC_OUTP_type_CM_boolean_flg 0.0 1.0 /end CHARACTERISTIC
/begin CHARACTERISTIC KOUTP_LFWheelTmpIndi_flg_maxval "" VALUE 0x0000 /* @ECU_Address@KOUTP_LFWheelTmpIndi_flg_maxval@ */ Scalar_BOOLEAN 0 SWC_OUTP_type_CM_boolean_flg 0.0 1.0 /end CHARACTERISTIC
/begin CHARACTERISTIC KOUTP_LFWheelTmpIndi_flg_minval "" VALUE 0x0000 /* @ECU_Address@KOUTP_LFWheelTmpIndi_flg_minval@ */ Scalar_BOOLEAN 0 SWC_OUTP_type_CM_boolean_flg 0.0 1.0 /end CHARACTERISTIC
/begin CHARACTERISTIC KOUTP_LFWheelTmpIndi_flg_ovrdflg "" VALUE 0x0000 /* @ECU_Address@KOUTP_LFWheelTmpIndi_flg_ovrdflg@ */ Scalar_BOOLEAN 0 SWC_OUTP_type_CM_boolean_flg 0.0 1.0 /end CHARACTERISTIC
/begin CHARACTERISTIC KOUTP_LFWheelTmpIndi_flg_ovrdval "" VALUE 0x0000 /* @ECU_Address@KOUTP_LFWheelTmpIndi_flg_ovrdval@ */ Scalar_BOOLEAN 0 SWC_OUTP_type_CM_boolean_flg 0.0 1.0 /end CHARACTERISTIC
/begin CHARACTERISTIC KOUTP_LProgress_enum_ovrdflg "" VALUE 0x0000 /* @ECU_Address@KOUTP_LProgress_enum_ovrdflg@ */ Scalar_BOOLEAN 0 SWC_OUTP_type_CM_boolean_flg 0.0 1.0 /end CHARACTERISTIC
/begin CHARACTERISTIC KOUTP_LRBatWarn_flg_maxval "" VALUE 0x0000 /* @ECU_Address@KOUTP_LRBatWarn_flg_maxval@ */ Scalar_BOOLEAN 0 SWC_OUTP_type_CM_boolean_flg 0.0 1.0 /end CHARACTERISTIC
/begin CHARACTERISTIC KOUTP_LRBatWarn_flg_minval "" VALUE 0x0000 /* @ECU_Address@KOUTP_LRBatWarn_flg_minval@ */ Scalar_BOOLEAN 0 SWC_OUTP_type_CM_boolean_flg 0.0 1.0 /end CHARACTERISTIC
/begin CHARACTERISTIC KOUTP_LRBatWarn_flg_ovrdflg "" VALUE 0x0000 /* @ECU_Address@KOUTP_LRBatWarn_flg_ovrdflg@ */ Scalar_BOOLEAN 0 SWC_OUTP_type_CM_boolean_flg 0.0 1.0 /end CHARACTERISTIC
/begin CHARACTERISTIC KOUTP_LRBatWarn_flg_ovrdval "" VALUE 0x0000 /* @ECU_Address@KOUTP_LRBatWarn_flg_ovrdval@ */ Scalar_BOOLEAN 0 SWC_OUTP_type_CM_boolean_flg 0.0 1.0 /end CHARACTERISTIC
/begin CHARACTERISTIC KOUTP_LRP20_raw8_ovrdflg "" VALUE 0x0000 /* @ECU_Address@KOUTP_LRP20_raw8_ovrdflg@ */ Scalar_BOOLEAN 0 SWC_OUTP_type_CM_boolean_flg 0.0 1.0 /end CHARACTERISTIC
/begin CHARACTERISTIC KOUTP_LRPindi_enum_ovrdflg "" VALUE 0x0000 /* @ECU_Address@KOUTP_LRPindi_enum_ovrdflg@ */ Scalar_BOOLEAN 0 SWC_OUTP_type_CM_boolean_flg 0.0 1.0 /end CHARACTERISTIC
/begin CHARACTERISTIC KOUTP_LRPressIndi_enum_ovrdflg "" VALUE 0x0000 /* @ECU_Address@KOUTP_LRPressIndi_enum_ovrdflg@ */ Scalar_BOOLEAN 0 SWC_OUTP_type_CM_boolean_flg 0.0 1.0 /end CHARACTERISTIC
/begin CHARACTERISTIC KOUTP_LRSensorFail_flg_maxval "" VALUE 0x0000 /* @ECU_Address@KOUTP_LRSensorFail_flg_maxval@ */ Scalar_BOOLEAN 0 SWC_OUTP_type_CM_boolean_flg 0.0 1.0 /end CHARACTERISTIC
/begin CHARACTERISTIC KOUTP_LRSensorFail_flg_minval "" VALUE 0x0000 /* @ECU_Address@KOUTP_LRSensorFail_flg_minval@ */ Scalar_BOOLEAN 0 SWC_OUTP_type_CM_boolean_flg 0.0 1.0 /end CHARACTERISTIC
/begin CHARACTERISTIC KOUTP_LRSensorFail_flg_ovrdflg "" VALUE 0x0000 /* @ECU_Address@KOUTP_LRSensorFail_flg_ovrdflg@ */ Scalar_BOOLEAN 0 SWC_OUTP_type_CM_boolean_flg 0.0 1.0 /end CHARACTERISTIC
/begin CHARACTERISTIC KOUTP_LRSensorFail_flg_ovrdval "" VALUE 0x0000 /* @ECU_Address@KOUTP_LRSensorFail_flg_ovrdval@ */ Scalar_BOOLEAN 0 SWC_OUTP_type_CM_boolean_flg 0.0 1.0 /end CHARACTERISTIC
/begin CHARACTERISTIC KOUTP_LRSensorMode_flg_maxval "" VALUE 0x0000 /* @ECU_Address@KOUTP_LRSensorMode_flg_maxval@ */ Scalar_BOOLEAN 0 SWC_OUTP_type_CM_boolean_flg 0.0 1.0 /end CHARACTERISTIC
/begin CHARACTERISTIC KOUTP_LRSensorMode_flg_minval "" VALUE 0x0000 /* @ECU_Address@KOUTP_LRSensorMode_flg_minval@ */ Scalar_BOOLEAN 0 SWC_OUTP_type_CM_boolean_flg 0.0 1.0 /end CHARACTERISTIC
/begin CHARACTERISTIC KOUTP_LRSensorMode_flg_ovrdflg "" VALUE 0x0000 /* @ECU_Address@KOUTP_LRSensorMode_flg_ovrdflg@ */ Scalar_BOOLEAN 0 SWC_OUTP_type_CM_boolean_flg 0.0 1.0 /end CHARACTERISTIC
/begin CHARACTERISTIC KOUTP_LRSensorMode_flg_ovrdval "" VALUE 0x0000 /* @ECU_Address@KOUTP_LRSensorMode_flg_ovrdval@ */ Scalar_BOOLEAN 0 SWC_OUTP_type_CM_boolean_flg 0.0 1.0 /end CHARACTERISTIC
/begin CHARACTERISTIC KOUTP_LRWheelDebug_flg_maxval "" VALUE 0x0000 /* @ECU_Address@KOUTP_LRWheelDebug_flg_maxval@ */ Scalar_BOOLEAN 0 SWC_OUTP_type_CM_boolean_flg 0.0 1.0 /end CHARACTERISTIC
/begin CHARACTERISTIC KOUTP_LRWheelDebug_flg_minval "" VALUE 0x0000 /* @ECU_Address@KOUTP_LRWheelDebug_flg_minval@ */ Scalar_BOOLEAN 0 SWC_OUTP_type_CM_boolean_flg 0.0 1.0 /end CHARACTERISTIC
/begin CHARACTERISTIC KOUTP_LRWheelDebug_flg_ovrdflg "" VALUE 0x0000 /* @ECU_Address@KOUTP_LRWheelDebug_flg_ovrdflg@ */ Scalar_BOOLEAN 0 SWC_OUTP_type_CM_boolean_flg 0.0 1.0 /end CHARACTERISTIC
/begin CHARACTERISTIC KOUTP_LRWheelDebug_flg_ovrdval "" VALUE 0x0000 /* @ECU_Address@KOUTP_LRWheelDebug_flg_ovrdval@ */ Scalar_BOOLEAN 0 SWC_OUTP_type_CM_boolean_flg 0.0 1.0 /end CHARACTERISTIC
/begin CHARACTERISTIC KOUTP_LRWheelPSW_raw8_ovrdflg "" VALUE 0x0000 /* @ECU_Address@KOUTP_LRWheelPSW_raw8_ovrdflg@ */ Scalar_BOOLEAN 0 SWC_OUTP_type_CM_boolean_flg 0.0 1.0 /end CHARACTERISTIC
/begin CHARACTERISTIC KOUTP_LRWheelPress_raw8_ovrdflg "" VALUE 0x0000 /* @ECU_Address@KOUTP_LRWheelPress_raw8_ovrdflg@ */ Scalar_BOOLEAN 0 SWC_OUTP_type_CM_boolean_flg 0.0 1.0 /end CHARACTERISTIC
/begin CHARACTERISTIC KOUTP_LRWheelTemp_C_ovrdflg "" VALUE 0x0000 /* @ECU_Address@KOUTP_LRWheelTemp_C_ovrdflg@ */ Scalar_BOOLEAN 0 SWC_OUTP_type_CM_boolean_flg 0.0 1.0 /end CHARACTERISTIC
/begin CHARACTERISTIC KOUTP_LRWheelTmpIndi_flg_maxval "" VALUE 0x0000 /* @ECU_Address@KOUTP_LRWheelTmpIndi_flg_maxval@ */ Scalar_BOOLEAN 0 SWC_OUTP_type_CM_boolean_flg 0.0 1.0 /end CHARACTERISTIC
/begin CHARACTERISTIC KOUTP_LRWheelTmpIndi_flg_minval "" VALUE 0x0000 /* @ECU_Address@KOUTP_LRWheelTmpIndi_flg_minval@ */ Scalar_BOOLEAN 0 SWC_OUTP_type_CM_boolean_flg 0.0 1.0 /end CHARACTERISTIC
/begin CHARACTERISTIC KOUTP_LRWheelTmpIndi_flg_ovrdflg "" VALUE 0x0000 /* @ECU_Address@KOUTP_LRWheelTmpIndi_flg_ovrdflg@ */ Scalar_BOOLEAN 0 SWC_OUTP_type_CM_boolean_flg 0.0 1.0 /end CHARACTERISTIC
/begin CHARACTERISTIC KOUTP_LRWheelTmpIndi_flg_ovrdval "" VALUE 0x0000 /* @ECU_Address@KOUTP_LRWheelTmpIndi_flg_ovrdval@ */ Scalar_BOOLEAN 0 SWC_OUTP_type_CM_boolean_flg 0.0 1.0 /end CHARACTERISTIC
/begin CHARACTERISTIC KOUTP_Major1_cnt_ovrdflg "" VALUE 0x0000 /* @ECU_Address@KOUTP_Major1_cnt_ovrdflg@ */ Scalar_BOOLEAN 0 SWC_OUTP_type_CM_boolean_flg 0.0 1.0 /end CHARACTERISTIC
/begin CHARACTERISTIC KOUTP_Major2_cnt_ovrdflg "" VALUE 0x0000 /* @ECU_Address@KOUTP_Major2_cnt_ovrdflg@ */ Scalar_BOOLEAN 0 SWC_OUTP_type_CM_boolean_flg 0.0 1.0 /end CHARACTERISTIC
/begin CHARACTERISTIC KOUTP_Minor1_cnt_ovrdflg "" VALUE 0x0000 /* @ECU_Address@KOUTP_Minor1_cnt_ovrdflg@ */ Scalar_BOOLEAN 0 SWC_OUTP_type_CM_boolean_flg 0.0 1.0 /end CHARACTERISTIC
/begin CHARACTERISTIC KOUTP_Minor2_cnt_ovrdflg "" VALUE 0x0000 /* @ECU_Address@KOUTP_Minor2_cnt_ovrdflg@ */ Scalar_BOOLEAN 0 SWC_OUTP_type_CM_boolean_flg 0.0 1.0 /end CHARACTERISTIC
/begin CHARACTERISTIC KOUTP_ModelVersionChksum_raw_ovrdflg "" VALUE 0x0000 /* @ECU_Address@KOUTP_ModelVersionChksum_raw_ovrdflg@ */ Scalar_BOOLEAN 0 SWC_OUTP_type_CM_boolean_flg 0.0 1.0 /end CHARACTERISTIC
/begin CHARACTERISTIC KOUTP_ModelVersion_raw_ovrdflg "" VALUE 0x0000 /* @ECU_Address@KOUTP_ModelVersion_raw_ovrdflg@ */ Scalar_BOOLEAN 0 SWC_OUTP_type_CM_boolean_flg 0.0 1.0 /end CHARACTERISTIC
/begin CHARACTERISTIC KOUTP_ModelYear_cnt_ovrdflg "" VALUE 0x0000 /* @ECU_Address@KOUTP_ModelYear_cnt_ovrdflg@ */ Scalar_BOOLEAN 0 SWC_OUTP_type_CM_boolean_flg 0.0 1.0 /end CHARACTERISTIC
/begin CHARACTERISTIC KOUTP_NvWriteReqRisingEdge_flg_maxval "" VALUE 0x0000 /* @ECU_Address@KOUTP_NvWriteReqRisingEdge_flg_maxval@ */ Scalar_BOOLEAN 0 SWC_OUTP_type_CM_boolean_flg 0.0 1.0 /end CHARACTERISTIC
/begin CHARACTERISTIC KOUTP_NvWriteReqRisingEdge_flg_minval "" VALUE 0x0000 /* @ECU_Address@KOUTP_NvWriteReqRisingEdge_flg_minval@ */ Scalar_BOOLEAN 0 SWC_OUTP_type_CM_boolean_flg 0.0 1.0 /end CHARACTERISTIC
/begin CHARACTERISTIC KOUTP_NvWriteReqRisingEdge_flg_ovrdflg "" VALUE 0x0000 /* @ECU_Address@KOUTP_NvWriteReqRisingEdge_flg_ovrdflg@ */ Scalar_BOOLEAN 0 SWC_OUTP_type_CM_boolean_flg 0.0 1.0 /end CHARACTERISTIC
/begin CHARACTERISTIC KOUTP_NvWriteReqRisingEdge_flg_ovrdval "" VALUE 0x0000 /* @ECU_Address@KOUTP_NvWriteReqRisingEdge_flg_ovrdval@ */ Scalar_BOOLEAN 0 SWC_OUTP_type_CM_boolean_flg 0.0 1.0 /end CHARACTERISTIC
/begin CHARACTERISTIC KOUTP_Patch1_cnt_ovrdflg "" VALUE 0x0000 /* @ECU_Address@KOUTP_Patch1_cnt_ovrdflg@ */ Scalar_BOOLEAN 0 SWC_OUTP_type_CM_boolean_flg 0.0 1.0 /end CHARACTERISTIC
/begin CHARACTERISTIC KOUTP_Patch2_cnt_ovrdflg "" VALUE 0x0000 /* @ECU_Address@KOUTP_Patch2_cnt_ovrdflg@ */ Scalar_BOOLEAN 0 SWC_OUTP_type_CM_boolean_flg 0.0 1.0 /end CHARACTERISTIC
/begin CHARACTERISTIC KOUTP_PmicBootPath_raw32_ovrdflg "" VALUE 0x0000 /* @ECU_Address@KOUTP_PmicBootPath_raw32_ovrdflg@ */ Scalar_BOOLEAN 0 SWC_OUTP_type_CM_boolean_flg 0.0 1.0 /end CHARACTERISTIC
/begin CHARACTERISTIC KOUTP_PmicBootReason_enum_ovrdflg "" VALUE 0x0000 /* @ECU_Address@KOUTP_PmicBootReason_enum_ovrdflg@ */ Scalar_BOOLEAN 0 SWC_OUTP_type_CM_boolean_flg 0.0 1.0 /end CHARACTERISTIC
/begin CHARACTERISTIC KOUTP_Prepresstempvalid_enum_ovrdflg "" VALUE 0x0000 /* @ECU_Address@KOUTP_Prepresstempvalid_enum_ovrdflg@ */ Scalar_BOOLEAN 0 SWC_OUTP_type_CM_boolean_flg 0.0 1.0 /end CHARACTERISTIC
/begin CHARACTERISTIC KOUTP_RFBatWarn_flg_maxval "" VALUE 0x0000 /* @ECU_Address@KOUTP_RFBatWarn_flg_maxval@ */ Scalar_BOOLEAN 0 SWC_OUTP_type_CM_boolean_flg 0.0 1.0 /end CHARACTERISTIC
/begin CHARACTERISTIC KOUTP_RFBatWarn_flg_minval "" VALUE 0x0000 /* @ECU_Address@KOUTP_RFBatWarn_flg_minval@ */ Scalar_BOOLEAN 0 SWC_OUTP_type_CM_boolean_flg 0.0 1.0 /end CHARACTERISTIC
/begin CHARACTERISTIC KOUTP_RFBatWarn_flg_ovrdflg "" VALUE 0x0000 /* @ECU_Address@KOUTP_RFBatWarn_flg_ovrdflg@ */ Scalar_BOOLEAN 0 SWC_OUTP_type_CM_boolean_flg 0.0 1.0 /end CHARACTERISTIC
/begin CHARACTERISTIC KOUTP_RFBatWarn_flg_ovrdval "" VALUE 0x0000 /* @ECU_Address@KOUTP_RFBatWarn_flg_ovrdval@ */ Scalar_BOOLEAN 0 SWC_OUTP_type_CM_boolean_flg 0.0 1.0 /end CHARACTERISTIC
/begin CHARACTERISTIC KOUTP_RFP20_raw8_ovrdflg "" VALUE 0x0000 /* @ECU_Address@KOUTP_RFP20_raw8_ovrdflg@ */ Scalar_BOOLEAN 0 SWC_OUTP_type_CM_boolean_flg 0.0 1.0 /end CHARACTERISTIC
/begin CHARACTERISTIC KOUTP_RFPind_enum_ovrdflg "" VALUE 0x0000 /* @ECU_Address@KOUTP_RFPind_enum_ovrdflg@ */ Scalar_BOOLEAN 0 SWC_OUTP_type_CM_boolean_flg 0.0 1.0 /end CHARACTERISTIC
/begin CHARACTERISTIC KOUTP_RFPressIndi_enum_ovrdflg "" VALUE 0x0000 /* @ECU_Address@KOUTP_RFPressIndi_enum_ovrdflg@ */ Scalar_BOOLEAN 0 SWC_OUTP_type_CM_boolean_flg 0.0 1.0 /end CHARACTERISTIC
/begin CHARACTERISTIC KOUTP_RFSensorFail_flg_maxval "" VALUE 0x0000 /* @ECU_Address@KOUTP_RFSensorFail_flg_maxval@ */ Scalar_BOOLEAN 0 SWC_OUTP_type_CM_boolean_flg 0.0 1.0 /end CHARACTERISTIC
/begin CHARACTERISTIC KOUTP_RFSensorFail_flg_minval "" VALUE 0x0000 /* @ECU_Address@KOUTP_RFSensorFail_flg_minval@ */ Scalar_BOOLEAN 0 SWC_OUTP_type_CM_boolean_flg 0.0 1.0 /end CHARACTERISTIC
/begin CHARACTERISTIC KOUTP_RFSensorFail_flg_ovrdflg "" VALUE 0x0000 /* @ECU_Address@KOUTP_RFSensorFail_flg_ovrdflg@ */ Scalar_BOOLEAN 0 SWC_OUTP_type_CM_boolean_flg 0.0 1.0 /end CHARACTERISTIC
/begin CHARACTERISTIC KOUTP_RFSensorFail_flg_ovrdval "" VALUE 0x0000 /* @ECU_Address@KOUTP_RFSensorFail_flg_ovrdval@ */ Scalar_BOOLEAN 0 SWC_OUTP_type_CM_boolean_flg 0.0 1.0 /end CHARACTERISTIC
/begin CHARACTERISTIC KOUTP_RFSensorMode_flg_maxval "" VALUE 0x0000 /* @ECU_Address@KOUTP_RFSensorMode_flg_maxval@ */ Scalar_BOOLEAN 0 SWC_OUTP_type_CM_boolean_flg 0.0 1.0 /end CHARACTERISTIC
/begin CHARACTERISTIC KOUTP_RFSensorMode_flg_minval "" VALUE 0x0000 /* @ECU_Address@KOUTP_RFSensorMode_flg_minval@ */ Scalar_BOOLEAN 0 SWC_OUTP_type_CM_boolean_flg 0.0 1.0 /end CHARACTERISTIC
/begin CHARACTERISTIC KOUTP_RFSensorMode_flg_ovrdflg "" VALUE 0x0000 /* @ECU_Address@KOUTP_RFSensorMode_flg_ovrdflg@ */ Scalar_BOOLEAN 0 SWC_OUTP_type_CM_boolean_flg 0.0 1.0 /end CHARACTERISTIC
/begin CHARACTERISTIC KOUTP_RFSensorMode_flg_ovrdval "" VALUE 0x0000 /* @ECU_Address@KOUTP_RFSensorMode_flg_ovrdval@ */ Scalar_BOOLEAN 0 SWC_OUTP_type_CM_boolean_flg 0.0 1.0 /end CHARACTERISTIC
/begin CHARACTERISTIC KOUTP_RFWheelDebug_flg_maxval "" VALUE 0x0000 /* @ECU_Address@KOUTP_RFWheelDebug_flg_maxval@ */ Scalar_BOOLEAN 0 SWC_OUTP_type_CM_boolean_flg 0.0 1.0 /end CHARACTERISTIC
/begin CHARACTERISTIC KOUTP_RFWheelDebug_flg_minval "" VALUE 0x0000 /* @ECU_Address@KOUTP_RFWheelDebug_flg_minval@ */ Scalar_BOOLEAN 0 SWC_OUTP_type_CM_boolean_flg 0.0 1.0 /end CHARACTERISTIC
/begin CHARACTERISTIC KOUTP_RFWheelDebug_flg_ovrdflg "" VALUE 0x0000 /* @ECU_Address@KOUTP_RFWheelDebug_flg_ovrdflg@ */ Scalar_BOOLEAN 0 SWC_OUTP_type_CM_boolean_flg 0.0 1.0 /end CHARACTERISTIC
/begin CHARACTERISTIC KOUTP_RFWheelDebug_flg_ovrdval "" VALUE 0x0000 /* @ECU_Address@KOUTP_RFWheelDebug_flg_ovrdval@ */ Scalar_BOOLEAN 0 SWC_OUTP_type_CM_boolean_flg 0.0 1.0 /end CHARACTERISTIC
/begin CHARACTERISTIC KOUTP_RFWheelPSW_raw8_ovrdflg "" VALUE 0x0000 /* @ECU_Address@KOUTP_RFWheelPSW_raw8_ovrdflg@ */ Scalar_BOOLEAN 0 SWC_OUTP_type_CM_boolean_flg 0.0 1.0 /end CHARACTERISTIC
/begin CHARACTERISTIC KOUTP_RFWheelPress_raw8_ovrdflg "" VALUE 0x0000 /* @ECU_Address@KOUTP_RFWheelPress_raw8_ovrdflg@ */ Scalar_BOOLEAN 0 SWC_OUTP_type_CM_boolean_flg 0.0 1.0 /end CHARACTERISTIC
/begin CHARACTERISTIC KOUTP_RFWheelTemp_C_ovrdflg "" VALUE 0x0000 /* @ECU_Address@KOUTP_RFWheelTemp_C_ovrdflg@ */ Scalar_BOOLEAN 0 SWC_OUTP_type_CM_boolean_flg 0.0 1.0 /end CHARACTERISTIC
/begin CHARACTERISTIC KOUTP_RFWheelTmpIndi_flg_maxval "" VALUE 0x0000 /* @ECU_Address@KOUTP_RFWheelTmpIndi_flg_maxval@ */ Scalar_BOOLEAN 0 SWC_OUTP_type_CM_boolean_flg 0.0 1.0 /end CHARACTERISTIC
/begin CHARACTERISTIC KOUTP_RFWheelTmpIndi_flg_minval "" VALUE 0x0000 /* @ECU_Address@KOUTP_RFWheelTmpIndi_flg_minval@ */ Scalar_BOOLEAN 0 SWC_OUTP_type_CM_boolean_flg 0.0 1.0 /end CHARACTERISTIC
/begin CHARACTERISTIC KOUTP_RFWheelTmpIndi_flg_ovrdflg "" VALUE 0x0000 /* @ECU_Address@KOUTP_RFWheelTmpIndi_flg_ovrdflg@ */ Scalar_BOOLEAN 0 SWC_OUTP_type_CM_boolean_flg 0.0 1.0 /end CHARACTERISTIC
/begin CHARACTERISTIC KOUTP_RFWheelTmpIndi_flg_ovrdval "" VALUE 0x0000 /* @ECU_Address@KOUTP_RFWheelTmpIndi_flg_ovrdval@ */ Scalar_BOOLEAN 0 SWC_OUTP_type_CM_boolean_flg 0.0 1.0 /end CHARACTERISTIC
/begin CHARACTERISTIC KOUTP_RRBatWarn_flg_maxval "" VALUE 0x0000 /* @ECU_Address@KOUTP_RRBatWarn_flg_maxval@ */ Scalar_BOOLEAN 0 SWC_OUTP_type_CM_boolean_flg 0.0 1.0 /end CHARACTERISTIC
/begin CHARACTERISTIC KOUTP_RRBatWarn_flg_minval "" VALUE 0x0000 /* @ECU_Address@KOUTP_RRBatWarn_flg_minval@ */ Scalar_BOOLEAN 0 SWC_OUTP_type_CM_boolean_flg 0.0 1.0 /end CHARACTERISTIC
/begin CHARACTERISTIC KOUTP_RRBatWarn_flg_ovrdflg "" VALUE 0x0000 /* @ECU_Address@KOUTP_RRBatWarn_flg_ovrdflg@ */ Scalar_BOOLEAN 0 SWC_OUTP_type_CM_boolean_flg 0.0 1.0 /end CHARACTERISTIC
/begin CHARACTERISTIC KOUTP_RRBatWarn_flg_ovrdval "" VALUE 0x0000 /* @ECU_Address@KOUTP_RRBatWarn_flg_ovrdval@ */ Scalar_BOOLEAN 0 SWC_OUTP_type_CM_boolean_flg 0.0 1.0 /end CHARACTERISTIC
/begin CHARACTERISTIC KOUTP_RRP20_raw8_ovrdflg "" VALUE 0x0000 /* @ECU_Address@KOUTP_RRP20_raw8_ovrdflg@ */ Scalar_BOOLEAN 0 SWC_OUTP_type_CM_boolean_flg 0.0 1.0 /end CHARACTERISTIC
/begin CHARACTERISTIC KOUTP_RRPindi_enum_ovrdflg "" VALUE 0x0000 /* @ECU_Address@KOUTP_RRPindi_enum_ovrdflg@ */ Scalar_BOOLEAN 0 SWC_OUTP_type_CM_boolean_flg 0.0 1.0 /end CHARACTERISTIC
/begin CHARACTERISTIC KOUTP_RRPressIndi_enum_ovrdflg "" VALUE 0x0000 /* @ECU_Address@KOUTP_RRPressIndi_enum_ovrdflg@ */ Scalar_BOOLEAN 0 SWC_OUTP_type_CM_boolean_flg 0.0 1.0 /end CHARACTERISTIC
/begin CHARACTERISTIC KOUTP_RRSensorFail_flg_maxval "" VALUE 0x0000 /* @ECU_Address@KOUTP_RRSensorFail_flg_maxval@ */ Scalar_BOOLEAN 0 SWC_OUTP_type_CM_boolean_flg 0.0 1.0 /end CHARACTERISTIC
/begin CHARACTERISTIC KOUTP_RRSensorFail_flg_minval "" VALUE 0x0000 /* @ECU_Address@KOUTP_RRSensorFail_flg_minval@ */ Scalar_BOOLEAN 0 SWC_OUTP_type_CM_boolean_flg 0.0 1.0 /end CHARACTERISTIC
/begin CHARACTERISTIC KOUTP_RRSensorFail_flg_ovrdflg "" VALUE 0x0000 /* @ECU_Address@KOUTP_RRSensorFail_flg_ovrdflg@ */ Scalar_BOOLEAN 0 SWC_OUTP_type_CM_boolean_flg 0.0 1.0 /end CHARACTERISTIC
/begin CHARACTERISTIC KOUTP_RRSensorFail_flg_ovrdval "" VALUE 0x0000 /* @ECU_Address@KOUTP_RRSensorFail_flg_ovrdval@ */ Scalar_BOOLEAN 0 SWC_OUTP_type_CM_boolean_flg 0.0 1.0 /end CHARACTERISTIC
/begin CHARACTERISTIC KOUTP_RRSensorMode_flg_maxval "" VALUE 0x0000 /* @ECU_Address@KOUTP_RRSensorMode_flg_maxval@ */ Scalar_BOOLEAN 0 SWC_OUTP_type_CM_boolean_flg 0.0 1.0 /end CHARACTERISTIC
/begin CHARACTERISTIC KOUTP_RRSensorMode_flg_minval "" VALUE 0x0000 /* @ECU_Address@KOUTP_RRSensorMode_flg_minval@ */ Scalar_BOOLEAN 0 SWC_OUTP_type_CM_boolean_flg 0.0 1.0 /end CHARACTERISTIC
/begin CHARACTERISTIC KOUTP_RRSensorMode_flg_ovrdflg "" VALUE 0x0000 /* @ECU_Address@KOUTP_RRSensorMode_flg_ovrdflg@ */ Scalar_BOOLEAN 0 SWC_OUTP_type_CM_boolean_flg 0.0 1.0 /end CHARACTERISTIC
/begin CHARACTERISTIC KOUTP_RRSensorMode_flg_ovrdval "" VALUE 0x0000 /* @ECU_Address@KOUTP_RRSensorMode_flg_ovrdval@ */ Scalar_BOOLEAN 0 SWC_OUTP_type_CM_boolean_flg 0.0 1.0 /end CHARACTERISTIC
/begin CHARACTERISTIC KOUTP_SHA1_cnt_ovrdflg "" VALUE 0x0000 /* @ECU_Address@KOUTP_SHA1_cnt_ovrdflg@ */ Scalar_BOOLEAN 0 SWC_OUTP_type_CM_boolean_flg 0.0 1.0 /end CHARACTERISTIC
/begin CHARACTERISTIC KOUTP_SHA2_cnt_ovrdflg "" VALUE 0x0000 /* @ECU_Address@KOUTP_SHA2_cnt_ovrdflg@ */ Scalar_BOOLEAN 0 SWC_OUTP_type_CM_boolean_flg 0.0 1.0 /end CHARACTERISTIC
/begin CHARACTERISTIC KOUTP_SHA3_cnt_ovrdflg "" VALUE 0x0000 /* @ECU_Address@KOUTP_SHA3_cnt_ovrdflg@ */ Scalar_BOOLEAN 0 SWC_OUTP_type_CM_boolean_flg 0.0 1.0 /end CHARACTERISTIC
/begin CHARACTERISTIC KOUTP_SHA4_cnt_ovrdflg "" VALUE 0x0000 /* @ECU_Address@KOUTP_SHA4_cnt_ovrdflg@ */ Scalar_BOOLEAN 0 SWC_OUTP_type_CM_boolean_flg 0.0 1.0 /end CHARACTERISTIC
/begin CHARACTERISTIC KOUTP_SHA5_cnt_ovrdflg "" VALUE 0x0000 /* @ECU_Address@KOUTP_SHA5_cnt_ovrdflg@ */ Scalar_BOOLEAN 0 SWC_OUTP_type_CM_boolean_flg 0.0 1.0 /end CHARACTERISTIC
/begin CHARACTERISTIC KOUTP_SHA6_cnt_ovrdflg "" VALUE 0x0000 /* @ECU_Address@KOUTP_SHA6_cnt_ovrdflg@ */ Scalar_BOOLEAN 0 SWC_OUTP_type_CM_boolean_flg 0.0 1.0 /end CHARACTERISTIC
/begin CHARACTERISTIC KOUTP_SHA7_cnt_ovrdflg "" VALUE 0x0000 /* @ECU_Address@KOUTP_SHA7_cnt_ovrdflg@ */ Scalar_BOOLEAN 0 SWC_OUTP_type_CM_boolean_flg 0.0 1.0 /end CHARACTERISTIC
/begin CHARACTERISTIC KOUTP_SHA8_cnt_ovrdflg "" VALUE 0x0000 /* @ECU_Address@KOUTP_SHA8_cnt_ovrdflg@ */ Scalar_BOOLEAN 0 SWC_OUTP_type_CM_boolean_flg 0.0 1.0 /end CHARACTERISTIC
/begin CHARACTERISTIC KOUTP_V2BLifeSig_cnt_ovrdflg "" VALUE 0x0000 /* @ECU_Address@KOUTP_V2BLifeSig_cnt_ovrdflg@ */ Scalar_BOOLEAN 0 SWC_OUTP_type_CM_boolean_flg 0.0 1.0 /end CHARACTERISTIC
/begin CHARACTERISTIC KOUTP_V2BMainPosRlyFit_enum_ovrdflg "" VALUE 0x0000 /* @ECU_Address@KOUTP_V2BMainPosRlyFit_enum_ovrdflg@ */ Scalar_BOOLEAN 0 SWC_OUTP_type_CM_boolean_flg 0.0 1.0 /end CHARACTERISTIC
/begin CHARACTERISTIC KOUTP_V2BMainPosRlySta_enum_ovrdflg "" VALUE 0x0000 /* @ECU_Address@KOUTP_V2BMainPosRlySta_enum_ovrdflg@ */ Scalar_BOOLEAN 0 SWC_OUTP_type_CM_boolean_flg 0.0 1.0 /end CHARACTERISTIC
/begin CHARACTERISTIC KOUTP_V2BOilPosRlyFit_enum_ovrdflg "" VALUE 0x0000 /* @ECU_Address@KOUTP_V2BOilPosRlyFit_enum_ovrdflg@ */ Scalar_BOOLEAN 0 SWC_OUTP_type_CM_boolean_flg 0.0 1.0 /end CHARACTERISTIC
/begin CHARACTERISTIC KOUTP_V2BOilPosRlySta_enum_ovrdflg "" VALUE 0x0000 /* @ECU_Address@KOUTP_V2BOilPosRlySta_enum_ovrdflg@ */ Scalar_BOOLEAN 0 SWC_OUTP_type_CM_boolean_flg 0.0 1.0 /end CHARACTERISTIC
/begin CHARACTERISTIC KOUTP_VCULife1_cnt_ovrdflg "" VALUE 0x0000 /* @ECU_Address@KOUTP_VCULife1_cnt_ovrdflg@ */ Scalar_BOOLEAN 0 SWC_OUTP_type_CM_boolean_flg 0.0 1.0 /end CHARACTERISTIC
/begin CHARACTERISTIC KOUTP_VCULife2_cnt_ovrdflg "" VALUE 0x0000 /* @ECU_Address@KOUTP_VCULife2_cnt_ovrdflg@ */ Scalar_BOOLEAN 0 SWC_OUTP_type_CM_boolean_flg 0.0 1.0 /end CHARACTERISTIC
/begin CHARACTERISTIC KOUTP_VCUMCUEn_flg_maxval "" VALUE 0x0000 /* @ECU_Address@KOUTP_VCUMCUEn_flg_maxval@ */ Scalar_BOOLEAN 0 SWC_OUTP_type_CM_boolean_flg 0.0 1.0 /end CHARACTERISTIC
/begin CHARACTERISTIC KOUTP_VCUMCUEn_flg_minval "" VALUE 0x0000 /* @ECU_Address@KOUTP_VCUMCUEn_flg_minval@ */ Scalar_BOOLEAN 0 SWC_OUTP_type_CM_boolean_flg 0.0 1.0 /end CHARACTERISTIC
/begin CHARACTERISTIC KOUTP_VCUMCUEn_flg_ovrdflg "" VALUE 0x0000 /* @ECU_Address@KOUTP_VCUMCUEn_flg_ovrdflg@ */ Scalar_BOOLEAN 0 SWC_OUTP_type_CM_boolean_flg 0.0 1.0 /end CHARACTERISTIC
/begin CHARACTERISTIC KOUTP_VCUMCUEn_flg_ovrdval "" VALUE 0x0000 /* @ECU_Address@KOUTP_VCUMCUEn_flg_ovrdval@ */ Scalar_BOOLEAN 0 SWC_OUTP_type_CM_boolean_flg 0.0 1.0 /end CHARACTERISTIC
/begin CHARACTERISTIC KOUTP_VCUMCUFailRst_flg_maxval "" VALUE 0x0000 /* @ECU_Address@KOUTP_VCUMCUFailRst_flg_maxval@ */ Scalar_BOOLEAN 0 SWC_OUTP_type_CM_boolean_flg 0.0 1.0 /end CHARACTERISTIC
/begin CHARACTERISTIC KOUTP_VCUMCUFailRst_flg_minval "" VALUE 0x0000 /* @ECU_Address@KOUTP_VCUMCUFailRst_flg_minval@ */ Scalar_BOOLEAN 0 SWC_OUTP_type_CM_boolean_flg 0.0 1.0 /end CHARACTERISTIC
/begin CHARACTERISTIC KOUTP_VCUMCUFailRst_flg_ovrdflg "" VALUE 0x0000 /* @ECU_Address@KOUTP_VCUMCUFailRst_flg_ovrdflg@ */ Scalar_BOOLEAN 0 SWC_OUTP_type_CM_boolean_flg 0.0 1.0 /end CHARACTERISTIC
/begin CHARACTERISTIC KOUTP_VCUMCUFailRst_flg_ovrdval "" VALUE 0x0000 /* @ECU_Address@KOUTP_VCUMCUFailRst_flg_ovrdval@ */ Scalar_BOOLEAN 0 SWC_OUTP_type_CM_boolean_flg 0.0 1.0 /end CHARACTERISTIC
/begin CHARACTERISTIC KOUTP_VSPFunc_enum_ovrdflg "" VALUE 0x0000 /* @ECU_Address@KOUTP_VSPFunc_enum_ovrdflg@ */ Scalar_BOOLEAN 0 SWC_OUTP_type_CM_boolean_flg 0.0 1.0 /end CHARACTERISTIC
/begin CHARACTERISTIC KOUTP_VSPIGNKeySta_enum_ovrdflg "" VALUE 0x0000 /* @ECU_Address@KOUTP_VSPIGNKeySta_enum_ovrdflg@ */ Scalar_BOOLEAN 0 SWC_OUTP_type_CM_boolean_flg 0.0 1.0 /end CHARACTERISTIC
/begin CHARACTERISTIC KOUTP_VSPReversed_flg_maxval "" VALUE 0x0000 /* @ECU_Address@KOUTP_VSPReversed_flg_maxval@ */ Scalar_BOOLEAN 0 SWC_OUTP_type_CM_boolean_flg 0.0 1.0 /end CHARACTERISTIC
/begin CHARACTERISTIC KOUTP_VSPReversed_flg_minval "" VALUE 0x0000 /* @ECU_Address@KOUTP_VSPReversed_flg_minval@ */ Scalar_BOOLEAN 0 SWC_OUTP_type_CM_boolean_flg 0.0 1.0 /end CHARACTERISTIC
/begin CHARACTERISTIC KOUTP_VSPReversed_flg_ovrdflg "" VALUE 0x0000 /* @ECU_Address@KOUTP_VSPReversed_flg_ovrdflg@ */ Scalar_BOOLEAN 0 SWC_OUTP_type_CM_boolean_flg 0.0 1.0 /end CHARACTERISTIC
/begin CHARACTERISTIC KOUTP_VSPReversed_flg_ovrdval "" VALUE 0x0000 /* @ECU_Address@KOUTP_VSPReversed_flg_ovrdval@ */ Scalar_BOOLEAN 0 SWC_OUTP_type_CM_boolean_flg 0.0 1.0 /end CHARACTERISTIC
/begin CHARACTERISTIC KOUTP_VSPTurnLeft_enum_ovrdflg "" VALUE 0x0000 /* @ECU_Address@KOUTP_VSPTurnLeft_enum_ovrdflg@ */ Scalar_BOOLEAN 0 SWC_OUTP_type_CM_boolean_flg 0.0 1.0 /end CHARACTERISTIC
/begin CHARACTERISTIC KOUTP_VSPTurnRight_enum_ovrdflg "" VALUE 0x0000 /* @ECU_Address@KOUTP_VSPTurnRight_enum_ovrdflg@ */ Scalar_BOOLEAN 0 SWC_OUTP_type_CM_boolean_flg 0.0 1.0 /end CHARACTERISTIC
/begin CHARACTERISTIC KOUTP_Variation_cnt_ovrdflg "" VALUE 0x0000 /* @ECU_Address@KOUTP_Variation_cnt_ovrdflg@ */ Scalar_BOOLEAN 0 SWC_OUTP_type_CM_boolean_flg 0.0 1.0 /end CHARACTERISTIC
/begin CHARACTERISTIC KOUTP_WisrBootReason_raw32_ovrdflg "" VALUE 0x0000 /* @ECU_Address@KOUTP_WisrBootReason_raw32_ovrdflg@ */ Scalar_BOOLEAN 0 SWC_OUTP_type_CM_boolean_flg 0.0 1.0 /end CHARACTERISTIC
/begin CHARACTERISTIC KOUTP_triggerBAM_flg_maxval "" VALUE 0x0000 /* @ECU_Address@KOUTP_triggerBAM_flg_maxval@ */ Scalar_BOOLEAN 0 SWC_OUTP_type_CM_boolean_flg 0.0 1.0 /end CHARACTERISTIC
/begin CHARACTERISTIC KOUTP_triggerBAM_flg_minval "" VALUE 0x0000 /* @ECU_Address@KOUTP_triggerBAM_flg_minval@ */ Scalar_BOOLEAN 0 SWC_OUTP_type_CM_boolean_flg 0.0 1.0 /end CHARACTERISTIC
/begin CHARACTERISTIC KOUTP_triggerBAM_flg_ovrdflg "" VALUE 0x0000 /* @ECU_Address@KOUTP_triggerBAM_flg_ovrdflg@ */ Scalar_BOOLEAN 0 SWC_OUTP_type_CM_boolean_flg 0.0 1.0 /end CHARACTERISTIC
/begin CHARACTERISTIC KOUTP_triggerBAM_flg_ovrdval "" VALUE 0x0000 /* @ECU_Address@KOUTP_triggerBAM_flg_ovrdval@ */ Scalar_BOOLEAN 0 SWC_OUTP_type_CM_boolean_flg 0.0 1.0 /end CHARACTERISTIC
/begin CHARACTERISTIC KOUTP_triggerDT_flg_maxval "" VALUE 0x0000 /* @ECU_Address@KOUTP_triggerDT_flg_maxval@ */ Scalar_BOOLEAN 0 SWC_OUTP_type_CM_boolean_flg 0.0 1.0 /end CHARACTERISTIC
/begin CHARACTERISTIC KOUTP_triggerDT_flg_minval "" VALUE 0x0000 /* @ECU_Address@KOUTP_triggerDT_flg_minval@ */ Scalar_BOOLEAN 0 SWC_OUTP_type_CM_boolean_flg 0.0 1.0 /end CHARACTERISTIC
/begin CHARACTERISTIC KOUTP_triggerDT_flg_ovrdflg "" VALUE 0x0000 /* @ECU_Address@KOUTP_triggerDT_flg_ovrdflg@ */ Scalar_BOOLEAN 0 SWC_OUTP_type_CM_boolean_flg 0.0 1.0 /end CHARACTERISTIC
/begin CHARACTERISTIC KOUTP_triggerDT_flg_ovrdval "" VALUE 0x0000 /* @ECU_Address@KOUTP_triggerDT_flg_ovrdval@ */ Scalar_BOOLEAN 0 SWC_OUTP_type_CM_boolean_flg 0.0 1.0 /end CHARACTERISTIC
/begin CHARACTERISTIC KOUTP_AutoLTips_enum_maxval "" VALUE 0x0000 /* @ECU_Address@KOUTP_AutoLTips_enum_maxval@ */ Scalar_UBYTE 0 SWC_OUTP_type_CM_uint8_enum 0.0 255.0 /end CHARACTERISTIC
/begin CHARACTERISTIC KOUTP_AutoLTips_enum_minval "" VALUE 0x0000 /* @ECU_Address@KOUTP_AutoLTips_enum_minval@ */ Scalar_UBYTE 0 SWC_OUTP_type_CM_uint8_enum 0.0 255.0 /end CHARACTERISTIC
/begin CHARACTERISTIC KOUTP_AutoLTips_enum_ovrdval "" VALUE 0x0000 /* @ECU_Address@KOUTP_AutoLTips_enum_ovrdval@ */ Scalar_UBYTE 0 SWC_OUTP_type_CM_uint8_enum 0.0 255.0 /end CHARACTERISTIC
/begin CHARACTERISTIC KOUTP_CFGEM1BAMRsv_raw_maxval "" VALUE 0x0000 /* @ECU_Address@KOUTP_CFGEM1BAMRsv_raw_maxval@ */ Scalar_UBYTE 0 SWC_OUTP_type_CM_uint8_enum 0.0 255.0 /end CHARACTERISTIC
/begin CHARACTERISTIC KOUTP_CFGEM1BAMRsv_raw_minval "" VALUE 0x0000 /* @ECU_Address@KOUTP_CFGEM1BAMRsv_raw_minval@ */ Scalar_UBYTE 0 SWC_OUTP_type_CM_uint8_enum 0.0 255.0 /end CHARACTERISTIC
/begin CHARACTERISTIC KOUTP_CFGEM1BAMRsv_raw_ovrdval "" VALUE 0x0000 /* @ECU_Address@KOUTP_CFGEM1BAMRsv_raw_ovrdval@ */ Scalar_UBYTE 0 SWC_OUTP_type_CM_uint8_enum 0.0 255.0 /end CHARACTERISTIC
/begin CHARACTERISTIC KOUTP_CFGEM1BAMTNum_raw_maxval "" VALUE 0x0000 /* @ECU_Address@KOUTP_CFGEM1BAMTNum_raw_maxval@ */ Scalar_UBYTE 0 SWC_OUTP_type_CM_uint8_enum 0.0 255.0 /end CHARACTERISTIC
/begin CHARACTERISTIC KOUTP_CFGEM1BAMTNum_raw_minval "" VALUE 0x0000 /* @ECU_Address@KOUTP_CFGEM1BAMTNum_raw_minval@ */ Scalar_UBYTE 0 SWC_OUTP_type_CM_uint8_enum 0.0 255.0 /end CHARACTERISTIC
/begin CHARACTERISTIC KOUTP_CFGEM1BAMTNum_raw_ovrdval "" VALUE 0x0000 /* @ECU_Address@KOUTP_CFGEM1BAMTNum_raw_ovrdval@ */ Scalar_UBYTE 0 SWC_OUTP_type_CM_uint8_enum 0.0 255.0 /end CHARACTERISTIC
/begin CHARACTERISTIC KOUTP_CFGEM1Ctrl_raw_maxval "" VALUE 0x0000 /* @ECU_Address@KOUTP_CFGEM1Ctrl_raw_maxval@ */ Scalar_UBYTE 0 SWC_OUTP_type_CM_uint8_enum 0.0 255.0 /end CHARACTERISTIC
/begin CHARACTERISTIC KOUTP_CFGEM1Ctrl_raw_minval "" VALUE 0x0000 /* @ECU_Address@KOUTP_CFGEM1Ctrl_raw_minval@ */ Scalar_UBYTE 0 SWC_OUTP_type_CM_uint8_enum 0.0 255.0 /end CHARACTERISTIC
/begin CHARACTERISTIC KOUTP_CFGEM1Ctrl_raw_ovrdval "" VALUE 0x0000 /* @ECU_Address@KOUTP_CFGEM1Ctrl_raw_ovrdval@ */ Scalar_UBYTE 0 SWC_OUTP_type_CM_uint8_enum 0.0 255.0 /end CHARACTERISTIC
/begin CHARACTERISTIC KOUTP_CWheelTips_enum_maxval "" VALUE 0x0000 /* @ECU_Address@KOUTP_CWheelTips_enum_maxval@ */ Scalar_UBYTE 0 SWC_OUTP_type_CM_uint8_enum 0.0 255.0 /end CHARACTERISTIC
/begin CHARACTERISTIC KOUTP_CWheelTips_enum_minval "" VALUE 0x0000 /* @ECU_Address@KOUTP_CWheelTips_enum_minval@ */ Scalar_UBYTE 0 SWC_OUTP_type_CM_uint8_enum 0.0 255.0 /end CHARACTERISTIC
/begin CHARACTERISTIC KOUTP_CWheelTips_enum_ovrdval "" VALUE 0x0000 /* @ECU_Address@KOUTP_CWheelTips_enum_ovrdval@ */ Scalar_UBYTE 0 SWC_OUTP_type_CM_uint8_enum 0.0 255.0 /end CHARACTERISTIC
/begin CHARACTERISTIC KOUTP_CarModel1_cnt_maxval "" VALUE 0x0000 /* @ECU_Address@KOUTP_CarModel1_cnt_maxval@ */ Scalar_UBYTE 0 SWC_OUTP_type_CM_uint8_cnt 0.0 255.0 /end CHARACTERISTIC
/begin CHARACTERISTIC KOUTP_CarModel1_cnt_minval "" VALUE 0x0000 /* @ECU_Address@KOUTP_CarModel1_cnt_minval@ */ Scalar_UBYTE 0 SWC_OUTP_type_CM_uint8_cnt 0.0 255.0 /end CHARACTERISTIC
/begin CHARACTERISTIC KOUTP_CarModel1_cnt_ovrdval "" VALUE 0x0000 /* @ECU_Address@KOUTP_CarModel1_cnt_ovrdval@ */ Scalar_UBYTE 0 SWC_OUTP_type_CM_uint8_enum 0.0 255.0 /end CHARACTERISTIC
/begin CHARACTERISTIC KOUTP_CarModel2_cnt_maxval "" VALUE 0x0000 /* @ECU_Address@KOUTP_CarModel2_cnt_maxval@ */ Scalar_UBYTE 0 SWC_OUTP_type_CM_uint8_cnt 0.0 255.0 /end CHARACTERISTIC
/begin CHARACTERISTIC KOUTP_CarModel2_cnt_minval "" VALUE 0x0000 /* @ECU_Address@KOUTP_CarModel2_cnt_minval@ */ Scalar_UBYTE 0 SWC_OUTP_type_CM_uint8_cnt 0.0 255.0 /end CHARACTERISTIC
/begin CHARACTERISTIC KOUTP_CarModel2_cnt_ovrdval "" VALUE 0x0000 /* @ECU_Address@KOUTP_CarModel2_cnt_ovrdval@ */ Scalar_UBYTE 0 SWC_OUTP_type_CM_uint8_enum 0.0 255.0 /end CHARACTERISTIC
/begin CHARACTERISTIC KOUTP_CarModel3_cnt_maxval "" VALUE 0x0000 /* @ECU_Address@KOUTP_CarModel3_cnt_maxval@ */ Scalar_UBYTE 0 SWC_OUTP_type_CM_uint8_cnt 0.0 255.0 /end CHARACTERISTIC
/begin CHARACTERISTIC KOUTP_CarModel3_cnt_minval "" VALUE 0x0000 /* @ECU_Address@KOUTP_CarModel3_cnt_minval@ */ Scalar_UBYTE 0 SWC_OUTP_type_CM_uint8_cnt 0.0 255.0 /end CHARACTERISTIC
/begin CHARACTERISTIC KOUTP_CarModel3_cnt_ovrdval "" VALUE 0x0000 /* @ECU_Address@KOUTP_CarModel3_cnt_ovrdval@ */ Scalar_UBYTE 0 SWC_OUTP_type_CM_uint8_enum 0.0 255.0 /end CHARACTERISTIC
/begin CHARACTERISTIC KOUTP_Change1_cnt_maxval "" VALUE 0x0000 /* @ECU_Address@KOUTP_Change1_cnt_maxval@ */ Scalar_UBYTE 0 SWC_OUTP_type_CM_uint8_cnt 0.0 255.0 /end CHARACTERISTIC
/begin CHARACTERISTIC KOUTP_Change1_cnt_minval "" VALUE 0x0000 /* @ECU_Address@KOUTP_Change1_cnt_minval@ */ Scalar_UBYTE 0 SWC_OUTP_type_CM_uint8_cnt 0.0 255.0 /end CHARACTERISTIC
/begin CHARACTERISTIC KOUTP_Change1_cnt_ovrdval "" VALUE 0x0000 /* @ECU_Address@KOUTP_Change1_cnt_ovrdval@ */ Scalar_UBYTE 0 SWC_OUTP_type_CM_uint8_enum 0.0 255.0 /end CHARACTERISTIC
/begin CHARACTERISTIC KOUTP_Change2_cnt_maxval "" VALUE 0x0000 /* @ECU_Address@KOUTP_Change2_cnt_maxval@ */ Scalar_UBYTE 0 SWC_OUTP_type_CM_uint8_cnt 0.0 255.0 /end CHARACTERISTIC
/begin CHARACTERISTIC KOUTP_Change2_cnt_minval "" VALUE 0x0000 /* @ECU_Address@KOUTP_Change2_cnt_minval@ */ Scalar_UBYTE 0 SWC_OUTP_type_CM_uint8_cnt 0.0 255.0 /end CHARACTERISTIC
/begin CHARACTERISTIC KOUTP_Change2_cnt_ovrdval "" VALUE 0x0000 /* @ECU_Address@KOUTP_Change2_cnt_ovrdval@ */ Scalar_UBYTE 0 SWC_OUTP_type_CM_uint8_enum 0.0 255.0 /end CHARACTERISTIC
/begin CHARACTERISTIC KOUTP_Country1_cnt_maxval "" VALUE 0x0000 /* @ECU_Address@KOUTP_Country1_cnt_maxval@ */ Scalar_UBYTE 0 SWC_OUTP_type_CM_uint8_cnt 0.0 255.0 /end CHARACTERISTIC
/begin CHARACTERISTIC KOUTP_Country1_cnt_minval "" VALUE 0x0000 /* @ECU_Address@KOUTP_Country1_cnt_minval@ */ Scalar_UBYTE 0 SWC_OUTP_type_CM_uint8_cnt 0.0 255.0 /end CHARACTERISTIC
/begin CHARACTERISTIC KOUTP_Country1_cnt_ovrdval "" VALUE 0x0000 /* @ECU_Address@KOUTP_Country1_cnt_ovrdval@ */ Scalar_UBYTE 0 SWC_OUTP_type_CM_uint8_enum 0.0 255.0 /end CHARACTERISTIC
/begin CHARACTERISTIC KOUTP_Country2_cnt_maxval "" VALUE 0x0000 /* @ECU_Address@KOUTP_Country2_cnt_maxval@ */ Scalar_UBYTE 0 SWC_OUTP_type_CM_uint8_cnt 0.0 255.0 /end CHARACTERISTIC
/begin CHARACTERISTIC KOUTP_Country2_cnt_minval "" VALUE 0x0000 /* @ECU_Address@KOUTP_Country2_cnt_minval@ */ Scalar_UBYTE 0 SWC_OUTP_type_CM_uint8_cnt 0.0 255.0 /end CHARACTERISTIC
/begin CHARACTERISTIC KOUTP_Country2_cnt_ovrdval "" VALUE 0x0000 /* @ECU_Address@KOUTP_Country2_cnt_ovrdval@ */ Scalar_UBYTE 0 SWC_OUTP_type_CM_uint8_enum 0.0 255.0 /end CHARACTERISTIC
/begin CHARACTERISTIC KOUTP_CurrentNmState_enum_maxval "" VALUE 0x0000 /* @ECU_Address@KOUTP_CurrentNmState_enum_maxval@ */ Scalar_UBYTE 0 SWC_OUTP_type_CM_uint8_enum 0.0 255.0 /end CHARACTERISTIC
/begin CHARACTERISTIC KOUTP_CurrentNmState_enum_minval "" VALUE 0x0000 /* @ECU_Address@KOUTP_CurrentNmState_enum_minval@ */ Scalar_UBYTE 0 SWC_OUTP_type_CM_uint8_enum 0.0 255.0 /end CHARACTERISTIC
/begin CHARACTERISTIC KOUTP_CurrentNmState_enum_ovrdval "" VALUE 0x0000 /* @ECU_Address@KOUTP_CurrentNmState_enum_ovrdval@ */ Scalar_UBYTE 0 SWC_OUTP_type_CM_uint8_enum 0.0 255.0 /end CHARACTERISTIC
/begin CHARACTERISTIC KOUTP_DTbyte0_raw_maxval "" VALUE 0x0000 /* @ECU_Address@KOUTP_DTbyte0_raw_maxval@ */ Scalar_UBYTE 0 SWC_OUTP_type_CM_uint8_enum 0.0 255.0 /end CHARACTERISTIC
/begin CHARACTERISTIC KOUTP_DTbyte0_raw_minval "" VALUE 0x0000 /* @ECU_Address@KOUTP_DTbyte0_raw_minval@ */ Scalar_UBYTE 0 SWC_OUTP_type_CM_uint8_enum 0.0 255.0 /end CHARACTERISTIC
/begin CHARACTERISTIC KOUTP_DTbyte0_raw_ovrdval "" VALUE 0x0000 /* @ECU_Address@KOUTP_DTbyte0_raw_ovrdval@ */ Scalar_UBYTE 0 SWC_OUTP_type_CM_uint8_enum 0.0 255.0 /end CHARACTERISTIC
/begin CHARACTERISTIC KOUTP_DTbyte1_raw_maxval "" VALUE 0x0000 /* @ECU_Address@KOUTP_DTbyte1_raw_maxval@ */ Scalar_UBYTE 0 SWC_OUTP_type_CM_uint8_enum 0.0 255.0 /end CHARACTERISTIC
/begin CHARACTERISTIC KOUTP_DTbyte1_raw_minval "" VALUE 0x0000 /* @ECU_Address@KOUTP_DTbyte1_raw_minval@ */ Scalar_UBYTE 0 SWC_OUTP_type_CM_uint8_enum 0.0 255.0 /end CHARACTERISTIC
/begin CHARACTERISTIC KOUTP_DTbyte1_raw_ovrdval "" VALUE 0x0000 /* @ECU_Address@KOUTP_DTbyte1_raw_ovrdval@ */ Scalar_UBYTE 0 SWC_OUTP_type_CM_uint8_enum 0.0 255.0 /end CHARACTERISTIC
/begin CHARACTERISTIC KOUTP_DTbyte2_raw_maxval "" VALUE 0x0000 /* @ECU_Address@KOUTP_DTbyte2_raw_maxval@ */ Scalar_UBYTE 0 SWC_OUTP_type_CM_uint8_enum 0.0 255.0 /end CHARACTERISTIC
/begin CHARACTERISTIC KOUTP_DTbyte2_raw_minval "" VALUE 0x0000 /* @ECU_Address@KOUTP_DTbyte2_raw_minval@ */ Scalar_UBYTE 0 SWC_OUTP_type_CM_uint8_enum 0.0 255.0 /end CHARACTERISTIC
/begin CHARACTERISTIC KOUTP_DTbyte2_raw_ovrdval "" VALUE 0x0000 /* @ECU_Address@KOUTP_DTbyte2_raw_ovrdval@ */ Scalar_UBYTE 0 SWC_OUTP_type_CM_uint8_enum 0.0 255.0 /end CHARACTERISTIC
/begin CHARACTERISTIC KOUTP_DTbyte3_raw_maxval "" VALUE 0x0000 /* @ECU_Address@KOUTP_DTbyte3_raw_maxval@ */ Scalar_UBYTE 0 SWC_OUTP_type_CM_uint8_enum 0.0 255.0 /end CHARACTERISTIC
/begin CHARACTERISTIC KOUTP_DTbyte3_raw_minval "" VALUE 0x0000 /* @ECU_Address@KOUTP_DTbyte3_raw_minval@ */ Scalar_UBYTE 0 SWC_OUTP_type_CM_uint8_enum 0.0 255.0 /end CHARACTERISTIC
/begin CHARACTERISTIC KOUTP_DTbyte3_raw_ovrdval "" VALUE 0x0000 /* @ECU_Address@KOUTP_DTbyte3_raw_ovrdval@ */ Scalar_UBYTE 0 SWC_OUTP_type_CM_uint8_enum 0.0 255.0 /end CHARACTERISTIC
/begin CHARACTERISTIC KOUTP_DTbyte4_raw_maxval "" VALUE 0x0000 /* @ECU_Address@KOUTP_DTbyte4_raw_maxval@ */ Scalar_UBYTE 0 SWC_OUTP_type_CM_uint8_enum 0.0 255.0 /end CHARACTERISTIC
/begin CHARACTERISTIC KOUTP_DTbyte4_raw_minval "" VALUE 0x0000 /* @ECU_Address@KOUTP_DTbyte4_raw_minval@ */ Scalar_UBYTE 0 SWC_OUTP_type_CM_uint8_enum 0.0 255.0 /end CHARACTERISTIC
/begin CHARACTERISTIC KOUTP_DTbyte4_raw_ovrdval "" VALUE 0x0000 /* @ECU_Address@KOUTP_DTbyte4_raw_ovrdval@ */ Scalar_UBYTE 0 SWC_OUTP_type_CM_uint8_enum 0.0 255.0 /end CHARACTERISTIC
/begin CHARACTERISTIC KOUTP_DTbyte5_raw_maxval "" VALUE 0x0000 /* @ECU_Address@KOUTP_DTbyte5_raw_maxval@ */ Scalar_UBYTE 0 SWC_OUTP_type_CM_uint8_enum 0.0 255.0 /end CHARACTERISTIC
/begin CHARACTERISTIC KOUTP_DTbyte5_raw_minval "" VALUE 0x0000 /* @ECU_Address@KOUTP_DTbyte5_raw_minval@ */ Scalar_UBYTE 0 SWC_OUTP_type_CM_uint8_enum 0.0 255.0 /end CHARACTERISTIC
/begin CHARACTERISTIC KOUTP_DTbyte5_raw_ovrdval "" VALUE 0x0000 /* @ECU_Address@KOUTP_DTbyte5_raw_ovrdval@ */ Scalar_UBYTE 0 SWC_OUTP_type_CM_uint8_enum 0.0 255.0 /end CHARACTERISTIC
/begin CHARACTERISTIC KOUTP_DTbyte6_raw_maxval "" VALUE 0x0000 /* @ECU_Address@KOUTP_DTbyte6_raw_maxval@ */ Scalar_UBYTE 0 SWC_OUTP_type_CM_uint8_enum 0.0 255.0 /end CHARACTERISTIC
/begin CHARACTERISTIC KOUTP_DTbyte6_raw_minval "" VALUE 0x0000 /* @ECU_Address@KOUTP_DTbyte6_raw_minval@ */ Scalar_UBYTE 0 SWC_OUTP_type_CM_uint8_enum 0.0 255.0 /end CHARACTERISTIC
/begin CHARACTERISTIC KOUTP_DTbyte6_raw_ovrdval "" VALUE 0x0000 /* @ECU_Address@KOUTP_DTbyte6_raw_ovrdval@ */ Scalar_UBYTE 0 SWC_OUTP_type_CM_uint8_enum 0.0 255.0 /end CHARACTERISTIC
/begin CHARACTERISTIC KOUTP_DTbyte7_raw_maxval "" VALUE 0x0000 /* @ECU_Address@KOUTP_DTbyte7_raw_maxval@ */ Scalar_UBYTE 0 SWC_OUTP_type_CM_uint8_enum 0.0 255.0 /end CHARACTERISTIC
/begin CHARACTERISTIC KOUTP_DTbyte7_raw_minval "" VALUE 0x0000 /* @ECU_Address@KOUTP_DTbyte7_raw_minval@ */ Scalar_UBYTE 0 SWC_OUTP_type_CM_uint8_enum 0.0 255.0 /end CHARACTERISTIC
/begin CHARACTERISTIC KOUTP_DTbyte7_raw_ovrdval "" VALUE 0x0000 /* @ECU_Address@KOUTP_DTbyte7_raw_ovrdval@ */ Scalar_UBYTE 0 SWC_OUTP_type_CM_uint8_enum 0.0 255.0 /end CHARACTERISTIC
/begin CHARACTERISTIC KOUTP_Dash1_cnt_maxval "" VALUE 0x0000 /* @ECU_Address@KOUTP_Dash1_cnt_maxval@ */ Scalar_UBYTE 0 SWC_OUTP_type_CM_uint8_cnt 0.0 255.0 /end CHARACTERISTIC
/begin CHARACTERISTIC KOUTP_Dash1_cnt_minval "" VALUE 0x0000 /* @ECU_Address@KOUTP_Dash1_cnt_minval@ */ Scalar_UBYTE 0 SWC_OUTP_type_CM_uint8_cnt 0.0 255.0 /end CHARACTERISTIC
/begin CHARACTERISTIC KOUTP_Dash1_cnt_ovrdval "" VALUE 0x0000 /* @ECU_Address@KOUTP_Dash1_cnt_ovrdval@ */ Scalar_UBYTE 0 SWC_OUTP_type_CM_uint8_enum 0.0 255.0 /end CHARACTERISTIC
/begin CHARACTERISTIC KOUTP_Dash2_cnt_maxval "" VALUE 0x0000 /* @ECU_Address@KOUTP_Dash2_cnt_maxval@ */ Scalar_UBYTE 0 SWC_OUTP_type_CM_uint8_cnt 0.0 255.0 /end CHARACTERISTIC
/begin CHARACTERISTIC KOUTP_Dash2_cnt_minval "" VALUE 0x0000 /* @ECU_Address@KOUTP_Dash2_cnt_minval@ */ Scalar_UBYTE 0 SWC_OUTP_type_CM_uint8_cnt 0.0 255.0 /end CHARACTERISTIC
/begin CHARACTERISTIC KOUTP_Dash2_cnt_ovrdval "" VALUE 0x0000 /* @ECU_Address@KOUTP_Dash2_cnt_ovrdval@ */ Scalar_UBYTE 0 SWC_OUTP_type_CM_uint8_enum 0.0 255.0 /end CHARACTERISTIC
/begin CHARACTERISTIC KOUTP_DrivingMode_cnt_maxval "" VALUE 0x0000 /* @ECU_Address@KOUTP_DrivingMode_cnt_maxval@ */ Scalar_UBYTE 0 SWC_OUTP_type_CM_uint8_cnt 0.0 255.0 /end CHARACTERISTIC
/begin CHARACTERISTIC KOUTP_DrivingMode_cnt_minval "" VALUE 0x0000 /* @ECU_Address@KOUTP_DrivingMode_cnt_minval@ */ Scalar_UBYTE 0 SWC_OUTP_type_CM_uint8_cnt 0.0 255.0 /end CHARACTERISTIC
/begin CHARACTERISTIC KOUTP_DrivingMode_cnt_ovrdval "" VALUE 0x0000 /* @ECU_Address@KOUTP_DrivingMode_cnt_ovrdval@ */ Scalar_UBYTE 0 SWC_OUTP_type_CM_uint8_enum 0.0 255.0 /end CHARACTERISTIC
/begin CHARACTERISTIC KOUTP_ECU1_cnt_maxval "" VALUE 0x0000 /* @ECU_Address@KOUTP_ECU1_cnt_maxval@ */ Scalar_UBYTE 0 SWC_OUTP_type_CM_uint8_cnt 0.0 255.0 /end CHARACTERISTIC
/begin CHARACTERISTIC KOUTP_ECU1_cnt_minval "" VALUE 0x0000 /* @ECU_Address@KOUTP_ECU1_cnt_minval@ */ Scalar_UBYTE 0 SWC_OUTP_type_CM_uint8_cnt 0.0 255.0 /end CHARACTERISTIC
/begin CHARACTERISTIC KOUTP_ECU1_cnt_ovrdval "" VALUE 0x0000 /* @ECU_Address@KOUTP_ECU1_cnt_ovrdval@ */ Scalar_UBYTE 0 SWC_OUTP_type_CM_uint8_enum 0.0 255.0 /end CHARACTERISTIC
/begin CHARACTERISTIC KOUTP_ECU2_cnt_maxval "" VALUE 0x0000 /* @ECU_Address@KOUTP_ECU2_cnt_maxval@ */ Scalar_UBYTE 0 SWC_OUTP_type_CM_uint8_cnt 0.0 255.0 /end CHARACTERISTIC
/begin CHARACTERISTIC KOUTP_ECU2_cnt_minval "" VALUE 0x0000 /* @ECU_Address@KOUTP_ECU2_cnt_minval@ */ Scalar_UBYTE 0 SWC_OUTP_type_CM_uint8_cnt 0.0 255.0 /end CHARACTERISTIC
/begin CHARACTERISTIC KOUTP_ECU2_cnt_ovrdval "" VALUE 0x0000 /* @ECU_Address@KOUTP_ECU2_cnt_ovrdval@ */ Scalar_UBYTE 0 SWC_OUTP_type_CM_uint8_enum 0.0 255.0 /end CHARACTERISTIC
/begin CHARACTERISTIC KOUTP_ECUGen1_cnt_maxval "" VALUE 0x0000 /* @ECU_Address@KOUTP_ECUGen1_cnt_maxval@ */ Scalar_UBYTE 0 SWC_OUTP_type_CM_uint8_enum 0.0 255.0 /end CHARACTERISTIC
/begin CHARACTERISTIC KOUTP_ECUGen1_cnt_minval "" VALUE 0x0000 /* @ECU_Address@KOUTP_ECUGen1_cnt_minval@ */ Scalar_UBYTE 0 SWC_OUTP_type_CM_uint8_enum 0.0 255.0 /end CHARACTERISTIC
/begin CHARACTERISTIC KOUTP_ECUGen1_cnt_ovrdval "" VALUE 0x0000 /* @ECU_Address@KOUTP_ECUGen1_cnt_ovrdval@ */ Scalar_UBYTE 0 SWC_OUTP_type_CM_uint8_enum 0.0 255.0 /end CHARACTERISTIC
/begin CHARACTERISTIC KOUTP_ECUGen2_cnt_maxval "" VALUE 0x0000 /* @ECU_Address@KOUTP_ECUGen2_cnt_maxval@ */ Scalar_UBYTE 0 SWC_OUTP_type_CM_uint8_enum 0.0 255.0 /end CHARACTERISTIC
/begin CHARACTERISTIC KOUTP_ECUGen2_cnt_minval "" VALUE 0x0000 /* @ECU_Address@KOUTP_ECUGen2_cnt_minval@ */ Scalar_UBYTE 0 SWC_OUTP_type_CM_uint8_enum 0.0 255.0 /end CHARACTERISTIC
/begin CHARACTERISTIC KOUTP_ECUGen2_cnt_ovrdval "" VALUE 0x0000 /* @ECU_Address@KOUTP_ECUGen2_cnt_ovrdval@ */ Scalar_UBYTE 0 SWC_OUTP_type_CM_uint8_enum 0.0 255.0 /end CHARACTERISTIC
/begin CHARACTERISTIC KOUTP_FlashIDvalid_enum_maxval "" VALUE 0x0000 /* @ECU_Address@KOUTP_FlashIDvalid_enum_maxval@ */ Scalar_UBYTE 0 SWC_OUTP_type_CM_uint8_enum 0.0 255.0 /end CHARACTERISTIC
/begin CHARACTERISTIC KOUTP_FlashIDvalid_enum_minval "" VALUE 0x0000 /* @ECU_Address@KOUTP_FlashIDvalid_enum_minval@ */ Scalar_UBYTE 0 SWC_OUTP_type_CM_uint8_enum 0.0 255.0 /end CHARACTERISTIC
/begin CHARACTERISTIC KOUTP_FlashIDvalid_enum_ovrdval "" VALUE 0x0000 /* @ECU_Address@KOUTP_FlashIDvalid_enum_ovrdval@ */ Scalar_UBYTE 0 SWC_OUTP_type_CM_uint8_enum 0.0 255.0 /end CHARACTERISTIC
/begin CHARACTERISTIC KOUTP_Flashchkdatavalid_enum_maxval "" VALUE 0x0000 /* @ECU_Address@KOUTP_Flashchkdatavalid_enum_maxval@ */ Scalar_UBYTE 0 SWC_OUTP_type_CM_uint8_enum 0.0 255.0 /end CHARACTERISTIC
/begin CHARACTERISTIC KOUTP_Flashchkdatavalid_enum_minval "" VALUE 0x0000 /* @ECU_Address@KOUTP_Flashchkdatavalid_enum_minval@ */ Scalar_UBYTE 0 SWC_OUTP_type_CM_uint8_enum 0.0 255.0 /end CHARACTERISTIC
/begin CHARACTERISTIC KOUTP_Flashchkdatavalid_enum_ovrdval "" VALUE 0x0000 /* @ECU_Address@KOUTP_Flashchkdatavalid_enum_ovrdval@ */ Scalar_UBYTE 0 SWC_OUTP_type_CM_uint8_enum 0.0 255.0 /end CHARACTERISTIC
/begin CHARACTERISTIC KOUTP_Flashdatavalid_enum_maxval "" VALUE 0x0000 /* @ECU_Address@KOUTP_Flashdatavalid_enum_maxval@ */ Scalar_UBYTE 0 SWC_OUTP_type_CM_uint8_enum 0.0 255.0 /end CHARACTERISTIC
/begin CHARACTERISTIC KOUTP_Flashdatavalid_enum_minval "" VALUE 0x0000 /* @ECU_Address@KOUTP_Flashdatavalid_enum_minval@ */ Scalar_UBYTE 0 SWC_OUTP_type_CM_uint8_enum 0.0 255.0 /end CHARACTERISTIC
/begin CHARACTERISTIC KOUTP_Flashdatavalid_enum_ovrdval "" VALUE 0x0000 /* @ECU_Address@KOUTP_Flashdatavalid_enum_ovrdval@ */ Scalar_UBYTE 0 SWC_OUTP_type_CM_uint8_enum 0.0 255.0 /end CHARACTERISTIC
/begin CHARACTERISTIC KOUTP_HWVer1_cnt_maxval "" VALUE 0x0000 /* @ECU_Address@KOUTP_HWVer1_cnt_maxval@ */ Scalar_UBYTE 0 SWC_OUTP_type_CM_uint8_cnt 0.0 255.0 /end CHARACTERISTIC
/begin CHARACTERISTIC KOUTP_HWVer1_cnt_minval "" VALUE 0x0000 /* @ECU_Address@KOUTP_HWVer1_cnt_minval@ */ Scalar_UBYTE 0 SWC_OUTP_type_CM_uint8_cnt 0.0 255.0 /end CHARACTERISTIC
/begin CHARACTERISTIC KOUTP_HWVer1_cnt_ovrdval "" VALUE 0x0000 /* @ECU_Address@KOUTP_HWVer1_cnt_ovrdval@ */ Scalar_UBYTE 0 SWC_OUTP_type_CM_uint8_enum 0.0 255.0 /end CHARACTERISTIC
/begin CHARACTERISTIC KOUTP_HWVer2_cnt_maxval "" VALUE 0x0000 /* @ECU_Address@KOUTP_HWVer2_cnt_maxval@ */ Scalar_UBYTE 0 SWC_OUTP_type_CM_uint8_cnt 0.0 255.0 /end CHARACTERISTIC
/begin CHARACTERISTIC KOUTP_HWVer2_cnt_minval "" VALUE 0x0000 /* @ECU_Address@KOUTP_HWVer2_cnt_minval@ */ Scalar_UBYTE 0 SWC_OUTP_type_CM_uint8_cnt 0.0 255.0 /end CHARACTERISTIC
/begin CHARACTERISTIC KOUTP_HWVer2_cnt_ovrdval "" VALUE 0x0000 /* @ECU_Address@KOUTP_HWVer2_cnt_ovrdval@ */ Scalar_UBYTE 0 SWC_OUTP_type_CM_uint8_enum 0.0 255.0 /end CHARACTERISTIC
/begin CHARACTERISTIC KOUTP_HWVer3_cnt_maxval "" VALUE 0x0000 /* @ECU_Address@KOUTP_HWVer3_cnt_maxval@ */ Scalar_UBYTE 0 SWC_OUTP_type_CM_uint8_cnt 0.0 255.0 /end CHARACTERISTIC
/begin CHARACTERISTIC KOUTP_HWVer3_cnt_minval "" VALUE 0x0000 /* @ECU_Address@KOUTP_HWVer3_cnt_minval@ */ Scalar_UBYTE 0 SWC_OUTP_type_CM_uint8_cnt 0.0 255.0 /end CHARACTERISTIC
/begin CHARACTERISTIC KOUTP_HWVer3_cnt_ovrdval "" VALUE 0x0000 /* @ECU_Address@KOUTP_HWVer3_cnt_ovrdval@ */ Scalar_UBYTE 0 SWC_OUTP_type_CM_uint8_enum 0.0 255.0 /end CHARACTERISTIC
/begin CHARACTERISTIC KOUTP_ID1messageALTU_raw8_maxval "" VALUE 0x0000 /* @ECU_Address@KOUTP_ID1messageALTU_raw8_maxval@ */ Scalar_UBYTE 0 SWC_OUTP_type_CM_uint8_raw 0.0 255.0 /end CHARACTERISTIC
/begin CHARACTERISTIC KOUTP_ID1messageALTU_raw8_minval "" VALUE 0x0000 /* @ECU_Address@KOUTP_ID1messageALTU_raw8_minval@ */ Scalar_UBYTE 0 SWC_OUTP_type_CM_uint8_raw 0.0 255.0 /end CHARACTERISTIC
/begin CHARACTERISTIC KOUTP_ID1messageALTU_raw8_ovrdval "" VALUE 0x0000 /* @ECU_Address@KOUTP_ID1messageALTU_raw8_ovrdval@ */ Scalar_UBYTE 0 SWC_OUTP_type_CM_uint8_enum 0.0 255.0 /end CHARACTERISTIC
/begin CHARACTERISTIC KOUTP_ID2messageALTU_raw8_maxval "" VALUE 0x0000 /* @ECU_Address@KOUTP_ID2messageALTU_raw8_maxval@ */ Scalar_UBYTE 0 SWC_OUTP_type_CM_uint8_raw 0.0 255.0 /end CHARACTERISTIC
/begin CHARACTERISTIC KOUTP_ID2messageALTU_raw8_minval "" VALUE 0x0000 /* @ECU_Address@KOUTP_ID2messageALTU_raw8_minval@ */ Scalar_UBYTE 0 SWC_OUTP_type_CM_uint8_raw 0.0 255.0 /end CHARACTERISTIC
/begin CHARACTERISTIC KOUTP_ID2messageALTU_raw8_ovrdval "" VALUE 0x0000 /* @ECU_Address@KOUTP_ID2messageALTU_raw8_ovrdval@ */ Scalar_UBYTE 0 SWC_OUTP_type_CM_uint8_enum 0.0 255.0 /end CHARACTERISTIC
/begin CHARACTERISTIC KOUTP_ID3messageALTU_raw8_maxval "" VALUE 0x0000 /* @ECU_Address@KOUTP_ID3messageALTU_raw8_maxval@ */ Scalar_UBYTE 0 SWC_OUTP_type_CM_uint8_raw 0.0 255.0 /end CHARACTERISTIC
/begin CHARACTERISTIC KOUTP_ID3messageALTU_raw8_minval "" VALUE 0x0000 /* @ECU_Address@KOUTP_ID3messageALTU_raw8_minval@ */ Scalar_UBYTE 0 SWC_OUTP_type_CM_uint8_raw 0.0 255.0 /end CHARACTERISTIC
/begin CHARACTERISTIC KOUTP_ID3messageALTU_raw8_ovrdval "" VALUE 0x0000 /* @ECU_Address@KOUTP_ID3messageALTU_raw8_ovrdval@ */ Scalar_UBYTE 0 SWC_OUTP_type_CM_uint8_enum 0.0 255.0 /end CHARACTERISTIC
/begin CHARACTERISTIC KOUTP_ID4messageALTU_raw8_maxval "" VALUE 0x0000 /* @ECU_Address@KOUTP_ID4messageALTU_raw8_maxval@ */ Scalar_UBYTE 0 SWC_OUTP_type_CM_uint8_raw 0.0 255.0 /end CHARACTERISTIC
/begin CHARACTERISTIC KOUTP_ID4messageALTU_raw8_minval "" VALUE 0x0000 /* @ECU_Address@KOUTP_ID4messageALTU_raw8_minval@ */ Scalar_UBYTE 0 SWC_OUTP_type_CM_uint8_raw 0.0 255.0 /end CHARACTERISTIC
/begin CHARACTERISTIC KOUTP_ID4messageALTU_raw8_ovrdval "" VALUE 0x0000 /* @ECU_Address@KOUTP_ID4messageALTU_raw8_ovrdval@ */ Scalar_UBYTE 0 SWC_OUTP_type_CM_uint8_enum 0.0 255.0 /end CHARACTERISTIC
/begin CHARACTERISTIC KOUTP_Keystatus_enum_maxval "" VALUE 0x0000 /* @ECU_Address@KOUTP_Keystatus_enum_maxval@ */ Scalar_UBYTE 0 SWC_OUTP_type_CM_uint8_enum 0.0 255.0 /end CHARACTERISTIC
/begin CHARACTERISTIC KOUTP_Keystatus_enum_minval "" VALUE 0x0000 /* @ECU_Address@KOUTP_Keystatus_enum_minval@ */ Scalar_UBYTE 0 SWC_OUTP_type_CM_uint8_enum 0.0 255.0 /end CHARACTERISTIC
/begin CHARACTERISTIC KOUTP_Keystatus_enum_ovrdval "" VALUE 0x0000 /* @ECU_Address@KOUTP_Keystatus_enum_ovrdval@ */ Scalar_UBYTE 0 SWC_OUTP_type_CM_uint8_enum 0.0 255.0 /end CHARACTERISTIC
/begin CHARACTERISTIC KOUTP_LFP20_raw8_maxval "" VALUE 0x0000 /* @ECU_Address@KOUTP_LFP20_raw8_maxval@ */ Scalar_UBYTE 0 SWC_OUTP_type_CM_uint8_raw 0.0 255.0 /end CHARACTERISTIC
/begin CHARACTERISTIC KOUTP_LFP20_raw8_minval "" VALUE 0x0000 /* @ECU_Address@KOUTP_LFP20_raw8_minval@ */ Scalar_UBYTE 0 SWC_OUTP_type_CM_uint8_raw 0.0 255.0 /end CHARACTERISTIC
/begin CHARACTERISTIC KOUTP_LFP20_raw8_ovrdval "" VALUE 0x0000 /* @ECU_Address@KOUTP_LFP20_raw8_ovrdval@ */ Scalar_UBYTE 0 SWC_OUTP_type_CM_uint8_enum 0.0 255.0 /end CHARACTERISTIC
/begin CHARACTERISTIC KOUTP_LFPindi_enum_maxval "" VALUE 0x0000 /* @ECU_Address@KOUTP_LFPindi_enum_maxval@ */ Scalar_UBYTE 0 SWC_OUTP_type_CM_uint8_enum 0.0 255.0 /end CHARACTERISTIC
/begin CHARACTERISTIC KOUTP_LFPindi_enum_minval "" VALUE 0x0000 /* @ECU_Address@KOUTP_LFPindi_enum_minval@ */ Scalar_UBYTE 0 SWC_OUTP_type_CM_uint8_enum 0.0 255.0 /end CHARACTERISTIC
/begin CHARACTERISTIC KOUTP_LFPindi_enum_ovrdval "" VALUE 0x0000 /* @ECU_Address@KOUTP_LFPindi_enum_ovrdval@ */ Scalar_UBYTE 0 SWC_OUTP_type_CM_uint8_enum 0.0 255.0 /end CHARACTERISTIC
/begin CHARACTERISTIC KOUTP_LFPressIndi_enum_maxval "" VALUE 0x0000 /* @ECU_Address@KOUTP_LFPressIndi_enum_maxval@ */ Scalar_UBYTE 0 SWC_OUTP_type_CM_uint8_enum 0.0 255.0 /end CHARACTERISTIC
/begin CHARACTERISTIC KOUTP_LFPressIndi_enum_minval "" VALUE 0x0000 /* @ECU_Address@KOUTP_LFPressIndi_enum_minval@ */ Scalar_UBYTE 0 SWC_OUTP_type_CM_uint8_enum 0.0 255.0 /end CHARACTERISTIC
/begin CHARACTERISTIC KOUTP_LFPressIndi_enum_ovrdval "" VALUE 0x0000 /* @ECU_Address@KOUTP_LFPressIndi_enum_ovrdval@ */ Scalar_UBYTE 0 SWC_OUTP_type_CM_uint8_enum 0.0 255.0 /end CHARACTERISTIC
/begin CHARACTERISTIC KOUTP_LFWheelPSW_raw8_maxval "" VALUE 0x0000 /* @ECU_Address@KOUTP_LFWheelPSW_raw8_maxval@ */ Scalar_UBYTE 0 SWC_OUTP_type_CM_uint8_raw8 0.0 255.0 /end CHARACTERISTIC
/begin CHARACTERISTIC KOUTP_LFWheelPSW_raw8_minval "" VALUE 0x0000 /* @ECU_Address@KOUTP_LFWheelPSW_raw8_minval@ */ Scalar_UBYTE 0 SWC_OUTP_type_CM_uint8_raw8 0.0 255.0 /end CHARACTERISTIC
/begin CHARACTERISTIC KOUTP_LFWheelPSW_raw8_ovrdval "" VALUE 0x0000 /* @ECU_Address@KOUTP_LFWheelPSW_raw8_ovrdval@ */ Scalar_UBYTE 0 SWC_OUTP_type_CM_uint8_enum 0.0 255.0 /end CHARACTERISTIC
/begin CHARACTERISTIC KOUTP_LFWheelPress_raw8_maxval "" VALUE 0x0000 /* @ECU_Address@KOUTP_LFWheelPress_raw8_maxval@ */ Scalar_UBYTE 0 SWC_OUTP_type_CM_uint8_raw8 0.0 255.0 /end CHARACTERISTIC
/begin CHARACTERISTIC KOUTP_LFWheelPress_raw8_minval "" VALUE 0x0000 /* @ECU_Address@KOUTP_LFWheelPress_raw8_minval@ */ Scalar_UBYTE 0 SWC_OUTP_type_CM_uint8_raw8 0.0 255.0 /end CHARACTERISTIC
/begin CHARACTERISTIC KOUTP_LFWheelPress_raw8_ovrdval "" VALUE 0x0000 /* @ECU_Address@KOUTP_LFWheelPress_raw8_ovrdval@ */ Scalar_UBYTE 0 SWC_OUTP_type_CM_uint8_enum 0.0 255.0 /end CHARACTERISTIC
/begin CHARACTERISTIC KOUTP_LProgress_enum_maxval "" VALUE 0x0000 /* @ECU_Address@KOUTP_LProgress_enum_maxval@ */ Scalar_UBYTE 0 SWC_OUTP_type_CM_uint8_enum 0.0 255.0 /end CHARACTERISTIC
/begin CHARACTERISTIC KOUTP_LProgress_enum_minval "" VALUE 0x0000 /* @ECU_Address@KOUTP_LProgress_enum_minval@ */ Scalar_UBYTE 0 SWC_OUTP_type_CM_uint8_enum 0.0 255.0 /end CHARACTERISTIC
/begin CHARACTERISTIC KOUTP_LProgress_enum_ovrdval "" VALUE 0x0000 /* @ECU_Address@KOUTP_LProgress_enum_ovrdval@ */ Scalar_UBYTE 0 SWC_OUTP_type_CM_uint8_enum 0.0 255.0 /end CHARACTERISTIC
/begin CHARACTERISTIC KOUTP_LRP20_raw8_maxval "" VALUE 0x0000 /* @ECU_Address@KOUTP_LRP20_raw8_maxval@ */ Scalar_UBYTE 0 SWC_OUTP_type_CM_uint8_raw 0.0 255.0 /end CHARACTERISTIC
/begin CHARACTERISTIC KOUTP_LRP20_raw8_minval "" VALUE 0x0000 /* @ECU_Address@KOUTP_LRP20_raw8_minval@ */ Scalar_UBYTE 0 SWC_OUTP_type_CM_uint8_raw 0.0 255.0 /end CHARACTERISTIC
/begin CHARACTERISTIC KOUTP_LRP20_raw8_ovrdval "" VALUE 0x0000 /* @ECU_Address@KOUTP_LRP20_raw8_ovrdval@ */ Scalar_UBYTE 0 SWC_OUTP_type_CM_uint8_enum 0.0 255.0 /end CHARACTERISTIC
/begin CHARACTERISTIC KOUTP_LRPindi_enum_maxval "" VALUE 0x0000 /* @ECU_Address@KOUTP_LRPindi_enum_maxval@ */ Scalar_UBYTE 0 SWC_OUTP_type_CM_uint8_enum 0.0 255.0 /end CHARACTERISTIC
/begin CHARACTERISTIC KOUTP_LRPindi_enum_minval "" VALUE 0x0000 /* @ECU_Address@KOUTP_LRPindi_enum_minval@ */ Scalar_UBYTE 0 SWC_OUTP_type_CM_uint8_enum 0.0 255.0 /end CHARACTERISTIC
/begin CHARACTERISTIC KOUTP_LRPindi_enum_ovrdval "" VALUE 0x0000 /* @ECU_Address@KOUTP_LRPindi_enum_ovrdval@ */ Scalar_UBYTE 0 SWC_OUTP_type_CM_uint8_enum 0.0 255.0 /end CHARACTERISTIC
/begin CHARACTERISTIC KOUTP_LRPressIndi_enum_maxval "" VALUE 0x0000 /* @ECU_Address@KOUTP_LRPressIndi_enum_maxval@ */ Scalar_UBYTE 0 SWC_OUTP_type_CM_uint8_enum 0.0 255.0 /end CHARACTERISTIC
/begin CHARACTERISTIC KOUTP_LRPressIndi_enum_minval "" VALUE 0x0000 /* @ECU_Address@KOUTP_LRPressIndi_enum_minval@ */ Scalar_UBYTE 0 SWC_OUTP_type_CM_uint8_enum 0.0 255.0 /end CHARACTERISTIC
/begin CHARACTERISTIC KOUTP_LRPressIndi_enum_ovrdval "" VALUE 0x0000 /* @ECU_Address@KOUTP_LRPressIndi_enum_ovrdval@ */ Scalar_UBYTE 0 SWC_OUTP_type_CM_uint8_enum 0.0 255.0 /end CHARACTERISTIC
/begin CHARACTERISTIC KOUTP_LRWheelPSW_raw8_maxval "" VALUE 0x0000 /* @ECU_Address@KOUTP_LRWheelPSW_raw8_maxval@ */ Scalar_UBYTE 0 SWC_OUTP_type_CM_uint8_raw8 0.0 255.0 /end CHARACTERISTIC
/begin CHARACTERISTIC KOUTP_LRWheelPSW_raw8_minval "" VALUE 0x0000 /* @ECU_Address@KOUTP_LRWheelPSW_raw8_minval@ */ Scalar_UBYTE 0 SWC_OUTP_type_CM_uint8_raw8 0.0 255.0 /end CHARACTERISTIC
/begin CHARACTERISTIC KOUTP_LRWheelPSW_raw8_ovrdval "" VALUE 0x0000 /* @ECU_Address@KOUTP_LRWheelPSW_raw8_ovrdval@ */ Scalar_UBYTE 0 SWC_OUTP_type_CM_uint8_enum 0.0 255.0 /end CHARACTERISTIC
/begin CHARACTERISTIC KOUTP_LRWheelPress_raw8_maxval "" VALUE 0x0000 /* @ECU_Address@KOUTP_LRWheelPress_raw8_maxval@ */ Scalar_UBYTE 0 SWC_OUTP_type_CM_uint8_raw8 0.0 255.0 /end CHARACTERISTIC
/begin CHARACTERISTIC KOUTP_LRWheelPress_raw8_minval "" VALUE 0x0000 /* @ECU_Address@KOUTP_LRWheelPress_raw8_minval@ */ Scalar_UBYTE 0 SWC_OUTP_type_CM_uint8_raw8 0.0 255.0 /end CHARACTERISTIC
/begin CHARACTERISTIC KOUTP_LRWheelPress_raw8_ovrdval "" VALUE 0x0000 /* @ECU_Address@KOUTP_LRWheelPress_raw8_ovrdval@ */ Scalar_UBYTE 0 SWC_OUTP_type_CM_uint8_enum 0.0 255.0 /end CHARACTERISTIC
/begin CHARACTERISTIC KOUTP_Major1_cnt_maxval "" VALUE 0x0000 /* @ECU_Address@KOUTP_Major1_cnt_maxval@ */ Scalar_UBYTE 0 SWC_OUTP_type_CM_uint8_cnt 0.0 255.0 /end CHARACTERISTIC
/begin CHARACTERISTIC KOUTP_Major1_cnt_minval "" VALUE 0x0000 /* @ECU_Address@KOUTP_Major1_cnt_minval@ */ Scalar_UBYTE 0 SWC_OUTP_type_CM_uint8_cnt 0.0 255.0 /end CHARACTERISTIC
/begin CHARACTERISTIC KOUTP_Major1_cnt_ovrdval "" VALUE 0x0000 /* @ECU_Address@KOUTP_Major1_cnt_ovrdval@ */ Scalar_UBYTE 0 SWC_OUTP_type_CM_uint8_enum 0.0 255.0 /end CHARACTERISTIC
/begin CHARACTERISTIC KOUTP_Major2_cnt_maxval "" VALUE 0x0000 /* @ECU_Address@KOUTP_Major2_cnt_maxval@ */ Scalar_UBYTE 0 SWC_OUTP_type_CM_uint8_cnt 0.0 255.0 /end CHARACTERISTIC
/begin CHARACTERISTIC KOUTP_Major2_cnt_minval "" VALUE 0x0000 /* @ECU_Address@KOUTP_Major2_cnt_minval@ */ Scalar_UBYTE 0 SWC_OUTP_type_CM_uint8_cnt 0.0 255.0 /end CHARACTERISTIC
/begin CHARACTERISTIC KOUTP_Major2_cnt_ovrdval "" VALUE 0x0000 /* @ECU_Address@KOUTP_Major2_cnt_ovrdval@ */ Scalar_UBYTE 0 SWC_OUTP_type_CM_uint8_enum 0.0 255.0 /end CHARACTERISTIC
/begin CHARACTERISTIC KOUTP_Minor1_cnt_maxval "" VALUE 0x0000 /* @ECU_Address@KOUTP_Minor1_cnt_maxval@ */ Scalar_UBYTE 0 SWC_OUTP_type_CM_uint8_cnt 0.0 255.0 /end CHARACTERISTIC
/begin CHARACTERISTIC KOUTP_Minor1_cnt_minval "" VALUE 0x0000 /* @ECU_Address@KOUTP_Minor1_cnt_minval@ */ Scalar_UBYTE 0 SWC_OUTP_type_CM_uint8_cnt 0.0 255.0 /end CHARACTERISTIC
/begin CHARACTERISTIC KOUTP_Minor1_cnt_ovrdval "" VALUE 0x0000 /* @ECU_Address@KOUTP_Minor1_cnt_ovrdval@ */ Scalar_UBYTE 0 SWC_OUTP_type_CM_uint8_enum 0.0 255.0 /end CHARACTERISTIC
/begin CHARACTERISTIC KOUTP_Minor2_cnt_maxval "" VALUE 0x0000 /* @ECU_Address@KOUTP_Minor2_cnt_maxval@ */ Scalar_UBYTE 0 SWC_OUTP_type_CM_uint8_cnt 0.0 255.0 /end CHARACTERISTIC
/begin CHARACTERISTIC KOUTP_Minor2_cnt_minval "" VALUE 0x0000 /* @ECU_Address@KOUTP_Minor2_cnt_minval@ */ Scalar_UBYTE 0 SWC_OUTP_type_CM_uint8_cnt 0.0 255.0 /end CHARACTERISTIC
/begin CHARACTERISTIC KOUTP_Minor2_cnt_ovrdval "" VALUE 0x0000 /* @ECU_Address@KOUTP_Minor2_cnt_ovrdval@ */ Scalar_UBYTE 0 SWC_OUTP_type_CM_uint8_enum 0.0 255.0 /end CHARACTERISTIC
/begin CHARACTERISTIC KOUTP_ModelVersionChksum_raw_maxval "" VALUE 0x0000 /* @ECU_Address@KOUTP_ModelVersionChksum_raw_maxval@ */ Scalar_UBYTE 0 SWC_OUTP_type_CM_uint8_raw8 0.0 255.0 /end CHARACTERISTIC
/begin CHARACTERISTIC KOUTP_ModelVersionChksum_raw_minval "" VALUE 0x0000 /* @ECU_Address@KOUTP_ModelVersionChksum_raw_minval@ */ Scalar_UBYTE 0 SWC_OUTP_type_CM_uint8_raw8 0.0 255.0 /end CHARACTERISTIC
/begin CHARACTERISTIC KOUTP_ModelVersionChksum_raw_ovrdval "" VALUE 0x0000 /* @ECU_Address@KOUTP_ModelVersionChksum_raw_ovrdval@ */ Scalar_UBYTE 0 SWC_OUTP_type_CM_uint8_enum 0.0 255.0 /end CHARACTERISTIC
/begin CHARACTERISTIC KOUTP_ModelVersion_raw_maxval "" VALUE 0x0000 /* @ECU_Address@KOUTP_ModelVersion_raw_maxval@ */ Scalar_UBYTE 0 SWC_OUTP_type_CM_uint8_raw8 0.0 255.0 /end CHARACTERISTIC
/begin CHARACTERISTIC KOUTP_ModelVersion_raw_minval "" VALUE 0x0000 /* @ECU_Address@KOUTP_ModelVersion_raw_minval@ */ Scalar_UBYTE 0 SWC_OUTP_type_CM_uint8_raw8 0.0 255.0 /end CHARACTERISTIC
/begin CHARACTERISTIC KOUTP_ModelVersion_raw_ovrdval "" VALUE 0x0000 /* @ECU_Address@KOUTP_ModelVersion_raw_ovrdval@ */ Scalar_UBYTE 0 SWC_OUTP_type_CM_uint8_enum 0.0 255.0 /end CHARACTERISTIC
/begin CHARACTERISTIC KOUTP_ModelYear_cnt_maxval "" VALUE 0x0000 /* @ECU_Address@KOUTP_ModelYear_cnt_maxval@ */ Scalar_UBYTE 0 SWC_OUTP_type_CM_uint8_cnt 0.0 255.0 /end CHARACTERISTIC
/begin CHARACTERISTIC KOUTP_ModelYear_cnt_minval "" VALUE 0x0000 /* @ECU_Address@KOUTP_ModelYear_cnt_minval@ */ Scalar_UBYTE 0 SWC_OUTP_type_CM_uint8_cnt 0.0 255.0 /end CHARACTERISTIC
/begin CHARACTERISTIC KOUTP_ModelYear_cnt_ovrdval "" VALUE 0x0000 /* @ECU_Address@KOUTP_ModelYear_cnt_ovrdval@ */ Scalar_UBYTE 0 SWC_OUTP_type_CM_uint8_enum 0.0 255.0 /end CHARACTERISTIC
/begin CHARACTERISTIC KOUTP_Patch1_cnt_maxval "" VALUE 0x0000 /* @ECU_Address@KOUTP_Patch1_cnt_maxval@ */ Scalar_UBYTE 0 SWC_OUTP_type_CM_uint8_cnt 0.0 255.0 /end CHARACTERISTIC
/begin CHARACTERISTIC KOUTP_Patch1_cnt_minval "" VALUE 0x0000 /* @ECU_Address@KOUTP_Patch1_cnt_minval@ */ Scalar_UBYTE 0 SWC_OUTP_type_CM_uint8_cnt 0.0 255.0 /end CHARACTERISTIC
/begin CHARACTERISTIC KOUTP_Patch1_cnt_ovrdval "" VALUE 0x0000 /* @ECU_Address@KOUTP_Patch1_cnt_ovrdval@ */ Scalar_UBYTE 0 SWC_OUTP_type_CM_uint8_enum 0.0 255.0 /end CHARACTERISTIC
/begin CHARACTERISTIC KOUTP_Patch2_cnt_maxval "" VALUE 0x0000 /* @ECU_Address@KOUTP_Patch2_cnt_maxval@ */ Scalar_UBYTE 0 SWC_OUTP_type_CM_uint8_cnt 0.0 255.0 /end CHARACTERISTIC
/begin CHARACTERISTIC KOUTP_Patch2_cnt_minval "" VALUE 0x0000 /* @ECU_Address@KOUTP_Patch2_cnt_minval@ */ Scalar_UBYTE 0 SWC_OUTP_type_CM_uint8_cnt 0.0 255.0 /end CHARACTERISTIC
/begin CHARACTERISTIC KOUTP_Patch2_cnt_ovrdval "" VALUE 0x0000 /* @ECU_Address@KOUTP_Patch2_cnt_ovrdval@ */ Scalar_UBYTE 0 SWC_OUTP_type_CM_uint8_enum 0.0 255.0 /end CHARACTERISTIC
/begin CHARACTERISTIC KOUTP_PmicBootReason_enum_maxval "" VALUE 0x0000 /* @ECU_Address@KOUTP_PmicBootReason_enum_maxval@ */ Scalar_UBYTE 0 SWC_OUTP_type_CM_uint8_cnt 0.0 255.0 /end CHARACTERISTIC
/begin CHARACTERISTIC KOUTP_PmicBootReason_enum_minval "" VALUE 0x0000 /* @ECU_Address@KOUTP_PmicBootReason_enum_minval@ */ Scalar_UBYTE 0 SWC_OUTP_type_CM_uint8_cnt 0.0 255.0 /end CHARACTERISTIC
/begin CHARACTERISTIC KOUTP_PmicBootReason_enum_ovrdval "" VALUE 0x0000 /* @ECU_Address@KOUTP_PmicBootReason_enum_ovrdval@ */ Scalar_UBYTE 0 SWC_OUTP_type_CM_uint8_enum 0.0 255.0 /end CHARACTERISTIC
/begin CHARACTERISTIC KOUTP_Prepresstempvalid_enum_maxval "" VALUE 0x0000 /* @ECU_Address@KOUTP_Prepresstempvalid_enum_maxval@ */ Scalar_UBYTE 0 SWC_OUTP_type_CM_uint8_enum 0.0 255.0 /end CHARACTERISTIC
/begin CHARACTERISTIC KOUTP_Prepresstempvalid_enum_minval "" VALUE 0x0000 /* @ECU_Address@KOUTP_Prepresstempvalid_enum_minval@ */ Scalar_UBYTE 0 SWC_OUTP_type_CM_uint8_enum 0.0 255.0 /end CHARACTERISTIC
/begin CHARACTERISTIC KOUTP_Prepresstempvalid_enum_ovrdval "" VALUE 0x0000 /* @ECU_Address@KOUTP_Prepresstempvalid_enum_ovrdval@ */ Scalar_UBYTE 0 SWC_OUTP_type_CM_uint8_enum 0.0 255.0 /end CHARACTERISTIC
/begin CHARACTERISTIC KOUTP_RFP20_raw8_maxval "" VALUE 0x0000 /* @ECU_Address@KOUTP_RFP20_raw8_maxval@ */ Scalar_UBYTE 0 SWC_OUTP_type_CM_uint8_raw 0.0 255.0 /end CHARACTERISTIC
/begin CHARACTERISTIC KOUTP_RFP20_raw8_minval "" VALUE 0x0000 /* @ECU_Address@KOUTP_RFP20_raw8_minval@ */ Scalar_UBYTE 0 SWC_OUTP_type_CM_uint8_raw 0.0 255.0 /end CHARACTERISTIC
/begin CHARACTERISTIC KOUTP_RFP20_raw8_ovrdval "" VALUE 0x0000 /* @ECU_Address@KOUTP_RFP20_raw8_ovrdval@ */ Scalar_UBYTE 0 SWC_OUTP_type_CM_uint8_enum 0.0 255.0 /end CHARACTERISTIC
/begin CHARACTERISTIC KOUTP_RFPind_enum_maxval "" VALUE 0x0000 /* @ECU_Address@KOUTP_RFPind_enum_maxval@ */ Scalar_UBYTE 0 SWC_OUTP_type_CM_uint8_enum 0.0 255.0 /end CHARACTERISTIC
/begin CHARACTERISTIC KOUTP_RFPind_enum_minval "" VALUE 0x0000 /* @ECU_Address@KOUTP_RFPind_enum_minval@ */ Scalar_UBYTE 0 SWC_OUTP_type_CM_uint8_enum 0.0 255.0 /end CHARACTERISTIC
/begin CHARACTERISTIC KOUTP_RFPind_enum_ovrdval "" VALUE 0x0000 /* @ECU_Address@KOUTP_RFPind_enum_ovrdval@ */ Scalar_UBYTE 0 SWC_OUTP_type_CM_uint8_enum 0.0 255.0 /end CHARACTERISTIC
/begin CHARACTERISTIC KOUTP_RFPressIndi_enum_maxval "" VALUE 0x0000 /* @ECU_Address@KOUTP_RFPressIndi_enum_maxval@ */ Scalar_UBYTE 0 SWC_OUTP_type_CM_uint8_enum 0.0 255.0 /end CHARACTERISTIC
/begin CHARACTERISTIC KOUTP_RFPressIndi_enum_minval "" VALUE 0x0000 /* @ECU_Address@KOUTP_RFPressIndi_enum_minval@ */ Scalar_UBYTE 0 SWC_OUTP_type_CM_uint8_enum 0.0 255.0 /end CHARACTERISTIC
/begin CHARACTERISTIC KOUTP_RFPressIndi_enum_ovrdval "" VALUE 0x0000 /* @ECU_Address@KOUTP_RFPressIndi_enum_ovrdval@ */ Scalar_UBYTE 0 SWC_OUTP_type_CM_uint8_enum 0.0 255.0 /end CHARACTERISTIC
/begin CHARACTERISTIC KOUTP_RFWheelPSW_raw8_maxval "" VALUE 0x0000 /* @ECU_Address@KOUTP_RFWheelPSW_raw8_maxval@ */ Scalar_UBYTE 0 SWC_OUTP_type_CM_uint8_raw8 0.0 255.0 /end CHARACTERISTIC
/begin CHARACTERISTIC KOUTP_RFWheelPSW_raw8_minval "" VALUE 0x0000 /* @ECU_Address@KOUTP_RFWheelPSW_raw8_minval@ */ Scalar_UBYTE 0 SWC_OUTP_type_CM_uint8_raw8 0.0 255.0 /end CHARACTERISTIC
/begin CHARACTERISTIC KOUTP_RFWheelPSW_raw8_ovrdval "" VALUE 0x0000 /* @ECU_Address@KOUTP_RFWheelPSW_raw8_ovrdval@ */ Scalar_UBYTE 0 SWC_OUTP_type_CM_uint8_enum 0.0 255.0 /end CHARACTERISTIC
/begin CHARACTERISTIC KOUTP_RFWheelPress_raw8_maxval "" VALUE 0x0000 /* @ECU_Address@KOUTP_RFWheelPress_raw8_maxval@ */ Scalar_UBYTE 0 SWC_OUTP_type_CM_uint8_raw8 0.0 255.0 /end CHARACTERISTIC
/begin CHARACTERISTIC KOUTP_RFWheelPress_raw8_minval "" VALUE 0x0000 /* @ECU_Address@KOUTP_RFWheelPress_raw8_minval@ */ Scalar_UBYTE 0 SWC_OUTP_type_CM_uint8_raw8 0.0 255.0 /end CHARACTERISTIC
/begin CHARACTERISTIC KOUTP_RFWheelPress_raw8_ovrdval "" VALUE 0x0000 /* @ECU_Address@KOUTP_RFWheelPress_raw8_ovrdval@ */ Scalar_UBYTE 0 SWC_OUTP_type_CM_uint8_enum 0.0 255.0 /end CHARACTERISTIC
/begin CHARACTERISTIC KOUTP_RRP20_raw8_maxval "" VALUE 0x0000 /* @ECU_Address@KOUTP_RRP20_raw8_maxval@ */ Scalar_UBYTE 0 SWC_OUTP_type_CM_uint8_raw 0.0 255.0 /end CHARACTERISTIC
/begin CHARACTERISTIC KOUTP_RRP20_raw8_minval "" VALUE 0x0000 /* @ECU_Address@KOUTP_RRP20_raw8_minval@ */ Scalar_UBYTE 0 SWC_OUTP_type_CM_uint8_raw 0.0 255.0 /end CHARACTERISTIC
/begin CHARACTERISTIC KOUTP_RRP20_raw8_ovrdval "" VALUE 0x0000 /* @ECU_Address@KOUTP_RRP20_raw8_ovrdval@ */ Scalar_UBYTE 0 SWC_OUTP_type_CM_uint8_enum 0.0 255.0 /end CHARACTERISTIC
/begin CHARACTERISTIC KOUTP_RRPindi_enum_maxval "" VALUE 0x0000 /* @ECU_Address@KOUTP_RRPindi_enum_maxval@ */ Scalar_UBYTE 0 SWC_OUTP_type_CM_uint8_enum 0.0 255.0 /end CHARACTERISTIC
/begin CHARACTERISTIC KOUTP_RRPindi_enum_minval "" VALUE 0x0000 /* @ECU_Address@KOUTP_RRPindi_enum_minval@ */ Scalar_UBYTE 0 SWC_OUTP_type_CM_uint8_enum 0.0 255.0 /end CHARACTERISTIC
/begin CHARACTERISTIC KOUTP_RRPindi_enum_ovrdval "" VALUE 0x0000 /* @ECU_Address@KOUTP_RRPindi_enum_ovrdval@ */ Scalar_UBYTE 0 SWC_OUTP_type_CM_uint8_enum 0.0 255.0 /end CHARACTERISTIC
/begin CHARACTERISTIC KOUTP_RRPressIndi_enum_maxval "" VALUE 0x0000 /* @ECU_Address@KOUTP_RRPressIndi_enum_maxval@ */ Scalar_UBYTE 0 SWC_OUTP_type_CM_uint8_enum 0.0 255.0 /end CHARACTERISTIC
/begin CHARACTERISTIC KOUTP_RRPressIndi_enum_minval "" VALUE 0x0000 /* @ECU_Address@KOUTP_RRPressIndi_enum_minval@ */ Scalar_UBYTE 0 SWC_OUTP_type_CM_uint8_enum 0.0 255.0 /end CHARACTERISTIC
/begin CHARACTERISTIC KOUTP_RRPressIndi_enum_ovrdval "" VALUE 0x0000 /* @ECU_Address@KOUTP_RRPressIndi_enum_ovrdval@ */ Scalar_UBYTE 0 SWC_OUTP_type_CM_uint8_enum 0.0 255.0 /end CHARACTERISTIC
/begin CHARACTERISTIC KOUTP_SHA1_cnt_maxval "" VALUE 0x0000 /* @ECU_Address@KOUTP_SHA1_cnt_maxval@ */ Scalar_UBYTE 0 SWC_OUTP_type_CM_uint8_cnt 0.0 255.0 /end CHARACTERISTIC
/begin CHARACTERISTIC KOUTP_SHA1_cnt_minval "" VALUE 0x0000 /* @ECU_Address@KOUTP_SHA1_cnt_minval@ */ Scalar_UBYTE 0 SWC_OUTP_type_CM_uint8_cnt 0.0 255.0 /end CHARACTERISTIC
/begin CHARACTERISTIC KOUTP_SHA1_cnt_ovrdval "" VALUE 0x0000 /* @ECU_Address@KOUTP_SHA1_cnt_ovrdval@ */ Scalar_UBYTE 0 SWC_OUTP_type_CM_uint8_enum 0.0 255.0 /end CHARACTERISTIC
/begin CHARACTERISTIC KOUTP_SHA2_cnt_maxval "" VALUE 0x0000 /* @ECU_Address@KOUTP_SHA2_cnt_maxval@ */ Scalar_UBYTE 0 SWC_OUTP_type_CM_uint8_cnt 0.0 255.0 /end CHARACTERISTIC
/begin CHARACTERISTIC KOUTP_SHA2_cnt_minval "" VALUE 0x0000 /* @ECU_Address@KOUTP_SHA2_cnt_minval@ */ Scalar_UBYTE 0 SWC_OUTP_type_CM_uint8_cnt 0.0 255.0 /end CHARACTERISTIC
/begin CHARACTERISTIC KOUTP_SHA2_cnt_ovrdval "" VALUE 0x0000 /* @ECU_Address@KOUTP_SHA2_cnt_ovrdval@ */ Scalar_UBYTE 0 SWC_OUTP_type_CM_uint8_enum 0.0 255.0 /end CHARACTERISTIC
/begin CHARACTERISTIC KOUTP_SHA3_cnt_maxval "" VALUE 0x0000 /* @ECU_Address@KOUTP_SHA3_cnt_maxval@ */ Scalar_UBYTE 0 SWC_OUTP_type_CM_uint8_cnt 0.0 255.0 /end CHARACTERISTIC
/begin CHARACTERISTIC KOUTP_SHA3_cnt_minval "" VALUE 0x0000 /* @ECU_Address@KOUTP_SHA3_cnt_minval@ */ Scalar_UBYTE 0 SWC_OUTP_type_CM_uint8_cnt 0.0 255.0 /end CHARACTERISTIC
/begin CHARACTERISTIC KOUTP_SHA3_cnt_ovrdval "" VALUE 0x0000 /* @ECU_Address@KOUTP_SHA3_cnt_ovrdval@ */ Scalar_UBYTE 0 SWC_OUTP_type_CM_uint8_enum 0.0 255.0 /end CHARACTERISTIC
/begin CHARACTERISTIC KOUTP_SHA4_cnt_maxval "" VALUE 0x0000 /* @ECU_Address@KOUTP_SHA4_cnt_maxval@ */ Scalar_UBYTE 0 SWC_OUTP_type_CM_uint8_cnt 0.0 255.0 /end CHARACTERISTIC
/begin CHARACTERISTIC KOUTP_SHA4_cnt_minval "" VALUE 0x0000 /* @ECU_Address@KOUTP_SHA4_cnt_minval@ */ Scalar_UBYTE 0 SWC_OUTP_type_CM_uint8_cnt 0.0 255.0 /end CHARACTERISTIC
/begin CHARACTERISTIC KOUTP_SHA4_cnt_ovrdval "" VALUE 0x0000 /* @ECU_Address@KOUTP_SHA4_cnt_ovrdval@ */ Scalar_UBYTE 0 SWC_OUTP_type_CM_uint8_enum 0.0 255.0 /end CHARACTERISTIC
/begin CHARACTERISTIC KOUTP_SHA5_cnt_maxval "" VALUE 0x0000 /* @ECU_Address@KOUTP_SHA5_cnt_maxval@ */ Scalar_UBYTE 0 SWC_OUTP_type_CM_uint8_cnt 0.0 255.0 /end CHARACTERISTIC
/begin CHARACTERISTIC KOUTP_SHA5_cnt_minval "" VALUE 0x0000 /* @ECU_Address@KOUTP_SHA5_cnt_minval@ */ Scalar_UBYTE 0 SWC_OUTP_type_CM_uint8_cnt 0.0 255.0 /end CHARACTERISTIC
/begin CHARACTERISTIC KOUTP_SHA5_cnt_ovrdval "" VALUE 0x0000 /* @ECU_Address@KOUTP_SHA5_cnt_ovrdval@ */ Scalar_UBYTE 0 SWC_OUTP_type_CM_uint8_enum 0.0 255.0 /end CHARACTERISTIC
/begin CHARACTERISTIC KOUTP_SHA6_cnt_maxval "" VALUE 0x0000 /* @ECU_Address@KOUTP_SHA6_cnt_maxval@ */ Scalar_UBYTE 0 SWC_OUTP_type_CM_uint8_cnt 0.0 255.0 /end CHARACTERISTIC
/begin CHARACTERISTIC KOUTP_SHA6_cnt_minval "" VALUE 0x0000 /* @ECU_Address@KOUTP_SHA6_cnt_minval@ */ Scalar_UBYTE 0 SWC_OUTP_type_CM_uint8_cnt 0.0 255.0 /end CHARACTERISTIC
/begin CHARACTERISTIC KOUTP_SHA6_cnt_ovrdval "" VALUE 0x0000 /* @ECU_Address@KOUTP_SHA6_cnt_ovrdval@ */ Scalar_UBYTE 0 SWC_OUTP_type_CM_uint8_enum 0.0 255.0 /end CHARACTERISTIC
/begin CHARACTERISTIC KOUTP_SHA7_cnt_maxval "" VALUE 0x0000 /* @ECU_Address@KOUTP_SHA7_cnt_maxval@ */ Scalar_UBYTE 0 SWC_OUTP_type_CM_uint8_cnt 0.0 255.0 /end CHARACTERISTIC
/begin CHARACTERISTIC KOUTP_SHA7_cnt_minval "" VALUE 0x0000 /* @ECU_Address@KOUTP_SHA7_cnt_minval@ */ Scalar_UBYTE 0 SWC_OUTP_type_CM_uint8_cnt 0.0 255.0 /end CHARACTERISTIC
/begin CHARACTERISTIC KOUTP_SHA7_cnt_ovrdval "" VALUE 0x0000 /* @ECU_Address@KOUTP_SHA7_cnt_ovrdval@ */ Scalar_UBYTE 0 SWC_OUTP_type_CM_uint8_enum 0.0 255.0 /end CHARACTERISTIC
/begin CHARACTERISTIC KOUTP_SHA8_cnt_maxval "" VALUE 0x0000 /* @ECU_Address@KOUTP_SHA8_cnt_maxval@ */ Scalar_UBYTE 0 SWC_OUTP_type_CM_uint8_cnt 0.0 255.0 /end CHARACTERISTIC
/begin CHARACTERISTIC KOUTP_SHA8_cnt_minval "" VALUE 0x0000 /* @ECU_Address@KOUTP_SHA8_cnt_minval@ */ Scalar_UBYTE 0 SWC_OUTP_type_CM_uint8_cnt 0.0 255.0 /end CHARACTERISTIC
/begin CHARACTERISTIC KOUTP_SHA8_cnt_ovrdval "" VALUE 0x0000 /* @ECU_Address@KOUTP_SHA8_cnt_ovrdval@ */ Scalar_UBYTE 0 SWC_OUTP_type_CM_uint8_enum 0.0 255.0 /end CHARACTERISTIC
/begin CHARACTERISTIC KOUTP_V2BLifeSig_cnt_ovrdval "" VALUE 0x0000 /* @ECU_Address@KOUTP_V2BLifeSig_cnt_ovrdval@ */ Scalar_UBYTE 0 SWC_OUTP_type_CM_uint8_enum 0.0 255.0 /end CHARACTERISTIC
/begin CHARACTERISTIC KOUTP_V2BMainPosRlyFit_enum_maxval "" VALUE 0x0000 /* @ECU_Address@KOUTP_V2BMainPosRlyFit_enum_maxval@ */ Scalar_UBYTE 0 SWC_OUTP_type_CM_uint8_enum 0.0 255.0 /end CHARACTERISTIC
/begin CHARACTERISTIC KOUTP_V2BMainPosRlyFit_enum_minval "" VALUE 0x0000 /* @ECU_Address@KOUTP_V2BMainPosRlyFit_enum_minval@ */ Scalar_UBYTE 0 SWC_OUTP_type_CM_uint8_enum 0.0 255.0 /end CHARACTERISTIC
/begin CHARACTERISTIC KOUTP_V2BMainPosRlyFit_enum_ovrdval "" VALUE 0x0000 /* @ECU_Address@KOUTP_V2BMainPosRlyFit_enum_ovrdval@ */ Scalar_UBYTE 0 SWC_OUTP_type_CM_uint8_enum 0.0 255.0 /end CHARACTERISTIC
/begin CHARACTERISTIC KOUTP_V2BMainPosRlySta_enum_maxval "" VALUE 0x0000 /* @ECU_Address@KOUTP_V2BMainPosRlySta_enum_maxval@ */ Scalar_UBYTE 0 SWC_OUTP_type_CM_uint8_enum 0.0 255.0 /end CHARACTERISTIC
/begin CHARACTERISTIC KOUTP_V2BMainPosRlySta_enum_minval "" VALUE 0x0000 /* @ECU_Address@KOUTP_V2BMainPosRlySta_enum_minval@ */ Scalar_UBYTE 0 SWC_OUTP_type_CM_uint8_enum 0.0 255.0 /end CHARACTERISTIC
/begin CHARACTERISTIC KOUTP_V2BMainPosRlySta_enum_ovrdval "" VALUE 0x0000 /* @ECU_Address@KOUTP_V2BMainPosRlySta_enum_ovrdval@ */ Scalar_UBYTE 0 SWC_OUTP_type_CM_uint8_enum 0.0 255.0 /end CHARACTERISTIC
/begin CHARACTERISTIC KOUTP_V2BOilPosRlyFit_enum_maxval "" VALUE 0x0000 /* @ECU_Address@KOUTP_V2BOilPosRlyFit_enum_maxval@ */ Scalar_UBYTE 0 SWC_OUTP_type_CM_uint8_enum 0.0 255.0 /end CHARACTERISTIC
/begin CHARACTERISTIC KOUTP_V2BOilPosRlyFit_enum_minval "" VALUE 0x0000 /* @ECU_Address@KOUTP_V2BOilPosRlyFit_enum_minval@ */ Scalar_UBYTE 0 SWC_OUTP_type_CM_uint8_enum 0.0 255.0 /end CHARACTERISTIC
/begin CHARACTERISTIC KOUTP_V2BOilPosRlyFit_enum_ovrdval "" VALUE 0x0000 /* @ECU_Address@KOUTP_V2BOilPosRlyFit_enum_ovrdval@ */ Scalar_UBYTE 0 SWC_OUTP_type_CM_uint8_enum 0.0 255.0 /end CHARACTERISTIC
/begin CHARACTERISTIC KOUTP_V2BOilPosRlySta_enum_maxval "" VALUE 0x0000 /* @ECU_Address@KOUTP_V2BOilPosRlySta_enum_maxval@ */ Scalar_UBYTE 0 SWC_OUTP_type_CM_uint8_enum 0.0 255.0 /end CHARACTERISTIC
/begin CHARACTERISTIC KOUTP_V2BOilPosRlySta_enum_minval "" VALUE 0x0000 /* @ECU_Address@KOUTP_V2BOilPosRlySta_enum_minval@ */ Scalar_UBYTE 0 SWC_OUTP_type_CM_uint8_enum 0.0 255.0 /end CHARACTERISTIC
/begin CHARACTERISTIC KOUTP_V2BOilPosRlySta_enum_ovrdval "" VALUE 0x0000 /* @ECU_Address@KOUTP_V2BOilPosRlySta_enum_ovrdval@ */ Scalar_UBYTE 0 SWC_OUTP_type_CM_uint8_enum 0.0 255.0 /end CHARACTERISTIC
/begin CHARACTERISTIC KOUTP_VCULife1_cnt_maxval "" VALUE 0x0000 /* @ECU_Address@KOUTP_VCULife1_cnt_maxval@ */ Scalar_UBYTE 0 SWC_OUTP_type_CM_uint8_enum 0.0 255.0 /end CHARACTERISTIC
/begin CHARACTERISTIC KOUTP_VCULife1_cnt_minval "" VALUE 0x0000 /* @ECU_Address@KOUTP_VCULife1_cnt_minval@ */ Scalar_UBYTE 0 SWC_OUTP_type_CM_uint8_enum 0.0 255.0 /end CHARACTERISTIC
/begin CHARACTERISTIC KOUTP_VCULife1_cnt_ovrdval "" VALUE 0x0000 /* @ECU_Address@KOUTP_VCULife1_cnt_ovrdval@ */ Scalar_UBYTE 0 SWC_OUTP_type_CM_uint8_enum 0.0 255.0 /end CHARACTERISTIC
/begin CHARACTERISTIC KOUTP_VCULife2_cnt_maxval "" VALUE 0x0000 /* @ECU_Address@KOUTP_VCULife2_cnt_maxval@ */ Scalar_UBYTE 0 SWC_OUTP_type_CM_uint8_enum 0.0 255.0 /end CHARACTERISTIC
/begin CHARACTERISTIC KOUTP_VCULife2_cnt_minval "" VALUE 0x0000 /* @ECU_Address@KOUTP_VCULife2_cnt_minval@ */ Scalar_UBYTE 0 SWC_OUTP_type_CM_uint8_enum 0.0 255.0 /end CHARACTERISTIC
/begin CHARACTERISTIC KOUTP_VCULife2_cnt_ovrdval "" VALUE 0x0000 /* @ECU_Address@KOUTP_VCULife2_cnt_ovrdval@ */ Scalar_UBYTE 0 SWC_OUTP_type_CM_uint8_enum 0.0 255.0 /end CHARACTERISTIC
/begin CHARACTERISTIC KOUTP_VSPFunc_enum_maxval "" VALUE 0x0000 /* @ECU_Address@KOUTP_VSPFunc_enum_maxval@ */ Scalar_UBYTE 0 SWC_OUTP_type_CM_uint8_enum 0.0 255.0 /end CHARACTERISTIC
/begin CHARACTERISTIC KOUTP_VSPFunc_enum_minval "" VALUE 0x0000 /* @ECU_Address@KOUTP_VSPFunc_enum_minval@ */ Scalar_UBYTE 0 SWC_OUTP_type_CM_uint8_enum 0.0 255.0 /end CHARACTERISTIC
/begin CHARACTERISTIC KOUTP_VSPFunc_enum_ovrdval "" VALUE 0x0000 /* @ECU_Address@KOUTP_VSPFunc_enum_ovrdval@ */ Scalar_UBYTE 0 SWC_OUTP_type_CM_uint8_enum 0.0 255.0 /end CHARACTERISTIC
/begin CHARACTERISTIC KOUTP_VSPIGNKeySta_enum_maxval "" VALUE 0x0000 /* @ECU_Address@KOUTP_VSPIGNKeySta_enum_maxval@ */ Scalar_UBYTE 0 SWC_OUTP_type_CM_uint8_enum 0.0 255.0 /end CHARACTERISTIC
/begin CHARACTERISTIC KOUTP_VSPIGNKeySta_enum_minval "" VALUE 0x0000 /* @ECU_Address@KOUTP_VSPIGNKeySta_enum_minval@ */ Scalar_UBYTE 0 SWC_OUTP_type_CM_uint8_enum 0.0 255.0 /end CHARACTERISTIC
/begin CHARACTERISTIC KOUTP_VSPIGNKeySta_enum_ovrdval "" VALUE 0x0000 /* @ECU_Address@KOUTP_VSPIGNKeySta_enum_ovrdval@ */ Scalar_UBYTE 0 SWC_OUTP_type_CM_uint8_enum 0.0 255.0 /end CHARACTERISTIC
/begin CHARACTERISTIC KOUTP_VSPTurnLeft_enum_maxval "" VALUE 0x0000 /* @ECU_Address@KOUTP_VSPTurnLeft_enum_maxval@ */ Scalar_UBYTE 0 SWC_OUTP_type_CM_uint8_enum 0.0 255.0 /end CHARACTERISTIC
/begin CHARACTERISTIC KOUTP_VSPTurnLeft_enum_minval "" VALUE 0x0000 /* @ECU_Address@KOUTP_VSPTurnLeft_enum_minval@ */ Scalar_UBYTE 0 SWC_OUTP_type_CM_uint8_enum 0.0 255.0 /end CHARACTERISTIC
/begin CHARACTERISTIC KOUTP_VSPTurnLeft_enum_ovrdval "" VALUE 0x0000 /* @ECU_Address@KOUTP_VSPTurnLeft_enum_ovrdval@ */ Scalar_UBYTE 0 SWC_OUTP_type_CM_uint8_enum 0.0 255.0 /end CHARACTERISTIC
/begin CHARACTERISTIC KOUTP_VSPTurnRight_enum_maxval "" VALUE 0x0000 /* @ECU_Address@KOUTP_VSPTurnRight_enum_maxval@ */ Scalar_UBYTE 0 SWC_OUTP_type_CM_uint8_enum 0.0 255.0 /end CHARACTERISTIC
/begin CHARACTERISTIC KOUTP_VSPTurnRight_enum_minval "" VALUE 0x0000 /* @ECU_Address@KOUTP_VSPTurnRight_enum_minval@ */ Scalar_UBYTE 0 SWC_OUTP_type_CM_uint8_enum 0.0 255.0 /end CHARACTERISTIC
/begin CHARACTERISTIC KOUTP_VSPTurnRight_enum_ovrdval "" VALUE 0x0000 /* @ECU_Address@KOUTP_VSPTurnRight_enum_ovrdval@ */ Scalar_UBYTE 0 SWC_OUTP_type_CM_uint8_enum 0.0 255.0 /end CHARACTERISTIC
/begin CHARACTERISTIC KOUTP_Variation_cnt_maxval "" VALUE 0x0000 /* @ECU_Address@KOUTP_Variation_cnt_maxval@ */ Scalar_UBYTE 0 SWC_OUTP_type_CM_uint8_cnt 0.0 255.0 /end CHARACTERISTIC
/begin CHARACTERISTIC KOUTP_Variation_cnt_minval "" VALUE 0x0000 /* @ECU_Address@KOUTP_Variation_cnt_minval@ */ Scalar_UBYTE 0 SWC_OUTP_type_CM_uint8_cnt 0.0 255.0 /end CHARACTERISTIC
/begin CHARACTERISTIC KOUTP_Variation_cnt_ovrdval "" VALUE 0x0000 /* @ECU_Address@KOUTP_Variation_cnt_ovrdval@ */ Scalar_UBYTE 0 SWC_OUTP_type_CM_uint8_enum 0.0 255.0 /end CHARACTERISTIC
/begin COMPU_METHOD SWC_OUTP_type_CM_single_pct "Q = V" RAT_FUNC "%8.6" "pct" COEFFS 0 1 0 0 0 1 /end COMPU_METHOD
/begin COMPU_METHOD SWC_OUTP_type_CM_single_C "Q = V" RAT_FUNC "%8.6" "C" COEFFS 0 1 0 0 0 1 /end COMPU_METHOD
/begin COMPU_METHOD SWC_OUTP_type_CM_single_rpm "Q = V" RAT_FUNC "%8.6" "rpm" COEFFS 0 1 0 0 0 1 /end COMPU_METHOD
/begin COMPU_METHOD SWC_OUTP_type_CM_single_sec "Q = V" RAT_FUNC "%8.6" "sec" COEFFS 0 1 0 0 0 1 /end COMPU_METHOD
/begin COMPU_METHOD SWC_OUTP_type_CM_uint32_raw32 "Q = V" RAT_FUNC "%10.0" "raw32" COEFFS 0 1 0 0 0 1 /end COMPU_METHOD
/begin COMPU_METHOD SWC_OUTP_type_CM_uint32_enum "Q = V" RAT_FUNC "%10.0" "enum" COEFFS 0 1 0 0 0 1 /end COMPU_METHOD
/begin COMPU_METHOD SWC_OUTP_type_CM_uint32_raw "Q = V" RAT_FUNC "%10.0" "raw" COEFFS 0 1 0 0 0 1 /end COMPU_METHOD
/begin COMPU_METHOD SWC_OUTP_type_CM_uint32_cnt "Q = V" RAT_FUNC "%10.0" "cnt" COEFFS 0 1 0 0 0 1 /end COMPU_METHOD
/begin COMPU_METHOD SWC_OUTP_type_CM_uint16_enum "Q = V" RAT_FUNC "%5.0" "enum" COEFFS 0 1 0 0 0 1 /end COMPU_METHOD
/begin COMPU_METHOD SWC_OUTP_type_CM_uint16_raw "Q = V" RAT_FUNC "%5.0" "raw" COEFFS 0 1 0 0 0 1 /end COMPU_METHOD
/begin COMPU_METHOD SWC_OUTP_type_CM_boolean_flg "Q = V" RAT_FUNC "%1.0" "flg" COEFFS 0 1 0 0 0 1 /end COMPU_METHOD
/begin COMPU_METHOD SWC_OUTP_type_CM_uint8_enum "Q = V" RAT_FUNC "%3.0" "enum" COEFFS 0 1 0 0 0 1 /end COMPU_METHOD
/begin COMPU_METHOD SWC_OUTP_type_CM_uint8_cnt "Q = V" RAT_FUNC "%3.0" "cnt" COEFFS 0 1 0 0 0 1 /end COMPU_METHOD
/begin COMPU_METHOD SWC_OUTP_type_CM_uint8_raw "Q = V" RAT_FUNC "%3.0" "raw" COEFFS 0 1 0 0 0 1 /end COMPU_METHOD
/begin COMPU_METHOD SWC_OUTP_type_CM_uint8_raw8 "Q = V" RAT_FUNC "%3.0" "raw8" COEFFS 0 1 0 0 0 1 /end COMPU_METHOD
/begin GROUP S579_Signal_Override "SWC_OUTP_type/run_SWC_OUTP_5ms_sys/OUTP/outpmodule/VPMM_V2BLifeSig_cnt_Inproc/Signal_Override" /begin REF_CHARACTERISTIC KOUTP_V2BLifeSig_cnt_ovrdflg KOUTP_V2BLifeSig_cnt_ovrdval /end REF_CHARACTERISTIC /end GROUP
/begin GROUP S580_Signal_Limit "SWC_OUTP_type/run_SWC_OUTP_5ms_sys/OUTP/outpmodule/VPMM_V2BMainPosRlyFit_enum_Inproc/Signal_Limit"
 /begin REF_CHARACTERISTIC KOUTP_V2BMainPosRlyFit_enum_maxval KOUTP_V2BMainPosRlyFit_enum_minval /end REF_CHARACTERISTIC
/end GROUP
/begin GROUP S580_Signal_Override "SWC_OUTP_type/run_SWC_OUTP_5ms_sys/OUTP/outpmodule/VPMM_V2BMainPosRlyFit_enum_Inproc/Signal_Override"
 /begin REF_CHARACTERISTIC KOUTP_V2BMainPosRlyFit_enum_ovrdflg KOUTP_V2BMainPosRlyFit_enum_ovrdval /end REF_CHARACTERISTIC
/end GROUP
/begin GROUP S581_Signal_Limit "SWC_OUTP_type/run_SWC_OUTP_5ms_sys/OUTP/outpmodule/VPMM_V2BMainPosRlySta_enum_Inproc/Signal_Limit"
 /begin REF_CHARACTERISTIC KOUTP_V2BMainPosRlySta_enum_maxval KOUTP_V2BMainPosRlySta_enum_minval /end REF_CHARACTERISTIC
/end GROUP
/begin GROUP S581_Signal_Override "SWC_OUTP_type/run_SWC_OUTP_5ms_sys/OUTP/outpmodule/VPMM_V2BMainPosRlySta_enum_Inproc/Signal_Override"
 /begin REF_CHARACTERISTIC KOUTP_V2BMainPosRlySta_enum_ovrdflg KOUTP_V2BMainPosRlySta_enum_ovrdval /end REF_CHARACTERISTIC
/end GROUP
/begin GROUP S582_Signal_Limit "SWC_OUTP_type/run_SWC_OUTP_5ms_sys/OUTP/outpmodule/VPMM_V2BOilPosRlyFit_enum_Inproc/Signal_Limit"
 /begin REF_CHARACTERISTIC KOUTP_V2BOilPosRlyFit_enum_maxval KOUTP_V2BOilPosRlyFit_enum_minval /end REF_CHARACTERISTIC
/end GROUP
/begin GROUP S582_Signal_Override "SWC_OUTP_type/run_SWC_OUTP_5ms_sys/OUTP/outpmodule/VPMM_V2BOilPosRlyFit_enum_Inproc/Signal_Override"
 /begin REF_CHARACTERISTIC KOUTP_V2BOilPosRlyFit_enum_ovrdflg KOUTP_V2BOilPosRlyFit_enum_ovrdval /end REF_CHARACTERISTIC
/end GROUP
/begin GROUP S583_Signal_Limit "SWC_OUTP_type/run_SWC_OUTP_5ms_sys/OUTP/outpmodule/VPMM_V2BOilPosRlySta_enum_Inproc/Signal_Limit"
 /begin REF_CHARACTERISTIC KOUTP_V2BOilPosRlySta_enum_maxval KOUTP_V2BOilPosRlySta_enum_minval /end REF_CHARACTERISTIC
/end GROUP
/begin GROUP S583_Signal_Override "SWC_OUTP_type/run_SWC_OUTP_5ms_sys/OUTP/outpmodule/VPMM_V2BOilPosRlySta_enum_Inproc/Signal_Override"
 /begin REF_CHARACTERISTIC KOUTP_V2BOilPosRlySta_enum_ovrdflg KOUTP_V2BOilPosRlySta_enum_ovrdval /end REF_CHARACTERISTIC
/end GROUP
/begin GROUP S584_Signal_Limit "SWC_OUTP_type/run_SWC_OUTP_5ms_sys/OUTP/outpmodule/VPMM_VCULife1_cnt_Inproc/Signal_Limit" /begin REF_CHARACTERISTIC KOUTP_VCULife1_cnt_maxval KOUTP_VCULife1_cnt_minval /end REF_CHARACTERISTIC /end GROUP
/begin GROUP S584_Signal_Override "SWC_OUTP_type/run_SWC_OUTP_5ms_sys/OUTP/outpmodule/VPMM_VCULife1_cnt_Inproc/Signal_Override" /begin REF_CHARACTERISTIC KOUTP_VCULife1_cnt_ovrdflg KOUTP_VCULife1_cnt_ovrdval /end REF_CHARACTERISTIC /end GROUP
/begin GROUP S585_Signal_Limit "SWC_OUTP_type/run_SWC_OUTP_5ms_sys/OUTP/outpmodule/VPMM_VCULife2_cnt_Inproc/Signal_Limit" /begin REF_CHARACTERISTIC KOUTP_VCULife2_cnt_maxval KOUTP_VCULife2_cnt_minval /end REF_CHARACTERISTIC /end GROUP
/begin GROUP S585_Signal_Override "SWC_OUTP_type/run_SWC_OUTP_5ms_sys/OUTP/outpmodule/VPMM_VCULife2_cnt_Inproc/Signal_Override" /begin REF_CHARACTERISTIC KOUTP_VCULife2_cnt_ovrdflg KOUTP_VCULife2_cnt_ovrdval /end REF_CHARACTERISTIC /end GROUP
/begin GROUP S586_Signal_Limit "SWC_OUTP_type/run_SWC_OUTP_5ms_sys/OUTP/outpmodule/VPMM_VCUMCUEn_flg_Inproc/Signal_Limit" /begin REF_CHARACTERISTIC KOUTP_VCUMCUEn_flg_maxval KOUTP_VCUMCUEn_flg_minval /end REF_CHARACTERISTIC /end GROUP
/begin GROUP S586_Signal_Override "SWC_OUTP_type/run_SWC_OUTP_5ms_sys/OUTP/outpmodule/VPMM_VCUMCUEn_flg_Inproc/Signal_Override" /begin REF_CHARACTERISTIC KOUTP_VCUMCUEn_flg_ovrdflg KOUTP_VCUMCUEn_flg_ovrdval /end REF_CHARACTERISTIC /end GROUP
/begin GROUP S587_Signal_Limit "SWC_OUTP_type/run_SWC_OUTP_5ms_sys/OUTP/outpmodule/VPMM_VCUMCUFailRst_flg_Inproc/Signal_Limit"
 /begin REF_CHARACTERISTIC KOUTP_VCUMCUFailRst_flg_maxval KOUTP_VCUMCUFailRst_flg_minval /end REF_CHARACTERISTIC
/end GROUP
/begin GROUP S587_Signal_Override "SWC_OUTP_type/run_SWC_OUTP_5ms_sys/OUTP/outpmodule/VPMM_VCUMCUFailRst_flg_Inproc/Signal_Override"
 /begin REF_CHARACTERISTIC KOUTP_VCUMCUFailRst_flg_ovrdflg KOUTP_VCUMCUFailRst_flg_ovrdval /end REF_CHARACTERISTIC
/end GROUP
/begin GROUP S588_Signal_Limit "SWC_OUTP_type/run_SWC_OUTP_5ms_sys/OUTP/outpmodule/VPMM_VSPFunc_enum_Inproc/Signal_Limit" /begin REF_CHARACTERISTIC KOUTP_VSPFunc_enum_maxval KOUTP_VSPFunc_enum_minval /end REF_CHARACTERISTIC /end GROUP
/begin GROUP S588_Signal_Override "SWC_OUTP_type/run_SWC_OUTP_5ms_sys/OUTP/outpmodule/VPMM_VSPFunc_enum_Inproc/Signal_Override" /begin REF_CHARACTERISTIC KOUTP_VSPFunc_enum_ovrdflg KOUTP_VSPFunc_enum_ovrdval /end REF_CHARACTERISTIC /end GROUP
/begin GROUP S589_Signal_Limit "SWC_OUTP_type/run_SWC_OUTP_5ms_sys/OUTP/outpmodule/VPMM_VSPIGNKeySta_enum_Inproc/Signal_Limit"
 /begin REF_CHARACTERISTIC KOUTP_VSPIGNKeySta_enum_maxval KOUTP_VSPIGNKeySta_enum_minval /end REF_CHARACTERISTIC
/end GROUP
/begin GROUP S589_Signal_Override "SWC_OUTP_type/run_SWC_OUTP_5ms_sys/OUTP/outpmodule/VPMM_VSPIGNKeySta_enum_Inproc/Signal_Override"
 /begin REF_CHARACTERISTIC KOUTP_VSPIGNKeySta_enum_ovrdflg KOUTP_VSPIGNKeySta_enum_ovrdval /end REF_CHARACTERISTIC
/end GROUP
/begin GROUP S590_Signal_Limit "SWC_OUTP_type/run_SWC_OUTP_5ms_sys/OUTP/outpmodule/VPMM_VSPReversed_flg_Inproc/Signal_Limit" /begin REF_CHARACTERISTIC KOUTP_VSPReversed_flg_maxval KOUTP_VSPReversed_flg_minval /end REF_CHARACTERISTIC /end GROUP
/begin GROUP S590_Signal_Override "SWC_OUTP_type/run_SWC_OUTP_5ms_sys/OUTP/outpmodule/VPMM_VSPReversed_flg_Inproc/Signal_Override"
 /begin REF_CHARACTERISTIC KOUTP_VSPReversed_flg_ovrdflg KOUTP_VSPReversed_flg_ovrdval /end REF_CHARACTERISTIC
/end GROUP
/begin GROUP S591_Signal_Limit "SWC_OUTP_type/run_SWC_OUTP_5ms_sys/OUTP/outpmodule/VPMM_VSPTurnLeft_enum_Inproc/Signal_Limit"
 /begin REF_CHARACTERISTIC KOUTP_VSPTurnLeft_enum_maxval KOUTP_VSPTurnLeft_enum_minval /end REF_CHARACTERISTIC
/end GROUP
/begin GROUP S591_Signal_Override "SWC_OUTP_type/run_SWC_OUTP_5ms_sys/OUTP/outpmodule/VPMM_VSPTurnLeft_enum_Inproc/Signal_Override"
 /begin REF_CHARACTERISTIC KOUTP_VSPTurnLeft_enum_ovrdflg KOUTP_VSPTurnLeft_enum_ovrdval /end REF_CHARACTERISTIC
/end GROUP
/begin GROUP S592_Signal_Limit "SWC_OUTP_type/run_SWC_OUTP_5ms_sys/OUTP/outpmodule/VPMM_VSPTurnRight_enum_Inproc/Signal_Limit"
 /begin REF_CHARACTERISTIC KOUTP_VSPTurnRight_enum_maxval KOUTP_VSPTurnRight_enum_minval /end REF_CHARACTERISTIC
/end GROUP
/begin GROUP S592_Signal_Override "SWC_OUTP_type/run_SWC_OUTP_5ms_sys/OUTP/outpmodule/VPMM_VSPTurnRight_enum_Inproc/Signal_Override"
 /begin REF_CHARACTERISTIC KOUTP_VSPTurnRight_enum_ovrdflg KOUTP_VSPTurnRight_enum_ovrdval /end REF_CHARACTERISTIC
/end GROUP
/begin GROUP S593_Signal_Limit "SWC_OUTP_type/run_SWC_OUTP_5ms_sys/OUTP/outpmodule/VPSA_EmergencyShutDown_flg_Inproc/Signal_Limit"
 /begin REF_CHARACTERISTIC KOUTP_EmergencyShutDown_flg_maxval KOUTP_EmergencyShutDown_flg_minval /end REF_CHARACTERISTIC
/end GROUP
/begin GROUP S593_Signal_Override "SWC_OUTP_type/run_SWC_OUTP_5ms_sys/OUTP/outpmodule/VPSA_EmergencyShutDown_flg_Inproc/Signal_Override"
 /begin REF_CHARACTERISTIC KOUTP_EmergencyShutDown_flg_ovrdflg KOUTP_EmergencyShutDown_flg_ovrdval /end REF_CHARACTERISTIC
/end GROUP
/begin GROUP S594_Signal_Limit "SWC_OUTP_type/run_SWC_OUTP_5ms_sys/OUTP/outpmodule/VPSA_Keystatus_enum_Inproc/Signal_Limit" /begin REF_CHARACTERISTIC KOUTP_Keystatus_enum_maxval KOUTP_Keystatus_enum_minval /end REF_CHARACTERISTIC /end GROUP
/begin GROUP S594_Signal_Override "SWC_OUTP_type/run_SWC_OUTP_5ms_sys/OUTP/outpmodule/VPSA_Keystatus_enum_Inproc/Signal_Override" /begin REF_CHARACTERISTIC KOUTP_Keystatus_enum_ovrdflg KOUTP_Keystatus_enum_ovrdval /end REF_CHARACTERISTIC /end GROUP
/begin GROUP S595_Signal_Limit "SWC_OUTP_type/run_SWC_OUTP_5ms_sys/OUTP/outpmodule/VSCP_CFGEM1BAMPGN_raw_Inproc/Signal_Limit"
 /begin REF_CHARACTERISTIC KOUTP_CFGEM1BAMPGN_raw_maxval KOUTP_CFGEM1BAMPGN_raw_minval /end REF_CHARACTERISTIC
/end GROUP
/begin GROUP S595_Signal_Override "SWC_OUTP_type/run_SWC_OUTP_5ms_sys/OUTP/outpmodule/VSCP_CFGEM1BAMPGN_raw_Inproc/Signal_Override"
 /begin REF_CHARACTERISTIC KOUTP_CFGEM1BAMPGN_raw_ovrdflg KOUTP_CFGEM1BAMPGN_raw_ovrdval /end REF_CHARACTERISTIC
/end GROUP
/begin GROUP S596_Signal_Limit "SWC_OUTP_type/run_SWC_OUTP_5ms_sys/OUTP/outpmodule/VSCP_CFGEM1BAMRsv_raw_Inproc/Signal_Limit"
 /begin REF_CHARACTERISTIC KOUTP_CFGEM1BAMRsv_raw_maxval KOUTP_CFGEM1BAMRsv_raw_minval /end REF_CHARACTERISTIC
/end GROUP
/begin GROUP S596_Signal_Override "SWC_OUTP_type/run_SWC_OUTP_5ms_sys/OUTP/outpmodule/VSCP_CFGEM1BAMRsv_raw_Inproc/Signal_Override"
 /begin REF_CHARACTERISTIC KOUTP_CFGEM1BAMRsv_raw_ovrdflg KOUTP_CFGEM1BAMRsv_raw_ovrdval /end REF_CHARACTERISTIC
/end GROUP
/begin GROUP S597_Signal_Limit "SWC_OUTP_type/run_SWC_OUTP_5ms_sys/OUTP/outpmodule/VSCP_CFGEM1BAMTNum_raw_Inproc/Signal_Limit"
 /begin REF_CHARACTERISTIC KOUTP_CFGEM1BAMTNum_raw_maxval KOUTP_CFGEM1BAMTNum_raw_minval /end REF_CHARACTERISTIC
/end GROUP
/begin GROUP S597_Signal_Override "SWC_OUTP_type/run_SWC_OUTP_5ms_sys/OUTP/outpmodule/VSCP_CFGEM1BAMTNum_raw_Inproc/Signal_Override"
 /begin REF_CHARACTERISTIC KOUTP_CFGEM1BAMTNum_raw_ovrdflg KOUTP_CFGEM1BAMTNum_raw_ovrdval /end REF_CHARACTERISTIC
/end GROUP
/begin GROUP S598_Signal_Limit "SWC_OUTP_type/run_SWC_OUTP_5ms_sys/OUTP/outpmodule/VSCP_CFGEM1BAMTSize_raw_Inproc/Signal_Limit"
 /begin REF_CHARACTERISTIC KOUTP_CFGEM1BAMTSize_raw_maxval KOUTP_CFGEM1BAMTSize_raw_minval /end REF_CHARACTERISTIC
/end GROUP
/begin GROUP S598_Signal_Override "SWC_OUTP_type/run_SWC_OUTP_5ms_sys/OUTP/outpmodule/VSCP_CFGEM1BAMTSize_raw_Inproc/Signal_Override"
 /begin REF_CHARACTERISTIC KOUTP_CFGEM1BAMTSize_raw_ovrdflg KOUTP_CFGEM1BAMTSize_raw_ovrdval /end REF_CHARACTERISTIC
/end GROUP
/begin GROUP S599_Signal_Limit "SWC_OUTP_type/run_SWC_OUTP_5ms_sys/OUTP/outpmodule/VSCP_CFGEM1Ctrl_raw_Inproc/Signal_Limit" /begin REF_CHARACTERISTIC KOUTP_CFGEM1Ctrl_raw_maxval KOUTP_CFGEM1Ctrl_raw_minval /end REF_CHARACTERISTIC /end GROUP
/begin GROUP S599_Signal_Override "SWC_OUTP_type/run_SWC_OUTP_5ms_sys/OUTP/outpmodule/VSCP_CFGEM1Ctrl_raw_Inproc/Signal_Override" /begin REF_CHARACTERISTIC KOUTP_CFGEM1Ctrl_raw_ovrdflg KOUTP_CFGEM1Ctrl_raw_ovrdval /end REF_CHARACTERISTIC /end GROUP
/begin GROUP S600_Signal_Limit "SWC_OUTP_type/run_SWC_OUTP_5ms_sys/OUTP/outpmodule/VSCP_DTbyte0_raw_Inproc/Signal_Limit" /begin REF_CHARACTERISTIC KOUTP_DTbyte0_raw_maxval KOUTP_DTbyte0_raw_minval /end REF_CHARACTERISTIC /end GROUP
/begin GROUP S600_Signal_Override "SWC_OUTP_type/run_SWC_OUTP_5ms_sys/OUTP/outpmodule/VSCP_DTbyte0_raw_Inproc/Signal_Override" /begin REF_CHARACTERISTIC KOUTP_DTbyte0_raw_ovrdflg KOUTP_DTbyte0_raw_ovrdval /end REF_CHARACTERISTIC /end GROUP
/begin GROUP S601_Signal_Limit "SWC_OUTP_type/run_SWC_OUTP_5ms_sys/OUTP/outpmodule/VSCP_DTbyte1_raw_Inproc/Signal_Limit" /begin REF_CHARACTERISTIC KOUTP_DTbyte1_raw_maxval KOUTP_DTbyte1_raw_minval /end REF_CHARACTERISTIC /end GROUP
/begin GROUP S601_Signal_Override "SWC_OUTP_type/run_SWC_OUTP_5ms_sys/OUTP/outpmodule/VSCP_DTbyte1_raw_Inproc/Signal_Override" /begin REF_CHARACTERISTIC KOUTP_DTbyte1_raw_ovrdflg KOUTP_DTbyte1_raw_ovrdval /end REF_CHARACTERISTIC /end GROUP
/begin GROUP S602_Signal_Limit "SWC_OUTP_type/run_SWC_OUTP_5ms_sys/OUTP/outpmodule/VSCP_DTbyte2_raw_Inproc/Signal_Limit" /begin REF_CHARACTERISTIC KOUTP_DTbyte2_raw_maxval KOUTP_DTbyte2_raw_minval /end REF_CHARACTERISTIC /end GROUP
/begin GROUP S602_Signal_Override "SWC_OUTP_type/run_SWC_OUTP_5ms_sys/OUTP/outpmodule/VSCP_DTbyte2_raw_Inproc/Signal_Override" /begin REF_CHARACTERISTIC KOUTP_DTbyte2_raw_ovrdflg KOUTP_DTbyte2_raw_ovrdval /end REF_CHARACTERISTIC /end GROUP
/begin GROUP S603_Signal_Limit "SWC_OUTP_type/run_SWC_OUTP_5ms_sys/OUTP/outpmodule/VSCP_DTbyte3_raw_Inproc/Signal_Limit" /begin REF_CHARACTERISTIC KOUTP_DTbyte3_raw_maxval KOUTP_DTbyte3_raw_minval /end REF_CHARACTERISTIC /end GROUP
/begin GROUP S603_Signal_Override "SWC_OUTP_type/run_SWC_OUTP_5ms_sys/OUTP/outpmodule/VSCP_DTbyte3_raw_Inproc/Signal_Override" /begin REF_CHARACTERISTIC KOUTP_DTbyte3_raw_ovrdflg KOUTP_DTbyte3_raw_ovrdval /end REF_CHARACTERISTIC /end GROUP
/begin GROUP S604_Signal_Limit "SWC_OUTP_type/run_SWC_OUTP_5ms_sys/OUTP/outpmodule/VSCP_DTbyte4_raw_Inproc/Signal_Limit" /begin REF_CHARACTERISTIC KOUTP_DTbyte4_raw_maxval KOUTP_DTbyte4_raw_minval /end REF_CHARACTERISTIC /end GROUP
/begin GROUP S604_Signal_Override "SWC_OUTP_type/run_SWC_OUTP_5ms_sys/OUTP/outpmodule/VSCP_DTbyte4_raw_Inproc/Signal_Override" /begin REF_CHARACTERISTIC KOUTP_DTbyte4_raw_ovrdflg KOUTP_DTbyte4_raw_ovrdval /end REF_CHARACTERISTIC /end GROUP
/begin GROUP S605_Signal_Limit "SWC_OUTP_type/run_SWC_OUTP_5ms_sys/OUTP/outpmodule/VSCP_DTbyte5_raw_Inproc/Signal_Limit" /begin REF_CHARACTERISTIC KOUTP_DTbyte5_raw_maxval KOUTP_DTbyte5_raw_minval /end REF_CHARACTERISTIC /end GROUP
/begin GROUP S605_Signal_Override "SWC_OUTP_type/run_SWC_OUTP_5ms_sys/OUTP/outpmodule/VSCP_DTbyte5_raw_Inproc/Signal_Override" /begin REF_CHARACTERISTIC KOUTP_DTbyte5_raw_ovrdflg KOUTP_DTbyte5_raw_ovrdval /end REF_CHARACTERISTIC /end GROUP
/begin GROUP S606_Signal_Limit "SWC_OUTP_type/run_SWC_OUTP_5ms_sys/OUTP/outpmodule/VSCP_DTbyte6_raw_Inproc/Signal_Limit" /begin REF_CHARACTERISTIC KOUTP_DTbyte6_raw_maxval KOUTP_DTbyte6_raw_minval /end REF_CHARACTERISTIC /end GROUP
/begin GROUP S606_Signal_Override "SWC_OUTP_type/run_SWC_OUTP_5ms_sys/OUTP/outpmodule/VSCP_DTbyte6_raw_Inproc/Signal_Override" /begin REF_CHARACTERISTIC KOUTP_DTbyte6_raw_ovrdflg KOUTP_DTbyte6_raw_ovrdval /end REF_CHARACTERISTIC /end GROUP
/begin GROUP S607_Signal_Limit "SWC_OUTP_type/run_SWC_OUTP_5ms_sys/OUTP/outpmodule/VSCP_DTbyte7_raw_Inproc/Signal_Limit" /begin REF_CHARACTERISTIC KOUTP_DTbyte7_raw_maxval KOUTP_DTbyte7_raw_minval /end REF_CHARACTERISTIC /end GROUP
/begin GROUP S607_Signal_Override "SWC_OUTP_type/run_SWC_OUTP_5ms_sys/OUTP/outpmodule/VSCP_DTbyte7_raw_Inproc/Signal_Override" /begin REF_CHARACTERISTIC KOUTP_DTbyte7_raw_ovrdflg KOUTP_DTbyte7_raw_ovrdval /end REF_CHARACTERISTIC /end GROUP
/begin GROUP S608_Signal_Limit "SWC_OUTP_type/run_SWC_OUTP_5ms_sys/OUTP/outpmodule/VSCP_triggerBAM_flg_Inproc/Signal_Limit" /begin REF_CHARACTERISTIC KOUTP_triggerBAM_flg_maxval KOUTP_triggerBAM_flg_minval /end REF_CHARACTERISTIC /end GROUP
/begin GROUP S608_Signal_Override "SWC_OUTP_type/run_SWC_OUTP_5ms_sys/OUTP/outpmodule/VSCP_triggerBAM_flg_Inproc/Signal_Override" /begin REF_CHARACTERISTIC KOUTP_triggerBAM_flg_ovrdflg KOUTP_triggerBAM_flg_ovrdval /end REF_CHARACTERISTIC /end GROUP
/begin GROUP S609_Signal_Limit "SWC_OUTP_type/run_SWC_OUTP_5ms_sys/OUTP/outpmodule/VSCP_triggerDT_flg_Inproc/Signal_Limit" /begin REF_CHARACTERISTIC KOUTP_triggerDT_flg_maxval KOUTP_triggerDT_flg_minval /end REF_CHARACTERISTIC /end GROUP
/begin GROUP S609_Signal_Override "SWC_OUTP_type/run_SWC_OUTP_5ms_sys/OUTP/outpmodule/VSCP_triggerDT_flg_Inproc/Signal_Override" /begin REF_CHARACTERISTIC KOUTP_triggerDT_flg_ovrdflg KOUTP_triggerDT_flg_ovrdval /end REF_CHARACTERISTIC /end GROUP
/begin GROUP S610_Signal_Limit "SWC_OUTP_type/run_SWC_OUTP_5ms_sys/OUTP/outpmodule/VSYS_AcoreRebootCmdACK_flg_Inproc/Signal_Limit"
 /begin REF_CHARACTERISTIC KOUTP_AcoreRebootCmdACK_flg_maxval KOUTP_AcoreRebootCmdACK_flg_minval /end REF_CHARACTERISTIC
/end GROUP
/begin GROUP S610_Signal_Override "SWC_OUTP_type/run_SWC_OUTP_5ms_sys/OUTP/outpmodule/VSYS_AcoreRebootCmdACK_flg_Inproc/Signal_Override"
 /begin REF_CHARACTERISTIC KOUTP_AcoreRebootCmdACK_flg_ovrdflg KOUTP_AcoreRebootCmdACK_flg_ovrdval /end REF_CHARACTERISTIC
/end GROUP
/begin GROUP S611_Signal_Limit "SWC_OUTP_type/run_SWC_OUTP_5ms_sys/OUTP/outpmodule/VSYS_CarModel1_cnt_Inproc/Signal_Limit" /begin REF_CHARACTERISTIC KOUTP_CarModel1_cnt_maxval KOUTP_CarModel1_cnt_minval /end REF_CHARACTERISTIC /end GROUP
/begin GROUP S611_Signal_Override "SWC_OUTP_type/run_SWC_OUTP_5ms_sys/OUTP/outpmodule/VSYS_CarModel1_cnt_Inproc/Signal_Override" /begin REF_CHARACTERISTIC KOUTP_CarModel1_cnt_ovrdflg KOUTP_CarModel1_cnt_ovrdval /end REF_CHARACTERISTIC /end GROUP
/begin GROUP S612_Signal_Limit "SWC_OUTP_type/run_SWC_OUTP_5ms_sys/OUTP/outpmodule/VSYS_CarModel2_cnt_Inproc/Signal_Limit" /begin REF_CHARACTERISTIC KOUTP_CarModel2_cnt_maxval KOUTP_CarModel2_cnt_minval /end REF_CHARACTERISTIC /end GROUP
/begin GROUP S612_Signal_Override "SWC_OUTP_type/run_SWC_OUTP_5ms_sys/OUTP/outpmodule/VSYS_CarModel2_cnt_Inproc/Signal_Override" /begin REF_CHARACTERISTIC KOUTP_CarModel2_cnt_ovrdflg KOUTP_CarModel2_cnt_ovrdval /end REF_CHARACTERISTIC /end GROUP
/begin GROUP S613_Signal_Limit "SWC_OUTP_type/run_SWC_OUTP_5ms_sys/OUTP/outpmodule/VSYS_CarModel3_cnt_Inproc/Signal_Limit" /begin REF_CHARACTERISTIC KOUTP_CarModel3_cnt_maxval KOUTP_CarModel3_cnt_minval /end REF_CHARACTERISTIC /end GROUP
/begin GROUP S613_Signal_Override "SWC_OUTP_type/run_SWC_OUTP_5ms_sys/OUTP/outpmodule/VSYS_CarModel3_cnt_Inproc/Signal_Override" /begin REF_CHARACTERISTIC KOUTP_CarModel3_cnt_ovrdflg KOUTP_CarModel3_cnt_ovrdval /end REF_CHARACTERISTIC /end GROUP
/begin GROUP S614_Signal_Limit "SWC_OUTP_type/run_SWC_OUTP_5ms_sys/OUTP/outpmodule/VSYS_Change1_cnt_Inproc/Signal_Limit" /begin REF_CHARACTERISTIC KOUTP_Change1_cnt_maxval KOUTP_Change1_cnt_minval /end REF_CHARACTERISTIC /end GROUP
/begin GROUP S614_Signal_Override "SWC_OUTP_type/run_SWC_OUTP_5ms_sys/OUTP/outpmodule/VSYS_Change1_cnt_Inproc/Signal_Override" /begin REF_CHARACTERISTIC KOUTP_Change1_cnt_ovrdflg KOUTP_Change1_cnt_ovrdval /end REF_CHARACTERISTIC /end GROUP
/begin GROUP S615_Signal_Limit "SWC_OUTP_type/run_SWC_OUTP_5ms_sys/OUTP/outpmodule/VSYS_Change2_cnt_Inproc/Signal_Limit" /begin REF_CHARACTERISTIC KOUTP_Change2_cnt_maxval KOUTP_Change2_cnt_minval /end REF_CHARACTERISTIC /end GROUP
/begin GROUP S615_Signal_Override "SWC_OUTP_type/run_SWC_OUTP_5ms_sys/OUTP/outpmodule/VSYS_Change2_cnt_Inproc/Signal_Override" /begin REF_CHARACTERISTIC KOUTP_Change2_cnt_ovrdflg KOUTP_Change2_cnt_ovrdval /end REF_CHARACTERISTIC /end GROUP
/begin GROUP S616_Signal_Limit "SWC_OUTP_type/run_SWC_OUTP_5ms_sys/OUTP/outpmodule/VSYS_Country1_cnt_Inproc/Signal_Limit" /begin REF_CHARACTERISTIC KOUTP_Country1_cnt_maxval KOUTP_Country1_cnt_minval /end REF_CHARACTERISTIC /end GROUP
/begin GROUP S616_Signal_Override "SWC_OUTP_type/run_SWC_OUTP_5ms_sys/OUTP/outpmodule/VSYS_Country1_cnt_Inproc/Signal_Override" /begin REF_CHARACTERISTIC KOUTP_Country1_cnt_ovrdflg KOUTP_Country1_cnt_ovrdval /end REF_CHARACTERISTIC /end GROUP
/begin GROUP S617_Signal_Limit "SWC_OUTP_type/run_SWC_OUTP_5ms_sys/OUTP/outpmodule/VSYS_Country2_cnt_Inproc/Signal_Limit" /begin REF_CHARACTERISTIC KOUTP_Country2_cnt_maxval KOUTP_Country2_cnt_minval /end REF_CHARACTERISTIC /end GROUP
/begin GROUP S617_Signal_Override "SWC_OUTP_type/run_SWC_OUTP_5ms_sys/OUTP/outpmodule/VSYS_Country2_cnt_Inproc/Signal_Override" /begin REF_CHARACTERISTIC KOUTP_Country2_cnt_ovrdflg KOUTP_Country2_cnt_ovrdval /end REF_CHARACTERISTIC /end GROUP
/begin GROUP S618_Signal_Limit "SWC_OUTP_type/run_SWC_OUTP_5ms_sys/OUTP/outpmodule/VSYS_CurrentNmState_enum_Inproc/Signal_Limit"
 /begin REF_CHARACTERISTIC KOUTP_CurrentNmState_enum_maxval KOUTP_CurrentNmState_enum_minval /end REF_CHARACTERISTIC
/end GROUP
/begin GROUP S618_Signal_Override "SWC_OUTP_type/run_SWC_OUTP_5ms_sys/OUTP/outpmodule/VSYS_CurrentNmState_enum_Inproc/Signal_Override"
 /begin REF_CHARACTERISTIC KOUTP_CurrentNmState_enum_ovrdflg KOUTP_CurrentNmState_enum_ovrdval /end REF_CHARACTERISTIC
/end GROUP
/begin GROUP S619_Signal_Limit "SWC_OUTP_type/run_SWC_OUTP_5ms_sys/OUTP/outpmodule/VSYS_Dash1_cnt_Inproc/Signal_Limit" /begin REF_CHARACTERISTIC KOUTP_Dash1_cnt_maxval KOUTP_Dash1_cnt_minval /end REF_CHARACTERISTIC /end GROUP
/begin GROUP S619_Signal_Override "SWC_OUTP_type/run_SWC_OUTP_5ms_sys/OUTP/outpmodule/VSYS_Dash1_cnt_Inproc/Signal_Override" /begin REF_CHARACTERISTIC KOUTP_Dash1_cnt_ovrdflg KOUTP_Dash1_cnt_ovrdval /end REF_CHARACTERISTIC /end GROUP
/begin GROUP S620_Signal_Limit "SWC_OUTP_type/run_SWC_OUTP_5ms_sys/OUTP/outpmodule/VSYS_Dash2_cnt_Inproc/Signal_Limit" /begin REF_CHARACTERISTIC KOUTP_Dash2_cnt_maxval KOUTP_Dash2_cnt_minval /end REF_CHARACTERISTIC /end GROUP
/begin GROUP S620_Signal_Override "SWC_OUTP_type/run_SWC_OUTP_5ms_sys/OUTP/outpmodule/VSYS_Dash2_cnt_Inproc/Signal_Override" /begin REF_CHARACTERISTIC KOUTP_Dash2_cnt_ovrdflg KOUTP_Dash2_cnt_ovrdval /end REF_CHARACTERISTIC /end GROUP
/begin GROUP S621_Signal_Limit "SWC_OUTP_type/run_SWC_OUTP_5ms_sys/OUTP/outpmodule/VSYS_DrivingMode_cnt_Inproc/Signal_Limit" /begin REF_CHARACTERISTIC KOUTP_DrivingMode_cnt_maxval KOUTP_DrivingMode_cnt_minval /end REF_CHARACTERISTIC /end GROUP
/begin GROUP S621_Signal_Override "SWC_OUTP_type/run_SWC_OUTP_5ms_sys/OUTP/outpmodule/VSYS_DrivingMode_cnt_Inproc/Signal_Override"
 /begin REF_CHARACTERISTIC KOUTP_DrivingMode_cnt_ovrdflg KOUTP_DrivingMode_cnt_ovrdval /end REF_CHARACTERISTIC
/end GROUP
/begin GROUP S622_Signal_Limit "SWC_OUTP_type/run_SWC_OUTP_5ms_sys/OUTP/outpmodule/VSYS_ECU1_cnt_Inproc/Signal_Limit" /begin REF_CHARACTERISTIC KOUTP_ECU1_cnt_maxval KOUTP_ECU1_cnt_minval /end REF_CHARACTERISTIC /end GROUP
/begin GROUP S622_Signal_Override "SWC_OUTP_type/run_SWC_OUTP_5ms_sys/OUTP/outpmodule/VSYS_ECU1_cnt_Inproc/Signal_Override" /begin REF_CHARACTERISTIC KOUTP_ECU1_cnt_ovrdflg KOUTP_ECU1_cnt_ovrdval /end REF_CHARACTERISTIC /end GROUP
/begin GROUP S623_Signal_Limit "SWC_OUTP_type/run_SWC_OUTP_5ms_sys/OUTP/outpmodule/VSYS_ECU2_cnt_Inproc/Signal_Limit" /begin REF_CHARACTERISTIC KOUTP_ECU2_cnt_maxval KOUTP_ECU2_cnt_minval /end REF_CHARACTERISTIC /end GROUP
/begin GROUP S623_Signal_Override "SWC_OUTP_type/run_SWC_OUTP_5ms_sys/OUTP/outpmodule/VSYS_ECU2_cnt_Inproc/Signal_Override" /begin REF_CHARACTERISTIC KOUTP_ECU2_cnt_ovrdflg KOUTP_ECU2_cnt_ovrdval /end REF_CHARACTERISTIC /end GROUP
/begin GROUP S624_Signal_Limit "SWC_OUTP_type/run_SWC_OUTP_5ms_sys/OUTP/outpmodule/VSYS_ECUGen1_cnt_Inproc/Signal_Limit" /begin REF_CHARACTERISTIC KOUTP_ECUGen1_cnt_maxval KOUTP_ECUGen1_cnt_minval /end REF_CHARACTERISTIC /end GROUP
/begin GROUP S624_Signal_Override "SWC_OUTP_type/run_SWC_OUTP_5ms_sys/OUTP/outpmodule/VSYS_ECUGen1_cnt_Inproc/Signal_Override" /begin REF_CHARACTERISTIC KOUTP_ECUGen1_cnt_ovrdflg KOUTP_ECUGen1_cnt_ovrdval /end REF_CHARACTERISTIC /end GROUP
/begin GROUP S625_Signal_Limit "SWC_OUTP_type/run_SWC_OUTP_5ms_sys/OUTP/outpmodule/VSYS_ECUGen2_cnt_Inproc/Signal_Limit" /begin REF_CHARACTERISTIC KOUTP_ECUGen2_cnt_maxval KOUTP_ECUGen2_cnt_minval /end REF_CHARACTERISTIC /end GROUP
/begin GROUP S625_Signal_Override "SWC_OUTP_type/run_SWC_OUTP_5ms_sys/OUTP/outpmodule/VSYS_ECUGen2_cnt_Inproc/Signal_Override" /begin REF_CHARACTERISTIC KOUTP_ECUGen2_cnt_ovrdflg KOUTP_ECUGen2_cnt_ovrdval /end REF_CHARACTERISTIC /end GROUP
/begin GROUP S626_Signal_Limit "SWC_OUTP_type/run_SWC_OUTP_5ms_sys/OUTP/outpmodule/VSYS_FdcSlpReqRisingEdge_flg_Inproc/Signal_Limit"
 /begin REF_CHARACTERISTIC KOUTP_FdcSlpReqRisingEdge_flg_maxval KOUTP_FdcSlpReqRisingEdge_flg_minval /end REF_CHARACTERISTIC
/end GROUP
/begin GROUP S626_Signal_Override "SWC_OUTP_type/run_SWC_OUTP_5ms_sys/OUTP/outpmodule/VSYS_FdcSlpReqRisingEdge_flg_Inproc/Signal_Override"
 /begin REF_CHARACTERISTIC KOUTP_FdcSlpReqRisingEdge_flg_ovrdflg KOUTP_FdcSlpReqRisingEdge_flg_ovrdval /end REF_CHARACTERISTIC
/end GROUP
/begin GROUP S627_Signal_Limit "SWC_OUTP_type/run_SWC_OUTP_5ms_sys/OUTP/outpmodule/VSYS_FdcSlpTime_sec_Inproc/Signal_Limit" /begin REF_CHARACTERISTIC KOUTP_FdcSlpTime_sec_maxval KOUTP_FdcSlpTime_sec_minval /end REF_CHARACTERISTIC /end GROUP
/begin GROUP S627_Signal_Override "SWC_OUTP_type/run_SWC_OUTP_5ms_sys/OUTP/outpmodule/VSYS_FdcSlpTime_sec_Inproc/Signal_Override" /begin REF_CHARACTERISTIC KOUTP_FdcSlpTime_sec_ovrdflg KOUTP_FdcSlpTime_sec_ovrdval /end REF_CHARACTERISTIC /end GROUP
/begin GROUP S628_Signal_Limit "SWC_OUTP_type/run_SWC_OUTP_5ms_sys/OUTP/outpmodule/VSYS_HWVer1_cnt_Inproc/Signal_Limit" /begin REF_CHARACTERISTIC KOUTP_HWVer1_cnt_maxval KOUTP_HWVer1_cnt_minval /end REF_CHARACTERISTIC /end GROUP
/begin GROUP S628_Signal_Override "SWC_OUTP_type/run_SWC_OUTP_5ms_sys/OUTP/outpmodule/VSYS_HWVer1_cnt_Inproc/Signal_Override" /begin REF_CHARACTERISTIC KOUTP_HWVer1_cnt_ovrdflg KOUTP_HWVer1_cnt_ovrdval /end REF_CHARACTERISTIC /end GROUP
/begin GROUP S629_Signal_Limit "SWC_OUTP_type/run_SWC_OUTP_5ms_sys/OUTP/outpmodule/VSYS_HWVer2_cnt_Inproc/Signal_Limit" /begin REF_CHARACTERISTIC KOUTP_HWVer2_cnt_maxval KOUTP_HWVer2_cnt_minval /end REF_CHARACTERISTIC /end GROUP
/begin GROUP S629_Signal_Override "SWC_OUTP_type/run_SWC_OUTP_5ms_sys/OUTP/outpmodule/VSYS_HWVer2_cnt_Inproc/Signal_Override" /begin REF_CHARACTERISTIC KOUTP_HWVer2_cnt_ovrdflg KOUTP_HWVer2_cnt_ovrdval /end REF_CHARACTERISTIC /end GROUP
/begin GROUP S630_Signal_Limit "SWC_OUTP_type/run_SWC_OUTP_5ms_sys/OUTP/outpmodule/VSYS_HWVer3_cnt_Inproc/Signal_Limit" /begin REF_CHARACTERISTIC KOUTP_HWVer3_cnt_maxval KOUTP_HWVer3_cnt_minval /end REF_CHARACTERISTIC /end GROUP
/begin GROUP S630_Signal_Override "SWC_OUTP_type/run_SWC_OUTP_5ms_sys/OUTP/outpmodule/VSYS_HWVer3_cnt_Inproc/Signal_Override" /begin REF_CHARACTERISTIC KOUTP_HWVer3_cnt_ovrdflg KOUTP_HWVer3_cnt_ovrdval /end REF_CHARACTERISTIC /end GROUP
/begin GROUP S631_Signal_Limit "SWC_OUTP_type/run_SWC_OUTP_5ms_sys/OUTP/outpmodule/VSYS_Major1_cnt_Inproc/Signal_Limit" /begin REF_CHARACTERISTIC KOUTP_Major1_cnt_maxval KOUTP_Major1_cnt_minval /end REF_CHARACTERISTIC /end GROUP
/begin GROUP S631_Signal_Override "SWC_OUTP_type/run_SWC_OUTP_5ms_sys/OUTP/outpmodule/VSYS_Major1_cnt_Inproc/Signal_Override" /begin REF_CHARACTERISTIC KOUTP_Major1_cnt_ovrdflg KOUTP_Major1_cnt_ovrdval /end REF_CHARACTERISTIC /end GROUP
/begin GROUP S632_Signal_Limit "SWC_OUTP_type/run_SWC_OUTP_5ms_sys/OUTP/outpmodule/VSYS_Major2_cnt_Inproc/Signal_Limit" /begin REF_CHARACTERISTIC KOUTP_Major2_cnt_maxval KOUTP_Major2_cnt_minval /end REF_CHARACTERISTIC /end GROUP
/begin GROUP S632_Signal_Override "SWC_OUTP_type/run_SWC_OUTP_5ms_sys/OUTP/outpmodule/VSYS_Major2_cnt_Inproc/Signal_Override" /begin REF_CHARACTERISTIC KOUTP_Major2_cnt_ovrdflg KOUTP_Major2_cnt_ovrdval /end REF_CHARACTERISTIC /end GROUP
/begin GROUP S633_Signal_Limit "SWC_OUTP_type/run_SWC_OUTP_5ms_sys/OUTP/outpmodule/VSYS_Minor1_cnt_Inproc/Signal_Limit" /begin REF_CHARACTERISTIC KOUTP_Minor1_cnt_maxval KOUTP_Minor1_cnt_minval /end REF_CHARACTERISTIC /end GROUP
/begin GROUP S633_Signal_Override "SWC_OUTP_type/run_SWC_OUTP_5ms_sys/OUTP/outpmodule/VSYS_Minor1_cnt_Inproc/Signal_Override" /begin REF_CHARACTERISTIC KOUTP_Minor1_cnt_ovrdflg KOUTP_Minor1_cnt_ovrdval /end REF_CHARACTERISTIC /end GROUP
/begin GROUP S634_Signal_Limit "SWC_OUTP_type/run_SWC_OUTP_5ms_sys/OUTP/outpmodule/VSYS_Minor2_cnt_Inproc/Signal_Limit" /begin REF_CHARACTERISTIC KOUTP_Minor2_cnt_maxval KOUTP_Minor2_cnt_minval /end REF_CHARACTERISTIC /end GROUP
/begin GROUP S634_Signal_Override "SWC_OUTP_type/run_SWC_OUTP_5ms_sys/OUTP/outpmodule/VSYS_Minor2_cnt_Inproc/Signal_Override" /begin REF_CHARACTERISTIC KOUTP_Minor2_cnt_ovrdflg KOUTP_Minor2_cnt_ovrdval /end REF_CHARACTERISTIC /end GROUP
/begin GROUP S635_Signal_Limit "SWC_OUTP_type/run_SWC_OUTP_5ms_sys/OUTP/outpmodule/VSYS_ModelYear_cnt_Inproc/Signal_Limit" /begin REF_CHARACTERISTIC KOUTP_ModelYear_cnt_maxval KOUTP_ModelYear_cnt_minval /end REF_CHARACTERISTIC /end GROUP
/begin GROUP S635_Signal_Override "SWC_OUTP_type/run_SWC_OUTP_5ms_sys/OUTP/outpmodule/VSYS_ModelYear_cnt_Inproc/Signal_Override" /begin REF_CHARACTERISTIC KOUTP_ModelYear_cnt_ovrdflg KOUTP_ModelYear_cnt_ovrdval /end REF_CHARACTERISTIC /end GROUP
/begin GROUP S636_Signal_Limit "SWC_OUTP_type/run_SWC_OUTP_5ms_sys/OUTP/outpmodule/VSYS_NvWriteReqRisingEdge_flg_Inproc/Signal_Limit"
 /begin REF_CHARACTERISTIC KOUTP_NvWriteReqRisingEdge_flg_maxval KOUTP_NvWriteReqRisingEdge_flg_minval /end REF_CHARACTERISTIC
/end GROUP
/begin GROUP S636_Signal_Override "SWC_OUTP_type/run_SWC_OUTP_5ms_sys/OUTP/outpmodule/VSYS_NvWriteReqRisingEdge_flg_Inproc/Signal_Override"
 /begin REF_CHARACTERISTIC KOUTP_NvWriteReqRisingEdge_flg_ovrdflg KOUTP_NvWriteReqRisingEdge_flg_ovrdval /end REF_CHARACTERISTIC
/end GROUP
/begin GROUP S637_Signal_Limit "SWC_OUTP_type/run_SWC_OUTP_5ms_sys/OUTP/outpmodule/VSYS_Patch1_cnt_Inproc/Signal_Limit" /begin REF_CHARACTERISTIC KOUTP_Patch1_cnt_maxval KOUTP_Patch1_cnt_minval /end REF_CHARACTERISTIC /end GROUP
/begin GROUP S637_Signal_Override "SWC_OUTP_type/run_SWC_OUTP_5ms_sys/OUTP/outpmodule/VSYS_Patch1_cnt_Inproc/Signal_Override" /begin REF_CHARACTERISTIC KOUTP_Patch1_cnt_ovrdflg KOUTP_Patch1_cnt_ovrdval /end REF_CHARACTERISTIC /end GROUP
/begin GROUP S638_Signal_Limit "SWC_OUTP_type/run_SWC_OUTP_5ms_sys/OUTP/outpmodule/VSYS_Patch2_cnt_Inproc/Signal_Limit" /begin REF_CHARACTERISTIC KOUTP_Patch2_cnt_maxval KOUTP_Patch2_cnt_minval /end REF_CHARACTERISTIC /end GROUP
/begin GROUP S638_Signal_Override "SWC_OUTP_type/run_SWC_OUTP_5ms_sys/OUTP/outpmodule/VSYS_Patch2_cnt_Inproc/Signal_Override" /begin REF_CHARACTERISTIC KOUTP_Patch2_cnt_ovrdflg KOUTP_Patch2_cnt_ovrdval /end REF_CHARACTERISTIC /end GROUP
/begin GROUP S639_Signal_Limit "SWC_OUTP_type/run_SWC_OUTP_5ms_sys/OUTP/outpmodule/VSYS_PmicBootPath_raw32_Inproc/Signal_Limit"
 /begin REF_CHARACTERISTIC KOUTP_PmicBootPath_raw32_maxval KOUTP_PmicBootPath_raw32_minval /end REF_CHARACTERISTIC
/end GROUP
/begin GROUP S639_Signal_Override "SWC_OUTP_type/run_SWC_OUTP_5ms_sys/OUTP/outpmodule/VSYS_PmicBootPath_raw32_Inproc/Signal_Override"
 /begin REF_CHARACTERISTIC KOUTP_PmicBootPath_raw32_ovrdflg KOUTP_PmicBootPath_raw32_ovrdval /end REF_CHARACTERISTIC
/end GROUP
/begin GROUP S640_Signal_Limit "SWC_OUTP_type/run_SWC_OUTP_5ms_sys/OUTP/outpmodule/VSYS_PmicBootReason_enum_Inproc/Signal_Limit"
 /begin REF_CHARACTERISTIC KOUTP_PmicBootReason_enum_maxval KOUTP_PmicBootReason_enum_minval /end REF_CHARACTERISTIC
/end GROUP
/begin GROUP S640_Signal_Override "SWC_OUTP_type/run_SWC_OUTP_5ms_sys/OUTP/outpmodule/VSYS_PmicBootReason_enum_Inproc/Signal_Override"
 /begin REF_CHARACTERISTIC KOUTP_PmicBootReason_enum_ovrdflg KOUTP_PmicBootReason_enum_ovrdval /end REF_CHARACTERISTIC
/end GROUP
/begin GROUP S641_Signal_Limit "SWC_OUTP_type/run_SWC_OUTP_5ms_sys/OUTP/outpmodule/VSYS_SHA1_cnt_Inproc/Signal_Limit" /begin REF_CHARACTERISTIC KOUTP_SHA1_cnt_maxval KOUTP_SHA1_cnt_minval /end REF_CHARACTERISTIC /end GROUP
/begin GROUP S641_Signal_Override "SWC_OUTP_type/run_SWC_OUTP_5ms_sys/OUTP/outpmodule/VSYS_SHA1_cnt_Inproc/Signal_Override" /begin REF_CHARACTERISTIC KOUTP_SHA1_cnt_ovrdflg KOUTP_SHA1_cnt_ovrdval /end REF_CHARACTERISTIC /end GROUP
/begin GROUP S642_Signal_Limit "SWC_OUTP_type/run_SWC_OUTP_5ms_sys/OUTP/outpmodule/VSYS_SHA2_cnt_Inproc/Signal_Limit" /begin REF_CHARACTERISTIC KOUTP_SHA2_cnt_maxval KOUTP_SHA2_cnt_minval /end REF_CHARACTERISTIC /end GROUP
/begin GROUP S642_Signal_Override "SWC_OUTP_type/run_SWC_OUTP_5ms_sys/OUTP/outpmodule/VSYS_SHA2_cnt_Inproc/Signal_Override" /begin REF_CHARACTERISTIC KOUTP_SHA2_cnt_ovrdflg KOUTP_SHA2_cnt_ovrdval /end REF_CHARACTERISTIC /end GROUP
/begin GROUP S643_Signal_Limit "SWC_OUTP_type/run_SWC_OUTP_5ms_sys/OUTP/outpmodule/VSYS_SHA3_cnt_Inproc/Signal_Limit" /begin REF_CHARACTERISTIC KOUTP_SHA3_cnt_maxval KOUTP_SHA3_cnt_minval /end REF_CHARACTERISTIC /end GROUP
/begin GROUP S643_Signal_Override "SWC_OUTP_type/run_SWC_OUTP_5ms_sys/OUTP/outpmodule/VSYS_SHA3_cnt_Inproc/Signal_Override" /begin REF_CHARACTERISTIC KOUTP_SHA3_cnt_ovrdflg KOUTP_SHA3_cnt_ovrdval /end REF_CHARACTERISTIC /end GROUP
/begin GROUP S644_Signal_Limit "SWC_OUTP_type/run_SWC_OUTP_5ms_sys/OUTP/outpmodule/VSYS_SHA4_cnt_Inproc/Signal_Limit" /begin REF_CHARACTERISTIC KOUTP_SHA4_cnt_maxval KOUTP_SHA4_cnt_minval /end REF_CHARACTERISTIC /end GROUP
/begin GROUP S644_Signal_Override "SWC_OUTP_type/run_SWC_OUTP_5ms_sys/OUTP/outpmodule/VSYS_SHA4_cnt_Inproc/Signal_Override" /begin REF_CHARACTERISTIC KOUTP_SHA4_cnt_ovrdflg KOUTP_SHA4_cnt_ovrdval /end REF_CHARACTERISTIC /end GROUP
/begin GROUP S645_Signal_Limit "SWC_OUTP_type/run_SWC_OUTP_5ms_sys/OUTP/outpmodule/VSYS_SHA5_cnt_Inproc/Signal_Limit" /begin REF_CHARACTERISTIC KOUTP_SHA5_cnt_maxval KOUTP_SHA5_cnt_minval /end REF_CHARACTERISTIC /end GROUP
/begin GROUP S645_Signal_Override "SWC_OUTP_type/run_SWC_OUTP_5ms_sys/OUTP/outpmodule/VSYS_SHA5_cnt_Inproc/Signal_Override" /begin REF_CHARACTERISTIC KOUTP_SHA5_cnt_ovrdflg KOUTP_SHA5_cnt_ovrdval /end REF_CHARACTERISTIC /end GROUP
/begin GROUP S646_Signal_Limit "SWC_OUTP_type/run_SWC_OUTP_5ms_sys/OUTP/outpmodule/VSYS_SHA6_cnt_Inproc/Signal_Limit" /begin REF_CHARACTERISTIC KOUTP_SHA6_cnt_maxval KOUTP_SHA6_cnt_minval /end REF_CHARACTERISTIC /end GROUP
/begin GROUP S646_Signal_Override "SWC_OUTP_type/run_SWC_OUTP_5ms_sys/OUTP/outpmodule/VSYS_SHA6_cnt_Inproc/Signal_Override" /begin REF_CHARACTERISTIC KOUTP_SHA6_cnt_ovrdflg KOUTP_SHA6_cnt_ovrdval /end REF_CHARACTERISTIC /end GROUP
/begin GROUP S647_Signal_Limit "SWC_OUTP_type/run_SWC_OUTP_5ms_sys/OUTP/outpmodule/VSYS_SHA7_cnt_Inproc/Signal_Limit" /begin REF_CHARACTERISTIC KOUTP_SHA7_cnt_maxval KOUTP_SHA7_cnt_minval /end REF_CHARACTERISTIC /end GROUP
/begin GROUP S647_Signal_Override "SWC_OUTP_type/run_SWC_OUTP_5ms_sys/OUTP/outpmodule/VSYS_SHA7_cnt_Inproc/Signal_Override" /begin REF_CHARACTERISTIC KOUTP_SHA7_cnt_ovrdflg KOUTP_SHA7_cnt_ovrdval /end REF_CHARACTERISTIC /end GROUP
/begin GROUP S648_Signal_Limit "SWC_OUTP_type/run_SWC_OUTP_5ms_sys/OUTP/outpmodule/VSYS_SHA8_cnt_Inproc/Signal_Limit" /begin REF_CHARACTERISTIC KOUTP_SHA8_cnt_maxval KOUTP_SHA8_cnt_minval /end REF_CHARACTERISTIC /end GROUP
/begin GROUP S648_Signal_Override "SWC_OUTP_type/run_SWC_OUTP_5ms_sys/OUTP/outpmodule/VSYS_SHA8_cnt_Inproc/Signal_Override" /begin REF_CHARACTERISTIC KOUTP_SHA8_cnt_ovrdflg KOUTP_SHA8_cnt_ovrdval /end REF_CHARACTERISTIC /end GROUP
/begin GROUP S649_Signal_Limit "SWC_OUTP_type/run_SWC_OUTP_5ms_sys/OUTP/outpmodule/VSYS_Variation_cnt_Inproc/Signal_Limit" /begin REF_CHARACTERISTIC KOUTP_Variation_cnt_maxval KOUTP_Variation_cnt_minval /end REF_CHARACTERISTIC /end GROUP
/begin GROUP S649_Signal_Override "SWC_OUTP_type/run_SWC_OUTP_5ms_sys/OUTP/outpmodule/VSYS_Variation_cnt_Inproc/Signal_Override" /begin REF_CHARACTERISTIC KOUTP_Variation_cnt_ovrdflg KOUTP_Variation_cnt_ovrdval /end REF_CHARACTERISTIC /end GROUP
/begin GROUP S650_Signal_Limit "SWC_OUTP_type/run_SWC_OUTP_5ms_sys/OUTP/outpmodule/VSYS_WisrBootReason_raw32_Inproc/Signal_Limit"
 /begin REF_CHARACTERISTIC KOUTP_WisrBootReason_raw32_maxval KOUTP_WisrBootReason_raw32_minval /end REF_CHARACTERISTIC
/end GROUP
/begin GROUP S650_Signal_Override "SWC_OUTP_type/run_SWC_OUTP_5ms_sys/OUTP/outpmodule/VSYS_WisrBootReason_raw32_Inproc/Signal_Override"
 /begin REF_CHARACTERISTIC KOUTP_WisrBootReason_raw32_ovrdflg KOUTP_WisrBootReason_raw32_ovrdval /end REF_CHARACTERISTIC
/end GROUP
/begin GROUP S651_Signal_Limit "SWC_OUTP_type/run_SWC_OUTP_5ms_sys/OUTP/outpmodule/VTHC_AfterrunningMode_flg_Inproc/Signal_Limit"
 /begin REF_CHARACTERISTIC KOUTP_AfterrunningMode_flg_maxval KOUTP_AfterrunningMode_flg_minval /end REF_CHARACTERISTIC
/end GROUP
/begin GROUP S651_Signal_Override "SWC_OUTP_type/run_SWC_OUTP_5ms_sys/OUTP/outpmodule/VTHC_AfterrunningMode_flg_Inproc/Signal_Override"
 /begin REF_CHARACTERISTIC KOUTP_AfterrunningMode_flg_ovrdflg KOUTP_AfterrunningMode_flg_ovrdval /end REF_CHARACTERISTIC
/end GROUP
/begin GROUP S652_Signal_Limit "SWC_OUTP_type/run_SWC_OUTP_5ms_sys/OUTP/outpmodule/VTHC_CoolFanReq_pct_Inproc/Signal_Limit" /begin REF_CHARACTERISTIC KOUTP_CoolFanReq_pct_maxval KOUTP_CoolFanReq_pct_minval /end REF_CHARACTERISTIC /end GROUP
/begin GROUP S652_Signal_Override "SWC_OUTP_type/run_SWC_OUTP_5ms_sys/OUTP/outpmodule/VTHC_CoolFanReq_pct_Inproc/Signal_Override" /begin REF_CHARACTERISTIC KOUTP_CoolFanReq_pct_ovrdflg KOUTP_CoolFanReq_pct_ovrdval /end REF_CHARACTERISTIC /end GROUP
/begin GROUP S653_Signal_Limit "SWC_OUTP_type/run_SWC_OUTP_5ms_sys/OUTP/outpmodule/VTHC_EWPPEReq_rpm_Inproc/Signal_Limit" /begin REF_CHARACTERISTIC KOUTP_EWPPEReq_rpm_maxval KOUTP_EWPPEReq_rpm_minval /end REF_CHARACTERISTIC /end GROUP
/begin GROUP S653_Signal_Override "SWC_OUTP_type/run_SWC_OUTP_5ms_sys/OUTP/outpmodule/VTHC_EWPPEReq_rpm_Inproc/Signal_Override" /begin REF_CHARACTERISTIC KOUTP_EWPPEReq_rpm_ovrdflg KOUTP_EWPPEReq_rpm_ovrdval /end REF_CHARACTERISTIC /end GROUP
/begin GROUP S654_Signal_Limit "SWC_OUTP_type/run_SWC_OUTP_5ms_sys/OUTP/outpmodule/VTPM_ALFin_flg_Inproc/Signal_Limit" /begin REF_CHARACTERISTIC KOUTP_ALFin_flg_maxval KOUTP_ALFin_flg_minval /end REF_CHARACTERISTIC /end GROUP
/begin GROUP S654_Signal_Override "SWC_OUTP_type/run_SWC_OUTP_5ms_sys/OUTP/outpmodule/VTPM_ALFin_flg_Inproc/Signal_Override" /begin REF_CHARACTERISTIC KOUTP_ALFin_flg_ovrdflg KOUTP_ALFin_flg_ovrdval /end REF_CHARACTERISTIC /end GROUP
/begin GROUP S655_Signal_Limit "SWC_OUTP_type/run_SWC_OUTP_5ms_sys/OUTP/outpmodule/VTPM_AutoLTips_enum_Inproc/Signal_Limit" /begin REF_CHARACTERISTIC KOUTP_AutoLTips_enum_maxval KOUTP_AutoLTips_enum_minval /end REF_CHARACTERISTIC /end GROUP
/begin GROUP S655_Signal_Override "SWC_OUTP_type/run_SWC_OUTP_5ms_sys/OUTP/outpmodule/VTPM_AutoLTips_enum_Inproc/Signal_Override" /begin REF_CHARACTERISTIC KOUTP_AutoLTips_enum_ovrdflg KOUTP_AutoLTips_enum_ovrdval /end REF_CHARACTERISTIC /end GROUP
/begin GROUP S656_Signal_Limit "SWC_OUTP_type/run_SWC_OUTP_5ms_sys/OUTP/outpmodule/VTPM_CWheelTips_enum_Inproc/Signal_Limit" /begin REF_CHARACTERISTIC KOUTP_CWheelTips_enum_maxval KOUTP_CWheelTips_enum_minval /end REF_CHARACTERISTIC /end GROUP
/begin GROUP S656_Signal_Override "SWC_OUTP_type/run_SWC_OUTP_5ms_sys/OUTP/outpmodule/VTPM_CWheelTips_enum_Inproc/Signal_Override"
 /begin REF_CHARACTERISTIC KOUTP_CWheelTips_enum_ovrdflg KOUTP_CWheelTips_enum_ovrdval /end REF_CHARACTERISTIC
/end GROUP
/begin GROUP S657_Signal_Limit "SWC_OUTP_type/run_SWC_OUTP_5ms_sys/OUTP/outpmodule/VTPM_ChkStorge_flg_Inproc/Signal_Limit" /begin REF_CHARACTERISTIC KOUTP_ChkStorge_flg_maxval KOUTP_ChkStorge_flg_minval /end REF_CHARACTERISTIC /end GROUP
/begin GROUP S657_Signal_Override "SWC_OUTP_type/run_SWC_OUTP_5ms_sys/OUTP/outpmodule/VTPM_ChkStorge_flg_Inproc/Signal_Override" /begin REF_CHARACTERISTIC KOUTP_ChkStorge_flg_ovrdflg KOUTP_ChkStorge_flg_ovrdval /end REF_CHARACTERISTIC /end GROUP
/begin GROUP S658_Signal_Limit "SWC_OUTP_type/run_SWC_OUTP_5ms_sys/OUTP/outpmodule/VTPM_Chkfin_flg_Inproc/Signal_Limit" /begin REF_CHARACTERISTIC KOUTP_Chkfin_flg_maxval KOUTP_Chkfin_flg_minval /end REF_CHARACTERISTIC /end GROUP
/begin GROUP S658_Signal_Override "SWC_OUTP_type/run_SWC_OUTP_5ms_sys/OUTP/outpmodule/VTPM_Chkfin_flg_Inproc/Signal_Override" /begin REF_CHARACTERISTIC KOUTP_Chkfin_flg_ovrdflg KOUTP_Chkfin_flg_ovrdval /end REF_CHARACTERISTIC /end GROUP
/begin GROUP S659_Signal_Limit "SWC_OUTP_type/run_SWC_OUTP_5ms_sys/OUTP/outpmodule/VTPM_FAT_flg_Inproc/Signal_Limit" /begin REF_CHARACTERISTIC KOUTP_FAT_flg_maxval KOUTP_FAT_flg_minval /end REF_CHARACTERISTIC /end GROUP
/begin GROUP S659_Signal_Override "SWC_OUTP_type/run_SWC_OUTP_5ms_sys/OUTP/outpmodule/VTPM_FAT_flg_Inproc/Signal_Override" /begin REF_CHARACTERISTIC KOUTP_FAT_flg_ovrdflg KOUTP_FAT_flg_ovrdval /end REF_CHARACTERISTIC /end GROUP
/begin GROUP S660_Signal_Limit "SWC_OUTP_type/run_SWC_OUTP_5ms_sys/OUTP/outpmodule/VTPM_FlashIDvalid_enum_Inproc/Signal_Limit"
 /begin REF_CHARACTERISTIC KOUTP_FlashIDvalid_enum_maxval KOUTP_FlashIDvalid_enum_minval /end REF_CHARACTERISTIC
/end GROUP
/begin GROUP S660_Signal_Override "SWC_OUTP_type/run_SWC_OUTP_5ms_sys/OUTP/outpmodule/VTPM_FlashIDvalid_enum_Inproc/Signal_Override"
 /begin REF_CHARACTERISTIC KOUTP_FlashIDvalid_enum_ovrdflg KOUTP_FlashIDvalid_enum_ovrdval /end REF_CHARACTERISTIC
/end GROUP
/begin GROUP S661_Signal_Limit "SWC_OUTP_type/run_SWC_OUTP_5ms_sys/OUTP/outpmodule/VTPM_FlashS1ID_raw_Inproc/Signal_Limit" /begin REF_CHARACTERISTIC KOUTP_FlashS1ID_raw_maxval KOUTP_FlashS1ID_raw_minval /end REF_CHARACTERISTIC /end GROUP
/begin GROUP S661_Signal_Override "SWC_OUTP_type/run_SWC_OUTP_5ms_sys/OUTP/outpmodule/VTPM_FlashS1ID_raw_Inproc/Signal_Override" /begin REF_CHARACTERISTIC KOUTP_FlashS1ID_raw_ovrdflg KOUTP_FlashS1ID_raw_ovrdval /end REF_CHARACTERISTIC /end GROUP
/begin GROUP S662_Signal_Limit "SWC_OUTP_type/run_SWC_OUTP_5ms_sys/OUTP/outpmodule/VTPM_FlashS2ID_raw_Inproc/Signal_Limit" /begin REF_CHARACTERISTIC KOUTP_FlashS2ID_raw_maxval KOUTP_FlashS2ID_raw_minval /end REF_CHARACTERISTIC /end GROUP
/begin GROUP S662_Signal_Override "SWC_OUTP_type/run_SWC_OUTP_5ms_sys/OUTP/outpmodule/VTPM_FlashS2ID_raw_Inproc/Signal_Override" /begin REF_CHARACTERISTIC KOUTP_FlashS2ID_raw_ovrdflg KOUTP_FlashS2ID_raw_ovrdval /end REF_CHARACTERISTIC /end GROUP
/begin GROUP S663_Signal_Limit "SWC_OUTP_type/run_SWC_OUTP_5ms_sys/OUTP/outpmodule/VTPM_FlashS3ID_raw_Inproc/Signal_Limit" /begin REF_CHARACTERISTIC KOUTP_FlashS3ID_raw_maxval KOUTP_FlashS3ID_raw_minval /end REF_CHARACTERISTIC /end GROUP
/begin GROUP S663_Signal_Override "SWC_OUTP_type/run_SWC_OUTP_5ms_sys/OUTP/outpmodule/VTPM_FlashS3ID_raw_Inproc/Signal_Override" /begin REF_CHARACTERISTIC KOUTP_FlashS3ID_raw_ovrdflg KOUTP_FlashS3ID_raw_ovrdval /end REF_CHARACTERISTIC /end GROUP
/begin GROUP S664_Signal_Limit "SWC_OUTP_type/run_SWC_OUTP_5ms_sys/OUTP/outpmodule/VTPM_FlashS4ID_raw_Inproc/Signal_Limit" /begin REF_CHARACTERISTIC KOUTP_FlashS4ID_raw_maxval KOUTP_FlashS4ID_raw_minval /end REF_CHARACTERISTIC /end GROUP
/begin GROUP S664_Signal_Override "SWC_OUTP_type/run_SWC_OUTP_5ms_sys/OUTP/outpmodule/VTPM_FlashS4ID_raw_Inproc/Signal_Override" /begin REF_CHARACTERISTIC KOUTP_FlashS4ID_raw_ovrdflg KOUTP_FlashS4ID_raw_ovrdval /end REF_CHARACTERISTIC /end GROUP
/begin GROUP S665_Signal_Limit "SWC_OUTP_type/run_SWC_OUTP_5ms_sys/OUTP/outpmodule/VTPM_Flashchkdatavalid_enum_Inproc/Signal_Limit"
 /begin REF_CHARACTERISTIC KOUTP_Flashchkdatavalid_enum_maxval KOUTP_Flashchkdatavalid_enum_minval /end REF_CHARACTERISTIC
/end GROUP
/begin GROUP S665_Signal_Override "SWC_OUTP_type/run_SWC_OUTP_5ms_sys/OUTP/outpmodule/VTPM_Flashchkdatavalid_enum_Inproc/Signal_Override"
 /begin REF_CHARACTERISTIC KOUTP_Flashchkdatavalid_enum_ovrdflg KOUTP_Flashchkdatavalid_enum_ovrdval /end REF_CHARACTERISTIC
/end GROUP
/begin GROUP S666_Signal_Limit "SWC_OUTP_type/run_SWC_OUTP_5ms_sys/OUTP/outpmodule/VTPM_Flashdatavalid_enum_Inproc/Signal_Limit"
 /begin REF_CHARACTERISTIC KOUTP_Flashdatavalid_enum_maxval KOUTP_Flashdatavalid_enum_minval /end REF_CHARACTERISTIC
/end GROUP
/begin GROUP S666_Signal_Override "SWC_OUTP_type/run_SWC_OUTP_5ms_sys/OUTP/outpmodule/VTPM_Flashdatavalid_enum_Inproc/Signal_Override"
 /begin REF_CHARACTERISTIC KOUTP_Flashdatavalid_enum_ovrdflg KOUTP_Flashdatavalid_enum_ovrdval /end REF_CHARACTERISTIC
/end GROUP
/begin GROUP S667_Signal_Limit "SWC_OUTP_type/run_SWC_OUTP_5ms_sys/OUTP/outpmodule/VTPM_ID1messageALTU_raw8_Inproc/Signal_Limit"
 /begin REF_CHARACTERISTIC KOUTP_ID1messageALTU_raw8_maxval KOUTP_ID1messageALTU_raw8_minval /end REF_CHARACTERISTIC
/end GROUP
/begin GROUP S667_Signal_Override "SWC_OUTP_type/run_SWC_OUTP_5ms_sys/OUTP/outpmodule/VTPM_ID1messageALTU_raw8_Inproc/Signal_Override"
 /begin REF_CHARACTERISTIC KOUTP_ID1messageALTU_raw8_ovrdflg KOUTP_ID1messageALTU_raw8_ovrdval /end REF_CHARACTERISTIC
/end GROUP
/begin GROUP S668_Signal_Limit "SWC_OUTP_type/run_SWC_OUTP_5ms_sys/OUTP/outpmodule/VTPM_ID2messageALTU_raw8_Inproc/Signal_Limit"
 /begin REF_CHARACTERISTIC KOUTP_ID2messageALTU_raw8_maxval KOUTP_ID2messageALTU_raw8_minval /end REF_CHARACTERISTIC
/end GROUP
/begin GROUP S668_Signal_Override "SWC_OUTP_type/run_SWC_OUTP_5ms_sys/OUTP/outpmodule/VTPM_ID2messageALTU_raw8_Inproc/Signal_Override"
 /begin REF_CHARACTERISTIC KOUTP_ID2messageALTU_raw8_ovrdflg KOUTP_ID2messageALTU_raw8_ovrdval /end REF_CHARACTERISTIC
/end GROUP
/begin GROUP S669_Signal_Limit "SWC_OUTP_type/run_SWC_OUTP_5ms_sys/OUTP/outpmodule/VTPM_ID3messageALTU_raw8_Inproc/Signal_Limit"
 /begin REF_CHARACTERISTIC KOUTP_ID3messageALTU_raw8_maxval KOUTP_ID3messageALTU_raw8_minval /end REF_CHARACTERISTIC
/end GROUP
/begin GROUP S669_Signal_Override "SWC_OUTP_type/run_SWC_OUTP_5ms_sys/OUTP/outpmodule/VTPM_ID3messageALTU_raw8_Inproc/Signal_Override"
 /begin REF_CHARACTERISTIC KOUTP_ID3messageALTU_raw8_ovrdflg KOUTP_ID3messageALTU_raw8_ovrdval /end REF_CHARACTERISTIC
/end GROUP
/begin GROUP S670_Signal_Limit "SWC_OUTP_type/run_SWC_OUTP_5ms_sys/OUTP/outpmodule/VTPM_ID4messageALTU_raw8_Inproc/Signal_Limit"
 /begin REF_CHARACTERISTIC KOUTP_ID4messageALTU_raw8_maxval KOUTP_ID4messageALTU_raw8_minval /end REF_CHARACTERISTIC
/end GROUP
/begin GROUP S670_Signal_Override "SWC_OUTP_type/run_SWC_OUTP_5ms_sys/OUTP/outpmodule/VTPM_ID4messageALTU_raw8_Inproc/Signal_Override"
 /begin REF_CHARACTERISTIC KOUTP_ID4messageALTU_raw8_ovrdflg KOUTP_ID4messageALTU_raw8_ovrdval /end REF_CHARACTERISTIC
/end GROUP
/begin GROUP S671_Signal_Limit "SWC_OUTP_type/run_SWC_OUTP_5ms_sys/OUTP/outpmodule/VTPM_IDin_raw32_Inproc/Signal_Limit" /begin REF_CHARACTERISTIC KOUTP_IDin_raw32_maxval KOUTP_IDin_raw32_minval /end REF_CHARACTERISTIC /end GROUP
/begin GROUP S671_Signal_Override "SWC_OUTP_type/run_SWC_OUTP_5ms_sys/OUTP/outpmodule/VTPM_IDin_raw32_Inproc/Signal_Override" /begin REF_CHARACTERISTIC KOUTP_IDin_raw32_ovrdflg KOUTP_IDin_raw32_ovrdval /end REF_CHARACTERISTIC /end GROUP
/begin GROUP S672_Signal_Limit "SWC_OUTP_type/run_SWC_OUTP_5ms_sys/OUTP/outpmodule/VTPM_LFBatWarn_flg_Inproc/Signal_Limit" /begin REF_CHARACTERISTIC KOUTP_LFBatWarn_flg_maxval KOUTP_LFBatWarn_flg_minval /end REF_CHARACTERISTIC /end GROUP
/begin GROUP S672_Signal_Override "SWC_OUTP_type/run_SWC_OUTP_5ms_sys/OUTP/outpmodule/VTPM_LFBatWarn_flg_Inproc/Signal_Override" /begin REF_CHARACTERISTIC KOUTP_LFBatWarn_flg_ovrdflg KOUTP_LFBatWarn_flg_ovrdval /end REF_CHARACTERISTIC /end GROUP
/begin GROUP S673_Signal_Limit "SWC_OUTP_type/run_SWC_OUTP_5ms_sys/OUTP/outpmodule/VTPM_LFP20_raw8_Inproc/Signal_Limit" /begin REF_CHARACTERISTIC KOUTP_LFP20_raw8_maxval KOUTP_LFP20_raw8_minval /end REF_CHARACTERISTIC /end GROUP
/begin GROUP S673_Signal_Override "SWC_OUTP_type/run_SWC_OUTP_5ms_sys/OUTP/outpmodule/VTPM_LFP20_raw8_Inproc/Signal_Override" /begin REF_CHARACTERISTIC KOUTP_LFP20_raw8_ovrdflg KOUTP_LFP20_raw8_ovrdval /end REF_CHARACTERISTIC /end GROUP
/begin GROUP S674_Signal_Limit "SWC_OUTP_type/run_SWC_OUTP_5ms_sys/OUTP/outpmodule/VTPM_LFPindi_enum_Inproc/Signal_Limit" /begin REF_CHARACTERISTIC KOUTP_LFPindi_enum_maxval KOUTP_LFPindi_enum_minval /end REF_CHARACTERISTIC /end GROUP
/begin GROUP S674_Signal_Override "SWC_OUTP_type/run_SWC_OUTP_5ms_sys/OUTP/outpmodule/VTPM_LFPindi_enum_Inproc/Signal_Override" /begin REF_CHARACTERISTIC KOUTP_LFPindi_enum_ovrdflg KOUTP_LFPindi_enum_ovrdval /end REF_CHARACTERISTIC /end GROUP
/begin GROUP S675_Signal_Limit "SWC_OUTP_type/run_SWC_OUTP_5ms_sys/OUTP/outpmodule/VTPM_LFPressIndi_enum_Inproc/Signal_Limit"
 /begin REF_CHARACTERISTIC KOUTP_LFPressIndi_enum_maxval KOUTP_LFPressIndi_enum_minval /end REF_CHARACTERISTIC
/end GROUP
/begin GROUP S675_Signal_Override "SWC_OUTP_type/run_SWC_OUTP_5ms_sys/OUTP/outpmodule/VTPM_LFPressIndi_enum_Inproc/Signal_Override"
 /begin REF_CHARACTERISTIC KOUTP_LFPressIndi_enum_ovrdflg KOUTP_LFPressIndi_enum_ovrdval /end REF_CHARACTERISTIC
/end GROUP
/begin GROUP S676_Signal_Limit "SWC_OUTP_type/run_SWC_OUTP_5ms_sys/OUTP/outpmodule/VTPM_LFSensorFail_flg_Inproc/Signal_Limit"
 /begin REF_CHARACTERISTIC KOUTP_LFSensorFail_flg_maxval KOUTP_LFSensorFail_flg_minval /end REF_CHARACTERISTIC
/end GROUP
/begin GROUP S676_Signal_Override "SWC_OUTP_type/run_SWC_OUTP_5ms_sys/OUTP/outpmodule/VTPM_LFSensorFail_flg_Inproc/Signal_Override"
 /begin REF_CHARACTERISTIC KOUTP_LFSensorFail_flg_ovrdflg KOUTP_LFSensorFail_flg_ovrdval /end REF_CHARACTERISTIC
/end GROUP
/begin GROUP S677_Signal_Limit "SWC_OUTP_type/run_SWC_OUTP_5ms_sys/OUTP/outpmodule/VTPM_LFSensorMode_flg_Inproc/Signal_Limit"
 /begin REF_CHARACTERISTIC KOUTP_LFSensorMode_flg_maxval KOUTP_LFSensorMode_flg_minval /end REF_CHARACTERISTIC
/end GROUP
/begin GROUP S677_Signal_Override "SWC_OUTP_type/run_SWC_OUTP_5ms_sys/OUTP/outpmodule/VTPM_LFSensorMode_flg_Inproc/Signal_Override"
 /begin REF_CHARACTERISTIC KOUTP_LFSensorMode_flg_ovrdflg KOUTP_LFSensorMode_flg_ovrdval /end REF_CHARACTERISTIC
/end GROUP
/begin GROUP S678_Signal_Limit "SWC_OUTP_type/run_SWC_OUTP_5ms_sys/OUTP/outpmodule/VTPM_LFWheelDebug_flg_Inproc/Signal_Limit"
 /begin REF_CHARACTERISTIC KOUTP_LFWheelDebug_flg_maxval KOUTP_LFWheelDebug_flg_minval /end REF_CHARACTERISTIC
/end GROUP
/begin GROUP S678_Signal_Override "SWC_OUTP_type/run_SWC_OUTP_5ms_sys/OUTP/outpmodule/VTPM_LFWheelDebug_flg_Inproc/Signal_Override"
 /begin REF_CHARACTERISTIC KOUTP_LFWheelDebug_flg_ovrdflg KOUTP_LFWheelDebug_flg_ovrdval /end REF_CHARACTERISTIC
/end GROUP
/begin GROUP S679_Signal_Limit "SWC_OUTP_type/run_SWC_OUTP_5ms_sys/OUTP/outpmodule/VTPM_LFWheelPSW_raw8_Inproc/Signal_Limit" /begin REF_CHARACTERISTIC KOUTP_LFWheelPSW_raw8_maxval KOUTP_LFWheelPSW_raw8_minval /end REF_CHARACTERISTIC /end GROUP
/begin GROUP S679_Signal_Override "SWC_OUTP_type/run_SWC_OUTP_5ms_sys/OUTP/outpmodule/VTPM_LFWheelPSW_raw8_Inproc/Signal_Override"
 /begin REF_CHARACTERISTIC KOUTP_LFWheelPSW_raw8_ovrdflg KOUTP_LFWheelPSW_raw8_ovrdval /end REF_CHARACTERISTIC
/end GROUP
/begin GROUP S680_Signal_Limit "SWC_OUTP_type/run_SWC_OUTP_5ms_sys/OUTP/outpmodule/VTPM_LFWheelPress_raw8_Inproc/Signal_Limit"
 /begin REF_CHARACTERISTIC KOUTP_LFWheelPress_raw8_maxval KOUTP_LFWheelPress_raw8_minval /end REF_CHARACTERISTIC
/end GROUP
/begin GROUP S680_Signal_Override "SWC_OUTP_type/run_SWC_OUTP_5ms_sys/OUTP/outpmodule/VTPM_LFWheelPress_raw8_Inproc/Signal_Override"
 /begin REF_CHARACTERISTIC KOUTP_LFWheelPress_raw8_ovrdflg KOUTP_LFWheelPress_raw8_ovrdval /end REF_CHARACTERISTIC
/end GROUP
/begin GROUP S681_Signal_Limit "SWC_OUTP_type/run_SWC_OUTP_5ms_sys/OUTP/outpmodule/VTPM_LFWheelTemp_C_Inproc/Signal_Limit" /begin REF_CHARACTERISTIC KOUTP_LFWheelTemp_C_maxval KOUTP_LFWheelTemp_C_minval /end REF_CHARACTERISTIC /end GROUP
/begin GROUP S681_Signal_Override "SWC_OUTP_type/run_SWC_OUTP_5ms_sys/OUTP/outpmodule/VTPM_LFWheelTemp_C_Inproc/Signal_Override" /begin REF_CHARACTERISTIC KOUTP_LFWheelTemp_C_ovrdflg KOUTP_LFWheelTemp_C_ovrdval /end REF_CHARACTERISTIC /end GROUP
/begin GROUP S682_Signal_Limit "SWC_OUTP_type/run_SWC_OUTP_5ms_sys/OUTP/outpmodule/VTPM_LFWheelTmpIndi_flg_Inproc/Signal_Limit"
 /begin REF_CHARACTERISTIC KOUTP_LFWheelTmpIndi_flg_maxval KOUTP_LFWheelTmpIndi_flg_minval /end REF_CHARACTERISTIC
/end GROUP
/begin GROUP S682_Signal_Override "SWC_OUTP_type/run_SWC_OUTP_5ms_sys/OUTP/outpmodule/VTPM_LFWheelTmpIndi_flg_Inproc/Signal_Override"
 /begin REF_CHARACTERISTIC KOUTP_LFWheelTmpIndi_flg_ovrdflg KOUTP_LFWheelTmpIndi_flg_ovrdval /end REF_CHARACTERISTIC
/end GROUP
/begin GROUP S683_Signal_Limit "SWC_OUTP_type/run_SWC_OUTP_5ms_sys/OUTP/outpmodule/VTPM_LProgress_enum_Inproc/Signal_Limit" /begin REF_CHARACTERISTIC KOUTP_LProgress_enum_maxval KOUTP_LProgress_enum_minval /end REF_CHARACTERISTIC /end GROUP
/begin GROUP S683_Signal_Override "SWC_OUTP_type/run_SWC_OUTP_5ms_sys/OUTP/outpmodule/VTPM_LProgress_enum_Inproc/Signal_Override" /begin REF_CHARACTERISTIC KOUTP_LProgress_enum_ovrdflg KOUTP_LProgress_enum_ovrdval /end REF_CHARACTERISTIC /end GROUP
/begin GROUP S684_Signal_Limit "SWC_OUTP_type/run_SWC_OUTP_5ms_sys/OUTP/outpmodule/VTPM_LRBatWarn_flg_Inproc/Signal_Limit" /begin REF_CHARACTERISTIC KOUTP_LRBatWarn_flg_maxval KOUTP_LRBatWarn_flg_minval /end REF_CHARACTERISTIC /end GROUP
/begin GROUP S684_Signal_Override "SWC_OUTP_type/run_SWC_OUTP_5ms_sys/OUTP/outpmodule/VTPM_LRBatWarn_flg_Inproc/Signal_Override" /begin REF_CHARACTERISTIC KOUTP_LRBatWarn_flg_ovrdflg KOUTP_LRBatWarn_flg_ovrdval /end REF_CHARACTERISTIC /end GROUP
/begin GROUP S685_Signal_Limit "SWC_OUTP_type/run_SWC_OUTP_5ms_sys/OUTP/outpmodule/VTPM_LRP20_raw8_Inproc/Signal_Limit" /begin REF_CHARACTERISTIC KOUTP_LRP20_raw8_maxval KOUTP_LRP20_raw8_minval /end REF_CHARACTERISTIC /end GROUP
/begin GROUP S685_Signal_Override "SWC_OUTP_type/run_SWC_OUTP_5ms_sys/OUTP/outpmodule/VTPM_LRP20_raw8_Inproc/Signal_Override" /begin REF_CHARACTERISTIC KOUTP_LRP20_raw8_ovrdflg KOUTP_LRP20_raw8_ovrdval /end REF_CHARACTERISTIC /end GROUP
/begin GROUP S686_Signal_Limit "SWC_OUTP_type/run_SWC_OUTP_5ms_sys/OUTP/outpmodule/VTPM_LRPindi_enum_Inproc/Signal_Limit" /begin REF_CHARACTERISTIC KOUTP_LRPindi_enum_maxval KOUTP_LRPindi_enum_minval /end REF_CHARACTERISTIC /end GROUP
/begin GROUP S686_Signal_Override "SWC_OUTP_type/run_SWC_OUTP_5ms_sys/OUTP/outpmodule/VTPM_LRPindi_enum_Inproc/Signal_Override" /begin REF_CHARACTERISTIC KOUTP_LRPindi_enum_ovrdflg KOUTP_LRPindi_enum_ovrdval /end REF_CHARACTERISTIC /end GROUP
/begin GROUP S687_Signal_Limit "SWC_OUTP_type/run_SWC_OUTP_5ms_sys/OUTP/outpmodule/VTPM_LRPressIndi_enum_Inproc/Signal_Limit"
 /begin REF_CHARACTERISTIC KOUTP_LRPressIndi_enum_maxval KOUTP_LRPressIndi_enum_minval /end REF_CHARACTERISTIC
/end GROUP
/begin GROUP S687_Signal_Override "SWC_OUTP_type/run_SWC_OUTP_5ms_sys/OUTP/outpmodule/VTPM_LRPressIndi_enum_Inproc/Signal_Override"
 /begin REF_CHARACTERISTIC KOUTP_LRPressIndi_enum_ovrdflg KOUTP_LRPressIndi_enum_ovrdval /end REF_CHARACTERISTIC
/end GROUP
/begin GROUP S688_Signal_Limit "SWC_OUTP_type/run_SWC_OUTP_5ms_sys/OUTP/outpmodule/VTPM_LRSensorFail_flg_Inproc/Signal_Limit"
 /begin REF_CHARACTERISTIC KOUTP_LRSensorFail_flg_maxval KOUTP_LRSensorFail_flg_minval /end REF_CHARACTERISTIC
/end GROUP
/begin GROUP S688_Signal_Override "SWC_OUTP_type/run_SWC_OUTP_5ms_sys/OUTP/outpmodule/VTPM_LRSensorFail_flg_Inproc/Signal_Override"
 /begin REF_CHARACTERISTIC KOUTP_LRSensorFail_flg_ovrdflg KOUTP_LRSensorFail_flg_ovrdval /end REF_CHARACTERISTIC
/end GROUP
/begin GROUP S689_Signal_Limit "SWC_OUTP_type/run_SWC_OUTP_5ms_sys/OUTP/outpmodule/VTPM_LRSensorMode_flg_Inproc/Signal_Limit"
 /begin REF_CHARACTERISTIC KOUTP_LRSensorMode_flg_maxval KOUTP_LRSensorMode_flg_minval /end REF_CHARACTERISTIC
/end GROUP
/begin GROUP S689_Signal_Override "SWC_OUTP_type/run_SWC_OUTP_5ms_sys/OUTP/outpmodule/VTPM_LRSensorMode_flg_Inproc/Signal_Override"
 /begin REF_CHARACTERISTIC KOUTP_LRSensorMode_flg_ovrdflg KOUTP_LRSensorMode_flg_ovrdval /end REF_CHARACTERISTIC
/end GROUP
/begin GROUP S690_Signal_Limit "SWC_OUTP_type/run_SWC_OUTP_5ms_sys/OUTP/outpmodule/VTPM_LRWheelDebug_flg_Inproc/Signal_Limit"
 /begin REF_CHARACTERISTIC KOUTP_LRWheelDebug_flg_maxval KOUTP_LRWheelDebug_flg_minval /end REF_CHARACTERISTIC
/end GROUP
/begin GROUP S690_Signal_Override "SWC_OUTP_type/run_SWC_OUTP_5ms_sys/OUTP/outpmodule/VTPM_LRWheelDebug_flg_Inproc/Signal_Override"
 /begin REF_CHARACTERISTIC KOUTP_LRWheelDebug_flg_ovrdflg KOUTP_LRWheelDebug_flg_ovrdval /end REF_CHARACTERISTIC
/end GROUP
/begin GROUP S691_Signal_Limit "SWC_OUTP_type/run_SWC_OUTP_5ms_sys/OUTP/outpmodule/VTPM_LRWheelPSW_raw8_Inproc/Signal_Limit" /begin REF_CHARACTERISTIC KOUTP_LRWheelPSW_raw8_maxval KOUTP_LRWheelPSW_raw8_minval /end REF_CHARACTERISTIC /end GROUP
/begin GROUP S691_Signal_Override "SWC_OUTP_type/run_SWC_OUTP_5ms_sys/OUTP/outpmodule/VTPM_LRWheelPSW_raw8_Inproc/Signal_Override"
 /begin REF_CHARACTERISTIC KOUTP_LRWheelPSW_raw8_ovrdflg KOUTP_LRWheelPSW_raw8_ovrdval /end REF_CHARACTERISTIC
/end GROUP
/begin GROUP S692_Signal_Limit "SWC_OUTP_type/run_SWC_OUTP_5ms_sys/OUTP/outpmodule/VTPM_LRWheelPress_raw8_Inproc/Signal_Limit"
 /begin REF_CHARACTERISTIC KOUTP_LRWheelPress_raw8_maxval KOUTP_LRWheelPress_raw8_minval /end REF_CHARACTERISTIC
/end GROUP
/begin GROUP S692_Signal_Override "SWC_OUTP_type/run_SWC_OUTP_5ms_sys/OUTP/outpmodule/VTPM_LRWheelPress_raw8_Inproc/Signal_Override"
 /begin REF_CHARACTERISTIC KOUTP_LRWheelPress_raw8_ovrdflg KOUTP_LRWheelPress_raw8_ovrdval /end REF_CHARACTERISTIC
/end GROUP
/begin GROUP S693_Signal_Limit "SWC_OUTP_type/run_SWC_OUTP_5ms_sys/OUTP/outpmodule/VTPM_LRWheelTemp_C_Inproc/Signal_Limit" /begin REF_CHARACTERISTIC KOUTP_LRWheelTemp_C_maxval KOUTP_LRWheelTemp_C_minval /end REF_CHARACTERISTIC /end GROUP
/begin GROUP S693_Signal_Override "SWC_OUTP_type/run_SWC_OUTP_5ms_sys/OUTP/outpmodule/VTPM_LRWheelTemp_C_Inproc/Signal_Override" /begin REF_CHARACTERISTIC KOUTP_LRWheelTemp_C_ovrdflg KOUTP_LRWheelTemp_C_ovrdval /end REF_CHARACTERISTIC /end GROUP
/begin GROUP S694_Signal_Limit "SWC_OUTP_type/run_SWC_OUTP_5ms_sys/OUTP/outpmodule/VTPM_LRWheelTmpIndi_flg_Inproc/Signal_Limit"
 /begin REF_CHARACTERISTIC KOUTP_LRWheelTmpIndi_flg_maxval KOUTP_LRWheelTmpIndi_flg_minval /end REF_CHARACTERISTIC
/end GROUP
/begin GROUP S694_Signal_Override "SWC_OUTP_type/run_SWC_OUTP_5ms_sys/OUTP/outpmodule/VTPM_LRWheelTmpIndi_flg_Inproc/Signal_Override"
 /begin REF_CHARACTERISTIC KOUTP_LRWheelTmpIndi_flg_ovrdflg KOUTP_LRWheelTmpIndi_flg_ovrdval /end REF_CHARACTERISTIC
/end GROUP
/begin GROUP S695_Signal_Limit "SWC_OUTP_type/run_SWC_OUTP_5ms_sys/OUTP/outpmodule/VTPM_ModelVersionChksum_raw_Inproc/Signal_Limit"
 /begin REF_CHARACTERISTIC KOUTP_ModelVersionChksum_raw_maxval KOUTP_ModelVersionChksum_raw_minval /end REF_CHARACTERISTIC
/end GROUP
/begin GROUP S695_Signal_Override "SWC_OUTP_type/run_SWC_OUTP_5ms_sys/OUTP/outpmodule/VTPM_ModelVersionChksum_raw_Inproc/Signal_Override"
 /begin REF_CHARACTERISTIC KOUTP_ModelVersionChksum_raw_ovrdflg KOUTP_ModelVersionChksum_raw_ovrdval /end REF_CHARACTERISTIC
/end GROUP
/begin GROUP S696_Signal_Limit "SWC_OUTP_type/run_SWC_OUTP_5ms_sys/OUTP/outpmodule/VTPM_ModelVersion_raw_Inproc/Signal_Limit"
 /begin REF_CHARACTERISTIC KOUTP_ModelVersion_raw_maxval KOUTP_ModelVersion_raw_minval /end REF_CHARACTERISTIC
/end GROUP
/begin GROUP S696_Signal_Override "SWC_OUTP_type/run_SWC_OUTP_5ms_sys/OUTP/outpmodule/VTPM_ModelVersion_raw_Inproc/Signal_Override"
 /begin REF_CHARACTERISTIC KOUTP_ModelVersion_raw_ovrdflg KOUTP_ModelVersion_raw_ovrdval /end REF_CHARACTERISTIC
/end GROUP
/begin GROUP S697_Signal_Limit "SWC_OUTP_type/run_SWC_OUTP_5ms_sys/OUTP/outpmodule/VTPM_Prepresstempvalid_enum_Inproc/Signal_Limit"
 /begin REF_CHARACTERISTIC KOUTP_Prepresstempvalid_enum_maxval KOUTP_Prepresstempvalid_enum_minval /end REF_CHARACTERISTIC
/end GROUP
/begin GROUP S697_Signal_Override "SWC_OUTP_type/run_SWC_OUTP_5ms_sys/OUTP/outpmodule/VTPM_Prepresstempvalid_enum_Inproc/Signal_Override"
 /begin REF_CHARACTERISTIC KOUTP_Prepresstempvalid_enum_ovrdflg KOUTP_Prepresstempvalid_enum_ovrdval /end REF_CHARACTERISTIC
/end GROUP
/begin GROUP S698_Signal_Limit "SWC_OUTP_type/run_SWC_OUTP_5ms_sys/OUTP/outpmodule/VTPM_RFBatWarn_flg_Inproc/Signal_Limit" /begin REF_CHARACTERISTIC KOUTP_RFBatWarn_flg_maxval KOUTP_RFBatWarn_flg_minval /end REF_CHARACTERISTIC /end GROUP
/begin GROUP S698_Signal_Override "SWC_OUTP_type/run_SWC_OUTP_5ms_sys/OUTP/outpmodule/VTPM_RFBatWarn_flg_Inproc/Signal_Override" /begin REF_CHARACTERISTIC KOUTP_RFBatWarn_flg_ovrdflg KOUTP_RFBatWarn_flg_ovrdval /end REF_CHARACTERISTIC /end GROUP
/begin GROUP S699_Signal_Limit "SWC_OUTP_type/run_SWC_OUTP_5ms_sys/OUTP/outpmodule/VTPM_RFP20_raw8_Inproc/Signal_Limit" /begin REF_CHARACTERISTIC KOUTP_RFP20_raw8_maxval KOUTP_RFP20_raw8_minval /end REF_CHARACTERISTIC /end GROUP
/begin GROUP S699_Signal_Override "SWC_OUTP_type/run_SWC_OUTP_5ms_sys/OUTP/outpmodule/VTPM_RFP20_raw8_Inproc/Signal_Override" /begin REF_CHARACTERISTIC KOUTP_RFP20_raw8_ovrdflg KOUTP_RFP20_raw8_ovrdval /end REF_CHARACTERISTIC /end GROUP
/begin GROUP S700_Signal_Limit "SWC_OUTP_type/run_SWC_OUTP_5ms_sys/OUTP/outpmodule/VTPM_RFPind_enum_Inproc/Signal_Limit" /begin REF_CHARACTERISTIC KOUTP_RFPind_enum_maxval KOUTP_RFPind_enum_minval /end REF_CHARACTERISTIC /end GROUP
/begin GROUP S700_Signal_Override "SWC_OUTP_type/run_SWC_OUTP_5ms_sys/OUTP/outpmodule/VTPM_RFPind_enum_Inproc/Signal_Override" /begin REF_CHARACTERISTIC KOUTP_RFPind_enum_ovrdflg KOUTP_RFPind_enum_ovrdval /end REF_CHARACTERISTIC /end GROUP
/begin GROUP S701_Signal_Limit "SWC_OUTP_type/run_SWC_OUTP_5ms_sys/OUTP/outpmodule/VTPM_RFPressIndi_enum_Inproc/Signal_Limit"
 /begin REF_CHARACTERISTIC KOUTP_RFPressIndi_enum_maxval KOUTP_RFPressIndi_enum_minval /end REF_CHARACTERISTIC
/end GROUP
/begin GROUP S701_Signal_Override "SWC_OUTP_type/run_SWC_OUTP_5ms_sys/OUTP/outpmodule/VTPM_RFPressIndi_enum_Inproc/Signal_Override"
 /begin REF_CHARACTERISTIC KOUTP_RFPressIndi_enum_ovrdflg KOUTP_RFPressIndi_enum_ovrdval /end REF_CHARACTERISTIC
/end GROUP
/begin GROUP S702_Signal_Limit "SWC_OUTP_type/run_SWC_OUTP_5ms_sys/OUTP/outpmodule/VTPM_RFSensorFail_flg_Inproc/Signal_Limit"
 /begin REF_CHARACTERISTIC KOUTP_RFSensorFail_flg_maxval KOUTP_RFSensorFail_flg_minval /end REF_CHARACTERISTIC
/end GROUP
/begin GROUP S702_Signal_Override "SWC_OUTP_type/run_SWC_OUTP_5ms_sys/OUTP/outpmodule/VTPM_RFSensorFail_flg_Inproc/Signal_Override"
 /begin REF_CHARACTERISTIC KOUTP_RFSensorFail_flg_ovrdflg KOUTP_RFSensorFail_flg_ovrdval /end REF_CHARACTERISTIC
/end GROUP
/begin GROUP S703_Signal_Limit "SWC_OUTP_type/run_SWC_OUTP_5ms_sys/OUTP/outpmodule/VTPM_RFSensorMode_flg_Inproc/Signal_Limit"
 /begin REF_CHARACTERISTIC KOUTP_RFSensorMode_flg_maxval KOUTP_RFSensorMode_flg_minval /end REF_CHARACTERISTIC
/end GROUP
/begin GROUP S703_Signal_Override "SWC_OUTP_type/run_SWC_OUTP_5ms_sys/OUTP/outpmodule/VTPM_RFSensorMode_flg_Inproc/Signal_Override"
 /begin REF_CHARACTERISTIC KOUTP_RFSensorMode_flg_ovrdflg KOUTP_RFSensorMode_flg_ovrdval /end REF_CHARACTERISTIC
/end GROUP
/begin GROUP S704_Signal_Limit "SWC_OUTP_type/run_SWC_OUTP_5ms_sys/OUTP/outpmodule/VTPM_RFWheelDebug_flg_Inproc/Signal_Limit"
 /begin REF_CHARACTERISTIC KOUTP_RFWheelDebug_flg_maxval KOUTP_RFWheelDebug_flg_minval /end REF_CHARACTERISTIC
/end GROUP
/begin GROUP S704_Signal_Override "SWC_OUTP_type/run_SWC_OUTP_5ms_sys/OUTP/outpmodule/VTPM_RFWheelDebug_flg_Inproc/Signal_Override"
 /begin REF_CHARACTERISTIC KOUTP_RFWheelDebug_flg_ovrdflg KOUTP_RFWheelDebug_flg_ovrdval /end REF_CHARACTERISTIC
/end GROUP
/begin GROUP S705_Signal_Limit "SWC_OUTP_type/run_SWC_OUTP_5ms_sys/OUTP/outpmodule/VTPM_RFWheelPSW_raw8_Inproc/Signal_Limit" /begin REF_CHARACTERISTIC KOUTP_RFWheelPSW_raw8_maxval KOUTP_RFWheelPSW_raw8_minval /end REF_CHARACTERISTIC /end GROUP
/begin GROUP S705_Signal_Override "SWC_OUTP_type/run_SWC_OUTP_5ms_sys/OUTP/outpmodule/VTPM_RFWheelPSW_raw8_Inproc/Signal_Override"
 /begin REF_CHARACTERISTIC KOUTP_RFWheelPSW_raw8_ovrdflg KOUTP_RFWheelPSW_raw8_ovrdval /end REF_CHARACTERISTIC
/end GROUP
/begin GROUP S706_Signal_Limit "SWC_OUTP_type/run_SWC_OUTP_5ms_sys/OUTP/outpmodule/VTPM_RFWheelPress_raw8_Inproc/Signal_Limit"
 /begin REF_CHARACTERISTIC KOUTP_RFWheelPress_raw8_maxval KOUTP_RFWheelPress_raw8_minval /end REF_CHARACTERISTIC
/end GROUP
/begin GROUP S706_Signal_Override "SWC_OUTP_type/run_SWC_OUTP_5ms_sys/OUTP/outpmodule/VTPM_RFWheelPress_raw8_Inproc/Signal_Override"
 /begin REF_CHARACTERISTIC KOUTP_RFWheelPress_raw8_ovrdflg KOUTP_RFWheelPress_raw8_ovrdval /end REF_CHARACTERISTIC
/end GROUP
/begin GROUP S707_Signal_Limit "SWC_OUTP_type/run_SWC_OUTP_5ms_sys/OUTP/outpmodule/VTPM_RFWheelTemp_C_Inproc/Signal_Limit" /begin REF_CHARACTERISTIC KOUTP_RFWheelTemp_C_maxval KOUTP_RFWheelTemp_C_minval /end REF_CHARACTERISTIC /end GROUP
/begin GROUP S707_Signal_Override "SWC_OUTP_type/run_SWC_OUTP_5ms_sys/OUTP/outpmodule/VTPM_RFWheelTemp_C_Inproc/Signal_Override" /begin REF_CHARACTERISTIC KOUTP_RFWheelTemp_C_ovrdflg KOUTP_RFWheelTemp_C_ovrdval /end REF_CHARACTERISTIC /end GROUP
/begin GROUP S708_Signal_Limit "SWC_OUTP_type/run_SWC_OUTP_5ms_sys/OUTP/outpmodule/VTPM_RFWheelTmpIndi_flg_Inproc/Signal_Limit"
 /begin REF_CHARACTERISTIC KOUTP_RFWheelTmpIndi_flg_maxval KOUTP_RFWheelTmpIndi_flg_minval /end REF_CHARACTERISTIC
/end GROUP
/begin GROUP S708_Signal_Override "SWC_OUTP_type/run_SWC_OUTP_5ms_sys/OUTP/outpmodule/VTPM_RFWheelTmpIndi_flg_Inproc/Signal_Override"
 /begin REF_CHARACTERISTIC KOUTP_RFWheelTmpIndi_flg_ovrdflg KOUTP_RFWheelTmpIndi_flg_ovrdval /end REF_CHARACTERISTIC
/end GROUP
/begin GROUP S709_Signal_Limit "SWC_OUTP_type/run_SWC_OUTP_5ms_sys/OUTP/outpmodule/VTPM_RRBatWarn_flg_Inproc/Signal_Limit" /begin REF_CHARACTERISTIC KOUTP_RRBatWarn_flg_maxval KOUTP_RRBatWarn_flg_minval /end REF_CHARACTERISTIC /end GROUP
/begin GROUP S709_Signal_Override "SWC_OUTP_type/run_SWC_OUTP_5ms_sys/OUTP/outpmodule/VTPM_RRBatWarn_flg_Inproc/Signal_Override" /begin REF_CHARACTERISTIC KOUTP_RRBatWarn_flg_ovrdflg KOUTP_RRBatWarn_flg_ovrdval /end REF_CHARACTERISTIC /end GROUP
/begin GROUP S710_Signal_Limit "SWC_OUTP_type/run_SWC_OUTP_5ms_sys/OUTP/outpmodule/VTPM_RRP20_raw8_Inproc/Signal_Limit" /begin REF_CHARACTERISTIC KOUTP_RRP20_raw8_maxval KOUTP_RRP20_raw8_minval /end REF_CHARACTERISTIC /end GROUP
/begin GROUP S710_Signal_Override "SWC_OUTP_type/run_SWC_OUTP_5ms_sys/OUTP/outpmodule/VTPM_RRP20_raw8_Inproc/Signal_Override" /begin REF_CHARACTERISTIC KOUTP_RRP20_raw8_ovrdflg KOUTP_RRP20_raw8_ovrdval /end REF_CHARACTERISTIC /end GROUP
/begin GROUP S711_Signal_Limit "SWC_OUTP_type/run_SWC_OUTP_5ms_sys/OUTP/outpmodule/VTPM_RRPindi_enum_Inproc/Signal_Limit" /begin REF_CHARACTERISTIC KOUTP_RRPindi_enum_maxval KOUTP_RRPindi_enum_minval /end REF_CHARACTERISTIC /end GROUP
/begin GROUP S711_Signal_Override "SWC_OUTP_type/run_SWC_OUTP_5ms_sys/OUTP/outpmodule/VTPM_RRPindi_enum_Inproc/Signal_Override" /begin REF_CHARACTERISTIC KOUTP_RRPindi_enum_ovrdflg KOUTP_RRPindi_enum_ovrdval /end REF_CHARACTERISTIC /end GROUP
/begin GROUP S712_Signal_Limit "SWC_OUTP_type/run_SWC_OUTP_5ms_sys/OUTP/outpmodule/VTPM_RRPressIndi_enum_Inproc/Signal_Limit"
 /begin REF_CHARACTERISTIC KOUTP_RRPressIndi_enum_maxval KOUTP_RRPressIndi_enum_minval /end REF_CHARACTERISTIC
/end GROUP
/begin GROUP S712_Signal_Override "SWC_OUTP_type/run_SWC_OUTP_5ms_sys/OUTP/outpmodule/VTPM_RRPressIndi_enum_Inproc/Signal_Override"
 /begin REF_CHARACTERISTIC KOUTP_RRPressIndi_enum_ovrdflg KOUTP_RRPressIndi_enum_ovrdval /end REF_CHARACTERISTIC
/end GROUP
/begin GROUP S713_Signal_Limit "SWC_OUTP_type/run_SWC_OUTP_5ms_sys/OUTP/outpmodule/VTPM_RRSensorFail_flg_Inproc/Signal_Limit"
 /begin REF_CHARACTERISTIC KOUTP_RRSensorFail_flg_maxval KOUTP_RRSensorFail_flg_minval /end REF_CHARACTERISTIC
/end GROUP
/begin GROUP S713_Signal_Override "SWC_OUTP_type/run_SWC_OUTP_5ms_sys/OUTP/outpmodule/VTPM_RRSensorFail_flg_Inproc/Signal_Override"
 /begin REF_CHARACTERISTIC KOUTP_RRSensorFail_flg_ovrdflg KOUTP_RRSensorFail_flg_ovrdval /end REF_CHARACTERISTIC
/end GROUP
/begin GROUP S714_Signal_Limit "SWC_OUTP_type/run_SWC_OUTP_5ms_sys/OUTP/outpmodule/VTPM_RRSensorMode_flg_Inproc/Signal_Limit"
 /begin REF_CHARACTERISTIC KOUTP_RRSensorMode_flg_maxval KOUTP_RRSensorMode_flg_minval /end REF_CHARACTERISTIC
/end GROUP
/begin GROUP S714_Signal_Override "SWC_OUTP_type/run_SWC_OUTP_5ms_sys/OUTP/outpmodule/VTPM_RRSensorMode_flg_Inproc/Signal_Override"
 /begin REF_CHARACTERISTIC KOUTP_RRSensorMode_flg_ovrdflg KOUTP_RRSensorMode_flg_ovrdval /end REF_CHARACTERISTIC
/end GROUP
/end MODULE
/end PROJECT
