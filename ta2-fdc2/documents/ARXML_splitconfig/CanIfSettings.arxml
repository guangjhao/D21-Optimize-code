AUTOSAR XML (schema 4-0-3)
package /CanIf
  module config CanIf: implementation-config-variant=VARIANT-POST-BUILD
    CanIfCtrlDrvCfg: CanIfCtrlDrvTxCancellation=0, CanIfCtrlDrvInitHohConfigRef=CanIfInitHohCfg, CanIfCtrlDrvNameRef=CanGeneral
      8 x CanIfCtrlCfg, all with CanIfCtrlMaxRxNotifyPdus=64, CanIfCtrlMaxTxNotifyPdus=64, CanIfCtrlWakeupSupport=0:
        CAN1: CanIfCtrlCanCtrlRef=CAN1
        CAN2: CanIfCtrlCanCtrlRef=CAN2
        CAN3: CanIfCtrlId=2, CanIfCtrlCanCtrlRef=CAN3
        CAN4: CanIfCtrlId=3, CanIfCtrlCanCtrlRef=CAN4
        CAN5: CanIfCtrlId=4, CanIfCtrlCanCtrlRef=CAN5
        CAN6: CanIfCtrlId=5, CanIfCtrlCanCtrlRef=CAN6
        CAN7: CanIfCtrlCanCtrlRef=CAN7
        Can8_Xcp: CanIfCtrlCanCtrlRef=CAN_XCP
    CanIfDecoupledMeasurementSupport:
      CanIfNumberOfEnqueuedRxPdusApiName = 
      CanIfNumberOfEnqueuedTxPdusApiName = 
      CanIfNumberOfRxPdusExceedingQueueApiName = 
      CanIfNumberOfTxPdusExceedingQueueApiName = 
      CanIfRxDecoupledMeasurementSupport = 0
      CanIfTxDecoupledMeasurementSupport = 0
    CanIfDefensiveProgramming:
      CanIfDefProgEnabled = 0
      CanIfInvariantAssertEnabled = 0
      CanIfPostcondAssertEnabled = 0
      CanIfPrecondAssertEnabled = 0
      CanIfStaticAssertEnabled = 0
      CanIfUnreachAssertEnabled = 0
    CanIfDispatchCfg:
      CanIfDispatchUserConfirmPnAvailabilityName = (unset)
      CanIfDispatchUserConfirmPnAvailabilityUL = CAN_SM
      CanIfDispatchUserCtrlBusOffName = (unset)
      CanIfDispatchUserCtrlBusOffUL = CAN_SM
      CanIfDispatchUserCtrlModeIndicationName = (unset)
      CanIfDispatchUserCtrlModeIndicationUL = CAN_SM
      CanIfDispatchUserSetWakeupEventName = (unset)
      CanIfDispatchUserSetWakeupEventUL = ECUM
      CanIfDispatchUserTrcvModeIndicationName = (unset)
      CanIfDispatchUserTrcvModeIndicationUL = CAN_SM
      CanIfDispatchUserValidateWakeupEventName = (unset)
      CanIfDispatchUserValidateWakeupEventUL = (unset)
    CanIfHookOnRxSupport: CanIfHookOnReceptionFunctionName=(unset), CanIfHookOnReceptionHeader=(unset)
    CanIfInitCfg: CanIfInitCfgSet=
      8 x CanIfBufferCfg, all with CanIfBufferSize=0:
        HOH_0_Can8_Xcp: CanIfBufferHthRef=CanIfInitHohCfg/HOH_0_Can8_Xcp
        HOH_TX_0_CAN{1..7}: CanIfBufferHthRef=CanIfInitHohCfg/HOH_TX_0_CAN{1..7}
      CanIfInitHohCfg: CanIfInitRefCfgSet=CanConfigSet
        68 x CanIfHrhCfg, all with CanIfHrhSoftwareFilter=0:
          HOH_{1..26}_CAN1: CanIfHrhCanCtrlIdRef=CAN1, CanIfHrhIdSymRef=HOH_{1..26}_CAN1
          HOH_{1..9}_CAN2: CanIfHrhCanCtrlIdRef=CAN2, CanIfHrhIdSymRef=HOH_{1..9}_CAN2
          HOH_{1..16}_CAN3: CanIfHrhCanCtrlIdRef=CAN3, CanIfHrhIdSymRef=HOH_{1..16}_CAN3
          HOH_{1..10}_CAN4: CanIfHrhCanCtrlIdRef=CAN4, CanIfHrhIdSymRef=HOH_{1..10}_CAN4
          HOH_1_CAN5: CanIfHrhCanCtrlIdRef=CAN5, CanIfHrhIdSymRef=HOH_1_CAN5
          HOH_2_CAN5: CanIfHrhCanCtrlIdRef=CAN5, CanIfHrhIdSymRef=HOH_2_CAN5
          HOH_1_CAN6: CanIfHrhCanCtrlIdRef=CAN6, CanIfHrhIdSymRef=HOH_1_CAN6
          HOH_{1..4}_CAN7: CanIfHrhCanCtrlIdRef=CAN7, CanIfHrhIdSymRef=HOH_{1..4}_CAN7
        HOH_0_Can8_Xcp (CanIfHthCfg): CanIfHthCanCtrlIdRef=Can8_Xcp, CanIfHthIdSymRef=HOH_0_Can8_Xcp
        HOH_1_Can8_Xcp (CanIfHrhCfg): CanIfHrhSoftwareFilter=0, CanIfHrhCanCtrlIdRef=Can8_Xcp, CanIfHrhIdSymRef=HOH_1_Can8_Xcp
        7 x CanIfHthCfg:
          HOH_TX_0_CAN{1..7}: CanIfHthCanCtrlIdRef=CAN{1..7}, CanIfHthIdSymRef=HOH_TX_0_CAN{1..7}
        10 x CanIfHrhCfg, all with CanIfHrhSoftwareFilter=0:
          HOH_TX_LOGGING_EXT_CAN{1..7}: CanIfHrhCanCtrlIdRef=CAN{1..7}, CanIfHrhIdSymRef=HOH_TX_LOGGING_EXT_CAN{1..7}
          HOH_TX_LOGGING_STD_CAN2: CanIfHrhCanCtrlIdRef=CAN2, CanIfHrhIdSymRef=HOH_TX_LOGGING_STD_CAN2
          HOH_TX_LOGGING_STD_CAN4: CanIfHrhCanCtrlIdRef=CAN4, CanIfHrhIdSymRef=HOH_TX_LOGGING_STD_CAN4
          HOH_TX_LOGGING_STD_CAN6: CanIfHrhCanCtrlIdRef=CAN6, CanIfHrhIdSymRef=HOH_TX_LOGGING_STD_CAN6
      45 x CanIfRxPduCfg, all with CanIfRxPduCanIdMask=536870911, CanIfRxPduReadData=0, CanIfRxPduReadNotifyStatus=0, CanIfRxPduUserRxIndicationName=, CanIfRxPduBswSchExclAreaIdRef=(unset):
        CAN1_AC_BTMS_C1000_0_404541651R: CanIfRxPduCanId=404541651, CanIfRxPduCanIdType=EXTENDED_NO_FD_CAN, CanIfRxPduDlc=8, CanIfRxPduTargetPduID=(unset), CanIfRxPduUserRxIndicationUL=PDUR, CanIfRxPduId=0, CanIfRxPduHrhIdRef=HOH_6_CAN1, CanIfRxPduRef=CAN1_AC_BTMS_C1000_0_404541651R, CanIfRxPduUpperLayerRef=(unset)
          CanIfTTRxFrameTriggering: CanIfTTRxHwObjectTriggerIdRef=(unset)
        CAN1_AC_BTMS_C1000_1_404541907R: CanIfRxPduCanId=404541907, CanIfRxPduCanIdType=EXTENDED_NO_FD_CAN, CanIfRxPduDlc=8, CanIfRxPduTargetPduID=(unset), CanIfRxPduUserRxIndicationUL=PDUR, CanIfRxPduId=1, CanIfRxPduHrhIdRef=HOH_7_CAN1, CanIfRxPduRef=CAN1_AC_BTMS_C1000_1_404541907R, CanIfRxPduUpperLayerRef=(unset)
          CanIfTTRxFrameTriggering: CanIfTTRxHwObjectTriggerIdRef=(unset)
        CAN1_AC_BTMS_C1000_2_419406361R: CanIfRxPduCanId=419406361, CanIfRxPduCanIdType=EXTENDED_NO_FD_CAN, CanIfRxPduDlc=8, CanIfRxPduTargetPduID=(unset), CanIfRxPduUserRxIndicationUL=PDUR, CanIfRxPduId=2, CanIfRxPduHrhIdRef=HOH_25_CAN1, CanIfRxPduRef=CAN1_AC_BTMS_C1000_2_419406361R, CanIfRxPduUpperLayerRef=(unset)
          CanIfTTRxFrameTriggering: CanIfTTRxHwObjectTriggerIdRef=(unset)
        CAN1_AC_BTMS_C1000_4_419414330R: CanIfRxPduCanId=419414330, CanIfRxPduCanIdType=EXTENDED_NO_FD_CAN, CanIfRxPduDlc=8, CanIfRxPduTargetPduID=(unset), CanIfRxPduUserRxIndicationUL=PDUR, CanIfRxPduId=3, CanIfRxPduHrhIdRef=HOH_26_CAN1, CanIfRxPduRef=CAN1_AC_BTMS_C1000_4_419414330R, CanIfRxPduUpperLayerRef=(unset)
          CanIfTTRxFrameTriggering: CanIfTTRxHwObjectTriggerIdRef=(unset)
        CAN1_AC_BTMS_C5000_0_404542163R: CanIfRxPduCanId=404542163, CanIfRxPduCanIdType=EXTENDED_NO_FD_CAN, CanIfRxPduDlc=8, CanIfRxPduTargetPduID=(unset), CanIfRxPduUserRxIndicationUL=PDUR, CanIfRxPduId=4, CanIfRxPduHrhIdRef=HOH_8_CAN1, CanIfRxPduRef=CAN1_AC_BTMS_C5000_0_404542163R, CanIfRxPduUpperLayerRef=(unset)
          CanIfTTRxFrameTriggering: CanIfTTRxHwObjectTriggerIdRef=(unset)
        CAN1_ASC1_A_217995823R: CanIfRxPduCanId=217995823, CanIfRxPduCanIdType=EXTENDED_NO_FD_CAN, CanIfRxPduDlc=8, CanIfRxPduTargetPduID=(unset), CanIfRxPduUserRxIndicationUL=PDUR, CanIfRxPduId=5, CanIfRxPduHrhIdRef=HOH_5_CAN1, CanIfRxPduRef=CAN1_ASC1_A_217995823R, CanIfRxPduUpperLayerRef=(unset)
          CanIfTTRxFrameTriggering: CanIfTTRxHwObjectTriggerIdRef=(unset)
        CAN1_EBC1_418382091R: CanIfRxPduCanId=418382091, CanIfRxPduCanIdType=EXTENDED_NO_FD_CAN, CanIfRxPduDlc=8, CanIfRxPduTargetPduID=(unset), CanIfRxPduUserRxIndicationUL=PDUR, CanIfRxPduId=6, CanIfRxPduHrhIdRef=HOH_17_CAN1, CanIfRxPduRef=CAN1_EBC1_418382091R, CanIfRxPduUpperLayerRef=(unset)
          CanIfTTRxFrameTriggering: CanIfTTRxHwObjectTriggerIdRef=(unset)
        CAN1_EBC2_419348235R: CanIfRxPduCanId=419348235, CanIfRxPduCanIdType=EXTENDED_NO_FD_CAN, CanIfRxPduDlc=8, CanIfRxPduTargetPduID=(unset), CanIfRxPduUserRxIndicationUL=PDUR, CanIfRxPduId=7, CanIfRxPduHrhIdRef=HOH_23_CAN1, CanIfRxPduRef=CAN1_EBC2_419348235R, CanIfRxPduUpperLayerRef=(unset)
          CanIfTTRxFrameTriggering: CanIfTTRxHwObjectTriggerIdRef=(unset)
        CAN1_EBC5_419283979R: CanIfRxPduCanId=419283979, CanIfRxPduCanIdType=EXTENDED_NO_FD_CAN, CanIfRxPduDlc=8, CanIfRxPduTargetPduID=(unset), CanIfRxPduUserRxIndicationUL=PDUR, CanIfRxPduId=8, CanIfRxPduHrhIdRef=HOH_21_CAN1, CanIfRxPduRef=CAN1_EBC5_419283979R, CanIfRxPduUpperLayerRef=(unset)
          CanIfTTRxFrameTriggering: CanIfTTRxHwObjectTriggerIdRef=(unset)
        CAN1_ECAS_DM1_419351087R: CanIfRxPduCanId=419351087, CanIfRxPduCanIdType=EXTENDED_NO_FD_CAN, CanIfRxPduDlc=8, CanIfRxPduTargetPduID=(unset), CanIfRxPduUserRxIndicationUL=PDUR, CanIfRxPduId=9, CanIfRxPduHrhIdRef=HOH_24_CAN1, CanIfRxPduRef=CAN1_ECAS_DM1_419351087R, CanIfRxPduUpperLayerRef=(unset)
          CanIfTTRxFrameTriggering: CanIfTTRxHwObjectTriggerIdRef=(unset)
        CAN1_EMC1_EM1_217050891R: CanIfRxPduCanId=217050891, CanIfRxPduCanIdType=EXTENDED_NO_FD_CAN, CanIfRxPduDlc=8, CanIfRxPduTargetPduID=(unset), CanIfRxPduUserRxIndicationUL=PDUR, CanIfRxPduId=10, CanIfRxPduHrhIdRef=HOH_4_CAN1, CanIfRxPduRef=CAN1_EMC1_EM1_217050891R, CanIfRxPduUpperLayerRef=(unset)
          CanIfTTRxFrameTriggering: CanIfTTRxHwObjectTriggerIdRef=(unset)
        CAN1_HRW_150892043R: CanIfRxPduCanId=150892043, CanIfRxPduCanIdType=EXTENDED_NO_FD_CAN, CanIfRxPduDlc=8, CanIfRxPduTargetPduID=(unset), CanIfRxPduUserRxIndicationUL=PDUR, CanIfRxPduId=11, CanIfRxPduHrhIdRef=HOH_2_CAN1, CanIfRxPduRef=CAN1_HRW_150892043R, CanIfRxPduUpperLayerRef=(unset)
          CanIfTTRxFrameTriggering: CanIfTTRxHwObjectTriggerIdRef=(unset)
        CAN1_TC1_201392901R: CanIfRxPduCanId=201392901, CanIfRxPduCanIdType=EXTENDED_NO_FD_CAN, CanIfRxPduDlc=8, CanIfRxPduTargetPduID=(unset), CanIfRxPduUserRxIndicationUL=PDUR, CanIfRxPduId=12, CanIfRxPduHrhIdRef=HOH_3_CAN1, CanIfRxPduRef=CAN1_TC1_201392901R, CanIfRxPduUpperLayerRef=(unset)
          CanIfTTRxFrameTriggering: CanIfTTRxHwObjectTriggerIdRef=(unset)
        CAN1_TPMS1_418517043R: CanIfRxPduCanId=418517043, CanIfRxPduCanIdType=EXTENDED_NO_FD_CAN, CanIfRxPduDlc=8, CanIfRxPduTargetPduID=(unset), CanIfRxPduUserRxIndicationUL=PDUR, CanIfRxPduId=13, CanIfRxPduHrhIdRef=HOH_18_CAN1, CanIfRxPduRef=CAN1_TPMS1_418517043R, CanIfRxPduUpperLayerRef=(unset)
          CanIfTTRxFrameTriggering: CanIfTTRxHwObjectTriggerIdRef=(unset)
        CAN1_TPMS2_418517299R: CanIfRxPduCanId=418517299, CanIfRxPduCanIdType=EXTENDED_NO_FD_CAN, CanIfRxPduDlc=8, CanIfRxPduTargetPduID=(unset), CanIfRxPduUserRxIndicationUL=PDUR, CanIfRxPduId=14, CanIfRxPduHrhIdRef=HOH_19_CAN1, CanIfRxPduRef=CAN1_TPMS2_418517299R, CanIfRxPduUpperLayerRef=(unset)
          CanIfTTRxFrameTriggering: CanIfTTRxHwObjectTriggerIdRef=(unset)
        CAN1_TPMS3_418517555R: CanIfRxPduCanId=418517555, CanIfRxPduCanIdType=EXTENDED_NO_FD_CAN, CanIfRxPduDlc=8, CanIfRxPduTargetPduID=(unset), CanIfRxPduUserRxIndicationUL=PDUR, CanIfRxPduId=15, CanIfRxPduHrhIdRef=HOH_20_CAN1, CanIfRxPduRef=CAN1_TPMS3_418517555R, CanIfRxPduUpperLayerRef=(unset)
          CanIfTTRxFrameTriggering: CanIfTTRxHwObjectTriggerIdRef=(unset)
        CAN1_VDC1_419319563R: CanIfRxPduCanId=419319563, CanIfRxPduCanIdType=EXTENDED_NO_FD_CAN, CanIfRxPduDlc=8, CanIfRxPduTargetPduID=(unset), CanIfRxPduUserRxIndicationUL=PDUR, CanIfRxPduId=16, CanIfRxPduHrhIdRef=HOH_22_CAN1, CanIfRxPduRef=CAN1_VDC1_419319563R, CanIfRxPduUpperLayerRef=(unset)
          CanIfTTRxFrameTriggering: CanIfTTRxHwObjectTriggerIdRef=(unset)
        CAN2_IVI_C100_0_419140446R: CanIfRxPduCanId=419140446, CanIfRxPduCanIdType=EXTENDED_NO_FD_CAN, CanIfRxPduDlc=8, CanIfRxPduTargetPduID=(unset), CanIfRxPduUserRxIndicationUL=PDUR, CanIfRxPduId=17, CanIfRxPduHrhIdRef=HOH_8_CAN2, CanIfRxPduRef=CAN2_IVI_C100_0_419140446R, CanIfRxPduUpperLayerRef=(unset)
          CanIfTTRxFrameTriggering: CanIfTTRxHwObjectTriggerIdRef=(unset)
        CAN3_B2TM_Info_419382772R: CanIfRxPduCanId=419382772, CanIfRxPduCanIdType=EXTENDED_NO_FD_CAN, CanIfRxPduDlc=8, CanIfRxPduTargetPduID=(unset), CanIfRxPduUserRxIndicationUL=PDUR, CanIfRxPduId=18, CanIfRxPduHrhIdRef=HOH_15_CAN3, CanIfRxPduRef=CAN3_B2TM_Info_419382772R, CanIfRxPduUpperLayerRef=(unset)
          CanIfTTRxFrameTriggering: CanIfTTRxHwObjectTriggerIdRef=(unset)
        CAN3_B2V_BattInfo1_417525747R: CanIfRxPduCanId=417525747, CanIfRxPduCanIdType=EXTENDED_NO_FD_CAN, CanIfRxPduDlc=8, CanIfRxPduTargetPduID=(unset), CanIfRxPduUserRxIndicationUL=PDUR, CanIfRxPduId=19, CanIfRxPduHrhIdRef=HOH_14_CAN3, CanIfRxPduRef=CAN3_B2V_BattInfo1_417525747R, CanIfRxPduUpperLayerRef=(unset)
          CanIfTTRxFrameTriggering: CanIfTTRxHwObjectTriggerIdRef=(unset)
        CAN3_B2V_CurrentLimit_415559667R: CanIfRxPduCanId=415559667, CanIfRxPduCanIdType=EXTENDED_NO_FD_CAN, CanIfRxPduDlc=8, CanIfRxPduTargetPduID=(unset), CanIfRxPduUserRxIndicationUL=PDUR, CanIfRxPduId=20, CanIfRxPduHrhIdRef=HOH_10_CAN3, CanIfRxPduRef=CAN3_B2V_CurrentLimit_415559667R, CanIfRxPduUpperLayerRef=(unset)
          CanIfTTRxFrameTriggering: CanIfTTRxHwObjectTriggerIdRef=(unset)
        CAN3_B2V_Fult1_32960_411168755R: CanIfRxPduCanId=411168755, CanIfRxPduCanIdType=EXTENDED_NO_FD_CAN, CanIfRxPduDlc=8, CanIfRxPduTargetPduID=(unset), CanIfRxPduUserRxIndicationUL=PDUR, CanIfRxPduId=21, CanIfRxPduHrhIdRef=HOH_5_CAN3, CanIfRxPduRef=CAN3_B2V_Fult1_32960_411168755R, CanIfRxPduUpperLayerRef=(unset)
          CanIfTTRxFrameTriggering: CanIfTTRxHwObjectTriggerIdRef=(unset)
        CAN3_B2V_ST1_411299827R: CanIfRxPduCanId=411299827, CanIfRxPduCanIdType=EXTENDED_NO_FD_CAN, CanIfRxPduDlc=8, CanIfRxPduTargetPduID=(unset), CanIfRxPduUserRxIndicationUL=PDUR, CanIfRxPduId=22, CanIfRxPduHrhIdRef=HOH_6_CAN3, CanIfRxPduRef=CAN3_B2V_ST1_411299827R, CanIfRxPduUpperLayerRef=(unset)
          CanIfTTRxFrameTriggering: CanIfTTRxHwObjectTriggerIdRef=(unset)
        CAN3_B2V_ST2_411365363R: CanIfRxPduCanId=411365363, CanIfRxPduCanIdType=EXTENDED_NO_FD_CAN, CanIfRxPduDlc=8, CanIfRxPduTargetPduID=(unset), CanIfRxPduUserRxIndicationUL=PDUR, CanIfRxPduId=23, CanIfRxPduHrhIdRef=HOH_7_CAN3, CanIfRxPduRef=CAN3_B2V_ST2_411365363R, CanIfRxPduUpperLayerRef=(unset)
          CanIfTTRxFrameTriggering: CanIfTTRxHwObjectTriggerIdRef=(unset)
        CAN3_B2V_ST4_411496435R: CanIfRxPduCanId=411496435, CanIfRxPduCanIdType=EXTENDED_NO_FD_CAN, CanIfRxPduDlc=8, CanIfRxPduTargetPduID=(unset), CanIfRxPduUserRxIndicationUL=PDUR, CanIfRxPduId=24, CanIfRxPduHrhIdRef=HOH_8_CAN3, CanIfRxPduRef=CAN3_B2V_ST4_411496435R, CanIfRxPduUpperLayerRef=(unset)
          CanIfTTRxFrameTriggering: CanIfTTRxHwObjectTriggerIdRef=(unset)
        CAN3_B2V_ST5_411561971R: CanIfRxPduCanId=411561971, CanIfRxPduCanIdType=EXTENDED_NO_FD_CAN, CanIfRxPduDlc=8, CanIfRxPduTargetPduID=(unset), CanIfRxPduUserRxIndicationUL=PDUR, CanIfRxPduId=25, CanIfRxPduHrhIdRef=HOH_9_CAN3, CanIfRxPduRef=CAN3_B2V_ST5_411561971R, CanIfRxPduUpperLayerRef=(unset)
          CanIfTTRxFrameTriggering: CanIfTTRxHwObjectTriggerIdRef=(unset)
        CAN3_EWP1_419425849R: CanIfRxPduCanId=419425849, CanIfRxPduCanIdType=EXTENDED_NO_FD_CAN, CanIfRxPduDlc=8, CanIfRxPduTargetPduID=(unset), CanIfRxPduUserRxIndicationUL=PDUR, CanIfRxPduId=26, CanIfRxPduHrhIdRef=HOH_16_CAN3, CanIfRxPduRef=CAN3_EWP1_419425849R, CanIfRxPduUpperLayerRef=(unset)
          CanIfTTRxFrameTriggering: CanIfTTRxHwObjectTriggerIdRef=(unset)
        CAN3_TM_MCUSta1_218038277R: CanIfRxPduCanId=218038277, CanIfRxPduCanIdType=EXTENDED_NO_FD_CAN, CanIfRxPduDlc=8, CanIfRxPduTargetPduID=(unset), CanIfRxPduUserRxIndicationUL=PDUR, CanIfRxPduId=27, CanIfRxPduHrhIdRef=HOH_2_CAN3, CanIfRxPduRef=CAN3_TM_MCUSta1_218038277R, CanIfRxPduUpperLayerRef=(unset)
          CanIfTTRxFrameTriggering: CanIfTTRxHwObjectTriggerIdRef=(unset)
        CAN3_TM_MCUSta2_218038533R: CanIfRxPduCanId=218038533, CanIfRxPduCanIdType=EXTENDED_NO_FD_CAN, CanIfRxPduDlc=8, CanIfRxPduTargetPduID=(unset), CanIfRxPduUserRxIndicationUL=PDUR, CanIfRxPduId=28, CanIfRxPduHrhIdRef=HOH_3_CAN3, CanIfRxPduRef=CAN3_TM_MCUSta2_218038533R, CanIfRxPduUpperLayerRef=(unset)
          CanIfTTRxFrameTriggering: CanIfTTRxHwObjectTriggerIdRef=(unset)
        CAN3_TM_MCUSta3_218038789R: CanIfRxPduCanId=218038789, CanIfRxPduCanIdType=EXTENDED_NO_FD_CAN, CanIfRxPduDlc=8, CanIfRxPduTargetPduID=(unset), CanIfRxPduUserRxIndicationUL=PDUR, CanIfRxPduId=29, CanIfRxPduHrhIdRef=HOH_4_CAN3, CanIfRxPduRef=CAN3_TM_MCUSta3_218038789R, CanIfRxPduUpperLayerRef=(unset)
          CanIfTTRxFrameTriggering: CanIfTTRxHwObjectTriggerIdRef=(unset)
        CAN4_ZFR_C100_0_515R: CanIfRxPduCanId=515, CanIfRxPduCanIdType=STANDARD_FD_CAN, CanIfRxPduDlc=32, CanIfRxPduTargetPduID=(unset), CanIfRxPduUserRxIndicationUL=PDUR, CanIfRxPduId=30, CanIfRxPduHrhIdRef=HOH_4_CAN4, CanIfRxPduRef=CAN4_ZFR_C100_0_515R, CanIfRxPduUpperLayerRef=(unset)
          CanIfTTRxFrameTriggering: CanIfTTRxHwObjectTriggerIdRef=(unset)
        CAN4_ZFR_C5000_0_513R: CanIfRxPduCanId=513, CanIfRxPduCanIdType=STANDARD_FD_CAN, CanIfRxPduDlc=32, CanIfRxPduTargetPduID=(unset), CanIfRxPduUserRxIndicationUL=PDUR, CanIfRxPduId=31, CanIfRxPduHrhIdRef=HOH_2_CAN4, CanIfRxPduRef=CAN4_ZFR_C5000_0_513R, CanIfRxPduUpperLayerRef=(unset)
          CanIfTTRxFrameTriggering: CanIfTTRxHwObjectTriggerIdRef=(unset)
        CAN4_ZFR_CE100_0_517R: CanIfRxPduCanId=517, CanIfRxPduCanIdType=STANDARD_FD_CAN, CanIfRxPduDlc=32, CanIfRxPduTargetPduID=(unset), CanIfRxPduUserRxIndicationUL=PDUR, CanIfRxPduId=32, CanIfRxPduHrhIdRef=HOH_5_CAN4, CanIfRxPduRef=CAN4_ZFR_CE100_0_517R, CanIfRxPduUpperLayerRef=(unset)
          CanIfTTRxFrameTriggering: CanIfTTRxHwObjectTriggerIdRef=(unset)
        CAN4_ZRR_C5000_0_514R: CanIfRxPduCanId=514, CanIfRxPduCanIdType=STANDARD_FD_CAN, CanIfRxPduDlc=32, CanIfRxPduTargetPduID=(unset), CanIfRxPduUserRxIndicationUL=PDUR, CanIfRxPduId=33, CanIfRxPduHrhIdRef=HOH_3_CAN4, CanIfRxPduRef=CAN4_ZRR_C5000_0_514R, CanIfRxPduUpperLayerRef=(unset)
          CanIfTTRxFrameTriggering: CanIfTTRxHwObjectTriggerIdRef=(unset)
        CAN4_ZRR_CE100_0_419319532R: CanIfRxPduCanId=419319532, CanIfRxPduCanIdType=EXTENDED_NO_FD_CAN, CanIfRxPduDlc=8, CanIfRxPduTargetPduID=(unset), CanIfRxPduUserRxIndicationUL=PDUR, CanIfRxPduId=34, CanIfRxPduHrhIdRef=HOH_10_CAN4, CanIfRxPduRef=CAN4_ZRR_CE100_0_419319532R, CanIfRxPduUpperLayerRef=(unset)
          CanIfTTRxFrameTriggering: CanIfTTRxHwObjectTriggerIdRef=(unset)
        CAN4_ZRR_CE100_1_518R: CanIfRxPduCanId=518, CanIfRxPduCanIdType=STANDARD_FD_CAN, CanIfRxPduDlc=32, CanIfRxPduTargetPduID=(unset), CanIfRxPduUserRxIndicationUL=PDUR, CanIfRxPduId=35, CanIfRxPduHrhIdRef=HOH_6_CAN4, CanIfRxPduRef=CAN4_ZRR_CE100_1_518R, CanIfRxPduUpperLayerRef=(unset)
          CanIfTTRxFrameTriggering: CanIfTTRxHwObjectTriggerIdRef=(unset)
        CAN4_zGW_CANRr1_C50_0_522R: CanIfRxPduCanId=522, CanIfRxPduCanIdType=STANDARD_FD_CAN, CanIfRxPduDlc=32, CanIfRxPduTargetPduID=(unset), CanIfRxPduUserRxIndicationUL=PDUR, CanIfRxPduId=36, CanIfRxPduHrhIdRef=HOH_7_CAN4, CanIfRxPduRef=CAN4_zGW_CANRr1_C50_0_522R, CanIfRxPduUpperLayerRef=(unset)
          CanIfTTRxFrameTriggering: CanIfTTRxHwObjectTriggerIdRef=(unset)
        CAN1_NMm_FUSION_RX_1280R: CanIfRxPduCanId=0, CanIfRxPduCanIdType=STANDARD_NO_FD_CAN, CanIfRxPduDlc=8, CanIfRxPduTargetPduID=(unset), CanIfRxPduUserRxIndicationUL=CAN_NM, CanIfRxPduId=37, CanIfRxPduHrhIdRef=HOH_1_CAN1, CanIfRxPduRef=CAN1_NMm_FUSION_RX_1280R, CanIfRxPduUpperLayerRef=(unset)
          CanIfRxPduCanIdRange: CanIfRxPduCanIdRangeLowerCanId=1280, CanIfRxPduCanIdRangeUpperCanId=1408
          CanIfTTRxFrameTriggering: CanIfTTRxHwObjectTriggerIdRef=(unset)
        CAN2_NMm_FUSION_RX_1280R: CanIfRxPduCanId=0, CanIfRxPduCanIdType=STANDARD_NO_FD_CAN, CanIfRxPduDlc=8, CanIfRxPduTargetPduID=(unset), CanIfRxPduUserRxIndicationUL=CAN_NM, CanIfRxPduId=38, CanIfRxPduHrhIdRef=HOH_1_CAN2, CanIfRxPduRef=CAN2_NMm_FUSION_RX_1280R, CanIfRxPduUpperLayerRef=(unset)
          CanIfRxPduCanIdRange: CanIfRxPduCanIdRangeLowerCanId=1280, CanIfRxPduCanIdRangeUpperCanId=1408
          CanIfTTRxFrameTriggering: CanIfTTRxHwObjectTriggerIdRef=(unset)
        CAN3_NMm_FUSION_RX_1280R: CanIfRxPduCanId=0, CanIfRxPduCanIdType=STANDARD_NO_FD_CAN, CanIfRxPduDlc=8, CanIfRxPduTargetPduID=(unset), CanIfRxPduUserRxIndicationUL=CAN_NM, CanIfRxPduId=39, CanIfRxPduHrhIdRef=HOH_1_CAN3, CanIfRxPduRef=CAN3_NMm_FUSION_RX_1280R, CanIfRxPduUpperLayerRef=(unset)
          CanIfRxPduCanIdRange: CanIfRxPduCanIdRangeLowerCanId=1280, CanIfRxPduCanIdRangeUpperCanId=1408
          CanIfTTRxFrameTriggering: CanIfTTRxHwObjectTriggerIdRef=(unset)
        CAN4_NMm_FUSION_RX_1280R: CanIfRxPduCanId=0, CanIfRxPduCanIdType=STANDARD_NO_FD_CAN, CanIfRxPduDlc=8, CanIfRxPduTargetPduID=(unset), CanIfRxPduUserRxIndicationUL=CAN_NM, CanIfRxPduId=40, CanIfRxPduHrhIdRef=HOH_1_CAN4, CanIfRxPduRef=CAN4_NMm_FUSION_RX_1280R, CanIfRxPduUpperLayerRef=(unset)
          CanIfRxPduCanIdRange: CanIfRxPduCanIdRangeLowerCanId=1280, CanIfRxPduCanIdRangeUpperCanId=1408
          CanIfTTRxFrameTriggering: CanIfTTRxHwObjectTriggerIdRef=(unset)
        CAN5_NMm_FUSION_RX_1280R: CanIfRxPduCanId=0, CanIfRxPduCanIdType=STANDARD_NO_FD_CAN, CanIfRxPduDlc=8, CanIfRxPduTargetPduID=(unset), CanIfRxPduUserRxIndicationUL=CAN_NM, CanIfRxPduId=41, CanIfRxPduHrhIdRef=HOH_1_CAN5, CanIfRxPduRef=CAN5_NMm_FUSION_RX_1280R, CanIfRxPduUpperLayerRef=(unset)
          CanIfRxPduCanIdRange: CanIfRxPduCanIdRangeLowerCanId=1280, CanIfRxPduCanIdRangeUpperCanId=1408
          CanIfTTRxFrameTriggering: CanIfTTRxHwObjectTriggerIdRef=(unset)
        CAN6_NMm_FUSION_RX_1280R: CanIfRxPduCanId=0, CanIfRxPduCanIdType=STANDARD_NO_FD_CAN, CanIfRxPduDlc=8, CanIfRxPduTargetPduID=(unset), CanIfRxPduUserRxIndicationUL=CAN_NM, CanIfRxPduId=42, CanIfRxPduHrhIdRef=HOH_1_CAN6, CanIfRxPduRef=CAN6_NMm_FUSION_RX_1280R, CanIfRxPduUpperLayerRef=(unset)
          CanIfRxPduCanIdRange: CanIfRxPduCanIdRangeLowerCanId=1280, CanIfRxPduCanIdRangeUpperCanId=1408
          CanIfTTRxFrameTriggering: CanIfTTRxHwObjectTriggerIdRef=(unset)
        CAN7_NMm_FUSION_RX_1280R: CanIfRxPduCanId=0, CanIfRxPduCanIdType=STANDARD_NO_FD_CAN, CanIfRxPduDlc=8, CanIfRxPduTargetPduID=(unset), CanIfRxPduUserRxIndicationUL=CAN_NM, CanIfRxPduId=43, CanIfRxPduHrhIdRef=HOH_1_CAN7, CanIfRxPduRef=CAN7_NMm_FUSION_RX_1280R, CanIfRxPduUpperLayerRef=(unset)
          CanIfRxPduCanIdRange: CanIfRxPduCanIdRangeLowerCanId=1280, CanIfRxPduCanIdRangeUpperCanId=1408
          CanIfTTRxFrameTriggering: CanIfTTRxHwObjectTriggerIdRef=(unset)
        XCP_1639R: CanIfRxPduCanId=1639, CanIfRxPduCanIdType=STANDARD_CAN, CanIfRxPduDlc=0, CanIfRxPduTargetPduID=0, CanIfRxPduUserRxIndicationUL=CDD, CanIfRxPduId=44, CanIfRxPduHrhIdRef=HOH_1_Can8_Xcp, CanIfRxPduRef=XCP_1639R, CanIfRxPduUpperLayerRef=XCP
          CanIfTTRxFrameTriggering: CanIfTTRxHwObjectTriggerIdRef=(unset)
      81 x CanIfTxPduCfg, all with CanIfTxPduCanIdMask=536870911, CanIfTxPduPnFilterPdu=0, CanIfTxPduReadNotifyStatus=0, CanIfTxPduTruncateToFrame=1, CanIfTxPduTruncation=1, CanIfTxPduType=STATIC, CanIfTxPduUserTxConfirmationName=, CanIfTxPduBswSchExclAreaIdRef=(unset):
        CAN1_DiagFuncReqFT_2000T: CanIfTxPduCanId=2000, CanIfTxPduCanIdType=STANDARD_CAN, CanIfTxPduDlc=8, CanIfTxPduSourcePduID=0, CanIfTxPduUserTxConfirmationUL=CDD, CanIfTxPduBufferRef=CanIfInitCfg/HOH_TX_0_CAN1, CanIfTxPduRef=CAN1_DiagFuncReqFT_2000T, CanIfTxPduUpperLayerRef=CAN_PASS
          CanIfTTTxFrameTriggering: CanIfTTTxHwObjectTriggerIdRef=(unset)
        CAN1_DiagPhyReqToAC_BTMS_416977401T: CanIfTxPduCanId=416977401, CanIfTxPduCanIdType=EXTENDED_CAN, CanIfTxPduDlc=8, CanIfTxPduSourcePduID=1, CanIfTxPduUserTxConfirmationUL=CDD, CanIfTxPduBufferRef=CanIfInitCfg/HOH_TX_0_CAN1, CanIfTxPduRef=CAN1_DiagPhyReqToAC_BTMS_416977401T, CanIfTxPduUpperLayerRef=CAN_PASS
          CanIfTTTxFrameTriggering: CanIfTTTxHwObjectTriggerIdRef=(unset)
        CAN1_DiagPhyReqToBSD_L_416974073T: CanIfTxPduCanId=416974073, CanIfTxPduCanIdType=EXTENDED_CAN, CanIfTxPduDlc=8, CanIfTxPduSourcePduID=2, CanIfTxPduUserTxConfirmationUL=CDD, CanIfTxPduBufferRef=CanIfInitCfg/HOH_TX_0_CAN1, CanIfTxPduRef=CAN1_DiagPhyReqToBSD_L_416974073T, CanIfTxPduUpperLayerRef=CAN_PASS
          CanIfTTTxFrameTriggering: CanIfTTTxHwObjectTriggerIdRef=(unset)
        CAN1_DiagPhyReqToBSD_R_416973817T: CanIfTxPduCanId=416973817, CanIfTxPduCanIdType=EXTENDED_CAN, CanIfTxPduDlc=8, CanIfTxPduSourcePduID=3, CanIfTxPduUserTxConfirmationUL=CDD, CanIfTxPduBufferRef=CanIfInitCfg/HOH_TX_0_CAN1, CanIfTxPduRef=CAN1_DiagPhyReqToBSD_R_416973817T, CanIfTxPduUpperLayerRef=CAN_PASS
          CanIfTTTxFrameTriggering: CanIfTTTxHwObjectTriggerIdRef=(unset)
        CAN1_DiagPhyReqToECAS_416974585T: CanIfTxPduCanId=416974585, CanIfTxPduCanIdType=EXTENDED_CAN, CanIfTxPduDlc=8, CanIfTxPduSourcePduID=4, CanIfTxPduUserTxConfirmationUL=CDD, CanIfTxPduBufferRef=CanIfInitCfg/HOH_TX_0_CAN1, CanIfTxPduRef=CAN1_DiagPhyReqToECAS_416974585T, CanIfTxPduUpperLayerRef=CAN_PASS
          CanIfTTTxFrameTriggering: CanIfTTTxHwObjectTriggerIdRef=(unset)
        CAN1_DiagPhyReqToSAS_416974329T: CanIfTxPduCanId=416974329, CanIfTxPduCanIdType=EXTENDED_CAN, CanIfTxPduDlc=8, CanIfTxPduSourcePduID=5, CanIfTxPduUserTxConfirmationUL=CDD, CanIfTxPduBufferRef=CanIfInitCfg/HOH_TX_0_CAN1, CanIfTxPduRef=CAN1_DiagPhyReqToSAS_416974329T, CanIfTxPduUpperLayerRef=CAN_PASS
          CanIfTTTxFrameTriggering: CanIfTTTxHwObjectTriggerIdRef=(unset)
        CAN1_DiagPhysReqToDMB_416941817T: CanIfTxPduCanId=416941817, CanIfTxPduCanIdType=EXTENDED_CAN, CanIfTxPduDlc=8, CanIfTxPduSourcePduID=6, CanIfTxPduUserTxConfirmationUL=CDD, CanIfTxPduBufferRef=CanIfInitCfg/HOH_TX_0_CAN1, CanIfTxPduRef=CAN1_DiagPhysReqToDMB_416941817T, CanIfTxPduUpperLayerRef=CAN_PASS
          CanIfTTTxFrameTriggering: CanIfTTTxHwObjectTriggerIdRef=(unset)
        CAN1_DiagPhysReqToEBS3_416943097T: CanIfTxPduCanId=416943097, CanIfTxPduCanIdType=EXTENDED_CAN, CanIfTxPduDlc=8, CanIfTxPduSourcePduID=7, CanIfTxPduUserTxConfirmationUL=CDD, CanIfTxPduBufferRef=CanIfInitCfg/HOH_TX_0_CAN1, CanIfTxPduRef=CAN1_DiagPhysReqToEBS3_416943097T, CanIfTxPduUpperLayerRef=CAN_PASS
          CanIfTTTxFrameTriggering: CanIfTTTxHwObjectTriggerIdRef=(unset)
        CAN1_DiagPhysReqToTPMS_416953337T: CanIfTxPduCanId=416953337, CanIfTxPduCanIdType=EXTENDED_CAN, CanIfTxPduDlc=8, CanIfTxPduSourcePduID=8, CanIfTxPduUserTxConfirmationUL=CDD, CanIfTxPduBufferRef=CanIfInitCfg/HOH_TX_0_CAN1, CanIfTxPduRef=CAN1_DiagPhysReqToTPMS_416953337T, CanIfTxPduUpperLayerRef=CAN_PASS
          CanIfTTTxFrameTriggering: CanIfTTTxHwObjectTriggerIdRef=(unset)
        CAN1_FD1_C1000_0_419343920T: CanIfTxPduCanId=419343920, CanIfTxPduCanIdType=EXTENDED_CAN, CanIfTxPduDlc=8, CanIfTxPduSourcePduID=(unset), CanIfTxPduUserTxConfirmationUL=PDUR, CanIfTxPduBufferRef=CanIfInitCfg/HOH_TX_0_CAN1, CanIfTxPduRef=CAN1_FD1_C1000_0_419343920T, CanIfTxPduUpperLayerRef=(unset)
          CanIfTTTxFrameTriggering: CanIfTTTxHwObjectTriggerIdRef=(unset)
        CAN1_FD1_C100_0_419318275T: CanIfTxPduCanId=419318275, CanIfTxPduCanIdType=EXTENDED_CAN, CanIfTxPduDlc=8, CanIfTxPduSourcePduID=(unset), CanIfTxPduUserTxConfirmationUL=PDUR, CanIfTxPduBufferRef=CanIfInitCfg/HOH_TX_0_CAN1, CanIfTxPduRef=CAN1_FD1_C100_0_419318275T, CanIfTxPduUpperLayerRef=(unset)
          CanIfTTTxFrameTriggering: CanIfTTTxHwObjectTriggerIdRef=(unset)
        CAN1_FD1_C100_1_419389483T: CanIfTxPduCanId=419389483, CanIfTxPduCanIdType=EXTENDED_CAN, CanIfTxPduDlc=8, CanIfTxPduSourcePduID=(unset), CanIfTxPduUserTxConfirmationUL=PDUR, CanIfTxPduBufferRef=CanIfInitCfg/HOH_TX_0_CAN1, CanIfTxPduRef=CAN1_FD1_C100_1_419389483T, CanIfTxPduUpperLayerRef=(unset)
          CanIfTTTxFrameTriggering: CanIfTTTxHwObjectTriggerIdRef=(unset)
        CAN1_FD1_C100_2_435160528T: CanIfTxPduCanId=435160528, CanIfTxPduCanIdType=EXTENDED_CAN, CanIfTxPduDlc=8, CanIfTxPduSourcePduID=(unset), CanIfTxPduUserTxConfirmationUL=PDUR, CanIfTxPduBufferRef=CanIfInitCfg/HOH_TX_0_CAN1, CanIfTxPduRef=CAN1_FD1_C100_2_435160528T, CanIfTxPduUpperLayerRef=(unset)
          CanIfTTTxFrameTriggering: CanIfTTTxHwObjectTriggerIdRef=(unset)
        CAN1_FD1_C100_3_419361024T: CanIfTxPduCanId=419361024, CanIfTxPduCanIdType=EXTENDED_CAN, CanIfTxPduDlc=8, CanIfTxPduSourcePduID=(unset), CanIfTxPduUserTxConfirmationUL=PDUR, CanIfTxPduBufferRef=CanIfInitCfg/HOH_TX_0_CAN1, CanIfTxPduRef=CAN1_FD1_C100_3_419361024T, CanIfTxPduUpperLayerRef=(unset)
          CanIfTTTxFrameTriggering: CanIfTTTxHwObjectTriggerIdRef=(unset)
        CAN1_FD1_C10_0_207737041T: CanIfTxPduCanId=207737041, CanIfTxPduCanIdType=EXTENDED_CAN, CanIfTxPduDlc=8, CanIfTxPduSourcePduID=(unset), CanIfTxPduUserTxConfirmationUL=PDUR, CanIfTxPduBufferRef=CanIfInitCfg/HOH_TX_0_CAN1, CanIfTxPduRef=CAN1_FD1_C10_0_207737041T, CanIfTxPduUpperLayerRef=(unset)
          CanIfTTTxFrameTriggering: CanIfTTTxHwObjectTriggerIdRef=(unset)
        CAN1_FD1_C10_1_419373295T: CanIfTxPduCanId=419373295, CanIfTxPduCanIdType=EXTENDED_CAN, CanIfTxPduDlc=8, CanIfTxPduSourcePduID=(unset), CanIfTxPduUserTxConfirmationUL=PDUR, CanIfTxPduBufferRef=CanIfInitCfg/HOH_TX_0_CAN1, CanIfTxPduRef=CAN1_FD1_C10_1_419373295T, CanIfTxPduUpperLayerRef=(unset)
          CanIfTTTxFrameTriggering: CanIfTTTxHwObjectTriggerIdRef=(unset)
        CAN1_FD1_C200_0_418382831T: CanIfTxPduCanId=418382831, CanIfTxPduCanIdType=EXTENDED_CAN, CanIfTxPduDlc=8, CanIfTxPduSourcePduID=(unset), CanIfTxPduUserTxConfirmationUL=PDUR, CanIfTxPduBufferRef=CanIfInitCfg/HOH_TX_0_CAN1, CanIfTxPduRef=CAN1_FD1_C200_0_418382831T, CanIfTxPduUpperLayerRef=(unset)
          CanIfTTTxFrameTriggering: CanIfTTTxHwObjectTriggerIdRef=(unset)
        CAN1_FD1_C20_0_207802577T: CanIfTxPduCanId=207802577, CanIfTxPduCanIdType=EXTENDED_CAN, CanIfTxPduDlc=8, CanIfTxPduSourcePduID=(unset), CanIfTxPduUserTxConfirmationUL=PDUR, CanIfTxPduBufferRef=CanIfInitCfg/HOH_TX_0_CAN1, CanIfTxPduRef=CAN1_FD1_C20_0_207802577T, CanIfTxPduUpperLayerRef=(unset)
          CanIfTTTxFrameTriggering: CanIfTTTxHwObjectTriggerIdRef=(unset)
        CAN1_FD1_C250_0_419356655T: CanIfTxPduCanId=419356655, CanIfTxPduCanIdType=EXTENDED_CAN, CanIfTxPduDlc=8, CanIfTxPduSourcePduID=(unset), CanIfTxPduUserTxConfirmationUL=PDUR, CanIfTxPduBufferRef=CanIfInitCfg/HOH_TX_0_CAN1, CanIfTxPduRef=CAN1_FD1_C250_0_419356655T, CanIfTxPduUpperLayerRef=(unset)
          CanIfTTTxFrameTriggering: CanIfTTTxHwObjectTriggerIdRef=(unset)
        CAN1_FD1_C5000_0_419357167T: CanIfTxPduCanId=419357167, CanIfTxPduCanIdType=EXTENDED_CAN, CanIfTxPduDlc=19, CanIfTxPduSourcePduID=(unset), CanIfTxPduUserTxConfirmationUL=PDUR, CanIfTxPduBufferRef=CanIfInitCfg/HOH_TX_0_CAN1, CanIfTxPduRef=CAN1_FD1_C5000_0_419357167T, CanIfTxPduUpperLayerRef=(unset)
          CanIfTTTxFrameTriggering: CanIfTTTxHwObjectTriggerIdRef=(unset)
        CAN1_FD1_C5000_1_419357679T: CanIfTxPduCanId=419357679, CanIfTxPduCanIdType=EXTENDED_CAN, CanIfTxPduDlc=39, CanIfTxPduSourcePduID=(unset), CanIfTxPduUserTxConfirmationUL=PDUR, CanIfTxPduBufferRef=CanIfInitCfg/HOH_TX_0_CAN1, CanIfTxPduRef=CAN1_FD1_C5000_1_419357679T, CanIfTxPduUpperLayerRef=(unset)
          CanIfTTTxFrameTriggering: CanIfTTTxHwObjectTriggerIdRef=(unset)
        CAN1_FD1_C50_0_418383107T: CanIfTxPduCanId=418383107, CanIfTxPduCanIdType=EXTENDED_CAN, CanIfTxPduDlc=8, CanIfTxPduSourcePduID=(unset), CanIfTxPduUserTxConfirmationUL=PDUR, CanIfTxPduBufferRef=CanIfInitCfg/HOH_TX_0_CAN1, CanIfTxPduRef=CAN1_FD1_C50_0_418383107T, CanIfTxPduUpperLayerRef=(unset)
          CanIfTTTxFrameTriggering: CanIfTTTxHwObjectTriggerIdRef=(unset)
        CAN1_FD1_C50_1_217056000T: CanIfTxPduCanId=217056000, CanIfTxPduCanIdType=EXTENDED_CAN, CanIfTxPduDlc=8, CanIfTxPduSourcePduID=(unset), CanIfTxPduUserTxConfirmationUL=PDUR, CanIfTxPduBufferRef=CanIfInitCfg/HOH_TX_0_CAN1, CanIfTxPduRef=CAN1_FD1_C50_1_217056000T, CanIfTxPduUpperLayerRef=(unset)
          CanIfTTTxFrameTriggering: CanIfTTTxHwObjectTriggerIdRef=(unset)
        CAN1_FD1_C80_0_418382339T: CanIfTxPduCanId=418382339, CanIfTxPduCanIdType=EXTENDED_CAN, CanIfTxPduDlc=8, CanIfTxPduSourcePduID=(unset), CanIfTxPduUserTxConfirmationUL=PDUR, CanIfTxPduBufferRef=CanIfInitCfg/HOH_TX_0_CAN1, CanIfTxPduRef=CAN1_FD1_C80_0_418382339T, CanIfTxPduUpperLayerRef=(unset)
          CanIfTTTxFrameTriggering: CanIfTTTxHwObjectTriggerIdRef=(unset)
        CAN1_FD1_CE100_0_418119663T: CanIfTxPduCanId=418119663, CanIfTxPduCanIdType=EXTENDED_CAN, CanIfTxPduDlc=8, CanIfTxPduSourcePduID=(unset), CanIfTxPduUserTxConfirmationUL=PDUR, CanIfTxPduBufferRef=CanIfInitCfg/HOH_TX_0_CAN1, CanIfTxPduRef=CAN1_FD1_CE100_0_418119663T, CanIfTxPduUpperLayerRef=(unset)
          CanIfTTTxFrameTriggering: CanIfTTTxHwObjectTriggerIdRef=(unset)
        CAN1_FD1_CE100_1_418185199T: CanIfTxPduCanId=418185199, CanIfTxPduCanIdType=EXTENDED_CAN, CanIfTxPduDlc=8, CanIfTxPduSourcePduID=(unset), CanIfTxPduUserTxConfirmationUL=PDUR, CanIfTxPduBufferRef=CanIfInitCfg/HOH_TX_0_CAN1, CanIfTxPduRef=CAN1_FD1_CE100_1_418185199T, CanIfTxPduUpperLayerRef=(unset)
          CanIfTTTxFrameTriggering: CanIfTTTxHwObjectTriggerIdRef=(unset)
        CAN1_FD1_CE100_2_419038649T: CanIfTxPduCanId=419038649, CanIfTxPduCanIdType=EXTENDED_CAN, CanIfTxPduDlc=8, CanIfTxPduSourcePduID=(unset), CanIfTxPduUserTxConfirmationUL=PDUR, CanIfTxPduBufferRef=CanIfInitCfg/HOH_TX_0_CAN1, CanIfTxPduRef=CAN1_FD1_CE100_2_419038649T, CanIfTxPduUpperLayerRef=(unset)
          CanIfTTTxFrameTriggering: CanIfTTTxHwObjectTriggerIdRef=(unset)
        CAN1_NMm_FUSION_TX_1280T: CanIfTxPduCanId=1280, CanIfTxPduCanIdType=STANDARD_CAN, CanIfTxPduDlc=8, CanIfTxPduSourcePduID=(unset), CanIfTxPduUserTxConfirmationUL=CAN_NM, CanIfTxPduBufferRef=CanIfInitCfg/HOH_TX_0_CAN1, CanIfTxPduRef=CAN1_NMm_FUSION_TX_1280T, CanIfTxPduUpperLayerRef=(unset)
          CanIfTTTxFrameTriggering: CanIfTTTxHwObjectTriggerIdRef=(unset)
        CAN2_DiagFuncReqFT_2000T: CanIfTxPduCanId=2000, CanIfTxPduCanIdType=STANDARD_CAN, CanIfTxPduDlc=8, CanIfTxPduSourcePduID=9, CanIfTxPduUserTxConfirmationUL=CDD, CanIfTxPduBufferRef=CanIfInitCfg/HOH_TX_0_CAN2, CanIfTxPduRef=CAN2_DiagFuncReqFT_2000T, CanIfTxPduUpperLayerRef=CAN_PASS
          CanIfTTTxFrameTriggering: CanIfTTTxHwObjectTriggerIdRef=(unset)
        CAN2_DiagPhysReqToCMS_L_1762T: CanIfTxPduCanId=1762, CanIfTxPduCanIdType=STANDARD_FD_CAN, CanIfTxPduDlc=64, CanIfTxPduSourcePduID=10, CanIfTxPduUserTxConfirmationUL=CDD, CanIfTxPduBufferRef=CanIfInitCfg/HOH_TX_0_CAN2, CanIfTxPduRef=CAN2_DiagPhysReqToCMS_L_1762T, CanIfTxPduUpperLayerRef=CAN_PASS
          CanIfTTTxFrameTriggering: CanIfTTTxHwObjectTriggerIdRef=(unset)
        CAN2_DiagPhysReqToCMS_R_1763T: CanIfTxPduCanId=1763, CanIfTxPduCanIdType=STANDARD_FD_CAN, CanIfTxPduDlc=64, CanIfTxPduSourcePduID=11, CanIfTxPduUserTxConfirmationUL=CDD, CanIfTxPduBufferRef=CanIfInitCfg/HOH_TX_0_CAN2, CanIfTxPduRef=CAN2_DiagPhysReqToCMS_R_1763T, CanIfTxPduUpperLayerRef=CAN_PASS
          CanIfTTTxFrameTriggering: CanIfTTTxHwObjectTriggerIdRef=(unset)
        CAN2_DiagPhysReqToIVI_1696T: CanIfTxPduCanId=1696, CanIfTxPduCanIdType=STANDARD_FD_CAN, CanIfTxPduDlc=64, CanIfTxPduSourcePduID=12, CanIfTxPduUserTxConfirmationUL=CDD, CanIfTxPduBufferRef=CanIfInitCfg/HOH_TX_0_CAN2, CanIfTxPduRef=CAN2_DiagPhysReqToIVI_1696T, CanIfTxPduUpperLayerRef=CAN_PASS
          CanIfTTTxFrameTriggering: CanIfTTTxHwObjectTriggerIdRef=(unset)
        CAN2_DiagPhysReqToIVI_F_1760T: CanIfTxPduCanId=1760, CanIfTxPduCanIdType=STANDARD_FD_CAN, CanIfTxPduDlc=64, CanIfTxPduSourcePduID=13, CanIfTxPduUserTxConfirmationUL=CDD, CanIfTxPduBufferRef=CanIfInitCfg/HOH_TX_0_CAN2, CanIfTxPduRef=CAN2_DiagPhysReqToIVI_F_1760T, CanIfTxPduUpperLayerRef=CAN_PASS
          CanIfTTTxFrameTriggering: CanIfTTTxHwObjectTriggerIdRef=(unset)
        CAN2_DiagPhysReqToIVI_M_1761T: CanIfTxPduCanId=1761, CanIfTxPduCanIdType=STANDARD_FD_CAN, CanIfTxPduDlc=64, CanIfTxPduSourcePduID=14, CanIfTxPduUserTxConfirmationUL=CDD, CanIfTxPduBufferRef=CanIfInitCfg/HOH_TX_0_CAN2, CanIfTxPduRef=CAN2_DiagPhysReqToIVI_M_1761T, CanIfTxPduUpperLayerRef=CAN_PASS
          CanIfTTTxFrameTriggering: CanIfTTTxHwObjectTriggerIdRef=(unset)
        CAN2_DiagPhysReqToMETER_1666T: CanIfTxPduCanId=1666, CanIfTxPduCanIdType=STANDARD_FD_CAN, CanIfTxPduDlc=64, CanIfTxPduSourcePduID=15, CanIfTxPduUserTxConfirmationUL=CDD, CanIfTxPduBufferRef=CanIfInitCfg/HOH_TX_0_CAN2, CanIfTxPduRef=CAN2_DiagPhysReqToMETER_1666T, CanIfTxPduUpperLayerRef=CAN_PASS
          CanIfTTTxFrameTriggering: CanIfTTTxHwObjectTriggerIdRef=(unset)
        CAN2_FD2_C1000_0_526T: CanIfTxPduCanId=526, CanIfTxPduCanIdType=STANDARD_FD_CAN, CanIfTxPduDlc=64, CanIfTxPduSourcePduID=(unset), CanIfTxPduUserTxConfirmationUL=PDUR, CanIfTxPduBufferRef=CanIfInitCfg/HOH_TX_0_CAN2, CanIfTxPduRef=CAN2_FD2_C1000_0_526T, CanIfTxPduUpperLayerRef=(unset)
          CanIfTTTxFrameTriggering: CanIfTTTxHwObjectTriggerIdRef=(unset)
        CAN2_FD2_C10_0_207737041T: CanIfTxPduCanId=207737041, CanIfTxPduCanIdType=EXTENDED_CAN, CanIfTxPduDlc=8, CanIfTxPduSourcePduID=(unset), CanIfTxPduUserTxConfirmationUL=PDUR, CanIfTxPduBufferRef=CanIfInitCfg/HOH_TX_0_CAN2, CanIfTxPduRef=CAN2_FD2_C10_0_207737041T, CanIfTxPduUpperLayerRef=(unset)
          CanIfTTTxFrameTriggering: CanIfTTTxHwObjectTriggerIdRef=(unset)
        CAN2_FD2_C200_0_527T: CanIfTxPduCanId=527, CanIfTxPduCanIdType=STANDARD_FD_CAN, CanIfTxPduDlc=32, CanIfTxPduSourcePduID=(unset), CanIfTxPduUserTxConfirmationUL=PDUR, CanIfTxPduBufferRef=CanIfInitCfg/HOH_TX_0_CAN2, CanIfTxPduRef=CAN2_FD2_C200_0_527T, CanIfTxPduUpperLayerRef=(unset)
          CanIfTTTxFrameTriggering: CanIfTTTxHwObjectTriggerIdRef=(unset)
        CAN2_FD2_C500_0_419038487T: CanIfTxPduCanId=419038487, CanIfTxPduCanIdType=EXTENDED_CAN, CanIfTxPduDlc=8, CanIfTxPduSourcePduID=(unset), CanIfTxPduUserTxConfirmationUL=PDUR, CanIfTxPduBufferRef=CanIfInitCfg/HOH_TX_0_CAN2, CanIfTxPduRef=CAN2_FD2_C500_0_419038487T, CanIfTxPduUpperLayerRef=(unset)
          CanIfTTTxFrameTriggering: CanIfTTTxHwObjectTriggerIdRef=(unset)
        CAN2_FD2_C50_0_218051930T: CanIfTxPduCanId=218051930, CanIfTxPduCanIdType=EXTENDED_CAN, CanIfTxPduDlc=8, CanIfTxPduSourcePduID=(unset), CanIfTxPduUserTxConfirmationUL=PDUR, CanIfTxPduBufferRef=CanIfInitCfg/HOH_TX_0_CAN2, CanIfTxPduRef=CAN2_FD2_C50_0_218051930T, CanIfTxPduUpperLayerRef=(unset)
          CanIfTTTxFrameTriggering: CanIfTTTxHwObjectTriggerIdRef=(unset)
        CAN2_FD2_CE100_0_521T: CanIfTxPduCanId=521, CanIfTxPduCanIdType=STANDARD_FD_CAN, CanIfTxPduDlc=32, CanIfTxPduSourcePduID=(unset), CanIfTxPduUserTxConfirmationUL=PDUR, CanIfTxPduBufferRef=CanIfInitCfg/HOH_TX_0_CAN2, CanIfTxPduRef=CAN2_FD2_CE100_0_521T, CanIfTxPduUpperLayerRef=(unset)
          CanIfTTTxFrameTriggering: CanIfTTTxHwObjectTriggerIdRef=(unset)
        CAN2_GW2_C100_0_523T: CanIfTxPduCanId=523, CanIfTxPduCanIdType=STANDARD_FD_CAN, CanIfTxPduDlc=32, CanIfTxPduSourcePduID=(unset), CanIfTxPduUserTxConfirmationUL=PDUR, CanIfTxPduBufferRef=CanIfInitCfg/HOH_TX_0_CAN2, CanIfTxPduRef=CAN2_GW2_C100_0_523T, CanIfTxPduUpperLayerRef=(unset)
          CanIfTTTxFrameTriggering: CanIfTTTxHwObjectTriggerIdRef=(unset)
        CAN2_NMm_FUSION_TX_1280T: CanIfTxPduCanId=1280, CanIfTxPduCanIdType=STANDARD_CAN, CanIfTxPduDlc=8, CanIfTxPduSourcePduID=(unset), CanIfTxPduUserTxConfirmationUL=CAN_NM, CanIfTxPduBufferRef=CanIfInitCfg/HOH_TX_0_CAN2, CanIfTxPduRef=CAN2_NMm_FUSION_TX_1280T, CanIfTxPduUpperLayerRef=(unset)
          CanIfTTTxFrameTriggering: CanIfTTTxHwObjectTriggerIdRef=(unset)
        CAN3_DiagFuncReqFT_2000T: CanIfTxPduCanId=2000, CanIfTxPduCanIdType=STANDARD_CAN, CanIfTxPduDlc=8, CanIfTxPduSourcePduID=16, CanIfTxPduUserTxConfirmationUL=CDD, CanIfTxPduBufferRef=CanIfInitCfg/HOH_TX_0_CAN3, CanIfTxPduRef=CAN3_DiagFuncReqFT_2000T, CanIfTxPduUpperLayerRef=CAN_PASS
          CanIfTTTxFrameTriggering: CanIfTTTxHwObjectTriggerIdRef=(unset)
        CAN3_DiagPhyReqToEWP1_416974841T: CanIfTxPduCanId=416974841, CanIfTxPduCanIdType=EXTENDED_CAN, CanIfTxPduDlc=8, CanIfTxPduSourcePduID=17, CanIfTxPduUserTxConfirmationUL=CDD, CanIfTxPduBufferRef=CanIfInitCfg/HOH_TX_0_CAN3, CanIfTxPduRef=CAN3_DiagPhyReqToEWP1_416974841T, CanIfTxPduUpperLayerRef=CAN_PASS
          CanIfTTTxFrameTriggering: CanIfTTTxHwObjectTriggerIdRef=(unset)
        CAN3_DiagPhysReqToBMS_417002745T: CanIfTxPduCanId=417002745, CanIfTxPduCanIdType=EXTENDED_CAN, CanIfTxPduDlc=8, CanIfTxPduSourcePduID=18, CanIfTxPduUserTxConfirmationUL=CDD, CanIfTxPduBufferRef=CanIfInitCfg/HOH_TX_0_CAN3, CanIfTxPduRef=CAN3_DiagPhysReqToBMS_417002745T, CanIfTxPduUpperLayerRef=CAN_PASS
          CanIfTTTxFrameTriggering: CanIfTTTxHwObjectTriggerIdRef=(unset)
        CAN3_DiagPhysReqToMCU_416941561T: CanIfTxPduCanId=416941561, CanIfTxPduCanIdType=EXTENDED_CAN, CanIfTxPduDlc=8, CanIfTxPduSourcePduID=19, CanIfTxPduUserTxConfirmationUL=CDD, CanIfTxPduBufferRef=CanIfInitCfg/HOH_TX_0_CAN3, CanIfTxPduRef=CAN3_DiagPhysReqToMCU_416941561T, CanIfTxPduUpperLayerRef=CAN_PASS
          CanIfTTTxFrameTriggering: CanIfTTTxHwObjectTriggerIdRef=(unset)
        CAN3_FD3_C100_0_402846703T: CanIfTxPduCanId=402846703, CanIfTxPduCanIdType=EXTENDED_CAN, CanIfTxPduDlc=8, CanIfTxPduSourcePduID=(unset), CanIfTxPduUserTxConfirmationUL=PDUR, CanIfTxPduBufferRef=CanIfInitCfg/HOH_TX_0_CAN3, CanIfTxPduRef=CAN3_FD3_C100_0_402846703T, CanIfTxPduUpperLayerRef=(unset)
          CanIfTTTxFrameTriggering: CanIfTTTxHwObjectTriggerIdRef=(unset)
        CAN3_FD3_C10_0_217121232T: CanIfTxPduCanId=217121232, CanIfTxPduCanIdType=EXTENDED_CAN, CanIfTxPduDlc=8, CanIfTxPduSourcePduID=(unset), CanIfTxPduUserTxConfirmationUL=PDUR, CanIfTxPduBufferRef=CanIfInitCfg/HOH_TX_0_CAN3, CanIfTxPduRef=CAN3_FD3_C10_0_217121232T, CanIfTxPduUpperLayerRef=(unset)
          CanIfTTTxFrameTriggering: CanIfTTTxHwObjectTriggerIdRef=(unset)
        CAN3_FD3_C10_1_218039791T: CanIfTxPduCanId=218039791, CanIfTxPduCanIdType=EXTENDED_CAN, CanIfTxPduDlc=8, CanIfTxPduSourcePduID=(unset), CanIfTxPduUserTxConfirmationUL=PDUR, CanIfTxPduBufferRef=CanIfInitCfg/HOH_TX_0_CAN3, CanIfTxPduRef=CAN3_FD3_C10_1_218039791T, CanIfTxPduUpperLayerRef=(unset)
          CanIfTTTxFrameTriggering: CanIfTTTxHwObjectTriggerIdRef=(unset)
        CAN3_FD3_C200_0_418382831T: CanIfTxPduCanId=418382831, CanIfTxPduCanIdType=EXTENDED_CAN, CanIfTxPduDlc=8, CanIfTxPduSourcePduID=(unset), CanIfTxPduUserTxConfirmationUL=PDUR, CanIfTxPduBufferRef=CanIfInitCfg/HOH_TX_0_CAN3, CanIfTxPduRef=CAN3_FD3_C200_0_418382831T, CanIfTxPduUpperLayerRef=(unset)
          CanIfTTTxFrameTriggering: CanIfTTTxHwObjectTriggerIdRef=(unset)
        CAN3_FD3_C200_1_418382319T: CanIfTxPduCanId=418382319, CanIfTxPduCanIdType=EXTENDED_CAN, CanIfTxPduDlc=8, CanIfTxPduSourcePduID=(unset), CanIfTxPduUserTxConfirmationUL=PDUR, CanIfTxPduBufferRef=CanIfInitCfg/HOH_TX_0_CAN3, CanIfTxPduRef=CAN3_FD3_C200_1_418382319T, CanIfTxPduUpperLayerRef=(unset)
          CanIfTTTxFrameTriggering: CanIfTTTxHwObjectTriggerIdRef=(unset)
        CAN3_NMm_FUSION_TX_1280T: CanIfTxPduCanId=1280, CanIfTxPduCanIdType=STANDARD_CAN, CanIfTxPduDlc=8, CanIfTxPduSourcePduID=(unset), CanIfTxPduUserTxConfirmationUL=CAN_NM, CanIfTxPduBufferRef=CanIfInitCfg/HOH_TX_0_CAN3, CanIfTxPduRef=CAN3_NMm_FUSION_TX_1280T, CanIfTxPduUpperLayerRef=(unset)
          CanIfTTTxFrameTriggering: CanIfTTTxHwObjectTriggerIdRef=(unset)
        CAN4_DiagFuncReqFT_2000T: CanIfTxPduCanId=2000, CanIfTxPduCanIdType=STANDARD_CAN, CanIfTxPduDlc=8, CanIfTxPduSourcePduID=20, CanIfTxPduUserTxConfirmationUL=CDD, CanIfTxPduBufferRef=CanIfInitCfg/HOH_TX_0_CAN4, CanIfTxPduRef=CAN4_DiagFuncReqFT_2000T, CanIfTxPduUpperLayerRef=CAN_PASS
          CanIfTTTxFrameTriggering: CanIfTTTxHwObjectTriggerIdRef=(unset)
        CAN4_DiagPhysReqToZONE_FR_1668T: CanIfTxPduCanId=1668, CanIfTxPduCanIdType=STANDARD_FD_CAN, CanIfTxPduDlc=64, CanIfTxPduSourcePduID=21, CanIfTxPduUserTxConfirmationUL=CDD, CanIfTxPduBufferRef=CanIfInitCfg/HOH_TX_0_CAN4, CanIfTxPduRef=CAN4_DiagPhysReqToZONE_FR_1668T, CanIfTxPduUpperLayerRef=CAN_PASS
          CanIfTTTxFrameTriggering: CanIfTTTxHwObjectTriggerIdRef=(unset)
        CAN4_DiagPhysReqToZONE_RR_1764T: CanIfTxPduCanId=1764, CanIfTxPduCanIdType=STANDARD_FD_CAN, CanIfTxPduDlc=64, CanIfTxPduSourcePduID=22, CanIfTxPduUserTxConfirmationUL=CDD, CanIfTxPduBufferRef=CanIfInitCfg/HOH_TX_0_CAN4, CanIfTxPduRef=CAN4_DiagPhysReqToZONE_RR_1764T, CanIfTxPduUpperLayerRef=CAN_PASS
          CanIfTTTxFrameTriggering: CanIfTTTxHwObjectTriggerIdRef=(unset)
        CAN4_FD4_C100_0_217121744T: CanIfTxPduCanId=217121744, CanIfTxPduCanIdType=EXTENDED_CAN, CanIfTxPduDlc=8, CanIfTxPduSourcePduID=(unset), CanIfTxPduUserTxConfirmationUL=PDUR, CanIfTxPduBufferRef=CanIfInitCfg/HOH_TX_0_CAN4, CanIfTxPduRef=CAN4_FD4_C100_0_217121744T, CanIfTxPduUpperLayerRef=(unset)
          CanIfTTTxFrameTriggering: CanIfTTTxHwObjectTriggerIdRef=(unset)
        CAN4_FD4_C10_0_217121232T: CanIfTxPduCanId=217121232, CanIfTxPduCanIdType=EXTENDED_CAN, CanIfTxPduDlc=8, CanIfTxPduSourcePduID=(unset), CanIfTxPduUserTxConfirmationUL=PDUR, CanIfTxPduBufferRef=CanIfInitCfg/HOH_TX_0_CAN4, CanIfTxPduRef=CAN4_FD4_C10_0_217121232T, CanIfTxPduUpperLayerRef=(unset)
          CanIfTTTxFrameTriggering: CanIfTTTxHwObjectTriggerIdRef=(unset)
        CAN4_FD4_C200_0_418382831T: CanIfTxPduCanId=418382831, CanIfTxPduCanIdType=EXTENDED_CAN, CanIfTxPduDlc=8, CanIfTxPduSourcePduID=(unset), CanIfTxPduUserTxConfirmationUL=PDUR, CanIfTxPduBufferRef=CanIfInitCfg/HOH_TX_0_CAN4, CanIfTxPduRef=CAN4_FD4_C200_0_418382831T, CanIfTxPduUpperLayerRef=(unset)
          CanIfTTTxFrameTriggering: CanIfTTTxHwObjectTriggerIdRef=(unset)
        CAN4_FD4_CE100_0_521T: CanIfTxPduCanId=521, CanIfTxPduCanIdType=STANDARD_FD_CAN, CanIfTxPduDlc=32, CanIfTxPduSourcePduID=(unset), CanIfTxPduUserTxConfirmationUL=PDUR, CanIfTxPduBufferRef=CanIfInitCfg/HOH_TX_0_CAN4, CanIfTxPduRef=CAN4_FD4_CE100_0_521T, CanIfTxPduUpperLayerRef=(unset)
          CanIfTTTxFrameTriggering: CanIfTTTxHwObjectTriggerIdRef=(unset)
        CAN4_FD4_CE100_1_528T: CanIfTxPduCanId=528, CanIfTxPduCanIdType=STANDARD_FD_CAN, CanIfTxPduDlc=32, CanIfTxPduSourcePduID=(unset), CanIfTxPduUserTxConfirmationUL=PDUR, CanIfTxPduBufferRef=CanIfInitCfg/HOH_TX_0_CAN4, CanIfTxPduRef=CAN4_FD4_CE100_1_528T, CanIfTxPduUpperLayerRef=(unset)
          CanIfTTTxFrameTriggering: CanIfTTTxHwObjectTriggerIdRef=(unset)
        CAN4_NMm_FUSION_TX_1280T: CanIfTxPduCanId=1280, CanIfTxPduCanIdType=STANDARD_CAN, CanIfTxPduDlc=8, CanIfTxPduSourcePduID=(unset), CanIfTxPduUserTxConfirmationUL=CAN_NM, CanIfTxPduBufferRef=CanIfInitCfg/HOH_TX_0_CAN4, CanIfTxPduRef=CAN4_NMm_FUSION_TX_1280T, CanIfTxPduUpperLayerRef=(unset)
          CanIfTTTxFrameTriggering: CanIfTTTxHwObjectTriggerIdRef=(unset)
        CAN5_DiagFuncReqFT_2000T: CanIfTxPduCanId=2000, CanIfTxPduCanIdType=STANDARD_CAN, CanIfTxPduDlc=8, CanIfTxPduSourcePduID=23, CanIfTxPduUserTxConfirmationUL=CDD, CanIfTxPduBufferRef=CanIfInitCfg/HOH_TX_0_CAN5, CanIfTxPduRef=CAN5_DiagFuncReqFT_2000T, CanIfTxPduUpperLayerRef=CAN_PASS
          CanIfTTTxFrameTriggering: CanIfTTTxHwObjectTriggerIdRef=(unset)
        CAN5_DiagPhysReqToTBOX_1744T: CanIfTxPduCanId=1744, CanIfTxPduCanIdType=STANDARD_FD_CAN, CanIfTxPduDlc=64, CanIfTxPduSourcePduID=24, CanIfTxPduUserTxConfirmationUL=CDD, CanIfTxPduBufferRef=CanIfInitCfg/HOH_TX_0_CAN5, CanIfTxPduRef=CAN5_DiagPhysReqToTBOX_1744T, CanIfTxPduUpperLayerRef=CAN_PASS
          CanIfTTTxFrameTriggering: CanIfTTTxHwObjectTriggerIdRef=(unset)
        CAN5_FD5_C100_0_418597072T: CanIfTxPduCanId=418597072, CanIfTxPduCanIdType=EXTENDED_CAN, CanIfTxPduDlc=8, CanIfTxPduSourcePduID=(unset), CanIfTxPduUserTxConfirmationUL=PDUR, CanIfTxPduBufferRef=CanIfInitCfg/HOH_TX_0_CAN5, CanIfTxPduRef=CAN5_FD5_C100_0_418597072T, CanIfTxPduUpperLayerRef=(unset)
          CanIfTTTxFrameTriggering: CanIfTTTxHwObjectTriggerIdRef=(unset)
        CAN5_FD5_C200_0_525T: CanIfTxPduCanId=525, CanIfTxPduCanIdType=STANDARD_FD_CAN, CanIfTxPduDlc=32, CanIfTxPduSourcePduID=(unset), CanIfTxPduUserTxConfirmationUL=PDUR, CanIfTxPduBufferRef=CanIfInitCfg/HOH_TX_0_CAN5, CanIfTxPduRef=CAN5_FD5_C200_0_525T, CanIfTxPduUpperLayerRef=(unset)
          CanIfTTTxFrameTriggering: CanIfTTTxHwObjectTriggerIdRef=(unset)
        CAN5_NMm_FUSION_TX_1280T: CanIfTxPduCanId=1280, CanIfTxPduCanIdType=STANDARD_CAN, CanIfTxPduDlc=8, CanIfTxPduSourcePduID=(unset), CanIfTxPduUserTxConfirmationUL=CAN_NM, CanIfTxPduBufferRef=CanIfInitCfg/HOH_TX_0_CAN5, CanIfTxPduRef=CAN5_NMm_FUSION_TX_1280T, CanIfTxPduUpperLayerRef=(unset)
          CanIfTTTxFrameTriggering: CanIfTTTxHwObjectTriggerIdRef=(unset)
        CAN6_DiagFuncReqFT_2000T: CanIfTxPduCanId=2000, CanIfTxPduCanIdType=STANDARD_CAN, CanIfTxPduDlc=8, CanIfTxPduSourcePduID=25, CanIfTxPduUserTxConfirmationUL=CDD, CanIfTxPduBufferRef=CanIfInitCfg/HOH_TX_0_CAN6, CanIfTxPduRef=CAN6_DiagFuncReqFT_2000T, CanIfTxPduUpperLayerRef=CAN_PASS
          CanIfTTTxFrameTriggering: CanIfTTTxHwObjectTriggerIdRef=(unset)
        CAN6_FD6_C200_0_524T: CanIfTxPduCanId=524, CanIfTxPduCanIdType=STANDARD_FD_CAN, CanIfTxPduDlc=32, CanIfTxPduSourcePduID=(unset), CanIfTxPduUserTxConfirmationUL=PDUR, CanIfTxPduBufferRef=CanIfInitCfg/HOH_TX_0_CAN6, CanIfTxPduRef=CAN6_FD6_C200_0_524T, CanIfTxPduUpperLayerRef=(unset)
          CanIfTTTxFrameTriggering: CanIfTTTxHwObjectTriggerIdRef=(unset)
        CAN6_NMm_FUSION_TX_1280T: CanIfTxPduCanId=1280, CanIfTxPduCanIdType=STANDARD_CAN, CanIfTxPduDlc=8, CanIfTxPduSourcePduID=(unset), CanIfTxPduUserTxConfirmationUL=CAN_NM, CanIfTxPduBufferRef=CanIfInitCfg/HOH_TX_0_CAN6, CanIfTxPduRef=CAN6_NMm_FUSION_TX_1280T, CanIfTxPduUpperLayerRef=(unset)
          CanIfTTTxFrameTriggering: CanIfTTTxHwObjectTriggerIdRef=(unset)
        CAN7_DiagFuncReqFT_2000T: CanIfTxPduCanId=2000, CanIfTxPduCanIdType=STANDARD_CAN, CanIfTxPduDlc=8, CanIfTxPduSourcePduID=26, CanIfTxPduUserTxConfirmationUL=CDD, CanIfTxPduBufferRef=CanIfInitCfg/HOH_TX_0_CAN7, CanIfTxPduRef=CAN7_DiagFuncReqFT_2000T, CanIfTxPduUpperLayerRef=CAN_PASS
          CanIfTTTxFrameTriggering: CanIfTTTxHwObjectTriggerIdRef=(unset)
        CAN7_DiagPhyReqToDATAC_416975353T: CanIfTxPduCanId=416975353, CanIfTxPduCanIdType=EXTENDED_CAN, CanIfTxPduDlc=8, CanIfTxPduSourcePduID=27, CanIfTxPduUserTxConfirmationUL=CDD, CanIfTxPduBufferRef=CanIfInitCfg/HOH_TX_0_CAN7, CanIfTxPduRef=CAN7_DiagPhyReqToDATAC_416975353T, CanIfTxPduUpperLayerRef=CAN_PASS
          CanIfTTTxFrameTriggering: CanIfTTTxHwObjectTriggerIdRef=(unset)
        CAN7_DiagPhyReqToEDR_416975097T: CanIfTxPduCanId=416975097, CanIfTxPduCanIdType=EXTENDED_CAN, CanIfTxPduDlc=8, CanIfTxPduSourcePduID=28, CanIfTxPduUserTxConfirmationUL=CDD, CanIfTxPduBufferRef=CanIfInitCfg/HOH_TX_0_CAN7, CanIfTxPduRef=CAN7_DiagPhyReqToEDR_416975097T, CanIfTxPduUpperLayerRef=CAN_PASS
          CanIfTTTxFrameTriggering: CanIfTTTxHwObjectTriggerIdRef=(unset)
        CAN7_DiagPhyReqToNSAS_416977145T: CanIfTxPduCanId=416977145, CanIfTxPduCanIdType=EXTENDED_CAN, CanIfTxPduDlc=8, CanIfTxPduSourcePduID=29, CanIfTxPduUserTxConfirmationUL=CDD, CanIfTxPduBufferRef=CanIfInitCfg/HOH_TX_0_CAN7, CanIfTxPduRef=CAN7_DiagPhyReqToNSAS_416977145T, CanIfTxPduUpperLayerRef=CAN_PASS
          CanIfTTTxFrameTriggering: CanIfTTTxHwObjectTriggerIdRef=(unset)
        CAN7_FD7_C100_0_435160528T: CanIfTxPduCanId=435160528, CanIfTxPduCanIdType=EXTENDED_CAN, CanIfTxPduDlc=8, CanIfTxPduSourcePduID=(unset), CanIfTxPduUserTxConfirmationUL=PDUR, CanIfTxPduBufferRef=CanIfInitCfg/HOH_TX_0_CAN7, CanIfTxPduRef=CAN7_FD7_C100_0_435160528T, CanIfTxPduUpperLayerRef=(unset)
          CanIfTTTxFrameTriggering: CanIfTTTxHwObjectTriggerIdRef=(unset)
        CAN7_FD7_C10_0_207737041T: CanIfTxPduCanId=207737041, CanIfTxPduCanIdType=EXTENDED_CAN, CanIfTxPduDlc=8, CanIfTxPduSourcePduID=(unset), CanIfTxPduUserTxConfirmationUL=PDUR, CanIfTxPduBufferRef=CanIfInitCfg/HOH_TX_0_CAN7, CanIfTxPduRef=CAN7_FD7_C10_0_207737041T, CanIfTxPduUpperLayerRef=(unset)
          CanIfTTTxFrameTriggering: CanIfTTTxHwObjectTriggerIdRef=(unset)
        CAN7_FD7_C200_0_418382831T: CanIfTxPduCanId=418382831, CanIfTxPduCanIdType=EXTENDED_CAN, CanIfTxPduDlc=8, CanIfTxPduSourcePduID=(unset), CanIfTxPduUserTxConfirmationUL=PDUR, CanIfTxPduBufferRef=CanIfInitCfg/HOH_TX_0_CAN7, CanIfTxPduRef=CAN7_FD7_C200_0_418382831T, CanIfTxPduUpperLayerRef=(unset)
          CanIfTTTxFrameTriggering: CanIfTTTxHwObjectTriggerIdRef=(unset)
        CAN7_FD7_C50_0_217056000T: CanIfTxPduCanId=217056000, CanIfTxPduCanIdType=EXTENDED_CAN, CanIfTxPduDlc=8, CanIfTxPduSourcePduID=(unset), CanIfTxPduUserTxConfirmationUL=PDUR, CanIfTxPduBufferRef=CanIfInitCfg/HOH_TX_0_CAN7, CanIfTxPduRef=CAN7_FD7_C50_0_217056000T, CanIfTxPduUpperLayerRef=(unset)
          CanIfTTTxFrameTriggering: CanIfTTTxHwObjectTriggerIdRef=(unset)
        CAN7_FD7_CE100_0_419038649T: CanIfTxPduCanId=419038649, CanIfTxPduCanIdType=EXTENDED_CAN, CanIfTxPduDlc=8, CanIfTxPduSourcePduID=(unset), CanIfTxPduUserTxConfirmationUL=PDUR, CanIfTxPduBufferRef=CanIfInitCfg/HOH_TX_0_CAN7, CanIfTxPduRef=CAN7_FD7_CE100_0_419038649T, CanIfTxPduUpperLayerRef=(unset)
          CanIfTTTxFrameTriggering: CanIfTTTxHwObjectTriggerIdRef=(unset)
        CAN7_NMm_FUSION_TX_1280T: CanIfTxPduCanId=1280, CanIfTxPduCanIdType=STANDARD_CAN, CanIfTxPduDlc=8, CanIfTxPduSourcePduID=(unset), CanIfTxPduUserTxConfirmationUL=CAN_NM, CanIfTxPduBufferRef=CanIfInitCfg/HOH_TX_0_CAN7, CanIfTxPduRef=CAN7_NMm_FUSION_TX_1280T, CanIfTxPduUpperLayerRef=(unset)
          CanIfTTTxFrameTriggering: CanIfTTTxHwObjectTriggerIdRef=(unset)
        XCP_1569T: CanIfTxPduCanId=1569, CanIfTxPduCanIdType=STANDARD_FD_CAN, CanIfTxPduDlc=8, CanIfTxPduSourcePduID=0, CanIfTxPduUserTxConfirmationUL=CDD, CanIfTxPduBufferRef=CanIfInitCfg/HOH_0_Can8_Xcp, CanIfTxPduRef=XCP_1569T, CanIfTxPduUpperLayerRef=XCP
          CanIfTTTxFrameTriggering: CanIfTTTxHwObjectTriggerIdRef=(unset)
    CanIfMirroringSupport:
      CanIfCanControllerErrorStateSupported = 0
      CanIfCanTxErrorCounterSupported = 0
      CanIfErrorStateValue = CAN_ERRORSTATE_ACTIVE
      CanIfMirrorToCDDReportingEnable = 0
      CanIfMirrorToCDDReportingFunctionName = (unset)
      CanIfMirrorToCDDReportingHeader = (unset)
      CanIfTxErrorCounterValue = 0
      TxMirrorBufferSize = (unset)
      TxMirrorNumTxPdus = (unset)
    CanIfPrivateCfg: CanIfPrivateDlcCheck=1, CanIfPrivateSoftwareFilterType=BINARY, CanIfSupportTTCAN=0
      CanIfTTGeneral: CanIfTTJoblist=0, CanIfTTMaxIsrDelay=(unset)
    CanIfPublicCfg:
      CanIfBusMirroringSupport = 0
      CanIfCanDriverCompatibility = ASR440
      CanIfDecoupledProcessingSupport = 0
      CanIfDetReportRuntimeError = 0
      CanIfEnableSecurityEventReporting = 0
      CanIfHookOnReceptionSupport = 0
      CanIfMetaDataSupport = 0
      CanIfMultiCoreSupport = 0
      CanIfPublicCanIdTypeEnum = UINT32
      CanIfPublicCancelTransmitSupport = 0
      CanIfPublicCddHeaderFile = Xcp_Cbk.h
      CanIfPublicCddHeaderFile = can_passthrough_handler.h
      CanIfPublicChangeBaudrateSupport = 0
      CanIfPublicCtrlWakeupSupport = 0
      CanIfPublicDevErrorDetect = 0
      CanIfPublicHandleTypeEnum = UINT8
      CanIfPublicHohTranslationOpt = 0
      CanIfPublicMaxDynTxPdus = 8
      CanIfPublicMaxHths = 150
      CanIfPublicMaxRxBuffer = 72
      CanIfPublicMaxRxNotifyPdus = 64
      CanIfPublicMaxTxBufferSize = 8192
      CanIfPublicMaxTxBuffers = 128
      CanIfPublicMaxTxNotifyPdus = 64
      CanIfPublicMultipleDrvSupport = 1
      CanIfPublicNumberOfCanHwUnits = 1
      CanIfPublicPnSupport = 0
      CanIfPublicRangeReceptionSupport = 1
      CanIfPublicReadRxPduDataApi = 0
      CanIfPublicReadRxPduNotifyStatusApi = 1
      CanIfPublicReadTxPduNotifyStatusApi = 0
      CanIfPublicSetDynamicTxIdApi = 0
      CanIfPublicSingleCtrlOpt = 0
      CanIfPublicTrcvWakeupSupport = 1
      CanIfPublicTxBuffering = 1
      CanIfPublicTxConfirmPollingSupport = 1
      CanIfPublicVersionInfoApi = 0
      CanIfPublicWakeupCheckValidByNM = 0
      CanIfPublicWakeupCheckValidSupport = 0
      CanIfRelocatablePbcfgEnable = 1
      CanIfSetBaudrateApi = 0
      CanIfSingleCanTrcvAPIInfixEnable = 1
      CanIfSoftwareFilteringSupport = 1
      CanIfTxOfflineActiveSupport = 0
      CanIfValidateWakeupOnStartedCtrlOnly = 0
      CanIfSecurityEventRefs
    4 x CanIfUpperLayerConfig, all with CanIfPublicTxConfResultSupport=0, CanIfUpperLayerUseCanId=0, CanIfUseCddHandleIds=0:
      CAN_NM: CanIfRxPduUserRxIndicationName=CanNm_RxIndication, CanIfTxPduUserTxConfirmationName=CanNm_TxConfirmation
      CAN_PASS: CanIfRxPduUserRxIndicationName=CanPass_RxIndication, CanIfTxPduUserTxConfirmationName=CanPass_TxConfirmation
      PDUR: CanIfRxPduUserRxIndicationName=PduR_CanIfRxIndication, CanIfTxPduUserTxConfirmationName=PduR_CanIfTxConfirmation
      XCP: CanIfRxPduUserRxIndicationName=Xcp_CanIfRxIndication, CanIfTxPduUserTxConfirmationName=Xcp_CanIfTxConfirmation
