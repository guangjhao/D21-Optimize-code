[part 1 of 2: packages /CAN2/ISignalGroup to /CAN2/Cluster]
AUTOSAR XML (schema 4-3-0)
package /CAN2/ISignalGroup
  19 x i signal group:
    CAN2_SG_FD2_C20_0: i-signal=[CAN2_APS_ExitCondition, CAN2_APS_RQ_Display, CAN2_APS_SW_Ver, CAN2_APS_Sta_System, CAN2_CAAS_Sta, CAN2_DISC_DISCTargetSpd, CAN2_FDC_VCU_RegenLimInd_Sta, CAN2_FDC_VCU_RegenMode_Sta, CAN2_FDC_VCU_SimSound_Cmd, CAN2_FDC_VCU_SmartEcoSpdLim_Sta, CAN2_FDC_VCU_SmartEco_Sta, CAN2_FDC_VMC_SetSpdDisp_Sta, CAN2_FDC_VMC_SetSpd_Sta, CAN2_FDC_VMC_SpdCtrlMode_Sta, CAN2_FDC_VMC_SpdCtrl_Sta, CAN2_PAS_A_FCL, CAN2_PAS_A_FCR, CAN2_PAS_A_FML, CAN2_PAS_A_FMR, CAN2_PAS_A_RCL, CAN2_PAS_A_RCR, CAN2_PAS_A_RML, CAN2_PAS_A_RMR, CAN2_PAS_Chime, CAN2_PAS_D_FCL, CAN2_PAS_D_FCR, CAN2_PAS_D_FML, CAN2_PAS_D_FMR, CAN2_PAS_D_RCL, CAN2_PAS_D_RCR, CAN2_PAS_D_RML, CAN2_PAS_D_RMR, CAN2_PAS_SNSR_Layout, CAN2_USS_Sta_FCL, CAN2_USS_Sta_FCR, CAN2_USS_Sta_FLL, CAN2_USS_Sta_FLR, CAN2_USS_Sta_FML, CAN2_USS_Sta_FMR, CAN2_USS_Sta_RCL, CAN2_USS_Sta_RCR, CAN2_USS_Sta_RLL, CAN2_USS_Sta_RLR, CAN2_USS_Sta_RML, CAN2_USS_Sta_RMR, CAN2_VMC_VCU_CC_Crl_Sta, CAN2_VMC_VCU_MSA_Crl_Sta], system-signal-group=CAN2_SG_FD2_C20_0
    CAN2_SG_FD2_CE100_0: i-signal=[CAN2_APMDoorControlSta, CAN2_ActAPSPosn, CAN2_AllDoorSW, CAN2_AntitheftSta, CAN2_BCM_DoorLock_Sta, CAN2_BrakeLamp, CAN2_CCMSA_SpdWar, CAN2_CCU_ACLampSts, CAN2_CCU_ACMaxLampSts, CAN2_CCU_AutoLampSts, CAN2_CCU_AutoMidLampSts, CAN2_CCU_Dispaly_Request, CAN2_CCU_EcoSts, CAN2_CCU_FrtOnOffLampSts, CAN2_CCU_RrOnOffLampSts, CAN2_CCU_SyncLampSts, CAN2_CC_Crl_Sta, CAN2_CoastDwModeStaChk, CAN2_CreepSW_Sta, CAN2_DISC_ButtSta, CAN2_DISC_Sta, CAN2_DemoModeStaChk, CAN2_Dimmer, CAN2_DimmerEN, CAN2_DisengageP_Fail, CAN2_DoorLockIND, CAN2_DrDoorSW, CAN2_Dr_SeatSta, CAN2_DynoModeStaChk, CAN2_EDriveSysErr_AccPedalErr, CAN2_EDriveSysErr_MCUErr, CAN2_EDriveSysErr_ShifterErr, CAN2_EDriveSysErr_VCUErr, CAN2_EVDriveMode, CAN2_Eng_AGSCloseSta, CAN2_Eng_ActvDmpDisabSta, CAN2_Eng_CoastDwSta, CAN2_Eng_PwrLockSta, CAN2_EngageP_Fail, CAN2_FDC_BCM_AutoWipHSpdEN_Sta, CAN2_FDC_BCM_HMIKey1Func_Sta, CAN2_FDC_BCM_HMIKey2Func_Sta, CAN2_FDC_BCM_HMIKey3Func_Sta, CAN2_FDC_BCM_HMIKey4Func_Sta, CAN2_FDC_BCM_HMIKey5Func_Sta, CAN2_FDC_BCM_HMIKey6Func_Sta, CAN2_FDC_BCM_HMIKey7Func_Sta, CAN2_FDC_BCM_HMIKey8Func_Sta, CAN2_FDC_RAPS_ErrWarn_Sta, CAN2_FDC_THCM_CLEVentY_Sta, CAN2_FDC_THCM_CLEVentZ_Sta, CAN2_FDC_THCM_CLVent_Sta, CAN2_FDC_THCM_CREVentY_Sta, CAN2_FDC_THCM_CREVentZ_Sta, CAN2_FDC_THCM_CRVent_Sta, CAN2_FDC_THCM_LEVentMode_Sta, CAN2_FDC_THCM_LEVentY_Sta, CAN2_FDC_THCM_LEVentZ_Sta, CAN2_FDC_THCM_LVent_Sta, CAN2_FDC_THCM_PreWPTCHeat_Sta, CAN2_FDC_THCM_REVentMode_Sta, CAN2_FDC_THCM_REVentY_Sta, CAN2_FDC_THCM_REVentZ_Sta, CAN2_FDC_THCM_RVent_Sta, CAN2_FDC_V2L_IVIV2LDischarg_Cmd, CAN2_FDC_VCU_LVChrgFreq_Sta, CAN2_FDC_VCU_LVStaDropQuick_Sta, CAN2_FDC_VCU_LVStaTooLow_Sta, CAN2_FDC_VCU_PwrSaveReq_Cmd, CAN2_FDC_VCU_TrailerDisOPD_Sta, CAN2_FD_ABS_Warning, CAN2_FD_AGS_Cmd, CAN2_FD_Battery_Charge_Warning, CAN2_FD_EBMErrSta, CAN2_FD_EDrive_System, CAN2_FD_EPB_Error, CAN2_FD_HV_Battery_Fault, CAN2_FD_Park_Brake_Warning, CAN2_FD_Power_limitation, CAN2_FD_Steering_Warning, CAN2_FD_TCS_Indicator, CAN2_FD_Telltale_Fail, CAN2_FalseNPrevent_Sta, CAN2_FeatSetSpdFinal_raw32, CAN2_FollowMe, CAN2_Fr_FogLamp, CAN2_HVRlyOpFail, CAN2_HVSysErr_IsolationErr, CAN2_HVSysErr_PackErr, CAN2_HVSysErr_RelayErr, CAN2_H_Beam, CAN2_HazardSW, CAN2_HoodSW, CAN2_LBSD, CAN2_LDRL, CAN2_LTurnLP, CAN2_LVChrgFuncStaChk, CAN2_LVSilentChrgReq, CAN2_LVSilentChrgSta, CAN2_LVSysErr_PwrOutpErr, CAN2_L_Beam, CAN2_LimphomeAct, CAN2_LockSetting, CAN2_MCUActDisFail, CAN2_MSA_Crl_Sta, CAN2_MeterIndSpeed_raw32, CAN2_PAS_Sta_F_Sys, CAN2_PosLamp, CAN2_PsDoorSW, CAN2_PwrSta, CAN2_PwrStaErr, CAN2_PwrStaONTOIVIPopReq, CAN2_PwrStaONTOIVIPopT, CAN2_RBSD, CAN2_RDRL, CAN2_RLDoorSW, CAN2_RRDoorSW, CAN2_RTurnLP, CAN2_Req_Internal_V2L_Status_Lamp, CAN2_Req_V2LSwOn, CAN2_Req_V2L_IVI_Popup, CAN2_ReverseLamp, CAN2_Rr_Defog, CAN2_Rr_FogLamp, CAN2_ShiftGearPosn, CAN2_SysAllowReadySta, CAN2_SysPwrSta, CAN2_Tailgate_SW, CAN2_VCUBrkSWSta, CAN2_VCUFLDoorSta, CAN2_VCUFRDoorSta, CAN2_VCUHoodSWSta, CAN2_VCURLDoorSta, CAN2_VCURRDoorSta, CAN2_VCUTailgateSWSta, CAN2_VCU_OPDHold, CAN2_VehMalfunLevel, CAN2_XWDMode, CAN2_sigAirIntenZon1St, CAN2_sigAirIntenZon3St, CAN2_sigAmbAirT, CAN2_sigCbnAirT, CAN2_sigDfrstSt, CAN2_sigHvacSt, CAN2_sigRecircSt, CAN2_sigSetTempZon1St, CAN2_sigSetTempZon2St, CAN2_sigSetTempZon3St, CAN2_sigWindDirZon1St, CAN2_sigWindDirZon3St], system-signal-group=CAN2_SG_FD2_CE100_0
    CAN2_SG_FD2_CE200_1: i-signal=[CAN2_AutoLTips, CAN2_CWheelTips, CAN2_FDC_BCM_Acc1Sta_Sta, CAN2_FDC_BCM_Acc2Sta_Sta, CAN2_FDC_BCM_Acc3Sta_Sta, CAN2_FDC_BCM_Acc4Sta_Sta, CAN2_FDC_BCM_Acc5Sta_Sta, CAN2_FDC_BCM_AmbBrightSta_Sta, CAN2_FDC_BCM_AmbColorSta_Sta, CAN2_FDC_BCM_AmbDimEN_Sta, CAN2_FDC_BCM_AmbFunEN_Sta, CAN2_FDC_BCM_AmbLinkDriSta_Sta, CAN2_FDC_BCM_AmbODAEN_Sta, CAN2_FDC_BCM_AmbPwrWarnEN_Sta, CAN2_FDC_BCM_AmbWelEN_Sta, CAN2_FDC_BCM_AutoLock_Sta, CAN2_FDC_BCM_AutoUnlock_Sta, CAN2_FDC_BCM_CLWinLockDr_Sta, CAN2_FDC_BCM_DSEATentryfset_Sta, CAN2_FDC_BCM_FollowMeENFun_Sta, CAN2_FDC_BCM_HBeamADB_Cmd, CAN2_FDC_BCM_Key10Acc_Sta, CAN2_FDC_BCM_Key1Acc_Sta, CAN2_FDC_BCM_Key2Acc_Sta, CAN2_FDC_BCM_Key3Acc_Sta, CAN2_FDC_BCM_Key4Acc_Sta, CAN2_FDC_BCM_Key5Acc_Sta, CAN2_FDC_BCM_Key6Acc_Sta, CAN2_FDC_BCM_Key7Acc_Sta, CAN2_FDC_BCM_Key8Acc_Sta, CAN2_FDC_BCM_Key9Acc_Sta, CAN2_FDC_BCM_LockAlarm_Cmd, CAN2_FDC_BCM_PTGOpenHeight_Sta, CAN2_FDC_BCM_RmLpModeENFun_Sta, CAN2_FDC_BCM_TurnSwTSetSta_Sta, CAN2_FDC_BCM_UserNow_Sta, CAN2_FDC_BCM_WalkInUnLkEnFun_Sta, CAN2_FDC_BCM_WalkOutLkEnFun_Sta, CAN2_FDC_DKC_DkeyShowIVI_Sta, CAN2_FDC_DKC_KeyMiss_Sta, CAN2_FDC_DKC_KeyNum_Sta, CAN2_FDC_DKC_KeyType_Sta, CAN2_FDC_DKC_UIDLowPower_Sta, CAN2_FDC_FGS_AirInt_Sta, CAN2_FDC_FGS_FGSCh_Sta, CAN2_FDC_FGS_IONSW_Sta, CAN2_FDC_SPTG_SPTGENFun_Sta, CAN2_FDC_THCM_APTCForceOFF_Sta, CAN2_FDC_THCM_APTCWarning_Sta, CAN2_FDC_THCM_AirIntZ3_Sta, CAN2_LFBatWarn, CAN2_LFPressIndi, CAN2_LFSensorFail, CAN2_LFWheelDebug, CAN2_LFWheelPSW, CAN2_LFWheelPress, CAN2_LFWheelShield, CAN2_LFWheelTemp, CAN2_LFWheelTmpIndi, CAN2_LRBatWarn, CAN2_LRPressIndi, CAN2_LRSensorFail, CAN2_LRWheelDebug, CAN2_LRWheelPSW, CAN2_LRWheelPress, CAN2_LRWheelShield, CAN2_LRWheelTemp, CAN2_LRWheelTmpIndi, CAN2_RFBatWarn, CAN2_RFPressIndi, CAN2_RFSensorFail, CAN2_RFWheelDebug, CAN2_RFWheelPSW, CAN2_RFWheelPress, CAN2_RFWheelShield, CAN2_RFWheelTemp, CAN2_RFWheelTmpIndi, CAN2_RRBatWarn, CAN2_RRPressIndi, CAN2_RRSensorFail, CAN2_RRWheelDebug, CAN2_RRWheelPSW, CAN2_RRWheelPress, CAN2_RRWheelShield, CAN2_RRWheelTemp, CAN2_RRWheelTmpIndi, CAN2_TPMSWarnIndi, CAN2_TPMS_Cali_Butt_Allow, CAN2_TPMS_Res_Butt_Allow], system-signal-group=CAN2_SG_FD2_CE200_1
    CAN2_SG_FD2_OTA1: i-signal=[CAN2_OTA_DL_Available, CAN2_OTA_DL_Speed, CAN2_OTA_Debug_Code, CAN2_OTA_Emergency_Sta, CAN2_OTA_InVehicle_FW, CAN2_OTA_Lock_Req, CAN2_OTA_MDA_Status, CAN2_OTA_Mode, CAN2_OTA_Network_Type, CAN2_OTA_Permit_Agreed, CAN2_OTA_Progress_Rate, CAN2_OTA_Remained_Time, CAN2_OTA_TBOXResetReq, CAN2_OTA_Update_Available, CAN2_OTA_Updating_ECU_8bit], system-signal-group=CAN2_SG_FD2_OTA1
    CAN2_SG_FD2_Version: i-signal=[CAN2_FUSION_HW_Ver1, CAN2_FUSION_HW_Ver2, CAN2_FUSION_HW_Ver3, CAN2_FUSION_SW_CarModel1, CAN2_FUSION_SW_CarModel2, CAN2_FUSION_SW_CarModel3, CAN2_FUSION_SW_Controller1, CAN2_FUSION_SW_Controller2, CAN2_FUSION_SW_Country1, CAN2_FUSION_SW_Country2, CAN2_FUSION_SW_ECUGen1, CAN2_FUSION_SW_ECUGen2, CAN2_FUSION_SW_Major1, CAN2_FUSION_SW_Major2, CAN2_FUSION_SW_Minor1, CAN2_FUSION_SW_Minor2, CAN2_FUSION_SW_Patch1, CAN2_FUSION_SW_Patch2, CAN2_FUSION_SW_SHA1, CAN2_FUSION_SW_SHA2, CAN2_FUSION_SW_SHA3, CAN2_FUSION_SW_SHA4, CAN2_FUSION_SW_SHA5, CAN2_FUSION_SW_SHA6, CAN2_FUSION_SW_SHA7, CAN2_FUSION_SW_SHA8, CAN2_FUSION_SW_Var1, CAN2_FUSION_SW_Var2, CAN2_FUSION_SW_Var3, CAN2_FUSION_SW_Var4, CAN2_FUSION_SW_Var5, CAN2_FUSION_SW_change1, CAN2_FUSION_SW_change2, CAN2_FUSION_SW_dash1, CAN2_FUSION_SW_dash2], system-signal-group=CAN2_SG_FD2_Version
    CAN2_SG_GW2_C10_0: i-signal=[CAN2_ABM_Passenger_ODS_Sta, CAN2_ABM_RearPassengerCTR_ODS_Sta, CAN2_ABM_RearPassengerLH_ODS_Sta, CAN2_ABM_RearPassengerRH_ODS_Sta, CAN2_ABS_Active, CAN2_ABS_Failed, CAN2_ABS_WnlmpSta, CAN2_AEBAvail, CAN2_AVH_Active, CAN2_AVH_Failed, CAN2_AirBagFailCmd, CAN2_Amber_WnlmpSta, CAN2_BTCS_Active, CAN2_BrkDiscTempSta, CAN2_BrkSw_Sta, CAN2_BrkSw_V, CAN2_CrashOutputSts, CAN2_DCDCAuxCur, CAN2_DCDCAuxVolt, CAN2_DrPMMLVOutPErrLmp, CAN2_DrPMMSysErrLmp, CAN2_DrSCPSysErrLmp, CAN2_DriverSeatBeltCmd, CAN2_EBD_Failed, CAN2_EBMErrSta, CAN2_EBMRLampSta, CAN2_ESC_ADAS_Sta, CAN2_ESC_BeepReq, CAN2_ESC_Failed, CAN2_ESC_OFF_Status, CAN2_ESC_Off_lmpSta, CAN2_ESC_WnlmpSta, CAN2_ESS_Active, CAN2_EpasFailed, CAN2_FLTurnLPErr, CAN2_FLTurn_Light_Warning, CAN2_FRTurnLPErr, CAN2_FRTurn_Light_Warning, CAN2_FireDetErr, CAN2_FrPMMLimpHomeActReq, CAN2_HBB_Active, CAN2_HBB_Failed, CAN2_HDD_Active, CAN2_HDD_Failed, CAN2_HSA_Active, CAN2_HSA_Failed, CAN2_HVBattCurr, CAN2_HVBattErr, CAN2_HVBattVolt, CAN2_LADBErr, CAN2_LADB_Hibeam_Indication, CAN2_LADB_Operation_Status, CAN2_LADB_Warning, CAN2_LAHB_Warning, CAN2_LDRL_Warning, CAN2_LF_PulseCount, CAN2_LF_PulseCount_V, CAN2_LF_WhlRotDir, CAN2_LH_BeamErr, CAN2_LLB_Warning, CAN2_LL_BeamErr, CAN2_LR_PulseCount, CAN2_LR_PulseCount_V, CAN2_LR_WhlRotDir, CAN2_LowBrakeFluid_Sta, CAN2_Lposition_Lamp_Warning, CAN2_Meter_Ind_VehSpeed, CAN2_PABSwitchCmd, CAN2_PBA_Active, CAN2_PBA_Failed, CAN2_PsngrSeatBeltCmd, CAN2_RADBErr, CAN2_RADB_Hibeam_Indication, CAN2_RADB_Operation_Status, CAN2_RADB_Warning, CAN2_RAHB_Warning, CAN2_RCenterSeatBeltCmd, CAN2_RDRL_Warning, CAN2_RDriverSeatBeltCmd, CAN2_RF_PulseCount, CAN2_RF_PulseCount_V, CAN2_RF_WhlRotDir, CAN2_RH_BeamErr, CAN2_RLB_Warning, CAN2_RLTurnLPErr, CAN2_RL_BeamErr, CAN2_RPsngrSeatBeltCmd, CAN2_RRTurnLPErr, CAN2_RR_PulseCount, CAN2_RR_PulseCount_V, CAN2_RR_WhlRotDir, CAN2_Red_WnlmpSta, CAN2_Rposition_Lamp_Warning, CAN2_SAS_Angle, CAN2_SAS_V, CAN2_TCS_Failed, CAN2_TLHPsngrSeatBeltCmd, CAN2_TRHPsngrSeatBeltCmd, CAN2_VehSpeed, CAN2_eBST_AmberWnlmpSta, CAN2_eBST_BeepReq, CAN2_eBST_RedWnlmpSta], system-signal-group=CAN2_SG_GW2_C10_0
    CAN2_SG_GW2_CE1000_0: i-signal=[CAN2_ACChrgCurrDis, CAN2_Charge_Percent_Set, CAN2_DSEAT_HW_Ver, CAN2_DSEAT_SW_Ver, CAN2_Fr_MCU_HW_Ver, CAN2_Fr_MCU_HW_Ver_Nidec, CAN2_Fr_MCU_SW_Ver, CAN2_Fr_MCU_SW_Ver_Nidec, CAN2_HVBChrgPwr, CAN2_HVBChrgPwrTotal, CAN2_HVBDrvPwr, CAN2_HVBDrvPwrTotal, CAN2_HVBattSOC, CAN2_HVBattSOCDis, CAN2_PSEAT_HW_Ver, CAN2_PSEAT_SW_Ver, CAN2_PTG_HW_Ver, CAN2_PTG_SW_Ver, CAN2_RemainChrgTime, CAN2_Rr_MCU3_HW_Ver, CAN2_Rr_MCU3_HW_Ver_Nidec, CAN2_Rr_MCU3_SW_Ver, CAN2_Rr_MCU3_SW_Ver_Nidec, CAN2_TBOX_HW_VER, CAN2_TBOX_SW_VER], system-signal-group=CAN2_SG_GW2_CE1000_0
    CAN2_SG_GW2_CE100_0: i-signal=[CAN2_FDC_BCM_DimSw, CAN2_FDC_BCM_FWipSw_Sta, CAN2_FDC_BCM_TurnSw_Sta], system-signal-group=CAN2_SG_GW2_CE100_0
    CAN2_SG_CGW_GW2_CE100_0: i-signal=[CAN2_COMP_ActualPwr, CAN2_CbnPreACEnaReq, CAN2_ChargeInletLockSta, CAN2_ChrgPlugSta, CAN2_DKC_KeyNum_Sta, CAN2_DKC_KeyType_Sta, CAN2_DisChrgPlugErr, CAN2_EBMSta, CAN2_ExtChrgSta, CAN2_FrntPTCLeActHeatPwr, CAN2_FrntPTCRearLeActHeatPwr, CAN2_FrntPTCRearRiActHeatPwr, CAN2_FrntPTCRiActHeatPwr, CAN2_HVBChrgErr, CAN2_HVBContactorSta, CAN2_HVBMTempMax, CAN2_HVBOvrTempErr, CAN2_HVBOvrTempWarn, CAN2_MainRlyNegSta, CAN2_MainRlyPosSta, CAN2_OBCACCSLimit, CAN2_OBCACCurrInf, CAN2_OBCACVoltInf, CAN2_OBCFaultSta, CAN2_OBC_AC_Cur_Lim, CAN2_P_Dkey_Show_IVI, CAN2_P_KeyMiss, CAN2_P_UID_LowPower, CAN2_RLS_Lamp_Sta, CAN2_Re_Radio, CAN2_SWC_ACC_Sta, CAN2_SWC_Down_Sta, CAN2_SWC_LKA_Sta, CAN2_SWC_Left_Sta, CAN2_SWC_RegenDown, CAN2_SWC_RegenUp, CAN2_SWC_Right_Sta, CAN2_SWC_Trip_Sta, CAN2_SWC_Undefined_Sta, CAN2_SWC_Up_Sta, CAN2_SWC_VR_Sta, CAN2_SWC_mode_Sta, CAN2_Shifter_Fail_sta, CAN2_Shifter_Handle_Cmd, CAN2_TBOX_NET_SIG_STR, CAN2_TBOX_TEST_STATUS, CAN2_TrailerCheck, CAN2_TrailerModeSta, CAN2_V2LSta, CAN2_ZFR_BCM_ChargerDoorSW_Sta, CAN2_ZFR_EChrg_Active_Sta, CAN2_ZFR_EChrg_OperationDeny_Cmd, CAN2_ZFR_EChrg_Sys_Sta, CAN2_ZFR_EChrg_WashMode_Sta], system-signal-group=CAN2_SG_CGW_GW2_CE100_0
    CAN2_SG_GW2_CE100_1: i-signal=[CAN2_FDC_BCM_WinLFOpened_Sta, CAN2_FDC_BCM_WinLROpened_Sta, CAN2_FDC_BCM_WinRFOpened_Sta, CAN2_FDC_BCM_WinRROpened_Sta], system-signal-group=CAN2_SG_GW2_CE100_1
    CAN2_SG_CGW_GW2_CE100_1: i-signal=[CAN2_BD_DSEAT_Anti_Sta, CAN2_BD_DSEAT_EntryFun_Sta, CAN2_BD_DSEAT_Error_Sta, CAN2_BD_DSEAT_MemSet_Sta, CAN2_BD_DSEAT_Mode_Sta, CAN2_BD_DSEAT_StopKeepMove_Sta, CAN2_BD_DSEAT_Vent_Sta, CAN2_BD_DSEAT_heater_Sta, CAN2_BD_Door_FHandleClose_Sta, CAN2_BD_Door_RHandleClose_Sta, CAN2_BP_Door_FHandleClose_Sta, CAN2_BP_Door_RHandleClose_Sta, CAN2_BP_PSEAT_Error_Sta, CAN2_BP_PSEAT_Mode_Sta, CAN2_BP_PSEAT_Vent_Sta, CAN2_BP_PSEAT_heater_Sta, CAN2_BP_PTG_Active_Sta, CAN2_BP_PTG_Exist_Sta, CAN2_BP_PTG_IsSetHeight_Sta, CAN2_BP_PTG_Sys_Sta, CAN2_BP_SEAT_LVent_Sta, CAN2_BP_SEAT_MLVent_Sta, CAN2_BP_SEAT_MRVent_Sta, CAN2_BP_SEAT_RVent_Sta, CAN2_Fr_EDUDrtSta, CAN2_Fr_EDURealTMTq, CAN2_Fr_MCUTemp, CAN2_Fr_MCUTempWarn, CAN2_Fr_MotorAvailTq, CAN2_Fr_TMSpd, CAN2_Fr_TMTemp, CAN2_Fr_TMTempWarn, CAN2_MCU_B_F_LLCTempWarn_Sta, CAN2_MCU_B_R_LLCTempWarn_Sta, CAN2_Rr_EDUDrtSta, CAN2_Rr_EDURealTMTq, CAN2_Rr_MCUTemp, CAN2_Rr_MCUTempWarn, CAN2_Rr_MotorAvailTq, CAN2_Rr_TMSpd, CAN2_Rr_TMTemp, CAN2_Rr_TMTempWarn, CAN2_SWC2_L_DriveMode_Sta, CAN2_SWC2_L_Home_Sta, CAN2_SWC2_R_Customize_Sta, CAN2_SWC2_R_Left_Sta, CAN2_SWC2_R_PageSwitch_Sta, CAN2_SWC2_R_Right_Sta, CAN2_SWC2_R_ScrollDown_Sta, CAN2_SWC2_R_ScrollPress_Sta, CAN2_SWC2_R_ScrollUp_Sta, CAN2_SWC2_R_VR_Sta], system-signal-group=CAN2_SG_CGW_GW2_CE100_1
    CAN2_SG_GW2_CE100_2: i-signal=[CAN2_DSEAT_Anti_Sta, CAN2_DSEAT_EntryFun_Sta, CAN2_DSEAT_Error_Sta, CAN2_DSEAT_Mode, CAN2_DSEAT_Vent_Sta, CAN2_DSEAT_heater_sta, CAN2_FAPWL_01_LIN_Response_Error, CAN2_Fr_EDUDrtSta_Nidec, CAN2_Fr_EDURealTMTq_Nidec, CAN2_Fr_MCUTempWarn_Nidec, CAN2_Fr_MCUTemp_Nidec, CAN2_Fr_MotorAvailTq_Nidec, CAN2_Fr_TMSpd_Nidec, CAN2_Fr_TMTempWarn_Nidec, CAN2_Fr_TMTemp_Nidec, CAN2_L_Drv_Motor_Relay_Error, CAN2_L_Drv_Motor_Ripple_Error, CAN2_L_Drv_Val_Wdw_Opened, CAN2_L_Pas_Motor_Relay_Error, CAN2_L_Pas_Motor_Ripple_Error, CAN2_L_Pas_Val_Wdw_Opened, CAN2_L_RLD_Motor_Relay_Error, CAN2_L_RLD_Motor_Ripple_Error, CAN2_L_RLD_Val_Wdw_Opened, CAN2_L_RRD_Motor_Relay_Error, CAN2_L_RRD_Motor_Ripple_Error, CAN2_L_RRD_Val_Wdw_Opened, CAN2_PSEAT_Error_Sta, CAN2_PSEAT_Mode, CAN2_PSEAT_Vent_Sta, CAN2_PSEAT_heater_sta, CAN2_PTG_Active_Sta, CAN2_PTG_AutoStaus, CAN2_PTG_Exist, CAN2_PTG_Is_Set_Height, CAN2_PTG_Sys_Sta, CAN2_RAPWL_01_LIN_Response_Error, CAN2_Rr_EDUDrtSta_Nidec, CAN2_Rr_EDURealTMTq_Nidec, CAN2_Rr_MCUTempWarn_Nidec, CAN2_Rr_MCUTemp_Nidec, CAN2_Rr_MotorAvailTq_Nidec, CAN2_Rr_TMSpd_Nidec, CAN2_Rr_TMTempWarn_Nidec, CAN2_Rr_TMTemp_Nidec], system-signal-group=CAN2_SG_GW2_CE100_2
    CAN2_SG_GW2_CE200_0: i-signal=CAN2_FDC_BCM_TimeGapLevel_Sta, system-signal-group=CAN2_SG_GW2_CE200_0
    CAN2_SG_CGW_GW2_CE200_0: i-signal=[CAN2_ACC_ObjDist, CAN2_ACC_ObjDstLvl, CAN2_ACC_ObjRelSpd, CAN2_ACC_TakeoverReq, CAN2_ADAS_ACC_Sta, CAN2_ADAS_AEBReq, CAN2_ADAS_AEB_Sta, CAN2_ADAS_CAM_SpdLim, CAN2_ADAS_FCW_Mute, CAN2_ADAS_FCW_Sensitivity, CAN2_ADAS_FCW_Sta, CAN2_ADAS_FltWrnReq, CAN2_ADAS_ISA_Sta, CAN2_ADAS_LDW_Mute, CAN2_ADAS_LDW_Sensitivity, CAN2_ADAS_LDW_Sta, CAN2_ADAS_LFC_Hands_Off_Warning, CAN2_ADAS_LFC_Sta, CAN2_ADAS_LFC_Warn_Sound, CAN2_ADAS_LKA_Sta, CAN2_ADAS_LaneModeL, CAN2_ADAS_LaneModeR, CAN2_ADAS_SLIF_SpdLim, CAN2_ADAS_SLIF_Sta, CAN2_ADAS_VehSpdLim, CAN2_ADAS_WarningMsg, CAN2_ActBrkLamp_Sta, CAN2_CameraBlockage, CAN2_ForceLowBeam, CAN2_HVBFullChrgPwr, CAN2_HVBPwrAvailChrg, CAN2_HVBPwrAvailChrg30, CAN2_HVBPwrAvailChrg60, CAN2_HVBSOH, CAN2_HazardWarningReq, CAN2_ISA_WarningMsg, CAN2_LKA_HOD_Display_Warning, CAN2_LKA_HOD_Sound_Warning, CAN2_LVDA_ACCStatusInformation, CAN2_LVDA_Disabled, CAN2_LVDA_Failinfo, CAN2_LVDA_Mute_Sta, CAN2_LVDA_Warning, CAN2_LeftTurnLightReq, CAN2_MCU_B_F_RealPwrKw_Sta, CAN2_MCU_B_R_RealPwrKw_Sta, CAN2_RightTurnLightReq, CAN2_Target_Type], system-signal-group=CAN2_SG_CGW_GW2_CE200_0
    CAN2_SG_HMI1: i-signal=[CAN2_HMI_ACAirIntM_Cmd, CAN2_HMI_ACAirIntP_Cmd, CAN2_HMI_ACAutoBtn_Cmd, CAN2_HMI_ACBtn_Cmd, CAN2_HMI_ACFrDefogBtn_Cmd, CAN2_HMI_ACRecycleBtn_Cmd, CAN2_HMI_ACWindDirM_Cmd, CAN2_HMI_ACWindDirP_Cmd, CAN2_HMI_AutoInterLight_Cmd, CAN2_HMI_BCMPostDefogBtn_Cmd, CAN2_HMI_DSEAT_LevelDown_Cmd, CAN2_HMI_DSEAT_LevelUp_Cmd, CAN2_HMI_Function1_LevelDown_Cmd, CAN2_HMI_Function1_LevelUp_Cmd, CAN2_HMI_Function2_LevelDown_Cmd, CAN2_HMI_Function2_LevelUp_Cmd, CAN2_HMI_Function3_LevelDown_Cmd, CAN2_HMI_Function3_LevelUp_Cmd, CAN2_HMI_Function4_LevelDown_Cmd, CAN2_HMI_Function4_LevelUp_Cmd, CAN2_HMI_Function5_LevelDown_Cmd, CAN2_HMI_Function5_LevelUp_Cmd, CAN2_HMI_Function6_LevelDown_Cmd, CAN2_HMI_Function6_LevelUp_Cmd, CAN2_HMI_PSEAT_LevelDown_Cmd, CAN2_HMI_PSEAT_LevelUp_Cmd, CAN2_HMI_ZLSetTM_Cmd, CAN2_HMI_ZLSetTP_Cmd, CAN2_HMI_ZRSetTM_Cmd, CAN2_HMI_ZRSetTP_Cmd], system-signal-group=CAN2_SG_HMI1
    CAN2_SG_IVI1: i-signal=[CAN2_A2B_Node_sta, CAN2_AmbLigh_LowBatAlert_SW, CAN2_AmbLigh_SafetyAlert_SW, CAN2_AmbLightBrightnessSet, CAN2_AmbLightColorSet, CAN2_AmbLight_DimInDark_SW, CAN2_AmbLight_SW, CAN2_AmbLight_WlcmLight_SW, CAN2_BrkAbn_GoReady_SW, CAN2_FCP_FrEvt_BtnACMaxReq, CAN2_FCP_FrEvt_BtnACReq, CAN2_FCP_FrEvt_BtnAutoReq, CAN2_FCP_FrEvt_BtnSyncReq, CAN2_FCP_MidEvt_BtnAutoReq, CAN2_IVI_AirRefresh_ByDMS_Sta, CAN2_IVI_AutoTheme_But_Sta, CAN2_IVI_AutoWipHSpdSW_Cmd, CAN2_IVI_CLWin_LockDoorSW_Sta, CAN2_IVI_CreateAccReq_Sta, CAN2_IVI_DMS_SW_Sta, CAN2_IVI_DSEAT_StopKeepMove_Sta, CAN2_IVI_DSEAT_anti_set_Sta, CAN2_IVI_DSEAT_entryfun_set_Sta, CAN2_IVI_DelAccReq_Sta, CAN2_IVI_Driving_Lock_SW_Sta, CAN2_IVI_EPS_Force_Cmd, CAN2_IVI_FrTrunk_UnlockReq_Sta, CAN2_IVI_HMI_Undefined_Sta, CAN2_IVI_LinkAccReq_Sta, CAN2_IVI_LinkAcc_Sta, CAN2_IVI_LinkKey_Sta, CAN2_IVI_Located_STA, CAN2_IVI_Lock_SoundSW_Sta, CAN2_IVI_MirrorFolded_SW_Sta, CAN2_IVI_NAVI_Foreground_Sta, CAN2_IVI_OTA_Upd_Sta, CAN2_IVI_QuickRefresh_Sta, CAN2_IVI_SWC_VibMode_Sta, CAN2_IVI_SilentChrg_Alert_Sta, CAN2_IVI_Stopping_Unlock_SW_Sta, CAN2_IVI_Theme_Sta, CAN2_IVI_Time_Check, CAN2_IVI_Time_Day, CAN2_IVI_Time_Hour, CAN2_IVI_Time_Minute, CAN2_IVI_Time_Month, CAN2_IVI_Time_Second, CAN2_IVI_Time_Year, CAN2_IVI_WPTC_SW_Sta, CAN2_IVI_WirelessCharge_Cmd, CAN2_IVI_sigScreenReq_Sta, CAN2_LINKtoDrive, CAN2_OTA_CancelDL_Req, CAN2_OTA_CompNTFY_Pres, CAN2_OTA_DL_Req, CAN2_OTA_SuspendDL_Req, CAN2_OTA_UpdStart_Req, CAN2_OpenDrOpenWdo_SW, CAN2_PW_CLOSE_IMD, CAN2_PW_CONTINUE_USE, CAN2_Re_Radio_Sta, CAN2_Sched_Chg_Day_Set, CAN2_Sched_Chg_End_Time_HR, CAN2_Sched_Chg_End_Time_Min, CAN2_Sched_Chg_St_Time_HR, CAN2_Sched_Chg_St_Time_Min, CAN2_Sched_OTA_wake, CAN2_SmartEco_Mode_SW, CAN2_Upd_Countdown_Cancel, CAN2_Upd_Countdown_Skip, CAN2_UserSet, CAN2_VehACModReq, CAN2_mFRD_link_Sta], system-signal-group=CAN2_SG_IVI1
    CAN2_SG_IVI2: i-signal=[CAN2_AC_Chg_Cur_Set, CAN2_AEB_BUTT, CAN2_AVM_Err_STA, CAN2_AVM_OFF_Rec_Butt, CAN2_AVM_Parking_mode, CAN2_AVM_parking_cancel, CAN2_AVM_parking_excute, CAN2_Approach_Unlock_SW, CAN2_BSDMute_BUTT, CAN2_CAAS_Sw, CAN2_CDL_Lock_Butt, CAN2_CDL_Unlock_Butt, CAN2_CameraWrn, CAN2_DMS_Status, CAN2_DMS_Warning_Distraction, CAN2_DMS_Warning_Fatigue, CAN2_DMS_Warning_Unresponsive, CAN2_DSEAT_anti_set, CAN2_DSEAT_entryfun_set, CAN2_DSEAT_vent_req, CAN2_Distance_unit, CAN2_ESC_SW_Cmd, CAN2_FCWMute_BUTT, CAN2_FFogLampSW, CAN2_FS_Off_Sw, CAN2_FalseNPrevent_SW, CAN2_FollowMeSW, CAN2_GPS_LAT, CAN2_GPS_LONG, CAN2_HeadLampSW, CAN2_Hood_Latch_SW, CAN2_IVI_ACC_Adaptive_Sta, CAN2_IVI_AGSCloseSW, CAN2_IVI_ActvDmpDisabSW, CAN2_IVI_AirIntZ3_Cmd, CAN2_IVI_Backlight_Sta, CAN2_IVI_CarWash_Mode_Cmd, CAN2_IVI_CfmTo_Rdy, CAN2_IVI_ChargePortSW_Sta, CAN2_IVI_CoastDwSW, CAN2_IVI_CreepSW_Req, CAN2_IVI_DMS_Faceblocked_Sta, CAN2_IVI_DMS_NoDriverDetected_Sta, CAN2_IVI_DSEATHeater_Cmd, CAN2_IVI_DSEAT_FroEdge_Height_Cmd, CAN2_IVI_DSEAT_Height_Cmd, CAN2_IVI_DSEAT_Memory1_Sta, CAN2_IVI_DSEAT_Memory2_Sta, CAN2_IVI_DSEAT_Memory_OPTCLS_Sta, CAN2_IVI_DSEAT_Recline_Cmd, CAN2_IVI_DSEAT_Slide_Cmd, CAN2_IVI_FGSAirInt_Cmd, CAN2_IVI_FGSCh_Cmd, CAN2_IVI_FWipIntTSet_Cmd, CAN2_IVI_GPS_Lat_Dir_Sta, CAN2_IVI_GPS_Long_Dir_Sta, CAN2_IVI_IC_Brightness_Sta, CAN2_IVI_IONSW_Cmd, CAN2_IVI_ISA_OffsetSpd, CAN2_IVI_LVChrgFuncSW, CAN2_IVI_Mute_Sta, CAN2_IVI_Night_Mode_Sta, CAN2_IVI_Off_Road_Mode_Sta, CAN2_IVI_PSEATHeater_Cmd, CAN2_IVI_PSEAT_Recline_Cmd, CAN2_IVI_PSEAT_Slide_Cmd, CAN2_IVI_PTG_Mode_SW, CAN2_IVI_PTG_Open_Height, CAN2_IVI_PTG_Sta_SW, CAN2_IVI_PTG_USSta_SW, CAN2_IVI_PW_Mode_Req, CAN2_IVI_Panel_Act, CAN2_IVI_Panel_X_Coor, CAN2_IVI_Panel_Y_Coor, CAN2_IVI_PwrLockSW, CAN2_IVI_Pwroff_req, CAN2_IVI_RR_Def_Req, CAN2_IVI_Req_V2L, CAN2_IVI_SLIF_Warning_Sta, CAN2_IVI_SWC_ACCMode_Sta, CAN2_IVI_SWC_LUndefined_Sta, CAN2_IVI_SWC_RUndefined_Sta, CAN2_IVI_Screen, CAN2_IVI_SetTempZon1_Sta, CAN2_IVI_SetTempZon2_Sta, CAN2_IVI_Start_Chg_req, CAN2_IVI_Status, CAN2_IVI_Stop_Chg_req, CAN2_IVI_TrailerCheckReq_Sta, CAN2_IVI_TrailerModeSW_Sta, CAN2_IVI_Trigger_req, CAN2_IVI_Unlock_Chg_req, CAN2_IVI_WI_MAIN_SW, CAN2_LDWMute_BUTT, CAN2_LKA_BUTT, CAN2_LVDAMute_BUTT, CAN2_L_Drv_ControlCommand, CAN2_L_Pas_ControlCommand, CAN2_L_RLD_ControlCommand, CAN2_L_RRD_ControlCommand, CAN2_Light_ShowStart_Req, CAN2_Light_ShowStop_Req, CAN2_METER_Malfunc_Sta, CAN2_MFRD_N_Bright_Req, CAN2_NAVI_Cam_Dist_info, CAN2_NAVI_Direction_STA, CAN2_NAVI_Distance_info, CAN2_NAVI_ForwardLinkLevel, CAN2_NAVI_LinkClass, CAN2_NAVI_RoadClass, CAN2_NAVI_SpeedLimit, CAN2_NAVI_Speed_Limit_A, CAN2_NAVI_State, CAN2_NAVI_Tollgate, CAN2_NAVI_Tunnel, CAN2_ODAMute_BUTT, CAN2_OFF_AC_MODE, CAN2_PSEAT_vent_req, CAN2_Perd_V2L, CAN2_Pressure_unit, CAN2_RCTA_BUTT, CAN2_RFogLampSW, CAN2_Roll_Eng_Mode, CAN2_Roll_Mode_SW_Cmd, CAN2_RoomLampMode, CAN2_SLG_Sw, CAN2_SLIF_BUTT, CAN2_SOC_ADJ_BUTT, CAN2_SOC_Limit_Set, CAN2_SOC_V2LLimit, CAN2_Sched_Chg_Start, CAN2_Sched_Chg_Stop, CAN2_Sched_Chg_butt, CAN2_Sched_Chg_limit, CAN2_Sched_Chg_wake, CAN2_SenstivityPosition, CAN2_SetUnlockSingle, CAN2_TCS_SW_Cmd, CAN2_TPMS_Cali_Butt, CAN2_TPMS_Res_Butt, CAN2_Temperature_unit, CAN2_Time_system, CAN2_TurnSwTimeSet, CAN2_User_p_download, CAN2_User_p_upload, CAN2_Walkaway_Lock_SW, CAN2_Wifi_Reset, CAN2_Wifi_Sta_IVI_TBOX, CAN2_WlcmLight_Mode, CAN2_sigAirIntenZon1Req, CAN2_sigAirIntenZon3Req, CAN2_sigDfrstReq, CAN2_sigFaceReq, CAN2_sigFootReq, CAN2_sigHvacFrontReq, CAN2_sigHvacRearReq, CAN2_sigHvacReq, CAN2_sigRecircReq, CAN2_sigSetTempZon1Req, CAN2_sigSetTempZon2Req, CAN2_sigSetTempZon3Req, CAN2_sigWindDirZon3Req], system-signal-group=CAN2_SG_IVI2
    CAN2_SG_IVI3: i-signal=[CAN2_IVI_CLBlower_Y_Sta, CAN2_IVI_CLBlower_Z_Sta, CAN2_IVI_CRBlower_Y_Sta, CAN2_IVI_CRBlower_Z_Sta, CAN2_IVI_HMI_CustmiFun_Sta, CAN2_IVI_HMI_CustmiKEY_Sta, CAN2_IVI_LBlower_Mode_Sta, CAN2_IVI_LBlower_Y_Sta, CAN2_IVI_LBlower_Z_Sta, CAN2_IVI_LSEATvent_Cmd, CAN2_IVI_LeftPSDOpenClose_Cmd, CAN2_IVI_MLFMost_Cmd, CAN2_IVI_MLFootLift_Cmd, CAN2_IVI_MLNapMode_Cmd, CAN2_IVI_MLRecliner_Cmd, CAN2_IVI_MLRestore_Cmd, CAN2_IVI_MLSEATvent_Cmd, CAN2_IVI_MLSeatLift_Cmd, CAN2_IVI_MLSldRestore_Cmd, CAN2_IVI_MLSlider_Cmd, CAN2_IVI_MLZeroGravity_Cmd, CAN2_IVI_MRFMost_Cmd, CAN2_IVI_MRFootLift_Cmd, CAN2_IVI_MRNapMode_Cmd, CAN2_IVI_MRRecliner_Cmd, CAN2_IVI_MRRestore_Cmd, CAN2_IVI_MRSEATvent_Cmd, CAN2_IVI_MRSeatLift_Cmd, CAN2_IVI_MRSldRestore_Cmd, CAN2_IVI_MRSlider_Cmd, CAN2_IVI_MRZeroGravity_Cmd, CAN2_IVI_PSDManualPower_Sta, CAN2_IVI_RBlower_Mode_Sta, CAN2_IVI_RBlower_Y_Sta, CAN2_IVI_RBlower_Z_Sta, CAN2_IVI_RSEATvent_Cmd, CAN2_IVI_RightPSDOpenClose_Cmd, CAN2_IVI_RollMod_atCarWash_Sta, CAN2_IVI_SOS_Call_Sta, CAN2_IVI_SnowMode_Cmd, CAN2_IVI_UserTakeOver_APS_Sta, CAN2_IVI_XWDMode_Cmd, CAN2_IVI_Zon1WindDirSWReq_Sta], system-signal-group=CAN2_SG_IVI3
    CAN2_SG_METER1: i-signal=[CAN2_APCforDTE, CAN2_AVGPwrConsumption, CAN2_AvailableTrip, CAN2_Averaged_vehspeed, CAN2_Charge, CAN2_LEDlitWarnReq, CAN2_METER_KPH_Calcu, CAN2_METER_KPH_Real, CAN2_METER_MPH_Calcu, CAN2_METER_MPH_Real, CAN2_ODOMETER, CAN2_ParkBrake, CAN2_Spd_Crl_Mode, CAN2_Spd_Crl_Sta, CAN2_Trip_A, CAN2_Trip_B], system-signal-group=CAN2_SG_METER1
package /CAN2/Cluster
  can cluster CAN2: baudrate=500, can-fd-baudrate=2000
    can physical channel CAN2: comm-connectors=ConnCAN2
      frame CAN2_DiagFuncReqFT: id 0x7D0, frame-length=8, can-addressing-mode=STANDARD, can-fd-frame-support=true, can-frame-rx-behavior=CAN-FD, can-frame-tx-behavior=CAN-FD
        n pdu CAN2_DiagFuncReqFT: length=8
      frame CAN2_DiagFuncReqOBD: id 0x7DF, frame-length=8, can-addressing-mode=STANDARD, can-fd-frame-support=true, can-frame-rx-behavior=CAN-FD, can-frame-tx-behavior=CAN-FD
        n pdu CAN2_DiagFuncReqOBD: length=8
      frame CAN2_DiagPhysReqToHMI: id 0x6B2, frame-length=64, can-addressing-mode=STANDARD, can-fd-frame-support=true, can-frame-rx-behavior=CAN-FD, can-frame-tx-behavior=CAN-FD
        n pdu CAN2_DiagPhysReqToHMI: length=8
      frame CAN2_DiagPhysReqToIVI: id 0x6A0, frame-length=8, can-addressing-mode=STANDARD, can-fd-frame-support=true, can-frame-rx-behavior=CAN-FD, can-frame-tx-behavior=CAN-FD
        n pdu CAN2_DiagPhysReqToIVI: length=8
      frame CAN2_DiagPhysReqToMeter: id 0x682, frame-length=8, can-addressing-mode=STANDARD, can-fd-frame-support=true, can-frame-rx-behavior=CAN-FD, can-frame-tx-behavior=CAN-FD
        n pdu CAN2_DiagPhysReqToMeter: length=8
      frame CAN2_DiagPhysReqToWCM: id 0x697, frame-length=64, can-addressing-mode=STANDARD, can-fd-frame-support=true, can-frame-rx-behavior=CAN-FD, can-frame-tx-behavior=CAN-FD
        n pdu CAN2_DiagPhysReqToWCM: length=8
      frame CAN2_DiagRespFromHMI: id 0x632, frame-length=64, can-addressing-mode=STANDARD, can-fd-frame-support=true, can-frame-rx-behavior=CAN-FD, can-frame-tx-behavior=CAN-FD
        n pdu CAN2_DiagRespFromHMI: length=8
      frame CAN2_DiagRespFromIVI: id 0x620, frame-length=8, can-addressing-mode=STANDARD, can-fd-frame-support=true, can-frame-rx-behavior=CAN-FD, can-frame-tx-behavior=CAN-FD
        n pdu CAN2_DiagRespFromIVI: length=8
      frame CAN2_DiagRespFromMeter: id 0x602, frame-length=8, can-addressing-mode=STANDARD, can-fd-frame-support=true, can-frame-rx-behavior=CAN-FD, can-frame-tx-behavior=CAN-FD
        n pdu CAN2_DiagRespFromMeter: length=8
      frame CAN2_DiagRespFromWCM: id 0x617, frame-length=64, can-addressing-mode=STANDARD, can-fd-frame-support=true, can-frame-rx-behavior=CAN-FD, can-frame-tx-behavior=CAN-FD
        n pdu CAN2_DiagRespFromWCM: length=8
      frame CAN2_FD2_C20_0: id 0x210, frame-length=32, can-addressing-mode=STANDARD, can-fd-frame-support=true, can-frame-rx-behavior=CAN-FD, can-frame-tx-behavior=CAN-FD
        pdu CAN2_FD2_C20_0: length=32, minimum-delay=0.0, transmission-mode-true-timing=cyclic-timing=time-period=0.02, unused-bit-pattern=0
          mapping CAN2_SG_FD2_C20_0: i-signal-group=CAN2_SG_FD2_C20_0, start-position=0, transfer-property=PENDING
          signal CAN2_APS_ExitCondition: start 151, 8 bit, big-endian, i-signal-type=PRIMITIVE, init-value=constant-reference=Init_CAN2_APS_ExitCondition, base-type=uint8, implementation-data-type=uint8, transfer-property=PENDING
          signal CAN2_APS_RQ_Display: start 207, 8 bit, big-endian, i-signal-type=PRIMITIVE, init-value=constant-reference=Init_CAN2_APS_RQ_Display, base-type=uint8, implementation-data-type=uint8, transfer-property=PENDING
          signal CAN2_APS_SW_Ver: start 167, 8 bit, big-endian, i-signal-type=PRIMITIVE, init-value=constant-reference=Init_CAN2_APS_SW_Ver, base-type=uint8, implementation-data-type=uint8, transfer-property=PENDING
          signal CAN2_APS_Sta_System: start 250, 3 bit, big-endian, i-signal-type=PRIMITIVE, init-value=constant-reference=Init_CAN2_APS_Sta_System, base-type=uint8, implementation-data-type=uint8, transfer-property=PENDING
          signal CAN2_CAAS_Sta: start 253, 3 bit, big-endian, i-signal-type=PRIMITIVE, init-value=constant-reference=Init_CAN2_CAAS_Sta, base-type=uint8, implementation-data-type=uint8, transfer-property=PENDING
          signal CAN2_DISC_DISCTargetSpd: start 99, 12 bit, big-endian, i-signal-type=PRIMITIVE, init-value=constant-reference=Init_CAN2_DISC_DISCTargetSpd, base-type=uint16, implementation-data-type=uint16, transfer-property=PENDING
          signal CAN2_FDC_VCU_RegenLimInd_Sta: start 71, 1 bit, big-endian, i-signal-type=PRIMITIVE, init-value=constant-reference=Init_CAN2_FDC_VCU_RegenLimInd_Sta, base-type=uint8, implementation-data-type=uint8, transfer-property=PENDING
          signal CAN2_FDC_VCU_RegenMode_Sta: start 74, 3 bit, big-endian, i-signal-type=PRIMITIVE, init-value=constant-reference=Init_CAN2_FDC_VCU_RegenMode_Sta, base-type=uint8, implementation-data-type=uint8, transfer-property=PENDING
          signal CAN2_FDC_VCU_SimSound_Cmd: start 95, 12 bit, big-endian, i-signal-type=PRIMITIVE, init-value=constant-reference=Init_CAN2_FDC_VCU_SimSound_Cmd, base-type=uint16, implementation-data-type=uint16, transfer-property=PENDING
          signal CAN2_FDC_VCU_SmartEcoSpdLim_Sta: start 67, 1 bit, big-endian, i-signal-type=PRIMITIVE, init-value=constant-reference=Init_CAN2_FDC_VCU_SmartEcoSpdLim_Sta, base-type=uint8, implementation-data-type=uint8, transfer-property=PENDING
          signal CAN2_FDC_VCU_SmartEco_Sta: start 75, 1 bit, big-endian, i-signal-type=PRIMITIVE, init-value=constant-reference=Init_CAN2_FDC_VCU_SmartEco_Sta, base-type=uint8, implementation-data-type=uint8, transfer-property=PENDING
          signal CAN2_FDC_VMC_SetSpdDisp_Sta: start 55, 8 bit, big-endian, i-signal-type=PRIMITIVE, init-value=constant-reference=Init_CAN2_FDC_VMC_SetSpdDisp_Sta, base-type=uint8, implementation-data-type=uint8, transfer-property=PENDING
          signal CAN2_FDC_VMC_SetSpd_Sta: start 63, 8 bit, big-endian, i-signal-type=PRIMITIVE, init-value=constant-reference=Init_CAN2_FDC_VMC_SetSpd_Sta, base-type=uint8, implementation-data-type=uint8, transfer-property=PENDING
          signal CAN2_FDC_VMC_SpdCtrlMode_Sta: start 10, 3 bit, big-endian, i-signal-type=PRIMITIVE, init-value=constant-reference=Init_CAN2_FDC_VMC_SpdCtrlMode_Sta, base-type=uint8, implementation-data-type=uint8, transfer-property=PENDING
          signal CAN2_FDC_VMC_SpdCtrl_Sta: start 11, 1 bit, big-endian, i-signal-type=PRIMITIVE, init-value=constant-reference=Init_CAN2_FDC_VMC_SpdCtrl_Sta, base-type=uint8, implementation-data-type=uint8, transfer-property=PENDING
          signal CAN2_PAS_A_FCL: start 219, 4 bit, big-endian, i-signal-type=PRIMITIVE, init-value=constant-reference=Init_CAN2_PAS_A_FCL, base-type=uint8, implementation-data-type=uint8, transfer-property=PENDING
          signal CAN2_PAS_A_FCR: start 23, 4 bit, big-endian, i-signal-type=PRIMITIVE, init-value=constant-reference=Init_CAN2_PAS_A_FCR, base-type=uint8, implementation-data-type=uint8, transfer-property=PENDING
          signal CAN2_PAS_A_FML: start 19, 4 bit, big-endian, i-signal-type=PRIMITIVE, init-value=constant-reference=Init_CAN2_PAS_A_FML, base-type=uint8, implementation-data-type=uint8, transfer-property=PENDING
          signal CAN2_PAS_A_FMR: start 31, 4 bit, big-endian, i-signal-type=PRIMITIVE, init-value=constant-reference=Init_CAN2_PAS_A_FMR, base-type=uint8, implementation-data-type=uint8, transfer-property=PENDING
          signal CAN2_PAS_A_RCL: start 27, 4 bit, big-endian, i-signal-type=PRIMITIVE, init-value=constant-reference=Init_CAN2_PAS_A_RCL, base-type=uint8, implementation-data-type=uint8, transfer-property=PENDING
          signal CAN2_PAS_A_RCR: start 39, 4 bit, big-endian, i-signal-type=PRIMITIVE, init-value=constant-reference=Init_CAN2_PAS_A_RCR, base-type=uint8, implementation-data-type=uint8, transfer-property=PENDING
          signal CAN2_PAS_A_RML: start 35, 4 bit, big-endian, i-signal-type=PRIMITIVE, init-value=constant-reference=Init_CAN2_PAS_A_RML, base-type=uint8, implementation-data-type=uint8, transfer-property=PENDING
          signal CAN2_PAS_A_RMR: start 47, 4 bit, big-endian, i-signal-type=PRIMITIVE, init-value=constant-reference=Init_CAN2_PAS_A_RMR, base-type=uint8, implementation-data-type=uint8, transfer-property=PENDING
          signal CAN2_PAS_Chime: start 223, 4 bit, big-endian, i-signal-type=PRIMITIVE, init-value=constant-reference=Init_CAN2_PAS_Chime, base-type=uint8, implementation-data-type=uint8, transfer-property=PENDING
          signal CAN2_PAS_D_FCL: start 119, 8 bit, big-endian, i-signal-type=PRIMITIVE, init-value=constant-reference=Init_CAN2_PAS_D_FCL, base-type=uint8, implementation-data-type=uint8, transfer-property=PENDING
          signal CAN2_PAS_D_FCR: start 127, 8 bit, big-endian, i-signal-type=PRIMITIVE, init-value=constant-reference=Init_CAN2_PAS_D_FCR, base-type=uint8, implementation-data-type=uint8, transfer-property=PENDING
          signal CAN2_PAS_D_FML: start 135, 8 bit, big-endian, i-signal-type=PRIMITIVE, init-value=constant-reference=Init_CAN2_PAS_D_FML, base-type=uint8, implementation-data-type=uint8, transfer-property=PENDING
          signal CAN2_PAS_D_FMR: start 143, 8 bit, big-endian, i-signal-type=PRIMITIVE, init-value=constant-reference=Init_CAN2_PAS_D_FMR, base-type=uint8, implementation-data-type=uint8, transfer-property=PENDING
          signal CAN2_PAS_D_RCL: start 175, 8 bit, big-endian, i-signal-type=PRIMITIVE, init-value=constant-reference=Init_CAN2_PAS_D_RCL, base-type=uint8, implementation-data-type=uint8, transfer-property=PENDING
          signal CAN2_PAS_D_RCR: start 183, 8 bit, big-endian, i-signal-type=PRIMITIVE, init-value=constant-reference=Init_CAN2_PAS_D_RCR, base-type=uint8, implementation-data-type=uint8, transfer-property=PENDING
          signal CAN2_PAS_D_RML: start 191, 8 bit, big-endian, i-signal-type=PRIMITIVE, init-value=constant-reference=Init_CAN2_PAS_D_RML, base-type=uint8, implementation-data-type=uint8, transfer-property=PENDING
          signal CAN2_PAS_D_RMR: start 199, 8 bit, big-endian, i-signal-type=PRIMITIVE, init-value=constant-reference=Init_CAN2_PAS_D_RMR, base-type=uint8, implementation-data-type=uint8, transfer-property=PENDING
          signal CAN2_PAS_SNSR_Layout: start 43, 4 bit, big-endian, i-signal-type=PRIMITIVE, init-value=constant-reference=Init_CAN2_PAS_SNSR_Layout, base-type=uint8, implementation-data-type=uint8, transfer-property=PENDING
          signal CAN2_USS_Sta_FCL: start 7, 1 bit, big-endian, i-signal-type=PRIMITIVE, init-value=constant-reference=Init_CAN2_USS_Sta_FCL, base-type=uint8, implementation-data-type=uint8, transfer-property=PENDING
          signal CAN2_USS_Sta_FCR: start 6, 1 bit, big-endian, i-signal-type=PRIMITIVE, init-value=constant-reference=Init_CAN2_USS_Sta_FCR, base-type=uint8, implementation-data-type=uint8, transfer-property=PENDING
          signal CAN2_USS_Sta_FLL: start 5, 1 bit, big-endian, i-signal-type=PRIMITIVE, init-value=constant-reference=Init_CAN2_USS_Sta_FLL, base-type=uint8, implementation-data-type=uint8, transfer-property=PENDING
          signal CAN2_USS_Sta_FLR: start 4, 1 bit, big-endian, i-signal-type=PRIMITIVE, init-value=constant-reference=Init_CAN2_USS_Sta_FLR, base-type=uint8, implementation-data-type=uint8, transfer-property=PENDING
          signal CAN2_USS_Sta_FML: start 3, 1 bit, big-endian, i-signal-type=PRIMITIVE, init-value=constant-reference=Init_CAN2_USS_Sta_FML, base-type=uint8, implementation-data-type=uint8, transfer-property=PENDING
          signal CAN2_USS_Sta_FMR: start 2, 1 bit, big-endian, i-signal-type=PRIMITIVE, init-value=constant-reference=Init_CAN2_USS_Sta_FMR, base-type=uint8, implementation-data-type=uint8, transfer-property=PENDING
          signal CAN2_USS_Sta_RCL: start 1, 1 bit, big-endian, i-signal-type=PRIMITIVE, init-value=constant-reference=Init_CAN2_USS_Sta_RCL, base-type=uint8, implementation-data-type=uint8, transfer-property=PENDING
          signal CAN2_USS_Sta_RCR: start 0, 1 bit, big-endian, i-signal-type=PRIMITIVE, init-value=constant-reference=Init_CAN2_USS_Sta_RCR, base-type=uint8, implementation-data-type=uint8, transfer-property=PENDING
          signal CAN2_USS_Sta_RLL: start 15, 1 bit, big-endian, i-signal-type=PRIMITIVE, init-value=constant-reference=Init_CAN2_USS_Sta_RLL, base-type=uint8, implementation-data-type=uint8, transfer-property=PENDING
          signal CAN2_USS_Sta_RLR: start 14, 1 bit, big-endian, i-signal-type=PRIMITIVE, init-value=constant-reference=Init_CAN2_USS_Sta_RLR, base-type=uint8, implementation-data-type=uint8, transfer-property=PENDING
          signal CAN2_USS_Sta_RML: start 13, 1 bit, big-endian, i-signal-type=PRIMITIVE, init-value=constant-reference=Init_CAN2_USS_Sta_RML, base-type=uint8, implementation-data-type=uint8, transfer-property=PENDING
          signal CAN2_USS_Sta_RMR: start 12, 1 bit, big-endian, i-signal-type=PRIMITIVE, init-value=constant-reference=Init_CAN2_USS_Sta_RMR, base-type=uint8, implementation-data-type=uint8, transfer-property=PENDING
          signal CAN2_VMC_VCU_CC_Crl_Sta: start 66, 3 bit, big-endian, i-signal-type=PRIMITIVE, init-value=constant-reference=Init_CAN2_VMC_VCU_CC_Crl_Sta, base-type=uint8, implementation-data-type=uint8, transfer-property=PENDING
          signal CAN2_VMC_VCU_MSA_Crl_Sta: start 70, 3 bit, big-endian, i-signal-type=PRIMITIVE, init-value=constant-reference=Init_CAN2_VMC_VCU_MSA_Crl_Sta, base-type=uint8, implementation-data-type=uint8, transfer-property=PENDING
      frame CAN2_FD2_CE100_0: id 0x117, frame-length=64, can-addressing-mode=STANDARD, can-fd-frame-support=true, can-frame-rx-behavior=CAN-FD, can-frame-tx-behavior=CAN-FD
        pdu CAN2_FD2_CE100_0: length=64, minimum-delay=0.0, transmission-mode-true-timing={cyclic-timing=time-period=0.1, event-controlled-timing={number-of-repetitions=0, repetition-period=0}}, unused-bit-pattern=0
          mapping CAN2_SG_FD2_CE100_0: i-signal-group=CAN2_SG_FD2_CE100_0, start-position=0, transfer-property=TRIGGERED-ON-CHANGE
          signal CAN2_APMDoorControlSta: start 219, 1 bit, big-endian, i-signal-type=PRIMITIVE, init-value=constant-reference=Init_CAN2_APMDoorControlSta, base-type=uint8, implementation-data-type=uint8, transfer-property=PENDING
          signal CAN2_ActAPSPosn: start 175, 8 bit, big-endian, i-signal-type=PRIMITIVE, init-value=constant-reference=Init_CAN2_ActAPSPosn, base-type=uint8, implementation-data-type=uint8, transfer-property=PENDING
          signal CAN2_AllDoorSW: start 205, 1 bit, big-endian, i-signal-type=PRIMITIVE, init-value=constant-reference=Init_CAN2_AllDoorSW, base-type=uint8, implementation-data-type=uint8, transfer-property=TRIGGERED-ON-CHANGE
          signal CAN2_AntitheftSta: start 244, 2 bit, big-endian, i-signal-type=PRIMITIVE, init-value=constant-reference=Init_CAN2_AntitheftSta, base-type=uint8, implementation-data-type=uint8, transfer-property=TRIGGERED-ON-CHANGE
          signal CAN2_BCM_DoorLock_Sta: start 240, 1 bit, big-endian, i-signal-type=PRIMITIVE, init-value=constant-reference=Init_CAN2_BCM_DoorLock_Sta, base-type=uint8, implementation-data-type=uint8, transfer-property=TRIGGERED-ON-CHANGE
          signal CAN2_BrakeLamp: start 236, 1 bit, big-endian, i-signal-type=PRIMITIVE, init-value=constant-reference=Init_CAN2_BrakeLamp, base-type=uint8, implementation-data-type=uint8, transfer-property=TRIGGERED-ON-CHANGE
          signal CAN2_CCMSA_SpdWar: start 167, 1 bit, big-endian, i-signal-type=PRIMITIVE, init-value=constant-reference=Init_CAN2_CCMSA_SpdWar, base-type=uint8, implementation-data-type=uint8, transfer-property=PENDING
          signal CAN2_CCU_ACLampSts: start 45, 1 bit, big-endian, i-signal-type=PRIMITIVE, init-value=constant-reference=Init_CAN2_CCU_ACLampSts, base-type=uint8, implementation-data-type=uint8, transfer-property=PENDING
          signal CAN2_CCU_ACMaxLampSts: start 40, 1 bit, big-endian, i-signal-type=PRIMITIVE, init-value=constant-reference=Init_CAN2_CCU_ACMaxLampSts, base-type=uint8, implementation-data-type=uint8, transfer-property=PENDING
          signal CAN2_CCU_AutoLampSts: start 41, 1 bit, big-endian, i-signal-type=PRIMITIVE, init-value=constant-reference=Init_CAN2_CCU_AutoLampSts, base-type=uint8, implementation-data-type=uint8, transfer-property=PENDING
          signal CAN2_CCU_AutoMidLampSts: start 42, 1 bit, big-endian, i-signal-type=PRIMITIVE, init-value=constant-reference=Init_CAN2_CCU_AutoMidLampSts, base-type=uint8, implementation-data-type=uint8, transfer-property=PENDING
          signal CAN2_CCU_Dispaly_Request: start 44, 1 bit, big-endian, i-signal-type=PRIMITIVE, init-value=constant-reference=Init_CAN2_CCU_Dispaly_Request, base-type=uint8, implementation-data-type=uint8, transfer-property=PENDING
          signal CAN2_CCU_EcoSts: start 43, 1 bit, big-endian, i-signal-type=PRIMITIVE, init-value=constant-reference=Init_CAN2_CCU_EcoSts, base-type=uint8, implementation-data-type=uint8, transfer-property=PENDING
          signal CAN2_CCU_FrtOnOffLampSts: start 51, 1 bit, big-endian, i-signal-type=PRIMITIVE, init-value=constant-reference=Init_CAN2_CCU_FrtOnOffLampSts, base-type=uint8, implementation-data-type=uint8, transfer-property=PENDING
          signal CAN2_CCU_RrOnOffLampSts: start 55, 1 bit, big-endian, i-signal-type=PRIMITIVE, init-value=constant-reference=Init_CAN2_CCU_RrOnOffLampSts, base-type=uint8, implementation-data-type=uint8, transfer-property=PENDING
          signal CAN2_CCU_SyncLampSts: start 71, 1 bit, big-endian, i-signal-type=PRIMITIVE, init-value=constant-reference=Init_CAN2_CCU_SyncLampSts, base-type=uint8, implementation-data-type=uint8, transfer-property=PENDING
          signal CAN2_CC_Crl_Sta: start 26, 3 bit, big-endian, i-signal-type=PRIMITIVE, init-value=constant-reference=Init_CAN2_CC_Crl_Sta, base-type=uint8, implementation-data-type=uint8, transfer-property=TRIGGERED-ON-CHANGE
          signal CAN2_CoastDwModeStaChk: start 17, 2 bit, big-endian, i-signal-type=PRIMITIVE, init-value=constant-reference=Init_CAN2_CoastDwModeStaChk, base-type=uint8, implementation-data-type=uint8, transfer-property=PENDING
          signal CAN2_CreepSW_Sta: start 23, 1 bit, big-endian, i-signal-type=PRIMITIVE, init-value=constant-reference=Init_CAN2_CreepSW_Sta, base-type=uint8, implementation-data-type=uint8, transfer-property=TRIGGERED-ON-CHANGE
          signal CAN2_DISC_ButtSta: start 143, 1 bit, big-endian, i-signal-type=PRIMITIVE, init-value=constant-reference=Init_CAN2_DISC_ButtSta, base-type=uint8, implementation-data-type=uint8, transfer-property=PENDING
          signal CAN2_DISC_Sta: start 159, 2 bit, big-endian, i-signal-type=PRIMITIVE, init-value=constant-reference=Init_CAN2_DISC_Sta, base-type=uint8, implementation-data-type=uint8, transfer-property=PENDING
          signal CAN2_DemoModeStaChk: start 31, 2 bit, big-endian, i-signal-type=PRIMITIVE, init-value=constant-reference=Init_CAN2_DemoModeStaChk, base-type=uint8, implementation-data-type=uint8, transfer-property=PENDING
          signal CAN2_Dimmer: start 254, 7 bit, big-endian, i-signal-type=PRIMITIVE, init-value=constant-reference=Init_CAN2_Dimmer, base-type=uint8, implementation-data-type=uint8, transfer-property=TRIGGERED-ON-CHANGE
          signal CAN2_DimmerEN: start 15, 1 bit, big-endian, i-signal-type=PRIMITIVE, init-value=constant-reference=Init_CAN2_DimmerEN, base-type=uint8, implementation-data-type=uint8, transfer-property=TRIGGERED-ON-CHANGE
          signal CAN2_DisengageP_Fail: start 21, 1 bit, big-endian, i-signal-type=PRIMITIVE, init-value=constant-reference=Init_CAN2_DisengageP_Fail, base-type=uint8, implementation-data-type=uint8, transfer-property=TRIGGERED-ON-CHANGE
          signal CAN2_DoorLockIND: start 204, 1 bit, big-endian, i-signal-type=PRIMITIVE, init-value=constant-reference=Init_CAN2_DoorLockIND, base-type=uint8, implementation-data-type=uint8, transfer-property=TRIGGERED-ON-CHANGE
          signal CAN2_DrDoorSW: start 225, 1 bit, big-endian, i-signal-type=PRIMITIVE, init-value=constant-reference=Init_CAN2_DrDoorSW, base-type=uint8, implementation-data-type=uint8, transfer-property=TRIGGERED-ON-CHANGE
          signal CAN2_Dr_SeatSta: start 239, 2 bit, big-endian, i-signal-type=PRIMITIVE, init-value=constant-reference=Init_CAN2_Dr_SeatSta, base-type=uint8, implementation-data-type=uint8, transfer-property=TRIGGERED-ON-CHANGE
          signal CAN2_DynoModeStaChk: start 19, 2 bit, big-endian, i-signal-type=PRIMITIVE, init-value=constant-reference=Init_CAN2_DynoModeStaChk, base-type=uint8, implementation-data-type=uint8, transfer-property=PENDING
          signal CAN2_EDriveSysErr_AccPedalErr: start 141, 1 bit, big-endian, i-signal-type=PRIMITIVE, init-value=constant-reference=Init_CAN2_EDriveSysErr_AccPedalErr, base-type=uint8, implementation-data-type=uint8, transfer-property=TRIGGERED-ON-CHANGE
          signal CAN2_EDriveSysErr_MCUErr: start 203, 1 bit, big-endian, i-signal-type=PRIMITIVE, init-value=constant-reference=Init_CAN2_EDriveSysErr_MCUErr, base-type=uint8, implementation-data-type=uint8, transfer-property=TRIGGERED-ON-CHANGE
          signal CAN2_EDriveSysErr_ShifterErr: start 223, 1 bit, big-endian, i-signal-type=PRIMITIVE, init-value=constant-reference=Init_CAN2_EDriveSysErr_ShifterErr, base-type=uint8, implementation-data-type=uint8, transfer-property=TRIGGERED-ON-CHANGE
          signal CAN2_EDriveSysErr_VCUErr: start 142, 1 bit, big-endian, i-signal-type=PRIMITIVE, init-value=constant-reference=Init_CAN2_EDriveSysErr_VCUErr, base-type=uint8, implementation-data-type=uint8, transfer-property=TRIGGERED-ON-CHANGE
          signal CAN2_EVDriveMode: start 157, 2 bit, big-endian, i-signal-type=PRIMITIVE, init-value=constant-reference=Init_CAN2_EVDriveMode, base-type=uint8, implementation-data-type=uint8, transfer-property=TRIGGERED-ON-CHANGE
          signal CAN2_Eng_AGSCloseSta: start 222, 1 bit, big-endian, i-signal-type=PRIMITIVE, init-value=constant-reference=Init_CAN2_Eng_AGSCloseSta, base-type=uint8, implementation-data-type=uint8, transfer-property=TRIGGERED-ON-CHANGE
          signal CAN2_Eng_ActvDmpDisabSta: start 153, 2 bit, big-endian, i-signal-type=PRIMITIVE, init-value=constant-reference=Init_CAN2_Eng_ActvDmpDisabSta, base-type=uint8, implementation-data-type=uint8, transfer-property=TRIGGERED-ON-CHANGE
          signal CAN2_Eng_CoastDwSta: start 155, 2 bit, big-endian, i-signal-type=PRIMITIVE, init-value=constant-reference=Init_CAN2_Eng_CoastDwSta, base-type=uint8, implementation-data-type=uint8, transfer-property=TRIGGERED-ON-CHANGE
          signal CAN2_Eng_PwrLockSta: start 185, 2 bit, big-endian, i-signal-type=PRIMITIVE, init-value=constant-reference=Init_CAN2_Eng_PwrLockSta, base-type=uint8, implementation-data-type=uint8, transfer-property=TRIGGERED-ON-CHANGE
          signal CAN2_EngageP_Fail: start 22, 1 bit, big-endian, i-signal-type=PRIMITIVE, init-value=constant-reference=Init_CAN2_EngageP_Fail, base-type=uint8, implementation-data-type=uint8, transfer-property=TRIGGERED-ON-CHANGE
          signal CAN2_FDC_BCM_AutoWipHSpdEN_Sta: start 288, 1 bit, big-endian, i-signal-type=PRIMITIVE, init-value=constant-reference=Init_CAN2_FDC_BCM_AutoWipHSpdEN_Sta, base-type=uint8, implementation-data-type=uint8, transfer-property=TRIGGERED-ON-CHANGE
          signal CAN2_FDC_BCM_HMIKey1Func_Sta: start 335, 4 bit, big-endian, i-signal-type=PRIMITIVE, init-value=constant-reference=Init_CAN2_FDC_BCM_HMIKey1Func_Sta, base-type=uint8, implementation-data-type=uint8, transfer-property=TRIGGERED-ON-CHANGE
          signal CAN2_FDC_BCM_HMIKey2Func_Sta: start 331, 4 bit, big-endian, i-signal-type=PRIMITIVE, init-value=constant-reference=Init_CAN2_FDC_BCM_HMIKey2Func_Sta, base-type=uint8, implementation-data-type=uint8, transfer-property=TRIGGERED-ON-CHANGE
          signal CAN2_FDC_BCM_HMIKey3Func_Sta: start 343, 4 bit, big-endian, i-signal-type=PRIMITIVE, init-value=constant-reference=Init_CAN2_FDC_BCM_HMIKey3Func_Sta, base-type=uint8, implementation-data-type=uint8, transfer-property=TRIGGERED-ON-CHANGE
          signal CAN2_FDC_BCM_HMIKey4Func_Sta: start 339, 4 bit, big-endian, i-signal-type=PRIMITIVE, init-value=constant-reference=Init_CAN2_FDC_BCM_HMIKey4Func_Sta, base-type=uint8, implementation-data-type=uint8, transfer-property=TRIGGERED-ON-CHANGE
          signal CAN2_FDC_BCM_HMIKey5Func_Sta: start 351, 4 bit, big-endian, i-signal-type=PRIMITIVE, init-value=constant-reference=Init_CAN2_FDC_BCM_HMIKey5Func_Sta, base-type=uint8, implementation-data-type=uint8, transfer-property=TRIGGERED-ON-CHANGE
          signal CAN2_FDC_BCM_HMIKey6Func_Sta: start 347, 4 bit, big-endian, i-signal-type=PRIMITIVE, init-value=constant-reference=Init_CAN2_FDC_BCM_HMIKey6Func_Sta, base-type=uint8, implementation-data-type=uint8, transfer-property=TRIGGERED-ON-CHANGE
          signal CAN2_FDC_BCM_HMIKey7Func_Sta: start 359, 4 bit, big-endian, i-signal-type=PRIMITIVE, init-value=constant-reference=Init_CAN2_FDC_BCM_HMIKey7Func_Sta, base-type=uint8, implementation-data-type=uint8, transfer-property=TRIGGERED-ON-CHANGE
          signal CAN2_FDC_BCM_HMIKey8Func_Sta: start 355, 4 bit, big-endian, i-signal-type=PRIMITIVE, init-value=constant-reference=Init_CAN2_FDC_BCM_HMIKey8Func_Sta, base-type=uint8, implementation-data-type=uint8, transfer-property=TRIGGERED-ON-CHANGE
          signal CAN2_FDC_RAPS_ErrWarn_Sta: start 315, 3 bit, big-endian, i-signal-type=PRIMITIVE, init-value=constant-reference=Init_CAN2_FDC_RAPS_ErrWarn_Sta, base-type=uint8, implementation-data-type=uint8, transfer-property=TRIGGERED-ON-CHANGE
          signal CAN2_FDC_THCM_CLEVentY_Sta: start 271, 7 bit, big-endian, i-signal-type=PRIMITIVE, init-value=constant-reference=Init_CAN2_FDC_THCM_CLEVentY_Sta, base-type=uint8, implementation-data-type=uint8, transfer-property=PENDING
          signal CAN2_FDC_THCM_CLEVentZ_Sta: start 303, 7 bit, big-endian, i-signal-type=PRIMITIVE, init-value=constant-reference=Init_CAN2_FDC_THCM_CLEVentZ_Sta, base-type=uint8, implementation-data-type=uint8, transfer-property=PENDING
          signal CAN2_FDC_THCM_CLVent_Sta: start 256, 1 bit, big-endian, i-signal-type=PRIMITIVE, init-value=constant-reference=Init_CAN2_FDC_THCM_CLVent_Sta, base-type=uint8, implementation-data-type=uint8, transfer-property=TRIGGERED-ON-CHANGE
          signal CAN2_FDC_THCM_CREVentY_Sta: start 279, 7 bit, big-endian, i-signal-type=PRIMITIVE, init-value=constant-reference=Init_CAN2_FDC_THCM_CREVentY_Sta, base-type=uint8, implementation-data-type=uint8, transfer-property=PENDING
          signal CAN2_FDC_THCM_CREVentZ_Sta: start 311, 7 bit, big-endian, i-signal-type=PRIMITIVE, init-value=constant-reference=Init_CAN2_FDC_THCM_CREVentZ_Sta, base-type=uint8, implementation-data-type=uint8, transfer-property=PENDING
          signal CAN2_FDC_THCM_CRVent_Sta: start 272, 1 bit, big-endian, i-signal-type=PRIMITIVE, init-value=constant-reference=Init_CAN2_FDC_THCM_CRVent_Sta, base-type=uint8, implementation-data-type=uint8, transfer-property=TRIGGERED-ON-CHANGE
          signal CAN2_FDC_THCM_LEVentMode_Sta: start 13, 3 bit, big-endian, i-signal-type=PRIMITIVE, init-value=constant-reference=Init_CAN2_FDC_THCM_LEVentMode_Sta, base-type=uint8, implementation-data-type=uint8, transfer-property=TRIGGERED-ON-CHANGE
          signal CAN2_FDC_THCM_LEVentY_Sta: start 7, 7 bit, big-endian, i-signal-type=PRIMITIVE, init-value=constant-reference=Init_CAN2_FDC_THCM_LEVentY_Sta, base-type=uint8, implementation-data-type=uint8, transfer-property=PENDING
          signal CAN2_FDC_THCM_LEVentZ_Sta: start 287, 7 bit, big-endian, i-signal-type=PRIMITIVE, init-value=constant-reference=Init_CAN2_FDC_THCM_LEVentZ_Sta, base-type=uint8, implementation-data-type=uint8, transfer-property=PENDING
          signal CAN2_FDC_THCM_LVent_Sta: start 0, 1 bit, big-endian, i-signal-type=PRIMITIVE, init-value=constant-reference=Init_CAN2_FDC_THCM_LVent_Sta, base-type=uint8, implementation-data-type=uint8, transfer-property=TRIGGERED-ON-CHANGE
          signal CAN2_FDC_THCM_PreWPTCHeat_Sta: start 317, 2 bit, big-endian, i-signal-type=PRIMITIVE, init-value=constant-reference=Init_CAN2_FDC_THCM_PreWPTCHeat_Sta, base-type=uint8, implementation-data-type=uint8, transfer-property=TRIGGERED-ON-CHANGE
          signal CAN2_FDC_THCM_REVentMode_Sta: start 10, 3 bit, big-endian, i-signal-type=PRIMITIVE, init-value=constant-reference=Init_CAN2_FDC_THCM_REVentMode_Sta, base-type=uint8, implementation-data-type=uint8, transfer-property=TRIGGERED-ON-CHANGE
          signal CAN2_FDC_THCM_REVentY_Sta: start 263, 7 bit, big-endian, i-signal-type=PRIMITIVE, init-value=constant-reference=Init_CAN2_FDC_THCM_REVentY_Sta, base-type=uint8, implementation-data-type=uint8, transfer-property=PENDING
          signal CAN2_FDC_THCM_REVentZ_Sta: start 295, 7 bit, big-endian, i-signal-type=PRIMITIVE, init-value=constant-reference=Init_CAN2_FDC_THCM_REVentZ_Sta, base-type=uint8, implementation-data-type=uint8, transfer-property=PENDING
          signal CAN2_FDC_THCM_RVent_Sta: start 264, 1 bit, big-endian, i-signal-type=PRIMITIVE, init-value=constant-reference=Init_CAN2_FDC_THCM_RVent_Sta, base-type=uint8, implementation-data-type=uint8, transfer-property=TRIGGERED-ON-CHANGE
          signal CAN2_FDC_V2L_IVIV2LDischarg_Cmd: start 327, 2 bit, big-endian, i-signal-type=PRIMITIVE, init-value=constant-reference=Init_CAN2_FDC_V2L_IVIV2LDischarg_Cmd, base-type=uint8, implementation-data-type=uint8, transfer-property=TRIGGERED-ON-CHANGE
          signal CAN2_FDC_VCU_LVChrgFreq_Sta: start 325, 2 bit, big-endian, i-signal-type=PRIMITIVE, init-value=constant-reference=Init_CAN2_FDC_VCU_LVChrgFreq_Sta, base-type=uint8, implementation-data-type=uint8, transfer-property=TRIGGERED-ON-CHANGE
          signal CAN2_FDC_VCU_LVStaDropQuick_Sta: start 312, 1 bit, big-endian, i-signal-type=PRIMITIVE, init-value=constant-reference=Init_CAN2_FDC_VCU_LVStaDropQuick_Sta, base-type=uint8, implementation-data-type=uint8, transfer-property=TRIGGERED-ON-CHANGE
          signal CAN2_FDC_VCU_LVStaTooLow_Sta: start 304, 1 bit, big-endian, i-signal-type=PRIMITIVE, init-value=constant-reference=Init_CAN2_FDC_VCU_LVStaTooLow_Sta, base-type=uint8, implementation-data-type=uint8, transfer-property=TRIGGERED-ON-CHANGE
          signal CAN2_FDC_VCU_PwrSaveReq_Cmd: start 14, 1 bit, big-endian, i-signal-type=PRIMITIVE, init-value=constant-reference=Init_CAN2_FDC_VCU_PwrSaveReq_Cmd, base-type=uint8, implementation-data-type=uint8, transfer-property=TRIGGERED-ON-CHANGE
          signal CAN2_FDC_VCU_TrailerDisOPD_Sta: start 296, 1 bit, big-endian, i-signal-type=PRIMITIVE, init-value=constant-reference=Init_CAN2_FDC_VCU_TrailerDisOPD_Sta, base-type=uint8, implementation-data-type=uint8, transfer-property=TRIGGERED-ON-CHANGE
          signal CAN2_FD_ABS_Warning: start 183, 2 bit, big-endian, i-signal-type=PRIMITIVE, init-value=constant-reference=Init_CAN2_FD_ABS_Warning, base-type=uint8, implementation-data-type=uint8, transfer-property=TRIGGERED-ON-CHANGE
          signal CAN2_FD_AGS_Cmd: start 111, 8 bit, big-endian, i-signal-type=PRIMITIVE, init-value=constant-reference=Init_CAN2_FD_AGS_Cmd, base-type=uint8, implementation-data-type=uint8, transfer-property=PENDING
          signal CAN2_FD_Battery_Charge_Warning: start 181, 2 bit, big-endian, i-signal-type=PRIMITIVE, init-value=constant-reference=Init_CAN2_FD_Battery_Charge_Warning, base-type=uint8, implementation-data-type=uint8, transfer-property=TRIGGERED-ON-CHANGE
          signal CAN2_FD_EBMErrSta: start 221, 2 bit, big-endian, i-signal-type=PRIMITIVE, init-value=constant-reference=Init_CAN2_FD_EBMErrSta, base-type=uint8, implementation-data-type=uint8, transfer-property=TRIGGERED-ON-CHANGE
          signal CAN2_FD_EDrive_System: start 179, 2 bit, big-endian, i-signal-type=PRIMITIVE, init-value=constant-reference=Init_CAN2_FD_EDrive_System, base-type=uint8, implementation-data-type=uint8, transfer-property=TRIGGERED-ON-CHANGE
          signal CAN2_FD_EPB_Error: start 177, 2 bit, big-endian, i-signal-type=PRIMITIVE, init-value=constant-reference=Init_CAN2_FD_EPB_Error, base-type=uint8, implementation-data-type=uint8, transfer-property=TRIGGERED-ON-CHANGE
          signal CAN2_FD_HV_Battery_Fault: start 191, 2 bit, big-endian, i-signal-type=PRIMITIVE, init-value=constant-reference=Init_CAN2_FD_HV_Battery_Fault, base-type=uint8, implementation-data-type=uint8, transfer-property=TRIGGERED-ON-CHANGE
          signal CAN2_FD_Park_Brake_Warning: start 189, 2 bit, big-endian, i-signal-type=PRIMITIVE, init-value=constant-reference=Init_CAN2_FD_Park_Brake_Warning, base-type=uint8, implementation-data-type=uint8, transfer-property=TRIGGERED-ON-CHANGE
          signal CAN2_FD_Power_limitation: start 187, 2 bit, big-endian, i-signal-type=PRIMITIVE, init-value=constant-reference=Init_CAN2_FD_Power_limitation, base-type=uint8, implementation-data-type=uint8, transfer-property=TRIGGERED-ON-CHANGE
          signal CAN2_FD_Steering_Warning: start 161, 2 bit, big-endian, i-signal-type=PRIMITIVE, init-value=constant-reference=Init_CAN2_FD_Steering_Warning, base-type=uint8, implementation-data-type=uint8, transfer-property=TRIGGERED-ON-CHANGE
          signal CAN2_FD_TCS_Indicator: start 163, 2 bit, big-endian, i-signal-type=PRIMITIVE, init-value=constant-reference=Init_CAN2_FD_TCS_Indicator, base-type=uint8, implementation-data-type=uint8, transfer-property=TRIGGERED-ON-CHANGE
          signal CAN2_FD_Telltale_Fail: start 164, 1 bit, big-endian, i-signal-type=PRIMITIVE, init-value=constant-reference=Init_CAN2_FD_Telltale_Fail, base-type=uint8, implementation-data-type=uint8, transfer-property=TRIGGERED-ON-CHANGE
          signal CAN2_FalseNPrevent_Sta: start 20, 1 bit, big-endian, i-signal-type=PRIMITIVE, init-value=constant-reference=Init_CAN2_FalseNPrevent_Sta, base-type=uint8, implementation-data-type=uint8, transfer-property=TRIGGERED-ON-CHANGE
          signal CAN2_FeatSetSpdFinal_raw32: start 199, 8 bit, big-endian, i-signal-type=PRIMITIVE, init-value=constant-reference=Init_CAN2_FeatSetSpdFinal_raw32, base-type=uint8, implementation-data-type=uint8, transfer-property=TRIGGERED-ON-CHANGE
          signal CAN2_FollowMe: start 242, 1 bit, big-endian, i-signal-type=PRIMITIVE, init-value=constant-reference=Init_CAN2_FollowMe, base-type=uint8, implementation-data-type=uint8, transfer-property=PENDING
          signal CAN2_Fr_FogLamp: start 237, 1 bit, big-endian, i-signal-type=PRIMITIVE, init-value=constant-reference=Init_CAN2_Fr_FogLamp, base-type=uint8, implementation-data-type=uint8, transfer-property=TRIGGERED-ON-CHANGE
          signal CAN2_HVRlyOpFail: start 125, 1 bit, big-endian, i-signal-type=PRIMITIVE, init-value=constant-reference=Init_CAN2_HVRlyOpFail, base-type=uint8, implementation-data-type=uint8, transfer-property=TRIGGERED-ON-CHANGE
          signal CAN2_HVSysErr_IsolationErr: start 210, 1 bit, big-endian, i-signal-type=PRIMITIVE, init-value=constant-reference=Init_CAN2_HVSysErr_IsolationErr, base-type=uint8, implementation-data-type=uint8, transfer-property=TRIGGERED-ON-CHANGE
          signal CAN2_HVSysErr_PackErr: start 211, 1 bit, big-endian, i-signal-type=PRIMITIVE, init-value=constant-reference=Init_CAN2_HVSysErr_PackErr, base-type=uint8, implementation-data-type=uint8, transfer-property=TRIGGERED-ON-CHANGE
          signal CAN2_HVSysErr_RelayErr: start 212, 1 bit, big-endian, i-signal-type=PRIMITIVE, init-value=constant-reference=Init_CAN2_HVSysErr_RelayErr, base-type=uint8, implementation-data-type=uint8, transfer-property=TRIGGERED-ON-CHANGE
          signal CAN2_H_Beam: start 226, 1 bit, big-endian, i-signal-type=PRIMITIVE, init-value=constant-reference=Init_CAN2_H_Beam, base-type=uint8, implementation-data-type=uint8, transfer-property=TRIGGERED-ON-CHANGE
          signal CAN2_HazardSW: start 227, 1 bit, big-endian, i-signal-type=PRIMITIVE, init-value=constant-reference=Init_CAN2_HazardSW, base-type=uint8, implementation-data-type=uint8, transfer-property=TRIGGERED-ON-CHANGE
          signal CAN2_HoodSW: start 213, 1 bit, big-endian, i-signal-type=PRIMITIVE, init-value=constant-reference=Init_CAN2_HoodSW, base-type=uint8, implementation-data-type=uint8, transfer-property=TRIGGERED-ON-CHANGE
          signal CAN2_LBSD: start 230, 1 bit, big-endian, i-signal-type=PRIMITIVE, init-value=constant-reference=Init_CAN2_LBSD, base-type=uint8, implementation-data-type=uint8, transfer-property=TRIGGERED-ON-CHANGE
          signal CAN2_LDRL: start 233, 1 bit, big-endian, i-signal-type=PRIMITIVE, init-value=constant-reference=Init_CAN2_LDRL, base-type=uint8, implementation-data-type=uint8, transfer-property=TRIGGERED-ON-CHANGE
          signal CAN2_LTurnLP: start 246, 1 bit, big-endian, i-signal-type=PRIMITIVE, init-value=constant-reference=Init_CAN2_LTurnLP, base-type=uint8, implementation-data-type=uint8, transfer-property=TRIGGERED-ON-CHANGE
          signal CAN2_LVChrgFuncStaChk: start 39, 2 bit, big-endian, i-signal-type=PRIMITIVE, init-value=constant-reference=Init_CAN2_LVChrgFuncStaChk, base-type=uint8, implementation-data-type=uint8, transfer-property=PENDING
          signal CAN2_LVSilentChrgReq: start 280, 1 bit, big-endian, i-signal-type=PRIMITIVE, init-value=constant-reference=Init_CAN2_LVSilentChrgReq, base-type=uint8, implementation-data-type=uint8, transfer-property=TRIGGERED-ON-CHANGE
          signal CAN2_LVSilentChrgSta: start 319, 2 bit, big-endian, i-signal-type=PRIMITIVE, init-value=constant-reference=Init_CAN2_LVSilentChrgSta, base-type=uint8, implementation-data-type=uint8, transfer-property=TRIGGERED-ON-CHANGE
          signal CAN2_LVSysErr_PwrOutpErr: start 208, 1 bit, big-endian, i-signal-type=PRIMITIVE, init-value=constant-reference=Init_CAN2_LVSysErr_PwrOutpErr, base-type=uint8, implementation-data-type=uint8, transfer-property=TRIGGERED-ON-CHANGE
          signal CAN2_L_Beam: start 224, 1 bit, big-endian, i-signal-type=PRIMITIVE, init-value=constant-reference=Init_CAN2_L_Beam, base-type=uint8, implementation-data-type=uint8, transfer-property=TRIGGERED-ON-CHANGE
          signal CAN2_LimphomeAct: start 207, 1 bit, big-endian, i-signal-type=PRIMITIVE, init-value=constant-reference=Init_CAN2_LimphomeAct, base-type=uint8, implementation-data-type=uint8, transfer-property=TRIGGERED-ON-CHANGE
          signal CAN2_LockSetting: start 247, 1 bit, big-endian, i-signal-type=PRIMITIVE, init-value=constant-reference=Init_CAN2_LockSetting, base-type=uint8, implementation-data-type=uint8, transfer-property=TRIGGERED-ON-CHANGE
          signal CAN2_MCUActDisFail: start 115, 1 bit, big-endian, i-signal-type=PRIMITIVE, init-value=constant-reference=Init_CAN2_MCUActDisFail, base-type=uint8, implementation-data-type=uint8, transfer-property=TRIGGERED-ON-CHANGE
          signal CAN2_MSA_Crl_Sta: start 29, 3 bit, big-endian, i-signal-type=PRIMITIVE, init-value=constant-reference=Init_CAN2_MSA_Crl_Sta, base-type=uint8, implementation-data-type=uint8, transfer-property=TRIGGERED-ON-CHANGE
          signal CAN2_MeterIndSpeed_raw32: start 151, 8 bit, big-endian, i-signal-type=PRIMITIVE, init-value=constant-reference=Init_CAN2_MeterIndSpeed_raw32, base-type=uint8, implementation-data-type=uint8, transfer-property=PENDING
          signal CAN2_PAS_Sta_F_Sys: start 214, 1 bit, big-endian, i-signal-type=PRIMITIVE, init-value=constant-reference=Init_CAN2_PAS_Sta_F_Sys, base-type=uint8, implementation-data-type=uint8, transfer-property=PENDING
          signal CAN2_PosLamp: start 232, 1 bit, big-endian, i-signal-type=PRIMITIVE, init-value=constant-reference=Init_CAN2_PosLamp, base-type=uint8, implementation-data-type=uint8, transfer-property=TRIGGERED-ON-CHANGE
          signal CAN2_PsDoorSW: start 229, 1 bit, big-endian, i-signal-type=PRIMITIVE, init-value=constant-reference=Init_CAN2_PsDoorSW, base-type=uint8, implementation-data-type=uint8, transfer-property=TRIGGERED-ON-CHANGE
          signal CAN2_PwrSta: start 34, 3 bit, big-endian, i-signal-type=PRIMITIVE, init-value=constant-reference=Init_CAN2_PwrSta, base-type=uint8, implementation-data-type=uint8, transfer-property=TRIGGERED-ON-CHANGE
          signal CAN2_PwrStaErr: start 209, 1 bit, big-endian, i-signal-type=PRIMITIVE, init-value=constant-reference=Init_CAN2_PwrStaErr, base-type=uint8, implementation-data-type=uint8, transfer-property=TRIGGERED-ON-CHANGE
          signal CAN2_PwrStaONTOIVIPopReq: start 114, 1 bit, big-endian, i-signal-type=PRIMITIVE, init-value=constant-reference=Init_CAN2_PwrStaONTOIVIPopReq, base-type=uint8, implementation-data-type=uint8, transfer-property=TRIGGERED-ON-CHANGE
          signal CAN2_PwrStaONTOIVIPopT: start 123, 12 bit, big-endian, i-signal-type=PRIMITIVE, init-value=constant-reference=Init_CAN2_PwrStaONTOIVIPopT, base-type=uint16, implementation-data-type=uint16, transfer-property=TRIGGERED-ON-CHANGE
          signal CAN2_RBSD: start 241, 1 bit, big-endian, i-signal-type=PRIMITIVE, init-value=constant-reference=Init_CAN2_RBSD, base-type=uint8, implementation-data-type=uint8, transfer-property=TRIGGERED-ON-CHANGE
          signal CAN2_RDRL: start 234, 1 bit, big-endian, i-signal-type=PRIMITIVE, init-value=constant-reference=Init_CAN2_RDRL, base-type=uint8, implementation-data-type=uint8, transfer-property=TRIGGERED-ON-CHANGE
          signal CAN2_RLDoorSW: start 231, 1 bit, big-endian, i-signal-type=PRIMITIVE, init-value=constant-reference=Init_CAN2_RLDoorSW, base-type=uint8, implementation-data-type=uint8, transfer-property=TRIGGERED-ON-CHANGE
          signal CAN2_RRDoorSW: start 206, 1 bit, big-endian, i-signal-type=PRIMITIVE, init-value=constant-reference=Init_CAN2_RRDoorSW, base-type=uint8, implementation-data-type=uint8, transfer-property=TRIGGERED-ON-CHANGE
          signal CAN2_RTurnLP: start 245, 1 bit, big-endian, i-signal-type=PRIMITIVE, init-value=constant-reference=Init_CAN2_RTurnLP, base-type=uint8, implementation-data-type=uint8, transfer-property=TRIGGERED-ON-CHANGE
          signal CAN2_Req_Internal_V2L_Status_Lamp: start 217, 2 bit, big-endian, i-signal-type=PRIMITIVE, init-value=constant-reference=Init_CAN2_Req_Internal_V2L_Status_Lamp, base-type=uint8, implementation-data-type=uint8, transfer-property=PENDING
          signal CAN2_Req_V2LSwOn: start 140, 1 bit, big-endian, i-signal-type=PRIMITIVE, init-value=constant-reference=Init_CAN2_Req_V2LSwOn, base-type=uint8, implementation-data-type=uint8, transfer-property=TRIGGERED-ON-CHANGE
          signal CAN2_Req_V2L_IVI_Popup: start 139, 4 bit, big-endian, i-signal-type=PRIMITIVE, init-value=constant-reference=Init_CAN2_Req_V2L_IVI_Popup, base-type=uint8, implementation-data-type=uint8, transfer-property=TRIGGERED-ON-CHANGE
          signal CAN2_ReverseLamp: start 235, 1 bit, big-endian, i-signal-type=PRIMITIVE, init-value=constant-reference=Init_CAN2_ReverseLamp, base-type=uint8, implementation-data-type=uint8, transfer-property=TRIGGERED-ON-CHANGE
          signal CAN2_Rr_Defog: start 215, 1 bit, big-endian, i-signal-type=PRIMITIVE, init-value=constant-reference=Init_CAN2_Rr_Defog, base-type=uint8, implementation-data-type=uint8, transfer-property=TRIGGERED-ON-CHANGE
          signal CAN2_Rr_FogLamp: start 228, 1 bit, big-endian, i-signal-type=PRIMITIVE, init-value=constant-reference=Init_CAN2_Rr_FogLamp, base-type=uint8, implementation-data-type=uint8, transfer-property=TRIGGERED-ON-CHANGE
          signal CAN2_ShiftGearPosn: start 37, 3 bit, big-endian, i-signal-type=PRIMITIVE, init-value=constant-reference=Init_CAN2_ShiftGearPosn, base-type=uint8, implementation-data-type=uint8, transfer-property=TRIGGERED-ON-CHANGE
          signal CAN2_SysAllowReadySta: start 124, 1 bit, big-endian, i-signal-type=PRIMITIVE, init-value=constant-reference=Init_CAN2_SysAllowReadySta, base-type=uint8, implementation-data-type=uint8, transfer-property=TRIGGERED-ON-CHANGE
          signal CAN2_SysPwrSta: start 119, 4 bit, big-endian, i-signal-type=PRIMITIVE, init-value=constant-reference=Init_CAN2_SysPwrSta, base-type=uint8, implementation-data-type=uint8, transfer-property=TRIGGERED-ON-CHANGE
          signal CAN2_Tailgate_SW: start 255, 1 bit, big-endian, i-signal-type=PRIMITIVE, init-value=constant-reference=Init_CAN2_Tailgate_SW, base-type=uint8, implementation-data-type=uint8, transfer-property=TRIGGERED-ON-CHANGE
          signal CAN2_VCUBrkSWSta: start 87, 2 bit, big-endian, i-signal-type=PRIMITIVE, init-value=constant-reference=Init_CAN2_VCUBrkSWSta, base-type=uint8, implementation-data-type=uint8, transfer-property=TRIGGERED-ON-CHANGE
          signal CAN2_VCUFLDoorSta: start 113, 1 bit, big-endian, i-signal-type=PRIMITIVE, init-value=constant-reference=Init_CAN2_VCUFLDoorSta, base-type=uint8, implementation-data-type=uint8, transfer-property=TRIGGERED-ON-CHANGE
          signal CAN2_VCUFRDoorSta: start 112, 1 bit, big-endian, i-signal-type=PRIMITIVE, init-value=constant-reference=Init_CAN2_VCUFRDoorSta, base-type=uint8, implementation-data-type=uint8, transfer-property=TRIGGERED-ON-CHANGE
          signal CAN2_VCUHoodSWSta: start 166, 1 bit, big-endian, i-signal-type=PRIMITIVE, init-value=constant-reference=Init_CAN2_VCUHoodSWSta, base-type=uint8, implementation-data-type=uint8, transfer-property=TRIGGERED-ON-CHANGE
          signal CAN2_VCURLDoorSta: start 127, 1 bit, big-endian, i-signal-type=PRIMITIVE, init-value=constant-reference=Init_CAN2_VCURLDoorSta, base-type=uint8, implementation-data-type=uint8, transfer-property=TRIGGERED-ON-CHANGE
          signal CAN2_VCURRDoorSta: start 126, 1 bit, big-endian, i-signal-type=PRIMITIVE, init-value=constant-reference=Init_CAN2_VCURRDoorSta, base-type=uint8, implementation-data-type=uint8, transfer-property=TRIGGERED-ON-CHANGE
          signal CAN2_VCUTailgateSWSta: start 165, 1 bit, big-endian, i-signal-type=PRIMITIVE, init-value=constant-reference=Init_CAN2_VCUTailgateSWSta, base-type=uint8, implementation-data-type=uint8, transfer-property=TRIGGERED-ON-CHANGE
          signal CAN2_VCU_OPDHold: start 218, 1 bit, big-endian, i-signal-type=PRIMITIVE, init-value=constant-reference=Init_CAN2_VCU_OPDHold, base-type=uint8, implementation-data-type=uint8, transfer-property=PENDING
          signal CAN2_VehMalfunLevel: start 202, 3 bit, big-endian, i-signal-type=PRIMITIVE, init-value=constant-reference=Init_CAN2_VehMalfunLevel, base-type=uint8, implementation-data-type=uint8, transfer-property=TRIGGERED-ON-CHANGE
          signal CAN2_XWDMode: start 47, 2 bit, big-endian, i-signal-type=PRIMITIVE, init-value=constant-reference=Init_CAN2_XWDMode, base-type=uint8, implementation-data-type=uint8, transfer-property=TRIGGERED-ON-CHANGE
          signal CAN2_sigAirIntenZon1St: start 63, 4 bit, big-endian, i-signal-type=PRIMITIVE, init-value=constant-reference=Init_CAN2_sigAirIntenZon1St, base-type=uint8, implementation-data-type=uint8, transfer-property=PENDING
          signal CAN2_sigAirIntenZon3St: start 59, 4 bit, big-endian, i-signal-type=PRIMITIVE, init-value=constant-reference=Init_CAN2_sigAirIntenZon3St, base-type=uint8, implementation-data-type=uint8, transfer-property=PENDING
          signal CAN2_sigAmbAirT: start 103, 8 bit, big-endian, i-signal-type=PRIMITIVE, init-value=constant-reference=Init_CAN2_sigAmbAirT, base-type=uint8, implementation-data-type=uint8, transfer-property=PENDING
          signal CAN2_sigCbnAirT: start 95, 8 bit, big-endian, i-signal-type=PRIMITIVE, init-value=constant-reference=Init_CAN2_sigCbnAirT, base-type=uint8, implementation-data-type=uint8, transfer-property=PENDING
          signal CAN2_sigDfrstSt: start 70, 1 bit, big-endian, i-signal-type=PRIMITIVE, init-value=constant-reference=Init_CAN2_sigDfrstSt, base-type=uint8, implementation-data-type=uint8, transfer-property=PENDING
          signal CAN2_sigHvacSt: start 78, 1 bit, big-endian, i-signal-type=PRIMITIVE, init-value=constant-reference=Init_CAN2_sigHvacSt, base-type=uint8, implementation-data-type=uint8, transfer-property=PENDING
          signal CAN2_sigRecircSt: start 79, 1 bit, big-endian, i-signal-type=PRIMITIVE, init-value=constant-reference=Init_CAN2_sigRecircSt, base-type=uint8, implementation-data-type=uint8, transfer-property=PENDING
          signal CAN2_sigSetTempZon1St: start 85, 6 bit, big-endian, i-signal-type=PRIMITIVE, init-value=constant-reference=Init_CAN2_sigSetTempZon1St, base-type=uint8, implementation-data-type=uint8, transfer-property=PENDING
          signal CAN2_sigSetTempZon2St: start 77, 6 bit, big-endian, i-signal-type=PRIMITIVE, init-value=constant-reference=Init_CAN2_sigSetTempZon2St, base-type=uint8, implementation-data-type=uint8, transfer-property=PENDING
          signal CAN2_sigSetTempZon3St: start 69, 6 bit, big-endian, i-signal-type=PRIMITIVE, init-value=constant-reference=Init_CAN2_sigSetTempZon3St, base-type=uint8, implementation-data-type=uint8, transfer-property=PENDING
          signal CAN2_sigWindDirZon1St: start 54, 3 bit, big-endian, i-signal-type=PRIMITIVE, init-value=constant-reference=Init_CAN2_sigWindDirZon1St, base-type=uint8, implementation-data-type=uint8, transfer-property=PENDING
          signal CAN2_sigWindDirZon3St: start 50, 3 bit, big-endian, i-signal-type=PRIMITIVE, init-value=constant-reference=Init_CAN2_sigWindDirZon3St, base-type=uint8, implementation-data-type=uint8, transfer-property=PENDING
      frame CAN2_FD2_CE200_1: id 0x435, frame-length=32, can-addressing-mode=STANDARD, can-fd-frame-support=true, can-frame-rx-behavior=CAN-FD, can-frame-tx-behavior=CAN-FD
        pdu CAN2_FD2_CE200_1: length=32, minimum-delay=0.0, transmission-mode-true-timing={cyclic-timing=time-period=0.2, event-controlled-timing={number-of-repetitions=0, repetition-period=0}}, unused-bit-pattern=0
          mapping CAN2_SG_FD2_CE200_1: i-signal-group=CAN2_SG_FD2_CE200_1, start-position=0, transfer-property=TRIGGERED-ON-CHANGE
          signal CAN2_AutoLTips: start 19, 2 bit, big-endian, i-signal-type=PRIMITIVE, init-value=constant-reference=Init_CAN2_AutoLTips, base-type=uint8, implementation-data-type=uint8, transfer-property=TRIGGERED-ON-CHANGE
          signal CAN2_CWheelTips: start 17, 2 bit, big-endian, i-signal-type=PRIMITIVE, init-value=constant-reference=Init_CAN2_CWheelTips, base-type=uint8, implementation-data-type=uint8, transfer-property=TRIGGERED-ON-CHANGE
          signal CAN2_FDC_BCM_Acc1Sta_Sta: start 183, 2 bit, big-endian, i-signal-type=PRIMITIVE, init-value=constant-reference=Init_CAN2_FDC_BCM_Acc1Sta_Sta, base-type=uint8, implementation-data-type=uint8, transfer-property=TRIGGERED-ON-CHANGE
          signal CAN2_FDC_BCM_Acc2Sta_Sta: start 191, 2 bit, big-endian, i-signal-type=PRIMITIVE, init-value=constant-reference=Init_CAN2_FDC_BCM_Acc2Sta_Sta, base-type=uint8, implementation-data-type=uint8, transfer-property=TRIGGERED-ON-CHANGE
          signal CAN2_FDC_BCM_Acc3Sta_Sta: start 199, 2 bit, big-endian, i-signal-type=PRIMITIVE, init-value=constant-reference=Init_CAN2_FDC_BCM_Acc3Sta_Sta, base-type=uint8, implementation-data-type=uint8, transfer-property=TRIGGERED-ON-CHANGE
          signal CAN2_FDC_BCM_Acc4Sta_Sta: start 207, 2 bit, big-endian, i-signal-type=PRIMITIVE, init-value=constant-reference=Init_CAN2_FDC_BCM_Acc4Sta_Sta, base-type=uint8, implementation-data-type=uint8, transfer-property=TRIGGERED-ON-CHANGE
          signal CAN2_FDC_BCM_Acc5Sta_Sta: start 215, 2 bit, big-endian, i-signal-type=PRIMITIVE, init-value=constant-reference=Init_CAN2_FDC_BCM_Acc5Sta_Sta, base-type=uint8, implementation-data-type=uint8, transfer-property=TRIGGERED-ON-CHANGE
          signal CAN2_FDC_BCM_AmbBrightSta_Sta: start 158, 7 bit, big-endian, i-signal-type=PRIMITIVE, init-value=constant-reference=Init_CAN2_FDC_BCM_AmbBrightSta_Sta, base-type=uint8, implementation-data-type=uint8, transfer-property=TRIGGERED-ON-CHANGE
          signal CAN2_FDC_BCM_AmbColorSta_Sta: start 165, 6 bit, big-endian, i-signal-type=PRIMITIVE, init-value=constant-reference=Init_CAN2_FDC_BCM_AmbColorSta_Sta, base-type=uint8, implementation-data-type=uint8, transfer-property=TRIGGERED-ON-CHANGE
          signal CAN2_FDC_BCM_AmbDimEN_Sta: start 166, 1 bit, big-endian, i-signal-type=PRIMITIVE, init-value=constant-reference=Init_CAN2_FDC_BCM_AmbDimEN_Sta, base-type=uint8, implementation-data-type=uint8, transfer-property=TRIGGERED-ON-CHANGE
          signal CAN2_FDC_BCM_AmbFunEN_Sta: start 167, 1 bit, big-endian, i-signal-type=PRIMITIVE, init-value=constant-reference=Init_CAN2_FDC_BCM_AmbFunEN_Sta, base-type=uint8, implementation-data-type=uint8, transfer-property=TRIGGERED-ON-CHANGE
          signal CAN2_FDC_BCM_AmbLinkDriSta_Sta: start 171, 1 bit, big-endian, i-signal-type=PRIMITIVE, init-value=constant-reference=Init_CAN2_FDC_BCM_AmbLinkDriSta_Sta, base-type=uint8, implementation-data-type=uint8, transfer-property=TRIGGERED-ON-CHANGE
          signal CAN2_FDC_BCM_AmbODAEN_Sta: start 224, 1 bit, big-endian, i-signal-type=PRIMITIVE, init-value=constant-reference=Init_CAN2_FDC_BCM_AmbODAEN_Sta, base-type=uint8, implementation-data-type=uint8, transfer-property=TRIGGERED-ON-CHANGE
          signal CAN2_FDC_BCM_AmbPwrWarnEN_Sta: start 225, 1 bit, big-endian, i-signal-type=PRIMITIVE, init-value=constant-reference=Init_CAN2_FDC_BCM_AmbPwrWarnEN_Sta, base-type=uint8, implementation-data-type=uint8, transfer-property=TRIGGERED-ON-CHANGE
          signal CAN2_FDC_BCM_AmbWelEN_Sta: start 159, 1 bit, big-endian, i-signal-type=PRIMITIVE, init-value=constant-reference=Init_CAN2_FDC_BCM_AmbWelEN_Sta, base-type=uint8, implementation-data-type=uint8, transfer-property=TRIGGERED-ON-CHANGE
          signal CAN2_FDC_BCM_AutoLock_Sta: start 252, 1 bit, big-endian, i-signal-type=PRIMITIVE, init-value=constant-reference=Init_CAN2_FDC_BCM_AutoLock_Sta, base-type=uint8, implementation-data-type=uint8, transfer-property=TRIGGERED-ON-CHANGE
          signal CAN2_FDC_BCM_AutoUnlock_Sta: start 253, 1 bit, big-endian, i-signal-type=PRIMITIVE, init-value=constant-reference=Init_CAN2_FDC_BCM_AutoUnlock_Sta, base-type=uint8, implementation-data-type=uint8, transfer-property=TRIGGERED-ON-CHANGE
          signal CAN2_FDC_BCM_CLWinLockDr_Sta: start 245, 1 bit, big-endian, i-signal-type=PRIMITIVE, init-value=constant-reference=Init_CAN2_FDC_BCM_CLWinLockDr_Sta, base-type=uint8, implementation-data-type=uint8, transfer-property=TRIGGERED-ON-CHANGE
          signal CAN2_FDC_BCM_DSEATentryfset_Sta: start 251, 1 bit, big-endian, i-signal-type=PRIMITIVE, init-value=constant-reference=Init_CAN2_FDC_BCM_DSEATentryfset_Sta, base-type=uint8, implementation-data-type=uint8, transfer-property=TRIGGERED-ON-CHANGE
          signal CAN2_FDC_BCM_FollowMeENFun_Sta: start 218, 1 bit, big-endian, i-signal-type=PRIMITIVE, init-value=constant-reference=Init_CAN2_FDC_BCM_FollowMeENFun_Sta, base-type=uint8, implementation-data-type=uint8, transfer-property=TRIGGERED-ON-CHANGE
          signal CAN2_FDC_BCM_HBeamADB_Cmd: start 95, 2 bit, big-endian, i-signal-type=PRIMITIVE, init-value=constant-reference=Init_CAN2_FDC_BCM_HBeamADB_Cmd, base-type=uint8, implementation-data-type=uint8, transfer-property=TRIGGERED-ON-CHANGE
          signal CAN2_FDC_BCM_Key10Acc_Sta: start 213, 3 bit, big-endian, i-signal-type=PRIMITIVE, init-value=constant-reference=Init_CAN2_FDC_BCM_Key10Acc_Sta, base-type=uint8, implementation-data-type=uint8, transfer-property=TRIGGERED-ON-CHANGE
          signal CAN2_FDC_BCM_Key1Acc_Sta: start 178, 3 bit, big-endian, i-signal-type=PRIMITIVE, init-value=constant-reference=Init_CAN2_FDC_BCM_Key1Acc_Sta, base-type=uint8, implementation-data-type=uint8, transfer-property=TRIGGERED-ON-CHANGE
          signal CAN2_FDC_BCM_Key2Acc_Sta: start 181, 3 bit, big-endian, i-signal-type=PRIMITIVE, init-value=constant-reference=Init_CAN2_FDC_BCM_Key2Acc_Sta, base-type=uint8, implementation-data-type=uint8, transfer-property=TRIGGERED-ON-CHANGE
          signal CAN2_FDC_BCM_Key3Acc_Sta: start 186, 3 bit, big-endian, i-signal-type=PRIMITIVE, init-value=constant-reference=Init_CAN2_FDC_BCM_Key3Acc_Sta, base-type=uint8, implementation-data-type=uint8, transfer-property=TRIGGERED-ON-CHANGE
          signal CAN2_FDC_BCM_Key4Acc_Sta: start 189, 3 bit, big-endian, i-signal-type=PRIMITIVE, init-value=constant-reference=Init_CAN2_FDC_BCM_Key4Acc_Sta, base-type=uint8, implementation-data-type=uint8, transfer-property=TRIGGERED-ON-CHANGE
          signal CAN2_FDC_BCM_Key5Acc_Sta: start 194, 3 bit, big-endian, i-signal-type=PRIMITIVE, init-value=constant-reference=Init_CAN2_FDC_BCM_Key5Acc_Sta, base-type=uint8, implementation-data-type=uint8, transfer-property=TRIGGERED-ON-CHANGE
          signal CAN2_FDC_BCM_Key6Acc_Sta: start 197, 3 bit, big-endian, i-signal-type=PRIMITIVE, init-value=constant-reference=Init_CAN2_FDC_BCM_Key6Acc_Sta, base-type=uint8, implementation-data-type=uint8, transfer-property=TRIGGERED-ON-CHANGE
          signal CAN2_FDC_BCM_Key7Acc_Sta: start 202, 3 bit, big-endian, i-signal-type=PRIMITIVE, init-value=constant-reference=Init_CAN2_FDC_BCM_Key7Acc_Sta, base-type=uint8, implementation-data-type=uint8, transfer-property=TRIGGERED-ON-CHANGE
          signal CAN2_FDC_BCM_Key8Acc_Sta: start 205, 3 bit, big-endian, i-signal-type=PRIMITIVE, init-value=constant-reference=Init_CAN2_FDC_BCM_Key8Acc_Sta, base-type=uint8, implementation-data-type=uint8, transfer-property=TRIGGERED-ON-CHANGE
          signal CAN2_FDC_BCM_Key9Acc_Sta: start 210, 3 bit, big-endian, i-signal-type=PRIMITIVE, init-value=constant-reference=Init_CAN2_FDC_BCM_Key9Acc_Sta, base-type=uint8, implementation-data-type=uint8, transfer-property=TRIGGERED-ON-CHANGE
          signal CAN2_FDC_BCM_LockAlarm_Cmd: start 217, 2 bit, big-endian, i-signal-type=PRIMITIVE, init-value=constant-reference=Init_CAN2_FDC_BCM_LockAlarm_Cmd, base-type=uint8, implementation-data-type=uint8, transfer-property=TRIGGERED-ON-CHANGE
          signal CAN2_FDC_BCM_PTGOpenHeight_Sta: start 174, 3 bit, big-endian, i-signal-type=PRIMITIVE, init-value=constant-reference=Init_CAN2_FDC_BCM_PTGOpenHeight_Sta, base-type=uint8, implementation-data-type=uint8, transfer-property=TRIGGERED-ON-CHANGE
          signal CAN2_FDC_BCM_RmLpModeENFun_Sta: start 219, 1 bit, big-endian, i-signal-type=PRIMITIVE, init-value=constant-reference=Init_CAN2_FDC_BCM_RmLpModeENFun_Sta, base-type=uint8, implementation-data-type=uint8, transfer-property=TRIGGERED-ON-CHANGE
          signal CAN2_FDC_BCM_TurnSwTSetSta_Sta: start 227, 2 bit, big-endian, i-signal-type=PRIMITIVE, init-value=constant-reference=Init_CAN2_FDC_BCM_TurnSwTSetSta_Sta, base-type=uint8, implementation-data-type=uint8, transfer-property=TRIGGERED-ON-CHANGE
          signal CAN2_FDC_BCM_UserNow_Sta: start 170, 3 bit, big-endian, i-signal-type=PRIMITIVE, init-value=constant-reference=Init_CAN2_FDC_BCM_UserNow_Sta, base-type=uint8, implementation-data-type=uint8, transfer-property=TRIGGERED-ON-CHANGE
          signal CAN2_FDC_BCM_WalkInUnLkEnFun_Sta: start 220, 1 bit, big-endian, i-signal-type=PRIMITIVE, init-value=constant-reference=Init_CAN2_FDC_BCM_WalkInUnLkEnFun_Sta, base-type=uint8, implementation-data-type=uint8, transfer-property=TRIGGERED-ON-CHANGE
          signal CAN2_FDC_BCM_WalkOutLkEnFun_Sta: start 221, 1 bit, big-endian, i-signal-type=PRIMITIVE, init-value=constant-reference=Init_CAN2_FDC_BCM_WalkOutLkEnFun_Sta, base-type=uint8, implementation-data-type=uint8, transfer-property=TRIGGERED-ON-CHANGE
          signal CAN2_FDC_DKC_DkeyShowIVI_Sta: start 235, 4 bit, big-endian, i-signal-type=PRIMITIVE, init-value=constant-reference=Init_CAN2_FDC_DKC_DkeyShowIVI_Sta, base-type=uint8, implementation-data-type=uint8, transfer-property=TRIGGERED-ON-CHANGE
          signal CAN2_FDC_DKC_KeyMiss_Sta: start 223, 1 bit, big-endian, i-signal-type=PRIMITIVE, init-value=constant-reference=Init_CAN2_FDC_DKC_KeyMiss_Sta, base-type=uint8, implementation-data-type=uint8, transfer-property=TRIGGERED-ON-CHANGE
          signal CAN2_FDC_DKC_KeyNum_Sta: start 243, 4 bit, big-endian, i-signal-type=PRIMITIVE, init-value=constant-reference=Init_CAN2_FDC_DKC_KeyNum_Sta, base-type=uint8, implementation-data-type=uint8, transfer-property=TRIGGERED-ON-CHANGE
          signal CAN2_FDC_DKC_KeyType_Sta: start 255, 2 bit, big-endian, i-signal-type=PRIMITIVE, init-value=constant-reference=Init_CAN2_FDC_DKC_KeyType_Sta, base-type=uint8, implementation-data-type=uint8, transfer-property=TRIGGERED-ON-CHANGE
          signal CAN2_FDC_DKC_UIDLowPower_Sta: start 236, 1 bit, big-endian, i-signal-type=PRIMITIVE, init-value=constant-reference=Init_CAN2_FDC_DKC_UIDLowPower_Sta, base-type=uint8, implementation-data-type=uint8, transfer-property=TRIGGERED-ON-CHANGE
          signal CAN2_FDC_FGS_AirInt_Sta: start 247, 2 bit, big-endian, i-signal-type=PRIMITIVE, init-value=constant-reference=Init_CAN2_FDC_FGS_AirInt_Sta, base-type=uint8, implementation-data-type=uint8, transfer-property=TRIGGERED-ON-CHANGE
          signal CAN2_FDC_FGS_FGSCh_Sta: start 239, 2 bit, big-endian, i-signal-type=PRIMITIVE, init-value=constant-reference=Init_CAN2_FDC_FGS_FGSCh_Sta, base-type=uint8, implementation-data-type=uint8, transfer-property=TRIGGERED-ON-CHANGE
          signal CAN2_FDC_FGS_IONSW_Sta: start 237, 1 bit, big-endian, i-signal-type=PRIMITIVE, init-value=constant-reference=Init_CAN2_FDC_FGS_IONSW_Sta, base-type=uint8, implementation-data-type=uint8, transfer-property=TRIGGERED-ON-CHANGE
          signal CAN2_FDC_SPTG_SPTGENFun_Sta: start 222, 1 bit, big-endian, i-signal-type=PRIMITIVE, init-value=constant-reference=Init_CAN2_FDC_SPTG_SPTGENFun_Sta, base-type=uint8, implementation-data-type=uint8, transfer-property=TRIGGERED-ON-CHANGE
          signal CAN2_FDC_THCM_APTCForceOFF_Sta: start 244, 1 bit, big-endian, i-signal-type=PRIMITIVE, init-value=constant-reference=Init_CAN2_FDC_THCM_APTCForceOFF_Sta, base-type=uint8, implementation-data-type=uint8, transfer-property=TRIGGERED-ON-CHANGE
          signal CAN2_FDC_THCM_APTCWarning_Sta: start 175, 1 bit, big-endian, i-signal-type=PRIMITIVE, init-value=constant-reference=Init_CAN2_FDC_THCM_APTCWarning_Sta, base-type=uint8, implementation-data-type=uint8, transfer-property=TRIGGERED-ON-CHANGE
          signal CAN2_FDC_THCM_AirIntZ3_Sta: start 250, 3 bit, big-endian, i-signal-type=PRIMITIVE, init-value=constant-reference=Init_CAN2_FDC_THCM_AirIntZ3_Sta, base-type=uint8, implementation-data-type=uint8, transfer-property=TRIGGERED-ON-CHANGE
          signal CAN2_LFBatWarn: start 97, 1 bit, big-endian, i-signal-type=PRIMITIVE, init-value=constant-reference=Init_CAN2_LFBatWarn, base-type=uint8, implementation-data-type=uint8, transfer-property=TRIGGERED-ON-CHANGE
          signal CAN2_LFPressIndi: start 115, 2 bit, big-endian, i-signal-type=PRIMITIVE, init-value=constant-reference=Init_CAN2_LFPressIndi, base-type=uint8, implementation-data-type=uint8, transfer-property=TRIGGERED-ON-CHANGE
          signal CAN2_LFSensorFail: start 109, 1 bit, big-endian, i-signal-type=PRIMITIVE, init-value=constant-reference=Init_CAN2_LFSensorFail, base-type=uint8, implementation-data-type=uint8, transfer-property=TRIGGERED-ON-CHANGE
          signal CAN2_LFWheelDebug: start 101, 1 bit, big-endian, i-signal-type=PRIMITIVE, init-value=constant-reference=Init_CAN2_LFWheelDebug, base-type=uint8, implementation-data-type=uint8, transfer-property=TRIGGERED-ON-CHANGE
          signal CAN2_LFWheelPSW: start 143, 8 bit, big-endian, i-signal-type=PRIMITIVE, init-value=constant-reference=Init_CAN2_LFWheelPSW, base-type=uint8, implementation-data-type=uint8, transfer-property=TRIGGERED-ON-CHANGE
          signal CAN2_LFWheelPress: start 79, 8 bit, big-endian, i-signal-type=PRIMITIVE, init-value=constant-reference=Init_CAN2_LFWheelPress, base-type=uint8, implementation-data-type=uint8, transfer-property=TRIGGERED-ON-CHANGE
          signal CAN2_LFWheelShield: start 231, 1 bit, big-endian, i-signal-type=PRIMITIVE, init-value=constant-reference=Init_CAN2_LFWheelShield, base-type=uint8, implementation-data-type=uint8, transfer-property=TRIGGERED-ON-CHANGE
          signal CAN2_LFWheelTemp: start 47, 8 bit, big-endian, i-signal-type=PRIMITIVE, init-value=constant-reference=Init_CAN2_LFWheelTemp, base-type=uint8, implementation-data-type=uint8, transfer-property=TRIGGERED-ON-CHANGE
          signal CAN2_LFWheelTmpIndi: start 105, 1 bit, big-endian, i-signal-type=PRIMITIVE, init-value=constant-reference=Init_CAN2_LFWheelTmpIndi, base-type=uint8, implementation-data-type=uint8, transfer-property=TRIGGERED-ON-CHANGE
          signal CAN2_LRBatWarn: start 99, 1 bit, big-endian, i-signal-type=PRIMITIVE, init-value=constant-reference=Init_CAN2_LRBatWarn, base-type=uint8, implementation-data-type=uint8, transfer-property=TRIGGERED-ON-CHANGE
          signal CAN2_LRPressIndi: start 119, 2 bit, big-endian, i-signal-type=PRIMITIVE, init-value=constant-reference=Init_CAN2_LRPressIndi, base-type=uint8, implementation-data-type=uint8, transfer-property=TRIGGERED-ON-CHANGE
          signal CAN2_LRSensorFail: start 111, 1 bit, big-endian, i-signal-type=PRIMITIVE, init-value=constant-reference=Init_CAN2_LRSensorFail, base-type=uint8, implementation-data-type=uint8, transfer-property=TRIGGERED-ON-CHANGE
          signal CAN2_LRWheelDebug: start 103, 1 bit, big-endian, i-signal-type=PRIMITIVE, init-value=constant-reference=Init_CAN2_LRWheelDebug, base-type=uint8, implementation-data-type=uint8, transfer-property=TRIGGERED-ON-CHANGE
          signal CAN2_LRWheelPSW: start 151, 8 bit, big-endian, i-signal-type=PRIMITIVE, init-value=constant-reference=Init_CAN2_LRWheelPSW, base-type=uint8, implementation-data-type=uint8, transfer-property=TRIGGERED-ON-CHANGE
          signal CAN2_LRWheelPress: start 63, 8 bit, big-endian, i-signal-type=PRIMITIVE, init-value=constant-reference=Init_CAN2_LRWheelPress, base-type=uint8, implementation-data-type=uint8, transfer-property=TRIGGERED-ON-CHANGE
          signal CAN2_LRWheelShield: start 230, 1 bit, big-endian, i-signal-type=PRIMITIVE, init-value=constant-reference=Init_CAN2_LRWheelShield, base-type=uint8, implementation-data-type=uint8, transfer-property=TRIGGERED-ON-CHANGE
          signal CAN2_LRWheelTemp: start 31, 8 bit, big-endian, i-signal-type=PRIMITIVE, init-value=constant-reference=Init_CAN2_LRWheelTemp, base-type=uint8, implementation-data-type=uint8, transfer-property=TRIGGERED-ON-CHANGE
          signal CAN2_LRWheelTmpIndi: start 107, 1 bit, big-endian, i-signal-type=PRIMITIVE, init-value=constant-reference=Init_CAN2_LRWheelTmpIndi, base-type=uint8, implementation-data-type=uint8, transfer-property=TRIGGERED-ON-CHANGE
          signal CAN2_RFBatWarn: start 96, 1 bit, big-endian, i-signal-type=PRIMITIVE, init-value=constant-reference=Init_CAN2_RFBatWarn, base-type=uint8, implementation-data-type=uint8, transfer-property=TRIGGERED-ON-CHANGE
          signal CAN2_RFPressIndi: start 113, 2 bit, big-endian, i-signal-type=PRIMITIVE, init-value=constant-reference=Init_CAN2_RFPressIndi, base-type=uint8, implementation-data-type=uint8, transfer-property=TRIGGERED-ON-CHANGE
          signal CAN2_RFSensorFail: start 108, 1 bit, big-endian, i-signal-type=PRIMITIVE, init-value=constant-reference=Init_CAN2_RFSensorFail, base-type=uint8, implementation-data-type=uint8, transfer-property=TRIGGERED-ON-CHANGE
          signal CAN2_RFWheelDebug: start 100, 1 bit, big-endian, i-signal-type=PRIMITIVE, init-value=constant-reference=Init_CAN2_RFWheelDebug, base-type=uint8, implementation-data-type=uint8, transfer-property=TRIGGERED-ON-CHANGE
          signal CAN2_RFWheelPSW: start 135, 8 bit, big-endian, i-signal-type=PRIMITIVE, init-value=constant-reference=Init_CAN2_RFWheelPSW, base-type=uint8, implementation-data-type=uint8, transfer-property=TRIGGERED-ON-CHANGE
          signal CAN2_RFWheelPress: start 87, 8 bit, big-endian, i-signal-type=PRIMITIVE, init-value=constant-reference=Init_CAN2_RFWheelPress, base-type=uint8, implementation-data-type=uint8, transfer-property=TRIGGERED-ON-CHANGE
          signal CAN2_RFWheelShield: start 229, 1 bit, big-endian, i-signal-type=PRIMITIVE, init-value=constant-reference=Init_CAN2_RFWheelShield, base-type=uint8, implementation-data-type=uint8, transfer-property=TRIGGERED-ON-CHANGE
          signal CAN2_RFWheelTemp: start 55, 8 bit, big-endian, i-signal-type=PRIMITIVE, init-value=constant-reference=Init_CAN2_RFWheelTemp, base-type=uint8, implementation-data-type=uint8, transfer-property=TRIGGERED-ON-CHANGE
          signal CAN2_RFWheelTmpIndi: start 104, 1 bit, big-endian, i-signal-type=PRIMITIVE, init-value=constant-reference=Init_CAN2_RFWheelTmpIndi, base-type=uint8, implementation-data-type=uint8, transfer-property=TRIGGERED-ON-CHANGE
          signal CAN2_RRBatWarn: start 98, 1 bit, big-endian, i-signal-type=PRIMITIVE, init-value=constant-reference=Init_CAN2_RRBatWarn, base-type=uint8, implementation-data-type=uint8, transfer-property=TRIGGERED-ON-CHANGE
          signal CAN2_RRPressIndi: start 117, 2 bit, big-endian, i-signal-type=PRIMITIVE, init-value=constant-reference=Init_CAN2_RRPressIndi, base-type=uint8, implementation-data-type=uint8, transfer-property=TRIGGERED-ON-CHANGE
          signal CAN2_RRSensorFail: start 110, 1 bit, big-endian, i-signal-type=PRIMITIVE, init-value=constant-reference=Init_CAN2_RRSensorFail, base-type=uint8, implementation-data-type=uint8, transfer-property=TRIGGERED-ON-CHANGE
          signal CAN2_RRWheelDebug: start 102, 1 bit, big-endian, i-signal-type=PRIMITIVE, init-value=constant-reference=Init_CAN2_RRWheelDebug, base-type=uint8, implementation-data-type=uint8, transfer-property=TRIGGERED-ON-CHANGE
          signal CAN2_RRWheelPSW: start 127, 8 bit, big-endian, i-signal-type=PRIMITIVE, init-value=constant-reference=Init_CAN2_RRWheelPSW, base-type=uint8, implementation-data-type=uint8, transfer-property=TRIGGERED-ON-CHANGE
          signal CAN2_RRWheelPress: start 71, 8 bit, big-endian, i-signal-type=PRIMITIVE, init-value=constant-reference=Init_CAN2_RRWheelPress, base-type=uint8, implementation-data-type=uint8, transfer-property=TRIGGERED-ON-CHANGE
          signal CAN2_RRWheelShield: start 228, 1 bit, big-endian, i-signal-type=PRIMITIVE, init-value=constant-reference=Init_CAN2_RRWheelShield, base-type=uint8, implementation-data-type=uint8, transfer-property=TRIGGERED-ON-CHANGE
          signal CAN2_RRWheelTemp: start 39, 8 bit, big-endian, i-signal-type=PRIMITIVE, init-value=constant-reference=Init_CAN2_RRWheelTemp, base-type=uint8, implementation-data-type=uint8, transfer-property=TRIGGERED-ON-CHANGE
          signal CAN2_RRWheelTmpIndi: start 106, 1 bit, big-endian, i-signal-type=PRIMITIVE, init-value=constant-reference=Init_CAN2_RRWheelTmpIndi, base-type=uint8, implementation-data-type=uint8, transfer-property=TRIGGERED-ON-CHANGE
          signal CAN2_TPMSWarnIndi: start 23, 2 bit, big-endian, i-signal-type=PRIMITIVE, init-value=constant-reference=Init_CAN2_TPMSWarnIndi, base-type=uint8, implementation-data-type=uint8, transfer-property=TRIGGERED-ON-CHANGE
          signal CAN2_TPMS_Cali_Butt_Allow: start 20, 1 bit, big-endian, i-signal-type=PRIMITIVE, init-value=constant-reference=Init_CAN2_TPMS_Cali_Butt_Allow, base-type=uint8, implementation-data-type=uint8, transfer-property=TRIGGERED-ON-CHANGE
          signal CAN2_TPMS_Res_Butt_Allow: start 21, 1 bit, big-endian, i-signal-type=PRIMITIVE, init-value=constant-reference=Init_CAN2_TPMS_Res_Butt_Allow, base-type=uint8, implementation-data-type=uint8, transfer-property=TRIGGERED-ON-CHANGE
      frame CAN2_FD2_OTA1: id 0x438, frame-length=12, can-addressing-mode=STANDARD, can-fd-frame-support=true, can-frame-rx-behavior=CAN-FD, can-frame-tx-behavior=CAN-FD
        pdu CAN2_FD2_OTA1: length=12, minimum-delay=0.0, transmission-mode-true-timing={cyclic-timing=time-period=0.2, event-controlled-timing={number-of-repetitions=0, repetition-period=0}}, unused-bit-pattern=0
          mapping CAN2_SG_FD2_OTA1: i-signal-group=CAN2_SG_FD2_OTA1, start-position=0, transfer-property=TRIGGERED-ON-CHANGE
          signal CAN2_OTA_DL_Available: start 8, 1 bit, big-endian, i-signal-type=PRIMITIVE, init-value=constant-reference=Init_CAN2_OTA_DL_Available, base-type=uint8, implementation-data-type=uint8, transfer-property=TRIGGERED-ON-CHANGE
          signal CAN2_OTA_DL_Speed: start 27, 20 bit, big-endian, i-signal-type=PRIMITIVE, init-value=constant-reference=Init_CAN2_OTA_DL_Speed, base-type=uint32, implementation-data-type=uint32, transfer-property=TRIGGERED-ON-CHANGE
          signal CAN2_OTA_Debug_Code: start 79, 8 bit, big-endian, i-signal-type=PRIMITIVE, init-value=constant-reference=Init_CAN2_OTA_Debug_Code, base-type=uint8, implementation-data-type=uint8, transfer-property=PENDING
          signal CAN2_OTA_Emergency_Sta: start 61, 2 bit, big-endian, i-signal-type=PRIMITIVE, init-value=constant-reference=Init_CAN2_OTA_Emergency_Sta, base-type=uint8, implementation-data-type=uint8, transfer-property=TRIGGERED-ON-CHANGE
          signal CAN2_OTA_InVehicle_FW: start 29, 2 bit, big-endian, i-signal-type=PRIMITIVE, init-value=constant-reference=Init_CAN2_OTA_InVehicle_FW, base-type=uint8, implementation-data-type=uint8, transfer-property=TRIGGERED-ON-CHANGE
          signal CAN2_OTA_Lock_Req: start 31, 1 bit, big-endian, i-signal-type=PRIMITIVE, init-value=constant-reference=Init_CAN2_OTA_Lock_Req, base-type=uint8, implementation-data-type=uint8, transfer-property=TRIGGERED-ON-CHANGE
          signal CAN2_OTA_MDA_Status: start 52, 5 bit, big-endian, i-signal-type=PRIMITIVE, init-value=constant-reference=Init_CAN2_OTA_MDA_Status, base-type=uint8, implementation-data-type=uint8, transfer-property=TRIGGERED-ON-CHANGE
          signal CAN2_OTA_Mode: start 9, 1 bit, big-endian, i-signal-type=PRIMITIVE, init-value=constant-reference=Init_CAN2_OTA_Mode, base-type=uint8, implementation-data-type=uint8, transfer-property=TRIGGERED-ON-CHANGE
          signal CAN2_OTA_Network_Type: start 11, 2 bit, big-endian, i-signal-type=PRIMITIVE, init-value=constant-reference=Init_CAN2_OTA_Network_Type, base-type=uint8, implementation-data-type=uint8, transfer-property=TRIGGERED-ON-CHANGE
          signal CAN2_OTA_Permit_Agreed: start 63, 1 bit, big-endian, i-signal-type=PRIMITIVE, init-value=constant-reference=Init_CAN2_OTA_Permit_Agreed, base-type=uint8, implementation-data-type=uint8, transfer-property=PENDING
          signal CAN2_OTA_Progress_Rate: start 7, 8 bit, big-endian, i-signal-type=PRIMITIVE, init-value=constant-reference=Init_CAN2_OTA_Progress_Rate, base-type=uint8, implementation-data-type=uint8, transfer-property=TRIGGERED-ON-CHANGE
          signal CAN2_OTA_Remained_Time: start 58, 11 bit, big-endian, i-signal-type=PRIMITIVE, init-value=constant-reference=Init_CAN2_OTA_Remained_Time, base-type=uint16, implementation-data-type=uint16, transfer-property=PENDING
          signal CAN2_OTA_TBOXResetReq: start 30, 1 bit, big-endian, i-signal-type=PRIMITIVE, init-value=constant-reference=Init_CAN2_OTA_TBOXResetReq, base-type=uint8, implementation-data-type=uint8, transfer-property=TRIGGERED-ON-CHANGE
          signal CAN2_OTA_Update_Available: start 62, 1 bit, big-endian, i-signal-type=PRIMITIVE, init-value=constant-reference=Init_CAN2_OTA_Update_Available, base-type=uint8, implementation-data-type=uint8, transfer-property=TRIGGERED-ON-CHANGE
          signal CAN2_OTA_Updating_ECU_8bit: start 23, 8 bit, big-endian, i-signal-type=PRIMITIVE, init-value=constant-reference=Init_CAN2_OTA_Updating_ECU_8bit, base-type=uint8, implementation-data-type=uint8, transfer-property=TRIGGERED-ON-CHANGE
      frame CAN2_FD2_Version: id 0x3C3, frame-length=48, can-addressing-mode=STANDARD, can-fd-frame-support=true, can-frame-rx-behavior=CAN-FD, can-frame-tx-behavior=CAN-FD
        pdu CAN2_FD2_Version: length=48, minimum-delay=0.0, transmission-mode-true-timing=cyclic-timing=time-period=5, unused-bit-pattern=0
          mapping CAN2_SG_FD2_Version: i-signal-group=CAN2_SG_FD2_Version, start-position=0, transfer-property=PENDING
          signal CAN2_FUSION_HW_Ver1: start 7, 8 bit, big-endian, i-signal-type=PRIMITIVE, init-value=constant-reference=Init_CAN2_FUSION_HW_Ver1, base-type=uint8, implementation-data-type=uint8, transfer-property=PENDING
          signal CAN2_FUSION_HW_Ver2: start 15, 8 bit, big-endian, i-signal-type=PRIMITIVE, init-value=constant-reference=Init_CAN2_FUSION_HW_Ver2, base-type=uint8, implementation-data-type=uint8, transfer-property=PENDING
          signal CAN2_FUSION_HW_Ver3: start 23, 8 bit, big-endian, i-signal-type=PRIMITIVE, init-value=constant-reference=Init_CAN2_FUSION_HW_Ver3, base-type=uint8, implementation-data-type=uint8, transfer-property=PENDING
          signal CAN2_FUSION_SW_CarModel1: start 31, 8 bit, big-endian, i-signal-type=PRIMITIVE, init-value=constant-reference=Init_CAN2_FUSION_SW_CarModel1, base-type=uint8, implementation-data-type=uint8, transfer-property=PENDING
          signal CAN2_FUSION_SW_CarModel2: start 39, 8 bit, big-endian, i-signal-type=PRIMITIVE, init-value=constant-reference=Init_CAN2_FUSION_SW_CarModel2, base-type=uint8, implementation-data-type=uint8, transfer-property=PENDING
          signal CAN2_FUSION_SW_CarModel3: start 47, 8 bit, big-endian, i-signal-type=PRIMITIVE, init-value=constant-reference=Init_CAN2_FUSION_SW_CarModel3, base-type=uint8, implementation-data-type=uint8, transfer-property=PENDING
          signal CAN2_FUSION_SW_Controller1: start 55, 8 bit, big-endian, i-signal-type=PRIMITIVE, init-value=constant-reference=Init_CAN2_FUSION_SW_Controller1, base-type=uint8, implementation-data-type=uint8, transfer-property=PENDING
          signal CAN2_FUSION_SW_Controller2: start 63, 8 bit, big-endian, i-signal-type=PRIMITIVE, init-value=constant-reference=Init_CAN2_FUSION_SW_Controller2, base-type=uint8, implementation-data-type=uint8, transfer-property=PENDING
          signal CAN2_FUSION_SW_Country1: start 119, 8 bit, big-endian, i-signal-type=PRIMITIVE, init-value=constant-reference=Init_CAN2_FUSION_SW_Country1, base-type=uint8, implementation-data-type=uint8, transfer-property=PENDING
          signal CAN2_FUSION_SW_Country2: start 127, 8 bit, big-endian, i-signal-type=PRIMITIVE, init-value=constant-reference=Init_CAN2_FUSION_SW_Country2, base-type=uint8, implementation-data-type=uint8, transfer-property=PENDING
          signal CAN2_FUSION_SW_ECUGen1: start 143, 8 bit, big-endian, i-signal-type=PRIMITIVE, init-value=constant-reference=Init_CAN2_FUSION_SW_ECUGen1, base-type=uint8, implementation-data-type=uint8, transfer-property=PENDING
          signal CAN2_FUSION_SW_ECUGen2: start 151, 8 bit, big-endian, i-signal-type=PRIMITIVE, init-value=constant-reference=Init_CAN2_FUSION_SW_ECUGen2, base-type=uint8, implementation-data-type=uint8, transfer-property=PENDING
          signal CAN2_FUSION_SW_Major1: start 71, 8 bit, big-endian, i-signal-type=PRIMITIVE, init-value=constant-reference=Init_CAN2_FUSION_SW_Major1, base-type=uint8, implementation-data-type=uint8, transfer-property=PENDING
          signal CAN2_FUSION_SW_Major2: start 79, 8 bit, big-endian, i-signal-type=PRIMITIVE, init-value=constant-reference=Init_CAN2_FUSION_SW_Major2, base-type=uint8, implementation-data-type=uint8, transfer-property=PENDING
          signal CAN2_FUSION_SW_Minor1: start 87, 8 bit, big-endian, i-signal-type=PRIMITIVE, init-value=constant-reference=Init_CAN2_FUSION_SW_Minor1, base-type=uint8, implementation-data-type=uint8, transfer-property=PENDING
          signal CAN2_FUSION_SW_Minor2: start 95, 8 bit, big-endian, i-signal-type=PRIMITIVE, init-value=constant-reference=Init_CAN2_FUSION_SW_Minor2, base-type=uint8, implementation-data-type=uint8, transfer-property=PENDING
          signal CAN2_FUSION_SW_Patch1: start 103, 8 bit, big-endian, i-signal-type=PRIMITIVE, init-value=constant-reference=Init_CAN2_FUSION_SW_Patch1, base-type=uint8, implementation-data-type=uint8, transfer-property=PENDING
          signal CAN2_FUSION_SW_Patch2: start 111, 8 bit, big-endian, i-signal-type=PRIMITIVE, init-value=constant-reference=Init_CAN2_FUSION_SW_Patch2, base-type=uint8, implementation-data-type=uint8, transfer-property=PENDING
          signal CAN2_FUSION_SW_SHA1: start 223, 8 bit, big-endian, i-signal-type=PRIMITIVE, init-value=constant-reference=Init_CAN2_FUSION_SW_SHA1, base-type=uint8, implementation-data-type=uint8, transfer-property=PENDING
          signal CAN2_FUSION_SW_SHA2: start 231, 8 bit, big-endian, i-signal-type=PRIMITIVE, init-value=constant-reference=Init_CAN2_FUSION_SW_SHA2, base-type=uint8, implementation-data-type=uint8, transfer-property=PENDING
          signal CAN2_FUSION_SW_SHA3: start 239, 8 bit, big-endian, i-signal-type=PRIMITIVE, init-value=constant-reference=Init_CAN2_FUSION_SW_SHA3, base-type=uint8, implementation-data-type=uint8, transfer-property=PENDING
          signal CAN2_FUSION_SW_SHA4: start 247, 8 bit, big-endian, i-signal-type=PRIMITIVE, init-value=constant-reference=Init_CAN2_FUSION_SW_SHA4, base-type=uint8, implementation-data-type=uint8, transfer-property=PENDING
          signal CAN2_FUSION_SW_SHA5: start 255, 8 bit, big-endian, i-signal-type=PRIMITIVE, init-value=constant-reference=Init_CAN2_FUSION_SW_SHA5, base-type=uint8, implementation-data-type=uint8, transfer-property=PENDING
          signal CAN2_FUSION_SW_SHA6: start 263, 8 bit, big-endian, i-signal-type=PRIMITIVE, init-value=constant-reference=Init_CAN2_FUSION_SW_SHA6, base-type=uint8, implementation-data-type=uint8, transfer-property=PENDING
          signal CAN2_FUSION_SW_SHA7: start 271, 8 bit, big-endian, i-signal-type=PRIMITIVE, init-value=constant-reference=Init_CAN2_FUSION_SW_SHA7, base-type=uint8, implementation-data-type=uint8, transfer-property=PENDING
          signal CAN2_FUSION_SW_SHA8: start 279, 8 bit, big-endian, i-signal-type=PRIMITIVE, init-value=constant-reference=Init_CAN2_FUSION_SW_SHA8, base-type=uint8, implementation-data-type=uint8, transfer-property=PENDING
          signal CAN2_FUSION_SW_Var1: start 135, 8 bit, big-endian, i-signal-type=PRIMITIVE, init-value=constant-reference=Init_CAN2_FUSION_SW_Var1, base-type=uint8, implementation-data-type=uint8, transfer-property=PENDING
          signal CAN2_FUSION_SW_Var2: start 159, 8 bit, big-endian, i-signal-type=PRIMITIVE, init-value=constant-reference=Init_CAN2_FUSION_SW_Var2, base-type=uint8, implementation-data-type=uint8, transfer-property=PENDING
          signal CAN2_FUSION_SW_Var3: start 167, 8 bit, big-endian, i-signal-type=PRIMITIVE, init-value=constant-reference=Init_CAN2_FUSION_SW_Var3, base-type=uint8, implementation-data-type=uint8, transfer-property=PENDING
          signal CAN2_FUSION_SW_Var4: start 175, 8 bit, big-endian, i-signal-type=PRIMITIVE, init-value=constant-reference=Init_CAN2_FUSION_SW_Var4, base-type=uint8, implementation-data-type=uint8, transfer-property=PENDING
          signal CAN2_FUSION_SW_Var5: start 183, 8 bit, big-endian, i-signal-type=PRIMITIVE, init-value=constant-reference=Init_CAN2_FUSION_SW_Var5, base-type=uint8, implementation-data-type=uint8, transfer-property=PENDING
          signal CAN2_FUSION_SW_change1: start 199, 8 bit, big-endian, i-signal-type=PRIMITIVE, init-value=constant-reference=Init_CAN2_FUSION_SW_change1, base-type=uint8, implementation-data-type=uint8, transfer-property=PENDING
          signal CAN2_FUSION_SW_change2: start 207, 8 bit, big-endian, i-signal-type=PRIMITIVE, init-value=constant-reference=Init_CAN2_FUSION_SW_change2, base-type=uint8, implementation-data-type=uint8, transfer-property=PENDING
          signal CAN2_FUSION_SW_dash1: start 191, 8 bit, big-endian, i-signal-type=PRIMITIVE, init-value=constant-reference=Init_CAN2_FUSION_SW_dash1, base-type=uint8, implementation-data-type=uint8, transfer-property=PENDING
          signal CAN2_FUSION_SW_dash2: start 215, 8 bit, big-endian, i-signal-type=PRIMITIVE, init-value=constant-reference=Init_CAN2_FUSION_SW_dash2, base-type=uint8, implementation-data-type=uint8, transfer-property=PENDING
      frame CAN2_GW2_C10_0: id 0x1B3, frame-length=32, can-addressing-mode=STANDARD, can-fd-frame-support=true, can-frame-rx-behavior=CAN-FD, can-frame-tx-behavior=CAN-FD
        pdu CAN2_GW2_C10_0: length=32, minimum-delay=0.0, transmission-mode-true-timing=cyclic-timing=time-period=0.01, unused-bit-pattern=0
          mapping CAN2_SG_GW2_C10_0: i-signal-group=CAN2_SG_GW2_C10_0, start-position=0, transfer-property=PENDING
          signal CAN2_ABM_Passenger_ODS_Sta: start 203, 1 bit, big-endian, i-signal-type=PRIMITIVE, init-value=constant-reference=Init_CAN2_ABM_Passenger_ODS_Sta, base-type=uint8, implementation-data-type=uint8, transfer-property=PENDING
          signal CAN2_ABM_RearPassengerCTR_ODS_Sta: start 201, 1 bit, big-endian, i-signal-type=PRIMITIVE, init-value=constant-reference=Init_CAN2_ABM_RearPassengerCTR_ODS_Sta, base-type=uint8, implementation-data-type=uint8, transfer-property=PENDING
          signal CAN2_ABM_RearPassengerLH_ODS_Sta: start 202, 1 bit, big-endian, i-signal-type=PRIMITIVE, init-value=constant-reference=Init_CAN2_ABM_RearPassengerLH_ODS_Sta, base-type=uint8, implementation-data-type=uint8, transfer-property=PENDING
          signal CAN2_ABM_RearPassengerRH_ODS_Sta: start 200, 1 bit, big-endian, i-signal-type=PRIMITIVE, init-value=constant-reference=Init_CAN2_ABM_RearPassengerRH_ODS_Sta, base-type=uint8, implementation-data-type=uint8, transfer-property=PENDING
          signal CAN2_ABS_Active: start 123, 1 bit, big-endian, i-signal-type=PRIMITIVE, init-value=constant-reference=Init_CAN2_ABS_Active, base-type=uint8, implementation-data-type=uint8, transfer-property=PENDING
          signal CAN2_ABS_Failed: start 117, 1 bit, big-endian, i-signal-type=PRIMITIVE, init-value=constant-reference=Init_CAN2_ABS_Failed, base-type=uint8, implementation-data-type=uint8, transfer-property=PENDING
          signal CAN2_ABS_WnlmpSta: start 109, 1 bit, big-endian, i-signal-type=PRIMITIVE, init-value=constant-reference=Init_CAN2_ABS_WnlmpSta, base-type=uint8, implementation-data-type=uint8, transfer-property=PENDING
          signal CAN2_AEBAvail: start 110, 1 bit, big-endian, i-signal-type=PRIMITIVE, init-value=constant-reference=Init_CAN2_AEBAvail, base-type=uint8, implementation-data-type=uint8, transfer-property=PENDING
          signal CAN2_AVH_Active: start 127, 1 bit, big-endian, i-signal-type=PRIMITIVE, init-value=constant-reference=Init_CAN2_AVH_Active, base-type=uint8, implementation-data-type=uint8, transfer-property=PENDING
          signal CAN2_AVH_Failed: start 107, 1 bit, big-endian, i-signal-type=PRIMITIVE, init-value=constant-reference=Init_CAN2_AVH_Failed, base-type=uint8, implementation-data-type=uint8, transfer-property=PENDING
          signal CAN2_AirBagFailCmd: start 219, 1 bit, big-endian, i-signal-type=PRIMITIVE, init-value=constant-reference=Init_CAN2_AirBagFailCmd, base-type=uint8, implementation-data-type=uint8, transfer-property=PENDING
          signal CAN2_Amber_WnlmpSta: start 112, 1 bit, big-endian, i-signal-type=PRIMITIVE, init-value=constant-reference=Init_CAN2_Amber_WnlmpSta, base-type=uint8, implementation-data-type=uint8, transfer-property=PENDING
          signal CAN2_BTCS_Active: start 113, 1 bit, big-endian, i-signal-type=PRIMITIVE, init-value=constant-reference=Init_CAN2_BTCS_Active, base-type=uint8, implementation-data-type=uint8, transfer-property=PENDING
          signal CAN2_BrkDiscTempSta: start 175, 1 bit, big-endian, i-signal-type=PRIMITIVE, init-value=constant-reference=Init_CAN2_BrkDiscTempSta, base-type=uint8, implementation-data-type=uint8, transfer-property=PENDING
          signal CAN2_BrkSw_Sta: start 121, 1 bit, big-endian, i-signal-type=PRIMITIVE, init-value=constant-reference=Init_CAN2_BrkSw_Sta, base-type=uint8, implementation-data-type=uint8, transfer-property=PENDING
          signal CAN2_BrkSw_V: start 151, 1 bit, big-endian, i-signal-type=PRIMITIVE, init-value=constant-reference=Init_CAN2_BrkSw_V, base-type=uint8, implementation-data-type=uint8, transfer-property=PENDING
          signal CAN2_CrashOutputSts: start 247, 8 bit, big-endian, i-signal-type=PRIMITIVE, init-value=constant-reference=Init_CAN2_CrashOutputSts, base-type=uint8, implementation-data-type=uint8, transfer-property=PENDING
          signal CAN2_DCDCAuxCur: start 51, 12 bit, big-endian, i-signal-type=PRIMITIVE, init-value=constant-reference=Init_CAN2_DCDCAuxCur, base-type=uint16, implementation-data-type=uint16, transfer-property=PENDING
          signal CAN2_DCDCAuxVolt: start 167, 8 bit, big-endian, i-signal-type=PRIMITIVE, init-value=constant-reference=Init_CAN2_DCDCAuxVolt, base-type=uint8, implementation-data-type=uint8, transfer-property=PENDING
          signal CAN2_DrPMMLVOutPErrLmp: start 206, 1 bit, big-endian, i-signal-type=PRIMITIVE, init-value=constant-reference=Init_CAN2_DrPMMLVOutPErrLmp, base-type=uint8, implementation-data-type=uint8, transfer-property=PENDING
          signal CAN2_DrPMMSysErrLmp: start 207, 1 bit, big-endian, i-signal-type=PRIMITIVE, init-value=constant-reference=Init_CAN2_DrPMMSysErrLmp, base-type=uint8, implementation-data-type=uint8, transfer-property=PENDING
          signal CAN2_DrSCPSysErrLmp: start 205, 1 bit, big-endian, i-signal-type=PRIMITIVE, init-value=constant-reference=Init_CAN2_DrSCPSysErrLmp, base-type=uint8, implementation-data-type=uint8, transfer-property=PENDING
          signal CAN2_DriverSeatBeltCmd: start 199, 1 bit, big-endian, i-signal-type=PRIMITIVE, init-value=constant-reference=Init_CAN2_DriverSeatBeltCmd, base-type=uint8, implementation-data-type=uint8, transfer-property=PENDING
          signal CAN2_EBD_Failed: start 116, 1 bit, big-endian, i-signal-type=PRIMITIVE, init-value=constant-reference=Init_CAN2_EBD_Failed, base-type=uint8, implementation-data-type=uint8, transfer-property=PENDING
          signal CAN2_EBMErrSta: start 174, 2 bit, big-endian, i-signal-type=PRIMITIVE, init-value=constant-reference=Init_CAN2_EBMErrSta, base-type=uint8, implementation-data-type=uint8, transfer-property=PENDING
          signal CAN2_EBMRLampSta: start 172, 2 bit, big-endian, i-signal-type=PRIMITIVE, init-value=constant-reference=Init_CAN2_EBMRLampSta, base-type=uint8, implementation-data-type=uint8, transfer-property=PENDING
          signal CAN2_ESC_ADAS_Sta: start 135, 3 bit, big-endian, i-signal-type=PRIMITIVE, init-value=constant-reference=Init_CAN2_ESC_ADAS_Sta, base-type=uint8, implementation-data-type=uint8, transfer-property=PENDING
          signal CAN2_ESC_BeepReq: start 111, 1 bit, big-endian, i-signal-type=PRIMITIVE, init-value=constant-reference=Init_CAN2_ESC_BeepReq, base-type=uint8, implementation-data-type=uint8, transfer-property=PENDING
          signal CAN2_ESC_Failed: start 119, 1 bit, big-endian, i-signal-type=PRIMITIVE, init-value=constant-reference=Init_CAN2_ESC_Failed, base-type=uint8, implementation-data-type=uint8, transfer-property=PENDING
          signal CAN2_ESC_OFF_Status: start 99, 2 bit, big-endian, i-signal-type=PRIMITIVE, init-value=constant-reference=Init_CAN2_ESC_OFF_Status, base-type=uint8, implementation-data-type=uint8, transfer-property=PENDING
          signal CAN2_ESC_Off_lmpSta: start 120, 1 bit, big-endian, i-signal-type=PRIMITIVE, init-value=constant-reference=Init_CAN2_ESC_Off_lmpSta, base-type=uint8, implementation-data-type=uint8, transfer-property=PENDING
          signal CAN2_ESC_WnlmpSta: start 97, 2 bit, big-endian, i-signal-type=PRIMITIVE, init-value=constant-reference=Init_CAN2_ESC_WnlmpSta, base-type=uint8, implementation-data-type=uint8, transfer-property=PENDING
          signal CAN2_ESS_Active: start 114, 1 bit, big-endian, i-signal-type=PRIMITIVE, init-value=constant-reference=Init_CAN2_ESS_Active, base-type=uint8, implementation-data-type=uint8, transfer-property=PENDING
          signal CAN2_EpasFailed: start 217, 2 bit, big-endian, i-signal-type=PRIMITIVE, init-value=constant-reference=Init_CAN2_EpasFailed, base-type=uint8, implementation-data-type=uint8, transfer-property=PENDING
          signal CAN2_FLTurnLPErr: start 215, 1 bit, big-endian, i-signal-type=PRIMITIVE, init-value=constant-reference=Init_CAN2_FLTurnLPErr, base-type=uint8, implementation-data-type=uint8, transfer-property=PENDING
          signal CAN2_FLTurn_Light_Warning: start 178, 1 bit, big-endian, i-signal-type=PRIMITIVE, init-value=constant-reference=Init_CAN2_FLTurn_Light_Warning, base-type=uint8, implementation-data-type=uint8, transfer-property=PENDING
          signal CAN2_FRTurnLPErr: start 214, 1 bit, big-endian, i-signal-type=PRIMITIVE, init-value=constant-reference=Init_CAN2_FRTurnLPErr, base-type=uint8, implementation-data-type=uint8, transfer-property=PENDING
          signal CAN2_FRTurn_Light_Warning: start 186, 1 bit, big-endian, i-signal-type=PRIMITIVE, init-value=constant-reference=Init_CAN2_FRTurn_Light_Warning, base-type=uint8, implementation-data-type=uint8, transfer-property=PENDING
          signal CAN2_FireDetErr: start 220, 1 bit, big-endian, i-signal-type=PRIMITIVE, init-value=constant-reference=Init_CAN2_FireDetErr, base-type=uint8, implementation-data-type=uint8, transfer-property=PENDING
          signal CAN2_FrPMMLimpHomeActReq: start 204, 1 bit, big-endian, i-signal-type=PRIMITIVE, init-value=constant-reference=Init_CAN2_FrPMMLimpHomeActReq, base-type=uint8, implementation-data-type=uint8, transfer-property=PENDING
          signal CAN2_HBB_Active: start 124, 1 bit, big-endian, i-signal-type=PRIMITIVE, init-value=constant-reference=Init_CAN2_HBB_Active, base-type=uint8, implementation-data-type=uint8, transfer-property=PENDING
          signal CAN2_HBB_Failed: start 104, 1 bit, big-endian, i-signal-type=PRIMITIVE, init-value=constant-reference=Init_CAN2_HBB_Failed, base-type=uint8, implementation-data-type=uint8, transfer-property=PENDING
          signal CAN2_HDD_Active: start 115, 1 bit, big-endian, i-signal-type=PRIMITIVE, init-value=constant-reference=Init_CAN2_HDD_Active, base-type=uint8, implementation-data-type=uint8, transfer-property=PENDING
          signal CAN2_HDD_Failed: start 108, 1 bit, big-endian, i-signal-type=PRIMITIVE, init-value=constant-reference=Init_CAN2_HDD_Failed, base-type=uint8, implementation-data-type=uint8, transfer-property=PENDING
          signal CAN2_HSA_Active: start 126, 1 bit, big-endian, i-signal-type=PRIMITIVE, init-value=constant-reference=Init_CAN2_HSA_Active, base-type=uint8, implementation-data-type=uint8, transfer-property=PENDING
          signal CAN2_HSA_Failed: start 106, 1 bit, big-endian, i-signal-type=PRIMITIVE, init-value=constant-reference=Init_CAN2_HSA_Failed, base-type=uint8, implementation-data-type=uint8, transfer-property=PENDING
          signal CAN2_HVBattCurr: start 150, 15 bit, big-endian, i-signal-type=PRIMITIVE, init-value=constant-reference=Init_CAN2_HVBattCurr, base-type=uint16, implementation-data-type=uint16, transfer-property=PENDING
          signal CAN2_HVBattErr: start 218, 1 bit, big-endian, i-signal-type=PRIMITIVE, init-value=constant-reference=Init_CAN2_HVBattErr, base-type=uint8, implementation-data-type=uint8, transfer-property=PENDING
          signal CAN2_HVBattVolt: start 132, 13 bit, big-endian, i-signal-type=PRIMITIVE, init-value=constant-reference=Init_CAN2_HVBattVolt, base-type=uint16, implementation-data-type=uint16, transfer-property=PENDING
          signal CAN2_LADBErr: start 208, 1 bit, big-endian, i-signal-type=PRIMITIVE, init-value=constant-reference=Init_CAN2_LADBErr, base-type=uint8, implementation-data-type=uint8, transfer-property=PENDING
          signal CAN2_LADB_Hibeam_Indication: start 183, 1 bit, big-endian, i-signal-type=PRIMITIVE, init-value=constant-reference=Init_CAN2_LADB_Hibeam_Indication, base-type=uint8, implementation-data-type=uint8, transfer-property=PENDING
          signal CAN2_LADB_Operation_Status: start 182, 1 bit, big-endian, i-signal-type=PRIMITIVE, init-value=constant-reference=Init_CAN2_LADB_Operation_Status, base-type=uint8, implementation-data-type=uint8, transfer-property=PENDING
          signal CAN2_LADB_Warning: start 181, 1 bit, big-endian, i-signal-type=PRIMITIVE, init-value=constant-reference=Init_CAN2_LADB_Warning, base-type=uint8, implementation-data-type=uint8, transfer-property=PENDING
          signal CAN2_LAHB_Warning: start 179, 1 bit, big-endian, i-signal-type=PRIMITIVE, init-value=constant-reference=Init_CAN2_LAHB_Warning, base-type=uint8, implementation-data-type=uint8, transfer-property=PENDING
          signal CAN2_LDRL_Warning: start 177, 1 bit, big-endian, i-signal-type=PRIMITIVE, init-value=constant-reference=Init_CAN2_LDRL_Warning, base-type=uint8, implementation-data-type=uint8, transfer-property=PENDING
          signal CAN2_LF_PulseCount: start 79, 8 bit, big-endian, i-signal-type=PRIMITIVE, init-value=constant-reference=Init_CAN2_LF_PulseCount, base-type=uint8, implementation-data-type=uint8, transfer-property=PENDING
          signal CAN2_LF_PulseCount_V: start 54, 1 bit, big-endian, i-signal-type=PRIMITIVE, init-value=constant-reference=Init_CAN2_LF_PulseCount_V, base-type=uint8, implementation-data-type=uint8, transfer-property=PENDING
          signal CAN2_LF_WhlRotDir: start 45, 2 bit, big-endian, i-signal-type=PRIMITIVE, init-value=constant-reference=Init_CAN2_LF_WhlRotDir, base-type=uint8, implementation-data-type=uint8, transfer-property=PENDING
          signal CAN2_LH_BeamErr: start 210, 1 bit, big-endian, i-signal-type=PRIMITIVE, init-value=constant-reference=Init_CAN2_LH_BeamErr, base-type=uint8, implementation-data-type=uint8, transfer-property=PENDING
          signal CAN2_LLB_Warning: start 180, 1 bit, big-endian, i-signal-type=PRIMITIVE, init-value=constant-reference=Init_CAN2_LLB_Warning, base-type=uint8, implementation-data-type=uint8, transfer-property=PENDING
          signal CAN2_LL_BeamErr: start 209, 1 bit, big-endian, i-signal-type=PRIMITIVE, init-value=constant-reference=Init_CAN2_LL_BeamErr, base-type=uint8, implementation-data-type=uint8, transfer-property=PENDING
          signal CAN2_LR_PulseCount: start 95, 8 bit, big-endian, i-signal-type=PRIMITIVE, init-value=constant-reference=Init_CAN2_LR_PulseCount, base-type=uint8, implementation-data-type=uint8, transfer-property=PENDING
          signal CAN2_LR_PulseCount_V: start 52, 1 bit, big-endian, i-signal-type=PRIMITIVE, init-value=constant-reference=Init_CAN2_LR_PulseCount_V, base-type=uint8, implementation-data-type=uint8, transfer-property=PENDING
          signal CAN2_LR_WhlRotDir: start 41, 2 bit, big-endian, i-signal-type=PRIMITIVE, init-value=constant-reference=Init_CAN2_LR_WhlRotDir, base-type=uint8, implementation-data-type=uint8, transfer-property=PENDING
          signal CAN2_LowBrakeFluid_Sta: start 102, 1 bit, big-endian, i-signal-type=PRIMITIVE, init-value=constant-reference=Init_CAN2_LowBrakeFluid_Sta, base-type=uint8, implementation-data-type=uint8, transfer-property=PENDING
          signal CAN2_Lposition_Lamp_Warning: start 176, 1 bit, big-endian, i-signal-type=PRIMITIVE, init-value=constant-reference=Init_CAN2_Lposition_Lamp_Warning, base-type=uint8, implementation-data-type=uint8, transfer-property=PENDING
          signal CAN2_Meter_Ind_VehSpeed: start 27, 12 bit, big-endian, i-signal-type=PRIMITIVE, init-value=constant-reference=Init_CAN2_Meter_Ind_VehSpeed, base-type=uint16, implementation-data-type=uint16, transfer-property=PENDING
          signal CAN2_PABSwitchCmd: start 192, 1 bit, big-endian, i-signal-type=PRIMITIVE, init-value=constant-reference=Init_CAN2_PABSwitchCmd, base-type=uint8, implementation-data-type=uint8, transfer-property=PENDING
          signal CAN2_PBA_Active: start 125, 1 bit, big-endian, i-signal-type=PRIMITIVE, init-value=constant-reference=Init_CAN2_PBA_Active, base-type=uint8, implementation-data-type=uint8, transfer-property=PENDING
          signal CAN2_PBA_Failed: start 105, 1 bit, big-endian, i-signal-type=PRIMITIVE, init-value=constant-reference=Init_CAN2_PBA_Failed, base-type=uint8, implementation-data-type=uint8, transfer-property=PENDING
          signal CAN2_PsngrSeatBeltCmd: start 197, 1 bit, big-endian, i-signal-type=PRIMITIVE, init-value=constant-reference=Init_CAN2_PsngrSeatBeltCmd, base-type=uint8, implementation-data-type=uint8, transfer-property=PENDING
          signal CAN2_RADBErr: start 168, 1 bit, big-endian, i-signal-type=PRIMITIVE, init-value=constant-reference=Init_CAN2_RADBErr, base-type=uint8, implementation-data-type=uint8, transfer-property=PENDING
          signal CAN2_RADB_Hibeam_Indication: start 191, 1 bit, big-endian, i-signal-type=PRIMITIVE, init-value=constant-reference=Init_CAN2_RADB_Hibeam_Indication, base-type=uint8, implementation-data-type=uint8, transfer-property=PENDING
          signal CAN2_RADB_Operation_Status: start 190, 1 bit, big-endian, i-signal-type=PRIMITIVE, init-value=constant-reference=Init_CAN2_RADB_Operation_Status, base-type=uint8, implementation-data-type=uint8, transfer-property=PENDING
          signal CAN2_RADB_Warning: start 189, 1 bit, big-endian, i-signal-type=PRIMITIVE, init-value=constant-reference=Init_CAN2_RADB_Warning, base-type=uint8, implementation-data-type=uint8, transfer-property=PENDING
          signal CAN2_RAHB_Warning: start 187, 1 bit, big-endian, i-signal-type=PRIMITIVE, init-value=constant-reference=Init_CAN2_RAHB_Warning, base-type=uint8, implementation-data-type=uint8, transfer-property=PENDING
          signal CAN2_RCenterSeatBeltCmd: start 193, 1 bit, big-endian, i-signal-type=PRIMITIVE, init-value=constant-reference=Init_CAN2_RCenterSeatBeltCmd, base-type=uint8, implementation-data-type=uint8, transfer-property=PENDING
          signal CAN2_RDRL_Warning: start 185, 1 bit, big-endian, i-signal-type=PRIMITIVE, init-value=constant-reference=Init_CAN2_RDRL_Warning, base-type=uint8, implementation-data-type=uint8, transfer-property=PENDING
          signal CAN2_RDriverSeatBeltCmd: start 198, 1 bit, big-endian, i-signal-type=PRIMITIVE, init-value=constant-reference=Init_CAN2_RDriverSeatBeltCmd, base-type=uint8, implementation-data-type=uint8, transfer-property=PENDING
          signal CAN2_RF_PulseCount: start 71, 8 bit, big-endian, i-signal-type=PRIMITIVE, init-value=constant-reference=Init_CAN2_RF_PulseCount, base-type=uint8, implementation-data-type=uint8, transfer-property=PENDING
          signal CAN2_RF_PulseCount_V: start 55, 1 bit, big-endian, i-signal-type=PRIMITIVE, init-value=constant-reference=Init_CAN2_RF_PulseCount_V, base-type=uint8, implementation-data-type=uint8, transfer-property=PENDING
          signal CAN2_RF_WhlRotDir: start 47, 2 bit, big-endian, i-signal-type=PRIMITIVE, init-value=constant-reference=Init_CAN2_RF_WhlRotDir, base-type=uint8, implementation-data-type=uint8, transfer-property=PENDING
          signal CAN2_RH_BeamErr: start 170, 1 bit, big-endian, i-signal-type=PRIMITIVE, init-value=constant-reference=Init_CAN2_RH_BeamErr, base-type=uint8, implementation-data-type=uint8, transfer-property=PENDING
          signal CAN2_RLB_Warning: start 188, 1 bit, big-endian, i-signal-type=PRIMITIVE, init-value=constant-reference=Init_CAN2_RLB_Warning, base-type=uint8, implementation-data-type=uint8, transfer-property=PENDING
          signal CAN2_RLTurnLPErr: start 223, 1 bit, big-endian, i-signal-type=PRIMITIVE, init-value=constant-reference=Init_CAN2_RLTurnLPErr, base-type=uint8, implementation-data-type=uint8, transfer-property=PENDING
          signal CAN2_RL_BeamErr: start 169, 1 bit, big-endian, i-signal-type=PRIMITIVE, init-value=constant-reference=Init_CAN2_RL_BeamErr, base-type=uint8, implementation-data-type=uint8, transfer-property=PENDING
          signal CAN2_RPsngrSeatBeltCmd: start 196, 1 bit, big-endian, i-signal-type=PRIMITIVE, init-value=constant-reference=Init_CAN2_RPsngrSeatBeltCmd, base-type=uint8, implementation-data-type=uint8, transfer-property=PENDING
          signal CAN2_RRTurnLPErr: start 222, 1 bit, big-endian, i-signal-type=PRIMITIVE, init-value=constant-reference=Init_CAN2_RRTurnLPErr, base-type=uint8, implementation-data-type=uint8, transfer-property=PENDING
          signal CAN2_RR_PulseCount: start 87, 8 bit, big-endian, i-signal-type=PRIMITIVE, init-value=constant-reference=Init_CAN2_RR_PulseCount, base-type=uint8, implementation-data-type=uint8, transfer-property=PENDING
          signal CAN2_RR_PulseCount_V: start 53, 1 bit, big-endian, i-signal-type=PRIMITIVE, init-value=constant-reference=Init_CAN2_RR_PulseCount_V, base-type=uint8, implementation-data-type=uint8, transfer-property=PENDING
          signal CAN2_RR_WhlRotDir: start 43, 2 bit, big-endian, i-signal-type=PRIMITIVE, init-value=constant-reference=Init_CAN2_RR_WhlRotDir, base-type=uint8, implementation-data-type=uint8, transfer-property=PENDING
          signal CAN2_Red_WnlmpSta: start 122, 1 bit, big-endian, i-signal-type=PRIMITIVE, init-value=constant-reference=Init_CAN2_Red_WnlmpSta, base-type=uint8, implementation-data-type=uint8, transfer-property=PENDING
          signal CAN2_Rposition_Lamp_Warning: start 184, 1 bit, big-endian, i-signal-type=PRIMITIVE, init-value=constant-reference=Init_CAN2_Rposition_Lamp_Warning, base-type=uint8, implementation-data-type=uint8, transfer-property=PENDING
          signal CAN2_SAS_Angle: start 231, 16 bit, big-endian, i-signal-type=PRIMITIVE, init-value=constant-reference=Init_CAN2_SAS_Angle, base-type=uint16, implementation-data-type=uint16, transfer-property=PENDING
          signal CAN2_SAS_V: start 221, 1 bit, big-endian, i-signal-type=PRIMITIVE, init-value=constant-reference=Init_CAN2_SAS_V, base-type=uint8, implementation-data-type=uint8, transfer-property=PENDING
          signal CAN2_TCS_Failed: start 118, 1 bit, big-endian, i-signal-type=PRIMITIVE, init-value=constant-reference=Init_CAN2_TCS_Failed, base-type=uint8, implementation-data-type=uint8, transfer-property=PENDING
          signal CAN2_TLHPsngrSeatBeltCmd: start 195, 1 bit, big-endian, i-signal-type=PRIMITIVE, init-value=constant-reference=Init_CAN2_TLHPsngrSeatBeltCmd, base-type=uint8, implementation-data-type=uint8, transfer-property=PENDING
          signal CAN2_TRHPsngrSeatBeltCmd: start 194, 1 bit, big-endian, i-signal-type=PRIMITIVE, init-value=constant-reference=Init_CAN2_TRHPsngrSeatBeltCmd, base-type=uint8, implementation-data-type=uint8, transfer-property=PENDING
          signal CAN2_VehSpeed: start 23, 12 bit, big-endian, i-signal-type=PRIMITIVE, init-value=constant-reference=Init_CAN2_VehSpeed, base-type=uint16, implementation-data-type=uint16, transfer-property=PENDING
          signal CAN2_eBST_AmberWnlmpSta: start 103, 1 bit, big-endian, i-signal-type=PRIMITIVE, init-value=constant-reference=Init_CAN2_eBST_AmberWnlmpSta, base-type=uint8, implementation-data-type=uint8, transfer-property=PENDING
          signal CAN2_eBST_BeepReq: start 100, 1 bit, big-endian, i-signal-type=PRIMITIVE, init-value=constant-reference=Init_CAN2_eBST_BeepReq, base-type=uint8, implementation-data-type=uint8, transfer-property=PENDING
          signal CAN2_eBST_RedWnlmpSta: start 101, 1 bit, big-endian, i-signal-type=PRIMITIVE, init-value=constant-reference=Init_CAN2_eBST_RedWnlmpSta, base-type=uint8, implementation-data-type=uint8, transfer-property=PENDING
      frame CAN2_GW2_CE1000_0: id 0x337, frame-length=48, can-addressing-mode=STANDARD, can-fd-frame-support=true, can-frame-rx-behavior=CAN-FD, can-frame-tx-behavior=CAN-FD
        pdu CAN2_GW2_CE1000_0: length=48, minimum-delay=0.0, transmission-mode-true-timing={cyclic-timing=time-period=1, event-controlled-timing={number-of-repetitions=0, repetition-period=0}}, unused-bit-pattern=0
          mapping CAN2_SG_GW2_CE1000_0: i-signal-group=CAN2_SG_GW2_CE1000_0, start-position=0, transfer-property=TRIGGERED-ON-CHANGE
          signal CAN2_ACChrgCurrDis: start 94, 15 bit, big-endian, i-signal-type=PRIMITIVE, init-value=constant-reference=Init_CAN2_ACChrgCurrDis, base-type=uint16, implementation-data-type=uint16, transfer-property=PENDING
          signal CAN2_Charge_Percent_Set: start 111, 8 bit, big-endian, i-signal-type=PRIMITIVE, init-value=constant-reference=Init_CAN2_Charge_Percent_Set, base-type=uint8, implementation-data-type=uint8, transfer-property=TRIGGERED-ON-CHANGE
          signal CAN2_DSEAT_HW_Ver: start 327, 16 bit, big-endian, i-signal-type=PRIMITIVE, init-value=constant-reference=Init_CAN2_DSEAT_HW_Ver, base-type=uint16, implementation-data-type=uint16, transfer-property=PENDING
          signal CAN2_DSEAT_SW_Ver: start 343, 16 bit, big-endian, i-signal-type=PRIMITIVE, init-value=constant-reference=Init_CAN2_DSEAT_SW_Ver, base-type=uint16, implementation-data-type=uint16, transfer-property=PENDING
          signal CAN2_Fr_MCU_HW_Ver: start 231, 16 bit, big-endian, i-signal-type=PRIMITIVE, init-value=constant-reference=Init_CAN2_Fr_MCU_HW_Ver, base-type=uint16, implementation-data-type=uint16, transfer-property=PENDING
          signal CAN2_Fr_MCU_HW_Ver_Nidec: start 295, 16 bit, big-endian, i-signal-type=PRIMITIVE, init-value=constant-reference=Init_CAN2_Fr_MCU_HW_Ver_Nidec, base-type=uint16, implementation-data-type=uint16, transfer-property=PENDING
          signal CAN2_Fr_MCU_SW_Ver: start 247, 16 bit, big-endian, i-signal-type=PRIMITIVE, init-value=constant-reference=Init_CAN2_Fr_MCU_SW_Ver, base-type=uint16, implementation-data-type=uint16, transfer-property=PENDING
          signal CAN2_Fr_MCU_SW_Ver_Nidec: start 311, 16 bit, big-endian, i-signal-type=PRIMITIVE, init-value=constant-reference=Init_CAN2_Fr_MCU_SW_Ver_Nidec, base-type=uint16, implementation-data-type=uint16, transfer-property=PENDING
          signal CAN2_HVBChrgPwr: start 57, 10 bit, big-endian, i-signal-type=PRIMITIVE, init-value=constant-reference=Init_CAN2_HVBChrgPwr, base-type=uint16, implementation-data-type=uint16, transfer-property=PENDING
          signal CAN2_HVBChrgPwrTotal: start 7, 18 bit, big-endian, i-signal-type=PRIMITIVE, init-value=constant-reference=Init_CAN2_HVBChrgPwrTotal, base-type=uint32, implementation-data-type=uint32, transfer-property=PENDING
          signal CAN2_HVBDrvPwr: start 35, 10 bit, big-endian, i-signal-type=PRIMITIVE, init-value=constant-reference=Init_CAN2_HVBDrvPwr, base-type=uint16, implementation-data-type=uint16, transfer-property=PENDING
          signal CAN2_HVBDrvPwrTotal: start 21, 18 bit, big-endian, i-signal-type=PRIMITIVE, init-value=constant-reference=Init_CAN2_HVBDrvPwrTotal, base-type=uint32, implementation-data-type=uint32, transfer-property=PENDING
          signal CAN2_HVBattSOC: start 127, 8 bit, big-endian, i-signal-type=PRIMITIVE, init-value=constant-reference=Init_CAN2_HVBattSOC, base-type=uint8, implementation-data-type=uint8, transfer-property=PENDING
          signal CAN2_HVBattSOCDis: start 119, 8 bit, big-endian, i-signal-type=PRIMITIVE, init-value=constant-reference=Init_CAN2_HVBattSOCDis, base-type=uint8, implementation-data-type=uint8, transfer-property=PENDING
          signal CAN2_PSEAT_HW_Ver: start 359, 16 bit, big-endian, i-signal-type=PRIMITIVE, init-value=constant-reference=Init_CAN2_PSEAT_HW_Ver, base-type=uint16, implementation-data-type=uint16, transfer-property=PENDING
          signal CAN2_PSEAT_SW_Ver: start 375, 16 bit, big-endian, i-signal-type=PRIMITIVE, init-value=constant-reference=Init_CAN2_PSEAT_SW_Ver, base-type=uint16, implementation-data-type=uint16, transfer-property=PENDING
          signal CAN2_PTG_HW_Ver: start 63, 5 bit, big-endian, i-signal-type=PRIMITIVE, init-value=constant-reference=Init_CAN2_PTG_HW_Ver, base-type=uint8, implementation-data-type=uint8, transfer-property=PENDING
          signal CAN2_PTG_SW_Ver: start 55, 5 bit, big-endian, i-signal-type=PRIMITIVE, init-value=constant-reference=Init_CAN2_PTG_SW_Ver, base-type=uint8, implementation-data-type=uint8, transfer-property=PENDING
          signal CAN2_RemainChrgTime: start 75, 12 bit, big-endian, i-signal-type=PRIMITIVE, init-value=constant-reference=Init_CAN2_RemainChrgTime, base-type=uint16, implementation-data-type=uint16, transfer-property=PENDING
          signal CAN2_Rr_MCU3_HW_Ver: start 199, 16 bit, big-endian, i-signal-type=PRIMITIVE, init-value=constant-reference=Init_CAN2_Rr_MCU3_HW_Ver, base-type=uint16, implementation-data-type=uint16, transfer-property=PENDING
          signal CAN2_Rr_MCU3_HW_Ver_Nidec: start 263, 16 bit, big-endian, i-signal-type=PRIMITIVE, init-value=constant-reference=Init_CAN2_Rr_MCU3_HW_Ver_Nidec, base-type=uint16, implementation-data-type=uint16, transfer-property=PENDING
          signal CAN2_Rr_MCU3_SW_Ver: start 215, 16 bit, big-endian, i-signal-type=PRIMITIVE, init-value=constant-reference=Init_CAN2_Rr_MCU3_SW_Ver, base-type=uint16, implementation-data-type=uint16, transfer-property=PENDING
          signal CAN2_Rr_MCU3_SW_Ver_Nidec: start 279, 16 bit, big-endian, i-signal-type=PRIMITIVE, init-value=constant-reference=Init_CAN2_Rr_MCU3_SW_Ver_Nidec, base-type=uint16, implementation-data-type=uint16, transfer-property=PENDING
          signal CAN2_TBOX_HW_VER: start 135, 32 bit, big-endian, i-signal-type=PRIMITIVE, init-value=constant-reference=Init_CAN2_TBOX_HW_VER, base-type=uint32, implementation-data-type=uint32, transfer-property=PENDING
          signal CAN2_TBOX_SW_VER: start 167, 32 bit, big-endian, i-signal-type=PRIMITIVE, init-value=constant-reference=Init_CAN2_TBOX_SW_VER, base-type=uint32, implementation-data-type=uint32, transfer-property=PENDING
      frame CAN2_GW2_CE100_0: id 0x1C2, frame-length=32, can-addressing-mode=STANDARD, can-fd-frame-support=true, can-frame-rx-behavior=CAN-FD, can-frame-tx-behavior=CAN-FD
        pdu CAN2_GW2_CE100_0: length=32, minimum-delay=0.0, transmission-mode-true-timing={cyclic-timing=time-period=0.1, event-controlled-timing={number-of-repetitions=0, repetition-period=0}}, unused-bit-pattern=0
          mapping CAN2_SG_GW2_CE100_0: i-signal-group=CAN2_SG_GW2_CE100_0, start-position=0, transfer-property=TRIGGERED-ON-CHANGE
          mapping CAN2_SG_CGW_GW2_CE100_0: i-signal-group=CAN2_SG_CGW_GW2_CE100_0, start-position=0, transfer-property=TRIGGERED-ON-CHANGE
          signal CAN2_COMP_ActualPwr: start 180, 13 bit, big-endian, i-signal-type=PRIMITIVE, init-value=constant-reference=Init_CAN2_COMP_ActualPwr, base-type=uint16, implementation-data-type=uint16, transfer-property=PENDING
          signal CAN2_CbnPreACEnaReq: start 229, 2 bit, big-endian, i-signal-type=PRIMITIVE, init-value=constant-reference=Init_CAN2_CbnPreACEnaReq, base-type=uint8, implementation-data-type=uint8, transfer-property=TRIGGERED-ON-CHANGE
          signal CAN2_ChargeInletLockSta: start 151, 1 bit, big-endian, i-signal-type=PRIMITIVE, init-value=constant-reference=Init_CAN2_ChargeInletLockSta, base-type=uint8, implementation-data-type=uint8, transfer-property=TRIGGERED-ON-CHANGE
          signal CAN2_ChrgPlugSta: start 25, 2 bit, big-endian, i-signal-type=PRIMITIVE, init-value=constant-reference=Init_CAN2_ChrgPlugSta, base-type=uint8, implementation-data-type=uint8, transfer-property=TRIGGERED-ON-CHANGE
          signal CAN2_DKC_KeyNum_Sta: start 123, 4 bit, big-endian, i-signal-type=PRIMITIVE, init-value=constant-reference=Init_CAN2_DKC_KeyNum_Sta, base-type=uint8, implementation-data-type=uint8, transfer-property=TRIGGERED-ON-CHANGE
          signal CAN2_DKC_KeyType_Sta: start 125, 2 bit, big-endian, i-signal-type=PRIMITIVE, init-value=constant-reference=Init_CAN2_DKC_KeyType_Sta, base-type=uint8, implementation-data-type=uint8, transfer-property=TRIGGERED-ON-CHANGE
          signal CAN2_DisChrgPlugErr: start 29, 2 bit, big-endian, i-signal-type=PRIMITIVE, init-value=constant-reference=Init_CAN2_DisChrgPlugErr, base-type=uint8, implementation-data-type=uint8, transfer-property=TRIGGERED-ON-CHANGE
          signal CAN2_EBMSta: start 134, 3 bit, big-endian, i-signal-type=PRIMITIVE, init-value=constant-reference=Init_CAN2_EBMSta, base-type=uint8, implementation-data-type=uint8, transfer-property=TRIGGERED-ON-CHANGE
          signal CAN2_ExtChrgSta: start 27, 2 bit, big-endian, i-signal-type=PRIMITIVE, init-value=constant-reference=Init_CAN2_ExtChrgSta, base-type=uint8, implementation-data-type=uint8, transfer-property=TRIGGERED-ON-CHANGE
          signal CAN2_FDC_BCM_DimSw: start 104, 1 bit, big-endian, i-signal-type=PRIMITIVE, init-value=constant-reference=Init_CAN2_FDC_BCM_DimSw, base-type=uint8, implementation-data-type=uint8, transfer-property=TRIGGERED-ON-CHANGE
          signal CAN2_FDC_BCM_FWipSw_Sta: start 109, 3 bit, big-endian, i-signal-type=PRIMITIVE, init-value=constant-reference=Init_CAN2_FDC_BCM_FWipSw_Sta, base-type=uint8, implementation-data-type=uint8, transfer-property=TRIGGERED-ON-CHANGE
          signal CAN2_FDC_BCM_TurnSw_Sta: start 106, 2 bit, big-endian, i-signal-type=PRIMITIVE, init-value=constant-reference=Init_CAN2_FDC_BCM_TurnSw_Sta, base-type=uint8, implementation-data-type=uint8, transfer-property=TRIGGERED-ON-CHANGE
          signal CAN2_FrntPTCLeActHeatPwr: start 79, 8 bit, big-endian, i-signal-type=PRIMITIVE, init-value=constant-reference=Init_CAN2_FrntPTCLeActHeatPwr, base-type=uint8, implementation-data-type=uint8, transfer-property=PENDING
          signal CAN2_FrntPTCRearLeActHeatPwr: start 95, 8 bit, big-endian, i-signal-type=PRIMITIVE, init-value=constant-reference=Init_CAN2_FrntPTCRearLeActHeatPwr, base-type=uint8, implementation-data-type=uint8, transfer-property=PENDING
          signal CAN2_FrntPTCRearRiActHeatPwr: start 103, 8 bit, big-endian, i-signal-type=PRIMITIVE, init-value=constant-reference=Init_CAN2_FrntPTCRearRiActHeatPwr, base-type=uint8, implementation-data-type=uint8, transfer-property=PENDING
          signal CAN2_FrntPTCRiActHeatPwr: start 87, 8 bit, big-endian, i-signal-type=PRIMITIVE, init-value=constant-reference=Init_CAN2_FrntPTCRiActHeatPwr, base-type=uint8, implementation-data-type=uint8, transfer-property=PENDING
          signal CAN2_HVBChrgErr: start 23, 8 bit, big-endian, i-signal-type=PRIMITIVE, init-value=constant-reference=Init_CAN2_HVBChrgErr, base-type=uint8, implementation-data-type=uint8, transfer-property=TRIGGERED-ON-CHANGE
          signal CAN2_HVBContactorSta: start 111, 1 bit, big-endian, i-signal-type=PRIMITIVE, init-value=constant-reference=Init_CAN2_HVBContactorSta, base-type=uint8, implementation-data-type=uint8, transfer-property=TRIGGERED-ON-CHANGE
          signal CAN2_HVBMTempMax: start 239, 8 bit, big-endian, i-signal-type=PRIMITIVE, init-value=constant-reference=Init_CAN2_HVBMTempMax, base-type=uint8, implementation-data-type=uint8, transfer-property=PENDING
          signal CAN2_HVBOvrTempErr: start 39, 1 bit, big-endian, i-signal-type=PRIMITIVE, init-value=constant-reference=Init_CAN2_HVBOvrTempErr, base-type=uint8, implementation-data-type=uint8, transfer-property=TRIGGERED-ON-CHANGE
          signal CAN2_HVBOvrTempWarn: start 36, 2 bit, big-endian, i-signal-type=PRIMITIVE, init-value=constant-reference=Init_CAN2_HVBOvrTempWarn, base-type=uint8, implementation-data-type=uint8, transfer-property=TRIGGERED-ON-CHANGE
          signal CAN2_MainRlyNegSta: start 207, 8 bit, big-endian, i-signal-type=PRIMITIVE, init-value=constant-reference=Init_CAN2_MainRlyNegSta, base-type=uint8, implementation-data-type=uint8, transfer-property=TRIGGERED-ON-CHANGE
          signal CAN2_MainRlyPosSta: start 199, 8 bit, big-endian, i-signal-type=PRIMITIVE, init-value=constant-reference=Init_CAN2_MainRlyPosSta, base-type=uint8, implementation-data-type=uint8, transfer-property=TRIGGERED-ON-CHANGE
          signal CAN2_OBCACCSLimit: start 15, 8 bit, big-endian, i-signal-type=PRIMITIVE, init-value=constant-reference=Init_CAN2_OBCACCSLimit, base-type=uint8, implementation-data-type=uint8, transfer-property=TRIGGERED-ON-CHANGE
          signal CAN2_OBCACCurrInf: start 57, 10 bit, big-endian, i-signal-type=PRIMITIVE, init-value=constant-reference=Init_CAN2_OBCACCurrInf, base-type=uint16, implementation-data-type=uint16, transfer-property=PENDING
          signal CAN2_OBCACVoltInf: start 55, 12 bit, big-endian, i-signal-type=PRIMITIVE, init-value=constant-reference=Init_CAN2_OBCACVoltInf, base-type=uint16, implementation-data-type=uint16, transfer-property=PENDING
          signal CAN2_OBCFaultSta: start 59, 2 bit, big-endian, i-signal-type=PRIMITIVE, init-value=constant-reference=Init_CAN2_OBCFaultSta, base-type=uint8, implementation-data-type=uint8, transfer-property=TRIGGERED-ON-CHANGE
          signal CAN2_OBC_AC_Cur_Lim: start 38, 2 bit, big-endian, i-signal-type=PRIMITIVE, init-value=constant-reference=Init_CAN2_OBC_AC_Cur_Lim, base-type=uint8, implementation-data-type=uint8, transfer-property=TRIGGERED-ON-CHANGE
          signal CAN2_P_Dkey_Show_IVI: start 215, 4 bit, big-endian, i-signal-type=PRIMITIVE, init-value=constant-reference=Init_CAN2_P_Dkey_Show_IVI, base-type=uint8, implementation-data-type=uint8, transfer-property=TRIGGERED-ON-CHANGE
          signal CAN2_P_KeyMiss: start 211, 1 bit, big-endian, i-signal-type=PRIMITIVE, init-value=constant-reference=Init_CAN2_P_KeyMiss, base-type=uint8, implementation-data-type=uint8, transfer-property=TRIGGERED-ON-CHANGE
          signal CAN2_P_UID_LowPower: start 231, 1 bit, big-endian, i-signal-type=PRIMITIVE, init-value=constant-reference=Init_CAN2_P_UID_LowPower, base-type=uint8, implementation-data-type=uint8, transfer-property=TRIGGERED-ON-CHANGE
          signal CAN2_RLS_Lamp_Sta: start 110, 1 bit, big-endian, i-signal-type=PRIMITIVE, init-value=constant-reference=Init_CAN2_RLS_Lamp_Sta, base-type=uint8, implementation-data-type=uint8, transfer-property=TRIGGERED-ON-CHANGE
          signal CAN2_Re_Radio: start 181, 1 bit, big-endian, i-signal-type=PRIMITIVE, init-value=constant-reference=Init_CAN2_Re_Radio, base-type=uint8, implementation-data-type=uint8, transfer-property=TRIGGERED-ON-CHANGE
          signal CAN2_SWC_ACC_Sta: start 119, 1 bit, big-endian, i-signal-type=PRIMITIVE, init-value=constant-reference=Init_CAN2_SWC_ACC_Sta, base-type=uint8, implementation-data-type=uint8, transfer-property=TRIGGERED-ON-CHANGE
          signal CAN2_SWC_Down_Sta: start 118, 1 bit, big-endian, i-signal-type=PRIMITIVE, init-value=constant-reference=Init_CAN2_SWC_Down_Sta, base-type=uint8, implementation-data-type=uint8, transfer-property=TRIGGERED-ON-CHANGE
          signal CAN2_SWC_LKA_Sta: start 127, 1 bit, big-endian, i-signal-type=PRIMITIVE, init-value=constant-reference=Init_CAN2_SWC_LKA_Sta, base-type=uint8, implementation-data-type=uint8, transfer-property=TRIGGERED-ON-CHANGE
          signal CAN2_SWC_Left_Sta: start 116, 1 bit, big-endian, i-signal-type=PRIMITIVE, init-value=constant-reference=Init_CAN2_SWC_Left_Sta, base-type=uint8, implementation-data-type=uint8, transfer-property=TRIGGERED-ON-CHANGE
          signal CAN2_SWC_RegenDown: start 230, 1 bit, big-endian, i-signal-type=PRIMITIVE, init-value=constant-reference=Init_CAN2_SWC_RegenDown, base-type=uint8, implementation-data-type=uint8, transfer-property=TRIGGERED-ON-CHANGE
          signal CAN2_SWC_RegenUp: start 117, 1 bit, big-endian, i-signal-type=PRIMITIVE, init-value=constant-reference=Init_CAN2_SWC_RegenUp, base-type=uint8, implementation-data-type=uint8, transfer-property=TRIGGERED-ON-CHANGE
          signal CAN2_SWC_Right_Sta: start 114, 1 bit, big-endian, i-signal-type=PRIMITIVE, init-value=constant-reference=Init_CAN2_SWC_Right_Sta, base-type=uint8, implementation-data-type=uint8, transfer-property=TRIGGERED-ON-CHANGE
          signal CAN2_SWC_Trip_Sta: start 113, 1 bit, big-endian, i-signal-type=PRIMITIVE, init-value=constant-reference=Init_CAN2_SWC_Trip_Sta, base-type=uint8, implementation-data-type=uint8, transfer-property=TRIGGERED-ON-CHANGE
          signal CAN2_SWC_Undefined_Sta: start 135, 1 bit, big-endian, i-signal-type=PRIMITIVE, init-value=constant-reference=Init_CAN2_SWC_Undefined_Sta, base-type=uint8, implementation-data-type=uint8, transfer-property=TRIGGERED-ON-CHANGE
          signal CAN2_SWC_Up_Sta: start 112, 1 bit, big-endian, i-signal-type=PRIMITIVE, init-value=constant-reference=Init_CAN2_SWC_Up_Sta, base-type=uint8, implementation-data-type=uint8, transfer-property=TRIGGERED-ON-CHANGE
          signal CAN2_SWC_VR_Sta: start 143, 1 bit, big-endian, i-signal-type=PRIMITIVE, init-value=constant-reference=Init_CAN2_SWC_VR_Sta, base-type=uint8, implementation-data-type=uint8, transfer-property=TRIGGERED-ON-CHANGE
          signal CAN2_SWC_mode_Sta: start 115, 1 bit, big-endian, i-signal-type=PRIMITIVE, init-value=constant-reference=Init_CAN2_SWC_mode_Sta, base-type=uint8, implementation-data-type=uint8, transfer-property=TRIGGERED-ON-CHANGE
          signal CAN2_Shifter_Fail_sta: start 34, 3 bit, big-endian, i-signal-type=PRIMITIVE, init-value=constant-reference=Init_CAN2_Shifter_Fail_sta, base-type=uint8, implementation-data-type=uint8, transfer-property=TRIGGERED-ON-CHANGE
          signal CAN2_Shifter_Handle_Cmd: start 47, 8 bit, big-endian, i-signal-type=PRIMITIVE, init-value=constant-reference=Init_CAN2_Shifter_Handle_Cmd, base-type=uint8, implementation-data-type=uint8, transfer-property=TRIGGERED-ON-CHANGE
          signal CAN2_TBOX_NET_SIG_STR: start 219, 4 bit, big-endian, i-signal-type=PRIMITIVE, init-value=constant-reference=Init_CAN2_TBOX_NET_SIG_STR, base-type=uint8, implementation-data-type=uint8, transfer-property=TRIGGERED-ON-CHANGE
          signal CAN2_TBOX_TEST_STATUS: start 227, 4 bit, big-endian, i-signal-type=PRIMITIVE, init-value=constant-reference=Init_CAN2_TBOX_TEST_STATUS, base-type=uint8, implementation-data-type=uint8, transfer-property=TRIGGERED-ON-CHANGE
          signal CAN2_TrailerCheck: start 253, 1 bit, big-endian, i-signal-type=PRIMITIVE, init-value=constant-reference=Init_CAN2_TrailerCheck, base-type=uint8, implementation-data-type=uint8, transfer-property=TRIGGERED-ON-CHANGE
          signal CAN2_TrailerModeSta: start 255, 2 bit, big-endian, i-signal-type=PRIMITIVE, init-value=constant-reference=Init_CAN2_TrailerModeSta, base-type=uint8, implementation-data-type=uint8, transfer-property=TRIGGERED-ON-CHANGE
          signal CAN2_V2LSta: start 31, 2 bit, big-endian, i-signal-type=PRIMITIVE, init-value=constant-reference=Init_CAN2_V2LSta, base-type=uint8, implementation-data-type=uint8, transfer-property=TRIGGERED-ON-CHANGE
          signal CAN2_ZFR_BCM_ChargerDoorSW_Sta: start 126, 1 bit, big-endian, i-signal-type=PRIMITIVE, init-value=constant-reference=Init_CAN2_ZFR_BCM_ChargerDoorSW_Sta, base-type=uint8, implementation-data-type=uint8, transfer-property=TRIGGERED-ON-CHANGE
          signal CAN2_ZFR_EChrg_Active_Sta: start 210, 3 bit, big-endian, i-signal-type=PRIMITIVE, init-value=constant-reference=Init_CAN2_ZFR_EChrg_Active_Sta, base-type=uint8, implementation-data-type=uint8, transfer-property=TRIGGERED-ON-CHANGE
          signal CAN2_ZFR_EChrg_OperationDeny_Cmd: start 252, 2 bit, big-endian, i-signal-type=PRIMITIVE, init-value=constant-reference=Init_CAN2_ZFR_EChrg_OperationDeny_Cmd, base-type=uint8, implementation-data-type=uint8, transfer-property=TRIGGERED-ON-CHANGE
          signal CAN2_ZFR_EChrg_Sys_Sta: start 183, 2 bit, big-endian, i-signal-type=PRIMITIVE, init-value=constant-reference=Init_CAN2_ZFR_EChrg_Sys_Sta, base-type=uint8, implementation-data-type=uint8, transfer-property=TRIGGERED-ON-CHANGE
          signal CAN2_ZFR_EChrg_WashMode_Sta: start 250, 1 bit, big-endian, i-signal-type=PRIMITIVE, init-value=constant-reference=Init_CAN2_ZFR_EChrg_WashMode_Sta, base-type=uint8, implementation-data-type=uint8, transfer-property=TRIGGERED-ON-CHANGE
      frame CAN2_GW2_CE100_1: id 0x357, frame-length=32, can-addressing-mode=STANDARD, can-fd-frame-support=true, can-frame-rx-behavior=CAN-FD, can-frame-tx-behavior=CAN-FD
        pdu CAN2_GW2_CE100_1: length=32, minimum-delay=0.0, transmission-mode-true-timing={cyclic-timing=time-period=0.1, event-controlled-timing={number-of-repetitions=0, repetition-period=0}}, unused-bit-pattern=0
          mapping CAN2_SG_GW2_CE100_1: i-signal-group=CAN2_SG_GW2_CE100_1, start-position=0, transfer-property=PENDING
          mapping CAN2_SG_CGW_GW2_CE100_1: i-signal-group=CAN2_SG_CGW_GW2_CE100_1, start-position=0, transfer-property=TRIGGERED-ON-CHANGE
          signal CAN2_BD_DSEAT_Anti_Sta: start 75, 1 bit, big-endian, i-signal-type=PRIMITIVE, init-value=constant-reference=Init_CAN2_BD_DSEAT_Anti_Sta, base-type=uint8, implementation-data-type=uint8, transfer-property=TRIGGERED-ON-CHANGE
          signal CAN2_BD_DSEAT_EntryFun_Sta: start 79, 1 bit, big-endian, i-signal-type=PRIMITIVE, init-value=constant-reference=Init_CAN2_BD_DSEAT_EntryFun_Sta, base-type=uint8, implementation-data-type=uint8, transfer-property=TRIGGERED-ON-CHANGE
          signal CAN2_BD_DSEAT_Error_Sta: start 83, 1 bit, big-endian, i-signal-type=PRIMITIVE, init-value=constant-reference=Init_CAN2_BD_DSEAT_Error_Sta, base-type=uint8, implementation-data-type=uint8, transfer-property=TRIGGERED-ON-CHANGE
          signal CAN2_BD_DSEAT_MemSet_Sta: start 15, 2 bit, big-endian, i-signal-type=PRIMITIVE, init-value=constant-reference=Init_CAN2_BD_DSEAT_MemSet_Sta, base-type=uint8, implementation-data-type=uint8, transfer-property=TRIGGERED-ON-CHANGE
          signal CAN2_BD_DSEAT_Mode_Sta: start 82, 3 bit, big-endian, i-signal-type=PRIMITIVE, init-value=constant-reference=Init_CAN2_BD_DSEAT_Mode_Sta, base-type=uint8, implementation-data-type=uint8, transfer-property=TRIGGERED-ON-CHANGE
          signal CAN2_BD_DSEAT_StopKeepMove_Sta: start 13, 2 bit, big-endian, i-signal-type=PRIMITIVE, init-value=constant-reference=Init_CAN2_BD_DSEAT_StopKeepMove_Sta, base-type=uint8, implementation-data-type=uint8, transfer-property=TRIGGERED-ON-CHANGE
          signal CAN2_BD_DSEAT_Vent_Sta: start 74, 3 bit, big-endian, i-signal-type=PRIMITIVE, init-value=constant-reference=Init_CAN2_BD_DSEAT_Vent_Sta, base-type=uint8, implementation-data-type=uint8, transfer-property=TRIGGERED-ON-CHANGE
          signal CAN2_BD_DSEAT_heater_Sta: start 66, 3 bit, big-endian, i-signal-type=PRIMITIVE, init-value=constant-reference=Init_CAN2_BD_DSEAT_heater_Sta, base-type=uint8, implementation-data-type=uint8, transfer-property=TRIGGERED-ON-CHANGE
          signal CAN2_BD_Door_FHandleClose_Sta: start 199, 1 bit, big-endian, i-signal-type=PRIMITIVE, init-value=constant-reference=Init_CAN2_BD_Door_FHandleClose_Sta, base-type=uint8, implementation-data-type=uint8, transfer-property=TRIGGERED-ON-CHANGE
          signal CAN2_BD_Door_RHandleClose_Sta: start 198, 1 bit, big-endian, i-signal-type=PRIMITIVE, init-value=constant-reference=Init_CAN2_BD_Door_RHandleClose_Sta, base-type=uint8, implementation-data-type=uint8, transfer-property=TRIGGERED-ON-CHANGE
          signal CAN2_BP_Door_FHandleClose_Sta: start 197, 1 bit, big-endian, i-signal-type=PRIMITIVE, init-value=constant-reference=Init_CAN2_BP_Door_FHandleClose_Sta, base-type=uint8, implementation-data-type=uint8, transfer-property=TRIGGERED-ON-CHANGE
          signal CAN2_BP_Door_RHandleClose_Sta: start 196, 1 bit, big-endian, i-signal-type=PRIMITIVE, init-value=constant-reference=Init_CAN2_BP_Door_RHandleClose_Sta, base-type=uint8, implementation-data-type=uint8, transfer-property=TRIGGERED-ON-CHANGE
          signal CAN2_BP_PSEAT_Error_Sta: start 87, 1 bit, big-endian, i-signal-type=PRIMITIVE, init-value=constant-reference=Init_CAN2_BP_PSEAT_Error_Sta, base-type=uint8, implementation-data-type=uint8, transfer-property=TRIGGERED-ON-CHANGE
          signal CAN2_BP_PSEAT_Mode_Sta: start 86, 3 bit, big-endian, i-signal-type=PRIMITIVE, init-value=constant-reference=Init_CAN2_BP_PSEAT_Mode_Sta, base-type=uint8, implementation-data-type=uint8, transfer-property=TRIGGERED-ON-CHANGE
          signal CAN2_BP_PSEAT_Vent_Sta: start 78, 3 bit, big-endian, i-signal-type=PRIMITIVE, init-value=constant-reference=Init_CAN2_BP_PSEAT_Vent_Sta, base-type=uint8, implementation-data-type=uint8, transfer-property=TRIGGERED-ON-CHANGE
          signal CAN2_BP_PSEAT_heater_Sta: start 70, 3 bit, big-endian, i-signal-type=PRIMITIVE, init-value=constant-reference=Init_CAN2_BP_PSEAT_heater_Sta, base-type=uint8, implementation-data-type=uint8, transfer-property=TRIGGERED-ON-CHANGE
          signal CAN2_BP_PTG_Active_Sta: start 90, 3 bit, big-endian, i-signal-type=PRIMITIVE, init-value=constant-reference=Init_CAN2_BP_PTG_Active_Sta, base-type=uint8, implementation-data-type=uint8, transfer-property=TRIGGERED-ON-CHANGE
          signal CAN2_BP_PTG_Exist_Sta: start 91, 1 bit, big-endian, i-signal-type=PRIMITIVE, init-value=constant-reference=Init_CAN2_BP_PTG_Exist_Sta, base-type=uint8, implementation-data-type=uint8, transfer-property=TRIGGERED-ON-CHANGE
          signal CAN2_BP_PTG_IsSetHeight_Sta: start 94, 1 bit, big-endian, i-signal-type=PRIMITIVE, init-value=constant-reference=Init_CAN2_BP_PTG_IsSetHeight_Sta, base-type=uint8, implementation-data-type=uint8, transfer-property=TRIGGERED-ON-CHANGE
          signal CAN2_BP_PTG_Sys_Sta: start 93, 2 bit, big-endian, i-signal-type=PRIMITIVE, init-value=constant-reference=Init_CAN2_BP_PTG_Sys_Sta, base-type=uint8, implementation-data-type=uint8, transfer-property=TRIGGERED-ON-CHANGE
          signal CAN2_BP_SEAT_LVent_Sta: start 21, 3 bit, big-endian, i-signal-type=PRIMITIVE, init-value=constant-reference=Init_CAN2_BP_SEAT_LVent_Sta, base-type=uint8, implementation-data-type=uint8, transfer-property=TRIGGERED-ON-CHANGE
          signal CAN2_BP_SEAT_MLVent_Sta: start 29, 3 bit, big-endian, i-signal-type=PRIMITIVE, init-value=constant-reference=Init_CAN2_BP_SEAT_MLVent_Sta, base-type=uint8, implementation-data-type=uint8, transfer-property=TRIGGERED-ON-CHANGE
          signal CAN2_BP_SEAT_MRVent_Sta: start 26, 3 bit, big-endian, i-signal-type=PRIMITIVE, init-value=constant-reference=Init_CAN2_BP_SEAT_MRVent_Sta, base-type=uint8, implementation-data-type=uint8, transfer-property=TRIGGERED-ON-CHANGE
          signal CAN2_BP_SEAT_RVent_Sta: start 18, 3 bit, big-endian, i-signal-type=PRIMITIVE, init-value=constant-reference=Init_CAN2_BP_SEAT_RVent_Sta, base-type=uint8, implementation-data-type=uint8, transfer-property=TRIGGERED-ON-CHANGE
          signal CAN2_FDC_BCM_WinLFOpened_Sta: start 38, 7 bit, big-endian, i-signal-type=PRIMITIVE, init-value=constant-reference=Init_CAN2_FDC_BCM_WinLFOpened_Sta, base-type=uint8, implementation-data-type=uint8, transfer-property=PENDING
          signal CAN2_FDC_BCM_WinLROpened_Sta: start 54, 7 bit, big-endian, i-signal-type=PRIMITIVE, init-value=constant-reference=Init_CAN2_FDC_BCM_WinLROpened_Sta, base-type=uint8, implementation-data-type=uint8, transfer-property=PENDING
          signal CAN2_FDC_BCM_WinRFOpened_Sta: start 46, 7 bit, big-endian, i-signal-type=PRIMITIVE, init-value=constant-reference=Init_CAN2_FDC_BCM_WinRFOpened_Sta, base-type=uint8, implementation-data-type=uint8, transfer-property=PENDING
          signal CAN2_FDC_BCM_WinRROpened_Sta: start 62, 7 bit, big-endian, i-signal-type=PRIMITIVE, init-value=constant-reference=Init_CAN2_FDC_BCM_WinRROpened_Sta, base-type=uint8, implementation-data-type=uint8, transfer-property=PENDING
          signal CAN2_Fr_EDUDrtSta: start 193, 1 bit, big-endian, i-signal-type=PRIMITIVE, init-value=constant-reference=Init_CAN2_Fr_EDUDrtSta, base-type=uint8, implementation-data-type=uint8, transfer-property=PENDING
          signal CAN2_Fr_EDURealTMTq: start 231, 16 bit, big-endian, i-signal-type=PRIMITIVE, init-value=constant-reference=Init_CAN2_Fr_EDURealTMTq, base-type=uint16, implementation-data-type=uint16, transfer-property=PENDING
          signal CAN2_Fr_MCUTemp: start 176, 9 bit, big-endian, i-signal-type=PRIMITIVE, init-value=constant-reference=Init_CAN2_Fr_MCUTemp, base-type=uint16, implementation-data-type=uint16, transfer-property=PENDING
          signal CAN2_Fr_MCUTempWarn: start 215, 2 bit, big-endian, i-signal-type=PRIMITIVE, init-value=constant-reference=Init_CAN2_Fr_MCUTempWarn, base-type=uint8, implementation-data-type=uint8, transfer-property=PENDING
          signal CAN2_Fr_MotorAvailTq: start 211, 12 bit, big-endian, i-signal-type=PRIMITIVE, init-value=constant-reference=Init_CAN2_Fr_MotorAvailTq, base-type=uint16, implementation-data-type=uint16, transfer-property=PENDING
          signal CAN2_Fr_TMSpd: start 247, 16 bit, big-endian, i-signal-type=PRIMITIVE, init-value=constant-reference=Init_CAN2_Fr_TMSpd, base-type=uint16, implementation-data-type=uint16, transfer-property=PENDING
          signal CAN2_Fr_TMTemp: start 192, 9 bit, big-endian, i-signal-type=PRIMITIVE, init-value=constant-reference=Init_CAN2_Fr_TMTemp, base-type=uint16, implementation-data-type=uint16, transfer-property=PENDING
          signal CAN2_Fr_TMTempWarn: start 195, 2 bit, big-endian, i-signal-type=PRIMITIVE, init-value=constant-reference=Init_CAN2_Fr_TMTempWarn, base-type=uint8, implementation-data-type=uint8, transfer-property=PENDING
          signal CAN2_MCU_B_F_LLCTempWarn_Sta: start 213, 2 bit, big-endian, i-signal-type=PRIMITIVE, init-value=constant-reference=Init_CAN2_MCU_B_F_LLCTempWarn_Sta, base-type=uint8, implementation-data-type=uint8, transfer-property=TRIGGERED-ON-CHANGE
          signal CAN2_MCU_B_R_LLCTempWarn_Sta: start 133, 2 bit, big-endian, i-signal-type=PRIMITIVE, init-value=constant-reference=Init_CAN2_MCU_B_R_LLCTempWarn_Sta, base-type=uint8, implementation-data-type=uint8, transfer-property=TRIGGERED-ON-CHANGE
          signal CAN2_Rr_EDUDrtSta: start 113, 1 bit, big-endian, i-signal-type=PRIMITIVE, init-value=constant-reference=Init_CAN2_Rr_EDUDrtSta, base-type=uint8, implementation-data-type=uint8, transfer-property=PENDING
          signal CAN2_Rr_EDURealTMTq: start 151, 16 bit, big-endian, i-signal-type=PRIMITIVE, init-value=constant-reference=Init_CAN2_Rr_EDURealTMTq, base-type=uint16, implementation-data-type=uint16, transfer-property=PENDING
          signal CAN2_Rr_MCUTemp: start 96, 9 bit, big-endian, i-signal-type=PRIMITIVE, init-value=constant-reference=Init_CAN2_Rr_MCUTemp, base-type=uint16, implementation-data-type=uint16, transfer-property=PENDING
          signal CAN2_Rr_MCUTempWarn: start 135, 2 bit, big-endian, i-signal-type=PRIMITIVE, init-value=constant-reference=Init_CAN2_Rr_MCUTempWarn, base-type=uint8, implementation-data-type=uint8, transfer-property=PENDING
          signal CAN2_Rr_MotorAvailTq: start 131, 12 bit, big-endian, i-signal-type=PRIMITIVE, init-value=constant-reference=Init_CAN2_Rr_MotorAvailTq, base-type=uint16, implementation-data-type=uint16, transfer-property=PENDING
          signal CAN2_Rr_TMSpd: start 167, 16 bit, big-endian, i-signal-type=PRIMITIVE, init-value=constant-reference=Init_CAN2_Rr_TMSpd, base-type=uint16, implementation-data-type=uint16, transfer-property=PENDING
          signal CAN2_Rr_TMTemp: start 112, 9 bit, big-endian, i-signal-type=PRIMITIVE, init-value=constant-reference=Init_CAN2_Rr_TMTemp, base-type=uint16, implementation-data-type=uint16, transfer-property=PENDING
          signal CAN2_Rr_TMTempWarn: start 115, 2 bit, big-endian, i-signal-type=PRIMITIVE, init-value=constant-reference=Init_CAN2_Rr_TMTempWarn, base-type=uint8, implementation-data-type=uint8, transfer-property=PENDING
          signal CAN2_SWC2_L_DriveMode_Sta: start 71, 1 bit, big-endian, i-signal-type=PRIMITIVE, init-value=constant-reference=Init_CAN2_SWC2_L_DriveMode_Sta, base-type=uint8, implementation-data-type=uint8, transfer-property=TRIGGERED-ON-CHANGE
          signal CAN2_SWC2_L_Home_Sta: start 67, 1 bit, big-endian, i-signal-type=PRIMITIVE, init-value=constant-reference=Init_CAN2_SWC2_L_Home_Sta, base-type=uint8, implementation-data-type=uint8, transfer-property=TRIGGERED-ON-CHANGE
          signal CAN2_SWC2_R_Customize_Sta: start 47, 1 bit, big-endian, i-signal-type=PRIMITIVE, init-value=constant-reference=Init_CAN2_SWC2_R_Customize_Sta, base-type=uint8, implementation-data-type=uint8, transfer-property=TRIGGERED-ON-CHANGE
          signal CAN2_SWC2_R_Left_Sta: start 23, 1 bit, big-endian, i-signal-type=PRIMITIVE, init-value=constant-reference=Init_CAN2_SWC2_R_Left_Sta, base-type=uint8, implementation-data-type=uint8, transfer-property=TRIGGERED-ON-CHANGE
          signal CAN2_SWC2_R_PageSwitch_Sta: start 55, 1 bit, big-endian, i-signal-type=PRIMITIVE, init-value=constant-reference=Init_CAN2_SWC2_R_PageSwitch_Sta, base-type=uint8, implementation-data-type=uint8, transfer-property=TRIGGERED-ON-CHANGE
          signal CAN2_SWC2_R_Right_Sta: start 22, 1 bit, big-endian, i-signal-type=PRIMITIVE, init-value=constant-reference=Init_CAN2_SWC2_R_Right_Sta, base-type=uint8, implementation-data-type=uint8, transfer-property=TRIGGERED-ON-CHANGE
          signal CAN2_SWC2_R_ScrollDown_Sta: start 30, 1 bit, big-endian, i-signal-type=PRIMITIVE, init-value=constant-reference=Init_CAN2_SWC2_R_ScrollDown_Sta, base-type=uint8, implementation-data-type=uint8, transfer-property=TRIGGERED-ON-CHANGE
          signal CAN2_SWC2_R_ScrollPress_Sta: start 39, 1 bit, big-endian, i-signal-type=PRIMITIVE, init-value=constant-reference=Init_CAN2_SWC2_R_ScrollPress_Sta, base-type=uint8, implementation-data-type=uint8, transfer-property=TRIGGERED-ON-CHANGE
          signal CAN2_SWC2_R_ScrollUp_Sta: start 31, 1 bit, big-endian, i-signal-type=PRIMITIVE, init-value=constant-reference=Init_CAN2_SWC2_R_ScrollUp_Sta, base-type=uint8, implementation-data-type=uint8, transfer-property=TRIGGERED-ON-CHANGE
          signal CAN2_SWC2_R_VR_Sta: start 63, 1 bit, big-endian, i-signal-type=PRIMITIVE, init-value=constant-reference=Init_CAN2_SWC2_R_VR_Sta, base-type=uint8, implementation-data-type=uint8, transfer-property=TRIGGERED-ON-CHANGE
      frame CAN2_GW2_CE100_2: id 0x359, frame-length=32, can-addressing-mode=STANDARD, can-fd-frame-support=true, can-frame-rx-behavior=CAN-FD, can-frame-tx-behavior=CAN-FD
        pdu CAN2_GW2_CE100_2: length=32, minimum-delay=0.0, transmission-mode-true-timing={cyclic-timing=time-period=0.1, event-controlled-timing={number-of-repetitions=0, repetition-period=0}}, unused-bit-pattern=0
          mapping CAN2_SG_GW2_CE100_2: i-signal-group=CAN2_SG_GW2_CE100_2, start-position=0, transfer-property=TRIGGERED-ON-CHANGE
          signal CAN2_DSEAT_Anti_Sta: start 75, 1 bit, big-endian, i-signal-type=PRIMITIVE, init-value=constant-reference=Init_CAN2_DSEAT_Anti_Sta, base-type=uint8, implementation-data-type=uint8, transfer-property=TRIGGERED-ON-CHANGE
          signal CAN2_DSEAT_EntryFun_Sta: start 79, 1 bit, big-endian, i-signal-type=PRIMITIVE, init-value=constant-reference=Init_CAN2_DSEAT_EntryFun_Sta, base-type=uint8, implementation-data-type=uint8, transfer-property=TRIGGERED-ON-CHANGE
          signal CAN2_DSEAT_Error_Sta: start 83, 1 bit, big-endian, i-signal-type=PRIMITIVE, init-value=constant-reference=Init_CAN2_DSEAT_Error_Sta, base-type=uint8, implementation-data-type=uint8, transfer-property=TRIGGERED-ON-CHANGE
          signal CAN2_DSEAT_Mode: start 82, 3 bit, big-endian, i-signal-type=PRIMITIVE, init-value=constant-reference=Init_CAN2_DSEAT_Mode, base-type=uint8, implementation-data-type=uint8, transfer-property=TRIGGERED-ON-CHANGE
          signal CAN2_DSEAT_Vent_Sta: start 74, 3 bit, big-endian, i-signal-type=PRIMITIVE, init-value=constant-reference=Init_CAN2_DSEAT_Vent_Sta, base-type=uint8, implementation-data-type=uint8, transfer-property=TRIGGERED-ON-CHANGE
          signal CAN2_DSEAT_heater_sta: start 66, 3 bit, big-endian, i-signal-type=PRIMITIVE, init-value=constant-reference=Init_CAN2_DSEAT_heater_sta, base-type=uint8, implementation-data-type=uint8, transfer-property=TRIGGERED-ON-CHANGE
          signal CAN2_FAPWL_01_LIN_Response_Error: start 71, 1 bit, big-endian, i-signal-type=PRIMITIVE, init-value=constant-reference=Init_CAN2_FAPWL_01_LIN_Response_Error, base-type=uint8, implementation-data-type=uint8, transfer-property=TRIGGERED-ON-CHANGE
          signal CAN2_Fr_EDUDrtSta_Nidec: start 193, 1 bit, big-endian, i-signal-type=PRIMITIVE, init-value=constant-reference=Init_CAN2_Fr_EDUDrtSta_Nidec, base-type=uint8, implementation-data-type=uint8, transfer-property=PENDING
          signal CAN2_Fr_EDURealTMTq_Nidec: start 227, 12 bit, big-endian, i-signal-type=PRIMITIVE, init-value=constant-reference=Init_CAN2_Fr_EDURealTMTq_Nidec, base-type=uint16, implementation-data-type=uint16, transfer-property=PENDING
          signal CAN2_Fr_MCUTempWarn_Nidec: start 231, 2 bit, big-endian, i-signal-type=PRIMITIVE, init-value=constant-reference=Init_CAN2_Fr_MCUTempWarn_Nidec, base-type=uint8, implementation-data-type=uint8, transfer-property=PENDING
          signal CAN2_Fr_MCUTemp_Nidec: start 176, 9 bit, big-endian, i-signal-type=PRIMITIVE, init-value=constant-reference=Init_CAN2_Fr_MCUTemp_Nidec, base-type=uint16, implementation-data-type=uint16, transfer-property=PENDING
          signal CAN2_Fr_MotorAvailTq_Nidec: start 211, 12 bit, big-endian, i-signal-type=PRIMITIVE, init-value=constant-reference=Init_CAN2_Fr_MotorAvailTq_Nidec, base-type=uint16, implementation-data-type=uint16, transfer-property=PENDING
          signal CAN2_Fr_TMSpd_Nidec: start 247, 16 bit, big-endian, i-signal-type=PRIMITIVE, init-value=constant-reference=Init_CAN2_Fr_TMSpd_Nidec, base-type=uint16, implementation-data-type=uint16, transfer-property=PENDING
          signal CAN2_Fr_TMTempWarn_Nidec: start 229, 2 bit, big-endian, i-signal-type=PRIMITIVE, init-value=constant-reference=Init_CAN2_Fr_TMTempWarn_Nidec, base-type=uint8, implementation-data-type=uint8, transfer-property=PENDING
          signal CAN2_Fr_TMTemp_Nidec: start 192, 9 bit, big-endian, i-signal-type=PRIMITIVE, init-value=constant-reference=Init_CAN2_Fr_TMTemp_Nidec, base-type=uint16, implementation-data-type=uint16, transfer-property=PENDING
          signal CAN2_L_Drv_Motor_Relay_Error: start 27, 1 bit, big-endian, i-signal-type=PRIMITIVE, init-value=constant-reference=Init_CAN2_L_Drv_Motor_Relay_Error, base-type=uint8, implementation-data-type=uint8, transfer-property=TRIGGERED-ON-CHANGE
          signal CAN2_L_Drv_Motor_Ripple_Error: start 39, 1 bit, big-endian, i-signal-type=PRIMITIVE, init-value=constant-reference=Init_CAN2_L_Drv_Motor_Ripple_Error, base-type=uint8, implementation-data-type=uint8, transfer-property=TRIGGERED-ON-CHANGE
          signal CAN2_L_Drv_Val_Wdw_Opened: start 38, 7 bit, big-endian, i-signal-type=PRIMITIVE, init-value=constant-reference=Init_CAN2_L_Drv_Val_Wdw_Opened, base-type=uint8, implementation-data-type=uint8, transfer-property=PENDING
          signal CAN2_L_Pas_Motor_Relay_Error: start 26, 1 bit, big-endian, i-signal-type=PRIMITIVE, init-value=constant-reference=Init_CAN2_L_Pas_Motor_Relay_Error, base-type=uint8, implementation-data-type=uint8, transfer-property=TRIGGERED-ON-CHANGE
          signal CAN2_L_Pas_Motor_Ripple_Error: start 47, 1 bit, big-endian, i-signal-type=PRIMITIVE, init-value=constant-reference=Init_CAN2_L_Pas_Motor_Ripple_Error, base-type=uint8, implementation-data-type=uint8, transfer-property=TRIGGERED-ON-CHANGE
          signal CAN2_L_Pas_Val_Wdw_Opened: start 46, 7 bit, big-endian, i-signal-type=PRIMITIVE, init-value=constant-reference=Init_CAN2_L_Pas_Val_Wdw_Opened, base-type=uint8, implementation-data-type=uint8, transfer-property=PENDING
          signal CAN2_L_RLD_Motor_Relay_Error: start 25, 1 bit, big-endian, i-signal-type=PRIMITIVE, init-value=constant-reference=Init_CAN2_L_RLD_Motor_Relay_Error, base-type=uint8, implementation-data-type=uint8, transfer-property=TRIGGERED-ON-CHANGE
          signal CAN2_L_RLD_Motor_Ripple_Error: start 55, 1 bit, big-endian, i-signal-type=PRIMITIVE, init-value=constant-reference=Init_CAN2_L_RLD_Motor_Ripple_Error, base-type=uint8, implementation-data-type=uint8, transfer-property=TRIGGERED-ON-CHANGE
          signal CAN2_L_RLD_Val_Wdw_Opened: start 54, 7 bit, big-endian, i-signal-type=PRIMITIVE, init-value=constant-reference=Init_CAN2_L_RLD_Val_Wdw_Opened, base-type=uint8, implementation-data-type=uint8, transfer-property=PENDING
          signal CAN2_L_RRD_Motor_Relay_Error: start 24, 1 bit, big-endian, i-signal-type=PRIMITIVE, init-value=constant-reference=Init_CAN2_L_RRD_Motor_Relay_Error, base-type=uint8, implementation-data-type=uint8, transfer-property=TRIGGERED-ON-CHANGE
          signal CAN2_L_RRD_Motor_Ripple_Error: start 63, 1 bit, big-endian, i-signal-type=PRIMITIVE, init-value=constant-reference=Init_CAN2_L_RRD_Motor_Ripple_Error, base-type=uint8, implementation-data-type=uint8, transfer-property=TRIGGERED-ON-CHANGE
          signal CAN2_L_RRD_Val_Wdw_Opened: start 62, 7 bit, big-endian, i-signal-type=PRIMITIVE, init-value=constant-reference=Init_CAN2_L_RRD_Val_Wdw_Opened, base-type=uint8, implementation-data-type=uint8, transfer-property=PENDING
          signal CAN2_PSEAT_Error_Sta: start 87, 1 bit, big-endian, i-signal-type=PRIMITIVE, init-value=constant-reference=Init_CAN2_PSEAT_Error_Sta, base-type=uint8, implementation-data-type=uint8, transfer-property=TRIGGERED-ON-CHANGE
          signal CAN2_PSEAT_Mode: start 86, 3 bit, big-endian, i-signal-type=PRIMITIVE, init-value=constant-reference=Init_CAN2_PSEAT_Mode, base-type=uint8, implementation-data-type=uint8, transfer-property=TRIGGERED-ON-CHANGE
          signal CAN2_PSEAT_Vent_Sta: start 78, 3 bit, big-endian, i-signal-type=PRIMITIVE, init-value=constant-reference=Init_CAN2_PSEAT_Vent_Sta, base-type=uint8, implementation-data-type=uint8, transfer-property=TRIGGERED-ON-CHANGE
          signal CAN2_PSEAT_heater_sta: start 70, 3 bit, big-endian, i-signal-type=PRIMITIVE, init-value=constant-reference=Init_CAN2_PSEAT_heater_sta, base-type=uint8, implementation-data-type=uint8, transfer-property=TRIGGERED-ON-CHANGE
          signal CAN2_PTG_Active_Sta: start 90, 3 bit, big-endian, i-signal-type=PRIMITIVE, init-value=constant-reference=Init_CAN2_PTG_Active_Sta, base-type=uint8, implementation-data-type=uint8, transfer-property=TRIGGERED-ON-CHANGE
          signal CAN2_PTG_AutoStaus: start 95, 1 bit, big-endian, i-signal-type=PRIMITIVE, init-value=constant-reference=Init_CAN2_PTG_AutoStaus, base-type=uint8, implementation-data-type=uint8, transfer-property=TRIGGERED-ON-CHANGE
          signal CAN2_PTG_Exist: start 91, 1 bit, big-endian, i-signal-type=PRIMITIVE, init-value=constant-reference=Init_CAN2_PTG_Exist, base-type=uint8, implementation-data-type=uint8, transfer-property=TRIGGERED-ON-CHANGE
          signal CAN2_PTG_Is_Set_Height: start 94, 1 bit, big-endian, i-signal-type=PRIMITIVE, init-value=constant-reference=Init_CAN2_PTG_Is_Set_Height, base-type=uint8, implementation-data-type=uint8, transfer-property=TRIGGERED-ON-CHANGE
          signal CAN2_PTG_Sys_Sta: start 93, 2 bit, big-endian, i-signal-type=PRIMITIVE, init-value=constant-reference=Init_CAN2_PTG_Sys_Sta, base-type=uint8, implementation-data-type=uint8, transfer-property=TRIGGERED-ON-CHANGE
          signal CAN2_RAPWL_01_LIN_Response_Error: start 67, 1 bit, big-endian, i-signal-type=PRIMITIVE, init-value=constant-reference=Init_CAN2_RAPWL_01_LIN_Response_Error, base-type=uint8, implementation-data-type=uint8, transfer-property=TRIGGERED-ON-CHANGE
          signal CAN2_Rr_EDUDrtSta_Nidec: start 113, 1 bit, big-endian, i-signal-type=PRIMITIVE, init-value=constant-reference=Init_CAN2_Rr_EDUDrtSta_Nidec, base-type=uint8, implementation-data-type=uint8, transfer-property=PENDING
          signal CAN2_Rr_EDURealTMTq_Nidec: start 147, 12 bit, big-endian, i-signal-type=PRIMITIVE, init-value=constant-reference=Init_CAN2_Rr_EDURealTMTq_Nidec, base-type=uint16, implementation-data-type=uint16, transfer-property=PENDING
          signal CAN2_Rr_MCUTempWarn_Nidec: start 151, 2 bit, big-endian, i-signal-type=PRIMITIVE, init-value=constant-reference=Init_CAN2_Rr_MCUTempWarn_Nidec, base-type=uint8, implementation-data-type=uint8, transfer-property=PENDING
          signal CAN2_Rr_MCUTemp_Nidec: start 96, 9 bit, big-endian, i-signal-type=PRIMITIVE, init-value=constant-reference=Init_CAN2_Rr_MCUTemp_Nidec, base-type=uint16, implementation-data-type=uint16, transfer-property=PENDING
          signal CAN2_Rr_MotorAvailTq_Nidec: start 131, 12 bit, big-endian, i-signal-type=PRIMITIVE, init-value=constant-reference=Init_CAN2_Rr_MotorAvailTq_Nidec, base-type=uint16, implementation-data-type=uint16, transfer-property=PENDING
          signal CAN2_Rr_TMSpd_Nidec: start 167, 16 bit, big-endian, i-signal-type=PRIMITIVE, init-value=constant-reference=Init_CAN2_Rr_TMSpd_Nidec, base-type=uint16, implementation-data-type=uint16, transfer-property=PENDING
          signal CAN2_Rr_TMTempWarn_Nidec: start 149, 2 bit, big-endian, i-signal-type=PRIMITIVE, init-value=constant-reference=Init_CAN2_Rr_TMTempWarn_Nidec, base-type=uint8, implementation-data-type=uint8, transfer-property=PENDING
          signal CAN2_Rr_TMTemp_Nidec: start 112, 9 bit, big-endian, i-signal-type=PRIMITIVE, init-value=constant-reference=Init_CAN2_Rr_TMTemp_Nidec, base-type=uint16, implementation-data-type=uint16, transfer-property=PENDING
      frame CAN2_GW2_CE200_0: id 0x174, frame-length=32, can-addressing-mode=STANDARD, can-fd-frame-support=true, can-frame-rx-behavior=CAN-FD, can-frame-tx-behavior=CAN-FD
        pdu CAN2_GW2_CE200_0: length=32, minimum-delay=0.0, transmission-mode-true-timing={cyclic-timing=time-period=0.2, event-controlled-timing={number-of-repetitions=0, repetition-period=0}}, unused-bit-pattern=0
          mapping CAN2_SG_GW2_CE200_0: i-signal-group=CAN2_SG_GW2_CE200_0, start-position=0, transfer-property=TRIGGERED-ON-CHANGE
          mapping CAN2_SG_CGW_GW2_CE200_0: i-signal-group=CAN2_SG_CGW_GW2_CE200_0, start-position=0, transfer-property=TRIGGERED-ON-CHANGE
          signal CAN2_ACC_ObjDist: start 98, 11 bit, big-endian, i-signal-type=PRIMITIVE, init-value=constant-reference=Init_CAN2_ACC_ObjDist, base-type=uint16, implementation-data-type=uint16, transfer-property=TRIGGERED-ON-CHANGE
          signal CAN2_ACC_ObjDstLvl: start 70, 3 bit, big-endian, i-signal-type=PRIMITIVE, init-value=constant-reference=Init_CAN2_ACC_ObjDstLvl, base-type=uint8, implementation-data-type=uint8, transfer-property=TRIGGERED-ON-CHANGE
          signal CAN2_ACC_ObjRelSpd: start 82, 11 bit, big-endian, i-signal-type=PRIMITIVE, init-value=constant-reference=Init_CAN2_ACC_ObjRelSpd, base-type=uint16, implementation-data-type=uint16, transfer-property=TRIGGERED-ON-CHANGE
          signal CAN2_ACC_TakeoverReq: start 83, 1 bit, big-endian, i-signal-type=PRIMITIVE, init-value=constant-reference=Init_CAN2_ACC_TakeoverReq, base-type=uint8, implementation-data-type=uint8, transfer-property=TRIGGERED-ON-CHANGE
          signal CAN2_ADAS_ACC_Sta: start 47, 3 bit, big-endian, i-signal-type=PRIMITIVE, init-value=constant-reference=Init_CAN2_ADAS_ACC_Sta, base-type=uint8, implementation-data-type=uint8, transfer-property=TRIGGERED-ON-CHANGE
          signal CAN2_ADAS_AEBReq: start 115, 3 bit, big-endian, i-signal-type=PRIMITIVE, init-value=constant-reference=Init_CAN2_ADAS_AEBReq, base-type=uint8, implementation-data-type=uint8, transfer-property=TRIGGERED-ON-CHANGE
          signal CAN2_ADAS_AEB_Sta: start 66, 3 bit, big-endian, i-signal-type=PRIMITIVE, init-value=constant-reference=Init_CAN2_ADAS_AEB_Sta, base-type=uint8, implementation-data-type=uint8, transfer-property=TRIGGERED-ON-CHANGE
          signal CAN2_ADAS_CAM_SpdLim: start 44, 5 bit, big-endian, i-signal-type=PRIMITIVE, init-value=constant-reference=Init_CAN2_ADAS_CAM_SpdLim, base-type=uint8, implementation-data-type=uint8, transfer-property=TRIGGERED-ON-CHANGE
          signal CAN2_ADAS_FCW_Mute: start 191, 1 bit, big-endian, i-signal-type=PRIMITIVE, init-value=constant-reference=Init_CAN2_ADAS_FCW_Mute, base-type=uint8, implementation-data-type=uint8, transfer-property=TRIGGERED-ON-CHANGE
          signal CAN2_ADAS_FCW_Sensitivity: start 6, 1 bit, big-endian, i-signal-type=PRIMITIVE, init-value=constant-reference=Init_CAN2_ADAS_FCW_Sensitivity, base-type=uint8, implementation-data-type=uint8, transfer-property=TRIGGERED-ON-CHANGE
          signal CAN2_ADAS_FCW_Sta: start 39, 3 bit, big-endian, i-signal-type=PRIMITIVE, init-value=constant-reference=Init_CAN2_ADAS_FCW_Sta, base-type=uint8, implementation-data-type=uint8, transfer-property=TRIGGERED-ON-CHANGE
          signal CAN2_ADAS_FltWrnReq: start 103, 1 bit, big-endian, i-signal-type=PRIMITIVE, init-value=constant-reference=Init_CAN2_ADAS_FltWrnReq, base-type=uint8, implementation-data-type=uint8, transfer-property=TRIGGERED-ON-CHANGE
          signal CAN2_ADAS_ISA_Sta: start 87, 4 bit, big-endian, i-signal-type=PRIMITIVE, init-value=constant-reference=Init_CAN2_ADAS_ISA_Sta, base-type=uint8, implementation-data-type=uint8, transfer-property=TRIGGERED-ON-CHANGE
          signal CAN2_ADAS_LDW_Mute: start 99, 1 bit, big-endian, i-signal-type=PRIMITIVE, init-value=constant-reference=Init_CAN2_ADAS_LDW_Mute, base-type=uint8, implementation-data-type=uint8, transfer-property=TRIGGERED-ON-CHANGE
          signal CAN2_ADAS_LDW_Sensitivity: start 5, 1 bit, big-endian, i-signal-type=PRIMITIVE, init-value=constant-reference=Init_CAN2_ADAS_LDW_Sensitivity, base-type=uint8, implementation-data-type=uint8, transfer-property=TRIGGERED-ON-CHANGE
          signal CAN2_ADAS_LDW_Sta: start 78, 3 bit, big-endian, i-signal-type=PRIMITIVE, init-value=constant-reference=Init_CAN2_ADAS_LDW_Sta, base-type=uint8, implementation-data-type=uint8, transfer-property=TRIGGERED-ON-CHANGE
          signal CAN2_ADAS_LFC_Hands_Off_Warning: start 207, 2 bit, big-endian, i-signal-type=PRIMITIVE, init-value=constant-reference=Init_CAN2_ADAS_LFC_Hands_Off_Warning, base-type=uint8, implementation-data-type=uint8, transfer-property=TRIGGERED-ON-CHANGE
          signal CAN2_ADAS_LFC_Sta: start 102, 3 bit, big-endian, i-signal-type=PRIMITIVE, init-value=constant-reference=Init_CAN2_ADAS_LFC_Sta, base-type=uint8, implementation-data-type=uint8, transfer-property=TRIGGERED-ON-CHANGE
          signal CAN2_ADAS_LFC_Warn_Sound: start 31, 8 bit, big-endian, i-signal-type=PRIMITIVE, init-value=constant-reference=Init_CAN2_ADAS_LFC_Warn_Sound, base-type=uint8, implementation-data-type=uint8, transfer-property=TRIGGERED-ON-CHANGE
          signal CAN2_ADAS_LKA_Sta: start 187, 3 bit, big-endian, i-signal-type=PRIMITIVE, init-value=constant-reference=Init_CAN2_ADAS_LKA_Sta, base-type=uint8, implementation-data-type=uint8, transfer-property=TRIGGERED-ON-CHANGE
          signal CAN2_ADAS_LaneModeL: start 118, 3 bit, big-endian, i-signal-type=PRIMITIVE, init-value=constant-reference=Init_CAN2_ADAS_LaneModeL, base-type=uint8, implementation-data-type=uint8, transfer-property=TRIGGERED-ON-CHANGE
          signal CAN2_ADAS_LaneModeR: start 190, 3 bit, big-endian, i-signal-type=PRIMITIVE, init-value=constant-reference=Init_CAN2_ADAS_LaneModeR, base-type=uint8, implementation-data-type=uint8, transfer-property=TRIGGERED-ON-CHANGE
          signal CAN2_ADAS_SLIF_SpdLim: start 36, 5 bit, big-endian, i-signal-type=PRIMITIVE, init-value=constant-reference=Init_CAN2_ADAS_SLIF_SpdLim, base-type=uint8, implementation-data-type=uint8, transfer-property=TRIGGERED-ON-CHANGE
          signal CAN2_ADAS_SLIF_Sta: start 74, 3 bit, big-endian, i-signal-type=PRIMITIVE, init-value=constant-reference=Init_CAN2_ADAS_SLIF_Sta, base-type=uint8, implementation-data-type=uint8, transfer-property=TRIGGERED-ON-CHANGE
          signal CAN2_ADAS_VehSpdLim: start 23, 8 bit, big-endian, i-signal-type=PRIMITIVE, init-value=constant-reference=Init_CAN2_ADAS_VehSpdLim, base-type=uint8, implementation-data-type=uint8, transfer-property=TRIGGERED-ON-CHANGE
          signal CAN2_ADAS_WarningMsg: start 55, 4 bit, big-endian, i-signal-type=PRIMITIVE, init-value=constant-reference=Init_CAN2_ADAS_WarningMsg, base-type=uint8, implementation-data-type=uint8, transfer-property=TRIGGERED-ON-CHANGE
          signal CAN2_ActBrkLamp_Sta: start 119, 1 bit, big-endian, i-signal-type=PRIMITIVE, init-value=constant-reference=Init_CAN2_ActBrkLamp_Sta, base-type=uint8, implementation-data-type=uint8, transfer-property=TRIGGERED-ON-CHANGE
          signal CAN2_CameraBlockage: start 4, 1 bit, big-endian, i-signal-type=PRIMITIVE, init-value=constant-reference=Init_CAN2_CameraBlockage, base-type=uint8, implementation-data-type=uint8, transfer-property=TRIGGERED-ON-CHANGE
          signal CAN2_FDC_BCM_TimeGapLevel_Sta: start 14, 3 bit, big-endian, i-signal-type=PRIMITIVE, init-value=constant-reference=Init_CAN2_FDC_BCM_TimeGapLevel_Sta, base-type=uint8, implementation-data-type=uint8, transfer-property=TRIGGERED-ON-CHANGE
          signal CAN2_ForceLowBeam: start 1, 2 bit, big-endian, i-signal-type=PRIMITIVE, init-value=constant-reference=Init_CAN2_ForceLowBeam, base-type=uint8, implementation-data-type=uint8, transfer-property=TRIGGERED-ON-CHANGE
          signal CAN2_HVBFullChrgPwr: start 205, 10 bit, big-endian, i-signal-type=PRIMITIVE, init-value=constant-reference=Init_CAN2_HVBFullChrgPwr, base-type=uint16, implementation-data-type=uint16, transfer-property=PENDING
          signal CAN2_HVBPwrAvailChrg: start 235, 12 bit, big-endian, i-signal-type=PRIMITIVE, init-value=constant-reference=Init_CAN2_HVBPwrAvailChrg, base-type=uint16, implementation-data-type=uint16, transfer-property=PENDING
          signal CAN2_HVBPwrAvailChrg30: start 231, 12 bit, big-endian, i-signal-type=PRIMITIVE, init-value=constant-reference=Init_CAN2_HVBPwrAvailChrg30, base-type=uint16, implementation-data-type=uint16, transfer-property=PENDING
          signal CAN2_HVBPwrAvailChrg60: start 211, 12 bit, big-endian, i-signal-type=PRIMITIVE, init-value=constant-reference=Init_CAN2_HVBPwrAvailChrg60, base-type=uint16, implementation-data-type=uint16, transfer-property=PENDING
          signal CAN2_HVBSOH: start 175, 8 bit, big-endian, i-signal-type=PRIMITIVE, init-value=constant-reference=Init_CAN2_HVBSOH, base-type=uint8, implementation-data-type=uint8, transfer-property=PENDING
          signal CAN2_HazardWarningReq: start 15, 1 bit, big-endian, i-signal-type=PRIMITIVE, init-value=constant-reference=Init_CAN2_HazardWarningReq, base-type=uint8, implementation-data-type=uint8, transfer-property=TRIGGERED-ON-CHANGE
          signal CAN2_ISA_WarningMsg: start 51, 4 bit, big-endian, i-signal-type=PRIMITIVE, init-value=constant-reference=Init_CAN2_ISA_WarningMsg, base-type=uint8, implementation-data-type=uint8, transfer-property=TRIGGERED-ON-CHANGE
          signal CAN2_LKA_HOD_Display_Warning: start 67, 1 bit, big-endian, i-signal-type=PRIMITIVE, init-value=constant-reference=Init_CAN2_LKA_HOD_Display_Warning, base-type=uint8, implementation-data-type=uint8, transfer-property=TRIGGERED-ON-CHANGE
          signal CAN2_LKA_HOD_Sound_Warning: start 75, 1 bit, big-endian, i-signal-type=PRIMITIVE, init-value=constant-reference=Init_CAN2_LKA_HOD_Sound_Warning, base-type=uint8, implementation-data-type=uint8, transfer-property=TRIGGERED-ON-CHANGE
          signal CAN2_LVDA_ACCStatusInformation: start 2, 1 bit, big-endian, i-signal-type=PRIMITIVE, init-value=constant-reference=Init_CAN2_LVDA_ACCStatusInformation, base-type=uint8, implementation-data-type=uint8, transfer-property=TRIGGERED-ON-CHANGE
          signal CAN2_LVDA_Disabled: start 3, 1 bit, big-endian, i-signal-type=PRIMITIVE, init-value=constant-reference=Init_CAN2_LVDA_Disabled, base-type=uint8, implementation-data-type=uint8, transfer-property=TRIGGERED-ON-CHANGE
          signal CAN2_LVDA_Failinfo: start 59, 1 bit, big-endian, i-signal-type=PRIMITIVE, init-value=constant-reference=Init_CAN2_LVDA_Failinfo, base-type=uint8, implementation-data-type=uint8, transfer-property=TRIGGERED-ON-CHANGE
          signal CAN2_LVDA_Mute_Sta: start 135, 2 bit, big-endian, i-signal-type=PRIMITIVE, init-value=constant-reference=Init_CAN2_LVDA_Mute_Sta, base-type=uint8, implementation-data-type=uint8, transfer-property=TRIGGERED-ON-CHANGE
          signal CAN2_LVDA_Warning: start 63, 1 bit, big-endian, i-signal-type=PRIMITIVE, init-value=constant-reference=Init_CAN2_LVDA_Warning, base-type=uint8, implementation-data-type=uint8, transfer-property=TRIGGERED-ON-CHANGE
          signal CAN2_LeftTurnLightReq: start 71, 1 bit, big-endian, i-signal-type=PRIMITIVE, init-value=constant-reference=Init_CAN2_LeftTurnLightReq, base-type=uint8, implementation-data-type=uint8, transfer-property=TRIGGERED-ON-CHANGE
          signal CAN2_MCU_B_F_RealPwrKw_Sta: start 143, 16 bit, big-endian, i-signal-type=PRIMITIVE, init-value=constant-reference=Init_CAN2_MCU_B_F_RealPwrKw_Sta, base-type=uint16, implementation-data-type=uint16, transfer-property=PENDING
          signal CAN2_MCU_B_R_RealPwrKw_Sta: start 159, 16 bit, big-endian, i-signal-type=PRIMITIVE, init-value=constant-reference=Init_CAN2_MCU_B_R_RealPwrKw_Sta, base-type=uint16, implementation-data-type=uint16, transfer-property=PENDING
          signal CAN2_RightTurnLightReq: start 79, 1 bit, big-endian, i-signal-type=PRIMITIVE, init-value=constant-reference=Init_CAN2_RightTurnLightReq, base-type=uint8, implementation-data-type=uint8, transfer-property=TRIGGERED-ON-CHANGE
          signal CAN2_Target_Type: start 11, 4 bit, big-endian, i-signal-type=PRIMITIVE, init-value=constant-reference=Init_CAN2_Target_Type, base-type=uint8, implementation-data-type=uint8, transfer-property=TRIGGERED-ON-CHANGE
      frame CAN2_HMI1: id 0x491, frame-length=8, can-addressing-mode=STANDARD, can-fd-frame-support=true, can-frame-rx-behavior=CAN-FD, can-frame-tx-behavior=CAN-FD
        pdu CAN2_HMI1: length=8, minimum-delay=0.0, transmission-mode-true-timing={cyclic-timing=time-period=0.2, event-controlled-timing={number-of-repetitions=0, repetition-period=0}}, unused-bit-pattern=0
          mapping CAN2_SG_HMI1: i-signal-group=CAN2_SG_HMI1, start-position=0, transfer-property=TRIGGERED-ON-CHANGE
          signal CAN2_HMI_ACAirIntM_Cmd: start 28, 1 bit, big-endian, i-signal-type=PRIMITIVE, init-value=constant-reference=Init_CAN2_HMI_ACAirIntM_Cmd, base-type=uint8, implementation-data-type=uint8, transfer-property=TRIGGERED-ON-CHANGE
          signal CAN2_HMI_ACAirIntP_Cmd: start 29, 1 bit, big-endian, i-signal-type=PRIMITIVE, init-value=constant-reference=Init_CAN2_HMI_ACAirIntP_Cmd, base-type=uint8, implementation-data-type=uint8, transfer-property=TRIGGERED-ON-CHANGE
          signal CAN2_HMI_ACAutoBtn_Cmd: start 22, 1 bit, big-endian, i-signal-type=PRIMITIVE, init-value=constant-reference=Init_CAN2_HMI_ACAutoBtn_Cmd, base-type=uint8, implementation-data-type=uint8, transfer-property=TRIGGERED-ON-CHANGE
          signal CAN2_HMI_ACBtn_Cmd: start 23, 1 bit, big-endian, i-signal-type=PRIMITIVE, init-value=constant-reference=Init_CAN2_HMI_ACBtn_Cmd, base-type=uint8, implementation-data-type=uint8, transfer-property=TRIGGERED-ON-CHANGE
          signal CAN2_HMI_ACFrDefogBtn_Cmd: start 20, 1 bit, big-endian, i-signal-type=PRIMITIVE, init-value=constant-reference=Init_CAN2_HMI_ACFrDefogBtn_Cmd, base-type=uint8, implementation-data-type=uint8, transfer-property=TRIGGERED-ON-CHANGE
          signal CAN2_HMI_ACRecycleBtn_Cmd: start 21, 1 bit, big-endian, i-signal-type=PRIMITIVE, init-value=constant-reference=Init_CAN2_HMI_ACRecycleBtn_Cmd, base-type=uint8, implementation-data-type=uint8, transfer-property=TRIGGERED-ON-CHANGE
          signal CAN2_HMI_ACWindDirM_Cmd: start 30, 1 bit, big-endian, i-signal-type=PRIMITIVE, init-value=constant-reference=Init_CAN2_HMI_ACWindDirM_Cmd, base-type=uint8, implementation-data-type=uint8, transfer-property=TRIGGERED-ON-CHANGE
          signal CAN2_HMI_ACWindDirP_Cmd: start 31, 1 bit, big-endian, i-signal-type=PRIMITIVE, init-value=constant-reference=Init_CAN2_HMI_ACWindDirP_Cmd, base-type=uint8, implementation-data-type=uint8, transfer-property=TRIGGERED-ON-CHANGE
          signal CAN2_HMI_AutoInterLight_Cmd: start 26, 1 bit, big-endian, i-signal-type=PRIMITIVE, init-value=constant-reference=Init_CAN2_HMI_AutoInterLight_Cmd, base-type=uint8, implementation-data-type=uint8, transfer-property=TRIGGERED-ON-CHANGE
          signal CAN2_HMI_BCMPostDefogBtn_Cmd: start 27, 1 bit, big-endian, i-signal-type=PRIMITIVE, init-value=constant-reference=Init_CAN2_HMI_BCMPostDefogBtn_Cmd, base-type=uint8, implementation-data-type=uint8, transfer-property=TRIGGERED-ON-CHANGE
          signal CAN2_HMI_DSEAT_LevelDown_Cmd: start 34, 1 bit, big-endian, i-signal-type=PRIMITIVE, init-value=constant-reference=Init_CAN2_HMI_DSEAT_LevelDown_Cmd, base-type=uint8, implementation-data-type=uint8, transfer-property=TRIGGERED-ON-CHANGE
          signal CAN2_HMI_DSEAT_LevelUp_Cmd: start 35, 1 bit, big-endian, i-signal-type=PRIMITIVE, init-value=constant-reference=Init_CAN2_HMI_DSEAT_LevelUp_Cmd, base-type=uint8, implementation-data-type=uint8, transfer-property=TRIGGERED-ON-CHANGE
          signal CAN2_HMI_Function1_LevelDown_Cmd: start 42, 1 bit, big-endian, i-signal-type=PRIMITIVE, init-value=constant-reference=Init_CAN2_HMI_Function1_LevelDown_Cmd, base-type=uint8, implementation-data-type=uint8, transfer-property=TRIGGERED-ON-CHANGE
          signal CAN2_HMI_Function1_LevelUp_Cmd: start 50, 1 bit, big-endian, i-signal-type=PRIMITIVE, init-value=constant-reference=Init_CAN2_HMI_Function1_LevelUp_Cmd, base-type=uint8, implementation-data-type=uint8, transfer-property=TRIGGERED-ON-CHANGE
          signal CAN2_HMI_Function2_LevelDown_Cmd: start 43, 1 bit, big-endian, i-signal-type=PRIMITIVE, init-value=constant-reference=Init_CAN2_HMI_Function2_LevelDown_Cmd, base-type=uint8, implementation-data-type=uint8, transfer-property=TRIGGERED-ON-CHANGE
          signal CAN2_HMI_Function2_LevelUp_Cmd: start 51, 1 bit, big-endian, i-signal-type=PRIMITIVE, init-value=constant-reference=Init_CAN2_HMI_Function2_LevelUp_Cmd, base-type=uint8, implementation-data-type=uint8, transfer-property=TRIGGERED-ON-CHANGE
          signal CAN2_HMI_Function3_LevelDown_Cmd: start 44, 1 bit, big-endian, i-signal-type=PRIMITIVE, init-value=constant-reference=Init_CAN2_HMI_Function3_LevelDown_Cmd, base-type=uint8, implementation-data-type=uint8, transfer-property=TRIGGERED-ON-CHANGE
          signal CAN2_HMI_Function3_LevelUp_Cmd: start 52, 1 bit, big-endian, i-signal-type=PRIMITIVE, init-value=constant-reference=Init_CAN2_HMI_Function3_LevelUp_Cmd, base-type=uint8, implementation-data-type=uint8, transfer-property=TRIGGERED-ON-CHANGE
          signal CAN2_HMI_Function4_LevelDown_Cmd: start 45, 1 bit, big-endian, i-signal-type=PRIMITIVE, init-value=constant-reference=Init_CAN2_HMI_Function4_LevelDown_Cmd, base-type=uint8, implementation-data-type=uint8, transfer-property=TRIGGERED-ON-CHANGE
          signal CAN2_HMI_Function4_LevelUp_Cmd: start 53, 1 bit, big-endian, i-signal-type=PRIMITIVE, init-value=constant-reference=Init_CAN2_HMI_Function4_LevelUp_Cmd, base-type=uint8, implementation-data-type=uint8, transfer-property=TRIGGERED-ON-CHANGE
          signal CAN2_HMI_Function5_LevelDown_Cmd: start 46, 1 bit, big-endian, i-signal-type=PRIMITIVE, init-value=constant-reference=Init_CAN2_HMI_Function5_LevelDown_Cmd, base-type=uint8, implementation-data-type=uint8, transfer-property=TRIGGERED-ON-CHANGE
          signal CAN2_HMI_Function5_LevelUp_Cmd: start 54, 1 bit, big-endian, i-signal-type=PRIMITIVE, init-value=constant-reference=Init_CAN2_HMI_Function5_LevelUp_Cmd, base-type=uint8, implementation-data-type=uint8, transfer-property=TRIGGERED-ON-CHANGE
          signal CAN2_HMI_Function6_LevelDown_Cmd: start 47, 1 bit, big-endian, i-signal-type=PRIMITIVE, init-value=constant-reference=Init_CAN2_HMI_Function6_LevelDown_Cmd, base-type=uint8, implementation-data-type=uint8, transfer-property=TRIGGERED-ON-CHANGE
          signal CAN2_HMI_Function6_LevelUp_Cmd: start 55, 1 bit, big-endian, i-signal-type=PRIMITIVE, init-value=constant-reference=Init_CAN2_HMI_Function6_LevelUp_Cmd, base-type=uint8, implementation-data-type=uint8, transfer-property=TRIGGERED-ON-CHANGE
          signal CAN2_HMI_PSEAT_LevelDown_Cmd: start 32, 1 bit, big-endian, i-signal-type=PRIMITIVE, init-value=constant-reference=Init_CAN2_HMI_PSEAT_LevelDown_Cmd, base-type=uint8, implementation-data-type=uint8, transfer-property=TRIGGERED-ON-CHANGE
          signal CAN2_HMI_PSEAT_LevelUp_Cmd: start 33, 1 bit, big-endian, i-signal-type=PRIMITIVE, init-value=constant-reference=Init_CAN2_HMI_PSEAT_LevelUp_Cmd, base-type=uint8, implementation-data-type=uint8, transfer-property=TRIGGERED-ON-CHANGE
          signal CAN2_HMI_ZLSetTM_Cmd: start 18, 1 bit, big-endian, i-signal-type=PRIMITIVE, init-value=constant-reference=Init_CAN2_HMI_ZLSetTM_Cmd, base-type=uint8, implementation-data-type=uint8, transfer-property=TRIGGERED-ON-CHANGE
          signal CAN2_HMI_ZLSetTP_Cmd: start 19, 1 bit, big-endian, i-signal-type=PRIMITIVE, init-value=constant-reference=Init_CAN2_HMI_ZLSetTP_Cmd, base-type=uint8, implementation-data-type=uint8, transfer-property=TRIGGERED-ON-CHANGE
          signal CAN2_HMI_ZRSetTM_Cmd: start 16, 1 bit, big-endian, i-signal-type=PRIMITIVE, init-value=constant-reference=Init_CAN2_HMI_ZRSetTM_Cmd, base-type=uint8, implementation-data-type=uint8, transfer-property=TRIGGERED-ON-CHANGE
          signal CAN2_HMI_ZRSetTP_Cmd: start 17, 1 bit, big-endian, i-signal-type=PRIMITIVE, init-value=constant-reference=Init_CAN2_HMI_ZRSetTP_Cmd, base-type=uint8, implementation-data-type=uint8, transfer-property=TRIGGERED-ON-CHANGE
