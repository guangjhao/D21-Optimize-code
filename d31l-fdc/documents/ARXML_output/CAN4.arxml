[part 2 of 2: packages /CAN4/ConstantSpecification to /CAN4/ImplementationDataTypes]
AUTOSAR XML (schema 4-3-0)
package /CAN4/ConstantSpecification
  618 x constant specification:
    Init_CAN4_DKC_P_BLE_RSSI: value-spec=0
    Init_CAN4_DKC_P_UID_BatVolt: value-spec=0
    Init_CAN4_DKC_Re_VehData: value-spec=0
    Init_CAN4_DKC_Remote_PW: value-spec=0
    Init_CAN4_P_CommandToBCM: value-spec=0
    Init_CAN4_P_CommandToPTG: value-spec=0
    Init_CAN4_P_DKey_Area_LockUnlock: value-spec=0
    Init_CAN4_P_DKey_Area_PS: value-spec=0
    Init_CAN4_P_DKey_Area_PTG: value-spec=0
    Init_CAN4_P_DKey_Welcome: value-spec=0
    Init_CAN4_P_Dkey_Show_IVI: value-spec=0
    Init_CAN4_P_KeyMiss: value-spec=0
    Init_CAN4_P_KeyMode: value-spec=0
    Init_CAN4_P_UID_LowPower: value-spec=0
    Init_CAN4_SG_DKC1: value-spec=fields=[Init_CAN4_DKC_P_BLE_RSSI, Init_CAN4_DKC_P_UID_BatVolt, Init_CAN4_DKC_Re_VehData, Init_CAN4_DKC_Remote_PW, Init_CAN4_P_CommandToBCM, Init_CAN4_P_CommandToPTG, Init_CAN4_P_DKey_Area_LockUnlock, Init_CAN4_P_DKey_Area_PS, Init_CAN4_P_DKey_Area_PTG, Init_CAN4_P_DKey_Welcome, Init_CAN4_P_Dkey_Show_IVI, Init_CAN4_P_KeyMiss, Init_CAN4_P_KeyMode, Init_CAN4_P_UID_LowPower]
    Init_CAN4_EncryptionDATA_0_63: value-spec=0
    Init_CAN4_EncryptionDATA_64_127: value-spec=0
    Init_CAN4_Random_Number_X: value-spec=0
    Init_CAN4_SG_DKC2: value-spec=fields=[Init_CAN4_EncryptionDATA_0_63, Init_CAN4_EncryptionDATA_64_127, Init_CAN4_Random_Number_X]
    Init_CAN4_FD4_CE100_2_CS: value-spec=0
    Init_CAN4_FD4_CE100_2_RC: value-spec=0
    Init_CAN4_FDC_VCU_ReqHWReset_Cmd: value-spec=0
    Init_CAN4_SG_FD4_CE100_2: value-spec=fields=[Init_CAN4_FD4_CE100_2_CS, Init_CAN4_FD4_CE100_2_RC, Init_CAN4_FDC_VCU_ReqHWReset_Cmd]
    Init_CAN4_Approach_Unlock_SW: value-spec=1
    Init_CAN4_BrkPedalPos: value-spec=0
    Init_CAN4_BrkPedalPos_Sta: value-spec=0
    Init_CAN4_BrkSw_Sta: value-spec=0
    Init_CAN4_BrkSw_V: value-spec=0
    Init_CAN4_DSEAT_anti_set: value-spec=0
    Init_CAN4_DSEAT_entryfun_set: value-spec=0
    Init_CAN4_DSEAT_vent_req: value-spec=0
    Init_CAN4_FDC_BCM_ATCtrl_Cmd: value-spec=0
    Init_CAN4_FDC_BCM_LockAlarm_Cmd: value-spec=0
    Init_CAN4_FDC_BCM_OutMode_Cmd: value-spec=0
    Init_CAN4_FDC_THCM_ACTInitial_Cmd: value-spec=0
    Init_CAN4_HeadLampSW: value-spec=0
    Init_CAN4_Hood_Latch_SW: value-spec=0
    Init_CAN4_IVI_ISA_OffsetSpd: value-spec=0
    Init_CAN4_IVI_Located_STA: value-spec=0
    Init_CAN4_IVI_PTG_Mode_SW: value-spec=0
    Init_CAN4_IVI_PTG_Open_Height: value-spec=0
    Init_CAN4_IVI_PTG_Sta_SW: value-spec=0
    Init_CAN4_IVI_PTG_USSta_SW: value-spec=0
    Init_CAN4_IVI_Time_Check: value-spec=0
    Init_CAN4_IVI_Time_Day: value-spec=0
    Init_CAN4_IVI_Time_Hour: value-spec=0
    Init_CAN4_IVI_Time_Minute: value-spec=0
    Init_CAN4_IVI_Time_Month: value-spec=0
    Init_CAN4_IVI_Time_Second: value-spec=0
    Init_CAN4_IVI_Time_Year: value-spec=0
    Init_CAN4_L_Drv_CtrlCmd: value-spec=127
    Init_CAN4_L_Pas_CtrlCmd: value-spec=127
    Init_CAN4_L_RLD_CtrlCmd: value-spec=127
    Init_CAN4_L_RRD_CtrlCmd: value-spec=127
    Init_CAN4_MCPressure: value-spec=97
    Init_CAN4_MCPressure_V: value-spec=0
    Init_CAN4_OFF_AC_MODE: value-spec=0
    Init_CAN4_PSEAT_vent_req: value-spec=0
    Init_CAN4_PTG_Inner_SW2: value-spec=0
    Init_CAN4_SenstivityPosition: value-spec=0
    Init_CAN4_TurnSwTimeSet: value-spec=0
    Init_CAN4_Walkaway_Lock_SW: value-spec=1
    Init_CAN4_SG_FD_DKC1: value-spec=fields=[Init_CAN4_Approach_Unlock_SW, Init_CAN4_BrkPedalPos, Init_CAN4_BrkPedalPos_Sta, Init_CAN4_BrkSw_Sta, Init_CAN4_BrkSw_V, Init_CAN4_DSEAT_anti_set, Init_CAN4_DSEAT_entryfun_set, Init_CAN4_DSEAT_vent_req, Init_CAN4_FDC_BCM_ATCtrl_Cmd, Init_CAN4_FDC_BCM_LockAlarm_Cmd, Init_CAN4_FDC_BCM_OutMode_Cmd, Init_CAN4_FDC_THCM_ACTInitial_Cmd, Init_CAN4_HeadLampSW, Init_CAN4_Hood_Latch_SW, Init_CAN4_IVI_ISA_OffsetSpd, Init_CAN4_IVI_Located_STA, Init_CAN4_IVI_PTG_Mode_SW, Init_CAN4_IVI_PTG_Open_Height, Init_CAN4_IVI_PTG_Sta_SW, Init_CAN4_IVI_PTG_USSta_SW, Init_CAN4_IVI_Time_Check, Init_CAN4_IVI_Time_Day, Init_CAN4_IVI_Time_Hour, Init_CAN4_IVI_Time_Minute, Init_CAN4_IVI_Time_Month, Init_CAN4_IVI_Time_Second, Init_CAN4_IVI_Time_Year, Init_CAN4_L_Drv_CtrlCmd, Init_CAN4_L_Pas_CtrlCmd, Init_CAN4_L_RLD_CtrlCmd, Init_CAN4_L_RRD_CtrlCmd, Init_CAN4_MCPressure, Init_CAN4_MCPressure_V, Init_CAN4_OFF_AC_MODE, Init_CAN4_PSEAT_vent_req, Init_CAN4_PTG_Inner_SW2, Init_CAN4_SenstivityPosition, Init_CAN4_TurnSwTimeSet, Init_CAN4_Walkaway_Lock_SW]
    Init_CAN4_OTA_DL_Available: value-spec=0
    Init_CAN4_OTA_DL_Speed: value-spec=0
    Init_CAN4_OTA_InVehicle_FW: value-spec=0
    Init_CAN4_OTA_Lock_Req: value-spec=0
    Init_CAN4_OTA_MDA_Status: value-spec=0
    Init_CAN4_OTA_Mode: value-spec=0
    Init_CAN4_OTA_Network_Type: value-spec=0
    Init_CAN4_OTA_Progress_Rate: value-spec=0
    Init_CAN4_OTA_TBOXResetReq: value-spec=0
    Init_CAN4_OTA_Up_Backcount: value-spec=0
    Init_CAN4_OTA_Update_Available: value-spec=0
    Init_CAN4_OTA_Updating_ECU: value-spec=0
    Init_CAN4_SG_FD_OTA1: value-spec=fields=[Init_CAN4_OTA_DL_Available, Init_CAN4_OTA_DL_Speed, Init_CAN4_OTA_InVehicle_FW, Init_CAN4_OTA_Lock_Req, Init_CAN4_OTA_MDA_Status, Init_CAN4_OTA_Mode, Init_CAN4_OTA_Network_Type, Init_CAN4_OTA_Progress_Rate, Init_CAN4_OTA_TBOXResetReq, Init_CAN4_OTA_Up_Backcount, Init_CAN4_OTA_Update_Available, Init_CAN4_OTA_Updating_ECU]
    Init_CAN4_BatteryMode: value-spec=0
    Init_CAN4_CCU_ACLampSts: value-spec=0
    Init_CAN4_CCU_ACMaxLampSts: value-spec=0
    Init_CAN4_CCU_AutoLampSts: value-spec=0
    Init_CAN4_CCU_AutoMidLampSts: value-spec=0
    Init_CAN4_CCU_Dispaly_Request: value-spec=0
    Init_CAN4_CCU_EcoSts: value-spec=0
    Init_CAN4_CCU_FrtOnOffLampSts: value-spec=0
    Init_CAN4_CCU_HEATMaxLampSts: value-spec=0
    Init_CAN4_CCU_RrOnOffLampSts: value-spec=0
    Init_CAN4_CCU_SyncLampSts: value-spec=0
    Init_CAN4_CabinMode: value-spec=0
    Init_CAN4_EDriveMode: value-spec=0
    Init_CAN4_FD_AGS_Cmd: value-spec=0
    Init_CAN4_FD_RecyAuto_Cmd: value-spec=0
    Init_CAN4_Fr_Coolantflow: value-spec=0
    Init_CAN4_Fr_Coolanttemp: value-spec=40
    Init_CAN4_HPThermalRecoveryReq: value-spec=0
    Init_CAN4_Rr_Coolantflow: value-spec=0
    Init_CAN4_Rr_Coolanttemp: value-spec=40
    Init_CAN4_sigAirIntenZon1St: value-spec=0
    Init_CAN4_sigAirIntenZon3St: value-spec=0
    Init_CAN4_sigAmbAirT: value-spec=0
    Init_CAN4_sigCbnAirT: value-spec=0
    Init_CAN4_sigCbnPTCPwrAct: value-spec=0
    Init_CAN4_sigCbnSolarLeft: value-spec=253
    Init_CAN4_sigCbnSolarRight: value-spec=253
    Init_CAN4_sigClmtCmprPwrAct: value-spec=0
    Init_CAN4_sigClntTHvBattOut: value-spec=120
    Init_CAN4_sigDfrstSt: value-spec=0
    Init_CAN4_sigHvacSt: value-spec=0
    Init_CAN4_sigRecircSt: value-spec=0
    Init_CAN4_sigSetTempZon{1..3}St: value-spec=0
    Init_CAN4_sigWindDirZon1St: value-spec=0
    Init_CAN4_sigWindDirZon3St: value-spec=0
    Init_CAN4_SG_FD_THCM1: value-spec=fields=[Init_CAN4_BatteryMode, Init_CAN4_CCU_ACLampSts, Init_CAN4_CCU_ACMaxLampSts, Init_CAN4_CCU_AutoLampSts, Init_CAN4_CCU_AutoMidLampSts, Init_CAN4_CCU_Dispaly_Request, Init_CAN4_CCU_EcoSts, Init_CAN4_CCU_FrtOnOffLampSts, Init_CAN4_CCU_HEATMaxLampSts, Init_CAN4_CCU_RrOnOffLampSts, Init_CAN4_CCU_SyncLampSts, Init_CAN4_CabinMode, Init_CAN4_EDriveMode, Init_CAN4_FD_AGS_Cmd, Init_CAN4_FD_RecyAuto_Cmd, Init_CAN4_Fr_Coolantflow, Init_CAN4_Fr_Coolanttemp, Init_CAN4_HPThermalRecoveryReq, Init_CAN4_Rr_Coolantflow, Init_CAN4_Rr_Coolanttemp, Init_CAN4_sigAirIntenZon1St, Init_CAN4_sigAirIntenZon3St, Init_CAN4_sigAmbAirT, Init_CAN4_sigCbnAirT, Init_CAN4_sigCbnPTCPwrAct, Init_CAN4_sigCbnSolarLeft, Init_CAN4_sigCbnSolarRight, Init_CAN4_sigClmtCmprPwrAct, Init_CAN4_sigClntTHvBattOut, Init_CAN4_sigDfrstSt, Init_CAN4_sigHvacSt, Init_CAN4_sigRecircSt, Init_CAN4_sigSetTempZon1St, Init_CAN4_sigSetTempZon2St, Init_CAN4_sigSetTempZon3St, Init_CAN4_sigWindDirZon1St, Init_CAN4_sigWindDirZon3St]
    Init_CAN4_ACSubMode: value-spec=0
    Init_CAN4_APTC_ActFrRiPwr: value-spec=0
    Init_CAN4_BatLoopActWtFlw: value-spec=0
    Init_CAN4_CCU_CbnPreACWkSts: value-spec=0
    Init_CAN4_CCU_CbnPreEstimdTi: value-spec=0
    Init_CAN4_CCU_CbnPreSts: value-spec=0
    Init_CAN4_CCU_HiVoltageReq: value-spec=0
    Init_CAN4_CoolgFanActDuty: value-spec=0
    Init_CAN4_DeiceModReq: value-spec=0
    Init_CAN4_FD_Blower_Cmd: value-spec=0
    Init_CAN4_FD_Comp_Cmd: value-spec=0
    Init_CAN4_FD_EWP{1..3}_Cmd: value-spec=0
    Init_CAN4_FD_EXV1_Cmd: value-spec=0
    Init_CAN4_FD_EXV2_Cmd: value-spec=0
    Init_CAN4_FD_FWV_Cmd: value-spec=0
    Init_CAN4_FD_FrLeAPTCHeatPwr_Cmd: value-spec=0
    Init_CAN4_FD_FrRiAPTCHeatPwr_Cmd: value-spec=0
    Init_CAN4_FD_FrWPTCHeatPwr_Cmd: value-spec=0
    Init_CAN4_FD_RrAPTCHeatPwr_Cmd: value-spec=0
    Init_CAN4_FD_SOTXV_Cmd: value-spec=0
    Init_CAN4_FD_SOV{1..3}_Cmd: value-spec=0
    Init_CAN4_FD_TWV_Cmd: value-spec=0
    Init_CAN4_SG_FD_THCM2: value-spec=fields=[Init_CAN4_ACSubMode, Init_CAN4_APTC_ActFrRiPwr, Init_CAN4_BatLoopActWtFlw, Init_CAN4_CCU_CbnPreACWkSts, Init_CAN4_CCU_CbnPreEstimdTi, Init_CAN4_CCU_CbnPreSts, Init_CAN4_CCU_HiVoltageReq, Init_CAN4_CoolgFanActDuty, Init_CAN4_DeiceModReq, Init_CAN4_FD_Blower_Cmd, Init_CAN4_FD_Comp_Cmd, Init_CAN4_FD_EWP1_Cmd, Init_CAN4_FD_EWP2_Cmd, Init_CAN4_FD_EWP3_Cmd, Init_CAN4_FD_EXV1_Cmd, Init_CAN4_FD_EXV2_Cmd, Init_CAN4_FD_FWV_Cmd, Init_CAN4_FD_FrLeAPTCHeatPwr_Cmd, Init_CAN4_FD_FrRiAPTCHeatPwr_Cmd, Init_CAN4_FD_FrWPTCHeatPwr_Cmd, Init_CAN4_FD_RrAPTCHeatPwr_Cmd, Init_CAN4_FD_SOTXV_Cmd, Init_CAN4_FD_SOV1_Cmd, Init_CAN4_FD_SOV2_Cmd, Init_CAN4_FD_SOV3_Cmd, Init_CAN4_FD_TWV_Cmd]
    Init_CAN4_AllDoorSW: value-spec=0
    Init_CAN4_AmbLightBreath{1..3}: value-spec=0
    Init_CAN4_AmbLightBrightness{1..3}: value-spec=0
    Init_CAN4_AmbLightColor{1..3}: value-spec=0
    Init_CAN4_AntiTheftSeatFold: value-spec=0
    Init_CAN4_AntitheftSta: value-spec=0
    Init_CAN4_BCM_Buzzer_Req: value-spec=0
    Init_CAN4_BCM_DoorLock_Sta: value-spec=0
    Init_CAN4_BrakeLamp: value-spec=0
    Init_CAN4_CC_Crl_Sta: value-spec=0
    Init_CAN4_CS_VCU1_CAN4: value-spec=0
    Init_CAN4_CTDCtrl: value-spec=0
    Init_CAN4_CTDLockSW: value-spec=0
    Init_CAN4_CTDUnlockSW: value-spec=0
    Init_CAN4_CrashDetd: value-spec=0
    Init_CAN4_CtrlDrPwrStbA2: value-spec=0
    Init_CAN4_CtrlFrBMSCCUCIR: value-spec=0
    Init_CAN4_CtrlFrEDUINVERTER: value-spec=0
    Init_CAN4_CtrlFrIRC1: value-spec=0
    Init_CAN4_CtrlFrPwrStbA1P: value-spec=0
    Init_CAN4_DKCAuthSta: value-spec=0
    Init_CAN4_DKCTimeSN: value-spec=0
    Init_CAN4_Dimmer: value-spec=0
    Init_CAN4_DimmerEN: value-spec=0
    Init_CAN4_DoorLockIND: value-spec=0
    Init_CAN4_DrDoorSW: value-spec=0
    Init_CAN4_Dr_SeatSta: value-spec=0
    Init_CAN4_EquivAccPedalSWSta: value-spec=0
    Init_CAN4_FD_DKC_VehData_Err: value-spec=0
    Init_CAN4_FD_DKC_VehData_Sta: value-spec=0
    Init_CAN4_FD_TBOX_DTCData_Err: value-spec=0
    Init_CAN4_FD_TBOX_DTCData_Sta: value-spec=0
    Init_CAN4_FD_TBOX_VehData_Err: value-spec=0
    Init_CAN4_FD_TBOX_VehData_Sta: value-spec=0
    Init_CAN4_Fr_ChargingDoorCtrl: value-spec=0
    Init_CAN4_Fr_FogLamp: value-spec=0
    Init_CAN4_Fr_Wiper_H: value-spec=0
    Init_CAN4_Fr_Wiper_L: value-spec=0
    Init_CAN4_HWResetSta: value-spec=0
    Init_CAN4_H_Beam: value-spec=0
    Init_CAN4_HazardSW: value-spec=0
    Init_CAN4_HoodSW: value-spec=0
    Init_CAN4_HornCtrl: value-spec=0
    Init_CAN4_LBSD: value-spec=0
    Init_CAN4_LDRL: value-spec=0
    Init_CAN4_LTurnLP: value-spec=0
    Init_CAN4_L_APM_WdwEnable: value-spec=0
    Init_CAN4_L_Beam: value-spec=0
    Init_CAN4_LampPwr: value-spec=0
    Init_CAN4_LockSetting: value-spec=0
    Init_CAN4_MSA_Crl_Sta: value-spec=0
    Init_CAN4_MirrorCtrl: value-spec=0
    Init_CAN4_MirrorDefog: value-spec=0
    Init_CAN4_PosLamp: value-spec=0
    Init_CAN4_PsDoorSW: value-spec=0
    Init_CAN4_PwrSta: value-spec=0
    Init_CAN4_RBSD: value-spec=0
    Init_CAN4_RC_VCU1_CAN4: value-spec=0
    Init_CAN4_RDRL: value-spec=0
    Init_CAN4_RLDoorSW: value-spec=0
    Init_CAN4_RRDoorSW: value-spec=0
    Init_CAN4_RTurnLP: value-spec=0
    Init_CAN4_ReBrakeLPReq: value-spec=0
    Init_CAN4_ReverseLamp: value-spec=0
    Init_CAN4_RoomLampH: value-spec=0
    Init_CAN4_RoomLampL: value-spec=0
    Init_CAN4_Rr_ChargingDoorCtrl: value-spec=0
    Init_CAN4_Rr_Defog: value-spec=0
    Init_CAN4_Rr_FogLamp: value-spec=0
    Init_CAN4_Rr_Wiper: value-spec=0
    Init_CAN4_ShiftGearPosn: value-spec=0
    Init_CAN4_TailgateHDSW: value-spec=0
    Init_CAN4_TailgateRemote: value-spec=0
    Init_CAN4_Tailgate_SW: value-spec=0
    Init_CAN4_TimeSNDKCFbk: value-spec=0
    Init_CAN4_TrunkRel: value-spec=0
    Init_CAN4_VehSpeed: value-spec=0
    Init_CAN4_WasherCtrl: value-spec=0
    Init_CAN4_WiperFixMode: value-spec=0
    Init_CAN4_SG_FD_VCU1: value-spec=fields=[Init_CAN4_AllDoorSW, Init_CAN4_AmbLightBreath1, Init_CAN4_AmbLightBreath2, Init_CAN4_AmbLightBreath3, Init_CAN4_AmbLightBrightness1, Init_CAN4_AmbLightBrightness2, Init_CAN4_AmbLightBrightness3, Init_CAN4_AmbLightColor1, Init_CAN4_AmbLightColor2, Init_CAN4_AmbLightColor3, Init_CAN4_AntiTheftSeatFold, Init_CAN4_AntitheftSta, Init_CAN4_BCM_Buzzer_Req, Init_CAN4_BCM_DoorLock_Sta, Init_CAN4_BrakeLamp, Init_CAN4_CC_Crl_Sta, Init_CAN4_CS_VCU1_CAN4, Init_CAN4_CTDCtrl, Init_CAN4_CTDLockSW, Init_CAN4_CTDUnlockSW, Init_CAN4_CrashDetd, Init_CAN4_CtrlDrPwrStbA2, Init_CAN4_CtrlFrBMSCCUCIR, Init_CAN4_CtrlFrEDUINVERTER, Init_CAN4_CtrlFrIRC1, Init_CAN4_CtrlFrPwrStbA1P, Init_CAN4_DKCAuthSta, Init_CAN4_DKCTimeSN, Init_CAN4_Dimmer, Init_CAN4_DimmerEN, Init_CAN4_DoorLockIND, Init_CAN4_DrDoorSW, Init_CAN4_Dr_SeatSta, Init_CAN4_EquivAccPedalSWSta, Init_CAN4_FD_DKC_VehData_Err, Init_CAN4_FD_DKC_VehData_Sta, Init_CAN4_FD_TBOX_DTCData_Err, Init_CAN4_FD_TBOX_DTCData_Sta, Init_CAN4_FD_TBOX_VehData_Err, Init_CAN4_FD_TBOX_VehData_Sta, Init_CAN4_Fr_ChargingDoorCtrl, Init_CAN4_Fr_FogLamp, Init_CAN4_Fr_Wiper_H, Init_CAN4_Fr_Wiper_L, Init_CAN4_HWResetSta, Init_CAN4_H_Beam, Init_CAN4_HazardSW, Init_CAN4_HoodSW, Init_CAN4_HornCtrl, Init_CAN4_LBSD, Init_CAN4_LDRL, Init_CAN4_LTurnLP, Init_CAN4_L_APM_WdwEnable, Init_CAN4_L_Beam, Init_CAN4_LampPwr, Init_CAN4_LockSetting, Init_CAN4_MSA_Crl_Sta, Init_CAN4_MirrorCtrl, Init_CAN4_MirrorDefog, Init_CAN4_PosLamp, Init_CAN4_PsDoorSW, Init_CAN4_PwrSta, Init_CAN4_RBSD, Init_CAN4_RC_VCU1_CAN4, Init_CAN4_RDRL, Init_CAN4_RLDoorSW, Init_CAN4_RRDoorSW, Init_CAN4_RTurnLP, Init_CAN4_ReBrakeLPReq, Init_CAN4_ReverseLamp, Init_CAN4_RoomLampH, Init_CAN4_RoomLampL, Init_CAN4_Rr_ChargingDoorCtrl, Init_CAN4_Rr_Defog, Init_CAN4_Rr_FogLamp, Init_CAN4_Rr_Wiper, Init_CAN4_ShiftGearPosn, Init_CAN4_TailgateHDSW, Init_CAN4_TailgateRemote, Init_CAN4_Tailgate_SW, Init_CAN4_TimeSNDKCFbk, Init_CAN4_TrunkRel, Init_CAN4_VehSpeed, Init_CAN4_WasherCtrl, Init_CAN4_WiperFixMode]
    Init_CAN4_PTG_Active_Sta: value-spec=0
    Init_CAN4_PTG_AutoStaus: value-spec=0
    Init_CAN4_PTG_Cinch_Current: value-spec=0
    Init_CAN4_PTG_Exist: value-spec=0
    Init_CAN4_PTG_Full_Lock: value-spec=0
    Init_CAN4_PTG_HW_Ver: value-spec=0
    Init_CAN4_PTG_Half_Lock: value-spec=0
    Init_CAN4_PTG_Inner_SW_1: value-spec=0
    Init_CAN4_PTG_Is_Set_Height: value-spec=0
    Init_CAN4_PTG_Open_Ratio: value-spec=0
    Init_CAN4_PTG_RDIL_Sta: value-spec=0
    Init_CAN4_PTG_SW_Ver: value-spec=0
    Init_CAN4_PTG_Strut_Current: value-spec=0
    Init_CAN4_PTG_Sys_Sta: value-spec=0
    Init_CAN4_PTG_Warning_Sta: value-spec=0
    Init_CAN4_SG_GW_ZDR_PTG1: value-spec=fields=[Init_CAN4_PTG_Active_Sta, Init_CAN4_PTG_AutoStaus, Init_CAN4_PTG_Cinch_Current, Init_CAN4_PTG_Exist, Init_CAN4_PTG_Full_Lock, Init_CAN4_PTG_HW_Ver, Init_CAN4_PTG_Half_Lock, Init_CAN4_PTG_Inner_SW_1, Init_CAN4_PTG_Is_Set_Height, Init_CAN4_PTG_Open_Ratio, Init_CAN4_PTG_RDIL_Sta, Init_CAN4_PTG_SW_Ver, Init_CAN4_PTG_Strut_Current, Init_CAN4_PTG_Sys_Sta, Init_CAN4_PTG_Warning_Sta]
    Init_CAN4_AllLockSta: value-spec=0
    Init_CAN4_AutoLightSW: value-spec=0
    Init_CAN4_BrakeLampFail: value-spec=0
    Init_CAN4_CSW_DimSw: value-spec=0
    Init_CAN4_CSW_FWasSw_Sta: value-spec=0
    Init_CAN4_CSW_FWipSw_Sta: value-spec=0
    Init_CAN4_CSW_HW_version: value-spec=0
    Init_CAN4_CSW_PassSW_Sta: value-spec=0
    Init_CAN4_CSW_RWasSW_Sta: value-spec=0
    Init_CAN4_CSW_RWipIntSw_Sta: value-spec=0
    Init_CAN4_CSW_SW_version: value-spec=0
    Init_CAN4_CSW_TurnSw_Sta: value-spec=0
    Init_CAN4_CSW_resp_error: value-spec=0
    Init_CAN4_DrLockSta: value-spec=0
    Init_CAN4_HornSW: value-spec=0
    Init_CAN4_MIRROR_FOLD_SW: value-spec=0
    Init_CAN4_PsLockSta: value-spec=0
    Init_CAN4_RLLockSta: value-spec=0
    Init_CAN4_RLS_Exist: value-spec=0
    Init_CAN4_RLS_LIN_Resp_Err: value-spec=0
    Init_CAN4_RLS_Lamp_Sta: value-spec=0
    Init_CAN4_RLS_LightSnrErr: value-spec=0
    Init_CAN4_RLS_RainSnrErr: value-spec=0
    Init_CAN4_RLS_RainSnrWiperCmd: value-spec=0
    Init_CAN4_RLTurnLampC: value-spec=0
    Init_CAN4_RRLockSta: value-spec=0
    Init_CAN4_RRTurnLampC: value-spec=0
    Init_CAN4_RWiperAS: value-spec=0
    Init_CAN4_RWiperProtection: value-spec=0
    Init_CAN4_Wip_Speed: value-spec=0
    Init_CAN4_WiperSWPos: value-spec=0
    Init_CAN4_WiperZeroPosSW: value-spec=0
    Init_CAN4_SG_GW_ZoneDR1: value-spec=fields=[Init_CAN4_AllLockSta, Init_CAN4_AutoLightSW, Init_CAN4_BrakeLampFail, Init_CAN4_CSW_DimSw, Init_CAN4_CSW_FWasSw_Sta, Init_CAN4_CSW_FWipSw_Sta, Init_CAN4_CSW_HW_version, Init_CAN4_CSW_PassSW_Sta, Init_CAN4_CSW_RWasSW_Sta, Init_CAN4_CSW_RWipIntSw_Sta, Init_CAN4_CSW_SW_version, Init_CAN4_CSW_TurnSw_Sta, Init_CAN4_CSW_resp_error, Init_CAN4_DrLockSta, Init_CAN4_HornSW, Init_CAN4_MIRROR_FOLD_SW, Init_CAN4_PsLockSta, Init_CAN4_RLLockSta, Init_CAN4_RLS_Exist, Init_CAN4_RLS_LIN_Resp_Err, Init_CAN4_RLS_Lamp_Sta, Init_CAN4_RLS_LightSnrErr, Init_CAN4_RLS_RainSnrErr, Init_CAN4_RLS_RainSnrWiperCmd, Init_CAN4_RLTurnLampC, Init_CAN4_RRLockSta, Init_CAN4_RRTurnLampC, Init_CAN4_RWiperAS, Init_CAN4_RWiperProtection, Init_CAN4_Wip_Speed, Init_CAN4_WiperSWPos, Init_CAN4_WiperZeroPosSW]
    Init_CAN4_SWC_ACC_Sta: value-spec=0
    Init_CAN4_SWC_A_HW_version: value-spec=0
    Init_CAN4_SWC_A_Resp_Err: value-spec=0
    Init_CAN4_SWC_A_SW_version: value-spec=0
    Init_CAN4_SWC_CANCEL_Sta: value-spec=0
    Init_CAN4_SWC_Distance_Sta: value-spec=0
    Init_CAN4_SWC_Down_Sta: value-spec=0
    Init_CAN4_SWC_Drivemode_Sta: value-spec=0
    Init_CAN4_SWC_LKA_Sta: value-spec=0
    Init_CAN4_SWC_Left_Sta: value-spec=0
    Init_CAN4_SWC_RegenDown: value-spec=0
    Init_CAN4_SWC_RegenUp: value-spec=0
    Init_CAN4_SWC_Res_Up_Sta: value-spec=0
    Init_CAN4_SWC_Right_Sta: value-spec=0
    Init_CAN4_SWC_Set_down_Sta: value-spec=0
    Init_CAN4_SWC_Trip_Sta: value-spec=0
    Init_CAN4_SWC_Undefined_Sta: value-spec=0
    Init_CAN4_SWC_Up_Sta: value-spec=0
    Init_CAN4_SWC_VR_Sta: value-spec=0
    Init_CAN4_SWC_mode_Sta: value-spec=0
    Init_CAN4_SWC_resp_error: value-spec=0
    Init_CAN4_SG_GW_ZoneDR2: value-spec=fields=[Init_CAN4_SWC_ACC_Sta, Init_CAN4_SWC_A_HW_version, Init_CAN4_SWC_A_Resp_Err, Init_CAN4_SWC_A_SW_version, Init_CAN4_SWC_CANCEL_Sta, Init_CAN4_SWC_Distance_Sta, Init_CAN4_SWC_Down_Sta, Init_CAN4_SWC_Drivemode_Sta, Init_CAN4_SWC_LKA_Sta, Init_CAN4_SWC_Left_Sta, Init_CAN4_SWC_RegenDown, Init_CAN4_SWC_RegenUp, Init_CAN4_SWC_Res_Up_Sta, Init_CAN4_SWC_Right_Sta, Init_CAN4_SWC_Set_down_Sta, Init_CAN4_SWC_Trip_Sta, Init_CAN4_SWC_Undefined_Sta, Init_CAN4_SWC_Up_Sta, Init_CAN4_SWC_VR_Sta, Init_CAN4_SWC_mode_Sta, Init_CAN4_SWC_resp_error]
    Init_CAN4_FAPWL_01_LIN_Response_Error: value-spec=0
    Init_CAN4_L_APM_IntellectClose: value-spec=0
    Init_CAN4_L_Drv_Motor_Relay_Error: value-spec=0
    Init_CAN4_L_Drv_Motor_Ripple_Error: value-spec=0
    Init_CAN4_L_Drv_OverHeat_Protect: value-spec=0
    Init_CAN4_L_Drv_Val_Wdw_Opened: value-spec=0
    Init_CAN4_L_Drv_Wdw_Init: value-spec=0
    Init_CAN4_L_Drv_Wdw_LocalSwitch: value-spec=0
    Init_CAN4_L_Drv_Wdw_OD_Sts: value-spec=0
    Init_CAN4_L_Drv_Wdw_Obs_InhibitSts: value-spec=0
    Init_CAN4_L_Drv_Wdw_Pas_Switch: value-spec=0
    Init_CAN4_L_Drv_Wdw_PositionSts: value-spec=0
    Init_CAN4_L_Drv_Wdw_RLD_Switch: value-spec=0
    Init_CAN4_L_Drv_Wdw_RRD_Switch: value-spec=0
    Init_CAN4_L_Drv_Wdw_Running_Sts: value-spec=0
    Init_CAN4_L_Pas_Motor_Relay_Error: value-spec=0
    Init_CAN4_L_Pas_Motor_Ripple_Error: value-spec=0
    Init_CAN4_L_Pas_OverHeat_Protect: value-spec=0
    Init_CAN4_L_Pas_Val_Wdw_Opened: value-spec=0
    Init_CAN4_L_Pas_Wdw_Init: value-spec=0
    Init_CAN4_L_Pas_Wdw_LocalSwitch: value-spec=0
    Init_CAN4_L_Pas_Wdw_OD_Sts: value-spec=0
    Init_CAN4_L_Pas_Wdw_Obs_InhibitSts: value-spec=0
    Init_CAN4_L_Pas_Wdw_PositionSts: value-spec=0
    Init_CAN4_L_Pas_Wdw_Running_Sts: value-spec=0
    Init_CAN4_L_Power_Status: value-spec=0
    Init_CAN4_SG_GW_ZoneDR3: value-spec=fields=[Init_CAN4_FAPWL_01_LIN_Response_Error, Init_CAN4_L_APM_IntellectClose, Init_CAN4_L_Drv_Motor_Relay_Error, Init_CAN4_L_Drv_Motor_Ripple_Error, Init_CAN4_L_Drv_OverHeat_Protect, Init_CAN4_L_Drv_Val_Wdw_Opened, Init_CAN4_L_Drv_Wdw_Init, Init_CAN4_L_Drv_Wdw_LocalSwitch, Init_CAN4_L_Drv_Wdw_OD_Sts, Init_CAN4_L_Drv_Wdw_Obs_InhibitSts, Init_CAN4_L_Drv_Wdw_Pas_Switch, Init_CAN4_L_Drv_Wdw_PositionSts, Init_CAN4_L_Drv_Wdw_RLD_Switch, Init_CAN4_L_Drv_Wdw_RRD_Switch, Init_CAN4_L_Drv_Wdw_Running_Sts, Init_CAN4_L_Pas_Motor_Relay_Error, Init_CAN4_L_Pas_Motor_Ripple_Error, Init_CAN4_L_Pas_OverHeat_Protect, Init_CAN4_L_Pas_Val_Wdw_Opened, Init_CAN4_L_Pas_Wdw_Init, Init_CAN4_L_Pas_Wdw_LocalSwitch, Init_CAN4_L_Pas_Wdw_OD_Sts, Init_CAN4_L_Pas_Wdw_Obs_InhibitSts, Init_CAN4_L_Pas_Wdw_PositionSts, Init_CAN4_L_Pas_Wdw_Running_Sts, Init_CAN4_L_Power_Status]
    Init_CAN4_L_RLD_Motor_Relay_Error: value-spec=0
    Init_CAN4_L_RLD_Motor_Ripple_Error: value-spec=0
    Init_CAN4_L_RLD_OverHeat_Protect: value-spec=0
    Init_CAN4_L_RLD_Val_Wdw_Opened: value-spec=0
    Init_CAN4_L_RLD_Wdw_Init: value-spec=0
    Init_CAN4_L_RLD_Wdw_LocalSwitch: value-spec=0
    Init_CAN4_L_RLD_Wdw_OD_Sts: value-spec=0
    Init_CAN4_L_RLD_Wdw_Obs_InhibitSts: value-spec=0
    Init_CAN4_L_RLD_Wdw_PositionSts: value-spec=0
    Init_CAN4_L_RLD_Wdw_Running_Sts: value-spec=0
    Init_CAN4_L_RRD_Motor_Relay_Error: value-spec=0
    Init_CAN4_L_RRD_Motor_Ripple_Error: value-spec=0
    Init_CAN4_L_RRD_OverHeat_Protect: value-spec=0
    Init_CAN4_L_RRD_Val_Wdw_Opened: value-spec=0
    Init_CAN4_L_RRD_Wdw_Init: value-spec=0
    Init_CAN4_L_RRD_Wdw_LocalSwitch: value-spec=0
    Init_CAN4_L_RRD_Wdw_OD_Sts: value-spec=0
    Init_CAN4_L_RRD_Wdw_Obs_InhibitSts: value-spec=0
    Init_CAN4_L_RRD_Wdw_PositionSts: value-spec=0
    Init_CAN4_L_RRD_Wdw_Running_Sts: value-spec=0
    Init_CAN4_PTG_Inner_SW_2: value-spec=0
    Init_CAN4_RAPWL_01_LIN_Response_Error: value-spec=0
    Init_CAN4_SG_GW_ZoneDR4: value-spec=fields=[Init_CAN4_L_RLD_Motor_Relay_Error, Init_CAN4_L_RLD_Motor_Ripple_Error, Init_CAN4_L_RLD_OverHeat_Protect, Init_CAN4_L_RLD_Val_Wdw_Opened, Init_CAN4_L_RLD_Wdw_Init, Init_CAN4_L_RLD_Wdw_LocalSwitch, Init_CAN4_L_RLD_Wdw_OD_Sts, Init_CAN4_L_RLD_Wdw_Obs_InhibitSts, Init_CAN4_L_RLD_Wdw_PositionSts, Init_CAN4_L_RLD_Wdw_Running_Sts, Init_CAN4_L_RRD_Motor_Relay_Error, Init_CAN4_L_RRD_Motor_Ripple_Error, Init_CAN4_L_RRD_OverHeat_Protect, Init_CAN4_L_RRD_Val_Wdw_Opened, Init_CAN4_L_RRD_Wdw_Init, Init_CAN4_L_RRD_Wdw_LocalSwitch, Init_CAN4_L_RRD_Wdw_OD_Sts, Init_CAN4_L_RRD_Wdw_Obs_InhibitSts, Init_CAN4_L_RRD_Wdw_PositionSts, Init_CAN4_L_RRD_Wdw_Running_Sts, Init_CAN4_PTG_Inner_SW_2, Init_CAN4_RAPWL_01_LIN_Response_Error]
    Init_CAN4_FrntPTCBusLineHiV: value-spec=0
    Init_CAN4_FrntPTCComFlt: value-spec=0
    Init_CAN4_FrntPTCFltSt: value-spec=0
    Init_CAN4_FrntPTCHVOverUFlt: value-spec=0
    Init_CAN4_FrntPTCHVUnderUFlt: value-spec=0
    Init_CAN4_FrntPTCHWVers: value-spec=0
    Init_CAN4_FrntPTCLVOverUFlt: value-spec=0
    Init_CAN4_FrntPTCLVUnderUFlt: value-spec=0
    Init_CAN4_FrntPTCLeActHeatPwr: value-spec=255
    Init_CAN4_FrntPTCLeBusLineC: value-spec=0
    Init_CAN4_FrntPTCLeCoreOverTFlt: value-spec=0
    Init_CAN4_FrntPTCLeCoreT: value-spec=255
    Init_CAN4_FrntPTCLeCoreTSnsrFlt: value-spec=0
    Init_CAN4_FrntPTCLeIGBTOverTFlt: value-spec=0
    Init_CAN4_FrntPTCLeIGBTShoCircFlt: value-spec=0
    Init_CAN4_FrntPTCLeIGBTT: value-spec=255
    Init_CAN4_FrntPTCLeIGBTTSnsrFlt: value-spec=0
    Init_CAN4_FrntPTCLeOpentCircFlt: value-spec=0
    Init_CAN4_FrntPTCLeOverAFlt: value-spec=0
    Init_CAN4_FrntPTCPCBOverTFlt: value-spec=0
    Init_CAN4_FrntPTCPCBT: value-spec=255
    Init_CAN4_FrntPTCPCBTSnsrFlt: value-spec=0
    Init_CAN4_FrntPTCRearLeActHeatPwr: value-spec=0
    Init_CAN4_FrntPTCRearLeBusLineC: value-spec=0
    Init_CAN4_FrntPTCRearLeCoreOverTFlt: value-spec=0
    Init_CAN4_FrntPTCRearLeCoreT: value-spec=0
    Init_CAN4_FrntPTCRearLeCoreTSnsrFlt: value-spec=0
    Init_CAN4_FrntPTCRearLeIGBTShoCFlt: value-spec=0
    Init_CAN4_FrntPTCRearLeOpentCircFlt: value-spec=0
    Init_CAN4_FrntPTCRearLeOverAFlt: value-spec=0
    Init_CAN4_FrntPTCRearRiActHeatPwr: value-spec=0
    Init_CAN4_FrntPTCRearRiBusLineC: value-spec=0
    Init_CAN4_FrntPTCRearRiCoreOverTFlt: value-spec=0
    Init_CAN4_FrntPTCRearRiCoreT: value-spec=0
    Init_CAN4_FrntPTCRearRiCoreTSnsrFlt: value-spec=0
    Init_CAN4_FrntPTCRearRiIGBTShoCFlt: value-spec=0
    Init_CAN4_FrntPTCRearRiOpentCircFlt: value-spec=0
    Init_CAN4_FrntPTCRearRiOverAFlt: value-spec=0
    Init_CAN4_FrntPTCRiActHeatPwr: value-spec=255
    Init_CAN4_FrntPTCRiBusLineC: value-spec=0
    Init_CAN4_FrntPTCRiCoreOverTFlt: value-spec=0
    Init_CAN4_FrntPTCRiCoreT: value-spec=255
    Init_CAN4_FrntPTCRiCoreTSnsrFlt: value-spec=0
    Init_CAN4_FrntPTCRiIGBTOverTFlt: value-spec=0
    Init_CAN4_FrntPTCRiIGBTShoCircFlt: value-spec=0
    Init_CAN4_FrntPTCRiIGBTT: value-spec=255
    Init_CAN4_FrntPTCRiIGBTTSnsrFlt: value-spec=0
    Init_CAN4_FrntPTCRiOpentCircFlt: value-spec=0
    Init_CAN4_FrntPTCRiOverAFlt: value-spec=0
    Init_CAN4_FrntPTCSWVers: value-spec=0
    Init_CAN4_FrntPTCSts: value-spec=0
    Init_CAN4_FrntPTCSupplierCod: value-spec=0
    Init_CAN4_SG_GW_ZoneDR6: value-spec=fields=[Init_CAN4_FrntPTCBusLineHiV, Init_CAN4_FrntPTCComFlt, Init_CAN4_FrntPTCFltSt, Init_CAN4_FrntPTCHVOverUFlt, Init_CAN4_FrntPTCHVUnderUFlt, Init_CAN4_FrntPTCHWVers, Init_CAN4_FrntPTCLVOverUFlt, Init_CAN4_FrntPTCLVUnderUFlt, Init_CAN4_FrntPTCLeActHeatPwr, Init_CAN4_FrntPTCLeBusLineC, Init_CAN4_FrntPTCLeCoreOverTFlt, Init_CAN4_FrntPTCLeCoreT, Init_CAN4_FrntPTCLeCoreTSnsrFlt, Init_CAN4_FrntPTCLeIGBTOverTFlt, Init_CAN4_FrntPTCLeIGBTShoCircFlt, Init_CAN4_FrntPTCLeIGBTT, Init_CAN4_FrntPTCLeIGBTTSnsrFlt, Init_CAN4_FrntPTCLeOpentCircFlt, Init_CAN4_FrntPTCLeOverAFlt, Init_CAN4_FrntPTCPCBOverTFlt, Init_CAN4_FrntPTCPCBT, Init_CAN4_FrntPTCPCBTSnsrFlt, Init_CAN4_FrntPTCRearLeActHeatPwr, Init_CAN4_FrntPTCRearLeBusLineC, Init_CAN4_FrntPTCRearLeCoreOverTFlt, Init_CAN4_FrntPTCRearLeCoreT, Init_CAN4_FrntPTCRearLeCoreTSnsrFlt, Init_CAN4_FrntPTCRearLeIGBTShoCFlt, Init_CAN4_FrntPTCRearLeOpentCircFlt, Init_CAN4_FrntPTCRearLeOverAFlt, Init_CAN4_FrntPTCRearRiActHeatPwr, Init_CAN4_FrntPTCRearRiBusLineC, Init_CAN4_FrntPTCRearRiCoreOverTFlt, Init_CAN4_FrntPTCRearRiCoreT, Init_CAN4_FrntPTCRearRiCoreTSnsrFlt, Init_CAN4_FrntPTCRearRiIGBTShoCFlt, Init_CAN4_FrntPTCRearRiOpentCircFlt, Init_CAN4_FrntPTCRearRiOverAFlt, Init_CAN4_FrntPTCRiActHeatPwr, Init_CAN4_FrntPTCRiBusLineC, Init_CAN4_FrntPTCRiCoreOverTFlt, Init_CAN4_FrntPTCRiCoreT, Init_CAN4_FrntPTCRiCoreTSnsrFlt, Init_CAN4_FrntPTCRiIGBTOverTFlt, Init_CAN4_FrntPTCRiIGBTShoCircFlt, Init_CAN4_FrntPTCRiIGBTT, Init_CAN4_FrntPTCRiIGBTTSnsrFlt, Init_CAN4_FrntPTCRiOpentCircFlt, Init_CAN4_FrntPTCRiOverAFlt, Init_CAN4_FrntPTCSWVers, Init_CAN4_FrntPTCSts, Init_CAN4_FrntPTCSupplierCod]
    Init_CAN4_AGS_Actual_Position: value-spec=127
    Init_CAN4_AGS_Actuator_Blocked: value-spec=0
    Init_CAN4_AGS_Actuator_Fault: value-spec=0
    Init_CAN4_AGS_Calibration_Active: value-spec=0
    Init_CAN4_AGS_Calibration_Enabled: value-spec=0
    Init_CAN4_AGS_Calibration_Indicated: value-spec=0
    Init_CAN4_AGS_Electrical_Error: value-spec=0
    Init_CAN4_AGS_LINResponse_Error: value-spec=0
    Init_CAN4_AGS_Low_Voltage_Error: value-spec=0
    Init_CAN4_AGS_Position_Request: value-spec=0
    Init_CAN4_AGS_Sensor_Error: value-spec=0
    Init_CAN4_AGS_Temperature_Error: value-spec=0
    Init_CAN4_BDC_1_MoveEnable: value-spec=0
    Init_CAN4_BDC_1_ReqMovePos: value-spec=0
    Init_CAN4_CCV4_MoveEnable: value-spec=0
    Init_CAN4_CCV4_ReqMovePos: value-spec=0
    Init_CAN4_ChargeInletLockSta: value-spec=0
    Init_CAN4_EWP1_Default_Operation_EWP_Rq: value-spec=0
    Init_CAN4_EWP1_RPM_Target_EWP_Rq: value-spec=0
    Init_CAN4_EWP2_Default_Operation_EWP_Rq: value-spec=0
    Init_CAN4_EWP2_RPM_Target_EWP_Rq: value-spec=0
    Init_CAN4_EWP3_Default_Operation_EWP_Rq: value-spec=0
    Init_CAN4_EWP3_RPM_Target_EWP_Rq: value-spec=0
    Init_CAN4_EXV2_Cmd_Init_Rq: value-spec=0
    Init_CAN4_EXV2_Cmd_Move_Enbl: value-spec=0
    Init_CAN4_EXV2_Cmd_Set_Rq: value-spec=0
    Init_CAN4_EXV_Cmd_Init_Rq: value-spec=0
    Init_CAN4_EXV_Cmd_Move_Enbl: value-spec=0
    Init_CAN4_EXV_Cmd_Set_Rq: value-spec=0
    Init_CAN4_FLTurnLampC: value-spec=0
    Init_CAN4_FRTurnLampC: value-spec=0
    Init_CAN4_FWiperAS: value-spec=0
    Init_CAN4_FWiperProtection: value-spec=0
    Init_CAN4_SG_GW_ZoneFR1: value-spec=fields=[Init_CAN4_AGS_Actual_Position, Init_CAN4_AGS_Actuator_Blocked, Init_CAN4_AGS_Actuator_Fault, Init_CAN4_AGS_Calibration_Active, Init_CAN4_AGS_Calibration_Enabled, Init_CAN4_AGS_Calibration_Indicated, Init_CAN4_AGS_Electrical_Error, Init_CAN4_AGS_LINResponse_Error, Init_CAN4_AGS_Low_Voltage_Error, Init_CAN4_AGS_Position_Request, Init_CAN4_AGS_Sensor_Error, Init_CAN4_AGS_Temperature_Error, Init_CAN4_BDC_1_MoveEnable, Init_CAN4_BDC_1_ReqMovePos, Init_CAN4_CCV4_MoveEnable, Init_CAN4_CCV4_ReqMovePos, Init_CAN4_ChargeInletLockSta, Init_CAN4_EWP1_Default_Operation_EWP_Rq, Init_CAN4_EWP1_RPM_Target_EWP_Rq, Init_CAN4_EWP2_Default_Operation_EWP_Rq, Init_CAN4_EWP2_RPM_Target_EWP_Rq, Init_CAN4_EWP3_Default_Operation_EWP_Rq, Init_CAN4_EWP3_RPM_Target_EWP_Rq, Init_CAN4_EXV2_Cmd_Init_Rq, Init_CAN4_EXV2_Cmd_Move_Enbl, Init_CAN4_EXV2_Cmd_Set_Rq, Init_CAN4_EXV_Cmd_Init_Rq, Init_CAN4_EXV_Cmd_Move_Enbl, Init_CAN4_EXV_Cmd_Set_Rq, Init_CAN4_FLTurnLampC, Init_CAN4_FRTurnLampC, Init_CAN4_FWiperAS, Init_CAN4_FWiperProtection]
    Init_CAN4_BMSPackVol_h6HSC6: value-spec=4095
    Init_CAN4_CCM_SpdCmd: value-spec=0
    Init_CAN4_COMP_ComLost: value-spec=0
    Init_CAN4_COMP_ConCur: value-spec=0
    Init_CAN4_COMP_ConVolt: value-spec=0
    Init_CAN4_COMP_CtrlCircFlt: value-spec=0
    Init_CAN4_COMP_CurOverProtect: value-spec=0
    Init_CAN4_COMP_CurVaild: value-spec=0
    Init_CAN4_COMP_IPM_HWFLt: value-spec=0
    Init_CAN4_COMP_IPM_TempOverFlt: value-spec=0
    Init_CAN4_COMP_Init: value-spec=0
    Init_CAN4_COMP_SpdVaild: value-spec=0
    Init_CAN4_COMP_Sta: value-spec=0
    Init_CAN4_COMP_StatorSpd: value-spec=0
    Init_CAN4_COMP_VoltLessErr: value-spec=0
    Init_CAN4_COMP_VoltOverErr: value-spec=0
    Init_CAN4_COMP_VoltVaild: value-spec=0
    Init_CAN4_CompProEN: value-spec=0
    Init_CAN4_EAC_DrvVoltFalt: value-spec=0
    Init_CAN4_EAC_MotCrt: value-spec=0
    Init_CAN4_EAC_MotorLackFalt: value-spec=0
    Init_CAN4_EAC_OvLoadFalt: value-spec=0
    Init_CAN4_EAC_Temp: value-spec=101
    Init_CAN4_EAC_TempSnsrFalt: value-spec=0
    Init_CAN4_PTCActuCrntHSC6: value-spec=0
    Init_CAN4_PTCActuPWMDutyHSC6: value-spec=0
    Init_CAN4_PTCActuVolHSC6: value-spec=0
    Init_CAN4_PTCChksmHSC6: value-spec=0
    Init_CAN4_PTCFltLvlHSC6: value-spec=0
    Init_CAN4_PTCHVLckStsHSC6: value-spec=0
    Init_CAN4_PTCIGBTOverHeatHSC6: value-spec=0
    Init_CAN4_PTCIGBTStsHSC6: value-spec=0
    Init_CAN4_PTCIGBTTemHSC6: value-spec=0
    Init_CAN4_PTCNTCStsHSC6: value-spec=0
    Init_CAN4_PTCOtptTemHSC6: value-spec=0
    Init_CAN4_PTCOverCrntHSC6: value-spec=0
    Init_CAN4_PTCOverHeatHSC6: value-spec=0
    Init_CAN4_PTCOverVolHSC6: value-spec=0
    Init_CAN4_PTCPCBTemHSC6: value-spec=0
    Init_CAN4_PTCRlngCtrHSC6: value-spec=0
    Init_CAN4_PTCSecChksmHSC6: value-spec=0
    Init_CAN4_PTCSecRlngCtrHSC6: value-spec=0
    Init_CAN4_PTCStsHSC6: value-spec=0
    Init_CAN4_PTCUnderVolHSC6: value-spec=0
    Init_CAN4_SG_GW_ZoneFR2: value-spec=fields=[Init_CAN4_BMSPackVol_h6HSC6, Init_CAN4_CCM_SpdCmd, Init_CAN4_COMP_ComLost, Init_CAN4_COMP_ConCur, Init_CAN4_COMP_ConVolt, Init_CAN4_COMP_CtrlCircFlt, Init_CAN4_COMP_CurOverProtect, Init_CAN4_COMP_CurVaild, Init_CAN4_COMP_IPM_HWFLt, Init_CAN4_COMP_IPM_TempOverFlt, Init_CAN4_COMP_Init, Init_CAN4_COMP_SpdVaild, Init_CAN4_COMP_Sta, Init_CAN4_COMP_StatorSpd, Init_CAN4_COMP_VoltLessErr, Init_CAN4_COMP_VoltOverErr, Init_CAN4_COMP_VoltVaild, Init_CAN4_CompProEN, Init_CAN4_EAC_DrvVoltFalt, Init_CAN4_EAC_MotCrt, Init_CAN4_EAC_MotorLackFalt, Init_CAN4_EAC_OvLoadFalt, Init_CAN4_EAC_Temp, Init_CAN4_EAC_TempSnsrFalt, Init_CAN4_PTCActuCrntHSC6, Init_CAN4_PTCActuPWMDutyHSC6, Init_CAN4_PTCActuVolHSC6, Init_CAN4_PTCChksmHSC6, Init_CAN4_PTCFltLvlHSC6, Init_CAN4_PTCHVLckStsHSC6, Init_CAN4_PTCIGBTOverHeatHSC6, Init_CAN4_PTCIGBTStsHSC6, Init_CAN4_PTCIGBTTemHSC6, Init_CAN4_PTCNTCStsHSC6, Init_CAN4_PTCOtptTemHSC6, Init_CAN4_PTCOverCrntHSC6, Init_CAN4_PTCOverHeatHSC6, Init_CAN4_PTCOverVolHSC6, Init_CAN4_PTCPCBTemHSC6, Init_CAN4_PTCRlngCtrHSC6, Init_CAN4_PTCSecChksmHSC6, Init_CAN4_PTCSecRlngCtrHSC6, Init_CAN4_PTCStsHSC6, Init_CAN4_PTCUnderVolHSC6]
    Init_CAN4_NM_DKC_Active_WU: value-spec=0
    Init_CAN4_NM_DKC_CSB: value-spec=0
    Init_CAN4_NM_DKC_ERROR_State: value-spec=0
    Init_CAN4_NM_DKC_Node_ID: value-spec=0
    Init_CAN4_NM_DKC_PNI: value-spec=0
    Init_CAN4_NM_DKC_Rpt_Msg_Req: value-spec=0
    Init_CAN4_SG_XNMm_DKC: value-spec=fields=[Init_CAN4_NM_DKC_Active_WU, Init_CAN4_NM_DKC_CSB, Init_CAN4_NM_DKC_ERROR_State, Init_CAN4_NM_DKC_Node_ID, Init_CAN4_NM_DKC_PNI, Init_CAN4_NM_DKC_Rpt_Msg_Req]
    Init_CAN4_NM_FUSION_Active_WU: value-spec=0
    Init_CAN4_NM_FUSION_CSB: value-spec=0
    Init_CAN4_NM_FUSION_ERROR_State: value-spec=0
    Init_CAN4_NM_FUSION_Node_ID: value-spec=0
    Init_CAN4_NM_FUSION_PNI: value-spec=0
    Init_CAN4_NM_FUSION_Rpt_Msg_Req: value-spec=0
    Init_CAN4_SG_XNMm_FUSION: value-spec=fields=[Init_CAN4_NM_FUSION_Active_WU, Init_CAN4_NM_FUSION_CSB, Init_CAN4_NM_FUSION_ERROR_State, Init_CAN4_NM_FUSION_Node_ID, Init_CAN4_NM_FUSION_PNI, Init_CAN4_NM_FUSION_Rpt_Msg_Req]
    Init_CAN4_NM_ZONE_DR_Active_WU: value-spec=0
    Init_CAN4_NM_ZONE_DR_CSB: value-spec=0
    Init_CAN4_NM_ZONE_DR_ERROR_State: value-spec=0
    Init_CAN4_NM_ZONE_DR_Node_ID: value-spec=0
    Init_CAN4_NM_ZONE_DR_PNI: value-spec=0
    Init_CAN4_NM_ZONE_DR_Rpt_Msg_Req: value-spec=0
    Init_CAN4_SG_XNMm_ZONE_DR: value-spec=fields=[Init_CAN4_NM_ZONE_DR_Active_WU, Init_CAN4_NM_ZONE_DR_CSB, Init_CAN4_NM_ZONE_DR_ERROR_State, Init_CAN4_NM_ZONE_DR_Node_ID, Init_CAN4_NM_ZONE_DR_PNI, Init_CAN4_NM_ZONE_DR_Rpt_Msg_Req]
    Init_CAN4_NM_ZONE_FR_Active_WU: value-spec=0
    Init_CAN4_NM_ZONE_FR_CSB: value-spec=0
    Init_CAN4_NM_ZONE_FR_ERROR_State: value-spec=0
    Init_CAN4_NM_ZONE_FR_Node_ID: value-spec=0
    Init_CAN4_NM_ZONE_FR_PNI: value-spec=0
    Init_CAN4_NM_ZONE_FR_Rpt_Msg_Req: value-spec=0
    Init_CAN4_SG_XNMm_ZONE_FR: value-spec=fields=[Init_CAN4_NM_ZONE_FR_Active_WU, Init_CAN4_NM_ZONE_FR_CSB, Init_CAN4_NM_ZONE_FR_ERROR_State, Init_CAN4_NM_ZONE_FR_Node_ID, Init_CAN4_NM_ZONE_FR_PNI, Init_CAN4_NM_ZONE_FR_Rpt_Msg_Req]
    Init_CAN4_DrSCPSysErrLmp: value-spec=0
    Init_CAN4_RegenMode: value-spec=0
    Init_CAN4_Set_Spd: value-spec=0
    Init_CAN4_Zone_Spd_Ctrl_Mode: value-spec=0
    Init_CAN4_Zone_Spd_Ctrl_Sta: value-spec=0
    Init_CAN4_SG_Zone_Dr_SCP: value-spec=fields=[Init_CAN4_DrSCPSysErrLmp, Init_CAN4_RegenMode, Init_CAN4_Set_Spd, Init_CAN4_Zone_Spd_Ctrl_Mode, Init_CAN4_Zone_Spd_Ctrl_Sta]
    Init_CAN4_APTC_Err: value-spec=0
    Init_CAN4_Blower_Err: value-spec=0
    Init_CAN4_Blower_FB: value-spec=0
    Init_CAN4_SolarL: value-spec=253
    Init_CAN4_SolarL_Err: value-spec=0
    Init_CAN4_SolarR: value-spec=253
    Init_CAN4_SolarR_Err: value-spec=0
    Init_CAN4_T_Face_L: value-spec=0
    Init_CAN4_T_Face_L_Err: value-spec=0
    Init_CAN4_T_Face_R: value-spec=0
    Init_CAN4_T_Face_R_Err: value-spec=0
    Init_CAN4_T_Face_Rr: value-spec=0
    Init_CAN4_T_Face_Rr_Err: value-spec=0
    Init_CAN4_T_Foot_L: value-spec=0
    Init_CAN4_T_Foot_L_Err: value-spec=0
    Init_CAN4_T_Foot_R: value-spec=0
    Init_CAN4_T_Foot_R_Err: value-spec=0
    Init_CAN4_T_Foot_Rr: value-spec=0
    Init_CAN4_T_Foot_Rr_Err: value-spec=0
    Init_CAN4_Tevap: value-spec=0
    Init_CAN4_Tevap_Err: value-spec=0
    Init_CAN4_Tincar: value-spec=0
    Init_CAN4_Tincar_Err: value-spec=0
    Init_CAN4_ZDR_THCM_IntakeFail_Sta: value-spec=0
    Init_CAN4_ZDR_THCM_LINACT{1..5}_Sta: value-spec=0
    Init_CAN4_ZDR_THCM_ModeFail_Sta: value-spec=0
    Init_CAN4_SG_Zone_Dr_THCM: value-spec=fields=[Init_CAN4_APTC_Err, Init_CAN4_Blower_Err, Init_CAN4_Blower_FB, Init_CAN4_SolarL, Init_CAN4_SolarL_Err, Init_CAN4_SolarR, Init_CAN4_SolarR_Err, Init_CAN4_T_Face_L, Init_CAN4_T_Face_L_Err, Init_CAN4_T_Face_R, Init_CAN4_T_Face_R_Err, Init_CAN4_T_Face_Rr, Init_CAN4_T_Face_Rr_Err, Init_CAN4_T_Foot_L, Init_CAN4_T_Foot_L_Err, Init_CAN4_T_Foot_R, Init_CAN4_T_Foot_R_Err, Init_CAN4_T_Foot_Rr, Init_CAN4_T_Foot_Rr_Err, Init_CAN4_Tevap, Init_CAN4_Tevap_Err, Init_CAN4_Tincar, Init_CAN4_Tincar_Err, Init_CAN4_ZDR_THCM_IntakeFail_Sta, Init_CAN4_ZDR_THCM_LINACT1_Sta, Init_CAN4_ZDR_THCM_LINACT2_Sta, Init_CAN4_ZDR_THCM_LINACT3_Sta, Init_CAN4_ZDR_THCM_LINACT4_Sta, Init_CAN4_ZDR_THCM_LINACT5_Sta, Init_CAN4_ZDR_THCM_ModeFail_Sta]
    Init_CAN4_DrAPWLINErr: value-spec=0
    Init_CAN4_DrAPWStaErr: value-spec=0
    Init_CAN4_DrAuBoxPwrN1Curr: value-spec=0
    Init_CAN4_DrAuBoxPwrN2Curr: value-spec=0
    Init_CAN4_DrColumnSWFault: value-spec=0
    Init_CAN4_DrCtrlBDVolt: value-spec=0
    Init_CAN4_DrCtrlTemp: value-spec=0
    Init_CAN4_DrEOBDFault: value-spec=0
    Init_CAN4_DrIVIFault: value-spec=0
    Init_CAN4_DrInfoErrSta: value-spec=0
    Init_CAN4_DrInfoFault: value-spec=0
    Init_CAN4_DrONA1ErrSta: value-spec=0
    Init_CAN4_DrPMMLVOutPErrLmp: value-spec=0
    Init_CAN4_DrPMMLimpHomeActReq: value-spec=0
    Init_CAN4_DrPMMSysErrLmp: value-spec=0
    Init_CAN4_DrPowerTemp1: value-spec=0
    Init_CAN4_DrPowerTemp2: value-spec=0
    Init_CAN4_DrPwrInformationSta: value-spec=0
    Init_CAN4_DrPwrONA1Curr: value-spec=0
    Init_CAN4_DrPwrONA2Curr: value-spec=0
    Init_CAN4_DrPwrSta: value-spec=0
    Init_CAN4_DrPwrStdbyACurr: value-spec=0
    Init_CAN4_DrPwrWinErrSta: value-spec=0
    Init_CAN4_DrPwrWindowECUFault: value-spec=0
    Init_CAN4_DrStdAErrSta: value-spec=0
    Init_CAN4_DrTHCMFault: value-spec=0
    Init_CAN4_ZDR_SYS_APMRetryCnt_Sta: value-spec=0
    Init_CAN4_ZDR_SYS_BSWSleepReq_Sta: value-spec=0
    Init_CAN4_ZDR_SYS_CSWRetryCnt_Sta: value-spec=0
    Init_CAN4_ZDR_VCU_HWReset_Sta: value-spec=0
    Init_CAN4_ZDR_VCU_PwrSupply_Sta: value-spec=0
    Init_CAN4_ZoneDrMalfunLevel: value-spec=0
    Init_CAN4_SG_Zone_Dr_VCU: value-spec=fields=[Init_CAN4_DrAPWLINErr, Init_CAN4_DrAPWStaErr, Init_CAN4_DrAuBoxPwrN1Curr, Init_CAN4_DrAuBoxPwrN2Curr, Init_CAN4_DrColumnSWFault, Init_CAN4_DrCtrlBDVolt, Init_CAN4_DrCtrlTemp, Init_CAN4_DrEOBDFault, Init_CAN4_DrIVIFault, Init_CAN4_DrInfoErrSta, Init_CAN4_DrInfoFault, Init_CAN4_DrONA1ErrSta, Init_CAN4_DrPMMLVOutPErrLmp, Init_CAN4_DrPMMLimpHomeActReq, Init_CAN4_DrPMMSysErrLmp, Init_CAN4_DrPowerTemp1, Init_CAN4_DrPowerTemp2, Init_CAN4_DrPwrInformationSta, Init_CAN4_DrPwrONA1Curr, Init_CAN4_DrPwrONA2Curr, Init_CAN4_DrPwrSta, Init_CAN4_DrPwrStdbyACurr, Init_CAN4_DrPwrWinErrSta, Init_CAN4_DrPwrWindowECUFault, Init_CAN4_DrStdAErrSta, Init_CAN4_DrTHCMFault, Init_CAN4_ZDR_SYS_APMRetryCnt_Sta, Init_CAN4_ZDR_SYS_BSWSleepReq_Sta, Init_CAN4_ZDR_SYS_CSWRetryCnt_Sta, Init_CAN4_ZDR_VCU_HWReset_Sta, Init_CAN4_ZDR_VCU_PwrSupply_Sta, Init_CAN4_ZoneDrMalfunLevel]
    Init_CAN4_AGS_Err: value-spec=0
    Init_CAN4_Bat_In_Temp: value-spec=0
    Init_CAN4_Bat_In_Temp_Err: value-spec=0
    Init_CAN4_Bat_Out_Temp: value-spec=0
    Init_CAN4_Bat_Out_Temp_Err: value-spec=0
    Init_CAN4_COMP_Err: value-spec=0
    Init_CAN4_EACProtectEnable: value-spec=0
    Init_CAN4_EWP{1..3}_Err: value-spec=0
    Init_CAN4_EXV1_Err: value-spec=0
    Init_CAN4_EXV2_Err: value-spec=0
    Init_CAN4_FWV_Err: value-spec=0
    Init_CAN4_Fan_Err: value-spec=0
    Init_CAN4_Motor_In_Temp: value-spec=0
    Init_CAN4_Motor_In_Temp_Err: value-spec=0
    Init_CAN4_Motor_Out_Temp: value-spec=0
    Init_CAN4_Motor_Out_Temp_Err: value-spec=0
    Init_CAN4_PT_High_P: value-spec=2700
    Init_CAN4_PT_High_P_Err: value-spec=0
    Init_CAN4_PT_High_T: value-spec=0
    Init_CAN4_PT_High_Tact: value-spec=0
    Init_CAN4_PT_High_Tact_Err: value-spec=0
    Init_CAN4_PT_Low_P1: value-spec=0
    Init_CAN4_PT_Low_P1_Err: value-spec=0
    Init_CAN4_PT_Low_P2: value-spec=0
    Init_CAN4_PT_Low_P2_Err: value-spec=0
    Init_CAN4_PT_Low_T1: value-spec=0
    Init_CAN4_PT_Low_T1_Err: value-spec=0
    Init_CAN4_PT_Low_T2: value-spec=0
    Init_CAN4_PT_Low_T2_Err: value-spec=0
    Init_CAN4_SOTXV_Err: value-spec=0
    Init_CAN4_SOV{1..3}_Err: value-spec=0
    Init_CAN4_TWV_Err: value-spec=0
    Init_CAN4_Tamb: value-spec=0
    Init_CAN4_Tamb_Err: value-spec=0
    Init_CAN4_WPTC_Err: value-spec=0
    Init_CAN4_SG_Zone_Fr_THCM: value-spec=fields=[Init_CAN4_AGS_Err, Init_CAN4_Bat_In_Temp, Init_CAN4_Bat_In_Temp_Err, Init_CAN4_Bat_Out_Temp, Init_CAN4_Bat_Out_Temp_Err, Init_CAN4_COMP_Err, Init_CAN4_EACProtectEnable, Init_CAN4_EWP1_Err, Init_CAN4_EWP2_Err, Init_CAN4_EWP3_Err, Init_CAN4_EXV1_Err, Init_CAN4_EXV2_Err, Init_CAN4_FWV_Err, Init_CAN4_Fan_Err, Init_CAN4_Motor_In_Temp, Init_CAN4_Motor_In_Temp_Err, Init_CAN4_Motor_Out_Temp, Init_CAN4_Motor_Out_Temp_Err, Init_CAN4_PT_High_P, Init_CAN4_PT_High_P_Err, Init_CAN4_PT_High_T, Init_CAN4_PT_High_Tact, Init_CAN4_PT_High_Tact_Err, Init_CAN4_PT_Low_P1, Init_CAN4_PT_Low_P1_Err, Init_CAN4_PT_Low_P2, Init_CAN4_PT_Low_P2_Err, Init_CAN4_PT_Low_T1, Init_CAN4_PT_Low_T1_Err, Init_CAN4_PT_Low_T2, Init_CAN4_PT_Low_T2_Err, Init_CAN4_SOTXV_Err, Init_CAN4_SOV1_Err, Init_CAN4_SOV2_Err, Init_CAN4_SOV3_Err, Init_CAN4_TWV_Err, Init_CAN4_Tamb, Init_CAN4_Tamb_Err, Init_CAN4_WPTC_Err]
package /CAN4/ImplementationDataTypes
  24 x impl type, all with category=STRUCTURE:
    DT_CAN4_SG_DKC1
      14 x element, all with category=TYPE_REFERENCE:
        CAN4_DKC_P_BLE_RSSI: implementation-data-type=uint8
        CAN4_DKC_P_UID_BatVolt: implementation-data-type=uint16
        CAN4_DKC_Re_VehData: implementation-data-type=uint8
        CAN4_DKC_Remote_PW: implementation-data-type=uint8
        CAN4_P_CommandToBCM: implementation-data-type=uint8
        CAN4_P_CommandToPTG: implementation-data-type=uint8
        CAN4_P_DKey_Area_LockUnlock: implementation-data-type=uint8
        CAN4_P_DKey_Area_PS: implementation-data-type=uint8
        CAN4_P_DKey_Area_PTG: implementation-data-type=uint8
        CAN4_P_DKey_Welcome: implementation-data-type=uint8
        CAN4_P_Dkey_Show_IVI: implementation-data-type=uint8
        CAN4_P_KeyMiss: implementation-data-type=uint8
        CAN4_P_KeyMode: implementation-data-type=uint8
        CAN4_P_UID_LowPower: implementation-data-type=uint8
    DT_CAN4_SG_DKC2
      element CAN4_EncryptionDATA_0_63: implementation-data-type=uint64
      element CAN4_EncryptionDATA_64_127: implementation-data-type=uint64
      element CAN4_Random_Number_X: implementation-data-type=uint64
    DT_CAN4_SG_FD4_CE100_2
      element CAN4_FD4_CE100_2_CS: implementation-data-type=uint8
      element CAN4_FD4_CE100_2_RC: implementation-data-type=uint8
      element CAN4_FDC_VCU_ReqHWReset_Cmd: implementation-data-type=uint8
    DT_CAN4_SG_FD_DKC1
      39 x element, all with category=TYPE_REFERENCE:
        CAN4_Approach_Unlock_SW: implementation-data-type=uint8
        CAN4_BrkPedalPos: implementation-data-type=uint8
        CAN4_BrkPedalPos_Sta: implementation-data-type=uint8
        CAN4_BrkSw_Sta: implementation-data-type=uint8
        CAN4_BrkSw_V: implementation-data-type=uint8
        CAN4_DSEAT_anti_set: implementation-data-type=uint8
        CAN4_DSEAT_entryfun_set: implementation-data-type=uint8
        CAN4_DSEAT_vent_req: implementation-data-type=uint8
        CAN4_FDC_BCM_ATCtrl_Cmd: implementation-data-type=uint8
        CAN4_FDC_BCM_LockAlarm_Cmd: implementation-data-type=uint8
        CAN4_FDC_BCM_OutMode_Cmd: implementation-data-type=uint8
        CAN4_FDC_THCM_ACTInitial_Cmd: implementation-data-type=uint8
        CAN4_HeadLampSW: implementation-data-type=uint8
        CAN4_Hood_Latch_SW: implementation-data-type=uint8
        CAN4_IVI_ISA_OffsetSpd: implementation-data-type=uint8
        CAN4_IVI_Located_STA: implementation-data-type=uint8
        CAN4_IVI_PTG_Mode_SW: implementation-data-type=uint8
        CAN4_IVI_PTG_Open_Height: implementation-data-type=uint8
        CAN4_IVI_PTG_Sta_SW: implementation-data-type=uint8
        CAN4_IVI_PTG_USSta_SW: implementation-data-type=uint8
        CAN4_IVI_Time_Check: implementation-data-type=uint8
        CAN4_IVI_Time_Day: implementation-data-type=uint8
        CAN4_IVI_Time_Hour: implementation-data-type=uint8
        CAN4_IVI_Time_Minute: implementation-data-type=uint8
        CAN4_IVI_Time_Month: implementation-data-type=uint8
        CAN4_IVI_Time_Second: implementation-data-type=uint8
        CAN4_IVI_Time_Year: implementation-data-type=uint8
        CAN4_L_Drv_CtrlCmd: implementation-data-type=uint8
        CAN4_L_Pas_CtrlCmd: implementation-data-type=uint8
        CAN4_L_RLD_CtrlCmd: implementation-data-type=uint8
        CAN4_L_RRD_CtrlCmd: implementation-data-type=uint8
        CAN4_MCPressure: implementation-data-type=uint16
        CAN4_MCPressure_V: implementation-data-type=uint8
        CAN4_OFF_AC_MODE: implementation-data-type=uint8
        CAN4_PSEAT_vent_req: implementation-data-type=uint8
        CAN4_PTG_Inner_SW2: implementation-data-type=uint8
        CAN4_SenstivityPosition: implementation-data-type=uint8
        CAN4_TurnSwTimeSet: implementation-data-type=uint8
        CAN4_Walkaway_Lock_SW: implementation-data-type=uint8
    DT_CAN4_SG_FD_OTA1
      12 x element, all with category=TYPE_REFERENCE:
        CAN4_OTA_DL_Available: implementation-data-type=uint8
        CAN4_OTA_DL_Speed: implementation-data-type=uint32
        CAN4_OTA_InVehicle_FW: implementation-data-type=uint8
        CAN4_OTA_Lock_Req: implementation-data-type=uint8
        CAN4_OTA_MDA_Status: implementation-data-type=uint8
        CAN4_OTA_Mode: implementation-data-type=uint8
        CAN4_OTA_Network_Type: implementation-data-type=uint8
        CAN4_OTA_Progress_Rate: implementation-data-type=uint8
        CAN4_OTA_TBOXResetReq: implementation-data-type=uint8
        CAN4_OTA_Up_Backcount: implementation-data-type=uint8
        CAN4_OTA_Update_Available: implementation-data-type=uint8
        CAN4_OTA_Updating_ECU: implementation-data-type=uint8
    DT_CAN4_SG_FD_THCM1
      37 x element, all with category=TYPE_REFERENCE:
        CAN4_BatteryMode: implementation-data-type=uint8
        CAN4_CCU_ACLampSts: implementation-data-type=uint8
        CAN4_CCU_ACMaxLampSts: implementation-data-type=uint8
        CAN4_CCU_AutoLampSts: implementation-data-type=uint8
        CAN4_CCU_AutoMidLampSts: implementation-data-type=uint8
        CAN4_CCU_Dispaly_Request: implementation-data-type=uint8
        CAN4_CCU_EcoSts: implementation-data-type=uint8
        CAN4_CCU_FrtOnOffLampSts: implementation-data-type=uint8
        CAN4_CCU_HEATMaxLampSts: implementation-data-type=uint8
        CAN4_CCU_RrOnOffLampSts: implementation-data-type=uint8
        CAN4_CCU_SyncLampSts: implementation-data-type=uint8
        CAN4_CabinMode: implementation-data-type=uint8
        CAN4_EDriveMode: implementation-data-type=uint8
        CAN4_FD_AGS_Cmd: implementation-data-type=uint8
        CAN4_FD_RecyAuto_Cmd: implementation-data-type=uint8
        CAN4_Fr_Coolantflow: implementation-data-type=uint8
        CAN4_Fr_Coolanttemp: implementation-data-type=uint16
        CAN4_HPThermalRecoveryReq: implementation-data-type=uint8
        CAN4_Rr_Coolantflow: implementation-data-type=uint8
        CAN4_Rr_Coolanttemp: implementation-data-type=uint16
        CAN4_sigAirIntenZon1St: implementation-data-type=uint8
        CAN4_sigAirIntenZon3St: implementation-data-type=uint8
        CAN4_sigAmbAirT: implementation-data-type=uint8
        CAN4_sigCbnAirT: implementation-data-type=uint8
        CAN4_sigCbnPTCPwrAct: implementation-data-type=uint8
        CAN4_sigCbnSolarLeft: implementation-data-type=uint8
        CAN4_sigCbnSolarRight: implementation-data-type=uint8
        CAN4_sigClmtCmprPwrAct: implementation-data-type=uint8
        CAN4_sigClntTHvBattOut: implementation-data-type=uint8
        CAN4_sigDfrstSt: implementation-data-type=uint8
        CAN4_sigHvacSt: implementation-data-type=uint8
        CAN4_sigRecircSt: implementation-data-type=uint8
        CAN4_sigSetTempZon{1..3}St: implementation-data-type=uint8
        CAN4_sigWindDirZon1St: implementation-data-type=uint8
        CAN4_sigWindDirZon3St: implementation-data-type=uint8
    DT_CAN4_SG_FD_THCM2
      26 x element, all with category=TYPE_REFERENCE:
        CAN4_ACSubMode: implementation-data-type=uint8
        CAN4_APTC_ActFrRiPwr: implementation-data-type=uint8
        CAN4_BatLoopActWtFlw: implementation-data-type=uint8
        CAN4_CCU_CbnPreACWkSts: implementation-data-type=uint8
        CAN4_CCU_CbnPreEstimdTi: implementation-data-type=uint8
        CAN4_CCU_CbnPreSts: implementation-data-type=uint8
        CAN4_CCU_HiVoltageReq: implementation-data-type=uint8
        CAN4_CoolgFanActDuty: implementation-data-type=uint8
        CAN4_DeiceModReq: implementation-data-type=uint8
        CAN4_FD_Blower_Cmd: implementation-data-type=uint8
        CAN4_FD_Comp_Cmd: implementation-data-type=uint16
        CAN4_FD_EWP{1..3}_Cmd: implementation-data-type=uint8
        CAN4_FD_EXV1_Cmd: implementation-data-type=uint16
        CAN4_FD_EXV2_Cmd: implementation-data-type=uint16
        CAN4_FD_FWV_Cmd: implementation-data-type=uint8
        CAN4_FD_FrLeAPTCHeatPwr_Cmd: implementation-data-type=uint8
        CAN4_FD_FrRiAPTCHeatPwr_Cmd: implementation-data-type=uint8
        CAN4_FD_FrWPTCHeatPwr_Cmd: implementation-data-type=uint16
        CAN4_FD_RrAPTCHeatPwr_Cmd: implementation-data-type=uint8
        CAN4_FD_SOTXV_Cmd: implementation-data-type=uint8
        CAN4_FD_SOV{1..3}_Cmd: implementation-data-type=uint8
        CAN4_FD_TWV_Cmd: implementation-data-type=uint8
    DT_CAN4_SG_FD_VCU1
      85 x element, all with category=TYPE_REFERENCE:
        CAN4_AllDoorSW: implementation-data-type=uint8
        CAN4_AmbLightBreath{1..3}: implementation-data-type=uint8
        CAN4_AmbLightBrightness{1..3}: implementation-data-type=uint8
        CAN4_AmbLightColor{1..3}: implementation-data-type=uint8
        CAN4_AntiTheftSeatFold: implementation-data-type=uint8
        CAN4_AntitheftSta: implementation-data-type=uint8
        CAN4_BCM_Buzzer_Req: implementation-data-type=uint8
        CAN4_BCM_DoorLock_Sta: implementation-data-type=uint8
        CAN4_BrakeLamp: implementation-data-type=uint8
        CAN4_CC_Crl_Sta: implementation-data-type=uint8
        CAN4_CS_VCU1_CAN4: implementation-data-type=uint8
        CAN4_CTDCtrl: implementation-data-type=uint8
        CAN4_CTDLockSW: implementation-data-type=uint8
        CAN4_CTDUnlockSW: implementation-data-type=uint8
        CAN4_CrashDetd: implementation-data-type=uint8
        CAN4_CtrlDrPwrStbA2: implementation-data-type=uint8
        CAN4_CtrlFrBMSCCUCIR: implementation-data-type=uint8
        CAN4_CtrlFrEDUINVERTER: implementation-data-type=uint8
        CAN4_CtrlFrIRC1: implementation-data-type=uint8
        CAN4_CtrlFrPwrStbA1P: implementation-data-type=uint8
        CAN4_DKCAuthSta: implementation-data-type=uint8
        CAN4_DKCTimeSN: implementation-data-type=uint32
        CAN4_Dimmer: implementation-data-type=uint8
        CAN4_DimmerEN: implementation-data-type=uint8
        CAN4_DoorLockIND: implementation-data-type=uint8
        CAN4_DrDoorSW: implementation-data-type=uint8
        CAN4_Dr_SeatSta: implementation-data-type=uint8
        CAN4_EquivAccPedalSWSta: implementation-data-type=uint8
        CAN4_FD_DKC_VehData_Err: implementation-data-type=uint8
        CAN4_FD_DKC_VehData_Sta: implementation-data-type=uint8
        CAN4_FD_TBOX_DTCData_Err: implementation-data-type=uint8
        CAN4_FD_TBOX_DTCData_Sta: implementation-data-type=uint8
        CAN4_FD_TBOX_VehData_Err: implementation-data-type=uint8
        CAN4_FD_TBOX_VehData_Sta: implementation-data-type=uint8
        CAN4_Fr_ChargingDoorCtrl: implementation-data-type=uint8
        CAN4_Fr_FogLamp: implementation-data-type=uint8
        CAN4_Fr_Wiper_H: implementation-data-type=uint8
        CAN4_Fr_Wiper_L: implementation-data-type=uint8
        CAN4_HWResetSta: implementation-data-type=uint8
        CAN4_H_Beam: implementation-data-type=uint8
        CAN4_HazardSW: implementation-data-type=uint8
        CAN4_HoodSW: implementation-data-type=uint8
        CAN4_HornCtrl: implementation-data-type=uint8
        CAN4_LBSD: implementation-data-type=uint8
        CAN4_LDRL: implementation-data-type=uint8
        CAN4_LTurnLP: implementation-data-type=uint8
        CAN4_L_APM_WdwEnable: implementation-data-type=uint8
        CAN4_L_Beam: implementation-data-type=uint8
        CAN4_LampPwr: implementation-data-type=uint8
        CAN4_LockSetting: implementation-data-type=uint8
        CAN4_MSA_Crl_Sta: implementation-data-type=uint8
        CAN4_MirrorCtrl: implementation-data-type=uint8
        CAN4_MirrorDefog: implementation-data-type=uint8
        CAN4_PosLamp: implementation-data-type=uint8
        CAN4_PsDoorSW: implementation-data-type=uint8
        CAN4_PwrSta: implementation-data-type=uint8
        CAN4_RBSD: implementation-data-type=uint8
        CAN4_RC_VCU1_CAN4: implementation-data-type=uint8
        CAN4_RDRL: implementation-data-type=uint8
        CAN4_RLDoorSW: implementation-data-type=uint8
        CAN4_RRDoorSW: implementation-data-type=uint8
        CAN4_RTurnLP: implementation-data-type=uint8
        CAN4_ReBrakeLPReq: implementation-data-type=uint8
        CAN4_ReverseLamp: implementation-data-type=uint8
        CAN4_RoomLampH: implementation-data-type=uint8
        CAN4_RoomLampL: implementation-data-type=uint8
        CAN4_Rr_ChargingDoorCtrl: implementation-data-type=uint8
        CAN4_Rr_Defog: implementation-data-type=uint8
        CAN4_Rr_FogLamp: implementation-data-type=uint8
        CAN4_Rr_Wiper: implementation-data-type=uint8
        CAN4_ShiftGearPosn: implementation-data-type=uint8
        CAN4_TailgateHDSW: implementation-data-type=uint8
        CAN4_TailgateRemote: implementation-data-type=uint8
        CAN4_Tailgate_SW: implementation-data-type=uint8
        CAN4_TimeSNDKCFbk: implementation-data-type=uint32
        CAN4_TrunkRel: implementation-data-type=uint8
        CAN4_VehSpeed: implementation-data-type=uint16
        CAN4_WasherCtrl: implementation-data-type=uint8
        CAN4_WiperFixMode: implementation-data-type=uint8
    DT_CAN4_SG_GW_ZDR_PTG1
      15 x element, all with category=TYPE_REFERENCE, implementation-data-type=uint8:
        CAN4_PTG_Active_Sta
        CAN4_PTG_AutoStaus
        CAN4_PTG_Cinch_Current
        CAN4_PTG_Exist
        CAN4_PTG_Full_Lock
        CAN4_PTG_HW_Ver
        CAN4_PTG_Half_Lock
        CAN4_PTG_Inner_SW_1
        CAN4_PTG_Is_Set_Height
        CAN4_PTG_Open_Ratio
        CAN4_PTG_RDIL_Sta
        CAN4_PTG_SW_Ver
        CAN4_PTG_Strut_Current
        CAN4_PTG_Sys_Sta
        CAN4_PTG_Warning_Sta
    DT_CAN4_SG_GW_ZoneDR1
      32 x element, all with category=TYPE_REFERENCE:
        CAN4_AllLockSta: implementation-data-type=uint8
        CAN4_AutoLightSW: implementation-data-type=uint8
        CAN4_BrakeLampFail: implementation-data-type=uint8
        CAN4_CSW_DimSw: implementation-data-type=uint8
        CAN4_CSW_FWasSw_Sta: implementation-data-type=uint8
        CAN4_CSW_FWipSw_Sta: implementation-data-type=uint8
        CAN4_CSW_HW_version: implementation-data-type=uint16
        CAN4_CSW_PassSW_Sta: implementation-data-type=uint8
        CAN4_CSW_RWasSW_Sta: implementation-data-type=uint8
        CAN4_CSW_RWipIntSw_Sta: implementation-data-type=uint8
        CAN4_CSW_SW_version: implementation-data-type=uint16
        CAN4_CSW_TurnSw_Sta: implementation-data-type=uint8
        CAN4_CSW_resp_error: implementation-data-type=uint8
        CAN4_DrLockSta: implementation-data-type=uint8
        CAN4_HornSW: implementation-data-type=uint8
        CAN4_MIRROR_FOLD_SW: implementation-data-type=uint8
        CAN4_PsLockSta: implementation-data-type=uint8
        CAN4_RLLockSta: implementation-data-type=uint8
        CAN4_RLS_Exist: implementation-data-type=uint8
        CAN4_RLS_LIN_Resp_Err: implementation-data-type=uint8
        CAN4_RLS_Lamp_Sta: implementation-data-type=uint8
        CAN4_RLS_LightSnrErr: implementation-data-type=uint8
        CAN4_RLS_RainSnrErr: implementation-data-type=uint8
        CAN4_RLS_RainSnrWiperCmd: implementation-data-type=uint8
        CAN4_RLTurnLampC: implementation-data-type=uint8
        CAN4_RRLockSta: implementation-data-type=uint8
        CAN4_RRTurnLampC: implementation-data-type=uint8
        CAN4_RWiperAS: implementation-data-type=uint8
        CAN4_RWiperProtection: implementation-data-type=uint8
        CAN4_Wip_Speed: implementation-data-type=uint8
        CAN4_WiperSWPos: implementation-data-type=uint8
        CAN4_WiperZeroPosSW: implementation-data-type=uint8
    DT_CAN4_SG_GW_ZoneDR2
      21 x element, all with category=TYPE_REFERENCE:
        CAN4_SWC_ACC_Sta: implementation-data-type=uint8
        CAN4_SWC_A_HW_version: implementation-data-type=uint16
        CAN4_SWC_A_Resp_Err: implementation-data-type=uint8
        CAN4_SWC_A_SW_version: implementation-data-type=uint16
        CAN4_SWC_CANCEL_Sta: implementation-data-type=uint8
        CAN4_SWC_Distance_Sta: implementation-data-type=uint8
        CAN4_SWC_Down_Sta: implementation-data-type=uint8
        CAN4_SWC_Drivemode_Sta: implementation-data-type=uint8
        CAN4_SWC_LKA_Sta: implementation-data-type=uint8
        CAN4_SWC_Left_Sta: implementation-data-type=uint8
        CAN4_SWC_RegenDown: implementation-data-type=uint8
        CAN4_SWC_RegenUp: implementation-data-type=uint8
        CAN4_SWC_Res_Up_Sta: implementation-data-type=uint8
        CAN4_SWC_Right_Sta: implementation-data-type=uint8
        CAN4_SWC_Set_down_Sta: implementation-data-type=uint8
        CAN4_SWC_Trip_Sta: implementation-data-type=uint8
        CAN4_SWC_Undefined_Sta: implementation-data-type=uint8
        CAN4_SWC_Up_Sta: implementation-data-type=uint8
        CAN4_SWC_VR_Sta: implementation-data-type=uint8
        CAN4_SWC_mode_Sta: implementation-data-type=uint8
        CAN4_SWC_resp_error: implementation-data-type=uint8
    DT_CAN4_SG_GW_ZoneDR3
      26 x element, all with category=TYPE_REFERENCE, implementation-data-type=uint8:
        CAN4_FAPWL_01_LIN_Response_Error
        CAN4_L_APM_IntellectClose
        CAN4_L_Drv_Motor_Relay_Error
        CAN4_L_Drv_Motor_Ripple_Error
        CAN4_L_Drv_OverHeat_Protect
        CAN4_L_Drv_Val_Wdw_Opened
        CAN4_L_Drv_Wdw_Init
        CAN4_L_Drv_Wdw_LocalSwitch
        CAN4_L_Drv_Wdw_OD_Sts
        CAN4_L_Drv_Wdw_Obs_InhibitSts
        CAN4_L_Drv_Wdw_Pas_Switch
        CAN4_L_Drv_Wdw_PositionSts
        CAN4_L_Drv_Wdw_RLD_Switch
        CAN4_L_Drv_Wdw_RRD_Switch
        CAN4_L_Drv_Wdw_Running_Sts
        CAN4_L_Pas_Motor_Relay_Error
        CAN4_L_Pas_Motor_Ripple_Error
        CAN4_L_Pas_OverHeat_Protect
        CAN4_L_Pas_Val_Wdw_Opened
        CAN4_L_Pas_Wdw_Init
        CAN4_L_Pas_Wdw_LocalSwitch
        CAN4_L_Pas_Wdw_OD_Sts
        CAN4_L_Pas_Wdw_Obs_InhibitSts
        CAN4_L_Pas_Wdw_PositionSts
        CAN4_L_Pas_Wdw_Running_Sts
        CAN4_L_Power_Status
    DT_CAN4_SG_GW_ZoneDR4
      22 x element, all with category=TYPE_REFERENCE, implementation-data-type=uint8:
        CAN4_L_RLD_Motor_Relay_Error
        CAN4_L_RLD_Motor_Ripple_Error
        CAN4_L_RLD_OverHeat_Protect
        CAN4_L_RLD_Val_Wdw_Opened
        CAN4_L_RLD_Wdw_Init
        CAN4_L_RLD_Wdw_LocalSwitch
        CAN4_L_RLD_Wdw_OD_Sts
        CAN4_L_RLD_Wdw_Obs_InhibitSts
        CAN4_L_RLD_Wdw_PositionSts
        CAN4_L_RLD_Wdw_Running_Sts
        CAN4_L_RRD_Motor_Relay_Error
        CAN4_L_RRD_Motor_Ripple_Error
        CAN4_L_RRD_OverHeat_Protect
        CAN4_L_RRD_Val_Wdw_Opened
        CAN4_L_RRD_Wdw_Init
        CAN4_L_RRD_Wdw_LocalSwitch
        CAN4_L_RRD_Wdw_OD_Sts
        CAN4_L_RRD_Wdw_Obs_InhibitSts
        CAN4_L_RRD_Wdw_PositionSts
        CAN4_L_RRD_Wdw_Running_Sts
        CAN4_PTG_Inner_SW_2
        CAN4_RAPWL_01_LIN_Response_Error
    DT_CAN4_SG_GW_ZoneDR6
      52 x element, all with category=TYPE_REFERENCE:
        CAN4_FrntPTCBusLineHiV: implementation-data-type=uint16
        CAN4_FrntPTCComFlt: implementation-data-type=uint8
        CAN4_FrntPTCFltSt: implementation-data-type=uint8
        CAN4_FrntPTCHVOverUFlt: implementation-data-type=uint8
        CAN4_FrntPTCHVUnderUFlt: implementation-data-type=uint8
        CAN4_FrntPTCHWVers: implementation-data-type=uint8
        CAN4_FrntPTCLVOverUFlt: implementation-data-type=uint8
        CAN4_FrntPTCLVUnderUFlt: implementation-data-type=uint8
        CAN4_FrntPTCLeActHeatPwr: implementation-data-type=uint8
        CAN4_FrntPTCLeBusLineC: implementation-data-type=uint8
        CAN4_FrntPTCLeCoreOverTFlt: implementation-data-type=uint8
        CAN4_FrntPTCLeCoreT: implementation-data-type=uint8
        CAN4_FrntPTCLeCoreTSnsrFlt: implementation-data-type=uint8
        CAN4_FrntPTCLeIGBTOverTFlt: implementation-data-type=uint8
        CAN4_FrntPTCLeIGBTShoCircFlt: implementation-data-type=uint8
        CAN4_FrntPTCLeIGBTT: implementation-data-type=uint8
        CAN4_FrntPTCLeIGBTTSnsrFlt: implementation-data-type=uint8
        CAN4_FrntPTCLeOpentCircFlt: implementation-data-type=uint8
        CAN4_FrntPTCLeOverAFlt: implementation-data-type=uint8
        CAN4_FrntPTCPCBOverTFlt: implementation-data-type=uint8
        CAN4_FrntPTCPCBT: implementation-data-type=uint8
        CAN4_FrntPTCPCBTSnsrFlt: implementation-data-type=uint8
        CAN4_FrntPTCRearLeActHeatPwr: implementation-data-type=uint8
        CAN4_FrntPTCRearLeBusLineC: implementation-data-type=uint8
        CAN4_FrntPTCRearLeCoreOverTFlt: implementation-data-type=uint8
        CAN4_FrntPTCRearLeCoreT: implementation-data-type=uint8
        CAN4_FrntPTCRearLeCoreTSnsrFlt: implementation-data-type=uint8
        CAN4_FrntPTCRearLeIGBTShoCFlt: implementation-data-type=uint8
        CAN4_FrntPTCRearLeOpentCircFlt: implementation-data-type=uint8
        CAN4_FrntPTCRearLeOverAFlt: implementation-data-type=uint8
        CAN4_FrntPTCRearRiActHeatPwr: implementation-data-type=uint8
        CAN4_FrntPTCRearRiBusLineC: implementation-data-type=uint8
        CAN4_FrntPTCRearRiCoreOverTFlt: implementation-data-type=uint8
        CAN4_FrntPTCRearRiCoreT: implementation-data-type=uint8
        CAN4_FrntPTCRearRiCoreTSnsrFlt: implementation-data-type=uint8
        CAN4_FrntPTCRearRiIGBTShoCFlt: implementation-data-type=uint8
        CAN4_FrntPTCRearRiOpentCircFlt: implementation-data-type=uint8
        CAN4_FrntPTCRearRiOverAFlt: implementation-data-type=uint8
        CAN4_FrntPTCRiActHeatPwr: implementation-data-type=uint8
        CAN4_FrntPTCRiBusLineC: implementation-data-type=uint8
        CAN4_FrntPTCRiCoreOverTFlt: implementation-data-type=uint8
        CAN4_FrntPTCRiCoreT: implementation-data-type=uint8
        CAN4_FrntPTCRiCoreTSnsrFlt: implementation-data-type=uint8
        CAN4_FrntPTCRiIGBTOverTFlt: implementation-data-type=uint8
        CAN4_FrntPTCRiIGBTShoCircFlt: implementation-data-type=uint8
        CAN4_FrntPTCRiIGBTT: implementation-data-type=uint8
        CAN4_FrntPTCRiIGBTTSnsrFlt: implementation-data-type=uint8
        CAN4_FrntPTCRiOpentCircFlt: implementation-data-type=uint8
        CAN4_FrntPTCRiOverAFlt: implementation-data-type=uint8
        CAN4_FrntPTCSWVers: implementation-data-type=uint8
        CAN4_FrntPTCSts: implementation-data-type=uint8
        CAN4_FrntPTCSupplierCod: implementation-data-type=uint8
    DT_CAN4_SG_GW_ZoneFR1
      33 x element, all with category=TYPE_REFERENCE:
        CAN4_AGS_Actual_Position: implementation-data-type=uint8
        CAN4_AGS_Actuator_Blocked: implementation-data-type=uint8
        CAN4_AGS_Actuator_Fault: implementation-data-type=uint8
        CAN4_AGS_Calibration_Active: implementation-data-type=uint8
        CAN4_AGS_Calibration_Enabled: implementation-data-type=uint8
        CAN4_AGS_Calibration_Indicated: implementation-data-type=uint8
        CAN4_AGS_Electrical_Error: implementation-data-type=uint8
        CAN4_AGS_LINResponse_Error: implementation-data-type=uint8
        CAN4_AGS_Low_Voltage_Error: implementation-data-type=uint8
        CAN4_AGS_Position_Request: implementation-data-type=uint8
        CAN4_AGS_Sensor_Error: implementation-data-type=uint8
        CAN4_AGS_Temperature_Error: implementation-data-type=uint8
        CAN4_BDC_1_MoveEnable: implementation-data-type=uint8
        CAN4_BDC_1_ReqMovePos: implementation-data-type=uint8
        CAN4_CCV4_MoveEnable: implementation-data-type=uint8
        CAN4_CCV4_ReqMovePos: implementation-data-type=uint8
        CAN4_ChargeInletLockSta: implementation-data-type=uint8
        CAN4_EWP1_Default_Operation_EWP_Rq: implementation-data-type=uint8
        CAN4_EWP1_RPM_Target_EWP_Rq: implementation-data-type=uint8
        CAN4_EWP2_Default_Operation_EWP_Rq: implementation-data-type=uint8
        CAN4_EWP2_RPM_Target_EWP_Rq: implementation-data-type=uint8
        CAN4_EWP3_Default_Operation_EWP_Rq: implementation-data-type=uint8
        CAN4_EWP3_RPM_Target_EWP_Rq: implementation-data-type=uint8
        CAN4_EXV2_Cmd_Init_Rq: implementation-data-type=uint8
        CAN4_EXV2_Cmd_Move_Enbl: implementation-data-type=uint8
        CAN4_EXV2_Cmd_Set_Rq: implementation-data-type=uint16
        CAN4_EXV_Cmd_Init_Rq: implementation-data-type=uint8
        CAN4_EXV_Cmd_Move_Enbl: implementation-data-type=uint8
        CAN4_EXV_Cmd_Set_Rq: implementation-data-type=uint16
        CAN4_FLTurnLampC: implementation-data-type=uint8
        CAN4_FRTurnLampC: implementation-data-type=uint8
        CAN4_FWiperAS: implementation-data-type=uint8
        CAN4_FWiperProtection: implementation-data-type=uint8
    DT_CAN4_SG_GW_ZoneFR2
      44 x element, all with category=TYPE_REFERENCE:
        CAN4_BMSPackVol_h6HSC6: implementation-data-type=uint16
        CAN4_CCM_SpdCmd: implementation-data-type=uint16
        CAN4_COMP_ComLost: implementation-data-type=uint8
        CAN4_COMP_ConCur: implementation-data-type=uint16
        CAN4_COMP_ConVolt: implementation-data-type=uint16
        CAN4_COMP_CtrlCircFlt: implementation-data-type=uint8
        CAN4_COMP_CurOverProtect: implementation-data-type=uint8
        CAN4_COMP_CurVaild: implementation-data-type=uint8
        CAN4_COMP_IPM_HWFLt: implementation-data-type=uint8
        CAN4_COMP_IPM_TempOverFlt: implementation-data-type=uint8
        CAN4_COMP_Init: implementation-data-type=uint8
        CAN4_COMP_SpdVaild: implementation-data-type=uint8
        CAN4_COMP_Sta: implementation-data-type=uint8
        CAN4_COMP_StatorSpd: implementation-data-type=uint16
        CAN4_COMP_VoltLessErr: implementation-data-type=uint8
        CAN4_COMP_VoltOverErr: implementation-data-type=uint8
        CAN4_COMP_VoltVaild: implementation-data-type=uint8
        CAN4_CompProEN: implementation-data-type=uint8
        CAN4_EAC_DrvVoltFalt: implementation-data-type=uint8
        CAN4_EAC_MotCrt: implementation-data-type=uint8
        CAN4_EAC_MotorLackFalt: implementation-data-type=uint8
        CAN4_EAC_OvLoadFalt: implementation-data-type=uint8
        CAN4_EAC_Temp: implementation-data-type=uint8
        CAN4_EAC_TempSnsrFalt: implementation-data-type=uint8
        CAN4_PTCActuCrntHSC6: implementation-data-type=uint16
        CAN4_PTCActuPWMDutyHSC6: implementation-data-type=uint8
        CAN4_PTCActuVolHSC6: implementation-data-type=uint16
        CAN4_PTCChksmHSC6: implementation-data-type=uint8
        CAN4_PTCFltLvlHSC6: implementation-data-type=uint8
        CAN4_PTCHVLckStsHSC6: implementation-data-type=uint8
        CAN4_PTCIGBTOverHeatHSC6: implementation-data-type=uint8
        CAN4_PTCIGBTStsHSC6: implementation-data-type=uint8
        CAN4_PTCIGBTTemHSC6: implementation-data-type=uint16
        CAN4_PTCNTCStsHSC6: implementation-data-type=uint8
        CAN4_PTCOtptTemHSC6: implementation-data-type=uint16
        CAN4_PTCOverCrntHSC6: implementation-data-type=uint8
        CAN4_PTCOverHeatHSC6: implementation-data-type=uint8
        CAN4_PTCOverVolHSC6: implementation-data-type=uint8
        CAN4_PTCPCBTemHSC6: implementation-data-type=uint16
        CAN4_PTCRlngCtrHSC6: implementation-data-type=uint8
        CAN4_PTCSecChksmHSC6: implementation-data-type=uint8
        CAN4_PTCSecRlngCtrHSC6: implementation-data-type=uint8
        CAN4_PTCStsHSC6: implementation-data-type=uint8
        CAN4_PTCUnderVolHSC6: implementation-data-type=uint8
    DT_CAN4_SG_XNMm_DKC
      6 x element, all with category=TYPE_REFERENCE, implementation-data-type=uint8:
        CAN4_NM_DKC_Active_WU
        CAN4_NM_DKC_CSB
        CAN4_NM_DKC_ERROR_State
        CAN4_NM_DKC_Node_ID
        CAN4_NM_DKC_PNI
        CAN4_NM_DKC_Rpt_Msg_Req
    DT_CAN4_SG_XNMm_FUSION
      6 x element, all with category=TYPE_REFERENCE, implementation-data-type=uint8:
        CAN4_NM_FUSION_Active_WU
        CAN4_NM_FUSION_CSB
        CAN4_NM_FUSION_ERROR_State
        CAN4_NM_FUSION_Node_ID
        CAN4_NM_FUSION_PNI
        CAN4_NM_FUSION_Rpt_Msg_Req
    DT_CAN4_SG_XNMm_ZONE_DR
      6 x element, all with category=TYPE_REFERENCE, implementation-data-type=uint8:
        CAN4_NM_ZONE_DR_Active_WU
        CAN4_NM_ZONE_DR_CSB
        CAN4_NM_ZONE_DR_ERROR_State
        CAN4_NM_ZONE_DR_Node_ID
        CAN4_NM_ZONE_DR_PNI
        CAN4_NM_ZONE_DR_Rpt_Msg_Req
    DT_CAN4_SG_XNMm_ZONE_FR
      6 x element, all with category=TYPE_REFERENCE, implementation-data-type=uint8:
        CAN4_NM_ZONE_FR_Active_WU
        CAN4_NM_ZONE_FR_CSB
        CAN4_NM_ZONE_FR_ERROR_State
        CAN4_NM_ZONE_FR_Node_ID
        CAN4_NM_ZONE_FR_PNI
        CAN4_NM_ZONE_FR_Rpt_Msg_Req
    DT_CAN4_SG_Zone_Dr_SCP
      5 x element, all with category=TYPE_REFERENCE, implementation-data-type=uint8:
        CAN4_DrSCPSysErrLmp
        CAN4_RegenMode
        CAN4_Set_Spd
        CAN4_Zone_Spd_Ctrl_Mode
        CAN4_Zone_Spd_Ctrl_Sta
    DT_CAN4_SG_Zone_Dr_THCM
      30 x element, all with category=TYPE_REFERENCE, implementation-data-type=uint8:
        CAN4_APTC_Err
        CAN4_Blower_Err
        CAN4_Blower_FB
        CAN4_SolarL
        CAN4_SolarL_Err
        CAN4_SolarR
        CAN4_SolarR_Err
        CAN4_T_Face_L
        CAN4_T_Face_L_Err
        CAN4_T_Face_R
        CAN4_T_Face_R_Err
        CAN4_T_Face_Rr
        CAN4_T_Face_Rr_Err
        CAN4_T_Foot_L
        CAN4_T_Foot_L_Err
        CAN4_T_Foot_R
        CAN4_T_Foot_R_Err
        CAN4_T_Foot_Rr
        CAN4_T_Foot_Rr_Err
        CAN4_Tevap
        CAN4_Tevap_Err
        CAN4_Tincar
        CAN4_Tincar_Err
        CAN4_ZDR_THCM_IntakeFail_Sta
        CAN4_ZDR_THCM_LINACT{1..5}_Sta
        CAN4_ZDR_THCM_ModeFail_Sta
    DT_CAN4_SG_Zone_Dr_VCU
      32 x element, all with category=TYPE_REFERENCE:
        CAN4_DrAPWLINErr: implementation-data-type=uint8
        CAN4_DrAPWStaErr: implementation-data-type=uint8
        CAN4_DrAuBoxPwrN1Curr: implementation-data-type=uint8
        CAN4_DrAuBoxPwrN2Curr: implementation-data-type=uint8
        CAN4_DrColumnSWFault: implementation-data-type=uint8
        CAN4_DrCtrlBDVolt: implementation-data-type=uint16
        CAN4_DrCtrlTemp: implementation-data-type=uint16
        CAN4_DrEOBDFault: implementation-data-type=uint8
        CAN4_DrIVIFault: implementation-data-type=uint8
        CAN4_DrInfoErrSta: implementation-data-type=uint8
        CAN4_DrInfoFault: implementation-data-type=uint8
        CAN4_DrONA1ErrSta: implementation-data-type=uint8
        CAN4_DrPMMLVOutPErrLmp: implementation-data-type=uint8
        CAN4_DrPMMLimpHomeActReq: implementation-data-type=uint8
        CAN4_DrPMMSysErrLmp: implementation-data-type=uint8
        CAN4_DrPowerTemp1: implementation-data-type=uint16
        CAN4_DrPowerTemp2: implementation-data-type=uint16
        CAN4_DrPwrInformationSta: implementation-data-type=uint8
        CAN4_DrPwrONA1Curr: implementation-data-type=uint8
        CAN4_DrPwrONA2Curr: implementation-data-type=uint8
        CAN4_DrPwrSta: implementation-data-type=uint8
        CAN4_DrPwrStdbyACurr: implementation-data-type=uint8
        CAN4_DrPwrWinErrSta: implementation-data-type=uint8
        CAN4_DrPwrWindowECUFault: implementation-data-type=uint8
        CAN4_DrStdAErrSta: implementation-data-type=uint8
        CAN4_DrTHCMFault: implementation-data-type=uint8
        CAN4_ZDR_SYS_APMRetryCnt_Sta: implementation-data-type=uint8
        CAN4_ZDR_SYS_BSWSleepReq_Sta: implementation-data-type=uint8
        CAN4_ZDR_SYS_CSWRetryCnt_Sta: implementation-data-type=uint8
        CAN4_ZDR_VCU_HWReset_Sta: implementation-data-type=uint8
        CAN4_ZDR_VCU_PwrSupply_Sta: implementation-data-type=uint8
        CAN4_ZoneDrMalfunLevel: implementation-data-type=uint8
    DT_CAN4_SG_Zone_Fr_THCM
      39 x element, all with category=TYPE_REFERENCE:
        CAN4_AGS_Err: implementation-data-type=uint8
        CAN4_Bat_In_Temp: implementation-data-type=uint8
        CAN4_Bat_In_Temp_Err: implementation-data-type=uint8
        CAN4_Bat_Out_Temp: implementation-data-type=uint8
        CAN4_Bat_Out_Temp_Err: implementation-data-type=uint8
        CAN4_COMP_Err: implementation-data-type=uint8
        CAN4_EACProtectEnable: implementation-data-type=uint8
        CAN4_EWP{1..3}_Err: implementation-data-type=uint8
        CAN4_EXV1_Err: implementation-data-type=uint8
        CAN4_EXV2_Err: implementation-data-type=uint8
        CAN4_FWV_Err: implementation-data-type=uint8
        CAN4_Fan_Err: implementation-data-type=uint8
        CAN4_Motor_In_Temp: implementation-data-type=uint8
        CAN4_Motor_In_Temp_Err: implementation-data-type=uint8
        CAN4_Motor_Out_Temp: implementation-data-type=uint8
        CAN4_Motor_Out_Temp_Err: implementation-data-type=uint8
        CAN4_PT_High_P: implementation-data-type=uint16
        CAN4_PT_High_P_Err: implementation-data-type=uint8
        CAN4_PT_High_T: implementation-data-type=uint8
        CAN4_PT_High_Tact: implementation-data-type=uint8
        CAN4_PT_High_Tact_Err: implementation-data-type=uint8
        CAN4_PT_Low_P1: implementation-data-type=uint16
        CAN4_PT_Low_P1_Err: implementation-data-type=uint8
        CAN4_PT_Low_P2: implementation-data-type=uint16
        CAN4_PT_Low_P2_Err: implementation-data-type=uint8
        CAN4_PT_Low_T1: implementation-data-type=uint8
        CAN4_PT_Low_T1_Err: implementation-data-type=uint8
        CAN4_PT_Low_T2: implementation-data-type=uint8
        CAN4_PT_Low_T2_Err: implementation-data-type=uint8
        CAN4_SOTXV_Err: implementation-data-type=uint8
        CAN4_SOV{1..3}_Err: implementation-data-type=uint8
        CAN4_TWV_Err: implementation-data-type=uint8
        CAN4_Tamb: implementation-data-type=uint8
        CAN4_Tamb_Err: implementation-data-type=uint8
        CAN4_WPTC_Err: implementation-data-type=uint8
