ASAP2_VERSION 1 31
/begin PROJECT ProjectName "Project Comment Goes Here"
/begin HEADER "Header Comments go here" /end HEADER
/begin MODULE ModuleName "Module Comment Goes Here"
/begin MOD_COMMON "Mod Common Comment Here" BYTE_ORDER MSB_LAST /end MOD_COMMON
/begin RECORD_LAYOUT Scalar_BOOLEAN FNC_VALUES 1 UBYTE COLUMN_DIR DIRECT /end RECORD_LAYOUT
/begin RECORD_LAYOUT Scalar_UBYTE FNC_VALUES 1 UBYTE COLUMN_DIR DIRECT /end RECORD_LAYOUT
/begin RECORD_LAYOUT Scalar_UWORD FNC_VALUES 1 UWORD COLUMN_DIR DIRECT /end RECORD_LAYOUT
/begin RECORD_LAYOUT Scalar_SWORD FNC_VALUES 1 SWORD COLUMN_DIR DIRECT /end RECORD_LAYOUT
/begin RECORD_LAYOUT Scalar_FLOAT32_IEEE FNC_VALUES 1 FLOAT32_IEEE COLUMN_DIR DIRECT /end RECORD_LAYOUT
/begin RECORD_LAYOUT Lookup1D_X_UWORD AXIS_PTS_X 1 UWORD INDEX_INCR DIRECT /end RECORD_LAYOUT
/begin RECORD_LAYOUT Lookup1D_WORD FNC_VALUES 1 SWORD COLUMN_DIR DIRECT /end RECORD_LAYOUT
/begin RECORD_LAYOUT Lookup1D_X_WORD AXIS_PTS_X 1 SWORD INDEX_INCR DIRECT /end RECORD_LAYOUT
/begin RECORD_LAYOUT Lookup1D_ULONG FNC_VALUES 1 ULONG COLUMN_DIR DIRECT /end RECORD_LAYOUT
/begin RECORD_LAYOUT Lookup1D_FLOAT32_IEEE FNC_VALUES 1 FLOAT32_IEEE COLUMN_DIR DIRECT /end RECORD_LAYOUT
/begin RECORD_LAYOUT Lookup1D_X_FLOAT32_IEEE AXIS_PTS_X 1 FLOAT32_IEEE INDEX_INCR DIRECT /end RECORD_LAYOUT
/begin RECORD_LAYOUT Lookup2D_UBYTE FNC_VALUES 1 UBYTE COLUMN_DIR DIRECT /end RECORD_LAYOUT
/begin RECORD_LAYOUT Lookup2D_FLOAT32_IEEE FNC_VALUES 1 FLOAT32_IEEE COLUMN_DIR DIRECT /end RECORD_LAYOUT
/begin RECORD_LAYOUT Lookup2D_X_FLOAT32_IEEE AXIS_PTS_X 1 FLOAT32_IEEE INDEX_INCR DIRECT /end RECORD_LAYOUT
/begin CHARACTERISTIC MVMC_ACCGradeofst_Z_Deg "" MAP 0x0000 /* @ECU_Address@MVMC_ACCGradeofst_Z_Deg@ */ Lookup2D_FLOAT32_IEEE 0 SWC_FDC_type_CM_single_deg -180.0 180.0
 /begin AXIS_DESCR COM_AXIS VVMC_CalibratedAccX_G SWC_FDC_type_CM_single_Gps 21 -65.536 65.536 AXIS_PTS_REF AVMC_ACCGradeofst_X_G /end AXIS_DESCR
 /begin AXIS_DESCR COM_AXIS NO_INPUT_QUANTITY SWC_FDC_type_CM_single_pct 11 0.0 100.0 AXIS_PTS_REF AVMC_ACCGradeofst_Y_pct /end AXIS_DESCR
/end CHARACTERISTIC
/begin AXIS_PTS AVMC_ACCGradeofst_Y_pct "" 0x0000 /* @ECU_Address@AVMC_ACCGradeofst_Y_pct@ */ NO_INPUT_QUANTITY Lookup2D_X_FLOAT32_IEEE 0 SWC_FDC_type_CM_single_pct 11 0.0 100.0 /end AXIS_PTS
/begin AXIS_PTS AVMC_ACCGradeofst_X_G "" 0x0000 /* @ECU_Address@AVMC_ACCGradeofst_X_G@ */ VVMC_CalibratedAccX_G Lookup2D_X_FLOAT32_IEEE 0 SWC_FDC_type_CM_single_Gps 21 -65.536 65.536 /end AXIS_PTS
/begin CHARACTERISTIC MVMC_CalEstSlopeTs_Y_c "" CURVE 0x0000 /* @ECU_Address@MVMC_CalEstSlopeTs_Y_c@ */ Lookup1D_FLOAT32_IEEE 0 SWC_FDC_type_CM_single_c 0.0 1.0
 /begin AXIS_DESCR COM_AXIS NO_INPUT_QUANTITY SWC_FDC_type_CM_single_kph 18 -20.0 200.0 AXIS_PTS_REF AVMC_EstPitchSlopeTs_X_kph /end AXIS_DESCR
/end CHARACTERISTIC
/begin AXIS_PTS AVMC_EstPitchSlopeTs_X_kph "" 0x0000 /* @ECU_Address@AVMC_EstPitchSlopeTs_X_kph@ */ NO_INPUT_QUANTITY Lookup1D_X_FLOAT32_IEEE 0 SWC_FDC_type_CM_single_kph 18 -20.0 200.0 /end AXIS_PTS
/begin CHARACTERISTIC MVMC_CalibratedGyroYDevTs_Y_c "" CURVE 0x0000 /* @ECU_Address@MVMC_CalibratedGyroYDevTs_Y_c@ */ Lookup1D_FLOAT32_IEEE 0 SWC_FDC_type_CM_single_c 0.0 1.0
 /begin AXIS_DESCR COM_AXIS NO_INPUT_QUANTITY SWC_FDC_type_CM_single_kph 18 -20.0 200.0 AXIS_PTS_REF AVMC_EstPitchSlopeTs_X_kph /end AXIS_DESCR
/end CHARACTERISTIC
/begin CHARACTERISTIC MVMC_DECGradeofst_Z_Deg "" MAP 0x0000 /* @ECU_Address@MVMC_DECGradeofst_Z_Deg@ */ Lookup2D_FLOAT32_IEEE 0 SWC_FDC_type_CM_single_deg -180.0 180.0
 /begin AXIS_DESCR COM_AXIS VVMC_CalibratedAccX_G SWC_FDC_type_CM_single_Gps 21 -65.536 65.536 AXIS_PTS_REF AVMC_DECGradeofst_X_G /end AXIS_DESCR
 /begin AXIS_DESCR COM_AXIS NO_INPUT_QUANTITY SWC_FDC_type_CM_single_pct 11 0.0 100.0 AXIS_PTS_REF AVMC_DECGradeofst_Y_pct /end AXIS_DESCR
/end CHARACTERISTIC
/begin AXIS_PTS AVMC_DECGradeofst_Y_pct "" 0x0000 /* @ECU_Address@AVMC_DECGradeofst_Y_pct@ */ NO_INPUT_QUANTITY Lookup2D_X_FLOAT32_IEEE 0 SWC_FDC_type_CM_single_pct 11 0.0 100.0 /end AXIS_PTS
/begin AXIS_PTS AVMC_DECGradeofst_X_G "" 0x0000 /* @ECU_Address@AVMC_DECGradeofst_X_G@ */ VVMC_CalibratedAccX_G Lookup2D_X_FLOAT32_IEEE 0 SWC_FDC_type_CM_single_Gps 21 -65.536 65.536 /end AXIS_PTS
/begin CHARACTERISTIC MVMC_EstPitchSlopeTs_Y_c "" CURVE 0x0000 /* @ECU_Address@MVMC_EstPitchSlopeTs_Y_c@ */ Lookup1D_FLOAT32_IEEE 0 SWC_FDC_type_CM_single_c 0.0 1.0
 /begin AXIS_DESCR COM_AXIS NO_INPUT_QUANTITY SWC_FDC_type_CM_single_kph 18 -20.0 200.0 AXIS_PTS_REF AVMC_EstPitchSlopeTs_X_kph /end AXIS_DESCR
/end CHARACTERISTIC
/begin CHARACTERISTIC MVMC_GradeCompFlt_Y_c "" CURVE 0x0000 /* @ECU_Address@MVMC_GradeCompFlt_Y_c@ */ Lookup1D_FLOAT32_IEEE 0 SWC_FDC_type_CM_single_c -1.0 1.0
 /begin AXIS_DESCR COM_AXIS NO_INPUT_QUANTITY SWC_FDC_type_CM_single_kph 17 -1.0 300.0 AXIS_PTS_REF AVMC_GradeCompFlt_X_kph /end AXIS_DESCR
/end CHARACTERISTIC
/begin AXIS_PTS AVMC_GradeCompFlt_X_kph "" 0x0000 /* @ECU_Address@AVMC_GradeCompFlt_X_kph@ */ NO_INPUT_QUANTITY Lookup1D_X_FLOAT32_IEEE 0 SWC_FDC_type_CM_single_kph 17 -1.0 300.0 /end AXIS_PTS
/begin CHARACTERISTIC MVMC_GyroYBandHi_Y_Dps "" CURVE 0x0000 /* @ECU_Address@MVMC_GyroYBandHi_Y_Dps@ */ Lookup1D_FLOAT32_IEEE 0 SWC_FDC_type_CM_single_Dps -10.0 10.0
 /begin AXIS_DESCR COM_AXIS NO_INPUT_QUANTITY SWC_FDC_type_CM_single_Gps 13 -200.0 200.0 AXIS_PTS_REF AVMC_GyroYBandLo_X_Gps /end AXIS_DESCR
/end CHARACTERISTIC
/begin AXIS_PTS AVMC_GyroYBandLo_X_Gps "" 0x0000 /* @ECU_Address@AVMC_GyroYBandLo_X_Gps@ */ NO_INPUT_QUANTITY Lookup1D_X_FLOAT32_IEEE 0 SWC_FDC_type_CM_single_Gps 13 -200.0 200.0 /end AXIS_PTS
/begin CHARACTERISTIC MVMC_GyroYBandLo_Y_Dps "" CURVE 0x0000 /* @ECU_Address@MVMC_GyroYBandLo_Y_Dps@ */ Lookup1D_FLOAT32_IEEE 0 SWC_FDC_type_CM_single_Dps -10.0 10.0
 /begin AXIS_DESCR COM_AXIS NO_INPUT_QUANTITY SWC_FDC_type_CM_single_Gps 13 -200.0 200.0 AXIS_PTS_REF AVMC_GyroYBandLo_X_Gps /end AXIS_DESCR
/end CHARACTERISTIC
/begin CHARACTERISTIC MVMC_VehspdTs_Y_c "" CURVE 0x0000 /* @ECU_Address@MVMC_VehspdTs_Y_c@ */ Lookup1D_FLOAT32_IEEE 0 SWC_FDC_type_CM_single_c 0.0 1.0
 /begin AXIS_DESCR COM_AXIS NO_INPUT_QUANTITY SWC_FDC_type_CM_single_kph 18 -20.0 200.0 AXIS_PTS_REF AVMC_EstPitchSlopeTs_X_kph /end AXIS_DESCR
/end CHARACTERISTIC
/begin CHARACTERISTIC MVMC_MSASpdBand_Y_pct "" CURVE 0x0000 /* @ECU_Address@MVMC_MSASpdBand_Y_pct@ */ Lookup1D_FLOAT32_IEEE 0 SWC_FDC_type_CM_single_pct 0.0 100.0
 /begin AXIS_DESCR COM_AXIS NO_INPUT_QUANTITY SWC_FDC_type_CM_single_kph 17 0.0 300.0 AXIS_PTS_REF AVMC_MSASpdBand_X_kph /end AXIS_DESCR
/end CHARACTERISTIC
/begin AXIS_PTS AVMC_MSASpdBand_X_kph "" 0x0000 /* @ECU_Address@AVMC_MSASpdBand_X_kph@ */ NO_INPUT_QUANTITY Lookup1D_X_FLOAT32_IEEE 0 SWC_FDC_type_CM_single_kph 17 0.0 300.0 /end AXIS_PTS
/begin CHARACTERISTIC MVMC_MSATqDownEndTq_Y_Nm "" CURVE 0x0000 /* @ECU_Address@MVMC_MSATqDownEndTq_Y_Nm@ */ Lookup1D_FLOAT32_IEEE 0 SWC_FDC_type_CM_single_Nm -3000.0 3000.0
 /begin AXIS_DESCR COM_AXIS NO_INPUT_QUANTITY SWC_FDC_type_CM_single_kph 17 0.0 300.0 AXIS_PTS_REF AVMC_MSATqDownEndTq_X_kph /end AXIS_DESCR
/end CHARACTERISTIC
/begin AXIS_PTS AVMC_MSATqDownEndTq_X_kph "" 0x0000 /* @ECU_Address@AVMC_MSATqDownEndTq_X_kph@ */ NO_INPUT_QUANTITY Lookup1D_X_FLOAT32_IEEE 0 SWC_FDC_type_CM_single_kph 17 0.0 300.0 /end AXIS_PTS
/begin CHARACTERISTIC MVMC_MSATqDownTime_Y_s "" CURVE 0x0000 /* @ECU_Address@MVMC_MSATqDownTime_Y_s@ */ Lookup1D_FLOAT32_IEEE 0 SWC_FDC_type_CM_single_s 0.01 10.0
 /begin AXIS_DESCR COM_AXIS NO_INPUT_QUANTITY SWC_FDC_type_CM_single_kph 17 0.0 300.0 AXIS_PTS_REF AVMC_MSATqDownTime_X_kph /end AXIS_DESCR
/end CHARACTERISTIC
/begin AXIS_PTS AVMC_MSATqDownTime_X_kph "" 0x0000 /* @ECU_Address@AVMC_MSATqDownTime_X_kph@ */ NO_INPUT_QUANTITY Lookup1D_X_FLOAT32_IEEE 0 SWC_FDC_type_CM_single_kph 17 0.0 300.0 /end AXIS_PTS
/begin CHARACTERISTIC MVMC_MSAPedalOvrd_Y_pct "" CURVE 0x0000 /* @ECU_Address@MVMC_MSAPedalOvrd_Y_pct@ */ Lookup1D_FLOAT32_IEEE 0 SWC_FDC_type_CM_single_pct 0.0 125.0
 /begin AXIS_DESCR COM_AXIS NO_INPUT_QUANTITY SWC_FDC_type_CM_single_kph 22 0.0 300.0 AXIS_PTS_REF AVMC_MSAPedalOvrd_X_kph /end AXIS_DESCR
/end CHARACTERISTIC
/begin AXIS_PTS AVMC_MSAPedalOvrd_X_kph "" 0x0000 /* @ECU_Address@AVMC_MSAPedalOvrd_X_kph@ */ NO_INPUT_QUANTITY Lookup1D_X_FLOAT32_IEEE 0 SWC_FDC_type_CM_single_kph 22 0.0 300.0 /end AXIS_PTS
/begin CHARACTERISTIC MVMC_ESCRegenOutEnSpd_Y_kph "" CURVE 0x0000 /* @ECU_Address@MVMC_ESCRegenOutEnSpd_Y_kph@ */ Lookup1D_FLOAT32_IEEE 0 SWC_FDC_type_CM_single_kph 0.0 300.0
 /begin AXIS_DESCR COM_AXIS NO_INPUT_QUANTITY SWC_FDC_type_CM_single_Deg 13 -500.0 500.0 AXIS_PTS_REF AVMC_ESCRegenOutEnSpd_X_Deg /end AXIS_DESCR
/end CHARACTERISTIC
/begin AXIS_PTS AVMC_ESCRegenOutEnSpd_X_Deg "" 0x0000 /* @ECU_Address@AVMC_ESCRegenOutEnSpd_X_Deg@ */ NO_INPUT_QUANTITY Lookup1D_X_FLOAT32_IEEE 0 SWC_FDC_type_CM_single_Deg 13 -500.0 500.0 /end AXIS_PTS
/begin CHARACTERISTIC MVMC_ESCRegenOut_Z_Dps "" MAP 0x0000 /* @ECU_Address@MVMC_ESCRegenOut_Z_Dps@ */ Lookup2D_FLOAT32_IEEE 0 SWC_FDC_type_CM_single_Dps -150.0 150.0
 /begin AXIS_DESCR COM_AXIS VVMC_VehicleSpeed_kph SWC_FDC_type_CM_single_kph 26 0.0 300.0 AXIS_PTS_REF AVMC_ESCRegenOut_X_kph /end AXIS_DESCR
 /begin AXIS_DESCR COM_AXIS NO_INPUT_QUANTITY SWC_FDC_type_CM_single_Deg 37 -900.0 900.0 AXIS_PTS_REF AVMC_ESCRegenOut_Y_Deg /end AXIS_DESCR
/end CHARACTERISTIC
/begin AXIS_PTS AVMC_ESCRegenOut_Y_Deg "" 0x0000 /* @ECU_Address@AVMC_ESCRegenOut_Y_Deg@ */ NO_INPUT_QUANTITY Lookup2D_X_FLOAT32_IEEE 0 SWC_FDC_type_CM_single_Deg 37 -900.0 900.0 /end AXIS_PTS
/begin AXIS_PTS AVMC_ESCRegenOut_X_kph "" 0x0000 /* @ECU_Address@AVMC_ESCRegenOut_X_kph@ */ VVMC_VehicleSpeed_kph Lookup2D_X_FLOAT32_IEEE 0 SWC_FDC_type_CM_single_kph 26 0.0 300.0 /end AXIS_PTS
/begin CHARACTERISTIC MVMC_LatESCRegenOut_Z_Gps "" MAP 0x0000 /* @ECU_Address@MVMC_LatESCRegenOut_Z_Gps@ */ Lookup2D_FLOAT32_IEEE 0 SWC_FDC_type_CM_single_Gps -150.0 150.0
 /begin AXIS_DESCR COM_AXIS VVMC_VehicleSpeed_kph SWC_FDC_type_CM_single_kph 26 0.0 300.0 AXIS_PTS_REF AVMC_LatESCRegenOut_X_kph /end AXIS_DESCR
 /begin AXIS_DESCR COM_AXIS NO_INPUT_QUANTITY SWC_FDC_type_CM_single_Deg 37 -900.0 900.0 AXIS_PTS_REF AVMC_LatESCRegenOut_Y_Deg /end AXIS_DESCR
/end CHARACTERISTIC
/begin AXIS_PTS AVMC_LatESCRegenOut_Y_Deg "" 0x0000 /* @ECU_Address@AVMC_LatESCRegenOut_Y_Deg@ */ NO_INPUT_QUANTITY Lookup2D_X_FLOAT32_IEEE 0 SWC_FDC_type_CM_single_Deg 37 -900.0 900.0 /end AXIS_PTS
/begin AXIS_PTS AVMC_LatESCRegenOut_X_kph "" 0x0000 /* @ECU_Address@AVMC_LatESCRegenOut_X_kph@ */ VVMC_VehicleSpeed_kph Lookup2D_X_FLOAT32_IEEE 0 SWC_FDC_type_CM_single_kph 26 0.0 300.0 /end AXIS_PTS
/begin CHARACTERISTIC MVMC_RDCDetectTime21AWD_Z_s "" MAP 0x0000 /* @ECU_Address@MVMC_RDCDetectTime21AWD_Z_s@ */ Lookup2D_FLOAT32_IEEE 0 SWC_FDC_type_CM_single_s 0.0 7200.0
 /begin AXIS_DESCR COM_AXIS VVMC_VehicleSpeed_kph SWC_FDC_type_CM_single_kph 42 0.0 300.0 AXIS_PTS_REF AVMC_RDCDetectTime21AWD_X_kph /end AXIS_DESCR
 /begin AXIS_DESCR COM_AXIS VVMC_ActMaxSlideRate_pct SWC_FDC_type_CM_single_pct 35 -125.0 125.0 AXIS_PTS_REF AVMC_RDCDetectTime21AWD_Y_pct /end AXIS_DESCR
/end CHARACTERISTIC
/begin AXIS_PTS AVMC_RDCDetectTime21AWD_Y_pct "" 0x0000 /* @ECU_Address@AVMC_RDCDetectTime21AWD_Y_pct@ */ VVMC_ActMaxSlideRate_pct Lookup2D_X_FLOAT32_IEEE 0 SWC_FDC_type_CM_single_pct 35 -125.0 125.0 /end AXIS_PTS
/begin AXIS_PTS AVMC_RDCDetectTime21AWD_X_kph "" 0x0000 /* @ECU_Address@AVMC_RDCDetectTime21AWD_X_kph@ */ VVMC_VehicleSpeed_kph Lookup2D_X_FLOAT32_IEEE 0 SWC_FDC_type_CM_single_kph 42 0.0 300.0 /end AXIS_PTS
/begin CHARACTERISTIC MVMC_RDCDetectTime21RWD_Z_s "" MAP 0x0000 /* @ECU_Address@MVMC_RDCDetectTime21RWD_Z_s@ */ Lookup2D_FLOAT32_IEEE 0 SWC_FDC_type_CM_single_s 0.0 7200.0
 /begin AXIS_DESCR COM_AXIS VVMC_VehicleSpeed_kph SWC_FDC_type_CM_single_kph 42 0.0 300.0 AXIS_PTS_REF AVMC_RDCDetectTime21RWD_X_kph /end AXIS_DESCR
 /begin AXIS_DESCR COM_AXIS VVMC_ActMaxSlideRate_pct SWC_FDC_type_CM_single_pct 35 -125.0 125.0 AXIS_PTS_REF AVMC_RDCDetectTime21RWD_Y_pct /end AXIS_DESCR
/end CHARACTERISTIC
/begin AXIS_PTS AVMC_RDCDetectTime21RWD_Y_pct "" 0x0000 /* @ECU_Address@AVMC_RDCDetectTime21RWD_Y_pct@ */ VVMC_ActMaxSlideRate_pct Lookup2D_X_FLOAT32_IEEE 0 SWC_FDC_type_CM_single_pct 35 -125.0 125.0 /end AXIS_PTS
/begin AXIS_PTS AVMC_RDCDetectTime21RWD_X_kph "" 0x0000 /* @ECU_Address@AVMC_RDCDetectTime21RWD_X_kph@ */ VVMC_VehicleSpeed_kph Lookup2D_X_FLOAT32_IEEE 0 SWC_FDC_type_CM_single_kph 42 0.0 300.0 /end AXIS_PTS
/begin CHARACTERISTIC MVMC_RDCDetectTimeF25_Z_s "" MAP 0x0000 /* @ECU_Address@MVMC_RDCDetectTimeF25_Z_s@ */ Lookup2D_FLOAT32_IEEE 0 SWC_FDC_type_CM_single_s 0.0 7200.0
 /begin AXIS_DESCR COM_AXIS VVMC_VehicleSpeed_kph SWC_FDC_type_CM_single_kph 42 0.0 300.0 AXIS_PTS_REF AVMC_RDCDetectTimeF25_X_kph /end AXIS_DESCR
 /begin AXIS_DESCR COM_AXIS VVMC_ActMaxSlideRate_pct SWC_FDC_type_CM_single_pct 35 -125.0 125.0 AXIS_PTS_REF AVMC_RDCDetectTimeF25_Y_pct /end AXIS_DESCR
/end CHARACTERISTIC
/begin AXIS_PTS AVMC_RDCDetectTimeF25_Y_pct "" 0x0000 /* @ECU_Address@AVMC_RDCDetectTimeF25_Y_pct@ */ VVMC_ActMaxSlideRate_pct Lookup2D_X_FLOAT32_IEEE 0 SWC_FDC_type_CM_single_pct 35 -125.0 125.0 /end AXIS_PTS
/begin AXIS_PTS AVMC_RDCDetectTimeF25_X_kph "" 0x0000 /* @ECU_Address@AVMC_RDCDetectTimeF25_X_kph@ */ VVMC_VehicleSpeed_kph Lookup2D_X_FLOAT32_IEEE 0 SWC_FDC_type_CM_single_kph 42 0.0 300.0 /end AXIS_PTS
/begin CHARACTERISTIC MVMC_RDCDetectTimeHAWD_Z_s "" MAP 0x0000 /* @ECU_Address@MVMC_RDCDetectTimeHAWD_Z_s@ */ Lookup2D_FLOAT32_IEEE 0 SWC_FDC_type_CM_single_s 0.0 7200.0
 /begin AXIS_DESCR COM_AXIS VVMC_VehicleSpeed_kph SWC_FDC_type_CM_single_kph 42 0.0 300.0 AXIS_PTS_REF AVMC_RDCDetectTimeHAWD_X_kph /end AXIS_DESCR
 /begin AXIS_DESCR COM_AXIS VVMC_ActMaxSlideRate_pct SWC_FDC_type_CM_single_pct 35 -125.0 125.0 AXIS_PTS_REF AVMC_RDCDetectTimeHAWD_Y_pct /end AXIS_DESCR
/end CHARACTERISTIC
/begin AXIS_PTS AVMC_RDCDetectTimeHAWD_Y_pct "" 0x0000 /* @ECU_Address@AVMC_RDCDetectTimeHAWD_Y_pct@ */ VVMC_ActMaxSlideRate_pct Lookup2D_X_FLOAT32_IEEE 0 SWC_FDC_type_CM_single_pct 35 -125.0 125.0 /end AXIS_PTS
/begin AXIS_PTS AVMC_RDCDetectTimeHAWD_X_kph "" 0x0000 /* @ECU_Address@AVMC_RDCDetectTimeHAWD_X_kph@ */ VVMC_VehicleSpeed_kph Lookup2D_X_FLOAT32_IEEE 0 SWC_FDC_type_CM_single_kph 42 0.0 300.0 /end AXIS_PTS
/begin CHARACTERISTIC MVMC_RDCDetectTimeHRWD_Z_s "" MAP 0x0000 /* @ECU_Address@MVMC_RDCDetectTimeHRWD_Z_s@ */ Lookup2D_FLOAT32_IEEE 0 SWC_FDC_type_CM_single_s 0.0 7200.0
 /begin AXIS_DESCR COM_AXIS VVMC_VehicleSpeed_kph SWC_FDC_type_CM_single_kph 42 0.0 300.0 AXIS_PTS_REF AVMC_RDCDetectTimeHRWD_X_kph /end AXIS_DESCR
 /begin AXIS_DESCR COM_AXIS VVMC_ActMaxSlideRate_pct SWC_FDC_type_CM_single_pct 35 -125.0 125.0 AXIS_PTS_REF AVMC_RDCDetectTimeHRWD_Y_pct /end AXIS_DESCR
/end CHARACTERISTIC
/begin AXIS_PTS AVMC_RDCDetectTimeHRWD_Y_pct "" 0x0000 /* @ECU_Address@AVMC_RDCDetectTimeHRWD_Y_pct@ */ VVMC_ActMaxSlideRate_pct Lookup2D_X_FLOAT32_IEEE 0 SWC_FDC_type_CM_single_pct 35 -125.0 125.0 /end AXIS_PTS
/begin AXIS_PTS AVMC_RDCDetectTimeHRWD_X_kph "" 0x0000 /* @ECU_Address@AVMC_RDCDetectTimeHRWD_X_kph@ */ VVMC_VehicleSpeed_kph Lookup2D_X_FLOAT32_IEEE 0 SWC_FDC_type_CM_single_kph 42 0.0 300.0 /end AXIS_PTS
/begin CHARACTERISTIC MVMC_RDCDetectTimeL24_Z_s "" MAP 0x0000 /* @ECU_Address@MVMC_RDCDetectTimeL24_Z_s@ */ Lookup2D_FLOAT32_IEEE 0 SWC_FDC_type_CM_single_s 0.0 7200.0
 /begin AXIS_DESCR COM_AXIS VVMC_VehicleSpeed_kph SWC_FDC_type_CM_single_kph 42 0.0 300.0 AXIS_PTS_REF AVMC_RDCDetectTimeL24_X_kph /end AXIS_DESCR
 /begin AXIS_DESCR COM_AXIS VVMC_ActMaxSlideRate_pct SWC_FDC_type_CM_single_pct 35 -125.0 125.0 AXIS_PTS_REF AVMC_RDCDetectTimeL24_Y_pct /end AXIS_DESCR
/end CHARACTERISTIC
/begin AXIS_PTS AVMC_RDCDetectTimeL24_Y_pct "" 0x0000 /* @ECU_Address@AVMC_RDCDetectTimeL24_Y_pct@ */ VVMC_ActMaxSlideRate_pct Lookup2D_X_FLOAT32_IEEE 0 SWC_FDC_type_CM_single_pct 35 -125.0 125.0 /end AXIS_PTS
/begin AXIS_PTS AVMC_RDCDetectTimeL24_X_kph "" 0x0000 /* @ECU_Address@AVMC_RDCDetectTimeL24_X_kph@ */ VVMC_VehicleSpeed_kph Lookup2D_X_FLOAT32_IEEE 0 SWC_FDC_type_CM_single_kph 42 0.0 300.0 /end AXIS_PTS
/begin CHARACTERISTIC MVMC_RDCEnSlideRate_Y_pct "" CURVE 0x0000 /* @ECU_Address@MVMC_RDCEnSlideRate_Y_pct@ */ Lookup1D_FLOAT32_IEEE 0 SWC_FDC_type_CM_single_pct 0.0 125.0
 /begin AXIS_DESCR COM_AXIS NO_INPUT_QUANTITY SWC_FDC_type_CM_single_Deg 43 -900.0 900.0 AXIS_PTS_REF AVMC_RDCEnSlideRate_X_Deg /end AXIS_DESCR
/end CHARACTERISTIC
/begin AXIS_PTS AVMC_RDCEnSlideRate_X_Deg "" 0x0000 /* @ECU_Address@AVMC_RDCEnSlideRate_X_Deg@ */ NO_INPUT_QUANTITY Lookup1D_X_FLOAT32_IEEE 0 SWC_FDC_type_CM_single_Deg 43 -900.0 900.0 /end AXIS_PTS
/begin CHARACTERISTIC MVMC_StESCYawCom_Z_Dps "" MAP 0x0000 /* @ECU_Address@MVMC_StESCYawCom_Z_Dps@ */ Lookup2D_FLOAT32_IEEE 0 SWC_FDC_type_CM_single_Dps -150.0 150.0
 /begin AXIS_DESCR COM_AXIS VVMC_VehicleSpeed_kph SWC_FDC_type_CM_single_kph 26 -10.0 300.0 AXIS_PTS_REF AVMC_StESCYawCom_X_kph /end AXIS_DESCR
 /begin AXIS_DESCR COM_AXIS NO_INPUT_QUANTITY SWC_FDC_type_CM_single_Gps 19 -20.0 20.0 AXIS_PTS_REF AVMC_StESCYawCom_Y_Gps /end AXIS_DESCR
/end CHARACTERISTIC
/begin AXIS_PTS AVMC_StESCYawCom_Y_Gps "" 0x0000 /* @ECU_Address@AVMC_StESCYawCom_Y_Gps@ */ NO_INPUT_QUANTITY Lookup2D_X_FLOAT32_IEEE 0 SWC_FDC_type_CM_single_Gps 19 -20.0 20.0 /end AXIS_PTS
/begin AXIS_PTS AVMC_StESCYawCom_X_kph "" 0x0000 /* @ECU_Address@AVMC_StESCYawCom_X_kph@ */ VVMC_VehicleSpeed_kph Lookup2D_X_FLOAT32_IEEE 0 SWC_FDC_type_CM_single_kph 26 -10.0 300.0 /end AXIS_PTS
/begin CHARACTERISTIC MVMC_StESCYaw_Z_Dps "" MAP 0x0000 /* @ECU_Address@MVMC_StESCYaw_Z_Dps@ */ Lookup2D_FLOAT32_IEEE 0 SWC_FDC_type_CM_single_Dps -150.0 150.0
 /begin AXIS_DESCR COM_AXIS VVMC_VehicleSpeed_kph SWC_FDC_type_CM_single_kph 26 0.0 300.0 AXIS_PTS_REF AVMC_StESCYaw_X_kph /end AXIS_DESCR
 /begin AXIS_DESCR COM_AXIS NO_INPUT_QUANTITY SWC_FDC_type_CM_single_Deg 19 -900.0 900.0 AXIS_PTS_REF AVMC_StESCYaw_Y_Deg /end AXIS_DESCR
/end CHARACTERISTIC
/begin AXIS_PTS AVMC_StESCYaw_Y_Deg "" 0x0000 /* @ECU_Address@AVMC_StESCYaw_Y_Deg@ */ NO_INPUT_QUANTITY Lookup2D_X_FLOAT32_IEEE 0 SWC_FDC_type_CM_single_Deg 19 -900.0 900.0 /end AXIS_PTS
/begin AXIS_PTS AVMC_StESCYaw_X_kph "" 0x0000 /* @ECU_Address@AVMC_StESCYaw_X_kph@ */ VVMC_VehicleSpeed_kph Lookup2D_X_FLOAT32_IEEE 0 SWC_FDC_type_CM_single_kph 26 0.0 300.0 /end AXIS_PTS
/begin CHARACTERISTIC MVMC_ISOAccLimit_Y_mps2 "" CURVE 0x0000 /* @ECU_Address@MVMC_ISOAccLimit_Y_mps2@ */ Lookup1D_FLOAT32_IEEE 0 SWC_FDC_type_CM_single_mps2 0.0 6.0
 /begin AXIS_DESCR COM_AXIS NO_INPUT_QUANTITY SWC_FDC_type_CM_single_mps 4 0.0 80.0 AXIS_PTS_REF AVMC_ISOAccLimit_X_mps /end AXIS_DESCR
/end CHARACTERISTIC
/begin AXIS_PTS AVMC_ISOAccLimit_X_mps "" 0x0000 /* @ECU_Address@AVMC_ISOAccLimit_X_mps@ */ NO_INPUT_QUANTITY Lookup1D_X_FLOAT32_IEEE 0 SWC_FDC_type_CM_single_mps 4 0.0 80.0 /end AXIS_PTS
/begin CHARACTERISTIC MVMC_ISODecLimit_Y_mps2 "" CURVE 0x0000 /* @ECU_Address@MVMC_ISODecLimit_Y_mps2@ */ Lookup1D_FLOAT32_IEEE 0 SWC_FDC_type_CM_single_mps2 0.0 6.0
 /begin AXIS_DESCR COM_AXIS NO_INPUT_QUANTITY SWC_FDC_type_CM_single_mps 4 0.0 80.0 AXIS_PTS_REF AVMC_ISODecLimit_X_mps /end AXIS_DESCR
/end CHARACTERISTIC
/begin AXIS_PTS AVMC_ISODecLimit_X_mps "" 0x0000 /* @ECU_Address@AVMC_ISODecLimit_X_mps@ */ NO_INPUT_QUANTITY Lookup1D_X_FLOAT32_IEEE 0 SWC_FDC_type_CM_single_mps 4 0.0 80.0 /end AXIS_PTS
/begin CHARACTERISTIC MVMC_ISOJerk_Y_mps3 "" CURVE 0x0000 /* @ECU_Address@MVMC_ISOJerk_Y_mps3@ */ Lookup1D_FLOAT32_IEEE 0 SWC_FDC_type_CM_single_mps3 0.0 6.0
 /begin AXIS_DESCR COM_AXIS NO_INPUT_QUANTITY SWC_FDC_type_CM_single_mps 4 0.0 80.0 AXIS_PTS_REF AVMC_ISOJerk_X_mps /end AXIS_DESCR
/end CHARACTERISTIC
/begin AXIS_PTS AVMC_ISOJerk_X_mps "" 0x0000 /* @ECU_Address@AVMC_ISOJerk_X_mps@ */ NO_INPUT_QUANTITY Lookup1D_X_FLOAT32_IEEE 0 SWC_FDC_type_CM_single_mps 4 0.0 80.0 /end AXIS_PTS
/begin CHARACTERISTIC MVMC_ReqBrkJoinDecSR_Y_mps3 "" CURVE 0x0000 /* @ECU_Address@MVMC_ReqBrkJoinDecSR_Y_mps3@ */ Lookup1D_FLOAT32_IEEE 0 SWC_FDC_type_CM_single_mps3 -10.0 10.0
 /begin AXIS_DESCR COM_AXIS NO_INPUT_QUANTITY SWC_FDC_type_CM_single_mps2 10 -10.0 10.0 AXIS_PTS_REF AVMC_ReqBrkJoinDecSR_X_mps2 /end AXIS_DESCR
/end CHARACTERISTIC
/begin AXIS_PTS AVMC_ReqBrkJoinDecSR_X_mps2 "" 0x0000 /* @ECU_Address@AVMC_ReqBrkJoinDecSR_X_mps2@ */ NO_INPUT_QUANTITY Lookup1D_X_FLOAT32_IEEE 0 SWC_FDC_type_CM_single_mps2 10 -10.0 10.0 /end AXIS_PTS
/begin CHARACTERISTIC MVMC_OVRD2ActSR2FCMCMD_Y_mps3 "" CURVE 0x0000 /* @ECU_Address@MVMC_OVRD2ActSR2FCMCMD_Y_mps3@ */ Lookup1D_FLOAT32_IEEE 0 SWC_FDC_type_CM_single_mps3 -10.0 10.0
 /begin AXIS_DESCR COM_AXIS NO_INPUT_QUANTITY SWC_FDC_type_CM_single_mps2 10 -10.0 10.0 AXIS_PTS_REF AVMC_OVRD2ActSR2FCMCMD_X_mps2 /end AXIS_DESCR
/end CHARACTERISTIC
/begin AXIS_PTS AVMC_OVRD2ActSR2FCMCMD_X_mps2 "" 0x0000 /* @ECU_Address@AVMC_OVRD2ActSR2FCMCMD_X_mps2@ */ NO_INPUT_QUANTITY Lookup1D_X_FLOAT32_IEEE 0 SWC_FDC_type_CM_single_mps2 10 -10.0 10.0 /end AXIS_PTS
/begin CHARACTERISTIC MVMC_ACCReqAccelGain_Z_rat "" MAP 0x0000 /* @ECU_Address@MVMC_ACCReqAccelGain_Z_rat@ */ Lookup2D_FLOAT32_IEEE 0 SWC_FDC_type_CM_single_rat 1.0 5.0
 /begin AXIS_DESCR COM_AXIS NO_INPUT_QUANTITY SWC_FDC_type_CM_single_mps2 15 -15.0 15.0 AXIS_PTS_REF AVMC_ACCReqAccelGain_X_mps2 /end AXIS_DESCR
 /begin AXIS_DESCR COM_AXIS NO_INPUT_QUANTITY SWC_FDC_type_CM_single_enum 5 0.0 6.0 AXIS_PTS_REF AVMC_ACCReqAccelGain_Y_enum /end AXIS_DESCR
/end CHARACTERISTIC
/begin AXIS_PTS AVMC_ACCReqAccelGain_Y_enum "" 0x0000 /* @ECU_Address@AVMC_ACCReqAccelGain_Y_enum@ */ NO_INPUT_QUANTITY Lookup2D_X_FLOAT32_IEEE 0 SWC_FDC_type_CM_single_enum 5 0.0 6.0 /end AXIS_PTS
/begin AXIS_PTS AVMC_ACCReqAccelGain_X_mps2 "" 0x0000 /* @ECU_Address@AVMC_ACCReqAccelGain_X_mps2@ */ NO_INPUT_QUANTITY Lookup2D_X_FLOAT32_IEEE 0 SWC_FDC_type_CM_single_mps2 15 -15.0 15.0 /end AXIS_PTS
/begin CHARACTERISTIC MVMC_VehHoldDecCtrlTime2_Y_s "" CURVE 0x0000 /* @ECU_Address@MVMC_VehHoldDecCtrlTime2_Y_s@ */ Lookup1D_FLOAT32_IEEE 0 SWC_FDC_type_CM_single_s 0.1 10.0
 /begin AXIS_DESCR COM_AXIS VVMC_VehHoldEnSpd_kph SWC_FDC_type_CM_single_kph 42 0.0 255.0 AXIS_PTS_REF AVMC_VehHoldDecCtrlTime2_X_kph /end AXIS_DESCR
/end CHARACTERISTIC
/begin AXIS_PTS AVMC_VehHoldDecCtrlTime2_X_kph "" 0x0000 /* @ECU_Address@AVMC_VehHoldDecCtrlTime2_X_kph@ */ VVMC_VehHoldEnSpd_kph Lookup1D_X_FLOAT32_IEEE 0 SWC_FDC_type_CM_single_kph 42 0.0 255.0 /end AXIS_PTS
/begin CHARACTERISTIC MVMC_VehHoldDecCtrlTime_Y_s "" CURVE 0x0000 /* @ECU_Address@MVMC_VehHoldDecCtrlTime_Y_s@ */ Lookup1D_FLOAT32_IEEE 0 SWC_FDC_type_CM_single_s 0.1 10.0
 /begin AXIS_DESCR COM_AXIS VVMC_VehHoldEnSpd_kph SWC_FDC_type_CM_single_kph 42 0.0 255.0 AXIS_PTS_REF AVMC_VehHoldDecCtrlTime_X_kph /end AXIS_DESCR
/end CHARACTERISTIC
/begin AXIS_PTS AVMC_VehHoldDecCtrlTime_X_kph "" 0x0000 /* @ECU_Address@AVMC_VehHoldDecCtrlTime_X_kph@ */ VVMC_VehHoldEnSpd_kph Lookup1D_X_FLOAT32_IEEE 0 SWC_FDC_type_CM_single_kph 42 0.0 255.0 /end AXIS_PTS
/begin CHARACTERISTIC MVMC_VehHoldMCPPass2_Y_bar "" CURVE 0x0000 /* @ECU_Address@MVMC_VehHoldMCPPass2_Y_bar@ */ Lookup1D_FLOAT32_IEEE 0 SWC_FDC_type_CM_single_bar 0.0 50.0
 /begin AXIS_DESCR COM_AXIS NO_INPUT_QUANTITY SWC_FDC_type_CM_single_deg 21 -50.0 50.0 AXIS_PTS_REF AVMC_VehHoldMCPPass2_X_deg /end AXIS_DESCR
/end CHARACTERISTIC
/begin AXIS_PTS AVMC_VehHoldMCPPass2_X_deg "" 0x0000 /* @ECU_Address@AVMC_VehHoldMCPPass2_X_deg@ */ NO_INPUT_QUANTITY Lookup1D_X_FLOAT32_IEEE 0 SWC_FDC_type_CM_single_deg 21 -50.0 50.0 /end AXIS_PTS
/begin CHARACTERISTIC MVMC_VehHoldMCPPass_Y_bar "" CURVE 0x0000 /* @ECU_Address@MVMC_VehHoldMCPPass_Y_bar@ */ Lookup1D_FLOAT32_IEEE 0 SWC_FDC_type_CM_single_bar 0.0 50.0
 /begin AXIS_DESCR COM_AXIS NO_INPUT_QUANTITY SWC_FDC_type_CM_single_deg 27 0.0 50.0 AXIS_PTS_REF AVMC_VehHoldMCPPass_X_deg /end AXIS_DESCR
/end CHARACTERISTIC
/begin AXIS_PTS AVMC_VehHoldMCPPass_X_deg "" 0x0000 /* @ECU_Address@AVMC_VehHoldMCPPass_X_deg@ */ NO_INPUT_QUANTITY Lookup1D_X_FLOAT32_IEEE 0 SWC_FDC_type_CM_single_deg 27 0.0 50.0 /end AXIS_PTS
/begin CHARACTERISTIC MVMC_VehPitchAngleSta_Z_enum "" MAP 0x0000 /* @ECU_Address@MVMC_VehPitchAngleSta_Z_enum@ */ Lookup2D_UBYTE 0 SWC_FDC_type_CM_uint8_enum 0.0 6.0
 /begin AXIS_DESCR COM_AXIS VVMC_VehPitchAngleEst_deg SWC_FDC_type_CM_single_deg 13 -10.0 10.0 AXIS_PTS_REF AVMC_VehPitchAngleSta_X_deg /end AXIS_DESCR
 /begin AXIS_DESCR COM_AXIS NO_INPUT_QUANTITY SWC_FDC_type_CM_single_deg 11 -10.0 10.0 AXIS_PTS_REF AVMC_VehPitchAngleSta_Y_deg /end AXIS_DESCR
/end CHARACTERISTIC
/begin AXIS_PTS AVMC_VehPitchAngleSta_Y_deg "" 0x0000 /* @ECU_Address@AVMC_VehPitchAngleSta_Y_deg@ */ NO_INPUT_QUANTITY Lookup2D_X_FLOAT32_IEEE 0 SWC_FDC_type_CM_single_deg 11 -10.0 10.0 /end AXIS_PTS
/begin AXIS_PTS AVMC_VehPitchAngleSta_X_deg "" 0x0000 /* @ECU_Address@AVMC_VehPitchAngleSta_X_deg@ */ VVMC_VehPitchAngleEst_deg Lookup2D_X_FLOAT32_IEEE 0 SWC_FDC_type_CM_single_deg 13 -10.0 10.0 /end AXIS_PTS
/begin CHARACTERISTIC MVMC_OPDDisSlideRate_Y_pct "" CURVE 0x0000 /* @ECU_Address@MVMC_OPDDisSlideRate_Y_pct@ */ Lookup1D_FLOAT32_IEEE 0 SWC_FDC_type_CM_single_pct -10.0 125.0
 /begin AXIS_DESCR COM_AXIS VVMC_EstSlope_Deg SWC_FDC_type_CM_single_Deg 8 -180.0 18.0 AXIS_PTS_REF AVMC_OPDDisSlideRate_X_Deg /end AXIS_DESCR
/end CHARACTERISTIC
/begin AXIS_PTS AVMC_OPDDisSlideRate_X_Deg "" 0x0000 /* @ECU_Address@AVMC_OPDDisSlideRate_X_Deg@ */ VVMC_EstSlope_Deg Lookup1D_X_FLOAT32_IEEE 0 SWC_FDC_type_CM_single_Deg 8 -180.0 18.0 /end AXIS_PTS
/begin CHARACTERISTIC MVMC_AggressJerkPCT4AT_Y_pct "" CURVE 0x0000 /* @ECU_Address@MVMC_AggressJerkPCT4AT_Y_pct@ */ Lookup1D_FLOAT32_IEEE 0 SWC_FDC_type_CM_single_pct 0.0 100.0
 /begin AXIS_DESCR COM_AXIS VVMC_MeterIndSpeedForCalcu_kph SWC_FDC_type_CM_single_kph 17 0.0 255.0 AXIS_PTS_REF AVMC_AggressJerkPCT4AT_X_kph /end AXIS_DESCR
/end CHARACTERISTIC
/begin AXIS_PTS AVMC_AggressJerkPCT4AT_X_kph "" 0x0000 /* @ECU_Address@AVMC_AggressJerkPCT4AT_X_kph@ */ VVMC_MeterIndSpeedForCalcu_kph Lookup1D_X_FLOAT32_IEEE 0 SWC_FDC_type_CM_single_kph 17 0.0 255.0 /end AXIS_PTS
/begin CHARACTERISTIC MVMC_AggressJerkPCT_Y_pct "" CURVE 0x0000 /* @ECU_Address@MVMC_AggressJerkPCT_Y_pct@ */ Lookup1D_FLOAT32_IEEE 0 SWC_FDC_type_CM_single_pct 0.0 100.0
 /begin AXIS_DESCR COM_AXIS VVMC_MeterIndSpeedForCalcu_kph SWC_FDC_type_CM_single_kph 17 0.0 255.0 AXIS_PTS_REF AVMC_AggressJerkPCT_X_kph /end AXIS_DESCR
/end CHARACTERISTIC
/begin AXIS_PTS AVMC_AggressJerkPCT_X_kph "" 0x0000 /* @ECU_Address@AVMC_AggressJerkPCT_X_kph@ */ VVMC_MeterIndSpeedForCalcu_kph Lookup1D_X_FLOAT32_IEEE 0 SWC_FDC_type_CM_single_kph 17 0.0 255.0 /end AXIS_PTS
/begin CHARACTERISTIC MVMC_AggressLimitPCT4AT_Y_pct "" CURVE 0x0000 /* @ECU_Address@MVMC_AggressLimitPCT4AT_Y_pct@ */ Lookup1D_FLOAT32_IEEE 0 SWC_FDC_type_CM_single_pct 0.0 100.0
 /begin AXIS_DESCR COM_AXIS NO_INPUT_QUANTITY SWC_FDC_type_CM_single_kph 17 0.0 255.0 AXIS_PTS_REF AVMC_AggressLimitPCT4AT_X_kph /end AXIS_DESCR
/end CHARACTERISTIC
/begin AXIS_PTS AVMC_AggressLimitPCT4AT_X_kph "" 0x0000 /* @ECU_Address@AVMC_AggressLimitPCT4AT_X_kph@ */ NO_INPUT_QUANTITY Lookup1D_X_FLOAT32_IEEE 0 SWC_FDC_type_CM_single_kph 17 0.0 255.0 /end AXIS_PTS
/begin CHARACTERISTIC MVMC_AggressLimitPCT_Y_pct "" CURVE 0x0000 /* @ECU_Address@MVMC_AggressLimitPCT_Y_pct@ */ Lookup1D_FLOAT32_IEEE 0 SWC_FDC_type_CM_single_pct 0.0 100.0
 /begin AXIS_DESCR COM_AXIS NO_INPUT_QUANTITY SWC_FDC_type_CM_single_kph 17 0.0 255.0 AXIS_PTS_REF AVMC_AggressLimitPCT_X_kph /end AXIS_DESCR
/end CHARACTERISTIC
/begin AXIS_PTS AVMC_AggressLimitPCT_X_kph "" 0x0000 /* @ECU_Address@AVMC_AggressLimitPCT_X_kph@ */ NO_INPUT_QUANTITY Lookup1D_X_FLOAT32_IEEE 0 SWC_FDC_type_CM_single_kph 17 0.0 255.0 /end AXIS_PTS
/begin CHARACTERISTIC MVMC_SoftJerkPCT_Y_pct "" CURVE 0x0000 /* @ECU_Address@MVMC_SoftJerkPCT_Y_pct@ */ Lookup1D_FLOAT32_IEEE 0 SWC_FDC_type_CM_single_pct 0.0 100.0
 /begin AXIS_DESCR COM_AXIS VVMC_MeterIndSpeedForCalcu_kph SWC_FDC_type_CM_single_kph 17 0.0 255.0 AXIS_PTS_REF AVMC_SoftJerkPCT_X_kph /end AXIS_DESCR
/end CHARACTERISTIC
/begin AXIS_PTS AVMC_SoftJerkPCT_X_kph "" 0x0000 /* @ECU_Address@AVMC_SoftJerkPCT_X_kph@ */ VVMC_MeterIndSpeedForCalcu_kph Lookup1D_X_FLOAT32_IEEE 0 SWC_FDC_type_CM_single_kph 17 0.0 255.0 /end AXIS_PTS
/begin CHARACTERISTIC MVMC_SoftLimitPCT_Y_pct "" CURVE 0x0000 /* @ECU_Address@MVMC_SoftLimitPCT_Y_pct@ */ Lookup1D_FLOAT32_IEEE 0 SWC_FDC_type_CM_single_pct 0.0 100.0
 /begin AXIS_DESCR COM_AXIS NO_INPUT_QUANTITY SWC_FDC_type_CM_single_kph 17 0.0 255.0 AXIS_PTS_REF AVMC_SoftLimitPCT_X_kph /end AXIS_DESCR
/end CHARACTERISTIC
/begin AXIS_PTS AVMC_SoftLimitPCT_X_kph "" 0x0000 /* @ECU_Address@AVMC_SoftLimitPCT_X_kph@ */ NO_INPUT_QUANTITY Lookup1D_X_FLOAT32_IEEE 0 SWC_FDC_type_CM_single_kph 17 0.0 255.0 /end AXIS_PTS
/begin CHARACTERISTIC MTHC_Qeq_Y_K "" CURVE 0x0000 /* @ECU_Address@MTHC_Qeq_Y_K@ */ Lookup1D_FLOAT32_IEEE 0 SWC_FDC_type_CM_single_K 0.0 500.0
 /begin AXIS_DESCR COM_AXIS NO_INPUT_QUANTITY SWC_FDC_type_CM_single_kmh 6 0.0 200.0 AXIS_PTS_REF ATHC_Qeq_X_kmh /end AXIS_DESCR
/end CHARACTERISTIC
/begin AXIS_PTS ATHC_Qeq_X_kmh "" 0x0000 /* @ECU_Address@ATHC_Qeq_X_kmh@ */ NO_INPUT_QUANTITY Lookup1D_X_FLOAT32_IEEE 0 SWC_FDC_type_CM_single_kmh 6 0.0 200.0 /end AXIS_PTS
/begin CHARACTERISTIC MTHC_VbaseH_Y_K "" CURVE 0x0000 /* @ECU_Address@MTHC_VbaseH_Y_K@ */ Lookup1D_FLOAT32_IEEE 0 SWC_FDC_type_CM_single_K 0.0 1.0
 /begin AXIS_DESCR COM_AXIS NO_INPUT_QUANTITY SWC_FDC_type_CM_single_C 8 -40.0 85.0 AXIS_PTS_REF ATHC_VbaseH_X_C /end AXIS_DESCR
/end CHARACTERISTIC
/begin AXIS_PTS ATHC_VbaseH_X_C "" 0x0000 /* @ECU_Address@ATHC_VbaseH_X_C@ */ NO_INPUT_QUANTITY Lookup1D_X_FLOAT32_IEEE 0 SWC_FDC_type_CM_single_C 8 -40.0 85.0 /end AXIS_PTS
/begin CHARACTERISTIC MTHC_VbaseD_Y_K "" CURVE 0x0000 /* @ECU_Address@MTHC_VbaseD_Y_K@ */ Lookup1D_FLOAT32_IEEE 0 SWC_FDC_type_CM_single_K 0.0 1.0
 /begin AXIS_DESCR COM_AXIS NO_INPUT_QUANTITY SWC_FDC_type_CM_single_C 8 -40.0 85.0 AXIS_PTS_REF ATHC_VbaseD_X_C /end AXIS_DESCR
/end CHARACTERISTIC
/begin AXIS_PTS ATHC_VbaseD_X_C "" 0x0000 /* @ECU_Address@ATHC_VbaseD_X_C@ */ NO_INPUT_QUANTITY Lookup1D_X_FLOAT32_IEEE 0 SWC_FDC_type_CM_single_C 8 -40.0 85.0 /end AXIS_PTS
/begin CHARACTERISTIC MTHC_VbaseC_Z_K "" MAP 0x0000 /* @ECU_Address@MTHC_VbaseC_Z_K@ */ Lookup2D_FLOAT32_IEEE 0 SWC_FDC_type_CM_single_K 0.0 1.0
 /begin AXIS_DESCR COM_AXIS NO_INPUT_QUANTITY SWC_FDC_type_CM_single_C 8 -40.0 85.0 AXIS_PTS_REF ATHC_VbaseC_X_C /end AXIS_DESCR
 /begin AXIS_DESCR COM_AXIS NO_INPUT_QUANTITY SWC_FDC_type_CM_single_W 8 0.0 10000.0 AXIS_PTS_REF ATHC_VbaseC_Y_W /end AXIS_DESCR
/end CHARACTERISTIC
/begin AXIS_PTS ATHC_VbaseC_Y_W "" 0x0000 /* @ECU_Address@ATHC_VbaseC_Y_W@ */ NO_INPUT_QUANTITY Lookup2D_X_FLOAT32_IEEE 0 SWC_FDC_type_CM_single_W 8 0.0 10000.0 /end AXIS_PTS
/begin AXIS_PTS ATHC_VbaseC_X_C "" 0x0000 /* @ECU_Address@ATHC_VbaseC_X_C@ */ NO_INPUT_QUANTITY Lookup2D_X_FLOAT32_IEEE 0 SWC_FDC_type_CM_single_C 8 -40.0 85.0 /end AXIS_PTS
/begin CHARACTERISTIC MTQD_EstInitVehWeight_Y_kg "" CURVE 0x0000 /* @ECU_Address@MTQD_EstInitVehWeight_Y_kg@ */ Lookup1D_FLOAT32_IEEE 0 SWC_FDC_type_CM_single_kg 0.0 5000.0
 /begin AXIS_DESCR COM_AXIS NO_INPUT_QUANTITY SWC_FDC_type_CM_single_c 10 0.0 10.0 AXIS_PTS_REF ATQD_EstInitVehWeight_X_c /end AXIS_DESCR
/end CHARACTERISTIC
/begin AXIS_PTS ATQD_EstInitVehWeight_X_c "" 0x0000 /* @ECU_Address@ATQD_EstInitVehWeight_X_c@ */ NO_INPUT_QUANTITY Lookup1D_X_FLOAT32_IEEE 0 SWC_FDC_type_CM_single_c 10 0.0 10.0 /end AXIS_PTS
/begin CHARACTERISTIC KTHC_DTymin1_K "" VALUE 0x0000 /* @ECU_Address@KTHC_DTymin1_K@ */ Scalar_FLOAT32_IEEE 0 SWC_FDC_type_CM_single_K 0.0 10.0 /end CHARACTERISTIC
/begin CHARACTERISTIC KTHC_DTymin2_K "" VALUE 0x0000 /* @ECU_Address@KTHC_DTymin2_K@ */ Scalar_FLOAT32_IEEE 0 SWC_FDC_type_CM_single_K 0.0 10.0 /end CHARACTERISTIC
/begin CHARACTERISTIC KTHC_DTymin3_K "" VALUE 0x0000 /* @ECU_Address@KTHC_DTymin3_K@ */ Scalar_FLOAT32_IEEE 0 SWC_FDC_type_CM_single_K 0.0 10.0 /end CHARACTERISTIC
/begin CHARACTERISTIC KTHC_DTymin4_K "" VALUE 0x0000 /* @ECU_Address@KTHC_DTymin4_K@ */ Scalar_FLOAT32_IEEE 0 SWC_FDC_type_CM_single_K 0.0 10.0 /end CHARACTERISTIC
/begin CHARACTERISTIC KTHC_DTymin5_K "" VALUE 0x0000 /* @ECU_Address@KTHC_DTymin5_K@ */ Scalar_FLOAT32_IEEE 0 SWC_FDC_type_CM_single_K 0.0 10.0 /end CHARACTERISTIC
/begin CHARACTERISTIC KTHC_T1Maxamb_C "" VALUE 0x0000 /* @ECU_Address@KTHC_T1Maxamb_C@ */ Scalar_FLOAT32_IEEE 0 SWC_FDC_type_CM_single_C -40.0 200.0 /end CHARACTERISTIC
/begin CHARACTERISTIC KTHC_T1winSetpointBC_C "" VALUE 0x0000 /* @ECU_Address@KTHC_T1winSetpointBC_C@ */ Scalar_FLOAT32_IEEE 0 SWC_FDC_type_CM_single_C -40.0 200.0 /end CHARACTERISTIC
/begin CHARACTERISTIC KTHC_T2Maxamb_C "" VALUE 0x0000 /* @ECU_Address@KTHC_T2Maxamb_C@ */ Scalar_FLOAT32_IEEE 0 SWC_FDC_type_CM_single_C -40.0 200.0 /end CHARACTERISTIC
/begin CHARACTERISTIC KTHC_T2Minamb_C "" VALUE 0x0000 /* @ECU_Address@KTHC_T2Minamb_C@ */ Scalar_FLOAT32_IEEE 0 SWC_FDC_type_CM_single_C -40.0 200.0 /end CHARACTERISTIC
/begin CHARACTERISTIC KTHC_T2winSetpointBC_C "" VALUE 0x0000 /* @ECU_Address@KTHC_T2winSetpointBC_C@ */ Scalar_FLOAT32_IEEE 0 SWC_FDC_type_CM_single_C -40.0 200.0 /end CHARACTERISTIC
/begin CHARACTERISTIC KTHC_T3Maxamb_C "" VALUE 0x0000 /* @ECU_Address@KTHC_T3Maxamb_C@ */ Scalar_FLOAT32_IEEE 0 SWC_FDC_type_CM_single_C -40.0 200.0 /end CHARACTERISTIC
/begin CHARACTERISTIC KTHC_T3Minamb_C "" VALUE 0x0000 /* @ECU_Address@KTHC_T3Minamb_C@ */ Scalar_FLOAT32_IEEE 0 SWC_FDC_type_CM_single_C -40.0 200.0 /end CHARACTERISTIC
/begin CHARACTERISTIC KTHC_T4Maxamb_C "" VALUE 0x0000 /* @ECU_Address@KTHC_T4Maxamb_C@ */ Scalar_FLOAT32_IEEE 0 SWC_FDC_type_CM_single_C -40.0 200.0 /end CHARACTERISTIC
/begin CHARACTERISTIC KTHC_T4Minamb_C "" VALUE 0x0000 /* @ECU_Address@KTHC_T4Minamb_C@ */ Scalar_FLOAT32_IEEE 0 SWC_FDC_type_CM_single_C -40.0 200.0 /end CHARACTERISTIC
/begin CHARACTERISTIC KTHC_T4winSetpointBC_C "" VALUE 0x0000 /* @ECU_Address@KTHC_T4winSetpointBC_C@ */ Scalar_FLOAT32_IEEE 0 SWC_FDC_type_CM_single_C -40.0 200.0 /end CHARACTERISTIC
/begin CHARACTERISTIC KTHC_T5Minamb_C "" VALUE 0x0000 /* @ECU_Address@KTHC_T5Minamb_C@ */ Scalar_FLOAT32_IEEE 0 SWC_FDC_type_CM_single_C -40.0 200.0 /end CHARACTERISTIC
/begin CHARACTERISTIC KTHC_T5winSetpointBC_C "" VALUE 0x0000 /* @ECU_Address@KTHC_T5winSetpointBC_C@ */ Scalar_FLOAT32_IEEE 0 SWC_FDC_type_CM_single_C -40.0 200.0 /end CHARACTERISTIC
/begin CHARACTERISTIC KTHC_Tambmin_C "" VALUE 0x0000 /* @ECU_Address@KTHC_Tambmin_C@ */ Scalar_FLOAT32_IEEE 0 SWC_FDC_type_CM_single_C -40.0 200.0 /end CHARACTERISTIC
/begin CHARACTERISTIC KTHC_VBlowerMid_K "" VALUE 0x0000 /* @ECU_Address@KTHC_VBlowerMid_K@ */ Scalar_FLOAT32_IEEE 0 SWC_FDC_type_CM_single_K 0.0 1.0 /end CHARACTERISTIC
/begin CHARACTERISTIC KTHC_VBlowerSetLow_K "" VALUE 0x0000 /* @ECU_Address@KTHC_VBlowerSetLow_K@ */ Scalar_FLOAT32_IEEE 0 SWC_FDC_type_CM_single_K 0.0 1.0 /end CHARACTERISTIC
/begin CHARACTERISTIC KTHC_VBlowerdfog_K "" VALUE 0x0000 /* @ECU_Address@KTHC_VBlowerdfog_K@ */ Scalar_FLOAT32_IEEE 0 SWC_FDC_type_CM_single_K 0.0 1.0 /end CHARACTERISTIC
/begin CHARACTERISTIC KTPM_DataInVehSpdThreshold_kph "" VALUE 0x0000 /* @ECU_Address@KTPM_DataInVehSpdThreshold_kph@ */ Scalar_FLOAT32_IEEE 0 SWC_FDC_type_CM_single_kph 0.0 255.0 /end CHARACTERISTIC
/begin CHARACTERISTIC KTQD_DrivProtEnToNTq_Nm "" VALUE 0x0000 /* @ECU_Address@KTQD_DrivProtEnToNTq_Nm@ */ Scalar_FLOAT32_IEEE 0 SWC_FDC_type_CM_single_Nm -100.0 500.0 /end CHARACTERISTIC
/begin CHARACTERISTIC KTQD_DriveProtDetTime_s "" VALUE 0x0000 /* @ECU_Address@KTQD_DriveProtDetTime_s@ */ Scalar_FLOAT32_IEEE 0 SWC_FDC_type_CM_single_s 0.0 3600.0 /end CHARACTERISTIC
/begin CHARACTERISTIC KTQD_EstDelayEnTime_s "" VALUE 0x0000 /* @ECU_Address@KTQD_EstDelayEnTime_s@ */ Scalar_FLOAT32_IEEE 0 SWC_FDC_type_CM_single_s 0.0 60.0 /end CHARACTERISTIC
/begin CHARACTERISTIC KTQD_EstEndDelayTime_s "" VALUE 0x0000 /* @ECU_Address@KTQD_EstEndDelayTime_s@ */ Scalar_FLOAT32_IEEE 0 SWC_FDC_type_CM_single_s 0.0 60.0 /end CHARACTERISTIC
/begin CHARACTERISTIC KTQD_EstWeighResetTime_s "" VALUE 0x0000 /* @ECU_Address@KTQD_EstWeighResetTime_s@ */ Scalar_FLOAT32_IEEE 0 SWC_FDC_type_CM_single_s 0.0 10000.0 /end CHARACTERISTIC
/begin CHARACTERISTIC KTQD_FrTqDeviation_Nm "" VALUE 0x0000 /* @ECU_Address@KTQD_FrTqDeviation_Nm@ */ Scalar_FLOAT32_IEEE 0 SWC_FDC_type_CM_single_Nm 0.0 500.0 /end CHARACTERISTIC
/begin CHARACTERISTIC KTQD_OPDHoldGradeDown_Deg "" VALUE 0x0000 /* @ECU_Address@KTQD_OPDHoldGradeDown_Deg@ */ Scalar_FLOAT32_IEEE 0 SWC_FDC_type_CM_single_Deg -180.0 180.0 /end CHARACTERISTIC
/begin CHARACTERISTIC KTQD_OPDHoldGradeUp_Deg "" VALUE 0x0000 /* @ECU_Address@KTQD_OPDHoldGradeUp_Deg@ */ Scalar_FLOAT32_IEEE 0 SWC_FDC_type_CM_single_Deg -180.0 180.0 /end CHARACTERISTIC
/begin CHARACTERISTIC KTQD_RegLongPLim_s "" VALUE 0x0000 /* @ECU_Address@KTQD_RegLongPLim_s@ */ Scalar_FLOAT32_IEEE 0 SWC_FDC_type_CM_single_s 0.0 10.0 /end CHARACTERISTIC
/begin CHARACTERISTIC KTQD_RegShortPLim_s "" VALUE 0x0000 /* @ECU_Address@KTQD_RegShortPLim_s@ */ Scalar_FLOAT32_IEEE 0 SWC_FDC_type_CM_single_s 0.0 10.0 /end CHARACTERISTIC
/begin CHARACTERISTIC KTQD_RrTqDeviation_Nm "" VALUE 0x0000 /* @ECU_Address@KTQD_RrTqDeviation_Nm@ */ Scalar_FLOAT32_IEEE 0 SWC_FDC_type_CM_single_Nm 0.0 500.0 /end CHARACTERISTIC
/begin CHARACTERISTIC KTQD_SpdCtrlModeChgHoldTime_s "" VALUE 0x0000 /* @ECU_Address@KTQD_SpdCtrlModeChgHoldTime_s@ */ Scalar_FLOAT32_IEEE 0 SWC_FDC_type_CM_single_s 0.0 10.0 /end CHARACTERISTIC
/begin CHARACTERISTIC KTQD_SpdModeLongPCancelLim_s "" VALUE 0x0000 /* @ECU_Address@KTQD_SpdModeLongPCancelLim_s@ */ Scalar_FLOAT32_IEEE 0 SWC_FDC_type_CM_single_s 0.0 10.0 /end CHARACTERISTIC
/begin CHARACTERISTIC KTQD_SpdModeLongPLim_s "" VALUE 0x0000 /* @ECU_Address@KTQD_SpdModeLongPLim_s@ */ Scalar_FLOAT32_IEEE 0 SWC_FDC_type_CM_single_s 0.0 10.0 /end CHARACTERISTIC
/begin CHARACTERISTIC KTQD_SpdModeShortPLim_s "" VALUE 0x0000 /* @ECU_Address@KTQD_SpdModeShortPLim_s@ */ Scalar_FLOAT32_IEEE 0 SWC_FDC_type_CM_single_s 0.0 10.0 /end CHARACTERISTIC
/begin CHARACTERISTIC KTQD_Veh2MetSpdAdd_kph "" VALUE 0x0000 /* @ECU_Address@KTQD_Veh2MetSpdAdd_kph@ */ Scalar_FLOAT32_IEEE 0 SWC_FDC_type_CM_single_kph 0.0 300.0 /end CHARACTERISTIC
/begin CHARACTERISTIC KTQD_Veh2MetSpdGain_c "" VALUE 0x0000 /* @ECU_Address@KTQD_Veh2MetSpdGain_c@ */ Scalar_FLOAT32_IEEE 0 SWC_FDC_type_CM_single_c 0.0 20.0 /end CHARACTERISTIC
/begin CHARACTERISTIC KTQD_VehWeighEstTime_s "" VALUE 0x0000 /* @ECU_Address@KTQD_VehWeighEstTime_s@ */ Scalar_FLOAT32_IEEE 0 SWC_FDC_type_CM_single_s 0.0 60.0 /end CHARACTERISTIC
/begin CHARACTERISTIC KTQD_VehWeightEstGradeEn_Deg "" VALUE 0x0000 /* @ECU_Address@KTQD_VehWeightEstGradeEn_Deg@ */ Scalar_FLOAT32_IEEE 0 SWC_FDC_type_CM_single_Deg 0.0 30.0 /end CHARACTERISTIC
/begin CHARACTERISTIC KTQD_VehWeightEstSpdEnLow_kph "" VALUE 0x0000 /* @ECU_Address@KTQD_VehWeightEstSpdEnLow_kph@ */ Scalar_FLOAT32_IEEE 0 SWC_FDC_type_CM_single_kph 0.0 300.0 /end CHARACTERISTIC
/begin CHARACTERISTIC KTQD_VehWeightEstSpdEnUp_kph "" VALUE 0x0000 /* @ECU_Address@KTQD_VehWeightEstSpdEnUp_kph@ */ Scalar_FLOAT32_IEEE 0 SWC_FDC_type_CM_single_kph 0.0 300.0 /end CHARACTERISTIC
/begin CHARACTERISTIC KVMC_4WhlSlideVehSpdDev_kph "" VALUE 0x0000 /* @ECU_Address@KVMC_4WhlSlideVehSpdDev_kph@ */ Scalar_FLOAT32_IEEE 0 SWC_FDC_type_CM_single_kph 0.0 300.0 /end CHARACTERISTIC
/begin CHARACTERISTIC KVMC_4WhleelSlideDetTime_s "" VALUE 0x0000 /* @ECU_Address@KVMC_4WhleelSlideDetTime_s@ */ Scalar_FLOAT32_IEEE 0 SWC_FDC_type_CM_single_s 0.0 3600.0 /end CHARACTERISTIC
/begin CHARACTERISTIC KVMC_ADSACCBRgnLimFr_Nm "" VALUE 0x0000 /* @ECU_Address@KVMC_ADSACCBRgnLimFr_Nm@ */ Scalar_FLOAT32_IEEE 0 SWC_FDC_type_CM_single_Nm -3000.0 3000.0 /end CHARACTERISTIC
/begin CHARACTERISTIC KVMC_ADSACCBRgnLimRr_Nm "" VALUE 0x0000 /* @ECU_Address@KVMC_ADSACCBRgnLimRr_Nm@ */ Scalar_FLOAT32_IEEE 0 SWC_FDC_type_CM_single_Nm -3000.0 3000.0 /end CHARACTERISTIC
/begin CHARACTERISTIC KVMC_ADSDecRspsRatio4RL_rat "" VALUE 0x0000 /* @ECU_Address@KVMC_ADSDecRspsRatio4RL_rat@ */ Scalar_FLOAT32_IEEE 0 SWC_FDC_type_CM_single_rat 0.1 1.0 /end CHARACTERISTIC
/begin CHARACTERISTIC KVMC_ADSDecRspsRatio_rat "" VALUE 0x0000 /* @ECU_Address@KVMC_ADSDecRspsRatio_rat@ */ Scalar_FLOAT32_IEEE 0 SWC_FDC_type_CM_single_rat 0.1 1.0 /end CHARACTERISTIC
/begin CHARACTERISTIC KVMC_ADSPosGFBDisMCP_bar "" VALUE 0x0000 /* @ECU_Address@KVMC_ADSPosGFBDisMCP_bar@ */ Scalar_FLOAT32_IEEE 0 SWC_FDC_type_CM_single_bar -1.0 50.0 /end CHARACTERISTIC
/begin CHARACTERISTIC KVMC_ADSPosGFBDisRgn_Nm "" VALUE 0x0000 /* @ECU_Address@KVMC_ADSPosGFBDisRgn_Nm@ */ Scalar_FLOAT32_IEEE 0 SWC_FDC_type_CM_single_Nm -100.0 0.0 /end CHARACTERISTIC
/begin CHARACTERISTIC KVMC_ADSPosGFBMCP_bar "" VALUE 0x0000 /* @ECU_Address@KVMC_ADSPosGFBMCP_bar@ */ Scalar_FLOAT32_IEEE 0 SWC_FDC_type_CM_single_bar -1.0 50.0 /end CHARACTERISTIC
/begin CHARACTERISTIC KVMC_ADSPosGFBPreventSpd_kph "" VALUE 0x0000 /* @ECU_Address@KVMC_ADSPosGFBPreventSpd_kph@ */ Scalar_FLOAT32_IEEE 0 SWC_FDC_type_CM_single_kph 0.0 100.0 /end CHARACTERISTIC
/begin CHARACTERISTIC KVMC_ADSPosGFBPrvtLoSpd_kph "" VALUE 0x0000 /* @ECU_Address@KVMC_ADSPosGFBPrvtLoSpd_kph@ */ Scalar_FLOAT32_IEEE 0 SWC_FDC_type_CM_single_kph 0.0 100.0 /end CHARACTERISTIC
/begin CHARACTERISTIC KVMC_ADSPosGFBRgn_Nm "" VALUE 0x0000 /* @ECU_Address@KVMC_ADSPosGFBRgn_Nm@ */ Scalar_FLOAT32_IEEE 0 SWC_FDC_type_CM_single_Nm -100.0 0.0 /end CHARACTERISTIC
/begin CHARACTERISTIC KVMC_AGSVReqAccel_mps2 "" VALUE 0x0000 /* @ECU_Address@KVMC_AGSVReqAccel_mps2@ */ Scalar_FLOAT32_IEEE 0 SWC_FDC_type_CM_single_mps2 -10.0 10.0 /end CHARACTERISTIC
/begin CHARACTERISTIC KVMC_AccTurnHoldMinDec_mps2 "" VALUE 0x0000 /* @ECU_Address@KVMC_AccTurnHoldMinDec_mps2@ */ Scalar_FLOAT32_IEEE 0 SWC_FDC_type_CM_single_mps2 -15.0 10.55 /end CHARACTERISTIC
/begin CHARACTERISTIC KVMC_AccelIGain_enum "" VALUE 0x0000 /* @ECU_Address@KVMC_AccelIGain_enum@ */ Scalar_FLOAT32_IEEE 0 SWC_FDC_type_CM_single_enum 0.0 1.0 /end CHARACTERISTIC
/begin CHARACTERISTIC KVMC_AltRDCActiveTq_Nm "" VALUE 0x0000 /* @ECU_Address@KVMC_AltRDCActiveTq_Nm@ */ Scalar_FLOAT32_IEEE 0 SWC_FDC_type_CM_single_Nm -100000.0 100000.0 /end CHARACTERISTIC
/begin CHARACTERISTIC KVMC_AltRDCRecTime_s "" VALUE 0x0000 /* @ECU_Address@KVMC_AltRDCRecTime_s@ */ Scalar_FLOAT32_IEEE 0 SWC_FDC_type_CM_single_s 0.0 7200.0 /end CHARACTERISTIC
/begin CHARACTERISTIC KVMC_AntiSpdLim_kph "" VALUE 0x0000 /* @ECU_Address@KVMC_AntiSpdLim_kph@ */ Scalar_FLOAT32_IEEE 0 SWC_FDC_type_CM_single_kph 0.0 100.0 /end CHARACTERISTIC
/begin CHARACTERISTIC KVMC_CalEstPitchAngleTs_raw32 "" VALUE 0x0000 /* @ECU_Address@KVMC_CalEstPitchAngleTs_raw32@ */ Scalar_FLOAT32_IEEE 0 SWC_FDC_type_CM_single_raw32 0.0 100.0 /end CHARACTERISTIC
/begin CHARACTERISTIC KVMC_CalEstSlopeOfst_c "" VALUE 0x0000 /* @ECU_Address@KVMC_CalEstSlopeOfst_c@ */ Scalar_FLOAT32_IEEE 0 SWC_FDC_type_CM_single_c 0.0 1.0 /end CHARACTERISTIC
/begin CHARACTERISTIC KVMC_CalWhleelSlideTs_c "" VALUE 0x0000 /* @ECU_Address@KVMC_CalWhleelSlideTs_c@ */ Scalar_FLOAT32_IEEE 0 SWC_FDC_type_CM_single_c 0.0 1.0 /end CHARACTERISTIC
/begin CHARACTERISTIC KVMC_CallBrkJoinSpd_kph "" VALUE 0x0000 /* @ECU_Address@KVMC_CallBrkJoinSpd_kph@ */ Scalar_FLOAT32_IEEE 0 SWC_FDC_type_CM_single_kph 0.0 300.0 /end CHARACTERISTIC
/begin CHARACTERISTIC KVMC_DISCAccCtrlLimit_mps2 "" VALUE 0x0000 /* @ECU_Address@KVMC_DISCAccCtrlLimit_mps2@ */ Scalar_FLOAT32_IEEE 0 SWC_FDC_type_CM_single_mps2 -10.0 10.0 /end CHARACTERISTIC
/begin CHARACTERISTIC KVMC_DISCDecCtrlJerk_mps3 "" VALUE 0x0000 /* @ECU_Address@KVMC_DISCDecCtrlJerk_mps3@ */ Scalar_FLOAT32_IEEE 0 SWC_FDC_type_CM_single_mps3 -10.0 10.0 /end CHARACTERISTIC
/begin CHARACTERISTIC KVMC_DISCDecCtrlLimit_mps2 "" VALUE 0x0000 /* @ECU_Address@KVMC_DISCDecCtrlLimit_mps2@ */ Scalar_FLOAT32_IEEE 0 SWC_FDC_type_CM_single_mps2 -10.0 10.0 /end CHARACTERISTIC
/begin CHARACTERISTIC KVMC_ESCRegenTqRecDelay_s "" VALUE 0x0000 /* @ECU_Address@KVMC_ESCRegenTqRecDelay_s@ */ Scalar_FLOAT32_IEEE 0 SWC_FDC_type_CM_single_s 0.0 7200.0 /end CHARACTERISTIC
/begin CHARACTERISTIC KVMC_EmgcHoldDecReq_mps2 "" VALUE 0x0000 /* @ECU_Address@KVMC_EmgcHoldDecReq_mps2@ */ Scalar_FLOAT32_IEEE 0 SWC_FDC_type_CM_single_mps2 -10.0 -0.5 /end CHARACTERISTIC
/begin CHARACTERISTIC KVMC_EmgcHoldSpd_kph "" VALUE 0x0000 /* @ECU_Address@KVMC_EmgcHoldSpd_kph@ */ Scalar_FLOAT32_IEEE 0 SWC_FDC_type_CM_single_kph 0.0 10.0 /end CHARACTERISTIC
/begin CHARACTERISTIC KVMC_FreezeStopGrade_kph "" VALUE 0x0000 /* @ECU_Address@KVMC_FreezeStopGrade_kph@ */ Scalar_FLOAT32_IEEE 0 SWC_FDC_type_CM_single_kph -5.0 10.0 /end CHARACTERISTIC
/begin CHARACTERISTIC KVMC_GradedelayTimer_s "" VALUE 0x0000 /* @ECU_Address@KVMC_GradedelayTimer_s@ */ Scalar_FLOAT32_IEEE 0 SWC_FDC_type_CM_single_s 0.01 10.0 /end CHARACTERISTIC
/begin CHARACTERISTIC KVMC_IMUGxFilter4ADB_raw32 "" VALUE 0x0000 /* @ECU_Address@KVMC_IMUGxFilter4ADB_raw32@ */ Scalar_FLOAT32_IEEE 0 SWC_FDC_type_CM_single_raw32 0.0 100.0 /end CHARACTERISTIC
/begin CHARACTERISTIC KVMC_IParm_enum "" VALUE 0x0000 /* @ECU_Address@KVMC_IParm_enum@ */ Scalar_FLOAT32_IEEE 0 SWC_FDC_type_CM_single_enum 0.0 1.0 /end CHARACTERISTIC
/begin CHARACTERISTIC KVMC_LoSpdCallBrkDec_mps2 "" VALUE 0x0000 /* @ECU_Address@KVMC_LoSpdCallBrkDec_mps2@ */ Scalar_FLOAT32_IEEE 0 SWC_FDC_type_CM_single_mps2 -10.0 10.0 /end CHARACTERISTIC
/begin CHARACTERISTIC KVMC_LongAccelDiffTime_s "" VALUE 0x0000 /* @ECU_Address@KVMC_LongAccelDiffTime_s@ */ Scalar_FLOAT32_IEEE 0 SWC_FDC_type_CM_single_s 0.0 1.0 /end CHARACTERISTIC
/begin CHARACTERISTIC KVMC_MCPPassHoldDecTime_s "" VALUE 0x0000 /* @ECU_Address@KVMC_MCPPassHoldDecTime_s@ */ Scalar_FLOAT32_IEEE 0 SWC_FDC_type_CM_single_sec 0.0 10.0 /end CHARACTERISTIC
/begin CHARACTERISTIC KVMC_MSAEnCtrlTargetAcc_mps2 "" VALUE 0x0000 /* @ECU_Address@KVMC_MSAEnCtrlTargetAcc_mps2@ */ Scalar_FLOAT32_IEEE 0 SWC_FDC_type_CM_single_mps2 0.0 10.0 /end CHARACTERISTIC
/begin CHARACTERISTIC KVMC_MSAOvrdDetTime_s "" VALUE 0x0000 /* @ECU_Address@KVMC_MSAOvrdDetTime_s@ */ Scalar_FLOAT32_IEEE 0 SWC_FDC_type_CM_single_s 0.0 10.0 /end CHARACTERISTIC
/begin CHARACTERISTIC KVMC_MSAOvrdJudgeSpd_kph "" VALUE 0x0000 /* @ECU_Address@KVMC_MSAOvrdJudgeSpd_kph@ */ Scalar_FLOAT32_IEEE 0 SWC_FDC_type_CM_single_kph 0.0 250.0 /end CHARACTERISTIC
/begin CHARACTERISTIC KVMC_MSAOvrdResAPSPosn_pct "" VALUE 0x0000 /* @ECU_Address@KVMC_MSAOvrdResAPSPosn_pct@ */ Scalar_FLOAT32_IEEE 0 SWC_FDC_type_CM_single_pct 0.0 100.0 /end CHARACTERISTIC
/begin CHARACTERISTIC KVMC_MSAOvrdResumeTime_s "" VALUE 0x0000 /* @ECU_Address@KVMC_MSAOvrdResumeTime_s@ */ Scalar_FLOAT32_IEEE 0 SWC_FDC_type_CM_single_s 0.0 10.0 /end CHARACTERISTIC
/begin CHARACTERISTIC KVMC_MSAOvrdTqRampSlope_Nmps "" VALUE 0x0000 /* @ECU_Address@KVMC_MSAOvrdTqRampSlope_Nmps@ */ Scalar_FLOAT32_IEEE 0 SWC_FDC_type_CM_single_Nmps -3000.0 3000.0 /end CHARACTERISTIC
/begin CHARACTERISTIC KVMC_MSASpdDevLowLim_kph "" VALUE 0x0000 /* @ECU_Address@KVMC_MSASpdDevLowLim_kph@ */ Scalar_FLOAT32_IEEE 0 SWC_FDC_type_CM_single_kph -100.0 0.0 /end CHARACTERISTIC
/begin CHARACTERISTIC KVMC_MSASpdDevUpLim_kph "" VALUE 0x0000 /* @ECU_Address@KVMC_MSASpdDevUpLim_kph@ */ Scalar_FLOAT32_IEEE 0 SWC_FDC_type_CM_single_kph 0.0 100.0 /end CHARACTERISTIC
/begin CHARACTERISTIC KVMC_MSATqDownEndTqRatio_pct "" VALUE 0x0000 /* @ECU_Address@KVMC_MSATqDownEndTqRatio_pct@ */ Scalar_FLOAT32_IEEE 0 SWC_FDC_type_CM_single_pct 0.1 1.0 /end CHARACTERISTIC
/begin CHARACTERISTIC KVMC_MSATqLowLim_Nm "" VALUE 0x0000 /* @ECU_Address@KVMC_MSATqLowLim_Nm@ */ Scalar_FLOAT32_IEEE 0 SWC_FDC_type_CM_single_Nm -15000.0 15000.0 /end CHARACTERISTIC
/begin CHARACTERISTIC KVMC_MSATqUpLim_Nm "" VALUE 0x0000 /* @ECU_Address@KVMC_MSATqUpLim_Nm@ */ Scalar_FLOAT32_IEEE 0 SWC_FDC_type_CM_single_Nm -15000.0 15000.0 /end CHARACTERISTIC
/begin CHARACTERISTIC KVMC_OPDDisSlideRateSpd_kph "" VALUE 0x0000 /* @ECU_Address@KVMC_OPDDisSlideRateSpd_kph@ */ Scalar_FLOAT32_IEEE 0 SWC_FDC_type_CM_single_kph -300.0 300.0 /end CHARACTERISTIC
/begin CHARACTERISTIC KVMC_PParm_enum "" VALUE 0x0000 /* @ECU_Address@KVMC_PParm_enum@ */ Scalar_FLOAT32_IEEE 0 SWC_FDC_type_CM_single_enum 0.0 1.0 /end CHARACTERISTIC
/begin CHARACTERISTIC KVMC_PitchAccGlow_mps2 "" VALUE 0x0000 /* @ECU_Address@KVMC_PitchAccGlow_mps2@ */ Scalar_FLOAT32_IEEE 0 SWC_FDC_type_CM_single_mps2 -10.0 10.0 /end CHARACTERISTIC
/begin CHARACTERISTIC KVMC_PitchAccGup_mps2 "" VALUE 0x0000 /* @ECU_Address@KVMC_PitchAccGup_mps2@ */ Scalar_FLOAT32_IEEE 0 SWC_FDC_type_CM_single_mps2 -10.0 10.0 /end CHARACTERISTIC
/begin CHARACTERISTIC KVMC_PitchBPSThres_pct "" VALUE 0x0000 /* @ECU_Address@KVMC_PitchBPSThres_pct@ */ Scalar_FLOAT32_IEEE 0 SWC_FDC_type_CM_single_pct 0.0 105.0 /end CHARACTERISTIC
/begin CHARACTERISTIC KVMC_PitchVehThres_kph "" VALUE 0x0000 /* @ECU_Address@KVMC_PitchVehThres_kph@ */ Scalar_FLOAT32_IEEE 0 SWC_FDC_type_CM_single_kph -5.0 10.0 /end CHARACTERISTIC
/begin CHARACTERISTIC KVMC_RawWhlSpeedDeadZone_kph "" VALUE 0x0000 /* @ECU_Address@KVMC_RawWhlSpeedDeadZone_kph@ */ Scalar_FLOAT32_IEEE 0 SWC_FDC_type_CM_single_kph 0.0 300.0 /end CHARACTERISTIC
/begin CHARACTERISTIC KVMC_ReachSpeedCountTime_s "" VALUE 0x0000 /* @ECU_Address@KVMC_ReachSpeedCountTime_s@ */ Scalar_FLOAT32_IEEE 0 SWC_FDC_type_CM_single_s 0.0 10.0 /end CHARACTERISTIC
/begin CHARACTERISTIC KVMC_ReqAccelLowerLimit_mps2 "" VALUE 0x0000 /* @ECU_Address@KVMC_ReqAccelLowerLimit_mps2@ */ Scalar_FLOAT32_IEEE 0 SWC_FDC_type_CM_single_mps2 -10.0 10.0 /end CHARACTERISTIC
/begin CHARACTERISTIC KVMC_ReqBrkJoinWaitTime_s "" VALUE 0x0000 /* @ECU_Address@KVMC_ReqBrkJoinWaitTime_s@ */ Scalar_FLOAT32_IEEE 0 SWC_FDC_type_CM_single_s 0.0 10.0 /end CHARACTERISTIC
/begin CHARACTERISTIC KVMC_ReqDecelLowerLimit_mps2 "" VALUE 0x0000 /* @ECU_Address@KVMC_ReqDecelLowerLimit_mps2@ */ Scalar_FLOAT32_IEEE 0 SWC_FDC_type_CM_single_mps2 -10.0 10.0 /end CHARACTERISTIC
/begin CHARACTERISTIC KVMC_RollAveEnTime_s "" VALUE 0x0000 /* @ECU_Address@KVMC_RollAveEnTime_s@ */ Scalar_FLOAT32_IEEE 0 SWC_FDC_type_CM_single_sec 0.0 10.0 /end CHARACTERISTIC
/begin CHARACTERISTIC KVMC_SafetyCtrlAllowTime_s "" VALUE 0x0000 /* @ECU_Address@KVMC_SafetyCtrlAllowTime_s@ */ Scalar_FLOAT32_IEEE 0 SWC_FDC_type_CM_single_sec 0.0 10.0 /end CHARACTERISTIC
/begin CHARACTERISTIC KVMC_SmartEcoLimitSpd_kph "" VALUE 0x0000 /* @ECU_Address@KVMC_SmartEcoLimitSpd_kph@ */ Scalar_FLOAT32_IEEE 0 SWC_FDC_type_CM_single_kph -300.0 300.0 /end CHARACTERISTIC
/begin CHARACTERISTIC KVMC_SpdCtrlDisBand_kph "" VALUE 0x0000 /* @ECU_Address@KVMC_SpdCtrlDisBand_kph@ */ Scalar_FLOAT32_IEEE 0 SWC_FDC_type_CM_single_kph -10.0 10.0 /end CHARACTERISTIC
/begin CHARACTERISTIC KVMC_SpdCtrlEnBand_kph "" VALUE 0x0000 /* @ECU_Address@KVMC_SpdCtrlEnBand_kph@ */ Scalar_FLOAT32_IEEE 0 SWC_FDC_type_CM_single_kph -10.0 10.0 /end CHARACTERISTIC
/begin CHARACTERISTIC KVMC_SpdCtrlReqAccel_mps2 "" VALUE 0x0000 /* @ECU_Address@KVMC_SpdCtrlReqAccel_mps2@ */ Scalar_FLOAT32_IEEE 0 SWC_FDC_type_CM_single_mps2 -1.0 1.0 /end CHARACTERISTIC
/begin CHARACTERISTIC KVMC_TqAccelCtrlBand_mps2 "" VALUE 0x0000 /* @ECU_Address@KVMC_TqAccelCtrlBand_mps2@ */ Scalar_FLOAT32_IEEE 0 SWC_FDC_type_CM_single_mps2 -10.0 10.0 /end CHARACTERISTIC
/begin CHARACTERISTIC KVMC_VHBigDeltaAcc4ATH_mps2 "" VALUE 0x0000 /* @ECU_Address@KVMC_VHBigDeltaAcc4ATH_mps2@ */ Scalar_FLOAT32_IEEE 0 SWC_FDC_type_CM_single_mps2 -15.0 10.55 /end CHARACTERISTIC
/begin CHARACTERISTIC KVMC_VHDec4ADSGain_rat "" VALUE 0x0000 /* @ECU_Address@KVMC_VHDec4ADSGain_rat@ */ Scalar_FLOAT32_IEEE 0 SWC_FDC_type_CM_single_rat 0.0 5.0 /end CHARACTERISTIC
/begin CHARACTERISTIC KVMC_VHDecCtrlDecSR_mps3 "" VALUE 0x0000 /* @ECU_Address@KVMC_VHDecCtrlDecSR_mps3@ */ Scalar_FLOAT32_IEEE 0 SWC_FDC_type_CM_single_mps3 -10.0 10.0 /end CHARACTERISTIC
/begin CHARACTERISTIC KVMC_VHDecCtrlIncSR_mps3 "" VALUE 0x0000 /* @ECU_Address@KVMC_VHDecCtrlIncSR_mps3@ */ Scalar_FLOAT32_IEEE 0 SWC_FDC_type_CM_single_mps3 -10.0 10.0 /end CHARACTERISTIC
/begin CHARACTERISTIC KVMC_VHFixDecTarget_mps2 "" VALUE 0x0000 /* @ECU_Address@KVMC_VHFixDecTarget_mps2@ */ Scalar_FLOAT32_IEEE 0 SWC_FDC_type_CM_single_mps2 -10.0 10.0 /end CHARACTERISTIC
/begin CHARACTERISTIC KVMC_VHRrWhlSSWaitTime_s "" VALUE 0x0000 /* @ECU_Address@KVMC_VHRrWhlSSWaitTime_s@ */ Scalar_FLOAT32_IEEE 0 SWC_FDC_type_CM_single_s 0.0 1.0 /end CHARACTERISTIC
/begin CHARACTERISTIC KVMC_VHTMSpdPassThres_rpm "" VALUE 0x0000 /* @ECU_Address@KVMC_VHTMSpdPassThres_rpm@ */ Scalar_FLOAT32_IEEE 0 SWC_FDC_type_CM_single_rpm -100.0 100.0 /end CHARACTERISTIC
/begin CHARACTERISTIC KVMC_VHTMSpdPassTime_s "" VALUE 0x0000 /* @ECU_Address@KVMC_VHTMSpdPassTime_s@ */ Scalar_FLOAT32_IEEE 0 SWC_FDC_type_CM_single_s 0.0 5.0 /end CHARACTERISTIC
/begin CHARACTERISTIC KVMC_VHTMSpdThresLowerLim_rpm "" VALUE 0x0000 /* @ECU_Address@KVMC_VHTMSpdThresLowerLim_rpm@ */ Scalar_FLOAT32_IEEE 0 SWC_FDC_type_CM_single_rpm -100.0 100.0 /end CHARACTERISTIC
/begin CHARACTERISTIC KVMC_VehHoldCal1BigDeltaAcc_mps2 "" VALUE 0x0000 /* @ECU_Address@KVMC_VehHoldCal1BigDeltaAcc_mps2@ */ Scalar_FLOAT32_IEEE 0 SWC_FDC_type_CM_single_mps2 -15.0 10.55 /end CHARACTERISTIC
/begin CHARACTERISTIC KVMC_VehHoldDecCtrlBSlope4ATH_mps3 "" VALUE 0x0000 /* @ECU_Address@KVMC_VehHoldDecCtrlBSlope4ATH_mps3@ */ Scalar_FLOAT32_IEEE 0 SWC_FDC_type_CM_single_mps3 -5.0 0.0 /end CHARACTERISTIC
/begin CHARACTERISTIC KVMC_VehHoldDecCtrlBSlopeCal1_mps3 "" VALUE 0x0000 /* @ECU_Address@KVMC_VehHoldDecCtrlBSlopeCal1_mps3@ */ Scalar_FLOAT32_IEEE 0 SWC_FDC_type_CM_single_mps3 0.0 5.0 /end CHARACTERISTIC
/begin CHARACTERISTIC KVMC_VehHoldDecCtrlBSlopeInc_mps3 "" VALUE 0x0000 /* @ECU_Address@KVMC_VehHoldDecCtrlBSlopeInc_mps3@ */ Scalar_FLOAT32_IEEE 0 SWC_FDC_type_CM_single_mps3 -5.0 5.0 /end CHARACTERISTIC
/begin CHARACTERISTIC KVMC_VehHoldDecCtrlBSlope_mps3 "" VALUE 0x0000 /* @ECU_Address@KVMC_VehHoldDecCtrlBSlope_mps3@ */ Scalar_FLOAT32_IEEE 0 SWC_FDC_type_CM_single_mps3 -5.0 0.0 /end CHARACTERISTIC
/begin CHARACTERISTIC KVMC_VehHoldDelayMCP_bar "" VALUE 0x0000 /* @ECU_Address@KVMC_VehHoldDelayMCP_bar@ */ Scalar_FLOAT32_IEEE 0 SWC_FDC_type_CM_single_bar -1.0 50.0 /end CHARACTERISTIC
/begin CHARACTERISTIC KVMC_VehHoldDeltaAccDB_mps2 "" VALUE 0x0000 /* @ECU_Address@KVMC_VehHoldDeltaAccDB_mps2@ */ Scalar_FLOAT32_IEEE 0 SWC_FDC_type_CM_single_mps2 -15.0 10.55 /end CHARACTERISTIC
/begin CHARACTERISTIC KVMC_VehHoldDist_m "" VALUE 0x0000 /* @ECU_Address@KVMC_VehHoldDist_m@ */ Scalar_FLOAT32_IEEE 0 SWC_FDC_type_CM_single_m 1.0 10.0 /end CHARACTERISTIC
/begin CHARACTERISTIC KVMC_VehHoldHEndSpd_kph "" VALUE 0x0000 /* @ECU_Address@KVMC_VehHoldHEndSpd_kph@ */ Scalar_FLOAT32_IEEE 0 SWC_FDC_type_CM_single_kph 0.0 10.0 /end CHARACTERISTIC
/begin CHARACTERISTIC KVMC_VehHoldHTimeNoMCPCnt_s "" VALUE 0x0000 /* @ECU_Address@KVMC_VehHoldHTimeNoMCPCnt_s@ */ Scalar_FLOAT32_IEEE 0 SWC_FDC_type_CM_single_s 0.0 10.0 /end CHARACTERISTIC
/begin CHARACTERISTIC KVMC_VehHoldHTimeNoMCP_bar "" VALUE 0x0000 /* @ECU_Address@KVMC_VehHoldHTimeNoMCP_bar@ */ Scalar_FLOAT32_IEEE 0 SWC_FDC_type_CM_single_bar -1.0 50.0 /end CHARACTERISTIC
/begin CHARACTERISTIC KVMC_VehHoldHoldDecTime_s "" VALUE 0x0000 /* @ECU_Address@KVMC_VehHoldHoldDecTime_s@ */ Scalar_FLOAT32_IEEE 0 SWC_FDC_type_CM_single_sec 0.0 10.0 /end CHARACTERISTIC
/begin CHARACTERISTIC KVMC_VehPitchAngleMax_deg "" VALUE 0x0000 /* @ECU_Address@KVMC_VehPitchAngleMax_deg@ */ Scalar_FLOAT32_IEEE 0 SWC_FDC_type_CM_single_deg -10.0 10.0 /end CHARACTERISTIC
/begin CHARACTERISTIC KVMC_VehPitchAngleMin_deg "" VALUE 0x0000 /* @ECU_Address@KVMC_VehPitchAngleMin_deg@ */ Scalar_FLOAT32_IEEE 0 SWC_FDC_type_CM_single_deg -10.0 10.0 /end CHARACTERISTIC
/begin CHARACTERISTIC KVMC_VehSpdDecSRLim_kphps "" VALUE 0x0000 /* @ECU_Address@KVMC_VehSpdDecSRLim_kphps@ */ Scalar_FLOAT32_IEEE 0 SWC_FDC_type_CM_single_kphps -10000.0 10000.0 /end CHARACTERISTIC
/begin CHARACTERISTIC KVMC_VehSpdIncSRLim_kphps "" VALUE 0x0000 /* @ECU_Address@KVMC_VehSpdIncSRLim_kphps@ */ Scalar_FLOAT32_IEEE 0 SWC_FDC_type_CM_single_kphps -10000.0 10000.0 /end CHARACTERISTIC
/begin CHARACTERISTIC KVMC_VehStandstillSpd_kph "" VALUE 0x0000 /* @ECU_Address@KVMC_VehStandstillSpd_kph@ */ Scalar_FLOAT32_IEEE 0 SWC_FDC_type_CM_single_kph 0.0 10.0 /end CHARACTERISTIC
/begin CHARACTERISTIC KVMC_VehStandstillTimer_s "" VALUE 0x0000 /* @ECU_Address@KVMC_VehStandstillTimer_s@ */ Scalar_FLOAT32_IEEE 0 SWC_FDC_type_CM_single_s 0.0 20.0 /end CHARACTERISTIC
/begin CHARACTERISTIC KVMC_VehStopAPSThresLo_pct "" VALUE 0x0000 /* @ECU_Address@KVMC_VehStopAPSThresLo_pct@ */ Scalar_FLOAT32_IEEE 0 SWC_FDC_type_CM_single_pct 0.0 105.0 /end CHARACTERISTIC
/begin CHARACTERISTIC KVMC_VehStopDelay_s "" VALUE 0x0000 /* @ECU_Address@KVMC_VehStopDelay_s@ */ Scalar_FLOAT32_IEEE 0 SWC_FDC_type_CM_single_s 0.0 10.0 /end CHARACTERISTIC
/begin CHARACTERISTIC KVMC_VehStopThresHi_kph "" VALUE 0x0000 /* @ECU_Address@KVMC_VehStopThresHi_kph@ */ Scalar_FLOAT32_IEEE 0 SWC_FDC_type_CM_single_kph 0.0 30.0 /end CHARACTERISTIC
/begin CHARACTERISTIC KVMC_VehStopThresLo_kph "" VALUE 0x0000 /* @ECU_Address@KVMC_VehStopThresLo_kph@ */ Scalar_FLOAT32_IEEE 0 SWC_FDC_type_CM_single_kph 0.0 30.0 /end CHARACTERISTIC
/begin CHARACTERISTIC KVMC_VehStopThres_kph "" VALUE 0x0000 /* @ECU_Address@KVMC_VehStopThres_kph@ */ Scalar_FLOAT32_IEEE 0 SWC_FDC_type_CM_single_kph -30.0 30.0 /end CHARACTERISTIC
/begin CHARACTERISTIC KVMC_VehStopTqThres_Nm "" VALUE 0x0000 /* @ECU_Address@KVMC_VehStopTqThres_Nm@ */ Scalar_FLOAT32_IEEE 0 SWC_FDC_type_CM_single_Nm 0.0 500.0 /end CHARACTERISTIC
/begin CHARACTERISTIC KVMC_WhlSlideEnDetBrkPedal_pct "" VALUE 0x0000 /* @ECU_Address@KVMC_WhlSlideEnDetBrkPedal_pct@ */ Scalar_FLOAT32_IEEE 0 SWC_FDC_type_CM_single_pct 0.0 125.0 /end CHARACTERISTIC
/begin CHARACTERISTIC KVMC_WhlSlideEnDetTq_Nm "" VALUE 0x0000 /* @ECU_Address@KVMC_WhlSlideEnDetTq_Nm@ */ Scalar_FLOAT32_IEEE 0 SWC_FDC_type_CM_single_Nm -100000.0 100000.0 /end CHARACTERISTIC
/begin CHARACTERISTIC KVMC_WhlSlideEnDetVehSpd_kph "" VALUE 0x0000 /* @ECU_Address@KVMC_WhlSlideEnDetVehSpd_kph@ */ Scalar_FLOAT32_IEEE 0 SWC_FDC_type_CM_single_kph 0.0 300.0 /end CHARACTERISTIC
/begin CHARACTERISTIC KVMC_WhlStandstillReqTime_sec "" VALUE 0x0000 /* @ECU_Address@KVMC_WhlStandstillReqTime_sec@ */ Scalar_FLOAT32_IEEE 0 SWC_FDC_type_CM_single_sec 0.0 5.0 /end CHARACTERISTIC
/begin CHARACTERISTIC KTHC_APTCRiLeMaxDff_W "" VALUE 0x0000 /* @ECU_Address@KTHC_APTCRiLeMaxDff_W@ */ Scalar_SWORD 0 SWC_FDC_type_CM_int16_W 0.0 2200.0 /end CHARACTERISTIC
/begin CHARACTERISTIC KTHC_APTCRiLeMinDff_W "" VALUE 0x0000 /* @ECU_Address@KTHC_APTCRiLeMinDff_W@ */ Scalar_SWORD 0 SWC_FDC_type_CM_int16_W -2200.0 0.0 /end CHARACTERISTIC
/begin CHARACTERISTIC KTHC_APTCOneZoneMax_W "" VALUE 0x0000 /* @ECU_Address@KTHC_APTCOneZoneMax_W@ */ Scalar_UWORD 0 SWC_FDC_type_CM_uint16_W 0.0 6500.0 /end CHARACTERISTIC
/begin CHARACTERISTIC KTHC_APTCPeriod_cnt "" VALUE 0x0000 /* @ECU_Address@KTHC_APTCPeriod_cnt@ */ Scalar_UWORD 0 SWC_FDC_type_CM_uint16_cnt 0.0 65535.0 /end CHARACTERISTIC
/begin CHARACTERISTIC KTHC_EWPErrorT_cnt "" VALUE 0x0000 /* @ECU_Address@KTHC_EWPErrorT_cnt@ */ Scalar_UWORD 0 SWC_FDC_type_CM_uint16_cnt 0.0 65535.0 /end CHARACTERISTIC
/begin CHARACTERISTIC KTHC_EWPRetryWarnT_cnt "" VALUE 0x0000 /* @ECU_Address@KTHC_EWPRetryWarnT_cnt@ */ Scalar_UWORD 0 SWC_FDC_type_CM_uint16_cnt 0.0 65535.0 /end CHARACTERISTIC
/begin CHARACTERISTIC KTHC_EWPTotalRetryT_cnt "" VALUE 0x0000 /* @ECU_Address@KTHC_EWPTotalRetryT_cnt@ */ Scalar_UWORD 0 SWC_FDC_type_CM_uint16_cnt 0.0 65535.0 /end CHARACTERISTIC
/begin CHARACTERISTIC KTHC_EWPpauseT_cnt "" VALUE 0x0000 /* @ECU_Address@KTHC_EWPpauseT_cnt@ */ Scalar_UWORD 0 SWC_FDC_type_CM_uint16_cnt 0.0 65535.0 /end CHARACTERISTIC
/begin CHARACTERISTIC KTHC_EWPretryT_cnt "" VALUE 0x0000 /* @ECU_Address@KTHC_EWPretryT_cnt@ */ Scalar_UWORD 0 SWC_FDC_type_CM_uint16_cnt 0.0 65535.0 /end CHARACTERISTIC
/begin CHARACTERISTIC KTHC_EWPErrHandleEN_flg "" VALUE 0x0000 /* @ECU_Address@KTHC_EWPErrHandleEN_flg@ */ Scalar_BOOLEAN 0 SWC_FDC_type_CM_boolean_flg 0.0 1.0 /end CHARACTERISTIC
/begin CHARACTERISTIC KTQD_DrivProtEnSW_flg "" VALUE 0x0000 /* @ECU_Address@KTQD_DrivProtEnSW_flg@ */ Scalar_BOOLEAN 0 SWC_FDC_type_CM_boolean_flg 0.0 1.0 /end CHARACTERISTIC
/begin CHARACTERISTIC KTQD_SCPMemSpdTest_flg "" VALUE 0x0000 /* @ECU_Address@KTQD_SCPMemSpdTest_flg@ */ Scalar_BOOLEAN 0 SWC_FDC_type_CM_boolean 0.0 1.0 /end CHARACTERISTIC
/begin CHARACTERISTIC KTQD_SpdLimOffsetOn_flg "" VALUE 0x0000 /* @ECU_Address@KTQD_SpdLimOffsetOn_flg@ */ Scalar_BOOLEAN 0 SWC_FDC_type_CM_boolean_flg 0.0 1.0 /end CHARACTERISTIC
/begin CHARACTERISTIC KVMC_4WheelLongAccSW_flg "" VALUE 0x0000 /* @ECU_Address@KVMC_4WheelLongAccSW_flg@ */ Scalar_BOOLEAN 0 SWC_FDC_type_CM_boolean_flg 0.0 1.0 /end CHARACTERISTIC
/begin CHARACTERISTIC KVMC_ACCReqAccelGainSW_flg "" VALUE 0x0000 /* @ECU_Address@KVMC_ACCReqAccelGainSW_flg@ */ Scalar_BOOLEAN 0 SWC_FDC_type_CM_boolean_flg 0.0 1.0 /end CHARACTERISTIC
/begin CHARACTERISTIC KVMC_ACCSpdCtrlSW_flg "" VALUE 0x0000 /* @ECU_Address@KVMC_ACCSpdCtrlSW_flg@ */ Scalar_BOOLEAN 0 SWC_FDC_type_CM_boolean_flg 0.0 1.0 /end CHARACTERISTIC
/begin CHARACTERISTIC KVMC_ADSDecShiftSW_flg "" VALUE 0x0000 /* @ECU_Address@KVMC_ADSDecShiftSW_flg@ */ Scalar_BOOLEAN 0 SWC_FDC_type_CM_boolean_flg 0.0 1.0 /end CHARACTERISTIC
/begin CHARACTERISTIC KVMC_ADSPosGFBDisWoRgn_flg "" VALUE 0x0000 /* @ECU_Address@KVMC_ADSPosGFBDisWoRgn_flg@ */ Scalar_BOOLEAN 0 SWC_FDC_type_CM_boolean_flg 0.0 1.0 /end CHARACTERISTIC
/begin CHARACTERISTIC KVMC_ADSPosGFBPrevent_flg "" VALUE 0x0000 /* @ECU_Address@KVMC_ADSPosGFBPrevent_flg@ */ Scalar_BOOLEAN 0 SWC_FDC_type_CM_boolean_kph 0.0 1.0 /end CHARACTERISTIC
/begin CHARACTERISTIC KVMC_ADSPosGFBPrvtLoSpd_flg "" VALUE 0x0000 /* @ECU_Address@KVMC_ADSPosGFBPrvtLoSpd_flg@ */ Scalar_BOOLEAN 0 SWC_FDC_type_CM_boolean_flg 0.0 1.0 /end CHARACTERISTIC
/begin CHARACTERISTIC KVMC_AltRDCActiveSW_flg "" VALUE 0x0000 /* @ECU_Address@KVMC_AltRDCActiveSW_flg@ */ Scalar_BOOLEAN 0 SWC_FDC_type_CM_boolean_flg 0.0 1.0 /end CHARACTERISTIC
/begin CHARACTERISTIC KVMC_AltWheelSlideRateSW_flg "" VALUE 0x0000 /* @ECU_Address@KVMC_AltWheelSlideRateSW_flg@ */ Scalar_BOOLEAN 0 SWC_FDC_type_CM_boolean_flg 0.0 1.0 /end CHARACTERISTIC
/begin CHARACTERISTIC KVMC_AntiSpdLimSW_flg "" VALUE 0x0000 /* @ECU_Address@KVMC_AntiSpdLimSW_flg@ */ Scalar_BOOLEAN 0 SWC_FDC_type_CM_boolean_flg 0.0 1.0 /end CHARACTERISTIC
/begin CHARACTERISTIC KVMC_AvailRgnReachBGap_flg "" VALUE 0x0000 /* @ECU_Address@KVMC_AvailRgnReachBGap_flg@ */ Scalar_BOOLEAN 0 SWC_FDC_type_CM_boolean_flg 0.0 1.0 /end CHARACTERISTIC
/begin CHARACTERISTIC KVMC_CalEstSlopeOfstSW_flg "" VALUE 0x0000 /* @ECU_Address@KVMC_CalEstSlopeOfstSW_flg@ */ Scalar_BOOLEAN 0 SWC_FDC_type_CM_boolean_flg 0.0 1.0 /end CHARACTERISTIC
/begin CHARACTERISTIC KVMC_DISCDecNoBrk_flg "" VALUE 0x0000 /* @ECU_Address@KVMC_DISCDecNoBrk_flg@ */ Scalar_BOOLEAN 0 SWC_FDC_type_CM_boolean_flg 0.0 1.0 /end CHARACTERISTIC
/begin CHARACTERISTIC KVMC_EmgcHoldDecReqSW_flg "" VALUE 0x0000 /* @ECU_Address@KVMC_EmgcHoldDecReqSW_flg@ */ Scalar_BOOLEAN 0 SWC_FDC_type_CM_boolean_flg 0.0 1.0 /end CHARACTERISTIC
/begin CHARACTERISTIC KVMC_EstSlopeLongGSW_flg "" VALUE 0x0000 /* @ECU_Address@KVMC_EstSlopeLongGSW_flg@ */ Scalar_BOOLEAN 0 SWC_FDC_type_CM_boolean_flg 0.0 1.0 /end CHARACTERISTIC
/begin CHARACTERISTIC KVMC_EstSlopeSW_flg "" VALUE 0x0000 /* @ECU_Address@KVMC_EstSlopeSW_flg@ */ Scalar_BOOLEAN 0 SWC_FDC_type_CM_boolean_flg 0.0 1.0 /end CHARACTERISTIC
/begin CHARACTERISTIC KVMC_EstSlopeVehSourceSW_flg "" VALUE 0x0000 /* @ECU_Address@KVMC_EstSlopeVehSourceSW_flg@ */ Scalar_BOOLEAN 0 SWC_FDC_type_CM_boolean_flg 0.0 1.0 /end CHARACTERISTIC
/begin CHARACTERISTIC KVMC_GradedelaytestSW_flg "" VALUE 0x0000 /* @ECU_Address@KVMC_GradedelaytestSW_flg@ */ Scalar_BOOLEAN 0 SWC_FDC_type_CM_boolean_flg 0.0 1.0 /end CHARACTERISTIC
/begin CHARACTERISTIC KVMC_GyroBandSource_flg "" VALUE 0x0000 /* @ECU_Address@KVMC_GyroBandSource_flg@ */ Scalar_BOOLEAN 0 SWC_FDC_type_CM_boolean_flg 0.0 1.0 /end CHARACTERISTIC
/begin CHARACTERISTIC KVMC_MSAPGainSW_flg "" VALUE 0x0000 /* @ECU_Address@KVMC_MSAPGainSW_flg@ */ Scalar_BOOLEAN 0 SWC_FDC_type_CM_boolean_flg 0.0 1.0 /end CHARACTERISTIC
/begin CHARACTERISTIC KVMC_MSAResponseAGSV_flg "" VALUE 0x0000 /* @ECU_Address@KVMC_MSAResponseAGSV_flg@ */ Scalar_BOOLEAN 0 SWC_FDC_type_CM_boolean_flg 0.0 1.0 /end CHARACTERISTIC
/begin CHARACTERISTIC KVMC_OVRD2ActRampSW_flg "" VALUE 0x0000 /* @ECU_Address@KVMC_OVRD2ActRampSW_flg@ */ Scalar_BOOLEAN 0 SWC_FDC_type_CM_boolean_flg 0.0 1.0 /end CHARACTERISTIC
/begin CHARACTERISTIC KVMC_PitchGradeL2HSource_flg "" VALUE 0x0000 /* @ECU_Address@KVMC_PitchGradeL2HSource_flg@ */ Scalar_BOOLEAN 0 SWC_FDC_type_CM_boolean_flg 0.0 1.0 /end CHARACTERISTIC
/begin CHARACTERISTIC KVMC_PitchGradeReset_flg "" VALUE 0x0000 /* @ECU_Address@KVMC_PitchGradeReset_flg@ */ Scalar_BOOLEAN 0 SWC_FDC_type_CM_boolean_flg 0.0 1.0 /end CHARACTERISTIC
/begin CHARACTERISTIC KVMC_PitchGradeStopSource_flg "" VALUE 0x0000 /* @ECU_Address@KVMC_PitchGradeStopSource_flg@ */ Scalar_BOOLEAN 0 SWC_FDC_type_CM_boolean_flg 0.0 1.0 /end CHARACTERISTIC
/begin CHARACTERISTIC KVMC_ReachSpeedCount_flg "" VALUE 0x0000 /* @ECU_Address@KVMC_ReachSpeedCount_flg@ */ Scalar_BOOLEAN 0 SWC_FDC_type_CM_boolean_flg 0.0 1.0 /end CHARACTERISTIC
/begin CHARACTERISTIC KVMC_ReqBrkInDecSRAddDif_flg "" VALUE 0x0000 /* @ECU_Address@KVMC_ReqBrkInDecSRAddDif_flg@ */ Scalar_BOOLEAN 0 SWC_FDC_type_CM_boolean_flg 0.0 1.0 /end CHARACTERISTIC
/begin CHARACTERISTIC KVMC_ReqBrkInDecSW_flg "" VALUE 0x0000 /* @ECU_Address@KVMC_ReqBrkInDecSW_flg@ */ Scalar_BOOLEAN 0 SWC_FDC_type_CM_boolean_flg 0.0 1.0 /end CHARACTERISTIC
/begin CHARACTERISTIC KVMC_SPD2ACCLastAccelSourceSW_flg "" VALUE 0x0000 /* @ECU_Address@KVMC_SPD2ACCLastAccelSourceSW_flg@ */ Scalar_BOOLEAN 0 SWC_FDC_type_CM_boolean_flg 0.0 1.0 /end CHARACTERISTIC
/begin CHARACTERISTIC KVMC_SlopeCalSource_flg "" VALUE 0x0000 /* @ECU_Address@KVMC_SlopeCalSource_flg@ */ Scalar_BOOLEAN 0 SWC_FDC_type_CM_boolean_flg 0.0 1.0 /end CHARACTERISTIC
/begin CHARACTERISTIC KVMC_SlopeSourceTs_flg "" VALUE 0x0000 /* @ECU_Address@KVMC_SlopeSourceTs_flg@ */ Scalar_BOOLEAN 0 SWC_FDC_type_CM_boolean_flg 0.0 1.0 /end CHARACTERISTIC
/begin CHARACTERISTIC KVMC_SmartEcoPlusSW_flg "" VALUE 0x0000 /* @ECU_Address@KVMC_SmartEcoPlusSW_flg@ */ Scalar_BOOLEAN 0 SWC_FDC_type_CM_boolean_flg 0.0 1.0 /end CHARACTERISTIC
/begin CHARACTERISTIC KVMC_SprtAccelCMDSW_flg "" VALUE 0x0000 /* @ECU_Address@KVMC_SprtAccelCMDSW_flg@ */ Scalar_BOOLEAN 0 SWC_FDC_type_CM_boolean_flg 0.0 1.0 /end CHARACTERISTIC
/begin CHARACTERISTIC KVMC_StoploopGradeSource_flg "" VALUE 0x0000 /* @ECU_Address@KVMC_StoploopGradeSource_flg@ */ Scalar_BOOLEAN 0 SWC_FDC_type_CM_boolean_flg 0.0 1.0 /end CHARACTERISTIC
/begin CHARACTERISTIC KVMC_VHDecCtrlCalSW2IncSW_flg "" VALUE 0x0000 /* @ECU_Address@KVMC_VHDecCtrlCalSW2IncSW_flg@ */ Scalar_BOOLEAN 0 SWC_FDC_type_CM_boolean_flg 0.0 1.0 /end CHARACTERISTIC
/begin CHARACTERISTIC KVMC_VHDecTargetSW_flg "" VALUE 0x0000 /* @ECU_Address@KVMC_VHDecTargetSW_flg@ */ Scalar_BOOLEAN 0 SWC_FDC_type_CM_boolean_flg 0.0 1.0 /end CHARACTERISTIC
/begin CHARACTERISTIC KVMC_VHJerkPrvtDec_flg "" VALUE 0x0000 /* @ECU_Address@KVMC_VHJerkPrvtDec_flg@ */ Scalar_BOOLEAN 0 SWC_FDC_type_CM_boolean_flg 0.0 1.0 /end CHARACTERISTIC
/begin CHARACTERISTIC KVMC_VHJerkPrvtHoldDelay_flg "" VALUE 0x0000 /* @ECU_Address@KVMC_VHJerkPrvtHoldDelay_flg@ */ Scalar_BOOLEAN 0 SWC_FDC_type_CM_boolean_flg 0.0 1.0 /end CHARACTERISTIC
/begin CHARACTERISTIC KVMC_VehHoldDecCtrl_flg "" VALUE 0x0000 /* @ECU_Address@KVMC_VehHoldDecCtrl_flg@ */ Scalar_BOOLEAN 0 SWC_FDC_type_CM_boolean_flg 0.0 1.0 /end CHARACTERISTIC
/begin CHARACTERISTIC KVMC_VehHoldDelaySW_flg "" VALUE 0x0000 /* @ECU_Address@KVMC_VehHoldDelaySW_flg@ */ Scalar_BOOLEAN 0 SWC_FDC_type_CM_boolean_flg 0.0 1.0 /end CHARACTERISTIC
/begin CHARACTERISTIC KVMC_VehHoldHEndChkMCP_flg "" VALUE 0x0000 /* @ECU_Address@KVMC_VehHoldHEndChkMCP_flg@ */ Scalar_BOOLEAN 0 SWC_FDC_type_CM_boolean_flg 0.0 1.0 /end CHARACTERISTIC
/begin CHARACTERISTIC KVMC_VehRunSlope_flg "" VALUE 0x0000 /* @ECU_Address@KVMC_VehRunSlope_flg@ */ Scalar_BOOLEAN 0 SWC_FDC_type_CM_boolean_flg 0.0 1.0 /end CHARACTERISTIC
/begin CHARACTERISTIC KVMC_VehStopSource_flg "" VALUE 0x0000 /* @ECU_Address@KVMC_VehStopSource_flg@ */ Scalar_BOOLEAN 0 SWC_FDC_type_CM_boolean_flg 0.0 1.0 /end CHARACTERISTIC
/begin CHARACTERISTIC KTQD_ACCActiveMetSpdLoMPH_mph "" VALUE 0x0000 /* @ECU_Address@KTQD_ACCActiveMetSpdLoMPH_mph@ */ Scalar_UBYTE 0 SWC_FDC_type_CM_uint8_kph 0.0 250.0 /end CHARACTERISTIC
/begin CHARACTERISTIC KTQD_ACCActiveMetSpdLo_kph "" VALUE 0x0000 /* @ECU_Address@KTQD_ACCActiveMetSpdLo_kph@ */ Scalar_UBYTE 0 SWC_FDC_type_CM_uint8_kph 0.0 250.0 /end CHARACTERISTIC
/begin CHARACTERISTIC KTQD_MSAActiveMetSpdHiMPH_mph "" VALUE 0x0000 /* @ECU_Address@KTQD_MSAActiveMetSpdHiMPH_mph@ */ Scalar_UBYTE 0 SWC_FDC_type_CM_uint8_kph 0.0 250.0 /end CHARACTERISTIC
/begin CHARACTERISTIC KTQD_MSAActiveMetSpdHi_kph "" VALUE 0x0000 /* @ECU_Address@KTQD_MSAActiveMetSpdHi_kph@ */ Scalar_UBYTE 0 SWC_FDC_type_CM_uint8_kph 0.0 250.0 /end CHARACTERISTIC
/begin CHARACTERISTIC KTQD_MSAActiveMetSpdLoMPH_mph "" VALUE 0x0000 /* @ECU_Address@KTQD_MSAActiveMetSpdLoMPH_mph@ */ Scalar_UBYTE 0 SWC_FDC_type_CM_uint8_kph 0.0 250.0 /end CHARACTERISTIC
/begin CHARACTERISTIC KTQD_MSAActiveMetSpdLo_kph "" VALUE 0x0000 /* @ECU_Address@KTQD_MSAActiveMetSpdLo_kph@ */ Scalar_UBYTE 0 SWC_FDC_type_CM_uint8_kph 0.0 250.0 /end CHARACTERISTIC
/begin CHARACTERISTIC KTQD_SetSpdDeltaLongFit_kph "" VALUE 0x0000 /* @ECU_Address@KTQD_SetSpdDeltaLongFit_kph@ */ Scalar_UBYTE 0 SWC_FDC_type_CM_uint8_kph 0.0 255.0 /end CHARACTERISTIC
/begin CHARACTERISTIC KTQD_SmartEcoLimitSpd_kph "" VALUE 0x0000 /* @ECU_Address@KTQD_SmartEcoLimitSpd_kph@ */ Scalar_UBYTE 0 SWC_FDC_type_CM_uint8_kph 0.0 255.0 /end CHARACTERISTIC
/begin CHARACTERISTIC KTQD_SmartEcoLimitSpd_mph "" VALUE 0x0000 /* @ECU_Address@KTQD_SmartEcoLimitSpd_mph@ */ Scalar_UBYTE 0 SWC_FDC_type_CM_uint8_mph 0.0 255.0 /end CHARACTERISTIC
/begin CHARACTERISTIC KVMC_CMDRepeatTime_enum "" VALUE 0x0000 /* @ECU_Address@KVMC_CMDRepeatTime_enum@ */ Scalar_UBYTE 0 SWC_FDC_type_CM_uint8_enum 0.0 20.0 /end CHARACTERISTIC
/begin CHARACTERISTIC KVMC_LatAccRollAveLevel_enum "" VALUE 0x0000 /* @ECU_Address@KVMC_LatAccRollAveLevel_enum@ */ Scalar_UBYTE 0 SWC_FDC_type_CM_uint8_enum 1.0 100.0 /end CHARACTERISTIC
/begin CHARACTERISTIC KVMC_VehSpdRollAveLevel_enum "" VALUE 0x0000 /* @ECU_Address@KVMC_VehSpdRollAveLevel_enum@ */ Scalar_UBYTE 0 SWC_FDC_type_CM_uint8_enum 1.0 100.0 /end CHARACTERISTIC
/begin CHARACTERISTIC KVMC_WhlSpdRollAveLevel_enum "" VALUE 0x0000 /* @ECU_Address@KVMC_WhlSpdRollAveLevel_enum@ */ Scalar_UBYTE 0 SWC_FDC_type_CM_uint8_enum 1.0 100.0 /end CHARACTERISTIC
/begin MEASUREMENT VTPM_LFWheelTemp_C "" FLOAT32_IEEE SWC_FDC_type_CM_single_C 0 0 -40.0 215.0 ECU_ADDRESS 0x0000 /* @ECU_Address@VTPM_LFWheelTemp_C@ */ /end MEASUREMENT
/begin MEASUREMENT VTPM_RFWheelTemp_C "" FLOAT32_IEEE SWC_FDC_type_CM_single_C 0 0 -40.0 215.0 ECU_ADDRESS 0x0000 /* @ECU_Address@VTPM_RFWheelTemp_C@ */ /end MEASUREMENT
/begin MEASUREMENT VTPM_LRWheelTemp_C "" FLOAT32_IEEE SWC_FDC_type_CM_single_C 0 0 -40.0 215.0 ECU_ADDRESS 0x0000 /* @ECU_Address@VTPM_LRWheelTemp_C@ */ /end MEASUREMENT
/begin MEASUREMENT VTPM_RRWheelTemp_C "" FLOAT32_IEEE SWC_FDC_type_CM_single_C 0 0 -40.0 215.0 ECU_ADDRESS 0x0000 /* @ECU_Address@VTPM_RRWheelTemp_C@ */ /end MEASUREMENT
/begin MEASUREMENT VVMC_AntiLimitSpd_kph "" FLOAT32_IEEE SWC_FDC_type_CM_single_kph 0 0 -10.0 300.0 ECU_ADDRESS 0x0000 /* @ECU_Address@VVMC_AntiLimitSpd_kph@ */ /end MEASUREMENT
/begin MEASUREMENT VVMC_SoftJerkPCT_pct "" FLOAT32_IEEE SWC_FDC_type_CM_single_pct 0 0 0.0 100.0 ECU_ADDRESS 0x0000 /* @ECU_Address@VVMC_SoftJerkPCT_pct@ */ /end MEASUREMENT
/begin MEASUREMENT VVMC_AggressJerkPCT_pct "" FLOAT32_IEEE SWC_FDC_type_CM_single_pct 0 0 0.0 100.0 ECU_ADDRESS 0x0000 /* @ECU_Address@VVMC_AggressJerkPCT_pct@ */ /end MEASUREMENT
/begin MEASUREMENT VVMC_SoftLimitPCT_pct "" FLOAT32_IEEE SWC_FDC_type_CM_single_pct 0 0 0.0 100.0 ECU_ADDRESS 0x0000 /* @ECU_Address@VVMC_SoftLimitPCT_pct@ */ /end MEASUREMENT
/begin MEASUREMENT VVMC_AggressLimitPCT_pct "" FLOAT32_IEEE SWC_FDC_type_CM_single_pct 0 0 0.0 100.0 ECU_ADDRESS 0x0000 /* @ECU_Address@VVMC_AggressLimitPCT_pct@ */ /end MEASUREMENT
/begin MEASUREMENT VVMC_AccCalcuPIDIGain_mps2 "" FLOAT32_IEEE SWC_FDC_type_CM_single_mps2 0 0 -15.0 10.55 ECU_ADDRESS 0x0000 /* @ECU_Address@VVMC_AccCalcuPIDIGain_mps2@ */ /end MEASUREMENT
/begin MEASUREMENT VVMC_AccCalcuPIDPGain_mps2 "" FLOAT32_IEEE SWC_FDC_type_CM_single_mps2 0 0 -15.0 10.55 ECU_ADDRESS 0x0000 /* @ECU_Address@VVMC_AccCalcuPIDPGain_mps2@ */ /end MEASUREMENT
/begin MEASUREMENT VVMC_AccCalcuPID_mps2 "" FLOAT32_IEEE SWC_FDC_type_CM_single_mps2 0 0 -15.0 10.55 ECU_ADDRESS 0x0000 /* @ECU_Address@VVMC_AccCalcuPID_mps2@ */ /end MEASUREMENT
/begin MEASUREMENT VVMC_ISOAccLimit_mps2 "" FLOAT32_IEEE SWC_FDC_type_CM_single_mps2 0 0 0.0 10.0 ECU_ADDRESS 0x0000 /* @ECU_Address@VVMC_ISOAccLimit_mps2@ */ /end MEASUREMENT
/begin MEASUREMENT VVMC_ISODecLimit_mps2 "" FLOAT32_IEEE SWC_FDC_type_CM_single_mps2 0 0 -10.0 0.0 ECU_ADDRESS 0x0000 /* @ECU_Address@VVMC_ISODecLimit_mps2@ */ /end MEASUREMENT
/begin MEASUREMENT VVMC_ISOJerkLimit_mps3 "" FLOAT32_IEEE SWC_FDC_type_CM_single_mps3 0 0 0.0 10.0 ECU_ADDRESS 0x0000 /* @ECU_Address@VVMC_ISOJerkLimit_mps3@ */ /end MEASUREMENT
/begin MEASUREMENT VVMC_ACCReqAccelGain_rat "" FLOAT32_IEEE SWC_FDC_type_CM_single_rat 0 0 1.0 5.0 ECU_ADDRESS 0x0000 /* @ECU_Address@VVMC_ACCReqAccelGain_rat@ */ /end MEASUREMENT
/begin MEASUREMENT VVMC_ACCReqAccelAftGn_mps2 "" FLOAT32_IEEE SWC_FDC_type_CM_single_mps2 0 0 -15.0 15.0 ECU_ADDRESS 0x0000 /* @ECU_Address@VVMC_ACCReqAccelAftGn_mps2@ */ /end MEASUREMENT
/begin MEASUREMENT VVMC_AfterCtrlACCReqAccel_mps2 "" FLOAT32_IEEE SWC_FDC_type_CM_single_mps2 0 0 -15.0 10.55 ECU_ADDRESS 0x0000 /* @ECU_Address@VVMC_AfterCtrlACCReqAccel_mps2@ */ /end MEASUREMENT
/begin MEASUREMENT VVMC_OVRD2ActReqAccelAftSR_mps2 "" FLOAT32_IEEE SWC_FDC_type_CM_single_mps2 0 0 -15.0 15.0 ECU_ADDRESS 0x0000 /* @ECU_Address@VVMC_OVRD2ActReqAccelAftSR_mps2@ */ /end MEASUREMENT
/begin MEASUREMENT VVMC_VehHoldEnReqAccel_mps2 "" FLOAT32_IEEE SWC_FDC_type_CM_single_mps2 0 0 -15.0 10.55 ECU_ADDRESS 0x0000 /* @ECU_Address@VVMC_VehHoldEnReqAccel_mps2@ */ /end MEASUREMENT
/begin MEASUREMENT VVMC_VehHoldDecCtrlBSlopeCal2_mps3 "" FLOAT32_IEEE SWC_FDC_type_CM_single_mps3 0 0 -2000.0 2000.0 ECU_ADDRESS 0x0000 /* @ECU_Address@VVMC_VehHoldDecCtrlBSlopeCal2_mps3@ */ /end MEASUREMENT
/begin MEASUREMENT VVMC_VehHoldDecCtrlBSlopeCal1_mps3 "" FLOAT32_IEEE SWC_FDC_type_CM_single_mps3 0 0 -2000.0 2000.0 ECU_ADDRESS 0x0000 /* @ECU_Address@VVMC_VehHoldDecCtrlBSlopeCal1_mps3@ */ /end MEASUREMENT
/begin MEASUREMENT VVMC_VehHoldDecCtrlBSlope_mps3 "" FLOAT32_IEEE SWC_FDC_type_CM_single_mps3 0 0 -2000.0 2000.0 ECU_ADDRESS 0x0000 /* @ECU_Address@VVMC_VehHoldDecCtrlBSlope_mps3@ */ /end MEASUREMENT
/begin MEASUREMENT VVMC_VehHoldDecCtrlAccel_mps2 "" FLOAT32_IEEE SWC_FDC_type_CM_single_mps2 0 0 -15.0 10.55 ECU_ADDRESS 0x0000 /* @ECU_Address@VVMC_VehHoldDecCtrlAccel_mps2@ */ /end MEASUREMENT
/begin MEASUREMENT VVMC_VHDecTarget_mps2 "" FLOAT32_IEEE SWC_FDC_type_CM_single_mps2 0 0 -10.0 10.0 ECU_ADDRESS 0x0000 /* @ECU_Address@VVMC_VHDecTarget_mps2@ */ /end MEASUREMENT
/begin MEASUREMENT VVMC_VHDecCtrlFinal_mps2 "" FLOAT32_IEEE SWC_FDC_type_CM_single_mps2 0 0 -10.0 10.0 ECU_ADDRESS 0x0000 /* @ECU_Address@VVMC_VHDecCtrlFinal_mps2@ */ /end MEASUREMENT
/begin MEASUREMENT VVMC_PreACCReqAcc_mps2 "" FLOAT32_IEEE SWC_FDC_type_CM_single_mps2 0 0 -15.0 10.55 ECU_ADDRESS 0x0000 /* @ECU_Address@VVMC_PreACCReqAcc_mps2@ */ /end MEASUREMENT
/begin MEASUREMENT VVMC_JerkSource_mps2 "" FLOAT32_IEEE SWC_FDC_type_CM_single_mps2 0 0 -10.0 10.0 ECU_ADDRESS 0x0000 /* @ECU_Address@VVMC_JerkSource_mps2@ */ /end MEASUREMENT
/begin MEASUREMENT VVMC_ISOJerkLimitFinal_mps3 "" FLOAT32_IEEE SWC_FDC_type_CM_single_mps3 0 0 0.0 10.0 ECU_ADDRESS 0x0000 /* @ECU_Address@VVMC_ISOJerkLimitFinal_mps3@ */ /end MEASUREMENT
/begin MEASUREMENT VVMC_DISCReqAccAftLim_mps2 "" FLOAT32_IEEE SWC_FDC_type_CM_single_mps2 0 0 -15.0 10.55 ECU_ADDRESS 0x0000 /* @ECU_Address@VVMC_DISCReqAccAftLim_mps2@ */ /end MEASUREMENT
/begin MEASUREMENT VVMC_DISCReqAccAftRepeat_mps2 "" FLOAT32_IEEE SWC_FDC_type_CM_single_mps2 0 0 -15.0 10.55 ECU_ADDRESS 0x0000 /* @ECU_Address@VVMC_DISCReqAccAftRepeat_mps2@ */ /end MEASUREMENT
/begin MEASUREMENT VVMC_ActACCRequiredAccel_mps2 "" FLOAT32_IEEE SWC_FDC_type_CM_single_mps2 0 0 -15.0 10.55 ECU_ADDRESS 0x0000 /* @ECU_Address@VVMC_ActACCRequiredAccel_mps2@ */ /end MEASUREMENT
/begin MEASUREMENT VVMC_ADSACCBRgnLim_Nm "" FLOAT32_IEEE SWC_FDC_type_CM_single_Nm 0 0 -3000.0 3000.0 ECU_ADDRESS 0x0000 /* @ECU_Address@VVMC_ADSACCBRgnLim_Nm@ */ /end MEASUREMENT
/begin MEASUREMENT VVMC_ADSDecRspsRatio_rat "" FLOAT32_IEEE SWC_FDC_type_CM_single_rat 0 0 0.1 1.0 ECU_ADDRESS 0x0000 /* @ECU_Address@VVMC_ADSDecRspsRatio_rat@ */ /end MEASUREMENT
/begin MEASUREMENT VVMC_ActACCReqAcc4ADS_mps2 "" FLOAT32_IEEE SWC_FDC_type_CM_single_mps2 0 0 -15.0 15.0 ECU_ADDRESS 0x0000 /* @ECU_Address@VVMC_ActACCReqAcc4ADS_mps2@ */ /end MEASUREMENT
/begin MEASUREMENT VVMC_ACCRequiredAccel_mps2 "" FLOAT32_IEEE SWC_FDC_type_CM_single_mps2 0 0 -15.0 10.55 ECU_ADDRESS 0x0000 /* @ECU_Address@VVMC_ACCRequiredAccel_mps2@ */ /end MEASUREMENT
/begin MEASUREMENT VVMC_MSAPedalOvrd_pct "" FLOAT32_IEEE SWC_FDC_type_CM_single_pct 0 0 0.0 125.0 ECU_ADDRESS 0x0000 /* @ECU_Address@VVMC_MSAPedalOvrd_pct@ */ /end MEASUREMENT
/begin MEASUREMENT VVMC_MSAOvrdWhlTqCal_Nm "" FLOAT32_IEEE SWC_FDC_type_CM_single_Nm 0 0 -100000.0 100000.0 ECU_ADDRESS 0x0000 /* @ECU_Address@VVMC_MSAOvrdWhlTqCal_Nm@ */ /end MEASUREMENT
/begin MEASUREMENT VVMC_MSAPGainDeltaTq_Nm "" FLOAT32_IEEE SWC_FDC_type_CM_single_Nm 0 0 -100000.0 100000.0 ECU_ADDRESS 0x0000 /* @ECU_Address@VVMC_MSAPGainDeltaTq_Nm@ */ /end MEASUREMENT
/begin MEASUREMENT VVMC_MSATqDownEndTq_Nm "" FLOAT32_IEEE SWC_FDC_type_CM_single_Nm 0 0 -100000.0 100000.0 ECU_ADDRESS 0x0000 /* @ECU_Address@VVMC_MSATqDownEndTq_Nm@ */ /end MEASUREMENT
/begin MEASUREMENT VVMC_MSAWhlTqCalDelay_Nm "" FLOAT32_IEEE SWC_FDC_type_CM_single_Nm 0 0 -100000.0 100000.0 ECU_ADDRESS 0x0000 /* @ECU_Address@VVMC_MSAWhlTqCalDelay_Nm@ */ /end MEASUREMENT
/begin MEASUREMENT VVMC_MSATqDownSlope_Nmps "" FLOAT32_IEEE SWC_FDC_type_CM_single_Nmps 0 0 -1.0E+6 1.0E+6 ECU_ADDRESS 0x0000 /* @ECU_Address@VVMC_MSATqDownSlope_Nmps@ */ /end MEASUREMENT
/begin MEASUREMENT VVMC_MSAWhlTqCalAftTqDown_Nm "" FLOAT32_IEEE SWC_FDC_type_CM_single_Nm 0 0 -100000.0 100000.0 ECU_ADDRESS 0x0000 /* @ECU_Address@VVMC_MSAWhlTqCalAftTqDown_Nm@ */ /end MEASUREMENT
/begin MEASUREMENT VVMC_MSAIGainDeltaTq_Nm "" FLOAT32_IEEE SWC_FDC_type_CM_single_Nm 0 0 -100000.0 100000.0 ECU_ADDRESS 0x0000 /* @ECU_Address@VVMC_MSAIGainDeltaTq_Nm@ */ /end MEASUREMENT
/begin MEASUREMENT VVMC_MSAWhlTqCalAftGCtrl_Nm "" FLOAT32_IEEE SWC_FDC_type_CM_single_Nm 0 0 -100000.0 100000.0 ECU_ADDRESS 0x0000 /* @ECU_Address@VVMC_MSAWhlTqCalAftGCtrl_Nm@ */ /end MEASUREMENT
/begin MEASUREMENT VVMC_MSAWhlTqCalNotTqDown_Nm "" FLOAT32_IEEE SWC_FDC_type_CM_single_Nm 0 0 -100000.0 100000.0 ECU_ADDRESS 0x0000 /* @ECU_Address@VVMC_MSAWhlTqCalNotTqDown_Nm@ */ /end MEASUREMENT
/begin MEASUREMENT VVMC_MSAWhlTqCalAftInCtrlSpd_Nm "" FLOAT32_IEEE SWC_FDC_type_CM_single_Nm 0 0 -100000.0 100000.0 ECU_ADDRESS 0x0000 /* @ECU_Address@VVMC_MSAWhlTqCalAftInCtrlSpd_Nm@ */ /end MEASUREMENT
/begin MEASUREMENT VVMC_MSAWhlTqCal_Nm "" FLOAT32_IEEE SWC_FDC_type_CM_single_Nm 0 0 -100000.0 100000.0 ECU_ADDRESS 0x0000 /* @ECU_Address@VVMC_MSAWhlTqCal_Nm@ */ /end MEASUREMENT
/begin MEASUREMENT VVMC_MSAWhlTqReq_Nm "" FLOAT32_IEEE SWC_FDC_type_CM_single_Nm 0 0 -100000.0 100000.0 ECU_ADDRESS 0x0000 /* @ECU_Address@VVMC_MSAWhlTqReq_Nm@ */ /end MEASUREMENT
/begin MEASUREMENT VVMC_MaxRawWhlSpeed_kph "" FLOAT32_IEEE SWC_FDC_type_CM_single_kph 0 0 0.0 300.0 ECU_ADDRESS 0x0000 /* @ECU_Address@VVMC_MaxRawWhlSpeed_kph@ */ /end MEASUREMENT
/begin MEASUREMENT VVMC_MinRawWhlSpeed_kph "" FLOAT32_IEEE SWC_FDC_type_CM_single_kph 0 0 0.0 300.0 ECU_ADDRESS 0x0000 /* @ECU_Address@VVMC_MinRawWhlSpeed_kph@ */ /end MEASUREMENT
/begin MEASUREMENT VVMC_RawCalWhlSpdSlideRate_pct "" FLOAT32_IEEE SWC_FDC_type_CM_single_pct 0 0 0.0 125.0 ECU_ADDRESS 0x0000 /* @ECU_Address@VVMC_RawCalWhlSpdSlideRate_pct@ */ /end MEASUREMENT
/begin MEASUREMENT VVMC_RawWhlSpdSlideRate_pct "" FLOAT32_IEEE SWC_FDC_type_CM_single_pct 0 0 0.0 125.0 ECU_ADDRESS 0x0000 /* @ECU_Address@VVMC_RawWhlSpdSlideRate_pct@ */ /end MEASUREMENT
/begin MEASUREMENT VVMC_LFCalWhlSpdSlideRate_pct "" FLOAT32_IEEE SWC_FDC_type_CM_single_pct 0 0 0.0 125.0 ECU_ADDRESS 0x0000 /* @ECU_Address@VVMC_LFCalWhlSpdSlideRate_pct@ */ /end MEASUREMENT
/begin MEASUREMENT VVMC_LFWhlSpdSlideRate_pct "" FLOAT32_IEEE SWC_FDC_type_CM_single_pct 0 0 0.0 125.0 ECU_ADDRESS 0x0000 /* @ECU_Address@VVMC_LFWhlSpdSlideRate_pct@ */ /end MEASUREMENT
/begin MEASUREMENT VVMC_RFCalWhlSpdSlideRate_pct "" FLOAT32_IEEE SWC_FDC_type_CM_single_pct 0 0 0.0 125.0 ECU_ADDRESS 0x0000 /* @ECU_Address@VVMC_RFCalWhlSpdSlideRate_pct@ */ /end MEASUREMENT
/begin MEASUREMENT VVMC_RFWhlSpdSlideRate_pct "" FLOAT32_IEEE SWC_FDC_type_CM_single_pct 0 0 0.0 125.0 ECU_ADDRESS 0x0000 /* @ECU_Address@VVMC_RFWhlSpdSlideRate_pct@ */ /end MEASUREMENT
/begin MEASUREMENT VVMC_LRCalWhlSpdSlideRate_pct "" FLOAT32_IEEE SWC_FDC_type_CM_single_pct 0 0 0.0 125.0 ECU_ADDRESS 0x0000 /* @ECU_Address@VVMC_LRCalWhlSpdSlideRate_pct@ */ /end MEASUREMENT
/begin MEASUREMENT VVMC_LRWhlSpdSlideRate_pct "" FLOAT32_IEEE SWC_FDC_type_CM_single_pct 0 0 0.0 125.0 ECU_ADDRESS 0x0000 /* @ECU_Address@VVMC_LRWhlSpdSlideRate_pct@ */ /end MEASUREMENT
/begin MEASUREMENT VVMC_RRCalWhlSpdSlideRate_pct "" FLOAT32_IEEE SWC_FDC_type_CM_single_pct 0 0 0.0 125.0 ECU_ADDRESS 0x0000 /* @ECU_Address@VVMC_RRCalWhlSpdSlideRate_pct@ */ /end MEASUREMENT
/begin MEASUREMENT VVMC_RRWhlSpdSlideRate_pct "" FLOAT32_IEEE SWC_FDC_type_CM_single_pct 0 0 0.0 125.0 ECU_ADDRESS 0x0000 /* @ECU_Address@VVMC_RRWhlSpdSlideRate_pct@ */ /end MEASUREMENT
/begin MEASUREMENT VVMC_4WheelLongAcc_Gps "" FLOAT32_IEEE SWC_FDC_type_CM_single_Gps 0 0 -20.0 20.0 ECU_ADDRESS 0x0000 /* @ECU_Address@VVMC_4WheelLongAcc_Gps@ */ /end MEASUREMENT
/begin MEASUREMENT VVMC_CalAltLWhlSlideRate_pct "" FLOAT32_IEEE SWC_FDC_type_CM_single_pct 0 0 0.0 125.0 ECU_ADDRESS 0x0000 /* @ECU_Address@VVMC_CalAltLWhlSlideRate_pct@ */ /end MEASUREMENT
/begin MEASUREMENT VVMC_AltLWhlSlideRate_pct "" FLOAT32_IEEE SWC_FDC_type_CM_single_pct 0 0 0.0 125.0 ECU_ADDRESS 0x0000 /* @ECU_Address@VVMC_AltLWhlSlideRate_pct@ */ /end MEASUREMENT
/begin MEASUREMENT VVMC_CalAltRWhlSlideRate_pct "" FLOAT32_IEEE SWC_FDC_type_CM_single_pct 0 0 0.0 125.0 ECU_ADDRESS 0x0000 /* @ECU_Address@VVMC_CalAltRWhlSlideRate_pct@ */ /end MEASUREMENT
/begin MEASUREMENT VVMC_AltRWhlSlideRate_pct "" FLOAT32_IEEE SWC_FDC_type_CM_single_pct 0 0 0.0 125.0 ECU_ADDRESS 0x0000 /* @ECU_Address@VVMC_AltRWhlSlideRate_pct@ */ /end MEASUREMENT
/begin MEASUREMENT VVMC_AltWhlSlideRate_pct "" FLOAT32_IEEE SWC_FDC_type_CM_single_pct 0 0 0.0 125.0 ECU_ADDRESS 0x0000 /* @ECU_Address@VVMC_AltWhlSlideRate_pct@ */ /end MEASUREMENT
/begin MEASUREMENT VVMC_OPDDisSlideRate_pct "" FLOAT32_IEEE SWC_FDC_type_CM_single_pct 0 0 0.0 125.0 ECU_ADDRESS 0x0000 /* @ECU_Address@VVMC_OPDDisSlideRate_pct@ */ /end MEASUREMENT
/begin MEASUREMENT VVMC_ActMaxSlideRate_pct "" FLOAT32_IEEE SWC_FDC_type_CM_single_pct 0 0 0.0 125.0 ECU_ADDRESS 0x0000 /* @ECU_Address@VVMC_ActMaxSlideRate_pct@ */ /end MEASUREMENT
/begin MEASUREMENT VVMC_LatESCRegenOut_Gps "" FLOAT32_IEEE SWC_FDC_type_CM_single_Gps 0 0 0.0 4.0 ECU_ADDRESS 0x0000 /* @ECU_Address@VVMC_LatESCRegenOut_Gps@ */ /end MEASUREMENT
/begin MEASUREMENT VVMC_ESCRegenOut_Dps "" FLOAT32_IEEE SWC_FDC_type_CM_single_Dps 0 0 -150.0 150.0 ECU_ADDRESS 0x0000 /* @ECU_Address@VVMC_ESCRegenOut_Dps@ */ /end MEASUREMENT
/begin MEASUREMENT VVMC_ESCRegenOutEnSpd_kph "" FLOAT32_IEEE SWC_FDC_type_CM_single_kph 0 0 0.0 300.0 ECU_ADDRESS 0x0000 /* @ECU_Address@VVMC_ESCRegenOutEnSpd_kph@ */ /end MEASUREMENT
/begin MEASUREMENT VVMC_RDCEnSlideRate_pct "" FLOAT32_IEEE SWC_FDC_type_CM_single_pct 0 0 0.0 125.0 ECU_ADDRESS 0x0000 /* @ECU_Address@VVMC_RDCEnSlideRate_pct@ */ /end MEASUREMENT
/begin MEASUREMENT VVMC_RDCDetectTime_s "" FLOAT32_IEEE SWC_FDC_type_CM_single_s 0 0 0.0 7200.0 ECU_ADDRESS 0x0000 /* @ECU_Address@VVMC_RDCDetectTime_s@ */ /end MEASUREMENT
/begin MEASUREMENT VVMC_StESCYaw_Dps "" FLOAT32_IEEE SWC_FDC_type_CM_single_Dps 0 0 -300.0 300.0 ECU_ADDRESS 0x0000 /* @ECU_Address@VVMC_StESCYaw_Dps@ */ /end MEASUREMENT
/begin MEASUREMENT VVMC_StESCYawCom_Dps "" FLOAT32_IEEE SWC_FDC_type_CM_single_Dps 0 0 -300.0 300.0 ECU_ADDRESS 0x0000 /* @ECU_Address@VVMC_StESCYawCom_Dps@ */ /end MEASUREMENT
/begin MEASUREMENT VVMC_ActStESCYaw_Dps "" FLOAT32_IEEE SWC_FDC_type_CM_single_Dps 0 0 -300.0 300.0 ECU_ADDRESS 0x0000 /* @ECU_Address@VVMC_ActStESCYaw_Dps@ */ /end MEASUREMENT
/begin MEASUREMENT VVMC_MeterSpdCalcu_mps "" FLOAT32_IEEE SWC_FDC_type_CM_single_mps 0 0 0.0 80.0 ECU_ADDRESS 0x0000 /* @ECU_Address@VVMC_MeterSpdCalcu_mps@ */ /end MEASUREMENT
/begin MEASUREMENT VVMC_FinalSlop_deg "" FLOAT32_IEEE SWC_FDC_type_CM_single_deg 0 0 -180.0 180.0 ECU_ADDRESS 0x0000 /* @ECU_Address@VVMC_FinalSlop_deg@ */ /end MEASUREMENT
/begin MEASUREMENT VVMC_IMUEstSlope_Deg1 "" FLOAT32_IEEE SWC_FDC_type_CM_single_Deg1 0 0 -180.0 180.0 ECU_ADDRESS 0x0000 /* @ECU_Address@VVMC_IMUEstSlope_Deg1@ */ /end MEASUREMENT
/begin MEASUREMENT VVMC_LongAcc_Gps "" FLOAT32_IEEE SWC_FDC_type_CM_single_Gps 0 0 -20.0 20.0 ECU_ADDRESS 0x0000 /* @ECU_Address@VVMC_LongAcc_Gps@ */ /end MEASUREMENT
/begin MEASUREMENT VVMC_LongAccFrWhl_Gps "" FLOAT32_IEEE SWC_FDC_type_CM_single_Gps 0 0 -2.0 2.0 ECU_ADDRESS 0x0000 /* @ECU_Address@VVMC_LongAccFrWhl_Gps@ */ /end MEASUREMENT
/begin MEASUREMENT VVMC_LongAccRrWhl_Gps "" FLOAT32_IEEE SWC_FDC_type_CM_single_Gps 0 0 -2.0 2.0 ECU_ADDRESS 0x0000 /* @ECU_Address@VVMC_LongAccRrWhl_Gps@ */ /end MEASUREMENT
/begin MEASUREMENT VVMC_LFWhlSpeedRollAve_kph "" FLOAT32_IEEE SWC_FDC_type_CM_single_kph 0 0 0.0 255.0 ECU_ADDRESS 0x0000 /* @ECU_Address@VVMC_LFWhlSpeedRollAve_kph@ */ /end MEASUREMENT
/begin MEASUREMENT VVMC_RFWhlSpeedRollAve_kph "" FLOAT32_IEEE SWC_FDC_type_CM_single_kph 0 0 0.0 255.0 ECU_ADDRESS 0x0000 /* @ECU_Address@VVMC_RFWhlSpeedRollAve_kph@ */ /end MEASUREMENT
/begin MEASUREMENT VVMC_LRWhlSpeedRollAve_kph "" FLOAT32_IEEE SWC_FDC_type_CM_single_kph 0 0 0.0 255.0 ECU_ADDRESS 0x0000 /* @ECU_Address@VVMC_LRWhlSpeedRollAve_kph@ */ /end MEASUREMENT
/begin MEASUREMENT VVMC_RRWhlSpeedRollAve_kph "" FLOAT32_IEEE SWC_FDC_type_CM_single_kph 0 0 0.0 255.0 ECU_ADDRESS 0x0000 /* @ECU_Address@VVMC_RRWhlSpeedRollAve_kph@ */ /end MEASUREMENT
/begin MEASUREMENT VVMC_MeterSpdRollAve_kph "" FLOAT32_IEEE SWC_FDC_type_CM_single_kph 0 0 0.0 254.0 ECU_ADDRESS 0x0000 /* @ECU_Address@VVMC_MeterSpdRollAve_kph@ */ /end MEASUREMENT
/begin MEASUREMENT VVMC_ACCConSpdCtrlCMD_mps2 "" FLOAT32_IEEE SWC_FDC_type_CM_single_mps2 0 0 -15.0 10.55 ECU_ADDRESS 0x0000 /* @ECU_Address@VVMC_ACCConSpdCtrlCMD_mps2@ */ /end MEASUREMENT
/begin MEASUREMENT VVMC_DISCConSpdCtrlCMD_mps2 "" FLOAT32_IEEE SWC_FDC_type_CM_single_mps2 0 0 -15.0 10.55 ECU_ADDRESS 0x0000 /* @ECU_Address@VVMC_DISCConSpdCtrlCMD_mps2@ */ /end MEASUREMENT
/begin MEASUREMENT VTQD_RrTqErr_Nm "" FLOAT32_IEEE SWC_FDC_type_CM_single_Nm 0 0 0.0 100000.0 ECU_ADDRESS 0x0000 /* @ECU_Address@VTQD_RrTqErr_Nm@ */ /end MEASUREMENT
/begin MEASUREMENT VTQD_FrTqErr_Nm "" FLOAT32_IEEE SWC_FDC_type_CM_single_Nm 0 0 0.0 100000.0 ECU_ADDRESS 0x0000 /* @ECU_Address@VTQD_FrTqErr_Nm@ */ /end MEASUREMENT
/begin MEASUREMENT VTQD_EstActVehWeight_kg "" FLOAT32_IEEE SWC_FDC_type_CM_single_kg 0 0 0.0 10000.0 ECU_ADDRESS 0x0000 /* @ECU_Address@VTQD_EstActVehWeight_kg@ */ /end MEASUREMENT
/begin MEASUREMENT VTQD_EstInitVehWeight_kg "" FLOAT32_IEEE SWC_FDC_type_CM_single_kg 0 0 0.0 10000.0 ECU_ADDRESS 0x0000 /* @ECU_Address@VTQD_EstInitVehWeight_kg@ */ /end MEASUREMENT
/begin MEASUREMENT VTQD_EstVehWeightResult_kg "" FLOAT32_IEEE SWC_FDC_type_CM_single_kg 0 0 0.0 10000.0 ECU_ADDRESS 0x0000 /* @ECU_Address@VTQD_EstVehWeightResult_kg@ */ /end MEASUREMENT
/begin MEASUREMENT VTQD_SimSouWaveReq_pct "" FLOAT32_IEEE SWC_FDC_type_CM_single_pct 0 0 -125.0 125.0 ECU_ADDRESS 0x0000 /* @ECU_Address@VTQD_SimSouWaveReq_pct@ */ /end MEASUREMENT
/begin MEASUREMENT VTQD_AvailTqWithARgnFr_Nm "" FLOAT32_IEEE SWC_FDC_type_CM_single_Nm 0 0 0.0 100000.0 ECU_ADDRESS 0x0000 /* @ECU_Address@VTQD_AvailTqWithARgnFr_Nm@ */ /end MEASUREMENT
/begin MEASUREMENT VTQD_AvailTqWithARgnRr_Nm "" FLOAT32_IEEE SWC_FDC_type_CM_single_Nm 0 0 0.0 100000.0 ECU_ADDRESS 0x0000 /* @ECU_Address@VTQD_AvailTqWithARgnRr_Nm@ */ /end MEASUREMENT
/begin MEASUREMENT VTQD_CalRoadSpdLim_raw32 "" FLOAT32_IEEE SWC_FDC_type_CM_single_raw32 0 0 0.0 254.0 ECU_ADDRESS 0x0000 /* @ECU_Address@VTQD_CalRoadSpdLim_raw32@ */ /end MEASUREMENT
/begin MEASUREMENT VTQD_CalRoadSpdLimOffSet_c "" FLOAT32_IEEE SWC_FDC_type_CM_single_c 0 0 0.0 30.0 ECU_ADDRESS 0x0000 /* @ECU_Address@VTQD_CalRoadSpdLimOffSet_c@ */ /end MEASUREMENT
/begin MEASUREMENT VTQD_RoadSpdLim_raw32 "" FLOAT32_IEEE SWC_FDC_type_CM_single_raw32 0 0 0.0 254.0 ECU_ADDRESS 0x0000 /* @ECU_Address@VTQD_RoadSpdLim_raw32@ */ /end MEASUREMENT
/begin MEASUREMENT VBCM_UserHeightSet_cnt "" UWORD SWC_FDC_type_CM_uint16_cnt 0 0 0.0 65535.0 ECU_ADDRESS 0x0000 /* @ECU_Address@VBCM_UserHeightSet_cnt@ */ /end MEASUREMENT
/begin MEASUREMENT VBCM_PTGUserHeight1_cnt "" UWORD SWC_FDC_type_CM_uint16_cnt 0 0 0.0 65535.0 ECU_ADDRESS 0x0000 /* @ECU_Address@VBCM_PTGUserHeight1_cnt@ */ /end MEASUREMENT
/begin MEASUREMENT VBCM_PTGUserHeight2_cnt "" UWORD SWC_FDC_type_CM_uint16_cnt 0 0 0.0 65535.0 ECU_ADDRESS 0x0000 /* @ECU_Address@VBCM_PTGUserHeight2_cnt@ */ /end MEASUREMENT
/begin MEASUREMENT VBCM_PTGUserHeight3_cnt "" UWORD SWC_FDC_type_CM_uint16_cnt 0 0 0.0 65535.0 ECU_ADDRESS 0x0000 /* @ECU_Address@VBCM_PTGUserHeight3_cnt@ */ /end MEASUREMENT
/begin MEASUREMENT VBCM_PTGUserHeight4_cnt "" UWORD SWC_FDC_type_CM_uint16_cnt 0 0 0.0 65535.0 ECU_ADDRESS 0x0000 /* @ECU_Address@VBCM_PTGUserHeight4_cnt@ */ /end MEASUREMENT
/begin MEASUREMENT VBCM_PTGUserHeight5_cnt "" UWORD SWC_FDC_type_CM_uint16_cnt 0 0 0.0 65535.0 ECU_ADDRESS 0x0000 /* @ECU_Address@VBCM_PTGUserHeight5_cnt@ */ /end MEASUREMENT
/begin MEASUREMENT VBCM_PTGUserHeight7_cnt "" UWORD SWC_FDC_type_CM_uint16_cnt 0 0 0.0 65535.0 ECU_ADDRESS 0x0000 /* @ECU_Address@VBCM_PTGUserHeight7_cnt@ */ /end MEASUREMENT
/begin MEASUREMENT VTPM_LFWheelPress_raw8 "" UBYTE SWC_FDC_type_CM_uint8_raw8 0 0 0.0 255.0 ECU_ADDRESS 0x0000 /* @ECU_Address@VTPM_LFWheelPress_raw8@ */ /end MEASUREMENT
/begin MEASUREMENT VTPM_RFWheelPress_raw8 "" UBYTE SWC_FDC_type_CM_uint8_raw8 0 0 0.0 255.0 ECU_ADDRESS 0x0000 /* @ECU_Address@VTPM_RFWheelPress_raw8@ */ /end MEASUREMENT
/begin MEASUREMENT VTPM_LRWheelPress_raw8 "" UBYTE SWC_FDC_type_CM_uint8_raw8 0 0 0.0 255.0 ECU_ADDRESS 0x0000 /* @ECU_Address@VTPM_LRWheelPress_raw8@ */ /end MEASUREMENT
/begin MEASUREMENT VTPM_RRWheelPress_raw8 "" UBYTE SWC_FDC_type_CM_uint8_raw8 0 0 0.0 255.0 ECU_ADDRESS 0x0000 /* @ECU_Address@VTPM_RRWheelPress_raw8@ */ /end MEASUREMENT
/begin MEASUREMENT VTPM_LFPindi_enum "" UBYTE SWC_FDC_type_CM_uint8_enum 0 0 0.0 3.0 ECU_ADDRESS 0x0000 /* @ECU_Address@VTPM_LFPindi_enum@ */ /end MEASUREMENT
/begin MEASUREMENT VTPM_RFPind_enum "" UBYTE SWC_FDC_type_CM_uint8_enum 0 0 0.0 3.0 ECU_ADDRESS 0x0000 /* @ECU_Address@VTPM_RFPind_enum@ */ /end MEASUREMENT
/begin MEASUREMENT VTPM_LRPindi_enum "" UBYTE SWC_FDC_type_CM_uint8_enum 0 0 0.0 3.0 ECU_ADDRESS 0x0000 /* @ECU_Address@VTPM_LRPindi_enum@ */ /end MEASUREMENT
/begin MEASUREMENT VTPM_RRPindi_enum "" UBYTE SWC_FDC_type_CM_uint8_enum 0 0 0.0 3.0 ECU_ADDRESS 0x0000 /* @ECU_Address@VTPM_RRPindi_enum@ */ /end MEASUREMENT
/begin MEASUREMENT VTPM_LFP20_raw8 "" UBYTE SWC_FDC_type_CM_uint8_raw8 0 0 0.0 255.0 ECU_ADDRESS 0x0000 /* @ECU_Address@VTPM_LFP20_raw8@ */ /end MEASUREMENT
/begin MEASUREMENT VTPM_LRP20_raw8 "" UBYTE SWC_FDC_type_CM_uint8_raw8 0 0 0.0 255.0 ECU_ADDRESS 0x0000 /* @ECU_Address@VTPM_LRP20_raw8@ */ /end MEASUREMENT
/begin MEASUREMENT VTPM_RFP20_raw8 "" UBYTE SWC_FDC_type_CM_uint8_raw8 0 0 0.0 255.0 ECU_ADDRESS 0x0000 /* @ECU_Address@VTPM_RFP20_raw8@ */ /end MEASUREMENT
/begin MEASUREMENT VTPM_RRP20_raw8 "" UBYTE SWC_FDC_type_CM_uint8_raw8 0 0 0.0 255.0 ECU_ADDRESS 0x0000 /* @ECU_Address@VTPM_RRP20_raw8@ */ /end MEASUREMENT
/begin MEASUREMENT VTPM_LFWheelPSW_raw8 "" UBYTE SWC_FDC_type_CM_uint8_raw8 0 0 0.0 200.0 ECU_ADDRESS 0x0000 /* @ECU_Address@VTPM_LFWheelPSW_raw8@ */ /end MEASUREMENT
/begin MEASUREMENT VTPM_RFWheelPSW_raw8 "" UBYTE SWC_FDC_type_CM_uint8_raw8 0 0 0.0 200.0 ECU_ADDRESS 0x0000 /* @ECU_Address@VTPM_RFWheelPSW_raw8@ */ /end MEASUREMENT
/begin MEASUREMENT VTPM_LRWheelPSW_raw8 "" UBYTE SWC_FDC_type_CM_uint8_raw8 0 0 0.0 200.0 ECU_ADDRESS 0x0000 /* @ECU_Address@VTPM_LRWheelPSW_raw8@ */ /end MEASUREMENT
/begin MEASUREMENT VTPM_RRWheelPSW_raw8 "" UBYTE SWC_FDC_type_CM_uint8_raw8 0 0 0.0 200.0 ECU_ADDRESS 0x0000 /* @ECU_Address@VTPM_RRWheelPSW_raw8@ */ /end MEASUREMENT
/begin MEASUREMENT VTPM_Prepresstempvalid_enum "" UBYTE SWC_FDC_type_CM_uint8_enum 0 0 0.0 255.0 ECU_ADDRESS 0x0000 /* @ECU_Address@VTPM_Prepresstempvalid_enum@ */ /end MEASUREMENT
/begin MEASUREMENT VTPM_LFPressIndi_enum "" UBYTE SWC_FDC_type_CM_uint8_enum 0 0 0.0 4.0 ECU_ADDRESS 0x0000 /* @ECU_Address@VTPM_LFPressIndi_enum@ */ /end MEASUREMENT
/begin MEASUREMENT VTPM_RFPressIndi_enum "" UBYTE SWC_FDC_type_CM_uint8_enum 0 0 0.0 4.0 ECU_ADDRESS 0x0000 /* @ECU_Address@VTPM_RFPressIndi_enum@ */ /end MEASUREMENT
/begin MEASUREMENT VTPM_LRPressIndi_enum "" UBYTE SWC_FDC_type_CM_uint8_enum 0 0 0.0 4.0 ECU_ADDRESS 0x0000 /* @ECU_Address@VTPM_LRPressIndi_enum@ */ /end MEASUREMENT
/begin MEASUREMENT VTPM_RRPressIndi_enum "" UBYTE SWC_FDC_type_CM_uint8_enum 0 0 0.0 4.0 ECU_ADDRESS 0x0000 /* @ECU_Address@VTPM_RRPressIndi_enum@ */ /end MEASUREMENT
/begin MEASUREMENT VTPM_TPMSWarnIndi_enum "" UBYTE SWC_FDC_type_CM_uint8_enum 0 0 0.0 3.0 ECU_ADDRESS 0x0000 /* @ECU_Address@VTPM_TPMSWarnIndi_enum@ */ /end MEASUREMENT
/begin MEASUREMENT VTPM_CWheelTips_enum "" UBYTE SWC_FDC_type_CM_uint8_enum 0 0 0.0 3.0 ECU_ADDRESS 0x0000 /* @ECU_Address@VTPM_CWheelTips_enum@ */ /end MEASUREMENT
/begin MEASUREMENT VTPM_AutoLTips_enum "" UBYTE SWC_FDC_type_CM_uint8_enum 0 0 0.0 3.0 ECU_ADDRESS 0x0000 /* @ECU_Address@VTPM_AutoLTips_enum@ */ /end MEASUREMENT
/begin MEASUREMENT VTPM_ManualP4alarm_raw "" UBYTE SWC_FDC_type_CM_uint8_raw 0 0 0.0 200.0 ECU_ADDRESS 0x0000 /* @ECU_Address@VTPM_ManualP4alarm_raw@ */ /end MEASUREMENT
/begin MEASUREMENT VTPM_ManualS4pressindi_enum "" UBYTE SWC_FDC_type_CM_uint8_enum 0 0 0.0 200.0 ECU_ADDRESS 0x0000 /* @ECU_Address@VTPM_ManualS4pressindi_enum@ */ /end MEASUREMENT
/begin MEASUREMENT VTPM_ManualID4P20_raw8 "" UBYTE SWC_FDC_type_CM_uint8_raw8 0 0 0.0 255.0 ECU_ADDRESS 0x0000 /* @ECU_Address@VTPM_ManualID4P20_raw8@ */ /end MEASUREMENT
/begin MEASUREMENT VTPM_ManualP3alarm_raw "" UBYTE SWC_FDC_type_CM_uint8_raw 0 0 0.0 200.0 ECU_ADDRESS 0x0000 /* @ECU_Address@VTPM_ManualP3alarm_raw@ */ /end MEASUREMENT
/begin MEASUREMENT VTPM_ManualS3pressindi_enum "" UBYTE SWC_FDC_type_CM_uint8_enum 0 0 0.0 200.0 ECU_ADDRESS 0x0000 /* @ECU_Address@VTPM_ManualS3pressindi_enum@ */ /end MEASUREMENT
/begin MEASUREMENT VTPM_ManualID3P20_raw8 "" UBYTE SWC_FDC_type_CM_uint8_raw8 0 0 0.0 255.0 ECU_ADDRESS 0x0000 /* @ECU_Address@VTPM_ManualID3P20_raw8@ */ /end MEASUREMENT
/begin MEASUREMENT VTPM_ManualP2alarm_raw "" UBYTE SWC_FDC_type_CM_uint8_raw 0 0 0.0 200.0 ECU_ADDRESS 0x0000 /* @ECU_Address@VTPM_ManualP2alarm_raw@ */ /end MEASUREMENT
/begin MEASUREMENT VTPM_ManualS2pressindi_enum "" UBYTE SWC_FDC_type_CM_uint8_enum 0 0 0.0 200.0 ECU_ADDRESS 0x0000 /* @ECU_Address@VTPM_ManualS2pressindi_enum@ */ /end MEASUREMENT
/begin MEASUREMENT VTPM_ManualID2P20_raw8 "" UBYTE SWC_FDC_type_CM_uint8_raw8 0 0 0.0 255.0 ECU_ADDRESS 0x0000 /* @ECU_Address@VTPM_ManualID2P20_raw8@ */ /end MEASUREMENT
/begin MEASUREMENT VTPM_Spressindi_enum "" UBYTE SWC_FDC_type_CM_uint8_enum 0 0 0.0 255.0 ECU_ADDRESS 0x0000 /* @ECU_Address@VTPM_Spressindi_enum@ */ /end MEASUREMENT
/begin MEASUREMENT VTPM_C_cnt "" UBYTE SWC_FDC_type_CM_uint8_cnt 0 0 0.0 255.0 ECU_ADDRESS 0x0000 /* @ECU_Address@VTPM_C_cnt@ */ /end MEASUREMENT
/begin MEASUREMENT VTPM_ManualP1alarm_raw "" UBYTE SWC_FDC_type_CM_uint8_raw 0 0 0.0 200.0 ECU_ADDRESS 0x0000 /* @ECU_Address@VTPM_ManualP1alarm_raw@ */ /end MEASUREMENT
/begin MEASUREMENT VTPM_ManualS1pressindi_enum "" UBYTE SWC_FDC_type_CM_uint8_enum 0 0 0.0 200.0 ECU_ADDRESS 0x0000 /* @ECU_Address@VTPM_ManualS1pressindi_enum@ */ /end MEASUREMENT
/begin MEASUREMENT VTPM_ManualID1P20_raw8 "" UBYTE SWC_FDC_type_CM_uint8_raw8 0 0 0.0 255.0 ECU_ADDRESS 0x0000 /* @ECU_Address@VTPM_ManualID1P20_raw8@ */ /end MEASUREMENT
/begin MEASUREMENT VVMC_IntMSACtrlSta_enum "" UBYTE SWC_FDC_type_CM_uint8_enum 0 0 0.0 8.0 ECU_ADDRESS 0x0000 /* @ECU_Address@VVMC_IntMSACtrlSta_enum@ */ /end MEASUREMENT
/begin MEASUREMENT VVMC_VehHoldDeltaAccSta_enum "" UBYTE SWC_FDC_type_CM_uint8_enum 0 0 0.0 2.0 ECU_ADDRESS 0x0000 /* @ECU_Address@VVMC_VehHoldDeltaAccSta_enum@ */ /end MEASUREMENT
/begin MEASUREMENT VVMC_FeatArbitrFinal_enum "" UBYTE SWC_FDC_type_CM_uint8_enum 0 0 0.0 6.0 ECU_ADDRESS 0x0000 /* @ECU_Address@VVMC_FeatArbitrFinal_enum@ */ /end MEASUREMENT
/begin MEASUREMENT VVMC_AltRDCActive_enum "" UBYTE SWC_FDC_type_CM_uint8_enum 0 0 0.0 15.0 ECU_ADDRESS 0x0000 /* @ECU_Address@VVMC_AltRDCActive_enum@ */ /end MEASUREMENT
/begin MEASUREMENT VVMC_RWDRDCActive_enum "" UBYTE SWC_FDC_type_CM_uint8_enum 0 0 0.0 2.0 ECU_ADDRESS 0x0000 /* @ECU_Address@VVMC_RWDRDCActive_enum@ */ /end MEASUREMENT
/begin MEASUREMENT VTQD_EstInitVehWightX_c "" UBYTE SWC_FDC_type_CM_uint8_c 0 0 0.0 255.0 ECU_ADDRESS 0x0000 /* @ECU_Address@VTQD_EstInitVehWightX_c@ */ /end MEASUREMENT
/begin MEASUREMENT VTQD_SetSpdDeltaLongFit_kph "" UBYTE SWC_FDC_type_CM_uint8_kph 0 0 0.0 255.0 ECU_ADDRESS 0x0000 /* @ECU_Address@VTQD_SetSpdDeltaLongFit_kph@ */ /end MEASUREMENT
/begin MEASUREMENT VBCM_TurnSwTSetSta_enum "" UBYTE SWC_FDC_type_CM_uint8_enum 0 0 0.0 255.0 ECU_ADDRESS 0x0000 /* @ECU_Address@VBCM_TurnSwTSetSta_enum@ */ /end MEASUREMENT
/begin MEASUREMENT VBCM_AmbColorSta_enum "" UBYTE SWC_FDC_type_CM_uint8_enum 0 0 0.0 127.0 ECU_ADDRESS 0x0000 /* @ECU_Address@VBCM_AmbColorSta_enum@ */ /end MEASUREMENT
/begin MEASUREMENT VBCM_AmbBrightSta_enum "" UBYTE SWC_FDC_type_CM_uint8_enum 0 0 0.0 127.0 ECU_ADDRESS 0x0000 /* @ECU_Address@VBCM_AmbBrightSta_enum@ */ /end MEASUREMENT
/begin MEASUREMENT VBCM_ACCLevelMem34_enum "" UBYTE SWC_FDC_type_CM_uint8_enum 0 0 0.0 255.0 ECU_ADDRESS 0x0000 /* @ECU_Address@VBCM_ACCLevelMem34_enum@ */ /end MEASUREMENT
/begin MEASUREMENT VBCM_ACCLevelMem12_enum "" UBYTE SWC_FDC_type_CM_uint8_enum 0 0 0.0 255.0 ECU_ADDRESS 0x0000 /* @ECU_Address@VBCM_ACCLevelMem12_enum@ */ /end MEASUREMENT
/begin MEASUREMENT VBCM_ACCLevelMem57_enum "" UBYTE SWC_FDC_type_CM_uint8_enum 0 0 0.0 255.0 ECU_ADDRESS 0x0000 /* @ECU_Address@VBCM_ACCLevelMem57_enum@ */ /end MEASUREMENT
/begin MEASUREMENT VBCM_AmbDimENFlash_enum "" UBYTE SWC_FDC_type_CM_uint8_enum 0 0 0.0 255.0 ECU_ADDRESS 0x0000 /* @ECU_Address@VBCM_AmbDimENFlash_enum@ */ /end MEASUREMENT
/begin MEASUREMENT VBCM_AmbFunENFlash_enum "" UBYTE SWC_FDC_type_CM_uint8_enum 0 0 0.0 255.0 ECU_ADDRESS 0x0000 /* @ECU_Address@VBCM_AmbFunENFlash_enum@ */ /end MEASUREMENT
/begin MEASUREMENT VBCM_AmbLinkDriStaFlash_enum "" UBYTE SWC_FDC_type_CM_uint8_enum 0 0 0.0 255.0 ECU_ADDRESS 0x0000 /* @ECU_Address@VBCM_AmbLinkDriStaFlash_enum@ */ /end MEASUREMENT
/begin MEASUREMENT VBCM_AmbODAENFlash_enum "" UBYTE SWC_FDC_type_CM_uint8_enum 0 0 0.0 255.0 ECU_ADDRESS 0x0000 /* @ECU_Address@VBCM_AmbODAENFlash_enum@ */ /end MEASUREMENT
/begin MEASUREMENT VBCM_AmbPwrWarnENFlash_enum "" UBYTE SWC_FDC_type_CM_uint8_enum 0 0 0.0 255.0 ECU_ADDRESS 0x0000 /* @ECU_Address@VBCM_AmbPwrWarnENFlash_enum@ */ /end MEASUREMENT
/begin MEASUREMENT VBCM_AmbWelENFlash_enum "" UBYTE SWC_FDC_type_CM_uint8_enum 0 0 0.0 255.0 ECU_ADDRESS 0x0000 /* @ECU_Address@VBCM_AmbWelENFlash_enum@ */ /end MEASUREMENT
/begin MEASUREMENT VBCM_AmbBrightnessSta1_enum "" UBYTE SWC_FDC_type_CM_uint8_enum 0 0 0.0 255.0 ECU_ADDRESS 0x0000 /* @ECU_Address@VBCM_AmbBrightnessSta1_enum@ */ /end MEASUREMENT
/begin MEASUREMENT VBCM_AmbBrightnessSta2_enum "" UBYTE SWC_FDC_type_CM_uint8_enum 0 0 0.0 255.0 ECU_ADDRESS 0x0000 /* @ECU_Address@VBCM_AmbBrightnessSta2_enum@ */ /end MEASUREMENT
/begin MEASUREMENT VBCM_AmbBrightnessSta3_enum "" UBYTE SWC_FDC_type_CM_uint8_enum 0 0 0.0 255.0 ECU_ADDRESS 0x0000 /* @ECU_Address@VBCM_AmbBrightnessSta3_enum@ */ /end MEASUREMENT
/begin MEASUREMENT VBCM_AmbBrightnessSta4_enum "" UBYTE SWC_FDC_type_CM_uint8_enum 0 0 0.0 255.0 ECU_ADDRESS 0x0000 /* @ECU_Address@VBCM_AmbBrightnessSta4_enum@ */ /end MEASUREMENT
/begin MEASUREMENT VBCM_AmbBrightnessSta5_enum "" UBYTE SWC_FDC_type_CM_uint8_enum 0 0 0.0 255.0 ECU_ADDRESS 0x0000 /* @ECU_Address@VBCM_AmbBrightnessSta5_enum@ */ /end MEASUREMENT
/begin MEASUREMENT VBCM_AmbBrightnessSta7_enum "" UBYTE SWC_FDC_type_CM_uint8_enum 0 0 0.0 255.0 ECU_ADDRESS 0x0000 /* @ECU_Address@VBCM_AmbBrightnessSta7_enum@ */ /end MEASUREMENT
/begin MEASUREMENT VBCM_AmbColorSta1_enum "" UBYTE SWC_FDC_type_CM_uint8_enum 0 0 0.0 255.0 ECU_ADDRESS 0x0000 /* @ECU_Address@VBCM_AmbColorSta1_enum@ */ /end MEASUREMENT
/begin MEASUREMENT VBCM_AmbColorSta2_enum "" UBYTE SWC_FDC_type_CM_uint8_enum 0 0 0.0 255.0 ECU_ADDRESS 0x0000 /* @ECU_Address@VBCM_AmbColorSta2_enum@ */ /end MEASUREMENT
/begin MEASUREMENT VBCM_AmbColorSta3_enum "" UBYTE SWC_FDC_type_CM_uint8_enum 0 0 0.0 255.0 ECU_ADDRESS 0x0000 /* @ECU_Address@VBCM_AmbColorSta3_enum@ */ /end MEASUREMENT
/begin MEASUREMENT VBCM_AmbColorSta4_enum "" UBYTE SWC_FDC_type_CM_uint8_enum 0 0 0.0 255.0 ECU_ADDRESS 0x0000 /* @ECU_Address@VBCM_AmbColorSta4_enum@ */ /end MEASUREMENT
/begin MEASUREMENT VBCM_AmbColorSta5_enum "" UBYTE SWC_FDC_type_CM_uint8_enum 0 0 0.0 255.0 ECU_ADDRESS 0x0000 /* @ECU_Address@VBCM_AmbColorSta5_enum@ */ /end MEASUREMENT
/begin MEASUREMENT VBCM_AmbColorSta7_enum "" UBYTE SWC_FDC_type_CM_uint8_enum 0 0 0.0 255.0 ECU_ADDRESS 0x0000 /* @ECU_Address@VBCM_AmbColorSta7_enum@ */ /end MEASUREMENT
/begin MEASUREMENT VBCM_AutoUnlockMem_enum "" UBYTE SWC_FDC_type_CM_uint8_enum 0 0 0.0 255.0 ECU_ADDRESS 0x0000 /* @ECU_Address@VBCM_AutoUnlockMem_enum@ */ /end MEASUREMENT
/begin MEASUREMENT VBCM_WalkInUnLkENMem_enum "" UBYTE SWC_FDC_type_CM_uint8_enum 0 0 0.0 255.0 ECU_ADDRESS 0x0000 /* @ECU_Address@VBCM_WalkInUnLkENMem_enum@ */ /end MEASUREMENT
/begin MEASUREMENT VBCM_WalkOutLkENMem_enum "" UBYTE SWC_FDC_type_CM_uint8_enum 0 0 0.0 255.0 ECU_ADDRESS 0x0000 /* @ECU_Address@VBCM_WalkOutLkENMem_enum@ */ /end MEASUREMENT
/begin MEASUREMENT VBCM_TurnSwTimeSetSta457_enum "" UBYTE SWC_FDC_type_CM_uint8_enum 0 0 0.0 255.0 ECU_ADDRESS 0x0000 /* @ECU_Address@VBCM_TurnSwTimeSetSta457_enum@ */ /end MEASUREMENT
/begin MEASUREMENT VBCM_TurnSwTimeSetSta123_enum "" UBYTE SWC_FDC_type_CM_uint8_enum 0 0 0.0 255.0 ECU_ADDRESS 0x0000 /* @ECU_Address@VBCM_TurnSwTimeSetSta123_enum@ */ /end MEASUREMENT
/begin MEASUREMENT VBCM_FollowMeENMem_enum "" UBYTE SWC_FDC_type_CM_uint8_enum 0 0 0.0 255.0 ECU_ADDRESS 0x0000 /* @ECU_Address@VBCM_FollowMeENMem_enum@ */ /end MEASUREMENT
/begin MEASUREMENT VBCM_LockSettingStaMem_enum "" UBYTE SWC_FDC_type_CM_uint8_enum 0 0 0.0 255.0 ECU_ADDRESS 0x0000 /* @ECU_Address@VBCM_LockSettingStaMem_enum@ */ /end MEASUREMENT
/begin MEASUREMENT VBCM_PTGOpenHeightSta_enum "" UBYTE SWC_FDC_type_CM_uint8_enum 0 0 0.0 255.0 ECU_ADDRESS 0x0000 /* @ECU_Address@VBCM_PTGOpenHeightSta_enum@ */ /end MEASUREMENT
/begin MEASUREMENT VBCM_PTGOpenHeight34_enum "" UBYTE SWC_FDC_type_CM_uint8_enum 0 0 0.0 255.0 ECU_ADDRESS 0x0000 /* @ECU_Address@VBCM_PTGOpenHeight34_enum@ */ /end MEASUREMENT
/begin MEASUREMENT VBCM_PTGOpenHeight12_enum "" UBYTE SWC_FDC_type_CM_uint8_enum 0 0 0.0 255.0 ECU_ADDRESS 0x0000 /* @ECU_Address@VBCM_PTGOpenHeight12_enum@ */ /end MEASUREMENT
/begin MEASUREMENT VBCM_PTGOpenHeight57_enum "" UBYTE SWC_FDC_type_CM_uint8_enum 0 0 0.0 255.0 ECU_ADDRESS 0x0000 /* @ECU_Address@VBCM_PTGOpenHeight57_enum@ */ /end MEASUREMENT
/begin MEASUREMENT VBCM_RmLpModeENMem_enum "" UBYTE SWC_FDC_type_CM_uint8_enum 0 0 0.0 255.0 ECU_ADDRESS 0x0000 /* @ECU_Address@VBCM_RmLpModeENMem_enum@ */ /end MEASUREMENT
/begin MEASUREMENT VBCM_SPTGENFunMem_enum "" UBYTE SWC_FDC_type_CM_uint8_enum 0 0 0.0 255.0 ECU_ADDRESS 0x0000 /* @ECU_Address@VBCM_SPTGENFunMem_enum@ */ /end MEASUREMENT
/begin MEASUREMENT VTPM_LFSensorFail_flg "" UBYTE SWC_FDC_type_CM_boolean_flg 0 0 0.0 1.0 ECU_ADDRESS 0x0000 /* @ECU_Address@VTPM_LFSensorFail_flg@ */ /end MEASUREMENT
/begin MEASUREMENT VTPM_RFSensorFail_flg "" UBYTE SWC_FDC_type_CM_boolean_flg 0 0 0.0 1.0 ECU_ADDRESS 0x0000 /* @ECU_Address@VTPM_RFSensorFail_flg@ */ /end MEASUREMENT
/begin MEASUREMENT VTPM_LRSensorFail_flg "" UBYTE SWC_FDC_type_CM_boolean_flg 0 0 0.0 1.0 ECU_ADDRESS 0x0000 /* @ECU_Address@VTPM_LRSensorFail_flg@ */ /end MEASUREMENT
/begin MEASUREMENT VTPM_RRSensorFail_flg "" UBYTE SWC_FDC_type_CM_boolean_flg 0 0 0.0 1.0 ECU_ADDRESS 0x0000 /* @ECU_Address@VTPM_RRSensorFail_flg@ */ /end MEASUREMENT
/begin MEASUREMENT VTPM_TPMSCaliButtAllow_flg "" UBYTE SWC_FDC_type_CM_boolean_flg 0 0 0.0 1.0 ECU_ADDRESS 0x0000 /* @ECU_Address@VTPM_TPMSCaliButtAllow_flg@ */ /end MEASUREMENT
/begin MEASUREMENT VTPM_TPMSResButtAllow_flg "" UBYTE SWC_FDC_type_CM_boolean_flg 0 0 0.0 1.0 ECU_ADDRESS 0x0000 /* @ECU_Address@VTPM_TPMSResButtAllow_flg@ */ /end MEASUREMENT
/begin MEASUREMENT VTPM_RRBatWarn_flg "" UBYTE SWC_FDC_type_CM_boolean_flg 0 0 0.0 1.0 ECU_ADDRESS 0x0000 /* @ECU_Address@VTPM_RRBatWarn_flg@ */ /end MEASUREMENT
/begin MEASUREMENT VTPM_RRWheelDebug_flg "" UBYTE SWC_FDC_type_CM_boolean_flg 0 0 0.0 1.0 ECU_ADDRESS 0x0000 /* @ECU_Address@VTPM_RRWheelDebug_flg@ */ /end MEASUREMENT
/begin MEASUREMENT VTPM_RRSensorMode_flg "" UBYTE SWC_FDC_type_CM_boolean_flg 0 0 0.0 1.0 ECU_ADDRESS 0x0000 /* @ECU_Address@VTPM_RRSensorMode_flg@ */ /end MEASUREMENT
/begin MEASUREMENT VTPM_RFBatWarn_flg "" UBYTE SWC_FDC_type_CM_boolean_flg 0 0 0.0 1.0 ECU_ADDRESS 0x0000 /* @ECU_Address@VTPM_RFBatWarn_flg@ */ /end MEASUREMENT
/begin MEASUREMENT VTPM_RFWheelDebug_flg "" UBYTE SWC_FDC_type_CM_boolean_flg 0 0 0.0 1.0 ECU_ADDRESS 0x0000 /* @ECU_Address@VTPM_RFWheelDebug_flg@ */ /end MEASUREMENT
/begin MEASUREMENT VTPM_RFSensorMode_flg "" UBYTE SWC_FDC_type_CM_boolean_flg 0 0 0.0 1.0 ECU_ADDRESS 0x0000 /* @ECU_Address@VTPM_RFSensorMode_flg@ */ /end MEASUREMENT
/begin MEASUREMENT VTPM_LRBatWarn_flg "" UBYTE SWC_FDC_type_CM_boolean_flg 0 0 0.0 1.0 ECU_ADDRESS 0x0000 /* @ECU_Address@VTPM_LRBatWarn_flg@ */ /end MEASUREMENT
/begin MEASUREMENT VTPM_LRWheelDebug_flg "" UBYTE SWC_FDC_type_CM_boolean_flg 0 0 0.0 1.0 ECU_ADDRESS 0x0000 /* @ECU_Address@VTPM_LRWheelDebug_flg@ */ /end MEASUREMENT
/begin MEASUREMENT VTPM_LRSensorMode_flg "" UBYTE SWC_FDC_type_CM_boolean_flg 0 0 0.0 1.0 ECU_ADDRESS 0x0000 /* @ECU_Address@VTPM_LRSensorMode_flg@ */ /end MEASUREMENT
/begin MEASUREMENT VTPM_LFBatWarn_flg "" UBYTE SWC_FDC_type_CM_boolean_flg 0 0 0.0 1.0 ECU_ADDRESS 0x0000 /* @ECU_Address@VTPM_LFBatWarn_flg@ */ /end MEASUREMENT
/begin MEASUREMENT VTPM_LFWheelDebug_flg "" UBYTE SWC_FDC_type_CM_boolean_flg 0 0 0.0 1.0 ECU_ADDRESS 0x0000 /* @ECU_Address@VTPM_LFWheelDebug_flg@ */ /end MEASUREMENT
/begin MEASUREMENT VTPM_LFSensorMode_flg "" UBYTE SWC_FDC_type_CM_boolean_flg 0 0 0.0 1.0 ECU_ADDRESS 0x0000 /* @ECU_Address@VTPM_LFSensorMode_flg@ */ /end MEASUREMENT
/begin MEASUREMENT VVMC_HoodSpdLimitEn_flg "" UBYTE SWC_FDC_type_CM_boolean_flg 0 0 0.0 1.0 ECU_ADDRESS 0x0000 /* @ECU_Address@VVMC_HoodSpdLimitEn_flg@ */ /end MEASUREMENT
/begin MEASUREMENT VVMC_SmartEcoEn_flg "" UBYTE SWC_FDC_type_CM_boolean_flg 0 0 0.0 1.0 ECU_ADDRESS 0x0000 /* @ECU_Address@VVMC_SmartEcoEn_flg@ */ /end MEASUREMENT
/begin MEASUREMENT VVMC_AntiSpdLimEn_flg "" UBYTE SWC_FDC_type_CM_boolean_flg 0 0 0.0 1.0 ECU_ADDRESS 0x0000 /* @ECU_Address@VVMC_AntiSpdLimEn_flg@ */ /end MEASUREMENT
/begin MEASUREMENT VVMC_AntiSpdLimSpdEn_flg "" UBYTE SWC_FDC_type_CM_boolean_flg 0 0 0.0 1.0 ECU_ADDRESS 0x0000 /* @ECU_Address@VVMC_AntiSpdLimSpdEn_flg@ */ /end MEASUREMENT
/begin MEASUREMENT VVMC_AntiSpdLimStaEn_flg "" UBYTE SWC_FDC_type_CM_boolean_flg 0 0 0.0 1.0 ECU_ADDRESS 0x0000 /* @ECU_Address@VVMC_AntiSpdLimStaEn_flg@ */ /end MEASUREMENT
/begin MEASUREMENT VVMC_DISCDecCtrl_flg "" UBYTE SWC_FDC_type_CM_boolean_flg 0 0 0.0 1.0 ECU_ADDRESS 0x0000 /* @ECU_Address@VVMC_DISCDecCtrl_flg@ */ /end MEASUREMENT
/begin MEASUREMENT VVMC_WhlStandstill_flg "" UBYTE SWC_FDC_type_CM_boolean_flg 0 0 0.0 1.0 ECU_ADDRESS 0x0000 /* @ECU_Address@VVMC_WhlStandstill_flg@ */ /end MEASUREMENT
/begin MEASUREMENT VVMC_WhlStandstillReachT_flg "" UBYTE SWC_FDC_type_CM_boolean_flg 0 0 0.0 1.0 ECU_ADDRESS 0x0000 /* @ECU_Address@VVMC_WhlStandstillReachT_flg@ */ /end MEASUREMENT
/begin MEASUREMENT VVMC_WhlBackward_flg "" UBYTE SWC_FDC_type_CM_boolean_flg 0 0 0.0 1.0 ECU_ADDRESS 0x0000 /* @ECU_Address@VVMC_WhlBackward_flg@ */ /end MEASUREMENT
/begin MEASUREMENT VVMC_AccelTurnHoldDet_flg "" UBYTE SWC_FDC_type_CM_boolean_flg 0 0 0.0 1.0 ECU_ADDRESS 0x0000 /* @ECU_Address@VVMC_AccelTurnHoldDet_flg@ */ /end MEASUREMENT
/begin MEASUREMENT VVMC_VHDecCtrlCalSW2Inc_flg "" UBYTE SWC_FDC_type_CM_boolean_flg 0 0 0.0 1.0 ECU_ADDRESS 0x0000 /* @ECU_Address@VVMC_VHDecCtrlCalSW2Inc_flg@ */ /end MEASUREMENT
/begin MEASUREMENT VVMC_VHDecCtrlCalSW2ReachDec_flg "" UBYTE SWC_FDC_type_CM_boolean_flg 0 0 0.0 1.0 ECU_ADDRESS 0x0000 /* @ECU_Address@VVMC_VHDecCtrlCalSW2ReachDec_flg@ */ /end MEASUREMENT
/begin MEASUREMENT VVMC_AccAct_flg "" UBYTE SWC_FDC_type_CM_boolean_flg 0 0 0.0 1.0 ECU_ADDRESS 0x0000 /* @ECU_Address@VVMC_AccAct_flg@ */ /end MEASUREMENT
/begin MEASUREMENT VVMC_AbsDeltaSpdNotZero_flg "" UBYTE SWC_FDC_type_CM_boolean_flg 0 0 0.0 1.0 ECU_ADDRESS 0x0000 /* @ECU_Address@VVMC_AbsDeltaSpdNotZero_flg@ */ /end MEASUREMENT
/begin MEASUREMENT VVMC_ReqAccelActive_flg "" UBYTE SWC_FDC_type_CM_boolean_flg 0 0 0.0 1.0 ECU_ADDRESS 0x0000 /* @ECU_Address@VVMC_ReqAccelActive_flg@ */ /end MEASUREMENT
/begin MEASUREMENT VVMC_ACCVehHoldReq_flg "" UBYTE SWC_FDC_type_CM_boolean_flg 0 0 0.0 1.0 ECU_ADDRESS 0x0000 /* @ECU_Address@VVMC_ACCVehHoldReq_flg@ */ /end MEASUREMENT
/begin MEASUREMENT VVMC_ADASWhlTqReachLim_flg "" UBYTE SWC_FDC_type_CM_boolean_flg 0 0 0.0 1.0 ECU_ADDRESS 0x0000 /* @ECU_Address@VVMC_ADASWhlTqReachLim_flg@ */ /end MEASUREMENT
/begin MEASUREMENT VVMC_ADSPosGFBEn_flg "" UBYTE SWC_FDC_type_CM_boolean_flg 0 0 0.0 1.0 ECU_ADDRESS 0x0000 /* @ECU_Address@VVMC_ADSPosGFBEn_flg@ */ /end MEASUREMENT
/begin MEASUREMENT VVMC_ADSPosGFBDis_flg "" UBYTE SWC_FDC_type_CM_boolean_flg 0 0 0.0 1.0 ECU_ADDRESS 0x0000 /* @ECU_Address@VVMC_ADSPosGFBDis_flg@ */ /end MEASUREMENT
/begin MEASUREMENT VVMC_ADSDecShiftEn_flg "" UBYTE SWC_FDC_type_CM_boolean_flg 0 0 0.0 1.0 ECU_ADDRESS 0x0000 /* @ECU_Address@VVMC_ADSDecShiftEn_flg@ */ /end MEASUREMENT
/begin MEASUREMENT VVMC_LDW1stTrigged_flg "" UBYTE SWC_FDC_type_CM_boolean_flg 0 0 0.0 1.0 ECU_ADDRESS 0x0000 /* @ECU_Address@VVMC_LDW1stTrigged_flg@ */ /end MEASUREMENT
/begin MEASUREMENT VVMC_LDWRestTrigged_flg "" UBYTE SWC_FDC_type_CM_boolean_flg 0 0 0.0 1.0 ECU_ADDRESS 0x0000 /* @ECU_Address@VVMC_LDWRestTrigged_flg@ */ /end MEASUREMENT
/begin MEASUREMENT VVMC_LDW2ndTrigged_flg "" UBYTE SWC_FDC_type_CM_boolean_flg 0 0 0.0 1.0 ECU_ADDRESS 0x0000 /* @ECU_Address@VVMC_LDW2ndTrigged_flg@ */ /end MEASUREMENT
/begin MEASUREMENT VVMC_IntMSAActive_flg "" UBYTE SWC_FDC_type_CM_boolean_flg 0 0 0.0 1.0 ECU_ADDRESS 0x0000 /* @ECU_Address@VVMC_IntMSAActive_flg@ */ /end MEASUREMENT
/begin MEASUREMENT VVMC_MSAOvrdProhibit_flg "" UBYTE SWC_FDC_type_CM_boolean_flg 0 0 0.0 1.0 ECU_ADDRESS 0x0000 /* @ECU_Address@VVMC_MSAOvrdProhibit_flg@ */ /end MEASUREMENT
/begin MEASUREMENT VVMC_MSAInCtrlSpd_flg "" UBYTE SWC_FDC_type_CM_boolean_flg 0 0 0.0 1.0 ECU_ADDRESS 0x0000 /* @ECU_Address@VVMC_MSAInCtrlSpd_flg@ */ /end MEASUREMENT
/begin MEASUREMENT VVMC_4WheelSlide_flg "" UBYTE SWC_FDC_type_CM_boolean_flg 0 0 0.0 1.0 ECU_ADDRESS 0x0000 /* @ECU_Address@VVMC_4WheelSlide_flg@ */ /end MEASUREMENT
/begin MEASUREMENT VVMC_SlideRateEnCal_flg "" UBYTE SWC_FDC_type_CM_boolean_flg 0 0 0.0 1.0 ECU_ADDRESS 0x0000 /* @ECU_Address@VVMC_SlideRateEnCal_flg@ */ /end MEASUREMENT
/begin MEASUREMENT VVMC_OPDDisSlideRate_flg "" UBYTE SWC_FDC_type_CM_boolean_flg 0 0 0.0 1.0 ECU_ADDRESS 0x0000 /* @ECU_Address@VVMC_OPDDisSlideRate_flg@ */ /end MEASUREMENT
/begin MEASUREMENT VVMC_IntMSASpdWar_flg "" UBYTE SWC_FDC_type_CM_boolean_flg 0 0 0.0 1.0 ECU_ADDRESS 0x0000 /* @ECU_Address@VVMC_IntMSASpdWar_flg@ */ /end MEASUREMENT
/begin MEASUREMENT VVMC_ESCSlip_flg "" UBYTE SWC_FDC_type_CM_boolean_flg 0 0 0.0 1.0 ECU_ADDRESS 0x0000 /* @ECU_Address@VVMC_ESCSlip_flg@ */ /end MEASUREMENT
/begin MEASUREMENT VVMC_MSAWhlTqActive_flg "" UBYTE SWC_FDC_type_CM_boolean_flg 0 0 0.0 1.0 ECU_ADDRESS 0x0000 /* @ECU_Address@VVMC_MSAWhlTqActive_flg@ */ /end MEASUREMENT
/begin MEASUREMENT VVMC_LDWRest2Trigged_flg "" UBYTE SWC_FDC_type_CM_boolean_flg 0 0 0.0 1.0 ECU_ADDRESS 0x0000 /* @ECU_Address@VVMC_LDWRest2Trigged_flg@ */ /end MEASUREMENT
/begin MEASUREMENT VTQD_DriveProtEn_flg "" UBYTE SWC_FDC_type_CM_boolean_flg 0 0 0.0 1.0 ECU_ADDRESS 0x0000 /* @ECU_Address@VTQD_DriveProtEn_flg@ */ /end MEASUREMENT
/begin MEASUREMENT VTQD_DriveProtToPsnN_flg "" UBYTE SWC_FDC_type_CM_boolean_flg 0 0 0.0 1.0 ECU_ADDRESS 0x0000 /* @ECU_Address@VTQD_DriveProtToPsnN_flg@ */ /end MEASUREMENT
/begin MEASUREMENT VTQD_LFWhlSkip_flg "" UBYTE SWC_FDC_type_CM_boolean_flg 0 0 0.0 1.0 ECU_ADDRESS 0x0000 /* @ECU_Address@VTQD_LFWhlSkip_flg@ */ /end MEASUREMENT
/begin MEASUREMENT VTQD_RFWhlSkip_flg "" UBYTE SWC_FDC_type_CM_boolean_flg 0 0 0.0 1.0 ECU_ADDRESS 0x0000 /* @ECU_Address@VTQD_RFWhlSkip_flg@ */ /end MEASUREMENT
/begin MEASUREMENT VTQD_LRWhlSkip_flg "" UBYTE SWC_FDC_type_CM_boolean_flg 0 0 0.0 1.0 ECU_ADDRESS 0x0000 /* @ECU_Address@VTQD_LRWhlSkip_flg@ */ /end MEASUREMENT
/begin MEASUREMENT VTQD_RRWhlSkip_flg "" UBYTE SWC_FDC_type_CM_boolean_flg 0 0 0.0 1.0 ECU_ADDRESS 0x0000 /* @ECU_Address@VTQD_RRWhlSkip_flg@ */ /end MEASUREMENT
/begin MEASUREMENT VTQD_PosLeftWhlSkip_flg "" UBYTE SWC_FDC_type_CM_boolean_flg 0 0 0.0 1.0 ECU_ADDRESS 0x0000 /* @ECU_Address@VTQD_PosLeftWhlSkip_flg@ */ /end MEASUREMENT
/begin MEASUREMENT VTQD_NegLeftWhlSkip_flg "" UBYTE SWC_FDC_type_CM_boolean_flg 0 0 0.0 1.0 ECU_ADDRESS 0x0000 /* @ECU_Address@VTQD_NegLeftWhlSkip_flg@ */ /end MEASUREMENT
/begin MEASUREMENT VTQD_NegRightWhlSkip_flg "" UBYTE SWC_FDC_type_CM_boolean_flg 0 0 0.0 1.0 ECU_ADDRESS 0x0000 /* @ECU_Address@VTQD_NegRightWhlSkip_flg@ */ /end MEASUREMENT
/begin MEASUREMENT VTQD_PosFrontWhlSkip_flg "" UBYTE SWC_FDC_type_CM_boolean_flg 0 0 0.0 1.0 ECU_ADDRESS 0x0000 /* @ECU_Address@VTQD_PosFrontWhlSkip_flg@ */ /end MEASUREMENT
/begin MEASUREMENT VTQD_NegFrontWhlSkip_flg "" UBYTE SWC_FDC_type_CM_boolean_flg 0 0 0.0 1.0 ECU_ADDRESS 0x0000 /* @ECU_Address@VTQD_NegFrontWhlSkip_flg@ */ /end MEASUREMENT
/begin MEASUREMENT VTQD_PosRearWhlSkip_flg "" UBYTE SWC_FDC_type_CM_boolean_flg 0 0 0.0 1.0 ECU_ADDRESS 0x0000 /* @ECU_Address@VTQD_PosRearWhlSkip_flg@ */ /end MEASUREMENT
/begin MEASUREMENT VTQD_NegRearWhlSkip_flg "" UBYTE SWC_FDC_type_CM_boolean_flg 0 0 0.0 1.0 ECU_ADDRESS 0x0000 /* @ECU_Address@VTQD_NegRearWhlSkip_flg@ */ /end MEASUREMENT
/begin MEASUREMENT VTQD_PosLFRRWhlSkip_flg "" UBYTE SWC_FDC_type_CM_boolean_flg 0 0 0.0 1.0 ECU_ADDRESS 0x0000 /* @ECU_Address@VTQD_PosLFRRWhlSkip_flg@ */ /end MEASUREMENT
/begin MEASUREMENT VTQD_NegLFRRWhlSkip_flg "" UBYTE SWC_FDC_type_CM_boolean_flg 0 0 0.0 1.0 ECU_ADDRESS 0x0000 /* @ECU_Address@VTQD_NegLFRRWhlSkip_flg@ */ /end MEASUREMENT
/begin MEASUREMENT VTQD_PosRFLRWhlSkip_flg "" UBYTE SWC_FDC_type_CM_boolean_flg 0 0 0.0 1.0 ECU_ADDRESS 0x0000 /* @ECU_Address@VTQD_PosRFLRWhlSkip_flg@ */ /end MEASUREMENT
/begin MEASUREMENT VTQD_NegRFLRWhlSkip_flg "" UBYTE SWC_FDC_type_CM_boolean_flg 0 0 0.0 1.0 ECU_ADDRESS 0x0000 /* @ECU_Address@VTQD_NegRFLRWhlSkip_flg@ */ /end MEASUREMENT
/begin MEASUREMENT VTQD_FrontLRWhlSkip_flg "" UBYTE SWC_FDC_type_CM_boolean_flg 0 0 0.0 1.0 ECU_ADDRESS 0x0000 /* @ECU_Address@VTQD_FrontLRWhlSkip_flg@ */ /end MEASUREMENT
/begin MEASUREMENT VTQD_FrontRRWhlSkip_flg "" UBYTE SWC_FDC_type_CM_boolean_flg 0 0 0.0 1.0 ECU_ADDRESS 0x0000 /* @ECU_Address@VTQD_FrontRRWhlSkip_flg@ */ /end MEASUREMENT
/begin MEASUREMENT VTQD_RearLFWhlSkip_flg "" UBYTE SWC_FDC_type_CM_boolean_flg 0 0 0.0 1.0 ECU_ADDRESS 0x0000 /* @ECU_Address@VTQD_RearLFWhlSkip_flg@ */ /end MEASUREMENT
/begin MEASUREMENT VTQD_RearRFWhlSkip_flg "" UBYTE SWC_FDC_type_CM_boolean_flg 0 0 0.0 1.0 ECU_ADDRESS 0x0000 /* @ECU_Address@VTQD_RearRFWhlSkip_flg@ */ /end MEASUREMENT
/begin MEASUREMENT VTQD_AllWhlSkip_flg "" UBYTE SWC_FDC_type_CM_boolean_flg 0 0 0.0 1.0 ECU_ADDRESS 0x0000 /* @ECU_Address@VTQD_AllWhlSkip_flg@ */ /end MEASUREMENT
/begin MEASUREMENT VTQD_TripleWhlSkip_flg "" UBYTE SWC_FDC_type_CM_boolean_flg 0 0 0.0 1.0 ECU_ADDRESS 0x0000 /* @ECU_Address@VTQD_TripleWhlSkip_flg@ */ /end MEASUREMENT
/begin MEASUREMENT VTQD_DoubleWhlSkip_flg "" UBYTE SWC_FDC_type_CM_boolean_flg 0 0 0.0 1.0 ECU_ADDRESS 0x0000 /* @ECU_Address@VTQD_DoubleWhlSkip_flg@ */ /end MEASUREMENT
/begin MEASUREMENT VTQD_SingleWhlSkip_flg "" UBYTE SWC_FDC_type_CM_boolean_flg 0 0 0.0 1.0 ECU_ADDRESS 0x0000 /* @ECU_Address@VTQD_SingleWhlSkip_flg@ */ /end MEASUREMENT
/begin MEASUREMENT VTQD_VehWeightEstEnCon1_flg "" UBYTE SWC_FDC_type_CM_boolean_flg 0 0 0.0 1.0 ECU_ADDRESS 0x0000 /* @ECU_Address@VTQD_VehWeightEstEnCon1_flg@ */ /end MEASUREMENT
/begin MEASUREMENT VTQD_VehWeightEstEnCon2_flg "" UBYTE SWC_FDC_type_CM_boolean_flg 0 0 0.0 1.0 ECU_ADDRESS 0x0000 /* @ECU_Address@VTQD_VehWeightEstEnCon2_flg@ */ /end MEASUREMENT
/begin MEASUREMENT VTQD_VehWeightEstEnCon3_flg "" UBYTE SWC_FDC_type_CM_boolean_flg 0 0 0.0 1.0 ECU_ADDRESS 0x0000 /* @ECU_Address@VTQD_VehWeightEstEnCon3_flg@ */ /end MEASUREMENT
/begin MEASUREMENT VTQD_VehWeightEstEnCon4_flg "" UBYTE SWC_FDC_type_CM_boolean_flg 0 0 0.0 1.0 ECU_ADDRESS 0x0000 /* @ECU_Address@VTQD_VehWeightEstEnCon4_flg@ */ /end MEASUREMENT
/begin MEASUREMENT VTQD_VehWeightEstEnCon5_flg "" UBYTE SWC_FDC_type_CM_boolean_flg 0 0 0.0 1.0 ECU_ADDRESS 0x0000 /* @ECU_Address@VTQD_VehWeightEstEnCon5_flg@ */ /end MEASUREMENT
/begin MEASUREMENT VTQD_VehWeightEstEnCon6_flg "" UBYTE SWC_FDC_type_CM_boolean_flg 0 0 0.0 1.0 ECU_ADDRESS 0x0000 /* @ECU_Address@VTQD_VehWeightEstEnCon6_flg@ */ /end MEASUREMENT
/begin MEASUREMENT VTQD_VehWeightEstEnCon7_flg "" UBYTE SWC_FDC_type_CM_boolean_flg 0 0 0.0 1.0 ECU_ADDRESS 0x0000 /* @ECU_Address@VTQD_VehWeightEstEnCon7_flg@ */ /end MEASUREMENT
/begin MEASUREMENT VTQD_VehWeightEstEnCon8_flg "" UBYTE SWC_FDC_type_CM_boolean_flg 0 0 0.0 1.0 ECU_ADDRESS 0x0000 /* @ECU_Address@VTQD_VehWeightEstEnCon8_flg@ */ /end MEASUREMENT
/begin MEASUREMENT VTQD_VehWeightEstEnCon9_flg "" UBYTE SWC_FDC_type_CM_boolean_flg 0 0 0.0 1.0 ECU_ADDRESS 0x0000 /* @ECU_Address@VTQD_VehWeightEstEnCon9_flg@ */ /end MEASUREMENT
/begin MEASUREMENT VTQD_VehWeightEstEnCon10_flg "" UBYTE SWC_FDC_type_CM_boolean_flg 0 0 0.0 1.0 ECU_ADDRESS 0x0000 /* @ECU_Address@VTQD_VehWeightEstEnCon10_flg@ */ /end MEASUREMENT
/begin MEASUREMENT VTQD_VehWeightEstEnCon11_flg "" UBYTE SWC_FDC_type_CM_boolean_flg 0 0 0.0 1.0 ECU_ADDRESS 0x0000 /* @ECU_Address@VTQD_VehWeightEstEnCon11_flg@ */ /end MEASUREMENT
/begin MEASUREMENT VTQD_VehWeightEstEnCon12_flg "" UBYTE SWC_FDC_type_CM_boolean_flg 0 0 0.0 1.0 ECU_ADDRESS 0x0000 /* @ECU_Address@VTQD_VehWeightEstEnCon12_flg@ */ /end MEASUREMENT
/begin MEASUREMENT VTQD_VehWeightEstDis_flg "" UBYTE SWC_FDC_type_CM_boolean_flg 0 0 0.0 1.0 ECU_ADDRESS 0x0000 /* @ECU_Address@VTQD_VehWeightEstDis_flg@ */ /end MEASUREMENT
/begin MEASUREMENT VTQD_VehWeightEstEnter_flg "" UBYTE SWC_FDC_type_CM_boolean_flg 0 0 0.0 1.0 ECU_ADDRESS 0x0000 /* @ECU_Address@VTQD_VehWeightEstEnter_flg@ */ /end MEASUREMENT
/begin MEASUREMENT VTQD_EstVehWeitResetFinish_flg "" UBYTE SWC_FDC_type_CM_boolean_flg 0 0 0.0 1.0 ECU_ADDRESS 0x0000 /* @ECU_Address@VTQD_EstVehWeitResetFinish_flg@ */ /end MEASUREMENT
/begin MEASUREMENT VTQD_SpdCtrlShortP_flg "" UBYTE SWC_FDC_type_CM_boolean_flg 0 0 0.0 1.0 ECU_ADDRESS 0x0000 /* @ECU_Address@VTQD_SpdCtrlShortP_flg@ */ /end MEASUREMENT
/begin MEASUREMENT VTQD_SpdCtrlLongP_flg "" UBYTE SWC_FDC_type_CM_boolean_flg 0 0 0.0 1.0 ECU_ADDRESS 0x0000 /* @ECU_Address@VTQD_SpdCtrlLongP_flg@ */ /end MEASUREMENT
/begin MEASUREMENT VTQD_LScrollPressLong_flg "" UBYTE SWC_FDC_type_CM_boolean_flg 0 0 0.0 1.0 ECU_ADDRESS 0x0000 /* @ECU_Address@VTQD_LScrollPressLong_flg@ */ /end MEASUREMENT
/begin MEASUREMENT VTQD_LScrollPressShort_flg "" UBYTE SWC_FDC_type_CM_boolean_flg 0 0 0.0 1.0 ECU_ADDRESS 0x0000 /* @ECU_Address@VTQD_LScrollPressShort_flg@ */ /end MEASUREMENT
/begin MEASUREMENT VDHP_EAPS1Learned_flg "" UBYTE SWC_FDC_type_CM_boolean_flg 0 0 0.0 1.0 ECU_ADDRESS 0x0000 /* @ECU_Address@VDHP_EAPS1Learned_flg@ */ /end MEASUREMENT
/begin MEASUREMENT VDHP_EAPS2Learned_flg "" UBYTE SWC_FDC_type_CM_boolean_flg 0 0 0.0 1.0 ECU_ADDRESS 0x0000 /* @ECU_Address@VDHP_EAPS2Learned_flg@ */ /end MEASUREMENT
/begin MEASUREMENT VBCM_AmbFunEN_flg "" UBYTE SWC_FDC_type_CM_boolean_flg 0 0 0.0 1.0 ECU_ADDRESS 0x0000 /* @ECU_Address@VBCM_AmbFunEN_flg@ */ /end MEASUREMENT
/begin MEASUREMENT VBCM_SPTGENFun_flg "" UBYTE SWC_FDC_type_CM_boolean_flg 0 0 0.0 1.0 ECU_ADDRESS 0x0000 /* @ECU_Address@VBCM_SPTGENFun_flg@ */ /end MEASUREMENT
/begin MEASUREMENT VBCM_WalkInUnLkENFunSta_flg "" UBYTE SWC_FDC_type_CM_boolean_flg 0 0 0.0 1.0 ECU_ADDRESS 0x0000 /* @ECU_Address@VBCM_WalkInUnLkENFunSta_flg@ */ /end MEASUREMENT
/begin MEASUREMENT VBCM_FollowMeENFunSta_flg "" UBYTE SWC_FDC_type_CM_boolean_flg 0 0 0.0 1.0 ECU_ADDRESS 0x0000 /* @ECU_Address@VBCM_FollowMeENFunSta_flg@ */ /end MEASUREMENT
/begin MEASUREMENT VBCM_AmbWelEN_flg "" UBYTE SWC_FDC_type_CM_boolean_flg 0 0 0.0 1.0 ECU_ADDRESS 0x0000 /* @ECU_Address@VBCM_AmbWelEN_flg@ */ /end MEASUREMENT
/begin MEASUREMENT VBCM_AmbDimEN_flg "" UBYTE SWC_FDC_type_CM_boolean_flg 0 0 0.0 1.0 ECU_ADDRESS 0x0000 /* @ECU_Address@VBCM_AmbDimEN_flg@ */ /end MEASUREMENT
/begin MEASUREMENT VBCM_AmbODAEN_flg "" UBYTE SWC_FDC_type_CM_boolean_flg 0 0 0.0 1.0 ECU_ADDRESS 0x0000 /* @ECU_Address@VBCM_AmbODAEN_flg@ */ /end MEASUREMENT
/begin MEASUREMENT VBCM_AmbPwrWarnEN_flg "" UBYTE SWC_FDC_type_CM_boolean_flg 0 0 0.0 1.0 ECU_ADDRESS 0x0000 /* @ECU_Address@VBCM_AmbPwrWarnEN_flg@ */ /end MEASUREMENT
/begin MEASUREMENT VBCM_AmbLinkDriSta_flg "" UBYTE SWC_FDC_type_CM_boolean_flg 0 0 0.0 1.0 ECU_ADDRESS 0x0000 /* @ECU_Address@VBCM_AmbLinkDriSta_flg@ */ /end MEASUREMENT
/begin MEASUREMENT VBCM_LockSetting_flg "" UBYTE SWC_FDC_type_CM_boolean_flg 0 0 0.0 1.0 ECU_ADDRESS 0x0000 /* @ECU_Address@VBCM_LockSetting_flg@ */ /end MEASUREMENT
/begin MEASUREMENT VBCM_RmLpModeENFunSta_flg "" UBYTE SWC_FDC_type_CM_boolean_flg 0 0 0.0 1.0 ECU_ADDRESS 0x0000 /* @ECU_Address@VBCM_RmLpModeENFunSta_flg@ */ /end MEASUREMENT
/begin MEASUREMENT VVMC_MCUTotalTq_Nm "" FLOAT32_IEEE SWC_FDC_type_CM_single_Nm 0 0 -5000.0 10000.0 ECU_ADDRESS 0x0000 /* @ECU_Address@VVMC_MCUTotalTq_Nm@ */ /end MEASUREMENT
/begin MEASUREMENT VVMC_CalEstSlopeTs_c "" FLOAT32_IEEE SWC_FDC_type_CM_single_c 0 0 0.0 1.0 ECU_ADDRESS 0x0000 /* @ECU_Address@VVMC_CalEstSlopeTs_c@ */ /end MEASUREMENT
/begin MEASUREMENT VVMC_VehspdTs_c "" FLOAT32_IEEE SWC_FDC_type_CM_single_c 0 0 0.0 1.0 ECU_ADDRESS 0x0000 /* @ECU_Address@VVMC_VehspdTs_c@ */ /end MEASUREMENT
/begin MEASUREMENT VVMC_VehCalgAfter_G "" FLOAT32_IEEE SWC_FDC_type_CM_single_G 0 0 -65.536 65.536 ECU_ADDRESS 0x0000 /* @ECU_Address@VVMC_VehCalgAfter_G@ */ /end MEASUREMENT
/begin MEASUREMENT VVMC_CalibratedGyroYDevTs_c "" FLOAT32_IEEE SWC_FDC_type_CM_single_c 0 0 0.0 1.0 ECU_ADDRESS 0x0000 /* @ECU_Address@VVMC_CalibratedGyroYDevTs_c@ */ /end MEASUREMENT
/begin MEASUREMENT VVMC_GyroYBandLow_Dps "" FLOAT32_IEEE SWC_FDC_type_CM_single_Dps 0 0 -1.0 1.0 ECU_ADDRESS 0x0000 /* @ECU_Address@VVMC_GyroYBandLow_Dps@ */ /end MEASUREMENT
/begin MEASUREMENT VVMC_GyroYBandHigh_Dps "" FLOAT32_IEEE SWC_FDC_type_CM_single_Dps 0 0 -1.0 1.0 ECU_ADDRESS 0x0000 /* @ECU_Address@VVMC_GyroYBandHigh_Dps@ */ /end MEASUREMENT
/begin MEASUREMENT VVMC_CalibratedGyroYDev_Dps "" FLOAT32_IEEE SWC_FDC_type_CM_single_Dps 0 0 0.0 20.0 ECU_ADDRESS 0x0000 /* @ECU_Address@VVMC_CalibratedGyroYDev_Dps@ */ /end MEASUREMENT
/begin MEASUREMENT VVMC_PitchIntegTotal_deg "" FLOAT32_IEEE SWC_FDC_type_CM_single_deg 0 0 -180.0 180.0 ECU_ADDRESS 0x0000 /* @ECU_Address@VVMC_PitchIntegTotal_deg@ */ /end MEASUREMENT
/begin MEASUREMENT VVMC_PitchIntegGradeBase_deg "" FLOAT32_IEEE SWC_FDC_type_CM_single_deg 0 0 -180.0 180.0 ECU_ADDRESS 0x0000 /* @ECU_Address@VVMC_PitchIntegGradeBase_deg@ */ /end MEASUREMENT
/begin MEASUREMENT VVMC_GradeCompFlt_deg "" FLOAT32_IEEE SWC_FDC_type_CM_single_deg 0 0 -180.0 180.0 ECU_ADDRESS 0x0000 /* @ECU_Address@VVMC_GradeCompFlt_deg@ */ /end MEASUREMENT
/begin MEASUREMENT VVMC_ACCGradeofst_Deg "" FLOAT32_IEEE SWC_FDC_type_CM_single_Deg 0 0 -180.0 180.0 ECU_ADDRESS 0x0000 /* @ECU_Address@VVMC_ACCGradeofst_Deg@ */ /end MEASUREMENT
/begin MEASUREMENT VVMC_DECGradeofst_Deg "" FLOAT32_IEEE SWC_FDC_type_CM_single_Deg 0 0 -180.0 180.0 ECU_ADDRESS 0x0000 /* @ECU_Address@VVMC_DECGradeofst_Deg@ */ /end MEASUREMENT
/begin MEASUREMENT VVMC_CalEstSlopeBefore_Deg "" FLOAT32_IEEE SWC_FDC_type_CM_single_Deg 0 0 -180.0 180.0 ECU_ADDRESS 0x0000 /* @ECU_Address@VVMC_CalEstSlopeBefore_Deg@ */ /end MEASUREMENT
/begin MEASUREMENT VVMC_CalEstSlopeOfstB_Deg "" FLOAT32_IEEE SWC_FDC_type_CM_single_Deg 0 0 -180.0 180.0 ECU_ADDRESS 0x0000 /* @ECU_Address@VVMC_CalEstSlopeOfstB_Deg@ */ /end MEASUREMENT
/begin MEASUREMENT VVMC_EstPitchSlopeTs_c "" FLOAT32_IEEE SWC_FDC_type_CM_single_c 0 0 0.0 1.0 ECU_ADDRESS 0x0000 /* @ECU_Address@VVMC_EstPitchSlopeTs_c@ */ /end MEASUREMENT
/begin MEASUREMENT VVMC_PitchIntegGradeBaseA_deg "" FLOAT32_IEEE SWC_FDC_type_CM_single_deg 0 0 -180.0 180.0 ECU_ADDRESS 0x0000 /* @ECU_Address@VVMC_PitchIntegGradeBaseA_deg@ */ /end MEASUREMENT
/begin MEASUREMENT VVMC_PitchIntegGradeBefore_deg "" FLOAT32_IEEE SWC_FDC_type_CM_single_deg 0 0 -180.0 180.0 ECU_ADDRESS 0x0000 /* @ECU_Address@VVMC_PitchIntegGradeBefore_deg@ */ /end MEASUREMENT
/begin MEASUREMENT VVMC_PitchIntegGradeMen_deg "" FLOAT32_IEEE SWC_FDC_type_CM_single_deg 0 0 -180.0 180.0 ECU_ADDRESS 0x0000 /* @ECU_Address@VVMC_PitchIntegGradeMen_deg@ */ /end MEASUREMENT
/begin MEASUREMENT VVMC_StopGrade_deg "" FLOAT32_IEEE SWC_FDC_type_CM_single_deg 0 0 -180.0 180.0 ECU_ADDRESS 0x0000 /* @ECU_Address@VVMC_StopGrade_deg@ */ /end MEASUREMENT
/begin MEASUREMENT VVMC_VehRunSlope_deg "" FLOAT32_IEEE SWC_FDC_type_CM_single_deg 0 0 -180.0 180.0 ECU_ADDRESS 0x0000 /* @ECU_Address@VVMC_VehRunSlope_deg@ */ /end MEASUREMENT
/begin MEASUREMENT VVMC_LongAccelCalcuRrWhl_gps "" FLOAT32_IEEE SWC_FDC_type_CM_single_gps 0 0 -2.0 2.0 ECU_ADDRESS 0x0000 /* @ECU_Address@VVMC_LongAccelCalcuRrWhl_gps@ */ /end MEASUREMENT
/begin MEASUREMENT VVMC_LongAccelCalcuByVehSpd_gps "" FLOAT32_IEEE SWC_FDC_type_CM_single_gps 0 0 -20.0 20.0 ECU_ADDRESS 0x0000 /* @ECU_Address@VVMC_LongAccelCalcuByVehSpd_gps@ */ /end MEASUREMENT
/begin MEASUREMENT VVMC_LongAccelCalcuFrWhl_gps "" FLOAT32_IEEE SWC_FDC_type_CM_single_gps 0 0 -2.0 2.0 ECU_ADDRESS 0x0000 /* @ECU_Address@VVMC_LongAccelCalcuFrWhl_gps@ */ /end MEASUREMENT
/begin MEASUREMENT VVMC_HoldEstSlope_deg "" FLOAT32_IEEE SWC_FDC_type_CM_single_deg 0 0 -180.0 180.0 ECU_ADDRESS 0x0000 /* @ECU_Address@VVMC_HoldEstSlope_deg@ */ /end MEASUREMENT
/begin MEASUREMENT VVMC_LongAccHighFilt_Gps "" FLOAT32_IEEE SWC_FDC_type_CM_single_Gps 0 0 -2.0 2.0 ECU_ADDRESS 0x0000 /* @ECU_Address@VVMC_LongAccHighFilt_Gps@ */ /end MEASUREMENT
/begin MEASUREMENT VVMC_LongAccMedFilt_Gps "" FLOAT32_IEEE SWC_FDC_type_CM_single_Gps 0 0 -2.0 2.0 ECU_ADDRESS 0x0000 /* @ECU_Address@VVMC_LongAccMedFilt_Gps@ */ /end MEASUREMENT
/begin MEASUREMENT VVMC_LongAccFrWhlLowFilt_Gps "" FLOAT32_IEEE SWC_FDC_type_CM_single_Gps 0 0 -2.0 2.0 ECU_ADDRESS 0x0000 /* @ECU_Address@VVMC_LongAccFrWhlLowFilt_Gps@ */ /end MEASUREMENT
/begin MEASUREMENT VVMC_LongAccRrWhlLowFilt_Gps "" FLOAT32_IEEE SWC_FDC_type_CM_single_Gps 0 0 -2.0 2.0 ECU_ADDRESS 0x0000 /* @ECU_Address@VVMC_LongAccRrWhlLowFilt_Gps@ */ /end MEASUREMENT
/begin MEASUREMENT VVMC_LongAccLowFilt_Gps "" FLOAT32_IEEE SWC_FDC_type_CM_single_Gps 0 0 -2.0 2.0 ECU_ADDRESS 0x0000 /* @ECU_Address@VVMC_LongAccLowFilt_Gps@ */ /end MEASUREMENT
/begin MEASUREMENT VVMC_EstSlope0SpdUnFrzOnce_flg "" UBYTE SWC_FDC_type_CM_boolean_flg 0 0 0.0 1.0 ECU_ADDRESS 0x0000 /* @ECU_Address@VVMC_EstSlope0SpdUnFrzOnce_flg@ */ /end MEASUREMENT
/begin MEASUREMENT VVMC_Vehstop_flg "" UBYTE SWC_FDC_type_CM_boolean_flg 0 0 0.0 1.0 ECU_ADDRESS 0x0000 /* @ECU_Address@VVMC_Vehstop_flg@ */ /end MEASUREMENT
/begin MEASUREMENT VVMC_VehspdLo_flg "" UBYTE SWC_FDC_type_CM_boolean_flg 0 0 0.0 1.0 ECU_ADDRESS 0x0000 /* @ECU_Address@VVMC_VehspdLo_flg@ */ /end MEASUREMENT
/begin MEASUREMENT VVMC_CalibratedAccXRang_flg "" UBYTE SWC_FDC_type_CM_boolean_flg 0 0 0.0 1.0 ECU_ADDRESS 0x0000 /* @ECU_Address@VVMC_CalibratedAccXRang_flg@ */ /end MEASUREMENT
/begin MEASUREMENT VVMC_PitchVehCondmet_flg "" UBYTE SWC_FDC_type_CM_boolean_flg 0 0 0.0 1.0 ECU_ADDRESS 0x0000 /* @ECU_Address@VVMC_PitchVehCondmet_flg@ */ /end MEASUREMENT
/begin MEASUREMENT VVMC_PitchRollingCondmet_flg "" UBYTE SWC_FDC_type_CM_boolean_flg 0 0 0.0 1.0 ECU_ADDRESS 0x0000 /* @ECU_Address@VVMC_PitchRollingCondmet_flg@ */ /end MEASUREMENT
/begin MEASUREMENT VVMC_VehSpdHi_flg "" UBYTE SWC_FDC_type_CM_boolean_flg 0 0 0.0 1.0 ECU_ADDRESS 0x0000 /* @ECU_Address@VVMC_VehSpdHi_flg@ */ /end MEASUREMENT
/begin MEASUREMENT VVMC_RDShift_flg "" UBYTE SWC_FDC_type_CM_boolean_flg 0 0 0.0 1.0 ECU_ADDRESS 0x0000 /* @ECU_Address@VVMC_RDShift_flg@ */ /end MEASUREMENT
/begin MEASUREMENT VVMC_Vehfullstop_flg "" UBYTE SWC_FDC_type_CM_boolean_flg 0 0 0.0 1.0 ECU_ADDRESS 0x0000 /* @ECU_Address@VVMC_Vehfullstop_flg@ */ /end MEASUREMENT
/begin MEASUREMENT VVMC_EstSlopeFreezeEn_flg "" UBYTE SWC_FDC_type_CM_boolean_flg 0 0 0.0 1.0 ECU_ADDRESS 0x0000 /* @ECU_Address@VVMC_EstSlopeFreezeEn_flg@ */ /end MEASUREMENT
/begin MEASUREMENT VVMC_EstSlopeAclFreezeEn_flg "" UBYTE SWC_FDC_type_CM_boolean_flg 0 0 0.0 1.0 ECU_ADDRESS 0x0000 /* @ECU_Address@VVMC_EstSlopeAclFreezeEn_flg@ */ /end MEASUREMENT
/begin MEASUREMENT VVMC_GyroYBand_flg "" UBYTE SWC_FDC_type_CM_boolean_flg 0 0 0.0 1.0 ECU_ADDRESS 0x0000 /* @ECU_Address@VVMC_GyroYBand_flg@ */ /end MEASUREMENT
/begin MEASUREMENT VVMC_GradeReset_flg "" UBYTE SWC_FDC_type_CM_boolean_flg 0 0 0.0 1.0 ECU_ADDRESS 0x0000 /* @ECU_Address@VVMC_GradeReset_flg@ */ /end MEASUREMENT
/begin MEASUREMENT VVMC_PitchAllcondmet_flg "" UBYTE SWC_FDC_type_CM_boolean_flg 0 0 0.0 1.0 ECU_ADDRESS 0x0000 /* @ECU_Address@VVMC_PitchAllcondmet_flg@ */ /end MEASUREMENT
/begin MEASUREMENT VVMC_MemVehPitchAngleEst_deg "" FLOAT32_IEEE SWC_FDC_type_CM_single_deg 0 0 -10.0 10.0 ECU_ADDRESS 0x0000 /* @ECU_Address@VVMC_MemVehPitchAngleEst_deg@ */ /end MEASUREMENT
/begin MEASUREMENT VVMC_VehPitchAngleEst_deg "" FLOAT32_IEEE SWC_FDC_type_CM_single_deg 0 0 -10.0 10.0 ECU_ADDRESS 0x0000 /* @ECU_Address@VVMC_VehPitchAngleEst_deg@ */ /end MEASUREMENT
/begin MEASUREMENT VVMC_LongAccelCalcuByVehSpdRaw_gps "" FLOAT32_IEEE SWC_FDC_type_CM_single_gps 0 0 -20.0 20.0 ECU_ADDRESS 0x0000 /* @ECU_Address@VVMC_LongAccelCalcuByVehSpdRaw_gps@ */ /end MEASUREMENT
/begin MEASUREMENT VVMC_RrWhlSpdRollAve_kph "" FLOAT32_IEEE SWC_FDC_type_CM_single_kph 0 0 0.0 300.0 ECU_ADDRESS 0x0000 /* @ECU_Address@VVMC_RrWhlSpdRollAve_kph@ */ /end MEASUREMENT
/begin MEASUREMENT VVMC_FrWhlSpdRollAve_kph "" FLOAT32_IEEE SWC_FDC_type_CM_single_kph 0 0 0.0 300.0 ECU_ADDRESS 0x0000 /* @ECU_Address@VVMC_FrWhlSpdRollAve_kph@ */ /end MEASUREMENT
/begin MEASUREMENT VVMC_FrRrSlipSpd_kph "" FLOAT32_IEEE SWC_FDC_type_CM_single_kph 0 0 0.0 255.0 ECU_ADDRESS 0x0000 /* @ECU_Address@VVMC_FrRrSlipSpd_kph@ */ /end MEASUREMENT
/begin MEASUREMENT VVMC_LongAccelCalcuFrWhlRaw_gps "" FLOAT32_IEEE SWC_FDC_type_CM_single_gps 0 0 -2.0 2.0 ECU_ADDRESS 0x0000 /* @ECU_Address@VVMC_LongAccelCalcuFrWhlRaw_gps@ */ /end MEASUREMENT
/begin MEASUREMENT VVMC_LongAccelCalcuRrWhlRaw_gps "" FLOAT32_IEEE SWC_FDC_type_CM_single_gps 0 0 -2.0 2.0 ECU_ADDRESS 0x0000 /* @ECU_Address@VVMC_LongAccelCalcuRrWhlRaw_gps@ */ /end MEASUREMENT
/begin MEASUREMENT VVMC_RRWhlSpeedRollAveRaw_kph "" FLOAT32_IEEE SWC_FDC_type_CM_single_kph 0 0 0.0 255.0 ECU_ADDRESS 0x0000 /* @ECU_Address@VVMC_RRWhlSpeedRollAveRaw_kph@ */ /end MEASUREMENT
/begin MEASUREMENT VVMC_LRWhlSpeedRollAveRaw_kph "" FLOAT32_IEEE SWC_FDC_type_CM_single_kph 0 0 0.0 255.0 ECU_ADDRESS 0x0000 /* @ECU_Address@VVMC_LRWhlSpeedRollAveRaw_kph@ */ /end MEASUREMENT
/begin MEASUREMENT VVMC_RFWhlSpeedRollAveRaw_kph "" FLOAT32_IEEE SWC_FDC_type_CM_single_kph 0 0 0.0 255.0 ECU_ADDRESS 0x0000 /* @ECU_Address@VVMC_RFWhlSpeedRollAveRaw_kph@ */ /end MEASUREMENT
/begin MEASUREMENT VVMC_LFWhlSpeedRollAveRaw_kph "" FLOAT32_IEEE SWC_FDC_type_CM_single_kph 0 0 0.0 255.0 ECU_ADDRESS 0x0000 /* @ECU_Address@VVMC_LFWhlSpeedRollAveRaw_kph@ */ /end MEASUREMENT
/begin MEASUREMENT VVMC_VehSpdRollAveRaw_kph "" FLOAT32_IEEE SWC_FDC_type_CM_single_kph 0 0 0.0 255.0 ECU_ADDRESS 0x0000 /* @ECU_Address@VVMC_VehSpdRollAveRaw_kph@ */ /end MEASUREMENT
/begin MEASUREMENT VVMC_LatAccRollAveRaw_Gps "" FLOAT32_IEEE SWC_FDC_type_CM_single_Gps 0 0 -1.27 1.27 ECU_ADDRESS 0x0000 /* @ECU_Address@VVMC_LatAccRollAveRaw_Gps@ */ /end MEASUREMENT
/begin MEASUREMENT VVMC_VehSpdRollAve_kph "" FLOAT32_IEEE SWC_FDC_type_CM_single_kph 0 0 0.0 255.0 ECU_ADDRESS 0x0000 /* @ECU_Address@VVMC_VehSpdRollAve_kph@ */ /end MEASUREMENT
/begin MEASUREMENT VVMC_LatAccRollAve_Gps "" FLOAT32_IEEE SWC_FDC_type_CM_single_Gps 0 0 -1.27 1.27 ECU_ADDRESS 0x0000 /* @ECU_Address@VVMC_LatAccRollAve_Gps@ */ /end MEASUREMENT
/begin MEASUREMENT VVMC_VehPitchAngleSta_enum "" UBYTE SWC_FDC_type_CM_uint8_enum 0 0 0.0 6.0 ECU_ADDRESS 0x0000 /* @ECU_Address@VVMC_VehPitchAngleSta_enum@ */ /end MEASUREMENT
/begin MEASUREMENT VVMC_VehPitchAngleUpd_flg "" UBYTE SWC_FDC_type_CM_boolean_flg 0 0 0.0 1.0 ECU_ADDRESS 0x0000 /* @ECU_Address@VVMC_VehPitchAngleUpd_flg@ */ /end MEASUREMENT
/begin MEASUREMENT VVMC_RollAveEn_flg "" UBYTE SWC_FDC_type_CM_boolean_flg 0 0 0.0 1.0 ECU_ADDRESS 0x0000 /* @ECU_Address@VVMC_RollAveEn_flg@ */ /end MEASUREMENT
/begin MEASUREMENT VVMC_FrontRearSlipRatioCtrl_flg "" UBYTE SWC_FDC_type_CM_boolean_flg 0 0 0.0 1.0 ECU_ADDRESS 0x0000 /* @ECU_Address@VVMC_FrontRearSlipRatioCtrl_flg@ */ /end MEASUREMENT
/begin MEASUREMENT VVMC_RearWhlSlipRatioCtrl_flg "" UBYTE SWC_FDC_type_CM_boolean_flg 0 0 0.0 1.0 ECU_ADDRESS 0x0000 /* @ECU_Address@VVMC_RearWhlSlipRatioCtrl_flg@ */ /end MEASUREMENT
/begin MEASUREMENT VVMC_SingleWhlSlipRatioCtrl_flg "" UBYTE SWC_FDC_type_CM_boolean_flg 0 0 0.0 1.0 ECU_ADDRESS 0x0000 /* @ECU_Address@VVMC_SingleWhlSlipRatioCtrl_flg@ */ /end MEASUREMENT
/begin MEASUREMENT VVMC_LatAccCtrl_flg "" UBYTE SWC_FDC_type_CM_boolean_flg 0 0 0.0 1.0 ECU_ADDRESS 0x0000 /* @ECU_Address@VVMC_LatAccCtrl_flg@ */ /end MEASUREMENT
/begin MEASUREMENT VVMC_RrWhlSpdInvalid_flg "" UBYTE SWC_FDC_type_CM_boolean_flg 0 0 0.0 1.0 ECU_ADDRESS 0x0000 /* @ECU_Address@VVMC_RrWhlSpdInvalid_flg@ */ /end MEASUREMENT
/begin MEASUREMENT VVMC_FrWhlSpdInvalid_flg "" UBYTE SWC_FDC_type_CM_boolean_flg 0 0 0.0 1.0 ECU_ADDRESS 0x0000 /* @ECU_Address@VVMC_FrWhlSpdInvalid_flg@ */ /end MEASUREMENT
/begin COMPU_METHOD SWC_FDC_type_CM_single_C "Q = V" RAT_FUNC "%8.6" "C" COEFFS 0 1 0 0 0 1 /end COMPU_METHOD
/begin COMPU_METHOD SWC_FDC_type_CM_single_s "Q = V" RAT_FUNC "%8.6" "s" COEFFS 0 1 0 0 0 1 /end COMPU_METHOD
/begin COMPU_METHOD SWC_FDC_type_CM_single_rpm "Q = V" RAT_FUNC "%8.6" "rpm" COEFFS 0 1 0 0 0 1 /end COMPU_METHOD
/begin COMPU_METHOD SWC_FDC_type_CM_uint8_enum "Q = V" RAT_FUNC "%3.0" "enum" COEFFS 0 1 0 0 0 1 /end COMPU_METHOD
/begin COMPU_METHOD SWC_FDC_type_CM_single_Gps "Q = V" RAT_FUNC "%8.6" "Gps" COEFFS 0 1 0 0 0 1 /end COMPU_METHOD
/begin COMPU_METHOD SWC_FDC_type_CM_single_kph "Q = V" RAT_FUNC "%8.6" "kph" COEFFS 0 1 0 0 0 1 /end COMPU_METHOD
/begin COMPU_METHOD SWC_FDC_type_CM_single_c "Q = V" RAT_FUNC "%8.6" "c" COEFFS 0 1 0 0 0 1 /end COMPU_METHOD
/begin COMPU_METHOD SWC_FDC_type_CM_single_mps2 "Q = V" RAT_FUNC "%8.6" "mps2" COEFFS 0 1 0 0 0 1 /end COMPU_METHOD
/begin COMPU_METHOD SWC_FDC_type_CM_single_pct "Q = V" RAT_FUNC "%8.6" "pct" COEFFS 0 1 0 0 0 1 /end COMPU_METHOD
/begin COMPU_METHOD SWC_FDC_type_CM_single_enum "Q = V" RAT_FUNC "%8.6" "enum" COEFFS 0 1 0 0 0 1 /end COMPU_METHOD
/begin COMPU_METHOD SWC_FDC_type_CM_single_W "Q = V" RAT_FUNC "%8.6" "W" COEFFS 0 1 0 0 0 1 /end COMPU_METHOD
/begin COMPU_METHOD SWC_FDC_type_CM_single_Deg "Q = V" RAT_FUNC "%8.6" "Deg" COEFFS 0 1 0 0 0 1 /end COMPU_METHOD
/begin COMPU_METHOD SWC_FDC_type_CM_single_kg "Q = V" RAT_FUNC "%8.6" "kg" COEFFS 0 1 0 0 0 1 /end COMPU_METHOD
/begin COMPU_METHOD SWC_FDC_type_CM_single_rat "Q = V" RAT_FUNC "%8.6" "rat" COEFFS 0 1 0 0 0 1 /end COMPU_METHOD
/begin COMPU_METHOD SWC_FDC_type_CM_single_Nm "Q = V" RAT_FUNC "%8.6" "Nm" COEFFS 0 1 0 0 0 1 /end COMPU_METHOD
/begin COMPU_METHOD SWC_FDC_type_CM_single_deg "Q = V" RAT_FUNC "%8.6" "deg" COEFFS 0 1 0 0 0 1 /end COMPU_METHOD
/begin COMPU_METHOD SWC_FDC_type_CM_single_gps "Q = V" RAT_FUNC "%8.6" "gps" COEFFS 0 1 0 0 0 1 /end COMPU_METHOD
/begin COMPU_METHOD SWC_FDC_type_CM_single_bar "Q = V" RAT_FUNC "%8.6" "bar" COEFFS 0 1 0 0 0 1 /end COMPU_METHOD
/begin COMPU_METHOD SWC_FDC_type_CM_single_Dps "Q = V" RAT_FUNC "%8.6" "Dps" COEFFS 0 1 0 0 0 1 /end COMPU_METHOD
/begin COMPU_METHOD SWC_FDC_type_CM_single_mps "Q = V" RAT_FUNC "%8.6" "mps" COEFFS 0 1 0 0 0 1 /end COMPU_METHOD
/begin COMPU_METHOD SWC_FDC_type_CM_single_mps3 "Q = V" RAT_FUNC "%8.6" "mps3" COEFFS 0 1 0 0 0 1 /end COMPU_METHOD
/begin COMPU_METHOD SWC_FDC_type_CM_single_K "Q = V" RAT_FUNC "%8.6" "K" COEFFS 0 1 0 0 0 1 /end COMPU_METHOD
/begin COMPU_METHOD SWC_FDC_type_CM_single_kmh "Q = V" RAT_FUNC "%8.6" "kmh" COEFFS 0 1 0 0 0 1 /end COMPU_METHOD
/begin COMPU_METHOD SWC_FDC_type_CM_single_sec "Q = V" RAT_FUNC "%8.6" "sec" COEFFS 0 1 0 0 0 1 /end COMPU_METHOD
/begin COMPU_METHOD SWC_FDC_type_CM_single_m "Q = V" RAT_FUNC "%8.6" "m" COEFFS 0 1 0 0 0 1 /end COMPU_METHOD
/begin COMPU_METHOD SWC_FDC_type_CM_single_Nmps "Q = V" RAT_FUNC "%8.6" "Nmps" COEFFS 0 1 0 0 0 1 /end COMPU_METHOD
/begin COMPU_METHOD SWC_FDC_type_CM_single_raw32 "Q = V" RAT_FUNC "%8.6" "raw32" COEFFS 0 1 0 0 0 1 /end COMPU_METHOD
/begin COMPU_METHOD SWC_FDC_type_CM_single_kphps "Q = V" RAT_FUNC "%8.6" "kphps" COEFFS 0 1 0 0 0 1 /end COMPU_METHOD
/begin COMPU_METHOD SWC_FDC_type_CM_int16_W "Q = V" RAT_FUNC "%5.0" "W" COEFFS 0 1 0 0 0 1 /end COMPU_METHOD
/begin COMPU_METHOD SWC_FDC_type_CM_uint16_cnt "Q = V" RAT_FUNC "%5.0" "cnt" COEFFS 0 1 0 0 0 1 /end COMPU_METHOD
/begin COMPU_METHOD SWC_FDC_type_CM_uint16_W "Q = V" RAT_FUNC "%5.0" "W" COEFFS 0 1 0 0 0 1 /end COMPU_METHOD
/begin COMPU_METHOD SWC_FDC_type_CM_boolean_flg "Q = V" RAT_FUNC "%1.0" "flg" COEFFS 0 1 0 0 0 1 /end COMPU_METHOD
/begin COMPU_METHOD SWC_FDC_type_CM_boolean "Q = V" RAT_FUNC "%1.0" "" COEFFS 0 1 0 0 0 1 /end COMPU_METHOD
/begin COMPU_METHOD SWC_FDC_type_CM_boolean_kph "Q = V" RAT_FUNC "%1.0" "kph" COEFFS 0 1 0 0 0 1 /end COMPU_METHOD
/begin COMPU_METHOD SWC_FDC_type_CM_uint8_cnt "Q = V" RAT_FUNC "%3.0" "cnt" COEFFS 0 1 0 0 0 1 /end COMPU_METHOD
/begin COMPU_METHOD SWC_FDC_type_CM_uint8_kph "Q = V" RAT_FUNC "%3.0" "kph" COEFFS 0 1 0 0 0 1 /end COMPU_METHOD
/begin COMPU_METHOD SWC_FDC_type_CM_uint8_raw8 "Q = V" RAT_FUNC "%3.0" "raw8" COEFFS 0 1 0 0 0 1 /end COMPU_METHOD
/begin COMPU_METHOD SWC_FDC_type_CM_uint8_mph "Q = V" RAT_FUNC "%3.0" "mph" COEFFS 0 1 0 0 0 1 /end COMPU_METHOD
/begin COMPU_METHOD SWC_FDC_type_CM_single_G "Q = V" RAT_FUNC "%8.6" "G" COEFFS 0 1 0 0 0 1 /end COMPU_METHOD
/begin COMPU_METHOD SWC_FDC_type_CM_single_Deg1 "Q = V" RAT_FUNC "%8.6" "Deg1" COEFFS 0 1 0 0 0 1 /end COMPU_METHOD
/begin COMPU_METHOD SWC_FDC_type_CM_uint8_raw "Q = V" RAT_FUNC "%3.0" "raw" COEFFS 0 1 0 0 0 1 /end COMPU_METHOD
/begin COMPU_METHOD SWC_FDC_type_CM_uint8_c "Q = V" RAT_FUNC "%3.0" "c" COEFFS 0 1 0 0 0 1 /end COMPU_METHOD
/begin GROUP S2310_Estimate_Slope1 "SWC_FDC_type/run_SWC_FDC_RxTx_5ms_sys/APP/VMC/VMC/Long Acceleration Calculation/Estimate Slope1"
 /begin SUB_GROUP S2446_FirstOrderFilter3 S2446_FirstOrderFilter5 S2446_FirstOrderFilter6 S2446_FirstOrderFilter7 S2446_FirstOrderFilter8 S2446_SR_Latch S2446_SR_Latch1 S2446_SR_Latch2 S2446_SR_Latch3 S2446_SR_Latch6 S2446_Triggered_Subsystem /end SUB_GROUP
 /begin REF_CHARACTERISTIC KVMC_CalEstSlopeOfstSW_flg KVMC_CalEstSlopeOfst_c KVMC_EstSlopeLongGSW_flg KVMC_EstSlopeSW_flg KVMC_EstSlopeVehSourceSW_flg KVMC_FreezeStopGrade_kph KVMC_GradedelayTimer_s KVMC_GradedelaytestSW_flg KVMC_GyroBandSource_flg KVMC_PitchAccGlow_mps2 KVMC_PitchAccGup_mps2 KVMC_PitchBPSThres_pct KVMC_PitchGradeL2HSource_flg KVMC_PitchGradeReset_flg KVMC_PitchGradeStopSource_flg KVMC_PitchVehThres_kph KVMC_SlopeCalSource_flg KVMC_SlopeSourceTs_flg KVMC_StoploopGradeSource_flg KVMC_VehRunSlope_flg KVMC_VehStopAPSThresLo_pct KVMC_VehStopDelay_s KVMC_VehStopSource_flg KVMC_VehStopThresHi_kph KVMC_VehStopThresLo_kph KVMC_VehStopThres_kph KVMC_VehStopTqThres_Nm MVMC_ACCGradeofst_Z_Deg MVMC_CalEstSlopeTs_Y_c MVMC_CalibratedGyroYDevTs_Y_c MVMC_DECGradeofst_Z_Deg MVMC_EstPitchSlopeTs_Y_c MVMC_GradeCompFlt_Y_c MVMC_GyroYBandHi_Y_Dps MVMC_GyroYBandLo_Y_Dps MVMC_VehspdTs_Y_c /end REF_CHARACTERISTIC
 /begin REF_MEASUREMENT VVMC_ACCGradeofst_Deg VVMC_CalEstSlopeBefore_Deg VVMC_CalEstSlopeOfstB_Deg VVMC_CalEstSlopeTs_c VVMC_CalibratedAccXRang_flg VVMC_CalibratedGyroYDevTs_c VVMC_CalibratedGyroYDev_Dps VVMC_DECGradeofst_Deg VVMC_EstPitchSlopeTs_c VVMC_FinalSlop_deg VVMC_GradeCompFlt_deg VVMC_GradeReset_flg VVMC_GyroYBandHigh_Dps VVMC_GyroYBandLow_Dps VVMC_GyroYBand_flg VVMC_IMUEstSlope_Deg1 VVMC_MCUTotalTq_Nm VVMC_PitchAllcondmet_flg VVMC_PitchIntegGradeBaseA_deg VVMC_PitchIntegGradeBase_deg VVMC_PitchIntegGradeBefore_deg VVMC_PitchIntegGradeMen_deg VVMC_PitchIntegTotal_deg VVMC_PitchRollingCondmet_flg VVMC_PitchVehCondmet_flg VVMC_RDShift_flg VVMC_StopGrade_deg VVMC_VehCalgAfter_G VVMC_VehRunSlope_deg VVMC_VehSpdHi_flg VVMC_Vehfullstop_flg VVMC_VehspdLo_flg VVMC_VehspdTs_c VVMC_Vehstop_flg /end REF_MEASUREMENT
/end GROUP
/begin GROUP S2310_FirstOrderFilter1 "SWC_FDC_type/run_SWC_FDC_RxTx_5ms_sys/APP/VMC/VMC/Long Acceleration Calculation/FirstOrderFilter1" /begin REF_MEASUREMENT VVMC_LongAccLowFilt_Gps /end REF_MEASUREMENT /end GROUP
/begin GROUP S2310_FirstOrderFilter10 "SWC_FDC_type/run_SWC_FDC_RxTx_5ms_sys/APP/VMC/VMC/Long Acceleration Calculation/FirstOrderFilter10" /begin REF_MEASUREMENT VVMC_LongAccRrWhlLowFilt_Gps /end REF_MEASUREMENT /end GROUP
/begin GROUP S2310_FirstOrderFilter11 "SWC_FDC_type/run_SWC_FDC_RxTx_5ms_sys/APP/VMC/VMC/Long Acceleration Calculation/FirstOrderFilter11" /begin REF_MEASUREMENT VVMC_LongAccFrWhlLowFilt_Gps /end REF_MEASUREMENT /end GROUP
/begin GROUP S2310_FirstOrderFilter2 "SWC_FDC_type/run_SWC_FDC_RxTx_5ms_sys/APP/VMC/VMC/Long Acceleration Calculation/FirstOrderFilter2" /begin REF_MEASUREMENT VVMC_LongAccMedFilt_Gps /end REF_MEASUREMENT /end GROUP
/begin GROUP S2310_FirstOrderFilter3 "SWC_FDC_type/run_SWC_FDC_RxTx_5ms_sys/APP/VMC/VMC/Long Acceleration Calculation/FirstOrderFilter3" /begin REF_MEASUREMENT VVMC_LongAccHighFilt_Gps /end REF_MEASUREMENT /end GROUP
/begin GROUP S2310_FirstOrderFilter5 "SWC_FDC_type/run_SWC_FDC_RxTx_5ms_sys/APP/VMC/VMC/Long Acceleration Calculation/FirstOrderFilter5" /begin REF_MEASUREMENT VVMC_HoldEstSlope_deg /end REF_MEASUREMENT /end GROUP
/begin GROUP S2310_FirstOrderFilter6 "SWC_FDC_type/run_SWC_FDC_RxTx_5ms_sys/APP/VMC/VMC/Long Acceleration Calculation/FirstOrderFilter6" /begin REF_MEASUREMENT VVMC_LongAccelCalcuFrWhl_gps /end REF_MEASUREMENT /end GROUP
/begin GROUP S2310_FirstOrderFilter8 "SWC_FDC_type/run_SWC_FDC_RxTx_5ms_sys/APP/VMC/VMC/Long Acceleration Calculation/FirstOrderFilter8" /begin REF_MEASUREMENT VVMC_LongAccelCalcuByVehSpd_gps /end REF_MEASUREMENT /end GROUP
/begin GROUP S2310_FirstOrderFilter9 "SWC_FDC_type/run_SWC_FDC_RxTx_5ms_sys/APP/VMC/VMC/Long Acceleration Calculation/FirstOrderFilter9" /begin REF_MEASUREMENT VVMC_LongAccelCalcuRrWhl_gps /end REF_MEASUREMENT /end GROUP
/begin GROUP S2310_RateLimit1 "SWC_FDC_type/run_SWC_FDC_RxTx_5ms_sys/APP/VMC/VMC/Long Acceleration Calculation/RateLimit1" /begin REF_MEASUREMENT VVMC_LongAcc_Gps /end REF_MEASUREMENT /end GROUP
/begin GROUP S2310_RateLimit2 "SWC_FDC_type/run_SWC_FDC_RxTx_5ms_sys/APP/VMC/VMC/Long Acceleration Calculation/RateLimit2" /begin REF_MEASUREMENT VVMC_LongAccFrWhl_Gps /end REF_MEASUREMENT /end GROUP
/begin GROUP S2310_RateLimit3 "SWC_FDC_type/run_SWC_FDC_RxTx_5ms_sys/APP/VMC/VMC/Long Acceleration Calculation/RateLimit3" /begin REF_MEASUREMENT VVMC_LongAccRrWhl_Gps /end REF_MEASUREMENT /end GROUP
/begin GROUP S2310_SR_Latch "SWC_FDC_type/run_SWC_FDC_RxTx_5ms_sys/APP/VMC/VMC/Long Acceleration Calculation/SR_Latch" /begin REF_MEASUREMENT VVMC_EstSlopeFreezeEn_flg /end REF_MEASUREMENT /end GROUP
/begin GROUP S2310_SR_Latch1 "SWC_FDC_type/run_SWC_FDC_RxTx_5ms_sys/APP/VMC/VMC/Long Acceleration Calculation/SR_Latch1" /begin REF_MEASUREMENT VVMC_EstSlope0SpdUnFrzOnce_flg /end REF_MEASUREMENT /end GROUP
/begin GROUP S2310_SR_Latch2 "SWC_FDC_type/run_SWC_FDC_RxTx_5ms_sys/APP/VMC/VMC/Long Acceleration Calculation/SR_Latch2" /begin REF_MEASUREMENT VVMC_EstSlopeAclFreezeEn_flg /end REF_MEASUREMENT /end GROUP
/begin GROUP S2311_Anti_Speed_Limitation "SWC_FDC_type/run_SWC_FDC_RxTx_5ms_sys/APP/VMC/VMC/MSA function/Anti-Speed Limitation"
 /begin REF_CHARACTERISTIC KVMC_AntiSpdLimSW_flg KVMC_AntiSpdLim_kph KVMC_SmartEcoLimitSpd_kph KVMC_SmartEcoPlusSW_flg /end REF_CHARACTERISTIC
 /begin REF_MEASUREMENT VVMC_AntiLimitSpd_kph VVMC_AntiSpdLimEn_flg VVMC_AntiSpdLimSpdEn_flg VVMC_AntiSpdLimStaEn_flg VVMC_HoodSpdLimitEn_flg VVMC_SmartEcoEn_flg /end REF_MEASUREMENT
/end GROUP
/begin GROUP S2311_MSAActivationHandshake "SWC_FDC_type/run_SWC_FDC_RxTx_5ms_sys/APP/VMC/VMC/MSA function/MSAActivationHandshake"
 /begin REF_CHARACTERISTIC KTQD_MSAActiveMetSpdHiMPH_mph KTQD_MSAActiveMetSpdHi_kph KTQD_MSAActiveMetSpdLoMPH_mph KTQD_MSAActiveMetSpdLo_kph /end REF_CHARACTERISTIC
 /begin REF_MEASUREMENT VVMC_IntMSAActive_flg VVMC_IntMSACtrlSta_enum VVMC_IntMSASpdWar_flg /end REF_MEASUREMENT
/end GROUP
/begin GROUP S2311_MSADemandTorqueCalculation "SWC_FDC_type/run_SWC_FDC_RxTx_5ms_sys/APP/VMC/VMC/MSA function/MSADemandTorqueCalculation" /begin SUB_GROUP S2490_SR_Latch5 S2490_Triggered_Subsystem /end SUB_GROUP
 /begin REF_CHARACTERISTIC KVMC_MSAEnCtrlTargetAcc_mps2 KVMC_MSAPGainSW_flg KVMC_MSASpdDevLowLim_kph KVMC_MSASpdDevUpLim_kph KVMC_MSATqDownEndTqRatio_pct KVMC_MSATqLowLim_Nm KVMC_MSATqUpLim_Nm MVMC_MSASpdBand_Y_pct MVMC_MSATqDownEndTq_Y_Nm MVMC_MSATqDownTime_Y_s /end REF_CHARACTERISTIC
 /begin REF_MEASUREMENT VVMC_MSAIGainDeltaTq_Nm VVMC_MSAInCtrlSpd_flg VVMC_MSAPGainDeltaTq_Nm VVMC_MSATqDownEndTq_Nm VVMC_MSATqDownSlope_Nmps VVMC_MSAWhlTqCalAftGCtrl_Nm VVMC_MSAWhlTqCalAftInCtrlSpd_Nm VVMC_MSAWhlTqCalAftTqDown_Nm VVMC_MSAWhlTqCalDelay_Nm VVMC_MSAWhlTqCalNotTqDown_Nm VVMC_MSAWhlTqCal_Nm /end REF_MEASUREMENT
/end GROUP
/begin GROUP S2311_MSATorqueSourceDetermination "SWC_FDC_type/run_SWC_FDC_RxTx_5ms_sys/APP/VMC/VMC/MSA function/MSATorqueSourceDetermination" /begin SUB_GROUP S2491_SR_Latch1 S2491_Triggered_Subsystem2 /end SUB_GROUP
 /begin REF_CHARACTERISTIC KVMC_MSAOvrdDetTime_s KVMC_MSAOvrdJudgeSpd_kph KVMC_MSAOvrdResAPSPosn_pct KVMC_MSAOvrdResumeTime_s KVMC_MSAOvrdTqRampSlope_Nmps KVMC_MSATqLowLim_Nm KVMC_MSATqUpLim_Nm MVMC_MSAPedalOvrd_Y_pct MVMC_MSASpdBand_Y_pct /end REF_CHARACTERISTIC
 /begin REF_MEASUREMENT VVMC_MSAOvrdProhibit_flg VVMC_MSAOvrdWhlTqCal_Nm VVMC_MSAPedalOvrd_pct VVMC_MSAWhlTqActive_flg VVMC_MSAWhlTqReq_Nm /end REF_MEASUREMENT
/end GROUP
/begin GROUP S2313_RWD "SWC_FDC_type/run_SWC_FDC_RxTx_5ms_sys/APP/VMC/VMC/RDC Determination/RWD" /begin SUB_GROUP S2524_DelayEnable1 S2524_DelayEnable2 S2524_SR_Latch5 /end SUB_GROUP
 /begin REF_CHARACTERISTIC KVMC_AltRDCActiveSW_flg KVMC_AltRDCActiveTq_Nm KVMC_AltRDCRecTime_s KVMC_ESCRegenTqRecDelay_s MVMC_ESCRegenOutEnSpd_Y_kph MVMC_ESCRegenOut_Z_Dps MVMC_LatESCRegenOut_Z_Gps MVMC_RDCDetectTime21AWD_Z_s MVMC_RDCDetectTime21RWD_Z_s MVMC_RDCDetectTimeF25_Z_s MVMC_RDCDetectTimeHAWD_Z_s MVMC_RDCDetectTimeHRWD_Z_s MVMC_RDCDetectTimeL24_Z_s MVMC_RDCEnSlideRate_Y_pct MVMC_StESCYawCom_Z_Dps MVMC_StESCYaw_Z_Dps /end REF_CHARACTERISTIC
 /begin REF_MEASUREMENT VVMC_ActStESCYaw_Dps VVMC_AltRDCActive_enum VVMC_ESCRegenOutEnSpd_kph VVMC_ESCRegenOut_Dps VVMC_ESCSlip_flg VVMC_LatESCRegenOut_Gps VVMC_RDCDetectTime_s VVMC_RDCEnSlideRate_pct VVMC_RWDRDCActive_enum VVMC_StESCYawCom_Dps VVMC_StESCYaw_Dps /end REF_MEASUREMENT
/end GROUP
/begin GROUP S2314_ISO22179 "SWC_FDC_type/run_SWC_FDC_RxTx_5ms_sys/APP/VMC/VMC/SPD2ACC/ISO22179"
 /begin REF_CHARACTERISTIC KVMC_DISCAccCtrlLimit_mps2 KVMC_DISCDecCtrlJerk_mps3 KVMC_DISCDecCtrlLimit_mps2 MVMC_ISOAccLimit_Y_mps2 MVMC_ISODecLimit_Y_mps2 MVMC_ISOJerk_Y_mps3 /end REF_CHARACTERISTIC
 /begin REF_MEASUREMENT VVMC_DISCDecCtrl_flg VVMC_ISOAccLimit_mps2 VVMC_ISODecLimit_mps2 VVMC_ISOJerkLimit_mps3 /end REF_MEASUREMENT
/end GROUP
/begin GROUP S2314_PID "SWC_FDC_type/run_SWC_FDC_RxTx_5ms_sys/APP/VMC/VMC/SPD2ACC/PID" /begin REF_CHARACTERISTIC KVMC_AccelIGain_enum KVMC_IParm_enum KVMC_PParm_enum /end REF_CHARACTERISTIC
 /begin REF_MEASUREMENT VVMC_AccCalcuPIDIGain_mps2 VVMC_AccCalcuPIDPGain_mps2 VVMC_AccCalcuPID_mps2 VVMC_MeterSpdCalcu_mps /end REF_MEASUREMENT
/end GROUP
/begin GROUP S2314_Required_Acceleration "SWC_FDC_type/run_SWC_FDC_RxTx_5ms_sys/APP/VMC/VMC/SPD2ACC/Required_Acceleration"
 /begin SUB_GROUP S2532_DelayEnable S2532_SR_Latch1 S2532_SR_Latch10 S2532_SR_Latch11 S2532_SR_Latch12 S2532_SR_Latch13 S2532_SR_Latch14 S2532_SR_Latch15 S2532_SR_Latch16 S2532_SR_Latch17 S2532_SR_Latch18 S2532_SR_Latch2 S2532_SR_Latch20 S2532_SR_Latch3 S2532_SR_Latch4 S2532_SR_Latch5 S2532_SR_Latch9 S2532_Triggered_Subsystem S2532_Triggered_Subsystem4 S2532_Triggered_Subsystem6 /end SUB_GROUP
 /begin REF_CHARACTERISTIC KVMC_ACCReqAccelGainSW_flg KVMC_ACCSpdCtrlSW_flg KVMC_ADSACCBRgnLimFr_Nm KVMC_ADSACCBRgnLimRr_Nm KVMC_ADSDecRspsRatio4RL_rat KVMC_ADSDecRspsRatio_rat KVMC_ADSDecShiftSW_flg KVMC_ADSPosGFBDisMCP_bar KVMC_ADSPosGFBDisRgn_Nm KVMC_ADSPosGFBDisWoRgn_flg KVMC_ADSPosGFBMCP_bar KVMC_ADSPosGFBPreventSpd_kph KVMC_ADSPosGFBPrevent_flg KVMC_ADSPosGFBPrvtLoSpd_flg KVMC_ADSPosGFBPrvtLoSpd_kph KVMC_ADSPosGFBRgn_Nm KVMC_AGSVReqAccel_mps2 KVMC_AccTurnHoldMinDec_mps2 KVMC_AvailRgnReachBGap_flg KVMC_CMDRepeatTime_enum KVMC_CallBrkJoinSpd_kph KVMC_DISCDecCtrlJerk_mps3 KVMC_DISCDecNoBrk_flg KVMC_EmgcHoldDecReqSW_flg KVMC_EmgcHoldDecReq_mps2 KVMC_EmgcHoldSpd_kph KVMC_LoSpdCallBrkDec_mps2 KVMC_MCPPassHoldDecTime_s KVMC_OVRD2ActRampSW_flg KVMC_ReachSpeedCountTime_s KVMC_ReachSpeedCount_flg KVMC_ReqAccelLowerLimit_mps2 KVMC_ReqBrkInDecSRAddDif_flg KVMC_ReqBrkInDecSW_flg KVMC_ReqBrkJoinWaitTime_s KVMC_ReqDecelLowerLimit_mps2 KVMC_SPD2ACCLastAccelSourceSW_flg KVMC_SpdCtrlDisBand_kph KVMC_SpdCtrlEnBand_kph KVMC_SpdCtrlReqAccel_mps2 KVMC_SprtAccelCMDSW_flg KVMC_TqAccelCtrlBand_mps2 KVMC_VHBigDeltaAcc4ATH_mps2 KVMC_VHDec4ADSGain_rat KVMC_VHDecCtrlCalSW2IncSW_flg KVMC_VHDecCtrlDecSR_mps3 KVMC_VHDecCtrlIncSR_mps3 KVMC_VHDecTargetSW_flg KVMC_VHFixDecTarget_mps2 KVMC_VHJerkPrvtDec_flg KVMC_VHJerkPrvtHoldDelay_flg KVMC_VHRrWhlSSWaitTime_s KVMC_VHTMSpdPassThres_rpm KVMC_VHTMSpdPassTime_s KVMC_VHTMSpdThresLowerLim_rpm KVMC_VehHoldCal1BigDeltaAcc_mps2 KVMC_VehHoldDecCtrlBSlope4ATH_mps3 KVMC_VehHoldDecCtrlBSlopeCal1_mps3 KVMC_VehHoldDecCtrlBSlopeInc_mps3 KVMC_VehHoldDecCtrlBSlope_mps3 KVMC_VehHoldDecCtrl_flg KVMC_VehHoldDelayMCP_bar KVMC_VehHoldDelaySW_flg KVMC_VehHoldDeltaAccDB_mps2 KVMC_VehHoldDist_m KVMC_VehHoldHEndChkMCP_flg KVMC_VehHoldHEndSpd_kph KVMC_VehHoldHTimeNoMCPCnt_s KVMC_VehHoldHTimeNoMCP_bar KVMC_VehHoldHoldDecTime_s KVMC_WhlStandstillReqTime_sec MVMC_ACCReqAccelGain_Z_rat MVMC_OVRD2ActSR2FCMCMD_Y_mps3 MVMC_ReqBrkJoinDecSR_Y_mps3 MVMC_VehHoldDecCtrlTime2_Y_s MVMC_VehHoldDecCtrlTime_Y_s MVMC_VehHoldMCPPass2_Y_bar MVMC_VehHoldMCPPass_Y_bar /end REF_CHARACTERISTIC
 /begin REF_MEASUREMENT VVMC_ACCConSpdCtrlCMD_mps2 VVMC_ACCReqAccelAftGn_mps2 VVMC_ACCReqAccelGain_rat VVMC_ACCRequiredAccel_mps2 VVMC_ACCVehHoldReq_flg VVMC_ADASWhlTqReachLim_flg VVMC_ADSACCBRgnLim_Nm VVMC_ADSDecRspsRatio_rat VVMC_ADSDecShiftEn_flg VVMC_ADSPosGFBDis_flg VVMC_ADSPosGFBEn_flg VVMC_AbsDeltaSpdNotZero_flg VVMC_AccAct_flg VVMC_AccelTurnHoldDet_flg VVMC_ActACCReqAcc4ADS_mps2 VVMC_ActACCRequiredAccel_mps2 VVMC_AfterCtrlACCReqAccel_mps2 VVMC_DISCConSpdCtrlCMD_mps2 VVMC_DISCReqAccAftLim_mps2 VVMC_DISCReqAccAftRepeat_mps2 VVMC_FeatArbitrFinal_enum VVMC_ISOJerkLimitFinal_mps3 VVMC_JerkSource_mps2 VVMC_OVRD2ActReqAccelAftSR_mps2 VVMC_PreACCReqAcc_mps2 VVMC_ReqAccelActive_flg VVMC_VHDecCtrlCalSW2Inc_flg VVMC_VHDecCtrlCalSW2ReachDec_flg VVMC_VHDecCtrlFinal_mps2 VVMC_VHDecTarget_mps2 VVMC_VehHoldDecCtrlAccel_mps2 VVMC_VehHoldDecCtrlBSlopeCal1_mps3 VVMC_VehHoldDecCtrlBSlopeCal2_mps3 VVMC_VehHoldDecCtrlBSlope_mps3 VVMC_VehHoldDeltaAccSta_enum VVMC_VehHoldEnReqAccel_mps2 VVMC_WhlBackward_flg VVMC_WhlStandstillReachT_flg VVMC_WhlStandstill_flg /end REF_MEASUREMENT
/end GROUP
/begin GROUP S2315_ADB_VehPitchAngleSta "SWC_FDC_type/run_SWC_FDC_RxTx_5ms_sys/APP/VMC/VMC/SafetyControl/ADB_VehPitchAngleSta" /begin SUB_GROUP S2586_FirstOrderFilter7 S2586_SR_Latch4 /end SUB_GROUP
 /begin REF_CHARACTERISTIC KVMC_CalEstPitchAngleTs_raw32 KVMC_IMUGxFilter4ADB_raw32 KVMC_VehPitchAngleMax_deg KVMC_VehPitchAngleMin_deg KVMC_VehStandstillSpd_kph KVMC_VehStandstillTimer_s MVMC_VehPitchAngleSta_Z_enum /end REF_CHARACTERISTIC
 /begin REF_MEASUREMENT VVMC_MemVehPitchAngleEst_deg VVMC_VehPitchAngleEst_deg VVMC_VehPitchAngleSta_enum VVMC_VehPitchAngleUpd_flg /end REF_MEASUREMENT
/end GROUP
/begin GROUP S2315_FirstOrderFilter "SWC_FDC_type/run_SWC_FDC_RxTx_5ms_sys/APP/VMC/VMC/SafetyControl/FirstOrderFilter" /begin REF_MEASUREMENT VVMC_RRWhlSpeedRollAve_kph /end REF_MEASUREMENT /end GROUP
/begin GROUP S2315_FirstOrderFilter1 "SWC_FDC_type/run_SWC_FDC_RxTx_5ms_sys/APP/VMC/VMC/SafetyControl/FirstOrderFilter1" /begin REF_MEASUREMENT VVMC_LRWhlSpeedRollAve_kph /end REF_MEASUREMENT /end GROUP
/begin GROUP S2315_FirstOrderFilter2 "SWC_FDC_type/run_SWC_FDC_RxTx_5ms_sys/APP/VMC/VMC/SafetyControl/FirstOrderFilter2" /begin REF_MEASUREMENT VVMC_RFWhlSpeedRollAve_kph /end REF_MEASUREMENT /end GROUP
/begin GROUP S2315_FirstOrderFilter3 "SWC_FDC_type/run_SWC_FDC_RxTx_5ms_sys/APP/VMC/VMC/SafetyControl/FirstOrderFilter3" /begin REF_MEASUREMENT VVMC_LFWhlSpeedRollAve_kph /end REF_MEASUREMENT /end GROUP
/begin GROUP S2315_FirstOrderFilter4 "SWC_FDC_type/run_SWC_FDC_RxTx_5ms_sys/APP/VMC/VMC/SafetyControl/FirstOrderFilter4" /begin REF_MEASUREMENT VVMC_LatAccRollAve_Gps /end REF_MEASUREMENT /end GROUP
/begin GROUP S2315_FirstOrderFilter6 "SWC_FDC_type/run_SWC_FDC_RxTx_5ms_sys/APP/VMC/VMC/SafetyControl/FirstOrderFilter6" /begin REF_MEASUREMENT VVMC_VehSpdRollAve_kph /end REF_MEASUREMENT /end GROUP
/begin GROUP S2315_LatAccRollingAverage "SWC_FDC_type/run_SWC_FDC_RxTx_5ms_sys/APP/VMC/VMC/SafetyControl/LatAccRollingAverage" /begin REF_CHARACTERISTIC KVMC_LatAccRollAveLevel_enum /end REF_CHARACTERISTIC /begin REF_MEASUREMENT VVMC_LatAccRollAveRaw_Gps /end REF_MEASUREMENT /end GROUP
/begin GROUP S2315_LongAccel_EstSlope_FrontRearSlipSpd "SWC_FDC_type/run_SWC_FDC_RxTx_5ms_sys/APP/VMC/VMC/SafetyControl/LongAccel_EstSlope_FrontRearSlipSpd" /begin SUB_GROUP S2594_Estimate_Slope /end SUB_GROUP /begin REF_CHARACTERISTIC KVMC_LongAccelDiffTime_s /end REF_CHARACTERISTIC
 /begin REF_MEASUREMENT VVMC_FrRrSlipSpd_kph VVMC_FrWhlSpdInvalid_flg VVMC_FrWhlSpdRollAve_kph VVMC_LongAccelCalcuByVehSpdRaw_gps VVMC_LongAccelCalcuFrWhlRaw_gps VVMC_LongAccelCalcuRrWhlRaw_gps VVMC_RrWhlSpdInvalid_flg VVMC_RrWhlSpdRollAve_kph /end REF_MEASUREMENT
/end GROUP
/begin GROUP S2315_Rolling_Average_Engage "SWC_FDC_type/run_SWC_FDC_RxTx_5ms_sys/APP/VMC/VMC/SafetyControl/Rolling Average Engage" /begin REF_CHARACTERISTIC KVMC_RollAveEnTime_s /end REF_CHARACTERISTIC /begin REF_MEASUREMENT VVMC_RollAveEn_flg /end REF_MEASUREMENT /end GROUP
/begin GROUP S2315_SafetyControlJudgement "SWC_FDC_type/run_SWC_FDC_RxTx_5ms_sys/APP/VMC/VMC/SafetyControl/SafetyControlJudgement"
 /begin SUB_GROUP S2596_FrontRearSlipRatio S2596_LateralAccelerationControl S2596_RearWheelSlipRatio S2596_SafetyControlJudgement S2596_SingleWheelSlipRatio /end SUB_GROUP
 /begin REF_CHARACTERISTIC KVMC_SafetyCtrlAllowTime_s /end REF_CHARACTERISTIC
 /begin REF_MEASUREMENT VVMC_FrontRearSlipRatioCtrl_flg VVMC_LatAccCtrl_flg VVMC_RearWhlSlipRatioCtrl_flg VVMC_SingleWhlSlipRatioCtrl_flg /end REF_MEASUREMENT
/end GROUP
/begin GROUP S2315_VehSpdRollingAverage "SWC_FDC_type/run_SWC_FDC_RxTx_5ms_sys/APP/VMC/VMC/SafetyControl/VehSpdRollingAverage" /begin SUB_GROUP S2597_RateLimit1 /end SUB_GROUP
 /begin REF_CHARACTERISTIC KVMC_VehSpdDecSRLim_kphps KVMC_VehSpdIncSRLim_kphps KVMC_VehSpdRollAveLevel_enum /end REF_CHARACTERISTIC
 /begin REF_MEASUREMENT VVMC_VehSpdRollAveRaw_kph /end REF_MEASUREMENT
/end GROUP
/begin GROUP S2315_WheelSpeedRollingAverage "SWC_FDC_type/run_SWC_FDC_RxTx_5ms_sys/APP/VMC/VMC/SafetyControl/WheelSpeedRollingAverage" /begin REF_CHARACTERISTIC KVMC_WhlSpdRollAveLevel_enum /end REF_CHARACTERISTIC
 /begin REF_MEASUREMENT VVMC_LFWhlSpeedRollAveRaw_kph VVMC_LRWhlSpeedRollAveRaw_kph VVMC_RFWhlSpeedRollAveRaw_kph VVMC_RRWhlSpeedRollAveRaw_kph /end REF_MEASUREMENT
/end GROUP
/begin GROUP S2318_4Wheel_Calculation "SWC_FDC_type/run_SWC_FDC_RxTx_5ms_sys/APP/VMC/VMC/Slide Rate  Calculation/4Wheel Calculation"
 /begin SUB_GROUP S2626_Determination S2626_LF_Wheel S2626_LR_Wheel S2626_RF_Wheel S2626_RR_Wheel /end SUB_GROUP
 /begin REF_CHARACTERISTIC KVMC_4WheelLongAccSW_flg /end REF_CHARACTERISTIC
 /begin REF_MEASUREMENT VVMC_4WheelLongAcc_Gps /end REF_MEASUREMENT
/end GROUP
/begin GROUP S2318_Alternative_Wheel_Slide_Calculation "SWC_FDC_type/run_SWC_FDC_RxTx_5ms_sys/APP/VMC/VMC/Slide Rate  Calculation/Alternative Wheel Slide Calculation" /begin REF_CHARACTERISTIC KVMC_RawWhlSpeedDeadZone_kph /end REF_CHARACTERISTIC
 /begin REF_MEASUREMENT VVMC_AltLWhlSlideRate_pct VVMC_AltRWhlSlideRate_pct VVMC_AltWhlSlideRate_pct VVMC_CalAltLWhlSlideRate_pct VVMC_CalAltRWhlSlideRate_pct /end REF_MEASUREMENT
/end GROUP
/begin GROUP S2318_Coordination "SWC_FDC_type/run_SWC_FDC_RxTx_5ms_sys/APP/VMC/VMC/Slide Rate  Calculation/Coordination"
 /begin SUB_GROUP S2628_DelayEnable S2628_FirstOrderFilter S2628_FirstOrderFilter1 S2628_FirstOrderFilter2 S2628_FirstOrderFilter3 S2628_FirstOrderFilter4 /end SUB_GROUP
 /begin REF_CHARACTERISTIC KTQD_OPDHoldGradeDown_Deg KTQD_OPDHoldGradeUp_Deg KVMC_4WhlSlideVehSpdDev_kph KVMC_4WhleelSlideDetTime_s KVMC_AltWheelSlideRateSW_flg KVMC_CalWhleelSlideTs_c KVMC_OPDDisSlideRateSpd_kph KVMC_WhlSlideEnDetBrkPedal_pct KVMC_WhlSlideEnDetTq_Nm KVMC_WhlSlideEnDetVehSpd_kph MVMC_OPDDisSlideRate_Y_pct /end REF_CHARACTERISTIC
 /begin REF_MEASUREMENT VVMC_4WheelSlide_flg VVMC_ActMaxSlideRate_pct VVMC_OPDDisSlideRate_flg VVMC_OPDDisSlideRate_pct VVMC_SlideRateEnCal_flg /end REF_MEASUREMENT
/end GROUP
/begin GROUP S2318_Partial_Wheel_Calculation "SWC_FDC_type/run_SWC_FDC_RxTx_5ms_sys/APP/VMC/VMC/Slide Rate  Calculation/Partial Wheel Calculation" /begin REF_CHARACTERISTIC KVMC_RawWhlSpeedDeadZone_kph /end REF_CHARACTERISTIC
 /begin REF_MEASUREMENT VVMC_LFCalWhlSpdSlideRate_pct VVMC_LFWhlSpdSlideRate_pct VVMC_LRCalWhlSpdSlideRate_pct VVMC_LRWhlSpdSlideRate_pct VVMC_MaxRawWhlSpeed_kph VVMC_MinRawWhlSpeed_kph VVMC_RFCalWhlSpdSlideRate_pct VVMC_RFWhlSpdSlideRate_pct VVMC_RRCalWhlSpdSlideRate_pct VVMC_RRWhlSpdSlideRate_pct VVMC_RawCalWhlSpdSlideRate_pct VVMC_RawWhlSpdSlideRate_pct /end REF_MEASUREMENT
/end GROUP
/begin GROUP S2319_Response_Gain "SWC_FDC_type/run_SWC_FDC_RxTx_5ms_sys/APP/VMC/VMC/SpeedArbitration/Response Gain"
 /begin REF_CHARACTERISTIC KVMC_MSAResponseAGSV_flg MVMC_AggressJerkPCT4AT_Y_pct MVMC_AggressJerkPCT_Y_pct MVMC_AggressLimitPCT4AT_Y_pct MVMC_AggressLimitPCT_Y_pct MVMC_SoftJerkPCT_Y_pct MVMC_SoftLimitPCT_Y_pct /end REF_CHARACTERISTIC
 /begin REF_MEASUREMENT VVMC_AggressJerkPCT_pct VVMC_AggressLimitPCT_pct VVMC_SoftJerkPCT_pct VVMC_SoftLimitPCT_pct /end REF_MEASUREMENT
/end GROUP
/begin GROUP S2320_FirstOrderFilter6 "SWC_FDC_type/run_SWC_FDC_RxTx_5ms_sys/APP/VMC/VMC/SpeedCalculation/FirstOrderFilter6" /begin REF_MEASUREMENT VVMC_MeterSpdRollAve_kph /end REF_MEASUREMENT /end GROUP
/begin GROUP S2321_SR_Latch3 "SWC_FDC_type/run_SWC_FDC_RxTx_5ms_sys/APP/VMC/VMC/VMC_FCM1/SR_Latch3" /begin REF_MEASUREMENT VVMC_LDW1stTrigged_flg /end REF_MEASUREMENT /end GROUP
/begin GROUP S2321_SR_Latch4 "SWC_FDC_type/run_SWC_FDC_RxTx_5ms_sys/APP/VMC/VMC/VMC_FCM1/SR_Latch4" /begin REF_MEASUREMENT VVMC_LDWRestTrigged_flg /end REF_MEASUREMENT /end GROUP
/begin GROUP S2321_SR_Latch5 "SWC_FDC_type/run_SWC_FDC_RxTx_5ms_sys/APP/VMC/VMC/VMC_FCM1/SR_Latch5" /begin REF_MEASUREMENT VVMC_LDW2ndTrigged_flg /end REF_MEASUREMENT /end GROUP
/begin GROUP S2321_SR_Latch6 "SWC_FDC_type/run_SWC_FDC_RxTx_5ms_sys/APP/VMC/VMC/VMC_FCM1/SR_Latch6" /begin REF_MEASUREMENT VVMC_LDWRest2Trigged_flg /end REF_MEASUREMENT /end GROUP
/begin GROUP S182_VALUE_TYPE_ACC "SWC_FDC_type/run_SWC_FDC_RxTx_5ms_sys/APP/BCM/BCM/Personal_Setting/ACC/VALUE_TYPE_ACC"
 /begin REF_MEASUREMENT VBCM_ACCLevelMem12_enum VBCM_ACCLevelMem34_enum VBCM_ACCLevelMem57_enum /end REF_MEASUREMENT
/end GROUP
/begin GROUP S183_TOGGLE_TYPE_AmbDimEN "SWC_FDC_type/run_SWC_FDC_RxTx_5ms_sys/APP/BCM/BCM/Personal_Setting/AmbLight/TOGGLE_TYPE_AmbDimEN" /begin REF_MEASUREMENT VBCM_AmbDimENFlash_enum VBCM_AmbDimEN_flg /end REF_MEASUREMENT /end GROUP
/begin GROUP S183_TOGGLE_TYPE_AmbFunEN "SWC_FDC_type/run_SWC_FDC_RxTx_5ms_sys/APP/BCM/BCM/Personal_Setting/AmbLight/TOGGLE_TYPE_AmbFunEN" /begin REF_MEASUREMENT VBCM_AmbFunENFlash_enum VBCM_AmbFunEN_flg /end REF_MEASUREMENT /end GROUP
/begin GROUP S183_TOGGLE_TYPE_AmbLinkDriSta "SWC_FDC_type/run_SWC_FDC_RxTx_5ms_sys/APP/BCM/BCM/Personal_Setting/AmbLight/TOGGLE_TYPE_AmbLinkDriSta" /begin REF_MEASUREMENT VBCM_AmbLinkDriStaFlash_enum VBCM_AmbLinkDriSta_flg /end REF_MEASUREMENT /end GROUP
/begin GROUP S183_TOGGLE_TYPE_AmbODAEN "SWC_FDC_type/run_SWC_FDC_RxTx_5ms_sys/APP/BCM/BCM/Personal_Setting/AmbLight/TOGGLE_TYPE_AmbODAEN" /begin REF_MEASUREMENT VBCM_AmbODAENFlash_enum VBCM_AmbODAEN_flg /end REF_MEASUREMENT /end GROUP
/begin GROUP S183_TOGGLE_TYPE_AmbPwrWarnEN "SWC_FDC_type/run_SWC_FDC_RxTx_5ms_sys/APP/BCM/BCM/Personal_Setting/AmbLight/TOGGLE_TYPE_AmbPwrWarnEN" /begin REF_MEASUREMENT VBCM_AmbPwrWarnENFlash_enum VBCM_AmbPwrWarnEN_flg /end REF_MEASUREMENT /end GROUP
/begin GROUP S183_TOGGLE_TYPE_AmbWelEN "SWC_FDC_type/run_SWC_FDC_RxTx_5ms_sys/APP/BCM/BCM/Personal_Setting/AmbLight/TOGGLE_TYPE_AmbWelEN" /begin REF_MEASUREMENT VBCM_AmbWelENFlash_enum VBCM_AmbWelEN_flg /end REF_MEASUREMENT /end GROUP
/begin GROUP S183_VALUE_TYPE_AmbBrightnessSta "SWC_FDC_type/run_SWC_FDC_RxTx_5ms_sys/APP/BCM/BCM/Personal_Setting/AmbLight/VALUE_TYPE_AmbBrightnessSta"
 /begin REF_MEASUREMENT VBCM_AmbBrightSta_enum VBCM_AmbBrightnessSta1_enum VBCM_AmbBrightnessSta2_enum VBCM_AmbBrightnessSta3_enum VBCM_AmbBrightnessSta4_enum VBCM_AmbBrightnessSta5_enum VBCM_AmbBrightnessSta7_enum /end REF_MEASUREMENT
/end GROUP
/begin GROUP S183_VALUE_TYPE_AmbColorSta "SWC_FDC_type/run_SWC_FDC_RxTx_5ms_sys/APP/BCM/BCM/Personal_Setting/AmbLight/VALUE_TYPE_AmbColorSta"
 /begin REF_MEASUREMENT VBCM_AmbColorSta1_enum VBCM_AmbColorSta2_enum VBCM_AmbColorSta3_enum VBCM_AmbColorSta4_enum VBCM_AmbColorSta5_enum VBCM_AmbColorSta7_enum VBCM_AmbColorSta_enum /end REF_MEASUREMENT
/end GROUP
/begin GROUP S184_TOGGLE_TYPE_AutoUnlock "SWC_FDC_type/run_SWC_FDC_RxTx_5ms_sys/APP/BCM/BCM/Personal_Setting/Autolock/TOGGLE_TYPE_AutoUnlock" /begin REF_MEASUREMENT VBCM_AutoUnlockMem_enum /end REF_MEASUREMENT /end GROUP
/begin GROUP S185_TOGGLE_TYPE_WalkInUnlock "SWC_FDC_type/run_SWC_FDC_RxTx_5ms_sys/APP/BCM/BCM/Personal_Setting/DKC_Lock_Setting/TOGGLE_TYPE_WalkInUnlock" /begin REF_MEASUREMENT VBCM_WalkInUnLkENFunSta_flg VBCM_WalkInUnLkENMem_enum /end REF_MEASUREMENT /end GROUP
/begin GROUP S185_TOGGLE_TYPE_WalkOutLock "SWC_FDC_type/run_SWC_FDC_RxTx_5ms_sys/APP/BCM/BCM/Personal_Setting/DKC_Lock_Setting/TOGGLE_TYPE_WalkOutLock" /begin REF_MEASUREMENT VBCM_WalkOutLkENMem_enum /end REF_MEASUREMENT /end GROUP
/begin GROUP S186_VALUE_TYPE_FlasherSignal "SWC_FDC_type/run_SWC_FDC_RxTx_5ms_sys/APP/BCM/BCM/Personal_Setting/FlasherSignal/VALUE_TYPE_FlasherSignal"
 /begin REF_MEASUREMENT VBCM_TurnSwTSetSta_enum VBCM_TurnSwTimeSetSta123_enum VBCM_TurnSwTimeSetSta457_enum /end REF_MEASUREMENT
/end GROUP
/begin GROUP S187_LockSetting "SWC_FDC_type/run_SWC_FDC_RxTx_5ms_sys/APP/BCM/BCM/Personal_Setting/FollowMeHome/LockSetting" /begin REF_MEASUREMENT VBCM_FollowMeENFunSta_flg VBCM_FollowMeENMem_enum /end REF_MEASUREMENT /end GROUP
/begin GROUP S188_LockSetting "SWC_FDC_type/run_SWC_FDC_RxTx_5ms_sys/APP/BCM/BCM/Personal_Setting/LockSetting/LockSetting" /begin REF_MEASUREMENT VBCM_LockSettingStaMem_enum VBCM_LockSetting_flg /end REF_MEASUREMENT /end GROUP
/begin GROUP S189_VALUE_TYPE_FlasherSignal "SWC_FDC_type/run_SWC_FDC_RxTx_5ms_sys/APP/BCM/BCM/Personal_Setting/PTG/VALUE_TYPE_FlasherSignal"
 /begin REF_MEASUREMENT VBCM_PTGOpenHeight12_enum VBCM_PTGOpenHeight34_enum VBCM_PTGOpenHeight57_enum VBCM_PTGOpenHeightSta_enum /end REF_MEASUREMENT
/end GROUP
/begin GROUP S189_VALUE_TYPE_PTGUserSetMaxHeight "SWC_FDC_type/run_SWC_FDC_RxTx_5ms_sys/APP/BCM/BCM/Personal_Setting/PTG/VALUE_TYPE_PTGUserSetMaxHeight"
 /begin REF_MEASUREMENT VBCM_PTGUserHeight1_cnt VBCM_PTGUserHeight2_cnt VBCM_PTGUserHeight3_cnt VBCM_PTGUserHeight4_cnt VBCM_PTGUserHeight5_cnt VBCM_PTGUserHeight7_cnt VBCM_UserHeightSet_cnt /end REF_MEASUREMENT
/end GROUP
/begin GROUP S190_TOGGLE_TYPE_RoomLampMode "SWC_FDC_type/run_SWC_FDC_RxTx_5ms_sys/APP/BCM/BCM/Personal_Setting/RoomLamp/TOGGLE_TYPE_RoomLampMode" /begin REF_MEASUREMENT VBCM_RmLpModeENFunSta_flg VBCM_RmLpModeENMem_enum /end REF_MEASUREMENT /end GROUP
/begin GROUP S191_TOGGLE_TYPE_AmbFunEN "SWC_FDC_type/run_SWC_FDC_RxTx_5ms_sys/APP/BCM/BCM/Personal_Setting/SPTG/TOGGLE_TYPE_AmbFunEN" /begin REF_MEASUREMENT VBCM_SPTGENFunMem_enum VBCM_SPTGENFun_flg /end REF_MEASUREMENT /end GROUP
/begin GROUP S351_Latch1 "SWC_FDC_type/run_SWC_FDC_RxTx_5ms_sys/APP/DHP/DHP/APS_calaulation/ZPLearn/Latch1" /begin REF_MEASUREMENT VDHP_EAPS2Learned_flg /end REF_MEASUREMENT /end GROUP
/begin GROUP S351_Latch2 "SWC_FDC_type/run_SWC_FDC_RxTx_5ms_sys/APP/DHP/DHP/APS_calaulation/ZPLearn/Latch2" /begin REF_MEASUREMENT VDHP_EAPS1Learned_flg /end REF_MEASUREMENT /end GROUP
/begin GROUP S913_APTCPWMControl "SWC_FDC_type/run_SWC_FDC_RxTx_5ms_sys/APP/THC/ThermalControl/THCM_Conctrl/APTC/APTCPWMControl" /begin REF_CHARACTERISTIC KTHC_APTCPeriod_cnt /end REF_CHARACTERISTIC /end GROUP
/begin GROUP S913_APTCPWMControl1 "SWC_FDC_type/run_SWC_FDC_RxTx_5ms_sys/APP/THC/ThermalControl/THCM_Conctrl/APTC/APTCPWMControl1" /begin REF_CHARACTERISTIC KTHC_APTCPeriod_cnt /end REF_CHARACTERISTIC /end GROUP
/begin GROUP S913_APTCPWMControl2 "SWC_FDC_type/run_SWC_FDC_RxTx_5ms_sys/APP/THC/ThermalControl/THCM_Conctrl/APTC/APTCPWMControl2" /begin REF_CHARACTERISTIC KTHC_APTCPeriod_cnt /end REF_CHARACTERISTIC /end GROUP
/begin GROUP S913_Subsystem "SWC_FDC_type/run_SWC_FDC_RxTx_5ms_sys/APP/THC/ThermalControl/THCM_Conctrl/APTC/Subsystem"
 /begin REF_CHARACTERISTIC KTHC_APTCOneZoneMax_W KTHC_APTCRiLeMaxDff_W KTHC_APTCRiLeMinDff_W MTHC_Qeq_Y_K /end REF_CHARACTERISTIC
/end GROUP
/begin GROUP S914_Enabled_Subsystem1 "SWC_FDC_type/run_SWC_FDC_RxTx_5ms_sys/APP/THC/ThermalControl/THCM_Conctrl/BlowerCtrl/Enabled Subsystem1"
 /begin REF_CHARACTERISTIC KTHC_VBlowerMid_K KTHC_VBlowerSetLow_K KTHC_VBlowerdfog_K MTHC_VbaseC_Z_K MTHC_VbaseD_Y_K MTHC_VbaseH_Y_K /end REF_CHARACTERISTIC
/end GROUP
/begin GROUP S918_Enabled_Subsystem "SWC_FDC_type/run_SWC_FDC_RxTx_5ms_sys/APP/THC/ThermalControl/THCM_Conctrl/CompCtrl/Enabled Subsystem"
 /begin REF_CHARACTERISTIC KTHC_DTymin1_K KTHC_DTymin2_K KTHC_DTymin3_K KTHC_DTymin4_K KTHC_DTymin5_K KTHC_T1Maxamb_C KTHC_T2Maxamb_C KTHC_T2Minamb_C KTHC_T3Maxamb_C KTHC_T3Minamb_C KTHC_T4Maxamb_C KTHC_T4Minamb_C KTHC_T5Minamb_C KTHC_Tambmin_C /end REF_CHARACTERISTIC
/end GROUP
/begin GROUP S918_Enabled_Subsystem1 "SWC_FDC_type/run_SWC_FDC_RxTx_5ms_sys/APP/THC/ThermalControl/THCM_Conctrl/CompCtrl/Enabled Subsystem1"
 /begin REF_CHARACTERISTIC KTHC_T1winSetpointBC_C KTHC_T2winSetpointBC_C KTHC_T4winSetpointBC_C KTHC_T5winSetpointBC_C /end REF_CHARACTERISTIC
/end GROUP
/begin GROUP S962_Subsystem1 "SWC_FDC_type/run_SWC_FDC_RxTx_5ms_sys/APP/THC/ThermalControl/THCM_Conctrl/Subsystem3/Subsystem1"
 /begin REF_CHARACTERISTIC KTHC_EWPErrHandleEN_flg KTHC_EWPErrorT_cnt KTHC_EWPRetryWarnT_cnt KTHC_EWPTotalRetryT_cnt KTHC_EWPpauseT_cnt KTHC_EWPretryT_cnt /end REF_CHARACTERISTIC
/end GROUP
/begin GROUP S962_Subsystem2 "SWC_FDC_type/run_SWC_FDC_RxTx_5ms_sys/APP/THC/ThermalControl/THCM_Conctrl/Subsystem3/Subsystem2"
 /begin REF_CHARACTERISTIC KTHC_EWPErrHandleEN_flg KTHC_EWPErrorT_cnt KTHC_EWPRetryWarnT_cnt KTHC_EWPTotalRetryT_cnt KTHC_EWPpauseT_cnt KTHC_EWPretryT_cnt /end REF_CHARACTERISTIC
/end GROUP
/begin GROUP S962_Subsystem3 "SWC_FDC_type/run_SWC_FDC_RxTx_5ms_sys/APP/THC/ThermalControl/THCM_Conctrl/Subsystem3/Subsystem3"
 /begin REF_CHARACTERISTIC KTHC_EWPErrHandleEN_flg KTHC_EWPErrorT_cnt KTHC_EWPRetryWarnT_cnt KTHC_EWPTotalRetryT_cnt KTHC_EWPpauseT_cnt KTHC_EWPretryT_cnt /end REF_CHARACTERISTIC
/end GROUP
/begin GROUP S1085_AutoLocation "SWC_FDC_type/run_SWC_FDC_RxTx_5ms_sys/APP/TPM/TPMS/TPMS/Learn/AutoLocation"
 /begin SUB_GROUP S1089_Doublecheck S1089_IDIdentify S1089_IDtrans S1089_Subsystem S1089_Subsystem1 S1089_WheelPosition /end SUB_GROUP
/end GROUP
/begin GROUP S1085_LowerTirePressureCalibration "SWC_FDC_type/run_SWC_FDC_RxTx_5ms_sys/APP/TPM/TPMS/TPMS/Learn/LowerTirePressureCalibration"
 /begin REF_MEASUREMENT VTPM_C_cnt VTPM_LFPindi_enum VTPM_LFWheelPSW_raw8 VTPM_LRPindi_enum VTPM_LRWheelPSW_raw8 VTPM_ManualID1P20_raw8 VTPM_ManualID2P20_raw8 VTPM_ManualID3P20_raw8 VTPM_ManualID4P20_raw8 VTPM_ManualP1alarm_raw VTPM_ManualP2alarm_raw VTPM_ManualP3alarm_raw VTPM_ManualP4alarm_raw VTPM_ManualS1pressindi_enum VTPM_ManualS2pressindi_enum VTPM_ManualS3pressindi_enum VTPM_ManualS4pressindi_enum VTPM_RFPind_enum VTPM_RFWheelPSW_raw8 VTPM_RRPindi_enum VTPM_RRWheelPSW_raw8 VTPM_Spressindi_enum /end REF_MEASUREMENT
/end GROUP
/begin GROUP S1086_Alarm "SWC_FDC_type/run_SWC_FDC_RxTx_5ms_sys/APP/TPM/TPMS/TPMS/Send/Alarm"
 /begin SUB_GROUP S1236_LFTHighWarn S1236_LRTHighWarn S1236_RFTHighWarn S1236_RRTHighWarn /end SUB_GROUP
 /begin REF_MEASUREMENT VTPM_AutoLTips_enum VTPM_CWheelTips_enum VTPM_LFPressIndi_enum VTPM_LRPressIndi_enum VTPM_RFPressIndi_enum VTPM_RRPressIndi_enum VTPM_TPMSWarnIndi_enum /end REF_MEASUREMENT
/end GROUP
/begin GROUP S1086_DATA "SWC_FDC_type/run_SWC_FDC_RxTx_5ms_sys/APP/TPM/TPMS/TPMS/Send/DATA"
 /begin REF_MEASUREMENT VTPM_LFBatWarn_flg VTPM_LFP20_raw8 VTPM_LFSensorFail_flg VTPM_LFSensorMode_flg VTPM_LFWheelDebug_flg VTPM_LFWheelPress_raw8 VTPM_LFWheelTemp_C VTPM_LRBatWarn_flg VTPM_LRP20_raw8 VTPM_LRSensorFail_flg VTPM_LRSensorMode_flg VTPM_LRWheelDebug_flg VTPM_LRWheelPress_raw8 VTPM_LRWheelTemp_C VTPM_Prepresstempvalid_enum VTPM_RFBatWarn_flg VTPM_RFP20_raw8 VTPM_RFSensorFail_flg VTPM_RFSensorMode_flg VTPM_RFWheelDebug_flg VTPM_RFWheelPress_raw8 VTPM_RFWheelTemp_C VTPM_RRBatWarn_flg VTPM_RRP20_raw8 VTPM_RRSensorFail_flg VTPM_RRSensorMode_flg VTPM_RRWheelDebug_flg VTPM_RRWheelPress_raw8 VTPM_RRWheelTemp_C /end REF_MEASUREMENT
/end GROUP
/begin GROUP S1086_ResetAllow_CalibrateAllow "SWC_FDC_type/run_SWC_FDC_RxTx_5ms_sys/APP/TPM/TPMS/TPMS/Send/ResetAllow&CalibrateAllow" /begin REF_CHARACTERISTIC KTPM_DataInVehSpdThreshold_kph /end REF_CHARACTERISTIC /begin REF_MEASUREMENT VTPM_TPMSCaliButtAllow_flg VTPM_TPMSResButtAllow_flg /end REF_MEASUREMENT /end GROUP
/begin GROUP S1316_Drive_Protection "SWC_FDC_type/run_SWC_FDC_RxTx_5ms_sys/APP/TQD/TorqueDemand/ShiftModule/GearShiftPosn/Drive Protection" /begin SUB_GROUP S1330_DelayEnable /end SUB_GROUP
 /begin REF_CHARACTERISTIC KTQD_DrivProtEnSW_flg KTQD_DrivProtEnToNTq_Nm KTQD_DriveProtDetTime_s /end REF_CHARACTERISTIC
 /begin REF_MEASUREMENT VTQD_DriveProtEn_flg VTQD_DriveProtToPsnN_flg /end REF_MEASUREMENT
/end GROUP
/begin GROUP S1370_RegenDOWN "SWC_FDC_type/run_SWC_FDC_RxTx_5ms_sys/APP/TQD/TorqueDemand/Signal_convert/Regen Level Switch Botton/RegenDOWN" /begin REF_CHARACTERISTIC KTQD_RegLongPLim_s KTQD_RegShortPLim_s /end REF_CHARACTERISTIC /end GROUP
/begin GROUP S1370_RegenUP "SWC_FDC_type/run_SWC_FDC_RxTx_5ms_sys/APP/TQD/TorqueDemand/Signal_convert/Regen Level Switch Botton/RegenUP" /begin REF_CHARACTERISTIC KTQD_RegLongPLim_s KTQD_RegShortPLim_s /end REF_CHARACTERISTIC /end GROUP
/begin GROUP S1380_Big_Mike_Combo "SWC_FDC_type/run_SWC_FDC_RxTx_5ms_sys/APP/TQD/TorqueDemand/Signal_convert/SWC2_Subsystem/Big Mike Combo"
 /begin SUB_GROUP S1406_Combo_Key_Detection S1406_Mode_Coordination S1406_Operation_Condition S1406_Signal_Status_Detection /end SUB_GROUP
/end GROUP
/begin GROUP S1380_L_ScrollPress_Behavior "SWC_FDC_type/run_SWC_FDC_RxTx_5ms_sys/APP/TQD/TorqueDemand/Signal_convert/SWC2_Subsystem/L_ScrollPress Behavior"
 /begin REF_CHARACTERISTIC KTQD_SpdModeLongPCancelLim_s KTQD_SpdModeLongPLim_s KTQD_SpdModeShortPLim_s /end REF_CHARACTERISTIC
 /begin REF_MEASUREMENT VTQD_LScrollPressLong_flg VTQD_LScrollPressShort_flg /end REF_MEASUREMENT
/end GROUP
/begin GROUP S1380_Road_Speed_Limit_Convert "SWC_FDC_type/run_SWC_FDC_RxTx_5ms_sys/APP/TQD/TorqueDemand/Signal_convert/SWC2_Subsystem/Road Speed Limit Convert"
 /begin REF_CHARACTERISTIC KTQD_ACCActiveMetSpdLoMPH_mph KTQD_ACCActiveMetSpdLo_kph KTQD_SpdLimOffsetOn_flg /end REF_CHARACTERISTIC
 /begin REF_MEASUREMENT VTQD_CalRoadSpdLimOffSet_c VTQD_CalRoadSpdLim_raw32 VTQD_RoadSpdLim_raw32 /end REF_MEASUREMENT
/end GROUP
/begin GROUP S1380_Speed_Setting_Mode "SWC_FDC_type/run_SWC_FDC_RxTx_5ms_sys/APP/TQD/TorqueDemand/Signal_convert/SWC2_Subsystem/Speed Setting Mode"
 /begin SUB_GROUP S1415_ACC_Speed_Setting_ON S1415_CC_Speed_Setting_ON S1415_ISA_Speed_Setting_ON S1415_MSA_Speed_Setting_ON S1415_SWC2ScrollDownSta S1415_SWC2ScrollUpSta /end SUB_GROUP
 /begin REF_CHARACTERISTIC KTQD_SCPMemSpdTest_flg KTQD_SetSpdDeltaLongFit_kph KTQD_SmartEcoLimitSpd_kph KTQD_SmartEcoLimitSpd_mph KTQD_SpdCtrlModeChgHoldTime_s /end REF_CHARACTERISTIC
/end GROUP
/begin GROUP S1381_SpdCtrlBotton_Behavior "SWC_FDC_type/run_SWC_FDC_RxTx_5ms_sys/APP/TQD/TorqueDemand/Signal_convert/SWC_Subsystem/SpdCtrlBotton Behavior" /begin REF_CHARACTERISTIC KTQD_SpdModeLongPLim_s KTQD_SpdModeShortPLim_s /end REF_CHARACTERISTIC /begin REF_MEASUREMENT VTQD_SpdCtrlLongP_flg VTQD_SpdCtrlShortP_flg /end REF_MEASUREMENT /end GROUP
/begin GROUP S1381_Speed_Setting_Mode "SWC_FDC_type/run_SWC_FDC_RxTx_5ms_sys/APP/TQD/TorqueDemand/Signal_convert/SWC_Subsystem/Speed Setting Mode"
 /begin SUB_GROUP S1761_ACC_Speed_Setting_ON S1761_CC_Speed_Setting_ON S1761_ISA_Speed_Setting_ON S1761_MSA_Speed_Setting_ON S1761_VTQD_SWCCancelP_flg S1761_VTQD_SWCResUpPress_enum S1761_VTQD_SWCSetDownPress_enum /end SUB_GROUP
 /begin REF_CHARACTERISTIC KTQD_SetSpdDeltaLongFit_kph KTQD_SmartEcoLimitSpd_kph KTQD_SmartEcoLimitSpd_mph /end REF_CHARACTERISTIC
 /begin REF_MEASUREMENT VTQD_SetSpdDeltaLongFit_kph /end REF_MEASUREMENT
/end GROUP
/begin GROUP S1381_Vehicle_to_Meter_Speed "SWC_FDC_type/run_SWC_FDC_RxTx_5ms_sys/APP/TQD/TorqueDemand/Signal_convert/SWC_Subsystem/Vehicle to Meter Speed" /begin REF_CHARACTERISTIC KTQD_Veh2MetSpdAdd_kph KTQD_Veh2MetSpdGain_c /end REF_CHARACTERISTIC /end GROUP
/begin GROUP S1382_RateLimit "SWC_FDC_type/run_SWC_FDC_RxTx_5ms_sys/APP/TQD/TorqueDemand/Signal_convert/Simulation Sound Wave /RateLimit" /begin REF_MEASUREMENT VTQD_SimSouWaveReq_pct /end REF_MEASUREMENT /end GROUP
/begin GROUP S1384_Calaulation "SWC_FDC_type/run_SWC_FDC_RxTx_5ms_sys/APP/TQD/TorqueDemand/Signal_convert/VehWeightEst/Calaulation"
 /begin SUB_GROUP S1794_Front_Wheel_Torque S1794_Long_Acc S1794_Rear_Wheel_Torque S1794_Vehicle_Weight /end SUB_GROUP
/end GROUP
/begin GROUP S1384_Condition "SWC_FDC_type/run_SWC_FDC_RxTx_5ms_sys/APP/TQD/TorqueDemand/Signal_convert/VehWeightEst/Condition" /begin SUB_GROUP S1795_DelayEnable S1795_Timer1 /end SUB_GROUP
 /begin REF_CHARACTERISTIC KTQD_EstDelayEnTime_s KTQD_EstWeighResetTime_s KTQD_FrTqDeviation_Nm KTQD_RrTqDeviation_Nm KTQD_VehWeighEstTime_s KTQD_VehWeightEstGradeEn_Deg KTQD_VehWeightEstSpdEnLow_kph KTQD_VehWeightEstSpdEnUp_kph /end REF_CHARACTERISTIC
 /begin REF_MEASUREMENT VTQD_EstVehWeitResetFinish_flg VTQD_FrTqErr_Nm VTQD_RrTqErr_Nm VTQD_VehWeightEstDis_flg VTQD_VehWeightEstEnCon10_flg VTQD_VehWeightEstEnCon11_flg VTQD_VehWeightEstEnCon12_flg VTQD_VehWeightEstEnCon1_flg VTQD_VehWeightEstEnCon2_flg VTQD_VehWeightEstEnCon3_flg VTQD_VehWeightEstEnCon4_flg VTQD_VehWeightEstEnCon5_flg VTQD_VehWeightEstEnCon6_flg VTQD_VehWeightEstEnCon7_flg VTQD_VehWeightEstEnCon8_flg VTQD_VehWeightEstEnCon9_flg /end REF_MEASUREMENT
/end GROUP
/begin GROUP S1384_Desicion "SWC_FDC_type/run_SWC_FDC_RxTx_5ms_sys/APP/TQD/TorqueDemand/Signal_convert/VehWeightEst/Desicion" /begin SUB_GROUP S1796_DelayEnable /end SUB_GROUP /begin REF_CHARACTERISTIC KTQD_EstEndDelayTime_s MTQD_EstInitVehWeight_Y_kg /end REF_CHARACTERISTIC
 /begin REF_MEASUREMENT VTQD_EstActVehWeight_kg VTQD_EstInitVehWeight_kg VTQD_EstInitVehWightX_c VTQD_EstVehWeightResult_kg VTQD_VehWeightEstEnter_flg /end REF_MEASUREMENT
/end GROUP
/begin GROUP S1385_SR_Latch "SWC_FDC_type/run_SWC_FDC_RxTx_5ms_sys/APP/TQD/TorqueDemand/Signal_convert/Wheel Status Judgment/SR_Latch" /begin REF_MEASUREMENT VTQD_LFWhlSkip_flg /end REF_MEASUREMENT /end GROUP
/begin GROUP S1385_SR_Latch1 "SWC_FDC_type/run_SWC_FDC_RxTx_5ms_sys/APP/TQD/TorqueDemand/Signal_convert/Wheel Status Judgment/SR_Latch1" /begin REF_MEASUREMENT VTQD_RFWhlSkip_flg /end REF_MEASUREMENT /end GROUP
/begin GROUP S1385_SR_Latch10 "SWC_FDC_type/run_SWC_FDC_RxTx_5ms_sys/APP/TQD/TorqueDemand/Signal_convert/Wheel Status Judgment/SR_Latch10" /begin REF_MEASUREMENT VTQD_NegRightWhlSkip_flg /end REF_MEASUREMENT /end GROUP
/begin GROUP S1385_SR_Latch11 "SWC_FDC_type/run_SWC_FDC_RxTx_5ms_sys/APP/TQD/TorqueDemand/Signal_convert/Wheel Status Judgment/SR_Latch11" /begin REF_MEASUREMENT VTQD_PosFrontWhlSkip_flg /end REF_MEASUREMENT /end GROUP
/begin GROUP S1385_SR_Latch12 "SWC_FDC_type/run_SWC_FDC_RxTx_5ms_sys/APP/TQD/TorqueDemand/Signal_convert/Wheel Status Judgment/SR_Latch12" /begin REF_MEASUREMENT VTQD_NegFrontWhlSkip_flg /end REF_MEASUREMENT /end GROUP
/begin GROUP S1385_SR_Latch13 "SWC_FDC_type/run_SWC_FDC_RxTx_5ms_sys/APP/TQD/TorqueDemand/Signal_convert/Wheel Status Judgment/SR_Latch13" /begin REF_MEASUREMENT VTQD_PosRearWhlSkip_flg /end REF_MEASUREMENT /end GROUP
/begin GROUP S1385_SR_Latch14 "SWC_FDC_type/run_SWC_FDC_RxTx_5ms_sys/APP/TQD/TorqueDemand/Signal_convert/Wheel Status Judgment/SR_Latch14" /begin REF_MEASUREMENT VTQD_NegRearWhlSkip_flg /end REF_MEASUREMENT /end GROUP
/begin GROUP S1385_SR_Latch15 "SWC_FDC_type/run_SWC_FDC_RxTx_5ms_sys/APP/TQD/TorqueDemand/Signal_convert/Wheel Status Judgment/SR_Latch15" /begin REF_MEASUREMENT VTQD_DoubleWhlSkip_flg /end REF_MEASUREMENT /end GROUP
/begin GROUP S1385_SR_Latch16 "SWC_FDC_type/run_SWC_FDC_RxTx_5ms_sys/APP/TQD/TorqueDemand/Signal_convert/Wheel Status Judgment/SR_Latch16" /begin REF_MEASUREMENT VTQD_PosLFRRWhlSkip_flg /end REF_MEASUREMENT /end GROUP
/begin GROUP S1385_SR_Latch17 "SWC_FDC_type/run_SWC_FDC_RxTx_5ms_sys/APP/TQD/TorqueDemand/Signal_convert/Wheel Status Judgment/SR_Latch17" /begin REF_MEASUREMENT VTQD_NegLFRRWhlSkip_flg /end REF_MEASUREMENT /end GROUP
/begin GROUP S1385_SR_Latch18 "SWC_FDC_type/run_SWC_FDC_RxTx_5ms_sys/APP/TQD/TorqueDemand/Signal_convert/Wheel Status Judgment/SR_Latch18" /begin REF_MEASUREMENT VTQD_PosRFLRWhlSkip_flg /end REF_MEASUREMENT /end GROUP
/begin GROUP S1385_SR_Latch19 "SWC_FDC_type/run_SWC_FDC_RxTx_5ms_sys/APP/TQD/TorqueDemand/Signal_convert/Wheel Status Judgment/SR_Latch19" /begin REF_MEASUREMENT VTQD_NegRFLRWhlSkip_flg /end REF_MEASUREMENT /end GROUP
/begin GROUP S1385_SR_Latch2 "SWC_FDC_type/run_SWC_FDC_RxTx_5ms_sys/APP/TQD/TorqueDemand/Signal_convert/Wheel Status Judgment/SR_Latch2" /begin REF_MEASUREMENT VTQD_LRWhlSkip_flg /end REF_MEASUREMENT /end GROUP
/begin GROUP S1385_SR_Latch20 "SWC_FDC_type/run_SWC_FDC_RxTx_5ms_sys/APP/TQD/TorqueDemand/Signal_convert/Wheel Status Judgment/SR_Latch20" /begin REF_MEASUREMENT VTQD_FrontLRWhlSkip_flg /end REF_MEASUREMENT /end GROUP
/begin GROUP S1385_SR_Latch21 "SWC_FDC_type/run_SWC_FDC_RxTx_5ms_sys/APP/TQD/TorqueDemand/Signal_convert/Wheel Status Judgment/SR_Latch21" /begin REF_MEASUREMENT VTQD_FrontRRWhlSkip_flg /end REF_MEASUREMENT /end GROUP
/begin GROUP S1385_SR_Latch22 "SWC_FDC_type/run_SWC_FDC_RxTx_5ms_sys/APP/TQD/TorqueDemand/Signal_convert/Wheel Status Judgment/SR_Latch22" /begin REF_MEASUREMENT VTQD_RearLFWhlSkip_flg /end REF_MEASUREMENT /end GROUP
/begin GROUP S1385_SR_Latch23 "SWC_FDC_type/run_SWC_FDC_RxTx_5ms_sys/APP/TQD/TorqueDemand/Signal_convert/Wheel Status Judgment/SR_Latch23" /begin REF_MEASUREMENT VTQD_RearRFWhlSkip_flg /end REF_MEASUREMENT /end GROUP
/begin GROUP S1385_SR_Latch24 "SWC_FDC_type/run_SWC_FDC_RxTx_5ms_sys/APP/TQD/TorqueDemand/Signal_convert/Wheel Status Judgment/SR_Latch24" /begin REF_MEASUREMENT VTQD_TripleWhlSkip_flg /end REF_MEASUREMENT /end GROUP
/begin GROUP S1385_SR_Latch25 "SWC_FDC_type/run_SWC_FDC_RxTx_5ms_sys/APP/TQD/TorqueDemand/Signal_convert/Wheel Status Judgment/SR_Latch25" /begin REF_MEASUREMENT VTQD_AllWhlSkip_flg /end REF_MEASUREMENT /end GROUP
/begin GROUP S1385_SR_Latch3 "SWC_FDC_type/run_SWC_FDC_RxTx_5ms_sys/APP/TQD/TorqueDemand/Signal_convert/Wheel Status Judgment/SR_Latch3" /begin REF_MEASUREMENT VTQD_RRWhlSkip_flg /end REF_MEASUREMENT /end GROUP
/begin GROUP S1385_SR_Latch4 "SWC_FDC_type/run_SWC_FDC_RxTx_5ms_sys/APP/TQD/TorqueDemand/Signal_convert/Wheel Status Judgment/SR_Latch4" /begin REF_MEASUREMENT VTQD_SingleWhlSkip_flg /end REF_MEASUREMENT /end GROUP
/begin GROUP S1385_SR_Latch5 "SWC_FDC_type/run_SWC_FDC_RxTx_5ms_sys/APP/TQD/TorqueDemand/Signal_convert/Wheel Status Judgment/SR_Latch5" /begin REF_MEASUREMENT VTQD_PosLeftWhlSkip_flg /end REF_MEASUREMENT /end GROUP
/begin GROUP S1385_SR_Latch6 "SWC_FDC_type/run_SWC_FDC_RxTx_5ms_sys/APP/TQD/TorqueDemand/Signal_convert/Wheel Status Judgment/SR_Latch6" /begin REF_MEASUREMENT VTQD_NegLeftWhlSkip_flg /end REF_MEASUREMENT /end GROUP
/begin GROUP S1849_If_Action_Subsystem1 "SWC_FDC_type/run_SWC_FDC_RxTx_5ms_sys/APP/TQD/TorqueDemand/TorqueModule/AvaliableTqLimit/If Action Subsystem1" /begin REF_MEASUREMENT VTQD_AvailTqWithARgnFr_Nm VTQD_AvailTqWithARgnRr_Nm /end REF_MEASUREMENT /end GROUP
/begin GROUP S1850_PedalMapWhlTq "SWC_FDC_type/run_SWC_FDC_RxTx_5ms_sys/APP/TQD/TorqueDemand/TorqueModule/DriverWhlTqDem/PedalMapWhlTq" /begin REF_CHARACTERISTIC KTQD_OPDHoldGradeDown_Deg KTQD_OPDHoldGradeUp_Deg /end REF_CHARACTERISTIC /end GROUP
/begin GROUP S1852_OPDHold_Request_ "SWC_FDC_type/run_SWC_FDC_RxTx_5ms_sys/APP/TQD/TorqueDemand/TorqueModule/OPD Hold/OPDHold Request " /begin REF_CHARACTERISTIC KTQD_OPDHoldGradeDown_Deg KTQD_OPDHoldGradeUp_Deg /end REF_CHARACTERISTIC /end GROUP
/begin GROUP S1852_Release_Condition "SWC_FDC_type/run_SWC_FDC_RxTx_5ms_sys/APP/TQD/TorqueDemand/TorqueModule/OPD Hold/Release Condition" /begin REF_CHARACTERISTIC KTQD_OPDHoldGradeDown_Deg KTQD_OPDHoldGradeUp_Deg /end REF_CHARACTERISTIC /end GROUP
/begin GROUP S2039_Front_Torque_zero_point_transfer_status_determination_ "SWC_FDC_type/run_SWC_FDC_RxTx_5ms_sys/APP/TQR/Determine Torque Request/TorqueArbitrament/TorqueSmooth/Front Torque zero point transfer status determination " /begin REF_CHARACTERISTIC KTQD_OPDHoldGradeDown_Deg KTQD_OPDHoldGradeUp_Deg /end REF_CHARACTERISTIC /end GROUP
/begin GROUP S2039_Rear_Torque_zero_point_transfer_status_determination_ "SWC_FDC_type/run_SWC_FDC_RxTx_5ms_sys/APP/TQR/Determine Torque Request/TorqueArbitrament/TorqueSmooth/Rear Torque zero point transfer status determination " /begin REF_CHARACTERISTIC KTQD_OPDHoldGradeDown_Deg KTQD_OPDHoldGradeUp_Deg /end REF_CHARACTERISTIC /end GROUP
/begin GROUP S2594_Estimate_Slope "SWC_FDC_type/run_SWC_FDC_RxTx_5ms_sys/APP/VMC/VMC/SafetyControl/LongAccel_EstSlope_FrontRearSlipSpd/Estimate Slope" /begin REF_CHARACTERISTIC KVMC_EstSlopeSW_flg /end REF_CHARACTERISTIC /end GROUP
/begin GROUP S2626_LF_Wheel "SWC_FDC_type/run_SWC_FDC_RxTx_5ms_sys/APP/VMC/VMC/Slide Rate  Calculation/4Wheel Calculation/LF Wheel" /begin REF_CHARACTERISTIC KVMC_RawWhlSpeedDeadZone_kph /end REF_CHARACTERISTIC /end GROUP
/begin GROUP S2626_LR_Wheel "SWC_FDC_type/run_SWC_FDC_RxTx_5ms_sys/APP/VMC/VMC/Slide Rate  Calculation/4Wheel Calculation/LR Wheel" /begin REF_CHARACTERISTIC KVMC_RawWhlSpeedDeadZone_kph /end REF_CHARACTERISTIC /end GROUP
/begin GROUP S2626_RF_Wheel "SWC_FDC_type/run_SWC_FDC_RxTx_5ms_sys/APP/VMC/VMC/Slide Rate  Calculation/4Wheel Calculation/RF Wheel" /begin REF_CHARACTERISTIC KVMC_RawWhlSpeedDeadZone_kph /end REF_CHARACTERISTIC /end GROUP
/begin GROUP S2626_RR_Wheel "SWC_FDC_type/run_SWC_FDC_RxTx_5ms_sys/APP/VMC/VMC/Slide Rate  Calculation/4Wheel Calculation/RR Wheel" /begin REF_CHARACTERISTIC KVMC_RawWhlSpeedDeadZone_kph /end REF_CHARACTERISTIC /end GROUP
/begin GROUP S1089_IDIdentify "SWC_FDC_type/run_SWC_FDC_RxTx_5ms_sys/APP/TPM/TPMS/TPMS/Learn/AutoLocation/IDIdentify" /begin REF_CHARACTERISTIC KTPM_DataInVehSpdThreshold_kph /end REF_CHARACTERISTIC /end GROUP
/begin GROUP S1415_ACC_Speed_Setting_ON "SWC_FDC_type/run_SWC_FDC_RxTx_5ms_sys/APP/TQD/TorqueDemand/Signal_convert/SWC2_Subsystem/Speed Setting Mode/ACC Speed Setting ON"
 /begin REF_CHARACTERISTIC KTQD_ACCActiveMetSpdLoMPH_mph KTQD_ACCActiveMetSpdLo_kph KTQD_SmartEcoLimitSpd_kph KTQD_SmartEcoLimitSpd_mph /end REF_CHARACTERISTIC
/end GROUP
/begin GROUP S1415_CC_Speed_Setting_ON "SWC_FDC_type/run_SWC_FDC_RxTx_5ms_sys/APP/TQD/TorqueDemand/Signal_convert/SWC2_Subsystem/Speed Setting Mode/CC Speed Setting ON"
 /begin REF_CHARACTERISTIC KTQD_SetSpdDeltaLongFit_kph KTQD_SmartEcoLimitSpd_kph KTQD_SmartEcoLimitSpd_mph /end REF_CHARACTERISTIC
/end GROUP
/begin GROUP S1415_ISA_Speed_Setting_ON "SWC_FDC_type/run_SWC_FDC_RxTx_5ms_sys/APP/TQD/TorqueDemand/Signal_convert/SWC2_Subsystem/Speed Setting Mode/ISA Speed Setting ON" /begin REF_CHARACTERISTIC KTQD_SmartEcoLimitSpd_kph /end REF_CHARACTERISTIC /end GROUP
/begin GROUP S1415_MSA_Speed_Setting_ON "SWC_FDC_type/run_SWC_FDC_RxTx_5ms_sys/APP/TQD/TorqueDemand/Signal_convert/SWC2_Subsystem/Speed Setting Mode/MSA Speed Setting ON"
 /begin REF_CHARACTERISTIC KTQD_MSAActiveMetSpdHiMPH_mph KTQD_MSAActiveMetSpdHi_kph KTQD_MSAActiveMetSpdLoMPH_mph KTQD_MSAActiveMetSpdLo_kph KTQD_SmartEcoLimitSpd_kph KTQD_SmartEcoLimitSpd_mph /end REF_CHARACTERISTIC
/end GROUP
/begin GROUP S1761_ACC_Speed_Setting_ON "SWC_FDC_type/run_SWC_FDC_RxTx_5ms_sys/APP/TQD/TorqueDemand/Signal_convert/SWC_Subsystem/Speed Setting Mode/ACC Speed Setting ON"
 /begin REF_CHARACTERISTIC KTQD_ACCActiveMetSpdLoMPH_mph KTQD_ACCActiveMetSpdLo_kph KTQD_SmartEcoLimitSpd_kph /end REF_CHARACTERISTIC
/end GROUP
/begin GROUP S1761_CC_Speed_Setting_ON "SWC_FDC_type/run_SWC_FDC_RxTx_5ms_sys/APP/TQD/TorqueDemand/Signal_convert/SWC_Subsystem/Speed Setting Mode/CC Speed Setting ON" /begin REF_CHARACTERISTIC KTQD_SetSpdDeltaLongFit_kph KTQD_SmartEcoLimitSpd_kph /end REF_CHARACTERISTIC /end GROUP
/begin GROUP S1761_ISA_Speed_Setting_ON "SWC_FDC_type/run_SWC_FDC_RxTx_5ms_sys/APP/TQD/TorqueDemand/Signal_convert/SWC_Subsystem/Speed Setting Mode/ISA Speed Setting ON" /begin REF_CHARACTERISTIC KTQD_SmartEcoLimitSpd_kph /end REF_CHARACTERISTIC /end GROUP
/begin GROUP S1761_MSA_Speed_Setting_ON "SWC_FDC_type/run_SWC_FDC_RxTx_5ms_sys/APP/TQD/TorqueDemand/Signal_convert/SWC_Subsystem/Speed Setting Mode/MSA Speed Setting ON"
 /begin REF_CHARACTERISTIC KTQD_MSAActiveMetSpdHiMPH_mph KTQD_MSAActiveMetSpdHi_kph KTQD_MSAActiveMetSpdLoMPH_mph KTQD_MSAActiveMetSpdLo_kph KTQD_SetSpdDeltaLongFit_kph KTQD_SmartEcoLimitSpd_kph /end REF_CHARACTERISTIC
/end GROUP
/begin GROUP S1794_Front_Wheel_Torque "SWC_FDC_type/run_SWC_FDC_RxTx_5ms_sys/APP/TQD/TorqueDemand/Signal_convert/VehWeightEst/Calaulation/Front Wheel Torque" /begin REF_CHARACTERISTIC KTQD_VehWeighEstTime_s /end REF_CHARACTERISTIC /end GROUP
/begin GROUP S1794_Long_Acc "SWC_FDC_type/run_SWC_FDC_RxTx_5ms_sys/APP/TQD/TorqueDemand/Signal_convert/VehWeightEst/Calaulation/Long Acc" /begin REF_CHARACTERISTIC KTQD_VehWeighEstTime_s /end REF_CHARACTERISTIC /end GROUP
/begin GROUP S1794_Rear_Wheel_Torque "SWC_FDC_type/run_SWC_FDC_RxTx_5ms_sys/APP/TQD/TorqueDemand/Signal_convert/VehWeightEst/Calaulation/Rear Wheel Torque" /begin REF_CHARACTERISTIC KTQD_VehWeighEstTime_s /end REF_CHARACTERISTIC /end GROUP
/begin GROUP S1098_Subsystem1 "SWC_FDC_type/run_SWC_FDC_RxTx_5ms_sys/APP/TPM/TPMS/TPMS/Learn/AutoLocation/IDIdentify/Subsystem1" /begin REF_CHARACTERISTIC KTPM_DataInVehSpdThreshold_kph /end REF_CHARACTERISTIC /end GROUP
/begin GROUP S1098_Subsystem2 "SWC_FDC_type/run_SWC_FDC_RxTx_5ms_sys/APP/TPM/TPMS/TPMS/Learn/AutoLocation/IDIdentify/Subsystem2" /begin REF_CHARACTERISTIC KTPM_DataInVehSpdThreshold_kph /end REF_CHARACTERISTIC /end GROUP
/begin GROUP S1098_Subsystem3 "SWC_FDC_type/run_SWC_FDC_RxTx_5ms_sys/APP/TPM/TPMS/TPMS/Learn/AutoLocation/IDIdentify/Subsystem3" /begin REF_CHARACTERISTIC KTPM_DataInVehSpdThreshold_kph /end REF_CHARACTERISTIC /end GROUP
/begin GROUP S1098_Subsystem7 "SWC_FDC_type/run_SWC_FDC_RxTx_5ms_sys/APP/TPM/TPMS/TPMS/Learn/AutoLocation/IDIdentify/Subsystem7" /begin REF_CHARACTERISTIC KTPM_DataInVehSpdThreshold_kph /end REF_CHARACTERISTIC /end GROUP
/end MODULE
/end PROJECT
