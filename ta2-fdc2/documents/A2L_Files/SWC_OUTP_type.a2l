ASAP2_VERSION 1 31
/begin PROJECT ProjectName "Project Comment Goes Here"
/begin HEADER "Header Comments go here" /end HEADER
/begin MODULE ModuleName "Module Comment Goes Here"
/begin MOD_COMMON "Mod Common Comment Here" BYTE_ORDER MSB_LAST /end MOD_COMMON
/begin RECORD_LAYOUT Scalar_BYTE FNC_VALUES 1 SBYTE COLUMN_DIR DIRECT /end RECORD_LAYOUT
/begin RECORD_LAYOUT Scalar_SWORD FNC_VALUES 1 SWORD COLUMN_DIR DIRECT /end RECORD_LAYOUT
/begin RECORD_LAYOUT Scalar_LONG FNC_VALUES 1 SLONG COLUMN_DIR DIRECT /end RECORD_LAYOUT
/begin RECORD_LAYOUT Scalar_FLOAT64_IEEE FNC_VALUES 1 FLOAT64_IEEE COLUMN_DIR DIRECT /end RECORD_LAYOUT
/begin RECORD_LAYOUT Lookup1D_BOOLEAN FNC_VALUES 1 UBYTE COLUMN_DIR DIRECT /end RECORD_LAYOUT
/begin RECORD_LAYOUT Lookup1D_X_BOOLEAN AXIS_PTS_X 1 UBYTE INDEX_INCR DIRECT /end RECORD_LAYOUT
/begin RECORD_LAYOUT Lookup1D_BYTE FNC_VALUES 1 SBYTE COLUMN_DIR DIRECT /end RECORD_LAYOUT
/begin MEASUREMENT VOUTP_RLDoorSWDTC_raw32 "" ULONG SWC_OUTP_type_CM_uint32_raw32 0 0 0.0 4.294967295E+9 ECU_ADDRESS 0x0000 /* @ECU_Address@VOUTP_RLDoorSWDTC_raw32@ */ /end MEASUREMENT
/begin MEASUREMENT VOUTP_RRDoorSWDTC_raw32 "" ULONG SWC_OUTP_type_CM_uint32_raw32 0 0 0.0 4.294967295E+9 ECU_ADDRESS 0x0000 /* @ECU_Address@VOUTP_RRDoorSWDTC_raw32@ */ /end MEASUREMENT
/begin MEASUREMENT VOUTP_TailgaSWDTC_raw32 "" ULONG SWC_OUTP_type_CM_uint32_raw32 0 0 0.0 4.294967295E+9 ECU_ADDRESS 0x0000 /* @ECU_Address@VOUTP_TailgaSWDTC_raw32@ */ /end MEASUREMENT
/begin MEASUREMENT VOUTP_Shifter1NoComDTC_raw32 "" ULONG SWC_OUTP_type_CM_uint32_raw32 0 0 0.0 4.294967295E+9 ECU_ADDRESS 0x0000 /* @ECU_Address@VOUTP_Shifter1NoComDTC_raw32@ */ /end MEASUREMENT
/begin MEASUREMENT VOUTP_RMLUSSDTC_raw32 "" ULONG SWC_OUTP_type_CM_uint32_raw32 0 0 0.0 4.294967295E+9 ECU_ADDRESS 0x0000 /* @ECU_Address@VOUTP_RMLUSSDTC_raw32@ */ /end MEASUREMENT
/begin MEASUREMENT VOUTP_RMRUSSDTC_raw32 "" ULONG SWC_OUTP_type_CM_uint32_raw32 0 0 0.0 4.294967295E+9 ECU_ADDRESS 0x0000 /* @ECU_Address@VOUTP_RMRUSSDTC_raw32@ */ /end MEASUREMENT
/begin MEASUREMENT VOUTP_RLLUSSDTC_raw32 "" ULONG SWC_OUTP_type_CM_uint32_raw32 0 0 0.0 4.294967295E+9 ECU_ADDRESS 0x0000 /* @ECU_Address@VOUTP_RLLUSSDTC_raw32@ */ /end MEASUREMENT
/begin MEASUREMENT VOUTP_RLRUSSDTC_raw32 "" ULONG SWC_OUTP_type_CM_uint32_raw32 0 0 0.0 4.294967295E+9 ECU_ADDRESS 0x0000 /* @ECU_Address@VOUTP_RLRUSSDTC_raw32@ */ /end MEASUREMENT
/begin MEASUREMENT VOUTP_ZoneSCPNoComDTC_raw32 "" ULONG SWC_OUTP_type_CM_uint32_raw32 0 0 0.0 4.294967295E+9 ECU_ADDRESS 0x0000 /* @ECU_Address@VOUTP_ZoneSCPNoComDTC_raw32@ */ /end MEASUREMENT
/begin MEASUREMENT VOUTP_RrMCUSigErrDetDTC_raw32 "" ULONG SWC_OUTP_type_CM_uint32_raw32 0 0 0.0 4.294967295E+9 ECU_ADDRESS 0x0000 /* @ECU_Address@VOUTP_RrMCUSigErrDetDTC_raw32@ */ /end MEASUREMENT
/begin MEASUREMENT VOUTP_Shifter1RCErrDTC_raw32 "" ULONG SWC_OUTP_type_CM_uint32_raw32 0 0 0.0 4.294967295E+9 ECU_ADDRESS 0x0000 /* @ECU_Address@VOUTP_Shifter1RCErrDTC_raw32@ */ /end MEASUREMENT
/begin MEASUREMENT VOUTP_Shifter1CSErrDTC_raw32 "" ULONG SWC_OUTP_type_CM_uint32_raw32 0 0 0.0 4.294967295E+9 ECU_ADDRESS 0x0000 /* @ECU_Address@VOUTP_Shifter1CSErrDTC_raw32@ */ /end MEASUREMENT
/begin MEASUREMENT VOUTP_RrMCUTqErrDTC_raw32 "" ULONG SWC_OUTP_type_CM_uint32_raw32 0 0 0.0 4.294967295E+9 ECU_ADDRESS 0x0000 /* @ECU_Address@VOUTP_RrMCUTqErrDTC_raw32@ */ /end MEASUREMENT
/begin MEASUREMENT VOUTP_RFBatwarnDTC_raw32 "" ULONG SWC_OUTP_type_CM_uint32_raw32 0 0 0.0 4.294967295E+9 ECU_ADDRESS 0x0000 /* @ECU_Address@VOUTP_RFBatwarnDTC_raw32@ */ /end MEASUREMENT
/begin MEASUREMENT VOUTP_RRBatwarnDTC_raw32 "" ULONG SWC_OUTP_type_CM_uint32_raw32 0 0 0.0 4.294967295E+9 ECU_ADDRESS 0x0000 /* @ECU_Address@VOUTP_RRBatwarnDTC_raw32@ */ /end MEASUREMENT
/begin MEASUREMENT VOUTP_RFPressIndiDTC_raw32 "" ULONG SWC_OUTP_type_CM_uint32_raw32 0 0 0.0 4.294967295E+9 ECU_ADDRESS 0x0000 /* @ECU_Address@VOUTP_RFPressIndiDTC_raw32@ */ /end MEASUREMENT
/begin MEASUREMENT VOUTP_RRPressIndiDTC_raw32 "" ULONG SWC_OUTP_type_CM_uint32_raw32 0 0 0.0 4.294967295E+9 ECU_ADDRESS 0x0000 /* @ECU_Address@VOUTP_RRPressIndiDTC_raw32@ */ /end MEASUREMENT
/begin MEASUREMENT VOUTP_RFWheelTmpHighDTC_raw32 "" ULONG SWC_OUTP_type_CM_uint32_raw32 0 0 0.0 4.294967295E+9 ECU_ADDRESS 0x0000 /* @ECU_Address@VOUTP_RFWheelTmpHighDTC_raw32@ */ /end MEASUREMENT
/begin MEASUREMENT VOUTP_RRWheelTmpHighDTC_raw32 "" ULONG SWC_OUTP_type_CM_uint32_raw32 0 0 0.0 4.294967295E+9 ECU_ADDRESS 0x0000 /* @ECU_Address@VOUTP_RRWheelTmpHighDTC_raw32@ */ /end MEASUREMENT
/begin MEASUREMENT VOUTP_RFSensorFailDTC_raw32 "" ULONG SWC_OUTP_type_CM_uint32_raw32 0 0 0.0 4.294967295E+9 ECU_ADDRESS 0x0000 /* @ECU_Address@VOUTP_RFSensorFailDTC_raw32@ */ /end MEASUREMENT
/begin MEASUREMENT VOUTP_RRSensorFailDTC_raw32 "" ULONG SWC_OUTP_type_CM_uint32_raw32 0 0 0.0 4.294967295E+9 ECU_ADDRESS 0x0000 /* @ECU_Address@VOUTP_RRSensorFailDTC_raw32@ */ /end MEASUREMENT
/begin MEASUREMENT VOUTP_TimeSNDKCFbk_cnt "" ULONG SWC_OUTP_type_CM_uint32_cnt 0 0 0.0 4.294967295E+9 ECU_ADDRESS 0x0000 /* @ECU_Address@VOUTP_TimeSNDKCFbk_cnt@ */ /end MEASUREMENT
/begin MEASUREMENT VOUTP_WisrBootReason_raw32 "" ULONG SWC_OUTP_type_CM_uint32_raw32 0 0 0.0 4.294967295E+9 ECU_ADDRESS 0x0000 /* @ECU_Address@VOUTP_WisrBootReason_raw32@ */ /end MEASUREMENT
/begin MEASUREMENT VOUTP_S1ID_raw32 "" ULONG SWC_OUTP_type_CM_uint32_raw32 0 0 0.0 4.294967295E+9 ECU_ADDRESS 0x0000 /* @ECU_Address@VOUTP_S1ID_raw32@ */ /end MEASUREMENT
/begin MEASUREMENT VOUTP_S2ID_raw32 "" ULONG SWC_OUTP_type_CM_uint32_raw32 0 0 0.0 4.294967295E+9 ECU_ADDRESS 0x0000 /* @ECU_Address@VOUTP_S2ID_raw32@ */ /end MEASUREMENT
/begin MEASUREMENT VOUTP_S3ID_raw32 "" ULONG SWC_OUTP_type_CM_uint32_raw32 0 0 0.0 4.294967295E+9 ECU_ADDRESS 0x0000 /* @ECU_Address@VOUTP_S3ID_raw32@ */ /end MEASUREMENT
/begin MEASUREMENT VOUTP_S4ID_raw32 "" ULONG SWC_OUTP_type_CM_uint32_raw32 0 0 0.0 4.294967295E+9 ECU_ADDRESS 0x0000 /* @ECU_Address@VOUTP_S4ID_raw32@ */ /end MEASUREMENT
/begin MEASUREMENT VOUTP_WriteChkLFID_raw "" ULONG SWC_OUTP_type_CM_uint32_raw 0 0 0.0 4.294967295E+9 ECU_ADDRESS 0x0000 /* @ECU_Address@VOUTP_WriteChkLFID_raw@ */ /end MEASUREMENT
/begin MEASUREMENT VOUTP_WriteChkRFID_raw "" ULONG SWC_OUTP_type_CM_uint32_raw 0 0 0.0 4.294967295E+9 ECU_ADDRESS 0x0000 /* @ECU_Address@VOUTP_WriteChkRFID_raw@ */ /end MEASUREMENT
/begin MEASUREMENT VOUTP_WriteChkLRID_raw "" ULONG SWC_OUTP_type_CM_uint32_raw 0 0 0.0 4.294967295E+9 ECU_ADDRESS 0x0000 /* @ECU_Address@VOUTP_WriteChkLRID_raw@ */ /end MEASUREMENT
/begin MEASUREMENT VOUTP_WriteChkRRID_raw "" ULONG SWC_OUTP_type_CM_uint32_raw 0 0 0.0 4.294967295E+9 ECU_ADDRESS 0x0000 /* @ECU_Address@VOUTP_WriteChkRRID_raw@ */ /end MEASUREMENT
/begin MEASUREMENT VOUTP_WriteChkfinLFID_raw "" ULONG SWC_OUTP_type_CM_uint32_raw 0 0 0.0 4.294967295E+9 ECU_ADDRESS 0x0000 /* @ECU_Address@VOUTP_WriteChkfinLFID_raw@ */ /end MEASUREMENT
/begin MEASUREMENT VOUTP_WriteChkfinRFID_raw "" ULONG SWC_OUTP_type_CM_uint32_raw 0 0 0.0 4.294967295E+9 ECU_ADDRESS 0x0000 /* @ECU_Address@VOUTP_WriteChkfinRFID_raw@ */ /end MEASUREMENT
/begin MEASUREMENT VOUTP_WriteChkfinLRID_raw "" ULONG SWC_OUTP_type_CM_uint32_raw 0 0 0.0 4.294967295E+9 ECU_ADDRESS 0x0000 /* @ECU_Address@VOUTP_WriteChkfinLRID_raw@ */ /end MEASUREMENT
/begin MEASUREMENT VOUTP_WriteChkfinRRID_raw "" ULONG SWC_OUTP_type_CM_uint32_raw 0 0 0.0 4.294967295E+9 ECU_ADDRESS 0x0000 /* @ECU_Address@VOUTP_WriteChkfinRRID_raw@ */ /end MEASUREMENT
/begin MEASUREMENT VOUTP_VehSpeed_kph "" FLOAT32_IEEE SWC_OUTP_type_CM_single_kph 0 0 0.0 300.0 ECU_ADDRESS 0x0000 /* @ECU_Address@VOUTP_VehSpeed_kph@ */ /end MEASUREMENT
/begin MEASUREMENT VOUTP_RFRawWhlSpeed_kph "" FLOAT32_IEEE SWC_OUTP_type_CM_single_kph 0 0 0.0 255.9375 ECU_ADDRESS 0x0000 /* @ECU_Address@VOUTP_RFRawWhlSpeed_kph@ */ /end MEASUREMENT
/begin MEASUREMENT VOUTP_RRRawWhlSpeed_kph "" FLOAT32_IEEE SWC_OUTP_type_CM_single_kph 0 0 0.0 255.9375 ECU_ADDRESS 0x0000 /* @ECU_Address@VOUTP_RRRawWhlSpeed_kph@ */ /end MEASUREMENT
/begin MEASUREMENT VOUTP_SASAngle_Deg "" FLOAT32_IEEE SWC_OUTP_type_CM_single_Deg 0 0 -900.0 900.0 ECU_ADDRESS 0x0000 /* @ECU_Address@VOUTP_SASAngle_Deg@ */ /end MEASUREMENT
/begin MEASUREMENT VOUTP_SASSpeed_degps "" FLOAT32_IEEE SWC_OUTP_type_CM_single_degps 0 0 0.0 1020.0 ECU_ADDRESS 0x0000 /* @ECU_Address@VOUTP_SASSpeed_degps@ */ /end MEASUREMENT
/begin MEASUREMENT VOUTP_YawRate_degps "" FLOAT32_IEEE SWC_OUTP_type_CM_single_degps 0 0 -100.0 100.0 ECU_ADDRESS 0x0000 /* @ECU_Address@VOUTP_YawRate_degps@ */ /end MEASUREMENT
/begin MEASUREMENT VOUTP_VSS_kph "" FLOAT32_IEEE SWC_OUTP_type_CM_single_kph 0 0 0.0 255.0 ECU_ADDRESS 0x0000 /* @ECU_Address@VOUTP_VSS_kph@ */ /end MEASUREMENT
/begin MEASUREMENT VOUTP_TNBCPSAR_Ahr "" FLOAT32_IEEE SWC_OUTP_type_CM_single_Ahr 0 0 0.0 4.294967295E+6 ECU_ADDRESS 0x0000 /* @ECU_Address@VOUTP_TNBCPSAR_Ahr@ */ /end MEASUREMENT
/begin MEASUREMENT VOUTP_TNBCPSAL_Ahr "" FLOAT32_IEEE SWC_OUTP_type_CM_single_Ahr 0 0 0.0 4.294967295E+8 ECU_ADDRESS 0x0000 /* @ECU_Address@VOUTP_TNBCPSAL_Ahr@ */ /end MEASUREMENT
/begin MEASUREMENT VOUTP_TNECPSAR_kWh "" FLOAT32_IEEE SWC_OUTP_type_CM_single_kWh 0 0 0.0 4.294967295E+8 ECU_ADDRESS 0x0000 /* @ECU_Address@VOUTP_TNECPSAR_kWh@ */ /end MEASUREMENT
/begin MEASUREMENT VOUTP_TNECPSAL_kWh "" FLOAT32_IEEE SWC_OUTP_type_CM_single_kWh 0 0 0.0 4.294967295E+8 ECU_ADDRESS 0x0000 /* @ECU_Address@VOUTP_TNECPSAL_kWh@ */ /end MEASUREMENT
/begin MEASUREMENT VOUTP_TEBPSAR_kWh "" FLOAT32_IEEE SWC_OUTP_type_CM_single_kWh 0 0 0.0 4.294967295E+8 ECU_ADDRESS 0x0000 /* @ECU_Address@VOUTP_TEBPSAR_kWh@ */ /end MEASUREMENT
/begin MEASUREMENT VOUTP_TEBPSAL_kWh "" FLOAT32_IEEE SWC_OUTP_type_CM_single_kWh 0 0 0.0 4.294967295E+8 ECU_ADDRESS 0x0000 /* @ECU_Address@VOUTP_TEBPSAL_kWh@ */ /end MEASUREMENT
/begin MEASUREMENT VOUTP_TGEOVCR_kWh "" FLOAT32_IEEE SWC_OUTP_type_CM_single_kWh 0 0 0.0 4.294967295E+8 ECU_ADDRESS 0x0000 /* @ECU_Address@VOUTP_TGEOVCR_kWh@ */ /end MEASUREMENT
/begin MEASUREMENT VOUTP_TGEOVCL_kWh "" FLOAT32_IEEE SWC_OUTP_type_CM_single_kWh 0 0 0.0 4.294967295E+8 ECU_ADDRESS 0x0000 /* @ECU_Address@VOUTP_TGEOVCL_kWh@ */ /end MEASUREMENT
/begin MEASUREMENT VOUTP_ResetCDEODTR_km "" FLOAT32_IEEE SWC_OUTP_type_CM_single_km 0 0 0.0 4.294967295E+8 ECU_ADDRESS 0x0000 /* @ECU_Address@VOUTP_ResetCDEODTR_km@ */ /end MEASUREMENT
/begin MEASUREMENT VOUTP_RFWheelTemp_C "" FLOAT32_IEEE SWC_OUTP_type_CM_single_C 0 0 -40.0 215.0 ECU_ADDRESS 0x0000 /* @ECU_Address@VOUTP_RFWheelTemp_C@ */ /end MEASUREMENT
/begin MEASUREMENT VOUTP_RRWheelTemp_C "" FLOAT32_IEEE SWC_OUTP_type_CM_single_C 0 0 -40.0 215.0 ECU_ADDRESS 0x0000 /* @ECU_Address@VOUTP_RRWheelTemp_C@ */ /end MEASUREMENT
/begin MEASUREMENT VOUTP_S1WheelDebugALTU_pct "" FLOAT32_IEEE SWC_OUTP_type_CM_single_pct 0 0 0.0 100.0 ECU_ADDRESS 0x0000 /* @ECU_Address@VOUTP_S1WheelDebugALTU_pct@ */ /end MEASUREMENT
/begin MEASUREMENT VOUTP_S2WheelDebugALTU_pct "" FLOAT32_IEEE SWC_OUTP_type_CM_single_pct 0 0 0.0 100.0 ECU_ADDRESS 0x0000 /* @ECU_Address@VOUTP_S2WheelDebugALTU_pct@ */ /end MEASUREMENT
/begin MEASUREMENT VOUTP_S3WheelDebugALTU_pct "" FLOAT32_IEEE SWC_OUTP_type_CM_single_pct 0 0 0.0 100.0 ECU_ADDRESS 0x0000 /* @ECU_Address@VOUTP_S3WheelDebugALTU_pct@ */ /end MEASUREMENT
/begin MEASUREMENT VOUTP_S4WheelDebugALTU_pct "" FLOAT32_IEEE SWC_OUTP_type_CM_single_pct 0 0 0.0 100.0 ECU_ADDRESS 0x0000 /* @ECU_Address@VOUTP_S4WheelDebugALTU_pct@ */ /end MEASUREMENT
/begin MEASUREMENT VOUTP_VCUMCUDemHiPosVal_rpm "" FLOAT32_IEEE SWC_OUTP_type_CM_single_rpm 0 0 -100000.0 100000.0 ECU_ADDRESS 0x0000 /* @ECU_Address@VOUTP_VCUMCUDemHiPosVal_rpm@ */ /end MEASUREMENT
/begin MEASUREMENT VOUTP_VehAcclLimitTG_mps2 "" FLOAT32_IEEE SWC_OUTP_type_CM_single_mps2 0 0 -20.0 20.0 ECU_ADDRESS 0x0000 /* @ECU_Address@VOUTP_VehAcclLimitTG_mps2@ */ /end MEASUREMENT
/begin MEASUREMENT VOUTP_VehSpdLimitTG_kph "" FLOAT32_IEEE SWC_OUTP_type_CM_single_kph 0 0 0.0 300.0 ECU_ADDRESS 0x0000 /* @ECU_Address@VOUTP_VehSpdLimitTG_kph@ */ /end MEASUREMENT
/begin MEASUREMENT VOUTP_VCUTMVehSpd_kph "" FLOAT32_IEEE SWC_OUTP_type_CM_single_kph 0 0 -300.0 300.0 ECU_ADDRESS 0x0000 /* @ECU_Address@VOUTP_VCUTMVehSpd_kph@ */ /end MEASUREMENT
/begin MEASUREMENT VOUTP_TMTqReq_Nm "" FLOAT32_IEEE SWC_OUTP_type_CM_single_Nm 0 0 -100000.0 100000.0 ECU_ADDRESS 0x0000 /* @ECU_Address@VOUTP_TMTqReq_Nm@ */ /end MEASUREMENT
/begin MEASUREMENT VOUTP_VCUMCUDemLoNegVal_rpm "" FLOAT32_IEEE SWC_OUTP_type_CM_single_rpm 0 0 -100000.0 100000.0 ECU_ADDRESS 0x0000 /* @ECU_Address@VOUTP_VCUMCUDemLoNegVal_rpm@ */ /end MEASUREMENT
/begin MEASUREMENT VOUTP_VCUMCUDemSpd_rpm "" FLOAT32_IEEE SWC_OUTP_type_CM_single_rpm 0 0 -100000.0 100000.0 ECU_ADDRESS 0x0000 /* @ECU_Address@VOUTP_VCUMCUDemSpd_rpm@ */ /end MEASUREMENT
/begin MEASUREMENT VOUTP_RrTMTqReq_Nm "" FLOAT32_IEEE SWC_OUTP_type_CM_single_Nm 0 0 -100000.0 100000.0 ECU_ADDRESS 0x0000 /* @ECU_Address@VOUTP_RrTMTqReq_Nm@ */ /end MEASUREMENT
/begin MEASUREMENT VOUTP_VehicleSpeed_mph "" FLOAT32_IEEE SWC_OUTP_type_CM_single_mph 0 0 0.0 254.0 ECU_ADDRESS 0x0000 /* @ECU_Address@VOUTP_VehicleSpeed_mph@ */ /end MEASUREMENT
/begin MEASUREMENT VOUTP_VehicleSpeed_kph "" FLOAT32_IEEE SWC_OUTP_type_CM_single_kph 0 0 0.0 254.0 ECU_ADDRESS 0x0000 /* @ECU_Address@VOUTP_VehicleSpeed_kph@ */ /end MEASUREMENT
/begin MEASUREMENT VOUTP_TimeGapCalcu_s "" FLOAT32_IEEE SWC_OUTP_type_CM_single_s 0 0 0.0 25.5 ECU_ADDRESS 0x0000 /* @ECU_Address@VOUTP_TimeGapCalcu_s@ */ /end MEASUREMENT
/begin MEASUREMENT VOUTP_RUNTM_s "" UWORD SWC_OUTP_type_CM_uint16_s 0 0 0.0 65535.0 ECU_ADDRESS 0x0000 /* @ECU_Address@VOUTP_RUNTM_s@ */ /end MEASUREMENT
/begin MEASUREMENT VOUTP_VinCode_cnt "" UBYTE SWC_OUTP_type_CM_uint8 0 0 0 255 ARRAY_SIZE 17 ECU_ADDRESS 0x0000 /* @ECU_Address@VOUTP_VinCode_cnt@ */ /end MEASUREMENT
/begin MEASUREMENT VOUTP_SNSRLayout_enum "" UBYTE SWC_OUTP_type_CM_uint8_enum 0 0 0.0 255.0 ECU_ADDRESS 0x0000 /* @ECU_Address@VOUTP_SNSRLayout_enum@ */ /end MEASUREMENT
/begin MEASUREMENT VOUTP_RFWhlRotDir_enum "" UBYTE SWC_OUTP_type_CM_uint8_enum 0 0 0.0 3.0 ECU_ADDRESS 0x0000 /* @ECU_Address@VOUTP_RFWhlRotDir_enum@ */ /end MEASUREMENT
/begin MEASUREMENT VOUTP_RRWhlRotDir_enum "" UBYTE SWC_OUTP_type_CM_uint8_enum 0 0 0.0 3.0 ECU_ADDRESS 0x0000 /* @ECU_Address@VOUTP_RRWhlRotDir_enum@ */ /end MEASUREMENT
/begin MEASUREMENT VOUTP_RFPulseCount_enum "" UBYTE SWC_OUTP_type_CM_uint8_enum 0 0 0.0 255.0 ECU_ADDRESS 0x0000 /* @ECU_Address@VOUTP_RFPulseCount_enum@ */ /end MEASUREMENT
/begin MEASUREMENT VOUTP_RRPulseCount_enum "" UBYTE SWC_OUTP_type_CM_uint8_enum 0 0 0.0 255.0 ECU_ADDRESS 0x0000 /* @ECU_Address@VOUTP_RRPulseCount_enum@ */ /end MEASUREMENT
/begin MEASUREMENT VOUTP_ShifterHandleCmd_enum "" UBYTE SWC_OUTP_type_CM_uint8_enum 0 0 0.0 255.0 ECU_ADDRESS 0x0000 /* @ECU_Address@VOUTP_ShifterHandleCmd_enum@ */ /end MEASUREMENT
/begin MEASUREMENT VOUTP_TurnLpPatternSta_enum "" UBYTE SWC_OUTP_type_CM_uint8_enum 0 0 0.0 3.0 ECU_ADDRESS 0x0000 /* @ECU_Address@VOUTP_TurnLpPatternSta_enum@ */ /end MEASUREMENT
/begin MEASUREMENT VOUTP_VehMalfunLevel_enum "" UBYTE SWC_OUTP_type_CM_uint8_enum 0 0 0.0 255.0 ECU_ADDRESS 0x0000 /* @ECU_Address@VOUTP_VehMalfunLevel_enum@ */ /end MEASUREMENT
/begin MEASUREMENT VOUTP_VCUBrkSWSta_enum "" UBYTE SWC_OUTP_type_CM_uint8_enum 0 0 0.0 2.0 ECU_ADDRESS 0x0000 /* @ECU_Address@VOUTP_VCUBrkSWSta_enum@ */ /end MEASUREMENT
/begin MEASUREMENT VOUTP_WARMUPS_cnt "" UBYTE SWC_OUTP_type_CM_uint8_cnt 0 0 0.0 255.0 ECU_ADDRESS 0x0000 /* @ECU_Address@VOUTP_WARMUPS_cnt@ */ /end MEASUREMENT
/begin MEASUREMENT VOUTP_STASUP_enum "" UBYTE SWC_OUTP_type_CM_uint8_enum 0 0 0.0 255.0 ECU_ADDRESS 0x0000 /* @ECU_Address@VOUTP_STASUP_enum@ */ /end MEASUREMENT
/begin MEASUREMENT VOUTP_UIDLowPowerSta_enum "" UBYTE SWC_OUTP_type_CM_uint8_enum 0 0 0.0 255.0 ECU_ADDRESS 0x0000 /* @ECU_Address@VOUTP_UIDLowPowerSta_enum@ */ /end MEASUREMENT
/begin MEASUREMENT VOUTP_WakeUp_enum "" UBYTE SWC_OUTP_type_CM_uint8_enum 0 0 0.0 15.0 ECU_ADDRESS 0x0000 /* @ECU_Address@VOUTP_WakeUp_enum@ */ /end MEASUREMENT
/begin MEASUREMENT VOUTP_SysNMmSta_enum "" UBYTE SWC_OUTP_type_CM_uint8_enum 0 0 0.0 15.0 ECU_ADDRESS 0x0000 /* @ECU_Address@VOUTP_SysNMmSta_enum@ */ /end MEASUREMENT
/begin MEASUREMENT VOUTP_SysPowerMode_enum "" UBYTE SWC_OUTP_type_CM_uint8_enum 0 0 0.0 10.0 ECU_ADDRESS 0x0000 /* @ECU_Address@VOUTP_SysPowerMode_enum@ */ /end MEASUREMENT
/begin MEASUREMENT VOUTP_V2BLifeSig_cnt "" UBYTE SWC_OUTP_type_CM_uint8_cnt 0 0 0.0 255.0 ECU_ADDRESS 0x0000 /* @ECU_Address@VOUTP_V2BLifeSig_cnt@ */ /end MEASUREMENT
/begin MEASUREMENT VOUTP_V2BAux1OnOff_enum "" UBYTE SWC_OUTP_type_CM_uint8_enum 0 0 0.0 3.0 ECU_ADDRESS 0x0000 /* @ECU_Address@VOUTP_V2BAux1OnOff_enum@ */ /end MEASUREMENT
/begin MEASUREMENT VOUTP_V2BAux2OnOff_enum "" UBYTE SWC_OUTP_type_CM_uint8_enum 0 0 0.0 3.0 ECU_ADDRESS 0x0000 /* @ECU_Address@VOUTP_V2BAux2OnOff_enum@ */ /end MEASUREMENT
/begin MEASUREMENT VOUTP_V2BAux3OnOff_enum "" UBYTE SWC_OUTP_type_CM_uint8_enum 0 0 0.0 3.0 ECU_ADDRESS 0x0000 /* @ECU_Address@VOUTP_V2BAux3OnOff_enum@ */ /end MEASUREMENT
/begin MEASUREMENT VOUTP_V2BMainPosRlySta_enum "" UBYTE SWC_OUTP_type_CM_uint8_enum 0 0 0.0 3.0 ECU_ADDRESS 0x0000 /* @ECU_Address@VOUTP_V2BMainPosRlySta_enum@ */ /end MEASUREMENT
/begin MEASUREMENT VOUTP_V2BMainPosRlyFit_enum "" UBYTE SWC_OUTP_type_CM_uint8_enum 0 0 0.0 3.0 ECU_ADDRESS 0x0000 /* @ECU_Address@VOUTP_V2BMainPosRlyFit_enum@ */ /end MEASUREMENT
/begin MEASUREMENT VOUTP_V2BACPosRlySta_enum "" UBYTE SWC_OUTP_type_CM_uint8_enum 0 0 0.0 3.0 ECU_ADDRESS 0x0000 /* @ECU_Address@VOUTP_V2BACPosRlySta_enum@ */ /end MEASUREMENT
/begin MEASUREMENT VOUTP_V2BACPosRlyFit_enum "" UBYTE SWC_OUTP_type_CM_uint8_enum 0 0 0.0 3.0 ECU_ADDRESS 0x0000 /* @ECU_Address@VOUTP_V2BACPosRlyFit_enum@ */ /end MEASUREMENT
/begin MEASUREMENT VOUTP_V2BAirPosRlySta_enum "" UBYTE SWC_OUTP_type_CM_uint8_enum 0 0 0.0 3.0 ECU_ADDRESS 0x0000 /* @ECU_Address@VOUTP_V2BAirPosRlySta_enum@ */ /end MEASUREMENT
/begin MEASUREMENT VOUTP_V2BAirPosRlyFit_enum "" UBYTE SWC_OUTP_type_CM_uint8_enum 0 0 0.0 3.0 ECU_ADDRESS 0x0000 /* @ECU_Address@VOUTP_V2BAirPosRlyFit_enum@ */ /end MEASUREMENT
/begin MEASUREMENT VOUTP_V2BOilPosRlySta_enum "" UBYTE SWC_OUTP_type_CM_uint8_enum 0 0 0.0 3.0 ECU_ADDRESS 0x0000 /* @ECU_Address@VOUTP_V2BOilPosRlySta_enum@ */ /end MEASUREMENT
/begin MEASUREMENT VOUTP_V2BOilPosRlyFit_enum "" UBYTE SWC_OUTP_type_CM_uint8_enum 0 0 0.0 3.0 ECU_ADDRESS 0x0000 /* @ECU_Address@VOUTP_V2BOilPosRlyFit_enum@ */ /end MEASUREMENT
/begin MEASUREMENT VOUTP_V2BDCDCPosRlySta_enum "" UBYTE SWC_OUTP_type_CM_uint8_enum 0 0 0.0 3.0 ECU_ADDRESS 0x0000 /* @ECU_Address@VOUTP_V2BDCDCPosRlySta_enum@ */ /end MEASUREMENT
/begin MEASUREMENT VOUTP_V2BDCDCPosRlyFit_enum "" UBYTE SWC_OUTP_type_CM_uint8_enum 0 0 0.0 3.0 ECU_ADDRESS 0x0000 /* @ECU_Address@VOUTP_V2BDCDCPosRlyFit_enum@ */ /end MEASUREMENT
/begin MEASUREMENT VOUTP_V2BAux1RlySta_enum "" UBYTE SWC_OUTP_type_CM_uint8_enum 0 0 0.0 3.0 ECU_ADDRESS 0x0000 /* @ECU_Address@VOUTP_V2BAux1RlySta_enum@ */ /end MEASUREMENT
/begin MEASUREMENT VOUTP_V2BAux1RlyFit_enum "" UBYTE SWC_OUTP_type_CM_uint8_enum 0 0 0.0 3.0 ECU_ADDRESS 0x0000 /* @ECU_Address@VOUTP_V2BAux1RlyFit_enum@ */ /end MEASUREMENT
/begin MEASUREMENT VOUTP_V2BAux2RlySta_enum "" UBYTE SWC_OUTP_type_CM_uint8_enum 0 0 0.0 3.0 ECU_ADDRESS 0x0000 /* @ECU_Address@VOUTP_V2BAux2RlySta_enum@ */ /end MEASUREMENT
/begin MEASUREMENT VOUTP_V2BAux2RlyFit_enum "" UBYTE SWC_OUTP_type_CM_uint8_enum 0 0 0.0 3.0 ECU_ADDRESS 0x0000 /* @ECU_Address@VOUTP_V2BAux2RlyFit_enum@ */ /end MEASUREMENT
/begin MEASUREMENT VOUTP_V2BAux3RlySta_enum "" UBYTE SWC_OUTP_type_CM_uint8_enum 0 0 0.0 3.0 ECU_ADDRESS 0x0000 /* @ECU_Address@VOUTP_V2BAux3RlySta_enum@ */ /end MEASUREMENT
/begin MEASUREMENT VOUTP_V2BAux3RlyFit_enum "" UBYTE SWC_OUTP_type_CM_uint8_enum 0 0 0.0 3.0 ECU_ADDRESS 0x0000 /* @ECU_Address@VOUTP_V2BAux3RlyFit_enum@ */ /end MEASUREMENT
/begin MEASUREMENT VOUTP_V2BAux4RlySta_enum "" UBYTE SWC_OUTP_type_CM_uint8_enum 0 0 0.0 3.0 ECU_ADDRESS 0x0000 /* @ECU_Address@VOUTP_V2BAux4RlySta_enum@ */ /end MEASUREMENT
/begin MEASUREMENT VOUTP_V2BAux4RlyFit_enum "" UBYTE SWC_OUTP_type_CM_uint8_enum 0 0 0.0 3.0 ECU_ADDRESS 0x0000 /* @ECU_Address@VOUTP_V2BAux4RlyFit_enum@ */ /end MEASUREMENT
/begin MEASUREMENT VOUTP_VCULife1_cnt "" UBYTE SWC_OUTP_type_CM_uint8_cnt 0 0 0.0 255.0 ECU_ADDRESS 0x0000 /* @ECU_Address@VOUTP_VCULife1_cnt@ */ /end MEASUREMENT
/begin MEASUREMENT VOUTP_VCULife2_cnt "" UBYTE SWC_OUTP_type_CM_uint8_cnt 0 0 0.0 255.0 ECU_ADDRESS 0x0000 /* @ECU_Address@VOUTP_VCULife2_cnt@ */ /end MEASUREMENT
/begin MEASUREMENT VOUTP_VSPFunc_enum "" UBYTE SWC_OUTP_type_CM_uint8_enum 0 0 0.0 3.0 ECU_ADDRESS 0x0000 /* @ECU_Address@VOUTP_VSPFunc_enum@ */ /end MEASUREMENT
/begin MEASUREMENT VOUTP_VSPIGNKeySta_enum "" UBYTE SWC_OUTP_type_CM_uint8_enum 0 0 0.0 3.0 ECU_ADDRESS 0x0000 /* @ECU_Address@VOUTP_VSPIGNKeySta_enum@ */ /end MEASUREMENT
/begin MEASUREMENT VOUTP_VSPTurnRight_enum "" UBYTE SWC_OUTP_type_CM_uint8_enum 0 0 0.0 255.0 ECU_ADDRESS 0x0000 /* @ECU_Address@VOUTP_VSPTurnRight_enum@ */ /end MEASUREMENT
/begin MEASUREMENT VOUTP_VSPTurnLeft_enum "" UBYTE SWC_OUTP_type_CM_uint8_enum 0 0 0.0 255.0 ECU_ADDRESS 0x0000 /* @ECU_Address@VOUTP_VSPTurnLeft_enum@ */ /end MEASUREMENT
/begin MEASUREMENT VOUTP_Variation_cnt "" UBYTE SWC_OUTP_type_CM_uint8_cnt 0 0 0.0 255.0 ECU_ADDRESS 0x0000 /* @ECU_Address@VOUTP_Variation_cnt@ */ /end MEASUREMENT
/begin MEASUREMENT VOUTP_SHA1_cnt "" UBYTE SWC_OUTP_type_CM_uint8_cnt 0 0 0.0 255.0 ECU_ADDRESS 0x0000 /* @ECU_Address@VOUTP_SHA1_cnt@ */ /end MEASUREMENT
/begin MEASUREMENT VOUTP_SHA2_cnt "" UBYTE SWC_OUTP_type_CM_uint8_cnt 0 0 0.0 255.0 ECU_ADDRESS 0x0000 /* @ECU_Address@VOUTP_SHA2_cnt@ */ /end MEASUREMENT
/begin MEASUREMENT VOUTP_SHA3_cnt "" UBYTE SWC_OUTP_type_CM_uint8_cnt 0 0 0.0 255.0 ECU_ADDRESS 0x0000 /* @ECU_Address@VOUTP_SHA3_cnt@ */ /end MEASUREMENT
/begin MEASUREMENT VOUTP_SHA4_cnt "" UBYTE SWC_OUTP_type_CM_uint8_cnt 0 0 0.0 255.0 ECU_ADDRESS 0x0000 /* @ECU_Address@VOUTP_SHA4_cnt@ */ /end MEASUREMENT
/begin MEASUREMENT VOUTP_SHA5_cnt "" UBYTE SWC_OUTP_type_CM_uint8_cnt 0 0 0.0 255.0 ECU_ADDRESS 0x0000 /* @ECU_Address@VOUTP_SHA5_cnt@ */ /end MEASUREMENT
/begin MEASUREMENT VOUTP_SHA6_cnt "" UBYTE SWC_OUTP_type_CM_uint8_cnt 0 0 0.0 255.0 ECU_ADDRESS 0x0000 /* @ECU_Address@VOUTP_SHA6_cnt@ */ /end MEASUREMENT
/begin MEASUREMENT VOUTP_SHA7_cnt "" UBYTE SWC_OUTP_type_CM_uint8_cnt 0 0 0.0 255.0 ECU_ADDRESS 0x0000 /* @ECU_Address@VOUTP_SHA7_cnt@ */ /end MEASUREMENT
/begin MEASUREMENT VOUTP_SHA8_cnt "" UBYTE SWC_OUTP_type_CM_uint8_cnt 0 0 0.0 255.0 ECU_ADDRESS 0x0000 /* @ECU_Address@VOUTP_SHA8_cnt@ */ /end MEASUREMENT
/begin MEASUREMENT VOUTP_RFWheelPress_raw8 "" UBYTE SWC_OUTP_type_CM_uint8_raw8 0 0 0.0 255.0 ECU_ADDRESS 0x0000 /* @ECU_Address@VOUTP_RFWheelPress_raw8@ */ /end MEASUREMENT
/begin MEASUREMENT VOUTP_RRWheelPress_raw8 "" UBYTE SWC_OUTP_type_CM_uint8_raw8 0 0 0.0 255.0 ECU_ADDRESS 0x0000 /* @ECU_Address@VOUTP_RRWheelPress_raw8@ */ /end MEASUREMENT
/begin MEASUREMENT VOUTP_RFPressIndi_enum "" UBYTE SWC_OUTP_type_CM_uint8_enum 0 0 0.0 4.0 ECU_ADDRESS 0x0000 /* @ECU_Address@VOUTP_RFPressIndi_enum@ */ /end MEASUREMENT
/begin MEASUREMENT VOUTP_RRPressIndi_enum "" UBYTE SWC_OUTP_type_CM_uint8_enum 0 0 0.0 4.0 ECU_ADDRESS 0x0000 /* @ECU_Address@VOUTP_RRPressIndi_enum@ */ /end MEASUREMENT
/begin MEASUREMENT VOUTP_TPMSWarnIndi_enum "" UBYTE SWC_OUTP_type_CM_uint8_enum 0 0 0.0 3.0 ECU_ADDRESS 0x0000 /* @ECU_Address@VOUTP_TPMSWarnIndi_enum@ */ /end MEASUREMENT
/begin MEASUREMENT VOUTP_RFWheelPSW_raw8 "" UBYTE SWC_OUTP_type_CM_uint8_raw8 0 0 0.0 200.0 ECU_ADDRESS 0x0000 /* @ECU_Address@VOUTP_RFWheelPSW_raw8@ */ /end MEASUREMENT
/begin MEASUREMENT VOUTP_RRWheelPSW_raw8 "" UBYTE SWC_OUTP_type_CM_uint8_raw8 0 0 0.0 200.0 ECU_ADDRESS 0x0000 /* @ECU_Address@VOUTP_RRWheelPSW_raw8@ */ /end MEASUREMENT
/begin MEASUREMENT VOUTP_S1L_enum "" UBYTE SWC_OUTP_type_CM_uint8_enum 0 0 0.0 5.0 ECU_ADDRESS 0x0000 /* @ECU_Address@VOUTP_S1L_enum@ */ /end MEASUREMENT
/begin MEASUREMENT VOUTP_S2L_enum "" UBYTE SWC_OUTP_type_CM_uint8_enum 0 0 0.0 5.0 ECU_ADDRESS 0x0000 /* @ECU_Address@VOUTP_S2L_enum@ */ /end MEASUREMENT
/begin MEASUREMENT VOUTP_S3L_enum "" UBYTE SWC_OUTP_type_CM_uint8_enum 0 0 0.0 5.0 ECU_ADDRESS 0x0000 /* @ECU_Address@VOUTP_S3L_enum@ */ /end MEASUREMENT
/begin MEASUREMENT VOUTP_S4L_enum "" UBYTE SWC_OUTP_type_CM_uint8_enum 0 0 0.0 5.0 ECU_ADDRESS 0x0000 /* @ECU_Address@VOUTP_S4L_enum@ */ /end MEASUREMENT
/begin MEASUREMENT VOUTP_RFP20_raw8 "" UBYTE SWC_OUTP_type_CM_uint8_raw8 0 0 0.0 255.0 ECU_ADDRESS 0x0000 /* @ECU_Address@VOUTP_RFP20_raw8@ */ /end MEASUREMENT
/begin MEASUREMENT VOUTP_RRP20_raw8 "" UBYTE SWC_OUTP_type_CM_uint8_raw8 0 0 0.0 255.0 ECU_ADDRESS 0x0000 /* @ECU_Address@VOUTP_RRP20_raw8@ */ /end MEASUREMENT
/begin MEASUREMENT VOUTP_RFPind_enum "" UBYTE SWC_OUTP_type_CM_uint8_enum 0 0 0.0 3.0 ECU_ADDRESS 0x0000 /* @ECU_Address@VOUTP_RFPind_enum@ */ /end MEASUREMENT
/begin MEASUREMENT VOUTP_RRPindi_enum "" UBYTE SWC_OUTP_type_CM_uint8_enum 0 0 0.0 3.0 ECU_ADDRESS 0x0000 /* @ECU_Address@VOUTP_RRPindi_enum@ */ /end MEASUREMENT
/begin MEASUREMENT VOUTP_unlearnSfailvalid_enum "" UBYTE SWC_OUTP_type_CM_uint8_enum 0 0 0.0 255.0 ECU_ADDRESS 0x0000 /* @ECU_Address@VOUTP_unlearnSfailvalid_enum@ */ /end MEASUREMENT
/begin MEASUREMENT VOUTP_WritingCnt_enum "" UBYTE SWC_OUTP_type_CM_uint8_enum 0 0 0.0 255.0 ECU_ADDRESS 0x0000 /* @ECU_Address@VOUTP_WritingCnt_enum@ */ /end MEASUREMENT
/begin MEASUREMENT VOUTP_VCUMCUCtrlMdTQD_enum "" UBYTE SWC_OUTP_type_CM_uint8_enum 0 0 0.0 15.0 ECU_ADDRESS 0x0000 /* @ECU_Address@VOUTP_VCUMCUCtrlMdTQD_enum@ */ /end MEASUREMENT
/begin MEASUREMENT VOUTP_VCUEBSHHSw_enum "" UBYTE SWC_OUTP_type_CM_uint8_enum 0 0 0.0 15.0 ECU_ADDRESS 0x0000 /* @ECU_Address@VOUTP_VCUEBSHHSw_enum@ */ /end MEASUREMENT
/begin MEASUREMENT VOUTP_VCUEBSRd4BR_enum "" UBYTE SWC_OUTP_type_CM_uint8_enum 0 0 0.0 15.0 ECU_ADDRESS 0x0000 /* @ECU_Address@VOUTP_VCUEBSRd4BR_enum@ */ /end MEASUREMENT
/begin MEASUREMENT VOUTP_VCUEBSHBSw_enum "" UBYTE SWC_OUTP_type_CM_uint8_enum 0 0 0.0 15.0 ECU_ADDRESS 0x0000 /* @ECU_Address@VOUTP_VCUEBSHBSw_enum@ */ /end MEASUREMENT
/begin MEASUREMENT VOUTP_VCUMCUGearSta_enum "" UBYTE SWC_OUTP_type_CM_uint8_enum 0 0 0.0 15.0 ECU_ADDRESS 0x0000 /* @ECU_Address@VOUTP_VCUMCUGearSta_enum@ */ /end MEASUREMENT
/begin MEASUREMENT VOUTP_TUpAIND_enum "" UBYTE SWC_OUTP_type_CM_uint8_enum 0 0 0.0 15.0 ECU_ADDRESS 0x0000 /* @ECU_Address@VOUTP_TUpAIND_enum@ */ /end MEASUREMENT
/begin MEASUREMENT VOUTP_ReqOBCV2LEna_enum "" UBYTE SWC_OUTP_type_CM_uint8_enum 0 0 0.0 255.0 ECU_ADDRESS 0x0000 /* @ECU_Address@VOUTP_ReqOBCV2LEna_enum@ */ /end MEASUREMENT
/begin MEASUREMENT VOUTP_ReqV2LIVIPopup_enum "" UBYTE SWC_OUTP_type_CM_uint8_enum 0 0 0.0 255.0 ECU_ADDRESS 0x0000 /* @ECU_Address@VOUTP_ReqV2LIVIPopup_enum@ */ /end MEASUREMENT
/begin MEASUREMENT VOUTP_ReqV2LIVIDisChrg_enum "" UBYTE SWC_OUTP_type_CM_uint8_enum 0 0 0.0 255.0 ECU_ADDRESS 0x0000 /* @ECU_Address@VOUTP_ReqV2LIVIDisChrg_enum@ */ /end MEASUREMENT
/begin MEASUREMENT VOUTP_ReqOBCExtrV2LEna_enum "" UBYTE SWC_OUTP_type_CM_uint8_enum 0 0 0.0 255.0 ECU_ADDRESS 0x0000 /* @ECU_Address@VOUTP_ReqOBCExtrV2LEna_enum@ */ /end MEASUREMENT
/begin MEASUREMENT VOUTP_ReqOBCIntrV2LEna_enum "" UBYTE SWC_OUTP_type_CM_uint8_enum 0 0 0.0 255.0 ECU_ADDRESS 0x0000 /* @ECU_Address@VOUTP_ReqOBCIntrV2LEna_enum@ */ /end MEASUREMENT
/begin MEASUREMENT VOUTP_TimeGapLevel_enum "" UBYTE SWC_OUTP_type_CM_uint8_enum 0 0 0.0 7.0 ECU_ADDRESS 0x0000 /* @ECU_Address@VOUTP_TimeGapLevel_enum@ */ /end MEASUREMENT
/begin MEASUREMENT VOUTP_TargetType_enum "" UBYTE SWC_OUTP_type_CM_uint8_enum 0 0 0.0 15.0 ECU_ADDRESS 0x0000 /* @ECU_Address@VOUTP_TargetType_enum@ */ /end MEASUREMENT
/begin MEASUREMENT VOUTP_VehSpeedTimeOut_flg "" UBYTE SWC_OUTP_type_CM_boolean_flg 0 0 0.0 1.0 ECU_ADDRESS 0x0000 /* @ECU_Address@VOUTP_VehSpeedTimeOut_flg@ */ /end MEASUREMENT
/begin MEASUREMENT VOUTP_USSStaRMR_flg "" UBYTE SWC_OUTP_type_CM_boolean_flg 0 0 0.0 1.0 ECU_ADDRESS 0x0000 /* @ECU_Address@VOUTP_USSStaRMR_flg@ */ /end MEASUREMENT
/begin MEASUREMENT VOUTP_USSStaRML_flg "" UBYTE SWC_OUTP_type_CM_boolean_flg 0 0 0.0 1.0 ECU_ADDRESS 0x0000 /* @ECU_Address@VOUTP_USSStaRML_flg@ */ /end MEASUREMENT
/begin MEASUREMENT VOUTP_USSStaRLR_flg "" UBYTE SWC_OUTP_type_CM_boolean_flg 0 0 0.0 1.0 ECU_ADDRESS 0x0000 /* @ECU_Address@VOUTP_USSStaRLR_flg@ */ /end MEASUREMENT
/begin MEASUREMENT VOUTP_USSStaRLL_flg "" UBYTE SWC_OUTP_type_CM_boolean_flg 0 0 0.0 1.0 ECU_ADDRESS 0x0000 /* @ECU_Address@VOUTP_USSStaRLL_flg@ */ /end MEASUREMENT
/begin MEASUREMENT VOUTP_USSStaRCR_flg "" UBYTE SWC_OUTP_type_CM_boolean_flg 0 0 0.0 1.0 ECU_ADDRESS 0x0000 /* @ECU_Address@VOUTP_USSStaRCR_flg@ */ /end MEASUREMENT
/begin MEASUREMENT VOUTP_USSStaRCL_flg "" UBYTE SWC_OUTP_type_CM_boolean_flg 0 0 0.0 1.0 ECU_ADDRESS 0x0000 /* @ECU_Address@VOUTP_USSStaRCL_flg@ */ /end MEASUREMENT
/begin MEASUREMENT VOUTP_USSStaFMR_flg "" UBYTE SWC_OUTP_type_CM_boolean_flg 0 0 0.0 1.0 ECU_ADDRESS 0x0000 /* @ECU_Address@VOUTP_USSStaFMR_flg@ */ /end MEASUREMENT
/begin MEASUREMENT VOUTP_USSStaFML_flg "" UBYTE SWC_OUTP_type_CM_boolean_flg 0 0 0.0 1.0 ECU_ADDRESS 0x0000 /* @ECU_Address@VOUTP_USSStaFML_flg@ */ /end MEASUREMENT
/begin MEASUREMENT VOUTP_USSStaFLR_flg "" UBYTE SWC_OUTP_type_CM_boolean_flg 0 0 0.0 1.0 ECU_ADDRESS 0x0000 /* @ECU_Address@VOUTP_USSStaFLR_flg@ */ /end MEASUREMENT
/begin MEASUREMENT VOUTP_USSStaFLL_flg "" UBYTE SWC_OUTP_type_CM_boolean_flg 0 0 0.0 1.0 ECU_ADDRESS 0x0000 /* @ECU_Address@VOUTP_USSStaFLL_flg@ */ /end MEASUREMENT
/begin MEASUREMENT VOUTP_USSStaFCR_flg "" UBYTE SWC_OUTP_type_CM_boolean_flg 0 0 0.0 1.0 ECU_ADDRESS 0x0000 /* @ECU_Address@VOUTP_USSStaFCR_flg@ */ /end MEASUREMENT
/begin MEASUREMENT VOUTP_USSStaFCL_flg "" UBYTE SWC_OUTP_type_CM_boolean_flg 0 0 0.0 1.0 ECU_ADDRESS 0x0000 /* @ECU_Address@VOUTP_USSStaFCL_flg@ */ /end MEASUREMENT
/begin MEASUREMENT VOUTP_StaFSya_flg "" UBYTE SWC_OUTP_type_CM_boolean_flg 0 0 0.0 1.0 ECU_ADDRESS 0x0000 /* @ECU_Address@VOUTP_StaFSya_flg@ */ /end MEASUREMENT
/begin MEASUREMENT VOUTP_RFRawWhlSpeedTimeOut_flg "" UBYTE SWC_OUTP_type_CM_boolean_flg 0 0 0.0 1.0 ECU_ADDRESS 0x0000 /* @ECU_Address@VOUTP_RFRawWhlSpeedTimeOut_flg@ */ /end MEASUREMENT
/begin MEASUREMENT VOUTP_RRRawWhlSpeedTimeOut_flg "" UBYTE SWC_OUTP_type_CM_boolean_flg 0 0 0.0 1.0 ECU_ADDRESS 0x0000 /* @ECU_Address@VOUTP_RRRawWhlSpeedTimeOut_flg@ */ /end MEASUREMENT
/begin MEASUREMENT VOUTP_RFRawWhlSpeedV_flg "" UBYTE SWC_OUTP_type_CM_boolean_flg 0 0 0.0 1.0 ECU_ADDRESS 0x0000 /* @ECU_Address@VOUTP_RFRawWhlSpeedV_flg@ */ /end MEASUREMENT
/begin MEASUREMENT VOUTP_RFRawWhlSpeedVTimeOut_flg "" UBYTE SWC_OUTP_type_CM_boolean_flg 0 0 0.0 1.0 ECU_ADDRESS 0x0000 /* @ECU_Address@VOUTP_RFRawWhlSpeedVTimeOut_flg@ */ /end MEASUREMENT
/begin MEASUREMENT VOUTP_RRRawWhlSpeedV_flg "" UBYTE SWC_OUTP_type_CM_boolean_flg 0 0 0.0 1.0 ECU_ADDRESS 0x0000 /* @ECU_Address@VOUTP_RRRawWhlSpeedV_flg@ */ /end MEASUREMENT
/begin MEASUREMENT VOUTP_RRRawWhlSpeedVTimeOut_flg "" UBYTE SWC_OUTP_type_CM_boolean_flg 0 0 0.0 1.0 ECU_ADDRESS 0x0000 /* @ECU_Address@VOUTP_RRRawWhlSpeedVTimeOut_flg@ */ /end MEASUREMENT
/begin MEASUREMENT VOUTP_RFWhlRotDirTimeOut_flg "" UBYTE SWC_OUTP_type_CM_boolean_flg 0 0 0.0 1.0 ECU_ADDRESS 0x0000 /* @ECU_Address@VOUTP_RFWhlRotDirTimeOut_flg@ */ /end MEASUREMENT
/begin MEASUREMENT VOUTP_RRWhlRotDirTimeOut_flg "" UBYTE SWC_OUTP_type_CM_boolean_flg 0 0 0.0 1.0 ECU_ADDRESS 0x0000 /* @ECU_Address@VOUTP_RRWhlRotDirTimeOut_flg@ */ /end MEASUREMENT
/begin MEASUREMENT VOUTP_RFPulseCountV_flg "" UBYTE SWC_OUTP_type_CM_boolean_flg 0 0 0.0 1.0 ECU_ADDRESS 0x0000 /* @ECU_Address@VOUTP_RFPulseCountV_flg@ */ /end MEASUREMENT
/begin MEASUREMENT VOUTP_RFPulseCountVTimeOut_flg "" UBYTE SWC_OUTP_type_CM_boolean_flg 0 0 0.0 1.0 ECU_ADDRESS 0x0000 /* @ECU_Address@VOUTP_RFPulseCountVTimeOut_flg@ */ /end MEASUREMENT
/begin MEASUREMENT VOUTP_RRPulseCountV_flg "" UBYTE SWC_OUTP_type_CM_boolean_flg 0 0 0.0 1.0 ECU_ADDRESS 0x0000 /* @ECU_Address@VOUTP_RRPulseCountV_flg@ */ /end MEASUREMENT
/begin MEASUREMENT VOUTP_RRPulseCountVTimeOut_flg "" UBYTE SWC_OUTP_type_CM_boolean_flg 0 0 0.0 1.0 ECU_ADDRESS 0x0000 /* @ECU_Address@VOUTP_RRPulseCountVTimeOut_flg@ */ /end MEASUREMENT
/begin MEASUREMENT VOUTP_RFPulseCountTimeOut_flg "" UBYTE SWC_OUTP_type_CM_boolean_flg 0 0 0.0 1.0 ECU_ADDRESS 0x0000 /* @ECU_Address@VOUTP_RFPulseCountTimeOut_flg@ */ /end MEASUREMENT
/begin MEASUREMENT VOUTP_RRPulseCountTimeOut_flg "" UBYTE SWC_OUTP_type_CM_boolean_flg 0 0 0.0 1.0 ECU_ADDRESS 0x0000 /* @ECU_Address@VOUTP_RRPulseCountTimeOut_flg@ */ /end MEASUREMENT
/begin MEASUREMENT VOUTP_ShifterHandleCmdTimeOut_flg "" UBYTE SWC_OUTP_type_CM_boolean_flg 0 0 0.0 1.0 ECU_ADDRESS 0x0000 /* @ECU_Address@VOUTP_ShifterHandleCmdTimeOut_flg@ */ /end MEASUREMENT
/begin MEASUREMENT VOUTP_SASAngleTimeOut_flg "" UBYTE SWC_OUTP_type_CM_boolean_flg 0 0 0.0 1.0 ECU_ADDRESS 0x0000 /* @ECU_Address@VOUTP_SASAngleTimeOut_flg@ */ /end MEASUREMENT
/begin MEASUREMENT VOUTP_SASSpeedTimeOut_flg "" UBYTE SWC_OUTP_type_CM_boolean_flg 0 0 0.0 1.0 ECU_ADDRESS 0x0000 /* @ECU_Address@VOUTP_SASSpeedTimeOut_flg@ */ /end MEASUREMENT
/begin MEASUREMENT VOUTP_SASSpeedValid_flg "" UBYTE SWC_OUTP_type_CM_boolean_flg 0 0 0.0 1.0 ECU_ADDRESS 0x0000 /* @ECU_Address@VOUTP_SASSpeedValid_flg@ */ /end MEASUREMENT
/begin MEASUREMENT VOUTP_SASSpeedValidTimeOut_flg "" UBYTE SWC_OUTP_type_CM_boolean_flg 0 0 0.0 1.0 ECU_ADDRESS 0x0000 /* @ECU_Address@VOUTP_SASSpeedValidTimeOut_flg@ */ /end MEASUREMENT
/begin MEASUREMENT VOUTP_SASCAL_flg "" UBYTE SWC_OUTP_type_CM_boolean_flg 0 0 0.0 1.0 ECU_ADDRESS 0x0000 /* @ECU_Address@VOUTP_SASCAL_flg@ */ /end MEASUREMENT
/begin MEASUREMENT VOUTP_SASCALTimeOut_flg "" UBYTE SWC_OUTP_type_CM_boolean_flg 0 0 0.0 1.0 ECU_ADDRESS 0x0000 /* @ECU_Address@VOUTP_SASCALTimeOut_flg@ */ /end MEASUREMENT
/begin MEASUREMENT VOUTP_SASV_flg "" UBYTE SWC_OUTP_type_CM_boolean_flg 0 0 0.0 1.0 ECU_ADDRESS 0x0000 /* @ECU_Address@VOUTP_SASV_flg@ */ /end MEASUREMENT
/begin MEASUREMENT VOUTP_SASVTimeOut_flg "" UBYTE SWC_OUTP_type_CM_boolean_flg 0 0 0.0 1.0 ECU_ADDRESS 0x0000 /* @ECU_Address@VOUTP_SASVTimeOut_flg@ */ /end MEASUREMENT
/begin MEASUREMENT VOUTP_YawRateTimeOut_flg "" UBYTE SWC_OUTP_type_CM_boolean_flg 0 0 0.0 1.0 ECU_ADDRESS 0x0000 /* @ECU_Address@VOUTP_YawRateTimeOut_flg@ */ /end MEASUREMENT
/begin MEASUREMENT VOUTP_YawRateV_flg "" UBYTE SWC_OUTP_type_CM_boolean_flg 0 0 0.0 1.0 ECU_ADDRESS 0x0000 /* @ECU_Address@VOUTP_YawRateV_flg@ */ /end MEASUREMENT
/begin MEASUREMENT VOUTP_YawRateVTimeOut_flg "" UBYTE SWC_OUTP_type_CM_boolean_flg 0 0 0.0 1.0 ECU_ADDRESS 0x0000 /* @ECU_Address@VOUTP_YawRateVTimeOut_flg@ */ /end MEASUREMENT
/begin MEASUREMENT VOUTP_TCSActive_flg "" UBYTE SWC_OUTP_type_CM_boolean_flg 0 0 0.0 1.0 ECU_ADDRESS 0x0000 /* @ECU_Address@VOUTP_TCSActive_flg@ */ /end MEASUREMENT
/begin MEASUREMENT VOUTP_TCSActiveTimeOut_flg "" UBYTE SWC_OUTP_type_CM_boolean_flg 0 0 0.0 1.0 ECU_ADDRESS 0x0000 /* @ECU_Address@VOUTP_TCSActiveTimeOut_flg@ */ /end MEASUREMENT
/begin MEASUREMENT VOUTP_WakeUp_flg "" UBYTE SWC_OUTP_type_CM_boolean_flg 0 0 0.0 1.0 ECU_ADDRESS 0x0000 /* @ECU_Address@VOUTP_WakeUp_flg@ */ /end MEASUREMENT
/begin MEASUREMENT VOUTP_VCURAPSErrLv2_flg "" UBYTE SWC_OUTP_type_CM_boolean_flg 0 0 0.0 1.0 ECU_ADDRESS 0x0000 /* @ECU_Address@VOUTP_VCURAPSErrLv2_flg@ */ /end MEASUREMENT
/begin MEASUREMENT VOUTP_VCURAPSErrLv3_flg "" UBYTE SWC_OUTP_type_CM_boolean_flg 0 0 0.0 1.0 ECU_ADDRESS 0x0000 /* @ECU_Address@VOUTP_VCURAPSErrLv3_flg@ */ /end MEASUREMENT
/begin MEASUREMENT VOUTP_VCUFLDoorSta_flg "" UBYTE SWC_OUTP_type_CM_boolean_flg 0 0 0.0 1.0 ECU_ADDRESS 0x0000 /* @ECU_Address@VOUTP_VCUFLDoorSta_flg@ */ /end MEASUREMENT
/begin MEASUREMENT VOUTP_VCUFRDoorSta_flg "" UBYTE SWC_OUTP_type_CM_boolean_flg 0 0 0.0 1.0 ECU_ADDRESS 0x0000 /* @ECU_Address@VOUTP_VCUFRDoorSta_flg@ */ /end MEASUREMENT
/begin MEASUREMENT VOUTP_VCURLDoorSta_flg "" UBYTE SWC_OUTP_type_CM_boolean_flg 0 0 0.0 1.0 ECU_ADDRESS 0x0000 /* @ECU_Address@VOUTP_VCURLDoorSta_flg@ */ /end MEASUREMENT
/begin MEASUREMENT VOUTP_VCURRDoorSta_flg "" UBYTE SWC_OUTP_type_CM_boolean_flg 0 0 0.0 1.0 ECU_ADDRESS 0x0000 /* @ECU_Address@VOUTP_VCURRDoorSta_flg@ */ /end MEASUREMENT
/begin MEASUREMENT VOUTP_SysAllowReadySta_flg "" UBYTE SWC_OUTP_type_CM_boolean_flg 0 0 0.0 1.0 ECU_ADDRESS 0x0000 /* @ECU_Address@VOUTP_SysAllowReadySta_flg@ */ /end MEASUREMENT
/begin MEASUREMENT VOUTP_VCUHoodSWSta_flg "" UBYTE SWC_OUTP_type_CM_boolean_flg 0 0 0.0 1.0 ECU_ADDRESS 0x0000 /* @ECU_Address@VOUTP_VCUHoodSWSta_flg@ */ /end MEASUREMENT
/begin MEASUREMENT VOUTP_VCUTailgateSWSta_flg "" UBYTE SWC_OUTP_type_CM_boolean_flg 0 0 0.0 1.0 ECU_ADDRESS 0x0000 /* @ECU_Address@VOUTP_VCUTailgateSWSta_flg@ */ /end MEASUREMENT
/begin MEASUREMENT VOUTP_ResetPedalZeroPosStart_flg "" UBYTE SWC_OUTP_type_CM_boolean_flg 0 0 0.0 1.0 ECU_ADDRESS 0x0000 /* @ECU_Address@VOUTP_ResetPedalZeroPosStart_flg@ */ /end MEASUREMENT
/begin MEASUREMENT VOUTP_RptMsgReq_flg "" UBYTE SWC_OUTP_type_CM_boolean_flg 0 0 0.0 1.0 ECU_ADDRESS 0x0000 /* @ECU_Address@VOUTP_RptMsgReq_flg@ */ /end MEASUREMENT
/begin MEASUREMENT VOUTP_VCUMCUEn_flg "" UBYTE SWC_OUTP_type_CM_boolean_flg 0 0 0.0 1.0 ECU_ADDRESS 0x0000 /* @ECU_Address@VOUTP_VCUMCUEn_flg@ */ /end MEASUREMENT
/begin MEASUREMENT VOUTP_VCUMCUFailRst_flg "" UBYTE SWC_OUTP_type_CM_boolean_flg 0 0 0.0 1.0 ECU_ADDRESS 0x0000 /* @ECU_Address@VOUTP_VCUMCUFailRst_flg@ */ /end MEASUREMENT
/begin MEASUREMENT VOUTP_VSPReversed_flg "" UBYTE SWC_OUTP_type_CM_boolean_flg 0 0 0.0 1.0 ECU_ADDRESS 0x0000 /* @ECU_Address@VOUTP_VSPReversed_flg@ */ /end MEASUREMENT
/begin MEASUREMENT VOUTP_triggerBAM_flg "" UBYTE SWC_OUTP_type_CM_boolean_flg 0 0 0.0 1.0 ECU_ADDRESS 0x0000 /* @ECU_Address@VOUTP_triggerBAM_flg@ */ /end MEASUREMENT
/begin MEASUREMENT VOUTP_triggerDT_flg "" UBYTE SWC_OUTP_type_CM_boolean_flg 0 0 0.0 1.0 ECU_ADDRESS 0x0000 /* @ECU_Address@VOUTP_triggerDT_flg@ */ /end MEASUREMENT
/begin MEASUREMENT VOUTP_RRBatWarn_flg "" UBYTE SWC_OUTP_type_CM_boolean_flg 0 0 0.0 1.0 ECU_ADDRESS 0x0000 /* @ECU_Address@VOUTP_RRBatWarn_flg@ */ /end MEASUREMENT
/begin MEASUREMENT VOUTP_RFSensorFail_flg "" UBYTE SWC_OUTP_type_CM_boolean_flg 0 0 0.0 1.0 ECU_ADDRESS 0x0000 /* @ECU_Address@VOUTP_RFSensorFail_flg@ */ /end MEASUREMENT
/begin MEASUREMENT VOUTP_RRSensorFail_flg "" UBYTE SWC_OUTP_type_CM_boolean_flg 0 0 0.0 1.0 ECU_ADDRESS 0x0000 /* @ECU_Address@VOUTP_RRSensorFail_flg@ */ /end MEASUREMENT
/begin MEASUREMENT VOUTP_RFWheelDebug_flg "" UBYTE SWC_OUTP_type_CM_boolean_flg 0 0 0.0 1.0 ECU_ADDRESS 0x0000 /* @ECU_Address@VOUTP_RFWheelDebug_flg@ */ /end MEASUREMENT
/begin MEASUREMENT VOUTP_RRWheelDebug_flg "" UBYTE SWC_OUTP_type_CM_boolean_flg 0 0 0.0 1.0 ECU_ADDRESS 0x0000 /* @ECU_Address@VOUTP_RRWheelDebug_flg@ */ /end MEASUREMENT
/begin MEASUREMENT VOUTP_TPMSResButtAllow_flg "" UBYTE SWC_OUTP_type_CM_boolean_flg 0 0 0.0 1.0 ECU_ADDRESS 0x0000 /* @ECU_Address@VOUTP_TPMSResButtAllow_flg@ */ /end MEASUREMENT
/begin MEASUREMENT VOUTP_TPMSCaliButtAllow_flg "" UBYTE SWC_OUTP_type_CM_boolean_flg 0 0 0.0 1.0 ECU_ADDRESS 0x0000 /* @ECU_Address@VOUTP_TPMSCaliButtAllow_flg@ */ /end MEASUREMENT
/begin MEASUREMENT VOUTP_RFWheelTmpIndi_flg "" UBYTE SWC_OUTP_type_CM_boolean_flg 0 0 0.0 1.0 ECU_ADDRESS 0x0000 /* @ECU_Address@VOUTP_RFWheelTmpIndi_flg@ */ /end MEASUREMENT
/begin MEASUREMENT VOUTP_RRWheelTmpIndi_flg "" UBYTE SWC_OUTP_type_CM_boolean_flg 0 0 0.0 1.0 ECU_ADDRESS 0x0000 /* @ECU_Address@VOUTP_RRWheelTmpIndi_flg@ */ /end MEASUREMENT
/begin MEASUREMENT VOUTP_RFSensorMode_flg "" UBYTE SWC_OUTP_type_CM_boolean_flg 0 0 0.0 1.0 ECU_ADDRESS 0x0000 /* @ECU_Address@VOUTP_RFSensorMode_flg@ */ /end MEASUREMENT
/begin MEASUREMENT VOUTP_RRSensorMode_flg "" UBYTE SWC_OUTP_type_CM_boolean_flg 0 0 0.0 1.0 ECU_ADDRESS 0x0000 /* @ECU_Address@VOUTP_RRSensorMode_flg@ */ /end MEASUREMENT
/begin MEASUREMENT VOUTP_SetIDLoc_flg "" UBYTE SWC_OUTP_type_CM_boolean_flg 0 0 0.0 1.0 ECU_ADDRESS 0x0000 /* @ECU_Address@VOUTP_SetIDLoc_flg@ */ /end MEASUREMENT
/begin MEASUREMENT VOUTP_TPMSStorge_flg "" UBYTE SWC_OUTP_type_CM_boolean_flg 0 0 0.0 1.0 ECU_ADDRESS 0x0000 /* @ECU_Address@VOUTP_TPMSStorge_flg@ */ /end MEASUREMENT
/begin MEASUREMENT VOUTP_TPMSResButt_flg "" UBYTE SWC_OUTP_type_CM_boolean_flg 0 0 0.0 1.0 ECU_ADDRESS 0x0000 /* @ECU_Address@VOUTP_TPMSResButt_flg@ */ /end MEASUREMENT
/begin MEASUREMENT VOUTP_unlearnSfali_flg "" UBYTE SWC_OUTP_type_CM_boolean_flg 0 0 0.0 1.0 ECU_ADDRESS 0x0000 /* @ECU_Address@VOUTP_unlearnSfali_flg@ */ /end MEASUREMENT
/begin MEASUREMENT VOUTP_TPMSTLCmd_flg "" UBYTE SWC_OUTP_type_CM_boolean_flg 0 0 0.0 1.0 ECU_ADDRESS 0x0000 /* @ECU_Address@VOUTP_TPMSTLCmd_flg@ */ /end MEASUREMENT
/begin MEASUREMENT VOUTP_TPMSSensorIDRegStart_flg "" UBYTE SWC_OUTP_type_CM_boolean_flg 0 0 0.0 1.0 ECU_ADDRESS 0x0000 /* @ECU_Address@VOUTP_TPMSSensorIDRegStart_flg@ */ /end MEASUREMENT
/begin MEASUREMENT VOUTP_VCU4PweLmtInd_flg "" UBYTE SWC_OUTP_type_CM_boolean_flg 0 0 0.0 1.0 ECU_ADDRESS 0x0000 /* @ECU_Address@VOUTP_VCU4PweLmtInd_flg@ */ /end MEASUREMENT
/begin MEASUREMENT VOUTP_SpdLimSta_flg "" UBYTE SWC_OUTP_type_CM_boolean_flg 0 0 0.0 1.0 ECU_ADDRESS 0x0000 /* @ECU_Address@VOUTP_SpdLimSta_flg@ */ /end MEASUREMENT
/begin MEASUREMENT VOUTP_VCUBCMBuzzReq_flg "" UBYTE SWC_OUTP_type_CM_boolean_flg 0 0 0.0 1.0 ECU_ADDRESS 0x0000 /* @ECU_Address@VOUTP_VCUBCMBuzzReq_flg@ */ /end MEASUREMENT
/begin MEASUREMENT VOUTP_VCUMCUHandBrk_flg "" UBYTE SWC_OUTP_type_CM_boolean_flg 0 0 0.0 1.0 ECU_ADDRESS 0x0000 /* @ECU_Address@VOUTP_VCUMCUHandBrk_flg@ */ /end MEASUREMENT
/begin MEASUREMENT VOUTP_VCUMCUFootBrk_flg "" UBYTE SWC_OUTP_type_CM_boolean_flg 0 0 0.0 1.0 ECU_ADDRESS 0x0000 /* @ECU_Address@VOUTP_VCUMCUFootBrk_flg@ */ /end MEASUREMENT
/begin MEASUREMENT VOUTP_VMCAEBCtrlAvail_flg "" UBYTE SWC_OUTP_type_CM_boolean_flg 0 0 0.0 1.0 ECU_ADDRESS 0x0000 /* @ECU_Address@VOUTP_VMCAEBCtrlAvail_flg@ */ /end MEASUREMENT
/begin MEASUREMENT VOUTP_VMCACCCtrlAvail_flg "" UBYTE SWC_OUTP_type_CM_boolean_flg 0 0 0.0 1.0 ECU_ADDRESS 0x0000 /* @ECU_Address@VOUTP_VMCACCCtrlAvail_flg@ */ /end MEASUREMENT
/begin MEASUREMENT VOUTP_VMCCCCtrlAvail_flg "" UBYTE SWC_OUTP_type_CM_boolean_flg 0 0 0.0 1.0 ECU_ADDRESS 0x0000 /* @ECU_Address@VOUTP_VMCCCCtrlAvail_flg@ */ /end MEASUREMENT
/begin MEASUREMENT VOUTP_VMCMSACtrlAvail_flg "" UBYTE SWC_OUTP_type_CM_boolean_flg 0 0 0.0 1.0 ECU_ADDRESS 0x0000 /* @ECU_Address@VOUTP_VMCMSACtrlAvail_flg@ */ /end MEASUREMENT
/begin MEASUREMENT VOUTP_RearWhlSlipRatioCtrl_flg "" UBYTE SWC_OUTP_type_CM_boolean_flg 0 0 0.0 1.0 ECU_ADDRESS 0x0000 /* @ECU_Address@VOUTP_RearWhlSlipRatioCtrl_flg@ */ /end MEASUREMENT
/begin MEASUREMENT VOUTP_SingleWhlSlipRatioCtrl_flg "" UBYTE SWC_OUTP_type_CM_boolean_flg 0 0 0.0 1.0 ECU_ADDRESS 0x0000 /* @ECU_Address@VOUTP_SingleWhlSlipRatioCtrl_flg@ */ /end MEASUREMENT
/begin MEASUREMENT VOUTP_SafetyCtrl_flg "" UBYTE SWC_OUTP_type_CM_boolean_flg 0 0 0.0 1.0 ECU_ADDRESS 0x0000 /* @ECU_Address@VOUTP_SafetyCtrl_flg@ */ /end MEASUREMENT
/begin MEASUREMENT VOUTP_SPD2ACCAct_flg "" UBYTE SWC_OUTP_type_CM_boolean_flg 0 0 0.0 1.0 ECU_ADDRESS 0x0000 /* @ECU_Address@VOUTP_SPD2ACCAct_flg@ */ /end MEASUREMENT
/begin MEASUREMENT VOUTP_RightTurnLightReq_flg "" UBYTE SWC_OUTP_type_CM_boolean_flg 0 0 0.0 1.0 ECU_ADDRESS 0x0000 /* @ECU_Address@VOUTP_RightTurnLightReq_flg@ */ /end MEASUREMENT
/begin COMPU_METHOD SWC_OUTP_type_CM_single_mps2 "Q = V" RAT_FUNC "%8.6" "mps2" COEFFS 0 1 0 0 0 1 /end COMPU_METHOD
/begin COMPU_METHOD SWC_OUTP_type_CM_single_pct "Q = V" RAT_FUNC "%8.6" "pct" COEFFS 0 1 0 0 0 1 /end COMPU_METHOD
/begin COMPU_METHOD SWC_OUTP_type_CM_single_Deg "Q = V" RAT_FUNC "%8.6" "Deg" COEFFS 0 1 0 0 0 1 /end COMPU_METHOD
/begin COMPU_METHOD SWC_OUTP_type_CM_single_kph "Q = V" RAT_FUNC "%8.6" "kph" COEFFS 0 1 0 0 0 1 /end COMPU_METHOD
/begin COMPU_METHOD SWC_OUTP_type_CM_single_C "Q = V" RAT_FUNC "%8.6" "C" COEFFS 0 1 0 0 0 1 /end COMPU_METHOD
/begin COMPU_METHOD SWC_OUTP_type_CM_single_km "Q = V" RAT_FUNC "%8.6" "km" COEFFS 0 1 0 0 0 1 /end COMPU_METHOD
/begin COMPU_METHOD SWC_OUTP_type_CM_single_rpm "Q = V" RAT_FUNC "%8.6" "rpm" COEFFS 0 1 0 0 0 1 /end COMPU_METHOD
/begin COMPU_METHOD SWC_OUTP_type_CM_single_s "Q = V" RAT_FUNC "%8.6" "s" COEFFS 0 1 0 0 0 1 /end COMPU_METHOD
/begin COMPU_METHOD SWC_OUTP_type_CM_single_Nm "Q = V" RAT_FUNC "%8.6" "Nm" COEFFS 0 1 0 0 0 1 /end COMPU_METHOD
/begin COMPU_METHOD SWC_OUTP_type_CM_single_kWh "Q = V" RAT_FUNC "%8.6" "kWh" COEFFS 0 1 0 0 0 1 /end COMPU_METHOD
/begin COMPU_METHOD SWC_OUTP_type_CM_single_Ahr "Q = V" RAT_FUNC "%8.6" "Ahr" COEFFS 0 1 0 0 0 1 /end COMPU_METHOD
/begin COMPU_METHOD SWC_OUTP_type_CM_single_degps "Q = V" RAT_FUNC "%8.6" "degps" COEFFS 0 1 0 0 0 1 /end COMPU_METHOD
/begin COMPU_METHOD SWC_OUTP_type_CM_single_mph "Q = V" RAT_FUNC "%8.6" "mph" COEFFS 0 1 0 0 0 1 /end COMPU_METHOD
/begin COMPU_METHOD SWC_OUTP_type_CM_uint32_raw32 "Q = V" RAT_FUNC "%10.0" "raw32" COEFFS 0 1 0 0 0 1 /end COMPU_METHOD
/begin COMPU_METHOD SWC_OUTP_type_CM_uint32_raw "Q = V" RAT_FUNC "%10.0" "raw" COEFFS 0 1 0 0 0 1 /end COMPU_METHOD
/begin COMPU_METHOD SWC_OUTP_type_CM_uint32_cnt "Q = V" RAT_FUNC "%10.0" "cnt" COEFFS 0 1 0 0 0 1 /end COMPU_METHOD
/begin COMPU_METHOD SWC_OUTP_type_CM_uint16_s "Q = V" RAT_FUNC "%5.0" "s" COEFFS 0 1 0 0 0 1 /end COMPU_METHOD
/begin COMPU_METHOD SWC_OUTP_type_CM_boolean_flg "Q = V" RAT_FUNC "%1.0" "flg" COEFFS 0 1 0 0 0 1 /end COMPU_METHOD
/begin COMPU_METHOD SWC_OUTP_type_CM_uint8_enum "Q = V" RAT_FUNC "%3.0" "enum" COEFFS 0 1 0 0 0 1 /end COMPU_METHOD
/begin COMPU_METHOD SWC_OUTP_type_CM_uint8_cnt "Q = V" RAT_FUNC "%3.0" "cnt" COEFFS 0 1 0 0 0 1 /end COMPU_METHOD
/begin COMPU_METHOD SWC_OUTP_type_CM_uint8_raw8 "Q = V" RAT_FUNC "%3.0" "raw8" COEFFS 0 1 0 0 0 1 /end COMPU_METHOD
/begin COMPU_METHOD SWC_OUTP_type_CM_uint8 "Q = V" RAT_FUNC "%3.0" "" COEFFS 0 1 0 0 0 1 /end COMPU_METHOD
/begin GROUP S3_outpmodule "SWC_OUTP_type/run_SWC_OUTP_5ms_sys/OUTP/outpmodule"
 /begin REF_MEASUREMENT VOUTP_RFBatwarnDTC_raw32 VOUTP_RFP20_raw8 VOUTP_RFPind_enum VOUTP_RFPressIndiDTC_raw32 VOUTP_RFPressIndi_enum VOUTP_RFPulseCountTimeOut_flg VOUTP_RFPulseCountVTimeOut_flg VOUTP_RFPulseCountV_flg VOUTP_RFPulseCount_enum VOUTP_RFRawWhlSpeedTimeOut_flg VOUTP_RFRawWhlSpeedVTimeOut_flg VOUTP_RFRawWhlSpeedV_flg VOUTP_RFRawWhlSpeed_kph VOUTP_RFSensorFailDTC_raw32 VOUTP_RFSensorFail_flg VOUTP_RFSensorMode_flg VOUTP_RFWheelDebug_flg VOUTP_RFWheelPSW_raw8 VOUTP_RFWheelPress_raw8 VOUTP_RFWheelTemp_C VOUTP_RFWheelTmpHighDTC_raw32 VOUTP_RFWheelTmpIndi_flg VOUTP_RFWhlRotDirTimeOut_flg VOUTP_RFWhlRotDir_enum VOUTP_RLDoorSWDTC_raw32 VOUTP_RLLUSSDTC_raw32 VOUTP_RLRUSSDTC_raw32 VOUTP_RMLUSSDTC_raw32 VOUTP_RMRUSSDTC_raw32 VOUTP_RRBatWarn_flg VOUTP_RRBatwarnDTC_raw32 VOUTP_RRDoorSWDTC_raw32 VOUTP_RRP20_raw8 VOUTP_RRPindi_enum VOUTP_RRPressIndiDTC_raw32 VOUTP_RRPressIndi_enum VOUTP_RRPulseCountTimeOut_flg VOUTP_RRPulseCountVTimeOut_flg VOUTP_RRPulseCountV_flg VOUTP_RRPulseCount_enum VOUTP_RRRawWhlSpeedTimeOut_flg VOUTP_RRRawWhlSpeedVTimeOut_flg VOUTP_RRRawWhlSpeedV_flg VOUTP_RRRawWhlSpeed_kph VOUTP_RRSensorFailDTC_raw32 VOUTP_RRSensorFail_flg VOUTP_RRSensorMode_flg VOUTP_RRWheelDebug_flg VOUTP_RRWheelPSW_raw8 VOUTP_RRWheelPress_raw8 VOUTP_RRWheelTemp_C VOUTP_RRWheelTmpHighDTC_raw32 VOUTP_RRWheelTmpIndi_flg VOUTP_RRWhlRotDirTimeOut_flg VOUTP_RRWhlRotDir_enum VOUTP_RUNTM_s VOUTP_RearWhlSlipRatioCtrl_flg VOUTP_ReqOBCExtrV2LEna_enum VOUTP_ReqOBCIntrV2LEna_enum VOUTP_ReqOBCV2LEna_enum VOUTP_ReqV2LIVIDisChrg_enum VOUTP_ReqV2LIVIPopup_enum VOUTP_ResetCDEODTR_km VOUTP_ResetPedalZeroPosStart_flg VOUTP_RightTurnLightReq_flg VOUTP_RptMsgReq_flg VOUTP_RrMCUSigErrDetDTC_raw32 VOUTP_RrMCUTqErrDTC_raw32 VOUTP_RrTMTqReq_Nm VOUTP_S1ID_raw32 VOUTP_S1L_enum VOUTP_S1WheelDebugALTU_pct VOUTP_S2ID_raw32 VOUTP_S2L_enum VOUTP_S2WheelDebugALTU_pct VOUTP_S3ID_raw32 VOUTP_S3L_enum VOUTP_S3WheelDebugALTU_pct VOUTP_S4ID_raw32 VOUTP_S4L_enum VOUTP_S4WheelDebugALTU_pct VOUTP_SASAngleTimeOut_flg VOUTP_SASAngle_Deg VOUTP_SASCALTimeOut_flg VOUTP_SASCAL_flg VOUTP_SASSpeedTimeOut_flg VOUTP_SASSpeedValidTimeOut_flg VOUTP_SASSpeedValid_flg VOUTP_SASSpeed_degps VOUTP_SASVTimeOut_flg VOUTP_SASV_flg VOUTP_SHA1_cnt VOUTP_SHA2_cnt VOUTP_SHA3_cnt VOUTP_SHA4_cnt VOUTP_SHA5_cnt VOUTP_SHA6_cnt VOUTP_SHA7_cnt VOUTP_SHA8_cnt VOUTP_SNSRLayout_enum VOUTP_SPD2ACCAct_flg VOUTP_STASUP_enum VOUTP_SafetyCtrl_flg VOUTP_SetIDLoc_flg VOUTP_Shifter1CSErrDTC_raw32 VOUTP_Shifter1NoComDTC_raw32 VOUTP_Shifter1RCErrDTC_raw32 VOUTP_ShifterHandleCmdTimeOut_flg VOUTP_ShifterHandleCmd_enum VOUTP_SingleWhlSlipRatioCtrl_flg VOUTP_SpdLimSta_flg VOUTP_StaFSya_flg VOUTP_SysAllowReadySta_flg VOUTP_SysNMmSta_enum VOUTP_SysPowerMode_enum VOUTP_TCSActiveTimeOut_flg VOUTP_TCSActive_flg VOUTP_TEBPSAL_kWh VOUTP_TEBPSAR_kWh VOUTP_TGEOVCL_kWh VOUTP_TGEOVCR_kWh VOUTP_TMTqReq_Nm VOUTP_TNBCPSAL_Ahr VOUTP_TNBCPSAR_Ahr VOUTP_TNECPSAL_kWh VOUTP_TNECPSAR_kWh VOUTP_TPMSCaliButtAllow_flg VOUTP_TPMSResButtAllow_flg VOUTP_TPMSResButt_flg VOUTP_TPMSSensorIDRegStart_flg VOUTP_TPMSStorge_flg VOUTP_TPMSTLCmd_flg VOUTP_TPMSWarnIndi_enum VOUTP_TUpAIND_enum VOUTP_TailgaSWDTC_raw32 VOUTP_TargetType_enum VOUTP_TimeGapCalcu_s VOUTP_TimeGapLevel_enum VOUTP_TimeSNDKCFbk_cnt VOUTP_TurnLpPatternSta_enum VOUTP_UIDLowPowerSta_enum VOUTP_USSStaFCL_flg VOUTP_USSStaFCR_flg VOUTP_USSStaFLL_flg VOUTP_USSStaFLR_flg VOUTP_USSStaFML_flg VOUTP_USSStaFMR_flg VOUTP_USSStaRCL_flg VOUTP_USSStaRCR_flg VOUTP_USSStaRLL_flg VOUTP_USSStaRLR_flg VOUTP_USSStaRML_flg VOUTP_USSStaRMR_flg VOUTP_V2BACPosRlyFit_enum VOUTP_V2BACPosRlySta_enum VOUTP_V2BAirPosRlyFit_enum VOUTP_V2BAirPosRlySta_enum VOUTP_V2BAux1OnOff_enum VOUTP_V2BAux1RlyFit_enum VOUTP_V2BAux1RlySta_enum VOUTP_V2BAux2OnOff_enum VOUTP_V2BAux2RlyFit_enum VOUTP_V2BAux2RlySta_enum VOUTP_V2BAux3OnOff_enum VOUTP_V2BAux3RlyFit_enum VOUTP_V2BAux3RlySta_enum VOUTP_V2BAux4RlyFit_enum VOUTP_V2BAux4RlySta_enum VOUTP_V2BDCDCPosRlyFit_enum VOUTP_V2BDCDCPosRlySta_enum VOUTP_V2BLifeSig_cnt VOUTP_V2BMainPosRlyFit_enum VOUTP_V2BMainPosRlySta_enum VOUTP_V2BOilPosRlyFit_enum VOUTP_V2BOilPosRlySta_enum VOUTP_VCU4PweLmtInd_flg VOUTP_VCUBCMBuzzReq_flg VOUTP_VCUBrkSWSta_enum VOUTP_VCUEBSHBSw_enum VOUTP_VCUEBSHHSw_enum VOUTP_VCUEBSRd4BR_enum VOUTP_VCUFLDoorSta_flg VOUTP_VCUFRDoorSta_flg VOUTP_VCUHoodSWSta_flg VOUTP_VCULife1_cnt VOUTP_VCULife2_cnt VOUTP_VCUMCUCtrlMdTQD_enum VOUTP_VCUMCUDemHiPosVal_rpm VOUTP_VCUMCUDemLoNegVal_rpm VOUTP_VCUMCUDemSpd_rpm VOUTP_VCUMCUEn_flg VOUTP_VCUMCUFailRst_flg VOUTP_VCUMCUFootBrk_flg VOUTP_VCUMCUGearSta_enum VOUTP_VCUMCUHandBrk_flg VOUTP_VCURAPSErrLv2_flg VOUTP_VCURAPSErrLv3_flg VOUTP_VCURLDoorSta_flg VOUTP_VCURRDoorSta_flg VOUTP_VCUTMVehSpd_kph VOUTP_VCUTailgateSWSta_flg VOUTP_VMCACCCtrlAvail_flg VOUTP_VMCAEBCtrlAvail_flg VOUTP_VMCCCCtrlAvail_flg VOUTP_VMCMSACtrlAvail_flg VOUTP_VSPFunc_enum VOUTP_VSPIGNKeySta_enum VOUTP_VSPReversed_flg VOUTP_VSPTurnLeft_enum VOUTP_VSPTurnRight_enum VOUTP_VSS_kph VOUTP_Variation_cnt VOUTP_VehAcclLimitTG_mps2 VOUTP_VehMalfunLevel_enum VOUTP_VehSpdLimitTG_kph VOUTP_VehSpeedTimeOut_flg VOUTP_VehSpeed_kph VOUTP_VehicleSpeed_kph VOUTP_VehicleSpeed_mph VOUTP_VinCode_cnt VOUTP_WARMUPS_cnt VOUTP_WakeUp_enum VOUTP_WakeUp_flg VOUTP_WisrBootReason_raw32 VOUTP_WriteChkLFID_raw VOUTP_WriteChkLRID_raw VOUTP_WriteChkRFID_raw VOUTP_WriteChkRRID_raw VOUTP_WriteChkfinLFID_raw VOUTP_WriteChkfinLRID_raw VOUTP_WriteChkfinRFID_raw VOUTP_WriteChkfinRRID_raw VOUTP_WritingCnt_enum VOUTP_YawRateTimeOut_flg VOUTP_YawRateVTimeOut_flg VOUTP_YawRateV_flg VOUTP_YawRate_degps VOUTP_ZoneSCPNoComDTC_raw32 VOUTP_triggerBAM_flg VOUTP_triggerDT_flg VOUTP_unlearnSfailvalid_enum VOUTP_unlearnSfali_flg /end REF_MEASUREMENT
/end GROUP
/begin GROUP S5_VACC_CACFanReq_flg_Inproc "SWC_OUTP_type/run_SWC_OUTP_5ms_sys/OUTP/outpmodule/VACC_CACFanReq_flg_Inproc" /begin SUB_GROUP S6_Signal_Limit S6_Signal_Override /end SUB_GROUP /end GROUP
/begin GROUP S5_VACC_CACOverrun_flg_Inproc "SWC_OUTP_type/run_SWC_OUTP_5ms_sys/OUTP/outpmodule/VACC_CACOverrun_flg_Inproc" /begin SUB_GROUP S7_Signal_Limit S7_Signal_Override /end SUB_GROUP /end GROUP
/begin GROUP S5_VACC_CACPresReady_flg_Inproc "SWC_OUTP_type/run_SWC_OUTP_5ms_sys/OUTP/outpmodule/VACC_CACPresReady_flg_Inproc" /begin SUB_GROUP S8_Signal_Limit S8_Signal_Override /end SUB_GROUP /end GROUP
/begin GROUP S5_VACC_CACPresWarn_flg_Inproc "SWC_OUTP_type/run_SWC_OUTP_5ms_sys/OUTP/outpmodule/VACC_CACPresWarn_flg_Inproc" /begin SUB_GROUP S9_Signal_Limit S9_Signal_Override /end SUB_GROUP /end GROUP
/begin GROUP S5_VACC_CACRunFail_flg_Inproc "SWC_OUTP_type/run_SWC_OUTP_5ms_sys/OUTP/outpmodule/VACC_CACRunFail_flg_Inproc" /begin SUB_GROUP S10_Signal_Limit S10_Signal_Override /end SUB_GROUP /end GROUP
/begin GROUP S5_VACC_CACTempOverHigh_flg_Inproc "SWC_OUTP_type/run_SWC_OUTP_5ms_sys/OUTP/outpmodule/VACC_CACTempOverHigh_flg_Inproc" /begin SUB_GROUP S11_Signal_Limit S11_Signal_Override /end SUB_GROUP /end GROUP
/begin GROUP S5_VACC_DCDCEnDemamd_enum_Inproc "SWC_OUTP_type/run_SWC_OUTP_5ms_sys/OUTP/outpmodule/VACC_DCDCEnDemamd_enum_Inproc" /begin SUB_GROUP S12_Signal_Limit S12_Signal_Override /end SUB_GROUP /end GROUP
/begin GROUP S5_VACC_EACEnDemand_enum_Inproc "SWC_OUTP_type/run_SWC_OUTP_5ms_sys/OUTP/outpmodule/VACC_EACEnDemand_enum_Inproc" /begin SUB_GROUP S13_Signal_Limit S13_Signal_Override /end SUB_GROUP /end GROUP
/begin GROUP S5_VACC_EACSpdDemand_rpm_Inproc "SWC_OUTP_type/run_SWC_OUTP_5ms_sys/OUTP/outpmodule/VACC_EACSpdDemand_rpm_Inproc" /begin SUB_GROUP S14_Signal_Limit S14_Signal_Override /end SUB_GROUP /end GROUP
/begin GROUP S5_VACC_EHPSDisEnTimeout_flg_Inproc "SWC_OUTP_type/run_SWC_OUTP_5ms_sys/OUTP/outpmodule/VACC_EHPSDisEnTimeout_flg_Inproc" /begin SUB_GROUP S15_Signal_Limit S15_Signal_Override /end SUB_GROUP /end GROUP
/begin GROUP S5_VACC_EHPSEnDemand_enum_Inproc "SWC_OUTP_type/run_SWC_OUTP_5ms_sys/OUTP/outpmodule/VACC_EHPSEnDemand_enum_Inproc" /begin SUB_GROUP S16_Signal_Limit S16_Signal_Override /end SUB_GROUP /end GROUP
/begin GROUP S5_VACC_EHPSEnTimeout_flg_Inproc "SWC_OUTP_type/run_SWC_OUTP_5ms_sys/OUTP/outpmodule/VACC_EHPSEnTimeout_flg_Inproc" /begin SUB_GROUP S17_Signal_Limit S17_Signal_Override /end SUB_GROUP /end GROUP
/begin GROUP S5_VACC_EHPSMotorDemSpd_rpm_Inproc "SWC_OUTP_type/run_SWC_OUTP_5ms_sys/OUTP/outpmodule/VACC_EHPSMotorDemSpd_rpm_Inproc" /begin SUB_GROUP S18_Signal_Limit S18_Signal_Override /end SUB_GROUP /end GROUP
/begin GROUP S5_VACC_EHPSSpdCtrlMode_enum_Inproc "SWC_OUTP_type/run_SWC_OUTP_5ms_sys/OUTP/outpmodule/VACC_EHPSSpdCtrlMode_enum_Inproc" /begin SUB_GROUP S19_Signal_Limit S19_Signal_Override /end SUB_GROUP /end GROUP
/begin GROUP S5_VACC_EHPSSpdDemTimeout_flg_Inproc "SWC_OUTP_type/run_SWC_OUTP_5ms_sys/OUTP/outpmodule/VACC_EHPSSpdDemTimeout_flg_Inproc" /begin SUB_GROUP S20_Signal_Limit S20_Signal_Override /end SUB_GROUP /end GROUP
/begin GROUP S5_VAPM_ABSActiveTimeOut_flg_Inproc "SWC_OUTP_type/run_SWC_OUTP_5ms_sys/OUTP/outpmodule/VAPM_ABSActiveTimeOut_flg_Inproc" /begin SUB_GROUP S21_Signal_Limit S21_Signal_Override /end SUB_GROUP /end GROUP
/begin GROUP S5_VAPM_ABSActive_flg_Inproc "SWC_OUTP_type/run_SWC_OUTP_5ms_sys/OUTP/outpmodule/VAPM_ABSActive_flg_Inproc" /begin SUB_GROUP S22_Signal_Limit S22_Signal_Override /end SUB_GROUP /end GROUP
/begin GROUP S5_VAPM_APSAngleTarget_Deg_Inproc "SWC_OUTP_type/run_SWC_OUTP_5ms_sys/OUTP/outpmodule/VAPM_APSAngleTarget_Deg_Inproc" /begin SUB_GROUP S23_Signal_Limit S23_Signal_Override /end SUB_GROUP /end GROUP
/begin GROUP S5_VAPM_APSDFLL_cm_Inproc "SWC_OUTP_type/run_SWC_OUTP_5ms_sys/OUTP/outpmodule/VAPM_APSDFLL_cm_Inproc" /begin SUB_GROUP S24_Signal_Limit S24_Signal_Override /end SUB_GROUP /end GROUP
/begin GROUP S5_VAPM_APSDFLR_cm_Inproc "SWC_OUTP_type/run_SWC_OUTP_5ms_sys/OUTP/outpmodule/VAPM_APSDFLR_cm_Inproc" /begin SUB_GROUP S25_Signal_Limit S25_Signal_Override /end SUB_GROUP /end GROUP
/begin GROUP S5_VAPM_APSDRLL_cm_Inproc "SWC_OUTP_type/run_SWC_OUTP_5ms_sys/OUTP/outpmodule/VAPM_APSDRLL_cm_Inproc" /begin SUB_GROUP S26_Signal_Limit S26_Signal_Override /end SUB_GROUP /end GROUP
/begin GROUP S5_VAPM_APSDRLR_cm_Inproc "SWC_OUTP_type/run_SWC_OUTP_5ms_sys/OUTP/outpmodule/VAPM_APSDRLR_cm_Inproc" /begin SUB_GROUP S27_Signal_Limit S27_Signal_Override /end SUB_GROUP /end GROUP
/begin GROUP S5_VAPM_APSExitCondition_enum_Inproc "SWC_OUTP_type/run_SWC_OUTP_5ms_sys/OUTP/outpmodule/VAPM_APSExitCondition_enum_Inproc" /begin SUB_GROUP S28_Signal_Limit S28_Signal_Override /end SUB_GROUP /end GROUP
/begin GROUP S5_VAPM_APSHWVer_enum_Inproc "SWC_OUTP_type/run_SWC_OUTP_5ms_sys/OUTP/outpmodule/VAPM_APSHWVer_enum_Inproc" /begin SUB_GROUP S29_Signal_Limit S29_Signal_Override /end SUB_GROUP /end GROUP
/begin GROUP S5_VAPM_APSProgressPCT_pct_Inproc "SWC_OUTP_type/run_SWC_OUTP_5ms_sys/OUTP/outpmodule/VAPM_APSProgressPCT_pct_Inproc" /begin SUB_GROUP S30_Signal_Limit S30_Signal_Override /end SUB_GROUP /end GROUP
/begin GROUP S5_VAPM_APSPwrReq_enum_Inproc "SWC_OUTP_type/run_SWC_OUTP_5ms_sys/OUTP/outpmodule/VAPM_APSPwrReq_enum_Inproc" /begin SUB_GROUP S31_Signal_Limit S31_Signal_Override /end SUB_GROUP /end GROUP
/begin GROUP S5_VAPM_APSRQDisplay_enum_Inproc "SWC_OUTP_type/run_SWC_OUTP_5ms_sys/OUTP/outpmodule/VAPM_APSRQDisplay_enum_Inproc" /begin SUB_GROUP S32_Signal_Limit S32_Signal_Override /end SUB_GROUP /end GROUP
/begin GROUP S5_VAPM_APSRqEPASCtrl_flg_Inproc "SWC_OUTP_type/run_SWC_OUTP_5ms_sys/OUTP/outpmodule/VAPM_APSRqEPASCtrl_flg_Inproc" /begin SUB_GROUP S33_Signal_Limit S33_Signal_Override /end SUB_GROUP /end GROUP
/begin GROUP S5_VAPM_APSSWVer_enum_Inproc "SWC_OUTP_type/run_SWC_OUTP_5ms_sys/OUTP/outpmodule/VAPM_APSSWVer_enum_Inproc" /begin SUB_GROUP S34_Signal_Limit S34_Signal_Override /end SUB_GROUP /end GROUP
/begin GROUP S5_VAPM_APSShiftPosnReq_enum_Inproc "SWC_OUTP_type/run_SWC_OUTP_5ms_sys/OUTP/outpmodule/VAPM_APSShiftPosnReq_enum_Inproc" /begin SUB_GROUP S35_Signal_Limit S35_Signal_Override /end SUB_GROUP /end GROUP
/begin GROUP S5_VAPM_APSSpeedCMD_kph_Inproc "SWC_OUTP_type/run_SWC_OUTP_5ms_sys/OUTP/outpmodule/VAPM_APSSpeedCMD_kph_Inproc" /begin SUB_GROUP S36_Signal_Limit S36_Signal_Override /end SUB_GROUP /end GROUP
/begin GROUP S5_VAPM_APSVMCReqA_flg_Inproc "SWC_OUTP_type/run_SWC_OUTP_5ms_sys/OUTP/outpmodule/VAPM_APSVMCReqA_flg_Inproc" /begin SUB_GROUP S37_Signal_Limit S37_Signal_Override /end SUB_GROUP /end GROUP
/begin GROUP S5_VAPM_APSVRqEPASCtrl_flg_Inproc "SWC_OUTP_type/run_SWC_OUTP_5ms_sys/OUTP/outpmodule/VAPM_APSVRqEPASCtrl_flg_Inproc" /begin SUB_GROUP S38_Signal_Limit S38_Signal_Override /end SUB_GROUP /end GROUP
/begin GROUP S5_VAPM_AVMErrSTATimeOut_flg_Inproc "SWC_OUTP_type/run_SWC_OUTP_5ms_sys/OUTP/outpmodule/VAPM_AVMErrSTATimeOut_flg_Inproc" /begin SUB_GROUP S39_Signal_Limit S39_Signal_Override /end SUB_GROUP /end GROUP
/begin GROUP S5_VAPM_AVMErrSTA_flg_Inproc "SWC_OUTP_type/run_SWC_OUTP_5ms_sys/OUTP/outpmodule/VAPM_AVMErrSTA_flg_Inproc" /begin SUB_GROUP S40_Signal_Limit S40_Signal_Override /end SUB_GROUP /end GROUP
/begin GROUP S5_VAPM_AVMParkingmodeTimeOut_flg_Inproc "SWC_OUTP_type/run_SWC_OUTP_5ms_sys/OUTP/outpmodule/VAPM_AVMParkingmodeTimeOut_flg_Inproc" /begin SUB_GROUP S41_Signal_Limit S41_Signal_Override /end SUB_GROUP /end GROUP
/begin GROUP S5_VAPM_AVMParkingmode_enum_Inproc "SWC_OUTP_type/run_SWC_OUTP_5ms_sys/OUTP/outpmodule/VAPM_AVMParkingmode_enum_Inproc" /begin SUB_GROUP S42_Signal_Limit S42_Signal_Override /end SUB_GROUP /end GROUP
/begin GROUP S5_VAPM_AVMparkingcancelTimeOut_flg_Inproc "SWC_OUTP_type/run_SWC_OUTP_5ms_sys/OUTP/outpmodule/VAPM_AVMparkingcancelTimeOut_flg_Inproc" /begin SUB_GROUP S43_Signal_Limit S43_Signal_Override /end SUB_GROUP /end GROUP
/begin GROUP S5_VAPM_AVMparkingcancel_enum_Inproc "SWC_OUTP_type/run_SWC_OUTP_5ms_sys/OUTP/outpmodule/VAPM_AVMparkingcancel_enum_Inproc" /begin SUB_GROUP S44_Signal_Limit S44_Signal_Override /end SUB_GROUP /end GROUP
/begin GROUP S5_VAPM_AVMparkingexcuteTimeOut_flg_Inproc "SWC_OUTP_type/run_SWC_OUTP_5ms_sys/OUTP/outpmodule/VAPM_AVMparkingexcuteTimeOut_flg_Inproc" /begin SUB_GROUP S45_Signal_Limit S45_Signal_Override /end SUB_GROUP /end GROUP
/begin GROUP S5_VAPM_AVMparkingexcute_enum_Inproc "SWC_OUTP_type/run_SWC_OUTP_5ms_sys/OUTP/outpmodule/VAPM_AVMparkingexcute_enum_Inproc" /begin SUB_GROUP S46_Signal_Limit S46_Signal_Override /end SUB_GROUP /end GROUP
/begin GROUP S5_VAPM_BrkPedalPosTimeOut_flg_Inproc "SWC_OUTP_type/run_SWC_OUTP_5ms_sys/OUTP/outpmodule/VAPM_BrkPedalPosTimeOut_flg_Inproc" /begin SUB_GROUP S47_Signal_Limit S47_Signal_Override /end SUB_GROUP /end GROUP
/begin GROUP S5_VAPM_BrkPedalPos_pct_Inproc "SWC_OUTP_type/run_SWC_OUTP_5ms_sys/OUTP/outpmodule/VAPM_BrkPedalPos_pct_Inproc" /begin SUB_GROUP S48_Signal_Limit S48_Signal_Override /end SUB_GROUP /end GROUP
/begin GROUP S5_VAPM_BrkSwStaTimeOut_flg_Inproc "SWC_OUTP_type/run_SWC_OUTP_5ms_sys/OUTP/outpmodule/VAPM_BrkSwStaTimeOut_flg_Inproc" /begin SUB_GROUP S49_Signal_Limit S49_Signal_Override /end SUB_GROUP /end GROUP
/begin GROUP S5_VAPM_BrkSwSta_flg_Inproc "SWC_OUTP_type/run_SWC_OUTP_5ms_sys/OUTP/outpmodule/VAPM_BrkSwSta_flg_Inproc" /begin SUB_GROUP S50_Signal_Limit S50_Signal_Override /end SUB_GROUP /end GROUP
/begin GROUP S5_VAPM_BrkSwVTimeOut_flg_Inproc "SWC_OUTP_type/run_SWC_OUTP_5ms_sys/OUTP/outpmodule/VAPM_BrkSwVTimeOut_flg_Inproc" /begin SUB_GROUP S51_Signal_Limit S51_Signal_Override /end SUB_GROUP /end GROUP
/begin GROUP S5_VAPM_BrkSwV_flg_Inproc "SWC_OUTP_type/run_SWC_OUTP_5ms_sys/OUTP/outpmodule/VAPM_BrkSwV_flg_Inproc" /begin SUB_GROUP S52_Signal_Limit S52_Signal_Override /end SUB_GROUP /end GROUP
/begin GROUP S5_VAPM_CAASSta_enum_Inproc "SWC_OUTP_type/run_SWC_OUTP_5ms_sys/OUTP/outpmodule/VAPM_CAASSta_enum_Inproc" /begin SUB_GROUP S53_Signal_Limit S53_Signal_Override /end SUB_GROUP /end GROUP
/begin GROUP S5_VAPM_CAASSwTimeOut_flg_Inproc "SWC_OUTP_type/run_SWC_OUTP_5ms_sys/OUTP/outpmodule/VAPM_CAASSwTimeOut_flg_Inproc" /begin SUB_GROUP S54_Signal_Limit S54_Signal_Override /end SUB_GROUP /end GROUP
/begin GROUP S5_VAPM_CAASSw_enum_Inproc "SWC_OUTP_type/run_SWC_OUTP_5ms_sys/OUTP/outpmodule/VAPM_CAASSw_enum_Inproc" /begin SUB_GROUP S55_Signal_Limit S55_Signal_Override /end SUB_GROUP /end GROUP
/begin GROUP S5_VAPM_CAASVMCReqA_flg_Inproc "SWC_OUTP_type/run_SWC_OUTP_5ms_sys/OUTP/outpmodule/VAPM_CAASVMCReqA_flg_Inproc" /begin SUB_GROUP S56_Signal_Limit S56_Signal_Override /end SUB_GROUP /end GROUP
/begin GROUP S5_VAPM_Chime_enum_Inproc "SWC_OUTP_type/run_SWC_OUTP_5ms_sys/OUTP/outpmodule/VAPM_Chime_enum_Inproc" /begin SUB_GROUP S57_Signal_Limit S57_Signal_Override /end SUB_GROUP /end GROUP
/begin GROUP S5_VAPM_ChrgPlugSta_enum_Inproc "SWC_OUTP_type/run_SWC_OUTP_5ms_sys/OUTP/outpmodule/VAPM_ChrgPlugSta_enum_Inproc" /begin SUB_GROUP S58_Signal_Limit S58_Signal_Override /end SUB_GROUP /end GROUP
/begin GROUP S5_VAPM_DKCPDkeyAreaRAPSSta_enum_Inproc "SWC_OUTP_type/run_SWC_OUTP_5ms_sys/OUTP/outpmodule/VAPM_DKCPDkeyAreaRAPSSta_enum_Inproc" /begin SUB_GROUP S59_Signal_Limit S59_Signal_Override /end SUB_GROUP /end GROUP
/begin GROUP S5_VAPM_DKCParkingModeCmd_enum_Inproc "SWC_OUTP_type/run_SWC_OUTP_5ms_sys/OUTP/outpmodule/VAPM_DKCParkingModeCmd_enum_Inproc" /begin SUB_GROUP S60_Signal_Limit S60_Signal_Override /end SUB_GROUP /end GROUP
/begin GROUP S5_VAPM_DriIntendTimeOut_flg_Inproc "SWC_OUTP_type/run_SWC_OUTP_5ms_sys/OUTP/outpmodule/VAPM_DriIntendTimeOut_flg_Inproc" /begin SUB_GROUP S61_Signal_Limit S61_Signal_Override /end SUB_GROUP /end GROUP
/begin GROUP S5_VAPM_DriIntend_enum_Inproc "SWC_OUTP_type/run_SWC_OUTP_5ms_sys/OUTP/outpmodule/VAPM_DriIntend_enum_Inproc" /begin SUB_GROUP S62_Signal_Limit S62_Signal_Override /end SUB_GROUP /end GROUP
/begin GROUP S5_VAPM_DriverSeatBeltCmdTimeOut_flg_Inproc "SWC_OUTP_type/run_SWC_OUTP_5ms_sys/OUTP/outpmodule/VAPM_DriverSeatBeltCmdTimeOut_flg_Inproc" /begin SUB_GROUP S63_Signal_Limit S63_Signal_Override /end SUB_GROUP /end GROUP
/begin GROUP S5_VAPM_DriverSeatBeltCmd_flg_Inproc "SWC_OUTP_type/run_SWC_OUTP_5ms_sys/OUTP/outpmodule/VAPM_DriverSeatBeltCmd_flg_Inproc" /begin SUB_GROUP S64_Signal_Limit S64_Signal_Override /end SUB_GROUP /end GROUP
/begin GROUP S5_VAPM_EPBErrStaTimeOut_flg_Inproc "SWC_OUTP_type/run_SWC_OUTP_5ms_sys/OUTP/outpmodule/VAPM_EPBErrStaTimeOut_flg_Inproc" /begin SUB_GROUP S65_Signal_Limit S65_Signal_Override /end SUB_GROUP /end GROUP
/begin GROUP S5_VAPM_EPBErrSta_enum_Inproc "SWC_OUTP_type/run_SWC_OUTP_5ms_sys/OUTP/outpmodule/VAPM_EPBErrSta_enum_Inproc" /begin SUB_GROUP S66_Signal_Limit S66_Signal_Override /end SUB_GROUP /end GROUP
/begin GROUP S5_VAPM_EPBExtApplyAvailTimeOut_flg_Inproc "SWC_OUTP_type/run_SWC_OUTP_5ms_sys/OUTP/outpmodule/VAPM_EPBExtApplyAvailTimeOut_flg_Inproc" /begin SUB_GROUP S67_Signal_Limit S67_Signal_Override /end SUB_GROUP /end GROUP
/begin GROUP S5_VAPM_EPBExtApplyAvail_flg_Inproc "SWC_OUTP_type/run_SWC_OUTP_5ms_sys/OUTP/outpmodule/VAPM_EPBExtApplyAvail_flg_Inproc" /begin SUB_GROUP S68_Signal_Limit S68_Signal_Override /end SUB_GROUP /end GROUP
/begin GROUP S5_VAPM_EPBExtReleaseAvailTimeOut_flg_Inproc "SWC_OUTP_type/run_SWC_OUTP_5ms_sys/OUTP/outpmodule/VAPM_EPBExtReleaseAvailTimeOut_flg_Inproc" /begin SUB_GROUP S69_Signal_Limit S69_Signal_Override /end SUB_GROUP /end GROUP
/begin GROUP S5_VAPM_EPBExtReleaseAvail_flg_Inproc "SWC_OUTP_type/run_SWC_OUTP_5ms_sys/OUTP/outpmodule/VAPM_EPBExtReleaseAvail_flg_Inproc" /begin SUB_GROUP S70_Signal_Limit S70_Signal_Override /end SUB_GROUP /end GROUP
/begin GROUP S5_VAPM_EPBStaTimeOut_flg_Inproc "SWC_OUTP_type/run_SWC_OUTP_5ms_sys/OUTP/outpmodule/VAPM_EPBStaTimeOut_flg_Inproc" /begin SUB_GROUP S71_Signal_Limit S71_Signal_Override /end SUB_GROUP /end GROUP
/begin GROUP S5_VAPM_EPBSta_enum_Inproc "SWC_OUTP_type/run_SWC_OUTP_5ms_sys/OUTP/outpmodule/VAPM_EPBSta_enum_Inproc" /begin SUB_GROUP S72_Signal_Limit S72_Signal_Override /end SUB_GROUP /end GROUP
/begin GROUP S5_VAPM_EPSAOIControlTimeOut_flg_Inproc "SWC_OUTP_type/run_SWC_OUTP_5ms_sys/OUTP/outpmodule/VAPM_EPSAOIControlTimeOut_flg_Inproc" /begin SUB_GROUP S73_Signal_Limit S73_Signal_Override /end SUB_GROUP /end GROUP
/begin GROUP S5_VAPM_EPSAOIControl_enum_Inproc "SWC_OUTP_type/run_SWC_OUTP_5ms_sys/OUTP/outpmodule/VAPM_EPSAOIControl_enum_Inproc" /begin SUB_GROUP S74_Signal_Limit S74_Signal_Override /end SUB_GROUP /end GROUP
/begin GROUP S5_VAPM_ESCAPSStaTimeOut_flg_Inproc "SWC_OUTP_type/run_SWC_OUTP_5ms_sys/OUTP/outpmodule/VAPM_ESCAPSStaTimeOut_flg_Inproc" /begin SUB_GROUP S75_Signal_Limit S75_Signal_Override /end SUB_GROUP /end GROUP
/begin GROUP S5_VAPM_ESCAPSSta_enum_Inproc "SWC_OUTP_type/run_SWC_OUTP_5ms_sys/OUTP/outpmodule/VAPM_ESCAPSSta_enum_Inproc" /begin SUB_GROUP S76_Signal_Limit S76_Signal_Override /end SUB_GROUP /end GROUP
/begin GROUP S5_VAPM_ESCStandstillTimeOut_flg_Inproc "SWC_OUTP_type/run_SWC_OUTP_5ms_sys/OUTP/outpmodule/VAPM_ESCStandstillTimeOut_flg_Inproc" /begin SUB_GROUP S77_Signal_Limit S77_Signal_Override /end SUB_GROUP /end GROUP
/begin GROUP S5_VAPM_ESCStandstill_flg_Inproc "SWC_OUTP_type/run_SWC_OUTP_5ms_sys/OUTP/outpmodule/VAPM_ESCStandstill_flg_Inproc" /begin SUB_GROUP S78_Signal_Limit S78_Signal_Override /end SUB_GROUP /end GROUP
/begin GROUP S5_VAPM_FSOffSwTimeOut_flg_Inproc "SWC_OUTP_type/run_SWC_OUTP_5ms_sys/OUTP/outpmodule/VAPM_FSOffSwTimeOut_flg_Inproc" /begin SUB_GROUP S79_Signal_Limit S79_Signal_Override /end SUB_GROUP /end GROUP
/begin GROUP S5_VAPM_FSOffSw_enum_Inproc "SWC_OUTP_type/run_SWC_OUTP_5ms_sys/OUTP/outpmodule/VAPM_FSOffSw_enum_Inproc" /begin SUB_GROUP S80_Signal_Limit S80_Signal_Override /end SUB_GROUP /end GROUP
/begin GROUP S5_VAPM_GRADETimeOut_flg_Inproc "SWC_OUTP_type/run_SWC_OUTP_5ms_sys/OUTP/outpmodule/VAPM_GRADETimeOut_flg_Inproc" /begin SUB_GROUP S81_Signal_Limit S81_Signal_Override /end SUB_GROUP /end GROUP
/begin GROUP S5_VAPM_GRADE_Deg_Inproc "SWC_OUTP_type/run_SWC_OUTP_5ms_sys/OUTP/outpmodule/VAPM_GRADE_Deg_Inproc" /begin SUB_GROUP S82_Signal_Limit S82_Signal_Override /end SUB_GROUP /end GROUP
/begin GROUP S5_VAPM_IVIScreenTimeOut_flg_Inproc "SWC_OUTP_type/run_SWC_OUTP_5ms_sys/OUTP/outpmodule/VAPM_IVIScreenTimeOut_flg_Inproc" /begin SUB_GROUP S83_Signal_Limit S83_Signal_Override /end SUB_GROUP /end GROUP
/begin GROUP S5_VAPM_IVIScreen_enum_Inproc "SWC_OUTP_type/run_SWC_OUTP_5ms_sys/OUTP/outpmodule/VAPM_IVIScreen_enum_Inproc" /begin SUB_GROUP S84_Signal_Limit S84_Signal_Override /end SUB_GROUP /end GROUP
/begin GROUP S5_VAPM_IVIStatusTimeOut_flg_Inproc "SWC_OUTP_type/run_SWC_OUTP_5ms_sys/OUTP/outpmodule/VAPM_IVIStatusTimeOut_flg_Inproc" /begin SUB_GROUP S85_Signal_Limit S85_Signal_Override /end SUB_GROUP /end GROUP
/begin GROUP S5_VAPM_IVIStatus_flg_Inproc "SWC_OUTP_type/run_SWC_OUTP_5ms_sys/OUTP/outpmodule/VAPM_IVIStatus_flg_Inproc" /begin SUB_GROUP S86_Signal_Limit S86_Signal_Override /end SUB_GROUP /end GROUP
/begin GROUP S5_VAPM_IVIUserTakeOverAPSSta_flg_Inproc "SWC_OUTP_type/run_SWC_OUTP_5ms_sys/OUTP/outpmodule/VAPM_IVIUserTakeOverAPSSta_flg_Inproc" /begin SUB_GROUP S87_Signal_Limit S87_Signal_Override /end SUB_GROUP /end GROUP
/begin GROUP S5_VAPM_LFPulseCountTimeOut_flg_Inproc "SWC_OUTP_type/run_SWC_OUTP_5ms_sys/OUTP/outpmodule/VAPM_LFPulseCountTimeOut_flg_Inproc" /begin SUB_GROUP S88_Signal_Limit S88_Signal_Override /end SUB_GROUP /end GROUP
/begin GROUP S5_VAPM_LFPulseCountVTimeOut_flg_Inproc "SWC_OUTP_type/run_SWC_OUTP_5ms_sys/OUTP/outpmodule/VAPM_LFPulseCountVTimeOut_flg_Inproc" /begin SUB_GROUP S89_Signal_Limit S89_Signal_Override /end SUB_GROUP /end GROUP
/begin GROUP S5_VAPM_LFPulseCountV_flg_Inproc "SWC_OUTP_type/run_SWC_OUTP_5ms_sys/OUTP/outpmodule/VAPM_LFPulseCountV_flg_Inproc" /begin SUB_GROUP S90_Signal_Limit S90_Signal_Override /end SUB_GROUP /end GROUP
/begin GROUP S5_VAPM_LFPulseCount_enum_Inproc "SWC_OUTP_type/run_SWC_OUTP_5ms_sys/OUTP/outpmodule/VAPM_LFPulseCount_enum_Inproc" /begin SUB_GROUP S91_Signal_Limit S91_Signal_Override /end SUB_GROUP /end GROUP
/begin GROUP S5_VAPM_LFRawWhlSpeedTimeOut_flg_Inproc "SWC_OUTP_type/run_SWC_OUTP_5ms_sys/OUTP/outpmodule/VAPM_LFRawWhlSpeedTimeOut_flg_Inproc" /begin SUB_GROUP S92_Signal_Limit S92_Signal_Override /end SUB_GROUP /end GROUP
/begin GROUP S5_VAPM_LFRawWhlSpeedVTimeOut_flg_Inproc "SWC_OUTP_type/run_SWC_OUTP_5ms_sys/OUTP/outpmodule/VAPM_LFRawWhlSpeedVTimeOut_flg_Inproc" /begin SUB_GROUP S93_Signal_Limit S93_Signal_Override /end SUB_GROUP /end GROUP
/begin GROUP S5_VAPM_LFRawWhlSpeedV_flg_Inproc "SWC_OUTP_type/run_SWC_OUTP_5ms_sys/OUTP/outpmodule/VAPM_LFRawWhlSpeedV_flg_Inproc" /begin SUB_GROUP S94_Signal_Limit S94_Signal_Override /end SUB_GROUP /end GROUP
/begin GROUP S5_VAPM_LFRawWhlSpeed_kph_Inproc "SWC_OUTP_type/run_SWC_OUTP_5ms_sys/OUTP/outpmodule/VAPM_LFRawWhlSpeed_kph_Inproc" /begin SUB_GROUP S95_Signal_Limit S95_Signal_Override /end SUB_GROUP /end GROUP
/begin GROUP S5_VAPM_LFWhlRotDirTimeOut_flg_Inproc "SWC_OUTP_type/run_SWC_OUTP_5ms_sys/OUTP/outpmodule/VAPM_LFWhlRotDirTimeOut_flg_Inproc" /begin SUB_GROUP S96_Signal_Limit S96_Signal_Override /end SUB_GROUP /end GROUP
/begin GROUP S5_VAPM_LFWhlRotDir_enum_Inproc "SWC_OUTP_type/run_SWC_OUTP_5ms_sys/OUTP/outpmodule/VAPM_LFWhlRotDir_enum_Inproc" /begin SUB_GROUP S97_Signal_Limit S97_Signal_Override /end SUB_GROUP /end GROUP
/begin GROUP S5_VAPM_LRPulseCountTimeOut_flg_Inproc "SWC_OUTP_type/run_SWC_OUTP_5ms_sys/OUTP/outpmodule/VAPM_LRPulseCountTimeOut_flg_Inproc" /begin SUB_GROUP S98_Signal_Limit S98_Signal_Override /end SUB_GROUP /end GROUP
/begin GROUP S5_VAPM_LRPulseCountVTimeOut_flg_Inproc "SWC_OUTP_type/run_SWC_OUTP_5ms_sys/OUTP/outpmodule/VAPM_LRPulseCountVTimeOut_flg_Inproc" /begin SUB_GROUP S99_Signal_Limit S99_Signal_Override /end SUB_GROUP /end GROUP
/begin GROUP S5_VAPM_LRPulseCountV_flg_Inproc "SWC_OUTP_type/run_SWC_OUTP_5ms_sys/OUTP/outpmodule/VAPM_LRPulseCountV_flg_Inproc" /begin SUB_GROUP S100_Signal_Limit S100_Signal_Override /end SUB_GROUP /end GROUP
/begin GROUP S5_VAPM_LRPulseCount_enum_Inproc "SWC_OUTP_type/run_SWC_OUTP_5ms_sys/OUTP/outpmodule/VAPM_LRPulseCount_enum_Inproc" /begin SUB_GROUP S101_Signal_Limit S101_Signal_Override /end SUB_GROUP /end GROUP
/begin GROUP S5_VAPM_LRRawWhlSpeedTimeOut_flg_Inproc "SWC_OUTP_type/run_SWC_OUTP_5ms_sys/OUTP/outpmodule/VAPM_LRRawWhlSpeedTimeOut_flg_Inproc" /begin SUB_GROUP S102_Signal_Limit S102_Signal_Override /end SUB_GROUP /end GROUP
/begin GROUP S5_VAPM_LRRawWhlSpeedVTimeOut_flg_Inproc "SWC_OUTP_type/run_SWC_OUTP_5ms_sys/OUTP/outpmodule/VAPM_LRRawWhlSpeedVTimeOut_flg_Inproc" /begin SUB_GROUP S103_Signal_Limit S103_Signal_Override /end SUB_GROUP /end GROUP
/begin GROUP S5_VAPM_LRRawWhlSpeedV_flg_Inproc "SWC_OUTP_type/run_SWC_OUTP_5ms_sys/OUTP/outpmodule/VAPM_LRRawWhlSpeedV_flg_Inproc" /begin SUB_GROUP S104_Signal_Limit S104_Signal_Override /end SUB_GROUP /end GROUP
/begin GROUP S5_VAPM_LRRawWhlSpeed_kph_Inproc "SWC_OUTP_type/run_SWC_OUTP_5ms_sys/OUTP/outpmodule/VAPM_LRRawWhlSpeed_kph_Inproc" /begin SUB_GROUP S105_Signal_Limit S105_Signal_Override /end SUB_GROUP /end GROUP
/begin GROUP S5_VAPM_LRWhlRotDirTimeOut_flg_Inproc "SWC_OUTP_type/run_SWC_OUTP_5ms_sys/OUTP/outpmodule/VAPM_LRWhlRotDirTimeOut_flg_Inproc" /begin SUB_GROUP S106_Signal_Limit S106_Signal_Override /end SUB_GROUP /end GROUP
/begin GROUP S5_VAPM_LRWhlRotDir_enum_Inproc "SWC_OUTP_type/run_SWC_OUTP_5ms_sys/OUTP/outpmodule/VAPM_LRWhlRotDir_enum_Inproc" /begin SUB_GROUP S107_Signal_Limit S107_Signal_Override /end SUB_GROUP /end GROUP
/begin GROUP S5_VAPM_LatAccelTimeOut_flg_Inproc "SWC_OUTP_type/run_SWC_OUTP_5ms_sys/OUTP/outpmodule/VAPM_LatAccelTimeOut_flg_Inproc" /begin SUB_GROUP S108_Signal_Limit S108_Signal_Override /end SUB_GROUP /end GROUP
/begin GROUP S5_VAPM_LatAccelVTimeOut_flg_Inproc "SWC_OUTP_type/run_SWC_OUTP_5ms_sys/OUTP/outpmodule/VAPM_LatAccelVTimeOut_flg_Inproc" /begin SUB_GROUP S109_Signal_Limit S109_Signal_Override /end SUB_GROUP /end GROUP
/begin GROUP S5_VAPM_LatAccelV_flg_Inproc "SWC_OUTP_type/run_SWC_OUTP_5ms_sys/OUTP/outpmodule/VAPM_LatAccelV_flg_Inproc" /begin SUB_GROUP S110_Signal_Limit S110_Signal_Override /end SUB_GROUP /end GROUP
/begin GROUP S5_VAPM_LatAccel_Gps_Inproc "SWC_OUTP_type/run_SWC_OUTP_5ms_sys/OUTP/outpmodule/VAPM_LatAccel_Gps_Inproc" /begin SUB_GROUP S111_Signal_Limit S111_Signal_Override /end SUB_GROUP /end GROUP
/begin GROUP S5_VAPM_LongAccelTimeOut_flg_Inproc "SWC_OUTP_type/run_SWC_OUTP_5ms_sys/OUTP/outpmodule/VAPM_LongAccelTimeOut_flg_Inproc" /begin SUB_GROUP S112_Signal_Limit S112_Signal_Override /end SUB_GROUP /end GROUP
/begin GROUP S5_VAPM_LongAccelVTimeOut_flg_Inproc "SWC_OUTP_type/run_SWC_OUTP_5ms_sys/OUTP/outpmodule/VAPM_LongAccelVTimeOut_flg_Inproc" /begin SUB_GROUP S113_Signal_Limit S113_Signal_Override /end SUB_GROUP /end GROUP
/begin GROUP S5_VAPM_LongAccelV_flg_Inproc "SWC_OUTP_type/run_SWC_OUTP_5ms_sys/OUTP/outpmodule/VAPM_LongAccelV_flg_Inproc" /begin SUB_GROUP S114_Signal_Limit S114_Signal_Override /end SUB_GROUP /end GROUP
/begin GROUP S5_VAPM_LongAccel_Gps_Inproc "SWC_OUTP_type/run_SWC_OUTP_5ms_sys/OUTP/outpmodule/VAPM_LongAccel_Gps_Inproc" /begin SUB_GROUP S115_Signal_Limit S115_Signal_Override /end SUB_GROUP /end GROUP
/begin GROUP S5_VAPM_MCPressureTimeOut_flg_Inproc "SWC_OUTP_type/run_SWC_OUTP_5ms_sys/OUTP/outpmodule/VAPM_MCPressureTimeOut_flg_Inproc" /begin SUB_GROUP S116_Signal_Limit S116_Signal_Override /end SUB_GROUP /end GROUP
/begin GROUP S5_VAPM_MCPressureVTimeOut_flg_Inproc "SWC_OUTP_type/run_SWC_OUTP_5ms_sys/OUTP/outpmodule/VAPM_MCPressureVTimeOut_flg_Inproc" /begin SUB_GROUP S117_Signal_Limit S117_Signal_Override /end SUB_GROUP /end GROUP
/begin GROUP S5_VAPM_MCPressureV_bar_Inproc "SWC_OUTP_type/run_SWC_OUTP_5ms_sys/OUTP/outpmodule/VAPM_MCPressureV_bar_Inproc" /begin SUB_GROUP S118_Signal_Limit S118_Signal_Override /end SUB_GROUP /end GROUP
/begin GROUP S5_VAPM_MCPressure_bar_Inproc "SWC_OUTP_type/run_SWC_OUTP_5ms_sys/OUTP/outpmodule/VAPM_MCPressure_bar_Inproc" /begin SUB_GROUP S119_Signal_Limit S119_Signal_Override /end SUB_GROUP /end GROUP
/begin GROUP S5_VAPM_ModOperation_enum_Inproc "SWC_OUTP_type/run_SWC_OUTP_5ms_sys/OUTP/outpmodule/VAPM_ModOperation_enum_Inproc" /begin SUB_GROUP S120_Signal_Limit S120_Signal_Override /end SUB_GROUP /end GROUP
/begin GROUP S5_VAPM_PASAFCL_enum_Inproc "SWC_OUTP_type/run_SWC_OUTP_5ms_sys/OUTP/outpmodule/VAPM_PASAFCL_enum_Inproc" /begin SUB_GROUP S121_Signal_Limit S121_Signal_Override /end SUB_GROUP /end GROUP
/begin GROUP S5_VAPM_PASAFCR_enum_Inproc "SWC_OUTP_type/run_SWC_OUTP_5ms_sys/OUTP/outpmodule/VAPM_PASAFCR_enum_Inproc" /begin SUB_GROUP S122_Signal_Limit S122_Signal_Override /end SUB_GROUP /end GROUP
/begin GROUP S5_VAPM_PASAFML_enum_Inproc "SWC_OUTP_type/run_SWC_OUTP_5ms_sys/OUTP/outpmodule/VAPM_PASAFML_enum_Inproc" /begin SUB_GROUP S123_Signal_Limit S123_Signal_Override /end SUB_GROUP /end GROUP
/begin GROUP S5_VAPM_PASAFMR_enum_Inproc "SWC_OUTP_type/run_SWC_OUTP_5ms_sys/OUTP/outpmodule/VAPM_PASAFMR_enum_Inproc" /begin SUB_GROUP S124_Signal_Limit S124_Signal_Override /end SUB_GROUP /end GROUP
/begin GROUP S5_VAPM_PASARCL_enum_Inproc "SWC_OUTP_type/run_SWC_OUTP_5ms_sys/OUTP/outpmodule/VAPM_PASARCL_enum_Inproc" /begin SUB_GROUP S125_Signal_Limit S125_Signal_Override /end SUB_GROUP /end GROUP
/begin GROUP S5_VAPM_PASARCR_enum_Inproc "SWC_OUTP_type/run_SWC_OUTP_5ms_sys/OUTP/outpmodule/VAPM_PASARCR_enum_Inproc" /begin SUB_GROUP S126_Signal_Limit S126_Signal_Override /end SUB_GROUP /end GROUP
/begin GROUP S5_VAPM_PASARML_enum_Inproc "SWC_OUTP_type/run_SWC_OUTP_5ms_sys/OUTP/outpmodule/VAPM_PASARML_enum_Inproc" /begin SUB_GROUP S127_Signal_Limit S127_Signal_Override /end SUB_GROUP /end GROUP
/begin GROUP S5_VAPM_PASARMR_enum_Inproc "SWC_OUTP_type/run_SWC_OUTP_5ms_sys/OUTP/outpmodule/VAPM_PASARMR_enum_Inproc" /begin SUB_GROUP S128_Signal_Limit S128_Signal_Override /end SUB_GROUP /end GROUP
/begin GROUP S5_VAPM_PASDFCL_cm_Inproc "SWC_OUTP_type/run_SWC_OUTP_5ms_sys/OUTP/outpmodule/VAPM_PASDFCL_cm_Inproc" /begin SUB_GROUP S129_Signal_Limit S129_Signal_Override /end SUB_GROUP /end GROUP
/begin GROUP S5_VAPM_PASDFCR_cm_Inproc "SWC_OUTP_type/run_SWC_OUTP_5ms_sys/OUTP/outpmodule/VAPM_PASDFCR_cm_Inproc" /begin SUB_GROUP S130_Signal_Limit S130_Signal_Override /end SUB_GROUP /end GROUP
/begin GROUP S5_VAPM_PASDFML_cm_Inproc "SWC_OUTP_type/run_SWC_OUTP_5ms_sys/OUTP/outpmodule/VAPM_PASDFML_cm_Inproc" /begin SUB_GROUP S131_Signal_Limit S131_Signal_Override /end SUB_GROUP /end GROUP
/begin GROUP S5_VAPM_PASDFMR_cm_Inproc "SWC_OUTP_type/run_SWC_OUTP_5ms_sys/OUTP/outpmodule/VAPM_PASDFMR_cm_Inproc" /begin SUB_GROUP S132_Signal_Limit S132_Signal_Override /end SUB_GROUP /end GROUP
/begin GROUP S5_VAPM_PASDRCL_cm_Inproc "SWC_OUTP_type/run_SWC_OUTP_5ms_sys/OUTP/outpmodule/VAPM_PASDRCL_cm_Inproc" /begin SUB_GROUP S133_Signal_Limit S133_Signal_Override /end SUB_GROUP /end GROUP
/begin GROUP S5_VAPM_PASDRCR_cm_Inproc "SWC_OUTP_type/run_SWC_OUTP_5ms_sys/OUTP/outpmodule/VAPM_PASDRCR_cm_Inproc" /begin SUB_GROUP S134_Signal_Limit S134_Signal_Override /end SUB_GROUP /end GROUP
/begin GROUP S5_VAPM_PASDRML_cm_Inproc "SWC_OUTP_type/run_SWC_OUTP_5ms_sys/OUTP/outpmodule/VAPM_PASDRML_cm_Inproc" /begin SUB_GROUP S135_Signal_Limit S135_Signal_Override /end SUB_GROUP /end GROUP
/begin GROUP S5_VAPM_PASDRMR_cm_Inproc "SWC_OUTP_type/run_SWC_OUTP_5ms_sys/OUTP/outpmodule/VAPM_PASDRMR_cm_Inproc" /begin SUB_GROUP S136_Signal_Limit S136_Signal_Override /end SUB_GROUP /end GROUP
/begin GROUP S5_VAPM_PUIDLowPower_flg_Inproc "SWC_OUTP_type/run_SWC_OUTP_5ms_sys/OUTP/outpmodule/VAPM_PUIDLowPower_flg_Inproc" /begin SUB_GROUP S137_Signal_Limit S137_Signal_Override /end SUB_GROUP /end GROUP
/begin GROUP S5_VAPM_RAPSBCMLamp_enum_Inproc "SWC_OUTP_type/run_SWC_OUTP_5ms_sys/OUTP/outpmodule/VAPM_RAPSBCMLamp_enum_Inproc" /begin SUB_GROUP S138_Signal_Limit S138_Signal_Override /end SUB_GROUP /end GROUP
/begin GROUP S5_VAPM_RAPSBCMLockReq_flg_Inproc "SWC_OUTP_type/run_SWC_OUTP_5ms_sys/OUTP/outpmodule/VAPM_RAPSBCMLockReq_flg_Inproc" /begin SUB_GROUP S139_Signal_Limit S139_Signal_Override /end SUB_GROUP /end GROUP
/begin GROUP S5_VAPM_RAPSErrLv1_flg_Inproc "SWC_OUTP_type/run_SWC_OUTP_5ms_sys/OUTP/outpmodule/VAPM_RAPSErrLv1_flg_Inproc" /begin SUB_GROUP S140_Signal_Limit S140_Signal_Override /end SUB_GROUP /end GROUP
/begin GROUP S5_VAPM_RAPSErrWarnSta_enum_Inproc "SWC_OUTP_type/run_SWC_OUTP_5ms_sys/OUTP/outpmodule/VAPM_RAPSErrWarnSta_enum_Inproc" /begin SUB_GROUP S141_Signal_Limit S141_Signal_Override /end SUB_GROUP /end GROUP
/begin GROUP S5_VAPM_RFPulseCountTimeOut_flg_Inproc "SWC_OUTP_type/run_SWC_OUTP_5ms_sys/OUTP/outpmodule/VAPM_RFPulseCountTimeOut_flg_Inproc" /begin SUB_GROUP S142_Signal_Limit S142_Signal_Override /end SUB_GROUP /end GROUP
/begin GROUP S5_VAPM_RFPulseCountVTimeOut_flg_Inproc "SWC_OUTP_type/run_SWC_OUTP_5ms_sys/OUTP/outpmodule/VAPM_RFPulseCountVTimeOut_flg_Inproc" /begin SUB_GROUP S143_Signal_Limit S143_Signal_Override /end SUB_GROUP /end GROUP
/begin GROUP S5_VAPM_RFPulseCountV_flg_Inproc "SWC_OUTP_type/run_SWC_OUTP_5ms_sys/OUTP/outpmodule/VAPM_RFPulseCountV_flg_Inproc" /begin SUB_GROUP S144_Signal_Limit S144_Signal_Override /end SUB_GROUP /end GROUP
/begin GROUP S5_VAPM_RFPulseCount_enum_Inproc "SWC_OUTP_type/run_SWC_OUTP_5ms_sys/OUTP/outpmodule/VAPM_RFPulseCount_enum_Inproc" /begin SUB_GROUP S145_Signal_Limit S145_Signal_Override /end SUB_GROUP /end GROUP
/begin GROUP S5_VAPM_RFRawWhlSpeedTimeOut_flg_Inproc "SWC_OUTP_type/run_SWC_OUTP_5ms_sys/OUTP/outpmodule/VAPM_RFRawWhlSpeedTimeOut_flg_Inproc" /begin SUB_GROUP S146_Signal_Limit S146_Signal_Override /end SUB_GROUP /end GROUP
/begin GROUP S5_VAPM_RFRawWhlSpeedVTimeOut_flg_Inproc "SWC_OUTP_type/run_SWC_OUTP_5ms_sys/OUTP/outpmodule/VAPM_RFRawWhlSpeedVTimeOut_flg_Inproc" /begin SUB_GROUP S147_Signal_Limit S147_Signal_Override /end SUB_GROUP /end GROUP
/begin GROUP S5_VAPM_RFRawWhlSpeedV_flg_Inproc "SWC_OUTP_type/run_SWC_OUTP_5ms_sys/OUTP/outpmodule/VAPM_RFRawWhlSpeedV_flg_Inproc" /begin SUB_GROUP S148_Signal_Limit S148_Signal_Override /end SUB_GROUP /end GROUP
/begin GROUP S5_VAPM_RFRawWhlSpeed_kph_Inproc "SWC_OUTP_type/run_SWC_OUTP_5ms_sys/OUTP/outpmodule/VAPM_RFRawWhlSpeed_kph_Inproc" /begin SUB_GROUP S149_Signal_Limit S149_Signal_Override /end SUB_GROUP /end GROUP
/begin GROUP S5_VAPM_RFWhlRotDirTimeOut_flg_Inproc "SWC_OUTP_type/run_SWC_OUTP_5ms_sys/OUTP/outpmodule/VAPM_RFWhlRotDirTimeOut_flg_Inproc" /begin SUB_GROUP S150_Signal_Limit S150_Signal_Override /end SUB_GROUP /end GROUP
/begin GROUP S5_VAPM_RFWhlRotDir_enum_Inproc "SWC_OUTP_type/run_SWC_OUTP_5ms_sys/OUTP/outpmodule/VAPM_RFWhlRotDir_enum_Inproc" /begin SUB_GROUP S151_Signal_Limit S151_Signal_Override /end SUB_GROUP /end GROUP
/begin GROUP S5_VAPM_RRPulseCountTimeOut_flg_Inproc "SWC_OUTP_type/run_SWC_OUTP_5ms_sys/OUTP/outpmodule/VAPM_RRPulseCountTimeOut_flg_Inproc" /begin SUB_GROUP S152_Signal_Limit S152_Signal_Override /end SUB_GROUP /end GROUP
/begin GROUP S5_VAPM_RRPulseCountVTimeOut_flg_Inproc "SWC_OUTP_type/run_SWC_OUTP_5ms_sys/OUTP/outpmodule/VAPM_RRPulseCountVTimeOut_flg_Inproc" /begin SUB_GROUP S153_Signal_Limit S153_Signal_Override /end SUB_GROUP /end GROUP
/begin GROUP S5_VAPM_RRPulseCountV_flg_Inproc "SWC_OUTP_type/run_SWC_OUTP_5ms_sys/OUTP/outpmodule/VAPM_RRPulseCountV_flg_Inproc" /begin SUB_GROUP S154_Signal_Limit S154_Signal_Override /end SUB_GROUP /end GROUP
/begin GROUP S5_VAPM_RRPulseCount_enum_Inproc "SWC_OUTP_type/run_SWC_OUTP_5ms_sys/OUTP/outpmodule/VAPM_RRPulseCount_enum_Inproc" /begin SUB_GROUP S155_Signal_Limit S155_Signal_Override /end SUB_GROUP /end GROUP
/begin GROUP S5_VAPM_RRRawWhlSpeedTimeOut_flg_Inproc "SWC_OUTP_type/run_SWC_OUTP_5ms_sys/OUTP/outpmodule/VAPM_RRRawWhlSpeedTimeOut_flg_Inproc" /begin SUB_GROUP S156_Signal_Limit S156_Signal_Override /end SUB_GROUP /end GROUP
/begin GROUP S5_VAPM_RRRawWhlSpeedVTimeOut_flg_Inproc "SWC_OUTP_type/run_SWC_OUTP_5ms_sys/OUTP/outpmodule/VAPM_RRRawWhlSpeedVTimeOut_flg_Inproc" /begin SUB_GROUP S157_Signal_Limit S157_Signal_Override /end SUB_GROUP /end GROUP
/begin GROUP S5_VAPM_RRRawWhlSpeedV_flg_Inproc "SWC_OUTP_type/run_SWC_OUTP_5ms_sys/OUTP/outpmodule/VAPM_RRRawWhlSpeedV_flg_Inproc" /begin SUB_GROUP S158_Signal_Limit S158_Signal_Override /end SUB_GROUP /end GROUP
/begin GROUP S5_VAPM_RRRawWhlSpeed_kph_Inproc "SWC_OUTP_type/run_SWC_OUTP_5ms_sys/OUTP/outpmodule/VAPM_RRRawWhlSpeed_kph_Inproc" /begin SUB_GROUP S159_Signal_Limit S159_Signal_Override /end SUB_GROUP /end GROUP
/begin GROUP S5_VAPM_RRWhlRotDirTimeOut_flg_Inproc "SWC_OUTP_type/run_SWC_OUTP_5ms_sys/OUTP/outpmodule/VAPM_RRWhlRotDirTimeOut_flg_Inproc" /begin SUB_GROUP S160_Signal_Limit S160_Signal_Override /end SUB_GROUP /end GROUP
/begin GROUP S5_VAPM_RRWhlRotDir_enum_Inproc "SWC_OUTP_type/run_SWC_OUTP_5ms_sys/OUTP/outpmodule/VAPM_RRWhlRotDir_enum_Inproc" /begin SUB_GROUP S161_Signal_Limit S161_Signal_Override /end SUB_GROUP /end GROUP
/begin GROUP S5_VAPM_SASAngleTimeOut_flg_Inproc "SWC_OUTP_type/run_SWC_OUTP_5ms_sys/OUTP/outpmodule/VAPM_SASAngleTimeOut_flg_Inproc" /begin SUB_GROUP S162_Signal_Limit S162_Signal_Override /end SUB_GROUP /end GROUP
/begin GROUP S5_VAPM_SASAngle_Deg_Inproc "SWC_OUTP_type/run_SWC_OUTP_5ms_sys/OUTP/outpmodule/VAPM_SASAngle_Deg_Inproc" /begin SUB_GROUP S163_Signal_Limit S163_Signal_Override /end SUB_GROUP /end GROUP
/begin GROUP S5_VAPM_SASCALTimeOut_flg_Inproc "SWC_OUTP_type/run_SWC_OUTP_5ms_sys/OUTP/outpmodule/VAPM_SASCALTimeOut_flg_Inproc" /begin SUB_GROUP S164_Signal_Limit S164_Signal_Override /end SUB_GROUP /end GROUP
/begin GROUP S5_VAPM_SASCAL_flg_Inproc "SWC_OUTP_type/run_SWC_OUTP_5ms_sys/OUTP/outpmodule/VAPM_SASCAL_flg_Inproc" /begin SUB_GROUP S165_Signal_Limit S165_Signal_Override /end SUB_GROUP /end GROUP
/begin GROUP S5_VAPM_SASSpeedTimeOut_flg_Inproc "SWC_OUTP_type/run_SWC_OUTP_5ms_sys/OUTP/outpmodule/VAPM_SASSpeedTimeOut_flg_Inproc" /begin SUB_GROUP S166_Signal_Limit S166_Signal_Override /end SUB_GROUP /end GROUP
/begin GROUP S5_VAPM_SASSpeedValidTimeOut_flg_Inproc "SWC_OUTP_type/run_SWC_OUTP_5ms_sys/OUTP/outpmodule/VAPM_SASSpeedValidTimeOut_flg_Inproc" /begin SUB_GROUP S167_Signal_Limit S167_Signal_Override /end SUB_GROUP /end GROUP
/begin GROUP S5_VAPM_SASSpeedValid_flg_Inproc "SWC_OUTP_type/run_SWC_OUTP_5ms_sys/OUTP/outpmodule/VAPM_SASSpeedValid_flg_Inproc" /begin SUB_GROUP S168_Signal_Limit S168_Signal_Override /end SUB_GROUP /end GROUP
/begin GROUP S5_VAPM_SASSpeed_degps_Inproc "SWC_OUTP_type/run_SWC_OUTP_5ms_sys/OUTP/outpmodule/VAPM_SASSpeed_degps_Inproc" /begin SUB_GROUP S169_Signal_Limit S169_Signal_Override /end SUB_GROUP /end GROUP
/begin GROUP S5_VAPM_SASVTimeOut_flg_Inproc "SWC_OUTP_type/run_SWC_OUTP_5ms_sys/OUTP/outpmodule/VAPM_SASVTimeOut_flg_Inproc" /begin SUB_GROUP S170_Signal_Limit S170_Signal_Override /end SUB_GROUP /end GROUP
/begin GROUP S5_VAPM_SASV_flg_Inproc "SWC_OUTP_type/run_SWC_OUTP_5ms_sys/OUTP/outpmodule/VAPM_SASV_flg_Inproc" /begin SUB_GROUP S171_Signal_Limit S171_Signal_Override /end SUB_GROUP /end GROUP
/begin GROUP S5_VAPM_SNSRLayout_enum_Inproc "SWC_OUTP_type/run_SWC_OUTP_5ms_sys/OUTP/outpmodule/VAPM_SNSRLayout_enum_Inproc" /begin SUB_GROUP S172_Signal_Limit S172_Signal_Override /end SUB_GROUP /end GROUP
/begin GROUP S5_VAPM_ShifterHandleCmdTimeOut_flg_Inproc "SWC_OUTP_type/run_SWC_OUTP_5ms_sys/OUTP/outpmodule/VAPM_ShifterHandleCmdTimeOut_flg_Inproc" /begin SUB_GROUP S173_Signal_Limit S173_Signal_Override /end SUB_GROUP /end GROUP
/begin GROUP S5_VAPM_ShifterHandleCmd_enum_Inproc "SWC_OUTP_type/run_SWC_OUTP_5ms_sys/OUTP/outpmodule/VAPM_ShifterHandleCmd_enum_Inproc" /begin SUB_GROUP S174_Signal_Limit S174_Signal_Override /end SUB_GROUP /end GROUP
/begin GROUP S5_VAPM_StaFSya_flg_Inproc "SWC_OUTP_type/run_SWC_OUTP_5ms_sys/OUTP/outpmodule/VAPM_StaFSya_flg_Inproc" /begin SUB_GROUP S175_Signal_Limit S175_Signal_Override /end SUB_GROUP /end GROUP
/begin GROUP S5_VAPM_TCSActiveTimeOut_flg_Inproc "SWC_OUTP_type/run_SWC_OUTP_5ms_sys/OUTP/outpmodule/VAPM_TCSActiveTimeOut_flg_Inproc" /begin SUB_GROUP S176_Signal_Limit S176_Signal_Override /end SUB_GROUP /end GROUP
/begin GROUP S5_VAPM_TCSActive_flg_Inproc "SWC_OUTP_type/run_SWC_OUTP_5ms_sys/OUTP/outpmodule/VAPM_TCSActive_flg_Inproc" /begin SUB_GROUP S177_Signal_Limit S177_Signal_Override /end SUB_GROUP /end GROUP
/begin GROUP S5_VAPM_USSStaFCL_flg_Inproc "SWC_OUTP_type/run_SWC_OUTP_5ms_sys/OUTP/outpmodule/VAPM_USSStaFCL_flg_Inproc" /begin SUB_GROUP S178_Signal_Limit S178_Signal_Override /end SUB_GROUP /end GROUP
/begin GROUP S5_VAPM_USSStaFCR_flg_Inproc "SWC_OUTP_type/run_SWC_OUTP_5ms_sys/OUTP/outpmodule/VAPM_USSStaFCR_flg_Inproc" /begin SUB_GROUP S179_Signal_Limit S179_Signal_Override /end SUB_GROUP /end GROUP
/begin GROUP S5_VAPM_USSStaFLL_flg_Inproc "SWC_OUTP_type/run_SWC_OUTP_5ms_sys/OUTP/outpmodule/VAPM_USSStaFLL_flg_Inproc" /begin SUB_GROUP S180_Signal_Limit S180_Signal_Override /end SUB_GROUP /end GROUP
/begin GROUP S5_VAPM_USSStaFLR_flg_Inproc "SWC_OUTP_type/run_SWC_OUTP_5ms_sys/OUTP/outpmodule/VAPM_USSStaFLR_flg_Inproc" /begin SUB_GROUP S181_Signal_Limit S181_Signal_Override /end SUB_GROUP /end GROUP
/begin GROUP S5_VAPM_USSStaFML_flg_Inproc "SWC_OUTP_type/run_SWC_OUTP_5ms_sys/OUTP/outpmodule/VAPM_USSStaFML_flg_Inproc" /begin SUB_GROUP S182_Signal_Limit S182_Signal_Override /end SUB_GROUP /end GROUP
/begin GROUP S5_VAPM_USSStaFMR_flg_Inproc "SWC_OUTP_type/run_SWC_OUTP_5ms_sys/OUTP/outpmodule/VAPM_USSStaFMR_flg_Inproc" /begin SUB_GROUP S183_Signal_Limit S183_Signal_Override /end SUB_GROUP /end GROUP
/begin GROUP S5_VAPM_USSStaRCL_flg_Inproc "SWC_OUTP_type/run_SWC_OUTP_5ms_sys/OUTP/outpmodule/VAPM_USSStaRCL_flg_Inproc" /begin SUB_GROUP S184_Signal_Limit S184_Signal_Override /end SUB_GROUP /end GROUP
/begin GROUP S5_VAPM_USSStaRCR_flg_Inproc "SWC_OUTP_type/run_SWC_OUTP_5ms_sys/OUTP/outpmodule/VAPM_USSStaRCR_flg_Inproc" /begin SUB_GROUP S185_Signal_Limit S185_Signal_Override /end SUB_GROUP /end GROUP
/begin GROUP S5_VAPM_USSStaRLL_flg_Inproc "SWC_OUTP_type/run_SWC_OUTP_5ms_sys/OUTP/outpmodule/VAPM_USSStaRLL_flg_Inproc" /begin SUB_GROUP S186_Signal_Limit S186_Signal_Override /end SUB_GROUP /end GROUP
/begin GROUP S5_VAPM_USSStaRLR_flg_Inproc "SWC_OUTP_type/run_SWC_OUTP_5ms_sys/OUTP/outpmodule/VAPM_USSStaRLR_flg_Inproc" /begin SUB_GROUP S187_Signal_Limit S187_Signal_Override /end SUB_GROUP /end GROUP
/begin GROUP S5_VAPM_USSStaRML_flg_Inproc "SWC_OUTP_type/run_SWC_OUTP_5ms_sys/OUTP/outpmodule/VAPM_USSStaRML_flg_Inproc" /begin SUB_GROUP S188_Signal_Limit S188_Signal_Override /end SUB_GROUP /end GROUP
/begin GROUP S5_VAPM_USSStaRMR_flg_Inproc "SWC_OUTP_type/run_SWC_OUTP_5ms_sys/OUTP/outpmodule/VAPM_USSStaRMR_flg_Inproc" /begin SUB_GROUP S189_Signal_Limit S189_Signal_Override /end SUB_GROUP /end GROUP
/begin GROUP S5_VAPM_VehSpeedTimeOut_flg_Inproc "SWC_OUTP_type/run_SWC_OUTP_5ms_sys/OUTP/outpmodule/VAPM_VehSpeedTimeOut_flg_Inproc" /begin SUB_GROUP S190_Signal_Limit S190_Signal_Override /end SUB_GROUP /end GROUP
/begin GROUP S5_VAPM_VehSpeed_kph_Inproc "SWC_OUTP_type/run_SWC_OUTP_5ms_sys/OUTP/outpmodule/VAPM_VehSpeed_kph_Inproc" /begin SUB_GROUP S191_Signal_Limit S191_Signal_Override /end SUB_GROUP /end GROUP
/begin GROUP S5_VAPM_YawRateTimeOut_flg_Inproc "SWC_OUTP_type/run_SWC_OUTP_5ms_sys/OUTP/outpmodule/VAPM_YawRateTimeOut_flg_Inproc" /begin SUB_GROUP S192_Signal_Limit S192_Signal_Override /end SUB_GROUP /end GROUP
/begin GROUP S5_VAPM_YawRateVTimeOut_flg_Inproc "SWC_OUTP_type/run_SWC_OUTP_5ms_sys/OUTP/outpmodule/VAPM_YawRateVTimeOut_flg_Inproc" /begin SUB_GROUP S193_Signal_Limit S193_Signal_Override /end SUB_GROUP /end GROUP
/begin GROUP S5_VAPM_YawRateV_flg_Inproc "SWC_OUTP_type/run_SWC_OUTP_5ms_sys/OUTP/outpmodule/VAPM_YawRateV_flg_Inproc" /begin SUB_GROUP S194_Signal_Limit S194_Signal_Override /end SUB_GROUP /end GROUP
/begin GROUP S5_VAPM_YawRate_degps_Inproc "SWC_OUTP_type/run_SWC_OUTP_5ms_sys/OUTP/outpmodule/VAPM_YawRate_degps_Inproc" /begin SUB_GROUP S195_Signal_Limit S195_Signal_Override /end SUB_GROUP /end GROUP
/begin GROUP S5_VBCM_FDCBCMBSDBuzzerCmd_flg_Inproc "SWC_OUTP_type/run_SWC_OUTP_5ms_sys/OUTP/outpmodule/VBCM_FDCBCMBSDBuzzerCmd_flg_Inproc" /begin SUB_GROUP S196_Signal_Limit S196_Signal_Override /end SUB_GROUP /end GROUP
/begin GROUP S5_VBCM_FDCBCMBrakeCmd_flg_Inproc "SWC_OUTP_type/run_SWC_OUTP_5ms_sys/OUTP/outpmodule/VBCM_FDCBCMBrakeCmd_flg_Inproc" /begin SUB_GROUP S197_Signal_Limit S197_Signal_Override /end SUB_GROUP /end GROUP
/begin GROUP S5_VBCM_FDCBCMCallBellCmd_flg_Inproc "SWC_OUTP_type/run_SWC_OUTP_5ms_sys/OUTP/outpmodule/VBCM_FDCBCMCallBellCmd_flg_Inproc" /begin SUB_GROUP S198_Signal_Limit S198_Signal_Override /end SUB_GROUP /end GROUP
/begin GROUP S5_VBCM_FDCBCMDVRSignalLCmd_flg_Inproc "SWC_OUTP_type/run_SWC_OUTP_5ms_sys/OUTP/outpmodule/VBCM_FDCBCMDVRSignalLCmd_flg_Inproc" /begin SUB_GROUP S199_Signal_Limit S199_Signal_Override /end SUB_GROUP /end GROUP
/begin GROUP S5_VBCM_FDCBCMDVRSignalRCmd_flg_Inproc "SWC_OUTP_type/run_SWC_OUTP_5ms_sys/OUTP/outpmodule/VBCM_FDCBCMDVRSignalRCmd_flg_Inproc" /begin SUB_GROUP S200_Signal_Limit S200_Signal_Override /end SUB_GROUP /end GROUP
/begin GROUP S5_VBCM_FDCBCMEmExitSWSta_flg_Inproc "SWC_OUTP_type/run_SWC_OUTP_5ms_sys/OUTP/outpmodule/VBCM_FDCBCMEmExitSWSta_flg_Inproc" /begin SUB_GROUP S201_Signal_Limit S201_Signal_Override /end SUB_GROUP /end GROUP
/begin GROUP S5_VBCM_FDCBCMEmSVCmd_flg_Inproc "SWC_OUTP_type/run_SWC_OUTP_5ms_sys/OUTP/outpmodule/VBCM_FDCBCMEmSVCmd_flg_Inproc" /begin SUB_GROUP S202_Signal_Limit S202_Signal_Override /end SUB_GROUP /end GROUP
/begin GROUP S5_VBCM_FDCBCMFDCloseSVCmd_flg_Inproc "SWC_OUTP_type/run_SWC_OUTP_5ms_sys/OUTP/outpmodule/VBCM_FDCBCMFDCloseSVCmd_flg_Inproc" /begin SUB_GROUP S203_Signal_Limit S203_Signal_Override /end SUB_GROUP /end GROUP
/begin GROUP S5_VBCM_FDCBCMFDOpenSVCmd_flg_Inproc "SWC_OUTP_type/run_SWC_OUTP_5ms_sys/OUTP/outpmodule/VBCM_FDCBCMFDOpenSVCmd_flg_Inproc" /begin SUB_GROUP S204_Signal_Limit S204_Signal_Override /end SUB_GROUP /end GROUP
/begin GROUP S5_VBCM_FDCBCMFDoorSta_flg_Inproc "SWC_OUTP_type/run_SWC_OUTP_5ms_sys/OUTP/outpmodule/VBCM_FDCBCMFDoorSta_flg_Inproc" /begin SUB_GROUP S205_Signal_Limit S205_Signal_Override /end SUB_GROUP /end GROUP
/begin GROUP S5_VBCM_FDCBCMFRoomLpCmd_pct_Inproc "SWC_OUTP_type/run_SWC_OUTP_5ms_sys/OUTP/outpmodule/VBCM_FDCBCMFRoomLpCmd_pct_Inproc" /begin SUB_GROUP S206_Signal_Limit S206_Signal_Override /end SUB_GROUP /end GROUP
/begin GROUP S5_VBCM_FDCBCMFRoomLpSetSta_pct_Inproc "SWC_OUTP_type/run_SWC_OUTP_5ms_sys/OUTP/outpmodule/VBCM_FDCBCMFRoomLpSetSta_pct_Inproc" /begin SUB_GROUP S207_Signal_Limit S207_Signal_Override /end SUB_GROUP /end GROUP
/begin GROUP S5_VBCM_FDCBCMHBeamCmd_flg_Inproc "SWC_OUTP_type/run_SWC_OUTP_5ms_sys/OUTP/outpmodule/VBCM_FDCBCMHBeamCmd_flg_Inproc" /begin SUB_GROUP S208_Signal_Limit S208_Signal_Override /end SUB_GROUP /end GROUP
/begin GROUP S5_VBCM_FDCBCMHelpINDCmd_flg_Inproc "SWC_OUTP_type/run_SWC_OUTP_5ms_sys/OUTP/outpmodule/VBCM_FDCBCMHelpINDCmd_flg_Inproc" /begin SUB_GROUP S209_Signal_Limit S209_Signal_Override /end SUB_GROUP /end GROUP
/begin GROUP S5_VBCM_FDCBCMInnerBuzzerCmd_flg_Inproc "SWC_OUTP_type/run_SWC_OUTP_5ms_sys/OUTP/outpmodule/VBCM_FDCBCMInnerBuzzerCmd_flg_Inproc" /begin SUB_GROUP S210_Signal_Limit S210_Signal_Override /end SUB_GROUP /end GROUP
/begin GROUP S5_VBCM_FDCBCMInnerCallBellCmd_flg_Inproc "SWC_OUTP_type/run_SWC_OUTP_5ms_sys/OUTP/outpmodule/VBCM_FDCBCMInnerCallBellCmd_flg_Inproc" /begin SUB_GROUP S211_Signal_Limit S211_Signal_Override /end SUB_GROUP /end GROUP
/begin GROUP S5_VBCM_FDCBCMLBSDRCmd_flg_Inproc "SWC_OUTP_type/run_SWC_OUTP_5ms_sys/OUTP/outpmodule/VBCM_FDCBCMLBSDRCmd_flg_Inproc" /begin SUB_GROUP S212_Signal_Limit S212_Signal_Override /end SUB_GROUP /end GROUP
/begin GROUP S5_VBCM_FDCBCMLBSDYCmd_flg_Inproc "SWC_OUTP_type/run_SWC_OUTP_5ms_sys/OUTP/outpmodule/VBCM_FDCBCMLBSDYCmd_flg_Inproc" /begin SUB_GROUP S213_Signal_Limit S213_Signal_Override /end SUB_GROUP /end GROUP
/begin GROUP S5_VBCM_FDCBCMLBeamCmd_flg_Inproc "SWC_OUTP_type/run_SWC_OUTP_5ms_sys/OUTP/outpmodule/VBCM_FDCBCMLBeamCmd_flg_Inproc" /begin SUB_GROUP S214_Signal_Limit S214_Signal_Override /end SUB_GROUP /end GROUP
/begin GROUP S5_VBCM_FDCBCMLDRLCmd_flg_Inproc "SWC_OUTP_type/run_SWC_OUTP_5ms_sys/OUTP/outpmodule/VBCM_FDCBCMLDRLCmd_flg_Inproc" /begin SUB_GROUP S215_Signal_Limit S215_Signal_Override /end SUB_GROUP /end GROUP
/begin GROUP S5_VBCM_FDCBCMLTurnLpCmd_flg_Inproc "SWC_OUTP_type/run_SWC_OUTP_5ms_sys/OUTP/outpmodule/VBCM_FDCBCMLTurnLpCmd_flg_Inproc" /begin SUB_GROUP S216_Signal_Limit S216_Signal_Override /end SUB_GROUP /end GROUP
/begin GROUP S5_VBCM_FDCBCMLTurnSWSta_flg_Inproc "SWC_OUTP_type/run_SWC_OUTP_5ms_sys/OUTP/outpmodule/VBCM_FDCBCMLTurnSWSta_flg_Inproc" /begin SUB_GROUP S217_Signal_Limit S217_Signal_Override /end SUB_GROUP /end GROUP
/begin GROUP S5_VBCM_FDCBCMMDCloseSVCmd_flg_Inproc "SWC_OUTP_type/run_SWC_OUTP_5ms_sys/OUTP/outpmodule/VBCM_FDCBCMMDCloseSVCmd_flg_Inproc" /begin SUB_GROUP S218_Signal_Limit S218_Signal_Override /end SUB_GROUP /end GROUP
/begin GROUP S5_VBCM_FDCBCMMDOpenSVCmd_flg_Inproc "SWC_OUTP_type/run_SWC_OUTP_5ms_sys/OUTP/outpmodule/VBCM_FDCBCMMDOpenSVCmd_flg_Inproc" /begin SUB_GROUP S219_Signal_Limit S219_Signal_Override /end SUB_GROUP /end GROUP
/begin GROUP S5_VBCM_FDCBCMMDoorSta_flg_Inproc "SWC_OUTP_type/run_SWC_OUTP_5ms_sys/OUTP/outpmodule/VBCM_FDCBCMMDoorSta_flg_Inproc" /begin SUB_GROUP S220_Signal_Limit S220_Signal_Override /end SUB_GROUP /end GROUP
/begin GROUP S5_VBCM_FDCBCMMRoomLpCmd_pct_Inproc "SWC_OUTP_type/run_SWC_OUTP_5ms_sys/OUTP/outpmodule/VBCM_FDCBCMMRoomLpCmd_pct_Inproc" /begin SUB_GROUP S221_Signal_Limit S221_Signal_Override /end SUB_GROUP /end GROUP
/begin GROUP S5_VBCM_FDCBCMMRoomLpSetSta_pct_Inproc "SWC_OUTP_type/run_SWC_OUTP_5ms_sys/OUTP/outpmodule/VBCM_FDCBCMMRoomLpSetSta_pct_Inproc" /begin SUB_GROUP S222_Signal_Limit S222_Signal_Override /end SUB_GROUP /end GROUP
/begin GROUP S5_VBCM_FDCBCMOSDrOpenSWSta_enum_Inproc "SWC_OUTP_type/run_SWC_OUTP_5ms_sys/OUTP/outpmodule/VBCM_FDCBCMOSDrOpenSWSta_enum_Inproc" /begin SUB_GROUP S223_Signal_Limit S223_Signal_Override /end SUB_GROUP /end GROUP
/begin GROUP S5_VBCM_FDCBCMPLampCmd_flg_Inproc "SWC_OUTP_type/run_SWC_OUTP_5ms_sys/OUTP/outpmodule/VBCM_FDCBCMPLampCmd_flg_Inproc" /begin SUB_GROUP S224_Signal_Limit S224_Signal_Override /end SUB_GROUP /end GROUP
/begin GROUP S5_VBCM_FDCBCMRBSDRCmd_flg_Inproc "SWC_OUTP_type/run_SWC_OUTP_5ms_sys/OUTP/outpmodule/VBCM_FDCBCMRBSDRCmd_flg_Inproc" /begin SUB_GROUP S225_Signal_Limit S225_Signal_Override /end SUB_GROUP /end GROUP
/begin GROUP S5_VBCM_FDCBCMRBSDYCmd_flg_Inproc "SWC_OUTP_type/run_SWC_OUTP_5ms_sys/OUTP/outpmodule/VBCM_FDCBCMRBSDYCmd_flg_Inproc" /begin SUB_GROUP S226_Signal_Limit S226_Signal_Override /end SUB_GROUP /end GROUP
/begin GROUP S5_VBCM_FDCBCMRDRLCmd_flg_Inproc "SWC_OUTP_type/run_SWC_OUTP_5ms_sys/OUTP/outpmodule/VBCM_FDCBCMRDRLCmd_flg_Inproc" /begin SUB_GROUP S227_Signal_Limit S227_Signal_Override /end SUB_GROUP /end GROUP
/begin GROUP S5_VBCM_FDCBCMRDoorSta_flg_Inproc "SWC_OUTP_type/run_SWC_OUTP_5ms_sys/OUTP/outpmodule/VBCM_FDCBCMRDoorSta_flg_Inproc" /begin SUB_GROUP S228_Signal_Limit S228_Signal_Override /end SUB_GROUP /end GROUP
/begin GROUP S5_VBCM_FDCBCMRFLampCmd_flg_Inproc "SWC_OUTP_type/run_SWC_OUTP_5ms_sys/OUTP/outpmodule/VBCM_FDCBCMRFLampCmd_flg_Inproc" /begin SUB_GROUP S229_Signal_Limit S229_Signal_Override /end SUB_GROUP /end GROUP
/begin GROUP S5_VBCM_FDCBCMRGearSta_flg_Inproc "SWC_OUTP_type/run_SWC_OUTP_5ms_sys/OUTP/outpmodule/VBCM_FDCBCMRGearSta_flg_Inproc" /begin SUB_GROUP S230_Signal_Limit S230_Signal_Override /end SUB_GROUP /end GROUP
/begin GROUP S5_VBCM_FDCBCMRRoomLpCmd_pct_Inproc "SWC_OUTP_type/run_SWC_OUTP_5ms_sys/OUTP/outpmodule/VBCM_FDCBCMRRoomLpCmd_pct_Inproc" /begin SUB_GROUP S231_Signal_Limit S231_Signal_Override /end SUB_GROUP /end GROUP
/begin GROUP S5_VBCM_FDCBCMRRoomLpSetSta_pct_Inproc "SWC_OUTP_type/run_SWC_OUTP_5ms_sys/OUTP/outpmodule/VBCM_FDCBCMRRoomLpSetSta_pct_Inproc" /begin SUB_GROUP S232_Signal_Limit S232_Signal_Override /end SUB_GROUP /end GROUP
/begin GROUP S5_VBCM_FDCBCMRTurnLpCmd_flg_Inproc "SWC_OUTP_type/run_SWC_OUTP_5ms_sys/OUTP/outpmodule/VBCM_FDCBCMRTurnLpCmd_flg_Inproc" /begin SUB_GROUP S233_Signal_Limit S233_Signal_Override /end SUB_GROUP /end GROUP
/begin GROUP S5_VBCM_FDCBCMRTurnSWSta_flg_Inproc "SWC_OUTP_type/run_SWC_OUTP_5ms_sys/OUTP/outpmodule/VBCM_FDCBCMRTurnSWSta_flg_Inproc" /begin SUB_GROUP S234_Signal_Limit S234_Signal_Override /end SUB_GROUP /end GROUP
/begin GROUP S5_VBCM_FDCBCMRoomLpAmbCmd_flg_Inproc "SWC_OUTP_type/run_SWC_OUTP_5ms_sys/OUTP/outpmodule/VBCM_FDCBCMRoomLpAmbCmd_flg_Inproc" /begin SUB_GROUP S235_Signal_Limit S235_Signal_Override /end SUB_GROUP /end GROUP
/begin GROUP S5_VBCM_FDCBCMRoomLpAmbSetSta_flg_Inproc "SWC_OUTP_type/run_SWC_OUTP_5ms_sys/OUTP/outpmodule/VBCM_FDCBCMRoomLpAmbSetSta_flg_Inproc" /begin SUB_GROUP S236_Signal_Limit S236_Signal_Override /end SUB_GROUP /end GROUP
/begin GROUP S5_VBCM_FDCBCMRoomLpSetSta_flg_Inproc "SWC_OUTP_type/run_SWC_OUTP_5ms_sys/OUTP/outpmodule/VBCM_FDCBCMRoomLpSetSta_flg_Inproc" /begin SUB_GROUP S237_Signal_Limit S237_Signal_Override /end SUB_GROUP /end GROUP
/begin GROUP S5_VBCM_FDCBCMSLTLpCmd_flg_Inproc "SWC_OUTP_type/run_SWC_OUTP_5ms_sys/OUTP/outpmodule/VBCM_FDCBCMSLTLpCmd_flg_Inproc" /begin SUB_GROUP S238_Signal_Limit S238_Signal_Override /end SUB_GROUP /end GROUP
/begin GROUP S5_VBCM_FDCBCMSMKLCmd_flg_Inproc "SWC_OUTP_type/run_SWC_OUTP_5ms_sys/OUTP/outpmodule/VBCM_FDCBCMSMKLCmd_flg_Inproc" /begin SUB_GROUP S239_Signal_Limit S239_Signal_Override /end SUB_GROUP /end GROUP
/begin GROUP S5_VBCM_FDCBCMSMKRCmd_flg_Inproc "SWC_OUTP_type/run_SWC_OUTP_5ms_sys/OUTP/outpmodule/VBCM_FDCBCMSMKRCmd_flg_Inproc" /begin SUB_GROUP S240_Signal_Limit S240_Signal_Override /end SUB_GROUP /end GROUP
/begin GROUP S5_VBCM_FDCBCMSRTLpCmd_flg_Inproc "SWC_OUTP_type/run_SWC_OUTP_5ms_sys/OUTP/outpmodule/VBCM_FDCBCMSRTLpCmd_flg_Inproc" /begin SUB_GROUP S241_Signal_Limit S241_Signal_Override /end SUB_GROUP /end GROUP
/begin GROUP S5_VBCM_FDCBCMSTOPBALLCmd_flg_Inproc "SWC_OUTP_type/run_SWC_OUTP_5ms_sys/OUTP/outpmodule/VBCM_FDCBCMSTOPBALLCmd_flg_Inproc" /begin SUB_GROUP S242_Signal_Limit S242_Signal_Override /end SUB_GROUP /end GROUP
/begin GROUP S5_VBCM_FDCBCMStopINDCmd_flg_Inproc "SWC_OUTP_type/run_SWC_OUTP_5ms_sys/OUTP/outpmodule/VBCM_FDCBCMStopINDCmd_flg_Inproc" /begin SUB_GROUP S243_Signal_Limit S243_Signal_Override /end SUB_GROUP /end GROUP
/begin GROUP S5_VBCM_FDCBCMTurnBuzzerENSta_flg_Inproc "SWC_OUTP_type/run_SWC_OUTP_5ms_sys/OUTP/outpmodule/VBCM_FDCBCMTurnBuzzerENSta_flg_Inproc" /begin SUB_GROUP S244_Signal_Limit S244_Signal_Override /end SUB_GROUP /end GROUP
/begin GROUP S5_VBCM_FDCBCMWasherCmd_flg_Inproc "SWC_OUTP_type/run_SWC_OUTP_5ms_sys/OUTP/outpmodule/VBCM_FDCBCMWasherCmd_flg_Inproc" /begin SUB_GROUP S245_Signal_Limit S245_Signal_Override /end SUB_GROUP /end GROUP
/begin GROUP S5_VBCM_FDCBCMWiperHCmd_flg_Inproc "SWC_OUTP_type/run_SWC_OUTP_5ms_sys/OUTP/outpmodule/VBCM_FDCBCMWiperHCmd_flg_Inproc" /begin SUB_GROUP S246_Signal_Limit S246_Signal_Override /end SUB_GROUP /end GROUP
/begin GROUP S5_VBCM_FDCBCMWiperLCmd_flg_Inproc "SWC_OUTP_type/run_SWC_OUTP_5ms_sys/OUTP/outpmodule/VBCM_FDCBCMWiperLCmd_flg_Inproc" /begin SUB_GROUP S247_Signal_Limit S247_Signal_Override /end SUB_GROUP /end GROUP
/begin GROUP S5_VBCM_InnerBuzzerModeSta_enum_Inproc "SWC_OUTP_type/run_SWC_OUTP_5ms_sys/OUTP/outpmodule/VBCM_InnerBuzzerModeSta_enum_Inproc" /begin SUB_GROUP S248_Signal_Limit S248_Signal_Override /end SUB_GROUP /end GROUP
/begin GROUP S5_VBCM_KeepWakeUp_flg_Inproc "SWC_OUTP_type/run_SWC_OUTP_5ms_sys/OUTP/outpmodule/VBCM_KeepWakeUp_flg_Inproc" /begin SUB_GROUP S249_Signal_Limit S249_Signal_Override /end SUB_GROUP /end GROUP
/begin GROUP S5_VBCM_TurnLpPatternSta_enum_Inproc "SWC_OUTP_type/run_SWC_OUTP_5ms_sys/OUTP/outpmodule/VBCM_TurnLpPatternSta_enum_Inproc" /begin SUB_GROUP S250_Signal_Limit S250_Signal_Override /end SUB_GROUP /end GROUP
/begin GROUP S5_VBCM_WakeUp_flg_Inproc "SWC_OUTP_type/run_SWC_OUTP_5ms_sys/OUTP/outpmodule/VBCM_WakeUp_flg_Inproc" /begin SUB_GROUP S251_Signal_Limit S251_Signal_Override /end SUB_GROUP /end GROUP
/begin GROUP S5_VDDM_5vAPS1PwrErrDTC_raw32_Inproc "SWC_OUTP_type/run_SWC_OUTP_5ms_sys/OUTP/outpmodule/VDDM_5vAPS1PwrErrDTC_raw32_Inproc" /begin SUB_GROUP S252_Signal_Limit S252_Signal_Override /end SUB_GROUP /end GROUP
/begin GROUP S5_VDDM_5vAPS2PwrErrDTC_raw32_Inproc "SWC_OUTP_type/run_SWC_OUTP_5ms_sys/OUTP/outpmodule/VDDM_5vAPS2PwrErrDTC_raw32_Inproc" /begin SUB_GROUP S253_Signal_Limit S253_Signal_Override /end SUB_GROUP /end GROUP
/begin GROUP S5_VDDM_ACCAccelCmdErrDetDTC_raw32_Inproc "SWC_OUTP_type/run_SWC_OUTP_5ms_sys/OUTP/outpmodule/VDDM_ACCAccelCmdErrDetDTC_raw32_Inproc" /begin SUB_GROUP S254_Signal_Limit S254_Signal_Override /end SUB_GROUP /end GROUP
/begin GROUP S5_VDDM_ACCMalfuncDetDTC_raw32_Inproc "SWC_OUTP_type/run_SWC_OUTP_5ms_sys/OUTP/outpmodule/VDDM_ACCMalfuncDetDTC_raw32_Inproc" /begin SUB_GROUP S255_Signal_Limit S255_Signal_Override /end SUB_GROUP /end GROUP
/begin GROUP S5_VDDM_APS1SigOoRDTC_raw32_Inproc "SWC_OUTP_type/run_SWC_OUTP_5ms_sys/OUTP/outpmodule/VDDM_APS1SigOoRDTC_raw32_Inproc" /begin SUB_GROUP S256_Signal_Limit S256_Signal_Override /end SUB_GROUP /end GROUP
/begin GROUP S5_VDDM_APS2SigOoRDTC_raw32_Inproc "SWC_OUTP_type/run_SWC_OUTP_5ms_sys/OUTP/outpmodule/VDDM_APS2SigOoRDTC_raw32_Inproc" /begin SUB_GROUP S257_Signal_Limit S257_Signal_Override /end SUB_GROUP /end GROUP
/begin GROUP S5_VDDM_APSCorrErrDTC_raw32_Inproc "SWC_OUTP_type/run_SWC_OUTP_5ms_sys/OUTP/outpmodule/VDDM_APSCorrErrDTC_raw32_Inproc" /begin SUB_GROUP S258_Signal_Limit S258_Signal_Override /end SUB_GROUP /end GROUP
/begin GROUP S5_VDDM_BMSRdyDTC_raw32_Inproc "SWC_OUTP_type/run_SWC_OUTP_5ms_sys/OUTP/outpmodule/VDDM_BMSRdyDTC_raw32_Inproc" /begin SUB_GROUP S259_Signal_Limit S259_Signal_Override /end SUB_GROUP /end GROUP
/begin GROUP S5_VDDM_BMSSigErrDetDTC_raw32_Inproc "SWC_OUTP_type/run_SWC_OUTP_5ms_sys/OUTP/outpmodule/VDDM_BMSSigErrDetDTC_raw32_Inproc" /begin SUB_GROUP S260_Signal_Limit S260_Signal_Override /end SUB_GROUP /end GROUP
/begin GROUP S5_VDDM_BrkSWErrDTC_raw32_Inproc "SWC_OUTP_type/run_SWC_OUTP_5ms_sys/OUTP/outpmodule/VDDM_BrkSWErrDTC_raw32_Inproc" /begin SUB_GROUP S261_Signal_Limit S261_Signal_Override /end SUB_GROUP /end GROUP
/begin GROUP S5_VDDM_BrkSWNoBacDTC_raw32_Inproc "SWC_OUTP_type/run_SWC_OUTP_5ms_sys/OUTP/outpmodule/VDDM_BrkSWNoBacDTC_raw32_Inproc" /begin SUB_GROUP S262_Signal_Limit S262_Signal_Override /end SUB_GROUP /end GROUP
/begin GROUP S5_VDDM_C1ABM1CSDTC_raw32_Inproc "SWC_OUTP_type/run_SWC_OUTP_5ms_sys/OUTP/outpmodule/VDDM_C1ABM1CSDTC_raw32_Inproc" /begin SUB_GROUP S263_Signal_Limit S263_Signal_Override /end SUB_GROUP /end GROUP
/begin GROUP S5_VDDM_C1ABM1LCDTC_raw32_Inproc "SWC_OUTP_type/run_SWC_OUTP_5ms_sys/OUTP/outpmodule/VDDM_C1ABM1LCDTC_raw32_Inproc" /begin SUB_GROUP S264_Signal_Limit S264_Signal_Override /end SUB_GROUP /end GROUP
/begin GROUP S5_VDDM_C1ABM1RCDTC_raw32_Inproc "SWC_OUTP_type/run_SWC_OUTP_5ms_sys/OUTP/outpmodule/VDDM_C1ABM1RCDTC_raw32_Inproc" /begin SUB_GROUP S265_Signal_Limit S265_Signal_Override /end SUB_GROUP /end GROUP
/begin GROUP S5_VDDM_C1EPAS2LCDTC_raw32_Inproc "SWC_OUTP_type/run_SWC_OUTP_5ms_sys/OUTP/outpmodule/VDDM_C1EPAS2LCDTC_raw32_Inproc" /begin SUB_GROUP S266_Signal_Limit S266_Signal_Override /end SUB_GROUP /end GROUP
/begin GROUP S5_VDDM_C3BMS1CSDTC_raw32_Inproc "SWC_OUTP_type/run_SWC_OUTP_5ms_sys/OUTP/outpmodule/VDDM_C3BMS1CSDTC_raw32_Inproc" /begin SUB_GROUP S267_Signal_Limit S267_Signal_Override /end SUB_GROUP /end GROUP
/begin GROUP S5_VDDM_C3BMS1LCDTC_raw32_Inproc "SWC_OUTP_type/run_SWC_OUTP_5ms_sys/OUTP/outpmodule/VDDM_C3BMS1LCDTC_raw32_Inproc" /begin SUB_GROUP S268_Signal_Limit S268_Signal_Override /end SUB_GROUP /end GROUP
/begin GROUP S5_VDDM_C3BMS1RCDTC_raw32_Inproc "SWC_OUTP_type/run_SWC_OUTP_5ms_sys/OUTP/outpmodule/VDDM_C3BMS1RCDTC_raw32_Inproc" /begin SUB_GROUP S269_Signal_Limit S269_Signal_Override /end SUB_GROUP /end GROUP
/begin GROUP S5_VDDM_C3BMS6CSDTC_raw32_Inproc "SWC_OUTP_type/run_SWC_OUTP_5ms_sys/OUTP/outpmodule/VDDM_C3BMS6CSDTC_raw32_Inproc" /begin SUB_GROUP S270_Signal_Limit S270_Signal_Override /end SUB_GROUP /end GROUP
/begin GROUP S5_VDDM_C3BMS6LCDTC_raw32_Inproc "SWC_OUTP_type/run_SWC_OUTP_5ms_sys/OUTP/outpmodule/VDDM_C3BMS6LCDTC_raw32_Inproc" /begin SUB_GROUP S271_Signal_Limit S271_Signal_Override /end SUB_GROUP /end GROUP
/begin GROUP S5_VDDM_C3BMS6RCDTC_raw32_Inproc "SWC_OUTP_type/run_SWC_OUTP_5ms_sys/OUTP/outpmodule/VDDM_C3BMS6RCDTC_raw32_Inproc" /begin SUB_GROUP S272_Signal_Limit S272_Signal_Override /end SUB_GROUP /end GROUP
/begin GROUP S5_VDDM_C3CCU1CSDTC_raw32_Inproc "SWC_OUTP_type/run_SWC_OUTP_5ms_sys/OUTP/outpmodule/VDDM_C3CCU1CSDTC_raw32_Inproc" /begin SUB_GROUP S273_Signal_Limit S273_Signal_Override /end SUB_GROUP /end GROUP
/begin GROUP S5_VDDM_C3CCU1LCDTC_raw32_Inproc "SWC_OUTP_type/run_SWC_OUTP_5ms_sys/OUTP/outpmodule/VDDM_C3CCU1LCDTC_raw32_Inproc" /begin SUB_GROUP S274_Signal_Limit S274_Signal_Override /end SUB_GROUP /end GROUP
/begin GROUP S5_VDDM_C3CCU1RCDTC_raw32_Inproc "SWC_OUTP_type/run_SWC_OUTP_5ms_sys/OUTP/outpmodule/VDDM_C3CCU1RCDTC_raw32_Inproc" /begin SUB_GROUP S275_Signal_Limit S275_Signal_Override /end SUB_GROUP /end GROUP
/begin GROUP S5_VDDM_C3CCU2CSDTC_raw32_Inproc "SWC_OUTP_type/run_SWC_OUTP_5ms_sys/OUTP/outpmodule/VDDM_C3CCU2CSDTC_raw32_Inproc" /begin SUB_GROUP S276_Signal_Limit S276_Signal_Override /end SUB_GROUP /end GROUP
/begin GROUP S5_VDDM_C3CCU2LCDTC_raw32_Inproc "SWC_OUTP_type/run_SWC_OUTP_5ms_sys/OUTP/outpmodule/VDDM_C3CCU2LCDTC_raw32_Inproc" /begin SUB_GROUP S277_Signal_Limit S277_Signal_Override /end SUB_GROUP /end GROUP
/begin GROUP S5_VDDM_C3CCU2RCDTC_raw32_Inproc "SWC_OUTP_type/run_SWC_OUTP_5ms_sys/OUTP/outpmodule/VDDM_C3CCU2RCDTC_raw32_Inproc" /begin SUB_GROUP S278_Signal_Limit S278_Signal_Override /end SUB_GROUP /end GROUP
/begin GROUP S5_VDDM_CCMalfuncDetDTC_raw32_Inproc "SWC_OUTP_type/run_SWC_OUTP_5ms_sys/OUTP/outpmodule/VDDM_CCMalfuncDetDTC_raw32_Inproc" /begin SUB_GROUP S279_Signal_Limit S279_Signal_Override /end SUB_GROUP /end GROUP
/begin GROUP S5_VDDM_CCUSigErrDetDTC_raw32_Inproc "SWC_OUTP_type/run_SWC_OUTP_5ms_sys/OUTP/outpmodule/VDDM_CCUSigErrDetDTC_raw32_Inproc" /begin SUB_GROUP S280_Signal_Limit S280_Signal_Override /end SUB_GROUP /end GROUP
/begin GROUP S5_VDDM_DCDC4PreDTC_raw32_Inproc "SWC_OUTP_type/run_SWC_OUTP_5ms_sys/OUTP/outpmodule/VDDM_DCDC4PreDTC_raw32_Inproc" /begin SUB_GROUP S281_Signal_Limit S281_Signal_Override /end SUB_GROUP /end GROUP
/begin GROUP S5_VDDM_DCDCDisDTC_raw32_Inproc "SWC_OUTP_type/run_SWC_OUTP_5ms_sys/OUTP/outpmodule/VDDM_DCDCDisDTC_raw32_Inproc" /begin SUB_GROUP S282_Signal_Limit S282_Signal_Override /end SUB_GROUP /end GROUP
/begin GROUP S5_VDDM_DCDCEnaDTC_raw32_Inproc "SWC_OUTP_type/run_SWC_OUTP_5ms_sys/OUTP/outpmodule/VDDM_DCDCEnaDTC_raw32_Inproc" /begin SUB_GROUP S283_Signal_Limit S283_Signal_Override /end SUB_GROUP /end GROUP
/begin GROUP S5_VDDM_DTCDetect_enum_Inproc "SWC_OUTP_type/run_SWC_OUTP_5ms_sys/OUTP/outpmodule/VDDM_DTCDetect_enum_Inproc" /begin SUB_GROUP S284_Signal_Limit S284_Signal_Override /end SUB_GROUP /end GROUP
/begin GROUP S5_VDDM_DiagFLTSDTC_raw32_Inproc "SWC_OUTP_type/run_SWC_OUTP_5ms_sys/OUTP/outpmodule/VDDM_DiagFLTSDTC_raw32_Inproc" /begin SUB_GROUP S285_Signal_Limit S285_Signal_Override /end SUB_GROUP /end GROUP
/begin GROUP S5_VDDM_DiagFRTSDTC_raw32_Inproc "SWC_OUTP_type/run_SWC_OUTP_5ms_sys/OUTP/outpmodule/VDDM_DiagFRTSDTC_raw32_Inproc" /begin SUB_GROUP S286_Signal_Limit S286_Signal_Override /end SUB_GROUP /end GROUP
/begin GROUP S5_VDDM_DiagHCrashDTC_raw32_Inproc "SWC_OUTP_type/run_SWC_OUTP_5ms_sys/OUTP/outpmodule/VDDM_DiagHCrashDTC_raw32_Inproc" /begin SUB_GROUP S287_Signal_Limit S287_Signal_Override /end SUB_GROUP /end GROUP
/begin GROUP S5_VDDM_DiagRLTSDTC_raw32_Inproc "SWC_OUTP_type/run_SWC_OUTP_5ms_sys/OUTP/outpmodule/VDDM_DiagRLTSDTC_raw32_Inproc" /begin SUB_GROUP S288_Signal_Limit S288_Signal_Override /end SUB_GROUP /end GROUP
/begin GROUP S5_VDDM_DiagRRTSDTC_raw32_Inproc "SWC_OUTP_type/run_SWC_OUTP_5ms_sys/OUTP/outpmodule/VDDM_DiagRRTSDTC_raw32_Inproc" /begin SUB_GROUP S289_Signal_Limit S289_Signal_Override /end SUB_GROUP /end GROUP
/begin GROUP S5_VDDM_DisengagePFail_flg_Inproc "SWC_OUTP_type/run_SWC_OUTP_5ms_sys/OUTP/outpmodule/VDDM_DisengagePFail_flg_Inproc" /begin SUB_GROUP S290_Signal_Limit S290_Signal_Override /end SUB_GROUP /end GROUP
/begin GROUP S5_VDDM_DrStSWDTC_raw32_Inproc "SWC_OUTP_type/run_SWC_OUTP_5ms_sys/OUTP/outpmodule/VDDM_DrStSWDTC_raw32_Inproc" /begin SUB_GROUP S291_Signal_Limit S291_Signal_Override /end SUB_GROUP /end GROUP
/begin GROUP S5_VDDM_EDriveSysErrShifterErr_flg_Inproc "SWC_OUTP_type/run_SWC_OUTP_5ms_sys/OUTP/outpmodule/VDDM_EDriveSysErrShifterErr_flg_Inproc" /begin SUB_GROUP S292_Signal_Limit S292_Signal_Override /end SUB_GROUP /end GROUP
/begin GROUP S5_VDDM_EDriveSysErrVCUErr_flg_Inproc "SWC_OUTP_type/run_SWC_OUTP_5ms_sys/OUTP/outpmodule/VDDM_EDriveSysErrVCUErr_flg_Inproc" /begin SUB_GROUP S293_Signal_Limit S293_Signal_Override /end SUB_GROUP /end GROUP
/begin GROUP S5_VDDM_EPBLockTODTC_raw32_Inproc "SWC_OUTP_type/run_SWC_OUTP_5ms_sys/OUTP/outpmodule/VDDM_EPBLockTODTC_raw32_Inproc" /begin SUB_GROUP S294_Signal_Limit S294_Signal_Override /end SUB_GROUP /end GROUP
/begin GROUP S5_VDDM_EPBUnlockTODTC_raw32_Inproc "SWC_OUTP_type/run_SWC_OUTP_5ms_sys/OUTP/outpmodule/VDDM_EPBUnlockTODTC_raw32_Inproc" /begin SUB_GROUP S295_Signal_Limit S295_Signal_Override /end SUB_GROUP /end GROUP
/begin GROUP S5_VDDM_ESC1CSErrDTC_raw32_Inproc "SWC_OUTP_type/run_SWC_OUTP_5ms_sys/OUTP/outpmodule/VDDM_ESC1CSErrDTC_raw32_Inproc" /begin SUB_GROUP S296_Signal_Limit S296_Signal_Override /end SUB_GROUP /end GROUP
/begin GROUP S5_VDDM_ESC1NoComDTC_raw32_Inproc "SWC_OUTP_type/run_SWC_OUTP_5ms_sys/OUTP/outpmodule/VDDM_ESC1NoComDTC_raw32_Inproc" /begin SUB_GROUP S297_Signal_Limit S297_Signal_Override /end SUB_GROUP /end GROUP
/begin GROUP S5_VDDM_ESC1RCErrDTC_raw32_Inproc "SWC_OUTP_type/run_SWC_OUTP_5ms_sys/OUTP/outpmodule/VDDM_ESC1RCErrDTC_raw32_Inproc" /begin SUB_GROUP S298_Signal_Limit S298_Signal_Override /end SUB_GROUP /end GROUP
/begin GROUP S5_VDDM_ESC5CSErrDTC_raw32_Inproc "SWC_OUTP_type/run_SWC_OUTP_5ms_sys/OUTP/outpmodule/VDDM_ESC5CSErrDTC_raw32_Inproc" /begin SUB_GROUP S299_Signal_Limit S299_Signal_Override /end SUB_GROUP /end GROUP
/begin GROUP S5_VDDM_ESC5NoComDTC_raw32_Inproc "SWC_OUTP_type/run_SWC_OUTP_5ms_sys/OUTP/outpmodule/VDDM_ESC5NoComDTC_raw32_Inproc" /begin SUB_GROUP S300_Signal_Limit S300_Signal_Override /end SUB_GROUP /end GROUP
/begin GROUP S5_VDDM_ESC5RCErrDTC_raw32_Inproc "SWC_OUTP_type/run_SWC_OUTP_5ms_sys/OUTP/outpmodule/VDDM_ESC5RCErrDTC_raw32_Inproc" /begin SUB_GROUP S301_Signal_Limit S301_Signal_Override /end SUB_GROUP /end GROUP
/begin GROUP S5_VDDM_ESC7CSErrDTC_raw32_Inproc "SWC_OUTP_type/run_SWC_OUTP_5ms_sys/OUTP/outpmodule/VDDM_ESC7CSErrDTC_raw32_Inproc" /begin SUB_GROUP S302_Signal_Limit S302_Signal_Override /end SUB_GROUP /end GROUP
/begin GROUP S5_VDDM_ESC7NoComDTC_raw32_Inproc "SWC_OUTP_type/run_SWC_OUTP_5ms_sys/OUTP/outpmodule/VDDM_ESC7NoComDTC_raw32_Inproc" /begin SUB_GROUP S303_Signal_Limit S303_Signal_Override /end SUB_GROUP /end GROUP
/begin GROUP S5_VDDM_ESC7RCErrDTC_raw32_Inproc "SWC_OUTP_type/run_SWC_OUTP_5ms_sys/OUTP/outpmodule/VDDM_ESC7RCErrDTC_raw32_Inproc" /begin SUB_GROUP S304_Signal_Limit S304_Signal_Override /end SUB_GROUP /end GROUP
/begin GROUP S5_VDDM_EngagePFail_flg_Inproc "SWC_OUTP_type/run_SWC_OUTP_5ms_sys/OUTP/outpmodule/VDDM_EngagePFail_flg_Inproc" /begin SUB_GROUP S305_Signal_Limit S305_Signal_Override /end SUB_GROUP /end GROUP
/begin GROUP S5_VDDM_EnterNewOperCyc_flg_Inproc "SWC_OUTP_type/run_SWC_OUTP_5ms_sys/OUTP/outpmodule/VDDM_EnterNewOperCyc_flg_Inproc" /begin SUB_GROUP S306_Signal_Limit S306_Signal_Override /end SUB_GROUP /end GROUP
/begin GROUP S5_VDDM_FCLUSSDTC_raw32_Inproc "SWC_OUTP_type/run_SWC_OUTP_5ms_sys/OUTP/outpmodule/VDDM_FCLUSSDTC_raw32_Inproc" /begin SUB_GROUP S307_Signal_Limit S307_Signal_Override /end SUB_GROUP /end GROUP
/begin GROUP S5_VDDM_FCM2CSErrDTC_raw32_Inproc "SWC_OUTP_type/run_SWC_OUTP_5ms_sys/OUTP/outpmodule/VDDM_FCM2CSErrDTC_raw32_Inproc" /begin SUB_GROUP S308_Signal_Limit S308_Signal_Override /end SUB_GROUP /end GROUP
/begin GROUP S5_VDDM_FCM2NoComDTC_raw32_Inproc "SWC_OUTP_type/run_SWC_OUTP_5ms_sys/OUTP/outpmodule/VDDM_FCM2NoComDTC_raw32_Inproc" /begin SUB_GROUP S309_Signal_Limit S309_Signal_Override /end SUB_GROUP /end GROUP
/begin GROUP S5_VDDM_FCM2RCErrDTC_raw32_Inproc "SWC_OUTP_type/run_SWC_OUTP_5ms_sys/OUTP/outpmodule/VDDM_FCM2RCErrDTC_raw32_Inproc" /begin SUB_GROUP S310_Signal_Limit S310_Signal_Override /end SUB_GROUP /end GROUP
/begin GROUP S5_VDDM_FCM3CSErrDTC_raw32_Inproc "SWC_OUTP_type/run_SWC_OUTP_5ms_sys/OUTP/outpmodule/VDDM_FCM3CSErrDTC_raw32_Inproc" /begin SUB_GROUP S311_Signal_Limit S311_Signal_Override /end SUB_GROUP /end GROUP
/begin GROUP S5_VDDM_FCM3NoComDTC_raw32_Inproc "SWC_OUTP_type/run_SWC_OUTP_5ms_sys/OUTP/outpmodule/VDDM_FCM3NoComDTC_raw32_Inproc" /begin SUB_GROUP S312_Signal_Limit S312_Signal_Override /end SUB_GROUP /end GROUP
/begin GROUP S5_VDDM_FCM3RCErrDTC_raw32_Inproc "SWC_OUTP_type/run_SWC_OUTP_5ms_sys/OUTP/outpmodule/VDDM_FCM3RCErrDTC_raw32_Inproc" /begin SUB_GROUP S313_Signal_Limit S313_Signal_Override /end SUB_GROUP /end GROUP
/begin GROUP S5_VDDM_FCM4CSErrDTC_raw32_Inproc "SWC_OUTP_type/run_SWC_OUTP_5ms_sys/OUTP/outpmodule/VDDM_FCM4CSErrDTC_raw32_Inproc" /begin SUB_GROUP S314_Signal_Limit S314_Signal_Override /end SUB_GROUP /end GROUP
/begin GROUP S5_VDDM_FCM4NoComDTC_raw32_Inproc "SWC_OUTP_type/run_SWC_OUTP_5ms_sys/OUTP/outpmodule/VDDM_FCM4NoComDTC_raw32_Inproc" /begin SUB_GROUP S315_Signal_Limit S315_Signal_Override /end SUB_GROUP /end GROUP
/begin GROUP S5_VDDM_FCM5CSErrDTC_raw32_Inproc "SWC_OUTP_type/run_SWC_OUTP_5ms_sys/OUTP/outpmodule/VDDM_FCM5CSErrDTC_raw32_Inproc" /begin SUB_GROUP S316_Signal_Limit S316_Signal_Override /end SUB_GROUP /end GROUP
/begin GROUP S5_VDDM_FCM5NoComDTC_raw32_Inproc "SWC_OUTP_type/run_SWC_OUTP_5ms_sys/OUTP/outpmodule/VDDM_FCM5NoComDTC_raw32_Inproc" /begin SUB_GROUP S317_Signal_Limit S317_Signal_Override /end SUB_GROUP /end GROUP
/begin GROUP S5_VDDM_FCMACCSigErrDetDTC_raw32_Inproc "SWC_OUTP_type/run_SWC_OUTP_5ms_sys/OUTP/outpmodule/VDDM_FCMACCSigErrDetDTC_raw32_Inproc" /begin SUB_GROUP S318_Signal_Limit S318_Signal_Override /end SUB_GROUP /end GROUP
/begin GROUP S5_VDDM_FCRUSSDTC_raw32_Inproc "SWC_OUTP_type/run_SWC_OUTP_5ms_sys/OUTP/outpmodule/VDDM_FCRUSSDTC_raw32_Inproc" /begin SUB_GROUP S319_Signal_Limit S319_Signal_Override /end SUB_GROUP /end GROUP
/begin GROUP S5_VDDM_FLDoorSWDTC_raw32_Inproc "SWC_OUTP_type/run_SWC_OUTP_5ms_sys/OUTP/outpmodule/VDDM_FLDoorSWDTC_raw32_Inproc" /begin SUB_GROUP S320_Signal_Limit S320_Signal_Override /end SUB_GROUP /end GROUP
/begin GROUP S5_VDDM_FLLUSSDTC_raw32_Inproc "SWC_OUTP_type/run_SWC_OUTP_5ms_sys/OUTP/outpmodule/VDDM_FLLUSSDTC_raw32_Inproc" /begin SUB_GROUP S321_Signal_Limit S321_Signal_Override /end SUB_GROUP /end GROUP
/begin GROUP S5_VDDM_FLRUSSDTC_raw32_Inproc "SWC_OUTP_type/run_SWC_OUTP_5ms_sys/OUTP/outpmodule/VDDM_FLRUSSDTC_raw32_Inproc" /begin SUB_GROUP S322_Signal_Limit S322_Signal_Override /end SUB_GROUP /end GROUP
/begin GROUP S5_VDDM_FMLUSSDTC_raw32_Inproc "SWC_OUTP_type/run_SWC_OUTP_5ms_sys/OUTP/outpmodule/VDDM_FMLUSSDTC_raw32_Inproc" /begin SUB_GROUP S323_Signal_Limit S323_Signal_Override /end SUB_GROUP /end GROUP
/begin GROUP S5_VDDM_FMRUSSDTC_raw32_Inproc "SWC_OUTP_type/run_SWC_OUTP_5ms_sys/OUTP/outpmodule/VDDM_FMRUSSDTC_raw32_Inproc" /begin SUB_GROUP S324_Signal_Limit S324_Signal_Override /end SUB_GROUP /end GROUP
/begin GROUP S5_VDDM_FRDoorSWDTC_raw32_Inproc "SWC_OUTP_type/run_SWC_OUTP_5ms_sys/OUTP/outpmodule/VDDM_FRDoorSWDTC_raw32_Inproc" /begin SUB_GROUP S325_Signal_Limit S325_Signal_Override /end SUB_GROUP /end GROUP
/begin GROUP S5_VDDM_FrMCUSigErrDetDTC_raw32_Inproc "SWC_OUTP_type/run_SWC_OUTP_5ms_sys/OUTP/outpmodule/VDDM_FrMCUSigErrDetDTC_raw32_Inproc" /begin SUB_GROUP S326_Signal_Limit S326_Signal_Override /end SUB_GROUP /end GROUP
/begin GROUP S5_VDDM_FrMCUTqErrDTC_raw32_Inproc "SWC_OUTP_type/run_SWC_OUTP_5ms_sys/OUTP/outpmodule/VDDM_FrMCUTqErrDTC_raw32_Inproc" /begin SUB_GROUP S327_Signal_Limit S327_Signal_Override /end SUB_GROUP /end GROUP
/begin GROUP S5_VDDM_HVB4PreDTC_raw32_Inproc "SWC_OUTP_type/run_SWC_OUTP_5ms_sys/OUTP/outpmodule/VDDM_HVB4PreDTC_raw32_Inproc" /begin SUB_GROUP S328_Signal_Limit S328_Signal_Override /end SUB_GROUP /end GROUP
/begin GROUP S5_VDDM_HVRlyCloDTC_raw32_Inproc "SWC_OUTP_type/run_SWC_OUTP_5ms_sys/OUTP/outpmodule/VDDM_HVRlyCloDTC_raw32_Inproc" /begin SUB_GROUP S329_Signal_Limit S329_Signal_Override /end SUB_GROUP /end GROUP
/begin GROUP S5_VDDM_HVRlyOpDTC_raw32_Inproc "SWC_OUTP_type/run_SWC_OUTP_5ms_sys/OUTP/outpmodule/VDDM_HVRlyOpDTC_raw32_Inproc" /begin SUB_GROUP S330_Signal_Limit S330_Signal_Override /end SUB_GROUP /end GROUP
/begin GROUP S5_VDDM_HVRlyOpFail_flg_Inproc "SWC_OUTP_type/run_SWC_OUTP_5ms_sys/OUTP/outpmodule/VDDM_HVRlyOpFail_flg_Inproc" /begin SUB_GROUP S331_Signal_Limit S331_Signal_Override /end SUB_GROUP /end GROUP
/begin GROUP S5_VDDM_HiLvSaChkDTC_raw32_Inproc "SWC_OUTP_type/run_SWC_OUTP_5ms_sys/OUTP/outpmodule/VDDM_HiLvSaChkDTC_raw32_Inproc" /begin SUB_GROUP S332_Signal_Limit S332_Signal_Override /end SUB_GROUP /end GROUP
/begin GROUP S5_VDDM_HoodSWDTC_raw32_Inproc "SWC_OUTP_type/run_SWC_OUTP_5ms_sys/OUTP/outpmodule/VDDM_HoodSWDTC_raw32_Inproc" /begin SUB_GROUP S333_Signal_Limit S333_Signal_Override /end SUB_GROUP /end GROUP
/begin GROUP S5_VDDM_ISAMalfuncDetDTC_raw32_Inproc "SWC_OUTP_type/run_SWC_OUTP_5ms_sys/OUTP/outpmodule/VDDM_ISAMalfuncDetDTC_raw32_Inproc" /begin SUB_GROUP S334_Signal_Limit S334_Signal_Override /end SUB_GROUP /end GROUP
/begin GROUP S5_VDDM_IniLVLoDTC_raw32_Inproc "SWC_OUTP_type/run_SWC_OUTP_5ms_sys/OUTP/outpmodule/VDDM_IniLVLoDTC_raw32_Inproc" /begin SUB_GROUP S335_Signal_Limit S335_Signal_Override /end SUB_GROUP /end GROUP
/begin GROUP S5_VDDM_KeyAuthDTC_raw32_Inproc "SWC_OUTP_type/run_SWC_OUTP_5ms_sys/OUTP/outpmodule/VDDM_KeyAuthDTC_raw32_Inproc" /begin SUB_GROUP S336_Signal_Limit S336_Signal_Override /end SUB_GROUP /end GROUP
/begin GROUP S5_VDDM_LFBatwarnDTC_raw32_Inproc "SWC_OUTP_type/run_SWC_OUTP_5ms_sys/OUTP/outpmodule/VDDM_LFBatwarnDTC_raw32_Inproc" /begin SUB_GROUP S337_Signal_Limit S337_Signal_Override /end SUB_GROUP /end GROUP
/begin GROUP S5_VDDM_LFPressIndiDTC_raw32_Inproc "SWC_OUTP_type/run_SWC_OUTP_5ms_sys/OUTP/outpmodule/VDDM_LFPressIndiDTC_raw32_Inproc" /begin SUB_GROUP S338_Signal_Limit S338_Signal_Override /end SUB_GROUP /end GROUP
/begin GROUP S5_VDDM_LFSensorFailDTC_raw32_Inproc "SWC_OUTP_type/run_SWC_OUTP_5ms_sys/OUTP/outpmodule/VDDM_LFSensorFailDTC_raw32_Inproc" /begin SUB_GROUP S339_Signal_Limit S339_Signal_Override /end SUB_GROUP /end GROUP
/begin GROUP S5_VDDM_LFWheelTmpHighDTC_raw32_Inproc "SWC_OUTP_type/run_SWC_OUTP_5ms_sys/OUTP/outpmodule/VDDM_LFWheelTmpHighDTC_raw32_Inproc" /begin SUB_GROUP S340_Signal_Limit S340_Signal_Override /end SUB_GROUP /end GROUP
/begin GROUP S5_VDDM_LRBatwarnDTC_raw32_Inproc "SWC_OUTP_type/run_SWC_OUTP_5ms_sys/OUTP/outpmodule/VDDM_LRBatwarnDTC_raw32_Inproc" /begin SUB_GROUP S341_Signal_Limit S341_Signal_Override /end SUB_GROUP /end GROUP
/begin GROUP S5_VDDM_LRPressIndiDTC_raw32_Inproc "SWC_OUTP_type/run_SWC_OUTP_5ms_sys/OUTP/outpmodule/VDDM_LRPressIndiDTC_raw32_Inproc" /begin SUB_GROUP S342_Signal_Limit S342_Signal_Override /end SUB_GROUP /end GROUP
/begin GROUP S5_VDDM_LRSensorFailDTC_raw32_Inproc "SWC_OUTP_type/run_SWC_OUTP_5ms_sys/OUTP/outpmodule/VDDM_LRSensorFailDTC_raw32_Inproc" /begin SUB_GROUP S343_Signal_Limit S343_Signal_Override /end SUB_GROUP /end GROUP
/begin GROUP S5_VDDM_LRWheelTmpHighDTC_raw32_Inproc "SWC_OUTP_type/run_SWC_OUTP_5ms_sys/OUTP/outpmodule/VDDM_LRWheelTmpHighDTC_raw32_Inproc" /begin SUB_GROUP S344_Signal_Limit S344_Signal_Override /end SUB_GROUP /end GROUP
/begin GROUP S5_VDDM_LVSupHiDTC_raw32_Inproc "SWC_OUTP_type/run_SWC_OUTP_5ms_sys/OUTP/outpmodule/VDDM_LVSupHiDTC_raw32_Inproc" /begin SUB_GROUP S345_Signal_Limit S345_Signal_Override /end SUB_GROUP /end GROUP
/begin GROUP S5_VDDM_LVSupLoDTC_raw32_Inproc "SWC_OUTP_type/run_SWC_OUTP_5ms_sys/OUTP/outpmodule/VDDM_LVSupLoDTC_raw32_Inproc" /begin SUB_GROUP S346_Signal_Limit S346_Signal_Override /end SUB_GROUP /end GROUP
/begin GROUP S5_VDDM_LVSysErrPwrOutErr_flg_Inproc "SWC_OUTP_type/run_SWC_OUTP_5ms_sys/OUTP/outpmodule/VDDM_LVSysErrPwrOutErr_flg_Inproc" /begin SUB_GROUP S347_Signal_Limit S347_Signal_Override /end SUB_GROUP /end GROUP
/begin GROUP S5_VDDM_LimpHomeActTmp_flg_Inproc "SWC_OUTP_type/run_SWC_OUTP_5ms_sys/OUTP/outpmodule/VDDM_LimpHomeActTmp_flg_Inproc" /begin SUB_GROUP S348_Signal_Limit S348_Signal_Override /end SUB_GROUP /end GROUP
/begin GROUP S5_VDDM_Lv1ErrDTC_raw32_Inproc "SWC_OUTP_type/run_SWC_OUTP_5ms_sys/OUTP/outpmodule/VDDM_Lv1ErrDTC_raw32_Inproc" /begin SUB_GROUP S349_Signal_Limit S349_Signal_Override /end SUB_GROUP /end GROUP
/begin GROUP S5_VDDM_Lv2ErrDTC_raw32_Inproc "SWC_OUTP_type/run_SWC_OUTP_5ms_sys/OUTP/outpmodule/VDDM_Lv2ErrDTC_raw32_Inproc" /begin SUB_GROUP S350_Signal_Limit S350_Signal_Override /end SUB_GROUP /end GROUP
/begin GROUP S5_VDDM_Lv3ErrDTC_raw32_Inproc "SWC_OUTP_type/run_SWC_OUTP_5ms_sys/OUTP/outpmodule/VDDM_Lv3ErrDTC_raw32_Inproc" /begin SUB_GROUP S351_Signal_Limit S351_Signal_Override /end SUB_GROUP /end GROUP
/begin GROUP S5_VDDM_Lv4ErrDTC_raw32_Inproc "SWC_OUTP_type/run_SWC_OUTP_5ms_sys/OUTP/outpmodule/VDDM_Lv4ErrDTC_raw32_Inproc" /begin SUB_GROUP S352_Signal_Limit S352_Signal_Override /end SUB_GROUP /end GROUP
/begin GROUP S5_VDDM_MCU4PreDTC_raw32_Inproc "SWC_OUTP_type/run_SWC_OUTP_5ms_sys/OUTP/outpmodule/VDDM_MCU4PreDTC_raw32_Inproc" /begin SUB_GROUP S353_Signal_Limit S353_Signal_Override /end SUB_GROUP /end GROUP
/begin GROUP S5_VDDM_MCUActDTC_raw32_Inproc "SWC_OUTP_type/run_SWC_OUTP_5ms_sys/OUTP/outpmodule/VDDM_MCUActDTC_raw32_Inproc" /begin SUB_GROUP S354_Signal_Limit S354_Signal_Override /end SUB_GROUP /end GROUP
/begin GROUP S5_VDDM_MCUActDisFail_flg_Inproc "SWC_OUTP_type/run_SWC_OUTP_5ms_sys/OUTP/outpmodule/VDDM_MCUActDisFail_flg_Inproc" /begin SUB_GROUP S355_Signal_Limit S355_Signal_Override /end SUB_GROUP /end GROUP
/begin GROUP S5_VDDM_MCUDisDTC_raw32_Inproc "SWC_OUTP_type/run_SWC_OUTP_5ms_sys/OUTP/outpmodule/VDDM_MCUDisDTC_raw32_Inproc" /begin SUB_GROUP S356_Signal_Limit S356_Signal_Override /end SUB_GROUP /end GROUP
/begin GROUP S5_VDDM_MCUF1CSErrDTC_raw32_Inproc "SWC_OUTP_type/run_SWC_OUTP_5ms_sys/OUTP/outpmodule/VDDM_MCUF1CSErrDTC_raw32_Inproc" /begin SUB_GROUP S357_Signal_Limit S357_Signal_Override /end SUB_GROUP /end GROUP
/begin GROUP S5_VDDM_MCUF1NoComDTC_raw32_Inproc "SWC_OUTP_type/run_SWC_OUTP_5ms_sys/OUTP/outpmodule/VDDM_MCUF1NoComDTC_raw32_Inproc" /begin SUB_GROUP S358_Signal_Limit S358_Signal_Override /end SUB_GROUP /end GROUP
/begin GROUP S5_VDDM_MCUF1RCErrDTC_raw32_Inproc "SWC_OUTP_type/run_SWC_OUTP_5ms_sys/OUTP/outpmodule/VDDM_MCUF1RCErrDTC_raw32_Inproc" /begin SUB_GROUP S359_Signal_Limit S359_Signal_Override /end SUB_GROUP /end GROUP
/begin GROUP S5_VDDM_MCUR1CSErrDTC_raw32_Inproc "SWC_OUTP_type/run_SWC_OUTP_5ms_sys/OUTP/outpmodule/VDDM_MCUR1CSErrDTC_raw32_Inproc" /begin SUB_GROUP S360_Signal_Limit S360_Signal_Override /end SUB_GROUP /end GROUP
/begin GROUP S5_VDDM_MCUR1NoComDTC_raw32_Inproc "SWC_OUTP_type/run_SWC_OUTP_5ms_sys/OUTP/outpmodule/VDDM_MCUR1NoComDTC_raw32_Inproc" /begin SUB_GROUP S361_Signal_Limit S361_Signal_Override /end SUB_GROUP /end GROUP
/begin GROUP S5_VDDM_MCUR1RCErrDTC_raw32_Inproc "SWC_OUTP_type/run_SWC_OUTP_5ms_sys/OUTP/outpmodule/VDDM_MCUR1RCErrDTC_raw32_Inproc" /begin SUB_GROUP S362_Signal_Limit S362_Signal_Override /end SUB_GROUP /end GROUP
/begin GROUP S5_VDDM_MSAMalfuncDetDTC_raw32_Inproc "SWC_OUTP_type/run_SWC_OUTP_5ms_sys/OUTP/outpmodule/VDDM_MSAMalfuncDetDTC_raw32_Inproc" /begin SUB_GROUP S363_Signal_Limit S363_Signal_Override /end SUB_GROUP /end GROUP
/begin GROUP S5_VDDM_MidLvSaChkDTC_raw32_Inproc "SWC_OUTP_type/run_SWC_OUTP_5ms_sys/OUTP/outpmodule/VDDM_MidLvSaChkDTC_raw32_Inproc" /begin SUB_GROUP S364_Signal_Limit S364_Signal_Override /end SUB_GROUP /end GROUP
/begin GROUP S5_VDDM_OBC4PreDTC_raw32_Inproc "SWC_OUTP_type/run_SWC_OUTP_5ms_sys/OUTP/outpmodule/VDDM_OBC4PreDTC_raw32_Inproc" /begin SUB_GROUP S365_Signal_Limit S365_Signal_Override /end SUB_GROUP /end GROUP
/begin GROUP S5_VDDM_ONtoRdyDTC_raw32_Inproc "SWC_OUTP_type/run_SWC_OUTP_5ms_sys/OUTP/outpmodule/VDDM_ONtoRdyDTC_raw32_Inproc" /begin SUB_GROUP S366_Signal_Limit S366_Signal_Override /end SUB_GROUP /end GROUP
/begin GROUP S5_VDDM_RCLUSSDTC_raw32_Inproc "SWC_OUTP_type/run_SWC_OUTP_5ms_sys/OUTP/outpmodule/VDDM_RCLUSSDTC_raw32_Inproc" /begin SUB_GROUP S367_Signal_Limit S367_Signal_Override /end SUB_GROUP /end GROUP
/begin GROUP S5_VDDM_RCRUSSDTC_raw32_Inproc "SWC_OUTP_type/run_SWC_OUTP_5ms_sys/OUTP/outpmodule/VDDM_RCRUSSDTC_raw32_Inproc" /begin SUB_GROUP S368_Signal_Limit S368_Signal_Override /end SUB_GROUP /end GROUP
/begin GROUP S5_VDDM_RFBatwarnDTC_raw32_Inproc "SWC_OUTP_type/run_SWC_OUTP_5ms_sys/OUTP/outpmodule/VDDM_RFBatwarnDTC_raw32_Inproc" /begin SUB_GROUP S369_Signal_Limit S369_Signal_Override /end SUB_GROUP /end GROUP
/begin GROUP S5_VDDM_RFPressIndiDTC_raw32_Inproc "SWC_OUTP_type/run_SWC_OUTP_5ms_sys/OUTP/outpmodule/VDDM_RFPressIndiDTC_raw32_Inproc" /begin SUB_GROUP S370_Signal_Limit S370_Signal_Override /end SUB_GROUP /end GROUP
/begin GROUP S5_VDDM_RFSensorFailDTC_raw32_Inproc "SWC_OUTP_type/run_SWC_OUTP_5ms_sys/OUTP/outpmodule/VDDM_RFSensorFailDTC_raw32_Inproc" /begin SUB_GROUP S371_Signal_Limit S371_Signal_Override /end SUB_GROUP /end GROUP
/begin GROUP S5_VDDM_RFWheelTmpHighDTC_raw32_Inproc "SWC_OUTP_type/run_SWC_OUTP_5ms_sys/OUTP/outpmodule/VDDM_RFWheelTmpHighDTC_raw32_Inproc" /begin SUB_GROUP S372_Signal_Limit S372_Signal_Override /end SUB_GROUP /end GROUP
/begin GROUP S5_VDDM_RLDoorSWDTC_raw32_Inproc "SWC_OUTP_type/run_SWC_OUTP_5ms_sys/OUTP/outpmodule/VDDM_RLDoorSWDTC_raw32_Inproc" /begin SUB_GROUP S373_Signal_Limit S373_Signal_Override /end SUB_GROUP /end GROUP
/begin GROUP S5_VDDM_RLLUSSDTC_raw32_Inproc "SWC_OUTP_type/run_SWC_OUTP_5ms_sys/OUTP/outpmodule/VDDM_RLLUSSDTC_raw32_Inproc" /begin SUB_GROUP S374_Signal_Limit S374_Signal_Override /end SUB_GROUP /end GROUP
/begin GROUP S5_VDDM_RLRUSSDTC_raw32_Inproc "SWC_OUTP_type/run_SWC_OUTP_5ms_sys/OUTP/outpmodule/VDDM_RLRUSSDTC_raw32_Inproc" /begin SUB_GROUP S375_Signal_Limit S375_Signal_Override /end SUB_GROUP /end GROUP
/begin GROUP S5_VDDM_RMLUSSDTC_raw32_Inproc "SWC_OUTP_type/run_SWC_OUTP_5ms_sys/OUTP/outpmodule/VDDM_RMLUSSDTC_raw32_Inproc" /begin SUB_GROUP S376_Signal_Limit S376_Signal_Override /end SUB_GROUP /end GROUP
/begin GROUP S5_VDDM_RMRUSSDTC_raw32_Inproc "SWC_OUTP_type/run_SWC_OUTP_5ms_sys/OUTP/outpmodule/VDDM_RMRUSSDTC_raw32_Inproc" /begin SUB_GROUP S377_Signal_Limit S377_Signal_Override /end SUB_GROUP /end GROUP
/begin GROUP S5_VDDM_RRBatwarnDTC_raw32_Inproc "SWC_OUTP_type/run_SWC_OUTP_5ms_sys/OUTP/outpmodule/VDDM_RRBatwarnDTC_raw32_Inproc" /begin SUB_GROUP S378_Signal_Limit S378_Signal_Override /end SUB_GROUP /end GROUP
/begin GROUP S5_VDDM_RRDoorSWDTC_raw32_Inproc "SWC_OUTP_type/run_SWC_OUTP_5ms_sys/OUTP/outpmodule/VDDM_RRDoorSWDTC_raw32_Inproc" /begin SUB_GROUP S379_Signal_Limit S379_Signal_Override /end SUB_GROUP /end GROUP
/begin GROUP S5_VDDM_RRPressIndiDTC_raw32_Inproc "SWC_OUTP_type/run_SWC_OUTP_5ms_sys/OUTP/outpmodule/VDDM_RRPressIndiDTC_raw32_Inproc" /begin SUB_GROUP S380_Signal_Limit S380_Signal_Override /end SUB_GROUP /end GROUP
/begin GROUP S5_VDDM_RRSensorFailDTC_raw32_Inproc "SWC_OUTP_type/run_SWC_OUTP_5ms_sys/OUTP/outpmodule/VDDM_RRSensorFailDTC_raw32_Inproc" /begin SUB_GROUP S381_Signal_Limit S381_Signal_Override /end SUB_GROUP /end GROUP
/begin GROUP S5_VDDM_RRWheelTmpHighDTC_raw32_Inproc "SWC_OUTP_type/run_SWC_OUTP_5ms_sys/OUTP/outpmodule/VDDM_RRWheelTmpHighDTC_raw32_Inproc" /begin SUB_GROUP S382_Signal_Limit S382_Signal_Override /end SUB_GROUP /end GROUP
/begin GROUP S5_VDDM_RrMCUSigErrDetDTC_raw32_Inproc "SWC_OUTP_type/run_SWC_OUTP_5ms_sys/OUTP/outpmodule/VDDM_RrMCUSigErrDetDTC_raw32_Inproc" /begin SUB_GROUP S383_Signal_Limit S383_Signal_Override /end SUB_GROUP /end GROUP
/begin GROUP S5_VDDM_RrMCUTqErrDTC_raw32_Inproc "SWC_OUTP_type/run_SWC_OUTP_5ms_sys/OUTP/outpmodule/VDDM_RrMCUTqErrDTC_raw32_Inproc" /begin SUB_GROUP S384_Signal_Limit S384_Signal_Override /end SUB_GROUP /end GROUP
/begin GROUP S5_VDDM_Shifter1CSErrDTC_raw32_Inproc "SWC_OUTP_type/run_SWC_OUTP_5ms_sys/OUTP/outpmodule/VDDM_Shifter1CSErrDTC_raw32_Inproc" /begin SUB_GROUP S385_Signal_Limit S385_Signal_Override /end SUB_GROUP /end GROUP
/begin GROUP S5_VDDM_Shifter1NoComDTC_raw32_Inproc "SWC_OUTP_type/run_SWC_OUTP_5ms_sys/OUTP/outpmodule/VDDM_Shifter1NoComDTC_raw32_Inproc" /begin SUB_GROUP S386_Signal_Limit S386_Signal_Override /end SUB_GROUP /end GROUP
/begin GROUP S5_VDDM_Shifter1RCErrDTC_raw32_Inproc "SWC_OUTP_type/run_SWC_OUTP_5ms_sys/OUTP/outpmodule/VDDM_Shifter1RCErrDTC_raw32_Inproc" /begin SUB_GROUP S387_Signal_Limit S387_Signal_Override /end SUB_GROUP /end GROUP
/begin GROUP S5_VDDM_SysAllowReadySta_flg_Inproc "SWC_OUTP_type/run_SWC_OUTP_5ms_sys/OUTP/outpmodule/VDDM_SysAllowReadySta_flg_Inproc" /begin SUB_GROUP S388_Signal_Limit S388_Signal_Override /end SUB_GROUP /end GROUP
/begin GROUP S5_VDDM_TailgaSWDTC_raw32_Inproc "SWC_OUTP_type/run_SWC_OUTP_5ms_sys/OUTP/outpmodule/VDDM_TailgaSWDTC_raw32_Inproc" /begin SUB_GROUP S389_Signal_Limit S389_Signal_Override /end SUB_GROUP /end GROUP
/begin GROUP S5_VDDM_VCUBrkSWSta_enum_Inproc "SWC_OUTP_type/run_SWC_OUTP_5ms_sys/OUTP/outpmodule/VDDM_VCUBrkSWSta_enum_Inproc" /begin SUB_GROUP S390_Signal_Limit S390_Signal_Override /end SUB_GROUP /end GROUP
/begin GROUP S5_VDDM_VCUFLDoorSta_flg_Inproc "SWC_OUTP_type/run_SWC_OUTP_5ms_sys/OUTP/outpmodule/VDDM_VCUFLDoorSta_flg_Inproc" /begin SUB_GROUP S391_Signal_Limit S391_Signal_Override /end SUB_GROUP /end GROUP
/begin GROUP S5_VDDM_VCUFRDoorSta_flg_Inproc "SWC_OUTP_type/run_SWC_OUTP_5ms_sys/OUTP/outpmodule/VDDM_VCUFRDoorSta_flg_Inproc" /begin SUB_GROUP S392_Signal_Limit S392_Signal_Override /end SUB_GROUP /end GROUP
/begin GROUP S5_VDDM_VCUHoodSWSta_flg_Inproc "SWC_OUTP_type/run_SWC_OUTP_5ms_sys/OUTP/outpmodule/VDDM_VCUHoodSWSta_flg_Inproc" /begin SUB_GROUP S393_Signal_Limit S393_Signal_Override /end SUB_GROUP /end GROUP
/begin GROUP S5_VDDM_VCURAPSErrLv2_flg_Inproc "SWC_OUTP_type/run_SWC_OUTP_5ms_sys/OUTP/outpmodule/VDDM_VCURAPSErrLv2_flg_Inproc" /begin SUB_GROUP S394_Signal_Limit S394_Signal_Override /end SUB_GROUP /end GROUP
/begin GROUP S5_VDDM_VCURAPSErrLv3_flg_Inproc "SWC_OUTP_type/run_SWC_OUTP_5ms_sys/OUTP/outpmodule/VDDM_VCURAPSErrLv3_flg_Inproc" /begin SUB_GROUP S395_Signal_Limit S395_Signal_Override /end SUB_GROUP /end GROUP
/begin GROUP S5_VDDM_VCURLDoorSta_flg_Inproc "SWC_OUTP_type/run_SWC_OUTP_5ms_sys/OUTP/outpmodule/VDDM_VCURLDoorSta_flg_Inproc" /begin SUB_GROUP S396_Signal_Limit S396_Signal_Override /end SUB_GROUP /end GROUP
/begin GROUP S5_VDDM_VCURRDoorSta_flg_Inproc "SWC_OUTP_type/run_SWC_OUTP_5ms_sys/OUTP/outpmodule/VDDM_VCURRDoorSta_flg_Inproc" /begin SUB_GROUP S397_Signal_Limit S397_Signal_Override /end SUB_GROUP /end GROUP
/begin GROUP S5_VDDM_VCUTailgateSWSta_flg_Inproc "SWC_OUTP_type/run_SWC_OUTP_5ms_sys/OUTP/outpmodule/VDDM_VCUTailgateSWSta_flg_Inproc" /begin SUB_GROUP S398_Signal_Limit S398_Signal_Override /end SUB_GROUP /end GROUP
/begin GROUP S5_VDDM_VehMalfunLevel_enum_Inproc "SWC_OUTP_type/run_SWC_OUTP_5ms_sys/OUTP/outpmodule/VDDM_VehMalfunLevel_enum_Inproc" /begin SUB_GROUP S399_Signal_Limit S399_Signal_Override /end SUB_GROUP /end GROUP
/begin GROUP S5_VDDM_ZoneSCPNoComDTC_raw32_Inproc "SWC_OUTP_type/run_SWC_OUTP_5ms_sys/OUTP/outpmodule/VDDM_ZoneSCPNoComDTC_raw32_Inproc" /begin SUB_GROUP S400_Signal_Limit S400_Signal_Override /end SUB_GROUP /end GROUP
/begin GROUP S5_VDHP_ActAPSPosn_pct_Inproc "SWC_OUTP_type/run_SWC_OUTP_5ms_sys/OUTP/outpmodule/VDHP_ActAPSPosn_pct_Inproc" /begin SUB_GROUP S401_Signal_Limit S401_Signal_Override /end SUB_GROUP /end GROUP
/begin GROUP S5_VDHP_EAPS1MIN_pct_Inproc "SWC_OUTP_type/run_SWC_OUTP_5ms_sys/OUTP/outpmodule/VDHP_EAPS1MIN_pct_Inproc" /begin SUB_GROUP S402_Signal_Limit S402_Signal_Override /end SUB_GROUP /end GROUP
/begin GROUP S5_VDHP_EAPS1NRM_pct_Inproc "SWC_OUTP_type/run_SWC_OUTP_5ms_sys/OUTP/outpmodule/VDHP_EAPS1NRM_pct_Inproc" /begin SUB_GROUP S403_Signal_Limit S403_Signal_Override /end SUB_GROUP /end GROUP
/begin GROUP S5_VDHP_EAPS2MIN_pct_Inproc "SWC_OUTP_type/run_SWC_OUTP_5ms_sys/OUTP/outpmodule/VDHP_EAPS2MIN_pct_Inproc" /begin SUB_GROUP S404_Signal_Limit S404_Signal_Override /end SUB_GROUP /end GROUP
/begin GROUP S5_VDHP_EAPS2NRM_pct_Inproc "SWC_OUTP_type/run_SWC_OUTP_5ms_sys/OUTP/outpmodule/VDHP_EAPS2NRM_pct_Inproc" /begin SUB_GROUP S405_Signal_Limit S405_Signal_Override /end SUB_GROUP /end GROUP
/begin GROUP S5_VDHP_ResetPedalZeroPosStart_flg_Inproc "SWC_OUTP_type/run_SWC_OUTP_5ms_sys/OUTP/outpmodule/VDHP_ResetPedalZeroPosStart_flg_Inproc" /begin SUB_GROUP S406_Signal_Limit S406_Signal_Override /end SUB_GROUP /end GROUP
/begin GROUP S5_VDID_APPD_pct_Inproc "SWC_OUTP_type/run_SWC_OUTP_5ms_sys/OUTP/outpmodule/VDID_APPD_pct_Inproc" /begin SUB_GROUP S407_Signal_Limit S407_Signal_Override /end SUB_GROUP /end GROUP
/begin GROUP S5_VDID_APPE_pct_Inproc "SWC_OUTP_type/run_SWC_OUTP_5ms_sys/OUTP/outpmodule/VDID_APPE_pct_Inproc" /begin SUB_GROUP S408_Signal_Limit S408_Signal_Override /end SUB_GROUP /end GROUP
/begin GROUP S5_VDID_AVGBATTEMPL_C_Inproc "SWC_OUTP_type/run_SWC_OUTP_5ms_sys/OUTP/outpmodule/VDID_AVGBATTEMPL_C_Inproc" /begin SUB_GROUP S409_Signal_Limit S409_Signal_Override /end SUB_GROUP /end GROUP
/begin GROUP S5_VDID_AVGBATTEMPL_sec_Inproc "SWC_OUTP_type/run_SWC_OUTP_5ms_sys/OUTP/outpmodule/VDID_AVGBATTEMPL_sec_Inproc" /begin SUB_GROUP S410_Signal_Limit S410_Signal_Override /end SUB_GROUP /end GROUP
/begin GROUP S5_VDID_AvgBattTempOFFL_C_Inproc "SWC_OUTP_type/run_SWC_OUTP_5ms_sys/OUTP/outpmodule/VDID_AvgBattTempOFFL_C_Inproc" /begin SUB_GROUP S411_Signal_Limit S411_Signal_Override /end SUB_GROUP /end GROUP
/begin GROUP S5_VDID_AvgBattTempOFFR_C_Inproc "SWC_OUTP_type/run_SWC_OUTP_5ms_sys/OUTP/outpmodule/VDID_AvgBattTempOFFR_C_Inproc" /begin SUB_GROUP S412_Signal_Limit S412_Signal_Override /end SUB_GROUP /end GROUP
/begin GROUP S5_VDID_AvgBattTempOVCL_C_Inproc "SWC_OUTP_type/run_SWC_OUTP_5ms_sys/OUTP/outpmodule/VDID_AvgBattTempOVCL_C_Inproc" /begin SUB_GROUP S413_Signal_Limit S413_Signal_Override /end SUB_GROUP /end GROUP
/begin GROUP S5_VDID_AvgBattTempOVCR_C_Inproc "SWC_OUTP_type/run_SWC_OUTP_5ms_sys/OUTP/outpmodule/VDID_AvgBattTempOVCR_C_Inproc" /begin SUB_GROUP S414_Signal_Limit S414_Signal_Override /end SUB_GROUP /end GROUP
/begin GROUP S5_VDID_AvgBattTempPSAL_C_Inproc "SWC_OUTP_type/run_SWC_OUTP_5ms_sys/OUTP/outpmodule/VDID_AvgBattTempPSAL_C_Inproc" /begin SUB_GROUP S415_Signal_Limit S415_Signal_Override /end SUB_GROUP /end GROUP
/begin GROUP S5_VDID_AvgBattTempPSAR_C_Inproc "SWC_OUTP_type/run_SWC_OUTP_5ms_sys/OUTP/outpmodule/VDID_AvgBattTempPSAR_C_Inproc" /begin SUB_GROUP S416_Signal_Limit S416_Signal_Override /end SUB_GROUP /end GROUP
/begin GROUP S5_VDID_BATSOC_pct_Inproc "SWC_OUTP_type/run_SWC_OUTP_5ms_sys/OUTP/outpmodule/VDID_BATSOC_pct_Inproc" /begin SUB_GROUP S417_Signal_Limit S417_Signal_Override /end SUB_GROUP /end GROUP
/begin GROUP S5_VDID_BATSOH_pct_Inproc "SWC_OUTP_type/run_SWC_OUTP_5ms_sys/OUTP/outpmodule/VDID_BATSOH_pct_Inproc" /begin SUB_GROUP S418_Signal_Limit S418_Signal_Override /end SUB_GROUP /end GROUP
/begin GROUP S5_VDID_BattTempPSAL_sec_Inproc "SWC_OUTP_type/run_SWC_OUTP_5ms_sys/OUTP/outpmodule/VDID_BattTempPSAL_sec_Inproc" /begin SUB_GROUP S419_Signal_Limit S419_Signal_Override /end SUB_GROUP /end GROUP
/begin GROUP S5_VDID_BattTempPSAR_sec_Inproc "SWC_OUTP_type/run_SWC_OUTP_5ms_sys/OUTP/outpmodule/VDID_BattTempPSAR_sec_Inproc" /begin SUB_GROUP S420_Signal_Limit S420_Signal_Override /end SUB_GROUP /end GROUP
/begin GROUP S5_VDID_CALID_cnt_Inproc "SWC_OUTP_type/run_SWC_OUTP_5ms_sys/OUTP/outpmodule/VDID_CALID_cnt_Inproc" /begin SUB_GROUP S421_Signal_Limit S421_Signal_Override /end SUB_GROUP /end GROUP
/begin GROUP S5_VDID_CDEODTL_km_Inproc "SWC_OUTP_type/run_SWC_OUTP_5ms_sys/OUTP/outpmodule/VDID_CDEODTL_km_Inproc" /begin SUB_GROUP S422_Signal_Limit S422_Signal_Override /end SUB_GROUP /end GROUP
/begin GROUP S5_VDID_CDEODTR_km_Inproc "SWC_OUTP_type/run_SWC_OUTP_5ms_sys/OUTP/outpmodule/VDID_CDEODTR_km_Inproc" /begin SUB_GROUP S423_Signal_Limit S423_Signal_Override /end SUB_GROUP /end GROUP
/begin GROUP S5_VDID_CLRDIST_km_Inproc "SWC_OUTP_type/run_SWC_OUTP_5ms_sys/OUTP/outpmodule/VDID_CLRDIST_km_Inproc" /begin SUB_GROUP S424_Signal_Limit S424_Signal_Override /end SUB_GROUP /end GROUP
/begin GROUP S5_VDID_CLRTIME_min_Inproc "SWC_OUTP_type/run_SWC_OUTP_5ms_sys/OUTP/outpmodule/VDID_CLRTIME_min_Inproc" /begin SUB_GROUP S425_Signal_Limit S425_Signal_Override /end SUB_GROUP /end GROUP
/begin GROUP S5_VDID_CPSAL_sec_Inproc "SWC_OUTP_type/run_SWC_OUTP_5ms_sys/OUTP/outpmodule/VDID_CPSAL_sec_Inproc" /begin SUB_GROUP S426_Signal_Limit S426_Signal_Override /end SUB_GROUP /end GROUP
/begin GROUP S5_VDID_CPSAR_sec_Inproc "SWC_OUTP_type/run_SWC_OUTP_5ms_sys/OUTP/outpmodule/VDID_CPSAR_sec_Inproc" /begin SUB_GROUP S427_Signal_Limit S427_Signal_Override /end SUB_GROUP /end GROUP
/begin GROUP S5_VDID_DIDModelVersionChksum_raw_Inproc "SWC_OUTP_type/run_SWC_OUTP_5ms_sys/OUTP/outpmodule/VDID_DIDModelVersionChksum_raw_Inproc" /begin SUB_GROUP S428_Signal_Limit S428_Signal_Override /end SUB_GROUP /end GROUP
/begin GROUP S5_VDID_DIDModelVersion_raw_Inproc "SWC_OUTP_type/run_SWC_OUTP_5ms_sys/OUTP/outpmodule/VDID_DIDModelVersion_raw_Inproc" /begin SUB_GROUP S429_Signal_Limit S429_Signal_Override /end SUB_GROUP /end GROUP
/begin GROUP S5_VDID_ECUNAME_cnt_Inproc "SWC_OUTP_type/run_SWC_OUTP_5ms_sys/OUTP/outpmodule/VDID_ECUNAME_cnt_Inproc" /begin SUB_GROUP S430_Signal_Limit S430_Signal_Override /end SUB_GROUP /end GROUP
/begin GROUP S5_VDID_ETMATOEL_kWh_Inproc "SWC_OUTP_type/run_SWC_OUTP_5ms_sys/OUTP/outpmodule/VDID_ETMATOEL_kWh_Inproc" /begin SUB_GROUP S431_Signal_Limit S431_Signal_Override /end SUB_GROUP /end GROUP
/begin GROUP S5_VDID_ETMATOER_kWh_Inproc "SWC_OUTP_type/run_SWC_OUTP_5ms_sys/OUTP/outpmodule/VDID_ETMATOER_kWh_Inproc" /begin SUB_GROUP S432_Signal_Limit S432_Signal_Override /end SUB_GROUP /end GROUP
/begin GROUP S5_VDID_ETMBTOEL_kWh_Inproc "SWC_OUTP_type/run_SWC_OUTP_5ms_sys/OUTP/outpmodule/VDID_ETMBTOEL_kWh_Inproc" /begin SUB_GROUP S433_Signal_Limit S433_Signal_Override /end SUB_GROUP /end GROUP
/begin GROUP S5_VDID_ETMBTOER_kWh_Inproc "SWC_OUTP_type/run_SWC_OUTP_5ms_sys/OUTP/outpmodule/VDID_ETMBTOER_kWh_Inproc" /begin SUB_GROUP S434_Signal_Limit S434_Signal_Override /end SUB_GROUP /end GROUP
/begin GROUP S5_VDID_GECHGOVCACL_kWh_Inproc "SWC_OUTP_type/run_SWC_OUTP_5ms_sys/OUTP/outpmodule/VDID_GECHGOVCACL_kWh_Inproc" /begin SUB_GROUP S435_Signal_Limit S435_Signal_Override /end SUB_GROUP /end GROUP
/begin GROUP S5_VDID_GECHGOVCACR_kWh_Inproc "SWC_OUTP_type/run_SWC_OUTP_5ms_sys/OUTP/outpmodule/VDID_GECHGOVCACR_kWh_Inproc" /begin SUB_GROUP S436_Signal_Limit S436_Signal_Override /end SUB_GROUP /end GROUP
/begin GROUP S5_VDID_GECHGOVCDCL_kWh_Inproc "SWC_OUTP_type/run_SWC_OUTP_5ms_sys/OUTP/outpmodule/VDID_GECHGOVCDCL_kWh_Inproc" /begin SUB_GROUP S437_Signal_Limit S437_Signal_Override /end SUB_GROUP /end GROUP
/begin GROUP S5_VDID_GECHGOVCDCR_kWh_Inproc "SWC_OUTP_type/run_SWC_OUTP_5ms_sys/OUTP/outpmodule/VDID_GECHGOVCDCR_kWh_Inproc" /begin SUB_GROUP S438_Signal_Limit S438_Signal_Override /end SUB_GROUP /end GROUP
/begin GROUP S5_VDID_HEVBATT_V_Inproc "SWC_OUTP_type/run_SWC_OUTP_5ms_sys/OUTP/outpmodule/VDID_HEVBATT_V_Inproc" /begin SUB_GROUP S439_Signal_Limit S439_Signal_Override /end SUB_GROUP /end GROUP
/begin GROUP S5_VDID_HEVMODE_enum_Inproc "SWC_OUTP_type/run_SWC_OUTP_5ms_sys/OUTP/outpmodule/VDID_HEVMODE_enum_Inproc" /begin SUB_GROUP S440_Signal_Limit S440_Signal_Override /end SUB_GROUP /end GROUP
/begin GROUP S5_VDID_HVBATT_A_Inproc "SWC_OUTP_type/run_SWC_OUTP_5ms_sys/OUTP/outpmodule/VDID_HVBATT_A_Inproc" /begin SUB_GROUP S441_Signal_Limit S441_Signal_Override /end SUB_GROUP /end GROUP
/begin GROUP S5_VDID_HVBCellVoltMax_V_Inproc "SWC_OUTP_type/run_SWC_OUTP_5ms_sys/OUTP/outpmodule/VDID_HVBCellVoltMax_V_Inproc" /begin SUB_GROUP S442_Signal_Limit S442_Signal_Override /end SUB_GROUP /end GROUP
/begin GROUP S5_VDID_HVBCellVoltMin_V_Inproc "SWC_OUTP_type/run_SWC_OUTP_5ms_sys/OUTP/outpmodule/VDID_HVBCellVoltMin_V_Inproc" /begin SUB_GROUP S443_Signal_Limit S443_Signal_Override /end SUB_GROUP /end GROUP
/begin GROUP S5_VDID_HVBNAH_Ahr_Inproc "SWC_OUTP_type/run_SWC_OUTP_5ms_sys/OUTP/outpmodule/VDID_HVBNAH_Ahr_Inproc" /begin SUB_GROUP S444_Signal_Limit S444_Signal_Override /end SUB_GROUP /end GROUP
/begin GROUP S5_VDID_HVBNE_kWh_Inproc "SWC_OUTP_type/run_SWC_OUTP_5ms_sys/OUTP/outpmodule/VDID_HVBNE_kWh_Inproc" /begin SUB_GROUP S445_Signal_Limit S445_Signal_Override /end SUB_GROUP /end GROUP
/begin GROUP S5_VDID_HVBattCurr_Ahps_Inproc "SWC_OUTP_type/run_SWC_OUTP_5ms_sys/OUTP/outpmodule/VDID_HVBattCurr_Ahps_Inproc" /begin SUB_GROUP S446_Signal_Limit S446_Signal_Override /end SUB_GROUP /end GROUP
/begin GROUP S5_VDID_HVESSCHARGEACT_kW_Inproc "SWC_OUTP_type/run_SWC_OUTP_5ms_sys/OUTP/outpmodule/VDID_HVESSCHARGEACT_kW_Inproc" /begin SUB_GROUP S447_Signal_Limit S447_Signal_Override /end SUB_GROUP /end GROUP
/begin GROUP S5_VDID_HVESSCHARGELIM_kW_Inproc "SWC_OUTP_type/run_SWC_OUTP_5ms_sys/OUTP/outpmodule/VDID_HVESSCHARGELIM_kW_Inproc" /begin SUB_GROUP S448_Signal_Limit S448_Signal_Override /end SUB_GROUP /end GROUP
/begin GROUP S5_VDID_HVESSENER_Whps_Inproc "SWC_OUTP_type/run_SWC_OUTP_5ms_sys/OUTP/outpmodule/VDID_HVESSENER_Whps_Inproc" /begin SUB_GROUP S449_Signal_Limit S449_Signal_Override /end SUB_GROUP /end GROUP
/begin GROUP S5_VDID_IGNCNTR_cnt_Inproc "SWC_OUTP_type/run_SWC_OUTP_5ms_sys/OUTP/outpmodule/VDID_IGNCNTR_cnt_Inproc" /begin SUB_GROUP S450_Signal_Limit S450_Signal_Override /end SUB_GROUP /end GROUP
/begin GROUP S5_VDID_IPSAL_sec_Inproc "SWC_OUTP_type/run_SWC_OUTP_5ms_sys/OUTP/outpmodule/VDID_IPSAL_sec_Inproc" /begin SUB_GROUP S451_Signal_Limit S451_Signal_Override /end SUB_GROUP /end GROUP
/begin GROUP S5_VDID_IPSAR_sec_Inproc "SWC_OUTP_type/run_SWC_OUTP_5ms_sys/OUTP/outpmodule/VDID_IPSAR_sec_Inproc" /begin SUB_GROUP S452_Signal_Limit S452_Signal_Override /end SUB_GROUP /end GROUP
/begin GROUP S5_VDID_MAXBATTEMPL_C_Inproc "SWC_OUTP_type/run_SWC_OUTP_5ms_sys/OUTP/outpmodule/VDID_MAXBATTEMPL_C_Inproc" /begin SUB_GROUP S453_Signal_Limit S453_Signal_Override /end SUB_GROUP /end GROUP
/begin GROUP S5_VDID_MILDIST_km_Inproc "SWC_OUTP_type/run_SWC_OUTP_5ms_sys/OUTP/outpmodule/VDID_MILDIST_km_Inproc" /begin SUB_GROUP S454_Signal_Limit S454_Signal_Override /end SUB_GROUP /end GROUP
/begin GROUP S5_VDID_MILTIME_min_Inproc "SWC_OUTP_type/run_SWC_OUTP_5ms_sys/OUTP/outpmodule/VDID_MILTIME_min_Inproc" /begin SUB_GROUP S455_Signal_Limit S455_Signal_Override /end SUB_GROUP /end GROUP
/begin GROUP S5_VDID_MINBATTEMPL_C_Inproc "SWC_OUTP_type/run_SWC_OUTP_5ms_sys/OUTP/outpmodule/VDID_MINBATTEMPL_C_Inproc" /begin SUB_GROUP S456_Signal_Limit S456_Signal_Override /end SUB_GROUP /end GROUP
/begin GROUP S5_VDID_NUMPSATRIPSFLTMEMCLR_cnt_Inproc "SWC_OUTP_type/run_SWC_OUTP_5ms_sys/OUTP/outpmodule/VDID_NUMPSATRIPSFLTMEMCLR_cnt_Inproc" /begin SUB_GROUP S457_Signal_Limit S457_Signal_Override /end SUB_GROUP /end GROUP
/begin GROUP S5_VDID_ODOMETER_km_Inproc "SWC_OUTP_type/run_SWC_OUTP_5ms_sys/OUTP/outpmodule/VDID_ODOMETER_km_Inproc" /begin SUB_GROUP S458_Signal_Limit S458_Signal_Override /end SUB_GROUP /end GROUP
/begin GROUP S5_VDID_OFFL_sec_Inproc "SWC_OUTP_type/run_SWC_OUTP_5ms_sys/OUTP/outpmodule/VDID_OFFL_sec_Inproc" /begin SUB_GROUP S459_Signal_Limit S459_Signal_Override /end SUB_GROUP /end GROUP
/begin GROUP S5_VDID_OFFR_sec_Inproc "SWC_OUTP_type/run_SWC_OUTP_5ms_sys/OUTP/outpmodule/VDID_OFFR_sec_Inproc" /begin SUB_GROUP S460_Signal_Limit S460_Signal_Override /end SUB_GROUP /end GROUP
/begin GROUP S5_VDID_OVCL_sec_Inproc "SWC_OUTP_type/run_SWC_OUTP_5ms_sys/OUTP/outpmodule/VDID_OVCL_sec_Inproc" /begin SUB_GROUP S461_Signal_Limit S461_Signal_Override /end SUB_GROUP /end GROUP
/begin GROUP S5_VDID_OVCR_sec_Inproc "SWC_OUTP_type/run_SWC_OUTP_5ms_sys/OUTP/outpmodule/VDID_OVCR_sec_Inproc" /begin SUB_GROUP S462_Signal_Limit S462_Signal_Override /end SUB_GROUP /end GROUP
/begin GROUP S5_VDID_PKELNumerator_kphsqr_Inproc "SWC_OUTP_type/run_SWC_OUTP_5ms_sys/OUTP/outpmodule/VDID_PKELNumerator_kphsqr_Inproc" /begin SUB_GROUP S463_Signal_Limit S463_Signal_Override /end SUB_GROUP /end GROUP
/begin GROUP S5_VDID_PKEL_kphsqr_Inproc "SWC_OUTP_type/run_SWC_OUTP_5ms_sys/OUTP/outpmodule/VDID_PKEL_kphsqr_Inproc" /begin SUB_GROUP S464_Signal_Limit S464_Signal_Override /end SUB_GROUP /end GROUP
/begin GROUP S5_VDID_PKERNumerator_kphsqr_Inproc "SWC_OUTP_type/run_SWC_OUTP_5ms_sys/OUTP/outpmodule/VDID_PKERNumerator_kphsqr_Inproc" /begin SUB_GROUP S465_Signal_Limit S465_Signal_Override /end SUB_GROUP /end GROUP
/begin GROUP S5_VDID_PKER_kphsqr_Inproc "SWC_OUTP_type/run_SWC_OUTP_5ms_sys/OUTP/outpmodule/VDID_PKER_kphsqr_Inproc" /begin SUB_GROUP S466_Signal_Limit S466_Signal_Override /end SUB_GROUP /end GROUP
/begin GROUP S5_VDID_PROTOCOLID_enum_Inproc "SWC_OUTP_type/run_SWC_OUTP_5ms_sys/OUTP/outpmodule/VDID_PROTOCOLID_enum_Inproc" /begin SUB_GROUP S467_Signal_Limit S467_Signal_Override /end SUB_GROUP /end GROUP
/begin GROUP S5_VDID_PSAL_sec_Inproc "SWC_OUTP_type/run_SWC_OUTP_5ms_sys/OUTP/outpmodule/VDID_PSAL_sec_Inproc" /begin SUB_GROUP S468_Signal_Limit S468_Signal_Override /end SUB_GROUP /end GROUP
/begin GROUP S5_VDID_PSAR_sec_Inproc "SWC_OUTP_type/run_SWC_OUTP_5ms_sys/OUTP/outpmodule/VDID_PSAR_sec_Inproc" /begin SUB_GROUP S469_Signal_Limit S469_Signal_Override /end SUB_GROUP /end GROUP
/begin GROUP S5_VDID_QTYPSATRIPSL_cnt_Inproc "SWC_OUTP_type/run_SWC_OUTP_5ms_sys/OUTP/outpmodule/VDID_QTYPSATRIPSL_cnt_Inproc" /begin SUB_GROUP S470_Signal_Limit S470_Signal_Override /end SUB_GROUP /end GROUP
/begin GROUP S5_VDID_QTYPSATRIPSR_cnt_Inproc "SWC_OUTP_type/run_SWC_OUTP_5ms_sys/OUTP/outpmodule/VDID_QTYPSATRIPSR_cnt_Inproc" /begin SUB_GROUP S471_Signal_Limit S471_Signal_Override /end SUB_GROUP /end GROUP
/begin GROUP S5_VDID_RESSCNTDODRNGL_cnt_Inproc "SWC_OUTP_type/run_SWC_OUTP_5ms_sys/OUTP/outpmodule/VDID_RESSCNTDODRNGL_cnt_Inproc" /begin SUB_GROUP S472_Signal_Limit S472_Signal_Override /end SUB_GROUP /end GROUP
/begin GROUP S5_VDID_RESSCNTDODRNGR_cnt_Inproc "SWC_OUTP_type/run_SWC_OUTP_5ms_sys/OUTP/outpmodule/VDID_RESSCNTDODRNGR_cnt_Inproc" /begin SUB_GROUP S473_Signal_Limit S473_Signal_Override /end SUB_GROUP /end GROUP
/begin GROUP S5_VDID_RESSCNTSDODRNGAXIS_enum_Inproc "SWC_OUTP_type/run_SWC_OUTP_5ms_sys/OUTP/outpmodule/VDID_RESSCNTSDODRNGAXIS_enum_Inproc" /begin SUB_GROUP S474_Signal_Limit S474_Signal_Override /end SUB_GROUP /end GROUP
/begin GROUP S5_VDID_RESSTIMESOCCHGRNGL_s_Inproc "SWC_OUTP_type/run_SWC_OUTP_5ms_sys/OUTP/outpmodule/VDID_RESSTIMESOCCHGRNGL_s_Inproc" /begin SUB_GROUP S475_Signal_Limit S475_Signal_Override /end SUB_GROUP /end GROUP
/begin GROUP S5_VDID_RESSTIMESOCCHGRNGR_s_Inproc "SWC_OUTP_type/run_SWC_OUTP_5ms_sys/OUTP/outpmodule/VDID_RESSTIMESOCCHGRNGR_s_Inproc" /begin SUB_GROUP S476_Signal_Limit S476_Signal_Override /end SUB_GROUP /end GROUP
/begin GROUP S5_VDID_RESSTIMESOCOFFRNGL_s_Inproc "SWC_OUTP_type/run_SWC_OUTP_5ms_sys/OUTP/outpmodule/VDID_RESSTIMESOCOFFRNGL_s_Inproc" /begin SUB_GROUP S477_Signal_Limit S477_Signal_Override /end SUB_GROUP /end GROUP
/begin GROUP S5_VDID_RESSTIMESOCOFFRNGR_s_Inproc "SWC_OUTP_type/run_SWC_OUTP_5ms_sys/OUTP/outpmodule/VDID_RESSTIMESOCOFFRNGR_s_Inproc" /begin SUB_GROUP S478_Signal_Limit S478_Signal_Override /end SUB_GROUP /end GROUP
/begin GROUP S5_VDID_RESSTIMESOCPSARNGL_s_Inproc "SWC_OUTP_type/run_SWC_OUTP_5ms_sys/OUTP/outpmodule/VDID_RESSTIMESOCPSARNGL_s_Inproc" /begin SUB_GROUP S479_Signal_Limit S479_Signal_Override /end SUB_GROUP /end GROUP
/begin GROUP S5_VDID_RESSTIMESOCPSARNGR_s_Inproc "SWC_OUTP_type/run_SWC_OUTP_5ms_sys/OUTP/outpmodule/VDID_RESSTIMESOCPSARNGR_s_Inproc" /begin SUB_GROUP S480_Signal_Limit S480_Signal_Override /end SUB_GROUP /end GROUP
/begin GROUP S5_VDID_RESSTIMESOCRNGAXIS_enum_Inproc "SWC_OUTP_type/run_SWC_OUTP_5ms_sys/OUTP/outpmodule/VDID_RESSTIMESOCRNGAXIS_enum_Inproc" /begin SUB_GROUP S481_Signal_Limit S481_Signal_Override /end SUB_GROUP /end GROUP
/begin GROUP S5_VDID_RESSTTEMPRNGAXIS_enum_Inproc "SWC_OUTP_type/run_SWC_OUTP_5ms_sys/OUTP/outpmodule/VDID_RESSTTEMPRNGAXIS_enum_Inproc" /begin SUB_GROUP S482_Signal_Limit S482_Signal_Override /end SUB_GROUP /end GROUP
/begin GROUP S5_VDID_RESSV2XENNONPSAL_kWh_Inproc "SWC_OUTP_type/run_SWC_OUTP_5ms_sys/OUTP/outpmodule/VDID_RESSV2XENNONPSAL_kWh_Inproc" /begin SUB_GROUP S483_Signal_Limit S483_Signal_Override /end SUB_GROUP /end GROUP
/begin GROUP S5_VDID_RESSV2XENNONPSAR_kWh_Inproc "SWC_OUTP_type/run_SWC_OUTP_5ms_sys/OUTP/outpmodule/VDID_RESSV2XENNONPSAR_kWh_Inproc" /begin SUB_GROUP S484_Signal_Limit S484_Signal_Override /end SUB_GROUP /end GROUP
/begin GROUP S5_VDID_RUNTM_s_Inproc "SWC_OUTP_type/run_SWC_OUTP_5ms_sys/OUTP/outpmodule/VDID_RUNTM_s_Inproc" /begin SUB_GROUP S485_Signal_Limit S485_Signal_Override /end SUB_GROUP /end GROUP
/begin GROUP S5_VDID_ResetCDEODTR_km_Inproc "SWC_OUTP_type/run_SWC_OUTP_5ms_sys/OUTP/outpmodule/VDID_ResetCDEODTR_km_Inproc" /begin SUB_GROUP S486_Signal_Limit S486_Signal_Override /end SUB_GROUP /end GROUP
/begin GROUP S5_VDID_STASUP_enum_Inproc "SWC_OUTP_type/run_SWC_OUTP_5ms_sys/OUTP/outpmodule/VDID_STASUP_enum_Inproc" /begin SUB_GROUP S487_Signal_Limit S487_Signal_Override /end SUB_GROUP /end GROUP
/begin GROUP S5_VDID_TEBPSAL_kWh_Inproc "SWC_OUTP_type/run_SWC_OUTP_5ms_sys/OUTP/outpmodule/VDID_TEBPSAL_kWh_Inproc" /begin SUB_GROUP S488_Signal_Limit S488_Signal_Override /end SUB_GROUP /end GROUP
/begin GROUP S5_VDID_TEBPSAR_kWh_Inproc "SWC_OUTP_type/run_SWC_OUTP_5ms_sys/OUTP/outpmodule/VDID_TEBPSAR_kWh_Inproc" /begin SUB_GROUP S489_Signal_Limit S489_Signal_Override /end SUB_GROUP /end GROUP
/begin GROUP S5_VDID_TGEOVCL_kWh_Inproc "SWC_OUTP_type/run_SWC_OUTP_5ms_sys/OUTP/outpmodule/VDID_TGEOVCL_kWh_Inproc" /begin SUB_GROUP S490_Signal_Limit S490_Signal_Override /end SUB_GROUP /end GROUP
/begin GROUP S5_VDID_TGEOVCR_kWh_Inproc "SWC_OUTP_type/run_SWC_OUTP_5ms_sys/OUTP/outpmodule/VDID_TGEOVCR_kWh_Inproc" /begin SUB_GROUP S491_Signal_Limit S491_Signal_Override /end SUB_GROUP /end GROUP
/begin GROUP S5_VDID_TNBCPSAL_Ahr_Inproc "SWC_OUTP_type/run_SWC_OUTP_5ms_sys/OUTP/outpmodule/VDID_TNBCPSAL_Ahr_Inproc" /begin SUB_GROUP S492_Signal_Limit S492_Signal_Override /end SUB_GROUP /end GROUP
/begin GROUP S5_VDID_TNBCPSAR_Ahr_Inproc "SWC_OUTP_type/run_SWC_OUTP_5ms_sys/OUTP/outpmodule/VDID_TNBCPSAR_Ahr_Inproc" /begin SUB_GROUP S493_Signal_Limit S493_Signal_Override /end SUB_GROUP /end GROUP
/begin GROUP S5_VDID_TNECPSAL_kWh_Inproc "SWC_OUTP_type/run_SWC_OUTP_5ms_sys/OUTP/outpmodule/VDID_TNECPSAL_kWh_Inproc" /begin SUB_GROUP S494_Signal_Limit S494_Signal_Override /end SUB_GROUP /end GROUP
/begin GROUP S5_VDID_TNECPSAR_kWh_Inproc "SWC_OUTP_type/run_SWC_OUTP_5ms_sys/OUTP/outpmodule/VDID_TNECPSAR_kWh_Inproc" /begin SUB_GROUP S495_Signal_Limit S495_Signal_Override /end SUB_GROUP /end GROUP
/begin GROUP S5_VDID_VSS_kph_Inproc "SWC_OUTP_type/run_SWC_OUTP_5ms_sys/OUTP/outpmodule/VDID_VSS_kph_Inproc" /begin SUB_GROUP S496_Signal_Limit S496_Signal_Override /end SUB_GROUP /end GROUP
/begin GROUP S5_VDID_VinCode_cnt_Inproc "SWC_OUTP_type/run_SWC_OUTP_5ms_sys/OUTP/outpmodule/VDID_VinCode_cnt_Inproc" /begin SUB_GROUP S497_Signal_Limit S497_Signal_Override /end SUB_GROUP /end GROUP
/begin GROUP S5_VDID_WARMUPS_cnt_Inproc "SWC_OUTP_type/run_SWC_OUTP_5ms_sys/OUTP/outpmodule/VDID_WARMUPS_cnt_Inproc" /begin SUB_GROUP S498_Signal_Limit S498_Signal_Override /end SUB_GROUP /end GROUP
/begin GROUP S5_VDKC_DKCAuthSta_enum_Inproc "SWC_OUTP_type/run_SWC_OUTP_5ms_sys/OUTP/outpmodule/VDKC_DKCAuthSta_enum_Inproc" /begin SUB_GROUP S499_Signal_Limit S499_Signal_Override /end SUB_GROUP /end GROUP
/begin GROUP S5_VDKC_DKCTimeSN_cnt_Inproc "SWC_OUTP_type/run_SWC_OUTP_5ms_sys/OUTP/outpmodule/VDKC_DKCTimeSN_cnt_Inproc" /begin SUB_GROUP S500_Signal_Limit S500_Signal_Override /end SUB_GROUP /end GROUP
/begin GROUP S5_VDKC_DKeyWelcomeSta_enum_Inproc "SWC_OUTP_type/run_SWC_OUTP_5ms_sys/OUTP/outpmodule/VDKC_DKeyWelcomeSta_enum_Inproc" /begin SUB_GROUP S501_Signal_Limit S501_Signal_Override /end SUB_GROUP /end GROUP
/begin GROUP S5_VDKC_DkeyAreaRAPSSta_enum_Inproc "SWC_OUTP_type/run_SWC_OUTP_5ms_sys/OUTP/outpmodule/VDKC_DkeyAreaRAPSSta_enum_Inproc" /begin SUB_GROUP S502_Signal_Limit S502_Signal_Override /end SUB_GROUP /end GROUP
/begin GROUP S5_VDKC_DkeyShowIVISta_enum_Inproc "SWC_OUTP_type/run_SWC_OUTP_5ms_sys/OUTP/outpmodule/VDKC_DkeyShowIVISta_enum_Inproc" /begin SUB_GROUP S503_Signal_Limit S503_Signal_Override /end SUB_GROUP /end GROUP
/begin GROUP S5_VDKC_FDCDKCAllowSleep_flg_Inproc "SWC_OUTP_type/run_SWC_OUTP_5ms_sys/OUTP/outpmodule/VDKC_FDCDKCAllowSleep_flg_Inproc" /begin SUB_GROUP S504_Signal_Limit S504_Signal_Override /end SUB_GROUP /end GROUP
/begin GROUP S5_VDKC_JudgeKeepUnlockZone_flg_Inproc "SWC_OUTP_type/run_SWC_OUTP_5ms_sys/OUTP/outpmodule/VDKC_JudgeKeepUnlockZone_flg_Inproc" /begin SUB_GROUP S505_Signal_Limit S505_Signal_Override /end SUB_GROUP /end GROUP
/begin GROUP S5_VDKC_KeyAreaLockUnlock_enum_Inproc "SWC_OUTP_type/run_SWC_OUTP_5ms_sys/OUTP/outpmodule/VDKC_KeyAreaLockUnlock_enum_Inproc" /begin SUB_GROUP S506_Signal_Limit S506_Signal_Override /end SUB_GROUP /end GROUP
/begin GROUP S5_VDKC_KeyAreaPS_enum_Inproc "SWC_OUTP_type/run_SWC_OUTP_5ms_sys/OUTP/outpmodule/VDKC_KeyAreaPS_enum_Inproc" /begin SUB_GROUP S507_Signal_Limit S507_Signal_Override /end SUB_GROUP /end GROUP
/begin GROUP S5_VDKC_KeyAreaPTG_enum_Inproc "SWC_OUTP_type/run_SWC_OUTP_5ms_sys/OUTP/outpmodule/VDKC_KeyAreaPTG_enum_Inproc" /begin SUB_GROUP S508_Signal_Limit S508_Signal_Override /end SUB_GROUP /end GROUP
/begin GROUP S5_VDKC_KeyAreaSPTGSta_enum_Inproc "SWC_OUTP_type/run_SWC_OUTP_5ms_sys/OUTP/outpmodule/VDKC_KeyAreaSPTGSta_enum_Inproc" /begin SUB_GROUP S509_Signal_Limit S509_Signal_Override /end SUB_GROUP /end GROUP
/begin GROUP S5_VDKC_KeyMissSta_flg_Inproc "SWC_OUTP_type/run_SWC_OUTP_5ms_sys/OUTP/outpmodule/VDKC_KeyMissSta_flg_Inproc" /begin SUB_GROUP S510_Signal_Limit S510_Signal_Override /end SUB_GROUP /end GROUP
/begin GROUP S5_VDKC_KeyModeSta_enum_Inproc "SWC_OUTP_type/run_SWC_OUTP_5ms_sys/OUTP/outpmodule/VDKC_KeyModeSta_enum_Inproc" /begin SUB_GROUP S511_Signal_Limit S511_Signal_Override /end SUB_GROUP /end GROUP
/begin GROUP S5_VDKC_KeyNumSta_enum_Inproc "SWC_OUTP_type/run_SWC_OUTP_5ms_sys/OUTP/outpmodule/VDKC_KeyNumSta_enum_Inproc" /begin SUB_GROUP S512_Signal_Limit S512_Signal_Override /end SUB_GROUP /end GROUP
/begin GROUP S5_VDKC_KeyTypeSta_enum_Inproc "SWC_OUTP_type/run_SWC_OUTP_5ms_sys/OUTP/outpmodule/VDKC_KeyTypeSta_enum_Inproc" /begin SUB_GROUP S513_Signal_Limit S513_Signal_Override /end SUB_GROUP /end GROUP
/begin GROUP S5_VDKC_PCommandToBCM_enum_Inproc "SWC_OUTP_type/run_SWC_OUTP_5ms_sys/OUTP/outpmodule/VDKC_PCommandToBCM_enum_Inproc" /begin SUB_GROUP S514_Signal_Limit S514_Signal_Override /end SUB_GROUP /end GROUP
/begin GROUP S5_VDKC_ParkingModeCmd_enum_Inproc "SWC_OUTP_type/run_SWC_OUTP_5ms_sys/OUTP/outpmodule/VDKC_ParkingModeCmd_enum_Inproc" /begin SUB_GROUP S515_Signal_Limit S515_Signal_Override /end SUB_GROUP /end GROUP
/begin GROUP S5_VDKC_TimeSNDKCFbk_cnt_Inproc "SWC_OUTP_type/run_SWC_OUTP_5ms_sys/OUTP/outpmodule/VDKC_TimeSNDKCFbk_cnt_Inproc" /begin SUB_GROUP S516_Signal_Limit S516_Signal_Override /end SUB_GROUP /end GROUP
/begin GROUP S5_VDKC_UIDLowPowerSta_enum_Inproc "SWC_OUTP_type/run_SWC_OUTP_5ms_sys/OUTP/outpmodule/VDKC_UIDLowPowerSta_enum_Inproc" /begin SUB_GROUP S517_Signal_Limit S517_Signal_Override /end SUB_GROUP /end GROUP
/begin GROUP S5_VDSC_DISCButtSta_flg_Inproc "SWC_OUTP_type/run_SWC_OUTP_5ms_sys/OUTP/outpmodule/VDSC_DISCButtSta_flg_Inproc" /begin SUB_GROUP S518_Signal_Limit S518_Signal_Override /end SUB_GROUP /end GROUP
/begin GROUP S5_VDSC_DISCSta_enum_Inproc "SWC_OUTP_type/run_SWC_OUTP_5ms_sys/OUTP/outpmodule/VDSC_DISCSta_enum_Inproc" /begin SUB_GROUP S519_Signal_Limit S519_Signal_Override /end SUB_GROUP /end GROUP
/begin GROUP S5_VDSC_DISCTargetSpd_kph_Inproc "SWC_OUTP_type/run_SWC_OUTP_5ms_sys/OUTP/outpmodule/VDSC_DISCTargetSpd_kph_Inproc" /begin SUB_GROUP S520_Signal_Limit S520_Signal_Override /end SUB_GROUP /end GROUP
/begin GROUP S5_VDSC_DISCTurn_flg_Inproc "SWC_OUTP_type/run_SWC_OUTP_5ms_sys/OUTP/outpmodule/VDSC_DISCTurn_flg_Inproc" /begin SUB_GROUP S521_Signal_Limit S521_Signal_Override /end SUB_GROUP /end GROUP
/begin GROUP S5_VNMM_ActiveWU_flg_Inproc "SWC_OUTP_type/run_SWC_OUTP_5ms_sys/OUTP/outpmodule/VNMM_ActiveWU_flg_Inproc" /begin SUB_GROUP S522_Signal_Limit S522_Signal_Override /end SUB_GROUP /end GROUP
/begin GROUP S5_VNMM_AllCANTxReq_flg_Inproc "SWC_OUTP_type/run_SWC_OUTP_5ms_sys/OUTP/outpmodule/VNMM_AllCANTxReq_flg_Inproc" /begin SUB_GROUP S523_Signal_Limit S523_Signal_Override /end SUB_GROUP /end GROUP
/begin GROUP S5_VNMM_Awake_enum_Inproc "SWC_OUTP_type/run_SWC_OUTP_5ms_sys/OUTP/outpmodule/VNMM_Awake_enum_Inproc" /begin SUB_GROUP S524_Signal_Limit S524_Signal_Override /end SUB_GROUP /end GROUP
/begin GROUP S5_VNMM_CSB_flg_Inproc "SWC_OUTP_type/run_SWC_OUTP_5ms_sys/OUTP/outpmodule/VNMM_CSB_flg_Inproc" /begin SUB_GROUP S525_Signal_Limit S525_Signal_Override /end SUB_GROUP /end GROUP
/begin GROUP S5_VNMM_ErrorState_enum_Inproc "SWC_OUTP_type/run_SWC_OUTP_5ms_sys/OUTP/outpmodule/VNMM_ErrorState_enum_Inproc" /begin SUB_GROUP S526_Signal_Limit S526_Signal_Override /end SUB_GROUP /end GROUP
/begin GROUP S5_VNMM_NMmTxReq_flg_Inproc "SWC_OUTP_type/run_SWC_OUTP_5ms_sys/OUTP/outpmodule/VNMM_NMmTxReq_flg_Inproc" /begin SUB_GROUP S527_Signal_Limit S527_Signal_Override /end SUB_GROUP /end GROUP
/begin GROUP S5_VNMM_NetworkReq_flg_Inproc "SWC_OUTP_type/run_SWC_OUTP_5ms_sys/OUTP/outpmodule/VNMM_NetworkReq_flg_Inproc" /begin SUB_GROUP S528_Signal_Limit S528_Signal_Override /end SUB_GROUP /end GROUP
/end MODULE
/end PROJECT
