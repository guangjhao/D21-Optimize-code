AUTOSAR XML (schema 4-3-0)
package /CANInterface_ARPkg
  103 x sender receiver interface:
    IF_CAN1_SG_ASC2_A
      data CAN1_SG_ASC2_A: type=DT_CAN1_SG_ASC2_A
    IF_CAN1_SG_CCVS
      data CAN1_SG_CCVS: type=DT_CAN1_SG_CCVS
    IF_CAN1_SG_CFGEM1_BAM
      data CAN1_SG_CFGEM1_BAM: type=DT_CAN1_SG_CFGEM1_BAM
    IF_CAN1_SG_CFGEM1_DT
      data CAN1_SG_CFGEM1_DT: type=DT_CAN1_SG_CFGEM1_DT
    IF_CAN1_SG_DCDC_Status_1
      data CAN1_SG_DCDC_Status_1: type=DT_CAN1_SG_DCDC_Status_1
    IF_CAN1_SG_DCDC_Status_2
      data CAN1_SG_DCDC_Status_2: type=DT_CAN1_SG_DCDC_Status_2
    IF_CAN1_SG_EAC_Status_1
      data CAN1_SG_EAC_Status_1: type=DT_CAN1_SG_EAC_Status_1
    IF_CAN1_SG_EBC1
      data CAN1_SG_EBC1: type=DT_CAN1_SG_EBC1
    IF_CAN1_SG_EBC2
      data CAN1_SG_EBC2: type=DT_CAN1_SG_EBC2
    IF_CAN1_SG_EBC5
      data CAN1_SG_EBC5: type=DT_CAN1_SG_EBC5
    IF_CAN1_SG_EEC2
      data CAN1_SG_EEC2: type=DT_CAN1_SG_EEC2
    IF_CAN1_SG_EEC3
      data CAN1_SG_EEC3: type=DT_CAN1_SG_EEC3
    IF_CAN1_SG_EHPS_Status_1
      data CAN1_SG_EHPS_Status_1: type=DT_CAN1_SG_EHPS_Status_1
    IF_CAN1_SG_EMC1_EM1
      data CAN1_SG_EMC1_EM1: type=DT_CAN1_SG_EMC1_EM1
    IF_CAN1_SG_EMRC1
      data CAN1_SG_EMRC1: type=DT_CAN1_SG_EMRC1
    IF_CAN1_SG_EPB1
      data CAN1_SG_EPB1: type=DT_CAN1_SG_EPB1
    IF_CAN1_SG_ETC1
      data CAN1_SG_ETC1: type=DT_CAN1_SG_ETC1
    IF_CAN1_SG_ETC2
      data CAN1_SG_ETC2: type=DT_CAN1_SG_ETC2
    IF_CAN1_SG_FD1_C100_1
      data CAN1_SG_FD1_C100_1: type=DT_CAN1_SG_FD1_C100_1
    IF_CAN1_SG_FD1_C100_2
      data CAN1_SG_FD1_C100_2: type=DT_CAN1_SG_FD1_C100_2
    IF_CAN1_SG_FD1_C100_3
      data CAN1_SG_FD1_C100_3: type=DT_CAN1_SG_FD1_C100_3
    IF_CAN1_SG_FD1_CE100_1
      data CAN1_SG_FD1_CE100_1: type=DT_CAN1_SG_FD1_CE100_1
    IF_CAN1_SG_GW1_C1000_1
      data CAN1_SG_GW1_C1000_1: type=DT_CAN1_SG_GW1_C1000_1
    IF_CAN1_SG_GW1_C100_4
      data CAN1_SG_GW1_C100_4: type=DT_CAN1_SG_GW1_C100_4
    IF_CAN1_SG_PDU_Status_1
      data CAN1_SG_PDU_Status_1: type=DT_CAN1_SG_PDU_Status_1
    IF_CAN1_SG_VCU_PDU_Demand_1
      data CAN1_SG_VCU_PDU_Demand_1: type=DT_CAN1_SG_VCU_PDU_Demand_1
    IF_CAN2_SG_FD2_C200_1
      data CAN2_SG_FD2_C200_1: type=DT_CAN2_SG_FD2_C200_1
    IF_CAN2_SG_FD2_C20_0
      data CAN2_SG_FD2_C20_0: type=DT_CAN2_SG_FD2_C20_0
    IF_CAN2_SG_FD2_CE100_0
      data CAN2_SG_FD2_CE100_0: type=DT_CAN2_SG_FD2_CE100_0
    IF_CAN2_SG_FD2_CE100_1
      data CAN2_SG_FD2_CE100_1: type=DT_CAN2_SG_FD2_CE100_1
    IF_CAN2_SG_FD2_CE200_1
      data CAN2_SG_FD2_CE200_1: type=DT_CAN2_SG_FD2_CE200_1
    IF_CAN2_SG_FD2_OTA1
      data CAN2_SG_FD2_OTA1: type=DT_CAN2_SG_FD2_OTA1
    IF_CAN2_SG_FD2_Version
      data CAN2_SG_FD2_Version: type=DT_CAN2_SG_FD2_Version
    IF_CAN2_SG_GW2_C10_0
      data CAN2_SG_GW2_C10_0: type=DT_CAN2_SG_GW2_C10_0
    IF_CAN2_SG_CGW_GW2_C10_0
      data CAN2_SG_CGW_GW2_C10_0: type=DT_CAN2_SG_CGW_GW2_C10_0
    IF_CAN2_SG_GW2_CE1000_0
      data CAN2_SG_GW2_CE1000_0: type=DT_CAN2_SG_GW2_CE1000_0
    IF_CAN2_SG_GW2_CE100_0
      data CAN2_SG_GW2_CE100_0: type=DT_CAN2_SG_GW2_CE100_0
    IF_CAN2_SG_GW2_CE100_1
      data CAN2_SG_GW2_CE100_1: type=DT_CAN2_SG_GW2_CE100_1
    IF_CAN2_SG_GW2_CE100_2
      data CAN2_SG_GW2_CE100_2: type=DT_CAN2_SG_GW2_CE100_2
    IF_CAN2_SG_IVI1
      data CAN2_SG_IVI1: type=DT_CAN2_SG_IVI1
    IF_CAN2_SG_IVI2
      data CAN2_SG_IVI2: type=DT_CAN2_SG_IVI2
    IF_CAN2_SG_IVI3
      data CAN2_SG_IVI3: type=DT_CAN2_SG_IVI3
    IF_CAN2_SG_IVI_P20_0
      data CAN2_SG_IVI_P20_0: type=DT_CAN2_SG_IVI_P20_0
    IF_CAN2_SG_METER1
      data CAN2_SG_METER1: type=DT_CAN2_SG_METER1
    IF_CAN3_SG_BMS1
      data CAN3_SG_BMS1: type=DT_CAN3_SG_BMS1
    IF_CAN3_SG_BMS3
      data CAN3_SG_BMS3: type=DT_CAN3_SG_BMS3
    IF_CAN3_SG_BMS4
      data CAN3_SG_BMS4: type=DT_CAN3_SG_BMS4
    IF_CAN3_SG_BMS5
      data CAN3_SG_BMS5: type=DT_CAN3_SG_BMS5
    IF_CAN3_SG_BMS6
      data CAN3_SG_BMS6: type=DT_CAN3_SG_BMS6
    IF_CAN3_SG_BMS8
      data CAN3_SG_BMS8: type=DT_CAN3_SG_BMS8
    IF_CAN3_SG_CCU1
      data CAN3_SG_CCU1: type=DT_CAN3_SG_CCU1
    IF_CAN3_SG_CCU2
      data CAN3_SG_CCU2: type=DT_CAN3_SG_CCU2
    IF_CAN3_SG_FD3_BCM1
      data CAN3_SG_FD3_BCM1: type=DT_CAN3_SG_FD3_BCM1
    IF_CAN3_SG_FD3_OTA1
      data CAN3_SG_FD3_OTA1: type=DT_CAN3_SG_FD3_OTA1
    IF_CAN3_SG_FD3_THCM1
      data CAN3_SG_FD3_THCM1: type=DT_CAN3_SG_FD3_THCM1
    IF_CAN3_SG_FD3_THCM2
      data CAN3_SG_FD3_THCM2: type=DT_CAN3_SG_FD3_THCM2
    IF_CAN3_SG_FD3_V2L1
      data CAN3_SG_FD3_V2L1: type=DT_CAN3_SG_FD3_V2L1
    IF_CAN3_SG_FD3_VCU0
      data CAN3_SG_FD3_VCU0: type=DT_CAN3_SG_FD3_VCU0
    IF_CAN3_SG_FD3_VCU1
      data CAN3_SG_FD3_VCU1: type=DT_CAN3_SG_FD3_VCU1
    IF_CAN3_SG_FD3_VCU1_toNIDEC
      data CAN3_SG_FD3_VCU1_toNIDEC: type=DT_CAN3_SG_FD3_VCU1_toNIDEC
    IF_CAN3_SG_FD3_VCU2
      data CAN3_SG_FD3_VCU2: type=DT_CAN3_SG_FD3_VCU2
    IF_CAN3_SG_FD3_VCU2_toNIDEC
      data CAN3_SG_FD3_VCU2_toNIDEC: type=DT_CAN3_SG_FD3_VCU2_toNIDEC
    IF_CAN3_SG_FD3_VCU4
      data CAN3_SG_FD3_VCU4: type=DT_CAN3_SG_FD3_VCU4
    IF_CAN3_SG_FD3_VCU5
      data CAN3_SG_FD3_VCU5: type=DT_CAN3_SG_FD3_VCU5
    IF_CAN3_SG_GW3_CE100_0
      data CAN3_SG_GW3_CE100_0: type=DT_CAN3_SG_GW3_CE100_0
    IF_CAN3_SG_CGW_GW3_CE100_0
      data CAN3_SG_CGW_GW3_CE100_0: type=DT_CAN3_SG_CGW_GW3_CE100_0
    IF_CAN3_SG_MCU_B_R1
      data CAN3_SG_MCU_B_R1: type=DT_CAN3_SG_MCU_B_R1
    IF_CAN3_SG_MCU_B_R2
      data CAN3_SG_MCU_B_R2: type=DT_CAN3_SG_MCU_B_R2
    IF_CAN3_SG_Shifter1
      data CAN3_SG_Shifter1: type=DT_CAN3_SG_Shifter1
    IF_CAN4_SG_DKC1
      data CAN4_SG_DKC1: type=DT_CAN4_SG_DKC1
    IF_CAN4_SG_DKC2
      data CAN4_SG_DKC2: type=DT_CAN4_SG_DKC2
    IF_CAN4_SG_FD4_C100_0
      data CAN4_SG_FD4_C100_0: type=DT_CAN4_SG_FD4_C100_0
    IF_CAN4_SG_FD4_CE100_0
      data CAN4_SG_FD4_CE100_0: type=DT_CAN4_SG_FD4_CE100_0
    IF_CAN4_SG_FD4_CE100_1
      data CAN4_SG_FD4_CE100_1: type=DT_CAN4_SG_FD4_CE100_1
    IF_CAN4_SG_FD4_CE100_2
      data CAN4_SG_FD4_CE100_2: type=DT_CAN4_SG_FD4_CE100_2
    IF_CAN4_SG_FD4_CE100_3
      data CAN4_SG_FD4_CE100_3: type=DT_CAN4_SG_FD4_CE100_3
    IF_CAN4_SG_FD4_CE200_0
      data CAN4_SG_FD4_CE200_0: type=DT_CAN4_SG_FD4_CE200_0
    IF_CAN4_SG_FD4_OTA1
      data CAN4_SG_FD4_OTA1: type=DT_CAN4_SG_FD4_OTA1
    IF_CAN4_SG_GW4_CE100_0
      data CAN4_SG_GW4_CE100_0: type=DT_CAN4_SG_GW4_CE100_0
    IF_CAN4_SG_CGW_GW4_CE100_0
      data CAN4_SG_CGW_GW4_CE100_0: type=DT_CAN4_SG_CGW_GW4_CE100_0
    IF_CAN4_SG_GW4_CE200_0
      data CAN4_SG_GW4_CE200_0: type=DT_CAN4_SG_GW4_CE200_0
    IF_CAN4_SG_Z24_C1000_0
      data CAN4_SG_Z24_C1000_0: type=DT_CAN4_SG_Z24_C1000_0
    IF_CAN4_SG_Z24_CE100_0
      data CAN4_SG_Z24_CE100_0: type=DT_CAN4_SG_Z24_CE100_0
    IF_CAN4_SG_ZONE_DR1
      data CAN4_SG_ZONE_DR1: type=DT_CAN4_SG_ZONE_DR1
    IF_CAN4_SG_ZONE_DR_VCU
      data CAN4_SG_ZONE_DR_VCU: type=DT_CAN4_SG_ZONE_DR_VCU
    IF_CAN4_SG_ZONE_FR1
      data CAN4_SG_ZONE_FR1: type=DT_CAN4_SG_ZONE_FR1
    IF_CAN4_SG_ZONE_FR_VCU
      data CAN4_SG_ZONE_FR_VCU: type=DT_CAN4_SG_ZONE_FR_VCU
    IF_CAN4_SG_zGW_APTC1
      data CAN4_SG_zGW_APTC1: type=DT_CAN4_SG_zGW_APTC1
    IF_CAN4_SG_zGW_CANFr1
      data CAN4_SG_zGW_CANFr1: type=DT_CAN4_SG_zGW_CANFr1
    IF_CAN4_SG_zGW_LINDr1
      data CAN4_SG_zGW_LINDr1: type=DT_CAN4_SG_zGW_LINDr1
    IF_CAN5_SG_FD5_CE100_0
      data CAN5_SG_FD5_CE100_0: type=DT_CAN5_SG_FD5_CE100_0
    IF_CAN5_SG_FD5_Debug1
      data CAN5_SG_FD5_Debug1: type=DT_CAN5_SG_FD5_Debug1
    IF_CAN5_SG_FD5_Debug2
      data CAN5_SG_FD5_Debug2: type=DT_CAN5_SG_FD5_Debug2
    IF_CAN5_SG_FD5_Debug3
      data CAN5_SG_FD5_Debug3: type=DT_CAN5_SG_FD5_Debug3
    IF_CAN5_SG_FD5_OTA1
      data CAN5_SG_FD5_OTA1: type=DT_CAN5_SG_FD5_OTA1
    IF_CAN5_SG_GW5_CE100_0
      data CAN5_SG_GW5_CE100_0: type=DT_CAN5_SG_GW5_CE100_0
    IF_CAN5_SG_CGW_GW5_CE100_0
      data CAN5_SG_CGW_GW5_CE100_0: type=DT_CAN5_SG_CGW_GW5_CE100_0
    IF_CAN5_SG_TBOX1
      data CAN5_SG_TBOX1: type=DT_CAN5_SG_TBOX1
    IF_CAN5_SG_TBOX2
      data CAN5_SG_TBOX2: type=DT_CAN5_SG_TBOX2
    IF_CAN5_SG_TBOX3
      data CAN5_SG_TBOX3: type=DT_CAN5_SG_TBOX3
    IF_CAN7_SG_Door_Fr1
      data CAN7_SG_Door_Fr1: type=DT_CAN7_SG_Door_Fr1
    IF_CAN7_SG_FD7_CE100_0
      data CAN7_SG_FD7_CE100_0: type=DT_CAN7_SG_FD7_CE100_0
    IF_CAN7_SG_FD7_CE100_1
      data CAN7_SG_FD7_CE100_1: type=DT_CAN7_SG_FD7_CE100_1
