AUTOSAR XML (schema 4-3-0)
package /ECU
  ecu instance FUSION: associated-com-i-pdu-group=[FUSION_CAN1_Tx, FUSION_CAN1_Rx, FUSION_CAN2_Tx, FUSION_CAN2_Rx, FUSION_CAN3_Tx, FUSION_CAN3_Rx, FUSION_CAN4_Tx, FUSION_CAN4_Rx, FUSION_CAN5_Tx, FUSION_CAN5_Rx, FUSION_CAN7_Tx, FUSION_CAN7_Rx], com-configuration-gw-time-base=0.005, com-configuration-rx-time-base=0.005, com-configuration-tx-time-base=0.005
    6 x can communication controller:
      CAN{1..5}
      CAN7
    can communication connector ConnCAN{1..5}: comm-controller=CAN{1..5}
    can communication connector ConnCAN7: comm-controller=CAN7
