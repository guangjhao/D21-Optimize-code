AUTOSAR XML (schema 4-3-0)
package /Gateway
  gateway Gateway_FUSION: ecu=FUSION
    signal-mappings:
      source-signal=ST_CAN5_TBOX_NET_SIG_STR, target-signal=ST_CAN2_TBOX_NET_SIG_STR
      source-signal=ST_CAN5_TBOX_TEST_STATUS, target-signal=ST_CAN2_TBOX_TEST_STATUS
      source-signal=ST_CAN5_CbnPreACEnaReq, target-signal=ST_CAN2_CbnPreACEnaReq
      source-signal=ST_CAN5_Re_Radio, target-signal=ST_CAN2_Re_Radio
      source-signal=ST_CAN5_TimeSyncFromBS_Second, target-signal=ST_CAN2_TimeSyncFromBS_Second
      source-signal=ST_CAN5_TimeSyncFromBS_Year, target-signal=ST_CAN2_TimeSyncFromBS_Year
      source-signal=ST_CAN5_TimeSyncFromBS_Month, target-signal=ST_CAN2_TimeSyncFromBS_Month
      source-signal=ST_CAN5_TimeSyncFromBS_Minute, target-signal=ST_CAN2_TimeSyncFromBS_Minute
      source-signal=ST_CAN5_TimeSyncFromBS_Day, target-signal=ST_CAN2_TimeSyncFromBS_Day
      source-signal=ST_CAN5_TimeSyncFromBS_Hour, target-signal=ST_CAN2_TimeSyncFromBS_Hour
      source-signal=ST_CAN5_TBOX_SW_VER, target-signal=ST_CAN2_TBOX_SW_VER
      source-signal=ST_CAN5_Charge_Percent_Set, target-signal=ST_CAN2_Charge_Percent_Set
      source-signal=ST_CAN5_TBOX_HW_VER, target-signal=ST_CAN2_TBOX_HW_VER
      source-signal=ST_CAN4_DrSCPSysErrLmp, target-signal=ST_CAN2_DrSCPSysErrLmp
      source-signal=ST_CAN4_DrPMMLVOutPErrLmp, target-signal=ST_CAN2_DrPMMLVOutPErrLmp
      source-signal=ST_CAN4_DrPMMSysErrLmp, target-signal=ST_CAN2_DrPMMSysErrLmp
      source-signal=ST_CAN4_FrPMMLimpHomeActReq, target-signal=ST_CAN2_FrPMMLimpHomeActReq
      source-signal=ST_CAN4_RLB_Warning, target-signal=ST_CAN2_RLB_Warning
      source-signal=ST_CAN4_RDRL_Warning, target-signal=ST_CAN2_RDRL_Warning
      source-signal=ST_CAN4_RADB_Warning, target-signal=ST_CAN2_RADB_Warning
      source-signal=ST_CAN4_FLTurn_Light_Warning, target-signal=ST_CAN2_FLTurn_Light_Warning
      source-signal=ST_CAN4_FRTurn_Light_Warning, target-signal=ST_CAN2_FRTurn_Light_Warning
      source-signal=ST_CAN4_RADB_Hibeam_Indication, target-signal=ST_CAN2_RADB_Hibeam_Indication
      source-signal=ST_CAN4_Lposition_Lamp_Warning, target-signal=ST_CAN2_Lposition_Lamp_Warning
      source-signal=ST_CAN4_LADB_Operation_Status, target-signal=ST_CAN2_LADB_Operation_Status
      source-signal=ST_CAN4_LLB_Warning, target-signal=ST_CAN2_LLB_Warning
      source-signal=ST_CAN4_LADB_Warning, target-signal=ST_CAN2_LADB_Warning
      source-signal=ST_CAN4_LDRL_Warning, target-signal=ST_CAN2_LDRL_Warning
      source-signal=ST_CAN4_Rposition_Lamp_Warning, target-signal=ST_CAN2_Rposition_Lamp_Warning
      source-signal=ST_CAN4_RAHB_Warning, target-signal=ST_CAN2_RAHB_Warning
      source-signal=ST_CAN4_RADB_Operation_Status, target-signal=ST_CAN2_RADB_Operation_Status
      source-signal=ST_CAN4_LADB_Hibeam_Indication, target-signal=ST_CAN2_LADB_Hibeam_Indication
      source-signal=ST_CAN4_LAHB_Warning, target-signal=ST_CAN2_LAHB_Warning
      source-signal=ST_CAN4_FrntPTCLeActHeatPwr, target-signal=ST_CAN2_FrntPTCLeActHeatPwr
      source-signal=ST_CAN4_FrntPTCRiActHeatPwr, target-signal=ST_CAN2_FrntPTCRiActHeatPwr
      source-signal=ST_CAN4_FrntPTCRearRiActHeatPwr, target-signal=ST_CAN2_FrntPTCRearRiActHeatPwr
      source-signal=ST_CAN4_FrntPTCRearLeActHeatPwr, target-signal=ST_CAN2_FrntPTCRearLeActHeatPwr
      source-signal=ST_CAN4_SWC_RegenUp, target-signal=ST_CAN2_SWC_RegenUp
      source-signal=ST_CAN4_SWC_LKA_Sta, target-signal=ST_CAN2_SWC_LKA_Sta
      source-signal=ST_CAN4_SWC_Left_Sta, target-signal=ST_CAN2_SWC_Left_Sta
      source-signal=ST_CAN4_RLS_Lamp_Sta, target-signal=ST_CAN2_RLS_Lamp_Sta
      source-signal=ST_CAN4_SWC_ACC_Sta, target-signal=ST_CAN2_SWC_ACC_Sta
      source-signal=ST_CAN4_SWC_RegenDown, target-signal=ST_CAN2_SWC_RegenDown
      source-signal=ST_CAN4_SWC_Right_Sta, target-signal=ST_CAN2_SWC_Right_Sta
      source-signal=ST_CAN4_SWC_Down_Sta, target-signal=ST_CAN2_SWC_Down_Sta
      source-signal=ST_CAN4_SWC_Undefined_Sta, target-signal=ST_CAN2_SWC_Undefined_Sta
      source-signal=ST_CAN4_SWC_Up_Sta, target-signal=ST_CAN2_SWC_Up_Sta
      source-signal=ST_CAN4_SWC_VR_Sta, target-signal=ST_CAN2_SWC_VR_Sta
      source-signal=ST_CAN4_SWC_Trip_Sta, target-signal=ST_CAN2_SWC_Trip_Sta
      source-signal=ST_CAN4_SWC_mode_Sta, target-signal=ST_CAN2_SWC_mode_Sta
      source-signal=ST_CAN4_P_KeyMiss, target-signal=ST_CAN2_P_KeyMiss
      source-signal=ST_CAN4_P_UID_LowPower, target-signal=ST_CAN2_P_UID_LowPower
      source-signal=ST_CAN4_P_Dkey_Show_IVI, target-signal=ST_CAN2_P_Dkey_Show_IVI
      source-signal=ST_CAN4_DKC_KeyType_Sta, target-signal=ST_CAN2_DKC_KeyType_Sta
      source-signal=ST_CAN4_DKC_KeyNum_Sta, target-signal=ST_CAN2_DKC_KeyNum_Sta
      source-signal=ST_CAN4_PTCActuPwrHSC6, target-signal=ST_CAN2_PTCActuPwrHSC6
      source-signal=ST_CAN4_COMP_ActualPwr, target-signal=ST_CAN2_COMP_ActualPwr
      source-signal=ST_CAN4_ZFR_EChrg_Active_Sta, target-signal=ST_CAN2_ZFR_EChrg_Active_Sta
      source-signal=ST_CAN4_ZFR_EChrg_Sys_Sta, target-signal=ST_CAN2_ZFR_EChrg_Sys_Sta
      source-signal=ST_CAN4_ZFR_BCM_ChargerDoorSW_Sta, target-signal=ST_CAN2_ZFR_BCM_ChargerDoorSW_Sta
      source-signal=ST_CAN4_ChargeInletLockSta, target-signal=ST_CAN2_ChargeInletLockSta
      source-signal=ST_CAN4_TrailerModeSta, target-signal=ST_CAN2_TrailerModeSta
      source-signal=ST_CAN4_TrailerCheck, target-signal=ST_CAN2_TrailerCheck
      source-signal=ST_CAN4_SWC2_R_PageSwitch_Sta, target-signal=ST_CAN2_SWC2_R_PageSwitch_Sta
      source-signal=ST_CAN4_SWC2_R_Left_Sta, target-signal=ST_CAN2_SWC2_R_Left_Sta
      source-signal=ST_CAN4_SWC2_L_DriveMode_Sta, target-signal=ST_CAN2_SWC2_L_DriveMode_Sta
      source-signal=ST_CAN4_SWC2_R_ScrollDown_Sta, target-signal=ST_CAN2_SWC2_R_ScrollDown_Sta
      source-signal=ST_CAN4_SWC2_R_Right_Sta, target-signal=ST_CAN2_SWC2_R_Right_Sta
      source-signal=ST_CAN4_SWC2_R_ScrollPress_Sta, target-signal=ST_CAN2_SWC2_R_ScrollPress_Sta
      source-signal=ST_CAN4_SWC2_R_VR_Sta, target-signal=ST_CAN2_SWC2_R_VR_Sta
      source-signal=ST_CAN4_SWC2_R_ScrollUp_Sta, target-signal=ST_CAN2_SWC2_R_ScrollUp_Sta
      source-signal=ST_CAN4_SWC2_R_Customize_Sta, target-signal=ST_CAN2_SWC2_R_Customize_Sta
      source-signal=ST_CAN4_SWC2_L_Home_Sta, target-signal=ST_CAN2_SWC2_L_Home_Sta
      source-signal=ST_CAN4_L_RLD_Motor_Relay_Error, target-signal=ST_CAN2_L_RLD_Motor_Relay_Error
      source-signal=ST_CAN4_L_Drv_Motor_Relay_Error, target-signal=ST_CAN2_L_Drv_Motor_Relay_Error
      source-signal=ST_CAN4_L_RRD_Motor_Relay_Error, target-signal=ST_CAN2_L_RRD_Motor_Relay_Error
      source-signal=ST_CAN4_L_Pas_Val_Wdw_Opened, target-signal=ST_CAN2_L_Pas_Val_Wdw_Opened
      source-signal=ST_CAN4_L_RLD_Motor_Ripple_Error, target-signal=ST_CAN2_L_RLD_Motor_Ripple_Error
      source-signal=ST_CAN4_L_Drv_Val_Wdw_Opened, target-signal=ST_CAN2_L_Drv_Val_Wdw_Opened
      source-signal=ST_CAN4_L_Pas_Motor_Relay_Error, target-signal=ST_CAN2_L_Pas_Motor_Relay_Error
      source-signal=ST_CAN4_FAPWL_01_LIN_Response_Error, target-signal=ST_CAN2_FAPWL_01_LIN_Response_Error
      source-signal=ST_CAN4_L_RLD_Val_Wdw_Opened, target-signal=ST_CAN2_L_RLD_Val_Wdw_Opened
      source-signal=ST_CAN4_L_RRD_Val_Wdw_Opened, target-signal=ST_CAN2_L_RRD_Val_Wdw_Opened
      source-signal=ST_CAN4_L_Pas_Motor_Ripple_Error, target-signal=ST_CAN2_L_Pas_Motor_Ripple_Error
      source-signal=ST_CAN4_L_Drv_Motor_Ripple_Error, target-signal=ST_CAN2_L_Drv_Motor_Ripple_Error
      source-signal=ST_CAN4_L_RRD_Motor_Ripple_Error, target-signal=ST_CAN2_L_RRD_Motor_Ripple_Error
      source-signal=ST_CAN4_RAPWL_01_LIN_Response_Error, target-signal=ST_CAN2_RAPWL_01_LIN_Response_Error
      source-signal=ST_CAN3_HVBattCurr, target-signal=ST_CAN2_HVBattCurr
      source-signal=ST_CAN3_HVBattVolt, target-signal=ST_CAN2_HVBattVolt
      source-signal=ST_CAN3_DCDCAuxCur, target-signal=ST_CAN2_DCDCAuxCur
      source-signal=ST_CAN3_DCDCAuxVolt, target-signal=ST_CAN2_DCDCAuxVolt
      source-signal=ST_CAN3_HVBattErr, target-signal=ST_CAN2_HVBattErr
      source-signal=ST_CAN3_FireDetErr, target-signal=ST_CAN2_FireDetErr
      source-signal=ST_CAN3_ChrgPlugSta, target-signal=ST_CAN2_ChrgPlugSta
      source-signal=ST_CAN3_HVBContactorSta, target-signal=ST_CAN2_HVBContactorSta
      source-signal=ST_CAN3_DisChrgPlugErr, target-signal=ST_CAN2_DisChrgPlugErr
      source-signal=ST_CAN3_HVBOvrTempErr, target-signal=ST_CAN2_HVBOvrTempErr
      source-signal=ST_CAN3_ExtChrgSta, target-signal=ST_CAN2_ExtChrgSta
      source-signal=ST_CAN3_HVBOvrTempWarn, target-signal=ST_CAN2_HVBOvrTempWarn
      source-signal=ST_CAN3_V2LSta, target-signal=ST_CAN2_V2LSta
      source-signal=ST_CAN3_HVBChrgErr, target-signal=ST_CAN2_HVBChrgErr
      source-signal=ST_CAN3_Shifter_Handle_Cmd, target-signal=ST_CAN2_Shifter_Handle_Cmd
      source-signal=ST_CAN3_Shifter_Fail_sta, target-signal=ST_CAN2_Shifter_Fail_sta
      source-signal=ST_CAN3_OBC_AC_Cur_Lim, target-signal=ST_CAN2_OBC_AC_Cur_Lim
      source-signal=ST_CAN3_OBCACVoltInf, target-signal=ST_CAN2_OBCACVoltInf
      source-signal=ST_CAN3_OBCACCurrInf, target-signal=ST_CAN2_OBCACCurrInf
      source-signal=ST_CAN3_OBCFaultSta, target-signal=ST_CAN2_OBCFaultSta
      source-signal=ST_CAN3_OBCACCSLimit, target-signal=ST_CAN2_OBCACCSLimit
      source-signal=ST_CAN3_MainRlyPosSta, target-signal=ST_CAN2_MainRlyPosSta
      source-signal=ST_CAN3_MainRlyNegSta, target-signal=ST_CAN2_MainRlyNegSta
      source-signal=ST_CAN3_HVBMTempMax, target-signal=ST_CAN2_HVBMTempMax
      source-signal=ST_CAN3_Rr_MCU3_HW_Ver, target-signal=ST_CAN2_Rr_MCU3_HW_Ver
      source-signal=ST_CAN3_Rr_MCU3_SW_Ver, target-signal=ST_CAN2_Rr_MCU3_SW_Ver
      source-signal=ST_CAN3_HVBChrgPwr, target-signal=ST_CAN2_HVBChrgPwr
      source-signal=ST_CAN3_ACChrgCurrDis, target-signal=ST_CAN2_ACChrgCurrDis
      source-signal=ST_CAN3_RemainChrgTime, target-signal=ST_CAN2_RemainChrgTime
      source-signal=ST_CAN3_HVBattSOCDis, target-signal=ST_CAN2_HVBattSOCDis
      source-signal=ST_CAN3_HVBattSOC, target-signal=ST_CAN2_HVBattSOC
      source-signal=ST_CAN3_Rr_TMSpd, target-signal=ST_CAN2_Rr_TMSpd
      source-signal=ST_CAN3_Rr_MotorAvailTq, target-signal=ST_CAN2_Rr_MotorAvailTq
      source-signal=ST_CAN3_Rr_EDURealTMTq, target-signal=ST_CAN2_Rr_EDURealTMTq
      source-signal=ST_CAN3_Rr_EDUDrtSta, target-signal=ST_CAN2_Rr_EDUDrtSta
      source-signal=ST_CAN3_Rr_MCUTemp, target-signal=ST_CAN2_Rr_MCUTemp
      source-signal=ST_CAN3_Rr_TMTemp, target-signal=ST_CAN2_Rr_TMTemp
      source-signal=ST_CAN3_MCU_B_R_LLCTempWarn_Sta, target-signal=ST_CAN2_MCU_B_R_LLCTempWarn_Sta
      source-signal=ST_CAN3_Rr_TMTempWarn, target-signal=ST_CAN2_Rr_TMTempWarn
      source-signal=ST_CAN3_Rr_MCUTempWarn, target-signal=ST_CAN2_Rr_MCUTempWarn
      source-signal=ST_CAN5_ReserveChargeOn_Month, target-signal=ST_CAN3_ReserveChargeOn_Month
      source-signal=ST_CAN5_ReserveChargeOn_Hour, target-signal=ST_CAN3_ReserveChargeOn_Hour
      source-signal=ST_CAN5_ReserveChargeOFF_Minute, target-signal=ST_CAN3_ReserveChargeOFF_Minute
      source-signal=ST_CAN5_ReserveChargeOFF_Year, target-signal=ST_CAN3_ReserveChargeOFF_Year
      source-signal=ST_CAN5_ReserveChargeOn_Minute, target-signal=ST_CAN3_ReserveChargeOn_Minute
      source-signal=ST_CAN5_Charge_Percent_Set, target-signal=ST_CAN3_Charge_Percent_Set
      source-signal=ST_CAN5_ReserveChargeOn_Year, target-signal=ST_CAN3_ReserveChargeOn_Year
      source-signal=ST_CAN5_ReserveChargeOFF_Month, target-signal=ST_CAN3_ReserveChargeOFF_Month
      source-signal=ST_CAN5_ReserveChargeOn_Day, target-signal=ST_CAN3_ReserveChargeOn_Day
      source-signal=ST_CAN5_ReserveChargeOFF_Day, target-signal=ST_CAN3_ReserveChargeOFF_Day
      source-signal=ST_CAN5_ReserveChargeOFF_Hour, target-signal=ST_CAN3_ReserveChargeOFF_Hour
      source-signal=ST_CAN4_COMP_ConVolt, target-signal=ST_CAN3_COMP_ConVolt
      source-signal=ST_CAN4_COMP_ActualPwr, target-signal=ST_CAN3_COMP_ActualPwr
      source-signal=ST_CAN4_PTC1_PowerConsumption, target-signal=ST_CAN3_PTC1_PowerConsumption
      source-signal=ST_CAN4_COMP_ConCur, target-signal=ST_CAN3_COMP_ConCur
      source-signal=ST_CAN4_ChargeInletLockSta, target-signal=ST_CAN3_ChargeInletLockSta
      source-signal=ST_CAN2_IVI_Time_Second, target-signal=ST_CAN3_IVI_Time_Second
      source-signal=ST_CAN2_IVI_Time_Month, target-signal=ST_CAN3_IVI_Time_Month
      source-signal=ST_CAN2_IVI_Time_Hour, target-signal=ST_CAN3_IVI_Time_Hour
      source-signal=ST_CAN2_IVI_Time_Day, target-signal=ST_CAN3_IVI_Time_Day
      source-signal=ST_CAN2_IVI_Time_Minute, target-signal=ST_CAN3_IVI_Time_Minute
      source-signal=ST_CAN2_Sched_Chg_limit, target-signal=ST_CAN3_Sched_Chg_limit
      source-signal=ST_CAN2_SOC_ADJ_BUTT, target-signal=ST_CAN3_SOC_ADJ_BUTT
      source-signal=ST_CAN2_SOC_Limit_Set, target-signal=ST_CAN3_SOC_Limit_Set
      source-signal=ST_CAN2_Sched_Chg_Start, target-signal=ST_CAN3_Sched_Chg_Start
      source-signal=ST_CAN2_SOC_V2LLimit, target-signal=ST_CAN3_SOC_V2LLimit
      source-signal=ST_CAN2_Perd_V2L, target-signal=ST_CAN3_Perd_V2L
      source-signal=ST_CAN2_IVI_Unlock_Chg_req, target-signal=ST_CAN3_IVI_Unlock_Chg_req
      source-signal=ST_CAN2_Sched_Chg_Stop, target-signal=ST_CAN3_Sched_Chg_Stop
      source-signal=ST_CAN2_AC_Chg_Cur_Set, target-signal=ST_CAN3_AC_Chg_Cur_Set
      source-signal=ST_CAN2_Sched_Chg_butt, target-signal=ST_CAN3_Sched_Chg_butt
      source-signal=ST_CAN2_IVI_Req_V2L, target-signal=ST_CAN3_IVI_Req_V2L
      source-signal=ST_CAN2_IVI_Stop_Chg_req, target-signal=ST_CAN3_IVI_Stop_Chg_req
      source-signal=ST_CAN2_IVI_Start_Chg_req, target-signal=ST_CAN3_IVI_Start_Chg_req
      source-signal=ST_CAN5_TBOX_Remote_PW, target-signal=ST_CAN4_TBOX_Remote_PW
      source-signal=ST_CAN3_ChrgPlugSta, target-signal=ST_CAN4_ChrgPlugSta
      source-signal=ST_CAN3_ExtChrgSta, target-signal=ST_CAN4_ExtChrgSta
      source-signal=ST_CAN3_V2LSta, target-signal=ST_CAN4_V2LSta
      source-signal=ST_CAN3_ChrgInLockReq, target-signal=ST_CAN4_ChrgInLockReq
      source-signal=ST_CAN3_OBCV2LSta, target-signal=ST_CAN4_OBCV2LSta
      source-signal=ST_CAN2_METER_KPH_Calcu, target-signal=ST_CAN4_METER_KPH_Calcu
      source-signal=ST_CAN2_IVI_Time_Second, target-signal=ST_CAN4_IVI_Time_Second
      source-signal=ST_CAN2_IVI_Time_Month, target-signal=ST_CAN4_IVI_Time_Month
      source-signal=ST_CAN2_IVI_Time_Check, target-signal=ST_CAN4_IVI_Time_Check
      source-signal=ST_CAN2_IVI_Time_Hour, target-signal=ST_CAN4_IVI_Time_Hour
      source-signal=ST_CAN2_IVI_Located_STA, target-signal=ST_CAN4_IVI_Located_STA
      source-signal=ST_CAN2_IVI_Time_Day, target-signal=ST_CAN4_IVI_Time_Day
      source-signal=ST_CAN2_IVI_Time_Minute, target-signal=ST_CAN4_IVI_Time_Minute
      source-signal=ST_CAN2_IVI_Time_Year, target-signal=ST_CAN4_IVI_Time_Year
      source-signal=ST_CAN2_IVI_PSEATHeater_Cmd, target-signal=ST_CAN4_IVI_PSEATHeater_Cmd
      source-signal=ST_CAN2_AVM_parking_excute, target-signal=ST_CAN4_AVM_parking_excute
      source-signal=ST_CAN2_IVI_PTG_Sta_SW, target-signal=ST_CAN4_IVI_PTG_Sta_SW
      source-signal=ST_CAN2_IVI_PTG_Mode_SW, target-signal=ST_CAN4_IVI_PTG_Mode_SW
      source-signal=ST_CAN2_Walkaway_Lock_SW, target-signal=ST_CAN4_Walkaway_Lock_SW
      source-signal=ST_CAN2_Approach_Unlock_SW, target-signal=ST_CAN4_Approach_Unlock_SW
      source-signal=ST_CAN2_IVI_TrailerModeSW_Sta, target-signal=ST_CAN4_IVI_TrailerModeSW_Sta
      source-signal=ST_CAN2_SenstivityPosition, target-signal=ST_CAN4_SenstivityPosition
      source-signal=ST_CAN2_OFF_AC_MODE, target-signal=ST_CAN4_OFF_AC_MODE
      source-signal=ST_CAN2_IVI_DSEATHeater_Cmd, target-signal=ST_CAN4_IVI_DSEATHeater_Cmd
      source-signal=ST_CAN2_IVI_PTG_Open_Height, target-signal=ST_CAN4_IVI_PTG_Open_Height
      source-signal=ST_CAN2_DSEAT_entryfun_set, target-signal=ST_CAN4_DSEAT_entryfun_set
      source-signal=ST_CAN2_IVI_ChargePortSW_Sta, target-signal=ST_CAN4_IVI_ChargePortSW_Sta
      source-signal=ST_CAN2_Distance_unit, target-signal=ST_CAN4_Distance_unit
      source-signal=ST_CAN2_HeadLampSW, target-signal=ST_CAN4_HeadLampSW
      source-signal=ST_CAN2_Light_ShowStop_Req, target-signal=ST_CAN4_Light_ShowStop_Req
      source-signal=ST_CAN2_PSEAT_vent_req, target-signal=ST_CAN4_PSEAT_vent_req
      source-signal=ST_CAN2_WlcmLight_Mode, target-signal=ST_CAN4_WlcmLight_Mode
      source-signal=ST_CAN2_Light_ShowStart_Req, target-signal=ST_CAN4_Light_ShowStart_Req
      source-signal=ST_CAN2_DSEAT_anti_set, target-signal=ST_CAN4_DSEAT_anti_set
      source-signal=ST_CAN2_Hood_Latch_SW, target-signal=ST_CAN4_Hood_Latch_SW
      source-signal=ST_CAN2_IVI_TrailerCheckReq_Sta, target-signal=ST_CAN4_IVI_TrailerCheckReq_Sta
      source-signal=ST_CAN2_IVI_ISA_OffsetSpd, target-signal=ST_CAN4_IVI_ISA_OffsetSpd
      source-signal=ST_CAN2_DSEAT_vent_req, target-signal=ST_CAN4_DSEAT_vent_req
      source-signal=ST_CAN2_IVI_MLFMost_Cmd, target-signal=ST_CAN4_IVI_MLFMost_Cmd
      source-signal=ST_CAN2_IVI_MRSEATvent_Cmd, target-signal=ST_CAN4_IVI_MRSEATvent_Cmd
      source-signal=ST_CAN2_IVI_MLSEATvent_Cmd, target-signal=ST_CAN4_IVI_MLSEATvent_Cmd
      source-signal=ST_CAN2_IVI_MLSlider_Cmd, target-signal=ST_CAN4_IVI_MLSlider_Cmd
      source-signal=ST_CAN2_IVI_MRZeroGravity_Cmd, target-signal=ST_CAN4_IVI_MRZeroGravity_Cmd
      source-signal=ST_CAN2_IVI_RSEATvent_Cmd, target-signal=ST_CAN4_IVI_RSEATvent_Cmd
      source-signal=ST_CAN2_IVI_MLZeroGravity_Cmd, target-signal=ST_CAN4_IVI_MLZeroGravity_Cmd
      source-signal=ST_CAN2_IVI_MRNapMode_Cmd, target-signal=ST_CAN4_IVI_MRNapMode_Cmd
      source-signal=ST_CAN2_IVI_LSEATvent_Cmd, target-signal=ST_CAN4_IVI_LSEATvent_Cmd
      source-signal=ST_CAN2_IVI_MRFMost_Cmd, target-signal=ST_CAN4_IVI_MRFMost_Cmd
      source-signal=ST_CAN2_IVI_MLRestore_Cmd, target-signal=ST_CAN4_IVI_MLRestore_Cmd
      source-signal=ST_CAN2_IVI_MRRecliner_Cmd, target-signal=ST_CAN4_IVI_MRRecliner_Cmd
      source-signal=ST_CAN2_IVI_MLRecliner_Cmd, target-signal=ST_CAN4_IVI_MLRecliner_Cmd
      source-signal=ST_CAN2_IVI_MRSldRestore_Cmd, target-signal=ST_CAN4_IVI_MRSldRestore_Cmd
      source-signal=ST_CAN2_IVI_MRFootLift_Cmd, target-signal=ST_CAN4_IVI_MRFootLift_Cmd
      source-signal=ST_CAN2_IVI_MRSlider_Cmd, target-signal=ST_CAN4_IVI_MRSlider_Cmd
      source-signal=ST_CAN2_IVI_MLFootLift_Cmd, target-signal=ST_CAN4_IVI_MLFootLift_Cmd
      source-signal=ST_CAN2_IVI_MRRestore_Cmd, target-signal=ST_CAN4_IVI_MRRestore_Cmd
      source-signal=ST_CAN2_IVI_MLNapMode_Cmd, target-signal=ST_CAN4_IVI_MLNapMode_Cmd
      source-signal=ST_CAN2_IVI_MLSldRestore_Cmd, target-signal=ST_CAN4_IVI_MLSldRestore_Cmd
      source-signal=ST_CAN2_IVI_MRSeatLift_Cmd, target-signal=ST_CAN4_IVI_MRSeatLift_Cmd
      source-signal=ST_CAN2_IVI_MLSeatLift_Cmd, target-signal=ST_CAN4_IVI_MLSeatLift_Cmd
      source-signal=ST_CAN4_L_RRD_Wdw_PositionSts, target-signal=ST_CAN5_L_RRD_Wdw_PositionSts
      source-signal=ST_CAN4_L_RLD_Wdw_PositionSts, target-signal=ST_CAN5_L_RLD_Wdw_PositionSts
      source-signal=ST_CAN4_L_Pas_Wdw_PositionSts, target-signal=ST_CAN5_L_Pas_Wdw_PositionSts
      source-signal=ST_CAN4_L_Pas_Val_Wdw_Opened, target-signal=ST_CAN5_L_Pas_Val_Wdw_Opened
      source-signal=ST_CAN4_L_Drv_Val_Wdw_Opened, target-signal=ST_CAN5_L_Drv_Val_Wdw_Opened
      source-signal=ST_CAN4_L_Drv_Wdw_PositionSts, target-signal=ST_CAN5_L_Drv_Wdw_PositionSts
      source-signal=ST_CAN4_L_RLD_Val_Wdw_Opened, target-signal=ST_CAN5_L_RLD_Val_Wdw_Opened
      source-signal=ST_CAN4_L_RRD_Val_Wdw_Opened, target-signal=ST_CAN5_L_RRD_Val_Wdw_Opened
