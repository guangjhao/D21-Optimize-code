ASAP2_VERSION 1 51
/begin PROJECT ProjectName "Project Comment Goes Here"
/begin HEADER "Header Comments go here" /end HEADER
/begin MODULE ModuleName "Module Comment Goes Here"
/begin MOD_COMMON "Mod Common Comment Here" BYTE_ORDER MSB_LAST ALIGNMENT_BYTE 1 ALIGNMENT_WORD 1 ALIGNMENT_LONG 1 ALIGNMENT_FLOAT32_IEEE 1 ALIGNMENT_FLOAT64_IEEE 1 /end MOD_COMMON
/begin FUNCTION FrTMTqReqtoNidec "" /begin SUB_FUNCTION convert_out Data_Type_Conversion /end SUB_FUNCTION /begin DEF_CHARACTERISTIC /end DEF_CHARACTERISTIC /begin IN_MEASUREMENT /end IN_MEASUREMENT /begin OUT_MEASUREMENT /end OUT_MEASUREMENT /end FUNCTION
/begin FUNCTION FrTorqMaxtoNidec "" /begin SUB_FUNCTION /end SUB_FUNCTION /begin DEF_CHARACTERISTIC /end DEF_CHARACTERISTIC /begin IN_MEASUREMENT /end IN_MEASUREMENT /begin OUT_MEASUREMENT /end OUT_MEASUREMENT /end FUNCTION
/begin FUNCTION FrTorqMintoNidec "" /begin SUB_FUNCTION convert_out Data_Type_Conversion /end SUB_FUNCTION /begin DEF_CHARACTERISTIC /end DEF_CHARACTERISTIC /begin IN_MEASUREMENT /end IN_MEASUREMENT /begin OUT_MEASUREMENT /end OUT_MEASUREMENT /end FUNCTION
/begin FUNCTION FrUdcMaxtoNidec "" /begin SUB_FUNCTION Data_Type_Conversion /end SUB_FUNCTION /begin DEF_CHARACTERISTIC /end DEF_CHARACTERISTIC /begin IN_MEASUREMENT /end IN_MEASUREMENT /begin OUT_MEASUREMENT /end OUT_MEASUREMENT /end FUNCTION
/begin FUNCTION FrUdcMintoNidec "" /begin SUB_FUNCTION Data_Type_Conversion /end SUB_FUNCTION /begin DEF_CHARACTERISTIC /end DEF_CHARACTERISTIC /begin IN_MEASUREMENT /end IN_MEASUREMENT /begin OUT_MEASUREMENT /end OUT_MEASUREMENT /end FUNCTION
/begin FUNCTION RCVCU2CAN1toNidec "" /begin SUB_FUNCTION /end SUB_FUNCTION /begin DEF_CHARACTERISTIC /end DEF_CHARACTERISTIC /begin IN_MEASUREMENT /end IN_MEASUREMENT /begin OUT_MEASUREMENT /end OUT_MEASUREMENT /end FUNCTION
/begin FUNCTION RollingCounter_IfAction ""
 /begin SUB_FUNCTION Constant1 Constant65 Constant66 Constant67 Equal34 Add2 Switch Switch5 Unit_Delay5 /end SUB_FUNCTION
 /begin DEF_CHARACTERISTIC /end DEF_CHARACTERISTIC
 /begin IN_MEASUREMENT /end IN_MEASUREMENT
 /begin OUT_MEASUREMENT /end OUT_MEASUREMENT
/end FUNCTION
/begin FUNCTION RollingCounter_IfAction1 ""
 /begin SUB_FUNCTION Constant1 Constant65 Constant66 Constant67 Equal34 Add2 Switch Switch5 Unit_Delay5 /end SUB_FUNCTION
 /begin DEF_CHARACTERISTIC /end DEF_CHARACTERISTIC
 /begin IN_MEASUREMENT /end IN_MEASUREMENT
 /begin OUT_MEASUREMENT /end OUT_MEASUREMENT
/end FUNCTION
/begin FUNCTION RrIdcMaxtoNidec "" /begin SUB_FUNCTION Data_Type_Conversion /end SUB_FUNCTION /begin DEF_CHARACTERISTIC /end DEF_CHARACTERISTIC /begin IN_MEASUREMENT /end IN_MEASUREMENT /begin OUT_MEASUREMENT /end OUT_MEASUREMENT /end FUNCTION
/begin FUNCTION RrIdcMintoNidec "" /begin SUB_FUNCTION convert_out Data_Type_Conversion /end SUB_FUNCTION /begin DEF_CHARACTERISTIC /end DEF_CHARACTERISTIC /begin IN_MEASUREMENT /end IN_MEASUREMENT /begin OUT_MEASUREMENT /end OUT_MEASUREMENT /end FUNCTION
/begin FUNCTION RrTMTqReqtoNidec "" /begin SUB_FUNCTION convert_out Data_Type_Conversion /end SUB_FUNCTION /begin DEF_CHARACTERISTIC /end DEF_CHARACTERISTIC /begin IN_MEASUREMENT /end IN_MEASUREMENT /begin OUT_MEASUREMENT /end OUT_MEASUREMENT /end FUNCTION
/begin FUNCTION RrTorqMaxtoNidec "" /begin SUB_FUNCTION /end SUB_FUNCTION /begin DEF_CHARACTERISTIC /end DEF_CHARACTERISTIC /begin IN_MEASUREMENT /end IN_MEASUREMENT /begin OUT_MEASUREMENT /end OUT_MEASUREMENT /end FUNCTION
/begin FUNCTION RrTorqMintoNidec "" /begin SUB_FUNCTION convert_out Data_Type_Conversion /end SUB_FUNCTION /begin DEF_CHARACTERISTIC /end DEF_CHARACTERISTIC /begin IN_MEASUREMENT /end IN_MEASUREMENT /begin OUT_MEASUREMENT /end OUT_MEASUREMENT /end FUNCTION
/begin FUNCTION RrUdcMaxtoNidec "" /begin SUB_FUNCTION Data_Type_Conversion /end SUB_FUNCTION /begin DEF_CHARACTERISTIC /end DEF_CHARACTERISTIC /begin IN_MEASUREMENT /end IN_MEASUREMENT /begin OUT_MEASUREMENT /end OUT_MEASUREMENT /end FUNCTION
/begin FUNCTION RrUdcMintoNidec "" /begin SUB_FUNCTION Data_Type_Conversion /end SUB_FUNCTION /begin DEF_CHARACTERISTIC /end DEF_CHARACTERISTIC /begin IN_MEASUREMENT /end IN_MEASUREMENT /begin OUT_MEASUREMENT /end OUT_MEASUREMENT /end FUNCTION
/begin FUNCTION bus_creator "" /begin DEF_CHARACTERISTIC /end DEF_CHARACTERISTIC /begin IN_MEASUREMENT /end IN_MEASUREMENT /begin OUT_MEASUREMENT /end OUT_MEASUREMENT /end FUNCTION
/begin FUNCTION Constant "" /begin DEF_CHARACTERISTIC KHAL_CAN3FD3VCU2toNIDECE2E_flg /end DEF_CHARACTERISTIC /begin IN_MEASUREMENT /end IN_MEASUREMENT /begin OUT_MEASUREMENT /end OUT_MEASUREMENT /end FUNCTION
/begin FUNCTION Constant1 "" /begin DEF_CHARACTERISTIC /end DEF_CHARACTERISTIC /begin IN_MEASUREMENT /end IN_MEASUREMENT /begin OUT_MEASUREMENT /end OUT_MEASUREMENT /end FUNCTION
/begin FUNCTION Constant2 "" /begin DEF_CHARACTERISTIC /end DEF_CHARACTERISTIC /begin IN_MEASUREMENT /end IN_MEASUREMENT /begin OUT_MEASUREMENT /end OUT_MEASUREMENT /end FUNCTION
/begin FUNCTION Constant3 "" /begin DEF_CHARACTERISTIC KHAL_CAN3FD3VCU2toNIDECE2E_flg /end DEF_CHARACTERISTIC /begin IN_MEASUREMENT /end IN_MEASUREMENT /begin OUT_MEASUREMENT /end OUT_MEASUREMENT /end FUNCTION
/begin FUNCTION Constant4 "" /begin DEF_CHARACTERISTIC KHAL_CAN3FD3VCU2toNIDECE2E_flg /end DEF_CHARACTERISTIC /begin IN_MEASUREMENT /end IN_MEASUREMENT /begin OUT_MEASUREMENT /end OUT_MEASUREMENT /end FUNCTION
/begin FUNCTION Chart "" /begin DEF_CHARACTERISTIC /end DEF_CHARACTERISTIC /begin IN_MEASUREMENT /end IN_MEASUREMENT /begin OUT_MEASUREMENT /end OUT_MEASUREMENT /end FUNCTION
/begin FUNCTION Constant "" /begin DEF_CHARACTERISTIC /end DEF_CHARACTERISTIC /begin IN_MEASUREMENT /end IN_MEASUREMENT /begin OUT_MEASUREMENT /end OUT_MEASUREMENT /end FUNCTION
/begin FUNCTION Constant3 "" /begin DEF_CHARACTERISTIC /end DEF_CHARACTERISTIC /begin IN_MEASUREMENT /end IN_MEASUREMENT /begin OUT_MEASUREMENT /end OUT_MEASUREMENT /end FUNCTION
/begin FUNCTION Data_Type_Conversion "" /begin DEF_CHARACTERISTIC /end DEF_CHARACTERISTIC /begin IN_MEASUREMENT /end IN_MEASUREMENT /begin OUT_MEASUREMENT /end OUT_MEASUREMENT /end FUNCTION
/begin FUNCTION Gain "" /begin DEF_CHARACTERISTIC /end DEF_CHARACTERISTIC /begin IN_MEASUREMENT /end IN_MEASUREMENT /begin OUT_MEASUREMENT /end OUT_MEASUREMENT /end FUNCTION
/begin FUNCTION Divide "" /begin DEF_CHARACTERISTIC /end DEF_CHARACTERISTIC /begin IN_MEASUREMENT /end IN_MEASUREMENT /begin OUT_MEASUREMENT /end OUT_MEASUREMENT /end FUNCTION
/begin FUNCTION ActAPSPosn "" /begin SUB_FUNCTION convert_out Data_Type_Conversion /end SUB_FUNCTION /begin DEF_CHARACTERISTIC /end DEF_CHARACTERISTIC /begin IN_MEASUREMENT /end IN_MEASUREMENT /begin OUT_MEASUREMENT /end OUT_MEASUREMENT /end FUNCTION
/begin FUNCTION FDCVCUFrSpdMaxReq "" /begin SUB_FUNCTION /end SUB_FUNCTION /begin DEF_CHARACTERISTIC /end DEF_CHARACTERISTIC /begin IN_MEASUREMENT /end IN_MEASUREMENT /begin OUT_MEASUREMENT /end OUT_MEASUREMENT /end FUNCTION
/begin FUNCTION FDCVCUFrSpdMinReq "" /begin SUB_FUNCTION convert_out Data_Type_Conversion /end SUB_FUNCTION /begin DEF_CHARACTERISTIC /end DEF_CHARACTERISTIC /begin IN_MEASUREMENT /end IN_MEASUREMENT /begin OUT_MEASUREMENT /end OUT_MEASUREMENT /end FUNCTION
/begin FUNCTION FDCVCUFrTMCtrlModeReq "" /begin SUB_FUNCTION /end SUB_FUNCTION /begin DEF_CHARACTERISTIC /end DEF_CHARACTERISTIC /begin IN_MEASUREMENT /end IN_MEASUREMENT /begin OUT_MEASUREMENT /end OUT_MEASUREMENT /end FUNCTION
/begin FUNCTION FDCVCUFrTMSpdReq "" /begin SUB_FUNCTION convert_out Data_Type_Conversion /end SUB_FUNCTION /begin DEF_CHARACTERISTIC /end DEF_CHARACTERISTIC /begin IN_MEASUREMENT /end IN_MEASUREMENT /begin OUT_MEASUREMENT /end OUT_MEASUREMENT /end FUNCTION
/begin FUNCTION FDCVCUFrTMTqReq "" /begin SUB_FUNCTION convert_out Data_Type_Conversion /end SUB_FUNCTION /begin DEF_CHARACTERISTIC /end DEF_CHARACTERISTIC /begin IN_MEASUREMENT /end IN_MEASUREMENT /begin OUT_MEASUREMENT /end OUT_MEASUREMENT /end FUNCTION
/begin FUNCTION FDCVCUFrTqMaxReq "" /begin SUB_FUNCTION /end SUB_FUNCTION /begin DEF_CHARACTERISTIC /end DEF_CHARACTERISTIC /begin IN_MEASUREMENT /end IN_MEASUREMENT /begin OUT_MEASUREMENT /end OUT_MEASUREMENT /end FUNCTION
/begin FUNCTION FDCVCUFrTqMinReq "" /begin SUB_FUNCTION convert_out Data_Type_Conversion /end SUB_FUNCTION /begin DEF_CHARACTERISTIC /end DEF_CHARACTERISTIC /begin IN_MEASUREMENT /end IN_MEASUREMENT /begin OUT_MEASUREMENT /end OUT_MEASUREMENT /end FUNCTION
/begin FUNCTION FDCVCURrSpdMaxReq "" /begin SUB_FUNCTION /end SUB_FUNCTION /begin DEF_CHARACTERISTIC /end DEF_CHARACTERISTIC /begin IN_MEASUREMENT /end IN_MEASUREMENT /begin OUT_MEASUREMENT /end OUT_MEASUREMENT /end FUNCTION
/begin FUNCTION FDCVCURrSpdMinReq "" /begin SUB_FUNCTION convert_out Data_Type_Conversion /end SUB_FUNCTION /begin DEF_CHARACTERISTIC /end DEF_CHARACTERISTIC /begin IN_MEASUREMENT /end IN_MEASUREMENT /begin OUT_MEASUREMENT /end OUT_MEASUREMENT /end FUNCTION
/begin FUNCTION FDCVCURrTMCtrlModeReq "" /begin SUB_FUNCTION /end SUB_FUNCTION /begin DEF_CHARACTERISTIC /end DEF_CHARACTERISTIC /begin IN_MEASUREMENT /end IN_MEASUREMENT /begin OUT_MEASUREMENT /end OUT_MEASUREMENT /end FUNCTION
/begin FUNCTION FDCVCURrTMSpdReq "" /begin SUB_FUNCTION convert_out Data_Type_Conversion /end SUB_FUNCTION /begin DEF_CHARACTERISTIC /end DEF_CHARACTERISTIC /begin IN_MEASUREMENT /end IN_MEASUREMENT /begin OUT_MEASUREMENT /end OUT_MEASUREMENT /end FUNCTION
/begin FUNCTION FDCVCURrTMTqReq "" /begin SUB_FUNCTION convert_out Data_Type_Conversion /end SUB_FUNCTION /begin DEF_CHARACTERISTIC /end DEF_CHARACTERISTIC /begin IN_MEASUREMENT /end IN_MEASUREMENT /begin OUT_MEASUREMENT /end OUT_MEASUREMENT /end FUNCTION
/begin FUNCTION FDCVCURrTqMaxReq "" /begin SUB_FUNCTION /end SUB_FUNCTION /begin DEF_CHARACTERISTIC /end DEF_CHARACTERISTIC /begin IN_MEASUREMENT /end IN_MEASUREMENT /begin OUT_MEASUREMENT /end OUT_MEASUREMENT /end FUNCTION
/begin FUNCTION FDCVCURrTqMinReq "" /begin SUB_FUNCTION convert_out Data_Type_Conversion /end SUB_FUNCTION /begin DEF_CHARACTERISTIC /end DEF_CHARACTERISTIC /begin IN_MEASUREMENT /end IN_MEASUREMENT /begin OUT_MEASUREMENT /end OUT_MEASUREMENT /end FUNCTION
/begin FUNCTION FrEDUSpd "" /begin SUB_FUNCTION convert_out Data_Type_Conversion /end SUB_FUNCTION /begin DEF_CHARACTERISTIC /end DEF_CHARACTERISTIC /begin IN_MEASUREMENT /end IN_MEASUREMENT /begin OUT_MEASUREMENT /end OUT_MEASUREMENT /end FUNCTION
/begin FUNCTION FrEDUSpdValid "" /begin SUB_FUNCTION Data_Type_Conversion /end SUB_FUNCTION /begin DEF_CHARACTERISTIC /end DEF_CHARACTERISTIC /begin IN_MEASUREMENT /end IN_MEASUREMENT /begin OUT_MEASUREMENT /end OUT_MEASUREMENT /end FUNCTION
/begin FUNCTION RrEDUSpd "" /begin SUB_FUNCTION convert_out Data_Type_Conversion /end SUB_FUNCTION /begin DEF_CHARACTERISTIC /end DEF_CHARACTERISTIC /begin IN_MEASUREMENT /end IN_MEASUREMENT /begin OUT_MEASUREMENT /end OUT_MEASUREMENT /end FUNCTION
/begin FUNCTION RrEDUSpdValid "" /begin SUB_FUNCTION Data_Type_Conversion /end SUB_FUNCTION /begin DEF_CHARACTERISTIC /end DEF_CHARACTERISTIC /begin IN_MEASUREMENT /end IN_MEASUREMENT /begin OUT_MEASUREMENT /end OUT_MEASUREMENT /end FUNCTION
/begin FUNCTION bus_creator "" /begin DEF_CHARACTERISTIC /end DEF_CHARACTERISTIC /begin IN_MEASUREMENT /end IN_MEASUREMENT /begin OUT_MEASUREMENT /end OUT_MEASUREMENT /end FUNCTION
/begin FUNCTION VehSpeedtoNidec "" /begin SUB_FUNCTION convert_out Data_Type_Conversion /end SUB_FUNCTION /begin DEF_CHARACTERISTIC /end DEF_CHARACTERISTIC /begin IN_MEASUREMENT /end IN_MEASUREMENT /begin OUT_MEASUREMENT /end OUT_MEASUREMENT /end FUNCTION
/begin FUNCTION bus_creator "" /begin DEF_CHARACTERISTIC /end DEF_CHARACTERISTIC /begin IN_MEASUREMENT /end IN_MEASUREMENT /begin OUT_MEASUREMENT /end OUT_MEASUREMENT /end FUNCTION
/begin FUNCTION IVITimeDaytoNidec "" /begin SUB_FUNCTION Data_Type_Conversion /end SUB_FUNCTION /begin DEF_CHARACTERISTIC /end DEF_CHARACTERISTIC /begin IN_MEASUREMENT /end IN_MEASUREMENT /begin OUT_MEASUREMENT /end OUT_MEASUREMENT /end FUNCTION
/begin FUNCTION IVITimeHourtoNidec "" /begin SUB_FUNCTION Data_Type_Conversion /end SUB_FUNCTION /begin DEF_CHARACTERISTIC /end DEF_CHARACTERISTIC /begin IN_MEASUREMENT /end IN_MEASUREMENT /begin OUT_MEASUREMENT /end OUT_MEASUREMENT /end FUNCTION
/begin FUNCTION IVITimeMinutetoNidec "" /begin SUB_FUNCTION Data_Type_Conversion /end SUB_FUNCTION /begin DEF_CHARACTERISTIC /end DEF_CHARACTERISTIC /begin IN_MEASUREMENT /end IN_MEASUREMENT /begin OUT_MEASUREMENT /end OUT_MEASUREMENT /end FUNCTION
/begin FUNCTION IVITimeMonthtoNidec "" /begin SUB_FUNCTION Data_Type_Conversion /end SUB_FUNCTION /begin DEF_CHARACTERISTIC /end DEF_CHARACTERISTIC /begin IN_MEASUREMENT /end IN_MEASUREMENT /begin OUT_MEASUREMENT /end OUT_MEASUREMENT /end FUNCTION
/begin FUNCTION IVITimeSecondtoNidec "" /begin SUB_FUNCTION Data_Type_Conversion /end SUB_FUNCTION /begin DEF_CHARACTERISTIC /end DEF_CHARACTERISTIC /begin IN_MEASUREMENT /end IN_MEASUREMENT /begin OUT_MEASUREMENT /end OUT_MEASUREMENT /end FUNCTION
/begin FUNCTION bus_creator "" /begin DEF_CHARACTERISTIC /end DEF_CHARACTERISTIC /begin IN_MEASUREMENT /end IN_MEASUREMENT /begin OUT_MEASUREMENT /end OUT_MEASUREMENT /end FUNCTION
/begin FUNCTION FixPt_Relational_Operator "" /begin DEF_CHARACTERISTIC /end DEF_CHARACTERISTIC /begin IN_MEASUREMENT /end IN_MEASUREMENT /begin OUT_MEASUREMENT /end OUT_MEASUREMENT /end FUNCTION
/begin FUNCTION Delay_Input1 "" /begin DEF_CHARACTERISTIC /end DEF_CHARACTERISTIC /begin IN_MEASUREMENT /end IN_MEASUREMENT /begin OUT_MEASUREMENT /end OUT_MEASUREMENT /end FUNCTION
/begin FUNCTION FD4_CE100_0 "" /begin DEF_CHARACTERISTIC /end DEF_CHARACTERISTIC /begin IN_MEASUREMENT /end IN_MEASUREMENT /begin OUT_MEASUREMENT /end OUT_MEASUREMENT /end FUNCTION
/begin FUNCTION APSStaSystem "" /begin SUB_FUNCTION /end SUB_FUNCTION /begin DEF_CHARACTERISTIC /end DEF_CHARACTERISTIC /begin IN_MEASUREMENT /end IN_MEASUREMENT /begin OUT_MEASUREMENT /end OUT_MEASUREMENT /end FUNCTION
/begin FUNCTION AllDoorSW "" /begin SUB_FUNCTION Data_Type_Conversion /end SUB_FUNCTION /begin DEF_CHARACTERISTIC /end DEF_CHARACTERISTIC /begin IN_MEASUREMENT /end IN_MEASUREMENT /begin OUT_MEASUREMENT /end OUT_MEASUREMENT /end FUNCTION
/begin FUNCTION AntiTheftSeatFold "" /begin SUB_FUNCTION Data_Type_Conversion /end SUB_FUNCTION /begin DEF_CHARACTERISTIC /end DEF_CHARACTERISTIC /begin IN_MEASUREMENT /end IN_MEASUREMENT /begin OUT_MEASUREMENT /end OUT_MEASUREMENT /end FUNCTION
/begin FUNCTION AntitheftSta "" /begin SUB_FUNCTION /end SUB_FUNCTION /begin DEF_CHARACTERISTIC /end DEF_CHARACTERISTIC /begin IN_MEASUREMENT /end IN_MEASUREMENT /begin OUT_MEASUREMENT /end OUT_MEASUREMENT /end FUNCTION
/begin FUNCTION BCMDoorLockSta "" /begin SUB_FUNCTION Data_Type_Conversion /end SUB_FUNCTION /begin DEF_CHARACTERISTIC /end DEF_CHARACTERISTIC /begin IN_MEASUREMENT /end IN_MEASUREMENT /begin OUT_MEASUREMENT /end OUT_MEASUREMENT /end FUNCTION
/begin FUNCTION BrakeLamp "" /begin SUB_FUNCTION Data_Type_Conversion /end SUB_FUNCTION /begin DEF_CHARACTERISTIC /end DEF_CHARACTERISTIC /begin IN_MEASUREMENT /end IN_MEASUREMENT /begin OUT_MEASUREMENT /end OUT_MEASUREMENT /end FUNCTION
/begin FUNCTION Byte_0 "" /begin SUB_FUNCTION SignalPack /end SUB_FUNCTION /begin DEF_CHARACTERISTIC /end DEF_CHARACTERISTIC /begin IN_MEASUREMENT /end IN_MEASUREMENT /begin OUT_MEASUREMENT /end OUT_MEASUREMENT /end FUNCTION
/begin FUNCTION Byte_1 "" /begin SUB_FUNCTION SignalPack /end SUB_FUNCTION /begin DEF_CHARACTERISTIC /end DEF_CHARACTERISTIC /begin IN_MEASUREMENT /end IN_MEASUREMENT /begin OUT_MEASUREMENT /end OUT_MEASUREMENT /end FUNCTION
/begin FUNCTION Byte_10 "" /begin SUB_FUNCTION SignalPack UnitConverter /end SUB_FUNCTION /begin DEF_CHARACTERISTIC /end DEF_CHARACTERISTIC /begin IN_MEASUREMENT /end IN_MEASUREMENT /begin OUT_MEASUREMENT /end OUT_MEASUREMENT /end FUNCTION
/begin FUNCTION Byte_11 "" /begin SUB_FUNCTION SignalPack UnitConverter /end SUB_FUNCTION /begin DEF_CHARACTERISTIC /end DEF_CHARACTERISTIC /begin IN_MEASUREMENT /end IN_MEASUREMENT /begin OUT_MEASUREMENT /end OUT_MEASUREMENT /end FUNCTION
/begin FUNCTION Byte_12 ""
 /begin SUB_FUNCTION SignalPack SignalPack1 SignalPack2 SignalPack3 SignalPack4 SignalPack5 SignalPack6 UnitConverter1 UnitConverter11 UnitConverter3 UnitConverter5 UnitConverter7 UnitConverter9 /end SUB_FUNCTION
 /begin DEF_CHARACTERISTIC /end DEF_CHARACTERISTIC
 /begin IN_MEASUREMENT /end IN_MEASUREMENT
 /begin OUT_MEASUREMENT /end OUT_MEASUREMENT
/end FUNCTION
/begin FUNCTION Byte_13 "" /begin SUB_FUNCTION SignalPack UnitConverter1 /end SUB_FUNCTION /begin DEF_CHARACTERISTIC /end DEF_CHARACTERISTIC /begin IN_MEASUREMENT /end IN_MEASUREMENT /begin OUT_MEASUREMENT /end OUT_MEASUREMENT /end FUNCTION
/begin FUNCTION Byte_14 ""
 /begin SUB_FUNCTION SignalPack SignalPack1 SignalPack2 SignalPack3 SignalPack4 SignalPack5 UnitConverter1 UnitConverter11 UnitConverter5 UnitConverter9 /end SUB_FUNCTION
 /begin DEF_CHARACTERISTIC /end DEF_CHARACTERISTIC
 /begin IN_MEASUREMENT /end IN_MEASUREMENT
 /begin OUT_MEASUREMENT /end OUT_MEASUREMENT
/end FUNCTION
/begin FUNCTION Byte_15 ""
 /begin SUB_FUNCTION SignalPack SignalPack1 SignalPack2 SignalPack3 SignalPack4 SignalPack5 SignalPack6 SignalPack7 UnitConverter1 UnitConverter11 UnitConverter13 UnitConverter15 UnitConverter5 UnitConverter7 UnitConverter9 /end SUB_FUNCTION
 /begin DEF_CHARACTERISTIC /end DEF_CHARACTERISTIC
 /begin IN_MEASUREMENT /end IN_MEASUREMENT
 /begin OUT_MEASUREMENT /end OUT_MEASUREMENT
/end FUNCTION
/begin FUNCTION Byte_16 ""
 /begin SUB_FUNCTION SignalPack SignalPack1 SignalPack2 SignalPack3 SignalPack4 SignalPack5 SignalPack6 UnitConverter1 UnitConverter13 UnitConverter3 UnitConverter5 UnitConverter7 UnitConverter9 /end SUB_FUNCTION
 /begin DEF_CHARACTERISTIC /end DEF_CHARACTERISTIC
 /begin IN_MEASUREMENT /end IN_MEASUREMENT
 /begin OUT_MEASUREMENT /end OUT_MEASUREMENT
/end FUNCTION
/begin FUNCTION Byte_17 ""
 /begin SUB_FUNCTION SignalPack SignalPack1 SignalPack2 SignalPack3 SignalPack4 SignalPack5 SignalPack6 UnitConverter1 UnitConverter11 UnitConverter13 UnitConverter3 UnitConverter7 UnitConverter9 /end SUB_FUNCTION
 /begin DEF_CHARACTERISTIC /end DEF_CHARACTERISTIC
 /begin IN_MEASUREMENT /end IN_MEASUREMENT
 /begin OUT_MEASUREMENT /end OUT_MEASUREMENT
/end FUNCTION
/begin FUNCTION Byte_19 ""
 /begin SUB_FUNCTION SignalPack SignalPack1 SignalPack2 SignalPack3 SignalPack4 SignalPack5 SignalPack6 UnitConverter1 UnitConverter11 UnitConverter13 UnitConverter3 UnitConverter7 UnitConverter9 /end SUB_FUNCTION
 /begin DEF_CHARACTERISTIC /end DEF_CHARACTERISTIC
 /begin IN_MEASUREMENT /end IN_MEASUREMENT
 /begin OUT_MEASUREMENT /end OUT_MEASUREMENT
/end FUNCTION
/begin FUNCTION Byte_2 "" /begin SUB_FUNCTION SignalPack SignalPack1 SignalPack2 /end SUB_FUNCTION /begin DEF_CHARACTERISTIC /end DEF_CHARACTERISTIC /begin IN_MEASUREMENT /end IN_MEASUREMENT /begin OUT_MEASUREMENT /end OUT_MEASUREMENT /end FUNCTION
/begin FUNCTION Byte_20 "" /begin SUB_FUNCTION SignalPack SignalPack1 SignalPack2 /end SUB_FUNCTION /begin DEF_CHARACTERISTIC /end DEF_CHARACTERISTIC /begin IN_MEASUREMENT /end IN_MEASUREMENT /begin OUT_MEASUREMENT /end OUT_MEASUREMENT /end FUNCTION
/begin FUNCTION Byte_21 "" /begin SUB_FUNCTION SignalPack SignalPack1 /end SUB_FUNCTION /begin DEF_CHARACTERISTIC /end DEF_CHARACTERISTIC /begin IN_MEASUREMENT /end IN_MEASUREMENT /begin OUT_MEASUREMENT /end OUT_MEASUREMENT /end FUNCTION
/begin FUNCTION Byte_22 "" /begin SUB_FUNCTION SignalPack SignalPack1 /end SUB_FUNCTION /begin DEF_CHARACTERISTIC /end DEF_CHARACTERISTIC /begin IN_MEASUREMENT /end IN_MEASUREMENT /begin OUT_MEASUREMENT /end OUT_MEASUREMENT /end FUNCTION
/begin FUNCTION Byte_23 "" /begin SUB_FUNCTION SignalPack SignalPack1 SignalPack2 UnitConverter5 /end SUB_FUNCTION /begin DEF_CHARACTERISTIC /end DEF_CHARACTERISTIC /begin IN_MEASUREMENT /end IN_MEASUREMENT /begin OUT_MEASUREMENT /end OUT_MEASUREMENT /end FUNCTION
/begin FUNCTION Byte_25 ""
 /begin SUB_FUNCTION SignalPack SignalPack1 SignalPack2 SignalPack3 SignalPack4 SignalPack5 SignalPack6 UnitConverter1 UnitConverter13 UnitConverter3 UnitConverter5 UnitConverter7 UnitConverter9 /end SUB_FUNCTION
 /begin DEF_CHARACTERISTIC /end DEF_CHARACTERISTIC
 /begin IN_MEASUREMENT /end IN_MEASUREMENT
 /begin OUT_MEASUREMENT /end OUT_MEASUREMENT
/end FUNCTION
/begin FUNCTION Byte_26 ""
 /begin SUB_FUNCTION SignalPack SignalPack1 SignalPack2 SignalPack3 UnitConverter3 /end SUB_FUNCTION
 /begin DEF_CHARACTERISTIC /end DEF_CHARACTERISTIC
 /begin IN_MEASUREMENT /end IN_MEASUREMENT
 /begin OUT_MEASUREMENT /end OUT_MEASUREMENT
/end FUNCTION
/begin FUNCTION Byte_27 "" /begin SUB_FUNCTION SignalPack SignalPack1 UnitConverter1 UnitConverter3 /end SUB_FUNCTION /begin DEF_CHARACTERISTIC /end DEF_CHARACTERISTIC /begin IN_MEASUREMENT /end IN_MEASUREMENT /begin OUT_MEASUREMENT /end OUT_MEASUREMENT /end FUNCTION
/begin FUNCTION Byte_3 ""
 /begin SUB_FUNCTION SignalPack SignalPack1 SignalPack2 SignalPack3 UnitConverter5 /end SUB_FUNCTION
 /begin DEF_CHARACTERISTIC /end DEF_CHARACTERISTIC
 /begin IN_MEASUREMENT /end IN_MEASUREMENT
 /begin OUT_MEASUREMENT /end OUT_MEASUREMENT
/end FUNCTION
/begin FUNCTION Byte_4 "" /begin SUB_FUNCTION SignalPack UnitConverter /end SUB_FUNCTION /begin DEF_CHARACTERISTIC /end DEF_CHARACTERISTIC /begin IN_MEASUREMENT /end IN_MEASUREMENT /begin OUT_MEASUREMENT /end OUT_MEASUREMENT /end FUNCTION
/begin FUNCTION Byte_5 "" /begin SUB_FUNCTION SignalPack UnitConverter /end SUB_FUNCTION /begin DEF_CHARACTERISTIC /end DEF_CHARACTERISTIC /begin IN_MEASUREMENT /end IN_MEASUREMENT /begin OUT_MEASUREMENT /end OUT_MEASUREMENT /end FUNCTION
/begin FUNCTION Byte_6 "" /begin SUB_FUNCTION SignalPack UnitConverter /end SUB_FUNCTION /begin DEF_CHARACTERISTIC /end DEF_CHARACTERISTIC /begin IN_MEASUREMENT /end IN_MEASUREMENT /begin OUT_MEASUREMENT /end OUT_MEASUREMENT /end FUNCTION
/begin FUNCTION Byte_7 "" /begin SUB_FUNCTION SignalPack UnitConverter /end SUB_FUNCTION /begin DEF_CHARACTERISTIC /end DEF_CHARACTERISTIC /begin IN_MEASUREMENT /end IN_MEASUREMENT /begin OUT_MEASUREMENT /end OUT_MEASUREMENT /end FUNCTION
/begin FUNCTION Byte_8 "" /begin SUB_FUNCTION SignalPack UnitConverter /end SUB_FUNCTION /begin DEF_CHARACTERISTIC /end DEF_CHARACTERISTIC /begin IN_MEASUREMENT /end IN_MEASUREMENT /begin OUT_MEASUREMENT /end OUT_MEASUREMENT /end FUNCTION
/begin FUNCTION Byte_9 "" /begin SUB_FUNCTION SignalPack UnitConverter /end SUB_FUNCTION /begin DEF_CHARACTERISTIC /end DEF_CHARACTERISTIC /begin IN_MEASUREMENT /end IN_MEASUREMENT /begin OUT_MEASUREMENT /end OUT_MEASUREMENT /end FUNCTION
/begin FUNCTION CCCrlSta "" /begin SUB_FUNCTION /end SUB_FUNCTION /begin DEF_CHARACTERISTIC /end DEF_CHARACTERISTIC /begin IN_MEASUREMENT /end IN_MEASUREMENT /begin OUT_MEASUREMENT /end OUT_MEASUREMENT /end FUNCTION
/begin FUNCTION CRC8_IfAction_Tx ""
 /begin SUB_FUNCTION If_Action_Subsystem If_Action_Subsystem1 Data_Type_Conversion If Merge /end SUB_FUNCTION
 /begin DEF_CHARACTERISTIC /end DEF_CHARACTERISTIC
 /begin IN_MEASUREMENT /end IN_MEASUREMENT
 /begin OUT_MEASUREMENT /end OUT_MEASUREMENT
/end FUNCTION
/begin FUNCTION CSVCU1CAN4 "" /begin SUB_FUNCTION /end SUB_FUNCTION /begin DEF_CHARACTERISTIC /end DEF_CHARACTERISTIC /begin IN_MEASUREMENT /end IN_MEASUREMENT /begin OUT_MEASUREMENT /end OUT_MEASUREMENT /end FUNCTION
/begin FUNCTION CTDCtrl "" /begin SUB_FUNCTION /end SUB_FUNCTION /begin DEF_CHARACTERISTIC /end DEF_CHARACTERISTIC /begin IN_MEASUREMENT /end IN_MEASUREMENT /begin OUT_MEASUREMENT /end OUT_MEASUREMENT /end FUNCTION
/begin FUNCTION CTDLockSW "" /begin SUB_FUNCTION Data_Type_Conversion /end SUB_FUNCTION /begin DEF_CHARACTERISTIC /end DEF_CHARACTERISTIC /begin IN_MEASUREMENT /end IN_MEASUREMENT /begin OUT_MEASUREMENT /end OUT_MEASUREMENT /end FUNCTION
/begin FUNCTION CTDUnlockSW "" /begin SUB_FUNCTION /end SUB_FUNCTION /begin DEF_CHARACTERISTIC /end DEF_CHARACTERISTIC /begin IN_MEASUREMENT /end IN_MEASUREMENT /begin OUT_MEASUREMENT /end OUT_MEASUREMENT /end FUNCTION
/begin FUNCTION CrashDetd "" /begin SUB_FUNCTION Data_Type_Conversion /end SUB_FUNCTION /begin DEF_CHARACTERISTIC /end DEF_CHARACTERISTIC /begin IN_MEASUREMENT /end IN_MEASUREMENT /begin OUT_MEASUREMENT /end OUT_MEASUREMENT /end FUNCTION
/begin FUNCTION CtrlDrPwrStbA2 "" /begin SUB_FUNCTION Data_Type_Conversion /end SUB_FUNCTION /begin DEF_CHARACTERISTIC /end DEF_CHARACTERISTIC /begin IN_MEASUREMENT /end IN_MEASUREMENT /begin OUT_MEASUREMENT /end OUT_MEASUREMENT /end FUNCTION
/begin FUNCTION CtrlFrBMSCCUCIR "" /begin SUB_FUNCTION Data_Type_Conversion /end SUB_FUNCTION /begin DEF_CHARACTERISTIC /end DEF_CHARACTERISTIC /begin IN_MEASUREMENT /end IN_MEASUREMENT /begin OUT_MEASUREMENT /end OUT_MEASUREMENT /end FUNCTION
/begin FUNCTION CtrlFrEDUINVERTER "" /begin SUB_FUNCTION Data_Type_Conversion /end SUB_FUNCTION /begin DEF_CHARACTERISTIC /end DEF_CHARACTERISTIC /begin IN_MEASUREMENT /end IN_MEASUREMENT /begin OUT_MEASUREMENT /end OUT_MEASUREMENT /end FUNCTION
/begin FUNCTION CtrlFrIRC1 "" /begin SUB_FUNCTION Data_Type_Conversion /end SUB_FUNCTION /begin DEF_CHARACTERISTIC /end DEF_CHARACTERISTIC /begin IN_MEASUREMENT /end IN_MEASUREMENT /begin OUT_MEASUREMENT /end OUT_MEASUREMENT /end FUNCTION
/begin FUNCTION CtrlFrPwrStbA1P "" /begin SUB_FUNCTION Data_Type_Conversion /end SUB_FUNCTION /begin DEF_CHARACTERISTIC /end DEF_CHARACTERISTIC /begin IN_MEASUREMENT /end IN_MEASUREMENT /begin OUT_MEASUREMENT /end OUT_MEASUREMENT /end FUNCTION
/begin FUNCTION DKCAuthSta "" /begin SUB_FUNCTION /end SUB_FUNCTION /begin DEF_CHARACTERISTIC /end DEF_CHARACTERISTIC /begin IN_MEASUREMENT /end IN_MEASUREMENT /begin OUT_MEASUREMENT /end OUT_MEASUREMENT /end FUNCTION
/begin FUNCTION DKCTimeSN "" /begin SUB_FUNCTION /end SUB_FUNCTION /begin DEF_CHARACTERISTIC /end DEF_CHARACTERISTIC /begin IN_MEASUREMENT /end IN_MEASUREMENT /begin OUT_MEASUREMENT /end OUT_MEASUREMENT /end FUNCTION
/begin FUNCTION Dimmer "" /begin SUB_FUNCTION Data_Type_Conversion /end SUB_FUNCTION /begin DEF_CHARACTERISTIC /end DEF_CHARACTERISTIC /begin IN_MEASUREMENT /end IN_MEASUREMENT /begin OUT_MEASUREMENT /end OUT_MEASUREMENT /end FUNCTION
/begin FUNCTION DimmerEN "" /begin SUB_FUNCTION Data_Type_Conversion /end SUB_FUNCTION /begin DEF_CHARACTERISTIC /end DEF_CHARACTERISTIC /begin IN_MEASUREMENT /end IN_MEASUREMENT /begin OUT_MEASUREMENT /end OUT_MEASUREMENT /end FUNCTION
/begin FUNCTION DoorLockIND "" /begin SUB_FUNCTION Data_Type_Conversion /end SUB_FUNCTION /begin DEF_CHARACTERISTIC /end DEF_CHARACTERISTIC /begin IN_MEASUREMENT /end IN_MEASUREMENT /begin OUT_MEASUREMENT /end OUT_MEASUREMENT /end FUNCTION
/begin FUNCTION DrDoorSW "" /begin SUB_FUNCTION Data_Type_Conversion /end SUB_FUNCTION /begin DEF_CHARACTERISTIC /end DEF_CHARACTERISTIC /begin IN_MEASUREMENT /end IN_MEASUREMENT /begin OUT_MEASUREMENT /end OUT_MEASUREMENT /end FUNCTION
/begin FUNCTION DrSeatSta "" /begin SUB_FUNCTION /end SUB_FUNCTION /begin DEF_CHARACTERISTIC /end DEF_CHARACTERISTIC /begin IN_MEASUREMENT /end IN_MEASUREMENT /begin OUT_MEASUREMENT /end OUT_MEASUREMENT /end FUNCTION
/begin FUNCTION EquivAccPedalSWSta "" /begin SUB_FUNCTION Data_Type_Conversion /end SUB_FUNCTION /begin DEF_CHARACTERISTIC /end DEF_CHARACTERISTIC /begin IN_MEASUREMENT /end IN_MEASUREMENT /begin OUT_MEASUREMENT /end OUT_MEASUREMENT /end FUNCTION
/begin FUNCTION FDCVMCVehPitchAngleSta "" /begin SUB_FUNCTION /end SUB_FUNCTION /begin DEF_CHARACTERISTIC /end DEF_CHARACTERISTIC /begin IN_MEASUREMENT /end IN_MEASUREMENT /begin OUT_MEASUREMENT /end OUT_MEASUREMENT /end FUNCTION
/begin FUNCTION FDDKCVehDataErr "" /begin SUB_FUNCTION /end SUB_FUNCTION /begin DEF_CHARACTERISTIC /end DEF_CHARACTERISTIC /begin IN_MEASUREMENT /end IN_MEASUREMENT /begin OUT_MEASUREMENT /end OUT_MEASUREMENT /end FUNCTION
/begin FUNCTION FDDKCVehDataSta "" /begin SUB_FUNCTION /end SUB_FUNCTION /begin DEF_CHARACTERISTIC /end DEF_CHARACTERISTIC /begin IN_MEASUREMENT /end IN_MEASUREMENT /begin OUT_MEASUREMENT /end OUT_MEASUREMENT /end FUNCTION
/begin FUNCTION FDTBOXDTCDataErr "" /begin SUB_FUNCTION /end SUB_FUNCTION /begin DEF_CHARACTERISTIC /end DEF_CHARACTERISTIC /begin IN_MEASUREMENT /end IN_MEASUREMENT /begin OUT_MEASUREMENT /end OUT_MEASUREMENT /end FUNCTION
/begin FUNCTION FDTBOXDTCDataSta "" /begin SUB_FUNCTION /end SUB_FUNCTION /begin DEF_CHARACTERISTIC /end DEF_CHARACTERISTIC /begin IN_MEASUREMENT /end IN_MEASUREMENT /begin OUT_MEASUREMENT /end OUT_MEASUREMENT /end FUNCTION
/begin FUNCTION FDTBOXVehDataErr "" /begin SUB_FUNCTION /end SUB_FUNCTION /begin DEF_CHARACTERISTIC /end DEF_CHARACTERISTIC /begin IN_MEASUREMENT /end IN_MEASUREMENT /begin OUT_MEASUREMENT /end OUT_MEASUREMENT /end FUNCTION
/begin FUNCTION FDTBOXVehDataSta "" /begin SUB_FUNCTION /end SUB_FUNCTION /begin DEF_CHARACTERISTIC /end DEF_CHARACTERISTIC /begin IN_MEASUREMENT /end IN_MEASUREMENT /begin OUT_MEASUREMENT /end OUT_MEASUREMENT /end FUNCTION
/begin FUNCTION FrChargingDoorCtrl "" /begin SUB_FUNCTION /end SUB_FUNCTION /begin DEF_CHARACTERISTIC /end DEF_CHARACTERISTIC /begin IN_MEASUREMENT /end IN_MEASUREMENT /begin OUT_MEASUREMENT /end OUT_MEASUREMENT /end FUNCTION
/begin FUNCTION FrFogLamp "" /begin SUB_FUNCTION /end SUB_FUNCTION /begin DEF_CHARACTERISTIC /end DEF_CHARACTERISTIC /begin IN_MEASUREMENT /end IN_MEASUREMENT /begin OUT_MEASUREMENT /end OUT_MEASUREMENT /end FUNCTION
/begin FUNCTION FrWiperH "" /begin SUB_FUNCTION Data_Type_Conversion /end SUB_FUNCTION /begin DEF_CHARACTERISTIC /end DEF_CHARACTERISTIC /begin IN_MEASUREMENT /end IN_MEASUREMENT /begin OUT_MEASUREMENT /end OUT_MEASUREMENT /end FUNCTION
/begin FUNCTION FrWiperL "" /begin SUB_FUNCTION Data_Type_Conversion /end SUB_FUNCTION /begin DEF_CHARACTERISTIC /end DEF_CHARACTERISTIC /begin IN_MEASUREMENT /end IN_MEASUREMENT /begin OUT_MEASUREMENT /end OUT_MEASUREMENT /end FUNCTION
/begin FUNCTION HBeam "" /begin SUB_FUNCTION Data_Type_Conversion /end SUB_FUNCTION /begin DEF_CHARACTERISTIC /end DEF_CHARACTERISTIC /begin IN_MEASUREMENT /end IN_MEASUREMENT /begin OUT_MEASUREMENT /end OUT_MEASUREMENT /end FUNCTION
/begin FUNCTION HBeamADB "" /begin SUB_FUNCTION /end SUB_FUNCTION /begin DEF_CHARACTERISTIC /end DEF_CHARACTERISTIC /begin IN_MEASUREMENT /end IN_MEASUREMENT /begin OUT_MEASUREMENT /end OUT_MEASUREMENT /end FUNCTION
/begin FUNCTION HWResetSta "" /begin SUB_FUNCTION /end SUB_FUNCTION /begin DEF_CHARACTERISTIC /end DEF_CHARACTERISTIC /begin IN_MEASUREMENT /end IN_MEASUREMENT /begin OUT_MEASUREMENT /end OUT_MEASUREMENT /end FUNCTION
/begin FUNCTION HazardSW "" /begin SUB_FUNCTION Data_Type_Conversion /end SUB_FUNCTION /begin DEF_CHARACTERISTIC /end DEF_CHARACTERISTIC /begin IN_MEASUREMENT /end IN_MEASUREMENT /begin OUT_MEASUREMENT /end OUT_MEASUREMENT /end FUNCTION
/begin FUNCTION HoodSW "" /begin SUB_FUNCTION Data_Type_Conversion /end SUB_FUNCTION /begin DEF_CHARACTERISTIC /end DEF_CHARACTERISTIC /begin IN_MEASUREMENT /end IN_MEASUREMENT /begin OUT_MEASUREMENT /end OUT_MEASUREMENT /end FUNCTION
/begin FUNCTION HornCtrl "" /begin SUB_FUNCTION Data_Type_Conversion /end SUB_FUNCTION /begin DEF_CHARACTERISTIC /end DEF_CHARACTERISTIC /begin IN_MEASUREMENT /end IN_MEASUREMENT /begin OUT_MEASUREMENT /end OUT_MEASUREMENT /end FUNCTION
/begin FUNCTION LAPMWdwEnable "" /begin SUB_FUNCTION /end SUB_FUNCTION /begin DEF_CHARACTERISTIC /end DEF_CHARACTERISTIC /begin IN_MEASUREMENT /end IN_MEASUREMENT /begin OUT_MEASUREMENT /end OUT_MEASUREMENT /end FUNCTION
/begin FUNCTION LBSD "" /begin SUB_FUNCTION Data_Type_Conversion /end SUB_FUNCTION /begin DEF_CHARACTERISTIC /end DEF_CHARACTERISTIC /begin IN_MEASUREMENT /end IN_MEASUREMENT /begin OUT_MEASUREMENT /end OUT_MEASUREMENT /end FUNCTION
/begin FUNCTION LBeam "" /begin SUB_FUNCTION Data_Type_Conversion /end SUB_FUNCTION /begin DEF_CHARACTERISTIC /end DEF_CHARACTERISTIC /begin IN_MEASUREMENT /end IN_MEASUREMENT /begin OUT_MEASUREMENT /end OUT_MEASUREMENT /end FUNCTION
/begin FUNCTION LDRL "" /begin SUB_FUNCTION Data_Type_Conversion /end SUB_FUNCTION /begin DEF_CHARACTERISTIC /end DEF_CHARACTERISTIC /begin IN_MEASUREMENT /end IN_MEASUREMENT /begin OUT_MEASUREMENT /end OUT_MEASUREMENT /end FUNCTION
/begin FUNCTION LTurnLP "" /begin SUB_FUNCTION Data_Type_Conversion /end SUB_FUNCTION /begin DEF_CHARACTERISTIC /end DEF_CHARACTERISTIC /begin IN_MEASUREMENT /end IN_MEASUREMENT /begin OUT_MEASUREMENT /end OUT_MEASUREMENT /end FUNCTION
/begin FUNCTION LampPwr "" /begin SUB_FUNCTION Data_Type_Conversion /end SUB_FUNCTION /begin DEF_CHARACTERISTIC /end DEF_CHARACTERISTIC /begin IN_MEASUREMENT /end IN_MEASUREMENT /begin OUT_MEASUREMENT /end OUT_MEASUREMENT /end FUNCTION
/begin FUNCTION LockSetting "" /begin SUB_FUNCTION Data_Type_Conversion /end SUB_FUNCTION /begin DEF_CHARACTERISTIC /end DEF_CHARACTERISTIC /begin IN_MEASUREMENT /end IN_MEASUREMENT /begin OUT_MEASUREMENT /end OUT_MEASUREMENT /end FUNCTION
/begin FUNCTION MSACrlSta "" /begin SUB_FUNCTION /end SUB_FUNCTION /begin DEF_CHARACTERISTIC /end DEF_CHARACTERISTIC /begin IN_MEASUREMENT /end IN_MEASUREMENT /begin OUT_MEASUREMENT /end OUT_MEASUREMENT /end FUNCTION
/begin FUNCTION MirrorCtrl "" /begin SUB_FUNCTION /end SUB_FUNCTION /begin DEF_CHARACTERISTIC /end DEF_CHARACTERISTIC /begin IN_MEASUREMENT /end IN_MEASUREMENT /begin OUT_MEASUREMENT /end OUT_MEASUREMENT /end FUNCTION
/begin FUNCTION MirrorDefog "" /begin SUB_FUNCTION Data_Type_Conversion /end SUB_FUNCTION /begin DEF_CHARACTERISTIC /end DEF_CHARACTERISTIC /begin IN_MEASUREMENT /end IN_MEASUREMENT /begin OUT_MEASUREMENT /end OUT_MEASUREMENT /end FUNCTION
/begin FUNCTION PosLamp "" /begin SUB_FUNCTION Data_Type_Conversion /end SUB_FUNCTION /begin DEF_CHARACTERISTIC /end DEF_CHARACTERISTIC /begin IN_MEASUREMENT /end IN_MEASUREMENT /begin OUT_MEASUREMENT /end OUT_MEASUREMENT /end FUNCTION
/begin FUNCTION PsDoorSW "" /begin SUB_FUNCTION Data_Type_Conversion /end SUB_FUNCTION /begin DEF_CHARACTERISTIC /end DEF_CHARACTERISTIC /begin IN_MEASUREMENT /end IN_MEASUREMENT /begin OUT_MEASUREMENT /end OUT_MEASUREMENT /end FUNCTION
/begin FUNCTION PwrSta "" /begin SUB_FUNCTION /end SUB_FUNCTION /begin DEF_CHARACTERISTIC /end DEF_CHARACTERISTIC /begin IN_MEASUREMENT /end IN_MEASUREMENT /begin OUT_MEASUREMENT /end OUT_MEASUREMENT /end FUNCTION
/begin FUNCTION RBSD "" /begin SUB_FUNCTION Data_Type_Conversion /end SUB_FUNCTION /begin DEF_CHARACTERISTIC /end DEF_CHARACTERISTIC /begin IN_MEASUREMENT /end IN_MEASUREMENT /begin OUT_MEASUREMENT /end OUT_MEASUREMENT /end FUNCTION
/begin FUNCTION RCVCU1CAN4 "" /begin SUB_FUNCTION /end SUB_FUNCTION /begin DEF_CHARACTERISTIC /end DEF_CHARACTERISTIC /begin IN_MEASUREMENT /end IN_MEASUREMENT /begin OUT_MEASUREMENT /end OUT_MEASUREMENT /end FUNCTION
/begin FUNCTION RDRL "" /begin SUB_FUNCTION Data_Type_Conversion /end SUB_FUNCTION /begin DEF_CHARACTERISTIC /end DEF_CHARACTERISTIC /begin IN_MEASUREMENT /end IN_MEASUREMENT /begin OUT_MEASUREMENT /end OUT_MEASUREMENT /end FUNCTION
/begin FUNCTION RLDoorSW "" /begin SUB_FUNCTION Data_Type_Conversion /end SUB_FUNCTION /begin DEF_CHARACTERISTIC /end DEF_CHARACTERISTIC /begin IN_MEASUREMENT /end IN_MEASUREMENT /begin OUT_MEASUREMENT /end OUT_MEASUREMENT /end FUNCTION
/begin FUNCTION RRDoorSW "" /begin SUB_FUNCTION Data_Type_Conversion /end SUB_FUNCTION /begin DEF_CHARACTERISTIC /end DEF_CHARACTERISTIC /begin IN_MEASUREMENT /end IN_MEASUREMENT /begin OUT_MEASUREMENT /end OUT_MEASUREMENT /end FUNCTION
/begin FUNCTION RTurnLP "" /begin SUB_FUNCTION Data_Type_Conversion /end SUB_FUNCTION /begin DEF_CHARACTERISTIC /end DEF_CHARACTERISTIC /begin IN_MEASUREMENT /end IN_MEASUREMENT /begin OUT_MEASUREMENT /end OUT_MEASUREMENT /end FUNCTION
/begin FUNCTION ReBrakeLPReq "" /begin SUB_FUNCTION Data_Type_Conversion /end SUB_FUNCTION /begin DEF_CHARACTERISTIC /end DEF_CHARACTERISTIC /begin IN_MEASUREMENT /end IN_MEASUREMENT /begin OUT_MEASUREMENT /end OUT_MEASUREMENT /end FUNCTION
/begin FUNCTION ReverseLamp "" /begin SUB_FUNCTION Data_Type_Conversion /end SUB_FUNCTION /begin DEF_CHARACTERISTIC /end DEF_CHARACTERISTIC /begin IN_MEASUREMENT /end IN_MEASUREMENT /begin OUT_MEASUREMENT /end OUT_MEASUREMENT /end FUNCTION
/begin FUNCTION RollingCounter_IfAction ""
 /begin SUB_FUNCTION Constant1 Constant65 Constant66 Constant67 Equal34 Add2 Switch Switch5 Unit_Delay5 /end SUB_FUNCTION
 /begin DEF_CHARACTERISTIC /end DEF_CHARACTERISTIC
 /begin IN_MEASUREMENT /end IN_MEASUREMENT
 /begin OUT_MEASUREMENT /end OUT_MEASUREMENT
/end FUNCTION
/begin FUNCTION RollingCounter_IfAction1 ""
 /begin SUB_FUNCTION Constant1 Constant65 Constant66 Constant67 Equal34 Add2 Switch Switch5 Unit_Delay5 /end SUB_FUNCTION
 /begin DEF_CHARACTERISTIC /end DEF_CHARACTERISTIC
 /begin IN_MEASUREMENT /end IN_MEASUREMENT
 /begin OUT_MEASUREMENT /end OUT_MEASUREMENT
/end FUNCTION
/begin FUNCTION RoomLampH "" /begin SUB_FUNCTION Data_Type_Conversion /end SUB_FUNCTION /begin DEF_CHARACTERISTIC /end DEF_CHARACTERISTIC /begin IN_MEASUREMENT /end IN_MEASUREMENT /begin OUT_MEASUREMENT /end OUT_MEASUREMENT /end FUNCTION
/begin FUNCTION RoomLampL "" /begin SUB_FUNCTION Data_Type_Conversion /end SUB_FUNCTION /begin DEF_CHARACTERISTIC /end DEF_CHARACTERISTIC /begin IN_MEASUREMENT /end IN_MEASUREMENT /begin OUT_MEASUREMENT /end OUT_MEASUREMENT /end FUNCTION
/begin FUNCTION RrChargingDoorCtrl "" /begin SUB_FUNCTION /end SUB_FUNCTION /begin DEF_CHARACTERISTIC /end DEF_CHARACTERISTIC /begin IN_MEASUREMENT /end IN_MEASUREMENT /begin OUT_MEASUREMENT /end OUT_MEASUREMENT /end FUNCTION
/begin FUNCTION RrDefog "" /begin SUB_FUNCTION Data_Type_Conversion /end SUB_FUNCTION /begin DEF_CHARACTERISTIC /end DEF_CHARACTERISTIC /begin IN_MEASUREMENT /end IN_MEASUREMENT /begin OUT_MEASUREMENT /end OUT_MEASUREMENT /end FUNCTION
/begin FUNCTION RrFogLamp "" /begin SUB_FUNCTION Data_Type_Conversion /end SUB_FUNCTION /begin DEF_CHARACTERISTIC /end DEF_CHARACTERISTIC /begin IN_MEASUREMENT /end IN_MEASUREMENT /begin OUT_MEASUREMENT /end OUT_MEASUREMENT /end FUNCTION
/begin FUNCTION RrWiper "" /begin SUB_FUNCTION Data_Type_Conversion /end SUB_FUNCTION /begin DEF_CHARACTERISTIC /end DEF_CHARACTERISTIC /begin IN_MEASUREMENT /end IN_MEASUREMENT /begin OUT_MEASUREMENT /end OUT_MEASUREMENT /end FUNCTION
/begin FUNCTION ShiftGearPosn "" /begin SUB_FUNCTION /end SUB_FUNCTION /begin DEF_CHARACTERISTIC /end DEF_CHARACTERISTIC /begin IN_MEASUREMENT /end IN_MEASUREMENT /begin OUT_MEASUREMENT /end OUT_MEASUREMENT /end FUNCTION
/begin FUNCTION TailgateHDSW "" /begin SUB_FUNCTION Data_Type_Conversion /end SUB_FUNCTION /begin DEF_CHARACTERISTIC /end DEF_CHARACTERISTIC /begin IN_MEASUREMENT /end IN_MEASUREMENT /begin OUT_MEASUREMENT /end OUT_MEASUREMENT /end FUNCTION
/begin FUNCTION TailgateRemote "" /begin SUB_FUNCTION /end SUB_FUNCTION /begin DEF_CHARACTERISTIC /end DEF_CHARACTERISTIC /begin IN_MEASUREMENT /end IN_MEASUREMENT /begin OUT_MEASUREMENT /end OUT_MEASUREMENT /end FUNCTION
/begin FUNCTION TailgateSW "" /begin SUB_FUNCTION Data_Type_Conversion /end SUB_FUNCTION /begin DEF_CHARACTERISTIC /end DEF_CHARACTERISTIC /begin IN_MEASUREMENT /end IN_MEASUREMENT /begin OUT_MEASUREMENT /end OUT_MEASUREMENT /end FUNCTION
/begin FUNCTION TimeSNDKCFbk "" /begin SUB_FUNCTION /end SUB_FUNCTION /begin DEF_CHARACTERISTIC /end DEF_CHARACTERISTIC /begin IN_MEASUREMENT /end IN_MEASUREMENT /begin OUT_MEASUREMENT /end OUT_MEASUREMENT /end FUNCTION
/begin FUNCTION TrunkRel "" /begin SUB_FUNCTION Data_Type_Conversion /end SUB_FUNCTION /begin DEF_CHARACTERISTIC /end DEF_CHARACTERISTIC /begin IN_MEASUREMENT /end IN_MEASUREMENT /begin OUT_MEASUREMENT /end OUT_MEASUREMENT /end FUNCTION
/begin FUNCTION WasherCtrl "" /begin SUB_FUNCTION /end SUB_FUNCTION /begin DEF_CHARACTERISTIC /end DEF_CHARACTERISTIC /begin IN_MEASUREMENT /end IN_MEASUREMENT /begin OUT_MEASUREMENT /end OUT_MEASUREMENT /end FUNCTION
/begin FUNCTION WiperFixMode "" /begin SUB_FUNCTION Data_Type_Conversion /end SUB_FUNCTION /begin DEF_CHARACTERISTIC /end DEF_CHARACTERISTIC /begin IN_MEASUREMENT /end IN_MEASUREMENT /begin OUT_MEASUREMENT /end OUT_MEASUREMENT /end FUNCTION
/begin FUNCTION bus_creator "" /begin DEF_CHARACTERISTIC /end DEF_CHARACTERISTIC /begin IN_MEASUREMENT /end IN_MEASUREMENT /begin OUT_MEASUREMENT /end OUT_MEASUREMENT /end FUNCTION
/begin FUNCTION Byte_18 "" /begin DEF_CHARACTERISTIC /end DEF_CHARACTERISTIC /begin IN_MEASUREMENT /end IN_MEASUREMENT /begin OUT_MEASUREMENT /end OUT_MEASUREMENT /end FUNCTION
/begin FUNCTION Byte_24 "" /begin DEF_CHARACTERISTIC /end DEF_CHARACTERISTIC /begin IN_MEASUREMENT /end IN_MEASUREMENT /begin OUT_MEASUREMENT /end OUT_MEASUREMENT /end FUNCTION
/begin FUNCTION Byte_28 "" /begin DEF_CHARACTERISTIC /end DEF_CHARACTERISTIC /begin IN_MEASUREMENT /end IN_MEASUREMENT /begin OUT_MEASUREMENT /end OUT_MEASUREMENT /end FUNCTION
/begin FUNCTION Byte_29 "" /begin DEF_CHARACTERISTIC /end DEF_CHARACTERISTIC /begin IN_MEASUREMENT /end IN_MEASUREMENT /begin OUT_MEASUREMENT /end OUT_MEASUREMENT /end FUNCTION
/begin FUNCTION Byte_30 "" /begin DEF_CHARACTERISTIC /end DEF_CHARACTERISTIC /begin IN_MEASUREMENT /end IN_MEASUREMENT /begin OUT_MEASUREMENT /end OUT_MEASUREMENT /end FUNCTION
/begin FUNCTION Byte_31 "" /begin DEF_CHARACTERISTIC /end DEF_CHARACTERISTIC /begin IN_MEASUREMENT /end IN_MEASUREMENT /begin OUT_MEASUREMENT /end OUT_MEASUREMENT /end FUNCTION
/begin FUNCTION Constant "" /begin DEF_CHARACTERISTIC KHAL_CAN4FD4CE1000E2E_flg /end DEF_CHARACTERISTIC /begin IN_MEASUREMENT /end IN_MEASUREMENT /begin OUT_MEASUREMENT /end OUT_MEASUREMENT /end FUNCTION
/begin FUNCTION Constant1 "" /begin DEF_CHARACTERISTIC /end DEF_CHARACTERISTIC /begin IN_MEASUREMENT /end IN_MEASUREMENT /begin OUT_MEASUREMENT /end OUT_MEASUREMENT /end FUNCTION
/begin FUNCTION Constant2 "" /begin DEF_CHARACTERISTIC /end DEF_CHARACTERISTIC /begin IN_MEASUREMENT /end IN_MEASUREMENT /begin OUT_MEASUREMENT /end OUT_MEASUREMENT /end FUNCTION
/begin FUNCTION Constant3 "" /begin DEF_CHARACTERISTIC KHAL_CAN4FD4CE1000E2E_flg /end DEF_CHARACTERISTIC /begin IN_MEASUREMENT /end IN_MEASUREMENT /begin OUT_MEASUREMENT /end OUT_MEASUREMENT /end FUNCTION
/begin FUNCTION Constant4 "" /begin DEF_CHARACTERISTIC KHAL_CAN4FD4CE1000E2E_flg /end DEF_CHARACTERISTIC /begin IN_MEASUREMENT /end IN_MEASUREMENT /begin OUT_MEASUREMENT /end OUT_MEASUREMENT /end FUNCTION
/begin FUNCTION convert_out "" /begin SUB_FUNCTION Constant gain offset MinMax Divide Add /end SUB_FUNCTION /begin DEF_CHARACTERISTIC /end DEF_CHARACTERISTIC /begin IN_MEASUREMENT /end IN_MEASUREMENT /begin OUT_MEASUREMENT /end OUT_MEASUREMENT /end FUNCTION
/begin FUNCTION detect_change "" /begin SUB_FUNCTION FixPt_Relational_Operator Delay_Input1 /end SUB_FUNCTION /begin DEF_CHARACTERISTIC /end DEF_CHARACTERISTIC /begin IN_MEASUREMENT /end IN_MEASUREMENT /begin OUT_MEASUREMENT /end OUT_MEASUREMENT /end FUNCTION
/begin FUNCTION detect_change1 "" /begin SUB_FUNCTION FixPt_Relational_Operator Delay_Input1 /end SUB_FUNCTION /begin DEF_CHARACTERISTIC /end DEF_CHARACTERISTIC /begin IN_MEASUREMENT /end IN_MEASUREMENT /begin OUT_MEASUREMENT /end OUT_MEASUREMENT /end FUNCTION
/begin FUNCTION detect_change10 "" /begin SUB_FUNCTION FixPt_Relational_Operator Delay_Input1 /end SUB_FUNCTION /begin DEF_CHARACTERISTIC /end DEF_CHARACTERISTIC /begin IN_MEASUREMENT /end IN_MEASUREMENT /begin OUT_MEASUREMENT /end OUT_MEASUREMENT /end FUNCTION
/begin FUNCTION detect_change11 "" /begin SUB_FUNCTION FixPt_Relational_Operator Delay_Input1 /end SUB_FUNCTION /begin DEF_CHARACTERISTIC /end DEF_CHARACTERISTIC /begin IN_MEASUREMENT /end IN_MEASUREMENT /begin OUT_MEASUREMENT /end OUT_MEASUREMENT /end FUNCTION
/begin FUNCTION detect_change12 "" /begin SUB_FUNCTION FixPt_Relational_Operator Delay_Input1 /end SUB_FUNCTION /begin DEF_CHARACTERISTIC /end DEF_CHARACTERISTIC /begin IN_MEASUREMENT /end IN_MEASUREMENT /begin OUT_MEASUREMENT /end OUT_MEASUREMENT /end FUNCTION
/begin FUNCTION detect_change13 "" /begin SUB_FUNCTION FixPt_Relational_Operator Delay_Input1 /end SUB_FUNCTION /begin DEF_CHARACTERISTIC /end DEF_CHARACTERISTIC /begin IN_MEASUREMENT /end IN_MEASUREMENT /begin OUT_MEASUREMENT /end OUT_MEASUREMENT /end FUNCTION
/begin FUNCTION detect_change14 "" /begin SUB_FUNCTION FixPt_Relational_Operator Delay_Input1 /end SUB_FUNCTION /begin DEF_CHARACTERISTIC /end DEF_CHARACTERISTIC /begin IN_MEASUREMENT /end IN_MEASUREMENT /begin OUT_MEASUREMENT /end OUT_MEASUREMENT /end FUNCTION
/begin FUNCTION detect_change15 "" /begin SUB_FUNCTION FixPt_Relational_Operator Delay_Input1 /end SUB_FUNCTION /begin DEF_CHARACTERISTIC /end DEF_CHARACTERISTIC /begin IN_MEASUREMENT /end IN_MEASUREMENT /begin OUT_MEASUREMENT /end OUT_MEASUREMENT /end FUNCTION
/begin FUNCTION detect_change16 "" /begin SUB_FUNCTION FixPt_Relational_Operator Delay_Input1 /end SUB_FUNCTION /begin DEF_CHARACTERISTIC /end DEF_CHARACTERISTIC /begin IN_MEASUREMENT /end IN_MEASUREMENT /begin OUT_MEASUREMENT /end OUT_MEASUREMENT /end FUNCTION
/begin FUNCTION detect_change17 "" /begin SUB_FUNCTION FixPt_Relational_Operator Delay_Input1 /end SUB_FUNCTION /begin DEF_CHARACTERISTIC /end DEF_CHARACTERISTIC /begin IN_MEASUREMENT /end IN_MEASUREMENT /begin OUT_MEASUREMENT /end OUT_MEASUREMENT /end FUNCTION
/begin FUNCTION detect_change18 "" /begin SUB_FUNCTION FixPt_Relational_Operator Delay_Input1 /end SUB_FUNCTION /begin DEF_CHARACTERISTIC /end DEF_CHARACTERISTIC /begin IN_MEASUREMENT /end IN_MEASUREMENT /begin OUT_MEASUREMENT /end OUT_MEASUREMENT /end FUNCTION
/begin FUNCTION detect_change19 "" /begin SUB_FUNCTION FixPt_Relational_Operator Delay_Input1 /end SUB_FUNCTION /begin DEF_CHARACTERISTIC /end DEF_CHARACTERISTIC /begin IN_MEASUREMENT /end IN_MEASUREMENT /begin OUT_MEASUREMENT /end OUT_MEASUREMENT /end FUNCTION
/begin FUNCTION detect_change2 "" /begin SUB_FUNCTION FixPt_Relational_Operator Delay_Input1 /end SUB_FUNCTION /begin DEF_CHARACTERISTIC /end DEF_CHARACTERISTIC /begin IN_MEASUREMENT /end IN_MEASUREMENT /begin OUT_MEASUREMENT /end OUT_MEASUREMENT /end FUNCTION
/begin FUNCTION detect_change20 "" /begin SUB_FUNCTION FixPt_Relational_Operator Delay_Input1 /end SUB_FUNCTION /begin DEF_CHARACTERISTIC /end DEF_CHARACTERISTIC /begin IN_MEASUREMENT /end IN_MEASUREMENT /begin OUT_MEASUREMENT /end OUT_MEASUREMENT /end FUNCTION
/begin FUNCTION detect_change23 "" /begin SUB_FUNCTION FixPt_Relational_Operator Delay_Input1 /end SUB_FUNCTION /begin DEF_CHARACTERISTIC /end DEF_CHARACTERISTIC /begin IN_MEASUREMENT /end IN_MEASUREMENT /begin OUT_MEASUREMENT /end OUT_MEASUREMENT /end FUNCTION
/begin FUNCTION detect_change24 "" /begin SUB_FUNCTION FixPt_Relational_Operator Delay_Input1 /end SUB_FUNCTION /begin DEF_CHARACTERISTIC /end DEF_CHARACTERISTIC /begin IN_MEASUREMENT /end IN_MEASUREMENT /begin OUT_MEASUREMENT /end OUT_MEASUREMENT /end FUNCTION
/begin FUNCTION detect_change25 "" /begin SUB_FUNCTION FixPt_Relational_Operator Delay_Input1 /end SUB_FUNCTION /begin DEF_CHARACTERISTIC /end DEF_CHARACTERISTIC /begin IN_MEASUREMENT /end IN_MEASUREMENT /begin OUT_MEASUREMENT /end OUT_MEASUREMENT /end FUNCTION
/begin FUNCTION detect_change26 "" /begin SUB_FUNCTION FixPt_Relational_Operator Delay_Input1 /end SUB_FUNCTION /begin DEF_CHARACTERISTIC /end DEF_CHARACTERISTIC /begin IN_MEASUREMENT /end IN_MEASUREMENT /begin OUT_MEASUREMENT /end OUT_MEASUREMENT /end FUNCTION
/begin FUNCTION detect_change27 "" /begin SUB_FUNCTION FixPt_Relational_Operator Delay_Input1 /end SUB_FUNCTION /begin DEF_CHARACTERISTIC /end DEF_CHARACTERISTIC /begin IN_MEASUREMENT /end IN_MEASUREMENT /begin OUT_MEASUREMENT /end OUT_MEASUREMENT /end FUNCTION
/begin FUNCTION detect_change28 "" /begin SUB_FUNCTION FixPt_Relational_Operator Delay_Input1 /end SUB_FUNCTION /begin DEF_CHARACTERISTIC /end DEF_CHARACTERISTIC /begin IN_MEASUREMENT /end IN_MEASUREMENT /begin OUT_MEASUREMENT /end OUT_MEASUREMENT /end FUNCTION
/begin FUNCTION detect_change29 "" /begin SUB_FUNCTION FixPt_Relational_Operator Delay_Input1 /end SUB_FUNCTION /begin DEF_CHARACTERISTIC /end DEF_CHARACTERISTIC /begin IN_MEASUREMENT /end IN_MEASUREMENT /begin OUT_MEASUREMENT /end OUT_MEASUREMENT /end FUNCTION
/begin FUNCTION detect_change3 "" /begin SUB_FUNCTION FixPt_Relational_Operator Delay_Input1 /end SUB_FUNCTION /begin DEF_CHARACTERISTIC /end DEF_CHARACTERISTIC /begin IN_MEASUREMENT /end IN_MEASUREMENT /begin OUT_MEASUREMENT /end OUT_MEASUREMENT /end FUNCTION
/begin FUNCTION detect_change30 "" /begin SUB_FUNCTION FixPt_Relational_Operator Delay_Input1 /end SUB_FUNCTION /begin DEF_CHARACTERISTIC /end DEF_CHARACTERISTIC /begin IN_MEASUREMENT /end IN_MEASUREMENT /begin OUT_MEASUREMENT /end OUT_MEASUREMENT /end FUNCTION
/begin FUNCTION detect_change31 "" /begin SUB_FUNCTION FixPt_Relational_Operator Delay_Input1 /end SUB_FUNCTION /begin DEF_CHARACTERISTIC /end DEF_CHARACTERISTIC /begin IN_MEASUREMENT /end IN_MEASUREMENT /begin OUT_MEASUREMENT /end OUT_MEASUREMENT /end FUNCTION
/begin FUNCTION detect_change32 "" /begin SUB_FUNCTION FixPt_Relational_Operator Delay_Input1 /end SUB_FUNCTION /begin DEF_CHARACTERISTIC /end DEF_CHARACTERISTIC /begin IN_MEASUREMENT /end IN_MEASUREMENT /begin OUT_MEASUREMENT /end OUT_MEASUREMENT /end FUNCTION
/begin FUNCTION detect_change33 "" /begin SUB_FUNCTION FixPt_Relational_Operator Delay_Input1 /end SUB_FUNCTION /begin DEF_CHARACTERISTIC /end DEF_CHARACTERISTIC /begin IN_MEASUREMENT /end IN_MEASUREMENT /begin OUT_MEASUREMENT /end OUT_MEASUREMENT /end FUNCTION
/begin FUNCTION detect_change34 "" /begin SUB_FUNCTION FixPt_Relational_Operator Delay_Input1 /end SUB_FUNCTION /begin DEF_CHARACTERISTIC /end DEF_CHARACTERISTIC /begin IN_MEASUREMENT /end IN_MEASUREMENT /begin OUT_MEASUREMENT /end OUT_MEASUREMENT /end FUNCTION
/begin FUNCTION detect_change35 "" /begin SUB_FUNCTION FixPt_Relational_Operator Delay_Input1 /end SUB_FUNCTION /begin DEF_CHARACTERISTIC /end DEF_CHARACTERISTIC /begin IN_MEASUREMENT /end IN_MEASUREMENT /begin OUT_MEASUREMENT /end OUT_MEASUREMENT /end FUNCTION
/begin FUNCTION detect_change36 "" /begin SUB_FUNCTION FixPt_Relational_Operator Delay_Input1 /end SUB_FUNCTION /begin DEF_CHARACTERISTIC /end DEF_CHARACTERISTIC /begin IN_MEASUREMENT /end IN_MEASUREMENT /begin OUT_MEASUREMENT /end OUT_MEASUREMENT /end FUNCTION
/begin FUNCTION detect_change37 "" /begin SUB_FUNCTION FixPt_Relational_Operator Delay_Input1 /end SUB_FUNCTION /begin DEF_CHARACTERISTIC /end DEF_CHARACTERISTIC /begin IN_MEASUREMENT /end IN_MEASUREMENT /begin OUT_MEASUREMENT /end OUT_MEASUREMENT /end FUNCTION
/begin FUNCTION detect_change38 "" /begin SUB_FUNCTION FixPt_Relational_Operator Delay_Input1 /end SUB_FUNCTION /begin DEF_CHARACTERISTIC /end DEF_CHARACTERISTIC /begin IN_MEASUREMENT /end IN_MEASUREMENT /begin OUT_MEASUREMENT /end OUT_MEASUREMENT /end FUNCTION
/begin FUNCTION detect_change39 "" /begin SUB_FUNCTION FixPt_Relational_Operator Delay_Input1 /end SUB_FUNCTION /begin DEF_CHARACTERISTIC /end DEF_CHARACTERISTIC /begin IN_MEASUREMENT /end IN_MEASUREMENT /begin OUT_MEASUREMENT /end OUT_MEASUREMENT /end FUNCTION
/begin FUNCTION detect_change4 "" /begin SUB_FUNCTION FixPt_Relational_Operator Delay_Input1 /end SUB_FUNCTION /begin DEF_CHARACTERISTIC /end DEF_CHARACTERISTIC /begin IN_MEASUREMENT /end IN_MEASUREMENT /begin OUT_MEASUREMENT /end OUT_MEASUREMENT /end FUNCTION
/begin FUNCTION detect_change40 "" /begin SUB_FUNCTION FixPt_Relational_Operator Delay_Input1 /end SUB_FUNCTION /begin DEF_CHARACTERISTIC /end DEF_CHARACTERISTIC /begin IN_MEASUREMENT /end IN_MEASUREMENT /begin OUT_MEASUREMENT /end OUT_MEASUREMENT /end FUNCTION
/begin FUNCTION detect_change41 "" /begin SUB_FUNCTION FixPt_Relational_Operator Delay_Input1 /end SUB_FUNCTION /begin DEF_CHARACTERISTIC /end DEF_CHARACTERISTIC /begin IN_MEASUREMENT /end IN_MEASUREMENT /begin OUT_MEASUREMENT /end OUT_MEASUREMENT /end FUNCTION
/begin FUNCTION detect_change42 "" /begin SUB_FUNCTION FixPt_Relational_Operator Delay_Input1 /end SUB_FUNCTION /begin DEF_CHARACTERISTIC /end DEF_CHARACTERISTIC /begin IN_MEASUREMENT /end IN_MEASUREMENT /begin OUT_MEASUREMENT /end OUT_MEASUREMENT /end FUNCTION
/begin FUNCTION detect_change43 "" /begin SUB_FUNCTION FixPt_Relational_Operator Delay_Input1 /end SUB_FUNCTION /begin DEF_CHARACTERISTIC /end DEF_CHARACTERISTIC /begin IN_MEASUREMENT /end IN_MEASUREMENT /begin OUT_MEASUREMENT /end OUT_MEASUREMENT /end FUNCTION
/begin FUNCTION detect_change44 "" /begin SUB_FUNCTION FixPt_Relational_Operator Delay_Input1 /end SUB_FUNCTION /begin DEF_CHARACTERISTIC /end DEF_CHARACTERISTIC /begin IN_MEASUREMENT /end IN_MEASUREMENT /begin OUT_MEASUREMENT /end OUT_MEASUREMENT /end FUNCTION
/begin FUNCTION detect_change45 "" /begin SUB_FUNCTION FixPt_Relational_Operator Delay_Input1 /end SUB_FUNCTION /begin DEF_CHARACTERISTIC /end DEF_CHARACTERISTIC /begin IN_MEASUREMENT /end IN_MEASUREMENT /begin OUT_MEASUREMENT /end OUT_MEASUREMENT /end FUNCTION
/begin FUNCTION detect_change46 "" /begin SUB_FUNCTION FixPt_Relational_Operator Delay_Input1 /end SUB_FUNCTION /begin DEF_CHARACTERISTIC /end DEF_CHARACTERISTIC /begin IN_MEASUREMENT /end IN_MEASUREMENT /begin OUT_MEASUREMENT /end OUT_MEASUREMENT /end FUNCTION
/begin FUNCTION detect_change47 "" /begin SUB_FUNCTION FixPt_Relational_Operator Delay_Input1 /end SUB_FUNCTION /begin DEF_CHARACTERISTIC /end DEF_CHARACTERISTIC /begin IN_MEASUREMENT /end IN_MEASUREMENT /begin OUT_MEASUREMENT /end OUT_MEASUREMENT /end FUNCTION
/begin FUNCTION detect_change48 "" /begin SUB_FUNCTION FixPt_Relational_Operator Delay_Input1 /end SUB_FUNCTION /begin DEF_CHARACTERISTIC /end DEF_CHARACTERISTIC /begin IN_MEASUREMENT /end IN_MEASUREMENT /begin OUT_MEASUREMENT /end OUT_MEASUREMENT /end FUNCTION
/begin FUNCTION detect_change49 "" /begin SUB_FUNCTION FixPt_Relational_Operator Delay_Input1 /end SUB_FUNCTION /begin DEF_CHARACTERISTIC /end DEF_CHARACTERISTIC /begin IN_MEASUREMENT /end IN_MEASUREMENT /begin OUT_MEASUREMENT /end OUT_MEASUREMENT /end FUNCTION
/begin FUNCTION detect_change5 "" /begin SUB_FUNCTION FixPt_Relational_Operator Delay_Input1 /end SUB_FUNCTION /begin DEF_CHARACTERISTIC /end DEF_CHARACTERISTIC /begin IN_MEASUREMENT /end IN_MEASUREMENT /begin OUT_MEASUREMENT /end OUT_MEASUREMENT /end FUNCTION
/begin FUNCTION detect_change50 "" /begin SUB_FUNCTION FixPt_Relational_Operator Delay_Input1 /end SUB_FUNCTION /begin DEF_CHARACTERISTIC /end DEF_CHARACTERISTIC /begin IN_MEASUREMENT /end IN_MEASUREMENT /begin OUT_MEASUREMENT /end OUT_MEASUREMENT /end FUNCTION
/begin FUNCTION detect_change51 "" /begin SUB_FUNCTION FixPt_Relational_Operator Delay_Input1 /end SUB_FUNCTION /begin DEF_CHARACTERISTIC /end DEF_CHARACTERISTIC /begin IN_MEASUREMENT /end IN_MEASUREMENT /begin OUT_MEASUREMENT /end OUT_MEASUREMENT /end FUNCTION
/begin FUNCTION detect_change52 "" /begin SUB_FUNCTION FixPt_Relational_Operator Delay_Input1 /end SUB_FUNCTION /begin DEF_CHARACTERISTIC /end DEF_CHARACTERISTIC /begin IN_MEASUREMENT /end IN_MEASUREMENT /begin OUT_MEASUREMENT /end OUT_MEASUREMENT /end FUNCTION
/begin FUNCTION detect_change53 "" /begin SUB_FUNCTION FixPt_Relational_Operator Delay_Input1 /end SUB_FUNCTION /begin DEF_CHARACTERISTIC /end DEF_CHARACTERISTIC /begin IN_MEASUREMENT /end IN_MEASUREMENT /begin OUT_MEASUREMENT /end OUT_MEASUREMENT /end FUNCTION
/begin FUNCTION detect_change54 "" /begin SUB_FUNCTION FixPt_Relational_Operator Delay_Input1 /end SUB_FUNCTION /begin DEF_CHARACTERISTIC /end DEF_CHARACTERISTIC /begin IN_MEASUREMENT /end IN_MEASUREMENT /begin OUT_MEASUREMENT /end OUT_MEASUREMENT /end FUNCTION
/begin FUNCTION detect_change55 "" /begin SUB_FUNCTION FixPt_Relational_Operator Delay_Input1 /end SUB_FUNCTION /begin DEF_CHARACTERISTIC /end DEF_CHARACTERISTIC /begin IN_MEASUREMENT /end IN_MEASUREMENT /begin OUT_MEASUREMENT /end OUT_MEASUREMENT /end FUNCTION
/begin FUNCTION detect_change56 "" /begin SUB_FUNCTION FixPt_Relational_Operator Delay_Input1 /end SUB_FUNCTION /begin DEF_CHARACTERISTIC /end DEF_CHARACTERISTIC /begin IN_MEASUREMENT /end IN_MEASUREMENT /begin OUT_MEASUREMENT /end OUT_MEASUREMENT /end FUNCTION
/begin FUNCTION detect_change57 "" /begin SUB_FUNCTION FixPt_Relational_Operator Delay_Input1 /end SUB_FUNCTION /begin DEF_CHARACTERISTIC /end DEF_CHARACTERISTIC /begin IN_MEASUREMENT /end IN_MEASUREMENT /begin OUT_MEASUREMENT /end OUT_MEASUREMENT /end FUNCTION
/begin FUNCTION detect_change6 "" /begin SUB_FUNCTION FixPt_Relational_Operator Delay_Input1 /end SUB_FUNCTION /begin DEF_CHARACTERISTIC /end DEF_CHARACTERISTIC /begin IN_MEASUREMENT /end IN_MEASUREMENT /begin OUT_MEASUREMENT /end OUT_MEASUREMENT /end FUNCTION
/begin FUNCTION detect_change7 "" /begin SUB_FUNCTION FixPt_Relational_Operator Delay_Input1 /end SUB_FUNCTION /begin DEF_CHARACTERISTIC /end DEF_CHARACTERISTIC /begin IN_MEASUREMENT /end IN_MEASUREMENT /begin OUT_MEASUREMENT /end OUT_MEASUREMENT /end FUNCTION
/begin FUNCTION detect_change8 "" /begin SUB_FUNCTION FixPt_Relational_Operator Delay_Input1 /end SUB_FUNCTION /begin DEF_CHARACTERISTIC /end DEF_CHARACTERISTIC /begin IN_MEASUREMENT /end IN_MEASUREMENT /begin OUT_MEASUREMENT /end OUT_MEASUREMENT /end FUNCTION
/begin FUNCTION detect_change9 "" /begin SUB_FUNCTION FixPt_Relational_Operator Delay_Input1 /end SUB_FUNCTION /begin DEF_CHARACTERISTIC /end DEF_CHARACTERISTIC /begin IN_MEASUREMENT /end IN_MEASUREMENT /begin OUT_MEASUREMENT /end OUT_MEASUREMENT /end FUNCTION
/begin FUNCTION Chart "" /begin DEF_CHARACTERISTIC /end DEF_CHARACTERISTIC /begin IN_MEASUREMENT /end IN_MEASUREMENT /begin OUT_MEASUREMENT /end OUT_MEASUREMENT /end FUNCTION
/begin FUNCTION Constant "" /begin DEF_CHARACTERISTIC /end DEF_CHARACTERISTIC /begin IN_MEASUREMENT /end IN_MEASUREMENT /begin OUT_MEASUREMENT /end OUT_MEASUREMENT /end FUNCTION
/begin FUNCTION Constant3 "" /begin DEF_CHARACTERISTIC /end DEF_CHARACTERISTIC /begin IN_MEASUREMENT /end IN_MEASUREMENT /begin OUT_MEASUREMENT /end OUT_MEASUREMENT /end FUNCTION
/begin FUNCTION Data_Type_Conversion "" /begin DEF_CHARACTERISTIC /end DEF_CHARACTERISTIC /begin IN_MEASUREMENT /end IN_MEASUREMENT /begin OUT_MEASUREMENT /end OUT_MEASUREMENT /end FUNCTION
/begin FUNCTION Data_Type_Conversion1 "" /begin DEF_CHARACTERISTIC /end DEF_CHARACTERISTIC /begin IN_MEASUREMENT /end IN_MEASUREMENT /begin OUT_MEASUREMENT /end OUT_MEASUREMENT /end FUNCTION
/begin FUNCTION Gain "" /begin DEF_CHARACTERISTIC /end DEF_CHARACTERISTIC /begin IN_MEASUREMENT /end IN_MEASUREMENT /begin OUT_MEASUREMENT /end OUT_MEASUREMENT /end FUNCTION
/begin FUNCTION OR "" /begin DEF_CHARACTERISTIC /end DEF_CHARACTERISTIC /begin IN_MEASUREMENT /end IN_MEASUREMENT /begin OUT_MEASUREMENT /end OUT_MEASUREMENT /end FUNCTION
/begin FUNCTION Divide "" /begin DEF_CHARACTERISTIC /end DEF_CHARACTERISTIC /begin IN_MEASUREMENT /end IN_MEASUREMENT /begin OUT_MEASUREMENT /end OUT_MEASUREMENT /end FUNCTION
/begin FUNCTION ACSubMode "" /begin SUB_FUNCTION /end SUB_FUNCTION /begin DEF_CHARACTERISTIC /end DEF_CHARACTERISTIC /begin IN_MEASUREMENT /end IN_MEASUREMENT /begin OUT_MEASUREMENT /end OUT_MEASUREMENT /end FUNCTION
/begin FUNCTION APTCActFrRiPwr "" /begin SUB_FUNCTION convert_out Data_Type_Conversion /end SUB_FUNCTION /begin DEF_CHARACTERISTIC /end DEF_CHARACTERISTIC /begin IN_MEASUREMENT /end IN_MEASUREMENT /begin OUT_MEASUREMENT /end OUT_MEASUREMENT /end FUNCTION
/begin FUNCTION BatLoopActWtFlw "" /begin SUB_FUNCTION convert_out Data_Type_Conversion /end SUB_FUNCTION /begin DEF_CHARACTERISTIC /end DEF_CHARACTERISTIC /begin IN_MEASUREMENT /end IN_MEASUREMENT /begin OUT_MEASUREMENT /end OUT_MEASUREMENT /end FUNCTION
/begin FUNCTION BatteryMode "" /begin SUB_FUNCTION /end SUB_FUNCTION /begin DEF_CHARACTERISTIC /end DEF_CHARACTERISTIC /begin IN_MEASUREMENT /end IN_MEASUREMENT /begin OUT_MEASUREMENT /end OUT_MEASUREMENT /end FUNCTION
/begin FUNCTION CCUACLampSts "" /begin SUB_FUNCTION Data_Type_Conversion /end SUB_FUNCTION /begin DEF_CHARACTERISTIC /end DEF_CHARACTERISTIC /begin IN_MEASUREMENT /end IN_MEASUREMENT /begin OUT_MEASUREMENT /end OUT_MEASUREMENT /end FUNCTION
/begin FUNCTION CCUACMaxLampSts "" /begin SUB_FUNCTION Data_Type_Conversion /end SUB_FUNCTION /begin DEF_CHARACTERISTIC /end DEF_CHARACTERISTIC /begin IN_MEASUREMENT /end IN_MEASUREMENT /begin OUT_MEASUREMENT /end OUT_MEASUREMENT /end FUNCTION
/begin FUNCTION CCUAutoLampSts "" /begin SUB_FUNCTION Data_Type_Conversion /end SUB_FUNCTION /begin DEF_CHARACTERISTIC /end DEF_CHARACTERISTIC /begin IN_MEASUREMENT /end IN_MEASUREMENT /begin OUT_MEASUREMENT /end OUT_MEASUREMENT /end FUNCTION
/begin FUNCTION CCUAutoMidLampSts "" /begin SUB_FUNCTION /end SUB_FUNCTION /begin DEF_CHARACTERISTIC /end DEF_CHARACTERISTIC /begin IN_MEASUREMENT /end IN_MEASUREMENT /begin OUT_MEASUREMENT /end OUT_MEASUREMENT /end FUNCTION
/begin FUNCTION CCUCbnPreACWkSts "" /begin SUB_FUNCTION /end SUB_FUNCTION /begin DEF_CHARACTERISTIC /end DEF_CHARACTERISTIC /begin IN_MEASUREMENT /end IN_MEASUREMENT /begin OUT_MEASUREMENT /end OUT_MEASUREMENT /end FUNCTION
/begin FUNCTION CCUCbnPreEstimdTi "" /begin SUB_FUNCTION /end SUB_FUNCTION /begin DEF_CHARACTERISTIC /end DEF_CHARACTERISTIC /begin IN_MEASUREMENT /end IN_MEASUREMENT /begin OUT_MEASUREMENT /end OUT_MEASUREMENT /end FUNCTION
/begin FUNCTION CCUCbnPreSts "" /begin SUB_FUNCTION /end SUB_FUNCTION /begin DEF_CHARACTERISTIC /end DEF_CHARACTERISTIC /begin IN_MEASUREMENT /end IN_MEASUREMENT /begin OUT_MEASUREMENT /end OUT_MEASUREMENT /end FUNCTION
/begin FUNCTION CCUDispalyRequest "" /begin SUB_FUNCTION /end SUB_FUNCTION /begin DEF_CHARACTERISTIC /end DEF_CHARACTERISTIC /begin IN_MEASUREMENT /end IN_MEASUREMENT /begin OUT_MEASUREMENT /end OUT_MEASUREMENT /end FUNCTION
/begin FUNCTION CCUEcoSts "" /begin SUB_FUNCTION /end SUB_FUNCTION /begin DEF_CHARACTERISTIC /end DEF_CHARACTERISTIC /begin IN_MEASUREMENT /end IN_MEASUREMENT /begin OUT_MEASUREMENT /end OUT_MEASUREMENT /end FUNCTION
/begin FUNCTION CCUFrtOnOffLampSts "" /begin SUB_FUNCTION /end SUB_FUNCTION /begin DEF_CHARACTERISTIC /end DEF_CHARACTERISTIC /begin IN_MEASUREMENT /end IN_MEASUREMENT /begin OUT_MEASUREMENT /end OUT_MEASUREMENT /end FUNCTION
/begin FUNCTION CCUHEATMaxLampSts "" /begin SUB_FUNCTION /end SUB_FUNCTION /begin DEF_CHARACTERISTIC /end DEF_CHARACTERISTIC /begin IN_MEASUREMENT /end IN_MEASUREMENT /begin OUT_MEASUREMENT /end OUT_MEASUREMENT /end FUNCTION
/begin FUNCTION CCUHiVoltageReq "" /begin SUB_FUNCTION /end SUB_FUNCTION /begin DEF_CHARACTERISTIC /end DEF_CHARACTERISTIC /begin IN_MEASUREMENT /end IN_MEASUREMENT /begin OUT_MEASUREMENT /end OUT_MEASUREMENT /end FUNCTION
/begin FUNCTION CCURrOnOffLampSts "" /begin SUB_FUNCTION /end SUB_FUNCTION /begin DEF_CHARACTERISTIC /end DEF_CHARACTERISTIC /begin IN_MEASUREMENT /end IN_MEASUREMENT /begin OUT_MEASUREMENT /end OUT_MEASUREMENT /end FUNCTION
/begin FUNCTION CCUSyncLampSts "" /begin SUB_FUNCTION Data_Type_Conversion /end SUB_FUNCTION /begin DEF_CHARACTERISTIC /end DEF_CHARACTERISTIC /begin IN_MEASUREMENT /end IN_MEASUREMENT /begin OUT_MEASUREMENT /end OUT_MEASUREMENT /end FUNCTION
/begin FUNCTION CabinMode "" /begin SUB_FUNCTION /end SUB_FUNCTION /begin DEF_CHARACTERISTIC /end DEF_CHARACTERISTIC /begin IN_MEASUREMENT /end IN_MEASUREMENT /begin OUT_MEASUREMENT /end OUT_MEASUREMENT /end FUNCTION
/begin FUNCTION CoolgFanActDuty "" /begin SUB_FUNCTION convert_out Data_Type_Conversion /end SUB_FUNCTION /begin DEF_CHARACTERISTIC /end DEF_CHARACTERISTIC /begin IN_MEASUREMENT /end IN_MEASUREMENT /begin OUT_MEASUREMENT /end OUT_MEASUREMENT /end FUNCTION
/begin FUNCTION DeiceModReq "" /begin SUB_FUNCTION /end SUB_FUNCTION /begin DEF_CHARACTERISTIC /end DEF_CHARACTERISTIC /begin IN_MEASUREMENT /end IN_MEASUREMENT /begin OUT_MEASUREMENT /end OUT_MEASUREMENT /end FUNCTION
/begin FUNCTION EDriveMode "" /begin SUB_FUNCTION /end SUB_FUNCTION /begin DEF_CHARACTERISTIC /end DEF_CHARACTERISTIC /begin IN_MEASUREMENT /end IN_MEASUREMENT /begin OUT_MEASUREMENT /end OUT_MEASUREMENT /end FUNCTION
/begin FUNCTION FDAGSCmd "" /begin SUB_FUNCTION /end SUB_FUNCTION /begin DEF_CHARACTERISTIC /end DEF_CHARACTERISTIC /begin IN_MEASUREMENT /end IN_MEASUREMENT /begin OUT_MEASUREMENT /end OUT_MEASUREMENT /end FUNCTION
/begin FUNCTION FDBlowerCmd "" /begin SUB_FUNCTION convert_out Data_Type_Conversion /end SUB_FUNCTION /begin DEF_CHARACTERISTIC /end DEF_CHARACTERISTIC /begin IN_MEASUREMENT /end IN_MEASUREMENT /begin OUT_MEASUREMENT /end OUT_MEASUREMENT /end FUNCTION
/begin FUNCTION FDCTHCMCLEVentYSta "" /begin SUB_FUNCTION /end SUB_FUNCTION /begin DEF_CHARACTERISTIC /end DEF_CHARACTERISTIC /begin IN_MEASUREMENT /end IN_MEASUREMENT /begin OUT_MEASUREMENT /end OUT_MEASUREMENT /end FUNCTION
/begin FUNCTION FDCTHCMCLEVentZSta "" /begin SUB_FUNCTION /end SUB_FUNCTION /begin DEF_CHARACTERISTIC /end DEF_CHARACTERISTIC /begin IN_MEASUREMENT /end IN_MEASUREMENT /begin OUT_MEASUREMENT /end OUT_MEASUREMENT /end FUNCTION
/begin FUNCTION FDCTHCMCLVentSta "" /begin SUB_FUNCTION Data_Type_Conversion /end SUB_FUNCTION /begin DEF_CHARACTERISTIC /end DEF_CHARACTERISTIC /begin IN_MEASUREMENT /end IN_MEASUREMENT /begin OUT_MEASUREMENT /end OUT_MEASUREMENT /end FUNCTION
/begin FUNCTION FDCTHCMCREVentYSta "" /begin SUB_FUNCTION /end SUB_FUNCTION /begin DEF_CHARACTERISTIC /end DEF_CHARACTERISTIC /begin IN_MEASUREMENT /end IN_MEASUREMENT /begin OUT_MEASUREMENT /end OUT_MEASUREMENT /end FUNCTION
/begin FUNCTION FDCTHCMCREVentZSta "" /begin SUB_FUNCTION /end SUB_FUNCTION /begin DEF_CHARACTERISTIC /end DEF_CHARACTERISTIC /begin IN_MEASUREMENT /end IN_MEASUREMENT /begin OUT_MEASUREMENT /end OUT_MEASUREMENT /end FUNCTION
/begin FUNCTION FDCTHCMCRVentSta "" /begin SUB_FUNCTION Data_Type_Conversion /end SUB_FUNCTION /begin DEF_CHARACTERISTIC /end DEF_CHARACTERISTIC /begin IN_MEASUREMENT /end IN_MEASUREMENT /begin OUT_MEASUREMENT /end OUT_MEASUREMENT /end FUNCTION
/begin FUNCTION FDCTHCMLEVentModeSta "" /begin SUB_FUNCTION /end SUB_FUNCTION /begin DEF_CHARACTERISTIC /end DEF_CHARACTERISTIC /begin IN_MEASUREMENT /end IN_MEASUREMENT /begin OUT_MEASUREMENT /end OUT_MEASUREMENT /end FUNCTION
/begin FUNCTION FDCTHCMLEVentYSta "" /begin SUB_FUNCTION /end SUB_FUNCTION /begin DEF_CHARACTERISTIC /end DEF_CHARACTERISTIC /begin IN_MEASUREMENT /end IN_MEASUREMENT /begin OUT_MEASUREMENT /end OUT_MEASUREMENT /end FUNCTION
/begin FUNCTION FDCTHCMLEVentZSta "" /begin SUB_FUNCTION /end SUB_FUNCTION /begin DEF_CHARACTERISTIC /end DEF_CHARACTERISTIC /begin IN_MEASUREMENT /end IN_MEASUREMENT /begin OUT_MEASUREMENT /end OUT_MEASUREMENT /end FUNCTION
/begin FUNCTION FDCTHCMLVentSta "" /begin SUB_FUNCTION Data_Type_Conversion /end SUB_FUNCTION /begin DEF_CHARACTERISTIC /end DEF_CHARACTERISTIC /begin IN_MEASUREMENT /end IN_MEASUREMENT /begin OUT_MEASUREMENT /end OUT_MEASUREMENT /end FUNCTION
/begin FUNCTION FDCTHCMREVentModeSta "" /begin SUB_FUNCTION /end SUB_FUNCTION /begin DEF_CHARACTERISTIC /end DEF_CHARACTERISTIC /begin IN_MEASUREMENT /end IN_MEASUREMENT /begin OUT_MEASUREMENT /end OUT_MEASUREMENT /end FUNCTION
/begin FUNCTION FDCTHCMREVentYSta "" /begin SUB_FUNCTION /end SUB_FUNCTION /begin DEF_CHARACTERISTIC /end DEF_CHARACTERISTIC /begin IN_MEASUREMENT /end IN_MEASUREMENT /begin OUT_MEASUREMENT /end OUT_MEASUREMENT /end FUNCTION
/begin FUNCTION FDCTHCMREVentZSta "" /begin SUB_FUNCTION /end SUB_FUNCTION /begin DEF_CHARACTERISTIC /end DEF_CHARACTERISTIC /begin IN_MEASUREMENT /end IN_MEASUREMENT /begin OUT_MEASUREMENT /end OUT_MEASUREMENT /end FUNCTION
/begin FUNCTION FDCTHCMRVentSta "" /begin SUB_FUNCTION Data_Type_Conversion /end SUB_FUNCTION /begin DEF_CHARACTERISTIC /end DEF_CHARACTERISTIC /begin IN_MEASUREMENT /end IN_MEASUREMENT /begin OUT_MEASUREMENT /end OUT_MEASUREMENT /end FUNCTION
/begin FUNCTION FDCompCmd "" /begin SUB_FUNCTION convert_out Data_Type_Conversion /end SUB_FUNCTION /begin DEF_CHARACTERISTIC /end DEF_CHARACTERISTIC /begin IN_MEASUREMENT /end IN_MEASUREMENT /begin OUT_MEASUREMENT /end OUT_MEASUREMENT /end FUNCTION
/begin FUNCTION FDEWP1Cmd "" /begin SUB_FUNCTION /end SUB_FUNCTION /begin DEF_CHARACTERISTIC /end DEF_CHARACTERISTIC /begin IN_MEASUREMENT /end IN_MEASUREMENT /begin OUT_MEASUREMENT /end OUT_MEASUREMENT /end FUNCTION
/begin FUNCTION FDEWP2Cmd "" /begin SUB_FUNCTION /end SUB_FUNCTION /begin DEF_CHARACTERISTIC /end DEF_CHARACTERISTIC /begin IN_MEASUREMENT /end IN_MEASUREMENT /begin OUT_MEASUREMENT /end OUT_MEASUREMENT /end FUNCTION
/begin FUNCTION FDEWP3Cmd "" /begin SUB_FUNCTION /end SUB_FUNCTION /begin DEF_CHARACTERISTIC /end DEF_CHARACTERISTIC /begin IN_MEASUREMENT /end IN_MEASUREMENT /begin OUT_MEASUREMENT /end OUT_MEASUREMENT /end FUNCTION
/begin FUNCTION FDEXV1Cmd "" /begin SUB_FUNCTION /end SUB_FUNCTION /begin DEF_CHARACTERISTIC /end DEF_CHARACTERISTIC /begin IN_MEASUREMENT /end IN_MEASUREMENT /begin OUT_MEASUREMENT /end OUT_MEASUREMENT /end FUNCTION
/begin FUNCTION FDEXV2Cmd "" /begin SUB_FUNCTION /end SUB_FUNCTION /begin DEF_CHARACTERISTIC /end DEF_CHARACTERISTIC /begin IN_MEASUREMENT /end IN_MEASUREMENT /begin OUT_MEASUREMENT /end OUT_MEASUREMENT /end FUNCTION
/begin FUNCTION FDFWVCmd "" /begin SUB_FUNCTION Data_Type_Conversion /end SUB_FUNCTION /begin DEF_CHARACTERISTIC /end DEF_CHARACTERISTIC /begin IN_MEASUREMENT /end IN_MEASUREMENT /begin OUT_MEASUREMENT /end OUT_MEASUREMENT /end FUNCTION
/begin FUNCTION FDFrLeAPTCHeatPwrCmd "" /begin SUB_FUNCTION convert_out Data_Type_Conversion /end SUB_FUNCTION /begin DEF_CHARACTERISTIC /end DEF_CHARACTERISTIC /begin IN_MEASUREMENT /end IN_MEASUREMENT /begin OUT_MEASUREMENT /end OUT_MEASUREMENT /end FUNCTION
/begin FUNCTION FDFrRiAPTCHeatPwrCmd "" /begin SUB_FUNCTION convert_out Data_Type_Conversion /end SUB_FUNCTION /begin DEF_CHARACTERISTIC /end DEF_CHARACTERISTIC /begin IN_MEASUREMENT /end IN_MEASUREMENT /begin OUT_MEASUREMENT /end OUT_MEASUREMENT /end FUNCTION
/begin FUNCTION FDFrWPTCHeatPwrCmd "" /begin SUB_FUNCTION Data_Type_Conversion /end SUB_FUNCTION /begin DEF_CHARACTERISTIC /end DEF_CHARACTERISTIC /begin IN_MEASUREMENT /end IN_MEASUREMENT /begin OUT_MEASUREMENT /end OUT_MEASUREMENT /end FUNCTION
/begin FUNCTION FDRecyAutoCmd "" /begin SUB_FUNCTION /end SUB_FUNCTION /begin DEF_CHARACTERISTIC /end DEF_CHARACTERISTIC /begin IN_MEASUREMENT /end IN_MEASUREMENT /begin OUT_MEASUREMENT /end OUT_MEASUREMENT /end FUNCTION
/begin FUNCTION FDRrAPTCHeatPwrCmd "" /begin SUB_FUNCTION convert_out Data_Type_Conversion /end SUB_FUNCTION /begin DEF_CHARACTERISTIC /end DEF_CHARACTERISTIC /begin IN_MEASUREMENT /end IN_MEASUREMENT /begin OUT_MEASUREMENT /end OUT_MEASUREMENT /end FUNCTION
/begin FUNCTION FDSOTXVCmd "" /begin SUB_FUNCTION Data_Type_Conversion /end SUB_FUNCTION /begin DEF_CHARACTERISTIC /end DEF_CHARACTERISTIC /begin IN_MEASUREMENT /end IN_MEASUREMENT /begin OUT_MEASUREMENT /end OUT_MEASUREMENT /end FUNCTION
/begin FUNCTION FDSOV1Cmd "" /begin SUB_FUNCTION Data_Type_Conversion /end SUB_FUNCTION /begin DEF_CHARACTERISTIC /end DEF_CHARACTERISTIC /begin IN_MEASUREMENT /end IN_MEASUREMENT /begin OUT_MEASUREMENT /end OUT_MEASUREMENT /end FUNCTION
/begin FUNCTION FDSOV2Cmd "" /begin SUB_FUNCTION Data_Type_Conversion /end SUB_FUNCTION /begin DEF_CHARACTERISTIC /end DEF_CHARACTERISTIC /begin IN_MEASUREMENT /end IN_MEASUREMENT /begin OUT_MEASUREMENT /end OUT_MEASUREMENT /end FUNCTION
/begin FUNCTION FDSOV3Cmd "" /begin SUB_FUNCTION Data_Type_Conversion /end SUB_FUNCTION /begin DEF_CHARACTERISTIC /end DEF_CHARACTERISTIC /begin IN_MEASUREMENT /end IN_MEASUREMENT /begin OUT_MEASUREMENT /end OUT_MEASUREMENT /end FUNCTION
/begin FUNCTION FDTWVCmd "" /begin SUB_FUNCTION convert_out Data_Type_Conversion /end SUB_FUNCTION /begin DEF_CHARACTERISTIC /end DEF_CHARACTERISTIC /begin IN_MEASUREMENT /end IN_MEASUREMENT /begin OUT_MEASUREMENT /end OUT_MEASUREMENT /end FUNCTION
/begin FUNCTION FrCoolantflow "" /begin SUB_FUNCTION convert_out Data_Type_Conversion /end SUB_FUNCTION /begin DEF_CHARACTERISTIC /end DEF_CHARACTERISTIC /begin IN_MEASUREMENT /end IN_MEASUREMENT /begin OUT_MEASUREMENT /end OUT_MEASUREMENT /end FUNCTION
/begin FUNCTION FrCoolanttemp "" /begin SUB_FUNCTION convert_out Data_Type_Conversion /end SUB_FUNCTION /begin DEF_CHARACTERISTIC /end DEF_CHARACTERISTIC /begin IN_MEASUREMENT /end IN_MEASUREMENT /begin OUT_MEASUREMENT /end OUT_MEASUREMENT /end FUNCTION
/begin FUNCTION HPThermalRecoveryReq "" /begin SUB_FUNCTION /end SUB_FUNCTION /begin DEF_CHARACTERISTIC /end DEF_CHARACTERISTIC /begin IN_MEASUREMENT /end IN_MEASUREMENT /begin OUT_MEASUREMENT /end OUT_MEASUREMENT /end FUNCTION
/begin FUNCTION RrCoolantflow "" /begin SUB_FUNCTION convert_out Data_Type_Conversion /end SUB_FUNCTION /begin DEF_CHARACTERISTIC /end DEF_CHARACTERISTIC /begin IN_MEASUREMENT /end IN_MEASUREMENT /begin OUT_MEASUREMENT /end OUT_MEASUREMENT /end FUNCTION
/begin FUNCTION RrCoolanttemp "" /begin SUB_FUNCTION convert_out Data_Type_Conversion /end SUB_FUNCTION /begin DEF_CHARACTERISTIC /end DEF_CHARACTERISTIC /begin IN_MEASUREMENT /end IN_MEASUREMENT /begin OUT_MEASUREMENT /end OUT_MEASUREMENT /end FUNCTION
/begin FUNCTION sigAirIntenZon1St "" /begin SUB_FUNCTION /end SUB_FUNCTION /begin DEF_CHARACTERISTIC /end DEF_CHARACTERISTIC /begin IN_MEASUREMENT /end IN_MEASUREMENT /begin OUT_MEASUREMENT /end OUT_MEASUREMENT /end FUNCTION
/begin FUNCTION sigAirIntenZon3St "" /begin SUB_FUNCTION /end SUB_FUNCTION /begin DEF_CHARACTERISTIC /end DEF_CHARACTERISTIC /begin IN_MEASUREMENT /end IN_MEASUREMENT /begin OUT_MEASUREMENT /end OUT_MEASUREMENT /end FUNCTION
/begin FUNCTION sigAmbAirT "" /begin SUB_FUNCTION convert_out Data_Type_Conversion /end SUB_FUNCTION /begin DEF_CHARACTERISTIC /end DEF_CHARACTERISTIC /begin IN_MEASUREMENT /end IN_MEASUREMENT /begin OUT_MEASUREMENT /end OUT_MEASUREMENT /end FUNCTION
/begin FUNCTION sigCbnAirT "" /begin SUB_FUNCTION convert_out Data_Type_Conversion /end SUB_FUNCTION /begin DEF_CHARACTERISTIC /end DEF_CHARACTERISTIC /begin IN_MEASUREMENT /end IN_MEASUREMENT /begin OUT_MEASUREMENT /end OUT_MEASUREMENT /end FUNCTION
/begin FUNCTION sigCbnPTCPwrAct "" /begin SUB_FUNCTION convert_out Data_Type_Conversion /end SUB_FUNCTION /begin DEF_CHARACTERISTIC /end DEF_CHARACTERISTIC /begin IN_MEASUREMENT /end IN_MEASUREMENT /begin OUT_MEASUREMENT /end OUT_MEASUREMENT /end FUNCTION
/begin FUNCTION sigCbnSolarLeft "" /begin SUB_FUNCTION convert_out Data_Type_Conversion /end SUB_FUNCTION /begin DEF_CHARACTERISTIC /end DEF_CHARACTERISTIC /begin IN_MEASUREMENT /end IN_MEASUREMENT /begin OUT_MEASUREMENT /end OUT_MEASUREMENT /end FUNCTION
/begin FUNCTION sigCbnSolarRight "" /begin SUB_FUNCTION convert_out Data_Type_Conversion /end SUB_FUNCTION /begin DEF_CHARACTERISTIC /end DEF_CHARACTERISTIC /begin IN_MEASUREMENT /end IN_MEASUREMENT /begin OUT_MEASUREMENT /end OUT_MEASUREMENT /end FUNCTION
/begin FUNCTION sigClmtCmprPwrAct "" /begin SUB_FUNCTION convert_out Data_Type_Conversion /end SUB_FUNCTION /begin DEF_CHARACTERISTIC /end DEF_CHARACTERISTIC /begin IN_MEASUREMENT /end IN_MEASUREMENT /begin OUT_MEASUREMENT /end OUT_MEASUREMENT /end FUNCTION
/begin FUNCTION sigClntTHvBattOut "" /begin SUB_FUNCTION convert_out Data_Type_Conversion /end SUB_FUNCTION /begin DEF_CHARACTERISTIC /end DEF_CHARACTERISTIC /begin IN_MEASUREMENT /end IN_MEASUREMENT /begin OUT_MEASUREMENT /end OUT_MEASUREMENT /end FUNCTION
/begin FUNCTION sigDfrstSt "" /begin SUB_FUNCTION Data_Type_Conversion /end SUB_FUNCTION /begin DEF_CHARACTERISTIC /end DEF_CHARACTERISTIC /begin IN_MEASUREMENT /end IN_MEASUREMENT /begin OUT_MEASUREMENT /end OUT_MEASUREMENT /end FUNCTION
/begin FUNCTION sigHvacSt "" /begin SUB_FUNCTION /end SUB_FUNCTION /begin DEF_CHARACTERISTIC /end DEF_CHARACTERISTIC /begin IN_MEASUREMENT /end IN_MEASUREMENT /begin OUT_MEASUREMENT /end OUT_MEASUREMENT /end FUNCTION
/begin FUNCTION sigRecircSt "" /begin SUB_FUNCTION Data_Type_Conversion /end SUB_FUNCTION /begin DEF_CHARACTERISTIC /end DEF_CHARACTERISTIC /begin IN_MEASUREMENT /end IN_MEASUREMENT /begin OUT_MEASUREMENT /end OUT_MEASUREMENT /end FUNCTION
/begin FUNCTION sigSetTempZon1St "" /begin SUB_FUNCTION convert_out Data_Type_Conversion /end SUB_FUNCTION /begin DEF_CHARACTERISTIC /end DEF_CHARACTERISTIC /begin IN_MEASUREMENT /end IN_MEASUREMENT /begin OUT_MEASUREMENT /end OUT_MEASUREMENT /end FUNCTION
/begin FUNCTION sigSetTempZon2St "" /begin SUB_FUNCTION convert_out Data_Type_Conversion /end SUB_FUNCTION /begin DEF_CHARACTERISTIC /end DEF_CHARACTERISTIC /begin IN_MEASUREMENT /end IN_MEASUREMENT /begin OUT_MEASUREMENT /end OUT_MEASUREMENT /end FUNCTION
/begin FUNCTION sigSetTempZon3St "" /begin SUB_FUNCTION convert_out Data_Type_Conversion /end SUB_FUNCTION /begin DEF_CHARACTERISTIC /end DEF_CHARACTERISTIC /begin IN_MEASUREMENT /end IN_MEASUREMENT /begin OUT_MEASUREMENT /end OUT_MEASUREMENT /end FUNCTION
/begin FUNCTION sigWindDirZon1St "" /begin SUB_FUNCTION /end SUB_FUNCTION /begin DEF_CHARACTERISTIC /end DEF_CHARACTERISTIC /begin IN_MEASUREMENT /end IN_MEASUREMENT /begin OUT_MEASUREMENT /end OUT_MEASUREMENT /end FUNCTION
/begin FUNCTION sigWindDirZon3St "" /begin SUB_FUNCTION /end SUB_FUNCTION /begin DEF_CHARACTERISTIC /end DEF_CHARACTERISTIC /begin IN_MEASUREMENT /end IN_MEASUREMENT /begin OUT_MEASUREMENT /end OUT_MEASUREMENT /end FUNCTION
/begin FUNCTION bus_creator "" /begin DEF_CHARACTERISTIC /end DEF_CHARACTERISTIC /begin IN_MEASUREMENT /end IN_MEASUREMENT /begin OUT_MEASUREMENT /end OUT_MEASUREMENT /end FUNCTION
/begin FUNCTION AmbLightBreath1 "" /begin SUB_FUNCTION /end SUB_FUNCTION /begin DEF_CHARACTERISTIC /end DEF_CHARACTERISTIC /begin IN_MEASUREMENT /end IN_MEASUREMENT /begin OUT_MEASUREMENT /end OUT_MEASUREMENT /end FUNCTION
/begin FUNCTION AmbLightBreath2 "" /begin SUB_FUNCTION /end SUB_FUNCTION /begin DEF_CHARACTERISTIC /end DEF_CHARACTERISTIC /begin IN_MEASUREMENT /end IN_MEASUREMENT /begin OUT_MEASUREMENT /end OUT_MEASUREMENT /end FUNCTION
/begin FUNCTION AmbLightBreath3 "" /begin SUB_FUNCTION /end SUB_FUNCTION /begin DEF_CHARACTERISTIC /end DEF_CHARACTERISTIC /begin IN_MEASUREMENT /end IN_MEASUREMENT /begin OUT_MEASUREMENT /end OUT_MEASUREMENT /end FUNCTION
/begin FUNCTION AmbLightBreath4 "" /begin SUB_FUNCTION /end SUB_FUNCTION /begin DEF_CHARACTERISTIC /end DEF_CHARACTERISTIC /begin IN_MEASUREMENT /end IN_MEASUREMENT /begin OUT_MEASUREMENT /end OUT_MEASUREMENT /end FUNCTION
/begin FUNCTION AmbLightBreath5 "" /begin SUB_FUNCTION /end SUB_FUNCTION /begin DEF_CHARACTERISTIC /end DEF_CHARACTERISTIC /begin IN_MEASUREMENT /end IN_MEASUREMENT /begin OUT_MEASUREMENT /end OUT_MEASUREMENT /end FUNCTION
/begin FUNCTION AmbLightBreath6 "" /begin SUB_FUNCTION /end SUB_FUNCTION /begin DEF_CHARACTERISTIC /end DEF_CHARACTERISTIC /begin IN_MEASUREMENT /end IN_MEASUREMENT /begin OUT_MEASUREMENT /end OUT_MEASUREMENT /end FUNCTION
/begin FUNCTION AmbLightBrightness1 "" /begin SUB_FUNCTION /end SUB_FUNCTION /begin DEF_CHARACTERISTIC /end DEF_CHARACTERISTIC /begin IN_MEASUREMENT /end IN_MEASUREMENT /begin OUT_MEASUREMENT /end OUT_MEASUREMENT /end FUNCTION
/begin FUNCTION AmbLightBrightness2 "" /begin SUB_FUNCTION /end SUB_FUNCTION /begin DEF_CHARACTERISTIC /end DEF_CHARACTERISTIC /begin IN_MEASUREMENT /end IN_MEASUREMENT /begin OUT_MEASUREMENT /end OUT_MEASUREMENT /end FUNCTION
/begin FUNCTION AmbLightBrightness3 "" /begin SUB_FUNCTION /end SUB_FUNCTION /begin DEF_CHARACTERISTIC /end DEF_CHARACTERISTIC /begin IN_MEASUREMENT /end IN_MEASUREMENT /begin OUT_MEASUREMENT /end OUT_MEASUREMENT /end FUNCTION
/begin FUNCTION AmbLightBrightness4 "" /begin SUB_FUNCTION /end SUB_FUNCTION /begin DEF_CHARACTERISTIC /end DEF_CHARACTERISTIC /begin IN_MEASUREMENT /end IN_MEASUREMENT /begin OUT_MEASUREMENT /end OUT_MEASUREMENT /end FUNCTION
/begin FUNCTION AmbLightBrightness5 "" /begin SUB_FUNCTION /end SUB_FUNCTION /begin DEF_CHARACTERISTIC /end DEF_CHARACTERISTIC /begin IN_MEASUREMENT /end IN_MEASUREMENT /begin OUT_MEASUREMENT /end OUT_MEASUREMENT /end FUNCTION
/begin FUNCTION AmbLightBrightness6 "" /begin SUB_FUNCTION /end SUB_FUNCTION /begin DEF_CHARACTERISTIC /end DEF_CHARACTERISTIC /begin IN_MEASUREMENT /end IN_MEASUREMENT /begin OUT_MEASUREMENT /end OUT_MEASUREMENT /end FUNCTION
/begin FUNCTION AmbLightColor1 "" /begin SUB_FUNCTION /end SUB_FUNCTION /begin DEF_CHARACTERISTIC /end DEF_CHARACTERISTIC /begin IN_MEASUREMENT /end IN_MEASUREMENT /begin OUT_MEASUREMENT /end OUT_MEASUREMENT /end FUNCTION
/begin FUNCTION AmbLightColor2 "" /begin SUB_FUNCTION /end SUB_FUNCTION /begin DEF_CHARACTERISTIC /end DEF_CHARACTERISTIC /begin IN_MEASUREMENT /end IN_MEASUREMENT /begin OUT_MEASUREMENT /end OUT_MEASUREMENT /end FUNCTION
/begin FUNCTION AmbLightColor3 "" /begin SUB_FUNCTION /end SUB_FUNCTION /begin DEF_CHARACTERISTIC /end DEF_CHARACTERISTIC /begin IN_MEASUREMENT /end IN_MEASUREMENT /begin OUT_MEASUREMENT /end OUT_MEASUREMENT /end FUNCTION
/begin FUNCTION AmbLightColor4 "" /begin SUB_FUNCTION /end SUB_FUNCTION /begin DEF_CHARACTERISTIC /end DEF_CHARACTERISTIC /begin IN_MEASUREMENT /end IN_MEASUREMENT /begin OUT_MEASUREMENT /end OUT_MEASUREMENT /end FUNCTION
/begin FUNCTION AmbLightColor5 "" /begin SUB_FUNCTION /end SUB_FUNCTION /begin DEF_CHARACTERISTIC /end DEF_CHARACTERISTIC /begin IN_MEASUREMENT /end IN_MEASUREMENT /begin OUT_MEASUREMENT /end OUT_MEASUREMENT /end FUNCTION
/begin FUNCTION AmbLightColor6 "" /begin SUB_FUNCTION /end SUB_FUNCTION /begin DEF_CHARACTERISTIC /end DEF_CHARACTERISTIC /begin IN_MEASUREMENT /end IN_MEASUREMENT /begin OUT_MEASUREMENT /end OUT_MEASUREMENT /end FUNCTION
/begin FUNCTION BCMBuzzerReq "" /begin SUB_FUNCTION Data_Type_Conversion /end SUB_FUNCTION /begin DEF_CHARACTERISTIC /end DEF_CHARACTERISTIC /begin IN_MEASUREMENT /end IN_MEASUREMENT /begin OUT_MEASUREMENT /end OUT_MEASUREMENT /end FUNCTION
/begin FUNCTION FDCBCMATCtrlCmd "" /begin SUB_FUNCTION /end SUB_FUNCTION /begin DEF_CHARACTERISTIC /end DEF_CHARACTERISTIC /begin IN_MEASUREMENT /end IN_MEASUREMENT /begin OUT_MEASUREMENT /end OUT_MEASUREMENT /end FUNCTION
/begin FUNCTION FDCBCMDSEATentryfsetSta "" /begin SUB_FUNCTION /end SUB_FUNCTION /begin DEF_CHARACTERISTIC /end DEF_CHARACTERISTIC /begin IN_MEASUREMENT /end IN_MEASUREMENT /begin OUT_MEASUREMENT /end OUT_MEASUREMENT /end FUNCTION
/begin FUNCTION FDCBCMDimSw "" /begin SUB_FUNCTION Data_Type_Conversion /end SUB_FUNCTION /begin DEF_CHARACTERISTIC /end DEF_CHARACTERISTIC /begin IN_MEASUREMENT /end IN_MEASUREMENT /begin OUT_MEASUREMENT /end OUT_MEASUREMENT /end FUNCTION
/begin FUNCTION FDCBCMDrHandleLampCmd "" /begin SUB_FUNCTION Data_Type_Conversion /end SUB_FUNCTION /begin DEF_CHARACTERISTIC /end DEF_CHARACTERISTIC /begin IN_MEASUREMENT /end IN_MEASUREMENT /begin OUT_MEASUREMENT /end OUT_MEASUREMENT /end FUNCTION
/begin FUNCTION FDCBCMDrRWdwReqAPSta "" /begin SUB_FUNCTION /end SUB_FUNCTION /begin DEF_CHARACTERISTIC /end DEF_CHARACTERISTIC /begin IN_MEASUREMENT /end IN_MEASUREMENT /begin OUT_MEASUREMENT /end OUT_MEASUREMENT /end FUNCTION
/begin FUNCTION FDCBCMDrvWdwReqAPSta "" /begin SUB_FUNCTION /end SUB_FUNCTION /begin DEF_CHARACTERISTIC /end DEF_CHARACTERISTIC /begin IN_MEASUREMENT /end IN_MEASUREMENT /begin OUT_MEASUREMENT /end OUT_MEASUREMENT /end FUNCTION
/begin FUNCTION FDCBCMFWasSwSta "" /begin SUB_FUNCTION /end SUB_FUNCTION /begin DEF_CHARACTERISTIC /end DEF_CHARACTERISTIC /begin IN_MEASUREMENT /end IN_MEASUREMENT /begin OUT_MEASUREMENT /end OUT_MEASUREMENT /end FUNCTION
/begin FUNCTION FDCBCMFWipSwSta "" /begin SUB_FUNCTION /end SUB_FUNCTION /begin DEF_CHARACTERISTIC /end DEF_CHARACTERISTIC /begin IN_MEASUREMENT /end IN_MEASUREMENT /begin OUT_MEASUREMENT /end OUT_MEASUREMENT /end FUNCTION
/begin FUNCTION FDCBCMHBeamADBCmd "" /begin SUB_FUNCTION /end SUB_FUNCTION /begin DEF_CHARACTERISTIC /end DEF_CHARACTERISTIC /begin IN_MEASUREMENT /end IN_MEASUREMENT /begin OUT_MEASUREMENT /end OUT_MEASUREMENT /end FUNCTION
/begin FUNCTION FDCBCMHandleControlCmd "" /begin SUB_FUNCTION /end SUB_FUNCTION /begin DEF_CHARACTERISTIC /end DEF_CHARACTERISTIC /begin IN_MEASUREMENT /end IN_MEASUREMENT /begin OUT_MEASUREMENT /end OUT_MEASUREMENT /end FUNCTION
/begin FUNCTION FDCBCMHazardINDCmd "" /begin SUB_FUNCTION Data_Type_Conversion /end SUB_FUNCTION /begin DEF_CHARACTERISTIC /end DEF_CHARACTERISTIC /begin IN_MEASUREMENT /end IN_MEASUREMENT /begin OUT_MEASUREMENT /end OUT_MEASUREMENT /end FUNCTION
/begin FUNCTION FDCBCMHoodRelCmd "" /begin SUB_FUNCTION Data_Type_Conversion /end SUB_FUNCTION /begin DEF_CHARACTERISTIC /end DEF_CHARACTERISTIC /begin IN_MEASUREMENT /end IN_MEASUREMENT /begin OUT_MEASUREMENT /end OUT_MEASUREMENT /end FUNCTION
/begin FUNCTION FDCBCMLPSDCtrlCmd "" /begin SUB_FUNCTION /end SUB_FUNCTION /begin DEF_CHARACTERISTIC /end DEF_CHARACTERISTIC /begin IN_MEASUREMENT /end IN_MEASUREMENT /begin OUT_MEASUREMENT /end OUT_MEASUREMENT /end FUNCTION
/begin FUNCTION FDCBCMLockAlarmCmd "" /begin SUB_FUNCTION /end SUB_FUNCTION /begin DEF_CHARACTERISTIC /end DEF_CHARACTERISTIC /begin IN_MEASUREMENT /end IN_MEASUREMENT /begin OUT_MEASUREMENT /end OUT_MEASUREMENT /end FUNCTION
/begin FUNCTION FDCBCMOtHandleLampCmd "" /begin SUB_FUNCTION Data_Type_Conversion /end SUB_FUNCTION /begin DEF_CHARACTERISTIC /end DEF_CHARACTERISTIC /begin IN_MEASUREMENT /end IN_MEASUREMENT /begin OUT_MEASUREMENT /end OUT_MEASUREMENT /end FUNCTION
/begin FUNCTION FDCBCMOutModeCmd "" /begin SUB_FUNCTION /end SUB_FUNCTION /begin DEF_CHARACTERISTIC /end DEF_CHARACTERISTIC /begin IN_MEASUREMENT /end IN_MEASUREMENT /begin OUT_MEASUREMENT /end OUT_MEASUREMENT /end FUNCTION
/begin FUNCTION FDCBCMPTGOpenHeightSta "" /begin SUB_FUNCTION /end SUB_FUNCTION /begin DEF_CHARACTERISTIC /end DEF_CHARACTERISTIC /begin IN_MEASUREMENT /end IN_MEASUREMENT /begin OUT_MEASUREMENT /end OUT_MEASUREMENT /end FUNCTION
/begin FUNCTION FDCBCMPasWdwReqAPSta "" /begin SUB_FUNCTION /end SUB_FUNCTION /begin DEF_CHARACTERISTIC /end DEF_CHARACTERISTIC /begin IN_MEASUREMENT /end IN_MEASUREMENT /begin OUT_MEASUREMENT /end OUT_MEASUREMENT /end FUNCTION
/begin FUNCTION FDCBCMPassSWSta "" /begin SUB_FUNCTION Data_Type_Conversion /end SUB_FUNCTION /begin DEF_CHARACTERISTIC /end DEF_CHARACTERISTIC /begin IN_MEASUREMENT /end IN_MEASUREMENT /begin OUT_MEASUREMENT /end OUT_MEASUREMENT /end FUNCTION
/begin FUNCTION FDCBCMPsRWdwReqAPSta "" /begin SUB_FUNCTION /end SUB_FUNCTION /begin DEF_CHARACTERISTIC /end DEF_CHARACTERISTIC /begin IN_MEASUREMENT /end IN_MEASUREMENT /begin OUT_MEASUREMENT /end OUT_MEASUREMENT /end FUNCTION
/begin FUNCTION FDCBCMRPSDCtrlCmd "" /begin SUB_FUNCTION /end SUB_FUNCTION /begin DEF_CHARACTERISTIC /end DEF_CHARACTERISTIC /begin IN_MEASUREMENT /end IN_MEASUREMENT /begin OUT_MEASUREMENT /end OUT_MEASUREMENT /end FUNCTION
/begin FUNCTION FDCBCMSettingUpdateReqCmd "" /begin SUB_FUNCTION /end SUB_FUNCTION /begin DEF_CHARACTERISTIC /end DEF_CHARACTERISTIC /begin IN_MEASUREMENT /end IN_MEASUREMENT /begin OUT_MEASUREMENT /end OUT_MEASUREMENT /end FUNCTION
/begin FUNCTION FDCBCMTurnSwSta "" /begin SUB_FUNCTION /end SUB_FUNCTION /begin DEF_CHARACTERISTIC /end DEF_CHARACTERISTIC /begin IN_MEASUREMENT /end IN_MEASUREMENT /begin OUT_MEASUREMENT /end OUT_MEASUREMENT /end FUNCTION
/begin FUNCTION FDCBCMTurnSwTSetStaSta "" /begin SUB_FUNCTION /end SUB_FUNCTION /begin DEF_CHARACTERISTIC /end DEF_CHARACTERISTIC /begin IN_MEASUREMENT /end IN_MEASUREMENT /begin OUT_MEASUREMENT /end OUT_MEASUREMENT /end FUNCTION
/begin FUNCTION FDCBCMUserHeightSetSta "" /begin SUB_FUNCTION /end SUB_FUNCTION /begin DEF_CHARACTERISTIC /end DEF_CHARACTERISTIC /begin IN_MEASUREMENT /end IN_MEASUREMENT /begin OUT_MEASUREMENT /end OUT_MEASUREMENT /end FUNCTION
/begin FUNCTION FDCBCMUserNowSta "" /begin SUB_FUNCTION /end SUB_FUNCTION /begin DEF_CHARACTERISTIC /end DEF_CHARACTERISTIC /begin IN_MEASUREMENT /end IN_MEASUREMENT /begin OUT_MEASUREMENT /end OUT_MEASUREMENT /end FUNCTION
/begin FUNCTION FDCDKCCommandToBCMCmd "" /begin SUB_FUNCTION /end SUB_FUNCTION /begin DEF_CHARACTERISTIC /end DEF_CHARACTERISTIC /begin IN_MEASUREMENT /end IN_MEASUREMENT /begin OUT_MEASUREMENT /end OUT_MEASUREMENT /end FUNCTION
/begin FUNCTION FDCDKCDKeyAreaPESta "" /begin SUB_FUNCTION /end SUB_FUNCTION /begin DEF_CHARACTERISTIC /end DEF_CHARACTERISTIC /begin IN_MEASUREMENT /end IN_MEASUREMENT /begin OUT_MEASUREMENT /end OUT_MEASUREMENT /end FUNCTION
/begin FUNCTION FDCDKCSPTGDetCmd "" /begin SUB_FUNCTION Data_Type_Conversion /end SUB_FUNCTION /begin DEF_CHARACTERISTIC /end DEF_CHARACTERISTIC /begin IN_MEASUREMENT /end IN_MEASUREMENT /begin OUT_MEASUREMENT /end OUT_MEASUREMENT /end FUNCTION
/begin FUNCTION FDCDKCSPTGOpenCmd "" /begin SUB_FUNCTION Data_Type_Conversion /end SUB_FUNCTION /begin DEF_CHARACTERISTIC /end DEF_CHARACTERISTIC /begin IN_MEASUREMENT /end IN_MEASUREMENT /begin OUT_MEASUREMENT /end OUT_MEASUREMENT /end FUNCTION
/begin FUNCTION FDCFGSAirIntCmd "" /begin SUB_FUNCTION /end SUB_FUNCTION /begin DEF_CHARACTERISTIC /end DEF_CHARACTERISTIC /begin IN_MEASUREMENT /end IN_MEASUREMENT /begin OUT_MEASUREMENT /end OUT_MEASUREMENT /end FUNCTION
/begin FUNCTION FDCFGSFGSChCmd "" /begin SUB_FUNCTION /end SUB_FUNCTION /begin DEF_CHARACTERISTIC /end DEF_CHARACTERISTIC /begin IN_MEASUREMENT /end IN_MEASUREMENT /begin OUT_MEASUREMENT /end OUT_MEASUREMENT /end FUNCTION
/begin FUNCTION FDCFGSFuncStaCmd "" /begin SUB_FUNCTION /end SUB_FUNCTION /begin DEF_CHARACTERISTIC /end DEF_CHARACTERISTIC /begin IN_MEASUREMENT /end IN_MEASUREMENT /begin OUT_MEASUREMENT /end OUT_MEASUREMENT /end FUNCTION
/begin FUNCTION FDCFGSIONCmd "" /begin SUB_FUNCTION Data_Type_Conversion /end SUB_FUNCTION /begin DEF_CHARACTERISTIC /end DEF_CHARACTERISTIC /begin IN_MEASUREMENT /end IN_MEASUREMENT /begin OUT_MEASUREMENT /end OUT_MEASUREMENT /end FUNCTION
/begin FUNCTION FDCTHCMACTInitialCmd "" /begin SUB_FUNCTION /end SUB_FUNCTION /begin DEF_CHARACTERISTIC /end DEF_CHARACTERISTIC /begin IN_MEASUREMENT /end IN_MEASUREMENT /begin OUT_MEASUREMENT /end OUT_MEASUREMENT /end FUNCTION
/begin FUNCTION FDCTHCMAirIntZ3Sta "" /begin SUB_FUNCTION /end SUB_FUNCTION /begin DEF_CHARACTERISTIC /end DEF_CHARACTERISTIC /begin IN_MEASUREMENT /end IN_MEASUREMENT /begin OUT_MEASUREMENT /end OUT_MEASUREMENT /end FUNCTION
/begin FUNCTION FDCV2LHVPOBklgtingCmd "" /begin SUB_FUNCTION /end SUB_FUNCTION /begin DEF_CHARACTERISTIC /end DEF_CHARACTERISTIC /begin IN_MEASUREMENT /end IN_MEASUREMENT /begin OUT_MEASUREMENT /end OUT_MEASUREMENT /end FUNCTION
/begin FUNCTION FDCV2LHVPOLEDStsCmd "" /begin SUB_FUNCTION /end SUB_FUNCTION /begin DEF_CHARACTERISTIC /end DEF_CHARACTERISTIC /begin IN_MEASUREMENT /end IN_MEASUREMENT /begin OUT_MEASUREMENT /end OUT_MEASUREMENT /end FUNCTION
/begin FUNCTION WelcomeLight "" /begin SUB_FUNCTION /end SUB_FUNCTION /begin DEF_CHARACTERISTIC /end DEF_CHARACTERISTIC /begin IN_MEASUREMENT /end IN_MEASUREMENT /begin OUT_MEASUREMENT /end OUT_MEASUREMENT /end FUNCTION
/begin FUNCTION bus_creator "" /begin DEF_CHARACTERISTIC /end DEF_CHARACTERISTIC /begin IN_MEASUREMENT /end IN_MEASUREMENT /begin OUT_MEASUREMENT /end OUT_MEASUREMENT /end FUNCTION
/begin FUNCTION TriggerCAN4VCU1_CNT "" /begin DEF_CHARACTERISTIC /end DEF_CHARACTERISTIC /begin IN_MEASUREMENT /end IN_MEASUREMENT /begin OUT_MEASUREMENT /end OUT_MEASUREMENT /end FUNCTION
/begin FUNCTION Constant "" /begin DEF_CHARACTERISTIC /end DEF_CHARACTERISTIC /begin IN_MEASUREMENT /end IN_MEASUREMENT /begin OUT_MEASUREMENT /end OUT_MEASUREMENT /end FUNCTION
/begin FUNCTION Constant1 "" /begin DEF_CHARACTERISTIC /end DEF_CHARACTERISTIC /begin IN_MEASUREMENT /end IN_MEASUREMENT /begin OUT_MEASUREMENT /end OUT_MEASUREMENT /end FUNCTION
/begin FUNCTION Constant2 "" /begin DEF_CHARACTERISTIC /end DEF_CHARACTERISTIC /begin IN_MEASUREMENT /end IN_MEASUREMENT /begin OUT_MEASUREMENT /end OUT_MEASUREMENT /end FUNCTION
/begin FUNCTION GreaterThan "" /begin DEF_CHARACTERISTIC /end DEF_CHARACTERISTIC /begin IN_MEASUREMENT /end IN_MEASUREMENT /begin OUT_MEASUREMENT /end OUT_MEASUREMENT /end FUNCTION
/begin FUNCTION Add "" /begin DEF_CHARACTERISTIC /end DEF_CHARACTERISTIC /begin IN_MEASUREMENT /end IN_MEASUREMENT /begin OUT_MEASUREMENT /end OUT_MEASUREMENT /end FUNCTION
/begin FUNCTION Switch "" /begin DEF_CHARACTERISTIC /end DEF_CHARACTERISTIC /begin IN_MEASUREMENT /end IN_MEASUREMENT /begin OUT_MEASUREMENT /end OUT_MEASUREMENT /end FUNCTION
/begin FUNCTION Unit_Delay "" /begin DEF_CHARACTERISTIC /end DEF_CHARACTERISTIC /begin IN_MEASUREMENT /end IN_MEASUREMENT /begin OUT_MEASUREMENT /end OUT_MEASUREMENT /end FUNCTION
/begin FUNCTION FDCBCMDrRWdwCtrlCmd "" /begin SUB_FUNCTION /end SUB_FUNCTION /begin DEF_CHARACTERISTIC /end DEF_CHARACTERISTIC /begin IN_MEASUREMENT /end IN_MEASUREMENT /begin OUT_MEASUREMENT /end OUT_MEASUREMENT /end FUNCTION
/begin FUNCTION FDCBCMDrvWdwCtrlCmd "" /begin SUB_FUNCTION /end SUB_FUNCTION /begin DEF_CHARACTERISTIC /end DEF_CHARACTERISTIC /begin IN_MEASUREMENT /end IN_MEASUREMENT /begin OUT_MEASUREMENT /end OUT_MEASUREMENT /end FUNCTION
/begin FUNCTION FDCBCMPasWdwCtrlCmd "" /begin SUB_FUNCTION /end SUB_FUNCTION /begin DEF_CHARACTERISTIC /end DEF_CHARACTERISTIC /begin IN_MEASUREMENT /end IN_MEASUREMENT /begin OUT_MEASUREMENT /end OUT_MEASUREMENT /end FUNCTION
/begin FUNCTION FDCBCMPsRWdwCtrlCmd "" /begin SUB_FUNCTION /end SUB_FUNCTION /begin DEF_CHARACTERISTIC /end DEF_CHARACTERISTIC /begin IN_MEASUREMENT /end IN_MEASUREMENT /begin OUT_MEASUREMENT /end OUT_MEASUREMENT /end FUNCTION
/begin FUNCTION FDCBCMSenstivityPosnCmd "" /begin SUB_FUNCTION /end SUB_FUNCTION /begin DEF_CHARACTERISTIC /end DEF_CHARACTERISTIC /begin IN_MEASUREMENT /end IN_MEASUREMENT /begin OUT_MEASUREMENT /end OUT_MEASUREMENT /end FUNCTION
/begin FUNCTION FDCPTGinnerSW2 "" /begin SUB_FUNCTION /end SUB_FUNCTION /begin DEF_CHARACTERISTIC /end DEF_CHARACTERISTIC /begin IN_MEASUREMENT /end IN_MEASUREMENT /begin OUT_MEASUREMENT /end OUT_MEASUREMENT /end FUNCTION
/begin FUNCTION bus_creator "" /begin DEF_CHARACTERISTIC /end DEF_CHARACTERISTIC /begin IN_MEASUREMENT /end IN_MEASUREMENT /begin OUT_MEASUREMENT /end OUT_MEASUREMENT /end FUNCTION
/begin FUNCTION AllDoorSW "" /begin SUB_FUNCTION Data_Type_Conversion /end SUB_FUNCTION /begin DEF_CHARACTERISTIC /end DEF_CHARACTERISTIC /begin IN_MEASUREMENT /end IN_MEASUREMENT /begin OUT_MEASUREMENT /end OUT_MEASUREMENT /end FUNCTION
/begin FUNCTION AntitheftSta "" /begin SUB_FUNCTION /end SUB_FUNCTION /begin DEF_CHARACTERISTIC /end DEF_CHARACTERISTIC /begin IN_MEASUREMENT /end IN_MEASUREMENT /begin OUT_MEASUREMENT /end OUT_MEASUREMENT /end FUNCTION
/begin FUNCTION BCMDoorLockSta "" /begin SUB_FUNCTION Data_Type_Conversion /end SUB_FUNCTION /begin DEF_CHARACTERISTIC /end DEF_CHARACTERISTIC /begin IN_MEASUREMENT /end IN_MEASUREMENT /begin OUT_MEASUREMENT /end OUT_MEASUREMENT /end FUNCTION
/begin FUNCTION CCUACLampSts "" /begin SUB_FUNCTION Data_Type_Conversion /end SUB_FUNCTION /begin DEF_CHARACTERISTIC /end DEF_CHARACTERISTIC /begin IN_MEASUREMENT /end IN_MEASUREMENT /begin OUT_MEASUREMENT /end OUT_MEASUREMENT /end FUNCTION
/begin FUNCTION CCUCbnPreACWkSts "" /begin SUB_FUNCTION /end SUB_FUNCTION /begin DEF_CHARACTERISTIC /end DEF_CHARACTERISTIC /begin IN_MEASUREMENT /end IN_MEASUREMENT /begin OUT_MEASUREMENT /end OUT_MEASUREMENT /end FUNCTION
/begin FUNCTION CCUCbnPreEstimdTi "" /begin SUB_FUNCTION /end SUB_FUNCTION /begin DEF_CHARACTERISTIC /end DEF_CHARACTERISTIC /begin IN_MEASUREMENT /end IN_MEASUREMENT /begin OUT_MEASUREMENT /end OUT_MEASUREMENT /end FUNCTION
/begin FUNCTION CCUCbnPreSts "" /begin SUB_FUNCTION /end SUB_FUNCTION /begin DEF_CHARACTERISTIC /end DEF_CHARACTERISTIC /begin IN_MEASUREMENT /end IN_MEASUREMENT /begin OUT_MEASUREMENT /end OUT_MEASUREMENT /end FUNCTION
/begin FUNCTION FDTBOXDTCDataErr "" /begin SUB_FUNCTION /end SUB_FUNCTION /begin DEF_CHARACTERISTIC /end DEF_CHARACTERISTIC /begin IN_MEASUREMENT /end IN_MEASUREMENT /begin OUT_MEASUREMENT /end OUT_MEASUREMENT /end FUNCTION
/begin FUNCTION FDTBOXDTCDataSta "" /begin SUB_FUNCTION /end SUB_FUNCTION /begin DEF_CHARACTERISTIC /end DEF_CHARACTERISTIC /begin IN_MEASUREMENT /end IN_MEASUREMENT /begin OUT_MEASUREMENT /end OUT_MEASUREMENT /end FUNCTION
/begin FUNCTION FDTBOXVehDataErr "" /begin SUB_FUNCTION /end SUB_FUNCTION /begin DEF_CHARACTERISTIC /end DEF_CHARACTERISTIC /begin IN_MEASUREMENT /end IN_MEASUREMENT /begin OUT_MEASUREMENT /end OUT_MEASUREMENT /end FUNCTION
/begin FUNCTION FDTBOXVehDataSta "" /begin SUB_FUNCTION /end SUB_FUNCTION /begin DEF_CHARACTERISTIC /end DEF_CHARACTERISTIC /begin IN_MEASUREMENT /end IN_MEASUREMENT /begin OUT_MEASUREMENT /end OUT_MEASUREMENT /end FUNCTION
/begin FUNCTION HoodSW "" /begin SUB_FUNCTION Data_Type_Conversion /end SUB_FUNCTION /begin DEF_CHARACTERISTIC /end DEF_CHARACTERISTIC /begin IN_MEASUREMENT /end IN_MEASUREMENT /begin OUT_MEASUREMENT /end OUT_MEASUREMENT /end FUNCTION
/begin FUNCTION LowSOCWarn "" /begin SUB_FUNCTION /end SUB_FUNCTION /begin DEF_CHARACTERISTIC /end DEF_CHARACTERISTIC /begin IN_MEASUREMENT /end IN_MEASUREMENT /begin OUT_MEASUREMENT /end OUT_MEASUREMENT /end FUNCTION
/begin FUNCTION PwrSta "" /begin SUB_FUNCTION /end SUB_FUNCTION /begin DEF_CHARACTERISTIC /end DEF_CHARACTERISTIC /begin IN_MEASUREMENT /end IN_MEASUREMENT /begin OUT_MEASUREMENT /end OUT_MEASUREMENT /end FUNCTION
/begin FUNCTION ReVehThdChkSta "" /begin SUB_FUNCTION /end SUB_FUNCTION /begin DEF_CHARACTERISTIC /end DEF_CHARACTERISTIC /begin IN_MEASUREMENT /end IN_MEASUREMENT /begin OUT_MEASUREMENT /end OUT_MEASUREMENT /end FUNCTION
/begin FUNCTION ShiftGearPosn "" /begin SUB_FUNCTION /end SUB_FUNCTION /begin DEF_CHARACTERISTIC /end DEF_CHARACTERISTIC /begin IN_MEASUREMENT /end IN_MEASUREMENT /begin OUT_MEASUREMENT /end OUT_MEASUREMENT /end FUNCTION
/begin FUNCTION TCountSta "" /begin SUB_FUNCTION /end SUB_FUNCTION /begin DEF_CHARACTERISTIC /end DEF_CHARACTERISTIC /begin IN_MEASUREMENT /end IN_MEASUREMENT /begin OUT_MEASUREMENT /end OUT_MEASUREMENT /end FUNCTION
/begin FUNCTION TailgateRemote "" /begin SUB_FUNCTION /end SUB_FUNCTION /begin DEF_CHARACTERISTIC /end DEF_CHARACTERISTIC /begin IN_MEASUREMENT /end IN_MEASUREMENT /begin OUT_MEASUREMENT /end OUT_MEASUREMENT /end FUNCTION
/begin FUNCTION TailgateSW "" /begin SUB_FUNCTION Data_Type_Conversion /end SUB_FUNCTION /begin DEF_CHARACTERISTIC /end DEF_CHARACTERISTIC /begin IN_MEASUREMENT /end IN_MEASUREMENT /begin OUT_MEASUREMENT /end OUT_MEASUREMENT /end FUNCTION
/begin FUNCTION VehMalfunLevel "" /begin SUB_FUNCTION /end SUB_FUNCTION /begin DEF_CHARACTERISTIC /end DEF_CHARACTERISTIC /begin IN_MEASUREMENT /end IN_MEASUREMENT /begin OUT_MEASUREMENT /end OUT_MEASUREMENT /end FUNCTION
/begin FUNCTION bus_creator "" /begin DEF_CHARACTERISTIC /end DEF_CHARACTERISTIC /begin IN_MEASUREMENT /end IN_MEASUREMENT /begin OUT_MEASUREMENT /end OUT_MEASUREMENT /end FUNCTION
/begin FUNCTION ID1ALTU "" /begin SUB_FUNCTION /end SUB_FUNCTION /begin DEF_CHARACTERISTIC /end DEF_CHARACTERISTIC /begin IN_MEASUREMENT /end IN_MEASUREMENT /begin OUT_MEASUREMENT /end OUT_MEASUREMENT /end FUNCTION
/begin FUNCTION ID1LocALTU "" /begin SUB_FUNCTION /end SUB_FUNCTION /begin DEF_CHARACTERISTIC /end DEF_CHARACTERISTIC /begin IN_MEASUREMENT /end IN_MEASUREMENT /begin OUT_MEASUREMENT /end OUT_MEASUREMENT /end FUNCTION
/begin FUNCTION ID1messageALTU "" /begin SUB_FUNCTION /end SUB_FUNCTION /begin DEF_CHARACTERISTIC /end DEF_CHARACTERISTIC /begin IN_MEASUREMENT /end IN_MEASUREMENT /begin OUT_MEASUREMENT /end OUT_MEASUREMENT /end FUNCTION
/begin FUNCTION ID2ALTU "" /begin SUB_FUNCTION /end SUB_FUNCTION /begin DEF_CHARACTERISTIC /end DEF_CHARACTERISTIC /begin IN_MEASUREMENT /end IN_MEASUREMENT /begin OUT_MEASUREMENT /end OUT_MEASUREMENT /end FUNCTION
/begin FUNCTION ID2LocALTU "" /begin SUB_FUNCTION /end SUB_FUNCTION /begin DEF_CHARACTERISTIC /end DEF_CHARACTERISTIC /begin IN_MEASUREMENT /end IN_MEASUREMENT /begin OUT_MEASUREMENT /end OUT_MEASUREMENT /end FUNCTION
/begin FUNCTION ID2messageALTU "" /begin SUB_FUNCTION /end SUB_FUNCTION /begin DEF_CHARACTERISTIC /end DEF_CHARACTERISTIC /begin IN_MEASUREMENT /end IN_MEASUREMENT /begin OUT_MEASUREMENT /end OUT_MEASUREMENT /end FUNCTION
/begin FUNCTION ID3ALTU "" /begin SUB_FUNCTION /end SUB_FUNCTION /begin DEF_CHARACTERISTIC /end DEF_CHARACTERISTIC /begin IN_MEASUREMENT /end IN_MEASUREMENT /begin OUT_MEASUREMENT /end OUT_MEASUREMENT /end FUNCTION
/begin FUNCTION ID3LocALTU "" /begin SUB_FUNCTION /end SUB_FUNCTION /begin DEF_CHARACTERISTIC /end DEF_CHARACTERISTIC /begin IN_MEASUREMENT /end IN_MEASUREMENT /begin OUT_MEASUREMENT /end OUT_MEASUREMENT /end FUNCTION
/begin FUNCTION ID3messageALTU "" /begin SUB_FUNCTION /end SUB_FUNCTION /begin DEF_CHARACTERISTIC /end DEF_CHARACTERISTIC /begin IN_MEASUREMENT /end IN_MEASUREMENT /begin OUT_MEASUREMENT /end OUT_MEASUREMENT /end FUNCTION
/begin FUNCTION ID4ALTU "" /begin SUB_FUNCTION /end SUB_FUNCTION /begin DEF_CHARACTERISTIC /end DEF_CHARACTERISTIC /begin IN_MEASUREMENT /end IN_MEASUREMENT /begin OUT_MEASUREMENT /end OUT_MEASUREMENT /end FUNCTION
/begin FUNCTION ID4LocALTU "" /begin SUB_FUNCTION /end SUB_FUNCTION /begin DEF_CHARACTERISTIC /end DEF_CHARACTERISTIC /begin IN_MEASUREMENT /end IN_MEASUREMENT /begin OUT_MEASUREMENT /end OUT_MEASUREMENT /end FUNCTION
/begin FUNCTION ID4messageALTU "" /begin SUB_FUNCTION /end SUB_FUNCTION /begin DEF_CHARACTERISTIC /end DEF_CHARACTERISTIC /begin IN_MEASUREMENT /end IN_MEASUREMENT /begin OUT_MEASUREMENT /end OUT_MEASUREMENT /end FUNCTION
/begin FUNCTION IDinALTU "" /begin SUB_FUNCTION /end SUB_FUNCTION /begin DEF_CHARACTERISTIC /end DEF_CHARACTERISTIC /begin IN_MEASUREMENT /end IN_MEASUREMENT /begin OUT_MEASUREMENT /end OUT_MEASUREMENT /end FUNCTION
/begin FUNCTION LFSensorMode "" /begin SUB_FUNCTION Data_Type_Conversion /end SUB_FUNCTION /begin DEF_CHARACTERISTIC /end DEF_CHARACTERISTIC /begin IN_MEASUREMENT /end IN_MEASUREMENT /begin OUT_MEASUREMENT /end OUT_MEASUREMENT /end FUNCTION
/begin FUNCTION LRSensorMode "" /begin SUB_FUNCTION Data_Type_Conversion /end SUB_FUNCTION /begin DEF_CHARACTERISTIC /end DEF_CHARACTERISTIC /begin IN_MEASUREMENT /end IN_MEASUREMENT /begin OUT_MEASUREMENT /end OUT_MEASUREMENT /end FUNCTION
/begin FUNCTION RFFATALTU "" /begin SUB_FUNCTION Data_Type_Conversion /end SUB_FUNCTION /begin DEF_CHARACTERISTIC /end DEF_CHARACTERISTIC /begin IN_MEASUREMENT /end IN_MEASUREMENT /begin OUT_MEASUREMENT /end OUT_MEASUREMENT /end FUNCTION
/begin FUNCTION RFSensorMode "" /begin SUB_FUNCTION Data_Type_Conversion /end SUB_FUNCTION /begin DEF_CHARACTERISTIC /end DEF_CHARACTERISTIC /begin IN_MEASUREMENT /end IN_MEASUREMENT /begin OUT_MEASUREMENT /end OUT_MEASUREMENT /end FUNCTION
/begin FUNCTION RRSensorMode "" /begin SUB_FUNCTION Data_Type_Conversion /end SUB_FUNCTION /begin DEF_CHARACTERISTIC /end DEF_CHARACTERISTIC /begin IN_MEASUREMENT /end IN_MEASUREMENT /begin OUT_MEASUREMENT /end OUT_MEASUREMENT /end FUNCTION
/begin FUNCTION S1WheelDebugALTU "" /begin SUB_FUNCTION convert_out Data_Type_Conversion /end SUB_FUNCTION /begin DEF_CHARACTERISTIC /end DEF_CHARACTERISTIC /begin IN_MEASUREMENT /end IN_MEASUREMENT /begin OUT_MEASUREMENT /end OUT_MEASUREMENT /end FUNCTION
/begin FUNCTION S2WheelDebugALTU "" /begin SUB_FUNCTION convert_out Data_Type_Conversion /end SUB_FUNCTION /begin DEF_CHARACTERISTIC /end DEF_CHARACTERISTIC /begin IN_MEASUREMENT /end IN_MEASUREMENT /begin OUT_MEASUREMENT /end OUT_MEASUREMENT /end FUNCTION
/begin FUNCTION S3WheelDebugALTU "" /begin SUB_FUNCTION convert_out Data_Type_Conversion /end SUB_FUNCTION /begin DEF_CHARACTERISTIC /end DEF_CHARACTERISTIC /begin IN_MEASUREMENT /end IN_MEASUREMENT /begin OUT_MEASUREMENT /end OUT_MEASUREMENT /end FUNCTION
/begin FUNCTION S4WheelDebugALTU "" /begin SUB_FUNCTION convert_out Data_Type_Conversion /end SUB_FUNCTION /begin DEF_CHARACTERISTIC /end DEF_CHARACTERISTIC /begin IN_MEASUREMENT /end IN_MEASUREMENT /begin OUT_MEASUREMENT /end OUT_MEASUREMENT /end FUNCTION
/begin FUNCTION bus_creator "" /begin DEF_CHARACTERISTIC /end DEF_CHARACTERISTIC /begin IN_MEASUREMENT /end IN_MEASUREMENT /begin OUT_MEASUREMENT /end OUT_MEASUREMENT /end FUNCTION
/begin FUNCTION FDCDKCA0UWBEventSta "" /begin SUB_FUNCTION /end SUB_FUNCTION /begin DEF_CHARACTERISTIC /end DEF_CHARACTERISTIC /begin IN_MEASUREMENT /end IN_MEASUREMENT /begin OUT_MEASUREMENT /end OUT_MEASUREMENT /end FUNCTION
/begin FUNCTION FDCDKCAllowSleepSta "" /begin SUB_FUNCTION Data_Type_Conversion /end SUB_FUNCTION /begin DEF_CHARACTERISTIC /end DEF_CHARACTERISTIC /begin IN_MEASUREMENT /end IN_MEASUREMENT /begin OUT_MEASUREMENT /end OUT_MEASUREMENT /end FUNCTION
/begin FUNCTION FDCDKCBLERSSISta "" /begin SUB_FUNCTION /end SUB_FUNCTION /begin DEF_CHARACTERISTIC /end DEF_CHARACTERISTIC /begin IN_MEASUREMENT /end IN_MEASUREMENT /begin OUT_MEASUREMENT /end OUT_MEASUREMENT /end FUNCTION
/begin FUNCTION FDCDKCBLEdcEventSta "" /begin SUB_FUNCTION /end SUB_FUNCTION /begin DEF_CHARACTERISTIC /end DEF_CHARACTERISTIC /begin IN_MEASUREMENT /end IN_MEASUREMENT /begin OUT_MEASUREMENT /end OUT_MEASUREMENT /end FUNCTION
/begin FUNCTION FDCDKCCalDistanceSta "" /begin SUB_FUNCTION /end SUB_FUNCTION /begin DEF_CHARACTERISTIC /end DEF_CHARACTERISTIC /begin IN_MEASUREMENT /end IN_MEASUREMENT /begin OUT_MEASUREMENT /end OUT_MEASUREMENT /end FUNCTION
/begin FUNCTION FDCDKCCommandToBCMCmd "" /begin SUB_FUNCTION /end SUB_FUNCTION /begin DEF_CHARACTERISTIC /end DEF_CHARACTERISTIC /begin IN_MEASUREMENT /end IN_MEASUREMENT /begin OUT_MEASUREMENT /end OUT_MEASUREMENT /end FUNCTION
/begin FUNCTION FDCDKCCoordinateXSta "" /begin SUB_FUNCTION convert_out Data_Type_Conversion /end SUB_FUNCTION /begin DEF_CHARACTERISTIC /end DEF_CHARACTERISTIC /begin IN_MEASUREMENT /end IN_MEASUREMENT /begin OUT_MEASUREMENT /end OUT_MEASUREMENT /end FUNCTION
/begin FUNCTION FDCDKCCoordinateYSta "" /begin SUB_FUNCTION convert_out Data_Type_Conversion /end SUB_FUNCTION /begin DEF_CHARACTERISTIC /end DEF_CHARACTERISTIC /begin IN_MEASUREMENT /end IN_MEASUREMENT /begin OUT_MEASUREMENT /end OUT_MEASUREMENT /end FUNCTION
/begin FUNCTION FDCDKCDKeyAreaPESta "" /begin SUB_FUNCTION /end SUB_FUNCTION /begin DEF_CHARACTERISTIC /end DEF_CHARACTERISTIC /begin IN_MEASUREMENT /end IN_MEASUREMENT /begin OUT_MEASUREMENT /end OUT_MEASUREMENT /end FUNCTION
/begin FUNCTION FDCDKCDKeyAreaPSSta "" /begin SUB_FUNCTION /end SUB_FUNCTION /begin DEF_CHARACTERISTIC /end DEF_CHARACTERISTIC /begin IN_MEASUREMENT /end IN_MEASUREMENT /begin OUT_MEASUREMENT /end OUT_MEASUREMENT /end FUNCTION
/begin FUNCTION FDCDKCDKeyAreaPTGSta "" /begin SUB_FUNCTION /end SUB_FUNCTION /begin DEF_CHARACTERISTIC /end DEF_CHARACTERISTIC /begin IN_MEASUREMENT /end IN_MEASUREMENT /begin OUT_MEASUREMENT /end OUT_MEASUREMENT /end FUNCTION
/begin FUNCTION FDCDKCDKeyAreaSPTGSta "" /begin SUB_FUNCTION /end SUB_FUNCTION /begin DEF_CHARACTERISTIC /end DEF_CHARACTERISTIC /begin IN_MEASUREMENT /end IN_MEASUREMENT /begin OUT_MEASUREMENT /end OUT_MEASUREMENT /end FUNCTION
/begin FUNCTION FDCDKCDKeyWelcomeSta "" /begin SUB_FUNCTION /end SUB_FUNCTION /begin DEF_CHARACTERISTIC /end DEF_CHARACTERISTIC /begin IN_MEASUREMENT /end IN_MEASUREMENT /begin OUT_MEASUREMENT /end OUT_MEASUREMENT /end FUNCTION
/begin FUNCTION FDCDKCDkeyAreaRAPSSta "" /begin SUB_FUNCTION /end SUB_FUNCTION /begin DEF_CHARACTERISTIC /end DEF_CHARACTERISTIC /begin IN_MEASUREMENT /end IN_MEASUREMENT /begin OUT_MEASUREMENT /end OUT_MEASUREMENT /end FUNCTION
/begin FUNCTION FDCDKCDkeyShowIVISta "" /begin SUB_FUNCTION /end SUB_FUNCTION /begin DEF_CHARACTERISTIC /end DEF_CHARACTERISTIC /begin IN_MEASUREMENT /end IN_MEASUREMENT /begin OUT_MEASUREMENT /end OUT_MEASUREMENT /end FUNCTION
/begin FUNCTION FDCDKCKeyMissSta "" /begin SUB_FUNCTION Data_Type_Conversion /end SUB_FUNCTION /begin DEF_CHARACTERISTIC /end DEF_CHARACTERISTIC /begin IN_MEASUREMENT /end IN_MEASUREMENT /begin OUT_MEASUREMENT /end OUT_MEASUREMENT /end FUNCTION
/begin FUNCTION FDCDKCKeyModeSta "" /begin SUB_FUNCTION /end SUB_FUNCTION /begin DEF_CHARACTERISTIC /end DEF_CHARACTERISTIC /begin IN_MEASUREMENT /end IN_MEASUREMENT /begin OUT_MEASUREMENT /end OUT_MEASUREMENT /end FUNCTION
/begin FUNCTION FDCDKCKeyNumSta "" /begin SUB_FUNCTION /end SUB_FUNCTION /begin DEF_CHARACTERISTIC /end DEF_CHARACTERISTIC /begin IN_MEASUREMENT /end IN_MEASUREMENT /begin OUT_MEASUREMENT /end OUT_MEASUREMENT /end FUNCTION
/begin FUNCTION FDCDKCKeyTypeSta "" /begin SUB_FUNCTION /end SUB_FUNCTION /begin DEF_CHARACTERISTIC /end DEF_CHARACTERISTIC /begin IN_MEASUREMENT /end IN_MEASUREMENT /begin OUT_MEASUREMENT /end OUT_MEASUREMENT /end FUNCTION
/begin FUNCTION FDCDKCOutputPCMDModuleSta "" /begin SUB_FUNCTION /end SUB_FUNCTION /begin DEF_CHARACTERISTIC /end DEF_CHARACTERISTIC /begin IN_MEASUREMENT /end IN_MEASUREMENT /begin OUT_MEASUREMENT /end OUT_MEASUREMENT /end FUNCTION
/begin FUNCTION FDCDKCParkingModeCmd "" /begin SUB_FUNCTION /end SUB_FUNCTION /begin DEF_CHARACTERISTIC /end DEF_CHARACTERISTIC /begin IN_MEASUREMENT /end IN_MEASUREMENT /begin OUT_MEASUREMENT /end OUT_MEASUREMENT /end FUNCTION
/begin FUNCTION FDCDKCReVehDataSta "" /begin SUB_FUNCTION /end SUB_FUNCTION /begin DEF_CHARACTERISTIC /end DEF_CHARACTERISTIC /begin IN_MEASUREMENT /end IN_MEASUREMENT /begin OUT_MEASUREMENT /end OUT_MEASUREMENT /end FUNCTION
/begin FUNCTION FDCDKCRemoLeftPSDCmd "" /begin SUB_FUNCTION /end SUB_FUNCTION /begin DEF_CHARACTERISTIC /end DEF_CHARACTERISTIC /begin IN_MEASUREMENT /end IN_MEASUREMENT /begin OUT_MEASUREMENT /end OUT_MEASUREMENT /end FUNCTION
/begin FUNCTION FDCDKCRemoRightPSDCmd "" /begin SUB_FUNCTION /end SUB_FUNCTION /begin DEF_CHARACTERISTIC /end DEF_CHARACTERISTIC /begin IN_MEASUREMENT /end IN_MEASUREMENT /begin OUT_MEASUREMENT /end OUT_MEASUREMENT /end FUNCTION
/begin FUNCTION FDCDKCSPTGDetCmd "" /begin SUB_FUNCTION Data_Type_Conversion /end SUB_FUNCTION /begin DEF_CHARACTERISTIC /end DEF_CHARACTERISTIC /begin IN_MEASUREMENT /end IN_MEASUREMENT /begin OUT_MEASUREMENT /end OUT_MEASUREMENT /end FUNCTION
/begin FUNCTION FDCDKCSPTGOpenCmd "" /begin SUB_FUNCTION Data_Type_Conversion /end SUB_FUNCTION /begin DEF_CHARACTERISTIC /end DEF_CHARACTERISTIC /begin IN_MEASUREMENT /end IN_MEASUREMENT /begin OUT_MEASUREMENT /end OUT_MEASUREMENT /end FUNCTION
/begin FUNCTION FDCDKCShippingModeSta "" /begin SUB_FUNCTION Data_Type_Conversion /end SUB_FUNCTION /begin DEF_CHARACTERISTIC /end DEF_CHARACTERISTIC /begin IN_MEASUREMENT /end IN_MEASUREMENT /begin OUT_MEASUREMENT /end OUT_MEASUREMENT /end FUNCTION
/begin FUNCTION FDCDKCUIDBatVoltSta "" /begin SUB_FUNCTION convert_out Data_Type_Conversion /end SUB_FUNCTION /begin DEF_CHARACTERISTIC /end DEF_CHARACTERISTIC /begin IN_MEASUREMENT /end IN_MEASUREMENT /begin OUT_MEASUREMENT /end OUT_MEASUREMENT /end FUNCTION
/begin FUNCTION FDCDKCUIDLowPowerSta "" /begin SUB_FUNCTION Data_Type_Conversion /end SUB_FUNCTION /begin DEF_CHARACTERISTIC /end DEF_CHARACTERISTIC /begin IN_MEASUREMENT /end IN_MEASUREMENT /begin OUT_MEASUREMENT /end OUT_MEASUREMENT /end FUNCTION
/begin FUNCTION FDCDKCUWB1DistanceSta "" /begin SUB_FUNCTION convert_out Data_Type_Conversion /end SUB_FUNCTION /begin DEF_CHARACTERISTIC /end DEF_CHARACTERISTIC /begin IN_MEASUREMENT /end IN_MEASUREMENT /begin OUT_MEASUREMENT /end OUT_MEASUREMENT /end FUNCTION
/begin FUNCTION FDCDKCUWB1FPPSta "" /begin SUB_FUNCTION convert_out Data_Type_Conversion /end SUB_FUNCTION /begin DEF_CHARACTERISTIC /end DEF_CHARACTERISTIC /begin IN_MEASUREMENT /end IN_MEASUREMENT /begin OUT_MEASUREMENT /end OUT_MEASUREMENT /end FUNCTION
/begin FUNCTION FDCDKCUWB1InvalidSta "" /begin SUB_FUNCTION /end SUB_FUNCTION /begin DEF_CHARACTERISTIC /end DEF_CHARACTERISTIC /begin IN_MEASUREMENT /end IN_MEASUREMENT /begin OUT_MEASUREMENT /end OUT_MEASUREMENT /end FUNCTION
/begin FUNCTION FDCDKCUWB2DistanceSta "" /begin SUB_FUNCTION convert_out Data_Type_Conversion /end SUB_FUNCTION /begin DEF_CHARACTERISTIC /end DEF_CHARACTERISTIC /begin IN_MEASUREMENT /end IN_MEASUREMENT /begin OUT_MEASUREMENT /end OUT_MEASUREMENT /end FUNCTION
/begin FUNCTION FDCDKCUWB2FPPSta "" /begin SUB_FUNCTION convert_out Data_Type_Conversion /end SUB_FUNCTION /begin DEF_CHARACTERISTIC /end DEF_CHARACTERISTIC /begin IN_MEASUREMENT /end IN_MEASUREMENT /begin OUT_MEASUREMENT /end OUT_MEASUREMENT /end FUNCTION
/begin FUNCTION FDCDKCUWB2InvalidSta "" /begin SUB_FUNCTION /end SUB_FUNCTION /begin DEF_CHARACTERISTIC /end DEF_CHARACTERISTIC /begin IN_MEASUREMENT /end IN_MEASUREMENT /begin OUT_MEASUREMENT /end OUT_MEASUREMENT /end FUNCTION
/begin FUNCTION FDCDKCUWB3DistanceSta "" /begin SUB_FUNCTION convert_out Data_Type_Conversion /end SUB_FUNCTION /begin DEF_CHARACTERISTIC /end DEF_CHARACTERISTIC /begin IN_MEASUREMENT /end IN_MEASUREMENT /begin OUT_MEASUREMENT /end OUT_MEASUREMENT /end FUNCTION
/begin FUNCTION FDCDKCUWB3FPPSta "" /begin SUB_FUNCTION convert_out Data_Type_Conversion /end SUB_FUNCTION /begin DEF_CHARACTERISTIC /end DEF_CHARACTERISTIC /begin IN_MEASUREMENT /end IN_MEASUREMENT /begin OUT_MEASUREMENT /end OUT_MEASUREMENT /end FUNCTION
/begin FUNCTION FDCDKCUWB3InvalidSta "" /begin SUB_FUNCTION /end SUB_FUNCTION /begin DEF_CHARACTERISTIC /end DEF_CHARACTERISTIC /begin IN_MEASUREMENT /end IN_MEASUREMENT /begin OUT_MEASUREMENT /end OUT_MEASUREMENT /end FUNCTION
/begin FUNCTION FDCDKCUWB4DistanceSta "" /begin SUB_FUNCTION convert_out Data_Type_Conversion /end SUB_FUNCTION /begin DEF_CHARACTERISTIC /end DEF_CHARACTERISTIC /begin IN_MEASUREMENT /end IN_MEASUREMENT /begin OUT_MEASUREMENT /end OUT_MEASUREMENT /end FUNCTION
/begin FUNCTION FDCDKCUWB4FPPSta "" /begin SUB_FUNCTION convert_out Data_Type_Conversion /end SUB_FUNCTION /begin DEF_CHARACTERISTIC /end DEF_CHARACTERISTIC /begin IN_MEASUREMENT /end IN_MEASUREMENT /begin OUT_MEASUREMENT /end OUT_MEASUREMENT /end FUNCTION
/begin FUNCTION FDCDKCUWB4InvalidSta "" /begin SUB_FUNCTION /end SUB_FUNCTION /begin DEF_CHARACTERISTIC /end DEF_CHARACTERISTIC /begin IN_MEASUREMENT /end IN_MEASUREMENT /begin OUT_MEASUREMENT /end OUT_MEASUREMENT /end FUNCTION
/begin FUNCTION FDCDKCUWB5DistanceSta "" /begin SUB_FUNCTION convert_out Data_Type_Conversion /end SUB_FUNCTION /begin DEF_CHARACTERISTIC /end DEF_CHARACTERISTIC /begin IN_MEASUREMENT /end IN_MEASUREMENT /begin OUT_MEASUREMENT /end OUT_MEASUREMENT /end FUNCTION
/begin FUNCTION FDCDKCUWB5FPPSta "" /begin SUB_FUNCTION convert_out Data_Type_Conversion /end SUB_FUNCTION /begin DEF_CHARACTERISTIC /end DEF_CHARACTERISTIC /begin IN_MEASUREMENT /end IN_MEASUREMENT /begin OUT_MEASUREMENT /end OUT_MEASUREMENT /end FUNCTION
/begin FUNCTION FDCDKCUWB5InvalidSta "" /begin SUB_FUNCTION /end SUB_FUNCTION /begin DEF_CHARACTERISTIC /end DEF_CHARACTERISTIC /begin IN_MEASUREMENT /end IN_MEASUREMENT /begin OUT_MEASUREMENT /end OUT_MEASUREMENT /end FUNCTION
/begin FUNCTION FDCDKCUWBDetAreaSta "" /begin SUB_FUNCTION /end SUB_FUNCTION /begin DEF_CHARACTERISTIC /end DEF_CHARACTERISTIC /begin IN_MEASUREMENT /end IN_MEASUREMENT /begin OUT_MEASUREMENT /end OUT_MEASUREMENT /end FUNCTION
/begin FUNCTION FDCDKCUWBDetPTGAreaSta "" /begin SUB_FUNCTION /end SUB_FUNCTION /begin DEF_CHARACTERISTIC /end DEF_CHARACTERISTIC /begin IN_MEASUREMENT /end IN_MEASUREMENT /begin OUT_MEASUREMENT /end OUT_MEASUREMENT /end FUNCTION
/begin FUNCTION FDCDKCUWBOnOffSta "" /begin SUB_FUNCTION Data_Type_Conversion /end SUB_FUNCTION /begin DEF_CHARACTERISTIC /end DEF_CHARACTERISTIC /begin IN_MEASUREMENT /end IN_MEASUREMENT /begin OUT_MEASUREMENT /end OUT_MEASUREMENT /end FUNCTION
/begin FUNCTION bus_creator "" /begin DEF_CHARACTERISTIC /end DEF_CHARACTERISTIC /begin IN_MEASUREMENT /end IN_MEASUREMENT /begin OUT_MEASUREMENT /end OUT_MEASUREMENT /end FUNCTION
/begin FUNCTION FDCVMCActReqAccCmd "" /begin SUB_FUNCTION convert_out Data_Type_Conversion /end SUB_FUNCTION /begin DEF_CHARACTERISTIC /end DEF_CHARACTERISTIC /begin IN_MEASUREMENT /end IN_MEASUREMENT /begin OUT_MEASUREMENT /end OUT_MEASUREMENT /end FUNCTION
/begin FUNCTION FDCVMCExtraMSACtrlSta "" /begin SUB_FUNCTION /end SUB_FUNCTION /begin DEF_CHARACTERISTIC /end DEF_CHARACTERISTIC /begin IN_MEASUREMENT /end IN_MEASUREMENT /begin OUT_MEASUREMENT /end OUT_MEASUREMENT /end FUNCTION
/begin FUNCTION FDCVMCIMUGxCmd "" /begin SUB_FUNCTION convert_out Data_Type_Conversion /end SUB_FUNCTION /begin DEF_CHARACTERISTIC /end DEF_CHARACTERISTIC /begin IN_MEASUREMENT /end IN_MEASUREMENT /begin OUT_MEASUREMENT /end OUT_MEASUREMENT /end FUNCTION
/begin FUNCTION FDCVMCIMUGyCmd "" /begin SUB_FUNCTION convert_out Data_Type_Conversion /end SUB_FUNCTION /begin DEF_CHARACTERISTIC /end DEF_CHARACTERISTIC /begin IN_MEASUREMENT /end IN_MEASUREMENT /begin OUT_MEASUREMENT /end OUT_MEASUREMENT /end FUNCTION
/begin FUNCTION FDCVMCIMUGzCmd "" /begin SUB_FUNCTION convert_out Data_Type_Conversion /end SUB_FUNCTION /begin DEF_CHARACTERISTIC /end DEF_CHARACTERISTIC /begin IN_MEASUREMENT /end IN_MEASUREMENT /begin OUT_MEASUREMENT /end OUT_MEASUREMENT /end FUNCTION
/begin FUNCTION FDCVMCIMUPitchRateCmd "" /begin SUB_FUNCTION convert_out Data_Type_Conversion /end SUB_FUNCTION /begin DEF_CHARACTERISTIC /end DEF_CHARACTERISTIC /begin IN_MEASUREMENT /end IN_MEASUREMENT /begin OUT_MEASUREMENT /end OUT_MEASUREMENT /end FUNCTION
/begin FUNCTION FDCVMCIMURollRateCmd "" /begin SUB_FUNCTION convert_out Data_Type_Conversion /end SUB_FUNCTION /begin DEF_CHARACTERISTIC /end DEF_CHARACTERISTIC /begin IN_MEASUREMENT /end IN_MEASUREMENT /begin OUT_MEASUREMENT /end OUT_MEASUREMENT /end FUNCTION
/begin FUNCTION FDCVMCIMUYawRateCmd "" /begin SUB_FUNCTION convert_out Data_Type_Conversion /end SUB_FUNCTION /begin DEF_CHARACTERISTIC /end DEF_CHARACTERISTIC /begin IN_MEASUREMENT /end IN_MEASUREMENT /begin OUT_MEASUREMENT /end OUT_MEASUREMENT /end FUNCTION
/begin FUNCTION FDCVMCLongAccelCmd "" /begin SUB_FUNCTION convert_out Data_Type_Conversion /end SUB_FUNCTION /begin DEF_CHARACTERISTIC /end DEF_CHARACTERISTIC /begin IN_MEASUREMENT /end IN_MEASUREMENT /begin OUT_MEASUREMENT /end OUT_MEASUREMENT /end FUNCTION
/begin FUNCTION bus_creator "" /begin DEF_CHARACTERISTIC /end DEF_CHARACTERISTIC /begin IN_MEASUREMENT /end IN_MEASUREMENT /begin OUT_MEASUREMENT /end OUT_MEASUREMENT /end FUNCTION
/begin FUNCTION FDCBCMWinLFOpenedSta "" /begin SUB_FUNCTION /end SUB_FUNCTION /begin DEF_CHARACTERISTIC /end DEF_CHARACTERISTIC /begin IN_MEASUREMENT /end IN_MEASUREMENT /begin OUT_MEASUREMENT /end OUT_MEASUREMENT /end FUNCTION
/begin FUNCTION FDCBCMWinLROpenedSta "" /begin SUB_FUNCTION /end SUB_FUNCTION /begin DEF_CHARACTERISTIC /end DEF_CHARACTERISTIC /begin IN_MEASUREMENT /end IN_MEASUREMENT /begin OUT_MEASUREMENT /end OUT_MEASUREMENT /end FUNCTION
/begin FUNCTION FDCBCMWinRFOpenedSta "" /begin SUB_FUNCTION /end SUB_FUNCTION /begin DEF_CHARACTERISTIC /end DEF_CHARACTERISTIC /begin IN_MEASUREMENT /end IN_MEASUREMENT /begin OUT_MEASUREMENT /end OUT_MEASUREMENT /end FUNCTION
/begin FUNCTION FDCBCMWinRROpenedSta "" /begin SUB_FUNCTION /end SUB_FUNCTION /begin DEF_CHARACTERISTIC /end DEF_CHARACTERISTIC /begin IN_MEASUREMENT /end IN_MEASUREMENT /begin OUT_MEASUREMENT /end OUT_MEASUREMENT /end FUNCTION
/begin FUNCTION bus_creator "" /begin DEF_CHARACTERISTIC /end DEF_CHARACTERISTIC /begin IN_MEASUREMENT /end IN_MEASUREMENT /begin OUT_MEASUREMENT /end OUT_MEASUREMENT /end FUNCTION
/begin FUNCTION FD6_APS3 "" /begin DEF_CHARACTERISTIC /end DEF_CHARACTERISTIC /begin IN_MEASUREMENT /end IN_MEASUREMENT /begin OUT_MEASUREMENT /end OUT_MEASUREMENT /end FUNCTION
/begin FUNCTION APS3LifeCount "" /begin SUB_FUNCTION /end SUB_FUNCTION /begin DEF_CHARACTERISTIC /end DEF_CHARACTERISTIC /begin IN_MEASUREMENT /end IN_MEASUREMENT /begin OUT_MEASUREMENT /end OUT_MEASUREMENT /end FUNCTION
/begin FUNCTION APS3checksum "" /begin SUB_FUNCTION /end SUB_FUNCTION /begin DEF_CHARACTERISTIC /end DEF_CHARACTERISTIC /begin IN_MEASUREMENT /end IN_MEASUREMENT /begin OUT_MEASUREMENT /end OUT_MEASUREMENT /end FUNCTION
/begin FUNCTION APSDecReq "" /begin SUB_FUNCTION convert_out Data_Type_Conversion /end SUB_FUNCTION /begin DEF_CHARACTERISTIC /end DEF_CHARACTERISTIC /begin IN_MEASUREMENT /end IN_MEASUREMENT /begin OUT_MEASUREMENT /end OUT_MEASUREMENT /end FUNCTION
/begin FUNCTION APSDecReqA "" /begin SUB_FUNCTION Data_Type_Conversion /end SUB_FUNCTION /begin DEF_CHARACTERISTIC /end DEF_CHARACTERISTIC /begin IN_MEASUREMENT /end IN_MEASUREMENT /begin OUT_MEASUREMENT /end OUT_MEASUREMENT /end FUNCTION
/begin FUNCTION APSOpenPTG "" /begin SUB_FUNCTION Data_Type_Conversion /end SUB_FUNCTION /begin DEF_CHARACTERISTIC /end DEF_CHARACTERISTIC /begin IN_MEASUREMENT /end IN_MEASUREMENT /begin OUT_MEASUREMENT /end OUT_MEASUREMENT /end FUNCTION
/begin FUNCTION APSReq "" /begin SUB_FUNCTION /end SUB_FUNCTION /begin DEF_CHARACTERISTIC /end DEF_CHARACTERISTIC /begin IN_MEASUREMENT /end IN_MEASUREMENT /begin OUT_MEASUREMENT /end OUT_MEASUREMENT /end FUNCTION
/begin FUNCTION APSStaSystem "" /begin SUB_FUNCTION /end SUB_FUNCTION /begin DEF_CHARACTERISTIC /end DEF_CHARACTERISTIC /begin IN_MEASUREMENT /end IN_MEASUREMENT /begin OUT_MEASUREMENT /end OUT_MEASUREMENT /end FUNCTION
/begin FUNCTION Byte_0 "" /begin SUB_FUNCTION SignalPack /end SUB_FUNCTION /begin DEF_CHARACTERISTIC /end DEF_CHARACTERISTIC /begin IN_MEASUREMENT /end IN_MEASUREMENT /begin OUT_MEASUREMENT /end OUT_MEASUREMENT /end FUNCTION
/begin FUNCTION Byte_1 "" /begin SUB_FUNCTION SignalPack /end SUB_FUNCTION /begin DEF_CHARACTERISTIC /end DEF_CHARACTERISTIC /begin IN_MEASUREMENT /end IN_MEASUREMENT /begin OUT_MEASUREMENT /end OUT_MEASUREMENT /end FUNCTION
/begin FUNCTION Byte_2 ""
 /begin SUB_FUNCTION SignalPack SignalPack1 SignalPack2 SignalPack3 UnitConverter1 UnitConverter3 /end SUB_FUNCTION
 /begin DEF_CHARACTERISTIC /end DEF_CHARACTERISTIC
 /begin IN_MEASUREMENT /end IN_MEASUREMENT
 /begin OUT_MEASUREMENT /end OUT_MEASUREMENT
/end FUNCTION
/begin FUNCTION Byte_3 "" /begin SUB_FUNCTION SignalPack convert_out UnitConverter1 /end SUB_FUNCTION /begin DEF_CHARACTERISTIC /end DEF_CHARACTERISTIC /begin IN_MEASUREMENT /end IN_MEASUREMENT /begin OUT_MEASUREMENT /end OUT_MEASUREMENT /end FUNCTION
/begin FUNCTION Byte_4 "" /begin SUB_FUNCTION SignalPack convert_out UnitConverter UnitConverter1 /end SUB_FUNCTION /begin DEF_CHARACTERISTIC /end DEF_CHARACTERISTIC /begin IN_MEASUREMENT /end IN_MEASUREMENT /begin OUT_MEASUREMENT /end OUT_MEASUREMENT /end FUNCTION
/begin FUNCTION Byte_5 "" /begin SUB_FUNCTION SignalPack convert_out UnitConverter UnitConverter1 /end SUB_FUNCTION /begin DEF_CHARACTERISTIC /end DEF_CHARACTERISTIC /begin IN_MEASUREMENT /end IN_MEASUREMENT /begin OUT_MEASUREMENT /end OUT_MEASUREMENT /end FUNCTION
/begin FUNCTION Byte_6 ""
 /begin SUB_FUNCTION SignalPack SignalPack1 SignalPack2 SignalPack3 UnitConverter3 UnitConverter5 /end SUB_FUNCTION
 /begin DEF_CHARACTERISTIC /end DEF_CHARACTERISTIC
 /begin IN_MEASUREMENT /end IN_MEASUREMENT
 /begin OUT_MEASUREMENT /end OUT_MEASUREMENT
/end FUNCTION
/begin FUNCTION Byte_7 "" /begin SUB_FUNCTION SignalPack UnitConverter1 /end SUB_FUNCTION /begin DEF_CHARACTERISTIC /end DEF_CHARACTERISTIC /begin IN_MEASUREMENT /end IN_MEASUREMENT /begin OUT_MEASUREMENT /end OUT_MEASUREMENT /end FUNCTION
/begin FUNCTION CAASSta "" /begin SUB_FUNCTION /end SUB_FUNCTION /begin DEF_CHARACTERISTIC /end DEF_CHARACTERISTIC /begin IN_MEASUREMENT /end IN_MEASUREMENT /begin OUT_MEASUREMENT /end OUT_MEASUREMENT /end FUNCTION
/begin FUNCTION CRC8_IfAction_Tx ""
 /begin SUB_FUNCTION If_Action_Subsystem If_Action_Subsystem1 Data_Type_Conversion If Merge /end SUB_FUNCTION
 /begin DEF_CHARACTERISTIC /end DEF_CHARACTERISTIC
 /begin IN_MEASUREMENT /end IN_MEASUREMENT
 /begin OUT_MEASUREMENT /end OUT_MEASUREMENT
/end FUNCTION
/begin FUNCTION FDCVMCAPSAngleTarget "" /begin SUB_FUNCTION convert_out Data_Type_Conversion /end SUB_FUNCTION /begin DEF_CHARACTERISTIC /end DEF_CHARACTERISTIC /begin IN_MEASUREMENT /end IN_MEASUREMENT /begin OUT_MEASUREMENT /end OUT_MEASUREMENT /end FUNCTION
/begin FUNCTION FDCVMCAPSRqEPSCtrl "" /begin SUB_FUNCTION Data_Type_Conversion /end SUB_FUNCTION /begin DEF_CHARACTERISTIC /end DEF_CHARACTERISTIC /begin IN_MEASUREMENT /end IN_MEASUREMENT /begin OUT_MEASUREMENT /end OUT_MEASUREMENT /end FUNCTION
/begin FUNCTION FDCVMCAPSVRqEPSCtrl "" /begin SUB_FUNCTION Data_Type_Conversion /end SUB_FUNCTION /begin DEF_CHARACTERISTIC /end DEF_CHARACTERISTIC /begin IN_MEASUREMENT /end IN_MEASUREMENT /begin OUT_MEASUREMENT /end OUT_MEASUREMENT /end FUNCTION
/begin FUNCTION RollingCounter_IfAction ""
 /begin SUB_FUNCTION Constant1 Constant65 Constant66 Constant67 Equal34 Add2 Switch Switch5 Unit_Delay5 /end SUB_FUNCTION
 /begin DEF_CHARACTERISTIC /end DEF_CHARACTERISTIC
 /begin IN_MEASUREMENT /end IN_MEASUREMENT
 /begin OUT_MEASUREMENT /end OUT_MEASUREMENT
/end FUNCTION
/begin FUNCTION RollingCounter_IfAction1 ""
 /begin SUB_FUNCTION Constant1 Constant65 Constant66 Constant67 Equal34 Add2 Switch Switch5 Unit_Delay5 /end SUB_FUNCTION
 /begin DEF_CHARACTERISTIC /end DEF_CHARACTERISTIC
 /begin IN_MEASUREMENT /end IN_MEASUREMENT
 /begin OUT_MEASUREMENT /end OUT_MEASUREMENT
/end FUNCTION
/begin FUNCTION SPTGDet "" /begin SUB_FUNCTION Data_Type_Conversion /end SUB_FUNCTION /begin DEF_CHARACTERISTIC /end DEF_CHARACTERISTIC /begin IN_MEASUREMENT /end IN_MEASUREMENT /begin OUT_MEASUREMENT /end OUT_MEASUREMENT /end FUNCTION
/begin FUNCTION SPTGSta "" /begin SUB_FUNCTION /end SUB_FUNCTION /begin DEF_CHARACTERISTIC /end DEF_CHARACTERISTIC /begin IN_MEASUREMENT /end IN_MEASUREMENT /begin OUT_MEASUREMENT /end OUT_MEASUREMENT /end FUNCTION
/begin FUNCTION bus_creator "" /begin DEF_CHARACTERISTIC /end DEF_CHARACTERISTIC /begin IN_MEASUREMENT /end IN_MEASUREMENT /begin OUT_MEASUREMENT /end OUT_MEASUREMENT /end FUNCTION
/begin FUNCTION Byte_10 "" /begin DEF_CHARACTERISTIC /end DEF_CHARACTERISTIC /begin IN_MEASUREMENT /end IN_MEASUREMENT /begin OUT_MEASUREMENT /end OUT_MEASUREMENT /end FUNCTION
/begin FUNCTION Byte_11 "" /begin DEF_CHARACTERISTIC /end DEF_CHARACTERISTIC /begin IN_MEASUREMENT /end IN_MEASUREMENT /begin OUT_MEASUREMENT /end OUT_MEASUREMENT /end FUNCTION
/begin FUNCTION Byte_12 "" /begin DEF_CHARACTERISTIC /end DEF_CHARACTERISTIC /begin IN_MEASUREMENT /end IN_MEASUREMENT /begin OUT_MEASUREMENT /end OUT_MEASUREMENT /end FUNCTION
/begin FUNCTION Byte_13 "" /begin DEF_CHARACTERISTIC /end DEF_CHARACTERISTIC /begin IN_MEASUREMENT /end IN_MEASUREMENT /begin OUT_MEASUREMENT /end OUT_MEASUREMENT /end FUNCTION
/begin FUNCTION Byte_14 "" /begin DEF_CHARACTERISTIC /end DEF_CHARACTERISTIC /begin IN_MEASUREMENT /end IN_MEASUREMENT /begin OUT_MEASUREMENT /end OUT_MEASUREMENT /end FUNCTION
/begin FUNCTION Byte_15 "" /begin DEF_CHARACTERISTIC /end DEF_CHARACTERISTIC /begin IN_MEASUREMENT /end IN_MEASUREMENT /begin OUT_MEASUREMENT /end OUT_MEASUREMENT /end FUNCTION
/begin FUNCTION Byte_8 "" /begin DEF_CHARACTERISTIC /end DEF_CHARACTERISTIC /begin IN_MEASUREMENT /end IN_MEASUREMENT /begin OUT_MEASUREMENT /end OUT_MEASUREMENT /end FUNCTION
/begin FUNCTION Byte_9 "" /begin DEF_CHARACTERISTIC /end DEF_CHARACTERISTIC /begin IN_MEASUREMENT /end IN_MEASUREMENT /begin OUT_MEASUREMENT /end OUT_MEASUREMENT /end FUNCTION
/begin FUNCTION Constant "" /begin DEF_CHARACTERISTIC KHAL_CAN6FD6APS3E2E_flg /end DEF_CHARACTERISTIC /begin IN_MEASUREMENT /end IN_MEASUREMENT /begin OUT_MEASUREMENT /end OUT_MEASUREMENT /end FUNCTION
/begin FUNCTION Constant1 "" /begin DEF_CHARACTERISTIC /end DEF_CHARACTERISTIC /begin IN_MEASUREMENT /end IN_MEASUREMENT /begin OUT_MEASUREMENT /end OUT_MEASUREMENT /end FUNCTION
/begin FUNCTION Constant2 "" /begin DEF_CHARACTERISTIC /end DEF_CHARACTERISTIC /begin IN_MEASUREMENT /end IN_MEASUREMENT /begin OUT_MEASUREMENT /end OUT_MEASUREMENT /end FUNCTION
/begin FUNCTION Constant3 "" /begin DEF_CHARACTERISTIC KHAL_CAN6FD6APS3E2E_flg /end DEF_CHARACTERISTIC /begin IN_MEASUREMENT /end IN_MEASUREMENT /begin OUT_MEASUREMENT /end OUT_MEASUREMENT /end FUNCTION
/begin FUNCTION Constant4 "" /begin DEF_CHARACTERISTIC KHAL_CAN6FD6APS3E2E_flg /end DEF_CHARACTERISTIC /begin IN_MEASUREMENT /end IN_MEASUREMENT /begin OUT_MEASUREMENT /end OUT_MEASUREMENT /end FUNCTION
/begin FUNCTION Chart "" /begin DEF_CHARACTERISTIC /end DEF_CHARACTERISTIC /begin IN_MEASUREMENT /end IN_MEASUREMENT /begin OUT_MEASUREMENT /end OUT_MEASUREMENT /end FUNCTION
/begin FUNCTION Constant "" /begin DEF_CHARACTERISTIC /end DEF_CHARACTERISTIC /begin IN_MEASUREMENT /end IN_MEASUREMENT /begin OUT_MEASUREMENT /end OUT_MEASUREMENT /end FUNCTION
/begin FUNCTION Constant3 "" /begin DEF_CHARACTERISTIC /end DEF_CHARACTERISTIC /begin IN_MEASUREMENT /end IN_MEASUREMENT /begin OUT_MEASUREMENT /end OUT_MEASUREMENT /end FUNCTION
/begin FUNCTION Data_Type_Conversion "" /begin DEF_CHARACTERISTIC /end DEF_CHARACTERISTIC /begin IN_MEASUREMENT /end IN_MEASUREMENT /begin OUT_MEASUREMENT /end OUT_MEASUREMENT /end FUNCTION
/begin FUNCTION Gain "" /begin DEF_CHARACTERISTIC /end DEF_CHARACTERISTIC /begin IN_MEASUREMENT /end IN_MEASUREMENT /begin OUT_MEASUREMENT /end OUT_MEASUREMENT /end FUNCTION
/begin FUNCTION Divide "" /begin DEF_CHARACTERISTIC /end DEF_CHARACTERISTIC /begin IN_MEASUREMENT /end IN_MEASUREMENT /begin OUT_MEASUREMENT /end OUT_MEASUREMENT /end FUNCTION
/begin FUNCTION AllDoorSW "" /begin SUB_FUNCTION Data_Type_Conversion /end SUB_FUNCTION /begin DEF_CHARACTERISTIC /end DEF_CHARACTERISTIC /begin IN_MEASUREMENT /end IN_MEASUREMENT /begin OUT_MEASUREMENT /end OUT_MEASUREMENT /end FUNCTION
/begin FUNCTION AntiTheftSeatFold "" /begin SUB_FUNCTION Data_Type_Conversion /end SUB_FUNCTION /begin DEF_CHARACTERISTIC /end DEF_CHARACTERISTIC /begin IN_MEASUREMENT /end IN_MEASUREMENT /begin OUT_MEASUREMENT /end OUT_MEASUREMENT /end FUNCTION
/begin FUNCTION AntitheftSta "" /begin SUB_FUNCTION /end SUB_FUNCTION /begin DEF_CHARACTERISTIC /end DEF_CHARACTERISTIC /begin IN_MEASUREMENT /end IN_MEASUREMENT /begin OUT_MEASUREMENT /end OUT_MEASUREMENT /end FUNCTION
/begin FUNCTION BCMBuzzerReq "" /begin SUB_FUNCTION Data_Type_Conversion /end SUB_FUNCTION /begin DEF_CHARACTERISTIC /end DEF_CHARACTERISTIC /begin IN_MEASUREMENT /end IN_MEASUREMENT /begin OUT_MEASUREMENT /end OUT_MEASUREMENT /end FUNCTION
/begin FUNCTION BCMDoorLockSta "" /begin SUB_FUNCTION Data_Type_Conversion /end SUB_FUNCTION /begin DEF_CHARACTERISTIC /end DEF_CHARACTERISTIC /begin IN_MEASUREMENT /end IN_MEASUREMENT /begin OUT_MEASUREMENT /end OUT_MEASUREMENT /end FUNCTION
/begin FUNCTION BrakeLamp "" /begin SUB_FUNCTION Data_Type_Conversion /end SUB_FUNCTION /begin DEF_CHARACTERISTIC /end DEF_CHARACTERISTIC /begin IN_MEASUREMENT /end IN_MEASUREMENT /begin OUT_MEASUREMENT /end OUT_MEASUREMENT /end FUNCTION
/begin FUNCTION CTDCtrl "" /begin SUB_FUNCTION /end SUB_FUNCTION /begin DEF_CHARACTERISTIC /end DEF_CHARACTERISTIC /begin IN_MEASUREMENT /end IN_MEASUREMENT /begin OUT_MEASUREMENT /end OUT_MEASUREMENT /end FUNCTION
/begin FUNCTION CTDLockSW "" /begin SUB_FUNCTION Data_Type_Conversion /end SUB_FUNCTION /begin DEF_CHARACTERISTIC /end DEF_CHARACTERISTIC /begin IN_MEASUREMENT /end IN_MEASUREMENT /begin OUT_MEASUREMENT /end OUT_MEASUREMENT /end FUNCTION
/begin FUNCTION CTDUnlockSW "" /begin SUB_FUNCTION /end SUB_FUNCTION /begin DEF_CHARACTERISTIC /end DEF_CHARACTERISTIC /begin IN_MEASUREMENT /end IN_MEASUREMENT /begin OUT_MEASUREMENT /end OUT_MEASUREMENT /end FUNCTION
/begin FUNCTION CrashDetd "" /begin SUB_FUNCTION Data_Type_Conversion /end SUB_FUNCTION /begin DEF_CHARACTERISTIC /end DEF_CHARACTERISTIC /begin IN_MEASUREMENT /end IN_MEASUREMENT /begin OUT_MEASUREMENT /end OUT_MEASUREMENT /end FUNCTION
/begin FUNCTION Dimmer "" /begin SUB_FUNCTION Data_Type_Conversion /end SUB_FUNCTION /begin DEF_CHARACTERISTIC /end DEF_CHARACTERISTIC /begin IN_MEASUREMENT /end IN_MEASUREMENT /begin OUT_MEASUREMENT /end OUT_MEASUREMENT /end FUNCTION
/begin FUNCTION DimmerEN "" /begin SUB_FUNCTION Data_Type_Conversion /end SUB_FUNCTION /begin DEF_CHARACTERISTIC /end DEF_CHARACTERISTIC /begin IN_MEASUREMENT /end IN_MEASUREMENT /begin OUT_MEASUREMENT /end OUT_MEASUREMENT /end FUNCTION
/begin FUNCTION DoorLockIND "" /begin SUB_FUNCTION Data_Type_Conversion /end SUB_FUNCTION /begin DEF_CHARACTERISTIC /end DEF_CHARACTERISTIC /begin IN_MEASUREMENT /end IN_MEASUREMENT /begin OUT_MEASUREMENT /end OUT_MEASUREMENT /end FUNCTION
/begin FUNCTION DrDoorSW "" /begin SUB_FUNCTION Data_Type_Conversion /end SUB_FUNCTION /begin DEF_CHARACTERISTIC /end DEF_CHARACTERISTIC /begin IN_MEASUREMENT /end IN_MEASUREMENT /begin OUT_MEASUREMENT /end OUT_MEASUREMENT /end FUNCTION
/begin FUNCTION FrChargingDoorCtrl "" /begin SUB_FUNCTION /end SUB_FUNCTION /begin DEF_CHARACTERISTIC /end DEF_CHARACTERISTIC /begin IN_MEASUREMENT /end IN_MEASUREMENT /begin OUT_MEASUREMENT /end OUT_MEASUREMENT /end FUNCTION
/begin FUNCTION FrFogLamp "" /begin SUB_FUNCTION /end SUB_FUNCTION /begin DEF_CHARACTERISTIC /end DEF_CHARACTERISTIC /begin IN_MEASUREMENT /end IN_MEASUREMENT /begin OUT_MEASUREMENT /end OUT_MEASUREMENT /end FUNCTION
/begin FUNCTION FrWiperH "" /begin SUB_FUNCTION Data_Type_Conversion /end SUB_FUNCTION /begin DEF_CHARACTERISTIC /end DEF_CHARACTERISTIC /begin IN_MEASUREMENT /end IN_MEASUREMENT /begin OUT_MEASUREMENT /end OUT_MEASUREMENT /end FUNCTION
/begin FUNCTION FrWiperL "" /begin SUB_FUNCTION Data_Type_Conversion /end SUB_FUNCTION /begin DEF_CHARACTERISTIC /end DEF_CHARACTERISTIC /begin IN_MEASUREMENT /end IN_MEASUREMENT /begin OUT_MEASUREMENT /end OUT_MEASUREMENT /end FUNCTION
/begin FUNCTION HBeam "" /begin SUB_FUNCTION Data_Type_Conversion /end SUB_FUNCTION /begin DEF_CHARACTERISTIC /end DEF_CHARACTERISTIC /begin IN_MEASUREMENT /end IN_MEASUREMENT /begin OUT_MEASUREMENT /end OUT_MEASUREMENT /end FUNCTION
/begin FUNCTION HazardSW "" /begin SUB_FUNCTION Data_Type_Conversion /end SUB_FUNCTION /begin DEF_CHARACTERISTIC /end DEF_CHARACTERISTIC /begin IN_MEASUREMENT /end IN_MEASUREMENT /begin OUT_MEASUREMENT /end OUT_MEASUREMENT /end FUNCTION
/begin FUNCTION HoodSW "" /begin SUB_FUNCTION Data_Type_Conversion /end SUB_FUNCTION /begin DEF_CHARACTERISTIC /end DEF_CHARACTERISTIC /begin IN_MEASUREMENT /end IN_MEASUREMENT /begin OUT_MEASUREMENT /end OUT_MEASUREMENT /end FUNCTION
/begin FUNCTION HornCtrl "" /begin SUB_FUNCTION Data_Type_Conversion /end SUB_FUNCTION /begin DEF_CHARACTERISTIC /end DEF_CHARACTERISTIC /begin IN_MEASUREMENT /end IN_MEASUREMENT /begin OUT_MEASUREMENT /end OUT_MEASUREMENT /end FUNCTION
/begin FUNCTION LAPMWdwEnable "" /begin SUB_FUNCTION /end SUB_FUNCTION /begin DEF_CHARACTERISTIC /end DEF_CHARACTERISTIC /begin IN_MEASUREMENT /end IN_MEASUREMENT /begin OUT_MEASUREMENT /end OUT_MEASUREMENT /end FUNCTION
/begin FUNCTION LBSD "" /begin SUB_FUNCTION Data_Type_Conversion /end SUB_FUNCTION /begin DEF_CHARACTERISTIC /end DEF_CHARACTERISTIC /begin IN_MEASUREMENT /end IN_MEASUREMENT /begin OUT_MEASUREMENT /end OUT_MEASUREMENT /end FUNCTION
/begin FUNCTION LBeam "" /begin SUB_FUNCTION Data_Type_Conversion /end SUB_FUNCTION /begin DEF_CHARACTERISTIC /end DEF_CHARACTERISTIC /begin IN_MEASUREMENT /end IN_MEASUREMENT /begin OUT_MEASUREMENT /end OUT_MEASUREMENT /end FUNCTION
/begin FUNCTION LDRL "" /begin SUB_FUNCTION Data_Type_Conversion /end SUB_FUNCTION /begin DEF_CHARACTERISTIC /end DEF_CHARACTERISTIC /begin IN_MEASUREMENT /end IN_MEASUREMENT /begin OUT_MEASUREMENT /end OUT_MEASUREMENT /end FUNCTION
/begin FUNCTION LTurnLP "" /begin SUB_FUNCTION Data_Type_Conversion /end SUB_FUNCTION /begin DEF_CHARACTERISTIC /end DEF_CHARACTERISTIC /begin IN_MEASUREMENT /end IN_MEASUREMENT /begin OUT_MEASUREMENT /end OUT_MEASUREMENT /end FUNCTION
/begin FUNCTION LockSetting "" /begin SUB_FUNCTION Data_Type_Conversion /end SUB_FUNCTION /begin DEF_CHARACTERISTIC /end DEF_CHARACTERISTIC /begin IN_MEASUREMENT /end IN_MEASUREMENT /begin OUT_MEASUREMENT /end OUT_MEASUREMENT /end FUNCTION
/begin FUNCTION MirrorCtrl "" /begin SUB_FUNCTION /end SUB_FUNCTION /begin DEF_CHARACTERISTIC /end DEF_CHARACTERISTIC /begin IN_MEASUREMENT /end IN_MEASUREMENT /begin OUT_MEASUREMENT /end OUT_MEASUREMENT /end FUNCTION
/begin FUNCTION MirrorDefog "" /begin SUB_FUNCTION Data_Type_Conversion /end SUB_FUNCTION /begin DEF_CHARACTERISTIC /end DEF_CHARACTERISTIC /begin IN_MEASUREMENT /end IN_MEASUREMENT /begin OUT_MEASUREMENT /end OUT_MEASUREMENT /end FUNCTION
/begin FUNCTION PosLamp "" /begin SUB_FUNCTION Data_Type_Conversion /end SUB_FUNCTION /begin DEF_CHARACTERISTIC /end DEF_CHARACTERISTIC /begin IN_MEASUREMENT /end IN_MEASUREMENT /begin OUT_MEASUREMENT /end OUT_MEASUREMENT /end FUNCTION
/begin FUNCTION PsDoorSW "" /begin SUB_FUNCTION Data_Type_Conversion /end SUB_FUNCTION /begin DEF_CHARACTERISTIC /end DEF_CHARACTERISTIC /begin IN_MEASUREMENT /end IN_MEASUREMENT /begin OUT_MEASUREMENT /end OUT_MEASUREMENT /end FUNCTION
/begin FUNCTION RBSD "" /begin SUB_FUNCTION Data_Type_Conversion /end SUB_FUNCTION /begin DEF_CHARACTERISTIC /end DEF_CHARACTERISTIC /begin IN_MEASUREMENT /end IN_MEASUREMENT /begin OUT_MEASUREMENT /end OUT_MEASUREMENT /end FUNCTION
/begin FUNCTION RDRL "" /begin SUB_FUNCTION Data_Type_Conversion /end SUB_FUNCTION /begin DEF_CHARACTERISTIC /end DEF_CHARACTERISTIC /begin IN_MEASUREMENT /end IN_MEASUREMENT /begin OUT_MEASUREMENT /end OUT_MEASUREMENT /end FUNCTION
/begin FUNCTION RLDoorSW "" /begin SUB_FUNCTION Data_Type_Conversion /end SUB_FUNCTION /begin DEF_CHARACTERISTIC /end DEF_CHARACTERISTIC /begin IN_MEASUREMENT /end IN_MEASUREMENT /begin OUT_MEASUREMENT /end OUT_MEASUREMENT /end FUNCTION
/begin FUNCTION RRDoorSW "" /begin SUB_FUNCTION Data_Type_Conversion /end SUB_FUNCTION /begin DEF_CHARACTERISTIC /end DEF_CHARACTERISTIC /begin IN_MEASUREMENT /end IN_MEASUREMENT /begin OUT_MEASUREMENT /end OUT_MEASUREMENT /end FUNCTION
/begin FUNCTION RTurnLP "" /begin SUB_FUNCTION Data_Type_Conversion /end SUB_FUNCTION /begin DEF_CHARACTERISTIC /end DEF_CHARACTERISTIC /begin IN_MEASUREMENT /end IN_MEASUREMENT /begin OUT_MEASUREMENT /end OUT_MEASUREMENT /end FUNCTION
/begin FUNCTION ReverseLamp "" /begin SUB_FUNCTION Data_Type_Conversion /end SUB_FUNCTION /begin DEF_CHARACTERISTIC /end DEF_CHARACTERISTIC /begin IN_MEASUREMENT /end IN_MEASUREMENT /begin OUT_MEASUREMENT /end OUT_MEASUREMENT /end FUNCTION
/begin FUNCTION RoomLampH "" /begin SUB_FUNCTION Data_Type_Conversion /end SUB_FUNCTION /begin DEF_CHARACTERISTIC /end DEF_CHARACTERISTIC /begin IN_MEASUREMENT /end IN_MEASUREMENT /begin OUT_MEASUREMENT /end OUT_MEASUREMENT /end FUNCTION
/begin FUNCTION RoomLampL "" /begin SUB_FUNCTION Data_Type_Conversion /end SUB_FUNCTION /begin DEF_CHARACTERISTIC /end DEF_CHARACTERISTIC /begin IN_MEASUREMENT /end IN_MEASUREMENT /begin OUT_MEASUREMENT /end OUT_MEASUREMENT /end FUNCTION
/begin FUNCTION RrChargingDoorCtrl "" /begin SUB_FUNCTION /end SUB_FUNCTION /begin DEF_CHARACTERISTIC /end DEF_CHARACTERISTIC /begin IN_MEASUREMENT /end IN_MEASUREMENT /begin OUT_MEASUREMENT /end OUT_MEASUREMENT /end FUNCTION
/begin FUNCTION RrDefog "" /begin SUB_FUNCTION Data_Type_Conversion /end SUB_FUNCTION /begin DEF_CHARACTERISTIC /end DEF_CHARACTERISTIC /begin IN_MEASUREMENT /end IN_MEASUREMENT /begin OUT_MEASUREMENT /end OUT_MEASUREMENT /end FUNCTION
/begin FUNCTION RrFogLamp "" /begin SUB_FUNCTION Data_Type_Conversion /end SUB_FUNCTION /begin DEF_CHARACTERISTIC /end DEF_CHARACTERISTIC /begin IN_MEASUREMENT /end IN_MEASUREMENT /begin OUT_MEASUREMENT /end OUT_MEASUREMENT /end FUNCTION
/begin FUNCTION RrWiper "" /begin SUB_FUNCTION Data_Type_Conversion /end SUB_FUNCTION /begin DEF_CHARACTERISTIC /end DEF_CHARACTERISTIC /begin IN_MEASUREMENT /end IN_MEASUREMENT /begin OUT_MEASUREMENT /end OUT_MEASUREMENT /end FUNCTION
/begin FUNCTION TailgateHDSW "" /begin SUB_FUNCTION Data_Type_Conversion /end SUB_FUNCTION /begin DEF_CHARACTERISTIC /end DEF_CHARACTERISTIC /begin IN_MEASUREMENT /end IN_MEASUREMENT /begin OUT_MEASUREMENT /end OUT_MEASUREMENT /end FUNCTION
/begin FUNCTION TailgateRemote "" /begin SUB_FUNCTION /end SUB_FUNCTION /begin DEF_CHARACTERISTIC /end DEF_CHARACTERISTIC /begin IN_MEASUREMENT /end IN_MEASUREMENT /begin OUT_MEASUREMENT /end OUT_MEASUREMENT /end FUNCTION
/begin FUNCTION TailgateSW "" /begin SUB_FUNCTION Data_Type_Conversion /end SUB_FUNCTION /begin DEF_CHARACTERISTIC /end DEF_CHARACTERISTIC /begin IN_MEASUREMENT /end IN_MEASUREMENT /begin OUT_MEASUREMENT /end OUT_MEASUREMENT /end FUNCTION
/begin FUNCTION TrunkRel "" /begin SUB_FUNCTION Data_Type_Conversion /end SUB_FUNCTION /begin DEF_CHARACTERISTIC /end DEF_CHARACTERISTIC /begin IN_MEASUREMENT /end IN_MEASUREMENT /begin OUT_MEASUREMENT /end OUT_MEASUREMENT /end FUNCTION
/begin FUNCTION WasherCtrl "" /begin SUB_FUNCTION /end SUB_FUNCTION /begin DEF_CHARACTERISTIC /end DEF_CHARACTERISTIC /begin IN_MEASUREMENT /end IN_MEASUREMENT /begin OUT_MEASUREMENT /end OUT_MEASUREMENT /end FUNCTION
/begin FUNCTION WiperFixMode "" /begin SUB_FUNCTION Data_Type_Conversion /end SUB_FUNCTION /begin DEF_CHARACTERISTIC /end DEF_CHARACTERISTIC /begin IN_MEASUREMENT /end IN_MEASUREMENT /begin OUT_MEASUREMENT /end OUT_MEASUREMENT /end FUNCTION
/begin FUNCTION bus_creator "" /begin DEF_CHARACTERISTIC /end DEF_CHARACTERISTIC /begin IN_MEASUREMENT /end IN_MEASUREMENT /begin OUT_MEASUREMENT /end OUT_MEASUREMENT /end FUNCTION
/begin FUNCTION CCCrlSta "" /begin SUB_FUNCTION /end SUB_FUNCTION /begin DEF_CHARACTERISTIC /end DEF_CHARACTERISTIC /begin IN_MEASUREMENT /end IN_MEASUREMENT /begin OUT_MEASUREMENT /end OUT_MEASUREMENT /end FUNCTION
/begin FUNCTION EngAGSCloseSta "" /begin SUB_FUNCTION /end SUB_FUNCTION /begin DEF_CHARACTERISTIC /end DEF_CHARACTERISTIC /begin IN_MEASUREMENT /end IN_MEASUREMENT /begin OUT_MEASUREMENT /end OUT_MEASUREMENT /end FUNCTION
/begin FUNCTION EngActvDmpDisabSta "" /begin SUB_FUNCTION /end SUB_FUNCTION /begin DEF_CHARACTERISTIC /end DEF_CHARACTERISTIC /begin IN_MEASUREMENT /end IN_MEASUREMENT /begin OUT_MEASUREMENT /end OUT_MEASUREMENT /end FUNCTION
/begin FUNCTION EngCoastDwSta "" /begin SUB_FUNCTION /end SUB_FUNCTION /begin DEF_CHARACTERISTIC /end DEF_CHARACTERISTIC /begin IN_MEASUREMENT /end IN_MEASUREMENT /begin OUT_MEASUREMENT /end OUT_MEASUREMENT /end FUNCTION
/begin FUNCTION EngPwrLockSta "" /begin SUB_FUNCTION /end SUB_FUNCTION /begin DEF_CHARACTERISTIC /end DEF_CHARACTERISTIC /begin IN_MEASUREMENT /end IN_MEASUREMENT /begin OUT_MEASUREMENT /end OUT_MEASUREMENT /end FUNCTION
/begin FUNCTION HVPwrSta "" /begin SUB_FUNCTION Data_Type_Conversion /end SUB_FUNCTION /begin DEF_CHARACTERISTIC /end DEF_CHARACTERISTIC /begin IN_MEASUREMENT /end IN_MEASUREMENT /begin OUT_MEASUREMENT /end OUT_MEASUREMENT /end FUNCTION
/begin FUNCTION LVPwrSta "" /begin SUB_FUNCTION Data_Type_Conversion /end SUB_FUNCTION /begin DEF_CHARACTERISTIC /end DEF_CHARACTERISTIC /begin IN_MEASUREMENT /end IN_MEASUREMENT /begin OUT_MEASUREMENT /end OUT_MEASUREMENT /end FUNCTION
/begin FUNCTION MSACrlSta "" /begin SUB_FUNCTION /end SUB_FUNCTION /begin DEF_CHARACTERISTIC /end DEF_CHARACTERISTIC /begin IN_MEASUREMENT /end IN_MEASUREMENT /begin OUT_MEASUREMENT /end OUT_MEASUREMENT /end FUNCTION
/begin FUNCTION PButtonSta "" /begin SUB_FUNCTION /end SUB_FUNCTION /begin DEF_CHARACTERISTIC /end DEF_CHARACTERISTIC /begin IN_MEASUREMENT /end IN_MEASUREMENT /begin OUT_MEASUREMENT /end OUT_MEASUREMENT /end FUNCTION
/begin FUNCTION PrkReq "" /begin SUB_FUNCTION Data_Type_Conversion /end SUB_FUNCTION /begin DEF_CHARACTERISTIC /end DEF_CHARACTERISTIC /begin IN_MEASUREMENT /end IN_MEASUREMENT /begin OUT_MEASUREMENT /end OUT_MEASUREMENT /end FUNCTION
/begin FUNCTION PrkReqValid "" /begin SUB_FUNCTION /end SUB_FUNCTION /begin DEF_CHARACTERISTIC /end DEF_CHARACTERISTIC /begin IN_MEASUREMENT /end IN_MEASUREMENT /begin OUT_MEASUREMENT /end OUT_MEASUREMENT /end FUNCTION
/begin FUNCTION PwrSta "" /begin SUB_FUNCTION /end SUB_FUNCTION /begin DEF_CHARACTERISTIC /end DEF_CHARACTERISTIC /begin IN_MEASUREMENT /end IN_MEASUREMENT /begin OUT_MEASUREMENT /end OUT_MEASUREMENT /end FUNCTION
/begin FUNCTION ShiftGearPosn "" /begin SUB_FUNCTION /end SUB_FUNCTION /begin DEF_CHARACTERISTIC /end DEF_CHARACTERISTIC /begin IN_MEASUREMENT /end IN_MEASUREMENT /begin OUT_MEASUREMENT /end OUT_MEASUREMENT /end FUNCTION
/begin FUNCTION VCUOPDHold "" /begin SUB_FUNCTION Data_Type_Conversion /end SUB_FUNCTION /begin DEF_CHARACTERISTIC /end DEF_CHARACTERISTIC /begin IN_MEASUREMENT /end IN_MEASUREMENT /begin OUT_MEASUREMENT /end OUT_MEASUREMENT /end FUNCTION
/begin FUNCTION VehMalfunLevel "" /begin SUB_FUNCTION /end SUB_FUNCTION /begin DEF_CHARACTERISTIC /end DEF_CHARACTERISTIC /begin IN_MEASUREMENT /end IN_MEASUREMENT /begin OUT_MEASUREMENT /end OUT_MEASUREMENT /end FUNCTION
/begin FUNCTION XWDMode "" /begin SUB_FUNCTION /end SUB_FUNCTION /begin DEF_CHARACTERISTIC /end DEF_CHARACTERISTIC /begin IN_MEASUREMENT /end IN_MEASUREMENT /begin OUT_MEASUREMENT /end OUT_MEASUREMENT /end FUNCTION
/begin FUNCTION bus_creator "" /begin DEF_CHARACTERISTIC /end DEF_CHARACTERISTIC /begin IN_MEASUREMENT /end IN_MEASUREMENT /begin OUT_MEASUREMENT /end OUT_MEASUREMENT /end FUNCTION
/begin FUNCTION FD6_VCU2 "" /begin DEF_CHARACTERISTIC /end DEF_CHARACTERISTIC /begin IN_MEASUREMENT /end IN_MEASUREMENT /begin OUT_MEASUREMENT /end OUT_MEASUREMENT /end FUNCTION
/begin FUNCTION ACCCtrlAvail "" /begin SUB_FUNCTION Data_Type_Conversion /end SUB_FUNCTION /begin DEF_CHARACTERISTIC /end DEF_CHARACTERISTIC /begin IN_MEASUREMENT /end IN_MEASUREMENT /begin OUT_MEASUREMENT /end OUT_MEASUREMENT /end FUNCTION
/begin FUNCTION AccPedalOverride "" /begin SUB_FUNCTION Data_Type_Conversion /end SUB_FUNCTION /begin DEF_CHARACTERISTIC /end DEF_CHARACTERISTIC /begin IN_MEASUREMENT /end IN_MEASUREMENT /begin OUT_MEASUREMENT /end OUT_MEASUREMENT /end FUNCTION
/begin FUNCTION ActAPSPosn "" /begin SUB_FUNCTION convert_out Data_Type_Conversion /end SUB_FUNCTION /begin DEF_CHARACTERISTIC /end DEF_CHARACTERISTIC /begin IN_MEASUREMENT /end IN_MEASUREMENT /begin OUT_MEASUREMENT /end OUT_MEASUREMENT /end FUNCTION
/begin FUNCTION Byte_0 "" /begin SUB_FUNCTION SignalPack /end SUB_FUNCTION /begin DEF_CHARACTERISTIC /end DEF_CHARACTERISTIC /begin IN_MEASUREMENT /end IN_MEASUREMENT /begin OUT_MEASUREMENT /end OUT_MEASUREMENT /end FUNCTION
/begin FUNCTION Byte_1 "" /begin SUB_FUNCTION SignalPack /end SUB_FUNCTION /begin DEF_CHARACTERISTIC /end DEF_CHARACTERISTIC /begin IN_MEASUREMENT /end IN_MEASUREMENT /begin OUT_MEASUREMENT /end OUT_MEASUREMENT /end FUNCTION
/begin FUNCTION Byte_10 "" /begin SUB_FUNCTION SignalPack convert_out UnitConverter UnitConverter1 /end SUB_FUNCTION /begin DEF_CHARACTERISTIC /end DEF_CHARACTERISTIC /begin IN_MEASUREMENT /end IN_MEASUREMENT /begin OUT_MEASUREMENT /end OUT_MEASUREMENT /end FUNCTION
/begin FUNCTION Byte_11 "" /begin SUB_FUNCTION SignalPack convert_out UnitConverter UnitConverter1 /end SUB_FUNCTION /begin DEF_CHARACTERISTIC /end DEF_CHARACTERISTIC /begin IN_MEASUREMENT /end IN_MEASUREMENT /begin OUT_MEASUREMENT /end OUT_MEASUREMENT /end FUNCTION
/begin FUNCTION Byte_12 "" /begin SUB_FUNCTION SignalPack convert_out UnitConverter UnitConverter1 /end SUB_FUNCTION /begin DEF_CHARACTERISTIC /end DEF_CHARACTERISTIC /begin IN_MEASUREMENT /end IN_MEASUREMENT /begin OUT_MEASUREMENT /end OUT_MEASUREMENT /end FUNCTION
/begin FUNCTION Byte_13 "" /begin SUB_FUNCTION SignalPack convert_out UnitConverter UnitConverter1 /end SUB_FUNCTION /begin DEF_CHARACTERISTIC /end DEF_CHARACTERISTIC /begin IN_MEASUREMENT /end IN_MEASUREMENT /begin OUT_MEASUREMENT /end OUT_MEASUREMENT /end FUNCTION
/begin FUNCTION Byte_14 "" /begin SUB_FUNCTION SignalPack convert_out UnitConverter UnitConverter1 /end SUB_FUNCTION /begin DEF_CHARACTERISTIC /end DEF_CHARACTERISTIC /begin IN_MEASUREMENT /end IN_MEASUREMENT /begin OUT_MEASUREMENT /end OUT_MEASUREMENT /end FUNCTION
/begin FUNCTION Byte_15 "" /begin SUB_FUNCTION SignalPack convert_out UnitConverter1 /end SUB_FUNCTION /begin DEF_CHARACTERISTIC /end DEF_CHARACTERISTIC /begin IN_MEASUREMENT /end IN_MEASUREMENT /begin OUT_MEASUREMENT /end OUT_MEASUREMENT /end FUNCTION
/begin FUNCTION Byte_2 "" /begin SUB_FUNCTION SignalPack convert_out UnitConverter UnitConverter1 /end SUB_FUNCTION /begin DEF_CHARACTERISTIC /end DEF_CHARACTERISTIC /begin IN_MEASUREMENT /end IN_MEASUREMENT /begin OUT_MEASUREMENT /end OUT_MEASUREMENT /end FUNCTION
/begin FUNCTION Byte_3 "" /begin SUB_FUNCTION SignalPack convert_out UnitConverter UnitConverter1 /end SUB_FUNCTION /begin DEF_CHARACTERISTIC /end DEF_CHARACTERISTIC /begin IN_MEASUREMENT /end IN_MEASUREMENT /begin OUT_MEASUREMENT /end OUT_MEASUREMENT /end FUNCTION
/begin FUNCTION Byte_4 "" /begin SUB_FUNCTION SignalPack convert_out UnitConverter UnitConverter1 /end SUB_FUNCTION /begin DEF_CHARACTERISTIC /end DEF_CHARACTERISTIC /begin IN_MEASUREMENT /end IN_MEASUREMENT /begin OUT_MEASUREMENT /end OUT_MEASUREMENT /end FUNCTION
/begin FUNCTION Byte_5 "" /begin SUB_FUNCTION SignalPack convert_out UnitConverter UnitConverter1 /end SUB_FUNCTION /begin DEF_CHARACTERISTIC /end DEF_CHARACTERISTIC /begin IN_MEASUREMENT /end IN_MEASUREMENT /begin OUT_MEASUREMENT /end OUT_MEASUREMENT /end FUNCTION
/begin FUNCTION Byte_6 "" /begin SUB_FUNCTION SignalPack SignalPack1 UnitConverter1 UnitConverter3 /end SUB_FUNCTION /begin DEF_CHARACTERISTIC /end DEF_CHARACTERISTIC /begin IN_MEASUREMENT /end IN_MEASUREMENT /begin OUT_MEASUREMENT /end OUT_MEASUREMENT /end FUNCTION
/begin FUNCTION CRC8_IfAction_Tx ""
 /begin SUB_FUNCTION If_Action_Subsystem If_Action_Subsystem1 Data_Type_Conversion If Merge /end SUB_FUNCTION
 /begin DEF_CHARACTERISTIC /end DEF_CHARACTERISTIC
 /begin IN_MEASUREMENT /end IN_MEASUREMENT
 /begin OUT_MEASUREMENT /end OUT_MEASUREMENT
/end FUNCTION
/begin FUNCTION CSVCU2CAN6 "" /begin SUB_FUNCTION /end SUB_FUNCTION /begin DEF_CHARACTERISTIC /end DEF_CHARACTERISTIC /begin IN_MEASUREMENT /end IN_MEASUREMENT /begin OUT_MEASUREMENT /end OUT_MEASUREMENT /end FUNCTION
/begin FUNCTION DriverTq "" /begin SUB_FUNCTION convert_out Data_Type_Conversion /end SUB_FUNCTION /begin DEF_CHARACTERISTIC /end DEF_CHARACTERISTIC /begin IN_MEASUREMENT /end IN_MEASUREMENT /begin OUT_MEASUREMENT /end OUT_MEASUREMENT /end FUNCTION
/begin FUNCTION FrDriverTq "" /begin SUB_FUNCTION convert_out Data_Type_Conversion /end SUB_FUNCTION /begin DEF_CHARACTERISTIC /end DEF_CHARACTERISTIC /begin IN_MEASUREMENT /end IN_MEASUREMENT /begin OUT_MEASUREMENT /end OUT_MEASUREMENT /end FUNCTION
/begin FUNCTION RCVCU2CAN6 "" /begin SUB_FUNCTION /end SUB_FUNCTION /begin DEF_CHARACTERISTIC /end DEF_CHARACTERISTIC /begin IN_MEASUREMENT /end IN_MEASUREMENT /begin OUT_MEASUREMENT /end OUT_MEASUREMENT /end FUNCTION
/begin FUNCTION RollingCounter_IfAction ""
 /begin SUB_FUNCTION Constant1 Constant65 Constant66 Constant67 Equal34 Add2 Switch Switch5 Unit_Delay5 /end SUB_FUNCTION
 /begin DEF_CHARACTERISTIC /end DEF_CHARACTERISTIC
 /begin IN_MEASUREMENT /end IN_MEASUREMENT
 /begin OUT_MEASUREMENT /end OUT_MEASUREMENT
/end FUNCTION
/begin FUNCTION RollingCounter_IfAction1 ""
 /begin SUB_FUNCTION Constant1 Constant65 Constant66 Constant67 Equal34 Add2 Switch Switch5 Unit_Delay5 /end SUB_FUNCTION
 /begin DEF_CHARACTERISTIC /end DEF_CHARACTERISTIC
 /begin IN_MEASUREMENT /end IN_MEASUREMENT
 /begin OUT_MEASUREMENT /end OUT_MEASUREMENT
/end FUNCTION
/begin FUNCTION RrDriverTq "" /begin SUB_FUNCTION convert_out Data_Type_Conversion /end SUB_FUNCTION /begin DEF_CHARACTERISTIC /end DEF_CHARACTERISTIC /begin IN_MEASUREMENT /end IN_MEASUREMENT /begin OUT_MEASUREMENT /end OUT_MEASUREMENT /end FUNCTION
/begin FUNCTION VehActPwr "" /begin SUB_FUNCTION convert_out Data_Type_Conversion /end SUB_FUNCTION /begin DEF_CHARACTERISTIC /end DEF_CHARACTERISTIC /begin IN_MEASUREMENT /end IN_MEASUREMENT /begin OUT_MEASUREMENT /end OUT_MEASUREMENT /end FUNCTION
/begin FUNCTION bus_creator "" /begin DEF_CHARACTERISTIC /end DEF_CHARACTERISTIC /begin IN_MEASUREMENT /end IN_MEASUREMENT /begin OUT_MEASUREMENT /end OUT_MEASUREMENT /end FUNCTION
/begin FUNCTION Byte_7 "" /begin DEF_CHARACTERISTIC /end DEF_CHARACTERISTIC /begin IN_MEASUREMENT /end IN_MEASUREMENT /begin OUT_MEASUREMENT /end OUT_MEASUREMENT /end FUNCTION
/begin FUNCTION Byte_8 "" /begin DEF_CHARACTERISTIC /end DEF_CHARACTERISTIC /begin IN_MEASUREMENT /end IN_MEASUREMENT /begin OUT_MEASUREMENT /end OUT_MEASUREMENT /end FUNCTION
/begin FUNCTION Byte_9 "" /begin DEF_CHARACTERISTIC /end DEF_CHARACTERISTIC /begin IN_MEASUREMENT /end IN_MEASUREMENT /begin OUT_MEASUREMENT /end OUT_MEASUREMENT /end FUNCTION
/begin FUNCTION Constant "" /begin DEF_CHARACTERISTIC KHAL_CAN6FD6VCU2E2E_flg /end DEF_CHARACTERISTIC /begin IN_MEASUREMENT /end IN_MEASUREMENT /begin OUT_MEASUREMENT /end OUT_MEASUREMENT /end FUNCTION
/begin FUNCTION Constant1 "" /begin DEF_CHARACTERISTIC /end DEF_CHARACTERISTIC /begin IN_MEASUREMENT /end IN_MEASUREMENT /begin OUT_MEASUREMENT /end OUT_MEASUREMENT /end FUNCTION
/begin FUNCTION Constant2 "" /begin DEF_CHARACTERISTIC /end DEF_CHARACTERISTIC /begin IN_MEASUREMENT /end IN_MEASUREMENT /begin OUT_MEASUREMENT /end OUT_MEASUREMENT /end FUNCTION
/begin FUNCTION Constant3 "" /begin DEF_CHARACTERISTIC KHAL_CAN6FD6VCU2E2E_flg /end DEF_CHARACTERISTIC /begin IN_MEASUREMENT /end IN_MEASUREMENT /begin OUT_MEASUREMENT /end OUT_MEASUREMENT /end FUNCTION
/begin FUNCTION Constant4 "" /begin DEF_CHARACTERISTIC KHAL_CAN6FD6VCU2E2E_flg /end DEF_CHARACTERISTIC /begin IN_MEASUREMENT /end IN_MEASUREMENT /begin OUT_MEASUREMENT /end OUT_MEASUREMENT /end FUNCTION
/begin FUNCTION Chart "" /begin DEF_CHARACTERISTIC /end DEF_CHARACTERISTIC /begin IN_MEASUREMENT /end IN_MEASUREMENT /begin OUT_MEASUREMENT /end OUT_MEASUREMENT /end FUNCTION
/begin FUNCTION Constant "" /begin DEF_CHARACTERISTIC /end DEF_CHARACTERISTIC /begin IN_MEASUREMENT /end IN_MEASUREMENT /begin OUT_MEASUREMENT /end OUT_MEASUREMENT /end FUNCTION
/begin FUNCTION Constant3 "" /begin DEF_CHARACTERISTIC /end DEF_CHARACTERISTIC /begin IN_MEASUREMENT /end IN_MEASUREMENT /begin OUT_MEASUREMENT /end OUT_MEASUREMENT /end FUNCTION
/begin FUNCTION Data_Type_Conversion "" /begin DEF_CHARACTERISTIC /end DEF_CHARACTERISTIC /begin IN_MEASUREMENT /end IN_MEASUREMENT /begin OUT_MEASUREMENT /end OUT_MEASUREMENT /end FUNCTION
/begin FUNCTION Gain "" /begin DEF_CHARACTERISTIC /end DEF_CHARACTERISTIC /begin IN_MEASUREMENT /end IN_MEASUREMENT /begin OUT_MEASUREMENT /end OUT_MEASUREMENT /end FUNCTION
/begin FUNCTION Divide "" /begin DEF_CHARACTERISTIC /end DEF_CHARACTERISTIC /begin IN_MEASUREMENT /end IN_MEASUREMENT /begin OUT_MEASUREMENT /end OUT_MEASUREMENT /end FUNCTION
/begin FUNCTION AccCalcuPID "" /begin SUB_FUNCTION convert_out Data_Type_Conversion /end SUB_FUNCTION /begin DEF_CHARACTERISTIC /end DEF_CHARACTERISTIC /begin IN_MEASUREMENT /end IN_MEASUREMENT /begin OUT_MEASUREMENT /end OUT_MEASUREMENT /end FUNCTION
/begin FUNCTION CCMSASpdWar "" /begin SUB_FUNCTION Data_Type_Conversion /end SUB_FUNCTION /begin DEF_CHARACTERISTIC /end DEF_CHARACTERISTIC /begin IN_MEASUREMENT /end IN_MEASUREMENT /begin OUT_MEASUREMENT /end OUT_MEASUREMENT /end FUNCTION
/begin FUNCTION DISCButtSta "" /begin SUB_FUNCTION Data_Type_Conversion /end SUB_FUNCTION /begin DEF_CHARACTERISTIC /end DEF_CHARACTERISTIC /begin IN_MEASUREMENT /end IN_MEASUREMENT /begin OUT_MEASUREMENT /end OUT_MEASUREMENT /end FUNCTION
/begin FUNCTION DISCDISCTargetSpd "" /begin SUB_FUNCTION convert_out Data_Type_Conversion /end SUB_FUNCTION /begin DEF_CHARACTERISTIC /end DEF_CHARACTERISTIC /begin IN_MEASUREMENT /end IN_MEASUREMENT /begin OUT_MEASUREMENT /end OUT_MEASUREMENT /end FUNCTION
/begin FUNCTION DISCDISCTurn "" /begin SUB_FUNCTION Data_Type_Conversion /end SUB_FUNCTION /begin DEF_CHARACTERISTIC /end DEF_CHARACTERISTIC /begin IN_MEASUREMENT /end IN_MEASUREMENT /begin OUT_MEASUREMENT /end OUT_MEASUREMENT /end FUNCTION
/begin FUNCTION DISCReqAcc "" /begin SUB_FUNCTION convert_out Data_Type_Conversion /end SUB_FUNCTION /begin DEF_CHARACTERISTIC /end DEF_CHARACTERISTIC /begin IN_MEASUREMENT /end IN_MEASUREMENT /begin OUT_MEASUREMENT /end OUT_MEASUREMENT /end FUNCTION
/begin FUNCTION DISCSta "" /begin SUB_FUNCTION /end SUB_FUNCTION /begin DEF_CHARACTERISTIC /end DEF_CHARACTERISTIC /begin IN_MEASUREMENT /end IN_MEASUREMENT /begin OUT_MEASUREMENT /end OUT_MEASUREMENT /end FUNCTION
/begin FUNCTION FDCVMCLongAccelCmd "" /begin SUB_FUNCTION convert_out Data_Type_Conversion /end SUB_FUNCTION /begin DEF_CHARACTERISTIC /end DEF_CHARACTERISTIC /begin IN_MEASUREMENT /end IN_MEASUREMENT /begin OUT_MEASUREMENT /end OUT_MEASUREMENT /end FUNCTION
/begin FUNCTION FeatArbitrFinal "" /begin SUB_FUNCTION /end SUB_FUNCTION /begin DEF_CHARACTERISTIC /end DEF_CHARACTERISTIC /begin IN_MEASUREMENT /end IN_MEASUREMENT /begin OUT_MEASUREMENT /end OUT_MEASUREMENT /end FUNCTION
/begin FUNCTION FeatArbitrSta "" /begin SUB_FUNCTION /end SUB_FUNCTION /begin DEF_CHARACTERISTIC /end DEF_CHARACTERISTIC /begin IN_MEASUREMENT /end IN_MEASUREMENT /begin OUT_MEASUREMENT /end OUT_MEASUREMENT /end FUNCTION
/begin FUNCTION FeatReqSpd "" /begin SUB_FUNCTION convert_out Data_Type_Conversion /end SUB_FUNCTION /begin DEF_CHARACTERISTIC /end DEF_CHARACTERISTIC /begin IN_MEASUREMENT /end IN_MEASUREMENT /begin OUT_MEASUREMENT /end OUT_MEASUREMENT /end FUNCTION
/begin FUNCTION FeatSetSpdFinalraw32 "" /begin SUB_FUNCTION Data_Type_Conversion /end SUB_FUNCTION /begin DEF_CHARACTERISTIC /end DEF_CHARACTERISTIC /begin IN_MEASUREMENT /end IN_MEASUREMENT /begin OUT_MEASUREMENT /end OUT_MEASUREMENT /end FUNCTION
/begin FUNCTION FrontRearSlipRatioCtrl "" /begin SUB_FUNCTION Data_Type_Conversion /end SUB_FUNCTION /begin DEF_CHARACTERISTIC /end DEF_CHARACTERISTIC /begin IN_MEASUREMENT /end IN_MEASUREMENT /begin OUT_MEASUREMENT /end OUT_MEASUREMENT /end FUNCTION
/begin FUNCTION JerkPCT "" /begin SUB_FUNCTION Data_Type_Conversion /end SUB_FUNCTION /begin DEF_CHARACTERISTIC /end DEF_CHARACTERISTIC /begin IN_MEASUREMENT /end IN_MEASUREMENT /begin OUT_MEASUREMENT /end OUT_MEASUREMENT /end FUNCTION
/begin FUNCTION LatAccCtrl "" /begin SUB_FUNCTION Data_Type_Conversion /end SUB_FUNCTION /begin DEF_CHARACTERISTIC /end DEF_CHARACTERISTIC /begin IN_MEASUREMENT /end IN_MEASUREMENT /begin OUT_MEASUREMENT /end OUT_MEASUREMENT /end FUNCTION
/begin FUNCTION LateralCtrl "" /begin SUB_FUNCTION Data_Type_Conversion /end SUB_FUNCTION /begin DEF_CHARACTERISTIC /end DEF_CHARACTERISTIC /begin IN_MEASUREMENT /end IN_MEASUREMENT /begin OUT_MEASUREMENT /end OUT_MEASUREMENT /end FUNCTION
/begin FUNCTION LimitPCT "" /begin SUB_FUNCTION Data_Type_Conversion /end SUB_FUNCTION /begin DEF_CHARACTERISTIC /end DEF_CHARACTERISTIC /begin IN_MEASUREMENT /end IN_MEASUREMENT /begin OUT_MEASUREMENT /end OUT_MEASUREMENT /end FUNCTION
/begin FUNCTION MeterIndSpeedraw32 "" /begin SUB_FUNCTION Data_Type_Conversion /end SUB_FUNCTION /begin DEF_CHARACTERISTIC /end DEF_CHARACTERISTIC /begin IN_MEASUREMENT /end IN_MEASUREMENT /begin OUT_MEASUREMENT /end OUT_MEASUREMENT /end FUNCTION
/begin FUNCTION RearWhlSlipRatioCtrl "" /begin SUB_FUNCTION Data_Type_Conversion /end SUB_FUNCTION /begin DEF_CHARACTERISTIC /end DEF_CHARACTERISTIC /begin IN_MEASUREMENT /end IN_MEASUREMENT /begin OUT_MEASUREMENT /end OUT_MEASUREMENT /end FUNCTION
/begin FUNCTION SPD2ACCAct "" /begin SUB_FUNCTION Data_Type_Conversion /end SUB_FUNCTION /begin DEF_CHARACTERISTIC /end DEF_CHARACTERISTIC /begin IN_MEASUREMENT /end IN_MEASUREMENT /begin OUT_MEASUREMENT /end OUT_MEASUREMENT /end FUNCTION
/begin FUNCTION SafetyCtrl "" /begin SUB_FUNCTION Data_Type_Conversion /end SUB_FUNCTION /begin DEF_CHARACTERISTIC /end DEF_CHARACTERISTIC /begin IN_MEASUREMENT /end IN_MEASUREMENT /begin OUT_MEASUREMENT /end OUT_MEASUREMENT /end FUNCTION
/begin FUNCTION SingleWhlSlipRatioCtrl "" /begin SUB_FUNCTION Data_Type_Conversion /end SUB_FUNCTION /begin DEF_CHARACTERISTIC /end DEF_CHARACTERISTIC /begin IN_MEASUREMENT /end IN_MEASUREMENT /begin OUT_MEASUREMENT /end OUT_MEASUREMENT /end FUNCTION
/begin FUNCTION TimeGapCalcu "" /begin SUB_FUNCTION convert_out Data_Type_Conversion /end SUB_FUNCTION /begin DEF_CHARACTERISTIC /end DEF_CHARACTERISTIC /begin IN_MEASUREMENT /end IN_MEASUREMENT /begin OUT_MEASUREMENT /end OUT_MEASUREMENT /end FUNCTION
/begin FUNCTION VMCACCCtrlAvail "" /begin SUB_FUNCTION Data_Type_Conversion /end SUB_FUNCTION /begin DEF_CHARACTERISTIC /end DEF_CHARACTERISTIC /begin IN_MEASUREMENT /end IN_MEASUREMENT /begin OUT_MEASUREMENT /end OUT_MEASUREMENT /end FUNCTION
/begin FUNCTION VMCAEBCtrlAvail "" /begin SUB_FUNCTION Data_Type_Conversion /end SUB_FUNCTION /begin DEF_CHARACTERISTIC /end DEF_CHARACTERISTIC /begin IN_MEASUREMENT /end IN_MEASUREMENT /begin OUT_MEASUREMENT /end OUT_MEASUREMENT /end FUNCTION
/begin FUNCTION VMCCCCtrlAvail "" /begin SUB_FUNCTION Data_Type_Conversion /end SUB_FUNCTION /begin DEF_CHARACTERISTIC /end DEF_CHARACTERISTIC /begin IN_MEASUREMENT /end IN_MEASUREMENT /begin OUT_MEASUREMENT /end OUT_MEASUREMENT /end FUNCTION
/begin FUNCTION VMCMSACtrlAvail "" /begin SUB_FUNCTION Data_Type_Conversion /end SUB_FUNCTION /begin DEF_CHARACTERISTIC /end DEF_CHARACTERISTIC /begin IN_MEASUREMENT /end IN_MEASUREMENT /begin OUT_MEASUREMENT /end OUT_MEASUREMENT /end FUNCTION
/begin FUNCTION VMCVCUACCCtrlAvail "" /begin SUB_FUNCTION Data_Type_Conversion /end SUB_FUNCTION /begin DEF_CHARACTERISTIC /end DEF_CHARACTERISTIC /begin IN_MEASUREMENT /end IN_MEASUREMENT /begin OUT_MEASUREMENT /end OUT_MEASUREMENT /end FUNCTION
/begin FUNCTION VMCVCUAPSCtrlAvailflg "" /begin SUB_FUNCTION Data_Type_Conversion /end SUB_FUNCTION /begin DEF_CHARACTERISTIC /end DEF_CHARACTERISTIC /begin IN_MEASUREMENT /end IN_MEASUREMENT /begin OUT_MEASUREMENT /end OUT_MEASUREMENT /end FUNCTION
/begin FUNCTION VMCVCUAccPedalOverride "" /begin SUB_FUNCTION Data_Type_Conversion /end SUB_FUNCTION /begin DEF_CHARACTERISTIC /end DEF_CHARACTERISTIC /begin IN_MEASUREMENT /end IN_MEASUREMENT /begin OUT_MEASUREMENT /end OUT_MEASUREMENT /end FUNCTION
/begin FUNCTION VMCVCUCCCrlSta "" /begin SUB_FUNCTION /end SUB_FUNCTION /begin DEF_CHARACTERISTIC /end DEF_CHARACTERISTIC /begin IN_MEASUREMENT /end IN_MEASUREMENT /begin OUT_MEASUREMENT /end OUT_MEASUREMENT /end FUNCTION
/begin FUNCTION VMCVCUMSACrlSta "" /begin SUB_FUNCTION /end SUB_FUNCTION /begin DEF_CHARACTERISTIC /end DEF_CHARACTERISTIC /begin IN_MEASUREMENT /end IN_MEASUREMENT /begin OUT_MEASUREMENT /end OUT_MEASUREMENT /end FUNCTION
/begin FUNCTION VehicleSpeedkph "" /begin SUB_FUNCTION convert_out Data_Type_Conversion /end SUB_FUNCTION /begin DEF_CHARACTERISTIC /end DEF_CHARACTERISTIC /begin IN_MEASUREMENT /end IN_MEASUREMENT /begin OUT_MEASUREMENT /end OUT_MEASUREMENT /end FUNCTION
/begin FUNCTION VehicleSpeedmph "" /begin SUB_FUNCTION convert_out Data_Type_Conversion /end SUB_FUNCTION /begin DEF_CHARACTERISTIC /end DEF_CHARACTERISTIC /begin IN_MEASUREMENT /end IN_MEASUREMENT /begin OUT_MEASUREMENT /end OUT_MEASUREMENT /end FUNCTION
/begin FUNCTION bus_creator "" /begin DEF_CHARACTERISTIC /end DEF_CHARACTERISTIC /begin IN_MEASUREMENT /end IN_MEASUREMENT /begin OUT_MEASUREMENT /end OUT_MEASUREMENT /end FUNCTION
/begin RECORD_LAYOUT Scalar_BOOLEAN FNC_VALUES 1 UBYTE COLUMN_DIR DIRECT /end RECORD_LAYOUT
/begin RECORD_LAYOUT Lookup1D_UBYTE FNC_VALUES 1 UBYTE COLUMN_DIR DIRECT /end RECORD_LAYOUT
/begin RECORD_LAYOUT Lookup1D_X_UBYTE AXIS_PTS_X 1 UBYTE INDEX_INCR DIRECT /end RECORD_LAYOUT
/begin CHARACTERISTIC KHAL_CAN3FD3VCU2toNIDECE2E_flg "" VALUE 0 Scalar_BOOLEAN 0 SWC_HALOUT_type_CM_boolean_flg 0.0 1.0 /end CHARACTERISTIC
/begin CHARACTERISTIC KHAL_CAN4FD4CE1000E2E_flg "" VALUE 0 Scalar_BOOLEAN 0 SWC_HALOUT_type_CM_boolean_flg 0.0 1.0 /end CHARACTERISTIC
/begin CHARACTERISTIC KHAL_CAN6FD6APS3E2E_flg "" VALUE 0 Scalar_BOOLEAN 0 SWC_HALOUT_type_CM_boolean_flg 0.0 1.0 /end CHARACTERISTIC
/begin CHARACTERISTIC KHAL_CAN6FD6VCU2E2E_flg "" VALUE 0 Scalar_BOOLEAN 0 SWC_HALOUT_type_CM_boolean_flg 0.0 1.0 /end CHARACTERISTIC
/begin COMPU_METHOD SWC_HALOUT_type_CM_boolean_flg "Q = V" RAT_FUNC "%1.0" "flg" COEFFS 0 1 0 0 0 1 /end COMPU_METHOD
/begin GROUP S41_FD3_VCU2_toNIDEC_0x154 "SWC_HALOUT_type/run_SWC_HALOUT_Tx_5ms_sys/HAL_OUT/CAN3/FD3_VCU2_toNIDEC_0x154" /begin REF_CHARACTERISTIC KHAL_CAN3FD3VCU2toNIDECE2E_flg /end REF_CHARACTERISTIC /end GROUP
/begin GROUP S42_FD4_CE100_0_0x116 "SWC_HALOUT_type/run_SWC_HALOUT_Tx_5ms_sys/HAL_OUT/CAN4/FD4_CE100_0_0x116" /begin REF_CHARACTERISTIC KHAL_CAN4FD4CE1000E2E_flg /end REF_CHARACTERISTIC /end GROUP
/begin GROUP S44_FD6_APS3_0x238 "SWC_HALOUT_type/run_SWC_HALOUT_Tx_5ms_sys/HAL_OUT/CAN6/FD6_APS3_0x238" /begin REF_CHARACTERISTIC KHAL_CAN6FD6APS3E2E_flg /end REF_CHARACTERISTIC /end GROUP
/begin GROUP S44_FD6_VCU2_0x154 "SWC_HALOUT_type/run_SWC_HALOUT_Tx_5ms_sys/HAL_OUT/CAN6/FD6_VCU2_0x154" /begin REF_CHARACTERISTIC KHAL_CAN6FD6VCU2E2E_flg /end REF_CHARACTERISTIC /end GROUP
/end MODULE
/end PROJECT
