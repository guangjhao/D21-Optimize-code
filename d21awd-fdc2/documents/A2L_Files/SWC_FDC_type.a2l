ASAP2_VERSION 1 31
/begin PROJECT ProjectName "Project Comment Goes Here"
/begin HEADER "Header Comments go here" /end HEADER
/begin MODULE ModuleName "Module Comment Goes Here"
/begin MOD_COMMON "Mod Common Comment Here" BYTE_ORDER MSB_LAST /end MOD_COMMON
/begin RECORD_LAYOUT Scalar_BOOLEAN FNC_VALUES 1 UBYTE COLUMN_DIR DIRECT /end RECORD_LAYOUT
/begin RECORD_LAYOUT Scalar_UBYTE FNC_VALUES 1 UBYTE COLUMN_DIR DIRECT /end RECORD_LAYOUT
/begin RECORD_LAYOUT Scalar_FLOAT32_IEEE FNC_VALUES 1 FLOAT32_IEEE COLUMN_DIR DIRECT /end RECORD_LAYOUT
/begin RECORD_LAYOUT Lookup1D_FLOAT32_IEEE FNC_VALUES 1 FLOAT32_IEEE COLUMN_DIR DIRECT /end RECORD_LAYOUT
/begin RECORD_LAYOUT Lookup1D_X_FLOAT32_IEEE AXIS_PTS_X 1 FLOAT32_IEEE INDEX_INCR DIRECT /end RECORD_LAYOUT
/begin RECORD_LAYOUT Lookup2D_BOOLEAN FNC_VALUES 1 UBYTE COLUMN_DIR DIRECT /end RECORD_LAYOUT
/begin RECORD_LAYOUT Lookup2D_X_BOOLEAN AXIS_PTS_X 1 UBYTE INDEX_INCR DIRECT /end RECORD_LAYOUT
/begin RECORD_LAYOUT Lookup2D_BYTE FNC_VALUES 1 SBYTE COLUMN_DIR DIRECT /end RECORD_LAYOUT
/begin RECORD_LAYOUT Lookup2D_X_BYTE AXIS_PTS_X 1 SBYTE INDEX_INCR DIRECT /end RECORD_LAYOUT
/begin RECORD_LAYOUT Lookup2D_UWORD FNC_VALUES 1 UWORD COLUMN_DIR DIRECT /end RECORD_LAYOUT
/begin RECORD_LAYOUT Lookup2D_X_UWORD AXIS_PTS_X 1 UWORD INDEX_INCR DIRECT /end RECORD_LAYOUT
/begin RECORD_LAYOUT Lookup2D_FLOAT32_IEEE FNC_VALUES 1 FLOAT32_IEEE COLUMN_DIR DIRECT /end RECORD_LAYOUT
/begin RECORD_LAYOUT Lookup2D_X_FLOAT32_IEEE AXIS_PTS_X 1 FLOAT32_IEEE INDEX_INCR DIRECT /end RECORD_LAYOUT
/begin CHARACTERISTIC MTQD_FrLossMAPHighV_Z_kw "" MAP 0x0000 /* @ECU_Address@MTQD_FrLossMAPHighV_Z_kw@ */ Lookup2D_FLOAT32_IEEE 0 SWC_FDC_type_CM_single_kw -200.0 200.0
 /begin AXIS_DESCR COM_AXIS VTQD_FrShaftSpd_rpm SWC_FDC_type_CM_single_rpm 28 -100000.0 100000.0 AXIS_PTS_REF ATQD_FrLossMAPLowV_X_rpm /end AXIS_DESCR
 /begin AXIS_DESCR COM_AXIS VTQD_CoordWhlTqDemFr_Nm SWC_FDC_type_CM_single_Nm 29 -100000.0 100000.0 AXIS_PTS_REF ATQD_FrLossMAPLowV_Y_Nm /end AXIS_DESCR
/end CHARACTERISTIC
/begin AXIS_PTS ATQD_FrLossMAPLowV_Y_Nm "" 0x0000 /* @ECU_Address@ATQD_FrLossMAPLowV_Y_Nm@ */ VTQD_CoordWhlTqDemFr_Nm Lookup2D_X_FLOAT32_IEEE 0 SWC_FDC_type_CM_single_Nm 29 -100000.0 100000.0 /end AXIS_PTS
/begin AXIS_PTS ATQD_FrLossMAPLowV_X_rpm "" 0x0000 /* @ECU_Address@ATQD_FrLossMAPLowV_X_rpm@ */ VTQD_FrShaftSpd_rpm Lookup2D_X_FLOAT32_IEEE 0 SWC_FDC_type_CM_single_rpm 28 -100000.0 100000.0 /end AXIS_PTS
/begin CHARACTERISTIC MTQD_FrLossMAPLowV_Z_kw "" MAP 0x0000 /* @ECU_Address@MTQD_FrLossMAPLowV_Z_kw@ */ Lookup2D_FLOAT32_IEEE 0 SWC_FDC_type_CM_single_kw -200.0 200.0
 /begin AXIS_DESCR COM_AXIS VTQD_FrShaftSpd_rpm SWC_FDC_type_CM_single_rpm 28 -100000.0 100000.0 AXIS_PTS_REF ATQD_FrLossMAPLowV_X_rpm /end AXIS_DESCR
 /begin AXIS_DESCR COM_AXIS VTQD_CoordWhlTqDemFr_Nm SWC_FDC_type_CM_single_Nm 29 -100000.0 100000.0 AXIS_PTS_REF ATQD_FrLossMAPLowV_Y_Nm /end AXIS_DESCR
/end CHARACTERISTIC
/begin CHARACTERISTIC MTQD_RrLossMAPHighV_Z_kw "" MAP 0x0000 /* @ECU_Address@MTQD_RrLossMAPHighV_Z_kw@ */ Lookup2D_FLOAT32_IEEE 0 SWC_FDC_type_CM_single_kw -200.0 200.0
 /begin AXIS_DESCR COM_AXIS VTQD_RrShaftSpd_rpm SWC_FDC_type_CM_single_rpm 28 -100000.0 100000.0 AXIS_PTS_REF ATQD_RrLossMAPLowV_X_rpm /end AXIS_DESCR
 /begin AXIS_DESCR COM_AXIS VTQD_CoordWhlTqDemRr_Nm SWC_FDC_type_CM_single_Nm 29 -100000.0 100000.0 AXIS_PTS_REF ATQD_RrLossMAPLowV_Y_Nm /end AXIS_DESCR
/end CHARACTERISTIC
/begin AXIS_PTS ATQD_RrLossMAPLowV_Y_Nm "" 0x0000 /* @ECU_Address@ATQD_RrLossMAPLowV_Y_Nm@ */ VTQD_CoordWhlTqDemRr_Nm Lookup2D_X_FLOAT32_IEEE 0 SWC_FDC_type_CM_single_Nm 29 -100000.0 100000.0 /end AXIS_PTS
/begin AXIS_PTS ATQD_RrLossMAPLowV_X_rpm "" 0x0000 /* @ECU_Address@ATQD_RrLossMAPLowV_X_rpm@ */ VTQD_RrShaftSpd_rpm Lookup2D_X_FLOAT32_IEEE 0 SWC_FDC_type_CM_single_rpm 28 -100000.0 100000.0 /end AXIS_PTS
/begin CHARACTERISTIC MTQD_RrLossMAPLowV_Z_kw "" MAP 0x0000 /* @ECU_Address@MTQD_RrLossMAPLowV_Z_kw@ */ Lookup2D_FLOAT32_IEEE 0 SWC_FDC_type_CM_single_kw -200.0 200.0
 /begin AXIS_DESCR COM_AXIS VTQD_RrShaftSpd_rpm SWC_FDC_type_CM_single_rpm 28 -100000.0 100000.0 AXIS_PTS_REF ATQD_RrLossMAPLowV_X_rpm /end AXIS_DESCR
 /begin AXIS_DESCR COM_AXIS VTQD_CoordWhlTqDemRr_Nm SWC_FDC_type_CM_single_Nm 29 -100000.0 100000.0 AXIS_PTS_REF ATQD_RrLossMAPLowV_Y_Nm /end AXIS_DESCR
/end CHARACTERISTIC
/begin CHARACTERISTIC MTQD_CreepItermMaxLimit_Y_Nm "" CURVE 0x0000 /* @ECU_Address@MTQD_CreepItermMaxLimit_Y_Nm@ */ Lookup1D_FLOAT32_IEEE 0 SWC_FDC_type_CM_single_s -100000.0 100000.0
 /begin AXIS_DESCR COM_AXIS VTQD_ActBPSPosn_pct SWC_FDC_type_CM_single_pct 17 0.0 125.0 AXIS_PTS_REF ATQD_CreepItermMaxLimit_X_pct /end AXIS_DESCR
/end CHARACTERISTIC
/begin AXIS_PTS ATQD_CreepItermMaxLimit_X_pct "" 0x0000 /* @ECU_Address@ATQD_CreepItermMaxLimit_X_pct@ */ VTQD_ActBPSPosn_pct Lookup1D_X_FLOAT32_IEEE 0 SWC_FDC_type_CM_single_pct 17 0.0 125.0 /end AXIS_PTS
/begin CHARACTERISTIC MTQD_FrPreLoadTq_Y_Nm "" CURVE 0x0000 /* @ECU_Address@MTQD_FrPreLoadTq_Y_Nm@ */ Lookup1D_FLOAT32_IEEE 0 SWC_FDC_type_CM_single_Nm -1000.0 1000.0
 /begin AXIS_DESCR COM_AXIS VTQD_PreLoadHoldtime_s SWC_FDC_type_CM_single_s 10 0.0 3600.0 AXIS_PTS_REF ATQD_FrPreLoadTq_X_s /end AXIS_DESCR
/end CHARACTERISTIC
/begin AXIS_PTS ATQD_FrPreLoadTq_X_s "" 0x0000 /* @ECU_Address@ATQD_FrPreLoadTq_X_s@ */ VTQD_PreLoadHoldtime_s Lookup1D_X_FLOAT32_IEEE 0 SWC_FDC_type_CM_single_s 10 0.0 3600.0 /end AXIS_PTS
/begin CHARACTERISTIC MTQD_RrPreLoadTq_Y_Nm "" CURVE 0x0000 /* @ECU_Address@MTQD_RrPreLoadTq_Y_Nm@ */ Lookup1D_FLOAT32_IEEE 0 SWC_FDC_type_CM_single_Nm -1000.0 1000.0
 /begin AXIS_DESCR COM_AXIS VTQD_PreLoadHoldtime_s SWC_FDC_type_CM_single_s 10 0.0 3600.0 AXIS_PTS_REF ATQD_FrPreLoadTq_X_s /end AXIS_DESCR
/end CHARACTERISTIC
/begin CHARACTERISTIC MTQD_LHMGrade2TqUpLim_Z_Nm "" MAP 0x0000 /* @ECU_Address@MTQD_LHMGrade2TqUpLim_Z_Nm@ */ Lookup2D_FLOAT32_IEEE 0 SWC_FDC_type_CM_single_Nm -100000.0 100000.0
 /begin AXIS_DESCR COM_AXIS VTQD_VehActSpd_kph SWC_FDC_type_CM_single_kph 17 -300.0 300.0 AXIS_PTS_REF ATQD_LHMGrade2TqUpLim_X_kph /end AXIS_DESCR
 /begin AXIS_DESCR COM_AXIS NO_INPUT_QUANTITY SWC_FDC_type_CM_single_Deg 15 -180.0 180.0 AXIS_PTS_REF ATQD_LHMGrade2TqUpLim_Y_Deg /end AXIS_DESCR
/end CHARACTERISTIC
/begin AXIS_PTS ATQD_LHMGrade2TqUpLim_Y_Deg "" 0x0000 /* @ECU_Address@ATQD_LHMGrade2TqUpLim_Y_Deg@ */ NO_INPUT_QUANTITY Lookup2D_X_FLOAT32_IEEE 0 SWC_FDC_type_CM_single_Deg 15 -180.0 180.0 /end AXIS_PTS
/begin AXIS_PTS ATQD_LHMGrade2TqUpLim_X_kph "" 0x0000 /* @ECU_Address@ATQD_LHMGrade2TqUpLim_X_kph@ */ VTQD_VehActSpd_kph Lookup2D_X_FLOAT32_IEEE 0 SWC_FDC_type_CM_single_kph 17 -300.0 300.0 /end AXIS_PTS
/begin CHARACTERISTIC MTQD_NL1TqMapD_Z_Nm "" MAP 0x0000 /* @ECU_Address@MTQD_NL1TqMapD_Z_Nm@ */ Lookup2D_FLOAT32_IEEE 0 SWC_FDC_type_CM_single_Nm -100000.0 100000.0
 /begin AXIS_DESCR COM_AXIS VTQD_TqTargetShaftSpd_rpm SWC_FDC_type_CM_single_rpm 42 -100000.0 100000.0 AXIS_PTS_REF ATQD_NL1TqMapD_X_rpm /end AXIS_DESCR
 /begin AXIS_DESCR COM_AXIS VTQD_ActAPSPosn_pct SWC_FDC_type_CM_single_pct 35 0.0 110.0 AXIS_PTS_REF ATQD_NL1TqMapD_Y_pct /end AXIS_DESCR
/end CHARACTERISTIC
/begin AXIS_PTS ATQD_NL1TqMapD_Y_pct "" 0x0000 /* @ECU_Address@ATQD_NL1TqMapD_Y_pct@ */ VTQD_ActAPSPosn_pct Lookup2D_X_FLOAT32_IEEE 0 SWC_FDC_type_CM_single_pct 35 0.0 110.0 /end AXIS_PTS
/begin AXIS_PTS ATQD_NL1TqMapD_X_rpm "" 0x0000 /* @ECU_Address@ATQD_NL1TqMapD_X_rpm@ */ VTQD_TqTargetShaftSpd_rpm Lookup2D_X_FLOAT32_IEEE 0 SWC_FDC_type_CM_single_rpm 42 -100000.0 100000.0 /end AXIS_PTS
/begin CHARACTERISTIC MTQD_NRMTqMapR_Z_Nm "" MAP 0x0000 /* @ECU_Address@MTQD_NRMTqMapR_Z_Nm@ */ Lookup2D_FLOAT32_IEEE 0 SWC_FDC_type_CM_single_Nm -100000.0 100000.0
 /begin AXIS_DESCR COM_AXIS VTQD_TqTargetShaftSpd_rpm SWC_FDC_type_CM_single_rpm 42 -100000.0 100000.0 AXIS_PTS_REF ATQD_NL1TqMapD_X_rpm /end AXIS_DESCR
 /begin AXIS_DESCR COM_AXIS VTQD_ActAPSPosn_pct SWC_FDC_type_CM_single_pct 35 0.0 110.0 AXIS_PTS_REF ATQD_NL1TqMapD_Y_pct /end AXIS_DESCR
/end CHARACTERISTIC
/begin CHARACTERISTIC MTQR_ESCAPEFEDUTs_Z_c "" MAP 0x0000 /* @ECU_Address@MTQR_ESCAPEFEDUTs_Z_c@ */ Lookup2D_FLOAT32_IEEE 0 SWC_FDC_type_CM_single_c 0.0 1.0
 /begin AXIS_DESCR COM_AXIS NO_INPUT_QUANTITY SWC_FDC_type_CM_single_rpm 24 -100000.0 100000.0 AXIS_PTS_REF ATQR_NL1FEDUTs_X_rpm /end AXIS_DESCR
 /begin AXIS_DESCR COM_AXIS VTQR_FEDUWhlTqReqSmoothDelay_Nm SWC_FDC_type_CM_single_Nm 18 -10000.0 10000.0 AXIS_PTS_REF ATQR_NL1FEDUTs_Y_Nm /end AXIS_DESCR
/end CHARACTERISTIC
/begin AXIS_PTS ATQR_NL1FEDUTs_Y_Nm "" 0x0000 /* @ECU_Address@ATQR_NL1FEDUTs_Y_Nm@ */ VTQR_FEDUWhlTqReqSmoothDelay_Nm Lookup2D_X_FLOAT32_IEEE 0 SWC_FDC_type_CM_single_Nm 18 -10000.0 10000.0 /end AXIS_PTS
/begin AXIS_PTS ATQR_NL1FEDUTs_X_rpm "" 0x0000 /* @ECU_Address@ATQR_NL1FEDUTs_X_rpm@ */ NO_INPUT_QUANTITY Lookup2D_X_FLOAT32_IEEE 0 SWC_FDC_type_CM_single_rpm 24 -100000.0 100000.0 /end AXIS_PTS
/begin CHARACTERISTIC MTQR_LHMFEDUTs_Z_c "" MAP 0x0000 /* @ECU_Address@MTQR_LHMFEDUTs_Z_c@ */ Lookup2D_FLOAT32_IEEE 0 SWC_FDC_type_CM_single_c 0.0 1.0
 /begin AXIS_DESCR COM_AXIS NO_INPUT_QUANTITY SWC_FDC_type_CM_single_rpm 24 -100000.0 100000.0 AXIS_PTS_REF ATQR_NL1FEDUTs_X_rpm /end AXIS_DESCR
 /begin AXIS_DESCR COM_AXIS VTQR_FEDUWhlTqReqSmoothDelay_Nm SWC_FDC_type_CM_single_Nm 18 -10000.0 10000.0 AXIS_PTS_REF ATQR_NL1FEDUTs_Y_Nm /end AXIS_DESCR
/end CHARACTERISTIC
/begin CHARACTERISTIC MTQR_SNOWFEDUTs_Z_c "" MAP 0x0000 /* @ECU_Address@MTQR_SNOWFEDUTs_Z_c@ */ Lookup2D_FLOAT32_IEEE 0 SWC_FDC_type_CM_single_c 0.0 1.0
 /begin AXIS_DESCR COM_AXIS NO_INPUT_QUANTITY SWC_FDC_type_CM_single_rpm 24 -100000.0 100000.0 AXIS_PTS_REF ATQR_NL1FEDUTs_X_rpm /end AXIS_DESCR
 /begin AXIS_DESCR COM_AXIS VTQR_FEDUWhlTqReqSmoothDelay_Nm SWC_FDC_type_CM_single_Nm 18 -10000.0 10000.0 AXIS_PTS_REF ATQR_NL1FEDUTs_Y_Nm /end AXIS_DESCR
/end CHARACTERISTIC
/begin CHARACTERISTIC MTQR_TCSFEDUTs_Z_c "" MAP 0x0000 /* @ECU_Address@MTQR_TCSFEDUTs_Z_c@ */ Lookup2D_FLOAT32_IEEE 0 SWC_FDC_type_CM_single_c 0.0 1.0
 /begin AXIS_DESCR COM_AXIS NO_INPUT_QUANTITY SWC_FDC_type_CM_single_rpm 24 -100000.0 100000.0 AXIS_PTS_REF ATQR_NL1FEDUTs_X_rpm /end AXIS_DESCR
 /begin AXIS_DESCR COM_AXIS VTQR_FEDUWhlTqReqSmoothDelay_Nm SWC_FDC_type_CM_single_Nm 18 -10000.0 10000.0 AXIS_PTS_REF ATQR_NL1FEDUTs_Y_Nm /end AXIS_DESCR
/end CHARACTERISTIC
/begin CHARACTERISTIC MTQR_FTqZeroTransLowBoundE_Y_Nm "" CURVE 0x0000 /* @ECU_Address@MTQR_FTqZeroTransLowBoundE_Y_Nm@ */ Lookup1D_FLOAT32_IEEE 0 SWC_FDC_type_CM_single_Nm -150.0 0.0
 /begin AXIS_DESCR COM_AXIS NO_INPUT_QUANTITY SWC_FDC_type_CM_single_rpm 16 -100000.0 100000.0 AXIS_PTS_REF ATQR_FTqZeroTransUpBoundN_X_rpm /end AXIS_DESCR
/end CHARACTERISTIC
/begin AXIS_PTS ATQR_FTqZeroTransUpBoundN_X_rpm "" 0x0000 /* @ECU_Address@ATQR_FTqZeroTransUpBoundN_X_rpm@ */ NO_INPUT_QUANTITY Lookup1D_X_FLOAT32_IEEE 0 SWC_FDC_type_CM_single_rpm 16 -100000.0 100000.0 /end AXIS_PTS
/begin CHARACTERISTIC MTQR_FTqZeroTransUpBoundE_Y_Nm "" CURVE 0x0000 /* @ECU_Address@MTQR_FTqZeroTransUpBoundE_Y_Nm@ */ Lookup1D_FLOAT32_IEEE 0 SWC_FDC_type_CM_single_Nm 0.0 150.0
 /begin AXIS_DESCR COM_AXIS NO_INPUT_QUANTITY SWC_FDC_type_CM_single_rpm 16 -100000.0 100000.0 AXIS_PTS_REF ATQR_FTqZeroTransUpBoundN_X_rpm /end AXIS_DESCR
/end CHARACTERISTIC
/begin CHARACTERISTIC MTQR_FTqZeroTransLowBoundN_Y_Nm "" CURVE 0x0000 /* @ECU_Address@MTQR_FTqZeroTransLowBoundN_Y_Nm@ */ Lookup1D_FLOAT32_IEEE 0 SWC_FDC_type_CM_single_Nm -150.0 0.0
 /begin AXIS_DESCR COM_AXIS NO_INPUT_QUANTITY SWC_FDC_type_CM_single_rpm 16 -100000.0 100000.0 AXIS_PTS_REF ATQR_FTqZeroTransUpBoundN_X_rpm /end AXIS_DESCR
/end CHARACTERISTIC
/begin CHARACTERISTIC MTQR_FTqZeroTransUpBoundN_Y_Nm "" CURVE 0x0000 /* @ECU_Address@MTQR_FTqZeroTransUpBoundN_Y_Nm@ */ Lookup1D_FLOAT32_IEEE 0 SWC_FDC_type_CM_single_Nm 0.0 150.0
 /begin AXIS_DESCR COM_AXIS NO_INPUT_QUANTITY SWC_FDC_type_CM_single_rpm 16 -100000.0 100000.0 AXIS_PTS_REF ATQR_FTqZeroTransUpBoundN_X_rpm /end AXIS_DESCR
/end CHARACTERISTIC
/begin CHARACTERISTIC MTQR_FTqZeroTransLowBoundS_Y_Nm "" CURVE 0x0000 /* @ECU_Address@MTQR_FTqZeroTransLowBoundS_Y_Nm@ */ Lookup1D_FLOAT32_IEEE 0 SWC_FDC_type_CM_single_Nm -150.0 0.0
 /begin AXIS_DESCR COM_AXIS NO_INPUT_QUANTITY SWC_FDC_type_CM_single_rpm 16 -100000.0 100000.0 AXIS_PTS_REF ATQR_FTqZeroTransUpBoundN_X_rpm /end AXIS_DESCR
/end CHARACTERISTIC
/begin CHARACTERISTIC MTQR_FTqZeroTransUpBoundS_Y_Nm "" CURVE 0x0000 /* @ECU_Address@MTQR_FTqZeroTransUpBoundS_Y_Nm@ */ Lookup1D_FLOAT32_IEEE 0 SWC_FDC_type_CM_single_Nm 0.0 150.0
 /begin AXIS_DESCR COM_AXIS NO_INPUT_QUANTITY SWC_FDC_type_CM_single_rpm 16 -100000.0 100000.0 AXIS_PTS_REF ATQR_FTqZeroTransUpBoundN_X_rpm /end AXIS_DESCR
/end CHARACTERISTIC
/begin CHARACTERISTIC MTQR_ECO2TqFrIncGain_Z_c "" MAP 0x0000 /* @ECU_Address@MTQR_ECO2TqFrIncGain_Z_c@ */ Lookup2D_FLOAT32_IEEE 0 SWC_FDC_type_CM_single_c 0.0 300.0
 /begin AXIS_DESCR COM_AXIS VTQR_FEDUWhlTqReqSmoothDelay_Nm SWC_FDC_type_CM_single_Nm 20 -100000.0 100000.0 AXIS_PTS_REF ATQR_ECO2TqFrIncGain_X_Nm /end AXIS_DESCR
 /begin AXIS_DESCR COM_AXIS NO_INPUT_QUANTITY SWC_FDC_type_CM_single_pct 17 -125.0 125.0 AXIS_PTS_REF ATQR_ECO2TqFrIncGain_Y_pct /end AXIS_DESCR
/end CHARACTERISTIC
/begin AXIS_PTS ATQR_ECO2TqFrIncGain_Y_pct "" 0x0000 /* @ECU_Address@ATQR_ECO2TqFrIncGain_Y_pct@ */ NO_INPUT_QUANTITY Lookup2D_X_FLOAT32_IEEE 0 SWC_FDC_type_CM_single_pct 17 -125.0 125.0 /end AXIS_PTS
/begin AXIS_PTS ATQR_ECO2TqFrIncGain_X_Nm "" 0x0000 /* @ECU_Address@ATQR_ECO2TqFrIncGain_X_Nm@ */ VTQR_FEDUWhlTqReqSmoothDelay_Nm Lookup2D_X_FLOAT32_IEEE 0 SWC_FDC_type_CM_single_Nm 20 -100000.0 100000.0 /end AXIS_PTS
/begin CHARACTERISTIC MTQR_ECO3TqFrIncGain_Z_c "" MAP 0x0000 /* @ECU_Address@MTQR_ECO3TqFrIncGain_Z_c@ */ Lookup2D_FLOAT32_IEEE 0 SWC_FDC_type_CM_single_c 0.0 300.0
 /begin AXIS_DESCR COM_AXIS VTQR_FEDUWhlTqReqSmoothDelay_Nm SWC_FDC_type_CM_single_Nm 20 -100000.0 100000.0 AXIS_PTS_REF ATQR_ECO2TqFrIncGain_X_Nm /end AXIS_DESCR
 /begin AXIS_DESCR COM_AXIS NO_INPUT_QUANTITY SWC_FDC_type_CM_single_pct 17 -125.0 125.0 AXIS_PTS_REF ATQR_ECO2TqFrIncGain_Y_pct /end AXIS_DESCR
/end CHARACTERISTIC
/begin CHARACTERISTIC MTQR_ECO4TqFrIncGain_Z_c "" MAP 0x0000 /* @ECU_Address@MTQR_ECO4TqFrIncGain_Z_c@ */ Lookup2D_FLOAT32_IEEE 0 SWC_FDC_type_CM_single_c 0.0 300.0
 /begin AXIS_DESCR COM_AXIS VTQR_FEDUWhlTqReqSmoothDelay_Nm SWC_FDC_type_CM_single_Nm 20 -100000.0 100000.0 AXIS_PTS_REF ATQR_ECO2TqFrIncGain_X_Nm /end AXIS_DESCR
 /begin AXIS_DESCR COM_AXIS NO_INPUT_QUANTITY SWC_FDC_type_CM_single_pct 17 -125.0 125.0 AXIS_PTS_REF ATQR_ECO2TqFrIncGain_Y_pct /end AXIS_DESCR
/end CHARACTERISTIC
/begin CHARACTERISTIC MTQR_ECO5TqFrIncGain_Z_c "" MAP 0x0000 /* @ECU_Address@MTQR_ECO5TqFrIncGain_Z_c@ */ Lookup2D_FLOAT32_IEEE 0 SWC_FDC_type_CM_single_c 0.0 300.0
 /begin AXIS_DESCR COM_AXIS VTQR_FEDUWhlTqReqSmoothDelay_Nm SWC_FDC_type_CM_single_Nm 20 -100000.0 100000.0 AXIS_PTS_REF ATQR_ECO2TqFrIncGain_X_Nm /end AXIS_DESCR
 /begin AXIS_DESCR COM_AXIS NO_INPUT_QUANTITY SWC_FDC_type_CM_single_pct 17 -125.0 125.0 AXIS_PTS_REF ATQR_ECO2TqFrIncGain_Y_pct /end AXIS_DESCR
/end CHARACTERISTIC
/begin CHARACTERISTIC MTQR_ECOOPDTqFrIncGain_Z_c "" MAP 0x0000 /* @ECU_Address@MTQR_ECOOPDTqFrIncGain_Z_c@ */ Lookup2D_FLOAT32_IEEE 0 SWC_FDC_type_CM_single_c 0.0 300.0
 /begin AXIS_DESCR COM_AXIS VTQR_FEDUWhlTqReqSmoothDelay_Nm SWC_FDC_type_CM_single_Nm 20 -100000.0 100000.0 AXIS_PTS_REF ATQR_ECO2TqFrIncGain_X_Nm /end AXIS_DESCR
 /begin AXIS_DESCR COM_AXIS NO_INPUT_QUANTITY SWC_FDC_type_CM_single_pct 17 -125.0 125.0 AXIS_PTS_REF ATQR_ECO2TqFrIncGain_Y_pct /end AXIS_DESCR
/end CHARACTERISTIC
/begin CHARACTERISTIC MTQR_EcoTqFrIncGain_Z_c "" MAP 0x0000 /* @ECU_Address@MTQR_EcoTqFrIncGain_Z_c@ */ Lookup2D_FLOAT32_IEEE 0 SWC_FDC_type_CM_single_c 0.0 300.0
 /begin AXIS_DESCR COM_AXIS VTQR_FEDUWhlTqReqSmoothDelay_Nm SWC_FDC_type_CM_single_Nm 24 -100000.0 100000.0 AXIS_PTS_REF ATQR_EcoTqFrIncGain_X_Nm /end AXIS_DESCR
 /begin AXIS_DESCR COM_AXIS NO_INPUT_QUANTITY SWC_FDC_type_CM_single_pct 17 -125.0 125.0 AXIS_PTS_REF ATQR_EcoTqFrIncGain_Y_pct /end AXIS_DESCR
/end CHARACTERISTIC
/begin AXIS_PTS ATQR_EcoTqFrIncGain_Y_pct "" 0x0000 /* @ECU_Address@ATQR_EcoTqFrIncGain_Y_pct@ */ NO_INPUT_QUANTITY Lookup2D_X_FLOAT32_IEEE 0 SWC_FDC_type_CM_single_pct 17 -125.0 125.0 /end AXIS_PTS
/begin AXIS_PTS ATQR_EcoTqFrIncGain_X_Nm "" 0x0000 /* @ECU_Address@ATQR_EcoTqFrIncGain_X_Nm@ */ VTQR_FEDUWhlTqReqSmoothDelay_Nm Lookup2D_X_FLOAT32_IEEE 0 SWC_FDC_type_CM_single_Nm 24 -100000.0 100000.0 /end AXIS_PTS
/begin CHARACTERISTIC MTQR_ESCAPEFEDUTqDecSR_Z_Nm "" MAP 0x0000 /* @ECU_Address@MTQR_ESCAPEFEDUTqDecSR_Z_Nm@ */ Lookup2D_FLOAT32_IEEE 0 SWC_FDC_type_CM_single_Nm -100000.0 0.0
 /begin AXIS_DESCR COM_AXIS NO_INPUT_QUANTITY SWC_FDC_type_CM_single_rpm 24 -100000.0 100000.0 AXIS_PTS_REF ATQR_NL1FEDUTqIncSR_X_rpm /end AXIS_DESCR
 /begin AXIS_DESCR COM_AXIS VTQR_FEDUWhlTqReqSmoothDelay_Nm SWC_FDC_type_CM_single_Nm 18 -10000.0 10000.0 AXIS_PTS_REF ATQR_NL1REDUTqDecSR_Y_Nm /end AXIS_DESCR
/end CHARACTERISTIC
/begin AXIS_PTS ATQR_NL1REDUTqDecSR_Y_Nm "" 0x0000 /* @ECU_Address@ATQR_NL1REDUTqDecSR_Y_Nm@ */ VTQR_FEDUWhlTqReqSmoothDelay_Nm Lookup2D_X_FLOAT32_IEEE 0 SWC_FDC_type_CM_single_Nm 18 -10000.0 10000.0 /end AXIS_PTS
/begin AXIS_PTS ATQR_NL1FEDUTqIncSR_X_rpm "" 0x0000 /* @ECU_Address@ATQR_NL1FEDUTqIncSR_X_rpm@ */ NO_INPUT_QUANTITY Lookup2D_X_FLOAT32_IEEE 0 SWC_FDC_type_CM_single_rpm 24 -100000.0 100000.0 /end AXIS_PTS
/begin CHARACTERISTIC MTQR_ESCAPEFEDUTqIncSR_Z_Nm "" MAP 0x0000 /* @ECU_Address@MTQR_ESCAPEFEDUTqIncSR_Z_Nm@ */ Lookup2D_FLOAT32_IEEE 0 SWC_FDC_type_CM_single_Nm 0.0 100000.0
 /begin AXIS_DESCR COM_AXIS NO_INPUT_QUANTITY SWC_FDC_type_CM_single_rpm 24 -100000.0 100000.0 AXIS_PTS_REF ATQR_NL1FEDUTqIncSR_X_rpm /end AXIS_DESCR
 /begin AXIS_DESCR COM_AXIS NO_INPUT_QUANTITY SWC_FDC_type_CM_single_Nm 17 0.0 120.0 AXIS_PTS_REF ATQR_NL1FEDUTqIncSR_Y_pct /end AXIS_DESCR
/end CHARACTERISTIC
/begin AXIS_PTS ATQR_NL1FEDUTqIncSR_Y_pct "" 0x0000 /* @ECU_Address@ATQR_NL1FEDUTqIncSR_Y_pct@ */ NO_INPUT_QUANTITY Lookup2D_X_FLOAT32_IEEE 0 SWC_FDC_type_CM_single_Nm 17 0.0 120.0 /end AXIS_PTS
/begin CHARACTERISTIC MTQR_LHMFEDUTqDecSR_Z_Nm "" MAP 0x0000 /* @ECU_Address@MTQR_LHMFEDUTqDecSR_Z_Nm@ */ Lookup2D_FLOAT32_IEEE 0 SWC_FDC_type_CM_single_Nm -100000.0 0.0
 /begin AXIS_DESCR COM_AXIS NO_INPUT_QUANTITY SWC_FDC_type_CM_single_rpm 24 -100000.0 100000.0 AXIS_PTS_REF ATQR_NL1FEDUTqIncSR_X_rpm /end AXIS_DESCR
 /begin AXIS_DESCR COM_AXIS VTQR_FEDUWhlTqReqSmoothDelay_Nm SWC_FDC_type_CM_single_Nm 18 -10000.0 10000.0 AXIS_PTS_REF ATQR_NL1FEDUTqDecSR_Y_Nm /end AXIS_DESCR
/end CHARACTERISTIC
/begin AXIS_PTS ATQR_NL1FEDUTqDecSR_Y_Nm "" 0x0000 /* @ECU_Address@ATQR_NL1FEDUTqDecSR_Y_Nm@ */ VTQR_FEDUWhlTqReqSmoothDelay_Nm Lookup2D_X_FLOAT32_IEEE 0 SWC_FDC_type_CM_single_Nm 18 -10000.0 10000.0 /end AXIS_PTS
/begin CHARACTERISTIC MTQR_LHMFEDUTqIncSR_Z_Nm "" MAP 0x0000 /* @ECU_Address@MTQR_LHMFEDUTqIncSR_Z_Nm@ */ Lookup2D_FLOAT32_IEEE 0 SWC_FDC_type_CM_single_Nm 0.0 100000.0
 /begin AXIS_DESCR COM_AXIS NO_INPUT_QUANTITY SWC_FDC_type_CM_single_rpm 24 -100000.0 100000.0 AXIS_PTS_REF ATQR_NL1FEDUTqIncSR_X_rpm /end AXIS_DESCR
 /begin AXIS_DESCR COM_AXIS NO_INPUT_QUANTITY SWC_FDC_type_CM_single_Nm 17 0.0 120.0 AXIS_PTS_REF ATQR_NL1FEDUTqIncSR_Y_pct /end AXIS_DESCR
/end CHARACTERISTIC
/begin CHARACTERISTIC MTQR_NL2TqFrIncGain_Z_c "" MAP 0x0000 /* @ECU_Address@MTQR_NL2TqFrIncGain_Z_c@ */ Lookup2D_FLOAT32_IEEE 0 SWC_FDC_type_CM_single_c 0.0 300.0
 /begin AXIS_DESCR COM_AXIS VTQR_FEDUWhlTqReqSmoothDelay_Nm SWC_FDC_type_CM_single_Nm 20 -100000.0 100000.0 AXIS_PTS_REF ATQR_NL2TqFrIncGain_X_Nm /end AXIS_DESCR
 /begin AXIS_DESCR COM_AXIS NO_INPUT_QUANTITY SWC_FDC_type_CM_single_pct 17 -125.0 125.0 AXIS_PTS_REF ATQR_NL2TqFrIncGain_Y_pct /end AXIS_DESCR
/end CHARACTERISTIC
/begin AXIS_PTS ATQR_NL2TqFrIncGain_Y_pct "" 0x0000 /* @ECU_Address@ATQR_NL2TqFrIncGain_Y_pct@ */ NO_INPUT_QUANTITY Lookup2D_X_FLOAT32_IEEE 0 SWC_FDC_type_CM_single_pct 17 -125.0 125.0 /end AXIS_PTS
/begin AXIS_PTS ATQR_NL2TqFrIncGain_X_Nm "" 0x0000 /* @ECU_Address@ATQR_NL2TqFrIncGain_X_Nm@ */ VTQR_FEDUWhlTqReqSmoothDelay_Nm Lookup2D_X_FLOAT32_IEEE 0 SWC_FDC_type_CM_single_Nm 20 -100000.0 100000.0 /end AXIS_PTS
/begin CHARACTERISTIC MTQR_NL3TqFrIncGain_Z_c "" MAP 0x0000 /* @ECU_Address@MTQR_NL3TqFrIncGain_Z_c@ */ Lookup2D_FLOAT32_IEEE 0 SWC_FDC_type_CM_single_c 0.0 300.0
 /begin AXIS_DESCR COM_AXIS VTQR_FEDUWhlTqReqSmoothDelay_Nm SWC_FDC_type_CM_single_Nm 20 -100000.0 100000.0 AXIS_PTS_REF ATQR_NL2TqFrIncGain_X_Nm /end AXIS_DESCR
 /begin AXIS_DESCR COM_AXIS NO_INPUT_QUANTITY SWC_FDC_type_CM_single_pct 17 -125.0 125.0 AXIS_PTS_REF ATQR_NL2TqFrIncGain_Y_pct /end AXIS_DESCR
/end CHARACTERISTIC
/begin CHARACTERISTIC MTQR_NL4TqFrIncGain_Z_c "" MAP 0x0000 /* @ECU_Address@MTQR_NL4TqFrIncGain_Z_c@ */ Lookup2D_FLOAT32_IEEE 0 SWC_FDC_type_CM_single_c 0.0 300.0
 /begin AXIS_DESCR COM_AXIS VTQR_FEDUWhlTqReqSmoothDelay_Nm SWC_FDC_type_CM_single_Nm 20 -100000.0 100000.0 AXIS_PTS_REF ATQR_NL2TqFrIncGain_X_Nm /end AXIS_DESCR
 /begin AXIS_DESCR COM_AXIS NO_INPUT_QUANTITY SWC_FDC_type_CM_single_pct 17 -125.0 125.0 AXIS_PTS_REF ATQR_NL2TqFrIncGain_Y_pct /end AXIS_DESCR
/end CHARACTERISTIC
/begin CHARACTERISTIC MTQR_NL5TqFrIncGain_Z_c "" MAP 0x0000 /* @ECU_Address@MTQR_NL5TqFrIncGain_Z_c@ */ Lookup2D_FLOAT32_IEEE 0 SWC_FDC_type_CM_single_c 0.0 300.0
 /begin AXIS_DESCR COM_AXIS VTQR_FEDUWhlTqReqSmoothDelay_Nm SWC_FDC_type_CM_single_Nm 20 -100000.0 100000.0 AXIS_PTS_REF ATQR_NL2TqFrIncGain_X_Nm /end AXIS_DESCR
 /begin AXIS_DESCR COM_AXIS NO_INPUT_QUANTITY SWC_FDC_type_CM_single_pct 17 -125.0 125.0 AXIS_PTS_REF ATQR_NL2TqFrIncGain_Y_pct /end AXIS_DESCR
/end CHARACTERISTIC
/begin CHARACTERISTIC MTQR_NLOPDTqFrIncGain_Z_c "" MAP 0x0000 /* @ECU_Address@MTQR_NLOPDTqFrIncGain_Z_c@ */ Lookup2D_FLOAT32_IEEE 0 SWC_FDC_type_CM_single_c 0.0 300.0
 /begin AXIS_DESCR COM_AXIS VTQR_FEDUWhlTqReqSmoothDelay_Nm SWC_FDC_type_CM_single_Nm 20 -100000.0 100000.0 AXIS_PTS_REF ATQR_NL2TqFrIncGain_X_Nm /end AXIS_DESCR
 /begin AXIS_DESCR COM_AXIS NO_INPUT_QUANTITY SWC_FDC_type_CM_single_pct 17 -125.0 125.0 AXIS_PTS_REF ATQR_NL2TqFrIncGain_Y_pct /end AXIS_DESCR
/end CHARACTERISTIC
/begin CHARACTERISTIC MTQR_NormalTqFrIncGain_Z_c "" MAP 0x0000 /* @ECU_Address@MTQR_NormalTqFrIncGain_Z_c@ */ Lookup2D_FLOAT32_IEEE 0 SWC_FDC_type_CM_single_c 0.0 300.0
 /begin AXIS_DESCR COM_AXIS VTQR_FEDUWhlTqReqSmoothDelay_Nm SWC_FDC_type_CM_single_Nm 24 -100000.0 100000.0 AXIS_PTS_REF ATQR_NormalTqFrIncGain_X_Nm /end AXIS_DESCR
 /begin AXIS_DESCR COM_AXIS NO_INPUT_QUANTITY SWC_FDC_type_CM_single_pct 17 -125.0 125.0 AXIS_PTS_REF ATQR_NormalTqFrIncGain_Y_pct /end AXIS_DESCR
/end CHARACTERISTIC
/begin AXIS_PTS ATQR_NormalTqFrIncGain_Y_pct "" 0x0000 /* @ECU_Address@ATQR_NormalTqFrIncGain_Y_pct@ */ NO_INPUT_QUANTITY Lookup2D_X_FLOAT32_IEEE 0 SWC_FDC_type_CM_single_pct 17 -125.0 125.0 /end AXIS_PTS
/begin AXIS_PTS ATQR_NormalTqFrIncGain_X_Nm "" 0x0000 /* @ECU_Address@ATQR_NormalTqFrIncGain_X_Nm@ */ VTQR_FEDUWhlTqReqSmoothDelay_Nm Lookup2D_X_FLOAT32_IEEE 0 SWC_FDC_type_CM_single_Nm 24 -100000.0 100000.0 /end AXIS_PTS
/begin CHARACTERISTIC MTQR_SNOWFEDUTqDecSR_Z_Nm "" MAP 0x0000 /* @ECU_Address@MTQR_SNOWFEDUTqDecSR_Z_Nm@ */ Lookup2D_FLOAT32_IEEE 0 SWC_FDC_type_CM_single_Nm -100000.0 0.0
 /begin AXIS_DESCR COM_AXIS NO_INPUT_QUANTITY SWC_FDC_type_CM_single_rpm 24 -100000.0 100000.0 AXIS_PTS_REF ATQR_NL1FEDUTqIncSR_X_rpm /end AXIS_DESCR
 /begin AXIS_DESCR COM_AXIS VTQR_FEDUWhlTqReqSmoothDelay_Nm SWC_FDC_type_CM_single_Nm 18 -10000.0 10000.0 AXIS_PTS_REF ATQR_NL1REDUTqDecSR_Y_Nm /end AXIS_DESCR
/end CHARACTERISTIC
/begin CHARACTERISTIC MTQR_SNOWFEDUTqIncSR_Z_Nm "" MAP 0x0000 /* @ECU_Address@MTQR_SNOWFEDUTqIncSR_Z_Nm@ */ Lookup2D_FLOAT32_IEEE 0 SWC_FDC_type_CM_single_Nm 0.0 100000.0
 /begin AXIS_DESCR COM_AXIS NO_INPUT_QUANTITY SWC_FDC_type_CM_single_rpm 24 -100000.0 100000.0 AXIS_PTS_REF ATQR_NL1FEDUTqIncSR_X_rpm /end AXIS_DESCR
 /begin AXIS_DESCR COM_AXIS NO_INPUT_QUANTITY SWC_FDC_type_CM_single_Nm 17 0.0 120.0 AXIS_PTS_REF ATQR_NL1FEDUTqIncSR_Y_pct /end AXIS_DESCR
/end CHARACTERISTIC
/begin CHARACTERISTIC MTQR_SnowMTqFrIncGain_Z_c "" MAP 0x0000 /* @ECU_Address@MTQR_SnowMTqFrIncGain_Z_c@ */ Lookup2D_FLOAT32_IEEE 0 SWC_FDC_type_CM_single_c 0.0 300.0
 /begin AXIS_DESCR COM_AXIS VTQR_FEDUWhlTqReqSmoothDelay_Nm SWC_FDC_type_CM_single_Nm 20 -100000.0 100000.0 AXIS_PTS_REF ATQR_SnowMTqFrIncGain_X_Nm /end AXIS_DESCR
 /begin AXIS_DESCR COM_AXIS NO_INPUT_QUANTITY SWC_FDC_type_CM_single_pct 17 -125.0 125.0 AXIS_PTS_REF ATQR_SnowMTqFrIncGain_Y_pct /end AXIS_DESCR
/end CHARACTERISTIC
/begin AXIS_PTS ATQR_SnowMTqFrIncGain_Y_pct "" 0x0000 /* @ECU_Address@ATQR_SnowMTqFrIncGain_Y_pct@ */ NO_INPUT_QUANTITY Lookup2D_X_FLOAT32_IEEE 0 SWC_FDC_type_CM_single_pct 17 -125.0 125.0 /end AXIS_PTS
/begin AXIS_PTS ATQR_SnowMTqFrIncGain_X_Nm "" 0x0000 /* @ECU_Address@ATQR_SnowMTqFrIncGain_X_Nm@ */ VTQR_FEDUWhlTqReqSmoothDelay_Nm Lookup2D_X_FLOAT32_IEEE 0 SWC_FDC_type_CM_single_Nm 20 -100000.0 100000.0 /end AXIS_PTS
/begin CHARACTERISTIC MTQR_Sport2TqFrIncGain_Z_c "" MAP 0x0000 /* @ECU_Address@MTQR_Sport2TqFrIncGain_Z_c@ */ Lookup2D_FLOAT32_IEEE 0 SWC_FDC_type_CM_single_c 0.0 300.0
 /begin AXIS_DESCR COM_AXIS VTQR_FEDUWhlTqReqSmoothDelay_Nm SWC_FDC_type_CM_single_Nm 20 -100000.0 100000.0 AXIS_PTS_REF ATQR_Sport2TqFrIncGain_X_Nm /end AXIS_DESCR
 /begin AXIS_DESCR COM_AXIS NO_INPUT_QUANTITY SWC_FDC_type_CM_single_pct 17 -125.0 125.0 AXIS_PTS_REF ATQR_Sport2TqFrIncGain_Y_pct /end AXIS_DESCR
/end CHARACTERISTIC
/begin AXIS_PTS ATQR_Sport2TqFrIncGain_Y_pct "" 0x0000 /* @ECU_Address@ATQR_Sport2TqFrIncGain_Y_pct@ */ NO_INPUT_QUANTITY Lookup2D_X_FLOAT32_IEEE 0 SWC_FDC_type_CM_single_pct 17 -125.0 125.0 /end AXIS_PTS
/begin AXIS_PTS ATQR_Sport2TqFrIncGain_X_Nm "" 0x0000 /* @ECU_Address@ATQR_Sport2TqFrIncGain_X_Nm@ */ VTQR_FEDUWhlTqReqSmoothDelay_Nm Lookup2D_X_FLOAT32_IEEE 0 SWC_FDC_type_CM_single_Nm 20 -100000.0 100000.0 /end AXIS_PTS
/begin CHARACTERISTIC MTQR_Sport3TqFrIncGain_Z_c "" MAP 0x0000 /* @ECU_Address@MTQR_Sport3TqFrIncGain_Z_c@ */ Lookup2D_FLOAT32_IEEE 0 SWC_FDC_type_CM_single_c 0.0 300.0
 /begin AXIS_DESCR COM_AXIS VTQR_FEDUWhlTqReqSmoothDelay_Nm SWC_FDC_type_CM_single_Nm 20 -100000.0 100000.0 AXIS_PTS_REF ATQR_Sport2TqFrIncGain_X_Nm /end AXIS_DESCR
 /begin AXIS_DESCR COM_AXIS NO_INPUT_QUANTITY SWC_FDC_type_CM_single_pct 17 -125.0 125.0 AXIS_PTS_REF ATQR_Sport2TqFrIncGain_Y_pct /end AXIS_DESCR
/end CHARACTERISTIC
/begin CHARACTERISTIC MTQR_Sport4TqFrIncGain_Z_c "" MAP 0x0000 /* @ECU_Address@MTQR_Sport4TqFrIncGain_Z_c@ */ Lookup2D_FLOAT32_IEEE 0 SWC_FDC_type_CM_single_c 0.0 300.0
 /begin AXIS_DESCR COM_AXIS VTQR_FEDUWhlTqReqSmoothDelay_Nm SWC_FDC_type_CM_single_Nm 20 -100000.0 100000.0 AXIS_PTS_REF ATQR_Sport2TqFrIncGain_X_Nm /end AXIS_DESCR
 /begin AXIS_DESCR COM_AXIS NO_INPUT_QUANTITY SWC_FDC_type_CM_single_pct 17 -125.0 125.0 AXIS_PTS_REF ATQR_Sport2TqFrIncGain_Y_pct /end AXIS_DESCR
/end CHARACTERISTIC
/begin CHARACTERISTIC MTQR_Sport5TqFrIncGain_Z_c "" MAP 0x0000 /* @ECU_Address@MTQR_Sport5TqFrIncGain_Z_c@ */ Lookup2D_FLOAT32_IEEE 0 SWC_FDC_type_CM_single_c 0.0 300.0
 /begin AXIS_DESCR COM_AXIS VTQR_FEDUWhlTqReqSmoothDelay_Nm SWC_FDC_type_CM_single_Nm 20 -100000.0 100000.0 AXIS_PTS_REF ATQR_Sport2TqFrIncGain_X_Nm /end AXIS_DESCR
 /begin AXIS_DESCR COM_AXIS NO_INPUT_QUANTITY SWC_FDC_type_CM_single_pct 17 -125.0 125.0 AXIS_PTS_REF ATQR_Sport2TqFrIncGain_Y_pct /end AXIS_DESCR
/end CHARACTERISTIC
/begin CHARACTERISTIC MTQR_SportOPDTqFrIncGain_Z_c "" MAP 0x0000 /* @ECU_Address@MTQR_SportOPDTqFrIncGain_Z_c@ */ Lookup2D_FLOAT32_IEEE 0 SWC_FDC_type_CM_single_c 0.0 300.0
 /begin AXIS_DESCR COM_AXIS VTQR_FEDUWhlTqReqSmoothDelay_Nm SWC_FDC_type_CM_single_Nm 20 -100000.0 100000.0 AXIS_PTS_REF ATQR_Sport2TqFrIncGain_X_Nm /end AXIS_DESCR
 /begin AXIS_DESCR COM_AXIS NO_INPUT_QUANTITY SWC_FDC_type_CM_single_pct 17 -125.0 125.0 AXIS_PTS_REF ATQR_Sport2TqFrIncGain_Y_pct /end AXIS_DESCR
/end CHARACTERISTIC
/begin CHARACTERISTIC MTQR_SportTqFrIncGain_Z_c "" MAP 0x0000 /* @ECU_Address@MTQR_SportTqFrIncGain_Z_c@ */ Lookup2D_FLOAT32_IEEE 0 SWC_FDC_type_CM_single_c 0.0 300.0
 /begin AXIS_DESCR COM_AXIS VTQR_FEDUWhlTqReqSmoothDelay_Nm SWC_FDC_type_CM_single_Nm 24 -100000.0 100000.0 AXIS_PTS_REF ATQR_SportTqFrIncGain_X_Nm /end AXIS_DESCR
 /begin AXIS_DESCR COM_AXIS NO_INPUT_QUANTITY SWC_FDC_type_CM_single_pct 17 -125.0 125.0 AXIS_PTS_REF ATQR_SportTqFrIncGain_Y_pct /end AXIS_DESCR
/end CHARACTERISTIC
/begin AXIS_PTS ATQR_SportTqFrIncGain_Y_pct "" 0x0000 /* @ECU_Address@ATQR_SportTqFrIncGain_Y_pct@ */ NO_INPUT_QUANTITY Lookup2D_X_FLOAT32_IEEE 0 SWC_FDC_type_CM_single_pct 17 -125.0 125.0 /end AXIS_PTS
/begin AXIS_PTS ATQR_SportTqFrIncGain_X_Nm "" 0x0000 /* @ECU_Address@ATQR_SportTqFrIncGain_X_Nm@ */ VTQR_FEDUWhlTqReqSmoothDelay_Nm Lookup2D_X_FLOAT32_IEEE 0 SWC_FDC_type_CM_single_Nm 24 -100000.0 100000.0 /end AXIS_PTS
/begin CHARACTERISTIC MTQR_TCSFEDUTqDecSR_Z_Nm "" MAP 0x0000 /* @ECU_Address@MTQR_TCSFEDUTqDecSR_Z_Nm@ */ Lookup2D_FLOAT32_IEEE 0 SWC_FDC_type_CM_single_Nm -100000.0 0.0
 /begin AXIS_DESCR COM_AXIS NO_INPUT_QUANTITY SWC_FDC_type_CM_single_rpm 24 -100000.0 100000.0 AXIS_PTS_REF ATQR_NL1FEDUTqIncSR_X_rpm /end AXIS_DESCR
 /begin AXIS_DESCR COM_AXIS VTQR_FEDUWhlTqReqSmoothDelay_Nm SWC_FDC_type_CM_single_Nm 18 -10000.0 10000.0 AXIS_PTS_REF ATQR_NL1REDUTqDecSR_Y_Nm /end AXIS_DESCR
/end CHARACTERISTIC
/begin CHARACTERISTIC MTQR_TCSFEDUTqIncSR_Z_Nm "" MAP 0x0000 /* @ECU_Address@MTQR_TCSFEDUTqIncSR_Z_Nm@ */ Lookup2D_FLOAT32_IEEE 0 SWC_FDC_type_CM_single_Nm 0.0 100000.0
 /begin AXIS_DESCR COM_AXIS NO_INPUT_QUANTITY SWC_FDC_type_CM_single_rpm 24 -100000.0 100000.0 AXIS_PTS_REF ATQR_NL1FEDUTqIncSR_X_rpm /end AXIS_DESCR
 /begin AXIS_DESCR COM_AXIS NO_INPUT_QUANTITY SWC_FDC_type_CM_single_Nm 17 0.0 120.0 AXIS_PTS_REF ATQR_NL1FEDUTqIncSR_Y_pct /end AXIS_DESCR
/end CHARACTERISTIC
/begin CHARACTERISTIC MTQR_ESCAPEREDUTs_Z_c "" MAP 0x0000 /* @ECU_Address@MTQR_ESCAPEREDUTs_Z_c@ */ Lookup2D_FLOAT32_IEEE 0 SWC_FDC_type_CM_single_c 0.0 1.0
 /begin AXIS_DESCR COM_AXIS NO_INPUT_QUANTITY SWC_FDC_type_CM_single_rpm 24 -100000.0 100000.0 AXIS_PTS_REF ATQR_NL1FEDUTs_X_rpm /end AXIS_DESCR
 /begin AXIS_DESCR COM_AXIS VTQR_REDUWhlTqReqSmoothDelay_Nm SWC_FDC_type_CM_single_Nm 18 -10000.0 10000.0 AXIS_PTS_REF ATQR_NL1REDUTs_Y_Nm /end AXIS_DESCR
/end CHARACTERISTIC
/begin AXIS_PTS ATQR_NL1REDUTs_Y_Nm "" 0x0000 /* @ECU_Address@ATQR_NL1REDUTs_Y_Nm@ */ VTQR_REDUWhlTqReqSmoothDelay_Nm Lookup2D_X_FLOAT32_IEEE 0 SWC_FDC_type_CM_single_Nm 18 -10000.0 10000.0 /end AXIS_PTS
/begin CHARACTERISTIC MTQR_LHMREDUTs_Z_c "" MAP 0x0000 /* @ECU_Address@MTQR_LHMREDUTs_Z_c@ */ Lookup2D_FLOAT32_IEEE 0 SWC_FDC_type_CM_single_c 0.0 1.0
 /begin AXIS_DESCR COM_AXIS NO_INPUT_QUANTITY SWC_FDC_type_CM_single_rpm 24 -100000.0 100000.0 AXIS_PTS_REF ATQR_NL1FEDUTs_X_rpm /end AXIS_DESCR
 /begin AXIS_DESCR COM_AXIS VTQR_REDUWhlTqReqSmoothDelay_Nm SWC_FDC_type_CM_single_Nm 18 -10000.0 10000.0 AXIS_PTS_REF ATQR_NL1REDUTs_Y_Nm /end AXIS_DESCR
/end CHARACTERISTIC
/begin CHARACTERISTIC MTQR_SNOWREDUTs_Z_c "" MAP 0x0000 /* @ECU_Address@MTQR_SNOWREDUTs_Z_c@ */ Lookup2D_FLOAT32_IEEE 0 SWC_FDC_type_CM_single_c 0.0 1.0
 /begin AXIS_DESCR COM_AXIS NO_INPUT_QUANTITY SWC_FDC_type_CM_single_rpm 24 -100000.0 100000.0 AXIS_PTS_REF ATQR_NL1FEDUTs_X_rpm /end AXIS_DESCR
 /begin AXIS_DESCR COM_AXIS VTQR_REDUWhlTqReqSmoothDelay_Nm SWC_FDC_type_CM_single_Nm 18 -10000.0 10000.0 AXIS_PTS_REF ATQR_NL1REDUTs_Y_Nm /end AXIS_DESCR
/end CHARACTERISTIC
/begin CHARACTERISTIC MTQR_TCSREDUTs_Z_c "" MAP 0x0000 /* @ECU_Address@MTQR_TCSREDUTs_Z_c@ */ Lookup2D_FLOAT32_IEEE 0 SWC_FDC_type_CM_single_c 0.0 1.0
 /begin AXIS_DESCR COM_AXIS NO_INPUT_QUANTITY SWC_FDC_type_CM_single_rpm 24 -100000.0 100000.0 AXIS_PTS_REF ATQR_NL1FEDUTs_X_rpm /end AXIS_DESCR
 /begin AXIS_DESCR COM_AXIS VTQR_REDUWhlTqReqSmoothDelay_Nm SWC_FDC_type_CM_single_Nm 18 -10000.0 10000.0 AXIS_PTS_REF ATQR_NL1REDUTs_Y_Nm /end AXIS_DESCR
/end CHARACTERISTIC
/begin CHARACTERISTIC MTQR_RTqZeroTransLowBoundE_Y_Nm "" CURVE 0x0000 /* @ECU_Address@MTQR_RTqZeroTransLowBoundE_Y_Nm@ */ Lookup1D_FLOAT32_IEEE 0 SWC_FDC_type_CM_single_Nm -150.0 0.0
 /begin AXIS_DESCR COM_AXIS NO_INPUT_QUANTITY SWC_FDC_type_CM_single_rpm 16 -100000.0 100000.0 AXIS_PTS_REF ATQR_FTqZeroTransUpBoundN_X_rpm /end AXIS_DESCR
/end CHARACTERISTIC
/begin CHARACTERISTIC MTQR_RTqZeroTransUpBoundE_Y_Nm "" CURVE 0x0000 /* @ECU_Address@MTQR_RTqZeroTransUpBoundE_Y_Nm@ */ Lookup1D_FLOAT32_IEEE 0 SWC_FDC_type_CM_single_Nm 0.0 150.0
 /begin AXIS_DESCR COM_AXIS NO_INPUT_QUANTITY SWC_FDC_type_CM_single_rpm 16 -100000.0 100000.0 AXIS_PTS_REF ATQR_FTqZeroTransUpBoundN_X_rpm /end AXIS_DESCR
/end CHARACTERISTIC
/begin CHARACTERISTIC MTQR_RTqZeroTransLowBoundN_Y_Nm "" CURVE 0x0000 /* @ECU_Address@MTQR_RTqZeroTransLowBoundN_Y_Nm@ */ Lookup1D_FLOAT32_IEEE 0 SWC_FDC_type_CM_single_Nm -150.0 0.0
 /begin AXIS_DESCR COM_AXIS NO_INPUT_QUANTITY SWC_FDC_type_CM_single_rpm 16 -100000.0 100000.0 AXIS_PTS_REF ATQR_FTqZeroTransUpBoundN_X_rpm /end AXIS_DESCR
/end CHARACTERISTIC
/begin CHARACTERISTIC MTQR_RTqZeroTransUpBoundN_Y_Nm "" CURVE 0x0000 /* @ECU_Address@MTQR_RTqZeroTransUpBoundN_Y_Nm@ */ Lookup1D_FLOAT32_IEEE 0 SWC_FDC_type_CM_single_Nm 0.0 150.0
 /begin AXIS_DESCR COM_AXIS NO_INPUT_QUANTITY SWC_FDC_type_CM_single_rpm 16 -100000.0 100000.0 AXIS_PTS_REF ATQR_FTqZeroTransUpBoundN_X_rpm /end AXIS_DESCR
/end CHARACTERISTIC
/begin CHARACTERISTIC MTQR_RTqZeroTransLowBoundS_Y_Nm "" CURVE 0x0000 /* @ECU_Address@MTQR_RTqZeroTransLowBoundS_Y_Nm@ */ Lookup1D_FLOAT32_IEEE 0 SWC_FDC_type_CM_single_Nm -150.0 0.0
 /begin AXIS_DESCR COM_AXIS NO_INPUT_QUANTITY SWC_FDC_type_CM_single_rpm 16 -100000.0 100000.0 AXIS_PTS_REF ATQR_FTqZeroTransUpBoundN_X_rpm /end AXIS_DESCR
/end CHARACTERISTIC
/begin CHARACTERISTIC MTQR_RTqZeroTransUpBoundS_Y_Nm "" CURVE 0x0000 /* @ECU_Address@MTQR_RTqZeroTransUpBoundS_Y_Nm@ */ Lookup1D_FLOAT32_IEEE 0 SWC_FDC_type_CM_single_Nm 0.0 150.0
 /begin AXIS_DESCR COM_AXIS NO_INPUT_QUANTITY SWC_FDC_type_CM_single_rpm 16 -100000.0 100000.0 AXIS_PTS_REF ATQR_FTqZeroTransUpBoundN_X_rpm /end AXIS_DESCR
/end CHARACTERISTIC
/begin CHARACTERISTIC MTQR_ECO2TqRrIncGain_Z_c "" MAP 0x0000 /* @ECU_Address@MTQR_ECO2TqRrIncGain_Z_c@ */ Lookup2D_FLOAT32_IEEE 0 SWC_FDC_type_CM_single_c 0.0 300.0
 /begin AXIS_DESCR COM_AXIS VTQR_REDUWhlTqReqSmoothDelay_Nm SWC_FDC_type_CM_single_Nm 20 -100000.0 100000.0 AXIS_PTS_REF ATQR_ECO2TqRrIncGain_X_Nm /end AXIS_DESCR
 /begin AXIS_DESCR COM_AXIS NO_INPUT_QUANTITY SWC_FDC_type_CM_single_pct 17 -125.0 125.0 AXIS_PTS_REF ATQR_ECO2TqRrIncGain_Y_pct /end AXIS_DESCR
/end CHARACTERISTIC
/begin AXIS_PTS ATQR_ECO2TqRrIncGain_Y_pct "" 0x0000 /* @ECU_Address@ATQR_ECO2TqRrIncGain_Y_pct@ */ NO_INPUT_QUANTITY Lookup2D_X_FLOAT32_IEEE 0 SWC_FDC_type_CM_single_pct 17 -125.0 125.0 /end AXIS_PTS
/begin AXIS_PTS ATQR_ECO2TqRrIncGain_X_Nm "" 0x0000 /* @ECU_Address@ATQR_ECO2TqRrIncGain_X_Nm@ */ VTQR_REDUWhlTqReqSmoothDelay_Nm Lookup2D_X_FLOAT32_IEEE 0 SWC_FDC_type_CM_single_Nm 20 -100000.0 100000.0 /end AXIS_PTS
/begin CHARACTERISTIC MTQR_ECO3TqRrIncGain_Z_c "" MAP 0x0000 /* @ECU_Address@MTQR_ECO3TqRrIncGain_Z_c@ */ Lookup2D_FLOAT32_IEEE 0 SWC_FDC_type_CM_single_c 0.0 300.0
 /begin AXIS_DESCR COM_AXIS VTQR_REDUWhlTqReqSmoothDelay_Nm SWC_FDC_type_CM_single_Nm 20 -100000.0 100000.0 AXIS_PTS_REF ATQR_ECO2TqRrIncGain_X_Nm /end AXIS_DESCR
 /begin AXIS_DESCR COM_AXIS NO_INPUT_QUANTITY SWC_FDC_type_CM_single_pct 17 -125.0 125.0 AXIS_PTS_REF ATQR_ECO2TqRrIncGain_Y_pct /end AXIS_DESCR
/end CHARACTERISTIC
/begin CHARACTERISTIC MTQR_ECO4TqRrIncGain_Z_c "" MAP 0x0000 /* @ECU_Address@MTQR_ECO4TqRrIncGain_Z_c@ */ Lookup2D_FLOAT32_IEEE 0 SWC_FDC_type_CM_single_c 0.0 300.0
 /begin AXIS_DESCR COM_AXIS VTQR_REDUWhlTqReqSmoothDelay_Nm SWC_FDC_type_CM_single_Nm 20 -100000.0 100000.0 AXIS_PTS_REF ATQR_ECO2TqRrIncGain_X_Nm /end AXIS_DESCR
 /begin AXIS_DESCR COM_AXIS NO_INPUT_QUANTITY SWC_FDC_type_CM_single_pct 17 -125.0 125.0 AXIS_PTS_REF ATQR_ECO2TqRrIncGain_Y_pct /end AXIS_DESCR
/end CHARACTERISTIC
/begin CHARACTERISTIC MTQR_ECO5TqRrIncGain_Z_c "" MAP 0x0000 /* @ECU_Address@MTQR_ECO5TqRrIncGain_Z_c@ */ Lookup2D_FLOAT32_IEEE 0 SWC_FDC_type_CM_single_c 0.0 300.0
 /begin AXIS_DESCR COM_AXIS VTQR_REDUWhlTqReqSmoothDelay_Nm SWC_FDC_type_CM_single_Nm 20 -100000.0 100000.0 AXIS_PTS_REF ATQR_ECO2TqRrIncGain_X_Nm /end AXIS_DESCR
 /begin AXIS_DESCR COM_AXIS NO_INPUT_QUANTITY SWC_FDC_type_CM_single_pct 17 -125.0 125.0 AXIS_PTS_REF ATQR_ECO2TqRrIncGain_Y_pct /end AXIS_DESCR
/end CHARACTERISTIC
/begin CHARACTERISTIC MTQR_ECOOPDTqRrIncGain_Z_c "" MAP 0x0000 /* @ECU_Address@MTQR_ECOOPDTqRrIncGain_Z_c@ */ Lookup2D_FLOAT32_IEEE 0 SWC_FDC_type_CM_single_c 0.0 300.0
 /begin AXIS_DESCR COM_AXIS VTQR_REDUWhlTqReqSmoothDelay_Nm SWC_FDC_type_CM_single_Nm 20 -100000.0 100000.0 AXIS_PTS_REF ATQR_ECO2TqRrIncGain_X_Nm /end AXIS_DESCR
 /begin AXIS_DESCR COM_AXIS NO_INPUT_QUANTITY SWC_FDC_type_CM_single_pct 17 -125.0 125.0 AXIS_PTS_REF ATQR_ECO2TqRrIncGain_Y_pct /end AXIS_DESCR
/end CHARACTERISTIC
/begin CHARACTERISTIC MTQR_EcoTqRrIncGain_Z_c "" MAP 0x0000 /* @ECU_Address@MTQR_EcoTqRrIncGain_Z_c@ */ Lookup2D_FLOAT32_IEEE 0 SWC_FDC_type_CM_single_c 0.0 300.0
 /begin AXIS_DESCR COM_AXIS VTQR_REDUWhlTqReqSmoothDelay_Nm SWC_FDC_type_CM_single_Nm 24 -100000.0 100000.0 AXIS_PTS_REF ATQR_EcoTqRrIncGain_X_Nm /end AXIS_DESCR
 /begin AXIS_DESCR COM_AXIS NO_INPUT_QUANTITY SWC_FDC_type_CM_single_pct 17 -125.0 125.0 AXIS_PTS_REF ATQR_EcoTqRrIncGain_Y_pct /end AXIS_DESCR
/end CHARACTERISTIC
/begin AXIS_PTS ATQR_EcoTqRrIncGain_Y_pct "" 0x0000 /* @ECU_Address@ATQR_EcoTqRrIncGain_Y_pct@ */ NO_INPUT_QUANTITY Lookup2D_X_FLOAT32_IEEE 0 SWC_FDC_type_CM_single_pct 17 -125.0 125.0 /end AXIS_PTS
/begin AXIS_PTS ATQR_EcoTqRrIncGain_X_Nm "" 0x0000 /* @ECU_Address@ATQR_EcoTqRrIncGain_X_Nm@ */ VTQR_REDUWhlTqReqSmoothDelay_Nm Lookup2D_X_FLOAT32_IEEE 0 SWC_FDC_type_CM_single_Nm 24 -100000.0 100000.0 /end AXIS_PTS
/begin CHARACTERISTIC MTQR_ESCAPEREDUTqDecSR_Z_Nm "" MAP 0x0000 /* @ECU_Address@MTQR_ESCAPEREDUTqDecSR_Z_Nm@ */ Lookup2D_FLOAT32_IEEE 0 SWC_FDC_type_CM_single_Nm -100000.0 0.0
 /begin AXIS_DESCR COM_AXIS NO_INPUT_QUANTITY SWC_FDC_type_CM_single_rpm 24 -100000.0 100000.0 AXIS_PTS_REF ATQR_NL1FEDUTqIncSR_X_rpm /end AXIS_DESCR
 /begin AXIS_DESCR COM_AXIS VTQR_REDUWhlTqReqSmoothDelay_Nm SWC_FDC_type_CM_single_Nm 18 -10000.0 10000.0 AXIS_PTS_REF ATQR_NL1REDUTqDecSR_Y_Nm /end AXIS_DESCR
/end CHARACTERISTIC
/begin CHARACTERISTIC MTQR_ESCAPEREDUTqIncSR_Z_Nm "" MAP 0x0000 /* @ECU_Address@MTQR_ESCAPEREDUTqIncSR_Z_Nm@ */ Lookup2D_FLOAT32_IEEE 0 SWC_FDC_type_CM_single_Nm 0.0 100000.0
 /begin AXIS_DESCR COM_AXIS NO_INPUT_QUANTITY SWC_FDC_type_CM_single_rpm 24 -100000.0 100000.0 AXIS_PTS_REF ATQR_NL1FEDUTqIncSR_X_rpm /end AXIS_DESCR
 /begin AXIS_DESCR COM_AXIS NO_INPUT_QUANTITY SWC_FDC_type_CM_single_Nm 17 0.0 120.0 AXIS_PTS_REF ATQR_NL1FEDUTqIncSR_Y_pct /end AXIS_DESCR
/end CHARACTERISTIC
/begin CHARACTERISTIC MTQR_LHMREDUTqDecSR_Z_Nm "" MAP 0x0000 /* @ECU_Address@MTQR_LHMREDUTqDecSR_Z_Nm@ */ Lookup2D_FLOAT32_IEEE 0 SWC_FDC_type_CM_single_Nm -100000.0 0.0
 /begin AXIS_DESCR COM_AXIS NO_INPUT_QUANTITY SWC_FDC_type_CM_single_rpm 24 -100000.0 100000.0 AXIS_PTS_REF ATQR_NL1FEDUTqIncSR_X_rpm /end AXIS_DESCR
 /begin AXIS_DESCR COM_AXIS VTQR_REDUWhlTqReqSmoothDelay_Nm SWC_FDC_type_CM_single_Nm 18 -10000.0 10000.0 AXIS_PTS_REF ATQR_NL1REDUTqDecSR_Y_Nm /end AXIS_DESCR
/end CHARACTERISTIC
/begin CHARACTERISTIC MTQR_LHMREDUTqIncSR_Z_Nm "" MAP 0x0000 /* @ECU_Address@MTQR_LHMREDUTqIncSR_Z_Nm@ */ Lookup2D_FLOAT32_IEEE 0 SWC_FDC_type_CM_single_Nm 0.0 100000.0
 /begin AXIS_DESCR COM_AXIS NO_INPUT_QUANTITY SWC_FDC_type_CM_single_rpm 24 -100000.0 100000.0 AXIS_PTS_REF ATQR_NL1FEDUTqIncSR_X_rpm /end AXIS_DESCR
 /begin AXIS_DESCR COM_AXIS NO_INPUT_QUANTITY SWC_FDC_type_CM_single_Nm 17 0.0 120.0 AXIS_PTS_REF ATQR_NL1FEDUTqIncSR_Y_pct /end AXIS_DESCR
/end CHARACTERISTIC
/begin CHARACTERISTIC MTQR_NL2TqRrIncGain_Z_c "" MAP 0x0000 /* @ECU_Address@MTQR_NL2TqRrIncGain_Z_c@ */ Lookup2D_FLOAT32_IEEE 0 SWC_FDC_type_CM_single_c 0.0 300.0
 /begin AXIS_DESCR COM_AXIS VTQR_REDUWhlTqReqSmoothDelay_Nm SWC_FDC_type_CM_single_Nm 20 -100000.0 100000.0 AXIS_PTS_REF ATQR_NL2TqRrIncGain_X_Nm /end AXIS_DESCR
 /begin AXIS_DESCR COM_AXIS NO_INPUT_QUANTITY SWC_FDC_type_CM_single_pct 17 -125.0 125.0 AXIS_PTS_REF ATQR_NL2TqRrIncGain_Y_pct /end AXIS_DESCR
/end CHARACTERISTIC
/begin AXIS_PTS ATQR_NL2TqRrIncGain_Y_pct "" 0x0000 /* @ECU_Address@ATQR_NL2TqRrIncGain_Y_pct@ */ NO_INPUT_QUANTITY Lookup2D_X_FLOAT32_IEEE 0 SWC_FDC_type_CM_single_pct 17 -125.0 125.0 /end AXIS_PTS
/begin AXIS_PTS ATQR_NL2TqRrIncGain_X_Nm "" 0x0000 /* @ECU_Address@ATQR_NL2TqRrIncGain_X_Nm@ */ VTQR_REDUWhlTqReqSmoothDelay_Nm Lookup2D_X_FLOAT32_IEEE 0 SWC_FDC_type_CM_single_Nm 20 -100000.0 100000.0 /end AXIS_PTS
/begin CHARACTERISTIC MTQR_NL3TqRrIncGain_Z_c "" MAP 0x0000 /* @ECU_Address@MTQR_NL3TqRrIncGain_Z_c@ */ Lookup2D_FLOAT32_IEEE 0 SWC_FDC_type_CM_single_c 0.0 300.0
 /begin AXIS_DESCR COM_AXIS VTQR_REDUWhlTqReqSmoothDelay_Nm SWC_FDC_type_CM_single_Nm 20 -100000.0 100000.0 AXIS_PTS_REF ATQR_NL2TqRrIncGain_X_Nm /end AXIS_DESCR
 /begin AXIS_DESCR COM_AXIS NO_INPUT_QUANTITY SWC_FDC_type_CM_single_pct 17 -125.0 125.0 AXIS_PTS_REF ATQR_NL2TqRrIncGain_Y_pct /end AXIS_DESCR
/end CHARACTERISTIC
/begin CHARACTERISTIC MTQR_NL4TqRrIncGain_Z_c "" MAP 0x0000 /* @ECU_Address@MTQR_NL4TqRrIncGain_Z_c@ */ Lookup2D_FLOAT32_IEEE 0 SWC_FDC_type_CM_single_c 0.0 300.0
 /begin AXIS_DESCR COM_AXIS VTQR_REDUWhlTqReqSmoothDelay_Nm SWC_FDC_type_CM_single_Nm 20 -100000.0 100000.0 AXIS_PTS_REF ATQR_NL2TqRrIncGain_X_Nm /end AXIS_DESCR
 /begin AXIS_DESCR COM_AXIS NO_INPUT_QUANTITY SWC_FDC_type_CM_single_pct 17 -125.0 125.0 AXIS_PTS_REF ATQR_NL2TqRrIncGain_Y_pct /end AXIS_DESCR
/end CHARACTERISTIC
/begin CHARACTERISTIC MTQR_NL5TqRrIncGain_Z_c "" MAP 0x0000 /* @ECU_Address@MTQR_NL5TqRrIncGain_Z_c@ */ Lookup2D_FLOAT32_IEEE 0 SWC_FDC_type_CM_single_c 0.0 300.0
 /begin AXIS_DESCR COM_AXIS VTQR_REDUWhlTqReqSmoothDelay_Nm SWC_FDC_type_CM_single_Nm 20 -100000.0 100000.0 AXIS_PTS_REF ATQR_NL2TqRrIncGain_X_Nm /end AXIS_DESCR
 /begin AXIS_DESCR COM_AXIS NO_INPUT_QUANTITY SWC_FDC_type_CM_single_pct 17 -125.0 125.0 AXIS_PTS_REF ATQR_NL2TqRrIncGain_Y_pct /end AXIS_DESCR
/end CHARACTERISTIC
/begin CHARACTERISTIC MTQR_NLOPDTqRrIncGain_Z_c "" MAP 0x0000 /* @ECU_Address@MTQR_NLOPDTqRrIncGain_Z_c@ */ Lookup2D_FLOAT32_IEEE 0 SWC_FDC_type_CM_single_c 0.0 300.0
 /begin AXIS_DESCR COM_AXIS VTQR_REDUWhlTqReqSmoothDelay_Nm SWC_FDC_type_CM_single_Nm 20 -100000.0 100000.0 AXIS_PTS_REF ATQR_NL2TqRrIncGain_X_Nm /end AXIS_DESCR
 /begin AXIS_DESCR COM_AXIS NO_INPUT_QUANTITY SWC_FDC_type_CM_single_pct 17 -125.0 125.0 AXIS_PTS_REF ATQR_NL2TqRrIncGain_Y_pct /end AXIS_DESCR
/end CHARACTERISTIC
/begin CHARACTERISTIC MTQR_NormalTqRrIncGain_Z_c "" MAP 0x0000 /* @ECU_Address@MTQR_NormalTqRrIncGain_Z_c@ */ Lookup2D_FLOAT32_IEEE 0 SWC_FDC_type_CM_single_c 0.0 300.0
 /begin AXIS_DESCR COM_AXIS VTQR_REDUWhlTqReqSmoothDelay_Nm SWC_FDC_type_CM_single_Nm 24 -100000.0 100000.0 AXIS_PTS_REF ATQR_NormalTqRrIncGain_X_Nm /end AXIS_DESCR
 /begin AXIS_DESCR COM_AXIS NO_INPUT_QUANTITY SWC_FDC_type_CM_single_pct 17 -125.0 125.0 AXIS_PTS_REF ATQR_NormalTqRrIncGain_Y_pct /end AXIS_DESCR
/end CHARACTERISTIC
/begin AXIS_PTS ATQR_NormalTqRrIncGain_Y_pct "" 0x0000 /* @ECU_Address@ATQR_NormalTqRrIncGain_Y_pct@ */ NO_INPUT_QUANTITY Lookup2D_X_FLOAT32_IEEE 0 SWC_FDC_type_CM_single_pct 17 -125.0 125.0 /end AXIS_PTS
/begin AXIS_PTS ATQR_NormalTqRrIncGain_X_Nm "" 0x0000 /* @ECU_Address@ATQR_NormalTqRrIncGain_X_Nm@ */ VTQR_REDUWhlTqReqSmoothDelay_Nm Lookup2D_X_FLOAT32_IEEE 0 SWC_FDC_type_CM_single_Nm 24 -100000.0 100000.0 /end AXIS_PTS
/begin CHARACTERISTIC MTQR_SNOWREDUTqDecSR_Z_Nm "" MAP 0x0000 /* @ECU_Address@MTQR_SNOWREDUTqDecSR_Z_Nm@ */ Lookup2D_FLOAT32_IEEE 0 SWC_FDC_type_CM_single_Nm -100000.0 0.0
 /begin AXIS_DESCR COM_AXIS NO_INPUT_QUANTITY SWC_FDC_type_CM_single_rpm 24 -100000.0 100000.0 AXIS_PTS_REF ATQR_NL1FEDUTqIncSR_X_rpm /end AXIS_DESCR
 /begin AXIS_DESCR COM_AXIS VTQR_REDUWhlTqReqSmoothDelay_Nm SWC_FDC_type_CM_single_Nm 18 -10000.0 10000.0 AXIS_PTS_REF ATQR_NL1REDUTqDecSR_Y_Nm /end AXIS_DESCR
/end CHARACTERISTIC
/begin CHARACTERISTIC MTQR_SNOWREDUTqIncSR_Z_Nm "" MAP 0x0000 /* @ECU_Address@MTQR_SNOWREDUTqIncSR_Z_Nm@ */ Lookup2D_FLOAT32_IEEE 0 SWC_FDC_type_CM_single_Nm 0.0 100000.0
 /begin AXIS_DESCR COM_AXIS NO_INPUT_QUANTITY SWC_FDC_type_CM_single_rpm 24 -100000.0 100000.0 AXIS_PTS_REF ATQR_NL1FEDUTqIncSR_X_rpm /end AXIS_DESCR
 /begin AXIS_DESCR COM_AXIS NO_INPUT_QUANTITY SWC_FDC_type_CM_single_Nm 17 0.0 120.0 AXIS_PTS_REF ATQR_NL1FEDUTqIncSR_Y_pct /end AXIS_DESCR
/end CHARACTERISTIC
/begin CHARACTERISTIC MTQR_SnowMTqRrIncGain_Z_c "" MAP 0x0000 /* @ECU_Address@MTQR_SnowMTqRrIncGain_Z_c@ */ Lookup2D_FLOAT32_IEEE 0 SWC_FDC_type_CM_single_c 0.0 300.0
 /begin AXIS_DESCR COM_AXIS VTQR_REDUWhlTqReqSmoothDelay_Nm SWC_FDC_type_CM_single_Nm 20 -100000.0 100000.0 AXIS_PTS_REF ATQR_SnowMTqFrIncGain_X_Nm /end AXIS_DESCR
 /begin AXIS_DESCR COM_AXIS NO_INPUT_QUANTITY SWC_FDC_type_CM_single_pct 17 -125.0 125.0 AXIS_PTS_REF ATQR_SnowMTqFrIncGain_Y_pct /end AXIS_DESCR
/end CHARACTERISTIC
/begin CHARACTERISTIC MTQR_Sport2TqRrIncGain_Z_c "" MAP 0x0000 /* @ECU_Address@MTQR_Sport2TqRrIncGain_Z_c@ */ Lookup2D_FLOAT32_IEEE 0 SWC_FDC_type_CM_single_c 0.0 300.0
 /begin AXIS_DESCR COM_AXIS VTQR_REDUWhlTqReqSmoothDelay_Nm SWC_FDC_type_CM_single_Nm 20 -100000.0 100000.0 AXIS_PTS_REF ATQR_Sport2TqRrIncGain_X_Nm /end AXIS_DESCR
 /begin AXIS_DESCR COM_AXIS NO_INPUT_QUANTITY SWC_FDC_type_CM_single_pct 17 -125.0 125.0 AXIS_PTS_REF ATQR_Sport2TqRrIncGain_Y_pct /end AXIS_DESCR
/end CHARACTERISTIC
/begin AXIS_PTS ATQR_Sport2TqRrIncGain_Y_pct "" 0x0000 /* @ECU_Address@ATQR_Sport2TqRrIncGain_Y_pct@ */ NO_INPUT_QUANTITY Lookup2D_X_FLOAT32_IEEE 0 SWC_FDC_type_CM_single_pct 17 -125.0 125.0 /end AXIS_PTS
/begin AXIS_PTS ATQR_Sport2TqRrIncGain_X_Nm "" 0x0000 /* @ECU_Address@ATQR_Sport2TqRrIncGain_X_Nm@ */ VTQR_REDUWhlTqReqSmoothDelay_Nm Lookup2D_X_FLOAT32_IEEE 0 SWC_FDC_type_CM_single_Nm 20 -100000.0 100000.0 /end AXIS_PTS
/begin CHARACTERISTIC MTQR_Sport3TqRrIncGain_Z_c "" MAP 0x0000 /* @ECU_Address@MTQR_Sport3TqRrIncGain_Z_c@ */ Lookup2D_FLOAT32_IEEE 0 SWC_FDC_type_CM_single_c 0.0 300.0
 /begin AXIS_DESCR COM_AXIS VTQR_REDUWhlTqReqSmoothDelay_Nm SWC_FDC_type_CM_single_Nm 20 -100000.0 100000.0 AXIS_PTS_REF ATQR_Sport2TqRrIncGain_X_Nm /end AXIS_DESCR
 /begin AXIS_DESCR COM_AXIS NO_INPUT_QUANTITY SWC_FDC_type_CM_single_pct 17 -125.0 125.0 AXIS_PTS_REF ATQR_Sport2TqRrIncGain_Y_pct /end AXIS_DESCR
/end CHARACTERISTIC
/begin CHARACTERISTIC MTQR_Sport4TqRrIncGain_Z_c "" MAP 0x0000 /* @ECU_Address@MTQR_Sport4TqRrIncGain_Z_c@ */ Lookup2D_FLOAT32_IEEE 0 SWC_FDC_type_CM_single_c 0.0 300.0
 /begin AXIS_DESCR COM_AXIS VTQR_REDUWhlTqReqSmoothDelay_Nm SWC_FDC_type_CM_single_Nm 20 -100000.0 100000.0 AXIS_PTS_REF ATQR_Sport2TqRrIncGain_X_Nm /end AXIS_DESCR
 /begin AXIS_DESCR COM_AXIS NO_INPUT_QUANTITY SWC_FDC_type_CM_single_pct 17 -125.0 125.0 AXIS_PTS_REF ATQR_Sport2TqRrIncGain_Y_pct /end AXIS_DESCR
/end CHARACTERISTIC
/begin CHARACTERISTIC MTQR_Sport5TqRrIncGain_Z_c "" MAP 0x0000 /* @ECU_Address@MTQR_Sport5TqRrIncGain_Z_c@ */ Lookup2D_FLOAT32_IEEE 0 SWC_FDC_type_CM_single_c 0.0 300.0
 /begin AXIS_DESCR COM_AXIS VTQR_REDUWhlTqReqSmoothDelay_Nm SWC_FDC_type_CM_single_Nm 20 -100000.0 100000.0 AXIS_PTS_REF ATQR_Sport2TqRrIncGain_X_Nm /end AXIS_DESCR
 /begin AXIS_DESCR COM_AXIS NO_INPUT_QUANTITY SWC_FDC_type_CM_single_pct 17 -125.0 125.0 AXIS_PTS_REF ATQR_Sport2TqRrIncGain_Y_pct /end AXIS_DESCR
/end CHARACTERISTIC
/begin CHARACTERISTIC MTQR_SportOPDTqRrIncGain_Z_c "" MAP 0x0000 /* @ECU_Address@MTQR_SportOPDTqRrIncGain_Z_c@ */ Lookup2D_FLOAT32_IEEE 0 SWC_FDC_type_CM_single_c 0.0 300.0
 /begin AXIS_DESCR COM_AXIS VTQR_REDUWhlTqReqSmoothDelay_Nm SWC_FDC_type_CM_single_Nm 20 -100000.0 100000.0 AXIS_PTS_REF ATQR_Sport2TqRrIncGain_X_Nm /end AXIS_DESCR
 /begin AXIS_DESCR COM_AXIS NO_INPUT_QUANTITY SWC_FDC_type_CM_single_pct 17 -125.0 125.0 AXIS_PTS_REF ATQR_Sport2TqRrIncGain_Y_pct /end AXIS_DESCR
/end CHARACTERISTIC
/begin CHARACTERISTIC MTQR_SportTqRrIncGain_Z_c "" MAP 0x0000 /* @ECU_Address@MTQR_SportTqRrIncGain_Z_c@ */ Lookup2D_FLOAT32_IEEE 0 SWC_FDC_type_CM_single_c 0.0 300.0
 /begin AXIS_DESCR COM_AXIS VTQR_REDUWhlTqReqSmoothDelay_Nm SWC_FDC_type_CM_single_Nm 24 -100000.0 100000.0 AXIS_PTS_REF ATQR_SportTqRrIncGain_X_Nm /end AXIS_DESCR
 /begin AXIS_DESCR COM_AXIS NO_INPUT_QUANTITY SWC_FDC_type_CM_single_pct 17 -125.0 125.0 AXIS_PTS_REF ATQR_SportTqRrIncGain_Y_pct /end AXIS_DESCR
/end CHARACTERISTIC
/begin AXIS_PTS ATQR_SportTqRrIncGain_Y_pct "" 0x0000 /* @ECU_Address@ATQR_SportTqRrIncGain_Y_pct@ */ NO_INPUT_QUANTITY Lookup2D_X_FLOAT32_IEEE 0 SWC_FDC_type_CM_single_pct 17 -125.0 125.0 /end AXIS_PTS
/begin AXIS_PTS ATQR_SportTqRrIncGain_X_Nm "" 0x0000 /* @ECU_Address@ATQR_SportTqRrIncGain_X_Nm@ */ VTQR_REDUWhlTqReqSmoothDelay_Nm Lookup2D_X_FLOAT32_IEEE 0 SWC_FDC_type_CM_single_Nm 24 -100000.0 100000.0 /end AXIS_PTS
/begin CHARACTERISTIC MTQR_TCSREDUTqDecSR_Z_Nm "" MAP 0x0000 /* @ECU_Address@MTQR_TCSREDUTqDecSR_Z_Nm@ */ Lookup2D_FLOAT32_IEEE 0 SWC_FDC_type_CM_single_Nm -100000.0 0.0
 /begin AXIS_DESCR COM_AXIS NO_INPUT_QUANTITY SWC_FDC_type_CM_single_rpm 24 -100000.0 100000.0 AXIS_PTS_REF ATQR_NL1FEDUTqIncSR_X_rpm /end AXIS_DESCR
 /begin AXIS_DESCR COM_AXIS VTQR_REDUWhlTqReqSmoothDelay_Nm SWC_FDC_type_CM_single_Nm 18 -10000.0 10000.0 AXIS_PTS_REF ATQR_NL1REDUTqDecSR_Y_Nm /end AXIS_DESCR
/end CHARACTERISTIC
/begin CHARACTERISTIC MTQR_TCSREDUTqIncSR_Z_Nm "" MAP 0x0000 /* @ECU_Address@MTQR_TCSREDUTqIncSR_Z_Nm@ */ Lookup2D_FLOAT32_IEEE 0 SWC_FDC_type_CM_single_Nm 0.0 100000.0
 /begin AXIS_DESCR COM_AXIS NO_INPUT_QUANTITY SWC_FDC_type_CM_single_rpm 24 -100000.0 100000.0 AXIS_PTS_REF ATQR_NL1FEDUTqIncSR_X_rpm /end AXIS_DESCR
 /begin AXIS_DESCR COM_AXIS NO_INPUT_QUANTITY SWC_FDC_type_CM_single_Nm 17 0.0 120.0 AXIS_PTS_REF ATQR_NL1FEDUTqIncSR_Y_pct /end AXIS_DESCR
/end CHARACTERISTIC
/begin CHARACTERISTIC MTQD_RL1TqMapDComp_Z_Nm "" MAP 0x0000 /* @ECU_Address@MTQD_RL1TqMapDComp_Z_Nm@ */ Lookup2D_FLOAT32_IEEE 0 SWC_FDC_type_CM_single_Nm -100000.0 100000.0
 /begin AXIS_DESCR COM_AXIS VTQD_TqTargetShaftSpd_rpm SWC_FDC_type_CM_single_rpm 11 -100000.0 100000.0 AXIS_PTS_REF ATQD_RL1TqMapDComp_X_rpm /end AXIS_DESCR
 /begin AXIS_DESCR COM_AXIS NO_INPUT_QUANTITY SWC_FDC_type_CM_single_Deg 9 -180.0 180.0 AXIS_PTS_REF ATQD_RL1TqMapDComp_Y_Deg /end AXIS_DESCR
/end CHARACTERISTIC
/begin AXIS_PTS ATQD_RL1TqMapDComp_Y_Deg "" 0x0000 /* @ECU_Address@ATQD_RL1TqMapDComp_Y_Deg@ */ NO_INPUT_QUANTITY Lookup2D_X_FLOAT32_IEEE 0 SWC_FDC_type_CM_single_Deg 9 -180.0 180.0 /end AXIS_PTS
/begin AXIS_PTS ATQD_RL1TqMapDComp_X_rpm "" 0x0000 /* @ECU_Address@ATQD_RL1TqMapDComp_X_rpm@ */ VTQD_TqTargetShaftSpd_rpm Lookup2D_X_FLOAT32_IEEE 0 SWC_FDC_type_CM_single_rpm 11 -100000.0 100000.0 /end AXIS_PTS
/begin CHARACTERISTIC MTQD_RL2TqMapDComp_Z_Nm "" MAP 0x0000 /* @ECU_Address@MTQD_RL2TqMapDComp_Z_Nm@ */ Lookup2D_FLOAT32_IEEE 0 SWC_FDC_type_CM_single_Nm -100000.0 100000.0
 /begin AXIS_DESCR COM_AXIS VTQD_TqTargetShaftSpd_rpm SWC_FDC_type_CM_single_rpm 11 -100000.0 100000.0 AXIS_PTS_REF ATQD_RL1TqMapDComp_X_rpm /end AXIS_DESCR
 /begin AXIS_DESCR COM_AXIS NO_INPUT_QUANTITY SWC_FDC_type_CM_single_Deg 9 -180.0 180.0 AXIS_PTS_REF ATQD_RL1TqMapDComp_Y_Deg /end AXIS_DESCR
/end CHARACTERISTIC
/begin CHARACTERISTIC MTQD_RL3TqMapDComp_Z_Nm "" MAP 0x0000 /* @ECU_Address@MTQD_RL3TqMapDComp_Z_Nm@ */ Lookup2D_FLOAT32_IEEE 0 SWC_FDC_type_CM_single_Nm -100000.0 100000.0
 /begin AXIS_DESCR COM_AXIS VTQD_TqTargetShaftSpd_rpm SWC_FDC_type_CM_single_rpm 11 -100000.0 100000.0 AXIS_PTS_REF ATQD_RL1TqMapDComp_X_rpm /end AXIS_DESCR
 /begin AXIS_DESCR COM_AXIS NO_INPUT_QUANTITY SWC_FDC_type_CM_single_Deg 9 -180.0 180.0 AXIS_PTS_REF ATQD_RL1TqMapDComp_Y_Deg /end AXIS_DESCR
/end CHARACTERISTIC
/begin CHARACTERISTIC MTQD_RL4TqMapDComp_Z_Nm "" MAP 0x0000 /* @ECU_Address@MTQD_RL4TqMapDComp_Z_Nm@ */ Lookup2D_FLOAT32_IEEE 0 SWC_FDC_type_CM_single_Nm -100000.0 100000.0
 /begin AXIS_DESCR COM_AXIS VTQD_TqTargetShaftSpd_rpm SWC_FDC_type_CM_single_rpm 11 -100000.0 100000.0 AXIS_PTS_REF ATQD_RL1TqMapDComp_X_rpm /end AXIS_DESCR
 /begin AXIS_DESCR COM_AXIS NO_INPUT_QUANTITY SWC_FDC_type_CM_single_Deg 9 -180.0 180.0 AXIS_PTS_REF ATQD_RL1TqMapDComp_Y_Deg /end AXIS_DESCR
/end CHARACTERISTIC
/begin CHARACTERISTIC MTQD_RL5TqMapDComp_Z_Nm "" MAP 0x0000 /* @ECU_Address@MTQD_RL5TqMapDComp_Z_Nm@ */ Lookup2D_FLOAT32_IEEE 0 SWC_FDC_type_CM_single_Nm -100000.0 100000.0
 /begin AXIS_DESCR COM_AXIS VTQD_TqTargetShaftSpd_rpm SWC_FDC_type_CM_single_rpm 11 -100000.0 100000.0 AXIS_PTS_REF ATQD_RL1TqMapDComp_X_rpm /end AXIS_DESCR
 /begin AXIS_DESCR COM_AXIS NO_INPUT_QUANTITY SWC_FDC_type_CM_single_Deg 9 -180.0 180.0 AXIS_PTS_REF ATQD_RL1TqMapDComp_Y_Deg /end AXIS_DESCR
/end CHARACTERISTIC
/begin CHARACTERISTIC KTQD_APSCreepItermMaxLim_Nm "" VALUE 0x0000 /* @ECU_Address@KTQD_APSCreepItermMaxLim_Nm@ */ Scalar_FLOAT32_IEEE 0 SWC_FDC_type_CM_single_Nm -100000.0 100000.0 /end CHARACTERISTIC
/begin CHARACTERISTIC KTQD_AllowSetSpdSpd_kph "" VALUE 0x0000 /* @ECU_Address@KTQD_AllowSetSpdSpd_kph@ */ Scalar_FLOAT32_IEEE 0 SWC_FDC_type_CM_single_kph 0.0 50.0 /end CHARACTERISTIC
/begin CHARACTERISTIC KTQD_CANCELCountDetTime_s "" VALUE 0x0000 /* @ECU_Address@KTQD_CANCELCountDetTime_s@ */ Scalar_FLOAT32_IEEE 0 SWC_FDC_type_CM_single_s 0.0 20.0 /end CHARACTERISTIC
/begin CHARACTERISTIC KTQD_ComboKeyDelay_s "" VALUE 0x0000 /* @ECU_Address@KTQD_ComboKeyDelay_s@ */ Scalar_FLOAT32_IEEE 0 SWC_FDC_type_CM_single_s 0.0 20.0 /end CHARACTERISTIC
/begin CHARACTERISTIC KTQD_ComboKeyLongDet_s "" VALUE 0x0000 /* @ECU_Address@KTQD_ComboKeyLongDet_s@ */ Scalar_FLOAT32_IEEE 0 SWC_FDC_type_CM_single_s 0.0 20.0 /end CHARACTERISTIC
/begin CHARACTERISTIC KTQD_CreepItermMinLimit_Nm "" VALUE 0x0000 /* @ECU_Address@KTQD_CreepItermMinLimit_Nm@ */ Scalar_FLOAT32_IEEE 0 SWC_FDC_type_CM_single_Nm -100000.0 100000.0 /end CHARACTERISTIC
/begin CHARACTERISTIC KTQD_EstFrWhlTqDev_Nm "" VALUE 0x0000 /* @ECU_Address@KTQD_EstFrWhlTqDev_Nm@ */ Scalar_FLOAT32_IEEE 0 SWC_FDC_type_CM_single_Nm 0.0 500.0 /end CHARACTERISTIC
/begin CHARACTERISTIC KTQD_EstLongAccDev_Gps "" VALUE 0x0000 /* @ECU_Address@KTQD_EstLongAccDev_Gps@ */ Scalar_FLOAT32_IEEE 0 SWC_FDC_type_CM_single_Gps 0.0 1.0 /end CHARACTERISTIC
/begin CHARACTERISTIC KTQD_EstRollCoeffA_c "" VALUE 0x0000 /* @ECU_Address@KTQD_EstRollCoeffA_c@ */ Scalar_FLOAT32_IEEE 0 SWC_FDC_type_CM_single_c 0.0 1000.0 /end CHARACTERISTIC
/begin CHARACTERISTIC KTQD_EstRollCoeffB_c "" VALUE 0x0000 /* @ECU_Address@KTQD_EstRollCoeffB_c@ */ Scalar_FLOAT32_IEEE 0 SWC_FDC_type_CM_single_c -100.0 100.0 /end CHARACTERISTIC
/begin CHARACTERISTIC KTQD_EstRollCoeffC_c "" VALUE 0x0000 /* @ECU_Address@KTQD_EstRollCoeffC_c@ */ Scalar_FLOAT32_IEEE 0 SWC_FDC_type_CM_single_c -10.0 10.0 /end CHARACTERISTIC
/begin CHARACTERISTIC KTQD_EstRrWhlTqDev_Nm "" VALUE 0x0000 /* @ECU_Address@KTQD_EstRrWhlTqDev_Nm@ */ Scalar_FLOAT32_IEEE 0 SWC_FDC_type_CM_single_Nm 0.0 500.0 /end CHARACTERISTIC
/begin CHARACTERISTIC KTQD_FrLossMAPHighV_V "" VALUE 0x0000 /* @ECU_Address@KTQD_FrLossMAPHighV_V@ */ Scalar_FLOAT32_IEEE 0 SWC_FDC_type_CM_single_v 0.0 1000.0 /end CHARACTERISTIC
/begin CHARACTERISTIC KTQD_FrLossMAPLowV_V "" VALUE 0x0000 /* @ECU_Address@KTQD_FrLossMAPLowV_V@ */ Scalar_FLOAT32_IEEE 0 SWC_FDC_type_CM_single_v 0.0 1000.0 /end CHARACTERISTIC
/begin CHARACTERISTIC KTQD_FrLowTheldTrq_Nm "" VALUE 0x0000 /* @ECU_Address@KTQD_FrLowTheldTrq_Nm@ */ Scalar_FLOAT32_IEEE 0 SWC_FDC_type_CM_single_Nm -100000.0 100000.0 /end CHARACTERISTIC
/begin CHARACTERISTIC KTQD_FrTMSpdMin_rpm "" VALUE 0x0000 /* @ECU_Address@KTQD_FrTMSpdMin_rpm@ */ Scalar_FLOAT32_IEEE 0 SWC_FDC_type_CM_single_rpm -100000.0 100000.0 /end CHARACTERISTIC
/begin CHARACTERISTIC KTQD_FrTireRadius_m "" VALUE 0x0000 /* @ECU_Address@KTQD_FrTireRadius_m@ */ Scalar_FLOAT32_IEEE 0 SWC_FDC_type_CM_single_m 0.0 5.0 /end CHARACTERISTIC
/begin CHARACTERISTIC KTQD_GravityValue_mps2 "" VALUE 0x0000 /* @ECU_Address@KTQD_GravityValue_mps2@ */ Scalar_FLOAT32_IEEE 0 SWC_FDC_type_CM_single_mps2 0.0 20.0 /end CHARACTERISTIC
/begin CHARACTERISTIC KTQD_PedGControlTrigTime_s "" VALUE 0x0000 /* @ECU_Address@KTQD_PedGControlTrigTime_s@ */ Scalar_FLOAT32_IEEE 0 SWC_FDC_type_CM_single_s 0.0 7200.0 /end CHARACTERISTIC
/begin CHARACTERISTIC KTQD_RrLossMAPHighV_V "" VALUE 0x0000 /* @ECU_Address@KTQD_RrLossMAPHighV_V@ */ Scalar_FLOAT32_IEEE 0 SWC_FDC_type_CM_single_v 0.0 1000.0 /end CHARACTERISTIC
/begin CHARACTERISTIC KTQD_RrLossMAPLowV_V "" VALUE 0x0000 /* @ECU_Address@KTQD_RrLossMAPLowV_V@ */ Scalar_FLOAT32_IEEE 0 SWC_FDC_type_CM_single_v 0.0 1000.0 /end CHARACTERISTIC
/begin CHARACTERISTIC KTQD_RrLowTheldTrq_Nm "" VALUE 0x0000 /* @ECU_Address@KTQD_RrLowTheldTrq_Nm@ */ Scalar_FLOAT32_IEEE 0 SWC_FDC_type_CM_single_Nm -100000.0 100000.0 /end CHARACTERISTIC
/begin CHARACTERISTIC KTQD_RrTMSpdMin_rpm "" VALUE 0x0000 /* @ECU_Address@KTQD_RrTMSpdMin_rpm@ */ Scalar_FLOAT32_IEEE 0 SWC_FDC_type_CM_single_rpm -100000.0 100000.0 /end CHARACTERISTIC
/begin CHARACTERISTIC KTQD_RrTireRadius_m "" VALUE 0x0000 /* @ECU_Address@KTQD_RrTireRadius_m@ */ Scalar_FLOAT32_IEEE 0 SWC_FDC_type_CM_single_m 0.0 5.0 /end CHARACTERISTIC
/begin CHARACTERISTIC KTQD_ScrollDownLongPLim_s "" VALUE 0x0000 /* @ECU_Address@KTQD_ScrollDownLongPLim_s@ */ Scalar_FLOAT32_IEEE 0 SWC_FDC_type_CM_single_s 0.0 10.0 /end CHARACTERISTIC
/begin CHARACTERISTIC KTQD_ScrollDownShortPLim_s "" VALUE 0x0000 /* @ECU_Address@KTQD_ScrollDownShortPLim_s@ */ Scalar_FLOAT32_IEEE 0 SWC_FDC_type_CM_single_s 0.0 10.0 /end CHARACTERISTIC
/begin CHARACTERISTIC KTQD_ScrollUpLongPLim_s "" VALUE 0x0000 /* @ECU_Address@KTQD_ScrollUpLongPLim_s@ */ Scalar_FLOAT32_IEEE 0 SWC_FDC_type_CM_single_s 0.0 10.0 /end CHARACTERISTIC
/begin CHARACTERISTIC KTQD_ScrollUpShortPLim_s "" VALUE 0x0000 /* @ECU_Address@KTQD_ScrollUpShortPLim_s@ */ Scalar_FLOAT32_IEEE 0 SWC_FDC_type_CM_single_s 0.0 10.0 /end CHARACTERISTIC
/begin CHARACTERISTIC KTQD_SetSpdLongPLim_s "" VALUE 0x0000 /* @ECU_Address@KTQD_SetSpdLongPLim_s@ */ Scalar_FLOAT32_IEEE 0 SWC_FDC_type_CM_single_s 0.0 10.0 /end CHARACTERISTIC
/begin CHARACTERISTIC KTQD_SetSpdShortPLim_s "" VALUE 0x0000 /* @ECU_Address@KTQD_SetSpdShortPLim_s@ */ Scalar_FLOAT32_IEEE 0 SWC_FDC_type_CM_single_s 0.0 10.0 /end CHARACTERISTIC
/begin CHARACTERISTIC KTQD_VehWeighEstIntAcc_Gps "" VALUE 0x0000 /* @ECU_Address@KTQD_VehWeighEstIntAcc_Gps@ */ Scalar_FLOAT32_IEEE 0 SWC_FDC_type_CM_single_Gps -10.0 10.0 /end CHARACTERISTIC
/begin CHARACTERISTIC KTQD_VehWeighEstTimeTune_cnt "" VALUE 0x0000 /* @ECU_Address@KTQD_VehWeighEstTimeTune_cnt@ */ Scalar_FLOAT32_IEEE 0 SWC_FDC_type_CM_single_cnt -15.0 15.0 /end CHARACTERISTIC
/begin CHARACTERISTIC KTQD_WhlTqCapGenFr_Nm_ovrdval "" VALUE 0x0000 /* @ECU_Address@KTQD_WhlTqCapGenFr_Nm_ovrdval@ */ Scalar_FLOAT32_IEEE 0 SWC_FDC_type_CM_single_Nm -100000.0 100000.0 /end CHARACTERISTIC
/begin CHARACTERISTIC KTQD_WhlTqCapGenRr_Nm_ovrdval "" VALUE 0x0000 /* @ECU_Address@KTQD_WhlTqCapGenRr_Nm_ovrdval@ */ Scalar_FLOAT32_IEEE 0 SWC_FDC_type_CM_single_Nm -100000.0 100000.0 /end CHARACTERISTIC
/begin CHARACTERISTIC KTQD_WhlTqCapMotFr_Nm_ovrdval "" VALUE 0x0000 /* @ECU_Address@KTQD_WhlTqCapMotFr_Nm_ovrdval@ */ Scalar_FLOAT32_IEEE 0 SWC_FDC_type_CM_single_Nm -100000.0 100000.0 /end CHARACTERISTIC
/begin CHARACTERISTIC KTQD_WhlTqCapMotRr_Nm_ovrdval "" VALUE 0x0000 /* @ECU_Address@KTQD_WhlTqCapMotRr_Nm_ovrdval@ */ Scalar_FLOAT32_IEEE 0 SWC_FDC_type_CM_single_Nm -100000.0 100000.0 /end CHARACTERISTIC
/begin CHARACTERISTIC KVMC_4WheelEnSkidDetSpd_kph "" VALUE 0x0000 /* @ECU_Address@KVMC_4WheelEnSkidDetSpd_kph@ */ Scalar_FLOAT32_IEEE 0 SWC_FDC_type_CM_single_kph -10.0 300.0 /end CHARACTERISTIC
/begin CHARACTERISTIC KVMC_PreVehSpdNum_c "" VALUE 0x0000 /* @ECU_Address@KVMC_PreVehSpdNum_c@ */ Scalar_FLOAT32_IEEE 0 SWC_FDC_type_CM_single_kph 1.0 20.0 /end CHARACTERISTIC
/begin CHARACTERISTIC KVMC_PredVehSpdLimit_mps "" VALUE 0x0000 /* @ECU_Address@KVMC_PredVehSpdLimit_mps@ */ Scalar_FLOAT32_IEEE 0 SWC_FDC_type_CM_single_mps 0.0 300.0 /end CHARACTERISTIC
/begin CHARACTERISTIC KVMC_SkidRecVehSpdDev_kph "" VALUE 0x0000 /* @ECU_Address@KVMC_SkidRecVehSpdDev_kph@ */ Scalar_FLOAT32_IEEE 0 SWC_FDC_type_CM_single_kph 0.0 300.0 /end CHARACTERISTIC
/begin CHARACTERISTIC KVMC_WheelSkidAccDev_Gps "" VALUE 0x0000 /* @ECU_Address@KVMC_WheelSkidAccDev_Gps@ */ Scalar_FLOAT32_IEEE 0 SWC_FDC_type_CM_single_Gps 0.0 5.0 /end CHARACTERISTIC
/begin CHARACTERISTIC KVMC_WhlSpdCalAccTs_c "" VALUE 0x0000 /* @ECU_Address@KVMC_WhlSpdCalAccTs_c@ */ Scalar_FLOAT32_IEEE 0 SWC_FDC_type_CM_single_c 0.0 1.0 /end CHARACTERISTIC
/begin CHARACTERISTIC KTQD_ACCOVRDSpdAdj_flg "" VALUE 0x0000 /* @ECU_Address@KTQD_ACCOVRDSpdAdj_flg@ */ Scalar_BOOLEAN 0 SWC_FDC_type_CM_boolean_flg 0.0 1.0 /end CHARACTERISTIC
/begin CHARACTERISTIC KTQD_AllowSetSpdOvrdVal_flg "" VALUE 0x0000 /* @ECU_Address@KTQD_AllowSetSpdOvrdVal_flg@ */ Scalar_BOOLEAN 0 SWC_FDC_type_CM_boolean_flg 0.0 1.0 /end CHARACTERISTIC
/begin CHARACTERISTIC KTQD_AllowSetSpdOvrd_flg "" VALUE 0x0000 /* @ECU_Address@KTQD_AllowSetSpdOvrd_flg@ */ Scalar_BOOLEAN 0 SWC_FDC_type_CM_boolean_flg 0.0 1.0 /end CHARACTERISTIC
/begin CHARACTERISTIC KTQD_ISATestSW_flg "" VALUE 0x0000 /* @ECU_Address@KTQD_ISATestSW_flg@ */ Scalar_BOOLEAN 0 SWC_FDC_type_CM_boolean_flg 0.0 1.0 /end CHARACTERISTIC
/begin CHARACTERISTIC KTQD_PedAccTqEn_flg_ovrdflg "" VALUE 0x0000 /* @ECU_Address@KTQD_PedAccTqEn_flg_ovrdflg@ */ Scalar_BOOLEAN 0 SWC_FDC_type_CM_boolean_flg 0.0 1.0 /end CHARACTERISTIC
/begin CHARACTERISTIC KTQD_PedAccTqEn_flg_ovrdval "" VALUE 0x0000 /* @ECU_Address@KTQD_PedAccTqEn_flg_ovrdval@ */ Scalar_BOOLEAN 0 SWC_FDC_type_CM_boolean_flg 0.0 1.0 /end CHARACTERISTIC
/begin CHARACTERISTIC KTQD_PedGControlModeSW_flg "" VALUE 0x0000 /* @ECU_Address@KTQD_PedGControlModeSW_flg@ */ Scalar_BOOLEAN 0 SWC_FDC_type_CM_boolean_flg 0.0 1.0 /end CHARACTERISTIC
/begin CHARACTERISTIC KTQD_WhlTqCapGenFr_Nm_ovrdflg "" VALUE 0x0000 /* @ECU_Address@KTQD_WhlTqCapGenFr_Nm_ovrdflg@ */ Scalar_BOOLEAN 0 SWC_FDC_type_CM_boolean_flg 0.0 1.0 /end CHARACTERISTIC
/begin CHARACTERISTIC KTQD_WhlTqCapGenRr_Nm_ovrdflg "" VALUE 0x0000 /* @ECU_Address@KTQD_WhlTqCapGenRr_Nm_ovrdflg@ */ Scalar_BOOLEAN 0 SWC_FDC_type_CM_boolean_flg 0.0 1.0 /end CHARACTERISTIC
/begin CHARACTERISTIC KTQD_WhlTqCapMotFr_Nm_ovrdflg "" VALUE 0x0000 /* @ECU_Address@KTQD_WhlTqCapMotFr_Nm_ovrdflg@ */ Scalar_BOOLEAN 0 SWC_FDC_type_CM_boolean_flg 0.0 1.0 /end CHARACTERISTIC
/begin CHARACTERISTIC KTQD_WhlTqCapMotRr_Nm_ovrdflg "" VALUE 0x0000 /* @ECU_Address@KTQD_WhlTqCapMotRr_Nm_ovrdflg@ */ Scalar_BOOLEAN 0 SWC_FDC_type_CM_boolean_flg 0.0 1.0 /end CHARACTERISTIC
/begin CHARACTERISTIC KVMC_LFWhlSkidReset_flg "" VALUE 0x0000 /* @ECU_Address@KVMC_LFWhlSkidReset_flg@ */ Scalar_BOOLEAN 0 SWC_FDC_type_CM_boolean_flg 0.0 1.0 /end CHARACTERISTIC
/begin CHARACTERISTIC KVMC_LRWhlSkidReset_flg "" VALUE 0x0000 /* @ECU_Address@KVMC_LRWhlSkidReset_flg@ */ Scalar_BOOLEAN 0 SWC_FDC_type_CM_boolean_flg 0.0 1.0 /end CHARACTERISTIC
/begin CHARACTERISTIC KVMC_PreVehSpdCalSW_flg "" VALUE 0x0000 /* @ECU_Address@KVMC_PreVehSpdCalSW_flg@ */ Scalar_BOOLEAN 0 SWC_FDC_type_CM_boolean_flg 0.0 1.0 /end CHARACTERISTIC
/begin CHARACTERISTIC KVMC_RFWhlSkidReset_flg "" VALUE 0x0000 /* @ECU_Address@KVMC_RFWhlSkidReset_flg@ */ Scalar_BOOLEAN 0 SWC_FDC_type_CM_boolean_flg 0.0 1.0 /end CHARACTERISTIC
/begin CHARACTERISTIC KVMC_RRWhlSkidReset_flg "" VALUE 0x0000 /* @ECU_Address@KVMC_RRWhlSkidReset_flg@ */ Scalar_BOOLEAN 0 SWC_FDC_type_CM_boolean_flg 0.0 1.0 /end CHARACTERISTIC
/begin CHARACTERISTIC KTPM_Delay_raw8 "" VALUE 0x0000 /* @ECU_Address@KTPM_Delay_raw8@ */ Scalar_UBYTE 0 SWC_FDC_type_CM_uint8_raw8 0.0 255.0 /end CHARACTERISTIC
/begin CHARACTERISTIC KTQD_ACCActiveMetSpdHiMPH_mph "" VALUE 0x0000 /* @ECU_Address@KTQD_ACCActiveMetSpdHiMPH_mph@ */ Scalar_UBYTE 0 SWC_FDC_type_CM_uint8_kph 0.0 250.0 /end CHARACTERISTIC
/begin CHARACTERISTIC KTQD_ACCActiveMetSpdHi_kph "" VALUE 0x0000 /* @ECU_Address@KTQD_ACCActiveMetSpdHi_kph@ */ Scalar_UBYTE 0 SWC_FDC_type_CM_uint8_kph 0.0 250.0 /end CHARACTERISTIC
/begin CHARACTERISTIC KTQD_CANCELUpCount_cnt "" VALUE 0x0000 /* @ECU_Address@KTQD_CANCELUpCount_cnt@ */ Scalar_UBYTE 0 SWC_FDC_type_CM_uint8_cnt 0.0 15.0 /end CHARACTERISTIC
/begin CHARACTERISTIC KTQD_SetSpdDeltaLongMPH_mph "" VALUE 0x0000 /* @ECU_Address@KTQD_SetSpdDeltaLongMPH_mph@ */ Scalar_UBYTE 0 SWC_FDC_type_CM_uint8_kph 0.0 250.0 /end CHARACTERISTIC
/begin CHARACTERISTIC KTQD_SetSpdDeltaLong_kph "" VALUE 0x0000 /* @ECU_Address@KTQD_SetSpdDeltaLong_kph@ */ Scalar_UBYTE 0 SWC_FDC_type_CM_uint8_kph 0.0 250.0 /end CHARACTERISTIC
/begin CHARACTERISTIC KTQD_SetSpdDeltaShort_kph "" VALUE 0x0000 /* @ECU_Address@KTQD_SetSpdDeltaShort_kph@ */ Scalar_UBYTE 0 SWC_FDC_type_CM_uint8_kph 0.0 250.0 /end CHARACTERISTIC
/begin CHARACTERISTIC KTQR_EnEcoFrIncGain_enum "" VALUE 0x0000 /* @ECU_Address@KTQR_EnEcoFrIncGain_enum@ */ Scalar_UBYTE 0 SWC_FDC_type_CM_uint8_enum 0.0 15.0 /end CHARACTERISTIC
/begin CHARACTERISTIC KTQR_EnEcoRrIncGain_enum "" VALUE 0x0000 /* @ECU_Address@KTQR_EnEcoRrIncGain_enum@ */ Scalar_UBYTE 0 SWC_FDC_type_CM_uint8_enum 0.0 15.0 /end CHARACTERISTIC
/begin CHARACTERISTIC KTQR_EnNormalFrIncGain_enum "" VALUE 0x0000 /* @ECU_Address@KTQR_EnNormalFrIncGain_enum@ */ Scalar_UBYTE 0 SWC_FDC_type_CM_uint8_enum 0.0 15.0 /end CHARACTERISTIC
/begin CHARACTERISTIC KTQR_EnNormalRrIncGain_enum "" VALUE 0x0000 /* @ECU_Address@KTQR_EnNormalRrIncGain_enum@ */ Scalar_UBYTE 0 SWC_FDC_type_CM_uint8_enum 0.0 15.0 /end CHARACTERISTIC
/begin CHARACTERISTIC KTQR_EnSportFrIncGain_enum "" VALUE 0x0000 /* @ECU_Address@KTQR_EnSportFrIncGain_enum@ */ Scalar_UBYTE 0 SWC_FDC_type_CM_uint8_enum 0.0 15.0 /end CHARACTERISTIC
/begin CHARACTERISTIC KTQR_EnSportRrIncGain_enum "" VALUE 0x0000 /* @ECU_Address@KTQR_EnSportRrIncGain_enum@ */ Scalar_UBYTE 0 SWC_FDC_type_CM_uint8_enum 0.0 15.0 /end CHARACTERISTIC
/begin CHARACTERISTIC KVMC_PreVehSpdSource_enum "" VALUE 0x0000 /* @ECU_Address@KVMC_PreVehSpdSource_enum@ */ Scalar_UBYTE 0 SWC_FDC_type_CM_uint8_enum 0.0 15.0 /end CHARACTERISTIC
/begin MEASUREMENT VTPM_S1ID_raw32 "" ULONG SWC_FDC_type_CM_uint32_raw32 0 0 0.0 4.294967295E+9 ECU_ADDRESS 0x0000 /* @ECU_Address@VTPM_S1ID_raw32@ */ /end MEASUREMENT
/begin MEASUREMENT VTPM_S2ID_raw32 "" ULONG SWC_FDC_type_CM_uint32_raw32 0 0 0.0 4.294967295E+9 ECU_ADDRESS 0x0000 /* @ECU_Address@VTPM_S2ID_raw32@ */ /end MEASUREMENT
/begin MEASUREMENT VTPM_S3ID_raw32 "" ULONG SWC_FDC_type_CM_uint32_raw32 0 0 0.0 4.294967295E+9 ECU_ADDRESS 0x0000 /* @ECU_Address@VTPM_S3ID_raw32@ */ /end MEASUREMENT
/begin MEASUREMENT VTPM_S4ID_raw32 "" ULONG SWC_FDC_type_CM_uint32_raw32 0 0 0.0 4.294967295E+9 ECU_ADDRESS 0x0000 /* @ECU_Address@VTPM_S4ID_raw32@ */ /end MEASUREMENT
/begin MEASUREMENT VTPM_GS2_cnt "" ULONG SWC_FDC_type_CM_uint32_cnt 0 0 0.0 4.294967295E+9 ECU_ADDRESS 0x0000 /* @ECU_Address@VTPM_GS2_cnt@ */ /end MEASUREMENT
/begin MEASUREMENT VTPM_GS3_cnt "" ULONG SWC_FDC_type_CM_uint32_cnt 0 0 0.0 4.294967295E+9 ECU_ADDRESS 0x0000 /* @ECU_Address@VTPM_GS3_cnt@ */ /end MEASUREMENT
/begin MEASUREMENT VTPM_GS4_cnt "" ULONG SWC_FDC_type_CM_uint32_cnt 0 0 0.0 4.294967295E+9 ECU_ADDRESS 0x0000 /* @ECU_Address@VTPM_GS4_cnt@ */ /end MEASUREMENT
/begin MEASUREMENT VTPM_GS1_cnt "" ULONG SWC_FDC_type_CM_uint32_cnt 0 0 0.0 4.294967295E+9 ECU_ADDRESS 0x0000 /* @ECU_Address@VTPM_GS1_cnt@ */ /end MEASUREMENT
/begin MEASUREMENT VTPM_MSensor1ID_raw "" ULONG SWC_FDC_type_CM_uint32_raw 0 0 0.0 4.294967295E+9 ECU_ADDRESS 0x0000 /* @ECU_Address@VTPM_MSensor1ID_raw@ */ /end MEASUREMENT
/begin MEASUREMENT VTPM_MSensor2ID_raw "" ULONG SWC_FDC_type_CM_uint32_raw 0 0 0.0 4.294967295E+9 ECU_ADDRESS 0x0000 /* @ECU_Address@VTPM_MSensor2ID_raw@ */ /end MEASUREMENT
/begin MEASUREMENT VTPM_MSensor3ID_raw "" ULONG SWC_FDC_type_CM_uint32_raw 0 0 0.0 4.294967295E+9 ECU_ADDRESS 0x0000 /* @ECU_Address@VTPM_MSensor3ID_raw@ */ /end MEASUREMENT
/begin MEASUREMENT VTPM_MSensor4ID_raw "" ULONG SWC_FDC_type_CM_uint32_raw 0 0 0.0 4.294967295E+9 ECU_ADDRESS 0x0000 /* @ECU_Address@VTPM_MSensor4ID_raw@ */ /end MEASUREMENT
/begin MEASUREMENT VTPM_MLFID_raw "" ULONG SWC_FDC_type_CM_uint32_raw 0 0 0.0 4.294967295E+9 ECU_ADDRESS 0x0000 /* @ECU_Address@VTPM_MLFID_raw@ */ /end MEASUREMENT
/begin MEASUREMENT VTPM_MLRID_raw "" ULONG SWC_FDC_type_CM_uint32_raw 0 0 0.0 4.294967295E+9 ECU_ADDRESS 0x0000 /* @ECU_Address@VTPM_MLRID_raw@ */ /end MEASUREMENT
/begin MEASUREMENT VTPM_MRFID_raw "" ULONG SWC_FDC_type_CM_uint32_raw 0 0 0.0 4.294967295E+9 ECU_ADDRESS 0x0000 /* @ECU_Address@VTPM_MRFID_raw@ */ /end MEASUREMENT
/begin MEASUREMENT VTPM_MRRID_raw "" ULONG SWC_FDC_type_CM_uint32_raw 0 0 0.0 4.294967295E+9 ECU_ADDRESS 0x0000 /* @ECU_Address@VTPM_MRRID_raw@ */ /end MEASUREMENT
/begin MEASUREMENT VTPM_ManualID1_raw "" ULONG SWC_FDC_type_CM_uint32_raw 0 0 0.0 4.294967295E+9 ECU_ADDRESS 0x0000 /* @ECU_Address@VTPM_ManualID1_raw@ */ /end MEASUREMENT
/begin MEASUREMENT VTPM_ManualID2_raw "" ULONG SWC_FDC_type_CM_uint32_raw 0 0 0.0 4.294967295E+9 ECU_ADDRESS 0x0000 /* @ECU_Address@VTPM_ManualID2_raw@ */ /end MEASUREMENT
/begin MEASUREMENT VTPM_ManualID3_raw "" ULONG SWC_FDC_type_CM_uint32_raw 0 0 0.0 4.294967295E+9 ECU_ADDRESS 0x0000 /* @ECU_Address@VTPM_ManualID3_raw@ */ /end MEASUREMENT
/begin MEASUREMENT VTPM_ManualID4_raw "" ULONG SWC_FDC_type_CM_uint32_raw 0 0 0.0 4.294967295E+9 ECU_ADDRESS 0x0000 /* @ECU_Address@VTPM_ManualID4_raw@ */ /end MEASUREMENT
/begin MEASUREMENT VTPM_FlashS1ID_raw "" ULONG SWC_FDC_type_CM_uint32_raw 0 0 0.0 4.294967295E+9 ECU_ADDRESS 0x0000 /* @ECU_Address@VTPM_FlashS1ID_raw@ */ /end MEASUREMENT
/begin MEASUREMENT VTPM_FlashS2ID_raw "" ULONG SWC_FDC_type_CM_uint32_raw 0 0 0.0 4.294967295E+9 ECU_ADDRESS 0x0000 /* @ECU_Address@VTPM_FlashS2ID_raw@ */ /end MEASUREMENT
/begin MEASUREMENT VTPM_FlashS3ID_raw "" ULONG SWC_FDC_type_CM_uint32_raw 0 0 0.0 4.294967295E+9 ECU_ADDRESS 0x0000 /* @ECU_Address@VTPM_FlashS3ID_raw@ */ /end MEASUREMENT
/begin MEASUREMENT VTPM_FlashS4ID_raw "" ULONG SWC_FDC_type_CM_uint32_raw 0 0 0.0 4.294967295E+9 ECU_ADDRESS 0x0000 /* @ECU_Address@VTPM_FlashS4ID_raw@ */ /end MEASUREMENT
/begin MEASUREMENT VTPM_LFID_raw "" ULONG SWC_FDC_type_CM_uint32_raw 0 0 0.0 4.294967295E+9 ECU_ADDRESS 0x0000 /* @ECU_Address@VTPM_LFID_raw@ */ /end MEASUREMENT
/begin MEASUREMENT VTPM_RFID_raw "" ULONG SWC_FDC_type_CM_uint32_raw 0 0 0.0 4.294967295E+9 ECU_ADDRESS 0x0000 /* @ECU_Address@VTPM_RFID_raw@ */ /end MEASUREMENT
/begin MEASUREMENT VTPM_LRID_raw "" ULONG SWC_FDC_type_CM_uint32_raw 0 0 0.0 4.294967295E+9 ECU_ADDRESS 0x0000 /* @ECU_Address@VTPM_LRID_raw@ */ /end MEASUREMENT
/begin MEASUREMENT VTPM_RRID_raw "" ULONG SWC_FDC_type_CM_uint32_raw 0 0 0.0 4.294967295E+9 ECU_ADDRESS 0x0000 /* @ECU_Address@VTPM_RRID_raw@ */ /end MEASUREMENT
/begin MEASUREMENT VTPM_S1WheelDebugALTU_pct "" FLOAT32_IEEE SWC_FDC_type_CM_single_pct 0 0 0.0 100.0 ECU_ADDRESS 0x0000 /* @ECU_Address@VTPM_S1WheelDebugALTU_pct@ */ /end MEASUREMENT
/begin MEASUREMENT VTPM_S2WheelDebugALTU_pct "" FLOAT32_IEEE SWC_FDC_type_CM_single_pct 0 0 0.0 100.0 ECU_ADDRESS 0x0000 /* @ECU_Address@VTPM_S2WheelDebugALTU_pct@ */ /end MEASUREMENT
/begin MEASUREMENT VTPM_S3WheelDebugALTU_pct "" FLOAT32_IEEE SWC_FDC_type_CM_single_pct 0 0 0.0 100.0 ECU_ADDRESS 0x0000 /* @ECU_Address@VTPM_S3WheelDebugALTU_pct@ */ /end MEASUREMENT
/begin MEASUREMENT VTPM_S4WheelDebugALTU_pct "" FLOAT32_IEEE SWC_FDC_type_CM_single_pct 0 0 0.0 100.0 ECU_ADDRESS 0x0000 /* @ECU_Address@VTPM_S4WheelDebugALTU_pct@ */ /end MEASUREMENT
/begin MEASUREMENT VTPM_ManualID1Temp_C "" FLOAT32_IEEE SWC_FDC_type_CM_single_C 0 0 -40.0 215.0 ECU_ADDRESS 0x0000 /* @ECU_Address@VTPM_ManualID1Temp_C@ */ /end MEASUREMENT
/begin MEASUREMENT VTPM_ManualID2Temp_C "" FLOAT32_IEEE SWC_FDC_type_CM_single_C 0 0 -40.0 215.0 ECU_ADDRESS 0x0000 /* @ECU_Address@VTPM_ManualID2Temp_C@ */ /end MEASUREMENT
/begin MEASUREMENT VTPM_ManualID3Temp_C "" FLOAT32_IEEE SWC_FDC_type_CM_single_C 0 0 -40.0 215.0 ECU_ADDRESS 0x0000 /* @ECU_Address@VTPM_ManualID3Temp_C@ */ /end MEASUREMENT
/begin MEASUREMENT VTPM_ManualID4Temp_C "" FLOAT32_IEEE SWC_FDC_type_CM_single_C 0 0 -40.0 215.0 ECU_ADDRESS 0x0000 /* @ECU_Address@VTPM_ManualID4Temp_C@ */ /end MEASUREMENT
/begin MEASUREMENT VVMC_LFDeltaVehSpd_mps "" FLOAT32_IEEE SWC_FDC_type_CM_single_mps 0 0 0.0 300.0 ECU_ADDRESS 0x0000 /* @ECU_Address@VVMC_LFDeltaVehSpd_mps@ */ /end MEASUREMENT
/begin MEASUREMENT VVMC_LFLastPreVehSpd_mps "" FLOAT32_IEEE SWC_FDC_type_CM_single_mps 0 0 0.0 300.0 ECU_ADDRESS 0x0000 /* @ECU_Address@VVMC_LFLastPreVehSpd_mps@ */ /end MEASUREMENT
/begin MEASUREMENT VVMC_LFCalPreVehSpd_mps "" FLOAT32_IEEE SWC_FDC_type_CM_single_mps 0 0 0.0 300.0 ECU_ADDRESS 0x0000 /* @ECU_Address@VVMC_LFCalPreVehSpd_mps@ */ /end MEASUREMENT
/begin MEASUREMENT VVMC_LFPreVehSpd_kph "" FLOAT32_IEEE SWC_FDC_type_CM_single_kph 0 0 0.0 300.0 ECU_ADDRESS 0x0000 /* @ECU_Address@VVMC_LFPreVehSpd_kph@ */ /end MEASUREMENT
/begin MEASUREMENT VVMC_RFDeltaVehSpd_mps "" FLOAT32_IEEE SWC_FDC_type_CM_single_mps 0 0 0.0 300.0 ECU_ADDRESS 0x0000 /* @ECU_Address@VVMC_RFDeltaVehSpd_mps@ */ /end MEASUREMENT
/begin MEASUREMENT VVMC_RFLastPreVehSpd_mps "" FLOAT32_IEEE SWC_FDC_type_CM_single_mps 0 0 0.0 300.0 ECU_ADDRESS 0x0000 /* @ECU_Address@VVMC_RFLastPreVehSpd_mps@ */ /end MEASUREMENT
/begin MEASUREMENT VVMC_RFCalPreVehSpd_mps "" FLOAT32_IEEE SWC_FDC_type_CM_single_mps 0 0 0.0 300.0 ECU_ADDRESS 0x0000 /* @ECU_Address@VVMC_RFCalPreVehSpd_mps@ */ /end MEASUREMENT
/begin MEASUREMENT VVMC_RFPreVehSpd_kph "" FLOAT32_IEEE SWC_FDC_type_CM_single_kph 0 0 0.0 300.0 ECU_ADDRESS 0x0000 /* @ECU_Address@VVMC_RFPreVehSpd_kph@ */ /end MEASUREMENT
/begin MEASUREMENT VVMC_LRDeltaVehSpd_mps "" FLOAT32_IEEE SWC_FDC_type_CM_single_mps 0 0 0.0 300.0 ECU_ADDRESS 0x0000 /* @ECU_Address@VVMC_LRDeltaVehSpd_mps@ */ /end MEASUREMENT
/begin MEASUREMENT VVMC_LRLastPreVehSpd_mps "" FLOAT32_IEEE SWC_FDC_type_CM_single_mps 0 0 0.0 300.0 ECU_ADDRESS 0x0000 /* @ECU_Address@VVMC_LRLastPreVehSpd_mps@ */ /end MEASUREMENT
/begin MEASUREMENT VVMC_LRCalPreVehSpd_mps "" FLOAT32_IEEE SWC_FDC_type_CM_single_mps 0 0 0.0 300.0 ECU_ADDRESS 0x0000 /* @ECU_Address@VVMC_LRCalPreVehSpd_mps@ */ /end MEASUREMENT
/begin MEASUREMENT VVMC_LRPreVehSpd_kph "" FLOAT32_IEEE SWC_FDC_type_CM_single_kph 0 0 0.0 300.0 ECU_ADDRESS 0x0000 /* @ECU_Address@VVMC_LRPreVehSpd_kph@ */ /end MEASUREMENT
/begin MEASUREMENT VVMC_RRDeltaVehSpd_mps "" FLOAT32_IEEE SWC_FDC_type_CM_single_mps 0 0 0.0 300.0 ECU_ADDRESS 0x0000 /* @ECU_Address@VVMC_RRDeltaVehSpd_mps@ */ /end MEASUREMENT
/begin MEASUREMENT VVMC_RRLastPreVehSpd_mps "" FLOAT32_IEEE SWC_FDC_type_CM_single_mps 0 0 0.0 300.0 ECU_ADDRESS 0x0000 /* @ECU_Address@VVMC_RRLastPreVehSpd_mps@ */ /end MEASUREMENT
/begin MEASUREMENT VVMC_RRCalPreVehSpd_mps "" FLOAT32_IEEE SWC_FDC_type_CM_single_mps 0 0 0.0 300.0 ECU_ADDRESS 0x0000 /* @ECU_Address@VVMC_RRCalPreVehSpd_mps@ */ /end MEASUREMENT
/begin MEASUREMENT VVMC_RRPreVehSpd_kph "" FLOAT32_IEEE SWC_FDC_type_CM_single_kph 0 0 0.0 300.0 ECU_ADDRESS 0x0000 /* @ECU_Address@VVMC_RRPreVehSpd_kph@ */ /end MEASUREMENT
/begin MEASUREMENT VVMC_Max4WhlPreVehSpd_kph "" FLOAT32_IEEE SWC_FDC_type_CM_single_kph 0 0 0.0 300.0 ECU_ADDRESS 0x0000 /* @ECU_Address@VVMC_Max4WhlPreVehSpd_kph@ */ /end MEASUREMENT
/begin MEASUREMENT VVMC_Min4WhlPreVehSpd_kph "" FLOAT32_IEEE SWC_FDC_type_CM_single_kph 0 0 0.0 300.0 ECU_ADDRESS 0x0000 /* @ECU_Address@VVMC_Min4WhlPreVehSpd_kph@ */ /end MEASUREMENT
/begin MEASUREMENT VVMC_PredictVehSpd3_kph "" FLOAT32_IEEE SWC_FDC_type_CM_single_kph 0 0 0.0 300.0 ECU_ADDRESS 0x0000 /* @ECU_Address@VVMC_PredictVehSpd3_kph@ */ /end MEASUREMENT
/begin MEASUREMENT VVMC_PredictVehSpd2_kph "" FLOAT32_IEEE SWC_FDC_type_CM_single_kph 0 0 0.0 300.0 ECU_ADDRESS 0x0000 /* @ECU_Address@VVMC_PredictVehSpd2_kph@ */ /end MEASUREMENT
/begin MEASUREMENT VVMC_DeltaVehSpd_mps "" FLOAT32_IEEE SWC_FDC_type_CM_single_mps 0 0 0.0 300.0 ECU_ADDRESS 0x0000 /* @ECU_Address@VVMC_DeltaVehSpd_mps@ */ /end MEASUREMENT
/begin MEASUREMENT VVMC_LastPredictVehSpd_mps "" FLOAT32_IEEE SWC_FDC_type_CM_single_mps 0 0 0.0 300.0 ECU_ADDRESS 0x0000 /* @ECU_Address@VVMC_LastPredictVehSpd_mps@ */ /end MEASUREMENT
/begin MEASUREMENT VVMC_CalPredictVehSpd_mps "" FLOAT32_IEEE SWC_FDC_type_CM_single_mps 0 0 0.0 300.0 ECU_ADDRESS 0x0000 /* @ECU_Address@VVMC_CalPredictVehSpd_mps@ */ /end MEASUREMENT
/begin MEASUREMENT VVMC_PredictVehSpd1_kph "" FLOAT32_IEEE SWC_FDC_type_CM_single_kph 0 0 0.0 300.0 ECU_ADDRESS 0x0000 /* @ECU_Address@VVMC_PredictVehSpd1_kph@ */ /end MEASUREMENT
/begin MEASUREMENT VVMC_PredictVehSpd_kph "" FLOAT32_IEEE SWC_FDC_type_CM_single_kph 0 0 0.0 300.0 ECU_ADDRESS 0x0000 /* @ECU_Address@VVMC_PredictVehSpd_kph@ */ /end MEASUREMENT
/begin MEASUREMENT VVMC_LFCal4WhlSpdSlideRate_pct "" FLOAT32_IEEE SWC_FDC_type_CM_single_pct 0 0 0.0 125.0 ECU_ADDRESS 0x0000 /* @ECU_Address@VVMC_LFCal4WhlSpdSlideRate_pct@ */ /end MEASUREMENT
/begin MEASUREMENT VVMC_LF4WhlSpdSlideRate_pct "" FLOAT32_IEEE SWC_FDC_type_CM_single_pct 0 0 0.0 125.0 ECU_ADDRESS 0x0000 /* @ECU_Address@VVMC_LF4WhlSpdSlideRate_pct@ */ /end MEASUREMENT
/begin MEASUREMENT VVMC_RFCal4WhlSpdSlideRate_pct "" FLOAT32_IEEE SWC_FDC_type_CM_single_pct 0 0 0.0 125.0 ECU_ADDRESS 0x0000 /* @ECU_Address@VVMC_RFCal4WhlSpdSlideRate_pct@ */ /end MEASUREMENT
/begin MEASUREMENT VVMC_RF4WhlSpdSlideRate_pct "" FLOAT32_IEEE SWC_FDC_type_CM_single_pct 0 0 0.0 125.0 ECU_ADDRESS 0x0000 /* @ECU_Address@VVMC_RF4WhlSpdSlideRate_pct@ */ /end MEASUREMENT
/begin MEASUREMENT VVMC_LRCal4WhlSpdSlideRate_pct "" FLOAT32_IEEE SWC_FDC_type_CM_single_pct 0 0 0.0 125.0 ECU_ADDRESS 0x0000 /* @ECU_Address@VVMC_LRCal4WhlSpdSlideRate_pct@ */ /end MEASUREMENT
/begin MEASUREMENT VVMC_LR4WhlSpdSlideRate_pct "" FLOAT32_IEEE SWC_FDC_type_CM_single_pct 0 0 0.0 125.0 ECU_ADDRESS 0x0000 /* @ECU_Address@VVMC_LR4WhlSpdSlideRate_pct@ */ /end MEASUREMENT
/begin MEASUREMENT VVMC_RRCal4WhlSpdSlideRate_pct "" FLOAT32_IEEE SWC_FDC_type_CM_single_pct 0 0 0.0 125.0 ECU_ADDRESS 0x0000 /* @ECU_Address@VVMC_RRCal4WhlSpdSlideRate_pct@ */ /end MEASUREMENT
/begin MEASUREMENT VVMC_RR4WhlSpdSlideRate_pct "" FLOAT32_IEEE SWC_FDC_type_CM_single_pct 0 0 0.0 125.0 ECU_ADDRESS 0x0000 /* @ECU_Address@VVMC_RR4WhlSpdSlideRate_pct@ */ /end MEASUREMENT
/begin MEASUREMENT VVMC_Min4WhlSpdSlideRate_pct "" FLOAT32_IEEE SWC_FDC_type_CM_single_pct 0 0 0.0 125.0 ECU_ADDRESS 0x0000 /* @ECU_Address@VVMC_Min4WhlSpdSlideRate_pct@ */ /end MEASUREMENT
/begin MEASUREMENT VVMC_Max4WhlSpdSlideRate_pct "" FLOAT32_IEEE SWC_FDC_type_CM_single_pct 0 0 0.0 125.0 ECU_ADDRESS 0x0000 /* @ECU_Address@VVMC_Max4WhlSpdSlideRate_pct@ */ /end MEASUREMENT
/begin MEASUREMENT VVMC_4WhlSpdSlideRate_pct "" FLOAT32_IEEE SWC_FDC_type_CM_single_pct 0 0 0.0 125.0 ECU_ADDRESS 0x0000 /* @ECU_Address@VVMC_4WhlSpdSlideRate_pct@ */ /end MEASUREMENT
/begin MEASUREMENT VVMC_ActRRSlideRate_pct "" FLOAT32_IEEE SWC_FDC_type_CM_single_pct 0 0 0.0 125.0 ECU_ADDRESS 0x0000 /* @ECU_Address@VVMC_ActRRSlideRate_pct@ */ /end MEASUREMENT
/begin MEASUREMENT VVMC_ActLRSlideRate_pct "" FLOAT32_IEEE SWC_FDC_type_CM_single_pct 0 0 0.0 125.0 ECU_ADDRESS 0x0000 /* @ECU_Address@VVMC_ActLRSlideRate_pct@ */ /end MEASUREMENT
/begin MEASUREMENT VVMC_ActRFSlideRate_pct "" FLOAT32_IEEE SWC_FDC_type_CM_single_pct 0 0 0.0 125.0 ECU_ADDRESS 0x0000 /* @ECU_Address@VVMC_ActRFSlideRate_pct@ */ /end MEASUREMENT
/begin MEASUREMENT VVMC_ActLFSlideRate_pct "" FLOAT32_IEEE SWC_FDC_type_CM_single_pct 0 0 0.0 125.0 ECU_ADDRESS 0x0000 /* @ECU_Address@VVMC_ActLFSlideRate_pct@ */ /end MEASUREMENT
/begin MEASUREMENT VVMC_IntMaxSlideRate_pct "" FLOAT32_IEEE SWC_FDC_type_CM_single_pct 0 0 0.0 125.0 ECU_ADDRESS 0x0000 /* @ECU_Address@VVMC_IntMaxSlideRate_pct@ */ /end MEASUREMENT
/begin MEASUREMENT VVMC_RRWhlCalAcc_Gps "" FLOAT32_IEEE SWC_FDC_type_CM_single_Gps 0 0 0.0 20.0 ECU_ADDRESS 0x0000 /* @ECU_Address@VVMC_RRWhlCalAcc_Gps@ */ /end MEASUREMENT
/begin MEASUREMENT VVMC_RFWhlCalAcc_Gps "" FLOAT32_IEEE SWC_FDC_type_CM_single_Gps 0 0 0.0 20.0 ECU_ADDRESS 0x0000 /* @ECU_Address@VVMC_RFWhlCalAcc_Gps@ */ /end MEASUREMENT
/begin MEASUREMENT VVMC_LRWhlCalAcc_Gps "" FLOAT32_IEEE SWC_FDC_type_CM_single_Gps 0 0 0.0 20.0 ECU_ADDRESS 0x0000 /* @ECU_Address@VVMC_LRWhlCalAcc_Gps@ */ /end MEASUREMENT
/begin MEASUREMENT VVMC_LFWhlCalAcc_Gps "" FLOAT32_IEEE SWC_FDC_type_CM_single_Gps 0 0 0.0 20.0 ECU_ADDRESS 0x0000 /* @ECU_Address@VVMC_LFWhlCalAcc_Gps@ */ /end MEASUREMENT
/begin MEASUREMENT VTQR_FShaftSpdDevTime_s "" FLOAT32_IEEE SWC_FDC_type_CM_single_s 0 0 0.0 3600.0 ECU_ADDRESS 0x0000 /* @ECU_Address@VTQR_FShaftSpdDevTime_s@ */ /end MEASUREMENT
/begin MEASUREMENT VTQR_RShaftSpdDevTime_s "" FLOAT32_IEEE SWC_FDC_type_CM_single_s 0 0 0.0 3600.0 ECU_ADDRESS 0x0000 /* @ECU_Address@VTQR_RShaftSpdDevTime_s@ */ /end MEASUREMENT
/begin MEASUREMENT VTQR_SportTqRrIncGain_c "" FLOAT32_IEEE SWC_FDC_type_CM_single_c 0 0 0.0 300.0 ECU_ADDRESS 0x0000 /* @ECU_Address@VTQR_SportTqRrIncGain_c@ */ /end MEASUREMENT
/begin MEASUREMENT VTQR_SportOPDTqRrIncGain_c "" FLOAT32_IEEE SWC_FDC_type_CM_single_c 0 0 0.0 1.0 ECU_ADDRESS 0x0000 /* @ECU_Address@VTQR_SportOPDTqRrIncGain_c@ */ /end MEASUREMENT
/begin MEASUREMENT VTQR_Sport5TqRrIncGain_c "" FLOAT32_IEEE SWC_FDC_type_CM_single_c 0 0 0.0 1.0 ECU_ADDRESS 0x0000 /* @ECU_Address@VTQR_Sport5TqRrIncGain_c@ */ /end MEASUREMENT
/begin MEASUREMENT VTQR_Sport4TqRrIncGain_c "" FLOAT32_IEEE SWC_FDC_type_CM_single_c 0 0 0.0 1.0 ECU_ADDRESS 0x0000 /* @ECU_Address@VTQR_Sport4TqRrIncGain_c@ */ /end MEASUREMENT
/begin MEASUREMENT VTQR_Sport3TqRrIncGain_c "" FLOAT32_IEEE SWC_FDC_type_CM_single_c 0 0 0.0 1.0 ECU_ADDRESS 0x0000 /* @ECU_Address@VTQR_Sport3TqRrIncGain_c@ */ /end MEASUREMENT
/begin MEASUREMENT VTQR_Sport2TqRrIncGain_c "" FLOAT32_IEEE SWC_FDC_type_CM_single_c 0 0 0.0 1.0 ECU_ADDRESS 0x0000 /* @ECU_Address@VTQR_Sport2TqRrIncGain_c@ */ /end MEASUREMENT
/begin MEASUREMENT VTQR_EcoTqRrIncGain_c "" FLOAT32_IEEE SWC_FDC_type_CM_single_c 0 0 0.0 300.0 ECU_ADDRESS 0x0000 /* @ECU_Address@VTQR_EcoTqRrIncGain_c@ */ /end MEASUREMENT
/begin MEASUREMENT VTQR_ECOOPDTqRrIncGain_c "" FLOAT32_IEEE SWC_FDC_type_CM_single_c 0 0 0.0 1.0 ECU_ADDRESS 0x0000 /* @ECU_Address@VTQR_ECOOPDTqRrIncGain_c@ */ /end MEASUREMENT
/begin MEASUREMENT VTQR_ECO5TqRrIncGain_c "" FLOAT32_IEEE SWC_FDC_type_CM_single_c 0 0 0.0 1.0 ECU_ADDRESS 0x0000 /* @ECU_Address@VTQR_ECO5TqRrIncGain_c@ */ /end MEASUREMENT
/begin MEASUREMENT VTQR_ECO4TqRrIncGain_c "" FLOAT32_IEEE SWC_FDC_type_CM_single_c 0 0 0.0 1.0 ECU_ADDRESS 0x0000 /* @ECU_Address@VTQR_ECO4TqRrIncGain_c@ */ /end MEASUREMENT
/begin MEASUREMENT VTQR_ECO3TqRrIncGain_c "" FLOAT32_IEEE SWC_FDC_type_CM_single_c 0 0 0.0 1.0 ECU_ADDRESS 0x0000 /* @ECU_Address@VTQR_ECO3TqRrIncGain_c@ */ /end MEASUREMENT
/begin MEASUREMENT VTQR_ECO2TqRrIncGain_c "" FLOAT32_IEEE SWC_FDC_type_CM_single_c 0 0 0.0 1.0 ECU_ADDRESS 0x0000 /* @ECU_Address@VTQR_ECO2TqRrIncGain_c@ */ /end MEASUREMENT
/begin MEASUREMENT VTQR_NormalTqRrIncGain_c "" FLOAT32_IEEE SWC_FDC_type_CM_single_c 0 0 0.0 300.0 ECU_ADDRESS 0x0000 /* @ECU_Address@VTQR_NormalTqRrIncGain_c@ */ /end MEASUREMENT
/begin MEASUREMENT VTQR_NLOPDTqRrIncGain_c "" FLOAT32_IEEE SWC_FDC_type_CM_single_c 0 0 0.0 1.0 ECU_ADDRESS 0x0000 /* @ECU_Address@VTQR_NLOPDTqRrIncGain_c@ */ /end MEASUREMENT
/begin MEASUREMENT VTQR_NL5TqRrIncGain_c "" FLOAT32_IEEE SWC_FDC_type_CM_single_c 0 0 0.0 1.0 ECU_ADDRESS 0x0000 /* @ECU_Address@VTQR_NL5TqRrIncGain_c@ */ /end MEASUREMENT
/begin MEASUREMENT VTQR_NL4TqRrIncGain_c "" FLOAT32_IEEE SWC_FDC_type_CM_single_c 0 0 0.0 1.0 ECU_ADDRESS 0x0000 /* @ECU_Address@VTQR_NL4TqRrIncGain_c@ */ /end MEASUREMENT
/begin MEASUREMENT VTQR_NL3TqRrIncGain_c "" FLOAT32_IEEE SWC_FDC_type_CM_single_c 0 0 0.0 1.0 ECU_ADDRESS 0x0000 /* @ECU_Address@VTQR_NL3TqRrIncGain_c@ */ /end MEASUREMENT
/begin MEASUREMENT VTQR_NL2TqRrIncGain_c "" FLOAT32_IEEE SWC_FDC_type_CM_single_c 0 0 0.0 1.0 ECU_ADDRESS 0x0000 /* @ECU_Address@VTQR_NL2TqRrIncGain_c@ */ /end MEASUREMENT
/begin MEASUREMENT VTQR_SnowMTqRrIncGain_c "" FLOAT32_IEEE SWC_FDC_type_CM_single_c 0 0 0.0 300.0 ECU_ADDRESS 0x0000 /* @ECU_Address@VTQR_SnowMTqRrIncGain_c@ */ /end MEASUREMENT
/begin MEASUREMENT VTQR_SportTqFrIncGain_c "" FLOAT32_IEEE SWC_FDC_type_CM_single_c 0 0 0.0 300.0 ECU_ADDRESS 0x0000 /* @ECU_Address@VTQR_SportTqFrIncGain_c@ */ /end MEASUREMENT
/begin MEASUREMENT VTQR_SportOPDTqFrIncGain_c "" FLOAT32_IEEE SWC_FDC_type_CM_single_c 0 0 0.0 1.0 ECU_ADDRESS 0x0000 /* @ECU_Address@VTQR_SportOPDTqFrIncGain_c@ */ /end MEASUREMENT
/begin MEASUREMENT VTQR_Sport5TqFrIncGain_c "" FLOAT32_IEEE SWC_FDC_type_CM_single_c 0 0 0.0 1.0 ECU_ADDRESS 0x0000 /* @ECU_Address@VTQR_Sport5TqFrIncGain_c@ */ /end MEASUREMENT
/begin MEASUREMENT VTQR_Sport4TqFrIncGain_c "" FLOAT32_IEEE SWC_FDC_type_CM_single_c 0 0 0.0 1.0 ECU_ADDRESS 0x0000 /* @ECU_Address@VTQR_Sport4TqFrIncGain_c@ */ /end MEASUREMENT
/begin MEASUREMENT VTQR_Sport3TqFrIncGain_c "" FLOAT32_IEEE SWC_FDC_type_CM_single_c 0 0 0.0 1.0 ECU_ADDRESS 0x0000 /* @ECU_Address@VTQR_Sport3TqFrIncGain_c@ */ /end MEASUREMENT
/begin MEASUREMENT VTQR_Sport2TqFrIncGain_c "" FLOAT32_IEEE SWC_FDC_type_CM_single_c 0 0 0.0 1.0 ECU_ADDRESS 0x0000 /* @ECU_Address@VTQR_Sport2TqFrIncGain_c@ */ /end MEASUREMENT
/begin MEASUREMENT VTQR_EcoTqFrIncGain_c "" FLOAT32_IEEE SWC_FDC_type_CM_single_c 0 0 0.0 300.0 ECU_ADDRESS 0x0000 /* @ECU_Address@VTQR_EcoTqFrIncGain_c@ */ /end MEASUREMENT
/begin MEASUREMENT VTQR_ECOOPDTqFrIncGain_c "" FLOAT32_IEEE SWC_FDC_type_CM_single_c 0 0 0.0 1.0 ECU_ADDRESS 0x0000 /* @ECU_Address@VTQR_ECOOPDTqFrIncGain_c@ */ /end MEASUREMENT
/begin MEASUREMENT VTQR_ECO5TqFrIncGain_c "" FLOAT32_IEEE SWC_FDC_type_CM_single_c 0 0 0.0 1.0 ECU_ADDRESS 0x0000 /* @ECU_Address@VTQR_ECO5TqFrIncGain_c@ */ /end MEASUREMENT
/begin MEASUREMENT VTQR_ECO4TqFrIncGain_c "" FLOAT32_IEEE SWC_FDC_type_CM_single_c 0 0 0.0 1.0 ECU_ADDRESS 0x0000 /* @ECU_Address@VTQR_ECO4TqFrIncGain_c@ */ /end MEASUREMENT
/begin MEASUREMENT VTQR_ECO3TqFrIncGain_c "" FLOAT32_IEEE SWC_FDC_type_CM_single_c 0 0 0.0 1.0 ECU_ADDRESS 0x0000 /* @ECU_Address@VTQR_ECO3TqFrIncGain_c@ */ /end MEASUREMENT
/begin MEASUREMENT VTQR_ECO2TqFrIncGain_c "" FLOAT32_IEEE SWC_FDC_type_CM_single_c 0 0 0.0 1.0 ECU_ADDRESS 0x0000 /* @ECU_Address@VTQR_ECO2TqFrIncGain_c@ */ /end MEASUREMENT
/begin MEASUREMENT VTQR_NormalTqFrIncGain_c "" FLOAT32_IEEE SWC_FDC_type_CM_single_c 0 0 0.0 300.0 ECU_ADDRESS 0x0000 /* @ECU_Address@VTQR_NormalTqFrIncGain_c@ */ /end MEASUREMENT
/begin MEASUREMENT VTQR_NLOPDTqFrIncGain_c "" FLOAT32_IEEE SWC_FDC_type_CM_single_c 0 0 0.0 1.0 ECU_ADDRESS 0x0000 /* @ECU_Address@VTQR_NLOPDTqFrIncGain_c@ */ /end MEASUREMENT
/begin MEASUREMENT VTQR_NL5TqFrIncGain_c "" FLOAT32_IEEE SWC_FDC_type_CM_single_c 0 0 0.0 1.0 ECU_ADDRESS 0x0000 /* @ECU_Address@VTQR_NL5TqFrIncGain_c@ */ /end MEASUREMENT
/begin MEASUREMENT VTQR_NL4TqFrIncGain_c "" FLOAT32_IEEE SWC_FDC_type_CM_single_c 0 0 0.0 1.0 ECU_ADDRESS 0x0000 /* @ECU_Address@VTQR_NL4TqFrIncGain_c@ */ /end MEASUREMENT
/begin MEASUREMENT VTQR_NL3TqFrIncGain_c "" FLOAT32_IEEE SWC_FDC_type_CM_single_c 0 0 0.0 1.0 ECU_ADDRESS 0x0000 /* @ECU_Address@VTQR_NL3TqFrIncGain_c@ */ /end MEASUREMENT
/begin MEASUREMENT VTQR_NL2TqFrIncGain_c "" FLOAT32_IEEE SWC_FDC_type_CM_single_c 0 0 0.0 1.0 ECU_ADDRESS 0x0000 /* @ECU_Address@VTQR_NL2TqFrIncGain_c@ */ /end MEASUREMENT
/begin MEASUREMENT VTQR_SnowMTqFrIncGain_c "" FLOAT32_IEEE SWC_FDC_type_CM_single_c 0 0 0.0 300.0 ECU_ADDRESS 0x0000 /* @ECU_Address@VTQR_SnowMTqFrIncGain_c@ */ /end MEASUREMENT
/begin MEASUREMENT VTQD_APSReqTimer_s "" FLOAT32_IEEE SWC_FDC_type_CM_single_s 0 0 0.0 100000.0 ECU_ADDRESS 0x0000 /* @ECU_Address@VTQD_APSReqTimer_s@ */ /end MEASUREMENT
/begin MEASUREMENT VTQD_PreLoadHoldtime_s "" FLOAT32_IEEE SWC_FDC_type_CM_single_s 0 0 0.0 3600.0 ECU_ADDRESS 0x0000 /* @ECU_Address@VTQD_PreLoadHoldtime_s@ */ /end MEASUREMENT
/begin MEASUREMENT VTQD_CreepPreloadTime_s "" FLOAT32_IEEE SWC_FDC_type_CM_single_s 0 0 0.0 300.0 ECU_ADDRESS 0x0000 /* @ECU_Address@VTQD_CreepPreloadTime_s@ */ /end MEASUREMENT
/begin MEASUREMENT VTQD_FrPreloadTq_Nm "" FLOAT32_IEEE SWC_FDC_type_CM_single_Nm 0 0 -1000.0 1000.0 ECU_ADDRESS 0x0000 /* @ECU_Address@VTQD_FrPreloadTq_Nm@ */ /end MEASUREMENT
/begin MEASUREMENT VTQD_EstFrRealTqSum_Nm "" FLOAT32_IEEE SWC_FDC_type_CM_single_Nm 0 0 -1.0E+6 1.0E+6 ECU_ADDRESS 0x0000 /* @ECU_Address@VTQD_EstFrRealTqSum_Nm@ */ /end MEASUREMENT
/begin MEASUREMENT VTQD_EstFrRealTqAvg_Nm "" FLOAT32_IEEE SWC_FDC_type_CM_single_Nm 0 0 -100000.0 100000.0 ECU_ADDRESS 0x0000 /* @ECU_Address@VTQD_EstFrRealTqAvg_Nm@ */ /end MEASUREMENT
/begin MEASUREMENT VTQD_EstFrWhlTqAvg_Nm "" FLOAT32_IEEE SWC_FDC_type_CM_single_Nm 0 0 -100000.0 100000.0 ECU_ADDRESS 0x0000 /* @ECU_Address@VTQD_EstFrWhlTqAvg_Nm@ */ /end MEASUREMENT
/begin MEASUREMENT VTQD_EstFrForce_N "" FLOAT32_IEEE SWC_FDC_type_CM_single_N 0 0 -100000.0 100000.0 ECU_ADDRESS 0x0000 /* @ECU_Address@VTQD_EstFrForce_N@ */ /end MEASUREMENT
/begin MEASUREMENT VTQD_EstRollForce_N "" FLOAT32_IEEE SWC_FDC_type_CM_single_N 0 0 -100000.0 100000.0 ECU_ADDRESS 0x0000 /* @ECU_Address@VTQD_EstRollForce_N@ */ /end MEASUREMENT
/begin MEASUREMENT VTQD_EstFrActForce_N "" FLOAT32_IEEE SWC_FDC_type_CM_single_N 0 0 -100000.0 100000.0 ECU_ADDRESS 0x0000 /* @ECU_Address@VTQD_EstFrActForce_N@ */ /end MEASUREMENT
/begin MEASUREMENT VTQD_EstRrRealTqSum_Nm "" FLOAT32_IEEE SWC_FDC_type_CM_single_Nm 0 0 -1.0E+6 1.0E+6 ECU_ADDRESS 0x0000 /* @ECU_Address@VTQD_EstRrRealTqSum_Nm@ */ /end MEASUREMENT
/begin MEASUREMENT VTQD_EstRrRealTqAvg_Nm "" FLOAT32_IEEE SWC_FDC_type_CM_single_Nm 0 0 -100000.0 100000.0 ECU_ADDRESS 0x0000 /* @ECU_Address@VTQD_EstRrRealTqAvg_Nm@ */ /end MEASUREMENT
/begin MEASUREMENT VTQD_EstRrWhlTqAvg_Nm "" FLOAT32_IEEE SWC_FDC_type_CM_single_Nm 0 0 -100000.0 100000.0 ECU_ADDRESS 0x0000 /* @ECU_Address@VTQD_EstRrWhlTqAvg_Nm@ */ /end MEASUREMENT
/begin MEASUREMENT VTQD_EstRrForce_N "" FLOAT32_IEEE SWC_FDC_type_CM_single_N 0 0 -100000.0 100000.0 ECU_ADDRESS 0x0000 /* @ECU_Address@VTQD_EstRrForce_N@ */ /end MEASUREMENT
/begin MEASUREMENT VTQD_EstRrActForce_N "" FLOAT32_IEEE SWC_FDC_type_CM_single_N 0 0 -100000.0 100000.0 ECU_ADDRESS 0x0000 /* @ECU_Address@VTQD_EstRrActForce_N@ */ /end MEASUREMENT
/begin MEASUREMENT VTQD_EstActTotalForce_N "" FLOAT32_IEEE SWC_FDC_type_CM_single_N 0 0 -100000.0 100000.0 ECU_ADDRESS 0x0000 /* @ECU_Address@VTQD_EstActTotalForce_N@ */ /end MEASUREMENT
/begin MEASUREMENT VTQD_EstLongAccSum_Gps "" FLOAT32_IEEE SWC_FDC_type_CM_single_Gps 0 0 -100000.0 100000.0 ECU_ADDRESS 0x0000 /* @ECU_Address@VTQD_EstLongAccSum_Gps@ */ /end MEASUREMENT
/begin MEASUREMENT VTQD_EstCycleCount_cnt "" FLOAT32_IEEE SWC_FDC_type_CM_single_cnt 0 0 0.0 100.0 ECU_ADDRESS 0x0000 /* @ECU_Address@VTQD_EstCycleCount_cnt@ */ /end MEASUREMENT
/begin MEASUREMENT VTQD_EstLongAccAvg_Gps "" FLOAT32_IEEE SWC_FDC_type_CM_single_Gps 0 0 -1.0 1.0 ECU_ADDRESS 0x0000 /* @ECU_Address@VTQD_EstLongAccAvg_Gps@ */ /end MEASUREMENT
/begin MEASUREMENT VTQD_EstVehWeight_kg "" FLOAT32_IEEE SWC_FDC_type_CM_single_kg 0 0 0.0 10000.0 ECU_ADDRESS 0x0000 /* @ECU_Address@VTQD_EstVehWeight_kg@ */ /end MEASUREMENT
/begin MEASUREMENT VTQD_EstLongAccMin_Gps "" FLOAT32_IEEE SWC_FDC_type_CM_single_Gps 0 0 -1.0 1.0 ECU_ADDRESS 0x0000 /* @ECU_Address@VTQD_EstLongAccMin_Gps@ */ /end MEASUREMENT
/begin MEASUREMENT VTQD_EstFrRealTqMin_Nm "" FLOAT32_IEEE SWC_FDC_type_CM_single_Nm 0 0 -100000.0 100000.0 ECU_ADDRESS 0x0000 /* @ECU_Address@VTQD_EstFrRealTqMin_Nm@ */ /end MEASUREMENT
/begin MEASUREMENT VTQD_EstRrRealTqMin_Nm "" FLOAT32_IEEE SWC_FDC_type_CM_single_Nm 0 0 -100000.0 100000.0 ECU_ADDRESS 0x0000 /* @ECU_Address@VTQD_EstRrRealTqMin_Nm@ */ /end MEASUREMENT
/begin MEASUREMENT VTQD_TMPwrAvailDchrg_kW "" FLOAT32_IEEE SWC_FDC_type_CM_single_kW 0 0 -100000.0 100000.0 ECU_ADDRESS 0x0000 /* @ECU_Address@VTQD_TMPwrAvailDchrg_kW@ */ /end MEASUREMENT
/begin MEASUREMENT VTQD_FrLossMAPLowV_V "" FLOAT32_IEEE SWC_FDC_type_CM_single_V 0 0 0.0 1000.0 ECU_ADDRESS 0x0000 /* @ECU_Address@VTQD_FrLossMAPLowV_V@ */ /end MEASUREMENT
/begin MEASUREMENT VTQD_FrLossMAPHighV_V "" FLOAT32_IEEE SWC_FDC_type_CM_single_V 0 0 0.0 1000.0 ECU_ADDRESS 0x0000 /* @ECU_Address@VTQD_FrLossMAPHighV_V@ */ /end MEASUREMENT
/begin MEASUREMENT VTQD_RrPreloadTq_Nm "" FLOAT32_IEEE SWC_FDC_type_CM_single_Nm 0 0 -1000.0 1000.0 ECU_ADDRESS 0x0000 /* @ECU_Address@VTQD_RrPreloadTq_Nm@ */ /end MEASUREMENT
/begin MEASUREMENT VTQD_FrLossMAPHighV_kw "" FLOAT32_IEEE SWC_FDC_type_CM_single_kw 0 0 -200.0 200.0 ECU_ADDRESS 0x0000 /* @ECU_Address@VTQD_FrLossMAPHighV_kw@ */ /end MEASUREMENT
/begin MEASUREMENT VTQD_FrLossMAPLowV_kw "" FLOAT32_IEEE SWC_FDC_type_CM_single_kw 0 0 -200.0 200.0 ECU_ADDRESS 0x0000 /* @ECU_Address@VTQD_FrLossMAPLowV_kw@ */ /end MEASUREMENT
/begin MEASUREMENT VTQD_FrLossMAPFinal_kw "" FLOAT32_IEEE SWC_FDC_type_CM_single_kw 0 0 -200.0 200.0 ECU_ADDRESS 0x0000 /* @ECU_Address@VTQD_FrLossMAPFinal_kw@ */ /end MEASUREMENT
/begin MEASUREMENT VTQD_RrLossMAPLowV_V "" FLOAT32_IEEE SWC_FDC_type_CM_single_V 0 0 0.0 1000.0 ECU_ADDRESS 0x0000 /* @ECU_Address@VTQD_RrLossMAPLowV_V@ */ /end MEASUREMENT
/begin MEASUREMENT VTQD_RrLossMAPHighV_V "" FLOAT32_IEEE SWC_FDC_type_CM_single_V 0 0 0.0 1000.0 ECU_ADDRESS 0x0000 /* @ECU_Address@VTQD_RrLossMAPHighV_V@ */ /end MEASUREMENT
/begin MEASUREMENT VTQD_RrLossMAPHighV_kw "" FLOAT32_IEEE SWC_FDC_type_CM_single_kw 0 0 -200.0 200.0 ECU_ADDRESS 0x0000 /* @ECU_Address@VTQD_RrLossMAPHighV_kw@ */ /end MEASUREMENT
/begin MEASUREMENT VTQD_RrLossMAPLowV_kw "" FLOAT32_IEEE SWC_FDC_type_CM_single_kw 0 0 -200.0 200.0 ECU_ADDRESS 0x0000 /* @ECU_Address@VTQD_RrLossMAPLowV_kw@ */ /end MEASUREMENT
/begin MEASUREMENT VTQD_RrLossMAPFinal_kw "" FLOAT32_IEEE SWC_FDC_type_CM_single_kw 0 0 -200.0 200.0 ECU_ADDRESS 0x0000 /* @ECU_Address@VTQD_RrLossMAPFinal_kw@ */ /end MEASUREMENT
/begin MEASUREMENT VTQD_MotorLossTotal_kw "" FLOAT32_IEEE SWC_FDC_type_CM_single_kw 0 0 -200.0 200.0 ECU_ADDRESS 0x0000 /* @ECU_Address@VTQD_MotorLossTotal_kw@ */ /end MEASUREMENT
/begin MEASUREMENT VTQD_FrHVBPwrAvailDchrg_kW "" FLOAT32_IEEE SWC_FDC_type_CM_single_kW 0 0 -100000.0 100000.0 ECU_ADDRESS 0x0000 /* @ECU_Address@VTQD_FrHVBPwrAvailDchrg_kW@ */ /end MEASUREMENT
/begin MEASUREMENT VTQD_FrRockDisAvalMotTq_Nm "" FLOAT32_IEEE SWC_FDC_type_CM_single_Nm 0 0 0.0 100000.0 ECU_ADDRESS 0x0000 /* @ECU_Address@VTQD_FrRockDisAvalMotTq_Nm@ */ /end MEASUREMENT
/begin MEASUREMENT VTQD_WhlTqCapMotFr_Nm "" FLOAT32_IEEE SWC_FDC_type_CM_single_Nm 0 0 -100000.0 100000.0 ECU_ADDRESS 0x0000 /* @ECU_Address@VTQD_WhlTqCapMotFr_Nm@ */ /end MEASUREMENT
/begin MEASUREMENT VTQD_WhlTqCapGenFr_Nm "" FLOAT32_IEEE SWC_FDC_type_CM_single_Nm 0 0 -100000.0 100000.0 ECU_ADDRESS 0x0000 /* @ECU_Address@VTQD_WhlTqCapGenFr_Nm@ */ /end MEASUREMENT
/begin MEASUREMENT VTQD_RrHVBPwrAvailDchrg_kW "" FLOAT32_IEEE SWC_FDC_type_CM_single_kW 0 0 -100000.0 100000.0 ECU_ADDRESS 0x0000 /* @ECU_Address@VTQD_RrHVBPwrAvailDchrg_kW@ */ /end MEASUREMENT
/begin MEASUREMENT VTQD_RrRockDisAvalMotTq_Nm "" FLOAT32_IEEE SWC_FDC_type_CM_single_Nm 0 0 0.0 100000.0 ECU_ADDRESS 0x0000 /* @ECU_Address@VTQD_RrRockDisAvalMotTq_Nm@ */ /end MEASUREMENT
/begin MEASUREMENT VTQD_WhlTqCapMotRr_Nm "" FLOAT32_IEEE SWC_FDC_type_CM_single_Nm 0 0 -100000.0 100000.0 ECU_ADDRESS 0x0000 /* @ECU_Address@VTQD_WhlTqCapMotRr_Nm@ */ /end MEASUREMENT
/begin MEASUREMENT VTQD_WhlTqCapGenRr_Nm "" FLOAT32_IEEE SWC_FDC_type_CM_single_Nm 0 0 -100000.0 100000.0 ECU_ADDRESS 0x0000 /* @ECU_Address@VTQD_WhlTqCapGenRr_Nm@ */ /end MEASUREMENT
/begin MEASUREMENT VTQD_EstVehWeightResetTime_s "" FLOAT32_IEEE SWC_FDC_type_CM_single_s 0 0 0.0 100000.0 ECU_ADDRESS 0x0000 /* @ECU_Address@VTQD_EstVehWeightResetTime_s@ */ /end MEASUREMENT
/begin MEASUREMENT VTQD_ACCCancelMemTq_Nm "" FLOAT32_IEEE SWC_FDC_type_CM_single_Nm 0 0 -100000.0 100000.0 ECU_ADDRESS 0x0000 /* @ECU_Address@VTQD_ACCCancelMemTq_Nm@ */ /end MEASUREMENT
/begin MEASUREMENT VTQD_ACCCancelMemPosn_pct "" FLOAT32_IEEE SWC_FDC_type_CM_single_pct 0 0 0.0 100.0 ECU_ADDRESS 0x0000 /* @ECU_Address@VTQD_ACCCancelMemPosn_pct@ */ /end MEASUREMENT
/begin MEASUREMENT VTQD_RL5TqMapDComp_Nm "" FLOAT32_IEEE SWC_FDC_type_CM_single_Nm 0 0 -100000.0 100000.0 ECU_ADDRESS 0x0000 /* @ECU_Address@VTQD_RL5TqMapDComp_Nm@ */ /end MEASUREMENT
/begin MEASUREMENT VTQD_RL4TqMapDComp_Nm "" FLOAT32_IEEE SWC_FDC_type_CM_single_Nm 0 0 -100000.0 100000.0 ECU_ADDRESS 0x0000 /* @ECU_Address@VTQD_RL4TqMapDComp_Nm@ */ /end MEASUREMENT
/begin MEASUREMENT VTQD_RL3TqMapDComp_Nm "" FLOAT32_IEEE SWC_FDC_type_CM_single_Nm 0 0 -100000.0 100000.0 ECU_ADDRESS 0x0000 /* @ECU_Address@VTQD_RL3TqMapDComp_Nm@ */ /end MEASUREMENT
/begin MEASUREMENT VTQD_RL2TqMapDComp_Nm "" FLOAT32_IEEE SWC_FDC_type_CM_single_Nm 0 0 -100000.0 100000.0 ECU_ADDRESS 0x0000 /* @ECU_Address@VTQD_RL2TqMapDComp_Nm@ */ /end MEASUREMENT
/begin MEASUREMENT VTQD_RL1TqMapDComp_Nm "" FLOAT32_IEEE SWC_FDC_type_CM_single_Nm 0 0 -100000.0 100000.0 ECU_ADDRESS 0x0000 /* @ECU_Address@VTQD_RL1TqMapDComp_Nm@ */ /end MEASUREMENT
/begin MEASUREMENT VTQD_CreepPtermTq_Nm "" FLOAT32_IEEE SWC_FDC_type_CM_single_Nm 0 0 -100000.0 100000.0 ECU_ADDRESS 0x0000 /* @ECU_Address@VTQD_CreepPtermTq_Nm@ */ /end MEASUREMENT
/begin MEASUREMENT VTQD_CreepItermMaxLimit_Nm "" FLOAT32_IEEE SWC_FDC_type_CM_single_Nm 0 0 -100000.0 100000.0 ECU_ADDRESS 0x0000 /* @ECU_Address@VTQD_CreepItermMaxLimit_Nm@ */ /end MEASUREMENT
/begin MEASUREMENT VTQD_CreepItermTq_Nm "" FLOAT32_IEEE SWC_FDC_type_CM_single_Nm 0 0 -100000.0 100000.0 ECU_ADDRESS 0x0000 /* @ECU_Address@VTQD_CreepItermTq_Nm@ */ /end MEASUREMENT
/begin MEASUREMENT VTQD_CreepOffsetTq_Nm "" FLOAT32_IEEE SWC_FDC_type_CM_single_Nm 0 0 -100000.0 100000.0 ECU_ADDRESS 0x0000 /* @ECU_Address@VTQD_CreepOffsetTq_Nm@ */ /end MEASUREMENT
/begin MEASUREMENT VTQD_CreepTotalOfstTq_Nm "" FLOAT32_IEEE SWC_FDC_type_CM_single_Nm 0 0 -100000.0 100000.0 ECU_ADDRESS 0x0000 /* @ECU_Address@VTQD_CreepTotalOfstTq_Nm@ */ /end MEASUREMENT
/begin MEASUREMENT VTPM_LRWP_raw16 "" SWORD SWC_FDC_type_CM_int16_raw16 0 0 -255.0 255.0 ECU_ADDRESS 0x0000 /* @ECU_Address@VTPM_LRWP_raw16@ */ /end MEASUREMENT
/begin MEASUREMENT VTPM_LFWP_raw16 "" SWORD SWC_FDC_type_CM_int16_raw16 0 0 -255.0 255.0 ECU_ADDRESS 0x0000 /* @ECU_Address@VTPM_LFWP_raw16@ */ /end MEASUREMENT
/begin MEASUREMENT VTPM_RRWP_raw16 "" SWORD SWC_FDC_type_CM_int16_raw16 0 0 -255.0 255.0 ECU_ADDRESS 0x0000 /* @ECU_Address@VTPM_RRWP_raw16@ */ /end MEASUREMENT
/begin MEASUREMENT VTPM_RFWP_raw16 "" SWORD SWC_FDC_type_CM_int16_raw16 0 0 -255.0 255.0 ECU_ADDRESS 0x0000 /* @ECU_Address@VTPM_RFWP_raw16@ */ /end MEASUREMENT
/begin MEASUREMENT VTPM_C1_cnt "" UBYTE SWC_FDC_type_CM_uint8_cnt 0 0 0.0 255.0 ECU_ADDRESS 0x0000 /* @ECU_Address@VTPM_C1_cnt@ */ /end MEASUREMENT
/begin MEASUREMENT VTPM_C2_cnt "" UBYTE SWC_FDC_type_CM_uint8_cnt 0 0 0.0 255.0 ECU_ADDRESS 0x0000 /* @ECU_Address@VTPM_C2_cnt@ */ /end MEASUREMENT
/begin MEASUREMENT VTPM_C3_cnt "" UBYTE SWC_FDC_type_CM_uint8_cnt 0 0 0.0 255.0 ECU_ADDRESS 0x0000 /* @ECU_Address@VTPM_C3_cnt@ */ /end MEASUREMENT
/begin MEASUREMENT VTPM_C4_cnt "" UBYTE SWC_FDC_type_CM_uint8_cnt 0 0 0.0 255.0 ECU_ADDRESS 0x0000 /* @ECU_Address@VTPM_C4_cnt@ */ /end MEASUREMENT
/begin MEASUREMENT VTPM_Locdonetimes_cnt "" UBYTE SWC_FDC_type_CM_uint8_cnt 0 0 0.0 255.0 ECU_ADDRESS 0x0000 /* @ECU_Address@VTPM_Locdonetimes_cnt@ */ /end MEASUREMENT
/begin MEASUREMENT VTPM_S1L_enum "" UBYTE SWC_FDC_type_CM_uint8_enum 0 0 0.0 5.0 ECU_ADDRESS 0x0000 /* @ECU_Address@VTPM_S1L_enum@ */ /end MEASUREMENT
/begin MEASUREMENT VTPM_S2L_enum "" UBYTE SWC_FDC_type_CM_uint8_enum 0 0 0.0 5.0 ECU_ADDRESS 0x0000 /* @ECU_Address@VTPM_S2L_enum@ */ /end MEASUREMENT
/begin MEASUREMENT VTPM_S3L_enum "" UBYTE SWC_FDC_type_CM_uint8_enum 0 0 0.0 5.0 ECU_ADDRESS 0x0000 /* @ECU_Address@VTPM_S3L_enum@ */ /end MEASUREMENT
/begin MEASUREMENT VTPM_S4L_enum "" UBYTE SWC_FDC_type_CM_uint8_enum 0 0 0.0 5.0 ECU_ADDRESS 0x0000 /* @ECU_Address@VTPM_S4L_enum@ */ /end MEASUREMENT
/begin MEASUREMENT VTPM_unlearnSfailvalid_enum "" UBYTE SWC_FDC_type_CM_uint8_enum 0 0 0.0 255.0 ECU_ADDRESS 0x0000 /* @ECU_Address@VTPM_unlearnSfailvalid_enum@ */ /end MEASUREMENT
/begin MEASUREMENT VTPM_ManualID1pressure_raw "" UBYTE SWC_FDC_type_CM_uint8_raw 0 0 0.0 255.0 ECU_ADDRESS 0x0000 /* @ECU_Address@VTPM_ManualID1pressure_raw@ */ /end MEASUREMENT
/begin MEASUREMENT VTPM_ManualID2pressure_raw "" UBYTE SWC_FDC_type_CM_uint8_raw 0 0 0.0 255.0 ECU_ADDRESS 0x0000 /* @ECU_Address@VTPM_ManualID2pressure_raw@ */ /end MEASUREMENT
/begin MEASUREMENT VTPM_ManualID3pressure_raw "" UBYTE SWC_FDC_type_CM_uint8_raw 0 0 0.0 255.0 ECU_ADDRESS 0x0000 /* @ECU_Address@VTPM_ManualID3pressure_raw@ */ /end MEASUREMENT
/begin MEASUREMENT VTPM_ManualID4pressure_raw "" UBYTE SWC_FDC_type_CM_uint8_raw 0 0 0.0 255.0 ECU_ADDRESS 0x0000 /* @ECU_Address@VTPM_ManualID4pressure_raw@ */ /end MEASUREMENT
/begin MEASUREMENT VTPM_WritingCnt_enum "" UBYTE SWC_FDC_type_CM_uint8_enum 0 0 0.0 255.0 ECU_ADDRESS 0x0000 /* @ECU_Address@VTPM_WritingCnt_enum@ */ /end MEASUREMENT
/begin MEASUREMENT VTPM_LProgress_enum "" UBYTE SWC_FDC_type_CM_uint8_enum 0 0 0.0 255.0 ECU_ADDRESS 0x0000 /* @ECU_Address@VTPM_LProgress_enum@ */ /end MEASUREMENT
/begin MEASUREMENT VTPM_FlashIDvalid_enum "" UBYTE SWC_FDC_type_CM_uint8_enum 0 0 0.0 255.0 ECU_ADDRESS 0x0000 /* @ECU_Address@VTPM_FlashIDvalid_enum@ */ /end MEASUREMENT
/begin MEASUREMENT VTPM_ID4messageALTU_raw8 "" UBYTE SWC_FDC_type_CM_uint8_raw8 0 0 0.0 255.0 ECU_ADDRESS 0x0000 /* @ECU_Address@VTPM_ID4messageALTU_raw8@ */ /end MEASUREMENT
/begin MEASUREMENT VTPM_ID3messageALTU_raw8 "" UBYTE SWC_FDC_type_CM_uint8_raw8 0 0 0.0 255.0 ECU_ADDRESS 0x0000 /* @ECU_Address@VTPM_ID3messageALTU_raw8@ */ /end MEASUREMENT
/begin MEASUREMENT VTPM_ID2messageALTU_raw8 "" UBYTE SWC_FDC_type_CM_uint8_raw8 0 0 0.0 255.0 ECU_ADDRESS 0x0000 /* @ECU_Address@VTPM_ID2messageALTU_raw8@ */ /end MEASUREMENT
/begin MEASUREMENT VTPM_ID1messageALTU_raw8 "" UBYTE SWC_FDC_type_CM_uint8_raw8 0 0 0.0 255.0 ECU_ADDRESS 0x0000 /* @ECU_Address@VTPM_ID1messageALTU_raw8@ */ /end MEASUREMENT
/begin MEASUREMENT VTQD_SWCResUpPress_enum "" UBYTE SWC_FDC_type_CM_uint8_enum 0 0 0.0 1.0 ECU_ADDRESS 0x0000 /* @ECU_Address@VTQD_SWCResUpPress_enum@ */ /end MEASUREMENT
/begin MEASUREMENT VTQD_SWCSetDownPress_enum "" UBYTE SWC_FDC_type_CM_uint8_enum 0 0 0.0 1.0 ECU_ADDRESS 0x0000 /* @ECU_Address@VTQD_SWCSetDownPress_enum@ */ /end MEASUREMENT
/begin MEASUREMENT VTQD_SWC2ScrollUpSta_enum "" UBYTE SWC_FDC_type_CM_uint8_enum 0 0 0.0 15.0 ECU_ADDRESS 0x0000 /* @ECU_Address@VTQD_SWC2ScrollUpSta_enum@ */ /end MEASUREMENT
/begin MEASUREMENT VTQD_ComboKey_enum "" UBYTE SWC_FDC_type_CM_uint8_enum 0 0 0.0 15.0 ECU_ADDRESS 0x0000 /* @ECU_Address@VTQD_ComboKey_enum@ */ /end MEASUREMENT
/begin MEASUREMENT VTQD_DiagnosisOffCMD_enum "" UBYTE SWC_FDC_type_CM_uint8_enum 0 0 0.0 15.0 ECU_ADDRESS 0x0000 /* @ECU_Address@VTQD_DiagnosisOffCMD_enum@ */ /end MEASUREMENT
/begin MEASUREMENT VTQD_CANCELCount_cnt "" UBYTE SWC_FDC_type_CM_uint8_cnt 0 0 0.0 15.0 ECU_ADDRESS 0x0000 /* @ECU_Address@VTQD_CANCELCount_cnt@ */ /end MEASUREMENT
/begin MEASUREMENT VTQD_EngineeringCMD_enum "" UBYTE SWC_FDC_type_CM_uint8_enum 0 0 0.0 15.0 ECU_ADDRESS 0x0000 /* @ECU_Address@VTQD_EngineeringCMD_enum@ */ /end MEASUREMENT
/begin MEASUREMENT VTQD_ExhibitionCMD_enum "" UBYTE SWC_FDC_type_CM_uint8_enum 0 0 0.0 15.0 ECU_ADDRESS 0x0000 /* @ECU_Address@VTQD_ExhibitionCMD_enum@ */ /end MEASUREMENT
/begin MEASUREMENT VTQD_ManufactureCMD_enum "" UBYTE SWC_FDC_type_CM_uint8_enum 0 0 0.0 15.0 ECU_ADDRESS 0x0000 /* @ECU_Address@VTQD_ManufactureCMD_enum@ */ /end MEASUREMENT
/begin MEASUREMENT VTQD_StreetFightCMD_enum "" UBYTE SWC_FDC_type_CM_uint8_enum 0 0 0.0 15.0 ECU_ADDRESS 0x0000 /* @ECU_Address@VTQD_StreetFightCMD_enum@ */ /end MEASUREMENT
/begin MEASUREMENT VTQD_SysMode_enum "" UBYTE SWC_FDC_type_CM_uint8_enum 0 0 0.0 15.0 ECU_ADDRESS 0x0000 /* @ECU_Address@VTQD_SysMode_enum@ */ /end MEASUREMENT
/begin MEASUREMENT VTQD_SWC2ScrollDownSta_enum "" UBYTE SWC_FDC_type_CM_uint8_enum 0 0 0.0 15.0 ECU_ADDRESS 0x0000 /* @ECU_Address@VTQD_SWC2ScrollDownSta_enum@ */ /end MEASUREMENT
/begin MEASUREMENT VTPM_SetIDLoc_flg "" UBYTE SWC_FDC_type_CM_boolean_flg 0 0 0.0 1.0 ECU_ADDRESS 0x0000 /* @ECU_Address@VTPM_SetIDLoc_flg@ */ /end MEASUREMENT
/begin MEASUREMENT VTPM_ALFin_flg "" UBYTE SWC_FDC_type_CM_boolean_flg 0 0 0.0 1.0 ECU_ADDRESS 0x0000 /* @ECU_Address@VTPM_ALFin_flg@ */ /end MEASUREMENT
/begin MEASUREMENT VTPM_IDLock_flg "" UBYTE SWC_FDC_type_CM_boolean_flg 0 0 0.0 1.0 ECU_ADDRESS 0x0000 /* @ECU_Address@VTPM_IDLock_flg@ */ /end MEASUREMENT
/begin MEASUREMENT VTPM_unlearnSfali_flg "" UBYTE SWC_FDC_type_CM_boolean_flg 0 0 0.0 1.0 ECU_ADDRESS 0x0000 /* @ECU_Address@VTPM_unlearnSfali_flg@ */ /end MEASUREMENT
/begin MEASUREMENT VTPM_LFWheelTmpIndi_flg "" UBYTE SWC_FDC_type_CM_boolean_flg 0 0 0.0 1.0 ECU_ADDRESS 0x0000 /* @ECU_Address@VTPM_LFWheelTmpIndi_flg@ */ /end MEASUREMENT
/begin MEASUREMENT VTPM_RFWheelTmpIndi_flg "" UBYTE SWC_FDC_type_CM_boolean_flg 0 0 0.0 1.0 ECU_ADDRESS 0x0000 /* @ECU_Address@VTPM_RFWheelTmpIndi_flg@ */ /end MEASUREMENT
/begin MEASUREMENT VTPM_LRWheelTmpIndi_flg "" UBYTE SWC_FDC_type_CM_boolean_flg 0 0 0.0 1.0 ECU_ADDRESS 0x0000 /* @ECU_Address@VTPM_LRWheelTmpIndi_flg@ */ /end MEASUREMENT
/begin MEASUREMENT VTPM_RRWheelTmpIndi_flg "" UBYTE SWC_FDC_type_CM_boolean_flg 0 0 0.0 1.0 ECU_ADDRESS 0x0000 /* @ECU_Address@VTPM_RRWheelTmpIndi_flg@ */ /end MEASUREMENT
/begin MEASUREMENT VTPM_FAT_flg "" UBYTE SWC_FDC_type_CM_boolean_flg 0 0 0.0 1.0 ECU_ADDRESS 0x0000 /* @ECU_Address@VTPM_FAT_flg@ */ /end MEASUREMENT
/begin MEASUREMENT VTPM_ManuTPMSStorge_flg "" UBYTE SWC_FDC_type_CM_boolean_flg 0 0 0.0 1.0 ECU_ADDRESS 0x0000 /* @ECU_Address@VTPM_ManuTPMSStorge_flg@ */ /end MEASUREMENT
/begin MEASUREMENT VTPM_TPMSTLCmd_flg "" UBYTE SWC_FDC_type_CM_boolean_flg 0 0 0.0 1.0 ECU_ADDRESS 0x0000 /* @ECU_Address@VTPM_TPMSTLCmd_flg@ */ /end MEASUREMENT
/begin MEASUREMENT VTPM_TPMSmanualDone_flg "" UBYTE SWC_FDC_type_CM_boolean_flg 0 0 0.0 1.0 ECU_ADDRESS 0x0000 /* @ECU_Address@VTPM_TPMSmanualDone_flg@ */ /end MEASUREMENT
/begin MEASUREMENT VTPM_Chkfin_flg "" UBYTE SWC_FDC_type_CM_boolean_flg 0 0 0.0 1.0 ECU_ADDRESS 0x0000 /* @ECU_Address@VTPM_Chkfin_flg@ */ /end MEASUREMENT
/begin MEASUREMENT VVMC_LFWhlSkidReset_flg "" UBYTE SWC_FDC_type_CM_boolean_flg 0 0 0.0 1.0 ECU_ADDRESS 0x0000 /* @ECU_Address@VVMC_LFWhlSkidReset_flg@ */ /end MEASUREMENT
/begin MEASUREMENT VVMC_LFWhlSkid_flg "" UBYTE SWC_FDC_type_CM_boolean_flg 0 0 0.0 1.0 ECU_ADDRESS 0x0000 /* @ECU_Address@VVMC_LFWhlSkid_flg@ */ /end MEASUREMENT
/begin MEASUREMENT VVMC_RFWhlSkidReset_flg "" UBYTE SWC_FDC_type_CM_boolean_flg 0 0 0.0 1.0 ECU_ADDRESS 0x0000 /* @ECU_Address@VVMC_RFWhlSkidReset_flg@ */ /end MEASUREMENT
/begin MEASUREMENT VVMC_RFWhlSkid_flg "" UBYTE SWC_FDC_type_CM_boolean_flg 0 0 0.0 1.0 ECU_ADDRESS 0x0000 /* @ECU_Address@VVMC_RFWhlSkid_flg@ */ /end MEASUREMENT
/begin MEASUREMENT VVMC_LRWhlSkidReset_flg "" UBYTE SWC_FDC_type_CM_boolean_flg 0 0 0.0 1.0 ECU_ADDRESS 0x0000 /* @ECU_Address@VVMC_LRWhlSkidReset_flg@ */ /end MEASUREMENT
/begin MEASUREMENT VVMC_LRWhlSkid_flg "" UBYTE SWC_FDC_type_CM_boolean_flg 0 0 0.0 1.0 ECU_ADDRESS 0x0000 /* @ECU_Address@VVMC_LRWhlSkid_flg@ */ /end MEASUREMENT
/begin MEASUREMENT VVMC_RRWhlSkidReset_flg "" UBYTE SWC_FDC_type_CM_boolean_flg 0 0 0.0 1.0 ECU_ADDRESS 0x0000 /* @ECU_Address@VVMC_RRWhlSkidReset_flg@ */ /end MEASUREMENT
/begin MEASUREMENT VVMC_RRWhlSkid_flg "" UBYTE SWC_FDC_type_CM_boolean_flg 0 0 0.0 1.0 ECU_ADDRESS 0x0000 /* @ECU_Address@VVMC_RRWhlSkid_flg@ */ /end MEASUREMENT
/begin MEASUREMENT VVMC_AllWhlSkid_flg "" UBYTE SWC_FDC_type_CM_boolean_flg 0 0 0.0 1.0 ECU_ADDRESS 0x0000 /* @ECU_Address@VVMC_AllWhlSkid_flg@ */ /end MEASUREMENT
/begin MEASUREMENT VVMC_VehSpdPredSkid_flg "" UBYTE SWC_FDC_type_CM_boolean_flg 0 0 0.0 1.0 ECU_ADDRESS 0x0000 /* @ECU_Address@VVMC_VehSpdPredSkid_flg@ */ /end MEASUREMENT
/begin MEASUREMENT VTQR_FShaftSpdTqLimLow_flg "" UBYTE SWC_FDC_type_CM_boolean_flg 0 0 0.0 1.0 ECU_ADDRESS 0x0000 /* @ECU_Address@VTQR_FShaftSpdTqLimLow_flg@ */ /end MEASUREMENT
/begin MEASUREMENT VTQR_FTimerTqLimLow_flg "" UBYTE SWC_FDC_type_CM_boolean_flg 0 0 0.0 1.0 ECU_ADDRESS 0x0000 /* @ECU_Address@VTQR_FTimerTqLimLow_flg@ */ /end MEASUREMENT
/begin MEASUREMENT VTQR_RShaftSpdTqLimLow_flg "" UBYTE SWC_FDC_type_CM_boolean_flg 0 0 0.0 1.0 ECU_ADDRESS 0x0000 /* @ECU_Address@VTQR_RShaftSpdTqLimLow_flg@ */ /end MEASUREMENT
/begin MEASUREMENT VTQR_RTimerTqLimLow_flg "" UBYTE SWC_FDC_type_CM_boolean_flg 0 0 0.0 1.0 ECU_ADDRESS 0x0000 /* @ECU_Address@VTQR_RTimerTqLimLow_flg@ */ /end MEASUREMENT
/begin MEASUREMENT VTQR_FrDrModLatch_flg "" UBYTE SWC_FDC_type_CM_boolean_flg 0 0 0.0 1.0 ECU_ADDRESS 0x0000 /* @ECU_Address@VTQR_FrDrModLatch_flg@ */ /end MEASUREMENT
/begin MEASUREMENT VTQR_RrDrModLatch_flg "" UBYTE SWC_FDC_type_CM_boolean_flg 0 0 0.0 1.0 ECU_ADDRESS 0x0000 /* @ECU_Address@VTQR_RrDrModLatch_flg@ */ /end MEASUREMENT
/begin MEASUREMENT VTQD_DriveProtRemove_flg "" UBYTE SWC_FDC_type_CM_boolean_flg 0 0 0.0 1.0 ECU_ADDRESS 0x0000 /* @ECU_Address@VTQD_DriveProtRemove_flg@ */ /end MEASUREMENT
/begin MEASUREMENT VTQD_CreepGradeLatch_flg "" UBYTE SWC_FDC_type_CM_boolean_flg 0 0 0.0 1.0 ECU_ADDRESS 0x0000 /* @ECU_Address@VTQD_CreepGradeLatch_flg@ */ /end MEASUREMENT
/begin MEASUREMENT VTQD_PedGControlAllow_flg "" UBYTE SWC_FDC_type_CM_boolean_flg 0 0 0.0 1.0 ECU_ADDRESS 0x0000 /* @ECU_Address@VTQD_PedGControlAllow_flg@ */ /end MEASUREMENT
/begin MEASUREMENT VTQD_PedGControlModeSW_flg "" UBYTE SWC_FDC_type_CM_boolean_flg 0 0 0.0 1.0 ECU_ADDRESS 0x0000 /* @ECU_Address@VTQD_PedGControlModeSW_flg@ */ /end MEASUREMENT
/begin MEASUREMENT VTQD_PedAccTqOperate_flg "" UBYTE SWC_FDC_type_CM_boolean_flg 0 0 0.0 1.0 ECU_ADDRESS 0x0000 /* @ECU_Address@VTQD_PedAccTqOperate_flg@ */ /end MEASUREMENT
/begin MEASUREMENT VTQD_PedAccTqEn_flg "" UBYTE SWC_FDC_type_CM_boolean_flg 0 0 0.0 1.0 ECU_ADDRESS 0x0000 /* @ECU_Address@VTQD_PedAccTqEn_flg@ */ /end MEASUREMENT
/begin MEASUREMENT VTQD_OPDHoldRelReverse_flg "" UBYTE SWC_FDC_type_CM_boolean_flg 0 0 0.0 1.0 ECU_ADDRESS 0x0000 /* @ECU_Address@VTQD_OPDHoldRelReverse_flg@ */ /end MEASUREMENT
/begin MEASUREMENT VTQD_OPDHoldEnRelLatch_flg "" UBYTE SWC_FDC_type_CM_boolean_flg 0 0 0.0 1.0 ECU_ADDRESS 0x0000 /* @ECU_Address@VTQD_OPDHoldEnRelLatch_flg@ */ /end MEASUREMENT
/begin MEASUREMENT VTQD_OPDHoldEnRel_flg "" UBYTE SWC_FDC_type_CM_boolean_flg 0 0 0.0 1.0 ECU_ADDRESS 0x0000 /* @ECU_Address@VTQD_OPDHoldEnRel_flg@ */ /end MEASUREMENT
/begin MEASUREMENT VTQD_OPDHoldRgnOn2Off_flg "" UBYTE SWC_FDC_type_CM_boolean_flg 0 0 0.0 1.0 ECU_ADDRESS 0x0000 /* @ECU_Address@VTQD_OPDHoldRgnOn2Off_flg@ */ /end MEASUREMENT
/begin MEASUREMENT VTQD_R2DEnOPDHold_flg "" UBYTE SWC_FDC_type_CM_boolean_flg 0 0 0.0 1.0 ECU_ADDRESS 0x0000 /* @ECU_Address@VTQD_R2DEnOPDHold_flg@ */ /end MEASUREMENT
/begin MEASUREMENT VTQD_OPDHoldR2D_flg "" UBYTE SWC_FDC_type_CM_boolean_flg 0 0 0.0 1.0 ECU_ADDRESS 0x0000 /* @ECU_Address@VTQD_OPDHoldR2D_flg@ */ /end MEASUREMENT
/begin MEASUREMENT VTQD_SkipDisOPDHoldReset_flg "" UBYTE SWC_FDC_type_CM_boolean_flg 0 0 0.0 1.0 ECU_ADDRESS 0x0000 /* @ECU_Address@VTQD_SkipDisOPDHoldReset_flg@ */ /end MEASUREMENT
/begin MEASUREMENT VTQD_WhlSkipDisOPDHold_flg "" UBYTE SWC_FDC_type_CM_boolean_flg 0 0 0.0 1.0 ECU_ADDRESS 0x0000 /* @ECU_Address@VTQD_WhlSkipDisOPDHold_flg@ */ /end MEASUREMENT
/begin MEASUREMENT VTQD_ADASShutOff_flg "" UBYTE SWC_FDC_type_CM_boolean_flg 0 0 0.0 1.0 ECU_ADDRESS 0x0000 /* @ECU_Address@VTQD_ADASShutOff_flg@ */ /end MEASUREMENT
/begin MEASUREMENT VTQD_RegenTqLimitEn_flg "" UBYTE SWC_FDC_type_CM_boolean_flg 0 0 0.0 1.0 ECU_ADDRESS 0x0000 /* @ECU_Address@VTQD_RegenTqLimitEn_flg@ */ /end MEASUREMENT
/begin MEASUREMENT VTQD_BrkRgnLatchEn_flg "" UBYTE SWC_FDC_type_CM_boolean_flg 0 0 0.0 1.0 ECU_ADDRESS 0x0000 /* @ECU_Address@VTQD_BrkRgnLatchEn_flg@ */ /end MEASUREMENT
/begin MEASUREMENT VTQD_ACCCancelDet_flg "" UBYTE SWC_FDC_type_CM_boolean_flg 0 0 0.0 1.0 ECU_ADDRESS 0x0000 /* @ECU_Address@VTQD_ACCCancelDet_flg@ */ /end MEASUREMENT
/begin MEASUREMENT VTQD_BOSEnable_flg "" UBYTE SWC_FDC_type_CM_boolean_flg 0 0 0.0 1.0 ECU_ADDRESS 0x0000 /* @ECU_Address@VTQD_BOSEnable_flg@ */ /end MEASUREMENT
/begin MEASUREMENT VTQD_LoSpdBrkCtrl_flg "" UBYTE SWC_FDC_type_CM_boolean_flg 0 0 0.0 1.0 ECU_ADDRESS 0x0000 /* @ECU_Address@VTQD_LoSpdBrkCtrl_flg@ */ /end MEASUREMENT
/begin MEASUREMENT VTQD_PreLoadHoldtimeEnd_flg "" UBYTE SWC_FDC_type_CM_boolean_flg 0 0 0.0 1.0 ECU_ADDRESS 0x0000 /* @ECU_Address@VTQD_PreLoadHoldtimeEnd_flg@ */ /end MEASUREMENT
/begin MEASUREMENT VTQD_PreLoadHold_flg "" UBYTE SWC_FDC_type_CM_boolean_flg 0 0 0.0 1.0 ECU_ADDRESS 0x0000 /* @ECU_Address@VTQD_PreLoadHold_flg@ */ /end MEASUREMENT
/begin MEASUREMENT VTQD_CreepTCSActive_flg "" UBYTE SWC_FDC_type_CM_boolean_flg 0 0 0.0 1.0 ECU_ADDRESS 0x0000 /* @ECU_Address@VTQD_CreepTCSActive_flg@ */ /end MEASUREMENT
/begin MEASUREMENT VTQD_MediumSkipDisCreep_flg "" UBYTE SWC_FDC_type_CM_boolean_flg 0 0 0.0 1.0 ECU_ADDRESS 0x0000 /* @ECU_Address@VTQD_MediumSkipDisCreep_flg@ */ /end MEASUREMENT
/begin MEASUREMENT VTQD_HighSkipDisCreep_flg "" UBYTE SWC_FDC_type_CM_boolean_flg 0 0 0.0 1.0 ECU_ADDRESS 0x0000 /* @ECU_Address@VTQD_HighSkipDisCreep_flg@ */ /end MEASUREMENT
/begin MEASUREMENT VTQD_CreepPrLoadEnable_flg "" UBYTE SWC_FDC_type_CM_boolean_flg 0 0 0.0 1.0 ECU_ADDRESS 0x0000 /* @ECU_Address@VTQD_CreepPrLoadEnable_flg@ */ /end MEASUREMENT
/begin MEASUREMENT VTQD_LowSkipDisCreep_flg "" UBYTE SWC_FDC_type_CM_boolean_flg 0 0 0.0 1.0 ECU_ADDRESS 0x0000 /* @ECU_Address@VTQD_LowSkipDisCreep_flg@ */ /end MEASUREMENT
/begin MEASUREMENT VTQD_VehWeightEstEn_flg "" UBYTE SWC_FDC_type_CM_boolean_flg 0 0 0.0 1.0 ECU_ADDRESS 0x0000 /* @ECU_Address@VTQD_VehWeightEstEn_flg@ */ /end MEASUREMENT
/begin MEASUREMENT VTQD_EstLongAccCheckPass_flg "" UBYTE SWC_FDC_type_CM_boolean_flg 0 0 0.0 1.0 ECU_ADDRESS 0x0000 /* @ECU_Address@VTQD_EstLongAccCheckPass_flg@ */ /end MEASUREMENT
/begin MEASUREMENT VTQD_EstFrRealTqCheckPass_flg "" UBYTE SWC_FDC_type_CM_boolean_flg 0 0 0.0 1.0 ECU_ADDRESS 0x0000 /* @ECU_Address@VTQD_EstFrRealTqCheckPass_flg@ */ /end MEASUREMENT
/begin MEASUREMENT VTQD_EstRrRealTqCheckPass_flg "" UBYTE SWC_FDC_type_CM_boolean_flg 0 0 0.0 1.0 ECU_ADDRESS 0x0000 /* @ECU_Address@VTQD_EstRrRealTqCheckPass_flg@ */ /end MEASUREMENT
/begin MEASUREMENT VTQD_OPDHoldAllowPark_flg "" UBYTE SWC_FDC_type_CM_boolean_flg 0 0 0.0 1.0 ECU_ADDRESS 0x0000 /* @ECU_Address@VTQD_OPDHoldAllowPark_flg@ */ /end MEASUREMENT
/begin MEASUREMENT VTQD_OPDHoldSpdEnLamp_flg "" UBYTE SWC_FDC_type_CM_boolean_flg 0 0 0.0 1.0 ECU_ADDRESS 0x0000 /* @ECU_Address@VTQD_OPDHoldSpdEnLamp_flg@ */ /end MEASUREMENT
/begin MEASUREMENT VTQD_VehWeightEstEnd_flg "" UBYTE SWC_FDC_type_CM_boolean_flg 0 0 0.0 1.0 ECU_ADDRESS 0x0000 /* @ECU_Address@VTQD_VehWeightEstEnd_flg@ */ /end MEASUREMENT
/begin MEASUREMENT VTQD_CreepPICtrlReset_flg "" UBYTE SWC_FDC_type_CM_boolean_flg 0 0 0.0 1.0 ECU_ADDRESS 0x0000 /* @ECU_Address@VTQD_CreepPICtrlReset_flg@ */ /end MEASUREMENT
/begin MEASUREMENT VTQD_SWCCancelP_flg "" UBYTE SWC_FDC_type_CM_boolean_flg 0 0 0.0 1.0 ECU_ADDRESS 0x0000 /* @ECU_Address@VTQD_SWCCancelP_flg@ */ /end MEASUREMENT
/begin MEASUREMENT VTQD_ChangeToOFF_flg "" UBYTE SWC_FDC_type_CM_boolean_flg 0 0 0.0 1.0 ECU_ADDRESS 0x0000 /* @ECU_Address@VTQD_ChangeToOFF_flg@ */ /end MEASUREMENT
/begin MEASUREMENT VTQD_CCChangeToSTANDBY_flg "" UBYTE SWC_FDC_type_CM_boolean_flg 0 0 0.0 1.0 ECU_ADDRESS 0x0000 /* @ECU_Address@VTQD_CCChangeToSTANDBY_flg@ */ /end MEASUREMENT
/begin MEASUREMENT VTQD_ComboKeyPreEn_flg "" UBYTE SWC_FDC_type_CM_boolean_flg 0 0 0.0 1.0 ECU_ADDRESS 0x0000 /* @ECU_Address@VTQD_ComboKeyPreEn_flg@ */ /end MEASUREMENT
/begin MEASUREMENT VTQD_SWCRegenDownLong_flg "" UBYTE SWC_FDC_type_CM_boolean_flg 0 0 0.0 1.0 ECU_ADDRESS 0x0000 /* @ECU_Address@VTQD_SWCRegenDownLong_flg@ */ /end MEASUREMENT
/begin MEASUREMENT VTQD_SWCRegenUpLong_flg "" UBYTE SWC_FDC_type_CM_boolean_flg 0 0 0.0 1.0 ECU_ADDRESS 0x0000 /* @ECU_Address@VTQD_SWCRegenUpLong_flg@ */ /end MEASUREMENT
/begin MEASUREMENT VTQD_SWCCANCELStaLong_flg "" UBYTE SWC_FDC_type_CM_boolean_flg 0 0 0.0 1.0 ECU_ADDRESS 0x0000 /* @ECU_Address@VTQD_SWCCANCELStaLong_flg@ */ /end MEASUREMENT
/begin MEASUREMENT VTQD_ComboKeyEnCMD_flg "" UBYTE SWC_FDC_type_CM_boolean_flg 0 0 0.0 1.0 ECU_ADDRESS 0x0000 /* @ECU_Address@VTQD_ComboKeyEnCMD_flg@ */ /end MEASUREMENT
/begin MEASUREMENT VTQD_ComboKeyEn_flg "" UBYTE SWC_FDC_type_CM_boolean_flg 0 0 0.0 1.0 ECU_ADDRESS 0x0000 /* @ECU_Address@VTQD_ComboKeyEn_flg@ */ /end MEASUREMENT
/begin MEASUREMENT VTQD_SWCACCStaLong_flg "" UBYTE SWC_FDC_type_CM_boolean_flg 0 0 0.0 1.0 ECU_ADDRESS 0x0000 /* @ECU_Address@VTQD_SWCACCStaLong_flg@ */ /end MEASUREMENT
/begin MEASUREMENT VTQD_ComboKeyReset_flg "" UBYTE SWC_FDC_type_CM_boolean_flg 0 0 0.0 1.0 ECU_ADDRESS 0x0000 /* @ECU_Address@VTQD_ComboKeyReset_flg@ */ /end MEASUREMENT
/begin MEASUREMENT VTQD_SWCRegenDownShort_flg "" UBYTE SWC_FDC_type_CM_boolean_flg 0 0 0.0 1.0 ECU_ADDRESS 0x0000 /* @ECU_Address@VTQD_SWCRegenDownShort_flg@ */ /end MEASUREMENT
/begin MEASUREMENT VTQD_SWCCANCELStaShort_flg "" UBYTE SWC_FDC_type_CM_boolean_flg 0 0 0.0 1.0 ECU_ADDRESS 0x0000 /* @ECU_Address@VTQD_SWCCANCELStaShort_flg@ */ /end MEASUREMENT
/begin MEASUREMENT VTQD_DiagnosisOffPass_flg "" UBYTE SWC_FDC_type_CM_boolean_flg 0 0 0.0 1.0 ECU_ADDRESS 0x0000 /* @ECU_Address@VTQD_DiagnosisOffPass_flg@ */ /end MEASUREMENT
/begin MEASUREMENT VTQD_ComboKeyEnter_flg "" UBYTE SWC_FDC_type_CM_boolean_flg 0 0 0.0 1.0 ECU_ADDRESS 0x0000 /* @ECU_Address@VTQD_ComboKeyEnter_flg@ */ /end MEASUREMENT
/begin MEASUREMENT VTQD_CANCELCountReset_flg "" UBYTE SWC_FDC_type_CM_boolean_flg 0 0 0.0 1.0 ECU_ADDRESS 0x0000 /* @ECU_Address@VTQD_CANCELCountReset_flg@ */ /end MEASUREMENT
/begin MEASUREMENT VTQD_StreetFightModeOff_flg "" UBYTE SWC_FDC_type_CM_boolean_flg 0 0 0.0 1.0 ECU_ADDRESS 0x0000 /* @ECU_Address@VTQD_StreetFightModeOff_flg@ */ /end MEASUREMENT
/begin MEASUREMENT VTQD_DiagnosisOffMode_flg "" UBYTE SWC_FDC_type_CM_boolean_flg 0 0 0.0 1.0 ECU_ADDRESS 0x0000 /* @ECU_Address@VTQD_DiagnosisOffMode_flg@ */ /end MEASUREMENT
/begin MEASUREMENT VTQD_EngineeringPass_flg "" UBYTE SWC_FDC_type_CM_boolean_flg 0 0 0.0 1.0 ECU_ADDRESS 0x0000 /* @ECU_Address@VTQD_EngineeringPass_flg@ */ /end MEASUREMENT
/begin MEASUREMENT VTQD_EngineeringMode_flg "" UBYTE SWC_FDC_type_CM_boolean_flg 0 0 0.0 1.0 ECU_ADDRESS 0x0000 /* @ECU_Address@VTQD_EngineeringMode_flg@ */ /end MEASUREMENT
/begin MEASUREMENT VTQD_ExhibitionPass_flg "" UBYTE SWC_FDC_type_CM_boolean_flg 0 0 0.0 1.0 ECU_ADDRESS 0x0000 /* @ECU_Address@VTQD_ExhibitionPass_flg@ */ /end MEASUREMENT
/begin MEASUREMENT VTQD_ExhibitionMode_flg "" UBYTE SWC_FDC_type_CM_boolean_flg 0 0 0.0 1.0 ECU_ADDRESS 0x0000 /* @ECU_Address@VTQD_ExhibitionMode_flg@ */ /end MEASUREMENT
/begin MEASUREMENT VTQD_ManufacturePass_flg "" UBYTE SWC_FDC_type_CM_boolean_flg 0 0 0.0 1.0 ECU_ADDRESS 0x0000 /* @ECU_Address@VTQD_ManufacturePass_flg@ */ /end MEASUREMENT
/begin MEASUREMENT VTQD_ManufactureMode_flg "" UBYTE SWC_FDC_type_CM_boolean_flg 0 0 0.0 1.0 ECU_ADDRESS 0x0000 /* @ECU_Address@VTQD_ManufactureMode_flg@ */ /end MEASUREMENT
/begin MEASUREMENT VTQD_StreetFightPass_flg "" UBYTE SWC_FDC_type_CM_boolean_flg 0 0 0.0 1.0 ECU_ADDRESS 0x0000 /* @ECU_Address@VTQD_StreetFightPass_flg@ */ /end MEASUREMENT
/begin MEASUREMENT VTQD_StreetFightMode_flg "" UBYTE SWC_FDC_type_CM_boolean_flg 0 0 0.0 1.0 ECU_ADDRESS 0x0000 /* @ECU_Address@VTQD_StreetFightMode_flg@ */ /end MEASUREMENT
/begin MEASUREMENT VTQD_CANCELCountDetFinish_flg "" UBYTE SWC_FDC_type_CM_boolean_flg 0 0 0.0 1.0 ECU_ADDRESS 0x0000 /* @ECU_Address@VTQD_CANCELCountDetFinish_flg@ */ /end MEASUREMENT
/begin MEASUREMENT VTQD_MSASavedSetSpd_raw32 "" FLOAT32_IEEE SWC_FDC_type_CM_single_raw32 0 0 0.0 300.0 ECU_ADDRESS 0x0000 /* @ECU_Address@VTQD_MSASavedSetSpd_raw32@ */ /end MEASUREMENT
/begin MEASUREMENT VTQD_ACCSavedSetSpd_raw32 "" FLOAT32_IEEE SWC_FDC_type_CM_single_raw32 0 0 0.0 300.0 ECU_ADDRESS 0x0000 /* @ECU_Address@VTQD_ACCSavedSetSpd_raw32@ */ /end MEASUREMENT
/begin MEASUREMENT VTQD_DistanceUnit_flg "" UBYTE SWC_FDC_type_CM_boolean_flg 0 0 0.0 1.0 ECU_ADDRESS 0x0000 /* @ECU_Address@VTQD_DistanceUnit_flg@ */ /end MEASUREMENT
/begin MEASUREMENT VTQD_RoadSpdActive2Standby_flg "" UBYTE SWC_FDC_type_CM_boolean_flg 0 0 0.0 1.0 ECU_ADDRESS 0x0000 /* @ECU_Address@VTQD_RoadSpdActive2Standby_flg@ */ /end MEASUREMENT
/begin MEASUREMENT VTQD_StandbyDisRoadSpd_flg "" UBYTE SWC_FDC_type_CM_boolean_flg 0 0 0.0 1.0 ECU_ADDRESS 0x0000 /* @ECU_Address@VTQD_StandbyDisRoadSpd_flg@ */ /end MEASUREMENT
/begin COMPU_METHOD SWC_FDC_type_CM_single_C "Q = V" RAT_FUNC "%8.6" "C" COEFFS 0 1 0 0 0 1 /end COMPU_METHOD
/begin COMPU_METHOD SWC_FDC_type_CM_single_s "Q = V" RAT_FUNC "%8.6" "s" COEFFS 0 1 0 0 0 1 /end COMPU_METHOD
/begin COMPU_METHOD SWC_FDC_type_CM_single_rpm "Q = V" RAT_FUNC "%8.6" "rpm" COEFFS 0 1 0 0 0 1 /end COMPU_METHOD
/begin COMPU_METHOD SWC_FDC_type_CM_uint8_enum "Q = V" RAT_FUNC "%3.0" "enum" COEFFS 0 1 0 0 0 1 /end COMPU_METHOD
/begin COMPU_METHOD SWC_FDC_type_CM_single_Gps "Q = V" RAT_FUNC "%8.6" "Gps" COEFFS 0 1 0 0 0 1 /end COMPU_METHOD
/begin COMPU_METHOD SWC_FDC_type_CM_single_kph "Q = V" RAT_FUNC "%8.6" "kph" COEFFS 0 1 0 0 0 1 /end COMPU_METHOD
/begin COMPU_METHOD SWC_FDC_type_CM_single_c "Q = V" RAT_FUNC "%8.6" "c" COEFFS 0 1 0 0 0 1 /end COMPU_METHOD
/begin COMPU_METHOD SWC_FDC_type_CM_single_mps2 "Q = V" RAT_FUNC "%8.6" "mps2" COEFFS 0 1 0 0 0 1 /end COMPU_METHOD
/begin COMPU_METHOD SWC_FDC_type_CM_single_pct "Q = V" RAT_FUNC "%8.6" "pct" COEFFS 0 1 0 0 0 1 /end COMPU_METHOD
/begin COMPU_METHOD SWC_FDC_type_CM_single_Deg "Q = V" RAT_FUNC "%8.6" "Deg" COEFFS 0 1 0 0 0 1 /end COMPU_METHOD
/begin COMPU_METHOD SWC_FDC_type_CM_single_kg "Q = V" RAT_FUNC "%8.6" "kg" COEFFS 0 1 0 0 0 1 /end COMPU_METHOD
/begin COMPU_METHOD SWC_FDC_type_CM_single_Nm "Q = V" RAT_FUNC "%8.6" "Nm" COEFFS 0 1 0 0 0 1 /end COMPU_METHOD
/begin COMPU_METHOD SWC_FDC_type_CM_single_mps "Q = V" RAT_FUNC "%8.6" "mps" COEFFS 0 1 0 0 0 1 /end COMPU_METHOD
/begin COMPU_METHOD SWC_FDC_type_CM_single_kw "Q = V" RAT_FUNC "%8.6" "kw" COEFFS 0 1 0 0 0 1 /end COMPU_METHOD
/begin COMPU_METHOD SWC_FDC_type_CM_single_kW "Q = V" RAT_FUNC "%8.6" "kW" COEFFS 0 1 0 0 0 1 /end COMPU_METHOD
/begin COMPU_METHOD SWC_FDC_type_CM_single_V "Q = V" RAT_FUNC "%8.6" "V" COEFFS 0 1 0 0 0 1 /end COMPU_METHOD
/begin COMPU_METHOD SWC_FDC_type_CM_single_m "Q = V" RAT_FUNC "%8.6" "m" COEFFS 0 1 0 0 0 1 /end COMPU_METHOD
/begin COMPU_METHOD SWC_FDC_type_CM_single_v "Q = V" RAT_FUNC "%8.6" "v" COEFFS 0 1 0 0 0 1 /end COMPU_METHOD
/begin COMPU_METHOD SWC_FDC_type_CM_single_cnt "Q = V" RAT_FUNC "%8.6" "cnt" COEFFS 0 1 0 0 0 1 /end COMPU_METHOD
/begin COMPU_METHOD SWC_FDC_type_CM_single_raw32 "Q = V" RAT_FUNC "%8.6" "raw32" COEFFS 0 1 0 0 0 1 /end COMPU_METHOD
/begin COMPU_METHOD SWC_FDC_type_CM_boolean_flg "Q = V" RAT_FUNC "%1.0" "flg" COEFFS 0 1 0 0 0 1 /end COMPU_METHOD
/begin COMPU_METHOD SWC_FDC_type_CM_uint8_cnt "Q = V" RAT_FUNC "%3.0" "cnt" COEFFS 0 1 0 0 0 1 /end COMPU_METHOD
/begin COMPU_METHOD SWC_FDC_type_CM_uint8_kph "Q = V" RAT_FUNC "%3.0" "kph" COEFFS 0 1 0 0 0 1 /end COMPU_METHOD
/begin COMPU_METHOD SWC_FDC_type_CM_uint8_raw8 "Q = V" RAT_FUNC "%3.0" "raw8" COEFFS 0 1 0 0 0 1 /end COMPU_METHOD
/begin COMPU_METHOD SWC_FDC_type_CM_uint32_cnt "Q = V" RAT_FUNC "%10.0" "cnt" COEFFS 0 1 0 0 0 1 /end COMPU_METHOD
/begin COMPU_METHOD SWC_FDC_type_CM_uint32_raw32 "Q = V" RAT_FUNC "%10.0" "raw32" COEFFS 0 1 0 0 0 1 /end COMPU_METHOD
/begin COMPU_METHOD SWC_FDC_type_CM_uint32_raw "Q = V" RAT_FUNC "%10.0" "raw" COEFFS 0 1 0 0 0 1 /end COMPU_METHOD
/begin COMPU_METHOD SWC_FDC_type_CM_single_N "Q = V" RAT_FUNC "%8.6" "N" COEFFS 0 1 0 0 0 1 /end COMPU_METHOD
/begin COMPU_METHOD SWC_FDC_type_CM_int16_raw16 "Q = V" RAT_FUNC "%5.0" "raw16" COEFFS 0 1 0 0 0 1 /end COMPU_METHOD
/begin COMPU_METHOD SWC_FDC_type_CM_uint8_raw "Q = V" RAT_FUNC "%3.0" "raw" COEFFS 0 1 0 0 0 1 /end COMPU_METHOD
/begin GROUP S2626_Determination "SWC_FDC_type/run_SWC_FDC_RxTx_5ms_sys/APP/VMC/VMC/Slide Rate  Calculation/4Wheel Calculation/Determination"
 /begin REF_CHARACTERISTIC KVMC_PreVehSpdCalSW_flg KVMC_PreVehSpdNum_c KVMC_PreVehSpdSource_enum KVMC_PredVehSpdLimit_mps /end REF_CHARACTERISTIC
 /begin REF_MEASUREMENT VVMC_4WhlSpdSlideRate_pct VVMC_AllWhlSkid_flg VVMC_CalPredictVehSpd_mps VVMC_DeltaVehSpd_mps VVMC_LastPredictVehSpd_mps VVMC_Max4WhlPreVehSpd_kph VVMC_Max4WhlSpdSlideRate_pct VVMC_Min4WhlPreVehSpd_kph VVMC_Min4WhlSpdSlideRate_pct VVMC_PredictVehSpd1_kph VVMC_PredictVehSpd2_kph VVMC_PredictVehSpd3_kph VVMC_PredictVehSpd_kph /end REF_MEASUREMENT
/end GROUP
/begin GROUP S2626_LF_Wheel "SWC_FDC_type/run_SWC_FDC_RxTx_5ms_sys/APP/VMC/VMC/Slide Rate  Calculation/4Wheel Calculation/LF Wheel" /begin SUB_GROUP S2631_FirstOrderFilter S2631_SR_Latch /end SUB_GROUP
 /begin REF_CHARACTERISTIC KVMC_4WheelEnSkidDetSpd_kph KVMC_LFWhlSkidReset_flg KVMC_PreVehSpdCalSW_flg KVMC_PredVehSpdLimit_mps KVMC_SkidRecVehSpdDev_kph KVMC_WheelSkidAccDev_Gps KVMC_WhlSpdCalAccTs_c /end REF_CHARACTERISTIC
 /begin REF_MEASUREMENT VVMC_LF4WhlSpdSlideRate_pct VVMC_LFCal4WhlSpdSlideRate_pct VVMC_LFCalPreVehSpd_mps VVMC_LFDeltaVehSpd_mps VVMC_LFLastPreVehSpd_mps VVMC_LFPreVehSpd_kph VVMC_LFWhlSkidReset_flg /end REF_MEASUREMENT
/end GROUP
/begin GROUP S2626_LR_Wheel "SWC_FDC_type/run_SWC_FDC_RxTx_5ms_sys/APP/VMC/VMC/Slide Rate  Calculation/4Wheel Calculation/LR Wheel" /begin SUB_GROUP S2632_FirstOrderFilter2 S2632_SR_Latch2 /end SUB_GROUP
 /begin REF_CHARACTERISTIC KVMC_4WheelEnSkidDetSpd_kph KVMC_LRWhlSkidReset_flg KVMC_PreVehSpdCalSW_flg KVMC_PredVehSpdLimit_mps KVMC_SkidRecVehSpdDev_kph KVMC_WheelSkidAccDev_Gps KVMC_WhlSpdCalAccTs_c /end REF_CHARACTERISTIC
 /begin REF_MEASUREMENT VVMC_LR4WhlSpdSlideRate_pct VVMC_LRCal4WhlSpdSlideRate_pct VVMC_LRCalPreVehSpd_mps VVMC_LRDeltaVehSpd_mps VVMC_LRLastPreVehSpd_mps VVMC_LRPreVehSpd_kph VVMC_LRWhlSkidReset_flg /end REF_MEASUREMENT
/end GROUP
/begin GROUP S2626_RF_Wheel "SWC_FDC_type/run_SWC_FDC_RxTx_5ms_sys/APP/VMC/VMC/Slide Rate  Calculation/4Wheel Calculation/RF Wheel" /begin SUB_GROUP S2633_FirstOrderFilter1 S2633_SR_Latch1 /end SUB_GROUP
 /begin REF_CHARACTERISTIC KVMC_4WheelEnSkidDetSpd_kph KVMC_PreVehSpdCalSW_flg KVMC_PredVehSpdLimit_mps KVMC_RFWhlSkidReset_flg KVMC_SkidRecVehSpdDev_kph KVMC_WheelSkidAccDev_Gps KVMC_WhlSpdCalAccTs_c /end REF_CHARACTERISTIC
 /begin REF_MEASUREMENT VVMC_RF4WhlSpdSlideRate_pct VVMC_RFCal4WhlSpdSlideRate_pct VVMC_RFCalPreVehSpd_mps VVMC_RFDeltaVehSpd_mps VVMC_RFLastPreVehSpd_mps VVMC_RFPreVehSpd_kph VVMC_RFWhlSkidReset_flg /end REF_MEASUREMENT
/end GROUP
/begin GROUP S2626_RR_Wheel "SWC_FDC_type/run_SWC_FDC_RxTx_5ms_sys/APP/VMC/VMC/Slide Rate  Calculation/4Wheel Calculation/RR Wheel" /begin SUB_GROUP S2634_FirstOrderFilter3 S2634_SR_Latch3 /end SUB_GROUP
 /begin REF_CHARACTERISTIC KVMC_4WheelEnSkidDetSpd_kph KVMC_PreVehSpdCalSW_flg KVMC_PredVehSpdLimit_mps KVMC_RRWhlSkidReset_flg KVMC_SkidRecVehSpdDev_kph KVMC_WheelSkidAccDev_Gps KVMC_WhlSpdCalAccTs_c /end REF_CHARACTERISTIC
 /begin REF_MEASUREMENT VVMC_RR4WhlSpdSlideRate_pct VVMC_RRCal4WhlSpdSlideRate_pct VVMC_RRCalPreVehSpd_mps VVMC_RRDeltaVehSpd_mps VVMC_RRLastPreVehSpd_mps VVMC_RRPreVehSpd_kph VVMC_RRWhlSkidReset_flg /end REF_MEASUREMENT
/end GROUP
/begin GROUP S2628_DelayEnable "SWC_FDC_type/run_SWC_FDC_RxTx_5ms_sys/APP/VMC/VMC/Slide Rate  Calculation/Coordination/DelayEnable" /begin REF_MEASUREMENT VVMC_VehSpdPredSkid_flg /end REF_MEASUREMENT /end GROUP
/begin GROUP S2628_FirstOrderFilter "SWC_FDC_type/run_SWC_FDC_RxTx_5ms_sys/APP/VMC/VMC/Slide Rate  Calculation/Coordination/FirstOrderFilter" /begin REF_MEASUREMENT VVMC_IntMaxSlideRate_pct /end REF_MEASUREMENT /end GROUP
/begin GROUP S2628_FirstOrderFilter1 "SWC_FDC_type/run_SWC_FDC_RxTx_5ms_sys/APP/VMC/VMC/Slide Rate  Calculation/Coordination/FirstOrderFilter1" /begin REF_MEASUREMENT VVMC_ActLFSlideRate_pct /end REF_MEASUREMENT /end GROUP
/begin GROUP S2628_FirstOrderFilter2 "SWC_FDC_type/run_SWC_FDC_RxTx_5ms_sys/APP/VMC/VMC/Slide Rate  Calculation/Coordination/FirstOrderFilter2" /begin REF_MEASUREMENT VVMC_ActRFSlideRate_pct /end REF_MEASUREMENT /end GROUP
/begin GROUP S2628_FirstOrderFilter3 "SWC_FDC_type/run_SWC_FDC_RxTx_5ms_sys/APP/VMC/VMC/Slide Rate  Calculation/Coordination/FirstOrderFilter3" /begin REF_MEASUREMENT VVMC_ActLRSlideRate_pct /end REF_MEASUREMENT /end GROUP
/begin GROUP S2628_FirstOrderFilter4 "SWC_FDC_type/run_SWC_FDC_RxTx_5ms_sys/APP/VMC/VMC/Slide Rate  Calculation/Coordination/FirstOrderFilter4" /begin REF_MEASUREMENT VVMC_ActRRSlideRate_pct /end REF_MEASUREMENT /end GROUP
/begin GROUP S1089_Doublecheck "SWC_FDC_type/run_SWC_FDC_RxTx_5ms_sys/APP/TPM/TPMS/TPMS/Learn/AutoLocation/Doublecheck"
 /begin REF_MEASUREMENT VTPM_Chkfin_flg VTPM_LFID_raw VTPM_LRID_raw VTPM_RFID_raw VTPM_RRID_raw /end REF_MEASUREMENT
/end GROUP
/begin GROUP S1089_IDIdentify "SWC_FDC_type/run_SWC_FDC_RxTx_5ms_sys/APP/TPM/TPMS/TPMS/Learn/AutoLocation/IDIdentify"
 /begin SUB_GROUP S1098_Acceptancerate S1098_Subsystem1 S1098_Subsystem2 S1098_Subsystem3 S1098_Subsystem7 /end SUB_GROUP
 /begin REF_MEASUREMENT VTPM_ALFin_flg VTPM_C1_cnt VTPM_C2_cnt VTPM_C3_cnt VTPM_C4_cnt VTPM_FAT_flg VTPM_IDLock_flg VTPM_Locdonetimes_cnt VTPM_SetIDLoc_flg VTPM_unlearnSfailvalid_enum VTPM_unlearnSfali_flg /end REF_MEASUREMENT
/end GROUP
/begin GROUP S1089_IDtrans "SWC_FDC_type/run_SWC_FDC_RxTx_5ms_sys/APP/TPM/TPMS/TPMS/Learn/AutoLocation/IDtrans"
 /begin REF_MEASUREMENT VTPM_S1ID_raw32 VTPM_S1L_enum VTPM_S2ID_raw32 VTPM_S2L_enum VTPM_S3ID_raw32 VTPM_S3L_enum VTPM_S4ID_raw32 VTPM_S4L_enum /end REF_MEASUREMENT
/end GROUP
/begin GROUP S1089_Subsystem "SWC_FDC_type/run_SWC_FDC_RxTx_5ms_sys/APP/TPM/TPMS/TPMS/Learn/AutoLocation/Subsystem"
 /begin REF_MEASUREMENT VTPM_FlashIDvalid_enum VTPM_FlashS1ID_raw VTPM_FlashS2ID_raw VTPM_FlashS3ID_raw VTPM_FlashS4ID_raw /end REF_MEASUREMENT
/end GROUP
/begin GROUP S1089_Subsystem1 "SWC_FDC_type/run_SWC_FDC_RxTx_5ms_sys/APP/TPM/TPMS/TPMS/Learn/AutoLocation/Subsystem1" /begin SUB_GROUP S1101_Subsystem /end SUB_GROUP
 /begin REF_MEASUREMENT VTPM_LProgress_enum VTPM_ManualID1Temp_C VTPM_ManualID1_raw VTPM_ManualID1pressure_raw VTPM_ManualID2Temp_C VTPM_ManualID2_raw VTPM_ManualID2pressure_raw VTPM_ManualID3Temp_C VTPM_ManualID3_raw VTPM_ManualID3pressure_raw VTPM_ManualID4Temp_C VTPM_ManualID4_raw VTPM_ManualID4pressure_raw VTPM_TPMSTLCmd_flg VTPM_TPMSmanualDone_flg VTPM_WritingCnt_enum /end REF_MEASUREMENT
/end GROUP
/begin GROUP S1089_WheelPosition "SWC_FDC_type/run_SWC_FDC_RxTx_5ms_sys/APP/TPM/TPMS/TPMS/Learn/AutoLocation/WheelPosition"
 /begin SUB_GROUP S1102_Subsystem S1102_Subsystem1 S1102_Subsystem2 S1102_Subsystem3 /end SUB_GROUP
/end GROUP
/begin GROUP S1236_LFTHighWarn "SWC_FDC_type/run_SWC_FDC_RxTx_5ms_sys/APP/TPM/TPMS/TPMS/Send/Alarm/LFTHighWarn" /begin REF_MEASUREMENT VTPM_LFWheelTmpIndi_flg /end REF_MEASUREMENT /end GROUP
/begin GROUP S1236_LRTHighWarn "SWC_FDC_type/run_SWC_FDC_RxTx_5ms_sys/APP/TPM/TPMS/TPMS/Send/Alarm/LRTHighWarn" /begin REF_MEASUREMENT VTPM_LRWheelTmpIndi_flg /end REF_MEASUREMENT /end GROUP
/begin GROUP S1236_RFTHighWarn "SWC_FDC_type/run_SWC_FDC_RxTx_5ms_sys/APP/TPM/TPMS/TPMS/Send/Alarm/RFTHighWarn" /begin REF_MEASUREMENT VTPM_RFWheelTmpIndi_flg /end REF_MEASUREMENT /end GROUP
/begin GROUP S1236_RRTHighWarn "SWC_FDC_type/run_SWC_FDC_RxTx_5ms_sys/APP/TPM/TPMS/TPMS/Send/Alarm/RRTHighWarn" /begin REF_MEASUREMENT VTPM_RRWheelTmpIndi_flg /end REF_MEASUREMENT /end GROUP
/begin GROUP S1330_DelayEnable "SWC_FDC_type/run_SWC_FDC_RxTx_5ms_sys/APP/TQD/TorqueDemand/ShiftModule/GearShiftPosn/Drive Protection/DelayEnable" /begin REF_MEASUREMENT VTQD_DriveProtRemove_flg /end REF_MEASUREMENT /end GROUP
/begin GROUP S1406_Combo_Key_Detection "SWC_FDC_type/run_SWC_FDC_RxTx_5ms_sys/APP/TQD/TorqueDemand/Signal_convert/SWC2_Subsystem/Big Mike Combo/Combo Key Detection"
 /begin SUB_GROUP S1418_DiagnosisOff_Mode S1418_Engineering_Mode S1418_Exhibition_Mode S1418_Manufacture_Mode S1418_Street_Fight_Mode /end SUB_GROUP
/end GROUP
/begin GROUP S1406_Mode_Coordination "SWC_FDC_type/run_SWC_FDC_RxTx_5ms_sys/APP/TQD/TorqueDemand/Signal_convert/SWC2_Subsystem/Big Mike Combo/Mode Coordination" /begin REF_MEASUREMENT VTQD_SysMode_enum /end REF_MEASUREMENT /end GROUP
/begin GROUP S1406_Operation_Condition "SWC_FDC_type/run_SWC_FDC_RxTx_5ms_sys/APP/TQD/TorqueDemand/Signal_convert/SWC2_Subsystem/Big Mike Combo/Operation Condition" /begin REF_MEASUREMENT VTQD_ComboKeyEn_flg VTQD_ComboKeyPreEn_flg /end REF_MEASUREMENT /end GROUP
/begin GROUP S1406_Signal_Status_Detection "SWC_FDC_type/run_SWC_FDC_RxTx_5ms_sys/APP/TQD/TorqueDemand/Signal_convert/SWC2_Subsystem/Big Mike Combo/Signal Status Detection"
 /begin SUB_GROUP S1421_DelayEnable6 S1421_DelayEnable7 S1421_DelayEnable8 S1421_DelayEnable9 S1421_SR_Latch S1421_Street_Fight_Switch_Off /end SUB_GROUP
 /begin REF_CHARACTERISTIC KTQD_ComboKeyLongDet_s KTQD_SetSpdShortPLim_s /end REF_CHARACTERISTIC
 /begin REF_MEASUREMENT VTQD_ComboKeyEnter_flg VTQD_ComboKeyReset_flg VTQD_ComboKey_enum VTQD_SWCCANCELStaShort_flg VTQD_SWCRegenDownShort_flg /end REF_MEASUREMENT
/end GROUP
/begin GROUP S1415_ACC_Speed_Setting_ON "SWC_FDC_type/run_SWC_FDC_RxTx_5ms_sys/APP/TQD/TorqueDemand/Signal_convert/SWC2_Subsystem/Speed Setting Mode/ACC Speed Setting ON"
 /begin REF_CHARACTERISTIC KTQD_ACCActiveMetSpdHiMPH_mph KTQD_ACCActiveMetSpdHi_kph KTQD_ACCOVRDSpdAdj_flg KTQD_AllowSetSpdOvrdVal_flg KTQD_AllowSetSpdOvrd_flg KTQD_AllowSetSpdSpd_kph KTQD_SetSpdDeltaLongMPH_mph KTQD_SetSpdDeltaLong_kph /end REF_CHARACTERISTIC
 /begin REF_MEASUREMENT VTQD_ACCSavedSetSpd_raw32 VTQD_DistanceUnit_flg VTQD_RoadSpdActive2Standby_flg VTQD_StandbyDisRoadSpd_flg /end REF_MEASUREMENT
/end GROUP
/begin GROUP S1415_CC_Speed_Setting_ON "SWC_FDC_type/run_SWC_FDC_RxTx_5ms_sys/APP/TQD/TorqueDemand/Signal_convert/SWC2_Subsystem/Speed Setting Mode/CC Speed Setting ON"
 /begin REF_CHARACTERISTIC KTQD_SetSpdDeltaLongMPH_mph KTQD_SetSpdDeltaLong_kph KTQD_SetSpdDeltaShort_kph /end REF_CHARACTERISTIC
/end GROUP
/begin GROUP S1415_MSA_Speed_Setting_ON "SWC_FDC_type/run_SWC_FDC_RxTx_5ms_sys/APP/TQD/TorqueDemand/Signal_convert/SWC2_Subsystem/Speed Setting Mode/MSA Speed Setting ON"
 /begin REF_CHARACTERISTIC KTQD_ACCOVRDSpdAdj_flg KTQD_ISATestSW_flg KTQD_SetSpdDeltaLongMPH_mph KTQD_SetSpdDeltaLong_kph /end REF_CHARACTERISTIC
 /begin REF_MEASUREMENT VTQD_MSASavedSetSpd_raw32 /end REF_MEASUREMENT
/end GROUP
/begin GROUP S1415_SWC2ScrollDownSta "SWC_FDC_type/run_SWC_FDC_RxTx_5ms_sys/APP/TQD/TorqueDemand/Signal_convert/SWC2_Subsystem/Speed Setting Mode/SWC2ScrollDownSta" /begin REF_CHARACTERISTIC KTQD_ScrollDownLongPLim_s KTQD_ScrollDownShortPLim_s /end REF_CHARACTERISTIC /begin REF_MEASUREMENT VTQD_SWC2ScrollDownSta_enum /end REF_MEASUREMENT /end GROUP
/begin GROUP S1415_SWC2ScrollUpSta "SWC_FDC_type/run_SWC_FDC_RxTx_5ms_sys/APP/TQD/TorqueDemand/Signal_convert/SWC2_Subsystem/Speed Setting Mode/SWC2ScrollUpSta" /begin REF_CHARACTERISTIC KTQD_ScrollUpLongPLim_s KTQD_ScrollUpShortPLim_s /end REF_CHARACTERISTIC /begin REF_MEASUREMENT VTQD_SWC2ScrollUpSta_enum /end REF_MEASUREMENT /end GROUP
/begin GROUP S1761_ACC_Speed_Setting_ON "SWC_FDC_type/run_SWC_FDC_RxTx_5ms_sys/APP/TQD/TorqueDemand/Signal_convert/SWC_Subsystem/Speed Setting Mode/ACC Speed Setting ON"
 /begin REF_CHARACTERISTIC KTQD_ACCActiveMetSpdHiMPH_mph KTQD_ACCActiveMetSpdHi_kph KTQD_AllowSetSpdOvrdVal_flg KTQD_AllowSetSpdOvrd_flg KTQD_AllowSetSpdSpd_kph KTQD_SetSpdDeltaLongMPH_mph KTQD_SetSpdDeltaLong_kph KTQD_SetSpdLongPLim_s /end REF_CHARACTERISTIC
/end GROUP
/begin GROUP S1761_CC_Speed_Setting_ON "SWC_FDC_type/run_SWC_FDC_RxTx_5ms_sys/APP/TQD/TorqueDemand/Signal_convert/SWC_Subsystem/Speed Setting Mode/CC Speed Setting ON"
 /begin REF_CHARACTERISTIC KTQD_SetSpdDeltaLongMPH_mph KTQD_SetSpdDeltaLong_kph KTQD_SetSpdDeltaShort_kph /end REF_CHARACTERISTIC
 /begin REF_MEASUREMENT VTQD_CCChangeToSTANDBY_flg /end REF_MEASUREMENT
/end GROUP
/begin GROUP S1761_MSA_Speed_Setting_ON "SWC_FDC_type/run_SWC_FDC_RxTx_5ms_sys/APP/TQD/TorqueDemand/Signal_convert/SWC_Subsystem/Speed Setting Mode/MSA Speed Setting ON"
 /begin REF_CHARACTERISTIC KTQD_SetSpdDeltaLongMPH_mph KTQD_SetSpdDeltaLong_kph KTQD_SetSpdDeltaShort_kph /end REF_CHARACTERISTIC
 /begin REF_MEASUREMENT VTQD_ChangeToOFF_flg /end REF_MEASUREMENT
/end GROUP
/begin GROUP S1761_VTQD_SWCCancelP_flg "SWC_FDC_type/run_SWC_FDC_RxTx_5ms_sys/APP/TQD/TorqueDemand/Signal_convert/SWC_Subsystem/Speed Setting Mode/VTQD_SWCCancelP_flg" /begin REF_MEASUREMENT VTQD_SWCCancelP_flg /end REF_MEASUREMENT /end GROUP
/begin GROUP S1761_VTQD_SWCResUpPress_enum "SWC_FDC_type/run_SWC_FDC_RxTx_5ms_sys/APP/TQD/TorqueDemand/Signal_convert/SWC_Subsystem/Speed Setting Mode/VTQD_SWCResUpPress_enum" /begin REF_CHARACTERISTIC KTQD_SetSpdLongPLim_s KTQD_SetSpdShortPLim_s /end REF_CHARACTERISTIC /begin REF_MEASUREMENT VTQD_SWCResUpPress_enum /end REF_MEASUREMENT /end GROUP
/begin GROUP S1761_VTQD_SWCSetDownPress_enum "SWC_FDC_type/run_SWC_FDC_RxTx_5ms_sys/APP/TQD/TorqueDemand/Signal_convert/SWC_Subsystem/Speed Setting Mode/VTQD_SWCSetDownPress_enum" /begin REF_CHARACTERISTIC KTQD_SetSpdLongPLim_s KTQD_SetSpdShortPLim_s /end REF_CHARACTERISTIC /begin REF_MEASUREMENT VTQD_SWCSetDownPress_enum /end REF_MEASUREMENT /end GROUP
/begin GROUP S1794_Front_Wheel_Torque "SWC_FDC_type/run_SWC_FDC_RxTx_5ms_sys/APP/TQD/TorqueDemand/Signal_convert/VehWeightEst/Calaulation/Front Wheel Torque" /begin REF_CHARACTERISTIC KTQD_EstFrWhlTqDev_Nm KTQD_VehWeighEstTimeTune_cnt /end REF_CHARACTERISTIC
 /begin REF_MEASUREMENT VTQD_EstFrRealTqAvg_Nm VTQD_EstFrRealTqCheckPass_flg VTQD_EstFrRealTqMin_Nm VTQD_EstFrRealTqSum_Nm /end REF_MEASUREMENT
/end GROUP
/begin GROUP S1794_Long_Acc "SWC_FDC_type/run_SWC_FDC_RxTx_5ms_sys/APP/TQD/TorqueDemand/Signal_convert/VehWeightEst/Calaulation/Long Acc"
 /begin REF_CHARACTERISTIC KTQD_EstLongAccDev_Gps KTQD_VehWeighEstIntAcc_Gps KTQD_VehWeighEstTimeTune_cnt /end REF_CHARACTERISTIC
 /begin REF_MEASUREMENT VTQD_EstCycleCount_cnt VTQD_EstLongAccAvg_Gps VTQD_EstLongAccCheckPass_flg VTQD_EstLongAccMin_Gps VTQD_EstLongAccSum_Gps /end REF_MEASUREMENT
/end GROUP
/begin GROUP S1794_Rear_Wheel_Torque "SWC_FDC_type/run_SWC_FDC_RxTx_5ms_sys/APP/TQD/TorqueDemand/Signal_convert/VehWeightEst/Calaulation/Rear Wheel Torque" /begin REF_CHARACTERISTIC KTQD_EstRrWhlTqDev_Nm KTQD_VehWeighEstTimeTune_cnt /end REF_CHARACTERISTIC
 /begin REF_MEASUREMENT VTQD_EstRrRealTqAvg_Nm VTQD_EstRrRealTqCheckPass_flg VTQD_EstRrRealTqMin_Nm VTQD_EstRrRealTqSum_Nm /end REF_MEASUREMENT
/end GROUP
/begin GROUP S1794_Vehicle_Weight "SWC_FDC_type/run_SWC_FDC_RxTx_5ms_sys/APP/TQD/TorqueDemand/Signal_convert/VehWeightEst/Calaulation/Vehicle Weight"
 /begin REF_CHARACTERISTIC KTQD_EstRollCoeffA_c KTQD_EstRollCoeffB_c KTQD_EstRollCoeffC_c KTQD_FrTireRadius_m KTQD_GravityValue_mps2 KTQD_RrTireRadius_m /end REF_CHARACTERISTIC
 /begin REF_MEASUREMENT VTQD_EstActTotalForce_N VTQD_EstFrActForce_N VTQD_EstFrForce_N VTQD_EstFrWhlTqAvg_Nm VTQD_EstRollForce_N VTQD_EstRrActForce_N VTQD_EstRrForce_N VTQD_EstRrWhlTqAvg_Nm VTQD_EstVehWeight_kg /end REF_MEASUREMENT
/end GROUP
/begin GROUP S1795_DelayEnable "SWC_FDC_type/run_SWC_FDC_RxTx_5ms_sys/APP/TQD/TorqueDemand/Signal_convert/VehWeightEst/Condition/DelayEnable" /begin REF_MEASUREMENT VTQD_VehWeightEstEn_flg /end REF_MEASUREMENT /end GROUP
/begin GROUP S1795_Timer1 "SWC_FDC_type/run_SWC_FDC_RxTx_5ms_sys/APP/TQD/TorqueDemand/Signal_convert/VehWeightEst/Condition/Timer1" /begin REF_MEASUREMENT VTQD_EstVehWeightResetTime_s /end REF_MEASUREMENT /end GROUP
/begin GROUP S1796_DelayEnable "SWC_FDC_type/run_SWC_FDC_RxTx_5ms_sys/APP/TQD/TorqueDemand/Signal_convert/VehWeightEst/Desicion/DelayEnable" /begin REF_MEASUREMENT VTQD_VehWeightEstEnd_flg /end REF_MEASUREMENT /end GROUP
/begin GROUP S1866_CapacityDistribution "SWC_FDC_type/run_SWC_FDC_RxTx_5ms_sys/APP/TQD/TorqueDemand/TorqueModule/AvaliableTqLimit/TorqueCapacityCalcalation/CapacityDistribution" /begin REF_MEASUREMENT VTQD_FrHVBPwrAvailDchrg_kW VTQD_RrHVBPwrAvailDchrg_kW /end REF_MEASUREMENT /end GROUP
/begin GROUP S1866_Generation "SWC_FDC_type/run_SWC_FDC_RxTx_5ms_sys/APP/TQD/TorqueDemand/TorqueModule/AvaliableTqLimit/TorqueCapacityCalcalation/Generation"
 /begin REF_CHARACTERISTIC KTQD_FrLowTheldTrq_Nm KTQD_FrTMSpdMin_rpm KTQD_RrLowTheldTrq_Nm KTQD_RrTMSpdMin_rpm KTQD_WhlTqCapGenFr_Nm_ovrdflg KTQD_WhlTqCapGenFr_Nm_ovrdval KTQD_WhlTqCapGenRr_Nm_ovrdflg KTQD_WhlTqCapGenRr_Nm_ovrdval /end REF_CHARACTERISTIC
 /begin REF_MEASUREMENT VTQD_WhlTqCapGenFr_Nm VTQD_WhlTqCapGenRr_Nm /end REF_MEASUREMENT
/end GROUP
/begin GROUP S1866_MOTOR_Loss_MAP_ "SWC_FDC_type/run_SWC_FDC_RxTx_5ms_sys/APP/TQD/TorqueDemand/TorqueModule/AvaliableTqLimit/TorqueCapacityCalcalation/MOTOR Loss MAP "
 /begin REF_CHARACTERISTIC KTQD_FrLossMAPHighV_V KTQD_FrLossMAPLowV_V KTQD_RrLossMAPHighV_V KTQD_RrLossMAPLowV_V MTQD_FrLossMAPHighV_Z_kw MTQD_FrLossMAPLowV_Z_kw MTQD_RrLossMAPHighV_Z_kw MTQD_RrLossMAPLowV_Z_kw /end REF_CHARACTERISTIC
 /begin REF_MEASUREMENT VTQD_FrLossMAPFinal_kw VTQD_FrLossMAPHighV_V VTQD_FrLossMAPHighV_kw VTQD_FrLossMAPLowV_V VTQD_FrLossMAPLowV_kw VTQD_MotorLossTotal_kw VTQD_RrLossMAPFinal_kw VTQD_RrLossMAPHighV_V VTQD_RrLossMAPHighV_kw VTQD_RrLossMAPLowV_V VTQD_RrLossMAPLowV_kw /end REF_MEASUREMENT
/end GROUP
/begin GROUP S1866_Motoring "SWC_FDC_type/run_SWC_FDC_RxTx_5ms_sys/APP/TQD/TorqueDemand/TorqueModule/AvaliableTqLimit/TorqueCapacityCalcalation/Motoring"
 /begin REF_CHARACTERISTIC KTQD_FrTMSpdMin_rpm KTQD_RrTMSpdMin_rpm KTQD_WhlTqCapMotFr_Nm_ovrdflg KTQD_WhlTqCapMotFr_Nm_ovrdval KTQD_WhlTqCapMotRr_Nm_ovrdflg KTQD_WhlTqCapMotRr_Nm_ovrdval /end REF_CHARACTERISTIC
 /begin REF_MEASUREMENT VTQD_WhlTqCapMotFr_Nm VTQD_WhlTqCapMotRr_Nm /end REF_MEASUREMENT
/end GROUP
/begin GROUP S1866_RateLimit "SWC_FDC_type/run_SWC_FDC_RxTx_5ms_sys/APP/TQD/TorqueDemand/TorqueModule/AvaliableTqLimit/TorqueCapacityCalcalation/RateLimit" /begin REF_MEASUREMENT VTQD_FrRockDisAvalMotTq_Nm /end REF_MEASUREMENT /end GROUP
/begin GROUP S1866_RateLimit1 "SWC_FDC_type/run_SWC_FDC_RxTx_5ms_sys/APP/TQD/TorqueDemand/TorqueModule/AvaliableTqLimit/TorqueCapacityCalcalation/RateLimit1" /begin REF_MEASUREMENT VTQD_RrRockDisAvalMotTq_Nm /end REF_MEASUREMENT /end GROUP
/begin GROUP S1866_TMAvailablePwr_Calculation "SWC_FDC_type/run_SWC_FDC_RxTx_5ms_sys/APP/TQD/TorqueDemand/TorqueModule/AvaliableTqLimit/TorqueCapacityCalcalation/TMAvailablePwr_Calculation" /begin REF_MEASUREMENT VTQD_TMPwrAvailDchrg_kW /end REF_MEASUREMENT /end GROUP
/begin GROUP S1874_SR_Latch "SWC_FDC_type/run_SWC_FDC_RxTx_5ms_sys/APP/TQD/TorqueDemand/TorqueModule/DriverWhlTqDem/BOS/SR_Latch" /begin REF_MEASUREMENT VTQD_BOSEnable_flg /end REF_MEASUREMENT /end GROUP
/begin GROUP S1875_If_Action_Subsystem1 "SWC_FDC_type/run_SWC_FDC_RxTx_5ms_sys/APP/TQD/TorqueDemand/TorqueModule/DriverWhlTqDem/Creep/If Action Subsystem1"
 /begin REF_CHARACTERISTIC KTQD_APSCreepItermMaxLim_Nm KTQD_CreepItermMinLimit_Nm MTQD_CreepItermMaxLimit_Y_Nm /end REF_CHARACTERISTIC
 /begin REF_MEASUREMENT VTQD_CreepItermMaxLimit_Nm VTQD_CreepItermTq_Nm VTQD_CreepOffsetTq_Nm VTQD_CreepPICtrlReset_flg VTQD_CreepPtermTq_Nm VTQD_CreepTotalOfstTq_Nm /end REF_MEASUREMENT
/end GROUP
/begin GROUP S1875_SR_Latch "SWC_FDC_type/run_SWC_FDC_RxTx_5ms_sys/APP/TQD/TorqueDemand/TorqueModule/DriverWhlTqDem/Creep/SR_Latch" /begin REF_MEASUREMENT VTQD_CreepPrLoadEnable_flg /end REF_MEASUREMENT /end GROUP
/begin GROUP S1875_SR_Latch2 "SWC_FDC_type/run_SWC_FDC_RxTx_5ms_sys/APP/TQD/TorqueDemand/TorqueModule/DriverWhlTqDem/Creep/SR_Latch2" /begin REF_MEASUREMENT VTQD_LowSkipDisCreep_flg /end REF_MEASUREMENT /end GROUP
/begin GROUP S1875_SR_Latch4 "SWC_FDC_type/run_SWC_FDC_RxTx_5ms_sys/APP/TQD/TorqueDemand/TorqueModule/DriverWhlTqDem/Creep/SR_Latch4" /begin REF_MEASUREMENT VTQD_CreepTCSActive_flg /end REF_MEASUREMENT /end GROUP
/begin GROUP S1875_SR_Latch5 "SWC_FDC_type/run_SWC_FDC_RxTx_5ms_sys/APP/TQD/TorqueDemand/TorqueModule/DriverWhlTqDem/Creep/SR_Latch5" /begin REF_MEASUREMENT VTQD_MediumSkipDisCreep_flg /end REF_MEASUREMENT /end GROUP
/begin GROUP S1875_SR_Latch6 "SWC_FDC_type/run_SWC_FDC_RxTx_5ms_sys/APP/TQD/TorqueDemand/TorqueModule/DriverWhlTqDem/Creep/SR_Latch6" /begin REF_MEASUREMENT VTQD_HighSkipDisCreep_flg /end REF_MEASUREMENT /end GROUP
/begin GROUP S1875_SR_Latch7 "SWC_FDC_type/run_SWC_FDC_RxTx_5ms_sys/APP/TQD/TorqueDemand/TorqueModule/DriverWhlTqDem/Creep/SR_Latch7" /begin REF_MEASUREMENT VTQD_CreepGradeLatch_flg /end REF_MEASUREMENT /end GROUP
/begin GROUP S1875_Timer "SWC_FDC_type/run_SWC_FDC_RxTx_5ms_sys/APP/TQD/TorqueDemand/TorqueModule/DriverWhlTqDem/Creep/Timer" /begin REF_MEASUREMENT VTQD_CreepPreloadTime_s /end REF_MEASUREMENT /end GROUP
/begin GROUP S1876_New_Preload_Torque "SWC_FDC_type/run_SWC_FDC_RxTx_5ms_sys/APP/TQD/TorqueDemand/TorqueModule/DriverWhlTqDem/DriverTqCoordination/New Preload Torque" /begin REF_CHARACTERISTIC MTQD_FrPreLoadTq_Y_Nm MTQD_RrPreLoadTq_Y_Nm /end REF_CHARACTERISTIC /begin REF_MEASUREMENT VTQD_FrPreloadTq_Nm VTQD_RrPreloadTq_Nm /end REF_MEASUREMENT /end GROUP
/begin GROUP S1876_SR_Latch "SWC_FDC_type/run_SWC_FDC_RxTx_5ms_sys/APP/TQD/TorqueDemand/TorqueModule/DriverWhlTqDem/DriverTqCoordination/SR_Latch" /begin REF_MEASUREMENT VTQD_LoSpdBrkCtrl_flg /end REF_MEASUREMENT /end GROUP
/begin GROUP S1876_SR_Latch2 "SWC_FDC_type/run_SWC_FDC_RxTx_5ms_sys/APP/TQD/TorqueDemand/TorqueModule/DriverWhlTqDem/DriverTqCoordination/SR_Latch2" /begin REF_MEASUREMENT VTQD_PreLoadHold_flg /end REF_MEASUREMENT /end GROUP
/begin GROUP S1876_SR_Latch6 "SWC_FDC_type/run_SWC_FDC_RxTx_5ms_sys/APP/TQD/TorqueDemand/TorqueModule/DriverWhlTqDem/DriverTqCoordination/SR_Latch6" /begin REF_MEASUREMENT VTQD_PreLoadHoldtimeEnd_flg /end REF_MEASUREMENT /end GROUP
/begin GROUP S1876_Timer1 "SWC_FDC_type/run_SWC_FDC_RxTx_5ms_sys/APP/TQD/TorqueDemand/TorqueModule/DriverWhlTqDem/DriverTqCoordination/Timer1" /begin REF_MEASUREMENT VTQD_PreLoadHoldtime_s /end REF_MEASUREMENT /end GROUP
/begin GROUP S1877_LHM "SWC_FDC_type/run_SWC_FDC_RxTx_5ms_sys/APP/TQD/TorqueDemand/TorqueModule/DriverWhlTqDem/PedalMapWhlTq/LHM"
 /begin REF_CHARACTERISTIC MTQD_LHMGrade2TqUpLim_Z_Nm MTQD_NL1TqMapD_Z_Nm MTQD_NRMTqMapR_Z_Nm /end REF_CHARACTERISTIC
/end GROUP
/begin GROUP S1877_NoLHM "SWC_FDC_type/run_SWC_FDC_RxTx_5ms_sys/APP/TQD/TorqueDemand/TorqueModule/DriverWhlTqDem/PedalMapWhlTq/NoLHM" /begin SUB_GROUP S1926_ShiftD S1926_ShiftR /end SUB_GROUP /end GROUP
/begin GROUP S1877_Pedal_G_Control_Mode "SWC_FDC_type/run_SWC_FDC_RxTx_5ms_sys/APP/TQD/TorqueDemand/TorqueModule/DriverWhlTqDem/PedalMapWhlTq/Pedal G-Control Mode" /begin SUB_GROUP S1927_Active_Determination S1927_Torque_Calculation /end SUB_GROUP /end GROUP
/begin GROUP S1877_SR_Latch1 "SWC_FDC_type/run_SWC_FDC_RxTx_5ms_sys/APP/TQD/TorqueDemand/TorqueModule/DriverWhlTqDem/PedalMapWhlTq/SR_Latch1" /begin REF_MEASUREMENT VTQD_RegenTqLimitEn_flg /end REF_MEASUREMENT /end GROUP
/begin GROUP S1877_SR_Latch2 "SWC_FDC_type/run_SWC_FDC_RxTx_5ms_sys/APP/TQD/TorqueDemand/TorqueModule/DriverWhlTqDem/PedalMapWhlTq/SR_Latch2" /begin REF_MEASUREMENT VTQD_BrkRgnLatchEn_flg /end REF_MEASUREMENT /end GROUP
/begin GROUP S1877_SR_Latch3 "SWC_FDC_type/run_SWC_FDC_RxTx_5ms_sys/APP/TQD/TorqueDemand/TorqueModule/DriverWhlTqDem/PedalMapWhlTq/SR_Latch3" /begin REF_MEASUREMENT VTQD_ADASShutOff_flg /end REF_MEASUREMENT /end GROUP
/begin GROUP S1877_SR_Latch4 "SWC_FDC_type/run_SWC_FDC_RxTx_5ms_sys/APP/TQD/TorqueDemand/TorqueModule/DriverWhlTqDem/PedalMapWhlTq/SR_Latch4" /begin REF_MEASUREMENT VTQD_ACCCancelDet_flg /end REF_MEASUREMENT /end GROUP
/begin GROUP S1877_Triggered_Subsystem "SWC_FDC_type/run_SWC_FDC_RxTx_5ms_sys/APP/TQD/TorqueDemand/TorqueModule/DriverWhlTqDem/PedalMapWhlTq/Triggered Subsystem" /begin REF_MEASUREMENT VTQD_ACCCancelMemPosn_pct VTQD_ACCCancelMemTq_Nm /end REF_MEASUREMENT /end GROUP
/begin GROUP S1988_SR_Latch1 "SWC_FDC_type/run_SWC_FDC_RxTx_5ms_sys/APP/TQD/TorqueDemand/TorqueModule/OPD Hold/OPDHold Request /SR_Latch1" /begin REF_MEASUREMENT VTQD_OPDHoldSpdEnLamp_flg /end REF_MEASUREMENT /end GROUP
/begin GROUP S1988_Timer "SWC_FDC_type/run_SWC_FDC_RxTx_5ms_sys/APP/TQD/TorqueDemand/TorqueModule/OPD Hold/OPDHold Request /Timer" /begin REF_MEASUREMENT VTQD_APSReqTimer_s /end REF_MEASUREMENT /end GROUP
/begin GROUP S1989_SR_Latch "SWC_FDC_type/run_SWC_FDC_RxTx_5ms_sys/APP/TQD/TorqueDemand/TorqueModule/OPD Hold/Parking Requeest Backup/SR_Latch" /begin REF_MEASUREMENT VTQD_OPDHoldAllowPark_flg /end REF_MEASUREMENT /end GROUP
/begin GROUP S1990_DelayEnable "SWC_FDC_type/run_SWC_FDC_RxTx_5ms_sys/APP/TQD/TorqueDemand/TorqueModule/OPD Hold/Release Condition/DelayEnable" /begin REF_MEASUREMENT VTQD_OPDHoldEnRel_flg /end REF_MEASUREMENT /end GROUP
/begin GROUP S1990_SR_Latch "SWC_FDC_type/run_SWC_FDC_RxTx_5ms_sys/APP/TQD/TorqueDemand/TorqueModule/OPD Hold/Release Condition/SR_Latch" /begin REF_MEASUREMENT VTQD_OPDHoldEnRelLatch_flg /end REF_MEASUREMENT /end GROUP
/begin GROUP S1990_SR_Latch1 "SWC_FDC_type/run_SWC_FDC_RxTx_5ms_sys/APP/TQD/TorqueDemand/TorqueModule/OPD Hold/Release Condition/SR_Latch1" /begin REF_MEASUREMENT VTQD_OPDHoldRelReverse_flg /end REF_MEASUREMENT /end GROUP
/begin GROUP S1991_DelayEnable "SWC_FDC_type/run_SWC_FDC_RxTx_5ms_sys/APP/TQD/TorqueDemand/TorqueModule/OPD Hold/System Status/DelayEnable" /begin REF_MEASUREMENT VTQD_R2DEnOPDHold_flg /end REF_MEASUREMENT /end GROUP
/begin GROUP S1991_DelayEnable1 "SWC_FDC_type/run_SWC_FDC_RxTx_5ms_sys/APP/TQD/TorqueDemand/TorqueModule/OPD Hold/System Status/DelayEnable1" /begin REF_MEASUREMENT VTQD_SkipDisOPDHoldReset_flg /end REF_MEASUREMENT /end GROUP
/begin GROUP S1991_SR_Latch "SWC_FDC_type/run_SWC_FDC_RxTx_5ms_sys/APP/TQD/TorqueDemand/TorqueModule/OPD Hold/System Status/SR_Latch" /begin REF_MEASUREMENT VTQD_WhlSkipDisOPDHold_flg /end REF_MEASUREMENT /end GROUP
/begin GROUP S1991_SR_Latch3 "SWC_FDC_type/run_SWC_FDC_RxTx_5ms_sys/APP/TQD/TorqueDemand/TorqueModule/OPD Hold/System Status/SR_Latch3" /begin REF_MEASUREMENT VTQD_OPDHoldRgnOn2Off_flg /end REF_MEASUREMENT /end GROUP
/begin GROUP S1991_SR_Latch4 "SWC_FDC_type/run_SWC_FDC_RxTx_5ms_sys/APP/TQD/TorqueDemand/TorqueModule/OPD Hold/System Status/SR_Latch4" /begin REF_MEASUREMENT VTQD_OPDHoldR2D_flg /end REF_MEASUREMENT /end GROUP
/begin GROUP S2056_SR_Latch1 "SWC_FDC_type/run_SWC_FDC_RxTx_5ms_sys/APP/TQR/Determine Torque Request/TorqueArbitrament/TorqueSmooth/Front First order filter input tau map and determination/SR_Latch1" /begin REF_MEASUREMENT VTQR_FrDrModLatch_flg /end REF_MEASUREMENT /end GROUP
/begin GROUP S2056_VTQR_ECOFEDUTs_c "SWC_FDC_type/run_SWC_FDC_RxTx_5ms_sys/APP/TQR/Determine Torque Request/TorqueArbitrament/TorqueSmooth/Front First order filter input tau map and determination/VTQR_ECOFEDUTs_c"
 /begin SUB_GROUP S2074_Invalid S2074_LV1 S2074_LV2 S2074_LV3 S2074_LV4 S2074_LV5 S2074_OPD /end SUB_GROUP
/end GROUP
/begin GROUP S2056_VTQR_ESCAPEFEDUTs_c "SWC_FDC_type/run_SWC_FDC_RxTx_5ms_sys/APP/TQR/Determine Torque Request/TorqueArbitrament/TorqueSmooth/Front First order filter input tau map and determination/VTQR_ESCAPEFEDUTs_c" /begin REF_CHARACTERISTIC MTQR_ESCAPEFEDUTs_Z_c /end REF_CHARACTERISTIC /end GROUP
/begin GROUP S2056_VTQR_LHMFEDUTs_c "SWC_FDC_type/run_SWC_FDC_RxTx_5ms_sys/APP/TQR/Determine Torque Request/TorqueArbitrament/TorqueSmooth/Front First order filter input tau map and determination/VTQR_LHMFEDUTs_c" /begin REF_CHARACTERISTIC MTQR_LHMFEDUTs_Z_c /end REF_CHARACTERISTIC /end GROUP
/begin GROUP S2056_VTQR_NORMALFEDUTs_c "SWC_FDC_type/run_SWC_FDC_RxTx_5ms_sys/APP/TQR/Determine Torque Request/TorqueArbitrament/TorqueSmooth/Front First order filter input tau map and determination/VTQR_NORMALFEDUTs_c"
 /begin SUB_GROUP S2077_Invalid S2077_LV1 S2077_LV2 S2077_LV3 S2077_LV4 S2077_LV5 S2077_OPD /end SUB_GROUP
/end GROUP
/begin GROUP S2056_VTQR_SNOWFEDUTs_c "SWC_FDC_type/run_SWC_FDC_RxTx_5ms_sys/APP/TQR/Determine Torque Request/TorqueArbitrament/TorqueSmooth/Front First order filter input tau map and determination/VTQR_SNOWFEDUTs_c" /begin REF_CHARACTERISTIC MTQR_SNOWFEDUTs_Z_c /end REF_CHARACTERISTIC /end GROUP
/begin GROUP S2056_VTQR_SPORTFEDUTs_c "SWC_FDC_type/run_SWC_FDC_RxTx_5ms_sys/APP/TQR/Determine Torque Request/TorqueArbitrament/TorqueSmooth/Front First order filter input tau map and determination/VTQR_SPORTFEDUTs_c"
 /begin SUB_GROUP S2079_Invalid S2079_LV1 S2079_LV2 S2079_LV3 S2079_LV4 S2079_LV5 S2079_OPD /end SUB_GROUP
/end GROUP
/begin GROUP S2056_VTQR_TCSFEDUTs_c "SWC_FDC_type/run_SWC_FDC_RxTx_5ms_sys/APP/TQR/Determine Torque Request/TorqueArbitrament/TorqueSmooth/Front First order filter input tau map and determination/VTQR_TCSFEDUTs_c" /begin REF_CHARACTERISTIC MTQR_TCSFEDUTs_Z_c /end REF_CHARACTERISTIC /end GROUP
/begin GROUP S2057_EcoLow "SWC_FDC_type/run_SWC_FDC_RxTx_5ms_sys/APP/TQR/Determine Torque Request/TorqueArbitrament/TorqueSmooth/Front Torque zero point transfer boundary map/EcoLow" /begin REF_CHARACTERISTIC MTQR_FTqZeroTransLowBoundE_Y_Nm /end REF_CHARACTERISTIC /end GROUP
/begin GROUP S2057_EcoUP "SWC_FDC_type/run_SWC_FDC_RxTx_5ms_sys/APP/TQR/Determine Torque Request/TorqueArbitrament/TorqueSmooth/Front Torque zero point transfer boundary map/EcoUP" /begin REF_CHARACTERISTIC MTQR_FTqZeroTransUpBoundE_Y_Nm /end REF_CHARACTERISTIC /end GROUP
/begin GROUP S2057_NormalLow "SWC_FDC_type/run_SWC_FDC_RxTx_5ms_sys/APP/TQR/Determine Torque Request/TorqueArbitrament/TorqueSmooth/Front Torque zero point transfer boundary map/NormalLow" /begin REF_CHARACTERISTIC MTQR_FTqZeroTransLowBoundN_Y_Nm /end REF_CHARACTERISTIC /end GROUP
/begin GROUP S2057_NormalUP "SWC_FDC_type/run_SWC_FDC_RxTx_5ms_sys/APP/TQR/Determine Torque Request/TorqueArbitrament/TorqueSmooth/Front Torque zero point transfer boundary map/NormalUP" /begin REF_CHARACTERISTIC MTQR_FTqZeroTransUpBoundN_Y_Nm /end REF_CHARACTERISTIC /end GROUP
/begin GROUP S2057_SportLow "SWC_FDC_type/run_SWC_FDC_RxTx_5ms_sys/APP/TQR/Determine Torque Request/TorqueArbitrament/TorqueSmooth/Front Torque zero point transfer boundary map/SportLow" /begin REF_CHARACTERISTIC MTQR_FTqZeroTransLowBoundS_Y_Nm /end REF_CHARACTERISTIC /end GROUP
/begin GROUP S2057_SportUP "SWC_FDC_type/run_SWC_FDC_RxTx_5ms_sys/APP/TQR/Determine Torque Request/TorqueArbitrament/TorqueSmooth/Front Torque zero point transfer boundary map/SportUP" /begin REF_CHARACTERISTIC MTQR_FTqZeroTransUpBoundS_Y_Nm /end REF_CHARACTERISTIC /end GROUP
/begin GROUP S2059_SR_Latch "SWC_FDC_type/run_SWC_FDC_RxTx_5ms_sys/APP/TQR/Determine Torque Request/TorqueArbitrament/TorqueSmooth/Front torque ramp limtation and determination/SR_Latch" /begin REF_MEASUREMENT VTQR_FShaftSpdTqLimLow_flg /end REF_MEASUREMENT /end GROUP
/begin GROUP S2059_SR_Latch1 "SWC_FDC_type/run_SWC_FDC_RxTx_5ms_sys/APP/TQR/Determine Torque Request/TorqueArbitrament/TorqueSmooth/Front torque ramp limtation and determination/SR_Latch1" /begin REF_MEASUREMENT VTQR_FTimerTqLimLow_flg /end REF_MEASUREMENT /end GROUP
/begin GROUP S2059_Timer "SWC_FDC_type/run_SWC_FDC_RxTx_5ms_sys/APP/TQR/Determine Torque Request/TorqueArbitrament/TorqueSmooth/Front torque ramp limtation and determination/Timer" /begin REF_MEASUREMENT VTQR_FShaftSpdDevTime_s /end REF_MEASUREMENT /end GROUP
/begin GROUP S2061_Negative_Rate_limit_Determination "SWC_FDC_type/run_SWC_FDC_RxTx_5ms_sys/APP/TQR/Determine Torque Request/TorqueArbitrament/TorqueSmooth/Front wheel rate limit determination/Negative Rate limit Determination"
 /begin SUB_GROUP S2114_VTQR_FrNegRateLimitDecE_Nm S2114_VTQR_FrNegRateLimitDecN_Nm S2114_VTQR_FrNegRateLimitDecS_Nm S2114_VTQR_FrNegRateLimitIncE_Nm S2114_VTQR_FrNegRateLimitIncN_Nm S2114_VTQR_FrNegRateLimitIncS_Nm /end SUB_GROUP
/end GROUP
/begin GROUP S2061_Positive_Rate_limit_Determination "SWC_FDC_type/run_SWC_FDC_RxTx_5ms_sys/APP/TQR/Determine Torque Request/TorqueArbitrament/TorqueSmooth/Front wheel rate limit determination/Positive Rate limit Determination"
 /begin SUB_GROUP S2115_VTQR_FrPosRateLimitDecE_Nm S2115_VTQR_FrPosRateLimitDecN_Nm S2115_VTQR_FrPosRateLimitDecS_Nm S2115_VTQR_FrPosRateLimitIncE_Nm S2115_VTQR_FrPosRateLimitIncN_Nm S2115_VTQR_FrPosRateLimitIncS_Nm /end SUB_GROUP
/end GROUP
/begin GROUP S2061_VTQR_ECOFEDURateLimitDec_Nm "SWC_FDC_type/run_SWC_FDC_RxTx_5ms_sys/APP/TQR/Determine Torque Request/TorqueArbitrament/TorqueSmooth/Front wheel rate limit determination/VTQR_ECOFEDURateLimitDec_Nm"
 /begin SUB_GROUP S2118_Invalid S2118_LV1 S2118_LV2 S2118_LV3 S2118_LV4 S2118_LV5 S2118_OPD /end SUB_GROUP
/end GROUP
/begin GROUP S2061_VTQR_ECOFEDURateLimitInc_Nm "SWC_FDC_type/run_SWC_FDC_RxTx_5ms_sys/APP/TQR/Determine Torque Request/TorqueArbitrament/TorqueSmooth/Front wheel rate limit determination/VTQR_ECOFEDURateLimitInc_Nm"
 /begin SUB_GROUP S2119_Invalid S2119_LV1 S2119_LV2 S2119_LV3 S2119_LV4 S2119_LV5 S2119_OPD /end SUB_GROUP
 /begin REF_CHARACTERISTIC KTQR_EnEcoFrIncGain_enum MTQR_ECO2TqFrIncGain_Z_c MTQR_ECO3TqFrIncGain_Z_c MTQR_ECO4TqFrIncGain_Z_c MTQR_ECO5TqFrIncGain_Z_c MTQR_ECOOPDTqFrIncGain_Z_c MTQR_EcoTqFrIncGain_Z_c /end REF_CHARACTERISTIC
 /begin REF_MEASUREMENT VTQR_ECO2TqFrIncGain_c VTQR_ECO3TqFrIncGain_c VTQR_ECO4TqFrIncGain_c VTQR_ECO5TqFrIncGain_c VTQR_ECOOPDTqFrIncGain_c VTQR_EcoTqFrIncGain_c /end REF_MEASUREMENT
/end GROUP
/begin GROUP S2061_VTQR_ESCAPEFEDURateLimitDec_Nm "SWC_FDC_type/run_SWC_FDC_RxTx_5ms_sys/APP/TQR/Determine Torque Request/TorqueArbitrament/TorqueSmooth/Front wheel rate limit determination/VTQR_ESCAPEFEDURateLimitDec_Nm" /begin REF_CHARACTERISTIC MTQR_ESCAPEFEDUTqDecSR_Z_Nm /end REF_CHARACTERISTIC /end GROUP
/begin GROUP S2061_VTQR_ESCAPEFEDURateLimitInc_Nm "SWC_FDC_type/run_SWC_FDC_RxTx_5ms_sys/APP/TQR/Determine Torque Request/TorqueArbitrament/TorqueSmooth/Front wheel rate limit determination/VTQR_ESCAPEFEDURateLimitInc_Nm" /begin REF_CHARACTERISTIC MTQR_ESCAPEFEDUTqIncSR_Z_Nm /end REF_CHARACTERISTIC /end GROUP
/begin GROUP S2061_VTQR_LHMFEDURateLimitDec_Nm "SWC_FDC_type/run_SWC_FDC_RxTx_5ms_sys/APP/TQR/Determine Torque Request/TorqueArbitrament/TorqueSmooth/Front wheel rate limit determination/VTQR_LHMFEDURateLimitDec_Nm" /begin REF_CHARACTERISTIC MTQR_LHMFEDUTqDecSR_Z_Nm /end REF_CHARACTERISTIC /end GROUP
/begin GROUP S2061_VTQR_LHMFEDURateLimitInc_Nm "SWC_FDC_type/run_SWC_FDC_RxTx_5ms_sys/APP/TQR/Determine Torque Request/TorqueArbitrament/TorqueSmooth/Front wheel rate limit determination/VTQR_LHMFEDURateLimitInc_Nm" /begin REF_CHARACTERISTIC MTQR_LHMFEDUTqIncSR_Z_Nm /end REF_CHARACTERISTIC /end GROUP
/begin GROUP S2061_VTQR_NORMALFEDURateLimitDec_Nm "SWC_FDC_type/run_SWC_FDC_RxTx_5ms_sys/APP/TQR/Determine Torque Request/TorqueArbitrament/TorqueSmooth/Front wheel rate limit determination/VTQR_NORMALFEDURateLimitDec_Nm"
 /begin SUB_GROUP S2124_Invalid S2124_LV1 S2124_LV2 S2124_LV3 S2124_LV4 S2124_LV5 S2124_OPD /end SUB_GROUP
/end GROUP
/begin GROUP S2061_VTQR_NORMALFEDURateLimitInc_Nm "SWC_FDC_type/run_SWC_FDC_RxTx_5ms_sys/APP/TQR/Determine Torque Request/TorqueArbitrament/TorqueSmooth/Front wheel rate limit determination/VTQR_NORMALFEDURateLimitInc_Nm"
 /begin SUB_GROUP S2125_Invalid S2125_LV1 S2125_LV2 S2125_LV3 S2125_LV4 S2125_LV5 S2125_OPD /end SUB_GROUP
 /begin REF_CHARACTERISTIC KTQR_EnNormalFrIncGain_enum MTQR_NL2TqFrIncGain_Z_c MTQR_NL3TqFrIncGain_Z_c MTQR_NL4TqFrIncGain_Z_c MTQR_NL5TqFrIncGain_Z_c MTQR_NLOPDTqFrIncGain_Z_c MTQR_NormalTqFrIncGain_Z_c /end REF_CHARACTERISTIC
 /begin REF_MEASUREMENT VTQR_NL2TqFrIncGain_c VTQR_NL3TqFrIncGain_c VTQR_NL4TqFrIncGain_c VTQR_NL5TqFrIncGain_c VTQR_NLOPDTqFrIncGain_c VTQR_NormalTqFrIncGain_c /end REF_MEASUREMENT
/end GROUP
/begin GROUP S2061_VTQR_SNOWFEDURateLimitDec_Nm "SWC_FDC_type/run_SWC_FDC_RxTx_5ms_sys/APP/TQR/Determine Torque Request/TorqueArbitrament/TorqueSmooth/Front wheel rate limit determination/VTQR_SNOWFEDURateLimitDec_Nm" /begin REF_CHARACTERISTIC MTQR_SNOWFEDUTqDecSR_Z_Nm /end REF_CHARACTERISTIC /end GROUP
/begin GROUP S2061_VTQR_SNOWFEDURateLimitInc_Nm "SWC_FDC_type/run_SWC_FDC_RxTx_5ms_sys/APP/TQR/Determine Torque Request/TorqueArbitrament/TorqueSmooth/Front wheel rate limit determination/VTQR_SNOWFEDURateLimitInc_Nm" /begin REF_CHARACTERISTIC MTQR_SNOWFEDUTqIncSR_Z_Nm MTQR_SnowMTqFrIncGain_Z_c /end REF_CHARACTERISTIC /begin REF_MEASUREMENT VTQR_SnowMTqFrIncGain_c /end REF_MEASUREMENT /end GROUP
/begin GROUP S2061_VTQR_SPORTFEDURateLimitDec_Nm "SWC_FDC_type/run_SWC_FDC_RxTx_5ms_sys/APP/TQR/Determine Torque Request/TorqueArbitrament/TorqueSmooth/Front wheel rate limit determination/VTQR_SPORTFEDURateLimitDec_Nm"
 /begin SUB_GROUP S2128_Invalid S2128_LV1 S2128_LV2 S2128_LV3 S2128_LV4 S2128_LV5 S2128_OPD /end SUB_GROUP
/end GROUP
/begin GROUP S2061_VTQR_SPORTFEDURateLimitInc_Nm "SWC_FDC_type/run_SWC_FDC_RxTx_5ms_sys/APP/TQR/Determine Torque Request/TorqueArbitrament/TorqueSmooth/Front wheel rate limit determination/VTQR_SPORTFEDURateLimitInc_Nm"
 /begin SUB_GROUP S2129_Invalid S2129_LV1 S2129_LV2 S2129_LV3 S2129_LV4 S2129_LV5 S2129_OPD /end SUB_GROUP
 /begin REF_CHARACTERISTIC KTQR_EnSportFrIncGain_enum MTQR_Sport2TqFrIncGain_Z_c MTQR_Sport3TqFrIncGain_Z_c MTQR_Sport4TqFrIncGain_Z_c MTQR_Sport5TqFrIncGain_Z_c MTQR_SportOPDTqFrIncGain_Z_c MTQR_SportTqFrIncGain_Z_c /end REF_CHARACTERISTIC
 /begin REF_MEASUREMENT VTQR_Sport2TqFrIncGain_c VTQR_Sport3TqFrIncGain_c VTQR_Sport4TqFrIncGain_c VTQR_Sport5TqFrIncGain_c VTQR_SportOPDTqFrIncGain_c VTQR_SportTqFrIncGain_c /end REF_MEASUREMENT
/end GROUP
/begin GROUP S2061_VTQR_TCSFEDURateLimitDec_Nm "SWC_FDC_type/run_SWC_FDC_RxTx_5ms_sys/APP/TQR/Determine Torque Request/TorqueArbitrament/TorqueSmooth/Front wheel rate limit determination/VTQR_TCSFEDURateLimitDec_Nm" /begin REF_CHARACTERISTIC MTQR_TCSFEDUTqDecSR_Z_Nm /end REF_CHARACTERISTIC /end GROUP
/begin GROUP S2061_VTQR_TCSFEDURateLimitInc_Nm "SWC_FDC_type/run_SWC_FDC_RxTx_5ms_sys/APP/TQR/Determine Torque Request/TorqueArbitrament/TorqueSmooth/Front wheel rate limit determination/VTQR_TCSFEDURateLimitInc_Nm" /begin REF_CHARACTERISTIC MTQR_TCSFEDUTqIncSR_Z_Nm /end REF_CHARACTERISTIC /end GROUP
/begin GROUP S2066_SR_Latch1 "SWC_FDC_type/run_SWC_FDC_RxTx_5ms_sys/APP/TQR/Determine Torque Request/TorqueArbitrament/TorqueSmooth/Rear First order filter input tau map and determination/SR_Latch1" /begin REF_MEASUREMENT VTQR_RrDrModLatch_flg /end REF_MEASUREMENT /end GROUP
/begin GROUP S2066_VTQR_ECOREDUTs_c "SWC_FDC_type/run_SWC_FDC_RxTx_5ms_sys/APP/TQR/Determine Torque Request/TorqueArbitrament/TorqueSmooth/Rear First order filter input tau map and determination/VTQR_ECOREDUTs_c"
 /begin SUB_GROUP S2188_Invalid S2188_LV1 S2188_LV2 S2188_LV3 S2188_LV4 S2188_LV5 S2188_OPD /end SUB_GROUP
/end GROUP
/begin GROUP S2066_VTQR_ESCAPEREDUTs_c "SWC_FDC_type/run_SWC_FDC_RxTx_5ms_sys/APP/TQR/Determine Torque Request/TorqueArbitrament/TorqueSmooth/Rear First order filter input tau map and determination/VTQR_ESCAPEREDUTs_c" /begin REF_CHARACTERISTIC MTQR_ESCAPEREDUTs_Z_c /end REF_CHARACTERISTIC /end GROUP
/begin GROUP S2066_VTQR_LHMREDUTs_c "SWC_FDC_type/run_SWC_FDC_RxTx_5ms_sys/APP/TQR/Determine Torque Request/TorqueArbitrament/TorqueSmooth/Rear First order filter input tau map and determination/VTQR_LHMREDUTs_c" /begin REF_CHARACTERISTIC MTQR_LHMREDUTs_Z_c /end REF_CHARACTERISTIC /end GROUP
/begin GROUP S2066_VTQR_NORMALREDUTs_c "SWC_FDC_type/run_SWC_FDC_RxTx_5ms_sys/APP/TQR/Determine Torque Request/TorqueArbitrament/TorqueSmooth/Rear First order filter input tau map and determination/VTQR_NORMALREDUTs_c"
 /begin SUB_GROUP S2191_Invalid S2191_LV1 S2191_LV2 S2191_LV3 S2191_LV4 S2191_LV5 S2191_OPD /end SUB_GROUP
/end GROUP
/begin GROUP S2066_VTQR_SNOWREDUTs_c "SWC_FDC_type/run_SWC_FDC_RxTx_5ms_sys/APP/TQR/Determine Torque Request/TorqueArbitrament/TorqueSmooth/Rear First order filter input tau map and determination/VTQR_SNOWREDUTs_c" /begin REF_CHARACTERISTIC MTQR_SNOWREDUTs_Z_c /end REF_CHARACTERISTIC /end GROUP
/begin GROUP S2066_VTQR_SPORTREDUTs_c "SWC_FDC_type/run_SWC_FDC_RxTx_5ms_sys/APP/TQR/Determine Torque Request/TorqueArbitrament/TorqueSmooth/Rear First order filter input tau map and determination/VTQR_SPORTREDUTs_c"
 /begin SUB_GROUP S2193_Invalid S2193_LV1 S2193_LV2 S2193_LV3 S2193_LV4 S2193_LV5 S2193_OPD /end SUB_GROUP
/end GROUP
/begin GROUP S2066_VTQR_TCSREDUTs_c "SWC_FDC_type/run_SWC_FDC_RxTx_5ms_sys/APP/TQR/Determine Torque Request/TorqueArbitrament/TorqueSmooth/Rear First order filter input tau map and determination/VTQR_TCSREDUTs_c" /begin REF_CHARACTERISTIC MTQR_TCSREDUTs_Z_c /end REF_CHARACTERISTIC /end GROUP
/begin GROUP S2067_EcoLow "SWC_FDC_type/run_SWC_FDC_RxTx_5ms_sys/APP/TQR/Determine Torque Request/TorqueArbitrament/TorqueSmooth/Rear Torque zero point transfer boundary map/EcoLow" /begin REF_CHARACTERISTIC MTQR_RTqZeroTransLowBoundE_Y_Nm /end REF_CHARACTERISTIC /end GROUP
/begin GROUP S2067_EcoUP "SWC_FDC_type/run_SWC_FDC_RxTx_5ms_sys/APP/TQR/Determine Torque Request/TorqueArbitrament/TorqueSmooth/Rear Torque zero point transfer boundary map/EcoUP" /begin REF_CHARACTERISTIC MTQR_RTqZeroTransUpBoundE_Y_Nm /end REF_CHARACTERISTIC /end GROUP
/begin GROUP S2067_NormalLow "SWC_FDC_type/run_SWC_FDC_RxTx_5ms_sys/APP/TQR/Determine Torque Request/TorqueArbitrament/TorqueSmooth/Rear Torque zero point transfer boundary map/NormalLow" /begin REF_CHARACTERISTIC MTQR_RTqZeroTransLowBoundN_Y_Nm /end REF_CHARACTERISTIC /end GROUP
/begin GROUP S2067_NormalUP "SWC_FDC_type/run_SWC_FDC_RxTx_5ms_sys/APP/TQR/Determine Torque Request/TorqueArbitrament/TorqueSmooth/Rear Torque zero point transfer boundary map/NormalUP" /begin REF_CHARACTERISTIC MTQR_RTqZeroTransUpBoundN_Y_Nm /end REF_CHARACTERISTIC /end GROUP
/begin GROUP S2067_SportLow "SWC_FDC_type/run_SWC_FDC_RxTx_5ms_sys/APP/TQR/Determine Torque Request/TorqueArbitrament/TorqueSmooth/Rear Torque zero point transfer boundary map/SportLow" /begin REF_CHARACTERISTIC MTQR_RTqZeroTransLowBoundS_Y_Nm /end REF_CHARACTERISTIC /end GROUP
/begin GROUP S2067_SportUP "SWC_FDC_type/run_SWC_FDC_RxTx_5ms_sys/APP/TQR/Determine Torque Request/TorqueArbitrament/TorqueSmooth/Rear Torque zero point transfer boundary map/SportUP" /begin REF_CHARACTERISTIC MTQR_RTqZeroTransUpBoundS_Y_Nm /end REF_CHARACTERISTIC /end GROUP
/begin GROUP S2069_SR_Latch "SWC_FDC_type/run_SWC_FDC_RxTx_5ms_sys/APP/TQR/Determine Torque Request/TorqueArbitrament/TorqueSmooth/Rear torque ramp limtation and determination/SR_Latch" /begin REF_MEASUREMENT VTQR_RShaftSpdTqLimLow_flg /end REF_MEASUREMENT /end GROUP
/begin GROUP S2069_SR_Latch1 "SWC_FDC_type/run_SWC_FDC_RxTx_5ms_sys/APP/TQR/Determine Torque Request/TorqueArbitrament/TorqueSmooth/Rear torque ramp limtation and determination/SR_Latch1" /begin REF_MEASUREMENT VTQR_RTimerTqLimLow_flg /end REF_MEASUREMENT /end GROUP
/begin GROUP S2069_Timer "SWC_FDC_type/run_SWC_FDC_RxTx_5ms_sys/APP/TQR/Determine Torque Request/TorqueArbitrament/TorqueSmooth/Rear torque ramp limtation and determination/Timer" /begin REF_MEASUREMENT VTQR_RShaftSpdDevTime_s /end REF_MEASUREMENT /end GROUP
/begin GROUP S2071_Negative_Rate_limit_Determination "SWC_FDC_type/run_SWC_FDC_RxTx_5ms_sys/APP/TQR/Determine Torque Request/TorqueArbitrament/TorqueSmooth/Rear wheel rate limit determination1/Negative Rate limit Determination"
 /begin SUB_GROUP S2229_VTQR_RrNegRateLimitDecE_Nm S2229_VTQR_RrNegRateLimitDecN_Nm S2229_VTQR_RrNegRateLimitDecS_Nm S2229_VTQR_RrNegRateLimitIncE_Nm S2229_VTQR_RrNegRateLimitIncN_Nm S2229_VTQR_RrNegRateLimitIncS_Nm /end SUB_GROUP
/end GROUP
/begin GROUP S2071_Positive_Rate_limit_Determination "SWC_FDC_type/run_SWC_FDC_RxTx_5ms_sys/APP/TQR/Determine Torque Request/TorqueArbitrament/TorqueSmooth/Rear wheel rate limit determination1/Positive Rate limit Determination"
 /begin SUB_GROUP S2230_VTQR_RrPosRateLimitDecE_Nm S2230_VTQR_RrPosRateLimitDecN_Nm S2230_VTQR_RrPosRateLimitDecS_Nm S2230_VTQR_RrPosRateLimitIncE_Nm S2230_VTQR_RrPosRateLimitIncN_Nm S2230_VTQR_RrPosRateLimitIncS_Nm /end SUB_GROUP
/end GROUP
/begin GROUP S2071_VTQR_ECOREDURateLimitDec_Nm "SWC_FDC_type/run_SWC_FDC_RxTx_5ms_sys/APP/TQR/Determine Torque Request/TorqueArbitrament/TorqueSmooth/Rear wheel rate limit determination1/VTQR_ECOREDURateLimitDec_Nm"
 /begin SUB_GROUP S2234_Invalid S2234_LV1 S2234_LV2 S2234_LV3 S2234_LV4 S2234_LV5 S2234_OPD /end SUB_GROUP
/end GROUP
/begin GROUP S2071_VTQR_ECOREDURateLimitInc_Nm "SWC_FDC_type/run_SWC_FDC_RxTx_5ms_sys/APP/TQR/Determine Torque Request/TorqueArbitrament/TorqueSmooth/Rear wheel rate limit determination1/VTQR_ECOREDURateLimitInc_Nm"
 /begin SUB_GROUP S2235_Invalid S2235_LV1 S2235_LV2 S2235_LV3 S2235_LV4 S2235_LV5 S2235_OPD /end SUB_GROUP
 /begin REF_CHARACTERISTIC KTQR_EnEcoRrIncGain_enum MTQR_ECO2TqRrIncGain_Z_c MTQR_ECO3TqRrIncGain_Z_c MTQR_ECO4TqRrIncGain_Z_c MTQR_ECO5TqRrIncGain_Z_c MTQR_ECOOPDTqRrIncGain_Z_c MTQR_EcoTqRrIncGain_Z_c /end REF_CHARACTERISTIC
 /begin REF_MEASUREMENT VTQR_ECO2TqRrIncGain_c VTQR_ECO3TqRrIncGain_c VTQR_ECO4TqRrIncGain_c VTQR_ECO5TqRrIncGain_c VTQR_ECOOPDTqRrIncGain_c VTQR_EcoTqRrIncGain_c /end REF_MEASUREMENT
/end GROUP
/begin GROUP S2071_VTQR_ESCAPEREDURateLimitDec_Nm "SWC_FDC_type/run_SWC_FDC_RxTx_5ms_sys/APP/TQR/Determine Torque Request/TorqueArbitrament/TorqueSmooth/Rear wheel rate limit determination1/VTQR_ESCAPEREDURateLimitDec_Nm" /begin REF_CHARACTERISTIC MTQR_ESCAPEREDUTqDecSR_Z_Nm /end REF_CHARACTERISTIC /end GROUP
/begin GROUP S2071_VTQR_ESCAPEREDURateLimitInc_Nm "SWC_FDC_type/run_SWC_FDC_RxTx_5ms_sys/APP/TQR/Determine Torque Request/TorqueArbitrament/TorqueSmooth/Rear wheel rate limit determination1/VTQR_ESCAPEREDURateLimitInc_Nm" /begin REF_CHARACTERISTIC MTQR_ESCAPEREDUTqIncSR_Z_Nm /end REF_CHARACTERISTIC /end GROUP
/begin GROUP S2071_VTQR_LHMREDURateLimitDec_Nm "SWC_FDC_type/run_SWC_FDC_RxTx_5ms_sys/APP/TQR/Determine Torque Request/TorqueArbitrament/TorqueSmooth/Rear wheel rate limit determination1/VTQR_LHMREDURateLimitDec_Nm" /begin REF_CHARACTERISTIC MTQR_LHMREDUTqDecSR_Z_Nm /end REF_CHARACTERISTIC /end GROUP
/begin GROUP S2071_VTQR_LHMREDURateLimitInc_Nm "SWC_FDC_type/run_SWC_FDC_RxTx_5ms_sys/APP/TQR/Determine Torque Request/TorqueArbitrament/TorqueSmooth/Rear wheel rate limit determination1/VTQR_LHMREDURateLimitInc_Nm" /begin REF_CHARACTERISTIC MTQR_LHMREDUTqIncSR_Z_Nm /end REF_CHARACTERISTIC /end GROUP
/begin GROUP S2071_VTQR_NORMALREDURateLimitDec_Nm "SWC_FDC_type/run_SWC_FDC_RxTx_5ms_sys/APP/TQR/Determine Torque Request/TorqueArbitrament/TorqueSmooth/Rear wheel rate limit determination1/VTQR_NORMALREDURateLimitDec_Nm"
 /begin SUB_GROUP S2240_Invalid S2240_LV1 S2240_LV2 S2240_LV3 S2240_LV4 S2240_LV5 S2240_OPD /end SUB_GROUP
/end GROUP
/begin GROUP S2071_VTQR_NORMALREDURateLimitInc_Nm "SWC_FDC_type/run_SWC_FDC_RxTx_5ms_sys/APP/TQR/Determine Torque Request/TorqueArbitrament/TorqueSmooth/Rear wheel rate limit determination1/VTQR_NORMALREDURateLimitInc_Nm"
 /begin SUB_GROUP S2241_Invalid S2241_LV1 S2241_LV2 S2241_LV3 S2241_LV4 S2241_LV5 S2241_OPD /end SUB_GROUP
 /begin REF_CHARACTERISTIC KTQR_EnNormalRrIncGain_enum MTQR_NL2TqRrIncGain_Z_c MTQR_NL3TqRrIncGain_Z_c MTQR_NL4TqRrIncGain_Z_c MTQR_NL5TqRrIncGain_Z_c MTQR_NLOPDTqRrIncGain_Z_c MTQR_NormalTqRrIncGain_Z_c /end REF_CHARACTERISTIC
 /begin REF_MEASUREMENT VTQR_NL2TqRrIncGain_c VTQR_NL3TqRrIncGain_c VTQR_NL4TqRrIncGain_c VTQR_NL5TqRrIncGain_c VTQR_NLOPDTqRrIncGain_c VTQR_NormalTqRrIncGain_c /end REF_MEASUREMENT
/end GROUP
/begin GROUP S2071_VTQR_SNOWREDURateLimitDec_Nm "SWC_FDC_type/run_SWC_FDC_RxTx_5ms_sys/APP/TQR/Determine Torque Request/TorqueArbitrament/TorqueSmooth/Rear wheel rate limit determination1/VTQR_SNOWREDURateLimitDec_Nm" /begin REF_CHARACTERISTIC MTQR_SNOWREDUTqDecSR_Z_Nm /end REF_CHARACTERISTIC /end GROUP
/begin GROUP S2071_VTQR_SNOWREDURateLimitInc_Nm "SWC_FDC_type/run_SWC_FDC_RxTx_5ms_sys/APP/TQR/Determine Torque Request/TorqueArbitrament/TorqueSmooth/Rear wheel rate limit determination1/VTQR_SNOWREDURateLimitInc_Nm" /begin REF_CHARACTERISTIC MTQR_SNOWREDUTqIncSR_Z_Nm MTQR_SnowMTqRrIncGain_Z_c /end REF_CHARACTERISTIC /begin REF_MEASUREMENT VTQR_SnowMTqRrIncGain_c /end REF_MEASUREMENT /end GROUP
/begin GROUP S2071_VTQR_SPORTREDURateLimitDec_Nm "SWC_FDC_type/run_SWC_FDC_RxTx_5ms_sys/APP/TQR/Determine Torque Request/TorqueArbitrament/TorqueSmooth/Rear wheel rate limit determination1/VTQR_SPORTREDURateLimitDec_Nm"
 /begin SUB_GROUP S2244_Invalid S2244_LV1 S2244_LV2 S2244_LV3 S2244_LV4 S2244_LV5 S2244_OPD /end SUB_GROUP
/end GROUP
/begin GROUP S2071_VTQR_SPORTREDURateLimitInc_Nm "SWC_FDC_type/run_SWC_FDC_RxTx_5ms_sys/APP/TQR/Determine Torque Request/TorqueArbitrament/TorqueSmooth/Rear wheel rate limit determination1/VTQR_SPORTREDURateLimitInc_Nm"
 /begin SUB_GROUP S2245_Invalid S2245_LV1 S2245_LV2 S2245_LV3 S2245_LV4 S2245_LV5 S2245_OPD /end SUB_GROUP
 /begin REF_CHARACTERISTIC KTQR_EnSportRrIncGain_enum MTQR_Sport2TqRrIncGain_Z_c MTQR_Sport3TqRrIncGain_Z_c MTQR_Sport4TqRrIncGain_Z_c MTQR_Sport5TqRrIncGain_Z_c MTQR_SportOPDTqRrIncGain_Z_c MTQR_SportTqRrIncGain_Z_c /end REF_CHARACTERISTIC
 /begin REF_MEASUREMENT VTQR_Sport2TqRrIncGain_c VTQR_Sport3TqRrIncGain_c VTQR_Sport4TqRrIncGain_c VTQR_Sport5TqRrIncGain_c VTQR_SportOPDTqRrIncGain_c VTQR_SportTqRrIncGain_c /end REF_MEASUREMENT
/end GROUP
/begin GROUP S2071_VTQR_TCSREDURateLimitDec_Nm "SWC_FDC_type/run_SWC_FDC_RxTx_5ms_sys/APP/TQR/Determine Torque Request/TorqueArbitrament/TorqueSmooth/Rear wheel rate limit determination1/VTQR_TCSREDURateLimitDec_Nm" /begin REF_CHARACTERISTIC MTQR_TCSREDUTqDecSR_Z_Nm /end REF_CHARACTERISTIC /end GROUP
/begin GROUP S2071_VTQR_TCSREDURateLimitInc_Nm "SWC_FDC_type/run_SWC_FDC_RxTx_5ms_sys/APP/TQR/Determine Torque Request/TorqueArbitrament/TorqueSmooth/Rear wheel rate limit determination1/VTQR_TCSREDURateLimitInc_Nm" /begin REF_CHARACTERISTIC MTQR_TCSREDUTqIncSR_Z_Nm /end REF_CHARACTERISTIC /end GROUP
/begin GROUP S2631_FirstOrderFilter "SWC_FDC_type/run_SWC_FDC_RxTx_5ms_sys/APP/VMC/VMC/Slide Rate  Calculation/4Wheel Calculation/LF Wheel/FirstOrderFilter" /begin REF_MEASUREMENT VVMC_LFWhlCalAcc_Gps /end REF_MEASUREMENT /end GROUP
/begin GROUP S2631_SR_Latch "SWC_FDC_type/run_SWC_FDC_RxTx_5ms_sys/APP/VMC/VMC/Slide Rate  Calculation/4Wheel Calculation/LF Wheel/SR_Latch" /begin REF_MEASUREMENT VVMC_LFWhlSkid_flg /end REF_MEASUREMENT /end GROUP
/begin GROUP S2632_FirstOrderFilter2 "SWC_FDC_type/run_SWC_FDC_RxTx_5ms_sys/APP/VMC/VMC/Slide Rate  Calculation/4Wheel Calculation/LR Wheel/FirstOrderFilter2" /begin REF_MEASUREMENT VVMC_LRWhlCalAcc_Gps /end REF_MEASUREMENT /end GROUP
/begin GROUP S2632_SR_Latch2 "SWC_FDC_type/run_SWC_FDC_RxTx_5ms_sys/APP/VMC/VMC/Slide Rate  Calculation/4Wheel Calculation/LR Wheel/SR_Latch2" /begin REF_MEASUREMENT VVMC_LRWhlSkid_flg /end REF_MEASUREMENT /end GROUP
/begin GROUP S2633_FirstOrderFilter1 "SWC_FDC_type/run_SWC_FDC_RxTx_5ms_sys/APP/VMC/VMC/Slide Rate  Calculation/4Wheel Calculation/RF Wheel/FirstOrderFilter1" /begin REF_MEASUREMENT VVMC_RFWhlCalAcc_Gps /end REF_MEASUREMENT /end GROUP
/begin GROUP S2633_SR_Latch1 "SWC_FDC_type/run_SWC_FDC_RxTx_5ms_sys/APP/VMC/VMC/Slide Rate  Calculation/4Wheel Calculation/RF Wheel/SR_Latch1" /begin REF_MEASUREMENT VVMC_RFWhlSkid_flg /end REF_MEASUREMENT /end GROUP
/begin GROUP S2634_FirstOrderFilter3 "SWC_FDC_type/run_SWC_FDC_RxTx_5ms_sys/APP/VMC/VMC/Slide Rate  Calculation/4Wheel Calculation/RR Wheel/FirstOrderFilter3" /begin REF_MEASUREMENT VVMC_RRWhlCalAcc_Gps /end REF_MEASUREMENT /end GROUP
/begin GROUP S2634_SR_Latch3 "SWC_FDC_type/run_SWC_FDC_RxTx_5ms_sys/APP/VMC/VMC/Slide Rate  Calculation/4Wheel Calculation/RR Wheel/SR_Latch3" /begin REF_MEASUREMENT VVMC_RRWhlSkid_flg /end REF_MEASUREMENT /end GROUP
/begin GROUP S1098_Acceptancerate "SWC_FDC_type/run_SWC_FDC_RxTx_5ms_sys/APP/TPM/TPMS/TPMS/Learn/AutoLocation/IDIdentify/Acceptancerate"
 /begin REF_MEASUREMENT VTPM_ID1messageALTU_raw8 VTPM_ID2messageALTU_raw8 VTPM_ID3messageALTU_raw8 VTPM_ID4messageALTU_raw8 VTPM_S1WheelDebugALTU_pct VTPM_S2WheelDebugALTU_pct VTPM_S3WheelDebugALTU_pct VTPM_S4WheelDebugALTU_pct /end REF_MEASUREMENT
/end GROUP
/begin GROUP S1098_Subsystem1 "SWC_FDC_type/run_SWC_FDC_RxTx_5ms_sys/APP/TPM/TPMS/TPMS/Learn/AutoLocation/IDIdentify/Subsystem1"
 /begin SUB_GROUP S1118_Enabled_Subsystem1 S1118_Enabled_Subsystem2 S1118_Enabled_Subsystem3 S1118_Enabled_Subsystem5 /end SUB_GROUP
 /begin REF_MEASUREMENT VTPM_GS2_cnt /end REF_MEASUREMENT
/end GROUP
/begin GROUP S1098_Subsystem2 "SWC_FDC_type/run_SWC_FDC_RxTx_5ms_sys/APP/TPM/TPMS/TPMS/Learn/AutoLocation/IDIdentify/Subsystem2"
 /begin SUB_GROUP S1119_Enabled_Subsystem1 S1119_Enabled_Subsystem2 S1119_Enabled_Subsystem3 S1119_Enabled_Subsystem5 /end SUB_GROUP
 /begin REF_MEASUREMENT VTPM_GS3_cnt /end REF_MEASUREMENT
/end GROUP
/begin GROUP S1098_Subsystem3 "SWC_FDC_type/run_SWC_FDC_RxTx_5ms_sys/APP/TPM/TPMS/TPMS/Learn/AutoLocation/IDIdentify/Subsystem3"
 /begin SUB_GROUP S1120_Enabled_Subsystem1 S1120_Enabled_Subsystem2 S1120_Enabled_Subsystem3 S1120_Enabled_Subsystem5 /end SUB_GROUP
 /begin REF_MEASUREMENT VTPM_GS4_cnt /end REF_MEASUREMENT
/end GROUP
/begin GROUP S1098_Subsystem7 "SWC_FDC_type/run_SWC_FDC_RxTx_5ms_sys/APP/TPM/TPMS/TPMS/Learn/AutoLocation/IDIdentify/Subsystem7"
 /begin SUB_GROUP S1121_Enabled_Subsystem1 S1121_Enabled_Subsystem2 S1121_Enabled_Subsystem3 S1121_Enabled_Subsystem5 /end SUB_GROUP
 /begin REF_MEASUREMENT VTPM_GS1_cnt /end REF_MEASUREMENT
/end GROUP
/begin GROUP S1101_Subsystem "SWC_FDC_type/run_SWC_FDC_RxTx_5ms_sys/APP/TPM/TPMS/TPMS/Learn/AutoLocation/Subsystem1/Subsystem"
 /begin REF_MEASUREMENT VTPM_MLFID_raw VTPM_MLRID_raw VTPM_MRFID_raw VTPM_MRRID_raw VTPM_MSensor1ID_raw VTPM_MSensor2ID_raw VTPM_MSensor3ID_raw VTPM_MSensor4ID_raw VTPM_ManuTPMSStorge_flg /end REF_MEASUREMENT
/end GROUP
/begin GROUP S1102_Subsystem "SWC_FDC_type/run_SWC_FDC_RxTx_5ms_sys/APP/TPM/TPMS/TPMS/Learn/AutoLocation/WheelPosition/Subsystem" /begin REF_CHARACTERISTIC KTPM_Delay_raw8 /end REF_CHARACTERISTIC /begin REF_MEASUREMENT VTPM_LFWP_raw16 /end REF_MEASUREMENT /end GROUP
/begin GROUP S1102_Subsystem1 "SWC_FDC_type/run_SWC_FDC_RxTx_5ms_sys/APP/TPM/TPMS/TPMS/Learn/AutoLocation/WheelPosition/Subsystem1" /begin REF_CHARACTERISTIC KTPM_Delay_raw8 /end REF_CHARACTERISTIC /begin REF_MEASUREMENT VTPM_RFWP_raw16 /end REF_MEASUREMENT /end GROUP
/begin GROUP S1102_Subsystem2 "SWC_FDC_type/run_SWC_FDC_RxTx_5ms_sys/APP/TPM/TPMS/TPMS/Learn/AutoLocation/WheelPosition/Subsystem2" /begin REF_CHARACTERISTIC KTPM_Delay_raw8 /end REF_CHARACTERISTIC /begin REF_MEASUREMENT VTPM_LRWP_raw16 /end REF_MEASUREMENT /end GROUP
/begin GROUP S1102_Subsystem3 "SWC_FDC_type/run_SWC_FDC_RxTx_5ms_sys/APP/TPM/TPMS/TPMS/Learn/AutoLocation/WheelPosition/Subsystem3" /begin REF_CHARACTERISTIC KTPM_Delay_raw8 /end REF_CHARACTERISTIC /begin REF_MEASUREMENT VTPM_RRWP_raw16 /end REF_MEASUREMENT /end GROUP
/begin GROUP S1418_DiagnosisOff_Mode "SWC_FDC_type/run_SWC_FDC_RxTx_5ms_sys/APP/TQD/TorqueDemand/Signal_convert/SWC2_Subsystem/Big Mike Combo/Combo Key Detection/DiagnosisOff Mode"
 /begin SUB_GROUP S1422_Key1 S1422_Key2 S1422_Key3 S1422_Key4 S1422_Key5 S1422_Key6 S1422_Key7 S1422_Key8 /end SUB_GROUP
 /begin REF_CHARACTERISTIC KTQD_ComboKeyDelay_s /end REF_CHARACTERISTIC
 /begin REF_MEASUREMENT VTQD_DiagnosisOffCMD_enum VTQD_DiagnosisOffMode_flg VTQD_DiagnosisOffPass_flg /end REF_MEASUREMENT
/end GROUP
/begin GROUP S1418_Engineering_Mode "SWC_FDC_type/run_SWC_FDC_RxTx_5ms_sys/APP/TQD/TorqueDemand/Signal_convert/SWC2_Subsystem/Big Mike Combo/Combo Key Detection/Engineering Mode"
 /begin SUB_GROUP S1423_Key1 S1423_Key2 S1423_Key3 S1423_Key4 S1423_Key5 S1423_Key6 S1423_Key7 S1423_Key8 /end SUB_GROUP
 /begin REF_CHARACTERISTIC KTQD_ComboKeyDelay_s /end REF_CHARACTERISTIC
 /begin REF_MEASUREMENT VTQD_EngineeringCMD_enum VTQD_EngineeringMode_flg VTQD_EngineeringPass_flg /end REF_MEASUREMENT
/end GROUP
/begin GROUP S1418_Exhibition_Mode "SWC_FDC_type/run_SWC_FDC_RxTx_5ms_sys/APP/TQD/TorqueDemand/Signal_convert/SWC2_Subsystem/Big Mike Combo/Combo Key Detection/Exhibition Mode"
 /begin SUB_GROUP S1424_Key1 S1424_Key2 S1424_Key3 S1424_Key4 S1424_Key5 S1424_Key6 S1424_Key7 S1424_Key8 /end SUB_GROUP
 /begin REF_CHARACTERISTIC KTQD_ComboKeyDelay_s /end REF_CHARACTERISTIC
 /begin REF_MEASUREMENT VTQD_ExhibitionCMD_enum VTQD_ExhibitionMode_flg VTQD_ExhibitionPass_flg /end REF_MEASUREMENT
/end GROUP
/begin GROUP S1418_Manufacture_Mode "SWC_FDC_type/run_SWC_FDC_RxTx_5ms_sys/APP/TQD/TorqueDemand/Signal_convert/SWC2_Subsystem/Big Mike Combo/Combo Key Detection/Manufacture Mode"
 /begin SUB_GROUP S1425_Key1 S1425_Key2 S1425_Key3 S1425_Key4 S1425_Key5 S1425_Key6 S1425_Key7 S1425_Key8 /end SUB_GROUP
 /begin REF_CHARACTERISTIC KTQD_ComboKeyDelay_s /end REF_CHARACTERISTIC
 /begin REF_MEASUREMENT VTQD_ManufactureCMD_enum VTQD_ManufactureMode_flg VTQD_ManufacturePass_flg /end REF_MEASUREMENT
/end GROUP
/begin GROUP S1418_Street_Fight_Mode "SWC_FDC_type/run_SWC_FDC_RxTx_5ms_sys/APP/TQD/TorqueDemand/Signal_convert/SWC2_Subsystem/Big Mike Combo/Combo Key Detection/Street Fight Mode"
 /begin SUB_GROUP S1426_Key1 S1426_Key2 S1426_Key3 S1426_Key4 S1426_Key5 S1426_Key6 S1426_Key7 S1426_Key8 /end SUB_GROUP
 /begin REF_CHARACTERISTIC KTQD_ComboKeyDelay_s /end REF_CHARACTERISTIC
 /begin REF_MEASUREMENT VTQD_StreetFightCMD_enum VTQD_StreetFightMode_flg VTQD_StreetFightPass_flg /end REF_MEASUREMENT
/end GROUP
/begin GROUP S1421_DelayEnable6 "SWC_FDC_type/run_SWC_FDC_RxTx_5ms_sys/APP/TQD/TorqueDemand/Signal_convert/SWC2_Subsystem/Big Mike Combo/Signal Status Detection/DelayEnable6" /begin REF_MEASUREMENT VTQD_SWCRegenDownLong_flg /end REF_MEASUREMENT /end GROUP
/begin GROUP S1421_DelayEnable7 "SWC_FDC_type/run_SWC_FDC_RxTx_5ms_sys/APP/TQD/TorqueDemand/Signal_convert/SWC2_Subsystem/Big Mike Combo/Signal Status Detection/DelayEnable7" /begin REF_MEASUREMENT VTQD_SWCRegenUpLong_flg /end REF_MEASUREMENT /end GROUP
/begin GROUP S1421_DelayEnable8 "SWC_FDC_type/run_SWC_FDC_RxTx_5ms_sys/APP/TQD/TorqueDemand/Signal_convert/SWC2_Subsystem/Big Mike Combo/Signal Status Detection/DelayEnable8" /begin REF_MEASUREMENT VTQD_SWCCANCELStaLong_flg /end REF_MEASUREMENT /end GROUP
/begin GROUP S1421_DelayEnable9 "SWC_FDC_type/run_SWC_FDC_RxTx_5ms_sys/APP/TQD/TorqueDemand/Signal_convert/SWC2_Subsystem/Big Mike Combo/Signal Status Detection/DelayEnable9" /begin REF_MEASUREMENT VTQD_SWCACCStaLong_flg /end REF_MEASUREMENT /end GROUP
/begin GROUP S1421_SR_Latch "SWC_FDC_type/run_SWC_FDC_RxTx_5ms_sys/APP/TQD/TorqueDemand/Signal_convert/SWC2_Subsystem/Big Mike Combo/Signal Status Detection/SR_Latch" /begin REF_MEASUREMENT VTQD_ComboKeyEnCMD_flg /end REF_MEASUREMENT /end GROUP
/begin GROUP S1421_Street_Fight_Switch_Off "SWC_FDC_type/run_SWC_FDC_RxTx_5ms_sys/APP/TQD/TorqueDemand/Signal_convert/SWC2_Subsystem/Big Mike Combo/Signal Status Detection/Street Fight Switch Off" /begin SUB_GROUP S1724_Timer /end SUB_GROUP /begin REF_CHARACTERISTIC KTQD_CANCELCountDetTime_s KTQD_CANCELUpCount_cnt /end REF_CHARACTERISTIC
 /begin REF_MEASUREMENT VTQD_CANCELCountDetFinish_flg VTQD_CANCELCountReset_flg VTQD_CANCELCount_cnt VTQD_StreetFightModeOff_flg /end REF_MEASUREMENT
/end GROUP
/begin GROUP S1926_ShiftD "SWC_FDC_type/run_SWC_FDC_RxTx_5ms_sys/APP/TQD/TorqueDemand/TorqueModule/DriverWhlTqDem/PedalMapWhlTq/NoLHM/ShiftD"
 /begin SUB_GROUP S1940_LUT_D_ECO S1940_LUT_D_EscapeMode S1940_LUT_D_Normal S1940_LUT_D_SnowMode S1940_LUT_D_Sport /end SUB_GROUP
 /begin REF_CHARACTERISTIC MTQD_RL1TqMapDComp_Z_Nm MTQD_RL2TqMapDComp_Z_Nm MTQD_RL3TqMapDComp_Z_Nm MTQD_RL4TqMapDComp_Z_Nm MTQD_RL5TqMapDComp_Z_Nm /end REF_CHARACTERISTIC
 /begin REF_MEASUREMENT VTQD_RL1TqMapDComp_Nm VTQD_RL2TqMapDComp_Nm VTQD_RL3TqMapDComp_Nm VTQD_RL4TqMapDComp_Nm VTQD_RL5TqMapDComp_Nm /end REF_MEASUREMENT
/end GROUP
/begin GROUP S1926_ShiftR "SWC_FDC_type/run_SWC_FDC_RxTx_5ms_sys/APP/TQD/TorqueDemand/TorqueModule/DriverWhlTqDem/PedalMapWhlTq/NoLHM/ShiftR" /begin REF_CHARACTERISTIC MTQD_NRMTqMapR_Z_Nm /end REF_CHARACTERISTIC /end GROUP
/begin GROUP S1927_Active_Determination "SWC_FDC_type/run_SWC_FDC_RxTx_5ms_sys/APP/TQD/TorqueDemand/TorqueModule/DriverWhlTqDem/PedalMapWhlTq/Pedal G-Control Mode/Active Determination" /begin SUB_GROUP S1976_DelayEnable3 /end SUB_GROUP
 /begin REF_CHARACTERISTIC KTQD_PedAccTqEn_flg_ovrdflg KTQD_PedAccTqEn_flg_ovrdval KTQD_PedGControlModeSW_flg KTQD_PedGControlTrigTime_s /end REF_CHARACTERISTIC
 /begin REF_MEASUREMENT VTQD_PedAccTqEn_flg VTQD_PedAccTqOperate_flg VTQD_PedGControlAllow_flg VTQD_PedGControlModeSW_flg /end REF_MEASUREMENT
/end GROUP
/begin GROUP S1940_LUT_D_Normal "SWC_FDC_type/run_SWC_FDC_RxTx_5ms_sys/APP/TQD/TorqueDemand/TorqueModule/DriverWhlTqDem/PedalMapWhlTq/NoLHM/ShiftD/LUT_D_Normal" /begin REF_CHARACTERISTIC MTQD_NL1TqMapD_Z_Nm /end REF_CHARACTERISTIC /end GROUP
/end MODULE
/end PROJECT
