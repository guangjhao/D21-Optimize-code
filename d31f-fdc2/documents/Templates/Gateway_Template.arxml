AUTOSAR XML (schema 4-3-0)
package /Gateway
  gateway Gateway_TargetECU: ecu=FUSION, i-signal-mapping{source-signal=ST_CS_BMS3, target-signal=ST_CS_BMS3}
