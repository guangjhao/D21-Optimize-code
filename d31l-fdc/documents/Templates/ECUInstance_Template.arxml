AUTOSAR XML (schema 4-3-0)
package /ECU
  ecu instance TargetECU: associated-com-i-pdu-group=FUSION_Can3_Tx, com-configuration-gw-time-base=0.005, com-configuration-rx-time-base=0.005, com-configuration-tx-time-base=0.005
    can communication controller ChannelName
    can communication connector CANCommunicationConnector: comm-controller=Can3
