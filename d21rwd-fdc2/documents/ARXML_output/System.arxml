[part 1 of 3: package /SysEnv_ARPkg]
AUTOSAR XML (schema 4-3-0)
package /SysEnv_ARPkg
  system System_FDC: category=SYSTEM_DESCRIPTION, ecu-extract-version=1.0.0, system-version=1.0.0
    168 x system mapping:
      SystemMapping
        sw-impl-mappings:
          23 x swc to impl mapping:
            BswMTest_ImplMapping: component-implementation=Impl_BswMTest_type, component=root_FDC.BswMTest
            SWC_CDD_ImplMapping: component-implementation=Impl_SWC_CDD_type, component=root_FDC.SWC_CDD
            SWC_CGW_ImplMapping: component-implementation=Impl_SWC_CGW_type, component=root_FDC.SWC_CGW
            SWC_DID_ImplMapping: component-implementation=Impl_SWC_DID_type, component=root_FDC.SWC_DID
            SWC_DKC_ImplMapping: component-implementation=Impl_SWC_DKC_type, component=root_FDC.SWC_DKC
            SWC_SCP_ImplMapping: component-implementation=Impl_SWC_SCP_type, component=root_FDC.SWC_SCP
            SWC_INP_ImplMapping: component-implementation=Impl_SWC_INP_type, component=root_FDC.SWC_INP
            SWC_HALIN_ImplMapping: component-implementation=Impl_SWC_HALIN_type, component=root_FDC.SWC_HALIN
            SWC_HALIN_CDD_ImplMapping: component-implementation=Impl_SWC_HALIN_CDD_type, component=root_FDC.SWC_HALIN_CDD
            SWC_OUTP_ImplMapping: component-implementation=Impl_SWC_OUTP_type, component=root_FDC.SWC_OUTP
            SWC_HALOUT_ImplMapping: component-implementation=Impl_SWC_HALOUT_type, component=root_FDC.SWC_HALOUT
            SWC_FDC_ImplMapping: component-implementation=Impl_SWC_FDC_type, component=root_FDC.SWC_FDC
            SWC_IMU_ImplMapping: component-implementation=Impl_SWC_IMU_type, component=root_FDC.SWC_IMU
            SWC_IOEXP_ImplMapping: component-implementation=Impl_SWC_IOEXP_type, component=root_FDC.SWC_IOEXP
            SWC_LOG_ImplMapping: component-implementation=Impl_SWC_LOG_type, component=root_FDC.SWC_LOG
            SWC_NVM_ImplMapping: component-implementation=Impl_SWC_NVM_type, component=root_FDC.SWC_NVM
            SWC_UART_ImplMapping: component-implementation=Impl_SWC_UART_type, component=root_FDC.SWC_UART
            SWC_UDS_ImplMapping: component-implementation=Impl_SWC_UDS_type, component=root_FDC.SWC_UDS
            SWC_VES_ImplMapping: component-implementation=Impl_SWC_VES_type, component=root_FDC.SWC_VES
            SWC_V2L_ImplMapping: component-implementation=Impl_SWC_V2L_type, component=root_FDC.SWC_V2L
            SWC_CARB_ImplMapping: component-implementation=Impl_SWC_CARB_type, component=root_FDC.SWC_CARB
            SWC_DDM_ImplMapping: component-implementation=Impl_SWC_DDM_type, component=root_FDC.SWC_DDM
            SWC_TPMS_APS_ImplMapping: component-implementation=Impl_SWC_TPMS_APS_type, component=root_FDC.SWC_TPMS_APS
        sw-mappings:
          swc to ecu mapping SWC_ECUMapping: ecu-instance=FUSION
            component:
              root_FDC.SWC_FDC
              root_FDC.SWC_CDD
              root_FDC.SWC_VES
              root_FDC.BswMTest
              root_FDC.SWC_NVM
              root_FDC.SWC_UDS
              root_FDC.SWC_IMU
              root_FDC.SWC_UART
              root_FDC.SWC_DID
              root_FDC.SWC_IOEXP
              root_FDC.SWC_CGW
              root_FDC.SWC_DKC
              root_FDC.SWC_LOG
              root_FDC.SWC_SCP
              root_FDC.SWC_INP
              root_FDC.SWC_HALIN
              root_FDC.SWC_HALIN_CDD
              root_FDC.SWC_OUTP
              root_FDC.SWC_HALOUT
              root_FDC.SWC_V2L
              root_FDC.SWC_CARB
              root_FDC.SWC_DDM
              root_FDC.SWC_TPMS_APS
      MAP_HALOUTP_CAN1_FD1_APS2: sender-receiver-to-signal-group-mapping{communication-direction=OUT, data-element=SWC_HALOUT.root_FDC.P_CAN1_FD1_APS2.CAN1_SG_FD1_APS2, signal-group=CAN1_SG_FD1_APS2, type-mapping=sender-rec-record-type-mapping=record-element-mappings=[{implementation-record-element=CAN1_APS_D_FLL, system-signal=CAN1_APS_D_FLL}, {implementation-record-element=CAN1_USS_Sta_RMR, system-signal=CAN1_USS_Sta_RMR}, {implementation-record-element=CAN1_USS_Sta_RML, system-signal=CAN1_USS_Sta_RML}, {implementation-record-element=CAN1_USS_Sta_RLR, system-signal=CAN1_USS_Sta_RLR}, {implementation-record-element=CAN1_USS_Sta_RLL, system-signal=CAN1_USS_Sta_RLL}, {implementation-record-element=CAN1_USS_Sta_RCR, system-signal=CAN1_USS_Sta_RCR}, {implementation-record-element=CAN1_USS_Sta_RCL, system-signal=CAN1_USS_Sta_RCL}, {implementation-record-element=CAN1_USS_Sta_FMR, system-signal=CAN1_USS_Sta_FMR}, {implementation-record-element=CAN1_USS_Sta_FML, system-signal=CAN1_USS_Sta_FML}, {implementation-record-element=CAN1_USS_Sta_FLR, system-signal=CAN1_USS_Sta_FLR}, {implementation-record-element=CAN1_USS_Sta_FLL, system-signal=CAN1_USS_Sta_FLL}, {implementation-record-element=CAN1_USS_Sta_FCR, system-signal=CAN1_USS_Sta_FCR}, {implementation-record-element=CAN1_USS_Sta_FCL, system-signal=CAN1_USS_Sta_FCL}, {implementation-record-element=CAN1_PAS_Sta_F_Sys, system-signal=CAN1_PAS_Sta_F_Sys}, {implementation-record-element=CAN1_PAS_SNSR_Layout, system-signal=CAN1_PAS_SNSR_Layout}, {implementation-record-element=CAN1_PAS_Mod_Operation, system-signal=CAN1_PAS_Mod_Operation}, {implementation-record-element=CAN1_PAS_D_RMR, system-signal=CAN1_PAS_D_RMR}, {implementation-record-element=CAN1_PAS_D_RML, system-signal=CAN1_PAS_D_RML}, {implementation-record-element=CAN1_PAS_D_RCR, system-signal=CAN1_PAS_D_RCR}, {implementation-record-element=CAN1_PAS_D_RCL, system-signal=CAN1_PAS_D_RCL}, {implementation-record-element=CAN1_PAS_D_FMR, system-signal=CAN1_PAS_D_FMR}, {implementation-record-element=CAN1_PAS_D_FML, system-signal=CAN1_PAS_D_FML}, {implementation-record-element=CAN1_PAS_D_FCR, system-signal=CAN1_PAS_D_FCR}, {implementation-record-element=CAN1_PAS_D_FCL, system-signal=CAN1_PAS_D_FCL}, {implementation-record-element=CAN1_PAS_Chime, system-signal=CAN1_PAS_Chime}, {implementation-record-element=CAN1_PAS_A_RMR, system-signal=CAN1_PAS_A_RMR}, {implementation-record-element=CAN1_PAS_A_RML, system-signal=CAN1_PAS_A_RML}, {implementation-record-element=CAN1_PAS_A_RCR, system-signal=CAN1_PAS_A_RCR}, {implementation-record-element=CAN1_PAS_A_RCL, system-signal=CAN1_PAS_A_RCL}, {implementation-record-element=CAN1_PAS_A_FMR, system-signal=CAN1_PAS_A_FMR}, {implementation-record-element=CAN1_PAS_A_FML, system-signal=CAN1_PAS_A_FML}, {implementation-record-element=CAN1_PAS_A_FCR, system-signal=CAN1_PAS_A_FCR}, {implementation-record-element=CAN1_PAS_A_FCL, system-signal=CAN1_PAS_A_FCL}, {implementation-record-element=CAN1_APS_SW_Ver, system-signal=CAN1_APS_SW_Ver}, {implementation-record-element=CAN1_APS_RQ_Display, system-signal=CAN1_APS_RQ_Display}, {implementation-record-element=CAN1_APS_Progress_PCT, system-signal=CAN1_APS_Progress_PCT}, {implementation-record-element=CAN1_APS_HW_Ver, system-signal=CAN1_APS_HW_Ver}, {implementation-record-element=CAN1_APS_ExitCondition, system-signal=CAN1_APS_ExitCondition}, {implementation-record-element=CAN1_APS_D_RLR, system-signal=CAN1_APS_D_RLR}, {implementation-record-element=CAN1_APS_D_RLL, system-signal=CAN1_APS_D_RLL}, {implementation-record-element=CAN1_APS_D_FLR, system-signal=CAN1_APS_D_FLR}]}
      MAP_HALOUTP_CAN1_FD1_APS3: sender-receiver-to-signal-group-mapping{communication-direction=OUT, data-element=SWC_HALOUT.root_FDC.P_CAN1_FD1_APS3.CAN1_SG_FD1_APS3, signal-group=CAN1_SG_FD1_APS3, type-mapping=sender-rec-record-type-mapping=record-element-mappings=[{implementation-record-element=CAN1_APS3_LifeCount, system-signal=CAN1_APS3_LifeCount}, {implementation-record-element=CAN1_SPTG_Sta, system-signal=CAN1_SPTG_Sta}, {implementation-record-element=CAN1_SPTGDet, system-signal=CAN1_SPTGDet}, {implementation-record-element=CAN1_FDC_VMC_APS_V_Rq_EPS_Ctrl, system-signal=CAN1_FDC_VMC_APS_V_Rq_EPS_Ctrl}, {implementation-record-element=CAN1_FDC_VMC_APS_Rq_EPS_Ctrl, system-signal=CAN1_FDC_VMC_APS_Rq_EPS_Ctrl}, {implementation-record-element=CAN1_FDC_VMC_APS_Angle_Target, system-signal=CAN1_FDC_VMC_APS_Angle_Target}, {implementation-record-element=CAN1_FDC_VCU_RAPSErrLv3_Flg, system-signal=CAN1_FDC_VCU_RAPSErrLv3_Flg}, {implementation-record-element=CAN1_FDC_VCU_RAPSErrLv2_Flg, system-signal=CAN1_FDC_VCU_RAPSErrLv2_Flg}, {implementation-record-element=CAN1_FDC_RAPS_PwrReq_Cmd, system-signal=CAN1_FDC_RAPS_PwrReq_Cmd}, {implementation-record-element=CAN1_FDC_RAPS_PwrReqAvail_Sta, system-signal=CAN1_FDC_RAPS_PwrReqAvail_Sta}, {implementation-record-element=CAN1_FDC_RAPS_ErrLv1_Flg, system-signal=CAN1_FDC_RAPS_ErrLv1_Flg}, {implementation-record-element=CAN1_FDC_RAPS_BCMLockReq_Cmd, system-signal=CAN1_FDC_RAPS_BCMLockReq_Cmd}, {implementation-record-element=CAN1_FDC_RAPS_BCMLamp_Cmd, system-signal=CAN1_FDC_RAPS_BCMLamp_Cmd}, {implementation-record-element=CAN1_FDC_APS_VMCReqA_Cmd, system-signal=CAN1_FDC_APS_VMCReqA_Cmd}, {implementation-record-element=CAN1_FDC_APS_SpeedReq_Cmd, system-signal=CAN1_FDC_APS_SpeedReq_Cmd}, {implementation-record-element=CAN1_FDC_APS_ShftPosnReq_Cmd, system-signal=CAN1_FDC_APS_ShftPosnReq_Cmd}, {implementation-record-element=CAN1_FDC_APS_CtrlAvail_Sta, system-signal=CAN1_FDC_APS_CtrlAvail_Sta}, {implementation-record-element=CAN1_FDC_APS_CaasVMCReqA_Cmd, system-signal=CAN1_FDC_APS_CaasVMCReqA_Cmd}, {implementation-record-element=CAN1_FDC_APS_CaasCtrlAvail_Sta, system-signal=CAN1_FDC_APS_CaasCtrlAvail_Sta}, {implementation-record-element=CAN1_FDC_APS_CaasActive_Sta, system-signal=CAN1_FDC_APS_CaasActive_Sta}, {implementation-record-element=CAN1_FDC_APS_Active_Sta, system-signal=CAN1_FDC_APS_Active_Sta}, {implementation-record-element=CAN1_CAAS_Sta, system-signal=CAN1_CAAS_Sta}, {implementation-record-element=CAN1_APS_Sta_System, system-signal=CAN1_APS_Sta_System}, {implementation-record-element=CAN1_APS_Req, system-signal=CAN1_APS_Req}, {implementation-record-element=CAN1_APS_DecReq_A, system-signal=CAN1_APS_DecReq_A}, {implementation-record-element=CAN1_APS_DecReq, system-signal=CAN1_APS_DecReq}, {implementation-record-element=CAN1_APSOpenPTG, system-signal=CAN1_APSOpenPTG}, {implementation-record-element=CAN1_APS3_checksum, system-signal=CAN1_APS3_checksum}]}
      MAP_HALOUTP_CAN1_FD1_BCM1: sender-receiver-to-signal-group-mapping{communication-direction=OUT, data-element=SWC_HALOUT.root_FDC.P_CAN1_FD1_BCM1.CAN1_SG_FD1_BCM1, signal-group=CAN1_SG_FD1_BCM1, type-mapping=sender-rec-record-type-mapping=record-element-mappings=[{implementation-record-element=CAN1_AllDoorSW, system-signal=CAN1_AllDoorSW}, {implementation-record-element=CAN1_WiperFixMode, system-signal=CAN1_WiperFixMode}, {implementation-record-element=CAN1_WasherCtrl, system-signal=CAN1_WasherCtrl}, {implementation-record-element=CAN1_TrunkRel, system-signal=CAN1_TrunkRel}, {implementation-record-element=CAN1_Tailgate_SW, system-signal=CAN1_Tailgate_SW}, {implementation-record-element=CAN1_TailgateRemote, system-signal=CAN1_TailgateRemote}, {implementation-record-element=CAN1_TailgateHDSW, system-signal=CAN1_TailgateHDSW}, {implementation-record-element=CAN1_Rr_Wiper, system-signal=CAN1_Rr_Wiper}, {implementation-record-element=CAN1_Rr_FogLamp, system-signal=CAN1_Rr_FogLamp}, {implementation-record-element=CAN1_Rr_Defog, system-signal=CAN1_Rr_Defog}, {implementation-record-element=CAN1_Rr_ChargingDoorCtrl, system-signal=CAN1_Rr_ChargingDoorCtrl}, {implementation-record-element=CAN1_RoomLampL, system-signal=CAN1_RoomLampL}, {implementation-record-element=CAN1_RoomLampH, system-signal=CAN1_RoomLampH}, {implementation-record-element=CAN1_ReverseLamp, system-signal=CAN1_ReverseLamp}, {implementation-record-element=CAN1_RTurnLP, system-signal=CAN1_RTurnLP}, {implementation-record-element=CAN1_RRDoorSW, system-signal=CAN1_RRDoorSW}, {implementation-record-element=CAN1_RLDoorSW, system-signal=CAN1_RLDoorSW}, {implementation-record-element=CAN1_RDRL, system-signal=CAN1_RDRL}, {implementation-record-element=CAN1_RBSD, system-signal=CAN1_RBSD}, {implementation-record-element=CAN1_PsDoorSW, system-signal=CAN1_PsDoorSW}, {implementation-record-element=CAN1_PosLamp, system-signal=CAN1_PosLamp}, {implementation-record-element=CAN1_MirrorDefog, system-signal=CAN1_MirrorDefog}, {implementation-record-element=CAN1_MirrorCtrl, system-signal=CAN1_MirrorCtrl}, {implementation-record-element=CAN1_LockSetting, system-signal=CAN1_LockSetting}, {implementation-record-element=CAN1_L_Beam, system-signal=CAN1_L_Beam}, {implementation-record-element=CAN1_L_APM_WdwEnable, system-signal=CAN1_L_APM_WdwEnable}, {implementation-record-element=CAN1_LTurnLP, system-signal=CAN1_LTurnLP}, {implementation-record-element=CAN1_LDRL, system-signal=CAN1_LDRL}, {implementation-record-element=CAN1_LBSD, system-signal=CAN1_LBSD}, {implementation-record-element=CAN1_HornCtrl, system-signal=CAN1_HornCtrl}, {implementation-record-element=CAN1_HoodSW, system-signal=CAN1_HoodSW}, {implementation-record-element=CAN1_HazardSW, system-signal=CAN1_HazardSW}, {implementation-record-element=CAN1_H_Beam, system-signal=CAN1_H_Beam}, {implementation-record-element=CAN1_Fr_Wiper_L, system-signal=CAN1_Fr_Wiper_L}, {implementation-record-element=CAN1_Fr_Wiper_H, system-signal=CAN1_Fr_Wiper_H}, {implementation-record-element=CAN1_Fr_FogLamp, system-signal=CAN1_Fr_FogLamp}, {implementation-record-element=CAN1_Fr_ChargingDoorCtrl, system-signal=CAN1_Fr_ChargingDoorCtrl}, {implementation-record-element=CAN1_DrDoorSW, system-signal=CAN1_DrDoorSW}, {implementation-record-element=CAN1_DoorLockIND, system-signal=CAN1_DoorLockIND}, {implementation-record-element=CAN1_DimmerEN, system-signal=CAN1_DimmerEN}, {implementation-record-element=CAN1_Dimmer, system-signal=CAN1_Dimmer}, {implementation-record-element=CAN1_CrashDetd, system-signal=CAN1_CrashDetd}, {implementation-record-element=CAN1_CTDUnlockSW, system-signal=CAN1_CTDUnlockSW}, {implementation-record-element=CAN1_CTDLockSW, system-signal=CAN1_CTDLockSW}, {implementation-record-element=CAN1_CTDCtrl, system-signal=CAN1_CTDCtrl}, {implementation-record-element=CAN1_BrakeLamp, system-signal=CAN1_BrakeLamp}, {implementation-record-element=CAN1_BCM_DoorLock_Sta, system-signal=CAN1_BCM_DoorLock_Sta}, {implementation-record-element=CAN1_BCM_Buzzer_Req, system-signal=CAN1_BCM_Buzzer_Req}, {implementation-record-element=CAN1_AntitheftSta, system-signal=CAN1_AntitheftSta}, {implementation-record-element=CAN1_AntiTheftSeatFold, system-signal=CAN1_AntiTheftSeatFold}]}
      MAP_HALOUTP_CAN1_FD1_THCM1: sender-receiver-to-signal-group-mapping{communication-direction=OUT, data-element=SWC_HALOUT.root_FDC.P_CAN1_FD1_THCM1.CAN1_SG_FD1_THCM1, signal-group=CAN1_SG_FD1_THCM1, type-mapping=sender-rec-record-type-mapping=record-element-mappings=[{implementation-record-element=CAN1_BatteryMode, system-signal=CAN1_BatteryMode}, {implementation-record-element=CAN1_sigWindDirZon3St, system-signal=CAN1_sigWindDirZon3St}, {implementation-record-element=CAN1_sigWindDirZon1St, system-signal=CAN1_sigWindDirZon1St}, {implementation-record-element=CAN1_sigSetTempZon3St, system-signal=CAN1_sigSetTempZon3St}, {implementation-record-element=CAN1_sigSetTempZon2St, system-signal=CAN1_sigSetTempZon2St}, {implementation-record-element=CAN1_sigSetTempZon1St, system-signal=CAN1_sigSetTempZon1St}, {implementation-record-element=CAN1_sigRecircSt, system-signal=CAN1_sigRecircSt}, {implementation-record-element=CAN1_sigHvacSt, system-signal=CAN1_sigHvacSt}, {implementation-record-element=CAN1_sigDfrstSt, system-signal=CAN1_sigDfrstSt}, {implementation-record-element=CAN1_sigClntTHvBattOut, system-signal=CAN1_sigClntTHvBattOut}, {implementation-record-element=CAN1_sigClmtCmprPwrAct, system-signal=CAN1_sigClmtCmprPwrAct}, {implementation-record-element=CAN1_sigCbnSolarRight, system-signal=CAN1_sigCbnSolarRight}, {implementation-record-element=CAN1_sigCbnSolarLeft, system-signal=CAN1_sigCbnSolarLeft}, {implementation-record-element=CAN1_sigCbnPTCPwrAct, system-signal=CAN1_sigCbnPTCPwrAct}, {implementation-record-element=CAN1_sigCbnAirT, system-signal=CAN1_sigCbnAirT}, {implementation-record-element=CAN1_sigAmbAirT, system-signal=CAN1_sigAmbAirT}, {implementation-record-element=CAN1_sigAirIntenZon3St, system-signal=CAN1_sigAirIntenZon3St}, {implementation-record-element=CAN1_sigAirIntenZon1St, system-signal=CAN1_sigAirIntenZon1St}, {implementation-record-element=CAN1_Rr_Coolanttemp, system-signal=CAN1_Rr_Coolanttemp}, {implementation-record-element=CAN1_Rr_Coolantflow, system-signal=CAN1_Rr_Coolantflow}, {implementation-record-element=CAN1_HPThermalRecoveryReq, system-signal=CAN1_HPThermalRecoveryReq}, {implementation-record-element=CAN1_Fr_Coolanttemp, system-signal=CAN1_Fr_Coolanttemp}, {implementation-record-element=CAN1_Fr_Coolantflow, system-signal=CAN1_Fr_Coolantflow}, {implementation-record-element=CAN1_FD_RecyAuto_Cmd, system-signal=CAN1_FD_RecyAuto_Cmd}, {implementation-record-element=CAN1_FD_AGS_Cmd, system-signal=CAN1_FD_AGS_Cmd}, {implementation-record-element=CAN1_EDriveMode, system-signal=CAN1_EDriveMode}, {implementation-record-element=CAN1_CabinMode, system-signal=CAN1_CabinMode}, {implementation-record-element=CAN1_CCU_SyncLampSts, system-signal=CAN1_CCU_SyncLampSts}, {implementation-record-element=CAN1_CCU_RrOnOffLampSts, system-signal=CAN1_CCU_RrOnOffLampSts}, {implementation-record-element=CAN1_CCU_HEATMaxLampSts, system-signal=CAN1_CCU_HEATMaxLampSts}, {implementation-record-element=CAN1_CCU_FrtOnOffLampSts, system-signal=CAN1_CCU_FrtOnOffLampSts}, {implementation-record-element=CAN1_CCU_EcoSts, system-signal=CAN1_CCU_EcoSts}, {implementation-record-element=CAN1_CCU_Dispaly_Request, system-signal=CAN1_CCU_Dispaly_Request}, {implementation-record-element=CAN1_CCU_AutoMidLampSts, system-signal=CAN1_CCU_AutoMidLampSts}, {implementation-record-element=CAN1_CCU_AutoLampSts, system-signal=CAN1_CCU_AutoLampSts}, {implementation-record-element=CAN1_CCU_ACMaxLampSts, system-signal=CAN1_CCU_ACMaxLampSts}, {implementation-record-element=CAN1_CCU_ACLampSts, system-signal=CAN1_CCU_ACLampSts}]}
      MAP_HALOUTP_CAN1_FD1_VCU1: sender-receiver-to-signal-group-mapping{communication-direction=OUT, data-element=SWC_HALOUT.root_FDC.P_CAN1_FD1_VCU1.CAN1_SG_FD1_VCU1, signal-group=CAN1_SG_FD1_VCU1, type-mapping=sender-rec-record-type-mapping=record-element-mappings=[{implementation-record-element=CAN1_CC_Crl_Sta, system-signal=CAN1_CC_Crl_Sta}, {implementation-record-element=CAN1_XWDMode, system-signal=CAN1_XWDMode}, {implementation-record-element=CAN1_VehMalfunLevel, system-signal=CAN1_VehMalfunLevel}, {implementation-record-element=CAN1_ShiftGearPosn, system-signal=CAN1_ShiftGearPosn}, {implementation-record-element=CAN1_PwrSta, system-signal=CAN1_PwrSta}, {implementation-record-element=CAN1_PrkReqValid, system-signal=CAN1_PrkReqValid}, {implementation-record-element=CAN1_PrkReq, system-signal=CAN1_PrkReq}, {implementation-record-element=CAN1_P_Button_Sta, system-signal=CAN1_P_Button_Sta}, {implementation-record-element=CAN1_MSA_Crl_Sta, system-signal=CAN1_MSA_Crl_Sta}, {implementation-record-element=CAN1_LVPwrSta, system-signal=CAN1_LVPwrSta}, {implementation-record-element=CAN1_HVPwrSta, system-signal=CAN1_HVPwrSta}, {implementation-record-element=CAN1_Eng_PwrLockSta, system-signal=CAN1_Eng_PwrLockSta}, {implementation-record-element=CAN1_Eng_CoastDwSta, system-signal=CAN1_Eng_CoastDwSta}, {implementation-record-element=CAN1_Eng_ActvDmpDisabSta, system-signal=CAN1_Eng_ActvDmpDisabSta}, {implementation-record-element=CAN1_Eng_AGSCloseSta, system-signal=CAN1_Eng_AGSCloseSta}]}
      MAP_HALOUTP_CAN1_FD1_VCU2: sender-receiver-to-signal-group-mapping{communication-direction=OUT, data-element=SWC_HALOUT.root_FDC.P_CAN1_FD1_VCU2.CAN1_SG_FD1_VCU2, signal-group=CAN1_SG_FD1_VCU2, type-mapping=sender-rec-record-type-mapping=record-element-mappings=[{implementation-record-element=CAN1_ACC_CtrlAvail, system-signal=CAN1_ACC_CtrlAvail}, {implementation-record-element=CAN1_VehActPwr, system-signal=CAN1_VehActPwr}, {implementation-record-element=CAN1_Rr_DriverTq, system-signal=CAN1_Rr_DriverTq}, {implementation-record-element=CAN1_RC_VCU2_CAN1, system-signal=CAN1_RC_VCU2_CAN1}, {implementation-record-element=CAN1_Fr_DriverTq, system-signal=CAN1_Fr_DriverTq}, {implementation-record-element=CAN1_DriverTq, system-signal=CAN1_DriverTq}, {implementation-record-element=CAN1_CS_VCU2_CAN1, system-signal=CAN1_CS_VCU2_CAN1}, {implementation-record-element=CAN1_ActAPSPosn, system-signal=CAN1_ActAPSPosn}, {implementation-record-element=CAN1_AccPedal_Override, system-signal=CAN1_AccPedal_Override}]}
      MAP_HALOUTP_CAN1_FD1_VCU3: sender-receiver-to-signal-group-mapping{communication-direction=OUT, data-element=SWC_HALOUT.root_FDC.P_CAN1_FD1_VCU3.CAN1_SG_FD1_VCU3, signal-group=CAN1_SG_FD1_VCU3, type-mapping=sender-rec-record-type-mapping=record-element-mappings=[{implementation-record-element=CAN1_CS_VCU3_CAN1, system-signal=CAN1_CS_VCU3_CAN1}, {implementation-record-element=CAN1_Rr_RgnPermSta, system-signal=CAN1_Rr_RgnPermSta}, {implementation-record-element=CAN1_Rr_RgnDecrSta, system-signal=CAN1_Rr_RgnDecrSta}, {implementation-record-element=CAN1_Rr_EDUSpdValid, system-signal=CAN1_Rr_EDUSpdValid}, {implementation-record-element=CAN1_Rr_EDUSpd, system-signal=CAN1_Rr_EDUSpd}, {implementation-record-element=CAN1_Rr_EDURealDrvOrBRgnTq, system-signal=CAN1_Rr_EDURealDrvOrBRgnTq}, {implementation-record-element=CAN1_Rr_EDURealARgnTq, system-signal=CAN1_Rr_EDURealARgnTq}, {implementation-record-element=CAN1_Rr_EDUAvailBrkRgnTqValid, system-signal=CAN1_Rr_EDUAvailBrkRgnTqValid}, {implementation-record-element=CAN1_Rr_EDUAvailBrkRgnTq, system-signal=CAN1_Rr_EDUAvailBrkRgnTq}, {implementation-record-element=CAN1_RgnAbnorSta, system-signal=CAN1_RgnAbnorSta}, {implementation-record-element=CAN1_RC_VCU3_CAN1, system-signal=CAN1_RC_VCU3_CAN1}, {implementation-record-element=CAN1_PTCS_PermSta, system-signal=CAN1_PTCS_PermSta}, {implementation-record-element=CAN1_Fr_RgnPermSta, system-signal=CAN1_Fr_RgnPermSta}, {implementation-record-element=CAN1_Fr_RgnDecrSta, system-signal=CAN1_Fr_RgnDecrSta}, {implementation-record-element=CAN1_Fr_EDUSpdValid, system-signal=CAN1_Fr_EDUSpdValid}, {implementation-record-element=CAN1_Fr_EDUSpd, system-signal=CAN1_Fr_EDUSpd}, {implementation-record-element=CAN1_Fr_EDURealDrvOrBRgnTq, system-signal=CAN1_Fr_EDURealDrvOrBRgnTq}, {implementation-record-element=CAN1_Fr_EDURealARgnTq, system-signal=CAN1_Fr_EDURealARgnTq}, {implementation-record-element=CAN1_Fr_EDUAvailBrkRgnTqValid, system-signal=CAN1_Fr_EDUAvailBrkRgnTqValid}, {implementation-record-element=CAN1_Fr_EDUAvailBrkRgnTq, system-signal=CAN1_Fr_EDUAvailBrkRgnTq}, {implementation-record-element=CAN1_EquivAccPedalSWSta, system-signal=CAN1_EquivAccPedalSWSta}]}
      MAP_HALOUTP_CAN1_FD1_VMC1: sender-receiver-to-signal-group-mapping{communication-direction=OUT, data-element=SWC_HALOUT.root_FDC.P_CAN1_FD1_VMC1.CAN1_SG_FD1_VMC1, signal-group=CAN1_SG_FD1_VMC1, type-mapping=sender-rec-record-type-mapping=record-element-mappings=[{implementation-record-element=CAN1_AccCalcuPID, system-signal=CAN1_AccCalcuPID}, {implementation-record-element=CAN1_VehicleSpeed_mph, system-signal=CAN1_VehicleSpeed_mph}, {implementation-record-element=CAN1_VehicleSpeed_kph, system-signal=CAN1_VehicleSpeed_kph}, {implementation-record-element=CAN1_VMC_VCU_MSA_Crl_Sta, system-signal=CAN1_VMC_VCU_MSA_Crl_Sta}, {implementation-record-element=CAN1_VMC_VCU_CC_Crl_Sta, system-signal=CAN1_VMC_VCU_CC_Crl_Sta}, {implementation-record-element=CAN1_VMC_VCU_AccPedal_Override, system-signal=CAN1_VMC_VCU_AccPedal_Override}, {implementation-record-element=CAN1_VMC_VCU_APSCtrlAvail_flg, system-signal=CAN1_VMC_VCU_APSCtrlAvail_flg}, {implementation-record-element=CAN1_VMC_VCU_ACC_CtrlAvail, system-signal=CAN1_VMC_VCU_ACC_CtrlAvail}, {implementation-record-element=CAN1_VMC_MSACtrlAvail, system-signal=CAN1_VMC_MSACtrlAvail}, {implementation-record-element=CAN1_VMC_CCCtrlAvail, system-signal=CAN1_VMC_CCCtrlAvail}, {implementation-record-element=CAN1_VMC_AEBCtrlAvail, system-signal=CAN1_VMC_AEBCtrlAvail}, {implementation-record-element=CAN1_VMC_ACCCtrlAvail, system-signal=CAN1_VMC_ACCCtrlAvail}, {implementation-record-element=CAN1_TimeGapCalcu, system-signal=CAN1_TimeGapCalcu}, {implementation-record-element=CAN1_SingleWhlSlipRatioCtrl, system-signal=CAN1_SingleWhlSlipRatioCtrl}, {implementation-record-element=CAN1_SafetyCtrl, system-signal=CAN1_SafetyCtrl}, {implementation-record-element=CAN1_SPD2ACCAct, system-signal=CAN1_SPD2ACCAct}, {implementation-record-element=CAN1_RearWhlSlipRatioCtrl, system-signal=CAN1_RearWhlSlipRatioCtrl}, {implementation-record-element=CAN1_MeterIndSpeed_raw32, system-signal=CAN1_MeterIndSpeed_raw32}, {implementation-record-element=CAN1_LimitPCT, system-signal=CAN1_LimitPCT}, {implementation-record-element=CAN1_LateralCtrl, system-signal=CAN1_LateralCtrl}, {implementation-record-element=CAN1_LatAccCtrl, system-signal=CAN1_LatAccCtrl}, {implementation-record-element=CAN1_JerkPCT, system-signal=CAN1_JerkPCT}, {implementation-record-element=CAN1_FrontRearSlipRatioCtrl, system-signal=CAN1_FrontRearSlipRatioCtrl}, {implementation-record-element=CAN1_FeatSetSpdFinal_raw32, system-signal=CAN1_FeatSetSpdFinal_raw32}, {implementation-record-element=CAN1_FeatReqSpd, system-signal=CAN1_FeatReqSpd}, {implementation-record-element=CAN1_FeatArbitrSta, system-signal=CAN1_FeatArbitrSta}, {implementation-record-element=CAN1_FeatArbitrFinal, system-signal=CAN1_FeatArbitrFinal}, {implementation-record-element=CAN1_DISC_Sta, system-signal=CAN1_DISC_Sta}, {implementation-record-element=CAN1_DISC_DISCTurn, system-signal=CAN1_DISC_DISCTurn}, {implementation-record-element=CAN1_DISC_DISCTargetSpd, system-signal=CAN1_DISC_DISCTargetSpd}, {implementation-record-element=CAN1_DISC_ButtSta, system-signal=CAN1_DISC_ButtSta}, {implementation-record-element=CAN1_DISCReqAcc, system-signal=CAN1_DISCReqAcc}, {implementation-record-element=CAN1_CCMSA_SpdWar, system-signal=CAN1_CCMSA_SpdWar}]}
      MAP_HALOUTP_CAN1_FD1_VMC2: sender-receiver-to-signal-group-mapping{communication-direction=OUT, data-element=SWC_HALOUT.root_FDC.P_CAN1_FD1_VMC2.CAN1_SG_FD1_VMC2, signal-group=CAN1_SG_FD1_VMC2, type-mapping=sender-rec-record-type-mapping=record-element-mappings=[{implementation-record-element=CAN1_FDC_VMC_RWS_Actv_Sta, system-signal=CAN1_FDC_VMC_RWS_Actv_Sta}, {implementation-record-element=CAN1_FDC_VMC_SteerFaultReq_Cmd, system-signal=CAN1_FDC_VMC_SteerFaultReq_Cmd}, {implementation-record-element=CAN1_FDC_VMC_RWS_PositionReq_Cmd, system-signal=CAN1_FDC_VMC_RWS_PositionReq_Cmd}, {implementation-record-element=CAN1_FDC_VMC_RWS_Dfctv_Sta, system-signal=CAN1_FDC_VMC_RWS_Dfctv_Sta}]}
      MAP_HALOUTP_CAN1_VMC_FCM1: sender-receiver-to-signal-group-mapping{communication-direction=OUT, data-element=SWC_HALOUT.root_FDC.P_CAN1_VMC_FCM1.CAN1_SG_VMC_FCM1, signal-group=CAN1_SG_VMC_FCM1, type-mapping=sender-rec-record-type-mapping=record-element-mappings=[{implementation-record-element=CAN1_FDC_VMC_AngCtrlTqWtGn, system-signal=CAN1_FDC_VMC_AngCtrlTqWtGn}, {implementation-record-element=CAN1_VMC_FCM_LKA_TOIFault, system-signal=CAN1_VMC_FCM_LKA_TOIFault}, {implementation-record-element=CAN1_VMC_FCM_LKA_TOIAct, system-signal=CAN1_VMC_FCM_LKA_TOIAct}, {implementation-record-element=CAN1_VMC_FCM_LKA_StrToqReq, system-signal=CAN1_VMC_FCM_LKA_StrToqReq}, {implementation-record-element=CAN1_VMC_FCM_LDW_Request, system-signal=CAN1_VMC_FCM_LDW_Request}, {implementation-record-element=CAN1_VMC_FCM_LDW_Fault, system-signal=CAN1_VMC_FCM_LDW_Fault}, {implementation-record-element=CAN1_VMC_FCM1_LifeCount, system-signal=CAN1_VMC_FCM1_LifeCount}, {implementation-record-element=CAN1_VMC_FCM1_Checksum, system-signal=CAN1_VMC_FCM1_Checksum}, {implementation-record-element=CAN1_VMC_AEB_VehHoldReq, system-signal=CAN1_VMC_AEB_VehHoldReq}, {implementation-record-element=CAN1_VMC_ADAS_FaultSta, system-signal=CAN1_VMC_ADAS_FaultSta}, {implementation-record-element=CAN1_VMC_ADAS_DBSReq, system-signal=CAN1_VMC_ADAS_DBSReq}, {implementation-record-element=CAN1_VMC_ADAS_AEB_Sta, system-signal=CAN1_VMC_ADAS_AEB_Sta}, {implementation-record-element=CAN1_VMC_ADAS_AEBReq, system-signal=CAN1_VMC_ADAS_AEBReq}, {implementation-record-element=CAN1_VMC_ADAS_ACC_Sta, system-signal=CAN1_VMC_ADAS_ACC_Sta}, {implementation-record-element=CAN1_VMC_ACC_VehHoldReq, system-signal=CAN1_VMC_ACC_VehHoldReq}, {implementation-record-element=CAN1_VMC_ACC_RequiredAccel, system-signal=CAN1_VMC_ACC_RequiredAccel}, {implementation-record-element=CAN1_VMC_ACC_JerkUpperLInit, system-signal=CAN1_VMC_ACC_JerkUpperLInit}, {implementation-record-element=CAN1_VMC_ACC_JerkLowerLInit, system-signal=CAN1_VMC_ACC_JerkLowerLInit}, {implementation-record-element=CAN1_VMC_ACC_ComfortBandUpper, system-signal=CAN1_VMC_ACC_ComfortBandUpper}, {implementation-record-element=CAN1_VMC_ACC_ComfortBandLower, system-signal=CAN1_VMC_ACC_ComfortBandLower}, {implementation-record-element=CAN1_FDC_VMC_MaxAngCtrlOutTqLim, system-signal=CAN1_FDC_VMC_MaxAngCtrlOutTqLim}, {implementation-record-element=CAN1_FDC_VMC_DrInpTqBstGn, system-signal=CAN1_FDC_VMC_DrInpTqBstGn}, {implementation-record-element=CAN1_FDC_VMC_DrInpTqBstAct, system-signal=CAN1_FDC_VMC_DrInpTqBstAct}, {implementation-record-element=CAN1_FDC_VMC_DMSMode_Cmd, system-signal=CAN1_FDC_VMC_DMSMode_Cmd}]}
      MAP_HALOUTP_CAN2_FD2_C20_0: sender-receiver-to-signal-group-mapping{communication-direction=OUT, data-element=SWC_HALOUT.root_FDC.P_CAN2_FD2_C20_0.CAN2_SG_FD2_C20_0, signal-group=CAN2_SG_FD2_C20_0, type-mapping=sender-rec-record-type-mapping=record-element-mappings=[{implementation-record-element=CAN2_APS_ExitCondition, system-signal=CAN2_APS_ExitCondition}, {implementation-record-element=CAN2_VMC_VCU_MSA_Crl_Sta, system-signal=CAN2_VMC_VCU_MSA_Crl_Sta}, {implementation-record-element=CAN2_VMC_VCU_CC_Crl_Sta, system-signal=CAN2_VMC_VCU_CC_Crl_Sta}, {implementation-record-element=CAN2_USS_Sta_RMR, system-signal=CAN2_USS_Sta_RMR}, {implementation-record-element=CAN2_USS_Sta_RML, system-signal=CAN2_USS_Sta_RML}, {implementation-record-element=CAN2_USS_Sta_RLR, system-signal=CAN2_USS_Sta_RLR}, {implementation-record-element=CAN2_USS_Sta_RLL, system-signal=CAN2_USS_Sta_RLL}, {implementation-record-element=CAN2_USS_Sta_RCR, system-signal=CAN2_USS_Sta_RCR}, {implementation-record-element=CAN2_USS_Sta_RCL, system-signal=CAN2_USS_Sta_RCL}, {implementation-record-element=CAN2_USS_Sta_FMR, system-signal=CAN2_USS_Sta_FMR}, {implementation-record-element=CAN2_USS_Sta_FML, system-signal=CAN2_USS_Sta_FML}, {implementation-record-element=CAN2_USS_Sta_FLR, system-signal=CAN2_USS_Sta_FLR}, {implementation-record-element=CAN2_USS_Sta_FLL, system-signal=CAN2_USS_Sta_FLL}, {implementation-record-element=CAN2_USS_Sta_FCR, system-signal=CAN2_USS_Sta_FCR}, {implementation-record-element=CAN2_USS_Sta_FCL, system-signal=CAN2_USS_Sta_FCL}, {implementation-record-element=CAN2_PAS_SNSR_Layout, system-signal=CAN2_PAS_SNSR_Layout}, {implementation-record-element=CAN2_PAS_D_RMR, system-signal=CAN2_PAS_D_RMR}, {implementation-record-element=CAN2_PAS_D_RML, system-signal=CAN2_PAS_D_RML}, {implementation-record-element=CAN2_PAS_D_RCR, system-signal=CAN2_PAS_D_RCR}, {implementation-record-element=CAN2_PAS_D_RCL, system-signal=CAN2_PAS_D_RCL}, {implementation-record-element=CAN2_PAS_D_FMR, system-signal=CAN2_PAS_D_FMR}, {implementation-record-element=CAN2_PAS_D_FML, system-signal=CAN2_PAS_D_FML}, {implementation-record-element=CAN2_PAS_D_FCR, system-signal=CAN2_PAS_D_FCR}, {implementation-record-element=CAN2_PAS_D_FCL, system-signal=CAN2_PAS_D_FCL}, {implementation-record-element=CAN2_PAS_Chime, system-signal=CAN2_PAS_Chime}, {implementation-record-element=CAN2_PAS_A_RMR, system-signal=CAN2_PAS_A_RMR}, {implementation-record-element=CAN2_PAS_A_RML, system-signal=CAN2_PAS_A_RML}, {implementation-record-element=CAN2_PAS_A_RCR, system-signal=CAN2_PAS_A_RCR}, {implementation-record-element=CAN2_PAS_A_RCL, system-signal=CAN2_PAS_A_RCL}, {implementation-record-element=CAN2_PAS_A_FMR, system-signal=CAN2_PAS_A_FMR}, {implementation-record-element=CAN2_PAS_A_FML, system-signal=CAN2_PAS_A_FML}, {implementation-record-element=CAN2_PAS_A_FCR, system-signal=CAN2_PAS_A_FCR}, {implementation-record-element=CAN2_PAS_A_FCL, system-signal=CAN2_PAS_A_FCL}, {implementation-record-element=CAN2_FDC_VMC_SpdCtrl_Sta, system-signal=CAN2_FDC_VMC_SpdCtrl_Sta}, {implementation-record-element=CAN2_FDC_VMC_SpdCtrlMode_Sta, system-signal=CAN2_FDC_VMC_SpdCtrlMode_Sta}, {implementation-record-element=CAN2_FDC_VMC_SetSpd_Sta, system-signal=CAN2_FDC_VMC_SetSpd_Sta}, {implementation-record-element=CAN2_FDC_VMC_SetSpdDisp_Sta, system-signal=CAN2_FDC_VMC_SetSpdDisp_Sta}, {implementation-record-element=CAN2_FDC_VCU_SmartEco_Sta, system-signal=CAN2_FDC_VCU_SmartEco_Sta}, {implementation-record-element=CAN2_FDC_VCU_SmartEcoSpdLim_Sta, system-signal=CAN2_FDC_VCU_SmartEcoSpdLim_Sta}, {implementation-record-element=CAN2_FDC_VCU_SimSound_Cmd, system-signal=CAN2_FDC_VCU_SimSound_Cmd}, {implementation-record-element=CAN2_FDC_VCU_RegenMode_Sta, system-signal=CAN2_FDC_VCU_RegenMode_Sta}, {implementation-record-element=CAN2_FDC_VCU_RegenLimInd_Sta, system-signal=CAN2_FDC_VCU_RegenLimInd_Sta}, {implementation-record-element=CAN2_DISC_DISCTargetSpd, system-signal=CAN2_DISC_DISCTargetSpd}, {implementation-record-element=CAN2_CAAS_Sta, system-signal=CAN2_CAAS_Sta}, {implementation-record-element=CAN2_APS_Sta_System, system-signal=CAN2_APS_Sta_System}, {implementation-record-element=CAN2_APS_SW_Ver, system-signal=CAN2_APS_SW_Ver}, {implementation-record-element=CAN2_APS_RQ_Display, system-signal=CAN2_APS_RQ_Display}]}
      MAP_HALOUTP_CAN2_FD2_CE100_0: sender-receiver-to-signal-group-mapping{communication-direction=OUT, data-element=SWC_HALOUT.root_FDC.P_CAN2_FD2_CE100_0.CAN2_SG_FD2_CE100_0, signal-group=CAN2_SG_FD2_CE100_0, type-mapping=sender-rec-record-type-mapping=record-element-mappings=[{implementation-record-element=CAN2_APMDoorControlSta, system-signal=CAN2_APMDoorControlSta}, {implementation-record-element=CAN2_sigWindDirZon3St, system-signal=CAN2_sigWindDirZon3St}, {implementation-record-element=CAN2_sigWindDirZon1St, system-signal=CAN2_sigWindDirZon1St}, {implementation-record-element=CAN2_sigSetTempZon3St, system-signal=CAN2_sigSetTempZon3St}, {implementation-record-element=CAN2_sigSetTempZon2St, system-signal=CAN2_sigSetTempZon2St}, {implementation-record-element=CAN2_sigSetTempZon1St, system-signal=CAN2_sigSetTempZon1St}, {implementation-record-element=CAN2_sigRecircSt, system-signal=CAN2_sigRecircSt}, {implementation-record-element=CAN2_sigHvacSt, system-signal=CAN2_sigHvacSt}, {implementation-record-element=CAN2_sigDfrstSt, system-signal=CAN2_sigDfrstSt}, {implementation-record-element=CAN2_sigCbnAirT, system-signal=CAN2_sigCbnAirT}, {implementation-record-element=CAN2_sigAmbAirT, system-signal=CAN2_sigAmbAirT}, {implementation-record-element=CAN2_sigAirIntenZon3St, system-signal=CAN2_sigAirIntenZon3St}, {implementation-record-element=CAN2_sigAirIntenZon1St, system-signal=CAN2_sigAirIntenZon1St}, {implementation-record-element=CAN2_XWDMode, system-signal=CAN2_XWDMode}, {implementation-record-element=CAN2_VehMalfunLevel, system-signal=CAN2_VehMalfunLevel}, {implementation-record-element=CAN2_VCU_OPDHold, system-signal=CAN2_VCU_OPDHold}, {implementation-record-element=CAN2_VCUTailgateSWSta, system-signal=CAN2_VCUTailgateSWSta}, {implementation-record-element=CAN2_VCURRDoorSta, system-signal=CAN2_VCURRDoorSta}, {implementation-record-element=CAN2_VCURLDoorSta, system-signal=CAN2_VCURLDoorSta}, {implementation-record-element=CAN2_VCUHoodSWSta, system-signal=CAN2_VCUHoodSWSta}, {implementation-record-element=CAN2_VCUFRDoorSta, system-signal=CAN2_VCUFRDoorSta}, {implementation-record-element=CAN2_VCUFLDoorSta, system-signal=CAN2_VCUFLDoorSta}, {implementation-record-element=CAN2_VCUBrkSWSta, system-signal=CAN2_VCUBrkSWSta}, {implementation-record-element=CAN2_Tailgate_SW, system-signal=CAN2_Tailgate_SW}, {implementation-record-element=CAN2_SysPwrSta, system-signal=CAN2_SysPwrSta}, {implementation-record-element=CAN2_SysAllowReadySta, system-signal=CAN2_SysAllowReadySta}, {implementation-record-element=CAN2_ShiftGearPosn, system-signal=CAN2_ShiftGearPosn}, {implementation-record-element=CAN2_Rr_FogLamp, system-signal=CAN2_Rr_FogLamp}, {implementation-record-element=CAN2_Rr_Defog, system-signal=CAN2_Rr_Defog}, {implementation-record-element=CAN2_ReverseLamp, system-signal=CAN2_ReverseLamp}, {implementation-record-element=CAN2_Req_V2L_IVI_Popup, system-signal=CAN2_Req_V2L_IVI_Popup}, {implementation-record-element=CAN2_Req_V2LSwOn, system-signal=CAN2_Req_V2LSwOn}, {implementation-record-element=CAN2_Req_Internal_V2L_Status_Lamp, system-signal=CAN2_Req_Internal_V2L_Status_Lamp}, {implementation-record-element=CAN2_RTurnLP, system-signal=CAN2_RTurnLP}, {implementation-record-element=CAN2_RRDoorSW, system-signal=CAN2_RRDoorSW}, {implementation-record-element=CAN2_RLDoorSW, system-signal=CAN2_RLDoorSW}, {implementation-record-element=CAN2_RDRL, system-signal=CAN2_RDRL}, {implementation-record-element=CAN2_RBSD, system-signal=CAN2_RBSD}, {implementation-record-element=CAN2_PwrStaONTOIVIPopT, system-signal=CAN2_PwrStaONTOIVIPopT}, {implementation-record-element=CAN2_PwrStaONTOIVIPopReq, system-signal=CAN2_PwrStaONTOIVIPopReq}, {implementation-record-element=CAN2_PwrStaErr, system-signal=CAN2_PwrStaErr}, {implementation-record-element=CAN2_PwrSta, system-signal=CAN2_PwrSta}, {implementation-record-element=CAN2_PsDoorSW, system-signal=CAN2_PsDoorSW}, {implementation-record-element=CAN2_PosLamp, system-signal=CAN2_PosLamp}, {implementation-record-element=CAN2_PAS_Sta_F_Sys, system-signal=CAN2_PAS_Sta_F_Sys}, {implementation-record-element=CAN2_MeterIndSpeed_raw32, system-signal=CAN2_MeterIndSpeed_raw32}, {implementation-record-element=CAN2_MSA_Crl_Sta, system-signal=CAN2_MSA_Crl_Sta}, {implementation-record-element=CAN2_MCUActDisFail, system-signal=CAN2_MCUActDisFail}, {implementation-record-element=CAN2_LockSetting, system-signal=CAN2_LockSetting}, {implementation-record-element=CAN2_LimphomeAct, system-signal=CAN2_LimphomeAct}, {implementation-record-element=CAN2_L_Beam, system-signal=CAN2_L_Beam}, {implementation-record-element=CAN2_LVSysErr_PwrOutpErr, system-signal=CAN2_LVSysErr_PwrOutpErr}, {implementation-record-element=CAN2_LVSilentChrgSta, system-signal=CAN2_LVSilentChrgSta}, {implementation-record-element=CAN2_LVSilentChrgReq, system-signal=CAN2_LVSilentChrgReq}, {implementation-record-element=CAN2_LVChrgFuncStaChk, system-signal=CAN2_LVChrgFuncStaChk}, {implementation-record-element=CAN2_LTurnLP, system-signal=CAN2_LTurnLP}, {implementation-record-element=CAN2_LDRL, system-signal=CAN2_LDRL}, {implementation-record-element=CAN2_LBSD, system-signal=CAN2_LBSD}, {implementation-record-element=CAN2_HoodSW, system-signal=CAN2_HoodSW}, {implementation-record-element=CAN2_HazardSW, system-signal=CAN2_HazardSW}, {implementation-record-element=CAN2_H_Beam, system-signal=CAN2_H_Beam}, {implementation-record-element=CAN2_HVSysErr_RelayErr, system-signal=CAN2_HVSysErr_RelayErr}, {implementation-record-element=CAN2_HVSysErr_PackErr, system-signal=CAN2_HVSysErr_PackErr}, {implementation-record-element=CAN2_HVSysErr_IsolationErr, system-signal=CAN2_HVSysErr_IsolationErr}, {implementation-record-element=CAN2_HVRlyOpFail, system-signal=CAN2_HVRlyOpFail}, {implementation-record-element=CAN2_Fr_FogLamp, system-signal=CAN2_Fr_FogLamp}, {implementation-record-element=CAN2_FollowMe, system-signal=CAN2_FollowMe}, {implementation-record-element=CAN2_FeatSetSpdFinal_raw32, system-signal=CAN2_FeatSetSpdFinal_raw32}, {implementation-record-element=CAN2_FalseNPrevent_Sta, system-signal=CAN2_FalseNPrevent_Sta}, {implementation-record-element=CAN2_FD_Telltale_Fail, system-signal=CAN2_FD_Telltale_Fail}, {implementation-record-element=CAN2_FD_TCS_Indicator, system-signal=CAN2_FD_TCS_Indicator}, {implementation-record-element=CAN2_FD_Steering_Warning, system-signal=CAN2_FD_Steering_Warning}, {implementation-record-element=CAN2_FD_Power_limitation, system-signal=CAN2_FD_Power_limitation}, {implementation-record-element=CAN2_FD_Park_Brake_Warning, system-signal=CAN2_FD_Park_Brake_Warning}, {implementation-record-element=CAN2_FD_HV_Battery_Fault, system-signal=CAN2_FD_HV_Battery_Fault}, {implementation-record-element=CAN2_FD_EPB_Error, system-signal=CAN2_FD_EPB_Error}, {implementation-record-element=CAN2_FD_EDrive_System, system-signal=CAN2_FD_EDrive_System}, {implementation-record-element=CAN2_FD_EBMErrSta, system-signal=CAN2_FD_EBMErrSta}, {implementation-record-element=CAN2_FD_Battery_Charge_Warning, system-signal=CAN2_FD_Battery_Charge_Warning}, {implementation-record-element=CAN2_FD_AGS_Cmd, system-signal=CAN2_FD_AGS_Cmd}, {implementation-record-element=CAN2_FD_ABS_Warning, system-signal=CAN2_FD_ABS_Warning}, {implementation-record-element=CAN2_FDC_VCU_TrailerDisOPD_Sta, system-signal=CAN2_FDC_VCU_TrailerDisOPD_Sta}, {implementation-record-element=CAN2_FDC_VCU_PwrSaveReq_Cmd, system-signal=CAN2_FDC_VCU_PwrSaveReq_Cmd}, {implementation-record-element=CAN2_FDC_VCU_LVStaTooLow_Sta, system-signal=CAN2_FDC_VCU_LVStaTooLow_Sta}, {implementation-record-element=CAN2_FDC_VCU_LVStaDropQuick_Sta, system-signal=CAN2_FDC_VCU_LVStaDropQuick_Sta}, {implementation-record-element=CAN2_FDC_VCU_LVChrgFreq_Sta, system-signal=CAN2_FDC_VCU_LVChrgFreq_Sta}, {implementation-record-element=CAN2_FDC_V2L_IVIV2LDischarg_Cmd, system-signal=CAN2_FDC_V2L_IVIV2LDischarg_Cmd}, {implementation-record-element=CAN2_FDC_THCM_RVent_Sta, system-signal=CAN2_FDC_THCM_RVent_Sta}, {implementation-record-element=CAN2_FDC_THCM_REVentZ_Sta, system-signal=CAN2_FDC_THCM_REVentZ_Sta}, {implementation-record-element=CAN2_FDC_THCM_REVentY_Sta, system-signal=CAN2_FDC_THCM_REVentY_Sta}, {implementation-record-element=CAN2_FDC_THCM_REVentMode_Sta, system-signal=CAN2_FDC_THCM_REVentMode_Sta}, {implementation-record-element=CAN2_FDC_THCM_PreWPTCHeat_Sta, system-signal=CAN2_FDC_THCM_PreWPTCHeat_Sta}, {implementation-record-element=CAN2_FDC_THCM_LVent_Sta, system-signal=CAN2_FDC_THCM_LVent_Sta}, {implementation-record-element=CAN2_FDC_THCM_LEVentZ_Sta, system-signal=CAN2_FDC_THCM_LEVentZ_Sta}, {implementation-record-element=CAN2_FDC_THCM_LEVentY_Sta, system-signal=CAN2_FDC_THCM_LEVentY_Sta}, {implementation-record-element=CAN2_FDC_THCM_LEVentMode_Sta, system-signal=CAN2_FDC_THCM_LEVentMode_Sta}, {implementation-record-element=CAN2_FDC_THCM_CRVent_Sta, system-signal=CAN2_FDC_THCM_CRVent_Sta}, {implementation-record-element=CAN2_FDC_THCM_CREVentZ_Sta, system-signal=CAN2_FDC_THCM_CREVentZ_Sta}, {implementation-record-element=CAN2_FDC_THCM_CREVentY_Sta, system-signal=CAN2_FDC_THCM_CREVentY_Sta}, {implementation-record-element=CAN2_FDC_THCM_CLVent_Sta, system-signal=CAN2_FDC_THCM_CLVent_Sta}, {implementation-record-element=CAN2_FDC_THCM_CLEVentZ_Sta, system-signal=CAN2_FDC_THCM_CLEVentZ_Sta}, {implementation-record-element=CAN2_FDC_THCM_CLEVentY_Sta, system-signal=CAN2_FDC_THCM_CLEVentY_Sta}, {implementation-record-element=CAN2_FDC_RAPS_ErrWarn_Sta, system-signal=CAN2_FDC_RAPS_ErrWarn_Sta}, {implementation-record-element=CAN2_FDC_BCM_HMIKey8Func_Sta, system-signal=CAN2_FDC_BCM_HMIKey8Func_Sta}, {implementation-record-element=CAN2_FDC_BCM_HMIKey7Func_Sta, system-signal=CAN2_FDC_BCM_HMIKey7Func_Sta}, {implementation-record-element=CAN2_FDC_BCM_HMIKey6Func_Sta, system-signal=CAN2_FDC_BCM_HMIKey6Func_Sta}, {implementation-record-element=CAN2_FDC_BCM_HMIKey5Func_Sta, system-signal=CAN2_FDC_BCM_HMIKey5Func_Sta}, {implementation-record-element=CAN2_FDC_BCM_HMIKey4Func_Sta, system-signal=CAN2_FDC_BCM_HMIKey4Func_Sta}, {implementation-record-element=CAN2_FDC_BCM_HMIKey3Func_Sta, system-signal=CAN2_FDC_BCM_HMIKey3Func_Sta}, {implementation-record-element=CAN2_FDC_BCM_HMIKey2Func_Sta, system-signal=CAN2_FDC_BCM_HMIKey2Func_Sta}, {implementation-record-element=CAN2_FDC_BCM_HMIKey1Func_Sta, system-signal=CAN2_FDC_BCM_HMIKey1Func_Sta}, {implementation-record-element=CAN2_FDC_BCM_AutoWipHSpdEN_Sta, system-signal=CAN2_FDC_BCM_AutoWipHSpdEN_Sta}, {implementation-record-element=CAN2_EngageP_Fail, system-signal=CAN2_EngageP_Fail}, {implementation-record-element=CAN2_Eng_PwrLockSta, system-signal=CAN2_Eng_PwrLockSta}, {implementation-record-element=CAN2_Eng_CoastDwSta, system-signal=CAN2_Eng_CoastDwSta}, {implementation-record-element=CAN2_Eng_ActvDmpDisabSta, system-signal=CAN2_Eng_ActvDmpDisabSta}, {implementation-record-element=CAN2_Eng_AGSCloseSta, system-signal=CAN2_Eng_AGSCloseSta}, {implementation-record-element=CAN2_EVDriveMode, system-signal=CAN2_EVDriveMode}, {implementation-record-element=CAN2_EDriveSysErr_VCUErr, system-signal=CAN2_EDriveSysErr_VCUErr}, {implementation-record-element=CAN2_EDriveSysErr_ShifterErr, system-signal=CAN2_EDriveSysErr_ShifterErr}, {implementation-record-element=CAN2_EDriveSysErr_MCUErr, system-signal=CAN2_EDriveSysErr_MCUErr}, {implementation-record-element=CAN2_EDriveSysErr_AccPedalErr, system-signal=CAN2_EDriveSysErr_AccPedalErr}, {implementation-record-element=CAN2_DynoModeStaChk, system-signal=CAN2_DynoModeStaChk}, {implementation-record-element=CAN2_Dr_SeatSta, system-signal=CAN2_Dr_SeatSta}, {implementation-record-element=CAN2_DrDoorSW, system-signal=CAN2_DrDoorSW}, {implementation-record-element=CAN2_DoorLockIND, system-signal=CAN2_DoorLockIND}, {implementation-record-element=CAN2_DisengageP_Fail, system-signal=CAN2_DisengageP_Fail}, {implementation-record-element=CAN2_DimmerEN, system-signal=CAN2_DimmerEN}, {implementation-record-element=CAN2_Dimmer, system-signal=CAN2_Dimmer}, {implementation-record-element=CAN2_DemoModeStaChk, system-signal=CAN2_DemoModeStaChk}, {implementation-record-element=CAN2_DISC_Sta, system-signal=CAN2_DISC_Sta}, {implementation-record-element=CAN2_DISC_ButtSta, system-signal=CAN2_DISC_ButtSta}, {implementation-record-element=CAN2_CreepSW_Sta, system-signal=CAN2_CreepSW_Sta}, {implementation-record-element=CAN2_CoastDwModeStaChk, system-signal=CAN2_CoastDwModeStaChk}, {implementation-record-element=CAN2_CC_Crl_Sta, system-signal=CAN2_CC_Crl_Sta}, {implementation-record-element=CAN2_CCU_SyncLampSts, system-signal=CAN2_CCU_SyncLampSts}, {implementation-record-element=CAN2_CCU_RrOnOffLampSts, system-signal=CAN2_CCU_RrOnOffLampSts}, {implementation-record-element=CAN2_CCU_FrtOnOffLampSts, system-signal=CAN2_CCU_FrtOnOffLampSts}, {implementation-record-element=CAN2_CCU_EcoSts, system-signal=CAN2_CCU_EcoSts}, {implementation-record-element=CAN2_CCU_Dispaly_Request, system-signal=CAN2_CCU_Dispaly_Request}, {implementation-record-element=CAN2_CCU_AutoMidLampSts, system-signal=CAN2_CCU_AutoMidLampSts}, {implementation-record-element=CAN2_CCU_AutoLampSts, system-signal=CAN2_CCU_AutoLampSts}, {implementation-record-element=CAN2_CCU_ACMaxLampSts, system-signal=CAN2_CCU_ACMaxLampSts}, {implementation-record-element=CAN2_CCU_ACLampSts, system-signal=CAN2_CCU_ACLampSts}, {implementation-record-element=CAN2_CCMSA_SpdWar, system-signal=CAN2_CCMSA_SpdWar}, {implementation-record-element=CAN2_BrakeLamp, system-signal=CAN2_BrakeLamp}, {implementation-record-element=CAN2_BCM_DoorLock_Sta, system-signal=CAN2_BCM_DoorLock_Sta}, {implementation-record-element=CAN2_AntitheftSta, system-signal=CAN2_AntitheftSta}, {implementation-record-element=CAN2_AllDoorSW, system-signal=CAN2_AllDoorSW}, {implementation-record-element=CAN2_ActAPSPosn, system-signal=CAN2_ActAPSPosn}]}
      MAP_HALOUTP_CAN2_FD2_CE200_1: sender-receiver-to-signal-group-mapping{communication-direction=OUT, data-element=SWC_HALOUT.root_FDC.P_CAN2_FD2_CE200_1.CAN2_SG_FD2_CE200_1, signal-group=CAN2_SG_FD2_CE200_1, type-mapping=sender-rec-record-type-mapping=record-element-mappings=[{implementation-record-element=CAN2_AutoLTips, system-signal=CAN2_AutoLTips}, {implementation-record-element=CAN2_TPMS_Res_Butt_Allow, system-signal=CAN2_TPMS_Res_Butt_Allow}, {implementation-record-element=CAN2_TPMS_Cali_Butt_Allow, system-signal=CAN2_TPMS_Cali_Butt_Allow}, {implementation-record-element=CAN2_TPMSWarnIndi, system-signal=CAN2_TPMSWarnIndi}, {implementation-record-element=CAN2_RRWheelTmpIndi, system-signal=CAN2_RRWheelTmpIndi}, {implementation-record-element=CAN2_RRWheelTemp, system-signal=CAN2_RRWheelTemp}, {implementation-record-element=CAN2_RRWheelShield, system-signal=CAN2_RRWheelShield}, {implementation-record-element=CAN2_RRWheelPress, system-signal=CAN2_RRWheelPress}, {implementation-record-element=CAN2_RRWheelPSW, system-signal=CAN2_RRWheelPSW}, {implementation-record-element=CAN2_RRWheelDebug, system-signal=CAN2_RRWheelDebug}, {implementation-record-element=CAN2_RRSensorFail, system-signal=CAN2_RRSensorFail}, {implementation-record-element=CAN2_RRPressIndi, system-signal=CAN2_RRPressIndi}, {implementation-record-element=CAN2_RRBatWarn, system-signal=CAN2_RRBatWarn}, {implementation-record-element=CAN2_RFWheelTmpIndi, system-signal=CAN2_RFWheelTmpIndi}, {implementation-record-element=CAN2_RFWheelTemp, system-signal=CAN2_RFWheelTemp}, {implementation-record-element=CAN2_RFWheelShield, system-signal=CAN2_RFWheelShield}, {implementation-record-element=CAN2_RFWheelPress, system-signal=CAN2_RFWheelPress}, {implementation-record-element=CAN2_RFWheelPSW, system-signal=CAN2_RFWheelPSW}, {implementation-record-element=CAN2_RFWheelDebug, system-signal=CAN2_RFWheelDebug}, {implementation-record-element=CAN2_RFSensorFail, system-signal=CAN2_RFSensorFail}, {implementation-record-element=CAN2_RFPressIndi, system-signal=CAN2_RFPressIndi}, {implementation-record-element=CAN2_RFBatWarn, system-signal=CAN2_RFBatWarn}, {implementation-record-element=CAN2_LRWheelTmpIndi, system-signal=CAN2_LRWheelTmpIndi}, {implementation-record-element=CAN2_LRWheelTemp, system-signal=CAN2_LRWheelTemp}, {implementation-record-element=CAN2_LRWheelShield, system-signal=CAN2_LRWheelShield}, {implementation-record-element=CAN2_LRWheelPress, system-signal=CAN2_LRWheelPress}, {implementation-record-element=CAN2_LRWheelPSW, system-signal=CAN2_LRWheelPSW}, {implementation-record-element=CAN2_LRWheelDebug, system-signal=CAN2_LRWheelDebug}, {implementation-record-element=CAN2_LRSensorFail, system-signal=CAN2_LRSensorFail}, {implementation-record-element=CAN2_LRPressIndi, system-signal=CAN2_LRPressIndi}, {implementation-record-element=CAN2_LRBatWarn, system-signal=CAN2_LRBatWarn}, {implementation-record-element=CAN2_LFWheelTmpIndi, system-signal=CAN2_LFWheelTmpIndi}, {implementation-record-element=CAN2_LFWheelTemp, system-signal=CAN2_LFWheelTemp}, {implementation-record-element=CAN2_LFWheelShield, system-signal=CAN2_LFWheelShield}, {implementation-record-element=CAN2_LFWheelPress, system-signal=CAN2_LFWheelPress}, {implementation-record-element=CAN2_LFWheelPSW, system-signal=CAN2_LFWheelPSW}, {implementation-record-element=CAN2_LFWheelDebug, system-signal=CAN2_LFWheelDebug}, {implementation-record-element=CAN2_LFSensorFail, system-signal=CAN2_LFSensorFail}, {implementation-record-element=CAN2_LFPressIndi, system-signal=CAN2_LFPressIndi}, {implementation-record-element=CAN2_LFBatWarn, system-signal=CAN2_LFBatWarn}, {implementation-record-element=CAN2_FDC_THCM_AirIntZ3_Sta, system-signal=CAN2_FDC_THCM_AirIntZ3_Sta}, {implementation-record-element=CAN2_FDC_THCM_APTCWarning_Sta, system-signal=CAN2_FDC_THCM_APTCWarning_Sta}, {implementation-record-element=CAN2_FDC_THCM_APTCForceOFF_Sta, system-signal=CAN2_FDC_THCM_APTCForceOFF_Sta}, {implementation-record-element=CAN2_FDC_SPTG_SPTGENFun_Sta, system-signal=CAN2_FDC_SPTG_SPTGENFun_Sta}, {implementation-record-element=CAN2_FDC_FGS_IONSW_Sta, system-signal=CAN2_FDC_FGS_IONSW_Sta}, {implementation-record-element=CAN2_FDC_FGS_FGSCh_Sta, system-signal=CAN2_FDC_FGS_FGSCh_Sta}, {implementation-record-element=CAN2_FDC_FGS_AirInt_Sta, system-signal=CAN2_FDC_FGS_AirInt_Sta}, {implementation-record-element=CAN2_FDC_DKC_UIDLowPower_Sta, system-signal=CAN2_FDC_DKC_UIDLowPower_Sta}, {implementation-record-element=CAN2_FDC_DKC_KeyType_Sta, system-signal=CAN2_FDC_DKC_KeyType_Sta}, {implementation-record-element=CAN2_FDC_DKC_KeyNum_Sta, system-signal=CAN2_FDC_DKC_KeyNum_Sta}, {implementation-record-element=CAN2_FDC_DKC_KeyMiss_Sta, system-signal=CAN2_FDC_DKC_KeyMiss_Sta}, {implementation-record-element=CAN2_FDC_DKC_DkeyShowIVI_Sta, system-signal=CAN2_FDC_DKC_DkeyShowIVI_Sta}, {implementation-record-element=CAN2_FDC_BCM_WalkOutLkEnFun_Sta, system-signal=CAN2_FDC_BCM_WalkOutLkEnFun_Sta}, {implementation-record-element=CAN2_FDC_BCM_WalkInUnLkEnFun_Sta, system-signal=CAN2_FDC_BCM_WalkInUnLkEnFun_Sta}, {implementation-record-element=CAN2_FDC_BCM_UserNow_Sta, system-signal=CAN2_FDC_BCM_UserNow_Sta}, {implementation-record-element=CAN2_FDC_BCM_TurnSwTSetSta_Sta, system-signal=CAN2_FDC_BCM_TurnSwTSetSta_Sta}, {implementation-record-element=CAN2_FDC_BCM_RmLpModeENFun_Sta, system-signal=CAN2_FDC_BCM_RmLpModeENFun_Sta}, {implementation-record-element=CAN2_FDC_BCM_PTGOpenHeight_Sta, system-signal=CAN2_FDC_BCM_PTGOpenHeight_Sta}, {implementation-record-element=CAN2_FDC_BCM_LockAlarm_Cmd, system-signal=CAN2_FDC_BCM_LockAlarm_Cmd}, {implementation-record-element=CAN2_FDC_BCM_Key9Acc_Sta, system-signal=CAN2_FDC_BCM_Key9Acc_Sta}, {implementation-record-element=CAN2_FDC_BCM_Key8Acc_Sta, system-signal=CAN2_FDC_BCM_Key8Acc_Sta}, {implementation-record-element=CAN2_FDC_BCM_Key7Acc_Sta, system-signal=CAN2_FDC_BCM_Key7Acc_Sta}, {implementation-record-element=CAN2_FDC_BCM_Key6Acc_Sta, system-signal=CAN2_FDC_BCM_Key6Acc_Sta}, {implementation-record-element=CAN2_FDC_BCM_Key5Acc_Sta, system-signal=CAN2_FDC_BCM_Key5Acc_Sta}, {implementation-record-element=CAN2_FDC_BCM_Key4Acc_Sta, system-signal=CAN2_FDC_BCM_Key4Acc_Sta}, {implementation-record-element=CAN2_FDC_BCM_Key3Acc_Sta, system-signal=CAN2_FDC_BCM_Key3Acc_Sta}, {implementation-record-element=CAN2_FDC_BCM_Key2Acc_Sta, system-signal=CAN2_FDC_BCM_Key2Acc_Sta}, {implementation-record-element=CAN2_FDC_BCM_Key1Acc_Sta, system-signal=CAN2_FDC_BCM_Key1Acc_Sta}, {implementation-record-element=CAN2_FDC_BCM_Key10Acc_Sta, system-signal=CAN2_FDC_BCM_Key10Acc_Sta}, {implementation-record-element=CAN2_FDC_BCM_HBeamADB_Cmd, system-signal=CAN2_FDC_BCM_HBeamADB_Cmd}, {implementation-record-element=CAN2_FDC_BCM_FollowMeENFun_Sta, system-signal=CAN2_FDC_BCM_FollowMeENFun_Sta}, {implementation-record-element=CAN2_FDC_BCM_DSEATentryfset_Sta, system-signal=CAN2_FDC_BCM_DSEATentryfset_Sta}, {implementation-record-element=CAN2_FDC_BCM_CLWinLockDr_Sta, system-signal=CAN2_FDC_BCM_CLWinLockDr_Sta}, {implementation-record-element=CAN2_FDC_BCM_AutoUnlock_Sta, system-signal=CAN2_FDC_BCM_AutoUnlock_Sta}, {implementation-record-element=CAN2_FDC_BCM_AutoLock_Sta, system-signal=CAN2_FDC_BCM_AutoLock_Sta}, {implementation-record-element=CAN2_FDC_BCM_AmbWelEN_Sta, system-signal=CAN2_FDC_BCM_AmbWelEN_Sta}, {implementation-record-element=CAN2_FDC_BCM_AmbPwrWarnEN_Sta, system-signal=CAN2_FDC_BCM_AmbPwrWarnEN_Sta}, {implementation-record-element=CAN2_FDC_BCM_AmbODAEN_Sta, system-signal=CAN2_FDC_BCM_AmbODAEN_Sta}, {implementation-record-element=CAN2_FDC_BCM_AmbLinkDriSta_Sta, system-signal=CAN2_FDC_BCM_AmbLinkDriSta_Sta}, {implementation-record-element=CAN2_FDC_BCM_AmbFunEN_Sta, system-signal=CAN2_FDC_BCM_AmbFunEN_Sta}, {implementation-record-element=CAN2_FDC_BCM_AmbDimEN_Sta, system-signal=CAN2_FDC_BCM_AmbDimEN_Sta}, {implementation-record-element=CAN2_FDC_BCM_AmbColorSta_Sta, system-signal=CAN2_FDC_BCM_AmbColorSta_Sta}, {implementation-record-element=CAN2_FDC_BCM_AmbBrightSta_Sta, system-signal=CAN2_FDC_BCM_AmbBrightSta_Sta}, {implementation-record-element=CAN2_FDC_BCM_Acc5Sta_Sta, system-signal=CAN2_FDC_BCM_Acc5Sta_Sta}, {implementation-record-element=CAN2_FDC_BCM_Acc4Sta_Sta, system-signal=CAN2_FDC_BCM_Acc4Sta_Sta}, {implementation-record-element=CAN2_FDC_BCM_Acc3Sta_Sta, system-signal=CAN2_FDC_BCM_Acc3Sta_Sta}, {implementation-record-element=CAN2_FDC_BCM_Acc2Sta_Sta, system-signal=CAN2_FDC_BCM_Acc2Sta_Sta}, {implementation-record-element=CAN2_FDC_BCM_Acc1Sta_Sta, system-signal=CAN2_FDC_BCM_Acc1Sta_Sta}, {implementation-record-element=CAN2_CWheelTips, system-signal=CAN2_CWheelTips}]}
      MAP_HALOUTP_CAN2_FD2_Version: sender-receiver-to-signal-group-mapping{communication-direction=OUT, data-element=SWC_HALOUT.root_FDC.P_CAN2_FD2_Version.CAN2_SG_FD2_Version, signal-group=CAN2_SG_FD2_Version, type-mapping=sender-rec-record-type-mapping=record-element-mappings=[{implementation-record-element=CAN2_FUSION_HW_Ver1, system-signal=CAN2_FUSION_HW_Ver1}, {implementation-record-element=CAN2_FUSION_SW_dash2, system-signal=CAN2_FUSION_SW_dash2}, {implementation-record-element=CAN2_FUSION_SW_dash1, system-signal=CAN2_FUSION_SW_dash1}, {implementation-record-element=CAN2_FUSION_SW_change2, system-signal=CAN2_FUSION_SW_change2}, {implementation-record-element=CAN2_FUSION_SW_change1, system-signal=CAN2_FUSION_SW_change1}, {implementation-record-element=CAN2_FUSION_SW_Var5, system-signal=CAN2_FUSION_SW_Var5}, {implementation-record-element=CAN2_FUSION_SW_Var4, system-signal=CAN2_FUSION_SW_Var4}, {implementation-record-element=CAN2_FUSION_SW_Var3, system-signal=CAN2_FUSION_SW_Var3}, {implementation-record-element=CAN2_FUSION_SW_Var2, system-signal=CAN2_FUSION_SW_Var2}, {implementation-record-element=CAN2_FUSION_SW_Var1, system-signal=CAN2_FUSION_SW_Var1}, {implementation-record-element=CAN2_FUSION_SW_SHA8, system-signal=CAN2_FUSION_SW_SHA8}, {implementation-record-element=CAN2_FUSION_SW_SHA7, system-signal=CAN2_FUSION_SW_SHA7}, {implementation-record-element=CAN2_FUSION_SW_SHA6, system-signal=CAN2_FUSION_SW_SHA6}, {implementation-record-element=CAN2_FUSION_SW_SHA5, system-signal=CAN2_FUSION_SW_SHA5}, {implementation-record-element=CAN2_FUSION_SW_SHA4, system-signal=CAN2_FUSION_SW_SHA4}, {implementation-record-element=CAN2_FUSION_SW_SHA3, system-signal=CAN2_FUSION_SW_SHA3}, {implementation-record-element=CAN2_FUSION_SW_SHA2, system-signal=CAN2_FUSION_SW_SHA2}, {implementation-record-element=CAN2_FUSION_SW_SHA1, system-signal=CAN2_FUSION_SW_SHA1}, {implementation-record-element=CAN2_FUSION_SW_Patch2, system-signal=CAN2_FUSION_SW_Patch2}, {implementation-record-element=CAN2_FUSION_SW_Patch1, system-signal=CAN2_FUSION_SW_Patch1}, {implementation-record-element=CAN2_FUSION_SW_Minor2, system-signal=CAN2_FUSION_SW_Minor2}, {implementation-record-element=CAN2_FUSION_SW_Minor1, system-signal=CAN2_FUSION_SW_Minor1}, {implementation-record-element=CAN2_FUSION_SW_Major2, system-signal=CAN2_FUSION_SW_Major2}, {implementation-record-element=CAN2_FUSION_SW_Major1, system-signal=CAN2_FUSION_SW_Major1}, {implementation-record-element=CAN2_FUSION_SW_ECUGen2, system-signal=CAN2_FUSION_SW_ECUGen2}, {implementation-record-element=CAN2_FUSION_SW_ECUGen1, system-signal=CAN2_FUSION_SW_ECUGen1}, {implementation-record-element=CAN2_FUSION_SW_Country2, system-signal=CAN2_FUSION_SW_Country2}, {implementation-record-element=CAN2_FUSION_SW_Country1, system-signal=CAN2_FUSION_SW_Country1}, {implementation-record-element=CAN2_FUSION_SW_Controller2, system-signal=CAN2_FUSION_SW_Controller2}, {implementation-record-element=CAN2_FUSION_SW_Controller1, system-signal=CAN2_FUSION_SW_Controller1}, {implementation-record-element=CAN2_FUSION_SW_CarModel3, system-signal=CAN2_FUSION_SW_CarModel3}, {implementation-record-element=CAN2_FUSION_SW_CarModel2, system-signal=CAN2_FUSION_SW_CarModel2}, {implementation-record-element=CAN2_FUSION_SW_CarModel1, system-signal=CAN2_FUSION_SW_CarModel1}, {implementation-record-element=CAN2_FUSION_HW_Ver3, system-signal=CAN2_FUSION_HW_Ver3}, {implementation-record-element=CAN2_FUSION_HW_Ver2, system-signal=CAN2_FUSION_HW_Ver2}]}
      MAP_HALOUTP_CAN2_GW2_CE100_0: sender-receiver-to-signal-group-mapping{communication-direction=OUT, data-element=SWC_HALOUT.root_FDC.P_CAN2_GW2_CE100_0.CAN2_SG_GW2_CE100_0, signal-group=CAN2_SG_GW2_CE100_0, type-mapping=sender-rec-record-type-mapping=record-element-mappings=[{implementation-record-element=CAN2_FDC_BCM_DimSw, system-signal=CAN2_FDC_BCM_DimSw}, {implementation-record-element=CAN2_FDC_BCM_TurnSw_Sta, system-signal=CAN2_FDC_BCM_TurnSw_Sta}, {implementation-record-element=CAN2_FDC_BCM_FWipSw_Sta, system-signal=CAN2_FDC_BCM_FWipSw_Sta}]}
      MAP_HALOUTP_CAN2_GW2_CE100_1: sender-receiver-to-signal-group-mapping{communication-direction=OUT, data-element=SWC_HALOUT.root_FDC.P_CAN2_GW2_CE100_1.CAN2_SG_GW2_CE100_1, signal-group=CAN2_SG_GW2_CE100_1, type-mapping=sender-rec-record-type-mapping=record-element-mappings=[{implementation-record-element=CAN2_FDC_BCM_WinLFOpened_Sta, system-signal=CAN2_FDC_BCM_WinLFOpened_Sta}, {implementation-record-element=CAN2_FDC_BCM_WinRROpened_Sta, system-signal=CAN2_FDC_BCM_WinRROpened_Sta}, {implementation-record-element=CAN2_FDC_BCM_WinRFOpened_Sta, system-signal=CAN2_FDC_BCM_WinRFOpened_Sta}, {implementation-record-element=CAN2_FDC_BCM_WinLROpened_Sta, system-signal=CAN2_FDC_BCM_WinLROpened_Sta}]}
      MAP_HALOUTP_CAN2_GW2_CE200_0: sender-receiver-to-signal-group-mapping{communication-direction=OUT, data-element=SWC_HALOUT.root_FDC.P_CAN2_GW2_CE200_0.CAN2_SG_GW2_CE200_0, signal-group=CAN2_SG_GW2_CE200_0, type-mapping=sender-rec-record-type-mapping=sender-rec-record-element-mapping{implementation-record-element=CAN2_FDC_BCM_TimeGapLevel_Sta, system-signal=CAN2_FDC_BCM_TimeGapLevel_Sta}}
      MAP_HALOUTP_CAN3_FD3_BCM1: sender-receiver-to-signal-group-mapping{communication-direction=OUT, data-element=SWC_HALOUT.root_FDC.P_CAN3_FD3_BCM1.CAN3_SG_FD3_BCM1, signal-group=CAN3_SG_FD3_BCM1, type-mapping=sender-rec-record-type-mapping=record-element-mappings=[{implementation-record-element=CAN3_AllDoorSW, system-signal=CAN3_AllDoorSW}, {implementation-record-element=CAN3_WiperFixMode, system-signal=CAN3_WiperFixMode}, {implementation-record-element=CAN3_WasherCtrl, system-signal=CAN3_WasherCtrl}, {implementation-record-element=CAN3_TrunkRel, system-signal=CAN3_TrunkRel}, {implementation-record-element=CAN3_Tailgate_SW, system-signal=CAN3_Tailgate_SW}, {implementation-record-element=CAN3_TailgateRemote, system-signal=CAN3_TailgateRemote}, {implementation-record-element=CAN3_TailgateHDSW, system-signal=CAN3_TailgateHDSW}, {implementation-record-element=CAN3_Rr_Wiper, system-signal=CAN3_Rr_Wiper}, {implementation-record-element=CAN3_Rr_FogLamp, system-signal=CAN3_Rr_FogLamp}, {implementation-record-element=CAN3_Rr_Defog, system-signal=CAN3_Rr_Defog}, {implementation-record-element=CAN3_Rr_ChargingDoorCtrl, system-signal=CAN3_Rr_ChargingDoorCtrl}, {implementation-record-element=CAN3_RoomLampL, system-signal=CAN3_RoomLampL}, {implementation-record-element=CAN3_RoomLampH, system-signal=CAN3_RoomLampH}, {implementation-record-element=CAN3_ReverseLamp, system-signal=CAN3_ReverseLamp}, {implementation-record-element=CAN3_RTurnLP, system-signal=CAN3_RTurnLP}, {implementation-record-element=CAN3_RRDoorSW, system-signal=CAN3_RRDoorSW}, {implementation-record-element=CAN3_RLDoorSW, system-signal=CAN3_RLDoorSW}, {implementation-record-element=CAN3_RDRL, system-signal=CAN3_RDRL}, {implementation-record-element=CAN3_RBSD, system-signal=CAN3_RBSD}, {implementation-record-element=CAN3_PsDoorSW, system-signal=CAN3_PsDoorSW}, {implementation-record-element=CAN3_PosLamp, system-signal=CAN3_PosLamp}, {implementation-record-element=CAN3_MirrorDefog, system-signal=CAN3_MirrorDefog}, {implementation-record-element=CAN3_MirrorCtrl, system-signal=CAN3_MirrorCtrl}, {implementation-record-element=CAN3_LockSetting, system-signal=CAN3_LockSetting}, {implementation-record-element=CAN3_L_Beam, system-signal=CAN3_L_Beam}, {implementation-record-element=CAN3_L_APM_WdwEnable, system-signal=CAN3_L_APM_WdwEnable}, {implementation-record-element=CAN3_LTurnLP, system-signal=CAN3_LTurnLP}, {implementation-record-element=CAN3_LDRL, system-signal=CAN3_LDRL}, {implementation-record-element=CAN3_LBSD, system-signal=CAN3_LBSD}, {implementation-record-element=CAN3_HornCtrl, system-signal=CAN3_HornCtrl}, {implementation-record-element=CAN3_HoodSW, system-signal=CAN3_HoodSW}, {implementation-record-element=CAN3_HazardSW, system-signal=CAN3_HazardSW}, {implementation-record-element=CAN3_H_Beam, system-signal=CAN3_H_Beam}, {implementation-record-element=CAN3_Fr_Wiper_L, system-signal=CAN3_Fr_Wiper_L}, {implementation-record-element=CAN3_Fr_Wiper_H, system-signal=CAN3_Fr_Wiper_H}, {implementation-record-element=CAN3_Fr_FogLamp, system-signal=CAN3_Fr_FogLamp}, {implementation-record-element=CAN3_Fr_ChargingDoorCtrl, system-signal=CAN3_Fr_ChargingDoorCtrl}, {implementation-record-element=CAN3_DrDoorSW, system-signal=CAN3_DrDoorSW}, {implementation-record-element=CAN3_DoorLockIND, system-signal=CAN3_DoorLockIND}, {implementation-record-element=CAN3_DimmerEN, system-signal=CAN3_DimmerEN}, {implementation-record-element=CAN3_Dimmer, system-signal=CAN3_Dimmer}, {implementation-record-element=CAN3_CrashDetd, system-signal=CAN3_CrashDetd}, {implementation-record-element=CAN3_CTDUnlockSW, system-signal=CAN3_CTDUnlockSW}, {implementation-record-element=CAN3_CTDLockSW, system-signal=CAN3_CTDLockSW}, {implementation-record-element=CAN3_CTDCtrl, system-signal=CAN3_CTDCtrl}, {implementation-record-element=CAN3_BrakeLamp, system-signal=CAN3_BrakeLamp}, {implementation-record-element=CAN3_BCM_DoorLock_Sta, system-signal=CAN3_BCM_DoorLock_Sta}, {implementation-record-element=CAN3_BCM_Buzzer_Req, system-signal=CAN3_BCM_Buzzer_Req}, {implementation-record-element=CAN3_AntitheftSta, system-signal=CAN3_AntitheftSta}, {implementation-record-element=CAN3_AntiTheftSeatFold, system-signal=CAN3_AntiTheftSeatFold}]}
      MAP_HALOUTP_CAN3_FD3_C100_0: sender-receiver-to-signal-group-mapping{communication-direction=OUT, data-element=SWC_HALOUT.root_FDC.P_CAN3_FD3_C100_0.CAN3_SG_FD3_C100_0, signal-group=CAN3_SG_FD3_C100_0, type-mapping=sender-rec-record-type-mapping=record-element-mappings=[{implementation-record-element=CAN3_BatteryMode, system-signal=CAN3_BatteryMode}, {implementation-record-element=CAN3_sigCbnPTCPwrAct, system-signal=CAN3_sigCbnPTCPwrAct}, {implementation-record-element=CAN3_Rr_Coolanttemp, system-signal=CAN3_Rr_Coolanttemp}, {implementation-record-element=CAN3_Rr_Coolantflow, system-signal=CAN3_Rr_Coolantflow}, {implementation-record-element=CAN3_Fr_Coolanttemp, system-signal=CAN3_Fr_Coolanttemp}, {implementation-record-element=CAN3_Fr_Coolantflow, system-signal=CAN3_Fr_Coolantflow}]}
      MAP_HALOUTP_CAN3_FD3_V2L1: sender-receiver-to-signal-group-mapping{communication-direction=OUT, data-element=SWC_HALOUT.root_FDC.P_CAN3_FD3_V2L1.CAN3_SG_FD3_V2L1, signal-group=CAN3_SG_FD3_V2L1, type-mapping=sender-rec-record-type-mapping=record-element-mappings=[{implementation-record-element=CAN3_FDC_V2L_OBCExtrV2L_Cmd, system-signal=CAN3_FDC_V2L_OBCExtrV2L_Cmd}, {implementation-record-element=CAN3_Req_V2L_IVI_Popup, system-signal=CAN3_Req_V2L_IVI_Popup}, {implementation-record-element=CAN3_Req_V2LSwOn, system-signal=CAN3_Req_V2LSwOn}, {implementation-record-element=CAN3_Req_OBCV2LEna, system-signal=CAN3_Req_OBCV2LEna}, {implementation-record-element=CAN3_FDC_V2L_OBCIntrV2L_Cmd, system-signal=CAN3_FDC_V2L_OBCIntrV2L_Cmd}]}
      MAP_HALOUTP_CAN3_FD3_VCU0: sender-receiver-to-signal-group-mapping{communication-direction=OUT, data-element=SWC_HALOUT.root_FDC.P_CAN3_FD3_VCU0.CAN3_SG_FD3_VCU0, signal-group=CAN3_SG_FD3_VCU0, type-mapping=sender-rec-record-type-mapping=record-element-mappings=[{implementation-record-element=CAN3_EVCCAplusPwrUpReq, system-signal=CAN3_EVCCAplusPwrUpReq}, {implementation-record-element=CAN3_WisrBootReason, system-signal=CAN3_WisrBootReason}, {implementation-record-element=CAN3_VehHVPwrAvail4THCM, system-signal=CAN3_VehHVPwrAvail4THCM}, {implementation-record-element=CAN3_VCURRDoorSta, system-signal=CAN3_VCURRDoorSta}, {implementation-record-element=CAN3_VCURLDoorSta, system-signal=CAN3_VCURLDoorSta}, {implementation-record-element=CAN3_VCUFRDoorSta, system-signal=CAN3_VCUFRDoorSta}, {implementation-record-element=CAN3_VCUFLDoorSta, system-signal=CAN3_VCUFLDoorSta}, {implementation-record-element=CAN3_VCUBrkSWSta, system-signal=CAN3_VCUBrkSWSta}, {implementation-record-element=CAN3_TimerAllowSleep, system-signal=CAN3_TimerAllowSleep}, {implementation-record-element=CAN3_TCountSta, system-signal=CAN3_TCountSta}, {implementation-record-element=CAN3_SysPwrSta, system-signal=CAN3_SysPwrSta}, {implementation-record-element=CAN3_SysAllowReadySta, system-signal=CAN3_SysAllowReadySta}, {implementation-record-element=CAN3_SilentChkAllowSleep, system-signal=CAN3_SilentChkAllowSleep}, {implementation-record-element=CAN3_SchedChgTOSta, system-signal=CAN3_SchedChgTOSta}, {implementation-record-element=CAN3_Rr_TqSource, system-signal=CAN3_Rr_TqSource}, {implementation-record-element=CAN3_PwrUpReq, system-signal=CAN3_PwrUpReq}, {implementation-record-element=CAN3_PwrStaTOSta, system-signal=CAN3_PwrStaTOSta}, {implementation-record-element=CAN3_PwrStaSelect, system-signal=CAN3_PwrStaSelect}, {implementation-record-element=CAN3_PwrStaONTOIVIPopT, system-signal=CAN3_PwrStaONTOIVIPopT}, {implementation-record-element=CAN3_PwrStaONTOIVIPopReq, system-signal=CAN3_PwrStaONTOIVIPopReq}, {implementation-record-element=CAN3_PwrStaConstraint, system-signal=CAN3_PwrStaConstraint}, {implementation-record-element=CAN3_PwrDownReq, system-signal=CAN3_PwrDownReq}, {implementation-record-element=CAN3_PowerUpState, system-signal=CAN3_PowerUpState}, {implementation-record-element=CAN3_PowerUpFault, system-signal=CAN3_PowerUpFault}, {implementation-record-element=CAN3_PowerDownState, system-signal=CAN3_PowerDownState}, {implementation-record-element=CAN3_PowerDownFault, system-signal=CAN3_PowerDownFault}, {implementation-record-element=CAN3_PmicBootReason, system-signal=CAN3_PmicBootReason}, {implementation-record-element=CAN3_PMMAllowECUSleep, system-signal=CAN3_PMMAllowECUSleep}, {implementation-record-element=CAN3_MCUActDisFail, system-signal=CAN3_MCUActDisFail}, {implementation-record-element=CAN3_LVSilentChrgSta, system-signal=CAN3_LVSilentChrgSta}, {implementation-record-element=CAN3_LVSilentChrgReq, system-signal=CAN3_LVSilentChrgReq}, {implementation-record-element=CAN3_LVSilentChrgLv, system-signal=CAN3_LVSilentChrgLv}, {implementation-record-element=CAN3_LVChrgHoldTAct, system-signal=CAN3_LVChrgHoldTAct}, {implementation-record-element=CAN3_LVBattVoltSta, system-signal=CAN3_LVBattVoltSta}, {implementation-record-element=CAN3_LVBattChrgtimeAct, system-signal=CAN3_LVBattChrgtimeAct}, {implementation-record-element=CAN3_HVTHCMSysAvail, system-signal=CAN3_HVTHCMSysAvail}, {implementation-record-element=CAN3_HVRlyOpFail, system-signal=CAN3_HVRlyOpFail}, {implementation-record-element=CAN3_Fr_TqSource, system-signal=CAN3_Fr_TqSource}, {implementation-record-element=CAN3_FDC_VMC_LongAcc_Sta, system-signal=CAN3_FDC_VMC_LongAcc_Sta}, {implementation-record-element=CAN3_FDC_VMC_ActStESCYaw_Sta, system-signal=CAN3_FDC_VMC_ActStESCYaw_Sta}, {implementation-record-element=CAN3_FDC_VCU_VehMalfunLevel_Sta, system-signal=CAN3_FDC_VCU_VehMalfunLevel_Sta}, {implementation-record-element=CAN3_FDC_VCU_VehActSpd_Sta, system-signal=CAN3_FDC_VCU_VehActSpd_Sta}, {implementation-record-element=CAN3_FDC_VCU_SlideRegenLimTq_Sta, system-signal=CAN3_FDC_VCU_SlideRegenLimTq_Sta}, {implementation-record-element=CAN3_FDC_VCU_RrRateLimitInc_Sta, system-signal=CAN3_FDC_VCU_RrRateLimitInc_Sta}, {implementation-record-element=CAN3_FDC_VCU_RrRateLimitDec_Sta, system-signal=CAN3_FDC_VCU_RrRateLimitDec_Sta}, {implementation-record-element=CAN3_FDC_VCU_RrFirstOrderInpTs, system-signal=CAN3_FDC_VCU_RrFirstOrderInpTs}, {implementation-record-element=CAN3_FDC_VCU_RegenTqLimitEn_Sta, system-signal=CAN3_FDC_VCU_RegenTqLimitEn_Sta}, {implementation-record-element=CAN3_FDC_VCU_RWDRDCActive_Sta, system-signal=CAN3_FDC_VCU_RWDRDCActive_Sta}, {implementation-record-element=CAN3_FDC_VCU_PwrReq_OTA_Sta, system-signal=CAN3_FDC_VCU_PwrReq_OTA_Sta}, {implementation-record-element=CAN3_FDC_VCU_OTAPwrReqStdChk_Sta, system-signal=CAN3_FDC_VCU_OTAPwrReqStdChk_Sta}, {implementation-record-element=CAN3_FDC_VCU_OTAPwrReqOFFChk_Sta, system-signal=CAN3_FDC_VCU_OTAPwrReqOFFChk_Sta}, {implementation-record-element=CAN3_FDC_VCU_LowIdleAccPedal_Sta, system-signal=CAN3_FDC_VCU_LowIdleAccPedal_Sta}, {implementation-record-element=CAN3_FDC_VCU_LVStaDropQukCnt_Sta, system-signal=CAN3_FDC_VCU_LVStaDropQukCnt_Sta}, {implementation-record-element=CAN3_FDC_VCU_LVChrgFreqCnt_Sta, system-signal=CAN3_FDC_VCU_LVChrgFreqCnt_Sta}, {implementation-record-element=CAN3_FDC_VCU_FrRateLimitInc_Sta, system-signal=CAN3_FDC_VCU_FrRateLimitInc_Sta}, {implementation-record-element=CAN3_FDC_VCU_FrRateLimitDec_Sta, system-signal=CAN3_FDC_VCU_FrRateLimitDec_Sta}, {implementation-record-element=CAN3_FDC_VCU_FrFirstOrderInpTs, system-signal=CAN3_FDC_VCU_FrFirstOrderInpTs}, {implementation-record-element=CAN3_FDC_VCU_ForceP_Cmd, system-signal=CAN3_FDC_VCU_ForceP_Cmd}, {implementation-record-element=CAN3_FDC_VCU_EAPS2Raw_Sta, system-signal=CAN3_FDC_VCU_EAPS2Raw_Sta}, {implementation-record-element=CAN3_FDC_VCU_EAPS2Min_Sta, system-signal=CAN3_FDC_VCU_EAPS2Min_Sta}, {implementation-record-element=CAN3_FDC_VCU_EAPS1Raw_Sta, system-signal=CAN3_FDC_VCU_EAPS1Raw_Sta}, {implementation-record-element=CAN3_FDC_VCU_EAPS1Min_Sta, system-signal=CAN3_FDC_VCU_EAPS1Min_Sta}, {implementation-record-element=CAN3_FDC_VCU_DTCCarousel_Sta, system-signal=CAN3_FDC_VCU_DTCCarousel_Sta}, {implementation-record-element=CAN3_FDC_VCU_CANBrkSW2Sta_Sta, system-signal=CAN3_FDC_VCU_CANBrkSW2Sta_Sta}, {implementation-record-element=CAN3_FDC_VCU_BrkPedalPosSta_Sta, system-signal=CAN3_FDC_VCU_BrkPedalPosSta_Sta}, {implementation-record-element=CAN3_FDC_VCU_BrakeSigMatrix_Sta, system-signal=CAN3_FDC_VCU_BrakeSigMatrix_Sta}, {implementation-record-element=CAN3_FDC_VCU_BOSEnable_Sta, system-signal=CAN3_FDC_VCU_BOSEnable_Sta}, {implementation-record-element=CAN3_FDC_VCU_AllowMovThd_OTA_Sta, system-signal=CAN3_FDC_VCU_AllowMovThd_OTA_Sta}, {implementation-record-element=CAN3_FDC_VCU_ActMaxSlideRate_Sta, system-signal=CAN3_FDC_VCU_ActMaxSlideRate_Sta}, {implementation-record-element=CAN3_FDC_SYS_PmicBootPath, system-signal=CAN3_FDC_SYS_PmicBootPath}, {implementation-record-element=CAN3_FDADC12VDetAvg, system-signal=CAN3_FDADC12VDetAvg}, {implementation-record-element=CAN3_FDADC12VDet, system-signal=CAN3_FDADC12VDet}]}
      MAP_HALOUTP_CAN3_FD3_VCU1: sender-receiver-to-signal-group-mapping{communication-direction=OUT, data-element=SWC_HALOUT.root_FDC.P_CAN3_FD3_VCU1.CAN3_SG_FD3_VCU1, signal-group=CAN3_SG_FD3_VCU1, type-mapping=sender-rec-record-type-mapping=record-element-mappings=[{implementation-record-element=CAN3_APS_Sta_System, system-signal=CAN3_APS_Sta_System}, {implementation-record-element=CAN3_ShiftGearPosn, system-signal=CAN3_ShiftGearPosn}, {implementation-record-element=CAN3_RC_VCU1, system-signal=CAN3_RC_VCU1}, {implementation-record-element=CAN3_PwrSta, system-signal=CAN3_PwrSta}, {implementation-record-element=CAN3_PrkReqValid, system-signal=CAN3_PrkReqValid}, {implementation-record-element=CAN3_PrkReq, system-signal=CAN3_PrkReq}, {implementation-record-element=CAN3_P_Button_Sta, system-signal=CAN3_P_Button_Sta}, {implementation-record-element=CAN3_MSA_Crl_Sta, system-signal=CAN3_MSA_Crl_Sta}, {implementation-record-element=CAN3_LVChrgFuncStaChk, system-signal=CAN3_LVChrgFuncStaChk}, {implementation-record-element=CAN3_HVSysReadyToCharge, system-signal=CAN3_HVSysReadyToCharge}, {implementation-record-element=CAN3_HVBatCnctReq, system-signal=CAN3_HVBatCnctReq}, {implementation-record-element=CAN3_DynoModeStaChk, system-signal=CAN3_DynoModeStaChk}, {implementation-record-element=CAN3_Dr_SeatSta, system-signal=CAN3_Dr_SeatSta}, {implementation-record-element=CAN3_DemoModeStaChk, system-signal=CAN3_DemoModeStaChk}, {implementation-record-element=CAN3_DCDCVoltSetpoint, system-signal=CAN3_DCDCVoltSetpoint}, {implementation-record-element=CAN3_DCDCEnaReq, system-signal=CAN3_DCDCEnaReq}, {implementation-record-element=CAN3_CoastDwModeStaChk, system-signal=CAN3_CoastDwModeStaChk}, {implementation-record-element=CAN3_CS_VCU1, system-signal=CAN3_CS_VCU1}, {implementation-record-element=CAN3_ActiveDischReq, system-signal=CAN3_ActiveDischReq}]}
      MAP_HALOUTP_CAN3_FD3_VCU1_toNIDEC: sender-receiver-to-signal-group-mapping{communication-direction=OUT, data-element=SWC_HALOUT.root_FDC.P_CAN3_FD3_VCU1_toNIDEC.CAN3_SG_FD3_VCU1_toNIDEC, signal-group=CAN3_SG_FD3_VCU1_toNIDEC, type-mapping=sender-rec-record-type-mapping=record-element-mappings=[{implementation-record-element=CAN3_ActiveDischReq_toNidec, system-signal=CAN3_ActiveDischReq_toNidec}, {implementation-record-element=CAN3_ShiftGearPosn_toNidec, system-signal=CAN3_ShiftGearPosn_toNidec}, {implementation-record-element=CAN3_Rr_MCUEnaReq_toNidec, system-signal=CAN3_Rr_MCUEnaReq_toNidec}, {implementation-record-element=CAN3_Rr_ActvDmpDisabReq_toNidec, system-signal=CAN3_Rr_ActvDmpDisabReq_toNidec}, {implementation-record-element=CAN3_RC_VCU1_toNidec, system-signal=CAN3_RC_VCU1_toNidec}, {implementation-record-element=CAN3_PwrSta_toNidec, system-signal=CAN3_PwrSta_toNidec}, {implementation-record-element=CAN3_PrkReq_toNidec, system-signal=CAN3_PrkReq_toNidec}, {implementation-record-element=CAN3_MSA_Crl_Sta_toNidec, system-signal=CAN3_MSA_Crl_Sta_toNidec}, {implementation-record-element=CAN3_LVChrgFuncStaChk_toNidec, system-signal=CAN3_LVChrgFuncStaChk_toNidec}, {implementation-record-element=CAN3_HVSysReadyToCharge_toNidec, system-signal=CAN3_HVSysReadyToCharge_toNidec}, {implementation-record-element=CAN3_HVBatCnctReq_toNidec, system-signal=CAN3_HVBatCnctReq_toNidec}, {implementation-record-element=CAN3_Fr_MCUEnaReq_toNidec, system-signal=CAN3_Fr_MCUEnaReq_toNidec}, {implementation-record-element=CAN3_Fr_ActvDmpDisabReq_toNidec, system-signal=CAN3_Fr_ActvDmpDisabReq_toNidec}, {implementation-record-element=CAN3_DynoModeStaChk_toNidec, system-signal=CAN3_DynoModeStaChk_toNidec}, {implementation-record-element=CAN3_Dr_SeatSta_toNidec, system-signal=CAN3_Dr_SeatSta_toNidec}, {implementation-record-element=CAN3_DemoModeStaChk_toNidec, system-signal=CAN3_DemoModeStaChk_toNidec}, {implementation-record-element=CAN3_DCDCVoltSetpoint_toNidec, system-signal=CAN3_DCDCVoltSetpoint_toNidec}, {implementation-record-element=CAN3_DCDCEnaReq_toNidec, system-signal=CAN3_DCDCEnaReq_toNidec}, {implementation-record-element=CAN3_CoastDwModeStaChk_toNidec, system-signal=CAN3_CoastDwModeStaChk_toNidec}, {implementation-record-element=CAN3_CS_VCU1_toNidec, system-signal=CAN3_CS_VCU1_toNidec}]}
      MAP_HALOUTP_CAN3_FD3_VCU2: sender-receiver-to-signal-group-mapping{communication-direction=OUT, data-element=SWC_HALOUT.root_FDC.P_CAN3_FD3_VCU2.CAN3_SG_FD3_VCU2, signal-group=CAN3_SG_FD3_VCU2, type-mapping=sender-rec-record-type-mapping=record-element-mappings=[{implementation-record-element=CAN3_CS_VCU2_CAN1, system-signal=CAN3_CS_VCU2_CAN1}, {implementation-record-element=CAN3_Rr_UdcMin, system-signal=CAN3_Rr_UdcMin}, {implementation-record-element=CAN3_Rr_UdcMax, system-signal=CAN3_Rr_UdcMax}, {implementation-record-element=CAN3_Rr_TorqMin, system-signal=CAN3_Rr_TorqMin}, {implementation-record-element=CAN3_Rr_TorqMax, system-signal=CAN3_Rr_TorqMax}, {implementation-record-element=CAN3_Rr_TMTqReq, system-signal=CAN3_Rr_TMTqReq}, {implementation-record-element=CAN3_Rr_MCUEnaReq, system-signal=CAN3_Rr_MCUEnaReq}, {implementation-record-element=CAN3_Rr_IdcMin, system-signal=CAN3_Rr_IdcMin}, {implementation-record-element=CAN3_Rr_IdcMax, system-signal=CAN3_Rr_IdcMax}, {implementation-record-element=CAN3_Rr_ActvDmpDisabReq, system-signal=CAN3_Rr_ActvDmpDisabReq}, {implementation-record-element=CAN3_RC_VCU2_CAN1, system-signal=CAN3_RC_VCU2_CAN1}, {implementation-record-element=CAN3_Fr_UdcMin, system-signal=CAN3_Fr_UdcMin}, {implementation-record-element=CAN3_Fr_UdcMax, system-signal=CAN3_Fr_UdcMax}, {implementation-record-element=CAN3_Fr_TorqMin, system-signal=CAN3_Fr_TorqMin}, {implementation-record-element=CAN3_Fr_TorqMax, system-signal=CAN3_Fr_TorqMax}, {implementation-record-element=CAN3_Fr_TMTqReq, system-signal=CAN3_Fr_TMTqReq}, {implementation-record-element=CAN3_Fr_MCUEnaReq, system-signal=CAN3_Fr_MCUEnaReq}, {implementation-record-element=CAN3_Fr_IdcMin, system-signal=CAN3_Fr_IdcMin}, {implementation-record-element=CAN3_Fr_IdcMax, system-signal=CAN3_Fr_IdcMax}, {implementation-record-element=CAN3_Fr_ActvDmpDisabReq, system-signal=CAN3_Fr_ActvDmpDisabReq}]}
      MAP_HALOUTP_CAN3_FD3_VCU2_toNIDEC: sender-receiver-to-signal-group-mapping{communication-direction=OUT, data-element=SWC_HALOUT.root_FDC.P_CAN3_FD3_VCU2_toNIDEC.CAN3_SG_FD3_VCU2_toNIDEC, signal-group=CAN3_SG_FD3_VCU2_toNIDEC, type-mapping=sender-rec-record-type-mapping=record-element-mappings=[{implementation-record-element=CAN3_CS_VCU2_CAN1_toNidec, system-signal=CAN3_CS_VCU2_CAN1_toNidec}, {implementation-record-element=CAN3_Rr_UdcMin_toNidec, system-signal=CAN3_Rr_UdcMin_toNidec}, {implementation-record-element=CAN3_Rr_UdcMax_toNidec, system-signal=CAN3_Rr_UdcMax_toNidec}, {implementation-record-element=CAN3_Rr_TorqMin_toNidec, system-signal=CAN3_Rr_TorqMin_toNidec}, {implementation-record-element=CAN3_Rr_TorqMax_toNidec, system-signal=CAN3_Rr_TorqMax_toNidec}, {implementation-record-element=CAN3_Rr_TMTqReq_toNidec, system-signal=CAN3_Rr_TMTqReq_toNidec}, {implementation-record-element=CAN3_Rr_IdcMin_toNidec, system-signal=CAN3_Rr_IdcMin_toNidec}, {implementation-record-element=CAN3_Rr_IdcMax_toNidec, system-signal=CAN3_Rr_IdcMax_toNidec}, {implementation-record-element=CAN3_RC_VCU2_CAN1_toNidec, system-signal=CAN3_RC_VCU2_CAN1_toNidec}, {implementation-record-element=CAN3_Fr_UdcMin_toNidec, system-signal=CAN3_Fr_UdcMin_toNidec}, {implementation-record-element=CAN3_Fr_UdcMax_toNidec, system-signal=CAN3_Fr_UdcMax_toNidec}, {implementation-record-element=CAN3_Fr_TorqMin_toNidec, system-signal=CAN3_Fr_TorqMin_toNidec}, {implementation-record-element=CAN3_Fr_TorqMax_toNidec, system-signal=CAN3_Fr_TorqMax_toNidec}, {implementation-record-element=CAN3_Fr_TMTqReq_toNidec, system-signal=CAN3_Fr_TMTqReq_toNidec}, {implementation-record-element=CAN3_Fr_IdcMin_toNidec, system-signal=CAN3_Fr_IdcMin_toNidec}, {implementation-record-element=CAN3_Fr_IdcMax_toNidec, system-signal=CAN3_Fr_IdcMax_toNidec}]}
      MAP_HALOUTP_CAN3_FD3_VCU5: sender-receiver-to-signal-group-mapping{communication-direction=OUT, data-element=SWC_HALOUT.root_FDC.P_CAN3_FD3_VCU5.CAN3_SG_FD3_VCU5, signal-group=CAN3_SG_FD3_VCU5, type-mapping=sender-rec-record-type-mapping=record-element-mappings=[{implementation-record-element=CAN3_ActAPSPosn, system-signal=CAN3_ActAPSPosn}, {implementation-record-element=CAN3_Rr_EDUSpdValid, system-signal=CAN3_Rr_EDUSpdValid}, {implementation-record-element=CAN3_Rr_EDUSpd, system-signal=CAN3_Rr_EDUSpd}, {implementation-record-element=CAN3_Fr_EDUSpdValid, system-signal=CAN3_Fr_EDUSpdValid}, {implementation-record-element=CAN3_Fr_EDUSpd, system-signal=CAN3_Fr_EDUSpd}, {implementation-record-element=CAN3_FDC_VCU_RrTqMin_Req, system-signal=CAN3_FDC_VCU_RrTqMin_Req}, {implementation-record-element=CAN3_FDC_VCU_RrTqMax_Req, system-signal=CAN3_FDC_VCU_RrTqMax_Req}, {implementation-record-element=CAN3_FDC_VCU_RrTMTq_Req, system-signal=CAN3_FDC_VCU_RrTMTq_Req}, {implementation-record-element=CAN3_FDC_VCU_RrTMSpd_Req, system-signal=CAN3_FDC_VCU_RrTMSpd_Req}, {implementation-record-element=CAN3_FDC_VCU_RrTMCtrlMode_Req, system-signal=CAN3_FDC_VCU_RrTMCtrlMode_Req}, {implementation-record-element=CAN3_FDC_VCU_RrSpdMin_Req, system-signal=CAN3_FDC_VCU_RrSpdMin_Req}, {implementation-record-element=CAN3_FDC_VCU_RrSpdMax_Req, system-signal=CAN3_FDC_VCU_RrSpdMax_Req}, {implementation-record-element=CAN3_FDC_VCU_FrTqMin_Req, system-signal=CAN3_FDC_VCU_FrTqMin_Req}, {implementation-record-element=CAN3_FDC_VCU_FrTqMax_Req, system-signal=CAN3_FDC_VCU_FrTqMax_Req}, {implementation-record-element=CAN3_FDC_VCU_FrTMTq_Req, system-signal=CAN3_FDC_VCU_FrTMTq_Req}, {implementation-record-element=CAN3_FDC_VCU_FrTMSpd_Req, system-signal=CAN3_FDC_VCU_FrTMSpd_Req}, {implementation-record-element=CAN3_FDC_VCU_FrTMCtrlMode_Req, system-signal=CAN3_FDC_VCU_FrTMCtrlMode_Req}, {implementation-record-element=CAN3_FDC_VCU_FrSpdMin_Req, system-signal=CAN3_FDC_VCU_FrSpdMin_Req}, {implementation-record-element=CAN3_FDC_VCU_FrSpdMax_Req, system-signal=CAN3_FDC_VCU_FrSpdMax_Req}]}
      MAP_HALOUTP_CAN3_GW_ESC1_toNIDEC: sender-receiver-to-signal-group-mapping{communication-direction=OUT, data-element=SWC_HALOUT.root_FDC.P_CAN3_GW_ESC1_toNIDEC.CAN3_SG_GW_ESC1_toNIDEC, signal-group=CAN3_SG_GW_ESC1_toNIDEC, type-mapping=sender-rec-record-type-mapping=sender-rec-record-element-mapping{implementation-record-element=CAN3_VehSpeed_toNidec, system-signal=CAN3_VehSpeed_toNidec}}
      MAP_HALOUTP_CAN3_GW_IVI6_toNIDEC: sender-receiver-to-signal-group-mapping{communication-direction=OUT, data-element=SWC_HALOUT.root_FDC.P_CAN3_GW_IVI6_toNIDEC.CAN3_SG_GW_IVI6_toNIDEC, signal-group=CAN3_SG_GW_IVI6_toNIDEC, type-mapping=sender-rec-record-type-mapping=record-element-mappings=[{implementation-record-element=CAN3_IVI_Time_Day_toNidec, system-signal=CAN3_IVI_Time_Day_toNidec}, {implementation-record-element=CAN3_IVI_Time_Second_toNidec, system-signal=CAN3_IVI_Time_Second_toNidec}, {implementation-record-element=CAN3_IVI_Time_Month_toNidec, system-signal=CAN3_IVI_Time_Month_toNidec}, {implementation-record-element=CAN3_IVI_Time_Minute_toNidec, system-signal=CAN3_IVI_Time_Minute_toNidec}, {implementation-record-element=CAN3_IVI_Time_Hour_toNidec, system-signal=CAN3_IVI_Time_Hour_toNidec}]}
      MAP_HALOUTP_CAN4_FD4_CE100_0: sender-receiver-to-signal-group-mapping{communication-direction=OUT, data-element=SWC_HALOUT.root_FDC.P_CAN4_FD4_CE100_0.CAN4_SG_FD4_CE100_0, signal-group=CAN4_SG_FD4_CE100_0, type-mapping=sender-rec-record-type-mapping=record-element-mappings=[{implementation-record-element=CAN4_APS_Sta_System, system-signal=CAN4_APS_Sta_System}, {implementation-record-element=CAN4_WiperFixMode, system-signal=CAN4_WiperFixMode}, {implementation-record-element=CAN4_WasherCtrl, system-signal=CAN4_WasherCtrl}, {implementation-record-element=CAN4_TrunkRel, system-signal=CAN4_TrunkRel}, {implementation-record-element=CAN4_TimeSNDKCFbk, system-signal=CAN4_TimeSNDKCFbk}, {implementation-record-element=CAN4_Tailgate_SW, system-signal=CAN4_Tailgate_SW}, {implementation-record-element=CAN4_TailgateRemote, system-signal=CAN4_TailgateRemote}, {implementation-record-element=CAN4_TailgateHDSW, system-signal=CAN4_TailgateHDSW}, {implementation-record-element=CAN4_ShiftGearPosn, system-signal=CAN4_ShiftGearPosn}, {implementation-record-element=CAN4_Rr_Wiper, system-signal=CAN4_Rr_Wiper}, {implementation-record-element=CAN4_Rr_FogLamp, system-signal=CAN4_Rr_FogLamp}, {implementation-record-element=CAN4_Rr_Defog, system-signal=CAN4_Rr_Defog}, {implementation-record-element=CAN4_Rr_ChargingDoorCtrl, system-signal=CAN4_Rr_ChargingDoorCtrl}, {implementation-record-element=CAN4_RoomLampL, system-signal=CAN4_RoomLampL}, {implementation-record-element=CAN4_RoomLampH, system-signal=CAN4_RoomLampH}, {implementation-record-element=CAN4_ReverseLamp, system-signal=CAN4_ReverseLamp}, {implementation-record-element=CAN4_ReBrakeLPReq, system-signal=CAN4_ReBrakeLPReq}, {implementation-record-element=CAN4_RTurnLP, system-signal=CAN4_RTurnLP}, {implementation-record-element=CAN4_RRDoorSW, system-signal=CAN4_RRDoorSW}, {implementation-record-element=CAN4_RLDoorSW, system-signal=CAN4_RLDoorSW}, {implementation-record-element=CAN4_RDRL, system-signal=CAN4_RDRL}, {implementation-record-element=CAN4_RC_VCU1_CAN4, system-signal=CAN4_RC_VCU1_CAN4}, {implementation-record-element=CAN4_RBSD, system-signal=CAN4_RBSD}, {implementation-record-element=CAN4_PwrSta, system-signal=CAN4_PwrSta}, {implementation-record-element=CAN4_PsDoorSW, system-signal=CAN4_PsDoorSW}, {implementation-record-element=CAN4_PosLamp, system-signal=CAN4_PosLamp}, {implementation-record-element=CAN4_MirrorDefog, system-signal=CAN4_MirrorDefog}, {implementation-record-element=CAN4_MirrorCtrl, system-signal=CAN4_MirrorCtrl}, {implementation-record-element=CAN4_MSA_Crl_Sta, system-signal=CAN4_MSA_Crl_Sta}, {implementation-record-element=CAN4_LockSetting, system-signal=CAN4_LockSetting}, {implementation-record-element=CAN4_LampPwr, system-signal=CAN4_LampPwr}, {implementation-record-element=CAN4_L_Beam, system-signal=CAN4_L_Beam}, {implementation-record-element=CAN4_L_APM_WdwEnable, system-signal=CAN4_L_APM_WdwEnable}, {implementation-record-element=CAN4_LTurnLP, system-signal=CAN4_LTurnLP}, {implementation-record-element=CAN4_LDRL, system-signal=CAN4_LDRL}, {implementation-record-element=CAN4_LBSD, system-signal=CAN4_LBSD}, {implementation-record-element=CAN4_HornCtrl, system-signal=CAN4_HornCtrl}, {implementation-record-element=CAN4_HoodSW, system-signal=CAN4_HoodSW}, {implementation-record-element=CAN4_HazardSW, system-signal=CAN4_HazardSW}, {implementation-record-element=CAN4_H_Beam_ADB, system-signal=CAN4_H_Beam_ADB}, {implementation-record-element=CAN4_H_Beam, system-signal=CAN4_H_Beam}, {implementation-record-element=CAN4_HWResetSta, system-signal=CAN4_HWResetSta}, {implementation-record-element=CAN4_Fr_Wiper_L, system-signal=CAN4_Fr_Wiper_L}, {implementation-record-element=CAN4_Fr_Wiper_H, system-signal=CAN4_Fr_Wiper_H}, {implementation-record-element=CAN4_Fr_FogLamp, system-signal=CAN4_Fr_FogLamp}, {implementation-record-element=CAN4_Fr_ChargingDoorCtrl, system-signal=CAN4_Fr_ChargingDoorCtrl}, {implementation-record-element=CAN4_FD_TBOX_VehData_Sta, system-signal=CAN4_FD_TBOX_VehData_Sta}, {implementation-record-element=CAN4_FD_TBOX_VehData_Err, system-signal=CAN4_FD_TBOX_VehData_Err}, {implementation-record-element=CAN4_FD_TBOX_DTCData_Sta, system-signal=CAN4_FD_TBOX_DTCData_Sta}, {implementation-record-element=CAN4_FD_TBOX_DTCData_Err, system-signal=CAN4_FD_TBOX_DTCData_Err}, {implementation-record-element=CAN4_FD_DKC_VehData_Sta, system-signal=CAN4_FD_DKC_VehData_Sta}, {implementation-record-element=CAN4_FD_DKC_VehData_Err, system-signal=CAN4_FD_DKC_VehData_Err}, {implementation-record-element=CAN4_FDC_VMC_VehPitchAngle_Sta, system-signal=CAN4_FDC_VMC_VehPitchAngle_Sta}, {implementation-record-element=CAN4_EquivAccPedalSWSta, system-signal=CAN4_EquivAccPedalSWSta}, {implementation-record-element=CAN4_Dr_SeatSta, system-signal=CAN4_Dr_SeatSta}, {implementation-record-element=CAN4_DrDoorSW, system-signal=CAN4_DrDoorSW}, {implementation-record-element=CAN4_DoorLockIND, system-signal=CAN4_DoorLockIND}, {implementation-record-element=CAN4_DimmerEN, system-signal=CAN4_DimmerEN}, {implementation-record-element=CAN4_Dimmer, system-signal=CAN4_Dimmer}, {implementation-record-element=CAN4_DKCTimeSN, system-signal=CAN4_DKCTimeSN}, {implementation-record-element=CAN4_DKCAuthSta, system-signal=CAN4_DKCAuthSta}, {implementation-record-element=CAN4_CtrlFrPwrStbA1P, system-signal=CAN4_CtrlFrPwrStbA1P}, {implementation-record-element=CAN4_CtrlFrIRC1, system-signal=CAN4_CtrlFrIRC1}, {implementation-record-element=CAN4_CtrlFrEDUINVERTER, system-signal=CAN4_CtrlFrEDUINVERTER}, {implementation-record-element=CAN4_CtrlFrBMSCCUCIR, system-signal=CAN4_CtrlFrBMSCCUCIR}, {implementation-record-element=CAN4_CtrlDrPwrStbA2, system-signal=CAN4_CtrlDrPwrStbA2}, {implementation-record-element=CAN4_CrashDetd, system-signal=CAN4_CrashDetd}, {implementation-record-element=CAN4_CTDUnlockSW, system-signal=CAN4_CTDUnlockSW}, {implementation-record-element=CAN4_CTDLockSW, system-signal=CAN4_CTDLockSW}, {implementation-record-element=CAN4_CTDCtrl, system-signal=CAN4_CTDCtrl}, {implementation-record-element=CAN4_CS_VCU1_CAN4, system-signal=CAN4_CS_VCU1_CAN4}, {implementation-record-element=CAN4_CC_Crl_Sta, system-signal=CAN4_CC_Crl_Sta}, {implementation-record-element=CAN4_BrakeLamp, system-signal=CAN4_BrakeLamp}, {implementation-record-element=CAN4_BCM_DoorLock_Sta, system-signal=CAN4_BCM_DoorLock_Sta}, {implementation-record-element=CAN4_AntitheftSta, system-signal=CAN4_AntitheftSta}, {implementation-record-element=CAN4_AntiTheftSeatFold, system-signal=CAN4_AntiTheftSeatFold}, {implementation-record-element=CAN4_AllDoorSW, system-signal=CAN4_AllDoorSW}]}
      MAP_HALOUTP_CAN4_FD4_CE100_1: sender-receiver-to-signal-group-mapping{communication-direction=OUT, data-element=SWC_HALOUT.root_FDC.P_CAN4_FD4_CE100_1.CAN4_SG_FD4_CE100_1, signal-group=CAN4_SG_FD4_CE100_1, type-mapping=sender-rec-record-type-mapping=record-element-mappings=[{implementation-record-element=CAN4_ACSubMode, system-signal=CAN4_ACSubMode}, {implementation-record-element=CAN4_sigWindDirZon3St, system-signal=CAN4_sigWindDirZon3St}, {implementation-record-element=CAN4_sigWindDirZon1St, system-signal=CAN4_sigWindDirZon1St}, {implementation-record-element=CAN4_sigSetTempZon3St, system-signal=CAN4_sigSetTempZon3St}, {implementation-record-element=CAN4_sigSetTempZon2St, system-signal=CAN4_sigSetTempZon2St}, {implementation-record-element=CAN4_sigSetTempZon1St, system-signal=CAN4_sigSetTempZon1St}, {implementation-record-element=CAN4_sigRecircSt, system-signal=CAN4_sigRecircSt}, {implementation-record-element=CAN4_sigHvacSt, system-signal=CAN4_sigHvacSt}, {implementation-record-element=CAN4_sigDfrstSt, system-signal=CAN4_sigDfrstSt}, {implementation-record-element=CAN4_sigClntTHvBattOut, system-signal=CAN4_sigClntTHvBattOut}, {implementation-record-element=CAN4_sigClmtCmprPwrAct, system-signal=CAN4_sigClmtCmprPwrAct}, {implementation-record-element=CAN4_sigCbnSolarRight, system-signal=CAN4_sigCbnSolarRight}, {implementation-record-element=CAN4_sigCbnSolarLeft, system-signal=CAN4_sigCbnSolarLeft}, {implementation-record-element=CAN4_sigCbnPTCPwrAct, system-signal=CAN4_sigCbnPTCPwrAct}, {implementation-record-element=CAN4_sigCbnAirT, system-signal=CAN4_sigCbnAirT}, {implementation-record-element=CAN4_sigAmbAirT, system-signal=CAN4_sigAmbAirT}, {implementation-record-element=CAN4_sigAirIntenZon3St, system-signal=CAN4_sigAirIntenZon3St}, {implementation-record-element=CAN4_sigAirIntenZon1St, system-signal=CAN4_sigAirIntenZon1St}, {implementation-record-element=CAN4_Rr_Coolanttemp, system-signal=CAN4_Rr_Coolanttemp}, {implementation-record-element=CAN4_Rr_Coolantflow, system-signal=CAN4_Rr_Coolantflow}, {implementation-record-element=CAN4_HPThermalRecoveryReq, system-signal=CAN4_HPThermalRecoveryReq}, {implementation-record-element=CAN4_Fr_Coolanttemp, system-signal=CAN4_Fr_Coolanttemp}, {implementation-record-element=CAN4_Fr_Coolantflow, system-signal=CAN4_Fr_Coolantflow}, {implementation-record-element=CAN4_FD_TWV_Cmd, system-signal=CAN4_FD_TWV_Cmd}, {implementation-record-element=CAN4_FD_SOV3_Cmd, system-signal=CAN4_FD_SOV3_Cmd}, {implementation-record-element=CAN4_FD_SOV2_Cmd, system-signal=CAN4_FD_SOV2_Cmd}, {implementation-record-element=CAN4_FD_SOV1_Cmd, system-signal=CAN4_FD_SOV1_Cmd}, {implementation-record-element=CAN4_FD_SOTXV_Cmd, system-signal=CAN4_FD_SOTXV_Cmd}, {implementation-record-element=CAN4_FD_RrAPTCHeatPwr_Cmd, system-signal=CAN4_FD_RrAPTCHeatPwr_Cmd}, {implementation-record-element=CAN4_FD_RecyAuto_Cmd, system-signal=CAN4_FD_RecyAuto_Cmd}, {implementation-record-element=CAN4_FD_FrWPTCHeatPwr_Cmd, system-signal=CAN4_FD_FrWPTCHeatPwr_Cmd}, {implementation-record-element=CAN4_FD_FrRiAPTCHeatPwr_Cmd, system-signal=CAN4_FD_FrRiAPTCHeatPwr_Cmd}, {implementation-record-element=CAN4_FD_FrLeAPTCHeatPwr_Cmd, system-signal=CAN4_FD_FrLeAPTCHeatPwr_Cmd}, {implementation-record-element=CAN4_FD_FWV_Cmd, system-signal=CAN4_FD_FWV_Cmd}, {implementation-record-element=CAN4_FD_EXV2_Cmd, system-signal=CAN4_FD_EXV2_Cmd}, {implementation-record-element=CAN4_FD_EXV1_Cmd, system-signal=CAN4_FD_EXV1_Cmd}, {implementation-record-element=CAN4_FD_EWP3_Cmd, system-signal=CAN4_FD_EWP3_Cmd}, {implementation-record-element=CAN4_FD_EWP2_Cmd, system-signal=CAN4_FD_EWP2_Cmd}, {implementation-record-element=CAN4_FD_EWP1_Cmd, system-signal=CAN4_FD_EWP1_Cmd}, {implementation-record-element=CAN4_FD_Comp_Cmd, system-signal=CAN4_FD_Comp_Cmd}, {implementation-record-element=CAN4_FD_Blower_Cmd, system-signal=CAN4_FD_Blower_Cmd}, {implementation-record-element=CAN4_FD_AGS_Cmd, system-signal=CAN4_FD_AGS_Cmd}, {implementation-record-element=CAN4_FDC_THCM_RVent_Sta, system-signal=CAN4_FDC_THCM_RVent_Sta}, {implementation-record-element=CAN4_FDC_THCM_REVentZ_Sta, system-signal=CAN4_FDC_THCM_REVentZ_Sta}, {implementation-record-element=CAN4_FDC_THCM_REVentY_Sta, system-signal=CAN4_FDC_THCM_REVentY_Sta}, {implementation-record-element=CAN4_FDC_THCM_REVentMode_Sta, system-signal=CAN4_FDC_THCM_REVentMode_Sta}, {implementation-record-element=CAN4_FDC_THCM_LVent_Sta, system-signal=CAN4_FDC_THCM_LVent_Sta}, {implementation-record-element=CAN4_FDC_THCM_LEVentZ_Sta, system-signal=CAN4_FDC_THCM_LEVentZ_Sta}, {implementation-record-element=CAN4_FDC_THCM_LEVentY_Sta, system-signal=CAN4_FDC_THCM_LEVentY_Sta}, {implementation-record-element=CAN4_FDC_THCM_LEVentMode_Sta, system-signal=CAN4_FDC_THCM_LEVentMode_Sta}, {implementation-record-element=CAN4_FDC_THCM_CRVent_Sta, system-signal=CAN4_FDC_THCM_CRVent_Sta}, {implementation-record-element=CAN4_FDC_THCM_CREVentZ_Sta, system-signal=CAN4_FDC_THCM_CREVentZ_Sta}, {implementation-record-element=CAN4_FDC_THCM_CREVentY_Sta, system-signal=CAN4_FDC_THCM_CREVentY_Sta}, {implementation-record-element=CAN4_FDC_THCM_CLVent_Sta, system-signal=CAN4_FDC_THCM_CLVent_Sta}, {implementation-record-element=CAN4_FDC_THCM_CLEVentZ_Sta, system-signal=CAN4_FDC_THCM_CLEVentZ_Sta}, {implementation-record-element=CAN4_FDC_THCM_CLEVentY_Sta, system-signal=CAN4_FDC_THCM_CLEVentY_Sta}, {implementation-record-element=CAN4_EDriveMode, system-signal=CAN4_EDriveMode}, {implementation-record-element=CAN4_DeiceModReq, system-signal=CAN4_DeiceModReq}, {implementation-record-element=CAN4_CoolgFanActDuty, system-signal=CAN4_CoolgFanActDuty}, {implementation-record-element=CAN4_CabinMode, system-signal=CAN4_CabinMode}, {implementation-record-element=CAN4_CCU_SyncLampSts, system-signal=CAN4_CCU_SyncLampSts}, {implementation-record-element=CAN4_CCU_RrOnOffLampSts, system-signal=CAN4_CCU_RrOnOffLampSts}, {implementation-record-element=CAN4_CCU_HiVoltageReq, system-signal=CAN4_CCU_HiVoltageReq}, {implementation-record-element=CAN4_CCU_HEATMaxLampSts, system-signal=CAN4_CCU_HEATMaxLampSts}, {implementation-record-element=CAN4_CCU_FrtOnOffLampSts, system-signal=CAN4_CCU_FrtOnOffLampSts}, {implementation-record-element=CAN4_CCU_EcoSts, system-signal=CAN4_CCU_EcoSts}, {implementation-record-element=CAN4_CCU_Dispaly_Request, system-signal=CAN4_CCU_Dispaly_Request}, {implementation-record-element=CAN4_CCU_CbnPreSts, system-signal=CAN4_CCU_CbnPreSts}, {implementation-record-element=CAN4_CCU_CbnPreEstimdTi, system-signal=CAN4_CCU_CbnPreEstimdTi}, {implementation-record-element=CAN4_CCU_CbnPreACWkSts, system-signal=CAN4_CCU_CbnPreACWkSts}, {implementation-record-element=CAN4_CCU_AutoMidLampSts, system-signal=CAN4_CCU_AutoMidLampSts}, {implementation-record-element=CAN4_CCU_AutoLampSts, system-signal=CAN4_CCU_AutoLampSts}, {implementation-record-element=CAN4_CCU_ACMaxLampSts, system-signal=CAN4_CCU_ACMaxLampSts}, {implementation-record-element=CAN4_CCU_ACLampSts, system-signal=CAN4_CCU_ACLampSts}, {implementation-record-element=CAN4_BatteryMode, system-signal=CAN4_BatteryMode}, {implementation-record-element=CAN4_BatLoopActWtFlw, system-signal=CAN4_BatLoopActWtFlw}, {implementation-record-element=CAN4_APTC_ActFrRiPwr, system-signal=CAN4_APTC_ActFrRiPwr}]}
      MAP_HALOUTP_CAN4_FD4_CE200_0: sender-receiver-to-signal-group-mapping{communication-direction=OUT, data-element=SWC_HALOUT.root_FDC.P_CAN4_FD4_CE200_0.CAN4_SG_FD4_CE200_0, signal-group=CAN4_SG_FD4_CE200_0, type-mapping=sender-rec-record-type-mapping=record-element-mappings=[{implementation-record-element=CAN4_AmbLightBreath1, system-signal=CAN4_AmbLightBreath1}, {implementation-record-element=CAN4_WelcomeLight, system-signal=CAN4_WelcomeLight}, {implementation-record-element=CAN4_FDC_V2L_HVPOLEDSts_Cmd, system-signal=CAN4_FDC_V2L_HVPOLEDSts_Cmd}, {implementation-record-element=CAN4_FDC_V2L_HVPOBklgting_Cmd, system-signal=CAN4_FDC_V2L_HVPOBklgting_Cmd}, {implementation-record-element=CAN4_FDC_THCM_AirIntZ3_Sta, system-signal=CAN4_FDC_THCM_AirIntZ3_Sta}, {implementation-record-element=CAN4_FDC_THCM_ACTInitial_Cmd, system-signal=CAN4_FDC_THCM_ACTInitial_Cmd}, {implementation-record-element=CAN4_FDC_FGS_ION_Cmd, system-signal=CAN4_FDC_FGS_ION_Cmd}, {implementation-record-element=CAN4_FDC_FGS_FuncSta_Cmd, system-signal=CAN4_FDC_FGS_FuncSta_Cmd}, {implementation-record-element=CAN4_FDC_FGS_FGSCh_Cmd, system-signal=CAN4_FDC_FGS_FGSCh_Cmd}, {implementation-record-element=CAN4_FDC_FGS_AirInt_Cmd, system-signal=CAN4_FDC_FGS_AirInt_Cmd}, {implementation-record-element=CAN4_FDC_DKC_SPTGOpen_Cmd, system-signal=CAN4_FDC_DKC_SPTGOpen_Cmd}, {implementation-record-element=CAN4_FDC_DKC_SPTGDet_Cmd, system-signal=CAN4_FDC_DKC_SPTGDet_Cmd}, {implementation-record-element=CAN4_FDC_DKC_DKeyAreaPE_Sta, system-signal=CAN4_FDC_DKC_DKeyAreaPE_Sta}, {implementation-record-element=CAN4_FDC_DKC_CommandToBCM_Cmd, system-signal=CAN4_FDC_DKC_CommandToBCM_Cmd}, {implementation-record-element=CAN4_FDC_BCM_UserNow_Sta, system-signal=CAN4_FDC_BCM_UserNow_Sta}, {implementation-record-element=CAN4_FDC_BCM_UserHeightSet_Sta, system-signal=CAN4_FDC_BCM_UserHeightSet_Sta}, {implementation-record-element=CAN4_FDC_BCM_TurnSw_Sta, system-signal=CAN4_FDC_BCM_TurnSw_Sta}, {implementation-record-element=CAN4_FDC_BCM_TurnSwTSetSta_Sta, system-signal=CAN4_FDC_BCM_TurnSwTSetSta_Sta}, {implementation-record-element=CAN4_FDC_BCM_SettingUpdateReq_Cmd, system-signal=CAN4_FDC_BCM_SettingUpdateReq_Cmd}, {implementation-record-element=CAN4_FDC_BCM_RPSDCtrl_Cmd, system-signal=CAN4_FDC_BCM_RPSDCtrl_Cmd}, {implementation-record-element=CAN4_FDC_BCM_PsRWdwReqAP_Sta, system-signal=CAN4_FDC_BCM_PsRWdwReqAP_Sta}, {implementation-record-element=CAN4_FDC_BCM_PassSW_Sta, system-signal=CAN4_FDC_BCM_PassSW_Sta}, {implementation-record-element=CAN4_FDC_BCM_PasWdwReqAP_Sta, system-signal=CAN4_FDC_BCM_PasWdwReqAP_Sta}, {implementation-record-element=CAN4_FDC_BCM_PTGOpenHeight_Sta, system-signal=CAN4_FDC_BCM_PTGOpenHeight_Sta}, {implementation-record-element=CAN4_FDC_BCM_OutMode_Cmd, system-signal=CAN4_FDC_BCM_OutMode_Cmd}, {implementation-record-element=CAN4_FDC_BCM_OtHandleLamp_Cmd, system-signal=CAN4_FDC_BCM_OtHandleLamp_Cmd}, {implementation-record-element=CAN4_FDC_BCM_LockAlarm_Cmd, system-signal=CAN4_FDC_BCM_LockAlarm_Cmd}, {implementation-record-element=CAN4_FDC_BCM_LPSDCtrl_Cmd, system-signal=CAN4_FDC_BCM_LPSDCtrl_Cmd}, {implementation-record-element=CAN4_FDC_BCM_HoodRel_Cmd, system-signal=CAN4_FDC_BCM_HoodRel_Cmd}, {implementation-record-element=CAN4_FDC_BCM_HazardIND_Cmd, system-signal=CAN4_FDC_BCM_HazardIND_Cmd}, {implementation-record-element=CAN4_FDC_BCM_HandleControl_Cmd, system-signal=CAN4_FDC_BCM_HandleControl_Cmd}, {implementation-record-element=CAN4_FDC_BCM_HBeamADB_Cmd, system-signal=CAN4_FDC_BCM_HBeamADB_Cmd}, {implementation-record-element=CAN4_FDC_BCM_FWipSw_Sta, system-signal=CAN4_FDC_BCM_FWipSw_Sta}, {implementation-record-element=CAN4_FDC_BCM_FWasSw_Sta, system-signal=CAN4_FDC_BCM_FWasSw_Sta}, {implementation-record-element=CAN4_FDC_BCM_DrvWdwReqAP_Sta, system-signal=CAN4_FDC_BCM_DrvWdwReqAP_Sta}, {implementation-record-element=CAN4_FDC_BCM_DrRWdwReqAP_Sta, system-signal=CAN4_FDC_BCM_DrRWdwReqAP_Sta}, {implementation-record-element=CAN4_FDC_BCM_DrHandleLamp_Cmd, system-signal=CAN4_FDC_BCM_DrHandleLamp_Cmd}, {implementation-record-element=CAN4_FDC_BCM_DimSw, system-signal=CAN4_FDC_BCM_DimSw}, {implementation-record-element=CAN4_FDC_BCM_DSEATentryfset_Sta, system-signal=CAN4_FDC_BCM_DSEATentryfset_Sta}, {implementation-record-element=CAN4_FDC_BCM_ATCtrl_Cmd, system-signal=CAN4_FDC_BCM_ATCtrl_Cmd}, {implementation-record-element=CAN4_BCM_Buzzer_Req, system-signal=CAN4_BCM_Buzzer_Req}, {implementation-record-element=CAN4_AmbLightColor6, system-signal=CAN4_AmbLightColor6}, {implementation-record-element=CAN4_AmbLightColor5, system-signal=CAN4_AmbLightColor5}, {implementation-record-element=CAN4_AmbLightColor4, system-signal=CAN4_AmbLightColor4}, {implementation-record-element=CAN4_AmbLightColor3, system-signal=CAN4_AmbLightColor3}, {implementation-record-element=CAN4_AmbLightColor2, system-signal=CAN4_AmbLightColor2}, {implementation-record-element=CAN4_AmbLightColor1, system-signal=CAN4_AmbLightColor1}, {implementation-record-element=CAN4_AmbLightBrightness6, system-signal=CAN4_AmbLightBrightness6}, {implementation-record-element=CAN4_AmbLightBrightness5, system-signal=CAN4_AmbLightBrightness5}, {implementation-record-element=CAN4_AmbLightBrightness4, system-signal=CAN4_AmbLightBrightness4}, {implementation-record-element=CAN4_AmbLightBrightness3, system-signal=CAN4_AmbLightBrightness3}, {implementation-record-element=CAN4_AmbLightBrightness2, system-signal=CAN4_AmbLightBrightness2}, {implementation-record-element=CAN4_AmbLightBrightness1, system-signal=CAN4_AmbLightBrightness1}, {implementation-record-element=CAN4_AmbLightBreath6, system-signal=CAN4_AmbLightBreath6}, {implementation-record-element=CAN4_AmbLightBreath5, system-signal=CAN4_AmbLightBreath5}, {implementation-record-element=CAN4_AmbLightBreath4, system-signal=CAN4_AmbLightBreath4}, {implementation-record-element=CAN4_AmbLightBreath3, system-signal=CAN4_AmbLightBreath3}, {implementation-record-element=CAN4_AmbLightBreath2, system-signal=CAN4_AmbLightBreath2}]}
      MAP_HALOUTP_CAN4_GW4_CE100_0: sender-receiver-to-signal-group-mapping{communication-direction=OUT, data-element=SWC_HALOUT.root_FDC.P_CAN4_GW4_CE100_0.CAN4_SG_GW4_CE100_0, signal-group=CAN4_SG_GW4_CE100_0, type-mapping=sender-rec-record-type-mapping=record-element-mappings=[{implementation-record-element=CAN4_FDC_BCM_DrRWdwCtrl_Cmd, system-signal=CAN4_FDC_BCM_DrRWdwCtrl_Cmd}, {implementation-record-element=CAN4_FDC_PTG_inner_SW_2, system-signal=CAN4_FDC_PTG_inner_SW_2}, {implementation-record-element=CAN4_FDC_BCM_SenstivityPosn_Cmd, system-signal=CAN4_FDC_BCM_SenstivityPosn_Cmd}, {implementation-record-element=CAN4_FDC_BCM_PsRWdwCtrl_Cmd, system-signal=CAN4_FDC_BCM_PsRWdwCtrl_Cmd}, {implementation-record-element=CAN4_FDC_BCM_PasWdwCtrl_Cmd, system-signal=CAN4_FDC_BCM_PasWdwCtrl_Cmd}, {implementation-record-element=CAN4_FDC_BCM_DrvWdwCtrl_Cmd, system-signal=CAN4_FDC_BCM_DrvWdwCtrl_Cmd}]}
      MAP_HALOUTP_CAN5_FD5_CE100_0: sender-receiver-to-signal-group-mapping{communication-direction=OUT, data-element=SWC_HALOUT.root_FDC.P_CAN5_FD5_CE100_0.CAN5_SG_FD5_CE100_0, signal-group=CAN5_SG_FD5_CE100_0, type-mapping=sender-rec-record-type-mapping=record-element-mappings=[{implementation-record-element=CAN5_AllDoorSW, system-signal=CAN5_AllDoorSW}, {implementation-record-element=CAN5_VehMalfunLevel, system-signal=CAN5_VehMalfunLevel}, {implementation-record-element=CAN5_Tailgate_SW, system-signal=CAN5_Tailgate_SW}, {implementation-record-element=CAN5_TailgateRemote, system-signal=CAN5_TailgateRemote}, {implementation-record-element=CAN5_TCountSta, system-signal=CAN5_TCountSta}, {implementation-record-element=CAN5_ShiftGearPosn, system-signal=CAN5_ShiftGearPosn}, {implementation-record-element=CAN5_Re_VehThdChkSta, system-signal=CAN5_Re_VehThdChkSta}, {implementation-record-element=CAN5_PwrSta, system-signal=CAN5_PwrSta}, {implementation-record-element=CAN5_LowSOCWarn, system-signal=CAN5_LowSOCWarn}, {implementation-record-element=CAN5_HoodSW, system-signal=CAN5_HoodSW}, {implementation-record-element=CAN5_FD_TBOX_VehData_Sta, system-signal=CAN5_FD_TBOX_VehData_Sta}, {implementation-record-element=CAN5_FD_TBOX_VehData_Err, system-signal=CAN5_FD_TBOX_VehData_Err}, {implementation-record-element=CAN5_FD_TBOX_DTCData_Sta, system-signal=CAN5_FD_TBOX_DTCData_Sta}, {implementation-record-element=CAN5_FD_TBOX_DTCData_Err, system-signal=CAN5_FD_TBOX_DTCData_Err}, {implementation-record-element=CAN5_CCU_CbnPreSts, system-signal=CAN5_CCU_CbnPreSts}, {implementation-record-element=CAN5_CCU_CbnPreEstimdTi, system-signal=CAN5_CCU_CbnPreEstimdTi}, {implementation-record-element=CAN5_CCU_CbnPreACWkSts, system-signal=CAN5_CCU_CbnPreACWkSts}, {implementation-record-element=CAN5_CCU_ACLampSts, system-signal=CAN5_CCU_ACLampSts}, {implementation-record-element=CAN5_BCM_DoorLock_Sta, system-signal=CAN5_BCM_DoorLock_Sta}, {implementation-record-element=CAN5_AntitheftSta, system-signal=CAN5_AntitheftSta}]}
      MAP_HALOUTP_CAN5_FD5_Debug1: sender-receiver-to-signal-group-mapping{communication-direction=OUT, data-element=SWC_HALOUT.root_FDC.P_CAN5_FD5_Debug1.CAN5_SG_FD5_Debug1, signal-group=CAN5_SG_FD5_Debug1, type-mapping=sender-rec-record-type-mapping=record-element-mappings=[{implementation-record-element=CAN5_ID1_ALTU, system-signal=CAN5_ID1_ALTU}, {implementation-record-element=CAN5_S4WheelDebug_ALTU, system-signal=CAN5_S4WheelDebug_ALTU}, {implementation-record-element=CAN5_S3WheelDebug_ALTU, system-signal=CAN5_S3WheelDebug_ALTU}, {implementation-record-element=CAN5_S2WheelDebug_ALTU, system-signal=CAN5_S2WheelDebug_ALTU}, {implementation-record-element=CAN5_S1WheelDebug_ALTU, system-signal=CAN5_S1WheelDebug_ALTU}, {implementation-record-element=CAN5_RRSensorMode, system-signal=CAN5_RRSensorMode}, {implementation-record-element=CAN5_RF_FAT_ALTU, system-signal=CAN5_RF_FAT_ALTU}, {implementation-record-element=CAN5_RFSensorMode, system-signal=CAN5_RFSensorMode}, {implementation-record-element=CAN5_LRSensorMode, system-signal=CAN5_LRSensorMode}, {implementation-record-element=CAN5_LFSensorMode, system-signal=CAN5_LFSensorMode}, {implementation-record-element=CAN5_IDin_ALTU, system-signal=CAN5_IDin_ALTU}, {implementation-record-element=CAN5_ID4_message_ALTU, system-signal=CAN5_ID4_message_ALTU}, {implementation-record-element=CAN5_ID4_Loc_ALTU, system-signal=CAN5_ID4_Loc_ALTU}, {implementation-record-element=CAN5_ID4_ALTU, system-signal=CAN5_ID4_ALTU}, {implementation-record-element=CAN5_ID3_message_ALTU, system-signal=CAN5_ID3_message_ALTU}, {implementation-record-element=CAN5_ID3_Loc_ALTU, system-signal=CAN5_ID3_Loc_ALTU}, {implementation-record-element=CAN5_ID3_ALTU, system-signal=CAN5_ID3_ALTU}, {implementation-record-element=CAN5_ID2_message_ALTU, system-signal=CAN5_ID2_message_ALTU}, {implementation-record-element=CAN5_ID2_Loc_ALTU, system-signal=CAN5_ID2_Loc_ALTU}, {implementation-record-element=CAN5_ID2_ALTU, system-signal=CAN5_ID2_ALTU}, {implementation-record-element=CAN5_ID1_message_ALTU, system-signal=CAN5_ID1_message_ALTU}, {implementation-record-element=CAN5_ID1_Loc_ALTU, system-signal=CAN5_ID1_Loc_ALTU}]}
      MAP_HALOUTP_CAN5_FD5_Debug2: sender-receiver-to-signal-group-mapping{communication-direction=OUT, data-element=SWC_HALOUT.root_FDC.P_CAN5_FD5_Debug2.CAN5_SG_FD5_Debug2, signal-group=CAN5_SG_FD5_Debug2, type-mapping=sender-rec-record-type-mapping=record-element-mappings=[{implementation-record-element=CAN5_FDC_DKC_A0_UWB_Event_Sta, system-signal=CAN5_FDC_DKC_A0_UWB_Event_Sta}, {implementation-record-element=CAN5_FDC_DKC_UWB_OnOff_Sta, system-signal=CAN5_FDC_DKC_UWB_OnOff_Sta}, {implementation-record-element=CAN5_FDC_DKC_UWBDetPTGArea_Sta, system-signal=CAN5_FDC_DKC_UWBDetPTGArea_Sta}, {implementation-record-element=CAN5_FDC_DKC_UWBDetArea_Sta, system-signal=CAN5_FDC_DKC_UWBDetArea_Sta}, {implementation-record-element=CAN5_FDC_DKC_UWB5_Invalid_Sta, system-signal=CAN5_FDC_DKC_UWB5_Invalid_Sta}, {implementation-record-element=CAN5_FDC_DKC_UWB5_FPP_Sta, system-signal=CAN5_FDC_DKC_UWB5_FPP_Sta}, {implementation-record-element=CAN5_FDC_DKC_UWB5_Distance_Sta, system-signal=CAN5_FDC_DKC_UWB5_Distance_Sta}, {implementation-record-element=CAN5_FDC_DKC_UWB4_Invalid_Sta, system-signal=CAN5_FDC_DKC_UWB4_Invalid_Sta}, {implementation-record-element=CAN5_FDC_DKC_UWB4_FPP_Sta, system-signal=CAN5_FDC_DKC_UWB4_FPP_Sta}, {implementation-record-element=CAN5_FDC_DKC_UWB4_Distance_Sta, system-signal=CAN5_FDC_DKC_UWB4_Distance_Sta}, {implementation-record-element=CAN5_FDC_DKC_UWB3_Invalid_Sta, system-signal=CAN5_FDC_DKC_UWB3_Invalid_Sta}, {implementation-record-element=CAN5_FDC_DKC_UWB3_FPP_Sta, system-signal=CAN5_FDC_DKC_UWB3_FPP_Sta}, {implementation-record-element=CAN5_FDC_DKC_UWB3_Distance_Sta, system-signal=CAN5_FDC_DKC_UWB3_Distance_Sta}, {implementation-record-element=CAN5_FDC_DKC_UWB2_Invalid_Sta, system-signal=CAN5_FDC_DKC_UWB2_Invalid_Sta}, {implementation-record-element=CAN5_FDC_DKC_UWB2_FPP_Sta, system-signal=CAN5_FDC_DKC_UWB2_FPP_Sta}, {implementation-record-element=CAN5_FDC_DKC_UWB2_Distance_Sta, system-signal=CAN5_FDC_DKC_UWB2_Distance_Sta}, {implementation-record-element=CAN5_FDC_DKC_UWB1_Invalid_Sta, system-signal=CAN5_FDC_DKC_UWB1_Invalid_Sta}, {implementation-record-element=CAN5_FDC_DKC_UWB1_FPP_Sta, system-signal=CAN5_FDC_DKC_UWB1_FPP_Sta}, {implementation-record-element=CAN5_FDC_DKC_UWB1_Distance_Sta, system-signal=CAN5_FDC_DKC_UWB1_Distance_Sta}, {implementation-record-element=CAN5_FDC_DKC_UIDLowPower_Sta, system-signal=CAN5_FDC_DKC_UIDLowPower_Sta}, {implementation-record-element=CAN5_FDC_DKC_UIDBatVolt_Sta, system-signal=CAN5_FDC_DKC_UIDBatVolt_Sta}, {implementation-record-element=CAN5_FDC_DKC_ShippingMode_Sta, system-signal=CAN5_FDC_DKC_ShippingMode_Sta}, {implementation-record-element=CAN5_FDC_DKC_SPTGOpen_Cmd, system-signal=CAN5_FDC_DKC_SPTGOpen_Cmd}, {implementation-record-element=CAN5_FDC_DKC_SPTGDet_Cmd, system-signal=CAN5_FDC_DKC_SPTGDet_Cmd}, {implementation-record-element=CAN5_FDC_DKC_RemoRightPSD_Cmd, system-signal=CAN5_FDC_DKC_RemoRightPSD_Cmd}, {implementation-record-element=CAN5_FDC_DKC_RemoLeftPSD_Cmd, system-signal=CAN5_FDC_DKC_RemoLeftPSD_Cmd}, {implementation-record-element=CAN5_FDC_DKC_ReVehData_Sta, system-signal=CAN5_FDC_DKC_ReVehData_Sta}, {implementation-record-element=CAN5_FDC_DKC_ParkingMode_Cmd, system-signal=CAN5_FDC_DKC_ParkingMode_Cmd}, {implementation-record-element=CAN5_FDC_DKC_OutputPCMDModule_Sta, system-signal=CAN5_FDC_DKC_OutputPCMDModule_Sta}, {implementation-record-element=CAN5_FDC_DKC_KeyType_Sta, system-signal=CAN5_FDC_DKC_KeyType_Sta}, {implementation-record-element=CAN5_FDC_DKC_KeyNum_Sta, system-signal=CAN5_FDC_DKC_KeyNum_Sta}, {implementation-record-element=CAN5_FDC_DKC_KeyMode_Sta, system-signal=CAN5_FDC_DKC_KeyMode_Sta}, {implementation-record-element=CAN5_FDC_DKC_KeyMiss_Sta, system-signal=CAN5_FDC_DKC_KeyMiss_Sta}, {implementation-record-element=CAN5_FDC_DKC_DkeyShowIVI_Sta, system-signal=CAN5_FDC_DKC_DkeyShowIVI_Sta}, {implementation-record-element=CAN5_FDC_DKC_DkeyAreaRAPS_Sta, system-signal=CAN5_FDC_DKC_DkeyAreaRAPS_Sta}, {implementation-record-element=CAN5_FDC_DKC_DKeyWelcome_Sta, system-signal=CAN5_FDC_DKC_DKeyWelcome_Sta}, {implementation-record-element=CAN5_FDC_DKC_DKeyAreaSPTG_Sta, system-signal=CAN5_FDC_DKC_DKeyAreaSPTG_Sta}, {implementation-record-element=CAN5_FDC_DKC_DKeyAreaPTG_Sta, system-signal=CAN5_FDC_DKC_DKeyAreaPTG_Sta}, {implementation-record-element=CAN5_FDC_DKC_DKeyAreaPS_Sta, system-signal=CAN5_FDC_DKC_DKeyAreaPS_Sta}, {implementation-record-element=CAN5_FDC_DKC_DKeyAreaPE_Sta, system-signal=CAN5_FDC_DKC_DKeyAreaPE_Sta}, {implementation-record-element=CAN5_FDC_DKC_CoordinateY_Sta, system-signal=CAN5_FDC_DKC_CoordinateY_Sta}, {implementation-record-element=CAN5_FDC_DKC_CoordinateX_Sta, system-signal=CAN5_FDC_DKC_CoordinateX_Sta}, {implementation-record-element=CAN5_FDC_DKC_CommandToBCM_Cmd, system-signal=CAN5_FDC_DKC_CommandToBCM_Cmd}, {implementation-record-element=CAN5_FDC_DKC_CalDistance_Sta, system-signal=CAN5_FDC_DKC_CalDistance_Sta}, {implementation-record-element=CAN5_FDC_DKC_BLEdcEvent_Sta, system-signal=CAN5_FDC_DKC_BLEdcEvent_Sta}, {implementation-record-element=CAN5_FDC_DKC_BLERSSI_Sta, system-signal=CAN5_FDC_DKC_BLERSSI_Sta}, {implementation-record-element=CAN5_FDC_DKC_AllowSleep_Sta, system-signal=CAN5_FDC_DKC_AllowSleep_Sta}]}
      MAP_HALOUTP_CAN5_FD5_Debug3: sender-receiver-to-signal-group-mapping{communication-direction=OUT, data-element=SWC_HALOUT.root_FDC.P_CAN5_FD5_Debug3.CAN5_SG_FD5_Debug3, signal-group=CAN5_SG_FD5_Debug3, type-mapping=sender-rec-record-type-mapping=record-element-mappings=[{implementation-record-element=CAN5_FDC_VMC_ActReqAcc_Cmd, system-signal=CAN5_FDC_VMC_ActReqAcc_Cmd}, {implementation-record-element=CAN5_FDC_VMC_LongAccel_Cmd, system-signal=CAN5_FDC_VMC_LongAccel_Cmd}, {implementation-record-element=CAN5_FDC_VMC_IMUYawRate_Cmd, system-signal=CAN5_FDC_VMC_IMUYawRate_Cmd}, {implementation-record-element=CAN5_FDC_VMC_IMURollRate_Cmd, system-signal=CAN5_FDC_VMC_IMURollRate_Cmd}, {implementation-record-element=CAN5_FDC_VMC_IMUPitchRate_Cmd, system-signal=CAN5_FDC_VMC_IMUPitchRate_Cmd}, {implementation-record-element=CAN5_FDC_VMC_IMUGz_Cmd, system-signal=CAN5_FDC_VMC_IMUGz_Cmd}, {implementation-record-element=CAN5_FDC_VMC_IMUGy_Cmd, system-signal=CAN5_FDC_VMC_IMUGy_Cmd}, {implementation-record-element=CAN5_FDC_VMC_IMUGx_Cmd, system-signal=CAN5_FDC_VMC_IMUGx_Cmd}, {implementation-record-element=CAN5_FDC_VMC_ExtraMSACtrl_Sta, system-signal=CAN5_FDC_VMC_ExtraMSACtrl_Sta}]}
      MAP_HALOUTP_CAN5_GW5_CE100_0: sender-receiver-to-signal-group-mapping{communication-direction=OUT, data-element=SWC_HALOUT.root_FDC.P_CAN5_GW5_CE100_0.CAN5_SG_GW5_CE100_0, signal-group=CAN5_SG_GW5_CE100_0, type-mapping=sender-rec-record-type-mapping=record-element-mappings=[{implementation-record-element=CAN5_FDC_BCM_WinLFOpened_Sta, system-signal=CAN5_FDC_BCM_WinLFOpened_Sta}, {implementation-record-element=CAN5_FDC_BCM_WinRROpened_Sta, system-signal=CAN5_FDC_BCM_WinRROpened_Sta}, {implementation-record-element=CAN5_FDC_BCM_WinRFOpened_Sta, system-signal=CAN5_FDC_BCM_WinRFOpened_Sta}, {implementation-record-element=CAN5_FDC_BCM_WinLROpened_Sta, system-signal=CAN5_FDC_BCM_WinLROpened_Sta}]}
      MAP_HALOUTP_CAN6_FD6_APS3: sender-receiver-to-signal-group-mapping{communication-direction=OUT, data-element=SWC_HALOUT.root_FDC.P_CAN6_FD6_APS3.CAN6_SG_FD6_APS3, signal-group=CAN6_SG_FD6_APS3, type-mapping=sender-rec-record-type-mapping=record-element-mappings=[{implementation-record-element=CAN6_APS3_LifeCount, system-signal=CAN6_APS3_LifeCount}, {implementation-record-element=CAN6_SPTG_Sta, system-signal=CAN6_SPTG_Sta}, {implementation-record-element=CAN6_SPTGDet, system-signal=CAN6_SPTGDet}, {implementation-record-element=CAN6_FDC_VMC_APS_V_Rq_EPS_Ctrl, system-signal=CAN6_FDC_VMC_APS_V_Rq_EPS_Ctrl}, {implementation-record-element=CAN6_FDC_VMC_APS_Rq_EPS_Ctrl, system-signal=CAN6_FDC_VMC_APS_Rq_EPS_Ctrl}, {implementation-record-element=CAN6_FDC_VMC_APS_Angle_Target, system-signal=CAN6_FDC_VMC_APS_Angle_Target}, {implementation-record-element=CAN6_CAAS_Sta, system-signal=CAN6_CAAS_Sta}, {implementation-record-element=CAN6_APS_Sta_System, system-signal=CAN6_APS_Sta_System}, {implementation-record-element=CAN6_APS_Req, system-signal=CAN6_APS_Req}, {implementation-record-element=CAN6_APS_DecReq_A, system-signal=CAN6_APS_DecReq_A}, {implementation-record-element=CAN6_APS_DecReq, system-signal=CAN6_APS_DecReq}, {implementation-record-element=CAN6_APSOpenPTG, system-signal=CAN6_APSOpenPTG}, {implementation-record-element=CAN6_APS3_checksum, system-signal=CAN6_APS3_checksum}]}
      MAP_HALOUTP_CAN6_FD6_BCM1: sender-receiver-to-signal-group-mapping{communication-direction=OUT, data-element=SWC_HALOUT.root_FDC.P_CAN6_FD6_BCM1.CAN6_SG_FD6_BCM1, signal-group=CAN6_SG_FD6_BCM1, type-mapping=sender-rec-record-type-mapping=record-element-mappings=[{implementation-record-element=CAN6_AllDoorSW, system-signal=CAN6_AllDoorSW}, {implementation-record-element=CAN6_WiperFixMode, system-signal=CAN6_WiperFixMode}, {implementation-record-element=CAN6_WasherCtrl, system-signal=CAN6_WasherCtrl}, {implementation-record-element=CAN6_TrunkRel, system-signal=CAN6_TrunkRel}, {implementation-record-element=CAN6_Tailgate_SW, system-signal=CAN6_Tailgate_SW}, {implementation-record-element=CAN6_TailgateRemote, system-signal=CAN6_TailgateRemote}, {implementation-record-element=CAN6_TailgateHDSW, system-signal=CAN6_TailgateHDSW}, {implementation-record-element=CAN6_Rr_Wiper, system-signal=CAN6_Rr_Wiper}, {implementation-record-element=CAN6_Rr_FogLamp, system-signal=CAN6_Rr_FogLamp}, {implementation-record-element=CAN6_Rr_Defog, system-signal=CAN6_Rr_Defog}, {implementation-record-element=CAN6_Rr_ChargingDoorCtrl, system-signal=CAN6_Rr_ChargingDoorCtrl}, {implementation-record-element=CAN6_RoomLampL, system-signal=CAN6_RoomLampL}, {implementation-record-element=CAN6_RoomLampH, system-signal=CAN6_RoomLampH}, {implementation-record-element=CAN6_ReverseLamp, system-signal=CAN6_ReverseLamp}, {implementation-record-element=CAN6_RTurnLP, system-signal=CAN6_RTurnLP}, {implementation-record-element=CAN6_RRDoorSW, system-signal=CAN6_RRDoorSW}, {implementation-record-element=CAN6_RLDoorSW, system-signal=CAN6_RLDoorSW}, {implementation-record-element=CAN6_RDRL, system-signal=CAN6_RDRL}, {implementation-record-element=CAN6_RBSD, system-signal=CAN6_RBSD}, {implementation-record-element=CAN6_PsDoorSW, system-signal=CAN6_PsDoorSW}, {implementation-record-element=CAN6_PosLamp, system-signal=CAN6_PosLamp}, {implementation-record-element=CAN6_MirrorDefog, system-signal=CAN6_MirrorDefog}, {implementation-record-element=CAN6_MirrorCtrl, system-signal=CAN6_MirrorCtrl}, {implementation-record-element=CAN6_LockSetting, system-signal=CAN6_LockSetting}, {implementation-record-element=CAN6_L_Beam, system-signal=CAN6_L_Beam}, {implementation-record-element=CAN6_L_APM_WdwEnable, system-signal=CAN6_L_APM_WdwEnable}, {implementation-record-element=CAN6_LTurnLP, system-signal=CAN6_LTurnLP}, {implementation-record-element=CAN6_LDRL, system-signal=CAN6_LDRL}, {implementation-record-element=CAN6_LBSD, system-signal=CAN6_LBSD}, {implementation-record-element=CAN6_HornCtrl, system-signal=CAN6_HornCtrl}, {implementation-record-element=CAN6_HoodSW, system-signal=CAN6_HoodSW}, {implementation-record-element=CAN6_HazardSW, system-signal=CAN6_HazardSW}, {implementation-record-element=CAN6_H_Beam, system-signal=CAN6_H_Beam}, {implementation-record-element=CAN6_Fr_Wiper_L, system-signal=CAN6_Fr_Wiper_L}, {implementation-record-element=CAN6_Fr_Wiper_H, system-signal=CAN6_Fr_Wiper_H}, {implementation-record-element=CAN6_Fr_FogLamp, system-signal=CAN6_Fr_FogLamp}, {implementation-record-element=CAN6_Fr_ChargingDoorCtrl, system-signal=CAN6_Fr_ChargingDoorCtrl}, {implementation-record-element=CAN6_DrDoorSW, system-signal=CAN6_DrDoorSW}, {implementation-record-element=CAN6_DoorLockIND, system-signal=CAN6_DoorLockIND}, {implementation-record-element=CAN6_DimmerEN, system-signal=CAN6_DimmerEN}, {implementation-record-element=CAN6_Dimmer, system-signal=CAN6_Dimmer}, {implementation-record-element=CAN6_CrashDetd, system-signal=CAN6_CrashDetd}, {implementation-record-element=CAN6_CTDUnlockSW, system-signal=CAN6_CTDUnlockSW}, {implementation-record-element=CAN6_CTDLockSW, system-signal=CAN6_CTDLockSW}, {implementation-record-element=CAN6_CTDCtrl, system-signal=CAN6_CTDCtrl}, {implementation-record-element=CAN6_BrakeLamp, system-signal=CAN6_BrakeLamp}, {implementation-record-element=CAN6_BCM_DoorLock_Sta, system-signal=CAN6_BCM_DoorLock_Sta}, {implementation-record-element=CAN6_BCM_Buzzer_Req, system-signal=CAN6_BCM_Buzzer_Req}, {implementation-record-element=CAN6_AntitheftSta, system-signal=CAN6_AntitheftSta}, {implementation-record-element=CAN6_AntiTheftSeatFold, system-signal=CAN6_AntiTheftSeatFold}]}
      MAP_HALOUTP_CAN6_FD6_VCU1: sender-receiver-to-signal-group-mapping{communication-direction=OUT, data-element=SWC_HALOUT.root_FDC.P_CAN6_FD6_VCU1.CAN6_SG_FD6_VCU1, signal-group=CAN6_SG_FD6_VCU1, type-mapping=sender-rec-record-type-mapping=record-element-mappings=[{implementation-record-element=CAN6_CC_Crl_Sta, system-signal=CAN6_CC_Crl_Sta}, {implementation-record-element=CAN6_XWDMode, system-signal=CAN6_XWDMode}, {implementation-record-element=CAN6_VehMalfunLevel, system-signal=CAN6_VehMalfunLevel}, {implementation-record-element=CAN6_VCU_OPDHold, system-signal=CAN6_VCU_OPDHold}, {implementation-record-element=CAN6_ShiftGearPosn, system-signal=CAN6_ShiftGearPosn}, {implementation-record-element=CAN6_PwrSta, system-signal=CAN6_PwrSta}, {implementation-record-element=CAN6_PrkReqValid, system-signal=CAN6_PrkReqValid}, {implementation-record-element=CAN6_PrkReq, system-signal=CAN6_PrkReq}, {implementation-record-element=CAN6_P_Button_Sta, system-signal=CAN6_P_Button_Sta}, {implementation-record-element=CAN6_MSA_Crl_Sta, system-signal=CAN6_MSA_Crl_Sta}, {implementation-record-element=CAN6_LVPwrSta, system-signal=CAN6_LVPwrSta}, {implementation-record-element=CAN6_HVPwrSta, system-signal=CAN6_HVPwrSta}, {implementation-record-element=CAN6_Eng_PwrLockSta, system-signal=CAN6_Eng_PwrLockSta}, {implementation-record-element=CAN6_Eng_CoastDwSta, system-signal=CAN6_Eng_CoastDwSta}, {implementation-record-element=CAN6_Eng_ActvDmpDisabSta, system-signal=CAN6_Eng_ActvDmpDisabSta}, {implementation-record-element=CAN6_Eng_AGSCloseSta, system-signal=CAN6_Eng_AGSCloseSta}]}
      MAP_HALOUTP_CAN6_FD6_VCU2: sender-receiver-to-signal-group-mapping{communication-direction=OUT, data-element=SWC_HALOUT.root_FDC.P_CAN6_FD6_VCU2.CAN6_SG_FD6_VCU2, signal-group=CAN6_SG_FD6_VCU2, type-mapping=sender-rec-record-type-mapping=record-element-mappings=[{implementation-record-element=CAN6_ACC_CtrlAvail, system-signal=CAN6_ACC_CtrlAvail}, {implementation-record-element=CAN6_VehActPwr, system-signal=CAN6_VehActPwr}, {implementation-record-element=CAN6_Rr_DriverTq, system-signal=CAN6_Rr_DriverTq}, {implementation-record-element=CAN6_RC_VCU2_CAN6, system-signal=CAN6_RC_VCU2_CAN6}, {implementation-record-element=CAN6_Fr_DriverTq, system-signal=CAN6_Fr_DriverTq}, {implementation-record-element=CAN6_DriverTq, system-signal=CAN6_DriverTq}, {implementation-record-element=CAN6_CS_VCU2_CAN6, system-signal=CAN6_CS_VCU2_CAN6}, {implementation-record-element=CAN6_ActAPSPosn, system-signal=CAN6_ActAPSPosn}, {implementation-record-element=CAN6_AccPedal_Override, system-signal=CAN6_AccPedal_Override}]}
      MAP_HALOUTP_CAN6_FD6_VMC1: sender-receiver-to-signal-group-mapping{communication-direction=OUT, data-element=SWC_HALOUT.root_FDC.P_CAN6_FD6_VMC1.CAN6_SG_FD6_VMC1, signal-group=CAN6_SG_FD6_VMC1, type-mapping=sender-rec-record-type-mapping=record-element-mappings=[{implementation-record-element=CAN6_AccCalcuPID, system-signal=CAN6_AccCalcuPID}, {implementation-record-element=CAN6_VehicleSpeed_mph, system-signal=CAN6_VehicleSpeed_mph}, {implementation-record-element=CAN6_VehicleSpeed_kph, system-signal=CAN6_VehicleSpeed_kph}, {implementation-record-element=CAN6_VMC_VCU_MSA_Crl_Sta, system-signal=CAN6_VMC_VCU_MSA_Crl_Sta}, {implementation-record-element=CAN6_VMC_VCU_CC_Crl_Sta, system-signal=CAN6_VMC_VCU_CC_Crl_Sta}, {implementation-record-element=CAN6_VMC_VCU_AccPedal_Override, system-signal=CAN6_VMC_VCU_AccPedal_Override}, {implementation-record-element=CAN6_VMC_VCU_APSCtrlAvail_flg, system-signal=CAN6_VMC_VCU_APSCtrlAvail_flg}, {implementation-record-element=CAN6_VMC_VCU_ACC_CtrlAvail, system-signal=CAN6_VMC_VCU_ACC_CtrlAvail}, {implementation-record-element=CAN6_VMC_MSACtrlAvail, system-signal=CAN6_VMC_MSACtrlAvail}, {implementation-record-element=CAN6_VMC_CCCtrlAvail, system-signal=CAN6_VMC_CCCtrlAvail}, {implementation-record-element=CAN6_VMC_AEBCtrlAvail, system-signal=CAN6_VMC_AEBCtrlAvail}, {implementation-record-element=CAN6_VMC_ACCCtrlAvail, system-signal=CAN6_VMC_ACCCtrlAvail}, {implementation-record-element=CAN6_TimeGapCalcu, system-signal=CAN6_TimeGapCalcu}, {implementation-record-element=CAN6_SingleWhlSlipRatioCtrl, system-signal=CAN6_SingleWhlSlipRatioCtrl}, {implementation-record-element=CAN6_SafetyCtrl, system-signal=CAN6_SafetyCtrl}, {implementation-record-element=CAN6_SPD2ACCAct, system-signal=CAN6_SPD2ACCAct}, {implementation-record-element=CAN6_RearWhlSlipRatioCtrl, system-signal=CAN6_RearWhlSlipRatioCtrl}, {implementation-record-element=CAN6_MeterIndSpeed_raw32, system-signal=CAN6_MeterIndSpeed_raw32}, {implementation-record-element=CAN6_LimitPCT, system-signal=CAN6_LimitPCT}, {implementation-record-element=CAN6_LateralCtrl, system-signal=CAN6_LateralCtrl}, {implementation-record-element=CAN6_LatAccCtrl, system-signal=CAN6_LatAccCtrl}, {implementation-record-element=CAN6_JerkPCT, system-signal=CAN6_JerkPCT}, {implementation-record-element=CAN6_FrontRearSlipRatioCtrl, system-signal=CAN6_FrontRearSlipRatioCtrl}, {implementation-record-element=CAN6_FeatSetSpdFinal_raw32, system-signal=CAN6_FeatSetSpdFinal_raw32}, {implementation-record-element=CAN6_FeatReqSpd, system-signal=CAN6_FeatReqSpd}, {implementation-record-element=CAN6_FeatArbitrSta, system-signal=CAN6_FeatArbitrSta}, {implementation-record-element=CAN6_FeatArbitrFinal, system-signal=CAN6_FeatArbitrFinal}, {implementation-record-element=CAN6_FDC_VMC_LongAccel_Cmd, system-signal=CAN6_FDC_VMC_LongAccel_Cmd}, {implementation-record-element=CAN6_DISC_Sta, system-signal=CAN6_DISC_Sta}, {implementation-record-element=CAN6_DISC_DISCTurn, system-signal=CAN6_DISC_DISCTurn}, {implementation-record-element=CAN6_DISC_DISCTargetSpd, system-signal=CAN6_DISC_DISCTargetSpd}, {implementation-record-element=CAN6_DISC_ButtSta, system-signal=CAN6_DISC_ButtSta}, {implementation-record-element=CAN6_DISCReqAcc, system-signal=CAN6_DISCReqAcc}, {implementation-record-element=CAN6_CCMSA_SpdWar, system-signal=CAN6_CCMSA_SpdWar}]}
      MAP_HALOUTP_CAN6_GW6_CE100_0: sender-receiver-to-signal-group-mapping{communication-direction=OUT, data-element=SWC_HALOUT.root_FDC.P_CAN6_GW6_CE100_0.CAN6_SG_GW6_CE100_0, signal-group=CAN6_SG_GW6_CE100_0, type-mapping=sender-rec-record-type-mapping=record-element-mappings=[{implementation-record-element=CAN6_FDC_BCM_DimSw, system-signal=CAN6_FDC_BCM_DimSw}, {implementation-record-element=CAN6_FDC_VMC_SpdCtrl_Sta, system-signal=CAN6_FDC_VMC_SpdCtrl_Sta}, {implementation-record-element=CAN6_FDC_VMC_SpdCtrlMode_Sta, system-signal=CAN6_FDC_VMC_SpdCtrlMode_Sta}, {implementation-record-element=CAN6_FDC_BCM_TurnSw_Sta, system-signal=CAN6_FDC_BCM_TurnSw_Sta}, {implementation-record-element=CAN6_FDC_BCM_PassSW_Sta, system-signal=CAN6_FDC_BCM_PassSW_Sta}, {implementation-record-element=CAN6_FDC_BCM_LRightSta_Cmd, system-signal=CAN6_FDC_BCM_LRightSta_Cmd}, {implementation-record-element=CAN6_FDC_BCM_LLeftSta_Cmd, system-signal=CAN6_FDC_BCM_LLeftSta_Cmd}, {implementation-record-element=CAN6_FDC_BCM_FWipSw_Sta, system-signal=CAN6_FDC_BCM_FWipSw_Sta}]}
      MAP_HALOUTP_CAN{2..5}_FD{2..5}_OTA1: sender-receiver-to-signal-group-mapping{communication-direction=OUT, data-element=SWC_VES.root_FDC.P_CAN{2..5}_FD{2..5}_OTA1.CAN{2..5}_SG_FD{2..5}_OTA1, signal-group=CAN{2..5}_SG_FD{2..5}_OTA1, type-mapping=sender-rec-record-type-mapping=record-element-mappings=[{implementation-record-element=CAN{2..5}_OTA_DL_Available, system-signal=CAN{2..5}_OTA_DL_Available}, {implementation-record-element=CAN{2..5}_OTA_Updating_ECU_8bit, system-signal=CAN{2..5}_OTA_Updating_ECU_8bit}, {implementation-record-element=CAN{2..5}_OTA_Update_Available, system-signal=CAN{2..5}_OTA_Update_Available}, {implementation-record-element=CAN{2..5}_OTA_TBOXResetReq, system-signal=CAN{2..5}_OTA_TBOXResetReq}, {implementation-record-element=CAN{2..5}_OTA_Remained_Time, system-signal=CAN{2..5}_OTA_Remained_Time}, {implementation-record-element=CAN{2..5}_OTA_Progress_Rate, system-signal=CAN{2..5}_OTA_Progress_Rate}, {implementation-record-element=CAN{2..5}_OTA_Permit_Agreed, system-signal=CAN{2..5}_OTA_Permit_Agreed}, {implementation-record-element=CAN{2..5}_OTA_Network_Type, system-signal=CAN{2..5}_OTA_Network_Type}, {implementation-record-element=CAN{2..5}_OTA_Mode, system-signal=CAN{2..5}_OTA_Mode}, {implementation-record-element=CAN{2..5}_OTA_MDA_Status, system-signal=CAN{2..5}_OTA_MDA_Status}, {implementation-record-element=CAN{2..5}_OTA_Lock_Req, system-signal=CAN{2..5}_OTA_Lock_Req}, {implementation-record-element=CAN{2..5}_OTA_InVehicle_FW, system-signal=CAN{2..5}_OTA_InVehicle_FW}, {implementation-record-element=CAN{2..5}_OTA_Emergency_Sta, system-signal=CAN{2..5}_OTA_Emergency_Sta}, {implementation-record-element=CAN{2..5}_OTA_Debug_Code, system-signal=CAN{2..5}_OTA_Debug_Code}, {implementation-record-element=CAN{2..5}_OTA_DL_Speed, system-signal=CAN{2..5}_OTA_DL_Speed}]}
      MAP_HALOUTP_CAN5_FD5_CONN1: sender-receiver-to-signal-group-mapping{communication-direction=OUT, data-element=SWC_VES.root_FDC.P_CAN5_FD5_CONN1.CAN5_SG_FD5_CONN1, signal-group=CAN5_SG_FD5_CONN1, type-mapping=sender-rec-record-type-mapping=record-element-mappings=[{implementation-record-element=CAN5_FDC_Conn_Antitheft_Zero, system-signal=CAN5_FDC_Conn_Antitheft_Zero}, {implementation-record-element=CAN5_FDC_Conn_Uncounting_Req, system-signal=CAN5_FDC_Conn_Uncounting_Req}, {implementation-record-element=CAN5_FDC_Conn_Remote_PW, system-signal=CAN5_FDC_Conn_Remote_PW}, {implementation-record-element=CAN5_FDC_Conn_Remote_MidAutoReq, system-signal=CAN5_FDC_Conn_Remote_MidAutoReq}, {implementation-record-element=CAN5_FDC_Conn_Remote_AutoReq, system-signal=CAN5_FDC_Conn_Remote_AutoReq}, {implementation-record-element=CAN5_FDC_Conn_Remote_ACTemp, system-signal=CAN5_FDC_Conn_Remote_ACTemp}, {implementation-record-element=CAN5_FDC_Conn_RemoteOn, system-signal=CAN5_FDC_Conn_RemoteOn}, {implementation-record-element=CAN5_FDC_Conn_Re_VehData, system-signal=CAN5_FDC_Conn_Re_VehData}, {implementation-record-element=CAN5_FDC_Conn_Re_Radio, system-signal=CAN5_FDC_Conn_Re_Radio}, {implementation-record-element=CAN5_FDC_Conn_Re_PwrReq, system-signal=CAN5_FDC_Conn_Re_PwrReq}, {implementation-record-element=CAN5_FDC_Conn_Re_DoorLock, system-signal=CAN5_FDC_Conn_Re_DoorLock}, {implementation-record-element=CAN5_FDC_Conn_Re_DTCData, system-signal=CAN5_FDC_Conn_Re_DTCData}, {implementation-record-element=CAN5_FDC_Conn_ReOutsideMirror, system-signal=CAN5_FDC_Conn_ReOutsideMirror}, {implementation-record-element=CAN5_FDC_Conn_RRDWdwCtrl_Cmd, system-signal=CAN5_FDC_Conn_RRDWdwCtrl_Cmd}, {implementation-record-element=CAN5_FDC_Conn_RLDWdwCtrl_Cmd, system-signal=CAN5_FDC_Conn_RLDWdwCtrl_Cmd}, {implementation-record-element=CAN5_FDC_Conn_PowerOff_T_Set, system-signal=CAN5_FDC_Conn_PowerOff_T_Set}, {implementation-record-element=CAN5_FDC_Conn_PasWdwCtrl_Cmd, system-signal=CAN5_FDC_Conn_PasWdwCtrl_Cmd}, {implementation-record-element=CAN5_FDC_Conn_DrvWdwCtrl_Cmd, system-signal=CAN5_FDC_Conn_DrvWdwCtrl_Cmd}, {implementation-record-element=CAN5_FDC_Conn_CbnPreTarT, system-signal=CAN5_FDC_Conn_CbnPreTarT}, {implementation-record-element=CAN5_FDC_Conn_CbnPreReq, system-signal=CAN5_FDC_Conn_CbnPreReq}, {implementation-record-element=CAN5_FDC_Conn_CbnPreACEnaReq, system-signal=CAN5_FDC_Conn_CbnPreACEnaReq}]}
      MAP_HALIN_R_CAN1_ABM1: sender-receiver-to-signal-group-mapping{communication-direction=IN, data-element=SWC_HALIN.root_FDC.R_CAN1_ABM1.CAN1_SG_ABM1, signal-group=CAN1_SG_ABM1, type-mapping=sender-rec-record-type-mapping=record-element-mappings=[{implementation-record-element=CAN1_ABM_Passenger_ODS_Sta, system-signal=CAN1_ABM_Passenger_ODS_Sta}, {implementation-record-element=CAN1_TRHPsngrSeatBeltCmd, system-signal=CAN1_TRHPsngrSeatBeltCmd}, {implementation-record-element=CAN1_TLHPsngrSeatBeltCmd, system-signal=CAN1_TLHPsngrSeatBeltCmd}, {implementation-record-element=CAN1_RPsngrSeatBeltCmd, system-signal=CAN1_RPsngrSeatBeltCmd}, {implementation-record-element=CAN1_RDriverSeatBeltCmd, system-signal=CAN1_RDriverSeatBeltCmd}, {implementation-record-element=CAN1_RCenterSeatBeltCmd, system-signal=CAN1_RCenterSeatBeltCmd}, {implementation-record-element=CAN1_PsngrSeatBeltCmd, system-signal=CAN1_PsngrSeatBeltCmd}, {implementation-record-element=CAN1_PABSwitchCmd, system-signal=CAN1_PABSwitchCmd}, {implementation-record-element=CAN1_LifeCount_ABM1, system-signal=CAN1_LifeCount_ABM1}, {implementation-record-element=CAN1_DriverSeatBeltCmd, system-signal=CAN1_DriverSeatBeltCmd}, {implementation-record-element=CAN1_CrashOutputSts, system-signal=CAN1_CrashOutputSts}, {implementation-record-element=CAN1_Checksum_ABM1, system-signal=CAN1_Checksum_ABM1}, {implementation-record-element=CAN1_AirBagFailCmd, system-signal=CAN1_AirBagFailCmd}, {implementation-record-element=CAN1_ABM_RearPassengerRH_ODS_Sta, system-signal=CAN1_ABM_RearPassengerRH_ODS_Sta}, {implementation-record-element=CAN1_ABM_RearPassengerLH_ODS_Sta, system-signal=CAN1_ABM_RearPassengerLH_ODS_Sta}, {implementation-record-element=CAN1_ABM_RearPassengerCTR_ODS_Sta, system-signal=CAN1_ABM_RearPassengerCTR_ODS_Sta}]}
      MAP_HALIN_R_CAN1_EPB1: sender-receiver-to-signal-group-mapping{communication-direction=IN, data-element=SWC_HALIN.root_FDC.R_CAN1_EPB1.CAN1_SG_EPB1, signal-group=CAN1_SG_EPB1, type-mapping=sender-rec-record-type-mapping=record-element-mappings=[{implementation-record-element=CAN1_DOA_Sta, system-signal=CAN1_DOA_Sta}, {implementation-record-element=CAN1_TakeOverReq, system-signal=CAN1_TakeOverReq}, {implementation-record-element=CAN1_EPBStaR, system-signal=CAN1_EPBStaR}, {implementation-record-element=CAN1_EPBStaL, system-signal=CAN1_EPBStaL}, {implementation-record-element=CAN1_EPBSta, system-signal=CAN1_EPBSta}, {implementation-record-element=CAN1_EPBRLampSta, system-signal=CAN1_EPBRLampSta}, {implementation-record-element=CAN1_EPBMsg, system-signal=CAN1_EPBMsg}, {implementation-record-element=CAN1_EPBExtReleaseAvail, system-signal=CAN1_EPBExtReleaseAvail}, {implementation-record-element=CAN1_EPBExtApplyAvail, system-signal=CAN1_EPBExtApplyAvail}, {implementation-record-element=CAN1_EPBErrSta, system-signal=CAN1_EPBErrSta}, {implementation-record-element=CAN1_EPBCarWashMode, system-signal=CAN1_EPBCarWashMode}, {implementation-record-element=CAN1_EPB1_RC, system-signal=CAN1_EPB1_RC}, {implementation-record-element=CAN1_EPB1_CS, system-signal=CAN1_EPB1_CS}]}
      MAP_HALIN_R_CAN1_EPS1: sender-receiver-to-signal-group-mapping{communication-direction=IN, data-element=SWC_HALIN.root_FDC.R_CAN1_EPS1.CAN1_SG_EPS1, signal-group=CAN1_SG_EPS1, type-mapping=sender-rec-record-type-mapping=record-element-mappings=[{implementation-record-element=CAN1_DriIntend, system-signal=CAN1_DriIntend}, {implementation-record-element=CAN1_Steering_Torque_V, system-signal=CAN1_Steering_Torque_V}, {implementation-record-element=CAN1_Steering_Torque, system-signal=CAN1_Steering_Torque}, {implementation-record-element=CAN1_SAS_V, system-signal=CAN1_SAS_V}, {implementation-record-element=CAN1_SAS_Speed_Valid, system-signal=CAN1_SAS_Speed_Valid}, {implementation-record-element=CAN1_SAS_Speed, system-signal=CAN1_SAS_Speed}, {implementation-record-element=CAN1_SAS_CAL, system-signal=CAN1_SAS_CAL}, {implementation-record-element=CAN1_SAS_Angle, system-signal=CAN1_SAS_Angle}, {implementation-record-element=CAN1_EpasFailed, system-signal=CAN1_EpasFailed}, {implementation-record-element=CAN1_EPS_VOL_V, system-signal=CAN1_EPS_VOL_V}, {implementation-record-element=CAN1_EPS_VOL, system-signal=CAN1_EPS_VOL}, {implementation-record-element=CAN1_EPS_Temp_V, system-signal=CAN1_EPS_Temp_V}, {implementation-record-element=CAN1_EPS_Temp, system-signal=CAN1_EPS_Temp}, {implementation-record-element=CAN1_EPS_TOI_Unavailable, system-signal=CAN1_EPS_TOI_Unavailable}, {implementation-record-element=CAN1_EPS_TOI_Fault, system-signal=CAN1_EPS_TOI_Fault}, {implementation-record-element=CAN1_EPS_TOI_Dis_R, system-signal=CAN1_EPS_TOI_Dis_R}, {implementation-record-element=CAN1_EPS_TOI_Activation, system-signal=CAN1_EPS_TOI_Activation}, {implementation-record-element=CAN1_EPS_RC, system-signal=CAN1_EPS_RC}, {implementation-record-element=CAN1_EPS_Pwr_Limit_V, system-signal=CAN1_EPS_Pwr_Limit_V}, {implementation-record-element=CAN1_EPS_Pwr_Limit, system-signal=CAN1_EPS_Pwr_Limit}, {implementation-record-element=CAN1_EPS_Pwr_Consumpt_V, system-signal=CAN1_EPS_Pwr_Consumpt_V}, {implementation-record-element=CAN1_EPS_Pwr_Consumpt, system-signal=CAN1_EPS_Pwr_Consumpt}, {implementation-record-element=CAN1_EPS_LDW_Unavailable, system-signal=CAN1_EPS_LDW_Unavailable}, {implementation-record-element=CAN1_EPS_LDW_Activation, system-signal=CAN1_EPS_LDW_Activation}, {implementation-record-element=CAN1_EPS_ESAInpBoost_Sta, system-signal=CAN1_EPS_ESAInpBoost_Sta}, {implementation-record-element=CAN1_EPS_ESABoostOut_Trq, system-signal=CAN1_EPS_ESABoostOut_Trq}, {implementation-record-element=CAN1_EPS_DMSMode_Sta, system-signal=CAN1_EPS_DMSMode_Sta}, {implementation-record-element=CAN1_EPS_CS, system-signal=CAN1_EPS_CS}, {implementation-record-element=CAN1_EPS_AOI_Dis_R, system-signal=CAN1_EPS_AOI_Dis_R}, {implementation-record-element=CAN1_EPS_AOI_Control, system-signal=CAN1_EPS_AOI_Control}]}
      MAP_HALIN_R_CAN1_ESC1: sender-receiver-to-signal-group-mapping{communication-direction=IN, data-element=SWC_HALIN.root_FDC.R_CAN1_ESC1.CAN1_SG_ESC1, signal-group=CAN1_SG_ESC1, type-mapping=sender-rec-record-type-mapping=record-element-mappings=[{implementation-record-element=CAN1_ABS_Active, system-signal=CAN1_ABS_Active}, {implementation-record-element=CAN1_VehSpeed, system-signal=CAN1_VehSpeed}, {implementation-record-element=CAN1_TCS_Failed, system-signal=CAN1_TCS_Failed}, {implementation-record-element=CAN1_TCS_Active, system-signal=CAN1_TCS_Active}, {implementation-record-element=CAN1_SystemVoltage, system-signal=CAN1_SystemVoltage}, {implementation-record-element=CAN1_Rr_PTCS_Active, system-signal=CAN1_Rr_PTCS_Active}, {implementation-record-element=CAN1_Red_WnlmpSta, system-signal=CAN1_Red_WnlmpSta}, {implementation-record-element=CAN1_RearAxlTrqReq_Drv, system-signal=CAN1_RearAxlTrqReq_Drv}, {implementation-record-element=CAN1_RR_WhlRotDir, system-signal=CAN1_RR_WhlRotDir}, {implementation-record-element=CAN1_RR_RawWhlSpeed_V, system-signal=CAN1_RR_RawWhlSpeed_V}, {implementation-record-element=CAN1_RR_RawWhlSpeed, system-signal=CAN1_RR_RawWhlSpeed}, {implementation-record-element=CAN1_RR_PulseCount_V, system-signal=CAN1_RR_PulseCount_V}, {implementation-record-element=CAN1_RR_PulseCount, system-signal=CAN1_RR_PulseCount}, {implementation-record-element=CAN1_RF_WhlRotDir, system-signal=CAN1_RF_WhlRotDir}, {implementation-record-element=CAN1_RF_RawWhlSpeed_V, system-signal=CAN1_RF_RawWhlSpeed_V}, {implementation-record-element=CAN1_RF_RawWhlSpeed, system-signal=CAN1_RF_RawWhlSpeed}, {implementation-record-element=CAN1_RF_PulseCount_V, system-signal=CAN1_RF_PulseCount_V}, {implementation-record-element=CAN1_RF_PulseCount, system-signal=CAN1_RF_PulseCount}, {implementation-record-element=CAN1_PBA_Failed, system-signal=CAN1_PBA_Failed}, {implementation-record-element=CAN1_PBA_Active, system-signal=CAN1_PBA_Active}, {implementation-record-element=CAN1_LR_WhlRotDir, system-signal=CAN1_LR_WhlRotDir}, {implementation-record-element=CAN1_LR_RawWhlSpeed_V, system-signal=CAN1_LR_RawWhlSpeed_V}, {implementation-record-element=CAN1_LR_RawWhlSpeed, system-signal=CAN1_LR_RawWhlSpeed}, {implementation-record-element=CAN1_LR_PulseCount_V, system-signal=CAN1_LR_PulseCount_V}, {implementation-record-element=CAN1_LR_PulseCount, system-signal=CAN1_LR_PulseCount}, {implementation-record-element=CAN1_LF_WhlRotDir, system-signal=CAN1_LF_WhlRotDir}, {implementation-record-element=CAN1_LF_RawWhlSpeed_V, system-signal=CAN1_LF_RawWhlSpeed_V}, {implementation-record-element=CAN1_LF_RawWhlSpeed, system-signal=CAN1_LF_RawWhlSpeed}, {implementation-record-element=CAN1_LF_PulseCount_V, system-signal=CAN1_LF_PulseCount_V}, {implementation-record-element=CAN1_LF_PulseCount, system-signal=CAN1_LF_PulseCount}, {implementation-record-element=CAN1_HSA_Failed, system-signal=CAN1_HSA_Failed}, {implementation-record-element=CAN1_HSA_Active, system-signal=CAN1_HSA_Active}, {implementation-record-element=CAN1_HDD_Failed, system-signal=CAN1_HDD_Failed}, {implementation-record-element=CAN1_HDD_Active, system-signal=CAN1_HDD_Active}, {implementation-record-element=CAN1_HBB_Failed, system-signal=CAN1_HBB_Failed}, {implementation-record-element=CAN1_HBB_Active, system-signal=CAN1_HBB_Active}, {implementation-record-element=CAN1_GRADE, system-signal=CAN1_GRADE}, {implementation-record-element=CAN1_FrntAxlTrqReq_Drv, system-signal=CAN1_FrntAxlTrqReq_Drv}, {implementation-record-element=CAN1_Fr_PTCS_Active, system-signal=CAN1_Fr_PTCS_Active}, {implementation-record-element=CAN1_ESS_Active, system-signal=CAN1_ESS_Active}, {implementation-record-element=CAN1_ESC_WnlmpSta, system-signal=CAN1_ESC_WnlmpSta}, {implementation-record-element=CAN1_ESC_TSA_Active, system-signal=CAN1_ESC_TSA_Active}, {implementation-record-element=CAN1_ESC_Off_lmpSta, system-signal=CAN1_ESC_Off_lmpSta}, {implementation-record-element=CAN1_ESC_OFF_Status, system-signal=CAN1_ESC_OFF_Status}, {implementation-record-element=CAN1_ESC_Failed, system-signal=CAN1_ESC_Failed}, {implementation-record-element=CAN1_ESC_EstVehSpd_V, system-signal=CAN1_ESC_EstVehSpd_V}, {implementation-record-element=CAN1_ESC_EstVehSpd, system-signal=CAN1_ESC_EstVehSpd}, {implementation-record-element=CAN1_ESC_BeepReq, system-signal=CAN1_ESC_BeepReq}, {implementation-record-element=CAN1_ESC_Active, system-signal=CAN1_ESC_Active}, {implementation-record-element=CAN1_ESC1_RC, system-signal=CAN1_ESC1_RC}, {implementation-record-element=CAN1_ESC1_CS, system-signal=CAN1_ESC1_CS}, {implementation-record-element=CAN1_EBD_Failed, system-signal=CAN1_EBD_Failed}, {implementation-record-element=CAN1_EBD_Active, system-signal=CAN1_EBD_Active}, {implementation-record-element=CAN1_BTCS_Active, system-signal=CAN1_BTCS_Active}, {implementation-record-element=CAN1_Amber_WnlmpSta, system-signal=CAN1_Amber_WnlmpSta}, {implementation-record-element=CAN1_AVH_Failed, system-signal=CAN1_AVH_Failed}, {implementation-record-element=CAN1_AVH_Active, system-signal=CAN1_AVH_Active}, {implementation-record-element=CAN1_ABS_WnlmpSta, system-signal=CAN1_ABS_WnlmpSta}, {implementation-record-element=CAN1_ABS_Failed, system-signal=CAN1_ABS_Failed}]}
      MAP_HALIN_R_CAN1_ESC5: sender-receiver-to-signal-group-mapping{communication-direction=IN, data-element=SWC_HALIN.root_FDC.R_CAN1_ESC5.CAN1_SG_ESC5, signal-group=CAN1_SG_ESC5, type-mapping=sender-rec-record-type-mapping=record-element-mappings=[{implementation-record-element=CAN1_ACCAvail, system-signal=CAN1_ACCAvail}, {implementation-record-element=CAN1_YawRate_V, system-signal=CAN1_YawRate_V}, {implementation-record-element=CAN1_YawRate, system-signal=CAN1_YawRate}, {implementation-record-element=CAN1_Rr_RBC_Active, system-signal=CAN1_Rr_RBC_Active}, {implementation-record-element=CAN1_RearAxlTrqReq_Brk, system-signal=CAN1_RearAxlTrqReq_Brk}, {implementation-record-element=CAN1_RDC_Active, system-signal=CAN1_RDC_Active}, {implementation-record-element=CAN1_Meter_Ind_VehSpeed, system-signal=CAN1_Meter_Ind_VehSpeed}, {implementation-record-element=CAN1_MCPressure_V, system-signal=CAN1_MCPressure_V}, {implementation-record-element=CAN1_MCPressure, system-signal=CAN1_MCPressure}, {implementation-record-element=CAN1_LongAccel_V, system-signal=CAN1_LongAccel_V}, {implementation-record-element=CAN1_LongAccel, system-signal=CAN1_LongAccel}, {implementation-record-element=CAN1_LatAccel_V, system-signal=CAN1_LatAccel_V}, {implementation-record-element=CAN1_LatAccel, system-signal=CAN1_LatAccel}, {implementation-record-element=CAN1_FrntAxlTrqReq_Brk, system-signal=CAN1_FrntAxlTrqReq_Brk}, {implementation-record-element=CAN1_Fr_RBC_Active, system-signal=CAN1_Fr_RBC_Active}, {implementation-record-element=CAN1_ESC_Standstill, system-signal=CAN1_ESC_Standstill}, {implementation-record-element=CAN1_ESC_DriverBrkOverride, system-signal=CAN1_ESC_DriverBrkOverride}, {implementation-record-element=CAN1_ESC_APS_Sta, system-signal=CAN1_ESC_APS_Sta}, {implementation-record-element=CAN1_ESC_ADAS_Sta, system-signal=CAN1_ESC_ADAS_Sta}, {implementation-record-element=CAN1_ESC5_RC, system-signal=CAN1_ESC5_RC}, {implementation-record-element=CAN1_ESC5_CS, system-signal=CAN1_ESC5_CS}, {implementation-record-element=CAN1_DecErrSta, system-signal=CAN1_DecErrSta}, {implementation-record-element=CAN1_BrkSw_V, system-signal=CAN1_BrkSw_V}, {implementation-record-element=CAN1_BrkSw_Sta, system-signal=CAN1_BrkSw_Sta}, {implementation-record-element=CAN1_BrkPedalPos_Sta, system-signal=CAN1_BrkPedalPos_Sta}, {implementation-record-element=CAN1_BrkPedalPos, system-signal=CAN1_BrkPedalPos}, {implementation-record-element=CAN1_BrkDiscTempSta, system-signal=CAN1_BrkDiscTempSta}, {implementation-record-element=CAN1_ActBrkLamp_Sta, system-signal=CAN1_ActBrkLamp_Sta}, {implementation-record-element=CAN1_AEBAvail, system-signal=CAN1_AEBAvail}]}
      MAP_HALIN_R_CAN1_eBST1: sender-receiver-to-signal-group-mapping{communication-direction=IN, data-element=SWC_HALIN.root_FDC.R_CAN1_eBST1.CAN1_SG_eBST1, signal-group=CAN1_SG_eBST1, type-mapping=sender-rec-record-type-mapping=record-element-mappings=[{implementation-record-element=CAN1_LowBrakeFluid_Sta, system-signal=CAN1_LowBrakeFluid_Sta}, {implementation-record-element=CAN1_eBST_RedWnlmpSta, system-signal=CAN1_eBST_RedWnlmpSta}, {implementation-record-element=CAN1_eBST_BeepReq, system-signal=CAN1_eBST_BeepReq}, {implementation-record-element=CAN1_eBST_AmberWnlmpSta, system-signal=CAN1_eBST_AmberWnlmpSta}]}
      MAP_HALIN_R_CAN2_HMI1: sender-receiver-to-signal-group-mapping{communication-direction=IN, data-element=SWC_HALIN.root_FDC.R_CAN2_HMI1.CAN2_SG_HMI1, signal-group=CAN2_SG_HMI1, type-mapping=sender-rec-record-type-mapping=record-element-mappings=[{implementation-record-element=CAN2_HMI_ACAirIntM_Cmd, system-signal=CAN2_HMI_ACAirIntM_Cmd}, {implementation-record-element=CAN2_HMI_ZRSetTP_Cmd, system-signal=CAN2_HMI_ZRSetTP_Cmd}, {implementation-record-element=CAN2_HMI_ZRSetTM_Cmd, system-signal=CAN2_HMI_ZRSetTM_Cmd}, {implementation-record-element=CAN2_HMI_ZLSetTP_Cmd, system-signal=CAN2_HMI_ZLSetTP_Cmd}, {implementation-record-element=CAN2_HMI_ZLSetTM_Cmd, system-signal=CAN2_HMI_ZLSetTM_Cmd}, {implementation-record-element=CAN2_HMI_PSEAT_LevelUp_Cmd, system-signal=CAN2_HMI_PSEAT_LevelUp_Cmd}, {implementation-record-element=CAN2_HMI_PSEAT_LevelDown_Cmd, system-signal=CAN2_HMI_PSEAT_LevelDown_Cmd}, {implementation-record-element=CAN2_HMI_Function6_LevelUp_Cmd, system-signal=CAN2_HMI_Function6_LevelUp_Cmd}, {implementation-record-element=CAN2_HMI_Function6_LevelDown_Cmd, system-signal=CAN2_HMI_Function6_LevelDown_Cmd}, {implementation-record-element=CAN2_HMI_Function5_LevelUp_Cmd, system-signal=CAN2_HMI_Function5_LevelUp_Cmd}, {implementation-record-element=CAN2_HMI_Function5_LevelDown_Cmd, system-signal=CAN2_HMI_Function5_LevelDown_Cmd}, {implementation-record-element=CAN2_HMI_Function4_LevelUp_Cmd, system-signal=CAN2_HMI_Function4_LevelUp_Cmd}, {implementation-record-element=CAN2_HMI_Function4_LevelDown_Cmd, system-signal=CAN2_HMI_Function4_LevelDown_Cmd}, {implementation-record-element=CAN2_HMI_Function3_LevelUp_Cmd, system-signal=CAN2_HMI_Function3_LevelUp_Cmd}, {implementation-record-element=CAN2_HMI_Function3_LevelDown_Cmd, system-signal=CAN2_HMI_Function3_LevelDown_Cmd}, {implementation-record-element=CAN2_HMI_Function2_LevelUp_Cmd, system-signal=CAN2_HMI_Function2_LevelUp_Cmd}, {implementation-record-element=CAN2_HMI_Function2_LevelDown_Cmd, system-signal=CAN2_HMI_Function2_LevelDown_Cmd}, {implementation-record-element=CAN2_HMI_Function1_LevelUp_Cmd, system-signal=CAN2_HMI_Function1_LevelUp_Cmd}, {implementation-record-element=CAN2_HMI_Function1_LevelDown_Cmd, system-signal=CAN2_HMI_Function1_LevelDown_Cmd}, {implementation-record-element=CAN2_HMI_DSEAT_LevelUp_Cmd, system-signal=CAN2_HMI_DSEAT_LevelUp_Cmd}, {implementation-record-element=CAN2_HMI_DSEAT_LevelDown_Cmd, system-signal=CAN2_HMI_DSEAT_LevelDown_Cmd}, {implementation-record-element=CAN2_HMI_BCMPostDefogBtn_Cmd, system-signal=CAN2_HMI_BCMPostDefogBtn_Cmd}, {implementation-record-element=CAN2_HMI_AutoInterLight_Cmd, system-signal=CAN2_HMI_AutoInterLight_Cmd}, {implementation-record-element=CAN2_HMI_ACWindDirP_Cmd, system-signal=CAN2_HMI_ACWindDirP_Cmd}, {implementation-record-element=CAN2_HMI_ACWindDirM_Cmd, system-signal=CAN2_HMI_ACWindDirM_Cmd}, {implementation-record-element=CAN2_HMI_ACRecycleBtn_Cmd, system-signal=CAN2_HMI_ACRecycleBtn_Cmd}, {implementation-record-element=CAN2_HMI_ACFrDefogBtn_Cmd, system-signal=CAN2_HMI_ACFrDefogBtn_Cmd}, {implementation-record-element=CAN2_HMI_ACBtn_Cmd, system-signal=CAN2_HMI_ACBtn_Cmd}, {implementation-record-element=CAN2_HMI_ACAutoBtn_Cmd, system-signal=CAN2_HMI_ACAutoBtn_Cmd}, {implementation-record-element=CAN2_HMI_ACAirIntP_Cmd, system-signal=CAN2_HMI_ACAirIntP_Cmd}]}
      MAP_HALIN_R_CAN2_IVI1: sender-receiver-to-signal-group-mapping{communication-direction=IN, data-element=SWC_HALIN.root_FDC.R_CAN2_IVI1.CAN2_SG_IVI1, signal-group=CAN2_SG_IVI1, type-mapping=sender-rec-record-type-mapping=record-element-mappings=[{implementation-record-element=CAN2_A2B_Node_sta, system-signal=CAN2_A2B_Node_sta}, {implementation-record-element=CAN2_mFRD_link_Sta, system-signal=CAN2_mFRD_link_Sta}, {implementation-record-element=CAN2_VehACModReq, system-signal=CAN2_VehACModReq}, {implementation-record-element=CAN2_UserSet, system-signal=CAN2_UserSet}, {implementation-record-element=CAN2_Upd_Countdown_Skip, system-signal=CAN2_Upd_Countdown_Skip}, {implementation-record-element=CAN2_Upd_Countdown_Cancel, system-signal=CAN2_Upd_Countdown_Cancel}, {implementation-record-element=CAN2_SmartEco_Mode_SW, system-signal=CAN2_SmartEco_Mode_SW}, {implementation-record-element=CAN2_Sched_OTA_wake, system-signal=CAN2_Sched_OTA_wake}, {implementation-record-element=CAN2_Sched_Chg_St_Time_Min, system-signal=CAN2_Sched_Chg_St_Time_Min}, {implementation-record-element=CAN2_Sched_Chg_St_Time_HR, system-signal=CAN2_Sched_Chg_St_Time_HR}, {implementation-record-element=CAN2_Sched_Chg_End_Time_Min, system-signal=CAN2_Sched_Chg_End_Time_Min}, {implementation-record-element=CAN2_Sched_Chg_End_Time_HR, system-signal=CAN2_Sched_Chg_End_Time_HR}, {implementation-record-element=CAN2_Sched_Chg_Day_Set, system-signal=CAN2_Sched_Chg_Day_Set}, {implementation-record-element=CAN2_Re_Radio_Sta, system-signal=CAN2_Re_Radio_Sta}, {implementation-record-element=CAN2_PW_CONTINUE_USE, system-signal=CAN2_PW_CONTINUE_USE}, {implementation-record-element=CAN2_PW_CLOSE_IMD, system-signal=CAN2_PW_CLOSE_IMD}, {implementation-record-element=CAN2_OpenDrOpenWdo_SW, system-signal=CAN2_OpenDrOpenWdo_SW}, {implementation-record-element=CAN2_OTA_UpdStart_Req, system-signal=CAN2_OTA_UpdStart_Req}, {implementation-record-element=CAN2_OTA_SuspendDL_Req, system-signal=CAN2_OTA_SuspendDL_Req}, {implementation-record-element=CAN2_OTA_DL_Req, system-signal=CAN2_OTA_DL_Req}, {implementation-record-element=CAN2_OTA_CompNTFY_Pres, system-signal=CAN2_OTA_CompNTFY_Pres}, {implementation-record-element=CAN2_OTA_CancelDL_Req, system-signal=CAN2_OTA_CancelDL_Req}, {implementation-record-element=CAN2_LINKtoDrive, system-signal=CAN2_LINKtoDrive}, {implementation-record-element=CAN2_IVI_sigScreenReq_Sta, system-signal=CAN2_IVI_sigScreenReq_Sta}, {implementation-record-element=CAN2_IVI_WirelessCharge_Cmd, system-signal=CAN2_IVI_WirelessCharge_Cmd}, {implementation-record-element=CAN2_IVI_WPTC_SW_Sta, system-signal=CAN2_IVI_WPTC_SW_Sta}, {implementation-record-element=CAN2_IVI_Time_Year, system-signal=CAN2_IVI_Time_Year}, {implementation-record-element=CAN2_IVI_Time_Second, system-signal=CAN2_IVI_Time_Second}, {implementation-record-element=CAN2_IVI_Time_Month, system-signal=CAN2_IVI_Time_Month}, {implementation-record-element=CAN2_IVI_Time_Minute, system-signal=CAN2_IVI_Time_Minute}, {implementation-record-element=CAN2_IVI_Time_Hour, system-signal=CAN2_IVI_Time_Hour}, {implementation-record-element=CAN2_IVI_Time_Day, system-signal=CAN2_IVI_Time_Day}, {implementation-record-element=CAN2_IVI_Time_Check, system-signal=CAN2_IVI_Time_Check}, {implementation-record-element=CAN2_IVI_Theme_Sta, system-signal=CAN2_IVI_Theme_Sta}, {implementation-record-element=CAN2_IVI_Stopping_Unlock_SW_Sta, system-signal=CAN2_IVI_Stopping_Unlock_SW_Sta}, {implementation-record-element=CAN2_IVI_SilentChrg_Alert_Sta, system-signal=CAN2_IVI_SilentChrg_Alert_Sta}, {implementation-record-element=CAN2_IVI_SWC_VibMode_Sta, system-signal=CAN2_IVI_SWC_VibMode_Sta}, {implementation-record-element=CAN2_IVI_QuickRefresh_Sta, system-signal=CAN2_IVI_QuickRefresh_Sta}, {implementation-record-element=CAN2_IVI_OTA_Upd_Sta, system-signal=CAN2_IVI_OTA_Upd_Sta}, {implementation-record-element=CAN2_IVI_NAVI_Foreground_Sta, system-signal=CAN2_IVI_NAVI_Foreground_Sta}, {implementation-record-element=CAN2_IVI_MirrorFolded_SW_Sta, system-signal=CAN2_IVI_MirrorFolded_SW_Sta}, {implementation-record-element=CAN2_IVI_Lock_SoundSW_Sta, system-signal=CAN2_IVI_Lock_SoundSW_Sta}, {implementation-record-element=CAN2_IVI_Located_STA, system-signal=CAN2_IVI_Located_STA}, {implementation-record-element=CAN2_IVI_LinkKey_Sta, system-signal=CAN2_IVI_LinkKey_Sta}, {implementation-record-element=CAN2_IVI_LinkAcc_Sta, system-signal=CAN2_IVI_LinkAcc_Sta}, {implementation-record-element=CAN2_IVI_LinkAccReq_Sta, system-signal=CAN2_IVI_LinkAccReq_Sta}, {implementation-record-element=CAN2_IVI_HMI_Undefined_Sta, system-signal=CAN2_IVI_HMI_Undefined_Sta}, {implementation-record-element=CAN2_IVI_FrTrunk_UnlockReq_Sta, system-signal=CAN2_IVI_FrTrunk_UnlockReq_Sta}, {implementation-record-element=CAN2_IVI_EPS_Force_Cmd, system-signal=CAN2_IVI_EPS_Force_Cmd}, {implementation-record-element=CAN2_IVI_Driving_Lock_SW_Sta, system-signal=CAN2_IVI_Driving_Lock_SW_Sta}, {implementation-record-element=CAN2_IVI_DelAccReq_Sta, system-signal=CAN2_IVI_DelAccReq_Sta}, {implementation-record-element=CAN2_IVI_DSEAT_entryfun_set_Sta, system-signal=CAN2_IVI_DSEAT_entryfun_set_Sta}, {implementation-record-element=CAN2_IVI_DSEAT_anti_set_Sta, system-signal=CAN2_IVI_DSEAT_anti_set_Sta}, {implementation-record-element=CAN2_IVI_DSEAT_StopKeepMove_Sta, system-signal=CAN2_IVI_DSEAT_StopKeepMove_Sta}, {implementation-record-element=CAN2_IVI_DMS_SW_Sta, system-signal=CAN2_IVI_DMS_SW_Sta}, {implementation-record-element=CAN2_IVI_CreateAccReq_Sta, system-signal=CAN2_IVI_CreateAccReq_Sta}, {implementation-record-element=CAN2_IVI_CLWin_LockDoorSW_Sta, system-signal=CAN2_IVI_CLWin_LockDoorSW_Sta}, {implementation-record-element=CAN2_IVI_AutoWipHSpdSW_Cmd, system-signal=CAN2_IVI_AutoWipHSpdSW_Cmd}, {implementation-record-element=CAN2_IVI_AutoTheme_But_Sta, system-signal=CAN2_IVI_AutoTheme_But_Sta}, {implementation-record-element=CAN2_IVI_AirRefresh_ByDMS_Sta, system-signal=CAN2_IVI_AirRefresh_ByDMS_Sta}, {implementation-record-element=CAN2_FCP_MidEvt_BtnAutoReq, system-signal=CAN2_FCP_MidEvt_BtnAutoReq}, {implementation-record-element=CAN2_FCP_FrEvt_BtnSyncReq, system-signal=CAN2_FCP_FrEvt_BtnSyncReq}, {implementation-record-element=CAN2_FCP_FrEvt_BtnAutoReq, system-signal=CAN2_FCP_FrEvt_BtnAutoReq}, {implementation-record-element=CAN2_FCP_FrEvt_BtnACReq, system-signal=CAN2_FCP_FrEvt_BtnACReq}, {implementation-record-element=CAN2_FCP_FrEvt_BtnACMaxReq, system-signal=CAN2_FCP_FrEvt_BtnACMaxReq}, {implementation-record-element=CAN2_BrkAbn_GoReady_SW, system-signal=CAN2_BrkAbn_GoReady_SW}, {implementation-record-element=CAN2_AmbLight_WlcmLight_SW, system-signal=CAN2_AmbLight_WlcmLight_SW}, {implementation-record-element=CAN2_AmbLight_SW, system-signal=CAN2_AmbLight_SW}, {implementation-record-element=CAN2_AmbLight_DimInDark_SW, system-signal=CAN2_AmbLight_DimInDark_SW}, {implementation-record-element=CAN2_AmbLightColorSet, system-signal=CAN2_AmbLightColorSet}, {implementation-record-element=CAN2_AmbLightBrightnessSet, system-signal=CAN2_AmbLightBrightnessSet}, {implementation-record-element=CAN2_AmbLigh_SafetyAlert_SW, system-signal=CAN2_AmbLigh_SafetyAlert_SW}, {implementation-record-element=CAN2_AmbLigh_LowBatAlert_SW, system-signal=CAN2_AmbLigh_LowBatAlert_SW}]}
      MAP_HALIN_R_CAN2_IVI2: sender-receiver-to-signal-group-mapping{communication-direction=IN, data-element=SWC_HALIN.root_FDC.R_CAN2_IVI2.CAN2_SG_IVI2, signal-group=CAN2_SG_IVI2, type-mapping=sender-rec-record-type-mapping=record-element-mappings=[{implementation-record-element=CAN2_AC_Chg_Cur_Set, system-signal=CAN2_AC_Chg_Cur_Set}, {implementation-record-element=CAN2_sigWindDirZon3Req, system-signal=CAN2_sigWindDirZon3Req}, {implementation-record-element=CAN2_sigSetTempZon3Req, system-signal=CAN2_sigSetTempZon3Req}, {implementation-record-element=CAN2_sigSetTempZon2Req, system-signal=CAN2_sigSetTempZon2Req}, {implementation-record-element=CAN2_sigSetTempZon1Req, system-signal=CAN2_sigSetTempZon1Req}, {implementation-record-element=CAN2_sigRecircReq, system-signal=CAN2_sigRecircReq}, {implementation-record-element=CAN2_sigHvacReq, system-signal=CAN2_sigHvacReq}, {implementation-record-element=CAN2_sigHvacRearReq, system-signal=CAN2_sigHvacRearReq}, {implementation-record-element=CAN2_sigHvacFrontReq, system-signal=CAN2_sigHvacFrontReq}, {implementation-record-element=CAN2_sigFootReq, system-signal=CAN2_sigFootReq}, {implementation-record-element=CAN2_sigFaceReq, system-signal=CAN2_sigFaceReq}, {implementation-record-element=CAN2_sigDfrstReq, system-signal=CAN2_sigDfrstReq}, {implementation-record-element=CAN2_sigAirIntenZon3Req, system-signal=CAN2_sigAirIntenZon3Req}, {implementation-record-element=CAN2_sigAirIntenZon1Req, system-signal=CAN2_sigAirIntenZon1Req}, {implementation-record-element=CAN2_WlcmLight_Mode, system-signal=CAN2_WlcmLight_Mode}, {implementation-record-element=CAN2_Wifi_Sta_IVI_TBOX, system-signal=CAN2_Wifi_Sta_IVI_TBOX}, {implementation-record-element=CAN2_Wifi_Reset, system-signal=CAN2_Wifi_Reset}, {implementation-record-element=CAN2_Walkaway_Lock_SW, system-signal=CAN2_Walkaway_Lock_SW}, {implementation-record-element=CAN2_User_p_upload, system-signal=CAN2_User_p_upload}, {implementation-record-element=CAN2_User_p_download, system-signal=CAN2_User_p_download}, {implementation-record-element=CAN2_TurnSwTimeSet, system-signal=CAN2_TurnSwTimeSet}, {implementation-record-element=CAN2_Time_system, system-signal=CAN2_Time_system}, {implementation-record-element=CAN2_Temperature_unit, system-signal=CAN2_Temperature_unit}, {implementation-record-element=CAN2_TPMS_Res_Butt, system-signal=CAN2_TPMS_Res_Butt}, {implementation-record-element=CAN2_TPMS_Cali_Butt, system-signal=CAN2_TPMS_Cali_Butt}, {implementation-record-element=CAN2_TCS_SW_Cmd, system-signal=CAN2_TCS_SW_Cmd}, {implementation-record-element=CAN2_SetUnlockSingle, system-signal=CAN2_SetUnlockSingle}, {implementation-record-element=CAN2_SenstivityPosition, system-signal=CAN2_SenstivityPosition}, {implementation-record-element=CAN2_Sched_Chg_wake, system-signal=CAN2_Sched_Chg_wake}, {implementation-record-element=CAN2_Sched_Chg_limit, system-signal=CAN2_Sched_Chg_limit}, {implementation-record-element=CAN2_Sched_Chg_butt, system-signal=CAN2_Sched_Chg_butt}, {implementation-record-element=CAN2_Sched_Chg_Stop, system-signal=CAN2_Sched_Chg_Stop}, {implementation-record-element=CAN2_Sched_Chg_Start, system-signal=CAN2_Sched_Chg_Start}, {implementation-record-element=CAN2_SOC_V2LLimit, system-signal=CAN2_SOC_V2LLimit}, {implementation-record-element=CAN2_SOC_Limit_Set, system-signal=CAN2_SOC_Limit_Set}, {implementation-record-element=CAN2_SOC_ADJ_BUTT, system-signal=CAN2_SOC_ADJ_BUTT}, {implementation-record-element=CAN2_SLIF_BUTT, system-signal=CAN2_SLIF_BUTT}, {implementation-record-element=CAN2_SLG_Sw, system-signal=CAN2_SLG_Sw}, {implementation-record-element=CAN2_RoomLampMode, system-signal=CAN2_RoomLampMode}, {implementation-record-element=CAN2_Roll_Mode_SW_Cmd, system-signal=CAN2_Roll_Mode_SW_Cmd}, {implementation-record-element=CAN2_Roll_Eng_Mode, system-signal=CAN2_Roll_Eng_Mode}, {implementation-record-element=CAN2_RFogLampSW, system-signal=CAN2_RFogLampSW}, {implementation-record-element=CAN2_RCTA_BUTT, system-signal=CAN2_RCTA_BUTT}, {implementation-record-element=CAN2_Pressure_unit, system-signal=CAN2_Pressure_unit}, {implementation-record-element=CAN2_Perd_V2L, system-signal=CAN2_Perd_V2L}, {implementation-record-element=CAN2_PSEAT_vent_req, system-signal=CAN2_PSEAT_vent_req}, {implementation-record-element=CAN2_OFF_AC_MODE, system-signal=CAN2_OFF_AC_MODE}, {implementation-record-element=CAN2_ODAMute_BUTT, system-signal=CAN2_ODAMute_BUTT}, {implementation-record-element=CAN2_NAVI_Tunnel, system-signal=CAN2_NAVI_Tunnel}, {implementation-record-element=CAN2_NAVI_Tollgate, system-signal=CAN2_NAVI_Tollgate}, {implementation-record-element=CAN2_NAVI_State, system-signal=CAN2_NAVI_State}, {implementation-record-element=CAN2_NAVI_Speed_Limit_A, system-signal=CAN2_NAVI_Speed_Limit_A}, {implementation-record-element=CAN2_NAVI_SpeedLimit, system-signal=CAN2_NAVI_SpeedLimit}, {implementation-record-element=CAN2_NAVI_RoadClass, system-signal=CAN2_NAVI_RoadClass}, {implementation-record-element=CAN2_NAVI_LinkClass, system-signal=CAN2_NAVI_LinkClass}, {implementation-record-element=CAN2_NAVI_ForwardLinkLevel, system-signal=CAN2_NAVI_ForwardLinkLevel}, {implementation-record-element=CAN2_NAVI_Distance_info, system-signal=CAN2_NAVI_Distance_info}, {implementation-record-element=CAN2_NAVI_Direction_STA, system-signal=CAN2_NAVI_Direction_STA}, {implementation-record-element=CAN2_NAVI_Cam_Dist_info, system-signal=CAN2_NAVI_Cam_Dist_info}, {implementation-record-element=CAN2_MFRD_N_Bright_Req, system-signal=CAN2_MFRD_N_Bright_Req}, {implementation-record-element=CAN2_METER_Malfunc_Sta, system-signal=CAN2_METER_Malfunc_Sta}, {implementation-record-element=CAN2_Light_ShowStop_Req, system-signal=CAN2_Light_ShowStop_Req}, {implementation-record-element=CAN2_Light_ShowStart_Req, system-signal=CAN2_Light_ShowStart_Req}, {implementation-record-element=CAN2_L_RRD_ControlCommand, system-signal=CAN2_L_RRD_ControlCommand}, {implementation-record-element=CAN2_L_RLD_ControlCommand, system-signal=CAN2_L_RLD_ControlCommand}, {implementation-record-element=CAN2_L_Pas_ControlCommand, system-signal=CAN2_L_Pas_ControlCommand}, {implementation-record-element=CAN2_L_Drv_ControlCommand, system-signal=CAN2_L_Drv_ControlCommand}, {implementation-record-element=CAN2_LVDAMute_BUTT, system-signal=CAN2_LVDAMute_BUTT}, {implementation-record-element=CAN2_LKA_BUTT, system-signal=CAN2_LKA_BUTT}, {implementation-record-element=CAN2_LDWMute_BUTT, system-signal=CAN2_LDWMute_BUTT}, {implementation-record-element=CAN2_IVI_WI_MAIN_SW, system-signal=CAN2_IVI_WI_MAIN_SW}, {implementation-record-element=CAN2_IVI_Unlock_Chg_req, system-signal=CAN2_IVI_Unlock_Chg_req}, {implementation-record-element=CAN2_IVI_Trigger_req, system-signal=CAN2_IVI_Trigger_req}, {implementation-record-element=CAN2_IVI_TrailerModeSW_Sta, system-signal=CAN2_IVI_TrailerModeSW_Sta}, {implementation-record-element=CAN2_IVI_TrailerCheckReq_Sta, system-signal=CAN2_IVI_TrailerCheckReq_Sta}, {implementation-record-element=CAN2_IVI_Stop_Chg_req, system-signal=CAN2_IVI_Stop_Chg_req}, {implementation-record-element=CAN2_IVI_Status, system-signal=CAN2_IVI_Status}, {implementation-record-element=CAN2_IVI_Start_Chg_req, system-signal=CAN2_IVI_Start_Chg_req}, {implementation-record-element=CAN2_IVI_SetTempZon2_Sta, system-signal=CAN2_IVI_SetTempZon2_Sta}, {implementation-record-element=CAN2_IVI_SetTempZon1_Sta, system-signal=CAN2_IVI_SetTempZon1_Sta}, {implementation-record-element=CAN2_IVI_Screen, system-signal=CAN2_IVI_Screen}, {implementation-record-element=CAN2_IVI_SWC_RUndefined_Sta, system-signal=CAN2_IVI_SWC_RUndefined_Sta}, {implementation-record-element=CAN2_IVI_SWC_LUndefined_Sta, system-signal=CAN2_IVI_SWC_LUndefined_Sta}, {implementation-record-element=CAN2_IVI_SWC_ACCMode_Sta, system-signal=CAN2_IVI_SWC_ACCMode_Sta}, {implementation-record-element=CAN2_IVI_SLIF_Warning_Sta, system-signal=CAN2_IVI_SLIF_Warning_Sta}, {implementation-record-element=CAN2_IVI_Req_V2L, system-signal=CAN2_IVI_Req_V2L}, {implementation-record-element=CAN2_IVI_RR_Def_Req, system-signal=CAN2_IVI_RR_Def_Req}, {implementation-record-element=CAN2_IVI_Pwroff_req, system-signal=CAN2_IVI_Pwroff_req}, {implementation-record-element=CAN2_IVI_PwrLockSW, system-signal=CAN2_IVI_PwrLockSW}, {implementation-record-element=CAN2_IVI_Panel_Y_Coor, system-signal=CAN2_IVI_Panel_Y_Coor}, {implementation-record-element=CAN2_IVI_Panel_X_Coor, system-signal=CAN2_IVI_Panel_X_Coor}, {implementation-record-element=CAN2_IVI_Panel_Act, system-signal=CAN2_IVI_Panel_Act}, {implementation-record-element=CAN2_IVI_PW_Mode_Req, system-signal=CAN2_IVI_PW_Mode_Req}, {implementation-record-element=CAN2_IVI_PTG_USSta_SW, system-signal=CAN2_IVI_PTG_USSta_SW}, {implementation-record-element=CAN2_IVI_PTG_Sta_SW, system-signal=CAN2_IVI_PTG_Sta_SW}, {implementation-record-element=CAN2_IVI_PTG_Open_Height, system-signal=CAN2_IVI_PTG_Open_Height}, {implementation-record-element=CAN2_IVI_PTG_Mode_SW, system-signal=CAN2_IVI_PTG_Mode_SW}, {implementation-record-element=CAN2_IVI_PSEAT_Slide_Cmd, system-signal=CAN2_IVI_PSEAT_Slide_Cmd}, {implementation-record-element=CAN2_IVI_PSEAT_Recline_Cmd, system-signal=CAN2_IVI_PSEAT_Recline_Cmd}, {implementation-record-element=CAN2_IVI_PSEATHeater_Cmd, system-signal=CAN2_IVI_PSEATHeater_Cmd}, {implementation-record-element=CAN2_IVI_Off_Road_Mode_Sta, system-signal=CAN2_IVI_Off_Road_Mode_Sta}, {implementation-record-element=CAN2_IVI_Night_Mode_Sta, system-signal=CAN2_IVI_Night_Mode_Sta}, {implementation-record-element=CAN2_IVI_Mute_Sta, system-signal=CAN2_IVI_Mute_Sta}, {implementation-record-element=CAN2_IVI_LVChrgFuncSW, system-signal=CAN2_IVI_LVChrgFuncSW}, {implementation-record-element=CAN2_IVI_ISA_OffsetSpd, system-signal=CAN2_IVI_ISA_OffsetSpd}, {implementation-record-element=CAN2_IVI_IONSW_Cmd, system-signal=CAN2_IVI_IONSW_Cmd}, {implementation-record-element=CAN2_IVI_IC_Brightness_Sta, system-signal=CAN2_IVI_IC_Brightness_Sta}, {implementation-record-element=CAN2_IVI_GPS_Long_Dir_Sta, system-signal=CAN2_IVI_GPS_Long_Dir_Sta}, {implementation-record-element=CAN2_IVI_GPS_Lat_Dir_Sta, system-signal=CAN2_IVI_GPS_Lat_Dir_Sta}, {implementation-record-element=CAN2_IVI_FWipIntTSet_Cmd, system-signal=CAN2_IVI_FWipIntTSet_Cmd}, {implementation-record-element=CAN2_IVI_FGSCh_Cmd, system-signal=CAN2_IVI_FGSCh_Cmd}, {implementation-record-element=CAN2_IVI_FGSAirInt_Cmd, system-signal=CAN2_IVI_FGSAirInt_Cmd}, {implementation-record-element=CAN2_IVI_DSEAT_Slide_Cmd, system-signal=CAN2_IVI_DSEAT_Slide_Cmd}, {implementation-record-element=CAN2_IVI_DSEAT_Recline_Cmd, system-signal=CAN2_IVI_DSEAT_Recline_Cmd}, {implementation-record-element=CAN2_IVI_DSEAT_Memory_OPTCLS_Sta, system-signal=CAN2_IVI_DSEAT_Memory_OPTCLS_Sta}, {implementation-record-element=CAN2_IVI_DSEAT_Memory2_Sta, system-signal=CAN2_IVI_DSEAT_Memory2_Sta}, {implementation-record-element=CAN2_IVI_DSEAT_Memory1_Sta, system-signal=CAN2_IVI_DSEAT_Memory1_Sta}, {implementation-record-element=CAN2_IVI_DSEAT_Height_Cmd, system-signal=CAN2_IVI_DSEAT_Height_Cmd}, {implementation-record-element=CAN2_IVI_DSEAT_FroEdge_Height_Cmd, system-signal=CAN2_IVI_DSEAT_FroEdge_Height_Cmd}, {implementation-record-element=CAN2_IVI_DSEATHeater_Cmd, system-signal=CAN2_IVI_DSEATHeater_Cmd}, {implementation-record-element=CAN2_IVI_DMS_NoDriverDetected_Sta, system-signal=CAN2_IVI_DMS_NoDriverDetected_Sta}, {implementation-record-element=CAN2_IVI_DMS_Faceblocked_Sta, system-signal=CAN2_IVI_DMS_Faceblocked_Sta}, {implementation-record-element=CAN2_IVI_CreepSW_Req, system-signal=CAN2_IVI_CreepSW_Req}, {implementation-record-element=CAN2_IVI_CoastDwSW, system-signal=CAN2_IVI_CoastDwSW}, {implementation-record-element=CAN2_IVI_ChargePortSW_Sta, system-signal=CAN2_IVI_ChargePortSW_Sta}, {implementation-record-element=CAN2_IVI_CfmTo_Rdy, system-signal=CAN2_IVI_CfmTo_Rdy}, {implementation-record-element=CAN2_IVI_CarWash_Mode_Cmd, system-signal=CAN2_IVI_CarWash_Mode_Cmd}, {implementation-record-element=CAN2_IVI_Backlight_Sta, system-signal=CAN2_IVI_Backlight_Sta}, {implementation-record-element=CAN2_IVI_AirIntZ3_Cmd, system-signal=CAN2_IVI_AirIntZ3_Cmd}, {implementation-record-element=CAN2_IVI_ActvDmpDisabSW, system-signal=CAN2_IVI_ActvDmpDisabSW}, {implementation-record-element=CAN2_IVI_AGSCloseSW, system-signal=CAN2_IVI_AGSCloseSW}, {implementation-record-element=CAN2_IVI_ACC_Adaptive_Sta, system-signal=CAN2_IVI_ACC_Adaptive_Sta}, {implementation-record-element=CAN2_Hood_Latch_SW, system-signal=CAN2_Hood_Latch_SW}, {implementation-record-element=CAN2_HeadLampSW, system-signal=CAN2_HeadLampSW}, {implementation-record-element=CAN2_GPS_LONG, system-signal=CAN2_GPS_LONG}, {implementation-record-element=CAN2_GPS_LAT, system-signal=CAN2_GPS_LAT}, {implementation-record-element=CAN2_FollowMeSW, system-signal=CAN2_FollowMeSW}, {implementation-record-element=CAN2_FalseNPrevent_SW, system-signal=CAN2_FalseNPrevent_SW}, {implementation-record-element=CAN2_FS_Off_Sw, system-signal=CAN2_FS_Off_Sw}, {implementation-record-element=CAN2_FFogLampSW, system-signal=CAN2_FFogLampSW}, {implementation-record-element=CAN2_FCWMute_BUTT, system-signal=CAN2_FCWMute_BUTT}, {implementation-record-element=CAN2_ESC_SW_Cmd, system-signal=CAN2_ESC_SW_Cmd}, {implementation-record-element=CAN2_Distance_unit, system-signal=CAN2_Distance_unit}, {implementation-record-element=CAN2_DSEAT_vent_req, system-signal=CAN2_DSEAT_vent_req}, {implementation-record-element=CAN2_DSEAT_entryfun_set, system-signal=CAN2_DSEAT_entryfun_set}, {implementation-record-element=CAN2_DSEAT_anti_set, system-signal=CAN2_DSEAT_anti_set}, {implementation-record-element=CAN2_DMS_Warning_Unresponsive, system-signal=CAN2_DMS_Warning_Unresponsive}, {implementation-record-element=CAN2_DMS_Warning_Fatigue, system-signal=CAN2_DMS_Warning_Fatigue}, {implementation-record-element=CAN2_DMS_Warning_Distraction, system-signal=CAN2_DMS_Warning_Distraction}, {implementation-record-element=CAN2_DMS_Status, system-signal=CAN2_DMS_Status}, {implementation-record-element=CAN2_CameraWrn, system-signal=CAN2_CameraWrn}, {implementation-record-element=CAN2_CDL_Unlock_Butt, system-signal=CAN2_CDL_Unlock_Butt}, {implementation-record-element=CAN2_CDL_Lock_Butt, system-signal=CAN2_CDL_Lock_Butt}, {implementation-record-element=CAN2_CAAS_Sw, system-signal=CAN2_CAAS_Sw}, {implementation-record-element=CAN2_BSDMute_BUTT, system-signal=CAN2_BSDMute_BUTT}, {implementation-record-element=CAN2_Approach_Unlock_SW, system-signal=CAN2_Approach_Unlock_SW}, {implementation-record-element=CAN2_AVM_parking_excute, system-signal=CAN2_AVM_parking_excute}, {implementation-record-element=CAN2_AVM_parking_cancel, system-signal=CAN2_AVM_parking_cancel}, {implementation-record-element=CAN2_AVM_Parking_mode, system-signal=CAN2_AVM_Parking_mode}, {implementation-record-element=CAN2_AVM_OFF_Rec_Butt, system-signal=CAN2_AVM_OFF_Rec_Butt}, {implementation-record-element=CAN2_AVM_Err_STA, system-signal=CAN2_AVM_Err_STA}, {implementation-record-element=CAN2_AEB_BUTT, system-signal=CAN2_AEB_BUTT}]}
