AUTOSAR XML (schema 4-3-0)
package /NmConfig_CAN1
  nm config NmConfig_CAN1: can-nm-cluster-coupling{coupled-cluster=CAN1, nm-busload-reduction-enabled=false, nm-immediate-restart-enabled=false}
    can nm cluster CAN1:
      communication-cluster=CAN1
      nm-channel-id=0
      nm-channel-sleep-master=false
      nm-synchronizing-network=false
      nm-busload-reduction-active=false
      nm-car-wake-up-filter-enabled=false
      nm-car-wake-up-rx-enabled=false
      nm-cbv-position=1
      nm-channel-active=false
      nm-immediate-nm-cycle-time=0.02
      nm-immediate-nm-transmissions=5
      nm-msg-cycle-time=0.7
      nm-network-timeout=1.0
      nm-nid-position=0
      nm-repeat-message-time=2
      nm-user-data-length=6
      nm-wait-bus-sleep-time=0.5
      can nm node FUSION: controller=CAN1, nm-if-ecu=NmConfig_CAN1/FUSION, nm-node-id=0, nm-passive-mode-enabled=false, rx-nm-pdu=CAN1_NMm_FUSION_RX, tx-nm-pdu=CAN1_NMm_FUSION_TX, nm-msg-cycle-offset=0, nm-msg-reduced-time=0.001, nm-range-config={lower-can-id=1280, upper-can-id=1408}
    nm-if-ecus:
      nm ecu FUSION:
        bus-specific-nm-ecu=can-nm-ecu=nm-repeat-msg-indication-enabled=true
        ecu-instance=FUSION
        nm-bus-synchronization-enabled=false
        nm-com-control-enabled=true
        nm-cycletime-main-function=0.02
        nm-node-detection-enabled=true
        nm-node-id-enabled=true
        nm-passive-mode-enabled=false
        nm-pdu-rx-indication-enabled=false
        nm-remote-sleep-ind-enabled=false
        nm-repeat-msg-ind-enabled=true
        nm-state-change-ind-enabled=true
        nm-user-data-enabled=true
package /NmConfig_CAN2
  nm config NmConfig_CAN2: can-nm-cluster-coupling{coupled-cluster=CAN2, nm-busload-reduction-enabled=false, nm-immediate-restart-enabled=false}
    can nm cluster CAN2:
      communication-cluster=CAN2
      nm-channel-id=0
      nm-channel-sleep-master=false
      nm-synchronizing-network=false
      nm-busload-reduction-active=false
      nm-car-wake-up-filter-enabled=false
      nm-car-wake-up-rx-enabled=false
      nm-cbv-position=1
      nm-channel-active=false
      nm-immediate-nm-cycle-time=0.02
      nm-immediate-nm-transmissions=5
      nm-msg-cycle-time=0.7
      nm-network-timeout=1.0
      nm-nid-position=0
      nm-repeat-message-time=2
      nm-user-data-length=6
      nm-wait-bus-sleep-time=0.5
      can nm node FUSION: controller=CAN2, nm-if-ecu=NmConfig_CAN2/FUSION, nm-node-id=0, nm-passive-mode-enabled=false, rx-nm-pdu=CAN2_NMm_FUSION_RX, tx-nm-pdu=CAN2_NMm_FUSION_TX, nm-msg-cycle-offset=0, nm-msg-reduced-time=0.001, nm-range-config={lower-can-id=1280, upper-can-id=1408}
    nm-if-ecus:
      nm ecu FUSION:
        bus-specific-nm-ecu=can-nm-ecu=nm-repeat-msg-indication-enabled=true
        ecu-instance=FUSION
        nm-bus-synchronization-enabled=false
        nm-com-control-enabled=true
        nm-cycletime-main-function=0.02
        nm-node-detection-enabled=true
        nm-node-id-enabled=true
        nm-passive-mode-enabled=false
        nm-pdu-rx-indication-enabled=false
        nm-remote-sleep-ind-enabled=false
        nm-repeat-msg-ind-enabled=true
        nm-state-change-ind-enabled=true
        nm-user-data-enabled=true
package /NmConfig_CAN3
  nm config NmConfig_CAN3: can-nm-cluster-coupling{coupled-cluster=CAN3, nm-busload-reduction-enabled=false, nm-immediate-restart-enabled=false}
    can nm cluster CAN3:
      communication-cluster=CAN3
      nm-channel-id=0
      nm-channel-sleep-master=false
      nm-synchronizing-network=false
      nm-busload-reduction-active=false
      nm-car-wake-up-filter-enabled=false
      nm-car-wake-up-rx-enabled=false
      nm-cbv-position=1
      nm-channel-active=false
      nm-immediate-nm-cycle-time=0.02
      nm-immediate-nm-transmissions=5
      nm-msg-cycle-time=0.7
      nm-network-timeout=1.0
      nm-nid-position=0
      nm-repeat-message-time=2
      nm-user-data-length=6
      nm-wait-bus-sleep-time=0.5
      can nm node FUSION: controller=CAN3, nm-if-ecu=NmConfig_CAN3/FUSION, nm-node-id=0, nm-passive-mode-enabled=false, rx-nm-pdu=CAN3_NMm_FUSION_RX, tx-nm-pdu=CAN3_NMm_FUSION_TX, nm-msg-cycle-offset=0, nm-msg-reduced-time=0.001, nm-range-config={lower-can-id=1280, upper-can-id=1408}
    nm-if-ecus:
      nm ecu FUSION:
        bus-specific-nm-ecu=can-nm-ecu=nm-repeat-msg-indication-enabled=true
        ecu-instance=FUSION
        nm-bus-synchronization-enabled=false
        nm-com-control-enabled=true
        nm-cycletime-main-function=0.02
        nm-node-detection-enabled=true
        nm-node-id-enabled=true
        nm-passive-mode-enabled=false
        nm-pdu-rx-indication-enabled=false
        nm-remote-sleep-ind-enabled=false
        nm-repeat-msg-ind-enabled=true
        nm-state-change-ind-enabled=true
        nm-user-data-enabled=true
package /NmConfig_CAN4
  nm config NmConfig_CAN4: can-nm-cluster-coupling{coupled-cluster=CAN4, nm-busload-reduction-enabled=false, nm-immediate-restart-enabled=false}
    can nm cluster CAN4:
      communication-cluster=CAN4
      nm-channel-id=0
      nm-channel-sleep-master=false
      nm-synchronizing-network=false
      nm-busload-reduction-active=false
      nm-car-wake-up-filter-enabled=false
      nm-car-wake-up-rx-enabled=false
      nm-cbv-position=1
      nm-channel-active=false
      nm-immediate-nm-cycle-time=0.02
      nm-immediate-nm-transmissions=5
      nm-msg-cycle-time=0.7
      nm-network-timeout=1.0
      nm-nid-position=0
      nm-repeat-message-time=2
      nm-user-data-length=6
      nm-wait-bus-sleep-time=0.5
      can nm node FUSION: controller=CAN4, nm-if-ecu=NmConfig_CAN4/FUSION, nm-node-id=0, nm-passive-mode-enabled=false, rx-nm-pdu=CAN4_NMm_FUSION_RX, tx-nm-pdu=CAN4_NMm_FUSION_TX, nm-msg-cycle-offset=0, nm-msg-reduced-time=0.001, nm-range-config={lower-can-id=1280, upper-can-id=1408}
    nm-if-ecus:
      nm ecu FUSION:
        bus-specific-nm-ecu=can-nm-ecu=nm-repeat-msg-indication-enabled=true
        ecu-instance=FUSION
        nm-bus-synchronization-enabled=false
        nm-com-control-enabled=true
        nm-cycletime-main-function=0.02
        nm-node-detection-enabled=true
        nm-node-id-enabled=true
        nm-passive-mode-enabled=false
        nm-pdu-rx-indication-enabled=false
        nm-remote-sleep-ind-enabled=false
        nm-repeat-msg-ind-enabled=true
        nm-state-change-ind-enabled=true
        nm-user-data-enabled=true
package /NmConfig_CAN5
  nm config NmConfig_CAN5: can-nm-cluster-coupling{coupled-cluster=CAN5, nm-busload-reduction-enabled=false, nm-immediate-restart-enabled=false}
    can nm cluster CAN5:
      communication-cluster=CAN5
      nm-channel-id=1
      nm-channel-sleep-master=false
      nm-synchronizing-network=false
      nm-busload-reduction-active=false
      nm-car-wake-up-filter-enabled=false
      nm-car-wake-up-rx-enabled=false
      nm-cbv-position=1
      nm-channel-active=false
      nm-immediate-nm-cycle-time=0.02
      nm-immediate-nm-transmissions=5
      nm-msg-cycle-time=0.7
      nm-network-timeout=1.0
      nm-nid-position=0
      nm-repeat-message-time=2
      nm-user-data-length=6
      nm-wait-bus-sleep-time=0.5
      can nm node FUSION: controller=CAN5, nm-if-ecu=NmConfig_CAN5/FUSION, nm-node-id=0, nm-passive-mode-enabled=false, rx-nm-pdu=CAN5_NMm_FUSION_RX, tx-nm-pdu=CAN5_NMm_FUSION_TX, nm-msg-cycle-offset=0, nm-msg-reduced-time=0.001, nm-range-config={lower-can-id=1280, upper-can-id=1408}
    nm-if-ecus:
      nm ecu FUSION:
        bus-specific-nm-ecu=can-nm-ecu=nm-repeat-msg-indication-enabled=true
        ecu-instance=FUSION
        nm-bus-synchronization-enabled=false
        nm-com-control-enabled=true
        nm-cycletime-main-function=0.02
        nm-node-detection-enabled=true
        nm-node-id-enabled=true
        nm-passive-mode-enabled=false
        nm-pdu-rx-indication-enabled=false
        nm-remote-sleep-ind-enabled=false
        nm-repeat-msg-ind-enabled=true
        nm-state-change-ind-enabled=true
        nm-user-data-enabled=true
package /NmConfig_CAN6
  nm config NmConfig_CAN6: can-nm-cluster-coupling{coupled-cluster=CAN6, nm-busload-reduction-enabled=false, nm-immediate-restart-enabled=false}
    can nm cluster CAN6:
      communication-cluster=CAN6
      nm-channel-id=1
      nm-channel-sleep-master=false
      nm-synchronizing-network=false
      nm-busload-reduction-active=false
      nm-car-wake-up-filter-enabled=false
      nm-car-wake-up-rx-enabled=false
      nm-cbv-position=1
      nm-channel-active=false
      nm-immediate-nm-cycle-time=0.02
      nm-immediate-nm-transmissions=5
      nm-msg-cycle-time=0.7
      nm-network-timeout=1.0
      nm-nid-position=0
      nm-repeat-message-time=2
      nm-user-data-length=6
      nm-wait-bus-sleep-time=0.5
      can nm node FUSION: controller=CAN6, nm-if-ecu=NmConfig_CAN6/FUSION, nm-node-id=0, nm-passive-mode-enabled=false, rx-nm-pdu=CAN6_NMm_FUSION_RX, tx-nm-pdu=CAN6_NMm_FUSION_TX, nm-msg-cycle-offset=0, nm-msg-reduced-time=0.001, nm-range-config={lower-can-id=1280, upper-can-id=1408}
    nm-if-ecus:
      nm ecu FUSION:
        bus-specific-nm-ecu=can-nm-ecu=nm-repeat-msg-indication-enabled=true
        ecu-instance=FUSION
        nm-bus-synchronization-enabled=false
        nm-com-control-enabled=true
        nm-cycletime-main-function=0.02
        nm-node-detection-enabled=true
        nm-node-id-enabled=true
        nm-passive-mode-enabled=false
        nm-pdu-rx-indication-enabled=false
        nm-remote-sleep-ind-enabled=false
        nm-repeat-msg-ind-enabled=true
        nm-state-change-ind-enabled=true
        nm-user-data-enabled=true
package /NmConfig_CAN7
  nm config NmConfig_CAN7: can-nm-cluster-coupling{coupled-cluster=CAN7, nm-busload-reduction-enabled=false, nm-immediate-restart-enabled=false}
    can nm cluster CAN7:
      communication-cluster=CAN7
      nm-channel-id=1
      nm-channel-sleep-master=false
      nm-synchronizing-network=false
      nm-busload-reduction-active=false
      nm-car-wake-up-filter-enabled=false
      nm-car-wake-up-rx-enabled=false
      nm-cbv-position=1
      nm-channel-active=false
      nm-immediate-nm-cycle-time=0.02
      nm-immediate-nm-transmissions=5
      nm-msg-cycle-time=0.7
      nm-network-timeout=1.0
      nm-nid-position=0
      nm-repeat-message-time=2
      nm-user-data-length=6
      nm-wait-bus-sleep-time=0.5
      can nm node FUSION: controller=CAN7, nm-if-ecu=NmConfig_CAN7/FUSION, nm-node-id=0, nm-passive-mode-enabled=false, rx-nm-pdu=CAN7_NMm_FUSION_RX, tx-nm-pdu=CAN7_NMm_FUSION_TX, nm-msg-cycle-offset=0, nm-msg-reduced-time=0.001, nm-range-config={lower-can-id=1280, upper-can-id=1408}
    nm-if-ecus:
      nm ecu FUSION:
        bus-specific-nm-ecu=can-nm-ecu=nm-repeat-msg-indication-enabled=true
        ecu-instance=FUSION
        nm-bus-synchronization-enabled=false
        nm-com-control-enabled=true
        nm-cycletime-main-function=0.02
        nm-node-detection-enabled=true
        nm-node-id-enabled=true
        nm-passive-mode-enabled=false
        nm-pdu-rx-indication-enabled=false
        nm-remote-sleep-ind-enabled=false
        nm-repeat-msg-ind-enabled=true
        nm-state-change-ind-enabled=true
        nm-user-data-enabled=true
