AUTOSAR XML (schema 4-3-0)
package /Impl_Type_ACC_ARPkg
  impl type BACC_outputs: category=STRUCTURE
    35 x element, all with category=TYPE_REFERENCE:
      VACC_CACOverrun_flg: implementation-data-type=boolean
      VACC_CACRunFail_flg: implementation-data-type=boolean
      VACC_EHPSSpdDemTimeout_flg: implementation-data-type=boolean
      VACC_EHPSEnTimeout_flg: implementation-data-type=boolean
      VACC_EHPSMotorDemSpd_rpm: implementation-data-type=float32
      VACC_EHPSSpdCtrlMode_enum: implementation-data-type=float32
      VACC_ASC2AutoTracH_enum: implementation-data-type=uint8
      VACC_ASC2KneeCtrlMReq_enum: implementation-data-type=uint8
      VACC_ASC2NLvReqFA_enum: implementation-data-type=uint8
      VACC_ASC2NLvReqRA_enum: implementation-data-type=uint8
      VACC_ASC2LvCtrlModeReq_enum: implementation-data-type=uint8
      VACC_ASC2LA1PosCmd_enum: implementation-data-type=uint8
      VACC_ASC2LA2PosCmd_enum: implementation-data-type=uint8
      VACC_ASC2DamStiffReqFA_pct: implementation-data-type=float32
      VACC_ASC2DamStiffReqRA_pct: implementation-data-type=float32
      VACC_ASC2DamStiffReqLA_pct: implementation-data-type=float32
      VACC_ASC2KneeReqFA_flg: implementation-data-type=boolean
      VACC_ASC2KneeReqRA_flg: implementation-data-type=boolean
      VACC_ASC2KneeReqLSide_flg: implementation-data-type=boolean
      VACC_ASC2KneeReqRSide_flg: implementation-data-type=boolean
      VACC_EACEnDemand_enum: implementation-data-type=uint8
      VACC_CACTempOverHigh_flg: implementation-data-type=boolean
      VACC_CACPresWarn_flg: implementation-data-type=boolean
      VACC_CACPresReady_flg: implementation-data-type=boolean
      VACC_EHPSEnDemand_enum: implementation-data-type=uint8
      VACC_EHPSDisEnTimeout_flg: implementation-data-type=boolean
      VACC_DCDCEnDemamd_enum: implementation-data-type=uint8
      VACC_EACSpdDemand_rpm: implementation-data-type=float32
      VACC_VCUEACpumpTemp_C: implementation-data-type=float32
      VACC_VCUEACPressureSW_flg: implementation-data-type=boolean
      VACC_EACTempWarnInd_flg: implementation-data-type=boolean
      VACC_EACPressWarnInd_flg: implementation-data-type=boolean
      VACC_AirPressureFDisp_kpa: implementation-data-type=float32
      VACC_AirPressureRDisp_kpa: implementation-data-type=float32
      VACC_AirPressurePDisp_kpa: implementation-data-type=float32
package /Interface_ACC_ARPkg
  sender receiver interface IF_BACC_outputs
    data BACC_outputs: type=BACC_outputs
package /Impl_Type_APM_ARPkg
  impl type BAPM_outputs: category=STRUCTURE
    176 x element, all with category=TYPE_REFERENCE:
      VAPM_VehSpeed_kph: implementation-data-type=float32
      VAPM_VehSpeedTimeOut_flg: implementation-data-type=boolean
      VAPM_FSOffSw_enum: implementation-data-type=uint8
      VAPM_FSOffSwTimeOut_flg: implementation-data-type=boolean
      VAPM_ChrgPlugSta_enum: implementation-data-type=uint8
      VAPM_PASDRMR_cm: implementation-data-type=uint8
      VAPM_PASDRML_cm: implementation-data-type=uint8
      VAPM_PASDRCR_cm: implementation-data-type=uint8
      VAPM_PASDRCL_cm: implementation-data-type=uint8
      VAPM_PASDFMR_cm: implementation-data-type=uint8
      VAPM_PASDFML_cm: implementation-data-type=uint8
      VAPM_PASDFCR_cm: implementation-data-type=uint8
      VAPM_PASDFCL_cm: implementation-data-type=uint8
      VAPM_APSDRLR_cm: implementation-data-type=uint16
      VAPM_APSDRLL_cm: implementation-data-type=uint16
      VAPM_APSDFLR_cm: implementation-data-type=uint16
      VAPM_APSDFLL_cm: implementation-data-type=uint16
      VAPM_PASAFCL_enum: implementation-data-type=uint8
      VAPM_PASARMR_enum: implementation-data-type=uint8
      VAPM_PASARML_enum: implementation-data-type=uint8
      VAPM_PASARCR_enum: implementation-data-type=uint8
      VAPM_PASARCL_enum: implementation-data-type=uint8
      VAPM_PASAFMR_enum: implementation-data-type=uint8
      VAPM_PASAFML_enum: implementation-data-type=uint8
      VAPM_PASAFCR_enum: implementation-data-type=uint8
      VAPM_USSStaRMR_flg: implementation-data-type=boolean
      VAPM_USSStaRML_flg: implementation-data-type=boolean
      VAPM_USSStaRLR_flg: implementation-data-type=boolean
      VAPM_USSStaRLL_flg: implementation-data-type=boolean
      VAPM_USSStaRCR_flg: implementation-data-type=boolean
      VAPM_USSStaRCL_flg: implementation-data-type=boolean
      VAPM_USSStaFMR_flg: implementation-data-type=boolean
      VAPM_USSStaFML_flg: implementation-data-type=boolean
      VAPM_USSStaFLR_flg: implementation-data-type=boolean
      VAPM_USSStaFLL_flg: implementation-data-type=boolean
      VAPM_USSStaFCR_flg: implementation-data-type=boolean
      VAPM_USSStaFCL_flg: implementation-data-type=boolean
      VAPM_Chime_enum: implementation-data-type=uint8
      VAPM_SNSRLayout_enum: implementation-data-type=uint8
      VAPM_StaFSya_flg: implementation-data-type=boolean
      VAPM_ModOperation_enum: implementation-data-type=uint8
      VAPM_BrkPedalPos_pct: implementation-data-type=float32
      VAPM_BrkPedalPosTimeOut_flg: implementation-data-type=boolean
      VAPM_ActAPSPosn_pct: implementation-data-type=float32
      VAPM_LFRawWhlSpeed_kph: implementation-data-type=float32
      VAPM_LFRawWhlSpeedTimeOut_flg: implementation-data-type=boolean
      VAPM_RFRawWhlSpeed_kph: implementation-data-type=float32
      VAPM_RFRawWhlSpeedTimeOut_flg: implementation-data-type=boolean
      VAPM_LRRawWhlSpeed_kph: implementation-data-type=float32
      VAPM_LRRawWhlSpeedTimeOut_flg: implementation-data-type=boolean
      VAPM_RRRawWhlSpeed_kph: implementation-data-type=float32
      VAPM_RRRawWhlSpeedTimeOut_flg: implementation-data-type=boolean
      VAPM_LFRawWhlSpeedV_flg: implementation-data-type=boolean
      VAPM_LFRawWhlSpeedVTimeOut_flg: implementation-data-type=boolean
      VAPM_RFRawWhlSpeedV_flg: implementation-data-type=boolean
      VAPM_RFRawWhlSpeedVTimeOut_flg: implementation-data-type=boolean
      VAPM_LRRawWhlSpeedV_flg: implementation-data-type=boolean
      VAPM_LRRawWhlSpeedVTimeOut_flg: implementation-data-type=boolean
      VAPM_RRRawWhlSpeedV_flg: implementation-data-type=boolean
      VAPM_RRRawWhlSpeedVTimeOut_flg: implementation-data-type=boolean
      VAPM_LFWhlRotDir_enum: implementation-data-type=uint8
      VAPM_LFWhlRotDirTimeOut_flg: implementation-data-type=boolean
      VAPM_RFWhlRotDir_enum: implementation-data-type=uint8
      VAPM_RFWhlRotDirTimeOut_flg: implementation-data-type=boolean
      VAPM_LRWhlRotDir_enum: implementation-data-type=uint8
      VAPM_LRWhlRotDirTimeOut_flg: implementation-data-type=boolean
      VAPM_RRWhlRotDir_enum: implementation-data-type=uint8
      VAPM_RRWhlRotDirTimeOut_flg: implementation-data-type=boolean
      VAPM_LFPulseCountV_flg: implementation-data-type=boolean
      VAPM_LFPulseCountVTimeOut_flg: implementation-data-type=boolean
      VAPM_RFPulseCountV_flg: implementation-data-type=boolean
      VAPM_RFPulseCountVTimeOut_flg: implementation-data-type=boolean
      VAPM_LRPulseCountV_flg: implementation-data-type=boolean
      VAPM_LRPulseCountVTimeOut_flg: implementation-data-type=boolean
      VAPM_RRPulseCountV_flg: implementation-data-type=boolean
      VAPM_RRPulseCountVTimeOut_flg: implementation-data-type=boolean
      VAPM_LFPulseCount_enum: implementation-data-type=uint8
      VAPM_LFPulseCountTimeOut_flg: implementation-data-type=boolean
      VAPM_RFPulseCount_enum: implementation-data-type=uint8
      VAPM_RFPulseCountTimeOut_flg: implementation-data-type=boolean
      VAPM_LRPulseCount_enum: implementation-data-type=uint8
      VAPM_LRPulseCountTimeOut_flg: implementation-data-type=boolean
      VAPM_RRPulseCount_enum: implementation-data-type=uint8
      VAPM_RRPulseCountTimeOut_flg: implementation-data-type=boolean
      VAPM_ShifterHandleCmd_enum: implementation-data-type=uint8
      VAPM_ShifterHandleCmdTimeOut_flg: implementation-data-type=boolean
      VAPM_DriIntend_enum: implementation-data-type=uint8
      VAPM_DriIntendTimeOut_flg: implementation-data-type=boolean
      VAPM_EPSAOIControl_enum: implementation-data-type=uint8
      VAPM_EPSAOIControlTimeOut_flg: implementation-data-type=boolean
      VAPM_SASAngle_Deg: implementation-data-type=float32
      VAPM_SASAngleTimeOut_flg: implementation-data-type=boolean
      VAPM_SASSpeed_degps: implementation-data-type=float32
      VAPM_SASSpeedTimeOut_flg: implementation-data-type=boolean
      VAPM_SASSpeedValid_flg: implementation-data-type=boolean
      VAPM_SASSpeedValidTimeOut_flg: implementation-data-type=boolean
      VAPM_SASCAL_flg: implementation-data-type=boolean
      VAPM_SASCALTimeOut_flg: implementation-data-type=boolean
      VAPM_SASV_flg: implementation-data-type=boolean
      VAPM_SASVTimeOut_flg: implementation-data-type=boolean
      VAPM_GRADE_Deg: implementation-data-type=float32
      VAPM_GRADETimeOut_flg: implementation-data-type=boolean
      VAPM_YawRate_degps: implementation-data-type=float32
      VAPM_YawRateTimeOut_flg: implementation-data-type=boolean
      VAPM_LatAccel_Gps: implementation-data-type=float32
      VAPM_LatAccelTimeOut_flg: implementation-data-type=boolean
      VAPM_LongAccel_Gps: implementation-data-type=float32
      VAPM_LongAccelTimeOut_flg: implementation-data-type=boolean
      VAPM_MCPressure_bar: implementation-data-type=float32
      VAPM_MCPressureTimeOut_flg: implementation-data-type=boolean
      VAPM_YawRateV_flg: implementation-data-type=boolean
      VAPM_YawRateVTimeOut_flg: implementation-data-type=boolean
      VAPM_LatAccelV_flg: implementation-data-type=boolean
      VAPM_LatAccelVTimeOut_flg: implementation-data-type=boolean
      VAPM_LongAccelV_flg: implementation-data-type=boolean
      VAPM_LongAccelVTimeOut_flg: implementation-data-type=boolean
      VAPM_MCPressureV_bar: implementation-data-type=boolean
      VAPM_MCPressureVTimeOut_flg: implementation-data-type=boolean
      VAPM_BrkSwSta_flg: implementation-data-type=boolean
      VAPM_BrkSwStaTimeOut_flg: implementation-data-type=boolean
      VAPM_BrkSwV_flg: implementation-data-type=boolean
      VAPM_BrkSwVTimeOut_flg: implementation-data-type=boolean
      VAPM_ESCStandstill_flg: implementation-data-type=boolean
      VAPM_ESCStandstillTimeOut_flg: implementation-data-type=boolean
      VAPM_ESCAPSSta_enum: implementation-data-type=uint8
      VAPM_ESCAPSStaTimeOut_flg: implementation-data-type=boolean
      VAPM_EPBExtReleaseAvail_flg: implementation-data-type=boolean
      VAPM_EPBExtReleaseAvailTimeOut_flg: implementation-data-type=boolean
      VAPM_EPBExtApplyAvail_flg: implementation-data-type=boolean
      VAPM_EPBExtApplyAvailTimeOut_flg: implementation-data-type=boolean
      VAPM_EPBErrSta_enum: implementation-data-type=uint8
      VAPM_EPBErrStaTimeOut_flg: implementation-data-type=boolean
      VAPM_EPBSta_enum: implementation-data-type=uint8
      VAPM_EPBStaTimeOut_flg: implementation-data-type=boolean
      VAPM_AVMparkingcancel_enum: implementation-data-type=uint8
      VAPM_AVMparkingcancelTimeOut_flg: implementation-data-type=boolean
      VAPM_AVMparkingexcute_enum: implementation-data-type=uint8
      VAPM_AVMparkingexcuteTimeOut_flg: implementation-data-type=boolean
      VAPM_AVMParkingmode_enum: implementation-data-type=uint8
      VAPM_AVMParkingmodeTimeOut_flg: implementation-data-type=boolean
      VAPM_AVMErrSTA_flg: implementation-data-type=boolean
      VAPM_AVMErrSTATimeOut_flg: implementation-data-type=boolean
      VAPM_IVIStatus_flg: implementation-data-type=boolean
      VAPM_IVIStatusTimeOut_flg: implementation-data-type=boolean
      VAPM_CAASSw_enum: implementation-data-type=uint8
      VAPM_CAASSwTimeOut_flg: implementation-data-type=boolean
      VAPM_IVIScreen_enum: implementation-data-type=uint8
      VAPM_IVIScreenTimeOut_flg: implementation-data-type=boolean
      VAPM_ABSActive_flg: implementation-data-type=boolean
      VAPM_ABSActiveTimeOut_flg: implementation-data-type=boolean
      VAPM_TCSActive_flg: implementation-data-type=boolean
      VAPM_TCSActiveTimeOut_flg: implementation-data-type=boolean
      VAPM_DriverSeatBeltCmd_flg: implementation-data-type=boolean
      VAPM_DriverSeatBeltCmdTimeOut_flg: implementation-data-type=boolean
      VAPM_APSProgressPCT_pct: implementation-data-type=float32
      VAPM_APSRQDisplay_enum: implementation-data-type=uint8
      VAPM_APSSWVer_enum: implementation-data-type=uint8
      VAPM_APSHWVer_enum: implementation-data-type=uint8
      VAPM_APSExitCondition_enum: implementation-data-type=uint8
      VAPM_APSAngleTarget_Deg: implementation-data-type=float32
      VAPM_APSVRqEPASCtrl_flg: implementation-data-type=boolean
      VAPM_APSRqEPASCtrl_flg: implementation-data-type=boolean
      VAPM_CAASSta_enum: implementation-data-type=uint8
      VAPM_DKCPDkeyAreaRAPSSta_enum: implementation-data-type=uint8
      VAPM_DKCParkingModeCmd_enum: implementation-data-type=uint8
      VAPM_PUIDLowPower_flg: implementation-data-type=boolean
      VAPM_CAASVMCReqA_flg: implementation-data-type=boolean
      VAPM_APSShiftPosnReq_enum: implementation-data-type=uint8
      VAPM_APSSpeedCMD_kph: implementation-data-type=float32
      VAPM_APSVMCReqA_flg: implementation-data-type=boolean
      VAPM_RAPSBCMLamp_enum: implementation-data-type=uint8
      VAPM_RAPSBCMLockReq_flg: implementation-data-type=boolean
      VAPM_APSPwrReq_enum: implementation-data-type=uint8
      VAPM_RAPSErrWarnSta_enum: implementation-data-type=uint8
      VAPM_RAPSErrLv1_flg: implementation-data-type=boolean
      VAPM_IVIUserTakeOverAPSSta_flg: implementation-data-type=boolean
package /Interface_APM_ARPkg
  sender receiver interface IF_BAPM_outputs
    data BAPM_outputs: type=BAPM_outputs
package /Impl_Type_BCM_ARPkg
  impl type BBCM_outputs: category=STRUCTURE
    56 x element, all with category=TYPE_REFERENCE:
      VBCM_FDCBCMLBeamCmd_flg: implementation-data-type=boolean
      VBCM_FDCBCMPLampCmd_flg: implementation-data-type=boolean
      VBCM_FDCBCMHBeamCmd_flg: implementation-data-type=boolean
      VBCM_FDCBCMSMKLCmd_flg: implementation-data-type=boolean
      VBCM_FDCBCMSMKRCmd_flg: implementation-data-type=boolean
      VBCM_FDCBCMDVRSignalLCmd_flg: implementation-data-type=boolean
      VBCM_FDCBCMDVRSignalRCmd_flg: implementation-data-type=boolean
      VBCM_FDCBCMBSDBuzzerCmd_flg: implementation-data-type=boolean
      VBCM_FDCBCMSLTLpCmd_flg: implementation-data-type=boolean
      VBCM_FDCBCMSRTLpCmd_flg: implementation-data-type=boolean
      VBCM_FDCBCMLTurnLpCmd_flg: implementation-data-type=boolean
      VBCM_FDCBCMRTurnLpCmd_flg: implementation-data-type=boolean
      VBCM_FDCBCMStopINDCmd_flg: implementation-data-type=boolean
      VBCM_FDCBCMSTOPBALLCmd_flg: implementation-data-type=boolean
      VBCM_FDCBCMInnerCallBellCmd_flg: implementation-data-type=boolean
      VBCM_FDCBCMCallBellCmd_flg: implementation-data-type=boolean
      VBCM_FDCBCMWiperHCmd_flg: implementation-data-type=boolean
      VBCM_FDCBCMWasherCmd_flg: implementation-data-type=boolean
      VBCM_FDCBCMWiperLCmd_flg: implementation-data-type=boolean
      VBCM_FDCBCMLDRLCmd_flg: implementation-data-type=boolean
      VBCM_FDCBCMRDRLCmd_flg: implementation-data-type=boolean
      VBCM_FDCBCMRFLampCmd_flg: implementation-data-type=boolean
      VBCM_TurnLpPatternSta_enum: implementation-data-type=uint8
      VBCM_FDCBCMFDoorSta_flg: implementation-data-type=boolean
      VBCM_FDCBCMMDoorSta_flg: implementation-data-type=boolean
      VBCM_FDCBCMRDoorSta_flg: implementation-data-type=boolean
      VBCM_FDCBCMRoomLpAmbCmd_flg: implementation-data-type=boolean
      VBCM_FDCBCMLBSDRCmd_flg: implementation-data-type=boolean
      VBCM_FDCBCMLBSDYCmd_flg: implementation-data-type=boolean
      VBCM_FDCBCMRBSDRCmd_flg: implementation-data-type=boolean
      VBCM_FDCBCMRBSDYCmd_flg: implementation-data-type=boolean
      VBCM_FDCBCMEmExitSWSta_flg: implementation-data-type=boolean
      VBCM_InnerBuzzerModeSta_enum: implementation-data-type=uint8
      VBCM_FDCBCMInnerBuzzerCmd_flg: implementation-data-type=boolean
      VBCM_FDCBCMRoomLpAmbSetSta_flg: implementation-data-type=boolean
      VBCM_FDCBCMRoomLpSetSta_flg: implementation-data-type=boolean
      VBCM_FDCBCMFRoomLpSetSta_pct: implementation-data-type=uint8
      VBCM_FDCBCMFRoomLpCmd_pct: implementation-data-type=uint8
      VBCM_FDCBCMMRoomLpSetSta_pct: implementation-data-type=uint8
      VBCM_FDCBCMMRoomLpCmd_pct: implementation-data-type=uint8
      VBCM_FDCBCMRRoomLpSetSta_pct: implementation-data-type=uint8
      VBCM_FDCBCMRRoomLpCmd_pct: implementation-data-type=uint8
      VBCM_FDCBCMHelpINDCmd_flg: implementation-data-type=boolean
      VBCM_FDCBCMOSDrOpenSWSta_enum: implementation-data-type=uint8
      VBCM_FDCBCMEmSVCmd_flg: implementation-data-type=boolean
      VBCM_FDCBCMFDOpenSVCmd_flg: implementation-data-type=boolean
      VBCM_FDCBCMFDCloseSVCmd_flg: implementation-data-type=boolean
      VBCM_FDCBCMMDOpenSVCmd_flg: implementation-data-type=boolean
      VBCM_FDCBCMMDCloseSVCmd_flg: implementation-data-type=boolean
      VBCM_FDCBCMLTurnSWSta_flg: implementation-data-type=boolean
      VBCM_FDCBCMRTurnSWSta_flg: implementation-data-type=boolean
      VBCM_FDCBCMRGearSta_flg: implementation-data-type=boolean
      VBCM_FDCBCMBrakeCmd_flg: implementation-data-type=boolean
      VBCM_FDCBCMTurnBuzzerENSta_flg: implementation-data-type=boolean
      VBCM_WakeUp_flg: implementation-data-type=boolean
      VBCM_KeepWakeUp_flg: implementation-data-type=boolean
package /Interface_BCM_ARPkg
  sender receiver interface IF_BBCM_outputs
    data BBCM_outputs: type=BBCM_outputs
package /Impl_Type_DDM_ARPkg
  impl type BDDM_outputs: category=STRUCTURE
    173 x element, all with category=TYPE_REFERENCE:
      VDDM_C3BMS6RCDTC_raw32: implementation-data-type=uint32
      VDDM_C3BMS6CSDTC_raw32: implementation-data-type=uint32
      VDDM_C3BMS6LCDTC_raw32: implementation-data-type=uint32
      VDDM_C3BMS1RCDTC_raw32: implementation-data-type=uint32
      VDDM_C3BMS1CSDTC_raw32: implementation-data-type=uint32
      VDDM_C3BMS1LCDTC_raw32: implementation-data-type=uint32
      VDDM_C3CCU1RCDTC_raw32: implementation-data-type=uint32
      VDDM_C3CCU1CSDTC_raw32: implementation-data-type=uint32
      VDDM_C3CCU1LCDTC_raw32: implementation-data-type=uint32
      VDDM_C3CCU2RCDTC_raw32: implementation-data-type=uint32
      VDDM_C3CCU2CSDTC_raw32: implementation-data-type=uint32
      VDDM_C3CCU2LCDTC_raw32: implementation-data-type=uint32
      VDDM_C1ABM1RCDTC_raw32: implementation-data-type=uint32
      VDDM_C1ABM1CSDTC_raw32: implementation-data-type=uint32
      VDDM_C1ABM1LCDTC_raw32: implementation-data-type=uint32
      VDDM_Lv{1..4}ErrDTC_raw32: implementation-data-type=uint32
      VDDM_BrkSWErrDTC_raw32: implementation-data-type=uint32
      VDDM_BrkSWNoBacDTC_raw32: implementation-data-type=uint32
      VDDM_KeyAuthDTC_raw32: implementation-data-type=uint32
      VDDM_ONtoRdyDTC_raw32: implementation-data-type=uint32
      VDDM_HVB4PreDTC_raw32: implementation-data-type=uint32
      VDDM_MCU4PreDTC_raw32: implementation-data-type=uint32
      VDDM_DCDC4PreDTC_raw32: implementation-data-type=uint32
      VDDM_HVRlyCloDTC_raw32: implementation-data-type=uint32
      VDDM_BMSRdyDTC_raw32: implementation-data-type=uint32
      VDDM_DCDCEnaDTC_raw32: implementation-data-type=uint32
      VDDM_HiLvSaChkDTC_raw32: implementation-data-type=uint32
      VDDM_MidLvSaChkDTC_raw32: implementation-data-type=uint32
      VDDM_MCUDisDTC_raw32: implementation-data-type=uint32
      VDDM_DCDCDisDTC_raw32: implementation-data-type=uint32
      VDDM_HVRlyOpDTC_raw32: implementation-data-type=uint32
      VDDM_MCUActDTC_raw32: implementation-data-type=uint32
      VDDM_OBC4PreDTC_raw32: implementation-data-type=uint32
      VDDM_IniLVLoDTC_raw32: implementation-data-type=uint32
      VDDM_LVSupLoDTC_raw32: implementation-data-type=uint32
      VDDM_LVSupHiDTC_raw32: implementation-data-type=uint32
      VDDM_LVInErrDTC_raw32: implementation-data-type=uint32
      VDDM_DrStSWDTC_raw32: implementation-data-type=uint32
      VDDM_FLDoorSWDTC_raw32: implementation-data-type=uint32
      VDDM_RLDoorSWDTC_raw32: implementation-data-type=uint32
      VDDM_FRDoorSWDTC_raw32: implementation-data-type=uint32
      VDDM_RRDoorSWDTC_raw32: implementation-data-type=uint32
      VDDM_HoodSWDTC_raw32: implementation-data-type=uint32
      VDDM_TailgaSWDTC_raw32: implementation-data-type=uint32
      VDDM_EDriveSysErrVCUErr_flg: implementation-data-type=boolean
      VDDM_VehMalfunLevel_enum: implementation-data-type=uint8
      VDDM_APS1SigOoRDTC_raw32: implementation-data-type=uint32
      VDDM_APS2SigOoRDTC_raw32: implementation-data-type=uint32
      VDDM_APSCorrErrDTC_raw32: implementation-data-type=uint32
      VDDM_MCUF1NoComDTC_raw32: implementation-data-type=uint32
      VDDM_MCUR1NoComDTC_raw32: implementation-data-type=uint32
      VDDM_Shifter1NoComDTC_raw32: implementation-data-type=uint32
      VDDM_ESC7NoComDTC_raw32: implementation-data-type=uint32
      VDDM_ESC1NoComDTC_raw32: implementation-data-type=uint32
      VDDM_ESC5NoComDTC_raw32: implementation-data-type=uint32
      VDDM_EnterNewOperCyc_flg: implementation-data-type=boolean
      VDDM_DiagHCrashDTC_raw32: implementation-data-type=uint32
      VDDM_DiagFLTSDTC_raw32: implementation-data-type=uint32
      VDDM_DiagFRTSDTC_raw32: implementation-data-type=uint32
      VDDM_DiagRLTSDTC_raw32: implementation-data-type=uint32
      VDDM_DiagRRTSDTC_raw32: implementation-data-type=uint32
      VDDM_FCLUSSDTC_raw32: implementation-data-type=uint32
      VDDM_FMLUSSDTC_raw32: implementation-data-type=uint32
      VDDM_FMRUSSDTC_raw32: implementation-data-type=uint32
      VDDM_FCRUSSDTC_raw32: implementation-data-type=uint32
      VDDM_RCLUSSDTC_raw32: implementation-data-type=uint32
      VDDM_RMLUSSDTC_raw32: implementation-data-type=uint32
      VDDM_RMRUSSDTC_raw32: implementation-data-type=uint32
      VDDM_RCRUSSDTC_raw32: implementation-data-type=uint32
      VDDM_FLLUSSDTC_raw32: implementation-data-type=uint32
      VDDM_FLRUSSDTC_raw32: implementation-data-type=uint32
      VDDM_RLLUSSDTC_raw32: implementation-data-type=uint32
      VDDM_RLRUSSDTC_raw32: implementation-data-type=uint32
      VDDM_FCM2NoComDTC_raw32: implementation-data-type=uint32
      VDDM_FCM2RCErrDTC_raw32: implementation-data-type=uint32
      VDDM_FCM2CSErrDTC_raw32: implementation-data-type=uint32
      VDDM_FCM3NoComDTC_raw32: implementation-data-type=uint32
      VDDM_FCM3RCErrDTC_raw32: implementation-data-type=uint32
      VDDM_FCM3CSErrDTC_raw32: implementation-data-type=uint32
      VDDM_FCM4NoComDTC_raw32: implementation-data-type=uint32
      VDDM_FCM4CSErrDTC_raw32: implementation-data-type=uint32
      VDDM_FCM5NoComDTC_raw32: implementation-data-type=uint32
      VDDM_FCM5CSErrDTC_raw32: implementation-data-type=uint32
      VDDM_ZoneSCPNoComDTC_raw32: implementation-data-type=uint32
      VDDM_BMSSigErrDetDTC_raw32: implementation-data-type=uint32
      VDDM_FCMACCSigErrDetDTC_raw32: implementation-data-type=uint32
      VDDM_FrMCUSigErrDetDTC_raw32: implementation-data-type=uint32
      VDDM_RrMCUSigErrDetDTC_raw32: implementation-data-type=uint32
      VDDM_CCUSigErrDetDTC_raw32: implementation-data-type=uint32
      VDDM_ACCAccelCmdErrDetDTC_raw32: implementation-data-type=uint32
      VDDM_ACCMalfuncDetDTC_raw32: implementation-data-type=uint32
      VDDM_CCMalfuncDetDTC_raw32: implementation-data-type=uint32
      VDDM_MSAMalfuncDetDTC_raw32: implementation-data-type=uint32
      VDDM_ISAMalfuncDetDTC_raw32: implementation-data-type=uint32
      VDDM_MCUF1RCErrDTC_raw32: implementation-data-type=uint32
      VDDM_MCUR1RCErrDTC_raw32: implementation-data-type=uint32
      VDDM_MCUF1CSErrDTC_raw32: implementation-data-type=uint32
      VDDM_MCUR1CSErrDTC_raw32: implementation-data-type=uint32
      VDDM_Shifter1RCErrDTC_raw32: implementation-data-type=uint32
      VDDM_Shifter1CSErrDTC_raw32: implementation-data-type=uint32
      VDDM_ESC7RCErrDTC_raw32: implementation-data-type=uint32
      VDDM_ESC7CSErrDTC_raw32: implementation-data-type=uint32
      VDDM_ESC1RCErrDTC_raw32: implementation-data-type=uint32
      VDDM_ESC1CSErrDTC_raw32: implementation-data-type=uint32
      VDDM_ESC5RCErrDTC_raw32: implementation-data-type=uint32
      VDDM_ESC5CSErrDTC_raw32: implementation-data-type=uint32
      VDDM_FrMCUTqErrDTC_raw32: implementation-data-type=uint32
      VDDM_RrMCUTqErrDTC_raw32: implementation-data-type=uint32
      VDDM_LFBatwarnDTC_raw32: implementation-data-type=uint32
      VDDM_RFBatwarnDTC_raw32: implementation-data-type=uint32
      VDDM_LRBatwarnDTC_raw32: implementation-data-type=uint32
      VDDM_RRBatwarnDTC_raw32: implementation-data-type=uint32
      VDDM_LFPressIndiDTC_raw32: implementation-data-type=uint32
      VDDM_RFPressIndiDTC_raw32: implementation-data-type=uint32
      VDDM_LRPressIndiDTC_raw32: implementation-data-type=uint32
      VDDM_RRPressIndiDTC_raw32: implementation-data-type=uint32
      VDDM_LFWheelTmpHighDTC_raw32: implementation-data-type=uint32
      VDDM_RFWheelTmpHighDTC_raw32: implementation-data-type=uint32
      VDDM_LRWheelTmpHighDTC_raw32: implementation-data-type=uint32
      VDDM_RRWheelTmpHighDTC_raw32: implementation-data-type=uint32
      VDDM_LFSensorFailDTC_raw32: implementation-data-type=uint32
      VDDM_RFSensorFailDTC_raw32: implementation-data-type=uint32
      VDDM_LRSensorFailDTC_raw32: implementation-data-type=uint32
      VDDM_RRSensorFailDTC_raw32: implementation-data-type=uint32
      VDDM_C1EPAS2LCDTC_raw32: implementation-data-type=uint32
      VDDM_5vAPS1PwrErrDTC_raw32: implementation-data-type=uint32
      VDDM_5vAPS2PwrErrDTC_raw32: implementation-data-type=uint32
      VDDM_EPBLockTODTC_raw32: implementation-data-type=uint32
      VDDM_EPBUnlockTODTC_raw32: implementation-data-type=uint32
      VDDM_LimpHomeActTmp_flg: implementation-data-type=boolean
      VDDM_EDriveSysErr_VCUErrTmp_flg: implementation-data-type=boolean
      VDDM_EPB1NoComDTC_raw32: implementation-data-type=uint32
      VDDM_EPB1RCErrDTC_raw32: implementation-data-type=uint32
      VDDM_EPB1CSErrDTC_raw32: implementation-data-type=uint32
      VDDM_EPBSigErrDTC_raw32: implementation-data-type=uint32
      VDDM_FCM1NoComDTC_raw32: implementation-data-type=uint32
      VDDM_FCM1RCErrDTC_raw32: implementation-data-type=uint32
      VDDM_FCM1CSErrDTC_raw32: implementation-data-type=uint32
      VDDM_ESCSigErrDetDTC_raw32: implementation-data-type=uint32
      VDDM_ShifterSigErrDetDTC_raw32: implementation-data-type=uint32
      VDDM_DrVCUNoComDTC_raw32: implementation-data-type=uint32
      VDDM_FrVCUNoComDTC_raw32: implementation-data-type=uint32
      VDDM_ZoneDrSigErrDetDTC_raw32: implementation-data-type=uint32
      VDDM_ZoneFrSigErrDetDTC_raw32: implementation-data-type=uint32
      VDDM_EPS1NoComDTC_raw32: implementation-data-type=uint32
      VDDM_EPS1RCErrDTC_raw32: implementation-data-type=uint32
      VDDM_EPS1CSErrDTC_raw32: implementation-data-type=uint32
      VDDM_EPSSigErrDTC_raw32: implementation-data-type=uint32
      VDDM_DTCDetect_enum: implementation-data-type=uint8
      VDDM_EngagePFail_flg: implementation-data-type=boolean
      VDDM_DisengagePFail_flg: implementation-data-type=boolean
      VDDM_VCURAPSErrLv2_flg: implementation-data-type=boolean
      VDDM_VCURAPSErrLv3_flg: implementation-data-type=boolean
      VDDM_EDriveSysErrShifterErr_flg: implementation-data-type=boolean
      VDDM_PMMBattErr_flg: implementation-data-type=boolean
      VDDM_LVSysErrPwrOutErr_flg: implementation-data-type=boolean
      VDDM_HVRlyOpFail_flg: implementation-data-type=boolean
      VDDM_MCUActDisFail_flg: implementation-data-type=boolean
      VDDM_VCUBrkSWSta_enum: implementation-data-type=uint8
      VDDM_VCUFLDoorSta_flg: implementation-data-type=boolean
      VDDM_VCUFRDoorSta_flg: implementation-data-type=boolean
      VDDM_VCURLDoorSta_flg: implementation-data-type=boolean
      VDDM_VCURRDoorSta_flg: implementation-data-type=boolean
      VDDM_SysAllowReadySta_flg: implementation-data-type=boolean
      VDDM_VCUHoodSWSta_flg: implementation-data-type=boolean
      VDDM_VCUTailgateSWSta_flg: implementation-data-type=boolean
      VDDM_EPB1NoComCFS_flg: implementation-data-type=boolean
      VDDM_EPB1RCErrCFS_flg: implementation-data-type=boolean
      VDDM_EPB1CSErrCFS_flg: implementation-data-type=boolean
      VDDM_EPBSigErrCFS_flg: implementation-data-type=boolean
package /Interface_DDM_ARPkg
  sender receiver interface IF_BDDM_outputs
    data BDDM_outputs: type=BDDM_outputs
package /Impl_Type_DHP_ARPkg
  impl type BDHP_outputs: category=STRUCTURE
    12 x element, all with category=TYPE_REFERENCE:
      VDHP_ActAPSPosn_pct: implementation-data-type=float32
      VDHP_LowIdleAccPedal_flg: implementation-data-type=boolean
      VDHP_AccPedalSWSta_flg: implementation-data-type=boolean
      VDHP_EAPS12RangeSta_enum: implementation-data-type=uint8
      VDHP_EAPCRBAD_flg: implementation-data-type=boolean
      VDHP_EAPS1MIN_pct: implementation-data-type=float32
      VDHP_EAPS2MIN_pct: implementation-data-type=float32
      VDHP_ResetPedalZeroPosStart_flg: implementation-data-type=boolean
      VDHP_EAPS1NRM_pct: implementation-data-type=float32
      VDHP_EAPS2NRM_pct: implementation-data-type=float32
      VDHP_EAPS1BAD_flg: implementation-data-type=boolean
      VDHP_EAPS2BAD_flg: implementation-data-type=boolean
package /Interface_DHP_ARPkg
  sender receiver interface IF_BDHP_outputs
    data BDHP_outputs: type=BDHP_outputs
package /Impl_Type_DID_ARPkg
  impl type BDID_outputs: category=STRUCTURE
    92 x element, all with category=TYPE_REFERENCE:
      VDID_VSS_kph: implementation-data-type=float32
      VDID_RUNTM_s: implementation-data-type=uint16
      VDID_MILDIST_km: implementation-data-type=float32
      VDID_WARMUPS_cnt: implementation-data-type=uint8
      VDID_CLRDIST_km: implementation-data-type=float32
      VDID_APPD_pct: implementation-data-type=float32
      VDID_APPE_pct: implementation-data-type=float32
      VDID_MILTIME_min: implementation-data-type=uint16
      VDID_CLRTIME_min: implementation-data-type=uint16
      VDID_BATSOC_pct: implementation-data-type=float32
      VDID_HEVBATT_V: implementation-data-type=float32
      VDID_ODOMETER_km: implementation-data-type=float32
      VDID_BATSOH_pct: implementation-data-type=float32
      VDID_HVBCellVoltMin_V: implementation-data-type=float32
      VDID_HVBCellVoltMax_V: implementation-data-type=float32
      VDID_HVESSCHARGELIM_kW: implementation-data-type=float32
      VDID_HVESSCHARGEACT_kW: implementation-data-type=float32
      VDID_HVESSENER_Whps: implementation-data-type=float32
      VDID_NUMPSATRIPSFLTMEMCLR_cnt: implementation-data-type=uint16
      VDID_HVBattCurr_Ahps: implementation-data-type=float32
      VDID_PSAR_sec: implementation-data-type=uint32
      VDID_PSAL_sec: implementation-data-type=uint32
      VDID_IPSAR_sec: implementation-data-type=uint32
      VDID_IPSAL_sec: implementation-data-type=uint32
      VDID_CPSAR_sec: implementation-data-type=uint32
      VDID_CPSAL_sec: implementation-data-type=uint32
      VDID_HVBNAH_Ahr: implementation-data-type=float32
      VDID_HVBNE_kWh: implementation-data-type=float32
      VDID_IGNCNTR_cnt: implementation-data-type=uint16
      VDID_TNBCPSAR_Ahr: implementation-data-type=float32
      VDID_TNBCPSAL_Ahr: implementation-data-type=float32
      VDID_TNECPSAR_kWh: implementation-data-type=float32
      VDID_TNECPSAL_kWh: implementation-data-type=float32
      VDID_TEBPSAR_kWh: implementation-data-type=float32
      VDID_TEBPSAL_kWh: implementation-data-type=float32
      VDID_TGEOVCR_kWh: implementation-data-type=float32
      VDID_TGEOVCL_kWh: implementation-data-type=float32
      VDID_GECHGOVCDCR_kWh: implementation-data-type=float32
      VDID_GECHGOVCDCL_kWh: implementation-data-type=float32
      VDID_GECHGOVCACR_kWh: implementation-data-type=float32
      VDID_GECHGOVCACL_kWh: implementation-data-type=float32
      VDID_RESSV2XENNONPSAR_kWh: implementation-data-type=float32
      VDID_RESSV2XENNONPSAL_kWh: implementation-data-type=float32
      VDID_PKER_kphsqr: implementation-data-type=float32
      VDID_PKEL_kphsqr: implementation-data-type=float32
      VDID_ResetCDEODTR_km: implementation-data-type=float32
      VDID_CDEODTR_km: implementation-data-type=float32
      VDID_CDEODTL_km: implementation-data-type=float32
      VDID_AvgBattTempPSAR_C: implementation-data-type=float32
      VDID_AvgBattTempPSAL_C: implementation-data-type=float32
      VDID_AvgBattTempOVCR_C: implementation-data-type=float32
      VDID_AvgBattTempOVCL_C: implementation-data-type=float32
      VDID_AvgBattTempOFFR_C: implementation-data-type=float32
      VDID_AvgBattTempOFFL_C: implementation-data-type=float32
      VDID_QTYPSATRIPSR_cnt: implementation-data-type=uint32
      VDID_QTYPSATRIPSL_cnt: implementation-data-type=uint32
      VDID_RESSCNTDODRNGR_cnt: implementation-data-type=u16_Array8_type
      VDID_RESSCNTDODRNGL_cnt: implementation-data-type=u16_Array8_type
      VDID_ETMATOER_kWh: implementation-data-type=float32
      VDID_ETMATOEL_kWh: implementation-data-type=float32
      VDID_ETMBTOER_kWh: implementation-data-type=float32
      VDID_ETMBTOEL_kWh: implementation-data-type=float32
      VDID_RESSTIMESOCPSARNGR_s: implementation-data-type=u32_Array8_type
      VDID_RESSTIMESOCPSARNGL_s: implementation-data-type=u32_Array8_type
      VDID_RESSTIMESOCCHGRNGR_s: implementation-data-type=u32_Array8_type
      VDID_RESSTIMESOCCHGRNGL_s: implementation-data-type=u32_Array8_type
      VDID_RESSTIMESOCOFFRNGR_s: implementation-data-type=u32_Array8_type
      VDID_RESSTIMESOCOFFRNGL_s: implementation-data-type=u32_Array8_type
      VDID_MAXBATTEMPL_C: implementation-data-type=float32
      VDID_MINBATTEMPL_C: implementation-data-type=float32
      VDID_AVGBATTEMPL_C: implementation-data-type=float32
      VDID_PROTOCOLID_enum: implementation-data-type=uint8
      VDID_RESSTTEMPRNGAXIS_enum: implementation-data-type=uint8
      VDID_RESSTIMESOCRNGAXIS_enum: implementation-data-type=uint8
      VDID_RESSCNTSDODRNGAXIS_enum: implementation-data-type=uint8
      VDID_CALID_cnt: implementation-data-type=u8_Array16_type
      VDID_ECUNAME_cnt: implementation-data-type=u8_Array20_type
      VDID_PKERNumerator_kphsqr: implementation-data-type=float32
      VDID_PKELNumerator_kphsqr: implementation-data-type=float32
      VDID_BattTempPSAR_sec: implementation-data-type=uint32
      VDID_BattTempPSAL_sec: implementation-data-type=uint32
      VDID_OVCR_sec: implementation-data-type=uint32
      VDID_OVCL_sec: implementation-data-type=uint32
      VDID_OFFR_sec: implementation-data-type=uint32
      VDID_OFFL_sec: implementation-data-type=uint32
      VDID_AVGBATTEMPL_sec: implementation-data-type=uint32
      VDID_VinCode_cnt: implementation-data-type=u8_Array17_type
      VDID_STASUP_enum: implementation-data-type=uint8
      VDID_HEVMODE_enum: implementation-data-type=uint8
      VDID_HVBATT_A: implementation-data-type=float32
      VDID_DIDModelVersion_raw: implementation-data-type=uint8
      VDID_DIDModelVersionChksum_raw: implementation-data-type=uint8
package /Interface_DID_ARPkg
  sender receiver interface IF_BDID_outputs
    data BDID_outputs: type=BDID_outputs
package /Impl_Type_DKC_ARPkg
  impl type BDKC_outputs: category=STRUCTURE
    19 x element, all with category=TYPE_REFERENCE:
      VDKC_DKCTimeSN_cnt: implementation-data-type=uint32
      VDKC_DKCAuthSta_enum: implementation-data-type=uint8
      VDKC_TimeSNDKCFbk_cnt: implementation-data-type=uint32
      VDKC_KeyMissSta_flg: implementation-data-type=boolean
      VDKC_KeyModeSta_enum: implementation-data-type=uint8
      VDKC_DkeyShowIVISta_enum: implementation-data-type=uint8
      VDKC_KeyAreaPS_enum: implementation-data-type=uint8
      VDKC_KeyAreaLockUnlock_enum: implementation-data-type=uint8
      VDKC_PCommandToBCM_enum: implementation-data-type=uint8
      VDKC_DKeyWelcomeSta_enum: implementation-data-type=uint8
      VDKC_KeyAreaPTG_enum: implementation-data-type=uint8
      VDKC_KeyAreaSPTGSta_enum: implementation-data-type=uint8
      VDKC_UIDLowPowerSta_enum: implementation-data-type=uint8
      VDKC_DkeyAreaRAPSSta_enum: implementation-data-type=uint8
      VDKC_ParkingModeCmd_enum: implementation-data-type=uint8
      VDKC_KeyNumSta_enum: implementation-data-type=uint8
      VDKC_KeyTypeSta_enum: implementation-data-type=uint8
      VDKC_FDCDKCAllowSleep_flg: implementation-data-type=boolean
      VDKC_JudgeKeepUnlockZone_flg: implementation-data-type=boolean
package /Interface_DKC_ARPkg
  sender receiver interface IF_BDKC_outputs
    data BDKC_outputs: type=BDKC_outputs
package /Impl_Type_DSC_ARPkg
  impl type BDSC_outputs: category=STRUCTURE
    4 x element, all with category=TYPE_REFERENCE:
      VDSC_DISCTurn_flg: implementation-data-type=boolean
      VDSC_DISCTargetSpd_kph: implementation-data-type=float32
      VDSC_DISCSta_enum: implementation-data-type=uint8
      VDSC_DISCButtSta_flg: implementation-data-type=boolean
package /Interface_DSC_ARPkg
  sender receiver interface IF_BDSC_outputs
    data BDSC_outputs: type=BDSC_outputs
package /Impl_Type_NMM_ARPkg
  impl type BNMM_outputs: category=STRUCTURE
    13 x element, all with category=TYPE_REFERENCE:
      VNMM_AllCANTxReq_flg: implementation-data-type=boolean
      VNMM_NMmTxReq_flg: implementation-data-type=boolean
      VNMM_Awake_enum: implementation-data-type=uint8
      VNMM_CSB_flg: implementation-data-type=boolean
      VNMM_ErrorState_enum: implementation-data-type=uint8
      VNMM_NodeID_enum: implementation-data-type=uint8
      VNMM_PNI_flg: implementation-data-type=boolean
      VNMM_RptMsgReq_flg: implementation-data-type=boolean
      VNMM_WakeUp_enum: implementation-data-type=uint8
      VNMM_ActiveWU_flg: implementation-data-type=boolean
      VNMM_SysNMmSta_enum: implementation-data-type=uint8
      VNMM_NetworkReq_flg: implementation-data-type=boolean
      VNMM_NetworkReqCalled_flg: implementation-data-type=boolean
package /Interface_NMM_ARPkg
  sender receiver interface IF_BNMM_outputs
    data BNMM_outputs: type=BNMM_outputs
package /Impl_Type_PMM_ARPkg
  impl type BPMM_outputs: category=STRUCTURE
    79 x element, all with category=TYPE_REFERENCE:
      VPMM_SysPowerMode_enum: implementation-data-type=uint8
      VPMM_PowerUpState_enum: implementation-data-type=uint8
      VPMM_PowerDownState_enum: implementation-data-type=uint8
      VPMM_ChrgState_enum: implementation-data-type=uint8
      VPMM_PowerUpFault_enum: implementation-data-type=uint8
      VPMM_PowerDownFault_enum: implementation-data-type=uint8
      VPMM_ChrgFault_enum: implementation-data-type=uint8
      VPMM_IRCRlyClose_flg: implementation-data-type=boolean
      VPMM_IGNRlyClose_flg: implementation-data-type=boolean
      VPMM_BattHVDem_enum: implementation-data-type=uint8
      VPMM_DCDCRlyDem_enum: implementation-data-type=uint8
      VPMM_CACRlyDem_enum: implementation-data-type=uint8
      VPMM_MCUHVLoopDem_enum: implementation-data-type=uint8
      VPMM_EHPSRlyDem_enum: implementation-data-type=uint8
      VPMM_ACHVLoopDem_enum: implementation-data-type=uint8
      VPMM_HVSysReady_enum: implementation-data-type=uint8
      VPMM_DrivelineRelease_enum: implementation-data-type=uint8
      VPMM_PMMDCDCEnableDem_flg: implementation-data-type=boolean
      VPMM_ActiveDischargeReq_enum: implementation-data-type=uint8
      VPMM_PowerDownCompleted_flg: implementation-data-type=boolean
      VPMM_PowerUpComplete_flg: implementation-data-type=boolean
      VPMM_ExtTorquePrevent_enum: implementation-data-type=uint8
      VPMM_PowerUpInhibit_flg: implementation-data-type=boolean
      VPMM_VCUMCUEn_flg: implementation-data-type=boolean
      VPMM_VCUMCUCtrlMd_enum: implementation-data-type=uint8
      VPMM_VCUMCUFailRst_flg: implementation-data-type=boolean
      VPMM_HVILFail_flg: implementation-data-type=boolean
      VPMM_PMMEACEnableDem_flg: implementation-data-type=boolean
      VPMM_PMMEHPSDemSpd_rpm: implementation-data-type=float32
      VPMM_PMMEHPSEnableDem_flg: implementation-data-type=boolean
      VPMM_EHPSIniFinish_flg: implementation-data-type=boolean
      VPMM_EACEnableCompleted_flg: implementation-data-type=boolean
      VPMM_AlcLockSta_enum: implementation-data-type=uint8
      VPMM_LostHVComActivePwrDown_flg: implementation-data-type=boolean
      VPMM_LVBattLowInd_enum: implementation-data-type=uint8
      VPMM_ChrgPowerUpFail_flg: implementation-data-type=boolean
      VPMM_ChrgBCUHVFail_flg: implementation-data-type=boolean
      VPMM_HVFailureChkPass_flg: implementation-data-type=boolean
      VPMM_HVILDetectFail_flg: implementation-data-type=boolean
      VPMM_LVChrgPreActFinished_flg: implementation-data-type=boolean
      VPMM_TrigRBuzeer_flg: implementation-data-type=boolean
      VPMM_TrigRLamp_flg: implementation-data-type=boolean
      VPMM_TrigBrkLamp_flg: implementation-data-type=boolean
      VPMM_DCDCVolLowTO_flg: implementation-data-type=boolean
      VPMM_LongIdleDetFinsh_flg: implementation-data-type=boolean
      VPMM_V2BLifeSig_cnt: implementation-data-type=uint8
      VPMM_V2BAux{1..3}OnOff_enum: implementation-data-type=uint8
      VPMM_V2BMainPosRlySta_enum: implementation-data-type=uint8
      VPMM_V2BMainPosRlyFit_enum: implementation-data-type=uint8
      VPMM_V2BACPosRlySta_enum: implementation-data-type=uint8
      VPMM_V2BACPosRlyFit_enum: implementation-data-type=uint8
      VPMM_V2BAirPosRlySta_enum: implementation-data-type=uint8
      VPMM_V2BAirPosRlyFit_enum: implementation-data-type=uint8
      VPMM_V2BOilPosRlySta_enum: implementation-data-type=uint8
      VPMM_V2BOilPosRlyFit_enum: implementation-data-type=uint8
      VPMM_V2BDCDCPosRlySta_enum: implementation-data-type=uint8
      VPMM_V2BDCDCPosRlyFit_enum: implementation-data-type=uint8
      VPMM_V2BAux1RlySta_enum: implementation-data-type=uint8
      VPMM_V2BAux1RlyFit_enum: implementation-data-type=uint8
      VPMM_V2BAux2RlySta_enum: implementation-data-type=uint8
      VPMM_V2BAux2RlyFit_enum: implementation-data-type=uint8
      VPMM_V2BAux3RlySta_enum: implementation-data-type=uint8
      VPMM_V2BAux3RlyFit_enum: implementation-data-type=uint8
      VPMM_V2BAux4RlySta_enum: implementation-data-type=uint8
      VPMM_V2BAux4RlyFit_enum: implementation-data-type=uint8
      VPMM_V2BRsv1_cnt: implementation-data-type=uint8
      VPMM_V2BRsv2_cnt: implementation-data-type=uint8
      VPMM_VCULife1_cnt: implementation-data-type=uint8
      VPMM_VCULife2_cnt: implementation-data-type=uint8
      VPMM_VSPFunc_enum: implementation-data-type=uint8
      VPMM_VSPIGNKeySta_enum: implementation-data-type=uint8
      VPMM_VSPReversed_flg: implementation-data-type=boolean
      VPMM_VSPTurnRight_enum: implementation-data-type=uint8
      VPMM_VSPTurnLeft_enum: implementation-data-type=uint8
      VPMM_FogTMSRlyCMD_enum: implementation-data-type=uint8
      VPMM_DCCurr_A: implementation-data-type=float32
      VPMM_DCVol_V: implementation-data-type=float32
package /Interface_PMM_ARPkg
  sender receiver interface IF_BPMM_outputs
    data BPMM_outputs: type=BPMM_outputs
package /Impl_Type_PSA_ARPkg
  impl type BPSA_outputs: category=STRUCTURE
    4 x element, all with category=TYPE_REFERENCE:
      VPSA_Keystatus_enum: implementation-data-type=uint8
      VPSA_PBtrig_flg: implementation-data-type=boolean
      VPSA_EmergencyShutDown_flg: implementation-data-type=boolean
      VPSA_AlcLockPass_flg: implementation-data-type=boolean
package /Interface_PSA_ARPkg
  sender receiver interface IF_BPSA_outputs
    data BPSA_outputs: type=BPSA_outputs
package /Impl_Type_SCP_ARPkg
  impl type BSCP_outputs: category=STRUCTURE
    15 x element, all with category=TYPE_REFERENCE:
      VSCP_triggerBAM_flg: implementation-data-type=boolean
      VSCP_CFGEM1Ctrl_raw: implementation-data-type=uint8
      VSCP_CFGEM1BAMTSize_raw: implementation-data-type=uint16
      VSCP_CFGEM1BAMTNum_raw: implementation-data-type=uint8
      VSCP_CFGEM1BAMRsv_raw: implementation-data-type=uint8
      VSCP_CFGEM1BAMPGN_raw: implementation-data-type=uint32
      VSCP_triggerDT_flg: implementation-data-type=boolean
      VSCP_DTbyte{0..7}_raw: implementation-data-type=uint8
package /Interface_SCP_ARPkg
  sender receiver interface IF_BSCP_outputs
    data BSCP_outputs: type=BSCP_outputs
package /Impl_Type_SYS_ARPkg
  impl type BSYS_outputs: category=STRUCTURE
    41 x element, all with category=TYPE_REFERENCE:
      VSYS_HWVer{1..3}_cnt: implementation-data-type=uint8
      VSYS_CarModel{1..3}_cnt: implementation-data-type=uint8
      VSYS_ECU1_cnt: implementation-data-type=uint8
      VSYS_ECU2_cnt: implementation-data-type=uint8
      VSYS_Major1_cnt: implementation-data-type=uint8
      VSYS_Major2_cnt: implementation-data-type=uint8
      VSYS_Minor1_cnt: implementation-data-type=uint8
      VSYS_Minor2_cnt: implementation-data-type=uint8
      VSYS_Patch1_cnt: implementation-data-type=uint8
      VSYS_Patch2_cnt: implementation-data-type=uint8
      VSYS_Country1_cnt: implementation-data-type=uint8
      VSYS_Country2_cnt: implementation-data-type=uint8
      VSYS_Variation_cnt: implementation-data-type=uint8
      VSYS_Dash1_cnt: implementation-data-type=uint8
      VSYS_Change1_cnt: implementation-data-type=uint8
      VSYS_Change2_cnt: implementation-data-type=uint8
      VSYS_Dash2_cnt: implementation-data-type=uint8
      VSYS_SHA{1..8}_cnt: implementation-data-type=uint8
      VSYS_NvWriteReqRisingEdge_flg: implementation-data-type=boolean
      VSYS_FdcSlpReqRisingEdge_flg: implementation-data-type=boolean
      VSYS_FdcSlpTime_sec: implementation-data-type=float32
      VSYS_PmicBootReason_enum: implementation-data-type=uint8
      VSYS_WisrBootReason_raw32: implementation-data-type=uint32
      VSYS_AcoreRebootCmdACK_flg: implementation-data-type=boolean
      VSYS_CurrentNmState_enum: implementation-data-type=uint8
      VSYS_ECUGen1_cnt: implementation-data-type=uint8
      VSYS_ECUGen2_cnt: implementation-data-type=uint8
      VSYS_PmicBootPath_raw32: implementation-data-type=uint32
      VSYS_DrivingMode_cnt: implementation-data-type=uint8
      VSYS_ModelYear_cnt: implementation-data-type=uint8
package /Interface_SYS_ARPkg
  sender receiver interface IF_BSYS_outputs
    data BSYS_outputs: type=BSYS_outputs
package /Impl_Type_THC_ARPkg
  impl type BTHC_outputs: category=STRUCTURE
    element VTHC_EWPPEReq_rpm: implementation-data-type=float32
    element VTHC_CoolFanReq_pct: implementation-data-type=float32
    element VTHC_AfterrunningMode_flg: implementation-data-type=boolean
package /Interface_THC_ARPkg
  sender receiver interface IF_BTHC_outputs
    data BTHC_outputs: type=BTHC_outputs
package /Impl_Type_TPM_ARPkg
  impl type BTPM_outputs: category=STRUCTURE
    114 x element, all with category=TYPE_REFERENCE:
      VTPM_LFBatWarn_flg: implementation-data-type=boolean
      VTPM_RFBatWarn_flg: implementation-data-type=boolean
      VTPM_LRBatWarn_flg: implementation-data-type=boolean
      VTPM_RRBatWarn_flg: implementation-data-type=boolean
      VTPM_LFWheelPress_raw8: implementation-data-type=uint8
      VTPM_RFWheelPress_raw8: implementation-data-type=uint8
      VTPM_LRWheelPress_raw8: implementation-data-type=uint8
      VTPM_RRWheelPress_raw8: implementation-data-type=uint8
      VTPM_LFWheelTemp_C: implementation-data-type=float32
      VTPM_RFWheelTemp_C: implementation-data-type=float32
      VTPM_LRWheelTemp_C: implementation-data-type=float32
      VTPM_RRWheelTemp_C: implementation-data-type=float32
      VTPM_LFSensorFail_flg: implementation-data-type=boolean
      VTPM_RFSensorFail_flg: implementation-data-type=boolean
      VTPM_LRSensorFail_flg: implementation-data-type=boolean
      VTPM_RRSensorFail_flg: implementation-data-type=boolean
      VTPM_LFWheelDebug_flg: implementation-data-type=boolean
      VTPM_LRWheelDebug_flg: implementation-data-type=boolean
      VTPM_RFWheelDebug_flg: implementation-data-type=boolean
      VTPM_RRWheelDebug_flg: implementation-data-type=boolean
      VTPM_TPMSResButtAllow_flg: implementation-data-type=boolean
      VTPM_TPMSCaliButtAllow_flg: implementation-data-type=boolean
      VTPM_LFPressIndi_enum: implementation-data-type=uint8
      VTPM_RFPressIndi_enum: implementation-data-type=uint8
      VTPM_LRPressIndi_enum: implementation-data-type=uint8
      VTPM_RRPressIndi_enum: implementation-data-type=uint8
      VTPM_TPMSWarnIndi_enum: implementation-data-type=uint8
      VTPM_LFWheelTmpIndi_flg: implementation-data-type=boolean
      VTPM_RFWheelTmpIndi_flg: implementation-data-type=boolean
      VTPM_LRWheelTmpIndi_flg: implementation-data-type=boolean
      VTPM_RRWheelTmpIndi_flg: implementation-data-type=boolean
      VTPM_LFWheelPSW_raw8: implementation-data-type=uint8
      VTPM_LRWheelPSW_raw8: implementation-data-type=uint8
      VTPM_RFWheelPSW_raw8: implementation-data-type=uint8
      VTPM_RRWheelPSW_raw8: implementation-data-type=uint8
      VTPM_LFS1_cnt: implementation-data-type=uint8
      VTPM_RFS1_cnt: implementation-data-type=uint8
      VTPM_RRS1_cnt: implementation-data-type=uint8
      VTPM_LRS1_cnt: implementation-data-type=uint8
      VTPM_LFS2_cnt: implementation-data-type=uint8
      VTPM_RFS2_cnt: implementation-data-type=uint8
      VTPM_RRS2_cnt: implementation-data-type=uint8
      VTPM_LRS2_cnt: implementation-data-type=uint8
      VTPM_LFS3_cnt: implementation-data-type=uint8
      VTPM_RFS3_cnt: implementation-data-type=uint8
      VTPM_RRS3_cnt: implementation-data-type=uint8
      VTPM_LRS3_cnt: implementation-data-type=uint8
      VTPM_LFS4_cnt: implementation-data-type=uint8
      VTPM_RFS4_cnt: implementation-data-type=uint8
      VTPM_RRS4_cnt: implementation-data-type=uint8
      VTPM_LRS4_cnt: implementation-data-type=uint8
      VTPM_CWheelTips_enum: implementation-data-type=uint8
      VTPM_AutoLTips_enum: implementation-data-type=uint8
      VTPM_LFSensorMode_flg: implementation-data-type=boolean
      VTPM_RFSensorMode_flg: implementation-data-type=boolean
      VTPM_LRSensorMode_flg: implementation-data-type=boolean
      VTPM_RRSensorMode_flg: implementation-data-type=boolean
      VTPM_S{1..4}ID_raw32: implementation-data-type=uint32
      VTPM_S{1..4}L_enum: implementation-data-type=uint8
      VTPM_ALFin_flg: implementation-data-type=boolean
      VTPM_IDLock_flg: implementation-data-type=boolean
      VTPM_LFP20_raw8: implementation-data-type=uint8
      VTPM_RFP20_raw8: implementation-data-type=uint8
      VTPM_LRP20_raw8: implementation-data-type=uint8
      VTPM_RRP20_raw8: implementation-data-type=uint8
      VTPM_FAT_flg: implementation-data-type=boolean
      VTPM_IDin_raw32: implementation-data-type=uint32
      VTPM_S{1..4}WheelDebugALTU_pct: implementation-data-type=float32
      VTPM_ID{1..4}messageALTU_raw8: implementation-data-type=uint8
      VTPM_Chkfin_flg: implementation-data-type=boolean
      VTPM_SetIDLoc_flg: implementation-data-type=boolean
      VTPM_TPMSStorge_flg: implementation-data-type=boolean
      VTPM_ChkStorge_flg: implementation-data-type=boolean
      VTPM_TPMSResButt_flg: implementation-data-type=boolean
      VTPM_LFPindi_enum: implementation-data-type=uint8
      VTPM_RFPind_enum: implementation-data-type=uint8
      VTPM_LRPindi_enum: implementation-data-type=uint8
      VTPM_RRPindi_enum: implementation-data-type=uint8
      VTPM_WriteChkLFID_raw: implementation-data-type=uint32
      VTPM_WriteChkRFID_raw: implementation-data-type=uint32
      VTPM_WriteChkLRID_raw: implementation-data-type=uint32
      VTPM_WriteChkRRID_raw: implementation-data-type=uint32
      VTPM_WriteChkfinLFID_raw: implementation-data-type=uint32
      VTPM_WriteChkfinRFID_raw: implementation-data-type=uint32
      VTPM_WriteChkfinLRID_raw: implementation-data-type=uint32
      VTPM_WriteChkfinRRID_raw: implementation-data-type=uint32
      VTPM_Flashchkdatavalid_enum: implementation-data-type=uint8
      VTPM_Flashdatavalid_enum: implementation-data-type=uint8
      VTPM_unlearnSfali_flg: implementation-data-type=boolean
      VTPM_unlearnSfailvalid_enum: implementation-data-type=uint8
      VTPM_Prepresstempvalid_enum: implementation-data-type=uint8
      VTPM_FlashS{1..4}ID_raw: implementation-data-type=uint32
      VTPM_FlashIDvalid_enum: implementation-data-type=uint8
      VTPM_WritingCnt_enum: implementation-data-type=uint8
      VTPM_TPMSTLCmd_flg: implementation-data-type=boolean
      VTPM_LProgress_enum: implementation-data-type=uint8
      VTPM_TPMSSensorIDRegStart_flg: implementation-data-type=boolean
      VTPM_ModelVersion_raw: implementation-data-type=uint8
      VTPM_ModelVersionChksum_raw: implementation-data-type=uint8
package /Interface_TPM_ARPkg
  sender receiver interface IF_BTPM_outputs
    data BTPM_outputs: type=BTPM_outputs
package /Impl_Type_TQD_ARPkg
  impl type BTQD_outputs: category=STRUCTURE
    120 x element, all with category=TYPE_REFERENCE:
      VTQD_PedalMapTq_Nm: implementation-data-type=float32
      VTQD_GearActualPosn_enum: implementation-data-type=uint8
      VTQD_TMRotateDirectionReq_enum: implementation-data-type=uint8
      VTQD_ParkingPawlPwrOn_flg: implementation-data-type=boolean
      VTQD_ParkingPawlEnable_flg: implementation-data-type=boolean
      VTQD_DRTransfer_flg: implementation-data-type=boolean
      VTQD_TqSource_enum: implementation-data-type=uint8
      VTQD_VCUMCUCtrlMdTQD_enum: implementation-data-type=uint8
      VTQD_CreepSpdReq_rpm: implementation-data-type=float32
      VTQD_CreepIND_enum: implementation-data-type=uint8
      VTQD_ActTUpAIND_enum: implementation-data-type=uint8
      VTQD_RollRegTorReq_Nm: implementation-data-type=float32
      VTQD_RollingRegenEnable_flg: implementation-data-type=boolean
      VTQD_VCUMCUDemHiPosVal_rpm: implementation-data-type=float32
      VTQD_VehAcclLimitTG_mps2: implementation-data-type=float32
      VTQD_TorqLimDoorOpn_flg: implementation-data-type=boolean
      VTQD_VCUEBSHHSw_enum: implementation-data-type=uint8
      VTQD_VCUEBSRd4BR_enum: implementation-data-type=uint8
      VTQD_ParkingProtectWarning_flg: implementation-data-type=boolean
      VTQD_ParkingProtectAction_flg: implementation-data-type=boolean
      VTQD_ActDriveMode_enum: implementation-data-type=uint8
      VTQD_VCU4PweLmtInd_flg: implementation-data-type=boolean
      VTQD_GearFlashIndDis_flg: implementation-data-type=boolean
      VTQD_GearFlashInd_flg: implementation-data-type=boolean
      VTQD_SpdLimSta_flg: implementation-data-type=boolean
      VTQD_EngModeEnDetTime_s: implementation-data-type=float32
      VTQD_EngModeEnDetEnd_flg: implementation-data-type=boolean
      VTQD_EngModeDisDetTime_s: implementation-data-type=float32
      VTQD_EngModeDisDetEnd_flg: implementation-data-type=boolean
      VTQD_LVchrgSvrMode_flg: implementation-data-type=boolean
      VTQD_ActFRDoorOPSta_flg: implementation-data-type=boolean
      VTQD_ActMDDoorOPSta_flg: implementation-data-type=boolean
      VTQD_ActTDDoorOPSta_flg: implementation-data-type=boolean
      VTQD_Function{1..5}Off_flg: implementation-data-type=boolean
      VTQD_FunctionOffSta_enum: implementation-data-type=uint8
      VTQD_ComboKeyEn_flg: implementation-data-type=boolean
      VTQD_ComboKeyPreEn_flg: implementation-data-type=boolean
      VTQD_VehSpdLimitTG_kph: implementation-data-type=float32
      VTQD_VCUTMVehSpd_kph: implementation-data-type=float32
      VTQD_VCUVehSpd_kph: implementation-data-type=float32
      VTQD_DriverTqDem_Nm: implementation-data-type=float32
      VTQD_AfterAvailableTqDemRr_Nm: implementation-data-type=float32
      VTQD_TMTqReq_Nm: implementation-data-type=float32
      VTQD_TqReductEnable_flg: implementation-data-type=boolean
      VTQD_ADASDriverDemWhTq_Nm: implementation-data-type=float32
      VTQD_RealWhTq_Nm: implementation-data-type=float32
      VTQD_VCUBCMBuzzReq_flg: implementation-data-type=boolean
      VTQD_VCUEBSHBSw_enum: implementation-data-type=uint8
      VTQD_EVCU1ActDrvMode_enum: implementation-data-type=uint8
      VTQD_EVCU1WheelSlipdet_enum: implementation-data-type=uint8
      VTQD_EVCU1EMotorSpd_rpm: implementation-data-type=float32
      VTQD_EVCU1EMotorOvrerSpd_enum: implementation-data-type=uint8
      VTQD_EVCU1EMotorPerformance_pct: implementation-data-type=float32
      VTQD_EVCU1EBrakeTorqLow_enum: implementation-data-type=uint8
      VTQD_EVCU2MaxTorqAvail_pct: implementation-data-type=float32
      VTQD_EVCU2MinTorqAvail_pct: implementation-data-type=float32
      VTQD_EEC3NFricPercTorq_pct: implementation-data-type=float32
      VTQD_EEC3EMPressLoss_pct: implementation-data-type=float32
      VTQD_ETC2ActDriveDirect_enum: implementation-data-type=float32
      VTQD_RC1PctTrqP4_pct: implementation-data-type=float32
      VTQD_RC1PctTrqPekTrqP5_pct: implementation-data-type=float32
      VTQD_EMRC1EMTquModeDrvBrk_enum: implementation-data-type=uint8
      VTQD_EMRC1ActEMpTrq_pct: implementation-data-type=float32
      VTQD_EMRC1ActEMOutSftSpd_rpm: implementation-data-type=float32
      VTQD_EMRC1ActEMpTrqHrls_pct: implementation-data-type=float32
      VTQD_EMRC1ActMaxAvaEMRecpTrq_pct: implementation-data-type=float32
      VTQD_EC1EMSpdIdleP1_rpm: implementation-data-type=float32
      VTQD_EC1PercTorqIdleP1_pct: implementation-data-type=float32
      VTQD_EC1EMSpdIdleP2_rpm: implementation-data-type=float32
      VTQD_EC1PercTorqIdleP2_pct: implementation-data-type=float32
      VTQD_EC1EMSpdIdleP3_rpm: implementation-data-type=float32
      VTQD_EC1PercTorqIdleP3_pct: implementation-data-type=float32
      VTQD_EC1EMSpdIdleP4_rpm: implementation-data-type=float32
      VTQD_EC1PercTorqIdleP4_pct: implementation-data-type=float32
      VTQD_EC1PercTorqIdleP5_pct: implementation-data-type=float32
      VTQD_EC1EMSpdIdleP5_rpm: implementation-data-type=float32
      VTQD_EC1EMRefTorq_Nm: implementation-data-type=float32
      VTQD_EC1EMMaxMEngOvrSP7_rpm: implementation-data-type=float32
      VTQD_EC1EMMaxMOvrTmt_s: implementation-data-type=float32
      VTQD_EC1EMReqSpdCtrlLoLmt_rpm: implementation-data-type=float32
      VTQD_EC1EMReqTrqCtrlLoLmt_pct: implementation-data-type=float32
      VTQD_EC1EMReqSpdCtrlUpLmt_rpm: implementation-data-type=float32
      VTQD_EC1EMReqTrqCtrlUpLmt_pct: implementation-data-type=float32
      VTQD_EC1EMExtRSCtrlUpLmt_rpm: implementation-data-type=float32
      VTQD_EC1EMMomOfInertia_kgpm2: implementation-data-type=float32
      VTQD_EC1EMDefTrqLmt_rpm: implementation-data-type=float32
      VTQD_EC1EMSupVarRTSC1MSG_cnt: implementation-data-type=uint8
      VTQD_EC1EMSupTSC1CtrlPG1_cnt: implementation-data-type=uint8
      VTQD_EC1EMSupTSC1CtrlPG3_cnt: implementation-data-type=uint8
      VTQD_EC1EMSupTSC1CtrlPG2_cnt: implementation-data-type=uint8
      VTQD_EC1EMSupTSC1CtrlPG4_cnt: implementation-data-type=uint8
      VTQD_EC1EMSpdHdleP6_rpm: implementation-data-type=float32
      VTQD_EC1EMGainEndSpdGvn_gain: implementation-data-type=float32
      VTQD_RC1RetType_enum: implementation-data-type=uint8
      VTQD_RC1RetLocat_enum: implementation-data-type=uint8
      VTQD_RC1RetCtrlMth_enum: implementation-data-type=float32
      VTQD_RC1RetSpdIdleP1_rpm: implementation-data-type=float32
      VTQD_RC1PctTrqIdleP1_pct: implementation-data-type=float32
      VTQD_RC1MaxRetSpdP2_rpm: implementation-data-type=float32
      VTQD_RC1RetSpdP2_pct: implementation-data-type=float32
      VTQD_RC1MaxRetSpdP3_rpm: implementation-data-type=float32
      VTQD_RC1PctTrqP3_pct: implementation-data-type=float32
      VTQD_RC1RefRetTrq_Nm: implementation-data-type=float32
      VTQD_RC1RetSpdPekTrqP5_Nm: implementation-data-type=float32
      VTQD_RC1RetSpdP4_rpm: implementation-data-type=float32
      VTQD_VCUMCUDemLoNegVal_rpm: implementation-data-type=float32
      VTQD_VCUMCUDemSpd_rpm: implementation-data-type=float32
      VTQD_VCUMCUGearSta_enum: implementation-data-type=uint8
      VTQD_TUpAIND_enum: implementation-data-type=uint8
      VTQD_ETC1ShiftrPgs_enum: implementation-data-type=uint8
      VTQD_EVCU1RecuperHighSta_enum: implementation-data-type=uint8
      VTQD_EMRC1DrvDemEMRtapTrq_pct: implementation-data-type=float32
      VTQD_EMRC1RetSelNonEng_pct: implementation-data-type=float32
      VTQD_EMRC1SACtrlDev_cnt: implementation-data-type=uint8
      VTQD_VCUMCUHandBrk_flg: implementation-data-type=boolean
      VTQD_VCUMCUFootBrk_flg: implementation-data-type=boolean
package /Interface_TQD_ARPkg
  sender receiver interface IF_BTQD_outputs
    data BTQD_outputs: type=BTQD_outputs
package /Impl_Type_TQR_ARPkg
  impl type BTQR_outputs: category=STRUCTURE
    18 x element, all with category=TYPE_REFERENCE:
      VTQR_FrTMTqReq_Nm: implementation-data-type=float32
      VTQR_FEDUTMSpdReq_rpm: implementation-data-type=float32
      VTQR_RrTMTqReq_Nm: implementation-data-type=float32
      VTQR_REDUTMSpdReq_rpm: implementation-data-type=float32
      VTQR_ActualFEDUWhlTqReq_Nm: implementation-data-type=float32
      VTQR_ActualREDUWhlTqReq_Nm: implementation-data-type=float32
      VTQR_NoABSFEDUWhlTqReq_Nm: implementation-data-type=float32
      VTQR_NoABSREDUWhlTqReq_Nm: implementation-data-type=float32
      VTQR_RShaftSpdTqLimLow_flg: implementation-data-type=boolean
      VTQR_RTimerTqLimLow_flg: implementation-data-type=boolean
      VTQR_FShaftSpdTqLimLow_flg: implementation-data-type=boolean
      VTQR_FTimerTqLimLow_flg: implementation-data-type=boolean
      VTQR_FrFirstOrderInpTs_c: implementation-data-type=float32
      VTQR_RrFirstOrderInpTs_c: implementation-data-type=float32
      VTQR_FrRateLimitInc_Nm: implementation-data-type=float32
      VTQR_FrRateLimitDec_Nm: implementation-data-type=float32
      VTQR_RrRateLimitInc_Nm: implementation-data-type=float32
      VTQR_RrRateLimitDec_Nm: implementation-data-type=float32
package /Interface_TQR_ARPkg
  sender receiver interface IF_BTQR_outputs
    data BTQR_outputs: type=BTQR_outputs
package /Impl_Type_V2L_ARPkg
  impl type BV2L_outputs: category=STRUCTURE
    7 x element, all with category=TYPE_REFERENCE, implementation-data-type=uint8:
      VV2L_ReqOBCV2LEna_enum
      VV2L_ReqV2LIVIPopup_enum
      VV2L_ReqV2LIVIDisChrg_enum
      VV2L_ReqOBCExtrV2LEna_enum
      VV2L_ReqOBCIntrV2LEna_enum
      VV2L_HVPO120VGrpALDSt_enum
      VV2L_HVPO120VGrpBLDSt_enum
package /Interface_V2L_ARPkg
  sender receiver interface IF_BV2L_outputs
    data BV2L_outputs: type=BV2L_outputs
package /Impl_Type_VMC_ARPkg
  impl type BVMC_outputs: category=STRUCTURE
    158 x element, all with category=TYPE_REFERENCE:
      VVMC_FeatSetSpdFinal_raw32: implementation-data-type=float32
      VVMC_VehicleSpeed_mph: implementation-data-type=float32
      VVMC_VehicleSpeed_kph: implementation-data-type=float32
      VVMC_MeterIndSpeed_raw32: implementation-data-type=float32
      VVMC_MeterIndSpeedForCalcu_kph: implementation-data-type=float32
      VVMC_VMCAEBCtrlAvail_flg: implementation-data-type=boolean
      VVMC_VMCACCCtrlAvail_flg: implementation-data-type=boolean
      VVMC_VMCCCCtrlAvail_flg: implementation-data-type=boolean
      VVMC_VMCMSACtrlAvail_flg: implementation-data-type=boolean
      VVMC_FeatArbitrSta_enum: implementation-data-type=uint8
      VVMC_FeatReqSpd_kph: implementation-data-type=float32
      VVMC_JerkPCT_pct: implementation-data-type=float32
      VVMC_LimitPCT_pct: implementation-data-type=float32
      VVMC_LFWhlSpeedRollAve_kph: implementation-data-type=float32
      VVMC_RFWhlSpeedRollAve_kph: implementation-data-type=float32
      VVMC_LRWhlSpeedRollAve_kph: implementation-data-type=float32
      VVMC_RRWhlSpeedRollAve_kph: implementation-data-type=float32
      VVMC_FrontRearSlipRatioCtrl_flg: implementation-data-type=boolean
      VVMC_RearWhlSlipRatioCtrl_flg: implementation-data-type=boolean
      VVMC_SingleWhlSlipRatioCtrl_flg: implementation-data-type=boolean
      VVMC_LatAccCtrl_flg: implementation-data-type=boolean
      VVMC_SafetyCtrl_flg: implementation-data-type=boolean
      VVMC_EstSlope_Deg: implementation-data-type=float32
      VVMC_SPD2ACCAct_flg: implementation-data-type=boolean
      VVMC_AccCalcuPID_mps2: implementation-data-type=float32
      VVMC_ISOAccLimit_mps2: implementation-data-type=float32
      VVMC_ISODecLimit_mps2: implementation-data-type=float32
      VVMC_ISOJerkLimit_mps3: implementation-data-type=float32
      VVMC_ACCRequiredAccel_mps2: implementation-data-type=float32
      VVMC_DISCReqAcc_mps2: implementation-data-type=float32
      VVMC_FeatArbitrFinal_enum: implementation-data-type=uint8
      VVMC_ActACCRequiredAccel_mps2: implementation-data-type=float32
      VVMC_LateralCtrl_flg: implementation-data-type=boolean
      VVMC_ADASLKASta_enum: implementation-data-type=uint8
      VVMC_LKAStrToqReq_Nm: implementation-data-type=float32
      VVMC_LKATOIFault_flg: implementation-data-type=boolean
      VVMC_LKATOIAct_enum: implementation-data-type=uint8
      VVMC_ADASAEBReq_enum: implementation-data-type=uint8
      VVMC_ADASFaultSta_flg: implementation-data-type=boolean
      VVMC_AEBVehHoldReq_flg: implementation-data-type=boolean
      VVMC_ACCVehHoldReq_flg: implementation-data-type=boolean
      VVMC_ADASDBSReq_enum: implementation-data-type=uint8
      VVMC_ADASACCSta_enum: implementation-data-type=uint8
      VVMC_ACCObjDist_m: implementation-data-type=float32
      VVMC_ACCObjRelSpd_mps: implementation-data-type=float32
      VVMC_TimeGapLevel_enum: implementation-data-type=uint8
      VVMC_ACCJerkUpperLimit_mps3: implementation-data-type=float32
      VVMC_ACCComfortBandUpper_mps2: implementation-data-type=float32
      VVMC_ACCJerkLowerLimit_mps3: implementation-data-type=float32
      VVMC_ACCComfortBandLower_mps2: implementation-data-type=float32
      VVMC_ADASVehSpdLim_raw32: implementation-data-type=float32
      VVMC_ADASShftPosnReqA_flg: implementation-data-type=boolean
      VVMC_ADASShftPosnReq_enum: implementation-data-type=uint8
      VVMC_ADASForceIdle_flg: implementation-data-type=boolean
      VVMC_HazardWarningReq_flg: implementation-data-type=boolean
      VVMC_RightTurnLightReq_flg: implementation-data-type=boolean
      VVMC_LeftTurnLightReq_flg: implementation-data-type=boolean
      VVMC_ADASFCWSta_enum: implementation-data-type=uint8
      VVMC_ADASLDWSta_enum: implementation-data-type=uint8
      VVMC_ADASFltWrnReq_flg: implementation-data-type=boolean
      VVMC_ACCObjDstLvl_enum: implementation-data-type=uint8
      VVMC_ForceLowBeam_enum: implementation-data-type=uint8
      VVMC_ACCTakeoverReq_flg: implementation-data-type=boolean
      VVMC_ADASWarningMsg_enum: implementation-data-type=uint8
      VVMC_ADASCAMSpdLim_enum: implementation-data-type=uint8
      VVMC_TargetType_enum: implementation-data-type=uint8
      VVMC_ADASSLIFSpdLim_enum: implementation-data-type=uint8
      VVMC_LKAHODDisplayWarning_flg: implementation-data-type=boolean
      VVMC_LKAHODSoundWarning_flg: implementation-data-type=boolean
      VVMC_ADASLFCSta_enum: implementation-data-type=uint8
      VVMC_ADASLaneModeL_enum: implementation-data-type=uint8
      VVMC_ADASLaneModeR_enum: implementation-data-type=uint8
      VVMC_ADASSLIFSta_enum: implementation-data-type=uint8
      VVMC_ADASISASta_enum: implementation-data-type=uint8
      VVMC_ADASLDWMute_flg: implementation-data-type=boolean
      VVMC_ADASFCWMute_flg: implementation-data-type=boolean
      VVMC_ADASLFCHandsOffWarning_enum: implementation-data-type=uint8
      VVMC_LVDADisabled_flg: implementation-data-type=boolean
      VVMC_LVDAMuteSta_enum: implementation-data-type=uint8
      VVMC_LVDAFailinfo_flg: implementation-data-type=boolean
      VVMC_LVDAWarning_flg: implementation-data-type=boolean
      VVMC_LVDAACCStatusInformation_flg: implementation-data-type=boolean
      VVMC_ADASLFCWarnSound_enum: implementation-data-type=uint8
      VVMC_FCMACCmode_enum: implementation-data-type=uint8
      VVMC_ADASLanetypeR_enum: implementation-data-type=uint8
      VVMC_ADASLanetypeL_enum: implementation-data-type=uint8
      VVMC_ADASLanecurveL_raw32: implementation-data-type=float32
      VVMC_ADASLanecurveR_raw32: implementation-data-type=float32
      VVMC_ADASAEBSta_enum: implementation-data-type=uint8
      VVMC_FCMLDWRequest_enum: implementation-data-type=uint8
      VVMC_FCMLDWFault_flg: implementation-data-type=boolean
      VVMC_ADASActive_flg: implementation-data-type=boolean
      VVMC_ACCCtrlAvail_flg: implementation-data-type=boolean
      VVMC_ADASNegReq_flg: implementation-data-type=boolean
      VVMC_ACCPedalOvrd_flg: implementation-data-type=boolean
      VVMC_ADASWhlTqReq_Nm: implementation-data-type=float32
      VVMC_AccPedalOvrdDISC_flg: implementation-data-type=boolean
      VVMC_RearTqRatio_rat: implementation-data-type=float32
      VVMC_TimeGapCalcu_s: implementation-data-type=float32
      VVMC_CCCtrlSta_enum: implementation-data-type=uint8
      VVMC_CruzActive_flg: implementation-data-type=boolean
      VVMC_CCPedalOvrd_flg: implementation-data-type=boolean
      VVMC_CruzWhlTqReq_Nm: implementation-data-type=float32
      VVMC_MSACtrlSta_enum: implementation-data-type=uint8
      VVMC_MSAActive_flg: implementation-data-type=boolean
      VVMC_MSAWhlTqReq_Nm: implementation-data-type=float32
      VVMC_APSCtrlAvail_flg: implementation-data-type=boolean
      VVMC_APSActive_flg: implementation-data-type=boolean
      VVMC_APSSpeedCMD_kph: implementation-data-type=float32
      VVMC_APSShiftPosnReq_enum: implementation-data-type=uint8
      VVMC_APSStaSys_enum: implementation-data-type=uint8
      VVMC_APSDecReqA_flg: implementation-data-type=boolean
      VVMC_APSDecReq_mps2: implementation-data-type=float32
      VVMC_APSReq_enum: implementation-data-type=uint8
      VVMC_LongAcc_Gps: implementation-data-type=float32
      VVMC_RawWhlSpdSlideRate_pct: implementation-data-type=float32
      VVMC_LFWhlSpdSlideRate_pct: implementation-data-type=float32
      VVMC_RFWhlSpdSlideRate_pct: implementation-data-type=float32
      VVMC_LRWhlSpdSlideRate_pct: implementation-data-type=float32
      VVMC_RRWhlSpdSlideRate_pct: implementation-data-type=float32
      VVMC_PredictVehSpd_kph: implementation-data-type=float32
      VVMC_LF4WhlSpdSlideRate_pct: implementation-data-type=float32
      VVMC_RF4WhlSpdSlideRate_pct: implementation-data-type=float32
      VVMC_LR4WhlSpdSlideRate_pct: implementation-data-type=float32
      VVMC_RR4WhlSpdSlideRate_pct: implementation-data-type=float32
      VVMC_4WhlSpdSlideRate_pct: implementation-data-type=float32
      VVMC_ActMaxSlideRate_pct: implementation-data-type=float32
      VVMC_ActLFSlideRate_pct: implementation-data-type=float32
      VVMC_ActRFSlideRate_pct: implementation-data-type=float32
      VVMC_ActLRSlideRate_pct: implementation-data-type=float32
      VVMC_ActRRSlideRate_pct: implementation-data-type=float32
      VVMC_AltLWhlSlideRate_pct: implementation-data-type=float32
      VVMC_AltRWhlSlideRate_pct: implementation-data-type=float32
      VVMC_AltWhlSlideRate_pct: implementation-data-type=float32
      VVMC_CCMSASpdWar_flg: implementation-data-type=boolean
      VVMC_IMUEnaCmd_flg: implementation-data-type=boolean
      VVMC_RWDRDCActive_enum: implementation-data-type=uint8
      VVMC_MSAWhlTqActive_flg: implementation-data-type=boolean
      VVMC_RDCEnSlideRate_pct: implementation-data-type=float32
      VVMC_ActStESCYaw_Dps: implementation-data-type=float32
      VVMC_ACCOvrdMemTq_Nm: implementation-data-type=float32
      VVMC_CAASCtrlAvail_flg: implementation-data-type=boolean
      VVMC_CAASActive_flg: implementation-data-type=boolean
      VVMC_ExtraMSACtrlSta_enum: implementation-data-type=uint8
      VVMC_CalibratedAccX_G: implementation-data-type=float32
      VVMC_CalibratedAccY_G: implementation-data-type=float32
      VVMC_CalibratedAccZ_G: implementation-data-type=float32
      VVMC_CalibratedGyroX_Dps: implementation-data-type=float32
      VVMC_CalibratedGyroY_Dps: implementation-data-type=float32
      VVMC_CalibratedGyroZ_Dps: implementation-data-type=float32
      VVMC_SetACCDisableAPS_flg: implementation-data-type=boolean
      VVMC_FDCVMCAPSVRqEPSCtrl_flg: implementation-data-type=boolean
      VVMC_FDCVMCAPSAngleTarget_deg: implementation-data-type=float32
      VVMC_FDCVMCAPSRqEPSCtrl_flg: implementation-data-type=boolean
      VVMC_FDCVMCAngCtrlTqWtGn_pct: implementation-data-type=float32
      VVMC_FDCVMCDrInpTqBstAct_flg: implementation-data-type=boolean
      VVMC_FDCVMCMaxAngCtrlOutTqLim_Nm: implementation-data-type=float32
      VVMC_FDCVMCDrInpTqBstGn_pct: implementation-data-type=float32
package /Interface_VMC_ARPkg
  sender receiver interface IF_BVMC_outputs
    data BVMC_outputs: type=BVMC_outputs
package /Impl_Type_APP_ARPkg
  7 x impl type, all with category=ARRAY:
    u8_Array16_type
      element u8_Array16: category=VALUE, array-size=16, array-size-semantics=FIXED-SIZE, base-type=uint8
    u8_Array8_type
      element u8_Array8: category=VALUE, array-size=8, array-size-semantics=FIXED-SIZE, base-type=uint8
    u16_Array8_type
      element u16_Array8: category=VALUE, array-size=8, array-size-semantics=FIXED-SIZE, base-type=uint16
    u32_Array8_type
      element u32_Array8: category=VALUE, array-size=8, array-size-semantics=FIXED-SIZE, base-type=uint32
    u8_Array17_type
      element u8_Array17: category=VALUE, array-size=17, array-size-semantics=FIXED-SIZE, base-type=uint8
    u8_Array20_type
      element u8_Array20: category=VALUE, array-size=20, array-size-semantics=FIXED-SIZE, base-type=uint8
    u8_Array12_type
      element u8_Array12: category=VALUE, array-size=12, array-size-semantics=FIXED-SIZE, base-type=uint8
