ASAP2_VERSION 1 31
/begin PROJECT ProjectName "Project Comment Goes Here"
/begin HEADER "Header Comments go here" /end HEADER
/begin MODULE ModuleName "Module Comment Goes Here"
/begin MOD_COMMON "Mod Common Comment Here" BYTE_ORDER MSB_LAST /end MOD_COMMON
/begin RECORD_LAYOUT Scalar_BOOLEAN FNC_VALUES 1 UBYTE COLUMN_DIR DIRECT /end RECORD_LAYOUT
/begin RECORD_LAYOUT Scalar_UBYTE FNC_VALUES 1 UBYTE COLUMN_DIR DIRECT /end RECORD_LAYOUT
/begin RECORD_LAYOUT Scalar_ULONG FNC_VALUES 1 ULONG COLUMN_DIR DIRECT /end RECORD_LAYOUT
/begin RECORD_LAYOUT Scalar_FLOAT32_IEEE FNC_VALUES 1 FLOAT32_IEEE COLUMN_DIR DIRECT /end RECORD_LAYOUT
/begin RECORD_LAYOUT Lookup1D_FLOAT32_IEEE FNC_VALUES 1 FLOAT32_IEEE COLUMN_DIR DIRECT /end RECORD_LAYOUT
/begin RECORD_LAYOUT Lookup1D_X_FLOAT32_IEEE AXIS_PTS_X 1 FLOAT32_IEEE INDEX_INCR DIRECT /end RECORD_LAYOUT
/begin RECORD_LAYOUT Lookup1D_FLOAT64_IEEE FNC_VALUES 1 FLOAT64_IEEE COLUMN_DIR DIRECT /end RECORD_LAYOUT
/begin RECORD_LAYOUT Lookup1D_X_FLOAT64_IEEE AXIS_PTS_X 1 FLOAT64_IEEE INDEX_INCR DIRECT /end RECORD_LAYOUT
/begin CHARACTERISTIC KOUTP_VehSpeed_kph_maxval "" VALUE 0x0000 /* @ECU_Address@KOUTP_VehSpeed_kph_maxval@ */ Scalar_FLOAT32_IEEE 0 SWC_OUTP_type_CM_single_kph -65535.0 65535.0 /end CHARACTERISTIC
/begin CHARACTERISTIC KOUTP_VehSpeed_kph_minval "" VALUE 0x0000 /* @ECU_Address@KOUTP_VehSpeed_kph_minval@ */ Scalar_FLOAT32_IEEE 0 SWC_OUTP_type_CM_single_kph -65535.0 65535.0 /end CHARACTERISTIC
/begin CHARACTERISTIC KOUTP_VehSpeed_kph_ovrdval "" VALUE 0x0000 /* @ECU_Address@KOUTP_VehSpeed_kph_ovrdval@ */ Scalar_FLOAT32_IEEE 0 SWC_OUTP_type_CM_single_kph -65535.0 65535.0 /end CHARACTERISTIC
/begin CHARACTERISTIC KOUTP_YawRate_degps_maxval "" VALUE 0x0000 /* @ECU_Address@KOUTP_YawRate_degps_maxval@ */ Scalar_FLOAT32_IEEE 0 SWC_OUTP_type_CM_single_degps -65535.0 65535.0 /end CHARACTERISTIC
/begin CHARACTERISTIC KOUTP_YawRate_degps_minval "" VALUE 0x0000 /* @ECU_Address@KOUTP_YawRate_degps_minval@ */ Scalar_FLOAT32_IEEE 0 SWC_OUTP_type_CM_single_degps -65535.0 65535.0 /end CHARACTERISTIC
/begin CHARACTERISTIC KOUTP_YawRate_degps_ovrdval "" VALUE 0x0000 /* @ECU_Address@KOUTP_YawRate_degps_ovrdval@ */ Scalar_FLOAT32_IEEE 0 SWC_OUTP_type_CM_single_degps -65535.0 65535.0 /end CHARACTERISTIC
/begin CHARACTERISTIC KOUTP_5vAPS1PwrErrDTC_raw32_maxval "" VALUE 0x0000 /* @ECU_Address@KOUTP_5vAPS1PwrErrDTC_raw32_maxval@ */ Scalar_ULONG 0 SWC_OUTP_type_CM_uint32_raw32 0.0 4.294967295E+9 /end CHARACTERISTIC
/begin CHARACTERISTIC KOUTP_5vAPS1PwrErrDTC_raw32_minval "" VALUE 0x0000 /* @ECU_Address@KOUTP_5vAPS1PwrErrDTC_raw32_minval@ */ Scalar_ULONG 0 SWC_OUTP_type_CM_uint32_raw32 0.0 4.294967295E+9 /end CHARACTERISTIC
/begin CHARACTERISTIC KOUTP_5vAPS1PwrErrDTC_raw32_ovrdval "" VALUE 0x0000 /* @ECU_Address@KOUTP_5vAPS1PwrErrDTC_raw32_ovrdval@ */ Scalar_ULONG 0 SWC_OUTP_type_CM_uint32_raw32 0.0 4.294967295E+9 /end CHARACTERISTIC
/begin CHARACTERISTIC KOUTP_5vAPS2PwrErrDTC_raw32_maxval "" VALUE 0x0000 /* @ECU_Address@KOUTP_5vAPS2PwrErrDTC_raw32_maxval@ */ Scalar_ULONG 0 SWC_OUTP_type_CM_uint32_raw32 0.0 4.294967295E+9 /end CHARACTERISTIC
/begin CHARACTERISTIC KOUTP_5vAPS2PwrErrDTC_raw32_minval "" VALUE 0x0000 /* @ECU_Address@KOUTP_5vAPS2PwrErrDTC_raw32_minval@ */ Scalar_ULONG 0 SWC_OUTP_type_CM_uint32_raw32 0.0 4.294967295E+9 /end CHARACTERISTIC
/begin CHARACTERISTIC KOUTP_5vAPS2PwrErrDTC_raw32_ovrdval "" VALUE 0x0000 /* @ECU_Address@KOUTP_5vAPS2PwrErrDTC_raw32_ovrdval@ */ Scalar_ULONG 0 SWC_OUTP_type_CM_uint32_raw32 0.0 4.294967295E+9 /end CHARACTERISTIC
/begin CHARACTERISTIC KOUTP_ACCAccelCmdErrDetDTC_raw32_maxval "" VALUE 0x0000 /* @ECU_Address@KOUTP_ACCAccelCmdErrDetDTC_raw32_maxval@ */ Scalar_ULONG 0 SWC_OUTP_type_CM_uint32_raw32 0.0 4.294967295E+9 /end CHARACTERISTIC
/begin CHARACTERISTIC KOUTP_ACCAccelCmdErrDetDTC_raw32_minval "" VALUE 0x0000 /* @ECU_Address@KOUTP_ACCAccelCmdErrDetDTC_raw32_minval@ */ Scalar_ULONG 0 SWC_OUTP_type_CM_uint32_raw32 0.0 4.294967295E+9 /end CHARACTERISTIC
/begin CHARACTERISTIC KOUTP_ACCAccelCmdErrDetDTC_raw32_ovrdval "" VALUE 0x0000 /* @ECU_Address@KOUTP_ACCAccelCmdErrDetDTC_raw32_ovrdval@ */ Scalar_ULONG 0 SWC_OUTP_type_CM_uint32_raw32 0.0 4.294967295E+9 /end CHARACTERISTIC
/begin CHARACTERISTIC KOUTP_ACCMalfuncDetDTC_raw32_maxval "" VALUE 0x0000 /* @ECU_Address@KOUTP_ACCMalfuncDetDTC_raw32_maxval@ */ Scalar_ULONG 0 SWC_OUTP_type_CM_uint32_raw32 0.0 4.294967295E+9 /end CHARACTERISTIC
/begin CHARACTERISTIC KOUTP_ACCMalfuncDetDTC_raw32_minval "" VALUE 0x0000 /* @ECU_Address@KOUTP_ACCMalfuncDetDTC_raw32_minval@ */ Scalar_ULONG 0 SWC_OUTP_type_CM_uint32_raw32 0.0 4.294967295E+9 /end CHARACTERISTIC
/begin CHARACTERISTIC KOUTP_ACCMalfuncDetDTC_raw32_ovrdval "" VALUE 0x0000 /* @ECU_Address@KOUTP_ACCMalfuncDetDTC_raw32_ovrdval@ */ Scalar_ULONG 0 SWC_OUTP_type_CM_uint32_raw32 0.0 4.294967295E+9 /end CHARACTERISTIC
/begin CHARACTERISTIC KOUTP_APS1SigOoRDTC_raw32_maxval "" VALUE 0x0000 /* @ECU_Address@KOUTP_APS1SigOoRDTC_raw32_maxval@ */ Scalar_ULONG 0 SWC_OUTP_type_CM_uint32_raw32 0.0 4.294967295E+9 /end CHARACTERISTIC
/begin CHARACTERISTIC KOUTP_APS1SigOoRDTC_raw32_minval "" VALUE 0x0000 /* @ECU_Address@KOUTP_APS1SigOoRDTC_raw32_minval@ */ Scalar_ULONG 0 SWC_OUTP_type_CM_uint32_raw32 0.0 4.294967295E+9 /end CHARACTERISTIC
/begin CHARACTERISTIC KOUTP_APS1SigOoRDTC_raw32_ovrdval "" VALUE 0x0000 /* @ECU_Address@KOUTP_APS1SigOoRDTC_raw32_ovrdval@ */ Scalar_ULONG 0 SWC_OUTP_type_CM_uint32_raw32 0.0 4.294967295E+9 /end CHARACTERISTIC
/begin CHARACTERISTIC KOUTP_APS2SigOoRDTC_raw32_maxval "" VALUE 0x0000 /* @ECU_Address@KOUTP_APS2SigOoRDTC_raw32_maxval@ */ Scalar_ULONG 0 SWC_OUTP_type_CM_uint32_raw32 0.0 4.294967295E+9 /end CHARACTERISTIC
/begin CHARACTERISTIC KOUTP_APS2SigOoRDTC_raw32_minval "" VALUE 0x0000 /* @ECU_Address@KOUTP_APS2SigOoRDTC_raw32_minval@ */ Scalar_ULONG 0 SWC_OUTP_type_CM_uint32_raw32 0.0 4.294967295E+9 /end CHARACTERISTIC
/begin CHARACTERISTIC KOUTP_APS2SigOoRDTC_raw32_ovrdval "" VALUE 0x0000 /* @ECU_Address@KOUTP_APS2SigOoRDTC_raw32_ovrdval@ */ Scalar_ULONG 0 SWC_OUTP_type_CM_uint32_raw32 0.0 4.294967295E+9 /end CHARACTERISTIC
/begin CHARACTERISTIC KOUTP_APSCorrErrDTC_raw32_maxval "" VALUE 0x0000 /* @ECU_Address@KOUTP_APSCorrErrDTC_raw32_maxval@ */ Scalar_ULONG 0 SWC_OUTP_type_CM_uint32_raw32 0.0 4.294967295E+9 /end CHARACTERISTIC
/begin CHARACTERISTIC KOUTP_APSCorrErrDTC_raw32_minval "" VALUE 0x0000 /* @ECU_Address@KOUTP_APSCorrErrDTC_raw32_minval@ */ Scalar_ULONG 0 SWC_OUTP_type_CM_uint32_raw32 0.0 4.294967295E+9 /end CHARACTERISTIC
/begin CHARACTERISTIC KOUTP_APSCorrErrDTC_raw32_ovrdval "" VALUE 0x0000 /* @ECU_Address@KOUTP_APSCorrErrDTC_raw32_ovrdval@ */ Scalar_ULONG 0 SWC_OUTP_type_CM_uint32_raw32 0.0 4.294967295E+9 /end CHARACTERISTIC
/begin CHARACTERISTIC KOUTP_BMSRdyDTC_raw32_maxval "" VALUE 0x0000 /* @ECU_Address@KOUTP_BMSRdyDTC_raw32_maxval@ */ Scalar_ULONG 0 SWC_OUTP_type_CM_uint32_raw32 0.0 4.294967295E+9 /end CHARACTERISTIC
/begin CHARACTERISTIC KOUTP_BMSRdyDTC_raw32_minval "" VALUE 0x0000 /* @ECU_Address@KOUTP_BMSRdyDTC_raw32_minval@ */ Scalar_ULONG 0 SWC_OUTP_type_CM_uint32_raw32 0.0 4.294967295E+9 /end CHARACTERISTIC
/begin CHARACTERISTIC KOUTP_BMSRdyDTC_raw32_ovrdval "" VALUE 0x0000 /* @ECU_Address@KOUTP_BMSRdyDTC_raw32_ovrdval@ */ Scalar_ULONG 0 SWC_OUTP_type_CM_uint32_raw32 0.0 4.294967295E+9 /end CHARACTERISTIC
/begin CHARACTERISTIC KOUTP_BMSSigErrDetDTC_raw32_maxval "" VALUE 0x0000 /* @ECU_Address@KOUTP_BMSSigErrDetDTC_raw32_maxval@ */ Scalar_ULONG 0 SWC_OUTP_type_CM_uint32_raw32 0.0 4.294967295E+9 /end CHARACTERISTIC
/begin CHARACTERISTIC KOUTP_BMSSigErrDetDTC_raw32_minval "" VALUE 0x0000 /* @ECU_Address@KOUTP_BMSSigErrDetDTC_raw32_minval@ */ Scalar_ULONG 0 SWC_OUTP_type_CM_uint32_raw32 0.0 4.294967295E+9 /end CHARACTERISTIC
/begin CHARACTERISTIC KOUTP_BMSSigErrDetDTC_raw32_ovrdval "" VALUE 0x0000 /* @ECU_Address@KOUTP_BMSSigErrDetDTC_raw32_ovrdval@ */ Scalar_ULONG 0 SWC_OUTP_type_CM_uint32_raw32 0.0 4.294967295E+9 /end CHARACTERISTIC
/begin CHARACTERISTIC KOUTP_BrkSWErrDTC_raw32_maxval "" VALUE 0x0000 /* @ECU_Address@KOUTP_BrkSWErrDTC_raw32_maxval@ */ Scalar_ULONG 0 SWC_OUTP_type_CM_uint32_raw32 0.0 4.294967295E+9 /end CHARACTERISTIC
/begin CHARACTERISTIC KOUTP_BrkSWErrDTC_raw32_minval "" VALUE 0x0000 /* @ECU_Address@KOUTP_BrkSWErrDTC_raw32_minval@ */ Scalar_ULONG 0 SWC_OUTP_type_CM_uint32_raw32 0.0 4.294967295E+9 /end CHARACTERISTIC
/begin CHARACTERISTIC KOUTP_BrkSWErrDTC_raw32_ovrdval "" VALUE 0x0000 /* @ECU_Address@KOUTP_BrkSWErrDTC_raw32_ovrdval@ */ Scalar_ULONG 0 SWC_OUTP_type_CM_uint32_raw32 0.0 4.294967295E+9 /end CHARACTERISTIC
/begin CHARACTERISTIC KOUTP_BrkSWNoBacDTC_raw32_maxval "" VALUE 0x0000 /* @ECU_Address@KOUTP_BrkSWNoBacDTC_raw32_maxval@ */ Scalar_ULONG 0 SWC_OUTP_type_CM_uint32_raw32 0.0 4.294967295E+9 /end CHARACTERISTIC
/begin CHARACTERISTIC KOUTP_BrkSWNoBacDTC_raw32_minval "" VALUE 0x0000 /* @ECU_Address@KOUTP_BrkSWNoBacDTC_raw32_minval@ */ Scalar_ULONG 0 SWC_OUTP_type_CM_uint32_raw32 0.0 4.294967295E+9 /end CHARACTERISTIC
/begin CHARACTERISTIC KOUTP_BrkSWNoBacDTC_raw32_ovrdval "" VALUE 0x0000 /* @ECU_Address@KOUTP_BrkSWNoBacDTC_raw32_ovrdval@ */ Scalar_ULONG 0 SWC_OUTP_type_CM_uint32_raw32 0.0 4.294967295E+9 /end CHARACTERISTIC
/begin CHARACTERISTIC KOUTP_C1ABM1CSDTC_raw32_maxval "" VALUE 0x0000 /* @ECU_Address@KOUTP_C1ABM1CSDTC_raw32_maxval@ */ Scalar_ULONG 0 SWC_OUTP_type_CM_uint32_raw32 0.0 4.294967295E+9 /end CHARACTERISTIC
/begin CHARACTERISTIC KOUTP_C1ABM1CSDTC_raw32_minval "" VALUE 0x0000 /* @ECU_Address@KOUTP_C1ABM1CSDTC_raw32_minval@ */ Scalar_ULONG 0 SWC_OUTP_type_CM_uint32_raw32 0.0 4.294967295E+9 /end CHARACTERISTIC
/begin CHARACTERISTIC KOUTP_C1ABM1CSDTC_raw32_ovrdval "" VALUE 0x0000 /* @ECU_Address@KOUTP_C1ABM1CSDTC_raw32_ovrdval@ */ Scalar_ULONG 0 SWC_OUTP_type_CM_uint32_raw32 0.0 4.294967295E+9 /end CHARACTERISTIC
/begin CHARACTERISTIC KOUTP_C1ABM1LCDTC_raw32_maxval "" VALUE 0x0000 /* @ECU_Address@KOUTP_C1ABM1LCDTC_raw32_maxval@ */ Scalar_ULONG 0 SWC_OUTP_type_CM_uint32_raw32 0.0 4.294967295E+9 /end CHARACTERISTIC
/begin CHARACTERISTIC KOUTP_C1ABM1LCDTC_raw32_minval "" VALUE 0x0000 /* @ECU_Address@KOUTP_C1ABM1LCDTC_raw32_minval@ */ Scalar_ULONG 0 SWC_OUTP_type_CM_uint32_raw32 0.0 4.294967295E+9 /end CHARACTERISTIC
/begin CHARACTERISTIC KOUTP_C1ABM1LCDTC_raw32_ovrdval "" VALUE 0x0000 /* @ECU_Address@KOUTP_C1ABM1LCDTC_raw32_ovrdval@ */ Scalar_ULONG 0 SWC_OUTP_type_CM_uint32_raw32 0.0 4.294967295E+9 /end CHARACTERISTIC
/begin CHARACTERISTIC KOUTP_C1ABM1RCDTC_raw32_maxval "" VALUE 0x0000 /* @ECU_Address@KOUTP_C1ABM1RCDTC_raw32_maxval@ */ Scalar_ULONG 0 SWC_OUTP_type_CM_uint32_raw32 0.0 4.294967295E+9 /end CHARACTERISTIC
/begin CHARACTERISTIC KOUTP_C1ABM1RCDTC_raw32_minval "" VALUE 0x0000 /* @ECU_Address@KOUTP_C1ABM1RCDTC_raw32_minval@ */ Scalar_ULONG 0 SWC_OUTP_type_CM_uint32_raw32 0.0 4.294967295E+9 /end CHARACTERISTIC
/begin CHARACTERISTIC KOUTP_C1ABM1RCDTC_raw32_ovrdval "" VALUE 0x0000 /* @ECU_Address@KOUTP_C1ABM1RCDTC_raw32_ovrdval@ */ Scalar_ULONG 0 SWC_OUTP_type_CM_uint32_raw32 0.0 4.294967295E+9 /end CHARACTERISTIC
/begin CHARACTERISTIC KOUTP_C1EPAS2LCDTC_raw32_maxval "" VALUE 0x0000 /* @ECU_Address@KOUTP_C1EPAS2LCDTC_raw32_maxval@ */ Scalar_ULONG 0 SWC_OUTP_type_CM_uint32_raw32 0.0 4.294967295E+9 /end CHARACTERISTIC
/begin CHARACTERISTIC KOUTP_C1EPAS2LCDTC_raw32_minval "" VALUE 0x0000 /* @ECU_Address@KOUTP_C1EPAS2LCDTC_raw32_minval@ */ Scalar_ULONG 0 SWC_OUTP_type_CM_uint32_raw32 0.0 4.294967295E+9 /end CHARACTERISTIC
/begin CHARACTERISTIC KOUTP_C1EPAS2LCDTC_raw32_ovrdval "" VALUE 0x0000 /* @ECU_Address@KOUTP_C1EPAS2LCDTC_raw32_ovrdval@ */ Scalar_ULONG 0 SWC_OUTP_type_CM_uint32_raw32 0.0 4.294967295E+9 /end CHARACTERISTIC
/begin CHARACTERISTIC KOUTP_C3BMS1CSDTC_raw32_maxval "" VALUE 0x0000 /* @ECU_Address@KOUTP_C3BMS1CSDTC_raw32_maxval@ */ Scalar_ULONG 0 SWC_OUTP_type_CM_uint32_raw32 0.0 4.294967295E+9 /end CHARACTERISTIC
/begin CHARACTERISTIC KOUTP_C3BMS1CSDTC_raw32_minval "" VALUE 0x0000 /* @ECU_Address@KOUTP_C3BMS1CSDTC_raw32_minval@ */ Scalar_ULONG 0 SWC_OUTP_type_CM_uint32_raw32 0.0 4.294967295E+9 /end CHARACTERISTIC
/begin CHARACTERISTIC KOUTP_C3BMS1CSDTC_raw32_ovrdval "" VALUE 0x0000 /* @ECU_Address@KOUTP_C3BMS1CSDTC_raw32_ovrdval@ */ Scalar_ULONG 0 SWC_OUTP_type_CM_uint32_raw32 0.0 4.294967295E+9 /end CHARACTERISTIC
/begin CHARACTERISTIC KOUTP_C3BMS1LCDTC_raw32_maxval "" VALUE 0x0000 /* @ECU_Address@KOUTP_C3BMS1LCDTC_raw32_maxval@ */ Scalar_ULONG 0 SWC_OUTP_type_CM_uint32_raw32 0.0 4.294967295E+9 /end CHARACTERISTIC
/begin CHARACTERISTIC KOUTP_C3BMS1LCDTC_raw32_minval "" VALUE 0x0000 /* @ECU_Address@KOUTP_C3BMS1LCDTC_raw32_minval@ */ Scalar_ULONG 0 SWC_OUTP_type_CM_uint32_raw32 0.0 4.294967295E+9 /end CHARACTERISTIC
/begin CHARACTERISTIC KOUTP_C3BMS1LCDTC_raw32_ovrdval "" VALUE 0x0000 /* @ECU_Address@KOUTP_C3BMS1LCDTC_raw32_ovrdval@ */ Scalar_ULONG 0 SWC_OUTP_type_CM_uint32_raw32 0.0 4.294967295E+9 /end CHARACTERISTIC
/begin CHARACTERISTIC KOUTP_C3BMS1RCDTC_raw32_maxval "" VALUE 0x0000 /* @ECU_Address@KOUTP_C3BMS1RCDTC_raw32_maxval@ */ Scalar_ULONG 0 SWC_OUTP_type_CM_uint32_raw32 0.0 4.294967295E+9 /end CHARACTERISTIC
/begin CHARACTERISTIC KOUTP_C3BMS1RCDTC_raw32_minval "" VALUE 0x0000 /* @ECU_Address@KOUTP_C3BMS1RCDTC_raw32_minval@ */ Scalar_ULONG 0 SWC_OUTP_type_CM_uint32_raw32 0.0 4.294967295E+9 /end CHARACTERISTIC
/begin CHARACTERISTIC KOUTP_C3BMS1RCDTC_raw32_ovrdval "" VALUE 0x0000 /* @ECU_Address@KOUTP_C3BMS1RCDTC_raw32_ovrdval@ */ Scalar_ULONG 0 SWC_OUTP_type_CM_uint32_raw32 0.0 4.294967295E+9 /end CHARACTERISTIC
/begin CHARACTERISTIC KOUTP_C3BMS6CSDTC_raw32_maxval "" VALUE 0x0000 /* @ECU_Address@KOUTP_C3BMS6CSDTC_raw32_maxval@ */ Scalar_ULONG 0 SWC_OUTP_type_CM_uint32_raw32 0.0 4.294967295E+9 /end CHARACTERISTIC
/begin CHARACTERISTIC KOUTP_C3BMS6CSDTC_raw32_minval "" VALUE 0x0000 /* @ECU_Address@KOUTP_C3BMS6CSDTC_raw32_minval@ */ Scalar_ULONG 0 SWC_OUTP_type_CM_uint32_raw32 0.0 4.294967295E+9 /end CHARACTERISTIC
/begin CHARACTERISTIC KOUTP_C3BMS6CSDTC_raw32_ovrdval "" VALUE 0x0000 /* @ECU_Address@KOUTP_C3BMS6CSDTC_raw32_ovrdval@ */ Scalar_ULONG 0 SWC_OUTP_type_CM_uint32_raw32 0.0 4.294967295E+9 /end CHARACTERISTIC
/begin CHARACTERISTIC KOUTP_C3BMS6LCDTC_raw32_maxval "" VALUE 0x0000 /* @ECU_Address@KOUTP_C3BMS6LCDTC_raw32_maxval@ */ Scalar_ULONG 0 SWC_OUTP_type_CM_uint32_raw32 0.0 4.294967295E+9 /end CHARACTERISTIC
/begin CHARACTERISTIC KOUTP_C3BMS6LCDTC_raw32_minval "" VALUE 0x0000 /* @ECU_Address@KOUTP_C3BMS6LCDTC_raw32_minval@ */ Scalar_ULONG 0 SWC_OUTP_type_CM_uint32_raw32 0.0 4.294967295E+9 /end CHARACTERISTIC
/begin CHARACTERISTIC KOUTP_C3BMS6LCDTC_raw32_ovrdval "" VALUE 0x0000 /* @ECU_Address@KOUTP_C3BMS6LCDTC_raw32_ovrdval@ */ Scalar_ULONG 0 SWC_OUTP_type_CM_uint32_raw32 0.0 4.294967295E+9 /end CHARACTERISTIC
/begin CHARACTERISTIC KOUTP_C3BMS6RCDTC_raw32_maxval "" VALUE 0x0000 /* @ECU_Address@KOUTP_C3BMS6RCDTC_raw32_maxval@ */ Scalar_ULONG 0 SWC_OUTP_type_CM_uint32_raw32 0.0 4.294967295E+9 /end CHARACTERISTIC
/begin CHARACTERISTIC KOUTP_C3BMS6RCDTC_raw32_minval "" VALUE 0x0000 /* @ECU_Address@KOUTP_C3BMS6RCDTC_raw32_minval@ */ Scalar_ULONG 0 SWC_OUTP_type_CM_uint32_raw32 0.0 4.294967295E+9 /end CHARACTERISTIC
/begin CHARACTERISTIC KOUTP_C3BMS6RCDTC_raw32_ovrdval "" VALUE 0x0000 /* @ECU_Address@KOUTP_C3BMS6RCDTC_raw32_ovrdval@ */ Scalar_ULONG 0 SWC_OUTP_type_CM_uint32_raw32 0.0 4.294967295E+9 /end CHARACTERISTIC
/begin CHARACTERISTIC KOUTP_C3CCU1CSDTC_raw32_maxval "" VALUE 0x0000 /* @ECU_Address@KOUTP_C3CCU1CSDTC_raw32_maxval@ */ Scalar_ULONG 0 SWC_OUTP_type_CM_uint32_raw32 0.0 4.294967295E+9 /end CHARACTERISTIC
/begin CHARACTERISTIC KOUTP_C3CCU1CSDTC_raw32_minval "" VALUE 0x0000 /* @ECU_Address@KOUTP_C3CCU1CSDTC_raw32_minval@ */ Scalar_ULONG 0 SWC_OUTP_type_CM_uint32_raw32 0.0 4.294967295E+9 /end CHARACTERISTIC
/begin CHARACTERISTIC KOUTP_C3CCU1CSDTC_raw32_ovrdval "" VALUE 0x0000 /* @ECU_Address@KOUTP_C3CCU1CSDTC_raw32_ovrdval@ */ Scalar_ULONG 0 SWC_OUTP_type_CM_uint32_raw32 0.0 4.294967295E+9 /end CHARACTERISTIC
/begin CHARACTERISTIC KOUTP_C3CCU1LCDTC_raw32_maxval "" VALUE 0x0000 /* @ECU_Address@KOUTP_C3CCU1LCDTC_raw32_maxval@ */ Scalar_ULONG 0 SWC_OUTP_type_CM_uint32_raw32 0.0 4.294967295E+9 /end CHARACTERISTIC
/begin CHARACTERISTIC KOUTP_C3CCU1LCDTC_raw32_minval "" VALUE 0x0000 /* @ECU_Address@KOUTP_C3CCU1LCDTC_raw32_minval@ */ Scalar_ULONG 0 SWC_OUTP_type_CM_uint32_raw32 0.0 4.294967295E+9 /end CHARACTERISTIC
/begin CHARACTERISTIC KOUTP_C3CCU1LCDTC_raw32_ovrdval "" VALUE 0x0000 /* @ECU_Address@KOUTP_C3CCU1LCDTC_raw32_ovrdval@ */ Scalar_ULONG 0 SWC_OUTP_type_CM_uint32_raw32 0.0 4.294967295E+9 /end CHARACTERISTIC
/begin CHARACTERISTIC KOUTP_C3CCU1RCDTC_raw32_maxval "" VALUE 0x0000 /* @ECU_Address@KOUTP_C3CCU1RCDTC_raw32_maxval@ */ Scalar_ULONG 0 SWC_OUTP_type_CM_uint32_raw32 0.0 4.294967295E+9 /end CHARACTERISTIC
/begin CHARACTERISTIC KOUTP_C3CCU1RCDTC_raw32_minval "" VALUE 0x0000 /* @ECU_Address@KOUTP_C3CCU1RCDTC_raw32_minval@ */ Scalar_ULONG 0 SWC_OUTP_type_CM_uint32_raw32 0.0 4.294967295E+9 /end CHARACTERISTIC
/begin CHARACTERISTIC KOUTP_C3CCU1RCDTC_raw32_ovrdval "" VALUE 0x0000 /* @ECU_Address@KOUTP_C3CCU1RCDTC_raw32_ovrdval@ */ Scalar_ULONG 0 SWC_OUTP_type_CM_uint32_raw32 0.0 4.294967295E+9 /end CHARACTERISTIC
/begin CHARACTERISTIC KOUTP_C3CCU2CSDTC_raw32_maxval "" VALUE 0x0000 /* @ECU_Address@KOUTP_C3CCU2CSDTC_raw32_maxval@ */ Scalar_ULONG 0 SWC_OUTP_type_CM_uint32_raw32 0.0 4.294967295E+9 /end CHARACTERISTIC
/begin CHARACTERISTIC KOUTP_C3CCU2CSDTC_raw32_minval "" VALUE 0x0000 /* @ECU_Address@KOUTP_C3CCU2CSDTC_raw32_minval@ */ Scalar_ULONG 0 SWC_OUTP_type_CM_uint32_raw32 0.0 4.294967295E+9 /end CHARACTERISTIC
/begin CHARACTERISTIC KOUTP_C3CCU2CSDTC_raw32_ovrdval "" VALUE 0x0000 /* @ECU_Address@KOUTP_C3CCU2CSDTC_raw32_ovrdval@ */ Scalar_ULONG 0 SWC_OUTP_type_CM_uint32_raw32 0.0 4.294967295E+9 /end CHARACTERISTIC
/begin CHARACTERISTIC KOUTP_C3CCU2LCDTC_raw32_maxval "" VALUE 0x0000 /* @ECU_Address@KOUTP_C3CCU2LCDTC_raw32_maxval@ */ Scalar_ULONG 0 SWC_OUTP_type_CM_uint32_raw32 0.0 4.294967295E+9 /end CHARACTERISTIC
/begin CHARACTERISTIC KOUTP_C3CCU2LCDTC_raw32_minval "" VALUE 0x0000 /* @ECU_Address@KOUTP_C3CCU2LCDTC_raw32_minval@ */ Scalar_ULONG 0 SWC_OUTP_type_CM_uint32_raw32 0.0 4.294967295E+9 /end CHARACTERISTIC
/begin CHARACTERISTIC KOUTP_C3CCU2LCDTC_raw32_ovrdval "" VALUE 0x0000 /* @ECU_Address@KOUTP_C3CCU2LCDTC_raw32_ovrdval@ */ Scalar_ULONG 0 SWC_OUTP_type_CM_uint32_raw32 0.0 4.294967295E+9 /end CHARACTERISTIC
/begin CHARACTERISTIC KOUTP_C3CCU2RCDTC_raw32_maxval "" VALUE 0x0000 /* @ECU_Address@KOUTP_C3CCU2RCDTC_raw32_maxval@ */ Scalar_ULONG 0 SWC_OUTP_type_CM_uint32_raw32 0.0 4.294967295E+9 /end CHARACTERISTIC
/begin CHARACTERISTIC KOUTP_C3CCU2RCDTC_raw32_minval "" VALUE 0x0000 /* @ECU_Address@KOUTP_C3CCU2RCDTC_raw32_minval@ */ Scalar_ULONG 0 SWC_OUTP_type_CM_uint32_raw32 0.0 4.294967295E+9 /end CHARACTERISTIC
/begin CHARACTERISTIC KOUTP_C3CCU2RCDTC_raw32_ovrdval "" VALUE 0x0000 /* @ECU_Address@KOUTP_C3CCU2RCDTC_raw32_ovrdval@ */ Scalar_ULONG 0 SWC_OUTP_type_CM_uint32_raw32 0.0 4.294967295E+9 /end CHARACTERISTIC
/begin CHARACTERISTIC KOUTP_CCMalfuncDetDTC_raw32_maxval "" VALUE 0x0000 /* @ECU_Address@KOUTP_CCMalfuncDetDTC_raw32_maxval@ */ Scalar_ULONG 0 SWC_OUTP_type_CM_uint32_raw32 0.0 4.294967295E+9 /end CHARACTERISTIC
/begin CHARACTERISTIC KOUTP_CCMalfuncDetDTC_raw32_minval "" VALUE 0x0000 /* @ECU_Address@KOUTP_CCMalfuncDetDTC_raw32_minval@ */ Scalar_ULONG 0 SWC_OUTP_type_CM_uint32_raw32 0.0 4.294967295E+9 /end CHARACTERISTIC
/begin CHARACTERISTIC KOUTP_CCMalfuncDetDTC_raw32_ovrdval "" VALUE 0x0000 /* @ECU_Address@KOUTP_CCMalfuncDetDTC_raw32_ovrdval@ */ Scalar_ULONG 0 SWC_OUTP_type_CM_uint32_raw32 0.0 4.294967295E+9 /end CHARACTERISTIC
/begin CHARACTERISTIC KOUTP_CCUSigErrDetDTC_raw32_maxval "" VALUE 0x0000 /* @ECU_Address@KOUTP_CCUSigErrDetDTC_raw32_maxval@ */ Scalar_ULONG 0 SWC_OUTP_type_CM_uint32_raw32 0.0 4.294967295E+9 /end CHARACTERISTIC
/begin CHARACTERISTIC KOUTP_CCUSigErrDetDTC_raw32_minval "" VALUE 0x0000 /* @ECU_Address@KOUTP_CCUSigErrDetDTC_raw32_minval@ */ Scalar_ULONG 0 SWC_OUTP_type_CM_uint32_raw32 0.0 4.294967295E+9 /end CHARACTERISTIC
/begin CHARACTERISTIC KOUTP_CCUSigErrDetDTC_raw32_ovrdval "" VALUE 0x0000 /* @ECU_Address@KOUTP_CCUSigErrDetDTC_raw32_ovrdval@ */ Scalar_ULONG 0 SWC_OUTP_type_CM_uint32_raw32 0.0 4.294967295E+9 /end CHARACTERISTIC
/begin CHARACTERISTIC KOUTP_DCDC4PreDTC_raw32_maxval "" VALUE 0x0000 /* @ECU_Address@KOUTP_DCDC4PreDTC_raw32_maxval@ */ Scalar_ULONG 0 SWC_OUTP_type_CM_uint32_raw32 0.0 4.294967295E+9 /end CHARACTERISTIC
/begin CHARACTERISTIC KOUTP_DCDC4PreDTC_raw32_minval "" VALUE 0x0000 /* @ECU_Address@KOUTP_DCDC4PreDTC_raw32_minval@ */ Scalar_ULONG 0 SWC_OUTP_type_CM_uint32_raw32 0.0 4.294967295E+9 /end CHARACTERISTIC
/begin CHARACTERISTIC KOUTP_DCDC4PreDTC_raw32_ovrdval "" VALUE 0x0000 /* @ECU_Address@KOUTP_DCDC4PreDTC_raw32_ovrdval@ */ Scalar_ULONG 0 SWC_OUTP_type_CM_uint32_raw32 0.0 4.294967295E+9 /end CHARACTERISTIC
/begin CHARACTERISTIC KOUTP_DCDCDisDTC_raw32_maxval "" VALUE 0x0000 /* @ECU_Address@KOUTP_DCDCDisDTC_raw32_maxval@ */ Scalar_ULONG 0 SWC_OUTP_type_CM_uint32_raw32 0.0 4.294967295E+9 /end CHARACTERISTIC
/begin CHARACTERISTIC KOUTP_DCDCDisDTC_raw32_minval "" VALUE 0x0000 /* @ECU_Address@KOUTP_DCDCDisDTC_raw32_minval@ */ Scalar_ULONG 0 SWC_OUTP_type_CM_uint32_raw32 0.0 4.294967295E+9 /end CHARACTERISTIC
/begin CHARACTERISTIC KOUTP_DCDCDisDTC_raw32_ovrdval "" VALUE 0x0000 /* @ECU_Address@KOUTP_DCDCDisDTC_raw32_ovrdval@ */ Scalar_ULONG 0 SWC_OUTP_type_CM_uint32_raw32 0.0 4.294967295E+9 /end CHARACTERISTIC
/begin CHARACTERISTIC KOUTP_DCDCEnaDTC_raw32_maxval "" VALUE 0x0000 /* @ECU_Address@KOUTP_DCDCEnaDTC_raw32_maxval@ */ Scalar_ULONG 0 SWC_OUTP_type_CM_uint32_raw32 0.0 4.294967295E+9 /end CHARACTERISTIC
/begin CHARACTERISTIC KOUTP_DCDCEnaDTC_raw32_minval "" VALUE 0x0000 /* @ECU_Address@KOUTP_DCDCEnaDTC_raw32_minval@ */ Scalar_ULONG 0 SWC_OUTP_type_CM_uint32_raw32 0.0 4.294967295E+9 /end CHARACTERISTIC
/begin CHARACTERISTIC KOUTP_DCDCEnaDTC_raw32_ovrdval "" VALUE 0x0000 /* @ECU_Address@KOUTP_DCDCEnaDTC_raw32_ovrdval@ */ Scalar_ULONG 0 SWC_OUTP_type_CM_uint32_raw32 0.0 4.294967295E+9 /end CHARACTERISTIC
/begin CHARACTERISTIC KOUTP_DiagFLTSDTC_raw32_maxval "" VALUE 0x0000 /* @ECU_Address@KOUTP_DiagFLTSDTC_raw32_maxval@ */ Scalar_ULONG 0 SWC_OUTP_type_CM_uint32_raw32 0.0 4.294967295E+9 /end CHARACTERISTIC
/begin CHARACTERISTIC KOUTP_DiagFLTSDTC_raw32_minval "" VALUE 0x0000 /* @ECU_Address@KOUTP_DiagFLTSDTC_raw32_minval@ */ Scalar_ULONG 0 SWC_OUTP_type_CM_uint32_raw32 0.0 4.294967295E+9 /end CHARACTERISTIC
/begin CHARACTERISTIC KOUTP_DiagFLTSDTC_raw32_ovrdval "" VALUE 0x0000 /* @ECU_Address@KOUTP_DiagFLTSDTC_raw32_ovrdval@ */ Scalar_ULONG 0 SWC_OUTP_type_CM_uint32_raw32 0.0 4.294967295E+9 /end CHARACTERISTIC
/begin CHARACTERISTIC KOUTP_DiagFRTSDTC_raw32_maxval "" VALUE 0x0000 /* @ECU_Address@KOUTP_DiagFRTSDTC_raw32_maxval@ */ Scalar_ULONG 0 SWC_OUTP_type_CM_uint32_raw32 0.0 4.294967295E+9 /end CHARACTERISTIC
/begin CHARACTERISTIC KOUTP_DiagFRTSDTC_raw32_minval "" VALUE 0x0000 /* @ECU_Address@KOUTP_DiagFRTSDTC_raw32_minval@ */ Scalar_ULONG 0 SWC_OUTP_type_CM_uint32_raw32 0.0 4.294967295E+9 /end CHARACTERISTIC
/begin CHARACTERISTIC KOUTP_DiagFRTSDTC_raw32_ovrdval "" VALUE 0x0000 /* @ECU_Address@KOUTP_DiagFRTSDTC_raw32_ovrdval@ */ Scalar_ULONG 0 SWC_OUTP_type_CM_uint32_raw32 0.0 4.294967295E+9 /end CHARACTERISTIC
/begin CHARACTERISTIC KOUTP_DiagHCrashDTC_raw32_maxval "" VALUE 0x0000 /* @ECU_Address@KOUTP_DiagHCrashDTC_raw32_maxval@ */ Scalar_ULONG 0 SWC_OUTP_type_CM_uint32_raw32 0.0 4.294967295E+9 /end CHARACTERISTIC
/begin CHARACTERISTIC KOUTP_DiagHCrashDTC_raw32_minval "" VALUE 0x0000 /* @ECU_Address@KOUTP_DiagHCrashDTC_raw32_minval@ */ Scalar_ULONG 0 SWC_OUTP_type_CM_uint32_raw32 0.0 4.294967295E+9 /end CHARACTERISTIC
/begin CHARACTERISTIC KOUTP_DiagHCrashDTC_raw32_ovrdval "" VALUE 0x0000 /* @ECU_Address@KOUTP_DiagHCrashDTC_raw32_ovrdval@ */ Scalar_ULONG 0 SWC_OUTP_type_CM_uint32_raw32 0.0 4.294967295E+9 /end CHARACTERISTIC
/begin CHARACTERISTIC KOUTP_DiagRLTSDTC_raw32_maxval "" VALUE 0x0000 /* @ECU_Address@KOUTP_DiagRLTSDTC_raw32_maxval@ */ Scalar_ULONG 0 SWC_OUTP_type_CM_uint32_raw32 0.0 4.294967295E+9 /end CHARACTERISTIC
/begin CHARACTERISTIC KOUTP_DiagRLTSDTC_raw32_minval "" VALUE 0x0000 /* @ECU_Address@KOUTP_DiagRLTSDTC_raw32_minval@ */ Scalar_ULONG 0 SWC_OUTP_type_CM_uint32_raw32 0.0 4.294967295E+9 /end CHARACTERISTIC
/begin CHARACTERISTIC KOUTP_DiagRLTSDTC_raw32_ovrdval "" VALUE 0x0000 /* @ECU_Address@KOUTP_DiagRLTSDTC_raw32_ovrdval@ */ Scalar_ULONG 0 SWC_OUTP_type_CM_uint32_raw32 0.0 4.294967295E+9 /end CHARACTERISTIC
/begin CHARACTERISTIC KOUTP_DiagRRTSDTC_raw32_maxval "" VALUE 0x0000 /* @ECU_Address@KOUTP_DiagRRTSDTC_raw32_maxval@ */ Scalar_ULONG 0 SWC_OUTP_type_CM_uint32_raw32 0.0 4.294967295E+9 /end CHARACTERISTIC
/begin CHARACTERISTIC KOUTP_DiagRRTSDTC_raw32_minval "" VALUE 0x0000 /* @ECU_Address@KOUTP_DiagRRTSDTC_raw32_minval@ */ Scalar_ULONG 0 SWC_OUTP_type_CM_uint32_raw32 0.0 4.294967295E+9 /end CHARACTERISTIC
/begin CHARACTERISTIC KOUTP_DiagRRTSDTC_raw32_ovrdval "" VALUE 0x0000 /* @ECU_Address@KOUTP_DiagRRTSDTC_raw32_ovrdval@ */ Scalar_ULONG 0 SWC_OUTP_type_CM_uint32_raw32 0.0 4.294967295E+9 /end CHARACTERISTIC
/begin CHARACTERISTIC KOUTP_DrStSWDTC_raw32_maxval "" VALUE 0x0000 /* @ECU_Address@KOUTP_DrStSWDTC_raw32_maxval@ */ Scalar_ULONG 0 SWC_OUTP_type_CM_uint32_raw32 0.0 4.294967295E+9 /end CHARACTERISTIC
/begin CHARACTERISTIC KOUTP_DrStSWDTC_raw32_minval "" VALUE 0x0000 /* @ECU_Address@KOUTP_DrStSWDTC_raw32_minval@ */ Scalar_ULONG 0 SWC_OUTP_type_CM_uint32_raw32 0.0 4.294967295E+9 /end CHARACTERISTIC
/begin CHARACTERISTIC KOUTP_DrStSWDTC_raw32_ovrdval "" VALUE 0x0000 /* @ECU_Address@KOUTP_DrStSWDTC_raw32_ovrdval@ */ Scalar_ULONG 0 SWC_OUTP_type_CM_uint32_raw32 0.0 4.294967295E+9 /end CHARACTERISTIC
/begin CHARACTERISTIC KOUTP_EPBLockTODTC_raw32_maxval "" VALUE 0x0000 /* @ECU_Address@KOUTP_EPBLockTODTC_raw32_maxval@ */ Scalar_ULONG 0 SWC_OUTP_type_CM_uint32_raw32 0.0 4.294967295E+9 /end CHARACTERISTIC
/begin CHARACTERISTIC KOUTP_EPBLockTODTC_raw32_minval "" VALUE 0x0000 /* @ECU_Address@KOUTP_EPBLockTODTC_raw32_minval@ */ Scalar_ULONG 0 SWC_OUTP_type_CM_uint32_raw32 0.0 4.294967295E+9 /end CHARACTERISTIC
/begin CHARACTERISTIC KOUTP_EPBLockTODTC_raw32_ovrdval "" VALUE 0x0000 /* @ECU_Address@KOUTP_EPBLockTODTC_raw32_ovrdval@ */ Scalar_ULONG 0 SWC_OUTP_type_CM_uint32_raw32 0.0 4.294967295E+9 /end CHARACTERISTIC
/begin CHARACTERISTIC KOUTP_EPBUnlockTODTC_raw32_maxval "" VALUE 0x0000 /* @ECU_Address@KOUTP_EPBUnlockTODTC_raw32_maxval@ */ Scalar_ULONG 0 SWC_OUTP_type_CM_uint32_raw32 0.0 4.294967295E+9 /end CHARACTERISTIC
/begin CHARACTERISTIC KOUTP_EPBUnlockTODTC_raw32_minval "" VALUE 0x0000 /* @ECU_Address@KOUTP_EPBUnlockTODTC_raw32_minval@ */ Scalar_ULONG 0 SWC_OUTP_type_CM_uint32_raw32 0.0 4.294967295E+9 /end CHARACTERISTIC
/begin CHARACTERISTIC KOUTP_EPBUnlockTODTC_raw32_ovrdval "" VALUE 0x0000 /* @ECU_Address@KOUTP_EPBUnlockTODTC_raw32_ovrdval@ */ Scalar_ULONG 0 SWC_OUTP_type_CM_uint32_raw32 0.0 4.294967295E+9 /end CHARACTERISTIC
/begin CHARACTERISTIC KOUTP_ESC1CSErrDTC_raw32_maxval "" VALUE 0x0000 /* @ECU_Address@KOUTP_ESC1CSErrDTC_raw32_maxval@ */ Scalar_ULONG 0 SWC_OUTP_type_CM_uint32_raw32 0.0 4.294967295E+9 /end CHARACTERISTIC
/begin CHARACTERISTIC KOUTP_ESC1CSErrDTC_raw32_minval "" VALUE 0x0000 /* @ECU_Address@KOUTP_ESC1CSErrDTC_raw32_minval@ */ Scalar_ULONG 0 SWC_OUTP_type_CM_uint32_raw32 0.0 4.294967295E+9 /end CHARACTERISTIC
/begin CHARACTERISTIC KOUTP_ESC1CSErrDTC_raw32_ovrdval "" VALUE 0x0000 /* @ECU_Address@KOUTP_ESC1CSErrDTC_raw32_ovrdval@ */ Scalar_ULONG 0 SWC_OUTP_type_CM_uint32_raw32 0.0 4.294967295E+9 /end CHARACTERISTIC
/begin CHARACTERISTIC KOUTP_ESC1NoComDTC_raw32_maxval "" VALUE 0x0000 /* @ECU_Address@KOUTP_ESC1NoComDTC_raw32_maxval@ */ Scalar_ULONG 0 SWC_OUTP_type_CM_uint32_raw32 0.0 4.294967295E+9 /end CHARACTERISTIC
/begin CHARACTERISTIC KOUTP_ESC1NoComDTC_raw32_minval "" VALUE 0x0000 /* @ECU_Address@KOUTP_ESC1NoComDTC_raw32_minval@ */ Scalar_ULONG 0 SWC_OUTP_type_CM_uint32_raw32 0.0 4.294967295E+9 /end CHARACTERISTIC
/begin CHARACTERISTIC KOUTP_ESC1NoComDTC_raw32_ovrdval "" VALUE 0x0000 /* @ECU_Address@KOUTP_ESC1NoComDTC_raw32_ovrdval@ */ Scalar_ULONG 0 SWC_OUTP_type_CM_uint32_raw32 0.0 4.294967295E+9 /end CHARACTERISTIC
/begin CHARACTERISTIC KOUTP_ESC1RCErrDTC_raw32_maxval "" VALUE 0x0000 /* @ECU_Address@KOUTP_ESC1RCErrDTC_raw32_maxval@ */ Scalar_ULONG 0 SWC_OUTP_type_CM_uint32_raw32 0.0 4.294967295E+9 /end CHARACTERISTIC
/begin CHARACTERISTIC KOUTP_ESC1RCErrDTC_raw32_minval "" VALUE 0x0000 /* @ECU_Address@KOUTP_ESC1RCErrDTC_raw32_minval@ */ Scalar_ULONG 0 SWC_OUTP_type_CM_uint32_raw32 0.0 4.294967295E+9 /end CHARACTERISTIC
/begin CHARACTERISTIC KOUTP_ESC1RCErrDTC_raw32_ovrdval "" VALUE 0x0000 /* @ECU_Address@KOUTP_ESC1RCErrDTC_raw32_ovrdval@ */ Scalar_ULONG 0 SWC_OUTP_type_CM_uint32_raw32 0.0 4.294967295E+9 /end CHARACTERISTIC
/begin CHARACTERISTIC KOUTP_ESC5CSErrDTC_raw32_maxval "" VALUE 0x0000 /* @ECU_Address@KOUTP_ESC5CSErrDTC_raw32_maxval@ */ Scalar_ULONG 0 SWC_OUTP_type_CM_uint32_raw32 0.0 4.294967295E+9 /end CHARACTERISTIC
/begin CHARACTERISTIC KOUTP_ESC5CSErrDTC_raw32_minval "" VALUE 0x0000 /* @ECU_Address@KOUTP_ESC5CSErrDTC_raw32_minval@ */ Scalar_ULONG 0 SWC_OUTP_type_CM_uint32_raw32 0.0 4.294967295E+9 /end CHARACTERISTIC
/begin CHARACTERISTIC KOUTP_ESC5CSErrDTC_raw32_ovrdval "" VALUE 0x0000 /* @ECU_Address@KOUTP_ESC5CSErrDTC_raw32_ovrdval@ */ Scalar_ULONG 0 SWC_OUTP_type_CM_uint32_raw32 0.0 4.294967295E+9 /end CHARACTERISTIC
/begin CHARACTERISTIC KOUTP_ESC5NoComDTC_raw32_maxval "" VALUE 0x0000 /* @ECU_Address@KOUTP_ESC5NoComDTC_raw32_maxval@ */ Scalar_ULONG 0 SWC_OUTP_type_CM_uint32_raw32 0.0 4.294967295E+9 /end CHARACTERISTIC
/begin CHARACTERISTIC KOUTP_ESC5NoComDTC_raw32_minval "" VALUE 0x0000 /* @ECU_Address@KOUTP_ESC5NoComDTC_raw32_minval@ */ Scalar_ULONG 0 SWC_OUTP_type_CM_uint32_raw32 0.0 4.294967295E+9 /end CHARACTERISTIC
/begin CHARACTERISTIC KOUTP_ESC5NoComDTC_raw32_ovrdval "" VALUE 0x0000 /* @ECU_Address@KOUTP_ESC5NoComDTC_raw32_ovrdval@ */ Scalar_ULONG 0 SWC_OUTP_type_CM_uint32_raw32 0.0 4.294967295E+9 /end CHARACTERISTIC
/begin CHARACTERISTIC KOUTP_ESC5RCErrDTC_raw32_maxval "" VALUE 0x0000 /* @ECU_Address@KOUTP_ESC5RCErrDTC_raw32_maxval@ */ Scalar_ULONG 0 SWC_OUTP_type_CM_uint32_raw32 0.0 4.294967295E+9 /end CHARACTERISTIC
/begin CHARACTERISTIC KOUTP_ESC5RCErrDTC_raw32_minval "" VALUE 0x0000 /* @ECU_Address@KOUTP_ESC5RCErrDTC_raw32_minval@ */ Scalar_ULONG 0 SWC_OUTP_type_CM_uint32_raw32 0.0 4.294967295E+9 /end CHARACTERISTIC
/begin CHARACTERISTIC KOUTP_ESC5RCErrDTC_raw32_ovrdval "" VALUE 0x0000 /* @ECU_Address@KOUTP_ESC5RCErrDTC_raw32_ovrdval@ */ Scalar_ULONG 0 SWC_OUTP_type_CM_uint32_raw32 0.0 4.294967295E+9 /end CHARACTERISTIC
/begin CHARACTERISTIC KOUTP_ESC7CSErrDTC_raw32_maxval "" VALUE 0x0000 /* @ECU_Address@KOUTP_ESC7CSErrDTC_raw32_maxval@ */ Scalar_ULONG 0 SWC_OUTP_type_CM_uint32_raw32 0.0 4.294967295E+9 /end CHARACTERISTIC
/begin CHARACTERISTIC KOUTP_ESC7CSErrDTC_raw32_minval "" VALUE 0x0000 /* @ECU_Address@KOUTP_ESC7CSErrDTC_raw32_minval@ */ Scalar_ULONG 0 SWC_OUTP_type_CM_uint32_raw32 0.0 4.294967295E+9 /end CHARACTERISTIC
/begin CHARACTERISTIC KOUTP_ESC7CSErrDTC_raw32_ovrdval "" VALUE 0x0000 /* @ECU_Address@KOUTP_ESC7CSErrDTC_raw32_ovrdval@ */ Scalar_ULONG 0 SWC_OUTP_type_CM_uint32_raw32 0.0 4.294967295E+9 /end CHARACTERISTIC
/begin CHARACTERISTIC KOUTP_ESC7NoComDTC_raw32_maxval "" VALUE 0x0000 /* @ECU_Address@KOUTP_ESC7NoComDTC_raw32_maxval@ */ Scalar_ULONG 0 SWC_OUTP_type_CM_uint32_raw32 0.0 4.294967295E+9 /end CHARACTERISTIC
/begin CHARACTERISTIC KOUTP_ESC7NoComDTC_raw32_minval "" VALUE 0x0000 /* @ECU_Address@KOUTP_ESC7NoComDTC_raw32_minval@ */ Scalar_ULONG 0 SWC_OUTP_type_CM_uint32_raw32 0.0 4.294967295E+9 /end CHARACTERISTIC
/begin CHARACTERISTIC KOUTP_ESC7NoComDTC_raw32_ovrdval "" VALUE 0x0000 /* @ECU_Address@KOUTP_ESC7NoComDTC_raw32_ovrdval@ */ Scalar_ULONG 0 SWC_OUTP_type_CM_uint32_raw32 0.0 4.294967295E+9 /end CHARACTERISTIC
/begin CHARACTERISTIC KOUTP_ESC7RCErrDTC_raw32_maxval "" VALUE 0x0000 /* @ECU_Address@KOUTP_ESC7RCErrDTC_raw32_maxval@ */ Scalar_ULONG 0 SWC_OUTP_type_CM_uint32_raw32 0.0 4.294967295E+9 /end CHARACTERISTIC
/begin CHARACTERISTIC KOUTP_ESC7RCErrDTC_raw32_minval "" VALUE 0x0000 /* @ECU_Address@KOUTP_ESC7RCErrDTC_raw32_minval@ */ Scalar_ULONG 0 SWC_OUTP_type_CM_uint32_raw32 0.0 4.294967295E+9 /end CHARACTERISTIC
/begin CHARACTERISTIC KOUTP_ESC7RCErrDTC_raw32_ovrdval "" VALUE 0x0000 /* @ECU_Address@KOUTP_ESC7RCErrDTC_raw32_ovrdval@ */ Scalar_ULONG 0 SWC_OUTP_type_CM_uint32_raw32 0.0 4.294967295E+9 /end CHARACTERISTIC
/begin CHARACTERISTIC KOUTP_FCLUSSDTC_raw32_maxval "" VALUE 0x0000 /* @ECU_Address@KOUTP_FCLUSSDTC_raw32_maxval@ */ Scalar_ULONG 0 SWC_OUTP_type_CM_uint32_raw32 0.0 4.294967295E+9 /end CHARACTERISTIC
/begin CHARACTERISTIC KOUTP_FCLUSSDTC_raw32_minval "" VALUE 0x0000 /* @ECU_Address@KOUTP_FCLUSSDTC_raw32_minval@ */ Scalar_ULONG 0 SWC_OUTP_type_CM_uint32_raw32 0.0 4.294967295E+9 /end CHARACTERISTIC
/begin CHARACTERISTIC KOUTP_FCLUSSDTC_raw32_ovrdval "" VALUE 0x0000 /* @ECU_Address@KOUTP_FCLUSSDTC_raw32_ovrdval@ */ Scalar_ULONG 0 SWC_OUTP_type_CM_uint32_raw32 0.0 4.294967295E+9 /end CHARACTERISTIC
/begin CHARACTERISTIC KOUTP_FCM2CSErrDTC_raw32_maxval "" VALUE 0x0000 /* @ECU_Address@KOUTP_FCM2CSErrDTC_raw32_maxval@ */ Scalar_ULONG 0 SWC_OUTP_type_CM_uint32_raw32 0.0 4.294967295E+9 /end CHARACTERISTIC
/begin CHARACTERISTIC KOUTP_FCM2CSErrDTC_raw32_minval "" VALUE 0x0000 /* @ECU_Address@KOUTP_FCM2CSErrDTC_raw32_minval@ */ Scalar_ULONG 0 SWC_OUTP_type_CM_uint32_raw32 0.0 4.294967295E+9 /end CHARACTERISTIC
/begin CHARACTERISTIC KOUTP_FCM2CSErrDTC_raw32_ovrdval "" VALUE 0x0000 /* @ECU_Address@KOUTP_FCM2CSErrDTC_raw32_ovrdval@ */ Scalar_ULONG 0 SWC_OUTP_type_CM_uint32_raw32 0.0 4.294967295E+9 /end CHARACTERISTIC
/begin CHARACTERISTIC KOUTP_FCM2NoComDTC_raw32_maxval "" VALUE 0x0000 /* @ECU_Address@KOUTP_FCM2NoComDTC_raw32_maxval@ */ Scalar_ULONG 0 SWC_OUTP_type_CM_uint32_raw32 0.0 4.294967295E+9 /end CHARACTERISTIC
/begin CHARACTERISTIC KOUTP_FCM2NoComDTC_raw32_minval "" VALUE 0x0000 /* @ECU_Address@KOUTP_FCM2NoComDTC_raw32_minval@ */ Scalar_ULONG 0 SWC_OUTP_type_CM_uint32_raw32 0.0 4.294967295E+9 /end CHARACTERISTIC
/begin CHARACTERISTIC KOUTP_FCM2NoComDTC_raw32_ovrdval "" VALUE 0x0000 /* @ECU_Address@KOUTP_FCM2NoComDTC_raw32_ovrdval@ */ Scalar_ULONG 0 SWC_OUTP_type_CM_uint32_raw32 0.0 4.294967295E+9 /end CHARACTERISTIC
/begin CHARACTERISTIC KOUTP_FCM2RCErrDTC_raw32_maxval "" VALUE 0x0000 /* @ECU_Address@KOUTP_FCM2RCErrDTC_raw32_maxval@ */ Scalar_ULONG 0 SWC_OUTP_type_CM_uint32_raw32 0.0 4.294967295E+9 /end CHARACTERISTIC
/begin CHARACTERISTIC KOUTP_FCM2RCErrDTC_raw32_minval "" VALUE 0x0000 /* @ECU_Address@KOUTP_FCM2RCErrDTC_raw32_minval@ */ Scalar_ULONG 0 SWC_OUTP_type_CM_uint32_raw32 0.0 4.294967295E+9 /end CHARACTERISTIC
/begin CHARACTERISTIC KOUTP_FCM2RCErrDTC_raw32_ovrdval "" VALUE 0x0000 /* @ECU_Address@KOUTP_FCM2RCErrDTC_raw32_ovrdval@ */ Scalar_ULONG 0 SWC_OUTP_type_CM_uint32_raw32 0.0 4.294967295E+9 /end CHARACTERISTIC
/begin CHARACTERISTIC KOUTP_FCM3CSErrDTC_raw32_maxval "" VALUE 0x0000 /* @ECU_Address@KOUTP_FCM3CSErrDTC_raw32_maxval@ */ Scalar_ULONG 0 SWC_OUTP_type_CM_uint32_raw32 0.0 4.294967295E+9 /end CHARACTERISTIC
/begin CHARACTERISTIC KOUTP_FCM3CSErrDTC_raw32_minval "" VALUE 0x0000 /* @ECU_Address@KOUTP_FCM3CSErrDTC_raw32_minval@ */ Scalar_ULONG 0 SWC_OUTP_type_CM_uint32_raw32 0.0 4.294967295E+9 /end CHARACTERISTIC
/begin CHARACTERISTIC KOUTP_FCM3CSErrDTC_raw32_ovrdval "" VALUE 0x0000 /* @ECU_Address@KOUTP_FCM3CSErrDTC_raw32_ovrdval@ */ Scalar_ULONG 0 SWC_OUTP_type_CM_uint32_raw32 0.0 4.294967295E+9 /end CHARACTERISTIC
/begin CHARACTERISTIC KOUTP_FCM3NoComDTC_raw32_maxval "" VALUE 0x0000 /* @ECU_Address@KOUTP_FCM3NoComDTC_raw32_maxval@ */ Scalar_ULONG 0 SWC_OUTP_type_CM_uint32_raw32 0.0 4.294967295E+9 /end CHARACTERISTIC
/begin CHARACTERISTIC KOUTP_FCM3NoComDTC_raw32_minval "" VALUE 0x0000 /* @ECU_Address@KOUTP_FCM3NoComDTC_raw32_minval@ */ Scalar_ULONG 0 SWC_OUTP_type_CM_uint32_raw32 0.0 4.294967295E+9 /end CHARACTERISTIC
/begin CHARACTERISTIC KOUTP_FCM3NoComDTC_raw32_ovrdval "" VALUE 0x0000 /* @ECU_Address@KOUTP_FCM3NoComDTC_raw32_ovrdval@ */ Scalar_ULONG 0 SWC_OUTP_type_CM_uint32_raw32 0.0 4.294967295E+9 /end CHARACTERISTIC
/begin CHARACTERISTIC KOUTP_FCM3RCErrDTC_raw32_maxval "" VALUE 0x0000 /* @ECU_Address@KOUTP_FCM3RCErrDTC_raw32_maxval@ */ Scalar_ULONG 0 SWC_OUTP_type_CM_uint32_raw32 0.0 4.294967295E+9 /end CHARACTERISTIC
/begin CHARACTERISTIC KOUTP_FCM3RCErrDTC_raw32_minval "" VALUE 0x0000 /* @ECU_Address@KOUTP_FCM3RCErrDTC_raw32_minval@ */ Scalar_ULONG 0 SWC_OUTP_type_CM_uint32_raw32 0.0 4.294967295E+9 /end CHARACTERISTIC
/begin CHARACTERISTIC KOUTP_FCM3RCErrDTC_raw32_ovrdval "" VALUE 0x0000 /* @ECU_Address@KOUTP_FCM3RCErrDTC_raw32_ovrdval@ */ Scalar_ULONG 0 SWC_OUTP_type_CM_uint32_raw32 0.0 4.294967295E+9 /end CHARACTERISTIC
/begin CHARACTERISTIC KOUTP_FCM4CSErrDTC_raw32_maxval "" VALUE 0x0000 /* @ECU_Address@KOUTP_FCM4CSErrDTC_raw32_maxval@ */ Scalar_ULONG 0 SWC_OUTP_type_CM_uint32_raw32 0.0 4.294967295E+9 /end CHARACTERISTIC
/begin CHARACTERISTIC KOUTP_FCM4CSErrDTC_raw32_minval "" VALUE 0x0000 /* @ECU_Address@KOUTP_FCM4CSErrDTC_raw32_minval@ */ Scalar_ULONG 0 SWC_OUTP_type_CM_uint32_raw32 0.0 4.294967295E+9 /end CHARACTERISTIC
/begin CHARACTERISTIC KOUTP_FCM4CSErrDTC_raw32_ovrdval "" VALUE 0x0000 /* @ECU_Address@KOUTP_FCM4CSErrDTC_raw32_ovrdval@ */ Scalar_ULONG 0 SWC_OUTP_type_CM_uint32_raw32 0.0 4.294967295E+9 /end CHARACTERISTIC
/begin CHARACTERISTIC KOUTP_FCM4NoComDTC_raw32_maxval "" VALUE 0x0000 /* @ECU_Address@KOUTP_FCM4NoComDTC_raw32_maxval@ */ Scalar_ULONG 0 SWC_OUTP_type_CM_uint32_raw32 0.0 4.294967295E+9 /end CHARACTERISTIC
/begin CHARACTERISTIC KOUTP_FCM4NoComDTC_raw32_minval "" VALUE 0x0000 /* @ECU_Address@KOUTP_FCM4NoComDTC_raw32_minval@ */ Scalar_ULONG 0 SWC_OUTP_type_CM_uint32_raw32 0.0 4.294967295E+9 /end CHARACTERISTIC
/begin CHARACTERISTIC KOUTP_FCM4NoComDTC_raw32_ovrdval "" VALUE 0x0000 /* @ECU_Address@KOUTP_FCM4NoComDTC_raw32_ovrdval@ */ Scalar_ULONG 0 SWC_OUTP_type_CM_uint32_raw32 0.0 4.294967295E+9 /end CHARACTERISTIC
/begin CHARACTERISTIC KOUTP_FCM5CSErrDTC_raw32_maxval "" VALUE 0x0000 /* @ECU_Address@KOUTP_FCM5CSErrDTC_raw32_maxval@ */ Scalar_ULONG 0 SWC_OUTP_type_CM_uint32_raw32 0.0 4.294967295E+9 /end CHARACTERISTIC
/begin CHARACTERISTIC KOUTP_FCM5CSErrDTC_raw32_minval "" VALUE 0x0000 /* @ECU_Address@KOUTP_FCM5CSErrDTC_raw32_minval@ */ Scalar_ULONG 0 SWC_OUTP_type_CM_uint32_raw32 0.0 4.294967295E+9 /end CHARACTERISTIC
/begin CHARACTERISTIC KOUTP_FCM5CSErrDTC_raw32_ovrdval "" VALUE 0x0000 /* @ECU_Address@KOUTP_FCM5CSErrDTC_raw32_ovrdval@ */ Scalar_ULONG 0 SWC_OUTP_type_CM_uint32_raw32 0.0 4.294967295E+9 /end CHARACTERISTIC
/begin CHARACTERISTIC KOUTP_FCM5NoComDTC_raw32_maxval "" VALUE 0x0000 /* @ECU_Address@KOUTP_FCM5NoComDTC_raw32_maxval@ */ Scalar_ULONG 0 SWC_OUTP_type_CM_uint32_raw32 0.0 4.294967295E+9 /end CHARACTERISTIC
/begin CHARACTERISTIC KOUTP_FCM5NoComDTC_raw32_minval "" VALUE 0x0000 /* @ECU_Address@KOUTP_FCM5NoComDTC_raw32_minval@ */ Scalar_ULONG 0 SWC_OUTP_type_CM_uint32_raw32 0.0 4.294967295E+9 /end CHARACTERISTIC
/begin CHARACTERISTIC KOUTP_FCM5NoComDTC_raw32_ovrdval "" VALUE 0x0000 /* @ECU_Address@KOUTP_FCM5NoComDTC_raw32_ovrdval@ */ Scalar_ULONG 0 SWC_OUTP_type_CM_uint32_raw32 0.0 4.294967295E+9 /end CHARACTERISTIC
/begin CHARACTERISTIC KOUTP_5vAPS1PwrErrDTC_raw32_ovrdflg "" VALUE 0x0000 /* @ECU_Address@KOUTP_5vAPS1PwrErrDTC_raw32_ovrdflg@ */ Scalar_BOOLEAN 0 SWC_OUTP_type_CM_boolean_flg 0.0 1.0 /end CHARACTERISTIC
/begin CHARACTERISTIC KOUTP_5vAPS2PwrErrDTC_raw32_ovrdflg "" VALUE 0x0000 /* @ECU_Address@KOUTP_5vAPS2PwrErrDTC_raw32_ovrdflg@ */ Scalar_BOOLEAN 0 SWC_OUTP_type_CM_boolean_flg 0.0 1.0 /end CHARACTERISTIC
/begin CHARACTERISTIC KOUTP_ACCAccelCmdErrDetDTC_raw32_ovrdflg "" VALUE 0x0000 /* @ECU_Address@KOUTP_ACCAccelCmdErrDetDTC_raw32_ovrdflg@ */ Scalar_BOOLEAN 0 SWC_OUTP_type_CM_boolean_flg 0.0 1.0 /end CHARACTERISTIC
/begin CHARACTERISTIC KOUTP_ACCMalfuncDetDTC_raw32_ovrdflg "" VALUE 0x0000 /* @ECU_Address@KOUTP_ACCMalfuncDetDTC_raw32_ovrdflg@ */ Scalar_BOOLEAN 0 SWC_OUTP_type_CM_boolean_flg 0.0 1.0 /end CHARACTERISTIC
/begin CHARACTERISTIC KOUTP_APS1SigOoRDTC_raw32_ovrdflg "" VALUE 0x0000 /* @ECU_Address@KOUTP_APS1SigOoRDTC_raw32_ovrdflg@ */ Scalar_BOOLEAN 0 SWC_OUTP_type_CM_boolean_flg 0.0 1.0 /end CHARACTERISTIC
/begin CHARACTERISTIC KOUTP_APS2SigOoRDTC_raw32_ovrdflg "" VALUE 0x0000 /* @ECU_Address@KOUTP_APS2SigOoRDTC_raw32_ovrdflg@ */ Scalar_BOOLEAN 0 SWC_OUTP_type_CM_boolean_flg 0.0 1.0 /end CHARACTERISTIC
/begin CHARACTERISTIC KOUTP_APSCorrErrDTC_raw32_ovrdflg "" VALUE 0x0000 /* @ECU_Address@KOUTP_APSCorrErrDTC_raw32_ovrdflg@ */ Scalar_BOOLEAN 0 SWC_OUTP_type_CM_boolean_flg 0.0 1.0 /end CHARACTERISTIC
/begin CHARACTERISTIC KOUTP_BMSRdyDTC_raw32_ovrdflg "" VALUE 0x0000 /* @ECU_Address@KOUTP_BMSRdyDTC_raw32_ovrdflg@ */ Scalar_BOOLEAN 0 SWC_OUTP_type_CM_boolean_flg 0.0 1.0 /end CHARACTERISTIC
/begin CHARACTERISTIC KOUTP_BMSSigErrDetDTC_raw32_ovrdflg "" VALUE 0x0000 /* @ECU_Address@KOUTP_BMSSigErrDetDTC_raw32_ovrdflg@ */ Scalar_BOOLEAN 0 SWC_OUTP_type_CM_boolean_flg 0.0 1.0 /end CHARACTERISTIC
/begin CHARACTERISTIC KOUTP_BrkSWErrDTC_raw32_ovrdflg "" VALUE 0x0000 /* @ECU_Address@KOUTP_BrkSWErrDTC_raw32_ovrdflg@ */ Scalar_BOOLEAN 0 SWC_OUTP_type_CM_boolean_flg 0.0 1.0 /end CHARACTERISTIC
/begin CHARACTERISTIC KOUTP_BrkSWNoBacDTC_raw32_ovrdflg "" VALUE 0x0000 /* @ECU_Address@KOUTP_BrkSWNoBacDTC_raw32_ovrdflg@ */ Scalar_BOOLEAN 0 SWC_OUTP_type_CM_boolean_flg 0.0 1.0 /end CHARACTERISTIC
/begin CHARACTERISTIC KOUTP_C1ABM1CSDTC_raw32_ovrdflg "" VALUE 0x0000 /* @ECU_Address@KOUTP_C1ABM1CSDTC_raw32_ovrdflg@ */ Scalar_BOOLEAN 0 SWC_OUTP_type_CM_boolean_flg 0.0 1.0 /end CHARACTERISTIC
/begin CHARACTERISTIC KOUTP_C1ABM1LCDTC_raw32_ovrdflg "" VALUE 0x0000 /* @ECU_Address@KOUTP_C1ABM1LCDTC_raw32_ovrdflg@ */ Scalar_BOOLEAN 0 SWC_OUTP_type_CM_boolean_flg 0.0 1.0 /end CHARACTERISTIC
/begin CHARACTERISTIC KOUTP_C1ABM1RCDTC_raw32_ovrdflg "" VALUE 0x0000 /* @ECU_Address@KOUTP_C1ABM1RCDTC_raw32_ovrdflg@ */ Scalar_BOOLEAN 0 SWC_OUTP_type_CM_boolean_flg 0.0 1.0 /end CHARACTERISTIC
/begin CHARACTERISTIC KOUTP_C1EPAS2LCDTC_raw32_ovrdflg "" VALUE 0x0000 /* @ECU_Address@KOUTP_C1EPAS2LCDTC_raw32_ovrdflg@ */ Scalar_BOOLEAN 0 SWC_OUTP_type_CM_boolean_flg 0.0 1.0 /end CHARACTERISTIC
/begin CHARACTERISTIC KOUTP_C3BMS1CSDTC_raw32_ovrdflg "" VALUE 0x0000 /* @ECU_Address@KOUTP_C3BMS1CSDTC_raw32_ovrdflg@ */ Scalar_BOOLEAN 0 SWC_OUTP_type_CM_boolean_flg 0.0 1.0 /end CHARACTERISTIC
/begin CHARACTERISTIC KOUTP_C3BMS1LCDTC_raw32_ovrdflg "" VALUE 0x0000 /* @ECU_Address@KOUTP_C3BMS1LCDTC_raw32_ovrdflg@ */ Scalar_BOOLEAN 0 SWC_OUTP_type_CM_boolean_flg 0.0 1.0 /end CHARACTERISTIC
/begin CHARACTERISTIC KOUTP_C3BMS1RCDTC_raw32_ovrdflg "" VALUE 0x0000 /* @ECU_Address@KOUTP_C3BMS1RCDTC_raw32_ovrdflg@ */ Scalar_BOOLEAN 0 SWC_OUTP_type_CM_boolean_flg 0.0 1.0 /end CHARACTERISTIC
/begin CHARACTERISTIC KOUTP_C3BMS6CSDTC_raw32_ovrdflg "" VALUE 0x0000 /* @ECU_Address@KOUTP_C3BMS6CSDTC_raw32_ovrdflg@ */ Scalar_BOOLEAN 0 SWC_OUTP_type_CM_boolean_flg 0.0 1.0 /end CHARACTERISTIC
/begin CHARACTERISTIC KOUTP_C3BMS6LCDTC_raw32_ovrdflg "" VALUE 0x0000 /* @ECU_Address@KOUTP_C3BMS6LCDTC_raw32_ovrdflg@ */ Scalar_BOOLEAN 0 SWC_OUTP_type_CM_boolean_flg 0.0 1.0 /end CHARACTERISTIC
/begin CHARACTERISTIC KOUTP_C3BMS6RCDTC_raw32_ovrdflg "" VALUE 0x0000 /* @ECU_Address@KOUTP_C3BMS6RCDTC_raw32_ovrdflg@ */ Scalar_BOOLEAN 0 SWC_OUTP_type_CM_boolean_flg 0.0 1.0 /end CHARACTERISTIC
/begin CHARACTERISTIC KOUTP_C3CCU1CSDTC_raw32_ovrdflg "" VALUE 0x0000 /* @ECU_Address@KOUTP_C3CCU1CSDTC_raw32_ovrdflg@ */ Scalar_BOOLEAN 0 SWC_OUTP_type_CM_boolean_flg 0.0 1.0 /end CHARACTERISTIC
/begin CHARACTERISTIC KOUTP_C3CCU1LCDTC_raw32_ovrdflg "" VALUE 0x0000 /* @ECU_Address@KOUTP_C3CCU1LCDTC_raw32_ovrdflg@ */ Scalar_BOOLEAN 0 SWC_OUTP_type_CM_boolean_flg 0.0 1.0 /end CHARACTERISTIC
/begin CHARACTERISTIC KOUTP_C3CCU1RCDTC_raw32_ovrdflg "" VALUE 0x0000 /* @ECU_Address@KOUTP_C3CCU1RCDTC_raw32_ovrdflg@ */ Scalar_BOOLEAN 0 SWC_OUTP_type_CM_boolean_flg 0.0 1.0 /end CHARACTERISTIC
/begin CHARACTERISTIC KOUTP_C3CCU2CSDTC_raw32_ovrdflg "" VALUE 0x0000 /* @ECU_Address@KOUTP_C3CCU2CSDTC_raw32_ovrdflg@ */ Scalar_BOOLEAN 0 SWC_OUTP_type_CM_boolean_flg 0.0 1.0 /end CHARACTERISTIC
/begin CHARACTERISTIC KOUTP_C3CCU2LCDTC_raw32_ovrdflg "" VALUE 0x0000 /* @ECU_Address@KOUTP_C3CCU2LCDTC_raw32_ovrdflg@ */ Scalar_BOOLEAN 0 SWC_OUTP_type_CM_boolean_flg 0.0 1.0 /end CHARACTERISTIC
/begin CHARACTERISTIC KOUTP_C3CCU2RCDTC_raw32_ovrdflg "" VALUE 0x0000 /* @ECU_Address@KOUTP_C3CCU2RCDTC_raw32_ovrdflg@ */ Scalar_BOOLEAN 0 SWC_OUTP_type_CM_boolean_flg 0.0 1.0 /end CHARACTERISTIC
/begin CHARACTERISTIC KOUTP_CCMalfuncDetDTC_raw32_ovrdflg "" VALUE 0x0000 /* @ECU_Address@KOUTP_CCMalfuncDetDTC_raw32_ovrdflg@ */ Scalar_BOOLEAN 0 SWC_OUTP_type_CM_boolean_flg 0.0 1.0 /end CHARACTERISTIC
/begin CHARACTERISTIC KOUTP_CCUSigErrDetDTC_raw32_ovrdflg "" VALUE 0x0000 /* @ECU_Address@KOUTP_CCUSigErrDetDTC_raw32_ovrdflg@ */ Scalar_BOOLEAN 0 SWC_OUTP_type_CM_boolean_flg 0.0 1.0 /end CHARACTERISTIC
/begin CHARACTERISTIC KOUTP_DCDC4PreDTC_raw32_ovrdflg "" VALUE 0x0000 /* @ECU_Address@KOUTP_DCDC4PreDTC_raw32_ovrdflg@ */ Scalar_BOOLEAN 0 SWC_OUTP_type_CM_boolean_flg 0.0 1.0 /end CHARACTERISTIC
/begin CHARACTERISTIC KOUTP_DCDCDisDTC_raw32_ovrdflg "" VALUE 0x0000 /* @ECU_Address@KOUTP_DCDCDisDTC_raw32_ovrdflg@ */ Scalar_BOOLEAN 0 SWC_OUTP_type_CM_boolean_flg 0.0 1.0 /end CHARACTERISTIC
/begin CHARACTERISTIC KOUTP_DCDCEnaDTC_raw32_ovrdflg "" VALUE 0x0000 /* @ECU_Address@KOUTP_DCDCEnaDTC_raw32_ovrdflg@ */ Scalar_BOOLEAN 0 SWC_OUTP_type_CM_boolean_flg 0.0 1.0 /end CHARACTERISTIC
/begin CHARACTERISTIC KOUTP_DTCDetect_enum_ovrdflg "" VALUE 0x0000 /* @ECU_Address@KOUTP_DTCDetect_enum_ovrdflg@ */ Scalar_BOOLEAN 0 SWC_OUTP_type_CM_boolean_flg 0.0 1.0 /end CHARACTERISTIC
/begin CHARACTERISTIC KOUTP_DiagFLTSDTC_raw32_ovrdflg "" VALUE 0x0000 /* @ECU_Address@KOUTP_DiagFLTSDTC_raw32_ovrdflg@ */ Scalar_BOOLEAN 0 SWC_OUTP_type_CM_boolean_flg 0.0 1.0 /end CHARACTERISTIC
/begin CHARACTERISTIC KOUTP_DiagFRTSDTC_raw32_ovrdflg "" VALUE 0x0000 /* @ECU_Address@KOUTP_DiagFRTSDTC_raw32_ovrdflg@ */ Scalar_BOOLEAN 0 SWC_OUTP_type_CM_boolean_flg 0.0 1.0 /end CHARACTERISTIC
/begin CHARACTERISTIC KOUTP_DiagHCrashDTC_raw32_ovrdflg "" VALUE 0x0000 /* @ECU_Address@KOUTP_DiagHCrashDTC_raw32_ovrdflg@ */ Scalar_BOOLEAN 0 SWC_OUTP_type_CM_boolean_flg 0.0 1.0 /end CHARACTERISTIC
/begin CHARACTERISTIC KOUTP_DiagRLTSDTC_raw32_ovrdflg "" VALUE 0x0000 /* @ECU_Address@KOUTP_DiagRLTSDTC_raw32_ovrdflg@ */ Scalar_BOOLEAN 0 SWC_OUTP_type_CM_boolean_flg 0.0 1.0 /end CHARACTERISTIC
/begin CHARACTERISTIC KOUTP_DiagRRTSDTC_raw32_ovrdflg "" VALUE 0x0000 /* @ECU_Address@KOUTP_DiagRRTSDTC_raw32_ovrdflg@ */ Scalar_BOOLEAN 0 SWC_OUTP_type_CM_boolean_flg 0.0 1.0 /end CHARACTERISTIC
/begin CHARACTERISTIC KOUTP_DisengagePFail_flg_maxval "" VALUE 0x0000 /* @ECU_Address@KOUTP_DisengagePFail_flg_maxval@ */ Scalar_BOOLEAN 0 SWC_OUTP_type_CM_boolean_flg 0.0 1.0 /end CHARACTERISTIC
/begin CHARACTERISTIC KOUTP_DisengagePFail_flg_minval "" VALUE 0x0000 /* @ECU_Address@KOUTP_DisengagePFail_flg_minval@ */ Scalar_BOOLEAN 0 SWC_OUTP_type_CM_boolean_flg 0.0 1.0 /end CHARACTERISTIC
/begin CHARACTERISTIC KOUTP_DisengagePFail_flg_ovrdflg "" VALUE 0x0000 /* @ECU_Address@KOUTP_DisengagePFail_flg_ovrdflg@ */ Scalar_BOOLEAN 0 SWC_OUTP_type_CM_boolean_flg 0.0 1.0 /end CHARACTERISTIC
/begin CHARACTERISTIC KOUTP_DisengagePFail_flg_ovrdval "" VALUE 0x0000 /* @ECU_Address@KOUTP_DisengagePFail_flg_ovrdval@ */ Scalar_BOOLEAN 0 SWC_OUTP_type_CM_boolean_flg 0.0 1.0 /end CHARACTERISTIC
/begin CHARACTERISTIC KOUTP_DrStSWDTC_raw32_ovrdflg "" VALUE 0x0000 /* @ECU_Address@KOUTP_DrStSWDTC_raw32_ovrdflg@ */ Scalar_BOOLEAN 0 SWC_OUTP_type_CM_boolean_flg 0.0 1.0 /end CHARACTERISTIC
/begin CHARACTERISTIC KOUTP_EDriveSysErrShifterErr_flg_maxval "" VALUE 0x0000 /* @ECU_Address@KOUTP_EDriveSysErrShifterErr_flg_maxval@ */ Scalar_BOOLEAN 0 SWC_OUTP_type_CM_boolean_flg 0.0 1.0 /end CHARACTERISTIC
/begin CHARACTERISTIC KOUTP_EDriveSysErrShifterErr_flg_minval "" VALUE 0x0000 /* @ECU_Address@KOUTP_EDriveSysErrShifterErr_flg_minval@ */ Scalar_BOOLEAN 0 SWC_OUTP_type_CM_boolean_flg 0.0 1.0 /end CHARACTERISTIC
/begin CHARACTERISTIC KOUTP_EDriveSysErrShifterErr_flg_ovrdflg "" VALUE 0x0000 /* @ECU_Address@KOUTP_EDriveSysErrShifterErr_flg_ovrdflg@ */ Scalar_BOOLEAN 0 SWC_OUTP_type_CM_boolean_flg 0.0 1.0 /end CHARACTERISTIC
/begin CHARACTERISTIC KOUTP_EDriveSysErrShifterErr_flg_ovrdval "" VALUE 0x0000 /* @ECU_Address@KOUTP_EDriveSysErrShifterErr_flg_ovrdval@ */ Scalar_BOOLEAN 0 SWC_OUTP_type_CM_boolean_flg 0.0 1.0 /end CHARACTERISTIC
/begin CHARACTERISTIC KOUTP_EDriveSysErrVCUErr_flg_maxval "" VALUE 0x0000 /* @ECU_Address@KOUTP_EDriveSysErrVCUErr_flg_maxval@ */ Scalar_BOOLEAN 0 SWC_OUTP_type_CM_boolean_flg 0.0 1.0 /end CHARACTERISTIC
/begin CHARACTERISTIC KOUTP_EDriveSysErrVCUErr_flg_minval "" VALUE 0x0000 /* @ECU_Address@KOUTP_EDriveSysErrVCUErr_flg_minval@ */ Scalar_BOOLEAN 0 SWC_OUTP_type_CM_boolean_flg 0.0 1.0 /end CHARACTERISTIC
/begin CHARACTERISTIC KOUTP_EDriveSysErrVCUErr_flg_ovrdflg "" VALUE 0x0000 /* @ECU_Address@KOUTP_EDriveSysErrVCUErr_flg_ovrdflg@ */ Scalar_BOOLEAN 0 SWC_OUTP_type_CM_boolean_flg 0.0 1.0 /end CHARACTERISTIC
/begin CHARACTERISTIC KOUTP_EDriveSysErrVCUErr_flg_ovrdval "" VALUE 0x0000 /* @ECU_Address@KOUTP_EDriveSysErrVCUErr_flg_ovrdval@ */ Scalar_BOOLEAN 0 SWC_OUTP_type_CM_boolean_flg 0.0 1.0 /end CHARACTERISTIC
/begin CHARACTERISTIC KOUTP_EPBLockTODTC_raw32_ovrdflg "" VALUE 0x0000 /* @ECU_Address@KOUTP_EPBLockTODTC_raw32_ovrdflg@ */ Scalar_BOOLEAN 0 SWC_OUTP_type_CM_boolean_flg 0.0 1.0 /end CHARACTERISTIC
/begin CHARACTERISTIC KOUTP_EPBUnlockTODTC_raw32_ovrdflg "" VALUE 0x0000 /* @ECU_Address@KOUTP_EPBUnlockTODTC_raw32_ovrdflg@ */ Scalar_BOOLEAN 0 SWC_OUTP_type_CM_boolean_flg 0.0 1.0 /end CHARACTERISTIC
/begin CHARACTERISTIC KOUTP_ESC1CSErrDTC_raw32_ovrdflg "" VALUE 0x0000 /* @ECU_Address@KOUTP_ESC1CSErrDTC_raw32_ovrdflg@ */ Scalar_BOOLEAN 0 SWC_OUTP_type_CM_boolean_flg 0.0 1.0 /end CHARACTERISTIC
/begin CHARACTERISTIC KOUTP_ESC1NoComDTC_raw32_ovrdflg "" VALUE 0x0000 /* @ECU_Address@KOUTP_ESC1NoComDTC_raw32_ovrdflg@ */ Scalar_BOOLEAN 0 SWC_OUTP_type_CM_boolean_flg 0.0 1.0 /end CHARACTERISTIC
/begin CHARACTERISTIC KOUTP_ESC1RCErrDTC_raw32_ovrdflg "" VALUE 0x0000 /* @ECU_Address@KOUTP_ESC1RCErrDTC_raw32_ovrdflg@ */ Scalar_BOOLEAN 0 SWC_OUTP_type_CM_boolean_flg 0.0 1.0 /end CHARACTERISTIC
/begin CHARACTERISTIC KOUTP_ESC5CSErrDTC_raw32_ovrdflg "" VALUE 0x0000 /* @ECU_Address@KOUTP_ESC5CSErrDTC_raw32_ovrdflg@ */ Scalar_BOOLEAN 0 SWC_OUTP_type_CM_boolean_flg 0.0 1.0 /end CHARACTERISTIC
/begin CHARACTERISTIC KOUTP_ESC5NoComDTC_raw32_ovrdflg "" VALUE 0x0000 /* @ECU_Address@KOUTP_ESC5NoComDTC_raw32_ovrdflg@ */ Scalar_BOOLEAN 0 SWC_OUTP_type_CM_boolean_flg 0.0 1.0 /end CHARACTERISTIC
/begin CHARACTERISTIC KOUTP_ESC5RCErrDTC_raw32_ovrdflg "" VALUE 0x0000 /* @ECU_Address@KOUTP_ESC5RCErrDTC_raw32_ovrdflg@ */ Scalar_BOOLEAN 0 SWC_OUTP_type_CM_boolean_flg 0.0 1.0 /end CHARACTERISTIC
/begin CHARACTERISTIC KOUTP_ESC7CSErrDTC_raw32_ovrdflg "" VALUE 0x0000 /* @ECU_Address@KOUTP_ESC7CSErrDTC_raw32_ovrdflg@ */ Scalar_BOOLEAN 0 SWC_OUTP_type_CM_boolean_flg 0.0 1.0 /end CHARACTERISTIC
/begin CHARACTERISTIC KOUTP_ESC7NoComDTC_raw32_ovrdflg "" VALUE 0x0000 /* @ECU_Address@KOUTP_ESC7NoComDTC_raw32_ovrdflg@ */ Scalar_BOOLEAN 0 SWC_OUTP_type_CM_boolean_flg 0.0 1.0 /end CHARACTERISTIC
/begin CHARACTERISTIC KOUTP_ESC7RCErrDTC_raw32_ovrdflg "" VALUE 0x0000 /* @ECU_Address@KOUTP_ESC7RCErrDTC_raw32_ovrdflg@ */ Scalar_BOOLEAN 0 SWC_OUTP_type_CM_boolean_flg 0.0 1.0 /end CHARACTERISTIC
/begin CHARACTERISTIC KOUTP_EngagePFail_flg_maxval "" VALUE 0x0000 /* @ECU_Address@KOUTP_EngagePFail_flg_maxval@ */ Scalar_BOOLEAN 0 SWC_OUTP_type_CM_boolean_flg 0.0 1.0 /end CHARACTERISTIC
/begin CHARACTERISTIC KOUTP_EngagePFail_flg_minval "" VALUE 0x0000 /* @ECU_Address@KOUTP_EngagePFail_flg_minval@ */ Scalar_BOOLEAN 0 SWC_OUTP_type_CM_boolean_flg 0.0 1.0 /end CHARACTERISTIC
/begin CHARACTERISTIC KOUTP_EngagePFail_flg_ovrdflg "" VALUE 0x0000 /* @ECU_Address@KOUTP_EngagePFail_flg_ovrdflg@ */ Scalar_BOOLEAN 0 SWC_OUTP_type_CM_boolean_flg 0.0 1.0 /end CHARACTERISTIC
/begin CHARACTERISTIC KOUTP_EngagePFail_flg_ovrdval "" VALUE 0x0000 /* @ECU_Address@KOUTP_EngagePFail_flg_ovrdval@ */ Scalar_BOOLEAN 0 SWC_OUTP_type_CM_boolean_flg 0.0 1.0 /end CHARACTERISTIC
/begin CHARACTERISTIC KOUTP_EnterNewOperCyc_flg_maxval "" VALUE 0x0000 /* @ECU_Address@KOUTP_EnterNewOperCyc_flg_maxval@ */ Scalar_BOOLEAN 0 SWC_OUTP_type_CM_boolean_flg 0.0 1.0 /end CHARACTERISTIC
/begin CHARACTERISTIC KOUTP_EnterNewOperCyc_flg_minval "" VALUE 0x0000 /* @ECU_Address@KOUTP_EnterNewOperCyc_flg_minval@ */ Scalar_BOOLEAN 0 SWC_OUTP_type_CM_boolean_flg 0.0 1.0 /end CHARACTERISTIC
/begin CHARACTERISTIC KOUTP_EnterNewOperCyc_flg_ovrdflg "" VALUE 0x0000 /* @ECU_Address@KOUTP_EnterNewOperCyc_flg_ovrdflg@ */ Scalar_BOOLEAN 0 SWC_OUTP_type_CM_boolean_flg 0.0 1.0 /end CHARACTERISTIC
/begin CHARACTERISTIC KOUTP_EnterNewOperCyc_flg_ovrdval "" VALUE 0x0000 /* @ECU_Address@KOUTP_EnterNewOperCyc_flg_ovrdval@ */ Scalar_BOOLEAN 0 SWC_OUTP_type_CM_boolean_flg 0.0 1.0 /end CHARACTERISTIC
/begin CHARACTERISTIC KOUTP_FCLUSSDTC_raw32_ovrdflg "" VALUE 0x0000 /* @ECU_Address@KOUTP_FCLUSSDTC_raw32_ovrdflg@ */ Scalar_BOOLEAN 0 SWC_OUTP_type_CM_boolean_flg 0.0 1.0 /end CHARACTERISTIC
/begin CHARACTERISTIC KOUTP_FCM2CSErrDTC_raw32_ovrdflg "" VALUE 0x0000 /* @ECU_Address@KOUTP_FCM2CSErrDTC_raw32_ovrdflg@ */ Scalar_BOOLEAN 0 SWC_OUTP_type_CM_boolean_flg 0.0 1.0 /end CHARACTERISTIC
/begin CHARACTERISTIC KOUTP_FCM2NoComDTC_raw32_ovrdflg "" VALUE 0x0000 /* @ECU_Address@KOUTP_FCM2NoComDTC_raw32_ovrdflg@ */ Scalar_BOOLEAN 0 SWC_OUTP_type_CM_boolean_flg 0.0 1.0 /end CHARACTERISTIC
/begin CHARACTERISTIC KOUTP_FCM2RCErrDTC_raw32_ovrdflg "" VALUE 0x0000 /* @ECU_Address@KOUTP_FCM2RCErrDTC_raw32_ovrdflg@ */ Scalar_BOOLEAN 0 SWC_OUTP_type_CM_boolean_flg 0.0 1.0 /end CHARACTERISTIC
/begin CHARACTERISTIC KOUTP_FCM3CSErrDTC_raw32_ovrdflg "" VALUE 0x0000 /* @ECU_Address@KOUTP_FCM3CSErrDTC_raw32_ovrdflg@ */ Scalar_BOOLEAN 0 SWC_OUTP_type_CM_boolean_flg 0.0 1.0 /end CHARACTERISTIC
/begin CHARACTERISTIC KOUTP_FCM3NoComDTC_raw32_ovrdflg "" VALUE 0x0000 /* @ECU_Address@KOUTP_FCM3NoComDTC_raw32_ovrdflg@ */ Scalar_BOOLEAN 0 SWC_OUTP_type_CM_boolean_flg 0.0 1.0 /end CHARACTERISTIC
/begin CHARACTERISTIC KOUTP_FCM3RCErrDTC_raw32_ovrdflg "" VALUE 0x0000 /* @ECU_Address@KOUTP_FCM3RCErrDTC_raw32_ovrdflg@ */ Scalar_BOOLEAN 0 SWC_OUTP_type_CM_boolean_flg 0.0 1.0 /end CHARACTERISTIC
/begin CHARACTERISTIC KOUTP_FCM4CSErrDTC_raw32_ovrdflg "" VALUE 0x0000 /* @ECU_Address@KOUTP_FCM4CSErrDTC_raw32_ovrdflg@ */ Scalar_BOOLEAN 0 SWC_OUTP_type_CM_boolean_flg 0.0 1.0 /end CHARACTERISTIC
/begin CHARACTERISTIC KOUTP_FCM4NoComDTC_raw32_ovrdflg "" VALUE 0x0000 /* @ECU_Address@KOUTP_FCM4NoComDTC_raw32_ovrdflg@ */ Scalar_BOOLEAN 0 SWC_OUTP_type_CM_boolean_flg 0.0 1.0 /end CHARACTERISTIC
/begin CHARACTERISTIC KOUTP_FCM5CSErrDTC_raw32_ovrdflg "" VALUE 0x0000 /* @ECU_Address@KOUTP_FCM5CSErrDTC_raw32_ovrdflg@ */ Scalar_BOOLEAN 0 SWC_OUTP_type_CM_boolean_flg 0.0 1.0 /end CHARACTERISTIC
/begin CHARACTERISTIC KOUTP_FCM5NoComDTC_raw32_ovrdflg "" VALUE 0x0000 /* @ECU_Address@KOUTP_FCM5NoComDTC_raw32_ovrdflg@ */ Scalar_BOOLEAN 0 SWC_OUTP_type_CM_boolean_flg 0.0 1.0 /end CHARACTERISTIC
/begin CHARACTERISTIC KOUTP_FDCBCMBSDBuzzerCmd_flg_maxval "" VALUE 0x0000 /* @ECU_Address@KOUTP_FDCBCMBSDBuzzerCmd_flg_maxval@ */ Scalar_BOOLEAN 0 SWC_OUTP_type_CM_boolean_flg 0.0 1.0 /end CHARACTERISTIC
/begin CHARACTERISTIC KOUTP_FDCBCMBSDBuzzerCmd_flg_minval "" VALUE 0x0000 /* @ECU_Address@KOUTP_FDCBCMBSDBuzzerCmd_flg_minval@ */ Scalar_BOOLEAN 0 SWC_OUTP_type_CM_boolean_flg 0.0 1.0 /end CHARACTERISTIC
/begin CHARACTERISTIC KOUTP_FDCBCMBSDBuzzerCmd_flg_ovrdflg "" VALUE 0x0000 /* @ECU_Address@KOUTP_FDCBCMBSDBuzzerCmd_flg_ovrdflg@ */ Scalar_BOOLEAN 0 SWC_OUTP_type_CM_boolean_flg 0.0 1.0 /end CHARACTERISTIC
/begin CHARACTERISTIC KOUTP_FDCBCMBSDBuzzerCmd_flg_ovrdval "" VALUE 0x0000 /* @ECU_Address@KOUTP_FDCBCMBSDBuzzerCmd_flg_ovrdval@ */ Scalar_BOOLEAN 0 SWC_OUTP_type_CM_boolean_flg 0.0 1.0 /end CHARACTERISTIC
/begin CHARACTERISTIC KOUTP_FDCBCMBrakeCmd_flg_maxval "" VALUE 0x0000 /* @ECU_Address@KOUTP_FDCBCMBrakeCmd_flg_maxval@ */ Scalar_BOOLEAN 0 SWC_OUTP_type_CM_boolean_flg 0.0 1.0 /end CHARACTERISTIC
/begin CHARACTERISTIC KOUTP_FDCBCMBrakeCmd_flg_minval "" VALUE 0x0000 /* @ECU_Address@KOUTP_FDCBCMBrakeCmd_flg_minval@ */ Scalar_BOOLEAN 0 SWC_OUTP_type_CM_boolean_flg 0.0 1.0 /end CHARACTERISTIC
/begin CHARACTERISTIC KOUTP_FDCBCMBrakeCmd_flg_ovrdflg "" VALUE 0x0000 /* @ECU_Address@KOUTP_FDCBCMBrakeCmd_flg_ovrdflg@ */ Scalar_BOOLEAN 0 SWC_OUTP_type_CM_boolean_flg 0.0 1.0 /end CHARACTERISTIC
/begin CHARACTERISTIC KOUTP_FDCBCMBrakeCmd_flg_ovrdval "" VALUE 0x0000 /* @ECU_Address@KOUTP_FDCBCMBrakeCmd_flg_ovrdval@ */ Scalar_BOOLEAN 0 SWC_OUTP_type_CM_boolean_flg 0.0 1.0 /end CHARACTERISTIC
/begin CHARACTERISTIC KOUTP_FDCBCMCallBellCmd_flg_maxval "" VALUE 0x0000 /* @ECU_Address@KOUTP_FDCBCMCallBellCmd_flg_maxval@ */ Scalar_BOOLEAN 0 SWC_OUTP_type_CM_boolean_flg 0.0 1.0 /end CHARACTERISTIC
/begin CHARACTERISTIC KOUTP_FDCBCMCallBellCmd_flg_minval "" VALUE 0x0000 /* @ECU_Address@KOUTP_FDCBCMCallBellCmd_flg_minval@ */ Scalar_BOOLEAN 0 SWC_OUTP_type_CM_boolean_flg 0.0 1.0 /end CHARACTERISTIC
/begin CHARACTERISTIC KOUTP_FDCBCMCallBellCmd_flg_ovrdflg "" VALUE 0x0000 /* @ECU_Address@KOUTP_FDCBCMCallBellCmd_flg_ovrdflg@ */ Scalar_BOOLEAN 0 SWC_OUTP_type_CM_boolean_flg 0.0 1.0 /end CHARACTERISTIC
/begin CHARACTERISTIC KOUTP_FDCBCMCallBellCmd_flg_ovrdval "" VALUE 0x0000 /* @ECU_Address@KOUTP_FDCBCMCallBellCmd_flg_ovrdval@ */ Scalar_BOOLEAN 0 SWC_OUTP_type_CM_boolean_flg 0.0 1.0 /end CHARACTERISTIC
/begin CHARACTERISTIC KOUTP_FDCBCMDVRSignalLCmd_flg_maxval "" VALUE 0x0000 /* @ECU_Address@KOUTP_FDCBCMDVRSignalLCmd_flg_maxval@ */ Scalar_BOOLEAN 0 SWC_OUTP_type_CM_boolean_flg 0.0 1.0 /end CHARACTERISTIC
/begin CHARACTERISTIC KOUTP_FDCBCMDVRSignalLCmd_flg_minval "" VALUE 0x0000 /* @ECU_Address@KOUTP_FDCBCMDVRSignalLCmd_flg_minval@ */ Scalar_BOOLEAN 0 SWC_OUTP_type_CM_boolean_flg 0.0 1.0 /end CHARACTERISTIC
/begin CHARACTERISTIC KOUTP_FDCBCMDVRSignalLCmd_flg_ovrdflg "" VALUE 0x0000 /* @ECU_Address@KOUTP_FDCBCMDVRSignalLCmd_flg_ovrdflg@ */ Scalar_BOOLEAN 0 SWC_OUTP_type_CM_boolean_flg 0.0 1.0 /end CHARACTERISTIC
/begin CHARACTERISTIC KOUTP_FDCBCMDVRSignalLCmd_flg_ovrdval "" VALUE 0x0000 /* @ECU_Address@KOUTP_FDCBCMDVRSignalLCmd_flg_ovrdval@ */ Scalar_BOOLEAN 0 SWC_OUTP_type_CM_boolean_flg 0.0 1.0 /end CHARACTERISTIC
/begin CHARACTERISTIC KOUTP_FDCBCMDVRSignalRCmd_flg_maxval "" VALUE 0x0000 /* @ECU_Address@KOUTP_FDCBCMDVRSignalRCmd_flg_maxval@ */ Scalar_BOOLEAN 0 SWC_OUTP_type_CM_boolean_flg 0.0 1.0 /end CHARACTERISTIC
/begin CHARACTERISTIC KOUTP_FDCBCMDVRSignalRCmd_flg_minval "" VALUE 0x0000 /* @ECU_Address@KOUTP_FDCBCMDVRSignalRCmd_flg_minval@ */ Scalar_BOOLEAN 0 SWC_OUTP_type_CM_boolean_flg 0.0 1.0 /end CHARACTERISTIC
/begin CHARACTERISTIC KOUTP_FDCBCMDVRSignalRCmd_flg_ovrdflg "" VALUE 0x0000 /* @ECU_Address@KOUTP_FDCBCMDVRSignalRCmd_flg_ovrdflg@ */ Scalar_BOOLEAN 0 SWC_OUTP_type_CM_boolean_flg 0.0 1.0 /end CHARACTERISTIC
/begin CHARACTERISTIC KOUTP_FDCBCMDVRSignalRCmd_flg_ovrdval "" VALUE 0x0000 /* @ECU_Address@KOUTP_FDCBCMDVRSignalRCmd_flg_ovrdval@ */ Scalar_BOOLEAN 0 SWC_OUTP_type_CM_boolean_flg 0.0 1.0 /end CHARACTERISTIC
/begin CHARACTERISTIC KOUTP_FDCBCMEmExitSWSta_flg_maxval "" VALUE 0x0000 /* @ECU_Address@KOUTP_FDCBCMEmExitSWSta_flg_maxval@ */ Scalar_BOOLEAN 0 SWC_OUTP_type_CM_boolean_flg 0.0 1.0 /end CHARACTERISTIC
/begin CHARACTERISTIC KOUTP_FDCBCMEmExitSWSta_flg_minval "" VALUE 0x0000 /* @ECU_Address@KOUTP_FDCBCMEmExitSWSta_flg_minval@ */ Scalar_BOOLEAN 0 SWC_OUTP_type_CM_boolean_flg 0.0 1.0 /end CHARACTERISTIC
/begin CHARACTERISTIC KOUTP_FDCBCMEmExitSWSta_flg_ovrdflg "" VALUE 0x0000 /* @ECU_Address@KOUTP_FDCBCMEmExitSWSta_flg_ovrdflg@ */ Scalar_BOOLEAN 0 SWC_OUTP_type_CM_boolean_flg 0.0 1.0 /end CHARACTERISTIC
/begin CHARACTERISTIC KOUTP_FDCBCMEmExitSWSta_flg_ovrdval "" VALUE 0x0000 /* @ECU_Address@KOUTP_FDCBCMEmExitSWSta_flg_ovrdval@ */ Scalar_BOOLEAN 0 SWC_OUTP_type_CM_boolean_flg 0.0 1.0 /end CHARACTERISTIC
/begin CHARACTERISTIC KOUTP_FDCBCMEmSVCmd_flg_maxval "" VALUE 0x0000 /* @ECU_Address@KOUTP_FDCBCMEmSVCmd_flg_maxval@ */ Scalar_BOOLEAN 0 SWC_OUTP_type_CM_boolean_flg 0.0 1.0 /end CHARACTERISTIC
/begin CHARACTERISTIC KOUTP_FDCBCMEmSVCmd_flg_minval "" VALUE 0x0000 /* @ECU_Address@KOUTP_FDCBCMEmSVCmd_flg_minval@ */ Scalar_BOOLEAN 0 SWC_OUTP_type_CM_boolean_flg 0.0 1.0 /end CHARACTERISTIC
/begin CHARACTERISTIC KOUTP_FDCBCMEmSVCmd_flg_ovrdflg "" VALUE 0x0000 /* @ECU_Address@KOUTP_FDCBCMEmSVCmd_flg_ovrdflg@ */ Scalar_BOOLEAN 0 SWC_OUTP_type_CM_boolean_flg 0.0 1.0 /end CHARACTERISTIC
/begin CHARACTERISTIC KOUTP_FDCBCMEmSVCmd_flg_ovrdval "" VALUE 0x0000 /* @ECU_Address@KOUTP_FDCBCMEmSVCmd_flg_ovrdval@ */ Scalar_BOOLEAN 0 SWC_OUTP_type_CM_boolean_flg 0.0 1.0 /end CHARACTERISTIC
/begin CHARACTERISTIC KOUTP_FDCBCMFDCloseSVCmd_flg_maxval "" VALUE 0x0000 /* @ECU_Address@KOUTP_FDCBCMFDCloseSVCmd_flg_maxval@ */ Scalar_BOOLEAN 0 SWC_OUTP_type_CM_boolean_flg 0.0 1.0 /end CHARACTERISTIC
/begin CHARACTERISTIC KOUTP_FDCBCMFDCloseSVCmd_flg_minval "" VALUE 0x0000 /* @ECU_Address@KOUTP_FDCBCMFDCloseSVCmd_flg_minval@ */ Scalar_BOOLEAN 0 SWC_OUTP_type_CM_boolean_flg 0.0 1.0 /end CHARACTERISTIC
/begin CHARACTERISTIC KOUTP_FDCBCMFDCloseSVCmd_flg_ovrdflg "" VALUE 0x0000 /* @ECU_Address@KOUTP_FDCBCMFDCloseSVCmd_flg_ovrdflg@ */ Scalar_BOOLEAN 0 SWC_OUTP_type_CM_boolean_flg 0.0 1.0 /end CHARACTERISTIC
/begin CHARACTERISTIC KOUTP_FDCBCMFDCloseSVCmd_flg_ovrdval "" VALUE 0x0000 /* @ECU_Address@KOUTP_FDCBCMFDCloseSVCmd_flg_ovrdval@ */ Scalar_BOOLEAN 0 SWC_OUTP_type_CM_boolean_flg 0.0 1.0 /end CHARACTERISTIC
/begin CHARACTERISTIC KOUTP_FDCBCMFDOpenSVCmd_flg_maxval "" VALUE 0x0000 /* @ECU_Address@KOUTP_FDCBCMFDOpenSVCmd_flg_maxval@ */ Scalar_BOOLEAN 0 SWC_OUTP_type_CM_boolean_flg 0.0 1.0 /end CHARACTERISTIC
/begin CHARACTERISTIC KOUTP_FDCBCMFDOpenSVCmd_flg_minval "" VALUE 0x0000 /* @ECU_Address@KOUTP_FDCBCMFDOpenSVCmd_flg_minval@ */ Scalar_BOOLEAN 0 SWC_OUTP_type_CM_boolean_flg 0.0 1.0 /end CHARACTERISTIC
/begin CHARACTERISTIC KOUTP_FDCBCMFDOpenSVCmd_flg_ovrdflg "" VALUE 0x0000 /* @ECU_Address@KOUTP_FDCBCMFDOpenSVCmd_flg_ovrdflg@ */ Scalar_BOOLEAN 0 SWC_OUTP_type_CM_boolean_flg 0.0 1.0 /end CHARACTERISTIC
/begin CHARACTERISTIC KOUTP_FDCBCMFDOpenSVCmd_flg_ovrdval "" VALUE 0x0000 /* @ECU_Address@KOUTP_FDCBCMFDOpenSVCmd_flg_ovrdval@ */ Scalar_BOOLEAN 0 SWC_OUTP_type_CM_boolean_flg 0.0 1.0 /end CHARACTERISTIC
/begin CHARACTERISTIC KOUTP_FDCBCMFDoorSta_flg_maxval "" VALUE 0x0000 /* @ECU_Address@KOUTP_FDCBCMFDoorSta_flg_maxval@ */ Scalar_BOOLEAN 0 SWC_OUTP_type_CM_boolean_flg 0.0 1.0 /end CHARACTERISTIC
/begin CHARACTERISTIC KOUTP_FDCBCMFDoorSta_flg_minval "" VALUE 0x0000 /* @ECU_Address@KOUTP_FDCBCMFDoorSta_flg_minval@ */ Scalar_BOOLEAN 0 SWC_OUTP_type_CM_boolean_flg 0.0 1.0 /end CHARACTERISTIC
/begin CHARACTERISTIC KOUTP_FDCBCMFDoorSta_flg_ovrdflg "" VALUE 0x0000 /* @ECU_Address@KOUTP_FDCBCMFDoorSta_flg_ovrdflg@ */ Scalar_BOOLEAN 0 SWC_OUTP_type_CM_boolean_flg 0.0 1.0 /end CHARACTERISTIC
/begin CHARACTERISTIC KOUTP_FDCBCMFDoorSta_flg_ovrdval "" VALUE 0x0000 /* @ECU_Address@KOUTP_FDCBCMFDoorSta_flg_ovrdval@ */ Scalar_BOOLEAN 0 SWC_OUTP_type_CM_boolean_flg 0.0 1.0 /end CHARACTERISTIC
/begin CHARACTERISTIC KOUTP_FDCBCMFRoomLpCmd_pct_ovrdflg "" VALUE 0x0000 /* @ECU_Address@KOUTP_FDCBCMFRoomLpCmd_pct_ovrdflg@ */ Scalar_BOOLEAN 0 SWC_OUTP_type_CM_boolean_flg 0.0 1.0 /end CHARACTERISTIC
/begin CHARACTERISTIC KOUTP_FDCBCMFRoomLpSetSta_pct_ovrdflg "" VALUE 0x0000 /* @ECU_Address@KOUTP_FDCBCMFRoomLpSetSta_pct_ovrdflg@ */ Scalar_BOOLEAN 0 SWC_OUTP_type_CM_boolean_flg 0.0 1.0 /end CHARACTERISTIC
/begin CHARACTERISTIC KOUTP_FDCBCMHBeamCmd_flg_maxval "" VALUE 0x0000 /* @ECU_Address@KOUTP_FDCBCMHBeamCmd_flg_maxval@ */ Scalar_BOOLEAN 0 SWC_OUTP_type_CM_boolean_flg 0.0 1.0 /end CHARACTERISTIC
/begin CHARACTERISTIC KOUTP_FDCBCMHBeamCmd_flg_minval "" VALUE 0x0000 /* @ECU_Address@KOUTP_FDCBCMHBeamCmd_flg_minval@ */ Scalar_BOOLEAN 0 SWC_OUTP_type_CM_boolean_flg 0.0 1.0 /end CHARACTERISTIC
/begin CHARACTERISTIC KOUTP_FDCBCMHBeamCmd_flg_ovrdflg "" VALUE 0x0000 /* @ECU_Address@KOUTP_FDCBCMHBeamCmd_flg_ovrdflg@ */ Scalar_BOOLEAN 0 SWC_OUTP_type_CM_boolean_flg 0.0 1.0 /end CHARACTERISTIC
/begin CHARACTERISTIC KOUTP_FDCBCMHBeamCmd_flg_ovrdval "" VALUE 0x0000 /* @ECU_Address@KOUTP_FDCBCMHBeamCmd_flg_ovrdval@ */ Scalar_BOOLEAN 0 SWC_OUTP_type_CM_boolean_flg 0.0 1.0 /end CHARACTERISTIC
/begin CHARACTERISTIC KOUTP_FDCBCMHelpINDCmd_flg_maxval "" VALUE 0x0000 /* @ECU_Address@KOUTP_FDCBCMHelpINDCmd_flg_maxval@ */ Scalar_BOOLEAN 0 SWC_OUTP_type_CM_boolean_flg 0.0 1.0 /end CHARACTERISTIC
/begin CHARACTERISTIC KOUTP_FDCBCMHelpINDCmd_flg_minval "" VALUE 0x0000 /* @ECU_Address@KOUTP_FDCBCMHelpINDCmd_flg_minval@ */ Scalar_BOOLEAN 0 SWC_OUTP_type_CM_boolean_flg 0.0 1.0 /end CHARACTERISTIC
/begin CHARACTERISTIC KOUTP_FDCBCMHelpINDCmd_flg_ovrdflg "" VALUE 0x0000 /* @ECU_Address@KOUTP_FDCBCMHelpINDCmd_flg_ovrdflg@ */ Scalar_BOOLEAN 0 SWC_OUTP_type_CM_boolean_flg 0.0 1.0 /end CHARACTERISTIC
/begin CHARACTERISTIC KOUTP_FDCBCMHelpINDCmd_flg_ovrdval "" VALUE 0x0000 /* @ECU_Address@KOUTP_FDCBCMHelpINDCmd_flg_ovrdval@ */ Scalar_BOOLEAN 0 SWC_OUTP_type_CM_boolean_flg 0.0 1.0 /end CHARACTERISTIC
/begin CHARACTERISTIC KOUTP_FDCBCMInnerBuzzerCmd_flg_maxval "" VALUE 0x0000 /* @ECU_Address@KOUTP_FDCBCMInnerBuzzerCmd_flg_maxval@ */ Scalar_BOOLEAN 0 SWC_OUTP_type_CM_boolean_flg 0.0 1.0 /end CHARACTERISTIC
/begin CHARACTERISTIC KOUTP_FDCBCMInnerBuzzerCmd_flg_minval "" VALUE 0x0000 /* @ECU_Address@KOUTP_FDCBCMInnerBuzzerCmd_flg_minval@ */ Scalar_BOOLEAN 0 SWC_OUTP_type_CM_boolean_flg 0.0 1.0 /end CHARACTERISTIC
/begin CHARACTERISTIC KOUTP_FDCBCMInnerBuzzerCmd_flg_ovrdflg "" VALUE 0x0000 /* @ECU_Address@KOUTP_FDCBCMInnerBuzzerCmd_flg_ovrdflg@ */ Scalar_BOOLEAN 0 SWC_OUTP_type_CM_boolean_flg 0.0 1.0 /end CHARACTERISTIC
/begin CHARACTERISTIC KOUTP_FDCBCMInnerBuzzerCmd_flg_ovrdval "" VALUE 0x0000 /* @ECU_Address@KOUTP_FDCBCMInnerBuzzerCmd_flg_ovrdval@ */ Scalar_BOOLEAN 0 SWC_OUTP_type_CM_boolean_flg 0.0 1.0 /end CHARACTERISTIC
/begin CHARACTERISTIC KOUTP_FDCBCMInnerCallBellCmd_flg_maxval "" VALUE 0x0000 /* @ECU_Address@KOUTP_FDCBCMInnerCallBellCmd_flg_maxval@ */ Scalar_BOOLEAN 0 SWC_OUTP_type_CM_boolean_flg 0.0 1.0 /end CHARACTERISTIC
/begin CHARACTERISTIC KOUTP_FDCBCMInnerCallBellCmd_flg_minval "" VALUE 0x0000 /* @ECU_Address@KOUTP_FDCBCMInnerCallBellCmd_flg_minval@ */ Scalar_BOOLEAN 0 SWC_OUTP_type_CM_boolean_flg 0.0 1.0 /end CHARACTERISTIC
/begin CHARACTERISTIC KOUTP_FDCBCMInnerCallBellCmd_flg_ovrdflg "" VALUE 0x0000 /* @ECU_Address@KOUTP_FDCBCMInnerCallBellCmd_flg_ovrdflg@ */ Scalar_BOOLEAN 0 SWC_OUTP_type_CM_boolean_flg 0.0 1.0 /end CHARACTERISTIC
/begin CHARACTERISTIC KOUTP_FDCBCMInnerCallBellCmd_flg_ovrdval "" VALUE 0x0000 /* @ECU_Address@KOUTP_FDCBCMInnerCallBellCmd_flg_ovrdval@ */ Scalar_BOOLEAN 0 SWC_OUTP_type_CM_boolean_flg 0.0 1.0 /end CHARACTERISTIC
/begin CHARACTERISTIC KOUTP_FDCBCMLBSDRCmd_flg_maxval "" VALUE 0x0000 /* @ECU_Address@KOUTP_FDCBCMLBSDRCmd_flg_maxval@ */ Scalar_BOOLEAN 0 SWC_OUTP_type_CM_boolean_flg 0.0 1.0 /end CHARACTERISTIC
/begin CHARACTERISTIC KOUTP_FDCBCMLBSDRCmd_flg_minval "" VALUE 0x0000 /* @ECU_Address@KOUTP_FDCBCMLBSDRCmd_flg_minval@ */ Scalar_BOOLEAN 0 SWC_OUTP_type_CM_boolean_flg 0.0 1.0 /end CHARACTERISTIC
/begin CHARACTERISTIC KOUTP_FDCBCMLBSDRCmd_flg_ovrdflg "" VALUE 0x0000 /* @ECU_Address@KOUTP_FDCBCMLBSDRCmd_flg_ovrdflg@ */ Scalar_BOOLEAN 0 SWC_OUTP_type_CM_boolean_flg 0.0 1.0 /end CHARACTERISTIC
/begin CHARACTERISTIC KOUTP_FDCBCMLBSDRCmd_flg_ovrdval "" VALUE 0x0000 /* @ECU_Address@KOUTP_FDCBCMLBSDRCmd_flg_ovrdval@ */ Scalar_BOOLEAN 0 SWC_OUTP_type_CM_boolean_flg 0.0 1.0 /end CHARACTERISTIC
/begin CHARACTERISTIC KOUTP_FDCBCMLBSDYCmd_flg_maxval "" VALUE 0x0000 /* @ECU_Address@KOUTP_FDCBCMLBSDYCmd_flg_maxval@ */ Scalar_BOOLEAN 0 SWC_OUTP_type_CM_boolean_flg 0.0 1.0 /end CHARACTERISTIC
/begin CHARACTERISTIC KOUTP_FDCBCMLBSDYCmd_flg_minval "" VALUE 0x0000 /* @ECU_Address@KOUTP_FDCBCMLBSDYCmd_flg_minval@ */ Scalar_BOOLEAN 0 SWC_OUTP_type_CM_boolean_flg 0.0 1.0 /end CHARACTERISTIC
/begin CHARACTERISTIC KOUTP_FDCBCMLBSDYCmd_flg_ovrdflg "" VALUE 0x0000 /* @ECU_Address@KOUTP_FDCBCMLBSDYCmd_flg_ovrdflg@ */ Scalar_BOOLEAN 0 SWC_OUTP_type_CM_boolean_flg 0.0 1.0 /end CHARACTERISTIC
/begin CHARACTERISTIC KOUTP_FDCBCMLBSDYCmd_flg_ovrdval "" VALUE 0x0000 /* @ECU_Address@KOUTP_FDCBCMLBSDYCmd_flg_ovrdval@ */ Scalar_BOOLEAN 0 SWC_OUTP_type_CM_boolean_flg 0.0 1.0 /end CHARACTERISTIC
/begin CHARACTERISTIC KOUTP_FDCBCMLBeamCmd_flg_maxval "" VALUE 0x0000 /* @ECU_Address@KOUTP_FDCBCMLBeamCmd_flg_maxval@ */ Scalar_BOOLEAN 0 SWC_OUTP_type_CM_boolean_flg 0.0 1.0 /end CHARACTERISTIC
/begin CHARACTERISTIC KOUTP_FDCBCMLBeamCmd_flg_minval "" VALUE 0x0000 /* @ECU_Address@KOUTP_FDCBCMLBeamCmd_flg_minval@ */ Scalar_BOOLEAN 0 SWC_OUTP_type_CM_boolean_flg 0.0 1.0 /end CHARACTERISTIC
/begin CHARACTERISTIC KOUTP_FDCBCMLBeamCmd_flg_ovrdflg "" VALUE 0x0000 /* @ECU_Address@KOUTP_FDCBCMLBeamCmd_flg_ovrdflg@ */ Scalar_BOOLEAN 0 SWC_OUTP_type_CM_boolean_flg 0.0 1.0 /end CHARACTERISTIC
/begin CHARACTERISTIC KOUTP_FDCBCMLBeamCmd_flg_ovrdval "" VALUE 0x0000 /* @ECU_Address@KOUTP_FDCBCMLBeamCmd_flg_ovrdval@ */ Scalar_BOOLEAN 0 SWC_OUTP_type_CM_boolean_flg 0.0 1.0 /end CHARACTERISTIC
/begin CHARACTERISTIC KOUTP_FDCBCMLDRLCmd_flg_maxval "" VALUE 0x0000 /* @ECU_Address@KOUTP_FDCBCMLDRLCmd_flg_maxval@ */ Scalar_BOOLEAN 0 SWC_OUTP_type_CM_boolean_flg 0.0 1.0 /end CHARACTERISTIC
/begin CHARACTERISTIC KOUTP_FDCBCMLDRLCmd_flg_minval "" VALUE 0x0000 /* @ECU_Address@KOUTP_FDCBCMLDRLCmd_flg_minval@ */ Scalar_BOOLEAN 0 SWC_OUTP_type_CM_boolean_flg 0.0 1.0 /end CHARACTERISTIC
/begin CHARACTERISTIC KOUTP_FDCBCMLDRLCmd_flg_ovrdflg "" VALUE 0x0000 /* @ECU_Address@KOUTP_FDCBCMLDRLCmd_flg_ovrdflg@ */ Scalar_BOOLEAN 0 SWC_OUTP_type_CM_boolean_flg 0.0 1.0 /end CHARACTERISTIC
/begin CHARACTERISTIC KOUTP_FDCBCMLDRLCmd_flg_ovrdval "" VALUE 0x0000 /* @ECU_Address@KOUTP_FDCBCMLDRLCmd_flg_ovrdval@ */ Scalar_BOOLEAN 0 SWC_OUTP_type_CM_boolean_flg 0.0 1.0 /end CHARACTERISTIC
/begin CHARACTERISTIC KOUTP_FDCBCMLTurnLpCmd_flg_maxval "" VALUE 0x0000 /* @ECU_Address@KOUTP_FDCBCMLTurnLpCmd_flg_maxval@ */ Scalar_BOOLEAN 0 SWC_OUTP_type_CM_boolean_flg 0.0 1.0 /end CHARACTERISTIC
/begin CHARACTERISTIC KOUTP_FDCBCMLTurnLpCmd_flg_minval "" VALUE 0x0000 /* @ECU_Address@KOUTP_FDCBCMLTurnLpCmd_flg_minval@ */ Scalar_BOOLEAN 0 SWC_OUTP_type_CM_boolean_flg 0.0 1.0 /end CHARACTERISTIC
/begin CHARACTERISTIC KOUTP_FDCBCMLTurnLpCmd_flg_ovrdflg "" VALUE 0x0000 /* @ECU_Address@KOUTP_FDCBCMLTurnLpCmd_flg_ovrdflg@ */ Scalar_BOOLEAN 0 SWC_OUTP_type_CM_boolean_flg 0.0 1.0 /end CHARACTERISTIC
/begin CHARACTERISTIC KOUTP_FDCBCMLTurnLpCmd_flg_ovrdval "" VALUE 0x0000 /* @ECU_Address@KOUTP_FDCBCMLTurnLpCmd_flg_ovrdval@ */ Scalar_BOOLEAN 0 SWC_OUTP_type_CM_boolean_flg 0.0 1.0 /end CHARACTERISTIC
/begin CHARACTERISTIC KOUTP_FDCBCMLTurnSWSta_flg_maxval "" VALUE 0x0000 /* @ECU_Address@KOUTP_FDCBCMLTurnSWSta_flg_maxval@ */ Scalar_BOOLEAN 0 SWC_OUTP_type_CM_boolean_flg 0.0 1.0 /end CHARACTERISTIC
/begin CHARACTERISTIC KOUTP_FDCBCMLTurnSWSta_flg_minval "" VALUE 0x0000 /* @ECU_Address@KOUTP_FDCBCMLTurnSWSta_flg_minval@ */ Scalar_BOOLEAN 0 SWC_OUTP_type_CM_boolean_flg 0.0 1.0 /end CHARACTERISTIC
/begin CHARACTERISTIC KOUTP_FDCBCMLTurnSWSta_flg_ovrdflg "" VALUE 0x0000 /* @ECU_Address@KOUTP_FDCBCMLTurnSWSta_flg_ovrdflg@ */ Scalar_BOOLEAN 0 SWC_OUTP_type_CM_boolean_flg 0.0 1.0 /end CHARACTERISTIC
/begin CHARACTERISTIC KOUTP_FDCBCMLTurnSWSta_flg_ovrdval "" VALUE 0x0000 /* @ECU_Address@KOUTP_FDCBCMLTurnSWSta_flg_ovrdval@ */ Scalar_BOOLEAN 0 SWC_OUTP_type_CM_boolean_flg 0.0 1.0 /end CHARACTERISTIC
/begin CHARACTERISTIC KOUTP_FDCBCMMDCloseSVCmd_flg_maxval "" VALUE 0x0000 /* @ECU_Address@KOUTP_FDCBCMMDCloseSVCmd_flg_maxval@ */ Scalar_BOOLEAN 0 SWC_OUTP_type_CM_boolean_flg 0.0 1.0 /end CHARACTERISTIC
/begin CHARACTERISTIC KOUTP_FDCBCMMDCloseSVCmd_flg_minval "" VALUE 0x0000 /* @ECU_Address@KOUTP_FDCBCMMDCloseSVCmd_flg_minval@ */ Scalar_BOOLEAN 0 SWC_OUTP_type_CM_boolean_flg 0.0 1.0 /end CHARACTERISTIC
/begin CHARACTERISTIC KOUTP_FDCBCMMDCloseSVCmd_flg_ovrdflg "" VALUE 0x0000 /* @ECU_Address@KOUTP_FDCBCMMDCloseSVCmd_flg_ovrdflg@ */ Scalar_BOOLEAN 0 SWC_OUTP_type_CM_boolean_flg 0.0 1.0 /end CHARACTERISTIC
/begin CHARACTERISTIC KOUTP_FDCBCMMDCloseSVCmd_flg_ovrdval "" VALUE 0x0000 /* @ECU_Address@KOUTP_FDCBCMMDCloseSVCmd_flg_ovrdval@ */ Scalar_BOOLEAN 0 SWC_OUTP_type_CM_boolean_flg 0.0 1.0 /end CHARACTERISTIC
/begin CHARACTERISTIC KOUTP_FDCBCMMDOpenSVCmd_flg_maxval "" VALUE 0x0000 /* @ECU_Address@KOUTP_FDCBCMMDOpenSVCmd_flg_maxval@ */ Scalar_BOOLEAN 0 SWC_OUTP_type_CM_boolean_flg 0.0 1.0 /end CHARACTERISTIC
/begin CHARACTERISTIC KOUTP_FDCBCMMDOpenSVCmd_flg_minval "" VALUE 0x0000 /* @ECU_Address@KOUTP_FDCBCMMDOpenSVCmd_flg_minval@ */ Scalar_BOOLEAN 0 SWC_OUTP_type_CM_boolean_flg 0.0 1.0 /end CHARACTERISTIC
/begin CHARACTERISTIC KOUTP_FDCBCMMDOpenSVCmd_flg_ovrdflg "" VALUE 0x0000 /* @ECU_Address@KOUTP_FDCBCMMDOpenSVCmd_flg_ovrdflg@ */ Scalar_BOOLEAN 0 SWC_OUTP_type_CM_boolean_flg 0.0 1.0 /end CHARACTERISTIC
/begin CHARACTERISTIC KOUTP_FDCBCMMDOpenSVCmd_flg_ovrdval "" VALUE 0x0000 /* @ECU_Address@KOUTP_FDCBCMMDOpenSVCmd_flg_ovrdval@ */ Scalar_BOOLEAN 0 SWC_OUTP_type_CM_boolean_flg 0.0 1.0 /end CHARACTERISTIC
/begin CHARACTERISTIC KOUTP_FDCBCMMDoorSta_flg_maxval "" VALUE 0x0000 /* @ECU_Address@KOUTP_FDCBCMMDoorSta_flg_maxval@ */ Scalar_BOOLEAN 0 SWC_OUTP_type_CM_boolean_flg 0.0 1.0 /end CHARACTERISTIC
/begin CHARACTERISTIC KOUTP_FDCBCMMDoorSta_flg_minval "" VALUE 0x0000 /* @ECU_Address@KOUTP_FDCBCMMDoorSta_flg_minval@ */ Scalar_BOOLEAN 0 SWC_OUTP_type_CM_boolean_flg 0.0 1.0 /end CHARACTERISTIC
/begin CHARACTERISTIC KOUTP_FDCBCMMDoorSta_flg_ovrdflg "" VALUE 0x0000 /* @ECU_Address@KOUTP_FDCBCMMDoorSta_flg_ovrdflg@ */ Scalar_BOOLEAN 0 SWC_OUTP_type_CM_boolean_flg 0.0 1.0 /end CHARACTERISTIC
/begin CHARACTERISTIC KOUTP_FDCBCMMDoorSta_flg_ovrdval "" VALUE 0x0000 /* @ECU_Address@KOUTP_FDCBCMMDoorSta_flg_ovrdval@ */ Scalar_BOOLEAN 0 SWC_OUTP_type_CM_boolean_flg 0.0 1.0 /end CHARACTERISTIC
/begin CHARACTERISTIC KOUTP_FDCBCMMRoomLpCmd_pct_ovrdflg "" VALUE 0x0000 /* @ECU_Address@KOUTP_FDCBCMMRoomLpCmd_pct_ovrdflg@ */ Scalar_BOOLEAN 0 SWC_OUTP_type_CM_boolean_flg 0.0 1.0 /end CHARACTERISTIC
/begin CHARACTERISTIC KOUTP_FDCBCMMRoomLpSetSta_pct_ovrdflg "" VALUE 0x0000 /* @ECU_Address@KOUTP_FDCBCMMRoomLpSetSta_pct_ovrdflg@ */ Scalar_BOOLEAN 0 SWC_OUTP_type_CM_boolean_flg 0.0 1.0 /end CHARACTERISTIC
/begin CHARACTERISTIC KOUTP_FDCBCMOSDrOpenSWSta_enum_ovrdflg "" VALUE 0x0000 /* @ECU_Address@KOUTP_FDCBCMOSDrOpenSWSta_enum_ovrdflg@ */ Scalar_BOOLEAN 0 SWC_OUTP_type_CM_boolean_flg 0.0 1.0 /end CHARACTERISTIC
/begin CHARACTERISTIC KOUTP_FDCBCMPLampCmd_flg_maxval "" VALUE 0x0000 /* @ECU_Address@KOUTP_FDCBCMPLampCmd_flg_maxval@ */ Scalar_BOOLEAN 0 SWC_OUTP_type_CM_boolean_flg 0.0 1.0 /end CHARACTERISTIC
/begin CHARACTERISTIC KOUTP_FDCBCMPLampCmd_flg_minval "" VALUE 0x0000 /* @ECU_Address@KOUTP_FDCBCMPLampCmd_flg_minval@ */ Scalar_BOOLEAN 0 SWC_OUTP_type_CM_boolean_flg 0.0 1.0 /end CHARACTERISTIC
/begin CHARACTERISTIC KOUTP_FDCBCMPLampCmd_flg_ovrdflg "" VALUE 0x0000 /* @ECU_Address@KOUTP_FDCBCMPLampCmd_flg_ovrdflg@ */ Scalar_BOOLEAN 0 SWC_OUTP_type_CM_boolean_flg 0.0 1.0 /end CHARACTERISTIC
/begin CHARACTERISTIC KOUTP_FDCBCMPLampCmd_flg_ovrdval "" VALUE 0x0000 /* @ECU_Address@KOUTP_FDCBCMPLampCmd_flg_ovrdval@ */ Scalar_BOOLEAN 0 SWC_OUTP_type_CM_boolean_flg 0.0 1.0 /end CHARACTERISTIC
/begin CHARACTERISTIC KOUTP_FDCBCMRBSDRCmd_flg_maxval "" VALUE 0x0000 /* @ECU_Address@KOUTP_FDCBCMRBSDRCmd_flg_maxval@ */ Scalar_BOOLEAN 0 SWC_OUTP_type_CM_boolean_flg 0.0 1.0 /end CHARACTERISTIC
/begin CHARACTERISTIC KOUTP_FDCBCMRBSDRCmd_flg_minval "" VALUE 0x0000 /* @ECU_Address@KOUTP_FDCBCMRBSDRCmd_flg_minval@ */ Scalar_BOOLEAN 0 SWC_OUTP_type_CM_boolean_flg 0.0 1.0 /end CHARACTERISTIC
/begin CHARACTERISTIC KOUTP_FDCBCMRBSDRCmd_flg_ovrdflg "" VALUE 0x0000 /* @ECU_Address@KOUTP_FDCBCMRBSDRCmd_flg_ovrdflg@ */ Scalar_BOOLEAN 0 SWC_OUTP_type_CM_boolean_flg 0.0 1.0 /end CHARACTERISTIC
/begin CHARACTERISTIC KOUTP_FDCBCMRBSDRCmd_flg_ovrdval "" VALUE 0x0000 /* @ECU_Address@KOUTP_FDCBCMRBSDRCmd_flg_ovrdval@ */ Scalar_BOOLEAN 0 SWC_OUTP_type_CM_boolean_flg 0.0 1.0 /end CHARACTERISTIC
/begin CHARACTERISTIC KOUTP_FDCBCMRBSDYCmd_flg_maxval "" VALUE 0x0000 /* @ECU_Address@KOUTP_FDCBCMRBSDYCmd_flg_maxval@ */ Scalar_BOOLEAN 0 SWC_OUTP_type_CM_boolean_flg 0.0 1.0 /end CHARACTERISTIC
/begin CHARACTERISTIC KOUTP_FDCBCMRBSDYCmd_flg_minval "" VALUE 0x0000 /* @ECU_Address@KOUTP_FDCBCMRBSDYCmd_flg_minval@ */ Scalar_BOOLEAN 0 SWC_OUTP_type_CM_boolean_flg 0.0 1.0 /end CHARACTERISTIC
/begin CHARACTERISTIC KOUTP_FDCBCMRBSDYCmd_flg_ovrdflg "" VALUE 0x0000 /* @ECU_Address@KOUTP_FDCBCMRBSDYCmd_flg_ovrdflg@ */ Scalar_BOOLEAN 0 SWC_OUTP_type_CM_boolean_flg 0.0 1.0 /end CHARACTERISTIC
/begin CHARACTERISTIC KOUTP_FDCBCMRBSDYCmd_flg_ovrdval "" VALUE 0x0000 /* @ECU_Address@KOUTP_FDCBCMRBSDYCmd_flg_ovrdval@ */ Scalar_BOOLEAN 0 SWC_OUTP_type_CM_boolean_flg 0.0 1.0 /end CHARACTERISTIC
/begin CHARACTERISTIC KOUTP_FDCBCMRDRLCmd_flg_maxval "" VALUE 0x0000 /* @ECU_Address@KOUTP_FDCBCMRDRLCmd_flg_maxval@ */ Scalar_BOOLEAN 0 SWC_OUTP_type_CM_boolean_flg 0.0 1.0 /end CHARACTERISTIC
/begin CHARACTERISTIC KOUTP_FDCBCMRDRLCmd_flg_minval "" VALUE 0x0000 /* @ECU_Address@KOUTP_FDCBCMRDRLCmd_flg_minval@ */ Scalar_BOOLEAN 0 SWC_OUTP_type_CM_boolean_flg 0.0 1.0 /end CHARACTERISTIC
/begin CHARACTERISTIC KOUTP_FDCBCMRDRLCmd_flg_ovrdflg "" VALUE 0x0000 /* @ECU_Address@KOUTP_FDCBCMRDRLCmd_flg_ovrdflg@ */ Scalar_BOOLEAN 0 SWC_OUTP_type_CM_boolean_flg 0.0 1.0 /end CHARACTERISTIC
/begin CHARACTERISTIC KOUTP_FDCBCMRDRLCmd_flg_ovrdval "" VALUE 0x0000 /* @ECU_Address@KOUTP_FDCBCMRDRLCmd_flg_ovrdval@ */ Scalar_BOOLEAN 0 SWC_OUTP_type_CM_boolean_flg 0.0 1.0 /end CHARACTERISTIC
/begin CHARACTERISTIC KOUTP_FDCBCMRDoorSta_flg_maxval "" VALUE 0x0000 /* @ECU_Address@KOUTP_FDCBCMRDoorSta_flg_maxval@ */ Scalar_BOOLEAN 0 SWC_OUTP_type_CM_boolean_flg 0.0 1.0 /end CHARACTERISTIC
/begin CHARACTERISTIC KOUTP_FDCBCMRDoorSta_flg_minval "" VALUE 0x0000 /* @ECU_Address@KOUTP_FDCBCMRDoorSta_flg_minval@ */ Scalar_BOOLEAN 0 SWC_OUTP_type_CM_boolean_flg 0.0 1.0 /end CHARACTERISTIC
/begin CHARACTERISTIC KOUTP_FDCBCMRDoorSta_flg_ovrdflg "" VALUE 0x0000 /* @ECU_Address@KOUTP_FDCBCMRDoorSta_flg_ovrdflg@ */ Scalar_BOOLEAN 0 SWC_OUTP_type_CM_boolean_flg 0.0 1.0 /end CHARACTERISTIC
/begin CHARACTERISTIC KOUTP_FDCBCMRDoorSta_flg_ovrdval "" VALUE 0x0000 /* @ECU_Address@KOUTP_FDCBCMRDoorSta_flg_ovrdval@ */ Scalar_BOOLEAN 0 SWC_OUTP_type_CM_boolean_flg 0.0 1.0 /end CHARACTERISTIC
/begin CHARACTERISTIC KOUTP_FDCBCMRFLampCmd_flg_maxval "" VALUE 0x0000 /* @ECU_Address@KOUTP_FDCBCMRFLampCmd_flg_maxval@ */ Scalar_BOOLEAN 0 SWC_OUTP_type_CM_boolean_flg 0.0 1.0 /end CHARACTERISTIC
/begin CHARACTERISTIC KOUTP_FDCBCMRFLampCmd_flg_minval "" VALUE 0x0000 /* @ECU_Address@KOUTP_FDCBCMRFLampCmd_flg_minval@ */ Scalar_BOOLEAN 0 SWC_OUTP_type_CM_boolean_flg 0.0 1.0 /end CHARACTERISTIC
/begin CHARACTERISTIC KOUTP_FDCBCMRFLampCmd_flg_ovrdflg "" VALUE 0x0000 /* @ECU_Address@KOUTP_FDCBCMRFLampCmd_flg_ovrdflg@ */ Scalar_BOOLEAN 0 SWC_OUTP_type_CM_boolean_flg 0.0 1.0 /end CHARACTERISTIC
/begin CHARACTERISTIC KOUTP_FDCBCMRFLampCmd_flg_ovrdval "" VALUE 0x0000 /* @ECU_Address@KOUTP_FDCBCMRFLampCmd_flg_ovrdval@ */ Scalar_BOOLEAN 0 SWC_OUTP_type_CM_boolean_flg 0.0 1.0 /end CHARACTERISTIC
/begin CHARACTERISTIC KOUTP_FDCBCMRGearSta_flg_maxval "" VALUE 0x0000 /* @ECU_Address@KOUTP_FDCBCMRGearSta_flg_maxval@ */ Scalar_BOOLEAN 0 SWC_OUTP_type_CM_boolean_flg 0.0 1.0 /end CHARACTERISTIC
/begin CHARACTERISTIC KOUTP_FDCBCMRGearSta_flg_minval "" VALUE 0x0000 /* @ECU_Address@KOUTP_FDCBCMRGearSta_flg_minval@ */ Scalar_BOOLEAN 0 SWC_OUTP_type_CM_boolean_flg 0.0 1.0 /end CHARACTERISTIC
/begin CHARACTERISTIC KOUTP_FDCBCMRGearSta_flg_ovrdflg "" VALUE 0x0000 /* @ECU_Address@KOUTP_FDCBCMRGearSta_flg_ovrdflg@ */ Scalar_BOOLEAN 0 SWC_OUTP_type_CM_boolean_flg 0.0 1.0 /end CHARACTERISTIC
/begin CHARACTERISTIC KOUTP_FDCBCMRGearSta_flg_ovrdval "" VALUE 0x0000 /* @ECU_Address@KOUTP_FDCBCMRGearSta_flg_ovrdval@ */ Scalar_BOOLEAN 0 SWC_OUTP_type_CM_boolean_flg 0.0 1.0 /end CHARACTERISTIC
/begin CHARACTERISTIC KOUTP_FDCBCMRRoomLpCmd_pct_ovrdflg "" VALUE 0x0000 /* @ECU_Address@KOUTP_FDCBCMRRoomLpCmd_pct_ovrdflg@ */ Scalar_BOOLEAN 0 SWC_OUTP_type_CM_boolean_flg 0.0 1.0 /end CHARACTERISTIC
/begin CHARACTERISTIC KOUTP_FDCBCMRRoomLpSetSta_pct_ovrdflg "" VALUE 0x0000 /* @ECU_Address@KOUTP_FDCBCMRRoomLpSetSta_pct_ovrdflg@ */ Scalar_BOOLEAN 0 SWC_OUTP_type_CM_boolean_flg 0.0 1.0 /end CHARACTERISTIC
/begin CHARACTERISTIC KOUTP_FDCBCMRTurnLpCmd_flg_maxval "" VALUE 0x0000 /* @ECU_Address@KOUTP_FDCBCMRTurnLpCmd_flg_maxval@ */ Scalar_BOOLEAN 0 SWC_OUTP_type_CM_boolean_flg 0.0 1.0 /end CHARACTERISTIC
/begin CHARACTERISTIC KOUTP_FDCBCMRTurnLpCmd_flg_minval "" VALUE 0x0000 /* @ECU_Address@KOUTP_FDCBCMRTurnLpCmd_flg_minval@ */ Scalar_BOOLEAN 0 SWC_OUTP_type_CM_boolean_flg 0.0 1.0 /end CHARACTERISTIC
/begin CHARACTERISTIC KOUTP_FDCBCMRTurnLpCmd_flg_ovrdflg "" VALUE 0x0000 /* @ECU_Address@KOUTP_FDCBCMRTurnLpCmd_flg_ovrdflg@ */ Scalar_BOOLEAN 0 SWC_OUTP_type_CM_boolean_flg 0.0 1.0 /end CHARACTERISTIC
/begin CHARACTERISTIC KOUTP_FDCBCMRTurnLpCmd_flg_ovrdval "" VALUE 0x0000 /* @ECU_Address@KOUTP_FDCBCMRTurnLpCmd_flg_ovrdval@ */ Scalar_BOOLEAN 0 SWC_OUTP_type_CM_boolean_flg 0.0 1.0 /end CHARACTERISTIC
/begin CHARACTERISTIC KOUTP_FDCBCMRTurnSWSta_flg_maxval "" VALUE 0x0000 /* @ECU_Address@KOUTP_FDCBCMRTurnSWSta_flg_maxval@ */ Scalar_BOOLEAN 0 SWC_OUTP_type_CM_boolean_flg 0.0 1.0 /end CHARACTERISTIC
/begin CHARACTERISTIC KOUTP_FDCBCMRTurnSWSta_flg_minval "" VALUE 0x0000 /* @ECU_Address@KOUTP_FDCBCMRTurnSWSta_flg_minval@ */ Scalar_BOOLEAN 0 SWC_OUTP_type_CM_boolean_flg 0.0 1.0 /end CHARACTERISTIC
/begin CHARACTERISTIC KOUTP_FDCBCMRTurnSWSta_flg_ovrdflg "" VALUE 0x0000 /* @ECU_Address@KOUTP_FDCBCMRTurnSWSta_flg_ovrdflg@ */ Scalar_BOOLEAN 0 SWC_OUTP_type_CM_boolean_flg 0.0 1.0 /end CHARACTERISTIC
/begin CHARACTERISTIC KOUTP_FDCBCMRTurnSWSta_flg_ovrdval "" VALUE 0x0000 /* @ECU_Address@KOUTP_FDCBCMRTurnSWSta_flg_ovrdval@ */ Scalar_BOOLEAN 0 SWC_OUTP_type_CM_boolean_flg 0.0 1.0 /end CHARACTERISTIC
/begin CHARACTERISTIC KOUTP_FDCBCMRoomLpAmbCmd_flg_maxval "" VALUE 0x0000 /* @ECU_Address@KOUTP_FDCBCMRoomLpAmbCmd_flg_maxval@ */ Scalar_BOOLEAN 0 SWC_OUTP_type_CM_boolean_flg 0.0 1.0 /end CHARACTERISTIC
/begin CHARACTERISTIC KOUTP_FDCBCMRoomLpAmbCmd_flg_minval "" VALUE 0x0000 /* @ECU_Address@KOUTP_FDCBCMRoomLpAmbCmd_flg_minval@ */ Scalar_BOOLEAN 0 SWC_OUTP_type_CM_boolean_flg 0.0 1.0 /end CHARACTERISTIC
/begin CHARACTERISTIC KOUTP_FDCBCMRoomLpAmbCmd_flg_ovrdflg "" VALUE 0x0000 /* @ECU_Address@KOUTP_FDCBCMRoomLpAmbCmd_flg_ovrdflg@ */ Scalar_BOOLEAN 0 SWC_OUTP_type_CM_boolean_flg 0.0 1.0 /end CHARACTERISTIC
/begin CHARACTERISTIC KOUTP_FDCBCMRoomLpAmbCmd_flg_ovrdval "" VALUE 0x0000 /* @ECU_Address@KOUTP_FDCBCMRoomLpAmbCmd_flg_ovrdval@ */ Scalar_BOOLEAN 0 SWC_OUTP_type_CM_boolean_flg 0.0 1.0 /end CHARACTERISTIC
/begin CHARACTERISTIC KOUTP_FDCBCMRoomLpAmbSetSta_flg_maxval "" VALUE 0x0000 /* @ECU_Address@KOUTP_FDCBCMRoomLpAmbSetSta_flg_maxval@ */ Scalar_BOOLEAN 0 SWC_OUTP_type_CM_boolean_flg 0.0 1.0 /end CHARACTERISTIC
/begin CHARACTERISTIC KOUTP_FDCBCMRoomLpAmbSetSta_flg_minval "" VALUE 0x0000 /* @ECU_Address@KOUTP_FDCBCMRoomLpAmbSetSta_flg_minval@ */ Scalar_BOOLEAN 0 SWC_OUTP_type_CM_boolean_flg 0.0 1.0 /end CHARACTERISTIC
/begin CHARACTERISTIC KOUTP_FDCBCMRoomLpAmbSetSta_flg_ovrdflg "" VALUE 0x0000 /* @ECU_Address@KOUTP_FDCBCMRoomLpAmbSetSta_flg_ovrdflg@ */ Scalar_BOOLEAN 0 SWC_OUTP_type_CM_boolean_flg 0.0 1.0 /end CHARACTERISTIC
/begin CHARACTERISTIC KOUTP_FDCBCMRoomLpAmbSetSta_flg_ovrdval "" VALUE 0x0000 /* @ECU_Address@KOUTP_FDCBCMRoomLpAmbSetSta_flg_ovrdval@ */ Scalar_BOOLEAN 0 SWC_OUTP_type_CM_boolean_flg 0.0 1.0 /end CHARACTERISTIC
/begin CHARACTERISTIC KOUTP_FDCBCMRoomLpSetSta_flg_maxval "" VALUE 0x0000 /* @ECU_Address@KOUTP_FDCBCMRoomLpSetSta_flg_maxval@ */ Scalar_BOOLEAN 0 SWC_OUTP_type_CM_boolean_flg 0.0 1.0 /end CHARACTERISTIC
/begin CHARACTERISTIC KOUTP_FDCBCMRoomLpSetSta_flg_minval "" VALUE 0x0000 /* @ECU_Address@KOUTP_FDCBCMRoomLpSetSta_flg_minval@ */ Scalar_BOOLEAN 0 SWC_OUTP_type_CM_boolean_flg 0.0 1.0 /end CHARACTERISTIC
/begin CHARACTERISTIC KOUTP_FDCBCMRoomLpSetSta_flg_ovrdflg "" VALUE 0x0000 /* @ECU_Address@KOUTP_FDCBCMRoomLpSetSta_flg_ovrdflg@ */ Scalar_BOOLEAN 0 SWC_OUTP_type_CM_boolean_flg 0.0 1.0 /end CHARACTERISTIC
/begin CHARACTERISTIC KOUTP_FDCBCMRoomLpSetSta_flg_ovrdval "" VALUE 0x0000 /* @ECU_Address@KOUTP_FDCBCMRoomLpSetSta_flg_ovrdval@ */ Scalar_BOOLEAN 0 SWC_OUTP_type_CM_boolean_flg 0.0 1.0 /end CHARACTERISTIC
/begin CHARACTERISTIC KOUTP_FDCBCMSLTLpCmd_flg_maxval "" VALUE 0x0000 /* @ECU_Address@KOUTP_FDCBCMSLTLpCmd_flg_maxval@ */ Scalar_BOOLEAN 0 SWC_OUTP_type_CM_boolean_flg 0.0 1.0 /end CHARACTERISTIC
/begin CHARACTERISTIC KOUTP_FDCBCMSLTLpCmd_flg_minval "" VALUE 0x0000 /* @ECU_Address@KOUTP_FDCBCMSLTLpCmd_flg_minval@ */ Scalar_BOOLEAN 0 SWC_OUTP_type_CM_boolean_flg 0.0 1.0 /end CHARACTERISTIC
/begin CHARACTERISTIC KOUTP_FDCBCMSLTLpCmd_flg_ovrdflg "" VALUE 0x0000 /* @ECU_Address@KOUTP_FDCBCMSLTLpCmd_flg_ovrdflg@ */ Scalar_BOOLEAN 0 SWC_OUTP_type_CM_boolean_flg 0.0 1.0 /end CHARACTERISTIC
/begin CHARACTERISTIC KOUTP_FDCBCMSLTLpCmd_flg_ovrdval "" VALUE 0x0000 /* @ECU_Address@KOUTP_FDCBCMSLTLpCmd_flg_ovrdval@ */ Scalar_BOOLEAN 0 SWC_OUTP_type_CM_boolean_flg 0.0 1.0 /end CHARACTERISTIC
/begin CHARACTERISTIC KOUTP_FDCBCMSMKLCmd_flg_maxval "" VALUE 0x0000 /* @ECU_Address@KOUTP_FDCBCMSMKLCmd_flg_maxval@ */ Scalar_BOOLEAN 0 SWC_OUTP_type_CM_boolean_flg 0.0 1.0 /end CHARACTERISTIC
/begin CHARACTERISTIC KOUTP_FDCBCMSMKLCmd_flg_minval "" VALUE 0x0000 /* @ECU_Address@KOUTP_FDCBCMSMKLCmd_flg_minval@ */ Scalar_BOOLEAN 0 SWC_OUTP_type_CM_boolean_flg 0.0 1.0 /end CHARACTERISTIC
/begin CHARACTERISTIC KOUTP_FDCBCMSMKLCmd_flg_ovrdflg "" VALUE 0x0000 /* @ECU_Address@KOUTP_FDCBCMSMKLCmd_flg_ovrdflg@ */ Scalar_BOOLEAN 0 SWC_OUTP_type_CM_boolean_flg 0.0 1.0 /end CHARACTERISTIC
/begin CHARACTERISTIC KOUTP_FDCBCMSMKLCmd_flg_ovrdval "" VALUE 0x0000 /* @ECU_Address@KOUTP_FDCBCMSMKLCmd_flg_ovrdval@ */ Scalar_BOOLEAN 0 SWC_OUTP_type_CM_boolean_flg 0.0 1.0 /end CHARACTERISTIC
/begin CHARACTERISTIC KOUTP_FDCBCMSMKRCmd_flg_maxval "" VALUE 0x0000 /* @ECU_Address@KOUTP_FDCBCMSMKRCmd_flg_maxval@ */ Scalar_BOOLEAN 0 SWC_OUTP_type_CM_boolean_flg 0.0 1.0 /end CHARACTERISTIC
/begin CHARACTERISTIC KOUTP_FDCBCMSMKRCmd_flg_minval "" VALUE 0x0000 /* @ECU_Address@KOUTP_FDCBCMSMKRCmd_flg_minval@ */ Scalar_BOOLEAN 0 SWC_OUTP_type_CM_boolean_flg 0.0 1.0 /end CHARACTERISTIC
/begin CHARACTERISTIC KOUTP_FDCBCMSMKRCmd_flg_ovrdflg "" VALUE 0x0000 /* @ECU_Address@KOUTP_FDCBCMSMKRCmd_flg_ovrdflg@ */ Scalar_BOOLEAN 0 SWC_OUTP_type_CM_boolean_flg 0.0 1.0 /end CHARACTERISTIC
/begin CHARACTERISTIC KOUTP_FDCBCMSMKRCmd_flg_ovrdval "" VALUE 0x0000 /* @ECU_Address@KOUTP_FDCBCMSMKRCmd_flg_ovrdval@ */ Scalar_BOOLEAN 0 SWC_OUTP_type_CM_boolean_flg 0.0 1.0 /end CHARACTERISTIC
/begin CHARACTERISTIC KOUTP_FDCBCMSRTLpCmd_flg_maxval "" VALUE 0x0000 /* @ECU_Address@KOUTP_FDCBCMSRTLpCmd_flg_maxval@ */ Scalar_BOOLEAN 0 SWC_OUTP_type_CM_boolean_flg 0.0 1.0 /end CHARACTERISTIC
/begin CHARACTERISTIC KOUTP_FDCBCMSRTLpCmd_flg_minval "" VALUE 0x0000 /* @ECU_Address@KOUTP_FDCBCMSRTLpCmd_flg_minval@ */ Scalar_BOOLEAN 0 SWC_OUTP_type_CM_boolean_flg 0.0 1.0 /end CHARACTERISTIC
/begin CHARACTERISTIC KOUTP_FDCBCMSRTLpCmd_flg_ovrdflg "" VALUE 0x0000 /* @ECU_Address@KOUTP_FDCBCMSRTLpCmd_flg_ovrdflg@ */ Scalar_BOOLEAN 0 SWC_OUTP_type_CM_boolean_flg 0.0 1.0 /end CHARACTERISTIC
/begin CHARACTERISTIC KOUTP_FDCBCMSRTLpCmd_flg_ovrdval "" VALUE 0x0000 /* @ECU_Address@KOUTP_FDCBCMSRTLpCmd_flg_ovrdval@ */ Scalar_BOOLEAN 0 SWC_OUTP_type_CM_boolean_flg 0.0 1.0 /end CHARACTERISTIC
/begin CHARACTERISTIC KOUTP_FDCBCMSTOPBALLCmd_flg_maxval "" VALUE 0x0000 /* @ECU_Address@KOUTP_FDCBCMSTOPBALLCmd_flg_maxval@ */ Scalar_BOOLEAN 0 SWC_OUTP_type_CM_boolean_flg 0.0 1.0 /end CHARACTERISTIC
/begin CHARACTERISTIC KOUTP_FDCBCMSTOPBALLCmd_flg_minval "" VALUE 0x0000 /* @ECU_Address@KOUTP_FDCBCMSTOPBALLCmd_flg_minval@ */ Scalar_BOOLEAN 0 SWC_OUTP_type_CM_boolean_flg 0.0 1.0 /end CHARACTERISTIC
/begin CHARACTERISTIC KOUTP_FDCBCMSTOPBALLCmd_flg_ovrdflg "" VALUE 0x0000 /* @ECU_Address@KOUTP_FDCBCMSTOPBALLCmd_flg_ovrdflg@ */ Scalar_BOOLEAN 0 SWC_OUTP_type_CM_boolean_flg 0.0 1.0 /end CHARACTERISTIC
/begin CHARACTERISTIC KOUTP_FDCBCMSTOPBALLCmd_flg_ovrdval "" VALUE 0x0000 /* @ECU_Address@KOUTP_FDCBCMSTOPBALLCmd_flg_ovrdval@ */ Scalar_BOOLEAN 0 SWC_OUTP_type_CM_boolean_flg 0.0 1.0 /end CHARACTERISTIC
/begin CHARACTERISTIC KOUTP_FDCBCMStopINDCmd_flg_maxval "" VALUE 0x0000 /* @ECU_Address@KOUTP_FDCBCMStopINDCmd_flg_maxval@ */ Scalar_BOOLEAN 0 SWC_OUTP_type_CM_boolean_flg 0.0 1.0 /end CHARACTERISTIC
/begin CHARACTERISTIC KOUTP_FDCBCMStopINDCmd_flg_minval "" VALUE 0x0000 /* @ECU_Address@KOUTP_FDCBCMStopINDCmd_flg_minval@ */ Scalar_BOOLEAN 0 SWC_OUTP_type_CM_boolean_flg 0.0 1.0 /end CHARACTERISTIC
/begin CHARACTERISTIC KOUTP_FDCBCMStopINDCmd_flg_ovrdflg "" VALUE 0x0000 /* @ECU_Address@KOUTP_FDCBCMStopINDCmd_flg_ovrdflg@ */ Scalar_BOOLEAN 0 SWC_OUTP_type_CM_boolean_flg 0.0 1.0 /end CHARACTERISTIC
/begin CHARACTERISTIC KOUTP_FDCBCMStopINDCmd_flg_ovrdval "" VALUE 0x0000 /* @ECU_Address@KOUTP_FDCBCMStopINDCmd_flg_ovrdval@ */ Scalar_BOOLEAN 0 SWC_OUTP_type_CM_boolean_flg 0.0 1.0 /end CHARACTERISTIC
/begin CHARACTERISTIC KOUTP_FDCBCMTurnBuzzerENSta_flg_maxval "" VALUE 0x0000 /* @ECU_Address@KOUTP_FDCBCMTurnBuzzerENSta_flg_maxval@ */ Scalar_BOOLEAN 0 SWC_OUTP_type_CM_boolean_flg 0.0 1.0 /end CHARACTERISTIC
/begin CHARACTERISTIC KOUTP_FDCBCMTurnBuzzerENSta_flg_minval "" VALUE 0x0000 /* @ECU_Address@KOUTP_FDCBCMTurnBuzzerENSta_flg_minval@ */ Scalar_BOOLEAN 0 SWC_OUTP_type_CM_boolean_flg 0.0 1.0 /end CHARACTERISTIC
/begin CHARACTERISTIC KOUTP_FDCBCMTurnBuzzerENSta_flg_ovrdflg "" VALUE 0x0000 /* @ECU_Address@KOUTP_FDCBCMTurnBuzzerENSta_flg_ovrdflg@ */ Scalar_BOOLEAN 0 SWC_OUTP_type_CM_boolean_flg 0.0 1.0 /end CHARACTERISTIC
/begin CHARACTERISTIC KOUTP_FDCBCMTurnBuzzerENSta_flg_ovrdval "" VALUE 0x0000 /* @ECU_Address@KOUTP_FDCBCMTurnBuzzerENSta_flg_ovrdval@ */ Scalar_BOOLEAN 0 SWC_OUTP_type_CM_boolean_flg 0.0 1.0 /end CHARACTERISTIC
/begin CHARACTERISTIC KOUTP_FDCBCMWasherCmd_flg_maxval "" VALUE 0x0000 /* @ECU_Address@KOUTP_FDCBCMWasherCmd_flg_maxval@ */ Scalar_BOOLEAN 0 SWC_OUTP_type_CM_boolean_flg 0.0 1.0 /end CHARACTERISTIC
/begin CHARACTERISTIC KOUTP_FDCBCMWasherCmd_flg_minval "" VALUE 0x0000 /* @ECU_Address@KOUTP_FDCBCMWasherCmd_flg_minval@ */ Scalar_BOOLEAN 0 SWC_OUTP_type_CM_boolean_flg 0.0 1.0 /end CHARACTERISTIC
/begin CHARACTERISTIC KOUTP_FDCBCMWasherCmd_flg_ovrdflg "" VALUE 0x0000 /* @ECU_Address@KOUTP_FDCBCMWasherCmd_flg_ovrdflg@ */ Scalar_BOOLEAN 0 SWC_OUTP_type_CM_boolean_flg 0.0 1.0 /end CHARACTERISTIC
/begin CHARACTERISTIC KOUTP_FDCBCMWasherCmd_flg_ovrdval "" VALUE 0x0000 /* @ECU_Address@KOUTP_FDCBCMWasherCmd_flg_ovrdval@ */ Scalar_BOOLEAN 0 SWC_OUTP_type_CM_boolean_flg 0.0 1.0 /end CHARACTERISTIC
/begin CHARACTERISTIC KOUTP_FDCBCMWiperHCmd_flg_maxval "" VALUE 0x0000 /* @ECU_Address@KOUTP_FDCBCMWiperHCmd_flg_maxval@ */ Scalar_BOOLEAN 0 SWC_OUTP_type_CM_boolean_flg 0.0 1.0 /end CHARACTERISTIC
/begin CHARACTERISTIC KOUTP_FDCBCMWiperHCmd_flg_minval "" VALUE 0x0000 /* @ECU_Address@KOUTP_FDCBCMWiperHCmd_flg_minval@ */ Scalar_BOOLEAN 0 SWC_OUTP_type_CM_boolean_flg 0.0 1.0 /end CHARACTERISTIC
/begin CHARACTERISTIC KOUTP_FDCBCMWiperHCmd_flg_ovrdflg "" VALUE 0x0000 /* @ECU_Address@KOUTP_FDCBCMWiperHCmd_flg_ovrdflg@ */ Scalar_BOOLEAN 0 SWC_OUTP_type_CM_boolean_flg 0.0 1.0 /end CHARACTERISTIC
/begin CHARACTERISTIC KOUTP_FDCBCMWiperHCmd_flg_ovrdval "" VALUE 0x0000 /* @ECU_Address@KOUTP_FDCBCMWiperHCmd_flg_ovrdval@ */ Scalar_BOOLEAN 0 SWC_OUTP_type_CM_boolean_flg 0.0 1.0 /end CHARACTERISTIC
/begin CHARACTERISTIC KOUTP_FDCBCMWiperLCmd_flg_maxval "" VALUE 0x0000 /* @ECU_Address@KOUTP_FDCBCMWiperLCmd_flg_maxval@ */ Scalar_BOOLEAN 0 SWC_OUTP_type_CM_boolean_flg 0.0 1.0 /end CHARACTERISTIC
/begin CHARACTERISTIC KOUTP_FDCBCMWiperLCmd_flg_minval "" VALUE 0x0000 /* @ECU_Address@KOUTP_FDCBCMWiperLCmd_flg_minval@ */ Scalar_BOOLEAN 0 SWC_OUTP_type_CM_boolean_flg 0.0 1.0 /end CHARACTERISTIC
/begin CHARACTERISTIC KOUTP_FDCBCMWiperLCmd_flg_ovrdflg "" VALUE 0x0000 /* @ECU_Address@KOUTP_FDCBCMWiperLCmd_flg_ovrdflg@ */ Scalar_BOOLEAN 0 SWC_OUTP_type_CM_boolean_flg 0.0 1.0 /end CHARACTERISTIC
/begin CHARACTERISTIC KOUTP_FDCBCMWiperLCmd_flg_ovrdval "" VALUE 0x0000 /* @ECU_Address@KOUTP_FDCBCMWiperLCmd_flg_ovrdval@ */ Scalar_BOOLEAN 0 SWC_OUTP_type_CM_boolean_flg 0.0 1.0 /end CHARACTERISTIC
/begin CHARACTERISTIC KOUTP_InnerBuzzerModeSta_enum_ovrdflg "" VALUE 0x0000 /* @ECU_Address@KOUTP_InnerBuzzerModeSta_enum_ovrdflg@ */ Scalar_BOOLEAN 0 SWC_OUTP_type_CM_boolean_flg 0.0 1.0 /end CHARACTERISTIC
/begin CHARACTERISTIC KOUTP_KeepWakeUp_flg_maxval "" VALUE 0x0000 /* @ECU_Address@KOUTP_KeepWakeUp_flg_maxval@ */ Scalar_BOOLEAN 0 SWC_OUTP_type_CM_boolean_flg 0.0 1.0 /end CHARACTERISTIC
/begin CHARACTERISTIC KOUTP_KeepWakeUp_flg_minval "" VALUE 0x0000 /* @ECU_Address@KOUTP_KeepWakeUp_flg_minval@ */ Scalar_BOOLEAN 0 SWC_OUTP_type_CM_boolean_flg 0.0 1.0 /end CHARACTERISTIC
/begin CHARACTERISTIC KOUTP_KeepWakeUp_flg_ovrdflg "" VALUE 0x0000 /* @ECU_Address@KOUTP_KeepWakeUp_flg_ovrdflg@ */ Scalar_BOOLEAN 0 SWC_OUTP_type_CM_boolean_flg 0.0 1.0 /end CHARACTERISTIC
/begin CHARACTERISTIC KOUTP_KeepWakeUp_flg_ovrdval "" VALUE 0x0000 /* @ECU_Address@KOUTP_KeepWakeUp_flg_ovrdval@ */ Scalar_BOOLEAN 0 SWC_OUTP_type_CM_boolean_flg 0.0 1.0 /end CHARACTERISTIC
/begin CHARACTERISTIC KOUTP_TurnLpPatternSta_enum_ovrdflg "" VALUE 0x0000 /* @ECU_Address@KOUTP_TurnLpPatternSta_enum_ovrdflg@ */ Scalar_BOOLEAN 0 SWC_OUTP_type_CM_boolean_flg 0.0 1.0 /end CHARACTERISTIC
/begin CHARACTERISTIC KOUTP_VehSpeedTimeOut_flg_maxval "" VALUE 0x0000 /* @ECU_Address@KOUTP_VehSpeedTimeOut_flg_maxval@ */ Scalar_BOOLEAN 0 SWC_OUTP_type_CM_boolean_flg 0.0 1.0 /end CHARACTERISTIC
/begin CHARACTERISTIC KOUTP_VehSpeedTimeOut_flg_minval "" VALUE 0x0000 /* @ECU_Address@KOUTP_VehSpeedTimeOut_flg_minval@ */ Scalar_BOOLEAN 0 SWC_OUTP_type_CM_boolean_flg 0.0 1.0 /end CHARACTERISTIC
/begin CHARACTERISTIC KOUTP_VehSpeedTimeOut_flg_ovrdflg "" VALUE 0x0000 /* @ECU_Address@KOUTP_VehSpeedTimeOut_flg_ovrdflg@ */ Scalar_BOOLEAN 0 SWC_OUTP_type_CM_boolean_flg 0.0 1.0 /end CHARACTERISTIC
/begin CHARACTERISTIC KOUTP_VehSpeedTimeOut_flg_ovrdval "" VALUE 0x0000 /* @ECU_Address@KOUTP_VehSpeedTimeOut_flg_ovrdval@ */ Scalar_BOOLEAN 0 SWC_OUTP_type_CM_boolean_flg 0.0 1.0 /end CHARACTERISTIC
/begin CHARACTERISTIC KOUTP_VehSpeed_kph_ovrdflg "" VALUE 0x0000 /* @ECU_Address@KOUTP_VehSpeed_kph_ovrdflg@ */ Scalar_BOOLEAN 0 SWC_OUTP_type_CM_boolean_flg 0.0 1.0 /end CHARACTERISTIC
/begin CHARACTERISTIC KOUTP_WakeUp_flg_maxval "" VALUE 0x0000 /* @ECU_Address@KOUTP_WakeUp_flg_maxval@ */ Scalar_BOOLEAN 0 SWC_OUTP_type_CM_boolean_flg 0.0 1.0 /end CHARACTERISTIC
/begin CHARACTERISTIC KOUTP_WakeUp_flg_minval "" VALUE 0x0000 /* @ECU_Address@KOUTP_WakeUp_flg_minval@ */ Scalar_BOOLEAN 0 SWC_OUTP_type_CM_boolean_flg 0.0 1.0 /end CHARACTERISTIC
/begin CHARACTERISTIC KOUTP_WakeUp_flg_ovrdflg "" VALUE 0x0000 /* @ECU_Address@KOUTP_WakeUp_flg_ovrdflg@ */ Scalar_BOOLEAN 0 SWC_OUTP_type_CM_boolean_flg 0.0 1.0 /end CHARACTERISTIC
/begin CHARACTERISTIC KOUTP_WakeUp_flg_ovrdval "" VALUE 0x0000 /* @ECU_Address@KOUTP_WakeUp_flg_ovrdval@ */ Scalar_BOOLEAN 0 SWC_OUTP_type_CM_boolean_flg 0.0 1.0 /end CHARACTERISTIC
/begin CHARACTERISTIC KOUTP_YawRateTimeOut_flg_maxval "" VALUE 0x0000 /* @ECU_Address@KOUTP_YawRateTimeOut_flg_maxval@ */ Scalar_BOOLEAN 0 SWC_OUTP_type_CM_boolean_flg 0.0 1.0 /end CHARACTERISTIC
/begin CHARACTERISTIC KOUTP_YawRateTimeOut_flg_minval "" VALUE 0x0000 /* @ECU_Address@KOUTP_YawRateTimeOut_flg_minval@ */ Scalar_BOOLEAN 0 SWC_OUTP_type_CM_boolean_flg 0.0 1.0 /end CHARACTERISTIC
/begin CHARACTERISTIC KOUTP_YawRateTimeOut_flg_ovrdflg "" VALUE 0x0000 /* @ECU_Address@KOUTP_YawRateTimeOut_flg_ovrdflg@ */ Scalar_BOOLEAN 0 SWC_OUTP_type_CM_boolean_flg 0.0 1.0 /end CHARACTERISTIC
/begin CHARACTERISTIC KOUTP_YawRateTimeOut_flg_ovrdval "" VALUE 0x0000 /* @ECU_Address@KOUTP_YawRateTimeOut_flg_ovrdval@ */ Scalar_BOOLEAN 0 SWC_OUTP_type_CM_boolean_flg 0.0 1.0 /end CHARACTERISTIC
/begin CHARACTERISTIC KOUTP_YawRateVTimeOut_flg_maxval "" VALUE 0x0000 /* @ECU_Address@KOUTP_YawRateVTimeOut_flg_maxval@ */ Scalar_BOOLEAN 0 SWC_OUTP_type_CM_boolean_flg 0.0 1.0 /end CHARACTERISTIC
/begin CHARACTERISTIC KOUTP_YawRateVTimeOut_flg_minval "" VALUE 0x0000 /* @ECU_Address@KOUTP_YawRateVTimeOut_flg_minval@ */ Scalar_BOOLEAN 0 SWC_OUTP_type_CM_boolean_flg 0.0 1.0 /end CHARACTERISTIC
/begin CHARACTERISTIC KOUTP_YawRateVTimeOut_flg_ovrdflg "" VALUE 0x0000 /* @ECU_Address@KOUTP_YawRateVTimeOut_flg_ovrdflg@ */ Scalar_BOOLEAN 0 SWC_OUTP_type_CM_boolean_flg 0.0 1.0 /end CHARACTERISTIC
/begin CHARACTERISTIC KOUTP_YawRateVTimeOut_flg_ovrdval "" VALUE 0x0000 /* @ECU_Address@KOUTP_YawRateVTimeOut_flg_ovrdval@ */ Scalar_BOOLEAN 0 SWC_OUTP_type_CM_boolean_flg 0.0 1.0 /end CHARACTERISTIC
/begin CHARACTERISTIC KOUTP_YawRateV_flg_maxval "" VALUE 0x0000 /* @ECU_Address@KOUTP_YawRateV_flg_maxval@ */ Scalar_BOOLEAN 0 SWC_OUTP_type_CM_boolean_flg 0.0 1.0 /end CHARACTERISTIC
/begin CHARACTERISTIC KOUTP_YawRateV_flg_minval "" VALUE 0x0000 /* @ECU_Address@KOUTP_YawRateV_flg_minval@ */ Scalar_BOOLEAN 0 SWC_OUTP_type_CM_boolean_flg 0.0 1.0 /end CHARACTERISTIC
/begin CHARACTERISTIC KOUTP_YawRateV_flg_ovrdflg "" VALUE 0x0000 /* @ECU_Address@KOUTP_YawRateV_flg_ovrdflg@ */ Scalar_BOOLEAN 0 SWC_OUTP_type_CM_boolean_flg 0.0 1.0 /end CHARACTERISTIC
/begin CHARACTERISTIC KOUTP_YawRateV_flg_ovrdval "" VALUE 0x0000 /* @ECU_Address@KOUTP_YawRateV_flg_ovrdval@ */ Scalar_BOOLEAN 0 SWC_OUTP_type_CM_boolean_flg 0.0 1.0 /end CHARACTERISTIC
/begin CHARACTERISTIC KOUTP_YawRate_degps_ovrdflg "" VALUE 0x0000 /* @ECU_Address@KOUTP_YawRate_degps_ovrdflg@ */ Scalar_BOOLEAN 0 SWC_OUTP_type_CM_boolean_flg 0.0 1.0 /end CHARACTERISTIC
/begin CHARACTERISTIC KOUTP_DTCDetect_enum_maxval "" VALUE 0x0000 /* @ECU_Address@KOUTP_DTCDetect_enum_maxval@ */ Scalar_UBYTE 0 SWC_OUTP_type_CM_uint8_enum 0.0 255.0 /end CHARACTERISTIC
/begin CHARACTERISTIC KOUTP_DTCDetect_enum_minval "" VALUE 0x0000 /* @ECU_Address@KOUTP_DTCDetect_enum_minval@ */ Scalar_UBYTE 0 SWC_OUTP_type_CM_uint8_enum 0.0 255.0 /end CHARACTERISTIC
/begin CHARACTERISTIC KOUTP_DTCDetect_enum_ovrdval "" VALUE 0x0000 /* @ECU_Address@KOUTP_DTCDetect_enum_ovrdval@ */ Scalar_UBYTE 0 SWC_OUTP_type_CM_uint8_enum 0.0 255.0 /end CHARACTERISTIC
/begin CHARACTERISTIC KOUTP_FDCBCMFRoomLpCmd_pct_maxval "" VALUE 0x0000 /* @ECU_Address@KOUTP_FDCBCMFRoomLpCmd_pct_maxval@ */ Scalar_UBYTE 0 SWC_OUTP_type_CM_uint8_pct 0.0 255.0 /end CHARACTERISTIC
/begin CHARACTERISTIC KOUTP_FDCBCMFRoomLpCmd_pct_minval "" VALUE 0x0000 /* @ECU_Address@KOUTP_FDCBCMFRoomLpCmd_pct_minval@ */ Scalar_UBYTE 0 SWC_OUTP_type_CM_uint8_pct 0.0 255.0 /end CHARACTERISTIC
/begin CHARACTERISTIC KOUTP_FDCBCMFRoomLpCmd_pct_ovrdval "" VALUE 0x0000 /* @ECU_Address@KOUTP_FDCBCMFRoomLpCmd_pct_ovrdval@ */ Scalar_UBYTE 0 SWC_OUTP_type_CM_uint8_enum 0.0 255.0 /end CHARACTERISTIC
/begin CHARACTERISTIC KOUTP_FDCBCMFRoomLpSetSta_pct_maxval "" VALUE 0x0000 /* @ECU_Address@KOUTP_FDCBCMFRoomLpSetSta_pct_maxval@ */ Scalar_UBYTE 0 SWC_OUTP_type_CM_uint8_pct 0.0 255.0 /end CHARACTERISTIC
/begin CHARACTERISTIC KOUTP_FDCBCMFRoomLpSetSta_pct_minval "" VALUE 0x0000 /* @ECU_Address@KOUTP_FDCBCMFRoomLpSetSta_pct_minval@ */ Scalar_UBYTE 0 SWC_OUTP_type_CM_uint8_pct 0.0 255.0 /end CHARACTERISTIC
/begin CHARACTERISTIC KOUTP_FDCBCMFRoomLpSetSta_pct_ovrdval "" VALUE 0x0000 /* @ECU_Address@KOUTP_FDCBCMFRoomLpSetSta_pct_ovrdval@ */ Scalar_UBYTE 0 SWC_OUTP_type_CM_uint8_enum 0.0 255.0 /end CHARACTERISTIC
/begin CHARACTERISTIC KOUTP_FDCBCMMRoomLpCmd_pct_maxval "" VALUE 0x0000 /* @ECU_Address@KOUTP_FDCBCMMRoomLpCmd_pct_maxval@ */ Scalar_UBYTE 0 SWC_OUTP_type_CM_uint8_pct 0.0 255.0 /end CHARACTERISTIC
/begin CHARACTERISTIC KOUTP_FDCBCMMRoomLpCmd_pct_minval "" VALUE 0x0000 /* @ECU_Address@KOUTP_FDCBCMMRoomLpCmd_pct_minval@ */ Scalar_UBYTE 0 SWC_OUTP_type_CM_uint8_pct 0.0 255.0 /end CHARACTERISTIC
/begin CHARACTERISTIC KOUTP_FDCBCMMRoomLpCmd_pct_ovrdval "" VALUE 0x0000 /* @ECU_Address@KOUTP_FDCBCMMRoomLpCmd_pct_ovrdval@ */ Scalar_UBYTE 0 SWC_OUTP_type_CM_uint8_enum 0.0 255.0 /end CHARACTERISTIC
/begin CHARACTERISTIC KOUTP_FDCBCMMRoomLpSetSta_pct_maxval "" VALUE 0x0000 /* @ECU_Address@KOUTP_FDCBCMMRoomLpSetSta_pct_maxval@ */ Scalar_UBYTE 0 SWC_OUTP_type_CM_uint8_pct 0.0 255.0 /end CHARACTERISTIC
/begin CHARACTERISTIC KOUTP_FDCBCMMRoomLpSetSta_pct_minval "" VALUE 0x0000 /* @ECU_Address@KOUTP_FDCBCMMRoomLpSetSta_pct_minval@ */ Scalar_UBYTE 0 SWC_OUTP_type_CM_uint8_pct 0.0 255.0 /end CHARACTERISTIC
/begin CHARACTERISTIC KOUTP_FDCBCMMRoomLpSetSta_pct_ovrdval "" VALUE 0x0000 /* @ECU_Address@KOUTP_FDCBCMMRoomLpSetSta_pct_ovrdval@ */ Scalar_UBYTE 0 SWC_OUTP_type_CM_uint8_enum 0.0 255.0 /end CHARACTERISTIC
/begin CHARACTERISTIC KOUTP_FDCBCMOSDrOpenSWSta_enum_maxval "" VALUE 0x0000 /* @ECU_Address@KOUTP_FDCBCMOSDrOpenSWSta_enum_maxval@ */ Scalar_UBYTE 0 SWC_OUTP_type_CM_uint8_enum 0.0 255.0 /end CHARACTERISTIC
/begin CHARACTERISTIC KOUTP_FDCBCMOSDrOpenSWSta_enum_minval "" VALUE 0x0000 /* @ECU_Address@KOUTP_FDCBCMOSDrOpenSWSta_enum_minval@ */ Scalar_UBYTE 0 SWC_OUTP_type_CM_uint8_enum 0.0 255.0 /end CHARACTERISTIC
/begin CHARACTERISTIC KOUTP_FDCBCMOSDrOpenSWSta_enum_ovrdval "" VALUE 0x0000 /* @ECU_Address@KOUTP_FDCBCMOSDrOpenSWSta_enum_ovrdval@ */ Scalar_UBYTE 0 SWC_OUTP_type_CM_uint8_enum 0.0 255.0 /end CHARACTERISTIC
/begin CHARACTERISTIC KOUTP_FDCBCMRRoomLpCmd_pct_maxval "" VALUE 0x0000 /* @ECU_Address@KOUTP_FDCBCMRRoomLpCmd_pct_maxval@ */ Scalar_UBYTE 0 SWC_OUTP_type_CM_uint8_pct 0.0 255.0 /end CHARACTERISTIC
/begin CHARACTERISTIC KOUTP_FDCBCMRRoomLpCmd_pct_minval "" VALUE 0x0000 /* @ECU_Address@KOUTP_FDCBCMRRoomLpCmd_pct_minval@ */ Scalar_UBYTE 0 SWC_OUTP_type_CM_uint8_pct 0.0 255.0 /end CHARACTERISTIC
/begin CHARACTERISTIC KOUTP_FDCBCMRRoomLpCmd_pct_ovrdval "" VALUE 0x0000 /* @ECU_Address@KOUTP_FDCBCMRRoomLpCmd_pct_ovrdval@ */ Scalar_UBYTE 0 SWC_OUTP_type_CM_uint8_enum 0.0 255.0 /end CHARACTERISTIC
/begin CHARACTERISTIC KOUTP_FDCBCMRRoomLpSetSta_pct_maxval "" VALUE 0x0000 /* @ECU_Address@KOUTP_FDCBCMRRoomLpSetSta_pct_maxval@ */ Scalar_UBYTE 0 SWC_OUTP_type_CM_uint8_pct 0.0 255.0 /end CHARACTERISTIC
/begin CHARACTERISTIC KOUTP_FDCBCMRRoomLpSetSta_pct_minval "" VALUE 0x0000 /* @ECU_Address@KOUTP_FDCBCMRRoomLpSetSta_pct_minval@ */ Scalar_UBYTE 0 SWC_OUTP_type_CM_uint8_pct 0.0 255.0 /end CHARACTERISTIC
/begin CHARACTERISTIC KOUTP_FDCBCMRRoomLpSetSta_pct_ovrdval "" VALUE 0x0000 /* @ECU_Address@KOUTP_FDCBCMRRoomLpSetSta_pct_ovrdval@ */ Scalar_UBYTE 0 SWC_OUTP_type_CM_uint8_enum 0.0 255.0 /end CHARACTERISTIC
/begin CHARACTERISTIC KOUTP_InnerBuzzerModeSta_enum_maxval "" VALUE 0x0000 /* @ECU_Address@KOUTP_InnerBuzzerModeSta_enum_maxval@ */ Scalar_UBYTE 0 SWC_OUTP_type_CM_uint8_enum 0.0 255.0 /end CHARACTERISTIC
/begin CHARACTERISTIC KOUTP_InnerBuzzerModeSta_enum_minval "" VALUE 0x0000 /* @ECU_Address@KOUTP_InnerBuzzerModeSta_enum_minval@ */ Scalar_UBYTE 0 SWC_OUTP_type_CM_uint8_enum 0.0 255.0 /end CHARACTERISTIC
/begin CHARACTERISTIC KOUTP_InnerBuzzerModeSta_enum_ovrdval "" VALUE 0x0000 /* @ECU_Address@KOUTP_InnerBuzzerModeSta_enum_ovrdval@ */ Scalar_UBYTE 0 SWC_OUTP_type_CM_uint8_enum 0.0 255.0 /end CHARACTERISTIC
/begin CHARACTERISTIC KOUTP_TurnLpPatternSta_enum_maxval "" VALUE 0x0000 /* @ECU_Address@KOUTP_TurnLpPatternSta_enum_maxval@ */ Scalar_UBYTE 0 SWC_OUTP_type_CM_uint8_enum 0.0 255.0 /end CHARACTERISTIC
/begin CHARACTERISTIC KOUTP_TurnLpPatternSta_enum_minval "" VALUE 0x0000 /* @ECU_Address@KOUTP_TurnLpPatternSta_enum_minval@ */ Scalar_UBYTE 0 SWC_OUTP_type_CM_uint8_enum 0.0 255.0 /end CHARACTERISTIC
/begin CHARACTERISTIC KOUTP_TurnLpPatternSta_enum_ovrdval "" VALUE 0x0000 /* @ECU_Address@KOUTP_TurnLpPatternSta_enum_ovrdval@ */ Scalar_UBYTE 0 SWC_OUTP_type_CM_uint8_enum 0.0 255.0 /end CHARACTERISTIC
/begin COMPU_METHOD SWC_OUTP_type_CM_single_kph "Q = V" RAT_FUNC "%8.6" "kph" COEFFS 0 1 0 0 0 1 /end COMPU_METHOD
/begin COMPU_METHOD SWC_OUTP_type_CM_single_degps "Q = V" RAT_FUNC "%8.6" "degps" COEFFS 0 1 0 0 0 1 /end COMPU_METHOD
/begin COMPU_METHOD SWC_OUTP_type_CM_uint32_raw32 "Q = V" RAT_FUNC "%10.0" "raw32" COEFFS 0 1 0 0 0 1 /end COMPU_METHOD
/begin COMPU_METHOD SWC_OUTP_type_CM_boolean_flg "Q = V" RAT_FUNC "%1.0" "flg" COEFFS 0 1 0 0 0 1 /end COMPU_METHOD
/begin COMPU_METHOD SWC_OUTP_type_CM_uint8_enum "Q = V" RAT_FUNC "%3.0" "enum" COEFFS 0 1 0 0 0 1 /end COMPU_METHOD
/begin COMPU_METHOD SWC_OUTP_type_CM_uint8_pct "Q = V" RAT_FUNC "%3.0" "pct" COEFFS 0 1 0 0 0 1 /end COMPU_METHOD
/begin GROUP S190_Signal_Limit "SWC_OUTP_type/run_SWC_OUTP_5ms_sys/OUTP/outpmodule/VAPM_VehSpeedTimeOut_flg_Inproc/Signal_Limit"
 /begin REF_CHARACTERISTIC KOUTP_VehSpeedTimeOut_flg_maxval KOUTP_VehSpeedTimeOut_flg_minval /end REF_CHARACTERISTIC
/end GROUP
/begin GROUP S190_Signal_Override "SWC_OUTP_type/run_SWC_OUTP_5ms_sys/OUTP/outpmodule/VAPM_VehSpeedTimeOut_flg_Inproc/Signal_Override"
 /begin REF_CHARACTERISTIC KOUTP_VehSpeedTimeOut_flg_ovrdflg KOUTP_VehSpeedTimeOut_flg_ovrdval /end REF_CHARACTERISTIC
/end GROUP
/begin GROUP S191_Signal_Limit "SWC_OUTP_type/run_SWC_OUTP_5ms_sys/OUTP/outpmodule/VAPM_VehSpeed_kph_Inproc/Signal_Limit" /begin REF_CHARACTERISTIC KOUTP_VehSpeed_kph_maxval KOUTP_VehSpeed_kph_minval /end REF_CHARACTERISTIC /end GROUP
/begin GROUP S191_Signal_Override "SWC_OUTP_type/run_SWC_OUTP_5ms_sys/OUTP/outpmodule/VAPM_VehSpeed_kph_Inproc/Signal_Override" /begin REF_CHARACTERISTIC KOUTP_VehSpeed_kph_ovrdflg KOUTP_VehSpeed_kph_ovrdval /end REF_CHARACTERISTIC /end GROUP
/begin GROUP S192_Signal_Limit "SWC_OUTP_type/run_SWC_OUTP_5ms_sys/OUTP/outpmodule/VAPM_YawRateTimeOut_flg_Inproc/Signal_Limit"
 /begin REF_CHARACTERISTIC KOUTP_YawRateTimeOut_flg_maxval KOUTP_YawRateTimeOut_flg_minval /end REF_CHARACTERISTIC
/end GROUP
/begin GROUP S192_Signal_Override "SWC_OUTP_type/run_SWC_OUTP_5ms_sys/OUTP/outpmodule/VAPM_YawRateTimeOut_flg_Inproc/Signal_Override"
 /begin REF_CHARACTERISTIC KOUTP_YawRateTimeOut_flg_ovrdflg KOUTP_YawRateTimeOut_flg_ovrdval /end REF_CHARACTERISTIC
/end GROUP
/begin GROUP S193_Signal_Limit "SWC_OUTP_type/run_SWC_OUTP_5ms_sys/OUTP/outpmodule/VAPM_YawRateVTimeOut_flg_Inproc/Signal_Limit"
 /begin REF_CHARACTERISTIC KOUTP_YawRateVTimeOut_flg_maxval KOUTP_YawRateVTimeOut_flg_minval /end REF_CHARACTERISTIC
/end GROUP
/begin GROUP S193_Signal_Override "SWC_OUTP_type/run_SWC_OUTP_5ms_sys/OUTP/outpmodule/VAPM_YawRateVTimeOut_flg_Inproc/Signal_Override"
 /begin REF_CHARACTERISTIC KOUTP_YawRateVTimeOut_flg_ovrdflg KOUTP_YawRateVTimeOut_flg_ovrdval /end REF_CHARACTERISTIC
/end GROUP
/begin GROUP S194_Signal_Limit "SWC_OUTP_type/run_SWC_OUTP_5ms_sys/OUTP/outpmodule/VAPM_YawRateV_flg_Inproc/Signal_Limit" /begin REF_CHARACTERISTIC KOUTP_YawRateV_flg_maxval KOUTP_YawRateV_flg_minval /end REF_CHARACTERISTIC /end GROUP
/begin GROUP S194_Signal_Override "SWC_OUTP_type/run_SWC_OUTP_5ms_sys/OUTP/outpmodule/VAPM_YawRateV_flg_Inproc/Signal_Override" /begin REF_CHARACTERISTIC KOUTP_YawRateV_flg_ovrdflg KOUTP_YawRateV_flg_ovrdval /end REF_CHARACTERISTIC /end GROUP
/begin GROUP S195_Signal_Limit "SWC_OUTP_type/run_SWC_OUTP_5ms_sys/OUTP/outpmodule/VAPM_YawRate_degps_Inproc/Signal_Limit" /begin REF_CHARACTERISTIC KOUTP_YawRate_degps_maxval KOUTP_YawRate_degps_minval /end REF_CHARACTERISTIC /end GROUP
/begin GROUP S195_Signal_Override "SWC_OUTP_type/run_SWC_OUTP_5ms_sys/OUTP/outpmodule/VAPM_YawRate_degps_Inproc/Signal_Override" /begin REF_CHARACTERISTIC KOUTP_YawRate_degps_ovrdflg KOUTP_YawRate_degps_ovrdval /end REF_CHARACTERISTIC /end GROUP
/begin GROUP S196_Signal_Limit "SWC_OUTP_type/run_SWC_OUTP_5ms_sys/OUTP/outpmodule/VBCM_FDCBCMBSDBuzzerCmd_flg_Inproc/Signal_Limit"
 /begin REF_CHARACTERISTIC KOUTP_FDCBCMBSDBuzzerCmd_flg_maxval KOUTP_FDCBCMBSDBuzzerCmd_flg_minval /end REF_CHARACTERISTIC
/end GROUP
/begin GROUP S196_Signal_Override "SWC_OUTP_type/run_SWC_OUTP_5ms_sys/OUTP/outpmodule/VBCM_FDCBCMBSDBuzzerCmd_flg_Inproc/Signal_Override"
 /begin REF_CHARACTERISTIC KOUTP_FDCBCMBSDBuzzerCmd_flg_ovrdflg KOUTP_FDCBCMBSDBuzzerCmd_flg_ovrdval /end REF_CHARACTERISTIC
/end GROUP
/begin GROUP S197_Signal_Limit "SWC_OUTP_type/run_SWC_OUTP_5ms_sys/OUTP/outpmodule/VBCM_FDCBCMBrakeCmd_flg_Inproc/Signal_Limit"
 /begin REF_CHARACTERISTIC KOUTP_FDCBCMBrakeCmd_flg_maxval KOUTP_FDCBCMBrakeCmd_flg_minval /end REF_CHARACTERISTIC
/end GROUP
/begin GROUP S197_Signal_Override "SWC_OUTP_type/run_SWC_OUTP_5ms_sys/OUTP/outpmodule/VBCM_FDCBCMBrakeCmd_flg_Inproc/Signal_Override"
 /begin REF_CHARACTERISTIC KOUTP_FDCBCMBrakeCmd_flg_ovrdflg KOUTP_FDCBCMBrakeCmd_flg_ovrdval /end REF_CHARACTERISTIC
/end GROUP
/begin GROUP S198_Signal_Limit "SWC_OUTP_type/run_SWC_OUTP_5ms_sys/OUTP/outpmodule/VBCM_FDCBCMCallBellCmd_flg_Inproc/Signal_Limit"
 /begin REF_CHARACTERISTIC KOUTP_FDCBCMCallBellCmd_flg_maxval KOUTP_FDCBCMCallBellCmd_flg_minval /end REF_CHARACTERISTIC
/end GROUP
/begin GROUP S198_Signal_Override "SWC_OUTP_type/run_SWC_OUTP_5ms_sys/OUTP/outpmodule/VBCM_FDCBCMCallBellCmd_flg_Inproc/Signal_Override"
 /begin REF_CHARACTERISTIC KOUTP_FDCBCMCallBellCmd_flg_ovrdflg KOUTP_FDCBCMCallBellCmd_flg_ovrdval /end REF_CHARACTERISTIC
/end GROUP
/begin GROUP S199_Signal_Limit "SWC_OUTP_type/run_SWC_OUTP_5ms_sys/OUTP/outpmodule/VBCM_FDCBCMDVRSignalLCmd_flg_Inproc/Signal_Limit"
 /begin REF_CHARACTERISTIC KOUTP_FDCBCMDVRSignalLCmd_flg_maxval KOUTP_FDCBCMDVRSignalLCmd_flg_minval /end REF_CHARACTERISTIC
/end GROUP
/begin GROUP S199_Signal_Override "SWC_OUTP_type/run_SWC_OUTP_5ms_sys/OUTP/outpmodule/VBCM_FDCBCMDVRSignalLCmd_flg_Inproc/Signal_Override"
 /begin REF_CHARACTERISTIC KOUTP_FDCBCMDVRSignalLCmd_flg_ovrdflg KOUTP_FDCBCMDVRSignalLCmd_flg_ovrdval /end REF_CHARACTERISTIC
/end GROUP
/begin GROUP S200_Signal_Limit "SWC_OUTP_type/run_SWC_OUTP_5ms_sys/OUTP/outpmodule/VBCM_FDCBCMDVRSignalRCmd_flg_Inproc/Signal_Limit"
 /begin REF_CHARACTERISTIC KOUTP_FDCBCMDVRSignalRCmd_flg_maxval KOUTP_FDCBCMDVRSignalRCmd_flg_minval /end REF_CHARACTERISTIC
/end GROUP
/begin GROUP S200_Signal_Override "SWC_OUTP_type/run_SWC_OUTP_5ms_sys/OUTP/outpmodule/VBCM_FDCBCMDVRSignalRCmd_flg_Inproc/Signal_Override"
 /begin REF_CHARACTERISTIC KOUTP_FDCBCMDVRSignalRCmd_flg_ovrdflg KOUTP_FDCBCMDVRSignalRCmd_flg_ovrdval /end REF_CHARACTERISTIC
/end GROUP
/begin GROUP S201_Signal_Limit "SWC_OUTP_type/run_SWC_OUTP_5ms_sys/OUTP/outpmodule/VBCM_FDCBCMEmExitSWSta_flg_Inproc/Signal_Limit"
 /begin REF_CHARACTERISTIC KOUTP_FDCBCMEmExitSWSta_flg_maxval KOUTP_FDCBCMEmExitSWSta_flg_minval /end REF_CHARACTERISTIC
/end GROUP
/begin GROUP S201_Signal_Override "SWC_OUTP_type/run_SWC_OUTP_5ms_sys/OUTP/outpmodule/VBCM_FDCBCMEmExitSWSta_flg_Inproc/Signal_Override"
 /begin REF_CHARACTERISTIC KOUTP_FDCBCMEmExitSWSta_flg_ovrdflg KOUTP_FDCBCMEmExitSWSta_flg_ovrdval /end REF_CHARACTERISTIC
/end GROUP
/begin GROUP S202_Signal_Limit "SWC_OUTP_type/run_SWC_OUTP_5ms_sys/OUTP/outpmodule/VBCM_FDCBCMEmSVCmd_flg_Inproc/Signal_Limit"
 /begin REF_CHARACTERISTIC KOUTP_FDCBCMEmSVCmd_flg_maxval KOUTP_FDCBCMEmSVCmd_flg_minval /end REF_CHARACTERISTIC
/end GROUP
/begin GROUP S202_Signal_Override "SWC_OUTP_type/run_SWC_OUTP_5ms_sys/OUTP/outpmodule/VBCM_FDCBCMEmSVCmd_flg_Inproc/Signal_Override"
 /begin REF_CHARACTERISTIC KOUTP_FDCBCMEmSVCmd_flg_ovrdflg KOUTP_FDCBCMEmSVCmd_flg_ovrdval /end REF_CHARACTERISTIC
/end GROUP
/begin GROUP S203_Signal_Limit "SWC_OUTP_type/run_SWC_OUTP_5ms_sys/OUTP/outpmodule/VBCM_FDCBCMFDCloseSVCmd_flg_Inproc/Signal_Limit"
 /begin REF_CHARACTERISTIC KOUTP_FDCBCMFDCloseSVCmd_flg_maxval KOUTP_FDCBCMFDCloseSVCmd_flg_minval /end REF_CHARACTERISTIC
/end GROUP
/begin GROUP S203_Signal_Override "SWC_OUTP_type/run_SWC_OUTP_5ms_sys/OUTP/outpmodule/VBCM_FDCBCMFDCloseSVCmd_flg_Inproc/Signal_Override"
 /begin REF_CHARACTERISTIC KOUTP_FDCBCMFDCloseSVCmd_flg_ovrdflg KOUTP_FDCBCMFDCloseSVCmd_flg_ovrdval /end REF_CHARACTERISTIC
/end GROUP
/begin GROUP S204_Signal_Limit "SWC_OUTP_type/run_SWC_OUTP_5ms_sys/OUTP/outpmodule/VBCM_FDCBCMFDOpenSVCmd_flg_Inproc/Signal_Limit"
 /begin REF_CHARACTERISTIC KOUTP_FDCBCMFDOpenSVCmd_flg_maxval KOUTP_FDCBCMFDOpenSVCmd_flg_minval /end REF_CHARACTERISTIC
/end GROUP
/begin GROUP S204_Signal_Override "SWC_OUTP_type/run_SWC_OUTP_5ms_sys/OUTP/outpmodule/VBCM_FDCBCMFDOpenSVCmd_flg_Inproc/Signal_Override"
 /begin REF_CHARACTERISTIC KOUTP_FDCBCMFDOpenSVCmd_flg_ovrdflg KOUTP_FDCBCMFDOpenSVCmd_flg_ovrdval /end REF_CHARACTERISTIC
/end GROUP
/begin GROUP S205_Signal_Limit "SWC_OUTP_type/run_SWC_OUTP_5ms_sys/OUTP/outpmodule/VBCM_FDCBCMFDoorSta_flg_Inproc/Signal_Limit"
 /begin REF_CHARACTERISTIC KOUTP_FDCBCMFDoorSta_flg_maxval KOUTP_FDCBCMFDoorSta_flg_minval /end REF_CHARACTERISTIC
/end GROUP
/begin GROUP S205_Signal_Override "SWC_OUTP_type/run_SWC_OUTP_5ms_sys/OUTP/outpmodule/VBCM_FDCBCMFDoorSta_flg_Inproc/Signal_Override"
 /begin REF_CHARACTERISTIC KOUTP_FDCBCMFDoorSta_flg_ovrdflg KOUTP_FDCBCMFDoorSta_flg_ovrdval /end REF_CHARACTERISTIC
/end GROUP
/begin GROUP S206_Signal_Limit "SWC_OUTP_type/run_SWC_OUTP_5ms_sys/OUTP/outpmodule/VBCM_FDCBCMFRoomLpCmd_pct_Inproc/Signal_Limit"
 /begin REF_CHARACTERISTIC KOUTP_FDCBCMFRoomLpCmd_pct_maxval KOUTP_FDCBCMFRoomLpCmd_pct_minval /end REF_CHARACTERISTIC
/end GROUP
/begin GROUP S206_Signal_Override "SWC_OUTP_type/run_SWC_OUTP_5ms_sys/OUTP/outpmodule/VBCM_FDCBCMFRoomLpCmd_pct_Inproc/Signal_Override"
 /begin REF_CHARACTERISTIC KOUTP_FDCBCMFRoomLpCmd_pct_ovrdflg KOUTP_FDCBCMFRoomLpCmd_pct_ovrdval /end REF_CHARACTERISTIC
/end GROUP
/begin GROUP S207_Signal_Limit "SWC_OUTP_type/run_SWC_OUTP_5ms_sys/OUTP/outpmodule/VBCM_FDCBCMFRoomLpSetSta_pct_Inproc/Signal_Limit"
 /begin REF_CHARACTERISTIC KOUTP_FDCBCMFRoomLpSetSta_pct_maxval KOUTP_FDCBCMFRoomLpSetSta_pct_minval /end REF_CHARACTERISTIC
/end GROUP
/begin GROUP S207_Signal_Override "SWC_OUTP_type/run_SWC_OUTP_5ms_sys/OUTP/outpmodule/VBCM_FDCBCMFRoomLpSetSta_pct_Inproc/Signal_Override"
 /begin REF_CHARACTERISTIC KOUTP_FDCBCMFRoomLpSetSta_pct_ovrdflg KOUTP_FDCBCMFRoomLpSetSta_pct_ovrdval /end REF_CHARACTERISTIC
/end GROUP
/begin GROUP S208_Signal_Limit "SWC_OUTP_type/run_SWC_OUTP_5ms_sys/OUTP/outpmodule/VBCM_FDCBCMHBeamCmd_flg_Inproc/Signal_Limit"
 /begin REF_CHARACTERISTIC KOUTP_FDCBCMHBeamCmd_flg_maxval KOUTP_FDCBCMHBeamCmd_flg_minval /end REF_CHARACTERISTIC
/end GROUP
/begin GROUP S208_Signal_Override "SWC_OUTP_type/run_SWC_OUTP_5ms_sys/OUTP/outpmodule/VBCM_FDCBCMHBeamCmd_flg_Inproc/Signal_Override"
 /begin REF_CHARACTERISTIC KOUTP_FDCBCMHBeamCmd_flg_ovrdflg KOUTP_FDCBCMHBeamCmd_flg_ovrdval /end REF_CHARACTERISTIC
/end GROUP
/begin GROUP S209_Signal_Limit "SWC_OUTP_type/run_SWC_OUTP_5ms_sys/OUTP/outpmodule/VBCM_FDCBCMHelpINDCmd_flg_Inproc/Signal_Limit"
 /begin REF_CHARACTERISTIC KOUTP_FDCBCMHelpINDCmd_flg_maxval KOUTP_FDCBCMHelpINDCmd_flg_minval /end REF_CHARACTERISTIC
/end GROUP
/begin GROUP S209_Signal_Override "SWC_OUTP_type/run_SWC_OUTP_5ms_sys/OUTP/outpmodule/VBCM_FDCBCMHelpINDCmd_flg_Inproc/Signal_Override"
 /begin REF_CHARACTERISTIC KOUTP_FDCBCMHelpINDCmd_flg_ovrdflg KOUTP_FDCBCMHelpINDCmd_flg_ovrdval /end REF_CHARACTERISTIC
/end GROUP
/begin GROUP S210_Signal_Limit "SWC_OUTP_type/run_SWC_OUTP_5ms_sys/OUTP/outpmodule/VBCM_FDCBCMInnerBuzzerCmd_flg_Inproc/Signal_Limit"
 /begin REF_CHARACTERISTIC KOUTP_FDCBCMInnerBuzzerCmd_flg_maxval KOUTP_FDCBCMInnerBuzzerCmd_flg_minval /end REF_CHARACTERISTIC
/end GROUP
/begin GROUP S210_Signal_Override "SWC_OUTP_type/run_SWC_OUTP_5ms_sys/OUTP/outpmodule/VBCM_FDCBCMInnerBuzzerCmd_flg_Inproc/Signal_Override"
 /begin REF_CHARACTERISTIC KOUTP_FDCBCMInnerBuzzerCmd_flg_ovrdflg KOUTP_FDCBCMInnerBuzzerCmd_flg_ovrdval /end REF_CHARACTERISTIC
/end GROUP
/begin GROUP S211_Signal_Limit "SWC_OUTP_type/run_SWC_OUTP_5ms_sys/OUTP/outpmodule/VBCM_FDCBCMInnerCallBellCmd_flg_Inproc/Signal_Limit"
 /begin REF_CHARACTERISTIC KOUTP_FDCBCMInnerCallBellCmd_flg_maxval KOUTP_FDCBCMInnerCallBellCmd_flg_minval /end REF_CHARACTERISTIC
/end GROUP
/begin GROUP S211_Signal_Override "SWC_OUTP_type/run_SWC_OUTP_5ms_sys/OUTP/outpmodule/VBCM_FDCBCMInnerCallBellCmd_flg_Inproc/Signal_Override"
 /begin REF_CHARACTERISTIC KOUTP_FDCBCMInnerCallBellCmd_flg_ovrdflg KOUTP_FDCBCMInnerCallBellCmd_flg_ovrdval /end REF_CHARACTERISTIC
/end GROUP
/begin GROUP S212_Signal_Limit "SWC_OUTP_type/run_SWC_OUTP_5ms_sys/OUTP/outpmodule/VBCM_FDCBCMLBSDRCmd_flg_Inproc/Signal_Limit"
 /begin REF_CHARACTERISTIC KOUTP_FDCBCMLBSDRCmd_flg_maxval KOUTP_FDCBCMLBSDRCmd_flg_minval /end REF_CHARACTERISTIC
/end GROUP
/begin GROUP S212_Signal_Override "SWC_OUTP_type/run_SWC_OUTP_5ms_sys/OUTP/outpmodule/VBCM_FDCBCMLBSDRCmd_flg_Inproc/Signal_Override"
 /begin REF_CHARACTERISTIC KOUTP_FDCBCMLBSDRCmd_flg_ovrdflg KOUTP_FDCBCMLBSDRCmd_flg_ovrdval /end REF_CHARACTERISTIC
/end GROUP
/begin GROUP S213_Signal_Limit "SWC_OUTP_type/run_SWC_OUTP_5ms_sys/OUTP/outpmodule/VBCM_FDCBCMLBSDYCmd_flg_Inproc/Signal_Limit"
 /begin REF_CHARACTERISTIC KOUTP_FDCBCMLBSDYCmd_flg_maxval KOUTP_FDCBCMLBSDYCmd_flg_minval /end REF_CHARACTERISTIC
/end GROUP
/begin GROUP S213_Signal_Override "SWC_OUTP_type/run_SWC_OUTP_5ms_sys/OUTP/outpmodule/VBCM_FDCBCMLBSDYCmd_flg_Inproc/Signal_Override"
 /begin REF_CHARACTERISTIC KOUTP_FDCBCMLBSDYCmd_flg_ovrdflg KOUTP_FDCBCMLBSDYCmd_flg_ovrdval /end REF_CHARACTERISTIC
/end GROUP
/begin GROUP S214_Signal_Limit "SWC_OUTP_type/run_SWC_OUTP_5ms_sys/OUTP/outpmodule/VBCM_FDCBCMLBeamCmd_flg_Inproc/Signal_Limit"
 /begin REF_CHARACTERISTIC KOUTP_FDCBCMLBeamCmd_flg_maxval KOUTP_FDCBCMLBeamCmd_flg_minval /end REF_CHARACTERISTIC
/end GROUP
/begin GROUP S214_Signal_Override "SWC_OUTP_type/run_SWC_OUTP_5ms_sys/OUTP/outpmodule/VBCM_FDCBCMLBeamCmd_flg_Inproc/Signal_Override"
 /begin REF_CHARACTERISTIC KOUTP_FDCBCMLBeamCmd_flg_ovrdflg KOUTP_FDCBCMLBeamCmd_flg_ovrdval /end REF_CHARACTERISTIC
/end GROUP
/begin GROUP S215_Signal_Limit "SWC_OUTP_type/run_SWC_OUTP_5ms_sys/OUTP/outpmodule/VBCM_FDCBCMLDRLCmd_flg_Inproc/Signal_Limit"
 /begin REF_CHARACTERISTIC KOUTP_FDCBCMLDRLCmd_flg_maxval KOUTP_FDCBCMLDRLCmd_flg_minval /end REF_CHARACTERISTIC
/end GROUP
/begin GROUP S215_Signal_Override "SWC_OUTP_type/run_SWC_OUTP_5ms_sys/OUTP/outpmodule/VBCM_FDCBCMLDRLCmd_flg_Inproc/Signal_Override"
 /begin REF_CHARACTERISTIC KOUTP_FDCBCMLDRLCmd_flg_ovrdflg KOUTP_FDCBCMLDRLCmd_flg_ovrdval /end REF_CHARACTERISTIC
/end GROUP
/begin GROUP S216_Signal_Limit "SWC_OUTP_type/run_SWC_OUTP_5ms_sys/OUTP/outpmodule/VBCM_FDCBCMLTurnLpCmd_flg_Inproc/Signal_Limit"
 /begin REF_CHARACTERISTIC KOUTP_FDCBCMLTurnLpCmd_flg_maxval KOUTP_FDCBCMLTurnLpCmd_flg_minval /end REF_CHARACTERISTIC
/end GROUP
/begin GROUP S216_Signal_Override "SWC_OUTP_type/run_SWC_OUTP_5ms_sys/OUTP/outpmodule/VBCM_FDCBCMLTurnLpCmd_flg_Inproc/Signal_Override"
 /begin REF_CHARACTERISTIC KOUTP_FDCBCMLTurnLpCmd_flg_ovrdflg KOUTP_FDCBCMLTurnLpCmd_flg_ovrdval /end REF_CHARACTERISTIC
/end GROUP
/begin GROUP S217_Signal_Limit "SWC_OUTP_type/run_SWC_OUTP_5ms_sys/OUTP/outpmodule/VBCM_FDCBCMLTurnSWSta_flg_Inproc/Signal_Limit"
 /begin REF_CHARACTERISTIC KOUTP_FDCBCMLTurnSWSta_flg_maxval KOUTP_FDCBCMLTurnSWSta_flg_minval /end REF_CHARACTERISTIC
/end GROUP
/begin GROUP S217_Signal_Override "SWC_OUTP_type/run_SWC_OUTP_5ms_sys/OUTP/outpmodule/VBCM_FDCBCMLTurnSWSta_flg_Inproc/Signal_Override"
 /begin REF_CHARACTERISTIC KOUTP_FDCBCMLTurnSWSta_flg_ovrdflg KOUTP_FDCBCMLTurnSWSta_flg_ovrdval /end REF_CHARACTERISTIC
/end GROUP
/begin GROUP S218_Signal_Limit "SWC_OUTP_type/run_SWC_OUTP_5ms_sys/OUTP/outpmodule/VBCM_FDCBCMMDCloseSVCmd_flg_Inproc/Signal_Limit"
 /begin REF_CHARACTERISTIC KOUTP_FDCBCMMDCloseSVCmd_flg_maxval KOUTP_FDCBCMMDCloseSVCmd_flg_minval /end REF_CHARACTERISTIC
/end GROUP
/begin GROUP S218_Signal_Override "SWC_OUTP_type/run_SWC_OUTP_5ms_sys/OUTP/outpmodule/VBCM_FDCBCMMDCloseSVCmd_flg_Inproc/Signal_Override"
 /begin REF_CHARACTERISTIC KOUTP_FDCBCMMDCloseSVCmd_flg_ovrdflg KOUTP_FDCBCMMDCloseSVCmd_flg_ovrdval /end REF_CHARACTERISTIC
/end GROUP
/begin GROUP S219_Signal_Limit "SWC_OUTP_type/run_SWC_OUTP_5ms_sys/OUTP/outpmodule/VBCM_FDCBCMMDOpenSVCmd_flg_Inproc/Signal_Limit"
 /begin REF_CHARACTERISTIC KOUTP_FDCBCMMDOpenSVCmd_flg_maxval KOUTP_FDCBCMMDOpenSVCmd_flg_minval /end REF_CHARACTERISTIC
/end GROUP
/begin GROUP S219_Signal_Override "SWC_OUTP_type/run_SWC_OUTP_5ms_sys/OUTP/outpmodule/VBCM_FDCBCMMDOpenSVCmd_flg_Inproc/Signal_Override"
 /begin REF_CHARACTERISTIC KOUTP_FDCBCMMDOpenSVCmd_flg_ovrdflg KOUTP_FDCBCMMDOpenSVCmd_flg_ovrdval /end REF_CHARACTERISTIC
/end GROUP
/begin GROUP S220_Signal_Limit "SWC_OUTP_type/run_SWC_OUTP_5ms_sys/OUTP/outpmodule/VBCM_FDCBCMMDoorSta_flg_Inproc/Signal_Limit"
 /begin REF_CHARACTERISTIC KOUTP_FDCBCMMDoorSta_flg_maxval KOUTP_FDCBCMMDoorSta_flg_minval /end REF_CHARACTERISTIC
/end GROUP
/begin GROUP S220_Signal_Override "SWC_OUTP_type/run_SWC_OUTP_5ms_sys/OUTP/outpmodule/VBCM_FDCBCMMDoorSta_flg_Inproc/Signal_Override"
 /begin REF_CHARACTERISTIC KOUTP_FDCBCMMDoorSta_flg_ovrdflg KOUTP_FDCBCMMDoorSta_flg_ovrdval /end REF_CHARACTERISTIC
/end GROUP
/begin GROUP S221_Signal_Limit "SWC_OUTP_type/run_SWC_OUTP_5ms_sys/OUTP/outpmodule/VBCM_FDCBCMMRoomLpCmd_pct_Inproc/Signal_Limit"
 /begin REF_CHARACTERISTIC KOUTP_FDCBCMMRoomLpCmd_pct_maxval KOUTP_FDCBCMMRoomLpCmd_pct_minval /end REF_CHARACTERISTIC
/end GROUP
/begin GROUP S221_Signal_Override "SWC_OUTP_type/run_SWC_OUTP_5ms_sys/OUTP/outpmodule/VBCM_FDCBCMMRoomLpCmd_pct_Inproc/Signal_Override"
 /begin REF_CHARACTERISTIC KOUTP_FDCBCMMRoomLpCmd_pct_ovrdflg KOUTP_FDCBCMMRoomLpCmd_pct_ovrdval /end REF_CHARACTERISTIC
/end GROUP
/begin GROUP S222_Signal_Limit "SWC_OUTP_type/run_SWC_OUTP_5ms_sys/OUTP/outpmodule/VBCM_FDCBCMMRoomLpSetSta_pct_Inproc/Signal_Limit"
 /begin REF_CHARACTERISTIC KOUTP_FDCBCMMRoomLpSetSta_pct_maxval KOUTP_FDCBCMMRoomLpSetSta_pct_minval /end REF_CHARACTERISTIC
/end GROUP
/begin GROUP S222_Signal_Override "SWC_OUTP_type/run_SWC_OUTP_5ms_sys/OUTP/outpmodule/VBCM_FDCBCMMRoomLpSetSta_pct_Inproc/Signal_Override"
 /begin REF_CHARACTERISTIC KOUTP_FDCBCMMRoomLpSetSta_pct_ovrdflg KOUTP_FDCBCMMRoomLpSetSta_pct_ovrdval /end REF_CHARACTERISTIC
/end GROUP
/begin GROUP S223_Signal_Limit "SWC_OUTP_type/run_SWC_OUTP_5ms_sys/OUTP/outpmodule/VBCM_FDCBCMOSDrOpenSWSta_enum_Inproc/Signal_Limit"
 /begin REF_CHARACTERISTIC KOUTP_FDCBCMOSDrOpenSWSta_enum_maxval KOUTP_FDCBCMOSDrOpenSWSta_enum_minval /end REF_CHARACTERISTIC
/end GROUP
/begin GROUP S223_Signal_Override "SWC_OUTP_type/run_SWC_OUTP_5ms_sys/OUTP/outpmodule/VBCM_FDCBCMOSDrOpenSWSta_enum_Inproc/Signal_Override"
 /begin REF_CHARACTERISTIC KOUTP_FDCBCMOSDrOpenSWSta_enum_ovrdflg KOUTP_FDCBCMOSDrOpenSWSta_enum_ovrdval /end REF_CHARACTERISTIC
/end GROUP
/begin GROUP S224_Signal_Limit "SWC_OUTP_type/run_SWC_OUTP_5ms_sys/OUTP/outpmodule/VBCM_FDCBCMPLampCmd_flg_Inproc/Signal_Limit"
 /begin REF_CHARACTERISTIC KOUTP_FDCBCMPLampCmd_flg_maxval KOUTP_FDCBCMPLampCmd_flg_minval /end REF_CHARACTERISTIC
/end GROUP
/begin GROUP S224_Signal_Override "SWC_OUTP_type/run_SWC_OUTP_5ms_sys/OUTP/outpmodule/VBCM_FDCBCMPLampCmd_flg_Inproc/Signal_Override"
 /begin REF_CHARACTERISTIC KOUTP_FDCBCMPLampCmd_flg_ovrdflg KOUTP_FDCBCMPLampCmd_flg_ovrdval /end REF_CHARACTERISTIC
/end GROUP
/begin GROUP S225_Signal_Limit "SWC_OUTP_type/run_SWC_OUTP_5ms_sys/OUTP/outpmodule/VBCM_FDCBCMRBSDRCmd_flg_Inproc/Signal_Limit"
 /begin REF_CHARACTERISTIC KOUTP_FDCBCMRBSDRCmd_flg_maxval KOUTP_FDCBCMRBSDRCmd_flg_minval /end REF_CHARACTERISTIC
/end GROUP
/begin GROUP S225_Signal_Override "SWC_OUTP_type/run_SWC_OUTP_5ms_sys/OUTP/outpmodule/VBCM_FDCBCMRBSDRCmd_flg_Inproc/Signal_Override"
 /begin REF_CHARACTERISTIC KOUTP_FDCBCMRBSDRCmd_flg_ovrdflg KOUTP_FDCBCMRBSDRCmd_flg_ovrdval /end REF_CHARACTERISTIC
/end GROUP
/begin GROUP S226_Signal_Limit "SWC_OUTP_type/run_SWC_OUTP_5ms_sys/OUTP/outpmodule/VBCM_FDCBCMRBSDYCmd_flg_Inproc/Signal_Limit"
 /begin REF_CHARACTERISTIC KOUTP_FDCBCMRBSDYCmd_flg_maxval KOUTP_FDCBCMRBSDYCmd_flg_minval /end REF_CHARACTERISTIC
/end GROUP
/begin GROUP S226_Signal_Override "SWC_OUTP_type/run_SWC_OUTP_5ms_sys/OUTP/outpmodule/VBCM_FDCBCMRBSDYCmd_flg_Inproc/Signal_Override"
 /begin REF_CHARACTERISTIC KOUTP_FDCBCMRBSDYCmd_flg_ovrdflg KOUTP_FDCBCMRBSDYCmd_flg_ovrdval /end REF_CHARACTERISTIC
/end GROUP
/begin GROUP S227_Signal_Limit "SWC_OUTP_type/run_SWC_OUTP_5ms_sys/OUTP/outpmodule/VBCM_FDCBCMRDRLCmd_flg_Inproc/Signal_Limit"
 /begin REF_CHARACTERISTIC KOUTP_FDCBCMRDRLCmd_flg_maxval KOUTP_FDCBCMRDRLCmd_flg_minval /end REF_CHARACTERISTIC
/end GROUP
/begin GROUP S227_Signal_Override "SWC_OUTP_type/run_SWC_OUTP_5ms_sys/OUTP/outpmodule/VBCM_FDCBCMRDRLCmd_flg_Inproc/Signal_Override"
 /begin REF_CHARACTERISTIC KOUTP_FDCBCMRDRLCmd_flg_ovrdflg KOUTP_FDCBCMRDRLCmd_flg_ovrdval /end REF_CHARACTERISTIC
/end GROUP
/begin GROUP S228_Signal_Limit "SWC_OUTP_type/run_SWC_OUTP_5ms_sys/OUTP/outpmodule/VBCM_FDCBCMRDoorSta_flg_Inproc/Signal_Limit"
 /begin REF_CHARACTERISTIC KOUTP_FDCBCMRDoorSta_flg_maxval KOUTP_FDCBCMRDoorSta_flg_minval /end REF_CHARACTERISTIC
/end GROUP
/begin GROUP S228_Signal_Override "SWC_OUTP_type/run_SWC_OUTP_5ms_sys/OUTP/outpmodule/VBCM_FDCBCMRDoorSta_flg_Inproc/Signal_Override"
 /begin REF_CHARACTERISTIC KOUTP_FDCBCMRDoorSta_flg_ovrdflg KOUTP_FDCBCMRDoorSta_flg_ovrdval /end REF_CHARACTERISTIC
/end GROUP
/begin GROUP S229_Signal_Limit "SWC_OUTP_type/run_SWC_OUTP_5ms_sys/OUTP/outpmodule/VBCM_FDCBCMRFLampCmd_flg_Inproc/Signal_Limit"
 /begin REF_CHARACTERISTIC KOUTP_FDCBCMRFLampCmd_flg_maxval KOUTP_FDCBCMRFLampCmd_flg_minval /end REF_CHARACTERISTIC
/end GROUP
/begin GROUP S229_Signal_Override "SWC_OUTP_type/run_SWC_OUTP_5ms_sys/OUTP/outpmodule/VBCM_FDCBCMRFLampCmd_flg_Inproc/Signal_Override"
 /begin REF_CHARACTERISTIC KOUTP_FDCBCMRFLampCmd_flg_ovrdflg KOUTP_FDCBCMRFLampCmd_flg_ovrdval /end REF_CHARACTERISTIC
/end GROUP
/begin GROUP S230_Signal_Limit "SWC_OUTP_type/run_SWC_OUTP_5ms_sys/OUTP/outpmodule/VBCM_FDCBCMRGearSta_flg_Inproc/Signal_Limit"
 /begin REF_CHARACTERISTIC KOUTP_FDCBCMRGearSta_flg_maxval KOUTP_FDCBCMRGearSta_flg_minval /end REF_CHARACTERISTIC
/end GROUP
/begin GROUP S230_Signal_Override "SWC_OUTP_type/run_SWC_OUTP_5ms_sys/OUTP/outpmodule/VBCM_FDCBCMRGearSta_flg_Inproc/Signal_Override"
 /begin REF_CHARACTERISTIC KOUTP_FDCBCMRGearSta_flg_ovrdflg KOUTP_FDCBCMRGearSta_flg_ovrdval /end REF_CHARACTERISTIC
/end GROUP
/begin GROUP S231_Signal_Limit "SWC_OUTP_type/run_SWC_OUTP_5ms_sys/OUTP/outpmodule/VBCM_FDCBCMRRoomLpCmd_pct_Inproc/Signal_Limit"
 /begin REF_CHARACTERISTIC KOUTP_FDCBCMRRoomLpCmd_pct_maxval KOUTP_FDCBCMRRoomLpCmd_pct_minval /end REF_CHARACTERISTIC
/end GROUP
/begin GROUP S231_Signal_Override "SWC_OUTP_type/run_SWC_OUTP_5ms_sys/OUTP/outpmodule/VBCM_FDCBCMRRoomLpCmd_pct_Inproc/Signal_Override"
 /begin REF_CHARACTERISTIC KOUTP_FDCBCMRRoomLpCmd_pct_ovrdflg KOUTP_FDCBCMRRoomLpCmd_pct_ovrdval /end REF_CHARACTERISTIC
/end GROUP
/begin GROUP S232_Signal_Limit "SWC_OUTP_type/run_SWC_OUTP_5ms_sys/OUTP/outpmodule/VBCM_FDCBCMRRoomLpSetSta_pct_Inproc/Signal_Limit"
 /begin REF_CHARACTERISTIC KOUTP_FDCBCMRRoomLpSetSta_pct_maxval KOUTP_FDCBCMRRoomLpSetSta_pct_minval /end REF_CHARACTERISTIC
/end GROUP
/begin GROUP S232_Signal_Override "SWC_OUTP_type/run_SWC_OUTP_5ms_sys/OUTP/outpmodule/VBCM_FDCBCMRRoomLpSetSta_pct_Inproc/Signal_Override"
 /begin REF_CHARACTERISTIC KOUTP_FDCBCMRRoomLpSetSta_pct_ovrdflg KOUTP_FDCBCMRRoomLpSetSta_pct_ovrdval /end REF_CHARACTERISTIC
/end GROUP
/begin GROUP S233_Signal_Limit "SWC_OUTP_type/run_SWC_OUTP_5ms_sys/OUTP/outpmodule/VBCM_FDCBCMRTurnLpCmd_flg_Inproc/Signal_Limit"
 /begin REF_CHARACTERISTIC KOUTP_FDCBCMRTurnLpCmd_flg_maxval KOUTP_FDCBCMRTurnLpCmd_flg_minval /end REF_CHARACTERISTIC
/end GROUP
/begin GROUP S233_Signal_Override "SWC_OUTP_type/run_SWC_OUTP_5ms_sys/OUTP/outpmodule/VBCM_FDCBCMRTurnLpCmd_flg_Inproc/Signal_Override"
 /begin REF_CHARACTERISTIC KOUTP_FDCBCMRTurnLpCmd_flg_ovrdflg KOUTP_FDCBCMRTurnLpCmd_flg_ovrdval /end REF_CHARACTERISTIC
/end GROUP
/begin GROUP S234_Signal_Limit "SWC_OUTP_type/run_SWC_OUTP_5ms_sys/OUTP/outpmodule/VBCM_FDCBCMRTurnSWSta_flg_Inproc/Signal_Limit"
 /begin REF_CHARACTERISTIC KOUTP_FDCBCMRTurnSWSta_flg_maxval KOUTP_FDCBCMRTurnSWSta_flg_minval /end REF_CHARACTERISTIC
/end GROUP
/begin GROUP S234_Signal_Override "SWC_OUTP_type/run_SWC_OUTP_5ms_sys/OUTP/outpmodule/VBCM_FDCBCMRTurnSWSta_flg_Inproc/Signal_Override"
 /begin REF_CHARACTERISTIC KOUTP_FDCBCMRTurnSWSta_flg_ovrdflg KOUTP_FDCBCMRTurnSWSta_flg_ovrdval /end REF_CHARACTERISTIC
/end GROUP
/begin GROUP S235_Signal_Limit "SWC_OUTP_type/run_SWC_OUTP_5ms_sys/OUTP/outpmodule/VBCM_FDCBCMRoomLpAmbCmd_flg_Inproc/Signal_Limit"
 /begin REF_CHARACTERISTIC KOUTP_FDCBCMRoomLpAmbCmd_flg_maxval KOUTP_FDCBCMRoomLpAmbCmd_flg_minval /end REF_CHARACTERISTIC
/end GROUP
/begin GROUP S235_Signal_Override "SWC_OUTP_type/run_SWC_OUTP_5ms_sys/OUTP/outpmodule/VBCM_FDCBCMRoomLpAmbCmd_flg_Inproc/Signal_Override"
 /begin REF_CHARACTERISTIC KOUTP_FDCBCMRoomLpAmbCmd_flg_ovrdflg KOUTP_FDCBCMRoomLpAmbCmd_flg_ovrdval /end REF_CHARACTERISTIC
/end GROUP
/begin GROUP S236_Signal_Limit "SWC_OUTP_type/run_SWC_OUTP_5ms_sys/OUTP/outpmodule/VBCM_FDCBCMRoomLpAmbSetSta_flg_Inproc/Signal_Limit"
 /begin REF_CHARACTERISTIC KOUTP_FDCBCMRoomLpAmbSetSta_flg_maxval KOUTP_FDCBCMRoomLpAmbSetSta_flg_minval /end REF_CHARACTERISTIC
/end GROUP
/begin GROUP S236_Signal_Override "SWC_OUTP_type/run_SWC_OUTP_5ms_sys/OUTP/outpmodule/VBCM_FDCBCMRoomLpAmbSetSta_flg_Inproc/Signal_Override"
 /begin REF_CHARACTERISTIC KOUTP_FDCBCMRoomLpAmbSetSta_flg_ovrdflg KOUTP_FDCBCMRoomLpAmbSetSta_flg_ovrdval /end REF_CHARACTERISTIC
/end GROUP
/begin GROUP S237_Signal_Limit "SWC_OUTP_type/run_SWC_OUTP_5ms_sys/OUTP/outpmodule/VBCM_FDCBCMRoomLpSetSta_flg_Inproc/Signal_Limit"
 /begin REF_CHARACTERISTIC KOUTP_FDCBCMRoomLpSetSta_flg_maxval KOUTP_FDCBCMRoomLpSetSta_flg_minval /end REF_CHARACTERISTIC
/end GROUP
/begin GROUP S237_Signal_Override "SWC_OUTP_type/run_SWC_OUTP_5ms_sys/OUTP/outpmodule/VBCM_FDCBCMRoomLpSetSta_flg_Inproc/Signal_Override"
 /begin REF_CHARACTERISTIC KOUTP_FDCBCMRoomLpSetSta_flg_ovrdflg KOUTP_FDCBCMRoomLpSetSta_flg_ovrdval /end REF_CHARACTERISTIC
/end GROUP
/begin GROUP S238_Signal_Limit "SWC_OUTP_type/run_SWC_OUTP_5ms_sys/OUTP/outpmodule/VBCM_FDCBCMSLTLpCmd_flg_Inproc/Signal_Limit"
 /begin REF_CHARACTERISTIC KOUTP_FDCBCMSLTLpCmd_flg_maxval KOUTP_FDCBCMSLTLpCmd_flg_minval /end REF_CHARACTERISTIC
/end GROUP
/begin GROUP S238_Signal_Override "SWC_OUTP_type/run_SWC_OUTP_5ms_sys/OUTP/outpmodule/VBCM_FDCBCMSLTLpCmd_flg_Inproc/Signal_Override"
 /begin REF_CHARACTERISTIC KOUTP_FDCBCMSLTLpCmd_flg_ovrdflg KOUTP_FDCBCMSLTLpCmd_flg_ovrdval /end REF_CHARACTERISTIC
/end GROUP
/begin GROUP S239_Signal_Limit "SWC_OUTP_type/run_SWC_OUTP_5ms_sys/OUTP/outpmodule/VBCM_FDCBCMSMKLCmd_flg_Inproc/Signal_Limit"
 /begin REF_CHARACTERISTIC KOUTP_FDCBCMSMKLCmd_flg_maxval KOUTP_FDCBCMSMKLCmd_flg_minval /end REF_CHARACTERISTIC
/end GROUP
/begin GROUP S239_Signal_Override "SWC_OUTP_type/run_SWC_OUTP_5ms_sys/OUTP/outpmodule/VBCM_FDCBCMSMKLCmd_flg_Inproc/Signal_Override"
 /begin REF_CHARACTERISTIC KOUTP_FDCBCMSMKLCmd_flg_ovrdflg KOUTP_FDCBCMSMKLCmd_flg_ovrdval /end REF_CHARACTERISTIC
/end GROUP
/begin GROUP S240_Signal_Limit "SWC_OUTP_type/run_SWC_OUTP_5ms_sys/OUTP/outpmodule/VBCM_FDCBCMSMKRCmd_flg_Inproc/Signal_Limit"
 /begin REF_CHARACTERISTIC KOUTP_FDCBCMSMKRCmd_flg_maxval KOUTP_FDCBCMSMKRCmd_flg_minval /end REF_CHARACTERISTIC
/end GROUP
/begin GROUP S240_Signal_Override "SWC_OUTP_type/run_SWC_OUTP_5ms_sys/OUTP/outpmodule/VBCM_FDCBCMSMKRCmd_flg_Inproc/Signal_Override"
 /begin REF_CHARACTERISTIC KOUTP_FDCBCMSMKRCmd_flg_ovrdflg KOUTP_FDCBCMSMKRCmd_flg_ovrdval /end REF_CHARACTERISTIC
/end GROUP
/begin GROUP S241_Signal_Limit "SWC_OUTP_type/run_SWC_OUTP_5ms_sys/OUTP/outpmodule/VBCM_FDCBCMSRTLpCmd_flg_Inproc/Signal_Limit"
 /begin REF_CHARACTERISTIC KOUTP_FDCBCMSRTLpCmd_flg_maxval KOUTP_FDCBCMSRTLpCmd_flg_minval /end REF_CHARACTERISTIC
/end GROUP
/begin GROUP S241_Signal_Override "SWC_OUTP_type/run_SWC_OUTP_5ms_sys/OUTP/outpmodule/VBCM_FDCBCMSRTLpCmd_flg_Inproc/Signal_Override"
 /begin REF_CHARACTERISTIC KOUTP_FDCBCMSRTLpCmd_flg_ovrdflg KOUTP_FDCBCMSRTLpCmd_flg_ovrdval /end REF_CHARACTERISTIC
/end GROUP
/begin GROUP S242_Signal_Limit "SWC_OUTP_type/run_SWC_OUTP_5ms_sys/OUTP/outpmodule/VBCM_FDCBCMSTOPBALLCmd_flg_Inproc/Signal_Limit"
 /begin REF_CHARACTERISTIC KOUTP_FDCBCMSTOPBALLCmd_flg_maxval KOUTP_FDCBCMSTOPBALLCmd_flg_minval /end REF_CHARACTERISTIC
/end GROUP
/begin GROUP S242_Signal_Override "SWC_OUTP_type/run_SWC_OUTP_5ms_sys/OUTP/outpmodule/VBCM_FDCBCMSTOPBALLCmd_flg_Inproc/Signal_Override"
 /begin REF_CHARACTERISTIC KOUTP_FDCBCMSTOPBALLCmd_flg_ovrdflg KOUTP_FDCBCMSTOPBALLCmd_flg_ovrdval /end REF_CHARACTERISTIC
/end GROUP
/begin GROUP S243_Signal_Limit "SWC_OUTP_type/run_SWC_OUTP_5ms_sys/OUTP/outpmodule/VBCM_FDCBCMStopINDCmd_flg_Inproc/Signal_Limit"
 /begin REF_CHARACTERISTIC KOUTP_FDCBCMStopINDCmd_flg_maxval KOUTP_FDCBCMStopINDCmd_flg_minval /end REF_CHARACTERISTIC
/end GROUP
/begin GROUP S243_Signal_Override "SWC_OUTP_type/run_SWC_OUTP_5ms_sys/OUTP/outpmodule/VBCM_FDCBCMStopINDCmd_flg_Inproc/Signal_Override"
 /begin REF_CHARACTERISTIC KOUTP_FDCBCMStopINDCmd_flg_ovrdflg KOUTP_FDCBCMStopINDCmd_flg_ovrdval /end REF_CHARACTERISTIC
/end GROUP
/begin GROUP S244_Signal_Limit "SWC_OUTP_type/run_SWC_OUTP_5ms_sys/OUTP/outpmodule/VBCM_FDCBCMTurnBuzzerENSta_flg_Inproc/Signal_Limit"
 /begin REF_CHARACTERISTIC KOUTP_FDCBCMTurnBuzzerENSta_flg_maxval KOUTP_FDCBCMTurnBuzzerENSta_flg_minval /end REF_CHARACTERISTIC
/end GROUP
/begin GROUP S244_Signal_Override "SWC_OUTP_type/run_SWC_OUTP_5ms_sys/OUTP/outpmodule/VBCM_FDCBCMTurnBuzzerENSta_flg_Inproc/Signal_Override"
 /begin REF_CHARACTERISTIC KOUTP_FDCBCMTurnBuzzerENSta_flg_ovrdflg KOUTP_FDCBCMTurnBuzzerENSta_flg_ovrdval /end REF_CHARACTERISTIC
/end GROUP
/begin GROUP S245_Signal_Limit "SWC_OUTP_type/run_SWC_OUTP_5ms_sys/OUTP/outpmodule/VBCM_FDCBCMWasherCmd_flg_Inproc/Signal_Limit"
 /begin REF_CHARACTERISTIC KOUTP_FDCBCMWasherCmd_flg_maxval KOUTP_FDCBCMWasherCmd_flg_minval /end REF_CHARACTERISTIC
/end GROUP
/begin GROUP S245_Signal_Override "SWC_OUTP_type/run_SWC_OUTP_5ms_sys/OUTP/outpmodule/VBCM_FDCBCMWasherCmd_flg_Inproc/Signal_Override"
 /begin REF_CHARACTERISTIC KOUTP_FDCBCMWasherCmd_flg_ovrdflg KOUTP_FDCBCMWasherCmd_flg_ovrdval /end REF_CHARACTERISTIC
/end GROUP
/begin GROUP S246_Signal_Limit "SWC_OUTP_type/run_SWC_OUTP_5ms_sys/OUTP/outpmodule/VBCM_FDCBCMWiperHCmd_flg_Inproc/Signal_Limit"
 /begin REF_CHARACTERISTIC KOUTP_FDCBCMWiperHCmd_flg_maxval KOUTP_FDCBCMWiperHCmd_flg_minval /end REF_CHARACTERISTIC
/end GROUP
/begin GROUP S246_Signal_Override "SWC_OUTP_type/run_SWC_OUTP_5ms_sys/OUTP/outpmodule/VBCM_FDCBCMWiperHCmd_flg_Inproc/Signal_Override"
 /begin REF_CHARACTERISTIC KOUTP_FDCBCMWiperHCmd_flg_ovrdflg KOUTP_FDCBCMWiperHCmd_flg_ovrdval /end REF_CHARACTERISTIC
/end GROUP
/begin GROUP S247_Signal_Limit "SWC_OUTP_type/run_SWC_OUTP_5ms_sys/OUTP/outpmodule/VBCM_FDCBCMWiperLCmd_flg_Inproc/Signal_Limit"
 /begin REF_CHARACTERISTIC KOUTP_FDCBCMWiperLCmd_flg_maxval KOUTP_FDCBCMWiperLCmd_flg_minval /end REF_CHARACTERISTIC
/end GROUP
/begin GROUP S247_Signal_Override "SWC_OUTP_type/run_SWC_OUTP_5ms_sys/OUTP/outpmodule/VBCM_FDCBCMWiperLCmd_flg_Inproc/Signal_Override"
 /begin REF_CHARACTERISTIC KOUTP_FDCBCMWiperLCmd_flg_ovrdflg KOUTP_FDCBCMWiperLCmd_flg_ovrdval /end REF_CHARACTERISTIC
/end GROUP
/begin GROUP S248_Signal_Limit "SWC_OUTP_type/run_SWC_OUTP_5ms_sys/OUTP/outpmodule/VBCM_InnerBuzzerModeSta_enum_Inproc/Signal_Limit"
 /begin REF_CHARACTERISTIC KOUTP_InnerBuzzerModeSta_enum_maxval KOUTP_InnerBuzzerModeSta_enum_minval /end REF_CHARACTERISTIC
/end GROUP
/begin GROUP S248_Signal_Override "SWC_OUTP_type/run_SWC_OUTP_5ms_sys/OUTP/outpmodule/VBCM_InnerBuzzerModeSta_enum_Inproc/Signal_Override"
 /begin REF_CHARACTERISTIC KOUTP_InnerBuzzerModeSta_enum_ovrdflg KOUTP_InnerBuzzerModeSta_enum_ovrdval /end REF_CHARACTERISTIC
/end GROUP
/begin GROUP S249_Signal_Limit "SWC_OUTP_type/run_SWC_OUTP_5ms_sys/OUTP/outpmodule/VBCM_KeepWakeUp_flg_Inproc/Signal_Limit" /begin REF_CHARACTERISTIC KOUTP_KeepWakeUp_flg_maxval KOUTP_KeepWakeUp_flg_minval /end REF_CHARACTERISTIC /end GROUP
/begin GROUP S249_Signal_Override "SWC_OUTP_type/run_SWC_OUTP_5ms_sys/OUTP/outpmodule/VBCM_KeepWakeUp_flg_Inproc/Signal_Override" /begin REF_CHARACTERISTIC KOUTP_KeepWakeUp_flg_ovrdflg KOUTP_KeepWakeUp_flg_ovrdval /end REF_CHARACTERISTIC /end GROUP
/begin GROUP S250_Signal_Limit "SWC_OUTP_type/run_SWC_OUTP_5ms_sys/OUTP/outpmodule/VBCM_TurnLpPatternSta_enum_Inproc/Signal_Limit"
 /begin REF_CHARACTERISTIC KOUTP_TurnLpPatternSta_enum_maxval KOUTP_TurnLpPatternSta_enum_minval /end REF_CHARACTERISTIC
/end GROUP
/begin GROUP S250_Signal_Override "SWC_OUTP_type/run_SWC_OUTP_5ms_sys/OUTP/outpmodule/VBCM_TurnLpPatternSta_enum_Inproc/Signal_Override"
 /begin REF_CHARACTERISTIC KOUTP_TurnLpPatternSta_enum_ovrdflg KOUTP_TurnLpPatternSta_enum_ovrdval /end REF_CHARACTERISTIC
/end GROUP
/begin GROUP S251_Signal_Limit "SWC_OUTP_type/run_SWC_OUTP_5ms_sys/OUTP/outpmodule/VBCM_WakeUp_flg_Inproc/Signal_Limit" /begin REF_CHARACTERISTIC KOUTP_WakeUp_flg_maxval KOUTP_WakeUp_flg_minval /end REF_CHARACTERISTIC /end GROUP
/begin GROUP S251_Signal_Override "SWC_OUTP_type/run_SWC_OUTP_5ms_sys/OUTP/outpmodule/VBCM_WakeUp_flg_Inproc/Signal_Override" /begin REF_CHARACTERISTIC KOUTP_WakeUp_flg_ovrdflg KOUTP_WakeUp_flg_ovrdval /end REF_CHARACTERISTIC /end GROUP
/begin GROUP S252_Signal_Limit "SWC_OUTP_type/run_SWC_OUTP_5ms_sys/OUTP/outpmodule/VDDM_5vAPS1PwrErrDTC_raw32_Inproc/Signal_Limit"
 /begin REF_CHARACTERISTIC KOUTP_5vAPS1PwrErrDTC_raw32_maxval KOUTP_5vAPS1PwrErrDTC_raw32_minval /end REF_CHARACTERISTIC
/end GROUP
/begin GROUP S252_Signal_Override "SWC_OUTP_type/run_SWC_OUTP_5ms_sys/OUTP/outpmodule/VDDM_5vAPS1PwrErrDTC_raw32_Inproc/Signal_Override"
 /begin REF_CHARACTERISTIC KOUTP_5vAPS1PwrErrDTC_raw32_ovrdflg KOUTP_5vAPS1PwrErrDTC_raw32_ovrdval /end REF_CHARACTERISTIC
/end GROUP
/begin GROUP S253_Signal_Limit "SWC_OUTP_type/run_SWC_OUTP_5ms_sys/OUTP/outpmodule/VDDM_5vAPS2PwrErrDTC_raw32_Inproc/Signal_Limit"
 /begin REF_CHARACTERISTIC KOUTP_5vAPS2PwrErrDTC_raw32_maxval KOUTP_5vAPS2PwrErrDTC_raw32_minval /end REF_CHARACTERISTIC
/end GROUP
/begin GROUP S253_Signal_Override "SWC_OUTP_type/run_SWC_OUTP_5ms_sys/OUTP/outpmodule/VDDM_5vAPS2PwrErrDTC_raw32_Inproc/Signal_Override"
 /begin REF_CHARACTERISTIC KOUTP_5vAPS2PwrErrDTC_raw32_ovrdflg KOUTP_5vAPS2PwrErrDTC_raw32_ovrdval /end REF_CHARACTERISTIC
/end GROUP
/begin GROUP S254_Signal_Limit "SWC_OUTP_type/run_SWC_OUTP_5ms_sys/OUTP/outpmodule/VDDM_ACCAccelCmdErrDetDTC_raw32_Inproc/Signal_Limit"
 /begin REF_CHARACTERISTIC KOUTP_ACCAccelCmdErrDetDTC_raw32_maxval KOUTP_ACCAccelCmdErrDetDTC_raw32_minval /end REF_CHARACTERISTIC
/end GROUP
/begin GROUP S254_Signal_Override "SWC_OUTP_type/run_SWC_OUTP_5ms_sys/OUTP/outpmodule/VDDM_ACCAccelCmdErrDetDTC_raw32_Inproc/Signal_Override"
 /begin REF_CHARACTERISTIC KOUTP_ACCAccelCmdErrDetDTC_raw32_ovrdflg KOUTP_ACCAccelCmdErrDetDTC_raw32_ovrdval /end REF_CHARACTERISTIC
/end GROUP
/begin GROUP S255_Signal_Limit "SWC_OUTP_type/run_SWC_OUTP_5ms_sys/OUTP/outpmodule/VDDM_ACCMalfuncDetDTC_raw32_Inproc/Signal_Limit"
 /begin REF_CHARACTERISTIC KOUTP_ACCMalfuncDetDTC_raw32_maxval KOUTP_ACCMalfuncDetDTC_raw32_minval /end REF_CHARACTERISTIC
/end GROUP
/begin GROUP S255_Signal_Override "SWC_OUTP_type/run_SWC_OUTP_5ms_sys/OUTP/outpmodule/VDDM_ACCMalfuncDetDTC_raw32_Inproc/Signal_Override"
 /begin REF_CHARACTERISTIC KOUTP_ACCMalfuncDetDTC_raw32_ovrdflg KOUTP_ACCMalfuncDetDTC_raw32_ovrdval /end REF_CHARACTERISTIC
/end GROUP
/begin GROUP S256_Signal_Limit "SWC_OUTP_type/run_SWC_OUTP_5ms_sys/OUTP/outpmodule/VDDM_APS1SigOoRDTC_raw32_Inproc/Signal_Limit"
 /begin REF_CHARACTERISTIC KOUTP_APS1SigOoRDTC_raw32_maxval KOUTP_APS1SigOoRDTC_raw32_minval /end REF_CHARACTERISTIC
/end GROUP
/begin GROUP S256_Signal_Override "SWC_OUTP_type/run_SWC_OUTP_5ms_sys/OUTP/outpmodule/VDDM_APS1SigOoRDTC_raw32_Inproc/Signal_Override"
 /begin REF_CHARACTERISTIC KOUTP_APS1SigOoRDTC_raw32_ovrdflg KOUTP_APS1SigOoRDTC_raw32_ovrdval /end REF_CHARACTERISTIC
/end GROUP
/begin GROUP S257_Signal_Limit "SWC_OUTP_type/run_SWC_OUTP_5ms_sys/OUTP/outpmodule/VDDM_APS2SigOoRDTC_raw32_Inproc/Signal_Limit"
 /begin REF_CHARACTERISTIC KOUTP_APS2SigOoRDTC_raw32_maxval KOUTP_APS2SigOoRDTC_raw32_minval /end REF_CHARACTERISTIC
/end GROUP
/begin GROUP S257_Signal_Override "SWC_OUTP_type/run_SWC_OUTP_5ms_sys/OUTP/outpmodule/VDDM_APS2SigOoRDTC_raw32_Inproc/Signal_Override"
 /begin REF_CHARACTERISTIC KOUTP_APS2SigOoRDTC_raw32_ovrdflg KOUTP_APS2SigOoRDTC_raw32_ovrdval /end REF_CHARACTERISTIC
/end GROUP
/begin GROUP S258_Signal_Limit "SWC_OUTP_type/run_SWC_OUTP_5ms_sys/OUTP/outpmodule/VDDM_APSCorrErrDTC_raw32_Inproc/Signal_Limit"
 /begin REF_CHARACTERISTIC KOUTP_APSCorrErrDTC_raw32_maxval KOUTP_APSCorrErrDTC_raw32_minval /end REF_CHARACTERISTIC
/end GROUP
/begin GROUP S258_Signal_Override "SWC_OUTP_type/run_SWC_OUTP_5ms_sys/OUTP/outpmodule/VDDM_APSCorrErrDTC_raw32_Inproc/Signal_Override"
 /begin REF_CHARACTERISTIC KOUTP_APSCorrErrDTC_raw32_ovrdflg KOUTP_APSCorrErrDTC_raw32_ovrdval /end REF_CHARACTERISTIC
/end GROUP
/begin GROUP S259_Signal_Limit "SWC_OUTP_type/run_SWC_OUTP_5ms_sys/OUTP/outpmodule/VDDM_BMSRdyDTC_raw32_Inproc/Signal_Limit" /begin REF_CHARACTERISTIC KOUTP_BMSRdyDTC_raw32_maxval KOUTP_BMSRdyDTC_raw32_minval /end REF_CHARACTERISTIC /end GROUP
/begin GROUP S259_Signal_Override "SWC_OUTP_type/run_SWC_OUTP_5ms_sys/OUTP/outpmodule/VDDM_BMSRdyDTC_raw32_Inproc/Signal_Override"
 /begin REF_CHARACTERISTIC KOUTP_BMSRdyDTC_raw32_ovrdflg KOUTP_BMSRdyDTC_raw32_ovrdval /end REF_CHARACTERISTIC
/end GROUP
/begin GROUP S260_Signal_Limit "SWC_OUTP_type/run_SWC_OUTP_5ms_sys/OUTP/outpmodule/VDDM_BMSSigErrDetDTC_raw32_Inproc/Signal_Limit"
 /begin REF_CHARACTERISTIC KOUTP_BMSSigErrDetDTC_raw32_maxval KOUTP_BMSSigErrDetDTC_raw32_minval /end REF_CHARACTERISTIC
/end GROUP
/begin GROUP S260_Signal_Override "SWC_OUTP_type/run_SWC_OUTP_5ms_sys/OUTP/outpmodule/VDDM_BMSSigErrDetDTC_raw32_Inproc/Signal_Override"
 /begin REF_CHARACTERISTIC KOUTP_BMSSigErrDetDTC_raw32_ovrdflg KOUTP_BMSSigErrDetDTC_raw32_ovrdval /end REF_CHARACTERISTIC
/end GROUP
/begin GROUP S261_Signal_Limit "SWC_OUTP_type/run_SWC_OUTP_5ms_sys/OUTP/outpmodule/VDDM_BrkSWErrDTC_raw32_Inproc/Signal_Limit"
 /begin REF_CHARACTERISTIC KOUTP_BrkSWErrDTC_raw32_maxval KOUTP_BrkSWErrDTC_raw32_minval /end REF_CHARACTERISTIC
/end GROUP
/begin GROUP S261_Signal_Override "SWC_OUTP_type/run_SWC_OUTP_5ms_sys/OUTP/outpmodule/VDDM_BrkSWErrDTC_raw32_Inproc/Signal_Override"
 /begin REF_CHARACTERISTIC KOUTP_BrkSWErrDTC_raw32_ovrdflg KOUTP_BrkSWErrDTC_raw32_ovrdval /end REF_CHARACTERISTIC
/end GROUP
/begin GROUP S262_Signal_Limit "SWC_OUTP_type/run_SWC_OUTP_5ms_sys/OUTP/outpmodule/VDDM_BrkSWNoBacDTC_raw32_Inproc/Signal_Limit"
 /begin REF_CHARACTERISTIC KOUTP_BrkSWNoBacDTC_raw32_maxval KOUTP_BrkSWNoBacDTC_raw32_minval /end REF_CHARACTERISTIC
/end GROUP
/begin GROUP S262_Signal_Override "SWC_OUTP_type/run_SWC_OUTP_5ms_sys/OUTP/outpmodule/VDDM_BrkSWNoBacDTC_raw32_Inproc/Signal_Override"
 /begin REF_CHARACTERISTIC KOUTP_BrkSWNoBacDTC_raw32_ovrdflg KOUTP_BrkSWNoBacDTC_raw32_ovrdval /end REF_CHARACTERISTIC
/end GROUP
/begin GROUP S263_Signal_Limit "SWC_OUTP_type/run_SWC_OUTP_5ms_sys/OUTP/outpmodule/VDDM_C1ABM1CSDTC_raw32_Inproc/Signal_Limit"
 /begin REF_CHARACTERISTIC KOUTP_C1ABM1CSDTC_raw32_maxval KOUTP_C1ABM1CSDTC_raw32_minval /end REF_CHARACTERISTIC
/end GROUP
/begin GROUP S263_Signal_Override "SWC_OUTP_type/run_SWC_OUTP_5ms_sys/OUTP/outpmodule/VDDM_C1ABM1CSDTC_raw32_Inproc/Signal_Override"
 /begin REF_CHARACTERISTIC KOUTP_C1ABM1CSDTC_raw32_ovrdflg KOUTP_C1ABM1CSDTC_raw32_ovrdval /end REF_CHARACTERISTIC
/end GROUP
/begin GROUP S264_Signal_Limit "SWC_OUTP_type/run_SWC_OUTP_5ms_sys/OUTP/outpmodule/VDDM_C1ABM1LCDTC_raw32_Inproc/Signal_Limit"
 /begin REF_CHARACTERISTIC KOUTP_C1ABM1LCDTC_raw32_maxval KOUTP_C1ABM1LCDTC_raw32_minval /end REF_CHARACTERISTIC
/end GROUP
/begin GROUP S264_Signal_Override "SWC_OUTP_type/run_SWC_OUTP_5ms_sys/OUTP/outpmodule/VDDM_C1ABM1LCDTC_raw32_Inproc/Signal_Override"
 /begin REF_CHARACTERISTIC KOUTP_C1ABM1LCDTC_raw32_ovrdflg KOUTP_C1ABM1LCDTC_raw32_ovrdval /end REF_CHARACTERISTIC
/end GROUP
/begin GROUP S265_Signal_Limit "SWC_OUTP_type/run_SWC_OUTP_5ms_sys/OUTP/outpmodule/VDDM_C1ABM1RCDTC_raw32_Inproc/Signal_Limit"
 /begin REF_CHARACTERISTIC KOUTP_C1ABM1RCDTC_raw32_maxval KOUTP_C1ABM1RCDTC_raw32_minval /end REF_CHARACTERISTIC
/end GROUP
/begin GROUP S265_Signal_Override "SWC_OUTP_type/run_SWC_OUTP_5ms_sys/OUTP/outpmodule/VDDM_C1ABM1RCDTC_raw32_Inproc/Signal_Override"
 /begin REF_CHARACTERISTIC KOUTP_C1ABM1RCDTC_raw32_ovrdflg KOUTP_C1ABM1RCDTC_raw32_ovrdval /end REF_CHARACTERISTIC
/end GROUP
/begin GROUP S266_Signal_Limit "SWC_OUTP_type/run_SWC_OUTP_5ms_sys/OUTP/outpmodule/VDDM_C1EPAS2LCDTC_raw32_Inproc/Signal_Limit"
 /begin REF_CHARACTERISTIC KOUTP_C1EPAS2LCDTC_raw32_maxval KOUTP_C1EPAS2LCDTC_raw32_minval /end REF_CHARACTERISTIC
/end GROUP
/begin GROUP S266_Signal_Override "SWC_OUTP_type/run_SWC_OUTP_5ms_sys/OUTP/outpmodule/VDDM_C1EPAS2LCDTC_raw32_Inproc/Signal_Override"
 /begin REF_CHARACTERISTIC KOUTP_C1EPAS2LCDTC_raw32_ovrdflg KOUTP_C1EPAS2LCDTC_raw32_ovrdval /end REF_CHARACTERISTIC
/end GROUP
/begin GROUP S267_Signal_Limit "SWC_OUTP_type/run_SWC_OUTP_5ms_sys/OUTP/outpmodule/VDDM_C3BMS1CSDTC_raw32_Inproc/Signal_Limit"
 /begin REF_CHARACTERISTIC KOUTP_C3BMS1CSDTC_raw32_maxval KOUTP_C3BMS1CSDTC_raw32_minval /end REF_CHARACTERISTIC
/end GROUP
/begin GROUP S267_Signal_Override "SWC_OUTP_type/run_SWC_OUTP_5ms_sys/OUTP/outpmodule/VDDM_C3BMS1CSDTC_raw32_Inproc/Signal_Override"
 /begin REF_CHARACTERISTIC KOUTP_C3BMS1CSDTC_raw32_ovrdflg KOUTP_C3BMS1CSDTC_raw32_ovrdval /end REF_CHARACTERISTIC
/end GROUP
/begin GROUP S268_Signal_Limit "SWC_OUTP_type/run_SWC_OUTP_5ms_sys/OUTP/outpmodule/VDDM_C3BMS1LCDTC_raw32_Inproc/Signal_Limit"
 /begin REF_CHARACTERISTIC KOUTP_C3BMS1LCDTC_raw32_maxval KOUTP_C3BMS1LCDTC_raw32_minval /end REF_CHARACTERISTIC
/end GROUP
/begin GROUP S268_Signal_Override "SWC_OUTP_type/run_SWC_OUTP_5ms_sys/OUTP/outpmodule/VDDM_C3BMS1LCDTC_raw32_Inproc/Signal_Override"
 /begin REF_CHARACTERISTIC KOUTP_C3BMS1LCDTC_raw32_ovrdflg KOUTP_C3BMS1LCDTC_raw32_ovrdval /end REF_CHARACTERISTIC
/end GROUP
/begin GROUP S269_Signal_Limit "SWC_OUTP_type/run_SWC_OUTP_5ms_sys/OUTP/outpmodule/VDDM_C3BMS1RCDTC_raw32_Inproc/Signal_Limit"
 /begin REF_CHARACTERISTIC KOUTP_C3BMS1RCDTC_raw32_maxval KOUTP_C3BMS1RCDTC_raw32_minval /end REF_CHARACTERISTIC
/end GROUP
/begin GROUP S269_Signal_Override "SWC_OUTP_type/run_SWC_OUTP_5ms_sys/OUTP/outpmodule/VDDM_C3BMS1RCDTC_raw32_Inproc/Signal_Override"
 /begin REF_CHARACTERISTIC KOUTP_C3BMS1RCDTC_raw32_ovrdflg KOUTP_C3BMS1RCDTC_raw32_ovrdval /end REF_CHARACTERISTIC
/end GROUP
/begin GROUP S270_Signal_Limit "SWC_OUTP_type/run_SWC_OUTP_5ms_sys/OUTP/outpmodule/VDDM_C3BMS6CSDTC_raw32_Inproc/Signal_Limit"
 /begin REF_CHARACTERISTIC KOUTP_C3BMS6CSDTC_raw32_maxval KOUTP_C3BMS6CSDTC_raw32_minval /end REF_CHARACTERISTIC
/end GROUP
/begin GROUP S270_Signal_Override "SWC_OUTP_type/run_SWC_OUTP_5ms_sys/OUTP/outpmodule/VDDM_C3BMS6CSDTC_raw32_Inproc/Signal_Override"
 /begin REF_CHARACTERISTIC KOUTP_C3BMS6CSDTC_raw32_ovrdflg KOUTP_C3BMS6CSDTC_raw32_ovrdval /end REF_CHARACTERISTIC
/end GROUP
/begin GROUP S271_Signal_Limit "SWC_OUTP_type/run_SWC_OUTP_5ms_sys/OUTP/outpmodule/VDDM_C3BMS6LCDTC_raw32_Inproc/Signal_Limit"
 /begin REF_CHARACTERISTIC KOUTP_C3BMS6LCDTC_raw32_maxval KOUTP_C3BMS6LCDTC_raw32_minval /end REF_CHARACTERISTIC
/end GROUP
/begin GROUP S271_Signal_Override "SWC_OUTP_type/run_SWC_OUTP_5ms_sys/OUTP/outpmodule/VDDM_C3BMS6LCDTC_raw32_Inproc/Signal_Override"
 /begin REF_CHARACTERISTIC KOUTP_C3BMS6LCDTC_raw32_ovrdflg KOUTP_C3BMS6LCDTC_raw32_ovrdval /end REF_CHARACTERISTIC
/end GROUP
/begin GROUP S272_Signal_Limit "SWC_OUTP_type/run_SWC_OUTP_5ms_sys/OUTP/outpmodule/VDDM_C3BMS6RCDTC_raw32_Inproc/Signal_Limit"
 /begin REF_CHARACTERISTIC KOUTP_C3BMS6RCDTC_raw32_maxval KOUTP_C3BMS6RCDTC_raw32_minval /end REF_CHARACTERISTIC
/end GROUP
/begin GROUP S272_Signal_Override "SWC_OUTP_type/run_SWC_OUTP_5ms_sys/OUTP/outpmodule/VDDM_C3BMS6RCDTC_raw32_Inproc/Signal_Override"
 /begin REF_CHARACTERISTIC KOUTP_C3BMS6RCDTC_raw32_ovrdflg KOUTP_C3BMS6RCDTC_raw32_ovrdval /end REF_CHARACTERISTIC
/end GROUP
/begin GROUP S273_Signal_Limit "SWC_OUTP_type/run_SWC_OUTP_5ms_sys/OUTP/outpmodule/VDDM_C3CCU1CSDTC_raw32_Inproc/Signal_Limit"
 /begin REF_CHARACTERISTIC KOUTP_C3CCU1CSDTC_raw32_maxval KOUTP_C3CCU1CSDTC_raw32_minval /end REF_CHARACTERISTIC
/end GROUP
/begin GROUP S273_Signal_Override "SWC_OUTP_type/run_SWC_OUTP_5ms_sys/OUTP/outpmodule/VDDM_C3CCU1CSDTC_raw32_Inproc/Signal_Override"
 /begin REF_CHARACTERISTIC KOUTP_C3CCU1CSDTC_raw32_ovrdflg KOUTP_C3CCU1CSDTC_raw32_ovrdval /end REF_CHARACTERISTIC
/end GROUP
/begin GROUP S274_Signal_Limit "SWC_OUTP_type/run_SWC_OUTP_5ms_sys/OUTP/outpmodule/VDDM_C3CCU1LCDTC_raw32_Inproc/Signal_Limit"
 /begin REF_CHARACTERISTIC KOUTP_C3CCU1LCDTC_raw32_maxval KOUTP_C3CCU1LCDTC_raw32_minval /end REF_CHARACTERISTIC
/end GROUP
/begin GROUP S274_Signal_Override "SWC_OUTP_type/run_SWC_OUTP_5ms_sys/OUTP/outpmodule/VDDM_C3CCU1LCDTC_raw32_Inproc/Signal_Override"
 /begin REF_CHARACTERISTIC KOUTP_C3CCU1LCDTC_raw32_ovrdflg KOUTP_C3CCU1LCDTC_raw32_ovrdval /end REF_CHARACTERISTIC
/end GROUP
/begin GROUP S275_Signal_Limit "SWC_OUTP_type/run_SWC_OUTP_5ms_sys/OUTP/outpmodule/VDDM_C3CCU1RCDTC_raw32_Inproc/Signal_Limit"
 /begin REF_CHARACTERISTIC KOUTP_C3CCU1RCDTC_raw32_maxval KOUTP_C3CCU1RCDTC_raw32_minval /end REF_CHARACTERISTIC
/end GROUP
/begin GROUP S275_Signal_Override "SWC_OUTP_type/run_SWC_OUTP_5ms_sys/OUTP/outpmodule/VDDM_C3CCU1RCDTC_raw32_Inproc/Signal_Override"
 /begin REF_CHARACTERISTIC KOUTP_C3CCU1RCDTC_raw32_ovrdflg KOUTP_C3CCU1RCDTC_raw32_ovrdval /end REF_CHARACTERISTIC
/end GROUP
/begin GROUP S276_Signal_Limit "SWC_OUTP_type/run_SWC_OUTP_5ms_sys/OUTP/outpmodule/VDDM_C3CCU2CSDTC_raw32_Inproc/Signal_Limit"
 /begin REF_CHARACTERISTIC KOUTP_C3CCU2CSDTC_raw32_maxval KOUTP_C3CCU2CSDTC_raw32_minval /end REF_CHARACTERISTIC
/end GROUP
/begin GROUP S276_Signal_Override "SWC_OUTP_type/run_SWC_OUTP_5ms_sys/OUTP/outpmodule/VDDM_C3CCU2CSDTC_raw32_Inproc/Signal_Override"
 /begin REF_CHARACTERISTIC KOUTP_C3CCU2CSDTC_raw32_ovrdflg KOUTP_C3CCU2CSDTC_raw32_ovrdval /end REF_CHARACTERISTIC
/end GROUP
/begin GROUP S277_Signal_Limit "SWC_OUTP_type/run_SWC_OUTP_5ms_sys/OUTP/outpmodule/VDDM_C3CCU2LCDTC_raw32_Inproc/Signal_Limit"
 /begin REF_CHARACTERISTIC KOUTP_C3CCU2LCDTC_raw32_maxval KOUTP_C3CCU2LCDTC_raw32_minval /end REF_CHARACTERISTIC
/end GROUP
/begin GROUP S277_Signal_Override "SWC_OUTP_type/run_SWC_OUTP_5ms_sys/OUTP/outpmodule/VDDM_C3CCU2LCDTC_raw32_Inproc/Signal_Override"
 /begin REF_CHARACTERISTIC KOUTP_C3CCU2LCDTC_raw32_ovrdflg KOUTP_C3CCU2LCDTC_raw32_ovrdval /end REF_CHARACTERISTIC
/end GROUP
/begin GROUP S278_Signal_Limit "SWC_OUTP_type/run_SWC_OUTP_5ms_sys/OUTP/outpmodule/VDDM_C3CCU2RCDTC_raw32_Inproc/Signal_Limit"
 /begin REF_CHARACTERISTIC KOUTP_C3CCU2RCDTC_raw32_maxval KOUTP_C3CCU2RCDTC_raw32_minval /end REF_CHARACTERISTIC
/end GROUP
/begin GROUP S278_Signal_Override "SWC_OUTP_type/run_SWC_OUTP_5ms_sys/OUTP/outpmodule/VDDM_C3CCU2RCDTC_raw32_Inproc/Signal_Override"
 /begin REF_CHARACTERISTIC KOUTP_C3CCU2RCDTC_raw32_ovrdflg KOUTP_C3CCU2RCDTC_raw32_ovrdval /end REF_CHARACTERISTIC
/end GROUP
/begin GROUP S279_Signal_Limit "SWC_OUTP_type/run_SWC_OUTP_5ms_sys/OUTP/outpmodule/VDDM_CCMalfuncDetDTC_raw32_Inproc/Signal_Limit"
 /begin REF_CHARACTERISTIC KOUTP_CCMalfuncDetDTC_raw32_maxval KOUTP_CCMalfuncDetDTC_raw32_minval /end REF_CHARACTERISTIC
/end GROUP
/begin GROUP S279_Signal_Override "SWC_OUTP_type/run_SWC_OUTP_5ms_sys/OUTP/outpmodule/VDDM_CCMalfuncDetDTC_raw32_Inproc/Signal_Override"
 /begin REF_CHARACTERISTIC KOUTP_CCMalfuncDetDTC_raw32_ovrdflg KOUTP_CCMalfuncDetDTC_raw32_ovrdval /end REF_CHARACTERISTIC
/end GROUP
/begin GROUP S280_Signal_Limit "SWC_OUTP_type/run_SWC_OUTP_5ms_sys/OUTP/outpmodule/VDDM_CCUSigErrDetDTC_raw32_Inproc/Signal_Limit"
 /begin REF_CHARACTERISTIC KOUTP_CCUSigErrDetDTC_raw32_maxval KOUTP_CCUSigErrDetDTC_raw32_minval /end REF_CHARACTERISTIC
/end GROUP
/begin GROUP S280_Signal_Override "SWC_OUTP_type/run_SWC_OUTP_5ms_sys/OUTP/outpmodule/VDDM_CCUSigErrDetDTC_raw32_Inproc/Signal_Override"
 /begin REF_CHARACTERISTIC KOUTP_CCUSigErrDetDTC_raw32_ovrdflg KOUTP_CCUSigErrDetDTC_raw32_ovrdval /end REF_CHARACTERISTIC
/end GROUP
/begin GROUP S281_Signal_Limit "SWC_OUTP_type/run_SWC_OUTP_5ms_sys/OUTP/outpmodule/VDDM_DCDC4PreDTC_raw32_Inproc/Signal_Limit"
 /begin REF_CHARACTERISTIC KOUTP_DCDC4PreDTC_raw32_maxval KOUTP_DCDC4PreDTC_raw32_minval /end REF_CHARACTERISTIC
/end GROUP
/begin GROUP S281_Signal_Override "SWC_OUTP_type/run_SWC_OUTP_5ms_sys/OUTP/outpmodule/VDDM_DCDC4PreDTC_raw32_Inproc/Signal_Override"
 /begin REF_CHARACTERISTIC KOUTP_DCDC4PreDTC_raw32_ovrdflg KOUTP_DCDC4PreDTC_raw32_ovrdval /end REF_CHARACTERISTIC
/end GROUP
/begin GROUP S282_Signal_Limit "SWC_OUTP_type/run_SWC_OUTP_5ms_sys/OUTP/outpmodule/VDDM_DCDCDisDTC_raw32_Inproc/Signal_Limit"
 /begin REF_CHARACTERISTIC KOUTP_DCDCDisDTC_raw32_maxval KOUTP_DCDCDisDTC_raw32_minval /end REF_CHARACTERISTIC
/end GROUP
/begin GROUP S282_Signal_Override "SWC_OUTP_type/run_SWC_OUTP_5ms_sys/OUTP/outpmodule/VDDM_DCDCDisDTC_raw32_Inproc/Signal_Override"
 /begin REF_CHARACTERISTIC KOUTP_DCDCDisDTC_raw32_ovrdflg KOUTP_DCDCDisDTC_raw32_ovrdval /end REF_CHARACTERISTIC
/end GROUP
/begin GROUP S283_Signal_Limit "SWC_OUTP_type/run_SWC_OUTP_5ms_sys/OUTP/outpmodule/VDDM_DCDCEnaDTC_raw32_Inproc/Signal_Limit"
 /begin REF_CHARACTERISTIC KOUTP_DCDCEnaDTC_raw32_maxval KOUTP_DCDCEnaDTC_raw32_minval /end REF_CHARACTERISTIC
/end GROUP
/begin GROUP S283_Signal_Override "SWC_OUTP_type/run_SWC_OUTP_5ms_sys/OUTP/outpmodule/VDDM_DCDCEnaDTC_raw32_Inproc/Signal_Override"
 /begin REF_CHARACTERISTIC KOUTP_DCDCEnaDTC_raw32_ovrdflg KOUTP_DCDCEnaDTC_raw32_ovrdval /end REF_CHARACTERISTIC
/end GROUP
/begin GROUP S284_Signal_Limit "SWC_OUTP_type/run_SWC_OUTP_5ms_sys/OUTP/outpmodule/VDDM_DTCDetect_enum_Inproc/Signal_Limit" /begin REF_CHARACTERISTIC KOUTP_DTCDetect_enum_maxval KOUTP_DTCDetect_enum_minval /end REF_CHARACTERISTIC /end GROUP
/begin GROUP S284_Signal_Override "SWC_OUTP_type/run_SWC_OUTP_5ms_sys/OUTP/outpmodule/VDDM_DTCDetect_enum_Inproc/Signal_Override" /begin REF_CHARACTERISTIC KOUTP_DTCDetect_enum_ovrdflg KOUTP_DTCDetect_enum_ovrdval /end REF_CHARACTERISTIC /end GROUP
/begin GROUP S285_Signal_Limit "SWC_OUTP_type/run_SWC_OUTP_5ms_sys/OUTP/outpmodule/VDDM_DiagFLTSDTC_raw32_Inproc/Signal_Limit"
 /begin REF_CHARACTERISTIC KOUTP_DiagFLTSDTC_raw32_maxval KOUTP_DiagFLTSDTC_raw32_minval /end REF_CHARACTERISTIC
/end GROUP
/begin GROUP S285_Signal_Override "SWC_OUTP_type/run_SWC_OUTP_5ms_sys/OUTP/outpmodule/VDDM_DiagFLTSDTC_raw32_Inproc/Signal_Override"
 /begin REF_CHARACTERISTIC KOUTP_DiagFLTSDTC_raw32_ovrdflg KOUTP_DiagFLTSDTC_raw32_ovrdval /end REF_CHARACTERISTIC
/end GROUP
/begin GROUP S286_Signal_Limit "SWC_OUTP_type/run_SWC_OUTP_5ms_sys/OUTP/outpmodule/VDDM_DiagFRTSDTC_raw32_Inproc/Signal_Limit"
 /begin REF_CHARACTERISTIC KOUTP_DiagFRTSDTC_raw32_maxval KOUTP_DiagFRTSDTC_raw32_minval /end REF_CHARACTERISTIC
/end GROUP
/begin GROUP S286_Signal_Override "SWC_OUTP_type/run_SWC_OUTP_5ms_sys/OUTP/outpmodule/VDDM_DiagFRTSDTC_raw32_Inproc/Signal_Override"
 /begin REF_CHARACTERISTIC KOUTP_DiagFRTSDTC_raw32_ovrdflg KOUTP_DiagFRTSDTC_raw32_ovrdval /end REF_CHARACTERISTIC
/end GROUP
/begin GROUP S287_Signal_Limit "SWC_OUTP_type/run_SWC_OUTP_5ms_sys/OUTP/outpmodule/VDDM_DiagHCrashDTC_raw32_Inproc/Signal_Limit"
 /begin REF_CHARACTERISTIC KOUTP_DiagHCrashDTC_raw32_maxval KOUTP_DiagHCrashDTC_raw32_minval /end REF_CHARACTERISTIC
/end GROUP
/begin GROUP S287_Signal_Override "SWC_OUTP_type/run_SWC_OUTP_5ms_sys/OUTP/outpmodule/VDDM_DiagHCrashDTC_raw32_Inproc/Signal_Override"
 /begin REF_CHARACTERISTIC KOUTP_DiagHCrashDTC_raw32_ovrdflg KOUTP_DiagHCrashDTC_raw32_ovrdval /end REF_CHARACTERISTIC
/end GROUP
/begin GROUP S288_Signal_Limit "SWC_OUTP_type/run_SWC_OUTP_5ms_sys/OUTP/outpmodule/VDDM_DiagRLTSDTC_raw32_Inproc/Signal_Limit"
 /begin REF_CHARACTERISTIC KOUTP_DiagRLTSDTC_raw32_maxval KOUTP_DiagRLTSDTC_raw32_minval /end REF_CHARACTERISTIC
/end GROUP
/begin GROUP S288_Signal_Override "SWC_OUTP_type/run_SWC_OUTP_5ms_sys/OUTP/outpmodule/VDDM_DiagRLTSDTC_raw32_Inproc/Signal_Override"
 /begin REF_CHARACTERISTIC KOUTP_DiagRLTSDTC_raw32_ovrdflg KOUTP_DiagRLTSDTC_raw32_ovrdval /end REF_CHARACTERISTIC
/end GROUP
/begin GROUP S289_Signal_Limit "SWC_OUTP_type/run_SWC_OUTP_5ms_sys/OUTP/outpmodule/VDDM_DiagRRTSDTC_raw32_Inproc/Signal_Limit"
 /begin REF_CHARACTERISTIC KOUTP_DiagRRTSDTC_raw32_maxval KOUTP_DiagRRTSDTC_raw32_minval /end REF_CHARACTERISTIC
/end GROUP
/begin GROUP S289_Signal_Override "SWC_OUTP_type/run_SWC_OUTP_5ms_sys/OUTP/outpmodule/VDDM_DiagRRTSDTC_raw32_Inproc/Signal_Override"
 /begin REF_CHARACTERISTIC KOUTP_DiagRRTSDTC_raw32_ovrdflg KOUTP_DiagRRTSDTC_raw32_ovrdval /end REF_CHARACTERISTIC
/end GROUP
/begin GROUP S290_Signal_Limit "SWC_OUTP_type/run_SWC_OUTP_5ms_sys/OUTP/outpmodule/VDDM_DisengagePFail_flg_Inproc/Signal_Limit"
 /begin REF_CHARACTERISTIC KOUTP_DisengagePFail_flg_maxval KOUTP_DisengagePFail_flg_minval /end REF_CHARACTERISTIC
/end GROUP
/begin GROUP S290_Signal_Override "SWC_OUTP_type/run_SWC_OUTP_5ms_sys/OUTP/outpmodule/VDDM_DisengagePFail_flg_Inproc/Signal_Override"
 /begin REF_CHARACTERISTIC KOUTP_DisengagePFail_flg_ovrdflg KOUTP_DisengagePFail_flg_ovrdval /end REF_CHARACTERISTIC
/end GROUP
/begin GROUP S291_Signal_Limit "SWC_OUTP_type/run_SWC_OUTP_5ms_sys/OUTP/outpmodule/VDDM_DrStSWDTC_raw32_Inproc/Signal_Limit" /begin REF_CHARACTERISTIC KOUTP_DrStSWDTC_raw32_maxval KOUTP_DrStSWDTC_raw32_minval /end REF_CHARACTERISTIC /end GROUP
/begin GROUP S291_Signal_Override "SWC_OUTP_type/run_SWC_OUTP_5ms_sys/OUTP/outpmodule/VDDM_DrStSWDTC_raw32_Inproc/Signal_Override"
 /begin REF_CHARACTERISTIC KOUTP_DrStSWDTC_raw32_ovrdflg KOUTP_DrStSWDTC_raw32_ovrdval /end REF_CHARACTERISTIC
/end GROUP
/begin GROUP S292_Signal_Limit "SWC_OUTP_type/run_SWC_OUTP_5ms_sys/OUTP/outpmodule/VDDM_EDriveSysErrShifterErr_flg_Inproc/Signal_Limit"
 /begin REF_CHARACTERISTIC KOUTP_EDriveSysErrShifterErr_flg_maxval KOUTP_EDriveSysErrShifterErr_flg_minval /end REF_CHARACTERISTIC
/end GROUP
/begin GROUP S292_Signal_Override "SWC_OUTP_type/run_SWC_OUTP_5ms_sys/OUTP/outpmodule/VDDM_EDriveSysErrShifterErr_flg_Inproc/Signal_Override"
 /begin REF_CHARACTERISTIC KOUTP_EDriveSysErrShifterErr_flg_ovrdflg KOUTP_EDriveSysErrShifterErr_flg_ovrdval /end REF_CHARACTERISTIC
/end GROUP
/begin GROUP S293_Signal_Limit "SWC_OUTP_type/run_SWC_OUTP_5ms_sys/OUTP/outpmodule/VDDM_EDriveSysErrVCUErr_flg_Inproc/Signal_Limit"
 /begin REF_CHARACTERISTIC KOUTP_EDriveSysErrVCUErr_flg_maxval KOUTP_EDriveSysErrVCUErr_flg_minval /end REF_CHARACTERISTIC
/end GROUP
/begin GROUP S293_Signal_Override "SWC_OUTP_type/run_SWC_OUTP_5ms_sys/OUTP/outpmodule/VDDM_EDriveSysErrVCUErr_flg_Inproc/Signal_Override"
 /begin REF_CHARACTERISTIC KOUTP_EDriveSysErrVCUErr_flg_ovrdflg KOUTP_EDriveSysErrVCUErr_flg_ovrdval /end REF_CHARACTERISTIC
/end GROUP
/begin GROUP S294_Signal_Limit "SWC_OUTP_type/run_SWC_OUTP_5ms_sys/OUTP/outpmodule/VDDM_EPBLockTODTC_raw32_Inproc/Signal_Limit"
 /begin REF_CHARACTERISTIC KOUTP_EPBLockTODTC_raw32_maxval KOUTP_EPBLockTODTC_raw32_minval /end REF_CHARACTERISTIC
/end GROUP
/begin GROUP S294_Signal_Override "SWC_OUTP_type/run_SWC_OUTP_5ms_sys/OUTP/outpmodule/VDDM_EPBLockTODTC_raw32_Inproc/Signal_Override"
 /begin REF_CHARACTERISTIC KOUTP_EPBLockTODTC_raw32_ovrdflg KOUTP_EPBLockTODTC_raw32_ovrdval /end REF_CHARACTERISTIC
/end GROUP
/begin GROUP S295_Signal_Limit "SWC_OUTP_type/run_SWC_OUTP_5ms_sys/OUTP/outpmodule/VDDM_EPBUnlockTODTC_raw32_Inproc/Signal_Limit"
 /begin REF_CHARACTERISTIC KOUTP_EPBUnlockTODTC_raw32_maxval KOUTP_EPBUnlockTODTC_raw32_minval /end REF_CHARACTERISTIC
/end GROUP
/begin GROUP S295_Signal_Override "SWC_OUTP_type/run_SWC_OUTP_5ms_sys/OUTP/outpmodule/VDDM_EPBUnlockTODTC_raw32_Inproc/Signal_Override"
 /begin REF_CHARACTERISTIC KOUTP_EPBUnlockTODTC_raw32_ovrdflg KOUTP_EPBUnlockTODTC_raw32_ovrdval /end REF_CHARACTERISTIC
/end GROUP
/begin GROUP S296_Signal_Limit "SWC_OUTP_type/run_SWC_OUTP_5ms_sys/OUTP/outpmodule/VDDM_ESC1CSErrDTC_raw32_Inproc/Signal_Limit"
 /begin REF_CHARACTERISTIC KOUTP_ESC1CSErrDTC_raw32_maxval KOUTP_ESC1CSErrDTC_raw32_minval /end REF_CHARACTERISTIC
/end GROUP
/begin GROUP S296_Signal_Override "SWC_OUTP_type/run_SWC_OUTP_5ms_sys/OUTP/outpmodule/VDDM_ESC1CSErrDTC_raw32_Inproc/Signal_Override"
 /begin REF_CHARACTERISTIC KOUTP_ESC1CSErrDTC_raw32_ovrdflg KOUTP_ESC1CSErrDTC_raw32_ovrdval /end REF_CHARACTERISTIC
/end GROUP
/begin GROUP S297_Signal_Limit "SWC_OUTP_type/run_SWC_OUTP_5ms_sys/OUTP/outpmodule/VDDM_ESC1NoComDTC_raw32_Inproc/Signal_Limit"
 /begin REF_CHARACTERISTIC KOUTP_ESC1NoComDTC_raw32_maxval KOUTP_ESC1NoComDTC_raw32_minval /end REF_CHARACTERISTIC
/end GROUP
/begin GROUP S297_Signal_Override "SWC_OUTP_type/run_SWC_OUTP_5ms_sys/OUTP/outpmodule/VDDM_ESC1NoComDTC_raw32_Inproc/Signal_Override"
 /begin REF_CHARACTERISTIC KOUTP_ESC1NoComDTC_raw32_ovrdflg KOUTP_ESC1NoComDTC_raw32_ovrdval /end REF_CHARACTERISTIC
/end GROUP
/begin GROUP S298_Signal_Limit "SWC_OUTP_type/run_SWC_OUTP_5ms_sys/OUTP/outpmodule/VDDM_ESC1RCErrDTC_raw32_Inproc/Signal_Limit"
 /begin REF_CHARACTERISTIC KOUTP_ESC1RCErrDTC_raw32_maxval KOUTP_ESC1RCErrDTC_raw32_minval /end REF_CHARACTERISTIC
/end GROUP
/begin GROUP S298_Signal_Override "SWC_OUTP_type/run_SWC_OUTP_5ms_sys/OUTP/outpmodule/VDDM_ESC1RCErrDTC_raw32_Inproc/Signal_Override"
 /begin REF_CHARACTERISTIC KOUTP_ESC1RCErrDTC_raw32_ovrdflg KOUTP_ESC1RCErrDTC_raw32_ovrdval /end REF_CHARACTERISTIC
/end GROUP
/begin GROUP S299_Signal_Limit "SWC_OUTP_type/run_SWC_OUTP_5ms_sys/OUTP/outpmodule/VDDM_ESC5CSErrDTC_raw32_Inproc/Signal_Limit"
 /begin REF_CHARACTERISTIC KOUTP_ESC5CSErrDTC_raw32_maxval KOUTP_ESC5CSErrDTC_raw32_minval /end REF_CHARACTERISTIC
/end GROUP
/begin GROUP S299_Signal_Override "SWC_OUTP_type/run_SWC_OUTP_5ms_sys/OUTP/outpmodule/VDDM_ESC5CSErrDTC_raw32_Inproc/Signal_Override"
 /begin REF_CHARACTERISTIC KOUTP_ESC5CSErrDTC_raw32_ovrdflg KOUTP_ESC5CSErrDTC_raw32_ovrdval /end REF_CHARACTERISTIC
/end GROUP
/begin GROUP S300_Signal_Limit "SWC_OUTP_type/run_SWC_OUTP_5ms_sys/OUTP/outpmodule/VDDM_ESC5NoComDTC_raw32_Inproc/Signal_Limit"
 /begin REF_CHARACTERISTIC KOUTP_ESC5NoComDTC_raw32_maxval KOUTP_ESC5NoComDTC_raw32_minval /end REF_CHARACTERISTIC
/end GROUP
/begin GROUP S300_Signal_Override "SWC_OUTP_type/run_SWC_OUTP_5ms_sys/OUTP/outpmodule/VDDM_ESC5NoComDTC_raw32_Inproc/Signal_Override"
 /begin REF_CHARACTERISTIC KOUTP_ESC5NoComDTC_raw32_ovrdflg KOUTP_ESC5NoComDTC_raw32_ovrdval /end REF_CHARACTERISTIC
/end GROUP
/begin GROUP S301_Signal_Limit "SWC_OUTP_type/run_SWC_OUTP_5ms_sys/OUTP/outpmodule/VDDM_ESC5RCErrDTC_raw32_Inproc/Signal_Limit"
 /begin REF_CHARACTERISTIC KOUTP_ESC5RCErrDTC_raw32_maxval KOUTP_ESC5RCErrDTC_raw32_minval /end REF_CHARACTERISTIC
/end GROUP
/begin GROUP S301_Signal_Override "SWC_OUTP_type/run_SWC_OUTP_5ms_sys/OUTP/outpmodule/VDDM_ESC5RCErrDTC_raw32_Inproc/Signal_Override"
 /begin REF_CHARACTERISTIC KOUTP_ESC5RCErrDTC_raw32_ovrdflg KOUTP_ESC5RCErrDTC_raw32_ovrdval /end REF_CHARACTERISTIC
/end GROUP
/begin GROUP S302_Signal_Limit "SWC_OUTP_type/run_SWC_OUTP_5ms_sys/OUTP/outpmodule/VDDM_ESC7CSErrDTC_raw32_Inproc/Signal_Limit"
 /begin REF_CHARACTERISTIC KOUTP_ESC7CSErrDTC_raw32_maxval KOUTP_ESC7CSErrDTC_raw32_minval /end REF_CHARACTERISTIC
/end GROUP
/begin GROUP S302_Signal_Override "SWC_OUTP_type/run_SWC_OUTP_5ms_sys/OUTP/outpmodule/VDDM_ESC7CSErrDTC_raw32_Inproc/Signal_Override"
 /begin REF_CHARACTERISTIC KOUTP_ESC7CSErrDTC_raw32_ovrdflg KOUTP_ESC7CSErrDTC_raw32_ovrdval /end REF_CHARACTERISTIC
/end GROUP
/begin GROUP S303_Signal_Limit "SWC_OUTP_type/run_SWC_OUTP_5ms_sys/OUTP/outpmodule/VDDM_ESC7NoComDTC_raw32_Inproc/Signal_Limit"
 /begin REF_CHARACTERISTIC KOUTP_ESC7NoComDTC_raw32_maxval KOUTP_ESC7NoComDTC_raw32_minval /end REF_CHARACTERISTIC
/end GROUP
/begin GROUP S303_Signal_Override "SWC_OUTP_type/run_SWC_OUTP_5ms_sys/OUTP/outpmodule/VDDM_ESC7NoComDTC_raw32_Inproc/Signal_Override"
 /begin REF_CHARACTERISTIC KOUTP_ESC7NoComDTC_raw32_ovrdflg KOUTP_ESC7NoComDTC_raw32_ovrdval /end REF_CHARACTERISTIC
/end GROUP
/begin GROUP S304_Signal_Limit "SWC_OUTP_type/run_SWC_OUTP_5ms_sys/OUTP/outpmodule/VDDM_ESC7RCErrDTC_raw32_Inproc/Signal_Limit"
 /begin REF_CHARACTERISTIC KOUTP_ESC7RCErrDTC_raw32_maxval KOUTP_ESC7RCErrDTC_raw32_minval /end REF_CHARACTERISTIC
/end GROUP
/begin GROUP S304_Signal_Override "SWC_OUTP_type/run_SWC_OUTP_5ms_sys/OUTP/outpmodule/VDDM_ESC7RCErrDTC_raw32_Inproc/Signal_Override"
 /begin REF_CHARACTERISTIC KOUTP_ESC7RCErrDTC_raw32_ovrdflg KOUTP_ESC7RCErrDTC_raw32_ovrdval /end REF_CHARACTERISTIC
/end GROUP
/begin GROUP S305_Signal_Limit "SWC_OUTP_type/run_SWC_OUTP_5ms_sys/OUTP/outpmodule/VDDM_EngagePFail_flg_Inproc/Signal_Limit" /begin REF_CHARACTERISTIC KOUTP_EngagePFail_flg_maxval KOUTP_EngagePFail_flg_minval /end REF_CHARACTERISTIC /end GROUP
/begin GROUP S305_Signal_Override "SWC_OUTP_type/run_SWC_OUTP_5ms_sys/OUTP/outpmodule/VDDM_EngagePFail_flg_Inproc/Signal_Override"
 /begin REF_CHARACTERISTIC KOUTP_EngagePFail_flg_ovrdflg KOUTP_EngagePFail_flg_ovrdval /end REF_CHARACTERISTIC
/end GROUP
/begin GROUP S306_Signal_Limit "SWC_OUTP_type/run_SWC_OUTP_5ms_sys/OUTP/outpmodule/VDDM_EnterNewOperCyc_flg_Inproc/Signal_Limit"
 /begin REF_CHARACTERISTIC KOUTP_EnterNewOperCyc_flg_maxval KOUTP_EnterNewOperCyc_flg_minval /end REF_CHARACTERISTIC
/end GROUP
/begin GROUP S306_Signal_Override "SWC_OUTP_type/run_SWC_OUTP_5ms_sys/OUTP/outpmodule/VDDM_EnterNewOperCyc_flg_Inproc/Signal_Override"
 /begin REF_CHARACTERISTIC KOUTP_EnterNewOperCyc_flg_ovrdflg KOUTP_EnterNewOperCyc_flg_ovrdval /end REF_CHARACTERISTIC
/end GROUP
/begin GROUP S307_Signal_Limit "SWC_OUTP_type/run_SWC_OUTP_5ms_sys/OUTP/outpmodule/VDDM_FCLUSSDTC_raw32_Inproc/Signal_Limit" /begin REF_CHARACTERISTIC KOUTP_FCLUSSDTC_raw32_maxval KOUTP_FCLUSSDTC_raw32_minval /end REF_CHARACTERISTIC /end GROUP
/begin GROUP S307_Signal_Override "SWC_OUTP_type/run_SWC_OUTP_5ms_sys/OUTP/outpmodule/VDDM_FCLUSSDTC_raw32_Inproc/Signal_Override"
 /begin REF_CHARACTERISTIC KOUTP_FCLUSSDTC_raw32_ovrdflg KOUTP_FCLUSSDTC_raw32_ovrdval /end REF_CHARACTERISTIC
/end GROUP
/begin GROUP S308_Signal_Limit "SWC_OUTP_type/run_SWC_OUTP_5ms_sys/OUTP/outpmodule/VDDM_FCM2CSErrDTC_raw32_Inproc/Signal_Limit"
 /begin REF_CHARACTERISTIC KOUTP_FCM2CSErrDTC_raw32_maxval KOUTP_FCM2CSErrDTC_raw32_minval /end REF_CHARACTERISTIC
/end GROUP
/begin GROUP S308_Signal_Override "SWC_OUTP_type/run_SWC_OUTP_5ms_sys/OUTP/outpmodule/VDDM_FCM2CSErrDTC_raw32_Inproc/Signal_Override"
 /begin REF_CHARACTERISTIC KOUTP_FCM2CSErrDTC_raw32_ovrdflg KOUTP_FCM2CSErrDTC_raw32_ovrdval /end REF_CHARACTERISTIC
/end GROUP
/begin GROUP S309_Signal_Limit "SWC_OUTP_type/run_SWC_OUTP_5ms_sys/OUTP/outpmodule/VDDM_FCM2NoComDTC_raw32_Inproc/Signal_Limit"
 /begin REF_CHARACTERISTIC KOUTP_FCM2NoComDTC_raw32_maxval KOUTP_FCM2NoComDTC_raw32_minval /end REF_CHARACTERISTIC
/end GROUP
/begin GROUP S309_Signal_Override "SWC_OUTP_type/run_SWC_OUTP_5ms_sys/OUTP/outpmodule/VDDM_FCM2NoComDTC_raw32_Inproc/Signal_Override"
 /begin REF_CHARACTERISTIC KOUTP_FCM2NoComDTC_raw32_ovrdflg KOUTP_FCM2NoComDTC_raw32_ovrdval /end REF_CHARACTERISTIC
/end GROUP
/begin GROUP S310_Signal_Limit "SWC_OUTP_type/run_SWC_OUTP_5ms_sys/OUTP/outpmodule/VDDM_FCM2RCErrDTC_raw32_Inproc/Signal_Limit"
 /begin REF_CHARACTERISTIC KOUTP_FCM2RCErrDTC_raw32_maxval KOUTP_FCM2RCErrDTC_raw32_minval /end REF_CHARACTERISTIC
/end GROUP
/begin GROUP S310_Signal_Override "SWC_OUTP_type/run_SWC_OUTP_5ms_sys/OUTP/outpmodule/VDDM_FCM2RCErrDTC_raw32_Inproc/Signal_Override"
 /begin REF_CHARACTERISTIC KOUTP_FCM2RCErrDTC_raw32_ovrdflg KOUTP_FCM2RCErrDTC_raw32_ovrdval /end REF_CHARACTERISTIC
/end GROUP
/begin GROUP S311_Signal_Limit "SWC_OUTP_type/run_SWC_OUTP_5ms_sys/OUTP/outpmodule/VDDM_FCM3CSErrDTC_raw32_Inproc/Signal_Limit"
 /begin REF_CHARACTERISTIC KOUTP_FCM3CSErrDTC_raw32_maxval KOUTP_FCM3CSErrDTC_raw32_minval /end REF_CHARACTERISTIC
/end GROUP
/begin GROUP S311_Signal_Override "SWC_OUTP_type/run_SWC_OUTP_5ms_sys/OUTP/outpmodule/VDDM_FCM3CSErrDTC_raw32_Inproc/Signal_Override"
 /begin REF_CHARACTERISTIC KOUTP_FCM3CSErrDTC_raw32_ovrdflg KOUTP_FCM3CSErrDTC_raw32_ovrdval /end REF_CHARACTERISTIC
/end GROUP
/begin GROUP S312_Signal_Limit "SWC_OUTP_type/run_SWC_OUTP_5ms_sys/OUTP/outpmodule/VDDM_FCM3NoComDTC_raw32_Inproc/Signal_Limit"
 /begin REF_CHARACTERISTIC KOUTP_FCM3NoComDTC_raw32_maxval KOUTP_FCM3NoComDTC_raw32_minval /end REF_CHARACTERISTIC
/end GROUP
/begin GROUP S312_Signal_Override "SWC_OUTP_type/run_SWC_OUTP_5ms_sys/OUTP/outpmodule/VDDM_FCM3NoComDTC_raw32_Inproc/Signal_Override"
 /begin REF_CHARACTERISTIC KOUTP_FCM3NoComDTC_raw32_ovrdflg KOUTP_FCM3NoComDTC_raw32_ovrdval /end REF_CHARACTERISTIC
/end GROUP
/begin GROUP S313_Signal_Limit "SWC_OUTP_type/run_SWC_OUTP_5ms_sys/OUTP/outpmodule/VDDM_FCM3RCErrDTC_raw32_Inproc/Signal_Limit"
 /begin REF_CHARACTERISTIC KOUTP_FCM3RCErrDTC_raw32_maxval KOUTP_FCM3RCErrDTC_raw32_minval /end REF_CHARACTERISTIC
/end GROUP
/begin GROUP S313_Signal_Override "SWC_OUTP_type/run_SWC_OUTP_5ms_sys/OUTP/outpmodule/VDDM_FCM3RCErrDTC_raw32_Inproc/Signal_Override"
 /begin REF_CHARACTERISTIC KOUTP_FCM3RCErrDTC_raw32_ovrdflg KOUTP_FCM3RCErrDTC_raw32_ovrdval /end REF_CHARACTERISTIC
/end GROUP
/begin GROUP S314_Signal_Limit "SWC_OUTP_type/run_SWC_OUTP_5ms_sys/OUTP/outpmodule/VDDM_FCM4CSErrDTC_raw32_Inproc/Signal_Limit"
 /begin REF_CHARACTERISTIC KOUTP_FCM4CSErrDTC_raw32_maxval KOUTP_FCM4CSErrDTC_raw32_minval /end REF_CHARACTERISTIC
/end GROUP
/begin GROUP S314_Signal_Override "SWC_OUTP_type/run_SWC_OUTP_5ms_sys/OUTP/outpmodule/VDDM_FCM4CSErrDTC_raw32_Inproc/Signal_Override"
 /begin REF_CHARACTERISTIC KOUTP_FCM4CSErrDTC_raw32_ovrdflg KOUTP_FCM4CSErrDTC_raw32_ovrdval /end REF_CHARACTERISTIC
/end GROUP
/begin GROUP S315_Signal_Limit "SWC_OUTP_type/run_SWC_OUTP_5ms_sys/OUTP/outpmodule/VDDM_FCM4NoComDTC_raw32_Inproc/Signal_Limit"
 /begin REF_CHARACTERISTIC KOUTP_FCM4NoComDTC_raw32_maxval KOUTP_FCM4NoComDTC_raw32_minval /end REF_CHARACTERISTIC
/end GROUP
/begin GROUP S315_Signal_Override "SWC_OUTP_type/run_SWC_OUTP_5ms_sys/OUTP/outpmodule/VDDM_FCM4NoComDTC_raw32_Inproc/Signal_Override"
 /begin REF_CHARACTERISTIC KOUTP_FCM4NoComDTC_raw32_ovrdflg KOUTP_FCM4NoComDTC_raw32_ovrdval /end REF_CHARACTERISTIC
/end GROUP
/begin GROUP S316_Signal_Limit "SWC_OUTP_type/run_SWC_OUTP_5ms_sys/OUTP/outpmodule/VDDM_FCM5CSErrDTC_raw32_Inproc/Signal_Limit"
 /begin REF_CHARACTERISTIC KOUTP_FCM5CSErrDTC_raw32_maxval KOUTP_FCM5CSErrDTC_raw32_minval /end REF_CHARACTERISTIC
/end GROUP
/begin GROUP S316_Signal_Override "SWC_OUTP_type/run_SWC_OUTP_5ms_sys/OUTP/outpmodule/VDDM_FCM5CSErrDTC_raw32_Inproc/Signal_Override"
 /begin REF_CHARACTERISTIC KOUTP_FCM5CSErrDTC_raw32_ovrdflg KOUTP_FCM5CSErrDTC_raw32_ovrdval /end REF_CHARACTERISTIC
/end GROUP
/begin GROUP S317_Signal_Limit "SWC_OUTP_type/run_SWC_OUTP_5ms_sys/OUTP/outpmodule/VDDM_FCM5NoComDTC_raw32_Inproc/Signal_Limit"
 /begin REF_CHARACTERISTIC KOUTP_FCM5NoComDTC_raw32_maxval KOUTP_FCM5NoComDTC_raw32_minval /end REF_CHARACTERISTIC
/end GROUP
/begin GROUP S317_Signal_Override "SWC_OUTP_type/run_SWC_OUTP_5ms_sys/OUTP/outpmodule/VDDM_FCM5NoComDTC_raw32_Inproc/Signal_Override"
 /begin REF_CHARACTERISTIC KOUTP_FCM5NoComDTC_raw32_ovrdflg KOUTP_FCM5NoComDTC_raw32_ovrdval /end REF_CHARACTERISTIC
/end GROUP
/end MODULE
/end PROJECT
