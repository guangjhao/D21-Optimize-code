ASAP2_VERSION 1 31
/begin PROJECT ProjectName "Project Comment Goes Here"
/begin HEADER "Header Comments go here" /end HEADER
/begin MODULE ModuleName "Module Comment Goes Here"
/begin MOD_COMMON "Mod Common Comment Here" BYTE_ORDER MSB_LAST /end MOD_COMMON
/begin RECORD_LAYOUT Scalar_BOOLEAN FNC_VALUES 1 UBYTE COLUMN_DIR DIRECT /end RECORD_LAYOUT
/begin RECORD_LAYOUT Scalar_UBYTE FNC_VALUES 1 UBYTE COLUMN_DIR DIRECT /end RECORD_LAYOUT
/begin RECORD_LAYOUT Scalar_ULONG FNC_VALUES 1 ULONG COLUMN_DIR DIRECT /end RECORD_LAYOUT
/begin RECORD_LAYOUT Scalar_FLOAT32_IEEE FNC_VALUES 1 FLOAT32_IEEE COLUMN_DIR DIRECT /end RECORD_LAYOUT
/begin RECORD_LAYOUT Lookup2D_X_ULONG AXIS_PTS_X 1 ULONG INDEX_INCR DIRECT /end RECORD_LAYOUT
/begin RECORD_LAYOUT Lookup2D_LONG FNC_VALUES 1 SLONG COLUMN_DIR DIRECT /end RECORD_LAYOUT
/begin RECORD_LAYOUT Lookup2D_X_LONG AXIS_PTS_X 1 SLONG INDEX_INCR DIRECT /end RECORD_LAYOUT
/begin CHARACTERISTIC KOUTP_CreepSpdReq_rpm_maxval "" VALUE 0x0000 /* @ECU_Address@KOUTP_CreepSpdReq_rpm_maxval@ */ Scalar_FLOAT32_IEEE 0 SWC_OUTP_type_CM_single_rpm -100000.0 100000.0 /end CHARACTERISTIC
/begin CHARACTERISTIC KOUTP_CreepSpdReq_rpm_minval "" VALUE 0x0000 /* @ECU_Address@KOUTP_CreepSpdReq_rpm_minval@ */ Scalar_FLOAT32_IEEE 0 SWC_OUTP_type_CM_single_rpm -100000.0 100000.0 /end CHARACTERISTIC
/begin CHARACTERISTIC KOUTP_CreepSpdReq_rpm_ovrdval "" VALUE 0x0000 /* @ECU_Address@KOUTP_CreepSpdReq_rpm_ovrdval@ */ Scalar_FLOAT32_IEEE 0 SWC_OUTP_type_CM_single_rpm -100000.0 100000.0 /end CHARACTERISTIC
/begin CHARACTERISTIC KOUTP_EC1EMDefTrqLmt_rpm_maxval "" VALUE 0x0000 /* @ECU_Address@KOUTP_EC1EMDefTrqLmt_rpm_maxval@ */ Scalar_FLOAT32_IEEE 0 SWC_OUTP_type_CM_single_rpm -100000.0 100000.0 /end CHARACTERISTIC
/begin CHARACTERISTIC KOUTP_EC1EMDefTrqLmt_rpm_minval "" VALUE 0x0000 /* @ECU_Address@KOUTP_EC1EMDefTrqLmt_rpm_minval@ */ Scalar_FLOAT32_IEEE 0 SWC_OUTP_type_CM_single_rpm -100000.0 100000.0 /end CHARACTERISTIC
/begin CHARACTERISTIC KOUTP_EC1EMDefTrqLmt_rpm_ovrdval "" VALUE 0x0000 /* @ECU_Address@KOUTP_EC1EMDefTrqLmt_rpm_ovrdval@ */ Scalar_FLOAT32_IEEE 0 SWC_OUTP_type_CM_single_rpm -100000.0 100000.0 /end CHARACTERISTIC
/begin CHARACTERISTIC KOUTP_EC1EMExtRSCtrlUpLmt_rpm_maxval "" VALUE 0x0000 /* @ECU_Address@KOUTP_EC1EMExtRSCtrlUpLmt_rpm_maxval@ */ Scalar_FLOAT32_IEEE 0 SWC_OUTP_type_CM_single_rpm -100000.0 100000.0 /end CHARACTERISTIC
/begin CHARACTERISTIC KOUTP_EC1EMExtRSCtrlUpLmt_rpm_minval "" VALUE 0x0000 /* @ECU_Address@KOUTP_EC1EMExtRSCtrlUpLmt_rpm_minval@ */ Scalar_FLOAT32_IEEE 0 SWC_OUTP_type_CM_single_rpm -100000.0 100000.0 /end CHARACTERISTIC
/begin CHARACTERISTIC KOUTP_EC1EMExtRSCtrlUpLmt_rpm_ovrdval "" VALUE 0x0000 /* @ECU_Address@KOUTP_EC1EMExtRSCtrlUpLmt_rpm_ovrdval@ */ Scalar_FLOAT32_IEEE 0 SWC_OUTP_type_CM_single_rpm -100000.0 100000.0 /end CHARACTERISTIC
/begin CHARACTERISTIC KOUTP_EC1EMGainEndSpdGvn_gain_maxval "" VALUE 0x0000 /* @ECU_Address@KOUTP_EC1EMGainEndSpdGvn_gain_maxval@ */ Scalar_FLOAT32_IEEE 0 SWC_OUTP_type_CM_single_gain -65535.0 100000.0 /end CHARACTERISTIC
/begin CHARACTERISTIC KOUTP_EC1EMGainEndSpdGvn_gain_minval "" VALUE 0x0000 /* @ECU_Address@KOUTP_EC1EMGainEndSpdGvn_gain_minval@ */ Scalar_FLOAT32_IEEE 0 SWC_OUTP_type_CM_single_gain -65535.0 100000.0 /end CHARACTERISTIC
/begin CHARACTERISTIC KOUTP_EC1EMGainEndSpdGvn_gain_ovrdval "" VALUE 0x0000 /* @ECU_Address@KOUTP_EC1EMGainEndSpdGvn_gain_ovrdval@ */ Scalar_FLOAT32_IEEE 0 SWC_OUTP_type_CM_single_gain -65535.0 100000.0 /end CHARACTERISTIC
/begin CHARACTERISTIC KOUTP_EC1EMMaxMEngOvrSP7_rpm_maxval "" VALUE 0x0000 /* @ECU_Address@KOUTP_EC1EMMaxMEngOvrSP7_rpm_maxval@ */ Scalar_FLOAT32_IEEE 0 SWC_OUTP_type_CM_single_rpm -100000.0 100000.0 /end CHARACTERISTIC
/begin CHARACTERISTIC KOUTP_EC1EMMaxMEngOvrSP7_rpm_minval "" VALUE 0x0000 /* @ECU_Address@KOUTP_EC1EMMaxMEngOvrSP7_rpm_minval@ */ Scalar_FLOAT32_IEEE 0 SWC_OUTP_type_CM_single_rpm -100000.0 100000.0 /end CHARACTERISTIC
/begin CHARACTERISTIC KOUTP_EC1EMMaxMEngOvrSP7_rpm_ovrdval "" VALUE 0x0000 /* @ECU_Address@KOUTP_EC1EMMaxMEngOvrSP7_rpm_ovrdval@ */ Scalar_FLOAT32_IEEE 0 SWC_OUTP_type_CM_single_rpm -100000.0 100000.0 /end CHARACTERISTIC
/begin CHARACTERISTIC KOUTP_EC1EMMaxMOvrTmt_s_maxval "" VALUE 0x0000 /* @ECU_Address@KOUTP_EC1EMMaxMOvrTmt_s_maxval@ */ Scalar_FLOAT32_IEEE 0 SWC_OUTP_type_CM_single_s -65535.0 65535.0 /end CHARACTERISTIC
/begin CHARACTERISTIC KOUTP_EC1EMMaxMOvrTmt_s_minval "" VALUE 0x0000 /* @ECU_Address@KOUTP_EC1EMMaxMOvrTmt_s_minval@ */ Scalar_FLOAT32_IEEE 0 SWC_OUTP_type_CM_single_s -65535.0 65535.0 /end CHARACTERISTIC
/begin CHARACTERISTIC KOUTP_EC1EMMaxMOvrTmt_s_ovrdval "" VALUE 0x0000 /* @ECU_Address@KOUTP_EC1EMMaxMOvrTmt_s_ovrdval@ */ Scalar_FLOAT32_IEEE 0 SWC_OUTP_type_CM_single_s -65535.0 65535.0 /end CHARACTERISTIC
/begin CHARACTERISTIC KOUTP_EC1EMMomOfInertia_kgpm2_maxval "" VALUE 0x0000 /* @ECU_Address@KOUTP_EC1EMMomOfInertia_kgpm2_maxval@ */ Scalar_FLOAT32_IEEE 0 SWC_OUTP_type_CM_single_kgpm2 -65535.0 100000.0 /end CHARACTERISTIC
/begin CHARACTERISTIC KOUTP_EC1EMMomOfInertia_kgpm2_minval "" VALUE 0x0000 /* @ECU_Address@KOUTP_EC1EMMomOfInertia_kgpm2_minval@ */ Scalar_FLOAT32_IEEE 0 SWC_OUTP_type_CM_single_kgpm2 -65535.0 100000.0 /end CHARACTERISTIC
/begin CHARACTERISTIC KOUTP_EC1EMMomOfInertia_kgpm2_ovrdval "" VALUE 0x0000 /* @ECU_Address@KOUTP_EC1EMMomOfInertia_kgpm2_ovrdval@ */ Scalar_FLOAT32_IEEE 0 SWC_OUTP_type_CM_single_kgpm2 -65535.0 100000.0 /end CHARACTERISTIC
/begin CHARACTERISTIC KOUTP_EC1EMRefTorq_Nm_maxval "" VALUE 0x0000 /* @ECU_Address@KOUTP_EC1EMRefTorq_Nm_maxval@ */ Scalar_FLOAT32_IEEE 0 SWC_OUTP_type_CM_single_Nm -100000.0 100000.0 /end CHARACTERISTIC
/begin CHARACTERISTIC KOUTP_EC1EMRefTorq_Nm_minval "" VALUE 0x0000 /* @ECU_Address@KOUTP_EC1EMRefTorq_Nm_minval@ */ Scalar_FLOAT32_IEEE 0 SWC_OUTP_type_CM_single_Nm -100000.0 100000.0 /end CHARACTERISTIC
/begin CHARACTERISTIC KOUTP_EC1EMRefTorq_Nm_ovrdval "" VALUE 0x0000 /* @ECU_Address@KOUTP_EC1EMRefTorq_Nm_ovrdval@ */ Scalar_FLOAT32_IEEE 0 SWC_OUTP_type_CM_single_Nm -100000.0 100000.0 /end CHARACTERISTIC
/begin CHARACTERISTIC KOUTP_EC1EMReqSpdCtrlLoLmt_rpm_maxval "" VALUE 0x0000 /* @ECU_Address@KOUTP_EC1EMReqSpdCtrlLoLmt_rpm_maxval@ */ Scalar_FLOAT32_IEEE 0 SWC_OUTP_type_CM_single_rpm -100000.0 100000.0 /end CHARACTERISTIC
/begin CHARACTERISTIC KOUTP_EC1EMReqSpdCtrlLoLmt_rpm_minval "" VALUE 0x0000 /* @ECU_Address@KOUTP_EC1EMReqSpdCtrlLoLmt_rpm_minval@ */ Scalar_FLOAT32_IEEE 0 SWC_OUTP_type_CM_single_rpm -100000.0 100000.0 /end CHARACTERISTIC
/begin CHARACTERISTIC KOUTP_EC1EMReqSpdCtrlLoLmt_rpm_ovrdval "" VALUE 0x0000 /* @ECU_Address@KOUTP_EC1EMReqSpdCtrlLoLmt_rpm_ovrdval@ */ Scalar_FLOAT32_IEEE 0 SWC_OUTP_type_CM_single_rpm -100000.0 100000.0 /end CHARACTERISTIC
/begin CHARACTERISTIC KOUTP_EC1EMReqSpdCtrlUpLmt_rpm_maxval "" VALUE 0x0000 /* @ECU_Address@KOUTP_EC1EMReqSpdCtrlUpLmt_rpm_maxval@ */ Scalar_FLOAT32_IEEE 0 SWC_OUTP_type_CM_single_rpm -100000.0 100000.0 /end CHARACTERISTIC
/begin CHARACTERISTIC KOUTP_EC1EMReqSpdCtrlUpLmt_rpm_minval "" VALUE 0x0000 /* @ECU_Address@KOUTP_EC1EMReqSpdCtrlUpLmt_rpm_minval@ */ Scalar_FLOAT32_IEEE 0 SWC_OUTP_type_CM_single_rpm -100000.0 100000.0 /end CHARACTERISTIC
/begin CHARACTERISTIC KOUTP_EC1EMReqSpdCtrlUpLmt_rpm_ovrdval "" VALUE 0x0000 /* @ECU_Address@KOUTP_EC1EMReqSpdCtrlUpLmt_rpm_ovrdval@ */ Scalar_FLOAT32_IEEE 0 SWC_OUTP_type_CM_single_rpm -100000.0 100000.0 /end CHARACTERISTIC
/begin CHARACTERISTIC KOUTP_EC1EMReqTrqCtrlLoLmt_pct_maxval "" VALUE 0x0000 /* @ECU_Address@KOUTP_EC1EMReqTrqCtrlLoLmt_pct_maxval@ */ Scalar_FLOAT32_IEEE 0 SWC_OUTP_type_CM_single_pct -65535.0 65535.0 /end CHARACTERISTIC
/begin CHARACTERISTIC KOUTP_EC1EMReqTrqCtrlLoLmt_pct_minval "" VALUE 0x0000 /* @ECU_Address@KOUTP_EC1EMReqTrqCtrlLoLmt_pct_minval@ */ Scalar_FLOAT32_IEEE 0 SWC_OUTP_type_CM_single_pct -65535.0 65535.0 /end CHARACTERISTIC
/begin CHARACTERISTIC KOUTP_EC1EMReqTrqCtrlLoLmt_pct_ovrdval "" VALUE 0x0000 /* @ECU_Address@KOUTP_EC1EMReqTrqCtrlLoLmt_pct_ovrdval@ */ Scalar_FLOAT32_IEEE 0 SWC_OUTP_type_CM_single_pct -65535.0 65535.0 /end CHARACTERISTIC
/begin CHARACTERISTIC KOUTP_EC1EMReqTrqCtrlUpLmt_pct_maxval "" VALUE 0x0000 /* @ECU_Address@KOUTP_EC1EMReqTrqCtrlUpLmt_pct_maxval@ */ Scalar_FLOAT32_IEEE 0 SWC_OUTP_type_CM_single_pct -65535.0 65535.0 /end CHARACTERISTIC
/begin CHARACTERISTIC KOUTP_EC1EMReqTrqCtrlUpLmt_pct_minval "" VALUE 0x0000 /* @ECU_Address@KOUTP_EC1EMReqTrqCtrlUpLmt_pct_minval@ */ Scalar_FLOAT32_IEEE 0 SWC_OUTP_type_CM_single_pct -65535.0 65535.0 /end CHARACTERISTIC
/begin CHARACTERISTIC KOUTP_EC1EMReqTrqCtrlUpLmt_pct_ovrdval "" VALUE 0x0000 /* @ECU_Address@KOUTP_EC1EMReqTrqCtrlUpLmt_pct_ovrdval@ */ Scalar_FLOAT32_IEEE 0 SWC_OUTP_type_CM_single_pct -65535.0 65535.0 /end CHARACTERISTIC
/begin CHARACTERISTIC KOUTP_EC1EMSpdHdleP6_rpm_maxval "" VALUE 0x0000 /* @ECU_Address@KOUTP_EC1EMSpdHdleP6_rpm_maxval@ */ Scalar_FLOAT32_IEEE 0 SWC_OUTP_type_CM_single_rpm -100000.0 100000.0 /end CHARACTERISTIC
/begin CHARACTERISTIC KOUTP_EC1EMSpdHdleP6_rpm_minval "" VALUE 0x0000 /* @ECU_Address@KOUTP_EC1EMSpdHdleP6_rpm_minval@ */ Scalar_FLOAT32_IEEE 0 SWC_OUTP_type_CM_single_rpm -100000.0 100000.0 /end CHARACTERISTIC
/begin CHARACTERISTIC KOUTP_EC1EMSpdHdleP6_rpm_ovrdval "" VALUE 0x0000 /* @ECU_Address@KOUTP_EC1EMSpdHdleP6_rpm_ovrdval@ */ Scalar_FLOAT32_IEEE 0 SWC_OUTP_type_CM_single_rpm -100000.0 100000.0 /end CHARACTERISTIC
/begin CHARACTERISTIC KOUTP_EC1EMSpdIdleP1_rpm_maxval "" VALUE 0x0000 /* @ECU_Address@KOUTP_EC1EMSpdIdleP1_rpm_maxval@ */ Scalar_FLOAT32_IEEE 0 SWC_OUTP_type_CM_single_rpm -100000.0 100000.0 /end CHARACTERISTIC
/begin CHARACTERISTIC KOUTP_EC1EMSpdIdleP1_rpm_minval "" VALUE 0x0000 /* @ECU_Address@KOUTP_EC1EMSpdIdleP1_rpm_minval@ */ Scalar_FLOAT32_IEEE 0 SWC_OUTP_type_CM_single_rpm -100000.0 100000.0 /end CHARACTERISTIC
/begin CHARACTERISTIC KOUTP_EC1EMSpdIdleP1_rpm_ovrdval "" VALUE 0x0000 /* @ECU_Address@KOUTP_EC1EMSpdIdleP1_rpm_ovrdval@ */ Scalar_FLOAT32_IEEE 0 SWC_OUTP_type_CM_single_rpm -100000.0 100000.0 /end CHARACTERISTIC
/begin CHARACTERISTIC KOUTP_EC1EMSpdIdleP2_rpm_maxval "" VALUE 0x0000 /* @ECU_Address@KOUTP_EC1EMSpdIdleP2_rpm_maxval@ */ Scalar_FLOAT32_IEEE 0 SWC_OUTP_type_CM_single_rpm -100000.0 100000.0 /end CHARACTERISTIC
/begin CHARACTERISTIC KOUTP_EC1EMSpdIdleP2_rpm_minval "" VALUE 0x0000 /* @ECU_Address@KOUTP_EC1EMSpdIdleP2_rpm_minval@ */ Scalar_FLOAT32_IEEE 0 SWC_OUTP_type_CM_single_rpm -100000.0 100000.0 /end CHARACTERISTIC
/begin CHARACTERISTIC KOUTP_EC1EMSpdIdleP2_rpm_ovrdval "" VALUE 0x0000 /* @ECU_Address@KOUTP_EC1EMSpdIdleP2_rpm_ovrdval@ */ Scalar_FLOAT32_IEEE 0 SWC_OUTP_type_CM_single_rpm -100000.0 100000.0 /end CHARACTERISTIC
/begin CHARACTERISTIC KOUTP_EC1EMSpdIdleP3_rpm_maxval "" VALUE 0x0000 /* @ECU_Address@KOUTP_EC1EMSpdIdleP3_rpm_maxval@ */ Scalar_FLOAT32_IEEE 0 SWC_OUTP_type_CM_single_rpm -100000.0 100000.0 /end CHARACTERISTIC
/begin CHARACTERISTIC KOUTP_EC1EMSpdIdleP3_rpm_minval "" VALUE 0x0000 /* @ECU_Address@KOUTP_EC1EMSpdIdleP3_rpm_minval@ */ Scalar_FLOAT32_IEEE 0 SWC_OUTP_type_CM_single_rpm -100000.0 100000.0 /end CHARACTERISTIC
/begin CHARACTERISTIC KOUTP_EC1EMSpdIdleP3_rpm_ovrdval "" VALUE 0x0000 /* @ECU_Address@KOUTP_EC1EMSpdIdleP3_rpm_ovrdval@ */ Scalar_FLOAT32_IEEE 0 SWC_OUTP_type_CM_single_rpm -100000.0 100000.0 /end CHARACTERISTIC
/begin CHARACTERISTIC KOUTP_EC1EMSpdIdleP4_rpm_maxval "" VALUE 0x0000 /* @ECU_Address@KOUTP_EC1EMSpdIdleP4_rpm_maxval@ */ Scalar_FLOAT32_IEEE 0 SWC_OUTP_type_CM_single_rpm -100000.0 100000.0 /end CHARACTERISTIC
/begin CHARACTERISTIC KOUTP_EC1EMSpdIdleP4_rpm_minval "" VALUE 0x0000 /* @ECU_Address@KOUTP_EC1EMSpdIdleP4_rpm_minval@ */ Scalar_FLOAT32_IEEE 0 SWC_OUTP_type_CM_single_rpm -100000.0 100000.0 /end CHARACTERISTIC
/begin CHARACTERISTIC KOUTP_EC1EMSpdIdleP4_rpm_ovrdval "" VALUE 0x0000 /* @ECU_Address@KOUTP_EC1EMSpdIdleP4_rpm_ovrdval@ */ Scalar_FLOAT32_IEEE 0 SWC_OUTP_type_CM_single_rpm -100000.0 100000.0 /end CHARACTERISTIC
/begin CHARACTERISTIC KOUTP_EC1EMSpdIdleP5_rpm_maxval "" VALUE 0x0000 /* @ECU_Address@KOUTP_EC1EMSpdIdleP5_rpm_maxval@ */ Scalar_FLOAT32_IEEE 0 SWC_OUTP_type_CM_single_rpm -100000.0 100000.0 /end CHARACTERISTIC
/begin CHARACTERISTIC KOUTP_EC1EMSpdIdleP5_rpm_minval "" VALUE 0x0000 /* @ECU_Address@KOUTP_EC1EMSpdIdleP5_rpm_minval@ */ Scalar_FLOAT32_IEEE 0 SWC_OUTP_type_CM_single_rpm -100000.0 100000.0 /end CHARACTERISTIC
/begin CHARACTERISTIC KOUTP_EC1EMSpdIdleP5_rpm_ovrdval "" VALUE 0x0000 /* @ECU_Address@KOUTP_EC1EMSpdIdleP5_rpm_ovrdval@ */ Scalar_FLOAT32_IEEE 0 SWC_OUTP_type_CM_single_rpm -100000.0 100000.0 /end CHARACTERISTIC
/begin CHARACTERISTIC KOUTP_EC1PercTorqIdleP1_pct_maxval "" VALUE 0x0000 /* @ECU_Address@KOUTP_EC1PercTorqIdleP1_pct_maxval@ */ Scalar_FLOAT32_IEEE 0 SWC_OUTP_type_CM_single_pct -65535.0 65535.0 /end CHARACTERISTIC
/begin CHARACTERISTIC KOUTP_EC1PercTorqIdleP1_pct_minval "" VALUE 0x0000 /* @ECU_Address@KOUTP_EC1PercTorqIdleP1_pct_minval@ */ Scalar_FLOAT32_IEEE 0 SWC_OUTP_type_CM_single_pct -65535.0 65535.0 /end CHARACTERISTIC
/begin CHARACTERISTIC KOUTP_EC1PercTorqIdleP1_pct_ovrdval "" VALUE 0x0000 /* @ECU_Address@KOUTP_EC1PercTorqIdleP1_pct_ovrdval@ */ Scalar_FLOAT32_IEEE 0 SWC_OUTP_type_CM_single_pct -65535.0 65535.0 /end CHARACTERISTIC
/begin CHARACTERISTIC KOUTP_EC1PercTorqIdleP2_pct_maxval "" VALUE 0x0000 /* @ECU_Address@KOUTP_EC1PercTorqIdleP2_pct_maxval@ */ Scalar_FLOAT32_IEEE 0 SWC_OUTP_type_CM_single_pct -65535.0 65535.0 /end CHARACTERISTIC
/begin CHARACTERISTIC KOUTP_EC1PercTorqIdleP2_pct_minval "" VALUE 0x0000 /* @ECU_Address@KOUTP_EC1PercTorqIdleP2_pct_minval@ */ Scalar_FLOAT32_IEEE 0 SWC_OUTP_type_CM_single_pct -65535.0 65535.0 /end CHARACTERISTIC
/begin CHARACTERISTIC KOUTP_EC1PercTorqIdleP2_pct_ovrdval "" VALUE 0x0000 /* @ECU_Address@KOUTP_EC1PercTorqIdleP2_pct_ovrdval@ */ Scalar_FLOAT32_IEEE 0 SWC_OUTP_type_CM_single_pct -65535.0 65535.0 /end CHARACTERISTIC
/begin CHARACTERISTIC KOUTP_EC1PercTorqIdleP3_pct_maxval "" VALUE 0x0000 /* @ECU_Address@KOUTP_EC1PercTorqIdleP3_pct_maxval@ */ Scalar_FLOAT32_IEEE 0 SWC_OUTP_type_CM_single_pct -65535.0 65535.0 /end CHARACTERISTIC
/begin CHARACTERISTIC KOUTP_EC1PercTorqIdleP3_pct_minval "" VALUE 0x0000 /* @ECU_Address@KOUTP_EC1PercTorqIdleP3_pct_minval@ */ Scalar_FLOAT32_IEEE 0 SWC_OUTP_type_CM_single_pct -65535.0 65535.0 /end CHARACTERISTIC
/begin CHARACTERISTIC KOUTP_EC1PercTorqIdleP3_pct_ovrdval "" VALUE 0x0000 /* @ECU_Address@KOUTP_EC1PercTorqIdleP3_pct_ovrdval@ */ Scalar_FLOAT32_IEEE 0 SWC_OUTP_type_CM_single_pct -65535.0 65535.0 /end CHARACTERISTIC
/begin CHARACTERISTIC KOUTP_EC1PercTorqIdleP4_pct_maxval "" VALUE 0x0000 /* @ECU_Address@KOUTP_EC1PercTorqIdleP4_pct_maxval@ */ Scalar_FLOAT32_IEEE 0 SWC_OUTP_type_CM_single_pct -65535.0 65535.0 /end CHARACTERISTIC
/begin CHARACTERISTIC KOUTP_EC1PercTorqIdleP4_pct_minval "" VALUE 0x0000 /* @ECU_Address@KOUTP_EC1PercTorqIdleP4_pct_minval@ */ Scalar_FLOAT32_IEEE 0 SWC_OUTP_type_CM_single_pct -65535.0 65535.0 /end CHARACTERISTIC
/begin CHARACTERISTIC KOUTP_EC1PercTorqIdleP4_pct_ovrdval "" VALUE 0x0000 /* @ECU_Address@KOUTP_EC1PercTorqIdleP4_pct_ovrdval@ */ Scalar_FLOAT32_IEEE 0 SWC_OUTP_type_CM_single_pct -65535.0 65535.0 /end CHARACTERISTIC
/begin CHARACTERISTIC KOUTP_EC1PercTorqIdleP5_pct_maxval "" VALUE 0x0000 /* @ECU_Address@KOUTP_EC1PercTorqIdleP5_pct_maxval@ */ Scalar_FLOAT32_IEEE 0 SWC_OUTP_type_CM_single_pct -65535.0 65535.0 /end CHARACTERISTIC
/begin CHARACTERISTIC KOUTP_EC1PercTorqIdleP5_pct_minval "" VALUE 0x0000 /* @ECU_Address@KOUTP_EC1PercTorqIdleP5_pct_minval@ */ Scalar_FLOAT32_IEEE 0 SWC_OUTP_type_CM_single_pct -65535.0 65535.0 /end CHARACTERISTIC
/begin CHARACTERISTIC KOUTP_EC1PercTorqIdleP5_pct_ovrdval "" VALUE 0x0000 /* @ECU_Address@KOUTP_EC1PercTorqIdleP5_pct_ovrdval@ */ Scalar_FLOAT32_IEEE 0 SWC_OUTP_type_CM_single_pct -65535.0 65535.0 /end CHARACTERISTIC
/begin CHARACTERISTIC KOUTP_EEC3EMPressLoss_pct_maxval "" VALUE 0x0000 /* @ECU_Address@KOUTP_EEC3EMPressLoss_pct_maxval@ */ Scalar_FLOAT32_IEEE 0 SWC_OUTP_type_CM_single_pct -65535.0 65535.0 /end CHARACTERISTIC
/begin CHARACTERISTIC KOUTP_EEC3EMPressLoss_pct_minval "" VALUE 0x0000 /* @ECU_Address@KOUTP_EEC3EMPressLoss_pct_minval@ */ Scalar_FLOAT32_IEEE 0 SWC_OUTP_type_CM_single_pct -65535.0 65535.0 /end CHARACTERISTIC
/begin CHARACTERISTIC KOUTP_EEC3EMPressLoss_pct_ovrdval "" VALUE 0x0000 /* @ECU_Address@KOUTP_EEC3EMPressLoss_pct_ovrdval@ */ Scalar_FLOAT32_IEEE 0 SWC_OUTP_type_CM_single_pct -65535.0 65535.0 /end CHARACTERISTIC
/begin CHARACTERISTIC KOUTP_EEC3NFricPercTorq_pct_maxval "" VALUE 0x0000 /* @ECU_Address@KOUTP_EEC3NFricPercTorq_pct_maxval@ */ Scalar_FLOAT32_IEEE 0 SWC_OUTP_type_CM_single_pct -65535.0 65535.0 /end CHARACTERISTIC
/begin CHARACTERISTIC KOUTP_EEC3NFricPercTorq_pct_minval "" VALUE 0x0000 /* @ECU_Address@KOUTP_EEC3NFricPercTorq_pct_minval@ */ Scalar_FLOAT32_IEEE 0 SWC_OUTP_type_CM_single_pct -65535.0 65535.0 /end CHARACTERISTIC
/begin CHARACTERISTIC KOUTP_EEC3NFricPercTorq_pct_ovrdval "" VALUE 0x0000 /* @ECU_Address@KOUTP_EEC3NFricPercTorq_pct_ovrdval@ */ Scalar_FLOAT32_IEEE 0 SWC_OUTP_type_CM_single_pct -65535.0 65535.0 /end CHARACTERISTIC
/begin CHARACTERISTIC KOUTP_EMRC1ActEMOutSftSpd_rpm_maxval "" VALUE 0x0000 /* @ECU_Address@KOUTP_EMRC1ActEMOutSftSpd_rpm_maxval@ */ Scalar_FLOAT32_IEEE 0 SWC_OUTP_type_CM_single_rpm -100000.0 100000.0 /end CHARACTERISTIC
/begin CHARACTERISTIC KOUTP_EMRC1ActEMOutSftSpd_rpm_minval "" VALUE 0x0000 /* @ECU_Address@KOUTP_EMRC1ActEMOutSftSpd_rpm_minval@ */ Scalar_FLOAT32_IEEE 0 SWC_OUTP_type_CM_single_rpm -100000.0 100000.0 /end CHARACTERISTIC
/begin CHARACTERISTIC KOUTP_EMRC1ActEMOutSftSpd_rpm_ovrdval "" VALUE 0x0000 /* @ECU_Address@KOUTP_EMRC1ActEMOutSftSpd_rpm_ovrdval@ */ Scalar_FLOAT32_IEEE 0 SWC_OUTP_type_CM_single_rpm -100000.0 100000.0 /end CHARACTERISTIC
/begin CHARACTERISTIC KOUTP_EMRC1ActEMpTrqHrls_pct_maxval "" VALUE 0x0000 /* @ECU_Address@KOUTP_EMRC1ActEMpTrqHrls_pct_maxval@ */ Scalar_FLOAT32_IEEE 0 SWC_OUTP_type_CM_single_pct -65535.0 65535.0 /end CHARACTERISTIC
/begin CHARACTERISTIC KOUTP_EMRC1ActEMpTrqHrls_pct_minval "" VALUE 0x0000 /* @ECU_Address@KOUTP_EMRC1ActEMpTrqHrls_pct_minval@ */ Scalar_FLOAT32_IEEE 0 SWC_OUTP_type_CM_single_pct -65535.0 65535.0 /end CHARACTERISTIC
/begin CHARACTERISTIC KOUTP_EMRC1ActEMpTrqHrls_pct_ovrdval "" VALUE 0x0000 /* @ECU_Address@KOUTP_EMRC1ActEMpTrqHrls_pct_ovrdval@ */ Scalar_FLOAT32_IEEE 0 SWC_OUTP_type_CM_single_pct -65535.0 65535.0 /end CHARACTERISTIC
/begin CHARACTERISTIC KOUTP_EMRC1ActEMpTrq_pct_maxval "" VALUE 0x0000 /* @ECU_Address@KOUTP_EMRC1ActEMpTrq_pct_maxval@ */ Scalar_FLOAT32_IEEE 0 SWC_OUTP_type_CM_single_pct -65535.0 65535.0 /end CHARACTERISTIC
/begin CHARACTERISTIC KOUTP_EMRC1ActEMpTrq_pct_minval "" VALUE 0x0000 /* @ECU_Address@KOUTP_EMRC1ActEMpTrq_pct_minval@ */ Scalar_FLOAT32_IEEE 0 SWC_OUTP_type_CM_single_pct -65535.0 65535.0 /end CHARACTERISTIC
/begin CHARACTERISTIC KOUTP_EMRC1ActEMpTrq_pct_ovrdval "" VALUE 0x0000 /* @ECU_Address@KOUTP_EMRC1ActEMpTrq_pct_ovrdval@ */ Scalar_FLOAT32_IEEE 0 SWC_OUTP_type_CM_single_pct -65535.0 65535.0 /end CHARACTERISTIC
/begin CHARACTERISTIC KOUTP_EMRC1ActMaxAvaEMRecpTrq_pct_maxval "" VALUE 0x0000 /* @ECU_Address@KOUTP_EMRC1ActMaxAvaEMRecpTrq_pct_maxval@ */ Scalar_FLOAT32_IEEE 0 SWC_OUTP_type_CM_single_pct -65535.0 65535.0 /end CHARACTERISTIC
/begin CHARACTERISTIC KOUTP_EMRC1ActMaxAvaEMRecpTrq_pct_minval "" VALUE 0x0000 /* @ECU_Address@KOUTP_EMRC1ActMaxAvaEMRecpTrq_pct_minval@ */ Scalar_FLOAT32_IEEE 0 SWC_OUTP_type_CM_single_pct -65535.0 65535.0 /end CHARACTERISTIC
/begin CHARACTERISTIC KOUTP_EMRC1ActMaxAvaEMRecpTrq_pct_ovrdval "" VALUE 0x0000 /* @ECU_Address@KOUTP_EMRC1ActMaxAvaEMRecpTrq_pct_ovrdval@ */ Scalar_FLOAT32_IEEE 0 SWC_OUTP_type_CM_single_pct -65535.0 65535.0 /end CHARACTERISTIC
/begin CHARACTERISTIC KOUTP_EMRC1DrvDemEMRtapTrq_pct_maxval "" VALUE 0x0000 /* @ECU_Address@KOUTP_EMRC1DrvDemEMRtapTrq_pct_maxval@ */ Scalar_FLOAT32_IEEE 0 SWC_OUTP_type_CM_single_pct -65535.0 65535.0 /end CHARACTERISTIC
/begin CHARACTERISTIC KOUTP_EMRC1DrvDemEMRtapTrq_pct_minval "" VALUE 0x0000 /* @ECU_Address@KOUTP_EMRC1DrvDemEMRtapTrq_pct_minval@ */ Scalar_FLOAT32_IEEE 0 SWC_OUTP_type_CM_single_pct -65535.0 65535.0 /end CHARACTERISTIC
/begin CHARACTERISTIC KOUTP_EMRC1DrvDemEMRtapTrq_pct_ovrdval "" VALUE 0x0000 /* @ECU_Address@KOUTP_EMRC1DrvDemEMRtapTrq_pct_ovrdval@ */ Scalar_FLOAT32_IEEE 0 SWC_OUTP_type_CM_single_pct -65535.0 65535.0 /end CHARACTERISTIC
/begin CHARACTERISTIC KOUTP_EMRC1RetSelNonEng_pct_maxval "" VALUE 0x0000 /* @ECU_Address@KOUTP_EMRC1RetSelNonEng_pct_maxval@ */ Scalar_FLOAT32_IEEE 0 SWC_OUTP_type_CM_single_pct -65535.0 65535.0 /end CHARACTERISTIC
/begin CHARACTERISTIC KOUTP_EMRC1RetSelNonEng_pct_minval "" VALUE 0x0000 /* @ECU_Address@KOUTP_EMRC1RetSelNonEng_pct_minval@ */ Scalar_FLOAT32_IEEE 0 SWC_OUTP_type_CM_single_pct -65535.0 65535.0 /end CHARACTERISTIC
/begin CHARACTERISTIC KOUTP_EMRC1RetSelNonEng_pct_ovrdval "" VALUE 0x0000 /* @ECU_Address@KOUTP_EMRC1RetSelNonEng_pct_ovrdval@ */ Scalar_FLOAT32_IEEE 0 SWC_OUTP_type_CM_single_pct -65535.0 65535.0 /end CHARACTERISTIC
/begin CHARACTERISTIC KOUTP_ETC2ActDriveDirect_enum_maxval "" VALUE 0x0000 /* @ECU_Address@KOUTP_ETC2ActDriveDirect_enum_maxval@ */ Scalar_FLOAT32_IEEE 0 SWC_OUTP_type_CM_single_enum -65535.0 65535.0 /end CHARACTERISTIC
/begin CHARACTERISTIC KOUTP_ETC2ActDriveDirect_enum_minval "" VALUE 0x0000 /* @ECU_Address@KOUTP_ETC2ActDriveDirect_enum_minval@ */ Scalar_FLOAT32_IEEE 0 SWC_OUTP_type_CM_single_enum -65535.0 65535.0 /end CHARACTERISTIC
/begin CHARACTERISTIC KOUTP_ETC2ActDriveDirect_enum_ovrdval "" VALUE 0x0000 /* @ECU_Address@KOUTP_ETC2ActDriveDirect_enum_ovrdval@ */ Scalar_FLOAT32_IEEE 0 SWC_OUTP_type_CM_single_enum -65535.0 65535.0 /end CHARACTERISTIC
/begin CHARACTERISTIC KOUTP_EVCU1EMotorPerformance_pct_maxval "" VALUE 0x0000 /* @ECU_Address@KOUTP_EVCU1EMotorPerformance_pct_maxval@ */ Scalar_FLOAT32_IEEE 0 SWC_OUTP_type_CM_single_pct -65535.0 65535.0 /end CHARACTERISTIC
/begin CHARACTERISTIC KOUTP_EVCU1EMotorPerformance_pct_minval "" VALUE 0x0000 /* @ECU_Address@KOUTP_EVCU1EMotorPerformance_pct_minval@ */ Scalar_FLOAT32_IEEE 0 SWC_OUTP_type_CM_single_pct -65535.0 65535.0 /end CHARACTERISTIC
/begin CHARACTERISTIC KOUTP_EVCU1EMotorPerformance_pct_ovrdval "" VALUE 0x0000 /* @ECU_Address@KOUTP_EVCU1EMotorPerformance_pct_ovrdval@ */ Scalar_FLOAT32_IEEE 0 SWC_OUTP_type_CM_single_pct -65535.0 65535.0 /end CHARACTERISTIC
/begin CHARACTERISTIC KOUTP_EVCU1EMotorSpd_rpm_maxval "" VALUE 0x0000 /* @ECU_Address@KOUTP_EVCU1EMotorSpd_rpm_maxval@ */ Scalar_FLOAT32_IEEE 0 SWC_OUTP_type_CM_single_rpm -100000.0 100000.0 /end CHARACTERISTIC
/begin CHARACTERISTIC KOUTP_EVCU1EMotorSpd_rpm_minval "" VALUE 0x0000 /* @ECU_Address@KOUTP_EVCU1EMotorSpd_rpm_minval@ */ Scalar_FLOAT32_IEEE 0 SWC_OUTP_type_CM_single_rpm -100000.0 100000.0 /end CHARACTERISTIC
/begin CHARACTERISTIC KOUTP_EVCU1EMotorSpd_rpm_ovrdval "" VALUE 0x0000 /* @ECU_Address@KOUTP_EVCU1EMotorSpd_rpm_ovrdval@ */ Scalar_FLOAT32_IEEE 0 SWC_OUTP_type_CM_single_rpm -100000.0 100000.0 /end CHARACTERISTIC
/begin CHARACTERISTIC KOUTP_EVCU2MaxTorqAvail_pct_maxval "" VALUE 0x0000 /* @ECU_Address@KOUTP_EVCU2MaxTorqAvail_pct_maxval@ */ Scalar_FLOAT32_IEEE 0 SWC_OUTP_type_CM_single_pct -65535.0 65535.0 /end CHARACTERISTIC
/begin CHARACTERISTIC KOUTP_EVCU2MaxTorqAvail_pct_minval "" VALUE 0x0000 /* @ECU_Address@KOUTP_EVCU2MaxTorqAvail_pct_minval@ */ Scalar_FLOAT32_IEEE 0 SWC_OUTP_type_CM_single_pct -65535.0 65535.0 /end CHARACTERISTIC
/begin CHARACTERISTIC KOUTP_EVCU2MaxTorqAvail_pct_ovrdval "" VALUE 0x0000 /* @ECU_Address@KOUTP_EVCU2MaxTorqAvail_pct_ovrdval@ */ Scalar_FLOAT32_IEEE 0 SWC_OUTP_type_CM_single_pct -65535.0 65535.0 /end CHARACTERISTIC
/begin CHARACTERISTIC KOUTP_EVCU2MinTorqAvail_pct_maxval "" VALUE 0x0000 /* @ECU_Address@KOUTP_EVCU2MinTorqAvail_pct_maxval@ */ Scalar_FLOAT32_IEEE 0 SWC_OUTP_type_CM_single_pct -65535.0 65535.0 /end CHARACTERISTIC
/begin CHARACTERISTIC KOUTP_EVCU2MinTorqAvail_pct_minval "" VALUE 0x0000 /* @ECU_Address@KOUTP_EVCU2MinTorqAvail_pct_minval@ */ Scalar_FLOAT32_IEEE 0 SWC_OUTP_type_CM_single_pct -65535.0 65535.0 /end CHARACTERISTIC
/begin CHARACTERISTIC KOUTP_EVCU2MinTorqAvail_pct_ovrdval "" VALUE 0x0000 /* @ECU_Address@KOUTP_EVCU2MinTorqAvail_pct_ovrdval@ */ Scalar_FLOAT32_IEEE 0 SWC_OUTP_type_CM_single_pct -65535.0 65535.0 /end CHARACTERISTIC
/begin CHARACTERISTIC KOUTP_FrTMTqReq_Nm_maxval "" VALUE 0x0000 /* @ECU_Address@KOUTP_FrTMTqReq_Nm_maxval@ */ Scalar_FLOAT32_IEEE 0 SWC_OUTP_type_CM_single_Nm -100000.0 100000.0 /end CHARACTERISTIC
/begin CHARACTERISTIC KOUTP_FrTMTqReq_Nm_minval "" VALUE 0x0000 /* @ECU_Address@KOUTP_FrTMTqReq_Nm_minval@ */ Scalar_FLOAT32_IEEE 0 SWC_OUTP_type_CM_single_Nm -100000.0 100000.0 /end CHARACTERISTIC
/begin CHARACTERISTIC KOUTP_FrTMTqReq_Nm_ovrdval "" VALUE 0x0000 /* @ECU_Address@KOUTP_FrTMTqReq_Nm_ovrdval@ */ Scalar_FLOAT32_IEEE 0 SWC_OUTP_type_CM_single_Nm -100000.0 100000.0 /end CHARACTERISTIC
/begin CHARACTERISTIC KOUTP_RC1MaxRetSpdP2_rpm_maxval "" VALUE 0x0000 /* @ECU_Address@KOUTP_RC1MaxRetSpdP2_rpm_maxval@ */ Scalar_FLOAT32_IEEE 0 SWC_OUTP_type_CM_single_rpm -100000.0 100000.0 /end CHARACTERISTIC
/begin CHARACTERISTIC KOUTP_RC1MaxRetSpdP2_rpm_minval "" VALUE 0x0000 /* @ECU_Address@KOUTP_RC1MaxRetSpdP2_rpm_minval@ */ Scalar_FLOAT32_IEEE 0 SWC_OUTP_type_CM_single_rpm -100000.0 100000.0 /end CHARACTERISTIC
/begin CHARACTERISTIC KOUTP_RC1MaxRetSpdP2_rpm_ovrdval "" VALUE 0x0000 /* @ECU_Address@KOUTP_RC1MaxRetSpdP2_rpm_ovrdval@ */ Scalar_FLOAT32_IEEE 0 SWC_OUTP_type_CM_single_rpm -100000.0 100000.0 /end CHARACTERISTIC
/begin CHARACTERISTIC KOUTP_RC1MaxRetSpdP3_rpm_maxval "" VALUE 0x0000 /* @ECU_Address@KOUTP_RC1MaxRetSpdP3_rpm_maxval@ */ Scalar_FLOAT32_IEEE 0 SWC_OUTP_type_CM_single_rpm -100000.0 100000.0 /end CHARACTERISTIC
/begin CHARACTERISTIC KOUTP_RC1MaxRetSpdP3_rpm_minval "" VALUE 0x0000 /* @ECU_Address@KOUTP_RC1MaxRetSpdP3_rpm_minval@ */ Scalar_FLOAT32_IEEE 0 SWC_OUTP_type_CM_single_rpm -100000.0 100000.0 /end CHARACTERISTIC
/begin CHARACTERISTIC KOUTP_RC1MaxRetSpdP3_rpm_ovrdval "" VALUE 0x0000 /* @ECU_Address@KOUTP_RC1MaxRetSpdP3_rpm_ovrdval@ */ Scalar_FLOAT32_IEEE 0 SWC_OUTP_type_CM_single_rpm -100000.0 100000.0 /end CHARACTERISTIC
/begin CHARACTERISTIC KOUTP_RC1PctTrqIdleP1_pct_maxval "" VALUE 0x0000 /* @ECU_Address@KOUTP_RC1PctTrqIdleP1_pct_maxval@ */ Scalar_FLOAT32_IEEE 0 SWC_OUTP_type_CM_single_pct -65535.0 65535.0 /end CHARACTERISTIC
/begin CHARACTERISTIC KOUTP_RC1PctTrqIdleP1_pct_minval "" VALUE 0x0000 /* @ECU_Address@KOUTP_RC1PctTrqIdleP1_pct_minval@ */ Scalar_FLOAT32_IEEE 0 SWC_OUTP_type_CM_single_pct -65535.0 65535.0 /end CHARACTERISTIC
/begin CHARACTERISTIC KOUTP_RC1PctTrqIdleP1_pct_ovrdval "" VALUE 0x0000 /* @ECU_Address@KOUTP_RC1PctTrqIdleP1_pct_ovrdval@ */ Scalar_FLOAT32_IEEE 0 SWC_OUTP_type_CM_single_pct -65535.0 65535.0 /end CHARACTERISTIC
/begin CHARACTERISTIC KOUTP_RC1PctTrqP3_pct_maxval "" VALUE 0x0000 /* @ECU_Address@KOUTP_RC1PctTrqP3_pct_maxval@ */ Scalar_FLOAT32_IEEE 0 SWC_OUTP_type_CM_single_pct -65535.0 65535.0 /end CHARACTERISTIC
/begin CHARACTERISTIC KOUTP_RC1PctTrqP3_pct_minval "" VALUE 0x0000 /* @ECU_Address@KOUTP_RC1PctTrqP3_pct_minval@ */ Scalar_FLOAT32_IEEE 0 SWC_OUTP_type_CM_single_pct -65535.0 65535.0 /end CHARACTERISTIC
/begin CHARACTERISTIC KOUTP_RC1PctTrqP3_pct_ovrdval "" VALUE 0x0000 /* @ECU_Address@KOUTP_RC1PctTrqP3_pct_ovrdval@ */ Scalar_FLOAT32_IEEE 0 SWC_OUTP_type_CM_single_pct -65535.0 65535.0 /end CHARACTERISTIC
/begin CHARACTERISTIC KOUTP_RC1PctTrqP4_pct_maxval "" VALUE 0x0000 /* @ECU_Address@KOUTP_RC1PctTrqP4_pct_maxval@ */ Scalar_FLOAT32_IEEE 0 SWC_OUTP_type_CM_single_pct -65535.0 65535.0 /end CHARACTERISTIC
/begin CHARACTERISTIC KOUTP_RC1PctTrqP4_pct_minval "" VALUE 0x0000 /* @ECU_Address@KOUTP_RC1PctTrqP4_pct_minval@ */ Scalar_FLOAT32_IEEE 0 SWC_OUTP_type_CM_single_pct -65535.0 65535.0 /end CHARACTERISTIC
/begin CHARACTERISTIC KOUTP_RC1PctTrqP4_pct_ovrdval "" VALUE 0x0000 /* @ECU_Address@KOUTP_RC1PctTrqP4_pct_ovrdval@ */ Scalar_FLOAT32_IEEE 0 SWC_OUTP_type_CM_single_pct -65535.0 65535.0 /end CHARACTERISTIC
/begin CHARACTERISTIC KOUTP_RC1PctTrqPekTrqP5_pct_maxval "" VALUE 0x0000 /* @ECU_Address@KOUTP_RC1PctTrqPekTrqP5_pct_maxval@ */ Scalar_FLOAT32_IEEE 0 SWC_OUTP_type_CM_single_pct -65535.0 65535.0 /end CHARACTERISTIC
/begin CHARACTERISTIC KOUTP_RC1PctTrqPekTrqP5_pct_minval "" VALUE 0x0000 /* @ECU_Address@KOUTP_RC1PctTrqPekTrqP5_pct_minval@ */ Scalar_FLOAT32_IEEE 0 SWC_OUTP_type_CM_single_pct -65535.0 65535.0 /end CHARACTERISTIC
/begin CHARACTERISTIC KOUTP_RC1PctTrqPekTrqP5_pct_ovrdval "" VALUE 0x0000 /* @ECU_Address@KOUTP_RC1PctTrqPekTrqP5_pct_ovrdval@ */ Scalar_FLOAT32_IEEE 0 SWC_OUTP_type_CM_single_pct -65535.0 65535.0 /end CHARACTERISTIC
/begin CHARACTERISTIC KOUTP_RC1RefRetTrq_Nm_maxval "" VALUE 0x0000 /* @ECU_Address@KOUTP_RC1RefRetTrq_Nm_maxval@ */ Scalar_FLOAT32_IEEE 0 SWC_OUTP_type_CM_single_Nm -100000.0 100000.0 /end CHARACTERISTIC
/begin CHARACTERISTIC KOUTP_RC1RefRetTrq_Nm_minval "" VALUE 0x0000 /* @ECU_Address@KOUTP_RC1RefRetTrq_Nm_minval@ */ Scalar_FLOAT32_IEEE 0 SWC_OUTP_type_CM_single_Nm -100000.0 100000.0 /end CHARACTERISTIC
/begin CHARACTERISTIC KOUTP_RC1RefRetTrq_Nm_ovrdval "" VALUE 0x0000 /* @ECU_Address@KOUTP_RC1RefRetTrq_Nm_ovrdval@ */ Scalar_FLOAT32_IEEE 0 SWC_OUTP_type_CM_single_Nm -100000.0 100000.0 /end CHARACTERISTIC
/begin CHARACTERISTIC KOUTP_RC1RetCtrlMth_enum_maxval "" VALUE 0x0000 /* @ECU_Address@KOUTP_RC1RetCtrlMth_enum_maxval@ */ Scalar_FLOAT32_IEEE 0 SWC_OUTP_type_CM_single_enum -65535.0 65535.0 /end CHARACTERISTIC
/begin CHARACTERISTIC KOUTP_RC1RetCtrlMth_enum_minval "" VALUE 0x0000 /* @ECU_Address@KOUTP_RC1RetCtrlMth_enum_minval@ */ Scalar_FLOAT32_IEEE 0 SWC_OUTP_type_CM_single_enum -65535.0 65535.0 /end CHARACTERISTIC
/begin CHARACTERISTIC KOUTP_RC1RetCtrlMth_enum_ovrdval "" VALUE 0x0000 /* @ECU_Address@KOUTP_RC1RetCtrlMth_enum_ovrdval@ */ Scalar_FLOAT32_IEEE 0 SWC_OUTP_type_CM_single_enum -65535.0 65535.0 /end CHARACTERISTIC
/begin CHARACTERISTIC KOUTP_RC1RetSpdIdleP1_rpm_maxval "" VALUE 0x0000 /* @ECU_Address@KOUTP_RC1RetSpdIdleP1_rpm_maxval@ */ Scalar_FLOAT32_IEEE 0 SWC_OUTP_type_CM_single_rpm -100000.0 100000.0 /end CHARACTERISTIC
/begin CHARACTERISTIC KOUTP_RC1RetSpdIdleP1_rpm_minval "" VALUE 0x0000 /* @ECU_Address@KOUTP_RC1RetSpdIdleP1_rpm_minval@ */ Scalar_FLOAT32_IEEE 0 SWC_OUTP_type_CM_single_rpm -100000.0 100000.0 /end CHARACTERISTIC
/begin CHARACTERISTIC KOUTP_RC1RetSpdIdleP1_rpm_ovrdval "" VALUE 0x0000 /* @ECU_Address@KOUTP_RC1RetSpdIdleP1_rpm_ovrdval@ */ Scalar_FLOAT32_IEEE 0 SWC_OUTP_type_CM_single_rpm -100000.0 100000.0 /end CHARACTERISTIC
/begin CHARACTERISTIC KOUTP_RC1RetSpdP2_pct_maxval "" VALUE 0x0000 /* @ECU_Address@KOUTP_RC1RetSpdP2_pct_maxval@ */ Scalar_FLOAT32_IEEE 0 SWC_OUTP_type_CM_single_pct -65535.0 65535.0 /end CHARACTERISTIC
/begin CHARACTERISTIC KOUTP_RC1RetSpdP2_pct_minval "" VALUE 0x0000 /* @ECU_Address@KOUTP_RC1RetSpdP2_pct_minval@ */ Scalar_FLOAT32_IEEE 0 SWC_OUTP_type_CM_single_pct -65535.0 65535.0 /end CHARACTERISTIC
/begin CHARACTERISTIC KOUTP_RC1RetSpdP2_pct_ovrdval "" VALUE 0x0000 /* @ECU_Address@KOUTP_RC1RetSpdP2_pct_ovrdval@ */ Scalar_FLOAT32_IEEE 0 SWC_OUTP_type_CM_single_pct -65535.0 65535.0 /end CHARACTERISTIC
/begin CHARACTERISTIC KOUTP_RC1RetSpdP4_rpm_maxval "" VALUE 0x0000 /* @ECU_Address@KOUTP_RC1RetSpdP4_rpm_maxval@ */ Scalar_FLOAT32_IEEE 0 SWC_OUTP_type_CM_single_rpm -100000.0 100000.0 /end CHARACTERISTIC
/begin CHARACTERISTIC KOUTP_RC1RetSpdP4_rpm_minval "" VALUE 0x0000 /* @ECU_Address@KOUTP_RC1RetSpdP4_rpm_minval@ */ Scalar_FLOAT32_IEEE 0 SWC_OUTP_type_CM_single_rpm -100000.0 100000.0 /end CHARACTERISTIC
/begin CHARACTERISTIC KOUTP_RC1RetSpdP4_rpm_ovrdval "" VALUE 0x0000 /* @ECU_Address@KOUTP_RC1RetSpdP4_rpm_ovrdval@ */ Scalar_FLOAT32_IEEE 0 SWC_OUTP_type_CM_single_rpm -100000.0 100000.0 /end CHARACTERISTIC
/begin CHARACTERISTIC KOUTP_RC1RetSpdPekTrqP5_Nm_maxval "" VALUE 0x0000 /* @ECU_Address@KOUTP_RC1RetSpdPekTrqP5_Nm_maxval@ */ Scalar_FLOAT32_IEEE 0 SWC_OUTP_type_CM_single_Nm -100000.0 100000.0 /end CHARACTERISTIC
/begin CHARACTERISTIC KOUTP_RC1RetSpdPekTrqP5_Nm_minval "" VALUE 0x0000 /* @ECU_Address@KOUTP_RC1RetSpdPekTrqP5_Nm_minval@ */ Scalar_FLOAT32_IEEE 0 SWC_OUTP_type_CM_single_Nm -100000.0 100000.0 /end CHARACTERISTIC
/begin CHARACTERISTIC KOUTP_RC1RetSpdPekTrqP5_Nm_ovrdval "" VALUE 0x0000 /* @ECU_Address@KOUTP_RC1RetSpdPekTrqP5_Nm_ovrdval@ */ Scalar_FLOAT32_IEEE 0 SWC_OUTP_type_CM_single_Nm -100000.0 100000.0 /end CHARACTERISTIC
/begin CHARACTERISTIC KOUTP_RRWheelTemp_C_maxval "" VALUE 0x0000 /* @ECU_Address@KOUTP_RRWheelTemp_C_maxval@ */ Scalar_FLOAT32_IEEE 0 SWC_OUTP_type_CM_single_C -65535.0 65535.0 /end CHARACTERISTIC
/begin CHARACTERISTIC KOUTP_RRWheelTemp_C_minval "" VALUE 0x0000 /* @ECU_Address@KOUTP_RRWheelTemp_C_minval@ */ Scalar_FLOAT32_IEEE 0 SWC_OUTP_type_CM_single_C -65535.0 65535.0 /end CHARACTERISTIC
/begin CHARACTERISTIC KOUTP_RRWheelTemp_C_ovrdval "" VALUE 0x0000 /* @ECU_Address@KOUTP_RRWheelTemp_C_ovrdval@ */ Scalar_FLOAT32_IEEE 0 SWC_OUTP_type_CM_single_C -65535.0 65535.0 /end CHARACTERISTIC
/begin CHARACTERISTIC KOUTP_RrTMTqReq_Nm_maxval "" VALUE 0x0000 /* @ECU_Address@KOUTP_RrTMTqReq_Nm_maxval@ */ Scalar_FLOAT32_IEEE 0 SWC_OUTP_type_CM_single_Nm -100000.0 100000.0 /end CHARACTERISTIC
/begin CHARACTERISTIC KOUTP_RrTMTqReq_Nm_minval "" VALUE 0x0000 /* @ECU_Address@KOUTP_RrTMTqReq_Nm_minval@ */ Scalar_FLOAT32_IEEE 0 SWC_OUTP_type_CM_single_Nm -100000.0 100000.0 /end CHARACTERISTIC
/begin CHARACTERISTIC KOUTP_RrTMTqReq_Nm_ovrdval "" VALUE 0x0000 /* @ECU_Address@KOUTP_RrTMTqReq_Nm_ovrdval@ */ Scalar_FLOAT32_IEEE 0 SWC_OUTP_type_CM_single_Nm -100000.0 100000.0 /end CHARACTERISTIC
/begin CHARACTERISTIC KOUTP_S1WheelDebugALTU_pct_maxval "" VALUE 0x0000 /* @ECU_Address@KOUTP_S1WheelDebugALTU_pct_maxval@ */ Scalar_FLOAT32_IEEE 0 SWC_OUTP_type_CM_single_pct -65535.0 65535.0 /end CHARACTERISTIC
/begin CHARACTERISTIC KOUTP_S1WheelDebugALTU_pct_minval "" VALUE 0x0000 /* @ECU_Address@KOUTP_S1WheelDebugALTU_pct_minval@ */ Scalar_FLOAT32_IEEE 0 SWC_OUTP_type_CM_single_pct -65535.0 65535.0 /end CHARACTERISTIC
/begin CHARACTERISTIC KOUTP_S1WheelDebugALTU_pct_ovrdval "" VALUE 0x0000 /* @ECU_Address@KOUTP_S1WheelDebugALTU_pct_ovrdval@ */ Scalar_FLOAT32_IEEE 0 SWC_OUTP_type_CM_single_pct -65535.0 65535.0 /end CHARACTERISTIC
/begin CHARACTERISTIC KOUTP_S2WheelDebugALTU_pct_maxval "" VALUE 0x0000 /* @ECU_Address@KOUTP_S2WheelDebugALTU_pct_maxval@ */ Scalar_FLOAT32_IEEE 0 SWC_OUTP_type_CM_single_pct -65535.0 65535.0 /end CHARACTERISTIC
/begin CHARACTERISTIC KOUTP_S2WheelDebugALTU_pct_minval "" VALUE 0x0000 /* @ECU_Address@KOUTP_S2WheelDebugALTU_pct_minval@ */ Scalar_FLOAT32_IEEE 0 SWC_OUTP_type_CM_single_pct -65535.0 65535.0 /end CHARACTERISTIC
/begin CHARACTERISTIC KOUTP_S2WheelDebugALTU_pct_ovrdval "" VALUE 0x0000 /* @ECU_Address@KOUTP_S2WheelDebugALTU_pct_ovrdval@ */ Scalar_FLOAT32_IEEE 0 SWC_OUTP_type_CM_single_pct -65535.0 65535.0 /end CHARACTERISTIC
/begin CHARACTERISTIC KOUTP_S3WheelDebugALTU_pct_maxval "" VALUE 0x0000 /* @ECU_Address@KOUTP_S3WheelDebugALTU_pct_maxval@ */ Scalar_FLOAT32_IEEE 0 SWC_OUTP_type_CM_single_pct -65535.0 65535.0 /end CHARACTERISTIC
/begin CHARACTERISTIC KOUTP_S3WheelDebugALTU_pct_minval "" VALUE 0x0000 /* @ECU_Address@KOUTP_S3WheelDebugALTU_pct_minval@ */ Scalar_FLOAT32_IEEE 0 SWC_OUTP_type_CM_single_pct -65535.0 65535.0 /end CHARACTERISTIC
/begin CHARACTERISTIC KOUTP_S3WheelDebugALTU_pct_ovrdval "" VALUE 0x0000 /* @ECU_Address@KOUTP_S3WheelDebugALTU_pct_ovrdval@ */ Scalar_FLOAT32_IEEE 0 SWC_OUTP_type_CM_single_pct -65535.0 65535.0 /end CHARACTERISTIC
/begin CHARACTERISTIC KOUTP_S4WheelDebugALTU_pct_maxval "" VALUE 0x0000 /* @ECU_Address@KOUTP_S4WheelDebugALTU_pct_maxval@ */ Scalar_FLOAT32_IEEE 0 SWC_OUTP_type_CM_single_pct -65535.0 65535.0 /end CHARACTERISTIC
/begin CHARACTERISTIC KOUTP_S4WheelDebugALTU_pct_minval "" VALUE 0x0000 /* @ECU_Address@KOUTP_S4WheelDebugALTU_pct_minval@ */ Scalar_FLOAT32_IEEE 0 SWC_OUTP_type_CM_single_pct -65535.0 65535.0 /end CHARACTERISTIC
/begin CHARACTERISTIC KOUTP_S4WheelDebugALTU_pct_ovrdval "" VALUE 0x0000 /* @ECU_Address@KOUTP_S4WheelDebugALTU_pct_ovrdval@ */ Scalar_FLOAT32_IEEE 0 SWC_OUTP_type_CM_single_pct -65535.0 65535.0 /end CHARACTERISTIC
/begin CHARACTERISTIC KOUTP_TMTqReq_Nm_maxval "" VALUE 0x0000 /* @ECU_Address@KOUTP_TMTqReq_Nm_maxval@ */ Scalar_FLOAT32_IEEE 0 SWC_OUTP_type_CM_single_Nm -100000.0 100000.0 /end CHARACTERISTIC
/begin CHARACTERISTIC KOUTP_TMTqReq_Nm_minval "" VALUE 0x0000 /* @ECU_Address@KOUTP_TMTqReq_Nm_minval@ */ Scalar_FLOAT32_IEEE 0 SWC_OUTP_type_CM_single_Nm -100000.0 100000.0 /end CHARACTERISTIC
/begin CHARACTERISTIC KOUTP_TMTqReq_Nm_ovrdval "" VALUE 0x0000 /* @ECU_Address@KOUTP_TMTqReq_Nm_ovrdval@ */ Scalar_FLOAT32_IEEE 0 SWC_OUTP_type_CM_single_Nm -100000.0 100000.0 /end CHARACTERISTIC
/begin CHARACTERISTIC KOUTP_VCUMCUDemHiPosVal_rpm_maxval "" VALUE 0x0000 /* @ECU_Address@KOUTP_VCUMCUDemHiPosVal_rpm_maxval@ */ Scalar_FLOAT32_IEEE 0 SWC_OUTP_type_CM_single_rpm -100000.0 100000.0 /end CHARACTERISTIC
/begin CHARACTERISTIC KOUTP_VCUMCUDemHiPosVal_rpm_minval "" VALUE 0x0000 /* @ECU_Address@KOUTP_VCUMCUDemHiPosVal_rpm_minval@ */ Scalar_FLOAT32_IEEE 0 SWC_OUTP_type_CM_single_rpm -100000.0 100000.0 /end CHARACTERISTIC
/begin CHARACTERISTIC KOUTP_VCUMCUDemHiPosVal_rpm_ovrdval "" VALUE 0x0000 /* @ECU_Address@KOUTP_VCUMCUDemHiPosVal_rpm_ovrdval@ */ Scalar_FLOAT32_IEEE 0 SWC_OUTP_type_CM_single_rpm -100000.0 100000.0 /end CHARACTERISTIC
/begin CHARACTERISTIC KOUTP_VCUMCUDemLoNegVal_rpm_maxval "" VALUE 0x0000 /* @ECU_Address@KOUTP_VCUMCUDemLoNegVal_rpm_maxval@ */ Scalar_FLOAT32_IEEE 0 SWC_OUTP_type_CM_single_rpm -100000.0 100000.0 /end CHARACTERISTIC
/begin CHARACTERISTIC KOUTP_VCUMCUDemLoNegVal_rpm_minval "" VALUE 0x0000 /* @ECU_Address@KOUTP_VCUMCUDemLoNegVal_rpm_minval@ */ Scalar_FLOAT32_IEEE 0 SWC_OUTP_type_CM_single_rpm -100000.0 100000.0 /end CHARACTERISTIC
/begin CHARACTERISTIC KOUTP_VCUMCUDemLoNegVal_rpm_ovrdval "" VALUE 0x0000 /* @ECU_Address@KOUTP_VCUMCUDemLoNegVal_rpm_ovrdval@ */ Scalar_FLOAT32_IEEE 0 SWC_OUTP_type_CM_single_rpm -100000.0 100000.0 /end CHARACTERISTIC
/begin CHARACTERISTIC KOUTP_VCUMCUDemSpd_rpm_maxval "" VALUE 0x0000 /* @ECU_Address@KOUTP_VCUMCUDemSpd_rpm_maxval@ */ Scalar_FLOAT32_IEEE 0 SWC_OUTP_type_CM_single_rpm -100000.0 100000.0 /end CHARACTERISTIC
/begin CHARACTERISTIC KOUTP_VCUMCUDemSpd_rpm_minval "" VALUE 0x0000 /* @ECU_Address@KOUTP_VCUMCUDemSpd_rpm_minval@ */ Scalar_FLOAT32_IEEE 0 SWC_OUTP_type_CM_single_rpm -100000.0 100000.0 /end CHARACTERISTIC
/begin CHARACTERISTIC KOUTP_VCUMCUDemSpd_rpm_ovrdval "" VALUE 0x0000 /* @ECU_Address@KOUTP_VCUMCUDemSpd_rpm_ovrdval@ */ Scalar_FLOAT32_IEEE 0 SWC_OUTP_type_CM_single_rpm -100000.0 100000.0 /end CHARACTERISTIC
/begin CHARACTERISTIC KOUTP_VCUTMVehSpd_kph_maxval "" VALUE 0x0000 /* @ECU_Address@KOUTP_VCUTMVehSpd_kph_maxval@ */ Scalar_FLOAT32_IEEE 0 SWC_OUTP_type_CM_single_kph -65535.0 65535.0 /end CHARACTERISTIC
/begin CHARACTERISTIC KOUTP_VCUTMVehSpd_kph_minval "" VALUE 0x0000 /* @ECU_Address@KOUTP_VCUTMVehSpd_kph_minval@ */ Scalar_FLOAT32_IEEE 0 SWC_OUTP_type_CM_single_kph -65535.0 65535.0 /end CHARACTERISTIC
/begin CHARACTERISTIC KOUTP_VCUTMVehSpd_kph_ovrdval "" VALUE 0x0000 /* @ECU_Address@KOUTP_VCUTMVehSpd_kph_ovrdval@ */ Scalar_FLOAT32_IEEE 0 SWC_OUTP_type_CM_single_kph -65535.0 65535.0 /end CHARACTERISTIC
/begin CHARACTERISTIC KOUTP_VehAcclLimitTG_mps2_maxval "" VALUE 0x0000 /* @ECU_Address@KOUTP_VehAcclLimitTG_mps2_maxval@ */ Scalar_FLOAT32_IEEE 0 SWC_OUTP_type_CM_single_mps2 -65535.0 65535.0 /end CHARACTERISTIC
/begin CHARACTERISTIC KOUTP_VehAcclLimitTG_mps2_minval "" VALUE 0x0000 /* @ECU_Address@KOUTP_VehAcclLimitTG_mps2_minval@ */ Scalar_FLOAT32_IEEE 0 SWC_OUTP_type_CM_single_mps2 -65535.0 65535.0 /end CHARACTERISTIC
/begin CHARACTERISTIC KOUTP_VehAcclLimitTG_mps2_ovrdval "" VALUE 0x0000 /* @ECU_Address@KOUTP_VehAcclLimitTG_mps2_ovrdval@ */ Scalar_FLOAT32_IEEE 0 SWC_OUTP_type_CM_single_mps2 -65535.0 65535.0 /end CHARACTERISTIC
/begin CHARACTERISTIC KOUTP_VehSpdLimitTG_kph_maxval "" VALUE 0x0000 /* @ECU_Address@KOUTP_VehSpdLimitTG_kph_maxval@ */ Scalar_FLOAT32_IEEE 0 SWC_OUTP_type_CM_single_kph -65535.0 65535.0 /end CHARACTERISTIC
/begin CHARACTERISTIC KOUTP_VehSpdLimitTG_kph_minval "" VALUE 0x0000 /* @ECU_Address@KOUTP_VehSpdLimitTG_kph_minval@ */ Scalar_FLOAT32_IEEE 0 SWC_OUTP_type_CM_single_kph -65535.0 65535.0 /end CHARACTERISTIC
/begin CHARACTERISTIC KOUTP_VehSpdLimitTG_kph_ovrdval "" VALUE 0x0000 /* @ECU_Address@KOUTP_VehSpdLimitTG_kph_ovrdval@ */ Scalar_FLOAT32_IEEE 0 SWC_OUTP_type_CM_single_kph -65535.0 65535.0 /end CHARACTERISTIC
/begin CHARACTERISTIC KOUTP_S1ID_raw32_maxval "" VALUE 0x0000 /* @ECU_Address@KOUTP_S1ID_raw32_maxval@ */ Scalar_ULONG 0 SWC_OUTP_type_CM_uint32_raw32 0.0 4.294967295E+9 /end CHARACTERISTIC
/begin CHARACTERISTIC KOUTP_S1ID_raw32_minval "" VALUE 0x0000 /* @ECU_Address@KOUTP_S1ID_raw32_minval@ */ Scalar_ULONG 0 SWC_OUTP_type_CM_uint32_raw32 0.0 4.294967295E+9 /end CHARACTERISTIC
/begin CHARACTERISTIC KOUTP_S1ID_raw32_ovrdval "" VALUE 0x0000 /* @ECU_Address@KOUTP_S1ID_raw32_ovrdval@ */ Scalar_ULONG 0 SWC_OUTP_type_CM_uint32_raw32 0.0 4.294967295E+9 /end CHARACTERISTIC
/begin CHARACTERISTIC KOUTP_S2ID_raw32_maxval "" VALUE 0x0000 /* @ECU_Address@KOUTP_S2ID_raw32_maxval@ */ Scalar_ULONG 0 SWC_OUTP_type_CM_uint32_raw32 0.0 4.294967295E+9 /end CHARACTERISTIC
/begin CHARACTERISTIC KOUTP_S2ID_raw32_minval "" VALUE 0x0000 /* @ECU_Address@KOUTP_S2ID_raw32_minval@ */ Scalar_ULONG 0 SWC_OUTP_type_CM_uint32_raw32 0.0 4.294967295E+9 /end CHARACTERISTIC
/begin CHARACTERISTIC KOUTP_S2ID_raw32_ovrdval "" VALUE 0x0000 /* @ECU_Address@KOUTP_S2ID_raw32_ovrdval@ */ Scalar_ULONG 0 SWC_OUTP_type_CM_uint32_raw32 0.0 4.294967295E+9 /end CHARACTERISTIC
/begin CHARACTERISTIC KOUTP_S3ID_raw32_maxval "" VALUE 0x0000 /* @ECU_Address@KOUTP_S3ID_raw32_maxval@ */ Scalar_ULONG 0 SWC_OUTP_type_CM_uint32_raw32 0.0 4.294967295E+9 /end CHARACTERISTIC
/begin CHARACTERISTIC KOUTP_S3ID_raw32_minval "" VALUE 0x0000 /* @ECU_Address@KOUTP_S3ID_raw32_minval@ */ Scalar_ULONG 0 SWC_OUTP_type_CM_uint32_raw32 0.0 4.294967295E+9 /end CHARACTERISTIC
/begin CHARACTERISTIC KOUTP_S3ID_raw32_ovrdval "" VALUE 0x0000 /* @ECU_Address@KOUTP_S3ID_raw32_ovrdval@ */ Scalar_ULONG 0 SWC_OUTP_type_CM_uint32_raw32 0.0 4.294967295E+9 /end CHARACTERISTIC
/begin CHARACTERISTIC KOUTP_S4ID_raw32_maxval "" VALUE 0x0000 /* @ECU_Address@KOUTP_S4ID_raw32_maxval@ */ Scalar_ULONG 0 SWC_OUTP_type_CM_uint32_raw32 0.0 4.294967295E+9 /end CHARACTERISTIC
/begin CHARACTERISTIC KOUTP_S4ID_raw32_minval "" VALUE 0x0000 /* @ECU_Address@KOUTP_S4ID_raw32_minval@ */ Scalar_ULONG 0 SWC_OUTP_type_CM_uint32_raw32 0.0 4.294967295E+9 /end CHARACTERISTIC
/begin CHARACTERISTIC KOUTP_S4ID_raw32_ovrdval "" VALUE 0x0000 /* @ECU_Address@KOUTP_S4ID_raw32_ovrdval@ */ Scalar_ULONG 0 SWC_OUTP_type_CM_uint32_raw32 0.0 4.294967295E+9 /end CHARACTERISTIC
/begin CHARACTERISTIC KOUTP_WriteChkLFID_raw_maxval "" VALUE 0x0000 /* @ECU_Address@KOUTP_WriteChkLFID_raw_maxval@ */ Scalar_ULONG 0 SWC_OUTP_type_CM_uint32_raw32 0.0 4.294967295E+9 /end CHARACTERISTIC
/begin CHARACTERISTIC KOUTP_WriteChkLFID_raw_minval "" VALUE 0x0000 /* @ECU_Address@KOUTP_WriteChkLFID_raw_minval@ */ Scalar_ULONG 0 SWC_OUTP_type_CM_uint32_raw32 0.0 4.294967295E+9 /end CHARACTERISTIC
/begin CHARACTERISTIC KOUTP_WriteChkLFID_raw_ovrdval "" VALUE 0x0000 /* @ECU_Address@KOUTP_WriteChkLFID_raw_ovrdval@ */ Scalar_ULONG 0 SWC_OUTP_type_CM_uint32_raw 0.0 4.294967295E+9 /end CHARACTERISTIC
/begin CHARACTERISTIC KOUTP_WriteChkLRID_raw_maxval "" VALUE 0x0000 /* @ECU_Address@KOUTP_WriteChkLRID_raw_maxval@ */ Scalar_ULONG 0 SWC_OUTP_type_CM_uint32_raw32 0.0 4.294967295E+9 /end CHARACTERISTIC
/begin CHARACTERISTIC KOUTP_WriteChkLRID_raw_minval "" VALUE 0x0000 /* @ECU_Address@KOUTP_WriteChkLRID_raw_minval@ */ Scalar_ULONG 0 SWC_OUTP_type_CM_uint32_raw32 0.0 4.294967295E+9 /end CHARACTERISTIC
/begin CHARACTERISTIC KOUTP_WriteChkLRID_raw_ovrdval "" VALUE 0x0000 /* @ECU_Address@KOUTP_WriteChkLRID_raw_ovrdval@ */ Scalar_ULONG 0 SWC_OUTP_type_CM_uint32_raw 0.0 4.294967295E+9 /end CHARACTERISTIC
/begin CHARACTERISTIC KOUTP_WriteChkRFID_raw_maxval "" VALUE 0x0000 /* @ECU_Address@KOUTP_WriteChkRFID_raw_maxval@ */ Scalar_ULONG 0 SWC_OUTP_type_CM_uint32_raw32 0.0 4.294967295E+9 /end CHARACTERISTIC
/begin CHARACTERISTIC KOUTP_WriteChkRFID_raw_minval "" VALUE 0x0000 /* @ECU_Address@KOUTP_WriteChkRFID_raw_minval@ */ Scalar_ULONG 0 SWC_OUTP_type_CM_uint32_raw32 0.0 4.294967295E+9 /end CHARACTERISTIC
/begin CHARACTERISTIC KOUTP_WriteChkRFID_raw_ovrdval "" VALUE 0x0000 /* @ECU_Address@KOUTP_WriteChkRFID_raw_ovrdval@ */ Scalar_ULONG 0 SWC_OUTP_type_CM_uint32_raw 0.0 4.294967295E+9 /end CHARACTERISTIC
/begin CHARACTERISTIC KOUTP_WriteChkRRID_raw_maxval "" VALUE 0x0000 /* @ECU_Address@KOUTP_WriteChkRRID_raw_maxval@ */ Scalar_ULONG 0 SWC_OUTP_type_CM_uint32_raw32 0.0 4.294967295E+9 /end CHARACTERISTIC
/begin CHARACTERISTIC KOUTP_WriteChkRRID_raw_minval "" VALUE 0x0000 /* @ECU_Address@KOUTP_WriteChkRRID_raw_minval@ */ Scalar_ULONG 0 SWC_OUTP_type_CM_uint32_raw32 0.0 4.294967295E+9 /end CHARACTERISTIC
/begin CHARACTERISTIC KOUTP_WriteChkRRID_raw_ovrdval "" VALUE 0x0000 /* @ECU_Address@KOUTP_WriteChkRRID_raw_ovrdval@ */ Scalar_ULONG 0 SWC_OUTP_type_CM_uint32_raw 0.0 4.294967295E+9 /end CHARACTERISTIC
/begin CHARACTERISTIC KOUTP_WriteChkfinLFID_raw_maxval "" VALUE 0x0000 /* @ECU_Address@KOUTP_WriteChkfinLFID_raw_maxval@ */ Scalar_ULONG 0 SWC_OUTP_type_CM_uint32_raw32 0.0 4.294967295E+9 /end CHARACTERISTIC
/begin CHARACTERISTIC KOUTP_WriteChkfinLFID_raw_minval "" VALUE 0x0000 /* @ECU_Address@KOUTP_WriteChkfinLFID_raw_minval@ */ Scalar_ULONG 0 SWC_OUTP_type_CM_uint32_raw32 0.0 4.294967295E+9 /end CHARACTERISTIC
/begin CHARACTERISTIC KOUTP_WriteChkfinLFID_raw_ovrdval "" VALUE 0x0000 /* @ECU_Address@KOUTP_WriteChkfinLFID_raw_ovrdval@ */ Scalar_ULONG 0 SWC_OUTP_type_CM_uint32_raw 0.0 4.294967295E+9 /end CHARACTERISTIC
/begin CHARACTERISTIC KOUTP_WriteChkfinLRID_raw_maxval "" VALUE 0x0000 /* @ECU_Address@KOUTP_WriteChkfinLRID_raw_maxval@ */ Scalar_ULONG 0 SWC_OUTP_type_CM_uint32_raw32 0.0 4.294967295E+9 /end CHARACTERISTIC
/begin CHARACTERISTIC KOUTP_WriteChkfinLRID_raw_minval "" VALUE 0x0000 /* @ECU_Address@KOUTP_WriteChkfinLRID_raw_minval@ */ Scalar_ULONG 0 SWC_OUTP_type_CM_uint32_raw32 0.0 4.294967295E+9 /end CHARACTERISTIC
/begin CHARACTERISTIC KOUTP_WriteChkfinLRID_raw_ovrdval "" VALUE 0x0000 /* @ECU_Address@KOUTP_WriteChkfinLRID_raw_ovrdval@ */ Scalar_ULONG 0 SWC_OUTP_type_CM_uint32_raw 0.0 4.294967295E+9 /end CHARACTERISTIC
/begin CHARACTERISTIC KOUTP_WriteChkfinRFID_raw_maxval "" VALUE 0x0000 /* @ECU_Address@KOUTP_WriteChkfinRFID_raw_maxval@ */ Scalar_ULONG 0 SWC_OUTP_type_CM_uint32_raw32 0.0 4.294967295E+9 /end CHARACTERISTIC
/begin CHARACTERISTIC KOUTP_WriteChkfinRFID_raw_minval "" VALUE 0x0000 /* @ECU_Address@KOUTP_WriteChkfinRFID_raw_minval@ */ Scalar_ULONG 0 SWC_OUTP_type_CM_uint32_raw32 0.0 4.294967295E+9 /end CHARACTERISTIC
/begin CHARACTERISTIC KOUTP_WriteChkfinRFID_raw_ovrdval "" VALUE 0x0000 /* @ECU_Address@KOUTP_WriteChkfinRFID_raw_ovrdval@ */ Scalar_ULONG 0 SWC_OUTP_type_CM_uint32_raw 0.0 4.294967295E+9 /end CHARACTERISTIC
/begin CHARACTERISTIC KOUTP_WriteChkfinRRID_raw_maxval "" VALUE 0x0000 /* @ECU_Address@KOUTP_WriteChkfinRRID_raw_maxval@ */ Scalar_ULONG 0 SWC_OUTP_type_CM_uint32_raw32 0.0 4.294967295E+9 /end CHARACTERISTIC
/begin CHARACTERISTIC KOUTP_WriteChkfinRRID_raw_minval "" VALUE 0x0000 /* @ECU_Address@KOUTP_WriteChkfinRRID_raw_minval@ */ Scalar_ULONG 0 SWC_OUTP_type_CM_uint32_raw32 0.0 4.294967295E+9 /end CHARACTERISTIC
/begin CHARACTERISTIC KOUTP_WriteChkfinRRID_raw_ovrdval "" VALUE 0x0000 /* @ECU_Address@KOUTP_WriteChkfinRRID_raw_ovrdval@ */ Scalar_ULONG 0 SWC_OUTP_type_CM_uint32_raw 0.0 4.294967295E+9 /end CHARACTERISTIC
/begin CHARACTERISTIC KOUTP_ActDriveMode_enum_ovrdflg "" VALUE 0x0000 /* @ECU_Address@KOUTP_ActDriveMode_enum_ovrdflg@ */ Scalar_BOOLEAN 0 SWC_OUTP_type_CM_boolean_flg 0.0 1.0 /end CHARACTERISTIC
/begin CHARACTERISTIC KOUTP_ActTUpAIND_enum_ovrdflg "" VALUE 0x0000 /* @ECU_Address@KOUTP_ActTUpAIND_enum_ovrdflg@ */ Scalar_BOOLEAN 0 SWC_OUTP_type_CM_boolean_flg 0.0 1.0 /end CHARACTERISTIC
/begin CHARACTERISTIC KOUTP_CreepIND_enum_ovrdflg "" VALUE 0x0000 /* @ECU_Address@KOUTP_CreepIND_enum_ovrdflg@ */ Scalar_BOOLEAN 0 SWC_OUTP_type_CM_boolean_flg 0.0 1.0 /end CHARACTERISTIC
/begin CHARACTERISTIC KOUTP_CreepSpdReq_rpm_ovrdflg "" VALUE 0x0000 /* @ECU_Address@KOUTP_CreepSpdReq_rpm_ovrdflg@ */ Scalar_BOOLEAN 0 SWC_OUTP_type_CM_boolean_flg 0.0 1.0 /end CHARACTERISTIC
/begin CHARACTERISTIC KOUTP_EC1EMDefTrqLmt_rpm_ovrdflg "" VALUE 0x0000 /* @ECU_Address@KOUTP_EC1EMDefTrqLmt_rpm_ovrdflg@ */ Scalar_BOOLEAN 0 SWC_OUTP_type_CM_boolean_flg 0.0 1.0 /end CHARACTERISTIC
/begin CHARACTERISTIC KOUTP_EC1EMExtRSCtrlUpLmt_rpm_ovrdflg "" VALUE 0x0000 /* @ECU_Address@KOUTP_EC1EMExtRSCtrlUpLmt_rpm_ovrdflg@ */ Scalar_BOOLEAN 0 SWC_OUTP_type_CM_boolean_flg 0.0 1.0 /end CHARACTERISTIC
/begin CHARACTERISTIC KOUTP_EC1EMGainEndSpdGvn_gain_ovrdflg "" VALUE 0x0000 /* @ECU_Address@KOUTP_EC1EMGainEndSpdGvn_gain_ovrdflg@ */ Scalar_BOOLEAN 0 SWC_OUTP_type_CM_boolean_flg 0.0 1.0 /end CHARACTERISTIC
/begin CHARACTERISTIC KOUTP_EC1EMMaxMEngOvrSP7_rpm_ovrdflg "" VALUE 0x0000 /* @ECU_Address@KOUTP_EC1EMMaxMEngOvrSP7_rpm_ovrdflg@ */ Scalar_BOOLEAN 0 SWC_OUTP_type_CM_boolean_flg 0.0 1.0 /end CHARACTERISTIC
/begin CHARACTERISTIC KOUTP_EC1EMMaxMOvrTmt_s_ovrdflg "" VALUE 0x0000 /* @ECU_Address@KOUTP_EC1EMMaxMOvrTmt_s_ovrdflg@ */ Scalar_BOOLEAN 0 SWC_OUTP_type_CM_boolean_flg 0.0 1.0 /end CHARACTERISTIC
/begin CHARACTERISTIC KOUTP_EC1EMMomOfInertia_kgpm2_ovrdflg "" VALUE 0x0000 /* @ECU_Address@KOUTP_EC1EMMomOfInertia_kgpm2_ovrdflg@ */ Scalar_BOOLEAN 0 SWC_OUTP_type_CM_boolean_flg 0.0 1.0 /end CHARACTERISTIC
/begin CHARACTERISTIC KOUTP_EC1EMRefTorq_Nm_ovrdflg "" VALUE 0x0000 /* @ECU_Address@KOUTP_EC1EMRefTorq_Nm_ovrdflg@ */ Scalar_BOOLEAN 0 SWC_OUTP_type_CM_boolean_flg 0.0 1.0 /end CHARACTERISTIC
/begin CHARACTERISTIC KOUTP_EC1EMReqSpdCtrlLoLmt_rpm_ovrdflg "" VALUE 0x0000 /* @ECU_Address@KOUTP_EC1EMReqSpdCtrlLoLmt_rpm_ovrdflg@ */ Scalar_BOOLEAN 0 SWC_OUTP_type_CM_boolean_flg 0.0 1.0 /end CHARACTERISTIC
/begin CHARACTERISTIC KOUTP_EC1EMReqSpdCtrlUpLmt_rpm_ovrdflg "" VALUE 0x0000 /* @ECU_Address@KOUTP_EC1EMReqSpdCtrlUpLmt_rpm_ovrdflg@ */ Scalar_BOOLEAN 0 SWC_OUTP_type_CM_boolean_flg 0.0 1.0 /end CHARACTERISTIC
/begin CHARACTERISTIC KOUTP_EC1EMReqTrqCtrlLoLmt_pct_ovrdflg "" VALUE 0x0000 /* @ECU_Address@KOUTP_EC1EMReqTrqCtrlLoLmt_pct_ovrdflg@ */ Scalar_BOOLEAN 0 SWC_OUTP_type_CM_boolean_flg 0.0 1.0 /end CHARACTERISTIC
/begin CHARACTERISTIC KOUTP_EC1EMReqTrqCtrlUpLmt_pct_ovrdflg "" VALUE 0x0000 /* @ECU_Address@KOUTP_EC1EMReqTrqCtrlUpLmt_pct_ovrdflg@ */ Scalar_BOOLEAN 0 SWC_OUTP_type_CM_boolean_flg 0.0 1.0 /end CHARACTERISTIC
/begin CHARACTERISTIC KOUTP_EC1EMSpdHdleP6_rpm_ovrdflg "" VALUE 0x0000 /* @ECU_Address@KOUTP_EC1EMSpdHdleP6_rpm_ovrdflg@ */ Scalar_BOOLEAN 0 SWC_OUTP_type_CM_boolean_flg 0.0 1.0 /end CHARACTERISTIC
/begin CHARACTERISTIC KOUTP_EC1EMSpdIdleP1_rpm_ovrdflg "" VALUE 0x0000 /* @ECU_Address@KOUTP_EC1EMSpdIdleP1_rpm_ovrdflg@ */ Scalar_BOOLEAN 0 SWC_OUTP_type_CM_boolean_flg 0.0 1.0 /end CHARACTERISTIC
/begin CHARACTERISTIC KOUTP_EC1EMSpdIdleP2_rpm_ovrdflg "" VALUE 0x0000 /* @ECU_Address@KOUTP_EC1EMSpdIdleP2_rpm_ovrdflg@ */ Scalar_BOOLEAN 0 SWC_OUTP_type_CM_boolean_flg 0.0 1.0 /end CHARACTERISTIC
/begin CHARACTERISTIC KOUTP_EC1EMSpdIdleP3_rpm_ovrdflg "" VALUE 0x0000 /* @ECU_Address@KOUTP_EC1EMSpdIdleP3_rpm_ovrdflg@ */ Scalar_BOOLEAN 0 SWC_OUTP_type_CM_boolean_flg 0.0 1.0 /end CHARACTERISTIC
/begin CHARACTERISTIC KOUTP_EC1EMSpdIdleP4_rpm_ovrdflg "" VALUE 0x0000 /* @ECU_Address@KOUTP_EC1EMSpdIdleP4_rpm_ovrdflg@ */ Scalar_BOOLEAN 0 SWC_OUTP_type_CM_boolean_flg 0.0 1.0 /end CHARACTERISTIC
/begin CHARACTERISTIC KOUTP_EC1EMSpdIdleP5_rpm_ovrdflg "" VALUE 0x0000 /* @ECU_Address@KOUTP_EC1EMSpdIdleP5_rpm_ovrdflg@ */ Scalar_BOOLEAN 0 SWC_OUTP_type_CM_boolean_flg 0.0 1.0 /end CHARACTERISTIC
/begin CHARACTERISTIC KOUTP_EC1EMSupTSC1CtrlPG1_cnt_ovrdflg "" VALUE 0x0000 /* @ECU_Address@KOUTP_EC1EMSupTSC1CtrlPG1_cnt_ovrdflg@ */ Scalar_BOOLEAN 0 SWC_OUTP_type_CM_boolean_flg 0.0 1.0 /end CHARACTERISTIC
/begin CHARACTERISTIC KOUTP_EC1EMSupTSC1CtrlPG2_cnt_ovrdflg "" VALUE 0x0000 /* @ECU_Address@KOUTP_EC1EMSupTSC1CtrlPG2_cnt_ovrdflg@ */ Scalar_BOOLEAN 0 SWC_OUTP_type_CM_boolean_flg 0.0 1.0 /end CHARACTERISTIC
/begin CHARACTERISTIC KOUTP_EC1EMSupTSC1CtrlPG3_cnt_ovrdflg "" VALUE 0x0000 /* @ECU_Address@KOUTP_EC1EMSupTSC1CtrlPG3_cnt_ovrdflg@ */ Scalar_BOOLEAN 0 SWC_OUTP_type_CM_boolean_flg 0.0 1.0 /end CHARACTERISTIC
/begin CHARACTERISTIC KOUTP_EC1EMSupTSC1CtrlPG4_cnt_ovrdflg "" VALUE 0x0000 /* @ECU_Address@KOUTP_EC1EMSupTSC1CtrlPG4_cnt_ovrdflg@ */ Scalar_BOOLEAN 0 SWC_OUTP_type_CM_boolean_flg 0.0 1.0 /end CHARACTERISTIC
/begin CHARACTERISTIC KOUTP_EC1EMSupVarRTSC1MSG_cnt_ovrdflg "" VALUE 0x0000 /* @ECU_Address@KOUTP_EC1EMSupVarRTSC1MSG_cnt_ovrdflg@ */ Scalar_BOOLEAN 0 SWC_OUTP_type_CM_boolean_flg 0.0 1.0 /end CHARACTERISTIC
/begin CHARACTERISTIC KOUTP_EC1PercTorqIdleP1_pct_ovrdflg "" VALUE 0x0000 /* @ECU_Address@KOUTP_EC1PercTorqIdleP1_pct_ovrdflg@ */ Scalar_BOOLEAN 0 SWC_OUTP_type_CM_boolean_flg 0.0 1.0 /end CHARACTERISTIC
/begin CHARACTERISTIC KOUTP_EC1PercTorqIdleP2_pct_ovrdflg "" VALUE 0x0000 /* @ECU_Address@KOUTP_EC1PercTorqIdleP2_pct_ovrdflg@ */ Scalar_BOOLEAN 0 SWC_OUTP_type_CM_boolean_flg 0.0 1.0 /end CHARACTERISTIC
/begin CHARACTERISTIC KOUTP_EC1PercTorqIdleP3_pct_ovrdflg "" VALUE 0x0000 /* @ECU_Address@KOUTP_EC1PercTorqIdleP3_pct_ovrdflg@ */ Scalar_BOOLEAN 0 SWC_OUTP_type_CM_boolean_flg 0.0 1.0 /end CHARACTERISTIC
/begin CHARACTERISTIC KOUTP_EC1PercTorqIdleP4_pct_ovrdflg "" VALUE 0x0000 /* @ECU_Address@KOUTP_EC1PercTorqIdleP4_pct_ovrdflg@ */ Scalar_BOOLEAN 0 SWC_OUTP_type_CM_boolean_flg 0.0 1.0 /end CHARACTERISTIC
/begin CHARACTERISTIC KOUTP_EC1PercTorqIdleP5_pct_ovrdflg "" VALUE 0x0000 /* @ECU_Address@KOUTP_EC1PercTorqIdleP5_pct_ovrdflg@ */ Scalar_BOOLEAN 0 SWC_OUTP_type_CM_boolean_flg 0.0 1.0 /end CHARACTERISTIC
/begin CHARACTERISTIC KOUTP_EEC3EMPressLoss_pct_ovrdflg "" VALUE 0x0000 /* @ECU_Address@KOUTP_EEC3EMPressLoss_pct_ovrdflg@ */ Scalar_BOOLEAN 0 SWC_OUTP_type_CM_boolean_flg 0.0 1.0 /end CHARACTERISTIC
/begin CHARACTERISTIC KOUTP_EEC3NFricPercTorq_pct_ovrdflg "" VALUE 0x0000 /* @ECU_Address@KOUTP_EEC3NFricPercTorq_pct_ovrdflg@ */ Scalar_BOOLEAN 0 SWC_OUTP_type_CM_boolean_flg 0.0 1.0 /end CHARACTERISTIC
/begin CHARACTERISTIC KOUTP_EMRC1ActEMOutSftSpd_rpm_ovrdflg "" VALUE 0x0000 /* @ECU_Address@KOUTP_EMRC1ActEMOutSftSpd_rpm_ovrdflg@ */ Scalar_BOOLEAN 0 SWC_OUTP_type_CM_boolean_flg 0.0 1.0 /end CHARACTERISTIC
/begin CHARACTERISTIC KOUTP_EMRC1ActEMpTrqHrls_pct_ovrdflg "" VALUE 0x0000 /* @ECU_Address@KOUTP_EMRC1ActEMpTrqHrls_pct_ovrdflg@ */ Scalar_BOOLEAN 0 SWC_OUTP_type_CM_boolean_flg 0.0 1.0 /end CHARACTERISTIC
/begin CHARACTERISTIC KOUTP_EMRC1ActEMpTrq_pct_ovrdflg "" VALUE 0x0000 /* @ECU_Address@KOUTP_EMRC1ActEMpTrq_pct_ovrdflg@ */ Scalar_BOOLEAN 0 SWC_OUTP_type_CM_boolean_flg 0.0 1.0 /end CHARACTERISTIC
/begin CHARACTERISTIC KOUTP_EMRC1ActMaxAvaEMRecpTrq_pct_ovrdflg "" VALUE 0x0000 /* @ECU_Address@KOUTP_EMRC1ActMaxAvaEMRecpTrq_pct_ovrdflg@ */ Scalar_BOOLEAN 0 SWC_OUTP_type_CM_boolean_flg 0.0 1.0 /end CHARACTERISTIC
/begin CHARACTERISTIC KOUTP_EMRC1DrvDemEMRtapTrq_pct_ovrdflg "" VALUE 0x0000 /* @ECU_Address@KOUTP_EMRC1DrvDemEMRtapTrq_pct_ovrdflg@ */ Scalar_BOOLEAN 0 SWC_OUTP_type_CM_boolean_flg 0.0 1.0 /end CHARACTERISTIC
/begin CHARACTERISTIC KOUTP_EMRC1EMTquModeDrvBrk_enum_ovrdflg "" VALUE 0x0000 /* @ECU_Address@KOUTP_EMRC1EMTquModeDrvBrk_enum_ovrdflg@ */ Scalar_BOOLEAN 0 SWC_OUTP_type_CM_boolean_flg 0.0 1.0 /end CHARACTERISTIC
/begin CHARACTERISTIC KOUTP_EMRC1RetSelNonEng_pct_ovrdflg "" VALUE 0x0000 /* @ECU_Address@KOUTP_EMRC1RetSelNonEng_pct_ovrdflg@ */ Scalar_BOOLEAN 0 SWC_OUTP_type_CM_boolean_flg 0.0 1.0 /end CHARACTERISTIC
/begin CHARACTERISTIC KOUTP_EMRC1SACtrlDev_cnt_ovrdflg "" VALUE 0x0000 /* @ECU_Address@KOUTP_EMRC1SACtrlDev_cnt_ovrdflg@ */ Scalar_BOOLEAN 0 SWC_OUTP_type_CM_boolean_flg 0.0 1.0 /end CHARACTERISTIC
/begin CHARACTERISTIC KOUTP_ETC1ShiftrPgs_enum_ovrdflg "" VALUE 0x0000 /* @ECU_Address@KOUTP_ETC1ShiftrPgs_enum_ovrdflg@ */ Scalar_BOOLEAN 0 SWC_OUTP_type_CM_boolean_flg 0.0 1.0 /end CHARACTERISTIC
/begin CHARACTERISTIC KOUTP_ETC2ActDriveDirect_enum_ovrdflg "" VALUE 0x0000 /* @ECU_Address@KOUTP_ETC2ActDriveDirect_enum_ovrdflg@ */ Scalar_BOOLEAN 0 SWC_OUTP_type_CM_boolean_flg 0.0 1.0 /end CHARACTERISTIC
/begin CHARACTERISTIC KOUTP_EVCU1ActDrvMode_enum_ovrdflg "" VALUE 0x0000 /* @ECU_Address@KOUTP_EVCU1ActDrvMode_enum_ovrdflg@ */ Scalar_BOOLEAN 0 SWC_OUTP_type_CM_boolean_flg 0.0 1.0 /end CHARACTERISTIC
/begin CHARACTERISTIC KOUTP_EVCU1EBrakeTorqLow_enum_ovrdflg "" VALUE 0x0000 /* @ECU_Address@KOUTP_EVCU1EBrakeTorqLow_enum_ovrdflg@ */ Scalar_BOOLEAN 0 SWC_OUTP_type_CM_boolean_flg 0.0 1.0 /end CHARACTERISTIC
/begin CHARACTERISTIC KOUTP_EVCU1EMotorOvrerSpd_enum_ovrdflg "" VALUE 0x0000 /* @ECU_Address@KOUTP_EVCU1EMotorOvrerSpd_enum_ovrdflg@ */ Scalar_BOOLEAN 0 SWC_OUTP_type_CM_boolean_flg 0.0 1.0 /end CHARACTERISTIC
/begin CHARACTERISTIC KOUTP_EVCU1EMotorPerformance_pct_ovrdflg "" VALUE 0x0000 /* @ECU_Address@KOUTP_EVCU1EMotorPerformance_pct_ovrdflg@ */ Scalar_BOOLEAN 0 SWC_OUTP_type_CM_boolean_flg 0.0 1.0 /end CHARACTERISTIC
/begin CHARACTERISTIC KOUTP_EVCU1EMotorSpd_rpm_ovrdflg "" VALUE 0x0000 /* @ECU_Address@KOUTP_EVCU1EMotorSpd_rpm_ovrdflg@ */ Scalar_BOOLEAN 0 SWC_OUTP_type_CM_boolean_flg 0.0 1.0 /end CHARACTERISTIC
/begin CHARACTERISTIC KOUTP_EVCU1RecuperHighSta_enum_ovrdflg "" VALUE 0x0000 /* @ECU_Address@KOUTP_EVCU1RecuperHighSta_enum_ovrdflg@ */ Scalar_BOOLEAN 0 SWC_OUTP_type_CM_boolean_flg 0.0 1.0 /end CHARACTERISTIC
/begin CHARACTERISTIC KOUTP_EVCU1WheelSlipdet_enum_ovrdflg "" VALUE 0x0000 /* @ECU_Address@KOUTP_EVCU1WheelSlipdet_enum_ovrdflg@ */ Scalar_BOOLEAN 0 SWC_OUTP_type_CM_boolean_flg 0.0 1.0 /end CHARACTERISTIC
/begin CHARACTERISTIC KOUTP_EVCU2MaxTorqAvail_pct_ovrdflg "" VALUE 0x0000 /* @ECU_Address@KOUTP_EVCU2MaxTorqAvail_pct_ovrdflg@ */ Scalar_BOOLEAN 0 SWC_OUTP_type_CM_boolean_flg 0.0 1.0 /end CHARACTERISTIC
/begin CHARACTERISTIC KOUTP_EVCU2MinTorqAvail_pct_ovrdflg "" VALUE 0x0000 /* @ECU_Address@KOUTP_EVCU2MinTorqAvail_pct_ovrdflg@ */ Scalar_BOOLEAN 0 SWC_OUTP_type_CM_boolean_flg 0.0 1.0 /end CHARACTERISTIC
/begin CHARACTERISTIC KOUTP_FrTMTqReq_Nm_ovrdflg "" VALUE 0x0000 /* @ECU_Address@KOUTP_FrTMTqReq_Nm_ovrdflg@ */ Scalar_BOOLEAN 0 SWC_OUTP_type_CM_boolean_flg 0.0 1.0 /end CHARACTERISTIC
/begin CHARACTERISTIC KOUTP_GearFlashIndDis_flg_maxval "" VALUE 0x0000 /* @ECU_Address@KOUTP_GearFlashIndDis_flg_maxval@ */ Scalar_BOOLEAN 0 SWC_OUTP_type_CM_boolean_flg 0.0 1.0 /end CHARACTERISTIC
/begin CHARACTERISTIC KOUTP_GearFlashIndDis_flg_minval "" VALUE 0x0000 /* @ECU_Address@KOUTP_GearFlashIndDis_flg_minval@ */ Scalar_BOOLEAN 0 SWC_OUTP_type_CM_boolean_flg 0.0 1.0 /end CHARACTERISTIC
/begin CHARACTERISTIC KOUTP_GearFlashIndDis_flg_ovrdflg "" VALUE 0x0000 /* @ECU_Address@KOUTP_GearFlashIndDis_flg_ovrdflg@ */ Scalar_BOOLEAN 0 SWC_OUTP_type_CM_boolean_flg 0.0 1.0 /end CHARACTERISTIC
/begin CHARACTERISTIC KOUTP_GearFlashIndDis_flg_ovrdval "" VALUE 0x0000 /* @ECU_Address@KOUTP_GearFlashIndDis_flg_ovrdval@ */ Scalar_BOOLEAN 0 SWC_OUTP_type_CM_boolean_flg 0.0 1.0 /end CHARACTERISTIC
/begin CHARACTERISTIC KOUTP_GearFlashInd_flg_maxval "" VALUE 0x0000 /* @ECU_Address@KOUTP_GearFlashInd_flg_maxval@ */ Scalar_BOOLEAN 0 SWC_OUTP_type_CM_boolean_flg 0.0 1.0 /end CHARACTERISTIC
/begin CHARACTERISTIC KOUTP_GearFlashInd_flg_minval "" VALUE 0x0000 /* @ECU_Address@KOUTP_GearFlashInd_flg_minval@ */ Scalar_BOOLEAN 0 SWC_OUTP_type_CM_boolean_flg 0.0 1.0 /end CHARACTERISTIC
/begin CHARACTERISTIC KOUTP_GearFlashInd_flg_ovrdflg "" VALUE 0x0000 /* @ECU_Address@KOUTP_GearFlashInd_flg_ovrdflg@ */ Scalar_BOOLEAN 0 SWC_OUTP_type_CM_boolean_flg 0.0 1.0 /end CHARACTERISTIC
/begin CHARACTERISTIC KOUTP_GearFlashInd_flg_ovrdval "" VALUE 0x0000 /* @ECU_Address@KOUTP_GearFlashInd_flg_ovrdval@ */ Scalar_BOOLEAN 0 SWC_OUTP_type_CM_boolean_flg 0.0 1.0 /end CHARACTERISTIC
/begin CHARACTERISTIC KOUTP_HVPO120VGrpALDSt_enum_ovrdflg "" VALUE 0x0000 /* @ECU_Address@KOUTP_HVPO120VGrpALDSt_enum_ovrdflg@ */ Scalar_BOOLEAN 0 SWC_OUTP_type_CM_boolean_flg 0.0 1.0 /end CHARACTERISTIC
/begin CHARACTERISTIC KOUTP_HVPO120VGrpBLDSt_enum_ovrdflg "" VALUE 0x0000 /* @ECU_Address@KOUTP_HVPO120VGrpBLDSt_enum_ovrdflg@ */ Scalar_BOOLEAN 0 SWC_OUTP_type_CM_boolean_flg 0.0 1.0 /end CHARACTERISTIC
/begin CHARACTERISTIC KOUTP_ParkingProtectWarning_flg_maxval "" VALUE 0x0000 /* @ECU_Address@KOUTP_ParkingProtectWarning_flg_maxval@ */ Scalar_BOOLEAN 0 SWC_OUTP_type_CM_boolean_flg 0.0 1.0 /end CHARACTERISTIC
/begin CHARACTERISTIC KOUTP_ParkingProtectWarning_flg_minval "" VALUE 0x0000 /* @ECU_Address@KOUTP_ParkingProtectWarning_flg_minval@ */ Scalar_BOOLEAN 0 SWC_OUTP_type_CM_boolean_flg 0.0 1.0 /end CHARACTERISTIC
/begin CHARACTERISTIC KOUTP_ParkingProtectWarning_flg_ovrdflg "" VALUE 0x0000 /* @ECU_Address@KOUTP_ParkingProtectWarning_flg_ovrdflg@ */ Scalar_BOOLEAN 0 SWC_OUTP_type_CM_boolean_flg 0.0 1.0 /end CHARACTERISTIC
/begin CHARACTERISTIC KOUTP_ParkingProtectWarning_flg_ovrdval "" VALUE 0x0000 /* @ECU_Address@KOUTP_ParkingProtectWarning_flg_ovrdval@ */ Scalar_BOOLEAN 0 SWC_OUTP_type_CM_boolean_flg 0.0 1.0 /end CHARACTERISTIC
/begin CHARACTERISTIC KOUTP_RC1MaxRetSpdP2_rpm_ovrdflg "" VALUE 0x0000 /* @ECU_Address@KOUTP_RC1MaxRetSpdP2_rpm_ovrdflg@ */ Scalar_BOOLEAN 0 SWC_OUTP_type_CM_boolean_flg 0.0 1.0 /end CHARACTERISTIC
/begin CHARACTERISTIC KOUTP_RC1MaxRetSpdP3_rpm_ovrdflg "" VALUE 0x0000 /* @ECU_Address@KOUTP_RC1MaxRetSpdP3_rpm_ovrdflg@ */ Scalar_BOOLEAN 0 SWC_OUTP_type_CM_boolean_flg 0.0 1.0 /end CHARACTERISTIC
/begin CHARACTERISTIC KOUTP_RC1PctTrqIdleP1_pct_ovrdflg "" VALUE 0x0000 /* @ECU_Address@KOUTP_RC1PctTrqIdleP1_pct_ovrdflg@ */ Scalar_BOOLEAN 0 SWC_OUTP_type_CM_boolean_flg 0.0 1.0 /end CHARACTERISTIC
/begin CHARACTERISTIC KOUTP_RC1PctTrqP3_pct_ovrdflg "" VALUE 0x0000 /* @ECU_Address@KOUTP_RC1PctTrqP3_pct_ovrdflg@ */ Scalar_BOOLEAN 0 SWC_OUTP_type_CM_boolean_flg 0.0 1.0 /end CHARACTERISTIC
/begin CHARACTERISTIC KOUTP_RC1PctTrqP4_pct_ovrdflg "" VALUE 0x0000 /* @ECU_Address@KOUTP_RC1PctTrqP4_pct_ovrdflg@ */ Scalar_BOOLEAN 0 SWC_OUTP_type_CM_boolean_flg 0.0 1.0 /end CHARACTERISTIC
/begin CHARACTERISTIC KOUTP_RC1PctTrqPekTrqP5_pct_ovrdflg "" VALUE 0x0000 /* @ECU_Address@KOUTP_RC1PctTrqPekTrqP5_pct_ovrdflg@ */ Scalar_BOOLEAN 0 SWC_OUTP_type_CM_boolean_flg 0.0 1.0 /end CHARACTERISTIC
/begin CHARACTERISTIC KOUTP_RC1RefRetTrq_Nm_ovrdflg "" VALUE 0x0000 /* @ECU_Address@KOUTP_RC1RefRetTrq_Nm_ovrdflg@ */ Scalar_BOOLEAN 0 SWC_OUTP_type_CM_boolean_flg 0.0 1.0 /end CHARACTERISTIC
/begin CHARACTERISTIC KOUTP_RC1RetCtrlMth_enum_ovrdflg "" VALUE 0x0000 /* @ECU_Address@KOUTP_RC1RetCtrlMth_enum_ovrdflg@ */ Scalar_BOOLEAN 0 SWC_OUTP_type_CM_boolean_flg 0.0 1.0 /end CHARACTERISTIC
/begin CHARACTERISTIC KOUTP_RC1RetLocat_enum_ovrdflg "" VALUE 0x0000 /* @ECU_Address@KOUTP_RC1RetLocat_enum_ovrdflg@ */ Scalar_BOOLEAN 0 SWC_OUTP_type_CM_boolean_flg 0.0 1.0 /end CHARACTERISTIC
/begin CHARACTERISTIC KOUTP_RC1RetSpdIdleP1_rpm_ovrdflg "" VALUE 0x0000 /* @ECU_Address@KOUTP_RC1RetSpdIdleP1_rpm_ovrdflg@ */ Scalar_BOOLEAN 0 SWC_OUTP_type_CM_boolean_flg 0.0 1.0 /end CHARACTERISTIC
/begin CHARACTERISTIC KOUTP_RC1RetSpdP2_pct_ovrdflg "" VALUE 0x0000 /* @ECU_Address@KOUTP_RC1RetSpdP2_pct_ovrdflg@ */ Scalar_BOOLEAN 0 SWC_OUTP_type_CM_boolean_flg 0.0 1.0 /end CHARACTERISTIC
/begin CHARACTERISTIC KOUTP_RC1RetSpdP4_rpm_ovrdflg "" VALUE 0x0000 /* @ECU_Address@KOUTP_RC1RetSpdP4_rpm_ovrdflg@ */ Scalar_BOOLEAN 0 SWC_OUTP_type_CM_boolean_flg 0.0 1.0 /end CHARACTERISTIC
/begin CHARACTERISTIC KOUTP_RC1RetSpdPekTrqP5_Nm_ovrdflg "" VALUE 0x0000 /* @ECU_Address@KOUTP_RC1RetSpdPekTrqP5_Nm_ovrdflg@ */ Scalar_BOOLEAN 0 SWC_OUTP_type_CM_boolean_flg 0.0 1.0 /end CHARACTERISTIC
/begin CHARACTERISTIC KOUTP_RC1RetType_enum_ovrdflg "" VALUE 0x0000 /* @ECU_Address@KOUTP_RC1RetType_enum_ovrdflg@ */ Scalar_BOOLEAN 0 SWC_OUTP_type_CM_boolean_flg 0.0 1.0 /end CHARACTERISTIC
/begin CHARACTERISTIC KOUTP_RRWheelDebug_flg_maxval "" VALUE 0x0000 /* @ECU_Address@KOUTP_RRWheelDebug_flg_maxval@ */ Scalar_BOOLEAN 0 SWC_OUTP_type_CM_boolean_flg 0.0 1.0 /end CHARACTERISTIC
/begin CHARACTERISTIC KOUTP_RRWheelDebug_flg_minval "" VALUE 0x0000 /* @ECU_Address@KOUTP_RRWheelDebug_flg_minval@ */ Scalar_BOOLEAN 0 SWC_OUTP_type_CM_boolean_flg 0.0 1.0 /end CHARACTERISTIC
/begin CHARACTERISTIC KOUTP_RRWheelDebug_flg_ovrdflg "" VALUE 0x0000 /* @ECU_Address@KOUTP_RRWheelDebug_flg_ovrdflg@ */ Scalar_BOOLEAN 0 SWC_OUTP_type_CM_boolean_flg 0.0 1.0 /end CHARACTERISTIC
/begin CHARACTERISTIC KOUTP_RRWheelDebug_flg_ovrdval "" VALUE 0x0000 /* @ECU_Address@KOUTP_RRWheelDebug_flg_ovrdval@ */ Scalar_BOOLEAN 0 SWC_OUTP_type_CM_boolean_flg 0.0 1.0 /end CHARACTERISTIC
/begin CHARACTERISTIC KOUTP_RRWheelPSW_raw8_ovrdflg "" VALUE 0x0000 /* @ECU_Address@KOUTP_RRWheelPSW_raw8_ovrdflg@ */ Scalar_BOOLEAN 0 SWC_OUTP_type_CM_boolean_flg 0.0 1.0 /end CHARACTERISTIC
/begin CHARACTERISTIC KOUTP_RRWheelPress_raw8_ovrdflg "" VALUE 0x0000 /* @ECU_Address@KOUTP_RRWheelPress_raw8_ovrdflg@ */ Scalar_BOOLEAN 0 SWC_OUTP_type_CM_boolean_flg 0.0 1.0 /end CHARACTERISTIC
/begin CHARACTERISTIC KOUTP_RRWheelTemp_C_ovrdflg "" VALUE 0x0000 /* @ECU_Address@KOUTP_RRWheelTemp_C_ovrdflg@ */ Scalar_BOOLEAN 0 SWC_OUTP_type_CM_boolean_flg 0.0 1.0 /end CHARACTERISTIC
/begin CHARACTERISTIC KOUTP_RRWheelTmpIndi_flg_maxval "" VALUE 0x0000 /* @ECU_Address@KOUTP_RRWheelTmpIndi_flg_maxval@ */ Scalar_BOOLEAN 0 SWC_OUTP_type_CM_boolean_flg 0.0 1.0 /end CHARACTERISTIC
/begin CHARACTERISTIC KOUTP_RRWheelTmpIndi_flg_minval "" VALUE 0x0000 /* @ECU_Address@KOUTP_RRWheelTmpIndi_flg_minval@ */ Scalar_BOOLEAN 0 SWC_OUTP_type_CM_boolean_flg 0.0 1.0 /end CHARACTERISTIC
/begin CHARACTERISTIC KOUTP_RRWheelTmpIndi_flg_ovrdflg "" VALUE 0x0000 /* @ECU_Address@KOUTP_RRWheelTmpIndi_flg_ovrdflg@ */ Scalar_BOOLEAN 0 SWC_OUTP_type_CM_boolean_flg 0.0 1.0 /end CHARACTERISTIC
/begin CHARACTERISTIC KOUTP_RRWheelTmpIndi_flg_ovrdval "" VALUE 0x0000 /* @ECU_Address@KOUTP_RRWheelTmpIndi_flg_ovrdval@ */ Scalar_BOOLEAN 0 SWC_OUTP_type_CM_boolean_flg 0.0 1.0 /end CHARACTERISTIC
/begin CHARACTERISTIC KOUTP_RrTMTqReq_Nm_ovrdflg "" VALUE 0x0000 /* @ECU_Address@KOUTP_RrTMTqReq_Nm_ovrdflg@ */ Scalar_BOOLEAN 0 SWC_OUTP_type_CM_boolean_flg 0.0 1.0 /end CHARACTERISTIC
/begin CHARACTERISTIC KOUTP_S1ID_raw32_ovrdflg "" VALUE 0x0000 /* @ECU_Address@KOUTP_S1ID_raw32_ovrdflg@ */ Scalar_BOOLEAN 0 SWC_OUTP_type_CM_boolean_flg 0.0 1.0 /end CHARACTERISTIC
/begin CHARACTERISTIC KOUTP_S1L_enum_ovrdflg "" VALUE 0x0000 /* @ECU_Address@KOUTP_S1L_enum_ovrdflg@ */ Scalar_BOOLEAN 0 SWC_OUTP_type_CM_boolean_flg 0.0 1.0 /end CHARACTERISTIC
/begin CHARACTERISTIC KOUTP_S1WheelDebugALTU_pct_ovrdflg "" VALUE 0x0000 /* @ECU_Address@KOUTP_S1WheelDebugALTU_pct_ovrdflg@ */ Scalar_BOOLEAN 0 SWC_OUTP_type_CM_boolean_flg 0.0 1.0 /end CHARACTERISTIC
/begin CHARACTERISTIC KOUTP_S2ID_raw32_ovrdflg "" VALUE 0x0000 /* @ECU_Address@KOUTP_S2ID_raw32_ovrdflg@ */ Scalar_BOOLEAN 0 SWC_OUTP_type_CM_boolean_flg 0.0 1.0 /end CHARACTERISTIC
/begin CHARACTERISTIC KOUTP_S2L_enum_ovrdflg "" VALUE 0x0000 /* @ECU_Address@KOUTP_S2L_enum_ovrdflg@ */ Scalar_BOOLEAN 0 SWC_OUTP_type_CM_boolean_flg 0.0 1.0 /end CHARACTERISTIC
/begin CHARACTERISTIC KOUTP_S2WheelDebugALTU_pct_ovrdflg "" VALUE 0x0000 /* @ECU_Address@KOUTP_S2WheelDebugALTU_pct_ovrdflg@ */ Scalar_BOOLEAN 0 SWC_OUTP_type_CM_boolean_flg 0.0 1.0 /end CHARACTERISTIC
/begin CHARACTERISTIC KOUTP_S3ID_raw32_ovrdflg "" VALUE 0x0000 /* @ECU_Address@KOUTP_S3ID_raw32_ovrdflg@ */ Scalar_BOOLEAN 0 SWC_OUTP_type_CM_boolean_flg 0.0 1.0 /end CHARACTERISTIC
/begin CHARACTERISTIC KOUTP_S3L_enum_ovrdflg "" VALUE 0x0000 /* @ECU_Address@KOUTP_S3L_enum_ovrdflg@ */ Scalar_BOOLEAN 0 SWC_OUTP_type_CM_boolean_flg 0.0 1.0 /end CHARACTERISTIC
/begin CHARACTERISTIC KOUTP_S3WheelDebugALTU_pct_ovrdflg "" VALUE 0x0000 /* @ECU_Address@KOUTP_S3WheelDebugALTU_pct_ovrdflg@ */ Scalar_BOOLEAN 0 SWC_OUTP_type_CM_boolean_flg 0.0 1.0 /end CHARACTERISTIC
/begin CHARACTERISTIC KOUTP_S4ID_raw32_ovrdflg "" VALUE 0x0000 /* @ECU_Address@KOUTP_S4ID_raw32_ovrdflg@ */ Scalar_BOOLEAN 0 SWC_OUTP_type_CM_boolean_flg 0.0 1.0 /end CHARACTERISTIC
/begin CHARACTERISTIC KOUTP_S4L_enum_ovrdflg "" VALUE 0x0000 /* @ECU_Address@KOUTP_S4L_enum_ovrdflg@ */ Scalar_BOOLEAN 0 SWC_OUTP_type_CM_boolean_flg 0.0 1.0 /end CHARACTERISTIC
/begin CHARACTERISTIC KOUTP_S4WheelDebugALTU_pct_ovrdflg "" VALUE 0x0000 /* @ECU_Address@KOUTP_S4WheelDebugALTU_pct_ovrdflg@ */ Scalar_BOOLEAN 0 SWC_OUTP_type_CM_boolean_flg 0.0 1.0 /end CHARACTERISTIC
/begin CHARACTERISTIC KOUTP_SetIDLoc_flg_maxval "" VALUE 0x0000 /* @ECU_Address@KOUTP_SetIDLoc_flg_maxval@ */ Scalar_BOOLEAN 0 SWC_OUTP_type_CM_boolean_flg 0.0 1.0 /end CHARACTERISTIC
/begin CHARACTERISTIC KOUTP_SetIDLoc_flg_minval "" VALUE 0x0000 /* @ECU_Address@KOUTP_SetIDLoc_flg_minval@ */ Scalar_BOOLEAN 0 SWC_OUTP_type_CM_boolean_flg 0.0 1.0 /end CHARACTERISTIC
/begin CHARACTERISTIC KOUTP_SetIDLoc_flg_ovrdflg "" VALUE 0x0000 /* @ECU_Address@KOUTP_SetIDLoc_flg_ovrdflg@ */ Scalar_BOOLEAN 0 SWC_OUTP_type_CM_boolean_flg 0.0 1.0 /end CHARACTERISTIC
/begin CHARACTERISTIC KOUTP_SetIDLoc_flg_ovrdval "" VALUE 0x0000 /* @ECU_Address@KOUTP_SetIDLoc_flg_ovrdval@ */ Scalar_BOOLEAN 0 SWC_OUTP_type_CM_boolean_flg 0.0 1.0 /end CHARACTERISTIC
/begin CHARACTERISTIC KOUTP_SpdLimSta_flg_maxval "" VALUE 0x0000 /* @ECU_Address@KOUTP_SpdLimSta_flg_maxval@ */ Scalar_BOOLEAN 0 SWC_OUTP_type_CM_boolean_flg 0.0 1.0 /end CHARACTERISTIC
/begin CHARACTERISTIC KOUTP_SpdLimSta_flg_minval "" VALUE 0x0000 /* @ECU_Address@KOUTP_SpdLimSta_flg_minval@ */ Scalar_BOOLEAN 0 SWC_OUTP_type_CM_boolean_flg 0.0 1.0 /end CHARACTERISTIC
/begin CHARACTERISTIC KOUTP_SpdLimSta_flg_ovrdflg "" VALUE 0x0000 /* @ECU_Address@KOUTP_SpdLimSta_flg_ovrdflg@ */ Scalar_BOOLEAN 0 SWC_OUTP_type_CM_boolean_flg 0.0 1.0 /end CHARACTERISTIC
/begin CHARACTERISTIC KOUTP_SpdLimSta_flg_ovrdval "" VALUE 0x0000 /* @ECU_Address@KOUTP_SpdLimSta_flg_ovrdval@ */ Scalar_BOOLEAN 0 SWC_OUTP_type_CM_boolean_flg 0.0 1.0 /end CHARACTERISTIC
/begin CHARACTERISTIC KOUTP_TMTqReq_Nm_ovrdflg "" VALUE 0x0000 /* @ECU_Address@KOUTP_TMTqReq_Nm_ovrdflg@ */ Scalar_BOOLEAN 0 SWC_OUTP_type_CM_boolean_flg 0.0 1.0 /end CHARACTERISTIC
/begin CHARACTERISTIC KOUTP_TPMSCaliButtAllow_flg_maxval "" VALUE 0x0000 /* @ECU_Address@KOUTP_TPMSCaliButtAllow_flg_maxval@ */ Scalar_BOOLEAN 0 SWC_OUTP_type_CM_boolean_flg 0.0 1.0 /end CHARACTERISTIC
/begin CHARACTERISTIC KOUTP_TPMSCaliButtAllow_flg_minval "" VALUE 0x0000 /* @ECU_Address@KOUTP_TPMSCaliButtAllow_flg_minval@ */ Scalar_BOOLEAN 0 SWC_OUTP_type_CM_boolean_flg 0.0 1.0 /end CHARACTERISTIC
/begin CHARACTERISTIC KOUTP_TPMSCaliButtAllow_flg_ovrdflg "" VALUE 0x0000 /* @ECU_Address@KOUTP_TPMSCaliButtAllow_flg_ovrdflg@ */ Scalar_BOOLEAN 0 SWC_OUTP_type_CM_boolean_flg 0.0 1.0 /end CHARACTERISTIC
/begin CHARACTERISTIC KOUTP_TPMSCaliButtAllow_flg_ovrdval "" VALUE 0x0000 /* @ECU_Address@KOUTP_TPMSCaliButtAllow_flg_ovrdval@ */ Scalar_BOOLEAN 0 SWC_OUTP_type_CM_boolean_flg 0.0 1.0 /end CHARACTERISTIC
/begin CHARACTERISTIC KOUTP_TPMSResButtAllow_flg_maxval "" VALUE 0x0000 /* @ECU_Address@KOUTP_TPMSResButtAllow_flg_maxval@ */ Scalar_BOOLEAN 0 SWC_OUTP_type_CM_boolean_flg 0.0 1.0 /end CHARACTERISTIC
/begin CHARACTERISTIC KOUTP_TPMSResButtAllow_flg_minval "" VALUE 0x0000 /* @ECU_Address@KOUTP_TPMSResButtAllow_flg_minval@ */ Scalar_BOOLEAN 0 SWC_OUTP_type_CM_boolean_flg 0.0 1.0 /end CHARACTERISTIC
/begin CHARACTERISTIC KOUTP_TPMSResButtAllow_flg_ovrdflg "" VALUE 0x0000 /* @ECU_Address@KOUTP_TPMSResButtAllow_flg_ovrdflg@ */ Scalar_BOOLEAN 0 SWC_OUTP_type_CM_boolean_flg 0.0 1.0 /end CHARACTERISTIC
/begin CHARACTERISTIC KOUTP_TPMSResButtAllow_flg_ovrdval "" VALUE 0x0000 /* @ECU_Address@KOUTP_TPMSResButtAllow_flg_ovrdval@ */ Scalar_BOOLEAN 0 SWC_OUTP_type_CM_boolean_flg 0.0 1.0 /end CHARACTERISTIC
/begin CHARACTERISTIC KOUTP_TPMSResButt_flg_maxval "" VALUE 0x0000 /* @ECU_Address@KOUTP_TPMSResButt_flg_maxval@ */ Scalar_BOOLEAN 0 SWC_OUTP_type_CM_boolean_flg 0.0 1.0 /end CHARACTERISTIC
/begin CHARACTERISTIC KOUTP_TPMSResButt_flg_minval "" VALUE 0x0000 /* @ECU_Address@KOUTP_TPMSResButt_flg_minval@ */ Scalar_BOOLEAN 0 SWC_OUTP_type_CM_boolean_flg 0.0 1.0 /end CHARACTERISTIC
/begin CHARACTERISTIC KOUTP_TPMSResButt_flg_ovrdflg "" VALUE 0x0000 /* @ECU_Address@KOUTP_TPMSResButt_flg_ovrdflg@ */ Scalar_BOOLEAN 0 SWC_OUTP_type_CM_boolean_flg 0.0 1.0 /end CHARACTERISTIC
/begin CHARACTERISTIC KOUTP_TPMSResButt_flg_ovrdval "" VALUE 0x0000 /* @ECU_Address@KOUTP_TPMSResButt_flg_ovrdval@ */ Scalar_BOOLEAN 0 SWC_OUTP_type_CM_boolean_flg 0.0 1.0 /end CHARACTERISTIC
/begin CHARACTERISTIC KOUTP_TPMSSensorIDRegStart_flg_maxval "" VALUE 0x0000 /* @ECU_Address@KOUTP_TPMSSensorIDRegStart_flg_maxval@ */ Scalar_BOOLEAN 0 SWC_OUTP_type_CM_boolean_flg 0.0 1.0 /end CHARACTERISTIC
/begin CHARACTERISTIC KOUTP_TPMSSensorIDRegStart_flg_minval "" VALUE 0x0000 /* @ECU_Address@KOUTP_TPMSSensorIDRegStart_flg_minval@ */ Scalar_BOOLEAN 0 SWC_OUTP_type_CM_boolean_flg 0.0 1.0 /end CHARACTERISTIC
/begin CHARACTERISTIC KOUTP_TPMSSensorIDRegStart_flg_ovrdflg "" VALUE 0x0000 /* @ECU_Address@KOUTP_TPMSSensorIDRegStart_flg_ovrdflg@ */ Scalar_BOOLEAN 0 SWC_OUTP_type_CM_boolean_flg 0.0 1.0 /end CHARACTERISTIC
/begin CHARACTERISTIC KOUTP_TPMSSensorIDRegStart_flg_ovrdval "" VALUE 0x0000 /* @ECU_Address@KOUTP_TPMSSensorIDRegStart_flg_ovrdval@ */ Scalar_BOOLEAN 0 SWC_OUTP_type_CM_boolean_flg 0.0 1.0 /end CHARACTERISTIC
/begin CHARACTERISTIC KOUTP_TPMSStorge_flg_maxval "" VALUE 0x0000 /* @ECU_Address@KOUTP_TPMSStorge_flg_maxval@ */ Scalar_BOOLEAN 0 SWC_OUTP_type_CM_boolean_flg 0.0 1.0 /end CHARACTERISTIC
/begin CHARACTERISTIC KOUTP_TPMSStorge_flg_minval "" VALUE 0x0000 /* @ECU_Address@KOUTP_TPMSStorge_flg_minval@ */ Scalar_BOOLEAN 0 SWC_OUTP_type_CM_boolean_flg 0.0 1.0 /end CHARACTERISTIC
/begin CHARACTERISTIC KOUTP_TPMSStorge_flg_ovrdflg "" VALUE 0x0000 /* @ECU_Address@KOUTP_TPMSStorge_flg_ovrdflg@ */ Scalar_BOOLEAN 0 SWC_OUTP_type_CM_boolean_flg 0.0 1.0 /end CHARACTERISTIC
/begin CHARACTERISTIC KOUTP_TPMSStorge_flg_ovrdval "" VALUE 0x0000 /* @ECU_Address@KOUTP_TPMSStorge_flg_ovrdval@ */ Scalar_BOOLEAN 0 SWC_OUTP_type_CM_boolean_flg 0.0 1.0 /end CHARACTERISTIC
/begin CHARACTERISTIC KOUTP_TPMSTLCmd_flg_maxval "" VALUE 0x0000 /* @ECU_Address@KOUTP_TPMSTLCmd_flg_maxval@ */ Scalar_BOOLEAN 0 SWC_OUTP_type_CM_boolean_flg 0.0 1.0 /end CHARACTERISTIC
/begin CHARACTERISTIC KOUTP_TPMSTLCmd_flg_minval "" VALUE 0x0000 /* @ECU_Address@KOUTP_TPMSTLCmd_flg_minval@ */ Scalar_BOOLEAN 0 SWC_OUTP_type_CM_boolean_flg 0.0 1.0 /end CHARACTERISTIC
/begin CHARACTERISTIC KOUTP_TPMSTLCmd_flg_ovrdflg "" VALUE 0x0000 /* @ECU_Address@KOUTP_TPMSTLCmd_flg_ovrdflg@ */ Scalar_BOOLEAN 0 SWC_OUTP_type_CM_boolean_flg 0.0 1.0 /end CHARACTERISTIC
/begin CHARACTERISTIC KOUTP_TPMSTLCmd_flg_ovrdval "" VALUE 0x0000 /* @ECU_Address@KOUTP_TPMSTLCmd_flg_ovrdval@ */ Scalar_BOOLEAN 0 SWC_OUTP_type_CM_boolean_flg 0.0 1.0 /end CHARACTERISTIC
/begin CHARACTERISTIC KOUTP_TPMSWarnIndi_enum_ovrdflg "" VALUE 0x0000 /* @ECU_Address@KOUTP_TPMSWarnIndi_enum_ovrdflg@ */ Scalar_BOOLEAN 0 SWC_OUTP_type_CM_boolean_flg 0.0 1.0 /end CHARACTERISTIC
/begin CHARACTERISTIC KOUTP_TUpAIND_enum_ovrdflg "" VALUE 0x0000 /* @ECU_Address@KOUTP_TUpAIND_enum_ovrdflg@ */ Scalar_BOOLEAN 0 SWC_OUTP_type_CM_boolean_flg 0.0 1.0 /end CHARACTERISTIC
/begin CHARACTERISTIC KOUTP_VCU4PweLmtInd_flg_maxval "" VALUE 0x0000 /* @ECU_Address@KOUTP_VCU4PweLmtInd_flg_maxval@ */ Scalar_BOOLEAN 0 SWC_OUTP_type_CM_boolean_flg 0.0 1.0 /end CHARACTERISTIC
/begin CHARACTERISTIC KOUTP_VCU4PweLmtInd_flg_minval "" VALUE 0x0000 /* @ECU_Address@KOUTP_VCU4PweLmtInd_flg_minval@ */ Scalar_BOOLEAN 0 SWC_OUTP_type_CM_boolean_flg 0.0 1.0 /end CHARACTERISTIC
/begin CHARACTERISTIC KOUTP_VCU4PweLmtInd_flg_ovrdflg "" VALUE 0x0000 /* @ECU_Address@KOUTP_VCU4PweLmtInd_flg_ovrdflg@ */ Scalar_BOOLEAN 0 SWC_OUTP_type_CM_boolean_flg 0.0 1.0 /end CHARACTERISTIC
/begin CHARACTERISTIC KOUTP_VCU4PweLmtInd_flg_ovrdval "" VALUE 0x0000 /* @ECU_Address@KOUTP_VCU4PweLmtInd_flg_ovrdval@ */ Scalar_BOOLEAN 0 SWC_OUTP_type_CM_boolean_flg 0.0 1.0 /end CHARACTERISTIC
/begin CHARACTERISTIC KOUTP_VCUBCMBuzzReq_flg_maxval "" VALUE 0x0000 /* @ECU_Address@KOUTP_VCUBCMBuzzReq_flg_maxval@ */ Scalar_BOOLEAN 0 SWC_OUTP_type_CM_boolean_flg 0.0 1.0 /end CHARACTERISTIC
/begin CHARACTERISTIC KOUTP_VCUBCMBuzzReq_flg_minval "" VALUE 0x0000 /* @ECU_Address@KOUTP_VCUBCMBuzzReq_flg_minval@ */ Scalar_BOOLEAN 0 SWC_OUTP_type_CM_boolean_flg 0.0 1.0 /end CHARACTERISTIC
/begin CHARACTERISTIC KOUTP_VCUBCMBuzzReq_flg_ovrdflg "" VALUE 0x0000 /* @ECU_Address@KOUTP_VCUBCMBuzzReq_flg_ovrdflg@ */ Scalar_BOOLEAN 0 SWC_OUTP_type_CM_boolean_flg 0.0 1.0 /end CHARACTERISTIC
/begin CHARACTERISTIC KOUTP_VCUBCMBuzzReq_flg_ovrdval "" VALUE 0x0000 /* @ECU_Address@KOUTP_VCUBCMBuzzReq_flg_ovrdval@ */ Scalar_BOOLEAN 0 SWC_OUTP_type_CM_boolean_flg 0.0 1.0 /end CHARACTERISTIC
/begin CHARACTERISTIC KOUTP_VCUEBSHBSw_enum_ovrdflg "" VALUE 0x0000 /* @ECU_Address@KOUTP_VCUEBSHBSw_enum_ovrdflg@ */ Scalar_BOOLEAN 0 SWC_OUTP_type_CM_boolean_flg 0.0 1.0 /end CHARACTERISTIC
/begin CHARACTERISTIC KOUTP_VCUEBSHHSw_enum_ovrdflg "" VALUE 0x0000 /* @ECU_Address@KOUTP_VCUEBSHHSw_enum_ovrdflg@ */ Scalar_BOOLEAN 0 SWC_OUTP_type_CM_boolean_flg 0.0 1.0 /end CHARACTERISTIC
/begin CHARACTERISTIC KOUTP_VCUEBSRd4BR_enum_ovrdflg "" VALUE 0x0000 /* @ECU_Address@KOUTP_VCUEBSRd4BR_enum_ovrdflg@ */ Scalar_BOOLEAN 0 SWC_OUTP_type_CM_boolean_flg 0.0 1.0 /end CHARACTERISTIC
/begin CHARACTERISTIC KOUTP_VCUMCUCtrlMdTQD_enum_ovrdflg "" VALUE 0x0000 /* @ECU_Address@KOUTP_VCUMCUCtrlMdTQD_enum_ovrdflg@ */ Scalar_BOOLEAN 0 SWC_OUTP_type_CM_boolean_flg 0.0 1.0 /end CHARACTERISTIC
/begin CHARACTERISTIC KOUTP_VCUMCUDemHiPosVal_rpm_ovrdflg "" VALUE 0x0000 /* @ECU_Address@KOUTP_VCUMCUDemHiPosVal_rpm_ovrdflg@ */ Scalar_BOOLEAN 0 SWC_OUTP_type_CM_boolean_flg 0.0 1.0 /end CHARACTERISTIC
/begin CHARACTERISTIC KOUTP_VCUMCUDemLoNegVal_rpm_ovrdflg "" VALUE 0x0000 /* @ECU_Address@KOUTP_VCUMCUDemLoNegVal_rpm_ovrdflg@ */ Scalar_BOOLEAN 0 SWC_OUTP_type_CM_boolean_flg 0.0 1.0 /end CHARACTERISTIC
/begin CHARACTERISTIC KOUTP_VCUMCUDemSpd_rpm_ovrdflg "" VALUE 0x0000 /* @ECU_Address@KOUTP_VCUMCUDemSpd_rpm_ovrdflg@ */ Scalar_BOOLEAN 0 SWC_OUTP_type_CM_boolean_flg 0.0 1.0 /end CHARACTERISTIC
/begin CHARACTERISTIC KOUTP_VCUMCUFootBrk_flg_maxval "" VALUE 0x0000 /* @ECU_Address@KOUTP_VCUMCUFootBrk_flg_maxval@ */ Scalar_BOOLEAN 0 SWC_OUTP_type_CM_boolean_flg 0.0 1.0 /end CHARACTERISTIC
/begin CHARACTERISTIC KOUTP_VCUMCUFootBrk_flg_minval "" VALUE 0x0000 /* @ECU_Address@KOUTP_VCUMCUFootBrk_flg_minval@ */ Scalar_BOOLEAN 0 SWC_OUTP_type_CM_boolean_flg 0.0 1.0 /end CHARACTERISTIC
/begin CHARACTERISTIC KOUTP_VCUMCUFootBrk_flg_ovrdflg "" VALUE 0x0000 /* @ECU_Address@KOUTP_VCUMCUFootBrk_flg_ovrdflg@ */ Scalar_BOOLEAN 0 SWC_OUTP_type_CM_boolean_flg 0.0 1.0 /end CHARACTERISTIC
/begin CHARACTERISTIC KOUTP_VCUMCUFootBrk_flg_ovrdval "" VALUE 0x0000 /* @ECU_Address@KOUTP_VCUMCUFootBrk_flg_ovrdval@ */ Scalar_BOOLEAN 0 SWC_OUTP_type_CM_boolean_flg 0.0 1.0 /end CHARACTERISTIC
/begin CHARACTERISTIC KOUTP_VCUMCUGearSta_enum_ovrdflg "" VALUE 0x0000 /* @ECU_Address@KOUTP_VCUMCUGearSta_enum_ovrdflg@ */ Scalar_BOOLEAN 0 SWC_OUTP_type_CM_boolean_flg 0.0 1.0 /end CHARACTERISTIC
/begin CHARACTERISTIC KOUTP_VCUMCUHandBrk_flg_maxval "" VALUE 0x0000 /* @ECU_Address@KOUTP_VCUMCUHandBrk_flg_maxval@ */ Scalar_BOOLEAN 0 SWC_OUTP_type_CM_boolean_flg 0.0 1.0 /end CHARACTERISTIC
/begin CHARACTERISTIC KOUTP_VCUMCUHandBrk_flg_minval "" VALUE 0x0000 /* @ECU_Address@KOUTP_VCUMCUHandBrk_flg_minval@ */ Scalar_BOOLEAN 0 SWC_OUTP_type_CM_boolean_flg 0.0 1.0 /end CHARACTERISTIC
/begin CHARACTERISTIC KOUTP_VCUMCUHandBrk_flg_ovrdflg "" VALUE 0x0000 /* @ECU_Address@KOUTP_VCUMCUHandBrk_flg_ovrdflg@ */ Scalar_BOOLEAN 0 SWC_OUTP_type_CM_boolean_flg 0.0 1.0 /end CHARACTERISTIC
/begin CHARACTERISTIC KOUTP_VCUMCUHandBrk_flg_ovrdval "" VALUE 0x0000 /* @ECU_Address@KOUTP_VCUMCUHandBrk_flg_ovrdval@ */ Scalar_BOOLEAN 0 SWC_OUTP_type_CM_boolean_flg 0.0 1.0 /end CHARACTERISTIC
/begin CHARACTERISTIC KOUTP_VCUTMVehSpd_kph_ovrdflg "" VALUE 0x0000 /* @ECU_Address@KOUTP_VCUTMVehSpd_kph_ovrdflg@ */ Scalar_BOOLEAN 0 SWC_OUTP_type_CM_boolean_flg 0.0 1.0 /end CHARACTERISTIC
/begin CHARACTERISTIC KOUTP_VehAcclLimitTG_mps2_ovrdflg "" VALUE 0x0000 /* @ECU_Address@KOUTP_VehAcclLimitTG_mps2_ovrdflg@ */ Scalar_BOOLEAN 0 SWC_OUTP_type_CM_boolean_flg 0.0 1.0 /end CHARACTERISTIC
/begin CHARACTERISTIC KOUTP_VehSpdLimitTG_kph_ovrdflg "" VALUE 0x0000 /* @ECU_Address@KOUTP_VehSpdLimitTG_kph_ovrdflg@ */ Scalar_BOOLEAN 0 SWC_OUTP_type_CM_boolean_flg 0.0 1.0 /end CHARACTERISTIC
/begin CHARACTERISTIC KOUTP_WriteChkLFID_raw_ovrdflg "" VALUE 0x0000 /* @ECU_Address@KOUTP_WriteChkLFID_raw_ovrdflg@ */ Scalar_BOOLEAN 0 SWC_OUTP_type_CM_boolean_flg 0.0 1.0 /end CHARACTERISTIC
/begin CHARACTERISTIC KOUTP_WriteChkLRID_raw_ovrdflg "" VALUE 0x0000 /* @ECU_Address@KOUTP_WriteChkLRID_raw_ovrdflg@ */ Scalar_BOOLEAN 0 SWC_OUTP_type_CM_boolean_flg 0.0 1.0 /end CHARACTERISTIC
/begin CHARACTERISTIC KOUTP_WriteChkRFID_raw_ovrdflg "" VALUE 0x0000 /* @ECU_Address@KOUTP_WriteChkRFID_raw_ovrdflg@ */ Scalar_BOOLEAN 0 SWC_OUTP_type_CM_boolean_flg 0.0 1.0 /end CHARACTERISTIC
/begin CHARACTERISTIC KOUTP_WriteChkRRID_raw_ovrdflg "" VALUE 0x0000 /* @ECU_Address@KOUTP_WriteChkRRID_raw_ovrdflg@ */ Scalar_BOOLEAN 0 SWC_OUTP_type_CM_boolean_flg 0.0 1.0 /end CHARACTERISTIC
/begin CHARACTERISTIC KOUTP_WriteChkfinLFID_raw_ovrdflg "" VALUE 0x0000 /* @ECU_Address@KOUTP_WriteChkfinLFID_raw_ovrdflg@ */ Scalar_BOOLEAN 0 SWC_OUTP_type_CM_boolean_flg 0.0 1.0 /end CHARACTERISTIC
/begin CHARACTERISTIC KOUTP_WriteChkfinLRID_raw_ovrdflg "" VALUE 0x0000 /* @ECU_Address@KOUTP_WriteChkfinLRID_raw_ovrdflg@ */ Scalar_BOOLEAN 0 SWC_OUTP_type_CM_boolean_flg 0.0 1.0 /end CHARACTERISTIC
/begin CHARACTERISTIC KOUTP_WriteChkfinRFID_raw_ovrdflg "" VALUE 0x0000 /* @ECU_Address@KOUTP_WriteChkfinRFID_raw_ovrdflg@ */ Scalar_BOOLEAN 0 SWC_OUTP_type_CM_boolean_flg 0.0 1.0 /end CHARACTERISTIC
/begin CHARACTERISTIC KOUTP_WriteChkfinRRID_raw_ovrdflg "" VALUE 0x0000 /* @ECU_Address@KOUTP_WriteChkfinRRID_raw_ovrdflg@ */ Scalar_BOOLEAN 0 SWC_OUTP_type_CM_boolean_flg 0.0 1.0 /end CHARACTERISTIC
/begin CHARACTERISTIC KOUTP_WritingCnt_enum_ovrdflg "" VALUE 0x0000 /* @ECU_Address@KOUTP_WritingCnt_enum_ovrdflg@ */ Scalar_BOOLEAN 0 SWC_OUTP_type_CM_boolean_flg 0.0 1.0 /end CHARACTERISTIC
/begin CHARACTERISTIC KOUTP_unlearnSfailvalid_enum_ovrdflg "" VALUE 0x0000 /* @ECU_Address@KOUTP_unlearnSfailvalid_enum_ovrdflg@ */ Scalar_BOOLEAN 0 SWC_OUTP_type_CM_boolean_flg 0.0 1.0 /end CHARACTERISTIC
/begin CHARACTERISTIC KOUTP_unlearnSfali_flg_maxval "" VALUE 0x0000 /* @ECU_Address@KOUTP_unlearnSfali_flg_maxval@ */ Scalar_BOOLEAN 0 SWC_OUTP_type_CM_boolean_flg 0.0 1.0 /end CHARACTERISTIC
/begin CHARACTERISTIC KOUTP_unlearnSfali_flg_minval "" VALUE 0x0000 /* @ECU_Address@KOUTP_unlearnSfali_flg_minval@ */ Scalar_BOOLEAN 0 SWC_OUTP_type_CM_boolean_flg 0.0 1.0 /end CHARACTERISTIC
/begin CHARACTERISTIC KOUTP_unlearnSfali_flg_ovrdflg "" VALUE 0x0000 /* @ECU_Address@KOUTP_unlearnSfali_flg_ovrdflg@ */ Scalar_BOOLEAN 0 SWC_OUTP_type_CM_boolean_flg 0.0 1.0 /end CHARACTERISTIC
/begin CHARACTERISTIC KOUTP_unlearnSfali_flg_ovrdval "" VALUE 0x0000 /* @ECU_Address@KOUTP_unlearnSfali_flg_ovrdval@ */ Scalar_BOOLEAN 0 SWC_OUTP_type_CM_boolean_flg 0.0 1.0 /end CHARACTERISTIC
/begin CHARACTERISTIC KOUTP_ActDriveMode_enum_maxval "" VALUE 0x0000 /* @ECU_Address@KOUTP_ActDriveMode_enum_maxval@ */ Scalar_UBYTE 0 SWC_OUTP_type_CM_uint8_enum 0.0 255.0 /end CHARACTERISTIC
/begin CHARACTERISTIC KOUTP_ActDriveMode_enum_minval "" VALUE 0x0000 /* @ECU_Address@KOUTP_ActDriveMode_enum_minval@ */ Scalar_UBYTE 0 SWC_OUTP_type_CM_uint8_enum 0.0 255.0 /end CHARACTERISTIC
/begin CHARACTERISTIC KOUTP_ActDriveMode_enum_ovrdval "" VALUE 0x0000 /* @ECU_Address@KOUTP_ActDriveMode_enum_ovrdval@ */ Scalar_UBYTE 0 SWC_OUTP_type_CM_uint8_enum 0.0 255.0 /end CHARACTERISTIC
/begin CHARACTERISTIC KOUTP_ActTUpAIND_enum_maxval "" VALUE 0x0000 /* @ECU_Address@KOUTP_ActTUpAIND_enum_maxval@ */ Scalar_UBYTE 0 SWC_OUTP_type_CM_uint8_enum 0.0 255.0 /end CHARACTERISTIC
/begin CHARACTERISTIC KOUTP_ActTUpAIND_enum_minval "" VALUE 0x0000 /* @ECU_Address@KOUTP_ActTUpAIND_enum_minval@ */ Scalar_UBYTE 0 SWC_OUTP_type_CM_uint8_enum 0.0 255.0 /end CHARACTERISTIC
/begin CHARACTERISTIC KOUTP_ActTUpAIND_enum_ovrdval "" VALUE 0x0000 /* @ECU_Address@KOUTP_ActTUpAIND_enum_ovrdval@ */ Scalar_UBYTE 0 SWC_OUTP_type_CM_uint8_enum 0.0 255.0 /end CHARACTERISTIC
/begin CHARACTERISTIC KOUTP_CreepIND_enum_maxval "" VALUE 0x0000 /* @ECU_Address@KOUTP_CreepIND_enum_maxval@ */ Scalar_UBYTE 0 SWC_OUTP_type_CM_uint8_enum 0.0 255.0 /end CHARACTERISTIC
/begin CHARACTERISTIC KOUTP_CreepIND_enum_minval "" VALUE 0x0000 /* @ECU_Address@KOUTP_CreepIND_enum_minval@ */ Scalar_UBYTE 0 SWC_OUTP_type_CM_uint8_enum 0.0 255.0 /end CHARACTERISTIC
/begin CHARACTERISTIC KOUTP_CreepIND_enum_ovrdval "" VALUE 0x0000 /* @ECU_Address@KOUTP_CreepIND_enum_ovrdval@ */ Scalar_UBYTE 0 SWC_OUTP_type_CM_uint8_enum 0.0 255.0 /end CHARACTERISTIC
/begin CHARACTERISTIC KOUTP_EC1EMSupTSC1CtrlPG1_cnt_maxval "" VALUE 0x0000 /* @ECU_Address@KOUTP_EC1EMSupTSC1CtrlPG1_cnt_maxval@ */ Scalar_UBYTE 0 SWC_OUTP_type_CM_uint8_enum 0.0 255.0 /end CHARACTERISTIC
/begin CHARACTERISTIC KOUTP_EC1EMSupTSC1CtrlPG1_cnt_minval "" VALUE 0x0000 /* @ECU_Address@KOUTP_EC1EMSupTSC1CtrlPG1_cnt_minval@ */ Scalar_UBYTE 0 SWC_OUTP_type_CM_uint8_enum 0.0 255.0 /end CHARACTERISTIC
/begin CHARACTERISTIC KOUTP_EC1EMSupTSC1CtrlPG1_cnt_ovrdval "" VALUE 0x0000 /* @ECU_Address@KOUTP_EC1EMSupTSC1CtrlPG1_cnt_ovrdval@ */ Scalar_UBYTE 0 SWC_OUTP_type_CM_uint8_enum 0.0 255.0 /end CHARACTERISTIC
/begin CHARACTERISTIC KOUTP_EC1EMSupTSC1CtrlPG2_cnt_maxval "" VALUE 0x0000 /* @ECU_Address@KOUTP_EC1EMSupTSC1CtrlPG2_cnt_maxval@ */ Scalar_UBYTE 0 SWC_OUTP_type_CM_uint8_enum 0.0 255.0 /end CHARACTERISTIC
/begin CHARACTERISTIC KOUTP_EC1EMSupTSC1CtrlPG2_cnt_minval "" VALUE 0x0000 /* @ECU_Address@KOUTP_EC1EMSupTSC1CtrlPG2_cnt_minval@ */ Scalar_UBYTE 0 SWC_OUTP_type_CM_uint8_enum 0.0 255.0 /end CHARACTERISTIC
/begin CHARACTERISTIC KOUTP_EC1EMSupTSC1CtrlPG2_cnt_ovrdval "" VALUE 0x0000 /* @ECU_Address@KOUTP_EC1EMSupTSC1CtrlPG2_cnt_ovrdval@ */ Scalar_UBYTE 0 SWC_OUTP_type_CM_uint8_enum 0.0 255.0 /end CHARACTERISTIC
/begin CHARACTERISTIC KOUTP_EC1EMSupTSC1CtrlPG3_cnt_maxval "" VALUE 0x0000 /* @ECU_Address@KOUTP_EC1EMSupTSC1CtrlPG3_cnt_maxval@ */ Scalar_UBYTE 0 SWC_OUTP_type_CM_uint8_enum 0.0 255.0 /end CHARACTERISTIC
/begin CHARACTERISTIC KOUTP_EC1EMSupTSC1CtrlPG3_cnt_minval "" VALUE 0x0000 /* @ECU_Address@KOUTP_EC1EMSupTSC1CtrlPG3_cnt_minval@ */ Scalar_UBYTE 0 SWC_OUTP_type_CM_uint8_enum 0.0 255.0 /end CHARACTERISTIC
/begin CHARACTERISTIC KOUTP_EC1EMSupTSC1CtrlPG3_cnt_ovrdval "" VALUE 0x0000 /* @ECU_Address@KOUTP_EC1EMSupTSC1CtrlPG3_cnt_ovrdval@ */ Scalar_UBYTE 0 SWC_OUTP_type_CM_uint8_enum 0.0 255.0 /end CHARACTERISTIC
/begin CHARACTERISTIC KOUTP_EC1EMSupTSC1CtrlPG4_cnt_maxval "" VALUE 0x0000 /* @ECU_Address@KOUTP_EC1EMSupTSC1CtrlPG4_cnt_maxval@ */ Scalar_UBYTE 0 SWC_OUTP_type_CM_uint8_enum 0.0 255.0 /end CHARACTERISTIC
/begin CHARACTERISTIC KOUTP_EC1EMSupTSC1CtrlPG4_cnt_minval "" VALUE 0x0000 /* @ECU_Address@KOUTP_EC1EMSupTSC1CtrlPG4_cnt_minval@ */ Scalar_UBYTE 0 SWC_OUTP_type_CM_uint8_enum 0.0 255.0 /end CHARACTERISTIC
/begin CHARACTERISTIC KOUTP_EC1EMSupTSC1CtrlPG4_cnt_ovrdval "" VALUE 0x0000 /* @ECU_Address@KOUTP_EC1EMSupTSC1CtrlPG4_cnt_ovrdval@ */ Scalar_UBYTE 0 SWC_OUTP_type_CM_uint8_enum 0.0 255.0 /end CHARACTERISTIC
/begin CHARACTERISTIC KOUTP_EC1EMSupVarRTSC1MSG_cnt_maxval "" VALUE 0x0000 /* @ECU_Address@KOUTP_EC1EMSupVarRTSC1MSG_cnt_maxval@ */ Scalar_UBYTE 0 SWC_OUTP_type_CM_uint8_enum 0.0 255.0 /end CHARACTERISTIC
/begin CHARACTERISTIC KOUTP_EC1EMSupVarRTSC1MSG_cnt_minval "" VALUE 0x0000 /* @ECU_Address@KOUTP_EC1EMSupVarRTSC1MSG_cnt_minval@ */ Scalar_UBYTE 0 SWC_OUTP_type_CM_uint8_enum 0.0 255.0 /end CHARACTERISTIC
/begin CHARACTERISTIC KOUTP_EC1EMSupVarRTSC1MSG_cnt_ovrdval "" VALUE 0x0000 /* @ECU_Address@KOUTP_EC1EMSupVarRTSC1MSG_cnt_ovrdval@ */ Scalar_UBYTE 0 SWC_OUTP_type_CM_uint8_enum 0.0 255.0 /end CHARACTERISTIC
/begin CHARACTERISTIC KOUTP_EMRC1EMTquModeDrvBrk_enum_maxval "" VALUE 0x0000 /* @ECU_Address@KOUTP_EMRC1EMTquModeDrvBrk_enum_maxval@ */ Scalar_UBYTE 0 SWC_OUTP_type_CM_uint8_enum 0.0 255.0 /end CHARACTERISTIC
/begin CHARACTERISTIC KOUTP_EMRC1EMTquModeDrvBrk_enum_minval "" VALUE 0x0000 /* @ECU_Address@KOUTP_EMRC1EMTquModeDrvBrk_enum_minval@ */ Scalar_UBYTE 0 SWC_OUTP_type_CM_uint8_enum 0.0 255.0 /end CHARACTERISTIC
/begin CHARACTERISTIC KOUTP_EMRC1EMTquModeDrvBrk_enum_ovrdval "" VALUE 0x0000 /* @ECU_Address@KOUTP_EMRC1EMTquModeDrvBrk_enum_ovrdval@ */ Scalar_UBYTE 0 SWC_OUTP_type_CM_uint8_enum 0.0 255.0 /end CHARACTERISTIC
/begin CHARACTERISTIC KOUTP_EMRC1SACtrlDev_cnt_maxval "" VALUE 0x0000 /* @ECU_Address@KOUTP_EMRC1SACtrlDev_cnt_maxval@ */ Scalar_UBYTE 0 SWC_OUTP_type_CM_uint8_enum 0.0 255.0 /end CHARACTERISTIC
/begin CHARACTERISTIC KOUTP_EMRC1SACtrlDev_cnt_minval "" VALUE 0x0000 /* @ECU_Address@KOUTP_EMRC1SACtrlDev_cnt_minval@ */ Scalar_UBYTE 0 SWC_OUTP_type_CM_uint8_enum 0.0 255.0 /end CHARACTERISTIC
/begin CHARACTERISTIC KOUTP_EMRC1SACtrlDev_cnt_ovrdval "" VALUE 0x0000 /* @ECU_Address@KOUTP_EMRC1SACtrlDev_cnt_ovrdval@ */ Scalar_UBYTE 0 SWC_OUTP_type_CM_uint8_enum 0.0 255.0 /end CHARACTERISTIC
/begin CHARACTERISTIC KOUTP_ETC1ShiftrPgs_enum_maxval "" VALUE 0x0000 /* @ECU_Address@KOUTP_ETC1ShiftrPgs_enum_maxval@ */ Scalar_UBYTE 0 SWC_OUTP_type_CM_uint8_enum 0.0 255.0 /end CHARACTERISTIC
/begin CHARACTERISTIC KOUTP_ETC1ShiftrPgs_enum_minval "" VALUE 0x0000 /* @ECU_Address@KOUTP_ETC1ShiftrPgs_enum_minval@ */ Scalar_UBYTE 0 SWC_OUTP_type_CM_uint8_enum 0.0 255.0 /end CHARACTERISTIC
/begin CHARACTERISTIC KOUTP_ETC1ShiftrPgs_enum_ovrdval "" VALUE 0x0000 /* @ECU_Address@KOUTP_ETC1ShiftrPgs_enum_ovrdval@ */ Scalar_UBYTE 0 SWC_OUTP_type_CM_uint8_enum 0.0 255.0 /end CHARACTERISTIC
/begin CHARACTERISTIC KOUTP_EVCU1ActDrvMode_enum_maxval "" VALUE 0x0000 /* @ECU_Address@KOUTP_EVCU1ActDrvMode_enum_maxval@ */ Scalar_UBYTE 0 SWC_OUTP_type_CM_uint8_enum 0.0 255.0 /end CHARACTERISTIC
/begin CHARACTERISTIC KOUTP_EVCU1ActDrvMode_enum_minval "" VALUE 0x0000 /* @ECU_Address@KOUTP_EVCU1ActDrvMode_enum_minval@ */ Scalar_UBYTE 0 SWC_OUTP_type_CM_uint8_enum 0.0 255.0 /end CHARACTERISTIC
/begin CHARACTERISTIC KOUTP_EVCU1ActDrvMode_enum_ovrdval "" VALUE 0x0000 /* @ECU_Address@KOUTP_EVCU1ActDrvMode_enum_ovrdval@ */ Scalar_UBYTE 0 SWC_OUTP_type_CM_uint8_enum 0.0 255.0 /end CHARACTERISTIC
/begin CHARACTERISTIC KOUTP_EVCU1EBrakeTorqLow_enum_maxval "" VALUE 0x0000 /* @ECU_Address@KOUTP_EVCU1EBrakeTorqLow_enum_maxval@ */ Scalar_UBYTE 0 SWC_OUTP_type_CM_uint8_enum 0.0 255.0 /end CHARACTERISTIC
/begin CHARACTERISTIC KOUTP_EVCU1EBrakeTorqLow_enum_minval "" VALUE 0x0000 /* @ECU_Address@KOUTP_EVCU1EBrakeTorqLow_enum_minval@ */ Scalar_UBYTE 0 SWC_OUTP_type_CM_uint8_enum 0.0 255.0 /end CHARACTERISTIC
/begin CHARACTERISTIC KOUTP_EVCU1EBrakeTorqLow_enum_ovrdval "" VALUE 0x0000 /* @ECU_Address@KOUTP_EVCU1EBrakeTorqLow_enum_ovrdval@ */ Scalar_UBYTE 0 SWC_OUTP_type_CM_uint8_enum 0.0 255.0 /end CHARACTERISTIC
/begin CHARACTERISTIC KOUTP_EVCU1EMotorOvrerSpd_enum_maxval "" VALUE 0x0000 /* @ECU_Address@KOUTP_EVCU1EMotorOvrerSpd_enum_maxval@ */ Scalar_UBYTE 0 SWC_OUTP_type_CM_uint8_enum 0.0 255.0 /end CHARACTERISTIC
/begin CHARACTERISTIC KOUTP_EVCU1EMotorOvrerSpd_enum_minval "" VALUE 0x0000 /* @ECU_Address@KOUTP_EVCU1EMotorOvrerSpd_enum_minval@ */ Scalar_UBYTE 0 SWC_OUTP_type_CM_uint8_enum 0.0 255.0 /end CHARACTERISTIC
/begin CHARACTERISTIC KOUTP_EVCU1EMotorOvrerSpd_enum_ovrdval "" VALUE 0x0000 /* @ECU_Address@KOUTP_EVCU1EMotorOvrerSpd_enum_ovrdval@ */ Scalar_UBYTE 0 SWC_OUTP_type_CM_uint8_enum 0.0 255.0 /end CHARACTERISTIC
/begin CHARACTERISTIC KOUTP_EVCU1RecuperHighSta_enum_maxval "" VALUE 0x0000 /* @ECU_Address@KOUTP_EVCU1RecuperHighSta_enum_maxval@ */ Scalar_UBYTE 0 SWC_OUTP_type_CM_uint8_enum 0.0 255.0 /end CHARACTERISTIC
/begin CHARACTERISTIC KOUTP_EVCU1RecuperHighSta_enum_minval "" VALUE 0x0000 /* @ECU_Address@KOUTP_EVCU1RecuperHighSta_enum_minval@ */ Scalar_UBYTE 0 SWC_OUTP_type_CM_uint8_enum 0.0 255.0 /end CHARACTERISTIC
/begin CHARACTERISTIC KOUTP_EVCU1RecuperHighSta_enum_ovrdval "" VALUE 0x0000 /* @ECU_Address@KOUTP_EVCU1RecuperHighSta_enum_ovrdval@ */ Scalar_UBYTE 0 SWC_OUTP_type_CM_uint8_enum 0.0 255.0 /end CHARACTERISTIC
/begin CHARACTERISTIC KOUTP_EVCU1WheelSlipdet_enum_maxval "" VALUE 0x0000 /* @ECU_Address@KOUTP_EVCU1WheelSlipdet_enum_maxval@ */ Scalar_UBYTE 0 SWC_OUTP_type_CM_uint8_enum 0.0 255.0 /end CHARACTERISTIC
/begin CHARACTERISTIC KOUTP_EVCU1WheelSlipdet_enum_minval "" VALUE 0x0000 /* @ECU_Address@KOUTP_EVCU1WheelSlipdet_enum_minval@ */ Scalar_UBYTE 0 SWC_OUTP_type_CM_uint8_enum 0.0 255.0 /end CHARACTERISTIC
/begin CHARACTERISTIC KOUTP_EVCU1WheelSlipdet_enum_ovrdval "" VALUE 0x0000 /* @ECU_Address@KOUTP_EVCU1WheelSlipdet_enum_ovrdval@ */ Scalar_UBYTE 0 SWC_OUTP_type_CM_uint8_enum 0.0 255.0 /end CHARACTERISTIC
/begin CHARACTERISTIC KOUTP_HVPO120VGrpALDSt_enum_maxval "" VALUE 0x0000 /* @ECU_Address@KOUTP_HVPO120VGrpALDSt_enum_maxval@ */ Scalar_UBYTE 0 SWC_OUTP_type_CM_uint8_enum 0.0 255.0 /end CHARACTERISTIC
/begin CHARACTERISTIC KOUTP_HVPO120VGrpALDSt_enum_minval "" VALUE 0x0000 /* @ECU_Address@KOUTP_HVPO120VGrpALDSt_enum_minval@ */ Scalar_UBYTE 0 SWC_OUTP_type_CM_uint8_enum 0.0 255.0 /end CHARACTERISTIC
/begin CHARACTERISTIC KOUTP_HVPO120VGrpALDSt_enum_ovrdval "" VALUE 0x0000 /* @ECU_Address@KOUTP_HVPO120VGrpALDSt_enum_ovrdval@ */ Scalar_UBYTE 0 SWC_OUTP_type_CM_uint8_enum 0.0 255.0 /end CHARACTERISTIC
/begin CHARACTERISTIC KOUTP_HVPO120VGrpBLDSt_enum_maxval "" VALUE 0x0000 /* @ECU_Address@KOUTP_HVPO120VGrpBLDSt_enum_maxval@ */ Scalar_UBYTE 0 SWC_OUTP_type_CM_uint8_enum 0.0 255.0 /end CHARACTERISTIC
/begin CHARACTERISTIC KOUTP_HVPO120VGrpBLDSt_enum_minval "" VALUE 0x0000 /* @ECU_Address@KOUTP_HVPO120VGrpBLDSt_enum_minval@ */ Scalar_UBYTE 0 SWC_OUTP_type_CM_uint8_enum 0.0 255.0 /end CHARACTERISTIC
/begin CHARACTERISTIC KOUTP_HVPO120VGrpBLDSt_enum_ovrdval "" VALUE 0x0000 /* @ECU_Address@KOUTP_HVPO120VGrpBLDSt_enum_ovrdval@ */ Scalar_UBYTE 0 SWC_OUTP_type_CM_uint8_enum 0.0 255.0 /end CHARACTERISTIC
/begin CHARACTERISTIC KOUTP_RC1RetLocat_enum_maxval "" VALUE 0x0000 /* @ECU_Address@KOUTP_RC1RetLocat_enum_maxval@ */ Scalar_UBYTE 0 SWC_OUTP_type_CM_uint8_enum 0.0 255.0 /end CHARACTERISTIC
/begin CHARACTERISTIC KOUTP_RC1RetLocat_enum_minval "" VALUE 0x0000 /* @ECU_Address@KOUTP_RC1RetLocat_enum_minval@ */ Scalar_UBYTE 0 SWC_OUTP_type_CM_uint8_enum 0.0 255.0 /end CHARACTERISTIC
/begin CHARACTERISTIC KOUTP_RC1RetLocat_enum_ovrdval "" VALUE 0x0000 /* @ECU_Address@KOUTP_RC1RetLocat_enum_ovrdval@ */ Scalar_UBYTE 0 SWC_OUTP_type_CM_uint8_enum 0.0 255.0 /end CHARACTERISTIC
/begin CHARACTERISTIC KOUTP_RC1RetType_enum_maxval "" VALUE 0x0000 /* @ECU_Address@KOUTP_RC1RetType_enum_maxval@ */ Scalar_UBYTE 0 SWC_OUTP_type_CM_uint8_enum 0.0 255.0 /end CHARACTERISTIC
/begin CHARACTERISTIC KOUTP_RC1RetType_enum_minval "" VALUE 0x0000 /* @ECU_Address@KOUTP_RC1RetType_enum_minval@ */ Scalar_UBYTE 0 SWC_OUTP_type_CM_uint8_enum 0.0 255.0 /end CHARACTERISTIC
/begin CHARACTERISTIC KOUTP_RC1RetType_enum_ovrdval "" VALUE 0x0000 /* @ECU_Address@KOUTP_RC1RetType_enum_ovrdval@ */ Scalar_UBYTE 0 SWC_OUTP_type_CM_uint8_enum 0.0 255.0 /end CHARACTERISTIC
/begin CHARACTERISTIC KOUTP_RRWheelPSW_raw8_maxval "" VALUE 0x0000 /* @ECU_Address@KOUTP_RRWheelPSW_raw8_maxval@ */ Scalar_UBYTE 0 SWC_OUTP_type_CM_uint8_raw8 0.0 255.0 /end CHARACTERISTIC
/begin CHARACTERISTIC KOUTP_RRWheelPSW_raw8_minval "" VALUE 0x0000 /* @ECU_Address@KOUTP_RRWheelPSW_raw8_minval@ */ Scalar_UBYTE 0 SWC_OUTP_type_CM_uint8_raw8 0.0 255.0 /end CHARACTERISTIC
/begin CHARACTERISTIC KOUTP_RRWheelPSW_raw8_ovrdval "" VALUE 0x0000 /* @ECU_Address@KOUTP_RRWheelPSW_raw8_ovrdval@ */ Scalar_UBYTE 0 SWC_OUTP_type_CM_uint8_enum 0.0 255.0 /end CHARACTERISTIC
/begin CHARACTERISTIC KOUTP_RRWheelPress_raw8_maxval "" VALUE 0x0000 /* @ECU_Address@KOUTP_RRWheelPress_raw8_maxval@ */ Scalar_UBYTE 0 SWC_OUTP_type_CM_uint8_raw8 0.0 255.0 /end CHARACTERISTIC
/begin CHARACTERISTIC KOUTP_RRWheelPress_raw8_minval "" VALUE 0x0000 /* @ECU_Address@KOUTP_RRWheelPress_raw8_minval@ */ Scalar_UBYTE 0 SWC_OUTP_type_CM_uint8_raw8 0.0 255.0 /end CHARACTERISTIC
/begin CHARACTERISTIC KOUTP_RRWheelPress_raw8_ovrdval "" VALUE 0x0000 /* @ECU_Address@KOUTP_RRWheelPress_raw8_ovrdval@ */ Scalar_UBYTE 0 SWC_OUTP_type_CM_uint8_enum 0.0 255.0 /end CHARACTERISTIC
/begin CHARACTERISTIC KOUTP_ReqOBCExtrV2LEna_enum_maxval "" VALUE 0x0000 /* @ECU_Address@KOUTP_ReqOBCExtrV2LEna_enum_maxval@ */ Scalar_UBYTE 0 SWC_OUTP_type_CM_uint8_enum 0.0 255.0 /end CHARACTERISTIC
/begin CHARACTERISTIC KOUTP_ReqOBCExtrV2LEna_enum_minval "" VALUE 0x0000 /* @ECU_Address@KOUTP_ReqOBCExtrV2LEna_enum_minval@ */ Scalar_UBYTE 0 SWC_OUTP_type_CM_uint8_enum 0.0 255.0 /end CHARACTERISTIC
/begin CHARACTERISTIC KOUTP_S1L_enum_maxval "" VALUE 0x0000 /* @ECU_Address@KOUTP_S1L_enum_maxval@ */ Scalar_UBYTE 0 SWC_OUTP_type_CM_uint8_enum 0.0 255.0 /end CHARACTERISTIC
/begin CHARACTERISTIC KOUTP_S1L_enum_minval "" VALUE 0x0000 /* @ECU_Address@KOUTP_S1L_enum_minval@ */ Scalar_UBYTE 0 SWC_OUTP_type_CM_uint8_enum 0.0 255.0 /end CHARACTERISTIC
/begin CHARACTERISTIC KOUTP_S1L_enum_ovrdval "" VALUE 0x0000 /* @ECU_Address@KOUTP_S1L_enum_ovrdval@ */ Scalar_UBYTE 0 SWC_OUTP_type_CM_uint8_enum 0.0 255.0 /end CHARACTERISTIC
/begin CHARACTERISTIC KOUTP_S2L_enum_maxval "" VALUE 0x0000 /* @ECU_Address@KOUTP_S2L_enum_maxval@ */ Scalar_UBYTE 0 SWC_OUTP_type_CM_uint8_enum 0.0 255.0 /end CHARACTERISTIC
/begin CHARACTERISTIC KOUTP_S2L_enum_minval "" VALUE 0x0000 /* @ECU_Address@KOUTP_S2L_enum_minval@ */ Scalar_UBYTE 0 SWC_OUTP_type_CM_uint8_enum 0.0 255.0 /end CHARACTERISTIC
/begin CHARACTERISTIC KOUTP_S2L_enum_ovrdval "" VALUE 0x0000 /* @ECU_Address@KOUTP_S2L_enum_ovrdval@ */ Scalar_UBYTE 0 SWC_OUTP_type_CM_uint8_enum 0.0 255.0 /end CHARACTERISTIC
/begin CHARACTERISTIC KOUTP_S3L_enum_maxval "" VALUE 0x0000 /* @ECU_Address@KOUTP_S3L_enum_maxval@ */ Scalar_UBYTE 0 SWC_OUTP_type_CM_uint8_enum 0.0 255.0 /end CHARACTERISTIC
/begin CHARACTERISTIC KOUTP_S3L_enum_minval "" VALUE 0x0000 /* @ECU_Address@KOUTP_S3L_enum_minval@ */ Scalar_UBYTE 0 SWC_OUTP_type_CM_uint8_enum 0.0 255.0 /end CHARACTERISTIC
/begin CHARACTERISTIC KOUTP_S3L_enum_ovrdval "" VALUE 0x0000 /* @ECU_Address@KOUTP_S3L_enum_ovrdval@ */ Scalar_UBYTE 0 SWC_OUTP_type_CM_uint8_enum 0.0 255.0 /end CHARACTERISTIC
/begin CHARACTERISTIC KOUTP_S4L_enum_maxval "" VALUE 0x0000 /* @ECU_Address@KOUTP_S4L_enum_maxval@ */ Scalar_UBYTE 0 SWC_OUTP_type_CM_uint8_enum 0.0 255.0 /end CHARACTERISTIC
/begin CHARACTERISTIC KOUTP_S4L_enum_minval "" VALUE 0x0000 /* @ECU_Address@KOUTP_S4L_enum_minval@ */ Scalar_UBYTE 0 SWC_OUTP_type_CM_uint8_enum 0.0 255.0 /end CHARACTERISTIC
/begin CHARACTERISTIC KOUTP_S4L_enum_ovrdval "" VALUE 0x0000 /* @ECU_Address@KOUTP_S4L_enum_ovrdval@ */ Scalar_UBYTE 0 SWC_OUTP_type_CM_uint8_enum 0.0 255.0 /end CHARACTERISTIC
/begin CHARACTERISTIC KOUTP_TPMSWarnIndi_enum_maxval "" VALUE 0x0000 /* @ECU_Address@KOUTP_TPMSWarnIndi_enum_maxval@ */ Scalar_UBYTE 0 SWC_OUTP_type_CM_uint8_enum 0.0 255.0 /end CHARACTERISTIC
/begin CHARACTERISTIC KOUTP_TPMSWarnIndi_enum_minval "" VALUE 0x0000 /* @ECU_Address@KOUTP_TPMSWarnIndi_enum_minval@ */ Scalar_UBYTE 0 SWC_OUTP_type_CM_uint8_enum 0.0 255.0 /end CHARACTERISTIC
/begin CHARACTERISTIC KOUTP_TPMSWarnIndi_enum_ovrdval "" VALUE 0x0000 /* @ECU_Address@KOUTP_TPMSWarnIndi_enum_ovrdval@ */ Scalar_UBYTE 0 SWC_OUTP_type_CM_uint8_enum 0.0 255.0 /end CHARACTERISTIC
/begin CHARACTERISTIC KOUTP_TUpAIND_enum_maxval "" VALUE 0x0000 /* @ECU_Address@KOUTP_TUpAIND_enum_maxval@ */ Scalar_UBYTE 0 SWC_OUTP_type_CM_uint8_enum 0.0 255.0 /end CHARACTERISTIC
/begin CHARACTERISTIC KOUTP_TUpAIND_enum_minval "" VALUE 0x0000 /* @ECU_Address@KOUTP_TUpAIND_enum_minval@ */ Scalar_UBYTE 0 SWC_OUTP_type_CM_uint8_enum 0.0 255.0 /end CHARACTERISTIC
/begin CHARACTERISTIC KOUTP_TUpAIND_enum_ovrdval "" VALUE 0x0000 /* @ECU_Address@KOUTP_TUpAIND_enum_ovrdval@ */ Scalar_UBYTE 0 SWC_OUTP_type_CM_uint8_enum 0.0 255.0 /end CHARACTERISTIC
/begin CHARACTERISTIC KOUTP_VCUEBSHBSw_enum_maxval "" VALUE 0x0000 /* @ECU_Address@KOUTP_VCUEBSHBSw_enum_maxval@ */ Scalar_UBYTE 0 SWC_OUTP_type_CM_uint8_enum 0.0 255.0 /end CHARACTERISTIC
/begin CHARACTERISTIC KOUTP_VCUEBSHBSw_enum_minval "" VALUE 0x0000 /* @ECU_Address@KOUTP_VCUEBSHBSw_enum_minval@ */ Scalar_UBYTE 0 SWC_OUTP_type_CM_uint8_enum 0.0 255.0 /end CHARACTERISTIC
/begin CHARACTERISTIC KOUTP_VCUEBSHBSw_enum_ovrdval "" VALUE 0x0000 /* @ECU_Address@KOUTP_VCUEBSHBSw_enum_ovrdval@ */ Scalar_UBYTE 0 SWC_OUTP_type_CM_uint8_enum 0.0 255.0 /end CHARACTERISTIC
/begin CHARACTERISTIC KOUTP_VCUEBSHHSw_enum_maxval "" VALUE 0x0000 /* @ECU_Address@KOUTP_VCUEBSHHSw_enum_maxval@ */ Scalar_UBYTE 0 SWC_OUTP_type_CM_uint8_enum 0.0 255.0 /end CHARACTERISTIC
/begin CHARACTERISTIC KOUTP_VCUEBSHHSw_enum_minval "" VALUE 0x0000 /* @ECU_Address@KOUTP_VCUEBSHHSw_enum_minval@ */ Scalar_UBYTE 0 SWC_OUTP_type_CM_uint8_enum 0.0 255.0 /end CHARACTERISTIC
/begin CHARACTERISTIC KOUTP_VCUEBSHHSw_enum_ovrdval "" VALUE 0x0000 /* @ECU_Address@KOUTP_VCUEBSHHSw_enum_ovrdval@ */ Scalar_UBYTE 0 SWC_OUTP_type_CM_uint8_enum 0.0 255.0 /end CHARACTERISTIC
/begin CHARACTERISTIC KOUTP_VCUEBSRd4BR_enum_maxval "" VALUE 0x0000 /* @ECU_Address@KOUTP_VCUEBSRd4BR_enum_maxval@ */ Scalar_UBYTE 0 SWC_OUTP_type_CM_uint8_enum 0.0 255.0 /end CHARACTERISTIC
/begin CHARACTERISTIC KOUTP_VCUEBSRd4BR_enum_minval "" VALUE 0x0000 /* @ECU_Address@KOUTP_VCUEBSRd4BR_enum_minval@ */ Scalar_UBYTE 0 SWC_OUTP_type_CM_uint8_enum 0.0 255.0 /end CHARACTERISTIC
/begin CHARACTERISTIC KOUTP_VCUEBSRd4BR_enum_ovrdval "" VALUE 0x0000 /* @ECU_Address@KOUTP_VCUEBSRd4BR_enum_ovrdval@ */ Scalar_UBYTE 0 SWC_OUTP_type_CM_uint8_enum 0.0 255.0 /end CHARACTERISTIC
/begin CHARACTERISTIC KOUTP_VCUMCUCtrlMdTQD_enum_maxval "" VALUE 0x0000 /* @ECU_Address@KOUTP_VCUMCUCtrlMdTQD_enum_maxval@ */ Scalar_UBYTE 0 SWC_OUTP_type_CM_uint8_enum 0.0 255.0 /end CHARACTERISTIC
/begin CHARACTERISTIC KOUTP_VCUMCUCtrlMdTQD_enum_minval "" VALUE 0x0000 /* @ECU_Address@KOUTP_VCUMCUCtrlMdTQD_enum_minval@ */ Scalar_UBYTE 0 SWC_OUTP_type_CM_uint8_enum 0.0 255.0 /end CHARACTERISTIC
/begin CHARACTERISTIC KOUTP_VCUMCUCtrlMdTQD_enum_ovrdval "" VALUE 0x0000 /* @ECU_Address@KOUTP_VCUMCUCtrlMdTQD_enum_ovrdval@ */ Scalar_UBYTE 0 SWC_OUTP_type_CM_uint8_enum 0.0 255.0 /end CHARACTERISTIC
/begin CHARACTERISTIC KOUTP_VCUMCUGearSta_enum_maxval "" VALUE 0x0000 /* @ECU_Address@KOUTP_VCUMCUGearSta_enum_maxval@ */ Scalar_UBYTE 0 SWC_OUTP_type_CM_uint8_enum 0.0 255.0 /end CHARACTERISTIC
/begin CHARACTERISTIC KOUTP_VCUMCUGearSta_enum_minval "" VALUE 0x0000 /* @ECU_Address@KOUTP_VCUMCUGearSta_enum_minval@ */ Scalar_UBYTE 0 SWC_OUTP_type_CM_uint8_enum 0.0 255.0 /end CHARACTERISTIC
/begin CHARACTERISTIC KOUTP_VCUMCUGearSta_enum_ovrdval "" VALUE 0x0000 /* @ECU_Address@KOUTP_VCUMCUGearSta_enum_ovrdval@ */ Scalar_UBYTE 0 SWC_OUTP_type_CM_uint8_enum 0.0 255.0 /end CHARACTERISTIC
/begin CHARACTERISTIC KOUTP_WritingCnt_enum_maxval "" VALUE 0x0000 /* @ECU_Address@KOUTP_WritingCnt_enum_maxval@ */ Scalar_UBYTE 0 SWC_OUTP_type_CM_uint8_enum 0.0 255.0 /end CHARACTERISTIC
/begin CHARACTERISTIC KOUTP_WritingCnt_enum_minval "" VALUE 0x0000 /* @ECU_Address@KOUTP_WritingCnt_enum_minval@ */ Scalar_UBYTE 0 SWC_OUTP_type_CM_uint8_enum 0.0 255.0 /end CHARACTERISTIC
/begin CHARACTERISTIC KOUTP_WritingCnt_enum_ovrdval "" VALUE 0x0000 /* @ECU_Address@KOUTP_WritingCnt_enum_ovrdval@ */ Scalar_UBYTE 0 SWC_OUTP_type_CM_uint8_enum 0.0 255.0 /end CHARACTERISTIC
/begin CHARACTERISTIC KOUTP_unlearnSfailvalid_enum_maxval "" VALUE 0x0000 /* @ECU_Address@KOUTP_unlearnSfailvalid_enum_maxval@ */ Scalar_UBYTE 0 SWC_OUTP_type_CM_uint8_enum 0.0 255.0 /end CHARACTERISTIC
/begin CHARACTERISTIC KOUTP_unlearnSfailvalid_enum_minval "" VALUE 0x0000 /* @ECU_Address@KOUTP_unlearnSfailvalid_enum_minval@ */ Scalar_UBYTE 0 SWC_OUTP_type_CM_uint8_enum 0.0 255.0 /end CHARACTERISTIC
/begin CHARACTERISTIC KOUTP_unlearnSfailvalid_enum_ovrdval "" VALUE 0x0000 /* @ECU_Address@KOUTP_unlearnSfailvalid_enum_ovrdval@ */ Scalar_UBYTE 0 SWC_OUTP_type_CM_uint8_enum 0.0 255.0 /end CHARACTERISTIC
/begin COMPU_METHOD SWC_OUTP_type_CM_single_mps2 "Q = V" RAT_FUNC "%8.6" "mps2" COEFFS 0 1 0 0 0 1 /end COMPU_METHOD
/begin COMPU_METHOD SWC_OUTP_type_CM_single_pct "Q = V" RAT_FUNC "%8.6" "pct" COEFFS 0 1 0 0 0 1 /end COMPU_METHOD
/begin COMPU_METHOD SWC_OUTP_type_CM_single_kph "Q = V" RAT_FUNC "%8.6" "kph" COEFFS 0 1 0 0 0 1 /end COMPU_METHOD
/begin COMPU_METHOD SWC_OUTP_type_CM_single_C "Q = V" RAT_FUNC "%8.6" "C" COEFFS 0 1 0 0 0 1 /end COMPU_METHOD
/begin COMPU_METHOD SWC_OUTP_type_CM_single_rpm "Q = V" RAT_FUNC "%8.6" "rpm" COEFFS 0 1 0 0 0 1 /end COMPU_METHOD
/begin COMPU_METHOD SWC_OUTP_type_CM_single_gain "Q = V" RAT_FUNC "%8.6" "gain" COEFFS 0 1 0 0 0 1 /end COMPU_METHOD
/begin COMPU_METHOD SWC_OUTP_type_CM_single_s "Q = V" RAT_FUNC "%8.6" "s" COEFFS 0 1 0 0 0 1 /end COMPU_METHOD
/begin COMPU_METHOD SWC_OUTP_type_CM_single_kgpm2 "Q = V" RAT_FUNC "%8.6" "kgpm2" COEFFS 0 1 0 0 0 1 /end COMPU_METHOD
/begin COMPU_METHOD SWC_OUTP_type_CM_single_Nm "Q = V" RAT_FUNC "%8.6" "Nm" COEFFS 0 1 0 0 0 1 /end COMPU_METHOD
/begin COMPU_METHOD SWC_OUTP_type_CM_single_enum "Q = V" RAT_FUNC "%8.6" "enum" COEFFS 0 1 0 0 0 1 /end COMPU_METHOD
/begin COMPU_METHOD SWC_OUTP_type_CM_uint32_raw32 "Q = V" RAT_FUNC "%10.0" "raw32" COEFFS 0 1 0 0 0 1 /end COMPU_METHOD
/begin COMPU_METHOD SWC_OUTP_type_CM_uint32_raw "Q = V" RAT_FUNC "%10.0" "raw" COEFFS 0 1 0 0 0 1 /end COMPU_METHOD
/begin COMPU_METHOD SWC_OUTP_type_CM_boolean_flg "Q = V" RAT_FUNC "%1.0" "flg" COEFFS 0 1 0 0 0 1 /end COMPU_METHOD
/begin COMPU_METHOD SWC_OUTP_type_CM_uint8_enum "Q = V" RAT_FUNC "%3.0" "enum" COEFFS 0 1 0 0 0 1 /end COMPU_METHOD
/begin COMPU_METHOD SWC_OUTP_type_CM_uint8_raw8 "Q = V" RAT_FUNC "%3.0" "raw8" COEFFS 0 1 0 0 0 1 /end COMPU_METHOD
/begin GROUP S715_Signal_Limit "SWC_OUTP_type/run_SWC_OUTP_5ms_sys/OUTP/outpmodule/VTPM_RRWheelDebug_flg_Inproc/Signal_Limit"
 /begin REF_CHARACTERISTIC KOUTP_RRWheelDebug_flg_maxval KOUTP_RRWheelDebug_flg_minval /end REF_CHARACTERISTIC
/end GROUP
/begin GROUP S715_Signal_Override "SWC_OUTP_type/run_SWC_OUTP_5ms_sys/OUTP/outpmodule/VTPM_RRWheelDebug_flg_Inproc/Signal_Override"
 /begin REF_CHARACTERISTIC KOUTP_RRWheelDebug_flg_ovrdflg KOUTP_RRWheelDebug_flg_ovrdval /end REF_CHARACTERISTIC
/end GROUP
/begin GROUP S716_Signal_Limit "SWC_OUTP_type/run_SWC_OUTP_5ms_sys/OUTP/outpmodule/VTPM_RRWheelPSW_raw8_Inproc/Signal_Limit" /begin REF_CHARACTERISTIC KOUTP_RRWheelPSW_raw8_maxval KOUTP_RRWheelPSW_raw8_minval /end REF_CHARACTERISTIC /end GROUP
/begin GROUP S716_Signal_Override "SWC_OUTP_type/run_SWC_OUTP_5ms_sys/OUTP/outpmodule/VTPM_RRWheelPSW_raw8_Inproc/Signal_Override"
 /begin REF_CHARACTERISTIC KOUTP_RRWheelPSW_raw8_ovrdflg KOUTP_RRWheelPSW_raw8_ovrdval /end REF_CHARACTERISTIC
/end GROUP
/begin GROUP S717_Signal_Limit "SWC_OUTP_type/run_SWC_OUTP_5ms_sys/OUTP/outpmodule/VTPM_RRWheelPress_raw8_Inproc/Signal_Limit"
 /begin REF_CHARACTERISTIC KOUTP_RRWheelPress_raw8_maxval KOUTP_RRWheelPress_raw8_minval /end REF_CHARACTERISTIC
/end GROUP
/begin GROUP S717_Signal_Override "SWC_OUTP_type/run_SWC_OUTP_5ms_sys/OUTP/outpmodule/VTPM_RRWheelPress_raw8_Inproc/Signal_Override"
 /begin REF_CHARACTERISTIC KOUTP_RRWheelPress_raw8_ovrdflg KOUTP_RRWheelPress_raw8_ovrdval /end REF_CHARACTERISTIC
/end GROUP
/begin GROUP S718_Signal_Limit "SWC_OUTP_type/run_SWC_OUTP_5ms_sys/OUTP/outpmodule/VTPM_RRWheelTemp_C_Inproc/Signal_Limit" /begin REF_CHARACTERISTIC KOUTP_RRWheelTemp_C_maxval KOUTP_RRWheelTemp_C_minval /end REF_CHARACTERISTIC /end GROUP
/begin GROUP S718_Signal_Override "SWC_OUTP_type/run_SWC_OUTP_5ms_sys/OUTP/outpmodule/VTPM_RRWheelTemp_C_Inproc/Signal_Override" /begin REF_CHARACTERISTIC KOUTP_RRWheelTemp_C_ovrdflg KOUTP_RRWheelTemp_C_ovrdval /end REF_CHARACTERISTIC /end GROUP
/begin GROUP S719_Signal_Limit "SWC_OUTP_type/run_SWC_OUTP_5ms_sys/OUTP/outpmodule/VTPM_RRWheelTmpIndi_flg_Inproc/Signal_Limit"
 /begin REF_CHARACTERISTIC KOUTP_RRWheelTmpIndi_flg_maxval KOUTP_RRWheelTmpIndi_flg_minval /end REF_CHARACTERISTIC
/end GROUP
/begin GROUP S719_Signal_Override "SWC_OUTP_type/run_SWC_OUTP_5ms_sys/OUTP/outpmodule/VTPM_RRWheelTmpIndi_flg_Inproc/Signal_Override"
 /begin REF_CHARACTERISTIC KOUTP_RRWheelTmpIndi_flg_ovrdflg KOUTP_RRWheelTmpIndi_flg_ovrdval /end REF_CHARACTERISTIC
/end GROUP
/begin GROUP S720_Signal_Limit "SWC_OUTP_type/run_SWC_OUTP_5ms_sys/OUTP/outpmodule/VTPM_S1ID_raw32_Inproc/Signal_Limit" /begin REF_CHARACTERISTIC KOUTP_S1ID_raw32_maxval KOUTP_S1ID_raw32_minval /end REF_CHARACTERISTIC /end GROUP
/begin GROUP S720_Signal_Override "SWC_OUTP_type/run_SWC_OUTP_5ms_sys/OUTP/outpmodule/VTPM_S1ID_raw32_Inproc/Signal_Override" /begin REF_CHARACTERISTIC KOUTP_S1ID_raw32_ovrdflg KOUTP_S1ID_raw32_ovrdval /end REF_CHARACTERISTIC /end GROUP
/begin GROUP S721_Signal_Limit "SWC_OUTP_type/run_SWC_OUTP_5ms_sys/OUTP/outpmodule/VTPM_S1L_enum_Inproc/Signal_Limit" /begin REF_CHARACTERISTIC KOUTP_S1L_enum_maxval KOUTP_S1L_enum_minval /end REF_CHARACTERISTIC /end GROUP
/begin GROUP S721_Signal_Override "SWC_OUTP_type/run_SWC_OUTP_5ms_sys/OUTP/outpmodule/VTPM_S1L_enum_Inproc/Signal_Override" /begin REF_CHARACTERISTIC KOUTP_S1L_enum_ovrdflg KOUTP_S1L_enum_ovrdval /end REF_CHARACTERISTIC /end GROUP
/begin GROUP S722_Signal_Limit "SWC_OUTP_type/run_SWC_OUTP_5ms_sys/OUTP/outpmodule/VTPM_S1WheelDebugALTU_pct_Inproc/Signal_Limit"
 /begin REF_CHARACTERISTIC KOUTP_S1WheelDebugALTU_pct_maxval KOUTP_S1WheelDebugALTU_pct_minval /end REF_CHARACTERISTIC
/end GROUP
/begin GROUP S722_Signal_Override "SWC_OUTP_type/run_SWC_OUTP_5ms_sys/OUTP/outpmodule/VTPM_S1WheelDebugALTU_pct_Inproc/Signal_Override"
 /begin REF_CHARACTERISTIC KOUTP_S1WheelDebugALTU_pct_ovrdflg KOUTP_S1WheelDebugALTU_pct_ovrdval /end REF_CHARACTERISTIC
/end GROUP
/begin GROUP S723_Signal_Limit "SWC_OUTP_type/run_SWC_OUTP_5ms_sys/OUTP/outpmodule/VTPM_S2ID_raw32_Inproc/Signal_Limit" /begin REF_CHARACTERISTIC KOUTP_S2ID_raw32_maxval KOUTP_S2ID_raw32_minval /end REF_CHARACTERISTIC /end GROUP
/begin GROUP S723_Signal_Override "SWC_OUTP_type/run_SWC_OUTP_5ms_sys/OUTP/outpmodule/VTPM_S2ID_raw32_Inproc/Signal_Override" /begin REF_CHARACTERISTIC KOUTP_S2ID_raw32_ovrdflg KOUTP_S2ID_raw32_ovrdval /end REF_CHARACTERISTIC /end GROUP
/begin GROUP S724_Signal_Limit "SWC_OUTP_type/run_SWC_OUTP_5ms_sys/OUTP/outpmodule/VTPM_S2L_enum_Inproc/Signal_Limit" /begin REF_CHARACTERISTIC KOUTP_S2L_enum_maxval KOUTP_S2L_enum_minval /end REF_CHARACTERISTIC /end GROUP
/begin GROUP S724_Signal_Override "SWC_OUTP_type/run_SWC_OUTP_5ms_sys/OUTP/outpmodule/VTPM_S2L_enum_Inproc/Signal_Override" /begin REF_CHARACTERISTIC KOUTP_S2L_enum_ovrdflg KOUTP_S2L_enum_ovrdval /end REF_CHARACTERISTIC /end GROUP
/begin GROUP S725_Signal_Limit "SWC_OUTP_type/run_SWC_OUTP_5ms_sys/OUTP/outpmodule/VTPM_S2WheelDebugALTU_pct_Inproc/Signal_Limit"
 /begin REF_CHARACTERISTIC KOUTP_S2WheelDebugALTU_pct_maxval KOUTP_S2WheelDebugALTU_pct_minval /end REF_CHARACTERISTIC
/end GROUP
/begin GROUP S725_Signal_Override "SWC_OUTP_type/run_SWC_OUTP_5ms_sys/OUTP/outpmodule/VTPM_S2WheelDebugALTU_pct_Inproc/Signal_Override"
 /begin REF_CHARACTERISTIC KOUTP_S2WheelDebugALTU_pct_ovrdflg KOUTP_S2WheelDebugALTU_pct_ovrdval /end REF_CHARACTERISTIC
/end GROUP
/begin GROUP S726_Signal_Limit "SWC_OUTP_type/run_SWC_OUTP_5ms_sys/OUTP/outpmodule/VTPM_S3ID_raw32_Inproc/Signal_Limit" /begin REF_CHARACTERISTIC KOUTP_S3ID_raw32_maxval KOUTP_S3ID_raw32_minval /end REF_CHARACTERISTIC /end GROUP
/begin GROUP S726_Signal_Override "SWC_OUTP_type/run_SWC_OUTP_5ms_sys/OUTP/outpmodule/VTPM_S3ID_raw32_Inproc/Signal_Override" /begin REF_CHARACTERISTIC KOUTP_S3ID_raw32_ovrdflg KOUTP_S3ID_raw32_ovrdval /end REF_CHARACTERISTIC /end GROUP
/begin GROUP S727_Signal_Limit "SWC_OUTP_type/run_SWC_OUTP_5ms_sys/OUTP/outpmodule/VTPM_S3L_enum_Inproc/Signal_Limit" /begin REF_CHARACTERISTIC KOUTP_S3L_enum_maxval KOUTP_S3L_enum_minval /end REF_CHARACTERISTIC /end GROUP
/begin GROUP S727_Signal_Override "SWC_OUTP_type/run_SWC_OUTP_5ms_sys/OUTP/outpmodule/VTPM_S3L_enum_Inproc/Signal_Override" /begin REF_CHARACTERISTIC KOUTP_S3L_enum_ovrdflg KOUTP_S3L_enum_ovrdval /end REF_CHARACTERISTIC /end GROUP
/begin GROUP S728_Signal_Limit "SWC_OUTP_type/run_SWC_OUTP_5ms_sys/OUTP/outpmodule/VTPM_S3WheelDebugALTU_pct_Inproc/Signal_Limit"
 /begin REF_CHARACTERISTIC KOUTP_S3WheelDebugALTU_pct_maxval KOUTP_S3WheelDebugALTU_pct_minval /end REF_CHARACTERISTIC
/end GROUP
/begin GROUP S728_Signal_Override "SWC_OUTP_type/run_SWC_OUTP_5ms_sys/OUTP/outpmodule/VTPM_S3WheelDebugALTU_pct_Inproc/Signal_Override"
 /begin REF_CHARACTERISTIC KOUTP_S3WheelDebugALTU_pct_ovrdflg KOUTP_S3WheelDebugALTU_pct_ovrdval /end REF_CHARACTERISTIC
/end GROUP
/begin GROUP S729_Signal_Limit "SWC_OUTP_type/run_SWC_OUTP_5ms_sys/OUTP/outpmodule/VTPM_S4ID_raw32_Inproc/Signal_Limit" /begin REF_CHARACTERISTIC KOUTP_S4ID_raw32_maxval KOUTP_S4ID_raw32_minval /end REF_CHARACTERISTIC /end GROUP
/begin GROUP S729_Signal_Override "SWC_OUTP_type/run_SWC_OUTP_5ms_sys/OUTP/outpmodule/VTPM_S4ID_raw32_Inproc/Signal_Override" /begin REF_CHARACTERISTIC KOUTP_S4ID_raw32_ovrdflg KOUTP_S4ID_raw32_ovrdval /end REF_CHARACTERISTIC /end GROUP
/begin GROUP S730_Signal_Limit "SWC_OUTP_type/run_SWC_OUTP_5ms_sys/OUTP/outpmodule/VTPM_S4L_enum_Inproc/Signal_Limit" /begin REF_CHARACTERISTIC KOUTP_S4L_enum_maxval KOUTP_S4L_enum_minval /end REF_CHARACTERISTIC /end GROUP
/begin GROUP S730_Signal_Override "SWC_OUTP_type/run_SWC_OUTP_5ms_sys/OUTP/outpmodule/VTPM_S4L_enum_Inproc/Signal_Override" /begin REF_CHARACTERISTIC KOUTP_S4L_enum_ovrdflg KOUTP_S4L_enum_ovrdval /end REF_CHARACTERISTIC /end GROUP
/begin GROUP S731_Signal_Limit "SWC_OUTP_type/run_SWC_OUTP_5ms_sys/OUTP/outpmodule/VTPM_S4WheelDebugALTU_pct_Inproc/Signal_Limit"
 /begin REF_CHARACTERISTIC KOUTP_S4WheelDebugALTU_pct_maxval KOUTP_S4WheelDebugALTU_pct_minval /end REF_CHARACTERISTIC
/end GROUP
/begin GROUP S731_Signal_Override "SWC_OUTP_type/run_SWC_OUTP_5ms_sys/OUTP/outpmodule/VTPM_S4WheelDebugALTU_pct_Inproc/Signal_Override"
 /begin REF_CHARACTERISTIC KOUTP_S4WheelDebugALTU_pct_ovrdflg KOUTP_S4WheelDebugALTU_pct_ovrdval /end REF_CHARACTERISTIC
/end GROUP
/begin GROUP S732_Signal_Limit "SWC_OUTP_type/run_SWC_OUTP_5ms_sys/OUTP/outpmodule/VTPM_SetIDLoc_flg_Inproc/Signal_Limit" /begin REF_CHARACTERISTIC KOUTP_SetIDLoc_flg_maxval KOUTP_SetIDLoc_flg_minval /end REF_CHARACTERISTIC /end GROUP
/begin GROUP S732_Signal_Override "SWC_OUTP_type/run_SWC_OUTP_5ms_sys/OUTP/outpmodule/VTPM_SetIDLoc_flg_Inproc/Signal_Override" /begin REF_CHARACTERISTIC KOUTP_SetIDLoc_flg_ovrdflg KOUTP_SetIDLoc_flg_ovrdval /end REF_CHARACTERISTIC /end GROUP
/begin GROUP S733_Signal_Limit "SWC_OUTP_type/run_SWC_OUTP_5ms_sys/OUTP/outpmodule/VTPM_TPMSCaliButtAllow_flg_Inproc/Signal_Limit"
 /begin REF_CHARACTERISTIC KOUTP_TPMSCaliButtAllow_flg_maxval KOUTP_TPMSCaliButtAllow_flg_minval /end REF_CHARACTERISTIC
/end GROUP
/begin GROUP S733_Signal_Override "SWC_OUTP_type/run_SWC_OUTP_5ms_sys/OUTP/outpmodule/VTPM_TPMSCaliButtAllow_flg_Inproc/Signal_Override"
 /begin REF_CHARACTERISTIC KOUTP_TPMSCaliButtAllow_flg_ovrdflg KOUTP_TPMSCaliButtAllow_flg_ovrdval /end REF_CHARACTERISTIC
/end GROUP
/begin GROUP S734_Signal_Limit "SWC_OUTP_type/run_SWC_OUTP_5ms_sys/OUTP/outpmodule/VTPM_TPMSResButtAllow_flg_Inproc/Signal_Limit"
 /begin REF_CHARACTERISTIC KOUTP_TPMSResButtAllow_flg_maxval KOUTP_TPMSResButtAllow_flg_minval /end REF_CHARACTERISTIC
/end GROUP
/begin GROUP S734_Signal_Override "SWC_OUTP_type/run_SWC_OUTP_5ms_sys/OUTP/outpmodule/VTPM_TPMSResButtAllow_flg_Inproc/Signal_Override"
 /begin REF_CHARACTERISTIC KOUTP_TPMSResButtAllow_flg_ovrdflg KOUTP_TPMSResButtAllow_flg_ovrdval /end REF_CHARACTERISTIC
/end GROUP
/begin GROUP S735_Signal_Limit "SWC_OUTP_type/run_SWC_OUTP_5ms_sys/OUTP/outpmodule/VTPM_TPMSResButt_flg_Inproc/Signal_Limit" /begin REF_CHARACTERISTIC KOUTP_TPMSResButt_flg_maxval KOUTP_TPMSResButt_flg_minval /end REF_CHARACTERISTIC /end GROUP
/begin GROUP S735_Signal_Override "SWC_OUTP_type/run_SWC_OUTP_5ms_sys/OUTP/outpmodule/VTPM_TPMSResButt_flg_Inproc/Signal_Override"
 /begin REF_CHARACTERISTIC KOUTP_TPMSResButt_flg_ovrdflg KOUTP_TPMSResButt_flg_ovrdval /end REF_CHARACTERISTIC
/end GROUP
/begin GROUP S736_Signal_Limit "SWC_OUTP_type/run_SWC_OUTP_5ms_sys/OUTP/outpmodule/VTPM_TPMSSensorIDRegStart_flg_Inproc/Signal_Limit"
 /begin REF_CHARACTERISTIC KOUTP_TPMSSensorIDRegStart_flg_maxval KOUTP_TPMSSensorIDRegStart_flg_minval /end REF_CHARACTERISTIC
/end GROUP
/begin GROUP S736_Signal_Override "SWC_OUTP_type/run_SWC_OUTP_5ms_sys/OUTP/outpmodule/VTPM_TPMSSensorIDRegStart_flg_Inproc/Signal_Override"
 /begin REF_CHARACTERISTIC KOUTP_TPMSSensorIDRegStart_flg_ovrdflg KOUTP_TPMSSensorIDRegStart_flg_ovrdval /end REF_CHARACTERISTIC
/end GROUP
/begin GROUP S737_Signal_Limit "SWC_OUTP_type/run_SWC_OUTP_5ms_sys/OUTP/outpmodule/VTPM_TPMSStorge_flg_Inproc/Signal_Limit" /begin REF_CHARACTERISTIC KOUTP_TPMSStorge_flg_maxval KOUTP_TPMSStorge_flg_minval /end REF_CHARACTERISTIC /end GROUP
/begin GROUP S737_Signal_Override "SWC_OUTP_type/run_SWC_OUTP_5ms_sys/OUTP/outpmodule/VTPM_TPMSStorge_flg_Inproc/Signal_Override" /begin REF_CHARACTERISTIC KOUTP_TPMSStorge_flg_ovrdflg KOUTP_TPMSStorge_flg_ovrdval /end REF_CHARACTERISTIC /end GROUP
/begin GROUP S738_Signal_Limit "SWC_OUTP_type/run_SWC_OUTP_5ms_sys/OUTP/outpmodule/VTPM_TPMSTLCmd_flg_Inproc/Signal_Limit" /begin REF_CHARACTERISTIC KOUTP_TPMSTLCmd_flg_maxval KOUTP_TPMSTLCmd_flg_minval /end REF_CHARACTERISTIC /end GROUP
/begin GROUP S738_Signal_Override "SWC_OUTP_type/run_SWC_OUTP_5ms_sys/OUTP/outpmodule/VTPM_TPMSTLCmd_flg_Inproc/Signal_Override" /begin REF_CHARACTERISTIC KOUTP_TPMSTLCmd_flg_ovrdflg KOUTP_TPMSTLCmd_flg_ovrdval /end REF_CHARACTERISTIC /end GROUP
/begin GROUP S739_Signal_Limit "SWC_OUTP_type/run_SWC_OUTP_5ms_sys/OUTP/outpmodule/VTPM_TPMSWarnIndi_enum_Inproc/Signal_Limit"
 /begin REF_CHARACTERISTIC KOUTP_TPMSWarnIndi_enum_maxval KOUTP_TPMSWarnIndi_enum_minval /end REF_CHARACTERISTIC
/end GROUP
/begin GROUP S739_Signal_Override "SWC_OUTP_type/run_SWC_OUTP_5ms_sys/OUTP/outpmodule/VTPM_TPMSWarnIndi_enum_Inproc/Signal_Override"
 /begin REF_CHARACTERISTIC KOUTP_TPMSWarnIndi_enum_ovrdflg KOUTP_TPMSWarnIndi_enum_ovrdval /end REF_CHARACTERISTIC
/end GROUP
/begin GROUP S740_Signal_Limit "SWC_OUTP_type/run_SWC_OUTP_5ms_sys/OUTP/outpmodule/VTPM_WriteChkLFID_raw_Inproc/Signal_Limit"
 /begin REF_CHARACTERISTIC KOUTP_WriteChkLFID_raw_maxval KOUTP_WriteChkLFID_raw_minval /end REF_CHARACTERISTIC
/end GROUP
/begin GROUP S740_Signal_Override "SWC_OUTP_type/run_SWC_OUTP_5ms_sys/OUTP/outpmodule/VTPM_WriteChkLFID_raw_Inproc/Signal_Override"
 /begin REF_CHARACTERISTIC KOUTP_WriteChkLFID_raw_ovrdflg KOUTP_WriteChkLFID_raw_ovrdval /end REF_CHARACTERISTIC
/end GROUP
/begin GROUP S741_Signal_Limit "SWC_OUTP_type/run_SWC_OUTP_5ms_sys/OUTP/outpmodule/VTPM_WriteChkLRID_raw_Inproc/Signal_Limit"
 /begin REF_CHARACTERISTIC KOUTP_WriteChkLRID_raw_maxval KOUTP_WriteChkLRID_raw_minval /end REF_CHARACTERISTIC
/end GROUP
/begin GROUP S741_Signal_Override "SWC_OUTP_type/run_SWC_OUTP_5ms_sys/OUTP/outpmodule/VTPM_WriteChkLRID_raw_Inproc/Signal_Override"
 /begin REF_CHARACTERISTIC KOUTP_WriteChkLRID_raw_ovrdflg KOUTP_WriteChkLRID_raw_ovrdval /end REF_CHARACTERISTIC
/end GROUP
/begin GROUP S742_Signal_Limit "SWC_OUTP_type/run_SWC_OUTP_5ms_sys/OUTP/outpmodule/VTPM_WriteChkRFID_raw_Inproc/Signal_Limit"
 /begin REF_CHARACTERISTIC KOUTP_WriteChkRFID_raw_maxval KOUTP_WriteChkRFID_raw_minval /end REF_CHARACTERISTIC
/end GROUP
/begin GROUP S742_Signal_Override "SWC_OUTP_type/run_SWC_OUTP_5ms_sys/OUTP/outpmodule/VTPM_WriteChkRFID_raw_Inproc/Signal_Override"
 /begin REF_CHARACTERISTIC KOUTP_WriteChkRFID_raw_ovrdflg KOUTP_WriteChkRFID_raw_ovrdval /end REF_CHARACTERISTIC
/end GROUP
/begin GROUP S743_Signal_Limit "SWC_OUTP_type/run_SWC_OUTP_5ms_sys/OUTP/outpmodule/VTPM_WriteChkRRID_raw_Inproc/Signal_Limit"
 /begin REF_CHARACTERISTIC KOUTP_WriteChkRRID_raw_maxval KOUTP_WriteChkRRID_raw_minval /end REF_CHARACTERISTIC
/end GROUP
/begin GROUP S743_Signal_Override "SWC_OUTP_type/run_SWC_OUTP_5ms_sys/OUTP/outpmodule/VTPM_WriteChkRRID_raw_Inproc/Signal_Override"
 /begin REF_CHARACTERISTIC KOUTP_WriteChkRRID_raw_ovrdflg KOUTP_WriteChkRRID_raw_ovrdval /end REF_CHARACTERISTIC
/end GROUP
/begin GROUP S744_Signal_Limit "SWC_OUTP_type/run_SWC_OUTP_5ms_sys/OUTP/outpmodule/VTPM_WriteChkfinLFID_raw_Inproc/Signal_Limit"
 /begin REF_CHARACTERISTIC KOUTP_WriteChkfinLFID_raw_maxval KOUTP_WriteChkfinLFID_raw_minval /end REF_CHARACTERISTIC
/end GROUP
/begin GROUP S744_Signal_Override "SWC_OUTP_type/run_SWC_OUTP_5ms_sys/OUTP/outpmodule/VTPM_WriteChkfinLFID_raw_Inproc/Signal_Override"
 /begin REF_CHARACTERISTIC KOUTP_WriteChkfinLFID_raw_ovrdflg KOUTP_WriteChkfinLFID_raw_ovrdval /end REF_CHARACTERISTIC
/end GROUP
/begin GROUP S745_Signal_Limit "SWC_OUTP_type/run_SWC_OUTP_5ms_sys/OUTP/outpmodule/VTPM_WriteChkfinLRID_raw_Inproc/Signal_Limit"
 /begin REF_CHARACTERISTIC KOUTP_WriteChkfinLRID_raw_maxval KOUTP_WriteChkfinLRID_raw_minval /end REF_CHARACTERISTIC
/end GROUP
/begin GROUP S745_Signal_Override "SWC_OUTP_type/run_SWC_OUTP_5ms_sys/OUTP/outpmodule/VTPM_WriteChkfinLRID_raw_Inproc/Signal_Override"
 /begin REF_CHARACTERISTIC KOUTP_WriteChkfinLRID_raw_ovrdflg KOUTP_WriteChkfinLRID_raw_ovrdval /end REF_CHARACTERISTIC
/end GROUP
/begin GROUP S746_Signal_Limit "SWC_OUTP_type/run_SWC_OUTP_5ms_sys/OUTP/outpmodule/VTPM_WriteChkfinRFID_raw_Inproc/Signal_Limit"
 /begin REF_CHARACTERISTIC KOUTP_WriteChkfinRFID_raw_maxval KOUTP_WriteChkfinRFID_raw_minval /end REF_CHARACTERISTIC
/end GROUP
/begin GROUP S746_Signal_Override "SWC_OUTP_type/run_SWC_OUTP_5ms_sys/OUTP/outpmodule/VTPM_WriteChkfinRFID_raw_Inproc/Signal_Override"
 /begin REF_CHARACTERISTIC KOUTP_WriteChkfinRFID_raw_ovrdflg KOUTP_WriteChkfinRFID_raw_ovrdval /end REF_CHARACTERISTIC
/end GROUP
/begin GROUP S747_Signal_Limit "SWC_OUTP_type/run_SWC_OUTP_5ms_sys/OUTP/outpmodule/VTPM_WriteChkfinRRID_raw_Inproc/Signal_Limit"
 /begin REF_CHARACTERISTIC KOUTP_WriteChkfinRRID_raw_maxval KOUTP_WriteChkfinRRID_raw_minval /end REF_CHARACTERISTIC
/end GROUP
/begin GROUP S747_Signal_Override "SWC_OUTP_type/run_SWC_OUTP_5ms_sys/OUTP/outpmodule/VTPM_WriteChkfinRRID_raw_Inproc/Signal_Override"
 /begin REF_CHARACTERISTIC KOUTP_WriteChkfinRRID_raw_ovrdflg KOUTP_WriteChkfinRRID_raw_ovrdval /end REF_CHARACTERISTIC
/end GROUP
/begin GROUP S748_Signal_Limit "SWC_OUTP_type/run_SWC_OUTP_5ms_sys/OUTP/outpmodule/VTPM_WritingCnt_enum_Inproc/Signal_Limit" /begin REF_CHARACTERISTIC KOUTP_WritingCnt_enum_maxval KOUTP_WritingCnt_enum_minval /end REF_CHARACTERISTIC /end GROUP
/begin GROUP S748_Signal_Override "SWC_OUTP_type/run_SWC_OUTP_5ms_sys/OUTP/outpmodule/VTPM_WritingCnt_enum_Inproc/Signal_Override"
 /begin REF_CHARACTERISTIC KOUTP_WritingCnt_enum_ovrdflg KOUTP_WritingCnt_enum_ovrdval /end REF_CHARACTERISTIC
/end GROUP
/begin GROUP S749_Signal_Limit "SWC_OUTP_type/run_SWC_OUTP_5ms_sys/OUTP/outpmodule/VTPM_unlearnSfailvalid_enum_Inproc/Signal_Limit"
 /begin REF_CHARACTERISTIC KOUTP_unlearnSfailvalid_enum_maxval KOUTP_unlearnSfailvalid_enum_minval /end REF_CHARACTERISTIC
/end GROUP
/begin GROUP S749_Signal_Override "SWC_OUTP_type/run_SWC_OUTP_5ms_sys/OUTP/outpmodule/VTPM_unlearnSfailvalid_enum_Inproc/Signal_Override"
 /begin REF_CHARACTERISTIC KOUTP_unlearnSfailvalid_enum_ovrdflg KOUTP_unlearnSfailvalid_enum_ovrdval /end REF_CHARACTERISTIC
/end GROUP
/begin GROUP S750_Signal_Limit "SWC_OUTP_type/run_SWC_OUTP_5ms_sys/OUTP/outpmodule/VTPM_unlearnSfali_flg_Inproc/Signal_Limit"
 /begin REF_CHARACTERISTIC KOUTP_unlearnSfali_flg_maxval KOUTP_unlearnSfali_flg_minval /end REF_CHARACTERISTIC
/end GROUP
/begin GROUP S750_Signal_Override "SWC_OUTP_type/run_SWC_OUTP_5ms_sys/OUTP/outpmodule/VTPM_unlearnSfali_flg_Inproc/Signal_Override"
 /begin REF_CHARACTERISTIC KOUTP_unlearnSfali_flg_ovrdflg KOUTP_unlearnSfali_flg_ovrdval /end REF_CHARACTERISTIC
/end GROUP
/begin GROUP S751_Signal_Limit "SWC_OUTP_type/run_SWC_OUTP_5ms_sys/OUTP/outpmodule/VTQD_ActDriveMode_enum_Inproc/Signal_Limit"
 /begin REF_CHARACTERISTIC KOUTP_ActDriveMode_enum_maxval KOUTP_ActDriveMode_enum_minval /end REF_CHARACTERISTIC
/end GROUP
/begin GROUP S751_Signal_Override "SWC_OUTP_type/run_SWC_OUTP_5ms_sys/OUTP/outpmodule/VTQD_ActDriveMode_enum_Inproc/Signal_Override"
 /begin REF_CHARACTERISTIC KOUTP_ActDriveMode_enum_ovrdflg KOUTP_ActDriveMode_enum_ovrdval /end REF_CHARACTERISTIC
/end GROUP
/begin GROUP S752_Signal_Limit "SWC_OUTP_type/run_SWC_OUTP_5ms_sys/OUTP/outpmodule/VTQD_ActTUpAIND_enum_Inproc/Signal_Limit" /begin REF_CHARACTERISTIC KOUTP_ActTUpAIND_enum_maxval KOUTP_ActTUpAIND_enum_minval /end REF_CHARACTERISTIC /end GROUP
/begin GROUP S752_Signal_Override "SWC_OUTP_type/run_SWC_OUTP_5ms_sys/OUTP/outpmodule/VTQD_ActTUpAIND_enum_Inproc/Signal_Override"
 /begin REF_CHARACTERISTIC KOUTP_ActTUpAIND_enum_ovrdflg KOUTP_ActTUpAIND_enum_ovrdval /end REF_CHARACTERISTIC
/end GROUP
/begin GROUP S753_Signal_Limit "SWC_OUTP_type/run_SWC_OUTP_5ms_sys/OUTP/outpmodule/VTQD_CreepIND_enum_Inproc/Signal_Limit" /begin REF_CHARACTERISTIC KOUTP_CreepIND_enum_maxval KOUTP_CreepIND_enum_minval /end REF_CHARACTERISTIC /end GROUP
/begin GROUP S753_Signal_Override "SWC_OUTP_type/run_SWC_OUTP_5ms_sys/OUTP/outpmodule/VTQD_CreepIND_enum_Inproc/Signal_Override" /begin REF_CHARACTERISTIC KOUTP_CreepIND_enum_ovrdflg KOUTP_CreepIND_enum_ovrdval /end REF_CHARACTERISTIC /end GROUP
/begin GROUP S754_Signal_Limit "SWC_OUTP_type/run_SWC_OUTP_5ms_sys/OUTP/outpmodule/VTQD_CreepSpdReq_rpm_Inproc/Signal_Limit" /begin REF_CHARACTERISTIC KOUTP_CreepSpdReq_rpm_maxval KOUTP_CreepSpdReq_rpm_minval /end REF_CHARACTERISTIC /end GROUP
/begin GROUP S754_Signal_Override "SWC_OUTP_type/run_SWC_OUTP_5ms_sys/OUTP/outpmodule/VTQD_CreepSpdReq_rpm_Inproc/Signal_Override"
 /begin REF_CHARACTERISTIC KOUTP_CreepSpdReq_rpm_ovrdflg KOUTP_CreepSpdReq_rpm_ovrdval /end REF_CHARACTERISTIC
/end GROUP
/begin GROUP S755_Signal_Limit "SWC_OUTP_type/run_SWC_OUTP_5ms_sys/OUTP/outpmodule/VTQD_EC1EMDefTrqLmt_rpm_Inproc/Signal_Limit"
 /begin REF_CHARACTERISTIC KOUTP_EC1EMDefTrqLmt_rpm_maxval KOUTP_EC1EMDefTrqLmt_rpm_minval /end REF_CHARACTERISTIC
/end GROUP
/begin GROUP S755_Signal_Override "SWC_OUTP_type/run_SWC_OUTP_5ms_sys/OUTP/outpmodule/VTQD_EC1EMDefTrqLmt_rpm_Inproc/Signal_Override"
 /begin REF_CHARACTERISTIC KOUTP_EC1EMDefTrqLmt_rpm_ovrdflg KOUTP_EC1EMDefTrqLmt_rpm_ovrdval /end REF_CHARACTERISTIC
/end GROUP
/begin GROUP S756_Signal_Limit "SWC_OUTP_type/run_SWC_OUTP_5ms_sys/OUTP/outpmodule/VTQD_EC1EMExtRSCtrlUpLmt_rpm_Inproc/Signal_Limit"
 /begin REF_CHARACTERISTIC KOUTP_EC1EMExtRSCtrlUpLmt_rpm_maxval KOUTP_EC1EMExtRSCtrlUpLmt_rpm_minval /end REF_CHARACTERISTIC
/end GROUP
/begin GROUP S756_Signal_Override "SWC_OUTP_type/run_SWC_OUTP_5ms_sys/OUTP/outpmodule/VTQD_EC1EMExtRSCtrlUpLmt_rpm_Inproc/Signal_Override"
 /begin REF_CHARACTERISTIC KOUTP_EC1EMExtRSCtrlUpLmt_rpm_ovrdflg KOUTP_EC1EMExtRSCtrlUpLmt_rpm_ovrdval /end REF_CHARACTERISTIC
/end GROUP
/begin GROUP S757_Signal_Limit "SWC_OUTP_type/run_SWC_OUTP_5ms_sys/OUTP/outpmodule/VTQD_EC1EMGainEndSpdGvn_gain_Inproc/Signal_Limit"
 /begin REF_CHARACTERISTIC KOUTP_EC1EMGainEndSpdGvn_gain_maxval KOUTP_EC1EMGainEndSpdGvn_gain_minval /end REF_CHARACTERISTIC
/end GROUP
/begin GROUP S757_Signal_Override "SWC_OUTP_type/run_SWC_OUTP_5ms_sys/OUTP/outpmodule/VTQD_EC1EMGainEndSpdGvn_gain_Inproc/Signal_Override"
 /begin REF_CHARACTERISTIC KOUTP_EC1EMGainEndSpdGvn_gain_ovrdflg KOUTP_EC1EMGainEndSpdGvn_gain_ovrdval /end REF_CHARACTERISTIC
/end GROUP
/begin GROUP S758_Signal_Limit "SWC_OUTP_type/run_SWC_OUTP_5ms_sys/OUTP/outpmodule/VTQD_EC1EMMaxMEngOvrSP7_rpm_Inproc/Signal_Limit"
 /begin REF_CHARACTERISTIC KOUTP_EC1EMMaxMEngOvrSP7_rpm_maxval KOUTP_EC1EMMaxMEngOvrSP7_rpm_minval /end REF_CHARACTERISTIC
/end GROUP
/begin GROUP S758_Signal_Override "SWC_OUTP_type/run_SWC_OUTP_5ms_sys/OUTP/outpmodule/VTQD_EC1EMMaxMEngOvrSP7_rpm_Inproc/Signal_Override"
 /begin REF_CHARACTERISTIC KOUTP_EC1EMMaxMEngOvrSP7_rpm_ovrdflg KOUTP_EC1EMMaxMEngOvrSP7_rpm_ovrdval /end REF_CHARACTERISTIC
/end GROUP
/begin GROUP S759_Signal_Limit "SWC_OUTP_type/run_SWC_OUTP_5ms_sys/OUTP/outpmodule/VTQD_EC1EMMaxMOvrTmt_s_Inproc/Signal_Limit"
 /begin REF_CHARACTERISTIC KOUTP_EC1EMMaxMOvrTmt_s_maxval KOUTP_EC1EMMaxMOvrTmt_s_minval /end REF_CHARACTERISTIC
/end GROUP
/begin GROUP S759_Signal_Override "SWC_OUTP_type/run_SWC_OUTP_5ms_sys/OUTP/outpmodule/VTQD_EC1EMMaxMOvrTmt_s_Inproc/Signal_Override"
 /begin REF_CHARACTERISTIC KOUTP_EC1EMMaxMOvrTmt_s_ovrdflg KOUTP_EC1EMMaxMOvrTmt_s_ovrdval /end REF_CHARACTERISTIC
/end GROUP
/begin GROUP S760_Signal_Limit "SWC_OUTP_type/run_SWC_OUTP_5ms_sys/OUTP/outpmodule/VTQD_EC1EMMomOfInertia_kgpm2_Inproc/Signal_Limit"
 /begin REF_CHARACTERISTIC KOUTP_EC1EMMomOfInertia_kgpm2_maxval KOUTP_EC1EMMomOfInertia_kgpm2_minval /end REF_CHARACTERISTIC
/end GROUP
/begin GROUP S760_Signal_Override "SWC_OUTP_type/run_SWC_OUTP_5ms_sys/OUTP/outpmodule/VTQD_EC1EMMomOfInertia_kgpm2_Inproc/Signal_Override"
 /begin REF_CHARACTERISTIC KOUTP_EC1EMMomOfInertia_kgpm2_ovrdflg KOUTP_EC1EMMomOfInertia_kgpm2_ovrdval /end REF_CHARACTERISTIC
/end GROUP
/begin GROUP S761_Signal_Limit "SWC_OUTP_type/run_SWC_OUTP_5ms_sys/OUTP/outpmodule/VTQD_EC1EMRefTorq_Nm_Inproc/Signal_Limit" /begin REF_CHARACTERISTIC KOUTP_EC1EMRefTorq_Nm_maxval KOUTP_EC1EMRefTorq_Nm_minval /end REF_CHARACTERISTIC /end GROUP
/begin GROUP S761_Signal_Override "SWC_OUTP_type/run_SWC_OUTP_5ms_sys/OUTP/outpmodule/VTQD_EC1EMRefTorq_Nm_Inproc/Signal_Override"
 /begin REF_CHARACTERISTIC KOUTP_EC1EMRefTorq_Nm_ovrdflg KOUTP_EC1EMRefTorq_Nm_ovrdval /end REF_CHARACTERISTIC
/end GROUP
/begin GROUP S762_Signal_Limit "SWC_OUTP_type/run_SWC_OUTP_5ms_sys/OUTP/outpmodule/VTQD_EC1EMReqSpdCtrlLoLmt_rpm_Inproc/Signal_Limit"
 /begin REF_CHARACTERISTIC KOUTP_EC1EMReqSpdCtrlLoLmt_rpm_maxval KOUTP_EC1EMReqSpdCtrlLoLmt_rpm_minval /end REF_CHARACTERISTIC
/end GROUP
/begin GROUP S762_Signal_Override "SWC_OUTP_type/run_SWC_OUTP_5ms_sys/OUTP/outpmodule/VTQD_EC1EMReqSpdCtrlLoLmt_rpm_Inproc/Signal_Override"
 /begin REF_CHARACTERISTIC KOUTP_EC1EMReqSpdCtrlLoLmt_rpm_ovrdflg KOUTP_EC1EMReqSpdCtrlLoLmt_rpm_ovrdval /end REF_CHARACTERISTIC
/end GROUP
/begin GROUP S763_Signal_Limit "SWC_OUTP_type/run_SWC_OUTP_5ms_sys/OUTP/outpmodule/VTQD_EC1EMReqSpdCtrlUpLmt_rpm_Inproc/Signal_Limit"
 /begin REF_CHARACTERISTIC KOUTP_EC1EMReqSpdCtrlUpLmt_rpm_maxval KOUTP_EC1EMReqSpdCtrlUpLmt_rpm_minval /end REF_CHARACTERISTIC
/end GROUP
/begin GROUP S763_Signal_Override "SWC_OUTP_type/run_SWC_OUTP_5ms_sys/OUTP/outpmodule/VTQD_EC1EMReqSpdCtrlUpLmt_rpm_Inproc/Signal_Override"
 /begin REF_CHARACTERISTIC KOUTP_EC1EMReqSpdCtrlUpLmt_rpm_ovrdflg KOUTP_EC1EMReqSpdCtrlUpLmt_rpm_ovrdval /end REF_CHARACTERISTIC
/end GROUP
/begin GROUP S764_Signal_Limit "SWC_OUTP_type/run_SWC_OUTP_5ms_sys/OUTP/outpmodule/VTQD_EC1EMReqTrqCtrlLoLmt_pct_Inproc/Signal_Limit"
 /begin REF_CHARACTERISTIC KOUTP_EC1EMReqTrqCtrlLoLmt_pct_maxval KOUTP_EC1EMReqTrqCtrlLoLmt_pct_minval /end REF_CHARACTERISTIC
/end GROUP
/begin GROUP S764_Signal_Override "SWC_OUTP_type/run_SWC_OUTP_5ms_sys/OUTP/outpmodule/VTQD_EC1EMReqTrqCtrlLoLmt_pct_Inproc/Signal_Override"
 /begin REF_CHARACTERISTIC KOUTP_EC1EMReqTrqCtrlLoLmt_pct_ovrdflg KOUTP_EC1EMReqTrqCtrlLoLmt_pct_ovrdval /end REF_CHARACTERISTIC
/end GROUP
/begin GROUP S765_Signal_Limit "SWC_OUTP_type/run_SWC_OUTP_5ms_sys/OUTP/outpmodule/VTQD_EC1EMReqTrqCtrlUpLmt_pct_Inproc/Signal_Limit"
 /begin REF_CHARACTERISTIC KOUTP_EC1EMReqTrqCtrlUpLmt_pct_maxval KOUTP_EC1EMReqTrqCtrlUpLmt_pct_minval /end REF_CHARACTERISTIC
/end GROUP
/begin GROUP S765_Signal_Override "SWC_OUTP_type/run_SWC_OUTP_5ms_sys/OUTP/outpmodule/VTQD_EC1EMReqTrqCtrlUpLmt_pct_Inproc/Signal_Override"
 /begin REF_CHARACTERISTIC KOUTP_EC1EMReqTrqCtrlUpLmt_pct_ovrdflg KOUTP_EC1EMReqTrqCtrlUpLmt_pct_ovrdval /end REF_CHARACTERISTIC
/end GROUP
/begin GROUP S766_Signal_Limit "SWC_OUTP_type/run_SWC_OUTP_5ms_sys/OUTP/outpmodule/VTQD_EC1EMSpdHdleP6_rpm_Inproc/Signal_Limit"
 /begin REF_CHARACTERISTIC KOUTP_EC1EMSpdHdleP6_rpm_maxval KOUTP_EC1EMSpdHdleP6_rpm_minval /end REF_CHARACTERISTIC
/end GROUP
/begin GROUP S766_Signal_Override "SWC_OUTP_type/run_SWC_OUTP_5ms_sys/OUTP/outpmodule/VTQD_EC1EMSpdHdleP6_rpm_Inproc/Signal_Override"
 /begin REF_CHARACTERISTIC KOUTP_EC1EMSpdHdleP6_rpm_ovrdflg KOUTP_EC1EMSpdHdleP6_rpm_ovrdval /end REF_CHARACTERISTIC
/end GROUP
/begin GROUP S767_Signal_Limit "SWC_OUTP_type/run_SWC_OUTP_5ms_sys/OUTP/outpmodule/VTQD_EC1EMSpdIdleP1_rpm_Inproc/Signal_Limit"
 /begin REF_CHARACTERISTIC KOUTP_EC1EMSpdIdleP1_rpm_maxval KOUTP_EC1EMSpdIdleP1_rpm_minval /end REF_CHARACTERISTIC
/end GROUP
/begin GROUP S767_Signal_Override "SWC_OUTP_type/run_SWC_OUTP_5ms_sys/OUTP/outpmodule/VTQD_EC1EMSpdIdleP1_rpm_Inproc/Signal_Override"
 /begin REF_CHARACTERISTIC KOUTP_EC1EMSpdIdleP1_rpm_ovrdflg KOUTP_EC1EMSpdIdleP1_rpm_ovrdval /end REF_CHARACTERISTIC
/end GROUP
/begin GROUP S768_Signal_Limit "SWC_OUTP_type/run_SWC_OUTP_5ms_sys/OUTP/outpmodule/VTQD_EC1EMSpdIdleP2_rpm_Inproc/Signal_Limit"
 /begin REF_CHARACTERISTIC KOUTP_EC1EMSpdIdleP2_rpm_maxval KOUTP_EC1EMSpdIdleP2_rpm_minval /end REF_CHARACTERISTIC
/end GROUP
/begin GROUP S768_Signal_Override "SWC_OUTP_type/run_SWC_OUTP_5ms_sys/OUTP/outpmodule/VTQD_EC1EMSpdIdleP2_rpm_Inproc/Signal_Override"
 /begin REF_CHARACTERISTIC KOUTP_EC1EMSpdIdleP2_rpm_ovrdflg KOUTP_EC1EMSpdIdleP2_rpm_ovrdval /end REF_CHARACTERISTIC
/end GROUP
/begin GROUP S769_Signal_Limit "SWC_OUTP_type/run_SWC_OUTP_5ms_sys/OUTP/outpmodule/VTQD_EC1EMSpdIdleP3_rpm_Inproc/Signal_Limit"
 /begin REF_CHARACTERISTIC KOUTP_EC1EMSpdIdleP3_rpm_maxval KOUTP_EC1EMSpdIdleP3_rpm_minval /end REF_CHARACTERISTIC
/end GROUP
/begin GROUP S769_Signal_Override "SWC_OUTP_type/run_SWC_OUTP_5ms_sys/OUTP/outpmodule/VTQD_EC1EMSpdIdleP3_rpm_Inproc/Signal_Override"
 /begin REF_CHARACTERISTIC KOUTP_EC1EMSpdIdleP3_rpm_ovrdflg KOUTP_EC1EMSpdIdleP3_rpm_ovrdval /end REF_CHARACTERISTIC
/end GROUP
/begin GROUP S770_Signal_Limit "SWC_OUTP_type/run_SWC_OUTP_5ms_sys/OUTP/outpmodule/VTQD_EC1EMSpdIdleP4_rpm_Inproc/Signal_Limit"
 /begin REF_CHARACTERISTIC KOUTP_EC1EMSpdIdleP4_rpm_maxval KOUTP_EC1EMSpdIdleP4_rpm_minval /end REF_CHARACTERISTIC
/end GROUP
/begin GROUP S770_Signal_Override "SWC_OUTP_type/run_SWC_OUTP_5ms_sys/OUTP/outpmodule/VTQD_EC1EMSpdIdleP4_rpm_Inproc/Signal_Override"
 /begin REF_CHARACTERISTIC KOUTP_EC1EMSpdIdleP4_rpm_ovrdflg KOUTP_EC1EMSpdIdleP4_rpm_ovrdval /end REF_CHARACTERISTIC
/end GROUP
/begin GROUP S771_Signal_Limit "SWC_OUTP_type/run_SWC_OUTP_5ms_sys/OUTP/outpmodule/VTQD_EC1EMSpdIdleP5_rpm_Inproc/Signal_Limit"
 /begin REF_CHARACTERISTIC KOUTP_EC1EMSpdIdleP5_rpm_maxval KOUTP_EC1EMSpdIdleP5_rpm_minval /end REF_CHARACTERISTIC
/end GROUP
/begin GROUP S771_Signal_Override "SWC_OUTP_type/run_SWC_OUTP_5ms_sys/OUTP/outpmodule/VTQD_EC1EMSpdIdleP5_rpm_Inproc/Signal_Override"
 /begin REF_CHARACTERISTIC KOUTP_EC1EMSpdIdleP5_rpm_ovrdflg KOUTP_EC1EMSpdIdleP5_rpm_ovrdval /end REF_CHARACTERISTIC
/end GROUP
/begin GROUP S772_Signal_Limit "SWC_OUTP_type/run_SWC_OUTP_5ms_sys/OUTP/outpmodule/VTQD_EC1EMSupTSC1CtrlPG1_cnt_Inproc/Signal_Limit"
 /begin REF_CHARACTERISTIC KOUTP_EC1EMSupTSC1CtrlPG1_cnt_maxval KOUTP_EC1EMSupTSC1CtrlPG1_cnt_minval /end REF_CHARACTERISTIC
/end GROUP
/begin GROUP S772_Signal_Override "SWC_OUTP_type/run_SWC_OUTP_5ms_sys/OUTP/outpmodule/VTQD_EC1EMSupTSC1CtrlPG1_cnt_Inproc/Signal_Override"
 /begin REF_CHARACTERISTIC KOUTP_EC1EMSupTSC1CtrlPG1_cnt_ovrdflg KOUTP_EC1EMSupTSC1CtrlPG1_cnt_ovrdval /end REF_CHARACTERISTIC
/end GROUP
/begin GROUP S773_Signal_Limit "SWC_OUTP_type/run_SWC_OUTP_5ms_sys/OUTP/outpmodule/VTQD_EC1EMSupTSC1CtrlPG2_cnt_Inproc/Signal_Limit"
 /begin REF_CHARACTERISTIC KOUTP_EC1EMSupTSC1CtrlPG2_cnt_maxval KOUTP_EC1EMSupTSC1CtrlPG2_cnt_minval /end REF_CHARACTERISTIC
/end GROUP
/begin GROUP S773_Signal_Override "SWC_OUTP_type/run_SWC_OUTP_5ms_sys/OUTP/outpmodule/VTQD_EC1EMSupTSC1CtrlPG2_cnt_Inproc/Signal_Override"
 /begin REF_CHARACTERISTIC KOUTP_EC1EMSupTSC1CtrlPG2_cnt_ovrdflg KOUTP_EC1EMSupTSC1CtrlPG2_cnt_ovrdval /end REF_CHARACTERISTIC
/end GROUP
/begin GROUP S774_Signal_Limit "SWC_OUTP_type/run_SWC_OUTP_5ms_sys/OUTP/outpmodule/VTQD_EC1EMSupTSC1CtrlPG3_cnt_Inproc/Signal_Limit"
 /begin REF_CHARACTERISTIC KOUTP_EC1EMSupTSC1CtrlPG3_cnt_maxval KOUTP_EC1EMSupTSC1CtrlPG3_cnt_minval /end REF_CHARACTERISTIC
/end GROUP
/begin GROUP S774_Signal_Override "SWC_OUTP_type/run_SWC_OUTP_5ms_sys/OUTP/outpmodule/VTQD_EC1EMSupTSC1CtrlPG3_cnt_Inproc/Signal_Override"
 /begin REF_CHARACTERISTIC KOUTP_EC1EMSupTSC1CtrlPG3_cnt_ovrdflg KOUTP_EC1EMSupTSC1CtrlPG3_cnt_ovrdval /end REF_CHARACTERISTIC
/end GROUP
/begin GROUP S775_Signal_Limit "SWC_OUTP_type/run_SWC_OUTP_5ms_sys/OUTP/outpmodule/VTQD_EC1EMSupTSC1CtrlPG4_cnt_Inproc/Signal_Limit"
 /begin REF_CHARACTERISTIC KOUTP_EC1EMSupTSC1CtrlPG4_cnt_maxval KOUTP_EC1EMSupTSC1CtrlPG4_cnt_minval /end REF_CHARACTERISTIC
/end GROUP
/begin GROUP S775_Signal_Override "SWC_OUTP_type/run_SWC_OUTP_5ms_sys/OUTP/outpmodule/VTQD_EC1EMSupTSC1CtrlPG4_cnt_Inproc/Signal_Override"
 /begin REF_CHARACTERISTIC KOUTP_EC1EMSupTSC1CtrlPG4_cnt_ovrdflg KOUTP_EC1EMSupTSC1CtrlPG4_cnt_ovrdval /end REF_CHARACTERISTIC
/end GROUP
/begin GROUP S776_Signal_Limit "SWC_OUTP_type/run_SWC_OUTP_5ms_sys/OUTP/outpmodule/VTQD_EC1EMSupVarRTSC1MSG_cnt_Inproc/Signal_Limit"
 /begin REF_CHARACTERISTIC KOUTP_EC1EMSupVarRTSC1MSG_cnt_maxval KOUTP_EC1EMSupVarRTSC1MSG_cnt_minval /end REF_CHARACTERISTIC
/end GROUP
/begin GROUP S776_Signal_Override "SWC_OUTP_type/run_SWC_OUTP_5ms_sys/OUTP/outpmodule/VTQD_EC1EMSupVarRTSC1MSG_cnt_Inproc/Signal_Override"
 /begin REF_CHARACTERISTIC KOUTP_EC1EMSupVarRTSC1MSG_cnt_ovrdflg KOUTP_EC1EMSupVarRTSC1MSG_cnt_ovrdval /end REF_CHARACTERISTIC
/end GROUP
/begin GROUP S777_Signal_Limit "SWC_OUTP_type/run_SWC_OUTP_5ms_sys/OUTP/outpmodule/VTQD_EC1PercTorqIdleP1_pct_Inproc/Signal_Limit"
 /begin REF_CHARACTERISTIC KOUTP_EC1PercTorqIdleP1_pct_maxval KOUTP_EC1PercTorqIdleP1_pct_minval /end REF_CHARACTERISTIC
/end GROUP
/begin GROUP S777_Signal_Override "SWC_OUTP_type/run_SWC_OUTP_5ms_sys/OUTP/outpmodule/VTQD_EC1PercTorqIdleP1_pct_Inproc/Signal_Override"
 /begin REF_CHARACTERISTIC KOUTP_EC1PercTorqIdleP1_pct_ovrdflg KOUTP_EC1PercTorqIdleP1_pct_ovrdval /end REF_CHARACTERISTIC
/end GROUP
/begin GROUP S778_Signal_Limit "SWC_OUTP_type/run_SWC_OUTP_5ms_sys/OUTP/outpmodule/VTQD_EC1PercTorqIdleP2_pct_Inproc/Signal_Limit"
 /begin REF_CHARACTERISTIC KOUTP_EC1PercTorqIdleP2_pct_maxval KOUTP_EC1PercTorqIdleP2_pct_minval /end REF_CHARACTERISTIC
/end GROUP
/begin GROUP S778_Signal_Override "SWC_OUTP_type/run_SWC_OUTP_5ms_sys/OUTP/outpmodule/VTQD_EC1PercTorqIdleP2_pct_Inproc/Signal_Override"
 /begin REF_CHARACTERISTIC KOUTP_EC1PercTorqIdleP2_pct_ovrdflg KOUTP_EC1PercTorqIdleP2_pct_ovrdval /end REF_CHARACTERISTIC
/end GROUP
/begin GROUP S779_Signal_Limit "SWC_OUTP_type/run_SWC_OUTP_5ms_sys/OUTP/outpmodule/VTQD_EC1PercTorqIdleP3_pct_Inproc/Signal_Limit"
 /begin REF_CHARACTERISTIC KOUTP_EC1PercTorqIdleP3_pct_maxval KOUTP_EC1PercTorqIdleP3_pct_minval /end REF_CHARACTERISTIC
/end GROUP
/begin GROUP S779_Signal_Override "SWC_OUTP_type/run_SWC_OUTP_5ms_sys/OUTP/outpmodule/VTQD_EC1PercTorqIdleP3_pct_Inproc/Signal_Override"
 /begin REF_CHARACTERISTIC KOUTP_EC1PercTorqIdleP3_pct_ovrdflg KOUTP_EC1PercTorqIdleP3_pct_ovrdval /end REF_CHARACTERISTIC
/end GROUP
/begin GROUP S780_Signal_Limit "SWC_OUTP_type/run_SWC_OUTP_5ms_sys/OUTP/outpmodule/VTQD_EC1PercTorqIdleP4_pct_Inproc/Signal_Limit"
 /begin REF_CHARACTERISTIC KOUTP_EC1PercTorqIdleP4_pct_maxval KOUTP_EC1PercTorqIdleP4_pct_minval /end REF_CHARACTERISTIC
/end GROUP
/begin GROUP S780_Signal_Override "SWC_OUTP_type/run_SWC_OUTP_5ms_sys/OUTP/outpmodule/VTQD_EC1PercTorqIdleP4_pct_Inproc/Signal_Override"
 /begin REF_CHARACTERISTIC KOUTP_EC1PercTorqIdleP4_pct_ovrdflg KOUTP_EC1PercTorqIdleP4_pct_ovrdval /end REF_CHARACTERISTIC
/end GROUP
/begin GROUP S781_Signal_Limit "SWC_OUTP_type/run_SWC_OUTP_5ms_sys/OUTP/outpmodule/VTQD_EC1PercTorqIdleP5_pct_Inproc/Signal_Limit"
 /begin REF_CHARACTERISTIC KOUTP_EC1PercTorqIdleP5_pct_maxval KOUTP_EC1PercTorqIdleP5_pct_minval /end REF_CHARACTERISTIC
/end GROUP
/begin GROUP S781_Signal_Override "SWC_OUTP_type/run_SWC_OUTP_5ms_sys/OUTP/outpmodule/VTQD_EC1PercTorqIdleP5_pct_Inproc/Signal_Override"
 /begin REF_CHARACTERISTIC KOUTP_EC1PercTorqIdleP5_pct_ovrdflg KOUTP_EC1PercTorqIdleP5_pct_ovrdval /end REF_CHARACTERISTIC
/end GROUP
/begin GROUP S782_Signal_Limit "SWC_OUTP_type/run_SWC_OUTP_5ms_sys/OUTP/outpmodule/VTQD_EEC3EMPressLoss_pct_Inproc/Signal_Limit"
 /begin REF_CHARACTERISTIC KOUTP_EEC3EMPressLoss_pct_maxval KOUTP_EEC3EMPressLoss_pct_minval /end REF_CHARACTERISTIC
/end GROUP
/begin GROUP S782_Signal_Override "SWC_OUTP_type/run_SWC_OUTP_5ms_sys/OUTP/outpmodule/VTQD_EEC3EMPressLoss_pct_Inproc/Signal_Override"
 /begin REF_CHARACTERISTIC KOUTP_EEC3EMPressLoss_pct_ovrdflg KOUTP_EEC3EMPressLoss_pct_ovrdval /end REF_CHARACTERISTIC
/end GROUP
/begin GROUP S783_Signal_Limit "SWC_OUTP_type/run_SWC_OUTP_5ms_sys/OUTP/outpmodule/VTQD_EEC3NFricPercTorq_pct_Inproc/Signal_Limit"
 /begin REF_CHARACTERISTIC KOUTP_EEC3NFricPercTorq_pct_maxval KOUTP_EEC3NFricPercTorq_pct_minval /end REF_CHARACTERISTIC
/end GROUP
/begin GROUP S783_Signal_Override "SWC_OUTP_type/run_SWC_OUTP_5ms_sys/OUTP/outpmodule/VTQD_EEC3NFricPercTorq_pct_Inproc/Signal_Override"
 /begin REF_CHARACTERISTIC KOUTP_EEC3NFricPercTorq_pct_ovrdflg KOUTP_EEC3NFricPercTorq_pct_ovrdval /end REF_CHARACTERISTIC
/end GROUP
/begin GROUP S784_Signal_Limit "SWC_OUTP_type/run_SWC_OUTP_5ms_sys/OUTP/outpmodule/VTQD_EMRC1ActEMOutSftSpd_rpm_Inproc/Signal_Limit"
 /begin REF_CHARACTERISTIC KOUTP_EMRC1ActEMOutSftSpd_rpm_maxval KOUTP_EMRC1ActEMOutSftSpd_rpm_minval /end REF_CHARACTERISTIC
/end GROUP
/begin GROUP S784_Signal_Override "SWC_OUTP_type/run_SWC_OUTP_5ms_sys/OUTP/outpmodule/VTQD_EMRC1ActEMOutSftSpd_rpm_Inproc/Signal_Override"
 /begin REF_CHARACTERISTIC KOUTP_EMRC1ActEMOutSftSpd_rpm_ovrdflg KOUTP_EMRC1ActEMOutSftSpd_rpm_ovrdval /end REF_CHARACTERISTIC
/end GROUP
/begin GROUP S785_Signal_Limit "SWC_OUTP_type/run_SWC_OUTP_5ms_sys/OUTP/outpmodule/VTQD_EMRC1ActEMpTrqHrls_pct_Inproc/Signal_Limit"
 /begin REF_CHARACTERISTIC KOUTP_EMRC1ActEMpTrqHrls_pct_maxval KOUTP_EMRC1ActEMpTrqHrls_pct_minval /end REF_CHARACTERISTIC
/end GROUP
/begin GROUP S785_Signal_Override "SWC_OUTP_type/run_SWC_OUTP_5ms_sys/OUTP/outpmodule/VTQD_EMRC1ActEMpTrqHrls_pct_Inproc/Signal_Override"
 /begin REF_CHARACTERISTIC KOUTP_EMRC1ActEMpTrqHrls_pct_ovrdflg KOUTP_EMRC1ActEMpTrqHrls_pct_ovrdval /end REF_CHARACTERISTIC
/end GROUP
/begin GROUP S786_Signal_Limit "SWC_OUTP_type/run_SWC_OUTP_5ms_sys/OUTP/outpmodule/VTQD_EMRC1ActEMpTrq_pct_Inproc/Signal_Limit"
 /begin REF_CHARACTERISTIC KOUTP_EMRC1ActEMpTrq_pct_maxval KOUTP_EMRC1ActEMpTrq_pct_minval /end REF_CHARACTERISTIC
/end GROUP
/begin GROUP S786_Signal_Override "SWC_OUTP_type/run_SWC_OUTP_5ms_sys/OUTP/outpmodule/VTQD_EMRC1ActEMpTrq_pct_Inproc/Signal_Override"
 /begin REF_CHARACTERISTIC KOUTP_EMRC1ActEMpTrq_pct_ovrdflg KOUTP_EMRC1ActEMpTrq_pct_ovrdval /end REF_CHARACTERISTIC
/end GROUP
/begin GROUP S787_Signal_Limit "SWC_OUTP_type/run_SWC_OUTP_5ms_sys/OUTP/outpmodule/VTQD_EMRC1ActMaxAvaEMRecpTrq_pct_Inproc/Signal_Limit"
 /begin REF_CHARACTERISTIC KOUTP_EMRC1ActMaxAvaEMRecpTrq_pct_maxval KOUTP_EMRC1ActMaxAvaEMRecpTrq_pct_minval /end REF_CHARACTERISTIC
/end GROUP
/begin GROUP S787_Signal_Override "SWC_OUTP_type/run_SWC_OUTP_5ms_sys/OUTP/outpmodule/VTQD_EMRC1ActMaxAvaEMRecpTrq_pct_Inproc/Signal_Override"
 /begin REF_CHARACTERISTIC KOUTP_EMRC1ActMaxAvaEMRecpTrq_pct_ovrdflg KOUTP_EMRC1ActMaxAvaEMRecpTrq_pct_ovrdval /end REF_CHARACTERISTIC
/end GROUP
/begin GROUP S788_Signal_Limit "SWC_OUTP_type/run_SWC_OUTP_5ms_sys/OUTP/outpmodule/VTQD_EMRC1DrvDemEMRtapTrq_pct_Inproc/Signal_Limit"
 /begin REF_CHARACTERISTIC KOUTP_EMRC1DrvDemEMRtapTrq_pct_maxval KOUTP_EMRC1DrvDemEMRtapTrq_pct_minval /end REF_CHARACTERISTIC
/end GROUP
/begin GROUP S788_Signal_Override "SWC_OUTP_type/run_SWC_OUTP_5ms_sys/OUTP/outpmodule/VTQD_EMRC1DrvDemEMRtapTrq_pct_Inproc/Signal_Override"
 /begin REF_CHARACTERISTIC KOUTP_EMRC1DrvDemEMRtapTrq_pct_ovrdflg KOUTP_EMRC1DrvDemEMRtapTrq_pct_ovrdval /end REF_CHARACTERISTIC
/end GROUP
/begin GROUP S789_Signal_Limit "SWC_OUTP_type/run_SWC_OUTP_5ms_sys/OUTP/outpmodule/VTQD_EMRC1EMTquModeDrvBrk_enum_Inproc/Signal_Limit"
 /begin REF_CHARACTERISTIC KOUTP_EMRC1EMTquModeDrvBrk_enum_maxval KOUTP_EMRC1EMTquModeDrvBrk_enum_minval /end REF_CHARACTERISTIC
/end GROUP
/begin GROUP S789_Signal_Override "SWC_OUTP_type/run_SWC_OUTP_5ms_sys/OUTP/outpmodule/VTQD_EMRC1EMTquModeDrvBrk_enum_Inproc/Signal_Override"
 /begin REF_CHARACTERISTIC KOUTP_EMRC1EMTquModeDrvBrk_enum_ovrdflg KOUTP_EMRC1EMTquModeDrvBrk_enum_ovrdval /end REF_CHARACTERISTIC
/end GROUP
/begin GROUP S790_Signal_Limit "SWC_OUTP_type/run_SWC_OUTP_5ms_sys/OUTP/outpmodule/VTQD_EMRC1RetSelNonEng_pct_Inproc/Signal_Limit"
 /begin REF_CHARACTERISTIC KOUTP_EMRC1RetSelNonEng_pct_maxval KOUTP_EMRC1RetSelNonEng_pct_minval /end REF_CHARACTERISTIC
/end GROUP
/begin GROUP S790_Signal_Override "SWC_OUTP_type/run_SWC_OUTP_5ms_sys/OUTP/outpmodule/VTQD_EMRC1RetSelNonEng_pct_Inproc/Signal_Override"
 /begin REF_CHARACTERISTIC KOUTP_EMRC1RetSelNonEng_pct_ovrdflg KOUTP_EMRC1RetSelNonEng_pct_ovrdval /end REF_CHARACTERISTIC
/end GROUP
/begin GROUP S791_Signal_Limit "SWC_OUTP_type/run_SWC_OUTP_5ms_sys/OUTP/outpmodule/VTQD_EMRC1SACtrlDev_cnt_Inproc/Signal_Limit"
 /begin REF_CHARACTERISTIC KOUTP_EMRC1SACtrlDev_cnt_maxval KOUTP_EMRC1SACtrlDev_cnt_minval /end REF_CHARACTERISTIC
/end GROUP
/begin GROUP S791_Signal_Override "SWC_OUTP_type/run_SWC_OUTP_5ms_sys/OUTP/outpmodule/VTQD_EMRC1SACtrlDev_cnt_Inproc/Signal_Override"
 /begin REF_CHARACTERISTIC KOUTP_EMRC1SACtrlDev_cnt_ovrdflg KOUTP_EMRC1SACtrlDev_cnt_ovrdval /end REF_CHARACTERISTIC
/end GROUP
/begin GROUP S792_Signal_Limit "SWC_OUTP_type/run_SWC_OUTP_5ms_sys/OUTP/outpmodule/VTQD_ETC1ShiftrPgs_enum_Inproc/Signal_Limit"
 /begin REF_CHARACTERISTIC KOUTP_ETC1ShiftrPgs_enum_maxval KOUTP_ETC1ShiftrPgs_enum_minval /end REF_CHARACTERISTIC
/end GROUP
/begin GROUP S792_Signal_Override "SWC_OUTP_type/run_SWC_OUTP_5ms_sys/OUTP/outpmodule/VTQD_ETC1ShiftrPgs_enum_Inproc/Signal_Override"
 /begin REF_CHARACTERISTIC KOUTP_ETC1ShiftrPgs_enum_ovrdflg KOUTP_ETC1ShiftrPgs_enum_ovrdval /end REF_CHARACTERISTIC
/end GROUP
/begin GROUP S793_Signal_Limit "SWC_OUTP_type/run_SWC_OUTP_5ms_sys/OUTP/outpmodule/VTQD_ETC2ActDriveDirect_enum_Inproc/Signal_Limit"
 /begin REF_CHARACTERISTIC KOUTP_ETC2ActDriveDirect_enum_maxval KOUTP_ETC2ActDriveDirect_enum_minval /end REF_CHARACTERISTIC
/end GROUP
/begin GROUP S793_Signal_Override "SWC_OUTP_type/run_SWC_OUTP_5ms_sys/OUTP/outpmodule/VTQD_ETC2ActDriveDirect_enum_Inproc/Signal_Override"
 /begin REF_CHARACTERISTIC KOUTP_ETC2ActDriveDirect_enum_ovrdflg KOUTP_ETC2ActDriveDirect_enum_ovrdval /end REF_CHARACTERISTIC
/end GROUP
/begin GROUP S794_Signal_Limit "SWC_OUTP_type/run_SWC_OUTP_5ms_sys/OUTP/outpmodule/VTQD_EVCU1ActDrvMode_enum_Inproc/Signal_Limit"
 /begin REF_CHARACTERISTIC KOUTP_EVCU1ActDrvMode_enum_maxval KOUTP_EVCU1ActDrvMode_enum_minval /end REF_CHARACTERISTIC
/end GROUP
/begin GROUP S794_Signal_Override "SWC_OUTP_type/run_SWC_OUTP_5ms_sys/OUTP/outpmodule/VTQD_EVCU1ActDrvMode_enum_Inproc/Signal_Override"
 /begin REF_CHARACTERISTIC KOUTP_EVCU1ActDrvMode_enum_ovrdflg KOUTP_EVCU1ActDrvMode_enum_ovrdval /end REF_CHARACTERISTIC
/end GROUP
/begin GROUP S795_Signal_Limit "SWC_OUTP_type/run_SWC_OUTP_5ms_sys/OUTP/outpmodule/VTQD_EVCU1EBrakeTorqLow_enum_Inproc/Signal_Limit"
 /begin REF_CHARACTERISTIC KOUTP_EVCU1EBrakeTorqLow_enum_maxval KOUTP_EVCU1EBrakeTorqLow_enum_minval /end REF_CHARACTERISTIC
/end GROUP
/begin GROUP S795_Signal_Override "SWC_OUTP_type/run_SWC_OUTP_5ms_sys/OUTP/outpmodule/VTQD_EVCU1EBrakeTorqLow_enum_Inproc/Signal_Override"
 /begin REF_CHARACTERISTIC KOUTP_EVCU1EBrakeTorqLow_enum_ovrdflg KOUTP_EVCU1EBrakeTorqLow_enum_ovrdval /end REF_CHARACTERISTIC
/end GROUP
/begin GROUP S796_Signal_Limit "SWC_OUTP_type/run_SWC_OUTP_5ms_sys/OUTP/outpmodule/VTQD_EVCU1EMotorOvrerSpd_enum_Inproc/Signal_Limit"
 /begin REF_CHARACTERISTIC KOUTP_EVCU1EMotorOvrerSpd_enum_maxval KOUTP_EVCU1EMotorOvrerSpd_enum_minval /end REF_CHARACTERISTIC
/end GROUP
/begin GROUP S796_Signal_Override "SWC_OUTP_type/run_SWC_OUTP_5ms_sys/OUTP/outpmodule/VTQD_EVCU1EMotorOvrerSpd_enum_Inproc/Signal_Override"
 /begin REF_CHARACTERISTIC KOUTP_EVCU1EMotorOvrerSpd_enum_ovrdflg KOUTP_EVCU1EMotorOvrerSpd_enum_ovrdval /end REF_CHARACTERISTIC
/end GROUP
/begin GROUP S797_Signal_Limit "SWC_OUTP_type/run_SWC_OUTP_5ms_sys/OUTP/outpmodule/VTQD_EVCU1EMotorPerformance_pct_Inproc/Signal_Limit"
 /begin REF_CHARACTERISTIC KOUTP_EVCU1EMotorPerformance_pct_maxval KOUTP_EVCU1EMotorPerformance_pct_minval /end REF_CHARACTERISTIC
/end GROUP
/begin GROUP S797_Signal_Override "SWC_OUTP_type/run_SWC_OUTP_5ms_sys/OUTP/outpmodule/VTQD_EVCU1EMotorPerformance_pct_Inproc/Signal_Override"
 /begin REF_CHARACTERISTIC KOUTP_EVCU1EMotorPerformance_pct_ovrdflg KOUTP_EVCU1EMotorPerformance_pct_ovrdval /end REF_CHARACTERISTIC
/end GROUP
/begin GROUP S798_Signal_Limit "SWC_OUTP_type/run_SWC_OUTP_5ms_sys/OUTP/outpmodule/VTQD_EVCU1EMotorSpd_rpm_Inproc/Signal_Limit"
 /begin REF_CHARACTERISTIC KOUTP_EVCU1EMotorSpd_rpm_maxval KOUTP_EVCU1EMotorSpd_rpm_minval /end REF_CHARACTERISTIC
/end GROUP
/begin GROUP S798_Signal_Override "SWC_OUTP_type/run_SWC_OUTP_5ms_sys/OUTP/outpmodule/VTQD_EVCU1EMotorSpd_rpm_Inproc/Signal_Override"
 /begin REF_CHARACTERISTIC KOUTP_EVCU1EMotorSpd_rpm_ovrdflg KOUTP_EVCU1EMotorSpd_rpm_ovrdval /end REF_CHARACTERISTIC
/end GROUP
/begin GROUP S799_Signal_Limit "SWC_OUTP_type/run_SWC_OUTP_5ms_sys/OUTP/outpmodule/VTQD_EVCU1RecuperHighSta_enum_Inproc/Signal_Limit"
 /begin REF_CHARACTERISTIC KOUTP_EVCU1RecuperHighSta_enum_maxval KOUTP_EVCU1RecuperHighSta_enum_minval /end REF_CHARACTERISTIC
/end GROUP
/begin GROUP S799_Signal_Override "SWC_OUTP_type/run_SWC_OUTP_5ms_sys/OUTP/outpmodule/VTQD_EVCU1RecuperHighSta_enum_Inproc/Signal_Override"
 /begin REF_CHARACTERISTIC KOUTP_EVCU1RecuperHighSta_enum_ovrdflg KOUTP_EVCU1RecuperHighSta_enum_ovrdval /end REF_CHARACTERISTIC
/end GROUP
/begin GROUP S800_Signal_Limit "SWC_OUTP_type/run_SWC_OUTP_5ms_sys/OUTP/outpmodule/VTQD_EVCU1WheelSlipdet_enum_Inproc/Signal_Limit"
 /begin REF_CHARACTERISTIC KOUTP_EVCU1WheelSlipdet_enum_maxval KOUTP_EVCU1WheelSlipdet_enum_minval /end REF_CHARACTERISTIC
/end GROUP
/begin GROUP S800_Signal_Override "SWC_OUTP_type/run_SWC_OUTP_5ms_sys/OUTP/outpmodule/VTQD_EVCU1WheelSlipdet_enum_Inproc/Signal_Override"
 /begin REF_CHARACTERISTIC KOUTP_EVCU1WheelSlipdet_enum_ovrdflg KOUTP_EVCU1WheelSlipdet_enum_ovrdval /end REF_CHARACTERISTIC
/end GROUP
/begin GROUP S801_Signal_Limit "SWC_OUTP_type/run_SWC_OUTP_5ms_sys/OUTP/outpmodule/VTQD_EVCU2MaxTorqAvail_pct_Inproc/Signal_Limit"
 /begin REF_CHARACTERISTIC KOUTP_EVCU2MaxTorqAvail_pct_maxval KOUTP_EVCU2MaxTorqAvail_pct_minval /end REF_CHARACTERISTIC
/end GROUP
/begin GROUP S801_Signal_Override "SWC_OUTP_type/run_SWC_OUTP_5ms_sys/OUTP/outpmodule/VTQD_EVCU2MaxTorqAvail_pct_Inproc/Signal_Override"
 /begin REF_CHARACTERISTIC KOUTP_EVCU2MaxTorqAvail_pct_ovrdflg KOUTP_EVCU2MaxTorqAvail_pct_ovrdval /end REF_CHARACTERISTIC
/end GROUP
/begin GROUP S802_Signal_Limit "SWC_OUTP_type/run_SWC_OUTP_5ms_sys/OUTP/outpmodule/VTQD_EVCU2MinTorqAvail_pct_Inproc/Signal_Limit"
 /begin REF_CHARACTERISTIC KOUTP_EVCU2MinTorqAvail_pct_maxval KOUTP_EVCU2MinTorqAvail_pct_minval /end REF_CHARACTERISTIC
/end GROUP
/begin GROUP S802_Signal_Override "SWC_OUTP_type/run_SWC_OUTP_5ms_sys/OUTP/outpmodule/VTQD_EVCU2MinTorqAvail_pct_Inproc/Signal_Override"
 /begin REF_CHARACTERISTIC KOUTP_EVCU2MinTorqAvail_pct_ovrdflg KOUTP_EVCU2MinTorqAvail_pct_ovrdval /end REF_CHARACTERISTIC
/end GROUP
/begin GROUP S803_Signal_Limit "SWC_OUTP_type/run_SWC_OUTP_5ms_sys/OUTP/outpmodule/VTQD_GearFlashIndDis_flg_Inproc/Signal_Limit"
 /begin REF_CHARACTERISTIC KOUTP_GearFlashIndDis_flg_maxval KOUTP_GearFlashIndDis_flg_minval /end REF_CHARACTERISTIC
/end GROUP
/begin GROUP S803_Signal_Override "SWC_OUTP_type/run_SWC_OUTP_5ms_sys/OUTP/outpmodule/VTQD_GearFlashIndDis_flg_Inproc/Signal_Override"
 /begin REF_CHARACTERISTIC KOUTP_GearFlashIndDis_flg_ovrdflg KOUTP_GearFlashIndDis_flg_ovrdval /end REF_CHARACTERISTIC
/end GROUP
/begin GROUP S804_Signal_Limit "SWC_OUTP_type/run_SWC_OUTP_5ms_sys/OUTP/outpmodule/VTQD_GearFlashInd_flg_Inproc/Signal_Limit"
 /begin REF_CHARACTERISTIC KOUTP_GearFlashInd_flg_maxval KOUTP_GearFlashInd_flg_minval /end REF_CHARACTERISTIC
/end GROUP
/begin GROUP S804_Signal_Override "SWC_OUTP_type/run_SWC_OUTP_5ms_sys/OUTP/outpmodule/VTQD_GearFlashInd_flg_Inproc/Signal_Override"
 /begin REF_CHARACTERISTIC KOUTP_GearFlashInd_flg_ovrdflg KOUTP_GearFlashInd_flg_ovrdval /end REF_CHARACTERISTIC
/end GROUP
/begin GROUP S805_Signal_Limit "SWC_OUTP_type/run_SWC_OUTP_5ms_sys/OUTP/outpmodule/VTQD_ParkingProtectWarning_flg_Inproc/Signal_Limit"
 /begin REF_CHARACTERISTIC KOUTP_ParkingProtectWarning_flg_maxval KOUTP_ParkingProtectWarning_flg_minval /end REF_CHARACTERISTIC
/end GROUP
/begin GROUP S805_Signal_Override "SWC_OUTP_type/run_SWC_OUTP_5ms_sys/OUTP/outpmodule/VTQD_ParkingProtectWarning_flg_Inproc/Signal_Override"
 /begin REF_CHARACTERISTIC KOUTP_ParkingProtectWarning_flg_ovrdflg KOUTP_ParkingProtectWarning_flg_ovrdval /end REF_CHARACTERISTIC
/end GROUP
/begin GROUP S806_Signal_Limit "SWC_OUTP_type/run_SWC_OUTP_5ms_sys/OUTP/outpmodule/VTQD_RC1MaxRetSpdP2_rpm_Inproc/Signal_Limit"
 /begin REF_CHARACTERISTIC KOUTP_RC1MaxRetSpdP2_rpm_maxval KOUTP_RC1MaxRetSpdP2_rpm_minval /end REF_CHARACTERISTIC
/end GROUP
/begin GROUP S806_Signal_Override "SWC_OUTP_type/run_SWC_OUTP_5ms_sys/OUTP/outpmodule/VTQD_RC1MaxRetSpdP2_rpm_Inproc/Signal_Override"
 /begin REF_CHARACTERISTIC KOUTP_RC1MaxRetSpdP2_rpm_ovrdflg KOUTP_RC1MaxRetSpdP2_rpm_ovrdval /end REF_CHARACTERISTIC
/end GROUP
/begin GROUP S807_Signal_Limit "SWC_OUTP_type/run_SWC_OUTP_5ms_sys/OUTP/outpmodule/VTQD_RC1MaxRetSpdP3_rpm_Inproc/Signal_Limit"
 /begin REF_CHARACTERISTIC KOUTP_RC1MaxRetSpdP3_rpm_maxval KOUTP_RC1MaxRetSpdP3_rpm_minval /end REF_CHARACTERISTIC
/end GROUP
/begin GROUP S807_Signal_Override "SWC_OUTP_type/run_SWC_OUTP_5ms_sys/OUTP/outpmodule/VTQD_RC1MaxRetSpdP3_rpm_Inproc/Signal_Override"
 /begin REF_CHARACTERISTIC KOUTP_RC1MaxRetSpdP3_rpm_ovrdflg KOUTP_RC1MaxRetSpdP3_rpm_ovrdval /end REF_CHARACTERISTIC
/end GROUP
/begin GROUP S808_Signal_Limit "SWC_OUTP_type/run_SWC_OUTP_5ms_sys/OUTP/outpmodule/VTQD_RC1PctTrqIdleP1_pct_Inproc/Signal_Limit"
 /begin REF_CHARACTERISTIC KOUTP_RC1PctTrqIdleP1_pct_maxval KOUTP_RC1PctTrqIdleP1_pct_minval /end REF_CHARACTERISTIC
/end GROUP
/begin GROUP S808_Signal_Override "SWC_OUTP_type/run_SWC_OUTP_5ms_sys/OUTP/outpmodule/VTQD_RC1PctTrqIdleP1_pct_Inproc/Signal_Override"
 /begin REF_CHARACTERISTIC KOUTP_RC1PctTrqIdleP1_pct_ovrdflg KOUTP_RC1PctTrqIdleP1_pct_ovrdval /end REF_CHARACTERISTIC
/end GROUP
/begin GROUP S809_Signal_Limit "SWC_OUTP_type/run_SWC_OUTP_5ms_sys/OUTP/outpmodule/VTQD_RC1PctTrqP3_pct_Inproc/Signal_Limit" /begin REF_CHARACTERISTIC KOUTP_RC1PctTrqP3_pct_maxval KOUTP_RC1PctTrqP3_pct_minval /end REF_CHARACTERISTIC /end GROUP
/begin GROUP S809_Signal_Override "SWC_OUTP_type/run_SWC_OUTP_5ms_sys/OUTP/outpmodule/VTQD_RC1PctTrqP3_pct_Inproc/Signal_Override"
 /begin REF_CHARACTERISTIC KOUTP_RC1PctTrqP3_pct_ovrdflg KOUTP_RC1PctTrqP3_pct_ovrdval /end REF_CHARACTERISTIC
/end GROUP
/begin GROUP S810_Signal_Limit "SWC_OUTP_type/run_SWC_OUTP_5ms_sys/OUTP/outpmodule/VTQD_RC1PctTrqP4_pct_Inproc/Signal_Limit" /begin REF_CHARACTERISTIC KOUTP_RC1PctTrqP4_pct_maxval KOUTP_RC1PctTrqP4_pct_minval /end REF_CHARACTERISTIC /end GROUP
/begin GROUP S810_Signal_Override "SWC_OUTP_type/run_SWC_OUTP_5ms_sys/OUTP/outpmodule/VTQD_RC1PctTrqP4_pct_Inproc/Signal_Override"
 /begin REF_CHARACTERISTIC KOUTP_RC1PctTrqP4_pct_ovrdflg KOUTP_RC1PctTrqP4_pct_ovrdval /end REF_CHARACTERISTIC
/end GROUP
/begin GROUP S811_Signal_Limit "SWC_OUTP_type/run_SWC_OUTP_5ms_sys/OUTP/outpmodule/VTQD_RC1PctTrqPekTrqP5_pct_Inproc/Signal_Limit"
 /begin REF_CHARACTERISTIC KOUTP_RC1PctTrqPekTrqP5_pct_maxval KOUTP_RC1PctTrqPekTrqP5_pct_minval /end REF_CHARACTERISTIC
/end GROUP
/begin GROUP S811_Signal_Override "SWC_OUTP_type/run_SWC_OUTP_5ms_sys/OUTP/outpmodule/VTQD_RC1PctTrqPekTrqP5_pct_Inproc/Signal_Override"
 /begin REF_CHARACTERISTIC KOUTP_RC1PctTrqPekTrqP5_pct_ovrdflg KOUTP_RC1PctTrqPekTrqP5_pct_ovrdval /end REF_CHARACTERISTIC
/end GROUP
/begin GROUP S812_Signal_Limit "SWC_OUTP_type/run_SWC_OUTP_5ms_sys/OUTP/outpmodule/VTQD_RC1RefRetTrq_Nm_Inproc/Signal_Limit" /begin REF_CHARACTERISTIC KOUTP_RC1RefRetTrq_Nm_maxval KOUTP_RC1RefRetTrq_Nm_minval /end REF_CHARACTERISTIC /end GROUP
/begin GROUP S812_Signal_Override "SWC_OUTP_type/run_SWC_OUTP_5ms_sys/OUTP/outpmodule/VTQD_RC1RefRetTrq_Nm_Inproc/Signal_Override"
 /begin REF_CHARACTERISTIC KOUTP_RC1RefRetTrq_Nm_ovrdflg KOUTP_RC1RefRetTrq_Nm_ovrdval /end REF_CHARACTERISTIC
/end GROUP
/begin GROUP S813_Signal_Limit "SWC_OUTP_type/run_SWC_OUTP_5ms_sys/OUTP/outpmodule/VTQD_RC1RetCtrlMth_enum_Inproc/Signal_Limit"
 /begin REF_CHARACTERISTIC KOUTP_RC1RetCtrlMth_enum_maxval KOUTP_RC1RetCtrlMth_enum_minval /end REF_CHARACTERISTIC
/end GROUP
/begin GROUP S813_Signal_Override "SWC_OUTP_type/run_SWC_OUTP_5ms_sys/OUTP/outpmodule/VTQD_RC1RetCtrlMth_enum_Inproc/Signal_Override"
 /begin REF_CHARACTERISTIC KOUTP_RC1RetCtrlMth_enum_ovrdflg KOUTP_RC1RetCtrlMth_enum_ovrdval /end REF_CHARACTERISTIC
/end GROUP
/begin GROUP S814_Signal_Limit "SWC_OUTP_type/run_SWC_OUTP_5ms_sys/OUTP/outpmodule/VTQD_RC1RetLocat_enum_Inproc/Signal_Limit"
 /begin REF_CHARACTERISTIC KOUTP_RC1RetLocat_enum_maxval KOUTP_RC1RetLocat_enum_minval /end REF_CHARACTERISTIC
/end GROUP
/begin GROUP S814_Signal_Override "SWC_OUTP_type/run_SWC_OUTP_5ms_sys/OUTP/outpmodule/VTQD_RC1RetLocat_enum_Inproc/Signal_Override"
 /begin REF_CHARACTERISTIC KOUTP_RC1RetLocat_enum_ovrdflg KOUTP_RC1RetLocat_enum_ovrdval /end REF_CHARACTERISTIC
/end GROUP
/begin GROUP S815_Signal_Limit "SWC_OUTP_type/run_SWC_OUTP_5ms_sys/OUTP/outpmodule/VTQD_RC1RetSpdIdleP1_rpm_Inproc/Signal_Limit"
 /begin REF_CHARACTERISTIC KOUTP_RC1RetSpdIdleP1_rpm_maxval KOUTP_RC1RetSpdIdleP1_rpm_minval /end REF_CHARACTERISTIC
/end GROUP
/begin GROUP S815_Signal_Override "SWC_OUTP_type/run_SWC_OUTP_5ms_sys/OUTP/outpmodule/VTQD_RC1RetSpdIdleP1_rpm_Inproc/Signal_Override"
 /begin REF_CHARACTERISTIC KOUTP_RC1RetSpdIdleP1_rpm_ovrdflg KOUTP_RC1RetSpdIdleP1_rpm_ovrdval /end REF_CHARACTERISTIC
/end GROUP
/begin GROUP S816_Signal_Limit "SWC_OUTP_type/run_SWC_OUTP_5ms_sys/OUTP/outpmodule/VTQD_RC1RetSpdP2_pct_Inproc/Signal_Limit" /begin REF_CHARACTERISTIC KOUTP_RC1RetSpdP2_pct_maxval KOUTP_RC1RetSpdP2_pct_minval /end REF_CHARACTERISTIC /end GROUP
/begin GROUP S816_Signal_Override "SWC_OUTP_type/run_SWC_OUTP_5ms_sys/OUTP/outpmodule/VTQD_RC1RetSpdP2_pct_Inproc/Signal_Override"
 /begin REF_CHARACTERISTIC KOUTP_RC1RetSpdP2_pct_ovrdflg KOUTP_RC1RetSpdP2_pct_ovrdval /end REF_CHARACTERISTIC
/end GROUP
/begin GROUP S817_Signal_Limit "SWC_OUTP_type/run_SWC_OUTP_5ms_sys/OUTP/outpmodule/VTQD_RC1RetSpdP4_rpm_Inproc/Signal_Limit" /begin REF_CHARACTERISTIC KOUTP_RC1RetSpdP4_rpm_maxval KOUTP_RC1RetSpdP4_rpm_minval /end REF_CHARACTERISTIC /end GROUP
/begin GROUP S817_Signal_Override "SWC_OUTP_type/run_SWC_OUTP_5ms_sys/OUTP/outpmodule/VTQD_RC1RetSpdP4_rpm_Inproc/Signal_Override"
 /begin REF_CHARACTERISTIC KOUTP_RC1RetSpdP4_rpm_ovrdflg KOUTP_RC1RetSpdP4_rpm_ovrdval /end REF_CHARACTERISTIC
/end GROUP
/begin GROUP S818_Signal_Limit "SWC_OUTP_type/run_SWC_OUTP_5ms_sys/OUTP/outpmodule/VTQD_RC1RetSpdPekTrqP5_Nm_Inproc/Signal_Limit"
 /begin REF_CHARACTERISTIC KOUTP_RC1RetSpdPekTrqP5_Nm_maxval KOUTP_RC1RetSpdPekTrqP5_Nm_minval /end REF_CHARACTERISTIC
/end GROUP
/begin GROUP S818_Signal_Override "SWC_OUTP_type/run_SWC_OUTP_5ms_sys/OUTP/outpmodule/VTQD_RC1RetSpdPekTrqP5_Nm_Inproc/Signal_Override"
 /begin REF_CHARACTERISTIC KOUTP_RC1RetSpdPekTrqP5_Nm_ovrdflg KOUTP_RC1RetSpdPekTrqP5_Nm_ovrdval /end REF_CHARACTERISTIC
/end GROUP
/begin GROUP S819_Signal_Limit "SWC_OUTP_type/run_SWC_OUTP_5ms_sys/OUTP/outpmodule/VTQD_RC1RetType_enum_Inproc/Signal_Limit" /begin REF_CHARACTERISTIC KOUTP_RC1RetType_enum_maxval KOUTP_RC1RetType_enum_minval /end REF_CHARACTERISTIC /end GROUP
/begin GROUP S819_Signal_Override "SWC_OUTP_type/run_SWC_OUTP_5ms_sys/OUTP/outpmodule/VTQD_RC1RetType_enum_Inproc/Signal_Override"
 /begin REF_CHARACTERISTIC KOUTP_RC1RetType_enum_ovrdflg KOUTP_RC1RetType_enum_ovrdval /end REF_CHARACTERISTIC
/end GROUP
/begin GROUP S820_Signal_Limit "SWC_OUTP_type/run_SWC_OUTP_5ms_sys/OUTP/outpmodule/VTQD_SpdLimSta_flg_Inproc/Signal_Limit" /begin REF_CHARACTERISTIC KOUTP_SpdLimSta_flg_maxval KOUTP_SpdLimSta_flg_minval /end REF_CHARACTERISTIC /end GROUP
/begin GROUP S820_Signal_Override "SWC_OUTP_type/run_SWC_OUTP_5ms_sys/OUTP/outpmodule/VTQD_SpdLimSta_flg_Inproc/Signal_Override" /begin REF_CHARACTERISTIC KOUTP_SpdLimSta_flg_ovrdflg KOUTP_SpdLimSta_flg_ovrdval /end REF_CHARACTERISTIC /end GROUP
/begin GROUP S821_Signal_Limit "SWC_OUTP_type/run_SWC_OUTP_5ms_sys/OUTP/outpmodule/VTQD_TMTqReq_Nm_Inproc/Signal_Limit" /begin REF_CHARACTERISTIC KOUTP_TMTqReq_Nm_maxval KOUTP_TMTqReq_Nm_minval /end REF_CHARACTERISTIC /end GROUP
/begin GROUP S821_Signal_Override "SWC_OUTP_type/run_SWC_OUTP_5ms_sys/OUTP/outpmodule/VTQD_TMTqReq_Nm_Inproc/Signal_Override" /begin REF_CHARACTERISTIC KOUTP_TMTqReq_Nm_ovrdflg KOUTP_TMTqReq_Nm_ovrdval /end REF_CHARACTERISTIC /end GROUP
/begin GROUP S822_Signal_Limit "SWC_OUTP_type/run_SWC_OUTP_5ms_sys/OUTP/outpmodule/VTQD_TUpAIND_enum_Inproc/Signal_Limit" /begin REF_CHARACTERISTIC KOUTP_TUpAIND_enum_maxval KOUTP_TUpAIND_enum_minval /end REF_CHARACTERISTIC /end GROUP
/begin GROUP S822_Signal_Override "SWC_OUTP_type/run_SWC_OUTP_5ms_sys/OUTP/outpmodule/VTQD_TUpAIND_enum_Inproc/Signal_Override" /begin REF_CHARACTERISTIC KOUTP_TUpAIND_enum_ovrdflg KOUTP_TUpAIND_enum_ovrdval /end REF_CHARACTERISTIC /end GROUP
/begin GROUP S823_Signal_Limit "SWC_OUTP_type/run_SWC_OUTP_5ms_sys/OUTP/outpmodule/VTQD_VCU4PweLmtInd_flg_Inproc/Signal_Limit"
 /begin REF_CHARACTERISTIC KOUTP_VCU4PweLmtInd_flg_maxval KOUTP_VCU4PweLmtInd_flg_minval /end REF_CHARACTERISTIC
/end GROUP
/begin GROUP S823_Signal_Override "SWC_OUTP_type/run_SWC_OUTP_5ms_sys/OUTP/outpmodule/VTQD_VCU4PweLmtInd_flg_Inproc/Signal_Override"
 /begin REF_CHARACTERISTIC KOUTP_VCU4PweLmtInd_flg_ovrdflg KOUTP_VCU4PweLmtInd_flg_ovrdval /end REF_CHARACTERISTIC
/end GROUP
/begin GROUP S824_Signal_Limit "SWC_OUTP_type/run_SWC_OUTP_5ms_sys/OUTP/outpmodule/VTQD_VCUBCMBuzzReq_flg_Inproc/Signal_Limit"
 /begin REF_CHARACTERISTIC KOUTP_VCUBCMBuzzReq_flg_maxval KOUTP_VCUBCMBuzzReq_flg_minval /end REF_CHARACTERISTIC
/end GROUP
/begin GROUP S824_Signal_Override "SWC_OUTP_type/run_SWC_OUTP_5ms_sys/OUTP/outpmodule/VTQD_VCUBCMBuzzReq_flg_Inproc/Signal_Override"
 /begin REF_CHARACTERISTIC KOUTP_VCUBCMBuzzReq_flg_ovrdflg KOUTP_VCUBCMBuzzReq_flg_ovrdval /end REF_CHARACTERISTIC
/end GROUP
/begin GROUP S825_Signal_Limit "SWC_OUTP_type/run_SWC_OUTP_5ms_sys/OUTP/outpmodule/VTQD_VCUEBSHBSw_enum_Inproc/Signal_Limit" /begin REF_CHARACTERISTIC KOUTP_VCUEBSHBSw_enum_maxval KOUTP_VCUEBSHBSw_enum_minval /end REF_CHARACTERISTIC /end GROUP
/begin GROUP S825_Signal_Override "SWC_OUTP_type/run_SWC_OUTP_5ms_sys/OUTP/outpmodule/VTQD_VCUEBSHBSw_enum_Inproc/Signal_Override"
 /begin REF_CHARACTERISTIC KOUTP_VCUEBSHBSw_enum_ovrdflg KOUTP_VCUEBSHBSw_enum_ovrdval /end REF_CHARACTERISTIC
/end GROUP
/begin GROUP S826_Signal_Limit "SWC_OUTP_type/run_SWC_OUTP_5ms_sys/OUTP/outpmodule/VTQD_VCUEBSHHSw_enum_Inproc/Signal_Limit" /begin REF_CHARACTERISTIC KOUTP_VCUEBSHHSw_enum_maxval KOUTP_VCUEBSHHSw_enum_minval /end REF_CHARACTERISTIC /end GROUP
/begin GROUP S826_Signal_Override "SWC_OUTP_type/run_SWC_OUTP_5ms_sys/OUTP/outpmodule/VTQD_VCUEBSHHSw_enum_Inproc/Signal_Override"
 /begin REF_CHARACTERISTIC KOUTP_VCUEBSHHSw_enum_ovrdflg KOUTP_VCUEBSHHSw_enum_ovrdval /end REF_CHARACTERISTIC
/end GROUP
/begin GROUP S827_Signal_Limit "SWC_OUTP_type/run_SWC_OUTP_5ms_sys/OUTP/outpmodule/VTQD_VCUEBSRd4BR_enum_Inproc/Signal_Limit"
 /begin REF_CHARACTERISTIC KOUTP_VCUEBSRd4BR_enum_maxval KOUTP_VCUEBSRd4BR_enum_minval /end REF_CHARACTERISTIC
/end GROUP
/begin GROUP S827_Signal_Override "SWC_OUTP_type/run_SWC_OUTP_5ms_sys/OUTP/outpmodule/VTQD_VCUEBSRd4BR_enum_Inproc/Signal_Override"
 /begin REF_CHARACTERISTIC KOUTP_VCUEBSRd4BR_enum_ovrdflg KOUTP_VCUEBSRd4BR_enum_ovrdval /end REF_CHARACTERISTIC
/end GROUP
/begin GROUP S828_Signal_Limit "SWC_OUTP_type/run_SWC_OUTP_5ms_sys/OUTP/outpmodule/VTQD_VCUMCUCtrlMdTQD_enum_Inproc/Signal_Limit"
 /begin REF_CHARACTERISTIC KOUTP_VCUMCUCtrlMdTQD_enum_maxval KOUTP_VCUMCUCtrlMdTQD_enum_minval /end REF_CHARACTERISTIC
/end GROUP
/begin GROUP S828_Signal_Override "SWC_OUTP_type/run_SWC_OUTP_5ms_sys/OUTP/outpmodule/VTQD_VCUMCUCtrlMdTQD_enum_Inproc/Signal_Override"
 /begin REF_CHARACTERISTIC KOUTP_VCUMCUCtrlMdTQD_enum_ovrdflg KOUTP_VCUMCUCtrlMdTQD_enum_ovrdval /end REF_CHARACTERISTIC
/end GROUP
/begin GROUP S829_Signal_Limit "SWC_OUTP_type/run_SWC_OUTP_5ms_sys/OUTP/outpmodule/VTQD_VCUMCUDemHiPosVal_rpm_Inproc/Signal_Limit"
 /begin REF_CHARACTERISTIC KOUTP_VCUMCUDemHiPosVal_rpm_maxval KOUTP_VCUMCUDemHiPosVal_rpm_minval /end REF_CHARACTERISTIC
/end GROUP
/begin GROUP S829_Signal_Override "SWC_OUTP_type/run_SWC_OUTP_5ms_sys/OUTP/outpmodule/VTQD_VCUMCUDemHiPosVal_rpm_Inproc/Signal_Override"
 /begin REF_CHARACTERISTIC KOUTP_VCUMCUDemHiPosVal_rpm_ovrdflg KOUTP_VCUMCUDemHiPosVal_rpm_ovrdval /end REF_CHARACTERISTIC
/end GROUP
/begin GROUP S830_Signal_Limit "SWC_OUTP_type/run_SWC_OUTP_5ms_sys/OUTP/outpmodule/VTQD_VCUMCUDemLoNegVal_rpm_Inproc/Signal_Limit"
 /begin REF_CHARACTERISTIC KOUTP_VCUMCUDemLoNegVal_rpm_maxval KOUTP_VCUMCUDemLoNegVal_rpm_minval /end REF_CHARACTERISTIC
/end GROUP
/begin GROUP S830_Signal_Override "SWC_OUTP_type/run_SWC_OUTP_5ms_sys/OUTP/outpmodule/VTQD_VCUMCUDemLoNegVal_rpm_Inproc/Signal_Override"
 /begin REF_CHARACTERISTIC KOUTP_VCUMCUDemLoNegVal_rpm_ovrdflg KOUTP_VCUMCUDemLoNegVal_rpm_ovrdval /end REF_CHARACTERISTIC
/end GROUP
/begin GROUP S831_Signal_Limit "SWC_OUTP_type/run_SWC_OUTP_5ms_sys/OUTP/outpmodule/VTQD_VCUMCUDemSpd_rpm_Inproc/Signal_Limit"
 /begin REF_CHARACTERISTIC KOUTP_VCUMCUDemSpd_rpm_maxval KOUTP_VCUMCUDemSpd_rpm_minval /end REF_CHARACTERISTIC
/end GROUP
/begin GROUP S831_Signal_Override "SWC_OUTP_type/run_SWC_OUTP_5ms_sys/OUTP/outpmodule/VTQD_VCUMCUDemSpd_rpm_Inproc/Signal_Override"
 /begin REF_CHARACTERISTIC KOUTP_VCUMCUDemSpd_rpm_ovrdflg KOUTP_VCUMCUDemSpd_rpm_ovrdval /end REF_CHARACTERISTIC
/end GROUP
/begin GROUP S832_Signal_Limit "SWC_OUTP_type/run_SWC_OUTP_5ms_sys/OUTP/outpmodule/VTQD_VCUMCUFootBrk_flg_Inproc/Signal_Limit"
 /begin REF_CHARACTERISTIC KOUTP_VCUMCUFootBrk_flg_maxval KOUTP_VCUMCUFootBrk_flg_minval /end REF_CHARACTERISTIC
/end GROUP
/begin GROUP S832_Signal_Override "SWC_OUTP_type/run_SWC_OUTP_5ms_sys/OUTP/outpmodule/VTQD_VCUMCUFootBrk_flg_Inproc/Signal_Override"
 /begin REF_CHARACTERISTIC KOUTP_VCUMCUFootBrk_flg_ovrdflg KOUTP_VCUMCUFootBrk_flg_ovrdval /end REF_CHARACTERISTIC
/end GROUP
/begin GROUP S833_Signal_Limit "SWC_OUTP_type/run_SWC_OUTP_5ms_sys/OUTP/outpmodule/VTQD_VCUMCUGearSta_enum_Inproc/Signal_Limit"
 /begin REF_CHARACTERISTIC KOUTP_VCUMCUGearSta_enum_maxval KOUTP_VCUMCUGearSta_enum_minval /end REF_CHARACTERISTIC
/end GROUP
/begin GROUP S833_Signal_Override "SWC_OUTP_type/run_SWC_OUTP_5ms_sys/OUTP/outpmodule/VTQD_VCUMCUGearSta_enum_Inproc/Signal_Override"
 /begin REF_CHARACTERISTIC KOUTP_VCUMCUGearSta_enum_ovrdflg KOUTP_VCUMCUGearSta_enum_ovrdval /end REF_CHARACTERISTIC
/end GROUP
/begin GROUP S834_Signal_Limit "SWC_OUTP_type/run_SWC_OUTP_5ms_sys/OUTP/outpmodule/VTQD_VCUMCUHandBrk_flg_Inproc/Signal_Limit"
 /begin REF_CHARACTERISTIC KOUTP_VCUMCUHandBrk_flg_maxval KOUTP_VCUMCUHandBrk_flg_minval /end REF_CHARACTERISTIC
/end GROUP
/begin GROUP S834_Signal_Override "SWC_OUTP_type/run_SWC_OUTP_5ms_sys/OUTP/outpmodule/VTQD_VCUMCUHandBrk_flg_Inproc/Signal_Override"
 /begin REF_CHARACTERISTIC KOUTP_VCUMCUHandBrk_flg_ovrdflg KOUTP_VCUMCUHandBrk_flg_ovrdval /end REF_CHARACTERISTIC
/end GROUP
/begin GROUP S835_Signal_Limit "SWC_OUTP_type/run_SWC_OUTP_5ms_sys/OUTP/outpmodule/VTQD_VCUTMVehSpd_kph_Inproc/Signal_Limit" /begin REF_CHARACTERISTIC KOUTP_VCUTMVehSpd_kph_maxval KOUTP_VCUTMVehSpd_kph_minval /end REF_CHARACTERISTIC /end GROUP
/begin GROUP S835_Signal_Override "SWC_OUTP_type/run_SWC_OUTP_5ms_sys/OUTP/outpmodule/VTQD_VCUTMVehSpd_kph_Inproc/Signal_Override"
 /begin REF_CHARACTERISTIC KOUTP_VCUTMVehSpd_kph_ovrdflg KOUTP_VCUTMVehSpd_kph_ovrdval /end REF_CHARACTERISTIC
/end GROUP
/begin GROUP S836_Signal_Limit "SWC_OUTP_type/run_SWC_OUTP_5ms_sys/OUTP/outpmodule/VTQD_VehAcclLimitTG_mps2_Inproc/Signal_Limit"
 /begin REF_CHARACTERISTIC KOUTP_VehAcclLimitTG_mps2_maxval KOUTP_VehAcclLimitTG_mps2_minval /end REF_CHARACTERISTIC
/end GROUP
/begin GROUP S836_Signal_Override "SWC_OUTP_type/run_SWC_OUTP_5ms_sys/OUTP/outpmodule/VTQD_VehAcclLimitTG_mps2_Inproc/Signal_Override"
 /begin REF_CHARACTERISTIC KOUTP_VehAcclLimitTG_mps2_ovrdflg KOUTP_VehAcclLimitTG_mps2_ovrdval /end REF_CHARACTERISTIC
/end GROUP
/begin GROUP S837_Signal_Limit "SWC_OUTP_type/run_SWC_OUTP_5ms_sys/OUTP/outpmodule/VTQD_VehSpdLimitTG_kph_Inproc/Signal_Limit"
 /begin REF_CHARACTERISTIC KOUTP_VehSpdLimitTG_kph_maxval KOUTP_VehSpdLimitTG_kph_minval /end REF_CHARACTERISTIC
/end GROUP
/begin GROUP S837_Signal_Override "SWC_OUTP_type/run_SWC_OUTP_5ms_sys/OUTP/outpmodule/VTQD_VehSpdLimitTG_kph_Inproc/Signal_Override"
 /begin REF_CHARACTERISTIC KOUTP_VehSpdLimitTG_kph_ovrdflg KOUTP_VehSpdLimitTG_kph_ovrdval /end REF_CHARACTERISTIC
/end GROUP
/begin GROUP S838_Signal_Limit "SWC_OUTP_type/run_SWC_OUTP_5ms_sys/OUTP/outpmodule/VTQR_FrTMTqReq_Nm_Inproc/Signal_Limit" /begin REF_CHARACTERISTIC KOUTP_FrTMTqReq_Nm_maxval KOUTP_FrTMTqReq_Nm_minval /end REF_CHARACTERISTIC /end GROUP
/begin GROUP S838_Signal_Override "SWC_OUTP_type/run_SWC_OUTP_5ms_sys/OUTP/outpmodule/VTQR_FrTMTqReq_Nm_Inproc/Signal_Override" /begin REF_CHARACTERISTIC KOUTP_FrTMTqReq_Nm_ovrdflg KOUTP_FrTMTqReq_Nm_ovrdval /end REF_CHARACTERISTIC /end GROUP
/begin GROUP S839_Signal_Limit "SWC_OUTP_type/run_SWC_OUTP_5ms_sys/OUTP/outpmodule/VTQR_RrTMTqReq_Nm_Inproc/Signal_Limit" /begin REF_CHARACTERISTIC KOUTP_RrTMTqReq_Nm_maxval KOUTP_RrTMTqReq_Nm_minval /end REF_CHARACTERISTIC /end GROUP
/begin GROUP S839_Signal_Override "SWC_OUTP_type/run_SWC_OUTP_5ms_sys/OUTP/outpmodule/VTQR_RrTMTqReq_Nm_Inproc/Signal_Override" /begin REF_CHARACTERISTIC KOUTP_RrTMTqReq_Nm_ovrdflg KOUTP_RrTMTqReq_Nm_ovrdval /end REF_CHARACTERISTIC /end GROUP
/begin GROUP S840_Signal_Limit "SWC_OUTP_type/run_SWC_OUTP_5ms_sys/OUTP/outpmodule/VV2L_HVPO120VGrpALDSt_enum_Inproc/Signal_Limit"
 /begin REF_CHARACTERISTIC KOUTP_HVPO120VGrpALDSt_enum_maxval KOUTP_HVPO120VGrpALDSt_enum_minval /end REF_CHARACTERISTIC
/end GROUP
/begin GROUP S840_Signal_Override "SWC_OUTP_type/run_SWC_OUTP_5ms_sys/OUTP/outpmodule/VV2L_HVPO120VGrpALDSt_enum_Inproc/Signal_Override"
 /begin REF_CHARACTERISTIC KOUTP_HVPO120VGrpALDSt_enum_ovrdflg KOUTP_HVPO120VGrpALDSt_enum_ovrdval /end REF_CHARACTERISTIC
/end GROUP
/begin GROUP S841_Signal_Limit "SWC_OUTP_type/run_SWC_OUTP_5ms_sys/OUTP/outpmodule/VV2L_HVPO120VGrpBLDSt_enum_Inproc/Signal_Limit"
 /begin REF_CHARACTERISTIC KOUTP_HVPO120VGrpBLDSt_enum_maxval KOUTP_HVPO120VGrpBLDSt_enum_minval /end REF_CHARACTERISTIC
/end GROUP
/begin GROUP S841_Signal_Override "SWC_OUTP_type/run_SWC_OUTP_5ms_sys/OUTP/outpmodule/VV2L_HVPO120VGrpBLDSt_enum_Inproc/Signal_Override"
 /begin REF_CHARACTERISTIC KOUTP_HVPO120VGrpBLDSt_enum_ovrdflg KOUTP_HVPO120VGrpBLDSt_enum_ovrdval /end REF_CHARACTERISTIC
/end GROUP
/begin GROUP S842_Signal_Limit "SWC_OUTP_type/run_SWC_OUTP_5ms_sys/OUTP/outpmodule/VV2L_ReqOBCExtrV2LEna_enum_Inproc/Signal_Limit"
 /begin REF_CHARACTERISTIC KOUTP_ReqOBCExtrV2LEna_enum_maxval KOUTP_ReqOBCExtrV2LEna_enum_minval /end REF_CHARACTERISTIC
/end GROUP
/end MODULE
/end PROJECT
