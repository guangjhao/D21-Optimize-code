ASAP2_VERSION 1 31
/begin PROJECT ProjectName "Project Comment Goes Here"
/begin HEADER "Header Comments go here" /end HEADER
/begin MODULE ModuleName "Module Comment Goes Here"
/begin MOD_COMMON "Mod Common Comment Here" BYTE_ORDER MSB_LAST /end MOD_COMMON
/begin RECORD_LAYOUT Scalar_BOOLEAN FNC_VALUES 1 UBYTE COLUMN_DIR DIRECT /end RECORD_LAYOUT
/begin RECORD_LAYOUT Scalar_UBYTE FNC_VALUES 1 UBYTE COLUMN_DIR DIRECT /end RECORD_LAYOUT
/begin RECORD_LAYOUT Scalar_UWORD FNC_VALUES 1 UWORD COLUMN_DIR DIRECT /end RECORD_LAYOUT
/begin RECORD_LAYOUT Scalar_FLOAT32_IEEE FNC_VALUES 1 FLOAT32_IEEE COLUMN_DIR DIRECT /end RECORD_LAYOUT
/begin RECORD_LAYOUT Lookup1D_X_BYTE AXIS_PTS_X 1 SBYTE INDEX_INCR DIRECT /end RECORD_LAYOUT
/begin RECORD_LAYOUT Lookup1D_UBYTE FNC_VALUES 1 UBYTE COLUMN_DIR DIRECT /end RECORD_LAYOUT
/begin RECORD_LAYOUT Lookup1D_X_UBYTE AXIS_PTS_X 1 UBYTE INDEX_INCR DIRECT /end RECORD_LAYOUT
/begin RECORD_LAYOUT Lookup1D_UWORD FNC_VALUES 1 UWORD COLUMN_DIR DIRECT /end RECORD_LAYOUT
/begin RECORD_LAYOUT Lookup1D_X_UWORD AXIS_PTS_X 1 UWORD INDEX_INCR DIRECT /end RECORD_LAYOUT
/begin RECORD_LAYOUT Lookup1D_WORD FNC_VALUES 1 SWORD COLUMN_DIR DIRECT /end RECORD_LAYOUT
/begin RECORD_LAYOUT Lookup1D_X_WORD AXIS_PTS_X 1 SWORD INDEX_INCR DIRECT /end RECORD_LAYOUT
/begin CHARACTERISTIC KOUTP_APSAngleTarget_Deg_maxval "" VALUE 0x0000 /* @ECU_Address@KOUTP_APSAngleTarget_Deg_maxval@ */ Scalar_FLOAT32_IEEE 0 SWC_OUTP_type_CM_single_Deg -65535.0 65535.0 /end CHARACTERISTIC
/begin CHARACTERISTIC KOUTP_APSAngleTarget_Deg_minval "" VALUE 0x0000 /* @ECU_Address@KOUTP_APSAngleTarget_Deg_minval@ */ Scalar_FLOAT32_IEEE 0 SWC_OUTP_type_CM_single_Deg -65535.0 65535.0 /end CHARACTERISTIC
/begin CHARACTERISTIC KOUTP_APSAngleTarget_Deg_ovrdval "" VALUE 0x0000 /* @ECU_Address@KOUTP_APSAngleTarget_Deg_ovrdval@ */ Scalar_FLOAT32_IEEE 0 SWC_OUTP_type_CM_single_Deg -65535.0 65535.0 /end CHARACTERISTIC
/begin CHARACTERISTIC KOUTP_APSProgressPCT_pct_maxval "" VALUE 0x0000 /* @ECU_Address@KOUTP_APSProgressPCT_pct_maxval@ */ Scalar_FLOAT32_IEEE 0 SWC_OUTP_type_CM_single_pct -65535.0 65535.0 /end CHARACTERISTIC
/begin CHARACTERISTIC KOUTP_APSProgressPCT_pct_minval "" VALUE 0x0000 /* @ECU_Address@KOUTP_APSProgressPCT_pct_minval@ */ Scalar_FLOAT32_IEEE 0 SWC_OUTP_type_CM_single_pct -65535.0 65535.0 /end CHARACTERISTIC
/begin CHARACTERISTIC KOUTP_APSProgressPCT_pct_ovrdval "" VALUE 0x0000 /* @ECU_Address@KOUTP_APSProgressPCT_pct_ovrdval@ */ Scalar_FLOAT32_IEEE 0 SWC_OUTP_type_CM_single_pct -65535.0 65535.0 /end CHARACTERISTIC
/begin CHARACTERISTIC KOUTP_APSSpeedCMD_kph_maxval "" VALUE 0x0000 /* @ECU_Address@KOUTP_APSSpeedCMD_kph_maxval@ */ Scalar_FLOAT32_IEEE 0 SWC_OUTP_type_CM_single_kph -65535.0 65535.0 /end CHARACTERISTIC
/begin CHARACTERISTIC KOUTP_APSSpeedCMD_kph_minval "" VALUE 0x0000 /* @ECU_Address@KOUTP_APSSpeedCMD_kph_minval@ */ Scalar_FLOAT32_IEEE 0 SWC_OUTP_type_CM_single_kph -65535.0 65535.0 /end CHARACTERISTIC
/begin CHARACTERISTIC KOUTP_APSSpeedCMD_kph_ovrdval "" VALUE 0x0000 /* @ECU_Address@KOUTP_APSSpeedCMD_kph_ovrdval@ */ Scalar_FLOAT32_IEEE 0 SWC_OUTP_type_CM_single_kph -65535.0 65535.0 /end CHARACTERISTIC
/begin CHARACTERISTIC KOUTP_BrkPedalPos_pct_maxval "" VALUE 0x0000 /* @ECU_Address@KOUTP_BrkPedalPos_pct_maxval@ */ Scalar_FLOAT32_IEEE 0 SWC_OUTP_type_CM_single_pct -65535.0 65535.0 /end CHARACTERISTIC
/begin CHARACTERISTIC KOUTP_BrkPedalPos_pct_minval "" VALUE 0x0000 /* @ECU_Address@KOUTP_BrkPedalPos_pct_minval@ */ Scalar_FLOAT32_IEEE 0 SWC_OUTP_type_CM_single_pct -65535.0 65535.0 /end CHARACTERISTIC
/begin CHARACTERISTIC KOUTP_BrkPedalPos_pct_ovrdval "" VALUE 0x0000 /* @ECU_Address@KOUTP_BrkPedalPos_pct_ovrdval@ */ Scalar_FLOAT32_IEEE 0 SWC_OUTP_type_CM_single_pct -65535.0 65535.0 /end CHARACTERISTIC
/begin CHARACTERISTIC KOUTP_EACSpdDemand_rpm_maxval "" VALUE 0x0000 /* @ECU_Address@KOUTP_EACSpdDemand_rpm_maxval@ */ Scalar_FLOAT32_IEEE 0 SWC_OUTP_type_CM_single_rpm -100000.0 100000.0 /end CHARACTERISTIC
/begin CHARACTERISTIC KOUTP_EACSpdDemand_rpm_minval "" VALUE 0x0000 /* @ECU_Address@KOUTP_EACSpdDemand_rpm_minval@ */ Scalar_FLOAT32_IEEE 0 SWC_OUTP_type_CM_single_rpm -100000.0 100000.0 /end CHARACTERISTIC
/begin CHARACTERISTIC KOUTP_EACSpdDemand_rpm_ovrdval "" VALUE 0x0000 /* @ECU_Address@KOUTP_EACSpdDemand_rpm_ovrdval@ */ Scalar_FLOAT32_IEEE 0 SWC_OUTP_type_CM_single_rpm -100000.0 100000.0 /end CHARACTERISTIC
/begin CHARACTERISTIC KOUTP_EHPSMotorDemSpd_rpm_maxval "" VALUE 0x0000 /* @ECU_Address@KOUTP_EHPSMotorDemSpd_rpm_maxval@ */ Scalar_FLOAT32_IEEE 0 SWC_OUTP_type_CM_single_rpm -65535.0 65535.0 /end CHARACTERISTIC
/begin CHARACTERISTIC KOUTP_EHPSMotorDemSpd_rpm_minval "" VALUE 0x0000 /* @ECU_Address@KOUTP_EHPSMotorDemSpd_rpm_minval@ */ Scalar_FLOAT32_IEEE 0 SWC_OUTP_type_CM_single_rpm -65535.0 65535.0 /end CHARACTERISTIC
/begin CHARACTERISTIC KOUTP_EHPSMotorDemSpd_rpm_ovrdval "" VALUE 0x0000 /* @ECU_Address@KOUTP_EHPSMotorDemSpd_rpm_ovrdval@ */ Scalar_FLOAT32_IEEE 0 SWC_OUTP_type_CM_single_rpm -65535.0 65535.0 /end CHARACTERISTIC
/begin CHARACTERISTIC KOUTP_EHPSSpdCtrlMode_enum_maxval "" VALUE 0x0000 /* @ECU_Address@KOUTP_EHPSSpdCtrlMode_enum_maxval@ */ Scalar_FLOAT32_IEEE 0 SWC_OUTP_type_CM_single_enum -65535.0 65535.0 /end CHARACTERISTIC
/begin CHARACTERISTIC KOUTP_EHPSSpdCtrlMode_enum_minval "" VALUE 0x0000 /* @ECU_Address@KOUTP_EHPSSpdCtrlMode_enum_minval@ */ Scalar_FLOAT32_IEEE 0 SWC_OUTP_type_CM_single_enum -65535.0 65535.0 /end CHARACTERISTIC
/begin CHARACTERISTIC KOUTP_EHPSSpdCtrlMode_enum_ovrdval "" VALUE 0x0000 /* @ECU_Address@KOUTP_EHPSSpdCtrlMode_enum_ovrdval@ */ Scalar_FLOAT32_IEEE 0 SWC_OUTP_type_CM_single_enum -65535.0 65535.0 /end CHARACTERISTIC
/begin CHARACTERISTIC KOUTP_APSDFLL_cm_maxval "" VALUE 0x0000 /* @ECU_Address@KOUTP_APSDFLL_cm_maxval@ */ Scalar_UWORD 0 SWC_OUTP_type_CM_uint16_cm 0.0 65535.0 /end CHARACTERISTIC
/begin CHARACTERISTIC KOUTP_APSDFLL_cm_minval "" VALUE 0x0000 /* @ECU_Address@KOUTP_APSDFLL_cm_minval@ */ Scalar_UWORD 0 SWC_OUTP_type_CM_uint16_cm 0.0 65535.0 /end CHARACTERISTIC
/begin CHARACTERISTIC KOUTP_APSDFLL_cm_ovrdval "" VALUE 0x0000 /* @ECU_Address@KOUTP_APSDFLL_cm_ovrdval@ */ Scalar_UWORD 0 SWC_OUTP_type_CM_uint16_cm 0.0 65535.0 /end CHARACTERISTIC
/begin CHARACTERISTIC KOUTP_APSDFLR_cm_maxval "" VALUE 0x0000 /* @ECU_Address@KOUTP_APSDFLR_cm_maxval@ */ Scalar_UWORD 0 SWC_OUTP_type_CM_uint16_cm 0.0 65535.0 /end CHARACTERISTIC
/begin CHARACTERISTIC KOUTP_APSDFLR_cm_minval "" VALUE 0x0000 /* @ECU_Address@KOUTP_APSDFLR_cm_minval@ */ Scalar_UWORD 0 SWC_OUTP_type_CM_uint16_cm 0.0 65535.0 /end CHARACTERISTIC
/begin CHARACTERISTIC KOUTP_APSDFLR_cm_ovrdval "" VALUE 0x0000 /* @ECU_Address@KOUTP_APSDFLR_cm_ovrdval@ */ Scalar_UWORD 0 SWC_OUTP_type_CM_uint16_cm 0.0 65535.0 /end CHARACTERISTIC
/begin CHARACTERISTIC KOUTP_APSDRLL_cm_maxval "" VALUE 0x0000 /* @ECU_Address@KOUTP_APSDRLL_cm_maxval@ */ Scalar_UWORD 0 SWC_OUTP_type_CM_uint16_cm 0.0 65535.0 /end CHARACTERISTIC
/begin CHARACTERISTIC KOUTP_APSDRLL_cm_minval "" VALUE 0x0000 /* @ECU_Address@KOUTP_APSDRLL_cm_minval@ */ Scalar_UWORD 0 SWC_OUTP_type_CM_uint16_cm 0.0 65535.0 /end CHARACTERISTIC
/begin CHARACTERISTIC KOUTP_APSDRLL_cm_ovrdval "" VALUE 0x0000 /* @ECU_Address@KOUTP_APSDRLL_cm_ovrdval@ */ Scalar_UWORD 0 SWC_OUTP_type_CM_uint16_cm 0.0 65535.0 /end CHARACTERISTIC
/begin CHARACTERISTIC KOUTP_APSDRLR_cm_maxval "" VALUE 0x0000 /* @ECU_Address@KOUTP_APSDRLR_cm_maxval@ */ Scalar_UWORD 0 SWC_OUTP_type_CM_uint16_cm 0.0 65535.0 /end CHARACTERISTIC
/begin CHARACTERISTIC KOUTP_APSDRLR_cm_minval "" VALUE 0x0000 /* @ECU_Address@KOUTP_APSDRLR_cm_minval@ */ Scalar_UWORD 0 SWC_OUTP_type_CM_uint16_cm 0.0 65535.0 /end CHARACTERISTIC
/begin CHARACTERISTIC KOUTP_APSDRLR_cm_ovrdval "" VALUE 0x0000 /* @ECU_Address@KOUTP_APSDRLR_cm_ovrdval@ */ Scalar_UWORD 0 SWC_OUTP_type_CM_uint16_cm 0.0 65535.0 /end CHARACTERISTIC
/begin CHARACTERISTIC KOUTP_ABSActiveTimeOut_flg_maxval "" VALUE 0x0000 /* @ECU_Address@KOUTP_ABSActiveTimeOut_flg_maxval@ */ Scalar_BOOLEAN 0 SWC_OUTP_type_CM_boolean_flg 0.0 1.0 /end CHARACTERISTIC
/begin CHARACTERISTIC KOUTP_ABSActiveTimeOut_flg_minval "" VALUE 0x0000 /* @ECU_Address@KOUTP_ABSActiveTimeOut_flg_minval@ */ Scalar_BOOLEAN 0 SWC_OUTP_type_CM_boolean_flg 0.0 1.0 /end CHARACTERISTIC
/begin CHARACTERISTIC KOUTP_ABSActiveTimeOut_flg_ovrdflg "" VALUE 0x0000 /* @ECU_Address@KOUTP_ABSActiveTimeOut_flg_ovrdflg@ */ Scalar_BOOLEAN 0 SWC_OUTP_type_CM_boolean_flg 0.0 1.0 /end CHARACTERISTIC
/begin CHARACTERISTIC KOUTP_ABSActiveTimeOut_flg_ovrdval "" VALUE 0x0000 /* @ECU_Address@KOUTP_ABSActiveTimeOut_flg_ovrdval@ */ Scalar_BOOLEAN 0 SWC_OUTP_type_CM_boolean_flg 0.0 1.0 /end CHARACTERISTIC
/begin CHARACTERISTIC KOUTP_ABSActive_flg_maxval "" VALUE 0x0000 /* @ECU_Address@KOUTP_ABSActive_flg_maxval@ */ Scalar_BOOLEAN 0 SWC_OUTP_type_CM_boolean_flg 0.0 1.0 /end CHARACTERISTIC
/begin CHARACTERISTIC KOUTP_ABSActive_flg_minval "" VALUE 0x0000 /* @ECU_Address@KOUTP_ABSActive_flg_minval@ */ Scalar_BOOLEAN 0 SWC_OUTP_type_CM_boolean_flg 0.0 1.0 /end CHARACTERISTIC
/begin CHARACTERISTIC KOUTP_ABSActive_flg_ovrdflg "" VALUE 0x0000 /* @ECU_Address@KOUTP_ABSActive_flg_ovrdflg@ */ Scalar_BOOLEAN 0 SWC_OUTP_type_CM_boolean_flg 0.0 1.0 /end CHARACTERISTIC
/begin CHARACTERISTIC KOUTP_ABSActive_flg_ovrdval "" VALUE 0x0000 /* @ECU_Address@KOUTP_ABSActive_flg_ovrdval@ */ Scalar_BOOLEAN 0 SWC_OUTP_type_CM_boolean_flg 0.0 1.0 /end CHARACTERISTIC
/begin CHARACTERISTIC KOUTP_APSAngleTarget_Deg_ovrdflg "" VALUE 0x0000 /* @ECU_Address@KOUTP_APSAngleTarget_Deg_ovrdflg@ */ Scalar_BOOLEAN 0 SWC_OUTP_type_CM_boolean_flg 0.0 1.0 /end CHARACTERISTIC
/begin CHARACTERISTIC KOUTP_APSDFLL_cm_ovrdflg "" VALUE 0x0000 /* @ECU_Address@KOUTP_APSDFLL_cm_ovrdflg@ */ Scalar_BOOLEAN 0 SWC_OUTP_type_CM_boolean_flg 0.0 1.0 /end CHARACTERISTIC
/begin CHARACTERISTIC KOUTP_APSDFLR_cm_ovrdflg "" VALUE 0x0000 /* @ECU_Address@KOUTP_APSDFLR_cm_ovrdflg@ */ Scalar_BOOLEAN 0 SWC_OUTP_type_CM_boolean_flg 0.0 1.0 /end CHARACTERISTIC
/begin CHARACTERISTIC KOUTP_APSDRLL_cm_ovrdflg "" VALUE 0x0000 /* @ECU_Address@KOUTP_APSDRLL_cm_ovrdflg@ */ Scalar_BOOLEAN 0 SWC_OUTP_type_CM_boolean_flg 0.0 1.0 /end CHARACTERISTIC
/begin CHARACTERISTIC KOUTP_APSDRLR_cm_ovrdflg "" VALUE 0x0000 /* @ECU_Address@KOUTP_APSDRLR_cm_ovrdflg@ */ Scalar_BOOLEAN 0 SWC_OUTP_type_CM_boolean_flg 0.0 1.0 /end CHARACTERISTIC
/begin CHARACTERISTIC KOUTP_APSExitCondition_enum_ovrdflg "" VALUE 0x0000 /* @ECU_Address@KOUTP_APSExitCondition_enum_ovrdflg@ */ Scalar_BOOLEAN 0 SWC_OUTP_type_CM_boolean_flg 0.0 1.0 /end CHARACTERISTIC
/begin CHARACTERISTIC KOUTP_APSHWVer_enum_ovrdflg "" VALUE 0x0000 /* @ECU_Address@KOUTP_APSHWVer_enum_ovrdflg@ */ Scalar_BOOLEAN 0 SWC_OUTP_type_CM_boolean_flg 0.0 1.0 /end CHARACTERISTIC
/begin CHARACTERISTIC KOUTP_APSProgressPCT_pct_ovrdflg "" VALUE 0x0000 /* @ECU_Address@KOUTP_APSProgressPCT_pct_ovrdflg@ */ Scalar_BOOLEAN 0 SWC_OUTP_type_CM_boolean_flg 0.0 1.0 /end CHARACTERISTIC
/begin CHARACTERISTIC KOUTP_APSPwrReq_enum_ovrdflg "" VALUE 0x0000 /* @ECU_Address@KOUTP_APSPwrReq_enum_ovrdflg@ */ Scalar_BOOLEAN 0 SWC_OUTP_type_CM_boolean_flg 0.0 1.0 /end CHARACTERISTIC
/begin CHARACTERISTIC KOUTP_APSRQDisplay_enum_ovrdflg "" VALUE 0x0000 /* @ECU_Address@KOUTP_APSRQDisplay_enum_ovrdflg@ */ Scalar_BOOLEAN 0 SWC_OUTP_type_CM_boolean_flg 0.0 1.0 /end CHARACTERISTIC
/begin CHARACTERISTIC KOUTP_APSRqEPASCtrl_flg_maxval "" VALUE 0x0000 /* @ECU_Address@KOUTP_APSRqEPASCtrl_flg_maxval@ */ Scalar_BOOLEAN 0 SWC_OUTP_type_CM_boolean_flg 0.0 1.0 /end CHARACTERISTIC
/begin CHARACTERISTIC KOUTP_APSRqEPASCtrl_flg_minval "" VALUE 0x0000 /* @ECU_Address@KOUTP_APSRqEPASCtrl_flg_minval@ */ Scalar_BOOLEAN 0 SWC_OUTP_type_CM_boolean_flg 0.0 1.0 /end CHARACTERISTIC
/begin CHARACTERISTIC KOUTP_APSRqEPASCtrl_flg_ovrdflg "" VALUE 0x0000 /* @ECU_Address@KOUTP_APSRqEPASCtrl_flg_ovrdflg@ */ Scalar_BOOLEAN 0 SWC_OUTP_type_CM_boolean_flg 0.0 1.0 /end CHARACTERISTIC
/begin CHARACTERISTIC KOUTP_APSRqEPASCtrl_flg_ovrdval "" VALUE 0x0000 /* @ECU_Address@KOUTP_APSRqEPASCtrl_flg_ovrdval@ */ Scalar_BOOLEAN 0 SWC_OUTP_type_CM_boolean_flg 0.0 1.0 /end CHARACTERISTIC
/begin CHARACTERISTIC KOUTP_APSSWVer_enum_ovrdflg "" VALUE 0x0000 /* @ECU_Address@KOUTP_APSSWVer_enum_ovrdflg@ */ Scalar_BOOLEAN 0 SWC_OUTP_type_CM_boolean_flg 0.0 1.0 /end CHARACTERISTIC
/begin CHARACTERISTIC KOUTP_APSShiftPosnReq_enum_ovrdflg "" VALUE 0x0000 /* @ECU_Address@KOUTP_APSShiftPosnReq_enum_ovrdflg@ */ Scalar_BOOLEAN 0 SWC_OUTP_type_CM_boolean_flg 0.0 1.0 /end CHARACTERISTIC
/begin CHARACTERISTIC KOUTP_APSSpeedCMD_kph_ovrdflg "" VALUE 0x0000 /* @ECU_Address@KOUTP_APSSpeedCMD_kph_ovrdflg@ */ Scalar_BOOLEAN 0 SWC_OUTP_type_CM_boolean_flg 0.0 1.0 /end CHARACTERISTIC
/begin CHARACTERISTIC KOUTP_APSVMCReqA_flg_maxval "" VALUE 0x0000 /* @ECU_Address@KOUTP_APSVMCReqA_flg_maxval@ */ Scalar_BOOLEAN 0 SWC_OUTP_type_CM_boolean_flg 0.0 1.0 /end CHARACTERISTIC
/begin CHARACTERISTIC KOUTP_APSVMCReqA_flg_minval "" VALUE 0x0000 /* @ECU_Address@KOUTP_APSVMCReqA_flg_minval@ */ Scalar_BOOLEAN 0 SWC_OUTP_type_CM_boolean_flg 0.0 1.0 /end CHARACTERISTIC
/begin CHARACTERISTIC KOUTP_APSVMCReqA_flg_ovrdflg "" VALUE 0x0000 /* @ECU_Address@KOUTP_APSVMCReqA_flg_ovrdflg@ */ Scalar_BOOLEAN 0 SWC_OUTP_type_CM_boolean_flg 0.0 1.0 /end CHARACTERISTIC
/begin CHARACTERISTIC KOUTP_APSVMCReqA_flg_ovrdval "" VALUE 0x0000 /* @ECU_Address@KOUTP_APSVMCReqA_flg_ovrdval@ */ Scalar_BOOLEAN 0 SWC_OUTP_type_CM_boolean_flg 0.0 1.0 /end CHARACTERISTIC
/begin CHARACTERISTIC KOUTP_APSVRqEPASCtrl_flg_maxval "" VALUE 0x0000 /* @ECU_Address@KOUTP_APSVRqEPASCtrl_flg_maxval@ */ Scalar_BOOLEAN 0 SWC_OUTP_type_CM_boolean_flg 0.0 1.0 /end CHARACTERISTIC
/begin CHARACTERISTIC KOUTP_APSVRqEPASCtrl_flg_minval "" VALUE 0x0000 /* @ECU_Address@KOUTP_APSVRqEPASCtrl_flg_minval@ */ Scalar_BOOLEAN 0 SWC_OUTP_type_CM_boolean_flg 0.0 1.0 /end CHARACTERISTIC
/begin CHARACTERISTIC KOUTP_APSVRqEPASCtrl_flg_ovrdflg "" VALUE 0x0000 /* @ECU_Address@KOUTP_APSVRqEPASCtrl_flg_ovrdflg@ */ Scalar_BOOLEAN 0 SWC_OUTP_type_CM_boolean_flg 0.0 1.0 /end CHARACTERISTIC
/begin CHARACTERISTIC KOUTP_APSVRqEPASCtrl_flg_ovrdval "" VALUE 0x0000 /* @ECU_Address@KOUTP_APSVRqEPASCtrl_flg_ovrdval@ */ Scalar_BOOLEAN 0 SWC_OUTP_type_CM_boolean_flg 0.0 1.0 /end CHARACTERISTIC
/begin CHARACTERISTIC KOUTP_AVMErrSTATimeOut_flg_maxval "" VALUE 0x0000 /* @ECU_Address@KOUTP_AVMErrSTATimeOut_flg_maxval@ */ Scalar_BOOLEAN 0 SWC_OUTP_type_CM_boolean_flg 0.0 1.0 /end CHARACTERISTIC
/begin CHARACTERISTIC KOUTP_AVMErrSTATimeOut_flg_minval "" VALUE 0x0000 /* @ECU_Address@KOUTP_AVMErrSTATimeOut_flg_minval@ */ Scalar_BOOLEAN 0 SWC_OUTP_type_CM_boolean_flg 0.0 1.0 /end CHARACTERISTIC
/begin CHARACTERISTIC KOUTP_AVMErrSTATimeOut_flg_ovrdflg "" VALUE 0x0000 /* @ECU_Address@KOUTP_AVMErrSTATimeOut_flg_ovrdflg@ */ Scalar_BOOLEAN 0 SWC_OUTP_type_CM_boolean_flg 0.0 1.0 /end CHARACTERISTIC
/begin CHARACTERISTIC KOUTP_AVMErrSTATimeOut_flg_ovrdval "" VALUE 0x0000 /* @ECU_Address@KOUTP_AVMErrSTATimeOut_flg_ovrdval@ */ Scalar_BOOLEAN 0 SWC_OUTP_type_CM_boolean_flg 0.0 1.0 /end CHARACTERISTIC
/begin CHARACTERISTIC KOUTP_AVMErrSTA_flg_maxval "" VALUE 0x0000 /* @ECU_Address@KOUTP_AVMErrSTA_flg_maxval@ */ Scalar_BOOLEAN 0 SWC_OUTP_type_CM_boolean_flg 0.0 1.0 /end CHARACTERISTIC
/begin CHARACTERISTIC KOUTP_AVMErrSTA_flg_minval "" VALUE 0x0000 /* @ECU_Address@KOUTP_AVMErrSTA_flg_minval@ */ Scalar_BOOLEAN 0 SWC_OUTP_type_CM_boolean_flg 0.0 1.0 /end CHARACTERISTIC
/begin CHARACTERISTIC KOUTP_AVMErrSTA_flg_ovrdflg "" VALUE 0x0000 /* @ECU_Address@KOUTP_AVMErrSTA_flg_ovrdflg@ */ Scalar_BOOLEAN 0 SWC_OUTP_type_CM_boolean_flg 0.0 1.0 /end CHARACTERISTIC
/begin CHARACTERISTIC KOUTP_AVMErrSTA_flg_ovrdval "" VALUE 0x0000 /* @ECU_Address@KOUTP_AVMErrSTA_flg_ovrdval@ */ Scalar_BOOLEAN 0 SWC_OUTP_type_CM_boolean_flg 0.0 1.0 /end CHARACTERISTIC
/begin CHARACTERISTIC KOUTP_AVMParkingmodeTimeOut_flg_maxval "" VALUE 0x0000 /* @ECU_Address@KOUTP_AVMParkingmodeTimeOut_flg_maxval@ */ Scalar_BOOLEAN 0 SWC_OUTP_type_CM_boolean_flg 0.0 1.0 /end CHARACTERISTIC
/begin CHARACTERISTIC KOUTP_AVMParkingmodeTimeOut_flg_minval "" VALUE 0x0000 /* @ECU_Address@KOUTP_AVMParkingmodeTimeOut_flg_minval@ */ Scalar_BOOLEAN 0 SWC_OUTP_type_CM_boolean_flg 0.0 1.0 /end CHARACTERISTIC
/begin CHARACTERISTIC KOUTP_AVMParkingmodeTimeOut_flg_ovrdflg "" VALUE 0x0000 /* @ECU_Address@KOUTP_AVMParkingmodeTimeOut_flg_ovrdflg@ */ Scalar_BOOLEAN 0 SWC_OUTP_type_CM_boolean_flg 0.0 1.0 /end CHARACTERISTIC
/begin CHARACTERISTIC KOUTP_AVMParkingmodeTimeOut_flg_ovrdval "" VALUE 0x0000 /* @ECU_Address@KOUTP_AVMParkingmodeTimeOut_flg_ovrdval@ */ Scalar_BOOLEAN 0 SWC_OUTP_type_CM_boolean_flg 0.0 1.0 /end CHARACTERISTIC
/begin CHARACTERISTIC KOUTP_AVMParkingmode_enum_ovrdflg "" VALUE 0x0000 /* @ECU_Address@KOUTP_AVMParkingmode_enum_ovrdflg@ */ Scalar_BOOLEAN 0 SWC_OUTP_type_CM_boolean_flg 0.0 1.0 /end CHARACTERISTIC
/begin CHARACTERISTIC KOUTP_AVMparkingcancelTimeOut_flg_maxval "" VALUE 0x0000 /* @ECU_Address@KOUTP_AVMparkingcancelTimeOut_flg_maxval@ */ Scalar_BOOLEAN 0 SWC_OUTP_type_CM_boolean_flg 0.0 1.0 /end CHARACTERISTIC
/begin CHARACTERISTIC KOUTP_AVMparkingcancelTimeOut_flg_minval "" VALUE 0x0000 /* @ECU_Address@KOUTP_AVMparkingcancelTimeOut_flg_minval@ */ Scalar_BOOLEAN 0 SWC_OUTP_type_CM_boolean_flg 0.0 1.0 /end CHARACTERISTIC
/begin CHARACTERISTIC KOUTP_AVMparkingcancelTimeOut_flg_ovrdflg "" VALUE 0x0000 /* @ECU_Address@KOUTP_AVMparkingcancelTimeOut_flg_ovrdflg@ */ Scalar_BOOLEAN 0 SWC_OUTP_type_CM_boolean_flg 0.0 1.0 /end CHARACTERISTIC
/begin CHARACTERISTIC KOUTP_AVMparkingcancelTimeOut_flg_ovrdval "" VALUE 0x0000 /* @ECU_Address@KOUTP_AVMparkingcancelTimeOut_flg_ovrdval@ */ Scalar_BOOLEAN 0 SWC_OUTP_type_CM_boolean_flg 0.0 1.0 /end CHARACTERISTIC
/begin CHARACTERISTIC KOUTP_AVMparkingcancel_enum_ovrdflg "" VALUE 0x0000 /* @ECU_Address@KOUTP_AVMparkingcancel_enum_ovrdflg@ */ Scalar_BOOLEAN 0 SWC_OUTP_type_CM_boolean_flg 0.0 1.0 /end CHARACTERISTIC
/begin CHARACTERISTIC KOUTP_AVMparkingexcuteTimeOut_flg_maxval "" VALUE 0x0000 /* @ECU_Address@KOUTP_AVMparkingexcuteTimeOut_flg_maxval@ */ Scalar_BOOLEAN 0 SWC_OUTP_type_CM_boolean_flg 0.0 1.0 /end CHARACTERISTIC
/begin CHARACTERISTIC KOUTP_AVMparkingexcuteTimeOut_flg_minval "" VALUE 0x0000 /* @ECU_Address@KOUTP_AVMparkingexcuteTimeOut_flg_minval@ */ Scalar_BOOLEAN 0 SWC_OUTP_type_CM_boolean_flg 0.0 1.0 /end CHARACTERISTIC
/begin CHARACTERISTIC KOUTP_AVMparkingexcuteTimeOut_flg_ovrdflg "" VALUE 0x0000 /* @ECU_Address@KOUTP_AVMparkingexcuteTimeOut_flg_ovrdflg@ */ Scalar_BOOLEAN 0 SWC_OUTP_type_CM_boolean_flg 0.0 1.0 /end CHARACTERISTIC
/begin CHARACTERISTIC KOUTP_AVMparkingexcuteTimeOut_flg_ovrdval "" VALUE 0x0000 /* @ECU_Address@KOUTP_AVMparkingexcuteTimeOut_flg_ovrdval@ */ Scalar_BOOLEAN 0 SWC_OUTP_type_CM_boolean_flg 0.0 1.0 /end CHARACTERISTIC
/begin CHARACTERISTIC KOUTP_AVMparkingexcute_enum_ovrdflg "" VALUE 0x0000 /* @ECU_Address@KOUTP_AVMparkingexcute_enum_ovrdflg@ */ Scalar_BOOLEAN 0 SWC_OUTP_type_CM_boolean_flg 0.0 1.0 /end CHARACTERISTIC
/begin CHARACTERISTIC KOUTP_BrkPedalPosTimeOut_flg_maxval "" VALUE 0x0000 /* @ECU_Address@KOUTP_BrkPedalPosTimeOut_flg_maxval@ */ Scalar_BOOLEAN 0 SWC_OUTP_type_CM_boolean_flg 0.0 1.0 /end CHARACTERISTIC
/begin CHARACTERISTIC KOUTP_BrkPedalPosTimeOut_flg_minval "" VALUE 0x0000 /* @ECU_Address@KOUTP_BrkPedalPosTimeOut_flg_minval@ */ Scalar_BOOLEAN 0 SWC_OUTP_type_CM_boolean_flg 0.0 1.0 /end CHARACTERISTIC
/begin CHARACTERISTIC KOUTP_BrkPedalPosTimeOut_flg_ovrdflg "" VALUE 0x0000 /* @ECU_Address@KOUTP_BrkPedalPosTimeOut_flg_ovrdflg@ */ Scalar_BOOLEAN 0 SWC_OUTP_type_CM_boolean_flg 0.0 1.0 /end CHARACTERISTIC
/begin CHARACTERISTIC KOUTP_BrkPedalPosTimeOut_flg_ovrdval "" VALUE 0x0000 /* @ECU_Address@KOUTP_BrkPedalPosTimeOut_flg_ovrdval@ */ Scalar_BOOLEAN 0 SWC_OUTP_type_CM_boolean_flg 0.0 1.0 /end CHARACTERISTIC
/begin CHARACTERISTIC KOUTP_BrkPedalPos_pct_ovrdflg "" VALUE 0x0000 /* @ECU_Address@KOUTP_BrkPedalPos_pct_ovrdflg@ */ Scalar_BOOLEAN 0 SWC_OUTP_type_CM_boolean_flg 0.0 1.0 /end CHARACTERISTIC
/begin CHARACTERISTIC KOUTP_BrkSwStaTimeOut_flg_maxval "" VALUE 0x0000 /* @ECU_Address@KOUTP_BrkSwStaTimeOut_flg_maxval@ */ Scalar_BOOLEAN 0 SWC_OUTP_type_CM_boolean_flg 0.0 1.0 /end CHARACTERISTIC
/begin CHARACTERISTIC KOUTP_BrkSwStaTimeOut_flg_minval "" VALUE 0x0000 /* @ECU_Address@KOUTP_BrkSwStaTimeOut_flg_minval@ */ Scalar_BOOLEAN 0 SWC_OUTP_type_CM_boolean_flg 0.0 1.0 /end CHARACTERISTIC
/begin CHARACTERISTIC KOUTP_BrkSwStaTimeOut_flg_ovrdflg "" VALUE 0x0000 /* @ECU_Address@KOUTP_BrkSwStaTimeOut_flg_ovrdflg@ */ Scalar_BOOLEAN 0 SWC_OUTP_type_CM_boolean_flg 0.0 1.0 /end CHARACTERISTIC
/begin CHARACTERISTIC KOUTP_BrkSwStaTimeOut_flg_ovrdval "" VALUE 0x0000 /* @ECU_Address@KOUTP_BrkSwStaTimeOut_flg_ovrdval@ */ Scalar_BOOLEAN 0 SWC_OUTP_type_CM_boolean_flg 0.0 1.0 /end CHARACTERISTIC
/begin CHARACTERISTIC KOUTP_BrkSwSta_flg_maxval "" VALUE 0x0000 /* @ECU_Address@KOUTP_BrkSwSta_flg_maxval@ */ Scalar_BOOLEAN 0 SWC_OUTP_type_CM_boolean_flg 0.0 1.0 /end CHARACTERISTIC
/begin CHARACTERISTIC KOUTP_BrkSwSta_flg_minval "" VALUE 0x0000 /* @ECU_Address@KOUTP_BrkSwSta_flg_minval@ */ Scalar_BOOLEAN 0 SWC_OUTP_type_CM_boolean_flg 0.0 1.0 /end CHARACTERISTIC
/begin CHARACTERISTIC KOUTP_BrkSwSta_flg_ovrdflg "" VALUE 0x0000 /* @ECU_Address@KOUTP_BrkSwSta_flg_ovrdflg@ */ Scalar_BOOLEAN 0 SWC_OUTP_type_CM_boolean_flg 0.0 1.0 /end CHARACTERISTIC
/begin CHARACTERISTIC KOUTP_BrkSwSta_flg_ovrdval "" VALUE 0x0000 /* @ECU_Address@KOUTP_BrkSwSta_flg_ovrdval@ */ Scalar_BOOLEAN 0 SWC_OUTP_type_CM_boolean_flg 0.0 1.0 /end CHARACTERISTIC
/begin CHARACTERISTIC KOUTP_BrkSwVTimeOut_flg_maxval "" VALUE 0x0000 /* @ECU_Address@KOUTP_BrkSwVTimeOut_flg_maxval@ */ Scalar_BOOLEAN 0 SWC_OUTP_type_CM_boolean_flg 0.0 1.0 /end CHARACTERISTIC
/begin CHARACTERISTIC KOUTP_BrkSwVTimeOut_flg_minval "" VALUE 0x0000 /* @ECU_Address@KOUTP_BrkSwVTimeOut_flg_minval@ */ Scalar_BOOLEAN 0 SWC_OUTP_type_CM_boolean_flg 0.0 1.0 /end CHARACTERISTIC
/begin CHARACTERISTIC KOUTP_BrkSwVTimeOut_flg_ovrdflg "" VALUE 0x0000 /* @ECU_Address@KOUTP_BrkSwVTimeOut_flg_ovrdflg@ */ Scalar_BOOLEAN 0 SWC_OUTP_type_CM_boolean_flg 0.0 1.0 /end CHARACTERISTIC
/begin CHARACTERISTIC KOUTP_BrkSwVTimeOut_flg_ovrdval "" VALUE 0x0000 /* @ECU_Address@KOUTP_BrkSwVTimeOut_flg_ovrdval@ */ Scalar_BOOLEAN 0 SWC_OUTP_type_CM_boolean_flg 0.0 1.0 /end CHARACTERISTIC
/begin CHARACTERISTIC KOUTP_BrkSwV_flg_maxval "" VALUE 0x0000 /* @ECU_Address@KOUTP_BrkSwV_flg_maxval@ */ Scalar_BOOLEAN 0 SWC_OUTP_type_CM_boolean_flg 0.0 1.0 /end CHARACTERISTIC
/begin CHARACTERISTIC KOUTP_BrkSwV_flg_minval "" VALUE 0x0000 /* @ECU_Address@KOUTP_BrkSwV_flg_minval@ */ Scalar_BOOLEAN 0 SWC_OUTP_type_CM_boolean_flg 0.0 1.0 /end CHARACTERISTIC
/begin CHARACTERISTIC KOUTP_BrkSwV_flg_ovrdflg "" VALUE 0x0000 /* @ECU_Address@KOUTP_BrkSwV_flg_ovrdflg@ */ Scalar_BOOLEAN 0 SWC_OUTP_type_CM_boolean_flg 0.0 1.0 /end CHARACTERISTIC
/begin CHARACTERISTIC KOUTP_BrkSwV_flg_ovrdval "" VALUE 0x0000 /* @ECU_Address@KOUTP_BrkSwV_flg_ovrdval@ */ Scalar_BOOLEAN 0 SWC_OUTP_type_CM_boolean_flg 0.0 1.0 /end CHARACTERISTIC
/begin CHARACTERISTIC KOUTP_CAASSta_enum_ovrdflg "" VALUE 0x0000 /* @ECU_Address@KOUTP_CAASSta_enum_ovrdflg@ */ Scalar_BOOLEAN 0 SWC_OUTP_type_CM_boolean_flg 0.0 1.0 /end CHARACTERISTIC
/begin CHARACTERISTIC KOUTP_CAASSwTimeOut_flg_maxval "" VALUE 0x0000 /* @ECU_Address@KOUTP_CAASSwTimeOut_flg_maxval@ */ Scalar_BOOLEAN 0 SWC_OUTP_type_CM_boolean_flg 0.0 1.0 /end CHARACTERISTIC
/begin CHARACTERISTIC KOUTP_CAASSwTimeOut_flg_minval "" VALUE 0x0000 /* @ECU_Address@KOUTP_CAASSwTimeOut_flg_minval@ */ Scalar_BOOLEAN 0 SWC_OUTP_type_CM_boolean_flg 0.0 1.0 /end CHARACTERISTIC
/begin CHARACTERISTIC KOUTP_CAASSwTimeOut_flg_ovrdflg "" VALUE 0x0000 /* @ECU_Address@KOUTP_CAASSwTimeOut_flg_ovrdflg@ */ Scalar_BOOLEAN 0 SWC_OUTP_type_CM_boolean_flg 0.0 1.0 /end CHARACTERISTIC
/begin CHARACTERISTIC KOUTP_CAASSwTimeOut_flg_ovrdval "" VALUE 0x0000 /* @ECU_Address@KOUTP_CAASSwTimeOut_flg_ovrdval@ */ Scalar_BOOLEAN 0 SWC_OUTP_type_CM_boolean_flg 0.0 1.0 /end CHARACTERISTIC
/begin CHARACTERISTIC KOUTP_CAASSw_enum_ovrdflg "" VALUE 0x0000 /* @ECU_Address@KOUTP_CAASSw_enum_ovrdflg@ */ Scalar_BOOLEAN 0 SWC_OUTP_type_CM_boolean_flg 0.0 1.0 /end CHARACTERISTIC
/begin CHARACTERISTIC KOUTP_CAASVMCReqA_flg_maxval "" VALUE 0x0000 /* @ECU_Address@KOUTP_CAASVMCReqA_flg_maxval@ */ Scalar_BOOLEAN 0 SWC_OUTP_type_CM_boolean_flg 0.0 1.0 /end CHARACTERISTIC
/begin CHARACTERISTIC KOUTP_CAASVMCReqA_flg_minval "" VALUE 0x0000 /* @ECU_Address@KOUTP_CAASVMCReqA_flg_minval@ */ Scalar_BOOLEAN 0 SWC_OUTP_type_CM_boolean_flg 0.0 1.0 /end CHARACTERISTIC
/begin CHARACTERISTIC KOUTP_CAASVMCReqA_flg_ovrdflg "" VALUE 0x0000 /* @ECU_Address@KOUTP_CAASVMCReqA_flg_ovrdflg@ */ Scalar_BOOLEAN 0 SWC_OUTP_type_CM_boolean_flg 0.0 1.0 /end CHARACTERISTIC
/begin CHARACTERISTIC KOUTP_CAASVMCReqA_flg_ovrdval "" VALUE 0x0000 /* @ECU_Address@KOUTP_CAASVMCReqA_flg_ovrdval@ */ Scalar_BOOLEAN 0 SWC_OUTP_type_CM_boolean_flg 0.0 1.0 /end CHARACTERISTIC
/begin CHARACTERISTIC KOUTP_CACFanReq_flg_maxval "" VALUE 0x0000 /* @ECU_Address@KOUTP_CACFanReq_flg_maxval@ */ Scalar_BOOLEAN 0 SWC_OUTP_type_CM_boolean_flg 0.0 1.0 /end CHARACTERISTIC
/begin CHARACTERISTIC KOUTP_CACFanReq_flg_minval "" VALUE 0x0000 /* @ECU_Address@KOUTP_CACFanReq_flg_minval@ */ Scalar_BOOLEAN 0 SWC_OUTP_type_CM_boolean_flg 0.0 1.0 /end CHARACTERISTIC
/begin CHARACTERISTIC KOUTP_CACFanReq_flg_ovrdflg "" VALUE 0x0000 /* @ECU_Address@KOUTP_CACFanReq_flg_ovrdflg@ */ Scalar_BOOLEAN 0 SWC_OUTP_type_CM_boolean_flg 0.0 1.0 /end CHARACTERISTIC
/begin CHARACTERISTIC KOUTP_CACFanReq_flg_ovrdval "" VALUE 0x0000 /* @ECU_Address@KOUTP_CACFanReq_flg_ovrdval@ */ Scalar_BOOLEAN 0 SWC_OUTP_type_CM_boolean_flg 0.0 1.0 /end CHARACTERISTIC
/begin CHARACTERISTIC KOUTP_CACOverrun_flg_maxval "" VALUE 0x0000 /* @ECU_Address@KOUTP_CACOverrun_flg_maxval@ */ Scalar_BOOLEAN 0 SWC_OUTP_type_CM_boolean_flg 0.0 1.0 /end CHARACTERISTIC
/begin CHARACTERISTIC KOUTP_CACOverrun_flg_minval "" VALUE 0x0000 /* @ECU_Address@KOUTP_CACOverrun_flg_minval@ */ Scalar_BOOLEAN 0 SWC_OUTP_type_CM_boolean_flg 0.0 1.0 /end CHARACTERISTIC
/begin CHARACTERISTIC KOUTP_CACOverrun_flg_ovrdflg "" VALUE 0x0000 /* @ECU_Address@KOUTP_CACOverrun_flg_ovrdflg@ */ Scalar_BOOLEAN 0 SWC_OUTP_type_CM_boolean_flg 0.0 1.0 /end CHARACTERISTIC
/begin CHARACTERISTIC KOUTP_CACOverrun_flg_ovrdval "" VALUE 0x0000 /* @ECU_Address@KOUTP_CACOverrun_flg_ovrdval@ */ Scalar_BOOLEAN 0 SWC_OUTP_type_CM_boolean_flg 0.0 1.0 /end CHARACTERISTIC
/begin CHARACTERISTIC KOUTP_CACPresReady_flg_maxval "" VALUE 0x0000 /* @ECU_Address@KOUTP_CACPresReady_flg_maxval@ */ Scalar_BOOLEAN 0 SWC_OUTP_type_CM_boolean_flg 0.0 1.0 /end CHARACTERISTIC
/begin CHARACTERISTIC KOUTP_CACPresReady_flg_minval "" VALUE 0x0000 /* @ECU_Address@KOUTP_CACPresReady_flg_minval@ */ Scalar_BOOLEAN 0 SWC_OUTP_type_CM_boolean_flg 0.0 1.0 /end CHARACTERISTIC
/begin CHARACTERISTIC KOUTP_CACPresReady_flg_ovrdflg "" VALUE 0x0000 /* @ECU_Address@KOUTP_CACPresReady_flg_ovrdflg@ */ Scalar_BOOLEAN 0 SWC_OUTP_type_CM_boolean_flg 0.0 1.0 /end CHARACTERISTIC
/begin CHARACTERISTIC KOUTP_CACPresReady_flg_ovrdval "" VALUE 0x0000 /* @ECU_Address@KOUTP_CACPresReady_flg_ovrdval@ */ Scalar_BOOLEAN 0 SWC_OUTP_type_CM_boolean_flg 0.0 1.0 /end CHARACTERISTIC
/begin CHARACTERISTIC KOUTP_CACPresWarn_flg_maxval "" VALUE 0x0000 /* @ECU_Address@KOUTP_CACPresWarn_flg_maxval@ */ Scalar_BOOLEAN 0 SWC_OUTP_type_CM_boolean_flg 0.0 1.0 /end CHARACTERISTIC
/begin CHARACTERISTIC KOUTP_CACPresWarn_flg_minval "" VALUE 0x0000 /* @ECU_Address@KOUTP_CACPresWarn_flg_minval@ */ Scalar_BOOLEAN 0 SWC_OUTP_type_CM_boolean_flg 0.0 1.0 /end CHARACTERISTIC
/begin CHARACTERISTIC KOUTP_CACPresWarn_flg_ovrdflg "" VALUE 0x0000 /* @ECU_Address@KOUTP_CACPresWarn_flg_ovrdflg@ */ Scalar_BOOLEAN 0 SWC_OUTP_type_CM_boolean_flg 0.0 1.0 /end CHARACTERISTIC
/begin CHARACTERISTIC KOUTP_CACPresWarn_flg_ovrdval "" VALUE 0x0000 /* @ECU_Address@KOUTP_CACPresWarn_flg_ovrdval@ */ Scalar_BOOLEAN 0 SWC_OUTP_type_CM_boolean_flg 0.0 1.0 /end CHARACTERISTIC
/begin CHARACTERISTIC KOUTP_CACRunFail_flg_maxval "" VALUE 0x0000 /* @ECU_Address@KOUTP_CACRunFail_flg_maxval@ */ Scalar_BOOLEAN 0 SWC_OUTP_type_CM_boolean_flg 0.0 1.0 /end CHARACTERISTIC
/begin CHARACTERISTIC KOUTP_CACRunFail_flg_minval "" VALUE 0x0000 /* @ECU_Address@KOUTP_CACRunFail_flg_minval@ */ Scalar_BOOLEAN 0 SWC_OUTP_type_CM_boolean_flg 0.0 1.0 /end CHARACTERISTIC
/begin CHARACTERISTIC KOUTP_CACRunFail_flg_ovrdflg "" VALUE 0x0000 /* @ECU_Address@KOUTP_CACRunFail_flg_ovrdflg@ */ Scalar_BOOLEAN 0 SWC_OUTP_type_CM_boolean_flg 0.0 1.0 /end CHARACTERISTIC
/begin CHARACTERISTIC KOUTP_CACRunFail_flg_ovrdval "" VALUE 0x0000 /* @ECU_Address@KOUTP_CACRunFail_flg_ovrdval@ */ Scalar_BOOLEAN 0 SWC_OUTP_type_CM_boolean_flg 0.0 1.0 /end CHARACTERISTIC
/begin CHARACTERISTIC KOUTP_CACTempOverHigh_flg_maxval "" VALUE 0x0000 /* @ECU_Address@KOUTP_CACTempOverHigh_flg_maxval@ */ Scalar_BOOLEAN 0 SWC_OUTP_type_CM_boolean_flg 0.0 1.0 /end CHARACTERISTIC
/begin CHARACTERISTIC KOUTP_CACTempOverHigh_flg_minval "" VALUE 0x0000 /* @ECU_Address@KOUTP_CACTempOverHigh_flg_minval@ */ Scalar_BOOLEAN 0 SWC_OUTP_type_CM_boolean_flg 0.0 1.0 /end CHARACTERISTIC
/begin CHARACTERISTIC KOUTP_CACTempOverHigh_flg_ovrdflg "" VALUE 0x0000 /* @ECU_Address@KOUTP_CACTempOverHigh_flg_ovrdflg@ */ Scalar_BOOLEAN 0 SWC_OUTP_type_CM_boolean_flg 0.0 1.0 /end CHARACTERISTIC
/begin CHARACTERISTIC KOUTP_CACTempOverHigh_flg_ovrdval "" VALUE 0x0000 /* @ECU_Address@KOUTP_CACTempOverHigh_flg_ovrdval@ */ Scalar_BOOLEAN 0 SWC_OUTP_type_CM_boolean_flg 0.0 1.0 /end CHARACTERISTIC
/begin CHARACTERISTIC KOUTP_Chime_enum_ovrdflg "" VALUE 0x0000 /* @ECU_Address@KOUTP_Chime_enum_ovrdflg@ */ Scalar_BOOLEAN 0 SWC_OUTP_type_CM_boolean_flg 0.0 1.0 /end CHARACTERISTIC
/begin CHARACTERISTIC KOUTP_DCDCEnDemamd_enum_ovrdflg "" VALUE 0x0000 /* @ECU_Address@KOUTP_DCDCEnDemamd_enum_ovrdflg@ */ Scalar_BOOLEAN 0 SWC_OUTP_type_CM_boolean_flg 0.0 1.0 /end CHARACTERISTIC
/begin CHARACTERISTIC KOUTP_EACEnDemand_enum_ovrdflg "" VALUE 0x0000 /* @ECU_Address@KOUTP_EACEnDemand_enum_ovrdflg@ */ Scalar_BOOLEAN 0 SWC_OUTP_type_CM_boolean_flg 0.0 1.0 /end CHARACTERISTIC
/begin CHARACTERISTIC KOUTP_EACSpdDemand_rpm_ovrdflg "" VALUE 0x0000 /* @ECU_Address@KOUTP_EACSpdDemand_rpm_ovrdflg@ */ Scalar_BOOLEAN 0 SWC_OUTP_type_CM_boolean_flg 0.0 1.0 /end CHARACTERISTIC
/begin CHARACTERISTIC KOUTP_EHPSDisEnTimeout_flg_maxval "" VALUE 0x0000 /* @ECU_Address@KOUTP_EHPSDisEnTimeout_flg_maxval@ */ Scalar_BOOLEAN 0 SWC_OUTP_type_CM_boolean_flg 0.0 1.0 /end CHARACTERISTIC
/begin CHARACTERISTIC KOUTP_EHPSDisEnTimeout_flg_minval "" VALUE 0x0000 /* @ECU_Address@KOUTP_EHPSDisEnTimeout_flg_minval@ */ Scalar_BOOLEAN 0 SWC_OUTP_type_CM_boolean_flg 0.0 1.0 /end CHARACTERISTIC
/begin CHARACTERISTIC KOUTP_EHPSDisEnTimeout_flg_ovrdflg "" VALUE 0x0000 /* @ECU_Address@KOUTP_EHPSDisEnTimeout_flg_ovrdflg@ */ Scalar_BOOLEAN 0 SWC_OUTP_type_CM_boolean_flg 0.0 1.0 /end CHARACTERISTIC
/begin CHARACTERISTIC KOUTP_EHPSDisEnTimeout_flg_ovrdval "" VALUE 0x0000 /* @ECU_Address@KOUTP_EHPSDisEnTimeout_flg_ovrdval@ */ Scalar_BOOLEAN 0 SWC_OUTP_type_CM_boolean_flg 0.0 1.0 /end CHARACTERISTIC
/begin CHARACTERISTIC KOUTP_EHPSEnDemand_enum_ovrdflg "" VALUE 0x0000 /* @ECU_Address@KOUTP_EHPSEnDemand_enum_ovrdflg@ */ Scalar_BOOLEAN 0 SWC_OUTP_type_CM_boolean_flg 0.0 1.0 /end CHARACTERISTIC
/begin CHARACTERISTIC KOUTP_EHPSEnTimeout_flg_maxval "" VALUE 0x0000 /* @ECU_Address@KOUTP_EHPSEnTimeout_flg_maxval@ */ Scalar_BOOLEAN 0 SWC_OUTP_type_CM_boolean_flg 0.0 1.0 /end CHARACTERISTIC
/begin CHARACTERISTIC KOUTP_EHPSEnTimeout_flg_minval "" VALUE 0x0000 /* @ECU_Address@KOUTP_EHPSEnTimeout_flg_minval@ */ Scalar_BOOLEAN 0 SWC_OUTP_type_CM_boolean_flg 0.0 1.0 /end CHARACTERISTIC
/begin CHARACTERISTIC KOUTP_EHPSEnTimeout_flg_ovrdflg "" VALUE 0x0000 /* @ECU_Address@KOUTP_EHPSEnTimeout_flg_ovrdflg@ */ Scalar_BOOLEAN 0 SWC_OUTP_type_CM_boolean_flg 0.0 1.0 /end CHARACTERISTIC
/begin CHARACTERISTIC KOUTP_EHPSEnTimeout_flg_ovrdval "" VALUE 0x0000 /* @ECU_Address@KOUTP_EHPSEnTimeout_flg_ovrdval@ */ Scalar_BOOLEAN 0 SWC_OUTP_type_CM_boolean_flg 0.0 1.0 /end CHARACTERISTIC
/begin CHARACTERISTIC KOUTP_EHPSMotorDemSpd_rpm_ovrdflg "" VALUE 0x0000 /* @ECU_Address@KOUTP_EHPSMotorDemSpd_rpm_ovrdflg@ */ Scalar_BOOLEAN 0 SWC_OUTP_type_CM_boolean_flg 0.0 1.0 /end CHARACTERISTIC
/begin CHARACTERISTIC KOUTP_EHPSSpdCtrlMode_enum_ovrdflg "" VALUE 0x0000 /* @ECU_Address@KOUTP_EHPSSpdCtrlMode_enum_ovrdflg@ */ Scalar_BOOLEAN 0 SWC_OUTP_type_CM_boolean_flg 0.0 1.0 /end CHARACTERISTIC
/begin CHARACTERISTIC KOUTP_EHPSSpdDemTimeout_flg_maxval "" VALUE 0x0000 /* @ECU_Address@KOUTP_EHPSSpdDemTimeout_flg_maxval@ */ Scalar_BOOLEAN 0 SWC_OUTP_type_CM_boolean_flg 0.0 1.0 /end CHARACTERISTIC
/begin CHARACTERISTIC KOUTP_EHPSSpdDemTimeout_flg_minval "" VALUE 0x0000 /* @ECU_Address@KOUTP_EHPSSpdDemTimeout_flg_minval@ */ Scalar_BOOLEAN 0 SWC_OUTP_type_CM_boolean_flg 0.0 1.0 /end CHARACTERISTIC
/begin CHARACTERISTIC KOUTP_EHPSSpdDemTimeout_flg_ovrdflg "" VALUE 0x0000 /* @ECU_Address@KOUTP_EHPSSpdDemTimeout_flg_ovrdflg@ */ Scalar_BOOLEAN 0 SWC_OUTP_type_CM_boolean_flg 0.0 1.0 /end CHARACTERISTIC
/begin CHARACTERISTIC KOUTP_EHPSSpdDemTimeout_flg_ovrdval "" VALUE 0x0000 /* @ECU_Address@KOUTP_EHPSSpdDemTimeout_flg_ovrdval@ */ Scalar_BOOLEAN 0 SWC_OUTP_type_CM_boolean_flg 0.0 1.0 /end CHARACTERISTIC
/begin CHARACTERISTIC KOUTP_APSExitCondition_enum_maxval "" VALUE 0x0000 /* @ECU_Address@KOUTP_APSExitCondition_enum_maxval@ */ Scalar_UBYTE 0 SWC_OUTP_type_CM_uint8_enum 0.0 255.0 /end CHARACTERISTIC
/begin CHARACTERISTIC KOUTP_APSExitCondition_enum_minval "" VALUE 0x0000 /* @ECU_Address@KOUTP_APSExitCondition_enum_minval@ */ Scalar_UBYTE 0 SWC_OUTP_type_CM_uint8_enum 0.0 255.0 /end CHARACTERISTIC
/begin CHARACTERISTIC KOUTP_APSExitCondition_enum_ovrdval "" VALUE 0x0000 /* @ECU_Address@KOUTP_APSExitCondition_enum_ovrdval@ */ Scalar_UBYTE 0 SWC_OUTP_type_CM_uint8_enum 0.0 255.0 /end CHARACTERISTIC
/begin CHARACTERISTIC KOUTP_APSHWVer_enum_maxval "" VALUE 0x0000 /* @ECU_Address@KOUTP_APSHWVer_enum_maxval@ */ Scalar_UBYTE 0 SWC_OUTP_type_CM_uint8_enum 0.0 255.0 /end CHARACTERISTIC
/begin CHARACTERISTIC KOUTP_APSHWVer_enum_minval "" VALUE 0x0000 /* @ECU_Address@KOUTP_APSHWVer_enum_minval@ */ Scalar_UBYTE 0 SWC_OUTP_type_CM_uint8_enum 0.0 255.0 /end CHARACTERISTIC
/begin CHARACTERISTIC KOUTP_APSHWVer_enum_ovrdval "" VALUE 0x0000 /* @ECU_Address@KOUTP_APSHWVer_enum_ovrdval@ */ Scalar_UBYTE 0 SWC_OUTP_type_CM_uint8_enum 0.0 255.0 /end CHARACTERISTIC
/begin CHARACTERISTIC KOUTP_APSPwrReq_enum_maxval "" VALUE 0x0000 /* @ECU_Address@KOUTP_APSPwrReq_enum_maxval@ */ Scalar_UBYTE 0 SWC_OUTP_type_CM_uint8_enum 0.0 255.0 /end CHARACTERISTIC
/begin CHARACTERISTIC KOUTP_APSPwrReq_enum_minval "" VALUE 0x0000 /* @ECU_Address@KOUTP_APSPwrReq_enum_minval@ */ Scalar_UBYTE 0 SWC_OUTP_type_CM_uint8_enum 0.0 255.0 /end CHARACTERISTIC
/begin CHARACTERISTIC KOUTP_APSPwrReq_enum_ovrdval "" VALUE 0x0000 /* @ECU_Address@KOUTP_APSPwrReq_enum_ovrdval@ */ Scalar_UBYTE 0 SWC_OUTP_type_CM_uint8_enum 0.0 255.0 /end CHARACTERISTIC
/begin CHARACTERISTIC KOUTP_APSRQDisplay_enum_maxval "" VALUE 0x0000 /* @ECU_Address@KOUTP_APSRQDisplay_enum_maxval@ */ Scalar_UBYTE 0 SWC_OUTP_type_CM_uint8_enum 0.0 255.0 /end CHARACTERISTIC
/begin CHARACTERISTIC KOUTP_APSRQDisplay_enum_minval "" VALUE 0x0000 /* @ECU_Address@KOUTP_APSRQDisplay_enum_minval@ */ Scalar_UBYTE 0 SWC_OUTP_type_CM_uint8_enum 0.0 255.0 /end CHARACTERISTIC
/begin CHARACTERISTIC KOUTP_APSRQDisplay_enum_ovrdval "" VALUE 0x0000 /* @ECU_Address@KOUTP_APSRQDisplay_enum_ovrdval@ */ Scalar_UBYTE 0 SWC_OUTP_type_CM_uint8_enum 0.0 255.0 /end CHARACTERISTIC
/begin CHARACTERISTIC KOUTP_APSSWVer_enum_maxval "" VALUE 0x0000 /* @ECU_Address@KOUTP_APSSWVer_enum_maxval@ */ Scalar_UBYTE 0 SWC_OUTP_type_CM_uint8_enum 0.0 255.0 /end CHARACTERISTIC
/begin CHARACTERISTIC KOUTP_APSSWVer_enum_minval "" VALUE 0x0000 /* @ECU_Address@KOUTP_APSSWVer_enum_minval@ */ Scalar_UBYTE 0 SWC_OUTP_type_CM_uint8_enum 0.0 255.0 /end CHARACTERISTIC
/begin CHARACTERISTIC KOUTP_APSSWVer_enum_ovrdval "" VALUE 0x0000 /* @ECU_Address@KOUTP_APSSWVer_enum_ovrdval@ */ Scalar_UBYTE 0 SWC_OUTP_type_CM_uint8_enum 0.0 255.0 /end CHARACTERISTIC
/begin CHARACTERISTIC KOUTP_APSShiftPosnReq_enum_maxval "" VALUE 0x0000 /* @ECU_Address@KOUTP_APSShiftPosnReq_enum_maxval@ */ Scalar_UBYTE 0 SWC_OUTP_type_CM_uint8_enum 0.0 255.0 /end CHARACTERISTIC
/begin CHARACTERISTIC KOUTP_APSShiftPosnReq_enum_minval "" VALUE 0x0000 /* @ECU_Address@KOUTP_APSShiftPosnReq_enum_minval@ */ Scalar_UBYTE 0 SWC_OUTP_type_CM_uint8_enum 0.0 255.0 /end CHARACTERISTIC
/begin CHARACTERISTIC KOUTP_APSShiftPosnReq_enum_ovrdval "" VALUE 0x0000 /* @ECU_Address@KOUTP_APSShiftPosnReq_enum_ovrdval@ */ Scalar_UBYTE 0 SWC_OUTP_type_CM_uint8_enum 0.0 255.0 /end CHARACTERISTIC
/begin CHARACTERISTIC KOUTP_AVMParkingmode_enum_maxval "" VALUE 0x0000 /* @ECU_Address@KOUTP_AVMParkingmode_enum_maxval@ */ Scalar_UBYTE 0 SWC_OUTP_type_CM_uint8_enum 0.0 255.0 /end CHARACTERISTIC
/begin CHARACTERISTIC KOUTP_AVMParkingmode_enum_minval "" VALUE 0x0000 /* @ECU_Address@KOUTP_AVMParkingmode_enum_minval@ */ Scalar_UBYTE 0 SWC_OUTP_type_CM_uint8_enum 0.0 255.0 /end CHARACTERISTIC
/begin CHARACTERISTIC KOUTP_AVMParkingmode_enum_ovrdval "" VALUE 0x0000 /* @ECU_Address@KOUTP_AVMParkingmode_enum_ovrdval@ */ Scalar_UBYTE 0 SWC_OUTP_type_CM_uint8_enum 0.0 255.0 /end CHARACTERISTIC
/begin CHARACTERISTIC KOUTP_AVMparkingcancel_enum_maxval "" VALUE 0x0000 /* @ECU_Address@KOUTP_AVMparkingcancel_enum_maxval@ */ Scalar_UBYTE 0 SWC_OUTP_type_CM_uint8_enum 0.0 255.0 /end CHARACTERISTIC
/begin CHARACTERISTIC KOUTP_AVMparkingcancel_enum_minval "" VALUE 0x0000 /* @ECU_Address@KOUTP_AVMparkingcancel_enum_minval@ */ Scalar_UBYTE 0 SWC_OUTP_type_CM_uint8_enum 0.0 255.0 /end CHARACTERISTIC
/begin CHARACTERISTIC KOUTP_AVMparkingcancel_enum_ovrdval "" VALUE 0x0000 /* @ECU_Address@KOUTP_AVMparkingcancel_enum_ovrdval@ */ Scalar_UBYTE 0 SWC_OUTP_type_CM_uint8_enum 0.0 255.0 /end CHARACTERISTIC
/begin CHARACTERISTIC KOUTP_AVMparkingexcute_enum_maxval "" VALUE 0x0000 /* @ECU_Address@KOUTP_AVMparkingexcute_enum_maxval@ */ Scalar_UBYTE 0 SWC_OUTP_type_CM_uint8_enum 0.0 255.0 /end CHARACTERISTIC
/begin CHARACTERISTIC KOUTP_AVMparkingexcute_enum_minval "" VALUE 0x0000 /* @ECU_Address@KOUTP_AVMparkingexcute_enum_minval@ */ Scalar_UBYTE 0 SWC_OUTP_type_CM_uint8_enum 0.0 255.0 /end CHARACTERISTIC
/begin CHARACTERISTIC KOUTP_AVMparkingexcute_enum_ovrdval "" VALUE 0x0000 /* @ECU_Address@KOUTP_AVMparkingexcute_enum_ovrdval@ */ Scalar_UBYTE 0 SWC_OUTP_type_CM_uint8_enum 0.0 255.0 /end CHARACTERISTIC
/begin CHARACTERISTIC KOUTP_CAASSta_enum_maxval "" VALUE 0x0000 /* @ECU_Address@KOUTP_CAASSta_enum_maxval@ */ Scalar_UBYTE 0 SWC_OUTP_type_CM_uint8_enum 0.0 255.0 /end CHARACTERISTIC
/begin CHARACTERISTIC KOUTP_CAASSta_enum_minval "" VALUE 0x0000 /* @ECU_Address@KOUTP_CAASSta_enum_minval@ */ Scalar_UBYTE 0 SWC_OUTP_type_CM_uint8_enum 0.0 255.0 /end CHARACTERISTIC
/begin CHARACTERISTIC KOUTP_CAASSta_enum_ovrdval "" VALUE 0x0000 /* @ECU_Address@KOUTP_CAASSta_enum_ovrdval@ */ Scalar_UBYTE 0 SWC_OUTP_type_CM_uint8_enum 0.0 255.0 /end CHARACTERISTIC
/begin CHARACTERISTIC KOUTP_CAASSw_enum_maxval "" VALUE 0x0000 /* @ECU_Address@KOUTP_CAASSw_enum_maxval@ */ Scalar_UBYTE 0 SWC_OUTP_type_CM_uint8_enum 0.0 255.0 /end CHARACTERISTIC
/begin CHARACTERISTIC KOUTP_CAASSw_enum_minval "" VALUE 0x0000 /* @ECU_Address@KOUTP_CAASSw_enum_minval@ */ Scalar_UBYTE 0 SWC_OUTP_type_CM_uint8_enum 0.0 255.0 /end CHARACTERISTIC
/begin CHARACTERISTIC KOUTP_CAASSw_enum_ovrdval "" VALUE 0x0000 /* @ECU_Address@KOUTP_CAASSw_enum_ovrdval@ */ Scalar_UBYTE 0 SWC_OUTP_type_CM_uint8_enum 0.0 255.0 /end CHARACTERISTIC
/begin CHARACTERISTIC KOUTP_Chime_enum_maxval "" VALUE 0x0000 /* @ECU_Address@KOUTP_Chime_enum_maxval@ */ Scalar_UBYTE 0 SWC_OUTP_type_CM_uint8_enum 0.0 255.0 /end CHARACTERISTIC
/begin CHARACTERISTIC KOUTP_Chime_enum_minval "" VALUE 0x0000 /* @ECU_Address@KOUTP_Chime_enum_minval@ */ Scalar_UBYTE 0 SWC_OUTP_type_CM_uint8_enum 0.0 255.0 /end CHARACTERISTIC
/begin CHARACTERISTIC KOUTP_Chime_enum_ovrdval "" VALUE 0x0000 /* @ECU_Address@KOUTP_Chime_enum_ovrdval@ */ Scalar_UBYTE 0 SWC_OUTP_type_CM_uint8_enum 0.0 255.0 /end CHARACTERISTIC
/begin CHARACTERISTIC KOUTP_ChrgPlugSta_enum_maxval "" VALUE 0x0000 /* @ECU_Address@KOUTP_ChrgPlugSta_enum_maxval@ */ Scalar_UBYTE 0 SWC_OUTP_type_CM_uint8_enum 0.0 255.0 /end CHARACTERISTIC
/begin CHARACTERISTIC KOUTP_ChrgPlugSta_enum_minval "" VALUE 0x0000 /* @ECU_Address@KOUTP_ChrgPlugSta_enum_minval@ */ Scalar_UBYTE 0 SWC_OUTP_type_CM_uint8_enum 0.0 255.0 /end CHARACTERISTIC
/begin CHARACTERISTIC KOUTP_DCDCEnDemamd_enum_maxval "" VALUE 0x0000 /* @ECU_Address@KOUTP_DCDCEnDemamd_enum_maxval@ */ Scalar_UBYTE 0 SWC_OUTP_type_CM_uint8_enum 0.0 255.0 /end CHARACTERISTIC
/begin CHARACTERISTIC KOUTP_DCDCEnDemamd_enum_minval "" VALUE 0x0000 /* @ECU_Address@KOUTP_DCDCEnDemamd_enum_minval@ */ Scalar_UBYTE 0 SWC_OUTP_type_CM_uint8_enum 0.0 255.0 /end CHARACTERISTIC
/begin CHARACTERISTIC KOUTP_DCDCEnDemamd_enum_ovrdval "" VALUE 0x0000 /* @ECU_Address@KOUTP_DCDCEnDemamd_enum_ovrdval@ */ Scalar_UBYTE 0 SWC_OUTP_type_CM_uint8_enum 0.0 255.0 /end CHARACTERISTIC
/begin CHARACTERISTIC KOUTP_EACEnDemand_enum_maxval "" VALUE 0x0000 /* @ECU_Address@KOUTP_EACEnDemand_enum_maxval@ */ Scalar_UBYTE 0 SWC_OUTP_type_CM_uint8_enum 0.0 255.0 /end CHARACTERISTIC
/begin CHARACTERISTIC KOUTP_EACEnDemand_enum_minval "" VALUE 0x0000 /* @ECU_Address@KOUTP_EACEnDemand_enum_minval@ */ Scalar_UBYTE 0 SWC_OUTP_type_CM_uint8_enum 0.0 255.0 /end CHARACTERISTIC
/begin CHARACTERISTIC KOUTP_EACEnDemand_enum_ovrdval "" VALUE 0x0000 /* @ECU_Address@KOUTP_EACEnDemand_enum_ovrdval@ */ Scalar_UBYTE 0 SWC_OUTP_type_CM_uint8_enum 0.0 255.0 /end CHARACTERISTIC
/begin CHARACTERISTIC KOUTP_EHPSEnDemand_enum_maxval "" VALUE 0x0000 /* @ECU_Address@KOUTP_EHPSEnDemand_enum_maxval@ */ Scalar_UBYTE 0 SWC_OUTP_type_CM_uint8_enum 0.0 255.0 /end CHARACTERISTIC
/begin CHARACTERISTIC KOUTP_EHPSEnDemand_enum_minval "" VALUE 0x0000 /* @ECU_Address@KOUTP_EHPSEnDemand_enum_minval@ */ Scalar_UBYTE 0 SWC_OUTP_type_CM_uint8_enum 0.0 255.0 /end CHARACTERISTIC
/begin CHARACTERISTIC KOUTP_EHPSEnDemand_enum_ovrdval "" VALUE 0x0000 /* @ECU_Address@KOUTP_EHPSEnDemand_enum_ovrdval@ */ Scalar_UBYTE 0 SWC_OUTP_type_CM_uint8_enum 0.0 255.0 /end CHARACTERISTIC
/begin COMPU_METHOD SWC_OUTP_type_CM_single_pct "Q = V" RAT_FUNC "%8.6" "pct" COEFFS 0 1 0 0 0 1 /end COMPU_METHOD
/begin COMPU_METHOD SWC_OUTP_type_CM_single_Deg "Q = V" RAT_FUNC "%8.6" "Deg" COEFFS 0 1 0 0 0 1 /end COMPU_METHOD
/begin COMPU_METHOD SWC_OUTP_type_CM_single_kph "Q = V" RAT_FUNC "%8.6" "kph" COEFFS 0 1 0 0 0 1 /end COMPU_METHOD
/begin COMPU_METHOD SWC_OUTP_type_CM_single_rpm "Q = V" RAT_FUNC "%8.6" "rpm" COEFFS 0 1 0 0 0 1 /end COMPU_METHOD
/begin COMPU_METHOD SWC_OUTP_type_CM_single_enum "Q = V" RAT_FUNC "%8.6" "enum" COEFFS 0 1 0 0 0 1 /end COMPU_METHOD
/begin COMPU_METHOD SWC_OUTP_type_CM_uint16_cm "Q = V" RAT_FUNC "%5.0" "cm" COEFFS 0 1 0 0 0 1 /end COMPU_METHOD
/begin COMPU_METHOD SWC_OUTP_type_CM_boolean_flg "Q = V" RAT_FUNC "%1.0" "flg" COEFFS 0 1 0 0 0 1 /end COMPU_METHOD
/begin COMPU_METHOD SWC_OUTP_type_CM_uint8_enum "Q = V" RAT_FUNC "%3.0" "enum" COEFFS 0 1 0 0 0 1 /end COMPU_METHOD
/begin GROUP S5_VNMM_NodeID_enum_Inproc "SWC_OUTP_type/run_SWC_OUTP_5ms_sys/OUTP/outpmodule/VNMM_NodeID_enum_Inproc" /begin SUB_GROUP S529_Signal_Limit S529_Signal_Override /end SUB_GROUP /end GROUP
/begin GROUP S5_VNMM_PNI_flg_Inproc "SWC_OUTP_type/run_SWC_OUTP_5ms_sys/OUTP/outpmodule/VNMM_PNI_flg_Inproc" /begin SUB_GROUP S530_Signal_Limit S530_Signal_Override /end SUB_GROUP /end GROUP
/begin GROUP S5_VNMM_RptMsgReq_flg_Inproc "SWC_OUTP_type/run_SWC_OUTP_5ms_sys/OUTP/outpmodule/VNMM_RptMsgReq_flg_Inproc" /begin SUB_GROUP S531_Signal_Limit S531_Signal_Override /end SUB_GROUP /end GROUP
/begin GROUP S5_VNMM_SysNMmSta_enum_Inproc "SWC_OUTP_type/run_SWC_OUTP_5ms_sys/OUTP/outpmodule/VNMM_SysNMmSta_enum_Inproc" /begin SUB_GROUP S532_Signal_Limit S532_Signal_Override /end SUB_GROUP /end GROUP
/begin GROUP S5_VNMM_WakeUp_enum_Inproc "SWC_OUTP_type/run_SWC_OUTP_5ms_sys/OUTP/outpmodule/VNMM_WakeUp_enum_Inproc" /begin SUB_GROUP S533_Signal_Limit S533_Signal_Override /end SUB_GROUP /end GROUP
/begin GROUP S5_VPMM_ACHVLoopDem_enum_Inproc "SWC_OUTP_type/run_SWC_OUTP_5ms_sys/OUTP/outpmodule/VPMM_ACHVLoopDem_enum_Inproc" /begin SUB_GROUP S534_Signal_Limit S534_Signal_Override /end SUB_GROUP /end GROUP
/begin GROUP S5_VPMM_ActiveDischargeReq_enum_Inproc "SWC_OUTP_type/run_SWC_OUTP_5ms_sys/OUTP/outpmodule/VPMM_ActiveDischargeReq_enum_Inproc" /begin SUB_GROUP S535_Signal_Limit S535_Signal_Override /end SUB_GROUP /end GROUP
/begin GROUP S5_VPMM_BattHVDem_enum_Inproc "SWC_OUTP_type/run_SWC_OUTP_5ms_sys/OUTP/outpmodule/VPMM_BattHVDem_enum_Inproc" /begin SUB_GROUP S536_Signal_Limit S536_Signal_Override /end SUB_GROUP /end GROUP
/begin GROUP S5_VPMM_CACRlyDem_enum_Inproc "SWC_OUTP_type/run_SWC_OUTP_5ms_sys/OUTP/outpmodule/VPMM_CACRlyDem_enum_Inproc" /begin SUB_GROUP S537_Signal_Limit S537_Signal_Override /end SUB_GROUP /end GROUP
/begin GROUP S5_VPMM_ChrgBCUHVFail_flg_Inproc "SWC_OUTP_type/run_SWC_OUTP_5ms_sys/OUTP/outpmodule/VPMM_ChrgBCUHVFail_flg_Inproc" /begin SUB_GROUP S538_Signal_Limit S538_Signal_Override /end SUB_GROUP /end GROUP
/begin GROUP S5_VPMM_ChrgFault_enum_Inproc "SWC_OUTP_type/run_SWC_OUTP_5ms_sys/OUTP/outpmodule/VPMM_ChrgFault_enum_Inproc" /begin SUB_GROUP S539_Signal_Limit S539_Signal_Override /end SUB_GROUP /end GROUP
/begin GROUP S5_VPMM_ChrgPowerUpFail_flg_Inproc "SWC_OUTP_type/run_SWC_OUTP_5ms_sys/OUTP/outpmodule/VPMM_ChrgPowerUpFail_flg_Inproc" /begin SUB_GROUP S540_Signal_Limit S540_Signal_Override /end SUB_GROUP /end GROUP
/begin GROUP S5_VPMM_ChrgState_enum_Inproc "SWC_OUTP_type/run_SWC_OUTP_5ms_sys/OUTP/outpmodule/VPMM_ChrgState_enum_Inproc" /begin SUB_GROUP S541_Signal_Limit S541_Signal_Override /end SUB_GROUP /end GROUP
/begin GROUP S5_VPMM_DCCurr_A_Inproc "SWC_OUTP_type/run_SWC_OUTP_5ms_sys/OUTP/outpmodule/VPMM_DCCurr_A_Inproc" /begin SUB_GROUP S542_Signal_Limit S542_Signal_Override /end SUB_GROUP /end GROUP
/begin GROUP S5_VPMM_DCDCRlyDem_enum_Inproc "SWC_OUTP_type/run_SWC_OUTP_5ms_sys/OUTP/outpmodule/VPMM_DCDCRlyDem_enum_Inproc" /begin SUB_GROUP S543_Signal_Limit S543_Signal_Override /end SUB_GROUP /end GROUP
/begin GROUP S5_VPMM_DCVol_V_Inproc "SWC_OUTP_type/run_SWC_OUTP_5ms_sys/OUTP/outpmodule/VPMM_DCVol_V_Inproc" /begin SUB_GROUP S544_Signal_Limit S544_Signal_Override /end SUB_GROUP /end GROUP
/begin GROUP S5_VPMM_DrivelineRelease_enum_Inproc "SWC_OUTP_type/run_SWC_OUTP_5ms_sys/OUTP/outpmodule/VPMM_DrivelineRelease_enum_Inproc" /begin SUB_GROUP S545_Signal_Limit S545_Signal_Override /end SUB_GROUP /end GROUP
/begin GROUP S5_VPMM_EHPSRlyDem_enum_Inproc "SWC_OUTP_type/run_SWC_OUTP_5ms_sys/OUTP/outpmodule/VPMM_EHPSRlyDem_enum_Inproc" /begin SUB_GROUP S546_Signal_Limit S546_Signal_Override /end SUB_GROUP /end GROUP
/begin GROUP S5_VPMM_FogTMSRlyCMD_enum_Inproc "SWC_OUTP_type/run_SWC_OUTP_5ms_sys/OUTP/outpmodule/VPMM_FogTMSRlyCMD_enum_Inproc" /begin SUB_GROUP S547_Signal_Limit S547_Signal_Override /end SUB_GROUP /end GROUP
/begin GROUP S5_VPMM_HVFailureChkPass_flg_Inproc "SWC_OUTP_type/run_SWC_OUTP_5ms_sys/OUTP/outpmodule/VPMM_HVFailureChkPass_flg_Inproc" /begin SUB_GROUP S548_Signal_Limit S548_Signal_Override /end SUB_GROUP /end GROUP
/begin GROUP S5_VPMM_HVILDetectFail_flg_Inproc "SWC_OUTP_type/run_SWC_OUTP_5ms_sys/OUTP/outpmodule/VPMM_HVILDetectFail_flg_Inproc" /begin SUB_GROUP S549_Signal_Limit S549_Signal_Override /end SUB_GROUP /end GROUP
/begin GROUP S5_VPMM_HVILFail_flg_Inproc "SWC_OUTP_type/run_SWC_OUTP_5ms_sys/OUTP/outpmodule/VPMM_HVILFail_flg_Inproc" /begin SUB_GROUP S550_Signal_Limit S550_Signal_Override /end SUB_GROUP /end GROUP
/begin GROUP S5_VPMM_HVSysReady_enum_Inproc "SWC_OUTP_type/run_SWC_OUTP_5ms_sys/OUTP/outpmodule/VPMM_HVSysReady_enum_Inproc" /begin SUB_GROUP S551_Signal_Limit S551_Signal_Override /end SUB_GROUP /end GROUP
/begin GROUP S5_VPMM_IGNRlyClose_flg_Inproc "SWC_OUTP_type/run_SWC_OUTP_5ms_sys/OUTP/outpmodule/VPMM_IGNRlyClose_flg_Inproc" /begin SUB_GROUP S552_Signal_Limit S552_Signal_Override /end SUB_GROUP /end GROUP
/begin GROUP S5_VPMM_IRCRlyClose_flg_Inproc "SWC_OUTP_type/run_SWC_OUTP_5ms_sys/OUTP/outpmodule/VPMM_IRCRlyClose_flg_Inproc" /begin SUB_GROUP S553_Signal_Limit S553_Signal_Override /end SUB_GROUP /end GROUP
/begin GROUP S5_VPMM_LVBattLowInd_enum_Inproc "SWC_OUTP_type/run_SWC_OUTP_5ms_sys/OUTP/outpmodule/VPMM_LVBattLowInd_enum_Inproc" /begin SUB_GROUP S554_Signal_Limit S554_Signal_Override /end SUB_GROUP /end GROUP
/begin GROUP S5_VPMM_LostHVComActivePwrDown_flg_Inproc "SWC_OUTP_type/run_SWC_OUTP_5ms_sys/OUTP/outpmodule/VPMM_LostHVComActivePwrDown_flg_Inproc" /begin SUB_GROUP S555_Signal_Limit S555_Signal_Override /end SUB_GROUP /end GROUP
/begin GROUP S5_VPMM_MCUHVLoopDem_enum_Inproc "SWC_OUTP_type/run_SWC_OUTP_5ms_sys/OUTP/outpmodule/VPMM_MCUHVLoopDem_enum_Inproc" /begin SUB_GROUP S556_Signal_Limit S556_Signal_Override /end SUB_GROUP /end GROUP
/begin GROUP S5_VPMM_PowerDownFault_enum_Inproc "SWC_OUTP_type/run_SWC_OUTP_5ms_sys/OUTP/outpmodule/VPMM_PowerDownFault_enum_Inproc" /begin SUB_GROUP S557_Signal_Limit S557_Signal_Override /end SUB_GROUP /end GROUP
/begin GROUP S5_VPMM_PowerDownState_enum_Inproc "SWC_OUTP_type/run_SWC_OUTP_5ms_sys/OUTP/outpmodule/VPMM_PowerDownState_enum_Inproc" /begin SUB_GROUP S558_Signal_Limit S558_Signal_Override /end SUB_GROUP /end GROUP
/begin GROUP S5_VPMM_PowerUpFault_enum_Inproc "SWC_OUTP_type/run_SWC_OUTP_5ms_sys/OUTP/outpmodule/VPMM_PowerUpFault_enum_Inproc" /begin SUB_GROUP S559_Signal_Limit S559_Signal_Override /end SUB_GROUP /end GROUP
/begin GROUP S5_VPMM_PowerUpState_enum_Inproc "SWC_OUTP_type/run_SWC_OUTP_5ms_sys/OUTP/outpmodule/VPMM_PowerUpState_enum_Inproc" /begin SUB_GROUP S560_Signal_Limit S560_Signal_Override /end SUB_GROUP /end GROUP
/begin GROUP S5_VPMM_SysPowerMode_enum_Inproc "SWC_OUTP_type/run_SWC_OUTP_5ms_sys/OUTP/outpmodule/VPMM_SysPowerMode_enum_Inproc" /begin SUB_GROUP S561_Signal_Limit S561_Signal_Override /end SUB_GROUP /end GROUP
/begin GROUP S5_VPMM_V2BACPosRlyFit_enum_Inproc "SWC_OUTP_type/run_SWC_OUTP_5ms_sys/OUTP/outpmodule/VPMM_V2BACPosRlyFit_enum_Inproc" /begin SUB_GROUP S562_Signal_Limit S562_Signal_Override /end SUB_GROUP /end GROUP
/begin GROUP S5_VPMM_V2BACPosRlySta_enum_Inproc "SWC_OUTP_type/run_SWC_OUTP_5ms_sys/OUTP/outpmodule/VPMM_V2BACPosRlySta_enum_Inproc" /begin SUB_GROUP S563_Signal_Limit S563_Signal_Override /end SUB_GROUP /end GROUP
/begin GROUP S5_VPMM_V2BAirPosRlyFit_enum_Inproc "SWC_OUTP_type/run_SWC_OUTP_5ms_sys/OUTP/outpmodule/VPMM_V2BAirPosRlyFit_enum_Inproc" /begin SUB_GROUP S564_Signal_Limit S564_Signal_Override /end SUB_GROUP /end GROUP
/begin GROUP S5_VPMM_V2BAirPosRlySta_enum_Inproc "SWC_OUTP_type/run_SWC_OUTP_5ms_sys/OUTP/outpmodule/VPMM_V2BAirPosRlySta_enum_Inproc" /begin SUB_GROUP S565_Signal_Limit S565_Signal_Override /end SUB_GROUP /end GROUP
/begin GROUP S5_VPMM_V2BAux1OnOff_enum_Inproc "SWC_OUTP_type/run_SWC_OUTP_5ms_sys/OUTP/outpmodule/VPMM_V2BAux1OnOff_enum_Inproc" /begin SUB_GROUP S566_Signal_Limit S566_Signal_Override /end SUB_GROUP /end GROUP
/begin GROUP S5_VPMM_V2BAux1RlyFit_enum_Inproc "SWC_OUTP_type/run_SWC_OUTP_5ms_sys/OUTP/outpmodule/VPMM_V2BAux1RlyFit_enum_Inproc" /begin SUB_GROUP S567_Signal_Limit S567_Signal_Override /end SUB_GROUP /end GROUP
/begin GROUP S5_VPMM_V2BAux1RlySta_enum_Inproc "SWC_OUTP_type/run_SWC_OUTP_5ms_sys/OUTP/outpmodule/VPMM_V2BAux1RlySta_enum_Inproc" /begin SUB_GROUP S568_Signal_Limit S568_Signal_Override /end SUB_GROUP /end GROUP
/begin GROUP S5_VPMM_V2BAux2OnOff_enum_Inproc "SWC_OUTP_type/run_SWC_OUTP_5ms_sys/OUTP/outpmodule/VPMM_V2BAux2OnOff_enum_Inproc" /begin SUB_GROUP S569_Signal_Limit S569_Signal_Override /end SUB_GROUP /end GROUP
/begin GROUP S5_VPMM_V2BAux2RlyFit_enum_Inproc "SWC_OUTP_type/run_SWC_OUTP_5ms_sys/OUTP/outpmodule/VPMM_V2BAux2RlyFit_enum_Inproc" /begin SUB_GROUP S570_Signal_Limit S570_Signal_Override /end SUB_GROUP /end GROUP
/begin GROUP S5_VPMM_V2BAux2RlySta_enum_Inproc "SWC_OUTP_type/run_SWC_OUTP_5ms_sys/OUTP/outpmodule/VPMM_V2BAux2RlySta_enum_Inproc" /begin SUB_GROUP S571_Signal_Limit S571_Signal_Override /end SUB_GROUP /end GROUP
/begin GROUP S5_VPMM_V2BAux3OnOff_enum_Inproc "SWC_OUTP_type/run_SWC_OUTP_5ms_sys/OUTP/outpmodule/VPMM_V2BAux3OnOff_enum_Inproc" /begin SUB_GROUP S572_Signal_Limit S572_Signal_Override /end SUB_GROUP /end GROUP
/begin GROUP S5_VPMM_V2BAux3RlyFit_enum_Inproc "SWC_OUTP_type/run_SWC_OUTP_5ms_sys/OUTP/outpmodule/VPMM_V2BAux3RlyFit_enum_Inproc" /begin SUB_GROUP S573_Signal_Limit S573_Signal_Override /end SUB_GROUP /end GROUP
/begin GROUP S5_VPMM_V2BAux3RlySta_enum_Inproc "SWC_OUTP_type/run_SWC_OUTP_5ms_sys/OUTP/outpmodule/VPMM_V2BAux3RlySta_enum_Inproc" /begin SUB_GROUP S574_Signal_Limit S574_Signal_Override /end SUB_GROUP /end GROUP
/begin GROUP S5_VPMM_V2BAux4RlyFit_enum_Inproc "SWC_OUTP_type/run_SWC_OUTP_5ms_sys/OUTP/outpmodule/VPMM_V2BAux4RlyFit_enum_Inproc" /begin SUB_GROUP S575_Signal_Limit S575_Signal_Override /end SUB_GROUP /end GROUP
/begin GROUP S5_VPMM_V2BAux4RlySta_enum_Inproc "SWC_OUTP_type/run_SWC_OUTP_5ms_sys/OUTP/outpmodule/VPMM_V2BAux4RlySta_enum_Inproc" /begin SUB_GROUP S576_Signal_Limit S576_Signal_Override /end SUB_GROUP /end GROUP
/begin GROUP S5_VPMM_V2BDCDCPosRlyFit_enum_Inproc "SWC_OUTP_type/run_SWC_OUTP_5ms_sys/OUTP/outpmodule/VPMM_V2BDCDCPosRlyFit_enum_Inproc" /begin SUB_GROUP S577_Signal_Limit S577_Signal_Override /end SUB_GROUP /end GROUP
/begin GROUP S5_VPMM_V2BDCDCPosRlySta_enum_Inproc "SWC_OUTP_type/run_SWC_OUTP_5ms_sys/OUTP/outpmodule/VPMM_V2BDCDCPosRlySta_enum_Inproc" /begin SUB_GROUP S578_Signal_Limit S578_Signal_Override /end SUB_GROUP /end GROUP
/begin GROUP S5_VPMM_V2BLifeSig_cnt_Inproc "SWC_OUTP_type/run_SWC_OUTP_5ms_sys/OUTP/outpmodule/VPMM_V2BLifeSig_cnt_Inproc" /begin SUB_GROUP S579_Signal_Limit S579_Signal_Override /end SUB_GROUP /end GROUP
/begin GROUP S5_VPMM_V2BMainPosRlyFit_enum_Inproc "SWC_OUTP_type/run_SWC_OUTP_5ms_sys/OUTP/outpmodule/VPMM_V2BMainPosRlyFit_enum_Inproc" /begin SUB_GROUP S580_Signal_Limit S580_Signal_Override /end SUB_GROUP /end GROUP
/begin GROUP S5_VPMM_V2BMainPosRlySta_enum_Inproc "SWC_OUTP_type/run_SWC_OUTP_5ms_sys/OUTP/outpmodule/VPMM_V2BMainPosRlySta_enum_Inproc" /begin SUB_GROUP S581_Signal_Limit S581_Signal_Override /end SUB_GROUP /end GROUP
/begin GROUP S5_VPMM_V2BOilPosRlyFit_enum_Inproc "SWC_OUTP_type/run_SWC_OUTP_5ms_sys/OUTP/outpmodule/VPMM_V2BOilPosRlyFit_enum_Inproc" /begin SUB_GROUP S582_Signal_Limit S582_Signal_Override /end SUB_GROUP /end GROUP
/begin GROUP S5_VPMM_V2BOilPosRlySta_enum_Inproc "SWC_OUTP_type/run_SWC_OUTP_5ms_sys/OUTP/outpmodule/VPMM_V2BOilPosRlySta_enum_Inproc" /begin SUB_GROUP S583_Signal_Limit S583_Signal_Override /end SUB_GROUP /end GROUP
/begin GROUP S5_VPMM_VCULife1_cnt_Inproc "SWC_OUTP_type/run_SWC_OUTP_5ms_sys/OUTP/outpmodule/VPMM_VCULife1_cnt_Inproc" /begin SUB_GROUP S584_Signal_Limit S584_Signal_Override /end SUB_GROUP /end GROUP
/begin GROUP S5_VPMM_VCULife2_cnt_Inproc "SWC_OUTP_type/run_SWC_OUTP_5ms_sys/OUTP/outpmodule/VPMM_VCULife2_cnt_Inproc" /begin SUB_GROUP S585_Signal_Limit S585_Signal_Override /end SUB_GROUP /end GROUP
/begin GROUP S5_VPMM_VCUMCUEn_flg_Inproc "SWC_OUTP_type/run_SWC_OUTP_5ms_sys/OUTP/outpmodule/VPMM_VCUMCUEn_flg_Inproc" /begin SUB_GROUP S586_Signal_Limit S586_Signal_Override /end SUB_GROUP /end GROUP
/begin GROUP S5_VPMM_VCUMCUFailRst_flg_Inproc "SWC_OUTP_type/run_SWC_OUTP_5ms_sys/OUTP/outpmodule/VPMM_VCUMCUFailRst_flg_Inproc" /begin SUB_GROUP S587_Signal_Limit S587_Signal_Override /end SUB_GROUP /end GROUP
/begin GROUP S5_VPMM_VSPFunc_enum_Inproc "SWC_OUTP_type/run_SWC_OUTP_5ms_sys/OUTP/outpmodule/VPMM_VSPFunc_enum_Inproc" /begin SUB_GROUP S588_Signal_Limit S588_Signal_Override /end SUB_GROUP /end GROUP
/begin GROUP S5_VPMM_VSPIGNKeySta_enum_Inproc "SWC_OUTP_type/run_SWC_OUTP_5ms_sys/OUTP/outpmodule/VPMM_VSPIGNKeySta_enum_Inproc" /begin SUB_GROUP S589_Signal_Limit S589_Signal_Override /end SUB_GROUP /end GROUP
/begin GROUP S5_VPMM_VSPReversed_flg_Inproc "SWC_OUTP_type/run_SWC_OUTP_5ms_sys/OUTP/outpmodule/VPMM_VSPReversed_flg_Inproc" /begin SUB_GROUP S590_Signal_Limit S590_Signal_Override /end SUB_GROUP /end GROUP
/begin GROUP S5_VPMM_VSPTurnLeft_enum_Inproc "SWC_OUTP_type/run_SWC_OUTP_5ms_sys/OUTP/outpmodule/VPMM_VSPTurnLeft_enum_Inproc" /begin SUB_GROUP S591_Signal_Limit S591_Signal_Override /end SUB_GROUP /end GROUP
/begin GROUP S5_VPMM_VSPTurnRight_enum_Inproc "SWC_OUTP_type/run_SWC_OUTP_5ms_sys/OUTP/outpmodule/VPMM_VSPTurnRight_enum_Inproc" /begin SUB_GROUP S592_Signal_Limit S592_Signal_Override /end SUB_GROUP /end GROUP
/begin GROUP S5_VPSA_EmergencyShutDown_flg_Inproc "SWC_OUTP_type/run_SWC_OUTP_5ms_sys/OUTP/outpmodule/VPSA_EmergencyShutDown_flg_Inproc" /begin SUB_GROUP S593_Signal_Limit S593_Signal_Override /end SUB_GROUP /end GROUP
/begin GROUP S5_VPSA_Keystatus_enum_Inproc "SWC_OUTP_type/run_SWC_OUTP_5ms_sys/OUTP/outpmodule/VPSA_Keystatus_enum_Inproc" /begin SUB_GROUP S594_Signal_Limit S594_Signal_Override /end SUB_GROUP /end GROUP
/begin GROUP S5_VSCP_CFGEM1BAMPGN_raw_Inproc "SWC_OUTP_type/run_SWC_OUTP_5ms_sys/OUTP/outpmodule/VSCP_CFGEM1BAMPGN_raw_Inproc" /begin SUB_GROUP S595_Signal_Limit S595_Signal_Override /end SUB_GROUP /end GROUP
/begin GROUP S5_VSCP_CFGEM1BAMRsv_raw_Inproc "SWC_OUTP_type/run_SWC_OUTP_5ms_sys/OUTP/outpmodule/VSCP_CFGEM1BAMRsv_raw_Inproc" /begin SUB_GROUP S596_Signal_Limit S596_Signal_Override /end SUB_GROUP /end GROUP
/begin GROUP S5_VSCP_CFGEM1BAMTNum_raw_Inproc "SWC_OUTP_type/run_SWC_OUTP_5ms_sys/OUTP/outpmodule/VSCP_CFGEM1BAMTNum_raw_Inproc" /begin SUB_GROUP S597_Signal_Limit S597_Signal_Override /end SUB_GROUP /end GROUP
/begin GROUP S5_VSCP_CFGEM1BAMTSize_raw_Inproc "SWC_OUTP_type/run_SWC_OUTP_5ms_sys/OUTP/outpmodule/VSCP_CFGEM1BAMTSize_raw_Inproc" /begin SUB_GROUP S598_Signal_Limit S598_Signal_Override /end SUB_GROUP /end GROUP
/begin GROUP S5_VSCP_CFGEM1Ctrl_raw_Inproc "SWC_OUTP_type/run_SWC_OUTP_5ms_sys/OUTP/outpmodule/VSCP_CFGEM1Ctrl_raw_Inproc" /begin SUB_GROUP S599_Signal_Limit S599_Signal_Override /end SUB_GROUP /end GROUP
/begin GROUP S5_VSCP_DTbyte0_raw_Inproc "SWC_OUTP_type/run_SWC_OUTP_5ms_sys/OUTP/outpmodule/VSCP_DTbyte0_raw_Inproc" /begin SUB_GROUP S600_Signal_Limit S600_Signal_Override /end SUB_GROUP /end GROUP
/begin GROUP S5_VSCP_DTbyte1_raw_Inproc "SWC_OUTP_type/run_SWC_OUTP_5ms_sys/OUTP/outpmodule/VSCP_DTbyte1_raw_Inproc" /begin SUB_GROUP S601_Signal_Limit S601_Signal_Override /end SUB_GROUP /end GROUP
/begin GROUP S5_VSCP_DTbyte2_raw_Inproc "SWC_OUTP_type/run_SWC_OUTP_5ms_sys/OUTP/outpmodule/VSCP_DTbyte2_raw_Inproc" /begin SUB_GROUP S602_Signal_Limit S602_Signal_Override /end SUB_GROUP /end GROUP
/begin GROUP S5_VSCP_DTbyte3_raw_Inproc "SWC_OUTP_type/run_SWC_OUTP_5ms_sys/OUTP/outpmodule/VSCP_DTbyte3_raw_Inproc" /begin SUB_GROUP S603_Signal_Limit S603_Signal_Override /end SUB_GROUP /end GROUP
/begin GROUP S5_VSCP_DTbyte4_raw_Inproc "SWC_OUTP_type/run_SWC_OUTP_5ms_sys/OUTP/outpmodule/VSCP_DTbyte4_raw_Inproc" /begin SUB_GROUP S604_Signal_Limit S604_Signal_Override /end SUB_GROUP /end GROUP
/begin GROUP S5_VSCP_DTbyte5_raw_Inproc "SWC_OUTP_type/run_SWC_OUTP_5ms_sys/OUTP/outpmodule/VSCP_DTbyte5_raw_Inproc" /begin SUB_GROUP S605_Signal_Limit S605_Signal_Override /end SUB_GROUP /end GROUP
/begin GROUP S5_VSCP_DTbyte6_raw_Inproc "SWC_OUTP_type/run_SWC_OUTP_5ms_sys/OUTP/outpmodule/VSCP_DTbyte6_raw_Inproc" /begin SUB_GROUP S606_Signal_Limit S606_Signal_Override /end SUB_GROUP /end GROUP
/begin GROUP S5_VSCP_DTbyte7_raw_Inproc "SWC_OUTP_type/run_SWC_OUTP_5ms_sys/OUTP/outpmodule/VSCP_DTbyte7_raw_Inproc" /begin SUB_GROUP S607_Signal_Limit S607_Signal_Override /end SUB_GROUP /end GROUP
/begin GROUP S5_VSCP_triggerBAM_flg_Inproc "SWC_OUTP_type/run_SWC_OUTP_5ms_sys/OUTP/outpmodule/VSCP_triggerBAM_flg_Inproc" /begin SUB_GROUP S608_Signal_Limit S608_Signal_Override /end SUB_GROUP /end GROUP
/begin GROUP S5_VSCP_triggerDT_flg_Inproc "SWC_OUTP_type/run_SWC_OUTP_5ms_sys/OUTP/outpmodule/VSCP_triggerDT_flg_Inproc" /begin SUB_GROUP S609_Signal_Limit S609_Signal_Override /end SUB_GROUP /end GROUP
/begin GROUP S5_VSYS_AcoreRebootCmdACK_flg_Inproc "SWC_OUTP_type/run_SWC_OUTP_5ms_sys/OUTP/outpmodule/VSYS_AcoreRebootCmdACK_flg_Inproc" /begin SUB_GROUP S610_Signal_Limit S610_Signal_Override /end SUB_GROUP /end GROUP
/begin GROUP S5_VSYS_CarModel1_cnt_Inproc "SWC_OUTP_type/run_SWC_OUTP_5ms_sys/OUTP/outpmodule/VSYS_CarModel1_cnt_Inproc" /begin SUB_GROUP S611_Signal_Limit S611_Signal_Override /end SUB_GROUP /end GROUP
/begin GROUP S5_VSYS_CarModel2_cnt_Inproc "SWC_OUTP_type/run_SWC_OUTP_5ms_sys/OUTP/outpmodule/VSYS_CarModel2_cnt_Inproc" /begin SUB_GROUP S612_Signal_Limit S612_Signal_Override /end SUB_GROUP /end GROUP
/begin GROUP S5_VSYS_CarModel3_cnt_Inproc "SWC_OUTP_type/run_SWC_OUTP_5ms_sys/OUTP/outpmodule/VSYS_CarModel3_cnt_Inproc" /begin SUB_GROUP S613_Signal_Limit S613_Signal_Override /end SUB_GROUP /end GROUP
/begin GROUP S5_VSYS_Change1_cnt_Inproc "SWC_OUTP_type/run_SWC_OUTP_5ms_sys/OUTP/outpmodule/VSYS_Change1_cnt_Inproc" /begin SUB_GROUP S614_Signal_Limit S614_Signal_Override /end SUB_GROUP /end GROUP
/begin GROUP S5_VSYS_Change2_cnt_Inproc "SWC_OUTP_type/run_SWC_OUTP_5ms_sys/OUTP/outpmodule/VSYS_Change2_cnt_Inproc" /begin SUB_GROUP S615_Signal_Limit S615_Signal_Override /end SUB_GROUP /end GROUP
/begin GROUP S5_VSYS_Country1_cnt_Inproc "SWC_OUTP_type/run_SWC_OUTP_5ms_sys/OUTP/outpmodule/VSYS_Country1_cnt_Inproc" /begin SUB_GROUP S616_Signal_Limit S616_Signal_Override /end SUB_GROUP /end GROUP
/begin GROUP S5_VSYS_Country2_cnt_Inproc "SWC_OUTP_type/run_SWC_OUTP_5ms_sys/OUTP/outpmodule/VSYS_Country2_cnt_Inproc" /begin SUB_GROUP S617_Signal_Limit S617_Signal_Override /end SUB_GROUP /end GROUP
/begin GROUP S5_VSYS_CurrentNmState_enum_Inproc "SWC_OUTP_type/run_SWC_OUTP_5ms_sys/OUTP/outpmodule/VSYS_CurrentNmState_enum_Inproc" /begin SUB_GROUP S618_Signal_Limit S618_Signal_Override /end SUB_GROUP /end GROUP
/begin GROUP S5_VSYS_Dash1_cnt_Inproc "SWC_OUTP_type/run_SWC_OUTP_5ms_sys/OUTP/outpmodule/VSYS_Dash1_cnt_Inproc" /begin SUB_GROUP S619_Signal_Limit S619_Signal_Override /end SUB_GROUP /end GROUP
/begin GROUP S5_VSYS_Dash2_cnt_Inproc "SWC_OUTP_type/run_SWC_OUTP_5ms_sys/OUTP/outpmodule/VSYS_Dash2_cnt_Inproc" /begin SUB_GROUP S620_Signal_Limit S620_Signal_Override /end SUB_GROUP /end GROUP
/begin GROUP S5_VSYS_DrivingMode_cnt_Inproc "SWC_OUTP_type/run_SWC_OUTP_5ms_sys/OUTP/outpmodule/VSYS_DrivingMode_cnt_Inproc" /begin SUB_GROUP S621_Signal_Limit S621_Signal_Override /end SUB_GROUP /end GROUP
/begin GROUP S5_VSYS_ECU1_cnt_Inproc "SWC_OUTP_type/run_SWC_OUTP_5ms_sys/OUTP/outpmodule/VSYS_ECU1_cnt_Inproc" /begin SUB_GROUP S622_Signal_Limit S622_Signal_Override /end SUB_GROUP /end GROUP
/begin GROUP S5_VSYS_ECU2_cnt_Inproc "SWC_OUTP_type/run_SWC_OUTP_5ms_sys/OUTP/outpmodule/VSYS_ECU2_cnt_Inproc" /begin SUB_GROUP S623_Signal_Limit S623_Signal_Override /end SUB_GROUP /end GROUP
/begin GROUP S5_VSYS_ECUGen1_cnt_Inproc "SWC_OUTP_type/run_SWC_OUTP_5ms_sys/OUTP/outpmodule/VSYS_ECUGen1_cnt_Inproc" /begin SUB_GROUP S624_Signal_Limit S624_Signal_Override /end SUB_GROUP /end GROUP
/begin GROUP S5_VSYS_ECUGen2_cnt_Inproc "SWC_OUTP_type/run_SWC_OUTP_5ms_sys/OUTP/outpmodule/VSYS_ECUGen2_cnt_Inproc" /begin SUB_GROUP S625_Signal_Limit S625_Signal_Override /end SUB_GROUP /end GROUP
/begin GROUP S5_VSYS_FdcSlpReqRisingEdge_flg_Inproc "SWC_OUTP_type/run_SWC_OUTP_5ms_sys/OUTP/outpmodule/VSYS_FdcSlpReqRisingEdge_flg_Inproc" /begin SUB_GROUP S626_Signal_Limit S626_Signal_Override /end SUB_GROUP /end GROUP
/begin GROUP S5_VSYS_FdcSlpTime_sec_Inproc "SWC_OUTP_type/run_SWC_OUTP_5ms_sys/OUTP/outpmodule/VSYS_FdcSlpTime_sec_Inproc" /begin SUB_GROUP S627_Signal_Limit S627_Signal_Override /end SUB_GROUP /end GROUP
/begin GROUP S5_VSYS_HWVer1_cnt_Inproc "SWC_OUTP_type/run_SWC_OUTP_5ms_sys/OUTP/outpmodule/VSYS_HWVer1_cnt_Inproc" /begin SUB_GROUP S628_Signal_Limit S628_Signal_Override /end SUB_GROUP /end GROUP
/begin GROUP S5_VSYS_HWVer2_cnt_Inproc "SWC_OUTP_type/run_SWC_OUTP_5ms_sys/OUTP/outpmodule/VSYS_HWVer2_cnt_Inproc" /begin SUB_GROUP S629_Signal_Limit S629_Signal_Override /end SUB_GROUP /end GROUP
/begin GROUP S5_VSYS_HWVer3_cnt_Inproc "SWC_OUTP_type/run_SWC_OUTP_5ms_sys/OUTP/outpmodule/VSYS_HWVer3_cnt_Inproc" /begin SUB_GROUP S630_Signal_Limit S630_Signal_Override /end SUB_GROUP /end GROUP
/begin GROUP S5_VSYS_Major1_cnt_Inproc "SWC_OUTP_type/run_SWC_OUTP_5ms_sys/OUTP/outpmodule/VSYS_Major1_cnt_Inproc" /begin SUB_GROUP S631_Signal_Limit S631_Signal_Override /end SUB_GROUP /end GROUP
/begin GROUP S5_VSYS_Major2_cnt_Inproc "SWC_OUTP_type/run_SWC_OUTP_5ms_sys/OUTP/outpmodule/VSYS_Major2_cnt_Inproc" /begin SUB_GROUP S632_Signal_Limit S632_Signal_Override /end SUB_GROUP /end GROUP
/begin GROUP S5_VSYS_Minor1_cnt_Inproc "SWC_OUTP_type/run_SWC_OUTP_5ms_sys/OUTP/outpmodule/VSYS_Minor1_cnt_Inproc" /begin SUB_GROUP S633_Signal_Limit S633_Signal_Override /end SUB_GROUP /end GROUP
/begin GROUP S5_VSYS_Minor2_cnt_Inproc "SWC_OUTP_type/run_SWC_OUTP_5ms_sys/OUTP/outpmodule/VSYS_Minor2_cnt_Inproc" /begin SUB_GROUP S634_Signal_Limit S634_Signal_Override /end SUB_GROUP /end GROUP
/begin GROUP S5_VSYS_ModelYear_cnt_Inproc "SWC_OUTP_type/run_SWC_OUTP_5ms_sys/OUTP/outpmodule/VSYS_ModelYear_cnt_Inproc" /begin SUB_GROUP S635_Signal_Limit S635_Signal_Override /end SUB_GROUP /end GROUP
/begin GROUP S5_VSYS_NvWriteReqRisingEdge_flg_Inproc "SWC_OUTP_type/run_SWC_OUTP_5ms_sys/OUTP/outpmodule/VSYS_NvWriteReqRisingEdge_flg_Inproc" /begin SUB_GROUP S636_Signal_Limit S636_Signal_Override /end SUB_GROUP /end GROUP
/begin GROUP S5_VSYS_Patch1_cnt_Inproc "SWC_OUTP_type/run_SWC_OUTP_5ms_sys/OUTP/outpmodule/VSYS_Patch1_cnt_Inproc" /begin SUB_GROUP S637_Signal_Limit S637_Signal_Override /end SUB_GROUP /end GROUP
/begin GROUP S5_VSYS_Patch2_cnt_Inproc "SWC_OUTP_type/run_SWC_OUTP_5ms_sys/OUTP/outpmodule/VSYS_Patch2_cnt_Inproc" /begin SUB_GROUP S638_Signal_Limit S638_Signal_Override /end SUB_GROUP /end GROUP
/begin GROUP S5_VSYS_PmicBootPath_raw32_Inproc "SWC_OUTP_type/run_SWC_OUTP_5ms_sys/OUTP/outpmodule/VSYS_PmicBootPath_raw32_Inproc" /begin SUB_GROUP S639_Signal_Limit S639_Signal_Override /end SUB_GROUP /end GROUP
/begin GROUP S5_VSYS_PmicBootReason_enum_Inproc "SWC_OUTP_type/run_SWC_OUTP_5ms_sys/OUTP/outpmodule/VSYS_PmicBootReason_enum_Inproc" /begin SUB_GROUP S640_Signal_Limit S640_Signal_Override /end SUB_GROUP /end GROUP
/begin GROUP S5_VSYS_SHA1_cnt_Inproc "SWC_OUTP_type/run_SWC_OUTP_5ms_sys/OUTP/outpmodule/VSYS_SHA1_cnt_Inproc" /begin SUB_GROUP S641_Signal_Limit S641_Signal_Override /end SUB_GROUP /end GROUP
/begin GROUP S5_VSYS_SHA2_cnt_Inproc "SWC_OUTP_type/run_SWC_OUTP_5ms_sys/OUTP/outpmodule/VSYS_SHA2_cnt_Inproc" /begin SUB_GROUP S642_Signal_Limit S642_Signal_Override /end SUB_GROUP /end GROUP
/begin GROUP S5_VSYS_SHA3_cnt_Inproc "SWC_OUTP_type/run_SWC_OUTP_5ms_sys/OUTP/outpmodule/VSYS_SHA3_cnt_Inproc" /begin SUB_GROUP S643_Signal_Limit S643_Signal_Override /end SUB_GROUP /end GROUP
/begin GROUP S5_VSYS_SHA4_cnt_Inproc "SWC_OUTP_type/run_SWC_OUTP_5ms_sys/OUTP/outpmodule/VSYS_SHA4_cnt_Inproc" /begin SUB_GROUP S644_Signal_Limit S644_Signal_Override /end SUB_GROUP /end GROUP
/begin GROUP S5_VSYS_SHA5_cnt_Inproc "SWC_OUTP_type/run_SWC_OUTP_5ms_sys/OUTP/outpmodule/VSYS_SHA5_cnt_Inproc" /begin SUB_GROUP S645_Signal_Limit S645_Signal_Override /end SUB_GROUP /end GROUP
/begin GROUP S5_VSYS_SHA6_cnt_Inproc "SWC_OUTP_type/run_SWC_OUTP_5ms_sys/OUTP/outpmodule/VSYS_SHA6_cnt_Inproc" /begin SUB_GROUP S646_Signal_Limit S646_Signal_Override /end SUB_GROUP /end GROUP
/begin GROUP S5_VSYS_SHA7_cnt_Inproc "SWC_OUTP_type/run_SWC_OUTP_5ms_sys/OUTP/outpmodule/VSYS_SHA7_cnt_Inproc" /begin SUB_GROUP S647_Signal_Limit S647_Signal_Override /end SUB_GROUP /end GROUP
/begin GROUP S5_VSYS_SHA8_cnt_Inproc "SWC_OUTP_type/run_SWC_OUTP_5ms_sys/OUTP/outpmodule/VSYS_SHA8_cnt_Inproc" /begin SUB_GROUP S648_Signal_Limit S648_Signal_Override /end SUB_GROUP /end GROUP
/begin GROUP S5_VSYS_Variation_cnt_Inproc "SWC_OUTP_type/run_SWC_OUTP_5ms_sys/OUTP/outpmodule/VSYS_Variation_cnt_Inproc" /begin SUB_GROUP S649_Signal_Limit S649_Signal_Override /end SUB_GROUP /end GROUP
/begin GROUP S5_VSYS_WisrBootReason_raw32_Inproc "SWC_OUTP_type/run_SWC_OUTP_5ms_sys/OUTP/outpmodule/VSYS_WisrBootReason_raw32_Inproc" /begin SUB_GROUP S650_Signal_Limit S650_Signal_Override /end SUB_GROUP /end GROUP
/begin GROUP S5_VTHC_AfterrunningMode_flg_Inproc "SWC_OUTP_type/run_SWC_OUTP_5ms_sys/OUTP/outpmodule/VTHC_AfterrunningMode_flg_Inproc" /begin SUB_GROUP S651_Signal_Limit S651_Signal_Override /end SUB_GROUP /end GROUP
/begin GROUP S5_VTHC_CoolFanReq_pct_Inproc "SWC_OUTP_type/run_SWC_OUTP_5ms_sys/OUTP/outpmodule/VTHC_CoolFanReq_pct_Inproc" /begin SUB_GROUP S652_Signal_Limit S652_Signal_Override /end SUB_GROUP /end GROUP
/begin GROUP S5_VTHC_EWPPEReq_rpm_Inproc "SWC_OUTP_type/run_SWC_OUTP_5ms_sys/OUTP/outpmodule/VTHC_EWPPEReq_rpm_Inproc" /begin SUB_GROUP S653_Signal_Limit S653_Signal_Override /end SUB_GROUP /end GROUP
/begin GROUP S5_VTPM_ALFin_flg_Inproc "SWC_OUTP_type/run_SWC_OUTP_5ms_sys/OUTP/outpmodule/VTPM_ALFin_flg_Inproc" /begin SUB_GROUP S654_Signal_Limit S654_Signal_Override /end SUB_GROUP /end GROUP
/begin GROUP S5_VTPM_AutoLTips_enum_Inproc "SWC_OUTP_type/run_SWC_OUTP_5ms_sys/OUTP/outpmodule/VTPM_AutoLTips_enum_Inproc" /begin SUB_GROUP S655_Signal_Limit S655_Signal_Override /end SUB_GROUP /end GROUP
/begin GROUP S5_VTPM_CWheelTips_enum_Inproc "SWC_OUTP_type/run_SWC_OUTP_5ms_sys/OUTP/outpmodule/VTPM_CWheelTips_enum_Inproc" /begin SUB_GROUP S656_Signal_Limit S656_Signal_Override /end SUB_GROUP /end GROUP
/begin GROUP S5_VTPM_ChkStorge_flg_Inproc "SWC_OUTP_type/run_SWC_OUTP_5ms_sys/OUTP/outpmodule/VTPM_ChkStorge_flg_Inproc" /begin SUB_GROUP S657_Signal_Limit S657_Signal_Override /end SUB_GROUP /end GROUP
/begin GROUP S5_VTPM_Chkfin_flg_Inproc "SWC_OUTP_type/run_SWC_OUTP_5ms_sys/OUTP/outpmodule/VTPM_Chkfin_flg_Inproc" /begin SUB_GROUP S658_Signal_Limit S658_Signal_Override /end SUB_GROUP /end GROUP
/begin GROUP S5_VTPM_FAT_flg_Inproc "SWC_OUTP_type/run_SWC_OUTP_5ms_sys/OUTP/outpmodule/VTPM_FAT_flg_Inproc" /begin SUB_GROUP S659_Signal_Limit S659_Signal_Override /end SUB_GROUP /end GROUP
/begin GROUP S5_VTPM_FlashIDvalid_enum_Inproc "SWC_OUTP_type/run_SWC_OUTP_5ms_sys/OUTP/outpmodule/VTPM_FlashIDvalid_enum_Inproc" /begin SUB_GROUP S660_Signal_Limit S660_Signal_Override /end SUB_GROUP /end GROUP
/begin GROUP S5_VTPM_FlashS1ID_raw_Inproc "SWC_OUTP_type/run_SWC_OUTP_5ms_sys/OUTP/outpmodule/VTPM_FlashS1ID_raw_Inproc" /begin SUB_GROUP S661_Signal_Limit S661_Signal_Override /end SUB_GROUP /end GROUP
/begin GROUP S5_VTPM_FlashS2ID_raw_Inproc "SWC_OUTP_type/run_SWC_OUTP_5ms_sys/OUTP/outpmodule/VTPM_FlashS2ID_raw_Inproc" /begin SUB_GROUP S662_Signal_Limit S662_Signal_Override /end SUB_GROUP /end GROUP
/begin GROUP S5_VTPM_FlashS3ID_raw_Inproc "SWC_OUTP_type/run_SWC_OUTP_5ms_sys/OUTP/outpmodule/VTPM_FlashS3ID_raw_Inproc" /begin SUB_GROUP S663_Signal_Limit S663_Signal_Override /end SUB_GROUP /end GROUP
/begin GROUP S5_VTPM_FlashS4ID_raw_Inproc "SWC_OUTP_type/run_SWC_OUTP_5ms_sys/OUTP/outpmodule/VTPM_FlashS4ID_raw_Inproc" /begin SUB_GROUP S664_Signal_Limit S664_Signal_Override /end SUB_GROUP /end GROUP
/begin GROUP S5_VTPM_Flashchkdatavalid_enum_Inproc "SWC_OUTP_type/run_SWC_OUTP_5ms_sys/OUTP/outpmodule/VTPM_Flashchkdatavalid_enum_Inproc" /begin SUB_GROUP S665_Signal_Limit S665_Signal_Override /end SUB_GROUP /end GROUP
/begin GROUP S5_VTPM_Flashdatavalid_enum_Inproc "SWC_OUTP_type/run_SWC_OUTP_5ms_sys/OUTP/outpmodule/VTPM_Flashdatavalid_enum_Inproc" /begin SUB_GROUP S666_Signal_Limit S666_Signal_Override /end SUB_GROUP /end GROUP
/begin GROUP S5_VTPM_ID1messageALTU_raw8_Inproc "SWC_OUTP_type/run_SWC_OUTP_5ms_sys/OUTP/outpmodule/VTPM_ID1messageALTU_raw8_Inproc" /begin SUB_GROUP S667_Signal_Limit S667_Signal_Override /end SUB_GROUP /end GROUP
/begin GROUP S5_VTPM_ID2messageALTU_raw8_Inproc "SWC_OUTP_type/run_SWC_OUTP_5ms_sys/OUTP/outpmodule/VTPM_ID2messageALTU_raw8_Inproc" /begin SUB_GROUP S668_Signal_Limit S668_Signal_Override /end SUB_GROUP /end GROUP
/begin GROUP S5_VTPM_ID3messageALTU_raw8_Inproc "SWC_OUTP_type/run_SWC_OUTP_5ms_sys/OUTP/outpmodule/VTPM_ID3messageALTU_raw8_Inproc" /begin SUB_GROUP S669_Signal_Limit S669_Signal_Override /end SUB_GROUP /end GROUP
/begin GROUP S5_VTPM_ID4messageALTU_raw8_Inproc "SWC_OUTP_type/run_SWC_OUTP_5ms_sys/OUTP/outpmodule/VTPM_ID4messageALTU_raw8_Inproc" /begin SUB_GROUP S670_Signal_Limit S670_Signal_Override /end SUB_GROUP /end GROUP
/begin GROUP S5_VTPM_IDin_raw32_Inproc "SWC_OUTP_type/run_SWC_OUTP_5ms_sys/OUTP/outpmodule/VTPM_IDin_raw32_Inproc" /begin SUB_GROUP S671_Signal_Limit S671_Signal_Override /end SUB_GROUP /end GROUP
/begin GROUP S5_VTPM_LFBatWarn_flg_Inproc "SWC_OUTP_type/run_SWC_OUTP_5ms_sys/OUTP/outpmodule/VTPM_LFBatWarn_flg_Inproc" /begin SUB_GROUP S672_Signal_Limit S672_Signal_Override /end SUB_GROUP /end GROUP
/begin GROUP S5_VTPM_LFP20_raw8_Inproc "SWC_OUTP_type/run_SWC_OUTP_5ms_sys/OUTP/outpmodule/VTPM_LFP20_raw8_Inproc" /begin SUB_GROUP S673_Signal_Limit S673_Signal_Override /end SUB_GROUP /end GROUP
/begin GROUP S5_VTPM_LFPindi_enum_Inproc "SWC_OUTP_type/run_SWC_OUTP_5ms_sys/OUTP/outpmodule/VTPM_LFPindi_enum_Inproc" /begin SUB_GROUP S674_Signal_Limit S674_Signal_Override /end SUB_GROUP /end GROUP
/begin GROUP S5_VTPM_LFPressIndi_enum_Inproc "SWC_OUTP_type/run_SWC_OUTP_5ms_sys/OUTP/outpmodule/VTPM_LFPressIndi_enum_Inproc" /begin SUB_GROUP S675_Signal_Limit S675_Signal_Override /end SUB_GROUP /end GROUP
/begin GROUP S5_VTPM_LFSensorFail_flg_Inproc "SWC_OUTP_type/run_SWC_OUTP_5ms_sys/OUTP/outpmodule/VTPM_LFSensorFail_flg_Inproc" /begin SUB_GROUP S676_Signal_Limit S676_Signal_Override /end SUB_GROUP /end GROUP
/begin GROUP S5_VTPM_LFSensorMode_flg_Inproc "SWC_OUTP_type/run_SWC_OUTP_5ms_sys/OUTP/outpmodule/VTPM_LFSensorMode_flg_Inproc" /begin SUB_GROUP S677_Signal_Limit S677_Signal_Override /end SUB_GROUP /end GROUP
/begin GROUP S5_VTPM_LFWheelDebug_flg_Inproc "SWC_OUTP_type/run_SWC_OUTP_5ms_sys/OUTP/outpmodule/VTPM_LFWheelDebug_flg_Inproc" /begin SUB_GROUP S678_Signal_Limit S678_Signal_Override /end SUB_GROUP /end GROUP
/begin GROUP S5_VTPM_LFWheelPSW_raw8_Inproc "SWC_OUTP_type/run_SWC_OUTP_5ms_sys/OUTP/outpmodule/VTPM_LFWheelPSW_raw8_Inproc" /begin SUB_GROUP S679_Signal_Limit S679_Signal_Override /end SUB_GROUP /end GROUP
/begin GROUP S5_VTPM_LFWheelPress_raw8_Inproc "SWC_OUTP_type/run_SWC_OUTP_5ms_sys/OUTP/outpmodule/VTPM_LFWheelPress_raw8_Inproc" /begin SUB_GROUP S680_Signal_Limit S680_Signal_Override /end SUB_GROUP /end GROUP
/begin GROUP S5_VTPM_LFWheelTemp_C_Inproc "SWC_OUTP_type/run_SWC_OUTP_5ms_sys/OUTP/outpmodule/VTPM_LFWheelTemp_C_Inproc" /begin SUB_GROUP S681_Signal_Limit S681_Signal_Override /end SUB_GROUP /end GROUP
/begin GROUP S5_VTPM_LFWheelTmpIndi_flg_Inproc "SWC_OUTP_type/run_SWC_OUTP_5ms_sys/OUTP/outpmodule/VTPM_LFWheelTmpIndi_flg_Inproc" /begin SUB_GROUP S682_Signal_Limit S682_Signal_Override /end SUB_GROUP /end GROUP
/begin GROUP S5_VTPM_LProgress_enum_Inproc "SWC_OUTP_type/run_SWC_OUTP_5ms_sys/OUTP/outpmodule/VTPM_LProgress_enum_Inproc" /begin SUB_GROUP S683_Signal_Limit S683_Signal_Override /end SUB_GROUP /end GROUP
/begin GROUP S5_VTPM_LRBatWarn_flg_Inproc "SWC_OUTP_type/run_SWC_OUTP_5ms_sys/OUTP/outpmodule/VTPM_LRBatWarn_flg_Inproc" /begin SUB_GROUP S684_Signal_Limit S684_Signal_Override /end SUB_GROUP /end GROUP
/begin GROUP S5_VTPM_LRP20_raw8_Inproc "SWC_OUTP_type/run_SWC_OUTP_5ms_sys/OUTP/outpmodule/VTPM_LRP20_raw8_Inproc" /begin SUB_GROUP S685_Signal_Limit S685_Signal_Override /end SUB_GROUP /end GROUP
/begin GROUP S5_VTPM_LRPindi_enum_Inproc "SWC_OUTP_type/run_SWC_OUTP_5ms_sys/OUTP/outpmodule/VTPM_LRPindi_enum_Inproc" /begin SUB_GROUP S686_Signal_Limit S686_Signal_Override /end SUB_GROUP /end GROUP
/begin GROUP S5_VTPM_LRPressIndi_enum_Inproc "SWC_OUTP_type/run_SWC_OUTP_5ms_sys/OUTP/outpmodule/VTPM_LRPressIndi_enum_Inproc" /begin SUB_GROUP S687_Signal_Limit S687_Signal_Override /end SUB_GROUP /end GROUP
/begin GROUP S5_VTPM_LRSensorFail_flg_Inproc "SWC_OUTP_type/run_SWC_OUTP_5ms_sys/OUTP/outpmodule/VTPM_LRSensorFail_flg_Inproc" /begin SUB_GROUP S688_Signal_Limit S688_Signal_Override /end SUB_GROUP /end GROUP
/begin GROUP S5_VTPM_LRSensorMode_flg_Inproc "SWC_OUTP_type/run_SWC_OUTP_5ms_sys/OUTP/outpmodule/VTPM_LRSensorMode_flg_Inproc" /begin SUB_GROUP S689_Signal_Limit S689_Signal_Override /end SUB_GROUP /end GROUP
/begin GROUP S5_VTPM_LRWheelDebug_flg_Inproc "SWC_OUTP_type/run_SWC_OUTP_5ms_sys/OUTP/outpmodule/VTPM_LRWheelDebug_flg_Inproc" /begin SUB_GROUP S690_Signal_Limit S690_Signal_Override /end SUB_GROUP /end GROUP
/begin GROUP S5_VTPM_LRWheelPSW_raw8_Inproc "SWC_OUTP_type/run_SWC_OUTP_5ms_sys/OUTP/outpmodule/VTPM_LRWheelPSW_raw8_Inproc" /begin SUB_GROUP S691_Signal_Limit S691_Signal_Override /end SUB_GROUP /end GROUP
/begin GROUP S5_VTPM_LRWheelPress_raw8_Inproc "SWC_OUTP_type/run_SWC_OUTP_5ms_sys/OUTP/outpmodule/VTPM_LRWheelPress_raw8_Inproc" /begin SUB_GROUP S692_Signal_Limit S692_Signal_Override /end SUB_GROUP /end GROUP
/begin GROUP S5_VTPM_LRWheelTemp_C_Inproc "SWC_OUTP_type/run_SWC_OUTP_5ms_sys/OUTP/outpmodule/VTPM_LRWheelTemp_C_Inproc" /begin SUB_GROUP S693_Signal_Limit S693_Signal_Override /end SUB_GROUP /end GROUP
/begin GROUP S5_VTPM_LRWheelTmpIndi_flg_Inproc "SWC_OUTP_type/run_SWC_OUTP_5ms_sys/OUTP/outpmodule/VTPM_LRWheelTmpIndi_flg_Inproc" /begin SUB_GROUP S694_Signal_Limit S694_Signal_Override /end SUB_GROUP /end GROUP
/begin GROUP S5_VTPM_ModelVersionChksum_raw_Inproc "SWC_OUTP_type/run_SWC_OUTP_5ms_sys/OUTP/outpmodule/VTPM_ModelVersionChksum_raw_Inproc" /begin SUB_GROUP S695_Signal_Limit S695_Signal_Override /end SUB_GROUP /end GROUP
/begin GROUP S5_VTPM_ModelVersion_raw_Inproc "SWC_OUTP_type/run_SWC_OUTP_5ms_sys/OUTP/outpmodule/VTPM_ModelVersion_raw_Inproc" /begin SUB_GROUP S696_Signal_Limit S696_Signal_Override /end SUB_GROUP /end GROUP
/begin GROUP S5_VTPM_Prepresstempvalid_enum_Inproc "SWC_OUTP_type/run_SWC_OUTP_5ms_sys/OUTP/outpmodule/VTPM_Prepresstempvalid_enum_Inproc" /begin SUB_GROUP S697_Signal_Limit S697_Signal_Override /end SUB_GROUP /end GROUP
/begin GROUP S5_VTPM_RFBatWarn_flg_Inproc "SWC_OUTP_type/run_SWC_OUTP_5ms_sys/OUTP/outpmodule/VTPM_RFBatWarn_flg_Inproc" /begin SUB_GROUP S698_Signal_Limit S698_Signal_Override /end SUB_GROUP /end GROUP
/begin GROUP S5_VTPM_RFP20_raw8_Inproc "SWC_OUTP_type/run_SWC_OUTP_5ms_sys/OUTP/outpmodule/VTPM_RFP20_raw8_Inproc" /begin SUB_GROUP S699_Signal_Limit S699_Signal_Override /end SUB_GROUP /end GROUP
/begin GROUP S5_VTPM_RFPind_enum_Inproc "SWC_OUTP_type/run_SWC_OUTP_5ms_sys/OUTP/outpmodule/VTPM_RFPind_enum_Inproc" /begin SUB_GROUP S700_Signal_Limit S700_Signal_Override /end SUB_GROUP /end GROUP
/begin GROUP S5_VTPM_RFPressIndi_enum_Inproc "SWC_OUTP_type/run_SWC_OUTP_5ms_sys/OUTP/outpmodule/VTPM_RFPressIndi_enum_Inproc" /begin SUB_GROUP S701_Signal_Limit S701_Signal_Override /end SUB_GROUP /end GROUP
/begin GROUP S5_VTPM_RFSensorFail_flg_Inproc "SWC_OUTP_type/run_SWC_OUTP_5ms_sys/OUTP/outpmodule/VTPM_RFSensorFail_flg_Inproc" /begin SUB_GROUP S702_Signal_Limit S702_Signal_Override /end SUB_GROUP /end GROUP
/begin GROUP S5_VTPM_RFSensorMode_flg_Inproc "SWC_OUTP_type/run_SWC_OUTP_5ms_sys/OUTP/outpmodule/VTPM_RFSensorMode_flg_Inproc" /begin SUB_GROUP S703_Signal_Limit S703_Signal_Override /end SUB_GROUP /end GROUP
/begin GROUP S5_VTPM_RFWheelDebug_flg_Inproc "SWC_OUTP_type/run_SWC_OUTP_5ms_sys/OUTP/outpmodule/VTPM_RFWheelDebug_flg_Inproc" /begin SUB_GROUP S704_Signal_Limit S704_Signal_Override /end SUB_GROUP /end GROUP
/begin GROUP S5_VTPM_RFWheelPSW_raw8_Inproc "SWC_OUTP_type/run_SWC_OUTP_5ms_sys/OUTP/outpmodule/VTPM_RFWheelPSW_raw8_Inproc" /begin SUB_GROUP S705_Signal_Limit S705_Signal_Override /end SUB_GROUP /end GROUP
/begin GROUP S5_VTPM_RFWheelPress_raw8_Inproc "SWC_OUTP_type/run_SWC_OUTP_5ms_sys/OUTP/outpmodule/VTPM_RFWheelPress_raw8_Inproc" /begin SUB_GROUP S706_Signal_Limit S706_Signal_Override /end SUB_GROUP /end GROUP
/begin GROUP S5_VTPM_RFWheelTemp_C_Inproc "SWC_OUTP_type/run_SWC_OUTP_5ms_sys/OUTP/outpmodule/VTPM_RFWheelTemp_C_Inproc" /begin SUB_GROUP S707_Signal_Limit S707_Signal_Override /end SUB_GROUP /end GROUP
/begin GROUP S5_VTPM_RFWheelTmpIndi_flg_Inproc "SWC_OUTP_type/run_SWC_OUTP_5ms_sys/OUTP/outpmodule/VTPM_RFWheelTmpIndi_flg_Inproc" /begin SUB_GROUP S708_Signal_Limit S708_Signal_Override /end SUB_GROUP /end GROUP
/begin GROUP S5_VTPM_RRBatWarn_flg_Inproc "SWC_OUTP_type/run_SWC_OUTP_5ms_sys/OUTP/outpmodule/VTPM_RRBatWarn_flg_Inproc" /begin SUB_GROUP S709_Signal_Limit S709_Signal_Override /end SUB_GROUP /end GROUP
/begin GROUP S5_VTPM_RRP20_raw8_Inproc "SWC_OUTP_type/run_SWC_OUTP_5ms_sys/OUTP/outpmodule/VTPM_RRP20_raw8_Inproc" /begin SUB_GROUP S710_Signal_Limit S710_Signal_Override /end SUB_GROUP /end GROUP
/begin GROUP S5_VTPM_RRPindi_enum_Inproc "SWC_OUTP_type/run_SWC_OUTP_5ms_sys/OUTP/outpmodule/VTPM_RRPindi_enum_Inproc" /begin SUB_GROUP S711_Signal_Limit S711_Signal_Override /end SUB_GROUP /end GROUP
/begin GROUP S5_VTPM_RRPressIndi_enum_Inproc "SWC_OUTP_type/run_SWC_OUTP_5ms_sys/OUTP/outpmodule/VTPM_RRPressIndi_enum_Inproc" /begin SUB_GROUP S712_Signal_Limit S712_Signal_Override /end SUB_GROUP /end GROUP
/begin GROUP S5_VTPM_RRSensorFail_flg_Inproc "SWC_OUTP_type/run_SWC_OUTP_5ms_sys/OUTP/outpmodule/VTPM_RRSensorFail_flg_Inproc" /begin SUB_GROUP S713_Signal_Limit S713_Signal_Override /end SUB_GROUP /end GROUP
/begin GROUP S5_VTPM_RRSensorMode_flg_Inproc "SWC_OUTP_type/run_SWC_OUTP_5ms_sys/OUTP/outpmodule/VTPM_RRSensorMode_flg_Inproc" /begin SUB_GROUP S714_Signal_Limit S714_Signal_Override /end SUB_GROUP /end GROUP
/begin GROUP S5_VTPM_RRWheelDebug_flg_Inproc "SWC_OUTP_type/run_SWC_OUTP_5ms_sys/OUTP/outpmodule/VTPM_RRWheelDebug_flg_Inproc" /begin SUB_GROUP S715_Signal_Limit S715_Signal_Override /end SUB_GROUP /end GROUP
/begin GROUP S5_VTPM_RRWheelPSW_raw8_Inproc "SWC_OUTP_type/run_SWC_OUTP_5ms_sys/OUTP/outpmodule/VTPM_RRWheelPSW_raw8_Inproc" /begin SUB_GROUP S716_Signal_Limit S716_Signal_Override /end SUB_GROUP /end GROUP
/begin GROUP S5_VTPM_RRWheelPress_raw8_Inproc "SWC_OUTP_type/run_SWC_OUTP_5ms_sys/OUTP/outpmodule/VTPM_RRWheelPress_raw8_Inproc" /begin SUB_GROUP S717_Signal_Limit S717_Signal_Override /end SUB_GROUP /end GROUP
/begin GROUP S5_VTPM_RRWheelTemp_C_Inproc "SWC_OUTP_type/run_SWC_OUTP_5ms_sys/OUTP/outpmodule/VTPM_RRWheelTemp_C_Inproc" /begin SUB_GROUP S718_Signal_Limit S718_Signal_Override /end SUB_GROUP /end GROUP
/begin GROUP S5_VTPM_RRWheelTmpIndi_flg_Inproc "SWC_OUTP_type/run_SWC_OUTP_5ms_sys/OUTP/outpmodule/VTPM_RRWheelTmpIndi_flg_Inproc" /begin SUB_GROUP S719_Signal_Limit S719_Signal_Override /end SUB_GROUP /end GROUP
/begin GROUP S5_VTPM_S1ID_raw32_Inproc "SWC_OUTP_type/run_SWC_OUTP_5ms_sys/OUTP/outpmodule/VTPM_S1ID_raw32_Inproc" /begin SUB_GROUP S720_Signal_Limit S720_Signal_Override /end SUB_GROUP /end GROUP
/begin GROUP S5_VTPM_S1L_enum_Inproc "SWC_OUTP_type/run_SWC_OUTP_5ms_sys/OUTP/outpmodule/VTPM_S1L_enum_Inproc" /begin SUB_GROUP S721_Signal_Limit S721_Signal_Override /end SUB_GROUP /end GROUP
/begin GROUP S5_VTPM_S1WheelDebugALTU_pct_Inproc "SWC_OUTP_type/run_SWC_OUTP_5ms_sys/OUTP/outpmodule/VTPM_S1WheelDebugALTU_pct_Inproc" /begin SUB_GROUP S722_Signal_Limit S722_Signal_Override /end SUB_GROUP /end GROUP
/begin GROUP S5_VTPM_S2ID_raw32_Inproc "SWC_OUTP_type/run_SWC_OUTP_5ms_sys/OUTP/outpmodule/VTPM_S2ID_raw32_Inproc" /begin SUB_GROUP S723_Signal_Limit S723_Signal_Override /end SUB_GROUP /end GROUP
/begin GROUP S5_VTPM_S2L_enum_Inproc "SWC_OUTP_type/run_SWC_OUTP_5ms_sys/OUTP/outpmodule/VTPM_S2L_enum_Inproc" /begin SUB_GROUP S724_Signal_Limit S724_Signal_Override /end SUB_GROUP /end GROUP
/begin GROUP S5_VTPM_S2WheelDebugALTU_pct_Inproc "SWC_OUTP_type/run_SWC_OUTP_5ms_sys/OUTP/outpmodule/VTPM_S2WheelDebugALTU_pct_Inproc" /begin SUB_GROUP S725_Signal_Limit S725_Signal_Override /end SUB_GROUP /end GROUP
/begin GROUP S5_VTPM_S3ID_raw32_Inproc "SWC_OUTP_type/run_SWC_OUTP_5ms_sys/OUTP/outpmodule/VTPM_S3ID_raw32_Inproc" /begin SUB_GROUP S726_Signal_Limit S726_Signal_Override /end SUB_GROUP /end GROUP
/begin GROUP S5_VTPM_S3L_enum_Inproc "SWC_OUTP_type/run_SWC_OUTP_5ms_sys/OUTP/outpmodule/VTPM_S3L_enum_Inproc" /begin SUB_GROUP S727_Signal_Limit S727_Signal_Override /end SUB_GROUP /end GROUP
/begin GROUP S5_VTPM_S3WheelDebugALTU_pct_Inproc "SWC_OUTP_type/run_SWC_OUTP_5ms_sys/OUTP/outpmodule/VTPM_S3WheelDebugALTU_pct_Inproc" /begin SUB_GROUP S728_Signal_Limit S728_Signal_Override /end SUB_GROUP /end GROUP
/begin GROUP S5_VTPM_S4ID_raw32_Inproc "SWC_OUTP_type/run_SWC_OUTP_5ms_sys/OUTP/outpmodule/VTPM_S4ID_raw32_Inproc" /begin SUB_GROUP S729_Signal_Limit S729_Signal_Override /end SUB_GROUP /end GROUP
/begin GROUP S5_VTPM_S4L_enum_Inproc "SWC_OUTP_type/run_SWC_OUTP_5ms_sys/OUTP/outpmodule/VTPM_S4L_enum_Inproc" /begin SUB_GROUP S730_Signal_Limit S730_Signal_Override /end SUB_GROUP /end GROUP
/begin GROUP S5_VTPM_S4WheelDebugALTU_pct_Inproc "SWC_OUTP_type/run_SWC_OUTP_5ms_sys/OUTP/outpmodule/VTPM_S4WheelDebugALTU_pct_Inproc" /begin SUB_GROUP S731_Signal_Limit S731_Signal_Override /end SUB_GROUP /end GROUP
/begin GROUP S5_VTPM_SetIDLoc_flg_Inproc "SWC_OUTP_type/run_SWC_OUTP_5ms_sys/OUTP/outpmodule/VTPM_SetIDLoc_flg_Inproc" /begin SUB_GROUP S732_Signal_Limit S732_Signal_Override /end SUB_GROUP /end GROUP
/begin GROUP S5_VTPM_TPMSCaliButtAllow_flg_Inproc "SWC_OUTP_type/run_SWC_OUTP_5ms_sys/OUTP/outpmodule/VTPM_TPMSCaliButtAllow_flg_Inproc" /begin SUB_GROUP S733_Signal_Limit S733_Signal_Override /end SUB_GROUP /end GROUP
/begin GROUP S5_VTPM_TPMSResButtAllow_flg_Inproc "SWC_OUTP_type/run_SWC_OUTP_5ms_sys/OUTP/outpmodule/VTPM_TPMSResButtAllow_flg_Inproc" /begin SUB_GROUP S734_Signal_Limit S734_Signal_Override /end SUB_GROUP /end GROUP
/begin GROUP S5_VTPM_TPMSResButt_flg_Inproc "SWC_OUTP_type/run_SWC_OUTP_5ms_sys/OUTP/outpmodule/VTPM_TPMSResButt_flg_Inproc" /begin SUB_GROUP S735_Signal_Limit S735_Signal_Override /end SUB_GROUP /end GROUP
/begin GROUP S5_VTPM_TPMSSensorIDRegStart_flg_Inproc "SWC_OUTP_type/run_SWC_OUTP_5ms_sys/OUTP/outpmodule/VTPM_TPMSSensorIDRegStart_flg_Inproc" /begin SUB_GROUP S736_Signal_Limit S736_Signal_Override /end SUB_GROUP /end GROUP
/begin GROUP S5_VTPM_TPMSStorge_flg_Inproc "SWC_OUTP_type/run_SWC_OUTP_5ms_sys/OUTP/outpmodule/VTPM_TPMSStorge_flg_Inproc" /begin SUB_GROUP S737_Signal_Limit S737_Signal_Override /end SUB_GROUP /end GROUP
/begin GROUP S5_VTPM_TPMSTLCmd_flg_Inproc "SWC_OUTP_type/run_SWC_OUTP_5ms_sys/OUTP/outpmodule/VTPM_TPMSTLCmd_flg_Inproc" /begin SUB_GROUP S738_Signal_Limit S738_Signal_Override /end SUB_GROUP /end GROUP
/begin GROUP S5_VTPM_TPMSWarnIndi_enum_Inproc "SWC_OUTP_type/run_SWC_OUTP_5ms_sys/OUTP/outpmodule/VTPM_TPMSWarnIndi_enum_Inproc" /begin SUB_GROUP S739_Signal_Limit S739_Signal_Override /end SUB_GROUP /end GROUP
/begin GROUP S5_VTPM_WriteChkLFID_raw_Inproc "SWC_OUTP_type/run_SWC_OUTP_5ms_sys/OUTP/outpmodule/VTPM_WriteChkLFID_raw_Inproc" /begin SUB_GROUP S740_Signal_Limit S740_Signal_Override /end SUB_GROUP /end GROUP
/begin GROUP S5_VTPM_WriteChkLRID_raw_Inproc "SWC_OUTP_type/run_SWC_OUTP_5ms_sys/OUTP/outpmodule/VTPM_WriteChkLRID_raw_Inproc" /begin SUB_GROUP S741_Signal_Limit S741_Signal_Override /end SUB_GROUP /end GROUP
/begin GROUP S5_VTPM_WriteChkRFID_raw_Inproc "SWC_OUTP_type/run_SWC_OUTP_5ms_sys/OUTP/outpmodule/VTPM_WriteChkRFID_raw_Inproc" /begin SUB_GROUP S742_Signal_Limit S742_Signal_Override /end SUB_GROUP /end GROUP
/begin GROUP S5_VTPM_WriteChkRRID_raw_Inproc "SWC_OUTP_type/run_SWC_OUTP_5ms_sys/OUTP/outpmodule/VTPM_WriteChkRRID_raw_Inproc" /begin SUB_GROUP S743_Signal_Limit S743_Signal_Override /end SUB_GROUP /end GROUP
/begin GROUP S5_VTPM_WriteChkfinLFID_raw_Inproc "SWC_OUTP_type/run_SWC_OUTP_5ms_sys/OUTP/outpmodule/VTPM_WriteChkfinLFID_raw_Inproc" /begin SUB_GROUP S744_Signal_Limit S744_Signal_Override /end SUB_GROUP /end GROUP
/begin GROUP S5_VTPM_WriteChkfinLRID_raw_Inproc "SWC_OUTP_type/run_SWC_OUTP_5ms_sys/OUTP/outpmodule/VTPM_WriteChkfinLRID_raw_Inproc" /begin SUB_GROUP S745_Signal_Limit S745_Signal_Override /end SUB_GROUP /end GROUP
/begin GROUP S5_VTPM_WriteChkfinRFID_raw_Inproc "SWC_OUTP_type/run_SWC_OUTP_5ms_sys/OUTP/outpmodule/VTPM_WriteChkfinRFID_raw_Inproc" /begin SUB_GROUP S746_Signal_Limit S746_Signal_Override /end SUB_GROUP /end GROUP
/begin GROUP S5_VTPM_WriteChkfinRRID_raw_Inproc "SWC_OUTP_type/run_SWC_OUTP_5ms_sys/OUTP/outpmodule/VTPM_WriteChkfinRRID_raw_Inproc" /begin SUB_GROUP S747_Signal_Limit S747_Signal_Override /end SUB_GROUP /end GROUP
/begin GROUP S5_VTPM_WritingCnt_enum_Inproc "SWC_OUTP_type/run_SWC_OUTP_5ms_sys/OUTP/outpmodule/VTPM_WritingCnt_enum_Inproc" /begin SUB_GROUP S748_Signal_Limit S748_Signal_Override /end SUB_GROUP /end GROUP
/begin GROUP S5_VTPM_unlearnSfailvalid_enum_Inproc "SWC_OUTP_type/run_SWC_OUTP_5ms_sys/OUTP/outpmodule/VTPM_unlearnSfailvalid_enum_Inproc" /begin SUB_GROUP S749_Signal_Limit S749_Signal_Override /end SUB_GROUP /end GROUP
/begin GROUP S5_VTPM_unlearnSfali_flg_Inproc "SWC_OUTP_type/run_SWC_OUTP_5ms_sys/OUTP/outpmodule/VTPM_unlearnSfali_flg_Inproc" /begin SUB_GROUP S750_Signal_Limit S750_Signal_Override /end SUB_GROUP /end GROUP
/begin GROUP S5_VTQD_ActDriveMode_enum_Inproc "SWC_OUTP_type/run_SWC_OUTP_5ms_sys/OUTP/outpmodule/VTQD_ActDriveMode_enum_Inproc" /begin SUB_GROUP S751_Signal_Limit S751_Signal_Override /end SUB_GROUP /end GROUP
/begin GROUP S5_VTQD_ActTUpAIND_enum_Inproc "SWC_OUTP_type/run_SWC_OUTP_5ms_sys/OUTP/outpmodule/VTQD_ActTUpAIND_enum_Inproc" /begin SUB_GROUP S752_Signal_Limit S752_Signal_Override /end SUB_GROUP /end GROUP
/begin GROUP S5_VTQD_CreepIND_enum_Inproc "SWC_OUTP_type/run_SWC_OUTP_5ms_sys/OUTP/outpmodule/VTQD_CreepIND_enum_Inproc" /begin SUB_GROUP S753_Signal_Limit S753_Signal_Override /end SUB_GROUP /end GROUP
/begin GROUP S5_VTQD_CreepSpdReq_rpm_Inproc "SWC_OUTP_type/run_SWC_OUTP_5ms_sys/OUTP/outpmodule/VTQD_CreepSpdReq_rpm_Inproc" /begin SUB_GROUP S754_Signal_Limit S754_Signal_Override /end SUB_GROUP /end GROUP
/begin GROUP S5_VTQD_EC1EMDefTrqLmt_rpm_Inproc "SWC_OUTP_type/run_SWC_OUTP_5ms_sys/OUTP/outpmodule/VTQD_EC1EMDefTrqLmt_rpm_Inproc" /begin SUB_GROUP S755_Signal_Limit S755_Signal_Override /end SUB_GROUP /end GROUP
/begin GROUP S5_VTQD_EC1EMExtRSCtrlUpLmt_rpm_Inproc "SWC_OUTP_type/run_SWC_OUTP_5ms_sys/OUTP/outpmodule/VTQD_EC1EMExtRSCtrlUpLmt_rpm_Inproc" /begin SUB_GROUP S756_Signal_Limit S756_Signal_Override /end SUB_GROUP /end GROUP
/begin GROUP S5_VTQD_EC1EMGainEndSpdGvn_gain_Inproc "SWC_OUTP_type/run_SWC_OUTP_5ms_sys/OUTP/outpmodule/VTQD_EC1EMGainEndSpdGvn_gain_Inproc" /begin SUB_GROUP S757_Signal_Limit S757_Signal_Override /end SUB_GROUP /end GROUP
/begin GROUP S5_VTQD_EC1EMMaxMEngOvrSP7_rpm_Inproc "SWC_OUTP_type/run_SWC_OUTP_5ms_sys/OUTP/outpmodule/VTQD_EC1EMMaxMEngOvrSP7_rpm_Inproc" /begin SUB_GROUP S758_Signal_Limit S758_Signal_Override /end SUB_GROUP /end GROUP
/begin GROUP S5_VTQD_EC1EMMaxMOvrTmt_s_Inproc "SWC_OUTP_type/run_SWC_OUTP_5ms_sys/OUTP/outpmodule/VTQD_EC1EMMaxMOvrTmt_s_Inproc" /begin SUB_GROUP S759_Signal_Limit S759_Signal_Override /end SUB_GROUP /end GROUP
/begin GROUP S5_VTQD_EC1EMMomOfInertia_kgpm2_Inproc "SWC_OUTP_type/run_SWC_OUTP_5ms_sys/OUTP/outpmodule/VTQD_EC1EMMomOfInertia_kgpm2_Inproc" /begin SUB_GROUP S760_Signal_Limit S760_Signal_Override /end SUB_GROUP /end GROUP
/begin GROUP S5_VTQD_EC1EMRefTorq_Nm_Inproc "SWC_OUTP_type/run_SWC_OUTP_5ms_sys/OUTP/outpmodule/VTQD_EC1EMRefTorq_Nm_Inproc" /begin SUB_GROUP S761_Signal_Limit S761_Signal_Override /end SUB_GROUP /end GROUP
/begin GROUP S5_VTQD_EC1EMReqSpdCtrlLoLmt_rpm_Inproc "SWC_OUTP_type/run_SWC_OUTP_5ms_sys/OUTP/outpmodule/VTQD_EC1EMReqSpdCtrlLoLmt_rpm_Inproc" /begin SUB_GROUP S762_Signal_Limit S762_Signal_Override /end SUB_GROUP /end GROUP
/begin GROUP S5_VTQD_EC1EMReqSpdCtrlUpLmt_rpm_Inproc "SWC_OUTP_type/run_SWC_OUTP_5ms_sys/OUTP/outpmodule/VTQD_EC1EMReqSpdCtrlUpLmt_rpm_Inproc" /begin SUB_GROUP S763_Signal_Limit S763_Signal_Override /end SUB_GROUP /end GROUP
/begin GROUP S5_VTQD_EC1EMReqTrqCtrlLoLmt_pct_Inproc "SWC_OUTP_type/run_SWC_OUTP_5ms_sys/OUTP/outpmodule/VTQD_EC1EMReqTrqCtrlLoLmt_pct_Inproc" /begin SUB_GROUP S764_Signal_Limit S764_Signal_Override /end SUB_GROUP /end GROUP
/begin GROUP S5_VTQD_EC1EMReqTrqCtrlUpLmt_pct_Inproc "SWC_OUTP_type/run_SWC_OUTP_5ms_sys/OUTP/outpmodule/VTQD_EC1EMReqTrqCtrlUpLmt_pct_Inproc" /begin SUB_GROUP S765_Signal_Limit S765_Signal_Override /end SUB_GROUP /end GROUP
/begin GROUP S5_VTQD_EC1EMSpdHdleP6_rpm_Inproc "SWC_OUTP_type/run_SWC_OUTP_5ms_sys/OUTP/outpmodule/VTQD_EC1EMSpdHdleP6_rpm_Inproc" /begin SUB_GROUP S766_Signal_Limit S766_Signal_Override /end SUB_GROUP /end GROUP
/begin GROUP S5_VTQD_EC1EMSpdIdleP1_rpm_Inproc "SWC_OUTP_type/run_SWC_OUTP_5ms_sys/OUTP/outpmodule/VTQD_EC1EMSpdIdleP1_rpm_Inproc" /begin SUB_GROUP S767_Signal_Limit S767_Signal_Override /end SUB_GROUP /end GROUP
/begin GROUP S5_VTQD_EC1EMSpdIdleP2_rpm_Inproc "SWC_OUTP_type/run_SWC_OUTP_5ms_sys/OUTP/outpmodule/VTQD_EC1EMSpdIdleP2_rpm_Inproc" /begin SUB_GROUP S768_Signal_Limit S768_Signal_Override /end SUB_GROUP /end GROUP
/begin GROUP S5_VTQD_EC1EMSpdIdleP3_rpm_Inproc "SWC_OUTP_type/run_SWC_OUTP_5ms_sys/OUTP/outpmodule/VTQD_EC1EMSpdIdleP3_rpm_Inproc" /begin SUB_GROUP S769_Signal_Limit S769_Signal_Override /end SUB_GROUP /end GROUP
/begin GROUP S5_VTQD_EC1EMSpdIdleP4_rpm_Inproc "SWC_OUTP_type/run_SWC_OUTP_5ms_sys/OUTP/outpmodule/VTQD_EC1EMSpdIdleP4_rpm_Inproc" /begin SUB_GROUP S770_Signal_Limit S770_Signal_Override /end SUB_GROUP /end GROUP
/begin GROUP S5_VTQD_EC1EMSpdIdleP5_rpm_Inproc "SWC_OUTP_type/run_SWC_OUTP_5ms_sys/OUTP/outpmodule/VTQD_EC1EMSpdIdleP5_rpm_Inproc" /begin SUB_GROUP S771_Signal_Limit S771_Signal_Override /end SUB_GROUP /end GROUP
/begin GROUP S5_VTQD_EC1EMSupTSC1CtrlPG1_cnt_Inproc "SWC_OUTP_type/run_SWC_OUTP_5ms_sys/OUTP/outpmodule/VTQD_EC1EMSupTSC1CtrlPG1_cnt_Inproc" /begin SUB_GROUP S772_Signal_Limit S772_Signal_Override /end SUB_GROUP /end GROUP
/begin GROUP S5_VTQD_EC1EMSupTSC1CtrlPG2_cnt_Inproc "SWC_OUTP_type/run_SWC_OUTP_5ms_sys/OUTP/outpmodule/VTQD_EC1EMSupTSC1CtrlPG2_cnt_Inproc" /begin SUB_GROUP S773_Signal_Limit S773_Signal_Override /end SUB_GROUP /end GROUP
/begin GROUP S5_VTQD_EC1EMSupTSC1CtrlPG3_cnt_Inproc "SWC_OUTP_type/run_SWC_OUTP_5ms_sys/OUTP/outpmodule/VTQD_EC1EMSupTSC1CtrlPG3_cnt_Inproc" /begin SUB_GROUP S774_Signal_Limit S774_Signal_Override /end SUB_GROUP /end GROUP
/begin GROUP S5_VTQD_EC1EMSupTSC1CtrlPG4_cnt_Inproc "SWC_OUTP_type/run_SWC_OUTP_5ms_sys/OUTP/outpmodule/VTQD_EC1EMSupTSC1CtrlPG4_cnt_Inproc" /begin SUB_GROUP S775_Signal_Limit S775_Signal_Override /end SUB_GROUP /end GROUP
/begin GROUP S5_VTQD_EC1EMSupVarRTSC1MSG_cnt_Inproc "SWC_OUTP_type/run_SWC_OUTP_5ms_sys/OUTP/outpmodule/VTQD_EC1EMSupVarRTSC1MSG_cnt_Inproc" /begin SUB_GROUP S776_Signal_Limit S776_Signal_Override /end SUB_GROUP /end GROUP
/begin GROUP S5_VTQD_EC1PercTorqIdleP1_pct_Inproc "SWC_OUTP_type/run_SWC_OUTP_5ms_sys/OUTP/outpmodule/VTQD_EC1PercTorqIdleP1_pct_Inproc" /begin SUB_GROUP S777_Signal_Limit S777_Signal_Override /end SUB_GROUP /end GROUP
/begin GROUP S5_VTQD_EC1PercTorqIdleP2_pct_Inproc "SWC_OUTP_type/run_SWC_OUTP_5ms_sys/OUTP/outpmodule/VTQD_EC1PercTorqIdleP2_pct_Inproc" /begin SUB_GROUP S778_Signal_Limit S778_Signal_Override /end SUB_GROUP /end GROUP
/begin GROUP S5_VTQD_EC1PercTorqIdleP3_pct_Inproc "SWC_OUTP_type/run_SWC_OUTP_5ms_sys/OUTP/outpmodule/VTQD_EC1PercTorqIdleP3_pct_Inproc" /begin SUB_GROUP S779_Signal_Limit S779_Signal_Override /end SUB_GROUP /end GROUP
/begin GROUP S5_VTQD_EC1PercTorqIdleP4_pct_Inproc "SWC_OUTP_type/run_SWC_OUTP_5ms_sys/OUTP/outpmodule/VTQD_EC1PercTorqIdleP4_pct_Inproc" /begin SUB_GROUP S780_Signal_Limit S780_Signal_Override /end SUB_GROUP /end GROUP
/begin GROUP S5_VTQD_EC1PercTorqIdleP5_pct_Inproc "SWC_OUTP_type/run_SWC_OUTP_5ms_sys/OUTP/outpmodule/VTQD_EC1PercTorqIdleP5_pct_Inproc" /begin SUB_GROUP S781_Signal_Limit S781_Signal_Override /end SUB_GROUP /end GROUP
/begin GROUP S5_VTQD_EEC3EMPressLoss_pct_Inproc "SWC_OUTP_type/run_SWC_OUTP_5ms_sys/OUTP/outpmodule/VTQD_EEC3EMPressLoss_pct_Inproc" /begin SUB_GROUP S782_Signal_Limit S782_Signal_Override /end SUB_GROUP /end GROUP
/begin GROUP S5_VTQD_EEC3NFricPercTorq_pct_Inproc "SWC_OUTP_type/run_SWC_OUTP_5ms_sys/OUTP/outpmodule/VTQD_EEC3NFricPercTorq_pct_Inproc" /begin SUB_GROUP S783_Signal_Limit S783_Signal_Override /end SUB_GROUP /end GROUP
/begin GROUP S5_VTQD_EMRC1ActEMOutSftSpd_rpm_Inproc "SWC_OUTP_type/run_SWC_OUTP_5ms_sys/OUTP/outpmodule/VTQD_EMRC1ActEMOutSftSpd_rpm_Inproc" /begin SUB_GROUP S784_Signal_Limit S784_Signal_Override /end SUB_GROUP /end GROUP
/begin GROUP S5_VTQD_EMRC1ActEMpTrqHrls_pct_Inproc "SWC_OUTP_type/run_SWC_OUTP_5ms_sys/OUTP/outpmodule/VTQD_EMRC1ActEMpTrqHrls_pct_Inproc" /begin SUB_GROUP S785_Signal_Limit S785_Signal_Override /end SUB_GROUP /end GROUP
/begin GROUP S5_VTQD_EMRC1ActEMpTrq_pct_Inproc "SWC_OUTP_type/run_SWC_OUTP_5ms_sys/OUTP/outpmodule/VTQD_EMRC1ActEMpTrq_pct_Inproc" /begin SUB_GROUP S786_Signal_Limit S786_Signal_Override /end SUB_GROUP /end GROUP
/begin GROUP S5_VTQD_EMRC1ActMaxAvaEMRecpTrq_pct_Inproc "SWC_OUTP_type/run_SWC_OUTP_5ms_sys/OUTP/outpmodule/VTQD_EMRC1ActMaxAvaEMRecpTrq_pct_Inproc" /begin SUB_GROUP S787_Signal_Limit S787_Signal_Override /end SUB_GROUP /end GROUP
/begin GROUP S5_VTQD_EMRC1DrvDemEMRtapTrq_pct_Inproc "SWC_OUTP_type/run_SWC_OUTP_5ms_sys/OUTP/outpmodule/VTQD_EMRC1DrvDemEMRtapTrq_pct_Inproc" /begin SUB_GROUP S788_Signal_Limit S788_Signal_Override /end SUB_GROUP /end GROUP
/begin GROUP S5_VTQD_EMRC1EMTquModeDrvBrk_enum_Inproc "SWC_OUTP_type/run_SWC_OUTP_5ms_sys/OUTP/outpmodule/VTQD_EMRC1EMTquModeDrvBrk_enum_Inproc" /begin SUB_GROUP S789_Signal_Limit S789_Signal_Override /end SUB_GROUP /end GROUP
/begin GROUP S5_VTQD_EMRC1RetSelNonEng_pct_Inproc "SWC_OUTP_type/run_SWC_OUTP_5ms_sys/OUTP/outpmodule/VTQD_EMRC1RetSelNonEng_pct_Inproc" /begin SUB_GROUP S790_Signal_Limit S790_Signal_Override /end SUB_GROUP /end GROUP
/begin GROUP S5_VTQD_EMRC1SACtrlDev_cnt_Inproc "SWC_OUTP_type/run_SWC_OUTP_5ms_sys/OUTP/outpmodule/VTQD_EMRC1SACtrlDev_cnt_Inproc" /begin SUB_GROUP S791_Signal_Limit S791_Signal_Override /end SUB_GROUP /end GROUP
/begin GROUP S5_VTQD_ETC1ShiftrPgs_enum_Inproc "SWC_OUTP_type/run_SWC_OUTP_5ms_sys/OUTP/outpmodule/VTQD_ETC1ShiftrPgs_enum_Inproc" /begin SUB_GROUP S792_Signal_Limit S792_Signal_Override /end SUB_GROUP /end GROUP
/begin GROUP S5_VTQD_ETC2ActDriveDirect_enum_Inproc "SWC_OUTP_type/run_SWC_OUTP_5ms_sys/OUTP/outpmodule/VTQD_ETC2ActDriveDirect_enum_Inproc" /begin SUB_GROUP S793_Signal_Limit S793_Signal_Override /end SUB_GROUP /end GROUP
/begin GROUP S5_VTQD_EVCU1ActDrvMode_enum_Inproc "SWC_OUTP_type/run_SWC_OUTP_5ms_sys/OUTP/outpmodule/VTQD_EVCU1ActDrvMode_enum_Inproc" /begin SUB_GROUP S794_Signal_Limit S794_Signal_Override /end SUB_GROUP /end GROUP
/begin GROUP S5_VTQD_EVCU1EBrakeTorqLow_enum_Inproc "SWC_OUTP_type/run_SWC_OUTP_5ms_sys/OUTP/outpmodule/VTQD_EVCU1EBrakeTorqLow_enum_Inproc" /begin SUB_GROUP S795_Signal_Limit S795_Signal_Override /end SUB_GROUP /end GROUP
/begin GROUP S5_VTQD_EVCU1EMotorOvrerSpd_enum_Inproc "SWC_OUTP_type/run_SWC_OUTP_5ms_sys/OUTP/outpmodule/VTQD_EVCU1EMotorOvrerSpd_enum_Inproc" /begin SUB_GROUP S796_Signal_Limit S796_Signal_Override /end SUB_GROUP /end GROUP
/begin GROUP S5_VTQD_EVCU1EMotorPerformance_pct_Inproc "SWC_OUTP_type/run_SWC_OUTP_5ms_sys/OUTP/outpmodule/VTQD_EVCU1EMotorPerformance_pct_Inproc" /begin SUB_GROUP S797_Signal_Limit S797_Signal_Override /end SUB_GROUP /end GROUP
/begin GROUP S5_VTQD_EVCU1EMotorSpd_rpm_Inproc "SWC_OUTP_type/run_SWC_OUTP_5ms_sys/OUTP/outpmodule/VTQD_EVCU1EMotorSpd_rpm_Inproc" /begin SUB_GROUP S798_Signal_Limit S798_Signal_Override /end SUB_GROUP /end GROUP
/begin GROUP S5_VTQD_EVCU1RecuperHighSta_enum_Inproc "SWC_OUTP_type/run_SWC_OUTP_5ms_sys/OUTP/outpmodule/VTQD_EVCU1RecuperHighSta_enum_Inproc" /begin SUB_GROUP S799_Signal_Limit S799_Signal_Override /end SUB_GROUP /end GROUP
/begin GROUP S5_VTQD_EVCU1WheelSlipdet_enum_Inproc "SWC_OUTP_type/run_SWC_OUTP_5ms_sys/OUTP/outpmodule/VTQD_EVCU1WheelSlipdet_enum_Inproc" /begin SUB_GROUP S800_Signal_Limit S800_Signal_Override /end SUB_GROUP /end GROUP
/begin GROUP S5_VTQD_EVCU2MaxTorqAvail_pct_Inproc "SWC_OUTP_type/run_SWC_OUTP_5ms_sys/OUTP/outpmodule/VTQD_EVCU2MaxTorqAvail_pct_Inproc" /begin SUB_GROUP S801_Signal_Limit S801_Signal_Override /end SUB_GROUP /end GROUP
/begin GROUP S5_VTQD_EVCU2MinTorqAvail_pct_Inproc "SWC_OUTP_type/run_SWC_OUTP_5ms_sys/OUTP/outpmodule/VTQD_EVCU2MinTorqAvail_pct_Inproc" /begin SUB_GROUP S802_Signal_Limit S802_Signal_Override /end SUB_GROUP /end GROUP
/begin GROUP S5_VTQD_GearFlashIndDis_flg_Inproc "SWC_OUTP_type/run_SWC_OUTP_5ms_sys/OUTP/outpmodule/VTQD_GearFlashIndDis_flg_Inproc" /begin SUB_GROUP S803_Signal_Limit S803_Signal_Override /end SUB_GROUP /end GROUP
/begin GROUP S5_VTQD_GearFlashInd_flg_Inproc "SWC_OUTP_type/run_SWC_OUTP_5ms_sys/OUTP/outpmodule/VTQD_GearFlashInd_flg_Inproc" /begin SUB_GROUP S804_Signal_Limit S804_Signal_Override /end SUB_GROUP /end GROUP
/begin GROUP S5_VTQD_ParkingProtectWarning_flg_Inproc "SWC_OUTP_type/run_SWC_OUTP_5ms_sys/OUTP/outpmodule/VTQD_ParkingProtectWarning_flg_Inproc" /begin SUB_GROUP S805_Signal_Limit S805_Signal_Override /end SUB_GROUP /end GROUP
/begin GROUP S5_VTQD_RC1MaxRetSpdP2_rpm_Inproc "SWC_OUTP_type/run_SWC_OUTP_5ms_sys/OUTP/outpmodule/VTQD_RC1MaxRetSpdP2_rpm_Inproc" /begin SUB_GROUP S806_Signal_Limit S806_Signal_Override /end SUB_GROUP /end GROUP
/begin GROUP S5_VTQD_RC1MaxRetSpdP3_rpm_Inproc "SWC_OUTP_type/run_SWC_OUTP_5ms_sys/OUTP/outpmodule/VTQD_RC1MaxRetSpdP3_rpm_Inproc" /begin SUB_GROUP S807_Signal_Limit S807_Signal_Override /end SUB_GROUP /end GROUP
/begin GROUP S5_VTQD_RC1PctTrqIdleP1_pct_Inproc "SWC_OUTP_type/run_SWC_OUTP_5ms_sys/OUTP/outpmodule/VTQD_RC1PctTrqIdleP1_pct_Inproc" /begin SUB_GROUP S808_Signal_Limit S808_Signal_Override /end SUB_GROUP /end GROUP
/begin GROUP S5_VTQD_RC1PctTrqP3_pct_Inproc "SWC_OUTP_type/run_SWC_OUTP_5ms_sys/OUTP/outpmodule/VTQD_RC1PctTrqP3_pct_Inproc" /begin SUB_GROUP S809_Signal_Limit S809_Signal_Override /end SUB_GROUP /end GROUP
/begin GROUP S5_VTQD_RC1PctTrqP4_pct_Inproc "SWC_OUTP_type/run_SWC_OUTP_5ms_sys/OUTP/outpmodule/VTQD_RC1PctTrqP4_pct_Inproc" /begin SUB_GROUP S810_Signal_Limit S810_Signal_Override /end SUB_GROUP /end GROUP
/begin GROUP S5_VTQD_RC1PctTrqPekTrqP5_pct_Inproc "SWC_OUTP_type/run_SWC_OUTP_5ms_sys/OUTP/outpmodule/VTQD_RC1PctTrqPekTrqP5_pct_Inproc" /begin SUB_GROUP S811_Signal_Limit S811_Signal_Override /end SUB_GROUP /end GROUP
/begin GROUP S5_VTQD_RC1RefRetTrq_Nm_Inproc "SWC_OUTP_type/run_SWC_OUTP_5ms_sys/OUTP/outpmodule/VTQD_RC1RefRetTrq_Nm_Inproc" /begin SUB_GROUP S812_Signal_Limit S812_Signal_Override /end SUB_GROUP /end GROUP
/begin GROUP S5_VTQD_RC1RetCtrlMth_enum_Inproc "SWC_OUTP_type/run_SWC_OUTP_5ms_sys/OUTP/outpmodule/VTQD_RC1RetCtrlMth_enum_Inproc" /begin SUB_GROUP S813_Signal_Limit S813_Signal_Override /end SUB_GROUP /end GROUP
/begin GROUP S5_VTQD_RC1RetLocat_enum_Inproc "SWC_OUTP_type/run_SWC_OUTP_5ms_sys/OUTP/outpmodule/VTQD_RC1RetLocat_enum_Inproc" /begin SUB_GROUP S814_Signal_Limit S814_Signal_Override /end SUB_GROUP /end GROUP
/begin GROUP S5_VTQD_RC1RetSpdIdleP1_rpm_Inproc "SWC_OUTP_type/run_SWC_OUTP_5ms_sys/OUTP/outpmodule/VTQD_RC1RetSpdIdleP1_rpm_Inproc" /begin SUB_GROUP S815_Signal_Limit S815_Signal_Override /end SUB_GROUP /end GROUP
/begin GROUP S5_VTQD_RC1RetSpdP2_pct_Inproc "SWC_OUTP_type/run_SWC_OUTP_5ms_sys/OUTP/outpmodule/VTQD_RC1RetSpdP2_pct_Inproc" /begin SUB_GROUP S816_Signal_Limit S816_Signal_Override /end SUB_GROUP /end GROUP
/begin GROUP S5_VTQD_RC1RetSpdP4_rpm_Inproc "SWC_OUTP_type/run_SWC_OUTP_5ms_sys/OUTP/outpmodule/VTQD_RC1RetSpdP4_rpm_Inproc" /begin SUB_GROUP S817_Signal_Limit S817_Signal_Override /end SUB_GROUP /end GROUP
/begin GROUP S5_VTQD_RC1RetSpdPekTrqP5_Nm_Inproc "SWC_OUTP_type/run_SWC_OUTP_5ms_sys/OUTP/outpmodule/VTQD_RC1RetSpdPekTrqP5_Nm_Inproc" /begin SUB_GROUP S818_Signal_Limit S818_Signal_Override /end SUB_GROUP /end GROUP
/begin GROUP S5_VTQD_RC1RetType_enum_Inproc "SWC_OUTP_type/run_SWC_OUTP_5ms_sys/OUTP/outpmodule/VTQD_RC1RetType_enum_Inproc" /begin SUB_GROUP S819_Signal_Limit S819_Signal_Override /end SUB_GROUP /end GROUP
/begin GROUP S5_VTQD_SpdLimSta_flg_Inproc "SWC_OUTP_type/run_SWC_OUTP_5ms_sys/OUTP/outpmodule/VTQD_SpdLimSta_flg_Inproc" /begin SUB_GROUP S820_Signal_Limit S820_Signal_Override /end SUB_GROUP /end GROUP
/begin GROUP S5_VTQD_TMTqReq_Nm_Inproc "SWC_OUTP_type/run_SWC_OUTP_5ms_sys/OUTP/outpmodule/VTQD_TMTqReq_Nm_Inproc" /begin SUB_GROUP S821_Signal_Limit S821_Signal_Override /end SUB_GROUP /end GROUP
/begin GROUP S5_VTQD_TUpAIND_enum_Inproc "SWC_OUTP_type/run_SWC_OUTP_5ms_sys/OUTP/outpmodule/VTQD_TUpAIND_enum_Inproc" /begin SUB_GROUP S822_Signal_Limit S822_Signal_Override /end SUB_GROUP /end GROUP
/begin GROUP S5_VTQD_VCU4PweLmtInd_flg_Inproc "SWC_OUTP_type/run_SWC_OUTP_5ms_sys/OUTP/outpmodule/VTQD_VCU4PweLmtInd_flg_Inproc" /begin SUB_GROUP S823_Signal_Limit S823_Signal_Override /end SUB_GROUP /end GROUP
/begin GROUP S5_VTQD_VCUBCMBuzzReq_flg_Inproc "SWC_OUTP_type/run_SWC_OUTP_5ms_sys/OUTP/outpmodule/VTQD_VCUBCMBuzzReq_flg_Inproc" /begin SUB_GROUP S824_Signal_Limit S824_Signal_Override /end SUB_GROUP /end GROUP
/begin GROUP S5_VTQD_VCUEBSHBSw_enum_Inproc "SWC_OUTP_type/run_SWC_OUTP_5ms_sys/OUTP/outpmodule/VTQD_VCUEBSHBSw_enum_Inproc" /begin SUB_GROUP S825_Signal_Limit S825_Signal_Override /end SUB_GROUP /end GROUP
/begin GROUP S5_VTQD_VCUEBSHHSw_enum_Inproc "SWC_OUTP_type/run_SWC_OUTP_5ms_sys/OUTP/outpmodule/VTQD_VCUEBSHHSw_enum_Inproc" /begin SUB_GROUP S826_Signal_Limit S826_Signal_Override /end SUB_GROUP /end GROUP
/begin GROUP S5_VTQD_VCUEBSRd4BR_enum_Inproc "SWC_OUTP_type/run_SWC_OUTP_5ms_sys/OUTP/outpmodule/VTQD_VCUEBSRd4BR_enum_Inproc" /begin SUB_GROUP S827_Signal_Limit S827_Signal_Override /end SUB_GROUP /end GROUP
/begin GROUP S5_VTQD_VCUMCUCtrlMdTQD_enum_Inproc "SWC_OUTP_type/run_SWC_OUTP_5ms_sys/OUTP/outpmodule/VTQD_VCUMCUCtrlMdTQD_enum_Inproc" /begin SUB_GROUP S828_Signal_Limit S828_Signal_Override /end SUB_GROUP /end GROUP
/begin GROUP S5_VTQD_VCUMCUDemHiPosVal_rpm_Inproc "SWC_OUTP_type/run_SWC_OUTP_5ms_sys/OUTP/outpmodule/VTQD_VCUMCUDemHiPosVal_rpm_Inproc" /begin SUB_GROUP S829_Signal_Limit S829_Signal_Override /end SUB_GROUP /end GROUP
/begin GROUP S5_VTQD_VCUMCUDemLoNegVal_rpm_Inproc "SWC_OUTP_type/run_SWC_OUTP_5ms_sys/OUTP/outpmodule/VTQD_VCUMCUDemLoNegVal_rpm_Inproc" /begin SUB_GROUP S830_Signal_Limit S830_Signal_Override /end SUB_GROUP /end GROUP
/begin GROUP S5_VTQD_VCUMCUDemSpd_rpm_Inproc "SWC_OUTP_type/run_SWC_OUTP_5ms_sys/OUTP/outpmodule/VTQD_VCUMCUDemSpd_rpm_Inproc" /begin SUB_GROUP S831_Signal_Limit S831_Signal_Override /end SUB_GROUP /end GROUP
/begin GROUP S5_VTQD_VCUMCUFootBrk_flg_Inproc "SWC_OUTP_type/run_SWC_OUTP_5ms_sys/OUTP/outpmodule/VTQD_VCUMCUFootBrk_flg_Inproc" /begin SUB_GROUP S832_Signal_Limit S832_Signal_Override /end SUB_GROUP /end GROUP
/begin GROUP S5_VTQD_VCUMCUGearSta_enum_Inproc "SWC_OUTP_type/run_SWC_OUTP_5ms_sys/OUTP/outpmodule/VTQD_VCUMCUGearSta_enum_Inproc" /begin SUB_GROUP S833_Signal_Limit S833_Signal_Override /end SUB_GROUP /end GROUP
/begin GROUP S5_VTQD_VCUMCUHandBrk_flg_Inproc "SWC_OUTP_type/run_SWC_OUTP_5ms_sys/OUTP/outpmodule/VTQD_VCUMCUHandBrk_flg_Inproc" /begin SUB_GROUP S834_Signal_Limit S834_Signal_Override /end SUB_GROUP /end GROUP
/begin GROUP S5_VTQD_VCUTMVehSpd_kph_Inproc "SWC_OUTP_type/run_SWC_OUTP_5ms_sys/OUTP/outpmodule/VTQD_VCUTMVehSpd_kph_Inproc" /begin SUB_GROUP S835_Signal_Limit S835_Signal_Override /end SUB_GROUP /end GROUP
/begin GROUP S5_VTQD_VehAcclLimitTG_mps2_Inproc "SWC_OUTP_type/run_SWC_OUTP_5ms_sys/OUTP/outpmodule/VTQD_VehAcclLimitTG_mps2_Inproc" /begin SUB_GROUP S836_Signal_Limit S836_Signal_Override /end SUB_GROUP /end GROUP
/begin GROUP S5_VTQD_VehSpdLimitTG_kph_Inproc "SWC_OUTP_type/run_SWC_OUTP_5ms_sys/OUTP/outpmodule/VTQD_VehSpdLimitTG_kph_Inproc" /begin SUB_GROUP S837_Signal_Limit S837_Signal_Override /end SUB_GROUP /end GROUP
/begin GROUP S5_VTQR_FrTMTqReq_Nm_Inproc "SWC_OUTP_type/run_SWC_OUTP_5ms_sys/OUTP/outpmodule/VTQR_FrTMTqReq_Nm_Inproc" /begin SUB_GROUP S838_Signal_Limit S838_Signal_Override /end SUB_GROUP /end GROUP
/begin GROUP S5_VTQR_RrTMTqReq_Nm_Inproc "SWC_OUTP_type/run_SWC_OUTP_5ms_sys/OUTP/outpmodule/VTQR_RrTMTqReq_Nm_Inproc" /begin SUB_GROUP S839_Signal_Limit S839_Signal_Override /end SUB_GROUP /end GROUP
/begin GROUP S5_VV2L_HVPO120VGrpALDSt_enum_Inproc "SWC_OUTP_type/run_SWC_OUTP_5ms_sys/OUTP/outpmodule/VV2L_HVPO120VGrpALDSt_enum_Inproc" /begin SUB_GROUP S840_Signal_Limit S840_Signal_Override /end SUB_GROUP /end GROUP
/begin GROUP S5_VV2L_HVPO120VGrpBLDSt_enum_Inproc "SWC_OUTP_type/run_SWC_OUTP_5ms_sys/OUTP/outpmodule/VV2L_HVPO120VGrpBLDSt_enum_Inproc" /begin SUB_GROUP S841_Signal_Limit S841_Signal_Override /end SUB_GROUP /end GROUP
/begin GROUP S5_VV2L_ReqOBCExtrV2LEna_enum_Inproc "SWC_OUTP_type/run_SWC_OUTP_5ms_sys/OUTP/outpmodule/VV2L_ReqOBCExtrV2LEna_enum_Inproc" /begin SUB_GROUP S842_Signal_Limit S842_Signal_Override /end SUB_GROUP /end GROUP
/begin GROUP S5_VV2L_ReqOBCIntrV2LEna_enum_Inproc "SWC_OUTP_type/run_SWC_OUTP_5ms_sys/OUTP/outpmodule/VV2L_ReqOBCIntrV2LEna_enum_Inproc" /begin SUB_GROUP S843_Signal_Limit S843_Signal_Override /end SUB_GROUP /end GROUP
/begin GROUP S5_VV2L_ReqOBCV2LEna_enum_Inproc "SWC_OUTP_type/run_SWC_OUTP_5ms_sys/OUTP/outpmodule/VV2L_ReqOBCV2LEna_enum_Inproc" /begin SUB_GROUP S844_Signal_Limit S844_Signal_Override /end SUB_GROUP /end GROUP
/begin GROUP S5_VV2L_ReqV2LIVIDisChrg_enum_Inproc "SWC_OUTP_type/run_SWC_OUTP_5ms_sys/OUTP/outpmodule/VV2L_ReqV2LIVIDisChrg_enum_Inproc" /begin SUB_GROUP S845_Signal_Limit S845_Signal_Override /end SUB_GROUP /end GROUP
/begin GROUP S5_VV2L_ReqV2LIVIPopup_enum_Inproc "SWC_OUTP_type/run_SWC_OUTP_5ms_sys/OUTP/outpmodule/VV2L_ReqV2LIVIPopup_enum_Inproc" /begin SUB_GROUP S846_Signal_Limit S846_Signal_Override /end SUB_GROUP /end GROUP
/begin GROUP S5_VVMC_ACCComfortBandLower_mps2_Inproc "SWC_OUTP_type/run_SWC_OUTP_5ms_sys/OUTP/outpmodule/VVMC_ACCComfortBandLower_mps2_Inproc" /begin SUB_GROUP S847_Signal_Limit S847_Signal_Override /end SUB_GROUP /end GROUP
/begin GROUP S5_VVMC_ACCComfortBandUpper_mps2_Inproc "SWC_OUTP_type/run_SWC_OUTP_5ms_sys/OUTP/outpmodule/VVMC_ACCComfortBandUpper_mps2_Inproc" /begin SUB_GROUP S848_Signal_Limit S848_Signal_Override /end SUB_GROUP /end GROUP
/begin GROUP S5_VVMC_ACCCtrlAvail_flg_Inproc "SWC_OUTP_type/run_SWC_OUTP_5ms_sys/OUTP/outpmodule/VVMC_ACCCtrlAvail_flg_Inproc" /begin SUB_GROUP S849_Signal_Limit S849_Signal_Override /end SUB_GROUP /end GROUP
/begin GROUP S5_VVMC_ACCJerkLowerLimit_mps3_Inproc "SWC_OUTP_type/run_SWC_OUTP_5ms_sys/OUTP/outpmodule/VVMC_ACCJerkLowerLimit_mps3_Inproc" /begin SUB_GROUP S850_Signal_Limit S850_Signal_Override /end SUB_GROUP /end GROUP
/begin GROUP S5_VVMC_ACCJerkUpperLimit_mps3_Inproc "SWC_OUTP_type/run_SWC_OUTP_5ms_sys/OUTP/outpmodule/VVMC_ACCJerkUpperLimit_mps3_Inproc" /begin SUB_GROUP S851_Signal_Limit S851_Signal_Override /end SUB_GROUP /end GROUP
/begin GROUP S5_VVMC_ACCObjDist_m_Inproc "SWC_OUTP_type/run_SWC_OUTP_5ms_sys/OUTP/outpmodule/VVMC_ACCObjDist_m_Inproc" /begin SUB_GROUP S852_Signal_Limit S852_Signal_Override /end SUB_GROUP /end GROUP
/begin GROUP S5_VVMC_ACCObjDstLvl_enum_Inproc "SWC_OUTP_type/run_SWC_OUTP_5ms_sys/OUTP/outpmodule/VVMC_ACCObjDstLvl_enum_Inproc" /begin SUB_GROUP S853_Signal_Limit S853_Signal_Override /end SUB_GROUP /end GROUP
/begin GROUP S5_VVMC_ACCObjRelSpd_mps_Inproc "SWC_OUTP_type/run_SWC_OUTP_5ms_sys/OUTP/outpmodule/VVMC_ACCObjRelSpd_mps_Inproc" /begin SUB_GROUP S854_Signal_Limit S854_Signal_Override /end SUB_GROUP /end GROUP
/begin GROUP S5_VVMC_ACCPedalOvrd_flg_Inproc "SWC_OUTP_type/run_SWC_OUTP_5ms_sys/OUTP/outpmodule/VVMC_ACCPedalOvrd_flg_Inproc" /begin SUB_GROUP S855_Signal_Limit S855_Signal_Override /end SUB_GROUP /end GROUP
/begin GROUP S5_VVMC_ACCRequiredAccel_mps2_Inproc "SWC_OUTP_type/run_SWC_OUTP_5ms_sys/OUTP/outpmodule/VVMC_ACCRequiredAccel_mps2_Inproc" /begin SUB_GROUP S856_Signal_Limit S856_Signal_Override /end SUB_GROUP /end GROUP
/begin GROUP S5_VVMC_ACCTakeoverReq_flg_Inproc "SWC_OUTP_type/run_SWC_OUTP_5ms_sys/OUTP/outpmodule/VVMC_ACCTakeoverReq_flg_Inproc" /begin SUB_GROUP S857_Signal_Limit S857_Signal_Override /end SUB_GROUP /end GROUP
/begin GROUP S5_VVMC_ACCVehHoldReq_flg_Inproc "SWC_OUTP_type/run_SWC_OUTP_5ms_sys/OUTP/outpmodule/VVMC_ACCVehHoldReq_flg_Inproc" /begin SUB_GROUP S858_Signal_Limit S858_Signal_Override /end SUB_GROUP /end GROUP
/begin GROUP S5_VVMC_ADASACCSta_enum_Inproc "SWC_OUTP_type/run_SWC_OUTP_5ms_sys/OUTP/outpmodule/VVMC_ADASACCSta_enum_Inproc" /begin SUB_GROUP S859_Signal_Limit S859_Signal_Override /end SUB_GROUP /end GROUP
/begin GROUP S5_VVMC_ADASAEBReq_enum_Inproc "SWC_OUTP_type/run_SWC_OUTP_5ms_sys/OUTP/outpmodule/VVMC_ADASAEBReq_enum_Inproc" /begin SUB_GROUP S860_Signal_Limit S860_Signal_Override /end SUB_GROUP /end GROUP
/begin GROUP S5_VVMC_ADASAEBSta_enum_Inproc "SWC_OUTP_type/run_SWC_OUTP_5ms_sys/OUTP/outpmodule/VVMC_ADASAEBSta_enum_Inproc" /begin SUB_GROUP S861_Signal_Limit S861_Signal_Override /end SUB_GROUP /end GROUP
/begin GROUP S5_VVMC_ADASCAMSpdLim_enum_Inproc "SWC_OUTP_type/run_SWC_OUTP_5ms_sys/OUTP/outpmodule/VVMC_ADASCAMSpdLim_enum_Inproc" /begin SUB_GROUP S862_Signal_Limit S862_Signal_Override /end SUB_GROUP /end GROUP
/begin GROUP S5_VVMC_ADASDBSReq_enum_Inproc "SWC_OUTP_type/run_SWC_OUTP_5ms_sys/OUTP/outpmodule/VVMC_ADASDBSReq_enum_Inproc" /begin SUB_GROUP S863_Signal_Limit S863_Signal_Override /end SUB_GROUP /end GROUP
/begin GROUP S5_VVMC_ADASFCWMute_flg_Inproc "SWC_OUTP_type/run_SWC_OUTP_5ms_sys/OUTP/outpmodule/VVMC_ADASFCWMute_flg_Inproc" /begin SUB_GROUP S864_Signal_Limit S864_Signal_Override /end SUB_GROUP /end GROUP
/begin GROUP S5_VVMC_ADASFCWSta_enum_Inproc "SWC_OUTP_type/run_SWC_OUTP_5ms_sys/OUTP/outpmodule/VVMC_ADASFCWSta_enum_Inproc" /begin SUB_GROUP S865_Signal_Limit S865_Signal_Override /end SUB_GROUP /end GROUP
/begin GROUP S5_VVMC_ADASFaultSta_flg_Inproc "SWC_OUTP_type/run_SWC_OUTP_5ms_sys/OUTP/outpmodule/VVMC_ADASFaultSta_flg_Inproc" /begin SUB_GROUP S866_Signal_Limit S866_Signal_Override /end SUB_GROUP /end GROUP
/begin GROUP S5_VVMC_ADASFltWrnReq_flg_Inproc "SWC_OUTP_type/run_SWC_OUTP_5ms_sys/OUTP/outpmodule/VVMC_ADASFltWrnReq_flg_Inproc" /begin SUB_GROUP S867_Signal_Limit S867_Signal_Override /end SUB_GROUP /end GROUP
/begin GROUP S5_VVMC_ADASForceIdle_flg_Inproc "SWC_OUTP_type/run_SWC_OUTP_5ms_sys/OUTP/outpmodule/VVMC_ADASForceIdle_flg_Inproc" /begin SUB_GROUP S868_Signal_Limit S868_Signal_Override /end SUB_GROUP /end GROUP
/begin GROUP S5_VVMC_ADASISASta_enum_Inproc "SWC_OUTP_type/run_SWC_OUTP_5ms_sys/OUTP/outpmodule/VVMC_ADASISASta_enum_Inproc" /begin SUB_GROUP S869_Signal_Limit S869_Signal_Override /end SUB_GROUP /end GROUP
/begin GROUP S5_VVMC_ADASLDWMute_flg_Inproc "SWC_OUTP_type/run_SWC_OUTP_5ms_sys/OUTP/outpmodule/VVMC_ADASLDWMute_flg_Inproc" /begin SUB_GROUP S870_Signal_Limit S870_Signal_Override /end SUB_GROUP /end GROUP
/begin GROUP S5_VVMC_ADASLDWSta_enum_Inproc "SWC_OUTP_type/run_SWC_OUTP_5ms_sys/OUTP/outpmodule/VVMC_ADASLDWSta_enum_Inproc" /begin SUB_GROUP S871_Signal_Limit S871_Signal_Override /end SUB_GROUP /end GROUP
/begin GROUP S5_VVMC_ADASLFCHandsOffWarning_enum_Inproc "SWC_OUTP_type/run_SWC_OUTP_5ms_sys/OUTP/outpmodule/VVMC_ADASLFCHandsOffWarning_enum_Inproc" /begin SUB_GROUP S872_Signal_Limit S872_Signal_Override /end SUB_GROUP /end GROUP
/begin GROUP S5_VVMC_ADASLFCSta_enum_Inproc "SWC_OUTP_type/run_SWC_OUTP_5ms_sys/OUTP/outpmodule/VVMC_ADASLFCSta_enum_Inproc" /begin SUB_GROUP S873_Signal_Limit S873_Signal_Override /end SUB_GROUP /end GROUP
/begin GROUP S5_VVMC_ADASLFCWarnSound_enum_Inproc "SWC_OUTP_type/run_SWC_OUTP_5ms_sys/OUTP/outpmodule/VVMC_ADASLFCWarnSound_enum_Inproc" /begin SUB_GROUP S874_Signal_Limit S874_Signal_Override /end SUB_GROUP /end GROUP
/begin GROUP S5_VVMC_ADASLKASta_enum_Inproc "SWC_OUTP_type/run_SWC_OUTP_5ms_sys/OUTP/outpmodule/VVMC_ADASLKASta_enum_Inproc" /begin SUB_GROUP S875_Signal_Limit S875_Signal_Override /end SUB_GROUP /end GROUP
/begin GROUP S5_VVMC_ADASLaneModeL_enum_Inproc "SWC_OUTP_type/run_SWC_OUTP_5ms_sys/OUTP/outpmodule/VVMC_ADASLaneModeL_enum_Inproc" /begin SUB_GROUP S876_Signal_Limit S876_Signal_Override /end SUB_GROUP /end GROUP
/begin GROUP S5_VVMC_ADASLaneModeR_enum_Inproc "SWC_OUTP_type/run_SWC_OUTP_5ms_sys/OUTP/outpmodule/VVMC_ADASLaneModeR_enum_Inproc" /begin SUB_GROUP S877_Signal_Limit S877_Signal_Override /end SUB_GROUP /end GROUP
/begin GROUP S5_VVMC_ADASLanecurveL_raw32_Inproc "SWC_OUTP_type/run_SWC_OUTP_5ms_sys/OUTP/outpmodule/VVMC_ADASLanecurveL_raw32_Inproc" /begin SUB_GROUP S878_Signal_Limit S878_Signal_Override /end SUB_GROUP /end GROUP
/begin GROUP S5_VVMC_ADASLanecurveR_raw32_Inproc "SWC_OUTP_type/run_SWC_OUTP_5ms_sys/OUTP/outpmodule/VVMC_ADASLanecurveR_raw32_Inproc" /begin SUB_GROUP S879_Signal_Limit S879_Signal_Override /end SUB_GROUP /end GROUP
/begin GROUP S5_VVMC_ADASLanetypeL_enum_Inproc "SWC_OUTP_type/run_SWC_OUTP_5ms_sys/OUTP/outpmodule/VVMC_ADASLanetypeL_enum_Inproc" /begin SUB_GROUP S880_Signal_Limit S880_Signal_Override /end SUB_GROUP /end GROUP
/begin GROUP S5_VVMC_ADASLanetypeR_enum_Inproc "SWC_OUTP_type/run_SWC_OUTP_5ms_sys/OUTP/outpmodule/VVMC_ADASLanetypeR_enum_Inproc" /begin SUB_GROUP S881_Signal_Limit S881_Signal_Override /end SUB_GROUP /end GROUP
/begin GROUP S5_VVMC_ADASSLIFSpdLim_enum_Inproc "SWC_OUTP_type/run_SWC_OUTP_5ms_sys/OUTP/outpmodule/VVMC_ADASSLIFSpdLim_enum_Inproc" /begin SUB_GROUP S882_Signal_Limit S882_Signal_Override /end SUB_GROUP /end GROUP
/begin GROUP S5_VVMC_ADASSLIFSta_enum_Inproc "SWC_OUTP_type/run_SWC_OUTP_5ms_sys/OUTP/outpmodule/VVMC_ADASSLIFSta_enum_Inproc" /begin SUB_GROUP S883_Signal_Limit S883_Signal_Override /end SUB_GROUP /end GROUP
/begin GROUP S5_VVMC_ADASShftPosnReqA_flg_Inproc "SWC_OUTP_type/run_SWC_OUTP_5ms_sys/OUTP/outpmodule/VVMC_ADASShftPosnReqA_flg_Inproc" /begin SUB_GROUP S884_Signal_Limit S884_Signal_Override /end SUB_GROUP /end GROUP
/begin GROUP S5_VVMC_ADASShftPosnReq_enum_Inproc "SWC_OUTP_type/run_SWC_OUTP_5ms_sys/OUTP/outpmodule/VVMC_ADASShftPosnReq_enum_Inproc" /begin SUB_GROUP S885_Signal_Limit S885_Signal_Override /end SUB_GROUP /end GROUP
/begin GROUP S5_VVMC_ADASVehSpdLim_raw32_Inproc "SWC_OUTP_type/run_SWC_OUTP_5ms_sys/OUTP/outpmodule/VVMC_ADASVehSpdLim_raw32_Inproc" /begin SUB_GROUP S886_Signal_Limit S886_Signal_Override /end SUB_GROUP /end GROUP
/begin GROUP S5_VVMC_ADASWarningMsg_enum_Inproc "SWC_OUTP_type/run_SWC_OUTP_5ms_sys/OUTP/outpmodule/VVMC_ADASWarningMsg_enum_Inproc" /begin SUB_GROUP S887_Signal_Limit S887_Signal_Override /end SUB_GROUP /end GROUP
/begin GROUP S5_VVMC_AEBVehHoldReq_flg_Inproc "SWC_OUTP_type/run_SWC_OUTP_5ms_sys/OUTP/outpmodule/VVMC_AEBVehHoldReq_flg_Inproc" /begin SUB_GROUP S888_Signal_Limit S888_Signal_Override /end SUB_GROUP /end GROUP
/begin GROUP S5_VVMC_APSActive_flg_Inproc "SWC_OUTP_type/run_SWC_OUTP_5ms_sys/OUTP/outpmodule/VVMC_APSActive_flg_Inproc" /begin SUB_GROUP S889_Signal_Limit S889_Signal_Override /end SUB_GROUP /end GROUP
/begin GROUP S5_VVMC_APSCtrlAvail_flg_Inproc "SWC_OUTP_type/run_SWC_OUTP_5ms_sys/OUTP/outpmodule/VVMC_APSCtrlAvail_flg_Inproc" /begin SUB_GROUP S890_Signal_Limit S890_Signal_Override /end SUB_GROUP /end GROUP
/begin GROUP S5_VVMC_APSDecReqA_flg_Inproc "SWC_OUTP_type/run_SWC_OUTP_5ms_sys/OUTP/outpmodule/VVMC_APSDecReqA_flg_Inproc" /begin SUB_GROUP S891_Signal_Limit S891_Signal_Override /end SUB_GROUP /end GROUP
/begin GROUP S5_VVMC_APSDecReq_mps2_Inproc "SWC_OUTP_type/run_SWC_OUTP_5ms_sys/OUTP/outpmodule/VVMC_APSDecReq_mps2_Inproc" /begin SUB_GROUP S892_Signal_Limit S892_Signal_Override /end SUB_GROUP /end GROUP
/begin GROUP S5_VVMC_APSReq_enum_Inproc "SWC_OUTP_type/run_SWC_OUTP_5ms_sys/OUTP/outpmodule/VVMC_APSReq_enum_Inproc" /begin SUB_GROUP S893_Signal_Limit S893_Signal_Override /end SUB_GROUP /end GROUP
/begin GROUP S5_VVMC_APSStaSys_enum_Inproc "SWC_OUTP_type/run_SWC_OUTP_5ms_sys/OUTP/outpmodule/VVMC_APSStaSys_enum_Inproc" /begin SUB_GROUP S894_Signal_Limit S894_Signal_Override /end SUB_GROUP /end GROUP
/begin GROUP S5_VVMC_AccCalcuPID_mps2_Inproc "SWC_OUTP_type/run_SWC_OUTP_5ms_sys/OUTP/outpmodule/VVMC_AccCalcuPID_mps2_Inproc" /begin SUB_GROUP S895_Signal_Limit S895_Signal_Override /end SUB_GROUP /end GROUP
/begin GROUP S5_VVMC_ActACCRequiredAccel_mps2_Inproc "SWC_OUTP_type/run_SWC_OUTP_5ms_sys/OUTP/outpmodule/VVMC_ActACCRequiredAccel_mps2_Inproc" /begin SUB_GROUP S896_Signal_Limit S896_Signal_Override /end SUB_GROUP /end GROUP
/begin GROUP S5_VVMC_CAASActive_flg_Inproc "SWC_OUTP_type/run_SWC_OUTP_5ms_sys/OUTP/outpmodule/VVMC_CAASActive_flg_Inproc" /begin SUB_GROUP S897_Signal_Limit S897_Signal_Override /end SUB_GROUP /end GROUP
/begin GROUP S5_VVMC_CAASCtrlAvail_flg_Inproc "SWC_OUTP_type/run_SWC_OUTP_5ms_sys/OUTP/outpmodule/VVMC_CAASCtrlAvail_flg_Inproc" /begin SUB_GROUP S898_Signal_Limit S898_Signal_Override /end SUB_GROUP /end GROUP
/begin GROUP S5_VVMC_CCCtrlSta_enum_Inproc "SWC_OUTP_type/run_SWC_OUTP_5ms_sys/OUTP/outpmodule/VVMC_CCCtrlSta_enum_Inproc" /begin SUB_GROUP S899_Signal_Limit S899_Signal_Override /end SUB_GROUP /end GROUP
/begin GROUP S5_VVMC_CCMSASpdWar_flg_Inproc "SWC_OUTP_type/run_SWC_OUTP_5ms_sys/OUTP/outpmodule/VVMC_CCMSASpdWar_flg_Inproc" /begin SUB_GROUP S900_Signal_Limit S900_Signal_Override /end SUB_GROUP /end GROUP
/begin GROUP S5_VVMC_CalibratedAccX_G_Inproc "SWC_OUTP_type/run_SWC_OUTP_5ms_sys/OUTP/outpmodule/VVMC_CalibratedAccX_G_Inproc" /begin SUB_GROUP S901_Signal_Limit S901_Signal_Override /end SUB_GROUP /end GROUP
/begin GROUP S5_VVMC_CalibratedAccY_G_Inproc "SWC_OUTP_type/run_SWC_OUTP_5ms_sys/OUTP/outpmodule/VVMC_CalibratedAccY_G_Inproc" /begin SUB_GROUP S902_Signal_Limit S902_Signal_Override /end SUB_GROUP /end GROUP
/begin GROUP S5_VVMC_CalibratedAccZ_G_Inproc "SWC_OUTP_type/run_SWC_OUTP_5ms_sys/OUTP/outpmodule/VVMC_CalibratedAccZ_G_Inproc" /begin SUB_GROUP S903_Signal_Limit S903_Signal_Override /end SUB_GROUP /end GROUP
/begin GROUP S5_VVMC_CalibratedGyroX_Dps_Inproc "SWC_OUTP_type/run_SWC_OUTP_5ms_sys/OUTP/outpmodule/VVMC_CalibratedGyroX_Dps_Inproc" /begin SUB_GROUP S904_Signal_Limit S904_Signal_Override /end SUB_GROUP /end GROUP
/begin GROUP S5_VVMC_CalibratedGyroY_Dps_Inproc "SWC_OUTP_type/run_SWC_OUTP_5ms_sys/OUTP/outpmodule/VVMC_CalibratedGyroY_Dps_Inproc" /begin SUB_GROUP S905_Signal_Limit S905_Signal_Override /end SUB_GROUP /end GROUP
/begin GROUP S5_VVMC_CalibratedGyroZ_Dps_Inproc "SWC_OUTP_type/run_SWC_OUTP_5ms_sys/OUTP/outpmodule/VVMC_CalibratedGyroZ_Dps_Inproc" /begin SUB_GROUP S906_Signal_Limit S906_Signal_Override /end SUB_GROUP /end GROUP
/begin GROUP S5_VVMC_DISCReqAcc_mps2_Inproc "SWC_OUTP_type/run_SWC_OUTP_5ms_sys/OUTP/outpmodule/VVMC_DISCReqAcc_mps2_Inproc" /begin SUB_GROUP S907_Signal_Limit S907_Signal_Override /end SUB_GROUP /end GROUP
/begin GROUP S5_VVMC_ExtraMSACtrlSta_enum_Inproc "SWC_OUTP_type/run_SWC_OUTP_5ms_sys/OUTP/outpmodule/VVMC_ExtraMSACtrlSta_enum_Inproc" /begin SUB_GROUP S908_Signal_Limit S908_Signal_Override /end SUB_GROUP /end GROUP
/begin GROUP S5_VVMC_FCMACCmode_enum_Inproc "SWC_OUTP_type/run_SWC_OUTP_5ms_sys/OUTP/outpmodule/VVMC_FCMACCmode_enum_Inproc" /begin SUB_GROUP S909_Signal_Limit S909_Signal_Override /end SUB_GROUP /end GROUP
/begin GROUP S5_VVMC_FCMLDWFault_flg_Inproc "SWC_OUTP_type/run_SWC_OUTP_5ms_sys/OUTP/outpmodule/VVMC_FCMLDWFault_flg_Inproc" /begin SUB_GROUP S910_Signal_Limit S910_Signal_Override /end SUB_GROUP /end GROUP
/begin GROUP S5_VVMC_FCMLDWRequest_enum_Inproc "SWC_OUTP_type/run_SWC_OUTP_5ms_sys/OUTP/outpmodule/VVMC_FCMLDWRequest_enum_Inproc" /begin SUB_GROUP S911_Signal_Limit S911_Signal_Override /end SUB_GROUP /end GROUP
/begin GROUP S5_VVMC_FDCVMCAPSAngleTarget_deg_Inproc "SWC_OUTP_type/run_SWC_OUTP_5ms_sys/OUTP/outpmodule/VVMC_FDCVMCAPSAngleTarget_deg_Inproc" /begin SUB_GROUP S912_Signal_Limit S912_Signal_Override /end SUB_GROUP /end GROUP
/begin GROUP S5_VVMC_FDCVMCAPSRqEPSCtrl_flg_Inproc "SWC_OUTP_type/run_SWC_OUTP_5ms_sys/OUTP/outpmodule/VVMC_FDCVMCAPSRqEPSCtrl_flg_Inproc" /begin SUB_GROUP S913_Signal_Limit S913_Signal_Override /end SUB_GROUP /end GROUP
/begin GROUP S5_VVMC_FDCVMCAPSVRqEPSCtrl_flg_Inproc "SWC_OUTP_type/run_SWC_OUTP_5ms_sys/OUTP/outpmodule/VVMC_FDCVMCAPSVRqEPSCtrl_flg_Inproc" /begin SUB_GROUP S914_Signal_Limit S914_Signal_Override /end SUB_GROUP /end GROUP
/begin GROUP S5_VVMC_FDCVMCAngCtrlTqWtGn_pct_Inproc "SWC_OUTP_type/run_SWC_OUTP_5ms_sys/OUTP/outpmodule/VVMC_FDCVMCAngCtrlTqWtGn_pct_Inproc" /begin SUB_GROUP S915_Signal_Limit S915_Signal_Override /end SUB_GROUP /end GROUP
/begin GROUP S5_VVMC_FDCVMCDrInpTqBstAct_flg_Inproc "SWC_OUTP_type/run_SWC_OUTP_5ms_sys/OUTP/outpmodule/VVMC_FDCVMCDrInpTqBstAct_flg_Inproc" /begin SUB_GROUP S916_Signal_Limit S916_Signal_Override /end SUB_GROUP /end GROUP
/begin GROUP S5_VVMC_FDCVMCDrInpTqBstGn_pct_Inproc "SWC_OUTP_type/run_SWC_OUTP_5ms_sys/OUTP/outpmodule/VVMC_FDCVMCDrInpTqBstGn_pct_Inproc" /begin SUB_GROUP S917_Signal_Limit S917_Signal_Override /end SUB_GROUP /end GROUP
/begin GROUP S5_VVMC_FDCVMCMaxAngCtrlOutTqLim_Nm_Inproc "SWC_OUTP_type/run_SWC_OUTP_5ms_sys/OUTP/outpmodule/VVMC_FDCVMCMaxAngCtrlOutTqLim_Nm_Inproc" /begin SUB_GROUP S918_Signal_Limit S918_Signal_Override /end SUB_GROUP /end GROUP
/begin GROUP S5_VVMC_FeatArbitrFinal_enum_Inproc "SWC_OUTP_type/run_SWC_OUTP_5ms_sys/OUTP/outpmodule/VVMC_FeatArbitrFinal_enum_Inproc" /begin SUB_GROUP S919_Signal_Limit S919_Signal_Override /end SUB_GROUP /end GROUP
/begin GROUP S5_VVMC_FeatArbitrSta_enum_Inproc "SWC_OUTP_type/run_SWC_OUTP_5ms_sys/OUTP/outpmodule/VVMC_FeatArbitrSta_enum_Inproc" /begin SUB_GROUP S920_Signal_Limit S920_Signal_Override /end SUB_GROUP /end GROUP
/begin GROUP S5_VVMC_FeatReqSpd_kph_Inproc "SWC_OUTP_type/run_SWC_OUTP_5ms_sys/OUTP/outpmodule/VVMC_FeatReqSpd_kph_Inproc" /begin SUB_GROUP S921_Signal_Limit S921_Signal_Override /end SUB_GROUP /end GROUP
/begin GROUP S5_VVMC_FeatSetSpdFinal_raw32_Inproc "SWC_OUTP_type/run_SWC_OUTP_5ms_sys/OUTP/outpmodule/VVMC_FeatSetSpdFinal_raw32_Inproc" /begin SUB_GROUP S922_Signal_Limit S922_Signal_Override /end SUB_GROUP /end GROUP
/begin GROUP S5_VVMC_ForceLowBeam_enum_Inproc "SWC_OUTP_type/run_SWC_OUTP_5ms_sys/OUTP/outpmodule/VVMC_ForceLowBeam_enum_Inproc" /begin SUB_GROUP S923_Signal_Limit S923_Signal_Override /end SUB_GROUP /end GROUP
/begin GROUP S5_VVMC_FrontRearSlipRatioCtrl_flg_Inproc "SWC_OUTP_type/run_SWC_OUTP_5ms_sys/OUTP/outpmodule/VVMC_FrontRearSlipRatioCtrl_flg_Inproc" /begin SUB_GROUP S924_Signal_Limit S924_Signal_Override /end SUB_GROUP /end GROUP
/begin GROUP S5_VVMC_HazardWarningReq_flg_Inproc "SWC_OUTP_type/run_SWC_OUTP_5ms_sys/OUTP/outpmodule/VVMC_HazardWarningReq_flg_Inproc" /begin SUB_GROUP S925_Signal_Limit S925_Signal_Override /end SUB_GROUP /end GROUP
/begin GROUP S5_VVMC_IMUEnaCmd_flg_Inproc "SWC_OUTP_type/run_SWC_OUTP_5ms_sys/OUTP/outpmodule/VVMC_IMUEnaCmd_flg_Inproc" /begin SUB_GROUP S926_Signal_Limit S926_Signal_Override /end SUB_GROUP /end GROUP
/begin GROUP S5_VVMC_ISOAccLimit_mps2_Inproc "SWC_OUTP_type/run_SWC_OUTP_5ms_sys/OUTP/outpmodule/VVMC_ISOAccLimit_mps2_Inproc" /begin SUB_GROUP S927_Signal_Limit S927_Signal_Override /end SUB_GROUP /end GROUP
/begin GROUP S5_VVMC_ISODecLimit_mps2_Inproc "SWC_OUTP_type/run_SWC_OUTP_5ms_sys/OUTP/outpmodule/VVMC_ISODecLimit_mps2_Inproc" /begin SUB_GROUP S928_Signal_Limit S928_Signal_Override /end SUB_GROUP /end GROUP
/begin GROUP S5_VVMC_ISOJerkLimit_mps3_Inproc "SWC_OUTP_type/run_SWC_OUTP_5ms_sys/OUTP/outpmodule/VVMC_ISOJerkLimit_mps3_Inproc" /begin SUB_GROUP S929_Signal_Limit S929_Signal_Override /end SUB_GROUP /end GROUP
/begin GROUP S5_VVMC_JerkPCT_pct_Inproc "SWC_OUTP_type/run_SWC_OUTP_5ms_sys/OUTP/outpmodule/VVMC_JerkPCT_pct_Inproc" /begin SUB_GROUP S930_Signal_Limit S930_Signal_Override /end SUB_GROUP /end GROUP
/begin GROUP S5_VVMC_LKAHODDisplayWarning_flg_Inproc "SWC_OUTP_type/run_SWC_OUTP_5ms_sys/OUTP/outpmodule/VVMC_LKAHODDisplayWarning_flg_Inproc" /begin SUB_GROUP S931_Signal_Limit S931_Signal_Override /end SUB_GROUP /end GROUP
/begin GROUP S5_VVMC_LKAHODSoundWarning_flg_Inproc "SWC_OUTP_type/run_SWC_OUTP_5ms_sys/OUTP/outpmodule/VVMC_LKAHODSoundWarning_flg_Inproc" /begin SUB_GROUP S932_Signal_Limit S932_Signal_Override /end SUB_GROUP /end GROUP
/begin GROUP S5_VVMC_LKAStrToqReq_Nm_Inproc "SWC_OUTP_type/run_SWC_OUTP_5ms_sys/OUTP/outpmodule/VVMC_LKAStrToqReq_Nm_Inproc" /begin SUB_GROUP S933_Signal_Limit S933_Signal_Override /end SUB_GROUP /end GROUP
/begin GROUP S5_VVMC_LKATOIAct_enum_Inproc "SWC_OUTP_type/run_SWC_OUTP_5ms_sys/OUTP/outpmodule/VVMC_LKATOIAct_enum_Inproc" /begin SUB_GROUP S934_Signal_Limit S934_Signal_Override /end SUB_GROUP /end GROUP
/begin GROUP S5_VVMC_LKATOIFault_flg_Inproc "SWC_OUTP_type/run_SWC_OUTP_5ms_sys/OUTP/outpmodule/VVMC_LKATOIFault_flg_Inproc" /begin SUB_GROUP S935_Signal_Limit S935_Signal_Override /end SUB_GROUP /end GROUP
/begin GROUP S5_VVMC_LVDAACCStatusInformation_flg_Inproc "SWC_OUTP_type/run_SWC_OUTP_5ms_sys/OUTP/outpmodule/VVMC_LVDAACCStatusInformation_flg_Inproc" /begin SUB_GROUP S936_Signal_Limit S936_Signal_Override /end SUB_GROUP /end GROUP
/begin GROUP S5_VVMC_LVDADisabled_flg_Inproc "SWC_OUTP_type/run_SWC_OUTP_5ms_sys/OUTP/outpmodule/VVMC_LVDADisabled_flg_Inproc" /begin SUB_GROUP S937_Signal_Limit S937_Signal_Override /end SUB_GROUP /end GROUP
/begin GROUP S5_VVMC_LVDAFailinfo_flg_Inproc "SWC_OUTP_type/run_SWC_OUTP_5ms_sys/OUTP/outpmodule/VVMC_LVDAFailinfo_flg_Inproc" /begin SUB_GROUP S938_Signal_Limit S938_Signal_Override /end SUB_GROUP /end GROUP
/begin GROUP S5_VVMC_LVDAMuteSta_enum_Inproc "SWC_OUTP_type/run_SWC_OUTP_5ms_sys/OUTP/outpmodule/VVMC_LVDAMuteSta_enum_Inproc" /begin SUB_GROUP S939_Signal_Limit S939_Signal_Override /end SUB_GROUP /end GROUP
/begin GROUP S5_VVMC_LVDAWarning_flg_Inproc "SWC_OUTP_type/run_SWC_OUTP_5ms_sys/OUTP/outpmodule/VVMC_LVDAWarning_flg_Inproc" /begin SUB_GROUP S940_Signal_Limit S940_Signal_Override /end SUB_GROUP /end GROUP
/begin GROUP S5_VVMC_LatAccCtrl_flg_Inproc "SWC_OUTP_type/run_SWC_OUTP_5ms_sys/OUTP/outpmodule/VVMC_LatAccCtrl_flg_Inproc" /begin SUB_GROUP S941_Signal_Limit S941_Signal_Override /end SUB_GROUP /end GROUP
/begin GROUP S5_VVMC_LateralCtrl_flg_Inproc "SWC_OUTP_type/run_SWC_OUTP_5ms_sys/OUTP/outpmodule/VVMC_LateralCtrl_flg_Inproc" /begin SUB_GROUP S942_Signal_Limit S942_Signal_Override /end SUB_GROUP /end GROUP
/begin GROUP S5_VVMC_LeftTurnLightReq_flg_Inproc "SWC_OUTP_type/run_SWC_OUTP_5ms_sys/OUTP/outpmodule/VVMC_LeftTurnLightReq_flg_Inproc" /begin SUB_GROUP S943_Signal_Limit S943_Signal_Override /end SUB_GROUP /end GROUP
/begin GROUP S5_VVMC_LimitPCT_pct_Inproc "SWC_OUTP_type/run_SWC_OUTP_5ms_sys/OUTP/outpmodule/VVMC_LimitPCT_pct_Inproc" /begin SUB_GROUP S944_Signal_Limit S944_Signal_Override /end SUB_GROUP /end GROUP
/begin GROUP S5_VVMC_LongAcc_Gps_Inproc "SWC_OUTP_type/run_SWC_OUTP_5ms_sys/OUTP/outpmodule/VVMC_LongAcc_Gps_Inproc" /begin SUB_GROUP S945_Signal_Limit S945_Signal_Override /end SUB_GROUP /end GROUP
/begin GROUP S5_VVMC_MSACtrlSta_enum_Inproc "SWC_OUTP_type/run_SWC_OUTP_5ms_sys/OUTP/outpmodule/VVMC_MSACtrlSta_enum_Inproc" /begin SUB_GROUP S946_Signal_Limit S946_Signal_Override /end SUB_GROUP /end GROUP
/begin GROUP S5_VVMC_MeterIndSpeed_raw32_Inproc "SWC_OUTP_type/run_SWC_OUTP_5ms_sys/OUTP/outpmodule/VVMC_MeterIndSpeed_raw32_Inproc" /begin SUB_GROUP S947_Signal_Limit S947_Signal_Override /end SUB_GROUP /end GROUP
/begin GROUP S5_VVMC_RearWhlSlipRatioCtrl_flg_Inproc "SWC_OUTP_type/run_SWC_OUTP_5ms_sys/OUTP/outpmodule/VVMC_RearWhlSlipRatioCtrl_flg_Inproc" /begin SUB_GROUP S948_Signal_Limit S948_Signal_Override /end SUB_GROUP /end GROUP
/begin GROUP S5_VVMC_RightTurnLightReq_flg_Inproc "SWC_OUTP_type/run_SWC_OUTP_5ms_sys/OUTP/outpmodule/VVMC_RightTurnLightReq_flg_Inproc" /begin SUB_GROUP S949_Signal_Limit S949_Signal_Override /end SUB_GROUP /end GROUP
/begin GROUP S5_VVMC_SPD2ACCAct_flg_Inproc "SWC_OUTP_type/run_SWC_OUTP_5ms_sys/OUTP/outpmodule/VVMC_SPD2ACCAct_flg_Inproc" /begin SUB_GROUP S950_Signal_Limit S950_Signal_Override /end SUB_GROUP /end GROUP
/begin GROUP S5_VVMC_SafetyCtrl_flg_Inproc "SWC_OUTP_type/run_SWC_OUTP_5ms_sys/OUTP/outpmodule/VVMC_SafetyCtrl_flg_Inproc" /begin SUB_GROUP S951_Signal_Limit S951_Signal_Override /end SUB_GROUP /end GROUP
/begin GROUP S5_VVMC_SingleWhlSlipRatioCtrl_flg_Inproc "SWC_OUTP_type/run_SWC_OUTP_5ms_sys/OUTP/outpmodule/VVMC_SingleWhlSlipRatioCtrl_flg_Inproc" /begin SUB_GROUP S952_Signal_Limit S952_Signal_Override /end SUB_GROUP /end GROUP
/begin GROUP S5_VVMC_TargetType_enum_Inproc "SWC_OUTP_type/run_SWC_OUTP_5ms_sys/OUTP/outpmodule/VVMC_TargetType_enum_Inproc" /begin SUB_GROUP S953_Signal_Limit S953_Signal_Override /end SUB_GROUP /end GROUP
/begin GROUP S5_VVMC_TimeGapCalcu_s_Inproc "SWC_OUTP_type/run_SWC_OUTP_5ms_sys/OUTP/outpmodule/VVMC_TimeGapCalcu_s_Inproc" /begin SUB_GROUP S954_Signal_Limit S954_Signal_Override /end SUB_GROUP /end GROUP
/begin GROUP S5_VVMC_TimeGapLevel_enum_Inproc "SWC_OUTP_type/run_SWC_OUTP_5ms_sys/OUTP/outpmodule/VVMC_TimeGapLevel_enum_Inproc" /begin SUB_GROUP S955_Signal_Limit S955_Signal_Override /end SUB_GROUP /end GROUP
/begin GROUP S5_VVMC_VMCACCCtrlAvail_flg_Inproc "SWC_OUTP_type/run_SWC_OUTP_5ms_sys/OUTP/outpmodule/VVMC_VMCACCCtrlAvail_flg_Inproc" /begin SUB_GROUP S956_Signal_Limit S956_Signal_Override /end SUB_GROUP /end GROUP
/begin GROUP S5_VVMC_VMCAEBCtrlAvail_flg_Inproc "SWC_OUTP_type/run_SWC_OUTP_5ms_sys/OUTP/outpmodule/VVMC_VMCAEBCtrlAvail_flg_Inproc" /begin SUB_GROUP S957_Signal_Limit S957_Signal_Override /end SUB_GROUP /end GROUP
/begin GROUP S5_VVMC_VMCCCCtrlAvail_flg_Inproc "SWC_OUTP_type/run_SWC_OUTP_5ms_sys/OUTP/outpmodule/VVMC_VMCCCCtrlAvail_flg_Inproc" /begin SUB_GROUP S958_Signal_Limit S958_Signal_Override /end SUB_GROUP /end GROUP
/begin GROUP S5_VVMC_VMCMSACtrlAvail_flg_Inproc "SWC_OUTP_type/run_SWC_OUTP_5ms_sys/OUTP/outpmodule/VVMC_VMCMSACtrlAvail_flg_Inproc" /begin SUB_GROUP S959_Signal_Limit S959_Signal_Override /end SUB_GROUP /end GROUP
/begin GROUP S5_VVMC_VehicleSpeed_kph_Inproc "SWC_OUTP_type/run_SWC_OUTP_5ms_sys/OUTP/outpmodule/VVMC_VehicleSpeed_kph_Inproc" /begin SUB_GROUP S960_Signal_Limit S960_Signal_Override /end SUB_GROUP /end GROUP
/begin GROUP S5_VVMC_VehicleSpeed_mph_Inproc "SWC_OUTP_type/run_SWC_OUTP_5ms_sys/OUTP/outpmodule/VVMC_VehicleSpeed_mph_Inproc" /begin SUB_GROUP S961_Signal_Limit S961_Signal_Override /end SUB_GROUP /end GROUP
/begin GROUP S6_Signal_Limit "SWC_OUTP_type/run_SWC_OUTP_5ms_sys/OUTP/outpmodule/VACC_CACFanReq_flg_Inproc/Signal_Limit" /begin REF_CHARACTERISTIC KOUTP_CACFanReq_flg_maxval KOUTP_CACFanReq_flg_minval /end REF_CHARACTERISTIC /end GROUP
/begin GROUP S6_Signal_Override "SWC_OUTP_type/run_SWC_OUTP_5ms_sys/OUTP/outpmodule/VACC_CACFanReq_flg_Inproc/Signal_Override" /begin REF_CHARACTERISTIC KOUTP_CACFanReq_flg_ovrdflg KOUTP_CACFanReq_flg_ovrdval /end REF_CHARACTERISTIC /end GROUP
/begin GROUP S7_Signal_Limit "SWC_OUTP_type/run_SWC_OUTP_5ms_sys/OUTP/outpmodule/VACC_CACOverrun_flg_Inproc/Signal_Limit" /begin REF_CHARACTERISTIC KOUTP_CACOverrun_flg_maxval KOUTP_CACOverrun_flg_minval /end REF_CHARACTERISTIC /end GROUP
/begin GROUP S7_Signal_Override "SWC_OUTP_type/run_SWC_OUTP_5ms_sys/OUTP/outpmodule/VACC_CACOverrun_flg_Inproc/Signal_Override" /begin REF_CHARACTERISTIC KOUTP_CACOverrun_flg_ovrdflg KOUTP_CACOverrun_flg_ovrdval /end REF_CHARACTERISTIC /end GROUP
/begin GROUP S8_Signal_Limit "SWC_OUTP_type/run_SWC_OUTP_5ms_sys/OUTP/outpmodule/VACC_CACPresReady_flg_Inproc/Signal_Limit"
 /begin REF_CHARACTERISTIC KOUTP_CACPresReady_flg_maxval KOUTP_CACPresReady_flg_minval /end REF_CHARACTERISTIC
/end GROUP
/begin GROUP S8_Signal_Override "SWC_OUTP_type/run_SWC_OUTP_5ms_sys/OUTP/outpmodule/VACC_CACPresReady_flg_Inproc/Signal_Override"
 /begin REF_CHARACTERISTIC KOUTP_CACPresReady_flg_ovrdflg KOUTP_CACPresReady_flg_ovrdval /end REF_CHARACTERISTIC
/end GROUP
/begin GROUP S9_Signal_Limit "SWC_OUTP_type/run_SWC_OUTP_5ms_sys/OUTP/outpmodule/VACC_CACPresWarn_flg_Inproc/Signal_Limit" /begin REF_CHARACTERISTIC KOUTP_CACPresWarn_flg_maxval KOUTP_CACPresWarn_flg_minval /end REF_CHARACTERISTIC /end GROUP
/begin GROUP S9_Signal_Override "SWC_OUTP_type/run_SWC_OUTP_5ms_sys/OUTP/outpmodule/VACC_CACPresWarn_flg_Inproc/Signal_Override"
 /begin REF_CHARACTERISTIC KOUTP_CACPresWarn_flg_ovrdflg KOUTP_CACPresWarn_flg_ovrdval /end REF_CHARACTERISTIC
/end GROUP
/begin GROUP S10_Signal_Limit "SWC_OUTP_type/run_SWC_OUTP_5ms_sys/OUTP/outpmodule/VACC_CACRunFail_flg_Inproc/Signal_Limit" /begin REF_CHARACTERISTIC KOUTP_CACRunFail_flg_maxval KOUTP_CACRunFail_flg_minval /end REF_CHARACTERISTIC /end GROUP
/begin GROUP S10_Signal_Override "SWC_OUTP_type/run_SWC_OUTP_5ms_sys/OUTP/outpmodule/VACC_CACRunFail_flg_Inproc/Signal_Override" /begin REF_CHARACTERISTIC KOUTP_CACRunFail_flg_ovrdflg KOUTP_CACRunFail_flg_ovrdval /end REF_CHARACTERISTIC /end GROUP
/begin GROUP S11_Signal_Limit "SWC_OUTP_type/run_SWC_OUTP_5ms_sys/OUTP/outpmodule/VACC_CACTempOverHigh_flg_Inproc/Signal_Limit"
 /begin REF_CHARACTERISTIC KOUTP_CACTempOverHigh_flg_maxval KOUTP_CACTempOverHigh_flg_minval /end REF_CHARACTERISTIC
/end GROUP
/begin GROUP S11_Signal_Override "SWC_OUTP_type/run_SWC_OUTP_5ms_sys/OUTP/outpmodule/VACC_CACTempOverHigh_flg_Inproc/Signal_Override"
 /begin REF_CHARACTERISTIC KOUTP_CACTempOverHigh_flg_ovrdflg KOUTP_CACTempOverHigh_flg_ovrdval /end REF_CHARACTERISTIC
/end GROUP
/begin GROUP S12_Signal_Limit "SWC_OUTP_type/run_SWC_OUTP_5ms_sys/OUTP/outpmodule/VACC_DCDCEnDemamd_enum_Inproc/Signal_Limit"
 /begin REF_CHARACTERISTIC KOUTP_DCDCEnDemamd_enum_maxval KOUTP_DCDCEnDemamd_enum_minval /end REF_CHARACTERISTIC
/end GROUP
/begin GROUP S12_Signal_Override "SWC_OUTP_type/run_SWC_OUTP_5ms_sys/OUTP/outpmodule/VACC_DCDCEnDemamd_enum_Inproc/Signal_Override"
 /begin REF_CHARACTERISTIC KOUTP_DCDCEnDemamd_enum_ovrdflg KOUTP_DCDCEnDemamd_enum_ovrdval /end REF_CHARACTERISTIC
/end GROUP
/begin GROUP S13_Signal_Limit "SWC_OUTP_type/run_SWC_OUTP_5ms_sys/OUTP/outpmodule/VACC_EACEnDemand_enum_Inproc/Signal_Limit"
 /begin REF_CHARACTERISTIC KOUTP_EACEnDemand_enum_maxval KOUTP_EACEnDemand_enum_minval /end REF_CHARACTERISTIC
/end GROUP
/begin GROUP S13_Signal_Override "SWC_OUTP_type/run_SWC_OUTP_5ms_sys/OUTP/outpmodule/VACC_EACEnDemand_enum_Inproc/Signal_Override"
 /begin REF_CHARACTERISTIC KOUTP_EACEnDemand_enum_ovrdflg KOUTP_EACEnDemand_enum_ovrdval /end REF_CHARACTERISTIC
/end GROUP
/begin GROUP S14_Signal_Limit "SWC_OUTP_type/run_SWC_OUTP_5ms_sys/OUTP/outpmodule/VACC_EACSpdDemand_rpm_Inproc/Signal_Limit"
 /begin REF_CHARACTERISTIC KOUTP_EACSpdDemand_rpm_maxval KOUTP_EACSpdDemand_rpm_minval /end REF_CHARACTERISTIC
/end GROUP
/begin GROUP S14_Signal_Override "SWC_OUTP_type/run_SWC_OUTP_5ms_sys/OUTP/outpmodule/VACC_EACSpdDemand_rpm_Inproc/Signal_Override"
 /begin REF_CHARACTERISTIC KOUTP_EACSpdDemand_rpm_ovrdflg KOUTP_EACSpdDemand_rpm_ovrdval /end REF_CHARACTERISTIC
/end GROUP
/begin GROUP S15_Signal_Limit "SWC_OUTP_type/run_SWC_OUTP_5ms_sys/OUTP/outpmodule/VACC_EHPSDisEnTimeout_flg_Inproc/Signal_Limit"
 /begin REF_CHARACTERISTIC KOUTP_EHPSDisEnTimeout_flg_maxval KOUTP_EHPSDisEnTimeout_flg_minval /end REF_CHARACTERISTIC
/end GROUP
/begin GROUP S15_Signal_Override "SWC_OUTP_type/run_SWC_OUTP_5ms_sys/OUTP/outpmodule/VACC_EHPSDisEnTimeout_flg_Inproc/Signal_Override"
 /begin REF_CHARACTERISTIC KOUTP_EHPSDisEnTimeout_flg_ovrdflg KOUTP_EHPSDisEnTimeout_flg_ovrdval /end REF_CHARACTERISTIC
/end GROUP
/begin GROUP S16_Signal_Limit "SWC_OUTP_type/run_SWC_OUTP_5ms_sys/OUTP/outpmodule/VACC_EHPSEnDemand_enum_Inproc/Signal_Limit"
 /begin REF_CHARACTERISTIC KOUTP_EHPSEnDemand_enum_maxval KOUTP_EHPSEnDemand_enum_minval /end REF_CHARACTERISTIC
/end GROUP
/begin GROUP S16_Signal_Override "SWC_OUTP_type/run_SWC_OUTP_5ms_sys/OUTP/outpmodule/VACC_EHPSEnDemand_enum_Inproc/Signal_Override"
 /begin REF_CHARACTERISTIC KOUTP_EHPSEnDemand_enum_ovrdflg KOUTP_EHPSEnDemand_enum_ovrdval /end REF_CHARACTERISTIC
/end GROUP
/begin GROUP S17_Signal_Limit "SWC_OUTP_type/run_SWC_OUTP_5ms_sys/OUTP/outpmodule/VACC_EHPSEnTimeout_flg_Inproc/Signal_Limit"
 /begin REF_CHARACTERISTIC KOUTP_EHPSEnTimeout_flg_maxval KOUTP_EHPSEnTimeout_flg_minval /end REF_CHARACTERISTIC
/end GROUP
/begin GROUP S17_Signal_Override "SWC_OUTP_type/run_SWC_OUTP_5ms_sys/OUTP/outpmodule/VACC_EHPSEnTimeout_flg_Inproc/Signal_Override"
 /begin REF_CHARACTERISTIC KOUTP_EHPSEnTimeout_flg_ovrdflg KOUTP_EHPSEnTimeout_flg_ovrdval /end REF_CHARACTERISTIC
/end GROUP
/begin GROUP S18_Signal_Limit "SWC_OUTP_type/run_SWC_OUTP_5ms_sys/OUTP/outpmodule/VACC_EHPSMotorDemSpd_rpm_Inproc/Signal_Limit"
 /begin REF_CHARACTERISTIC KOUTP_EHPSMotorDemSpd_rpm_maxval KOUTP_EHPSMotorDemSpd_rpm_minval /end REF_CHARACTERISTIC
/end GROUP
/begin GROUP S18_Signal_Override "SWC_OUTP_type/run_SWC_OUTP_5ms_sys/OUTP/outpmodule/VACC_EHPSMotorDemSpd_rpm_Inproc/Signal_Override"
 /begin REF_CHARACTERISTIC KOUTP_EHPSMotorDemSpd_rpm_ovrdflg KOUTP_EHPSMotorDemSpd_rpm_ovrdval /end REF_CHARACTERISTIC
/end GROUP
/begin GROUP S19_Signal_Limit "SWC_OUTP_type/run_SWC_OUTP_5ms_sys/OUTP/outpmodule/VACC_EHPSSpdCtrlMode_enum_Inproc/Signal_Limit"
 /begin REF_CHARACTERISTIC KOUTP_EHPSSpdCtrlMode_enum_maxval KOUTP_EHPSSpdCtrlMode_enum_minval /end REF_CHARACTERISTIC
/end GROUP
/begin GROUP S19_Signal_Override "SWC_OUTP_type/run_SWC_OUTP_5ms_sys/OUTP/outpmodule/VACC_EHPSSpdCtrlMode_enum_Inproc/Signal_Override"
 /begin REF_CHARACTERISTIC KOUTP_EHPSSpdCtrlMode_enum_ovrdflg KOUTP_EHPSSpdCtrlMode_enum_ovrdval /end REF_CHARACTERISTIC
/end GROUP
/begin GROUP S20_Signal_Limit "SWC_OUTP_type/run_SWC_OUTP_5ms_sys/OUTP/outpmodule/VACC_EHPSSpdDemTimeout_flg_Inproc/Signal_Limit"
 /begin REF_CHARACTERISTIC KOUTP_EHPSSpdDemTimeout_flg_maxval KOUTP_EHPSSpdDemTimeout_flg_minval /end REF_CHARACTERISTIC
/end GROUP
/begin GROUP S20_Signal_Override "SWC_OUTP_type/run_SWC_OUTP_5ms_sys/OUTP/outpmodule/VACC_EHPSSpdDemTimeout_flg_Inproc/Signal_Override"
 /begin REF_CHARACTERISTIC KOUTP_EHPSSpdDemTimeout_flg_ovrdflg KOUTP_EHPSSpdDemTimeout_flg_ovrdval /end REF_CHARACTERISTIC
/end GROUP
/begin GROUP S21_Signal_Limit "SWC_OUTP_type/run_SWC_OUTP_5ms_sys/OUTP/outpmodule/VAPM_ABSActiveTimeOut_flg_Inproc/Signal_Limit"
 /begin REF_CHARACTERISTIC KOUTP_ABSActiveTimeOut_flg_maxval KOUTP_ABSActiveTimeOut_flg_minval /end REF_CHARACTERISTIC
/end GROUP
/begin GROUP S21_Signal_Override "SWC_OUTP_type/run_SWC_OUTP_5ms_sys/OUTP/outpmodule/VAPM_ABSActiveTimeOut_flg_Inproc/Signal_Override"
 /begin REF_CHARACTERISTIC KOUTP_ABSActiveTimeOut_flg_ovrdflg KOUTP_ABSActiveTimeOut_flg_ovrdval /end REF_CHARACTERISTIC
/end GROUP
/begin GROUP S22_Signal_Limit "SWC_OUTP_type/run_SWC_OUTP_5ms_sys/OUTP/outpmodule/VAPM_ABSActive_flg_Inproc/Signal_Limit" /begin REF_CHARACTERISTIC KOUTP_ABSActive_flg_maxval KOUTP_ABSActive_flg_minval /end REF_CHARACTERISTIC /end GROUP
/begin GROUP S22_Signal_Override "SWC_OUTP_type/run_SWC_OUTP_5ms_sys/OUTP/outpmodule/VAPM_ABSActive_flg_Inproc/Signal_Override" /begin REF_CHARACTERISTIC KOUTP_ABSActive_flg_ovrdflg KOUTP_ABSActive_flg_ovrdval /end REF_CHARACTERISTIC /end GROUP
/begin GROUP S23_Signal_Limit "SWC_OUTP_type/run_SWC_OUTP_5ms_sys/OUTP/outpmodule/VAPM_APSAngleTarget_Deg_Inproc/Signal_Limit"
 /begin REF_CHARACTERISTIC KOUTP_APSAngleTarget_Deg_maxval KOUTP_APSAngleTarget_Deg_minval /end REF_CHARACTERISTIC
/end GROUP
/begin GROUP S23_Signal_Override "SWC_OUTP_type/run_SWC_OUTP_5ms_sys/OUTP/outpmodule/VAPM_APSAngleTarget_Deg_Inproc/Signal_Override"
 /begin REF_CHARACTERISTIC KOUTP_APSAngleTarget_Deg_ovrdflg KOUTP_APSAngleTarget_Deg_ovrdval /end REF_CHARACTERISTIC
/end GROUP
/begin GROUP S24_Signal_Limit "SWC_OUTP_type/run_SWC_OUTP_5ms_sys/OUTP/outpmodule/VAPM_APSDFLL_cm_Inproc/Signal_Limit" /begin REF_CHARACTERISTIC KOUTP_APSDFLL_cm_maxval KOUTP_APSDFLL_cm_minval /end REF_CHARACTERISTIC /end GROUP
/begin GROUP S24_Signal_Override "SWC_OUTP_type/run_SWC_OUTP_5ms_sys/OUTP/outpmodule/VAPM_APSDFLL_cm_Inproc/Signal_Override" /begin REF_CHARACTERISTIC KOUTP_APSDFLL_cm_ovrdflg KOUTP_APSDFLL_cm_ovrdval /end REF_CHARACTERISTIC /end GROUP
/begin GROUP S25_Signal_Limit "SWC_OUTP_type/run_SWC_OUTP_5ms_sys/OUTP/outpmodule/VAPM_APSDFLR_cm_Inproc/Signal_Limit" /begin REF_CHARACTERISTIC KOUTP_APSDFLR_cm_maxval KOUTP_APSDFLR_cm_minval /end REF_CHARACTERISTIC /end GROUP
/begin GROUP S25_Signal_Override "SWC_OUTP_type/run_SWC_OUTP_5ms_sys/OUTP/outpmodule/VAPM_APSDFLR_cm_Inproc/Signal_Override" /begin REF_CHARACTERISTIC KOUTP_APSDFLR_cm_ovrdflg KOUTP_APSDFLR_cm_ovrdval /end REF_CHARACTERISTIC /end GROUP
/begin GROUP S26_Signal_Limit "SWC_OUTP_type/run_SWC_OUTP_5ms_sys/OUTP/outpmodule/VAPM_APSDRLL_cm_Inproc/Signal_Limit" /begin REF_CHARACTERISTIC KOUTP_APSDRLL_cm_maxval KOUTP_APSDRLL_cm_minval /end REF_CHARACTERISTIC /end GROUP
/begin GROUP S26_Signal_Override "SWC_OUTP_type/run_SWC_OUTP_5ms_sys/OUTP/outpmodule/VAPM_APSDRLL_cm_Inproc/Signal_Override" /begin REF_CHARACTERISTIC KOUTP_APSDRLL_cm_ovrdflg KOUTP_APSDRLL_cm_ovrdval /end REF_CHARACTERISTIC /end GROUP
/begin GROUP S27_Signal_Limit "SWC_OUTP_type/run_SWC_OUTP_5ms_sys/OUTP/outpmodule/VAPM_APSDRLR_cm_Inproc/Signal_Limit" /begin REF_CHARACTERISTIC KOUTP_APSDRLR_cm_maxval KOUTP_APSDRLR_cm_minval /end REF_CHARACTERISTIC /end GROUP
/begin GROUP S27_Signal_Override "SWC_OUTP_type/run_SWC_OUTP_5ms_sys/OUTP/outpmodule/VAPM_APSDRLR_cm_Inproc/Signal_Override" /begin REF_CHARACTERISTIC KOUTP_APSDRLR_cm_ovrdflg KOUTP_APSDRLR_cm_ovrdval /end REF_CHARACTERISTIC /end GROUP
/begin GROUP S28_Signal_Limit "SWC_OUTP_type/run_SWC_OUTP_5ms_sys/OUTP/outpmodule/VAPM_APSExitCondition_enum_Inproc/Signal_Limit"
 /begin REF_CHARACTERISTIC KOUTP_APSExitCondition_enum_maxval KOUTP_APSExitCondition_enum_minval /end REF_CHARACTERISTIC
/end GROUP
/begin GROUP S28_Signal_Override "SWC_OUTP_type/run_SWC_OUTP_5ms_sys/OUTP/outpmodule/VAPM_APSExitCondition_enum_Inproc/Signal_Override"
 /begin REF_CHARACTERISTIC KOUTP_APSExitCondition_enum_ovrdflg KOUTP_APSExitCondition_enum_ovrdval /end REF_CHARACTERISTIC
/end GROUP
/begin GROUP S29_Signal_Limit "SWC_OUTP_type/run_SWC_OUTP_5ms_sys/OUTP/outpmodule/VAPM_APSHWVer_enum_Inproc/Signal_Limit" /begin REF_CHARACTERISTIC KOUTP_APSHWVer_enum_maxval KOUTP_APSHWVer_enum_minval /end REF_CHARACTERISTIC /end GROUP
/begin GROUP S29_Signal_Override "SWC_OUTP_type/run_SWC_OUTP_5ms_sys/OUTP/outpmodule/VAPM_APSHWVer_enum_Inproc/Signal_Override" /begin REF_CHARACTERISTIC KOUTP_APSHWVer_enum_ovrdflg KOUTP_APSHWVer_enum_ovrdval /end REF_CHARACTERISTIC /end GROUP
/begin GROUP S30_Signal_Limit "SWC_OUTP_type/run_SWC_OUTP_5ms_sys/OUTP/outpmodule/VAPM_APSProgressPCT_pct_Inproc/Signal_Limit"
 /begin REF_CHARACTERISTIC KOUTP_APSProgressPCT_pct_maxval KOUTP_APSProgressPCT_pct_minval /end REF_CHARACTERISTIC
/end GROUP
/begin GROUP S30_Signal_Override "SWC_OUTP_type/run_SWC_OUTP_5ms_sys/OUTP/outpmodule/VAPM_APSProgressPCT_pct_Inproc/Signal_Override"
 /begin REF_CHARACTERISTIC KOUTP_APSProgressPCT_pct_ovrdflg KOUTP_APSProgressPCT_pct_ovrdval /end REF_CHARACTERISTIC
/end GROUP
/begin GROUP S31_Signal_Limit "SWC_OUTP_type/run_SWC_OUTP_5ms_sys/OUTP/outpmodule/VAPM_APSPwrReq_enum_Inproc/Signal_Limit" /begin REF_CHARACTERISTIC KOUTP_APSPwrReq_enum_maxval KOUTP_APSPwrReq_enum_minval /end REF_CHARACTERISTIC /end GROUP
/begin GROUP S31_Signal_Override "SWC_OUTP_type/run_SWC_OUTP_5ms_sys/OUTP/outpmodule/VAPM_APSPwrReq_enum_Inproc/Signal_Override" /begin REF_CHARACTERISTIC KOUTP_APSPwrReq_enum_ovrdflg KOUTP_APSPwrReq_enum_ovrdval /end REF_CHARACTERISTIC /end GROUP
/begin GROUP S32_Signal_Limit "SWC_OUTP_type/run_SWC_OUTP_5ms_sys/OUTP/outpmodule/VAPM_APSRQDisplay_enum_Inproc/Signal_Limit"
 /begin REF_CHARACTERISTIC KOUTP_APSRQDisplay_enum_maxval KOUTP_APSRQDisplay_enum_minval /end REF_CHARACTERISTIC
/end GROUP
/begin GROUP S32_Signal_Override "SWC_OUTP_type/run_SWC_OUTP_5ms_sys/OUTP/outpmodule/VAPM_APSRQDisplay_enum_Inproc/Signal_Override"
 /begin REF_CHARACTERISTIC KOUTP_APSRQDisplay_enum_ovrdflg KOUTP_APSRQDisplay_enum_ovrdval /end REF_CHARACTERISTIC
/end GROUP
/begin GROUP S33_Signal_Limit "SWC_OUTP_type/run_SWC_OUTP_5ms_sys/OUTP/outpmodule/VAPM_APSRqEPASCtrl_flg_Inproc/Signal_Limit"
 /begin REF_CHARACTERISTIC KOUTP_APSRqEPASCtrl_flg_maxval KOUTP_APSRqEPASCtrl_flg_minval /end REF_CHARACTERISTIC
/end GROUP
/begin GROUP S33_Signal_Override "SWC_OUTP_type/run_SWC_OUTP_5ms_sys/OUTP/outpmodule/VAPM_APSRqEPASCtrl_flg_Inproc/Signal_Override"
 /begin REF_CHARACTERISTIC KOUTP_APSRqEPASCtrl_flg_ovrdflg KOUTP_APSRqEPASCtrl_flg_ovrdval /end REF_CHARACTERISTIC
/end GROUP
/begin GROUP S34_Signal_Limit "SWC_OUTP_type/run_SWC_OUTP_5ms_sys/OUTP/outpmodule/VAPM_APSSWVer_enum_Inproc/Signal_Limit" /begin REF_CHARACTERISTIC KOUTP_APSSWVer_enum_maxval KOUTP_APSSWVer_enum_minval /end REF_CHARACTERISTIC /end GROUP
/begin GROUP S34_Signal_Override "SWC_OUTP_type/run_SWC_OUTP_5ms_sys/OUTP/outpmodule/VAPM_APSSWVer_enum_Inproc/Signal_Override" /begin REF_CHARACTERISTIC KOUTP_APSSWVer_enum_ovrdflg KOUTP_APSSWVer_enum_ovrdval /end REF_CHARACTERISTIC /end GROUP
/begin GROUP S35_Signal_Limit "SWC_OUTP_type/run_SWC_OUTP_5ms_sys/OUTP/outpmodule/VAPM_APSShiftPosnReq_enum_Inproc/Signal_Limit"
 /begin REF_CHARACTERISTIC KOUTP_APSShiftPosnReq_enum_maxval KOUTP_APSShiftPosnReq_enum_minval /end REF_CHARACTERISTIC
/end GROUP
/begin GROUP S35_Signal_Override "SWC_OUTP_type/run_SWC_OUTP_5ms_sys/OUTP/outpmodule/VAPM_APSShiftPosnReq_enum_Inproc/Signal_Override"
 /begin REF_CHARACTERISTIC KOUTP_APSShiftPosnReq_enum_ovrdflg KOUTP_APSShiftPosnReq_enum_ovrdval /end REF_CHARACTERISTIC
/end GROUP
/begin GROUP S36_Signal_Limit "SWC_OUTP_type/run_SWC_OUTP_5ms_sys/OUTP/outpmodule/VAPM_APSSpeedCMD_kph_Inproc/Signal_Limit" /begin REF_CHARACTERISTIC KOUTP_APSSpeedCMD_kph_maxval KOUTP_APSSpeedCMD_kph_minval /end REF_CHARACTERISTIC /end GROUP
/begin GROUP S36_Signal_Override "SWC_OUTP_type/run_SWC_OUTP_5ms_sys/OUTP/outpmodule/VAPM_APSSpeedCMD_kph_Inproc/Signal_Override"
 /begin REF_CHARACTERISTIC KOUTP_APSSpeedCMD_kph_ovrdflg KOUTP_APSSpeedCMD_kph_ovrdval /end REF_CHARACTERISTIC
/end GROUP
/begin GROUP S37_Signal_Limit "SWC_OUTP_type/run_SWC_OUTP_5ms_sys/OUTP/outpmodule/VAPM_APSVMCReqA_flg_Inproc/Signal_Limit" /begin REF_CHARACTERISTIC KOUTP_APSVMCReqA_flg_maxval KOUTP_APSVMCReqA_flg_minval /end REF_CHARACTERISTIC /end GROUP
/begin GROUP S37_Signal_Override "SWC_OUTP_type/run_SWC_OUTP_5ms_sys/OUTP/outpmodule/VAPM_APSVMCReqA_flg_Inproc/Signal_Override" /begin REF_CHARACTERISTIC KOUTP_APSVMCReqA_flg_ovrdflg KOUTP_APSVMCReqA_flg_ovrdval /end REF_CHARACTERISTIC /end GROUP
/begin GROUP S38_Signal_Limit "SWC_OUTP_type/run_SWC_OUTP_5ms_sys/OUTP/outpmodule/VAPM_APSVRqEPASCtrl_flg_Inproc/Signal_Limit"
 /begin REF_CHARACTERISTIC KOUTP_APSVRqEPASCtrl_flg_maxval KOUTP_APSVRqEPASCtrl_flg_minval /end REF_CHARACTERISTIC
/end GROUP
/begin GROUP S38_Signal_Override "SWC_OUTP_type/run_SWC_OUTP_5ms_sys/OUTP/outpmodule/VAPM_APSVRqEPASCtrl_flg_Inproc/Signal_Override"
 /begin REF_CHARACTERISTIC KOUTP_APSVRqEPASCtrl_flg_ovrdflg KOUTP_APSVRqEPASCtrl_flg_ovrdval /end REF_CHARACTERISTIC
/end GROUP
/begin GROUP S39_Signal_Limit "SWC_OUTP_type/run_SWC_OUTP_5ms_sys/OUTP/outpmodule/VAPM_AVMErrSTATimeOut_flg_Inproc/Signal_Limit"
 /begin REF_CHARACTERISTIC KOUTP_AVMErrSTATimeOut_flg_maxval KOUTP_AVMErrSTATimeOut_flg_minval /end REF_CHARACTERISTIC
/end GROUP
/begin GROUP S39_Signal_Override "SWC_OUTP_type/run_SWC_OUTP_5ms_sys/OUTP/outpmodule/VAPM_AVMErrSTATimeOut_flg_Inproc/Signal_Override"
 /begin REF_CHARACTERISTIC KOUTP_AVMErrSTATimeOut_flg_ovrdflg KOUTP_AVMErrSTATimeOut_flg_ovrdval /end REF_CHARACTERISTIC
/end GROUP
/begin GROUP S40_Signal_Limit "SWC_OUTP_type/run_SWC_OUTP_5ms_sys/OUTP/outpmodule/VAPM_AVMErrSTA_flg_Inproc/Signal_Limit" /begin REF_CHARACTERISTIC KOUTP_AVMErrSTA_flg_maxval KOUTP_AVMErrSTA_flg_minval /end REF_CHARACTERISTIC /end GROUP
/begin GROUP S40_Signal_Override "SWC_OUTP_type/run_SWC_OUTP_5ms_sys/OUTP/outpmodule/VAPM_AVMErrSTA_flg_Inproc/Signal_Override" /begin REF_CHARACTERISTIC KOUTP_AVMErrSTA_flg_ovrdflg KOUTP_AVMErrSTA_flg_ovrdval /end REF_CHARACTERISTIC /end GROUP
/begin GROUP S41_Signal_Limit "SWC_OUTP_type/run_SWC_OUTP_5ms_sys/OUTP/outpmodule/VAPM_AVMParkingmodeTimeOut_flg_Inproc/Signal_Limit"
 /begin REF_CHARACTERISTIC KOUTP_AVMParkingmodeTimeOut_flg_maxval KOUTP_AVMParkingmodeTimeOut_flg_minval /end REF_CHARACTERISTIC
/end GROUP
/begin GROUP S41_Signal_Override "SWC_OUTP_type/run_SWC_OUTP_5ms_sys/OUTP/outpmodule/VAPM_AVMParkingmodeTimeOut_flg_Inproc/Signal_Override"
 /begin REF_CHARACTERISTIC KOUTP_AVMParkingmodeTimeOut_flg_ovrdflg KOUTP_AVMParkingmodeTimeOut_flg_ovrdval /end REF_CHARACTERISTIC
/end GROUP
/begin GROUP S42_Signal_Limit "SWC_OUTP_type/run_SWC_OUTP_5ms_sys/OUTP/outpmodule/VAPM_AVMParkingmode_enum_Inproc/Signal_Limit"
 /begin REF_CHARACTERISTIC KOUTP_AVMParkingmode_enum_maxval KOUTP_AVMParkingmode_enum_minval /end REF_CHARACTERISTIC
/end GROUP
/begin GROUP S42_Signal_Override "SWC_OUTP_type/run_SWC_OUTP_5ms_sys/OUTP/outpmodule/VAPM_AVMParkingmode_enum_Inproc/Signal_Override"
 /begin REF_CHARACTERISTIC KOUTP_AVMParkingmode_enum_ovrdflg KOUTP_AVMParkingmode_enum_ovrdval /end REF_CHARACTERISTIC
/end GROUP
/begin GROUP S43_Signal_Limit "SWC_OUTP_type/run_SWC_OUTP_5ms_sys/OUTP/outpmodule/VAPM_AVMparkingcancelTimeOut_flg_Inproc/Signal_Limit"
 /begin REF_CHARACTERISTIC KOUTP_AVMparkingcancelTimeOut_flg_maxval KOUTP_AVMparkingcancelTimeOut_flg_minval /end REF_CHARACTERISTIC
/end GROUP
/begin GROUP S43_Signal_Override "SWC_OUTP_type/run_SWC_OUTP_5ms_sys/OUTP/outpmodule/VAPM_AVMparkingcancelTimeOut_flg_Inproc/Signal_Override"
 /begin REF_CHARACTERISTIC KOUTP_AVMparkingcancelTimeOut_flg_ovrdflg KOUTP_AVMparkingcancelTimeOut_flg_ovrdval /end REF_CHARACTERISTIC
/end GROUP
/begin GROUP S44_Signal_Limit "SWC_OUTP_type/run_SWC_OUTP_5ms_sys/OUTP/outpmodule/VAPM_AVMparkingcancel_enum_Inproc/Signal_Limit"
 /begin REF_CHARACTERISTIC KOUTP_AVMparkingcancel_enum_maxval KOUTP_AVMparkingcancel_enum_minval /end REF_CHARACTERISTIC
/end GROUP
/begin GROUP S44_Signal_Override "SWC_OUTP_type/run_SWC_OUTP_5ms_sys/OUTP/outpmodule/VAPM_AVMparkingcancel_enum_Inproc/Signal_Override"
 /begin REF_CHARACTERISTIC KOUTP_AVMparkingcancel_enum_ovrdflg KOUTP_AVMparkingcancel_enum_ovrdval /end REF_CHARACTERISTIC
/end GROUP
/begin GROUP S45_Signal_Limit "SWC_OUTP_type/run_SWC_OUTP_5ms_sys/OUTP/outpmodule/VAPM_AVMparkingexcuteTimeOut_flg_Inproc/Signal_Limit"
 /begin REF_CHARACTERISTIC KOUTP_AVMparkingexcuteTimeOut_flg_maxval KOUTP_AVMparkingexcuteTimeOut_flg_minval /end REF_CHARACTERISTIC
/end GROUP
/begin GROUP S45_Signal_Override "SWC_OUTP_type/run_SWC_OUTP_5ms_sys/OUTP/outpmodule/VAPM_AVMparkingexcuteTimeOut_flg_Inproc/Signal_Override"
 /begin REF_CHARACTERISTIC KOUTP_AVMparkingexcuteTimeOut_flg_ovrdflg KOUTP_AVMparkingexcuteTimeOut_flg_ovrdval /end REF_CHARACTERISTIC
/end GROUP
/begin GROUP S46_Signal_Limit "SWC_OUTP_type/run_SWC_OUTP_5ms_sys/OUTP/outpmodule/VAPM_AVMparkingexcute_enum_Inproc/Signal_Limit"
 /begin REF_CHARACTERISTIC KOUTP_AVMparkingexcute_enum_maxval KOUTP_AVMparkingexcute_enum_minval /end REF_CHARACTERISTIC
/end GROUP
/begin GROUP S46_Signal_Override "SWC_OUTP_type/run_SWC_OUTP_5ms_sys/OUTP/outpmodule/VAPM_AVMparkingexcute_enum_Inproc/Signal_Override"
 /begin REF_CHARACTERISTIC KOUTP_AVMparkingexcute_enum_ovrdflg KOUTP_AVMparkingexcute_enum_ovrdval /end REF_CHARACTERISTIC
/end GROUP
/begin GROUP S47_Signal_Limit "SWC_OUTP_type/run_SWC_OUTP_5ms_sys/OUTP/outpmodule/VAPM_BrkPedalPosTimeOut_flg_Inproc/Signal_Limit"
 /begin REF_CHARACTERISTIC KOUTP_BrkPedalPosTimeOut_flg_maxval KOUTP_BrkPedalPosTimeOut_flg_minval /end REF_CHARACTERISTIC
/end GROUP
/begin GROUP S47_Signal_Override "SWC_OUTP_type/run_SWC_OUTP_5ms_sys/OUTP/outpmodule/VAPM_BrkPedalPosTimeOut_flg_Inproc/Signal_Override"
 /begin REF_CHARACTERISTIC KOUTP_BrkPedalPosTimeOut_flg_ovrdflg KOUTP_BrkPedalPosTimeOut_flg_ovrdval /end REF_CHARACTERISTIC
/end GROUP
/begin GROUP S48_Signal_Limit "SWC_OUTP_type/run_SWC_OUTP_5ms_sys/OUTP/outpmodule/VAPM_BrkPedalPos_pct_Inproc/Signal_Limit" /begin REF_CHARACTERISTIC KOUTP_BrkPedalPos_pct_maxval KOUTP_BrkPedalPos_pct_minval /end REF_CHARACTERISTIC /end GROUP
/begin GROUP S48_Signal_Override "SWC_OUTP_type/run_SWC_OUTP_5ms_sys/OUTP/outpmodule/VAPM_BrkPedalPos_pct_Inproc/Signal_Override"
 /begin REF_CHARACTERISTIC KOUTP_BrkPedalPos_pct_ovrdflg KOUTP_BrkPedalPos_pct_ovrdval /end REF_CHARACTERISTIC
/end GROUP
/begin GROUP S49_Signal_Limit "SWC_OUTP_type/run_SWC_OUTP_5ms_sys/OUTP/outpmodule/VAPM_BrkSwStaTimeOut_flg_Inproc/Signal_Limit"
 /begin REF_CHARACTERISTIC KOUTP_BrkSwStaTimeOut_flg_maxval KOUTP_BrkSwStaTimeOut_flg_minval /end REF_CHARACTERISTIC
/end GROUP
/begin GROUP S49_Signal_Override "SWC_OUTP_type/run_SWC_OUTP_5ms_sys/OUTP/outpmodule/VAPM_BrkSwStaTimeOut_flg_Inproc/Signal_Override"
 /begin REF_CHARACTERISTIC KOUTP_BrkSwStaTimeOut_flg_ovrdflg KOUTP_BrkSwStaTimeOut_flg_ovrdval /end REF_CHARACTERISTIC
/end GROUP
/begin GROUP S50_Signal_Limit "SWC_OUTP_type/run_SWC_OUTP_5ms_sys/OUTP/outpmodule/VAPM_BrkSwSta_flg_Inproc/Signal_Limit" /begin REF_CHARACTERISTIC KOUTP_BrkSwSta_flg_maxval KOUTP_BrkSwSta_flg_minval /end REF_CHARACTERISTIC /end GROUP
/begin GROUP S50_Signal_Override "SWC_OUTP_type/run_SWC_OUTP_5ms_sys/OUTP/outpmodule/VAPM_BrkSwSta_flg_Inproc/Signal_Override" /begin REF_CHARACTERISTIC KOUTP_BrkSwSta_flg_ovrdflg KOUTP_BrkSwSta_flg_ovrdval /end REF_CHARACTERISTIC /end GROUP
/begin GROUP S51_Signal_Limit "SWC_OUTP_type/run_SWC_OUTP_5ms_sys/OUTP/outpmodule/VAPM_BrkSwVTimeOut_flg_Inproc/Signal_Limit"
 /begin REF_CHARACTERISTIC KOUTP_BrkSwVTimeOut_flg_maxval KOUTP_BrkSwVTimeOut_flg_minval /end REF_CHARACTERISTIC
/end GROUP
/begin GROUP S51_Signal_Override "SWC_OUTP_type/run_SWC_OUTP_5ms_sys/OUTP/outpmodule/VAPM_BrkSwVTimeOut_flg_Inproc/Signal_Override"
 /begin REF_CHARACTERISTIC KOUTP_BrkSwVTimeOut_flg_ovrdflg KOUTP_BrkSwVTimeOut_flg_ovrdval /end REF_CHARACTERISTIC
/end GROUP
/begin GROUP S52_Signal_Limit "SWC_OUTP_type/run_SWC_OUTP_5ms_sys/OUTP/outpmodule/VAPM_BrkSwV_flg_Inproc/Signal_Limit" /begin REF_CHARACTERISTIC KOUTP_BrkSwV_flg_maxval KOUTP_BrkSwV_flg_minval /end REF_CHARACTERISTIC /end GROUP
/begin GROUP S52_Signal_Override "SWC_OUTP_type/run_SWC_OUTP_5ms_sys/OUTP/outpmodule/VAPM_BrkSwV_flg_Inproc/Signal_Override" /begin REF_CHARACTERISTIC KOUTP_BrkSwV_flg_ovrdflg KOUTP_BrkSwV_flg_ovrdval /end REF_CHARACTERISTIC /end GROUP
/begin GROUP S53_Signal_Limit "SWC_OUTP_type/run_SWC_OUTP_5ms_sys/OUTP/outpmodule/VAPM_CAASSta_enum_Inproc/Signal_Limit" /begin REF_CHARACTERISTIC KOUTP_CAASSta_enum_maxval KOUTP_CAASSta_enum_minval /end REF_CHARACTERISTIC /end GROUP
/begin GROUP S53_Signal_Override "SWC_OUTP_type/run_SWC_OUTP_5ms_sys/OUTP/outpmodule/VAPM_CAASSta_enum_Inproc/Signal_Override" /begin REF_CHARACTERISTIC KOUTP_CAASSta_enum_ovrdflg KOUTP_CAASSta_enum_ovrdval /end REF_CHARACTERISTIC /end GROUP
/begin GROUP S54_Signal_Limit "SWC_OUTP_type/run_SWC_OUTP_5ms_sys/OUTP/outpmodule/VAPM_CAASSwTimeOut_flg_Inproc/Signal_Limit"
 /begin REF_CHARACTERISTIC KOUTP_CAASSwTimeOut_flg_maxval KOUTP_CAASSwTimeOut_flg_minval /end REF_CHARACTERISTIC
/end GROUP
/begin GROUP S54_Signal_Override "SWC_OUTP_type/run_SWC_OUTP_5ms_sys/OUTP/outpmodule/VAPM_CAASSwTimeOut_flg_Inproc/Signal_Override"
 /begin REF_CHARACTERISTIC KOUTP_CAASSwTimeOut_flg_ovrdflg KOUTP_CAASSwTimeOut_flg_ovrdval /end REF_CHARACTERISTIC
/end GROUP
/begin GROUP S55_Signal_Limit "SWC_OUTP_type/run_SWC_OUTP_5ms_sys/OUTP/outpmodule/VAPM_CAASSw_enum_Inproc/Signal_Limit" /begin REF_CHARACTERISTIC KOUTP_CAASSw_enum_maxval KOUTP_CAASSw_enum_minval /end REF_CHARACTERISTIC /end GROUP
/begin GROUP S55_Signal_Override "SWC_OUTP_type/run_SWC_OUTP_5ms_sys/OUTP/outpmodule/VAPM_CAASSw_enum_Inproc/Signal_Override" /begin REF_CHARACTERISTIC KOUTP_CAASSw_enum_ovrdflg KOUTP_CAASSw_enum_ovrdval /end REF_CHARACTERISTIC /end GROUP
/begin GROUP S56_Signal_Limit "SWC_OUTP_type/run_SWC_OUTP_5ms_sys/OUTP/outpmodule/VAPM_CAASVMCReqA_flg_Inproc/Signal_Limit" /begin REF_CHARACTERISTIC KOUTP_CAASVMCReqA_flg_maxval KOUTP_CAASVMCReqA_flg_minval /end REF_CHARACTERISTIC /end GROUP
/begin GROUP S56_Signal_Override "SWC_OUTP_type/run_SWC_OUTP_5ms_sys/OUTP/outpmodule/VAPM_CAASVMCReqA_flg_Inproc/Signal_Override"
 /begin REF_CHARACTERISTIC KOUTP_CAASVMCReqA_flg_ovrdflg KOUTP_CAASVMCReqA_flg_ovrdval /end REF_CHARACTERISTIC
/end GROUP
/begin GROUP S57_Signal_Limit "SWC_OUTP_type/run_SWC_OUTP_5ms_sys/OUTP/outpmodule/VAPM_Chime_enum_Inproc/Signal_Limit" /begin REF_CHARACTERISTIC KOUTP_Chime_enum_maxval KOUTP_Chime_enum_minval /end REF_CHARACTERISTIC /end GROUP
/begin GROUP S57_Signal_Override "SWC_OUTP_type/run_SWC_OUTP_5ms_sys/OUTP/outpmodule/VAPM_Chime_enum_Inproc/Signal_Override" /begin REF_CHARACTERISTIC KOUTP_Chime_enum_ovrdflg KOUTP_Chime_enum_ovrdval /end REF_CHARACTERISTIC /end GROUP
/begin GROUP S58_Signal_Limit "SWC_OUTP_type/run_SWC_OUTP_5ms_sys/OUTP/outpmodule/VAPM_ChrgPlugSta_enum_Inproc/Signal_Limit"
 /begin REF_CHARACTERISTIC KOUTP_ChrgPlugSta_enum_maxval KOUTP_ChrgPlugSta_enum_minval /end REF_CHARACTERISTIC
/end GROUP
/end MODULE
/end PROJECT
