ASAP2_VERSION 1 31
/begin PROJECT ProjectName "Project Comment Goes Here"
/begin HEADER "Header Comments go here" /end HEADER
/begin MODULE ModuleName "Module Comment Goes Here"
/begin MOD_COMMON "Mod Common Comment Here" BYTE_ORDER MSB_LAST /end MOD_COMMON
/begin RECORD_LAYOUT Scalar_BOOLEAN FNC_VALUES 1 UBYTE COLUMN_DIR DIRECT /end RECORD_LAYOUT
/begin RECORD_LAYOUT Scalar_UBYTE FNC_VALUES 1 UBYTE COLUMN_DIR DIRECT /end RECORD_LAYOUT
/begin RECORD_LAYOUT Scalar_UWORD FNC_VALUES 1 UWORD COLUMN_DIR DIRECT /end RECORD_LAYOUT
/begin RECORD_LAYOUT Scalar_FLOAT32_IEEE FNC_VALUES 1 FLOAT32_IEEE COLUMN_DIR DIRECT /end RECORD_LAYOUT
/begin RECORD_LAYOUT Lookup1D_X_ULONG AXIS_PTS_X 1 ULONG INDEX_INCR DIRECT /end RECORD_LAYOUT
/begin RECORD_LAYOUT Lookup1D_SLONG FNC_VALUES 1 SLONG COLUMN_DIR DIRECT /end RECORD_LAYOUT
/begin RECORD_LAYOUT Lookup1D_X_LONG AXIS_PTS_X 1 SLONG INDEX_INCR DIRECT /end RECORD_LAYOUT
/begin RECORD_LAYOUT Lookup1D_FLOAT32_IEEE FNC_VALUES 1 FLOAT32_IEEE COLUMN_DIR DIRECT /end RECORD_LAYOUT
/begin RECORD_LAYOUT Lookup1D_X_FLOAT32_IEEE AXIS_PTS_X 1 FLOAT32_IEEE INDEX_INCR DIRECT /end RECORD_LAYOUT
/begin RECORD_LAYOUT Lookup1D_FLOAT64_IEEE FNC_VALUES 1 FLOAT64_IEEE COLUMN_DIR DIRECT /end RECORD_LAYOUT
/begin RECORD_LAYOUT Lookup1D_X_FLOAT64_IEEE AXIS_PTS_X 1 FLOAT64_IEEE INDEX_INCR DIRECT /end RECORD_LAYOUT
/begin RECORD_LAYOUT Lookup2D_BOOLEAN FNC_VALUES 1 UBYTE COLUMN_DIR DIRECT /end RECORD_LAYOUT
/begin RECORD_LAYOUT Lookup2D_X_BOOLEAN AXIS_PTS_X 1 UBYTE INDEX_INCR DIRECT /end RECORD_LAYOUT
/begin RECORD_LAYOUT Lookup2D_UBYTE FNC_VALUES 1 UBYTE COLUMN_DIR DIRECT /end RECORD_LAYOUT
/begin RECORD_LAYOUT Lookup2D_X_UBYTE AXIS_PTS_X 1 UBYTE INDEX_INCR DIRECT /end RECORD_LAYOUT
/begin RECORD_LAYOUT Lookup2D_BYTE FNC_VALUES 1 SBYTE COLUMN_DIR DIRECT /end RECORD_LAYOUT
/begin RECORD_LAYOUT Lookup2D_X_BYTE AXIS_PTS_X 1 SBYTE INDEX_INCR DIRECT /end RECORD_LAYOUT
/begin RECORD_LAYOUT Lookup2D_UWORD FNC_VALUES 1 UWORD COLUMN_DIR DIRECT /end RECORD_LAYOUT
/begin RECORD_LAYOUT Lookup2D_X_UWORD AXIS_PTS_X 1 UWORD INDEX_INCR DIRECT /end RECORD_LAYOUT
/begin RECORD_LAYOUT Lookup2D_WORD FNC_VALUES 1 SWORD COLUMN_DIR DIRECT /end RECORD_LAYOUT
/begin RECORD_LAYOUT Lookup2D_X_WORD AXIS_PTS_X 1 SWORD INDEX_INCR DIRECT /end RECORD_LAYOUT
/begin RECORD_LAYOUT Lookup2D_ULONG FNC_VALUES 1 ULONG COLUMN_DIR DIRECT /end RECORD_LAYOUT
/begin RECORD_LAYOUT Lookup2D_X_ULONG AXIS_PTS_X 1 ULONG INDEX_INCR DIRECT /end RECORD_LAYOUT
/begin RECORD_LAYOUT Lookup2D_LONG FNC_VALUES 1 SLONG COLUMN_DIR DIRECT /end RECORD_LAYOUT
/begin RECORD_LAYOUT Lookup2D_X_LONG AXIS_PTS_X 1 SLONG INDEX_INCR DIRECT /end RECORD_LAYOUT
/begin RECORD_LAYOUT Lookup2D_FLOAT32_IEEE FNC_VALUES 1 FLOAT32_IEEE COLUMN_DIR DIRECT /end RECORD_LAYOUT
/begin RECORD_LAYOUT Lookup2D_X_FLOAT32_IEEE AXIS_PTS_X 1 FLOAT32_IEEE INDEX_INCR DIRECT /end RECORD_LAYOUT
/begin RECORD_LAYOUT Lookup2D_FLOAT64_IEEE FNC_VALUES 1 FLOAT64_IEEE COLUMN_DIR DIRECT /end RECORD_LAYOUT
/begin RECORD_LAYOUT Lookup2D_X_FLOAT64_IEEE AXIS_PTS_X 1 FLOAT64_IEEE INDEX_INCR DIRECT /end RECORD_LAYOUT
/begin CHARACTERISTIC MDHP_HysOffset_Y_pct "" CURVE 0x0000 /* @ECU_Address@MDHP_HysOffset_Y_pct@ */ Lookup1D_FLOAT32_IEEE 0 SWC_FDC_type_CM_single_pct 0.0 120.0
 /begin AXIS_DESCR COM_AXIS NO_INPUT_QUANTITY SWC_FDC_type_CM_single_pct 12 0.0 120.0 AXIS_PTS_REF ADHP_HysOffset_X_pct /end AXIS_DESCR
/end CHARACTERISTIC
/begin AXIS_PTS ADHP_HysOffset_X_pct "" 0x0000 /* @ECU_Address@ADHP_HysOffset_X_pct@ */ NO_INPUT_QUANTITY Lookup1D_X_FLOAT32_IEEE 0 SWC_FDC_type_CM_single_pct 12 0.0 120.0 /end AXIS_PTS
/begin CHARACTERISTIC MTQD_AccelLimitInRange_Z_Gain "" MAP 0x0000 /* @ECU_Address@MTQD_AccelLimitInRange_Z_Gain@ */ Lookup2D_FLOAT32_IEEE 0 SWC_FDC_type_CM_single_Gain 0.0 1.0
 /begin AXIS_DESCR COM_AXIS NO_INPUT_QUANTITY SWC_FDC_type_CM_single_rpm 6 -100000.0 100000.0 AXIS_PTS_REF ATQD_AccelLimitInRange_X_rpm /end AXIS_DESCR
 /begin AXIS_DESCR COM_AXIS NO_INPUT_QUANTITY SWC_FDC_type_CM_single_Nm 9 -100000.0 100000.0 AXIS_PTS_REF ATQD_AccelLimitInRange_Y_Nm /end AXIS_DESCR
/end CHARACTERISTIC
/begin AXIS_PTS ATQD_AccelLimitInRange_Y_Nm "" 0x0000 /* @ECU_Address@ATQD_AccelLimitInRange_Y_Nm@ */ NO_INPUT_QUANTITY Lookup2D_X_FLOAT32_IEEE 0 SWC_FDC_type_CM_single_Nm 9 -100000.0 100000.0 /end AXIS_PTS
/begin AXIS_PTS ATQD_AccelLimitInRange_X_rpm "" 0x0000 /* @ECU_Address@ATQD_AccelLimitInRange_X_rpm@ */ NO_INPUT_QUANTITY Lookup2D_X_FLOAT32_IEEE 0 SWC_FDC_type_CM_single_rpm 6 -100000.0 100000.0 /end AXIS_PTS
/begin CHARACTERISTIC MTQD_BOSMapD_Z_pct "" MAP 0x0000 /* @ECU_Address@MTQD_BOSMapD_Z_pct@ */ Lookup2D_FLOAT32_IEEE 0 SWC_FDC_type_CM_single_pct 0.0 125.0
 /begin AXIS_DESCR COM_AXIS VTQD_TqTargetShaftSpd_rpm SWC_FDC_type_CM_single_rpm 4 -100000.0 100000.0 AXIS_PTS_REF ATQD_BOSMapD_X_rpm /end AXIS_DESCR
 /begin AXIS_DESCR COM_AXIS NO_INPUT_QUANTITY SWC_FDC_type_CM_single_pct 5 0.0 125.0 AXIS_PTS_REF ATQD_BOSMapD_Y_pct /end AXIS_DESCR
/end CHARACTERISTIC
/begin AXIS_PTS ATQD_BOSMapD_Y_pct "" 0x0000 /* @ECU_Address@ATQD_BOSMapD_Y_pct@ */ NO_INPUT_QUANTITY Lookup2D_X_FLOAT32_IEEE 0 SWC_FDC_type_CM_single_pct 5 0.0 125.0 /end AXIS_PTS
/begin AXIS_PTS ATQD_BOSMapD_X_rpm "" 0x0000 /* @ECU_Address@ATQD_BOSMapD_X_rpm@ */ VTQD_TqTargetShaftSpd_rpm Lookup2D_X_FLOAT32_IEEE 0 SWC_FDC_type_CM_single_rpm 4 -100000.0 100000.0 /end AXIS_PTS
/begin CHARACTERISTIC MTQD_BOSMapR_Z_pct "" MAP 0x0000 /* @ECU_Address@MTQD_BOSMapR_Z_pct@ */ Lookup2D_FLOAT32_IEEE 0 SWC_FDC_type_CM_single_pct 0.0 125.0
 /begin AXIS_DESCR COM_AXIS VTQD_TqTargetShaftSpd_rpm SWC_FDC_type_CM_single_rpm 4 -100000.0 100000.0 AXIS_PTS_REF ATQD_BOSMapR_X_rpm /end AXIS_DESCR
 /begin AXIS_DESCR COM_AXIS NO_INPUT_QUANTITY SWC_FDC_type_CM_single_pct 5 0.0 125.0 AXIS_PTS_REF ATQD_BOSMapR_Y_pct /end AXIS_DESCR
/end CHARACTERISTIC
/begin AXIS_PTS ATQD_BOSMapR_Y_pct "" 0x0000 /* @ECU_Address@ATQD_BOSMapR_Y_pct@ */ NO_INPUT_QUANTITY Lookup2D_X_FLOAT32_IEEE 0 SWC_FDC_type_CM_single_pct 5 0.0 125.0 /end AXIS_PTS
/begin AXIS_PTS ATQD_BOSMapR_X_rpm "" 0x0000 /* @ECU_Address@ATQD_BOSMapR_X_rpm@ */ VTQD_TqTargetShaftSpd_rpm Lookup2D_X_FLOAT32_IEEE 0 SWC_FDC_type_CM_single_rpm 4 -100000.0 100000.0 /end AXIS_PTS
/begin CHARACTERISTIC MTQD_ConfortTqMapDLC_Z_Nm "" MAP 0x0000 /* @ECU_Address@MTQD_ConfortTqMapDLC_Z_Nm@ */ Lookup2D_FLOAT32_IEEE 0 SWC_FDC_type_CM_single_Nm -100000.0 100000.0
 /begin AXIS_DESCR COM_AXIS VTQD_TqTargetShaftSpd_rpm SWC_FDC_type_CM_single_rpm 31 -100000.0 100000.0 AXIS_PTS_REF ATQD_NormalMapDLC_X_rpm /end AXIS_DESCR
 /begin AXIS_DESCR COM_AXIS NO_INPUT_QUANTITY SWC_FDC_type_CM_single_pct 30 0.0 125.0 AXIS_PTS_REF ATQD_NormalMapDLC_Y_pct /end AXIS_DESCR
/end CHARACTERISTIC
/begin AXIS_PTS ATQD_NormalMapDLC_Y_pct "" 0x0000 /* @ECU_Address@ATQD_NormalMapDLC_Y_pct@ */ NO_INPUT_QUANTITY Lookup2D_X_FLOAT32_IEEE 0 SWC_FDC_type_CM_single_pct 30 0.0 125.0 /end AXIS_PTS
/begin AXIS_PTS ATQD_NormalMapDLC_X_rpm "" 0x0000 /* @ECU_Address@ATQD_NormalMapDLC_X_rpm@ */ VTQD_TqTargetShaftSpd_rpm Lookup2D_X_FLOAT32_IEEE 0 SWC_FDC_type_CM_single_rpm 31 -100000.0 100000.0 /end AXIS_PTS
/begin CHARACTERISTIC MTQD_ECOTqMapDLC_Z_Nm "" MAP 0x0000 /* @ECU_Address@MTQD_ECOTqMapDLC_Z_Nm@ */ Lookup2D_FLOAT32_IEEE 0 SWC_FDC_type_CM_single_Nm -100000.0 100000.0
 /begin AXIS_DESCR COM_AXIS VTQD_TqTargetShaftSpd_rpm SWC_FDC_type_CM_single_rpm 31 -100000.0 100000.0 AXIS_PTS_REF ATQD_NormalMapDLC_X_rpm /end AXIS_DESCR
 /begin AXIS_DESCR COM_AXIS NO_INPUT_QUANTITY SWC_FDC_type_CM_single_pct 30 0.0 125.0 AXIS_PTS_REF ATQD_NormalMapDLC_Y_pct /end AXIS_DESCR
/end CHARACTERISTIC
/begin CHARACTERISTIC MTQD_LHMTqMapDLC_Z_Nm "" MAP 0x0000 /* @ECU_Address@MTQD_LHMTqMapDLC_Z_Nm@ */ Lookup2D_FLOAT32_IEEE 0 SWC_FDC_type_CM_single_Nm -100000.0 100000.0
 /begin AXIS_DESCR COM_AXIS VTQD_TqTargetShaftSpd_rpm SWC_FDC_type_CM_single_rpm 31 -100000.0 100000.0 AXIS_PTS_REF ATQD_LHMTqMapDLC_X_rpm /end AXIS_DESCR
 /begin AXIS_DESCR COM_AXIS NO_INPUT_QUANTITY SWC_FDC_type_CM_single_pct 30 0.0 125.0 AXIS_PTS_REF ATQD_LHMTqMapDLC_Y_pct /end AXIS_DESCR
/end CHARACTERISTIC
/begin AXIS_PTS ATQD_LHMTqMapDLC_Y_pct "" 0x0000 /* @ECU_Address@ATQD_LHMTqMapDLC_Y_pct@ */ NO_INPUT_QUANTITY Lookup2D_X_FLOAT32_IEEE 0 SWC_FDC_type_CM_single_pct 30 0.0 125.0 /end AXIS_PTS
/begin AXIS_PTS ATQD_LHMTqMapDLC_X_rpm "" 0x0000 /* @ECU_Address@ATQD_LHMTqMapDLC_X_rpm@ */ VTQD_TqTargetShaftSpd_rpm Lookup2D_X_FLOAT32_IEEE 0 SWC_FDC_type_CM_single_rpm 31 -100000.0 100000.0 /end AXIS_PTS
/begin CHARACTERISTIC MTQD_LHMTqMapRLC_Z_Nm "" MAP 0x0000 /* @ECU_Address@MTQD_LHMTqMapRLC_Z_Nm@ */ Lookup2D_FLOAT32_IEEE 0 SWC_FDC_type_CM_single_Nm -100000.0 100000.0
 /begin AXIS_DESCR COM_AXIS VTQD_TqTargetShaftSpd_rpm SWC_FDC_type_CM_single_rpm 31 -100000.0 100000.0 AXIS_PTS_REF ATQD_LHMTqMapRLC_X_rpm /end AXIS_DESCR
 /begin AXIS_DESCR COM_AXIS NO_INPUT_QUANTITY SWC_FDC_type_CM_single_pct 30 0.0 125.0 AXIS_PTS_REF ATQD_LHMTqMapRLC_Y_pct /end AXIS_DESCR
/end CHARACTERISTIC
/begin AXIS_PTS ATQD_LHMTqMapRLC_Y_pct "" 0x0000 /* @ECU_Address@ATQD_LHMTqMapRLC_Y_pct@ */ NO_INPUT_QUANTITY Lookup2D_X_FLOAT32_IEEE 0 SWC_FDC_type_CM_single_pct 30 0.0 125.0 /end AXIS_PTS
/begin AXIS_PTS ATQD_LHMTqMapRLC_X_rpm "" 0x0000 /* @ECU_Address@ATQD_LHMTqMapRLC_X_rpm@ */ VTQD_TqTargetShaftSpd_rpm Lookup2D_X_FLOAT32_IEEE 0 SWC_FDC_type_CM_single_rpm 31 -100000.0 100000.0 /end AXIS_PTS
/begin CHARACTERISTIC MTQD_NormalMapDLC_Z_Nm "" MAP 0x0000 /* @ECU_Address@MTQD_NormalMapDLC_Z_Nm@ */ Lookup2D_FLOAT32_IEEE 0 SWC_FDC_type_CM_single_Nm -100000.0 100000.0
 /begin AXIS_DESCR COM_AXIS VTQD_TqTargetShaftSpd_rpm SWC_FDC_type_CM_single_rpm 31 -100000.0 100000.0 AXIS_PTS_REF ATQD_NormalMapDLC_X_rpm /end AXIS_DESCR
 /begin AXIS_DESCR COM_AXIS NO_INPUT_QUANTITY SWC_FDC_type_CM_single_pct 30 0.0 125.0 AXIS_PTS_REF ATQD_NormalMapDLC_Y_pct /end AXIS_DESCR
/end CHARACTERISTIC
/begin CHARACTERISTIC MTQD_OPDMapRLC_Z_Nm "" MAP 0x0000 /* @ECU_Address@MTQD_OPDMapRLC_Z_Nm@ */ Lookup2D_FLOAT32_IEEE 0 SWC_FDC_type_CM_single_Nm -100000.0 100000.0
 /begin AXIS_DESCR COM_AXIS VTQD_TqTargetShaftSpd_rpm SWC_FDC_type_CM_single_rpm 31 -100000.0 100000.0 AXIS_PTS_REF ATQD_OPDMapRLC_X_rpm /end AXIS_DESCR
 /begin AXIS_DESCR COM_AXIS NO_INPUT_QUANTITY SWC_FDC_type_CM_single_pct 30 0.0 125.0 AXIS_PTS_REF ATQD_OPDMapRLC_Y_pct /end AXIS_DESCR
/end CHARACTERISTIC
/begin AXIS_PTS ATQD_OPDMapRLC_Y_pct "" 0x0000 /* @ECU_Address@ATQD_OPDMapRLC_Y_pct@ */ NO_INPUT_QUANTITY Lookup2D_X_FLOAT32_IEEE 0 SWC_FDC_type_CM_single_pct 30 0.0 125.0 /end AXIS_PTS
/begin AXIS_PTS ATQD_OPDMapRLC_X_rpm "" 0x0000 /* @ECU_Address@ATQD_OPDMapRLC_X_rpm@ */ VTQD_TqTargetShaftSpd_rpm Lookup2D_X_FLOAT32_IEEE 0 SWC_FDC_type_CM_single_rpm 31 -100000.0 100000.0 /end AXIS_PTS
/begin CHARACTERISTIC MTQD_ConfortTqDecSR_Z_Nm "" MAP 0x0000 /* @ECU_Address@MTQD_ConfortTqDecSR_Z_Nm@ */ Lookup2D_FLOAT32_IEEE 0 SWC_FDC_type_CM_single_Nm -100000.0 0.0
 /begin AXIS_DESCR COM_AXIS NO_INPUT_QUANTITY SWC_FDC_type_CM_single_rpm 16 -100000.0 100000.0 AXIS_PTS_REF ATQD_NormalTqDecSR_X_rpm /end AXIS_DESCR
 /begin AXIS_DESCR COM_AXIS NO_INPUT_QUANTITY SWC_FDC_type_CM_single_Nm 11 -100000.0 100000.0 AXIS_PTS_REF ATQD_NormalTqDecSR_Y_Nm /end AXIS_DESCR
/end CHARACTERISTIC
/begin AXIS_PTS ATQD_NormalTqDecSR_Y_Nm "" 0x0000 /* @ECU_Address@ATQD_NormalTqDecSR_Y_Nm@ */ NO_INPUT_QUANTITY Lookup2D_X_FLOAT32_IEEE 0 SWC_FDC_type_CM_single_Nm 11 -100000.0 100000.0 /end AXIS_PTS
/begin AXIS_PTS ATQD_NormalTqDecSR_X_rpm "" 0x0000 /* @ECU_Address@ATQD_NormalTqDecSR_X_rpm@ */ NO_INPUT_QUANTITY Lookup2D_X_FLOAT32_IEEE 0 SWC_FDC_type_CM_single_rpm 16 -100000.0 100000.0 /end AXIS_PTS
/begin CHARACTERISTIC MTQD_ConfortTqIncSR_Z_Nm "" MAP 0x0000 /* @ECU_Address@MTQD_ConfortTqIncSR_Z_Nm@ */ Lookup2D_FLOAT32_IEEE 0 SWC_FDC_type_CM_single_Nm 0.0 100000.0
 /begin AXIS_DESCR COM_AXIS NO_INPUT_QUANTITY SWC_FDC_type_CM_single_rpm 16 -100000.0 100000.0 AXIS_PTS_REF ATQD_NormalTqIncSR_X_rpm /end AXIS_DESCR
 /begin AXIS_DESCR COM_AXIS NO_INPUT_QUANTITY SWC_FDC_type_CM_single_Nm 11 -100000.0 100000.0 AXIS_PTS_REF ATQD_NormalTqIncSR_Y_Nm /end AXIS_DESCR
/end CHARACTERISTIC
/begin AXIS_PTS ATQD_NormalTqIncSR_Y_Nm "" 0x0000 /* @ECU_Address@ATQD_NormalTqIncSR_Y_Nm@ */ NO_INPUT_QUANTITY Lookup2D_X_FLOAT32_IEEE 0 SWC_FDC_type_CM_single_Nm 11 -100000.0 100000.0 /end AXIS_PTS
/begin AXIS_PTS ATQD_NormalTqIncSR_X_rpm "" 0x0000 /* @ECU_Address@ATQD_NormalTqIncSR_X_rpm@ */ NO_INPUT_QUANTITY Lookup2D_X_FLOAT32_IEEE 0 SWC_FDC_type_CM_single_rpm 16 -100000.0 100000.0 /end AXIS_PTS
/begin CHARACTERISTIC MTQD_ECOTqDecSR_Z_Nm "" MAP 0x0000 /* @ECU_Address@MTQD_ECOTqDecSR_Z_Nm@ */ Lookup2D_FLOAT32_IEEE 0 SWC_FDC_type_CM_single_Nm -100000.0 0.0
 /begin AXIS_DESCR COM_AXIS NO_INPUT_QUANTITY SWC_FDC_type_CM_single_rpm 16 -100000.0 100000.0 AXIS_PTS_REF ATQD_NormalTqDecSR_X_rpm /end AXIS_DESCR
 /begin AXIS_DESCR COM_AXIS NO_INPUT_QUANTITY SWC_FDC_type_CM_single_Nm 11 -100000.0 100000.0 AXIS_PTS_REF ATQD_NormalTqDecSR_Y_Nm /end AXIS_DESCR
/end CHARACTERISTIC
/begin CHARACTERISTIC MTQD_ECOTqIncSR_Z_Nm "" MAP 0x0000 /* @ECU_Address@MTQD_ECOTqIncSR_Z_Nm@ */ Lookup2D_FLOAT32_IEEE 0 SWC_FDC_type_CM_single_NM 0.0 100000.0
 /begin AXIS_DESCR COM_AXIS NO_INPUT_QUANTITY SWC_FDC_type_CM_single_rpm 16 -100000.0 100000.0 AXIS_PTS_REF ATQD_NormalTqIncSR_X_rpm /end AXIS_DESCR
 /begin AXIS_DESCR COM_AXIS NO_INPUT_QUANTITY SWC_FDC_type_CM_single_Nm 11 -100000.0 100000.0 AXIS_PTS_REF ATQD_NormalTqIncSR_Y_Nm /end AXIS_DESCR
/end CHARACTERISTIC
/begin CHARACTERISTIC MTQD_NormalTqDecSR_Z_Nm "" MAP 0x0000 /* @ECU_Address@MTQD_NormalTqDecSR_Z_Nm@ */ Lookup2D_FLOAT32_IEEE 0 SWC_FDC_type_CM_single_Nm -100000.0 0.0
 /begin AXIS_DESCR COM_AXIS NO_INPUT_QUANTITY SWC_FDC_type_CM_single_rpm 16 -100000.0 100000.0 AXIS_PTS_REF ATQD_NormalTqDecSR_X_rpm /end AXIS_DESCR
 /begin AXIS_DESCR COM_AXIS NO_INPUT_QUANTITY SWC_FDC_type_CM_single_Nm 11 -100000.0 100000.0 AXIS_PTS_REF ATQD_NormalTqDecSR_Y_Nm /end AXIS_DESCR
/end CHARACTERISTIC
/begin CHARACTERISTIC MTQD_NormalTqIncSR_Z_Nm "" MAP 0x0000 /* @ECU_Address@MTQD_NormalTqIncSR_Z_Nm@ */ Lookup2D_FLOAT32_IEEE 0 SWC_FDC_type_CM_single_NM 0.0 100000.0
 /begin AXIS_DESCR COM_AXIS NO_INPUT_QUANTITY SWC_FDC_type_CM_single_rpm 16 -100000.0 100000.0 AXIS_PTS_REF ATQD_NormalTqIncSR_X_rpm /end AXIS_DESCR
 /begin AXIS_DESCR COM_AXIS NO_INPUT_QUANTITY SWC_FDC_type_CM_single_Nm 11 -100000.0 100000.0 AXIS_PTS_REF ATQD_NormalTqIncSR_Y_Nm /end AXIS_DESCR
/end CHARACTERISTIC
/begin CHARACTERISTIC MTQD_RollRegTorReq_Z_Nm "" MAP 0x0000 /* @ECU_Address@MTQD_RollRegTorReq_Z_Nm@ */ Lookup2D_FLOAT32_IEEE 0 SWC_FDC_type_CM_single_Nm -1000.0 1000.0
 /begin AXIS_DESCR COM_AXIS NO_INPUT_QUANTITY SWC_FDC_type_CM_single_rpm 10 0.0 3500.0 AXIS_PTS_REF ATQD_RollRegTorReq_X_rpm /end AXIS_DESCR
 /begin AXIS_DESCR COM_AXIS NO_INPUT_QUANTITY SWC_FDC_type_CM_single_enum 4 0.0 3.0 AXIS_PTS_REF ATQD_RollRegTorReq_Y_enum /end AXIS_DESCR
/end CHARACTERISTIC
/begin AXIS_PTS ATQD_RollRegTorReq_Y_enum "" 0x0000 /* @ECU_Address@ATQD_RollRegTorReq_Y_enum@ */ NO_INPUT_QUANTITY Lookup2D_X_FLOAT32_IEEE 0 SWC_FDC_type_CM_single_enum 4 0.0 3.0 /end AXIS_PTS
/begin AXIS_PTS ATQD_RollRegTorReq_X_rpm "" 0x0000 /* @ECU_Address@ATQD_RollRegTorReq_X_rpm@ */ NO_INPUT_QUANTITY Lookup2D_X_FLOAT32_IEEE 0 SWC_FDC_type_CM_single_rpm 10 0.0 3500.0 /end AXIS_PTS
/begin CHARACTERISTIC MTQD_VehSpdLimitInRange_Z_Gain "" MAP 0x0000 /* @ECU_Address@MTQD_VehSpdLimitInRange_Z_Gain@ */ Lookup2D_FLOAT32_IEEE 0 SWC_FDC_type_CM_single_Gain 0.0 1.0
 /begin AXIS_DESCR COM_AXIS NO_INPUT_QUANTITY SWC_FDC_type_CM_single_rpm 6 -100000.0 100000.0 AXIS_PTS_REF ATQD_VehSpdLimitInRange_X_rpm /end AXIS_DESCR
 /begin AXIS_DESCR COM_AXIS NO_INPUT_QUANTITY SWC_FDC_type_CM_single_Nm 9 -100000.0 100000.0 AXIS_PTS_REF ATQD_VehSpdLimitInRange_Y_Nm /end AXIS_DESCR
/end CHARACTERISTIC
/begin AXIS_PTS ATQD_VehSpdLimitInRange_Y_Nm "" 0x0000 /* @ECU_Address@ATQD_VehSpdLimitInRange_Y_Nm@ */ NO_INPUT_QUANTITY Lookup2D_X_FLOAT32_IEEE 0 SWC_FDC_type_CM_single_Nm 9 -100000.0 100000.0 /end AXIS_PTS
/begin AXIS_PTS ATQD_VehSpdLimitInRange_X_rpm "" 0x0000 /* @ECU_Address@ATQD_VehSpdLimitInRange_X_rpm@ */ NO_INPUT_QUANTITY Lookup2D_X_FLOAT32_IEEE 0 SWC_FDC_type_CM_single_rpm 6 -100000.0 100000.0 /end AXIS_PTS
/begin CHARACTERISTIC MTQD_HVBCurrSmooth_Y_gain "" CURVE 0x0000 /* @ECU_Address@MTQD_HVBCurrSmooth_Y_gain@ */ Lookup1D_FLOAT32_IEEE 0 SWC_FDC_type_CM_single_gain -100000.0 100000.0
 /begin AXIS_DESCR COM_AXIS NO_INPUT_QUANTITY SWC_FDC_type_CM_single_A 4 -100000.0 100000.0 AXIS_PTS_REF ATQD_HVBCurrSmooth_X_A /end AXIS_DESCR
/end CHARACTERISTIC
/begin AXIS_PTS ATQD_HVBCurrSmooth_X_A "" 0x0000 /* @ECU_Address@ATQD_HVBCurrSmooth_X_A@ */ NO_INPUT_QUANTITY Lookup1D_X_FLOAT32_IEEE 0 SWC_FDC_type_CM_single_A 4 -100000.0 100000.0 /end AXIS_PTS
/begin CHARACTERISTIC MTQD_AccelLimitOvrKi_Y_Gain "" CURVE 0x0000 /* @ECU_Address@MTQD_AccelLimitOvrKi_Y_Gain@ */ Lookup1D_FLOAT32_IEEE 0 SWC_FDC_type_CM_single_Gain -100000.0 100000.0
 /begin AXIS_DESCR COM_AXIS NO_INPUT_QUANTITY SWC_FDC_type_CM_single_Nm 10 -100000.0 100000.0 AXIS_PTS_REF ATQD_AccelLimitOvrKi_X_Nm /end AXIS_DESCR
/end CHARACTERISTIC
/begin AXIS_PTS ATQD_AccelLimitOvrKi_X_Nm "" 0x0000 /* @ECU_Address@ATQD_AccelLimitOvrKi_X_Nm@ */ NO_INPUT_QUANTITY Lookup1D_X_FLOAT32_IEEE 0 SWC_FDC_type_CM_single_Nm 10 -100000.0 100000.0 /end AXIS_PTS
/begin CHARACTERISTIC MTQD_AccelLimitOvrKp_Y_Gain "" CURVE 0x0000 /* @ECU_Address@MTQD_AccelLimitOvrKp_Y_Gain@ */ Lookup1D_FLOAT32_IEEE 0 SWC_FDC_type_CM_single_Gain -100000.0 100000.0
 /begin AXIS_DESCR COM_AXIS NO_INPUT_QUANTITY SWC_FDC_type_CM_single_Nm 10 -100000.0 100000.0 AXIS_PTS_REF ATQD_AccelLimitOvrKp_X_Nm /end AXIS_DESCR
/end CHARACTERISTIC
/begin AXIS_PTS ATQD_AccelLimitOvrKp_X_Nm "" 0x0000 /* @ECU_Address@ATQD_AccelLimitOvrKp_X_Nm@ */ NO_INPUT_QUANTITY Lookup1D_X_FLOAT32_IEEE 0 SWC_FDC_type_CM_single_Nm 10 -100000.0 100000.0 /end AXIS_PTS
/begin CHARACTERISTIC MTQD_VehSpdLimitOvrKi_Y_Gain "" CURVE 0x0000 /* @ECU_Address@MTQD_VehSpdLimitOvrKi_Y_Gain@ */ Lookup1D_FLOAT32_IEEE 0 SWC_FDC_type_CM_single_Gain -100000.0 100000.0
 /begin AXIS_DESCR COM_AXIS NO_INPUT_QUANTITY SWC_FDC_type_CM_single_Nm 10 -100000.0 100000.0 AXIS_PTS_REF ATQD_VehSpdLimitOvrKi_X_Nm /end AXIS_DESCR
/end CHARACTERISTIC
/begin AXIS_PTS ATQD_VehSpdLimitOvrKi_X_Nm "" 0x0000 /* @ECU_Address@ATQD_VehSpdLimitOvrKi_X_Nm@ */ NO_INPUT_QUANTITY Lookup1D_X_FLOAT32_IEEE 0 SWC_FDC_type_CM_single_Nm 10 -100000.0 100000.0 /end AXIS_PTS
/begin CHARACTERISTIC MTQD_VehSpdLimitOvrKp_Y_Gain "" CURVE 0x0000 /* @ECU_Address@MTQD_VehSpdLimitOvrKp_Y_Gain@ */ Lookup1D_FLOAT32_IEEE 0 SWC_FDC_type_CM_single_Gain -100000.0 100000.0
 /begin AXIS_DESCR COM_AXIS NO_INPUT_QUANTITY SWC_FDC_type_CM_single_Nm 10 -100000.0 100000.0 AXIS_PTS_REF ATQD_VehSpdLimitOvrKp_X_Nm /end AXIS_DESCR
/end CHARACTERISTIC
/begin AXIS_PTS ATQD_VehSpdLimitOvrKp_X_Nm "" 0x0000 /* @ECU_Address@ATQD_VehSpdLimitOvrKp_X_Nm@ */ NO_INPUT_QUANTITY Lookup1D_X_FLOAT32_IEEE 0 SWC_FDC_type_CM_single_Nm 10 -100000.0 100000.0 /end AXIS_PTS
/begin CHARACTERISTIC KDHP_AccPedalDepressed_pct "" VALUE 0x0000 /* @ECU_Address@KDHP_AccPedalDepressed_pct@ */ Scalar_FLOAT32_IEEE 0 SWC_FDC_type_CM_single_deg 0.0 20.0 /end CHARACTERISTIC
/begin CHARACTERISTIC KDHP_AccPedalReleased_pct "" VALUE 0x0000 /* @ECU_Address@KDHP_AccPedalReleased_pct@ */ Scalar_FLOAT32_IEEE 0 SWC_FDC_type_CM_single_deg 0.0 20.0 /end CHARACTERISTIC
/begin CHARACTERISTIC KDHP_AcceleratorLoadScalr_gain "" VALUE 0x0000 /* @ECU_Address@KDHP_AcceleratorLoadScalr_gain@ */ Scalar_FLOAT32_IEEE 0 SWC_FDC_type_CM_single_gain 0.0 3.0 /end CHARACTERISTIC
/begin CHARACTERISTIC KDHP_ActAPSPosn_pct_ovrdval "" VALUE 0x0000 /* @ECU_Address@KDHP_ActAPSPosn_pct_ovrdval@ */ Scalar_FLOAT32_IEEE 0 SWC_FDC_type_CM_single_pct 0.0 120.0 /end CHARACTERISTIC
/begin CHARACTERISTIC KDHP_DeadBand_pct "" VALUE 0x0000 /* @ECU_Address@KDHP_DeadBand_pct@ */ Scalar_FLOAT32_IEEE 0 SWC_FDC_type_CM_single_pct 0.0 100.0 /end CHARACTERISTIC
/begin CHARACTERISTIC KDHP_EAPS11OutWT_gain "" VALUE 0x0000 /* @ECU_Address@KDHP_EAPS11OutWT_gain@ */ Scalar_FLOAT32_IEEE 0 SWC_FDC_type_CM_single_gain 0.0 1.0 /end CHARACTERISTIC
/begin CHARACTERISTIC KDHP_EAPS12DisagreeTime_s "" VALUE 0x0000 /* @ECU_Address@KDHP_EAPS12DisagreeTime_s@ */ Scalar_FLOAT32_IEEE 0 SWC_FDC_type_CM_single_sec 0.0 10.0 /end CHARACTERISTIC
/begin CHARACTERISTIC KDHP_EAPS12Disagree_pct "" VALUE 0x0000 /* @ECU_Address@KDHP_EAPS12Disagree_pct@ */ Scalar_FLOAT32_IEEE 0 SWC_FDC_type_CM_single_pct 0.0 100.0 /end CHARACTERISTIC
/begin CHARACTERISTIC KDHP_EAPS12OutWT_gain "" VALUE 0x0000 /* @ECU_Address@KDHP_EAPS12OutWT_gain@ */ Scalar_FLOAT32_IEEE 0 SWC_FDC_type_CM_single_gain 0.0 1.0 /end CHARACTERISTIC
/begin CHARACTERISTIC KDHP_EAPS1AOutWT_gain "" VALUE 0x0000 /* @ECU_Address@KDHP_EAPS1AOutWT_gain@ */ Scalar_FLOAT32_IEEE 0 SWC_FDC_type_CM_single_gain 0.0 1.0 /end CHARACTERISTIC
/begin CHARACTERISTIC KDHP_EAPS1BADHigh_pct "" VALUE 0x0000 /* @ECU_Address@KDHP_EAPS1BADHigh_pct@ */ Scalar_FLOAT32_IEEE 0 SWC_FDC_type_CM_single_pct 70.0 120.0 /end CHARACTERISTIC
/begin CHARACTERISTIC KDHP_EAPS1BADLow_pct "" VALUE 0x0000 /* @ECU_Address@KDHP_EAPS1BADLow_pct@ */ Scalar_FLOAT32_IEEE 0 SWC_FDC_type_CM_single_pct 0.0 30.0 /end CHARACTERISTIC
/begin CHARACTERISTIC KDHP_EAPS1BADTime_s "" VALUE 0x0000 /* @ECU_Address@KDHP_EAPS1BADTime_s@ */ Scalar_FLOAT32_IEEE 0 SWC_FDC_type_CM_single_sec 0.0 10.0 /end CHARACTERISTIC
/begin CHARACTERISTIC KDHP_EAPS1MINInitLowLim_pct "" VALUE 0x0000 /* @ECU_Address@KDHP_EAPS1MINInitLowLim_pct@ */ Scalar_FLOAT32_IEEE 0 SWC_FDC_type_CM_single_pct 0.0 100.0 /end CHARACTERISTIC
/begin CHARACTERISTIC KDHP_EAPS1MINInitUpLim_pct "" VALUE 0x0000 /* @ECU_Address@KDHP_EAPS1MINInitUpLim_pct@ */ Scalar_FLOAT32_IEEE 0 SWC_FDC_type_CM_single_pct 0.0 100.0 /end CHARACTERISTIC
/begin CHARACTERISTIC KDHP_EAPS1Min_pct_ovrdval "" VALUE 0x0000 /* @ECU_Address@KDHP_EAPS1Min_pct_ovrdval@ */ Scalar_FLOAT32_IEEE 0 SWC_FDC_type_CM_single_pct 0.0 100.0 /end CHARACTERISTIC
/begin CHARACTERISTIC KDHP_EAPS1WT_gain "" VALUE 0x0000 /* @ECU_Address@KDHP_EAPS1WT_gain@ */ Scalar_FLOAT32_IEEE 0 SWC_FDC_type_CM_single_gain 0.0 1.0 /end CHARACTERISTIC
/begin CHARACTERISTIC KDHP_EAPS21OutWT_gain "" VALUE 0x0000 /* @ECU_Address@KDHP_EAPS21OutWT_gain@ */ Scalar_FLOAT32_IEEE 0 SWC_FDC_type_CM_single_gain 0.0 1.0 /end CHARACTERISTIC
/begin CHARACTERISTIC KDHP_EAPS22OutWT_gain "" VALUE 0x0000 /* @ECU_Address@KDHP_EAPS22OutWT_gain@ */ Scalar_FLOAT32_IEEE 0 SWC_FDC_type_CM_single_gain 0.0 1.0 /end CHARACTERISTIC
/begin CHARACTERISTIC KDHP_EAPS2AOutWT_gain "" VALUE 0x0000 /* @ECU_Address@KDHP_EAPS2AOutWT_gain@ */ Scalar_FLOAT32_IEEE 0 SWC_FDC_type_CM_single_gain 0.0 1.0 /end CHARACTERISTIC
/begin CHARACTERISTIC KDHP_EAPS2BADHigh_pct "" VALUE 0x0000 /* @ECU_Address@KDHP_EAPS2BADHigh_pct@ */ Scalar_FLOAT32_IEEE 0 SWC_FDC_type_CM_single_pct 30.0 60.0 /end CHARACTERISTIC
/begin CHARACTERISTIC KDHP_EAPS2BADLow_pct "" VALUE 0x0000 /* @ECU_Address@KDHP_EAPS2BADLow_pct@ */ Scalar_FLOAT32_IEEE 0 SWC_FDC_type_CM_single_pct 0.0 30.0 /end CHARACTERISTIC
/begin CHARACTERISTIC KDHP_EAPS2BADTime_s "" VALUE 0x0000 /* @ECU_Address@KDHP_EAPS2BADTime_s@ */ Scalar_FLOAT32_IEEE 0 SWC_FDC_type_CM_single_sec 0.0 10.0 /end CHARACTERISTIC
/begin CHARACTERISTIC KDHP_EAPS2MINInitLowLim_pct "" VALUE 0x0000 /* @ECU_Address@KDHP_EAPS2MINInitLowLim_pct@ */ Scalar_FLOAT32_IEEE 0 SWC_FDC_type_CM_single_pct 0.0 100.0 /end CHARACTERISTIC
/begin CHARACTERISTIC KDHP_EAPS2MINInitUpLim_pct "" VALUE 0x0000 /* @ECU_Address@KDHP_EAPS2MINInitUpLim_pct@ */ Scalar_FLOAT32_IEEE 0 SWC_FDC_type_CM_single_pct 0.0 100.0 /end CHARACTERISTIC
/begin CHARACTERISTIC KDHP_EAPS2Min_pct_ovrdval "" VALUE 0x0000 /* @ECU_Address@KDHP_EAPS2Min_pct_ovrdval@ */ Scalar_FLOAT32_IEEE 0 SWC_FDC_type_CM_single_pct 0.0 100.0 /end CHARACTERISTIC
/begin CHARACTERISTIC KDHP_EAPS2Offset_pct "" VALUE 0x0000 /* @ECU_Address@KDHP_EAPS2Offset_pct@ */ Scalar_FLOAT32_IEEE 0 SWC_FDC_type_CM_single_pct 0.0 30.0 /end CHARACTERISTIC
/begin CHARACTERISTIC KDHP_EAPS2Scaler_gain "" VALUE 0x0000 /* @ECU_Address@KDHP_EAPS2Scaler_gain@ */ Scalar_FLOAT32_IEEE 0 SWC_FDC_type_CM_single_gain 0.4 3.0 /end CHARACTERISTIC
/begin CHARACTERISTIC KDHP_EAPS2WT_gain "" VALUE 0x0000 /* @ECU_Address@KDHP_EAPS2WT_gain@ */ Scalar_FLOAT32_IEEE 0 SWC_FDC_type_CM_single_gain 0.0 1.0 /end CHARACTERISTIC
/begin CHARACTERISTIC KDHP_EAPSCRBadWDSP_pct "" VALUE 0x0000 /* @ECU_Address@KDHP_EAPSCRBadWDSP_pct@ */ Scalar_FLOAT32_IEEE 0 SWC_FDC_type_CM_single_pct 0.0 120.0 /end CHARACTERISTIC
/begin CHARACTERISTIC KDHP_EAPSLearnDwHigh_pct "" VALUE 0x0000 /* @ECU_Address@KDHP_EAPSLearnDwHigh_pct@ */ Scalar_FLOAT32_IEEE 0 SWC_FDC_type_CM_single_pct 0.0 50.0 /end CHARACTERISTIC
/begin CHARACTERISTIC KDHP_EAPSLearnDwLow_pct "" VALUE 0x0000 /* @ECU_Address@KDHP_EAPSLearnDwLow_pct@ */ Scalar_FLOAT32_IEEE 0 SWC_FDC_type_CM_single_pct 0.0 50.0 /end CHARACTERISTIC
/begin CHARACTERISTIC KDHP_EAPSLearnDwMAX_pct "" VALUE 0x0000 /* @ECU_Address@KDHP_EAPSLearnDwMAX_pct@ */ Scalar_FLOAT32_IEEE 0 SWC_FDC_type_CM_single_pct 0.0 50.0 /end CHARACTERISTIC
/begin CHARACTERISTIC KDHP_EAPSLearnUpHigh_pct "" VALUE 0x0000 /* @ECU_Address@KDHP_EAPSLearnUpHigh_pct@ */ Scalar_FLOAT32_IEEE 0 SWC_FDC_type_CM_single_pct 0.0 100.0 /end CHARACTERISTIC
/begin CHARACTERISTIC KDHP_EAPSLearnUpLow_pct "" VALUE 0x0000 /* @ECU_Address@KDHP_EAPSLearnUpLow_pct@ */ Scalar_FLOAT32_IEEE 0 SWC_FDC_type_CM_single_pct 0.0 100.0 /end CHARACTERISTIC
/begin CHARACTERISTIC KDHP_EAPSLearnUpOffset_pct "" VALUE 0x0000 /* @ECU_Address@KDHP_EAPSLearnUpOffset_pct@ */ Scalar_FLOAT32_IEEE 0 SWC_FDC_type_CM_single_pct 0.0 100.0 /end CHARACTERISTIC
/begin CHARACTERISTIC KDHP_EAPSMINLowerLimit_pct "" VALUE 0x0000 /* @ECU_Address@KDHP_EAPSMINLowerLimit_pct@ */ Scalar_FLOAT32_IEEE 0 SWC_FDC_type_CM_single_pct 0.0 100.0 /end CHARACTERISTIC
/begin CHARACTERISTIC KDHP_EAPSStableThrsh_pct "" VALUE 0x0000 /* @ECU_Address@KDHP_EAPSStableThrsh_pct@ */ Scalar_FLOAT32_IEEE 0 SWC_FDC_type_CM_single_pct 0.0 50.0 /end CHARACTERISTIC
/begin CHARACTERISTIC KDHP_EAPSStableTime_s "" VALUE 0x0000 /* @ECU_Address@KDHP_EAPSStableTime_s@ */ Scalar_FLOAT32_IEEE 0 SWC_FDC_type_CM_single_sec 0.0 10.0 /end CHARACTERISTIC
/begin CHARACTERISTIC KDHP_EPEDPOSNUpLimit_pct "" VALUE 0x0000 /* @ECU_Address@KDHP_EPEDPOSNUpLimit_pct@ */ Scalar_FLOAT32_IEEE 0 SWC_FDC_type_CM_single_pct 0.0 120.0 /end CHARACTERISTIC
/begin CHARACTERISTIC KDHP_GetNRMBaseTime_s "" VALUE 0x0000 /* @ECU_Address@KDHP_GetNRMBaseTime_s@ */ Scalar_FLOAT32_IEEE 0 SWC_FDC_type_CM_single_sec 0.0 10.0 /end CHARACTERISTIC
/begin CHARACTERISTIC KDHP_LVBattHighLimit_V "" VALUE 0x0000 /* @ECU_Address@KDHP_LVBattHighLimit_V@ */ Scalar_FLOAT32_IEEE 0 SWC_FDC_type_CM_single_V 0.0 30.0 /end CHARACTERISTIC
/begin CHARACTERISTIC KDHP_LVBattHigh_V "" VALUE 0x0000 /* @ECU_Address@KDHP_LVBattHigh_V@ */ Scalar_FLOAT32_IEEE 0 SWC_FDC_type_CM_single_V 0.0 30.0 /end CHARACTERISTIC
/begin CHARACTERISTIC KDHP_LVBattLow_V "" VALUE 0x0000 /* @ECU_Address@KDHP_LVBattLow_V@ */ Scalar_FLOAT32_IEEE 0 SWC_FDC_type_CM_single_V 0.0 30.0 /end CHARACTERISTIC
/begin CHARACTERISTIC KPMM_ActTimeHVILFail_s "" VALUE 0x0000 /* @ECU_Address@KPMM_ActTimeHVILFail_s@ */ Scalar_FLOAT32_IEEE 0 SWC_FDC_type_CM_single_s 0.0 3600.0 /end CHARACTERISTIC
/begin CHARACTERISTIC KPMM_ActTimeHVpwrOffReq_s "" VALUE 0x0000 /* @ECU_Address@KPMM_ActTimeHVpwrOffReq_s@ */ Scalar_FLOAT32_IEEE 0 SWC_FDC_type_CM_single_s 0.0 3600.0 /end CHARACTERISTIC
/begin CHARACTERISTIC KPMM_ActTimeMCUFail_s "" VALUE 0x0000 /* @ECU_Address@KPMM_ActTimeMCUFail_s@ */ Scalar_FLOAT32_IEEE 0 SWC_FDC_type_CM_single_s 0.0 3600.0 /end CHARACTERISTIC
/begin CHARACTERISTIC KPMM_ActTimePDUFail_s "" VALUE 0x0000 /* @ECU_Address@KPMM_ActTimePDUFail_s@ */ Scalar_FLOAT32_IEEE 0 SWC_FDC_type_CM_single_s 0.0 3600.0 /end CHARACTERISTIC
/begin CHARACTERISTIC KPMM_EHPSEnSpdDiv_rpm "" VALUE 0x0000 /* @ECU_Address@KPMM_EHPSEnSpdDiv_rpm@ */ Scalar_FLOAT32_IEEE 0 SWC_FDC_type_CM_single_rpm 0.0 1500.0 /end CHARACTERISTIC
/begin CHARACTERISTIC KPMM_EHPSIniHoldTime_s "" VALUE 0x0000 /* @ECU_Address@KPMM_EHPSIniHoldTime_s@ */ Scalar_FLOAT32_IEEE 0 SWC_FDC_type_CM_single_s 0.0 3600.0 /end CHARACTERISTIC
/begin CHARACTERISTIC KPMM_HVILDetFailDelayTime_s "" VALUE 0x0000 /* @ECU_Address@KPMM_HVILDetFailDelayTime_s@ */ Scalar_FLOAT32_IEEE 0 SWC_FDC_type_CM_single_s 0.0 3600.0 /end CHARACTERISTIC
/begin CHARACTERISTIC KPMM_HVRlyNoFBVehSpd_kph "" VALUE 0x0000 /* @ECU_Address@KPMM_HVRlyNoFBVehSpd_kph@ */ Scalar_FLOAT32_IEEE 0 SWC_FDC_type_CM_single_kph 0.0 255.0 /end CHARACTERISTIC
/begin CHARACTERISTIC KPMM_LVChrgDCDCDisTimer_s "" VALUE 0x0000 /* @ECU_Address@KPMM_LVChrgDCDCDisTimer_s@ */ Scalar_FLOAT32_IEEE 0 SWC_FDC_type_CM_single_s 0.0 10000.0 /end CHARACTERISTIC
/begin CHARACTERISTIC KPMM_LVChrgDCDCEnTimer_s "" VALUE 0x0000 /* @ECU_Address@KPMM_LVChrgDCDCEnTimer_s@ */ Scalar_FLOAT32_IEEE 0 SWC_FDC_type_CM_single_s 0.0 10000.0 /end CHARACTERISTIC
/begin CHARACTERISTIC KPMM_LVChrgDisHVSOC_pct "" VALUE 0x0000 /* @ECU_Address@KPMM_LVChrgDisHVSOC_pct@ */ Scalar_FLOAT32_IEEE 0 SWC_FDC_type_CM_single_pct 0.0 100.0 /end CHARACTERISTIC
/begin CHARACTERISTIC KPMM_LVChrgDisVoltageDet_V "" VALUE 0x0000 /* @ECU_Address@KPMM_LVChrgDisVoltageDet_V@ */ Scalar_FLOAT32_IEEE 0 SWC_FDC_type_CM_single_V 0.0 100.0 /end CHARACTERISTIC
/begin CHARACTERISTIC KPMM_LVChrgDisVoltageDur_V "" VALUE 0x0000 /* @ECU_Address@KPMM_LVChrgDisVoltageDur_V@ */ Scalar_FLOAT32_IEEE 0 SWC_FDC_type_CM_single_V 0.0 100.0 /end CHARACTERISTIC
/begin CHARACTERISTIC KPMM_LVChrgDuBrkLampFlash_cnt "" VALUE 0x0000 /* @ECU_Address@KPMM_LVChrgDuBrkLampFlash_cnt@ */ Scalar_FLOAT32_IEEE 0 SWC_FDC_type_CM_single_cnt 0.0 1000.0 /end CHARACTERISTIC
/begin CHARACTERISTIC KPMM_LVChrgDuBrkLampOFF_s "" VALUE 0x0000 /* @ECU_Address@KPMM_LVChrgDuBrkLampOFF_s@ */ Scalar_FLOAT32_IEEE 0 SWC_FDC_type_CM_single_s 0.0 3600.0 /end CHARACTERISTIC
/begin CHARACTERISTIC KPMM_LVChrgDuBrkLampON_s "" VALUE 0x0000 /* @ECU_Address@KPMM_LVChrgDuBrkLampON_s@ */ Scalar_FLOAT32_IEEE 0 SWC_FDC_type_CM_single_s 0.0 3600.0 /end CHARACTERISTIC
/begin CHARACTERISTIC KPMM_LVChrgDuBrkLampWait_s "" VALUE 0x0000 /* @ECU_Address@KPMM_LVChrgDuBrkLampWait_s@ */ Scalar_FLOAT32_IEEE 0 SWC_FDC_type_CM_single_s 0.0 3600.0 /end CHARACTERISTIC
/begin CHARACTERISTIC KPMM_LVChrgDuRBuzzerFlash_cnt "" VALUE 0x0000 /* @ECU_Address@KPMM_LVChrgDuRBuzzerFlash_cnt@ */ Scalar_FLOAT32_IEEE 0 SWC_FDC_type_CM_single_cnt 0.0 1000.0 /end CHARACTERISTIC
/begin CHARACTERISTIC KPMM_LVChrgDuRBuzzerOFF_s "" VALUE 0x0000 /* @ECU_Address@KPMM_LVChrgDuRBuzzerOFF_s@ */ Scalar_FLOAT32_IEEE 0 SWC_FDC_type_CM_single_s 0.0 3600.0 /end CHARACTERISTIC
/begin CHARACTERISTIC KPMM_LVChrgDuRBuzzerON_s "" VALUE 0x0000 /* @ECU_Address@KPMM_LVChrgDuRBuzzerON_s@ */ Scalar_FLOAT32_IEEE 0 SWC_FDC_type_CM_single_s 0.0 3600.0 /end CHARACTERISTIC
/begin CHARACTERISTIC KPMM_LVChrgDuRBuzzerWait_s "" VALUE 0x0000 /* @ECU_Address@KPMM_LVChrgDuRBuzzerWait_s@ */ Scalar_FLOAT32_IEEE 0 SWC_FDC_type_CM_single_s 0.0 3600.0 /end CHARACTERISTIC
/begin CHARACTERISTIC KPMM_LVChrgEnHVSOC_pct "" VALUE 0x0000 /* @ECU_Address@KPMM_LVChrgEnHVSOC_pct@ */ Scalar_FLOAT32_IEEE 0 SWC_FDC_type_CM_single_pct 0.0 100.0 /end CHARACTERISTIC
/begin CHARACTERISTIC KPMM_LVChrgEnVoltageDet_V "" VALUE 0x0000 /* @ECU_Address@KPMM_LVChrgEnVoltageDet_V@ */ Scalar_FLOAT32_IEEE 0 SWC_FDC_type_CM_single_V 0.0 100.0 /end CHARACTERISTIC
/begin CHARACTERISTIC KPMM_LVChrgEnVoltageDur_V "" VALUE 0x0000 /* @ECU_Address@KPMM_LVChrgEnVoltageDur_V@ */ Scalar_FLOAT32_IEEE 0 SWC_FDC_type_CM_single_V 0.0 100.0 /end CHARACTERISTIC
/begin CHARACTERISTIC KPMM_LVChrgPreActBrkLampFlash_cnt "" VALUE 0x0000 /* @ECU_Address@KPMM_LVChrgPreActBrkLampFlash_cnt@ */ Scalar_FLOAT32_IEEE 0 SWC_FDC_type_CM_single_cnt 0.0 1000.0 /end CHARACTERISTIC
/begin CHARACTERISTIC KPMM_LVChrgPreActBrkLampOFF_s "" VALUE 0x0000 /* @ECU_Address@KPMM_LVChrgPreActBrkLampOFF_s@ */ Scalar_FLOAT32_IEEE 0 SWC_FDC_type_CM_single_s 0.0 3600.0 /end CHARACTERISTIC
/begin CHARACTERISTIC KPMM_LVChrgPreActBrkLampON_s "" VALUE 0x0000 /* @ECU_Address@KPMM_LVChrgPreActBrkLampON_s@ */ Scalar_FLOAT32_IEEE 0 SWC_FDC_type_CM_single_s 0.0 3600.0 /end CHARACTERISTIC
/begin CHARACTERISTIC KPMM_LVChrgPreActBrkLampWait_s "" VALUE 0x0000 /* @ECU_Address@KPMM_LVChrgPreActBrkLampWait_s@ */ Scalar_FLOAT32_IEEE 0 SWC_FDC_type_CM_single_s 0.0 3600.0 /end CHARACTERISTIC
/begin CHARACTERISTIC KPMM_LVChrgPreActRBuzzerFlash_cnt "" VALUE 0x0000 /* @ECU_Address@KPMM_LVChrgPreActRBuzzerFlash_cnt@ */ Scalar_FLOAT32_IEEE 0 SWC_FDC_type_CM_single_cnt 0.0 1000.0 /end CHARACTERISTIC
/begin CHARACTERISTIC KPMM_LVChrgPreActRBuzzerOFF_s "" VALUE 0x0000 /* @ECU_Address@KPMM_LVChrgPreActRBuzzerOFF_s@ */ Scalar_FLOAT32_IEEE 0 SWC_FDC_type_CM_single_s 0.0 3600.0 /end CHARACTERISTIC
/begin CHARACTERISTIC KPMM_LVChrgPreActRBuzzerON_s "" VALUE 0x0000 /* @ECU_Address@KPMM_LVChrgPreActRBuzzerON_s@ */ Scalar_FLOAT32_IEEE 0 SWC_FDC_type_CM_single_s 0.0 3600.0 /end CHARACTERISTIC
/begin CHARACTERISTIC KPMM_LVChrgPreActRBuzzerWait_s "" VALUE 0x0000 /* @ECU_Address@KPMM_LVChrgPreActRBuzzerWait_s@ */ Scalar_FLOAT32_IEEE 0 SWC_FDC_type_CM_single_s 0.0 3600.0 /end CHARACTERISTIC
/begin CHARACTERISTIC KPMM_LVChrgPreActRLampFlash_cnt "" VALUE 0x0000 /* @ECU_Address@KPMM_LVChrgPreActRLampFlash_cnt@ */ Scalar_FLOAT32_IEEE 0 SWC_FDC_type_CM_single_cnt 0.0 1000.0 /end CHARACTERISTIC
/begin CHARACTERISTIC KPMM_LVChrgPreActRLampOFF_s "" VALUE 0x0000 /* @ECU_Address@KPMM_LVChrgPreActRLampOFF_s@ */ Scalar_FLOAT32_IEEE 0 SWC_FDC_type_CM_single_s 0.0 3600.0 /end CHARACTERISTIC
/begin CHARACTERISTIC KPMM_LVChrgPreActRLampON_s "" VALUE 0x0000 /* @ECU_Address@KPMM_LVChrgPreActRLampON_s@ */ Scalar_FLOAT32_IEEE 0 SWC_FDC_type_CM_single_s 0.0 3600.0 /end CHARACTERISTIC
/begin CHARACTERISTIC KPMM_LVChrgPreActRLampWait_s "" VALUE 0x0000 /* @ECU_Address@KPMM_LVChrgPreActRLampWait_s@ */ Scalar_FLOAT32_IEEE 0 SWC_FDC_type_CM_single_s 0.0 3600.0 /end CHARACTERISTIC
/begin CHARACTERISTIC KPMM_LVChrgPreAction_s "" VALUE 0x0000 /* @ECU_Address@KPMM_LVChrgPreAction_s@ */ Scalar_FLOAT32_IEEE 0 SWC_FDC_type_CM_single_s 0.0 3600.0 /end CHARACTERISTIC
/begin CHARACTERISTIC KPMM_LVChrgPreAlarm_s "" VALUE 0x0000 /* @ECU_Address@KPMM_LVChrgPreAlarm_s@ */ Scalar_FLOAT32_IEEE 0 SWC_FDC_type_CM_single_s 0.0 600.0 /end CHARACTERISTIC
/begin CHARACTERISTIC KPMM_LongIdleBuzzerFlashTime_s "" VALUE 0x0000 /* @ECU_Address@KPMM_LongIdleBuzzerFlashTime_s@ */ Scalar_FLOAT32_IEEE 0 SWC_FDC_type_CM_single_s 0.0 3600.0 /end CHARACTERISTIC
/begin CHARACTERISTIC KPMM_LongIdleBuzzerFlash_cnt "" VALUE 0x0000 /* @ECU_Address@KPMM_LongIdleBuzzerFlash_cnt@ */ Scalar_FLOAT32_IEEE 0 SWC_FDC_type_CM_single_cnt 0.0 1000.0 /end CHARACTERISTIC
/begin CHARACTERISTIC KPMM_LongIdleBuzzerOFF_s "" VALUE 0x0000 /* @ECU_Address@KPMM_LongIdleBuzzerOFF_s@ */ Scalar_FLOAT32_IEEE 0 SWC_FDC_type_CM_single_s 0.0 3600.0 /end CHARACTERISTIC
/begin CHARACTERISTIC KPMM_LongIdleBuzzerON_s "" VALUE 0x0000 /* @ECU_Address@KPMM_LongIdleBuzzerON_s@ */ Scalar_FLOAT32_IEEE 0 SWC_FDC_type_CM_single_s 0.0 3600.0 /end CHARACTERISTIC
/begin CHARACTERISTIC KPMM_LongIdleBuzzerWait_s "" VALUE 0x0000 /* @ECU_Address@KPMM_LongIdleBuzzerWait_s@ */ Scalar_FLOAT32_IEEE 0 SWC_FDC_type_CM_single_s 0.0 3600.0 /end CHARACTERISTIC
/begin CHARACTERISTIC KPMM_LongIdleDectMotorSpd_rpm "" VALUE 0x0000 /* @ECU_Address@KPMM_LongIdleDectMotorSpd_rpm@ */ Scalar_FLOAT32_IEEE 0 SWC_FDC_type_CM_single_rpm 0.0 100000.0 /end CHARACTERISTIC
/begin CHARACTERISTIC KPMM_LongIdleDectTime_s "" VALUE 0x0000 /* @ECU_Address@KPMM_LongIdleDectTime_s@ */ Scalar_FLOAT32_IEEE 0 SWC_FDC_type_CM_single_s 0.0 360000.0 /end CHARACTERISTIC
/begin CHARACTERISTIC KPMM_LongIdleDectVehSpd_kph "" VALUE 0x0000 /* @ECU_Address@KPMM_LongIdleDectVehSpd_kph@ */ Scalar_FLOAT32_IEEE 0 SWC_FDC_type_CM_single_kph 0.0 300.0 /end CHARACTERISTIC
/begin CHARACTERISTIC KPMM_LostComBCUPDVehSpd_kph "" VALUE 0x0000 /* @ECU_Address@KPMM_LostComBCUPDVehSpd_kph@ */ Scalar_FLOAT32_IEEE 0 SWC_FDC_type_CM_single_kph 0.0 255.0 /end CHARACTERISTIC
/begin CHARACTERISTIC KPMM_LostComMCUPDVehSpd_kph "" VALUE 0x0000 /* @ECU_Address@KPMM_LostComMCUPDVehSpd_kph@ */ Scalar_FLOAT32_IEEE 0 SWC_FDC_type_CM_single_kph 0.0 255.0 /end CHARACTERISTIC
/begin CHARACTERISTIC KPMM_LostComPDUPDVehSpd_kph "" VALUE 0x0000 /* @ECU_Address@KPMM_LostComPDUPDVehSpd_kph@ */ Scalar_FLOAT32_IEEE 0 SWC_FDC_type_CM_single_kph 0.0 255.0 /end CHARACTERISTIC
/begin CHARACTERISTIC KPMM_MCURCIncorrectVehSpd_kph "" VALUE 0x0000 /* @ECU_Address@KPMM_MCURCIncorrectVehSpd_kph@ */ Scalar_FLOAT32_IEEE 0 SWC_FDC_type_CM_single_kph 0.0 255.0 /end CHARACTERISTIC
/begin CHARACTERISTIC KPMM_MCUSta2Lost4Sleep_s "" VALUE 0x0000 /* @ECU_Address@KPMM_MCUSta2Lost4Sleep_s@ */ Scalar_FLOAT32_IEEE 0 SWC_FDC_type_CM_single_s 0.0 3600.0 /end CHARACTERISTIC
/begin CHARACTERISTIC KPMM_RCIncorrectVehSpd_kph "" VALUE 0x0000 /* @ECU_Address@KPMM_RCIncorrectVehSpd_kph@ */ Scalar_FLOAT32_IEEE 0 SWC_FDC_type_CM_single_kph 0.0 255.0 /end CHARACTERISTIC
/begin CHARACTERISTIC KTQD_APSPedLim4Creep_pct "" VALUE 0x0000 /* @ECU_Address@KTQD_APSPedLim4Creep_pct@ */ Scalar_FLOAT32_IEEE 0 SWC_FDC_type_CM_single_pct 0.0 100.0 /end CHARACTERISTIC
/begin CHARACTERISTIC KTQD_CAN1BusOffTrqLimit_Nm "" VALUE 0x0000 /* @ECU_Address@KTQD_CAN1BusOffTrqLimit_Nm@ */ Scalar_FLOAT32_IEEE 0 SWC_FDC_type_CM_single_Nm -100000.0 100000.0 /end CHARACTERISTIC
/begin CHARACTERISTIC KTQD_CANCELCountDetTime_s "" VALUE 0x0000 /* @ECU_Address@KTQD_CANCELCountDetTime_s@ */ Scalar_FLOAT32_IEEE 0 SWC_FDC_type_CM_single_s 0.0 3600.0 /end CHARACTERISTIC
/begin CHARACTERISTIC KTQD_CANCELUpCount_cnt "" VALUE 0x0000 /* @ECU_Address@KTQD_CANCELUpCount_cnt@ */ Scalar_FLOAT32_IEEE 0 SWC_FDC_type_CM_single_cnt 0.0 255.0 /end CHARACTERISTIC
/begin CHARACTERISTIC KTQD_ComboKeyAPSPedEn_pct "" VALUE 0x0000 /* @ECU_Address@KTQD_ComboKeyAPSPedEn_pct@ */ Scalar_FLOAT32_IEEE 0 SWC_FDC_type_CM_single_pct -10.0 125.0 /end CHARACTERISTIC
/begin CHARACTERISTIC KTQD_ComboKeyBPSPedEn_pct "" VALUE 0x0000 /* @ECU_Address@KTQD_ComboKeyBPSPedEn_pct@ */ Scalar_FLOAT32_IEEE 0 SWC_FDC_type_CM_single_pct -10.0 125.0 /end CHARACTERISTIC
/begin CHARACTERISTIC KTQD_ComboKeyDelay_s "" VALUE 0x0000 /* @ECU_Address@KTQD_ComboKeyDelay_s@ */ Scalar_FLOAT32_IEEE 0 SWC_FDC_type_CM_single_s 0.0 3600.0 /end CHARACTERISTIC
/begin CHARACTERISTIC KTQD_ComboKeyEnDelayTime_s "" VALUE 0x0000 /* @ECU_Address@KTQD_ComboKeyEnDelayTime_s@ */ Scalar_FLOAT32_IEEE 0 SWC_FDC_type_CM_single_s 0.0 3600.0 /end CHARACTERISTIC
/begin CHARACTERISTIC KTQD_ConfortTs_c "" VALUE 0x0000 /* @ECU_Address@KTQD_ConfortTs_c@ */ Scalar_FLOAT32_IEEE 0 SWC_FDC_type_CM_single_c 0.0 10.0 /end CHARACTERISTIC
/begin CHARACTERISTIC KTQD_CreepContinueOffset_s "" VALUE 0x0000 /* @ECU_Address@KTQD_CreepContinueOffset_s@ */ Scalar_FLOAT32_IEEE 0 SWC_FDC_type_CM_single_s 0.0 3600.0 /end CHARACTERISTIC
/begin CHARACTERISTIC KTQD_CreepContinueTO_s "" VALUE 0x0000 /* @ECU_Address@KTQD_CreepContinueTO_s@ */ Scalar_FLOAT32_IEEE 0 SWC_FDC_type_CM_single_s 0.0 3600.0 /end CHARACTERISTIC
/begin CHARACTERISTIC KTQD_CreepDisTMTorq_gain "" VALUE 0x0000 /* @ECU_Address@KTQD_CreepDisTMTorq_gain@ */ Scalar_FLOAT32_IEEE 0 SWC_FDC_type_CM_single_Gain 0.0 10.0 /end CHARACTERISTIC
/begin CHARACTERISTIC KTQD_CreepDisableSpd_kph "" VALUE 0x0000 /* @ECU_Address@KTQD_CreepDisableSpd_kph@ */ Scalar_FLOAT32_IEEE 0 SWC_FDC_type_CM_single_kph 0.0 20.0 /end CHARACTERISTIC
/begin CHARACTERISTIC KTQD_CreepEanbleSpd_kph "" VALUE 0x0000 /* @ECU_Address@KTQD_CreepEanbleSpd_kph@ */ Scalar_FLOAT32_IEEE 0 SWC_FDC_type_CM_single_kph 0.0 20.0 /end CHARACTERISTIC
/begin CHARACTERISTIC KTQD_CreepForcedDisaSpd_kph "" VALUE 0x0000 /* @ECU_Address@KTQD_CreepForcedDisaSpd_kph@ */ Scalar_FLOAT32_IEEE 0 SWC_FDC_type_CM_single_kph 0.0 100.0 /end CHARACTERISTIC
/begin CHARACTERISTIC KTQD_CreepSpdReq_ovrdval "" VALUE 0x0000 /* @ECU_Address@KTQD_CreepSpdReq_ovrdval@ */ Scalar_FLOAT32_IEEE 0 SWC_FDC_type_CM_single_rpm -2000.0 2000.0 /end CHARACTERISTIC
/begin CHARACTERISTIC KTQD_CreepTGMotorSpdCal_rpm "" VALUE 0x0000 /* @ECU_Address@KTQD_CreepTGMotorSpdCal_rpm@ */ Scalar_FLOAT32_IEEE 0 SWC_FDC_type_CM_single_rpm -2000.0 2000.0 /end CHARACTERISTIC
/begin CHARACTERISTIC KTQD_CreepTargetRamp_mps2 "" VALUE 0x0000 /* @ECU_Address@KTQD_CreepTargetRamp_mps2@ */ Scalar_FLOAT32_IEEE 0 SWC_FDC_type_CM_single_mps2 0.0 20.0 /end CHARACTERISTIC
/begin CHARACTERISTIC KTQD_CreepTargetSpdOffset_rpm "" VALUE 0x0000 /* @ECU_Address@KTQD_CreepTargetSpdOffset_rpm@ */ Scalar_FLOAT32_IEEE 0 SWC_FDC_type_CM_single_rpm -2000.0 2000.0 /end CHARACTERISTIC
/begin CHARACTERISTIC KTQD_CreepTargetSpd_kph "" VALUE 0x0000 /* @ECU_Address@KTQD_CreepTargetSpd_kph@ */ Scalar_FLOAT32_IEEE 0 SWC_FDC_type_CM_single_kph 0.0 20.0 /end CHARACTERISTIC
/begin CHARACTERISTIC KTQD_CreepTartgerSpdDiv_kph "" VALUE 0x0000 /* @ECU_Address@KTQD_CreepTartgerSpdDiv_kph@ */ Scalar_FLOAT32_IEEE 0 SWC_FDC_type_CM_single_kph 0.0 100.0 /end CHARACTERISTIC
/begin CHARACTERISTIC KTQD_CreepWarnTime_s "" VALUE 0x0000 /* @ECU_Address@KTQD_CreepWarnTime_s@ */ Scalar_FLOAT32_IEEE 0 SWC_FDC_type_CM_single_s 0.0 3600.0 /end CHARACTERISTIC
/begin CHARACTERISTIC KTQD_DDMSpdLimitation_rpm "" VALUE 0x0000 /* @ECU_Address@KTQD_DDMSpdLimitation_rpm@ */ Scalar_FLOAT32_IEEE 0 SWC_FDC_type_CM_single_rpm 0.0 15000.0 /end CHARACTERISTIC
/begin CHARACTERISTIC KTQD_DDMTrqLimitation_Nm "" VALUE 0x0000 /* @ECU_Address@KTQD_DDMTrqLimitation_Nm@ */ Scalar_FLOAT32_IEEE 0 SWC_FDC_type_CM_single_Nm -100000.0 100000.0 /end CHARACTERISTIC
/begin CHARACTERISTIC KTQD_ECOTs_c "" VALUE 0x0000 /* @ECU_Address@KTQD_ECOTs_c@ */ Scalar_FLOAT32_IEEE 0 SWC_FDC_type_CM_single_c 0.0 10.0 /end CHARACTERISTIC
/begin CHARACTERISTIC KTQD_ECPSetValErr1_kph "" VALUE 0x0000 /* @ECU_Address@KTQD_ECPSetValErr1_kph@ */ Scalar_FLOAT32_IEEE 0 SWC_FDC_type_CM_single_kph 0.0 255.0 /end CHARACTERISTIC
/begin CHARACTERISTIC KTQD_ECPSetValErr1_mps2 "" VALUE 0x0000 /* @ECU_Address@KTQD_ECPSetValErr1_mps2@ */ Scalar_FLOAT32_IEEE 0 SWC_FDC_type_CM_single_mps2 0.0 255.0 /end CHARACTERISTIC
/begin CHARACTERISTIC KTQD_ECPSetValNoReq_kph "" VALUE 0x0000 /* @ECU_Address@KTQD_ECPSetValNoReq_kph@ */ Scalar_FLOAT32_IEEE 0 SWC_FDC_type_CM_single_kph 0.0 255.0 /end CHARACTERISTIC
/begin CHARACTERISTIC KTQD_ECPSetValNoReq_mps2 "" VALUE 0x0000 /* @ECU_Address@KTQD_ECPSetValNoReq_mps2@ */ Scalar_FLOAT32_IEEE 0 SWC_FDC_type_CM_single_mps2 0.0 255.0 /end CHARACTERISTIC
/begin CHARACTERISTIC KTQD_EMSpdAcclLimitEnHi_rpm "" VALUE 0x0000 /* @ECU_Address@KTQD_EMSpdAcclLimitEnHi_rpm@ */ Scalar_FLOAT32_IEEE 0 SWC_FDC_type_CM_single_rpm 0.0 65535.0 /end CHARACTERISTIC
/begin CHARACTERISTIC KTQD_EMSpdAcclLimitEnLow_rpm "" VALUE 0x0000 /* @ECU_Address@KTQD_EMSpdAcclLimitEnLow_rpm@ */ Scalar_FLOAT32_IEEE 0 SWC_FDC_type_CM_single_rpm 0.0 65535.0 /end CHARACTERISTIC
/begin CHARACTERISTIC KTQD_ESCEnableDecSR_c "" VALUE 0x0000 /* @ECU_Address@KTQD_ESCEnableDecSR_c@ */ Scalar_FLOAT32_IEEE 0 SWC_FDC_type_CM_single_Nm -100000.0 0.0 /end CHARACTERISTIC
/begin CHARACTERISTIC KTQD_ESCEnableIncSR_c "" VALUE 0x0000 /* @ECU_Address@KTQD_ESCEnableIncSR_c@ */ Scalar_FLOAT32_IEEE 0 SWC_FDC_type_CM_single_Nm 0.0 100000.0 /end CHARACTERISTIC
/begin CHARACTERISTIC KTQD_ESCEnableTs_c "" VALUE 0x0000 /* @ECU_Address@KTQD_ESCEnableTs_c@ */ Scalar_FLOAT32_IEEE 0 SWC_FDC_type_CM_single_c 0.0 10.0 /end CHARACTERISTIC
/begin CHARACTERISTIC KTQD_EnterKeyCheckTime_s "" VALUE 0x0000 /* @ECU_Address@KTQD_EnterKeyCheckTime_s@ */ Scalar_FLOAT32_IEEE 0 SWC_FDC_type_CM_single_s 0.0 3600.0 /end CHARACTERISTIC
/begin CHARACTERISTIC KTQD_FinalTrqLowLim_Nm "" VALUE 0x0000 /* @ECU_Address@KTQD_FinalTrqLowLim_Nm@ */ Scalar_FLOAT32_IEEE 0 SWC_FDC_type_CM_single_Nm -5000.0 0.0 /end CHARACTERISTIC
/begin CHARACTERISTIC KTQD_FinalTrqUpLim_Nm "" VALUE 0x0000 /* @ECU_Address@KTQD_FinalTrqUpLim_Nm@ */ Scalar_FLOAT32_IEEE 0 SWC_FDC_type_CM_single_Nm 0.0 5000.0 /end CHARACTERISTIC
/begin CHARACTERISTIC KTQD_FrEDUSpRat_rat "" VALUE 0x0000 /* @ECU_Address@KTQD_FrEDUSpRat_rat@ */ Scalar_FLOAT32_IEEE 0 SWC_FDC_type_CM_single_rat 0.0 1.0 /end CHARACTERISTIC
/begin CHARACTERISTIC KTQD_GearShiftDAllowSpd_kph "" VALUE 0x0000 /* @ECU_Address@KTQD_GearShiftDAllowSpd_kph@ */ Scalar_FLOAT32_IEEE 0 SWC_FDC_type_CM_single_kph 0.0 10.0 /end CHARACTERISTIC
/begin CHARACTERISTIC KTQD_GearShiftDAllowTMSpd_rpm "" VALUE 0x0000 /* @ECU_Address@KTQD_GearShiftDAllowTMSpd_rpm@ */ Scalar_FLOAT32_IEEE 0 SWC_FDC_type_CM_single_rpm 0.0 15000.0 /end CHARACTERISTIC
/begin CHARACTERISTIC KTQD_GearShiftPSpd_kph "" VALUE 0x0000 /* @ECU_Address@KTQD_GearShiftPSpd_kph@ */ Scalar_FLOAT32_IEEE 0 SWC_FDC_type_CM_single_kph -100000.0 100000.0 /end CHARACTERISTIC
/begin CHARACTERISTIC KTQD_GearShiftRAllowSpd_kph "" VALUE 0x0000 /* @ECU_Address@KTQD_GearShiftRAllowSpd_kph@ */ Scalar_FLOAT32_IEEE 0 SWC_FDC_type_CM_single_kph 0.0 10.0 /end CHARACTERISTIC
/begin CHARACTERISTIC KTQD_GearShiftRAllowTMSpd_rpm "" VALUE 0x0000 /* @ECU_Address@KTQD_GearShiftRAllowTMSpd_rpm@ */ Scalar_FLOAT32_IEEE 0 SWC_FDC_type_CM_single_rpm 0.0 15000.0 /end CHARACTERISTIC
/begin CHARACTERISTIC KTQD_HHAllowMotorSpd_rpm "" VALUE 0x0000 /* @ECU_Address@KTQD_HHAllowMotorSpd_rpm@ */ Scalar_FLOAT32_IEEE 0 SWC_FDC_type_CM_single_rpm 0.0 3000.0 /end CHARACTERISTIC
/begin CHARACTERISTIC KTQD_HHAllowMotorTq_Nm "" VALUE 0x0000 /* @ECU_Address@KTQD_HHAllowMotorTq_Nm@ */ Scalar_FLOAT32_IEEE 0 SWC_FDC_type_CM_single_Nm 0.0 3000.0 /end CHARACTERISTIC
/begin CHARACTERISTIC KTQD_HHAllowSpd_kph "" VALUE 0x0000 /* @ECU_Address@KTQD_HHAllowSpd_kph@ */ Scalar_FLOAT32_IEEE 0 SWC_FDC_type_CM_single_kph 0.0 255.0 /end CHARACTERISTIC
/begin CHARACTERISTIC KTQD_HVBattAvailPwrDefGen_Nm "" VALUE 0x0000 /* @ECU_Address@KTQD_HVBattAvailPwrDefGen_Nm@ */ Scalar_FLOAT32_IEEE 0 SWC_FDC_type_CM_single_Nm -100000.0 0.0 /end CHARACTERISTIC
/begin CHARACTERISTIC KTQD_HVBattAvailPwrDefMot_Nm "" VALUE 0x0000 /* @ECU_Address@KTQD_HVBattAvailPwrDefMot_Nm@ */ Scalar_FLOAT32_IEEE 0 SWC_FDC_type_CM_single_Nm 0.0 100000.0 /end CHARACTERISTIC
/begin CHARACTERISTIC KTQD_InitializeWaitTime4ADAS_s "" VALUE 0x0000 /* @ECU_Address@KTQD_InitializeWaitTime4ADAS_s@ */ Scalar_FLOAT32_IEEE 0 SWC_FDC_type_CM_single_s 0.0 3600.0 /end CHARACTERISTIC
/begin CHARACTERISTIC KTQD_InitializeWaitTime_s "" VALUE 0x0000 /* @ECU_Address@KTQD_InitializeWaitTime_s@ */ Scalar_FLOAT32_IEEE 0 SWC_FDC_type_CM_single_s 0.0 2.0 /end CHARACTERISTIC
/begin CHARACTERISTIC KTQD_MCUEnSpdModeErrTime_s "" VALUE 0x0000 /* @ECU_Address@KTQD_MCUEnSpdModeErrTime_s@ */ Scalar_FLOAT32_IEEE 0 SWC_FDC_type_CM_single_s 0.0 3600.0 /end CHARACTERISTIC
/begin CHARACTERISTIC KTQD_NormalTs_c "" VALUE 0x0000 /* @ECU_Address@KTQD_NormalTs_c@ */ Scalar_FLOAT32_IEEE 0 SWC_FDC_type_CM_single_c 0.0 10.0 /end CHARACTERISTIC
/begin CHARACTERISTIC KTQD_POSNEGSWSMOTIME_s "" VALUE 0x0000 /* @ECU_Address@KTQD_POSNEGSWSMOTIME_s@ */ Scalar_FLOAT32_IEEE 0 SWC_FDC_type_CM_single_s 0.0 10.0 /end CHARACTERISTIC
/begin CHARACTERISTIC KTQD_POSNEGSWTs_c "" VALUE 0x0000 /* @ECU_Address@KTQD_POSNEGSWTs_c@ */ Scalar_FLOAT32_IEEE 0 SWC_FDC_type_CM_single_c 0.0 10.0 /end CHARACTERISTIC
/begin CHARACTERISTIC KTQD_PowerTrainTqLimtAtRegen_Nm "" VALUE 0x0000 /* @ECU_Address@KTQD_PowerTrainTqLimtAtRegen_Nm@ */ Scalar_FLOAT32_IEEE 0 SWC_FDC_type_CM_single_Nm -3000.0 0.0 /end CHARACTERISTIC
/begin CHARACTERISTIC KTQD_PowerTrainTqLimtAtTargetShaft_Nm "" VALUE 0x0000 /* @ECU_Address@KTQD_PowerTrainTqLimtAtTargetShaft_Nm@ */ Scalar_FLOAT32_IEEE 0 SWC_FDC_type_CM_single_Nm -100000.0 100000.0 /end CHARACTERISTIC
/begin CHARACTERISTIC KTQD_RollRegAPSLimit_pct "" VALUE 0x0000 /* @ECU_Address@KTQD_RollRegAPSLimit_pct@ */ Scalar_FLOAT32_IEEE 0 SWC_FDC_type_CM_single_pct 0.0 100.0 /end CHARACTERISTIC
/begin CHARACTERISTIC KTQD_RollRegBatAvalChgCurr_A "" VALUE 0x0000 /* @ECU_Address@KTQD_RollRegBatAvalChgCurr_A@ */ Scalar_FLOAT32_IEEE 0 SWC_FDC_type_CM_single_A -1000.0 1000.0 /end CHARACTERISTIC
/begin CHARACTERISTIC KTQD_RollRegVehSpdLimit_kph "" VALUE 0x0000 /* @ECU_Address@KTQD_RollRegVehSpdLimit_kph@ */ Scalar_FLOAT32_IEEE 0 SWC_FDC_type_CM_single_kph 0.0 150.0 /end CHARACTERISTIC
/begin CHARACTERISTIC KTQD_RotateShiftMaxTime_s "" VALUE 0x0000 /* @ECU_Address@KTQD_RotateShiftMaxTime_s@ */ Scalar_FLOAT32_IEEE 0 SWC_FDC_type_CM_single_s 0.0 60.0 /end CHARACTERISTIC
/begin CHARACTERISTIC KTQD_RrEDUSpRat_rat "" VALUE 0x0000 /* @ECU_Address@KTQD_RrEDUSpRat_rat@ */ Scalar_FLOAT32_IEEE 0 SWC_FDC_type_CM_single_rat 0.0 1.0 /end CHARACTERISTIC
/begin CHARACTERISTIC KTQD_SetSpdShortPLim_s "" VALUE 0x0000 /* @ECU_Address@KTQD_SetSpdShortPLim_s@ */ Scalar_FLOAT32_IEEE 0 SWC_FDC_type_CM_single_s 0.0 3600.0 /end CHARACTERISTIC
/begin CHARACTERISTIC KTQD_SpeedThrDoorOpn_kph "" VALUE 0x0000 /* @ECU_Address@KTQD_SpeedThrDoorOpn_kph@ */ Scalar_FLOAT32_IEEE 0 SWC_FDC_type_CM_single_kph 0.0 255.0 /end CHARACTERISTIC
/begin CHARACTERISTIC KTQD_TUpAEnaBrkPos_pct "" VALUE 0x0000 /* @ECU_Address@KTQD_TUpAEnaBrkPos_pct@ */ Scalar_FLOAT32_IEEE 0 SWC_FDC_type_CM_single_pct 0.0 100.0 /end CHARACTERISTIC
/begin CHARACTERISTIC KTQD_TUpAHHFbkTO_s "" VALUE 0x0000 /* @ECU_Address@KTQD_TUpAHHFbkTO_s@ */ Scalar_FLOAT32_IEEE 0 SWC_FDC_type_CM_single_s 0.0 100.0 /end CHARACTERISTIC
/begin CHARACTERISTIC KTQD_TUpAHHRlsSpd_rpm "" VALUE 0x0000 /* @ECU_Address@KTQD_TUpAHHRlsSpd_rpm@ */ Scalar_FLOAT32_IEEE 0 SWC_FDC_type_CM_single_rpm 0.0 3000.0 /end CHARACTERISTIC
/begin CHARACTERISTIC KTQD_TUpAHHRlsTrq_Nm "" VALUE 0x0000 /* @ECU_Address@KTQD_TUpAHHRlsTrq_Nm@ */ Scalar_FLOAT32_IEEE 0 SWC_FDC_type_CM_single_Nm 0.0 3000.0 /end CHARACTERISTIC
/begin CHARACTERISTIC KTQD_TUpARetryTMSpd_rpm "" VALUE 0x0000 /* @ECU_Address@KTQD_TUpARetryTMSpd_rpm@ */ Scalar_FLOAT32_IEEE 0 SWC_FDC_type_CM_single_rpm 0.0 3000.0 /end CHARACTERISTIC
/begin CHARACTERISTIC KTQD_TUpAWarnLatchTime_s "" VALUE 0x0000 /* @ECU_Address@KTQD_TUpAWarnLatchTime_s@ */ Scalar_FLOAT32_IEEE 0 SWC_FDC_type_CM_single_s 0.0 100.0 /end CHARACTERISTIC
/begin CHARACTERISTIC KTQD_VehAccPhyShrehold_mps2 "" VALUE 0x0000 /* @ECU_Address@KTQD_VehAccPhyShrehold_mps2@ */ Scalar_FLOAT32_IEEE 0 SWC_FDC_type_CM_single_mps2 0.0 100.0 /end CHARACTERISTIC
/begin CHARACTERISTIC KTQD_VehAccelCalDeltaT_s "" VALUE 0x0000 /* @ECU_Address@KTQD_VehAccelCalDeltaT_s@ */ Scalar_FLOAT32_IEEE 0 SWC_FDC_type_CM_single_s 0.0 3600.0 /end CHARACTERISTIC
/begin CHARACTERISTIC KTQD_VehAccelCalEna_kph "" VALUE 0x0000 /* @ECU_Address@KTQD_VehAccelCalEna_kph@ */ Scalar_FLOAT32_IEEE 0 SWC_FDC_type_CM_single_kph 0.0 255.0 /end CHARACTERISTIC
/begin CHARACTERISTIC KTQD_VehAccelCalFilterTs_s "" VALUE 0x0000 /* @ECU_Address@KTQD_VehAccelCalFilterTs_s@ */ Scalar_FLOAT32_IEEE 0 SWC_FDC_type_CM_single_s 0.0 3600.0 /end CHARACTERISTIC
/begin CHARACTERISTIC KTQD_VehAccelLimInRagDis_mps2 "" VALUE 0x0000 /* @ECU_Address@KTQD_VehAccelLimInRagDis_mps2@ */ Scalar_FLOAT32_IEEE 0 SWC_FDC_type_CM_single_mps2 0.0 255.0 /end CHARACTERISTIC
/begin CHARACTERISTIC KTQD_VehAccelLimOvrRagDis_mps2 "" VALUE 0x0000 /* @ECU_Address@KTQD_VehAccelLimOvrRagDis_mps2@ */ Scalar_FLOAT32_IEEE 0 SWC_FDC_type_CM_single_mps2 0.0 255.0 /end CHARACTERISTIC
/begin CHARACTERISTIC KTQD_VehAccelOvrLimRefreTime_s "" VALUE 0x0000 /* @ECU_Address@KTQD_VehAccelOvrLimRefreTime_s@ */ Scalar_FLOAT32_IEEE 0 SWC_FDC_type_CM_single_s 0.0 3600.0 /end CHARACTERISTIC
/begin CHARACTERISTIC KTQD_VehAcclLimitExtre_mps2 "" VALUE 0x0000 /* @ECU_Address@KTQD_VehAcclLimitExtre_mps2@ */ Scalar_FLOAT32_IEEE 0 SWC_FDC_type_CM_single_mps2 0.0 255.0 /end CHARACTERISTIC
/begin CHARACTERISTIC KTQD_VehAcclLimitTG_msp2 "" VALUE 0x0000 /* @ECU_Address@KTQD_VehAcclLimitTG_msp2@ */ Scalar_FLOAT32_IEEE 0 SWC_FDC_type_CM_single_mps2 0.0 255.0 /end CHARACTERISTIC
/begin CHARACTERISTIC KTQD_VehSpdLimitExtre_kph "" VALUE 0x0000 /* @ECU_Address@KTQD_VehSpdLimitExtre_kph@ */ Scalar_FLOAT32_IEEE 0 SWC_FDC_type_CM_single_kph 0.0 255.0 /end CHARACTERISTIC
/begin CHARACTERISTIC KTQD_VehSpdLimitInRangeDis_kph "" VALUE 0x0000 /* @ECU_Address@KTQD_VehSpdLimitInRangeDis_kph@ */ Scalar_FLOAT32_IEEE 0 SWC_FDC_type_CM_single_kph 0.0 255.0 /end CHARACTERISTIC
/begin CHARACTERISTIC KTQD_VehSpdLimitOvrRangeDis_kph "" VALUE 0x0000 /* @ECU_Address@KTQD_VehSpdLimitOvrRangeDis_kph@ */ Scalar_FLOAT32_IEEE 0 SWC_FDC_type_CM_single_kph 0.0 255.0 /end CHARACTERISTIC
/begin CHARACTERISTIC KTQD_VehSpdLimitTG_kph "" VALUE 0x0000 /* @ECU_Address@KTQD_VehSpdLimitTG_kph@ */ Scalar_FLOAT32_IEEE 0 SWC_FDC_type_CM_single_kph 0.0 255.0 /end CHARACTERISTIC
/begin CHARACTERISTIC KTQD_VehSpdLimitTorLowerLim_Nm "" VALUE 0x0000 /* @ECU_Address@KTQD_VehSpdLimitTorLowerLim_Nm@ */ Scalar_FLOAT32_IEEE 0 SWC_FDC_type_CM_single_Nm 0.0 3000.0 /end CHARACTERISTIC
/begin CHARACTERISTIC KTQD_VehSpdOvrLimitRefreTime_s "" VALUE 0x0000 /* @ECU_Address@KTQD_VehSpdOvrLimitRefreTime_s@ */ Scalar_FLOAT32_IEEE 0 SWC_FDC_type_CM_single_s 0.0 3600.0 /end CHARACTERISTIC
/begin CHARACTERISTIC KTQD_VehSpdPhyShrehold_kph "" VALUE 0x0000 /* @ECU_Address@KTQD_VehSpdPhyShrehold_kph@ */ Scalar_FLOAT32_IEEE 0 SWC_FDC_type_CM_single_kph 0.0 300.0 /end CHARACTERISTIC
/begin CHARACTERISTIC KTQD_noPBDetectSpd_kph "" VALUE 0x0000 /* @ECU_Address@KTQD_noPBDetectSpd_kph@ */ Scalar_FLOAT32_IEEE 0 SWC_FDC_type_CM_single_kph 0.0 300.0 /end CHARACTERISTIC
/begin CHARACTERISTIC KTQD_noPBDetectTMSpd_rpm "" VALUE 0x0000 /* @ECU_Address@KTQD_noPBDetectTMSpd_rpm@ */ Scalar_FLOAT32_IEEE 0 SWC_FDC_type_CM_single_rpm 0.0 15000.0 /end CHARACTERISTIC
/begin CHARACTERISTIC KTQD_noPBStillSpd_kph "" VALUE 0x0000 /* @ECU_Address@KTQD_noPBStillSpd_kph@ */ Scalar_FLOAT32_IEEE 0 SWC_FDC_type_CM_single_kph 0.0 300.0 /end CHARACTERISTIC
/begin CHARACTERISTIC KTQD_noPBStillTMSpd_rpm "" VALUE 0x0000 /* @ECU_Address@KTQD_noPBStillTMSpd_rpm@ */ Scalar_FLOAT32_IEEE 0 SWC_FDC_type_CM_single_rpm 0.0 15000.0 /end CHARACTERISTIC
/begin CHARACTERISTIC KTQD_noPBWarnPreActBuzzer_s "" VALUE 0x0000 /* @ECU_Address@KTQD_noPBWarnPreActBuzzer_s@ */ Scalar_FLOAT32_IEEE 0 SWC_FDC_type_CM_single_s 0.0 3600.0 /end CHARACTERISTIC
/begin CHARACTERISTIC KBCM_LightDelayOFFT_Cnt "" VALUE 0x0000 /* @ECU_Address@KBCM_LightDelayOFFT_Cnt@ */ Scalar_UWORD 0 SWC_FDC_type_CM_uint16_cnt 0.0 3000.0 /end CHARACTERISTIC
/begin CHARACTERISTIC KBCM_LightDelayONT_Cnt "" VALUE 0x0000 /* @ECU_Address@KBCM_LightDelayONT_Cnt@ */ Scalar_UWORD 0 SWC_FDC_type_CM_uint16_cnt 0.0 3000.0 /end CHARACTERISTIC
/begin CHARACTERISTIC KDHP_ActAPSPosn_pct_ovrdflg "" VALUE 0x0000 /* @ECU_Address@KDHP_ActAPSPosn_pct_ovrdflg@ */ Scalar_BOOLEAN 0 SWC_FDC_type_CM_boolean_flg 0.0 1.0 /end CHARACTERISTIC
/begin CHARACTERISTIC KDHP_EAPS1Min_pct_ovrdflg "" VALUE 0x0000 /* @ECU_Address@KDHP_EAPS1Min_pct_ovrdflg@ */ Scalar_BOOLEAN 0 SWC_FDC_type_CM_boolean_flg 0.0 1.0 /end CHARACTERISTIC
/begin CHARACTERISTIC KDHP_EAPS2Min_pct_ovrdflg "" VALUE 0x0000 /* @ECU_Address@KDHP_EAPS2Min_pct_ovrdflg@ */ Scalar_BOOLEAN 0 SWC_FDC_type_CM_boolean_flg 0.0 1.0 /end CHARACTERISTIC
/begin CHARACTERISTIC KPMM_HVFailureMCUByPass_ovrdflg "" VALUE 0x0000 /* @ECU_Address@KPMM_HVFailureMCUByPass_ovrdflg@ */ Scalar_BOOLEAN 0 SWC_FDC_type_CM_boolean_flg 0.0 1.0 /end CHARACTERISTIC
/begin CHARACTERISTIC KPMM_HVFailureMCUByPass_ovrdval "" VALUE 0x0000 /* @ECU_Address@KPMM_HVFailureMCUByPass_ovrdval@ */ Scalar_BOOLEAN 0 SWC_FDC_type_CM_boolean_flg 0.0 1.0 /end CHARACTERISTIC
/begin CHARACTERISTIC KPMM_HVILEmergencyStop_flg_ovrdflg "" VALUE 0x0000 /* @ECU_Address@KPMM_HVILEmergencyStop_flg_ovrdflg@ */ Scalar_BOOLEAN 0 SWC_FDC_type_CM_boolean_flg 0.0 1.0 /end CHARACTERISTIC
/begin CHARACTERISTIC KPMM_HVILEmergencyStop_flg_ovrdval "" VALUE 0x0000 /* @ECU_Address@KPMM_HVILEmergencyStop_flg_ovrdval@ */ Scalar_BOOLEAN 0 SWC_FDC_type_CM_boolean_flg 0.0 1.0 /end CHARACTERISTIC
/begin CHARACTERISTIC KPMM_HVILSourceSelect_flg "" VALUE 0x0000 /* @ECU_Address@KPMM_HVILSourceSelect_flg@ */ Scalar_BOOLEAN 0 SWC_FDC_type_CM_boolean_flg 0.0 1.0 /end CHARACTERISTIC
/begin CHARACTERISTIC KPMM_LongIdleBuzzerSW_flg "" VALUE 0x0000 /* @ECU_Address@KPMM_LongIdleBuzzerSW_flg@ */ Scalar_BOOLEAN 0 SWC_FDC_type_CM_boolean_flg 0.0 1.0 /end CHARACTERISTIC
/begin CHARACTERISTIC KPMM_LongIdleDetSW_flg "" VALUE 0x0000 /* @ECU_Address@KPMM_LongIdleDetSW_flg@ */ Scalar_BOOLEAN 0 SWC_FDC_type_CM_boolean_flg 0.0 1.0 /end CHARACTERISTIC
/begin CHARACTERISTIC KTQD_ComboKeyOff_flg_ovrdflg "" VALUE 0x0000 /* @ECU_Address@KTQD_ComboKeyOff_flg_ovrdflg@ */ Scalar_BOOLEAN 0 SWC_FDC_type_CM_boolean_flg 0.0 1.0 /end CHARACTERISTIC
/begin CHARACTERISTIC KTQD_ComboKeyOff_flg_ovrdval "" VALUE 0x0000 /* @ECU_Address@KTQD_ComboKeyOff_flg_ovrdval@ */ Scalar_BOOLEAN 0 SWC_FDC_type_CM_boolean_flg 0.0 1.0 /end CHARACTERISTIC
/begin CHARACTERISTIC KTQD_CreepEanble_ovrdflg "" VALUE 0x0000 /* @ECU_Address@KTQD_CreepEanble_ovrdflg@ */ Scalar_BOOLEAN 0 SWC_FDC_type_CM_boolean_flg 0.0 1.0 /end CHARACTERISTIC
/begin CHARACTERISTIC KTQD_CreepEanble_ovrdval "" VALUE 0x0000 /* @ECU_Address@KTQD_CreepEanble_ovrdval@ */ Scalar_BOOLEAN 0 SWC_FDC_type_CM_boolean_flg 0.0 1.0 /end CHARACTERISTIC
/begin CHARACTERISTIC KTQD_CreepForedEnable_flg "" VALUE 0x0000 /* @ECU_Address@KTQD_CreepForedEnable_flg@ */ Scalar_BOOLEAN 0 SWC_FDC_type_CM_boolean_flg 0.0 1.0 /end CHARACTERISTIC
/begin CHARACTERISTIC KTQD_CreepSpdReq_ovrdflg "" VALUE 0x0000 /* @ECU_Address@KTQD_CreepSpdReq_ovrdflg@ */ Scalar_BOOLEAN 0 SWC_FDC_type_CM_boolean_flg 0.0 1.0 /end CHARACTERISTIC
/begin CHARACTERISTIC KTQD_CreepTGMotorSpdCal_flg "" VALUE 0x0000 /* @ECU_Address@KTQD_CreepTGMotorSpdCal_flg@ */ Scalar_BOOLEAN 0 SWC_FDC_type_CM_boolean_flg 0.0 1.0 /end CHARACTERISTIC
/begin CHARACTERISTIC KTQD_GearShiftDRAllowSW_flg "" VALUE 0x0000 /* @ECU_Address@KTQD_GearShiftDRAllowSW_flg@ */ Scalar_BOOLEAN 0 SWC_FDC_type_CM_boolean_flg 0.0 1.0 /end CHARACTERISTIC
/begin CHARACTERISTIC KTQD_ParkSafeDoorOpenSW_ovrdflg "" VALUE 0x0000 /* @ECU_Address@KTQD_ParkSafeDoorOpenSW_ovrdflg@ */ Scalar_BOOLEAN 0 SWC_FDC_type_CM_boolean_flg 0.0 1.0 /end CHARACTERISTIC
/begin CHARACTERISTIC KTQD_ParkSafeDoorOpenSW_ovrdval "" VALUE 0x0000 /* @ECU_Address@KTQD_ParkSafeDoorOpenSW_ovrdval@ */ Scalar_BOOLEAN 0 SWC_FDC_type_CM_boolean_flg 0.0 1.0 /end CHARACTERISTIC
/begin CHARACTERISTIC KTQD_ParkSafeSeatBeltSW_ovrdflg "" VALUE 0x0000 /* @ECU_Address@KTQD_ParkSafeSeatBeltSW_ovrdflg@ */ Scalar_BOOLEAN 0 SWC_FDC_type_CM_boolean_flg 0.0 1.0 /end CHARACTERISTIC
/begin CHARACTERISTIC KTQD_ParkSafeSeatBeltSW_ovrdval "" VALUE 0x0000 /* @ECU_Address@KTQD_ParkSafeSeatBeltSW_ovrdval@ */ Scalar_BOOLEAN 0 SWC_FDC_type_CM_boolean_flg 0.0 1.0 /end CHARACTERISTIC
/begin CHARACTERISTIC KTQD_RegenModeSW_flg "" VALUE 0x0000 /* @ECU_Address@KTQD_RegenModeSW_flg@ */ Scalar_BOOLEAN 0 SWC_FDC_type_CM_boolean_flg 0.0 1.0 /end CHARACTERISTIC
/begin CHARACTERISTIC KTQD_RollingRegSW_enum_ovrdflg "" VALUE 0x0000 /* @ECU_Address@KTQD_RollingRegSW_enum_ovrdflg@ */ Scalar_BOOLEAN 0 SWC_FDC_type_CM_boolean_flg 0.0 1.0 /end CHARACTERISTIC
/begin CHARACTERISTIC KTQD_RollingRegSW_flg_ovrdflg "" VALUE 0x0000 /* @ECU_Address@KTQD_RollingRegSW_flg_ovrdflg@ */ Scalar_BOOLEAN 0 SWC_FDC_type_CM_boolean_flg 0.0 1.0 /end CHARACTERISTIC
/begin CHARACTERISTIC KTQD_RollingRegSW_flg_ovrdval "" VALUE 0x0000 /* @ECU_Address@KTQD_RollingRegSW_flg_ovrdval@ */ Scalar_BOOLEAN 0 SWC_FDC_type_CM_boolean_flg 0.0 1.0 /end CHARACTERISTIC
/begin CHARACTERISTIC KTQD_TUpAFuncEn_ovrdflg_flg "" VALUE 0x0000 /* @ECU_Address@KTQD_TUpAFuncEn_ovrdflg_flg@ */ Scalar_BOOLEAN 0 SWC_FDC_type_CM_boolean_flg 0.0 1.0 /end CHARACTERISTIC
/begin CHARACTERISTIC KTQD_TUpAFuncEn_ovrdval_flg "" VALUE 0x0000 /* @ECU_Address@KTQD_TUpAFuncEn_ovrdval_flg@ */ Scalar_BOOLEAN 0 SWC_FDC_type_CM_boolean_flg 0.0 1.0 /end CHARACTERISTIC
/begin CHARACTERISTIC KTQD_VehAcclLimitSW_flg_ovrdflg "" VALUE 0x0000 /* @ECU_Address@KTQD_VehAcclLimitSW_flg_ovrdflg@ */ Scalar_BOOLEAN 0 SWC_FDC_type_CM_boolean_flg 0.0 1.0 /end CHARACTERISTIC
/begin CHARACTERISTIC KTQD_VehAcclLimitSW_flg_ovrdval "" VALUE 0x0000 /* @ECU_Address@KTQD_VehAcclLimitSW_flg_ovrdval@ */ Scalar_BOOLEAN 0 SWC_FDC_type_CM_boolean_flg 0.0 1.0 /end CHARACTERISTIC
/begin CHARACTERISTIC KTQD_VehSpdLimitSW_flg_ovrdflg "" VALUE 0x0000 /* @ECU_Address@KTQD_VehSpdLimitSW_flg_ovrdflg@ */ Scalar_BOOLEAN 0 SWC_FDC_type_CM_boolean_flg 0.0 1.0 /end CHARACTERISTIC
/begin CHARACTERISTIC KTQD_VehSpdLimitSW_flg_ovrdval "" VALUE 0x0000 /* @ECU_Address@KTQD_VehSpdLimitSW_flg_ovrdval@ */ Scalar_BOOLEAN 0 SWC_FDC_type_CM_boolean_flg 0.0 1.0 /end CHARACTERISTIC
/begin CHARACTERISTIC KTQD_Function1Off1_enum "" VALUE 0x0000 /* @ECU_Address@KTQD_Function1Off1_enum@ */ Scalar_UBYTE 0 SWC_FDC_type_CM_uint8_enum 0.0 15.0 /end CHARACTERISTIC
/begin CHARACTERISTIC KTQD_Function1Off2_enum "" VALUE 0x0000 /* @ECU_Address@KTQD_Function1Off2_enum@ */ Scalar_UBYTE 0 SWC_FDC_type_CM_uint8_enum 0.0 15.0 /end CHARACTERISTIC
/begin CHARACTERISTIC KTQD_Function1Off3_enum "" VALUE 0x0000 /* @ECU_Address@KTQD_Function1Off3_enum@ */ Scalar_UBYTE 0 SWC_FDC_type_CM_uint8_enum 0.0 15.0 /end CHARACTERISTIC
/begin CHARACTERISTIC KTQD_Function1Off4_enum "" VALUE 0x0000 /* @ECU_Address@KTQD_Function1Off4_enum@ */ Scalar_UBYTE 0 SWC_FDC_type_CM_uint8_enum 0.0 15.0 /end CHARACTERISTIC
/begin CHARACTERISTIC KTQD_Function1Off5_enum "" VALUE 0x0000 /* @ECU_Address@KTQD_Function1Off5_enum@ */ Scalar_UBYTE 0 SWC_FDC_type_CM_uint8_enum 0.0 15.0 /end CHARACTERISTIC
/begin CHARACTERISTIC KTQD_Function1Off6_enum "" VALUE 0x0000 /* @ECU_Address@KTQD_Function1Off6_enum@ */ Scalar_UBYTE 0 SWC_FDC_type_CM_uint8_enum 0.0 15.0 /end CHARACTERISTIC
/begin CHARACTERISTIC KTQD_Function1Off7_enum "" VALUE 0x0000 /* @ECU_Address@KTQD_Function1Off7_enum@ */ Scalar_UBYTE 0 SWC_FDC_type_CM_uint8_enum 0.0 15.0 /end CHARACTERISTIC
/begin CHARACTERISTIC KTQD_Function1Off8_enum "" VALUE 0x0000 /* @ECU_Address@KTQD_Function1Off8_enum@ */ Scalar_UBYTE 0 SWC_FDC_type_CM_uint8_enum 0.0 15.0 /end CHARACTERISTIC
/begin CHARACTERISTIC KTQD_Function2Off1_enum "" VALUE 0x0000 /* @ECU_Address@KTQD_Function2Off1_enum@ */ Scalar_UBYTE 0 SWC_FDC_type_CM_uint8_enum 0.0 15.0 /end CHARACTERISTIC
/begin CHARACTERISTIC KTQD_Function2Off2_enum "" VALUE 0x0000 /* @ECU_Address@KTQD_Function2Off2_enum@ */ Scalar_UBYTE 0 SWC_FDC_type_CM_uint8_enum 0.0 15.0 /end CHARACTERISTIC
/begin CHARACTERISTIC KTQD_Function2Off3_enum "" VALUE 0x0000 /* @ECU_Address@KTQD_Function2Off3_enum@ */ Scalar_UBYTE 0 SWC_FDC_type_CM_uint8_enum 0.0 15.0 /end CHARACTERISTIC
/begin CHARACTERISTIC KTQD_Function2Off4_enum "" VALUE 0x0000 /* @ECU_Address@KTQD_Function2Off4_enum@ */ Scalar_UBYTE 0 SWC_FDC_type_CM_uint8_enum 0.0 15.0 /end CHARACTERISTIC
/begin CHARACTERISTIC KTQD_Function2Off5_enum "" VALUE 0x0000 /* @ECU_Address@KTQD_Function2Off5_enum@ */ Scalar_UBYTE 0 SWC_FDC_type_CM_uint8_enum 0.0 15.0 /end CHARACTERISTIC
/begin CHARACTERISTIC KTQD_Function2Off6_enum "" VALUE 0x0000 /* @ECU_Address@KTQD_Function2Off6_enum@ */ Scalar_UBYTE 0 SWC_FDC_type_CM_uint8_enum 0.0 15.0 /end CHARACTERISTIC
/begin CHARACTERISTIC KTQD_Function2Off7_enum "" VALUE 0x0000 /* @ECU_Address@KTQD_Function2Off7_enum@ */ Scalar_UBYTE 0 SWC_FDC_type_CM_uint8_enum 0.0 15.0 /end CHARACTERISTIC
/begin CHARACTERISTIC KTQD_Function2Off8_enum "" VALUE 0x0000 /* @ECU_Address@KTQD_Function2Off8_enum@ */ Scalar_UBYTE 0 SWC_FDC_type_CM_uint8_enum 0.0 15.0 /end CHARACTERISTIC
/begin CHARACTERISTIC KTQD_Function3Off1_enum "" VALUE 0x0000 /* @ECU_Address@KTQD_Function3Off1_enum@ */ Scalar_UBYTE 0 SWC_FDC_type_CM_uint8_enum 0.0 15.0 /end CHARACTERISTIC
/begin CHARACTERISTIC KTQD_Function3Off2_enum "" VALUE 0x0000 /* @ECU_Address@KTQD_Function3Off2_enum@ */ Scalar_UBYTE 0 SWC_FDC_type_CM_uint8_enum 0.0 15.0 /end CHARACTERISTIC
/begin CHARACTERISTIC KTQD_Function3Off3_enum "" VALUE 0x0000 /* @ECU_Address@KTQD_Function3Off3_enum@ */ Scalar_UBYTE 0 SWC_FDC_type_CM_uint8_enum 0.0 15.0 /end CHARACTERISTIC
/begin CHARACTERISTIC KTQD_Function3Off4_enum "" VALUE 0x0000 /* @ECU_Address@KTQD_Function3Off4_enum@ */ Scalar_UBYTE 0 SWC_FDC_type_CM_uint8_enum 0.0 15.0 /end CHARACTERISTIC
/begin CHARACTERISTIC KTQD_Function3Off5_enum "" VALUE 0x0000 /* @ECU_Address@KTQD_Function3Off5_enum@ */ Scalar_UBYTE 0 SWC_FDC_type_CM_uint8_enum 0.0 15.0 /end CHARACTERISTIC
/begin CHARACTERISTIC KTQD_Function3Off6_enum "" VALUE 0x0000 /* @ECU_Address@KTQD_Function3Off6_enum@ */ Scalar_UBYTE 0 SWC_FDC_type_CM_uint8_enum 0.0 15.0 /end CHARACTERISTIC
/begin CHARACTERISTIC KTQD_Function3Off7_enum "" VALUE 0x0000 /* @ECU_Address@KTQD_Function3Off7_enum@ */ Scalar_UBYTE 0 SWC_FDC_type_CM_uint8_enum 0.0 15.0 /end CHARACTERISTIC
/begin CHARACTERISTIC KTQD_Function3Off8_enum "" VALUE 0x0000 /* @ECU_Address@KTQD_Function3Off8_enum@ */ Scalar_UBYTE 0 SWC_FDC_type_CM_uint8_enum 0.0 15.0 /end CHARACTERISTIC
/begin CHARACTERISTIC KTQD_Function4Off1_enum "" VALUE 0x0000 /* @ECU_Address@KTQD_Function4Off1_enum@ */ Scalar_UBYTE 0 SWC_FDC_type_CM_uint8_enum 0.0 15.0 /end CHARACTERISTIC
/begin CHARACTERISTIC KTQD_Function4Off2_enum "" VALUE 0x0000 /* @ECU_Address@KTQD_Function4Off2_enum@ */ Scalar_UBYTE 0 SWC_FDC_type_CM_uint8_enum 0.0 15.0 /end CHARACTERISTIC
/begin CHARACTERISTIC KTQD_Function4Off3_enum "" VALUE 0x0000 /* @ECU_Address@KTQD_Function4Off3_enum@ */ Scalar_UBYTE 0 SWC_FDC_type_CM_uint8_enum 0.0 15.0 /end CHARACTERISTIC
/begin CHARACTERISTIC KTQD_Function4Off4_enum "" VALUE 0x0000 /* @ECU_Address@KTQD_Function4Off4_enum@ */ Scalar_UBYTE 0 SWC_FDC_type_CM_uint8_enum 0.0 15.0 /end CHARACTERISTIC
/begin CHARACTERISTIC KTQD_Function4Off5_enum "" VALUE 0x0000 /* @ECU_Address@KTQD_Function4Off5_enum@ */ Scalar_UBYTE 0 SWC_FDC_type_CM_uint8_enum 0.0 15.0 /end CHARACTERISTIC
/begin CHARACTERISTIC KTQD_Function4Off6_enum "" VALUE 0x0000 /* @ECU_Address@KTQD_Function4Off6_enum@ */ Scalar_UBYTE 0 SWC_FDC_type_CM_uint8_enum 0.0 15.0 /end CHARACTERISTIC
/begin CHARACTERISTIC KTQD_Function4Off7_enum "" VALUE 0x0000 /* @ECU_Address@KTQD_Function4Off7_enum@ */ Scalar_UBYTE 0 SWC_FDC_type_CM_uint8_enum 0.0 15.0 /end CHARACTERISTIC
/begin CHARACTERISTIC KTQD_Function4Off8_enum "" VALUE 0x0000 /* @ECU_Address@KTQD_Function4Off8_enum@ */ Scalar_UBYTE 0 SWC_FDC_type_CM_uint8_enum 0.0 15.0 /end CHARACTERISTIC
/begin CHARACTERISTIC KTQD_Function5Off1_enum "" VALUE 0x0000 /* @ECU_Address@KTQD_Function5Off1_enum@ */ Scalar_UBYTE 0 SWC_FDC_type_CM_uint8_enum 0.0 15.0 /end CHARACTERISTIC
/begin CHARACTERISTIC KTQD_Function5Off2_enum "" VALUE 0x0000 /* @ECU_Address@KTQD_Function5Off2_enum@ */ Scalar_UBYTE 0 SWC_FDC_type_CM_uint8_enum 0.0 15.0 /end CHARACTERISTIC
/begin CHARACTERISTIC KTQD_Function5Off3_enum "" VALUE 0x0000 /* @ECU_Address@KTQD_Function5Off3_enum@ */ Scalar_UBYTE 0 SWC_FDC_type_CM_uint8_enum 0.0 15.0 /end CHARACTERISTIC
/begin CHARACTERISTIC KTQD_Function5Off4_enum "" VALUE 0x0000 /* @ECU_Address@KTQD_Function5Off4_enum@ */ Scalar_UBYTE 0 SWC_FDC_type_CM_uint8_enum 0.0 15.0 /end CHARACTERISTIC
/begin CHARACTERISTIC KTQD_Function5Off5_enum "" VALUE 0x0000 /* @ECU_Address@KTQD_Function5Off5_enum@ */ Scalar_UBYTE 0 SWC_FDC_type_CM_uint8_enum 0.0 15.0 /end CHARACTERISTIC
/begin CHARACTERISTIC KTQD_Function5Off6_enum "" VALUE 0x0000 /* @ECU_Address@KTQD_Function5Off6_enum@ */ Scalar_UBYTE 0 SWC_FDC_type_CM_uint8_enum 0.0 15.0 /end CHARACTERISTIC
/begin CHARACTERISTIC KTQD_Function5Off7_enum "" VALUE 0x0000 /* @ECU_Address@KTQD_Function5Off7_enum@ */ Scalar_UBYTE 0 SWC_FDC_type_CM_uint8_enum 0.0 15.0 /end CHARACTERISTIC
/begin CHARACTERISTIC KTQD_Function5Off8_enum "" VALUE 0x0000 /* @ECU_Address@KTQD_Function5Off8_enum@ */ Scalar_UBYTE 0 SWC_FDC_type_CM_uint8_enum 0.0 15.0 /end CHARACTERISTIC
/begin CHARACTERISTIC KTQD_RollRegenIni_enum "" VALUE 0x0000 /* @ECU_Address@KTQD_RollRegenIni_enum@ */ Scalar_UBYTE 0 SWC_FDC_type_CM_uint8_enum 0.0 3.0 /end CHARACTERISTIC
/begin CHARACTERISTIC KTQD_RollRegenThreshold_enum "" VALUE 0x0000 /* @ECU_Address@KTQD_RollRegenThreshold_enum@ */ Scalar_UBYTE 0 SWC_FDC_type_CM_uint8_enum 0.0 255.0 /end CHARACTERISTIC
/begin CHARACTERISTIC KTQD_RollingRegSW_enum_ovrdval "" VALUE 0x0000 /* @ECU_Address@KTQD_RollingRegSW_enum_ovrdval@ */ Scalar_UBYTE 0 SWC_FDC_type_CM_uint8_enum 0.0 3.0 /end CHARACTERISTIC
/begin MEASUREMENT VTQD_VehAcclLimitTG_mps2 "" FLOAT32_IEEE SWC_FDC_type_CM_single_mps2 0 0 -20.0 20.0 ECU_ADDRESS 0x0000 /* @ECU_Address@VTQD_VehAcclLimitTG_mps2@ */ /end MEASUREMENT
/begin MEASUREMENT VTQD_VehAcclLimitRef_mps2 "" FLOAT32_IEEE SWC_FDC_type_CM_single_mps2 0 0 0.0 2.55 ECU_ADDRESS 0x0000 /* @ECU_Address@VTQD_VehAcclLimitRef_mps2@ */ /end MEASUREMENT
/begin MEASUREMENT VTQD_VehAccelCalDeltaT_cnt "" FLOAT32_IEEE SWC_FDC_type_CM_single_cnt 0 0 0.0 65535.0 ECU_ADDRESS 0x0000 /* @ECU_Address@VTQD_VehAccelCalDeltaT_cnt@ */ /end MEASUREMENT
/begin MEASUREMENT VTQD_VehAccel_mps2 "" FLOAT32_IEEE SWC_FDC_type_CM_single_mps2 0 0 0.0 2.55 ECU_ADDRESS 0x0000 /* @ECU_Address@VTQD_VehAccel_mps2@ */ /end MEASUREMENT
/begin MEASUREMENT VTQD_NormalTqMapD_Nm "" FLOAT32_IEEE SWC_FDC_type_CM_single_Nm 0 0 -100000.0 100000.0 ECU_ADDRESS 0x0000 /* @ECU_Address@VTQD_NormalTqMapD_Nm@ */ /end MEASUREMENT
/begin MEASUREMENT VTQD_ECOTqMapD_Nm "" FLOAT32_IEEE SWC_FDC_type_CM_single_Nm 0 0 -100000.0 100000.0 ECU_ADDRESS 0x0000 /* @ECU_Address@VTQD_ECOTqMapD_Nm@ */ /end MEASUREMENT
/begin MEASUREMENT VTQD_ConfortTqMapD_Nm "" FLOAT32_IEEE SWC_FDC_type_CM_single_Nm 0 0 -100000.0 100000.0 ECU_ADDRESS 0x0000 /* @ECU_Address@VTQD_ConfortTqMapD_Nm@ */ /end MEASUREMENT
/begin MEASUREMENT VTQD_OPDMapRLC_Nm "" FLOAT32_IEEE SWC_FDC_type_CM_single_Nm 0 0 -100000.0 100000.0 ECU_ADDRESS 0x0000 /* @ECU_Address@VTQD_OPDMapRLC_Nm@ */ /end MEASUREMENT
/begin MEASUREMENT VTQD_LHMTqMapRLC_Nm "" FLOAT32_IEEE SWC_FDC_type_CM_single_Nm 0 0 -100000.0 100000.0 ECU_ADDRESS 0x0000 /* @ECU_Address@VTQD_LHMTqMapRLC_Nm@ */ /end MEASUREMENT
/begin MEASUREMENT VTQD_VehAcclTorLimit_Nm "" FLOAT32_IEEE SWC_FDC_type_CM_single_Nm 0 0 -100000.0 100000.0 ECU_ADDRESS 0x0000 /* @ECU_Address@VTQD_VehAcclTorLimit_Nm@ */ /end MEASUREMENT
/begin MEASUREMENT VTQD_VehSpdLimitTG_kph "" FLOAT32_IEEE SWC_FDC_type_CM_single_kph 0 0 0.0 300.0 ECU_ADDRESS 0x0000 /* @ECU_Address@VTQD_VehSpdLimitTG_kph@ */ /end MEASUREMENT
/begin MEASUREMENT VTQD_VehSpdLimitRef_kph "" FLOAT32_IEEE SWC_FDC_type_CM_single_kph 0 0 0.0 300.0 ECU_ADDRESS 0x0000 /* @ECU_Address@VTQD_VehSpdLimitRef_kph@ */ /end MEASUREMENT
/begin MEASUREMENT VTQD_VehSpdTorLimit_Nm "" FLOAT32_IEEE SWC_FDC_type_CM_single_Nm 0 0 -3000.0 3000.0 ECU_ADDRESS 0x0000 /* @ECU_Address@VTQD_VehSpdTorLimit_Nm@ */ /end MEASUREMENT
/begin MEASUREMENT VTQD_TqCMDUpLim_Nm "" FLOAT32_IEEE SWC_FDC_type_CM_single_Nm 0 0 0.0 100000.0 ECU_ADDRESS 0x0000 /* @ECU_Address@VTQD_TqCMDUpLim_Nm@ */ /end MEASUREMENT
/begin MEASUREMENT VTQD_BrkReleaseSpd_kph "" FLOAT32_IEEE SWC_FDC_type_CM_single_kph 0 0 -255.0 255.0 ECU_ADDRESS 0x0000 /* @ECU_Address@VTQD_BrkReleaseSpd_kph@ */ /end MEASUREMENT
/begin MEASUREMENT VTQD_EngModeDisDetTime_s "" FLOAT32_IEEE SWC_FDC_type_CM_single_s 0 0 0.0 3600.0 ECU_ADDRESS 0x0000 /* @ECU_Address@VTQD_EngModeDisDetTime_s@ */ /end MEASUREMENT
/begin MEASUREMENT VTQD_EngModeEnDetTime_s "" FLOAT32_IEEE SWC_FDC_type_CM_single_s 0 0 0.0 3600.0 ECU_ADDRESS 0x0000 /* @ECU_Address@VTQD_EngModeEnDetTime_s@ */ /end MEASUREMENT
/begin MEASUREMENT VTQD_RollRegTorReq_Nm "" FLOAT32_IEEE SWC_FDC_type_CM_single_Nm 0 0 -100000.0 100000.0 ECU_ADDRESS 0x0000 /* @ECU_Address@VTQD_RollRegTorReq_Nm@ */ /end MEASUREMENT
/begin MEASUREMENT VTQD_BOSTqDecRate_pct "" FLOAT32_IEEE SWC_FDC_type_CM_single_pct 0 0 0.0 125.0 ECU_ADDRESS 0x0000 /* @ECU_Address@VTQD_BOSTqDecRate_pct@ */ /end MEASUREMENT
/begin MEASUREMENT VTQD_TqCMDLowLim_Nm "" FLOAT32_IEEE SWC_FDC_type_CM_single_Nm 0 0 -100000.0 0.0 ECU_ADDRESS 0x0000 /* @ECU_Address@VTQD_TqCMDLowLim_Nm@ */ /end MEASUREMENT
/begin MEASUREMENT VTQD_ConfortTqDecSR_Nm "" FLOAT32_IEEE SWC_FDC_type_CM_single_Nm 0 0 -100000.0 100000.0 ECU_ADDRESS 0x0000 /* @ECU_Address@VTQD_ConfortTqDecSR_Nm@ */ /end MEASUREMENT
/begin MEASUREMENT VTQD_ConfortTqIncSR_Nm "" FLOAT32_IEEE SWC_FDC_type_CM_single_Nm 0 0 -100000.0 100000.0 ECU_ADDRESS 0x0000 /* @ECU_Address@VTQD_ConfortTqIncSR_Nm@ */ /end MEASUREMENT
/begin MEASUREMENT VTQD_ECOTqDecSR_Nm "" FLOAT32_IEEE SWC_FDC_type_CM_single_Nm 0 0 -100000.0 100000.0 ECU_ADDRESS 0x0000 /* @ECU_Address@VTQD_ECOTqDecSR_Nm@ */ /end MEASUREMENT
/begin MEASUREMENT VTQD_ECOTqIncSR_Nm "" FLOAT32_IEEE SWC_FDC_type_CM_single_Nm 0 0 -100000.0 100000.0 ECU_ADDRESS 0x0000 /* @ECU_Address@VTQD_ECOTqIncSR_Nm@ */ /end MEASUREMENT
/begin MEASUREMENT VTQD_NormalTqDecSR_Nm "" FLOAT32_IEEE SWC_FDC_type_CM_single_Nm 0 0 -100000.0 100000.0 ECU_ADDRESS 0x0000 /* @ECU_Address@VTQD_NormalTqDecSR_Nm@ */ /end MEASUREMENT
/begin MEASUREMENT VTQD_NormalTqIncSR_Nm "" FLOAT32_IEEE SWC_FDC_type_CM_single_Nm 0 0 -100000.0 100000.0 ECU_ADDRESS 0x0000 /* @ECU_Address@VTQD_NormalTqIncSR_Nm@ */ /end MEASUREMENT
/begin MEASUREMENT VTQD_CreepTartgerMorSpd_rpm "" FLOAT32_IEEE SWC_FDC_type_CM_single_rpm 0 0 -2000.0 2000.0 ECU_ADDRESS 0x0000 /* @ECU_Address@VTQD_CreepTartgerMorSpd_rpm@ */ /end MEASUREMENT
/begin MEASUREMENT VTQD_MinimizeSpdCMD_rpm "" FLOAT32_IEEE SWC_FDC_type_CM_single_rpm 0 0 -2000.0 2000.0 ECU_ADDRESS 0x0000 /* @ECU_Address@VTQD_MinimizeSpdCMD_rpm@ */ /end MEASUREMENT
/begin MEASUREMENT VTQD_CreepSpdReq_rpm "" FLOAT32_IEEE SWC_FDC_type_CM_single_rpm 0 0 -100000.0 100000.0 ECU_ADDRESS 0x0000 /* @ECU_Address@VTQD_CreepSpdReq_rpm@ */ /end MEASUREMENT
/begin MEASUREMENT VTQD_CreepContinueTime_s "" FLOAT32_IEEE SWC_FDC_type_CM_single_s 0 0 0.0 3600.0 ECU_ADDRESS 0x0000 /* @ECU_Address@VTQD_CreepContinueTime_s@ */ /end MEASUREMENT
/begin MEASUREMENT VTQD_CreepSpdReq_kph "" FLOAT32_IEEE SWC_FDC_type_CM_single_kph 0 0 -20.0 20.0 ECU_ADDRESS 0x0000 /* @ECU_Address@VTQD_CreepSpdReq_kph@ */ /end MEASUREMENT
/begin MEASUREMENT VTQD_ECPCalSpdLimTG_rpm "" FLOAT32_IEEE SWC_FDC_type_CM_single_rpm 0 0 -100000.0 100000.0 ECU_ADDRESS 0x0000 /* @ECU_Address@VTQD_ECPCalSpdLimTG_rpm@ */ /end MEASUREMENT
/begin MEASUREMENT VTQD_TMTqReqRaw_Nm "" FLOAT32_IEEE SWC_FDC_type_CM_single_Nm 0 0 -100000.0 100000.0 ECU_ADDRESS 0x0000 /* @ECU_Address@VTQD_TMTqReqRaw_Nm@ */ /end MEASUREMENT
/begin MEASUREMENT VTQD_TMTqReqSmooth_Nm "" FLOAT32_IEEE SWC_FDC_type_CM_single_Nm 0 0 -100000.0 100000.0 ECU_ADDRESS 0x0000 /* @ECU_Address@VTQD_TMTqReqSmooth_Nm@ */ /end MEASUREMENT
/begin MEASUREMENT VTQD_CANCELCountDetTime_s "" FLOAT32_IEEE SWC_FDC_type_CM_single_s 0 0 0.0 3600.0 ECU_ADDRESS 0x0000 /* @ECU_Address@VTQD_CANCELCountDetTime_s@ */ /end MEASUREMENT
/begin MEASUREMENT VTQD_HVBPwrAvailDchrg_kW "" FLOAT32_IEEE SWC_FDC_type_CM_single_kW 0 0 -10000.0 10000.0 ECU_ADDRESS 0x0000 /* @ECU_Address@VTQD_HVBPwrAvailDchrg_kW@ */ /end MEASUREMENT
/begin MEASUREMENT VTQD_HVBDischrgLim_Nm "" FLOAT32_IEEE SWC_FDC_type_CM_single_Nm 0 0 -100000.0 100000.0 ECU_ADDRESS 0x0000 /* @ECU_Address@VTQD_HVBDischrgLim_Nm@ */ /end MEASUREMENT
/begin MEASUREMENT VTQD_HVBCurrSmooth_gain "" FLOAT32_IEEE SWC_FDC_type_CM_single_gain 0 0 -100000.0 100000.0 ECU_ADDRESS 0x0000 /* @ECU_Address@VTQD_HVBCurrSmooth_gain@ */ /end MEASUREMENT
/begin MEASUREMENT VTQD_TMTqCapMot_Nm "" FLOAT32_IEEE SWC_FDC_type_CM_single_Nm 0 0 0.0 100000.0 ECU_ADDRESS 0x0000 /* @ECU_Address@VTQD_TMTqCapMot_Nm@ */ /end MEASUREMENT
/begin MEASUREMENT VTQD_HVBattPwrAvailChrg_kW "" FLOAT32_IEEE SWC_FDC_type_CM_single_kW 0 0 -10000.0 10000.0 ECU_ADDRESS 0x0000 /* @ECU_Address@VTQD_HVBattPwrAvailChrg_kW@ */ /end MEASUREMENT
/begin MEASUREMENT VTQD_HVBChrgLim_Nm "" FLOAT32_IEEE SWC_FDC_type_CM_single_Nm 0 0 -100000.0 100000.0 ECU_ADDRESS 0x0000 /* @ECU_Address@VTQD_HVBChrgLim_Nm@ */ /end MEASUREMENT
/begin MEASUREMENT VTQD_TMTqCapGen_Nm "" FLOAT32_IEEE SWC_FDC_type_CM_single_Nm 0 0 -100000.0 0.0 ECU_ADDRESS 0x0000 /* @ECU_Address@VTQD_TMTqCapGen_Nm@ */ /end MEASUREMENT
/begin MEASUREMENT VTQD_VehSpdLimitOvrKp_Gain "" FLOAT32_IEEE SWC_FDC_type_CM_single_Gain 0 0 0.0 1.0 ECU_ADDRESS 0x0000 /* @ECU_Address@VTQD_VehSpdLimitOvrKp_Gain@ */ /end MEASUREMENT
/begin MEASUREMENT VTQD_VehSpdLimitOvrKi_Gain "" FLOAT32_IEEE SWC_FDC_type_CM_single_Gain 0 0 0.0 1.0 ECU_ADDRESS 0x0000 /* @ECU_Address@VTQD_VehSpdLimitOvrKi_Gain@ */ /end MEASUREMENT
/begin MEASUREMENT VTQD_RampTs_c "" FLOAT32_IEEE SWC_FDC_type_CM_single_c 0 0 0.0 1.0 ECU_ADDRESS 0x0000 /* @ECU_Address@VTQD_RampTs_c@ */ /end MEASUREMENT
/begin MEASUREMENT VTQD_RampTqIncSR_Nm "" FLOAT32_IEEE SWC_FDC_type_CM_single_Nm 0 0 0.0 100000.0 ECU_ADDRESS 0x0000 /* @ECU_Address@VTQD_RampTqIncSR_Nm@ */ /end MEASUREMENT
/begin MEASUREMENT VTQD_RampTqDecSR_Nm "" FLOAT32_IEEE SWC_FDC_type_CM_single_Nm 0 0 -100000.0 0.0 ECU_ADDRESS 0x0000 /* @ECU_Address@VTQD_RampTqDecSR_Nm@ */ /end MEASUREMENT
/begin MEASUREMENT VTQD_FinalTrqUpLim_Nm "" FLOAT32_IEEE SWC_FDC_type_CM_single_Nm 0 0 0.0 5000.0 ECU_ADDRESS 0x0000 /* @ECU_Address@VTQD_FinalTrqUpLim_Nm@ */ /end MEASUREMENT
/begin MEASUREMENT VTQD_FinalTrqLowLim_Nm "" FLOAT32_IEEE SWC_FDC_type_CM_single_Nm 0 0 -5000.0 0.0 ECU_ADDRESS 0x0000 /* @ECU_Address@VTQD_FinalTrqLowLim_Nm@ */ /end MEASUREMENT
/begin MEASUREMENT VTQD_PedalMapTq_Nm "" FLOAT32_IEEE SWC_FDC_type_CM_single_Nm 0 0 -100000.0 100000.0 ECU_ADDRESS 0x0000 /* @ECU_Address@VTQD_PedalMapTq_Nm@ */ /end MEASUREMENT
/begin MEASUREMENT VTQD_FrEDUSpRat_rat "" FLOAT32_IEEE SWC_FDC_type_CM_single_rat 0 0 0.0 1.0 ECU_ADDRESS 0x0000 /* @ECU_Address@VTQD_FrEDUSpRat_rat@ */ /end MEASUREMENT
/begin MEASUREMENT VTQD_RrEDUSpRat_rat "" FLOAT32_IEEE SWC_FDC_type_CM_single_rat 0 0 0.0 1.0 ECU_ADDRESS 0x0000 /* @ECU_Address@VTQD_RrEDUSpRat_rat@ */ /end MEASUREMENT
/begin MEASUREMENT VTQD_AccelLimitOvrKp_Gain "" FLOAT32_IEEE SWC_FDC_type_CM_single_Gain 0 0 -100000.0 100000.0 ECU_ADDRESS 0x0000 /* @ECU_Address@VTQD_AccelLimitOvrKp_Gain@ */ /end MEASUREMENT
/begin MEASUREMENT VTQD_AceelLimitOvrKi_Gain "" FLOAT32_IEEE SWC_FDC_type_CM_single_Gain 0 0 -100000.0 100000.0 ECU_ADDRESS 0x0000 /* @ECU_Address@VTQD_AceelLimitOvrKi_Gain@ */ /end MEASUREMENT
/begin MEASUREMENT VDHP_EAPS1MINInit_pct "" FLOAT32_IEEE SWC_FDC_type_CM_single_pct 0 0 0.0 120.0 ECU_ADDRESS 0x0000 /* @ECU_Address@VDHP_EAPS1MINInit_pct@ */ /end MEASUREMENT
/begin MEASUREMENT VDHP_EAPS1NRM_pct "" FLOAT32_IEEE SWC_FDC_type_CM_single_pct 0 0 0.0 120.0 ECU_ADDRESS 0x0000 /* @ECU_Address@VDHP_EAPS1NRM_pct@ */ /end MEASUREMENT
/begin MEASUREMENT VDHP_EAPS2NRM_pct "" FLOAT32_IEEE SWC_FDC_type_CM_single_pct 0 0 0.0 120.0 ECU_ADDRESS 0x0000 /* @ECU_Address@VDHP_EAPS2NRM_pct@ */ /end MEASUREMENT
/begin MEASUREMENT VDHP_EAPS1NRMDiff_pct "" FLOAT32_IEEE SWC_FDC_type_CM_single_pct 0 0 0.0 120.0 ECU_ADDRESS 0x0000 /* @ECU_Address@VDHP_EAPS1NRMDiff_pct@ */ /end MEASUREMENT
/begin MEASUREMENT VDHP_EAPS1MIN_pct "" FLOAT32_IEEE SWC_FDC_type_CM_single_pct 0 0 0.0 120.0 ECU_ADDRESS 0x0000 /* @ECU_Address@VDHP_EAPS1MIN_pct@ */ /end MEASUREMENT
/begin MEASUREMENT VDHP_EAPS2MINInit_pct "" FLOAT32_IEEE SWC_FDC_type_CM_single_pct 0 0 0.0 120.0 ECU_ADDRESS 0x0000 /* @ECU_Address@VDHP_EAPS2MINInit_pct@ */ /end MEASUREMENT
/begin MEASUREMENT VDHP_EAPS2NRMDiff_pct "" FLOAT32_IEEE SWC_FDC_type_CM_single_pct 0 0 0.0 120.0 ECU_ADDRESS 0x0000 /* @ECU_Address@VDHP_EAPS2NRMDiff_pct@ */ /end MEASUREMENT
/begin MEASUREMENT VDHP_EAPS2MIN_pct "" FLOAT32_IEEE SWC_FDC_type_CM_single_pct 0 0 0.0 120.0 ECU_ADDRESS 0x0000 /* @ECU_Address@VDHP_EAPS2MIN_pct@ */ /end MEASUREMENT
/begin MEASUREMENT VDHP_EAPS1DIS_pct "" FLOAT32_IEEE SWC_FDC_type_CM_single_pct 0 0 0.0 120.0 ECU_ADDRESS 0x0000 /* @ECU_Address@VDHP_EAPS1DIS_pct@ */ /end MEASUREMENT
/begin MEASUREMENT VDHP_EAPS2DIS_pct "" FLOAT32_IEEE SWC_FDC_type_CM_single_pct 0 0 0.0 120.0 ECU_ADDRESS 0x0000 /* @ECU_Address@VDHP_EAPS2DIS_pct@ */ /end MEASUREMENT
/begin MEASUREMENT VDHP_EAPSWDSP_pct "" FLOAT32_IEEE SWC_FDC_type_CM_single_pct 0 0 0.0 120.0 ECU_ADDRESS 0x0000 /* @ECU_Address@VDHP_EAPSWDSP_pct@ */ /end MEASUREMENT
/begin MEASUREMENT VDHP_EPEDLIND_pct "" FLOAT32_IEEE SWC_FDC_type_CM_single_pct 0 0 0.0 120.0 ECU_ADDRESS 0x0000 /* @ECU_Address@VDHP_EPEDLIND_pct@ */ /end MEASUREMENT
/begin MEASUREMENT VDHP_HysOffset_pct "" FLOAT32_IEEE SWC_FDC_type_CM_single_pct 0 0 0.0 120.0 ECU_ADDRESS 0x0000 /* @ECU_Address@VDHP_HysOffset_pct@ */ /end MEASUREMENT
/begin MEASUREMENT VDHP_ActAPSPosn_pct "" FLOAT32_IEEE SWC_FDC_type_CM_single_pct 0 0 0.0 120.0 ECU_ADDRESS 0x0000 /* @ECU_Address@VDHP_ActAPSPosn_pct@ */ /end MEASUREMENT
/begin MEASUREMENT VPMM_HVILFailTimes_cnt "" FLOAT32_IEEE SWC_FDC_type_CM_single_cnt 0 0 0.0 1000.0 ECU_ADDRESS 0x0000 /* @ECU_Address@VPMM_HVILFailTimes_cnt@ */ /end MEASUREMENT
/begin MEASUREMENT VPMM_HVILPassTimes_cnt "" FLOAT32_IEEE SWC_FDC_type_CM_single_cnt 0 0 0.0 1000.0 ECU_ADDRESS 0x0000 /* @ECU_Address@VPMM_HVILPassTimes_cnt@ */ /end MEASUREMENT
/begin MEASUREMENT VTHC_PECoolingMode_enum "" UBYTE SWC_FDC_type_CM_uint8_enum 0 0 0.0 4.0 ECU_ADDRESS 0x0000 /* @ECU_Address@VTHC_PECoolingMode_enum@ */ /end MEASUREMENT
/begin MEASUREMENT VTQD_GearShiftPosn_enum "" UBYTE SWC_FDC_type_CM_uint8_enum 0 0 0.0 15.0 ECU_ADDRESS 0x0000 /* @ECU_Address@VTQD_GearShiftPosn_enum@ */ /end MEASUREMENT
/begin MEASUREMENT VTQD_VCUMCUCtrlMdTQD_enum "" UBYTE SWC_FDC_type_CM_uint8_enum 0 0 0.0 15.0 ECU_ADDRESS 0x0000 /* @ECU_Address@VTQD_VCUMCUCtrlMdTQD_enum@ */ /end MEASUREMENT
/begin MEASUREMENT VTQD_CreepIND_enum "" UBYTE SWC_FDC_type_CM_uint8_enum 0 0 0.0 15.0 ECU_ADDRESS 0x0000 /* @ECU_Address@VTQD_CreepIND_enum@ */ /end MEASUREMENT
/begin MEASUREMENT VTQD_ActTUpAIND_enum "" UBYTE SWC_FDC_type_CM_uint8_enum 0 0 0.0 15.0 ECU_ADDRESS 0x0000 /* @ECU_Address@VTQD_ActTUpAIND_enum@ */ /end MEASUREMENT
/begin MEASUREMENT VTQD_VCUEBSHHSw_enum "" UBYTE SWC_FDC_type_CM_uint8_enum 0 0 0.0 15.0 ECU_ADDRESS 0x0000 /* @ECU_Address@VTQD_VCUEBSHHSw_enum@ */ /end MEASUREMENT
/begin MEASUREMENT VTQD_VCUEBSRd4BR_enum "" UBYTE SWC_FDC_type_CM_uint8_enum 0 0 0.0 15.0 ECU_ADDRESS 0x0000 /* @ECU_Address@VTQD_VCUEBSRd4BR_enum@ */ /end MEASUREMENT
/begin MEASUREMENT VTQD_ComboKey_enum "" UBYTE SWC_FDC_type_CM_uint8_enum 0 0 0.0 15.0 ECU_ADDRESS 0x0000 /* @ECU_Address@VTQD_ComboKey_enum@ */ /end MEASUREMENT
/begin MEASUREMENT VTQD_Function1CMD_enum "" UBYTE SWC_FDC_type_CM_uint8_enum 0 0 0.0 15.0 ECU_ADDRESS 0x0000 /* @ECU_Address@VTQD_Function1CMD_enum@ */ /end MEASUREMENT
/begin MEASUREMENT VTQD_Function1Off8_enum "" UBYTE SWC_FDC_type_CM_uint8_enum 0 0 0.0 15.0 ECU_ADDRESS 0x0000 /* @ECU_Address@VTQD_Function1Off8_enum@ */ /end MEASUREMENT
/begin MEASUREMENT VTQD_Function1Off1_enum "" UBYTE SWC_FDC_type_CM_uint8_enum 0 0 0.0 15.0 ECU_ADDRESS 0x0000 /* @ECU_Address@VTQD_Function1Off1_enum@ */ /end MEASUREMENT
/begin MEASUREMENT VTQD_Function1Off2_enum "" UBYTE SWC_FDC_type_CM_uint8_enum 0 0 0.0 15.0 ECU_ADDRESS 0x0000 /* @ECU_Address@VTQD_Function1Off2_enum@ */ /end MEASUREMENT
/begin MEASUREMENT VTQD_Function1Off3_enum "" UBYTE SWC_FDC_type_CM_uint8_enum 0 0 0.0 15.0 ECU_ADDRESS 0x0000 /* @ECU_Address@VTQD_Function1Off3_enum@ */ /end MEASUREMENT
/begin MEASUREMENT VTQD_Function1Off4_enum "" UBYTE SWC_FDC_type_CM_uint8_enum 0 0 0.0 15.0 ECU_ADDRESS 0x0000 /* @ECU_Address@VTQD_Function1Off4_enum@ */ /end MEASUREMENT
/begin MEASUREMENT VTQD_Function1Off5_enum "" UBYTE SWC_FDC_type_CM_uint8_enum 0 0 0.0 15.0 ECU_ADDRESS 0x0000 /* @ECU_Address@VTQD_Function1Off5_enum@ */ /end MEASUREMENT
/begin MEASUREMENT VTQD_Function1Off6_enum "" UBYTE SWC_FDC_type_CM_uint8_enum 0 0 0.0 15.0 ECU_ADDRESS 0x0000 /* @ECU_Address@VTQD_Function1Off6_enum@ */ /end MEASUREMENT
/begin MEASUREMENT VTQD_Function1Off7_enum "" UBYTE SWC_FDC_type_CM_uint8_enum 0 0 0.0 15.0 ECU_ADDRESS 0x0000 /* @ECU_Address@VTQD_Function1Off7_enum@ */ /end MEASUREMENT
/begin MEASUREMENT VTQD_CANCELCount_cnt "" UBYTE SWC_FDC_type_CM_uint8_cnt 0 0 0.0 15.0 ECU_ADDRESS 0x0000 /* @ECU_Address@VTQD_CANCELCount_cnt@ */ /end MEASUREMENT
/begin MEASUREMENT VTQD_Function2CMD_enum "" UBYTE SWC_FDC_type_CM_uint8_enum 0 0 0.0 15.0 ECU_ADDRESS 0x0000 /* @ECU_Address@VTQD_Function2CMD_enum@ */ /end MEASUREMENT
/begin MEASUREMENT VTQD_Function2Off8_enum "" UBYTE SWC_FDC_type_CM_uint8_enum 0 0 0.0 15.0 ECU_ADDRESS 0x0000 /* @ECU_Address@VTQD_Function2Off8_enum@ */ /end MEASUREMENT
/begin MEASUREMENT VTQD_Function2Off1_enum "" UBYTE SWC_FDC_type_CM_uint8_enum 0 0 0.0 15.0 ECU_ADDRESS 0x0000 /* @ECU_Address@VTQD_Function2Off1_enum@ */ /end MEASUREMENT
/begin MEASUREMENT VTQD_Function2Off2_enum "" UBYTE SWC_FDC_type_CM_uint8_enum 0 0 0.0 15.0 ECU_ADDRESS 0x0000 /* @ECU_Address@VTQD_Function2Off2_enum@ */ /end MEASUREMENT
/begin MEASUREMENT VTQD_Function2Off3_enum "" UBYTE SWC_FDC_type_CM_uint8_enum 0 0 0.0 15.0 ECU_ADDRESS 0x0000 /* @ECU_Address@VTQD_Function2Off3_enum@ */ /end MEASUREMENT
/begin MEASUREMENT VTQD_Function2Off4_enum "" UBYTE SWC_FDC_type_CM_uint8_enum 0 0 0.0 15.0 ECU_ADDRESS 0x0000 /* @ECU_Address@VTQD_Function2Off4_enum@ */ /end MEASUREMENT
/begin MEASUREMENT VTQD_Function2Off5_enum "" UBYTE SWC_FDC_type_CM_uint8_enum 0 0 0.0 15.0 ECU_ADDRESS 0x0000 /* @ECU_Address@VTQD_Function2Off5_enum@ */ /end MEASUREMENT
/begin MEASUREMENT VTQD_Function2Off6_enum "" UBYTE SWC_FDC_type_CM_uint8_enum 0 0 0.0 15.0 ECU_ADDRESS 0x0000 /* @ECU_Address@VTQD_Function2Off6_enum@ */ /end MEASUREMENT
/begin MEASUREMENT VTQD_Function2Off7_enum "" UBYTE SWC_FDC_type_CM_uint8_enum 0 0 0.0 15.0 ECU_ADDRESS 0x0000 /* @ECU_Address@VTQD_Function2Off7_enum@ */ /end MEASUREMENT
/begin MEASUREMENT VTQD_Function3CMD_enum "" UBYTE SWC_FDC_type_CM_uint8_enum 0 0 0.0 15.0 ECU_ADDRESS 0x0000 /* @ECU_Address@VTQD_Function3CMD_enum@ */ /end MEASUREMENT
/begin MEASUREMENT VTQD_Function3Off8_enum "" UBYTE SWC_FDC_type_CM_uint8_enum 0 0 0.0 15.0 ECU_ADDRESS 0x0000 /* @ECU_Address@VTQD_Function3Off8_enum@ */ /end MEASUREMENT
/begin MEASUREMENT VTQD_Function3Off1_enum "" UBYTE SWC_FDC_type_CM_uint8_enum 0 0 0.0 15.0 ECU_ADDRESS 0x0000 /* @ECU_Address@VTQD_Function3Off1_enum@ */ /end MEASUREMENT
/begin MEASUREMENT VTQD_Function3Off2_enum "" UBYTE SWC_FDC_type_CM_uint8_enum 0 0 0.0 15.0 ECU_ADDRESS 0x0000 /* @ECU_Address@VTQD_Function3Off2_enum@ */ /end MEASUREMENT
/begin MEASUREMENT VTQD_Function3Off3_enum "" UBYTE SWC_FDC_type_CM_uint8_enum 0 0 0.0 15.0 ECU_ADDRESS 0x0000 /* @ECU_Address@VTQD_Function3Off3_enum@ */ /end MEASUREMENT
/begin MEASUREMENT VTQD_Function3Off4_enum "" UBYTE SWC_FDC_type_CM_uint8_enum 0 0 0.0 15.0 ECU_ADDRESS 0x0000 /* @ECU_Address@VTQD_Function3Off4_enum@ */ /end MEASUREMENT
/begin MEASUREMENT VTQD_Function3Off5_enum "" UBYTE SWC_FDC_type_CM_uint8_enum 0 0 0.0 15.0 ECU_ADDRESS 0x0000 /* @ECU_Address@VTQD_Function3Off5_enum@ */ /end MEASUREMENT
/begin MEASUREMENT VTQD_Function3Off6_enum "" UBYTE SWC_FDC_type_CM_uint8_enum 0 0 0.0 15.0 ECU_ADDRESS 0x0000 /* @ECU_Address@VTQD_Function3Off6_enum@ */ /end MEASUREMENT
/begin MEASUREMENT VTQD_Function3Off7_enum "" UBYTE SWC_FDC_type_CM_uint8_enum 0 0 0.0 15.0 ECU_ADDRESS 0x0000 /* @ECU_Address@VTQD_Function3Off7_enum@ */ /end MEASUREMENT
/begin MEASUREMENT VTQD_Function4CMD_enum "" UBYTE SWC_FDC_type_CM_uint8_enum 0 0 0.0 15.0 ECU_ADDRESS 0x0000 /* @ECU_Address@VTQD_Function4CMD_enum@ */ /end MEASUREMENT
/begin MEASUREMENT VTQD_Function4Off8_enum "" UBYTE SWC_FDC_type_CM_uint8_enum 0 0 0.0 15.0 ECU_ADDRESS 0x0000 /* @ECU_Address@VTQD_Function4Off8_enum@ */ /end MEASUREMENT
/begin MEASUREMENT VTQD_Function4Off1_enum "" UBYTE SWC_FDC_type_CM_uint8_enum 0 0 0.0 15.0 ECU_ADDRESS 0x0000 /* @ECU_Address@VTQD_Function4Off1_enum@ */ /end MEASUREMENT
/begin MEASUREMENT VTQD_Function4Off2_enum "" UBYTE SWC_FDC_type_CM_uint8_enum 0 0 0.0 15.0 ECU_ADDRESS 0x0000 /* @ECU_Address@VTQD_Function4Off2_enum@ */ /end MEASUREMENT
/begin MEASUREMENT VTQD_Function4Off3_enum "" UBYTE SWC_FDC_type_CM_uint8_enum 0 0 0.0 15.0 ECU_ADDRESS 0x0000 /* @ECU_Address@VTQD_Function4Off3_enum@ */ /end MEASUREMENT
/begin MEASUREMENT VTQD_Function4Off4_enum "" UBYTE SWC_FDC_type_CM_uint8_enum 0 0 0.0 15.0 ECU_ADDRESS 0x0000 /* @ECU_Address@VTQD_Function4Off4_enum@ */ /end MEASUREMENT
/begin MEASUREMENT VTQD_Function4Off5_enum "" UBYTE SWC_FDC_type_CM_uint8_enum 0 0 0.0 15.0 ECU_ADDRESS 0x0000 /* @ECU_Address@VTQD_Function4Off5_enum@ */ /end MEASUREMENT
/begin MEASUREMENT VTQD_Function4Off6_enum "" UBYTE SWC_FDC_type_CM_uint8_enum 0 0 0.0 15.0 ECU_ADDRESS 0x0000 /* @ECU_Address@VTQD_Function4Off6_enum@ */ /end MEASUREMENT
/begin MEASUREMENT VTQD_Function4Off7_enum "" UBYTE SWC_FDC_type_CM_uint8_enum 0 0 0.0 15.0 ECU_ADDRESS 0x0000 /* @ECU_Address@VTQD_Function4Off7_enum@ */ /end MEASUREMENT
/begin MEASUREMENT VTQD_Function5CMD_enum "" UBYTE SWC_FDC_type_CM_uint8_enum 0 0 0.0 15.0 ECU_ADDRESS 0x0000 /* @ECU_Address@VTQD_Function5CMD_enum@ */ /end MEASUREMENT
/begin MEASUREMENT VTQD_Function5Off8_enum "" UBYTE SWC_FDC_type_CM_uint8_enum 0 0 0.0 15.0 ECU_ADDRESS 0x0000 /* @ECU_Address@VTQD_Function5Off8_enum@ */ /end MEASUREMENT
/begin MEASUREMENT VTQD_Function5Off1_enum "" UBYTE SWC_FDC_type_CM_uint8_enum 0 0 0.0 15.0 ECU_ADDRESS 0x0000 /* @ECU_Address@VTQD_Function5Off1_enum@ */ /end MEASUREMENT
/begin MEASUREMENT VTQD_Function5Off2_enum "" UBYTE SWC_FDC_type_CM_uint8_enum 0 0 0.0 15.0 ECU_ADDRESS 0x0000 /* @ECU_Address@VTQD_Function5Off2_enum@ */ /end MEASUREMENT
/begin MEASUREMENT VTQD_Function5Off3_enum "" UBYTE SWC_FDC_type_CM_uint8_enum 0 0 0.0 15.0 ECU_ADDRESS 0x0000 /* @ECU_Address@VTQD_Function5Off3_enum@ */ /end MEASUREMENT
/begin MEASUREMENT VTQD_Function5Off4_enum "" UBYTE SWC_FDC_type_CM_uint8_enum 0 0 0.0 15.0 ECU_ADDRESS 0x0000 /* @ECU_Address@VTQD_Function5Off4_enum@ */ /end MEASUREMENT
/begin MEASUREMENT VTQD_Function5Off5_enum "" UBYTE SWC_FDC_type_CM_uint8_enum 0 0 0.0 15.0 ECU_ADDRESS 0x0000 /* @ECU_Address@VTQD_Function5Off5_enum@ */ /end MEASUREMENT
/begin MEASUREMENT VTQD_Function5Off6_enum "" UBYTE SWC_FDC_type_CM_uint8_enum 0 0 0.0 15.0 ECU_ADDRESS 0x0000 /* @ECU_Address@VTQD_Function5Off6_enum@ */ /end MEASUREMENT
/begin MEASUREMENT VTQD_Function5Off7_enum "" UBYTE SWC_FDC_type_CM_uint8_enum 0 0 0.0 15.0 ECU_ADDRESS 0x0000 /* @ECU_Address@VTQD_Function5Off7_enum@ */ /end MEASUREMENT
/begin MEASUREMENT VTQD_FunctionOffSta_enum "" UBYTE SWC_FDC_type_CM_uint8_enum 0 0 0.0 15.0 ECU_ADDRESS 0x0000 /* @ECU_Address@VTQD_FunctionOffSta_enum@ */ /end MEASUREMENT
/begin MEASUREMENT VTQD_GearActualPosn_enum "" UBYTE SWC_FDC_type_CM_uint8_enum 0 0 0.0 15.0 ECU_ADDRESS 0x0000 /* @ECU_Address@VTQD_GearActualPosn_enum@ */ /end MEASUREMENT
/begin MEASUREMENT VDHP_EAPS12RangeSta_enum "" UBYTE SWC_FDC_type_CM_uint8_enum 0 0 0.0 3.0 ECU_ADDRESS 0x0000 /* @ECU_Address@VDHP_EAPS12RangeSta_enum@ */ /end MEASUREMENT
/begin MEASUREMENT VPMM_LVBattLowInd_enum "" UBYTE SWC_FDC_type_CM_uint8_enum 0 0 0.0 3.0 ECU_ADDRESS 0x0000 /* @ECU_Address@VPMM_LVBattLowInd_enum@ */ /end MEASUREMENT
/begin MEASUREMENT VPSA_EmergencyShutDown_flg "" UBYTE SWC_FDC_type_CM_boolean_flg 0 0 0.0 1.0 ECU_ADDRESS 0x0000 /* @ECU_Address@VPSA_EmergencyShutDown_flg@ */ /end MEASUREMENT
/begin MEASUREMENT VTHC_ChargingMode_flg "" UBYTE SWC_FDC_type_CM_boolean_flg 0 0 0.0 1.0 ECU_ADDRESS 0x0000 /* @ECU_Address@VTHC_ChargingMode_flg@ */ /end MEASUREMENT
/begin MEASUREMENT VTHC_CoolingMode_flg "" UBYTE SWC_FDC_type_CM_boolean_flg 0 0 0.0 1.0 ECU_ADDRESS 0x0000 /* @ECU_Address@VTHC_CoolingMode_flg@ */ /end MEASUREMENT
/begin MEASUREMENT VTQD_RNDTrig_flg "" UBYTE SWC_FDC_type_CM_boolean_flg 0 0 0.0 1.0 ECU_ADDRESS 0x0000 /* @ECU_Address@VTQD_RNDTrig_flg@ */ /end MEASUREMENT
/begin MEASUREMENT VTQD_DMSLossLimitGear_flg "" UBYTE SWC_FDC_type_CM_boolean_flg 0 0 0.0 1.0 ECU_ADDRESS 0x0000 /* @ECU_Address@VTQD_DMSLossLimitGear_flg@ */ /end MEASUREMENT
/begin MEASUREMENT VTQD_VehAcclEMSpdInRange_flg "" UBYTE SWC_FDC_type_CM_boolean_flg 0 0 0.0 1.0 ECU_ADDRESS 0x0000 /* @ECU_Address@VTQD_VehAcclEMSpdInRange_flg@ */ /end MEASUREMENT
/begin MEASUREMENT VTQD_VehAcclLimitEnable_flg "" UBYTE SWC_FDC_type_CM_boolean_flg 0 0 0.0 1.0 ECU_ADDRESS 0x0000 /* @ECU_Address@VTQD_VehAcclLimitEnable_flg@ */ /end MEASUREMENT
/begin MEASUREMENT VTQD_VehAccelCalTrig_flg "" UBYTE SWC_FDC_type_CM_boolean_flg 0 0 0.0 1.0 ECU_ADDRESS 0x0000 /* @ECU_Address@VTQD_VehAccelCalTrig_flg@ */ /end MEASUREMENT
/begin MEASUREMENT VTQD_VehAcceleOvrLimit_flg "" UBYTE SWC_FDC_type_CM_boolean_flg 0 0 0.0 1.0 ECU_ADDRESS 0x0000 /* @ECU_Address@VTQD_VehAcceleOvrLimit_flg@ */ /end MEASUREMENT
/begin MEASUREMENT VTQD_VehAcceleContiOvrLimit_flg "" UBYTE SWC_FDC_type_CM_boolean_flg 0 0 0.0 1.0 ECU_ADDRESS 0x0000 /* @ECU_Address@VTQD_VehAcceleContiOvrLimit_flg@ */ /end MEASUREMENT
/begin MEASUREMENT VTQD_VehAcceleInLimit_flg "" UBYTE SWC_FDC_type_CM_boolean_flg 0 0 0.0 1.0 ECU_ADDRESS 0x0000 /* @ECU_Address@VTQD_VehAcceleInLimit_flg@ */ /end MEASUREMENT
/begin MEASUREMENT VTQD_VehAcceleOvrRef_flg "" UBYTE SWC_FDC_type_CM_boolean_flg 0 0 0.0 1.0 ECU_ADDRESS 0x0000 /* @ECU_Address@VTQD_VehAcceleOvrRef_flg@ */ /end MEASUREMENT
/begin MEASUREMENT VTQD_VehSpdLimitEnable_flg "" UBYTE SWC_FDC_type_CM_boolean_flg 0 0 0.0 1.0 ECU_ADDRESS 0x0000 /* @ECU_Address@VTQD_VehSpdLimitEnable_flg@ */ /end MEASUREMENT
/begin MEASUREMENT VTQD_VehSpdOvrLimit_flg "" UBYTE SWC_FDC_type_CM_boolean_flg 0 0 0.0 1.0 ECU_ADDRESS 0x0000 /* @ECU_Address@VTQD_VehSpdOvrLimit_flg@ */ /end MEASUREMENT
/begin MEASUREMENT VTQD_VehSpdContiOvrLimit_flg "" UBYTE SWC_FDC_type_CM_boolean_flg 0 0 0.0 1.0 ECU_ADDRESS 0x0000 /* @ECU_Address@VTQD_VehSpdContiOvrLimit_flg@ */ /end MEASUREMENT
/begin MEASUREMENT VTQD_VehSpdInLimit_flg "" UBYTE SWC_FDC_type_CM_boolean_flg 0 0 0.0 1.0 ECU_ADDRESS 0x0000 /* @ECU_Address@VTQD_VehSpdInLimit_flg@ */ /end MEASUREMENT
/begin MEASUREMENT VTQD_VehSpdOvrRef_flg "" UBYTE SWC_FDC_type_CM_boolean_flg 0 0 0.0 1.0 ECU_ADDRESS 0x0000 /* @ECU_Address@VTQD_VehSpdOvrRef_flg@ */ /end MEASUREMENT
/begin MEASUREMENT VTQD_TUpADisableReq_flg "" UBYTE SWC_FDC_type_CM_boolean_flg 0 0 0.0 1.0 ECU_ADDRESS 0x0000 /* @ECU_Address@VTQD_TUpADisableReq_flg@ */ /end MEASUREMENT
/begin MEASUREMENT VTQD_TUpAPreconChecked_flg "" UBYTE SWC_FDC_type_CM_boolean_flg 0 0 0.0 1.0 ECU_ADDRESS 0x0000 /* @ECU_Address@VTQD_TUpAPreconChecked_flg@ */ /end MEASUREMENT
/begin MEASUREMENT VTQD_TUpAReady_flg "" UBYTE SWC_FDC_type_CM_boolean_flg 0 0 0.0 1.0 ECU_ADDRESS 0x0000 /* @ECU_Address@VTQD_TUpAReady_flg@ */ /end MEASUREMENT
/begin MEASUREMENT VTQD_TUpAEnableReq_flg "" UBYTE SWC_FDC_type_CM_boolean_flg 0 0 0.0 1.0 ECU_ADDRESS 0x0000 /* @ECU_Address@VTQD_TUpAEnableReq_flg@ */ /end MEASUREMENT
/begin MEASUREMENT VTQD_BrakeRelease_flg "" UBYTE SWC_FDC_type_CM_boolean_flg 0 0 0.0 1.0 ECU_ADDRESS 0x0000 /* @ECU_Address@VTQD_BrakeRelease_flg@ */ /end MEASUREMENT
/begin MEASUREMENT VTQD_CreepEnable_flg "" UBYTE SWC_FDC_type_CM_boolean_flg 0 0 0.0 1.0 ECU_ADDRESS 0x0000 /* @ECU_Address@VTQD_CreepEnable_flg@ */ /end MEASUREMENT
/begin MEASUREMENT VTQD_MCUFNoFault_flg "" UBYTE SWC_FDC_type_CM_boolean_flg 0 0 0.0 1.0 ECU_ADDRESS 0x0000 /* @ECU_Address@VTQD_MCUFNoFault_flg@ */ /end MEASUREMENT
/begin MEASUREMENT VTQD_TUpADisableCreep_flg "" UBYTE SWC_FDC_type_CM_boolean_flg 0 0 0.0 1.0 ECU_ADDRESS 0x0000 /* @ECU_Address@VTQD_TUpADisableCreep_flg@ */ /end MEASUREMENT
/begin MEASUREMENT VTQD_DriverTqOvr_flg "" UBYTE SWC_FDC_type_CM_boolean_flg 0 0 0.0 1.0 ECU_ADDRESS 0x0000 /* @ECU_Address@VTQD_DriverTqOvr_flg@ */ /end MEASUREMENT
/begin MEASUREMENT VTQD_VehBrkReleaseFail_flg "" UBYTE SWC_FDC_type_CM_boolean_flg 0 0 0.0 1.0 ECU_ADDRESS 0x0000 /* @ECU_Address@VTQD_VehBrkReleaseFail_flg@ */ /end MEASUREMENT
/begin MEASUREMENT VTQD_TorqLimDoorOpn_flg "" UBYTE SWC_FDC_type_CM_boolean_flg 0 0 0.0 1.0 ECU_ADDRESS 0x0000 /* @ECU_Address@VTQD_TorqLimDoorOpn_flg@ */ /end MEASUREMENT
/begin MEASUREMENT VTQD_CreeperNotAvail_flg "" UBYTE SWC_FDC_type_CM_boolean_flg 0 0 0.0 1.0 ECU_ADDRESS 0x0000 /* @ECU_Address@VTQD_CreeperNotAvail_flg@ */ /end MEASUREMENT
/begin MEASUREMENT VTQD_CreepStart_flg "" UBYTE SWC_FDC_type_CM_boolean_flg 0 0 0.0 1.0 ECU_ADDRESS 0x0000 /* @ECU_Address@VTQD_CreepStart_flg@ */ /end MEASUREMENT
/begin MEASUREMENT VTQD_FlasherDis_flg "" UBYTE SWC_FDC_type_CM_boolean_flg 0 0 0.0 1.0 ECU_ADDRESS 0x0000 /* @ECU_Address@VTQD_FlasherDis_flg@ */ /end MEASUREMENT
/begin MEASUREMENT VTQD_FlasherEn_flg "" UBYTE SWC_FDC_type_CM_boolean_flg 0 0 0.0 1.0 ECU_ADDRESS 0x0000 /* @ECU_Address@VTQD_FlasherEn_flg@ */ /end MEASUREMENT
/begin MEASUREMENT VTQD_ParkingProtectWarnWind_flg "" UBYTE SWC_FDC_type_CM_boolean_flg 0 0 0.0 1.0 ECU_ADDRESS 0x0000 /* @ECU_Address@VTQD_ParkingProtectWarnWind_flg@ */ /end MEASUREMENT
/begin MEASUREMENT VTQD_NoPBDoorOpen_flg "" UBYTE SWC_FDC_type_CM_boolean_flg 0 0 0.0 1.0 ECU_ADDRESS 0x0000 /* @ECU_Address@VTQD_NoPBDoorOpen_flg@ */ /end MEASUREMENT
/begin MEASUREMENT VTQD_NoPBSeatBelt_flg "" UBYTE SWC_FDC_type_CM_boolean_flg 0 0 0.0 1.0 ECU_ADDRESS 0x0000 /* @ECU_Address@VTQD_NoPBSeatBelt_flg@ */ /end MEASUREMENT
/begin MEASUREMENT VTQD_ParkingProtectWarnCrit_flg "" UBYTE SWC_FDC_type_CM_boolean_flg 0 0 0.0 1.0 ECU_ADDRESS 0x0000 /* @ECU_Address@VTQD_ParkingProtectWarnCrit_flg@ */ /end MEASUREMENT
/begin MEASUREMENT VTQD_ParkingProtectRelease_flg "" UBYTE SWC_FDC_type_CM_boolean_flg 0 0 0.0 1.0 ECU_ADDRESS 0x0000 /* @ECU_Address@VTQD_ParkingProtectRelease_flg@ */ /end MEASUREMENT
/begin MEASUREMENT VTQD_ParkingProtectWarning_flg "" UBYTE SWC_FDC_type_CM_boolean_flg 0 0 0.0 1.0 ECU_ADDRESS 0x0000 /* @ECU_Address@VTQD_ParkingProtectWarning_flg@ */ /end MEASUREMENT
/begin MEASUREMENT VTQD_ParkingProtectAction_flg "" UBYTE SWC_FDC_type_CM_boolean_flg 0 0 0.0 1.0 ECU_ADDRESS 0x0000 /* @ECU_Address@VTQD_ParkingProtectAction_flg@ */ /end MEASUREMENT
/begin MEASUREMENT VTQD_RollingRegenEnable_flg "" UBYTE SWC_FDC_type_CM_boolean_flg 0 0 0.0 1.0 ECU_ADDRESS 0x0000 /* @ECU_Address@VTQD_RollingRegenEnable_flg@ */ /end MEASUREMENT
/begin MEASUREMENT VTQD_POSNEGCONVSM_flg "" UBYTE SWC_FDC_type_CM_boolean_flg 0 0 0.0 1.0 ECU_ADDRESS 0x0000 /* @ECU_Address@VTQD_POSNEGCONVSM_flg@ */ /end MEASUREMENT
/begin MEASUREMENT VTQD_ComboBuzzerReset_flg "" UBYTE SWC_FDC_type_CM_boolean_flg 0 0 0.0 1.0 ECU_ADDRESS 0x0000 /* @ECU_Address@VTQD_ComboBuzzerReset_flg@ */ /end MEASUREMENT
/begin MEASUREMENT VTQD_ComboKeyBuzzEn_flg "" UBYTE SWC_FDC_type_CM_boolean_flg 0 0 0.0 1.0 ECU_ADDRESS 0x0000 /* @ECU_Address@VTQD_ComboKeyBuzzEn_flg@ */ /end MEASUREMENT
/begin MEASUREMENT VTQD_PwrUpStart_flg "" UBYTE SWC_FDC_type_CM_boolean_flg 0 0 0.0 1.0 ECU_ADDRESS 0x0000 /* @ECU_Address@VTQD_PwrUpStart_flg@ */ /end MEASUREMENT
/begin MEASUREMENT VTQD_PwrUpFinished_flg "" UBYTE SWC_FDC_type_CM_boolean_flg 0 0 0.0 1.0 ECU_ADDRESS 0x0000 /* @ECU_Address@VTQD_PwrUpFinished_flg@ */ /end MEASUREMENT
/begin MEASUREMENT VTQD_PwrUpFail_flg "" UBYTE SWC_FDC_type_CM_boolean_flg 0 0 0.0 1.0 ECU_ADDRESS 0x0000 /* @ECU_Address@VTQD_PwrUpFail_flg@ */ /end MEASUREMENT
/begin MEASUREMENT VTQD_MCUEnSpdModeErr_flg "" UBYTE SWC_FDC_type_CM_boolean_flg 0 0 0.0 1.0 ECU_ADDRESS 0x0000 /* @ECU_Address@VTQD_MCUEnSpdModeErr_flg@ */ /end MEASUREMENT
/begin MEASUREMENT VTQD_CreepContiTO_flg "" UBYTE SWC_FDC_type_CM_boolean_flg 0 0 0.0 1.0 ECU_ADDRESS 0x0000 /* @ECU_Address@VTQD_CreepContiTO_flg@ */ /end MEASUREMENT
/begin MEASUREMENT VTQD_CreeperErr_flg "" UBYTE SWC_FDC_type_CM_boolean_flg 0 0 0.0 1.0 ECU_ADDRESS 0x0000 /* @ECU_Address@VTQD_CreeperErr_flg@ */ /end MEASUREMENT
/begin MEASUREMENT VTQD_TUpAIndRun_flg "" UBYTE SWC_FDC_type_CM_boolean_flg 0 0 0.0 1.0 ECU_ADDRESS 0x0000 /* @ECU_Address@VTQD_TUpAIndRun_flg@ */ /end MEASUREMENT
/begin MEASUREMENT VTQD_CreepContiWarn_flg "" UBYTE SWC_FDC_type_CM_boolean_flg 0 0 0.0 1.0 ECU_ADDRESS 0x0000 /* @ECU_Address@VTQD_CreepContiWarn_flg@ */ /end MEASUREMENT
/begin MEASUREMENT VTQD_DRTransfer_flg "" UBYTE SWC_FDC_type_CM_boolean_flg 0 0 0.0 1.0 ECU_ADDRESS 0x0000 /* @ECU_Address@VTQD_DRTransfer_flg@ */ /end MEASUREMENT
/begin MEASUREMENT VTQD_ComboKeyPreEnSet_flg "" UBYTE SWC_FDC_type_CM_boolean_flg 0 0 0.0 1.0 ECU_ADDRESS 0x0000 /* @ECU_Address@VTQD_ComboKeyPreEnSet_flg@ */ /end MEASUREMENT
/begin MEASUREMENT VTQD_ComboKeyPreEnReset_flg "" UBYTE SWC_FDC_type_CM_boolean_flg 0 0 0.0 1.0 ECU_ADDRESS 0x0000 /* @ECU_Address@VTQD_ComboKeyPreEnReset_flg@ */ /end MEASUREMENT
/begin MEASUREMENT VTQD_ComboKeyPreEn_flg "" UBYTE SWC_FDC_type_CM_boolean_flg 0 0 0.0 1.0 ECU_ADDRESS 0x0000 /* @ECU_Address@VTQD_ComboKeyPreEn_flg@ */ /end MEASUREMENT
/begin MEASUREMENT VTQD_ComboKeyEnCMDSta_flg "" UBYTE SWC_FDC_type_CM_boolean_flg 0 0 0.0 1.0 ECU_ADDRESS 0x0000 /* @ECU_Address@VTQD_ComboKeyEnCMDSta_flg@ */ /end MEASUREMENT
/begin MEASUREMENT VTQD_ComboKeyEnCMD_flg "" UBYTE SWC_FDC_type_CM_boolean_flg 0 0 0.0 1.0 ECU_ADDRESS 0x0000 /* @ECU_Address@VTQD_ComboKeyEnCMD_flg@ */ /end MEASUREMENT
/begin MEASUREMENT VTQD_ComboKeyEn_flg "" UBYTE SWC_FDC_type_CM_boolean_flg 0 0 0.0 1.0 ECU_ADDRESS 0x0000 /* @ECU_Address@VTQD_ComboKeyEn_flg@ */ /end MEASUREMENT
/begin MEASUREMENT VTQD_ComboKeyReset_flg "" UBYTE SWC_FDC_type_CM_boolean_flg 0 0 0.0 1.0 ECU_ADDRESS 0x0000 /* @ECU_Address@VTQD_ComboKeyReset_flg@ */ /end MEASUREMENT
/begin MEASUREMENT VTQD_ECPECASUp_flg "" UBYTE SWC_FDC_type_CM_boolean_flg 0 0 0.0 1.0 ECU_ADDRESS 0x0000 /* @ECU_Address@VTQD_ECPECASUp_flg@ */ /end MEASUREMENT
/begin MEASUREMENT VTQD_UpShort_flg "" UBYTE SWC_FDC_type_CM_boolean_flg 0 0 0.0 1.0 ECU_ADDRESS 0x0000 /* @ECU_Address@VTQD_UpShort_flg@ */ /end MEASUREMENT
/begin MEASUREMENT VTQD_ECPECASDown_flg "" UBYTE SWC_FDC_type_CM_boolean_flg 0 0 0.0 1.0 ECU_ADDRESS 0x0000 /* @ECU_Address@VTQD_ECPECASDown_flg@ */ /end MEASUREMENT
/begin MEASUREMENT VTQD_DownShort_flg "" UBYTE SWC_FDC_type_CM_boolean_flg 0 0 0.0 1.0 ECU_ADDRESS 0x0000 /* @ECU_Address@VTQD_DownShort_flg@ */ /end MEASUREMENT
/begin MEASUREMENT VTQD_ECPECASStopLV_flg "" UBYTE SWC_FDC_type_CM_boolean_flg 0 0 0.0 1.0 ECU_ADDRESS 0x0000 /* @ECU_Address@VTQD_ECPECASStopLV_flg@ */ /end MEASUREMENT
/begin MEASUREMENT VTQD_StopLVShort_flg "" UBYTE SWC_FDC_type_CM_boolean_flg 0 0 0.0 1.0 ECU_ADDRESS 0x0000 /* @ECU_Address@VTQD_StopLVShort_flg@ */ /end MEASUREMENT
/begin MEASUREMENT VTQD_ECPECASM1_flg "" UBYTE SWC_FDC_type_CM_boolean_flg 0 0 0.0 1.0 ECU_ADDRESS 0x0000 /* @ECU_Address@VTQD_ECPECASM1_flg@ */ /end MEASUREMENT
/begin MEASUREMENT VTQD_M1Short_flg "" UBYTE SWC_FDC_type_CM_boolean_flg 0 0 0.0 1.0 ECU_ADDRESS 0x0000 /* @ECU_Address@VTQD_M1Short_flg@ */ /end MEASUREMENT
/begin MEASUREMENT VTQD_ECPECASM2_flg "" UBYTE SWC_FDC_type_CM_boolean_flg 0 0 0.0 1.0 ECU_ADDRESS 0x0000 /* @ECU_Address@VTQD_ECPECASM2_flg@ */ /end MEASUREMENT
/begin MEASUREMENT VTQD_M2Short_flg "" UBYTE SWC_FDC_type_CM_boolean_flg 0 0 0.0 1.0 ECU_ADDRESS 0x0000 /* @ECU_Address@VTQD_M2Short_flg@ */ /end MEASUREMENT
/begin MEASUREMENT VTQD_ECPECASRKnee_flg "" UBYTE SWC_FDC_type_CM_boolean_flg 0 0 0.0 1.0 ECU_ADDRESS 0x0000 /* @ECU_Address@VTQD_ECPECASRKnee_flg@ */ /end MEASUREMENT
/begin MEASUREMENT VTQD_RKneeShort_flg "" UBYTE SWC_FDC_type_CM_boolean_flg 0 0 0.0 1.0 ECU_ADDRESS 0x0000 /* @ECU_Address@VTQD_RKneeShort_flg@ */ /end MEASUREMENT
/begin MEASUREMENT VTQD_Function1Off1Pass_flg "" UBYTE SWC_FDC_type_CM_boolean_flg 0 0 0.0 1.0 ECU_ADDRESS 0x0000 /* @ECU_Address@VTQD_Function1Off1Pass_flg@ */ /end MEASUREMENT
/begin MEASUREMENT VTQD_Function1Off2Pass_flg "" UBYTE SWC_FDC_type_CM_boolean_flg 0 0 0.0 1.0 ECU_ADDRESS 0x0000 /* @ECU_Address@VTQD_Function1Off2Pass_flg@ */ /end MEASUREMENT
/begin MEASUREMENT VTQD_Function1Off3Pass_flg "" UBYTE SWC_FDC_type_CM_boolean_flg 0 0 0.0 1.0 ECU_ADDRESS 0x0000 /* @ECU_Address@VTQD_Function1Off3Pass_flg@ */ /end MEASUREMENT
/begin MEASUREMENT VTQD_Function1Off4Pass_flg "" UBYTE SWC_FDC_type_CM_boolean_flg 0 0 0.0 1.0 ECU_ADDRESS 0x0000 /* @ECU_Address@VTQD_Function1Off4Pass_flg@ */ /end MEASUREMENT
/begin MEASUREMENT VTQD_Function1Off5Pass_flg "" UBYTE SWC_FDC_type_CM_boolean_flg 0 0 0.0 1.0 ECU_ADDRESS 0x0000 /* @ECU_Address@VTQD_Function1Off5Pass_flg@ */ /end MEASUREMENT
/begin MEASUREMENT VTQD_Function1Off6Pass_flg "" UBYTE SWC_FDC_type_CM_boolean_flg 0 0 0.0 1.0 ECU_ADDRESS 0x0000 /* @ECU_Address@VTQD_Function1Off6Pass_flg@ */ /end MEASUREMENT
/begin MEASUREMENT VTQD_Function1Off7Pass_flg "" UBYTE SWC_FDC_type_CM_boolean_flg 0 0 0.0 1.0 ECU_ADDRESS 0x0000 /* @ECU_Address@VTQD_Function1Off7Pass_flg@ */ /end MEASUREMENT
/begin MEASUREMENT VTQD_Function1Off8Pass_flg "" UBYTE SWC_FDC_type_CM_boolean_flg 0 0 0.0 1.0 ECU_ADDRESS 0x0000 /* @ECU_Address@VTQD_Function1Off8Pass_flg@ */ /end MEASUREMENT
/begin MEASUREMENT VTQD_Function1OffPass_flg "" UBYTE SWC_FDC_type_CM_boolean_flg 0 0 0.0 1.0 ECU_ADDRESS 0x0000 /* @ECU_Address@VTQD_Function1OffPass_flg@ */ /end MEASUREMENT
/begin MEASUREMENT VTQD_EnterKeyRest_flg "" UBYTE SWC_FDC_type_CM_boolean_flg 0 0 0.0 1.0 ECU_ADDRESS 0x0000 /* @ECU_Address@VTQD_EnterKeyRest_flg@ */ /end MEASUREMENT
/begin MEASUREMENT VTQD_N2DEnterKeyReady_flg "" UBYTE SWC_FDC_type_CM_boolean_flg 0 0 0.0 1.0 ECU_ADDRESS 0x0000 /* @ECU_Address@VTQD_N2DEnterKeyReady_flg@ */ /end MEASUREMENT
/begin MEASUREMENT VTQD_D2REnterKeyReady_flg "" UBYTE SWC_FDC_type_CM_boolean_flg 0 0 0.0 1.0 ECU_ADDRESS 0x0000 /* @ECU_Address@VTQD_D2REnterKeyReady_flg@ */ /end MEASUREMENT
/begin MEASUREMENT VTQD_R2NEnterKeyReady_flg "" UBYTE SWC_FDC_type_CM_boolean_flg 0 0 0.0 1.0 ECU_ADDRESS 0x0000 /* @ECU_Address@VTQD_R2NEnterKeyReady_flg@ */ /end MEASUREMENT
/begin MEASUREMENT VTQD_ComboKeyEnter_flg "" UBYTE SWC_FDC_type_CM_boolean_flg 0 0 0.0 1.0 ECU_ADDRESS 0x0000 /* @ECU_Address@VTQD_ComboKeyEnter_flg@ */ /end MEASUREMENT
/begin MEASUREMENT VTQD_CANCELCountReset_flg "" UBYTE SWC_FDC_type_CM_boolean_flg 0 0 0.0 1.0 ECU_ADDRESS 0x0000 /* @ECU_Address@VTQD_CANCELCountReset_flg@ */ /end MEASUREMENT
/begin MEASUREMENT VTQD_ComboKeyOff_flg "" UBYTE SWC_FDC_type_CM_boolean_flg 0 0 0.0 1.0 ECU_ADDRESS 0x0000 /* @ECU_Address@VTQD_ComboKeyOff_flg@ */ /end MEASUREMENT
/begin MEASUREMENT VTQD_Function1Off_flg "" UBYTE SWC_FDC_type_CM_boolean_flg 0 0 0.0 1.0 ECU_ADDRESS 0x0000 /* @ECU_Address@VTQD_Function1Off_flg@ */ /end MEASUREMENT
/begin MEASUREMENT VTQD_Function2Off1Pass_flg "" UBYTE SWC_FDC_type_CM_boolean_flg 0 0 0.0 1.0 ECU_ADDRESS 0x0000 /* @ECU_Address@VTQD_Function2Off1Pass_flg@ */ /end MEASUREMENT
/begin MEASUREMENT VTQD_Function2Off2Pass_flg "" UBYTE SWC_FDC_type_CM_boolean_flg 0 0 0.0 1.0 ECU_ADDRESS 0x0000 /* @ECU_Address@VTQD_Function2Off2Pass_flg@ */ /end MEASUREMENT
/begin MEASUREMENT VTQD_Function2Off3Pass_flg "" UBYTE SWC_FDC_type_CM_boolean_flg 0 0 0.0 1.0 ECU_ADDRESS 0x0000 /* @ECU_Address@VTQD_Function2Off3Pass_flg@ */ /end MEASUREMENT
/begin MEASUREMENT VTQD_Function2Off4Pass_flg "" UBYTE SWC_FDC_type_CM_boolean_flg 0 0 0.0 1.0 ECU_ADDRESS 0x0000 /* @ECU_Address@VTQD_Function2Off4Pass_flg@ */ /end MEASUREMENT
/begin MEASUREMENT VTQD_Function2Off5Pass_flg "" UBYTE SWC_FDC_type_CM_boolean_flg 0 0 0.0 1.0 ECU_ADDRESS 0x0000 /* @ECU_Address@VTQD_Function2Off5Pass_flg@ */ /end MEASUREMENT
/begin MEASUREMENT VTQD_Function2Off6Pass_flg "" UBYTE SWC_FDC_type_CM_boolean_flg 0 0 0.0 1.0 ECU_ADDRESS 0x0000 /* @ECU_Address@VTQD_Function2Off6Pass_flg@ */ /end MEASUREMENT
/begin MEASUREMENT VTQD_Function2Off7Pass_flg "" UBYTE SWC_FDC_type_CM_boolean_flg 0 0 0.0 1.0 ECU_ADDRESS 0x0000 /* @ECU_Address@VTQD_Function2Off7Pass_flg@ */ /end MEASUREMENT
/begin MEASUREMENT VTQD_Function2Off8Pass_flg "" UBYTE SWC_FDC_type_CM_boolean_flg 0 0 0.0 1.0 ECU_ADDRESS 0x0000 /* @ECU_Address@VTQD_Function2Off8Pass_flg@ */ /end MEASUREMENT
/begin MEASUREMENT VTQD_Function2OffPass_flg "" UBYTE SWC_FDC_type_CM_boolean_flg 0 0 0.0 1.0 ECU_ADDRESS 0x0000 /* @ECU_Address@VTQD_Function2OffPass_flg@ */ /end MEASUREMENT
/begin MEASUREMENT VTQD_Function2Off_flg "" UBYTE SWC_FDC_type_CM_boolean_flg 0 0 0.0 1.0 ECU_ADDRESS 0x0000 /* @ECU_Address@VTQD_Function2Off_flg@ */ /end MEASUREMENT
/begin MEASUREMENT VTQD_Function3Off1Pass_flg "" UBYTE SWC_FDC_type_CM_boolean_flg 0 0 0.0 1.0 ECU_ADDRESS 0x0000 /* @ECU_Address@VTQD_Function3Off1Pass_flg@ */ /end MEASUREMENT
/begin MEASUREMENT VTQD_Function3Off2Pass_flg "" UBYTE SWC_FDC_type_CM_boolean_flg 0 0 0.0 1.0 ECU_ADDRESS 0x0000 /* @ECU_Address@VTQD_Function3Off2Pass_flg@ */ /end MEASUREMENT
/begin MEASUREMENT VTQD_Function3Off3Pass_flg "" UBYTE SWC_FDC_type_CM_boolean_flg 0 0 0.0 1.0 ECU_ADDRESS 0x0000 /* @ECU_Address@VTQD_Function3Off3Pass_flg@ */ /end MEASUREMENT
/begin MEASUREMENT VTQD_Function3Off4Pass_flg "" UBYTE SWC_FDC_type_CM_boolean_flg 0 0 0.0 1.0 ECU_ADDRESS 0x0000 /* @ECU_Address@VTQD_Function3Off4Pass_flg@ */ /end MEASUREMENT
/begin MEASUREMENT VTQD_Function3Off5Pass_flg "" UBYTE SWC_FDC_type_CM_boolean_flg 0 0 0.0 1.0 ECU_ADDRESS 0x0000 /* @ECU_Address@VTQD_Function3Off5Pass_flg@ */ /end MEASUREMENT
/begin MEASUREMENT VTQD_Function3Off6Pass_flg "" UBYTE SWC_FDC_type_CM_boolean_flg 0 0 0.0 1.0 ECU_ADDRESS 0x0000 /* @ECU_Address@VTQD_Function3Off6Pass_flg@ */ /end MEASUREMENT
/begin MEASUREMENT VTQD_Function3Off7Pass_flg "" UBYTE SWC_FDC_type_CM_boolean_flg 0 0 0.0 1.0 ECU_ADDRESS 0x0000 /* @ECU_Address@VTQD_Function3Off7Pass_flg@ */ /end MEASUREMENT
/begin MEASUREMENT VTQD_Function3Off8Pass_flg "" UBYTE SWC_FDC_type_CM_boolean_flg 0 0 0.0 1.0 ECU_ADDRESS 0x0000 /* @ECU_Address@VTQD_Function3Off8Pass_flg@ */ /end MEASUREMENT
/begin MEASUREMENT VTQD_Function3OffPass_flg "" UBYTE SWC_FDC_type_CM_boolean_flg 0 0 0.0 1.0 ECU_ADDRESS 0x0000 /* @ECU_Address@VTQD_Function3OffPass_flg@ */ /end MEASUREMENT
/begin MEASUREMENT VTQD_Function3Off_flg "" UBYTE SWC_FDC_type_CM_boolean_flg 0 0 0.0 1.0 ECU_ADDRESS 0x0000 /* @ECU_Address@VTQD_Function3Off_flg@ */ /end MEASUREMENT
/begin MEASUREMENT VTQD_Function4Off1Pass_flg "" UBYTE SWC_FDC_type_CM_boolean_flg 0 0 0.0 1.0 ECU_ADDRESS 0x0000 /* @ECU_Address@VTQD_Function4Off1Pass_flg@ */ /end MEASUREMENT
/begin MEASUREMENT VTQD_Function4Off2Pass_flg "" UBYTE SWC_FDC_type_CM_boolean_flg 0 0 0.0 1.0 ECU_ADDRESS 0x0000 /* @ECU_Address@VTQD_Function4Off2Pass_flg@ */ /end MEASUREMENT
/begin MEASUREMENT VTQD_Function4Off3Pass_flg "" UBYTE SWC_FDC_type_CM_boolean_flg 0 0 0.0 1.0 ECU_ADDRESS 0x0000 /* @ECU_Address@VTQD_Function4Off3Pass_flg@ */ /end MEASUREMENT
/begin MEASUREMENT VTQD_Function4Off4Pass_flg "" UBYTE SWC_FDC_type_CM_boolean_flg 0 0 0.0 1.0 ECU_ADDRESS 0x0000 /* @ECU_Address@VTQD_Function4Off4Pass_flg@ */ /end MEASUREMENT
/begin MEASUREMENT VTQD_Function4Off5Pass_flg "" UBYTE SWC_FDC_type_CM_boolean_flg 0 0 0.0 1.0 ECU_ADDRESS 0x0000 /* @ECU_Address@VTQD_Function4Off5Pass_flg@ */ /end MEASUREMENT
/begin MEASUREMENT VTQD_Function4Off6Pass_flg "" UBYTE SWC_FDC_type_CM_boolean_flg 0 0 0.0 1.0 ECU_ADDRESS 0x0000 /* @ECU_Address@VTQD_Function4Off6Pass_flg@ */ /end MEASUREMENT
/begin MEASUREMENT VTQD_Function4Off7Pass_flg "" UBYTE SWC_FDC_type_CM_boolean_flg 0 0 0.0 1.0 ECU_ADDRESS 0x0000 /* @ECU_Address@VTQD_Function4Off7Pass_flg@ */ /end MEASUREMENT
/begin MEASUREMENT VTQD_Function4Off8Pass_flg "" UBYTE SWC_FDC_type_CM_boolean_flg 0 0 0.0 1.0 ECU_ADDRESS 0x0000 /* @ECU_Address@VTQD_Function4Off8Pass_flg@ */ /end MEASUREMENT
/begin MEASUREMENT VTQD_Function4OffPass_flg "" UBYTE SWC_FDC_type_CM_boolean_flg 0 0 0.0 1.0 ECU_ADDRESS 0x0000 /* @ECU_Address@VTQD_Function4OffPass_flg@ */ /end MEASUREMENT
/begin MEASUREMENT VTQD_Function4Off_flg "" UBYTE SWC_FDC_type_CM_boolean_flg 0 0 0.0 1.0 ECU_ADDRESS 0x0000 /* @ECU_Address@VTQD_Function4Off_flg@ */ /end MEASUREMENT
/begin MEASUREMENT VTQD_Function5Off1Pass_flg "" UBYTE SWC_FDC_type_CM_boolean_flg 0 0 0.0 1.0 ECU_ADDRESS 0x0000 /* @ECU_Address@VTQD_Function5Off1Pass_flg@ */ /end MEASUREMENT
/begin MEASUREMENT VTQD_Function5Off2Pass_flg "" UBYTE SWC_FDC_type_CM_boolean_flg 0 0 0.0 1.0 ECU_ADDRESS 0x0000 /* @ECU_Address@VTQD_Function5Off2Pass_flg@ */ /end MEASUREMENT
/begin MEASUREMENT VTQD_Function5Off3Pass_flg "" UBYTE SWC_FDC_type_CM_boolean_flg 0 0 0.0 1.0 ECU_ADDRESS 0x0000 /* @ECU_Address@VTQD_Function5Off3Pass_flg@ */ /end MEASUREMENT
/begin MEASUREMENT VTQD_Function5Off4Pass_flg "" UBYTE SWC_FDC_type_CM_boolean_flg 0 0 0.0 1.0 ECU_ADDRESS 0x0000 /* @ECU_Address@VTQD_Function5Off4Pass_flg@ */ /end MEASUREMENT
/begin MEASUREMENT VTQD_Function5Off5Pass_flg "" UBYTE SWC_FDC_type_CM_boolean_flg 0 0 0.0 1.0 ECU_ADDRESS 0x0000 /* @ECU_Address@VTQD_Function5Off5Pass_flg@ */ /end MEASUREMENT
/begin MEASUREMENT VTQD_Function5Off6Pass_flg "" UBYTE SWC_FDC_type_CM_boolean_flg 0 0 0.0 1.0 ECU_ADDRESS 0x0000 /* @ECU_Address@VTQD_Function5Off6Pass_flg@ */ /end MEASUREMENT
/begin MEASUREMENT VTQD_Function5Off7Pass_flg "" UBYTE SWC_FDC_type_CM_boolean_flg 0 0 0.0 1.0 ECU_ADDRESS 0x0000 /* @ECU_Address@VTQD_Function5Off7Pass_flg@ */ /end MEASUREMENT
/begin MEASUREMENT VTQD_Function5Off8Pass_flg "" UBYTE SWC_FDC_type_CM_boolean_flg 0 0 0.0 1.0 ECU_ADDRESS 0x0000 /* @ECU_Address@VTQD_Function5Off8Pass_flg@ */ /end MEASUREMENT
/begin MEASUREMENT VTQD_Function5OffPass_flg "" UBYTE SWC_FDC_type_CM_boolean_flg 0 0 0.0 1.0 ECU_ADDRESS 0x0000 /* @ECU_Address@VTQD_Function5OffPass_flg@ */ /end MEASUREMENT
/begin MEASUREMENT VTQD_Function5Off_flg "" UBYTE SWC_FDC_type_CM_boolean_flg 0 0 0.0 1.0 ECU_ADDRESS 0x0000 /* @ECU_Address@VTQD_Function5Off_flg@ */ /end MEASUREMENT
/begin MEASUREMENT VTQD_CANCELCountDetFinish_flg "" UBYTE SWC_FDC_type_CM_boolean_flg 0 0 0.0 1.0 ECU_ADDRESS 0x0000 /* @ECU_Address@VTQD_CANCELCountDetFinish_flg@ */ /end MEASUREMENT
/begin MEASUREMENT VTQD_TUpAReadyReset_flg "" UBYTE SWC_FDC_type_CM_boolean_flg 0 0 0.0 1.0 ECU_ADDRESS 0x0000 /* @ECU_Address@VTQD_TUpAReadyReset_flg@ */ /end MEASUREMENT
/begin MEASUREMENT VTQD_ParkingPawlPwrOn_flg "" UBYTE SWC_FDC_type_CM_boolean_flg 0 0 0.0 1.0 ECU_ADDRESS 0x0000 /* @ECU_Address@VTQD_ParkingPawlPwrOn_flg@ */ /end MEASUREMENT
/begin MEASUREMENT VTQD_ParkingPawlEnable_flg "" UBYTE SWC_FDC_type_CM_boolean_flg 0 0 0.0 1.0 ECU_ADDRESS 0x0000 /* @ECU_Address@VTQD_ParkingPawlEnable_flg@ */ /end MEASUREMENT
/begin MEASUREMENT VDHP_EAPS1BAD_flg "" UBYTE SWC_FDC_type_CM_boolean_flg 0 0 0.0 1.0 ECU_ADDRESS 0x0000 /* @ECU_Address@VDHP_EAPS1BAD_flg@ */ /end MEASUREMENT
/begin MEASUREMENT VDHP_EAPCRBAD_flg "" UBYTE SWC_FDC_type_CM_boolean_flg 0 0 0.0 1.0 ECU_ADDRESS 0x0000 /* @ECU_Address@VDHP_EAPCRBAD_flg@ */ /end MEASUREMENT
/begin MEASUREMENT VDHP_EAPS1LearnInRange_flg "" UBYTE SWC_FDC_type_CM_boolean_flg 0 0 0.0 1.0 ECU_ADDRESS 0x0000 /* @ECU_Address@VDHP_EAPS1LearnInRange_flg@ */ /end MEASUREMENT
/begin MEASUREMENT VDHP_EAPS1NRMStable_flg "" UBYTE SWC_FDC_type_CM_boolean_flg 0 0 0.0 1.0 ECU_ADDRESS 0x0000 /* @ECU_Address@VDHP_EAPS1NRMStable_flg@ */ /end MEASUREMENT
/begin MEASUREMENT VDHP_EAPS1LearnDwEnable_flg "" UBYTE SWC_FDC_type_CM_boolean_flg 0 0 0.0 1.0 ECU_ADDRESS 0x0000 /* @ECU_Address@VDHP_EAPS1LearnDwEnable_flg@ */ /end MEASUREMENT
/begin MEASUREMENT VDHP_EAPSLearnUpEnable_flg "" UBYTE SWC_FDC_type_CM_boolean_flg 0 0 0.0 1.0 ECU_ADDRESS 0x0000 /* @ECU_Address@VDHP_EAPSLearnUpEnable_flg@ */ /end MEASUREMENT
/begin MEASUREMENT VDHP_EAPS1Learned_flg "" UBYTE SWC_FDC_type_CM_boolean_flg 0 0 0.0 1.0 ECU_ADDRESS 0x0000 /* @ECU_Address@VDHP_EAPS1Learned_flg@ */ /end MEASUREMENT
/begin MEASUREMENT VDHP_EAPS2BAD_flg "" UBYTE SWC_FDC_type_CM_boolean_flg 0 0 0.0 1.0 ECU_ADDRESS 0x0000 /* @ECU_Address@VDHP_EAPS2BAD_flg@ */ /end MEASUREMENT
/begin MEASUREMENT VDHP_EAPS2LearnInRange_flg "" UBYTE SWC_FDC_type_CM_boolean_flg 0 0 0.0 1.0 ECU_ADDRESS 0x0000 /* @ECU_Address@VDHP_EAPS2LearnInRange_flg@ */ /end MEASUREMENT
/begin MEASUREMENT VDHP_EAPS2NRMStable_flg "" UBYTE SWC_FDC_type_CM_boolean_flg 0 0 0.0 1.0 ECU_ADDRESS 0x0000 /* @ECU_Address@VDHP_EAPS2NRMStable_flg@ */ /end MEASUREMENT
/begin MEASUREMENT VDHP_EAPS2LearnDwEnable_flg "" UBYTE SWC_FDC_type_CM_boolean_flg 0 0 0.0 1.0 ECU_ADDRESS 0x0000 /* @ECU_Address@VDHP_EAPS2LearnDwEnable_flg@ */ /end MEASUREMENT
/begin MEASUREMENT VDHP_EAPS2Learned_flg "" UBYTE SWC_FDC_type_CM_boolean_flg 0 0 0.0 1.0 ECU_ADDRESS 0x0000 /* @ECU_Address@VDHP_EAPS2Learned_flg@ */ /end MEASUREMENT
/begin MEASUREMENT VDHP_PedalIncreasing_flg "" UBYTE SWC_FDC_type_CM_boolean_flg 0 0 0.0 1.0 ECU_ADDRESS 0x0000 /* @ECU_Address@VDHP_PedalIncreasing_flg@ */ /end MEASUREMENT
/begin MEASUREMENT VDHP_LowIdleAccPedal_flg "" UBYTE SWC_FDC_type_CM_boolean_flg 0 0 0.0 1.0 ECU_ADDRESS 0x0000 /* @ECU_Address@VDHP_LowIdleAccPedal_flg@ */ /end MEASUREMENT
/begin MEASUREMENT VDHP_AccPedalSWSta_flg "" UBYTE SWC_FDC_type_CM_boolean_flg 0 0 0.0 1.0 ECU_ADDRESS 0x0000 /* @ECU_Address@VDHP_AccPedalSWSta_flg@ */ /end MEASUREMENT
/begin MEASUREMENT VPMM_HVUnitSelfChkCompleted4PU_flg "" UBYTE SWC_FDC_type_CM_boolean_flg 0 0 0.0 1.0 ECU_ADDRESS 0x0000 /* @ECU_Address@VPMM_HVUnitSelfChkCompleted4PU_flg@ */ /end MEASUREMENT
/begin MEASUREMENT VPMM_HVILDetectFail_flg "" UBYTE SWC_FDC_type_CM_boolean_flg 0 0 0.0 1.0 ECU_ADDRESS 0x0000 /* @ECU_Address@VPMM_HVILDetectFail_flg@ */ /end MEASUREMENT
/begin MEASUREMENT VPMM_HVILFail_flg "" UBYTE SWC_FDC_type_CM_boolean_flg 0 0 0.0 1.0 ECU_ADDRESS 0x0000 /* @ECU_Address@VPMM_HVILFail_flg@ */ /end MEASUREMENT
/begin MEASUREMENT VPMM_HVFailureChkPass_flg "" UBYTE SWC_FDC_type_CM_boolean_flg 0 0 0.0 1.0 ECU_ADDRESS 0x0000 /* @ECU_Address@VPMM_HVFailureChkPass_flg@ */ /end MEASUREMENT
/begin MEASUREMENT VPMM_Boot2Initialize_flg "" UBYTE SWC_FDC_type_CM_boolean_flg 0 0 0.0 1.0 ECU_ADDRESS 0x0000 /* @ECU_Address@VPMM_Boot2Initialize_flg@ */ /end MEASUREMENT
/begin MEASUREMENT VPMM_AfterRun2Initialize_flg "" UBYTE SWC_FDC_type_CM_boolean_flg 0 0 0.0 1.0 ECU_ADDRESS 0x0000 /* @ECU_Address@VPMM_AfterRun2Initialize_flg@ */ /end MEASUREMENT
/begin MEASUREMENT VPMM_LVBattDetLow_flg "" UBYTE SWC_FDC_type_CM_boolean_flg 0 0 0.0 1.0 ECU_ADDRESS 0x0000 /* @ECU_Address@VPMM_LVBattDetLow_flg@ */ /end MEASUREMENT
/begin MEASUREMENT VPMM_DCDCVolLowTO_flg "" UBYTE SWC_FDC_type_CM_boolean_flg 0 0 0.0 1.0 ECU_ADDRESS 0x0000 /* @ECU_Address@VPMM_DCDCVolLowTO_flg@ */ /end MEASUREMENT
/begin MEASUREMENT VPMM_LVChrgPreActFinished_flg "" UBYTE SWC_FDC_type_CM_boolean_flg 0 0 0.0 1.0 ECU_ADDRESS 0x0000 /* @ECU_Address@VPMM_LVChrgPreActFinished_flg@ */ /end MEASUREMENT
/begin MEASUREMENT VPMM_LVChrgIinit2Idle_flg "" UBYTE SWC_FDC_type_CM_boolean_flg 0 0 0.0 1.0 ECU_ADDRESS 0x0000 /* @ECU_Address@VPMM_LVChrgIinit2Idle_flg@ */ /end MEASUREMENT
/begin MEASUREMENT VPMM_Initialize2Idle_flg "" UBYTE SWC_FDC_type_CM_boolean_flg 0 0 0.0 1.0 ECU_ADDRESS 0x0000 /* @ECU_Address@VPMM_Initialize2Idle_flg@ */ /end MEASUREMENT
/begin MEASUREMENT VPMM_Initialize2Charge_flg "" UBYTE SWC_FDC_type_CM_boolean_flg 0 0 0.0 1.0 ECU_ADDRESS 0x0000 /* @ECU_Address@VPMM_Initialize2Charge_flg@ */ /end MEASUREMENT
/begin MEASUREMENT VPMM_LVChrgInit2PowerUp_flg "" UBYTE SWC_FDC_type_CM_boolean_flg 0 0 0.0 1.0 ECU_ADDRESS 0x0000 /* @ECU_Address@VPMM_LVChrgInit2PowerUp_flg@ */ /end MEASUREMENT
/begin MEASUREMENT VPMM_Initialize2PowerUp_flg "" UBYTE SWC_FDC_type_CM_boolean_flg 0 0 0.0 1.0 ECU_ADDRESS 0x0000 /* @ECU_Address@VPMM_Initialize2PowerUp_flg@ */ /end MEASUREMENT
/begin MEASUREMENT VPMM_LostHVComActivePwrDown_flg "" UBYTE SWC_FDC_type_CM_boolean_flg 0 0 0.0 1.0 ECU_ADDRESS 0x0000 /* @ECU_Address@VPMM_LostHVComActivePwrDown_flg@ */ /end MEASUREMENT
/begin MEASUREMENT VPMM_RCIncorrect_flg "" UBYTE SWC_FDC_type_CM_boolean_flg 0 0 0.0 1.0 ECU_ADDRESS 0x0000 /* @ECU_Address@VPMM_RCIncorrect_flg@ */ /end MEASUREMENT
/begin MEASUREMENT VPMM_PowerUp2PowerDown_flg "" UBYTE SWC_FDC_type_CM_boolean_flg 0 0 0.0 1.0 ECU_ADDRESS 0x0000 /* @ECU_Address@VPMM_PowerUp2PowerDown_flg@ */ /end MEASUREMENT
/begin MEASUREMENT VPMM_HVRlyNoFeedBack_flg "" UBYTE SWC_FDC_type_CM_boolean_flg 0 0 0.0 1.0 ECU_ADDRESS 0x0000 /* @ECU_Address@VPMM_HVRlyNoFeedBack_flg@ */ /end MEASUREMENT
/begin MEASUREMENT VPMM_LVChrgBattdetEnd_flg "" UBYTE SWC_FDC_type_CM_boolean_flg 0 0 0.0 1.0 ECU_ADDRESS 0x0000 /* @ECU_Address@VPMM_LVChrgBattdetEnd_flg@ */ /end MEASUREMENT
/begin MEASUREMENT VPMM_LVChrgDetFault_flg "" UBYTE SWC_FDC_type_CM_boolean_flg 0 0 0.0 1.0 ECU_ADDRESS 0x0000 /* @ECU_Address@VPMM_LVChrgDetFault_flg@ */ /end MEASUREMENT
/begin MEASUREMENT VPMM_LVChrgFinished_flg "" UBYTE SWC_FDC_type_CM_boolean_flg 0 0 0.0 1.0 ECU_ADDRESS 0x0000 /* @ECU_Address@VPMM_LVChrgFinished_flg@ */ /end MEASUREMENT
/begin MEASUREMENT VPMM_LongIdleDriveCon_flg "" UBYTE SWC_FDC_type_CM_boolean_flg 0 0 0.0 1.0 ECU_ADDRESS 0x0000 /* @ECU_Address@VPMM_LongIdleDriveCon_flg@ */ /end MEASUREMENT
/begin MEASUREMENT VPMM_LongIdleDoorCon_flg "" UBYTE SWC_FDC_type_CM_boolean_flg 0 0 0.0 1.0 ECU_ADDRESS 0x0000 /* @ECU_Address@VPMM_LongIdleDoorCon_flg@ */ /end MEASUREMENT
/begin MEASUREMENT VPMM_LongIdlePowerCon_flg "" UBYTE SWC_FDC_type_CM_boolean_flg 0 0 0.0 1.0 ECU_ADDRESS 0x0000 /* @ECU_Address@VPMM_LongIdlePowerCon_flg@ */ /end MEASUREMENT
/begin MEASUREMENT VPMM_LongIdleEn_flg "" UBYTE SWC_FDC_type_CM_boolean_flg 0 0 0.0 1.0 ECU_ADDRESS 0x0000 /* @ECU_Address@VPMM_LongIdleEn_flg@ */ /end MEASUREMENT
/begin MEASUREMENT VPMM_LongIdleDetFinsh_flg "" UBYTE SWC_FDC_type_CM_boolean_flg 0 0 0.0 1.0 ECU_ADDRESS 0x0000 /* @ECU_Address@VPMM_LongIdleDetFinsh_flg@ */ /end MEASUREMENT
/begin MEASUREMENT VPMM_LongIdle_flg "" UBYTE SWC_FDC_type_CM_boolean_flg 0 0 0.0 1.0 ECU_ADDRESS 0x0000 /* @ECU_Address@VPMM_LongIdle_flg@ */ /end MEASUREMENT
/begin MEASUREMENT VPMM_Drive2PowerDown_flg "" UBYTE SWC_FDC_type_CM_boolean_flg 0 0 0.0 1.0 ECU_ADDRESS 0x0000 /* @ECU_Address@VPMM_Drive2PowerDown_flg@ */ /end MEASUREMENT
/begin MEASUREMENT VPMM_Charge2PowerDown_flg "" UBYTE SWC_FDC_type_CM_boolean_flg 0 0 0.0 1.0 ECU_ADDRESS 0x0000 /* @ECU_Address@VPMM_Charge2PowerDown_flg@ */ /end MEASUREMENT
/begin MEASUREMENT VPMM_LVChrgDCDCEn_flg "" UBYTE SWC_FDC_type_CM_boolean_flg 0 0 0.0 1.0 ECU_ADDRESS 0x0000 /* @ECU_Address@VPMM_LVChrgDCDCEn_flg@ */ /end MEASUREMENT
/begin MEASUREMENT VPMM_LVChrgDCDCDis_flg "" UBYTE SWC_FDC_type_CM_boolean_flg 0 0 0.0 1.0 ECU_ADDRESS 0x0000 /* @ECU_Address@VPMM_LVChrgDCDCDis_flg@ */ /end MEASUREMENT
/begin MEASUREMENT VPMM_LongIdleBuzzer_flg "" UBYTE SWC_FDC_type_CM_boolean_flg 0 0 0.0 1.0 ECU_ADDRESS 0x0000 /* @ECU_Address@VPMM_LongIdleBuzzer_flg@ */ /end MEASUREMENT
/begin MEASUREMENT VPMM_LVChrgDuRBuzzer_flg "" UBYTE SWC_FDC_type_CM_boolean_flg 0 0 0.0 1.0 ECU_ADDRESS 0x0000 /* @ECU_Address@VPMM_LVChrgDuRBuzzer_flg@ */ /end MEASUREMENT
/begin MEASUREMENT VPMM_LVChrgDuBrkLamp_flg "" UBYTE SWC_FDC_type_CM_boolean_flg 0 0 0.0 1.0 ECU_ADDRESS 0x0000 /* @ECU_Address@VPMM_LVChrgDuBrkLamp_flg@ */ /end MEASUREMENT
/begin MEASUREMENT VPMM_LVChrgPreActRBuzzer_flg "" UBYTE SWC_FDC_type_CM_boolean_flg 0 0 0.0 1.0 ECU_ADDRESS 0x0000 /* @ECU_Address@VPMM_LVChrgPreActRBuzzer_flg@ */ /end MEASUREMENT
/begin MEASUREMENT VPMM_LVChrgPreActRLamp_flg "" UBYTE SWC_FDC_type_CM_boolean_flg 0 0 0.0 1.0 ECU_ADDRESS 0x0000 /* @ECU_Address@VPMM_LVChrgPreActRLamp_flg@ */ /end MEASUREMENT
/begin MEASUREMENT VPMM_LVChrgPreActBrkLamp_flg "" UBYTE SWC_FDC_type_CM_boolean_flg 0 0 0.0 1.0 ECU_ADDRESS 0x0000 /* @ECU_Address@VPMM_LVChrgPreActBrkLamp_flg@ */ /end MEASUREMENT
/begin MEASUREMENT VPMM_TrigRBuzeer_flg "" UBYTE SWC_FDC_type_CM_boolean_flg 0 0 0.0 1.0 ECU_ADDRESS 0x0000 /* @ECU_Address@VPMM_TrigRBuzeer_flg@ */ /end MEASUREMENT
/begin MEASUREMENT VPMM_TrigRLamp_flg "" UBYTE SWC_FDC_type_CM_boolean_flg 0 0 0.0 1.0 ECU_ADDRESS 0x0000 /* @ECU_Address@VPMM_TrigRLamp_flg@ */ /end MEASUREMENT
/begin MEASUREMENT VPMM_TrigBrkLamp_flg "" UBYTE SWC_FDC_type_CM_boolean_flg 0 0 0.0 1.0 ECU_ADDRESS 0x0000 /* @ECU_Address@VPMM_TrigBrkLamp_flg@ */ /end MEASUREMENT
/begin MEASUREMENT VPMM_LVChrgDuRLamp_flg "" UBYTE SWC_FDC_type_CM_boolean_flg 0 0 0.0 1.0 ECU_ADDRESS 0x0000 /* @ECU_Address@VPMM_LVChrgDuRLamp_flg@ */ /end MEASUREMENT
/begin MEASUREMENT VDHP_EPEDLINDMem_pct "" FLOAT32_IEEE SWC_FDC_type_CM_single_pct 0 0 0.0 120.0 ECU_ADDRESS 0x0000 /* @ECU_Address@VDHP_EPEDLINDMem_pct@ */ /end MEASUREMENT
/begin MEASUREMENT VDHP_Dec2IncMemoryReset_flg "" UBYTE SWC_FDC_type_CM_boolean_flg 0 0 0.0 1.0 ECU_ADDRESS 0x0000 /* @ECU_Address@VDHP_Dec2IncMemoryReset_flg@ */ /end MEASUREMENT
/begin MEASUREMENT VDHP_Dec2IncPctMemorize_flg "" UBYTE SWC_FDC_type_CM_boolean_flg 0 0 0.0 1.0 ECU_ADDRESS 0x0000 /* @ECU_Address@VDHP_Dec2IncPctMemorize_flg@ */ /end MEASUREMENT
/begin MEASUREMENT VDHP_Inc2DecMemoryReset_flg "" UBYTE SWC_FDC_type_CM_boolean_flg 0 0 0.0 1.0 ECU_ADDRESS 0x0000 /* @ECU_Address@VDHP_Inc2DecMemoryReset_flg@ */ /end MEASUREMENT
/begin MEASUREMENT VDHP_Inc2DecPctMemorize_flg "" UBYTE SWC_FDC_type_CM_boolean_flg 0 0 0.0 1.0 ECU_ADDRESS 0x0000 /* @ECU_Address@VDHP_Inc2DecPctMemorize_flg@ */ /end MEASUREMENT
/begin MEASUREMENT SWC_FDC_type_DW.tp_Standby "" UBYTE SWC_FDC_type_CM_uint8 0 0 0 255 ECU_ADDRESS 0x0000 /* @ECU_Address@SWC_FDC_type_DW.tp_Standby@ */ /end MEASUREMENT
/begin COMPU_METHOD SWC_FDC_type_CM_single_rpm "Q = V" RAT_FUNC "%8.6" "rpm" COEFFS 0 1 0 0 0 1 /end COMPU_METHOD
/begin COMPU_METHOD SWC_FDC_type_CM_single_pct "Q = V" RAT_FUNC "%8.6" "pct" COEFFS 0 1 0 0 0 1 /end COMPU_METHOD
/begin COMPU_METHOD SWC_FDC_type_CM_single_Gain "Q = V" RAT_FUNC "%8.6" "Gain" COEFFS 0 1 0 0 0 1 /end COMPU_METHOD
/begin COMPU_METHOD SWC_FDC_type_CM_single_Nm "Q = V" RAT_FUNC "%8.6" "Nm" COEFFS 0 1 0 0 0 1 /end COMPU_METHOD
/begin COMPU_METHOD SWC_FDC_type_CM_single_NM "Q = V" RAT_FUNC "%8.6" "NM" COEFFS 0 1 0 0 0 1 /end COMPU_METHOD
/begin COMPU_METHOD SWC_FDC_type_CM_single_enum "Q = V" RAT_FUNC "%8.6" "enum" COEFFS 0 1 0 0 0 1 /end COMPU_METHOD
/begin COMPU_METHOD SWC_FDC_type_CM_single_gain "Q = V" RAT_FUNC "%8.6" "gain" COEFFS 0 1 0 0 0 1 /end COMPU_METHOD
/begin COMPU_METHOD SWC_FDC_type_CM_single_A "Q = V" RAT_FUNC "%8.6" "A" COEFFS 0 1 0 0 0 1 /end COMPU_METHOD
/begin COMPU_METHOD SWC_FDC_type_CM_single_s "Q = V" RAT_FUNC "%8.6" "s" COEFFS 0 1 0 0 0 1 /end COMPU_METHOD
/begin COMPU_METHOD SWC_FDC_type_CM_single_kph "Q = V" RAT_FUNC "%8.6" "kph" COEFFS 0 1 0 0 0 1 /end COMPU_METHOD
/begin COMPU_METHOD SWC_FDC_type_CM_single_V "Q = V" RAT_FUNC "%8.6" "V" COEFFS 0 1 0 0 0 1 /end COMPU_METHOD
/begin COMPU_METHOD SWC_FDC_type_CM_single_deg "Q = V" RAT_FUNC "%8.6" "deg" COEFFS 0 1 0 0 0 1 /end COMPU_METHOD
/begin COMPU_METHOD SWC_FDC_type_CM_single_sec "Q = V" RAT_FUNC "%8.6" "sec" COEFFS 0 1 0 0 0 1 /end COMPU_METHOD
/begin COMPU_METHOD SWC_FDC_type_CM_single_cnt "Q = V" RAT_FUNC "%8.6" "cnt" COEFFS 0 1 0 0 0 1 /end COMPU_METHOD
/begin COMPU_METHOD SWC_FDC_type_CM_single_c "Q = V" RAT_FUNC "%8.6" "c" COEFFS 0 1 0 0 0 1 /end COMPU_METHOD
/begin COMPU_METHOD SWC_FDC_type_CM_single_mps2 "Q = V" RAT_FUNC "%8.6" "mps2" COEFFS 0 1 0 0 0 1 /end COMPU_METHOD
/begin COMPU_METHOD SWC_FDC_type_CM_single_rat "Q = V" RAT_FUNC "%8.6" "rat" COEFFS 0 1 0 0 0 1 /end COMPU_METHOD
/begin COMPU_METHOD SWC_FDC_type_CM_single_kW "Q = V" RAT_FUNC "%8.6" "kW" COEFFS 0 1 0 0 0 1 /end COMPU_METHOD
/begin COMPU_METHOD SWC_FDC_type_CM_uint16_cnt "Q = V" RAT_FUNC "%5.0" "cnt" COEFFS 0 1 0 0 0 1 /end COMPU_METHOD
/begin COMPU_METHOD SWC_FDC_type_CM_boolean_flg "Q = V" RAT_FUNC "%1.0" "flg" COEFFS 0 1 0 0 0 1 /end COMPU_METHOD
/begin COMPU_METHOD SWC_FDC_type_CM_uint8_enum "Q = V" RAT_FUNC "%3.0" "enum" COEFFS 0 1 0 0 0 1 /end COMPU_METHOD
/begin COMPU_METHOD SWC_FDC_type_CM_uint8_cnt "Q = V" RAT_FUNC "%3.0" "cnt" COEFFS 0 1 0 0 0 1 /end COMPU_METHOD
/begin COMPU_METHOD SWC_FDC_type_CM_uint8 "Q = V" RAT_FUNC "%3.0" "" COEFFS 0 1 0 0 0 1 /end COMPU_METHOD
/begin GROUP S205_Calculation "SWC_FDC_type/run_SWC_FDC_RxTx_5ms_sys/APP/DHP/DHP/APS_calaulation/Calculation"
 /begin REF_CHARACTERISTIC KDHP_AccPedalDepressed_pct KDHP_AccPedalReleased_pct KDHP_AcceleratorLoadScalr_gain KDHP_ActAPSPosn_pct_ovrdflg KDHP_ActAPSPosn_pct_ovrdval KDHP_DeadBand_pct KDHP_EAPS11OutWT_gain KDHP_EAPS12OutWT_gain KDHP_EAPS1AOutWT_gain KDHP_EAPS1WT_gain KDHP_EAPS21OutWT_gain KDHP_EAPS22OutWT_gain KDHP_EAPS2AOutWT_gain KDHP_EAPS2WT_gain KDHP_EAPSCRBadWDSP_pct KDHP_EPEDPOSNUpLimit_pct MDHP_HysOffset_Y_pct /end REF_CHARACTERISTIC
 /begin REF_MEASUREMENT VDHP_AccPedalSWSta_flg VDHP_ActAPSPosn_pct VDHP_Dec2IncMemoryReset_flg VDHP_Dec2IncPctMemorize_flg VDHP_EAPS1DIS_pct VDHP_EAPS2DIS_pct VDHP_EAPSWDSP_pct VDHP_EPEDLINDMem_pct VDHP_EPEDLIND_pct VDHP_HysOffset_pct VDHP_Inc2DecMemoryReset_flg VDHP_Inc2DecPctMemorize_flg VDHP_LowIdleAccPedal_flg VDHP_PedalIncreasing_flg /end REF_MEASUREMENT
/end GROUP
/begin GROUP S205_StateJudge "SWC_FDC_type/run_SWC_FDC_RxTx_5ms_sys/APP/DHP/DHP/APS_calaulation/StateJudge"
 /begin REF_CHARACTERISTIC KDHP_EAPS12DisagreeTime_s KDHP_EAPS12Disagree_pct KDHP_EAPS1BADHigh_pct KDHP_EAPS1BADLow_pct KDHP_EAPS1BADTime_s KDHP_EAPS2BADHigh_pct KDHP_EAPS2BADLow_pct KDHP_EAPS2BADTime_s KDHP_EAPS2Offset_pct KDHP_EAPS2Scaler_gain /end REF_CHARACTERISTIC
 /begin REF_MEASUREMENT VDHP_EAPCRBAD_flg VDHP_EAPS12RangeSta_enum VDHP_EAPS1BAD_flg VDHP_EAPS1NRM_pct VDHP_EAPS2BAD_flg VDHP_EAPS2NRM_pct /end REF_MEASUREMENT
/end GROUP
/begin GROUP S205_ZPLearn "SWC_FDC_type/run_SWC_FDC_RxTx_5ms_sys/APP/DHP/DHP/APS_calaulation/ZPLearn" /begin SUB_GROUP S209_Latch1 S209_Latch2 /end SUB_GROUP
 /begin REF_CHARACTERISTIC KDHP_EAPS1MINInitLowLim_pct KDHP_EAPS1MINInitUpLim_pct KDHP_EAPS1Min_pct_ovrdflg KDHP_EAPS1Min_pct_ovrdval KDHP_EAPS2MINInitLowLim_pct KDHP_EAPS2MINInitUpLim_pct KDHP_EAPS2Min_pct_ovrdflg KDHP_EAPS2Min_pct_ovrdval KDHP_EAPSLearnDwHigh_pct KDHP_EAPSLearnDwLow_pct KDHP_EAPSLearnDwMAX_pct KDHP_EAPSLearnUpHigh_pct KDHP_EAPSLearnUpLow_pct KDHP_EAPSLearnUpOffset_pct KDHP_EAPSMINLowerLimit_pct KDHP_EAPSStableThrsh_pct KDHP_EAPSStableTime_s KDHP_GetNRMBaseTime_s KDHP_LVBattHighLimit_V KDHP_LVBattHigh_V KDHP_LVBattLow_V /end REF_CHARACTERISTIC
 /begin REF_MEASUREMENT VDHP_EAPS1LearnDwEnable_flg VDHP_EAPS1LearnInRange_flg VDHP_EAPS1MINInit_pct VDHP_EAPS1MIN_pct VDHP_EAPS1NRMDiff_pct VDHP_EAPS1NRMStable_flg VDHP_EAPS2LearnDwEnable_flg VDHP_EAPS2LearnInRange_flg VDHP_EAPS2MINInit_pct VDHP_EAPS2MIN_pct VDHP_EAPS2NRMDiff_pct VDHP_EAPS2NRMStable_flg VDHP_EAPSLearnUpEnable_flg /end REF_MEASUREMENT
/end GROUP
/begin GROUP S232_EHPS_Initialization "SWC_FDC_type/run_SWC_FDC_RxTx_5ms_sys/APP/PMM/PowerModeManagement/PMM Flag Creator /EHPS Initialization" /begin REF_CHARACTERISTIC KPMM_EHPSEnSpdDiv_rpm KPMM_EHPSIniHoldTime_s /end REF_CHARACTERISTIC /end GROUP
/begin GROUP S232_Flag_with_Condition "SWC_FDC_type/run_SWC_FDC_RxTx_5ms_sys/APP/PMM/PowerModeManagement/PMM Flag Creator /Flag with Condition"
 /begin REF_CHARACTERISTIC KPMM_HVRlyNoFBVehSpd_kph KPMM_LostComBCUPDVehSpd_kph KPMM_LostComMCUPDVehSpd_kph KPMM_LostComPDUPDVehSpd_kph KPMM_MCURCIncorrectVehSpd_kph KPMM_RCIncorrectVehSpd_kph /end REF_CHARACTERISTIC
 /begin REF_MEASUREMENT VPMM_HVRlyNoFeedBack_flg VPMM_LostHVComActivePwrDown_flg VPMM_RCIncorrect_flg /end REF_MEASUREMENT
/end GROUP
/begin GROUP S232_HVIL_Judgement "SWC_FDC_type/run_SWC_FDC_RxTx_5ms_sys/APP/PMM/PowerModeManagement/PMM Flag Creator /HVIL Judgement"
 /begin SUB_GROUP S238_DelayEnable S238_Signal_reach_time_counter S238_Signal_reach_time_counter1 /end SUB_GROUP
 /begin REF_CHARACTERISTIC KPMM_HVILDetFailDelayTime_s KPMM_HVILEmergencyStop_flg_ovrdflg KPMM_HVILEmergencyStop_flg_ovrdval KPMM_HVILSourceSelect_flg /end REF_CHARACTERISTIC
 /begin REF_MEASUREMENT VPMM_HVILFail_flg /end REF_MEASUREMENT
/end GROUP
/begin GROUP S232_Long_Idle_Detection "SWC_FDC_type/run_SWC_FDC_RxTx_5ms_sys/APP/PMM/PowerModeManagement/PMM Flag Creator /Long Idle Detection" /begin SUB_GROUP S239_DelayEnable1 /end SUB_GROUP
 /begin REF_CHARACTERISTIC KPMM_LongIdleBuzzerFlashTime_s KPMM_LongIdleDectMotorSpd_rpm KPMM_LongIdleDectTime_s KPMM_LongIdleDectVehSpd_kph KPMM_LongIdleDetSW_flg /end REF_CHARACTERISTIC
 /begin REF_MEASUREMENT VPMM_LongIdleDetFinsh_flg VPMM_LongIdleDoorCon_flg VPMM_LongIdleDriveCon_flg VPMM_LongIdleEn_flg VPMM_LongIdlePowerCon_flg /end REF_MEASUREMENT
/end GROUP
/begin GROUP S232_Low_Battery_Voltage "SWC_FDC_type/run_SWC_FDC_RxTx_5ms_sys/APP/PMM/PowerModeManagement/PMM Flag Creator /Low Battery Voltage"
 /begin SUB_GROUP S240_Latch S240_Latch1 S240_Long_Idle_Flasher S240_Low_Voltage_Charge_Action_Flasher S240_Low_Voltage_Charge_Pre_Action_Flasher /end SUB_GROUP
 /begin REF_CHARACTERISTIC KPMM_LVChrgDCDCDisTimer_s KPMM_LVChrgDCDCEnTimer_s KPMM_LVChrgDisHVSOC_pct KPMM_LVChrgDisVoltageDet_V KPMM_LVChrgDisVoltageDur_V KPMM_LVChrgEnHVSOC_pct KPMM_LVChrgEnVoltageDet_V KPMM_LVChrgEnVoltageDur_V KPMM_LVChrgPreAction_s KPMM_LVChrgPreAlarm_s KPMM_LongIdleBuzzerSW_flg /end REF_CHARACTERISTIC
 /begin REF_MEASUREMENT VPMM_DCDCVolLowTO_flg VPMM_LVBattDetLow_flg VPMM_LVBattLowInd_enum VPMM_LVChrgBattdetEnd_flg VPMM_LVChrgDCDCDis_flg VPMM_LVChrgDCDCEn_flg VPMM_LVChrgDetFault_flg VPMM_TrigBrkLamp_flg VPMM_TrigRBuzeer_flg VPMM_TrigRLamp_flg /end REF_MEASUREMENT
/end GROUP
/begin GROUP S232_MCU_Status2_Lost_Communication "SWC_FDC_type/run_SWC_FDC_RxTx_5ms_sys/APP/PMM/PowerModeManagement/PMM Flag Creator /MCU Status2 Lost Communication" /begin REF_CHARACTERISTIC KPMM_MCUSta2Lost4Sleep_s /end REF_CHARACTERISTIC /end GROUP
/begin GROUP S232_PMM_Relay_open_Chk__HV_unit_Chk "SWC_FDC_type/run_SWC_FDC_RxTx_5ms_sys/APP/PMM/PowerModeManagement/PMM Flag Creator /PMM_Relay_open_Chk//HV_unit_Chk"
 /begin REF_CHARACTERISTIC KPMM_ActTimeHVILFail_s KPMM_ActTimeHVpwrOffReq_s KPMM_ActTimeMCUFail_s KPMM_ActTimePDUFail_s KPMM_HVFailureMCUByPass_ovrdflg KPMM_HVFailureMCUByPass_ovrdval /end REF_CHARACTERISTIC
 /begin REF_MEASUREMENT VPMM_HVFailureChkPass_flg VPMM_HVUnitSelfChkCompleted4PU_flg /end REF_MEASUREMENT
/end GROUP
/begin GROUP S233_PMM_AfterRun_to_Initialize_State "SWC_FDC_type/run_SWC_FDC_RxTx_5ms_sys/APP/PMM/PowerModeManagement/PMM State Change Configuration/PMM AfterRun to Initialize State" /begin REF_MEASUREMENT VPMM_AfterRun2Initialize_flg /end REF_MEASUREMENT /end GROUP
/begin GROUP S233_PMM_Boot_to_Initialize_State "SWC_FDC_type/run_SWC_FDC_RxTx_5ms_sys/APP/PMM/PowerModeManagement/PMM State Change Configuration/PMM Boot to Initialize State" /begin REF_MEASUREMENT VPMM_Boot2Initialize_flg /end REF_MEASUREMENT /end GROUP
/begin GROUP S233_PMM_Charge_to_PowerDown_State "SWC_FDC_type/run_SWC_FDC_RxTx_5ms_sys/APP/PMM/PowerModeManagement/PMM State Change Configuration/PMM Charge to PowerDown State" /begin REF_MEASUREMENT VPMM_Charge2PowerDown_flg /end REF_MEASUREMENT /end GROUP
/begin GROUP S233_PMM_Drive_to_PowerDown_State "SWC_FDC_type/run_SWC_FDC_RxTx_5ms_sys/APP/PMM/PowerModeManagement/PMM State Change Configuration/PMM Drive to PowerDown State" /begin REF_CHARACTERISTIC KPMM_LVChrgDisHVSOC_pct KPMM_LVChrgEnHVSOC_pct /end REF_CHARACTERISTIC /begin REF_MEASUREMENT VPMM_Drive2PowerDown_flg /end REF_MEASUREMENT /end GROUP
/begin GROUP S233_PMM_Initialize_to_Charge_State "SWC_FDC_type/run_SWC_FDC_RxTx_5ms_sys/APP/PMM/PowerModeManagement/PMM State Change Configuration/PMM Initialize to Charge State" /begin REF_MEASUREMENT VPMM_Initialize2Charge_flg /end REF_MEASUREMENT /end GROUP
/begin GROUP S233_PMM_Initialize_to_Idle_State "SWC_FDC_type/run_SWC_FDC_RxTx_5ms_sys/APP/PMM/PowerModeManagement/PMM State Change Configuration/PMM Initialize to Idle State" /begin REF_CHARACTERISTIC KPMM_LVChrgDisHVSOC_pct KPMM_LVChrgEnHVSOC_pct /end REF_CHARACTERISTIC /begin REF_MEASUREMENT VPMM_Initialize2Idle_flg VPMM_LVChrgIinit2Idle_flg /end REF_MEASUREMENT /end GROUP
/begin GROUP S233_PMM_Initialize_to_PowerUp_State "SWC_FDC_type/run_SWC_FDC_RxTx_5ms_sys/APP/PMM/PowerModeManagement/PMM State Change Configuration/PMM Initialize to PowerUp State" /begin REF_CHARACTERISTIC KPMM_LVChrgDisHVSOC_pct KPMM_LVChrgEnHVSOC_pct /end REF_CHARACTERISTIC /begin REF_MEASUREMENT VPMM_Initialize2PowerUp_flg VPMM_LVChrgInit2PowerUp_flg /end REF_MEASUREMENT /end GROUP
/begin GROUP S233_PMM_PowerUp_to_PowerDown_State "SWC_FDC_type/run_SWC_FDC_RxTx_5ms_sys/APP/PMM/PowerModeManagement/PMM State Change Configuration/PMM PowerUp to PowerDown State" /begin REF_CHARACTERISTIC KPMM_LVChrgDisHVSOC_pct KPMM_LVChrgEnHVSOC_pct /end REF_CHARACTERISTIC /begin REF_MEASUREMENT VPMM_PowerUp2PowerDown_flg /end REF_MEASUREMENT /end GROUP
/begin GROUP S328_SR_Latch1 "SWC_FDC_type/run_SWC_FDC_RxTx_5ms_sys/APP/PSA/PSA/PSA/SR_Latch1" /begin REF_MEASUREMENT VPSA_EmergencyShutDown_flg /end REF_MEASUREMENT /end GROUP
/begin GROUP S345_Cooling_Mode "SWC_FDC_type/run_SWC_FDC_RxTx_5ms_sys/APP/THC/PE_Cooling_Management/FUN_05.01.01_Thermal_Managemant_Mode_Determination/Cooling Mode" /begin REF_MEASUREMENT VTHC_ChargingMode_flg /end REF_MEASUREMENT /end GROUP
/begin GROUP S345_PECoolingMode "SWC_FDC_type/run_SWC_FDC_RxTx_5ms_sys/APP/THC/PE_Cooling_Management/FUN_05.01.01_Thermal_Managemant_Mode_Determination/PECoolingMode" /begin REF_MEASUREMENT VTHC_PECoolingMode_enum /end REF_MEASUREMENT /end GROUP
/begin GROUP S345_Subsystem "SWC_FDC_type/run_SWC_FDC_RxTx_5ms_sys/APP/THC/PE_Cooling_Management/FUN_05.01.01_Thermal_Managemant_Mode_Determination/Subsystem" /begin REF_MEASUREMENT VTHC_CoolingMode_flg /end REF_MEASUREMENT /end GROUP
/begin GROUP S358_Acceleration_Limiter "SWC_FDC_type/run_SWC_FDC_RxTx_5ms_sys/APP/TQD/Input_Convert/Function/Acceleration Limiter" /begin SUB_GROUP S360_Limit1 S360_Limit_Torque_Calaulation /end SUB_GROUP
 /begin REF_CHARACTERISTIC KTQD_ECPSetValErr1_mps2 KTQD_ECPSetValNoReq_mps2 KTQD_EMSpdAcclLimitEnHi_rpm KTQD_EMSpdAcclLimitEnLow_rpm KTQD_VehAccPhyShrehold_mps2 KTQD_VehAccelCalDeltaT_s KTQD_VehAccelCalEna_kph KTQD_VehAccelCalFilterTs_s KTQD_VehAccelLimInRagDis_mps2 KTQD_VehAccelLimOvrRagDis_mps2 KTQD_VehAccelOvrLimRefreTime_s KTQD_VehAcclLimitExtre_mps2 KTQD_VehAcclLimitSW_flg_ovrdflg KTQD_VehAcclLimitSW_flg_ovrdval KTQD_VehAcclLimitTG_msp2 KTQD_VehSpdLimitTorLowerLim_Nm MTQD_AccelLimitInRange_Z_Gain /end REF_CHARACTERISTIC
 /begin REF_MEASUREMENT VTQD_VehAccelCalDeltaT_cnt VTQD_VehAccelCalTrig_flg VTQD_VehAccel_mps2 VTQD_VehAcceleContiOvrLimit_flg VTQD_VehAcceleInLimit_flg VTQD_VehAcceleOvrLimit_flg VTQD_VehAcceleOvrRef_flg VTQD_VehAcclEMSpdInRange_flg VTQD_VehAcclLimitEnable_flg VTQD_VehAcclLimitRef_mps2 VTQD_VehAcclLimitTG_mps2 /end REF_MEASUREMENT
/end GROUP
/begin GROUP S358_BOS "SWC_FDC_type/run_SWC_FDC_RxTx_5ms_sys/APP/TQD/Input_Convert/Function/BOS" /begin REF_CHARACTERISTIC MTQD_BOSMapD_Z_pct MTQD_BOSMapR_Z_pct /end REF_CHARACTERISTIC /begin REF_MEASUREMENT VTQD_BOSTqDecRate_pct /end REF_MEASUREMENT /end GROUP
/begin GROUP S358_Command_Limitation "SWC_FDC_type/run_SWC_FDC_RxTx_5ms_sys/APP/TQD/Input_Convert/Function/Command Limitation"
 /begin REF_CHARACTERISTIC KTQD_CAN1BusOffTrqLimit_Nm KTQD_DDMTrqLimitation_Nm KTQD_PowerTrainTqLimtAtRegen_Nm KTQD_PowerTrainTqLimtAtTargetShaft_Nm /end REF_CHARACTERISTIC
 /begin REF_MEASUREMENT VTQD_TqCMDLowLim_Nm VTQD_TqCMDUpLim_Nm /end REF_MEASUREMENT
/end GROUP
/begin GROUP S358_Creep "SWC_FDC_type/run_SWC_FDC_RxTx_5ms_sys/APP/TQD/Input_Convert/Function/Creep" /begin SUB_GROUP S363_Timer2 /end SUB_GROUP
 /begin REF_CHARACTERISTIC KTQD_APSPedLim4Creep_pct KTQD_CreepContinueOffset_s KTQD_CreepContinueTO_s KTQD_CreepDisTMTorq_gain KTQD_CreepDisableSpd_kph KTQD_CreepEanbleSpd_kph KTQD_CreepEanble_ovrdflg KTQD_CreepEanble_ovrdval KTQD_CreepForcedDisaSpd_kph KTQD_CreepForedEnable_flg KTQD_CreepSpdReq_ovrdflg KTQD_CreepSpdReq_ovrdval KTQD_CreepTGMotorSpdCal_flg KTQD_CreepTGMotorSpdCal_rpm KTQD_CreepTargetRamp_mps2 KTQD_CreepTargetSpdOffset_rpm KTQD_CreepTargetSpd_kph KTQD_CreepTartgerSpdDiv_kph KTQD_CreepWarnTime_s KTQD_DDMSpdLimitation_rpm KTQD_MCUEnSpdModeErrTime_s /end REF_CHARACTERISTIC
 /begin REF_MEASUREMENT VTQD_BrakeRelease_flg VTQD_BrkReleaseSpd_kph VTQD_CreepContiTO_flg VTQD_CreepContiWarn_flg VTQD_CreepEnable_flg VTQD_CreepIND_enum VTQD_CreepSpdReq_kph VTQD_CreepSpdReq_rpm VTQD_CreepStart_flg VTQD_CreepTartgerMorSpd_rpm VTQD_CreeperErr_flg VTQD_CreeperNotAvail_flg VTQD_DriverTqOvr_flg VTQD_MCUEnSpdModeErr_flg VTQD_MCUFNoFault_flg VTQD_MinimizeSpdCMD_rpm VTQD_TUpAIndRun_flg VTQD_VehBrkReleaseFail_flg /end REF_MEASUREMENT
/end GROUP
/begin GROUP S358_Distribution_Rate "SWC_FDC_type/run_SWC_FDC_RxTx_5ms_sys/APP/TQD/Input_Convert/Function/Distribution Rate" /begin REF_CHARACTERISTIC KTQD_FrEDUSpRat_rat KTQD_RrEDUSpRat_rat /end REF_CHARACTERISTIC /begin REF_MEASUREMENT VTQD_FrEDUSpRat_rat VTQD_RrEDUSpRat_rat /end REF_MEASUREMENT /end GROUP
/begin GROUP S358_Door_Limit "SWC_FDC_type/run_SWC_FDC_RxTx_5ms_sys/APP/TQD/Input_Convert/Function/Door Limit" /begin REF_CHARACTERISTIC KTQD_SpeedThrDoorOpn_kph /end REF_CHARACTERISTIC /begin REF_MEASUREMENT VTQD_TorqLimDoorOpn_flg /end REF_MEASUREMENT /end GROUP
/begin GROUP S358_MCU_Control_Mode "SWC_FDC_type/run_SWC_FDC_RxTx_5ms_sys/APP/TQD/Input_Convert/Function/MCU Control Mode" /begin REF_MEASUREMENT VTQD_VCUMCUCtrlMdTQD_enum /end REF_MEASUREMENT /end GROUP
/begin GROUP S358_Parking_Protection "SWC_FDC_type/run_SWC_FDC_RxTx_5ms_sys/APP/TQD/Input_Convert/Function/Parking Protection" /begin SUB_GROUP S367_SR_Latch /end SUB_GROUP
 /begin REF_CHARACTERISTIC KTQD_ParkSafeDoorOpenSW_ovrdflg KTQD_ParkSafeDoorOpenSW_ovrdval KTQD_ParkSafeSeatBeltSW_ovrdflg KTQD_ParkSafeSeatBeltSW_ovrdval KTQD_noPBDetectSpd_kph KTQD_noPBDetectTMSpd_rpm KTQD_noPBStillSpd_kph KTQD_noPBStillTMSpd_rpm KTQD_noPBWarnPreActBuzzer_s /end REF_CHARACTERISTIC
 /begin REF_MEASUREMENT VTQD_NoPBDoorOpen_flg VTQD_NoPBSeatBelt_flg VTQD_ParkingProtectAction_flg VTQD_ParkingProtectRelease_flg VTQD_ParkingProtectWarnCrit_flg VTQD_ParkingProtectWarnWind_flg /end REF_MEASUREMENT
/end GROUP
/begin GROUP S358_Pedal_Torque "SWC_FDC_type/run_SWC_FDC_RxTx_5ms_sys/APP/TQD/Input_Convert/Function/Pedal Torque"
 /begin REF_CHARACTERISTIC MTQD_ConfortTqMapDLC_Z_Nm MTQD_ECOTqMapDLC_Z_Nm MTQD_LHMTqMapDLC_Z_Nm MTQD_LHMTqMapRLC_Z_Nm MTQD_NormalMapDLC_Z_Nm MTQD_OPDMapRLC_Z_Nm /end REF_CHARACTERISTIC
 /begin REF_MEASUREMENT SWC_FDC_type_DW.tp_Standby VTQD_ConfortTqMapD_Nm VTQD_ECOTqMapD_Nm VTQD_LHMTqMapRLC_Nm VTQD_NormalTqMapD_Nm VTQD_OPDMapRLC_Nm VTQD_PedalMapTq_Nm /end REF_MEASUREMENT
/end GROUP
/begin GROUP S358_Ramp_Limitation "SWC_FDC_type/run_SWC_FDC_RxTx_5ms_sys/APP/TQD/Input_Convert/Function/Ramp Limitation" /begin REF_CHARACTERISTIC KTQD_FinalTrqLowLim_Nm KTQD_FinalTrqUpLim_Nm /end REF_CHARACTERISTIC /begin REF_MEASUREMENT VTQD_FinalTrqLowLim_Nm VTQD_FinalTrqUpLim_Nm /end REF_MEASUREMENT /end GROUP
/begin GROUP S358_Ramp_Parameter "SWC_FDC_type/run_SWC_FDC_RxTx_5ms_sys/APP/TQD/Input_Convert/Function/Ramp Parameter" /begin SUB_GROUP S370_SR_Latch1 /end SUB_GROUP
 /begin REF_CHARACTERISTIC KTQD_ConfortTs_c KTQD_ECOTs_c KTQD_ESCEnableDecSR_c KTQD_ESCEnableIncSR_c KTQD_ESCEnableTs_c KTQD_NormalTs_c KTQD_POSNEGSWSMOTIME_s KTQD_POSNEGSWTs_c MTQD_ConfortTqDecSR_Z_Nm MTQD_ConfortTqIncSR_Z_Nm MTQD_ECOTqDecSR_Z_Nm MTQD_ECOTqIncSR_Z_Nm MTQD_NormalTqDecSR_Z_Nm MTQD_NormalTqIncSR_Z_Nm /end REF_CHARACTERISTIC
 /begin REF_MEASUREMENT VTQD_ConfortTqDecSR_Nm VTQD_ConfortTqIncSR_Nm VTQD_ECOTqDecSR_Nm VTQD_ECOTqIncSR_Nm VTQD_NormalTqDecSR_Nm VTQD_NormalTqIncSR_Nm VTQD_RampTqDecSR_Nm VTQD_RampTqIncSR_Nm VTQD_RampTs_c /end REF_MEASUREMENT
/end GROUP
/begin GROUP S358_Rolling_Regen "SWC_FDC_type/run_SWC_FDC_RxTx_5ms_sys/APP/TQD/Input_Convert/Function/Rolling Regen"
 /begin REF_CHARACTERISTIC KTQD_RegenModeSW_flg KTQD_RollRegAPSLimit_pct KTQD_RollRegBatAvalChgCurr_A KTQD_RollRegVehSpdLimit_kph KTQD_RollRegenIni_enum KTQD_RollRegenThreshold_enum KTQD_RollingRegSW_enum_ovrdflg KTQD_RollingRegSW_enum_ovrdval KTQD_RollingRegSW_flg_ovrdflg KTQD_RollingRegSW_flg_ovrdval MTQD_RollRegTorReq_Z_Nm /end REF_CHARACTERISTIC
 /begin REF_MEASUREMENT VTQD_RollRegTorReq_Nm VTQD_RollingRegenEnable_flg /end REF_MEASUREMENT
/end GROUP
/begin GROUP S358_Shift_Modul "SWC_FDC_type/run_SWC_FDC_RxTx_5ms_sys/APP/TQD/Input_Convert/Function/Shift Modul"
 /begin REF_CHARACTERISTIC KTQD_GearShiftDAllowSpd_kph KTQD_GearShiftDAllowTMSpd_rpm KTQD_GearShiftDRAllowSW_flg KTQD_GearShiftPSpd_kph KTQD_GearShiftRAllowSpd_kph KTQD_GearShiftRAllowTMSpd_rpm KTQD_InitializeWaitTime4ADAS_s KTQD_InitializeWaitTime_s KTQD_RotateShiftMaxTime_s /end REF_CHARACTERISTIC
 /begin REF_MEASUREMENT VTQD_GearActualPosn_enum VTQD_GearShiftPosn_enum VTQD_ParkingPawlEnable_flg VTQD_ParkingPawlPwrOn_flg VTQD_RNDTrig_flg /end REF_MEASUREMENT
/end GROUP
/begin GROUP S358_Speed_Limiter "SWC_FDC_type/run_SWC_FDC_RxTx_5ms_sys/APP/TQD/Input_Convert/Function/Speed Limiter" /begin SUB_GROUP S373_Limit2 S373_Limit_Torque_Calculation /end SUB_GROUP
 /begin REF_CHARACTERISTIC KTQD_ECPSetValErr1_kph KTQD_ECPSetValNoReq_kph KTQD_EMSpdAcclLimitEnHi_rpm KTQD_VehSpdLimitExtre_kph KTQD_VehSpdLimitInRangeDis_kph KTQD_VehSpdLimitOvrRangeDis_kph KTQD_VehSpdLimitSW_flg_ovrdflg KTQD_VehSpdLimitSW_flg_ovrdval KTQD_VehSpdLimitTG_kph KTQD_VehSpdLimitTorLowerLim_Nm KTQD_VehSpdOvrLimitRefreTime_s KTQD_VehSpdPhyShrehold_kph MTQD_VehSpdLimitInRange_Z_Gain /end REF_CHARACTERISTIC
 /begin REF_MEASUREMENT VTQD_VehSpdContiOvrLimit_flg VTQD_VehSpdInLimit_flg VTQD_VehSpdLimitEnable_flg VTQD_VehSpdLimitRef_kph VTQD_VehSpdLimitTG_kph VTQD_VehSpdOvrLimit_flg VTQD_VehSpdOvrRef_flg /end REF_MEASUREMENT
/end GROUP
/begin GROUP S358_TUpA "SWC_FDC_type/run_SWC_FDC_RxTx_5ms_sys/APP/TQD/Input_Convert/Function/TUpA"
 /begin REF_CHARACTERISTIC KTQD_HHAllowMotorSpd_rpm KTQD_HHAllowMotorTq_Nm KTQD_HHAllowSpd_kph KTQD_TUpAEnaBrkPos_pct KTQD_TUpAFuncEn_ovrdflg_flg KTQD_TUpAFuncEn_ovrdval_flg KTQD_TUpAHHFbkTO_s KTQD_TUpAHHRlsSpd_rpm KTQD_TUpAHHRlsTrq_Nm KTQD_TUpARetryTMSpd_rpm KTQD_TUpAWarnLatchTime_s /end REF_CHARACTERISTIC
 /begin REF_MEASUREMENT VTQD_ActTUpAIND_enum VTQD_TUpADisableCreep_flg VTQD_TUpADisableReq_flg VTQD_TUpAEnableReq_flg VTQD_TUpAPreconChecked_flg VTQD_TUpAReadyReset_flg VTQD_TUpAReady_flg VTQD_VCUEBSHHSw_enum VTQD_VCUEBSRd4BR_enum /end REF_MEASUREMENT
/end GROUP
/begin GROUP S358_Torque_Capacity "SWC_FDC_type/run_SWC_FDC_RxTx_5ms_sys/APP/TQD/Input_Convert/Function/Torque Capacity"
 /begin REF_CHARACTERISTIC KTQD_HVBattAvailPwrDefGen_Nm KTQD_HVBattAvailPwrDefMot_Nm MTQD_HVBCurrSmooth_Y_gain /end REF_CHARACTERISTIC
 /begin REF_MEASUREMENT VTQD_HVBChrgLim_Nm VTQD_HVBCurrSmooth_gain VTQD_HVBDischrgLim_Nm VTQD_HVBPwrAvailDchrg_kW VTQD_HVBattPwrAvailChrg_kW VTQD_TMTqCapGen_Nm VTQD_TMTqCapMot_Nm /end REF_MEASUREMENT
/end GROUP
/begin GROUP S359_Big_Mike_Combo_V2_ "SWC_FDC_type/run_SWC_FDC_RxTx_5ms_sys/APP/TQD/Input_Convert/Input Signal Convert/Big Mike Combo V2 "
 /begin SUB_GROUP S412_Combo_Key_Detection S412_Mode_Coordination S412_Operation_Condition S412_Signal_Status_Detection /end SUB_GROUP
/end GROUP
/begin GROUP S359_SR_Latch10 "SWC_FDC_type/run_SWC_FDC_RxTx_5ms_sys/APP/TQD/Input_Convert/Input Signal Convert/SR_Latch10" /begin REF_MEASUREMENT VTQD_FlasherDis_flg /end REF_MEASUREMENT /end GROUP
/begin GROUP S359_SR_Latch3 "SWC_FDC_type/run_SWC_FDC_RxTx_5ms_sys/APP/TQD/Input_Convert/Input Signal Convert/SR_Latch3" /begin REF_MEASUREMENT VTQD_FlasherEn_flg /end REF_MEASUREMENT /end GROUP
/begin GROUP S359_SR_Latch5 "SWC_FDC_type/run_SWC_FDC_RxTx_5ms_sys/APP/TQD/Input_Convert/Input Signal Convert/SR_Latch5" /begin REF_MEASUREMENT VTQD_DMSLossLimitGear_flg /end REF_MEASUREMENT /end GROUP
/begin GROUP S359_SR_Latch6 "SWC_FDC_type/run_SWC_FDC_RxTx_5ms_sys/APP/TQD/Input_Convert/Input Signal Convert/SR_Latch6" /begin REF_MEASUREMENT VTQD_DRTransfer_flg /end REF_MEASUREMENT /end GROUP
/begin GROUP S359_Timer1 "SWC_FDC_type/run_SWC_FDC_RxTx_5ms_sys/APP/TQD/Input_Convert/Input Signal Convert/Timer1" /begin REF_MEASUREMENT VTQD_EngModeEnDetTime_s /end REF_MEASUREMENT /end GROUP
/begin GROUP S359_Timer2 "SWC_FDC_type/run_SWC_FDC_RxTx_5ms_sys/APP/TQD/Input_Convert/Input Signal Convert/Timer2" /begin REF_MEASUREMENT VTQD_EngModeDisDetTime_s /end REF_MEASUREMENT /end GROUP
/begin GROUP S359_kph_to_rpm_ "SWC_FDC_type/run_SWC_FDC_RxTx_5ms_sys/APP/TQD/Input_Convert/Input Signal Convert/kph to rpm " /begin REF_MEASUREMENT VTQD_ECPCalSpdLimTG_rpm /end REF_MEASUREMENT /end GROUP
/begin GROUP S734_FirstOrderFilter1 "SWC_FDC_type/run_SWC_FDC_RxTx_5ms_sys/APP/TQD/Main/Torque Ramp/FirstOrderFilter1" /begin REF_MEASUREMENT VTQD_TMTqReqSmooth_Nm /end REF_MEASUREMENT /end GROUP
/begin GROUP S734_Limit "SWC_FDC_type/run_SWC_FDC_RxTx_5ms_sys/APP/TQD/Main/Torque Ramp/Limit" /begin REF_MEASUREMENT VTQD_TMTqReqRaw_Nm /end REF_MEASUREMENT /end GROUP
/begin GROUP S743_DelayEnable "SWC_FDC_type/run_SWC_FDC_RxTx_5ms_sys/APP/TQD/OutpConvert/Buzzer Request/DelayEnable" /begin REF_MEASUREMENT VTQD_PwrUpFinished_flg /end REF_MEASUREMENT /end GROUP
/begin GROUP S743_DelayEnable2 "SWC_FDC_type/run_SWC_FDC_RxTx_5ms_sys/APP/TQD/OutpConvert/Buzzer Request/DelayEnable2" /begin REF_MEASUREMENT VTQD_ComboBuzzerReset_flg /end REF_MEASUREMENT /end GROUP
/begin GROUP S743_Latch "SWC_FDC_type/run_SWC_FDC_RxTx_5ms_sys/APP/TQD/OutpConvert/Buzzer Request/Latch" /begin REF_MEASUREMENT VTQD_PwrUpFail_flg /end REF_MEASUREMENT /end GROUP
/begin GROUP S743_SR_Latch1 "SWC_FDC_type/run_SWC_FDC_RxTx_5ms_sys/APP/TQD/OutpConvert/Buzzer Request/SR_Latch1" /begin REF_MEASUREMENT VTQD_PwrUpStart_flg /end REF_MEASUREMENT /end GROUP
/begin GROUP S743_SR_Latch3 "SWC_FDC_type/run_SWC_FDC_RxTx_5ms_sys/APP/TQD/OutpConvert/Buzzer Request/SR_Latch3" /begin REF_MEASUREMENT VTQD_ComboKeyBuzzEn_flg /end REF_MEASUREMENT /end GROUP
/begin GROUP S136_DelayOFF "SWC_FDC_type/run_SWC_FDC_RxTx_5ms_sys/APP/BCM/Subsystem/ExteriorLight/Subsystem4/DelayOFF" /begin REF_CHARACTERISTIC KBCM_LightDelayOFFT_Cnt /end REF_CHARACTERISTIC /end GROUP
/begin GROUP S136_DelayON "SWC_FDC_type/run_SWC_FDC_RxTx_5ms_sys/APP/BCM/Subsystem/ExteriorLight/Subsystem4/DelayON" /begin REF_CHARACTERISTIC KBCM_LightDelayONT_Cnt /end REF_CHARACTERISTIC /end GROUP
/begin GROUP S209_Latch1 "SWC_FDC_type/run_SWC_FDC_RxTx_5ms_sys/APP/DHP/DHP/APS_calaulation/ZPLearn/Latch1" /begin REF_MEASUREMENT VDHP_EAPS2Learned_flg /end REF_MEASUREMENT /end GROUP
/begin GROUP S209_Latch2 "SWC_FDC_type/run_SWC_FDC_RxTx_5ms_sys/APP/DHP/DHP/APS_calaulation/ZPLearn/Latch2" /begin REF_MEASUREMENT VDHP_EAPS1Learned_flg /end REF_MEASUREMENT /end GROUP
/begin GROUP S238_DelayEnable "SWC_FDC_type/run_SWC_FDC_RxTx_5ms_sys/APP/PMM/PowerModeManagement/PMM Flag Creator /HVIL Judgement/DelayEnable" /begin REF_MEASUREMENT VPMM_HVILDetectFail_flg /end REF_MEASUREMENT /end GROUP
/begin GROUP S238_Signal_reach_time_counter "SWC_FDC_type/run_SWC_FDC_RxTx_5ms_sys/APP/PMM/PowerModeManagement/PMM Flag Creator /HVIL Judgement/Signal reach time counter" /begin REF_MEASUREMENT VPMM_HVILFailTimes_cnt /end REF_MEASUREMENT /end GROUP
/begin GROUP S238_Signal_reach_time_counter1 "SWC_FDC_type/run_SWC_FDC_RxTx_5ms_sys/APP/PMM/PowerModeManagement/PMM Flag Creator /HVIL Judgement/Signal reach time counter1" /begin REF_MEASUREMENT VPMM_HVILPassTimes_cnt /end REF_MEASUREMENT /end GROUP
/begin GROUP S239_DelayEnable1 "SWC_FDC_type/run_SWC_FDC_RxTx_5ms_sys/APP/PMM/PowerModeManagement/PMM Flag Creator /Long Idle Detection/DelayEnable1" /begin REF_MEASUREMENT VPMM_LongIdle_flg /end REF_MEASUREMENT /end GROUP
/begin GROUP S240_Latch "SWC_FDC_type/run_SWC_FDC_RxTx_5ms_sys/APP/PMM/PowerModeManagement/PMM Flag Creator /Low Battery Voltage/Latch" /begin REF_MEASUREMENT VPMM_LVChrgFinished_flg /end REF_MEASUREMENT /end GROUP
/begin GROUP S240_Latch1 "SWC_FDC_type/run_SWC_FDC_RxTx_5ms_sys/APP/PMM/PowerModeManagement/PMM Flag Creator /Low Battery Voltage/Latch1" /begin REF_MEASUREMENT VPMM_LVChrgPreActFinished_flg /end REF_MEASUREMENT /end GROUP
/begin GROUP S240_Long_Idle_Flasher "SWC_FDC_type/run_SWC_FDC_RxTx_5ms_sys/APP/PMM/PowerModeManagement/PMM Flag Creator /Low Battery Voltage/Long Idle Flasher"
 /begin REF_CHARACTERISTIC KPMM_LongIdleBuzzerFlash_cnt KPMM_LongIdleBuzzerOFF_s KPMM_LongIdleBuzzerON_s KPMM_LongIdleBuzzerWait_s /end REF_CHARACTERISTIC
 /begin REF_MEASUREMENT VPMM_LongIdleBuzzer_flg /end REF_MEASUREMENT
/end GROUP
/begin GROUP S240_Low_Voltage_Charge_Action_Flasher "SWC_FDC_type/run_SWC_FDC_RxTx_5ms_sys/APP/PMM/PowerModeManagement/PMM Flag Creator /Low Battery Voltage/Low Voltage Charge Action Flasher"
 /begin REF_CHARACTERISTIC KPMM_LVChrgDuBrkLampFlash_cnt KPMM_LVChrgDuBrkLampOFF_s KPMM_LVChrgDuBrkLampON_s KPMM_LVChrgDuBrkLampWait_s KPMM_LVChrgDuRBuzzerFlash_cnt KPMM_LVChrgDuRBuzzerOFF_s KPMM_LVChrgDuRBuzzerON_s KPMM_LVChrgDuRBuzzerWait_s /end REF_CHARACTERISTIC
 /begin REF_MEASUREMENT VPMM_LVChrgDuBrkLamp_flg VPMM_LVChrgDuRBuzzer_flg VPMM_LVChrgDuRLamp_flg /end REF_MEASUREMENT
/end GROUP
/begin GROUP S240_Low_Voltage_Charge_Pre_Action_Flasher "SWC_FDC_type/run_SWC_FDC_RxTx_5ms_sys/APP/PMM/PowerModeManagement/PMM Flag Creator /Low Battery Voltage/Low Voltage Charge Pre-Action Flasher"
 /begin REF_CHARACTERISTIC KPMM_LVChrgPreActBrkLampFlash_cnt KPMM_LVChrgPreActBrkLampOFF_s KPMM_LVChrgPreActBrkLampON_s KPMM_LVChrgPreActBrkLampWait_s KPMM_LVChrgPreActRBuzzerFlash_cnt KPMM_LVChrgPreActRBuzzerOFF_s KPMM_LVChrgPreActRBuzzerON_s KPMM_LVChrgPreActRBuzzerWait_s KPMM_LVChrgPreActRLampFlash_cnt KPMM_LVChrgPreActRLampOFF_s KPMM_LVChrgPreActRLampON_s KPMM_LVChrgPreActRLampWait_s /end REF_CHARACTERISTIC
 /begin REF_MEASUREMENT VPMM_LVChrgPreActBrkLamp_flg VPMM_LVChrgPreActRBuzzer_flg VPMM_LVChrgPreActRLamp_flg /end REF_MEASUREMENT
/end GROUP
/begin GROUP S360_Limit_Torque_Calaulation "SWC_FDC_type/run_SWC_FDC_RxTx_5ms_sys/APP/TQD/Input_Convert/Function/Acceleration Limiter/Limit Torque Calaulation" /begin REF_CHARACTERISTIC MTQD_AccelLimitOvrKi_Y_Gain MTQD_AccelLimitOvrKp_Y_Gain /end REF_CHARACTERISTIC /begin REF_MEASUREMENT VTQD_AccelLimitOvrKp_Gain VTQD_AceelLimitOvrKi_Gain /end REF_MEASUREMENT /end GROUP
/begin GROUP S360_Limit1 "SWC_FDC_type/run_SWC_FDC_RxTx_5ms_sys/APP/TQD/Input_Convert/Function/Acceleration Limiter/Limit1" /begin REF_MEASUREMENT VTQD_VehAcclTorLimit_Nm /end REF_MEASUREMENT /end GROUP
/begin GROUP S363_Timer2 "SWC_FDC_type/run_SWC_FDC_RxTx_5ms_sys/APP/TQD/Input_Convert/Function/Creep/Timer2" /begin REF_MEASUREMENT VTQD_CreepContinueTime_s /end REF_MEASUREMENT /end GROUP
/begin GROUP S367_SR_Latch "SWC_FDC_type/run_SWC_FDC_RxTx_5ms_sys/APP/TQD/Input_Convert/Function/Parking Protection/SR_Latch" /begin REF_MEASUREMENT VTQD_ParkingProtectWarning_flg /end REF_MEASUREMENT /end GROUP
/begin GROUP S370_SR_Latch1 "SWC_FDC_type/run_SWC_FDC_RxTx_5ms_sys/APP/TQD/Input_Convert/Function/Ramp Parameter/SR_Latch1" /begin REF_MEASUREMENT VTQD_POSNEGCONVSM_flg /end REF_MEASUREMENT /end GROUP
/begin GROUP S373_Limit_Torque_Calculation "SWC_FDC_type/run_SWC_FDC_RxTx_5ms_sys/APP/TQD/Input_Convert/Function/Speed Limiter/Limit Torque Calculation" /begin REF_CHARACTERISTIC MTQD_VehSpdLimitOvrKi_Y_Gain MTQD_VehSpdLimitOvrKp_Y_Gain /end REF_CHARACTERISTIC /begin REF_MEASUREMENT VTQD_VehSpdLimitOvrKi_Gain VTQD_VehSpdLimitOvrKp_Gain /end REF_MEASUREMENT /end GROUP
/begin GROUP S373_Limit2 "SWC_FDC_type/run_SWC_FDC_RxTx_5ms_sys/APP/TQD/Input_Convert/Function/Speed Limiter/Limit2" /begin REF_MEASUREMENT VTQD_VehSpdTorLimit_Nm /end REF_MEASUREMENT /end GROUP
/begin GROUP S412_Combo_Key_Detection "SWC_FDC_type/run_SWC_FDC_RxTx_5ms_sys/APP/TQD/Input_Convert/Input Signal Convert/Big Mike Combo V2 /Combo Key Detection"
 /begin SUB_GROUP S438_Function1_Alcohol_Lock S438_Function2_ S438_Function3 S438_Function4_ S438_Function5 /end SUB_GROUP
/end GROUP
/begin GROUP S412_Mode_Coordination "SWC_FDC_type/run_SWC_FDC_RxTx_5ms_sys/APP/TQD/Input_Convert/Input Signal Convert/Big Mike Combo V2 /Mode Coordination" /begin REF_MEASUREMENT VTQD_FunctionOffSta_enum /end REF_MEASUREMENT /end GROUP
/begin GROUP S412_Operation_Condition "SWC_FDC_type/run_SWC_FDC_RxTx_5ms_sys/APP/TQD/Input_Convert/Input Signal Convert/Big Mike Combo V2 /Operation Condition" /begin SUB_GROUP S440_SR_Latch /end SUB_GROUP
 /begin REF_MEASUREMENT VTQD_ComboKeyEn_flg VTQD_ComboKeyPreEnReset_flg VTQD_ComboKeyPreEnSet_flg /end REF_MEASUREMENT
/end GROUP
/begin GROUP S412_Signal_Status_Detection "SWC_FDC_type/run_SWC_FDC_RxTx_5ms_sys/APP/TQD/Input_Convert/Input Signal Convert/Big Mike Combo V2 /Signal Status Detection"
 /begin SUB_GROUP S441_DelayEnable16 S441_DelayEnable6 S441_SR_Latch S441_SR_Latch1 S441_SR_Latch2 S441_SR_Latch3 S441_Street_Fight_Switch_Off /end SUB_GROUP
 /begin REF_CHARACTERISTIC KTQD_ComboKeyAPSPedEn_pct KTQD_ComboKeyBPSPedEn_pct KTQD_ComboKeyEnDelayTime_s KTQD_EnterKeyCheckTime_s KTQD_SetSpdShortPLim_s /end REF_CHARACTERISTIC
 /begin REF_MEASUREMENT VTQD_ComboKeyReset_flg VTQD_ComboKey_enum VTQD_DownShort_flg VTQD_ECPECASDown_flg VTQD_ECPECASM1_flg VTQD_ECPECASM2_flg VTQD_ECPECASRKnee_flg VTQD_ECPECASStopLV_flg VTQD_ECPECASUp_flg VTQD_EnterKeyRest_flg VTQD_M1Short_flg VTQD_M2Short_flg VTQD_RKneeShort_flg VTQD_StopLVShort_flg VTQD_UpShort_flg /end REF_MEASUREMENT
/end GROUP
/begin GROUP S438_Function1_Alcohol_Lock "SWC_FDC_type/run_SWC_FDC_RxTx_5ms_sys/APP/TQD/Input_Convert/Input Signal Convert/Big Mike Combo V2 /Combo Key Detection/Function1 Alcohol Lock"
 /begin SUB_GROUP S442_Key1 S442_Key2 S442_Key3 S442_Key4 S442_Key5 S442_Key6 S442_Key7 S442_Key8 /end SUB_GROUP
 /begin REF_CHARACTERISTIC KTQD_ComboKeyDelay_s /end REF_CHARACTERISTIC
 /begin REF_MEASUREMENT VTQD_Function1CMD_enum VTQD_Function1OffPass_flg VTQD_Function1Off_flg /end REF_MEASUREMENT
/end GROUP
/begin GROUP S438_Function2_ "SWC_FDC_type/run_SWC_FDC_RxTx_5ms_sys/APP/TQD/Input_Convert/Input Signal Convert/Big Mike Combo V2 /Combo Key Detection/Function2 "
 /begin SUB_GROUP S443_Key1 S443_Key2 S443_Key3 S443_Key4 S443_Key5 S443_Key6 S443_Key7 S443_Key8 /end SUB_GROUP
 /begin REF_CHARACTERISTIC KTQD_ComboKeyDelay_s /end REF_CHARACTERISTIC
 /begin REF_MEASUREMENT VTQD_Function2CMD_enum VTQD_Function2OffPass_flg VTQD_Function2Off_flg /end REF_MEASUREMENT
/end GROUP
/begin GROUP S438_Function3 "SWC_FDC_type/run_SWC_FDC_RxTx_5ms_sys/APP/TQD/Input_Convert/Input Signal Convert/Big Mike Combo V2 /Combo Key Detection/Function3"
 /begin SUB_GROUP S444_Key1 S444_Key2 S444_Key3 S444_Key4 S444_Key5 S444_Key6 S444_Key7 S444_Key8 /end SUB_GROUP
 /begin REF_CHARACTERISTIC KTQD_ComboKeyDelay_s /end REF_CHARACTERISTIC
 /begin REF_MEASUREMENT VTQD_Function3CMD_enum VTQD_Function3OffPass_flg VTQD_Function3Off_flg /end REF_MEASUREMENT
/end GROUP
/begin GROUP S438_Function4_ "SWC_FDC_type/run_SWC_FDC_RxTx_5ms_sys/APP/TQD/Input_Convert/Input Signal Convert/Big Mike Combo V2 /Combo Key Detection/Function4 "
 /begin SUB_GROUP S445_Key1 S445_Key2 S445_Key3 S445_Key4 S445_Key5 S445_Key6 S445_Key7 S445_Key8 /end SUB_GROUP
 /begin REF_CHARACTERISTIC KTQD_ComboKeyDelay_s /end REF_CHARACTERISTIC
 /begin REF_MEASUREMENT VTQD_Function4CMD_enum VTQD_Function4OffPass_flg VTQD_Function4Off_flg /end REF_MEASUREMENT
/end GROUP
/begin GROUP S438_Function5 "SWC_FDC_type/run_SWC_FDC_RxTx_5ms_sys/APP/TQD/Input_Convert/Input Signal Convert/Big Mike Combo V2 /Combo Key Detection/Function5"
 /begin SUB_GROUP S446_Key1 S446_Key2 S446_Key3 S446_Key4 S446_Key5 S446_Key6 S446_Key7 S446_Key8 /end SUB_GROUP
 /begin REF_CHARACTERISTIC KTQD_ComboKeyDelay_s /end REF_CHARACTERISTIC
 /begin REF_MEASUREMENT VTQD_Function5CMD_enum VTQD_Function5OffPass_flg VTQD_Function5Off_flg /end REF_MEASUREMENT
/end GROUP
/begin GROUP S440_SR_Latch "SWC_FDC_type/run_SWC_FDC_RxTx_5ms_sys/APP/TQD/Input_Convert/Input Signal Convert/Big Mike Combo V2 /Operation Condition/SR_Latch" /begin REF_MEASUREMENT VTQD_ComboKeyPreEn_flg /end REF_MEASUREMENT /end GROUP
/begin GROUP S441_DelayEnable16 "SWC_FDC_type/run_SWC_FDC_RxTx_5ms_sys/APP/TQD/Input_Convert/Input Signal Convert/Big Mike Combo V2 /Signal Status Detection/DelayEnable16" /begin REF_MEASUREMENT VTQD_ComboKeyEnCMDSta_flg /end REF_MEASUREMENT /end GROUP
/begin GROUP S441_DelayEnable6 "SWC_FDC_type/run_SWC_FDC_RxTx_5ms_sys/APP/TQD/Input_Convert/Input Signal Convert/Big Mike Combo V2 /Signal Status Detection/DelayEnable6" /begin REF_MEASUREMENT VTQD_ComboKeyEnter_flg /end REF_MEASUREMENT /end GROUP
/begin GROUP S441_SR_Latch "SWC_FDC_type/run_SWC_FDC_RxTx_5ms_sys/APP/TQD/Input_Convert/Input Signal Convert/Big Mike Combo V2 /Signal Status Detection/SR_Latch" /begin REF_MEASUREMENT VTQD_ComboKeyEnCMD_flg /end REF_MEASUREMENT /end GROUP
/begin GROUP S441_SR_Latch1 "SWC_FDC_type/run_SWC_FDC_RxTx_5ms_sys/APP/TQD/Input_Convert/Input Signal Convert/Big Mike Combo V2 /Signal Status Detection/SR_Latch1" /begin REF_MEASUREMENT VTQD_N2DEnterKeyReady_flg /end REF_MEASUREMENT /end GROUP
/begin GROUP S441_SR_Latch2 "SWC_FDC_type/run_SWC_FDC_RxTx_5ms_sys/APP/TQD/Input_Convert/Input Signal Convert/Big Mike Combo V2 /Signal Status Detection/SR_Latch2" /begin REF_MEASUREMENT VTQD_D2REnterKeyReady_flg /end REF_MEASUREMENT /end GROUP
/begin GROUP S441_SR_Latch3 "SWC_FDC_type/run_SWC_FDC_RxTx_5ms_sys/APP/TQD/Input_Convert/Input Signal Convert/Big Mike Combo V2 /Signal Status Detection/SR_Latch3" /begin REF_MEASUREMENT VTQD_R2NEnterKeyReady_flg /end REF_MEASUREMENT /end GROUP
/begin GROUP S441_Street_Fight_Switch_Off "SWC_FDC_type/run_SWC_FDC_RxTx_5ms_sys/APP/TQD/Input_Convert/Input Signal Convert/Big Mike Combo V2 /Signal Status Detection/Street Fight Switch Off" /begin SUB_GROUP S720_Timer /end SUB_GROUP
 /begin REF_CHARACTERISTIC KTQD_CANCELCountDetTime_s KTQD_CANCELUpCount_cnt KTQD_ComboKeyOff_flg_ovrdflg KTQD_ComboKeyOff_flg_ovrdval /end REF_CHARACTERISTIC
 /begin REF_MEASUREMENT VTQD_CANCELCountDetFinish_flg VTQD_CANCELCountReset_flg VTQD_CANCELCount_cnt VTQD_ComboKeyOff_flg /end REF_MEASUREMENT
/end GROUP
/begin GROUP S442_Key1 "SWC_FDC_type/run_SWC_FDC_RxTx_5ms_sys/APP/TQD/Input_Convert/Input Signal Convert/Big Mike Combo V2 /Combo Key Detection/Function1 Alcohol Lock/Key1" /begin REF_CHARACTERISTIC KTQD_Function1Off1_enum /end REF_CHARACTERISTIC /begin REF_MEASUREMENT VTQD_Function1Off1Pass_flg VTQD_Function1Off1_enum /end REF_MEASUREMENT /end GROUP
/begin GROUP S442_Key2 "SWC_FDC_type/run_SWC_FDC_RxTx_5ms_sys/APP/TQD/Input_Convert/Input Signal Convert/Big Mike Combo V2 /Combo Key Detection/Function1 Alcohol Lock/Key2" /begin REF_CHARACTERISTIC KTQD_Function1Off2_enum /end REF_CHARACTERISTIC /begin REF_MEASUREMENT VTQD_Function1Off2Pass_flg VTQD_Function1Off2_enum /end REF_MEASUREMENT /end GROUP
/begin GROUP S442_Key3 "SWC_FDC_type/run_SWC_FDC_RxTx_5ms_sys/APP/TQD/Input_Convert/Input Signal Convert/Big Mike Combo V2 /Combo Key Detection/Function1 Alcohol Lock/Key3" /begin REF_CHARACTERISTIC KTQD_Function1Off3_enum /end REF_CHARACTERISTIC /begin REF_MEASUREMENT VTQD_Function1Off3Pass_flg VTQD_Function1Off3_enum /end REF_MEASUREMENT /end GROUP
/begin GROUP S442_Key4 "SWC_FDC_type/run_SWC_FDC_RxTx_5ms_sys/APP/TQD/Input_Convert/Input Signal Convert/Big Mike Combo V2 /Combo Key Detection/Function1 Alcohol Lock/Key4" /begin REF_CHARACTERISTIC KTQD_Function1Off4_enum /end REF_CHARACTERISTIC /begin REF_MEASUREMENT VTQD_Function1Off4Pass_flg VTQD_Function1Off4_enum /end REF_MEASUREMENT /end GROUP
/begin GROUP S442_Key5 "SWC_FDC_type/run_SWC_FDC_RxTx_5ms_sys/APP/TQD/Input_Convert/Input Signal Convert/Big Mike Combo V2 /Combo Key Detection/Function1 Alcohol Lock/Key5" /begin REF_CHARACTERISTIC KTQD_Function1Off5_enum /end REF_CHARACTERISTIC /begin REF_MEASUREMENT VTQD_Function1Off5Pass_flg VTQD_Function1Off5_enum /end REF_MEASUREMENT /end GROUP
/begin GROUP S442_Key6 "SWC_FDC_type/run_SWC_FDC_RxTx_5ms_sys/APP/TQD/Input_Convert/Input Signal Convert/Big Mike Combo V2 /Combo Key Detection/Function1 Alcohol Lock/Key6" /begin REF_CHARACTERISTIC KTQD_Function1Off6_enum /end REF_CHARACTERISTIC /begin REF_MEASUREMENT VTQD_Function1Off6Pass_flg VTQD_Function1Off6_enum /end REF_MEASUREMENT /end GROUP
/begin GROUP S442_Key7 "SWC_FDC_type/run_SWC_FDC_RxTx_5ms_sys/APP/TQD/Input_Convert/Input Signal Convert/Big Mike Combo V2 /Combo Key Detection/Function1 Alcohol Lock/Key7" /begin REF_CHARACTERISTIC KTQD_Function1Off7_enum /end REF_CHARACTERISTIC /begin REF_MEASUREMENT VTQD_Function1Off7Pass_flg VTQD_Function1Off7_enum /end REF_MEASUREMENT /end GROUP
/begin GROUP S442_Key8 "SWC_FDC_type/run_SWC_FDC_RxTx_5ms_sys/APP/TQD/Input_Convert/Input Signal Convert/Big Mike Combo V2 /Combo Key Detection/Function1 Alcohol Lock/Key8" /begin REF_CHARACTERISTIC KTQD_Function1Off8_enum /end REF_CHARACTERISTIC /begin REF_MEASUREMENT VTQD_Function1Off8Pass_flg VTQD_Function1Off8_enum /end REF_MEASUREMENT /end GROUP
/begin GROUP S443_Key1 "SWC_FDC_type/run_SWC_FDC_RxTx_5ms_sys/APP/TQD/Input_Convert/Input Signal Convert/Big Mike Combo V2 /Combo Key Detection/Function2 /Key1" /begin REF_CHARACTERISTIC KTQD_Function2Off1_enum /end REF_CHARACTERISTIC /begin REF_MEASUREMENT VTQD_Function2Off1Pass_flg VTQD_Function2Off1_enum /end REF_MEASUREMENT /end GROUP
/begin GROUP S443_Key2 "SWC_FDC_type/run_SWC_FDC_RxTx_5ms_sys/APP/TQD/Input_Convert/Input Signal Convert/Big Mike Combo V2 /Combo Key Detection/Function2 /Key2" /begin REF_CHARACTERISTIC KTQD_Function2Off2_enum /end REF_CHARACTERISTIC /begin REF_MEASUREMENT VTQD_Function2Off2Pass_flg VTQD_Function2Off2_enum /end REF_MEASUREMENT /end GROUP
/begin GROUP S443_Key3 "SWC_FDC_type/run_SWC_FDC_RxTx_5ms_sys/APP/TQD/Input_Convert/Input Signal Convert/Big Mike Combo V2 /Combo Key Detection/Function2 /Key3" /begin REF_CHARACTERISTIC KTQD_Function2Off3_enum /end REF_CHARACTERISTIC /begin REF_MEASUREMENT VTQD_Function2Off3Pass_flg VTQD_Function2Off3_enum /end REF_MEASUREMENT /end GROUP
/begin GROUP S443_Key4 "SWC_FDC_type/run_SWC_FDC_RxTx_5ms_sys/APP/TQD/Input_Convert/Input Signal Convert/Big Mike Combo V2 /Combo Key Detection/Function2 /Key4" /begin REF_CHARACTERISTIC KTQD_Function2Off4_enum /end REF_CHARACTERISTIC /begin REF_MEASUREMENT VTQD_Function2Off4Pass_flg VTQD_Function2Off4_enum /end REF_MEASUREMENT /end GROUP
/begin GROUP S443_Key5 "SWC_FDC_type/run_SWC_FDC_RxTx_5ms_sys/APP/TQD/Input_Convert/Input Signal Convert/Big Mike Combo V2 /Combo Key Detection/Function2 /Key5" /begin REF_CHARACTERISTIC KTQD_Function2Off5_enum /end REF_CHARACTERISTIC /begin REF_MEASUREMENT VTQD_Function2Off5Pass_flg VTQD_Function2Off5_enum /end REF_MEASUREMENT /end GROUP
/begin GROUP S443_Key6 "SWC_FDC_type/run_SWC_FDC_RxTx_5ms_sys/APP/TQD/Input_Convert/Input Signal Convert/Big Mike Combo V2 /Combo Key Detection/Function2 /Key6" /begin REF_CHARACTERISTIC KTQD_Function2Off6_enum /end REF_CHARACTERISTIC /begin REF_MEASUREMENT VTQD_Function2Off6Pass_flg VTQD_Function2Off6_enum /end REF_MEASUREMENT /end GROUP
/begin GROUP S443_Key7 "SWC_FDC_type/run_SWC_FDC_RxTx_5ms_sys/APP/TQD/Input_Convert/Input Signal Convert/Big Mike Combo V2 /Combo Key Detection/Function2 /Key7" /begin REF_CHARACTERISTIC KTQD_Function2Off7_enum /end REF_CHARACTERISTIC /begin REF_MEASUREMENT VTQD_Function2Off7Pass_flg VTQD_Function2Off7_enum /end REF_MEASUREMENT /end GROUP
/begin GROUP S443_Key8 "SWC_FDC_type/run_SWC_FDC_RxTx_5ms_sys/APP/TQD/Input_Convert/Input Signal Convert/Big Mike Combo V2 /Combo Key Detection/Function2 /Key8" /begin REF_CHARACTERISTIC KTQD_Function2Off8_enum /end REF_CHARACTERISTIC /begin REF_MEASUREMENT VTQD_Function2Off8Pass_flg VTQD_Function2Off8_enum /end REF_MEASUREMENT /end GROUP
/begin GROUP S444_Key1 "SWC_FDC_type/run_SWC_FDC_RxTx_5ms_sys/APP/TQD/Input_Convert/Input Signal Convert/Big Mike Combo V2 /Combo Key Detection/Function3/Key1" /begin REF_CHARACTERISTIC KTQD_Function3Off1_enum /end REF_CHARACTERISTIC /begin REF_MEASUREMENT VTQD_Function3Off1Pass_flg VTQD_Function3Off1_enum /end REF_MEASUREMENT /end GROUP
/begin GROUP S444_Key2 "SWC_FDC_type/run_SWC_FDC_RxTx_5ms_sys/APP/TQD/Input_Convert/Input Signal Convert/Big Mike Combo V2 /Combo Key Detection/Function3/Key2" /begin REF_CHARACTERISTIC KTQD_Function3Off2_enum /end REF_CHARACTERISTIC /begin REF_MEASUREMENT VTQD_Function3Off2Pass_flg VTQD_Function3Off2_enum /end REF_MEASUREMENT /end GROUP
/begin GROUP S444_Key3 "SWC_FDC_type/run_SWC_FDC_RxTx_5ms_sys/APP/TQD/Input_Convert/Input Signal Convert/Big Mike Combo V2 /Combo Key Detection/Function3/Key3" /begin REF_CHARACTERISTIC KTQD_Function3Off3_enum /end REF_CHARACTERISTIC /begin REF_MEASUREMENT VTQD_Function3Off3Pass_flg VTQD_Function3Off3_enum /end REF_MEASUREMENT /end GROUP
/begin GROUP S444_Key4 "SWC_FDC_type/run_SWC_FDC_RxTx_5ms_sys/APP/TQD/Input_Convert/Input Signal Convert/Big Mike Combo V2 /Combo Key Detection/Function3/Key4" /begin REF_CHARACTERISTIC KTQD_Function3Off4_enum /end REF_CHARACTERISTIC /begin REF_MEASUREMENT VTQD_Function3Off4Pass_flg VTQD_Function3Off4_enum /end REF_MEASUREMENT /end GROUP
/begin GROUP S444_Key5 "SWC_FDC_type/run_SWC_FDC_RxTx_5ms_sys/APP/TQD/Input_Convert/Input Signal Convert/Big Mike Combo V2 /Combo Key Detection/Function3/Key5" /begin REF_CHARACTERISTIC KTQD_Function3Off5_enum /end REF_CHARACTERISTIC /begin REF_MEASUREMENT VTQD_Function3Off5Pass_flg VTQD_Function3Off5_enum /end REF_MEASUREMENT /end GROUP
/begin GROUP S444_Key6 "SWC_FDC_type/run_SWC_FDC_RxTx_5ms_sys/APP/TQD/Input_Convert/Input Signal Convert/Big Mike Combo V2 /Combo Key Detection/Function3/Key6" /begin REF_CHARACTERISTIC KTQD_Function3Off6_enum /end REF_CHARACTERISTIC /begin REF_MEASUREMENT VTQD_Function3Off6Pass_flg VTQD_Function3Off6_enum /end REF_MEASUREMENT /end GROUP
/begin GROUP S444_Key7 "SWC_FDC_type/run_SWC_FDC_RxTx_5ms_sys/APP/TQD/Input_Convert/Input Signal Convert/Big Mike Combo V2 /Combo Key Detection/Function3/Key7" /begin REF_CHARACTERISTIC KTQD_Function3Off7_enum /end REF_CHARACTERISTIC /begin REF_MEASUREMENT VTQD_Function3Off7Pass_flg VTQD_Function3Off7_enum /end REF_MEASUREMENT /end GROUP
/begin GROUP S444_Key8 "SWC_FDC_type/run_SWC_FDC_RxTx_5ms_sys/APP/TQD/Input_Convert/Input Signal Convert/Big Mike Combo V2 /Combo Key Detection/Function3/Key8" /begin REF_CHARACTERISTIC KTQD_Function3Off8_enum /end REF_CHARACTERISTIC /begin REF_MEASUREMENT VTQD_Function3Off8Pass_flg VTQD_Function3Off8_enum /end REF_MEASUREMENT /end GROUP
/begin GROUP S445_Key1 "SWC_FDC_type/run_SWC_FDC_RxTx_5ms_sys/APP/TQD/Input_Convert/Input Signal Convert/Big Mike Combo V2 /Combo Key Detection/Function4 /Key1" /begin REF_CHARACTERISTIC KTQD_Function4Off1_enum /end REF_CHARACTERISTIC /begin REF_MEASUREMENT VTQD_Function4Off1Pass_flg VTQD_Function4Off1_enum /end REF_MEASUREMENT /end GROUP
/begin GROUP S445_Key2 "SWC_FDC_type/run_SWC_FDC_RxTx_5ms_sys/APP/TQD/Input_Convert/Input Signal Convert/Big Mike Combo V2 /Combo Key Detection/Function4 /Key2" /begin REF_CHARACTERISTIC KTQD_Function4Off2_enum /end REF_CHARACTERISTIC /begin REF_MEASUREMENT VTQD_Function4Off2Pass_flg VTQD_Function4Off2_enum /end REF_MEASUREMENT /end GROUP
/begin GROUP S445_Key3 "SWC_FDC_type/run_SWC_FDC_RxTx_5ms_sys/APP/TQD/Input_Convert/Input Signal Convert/Big Mike Combo V2 /Combo Key Detection/Function4 /Key3" /begin REF_CHARACTERISTIC KTQD_Function4Off3_enum /end REF_CHARACTERISTIC /begin REF_MEASUREMENT VTQD_Function4Off3Pass_flg VTQD_Function4Off3_enum /end REF_MEASUREMENT /end GROUP
/begin GROUP S445_Key4 "SWC_FDC_type/run_SWC_FDC_RxTx_5ms_sys/APP/TQD/Input_Convert/Input Signal Convert/Big Mike Combo V2 /Combo Key Detection/Function4 /Key4" /begin REF_CHARACTERISTIC KTQD_Function4Off4_enum /end REF_CHARACTERISTIC /begin REF_MEASUREMENT VTQD_Function4Off4Pass_flg VTQD_Function4Off4_enum /end REF_MEASUREMENT /end GROUP
/begin GROUP S445_Key5 "SWC_FDC_type/run_SWC_FDC_RxTx_5ms_sys/APP/TQD/Input_Convert/Input Signal Convert/Big Mike Combo V2 /Combo Key Detection/Function4 /Key5" /begin REF_CHARACTERISTIC KTQD_Function4Off5_enum /end REF_CHARACTERISTIC /begin REF_MEASUREMENT VTQD_Function4Off5Pass_flg VTQD_Function4Off5_enum /end REF_MEASUREMENT /end GROUP
/begin GROUP S445_Key6 "SWC_FDC_type/run_SWC_FDC_RxTx_5ms_sys/APP/TQD/Input_Convert/Input Signal Convert/Big Mike Combo V2 /Combo Key Detection/Function4 /Key6" /begin REF_CHARACTERISTIC KTQD_Function4Off6_enum /end REF_CHARACTERISTIC /begin REF_MEASUREMENT VTQD_Function4Off6Pass_flg VTQD_Function4Off6_enum /end REF_MEASUREMENT /end GROUP
/begin GROUP S445_Key7 "SWC_FDC_type/run_SWC_FDC_RxTx_5ms_sys/APP/TQD/Input_Convert/Input Signal Convert/Big Mike Combo V2 /Combo Key Detection/Function4 /Key7" /begin REF_CHARACTERISTIC KTQD_Function4Off7_enum /end REF_CHARACTERISTIC /begin REF_MEASUREMENT VTQD_Function4Off7Pass_flg VTQD_Function4Off7_enum /end REF_MEASUREMENT /end GROUP
/begin GROUP S445_Key8 "SWC_FDC_type/run_SWC_FDC_RxTx_5ms_sys/APP/TQD/Input_Convert/Input Signal Convert/Big Mike Combo V2 /Combo Key Detection/Function4 /Key8" /begin REF_CHARACTERISTIC KTQD_Function4Off8_enum /end REF_CHARACTERISTIC /begin REF_MEASUREMENT VTQD_Function4Off8Pass_flg VTQD_Function4Off8_enum /end REF_MEASUREMENT /end GROUP
/begin GROUP S446_Key1 "SWC_FDC_type/run_SWC_FDC_RxTx_5ms_sys/APP/TQD/Input_Convert/Input Signal Convert/Big Mike Combo V2 /Combo Key Detection/Function5/Key1" /begin REF_CHARACTERISTIC KTQD_Function5Off1_enum /end REF_CHARACTERISTIC /begin REF_MEASUREMENT VTQD_Function5Off1Pass_flg VTQD_Function5Off1_enum /end REF_MEASUREMENT /end GROUP
/begin GROUP S446_Key2 "SWC_FDC_type/run_SWC_FDC_RxTx_5ms_sys/APP/TQD/Input_Convert/Input Signal Convert/Big Mike Combo V2 /Combo Key Detection/Function5/Key2" /begin REF_CHARACTERISTIC KTQD_Function5Off2_enum /end REF_CHARACTERISTIC /begin REF_MEASUREMENT VTQD_Function5Off2Pass_flg VTQD_Function5Off2_enum /end REF_MEASUREMENT /end GROUP
/begin GROUP S446_Key3 "SWC_FDC_type/run_SWC_FDC_RxTx_5ms_sys/APP/TQD/Input_Convert/Input Signal Convert/Big Mike Combo V2 /Combo Key Detection/Function5/Key3" /begin REF_CHARACTERISTIC KTQD_Function5Off3_enum /end REF_CHARACTERISTIC /begin REF_MEASUREMENT VTQD_Function5Off3Pass_flg VTQD_Function5Off3_enum /end REF_MEASUREMENT /end GROUP
/begin GROUP S446_Key4 "SWC_FDC_type/run_SWC_FDC_RxTx_5ms_sys/APP/TQD/Input_Convert/Input Signal Convert/Big Mike Combo V2 /Combo Key Detection/Function5/Key4" /begin REF_CHARACTERISTIC KTQD_Function5Off4_enum /end REF_CHARACTERISTIC /begin REF_MEASUREMENT VTQD_Function5Off4Pass_flg VTQD_Function5Off4_enum /end REF_MEASUREMENT /end GROUP
/begin GROUP S446_Key5 "SWC_FDC_type/run_SWC_FDC_RxTx_5ms_sys/APP/TQD/Input_Convert/Input Signal Convert/Big Mike Combo V2 /Combo Key Detection/Function5/Key5" /begin REF_CHARACTERISTIC KTQD_Function5Off5_enum /end REF_CHARACTERISTIC /begin REF_MEASUREMENT VTQD_Function5Off5Pass_flg VTQD_Function5Off5_enum /end REF_MEASUREMENT /end GROUP
/begin GROUP S446_Key6 "SWC_FDC_type/run_SWC_FDC_RxTx_5ms_sys/APP/TQD/Input_Convert/Input Signal Convert/Big Mike Combo V2 /Combo Key Detection/Function5/Key6" /begin REF_CHARACTERISTIC KTQD_Function5Off6_enum /end REF_CHARACTERISTIC /begin REF_MEASUREMENT VTQD_Function5Off6Pass_flg VTQD_Function5Off6_enum /end REF_MEASUREMENT /end GROUP
/begin GROUP S446_Key7 "SWC_FDC_type/run_SWC_FDC_RxTx_5ms_sys/APP/TQD/Input_Convert/Input Signal Convert/Big Mike Combo V2 /Combo Key Detection/Function5/Key7" /begin REF_CHARACTERISTIC KTQD_Function5Off7_enum /end REF_CHARACTERISTIC /begin REF_MEASUREMENT VTQD_Function5Off7Pass_flg VTQD_Function5Off7_enum /end REF_MEASUREMENT /end GROUP
/begin GROUP S446_Key8 "SWC_FDC_type/run_SWC_FDC_RxTx_5ms_sys/APP/TQD/Input_Convert/Input Signal Convert/Big Mike Combo V2 /Combo Key Detection/Function5/Key8" /begin REF_CHARACTERISTIC KTQD_Function5Off8_enum /end REF_CHARACTERISTIC /begin REF_MEASUREMENT VTQD_Function5Off8Pass_flg VTQD_Function5Off8_enum /end REF_MEASUREMENT /end GROUP
/begin GROUP S720_Timer "SWC_FDC_type/run_SWC_FDC_RxTx_5ms_sys/APP/TQD/Input_Convert/Input Signal Convert/Big Mike Combo V2 /Signal Status Detection/Street Fight Switch Off/Timer" /begin REF_MEASUREMENT VTQD_CANCELCountDetTime_s /end REF_MEASUREMENT /end GROUP
/end MODULE
/end PROJECT
