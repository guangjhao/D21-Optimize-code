ASAP2_VERSION 1 31
/begin PROJECT ProjectName "Project Comment Goes Here"
/begin HEADER "Header Comments go here" /end HEADER
/begin MODULE ModuleName "Module Comment Goes Here"
/begin MOD_COMMON "Mod Common Comment Here" BYTE_ORDER MSB_LAST /end MOD_COMMON
/begin RECORD_LAYOUT Scalar_BOOLEAN FNC_VALUES 1 UBYTE COLUMN_DIR DIRECT /end RECORD_LAYOUT
/begin RECORD_LAYOUT Scalar_UBYTE FNC_VALUES 1 UBYTE COLUMN_DIR DIRECT /end RECORD_LAYOUT
/begin RECORD_LAYOUT Scalar_UWORD FNC_VALUES 1 UWORD COLUMN_DIR DIRECT /end RECORD_LAYOUT
/begin RECORD_LAYOUT Scalar_FLOAT32_IEEE FNC_VALUES 1 FLOAT32_IEEE COLUMN_DIR DIRECT /end RECORD_LAYOUT
/begin RECORD_LAYOUT Lookup1D_UWORD FNC_VALUES 1 UWORD COLUMN_DIR DIRECT /end RECORD_LAYOUT
/begin RECORD_LAYOUT Lookup1D_X_UWORD AXIS_PTS_X 1 UWORD INDEX_INCR DIRECT /end RECORD_LAYOUT
/begin RECORD_LAYOUT Lookup1D_WORD FNC_VALUES 1 SWORD COLUMN_DIR DIRECT /end RECORD_LAYOUT
/begin RECORD_LAYOUT Lookup1D_FLOAT32_IEEE FNC_VALUES 1 FLOAT32_IEEE COLUMN_DIR DIRECT /end RECORD_LAYOUT
/begin RECORD_LAYOUT Lookup1D_X_FLOAT32_IEEE AXIS_PTS_X 1 FLOAT32_IEEE INDEX_INCR DIRECT /end RECORD_LAYOUT
/begin RECORD_LAYOUT Lookup2D_FLOAT32_IEEE FNC_VALUES 1 FLOAT32_IEEE COLUMN_DIR DIRECT /end RECORD_LAYOUT
/begin RECORD_LAYOUT Lookup2D_X_FLOAT32_IEEE AXIS_PTS_X 1 FLOAT32_IEEE INDEX_INCR DIRECT /end RECORD_LAYOUT
/begin CHARACTERISTIC MTQD_AfterTqMinGain_Y_c "" CURVE 0x0000 /* @ECU_Address@MTQD_AfterTqMinGain_Y_c@ */ Lookup1D_FLOAT32_IEEE 0 SWC_FDC_type_CM_single_c 0.0 1.0
 /begin AXIS_DESCR COM_AXIS NO_INPUT_QUANTITY SWC_FDC_type_CM_single_Deg 19 -90.0 90.0 AXIS_PTS_REF ATQD_AfterTqMinGain_X_Deg /end AXIS_DESCR
/end CHARACTERISTIC
/begin AXIS_PTS ATQD_AfterTqMinGain_X_Deg "" 0x0000 /* @ECU_Address@ATQD_AfterTqMinGain_X_Deg@ */ NO_INPUT_QUANTITY Lookup1D_X_FLOAT32_IEEE 0 SWC_FDC_type_CM_single_Deg 19 -90.0 90.0 /end AXIS_PTS
/begin CHARACTERISTIC MTQD_FAfterTqCMDGain_Z_c "" MAP 0x0000 /* @ECU_Address@MTQD_FAfterTqCMDGain_Z_c@ */ Lookup2D_FLOAT32_IEEE 0 SWC_FDC_type_CM_single_c 0.0 1.0
 /begin AXIS_DESCR COM_AXIS NO_INPUT_QUANTITY SWC_FDC_type_CM_single_rpm 17 -100000.0 100000.0 AXIS_PTS_REF ATQD_FAfterTqCMDGain_X_rpm /end AXIS_DESCR
 /begin AXIS_DESCR COM_AXIS VTQD_FrontSlideRate_pct SWC_FDC_type_CM_single_pct 19 -125.0 125.0 AXIS_PTS_REF ATQD_FAfterTqCMDGain_Y_pct /end AXIS_DESCR
/end CHARACTERISTIC
/begin AXIS_PTS ATQD_FAfterTqCMDGain_Y_pct "" 0x0000 /* @ECU_Address@ATQD_FAfterTqCMDGain_Y_pct@ */ VTQD_FrontSlideRate_pct Lookup2D_X_FLOAT32_IEEE 0 SWC_FDC_type_CM_single_pct 19 -125.0 125.0 /end AXIS_PTS
/begin AXIS_PTS ATQD_FAfterTqCMDGain_X_rpm "" 0x0000 /* @ECU_Address@ATQD_FAfterTqCMDGain_X_rpm@ */ NO_INPUT_QUANTITY Lookup2D_X_FLOAT32_IEEE 0 SWC_FDC_type_CM_single_rpm 17 -100000.0 100000.0 /end AXIS_PTS
/begin CHARACTERISTIC MTQD_RAfterTqCMDGain_Z_c "" MAP 0x0000 /* @ECU_Address@MTQD_RAfterTqCMDGain_Z_c@ */ Lookup2D_FLOAT32_IEEE 0 SWC_FDC_type_CM_single_c 0.0 1.0
 /begin AXIS_DESCR COM_AXIS NO_INPUT_QUANTITY SWC_FDC_type_CM_single_rpm 17 -100000.0 100000.0 AXIS_PTS_REF ATQD_FAfterTqCMDGain_X_rpm /end AXIS_DESCR
 /begin AXIS_DESCR COM_AXIS VTQD_RearSlideRate_pct SWC_FDC_type_CM_single_pct 19 -125.0 125.0 AXIS_PTS_REF ATQD_FAfterTqCMDGain_Y_pct /end AXIS_DESCR
/end CHARACTERISTIC
/begin CHARACTERISTIC MTQD_AWDLoadTrqnsGain_Z_c "" MAP 0x0000 /* @ECU_Address@MTQD_AWDLoadTrqnsGain_Z_c@ */ Lookup2D_FLOAT32_IEEE 0 SWC_FDC_type_CM_single_c 0.0 1.5
 /begin AXIS_DESCR COM_AXIS VTQD_EstVehWeightResult_kg SWC_FDC_type_CM_single_kg 27 0.0 10000.0 AXIS_PTS_REF ATQD_AWDLoadTrqnsGain_X_kg /end AXIS_DESCR
 /begin AXIS_DESCR COM_AXIS VTQD_AWDLoadTrqnsGain_pct SWC_FDC_type_CM_single_pct 27 -1.0 125.0 AXIS_PTS_REF ATQD_AWDLoadTrqnsGain_Y_pct /end AXIS_DESCR
/end CHARACTERISTIC
/begin AXIS_PTS ATQD_AWDLoadTrqnsGain_Y_pct "" 0x0000 /* @ECU_Address@ATQD_AWDLoadTrqnsGain_Y_pct@ */ VTQD_AWDLoadTrqnsGain_pct Lookup2D_X_FLOAT32_IEEE 0 SWC_FDC_type_CM_single_pct 27 -1.0 125.0 /end AXIS_PTS
/begin AXIS_PTS ATQD_AWDLoadTrqnsGain_X_kg "" 0x0000 /* @ECU_Address@ATQD_AWDLoadTrqnsGain_X_kg@ */ VTQD_EstVehWeightResult_kg Lookup2D_X_FLOAT32_IEEE 0 SWC_FDC_type_CM_single_kg 27 0.0 10000.0 /end AXIS_PTS
/begin CHARACTERISTIC MTQD_CreepRrTqSpRat_Z_rat "" MAP 0x0000 /* @ECU_Address@MTQD_CreepRrTqSpRat_Z_rat@ */ Lookup2D_FLOAT32_IEEE 0 SWC_FDC_type_CM_single_rat 0.0 1.0
 /begin AXIS_DESCR COM_AXIS NO_INPUT_QUANTITY SWC_FDC_type_CM_single_rpm 15 -100000.0 100000.0 AXIS_PTS_REF ATQD_CreepRrTqSpRat_X_rpm /end AXIS_DESCR
 /begin AXIS_DESCR COM_AXIS VTQD_DriverWhlTqDem_Nm SWC_FDC_type_CM_single_Nm 18 -100000.0 100000.0 AXIS_PTS_REF ATQD_CreepRrTqSpRat_Y_Nm /end AXIS_DESCR
/end CHARACTERISTIC
/begin AXIS_PTS ATQD_CreepRrTqSpRat_Y_Nm "" 0x0000 /* @ECU_Address@ATQD_CreepRrTqSpRat_Y_Nm@ */ VTQD_DriverWhlTqDem_Nm Lookup2D_X_FLOAT32_IEEE 0 SWC_FDC_type_CM_single_Nm 18 -100000.0 100000.0 /end AXIS_PTS
/begin AXIS_PTS ATQD_CreepRrTqSpRat_X_rpm "" 0x0000 /* @ECU_Address@ATQD_CreepRrTqSpRat_X_rpm@ */ NO_INPUT_QUANTITY Lookup2D_X_FLOAT32_IEEE 0 SWC_FDC_type_CM_single_rpm 15 -100000.0 100000.0 /end AXIS_PTS
/begin CHARACTERISTIC MTQD_ECORrEDUSpRat_Z_rat "" MAP 0x0000 /* @ECU_Address@MTQD_ECORrEDUSpRat_Z_rat@ */ Lookup2D_FLOAT32_IEEE 0 SWC_FDC_type_CM_single_gain 0.0 1.0
 /begin AXIS_DESCR COM_AXIS NO_INPUT_QUANTITY SWC_FDC_type_CM_single_rpm 27 -100000.0 100000.0 AXIS_PTS_REF ATQD_NRMRrEDUSpRat_X_rpm /end AXIS_DESCR
 /begin AXIS_DESCR COM_AXIS VTQD_DriverWhlTqDem_Nm SWC_FDC_type_CM_single_Nm 27 -100000.0 100000.0 AXIS_PTS_REF ATQD_NRMRrEDUSpRat_Y_Nm /end AXIS_DESCR
/end CHARACTERISTIC
/begin AXIS_PTS ATQD_NRMRrEDUSpRat_Y_Nm "" 0x0000 /* @ECU_Address@ATQD_NRMRrEDUSpRat_Y_Nm@ */ VTQD_DriverWhlTqDem_Nm Lookup2D_X_FLOAT32_IEEE 0 SWC_FDC_type_CM_single_Nm 27 -100000.0 100000.0 /end AXIS_PTS
/begin AXIS_PTS ATQD_NRMRrEDUSpRat_X_rpm "" 0x0000 /* @ECU_Address@ATQD_NRMRrEDUSpRat_X_rpm@ */ NO_INPUT_QUANTITY Lookup2D_X_FLOAT32_IEEE 0 SWC_FDC_type_CM_single_rpm 27 -100000.0 100000.0 /end AXIS_PTS
/begin CHARACTERISTIC MTQD_NRMRrEDUSpRat_Z_rat "" MAP 0x0000 /* @ECU_Address@MTQD_NRMRrEDUSpRat_Z_rat@ */ Lookup2D_FLOAT32_IEEE 0 SWC_FDC_type_CM_single_gain 0.0 1.0
 /begin AXIS_DESCR COM_AXIS NO_INPUT_QUANTITY SWC_FDC_type_CM_single_rpm 27 -100000.0 100000.0 AXIS_PTS_REF ATQD_NRMRrEDUSpRat_X_rpm /end AXIS_DESCR
 /begin AXIS_DESCR COM_AXIS VTQD_DriverWhlTqDem_Nm SWC_FDC_type_CM_single_Nm 27 -100000.0 100000.0 AXIS_PTS_REF ATQD_NRMRrEDUSpRat_Y_Nm /end AXIS_DESCR
/end CHARACTERISTIC
/begin CHARACTERISTIC MTQD_RrTqSRRateTs_Y_c "" CURVE 0x0000 /* @ECU_Address@MTQD_RrTqSRRateTs_Y_c@ */ Lookup1D_FLOAT32_IEEE 0 SWC_FDC_type_CM_single_c 0.0 1.0
 /begin AXIS_DESCR COM_AXIS VTQD_ActAPSPosn_pct SWC_FDC_type_CM_single_pct 14 -10.0 125.0 AXIS_PTS_REF ATQD_RrTqSRRateTs_X_pct /end AXIS_DESCR
/end CHARACTERISTIC
/begin AXIS_PTS ATQD_RrTqSRRateTs_X_pct "" 0x0000 /* @ECU_Address@ATQD_RrTqSRRateTs_X_pct@ */ VTQD_ActAPSPosn_pct Lookup1D_X_FLOAT32_IEEE 0 SWC_FDC_type_CM_single_pct 14 -10.0 125.0 /end AXIS_PTS
/begin CHARACTERISTIC MTQD_SPORTRrEDUSpRat_Z_rat "" MAP 0x0000 /* @ECU_Address@MTQD_SPORTRrEDUSpRat_Z_rat@ */ Lookup2D_FLOAT32_IEEE 0 SWC_FDC_type_CM_single_gain 0.0 1.0
 /begin AXIS_DESCR COM_AXIS NO_INPUT_QUANTITY SWC_FDC_type_CM_single_rpm 27 -100000.0 100000.0 AXIS_PTS_REF ATQD_NRMRrEDUSpRat_X_rpm /end AXIS_DESCR
 /begin AXIS_DESCR COM_AXIS VTQD_DriverWhlTqDem_Nm SWC_FDC_type_CM_single_Nm 27 -100000.0 100000.0 AXIS_PTS_REF ATQD_NRMRrEDUSpRat_Y_Nm /end AXIS_DESCR
/end CHARACTERISTIC
/begin CHARACTERISTIC MVMC_PedalTqRWhlSlipGain_Z_Nm "" MAP 0x0000 /* @ECU_Address@MVMC_PedalTqRWhlSlipGain_Z_Nm@ */ Lookup2D_FLOAT32_IEEE 0 SWC_FDC_type_CM_single_Nm -10000.0 10000.0
 /begin AXIS_DESCR COM_AXIS VVMC_FrRrSlipRate_rat SWC_FDC_type_CM_single_rat 13 -1.0 1.0 AXIS_PTS_REF AVMC_PedalTqRWhlSlipGain_X_rat /end AXIS_DESCR
 /begin AXIS_DESCR COM_AXIS NO_INPUT_QUANTITY SWC_FDC_type_CM_single_kph 17 0.0 255.0 AXIS_PTS_REF AVMC_PedalTqRWhlSlipGain_Y_kph /end AXIS_DESCR
/end CHARACTERISTIC
/begin AXIS_PTS AVMC_PedalTqRWhlSlipGain_Y_kph "" 0x0000 /* @ECU_Address@AVMC_PedalTqRWhlSlipGain_Y_kph@ */ NO_INPUT_QUANTITY Lookup2D_X_FLOAT32_IEEE 0 SWC_FDC_type_CM_single_kph 17 0.0 255.0 /end AXIS_PTS
/begin AXIS_PTS AVMC_PedalTqRWhlSlipGain_X_rat "" 0x0000 /* @ECU_Address@AVMC_PedalTqRWhlSlipGain_X_rat@ */ VVMC_FrRrSlipRate_rat Lookup2D_X_FLOAT32_IEEE 0 SWC_FDC_type_CM_single_rat 13 -1.0 1.0 /end AXIS_PTS
/begin CHARACTERISTIC MVMC_RearWhlTqSlipGain_Z_Nm "" MAP 0x0000 /* @ECU_Address@MVMC_RearWhlTqSlipGain_Z_Nm@ */ Lookup2D_FLOAT32_IEEE 0 SWC_FDC_type_CM_single_Nm -10000.0 10000.0
 /begin AXIS_DESCR COM_AXIS VVMC_FrRrSlipRate_rat SWC_FDC_type_CM_single_rat 13 -1.0 1.0 AXIS_PTS_REF AVMC_RearWhlTqSlipGain_X_rat /end AXIS_DESCR
 /begin AXIS_DESCR COM_AXIS NO_INPUT_QUANTITY SWC_FDC_type_CM_single_kph 17 0.0 255.0 AXIS_PTS_REF AVMC_RearWhlTqSlipGain_Y_kph /end AXIS_DESCR
/end CHARACTERISTIC
/begin AXIS_PTS AVMC_RearWhlTqSlipGain_Y_kph "" 0x0000 /* @ECU_Address@AVMC_RearWhlTqSlipGain_Y_kph@ */ NO_INPUT_QUANTITY Lookup2D_X_FLOAT32_IEEE 0 SWC_FDC_type_CM_single_kph 17 0.0 255.0 /end AXIS_PTS
/begin AXIS_PTS AVMC_RearWhlTqSlipGain_X_rat "" 0x0000 /* @ECU_Address@AVMC_RearWhlTqSlipGain_X_rat@ */ VVMC_FrRrSlipRate_rat Lookup2D_X_FLOAT32_IEEE 0 SWC_FDC_type_CM_single_rat 13 -1.0 1.0 /end AXIS_PTS
/begin CHARACTERISTIC MVMC_PedalTqRWhSTRGGain_Z_Nm "" MAP 0x0000 /* @ECU_Address@MVMC_PedalTqRWhSTRGGain_Z_Nm@ */ Lookup2D_FLOAT32_IEEE 0 SWC_FDC_type_CM_single_Nm -10000.0 10000.0
 /begin AXIS_DESCR COM_AXIS NO_INPUT_QUANTITY SWC_FDC_type_CM_single_deg 8 -900.0 900.0 AXIS_PTS_REF AVMC_PedalTqRWhSTRGGain_X_deg /end AXIS_DESCR
 /begin AXIS_DESCR COM_AXIS NO_INPUT_QUANTITY SWC_FDC_type_CM_single_kph 8 0.0 255.0 AXIS_PTS_REF AVMC_PedalTqRWhSTRGGain_Y_kph /end AXIS_DESCR
/end CHARACTERISTIC
/begin AXIS_PTS AVMC_PedalTqRWhSTRGGain_Y_kph "" 0x0000 /* @ECU_Address@AVMC_PedalTqRWhSTRGGain_Y_kph@ */ NO_INPUT_QUANTITY Lookup2D_X_FLOAT32_IEEE 0 SWC_FDC_type_CM_single_kph 8 0.0 255.0 /end AXIS_PTS
/begin AXIS_PTS AVMC_PedalTqRWhSTRGGain_X_deg "" 0x0000 /* @ECU_Address@AVMC_PedalTqRWhSTRGGain_X_deg@ */ NO_INPUT_QUANTITY Lookup2D_X_FLOAT32_IEEE 0 SWC_FDC_type_CM_single_deg 8 -900.0 900.0 /end AXIS_PTS
/begin CHARACTERISTIC MVMC_PedalTqRWhlRatio_Z_rat "" MAP 0x0000 /* @ECU_Address@MVMC_PedalTqRWhlRatio_Z_rat@ */ Lookup2D_FLOAT32_IEEE 0 SWC_FDC_type_CM_single_rat 0.0 1.0
 /begin AXIS_DESCR COM_AXIS VVMC_VMCWhlTq4RatioCalcu_Nm SWC_FDC_type_CM_single_Nm 35 -10000.0 10000.0 AXIS_PTS_REF AVMC_PedalTqRWhlRatio_X_Nm /end AXIS_DESCR
 /begin AXIS_DESCR COM_AXIS VVMC_ESCLongAccelFilt_Gps SWC_FDC_type_CM_single_gps 21 -5.0 5.0 AXIS_PTS_REF AVMC_PedalTqRWhlRatio_Y_gps /end AXIS_DESCR
/end CHARACTERISTIC
/begin AXIS_PTS AVMC_PedalTqRWhlRatio_Y_gps "" 0x0000 /* @ECU_Address@AVMC_PedalTqRWhlRatio_Y_gps@ */ VVMC_ESCLongAccelFilt_Gps Lookup2D_X_FLOAT32_IEEE 0 SWC_FDC_type_CM_single_gps 21 -5.0 5.0 /end AXIS_PTS
/begin AXIS_PTS AVMC_PedalTqRWhlRatio_X_Nm "" 0x0000 /* @ECU_Address@AVMC_PedalTqRWhlRatio_X_Nm@ */ VVMC_VMCWhlTq4RatioCalcu_Nm Lookup2D_X_FLOAT32_IEEE 0 SWC_FDC_type_CM_single_Nm 35 -10000.0 10000.0 /end AXIS_PTS
/begin CHARACTERISTIC MVMC_RearWhlTqRatio_Z_rat "" MAP 0x0000 /* @ECU_Address@MVMC_RearWhlTqRatio_Z_rat@ */ Lookup2D_FLOAT32_IEEE 0 SWC_FDC_type_CM_single_rat 0.0 1.0
 /begin AXIS_DESCR COM_AXIS VVMC_VMCWhlTq4RatioCalcu_Nm SWC_FDC_type_CM_single_Nm 35 -10000.0 10000.0 AXIS_PTS_REF AVMC_RearWhlTqRatio_X_Nm /end AXIS_DESCR
 /begin AXIS_DESCR COM_AXIS VVMC_ESCLongAccelFilt_Gps SWC_FDC_type_CM_single_gps 21 -5.0 5.0 AXIS_PTS_REF AVMC_RearWhlTqRatio_Y_gps /end AXIS_DESCR
/end CHARACTERISTIC
/begin AXIS_PTS AVMC_RearWhlTqRatio_Y_gps "" 0x0000 /* @ECU_Address@AVMC_RearWhlTqRatio_Y_gps@ */ VVMC_ESCLongAccelFilt_Gps Lookup2D_X_FLOAT32_IEEE 0 SWC_FDC_type_CM_single_gps 21 -5.0 5.0 /end AXIS_PTS
/begin AXIS_PTS AVMC_RearWhlTqRatio_X_Nm "" 0x0000 /* @ECU_Address@AVMC_RearWhlTqRatio_X_Nm@ */ VVMC_VMCWhlTq4RatioCalcu_Nm Lookup2D_X_FLOAT32_IEEE 0 SWC_FDC_type_CM_single_Nm 35 -10000.0 10000.0 /end AXIS_PTS
/begin CHARACTERISTIC MVMC_RearWhlTqSTRGGain_Z_Nm "" MAP 0x0000 /* @ECU_Address@MVMC_RearWhlTqSTRGGain_Z_Nm@ */ Lookup2D_FLOAT32_IEEE 0 SWC_FDC_type_CM_single_Nm -10000.0 10000.0
 /begin AXIS_DESCR COM_AXIS NO_INPUT_QUANTITY SWC_FDC_type_CM_single_deg 8 -900.0 900.0 AXIS_PTS_REF AVMC_RearWhlTqSTRGGain_X_deg /end AXIS_DESCR
 /begin AXIS_DESCR COM_AXIS NO_INPUT_QUANTITY SWC_FDC_type_CM_single_kph 8 0.0 255.0 AXIS_PTS_REF AVMC_RearWhlTqSTRGGain_Y_kph /end AXIS_DESCR
/end CHARACTERISTIC
/begin AXIS_PTS AVMC_RearWhlTqSTRGGain_Y_kph "" 0x0000 /* @ECU_Address@AVMC_RearWhlTqSTRGGain_Y_kph@ */ NO_INPUT_QUANTITY Lookup2D_X_FLOAT32_IEEE 0 SWC_FDC_type_CM_single_kph 8 0.0 255.0 /end AXIS_PTS
/begin AXIS_PTS AVMC_RearWhlTqSTRGGain_X_deg "" 0x0000 /* @ECU_Address@AVMC_RearWhlTqSTRGGain_X_deg@ */ NO_INPUT_QUANTITY Lookup2D_X_FLOAT32_IEEE 0 SWC_FDC_type_CM_single_deg 8 -900.0 900.0 /end AXIS_PTS
/begin CHARACTERISTIC MVMC_ACCDeltaTqIGain4OVRD_Z_Nm "" MAP 0x0000 /* @ECU_Address@MVMC_ACCDeltaTqIGain4OVRD_Z_Nm@ */ Lookup2D_FLOAT32_IEEE 0 SWC_FDC_type_CM_single_Nm -50.0 50.0
 /begin AXIS_DESCR COM_AXIS NO_INPUT_QUANTITY SWC_FDC_type_CM_single_kph 17 0.0 300.0 AXIS_PTS_REF AVMC_ACCDeltaTqIGain4OVRD_X_kph /end AXIS_DESCR
 /begin AXIS_DESCR COM_AXIS VVMC_ActAccDev_mps2 SWC_FDC_type_CM_single_mps2 21 -10.0 10.0 AXIS_PTS_REF AVMC_ACCDeltaTqIGain4OVRD_Y_mps2 /end AXIS_DESCR
/end CHARACTERISTIC
/begin AXIS_PTS AVMC_ACCDeltaTqIGain4OVRD_Y_mps2 "" 0x0000 /* @ECU_Address@AVMC_ACCDeltaTqIGain4OVRD_Y_mps2@ */ VVMC_ActAccDev_mps2 Lookup2D_X_FLOAT32_IEEE 0 SWC_FDC_type_CM_single_mps2 21 -10.0 10.0 /end AXIS_PTS
/begin AXIS_PTS AVMC_ACCDeltaTqIGain4OVRD_X_kph "" 0x0000 /* @ECU_Address@AVMC_ACCDeltaTqIGain4OVRD_X_kph@ */ NO_INPUT_QUANTITY Lookup2D_X_FLOAT32_IEEE 0 SWC_FDC_type_CM_single_kph 17 0.0 300.0 /end AXIS_PTS
/begin CHARACTERISTIC MVMC_ACCDeltaTqIGain_Z_Nm "" MAP 0x0000 /* @ECU_Address@MVMC_ACCDeltaTqIGain_Z_Nm@ */ Lookup2D_FLOAT32_IEEE 0 SWC_FDC_type_CM_single_Nm -50.0 50.0
 /begin AXIS_DESCR COM_AXIS NO_INPUT_QUANTITY SWC_FDC_type_CM_single_kph 17 0.0 300.0 AXIS_PTS_REF AVMC_ACCDeltaTqIGain_X_kph /end AXIS_DESCR
 /begin AXIS_DESCR COM_AXIS VVMC_ActAccDev_mps2 SWC_FDC_type_CM_single_mps2 21 -10.0 10.0 AXIS_PTS_REF AVMC_ACCDeltaTqIGain_Y_mps2 /end AXIS_DESCR
/end CHARACTERISTIC
/begin AXIS_PTS AVMC_ACCDeltaTqIGain_Y_mps2 "" 0x0000 /* @ECU_Address@AVMC_ACCDeltaTqIGain_Y_mps2@ */ VVMC_ActAccDev_mps2 Lookup2D_X_FLOAT32_IEEE 0 SWC_FDC_type_CM_single_mps2 21 -10.0 10.0 /end AXIS_PTS
/begin AXIS_PTS AVMC_ACCDeltaTqIGain_X_kph "" 0x0000 /* @ECU_Address@AVMC_ACCDeltaTqIGain_X_kph@ */ NO_INPUT_QUANTITY Lookup2D_X_FLOAT32_IEEE 0 SWC_FDC_type_CM_single_kph 17 0.0 300.0 /end AXIS_PTS
/begin CHARACTERISTIC MVMC_ACCDeltaTqPGain_Z_Nm "" MAP 0x0000 /* @ECU_Address@MVMC_ACCDeltaTqPGain_Z_Nm@ */ Lookup2D_FLOAT32_IEEE 0 SWC_FDC_type_CM_single_Nm -20.0 20.0
 /begin AXIS_DESCR COM_AXIS NO_INPUT_QUANTITY SWC_FDC_type_CM_single_kph 17 0.0 300.0 AXIS_PTS_REF AVMC_ACCDeltaTqPGain_X_kph /end AXIS_DESCR
 /begin AXIS_DESCR COM_AXIS VVMC_ACCActSpdDev_kph SWC_FDC_type_CM_single_kph 21 -300.0 300.0 AXIS_PTS_REF AVMC_ACCDeltaTqPGain_Y_kph /end AXIS_DESCR
/end CHARACTERISTIC
/begin AXIS_PTS AVMC_ACCDeltaTqPGain_Y_kph "" 0x0000 /* @ECU_Address@AVMC_ACCDeltaTqPGain_Y_kph@ */ VVMC_ACCActSpdDev_kph Lookup2D_X_FLOAT32_IEEE 0 SWC_FDC_type_CM_single_kph 21 -300.0 300.0 /end AXIS_PTS
/begin AXIS_PTS AVMC_ACCDeltaTqPGain_X_kph "" 0x0000 /* @ECU_Address@AVMC_ACCDeltaTqPGain_X_kph@ */ NO_INPUT_QUANTITY Lookup2D_X_FLOAT32_IEEE 0 SWC_FDC_type_CM_single_kph 17 0.0 300.0 /end AXIS_PTS
/begin CHARACTERISTIC MVMC_ADSPosGFBDeltaTq_Z_Nm "" MAP 0x0000 /* @ECU_Address@MVMC_ADSPosGFBDeltaTq_Z_Nm@ */ Lookup2D_FLOAT32_IEEE 0 SWC_FDC_type_CM_single_Nm -50.0 50.0
 /begin AXIS_DESCR COM_AXIS NO_INPUT_QUANTITY SWC_FDC_type_CM_single_kph 17 0.0 300.0 AXIS_PTS_REF AVMC_ADSPosGFBDeltaTq_X_kph /end AXIS_DESCR
 /begin AXIS_DESCR COM_AXIS VVMC_ActAccDev_mps2 SWC_FDC_type_CM_single_mps2 21 -10.0 10.0 AXIS_PTS_REF AVMC_ADSPosGFBDeltaTq_Y_mps2 /end AXIS_DESCR
/end CHARACTERISTIC
/begin AXIS_PTS AVMC_ADSPosGFBDeltaTq_Y_mps2 "" 0x0000 /* @ECU_Address@AVMC_ADSPosGFBDeltaTq_Y_mps2@ */ VVMC_ActAccDev_mps2 Lookup2D_X_FLOAT32_IEEE 0 SWC_FDC_type_CM_single_mps2 21 -10.0 10.0 /end AXIS_PTS
/begin AXIS_PTS AVMC_ADSPosGFBDeltaTq_X_kph "" 0x0000 /* @ECU_Address@AVMC_ADSPosGFBDeltaTq_X_kph@ */ NO_INPUT_QUANTITY Lookup2D_X_FLOAT32_IEEE 0 SWC_FDC_type_CM_single_kph 17 0.0 300.0 /end AXIS_PTS
/begin CHARACTERISTIC MVMC_DISCDeltaTqIGain_Z_Nm "" MAP 0x0000 /* @ECU_Address@MVMC_DISCDeltaTqIGain_Z_Nm@ */ Lookup2D_FLOAT32_IEEE 0 SWC_FDC_type_CM_single_Nm -50.0 50.0
 /begin AXIS_DESCR COM_AXIS NO_INPUT_QUANTITY SWC_FDC_type_CM_single_kph 17 0.0 300.0 AXIS_PTS_REF AVMC_DISCDeltaTqIGain_X_kph /end AXIS_DESCR
 /begin AXIS_DESCR COM_AXIS VVMC_ActAccDev_mps2 SWC_FDC_type_CM_single_mps2 21 -10.0 10.0 AXIS_PTS_REF AVMC_DISCDeltaTqIGain_Y_mps2 /end AXIS_DESCR
/end CHARACTERISTIC
/begin AXIS_PTS AVMC_DISCDeltaTqIGain_Y_mps2 "" 0x0000 /* @ECU_Address@AVMC_DISCDeltaTqIGain_Y_mps2@ */ VVMC_ActAccDev_mps2 Lookup2D_X_FLOAT32_IEEE 0 SWC_FDC_type_CM_single_mps2 21 -10.0 10.0 /end AXIS_PTS
/begin AXIS_PTS AVMC_DISCDeltaTqIGain_X_kph "" 0x0000 /* @ECU_Address@AVMC_DISCDeltaTqIGain_X_kph@ */ NO_INPUT_QUANTITY Lookup2D_X_FLOAT32_IEEE 0 SWC_FDC_type_CM_single_kph 17 0.0 300.0 /end AXIS_PTS
/begin CHARACTERISTIC MVMC_MCPresBaseTq_Y_Nm "" CURVE 0x0000 /* @ECU_Address@MVMC_MCPresBaseTq_Y_Nm@ */ Lookup1D_FLOAT32_IEEE 0 SWC_FDC_type_CM_single_Nm -1000.0 1000.0
 /begin AXIS_DESCR COM_AXIS NO_INPUT_QUANTITY SWC_FDC_type_CM_single_bar 17 -500.0 500.0 AXIS_PTS_REF AVMC_MCPresBaseTq_X_bar /end AXIS_DESCR
/end CHARACTERISTIC
/begin AXIS_PTS AVMC_MCPresBaseTq_X_bar "" 0x0000 /* @ECU_Address@AVMC_MCPresBaseTq_X_bar@ */ NO_INPUT_QUANTITY Lookup1D_X_FLOAT32_IEEE 0 SWC_FDC_type_CM_single_bar 17 -500.0 500.0 /end AXIS_PTS
/begin CHARACTERISTIC MVMC_TMSpdBaseTq_Y_Nm "" CURVE 0x0000 /* @ECU_Address@MVMC_TMSpdBaseTq_Y_Nm@ */ Lookup1D_FLOAT32_IEEE 0 SWC_FDC_type_CM_single_Nm 0.0 500.0
 /begin AXIS_DESCR COM_AXIS NO_INPUT_QUANTITY SWC_FDC_type_CM_single_rpm 13 -100.0 100.0 AXIS_PTS_REF AVMC_TMSpdBaseTq_X_rpm /end AXIS_DESCR
/end CHARACTERISTIC
/begin AXIS_PTS AVMC_TMSpdBaseTq_X_rpm "" 0x0000 /* @ECU_Address@AVMC_TMSpdBaseTq_X_rpm@ */ NO_INPUT_QUANTITY Lookup1D_X_FLOAT32_IEEE 0 SWC_FDC_type_CM_single_rpm 13 -100.0 100.0 /end AXIS_PTS
/begin CHARACTERISTIC MVMC_VehHoldTqIncGain_Y_Nm "" CURVE 0x0000 /* @ECU_Address@MVMC_VehHoldTqIncGain_Y_Nm@ */ Lookup1D_FLOAT32_IEEE 0 SWC_FDC_type_CM_single_Nm -1000.0 1000.0
 /begin AXIS_DESCR COM_AXIS VVMC_EstSlope_Deg SWC_FDC_type_CM_single_deg 10 -50.0 50.0 AXIS_PTS_REF AVMC_VehHoldTqIncGain_X_deg /end AXIS_DESCR
/end CHARACTERISTIC
/begin AXIS_PTS AVMC_VehHoldTqIncGain_X_deg "" 0x0000 /* @ECU_Address@AVMC_VehHoldTqIncGain_X_deg@ */ VVMC_EstSlope_Deg Lookup1D_X_FLOAT32_IEEE 0 SWC_FDC_type_CM_single_deg 10 -50.0 50.0 /end AXIS_PTS
/begin CHARACTERISTIC MVMC_DISCDeltaTqPGain_Z_Nm "" MAP 0x0000 /* @ECU_Address@MVMC_DISCDeltaTqPGain_Z_Nm@ */ Lookup2D_FLOAT32_IEEE 0 SWC_FDC_type_CM_single_Nm -3000.0 3000.0
 /begin AXIS_DESCR COM_AXIS VVMC_FeatSetSpdForCalcu_kph SWC_FDC_type_CM_single_kph 19 0.0 300.0 AXIS_PTS_REF AVMC_DISCDeltaTqPGain_X_kph /end AXIS_DESCR
 /begin AXIS_DESCR COM_AXIS NO_INPUT_QUANTITY SWC_FDC_type_CM_single_kph 21 -300.0 300.0 AXIS_PTS_REF AVMC_DISCDeltaTqPGain_Y_kph /end AXIS_DESCR
/end CHARACTERISTIC
/begin AXIS_PTS AVMC_DISCDeltaTqPGain_Y_kph "" 0x0000 /* @ECU_Address@AVMC_DISCDeltaTqPGain_Y_kph@ */ NO_INPUT_QUANTITY Lookup2D_X_FLOAT32_IEEE 0 SWC_FDC_type_CM_single_kph 21 -300.0 300.0 /end AXIS_PTS
/begin AXIS_PTS AVMC_DISCDeltaTqPGain_X_kph "" 0x0000 /* @ECU_Address@AVMC_DISCDeltaTqPGain_X_kph@ */ VVMC_FeatSetSpdForCalcu_kph Lookup2D_X_FLOAT32_IEEE 0 SWC_FDC_type_CM_single_kph 19 0.0 300.0 /end AXIS_PTS
/begin CHARACTERISTIC MVMC_ACCPedalOvrdTqHys_Y_Nm "" CURVE 0x0000 /* @ECU_Address@MVMC_ACCPedalOvrdTqHys_Y_Nm@ */ Lookup1D_FLOAT32_IEEE 0 SWC_FDC_type_CM_single_Nm -1000.0 1000.0
 /begin AXIS_DESCR FIX_AXIS NO_INPUT_QUANTITY SWC_FDC_type_CM_uint32 8 0 7 FIX_AXIS_PAR_DIST 0 1 8 /end AXIS_DESCR
/end CHARACTERISTIC
/begin CHARACTERISTIC MVMC_MSASpdBand_Y_pct "" CURVE 0x0000 /* @ECU_Address@MVMC_MSASpdBand_Y_pct@ */ Lookup1D_FLOAT32_IEEE 0 SWC_FDC_type_CM_single_pct 0.0 100.0
 /begin AXIS_DESCR COM_AXIS NO_INPUT_QUANTITY SWC_FDC_type_CM_single_kph 17 0.0 300.0 AXIS_PTS_REF AVMC_MSASpdBand_X_kph /end AXIS_DESCR
/end CHARACTERISTIC
/begin AXIS_PTS AVMC_MSASpdBand_X_kph "" 0x0000 /* @ECU_Address@AVMC_MSASpdBand_X_kph@ */ NO_INPUT_QUANTITY Lookup1D_X_FLOAT32_IEEE 0 SWC_FDC_type_CM_single_kph 17 0.0 300.0 /end AXIS_PTS
/begin CHARACTERISTIC MVMC_MSATqDownEndTq_Y_Nm "" CURVE 0x0000 /* @ECU_Address@MVMC_MSATqDownEndTq_Y_Nm@ */ Lookup1D_FLOAT32_IEEE 0 SWC_FDC_type_CM_single_Nm -3000.0 3000.0
 /begin AXIS_DESCR COM_AXIS NO_INPUT_QUANTITY SWC_FDC_type_CM_single_kph 17 0.0 300.0 AXIS_PTS_REF AVMC_MSATqDownEndTq_X_kph /end AXIS_DESCR
/end CHARACTERISTIC
/begin AXIS_PTS AVMC_MSATqDownEndTq_X_kph "" 0x0000 /* @ECU_Address@AVMC_MSATqDownEndTq_X_kph@ */ NO_INPUT_QUANTITY Lookup1D_X_FLOAT32_IEEE 0 SWC_FDC_type_CM_single_kph 17 0.0 300.0 /end AXIS_PTS
/begin CHARACTERISTIC MVMC_MSATqDownTime_Y_s "" CURVE 0x0000 /* @ECU_Address@MVMC_MSATqDownTime_Y_s@ */ Lookup1D_FLOAT32_IEEE 0 SWC_FDC_type_CM_single_s 0.01 10.0
 /begin AXIS_DESCR COM_AXIS NO_INPUT_QUANTITY SWC_FDC_type_CM_single_kph 17 0.0 300.0 AXIS_PTS_REF AVMC_MSATqDownTime_X_kph /end AXIS_DESCR
/end CHARACTERISTIC
/begin AXIS_PTS AVMC_MSATqDownTime_X_kph "" 0x0000 /* @ECU_Address@AVMC_MSATqDownTime_X_kph@ */ NO_INPUT_QUANTITY Lookup1D_X_FLOAT32_IEEE 0 SWC_FDC_type_CM_single_kph 17 0.0 300.0 /end AXIS_PTS
/begin CHARACTERISTIC MVMC_MSAPedalOvrd_Y_pct "" CURVE 0x0000 /* @ECU_Address@MVMC_MSAPedalOvrd_Y_pct@ */ Lookup1D_FLOAT32_IEEE 0 SWC_FDC_type_CM_single_pct 0.0 125.0
 /begin AXIS_DESCR COM_AXIS NO_INPUT_QUANTITY SWC_FDC_type_CM_single_kph 22 0.0 300.0 AXIS_PTS_REF AVMC_MSAPedalOvrd_X_kph /end AXIS_DESCR
/end CHARACTERISTIC
/begin AXIS_PTS AVMC_MSAPedalOvrd_X_kph "" 0x0000 /* @ECU_Address@AVMC_MSAPedalOvrd_X_kph@ */ NO_INPUT_QUANTITY Lookup1D_X_FLOAT32_IEEE 0 SWC_FDC_type_CM_single_kph 22 0.0 300.0 /end AXIS_PTS
/begin CHARACTERISTIC MVMC_ESCRegenOutEnSpd_Y_kph "" CURVE 0x0000 /* @ECU_Address@MVMC_ESCRegenOutEnSpd_Y_kph@ */ Lookup1D_FLOAT32_IEEE 0 SWC_FDC_type_CM_single_kph 0.0 300.0
 /begin AXIS_DESCR COM_AXIS NO_INPUT_QUANTITY SWC_FDC_type_CM_single_Deg 13 -500.0 500.0 AXIS_PTS_REF AVMC_ESCRegenOutEnSpd_X_Deg /end AXIS_DESCR
/end CHARACTERISTIC
/begin AXIS_PTS AVMC_ESCRegenOutEnSpd_X_Deg "" 0x0000 /* @ECU_Address@AVMC_ESCRegenOutEnSpd_X_Deg@ */ NO_INPUT_QUANTITY Lookup1D_X_FLOAT32_IEEE 0 SWC_FDC_type_CM_single_Deg 13 -500.0 500.0 /end AXIS_PTS
/begin CHARACTERISTIC MVMC_ESCRegenOut_Z_Dps "" MAP 0x0000 /* @ECU_Address@MVMC_ESCRegenOut_Z_Dps@ */ Lookup2D_FLOAT32_IEEE 0 SWC_FDC_type_CM_single_Dps -150.0 150.0
 /begin AXIS_DESCR COM_AXIS NO_INPUT_QUANTITY SWC_FDC_type_CM_single_kph 26 0.0 300.0 AXIS_PTS_REF AVMC_ESCRegenOut_X_kph /end AXIS_DESCR
 /begin AXIS_DESCR COM_AXIS NO_INPUT_QUANTITY SWC_FDC_type_CM_single_Deg 37 -900.0 900.0 AXIS_PTS_REF AVMC_ESCRegenOut_Y_Deg /end AXIS_DESCR
/end CHARACTERISTIC
/begin AXIS_PTS AVMC_ESCRegenOut_Y_Deg "" 0x0000 /* @ECU_Address@AVMC_ESCRegenOut_Y_Deg@ */ NO_INPUT_QUANTITY Lookup2D_X_FLOAT32_IEEE 0 SWC_FDC_type_CM_single_Deg 37 -900.0 900.0 /end AXIS_PTS
/begin AXIS_PTS AVMC_ESCRegenOut_X_kph "" 0x0000 /* @ECU_Address@AVMC_ESCRegenOut_X_kph@ */ NO_INPUT_QUANTITY Lookup2D_X_FLOAT32_IEEE 0 SWC_FDC_type_CM_single_kph 26 0.0 300.0 /end AXIS_PTS
/begin CHARACTERISTIC MVMC_LatESCRegenOut_Z_Gps "" MAP 0x0000 /* @ECU_Address@MVMC_LatESCRegenOut_Z_Gps@ */ Lookup2D_FLOAT32_IEEE 0 SWC_FDC_type_CM_single_Gps -150.0 150.0
 /begin AXIS_DESCR COM_AXIS NO_INPUT_QUANTITY SWC_FDC_type_CM_single_kph 26 0.0 300.0 AXIS_PTS_REF AVMC_LatESCRegenOut_X_kph /end AXIS_DESCR
 /begin AXIS_DESCR COM_AXIS NO_INPUT_QUANTITY SWC_FDC_type_CM_single_Deg 37 -900.0 900.0 AXIS_PTS_REF AVMC_LatESCRegenOut_Y_Deg /end AXIS_DESCR
/end CHARACTERISTIC
/begin AXIS_PTS AVMC_LatESCRegenOut_Y_Deg "" 0x0000 /* @ECU_Address@AVMC_LatESCRegenOut_Y_Deg@ */ NO_INPUT_QUANTITY Lookup2D_X_FLOAT32_IEEE 0 SWC_FDC_type_CM_single_Deg 37 -900.0 900.0 /end AXIS_PTS
/begin AXIS_PTS AVMC_LatESCRegenOut_X_kph "" 0x0000 /* @ECU_Address@AVMC_LatESCRegenOut_X_kph@ */ NO_INPUT_QUANTITY Lookup2D_X_FLOAT32_IEEE 0 SWC_FDC_type_CM_single_kph 26 0.0 300.0 /end AXIS_PTS
/begin CHARACTERISTIC MVMC_RDCDetectTime_Z_s "" MAP 0x0000 /* @ECU_Address@MVMC_RDCDetectTime_Z_s@ */ Lookup2D_FLOAT32_IEEE 0 SWC_FDC_type_CM_single_s 0.0 7200.0
 /begin AXIS_DESCR COM_AXIS NO_INPUT_QUANTITY SWC_FDC_type_CM_single_kph 42 0.0 300.0 AXIS_PTS_REF AVMC_RDCDetectTime_X_kph /end AXIS_DESCR
 /begin AXIS_DESCR COM_AXIS VVMC_ActMaxSlideRate_pct SWC_FDC_type_CM_single_pct 35 -125.0 125.0 AXIS_PTS_REF AVMC_RDCDetectTime_Y_pct /end AXIS_DESCR
/end CHARACTERISTIC
/begin AXIS_PTS AVMC_RDCDetectTime_Y_pct "" 0x0000 /* @ECU_Address@AVMC_RDCDetectTime_Y_pct@ */ VVMC_ActMaxSlideRate_pct Lookup2D_X_FLOAT32_IEEE 0 SWC_FDC_type_CM_single_pct 35 -125.0 125.0 /end AXIS_PTS
/begin AXIS_PTS AVMC_RDCDetectTime_X_kph "" 0x0000 /* @ECU_Address@AVMC_RDCDetectTime_X_kph@ */ NO_INPUT_QUANTITY Lookup2D_X_FLOAT32_IEEE 0 SWC_FDC_type_CM_single_kph 42 0.0 300.0 /end AXIS_PTS
/begin CHARACTERISTIC MVMC_RDCEnSlideRate_Y_pct "" CURVE 0x0000 /* @ECU_Address@MVMC_RDCEnSlideRate_Y_pct@ */ Lookup1D_FLOAT32_IEEE 0 SWC_FDC_type_CM_single_pct 0.0 125.0
 /begin AXIS_DESCR COM_AXIS NO_INPUT_QUANTITY SWC_FDC_type_CM_single_Deg 43 -900.0 900.0 AXIS_PTS_REF AVMC_RDCEnSlideRate_X_Deg /end AXIS_DESCR
/end CHARACTERISTIC
/begin AXIS_PTS AVMC_RDCEnSlideRate_X_Deg "" 0x0000 /* @ECU_Address@AVMC_RDCEnSlideRate_X_Deg@ */ NO_INPUT_QUANTITY Lookup1D_X_FLOAT32_IEEE 0 SWC_FDC_type_CM_single_Deg 43 -900.0 900.0 /end AXIS_PTS
/begin CHARACTERISTIC MVMC_StESCYawCom_Z_Dps "" MAP 0x0000 /* @ECU_Address@MVMC_StESCYawCom_Z_Dps@ */ Lookup2D_FLOAT32_IEEE 0 SWC_FDC_type_CM_single_Dps -150.0 150.0
 /begin AXIS_DESCR COM_AXIS NO_INPUT_QUANTITY SWC_FDC_type_CM_single_kph 26 -10.0 300.0 AXIS_PTS_REF AVMC_StESCYawCom_X_kph /end AXIS_DESCR
 /begin AXIS_DESCR COM_AXIS NO_INPUT_QUANTITY SWC_FDC_type_CM_single_Gps 19 -20.0 20.0 AXIS_PTS_REF AVMC_StESCYawCom_Y_Gps /end AXIS_DESCR
/end CHARACTERISTIC
/begin AXIS_PTS AVMC_StESCYawCom_Y_Gps "" 0x0000 /* @ECU_Address@AVMC_StESCYawCom_Y_Gps@ */ NO_INPUT_QUANTITY Lookup2D_X_FLOAT32_IEEE 0 SWC_FDC_type_CM_single_Gps 19 -20.0 20.0 /end AXIS_PTS
/begin AXIS_PTS AVMC_StESCYawCom_X_kph "" 0x0000 /* @ECU_Address@AVMC_StESCYawCom_X_kph@ */ NO_INPUT_QUANTITY Lookup2D_X_FLOAT32_IEEE 0 SWC_FDC_type_CM_single_kph 26 -10.0 300.0 /end AXIS_PTS
/begin CHARACTERISTIC MVMC_StESCYaw_Z_Dps "" MAP 0x0000 /* @ECU_Address@MVMC_StESCYaw_Z_Dps@ */ Lookup2D_FLOAT32_IEEE 0 SWC_FDC_type_CM_single_Dps -150.0 150.0
 /begin AXIS_DESCR COM_AXIS NO_INPUT_QUANTITY SWC_FDC_type_CM_single_kph 26 0.0 300.0 AXIS_PTS_REF AVMC_StESCYaw_X_kph /end AXIS_DESCR
 /begin AXIS_DESCR COM_AXIS NO_INPUT_QUANTITY SWC_FDC_type_CM_single_Deg 19 -900.0 900.0 AXIS_PTS_REF AVMC_StESCYaw_Y_Deg /end AXIS_DESCR
/end CHARACTERISTIC
/begin AXIS_PTS AVMC_StESCYaw_Y_Deg "" 0x0000 /* @ECU_Address@AVMC_StESCYaw_Y_Deg@ */ NO_INPUT_QUANTITY Lookup2D_X_FLOAT32_IEEE 0 SWC_FDC_type_CM_single_Deg 19 -900.0 900.0 /end AXIS_PTS
/begin AXIS_PTS AVMC_StESCYaw_X_kph "" 0x0000 /* @ECU_Address@AVMC_StESCYaw_X_kph@ */ NO_INPUT_QUANTITY Lookup2D_X_FLOAT32_IEEE 0 SWC_FDC_type_CM_single_kph 26 0.0 300.0 /end AXIS_PTS
/begin CHARACTERISTIC MVMC_ISOAccLimit_Y_mps2 "" CURVE 0x0000 /* @ECU_Address@MVMC_ISOAccLimit_Y_mps2@ */ Lookup1D_FLOAT32_IEEE 0 SWC_FDC_type_CM_single_mps2 0.0 6.0
 /begin AXIS_DESCR COM_AXIS NO_INPUT_QUANTITY SWC_FDC_type_CM_single_mps 4 0.0 80.0 AXIS_PTS_REF AVMC_ISOAccLimit_X_mps /end AXIS_DESCR
/end CHARACTERISTIC
/begin AXIS_PTS AVMC_ISOAccLimit_X_mps "" 0x0000 /* @ECU_Address@AVMC_ISOAccLimit_X_mps@ */ NO_INPUT_QUANTITY Lookup1D_X_FLOAT32_IEEE 0 SWC_FDC_type_CM_single_mps 4 0.0 80.0 /end AXIS_PTS
/begin CHARACTERISTIC MVMC_ISODecLimit_Y_mps2 "" CURVE 0x0000 /* @ECU_Address@MVMC_ISODecLimit_Y_mps2@ */ Lookup1D_FLOAT32_IEEE 0 SWC_FDC_type_CM_single_mps2 0.0 6.0
 /begin AXIS_DESCR COM_AXIS NO_INPUT_QUANTITY SWC_FDC_type_CM_single_mps 4 0.0 80.0 AXIS_PTS_REF AVMC_ISODecLimit_X_mps /end AXIS_DESCR
/end CHARACTERISTIC
/begin AXIS_PTS AVMC_ISODecLimit_X_mps "" 0x0000 /* @ECU_Address@AVMC_ISODecLimit_X_mps@ */ NO_INPUT_QUANTITY Lookup1D_X_FLOAT32_IEEE 0 SWC_FDC_type_CM_single_mps 4 0.0 80.0 /end AXIS_PTS
/begin CHARACTERISTIC MVMC_ISOJerk_Y_mps3 "" CURVE 0x0000 /* @ECU_Address@MVMC_ISOJerk_Y_mps3@ */ Lookup1D_FLOAT32_IEEE 0 SWC_FDC_type_CM_single_mps3 0.0 6.0
 /begin AXIS_DESCR COM_AXIS NO_INPUT_QUANTITY SWC_FDC_type_CM_single_mps 4 0.0 80.0 AXIS_PTS_REF AVMC_ISOJerk_X_mps /end AXIS_DESCR
/end CHARACTERISTIC
/begin AXIS_PTS AVMC_ISOJerk_X_mps "" 0x0000 /* @ECU_Address@AVMC_ISOJerk_X_mps@ */ NO_INPUT_QUANTITY Lookup1D_X_FLOAT32_IEEE 0 SWC_FDC_type_CM_single_mps 4 0.0 80.0 /end AXIS_PTS
/begin CHARACTERISTIC MVMC_ReqBrkJoinDecSR_Y_mps3 "" CURVE 0x0000 /* @ECU_Address@MVMC_ReqBrkJoinDecSR_Y_mps3@ */ Lookup1D_FLOAT32_IEEE 0 SWC_FDC_type_CM_single_mps3 -10.0 10.0
 /begin AXIS_DESCR COM_AXIS NO_INPUT_QUANTITY SWC_FDC_type_CM_single_mps2 10 -10.0 10.0 AXIS_PTS_REF AVMC_ReqBrkJoinDecSR_X_mps2 /end AXIS_DESCR
/end CHARACTERISTIC
/begin AXIS_PTS AVMC_ReqBrkJoinDecSR_X_mps2 "" 0x0000 /* @ECU_Address@AVMC_ReqBrkJoinDecSR_X_mps2@ */ NO_INPUT_QUANTITY Lookup1D_X_FLOAT32_IEEE 0 SWC_FDC_type_CM_single_mps2 10 -10.0 10.0 /end AXIS_PTS
/begin CHARACTERISTIC MVMC_OVRD2ActSR2FCMCMD_Y_mps3 "" CURVE 0x0000 /* @ECU_Address@MVMC_OVRD2ActSR2FCMCMD_Y_mps3@ */ Lookup1D_FLOAT32_IEEE 0 SWC_FDC_type_CM_single_mps3 -10.0 10.0
 /begin AXIS_DESCR COM_AXIS NO_INPUT_QUANTITY SWC_FDC_type_CM_single_mps2 10 -10.0 10.0 AXIS_PTS_REF AVMC_OVRD2ActSR2FCMCMD_X_mps2 /end AXIS_DESCR
/end CHARACTERISTIC
/begin AXIS_PTS AVMC_OVRD2ActSR2FCMCMD_X_mps2 "" 0x0000 /* @ECU_Address@AVMC_OVRD2ActSR2FCMCMD_X_mps2@ */ NO_INPUT_QUANTITY Lookup1D_X_FLOAT32_IEEE 0 SWC_FDC_type_CM_single_mps2 10 -10.0 10.0 /end AXIS_PTS
/begin CHARACTERISTIC MVMC_VehHoldDecCtrlTime2_Y_s "" CURVE 0x0000 /* @ECU_Address@MVMC_VehHoldDecCtrlTime2_Y_s@ */ Lookup1D_FLOAT32_IEEE 0 SWC_FDC_type_CM_single_s 0.1 10.0
 /begin AXIS_DESCR COM_AXIS VVMC_VehHoldEnSpd_kph SWC_FDC_type_CM_single_kph 42 0.0 255.0 AXIS_PTS_REF AVMC_VehHoldDecCtrlTime2_X_kph /end AXIS_DESCR
/end CHARACTERISTIC
/begin AXIS_PTS AVMC_VehHoldDecCtrlTime2_X_kph "" 0x0000 /* @ECU_Address@AVMC_VehHoldDecCtrlTime2_X_kph@ */ VVMC_VehHoldEnSpd_kph Lookup1D_X_FLOAT32_IEEE 0 SWC_FDC_type_CM_single_kph 42 0.0 255.0 /end AXIS_PTS
/begin CHARACTERISTIC MVMC_VehHoldDecCtrlTime_Y_s "" CURVE 0x0000 /* @ECU_Address@MVMC_VehHoldDecCtrlTime_Y_s@ */ Lookup1D_FLOAT32_IEEE 0 SWC_FDC_type_CM_single_s 0.1 10.0
 /begin AXIS_DESCR COM_AXIS VVMC_VehHoldEnSpd_kph SWC_FDC_type_CM_single_kph 42 0.0 255.0 AXIS_PTS_REF AVMC_VehHoldDecCtrlTime_X_kph /end AXIS_DESCR
/end CHARACTERISTIC
/begin AXIS_PTS AVMC_VehHoldDecCtrlTime_X_kph "" 0x0000 /* @ECU_Address@AVMC_VehHoldDecCtrlTime_X_kph@ */ VVMC_VehHoldEnSpd_kph Lookup1D_X_FLOAT32_IEEE 0 SWC_FDC_type_CM_single_kph 42 0.0 255.0 /end AXIS_PTS
/begin CHARACTERISTIC MVMC_VehHoldMCPPass2_Y_bar "" CURVE 0x0000 /* @ECU_Address@MVMC_VehHoldMCPPass2_Y_bar@ */ Lookup1D_FLOAT32_IEEE 0 SWC_FDC_type_CM_single_bar 0.0 50.0
 /begin AXIS_DESCR COM_AXIS NO_INPUT_QUANTITY SWC_FDC_type_CM_single_deg 21 -50.0 50.0 AXIS_PTS_REF AVMC_VehHoldMCPPass2_X_deg /end AXIS_DESCR
/end CHARACTERISTIC
/begin AXIS_PTS AVMC_VehHoldMCPPass2_X_deg "" 0x0000 /* @ECU_Address@AVMC_VehHoldMCPPass2_X_deg@ */ NO_INPUT_QUANTITY Lookup1D_X_FLOAT32_IEEE 0 SWC_FDC_type_CM_single_deg 21 -50.0 50.0 /end AXIS_PTS
/begin CHARACTERISTIC MVMC_VehHoldMCPPass_Y_bar "" CURVE 0x0000 /* @ECU_Address@MVMC_VehHoldMCPPass_Y_bar@ */ Lookup1D_FLOAT32_IEEE 0 SWC_FDC_type_CM_single_bar 0.0 50.0
 /begin AXIS_DESCR COM_AXIS NO_INPUT_QUANTITY SWC_FDC_type_CM_single_deg 27 0.0 50.0 AXIS_PTS_REF AVMC_VehHoldMCPPass_X_deg /end AXIS_DESCR
/end CHARACTERISTIC
/begin AXIS_PTS AVMC_VehHoldMCPPass_X_deg "" 0x0000 /* @ECU_Address@AVMC_VehHoldMCPPass_X_deg@ */ NO_INPUT_QUANTITY Lookup1D_X_FLOAT32_IEEE 0 SWC_FDC_type_CM_single_deg 27 0.0 50.0 /end AXIS_PTS
/begin CHARACTERISTIC KTHC_KiEXV1SHDeice_K "" VALUE 0x0000 /* @ECU_Address@KTHC_KiEXV1SHDeice_K@ */ Scalar_FLOAT32_IEEE 0 SWC_FDC_type_CM_single_K -10000.0 10000.0 /end CHARACTERISTIC
/begin CHARACTERISTIC KTHC_KiEXV1SH_K "" VALUE 0x0000 /* @ECU_Address@KTHC_KiEXV1SH_K@ */ Scalar_FLOAT32_IEEE 0 SWC_FDC_type_CM_single_K -10000.0 10000.0 /end CHARACTERISTIC
/begin CHARACTERISTIC KTHC_KiEXV2SHD_K "" VALUE 0x0000 /* @ECU_Address@KTHC_KiEXV2SHD_K@ */ Scalar_FLOAT32_IEEE 0 SWC_FDC_type_CM_single_K -10000.0 10000.0 /end CHARACTERISTIC
/begin CHARACTERISTIC KTHC_KiEXV2SH_K "" VALUE 0x0000 /* @ECU_Address@KTHC_KiEXV2SH_K@ */ Scalar_FLOAT32_IEEE 0 SWC_FDC_type_CM_single_K -10000.0 10000.0 /end CHARACTERISTIC
/begin CHARACTERISTIC KTHC_KpEXV1SHDeice_K "" VALUE 0x0000 /* @ECU_Address@KTHC_KpEXV1SHDeice_K@ */ Scalar_FLOAT32_IEEE 0 SWC_FDC_type_CM_single_K -10000.0 10000.0 /end CHARACTERISTIC
/begin CHARACTERISTIC KTHC_KpEXV1SH_K "" VALUE 0x0000 /* @ECU_Address@KTHC_KpEXV1SH_K@ */ Scalar_FLOAT32_IEEE 0 SWC_FDC_type_CM_single_K -10000.0 10000.0 /end CHARACTERISTIC
/begin CHARACTERISTIC KTHC_KpEXV2SHD_K "" VALUE 0x0000 /* @ECU_Address@KTHC_KpEXV2SHD_K@ */ Scalar_FLOAT32_IEEE 0 SWC_FDC_type_CM_single_K -10000.0 10000.0 /end CHARACTERISTIC
/begin CHARACTERISTIC KTHC_KpEXV2SH_K "" VALUE 0x0000 /* @ECU_Address@KTHC_KpEXV2SH_K@ */ Scalar_FLOAT32_IEEE 0 SWC_FDC_type_CM_single_K -10000.0 10000.0 /end CHARACTERISTIC
/begin CHARACTERISTIC KTHC_MotorInTempDefH_C "" VALUE 0x0000 /* @ECU_Address@KTHC_MotorInTempDefH_C@ */ Scalar_FLOAT32_IEEE 0 SWC_FDC_type_CM_single_C -40.0 200.0 /end CHARACTERISTIC
/begin CHARACTERISTIC KTHC_MotorInTempDefL_C "" VALUE 0x0000 /* @ECU_Address@KTHC_MotorInTempDefL_C@ */ Scalar_FLOAT32_IEEE 0 SWC_FDC_type_CM_single_C -40.0 200.0 /end CHARACTERISTIC
/begin CHARACTERISTIC KTHC_TdiffC_C "" VALUE 0x0000 /* @ECU_Address@KTHC_TdiffC_C@ */ Scalar_FLOAT32_IEEE 0 SWC_FDC_type_CM_single_C -40.0 200.0 /end CHARACTERISTIC
/begin CHARACTERISTIC KTHC_TdiffD_C "" VALUE 0x0000 /* @ECU_Address@KTHC_TdiffD_C@ */ Scalar_FLOAT32_IEEE 0 SWC_FDC_type_CM_single_C -40.0 200.0 /end CHARACTERISTIC
/begin CHARACTERISTIC KTHC_TdiffH_C "" VALUE 0x0000 /* @ECU_Address@KTHC_TdiffH_C@ */ Scalar_FLOAT32_IEEE 0 SWC_FDC_type_CM_single_C -40.0 200.0 /end CHARACTERISTIC
/begin CHARACTERISTIC KTQD_AvailBRgnTqVSOC_pct "" VALUE 0x0000 /* @ECU_Address@KTQD_AvailBRgnTqVSOC_pct@ */ Scalar_FLOAT32_IEEE 0 SWC_FDC_type_CM_single_pct 0.0 100.0 /end CHARACTERISTIC
/begin CHARACTERISTIC KTQD_AvailBrkRgnTqSpd_kph "" VALUE 0x0000 /* @ECU_Address@KTQD_AvailBrkRgnTqSpd_kph@ */ Scalar_FLOAT32_IEEE 0 SWC_FDC_type_CM_single_kph 0.0 300.0 /end CHARACTERISTIC
/begin CHARACTERISTIC KTQD_BRegenCalEnTq_Nm "" VALUE 0x0000 /* @ECU_Address@KTQD_BRegenCalEnTq_Nm@ */ Scalar_FLOAT32_IEEE 0 SWC_FDC_type_CM_single_Nm 0.0 100.0 /end CHARACTERISTIC
/begin CHARACTERISTIC KTQD_BRgnPermDisDelay_s "" VALUE 0x0000 /* @ECU_Address@KTQD_BRgnPermDisDelay_s@ */ Scalar_FLOAT32_IEEE 0 SWC_FDC_type_CM_single_s 0.0 60.0 /end CHARACTERISTIC
/begin CHARACTERISTIC KTQD_DriveProtVehSpdGain_kph "" VALUE 0x0000 /* @ECU_Address@KTQD_DriveProtVehSpdGain_kph@ */ Scalar_FLOAT32_IEEE 0 SWC_FDC_type_CM_single_kph -300.0 300.0 /end CHARACTERISTIC
/begin CHARACTERISTIC KTQD_EscModeTqLimSpdDev_kph "" VALUE 0x0000 /* @ECU_Address@KTQD_EscModeTqLimSpdDev_kph@ */ Scalar_FLOAT32_IEEE 0 SWC_FDC_type_CM_single_kph -1.0 255.0 /end CHARACTERISTIC
/begin CHARACTERISTIC KTQD_FAfterTqCMDGainDec_c "" VALUE 0x0000 /* @ECU_Address@KTQD_FAfterTqCMDGainDec_c@ */ Scalar_FLOAT32_IEEE 0 SWC_FDC_type_CM_single_c -100.0 0.0 /end CHARACTERISTIC
/begin CHARACTERISTIC KTQD_FAfterTqCMDGainInc_c "" VALUE 0x0000 /* @ECU_Address@KTQD_FAfterTqCMDGainInc_c@ */ Scalar_FLOAT32_IEEE 0 SWC_FDC_type_CM_single_c 0.0 100.0 /end CHARACTERISTIC
/begin CHARACTERISTIC KTQD_ForcePLimitSpd_kph "" VALUE 0x0000 /* @ECU_Address@KTQD_ForcePLimitSpd_kph@ */ Scalar_FLOAT32_IEEE 0 SWC_FDC_type_CM_single_kph 0.0 300.0 /end CHARACTERISTIC
/begin CHARACTERISTIC KTQD_FrBRgnCalLowLim_Nm "" VALUE 0x0000 /* @ECU_Address@KTQD_FrBRgnCalLowLim_Nm@ */ Scalar_FLOAT32_IEEE 0 SWC_FDC_type_CM_single_Nm -100000.0 100000.0 /end CHARACTERISTIC
/begin CHARACTERISTIC KTQD_FrBRgnCalUpLim_Nm "" VALUE 0x0000 /* @ECU_Address@KTQD_FrBRgnCalUpLim_Nm@ */ Scalar_FLOAT32_IEEE 0 SWC_FDC_type_CM_single_Nm -100000.0 100000.0 /end CHARACTERISTIC
/begin CHARACTERISTIC KTQD_FrBatapCont_factor "" VALUE 0x0000 /* @ECU_Address@KTQD_FrBatapCont_factor@ */ Scalar_FLOAT32_IEEE 0 SWC_FDC_type_CM_single_factor -100000.0 100000.0 /end CHARACTERISTIC
/begin CHARACTERISTIC KTQD_FrEDURollRgnLowTq_Nm "" VALUE 0x0000 /* @ECU_Address@KTQD_FrEDURollRgnLowTq_Nm@ */ Scalar_FLOAT32_IEEE 0 SWC_FDC_type_CM_single_Nm -100000.0 100000.0 /end CHARACTERISTIC
/begin CHARACTERISTIC KTQD_FrEDURollRgnUpTq_Nm "" VALUE 0x0000 /* @ECU_Address@KTQD_FrEDURollRgnUpTq_Nm@ */ Scalar_FLOAT32_IEEE 0 SWC_FDC_type_CM_single_Nm -100000.0 100000.0 /end CHARACTERISTIC
/begin CHARACTERISTIC KTQD_FrIdcMax_A "" VALUE 0x0000 /* @ECU_Address@KTQD_FrIdcMax_A@ */ Scalar_FLOAT32_IEEE 0 SWC_FDC_type_CM_single_A 0.0 1022.0 /end CHARACTERISTIC
/begin CHARACTERISTIC KTQD_FrIdcMin_A "" VALUE 0x0000 /* @ECU_Address@KTQD_FrIdcMin_A@ */ Scalar_FLOAT32_IEEE 0 SWC_FDC_type_CM_single_A -1022.0 0.0 /end CHARACTERISTIC
/begin CHARACTERISTIC KTQD_FrMotorRefPower_kW "" VALUE 0x0000 /* @ECU_Address@KTQD_FrMotorRefPower_kW@ */ Scalar_FLOAT32_IEEE 0 SWC_FDC_type_CM_single_kW 0.0 1000.0 /end CHARACTERISTIC
/begin CHARACTERISTIC KTQD_FrUdcMax_V "" VALUE 0x0000 /* @ECU_Address@KTQD_FrUdcMax_V@ */ Scalar_FLOAT32_IEEE 0 SWC_FDC_type_CM_single_V 0.0 1022.0 /end CHARACTERISTIC
/begin CHARACTERISTIC KTQD_FrUdcMin_V "" VALUE 0x0000 /* @ECU_Address@KTQD_FrUdcMin_V@ */ Scalar_FLOAT32_IEEE 0 SWC_FDC_type_CM_single_V 0.0 1022.0 /end CHARACTERISTIC
/begin CHARACTERISTIC KTQD_FrUppTheldTrq_Nm "" VALUE 0x0000 /* @ECU_Address@KTQD_FrUppTheldTrq_Nm@ */ Scalar_FLOAT32_IEEE 0 SWC_FDC_type_CM_single_Nm -100000.0 100000.0 /end CHARACTERISTIC
/begin CHARACTERISTIC KTQD_FreeWhlDetStableSpd_kph "" VALUE 0x0000 /* @ECU_Address@KTQD_FreeWhlDetStableSpd_kph@ */ Scalar_FLOAT32_IEEE 0 SWC_FDC_type_CM_single_kph -255.0 255.0 /end CHARACTERISTIC
/begin CHARACTERISTIC KTQD_NewSlideRateTs_c "" VALUE 0x0000 /* @ECU_Address@KTQD_NewSlideRateTs_c@ */ Scalar_FLOAT32_IEEE 0 SWC_FDC_type_CM_single_c 0.0 1.0 /end CHARACTERISTIC
/begin CHARACTERISTIC KTQD_OvrSpdSetDownOffSet_kph "" VALUE 0x0000 /* @ECU_Address@KTQD_OvrSpdSetDownOffSet_kph@ */ Scalar_FLOAT32_IEEE 0 SWC_FDC_type_CM_single_kph -300.0 300.0 /end CHARACTERISTIC
/begin CHARACTERISTIC KTQD_RAfterTqCMDGainDec_c "" VALUE 0x0000 /* @ECU_Address@KTQD_RAfterTqCMDGainDec_c@ */ Scalar_FLOAT32_IEEE 0 SWC_FDC_type_CM_single_c -100.0 0.0 /end CHARACTERISTIC
/begin CHARACTERISTIC KTQD_RAfterTqCMDGainInc_c "" VALUE 0x0000 /* @ECU_Address@KTQD_RAfterTqCMDGainInc_c@ */ Scalar_FLOAT32_IEEE 0 SWC_FDC_type_CM_single_c 0.0 100.0 /end CHARACTERISTIC
/begin CHARACTERISTIC KTQD_RegBrkLPOff_c "" VALUE 0x0000 /* @ECU_Address@KTQD_RegBrkLPOff_c@ */ Scalar_FLOAT32_IEEE 0 SWC_FDC_type_CM_single_C -10.0 10.0 /end CHARACTERISTIC
/begin CHARACTERISTIC KTQD_RegBrkLPOn_c "" VALUE 0x0000 /* @ECU_Address@KTQD_RegBrkLPOn_c@ */ Scalar_FLOAT32_IEEE 0 SWC_FDC_type_CM_single_C -10.0 10.0 /end CHARACTERISTIC
/begin CHARACTERISTIC KTQD_RrBRgnCalLowLim_Nm "" VALUE 0x0000 /* @ECU_Address@KTQD_RrBRgnCalLowLim_Nm@ */ Scalar_FLOAT32_IEEE 0 SWC_FDC_type_CM_single_Nm -100000.0 100000.0 /end CHARACTERISTIC
/begin CHARACTERISTIC KTQD_RrBRgnCalUpLim_Nm "" VALUE 0x0000 /* @ECU_Address@KTQD_RrBRgnCalUpLim_Nm@ */ Scalar_FLOAT32_IEEE 0 SWC_FDC_type_CM_single_Nm -100000.0 100000.0 /end CHARACTERISTIC
/begin CHARACTERISTIC KTQD_RrBatapCont_factor "" VALUE 0x0000 /* @ECU_Address@KTQD_RrBatapCont_factor@ */ Scalar_FLOAT32_IEEE 0 SWC_FDC_type_CM_single_factor -100000.0 100000.0 /end CHARACTERISTIC
/begin CHARACTERISTIC KTQD_RrEDURollRgnLowTq_Nm "" VALUE 0x0000 /* @ECU_Address@KTQD_RrEDURollRgnLowTq_Nm@ */ Scalar_FLOAT32_IEEE 0 SWC_FDC_type_CM_single_Nm -100000.0 100000.0 /end CHARACTERISTIC
/begin CHARACTERISTIC KTQD_RrEDURollRgnUpTq_Nm "" VALUE 0x0000 /* @ECU_Address@KTQD_RrEDURollRgnUpTq_Nm@ */ Scalar_FLOAT32_IEEE 0 SWC_FDC_type_CM_single_Nm -100000.0 100000.0 /end CHARACTERISTIC
/begin CHARACTERISTIC KTQD_RrIdcMax_A "" VALUE 0x0000 /* @ECU_Address@KTQD_RrIdcMax_A@ */ Scalar_FLOAT32_IEEE 0 SWC_FDC_type_CM_single_A 0.0 1022.0 /end CHARACTERISTIC
/begin CHARACTERISTIC KTQD_RrIdcMin_A "" VALUE 0x0000 /* @ECU_Address@KTQD_RrIdcMin_A@ */ Scalar_FLOAT32_IEEE 0 SWC_FDC_type_CM_single_A -1022.0 0.0 /end CHARACTERISTIC
/begin CHARACTERISTIC KTQD_RrMotorRefPower_kW "" VALUE 0x0000 /* @ECU_Address@KTQD_RrMotorRefPower_kW@ */ Scalar_FLOAT32_IEEE 0 SWC_FDC_type_CM_single_kW 0.0 1000.0 /end CHARACTERISTIC
/begin CHARACTERISTIC KTQD_RrUdcMax_V "" VALUE 0x0000 /* @ECU_Address@KTQD_RrUdcMax_V@ */ Scalar_FLOAT32_IEEE 0 SWC_FDC_type_CM_single_V 0.0 1022.0 /end CHARACTERISTIC
/begin CHARACTERISTIC KTQD_RrUdcMin_V "" VALUE 0x0000 /* @ECU_Address@KTQD_RrUdcMin_V@ */ Scalar_FLOAT32_IEEE 0 SWC_FDC_type_CM_single_V 0.0 1022.0 /end CHARACTERISTIC
/begin CHARACTERISTIC KTQD_RrUppTheldTrq_Nm "" VALUE 0x0000 /* @ECU_Address@KTQD_RrUppTheldTrq_Nm@ */ Scalar_FLOAT32_IEEE 0 SWC_FDC_type_CM_single_Nm -100000.0 100000.0 /end CHARACTERISTIC
/begin CHARACTERISTIC KTQD_SimSoundWaveDec_pct "" VALUE 0x0000 /* @ECU_Address@KTQD_SimSoundWaveDec_pct@ */ Scalar_FLOAT32_IEEE 0 SWC_FDC_type_CM_single_pct -10000.0 0.0 /end CHARACTERISTIC
/begin CHARACTERISTIC KTQD_SimSoundWaveInc_pct "" VALUE 0x0000 /* @ECU_Address@KTQD_SimSoundWaveInc_pct@ */ Scalar_FLOAT32_IEEE 0 SWC_FDC_type_CM_single_pct 0.0 10000.0 /end CHARACTERISTIC
/begin CHARACTERISTIC KTQD_TCSCompUpLimit_Nm "" VALUE 0x0000 /* @ECU_Address@KTQD_TCSCompUpLimit_Nm@ */ Scalar_FLOAT32_IEEE 0 SWC_FDC_type_CM_single_Nm -100000.0 100000.0 /end CHARACTERISTIC
/begin CHARACTERISTIC KTQD_TMTqDeviationLow_c "" VALUE 0x0000 /* @ECU_Address@KTQD_TMTqDeviationLow_c@ */ Scalar_FLOAT32_IEEE 0 SWC_FDC_type_CM_single_c 0.0 1.2 /end CHARACTERISTIC
/begin CHARACTERISTIC KTQD_TMTqDeviationUp_c "" VALUE 0x0000 /* @ECU_Address@KTQD_TMTqDeviationUp_c@ */ Scalar_FLOAT32_IEEE 0 SWC_FDC_type_CM_single_c 0.0 1.2 /end CHARACTERISTIC
/begin CHARACTERISTIC KTQD_Veh2MetSpdHiBand_kph "" VALUE 0x0000 /* @ECU_Address@KTQD_Veh2MetSpdHiBand_kph@ */ Scalar_FLOAT32_IEEE 0 SWC_FDC_type_CM_single_kph 0.0 300.0 /end CHARACTERISTIC
/begin CHARACTERISTIC KTQD_Veh2MetSpdLowBand_kph "" VALUE 0x0000 /* @ECU_Address@KTQD_Veh2MetSpdLowBand_kph@ */ Scalar_FLOAT32_IEEE 0 SWC_FDC_type_CM_single_kph 0.0 300.0 /end CHARACTERISTIC
/begin CHARACTERISTIC KTQD_WhlEnDetStableSpd_kph "" VALUE 0x0000 /* @ECU_Address@KTQD_WhlEnDetStableSpd_kph@ */ Scalar_FLOAT32_IEEE 0 SWC_FDC_type_CM_single_kph -255.0 255.0 /end CHARACTERISTIC
/begin CHARACTERISTIC KTQD_WhlSpeedStableDev_kph "" VALUE 0x0000 /* @ECU_Address@KTQD_WhlSpeedStableDev_kph@ */ Scalar_FLOAT32_IEEE 0 SWC_FDC_type_CM_single_kph -255.0 255.0 /end CHARACTERISTIC
/begin CHARACTERISTIC KTQD_WhlStableDetTime_s "" VALUE 0x0000 /* @ECU_Address@KTQD_WhlStableDetTime_s@ */ Scalar_FLOAT32_IEEE 0 SWC_FDC_type_CM_single_s 0.0 3600.0 /end CHARACTERISTIC
/begin CHARACTERISTIC KTQR_ADASCancelBRgnSlopeF_Nmps "" VALUE 0x0000 /* @ECU_Address@KTQR_ADASCancelBRgnSlopeF_Nmps@ */ Scalar_FLOAT32_IEEE 0 SWC_FDC_type_CM_single_Nmps -100000.0 0.0 /end CHARACTERISTIC
/begin CHARACTERISTIC KTQR_ADASCancelBRgnSlopeR_Nmps "" VALUE 0x0000 /* @ECU_Address@KTQR_ADASCancelBRgnSlopeR_Nmps@ */ Scalar_FLOAT32_IEEE 0 SWC_FDC_type_CM_single_Nmps -100000.0 0.0 /end CHARACTERISTIC
/begin CHARACTERISTIC KTQR_FinalFEDUTrqLowLim_Nm "" VALUE 0x0000 /* @ECU_Address@KTQR_FinalFEDUTrqLowLim_Nm@ */ Scalar_FLOAT32_IEEE 0 SWC_FDC_type_CM_single_Nm -100000.0 0.0 /end CHARACTERISTIC
/begin CHARACTERISTIC KTQR_FinalFEDUTrqUpLim_Nm "" VALUE 0x0000 /* @ECU_Address@KTQR_FinalFEDUTrqUpLim_Nm@ */ Scalar_FLOAT32_IEEE 0 SWC_FDC_type_CM_single_Nm 0.0 100000.0 /end CHARACTERISTIC
/begin CHARACTERISTIC KTQR_FinalREDUTrqLowLim_Nm "" VALUE 0x0000 /* @ECU_Address@KTQR_FinalREDUTrqLowLim_Nm@ */ Scalar_FLOAT32_IEEE 0 SWC_FDC_type_CM_single_Nm -100000.0 0.0 /end CHARACTERISTIC
/begin CHARACTERISTIC KTQR_FinalREDUTrqUpLim_Nm "" VALUE 0x0000 /* @ECU_Address@KTQR_FinalREDUTrqUpLim_Nm@ */ Scalar_FLOAT32_IEEE 0 SWC_FDC_type_CM_single_Nm 0.0 100000.0 /end CHARACTERISTIC
/begin CHARACTERISTIC KTQR_FrTMGearEff_c "" VALUE 0x0000 /* @ECU_Address@KTQR_FrTMGearEff_c@ */ Scalar_FLOAT32_IEEE 0 SWC_FDC_type_CM_single_c 0.0 1.0 /end CHARACTERISTIC
/begin CHARACTERISTIC KTQR_GearEnChangeTq_Nm "" VALUE 0x0000 /* @ECU_Address@KTQR_GearEnChangeTq_Nm@ */ Scalar_FLOAT32_IEEE 0 SWC_FDC_type_CM_single_Nm -1.0 1000.0 /end CHARACTERISTIC
/begin CHARACTERISTIC KTQR_LaunchEnPedal_pct "" VALUE 0x0000 /* @ECU_Address@KTQR_LaunchEnPedal_pct@ */ Scalar_FLOAT32_IEEE 0 SWC_FDC_type_CM_single_pct 0.0 125.0 /end CHARACTERISTIC
/begin CHARACTERISTIC KTQR_LaunchEnSpd_kph "" VALUE 0x0000 /* @ECU_Address@KTQR_LaunchEnSpd_kph@ */ Scalar_FLOAT32_IEEE 0 SWC_FDC_type_CM_single_kph -10.0 125.0 /end CHARACTERISTIC
/begin CHARACTERISTIC KTQR_RrTMGearEff_c "" VALUE 0x0000 /* @ECU_Address@KTQR_RrTMGearEff_c@ */ Scalar_FLOAT32_IEEE 0 SWC_FDC_type_CM_single_c 0.0 1.0 /end CHARACTERISTIC
/begin CHARACTERISTIC KVMC_ACCOvrdPedalTqLinearLim_Nm "" VALUE 0x0000 /* @ECU_Address@KVMC_ACCOvrdPedalTqLinearLim_Nm@ */ Scalar_FLOAT32_IEEE 0 SWC_FDC_type_CM_single_Nm 0.0 3000.0 /end CHARACTERISTIC
/begin CHARACTERISTIC KVMC_ACCOvrdPedalTqRatio_Nm "" VALUE 0x0000 /* @ECU_Address@KVMC_ACCOvrdPedalTqRatio_Nm@ */ Scalar_FLOAT32_IEEE 0 SWC_FDC_type_CM_single_Nm 0.0 3000.0 /end CHARACTERISTIC
/begin CHARACTERISTIC KVMC_ACCPedalOvrdPosn4Hold_pct "" VALUE 0x0000 /* @ECU_Address@KVMC_ACCPedalOvrdPosn4Hold_pct@ */ Scalar_FLOAT32_IEEE 0 SWC_FDC_type_CM_single_pct 0.0 100.0 /end CHARACTERISTIC
/begin CHARACTERISTIC KVMC_ACCPedalOvrdPosn_pct "" VALUE 0x0000 /* @ECU_Address@KVMC_ACCPedalOvrdPosn_pct@ */ Scalar_FLOAT32_IEEE 0 SWC_FDC_type_CM_single_pct 0.0 100.0 /end CHARACTERISTIC
/begin CHARACTERISTIC KVMC_ACCPedalOvrdResPosn_pct "" VALUE 0x0000 /* @ECU_Address@KVMC_ACCPedalOvrdResPosn_pct@ */ Scalar_FLOAT32_IEEE 0 SWC_FDC_type_CM_single_pct 0.0 100.0 /end CHARACTERISTIC
/begin CHARACTERISTIC KVMC_ACCPedalOvrdRestTime_s "" VALUE 0x0000 /* @ECU_Address@KVMC_ACCPedalOvrdRestTime_s@ */ Scalar_FLOAT32_IEEE 0 SWC_FDC_type_CM_single_s 0.0 3600.0 /end CHARACTERISTIC
/begin CHARACTERISTIC KVMC_ACCReqCMdBond_mps2 "" VALUE 0x0000 /* @ECU_Address@KVMC_ACCReqCMdBond_mps2@ */ Scalar_FLOAT32_IEEE 0 SWC_FDC_type_CM_single_mps2 -20.0 20.0 /end CHARACTERISTIC
/begin CHARACTERISTIC KVMC_ACCResUpEnAccCMD_mps2 "" VALUE 0x0000 /* @ECU_Address@KVMC_ACCResUpEnAccCMD_mps2@ */ Scalar_FLOAT32_IEEE 0 SWC_FDC_type_CM_single_mps2 -10.0 10.0 /end CHARACTERISTIC
/begin CHARACTERISTIC KVMC_ACCResUpEnGrade_Deg "" VALUE 0x0000 /* @ECU_Address@KVMC_ACCResUpEnGrade_Deg@ */ Scalar_FLOAT32_IEEE 0 SWC_FDC_type_CM_single_Deg -90.0 90.0 /end CHARACTERISTIC
/begin CHARACTERISTIC KVMC_ACCSpdDevLowLim_kph "" VALUE 0x0000 /* @ECU_Address@KVMC_ACCSpdDevLowLim_kph@ */ Scalar_FLOAT32_IEEE 0 SWC_FDC_type_CM_single_kph -100.0 0.0 /end CHARACTERISTIC
/begin CHARACTERISTIC KVMC_ACCSpdDevUpLim_kph "" VALUE 0x0000 /* @ECU_Address@KVMC_ACCSpdDevUpLim_kph@ */ Scalar_FLOAT32_IEEE 0 SWC_FDC_type_CM_single_kph 0.0 100.0 /end CHARACTERISTIC
/begin CHARACTERISTIC KVMC_ACCTq2ZeroDisMCPress2_bar "" VALUE 0x0000 /* @ECU_Address@KVMC_ACCTq2ZeroDisMCPress2_bar@ */ Scalar_FLOAT32_IEEE 0 SWC_FDC_type_CM_single_bar 0.0 500.0 /end CHARACTERISTIC
/begin CHARACTERISTIC KVMC_ACCTq2ZeroDisMCPress_bar "" VALUE 0x0000 /* @ECU_Address@KVMC_ACCTq2ZeroDisMCPress_bar@ */ Scalar_FLOAT32_IEEE 0 SWC_FDC_type_CM_single_bar 0.0 500.0 /end CHARACTERISTIC
/begin CHARACTERISTIC KVMC_ACCTq2ZeroEnMCPress2_bar "" VALUE 0x0000 /* @ECU_Address@KVMC_ACCTq2ZeroEnMCPress2_bar@ */ Scalar_FLOAT32_IEEE 0 SWC_FDC_type_CM_single_bar 0.0 500.0 /end CHARACTERISTIC
/begin CHARACTERISTIC KVMC_ACCTq2ZeroEnMCPress_bar "" VALUE 0x0000 /* @ECU_Address@KVMC_ACCTq2ZeroEnMCPress_bar@ */ Scalar_FLOAT32_IEEE 0 SWC_FDC_type_CM_single_bar 0.0 500.0 /end CHARACTERISTIC
/begin CHARACTERISTIC KVMC_ADASWhlTqLimRat_rat "" VALUE 0x0000 /* @ECU_Address@KVMC_ADASWhlTqLimRat_rat@ */ Scalar_FLOAT32_IEEE 0 SWC_FDC_type_CM_single_rat 0.0 1.0 /end CHARACTERISTIC
/begin CHARACTERISTIC KVMC_ADASWhlTqLowerLim_Nm "" VALUE 0x0000 /* @ECU_Address@KVMC_ADASWhlTqLowerLim_Nm@ */ Scalar_FLOAT32_IEEE 0 SWC_FDC_type_CM_single_Nm -15000.0 15000.0 /end CHARACTERISTIC
/begin CHARACTERISTIC KVMC_ADASWhlTqUpperLim_Nm "" VALUE 0x0000 /* @ECU_Address@KVMC_ADASWhlTqUpperLim_Nm@ */ Scalar_FLOAT32_IEEE 0 SWC_FDC_type_CM_single_Nm -15000.0 15000.0 /end CHARACTERISTIC
/begin CHARACTERISTIC KVMC_ADSDecRspsRatio_rat "" VALUE 0x0000 /* @ECU_Address@KVMC_ADSDecRspsRatio_rat@ */ Scalar_FLOAT32_IEEE 0 SWC_FDC_type_CM_single_rat 0.1 1.0 /end CHARACTERISTIC
/begin CHARACTERISTIC KVMC_AGSVReqAccel_mps2 "" VALUE 0x0000 /* @ECU_Address@KVMC_AGSVReqAccel_mps2@ */ Scalar_FLOAT32_IEEE 0 SWC_FDC_type_CM_single_mps2 -10.0 10.0 /end CHARACTERISTIC
/begin CHARACTERISTIC KVMC_APSAllowSetACCMCP_bar "" VALUE 0x0000 /* @ECU_Address@KVMC_APSAllowSetACCMCP_bar@ */ Scalar_FLOAT32_IEEE 0 SWC_FDC_type_CM_single_bar 0.0 100.0 /end CHARACTERISTIC
/begin CHARACTERISTIC KVMC_APSAllowSetACCPosn_pct "" VALUE 0x0000 /* @ECU_Address@KVMC_APSAllowSetACCPosn_pct@ */ Scalar_FLOAT32_IEEE 0 SWC_FDC_type_CM_single_pct 0.0 100.0 /end CHARACTERISTIC
/begin CHARACTERISTIC KVMC_AccDevLowLim_mps2 "" VALUE 0x0000 /* @ECU_Address@KVMC_AccDevLowLim_mps2@ */ Scalar_FLOAT32_IEEE 0 SWC_FDC_type_CM_single_mps2 -20.0 0.0 /end CHARACTERISTIC
/begin CHARACTERISTIC KVMC_AccDevUpLim_mps2 "" VALUE 0x0000 /* @ECU_Address@KVMC_AccDevUpLim_mps2@ */ Scalar_FLOAT32_IEEE 0 SWC_FDC_type_CM_single_mps2 0.0 20.0 /end CHARACTERISTIC
/begin CHARACTERISTIC KVMC_AccelCtrlTqLowerLimit_Nm "" VALUE 0x0000 /* @ECU_Address@KVMC_AccelCtrlTqLowerLimit_Nm@ */ Scalar_FLOAT32_IEEE 0 SWC_FDC_type_CM_single_Nm -3000.0 3000.0 /end CHARACTERISTIC
/begin CHARACTERISTIC KVMC_AccelIGain_enum "" VALUE 0x0000 /* @ECU_Address@KVMC_AccelIGain_enum@ */ Scalar_FLOAT32_IEEE 0 SWC_FDC_type_CM_single_enum 0.0 1.0 /end CHARACTERISTIC
/begin CHARACTERISTIC KVMC_AllowSetSpdDist_m "" VALUE 0x0000 /* @ECU_Address@KVMC_AllowSetSpdDist_m@ */ Scalar_FLOAT32_IEEE 0 SWC_FDC_type_CM_single_m 0.0 50.0 /end CHARACTERISTIC
/begin CHARACTERISTIC KVMC_AltRDCActiveTq_Nm "" VALUE 0x0000 /* @ECU_Address@KVMC_AltRDCActiveTq_Nm@ */ Scalar_FLOAT32_IEEE 0 SWC_FDC_type_CM_single_Nm -100000.0 100000.0 /end CHARACTERISTIC
/begin CHARACTERISTIC KVMC_AltRDCRecTime_s "" VALUE 0x0000 /* @ECU_Address@KVMC_AltRDCRecTime_s@ */ Scalar_FLOAT32_IEEE 0 SWC_FDC_type_CM_single_s 0.0 7200.0 /end CHARACTERISTIC
/begin CHARACTERISTIC KVMC_AntiSpdLim_kph "" VALUE 0x0000 /* @ECU_Address@KVMC_AntiSpdLim_kph@ */ Scalar_FLOAT32_IEEE 0 SWC_FDC_type_CM_single_kph 0.0 100.0 /end CHARACTERISTIC
/begin CHARACTERISTIC KVMC_CAASCtrlAllowTime_s "" VALUE 0x0000 /* @ECU_Address@KVMC_CAASCtrlAllowTime_s@ */ Scalar_FLOAT32_IEEE 0 SWC_FDC_type_CM_single_s 0.0 3600.0 /end CHARACTERISTIC
/begin CHARACTERISTIC KVMC_CAASEnVehSpd_kph "" VALUE 0x0000 /* @ECU_Address@KVMC_CAASEnVehSpd_kph@ */ Scalar_FLOAT32_IEEE 0 SWC_FDC_type_CM_single_kph -10.0 300.0 /end CHARACTERISTIC
/begin CHARACTERISTIC KVMC_CCSpdDevLowLim_kph "" VALUE 0x0000 /* @ECU_Address@KVMC_CCSpdDevLowLim_kph@ */ Scalar_FLOAT32_IEEE 0 SWC_FDC_type_CM_single_kph -100.0 0.0 /end CHARACTERISTIC
/begin CHARACTERISTIC KVMC_CCSpdDevUpLim_kph "" VALUE 0x0000 /* @ECU_Address@KVMC_CCSpdDevUpLim_kph@ */ Scalar_FLOAT32_IEEE 0 SWC_FDC_type_CM_single_kph 0.0 100.0 /end CHARACTERISTIC
/begin CHARACTERISTIC KVMC_CCTqLowLim_Nm "" VALUE 0x0000 /* @ECU_Address@KVMC_CCTqLowLim_Nm@ */ Scalar_FLOAT32_IEEE 0 SWC_FDC_type_CM_single_Nm -15000.0 15000.0 /end CHARACTERISTIC
/begin CHARACTERISTIC KVMC_CCTqUpLim_Nm "" VALUE 0x0000 /* @ECU_Address@KVMC_CCTqUpLim_Nm@ */ Scalar_FLOAT32_IEEE 0 SWC_FDC_type_CM_single_Nm -15000.0 15000.0 /end CHARACTERISTIC
/begin CHARACTERISTIC KVMC_CallBrkJoinSpd_kph "" VALUE 0x0000 /* @ECU_Address@KVMC_CallBrkJoinSpd_kph@ */ Scalar_FLOAT32_IEEE 0 SWC_FDC_type_CM_single_kph 0.0 300.0 /end CHARACTERISTIC
/begin CHARACTERISTIC KVMC_CutOffNegTqSpd_kph "" VALUE 0x0000 /* @ECU_Address@KVMC_CutOffNegTqSpd_kph@ */ Scalar_FLOAT32_IEEE 0 SWC_FDC_type_CM_single_kph 0.0 20.0 /end CHARACTERISTIC
/begin CHARACTERISTIC KVMC_DISCAccCtrlLimit_mps2 "" VALUE 0x0000 /* @ECU_Address@KVMC_DISCAccCtrlLimit_mps2@ */ Scalar_FLOAT32_IEEE 0 SWC_FDC_type_CM_single_mps2 -10.0 10.0 /end CHARACTERISTIC
/begin CHARACTERISTIC KVMC_DISCDecCtrlJerk_mps3 "" VALUE 0x0000 /* @ECU_Address@KVMC_DISCDecCtrlJerk_mps3@ */ Scalar_FLOAT32_IEEE 0 SWC_FDC_type_CM_single_mps3 -10.0 10.0 /end CHARACTERISTIC
/begin CHARACTERISTIC KVMC_DISCDecCtrlLimit_mps2 "" VALUE 0x0000 /* @ECU_Address@KVMC_DISCDecCtrlLimit_mps2@ */ Scalar_FLOAT32_IEEE 0 SWC_FDC_type_CM_single_mps2 -10.0 10.0 /end CHARACTERISTIC
/begin CHARACTERISTIC KVMC_ESCLongGBWFilter_raw32 "" VALUE 0x0000 /* @ECU_Address@KVMC_ESCLongGBWFilter_raw32@ */ Scalar_FLOAT32_IEEE 0 SWC_FDC_type_CM_single_raw32 0.0 100.0 /end CHARACTERISTIC
/begin CHARACTERISTIC KVMC_ESCRegenTqRecDelay_s "" VALUE 0x0000 /* @ECU_Address@KVMC_ESCRegenTqRecDelay_s@ */ Scalar_FLOAT32_IEEE 0 SWC_FDC_type_CM_single_s 0.0 7200.0 /end CHARACTERISTIC
/begin CHARACTERISTIC KVMC_EstSlopeLongAccelTs_c "" VALUE 0x0000 /* @ECU_Address@KVMC_EstSlopeLongAccelTs_c@ */ Scalar_FLOAT32_IEEE 0 SWC_FDC_type_CM_single_c 0.0 3600.0 /end CHARACTERISTIC
/begin CHARACTERISTIC KVMC_EstSlopeTs_c "" VALUE 0x0000 /* @ECU_Address@KVMC_EstSlopeTs_c@ */ Scalar_FLOAT32_IEEE 0 SWC_FDC_type_CM_single_c 0.0 3600.0 /end CHARACTERISTIC
/begin CHARACTERISTIC KVMC_EstSlopeVehSpdTs_c "" VALUE 0x0000 /* @ECU_Address@KVMC_EstSlopeVehSpdTs_c@ */ Scalar_FLOAT32_IEEE 0 SWC_FDC_type_CM_single_c 0.0 3600.0 /end CHARACTERISTIC
/begin CHARACTERISTIC KVMC_ExternalDoorAllowTime_s "" VALUE 0x0000 /* @ECU_Address@KVMC_ExternalDoorAllowTime_s@ */ Scalar_FLOAT32_IEEE 0 SWC_FDC_type_CM_single_s 0.0 10.0 /end CHARACTERISTIC
/begin CHARACTERISTIC KVMC_ExternalShiftAllowTime_s "" VALUE 0x0000 /* @ECU_Address@KVMC_ExternalShiftAllowTime_s@ */ Scalar_FLOAT32_IEEE 0 SWC_FDC_type_CM_single_s 0.0 10.0 /end CHARACTERISTIC
/begin CHARACTERISTIC KVMC_ExternalTqAllowTime_s "" VALUE 0x0000 /* @ECU_Address@KVMC_ExternalTqAllowTime_s@ */ Scalar_FLOAT32_IEEE 0 SWC_FDC_type_CM_single_sec 0.0 10.0 /end CHARACTERISTIC
/begin CHARACTERISTIC KVMC_GravityValue_mps2 "" VALUE 0x0000 /* @ECU_Address@KVMC_GravityValue_mps2@ */ Scalar_FLOAT32_IEEE 0 SWC_FDC_type_CM_single_mps2 0.0 20.0 /end CHARACTERISTIC
/begin CHARACTERISTIC KVMC_HillUpResetTMSpd_rpm "" VALUE 0x0000 /* @ECU_Address@KVMC_HillUpResetTMSpd_rpm@ */ Scalar_FLOAT32_IEEE 0 SWC_FDC_type_CM_single_rpm -1000.0 1000.0 /end CHARACTERISTIC
/begin CHARACTERISTIC KVMC_HoldAllowZeroTqGrade_deg "" VALUE 0x0000 /* @ECU_Address@KVMC_HoldAllowZeroTqGrade_deg@ */ Scalar_FLOAT32_IEEE 0 SWC_FDC_type_CM_single_deg -45.0 45.0 /end CHARACTERISTIC
/begin CHARACTERISTIC KVMC_IMUGxFilter_raw32 "" VALUE 0x0000 /* @ECU_Address@KVMC_IMUGxFilter_raw32@ */ Scalar_FLOAT32_IEEE 0 SWC_FDC_type_CM_single_raw32 0.0 100.0 /end CHARACTERISTIC
/begin CHARACTERISTIC KVMC_IMUGyFilter_raw32 "" VALUE 0x0000 /* @ECU_Address@KVMC_IMUGyFilter_raw32@ */ Scalar_FLOAT32_IEEE 0 SWC_FDC_type_CM_single_raw32 0.0 100.0 /end CHARACTERISTIC
/begin CHARACTERISTIC KVMC_IMUGzFilter_raw32 "" VALUE 0x0000 /* @ECU_Address@KVMC_IMUGzFilter_raw32@ */ Scalar_FLOAT32_IEEE 0 SWC_FDC_type_CM_single_raw32 0.0 100.0 /end CHARACTERISTIC
/begin CHARACTERISTIC KVMC_IMURxFilter_raw32 "" VALUE 0x0000 /* @ECU_Address@KVMC_IMURxFilter_raw32@ */ Scalar_FLOAT32_IEEE 0 SWC_FDC_type_CM_single_raw32 0.0 100.0 /end CHARACTERISTIC
/begin CHARACTERISTIC KVMC_IMURyFilter_raw32 "" VALUE 0x0000 /* @ECU_Address@KVMC_IMURyFilter_raw32@ */ Scalar_FLOAT32_IEEE 0 SWC_FDC_type_CM_single_raw32 0.0 100.0 /end CHARACTERISTIC
/begin CHARACTERISTIC KVMC_IMURzFilter_raw32 "" VALUE 0x0000 /* @ECU_Address@KVMC_IMURzFilter_raw32@ */ Scalar_FLOAT32_IEEE 0 SWC_FDC_type_CM_single_raw32 0.0 100.0 /end CHARACTERISTIC
/begin CHARACTERISTIC KVMC_IParm_enum "" VALUE 0x0000 /* @ECU_Address@KVMC_IParm_enum@ */ Scalar_FLOAT32_IEEE 0 SWC_FDC_type_CM_single_enum 0.0 1.0 /end CHARACTERISTIC
/begin CHARACTERISTIC KVMC_MCPPassHoldDecTime_s "" VALUE 0x0000 /* @ECU_Address@KVMC_MCPPassHoldDecTime_s@ */ Scalar_FLOAT32_IEEE 0 SWC_FDC_type_CM_single_sec 0.0 10.0 /end CHARACTERISTIC
/begin CHARACTERISTIC KVMC_MSAEnCtrlTargetAcc_mps2 "" VALUE 0x0000 /* @ECU_Address@KVMC_MSAEnCtrlTargetAcc_mps2@ */ Scalar_FLOAT32_IEEE 0 SWC_FDC_type_CM_single_mps2 0.0 10.0 /end CHARACTERISTIC
/begin CHARACTERISTIC KVMC_MSAOvrdDetTime_s "" VALUE 0x0000 /* @ECU_Address@KVMC_MSAOvrdDetTime_s@ */ Scalar_FLOAT32_IEEE 0 SWC_FDC_type_CM_single_s 0.0 10.0 /end CHARACTERISTIC
/begin CHARACTERISTIC KVMC_MSAOvrdJudgeSpd_kph "" VALUE 0x0000 /* @ECU_Address@KVMC_MSAOvrdJudgeSpd_kph@ */ Scalar_FLOAT32_IEEE 0 SWC_FDC_type_CM_single_kph 0.0 250.0 /end CHARACTERISTIC
/begin CHARACTERISTIC KVMC_MSAOvrdResAPSPosn_pct "" VALUE 0x0000 /* @ECU_Address@KVMC_MSAOvrdResAPSPosn_pct@ */ Scalar_FLOAT32_IEEE 0 SWC_FDC_type_CM_single_pct 0.0 100.0 /end CHARACTERISTIC
/begin CHARACTERISTIC KVMC_MSAOvrdResumeTime_s "" VALUE 0x0000 /* @ECU_Address@KVMC_MSAOvrdResumeTime_s@ */ Scalar_FLOAT32_IEEE 0 SWC_FDC_type_CM_single_s 0.0 10.0 /end CHARACTERISTIC
/begin CHARACTERISTIC KVMC_MSAOvrdTqRampSlope_Nmps "" VALUE 0x0000 /* @ECU_Address@KVMC_MSAOvrdTqRampSlope_Nmps@ */ Scalar_FLOAT32_IEEE 0 SWC_FDC_type_CM_single_Nmps -3000.0 3000.0 /end CHARACTERISTIC
/begin CHARACTERISTIC KVMC_MSASpdDevLowLim_kph "" VALUE 0x0000 /* @ECU_Address@KVMC_MSASpdDevLowLim_kph@ */ Scalar_FLOAT32_IEEE 0 SWC_FDC_type_CM_single_kph -100.0 0.0 /end CHARACTERISTIC
/begin CHARACTERISTIC KVMC_MSASpdDevUpLim_kph "" VALUE 0x0000 /* @ECU_Address@KVMC_MSASpdDevUpLim_kph@ */ Scalar_FLOAT32_IEEE 0 SWC_FDC_type_CM_single_kph 0.0 100.0 /end CHARACTERISTIC
/begin CHARACTERISTIC KVMC_MSATqDownEndTqRatio_pct "" VALUE 0x0000 /* @ECU_Address@KVMC_MSATqDownEndTqRatio_pct@ */ Scalar_FLOAT32_IEEE 0 SWC_FDC_type_CM_single_pct 0.1 1.0 /end CHARACTERISTIC
/begin CHARACTERISTIC KVMC_MSATqLowLim_Nm "" VALUE 0x0000 /* @ECU_Address@KVMC_MSATqLowLim_Nm@ */ Scalar_FLOAT32_IEEE 0 SWC_FDC_type_CM_single_Nm -15000.0 15000.0 /end CHARACTERISTIC
/begin CHARACTERISTIC KVMC_MSATqUpLim_Nm "" VALUE 0x0000 /* @ECU_Address@KVMC_MSATqUpLim_Nm@ */ Scalar_FLOAT32_IEEE 0 SWC_FDC_type_CM_single_Nm -15000.0 15000.0 /end CHARACTERISTIC
/begin CHARACTERISTIC KVMC_MaxReqAccel_mps2 "" VALUE 0x0000 /* @ECU_Address@KVMC_MaxReqAccel_mps2@ */ Scalar_FLOAT32_IEEE 0 SWC_FDC_type_CM_single_mps2 -10.0 10.0 /end CHARACTERISTIC
/begin CHARACTERISTIC KVMC_MinReqAccel_mps2 "" VALUE 0x0000 /* @ECU_Address@KVMC_MinReqAccel_mps2@ */ Scalar_FLOAT32_IEEE 0 SWC_FDC_type_CM_single_mps2 -10.0 10.0 /end CHARACTERISTIC
/begin CHARACTERISTIC KVMC_NegReqEnSpd_kph "" VALUE 0x0000 /* @ECU_Address@KVMC_NegReqEnSpd_kph@ */ Scalar_FLOAT32_IEEE 0 SWC_FDC_type_CM_single_kph 0.0 100.0 /end CHARACTERISTIC
/begin CHARACTERISTIC KVMC_NegReqSwEnSlope_Deg "" VALUE 0x0000 /* @ECU_Address@KVMC_NegReqSwEnSlope_Deg@ */ Scalar_FLOAT32_IEEE 0 SWC_FDC_type_CM_single_Deg -90.0 90.0 /end CHARACTERISTIC
/begin CHARACTERISTIC KVMC_NegReqSwEnSpd_kph "" VALUE 0x0000 /* @ECU_Address@KVMC_NegReqSwEnSpd_kph@ */ Scalar_FLOAT32_IEEE 0 SWC_FDC_type_CM_single_kph 0.0 100.0 /end CHARACTERISTIC
/begin CHARACTERISTIC KVMC_NotAllowSetSpdDist_m "" VALUE 0x0000 /* @ECU_Address@KVMC_NotAllowSetSpdDist_m@ */ Scalar_FLOAT32_IEEE 0 SWC_FDC_type_CM_single_m 0.0 50.0 /end CHARACTERISTIC
/begin CHARACTERISTIC KVMC_OVRD2ActRgnTarget_Nm "" VALUE 0x0000 /* @ECU_Address@KVMC_OVRD2ActRgnTarget_Nm@ */ Scalar_FLOAT32_IEEE 0 SWC_FDC_type_CM_single_Nm -3000.0 3000.0 /end CHARACTERISTIC
/begin CHARACTERISTIC KVMC_OVRDResTqDec4Smooth_Nm "" VALUE 0x0000 /* @ECU_Address@KVMC_OVRDResTqDec4Smooth_Nm@ */ Scalar_FLOAT32_IEEE 0 SWC_FDC_type_CM_single_Nm -3000.0 3000.0 /end CHARACTERISTIC
/begin CHARACTERISTIC KVMC_PParm_enum "" VALUE 0x0000 /* @ECU_Address@KVMC_PParm_enum@ */ Scalar_FLOAT32_IEEE 0 SWC_FDC_type_CM_single_enum 0.0 1.0 /end CHARACTERISTIC
/begin CHARACTERISTIC KVMC_ReachSpeedCountTime_s "" VALUE 0x0000 /* @ECU_Address@KVMC_ReachSpeedCountTime_s@ */ Scalar_FLOAT32_IEEE 0 SWC_FDC_type_CM_single_s 0.0 10.0 /end CHARACTERISTIC
/begin CHARACTERISTIC KVMC_ReqAccelLowerLimit_mps2 "" VALUE 0x0000 /* @ECU_Address@KVMC_ReqAccelLowerLimit_mps2@ */ Scalar_FLOAT32_IEEE 0 SWC_FDC_type_CM_single_mps2 -10.0 10.0 /end CHARACTERISTIC
/begin CHARACTERISTIC KVMC_ReqBrkJoinWaitTime_s "" VALUE 0x0000 /* @ECU_Address@KVMC_ReqBrkJoinWaitTime_s@ */ Scalar_FLOAT32_IEEE 0 SWC_FDC_type_CM_single_s 0.0 10.0 /end CHARACTERISTIC
/begin CHARACTERISTIC KVMC_ReqDecelLowerLimit_mps2 "" VALUE 0x0000 /* @ECU_Address@KVMC_ReqDecelLowerLimit_mps2@ */ Scalar_FLOAT32_IEEE 0 SWC_FDC_type_CM_single_mps2 -10.0 10.0 /end CHARACTERISTIC
/begin CHARACTERISTIC KVMC_SmartEcoLimitSpd_kph "" VALUE 0x0000 /* @ECU_Address@KVMC_SmartEcoLimitSpd_kph@ */ Scalar_FLOAT32_IEEE 0 SWC_FDC_type_CM_single_kph -300.0 300.0 /end CHARACTERISTIC
/begin CHARACTERISTIC KVMC_SpdCtrlDisBand_kph "" VALUE 0x0000 /* @ECU_Address@KVMC_SpdCtrlDisBand_kph@ */ Scalar_FLOAT32_IEEE 0 SWC_FDC_type_CM_single_kph -10.0 10.0 /end CHARACTERISTIC
/begin CHARACTERISTIC KVMC_SpdCtrlEnBand_kph "" VALUE 0x0000 /* @ECU_Address@KVMC_SpdCtrlEnBand_kph@ */ Scalar_FLOAT32_IEEE 0 SWC_FDC_type_CM_single_kph -10.0 10.0 /end CHARACTERISTIC
/begin CHARACTERISTIC KVMC_SpdCtrlReqAccel_mps2 "" VALUE 0x0000 /* @ECU_Address@KVMC_SpdCtrlReqAccel_mps2@ */ Scalar_FLOAT32_IEEE 0 SWC_FDC_type_CM_single_mps2 -1.0 1.0 /end CHARACTERISTIC
/begin CHARACTERISTIC KVMC_StandstillTqRamp2ZeroSlope_Nmps "" VALUE 0x0000 /* @ECU_Address@KVMC_StandstillTqRamp2ZeroSlope_Nmps@ */ Scalar_FLOAT32_IEEE 0 SWC_FDC_type_CM_single_Nmps -3000.0 3000.0 /end CHARACTERISTIC
/begin CHARACTERISTIC KVMC_TimeGapBandLv1_s "" VALUE 0x0000 /* @ECU_Address@KVMC_TimeGapBandLv1_s@ */ Scalar_FLOAT32_IEEE 0 SWC_FDC_type_CM_single_s 0.0 25.5 /end CHARACTERISTIC
/begin CHARACTERISTIC KVMC_TimeGapBandLv2_s "" VALUE 0x0000 /* @ECU_Address@KVMC_TimeGapBandLv2_s@ */ Scalar_FLOAT32_IEEE 0 SWC_FDC_type_CM_single_s 0.0 25.5 /end CHARACTERISTIC
/begin CHARACTERISTIC KVMC_TimeGapBandLv3_s "" VALUE 0x0000 /* @ECU_Address@KVMC_TimeGapBandLv3_s@ */ Scalar_FLOAT32_IEEE 0 SWC_FDC_type_CM_single_s 0.0 25.5 /end CHARACTERISTIC
/begin CHARACTERISTIC KVMC_TimeGapBandLv4_s "" VALUE 0x0000 /* @ECU_Address@KVMC_TimeGapBandLv4_s@ */ Scalar_FLOAT32_IEEE 0 SWC_FDC_type_CM_single_s 0.0 25.5 /end CHARACTERISTIC
/begin CHARACTERISTIC KVMC_TimeGapMax_s "" VALUE 0x0000 /* @ECU_Address@KVMC_TimeGapMax_s@ */ Scalar_FLOAT32_IEEE 0 SWC_FDC_type_CM_single_s 0.0 25.5 /end CHARACTERISTIC
/begin CHARACTERISTIC KVMC_TqAccelCtrlBand_mps2 "" VALUE 0x0000 /* @ECU_Address@KVMC_TqAccelCtrlBand_mps2@ */ Scalar_FLOAT32_IEEE 0 SWC_FDC_type_CM_single_mps2 -10.0 10.0 /end CHARACTERISTIC
/begin CHARACTERISTIC KVMC_TqMCPRelFactorHold_Nm "" VALUE 0x0000 /* @ECU_Address@KVMC_TqMCPRelFactorHold_Nm@ */ Scalar_FLOAT32_IEEE 0 SWC_FDC_type_CM_single_Nm -3000.0 3000.0 /end CHARACTERISTIC
/begin CHARACTERISTIC KVMC_TqMCPRelFactor_Nm "" VALUE 0x0000 /* @ECU_Address@KVMC_TqMCPRelFactor_Nm@ */ Scalar_FLOAT32_IEEE 0 SWC_FDC_type_CM_single_Nm -3000.0 3000.0 /end CHARACTERISTIC
/begin CHARACTERISTIC KVMC_VehHoldCal1BigDeltaAcc_mps2 "" VALUE 0x0000 /* @ECU_Address@KVMC_VehHoldCal1BigDeltaAcc_mps2@ */ Scalar_FLOAT32_IEEE 0 SWC_FDC_type_CM_single_mps2 -15.0 10.55 /end CHARACTERISTIC
/begin CHARACTERISTIC KVMC_VehHoldDecCtrlBSlope4ATH_mps3 "" VALUE 0x0000 /* @ECU_Address@KVMC_VehHoldDecCtrlBSlope4ATH_mps3@ */ Scalar_FLOAT32_IEEE 0 SWC_FDC_type_CM_single_mps3 -5.0 0.0 /end CHARACTERISTIC
/begin CHARACTERISTIC KVMC_VehHoldDecCtrlBSlopeCal1_mps3 "" VALUE 0x0000 /* @ECU_Address@KVMC_VehHoldDecCtrlBSlopeCal1_mps3@ */ Scalar_FLOAT32_IEEE 0 SWC_FDC_type_CM_single_mps3 0.0 5.0 /end CHARACTERISTIC
/begin CHARACTERISTIC KVMC_VehHoldDecCtrlBSlope_mps3 "" VALUE 0x0000 /* @ECU_Address@KVMC_VehHoldDecCtrlBSlope_mps3@ */ Scalar_FLOAT32_IEEE 0 SWC_FDC_type_CM_single_mps3 -5.0 0.0 /end CHARACTERISTIC
/begin CHARACTERISTIC KVMC_VehHoldDecCtrlMaxDec_mps2 "" VALUE 0x0000 /* @ECU_Address@KVMC_VehHoldDecCtrlMaxDec_mps2@ */ Scalar_FLOAT32_IEEE 0 SWC_FDC_type_CM_single_mps2 -15.0 10.55 /end CHARACTERISTIC
/begin CHARACTERISTIC KVMC_VehHoldDecSR_Nm "" VALUE 0x0000 /* @ECU_Address@KVMC_VehHoldDecSR_Nm@ */ Scalar_FLOAT32_IEEE 0 SWC_FDC_type_CM_single_Nm -1000.0 1000.0 /end CHARACTERISTIC
/begin CHARACTERISTIC KVMC_VehHoldDelayMCP_bar "" VALUE 0x0000 /* @ECU_Address@KVMC_VehHoldDelayMCP_bar@ */ Scalar_FLOAT32_IEEE 0 SWC_FDC_type_CM_single_bar -1.0 50.0 /end CHARACTERISTIC
/begin CHARACTERISTIC KVMC_VehHoldDeltaAccDB_mps2 "" VALUE 0x0000 /* @ECU_Address@KVMC_VehHoldDeltaAccDB_mps2@ */ Scalar_FLOAT32_IEEE 0 SWC_FDC_type_CM_single_mps2 -15.0 10.55 /end CHARACTERISTIC
/begin CHARACTERISTIC KVMC_VehHoldDist_m "" VALUE 0x0000 /* @ECU_Address@KVMC_VehHoldDist_m@ */ Scalar_FLOAT32_IEEE 0 SWC_FDC_type_CM_single_m 1.0 10.0 /end CHARACTERISTIC
/begin CHARACTERISTIC KVMC_VehHoldHTimeNoMCPCnt_s "" VALUE 0x0000 /* @ECU_Address@KVMC_VehHoldHTimeNoMCPCnt_s@ */ Scalar_FLOAT32_IEEE 0 SWC_FDC_type_CM_single_s 0.0 10.0 /end CHARACTERISTIC
/begin CHARACTERISTIC KVMC_VehHoldHTimeNoMCP_bar "" VALUE 0x0000 /* @ECU_Address@KVMC_VehHoldHTimeNoMCP_bar@ */ Scalar_FLOAT32_IEEE 0 SWC_FDC_type_CM_single_bar -1.0 50.0 /end CHARACTERISTIC
/begin CHARACTERISTIC KVMC_VehHoldHoldDecTime_s "" VALUE 0x0000 /* @ECU_Address@KVMC_VehHoldHoldDecTime_s@ */ Scalar_FLOAT32_IEEE 0 SWC_FDC_type_CM_single_sec 0.0 10.0 /end CHARACTERISTIC
/begin CHARACTERISTIC KVMC_VehHoldTqIncMCP_bar "" VALUE 0x0000 /* @ECU_Address@KVMC_VehHoldTqIncMCP_bar@ */ Scalar_FLOAT32_IEEE 0 SWC_FDC_type_CM_single_bar -1.0 50.0 /end CHARACTERISTIC
/begin CHARACTERISTIC KVMC_VehHoldTqIncMinTq_Nm "" VALUE 0x0000 /* @ECU_Address@KVMC_VehHoldTqIncMinTq_Nm@ */ Scalar_FLOAT32_IEEE 0 SWC_FDC_type_CM_single_Nm -1000.0 1000.0 /end CHARACTERISTIC
/begin CHARACTERISTIC KVMC_ZeroRgnTqSpdCtrlTime_s "" VALUE 0x0000 /* @ECU_Address@KVMC_ZeroRgnTqSpdCtrlTime_s@ */ Scalar_FLOAT32_IEEE 0 SWC_FDC_type_CM_single_s 0.01 10.0 /end CHARACTERISTIC
/begin CHARACTERISTIC KVMC_ZeroRgnTqSpd_kph "" VALUE 0x0000 /* @ECU_Address@KVMC_ZeroRgnTqSpd_kph@ */ Scalar_FLOAT32_IEEE 0 SWC_FDC_type_CM_single_kph 0.0 10.0 /end CHARACTERISTIC
/begin CHARACTERISTIC KTHC_EXVBlancePulse_K "" VALUE 0x0000 /* @ECU_Address@KTHC_EXVBlancePulse_K@ */ Scalar_UWORD 0 SWC_FDC_type_CM_uint16_K 0.0 1000.0 /end CHARACTERISTIC
/begin CHARACTERISTIC KTHC_PBlaceTime1_K "" VALUE 0x0000 /* @ECU_Address@KTHC_PBlaceTime1_K@ */ Scalar_UWORD 0 SWC_FDC_type_CM_uint16_K 0.0 200.0 /end CHARACTERISTIC
/begin CHARACTERISTIC KTHC_PBlaceTime2_K "" VALUE 0x0000 /* @ECU_Address@KTHC_PBlaceTime2_K@ */ Scalar_UWORD 0 SWC_FDC_type_CM_uint16_K 0.0 200.0 /end CHARACTERISTIC
/begin CHARACTERISTIC KTHC_PBlaceTime3_K "" VALUE 0x0000 /* @ECU_Address@KTHC_PBlaceTime3_K@ */ Scalar_UWORD 0 SWC_FDC_type_CM_uint16_K 0.0 200.0 /end CHARACTERISTIC
/begin CHARACTERISTIC KTHC_PBlaceTime4_K "" VALUE 0x0000 /* @ECU_Address@KTHC_PBlaceTime4_K@ */ Scalar_UWORD 0 SWC_FDC_type_CM_uint16_K 0.0 200.0 /end CHARACTERISTIC
/begin CHARACTERISTIC KVMC_AccFSCalSet_enum "" VALUE 0x0000 /* @ECU_Address@KVMC_AccFSCalSet_enum@ */ Scalar_UWORD 0 SWC_FDC_type_CM_uint16_enum 0.0 2000.0 /end CHARACTERISTIC
/begin CHARACTERISTIC KVMC_AccFSSlect_enum "" VALUE 0x0000 /* @ECU_Address@KVMC_AccFSSlect_enum@ */ Scalar_UWORD 0 SWC_FDC_type_CM_uint16_enum 0.0 2000.0 /end CHARACTERISTIC
/begin CHARACTERISTIC KVMC_GyroFSCalSet_enum "" VALUE 0x0000 /* @ECU_Address@KVMC_GyroFSCalSet_enum@ */ Scalar_UWORD 0 SWC_FDC_type_CM_uint16_enum 0.0 50.0 /end CHARACTERISTIC
/begin CHARACTERISTIC KVMC_GyroFSSlect_enum "" VALUE 0x0000 /* @ECU_Address@KVMC_GyroFSSlect_enum@ */ Scalar_UWORD 0 SWC_FDC_type_CM_uint16_enum 0.0 50.0 /end CHARACTERISTIC
/begin CHARACTERISTIC KTHC_TevaErrHandleEN_flg "" VALUE 0x0000 /* @ECU_Address@KTHC_TevaErrHandleEN_flg@ */ Scalar_BOOLEAN 0 SWC_FDC_type_CM_boolean_flg 0.0 1.0 /end CHARACTERISTIC
/begin CHARACTERISTIC KTQD_AWDWhlTqRatioSW_flg "" VALUE 0x0000 /* @ECU_Address@KTQD_AWDWhlTqRatioSW_flg@ */ Scalar_BOOLEAN 0 SWC_FDC_type_CM_boolean_flg 0.0 1.0 /end CHARACTERISTIC
/begin CHARACTERISTIC KTQD_ActWhlSkipSta_enum_ovrdflg "" VALUE 0x0000 /* @ECU_Address@KTQD_ActWhlSkipSta_enum_ovrdflg@ */ Scalar_BOOLEAN 0 SWC_FDC_type_CM_boolean_flg 0.0 1.0 /end CHARACTERISTIC
/begin CHARACTERISTIC KTQD_DecideEDUActTqSW_flg "" VALUE 0x0000 /* @ECU_Address@KTQD_DecideEDUActTqSW_flg@ */ Scalar_BOOLEAN 0 SWC_FDC_type_CM_boolean_flg 0.0 1.0 /end CHARACTERISTIC
/begin CHARACTERISTIC KTQD_ExtDoorAllow_flg_ovrdflg "" VALUE 0x0000 /* @ECU_Address@KTQD_ExtDoorAllow_flg_ovrdflg@ */ Scalar_BOOLEAN 0 SWC_FDC_type_CM_boolean_flg 0.0 1.0 /end CHARACTERISTIC
/begin CHARACTERISTIC KTQD_ExtDoorAllow_flg_ovrdval "" VALUE 0x0000 /* @ECU_Address@KTQD_ExtDoorAllow_flg_ovrdval@ */ Scalar_BOOLEAN 0 SWC_FDC_type_CM_boolean_flg 0.0 1.0 /end CHARACTERISTIC
/begin CHARACTERISTIC KTQD_ExtShftAllow_flg_ovrdflg "" VALUE 0x0000 /* @ECU_Address@KTQD_ExtShftAllow_flg_ovrdflg@ */ Scalar_BOOLEAN 0 SWC_FDC_type_CM_boolean_flg 0.0 1.0 /end CHARACTERISTIC
/begin CHARACTERISTIC KTQD_ExtShftAllow_flg_ovrdval "" VALUE 0x0000 /* @ECU_Address@KTQD_ExtShftAllow_flg_ovrdval@ */ Scalar_BOOLEAN 0 SWC_FDC_type_CM_boolean_flg 0.0 1.0 /end CHARACTERISTIC
/begin CHARACTERISTIC KTQD_ExtTqAllow_flg_ovrdflg "" VALUE 0x0000 /* @ECU_Address@KTQD_ExtTqAllow_flg_ovrdflg@ */ Scalar_BOOLEAN 0 SWC_FDC_type_CM_boolean_flg 0.0 1.0 /end CHARACTERISTIC
/begin CHARACTERISTIC KTQD_ExtTqAllow_flg_ovrdval "" VALUE 0x0000 /* @ECU_Address@KTQD_ExtTqAllow_flg_ovrdval@ */ Scalar_BOOLEAN 0 SWC_FDC_type_CM_boolean_flg 0.0 1.0 /end CHARACTERISTIC
/begin CHARACTERISTIC KTQD_FrAvailBRgnTqV_flg_ovrdflg "" VALUE 0x0000 /* @ECU_Address@KTQD_FrAvailBRgnTqV_flg_ovrdflg@ */ Scalar_BOOLEAN 0 SWC_FDC_type_CM_boolean_flg 0.0 1.0 /end CHARACTERISTIC
/begin CHARACTERISTIC KTQD_FrAvailBRgnTqV_flg_ovrdval "" VALUE 0x0000 /* @ECU_Address@KTQD_FrAvailBRgnTqV_flg_ovrdval@ */ Scalar_BOOLEAN 0 SWC_FDC_type_CM_boolean_flg 0.0 1.0 /end CHARACTERISTIC
/begin CHARACTERISTIC KTQD_FrTCSCompensateSW_flg "" VALUE 0x0000 /* @ECU_Address@KTQD_FrTCSCompensateSW_flg@ */ Scalar_BOOLEAN 0 SWC_FDC_type_CM_boolean_flg 0.0 1.0 /end CHARACTERISTIC
/begin CHARACTERISTIC KTQD_OPDHoldAllowGearPSW_flg "" VALUE 0x0000 /* @ECU_Address@KTQD_OPDHoldAllowGearPSW_flg@ */ Scalar_BOOLEAN 0 SWC_FDC_type_CM_boolean_flg 0.0 1.0 /end CHARACTERISTIC
/begin CHARACTERISTIC KTQD_PTCSPermSta_flg "" VALUE 0x0000 /* @ECU_Address@KTQD_PTCSPermSta_flg@ */ Scalar_BOOLEAN 0 SWC_FDC_type_CM_boolean_flg 0.0 1.0 /end CHARACTERISTIC
/begin CHARACTERISTIC KTQD_RrAvailBRgnTqV_flg_ovrdflg "" VALUE 0x0000 /* @ECU_Address@KTQD_RrAvailBRgnTqV_flg_ovrdflg@ */ Scalar_BOOLEAN 0 SWC_FDC_type_CM_boolean_flg 0.0 1.0 /end CHARACTERISTIC
/begin CHARACTERISTIC KTQD_RrAvailBRgnTqV_flg_ovrdval "" VALUE 0x0000 /* @ECU_Address@KTQD_RrAvailBRgnTqV_flg_ovrdval@ */ Scalar_BOOLEAN 0 SWC_FDC_type_CM_boolean_flg 0.0 1.0 /end CHARACTERISTIC
/begin CHARACTERISTIC KTQD_RrTCSCompensateSW_flg "" VALUE 0x0000 /* @ECU_Address@KTQD_RrTCSCompensateSW_flg@ */ Scalar_BOOLEAN 0 SWC_FDC_type_CM_boolean_flg 0.0 1.0 /end CHARACTERISTIC
/begin CHARACTERISTIC KTQD_SpdCtrlMode_enum_ovrdflg "" VALUE 0x0000 /* @ECU_Address@KTQD_SpdCtrlMode_enum_ovrdflg@ */ Scalar_BOOLEAN 0 SWC_FDC_type_CM_boolean_flg 0.0 1.0 /end CHARACTERISTIC
/begin CHARACTERISTIC KTQR_ACCCancelNoRBC_flg "" VALUE 0x0000 /* @ECU_Address@KTQR_ACCCancelNoRBC_flg@ */ Scalar_BOOLEAN 0 SWC_FDC_type_CM_boolean_flg 0.0 1.0 /end CHARACTERISTIC
/begin CHARACTERISTIC KTQR_ADASCancelBRgnSlopeSW_flg "" VALUE 0x0000 /* @ECU_Address@KTQR_ADASCancelBRgnSlopeSW_flg@ */ Scalar_BOOLEAN 0 SWC_FDC_type_CM_boolean_flg 0.0 1.0 /end CHARACTERISTIC
/begin CHARACTERISTIC KTQR_FrAbsoluteMTTqDir_flg "" VALUE 0x0000 /* @ECU_Address@KTQR_FrAbsoluteMTTqDir_flg@ */ Scalar_BOOLEAN 0 SWC_FDC_type_CM_boolean_flg 0.0 1.0 /end CHARACTERISTIC
/begin CHARACTERISTIC KTQR_GearChangeTqDSW_flg "" VALUE 0x0000 /* @ECU_Address@KTQR_GearChangeTqDSW_flg@ */ Scalar_BOOLEAN 0 SWC_FDC_type_CM_boolean_flg 0.0 1.0 /end CHARACTERISTIC
/begin CHARACTERISTIC KTQR_GearChangeTqSW_flg "" VALUE 0x0000 /* @ECU_Address@KTQR_GearChangeTqSW_flg@ */ Scalar_BOOLEAN 0 SWC_FDC_type_CM_boolean_flg 0.0 1.0 /end CHARACTERISTIC
/begin CHARACTERISTIC KTQR_NewRampArchSW_flg "" VALUE 0x0000 /* @ECU_Address@KTQR_NewRampArchSW_flg@ */ Scalar_BOOLEAN 0 SWC_FDC_type_CM_boolean_flg 0.0 1.0 /end CHARACTERISTIC
/begin CHARACTERISTIC KTQR_RrAbsoluteMTTqDir_flg "" VALUE 0x0000 /* @ECU_Address@KTQR_RrAbsoluteMTTqDir_flg@ */ Scalar_BOOLEAN 0 SWC_FDC_type_CM_boolean_flg 0.0 1.0 /end CHARACTERISTIC
/begin CHARACTERISTIC KTQR_TCSActTQRLimSW_flg "" VALUE 0x0000 /* @ECU_Address@KTQR_TCSActTQRLimSW_flg@ */ Scalar_BOOLEAN 0 SWC_FDC_type_CM_boolean_flg 0.0 1.0 /end CHARACTERISTIC
/begin CHARACTERISTIC KVMC_ACCOvrdTestSW_flg "" VALUE 0x0000 /* @ECU_Address@KVMC_ACCOvrdTestSW_flg@ */ Scalar_BOOLEAN 0 SWC_FDC_type_CM_boolean_flg 0.0 1.0 /end CHARACTERISTIC
/begin CHARACTERISTIC KVMC_ACCSpdCtrlSW_flg "" VALUE 0x0000 /* @ECU_Address@KVMC_ACCSpdCtrlSW_flg@ */ Scalar_BOOLEAN 0 SWC_FDC_type_CM_boolean_flg 0.0 1.0 /end CHARACTERISTIC
/begin CHARACTERISTIC KVMC_ADSDecAlwaysShift_flg "" VALUE 0x0000 /* @ECU_Address@KVMC_ADSDecAlwaysShift_flg@ */ Scalar_BOOLEAN 0 SWC_FDC_type_CM_boolean_flg 0.0 1.0 /end CHARACTERISTIC
/begin CHARACTERISTIC KVMC_ADSDecShiftSW_flg "" VALUE 0x0000 /* @ECU_Address@KVMC_ADSDecShiftSW_flg@ */ Scalar_BOOLEAN 0 SWC_FDC_type_CM_boolean_flg 0.0 1.0 /end CHARACTERISTIC
/begin CHARACTERISTIC KVMC_AddBRegen2ACCLoop_flg "" VALUE 0x0000 /* @ECU_Address@KVMC_AddBRegen2ACCLoop_flg@ */ Scalar_BOOLEAN 0 SWC_FDC_type_CM_boolean_flg 0.0 1.0 /end CHARACTERISTIC
/begin CHARACTERISTIC KVMC_AllowSetSpdOvrdVal_flg "" VALUE 0x0000 /* @ECU_Address@KVMC_AllowSetSpdOvrdVal_flg@ */ Scalar_BOOLEAN 0 SWC_FDC_type_CM_boolean_flg 0.0 1.0 /end CHARACTERISTIC
/begin CHARACTERISTIC KVMC_AllowSetSpdOvrd_flg "" VALUE 0x0000 /* @ECU_Address@KVMC_AllowSetSpdOvrd_flg@ */ Scalar_BOOLEAN 0 SWC_FDC_type_CM_boolean_flg 0.0 1.0 /end CHARACTERISTIC
/begin CHARACTERISTIC KVMC_AltRDCActiveSW_flg "" VALUE 0x0000 /* @ECU_Address@KVMC_AltRDCActiveSW_flg@ */ Scalar_BOOLEAN 0 SWC_FDC_type_CM_boolean_flg 0.0 1.0 /end CHARACTERISTIC
/begin CHARACTERISTIC KVMC_AntiSpdLimSW_flg "" VALUE 0x0000 /* @ECU_Address@KVMC_AntiSpdLimSW_flg@ */ Scalar_BOOLEAN 0 SWC_FDC_type_CM_boolean_flg 0.0 1.0 /end CHARACTERISTIC
/begin CHARACTERISTIC KVMC_CAASVMCReqA_flg_ovrdflg "" VALUE 0x0000 /* @ECU_Address@KVMC_CAASVMCReqA_flg_ovrdflg@ */ Scalar_BOOLEAN 0 SWC_FDC_type_CM_boolean_flg 0.0 1.0 /end CHARACTERISTIC
/begin CHARACTERISTIC KVMC_CAASVMCReqA_flg_ovrdval "" VALUE 0x0000 /* @ECU_Address@KVMC_CAASVMCReqA_flg_ovrdval@ */ Scalar_BOOLEAN 0 SWC_FDC_type_CM_boolean_flg 0.0 1.0 /end CHARACTERISTIC
/begin CHARACTERISTIC KVMC_CCDISCPGainSW_flg "" VALUE 0x0000 /* @ECU_Address@KVMC_CCDISCPGainSW_flg@ */ Scalar_BOOLEAN 0 SWC_FDC_type_CM_boolean_flg 0.0 1.0 /end CHARACTERISTIC
/begin CHARACTERISTIC KVMC_DISCDecNoBrk_flg "" VALUE 0x0000 /* @ECU_Address@KVMC_DISCDecNoBrk_flg@ */ Scalar_BOOLEAN 0 SWC_FDC_type_CM_boolean_flg 0.0 1.0 /end CHARACTERISTIC
/begin CHARACTERISTIC KVMC_EstSlopeSW_flg "" VALUE 0x0000 /* @ECU_Address@KVMC_EstSlopeSW_flg@ */ Scalar_BOOLEAN 0 SWC_FDC_type_CM_boolean_flg 0.0 1.0 /end CHARACTERISTIC
/begin CHARACTERISTIC KVMC_MSAPGainSW_flg "" VALUE 0x0000 /* @ECU_Address@KVMC_MSAPGainSW_flg@ */ Scalar_BOOLEAN 0 SWC_FDC_type_CM_boolean_flg 0.0 1.0 /end CHARACTERISTIC
/begin CHARACTERISTIC KVMC_OVRD2ActRampSW_flg "" VALUE 0x0000 /* @ECU_Address@KVMC_OVRD2ActRampSW_flg@ */ Scalar_BOOLEAN 0 SWC_FDC_type_CM_boolean_flg 0.0 1.0 /end CHARACTERISTIC
/begin CHARACTERISTIC KVMC_OVRDResSmoothTest_SW "" VALUE 0x0000 /* @ECU_Address@KVMC_OVRDResSmoothTest_SW@ */ Scalar_BOOLEAN 0 SWC_FDC_type_CM_boolean_flg 0.0 1.0 /end CHARACTERISTIC
/begin CHARACTERISTIC KVMC_ReachSpeedCount_flg "" VALUE 0x0000 /* @ECU_Address@KVMC_ReachSpeedCount_flg@ */ Scalar_BOOLEAN 0 SWC_FDC_type_CM_boolean_flg 0.0 1.0 /end CHARACTERISTIC
/begin CHARACTERISTIC KVMC_ReqAccelLimitSW_flg "" VALUE 0x0000 /* @ECU_Address@KVMC_ReqAccelLimitSW_flg@ */ Scalar_BOOLEAN 0 SWC_FDC_type_CM_boolean_flg 0.0 1.0 /end CHARACTERISTIC
/begin CHARACTERISTIC KVMC_ReqBrkInDecSW_flg "" VALUE 0x0000 /* @ECU_Address@KVMC_ReqBrkInDecSW_flg@ */ Scalar_BOOLEAN 0 SWC_FDC_type_CM_boolean_flg 0.0 1.0 /end CHARACTERISTIC
/begin CHARACTERISTIC KVMC_SPD2ACCLastAccelSourceSW_flg "" VALUE 0x0000 /* @ECU_Address@KVMC_SPD2ACCLastAccelSourceSW_flg@ */ Scalar_BOOLEAN 0 SWC_FDC_type_CM_boolean_flg 0.0 1.0 /end CHARACTERISTIC
/begin CHARACTERISTIC KVMC_SmartEcoPlusSW_flg "" VALUE 0x0000 /* @ECU_Address@KVMC_SmartEcoPlusSW_flg@ */ Scalar_BOOLEAN 0 SWC_FDC_type_CM_boolean_flg 0.0 1.0 /end CHARACTERISTIC
/begin CHARACTERISTIC KVMC_SprtAccelCMDSW_flg "" VALUE 0x0000 /* @ECU_Address@KVMC_SprtAccelCMDSW_flg@ */ Scalar_BOOLEAN 0 SWC_FDC_type_CM_boolean_flg 0.0 1.0 /end CHARACTERISTIC
/begin CHARACTERISTIC KVMC_TqSafetyCtrl_flg "" VALUE 0x0000 /* @ECU_Address@KVMC_TqSafetyCtrl_flg@ */ Scalar_BOOLEAN 0 SWC_FDC_type_CM_boolean_flg 0.0 1.0 /end CHARACTERISTIC
/begin CHARACTERISTIC KVMC_VehHoldDecCtrl_flg "" VALUE 0x0000 /* @ECU_Address@KVMC_VehHoldDecCtrl_flg@ */ Scalar_BOOLEAN 0 SWC_FDC_type_CM_boolean_flg 0.0 1.0 /end CHARACTERISTIC
/begin CHARACTERISTIC KVMC_VehHoldDelaySW_flg "" VALUE 0x0000 /* @ECU_Address@KVMC_VehHoldDelaySW_flg@ */ Scalar_BOOLEAN 0 SWC_FDC_type_CM_boolean_flg 0.0 1.0 /end CHARACTERISTIC
/begin CHARACTERISTIC KVMC_VehHoldTqAlwaysIncSW_flg "" VALUE 0x0000 /* @ECU_Address@KVMC_VehHoldTqAlwaysIncSW_flg@ */ Scalar_BOOLEAN 0 SWC_FDC_type_CM_boolean_flg 0.0 1.0 /end CHARACTERISTIC
/begin CHARACTERISTIC KTHC_EWP3SpdDeice_K "" VALUE 0x0000 /* @ECU_Address@KTHC_EWP3SpdDeice_K@ */ Scalar_UBYTE 0 SWC_FDC_type_CM_uint8_K 0.0 255.0 /end CHARACTERISTIC
/begin CHARACTERISTIC KTHC_EWPDcCharge_K "" VALUE 0x0000 /* @ECU_Address@KTHC_EWPDcCharge_K@ */ Scalar_UBYTE 0 SWC_FDC_type_CM_uint8_K 0.0 255.0 /end CHARACTERISTIC
/begin CHARACTERISTIC KTHC_EWPLv1_K "" VALUE 0x0000 /* @ECU_Address@KTHC_EWPLv1_K@ */ Scalar_UBYTE 0 SWC_FDC_type_CM_uint8_K 0.0 255.0 /end CHARACTERISTIC
/begin CHARACTERISTIC KTHC_EWPLv2_K "" VALUE 0x0000 /* @ECU_Address@KTHC_EWPLv2_K@ */ Scalar_UBYTE 0 SWC_FDC_type_CM_uint8_K 0.0 255.0 /end CHARACTERISTIC
/begin CHARACTERISTIC KTHC_EWPLv3_K "" VALUE 0x0000 /* @ECU_Address@KTHC_EWPLv3_K@ */ Scalar_UBYTE 0 SWC_FDC_type_CM_uint8_K 0.0 255.0 /end CHARACTERISTIC
/begin CHARACTERISTIC KTHC_EWPLv4_K "" VALUE 0x0000 /* @ECU_Address@KTHC_EWPLv4_K@ */ Scalar_UBYTE 0 SWC_FDC_type_CM_uint8_K 0.0 255.0 /end CHARACTERISTIC
/begin CHARACTERISTIC KTHC_EWPLv5_K "" VALUE 0x0000 /* @ECU_Address@KTHC_EWPLv5_K@ */ Scalar_UBYTE 0 SWC_FDC_type_CM_uint8_K 0.0 255.0 /end CHARACTERISTIC
/begin CHARACTERISTIC KTHC_EWPStopT_cnt "" VALUE 0x0000 /* @ECU_Address@KTHC_EWPStopT_cnt@ */ Scalar_UBYTE 0 SWC_FDC_type_CM_uint8_cnt 0.0 255.0 /end CHARACTERISTIC
/begin CHARACTERISTIC KTHC_FANDefLv_pct "" VALUE 0x0000 /* @ECU_Address@KTHC_FANDefLv_pct@ */ Scalar_UBYTE 0 SWC_FDC_type_CM_uint8_pct 0.0 100.0 /end CHARACTERISTIC
/begin CHARACTERISTIC KTHC_FANLv1_pct "" VALUE 0x0000 /* @ECU_Address@KTHC_FANLv1_pct@ */ Scalar_UBYTE 0 SWC_FDC_type_CM_uint8_pct 0.0 100.0 /end CHARACTERISTIC
/begin CHARACTERISTIC KTHC_FANLv2_pct "" VALUE 0x0000 /* @ECU_Address@KTHC_FANLv2_pct@ */ Scalar_UBYTE 0 SWC_FDC_type_CM_uint8_pct 0.0 100.0 /end CHARACTERISTIC
/begin CHARACTERISTIC KTHC_FANLv3_pct "" VALUE 0x0000 /* @ECU_Address@KTHC_FANLv3_pct@ */ Scalar_UBYTE 0 SWC_FDC_type_CM_uint8_pct 0.0 100.0 /end CHARACTERISTIC
/begin CHARACTERISTIC KTHC_FANLv4_pct "" VALUE 0x0000 /* @ECU_Address@KTHC_FANLv4_pct@ */ Scalar_UBYTE 0 SWC_FDC_type_CM_uint8_pct 0.0 100.0 /end CHARACTERISTIC
/begin CHARACTERISTIC KTHC_FANLv5_pct "" VALUE 0x0000 /* @ECU_Address@KTHC_FANLv5_pct@ */ Scalar_UBYTE 0 SWC_FDC_type_CM_uint8_pct 0.0 100.0 /end CHARACTERISTIC
/begin CHARACTERISTIC KTHC_RefrigerantType_enum "" VALUE 0x0000 /* @ECU_Address@KTHC_RefrigerantType_enum@ */ Scalar_UBYTE 0 SWC_FDC_type_CM_uint8_enum 0.0 2.0 /end CHARACTERISTIC
/begin CHARACTERISTIC KTHC_ValueSWT_cnt "" VALUE 0x0000 /* @ECU_Address@KTHC_ValueSWT_cnt@ */ Scalar_UBYTE 0 SWC_FDC_type_CM_uint8_cnt 0.0 255.0 /end CHARACTERISTIC
/begin CHARACTERISTIC KTPM_TPMSModelVersionInit_raw "" VALUE 0x0000 /* @ECU_Address@KTPM_TPMSModelVersionInit_raw@ */ Scalar_UBYTE 0 SWC_FDC_type_CM_uint8_kph 1.0 255.0 /end CHARACTERISTIC
/begin CHARACTERISTIC KTQD_ActWhlSkipSta_enum_ovrdval "" VALUE 0x0000 /* @ECU_Address@KTQD_ActWhlSkipSta_enum_ovrdval@ */ Scalar_UBYTE 0 SWC_FDC_type_CM_uint8_enum 0.0 15.0 /end CHARACTERISTIC
/begin CHARACTERISTIC KTQD_CCActiveMetSpdHiMPH_mph "" VALUE 0x0000 /* @ECU_Address@KTQD_CCActiveMetSpdHiMPH_mph@ */ Scalar_UBYTE 0 SWC_FDC_type_CM_uint8_kph 0.0 250.0 /end CHARACTERISTIC
/begin CHARACTERISTIC KTQD_CCActiveMetSpdHi_kph "" VALUE 0x0000 /* @ECU_Address@KTQD_CCActiveMetSpdHi_kph@ */ Scalar_UBYTE 0 SWC_FDC_type_CM_uint8_kph 0.0 250.0 /end CHARACTERISTIC
/begin CHARACTERISTIC KTQD_CCActiveMetSpdLoMPH_mph "" VALUE 0x0000 /* @ECU_Address@KTQD_CCActiveMetSpdLoMPH_mph@ */ Scalar_UBYTE 0 SWC_FDC_type_CM_uint8_kph 0.0 250.0 /end CHARACTERISTIC
/begin CHARACTERISTIC KTQD_CCActiveMetSpdLo_kph "" VALUE 0x0000 /* @ECU_Address@KTQD_CCActiveMetSpdLo_kph@ */ Scalar_UBYTE 0 SWC_FDC_type_CM_uint8_kph 0.0 250.0 /end CHARACTERISTIC
/begin CHARACTERISTIC KTQD_EscModeWhlSpdDely_cnt "" VALUE 0x0000 /* @ECU_Address@KTQD_EscModeWhlSpdDely_cnt@ */ Scalar_UBYTE 0 SWC_FDC_type_CM_uint8_cnt 0.0 255.0 /end CHARACTERISTIC
/begin CHARACTERISTIC KTQD_MSAActiveMetSpdHiMPH_mph "" VALUE 0x0000 /* @ECU_Address@KTQD_MSAActiveMetSpdHiMPH_mph@ */ Scalar_UBYTE 0 SWC_FDC_type_CM_uint8_kph 0.0 250.0 /end CHARACTERISTIC
/begin CHARACTERISTIC KTQD_MSAActiveMetSpdHi_kph "" VALUE 0x0000 /* @ECU_Address@KTQD_MSAActiveMetSpdHi_kph@ */ Scalar_UBYTE 0 SWC_FDC_type_CM_uint8_kph 0.0 250.0 /end CHARACTERISTIC
/begin CHARACTERISTIC KTQD_MSAActiveMetSpdLoMPH_mph "" VALUE 0x0000 /* @ECU_Address@KTQD_MSAActiveMetSpdLoMPH_mph@ */ Scalar_UBYTE 0 SWC_FDC_type_CM_uint8_kph 0.0 250.0 /end CHARACTERISTIC
/begin CHARACTERISTIC KTQD_MSAActiveMetSpdLo_kph "" VALUE 0x0000 /* @ECU_Address@KTQD_MSAActiveMetSpdLo_kph@ */ Scalar_UBYTE 0 SWC_FDC_type_CM_uint8_kph 0.0 250.0 /end CHARACTERISTIC
/begin CHARACTERISTIC KTQD_RegenButEnSpd_kph "" VALUE 0x0000 /* @ECU_Address@KTQD_RegenButEnSpd_kph@ */ Scalar_UBYTE 0 SWC_FDC_type_CM_uint8_kph 0.0 255.0 /end CHARACTERISTIC
/begin CHARACTERISTIC KTQD_SimSoundWaveSet_enum "" VALUE 0x0000 /* @ECU_Address@KTQD_SimSoundWaveSet_enum@ */ Scalar_UBYTE 0 SWC_FDC_type_CM_uint8_enum 0.0 15.0 /end CHARACTERISTIC
/begin CHARACTERISTIC KTQD_SpdCtrlMode_enum_ovrdval "" VALUE 0x0000 /* @ECU_Address@KTQD_SpdCtrlMode_enum_ovrdval@ */ Scalar_UBYTE 0 SWC_FDC_type_CM_uint8_enum 0.0 5.0 /end CHARACTERISTIC
/begin CHARACTERISTIC KVMC_CMDRepeatTime_enum "" VALUE 0x0000 /* @ECU_Address@KVMC_CMDRepeatTime_enum@ */ Scalar_UBYTE 0 SWC_FDC_type_CM_uint8_enum 0.0 20.0 /end CHARACTERISTIC
/begin CHARACTERISTIC KVMC_IMUAccXRollAveLevel_enum "" VALUE 0x0000 /* @ECU_Address@KVMC_IMUAccXRollAveLevel_enum@ */ Scalar_UBYTE 0 SWC_FDC_type_CM_uint8_enum 1.0 100.0 /end CHARACTERISTIC
/begin CHARACTERISTIC KVMC_IMUAccYRollAveLevel_enum "" VALUE 0x0000 /* @ECU_Address@KVMC_IMUAccYRollAveLevel_enum@ */ Scalar_UBYTE 0 SWC_FDC_type_CM_uint8_enum 1.0 100.0 /end CHARACTERISTIC
/begin CHARACTERISTIC KVMC_IMUAccZRollAveLevel_enum "" VALUE 0x0000 /* @ECU_Address@KVMC_IMUAccZRollAveLevel_enum@ */ Scalar_UBYTE 0 SWC_FDC_type_CM_uint8_enum 1.0 100.0 /end CHARACTERISTIC
/begin CHARACTERISTIC KVMC_IMUGyroXRollAveLevel_enum "" VALUE 0x0000 /* @ECU_Address@KVMC_IMUGyroXRollAveLevel_enum@ */ Scalar_UBYTE 0 SWC_FDC_type_CM_uint8_enum 1.0 100.0 /end CHARACTERISTIC
/begin CHARACTERISTIC KVMC_IMUGyroYRollAveLevel_enum "" VALUE 0x0000 /* @ECU_Address@KVMC_IMUGyroYRollAveLevel_enum@ */ Scalar_UBYTE 0 SWC_FDC_type_CM_uint8_enum 1.0 100.0 /end CHARACTERISTIC
/begin CHARACTERISTIC KVMC_IMUGyroZRollAveLevel_enum "" VALUE 0x0000 /* @ECU_Address@KVMC_IMUGyroZRollAveLevel_enum@ */ Scalar_UBYTE 0 SWC_FDC_type_CM_uint8_enum 1.0 100.0 /end CHARACTERISTIC
/begin MEASUREMENT VTPM_WriteChkLFID_raw "" ULONG SWC_FDC_type_CM_uint32_raw 0 0 0.0 4.294967295E+9 ECU_ADDRESS 0x0000 /* @ECU_Address@VTPM_WriteChkLFID_raw@ */ /end MEASUREMENT
/begin MEASUREMENT VTPM_WriteChkLRID_raw "" ULONG SWC_FDC_type_CM_uint32_raw 0 0 0.0 4.294967295E+9 ECU_ADDRESS 0x0000 /* @ECU_Address@VTPM_WriteChkLRID_raw@ */ /end MEASUREMENT
/begin MEASUREMENT VTPM_WriteChkRFID_raw "" ULONG SWC_FDC_type_CM_uint32_raw 0 0 0.0 4.294967295E+9 ECU_ADDRESS 0x0000 /* @ECU_Address@VTPM_WriteChkRFID_raw@ */ /end MEASUREMENT
/begin MEASUREMENT VTPM_WriteChkRRID_raw "" ULONG SWC_FDC_type_CM_uint32_raw 0 0 0.0 4.294967295E+9 ECU_ADDRESS 0x0000 /* @ECU_Address@VTPM_WriteChkRRID_raw@ */ /end MEASUREMENT
/begin MEASUREMENT VTPM_WriteChkfinLFID_raw "" ULONG SWC_FDC_type_CM_uint32_raw 0 0 0.0 4.294967295E+9 ECU_ADDRESS 0x0000 /* @ECU_Address@VTPM_WriteChkfinLFID_raw@ */ /end MEASUREMENT
/begin MEASUREMENT VTPM_WriteChkfinLRID_raw "" ULONG SWC_FDC_type_CM_uint32_raw 0 0 0.0 4.294967295E+9 ECU_ADDRESS 0x0000 /* @ECU_Address@VTPM_WriteChkfinLRID_raw@ */ /end MEASUREMENT
/begin MEASUREMENT VTPM_WriteChkfinRFID_raw "" ULONG SWC_FDC_type_CM_uint32_raw 0 0 0.0 4.294967295E+9 ECU_ADDRESS 0x0000 /* @ECU_Address@VTPM_WriteChkfinRFID_raw@ */ /end MEASUREMENT
/begin MEASUREMENT VTPM_WriteChkfinRRID_raw "" ULONG SWC_FDC_type_CM_uint32_raw 0 0 0.0 4.294967295E+9 ECU_ADDRESS 0x0000 /* @ECU_Address@VTPM_WriteChkfinRRID_raw@ */ /end MEASUREMENT
/begin MEASUREMENT VTHC_FDTWVCmd_pct "" FLOAT32_IEEE SWC_FDC_type_CM_single_pct 0 0 0.0 99.96 ECU_ADDRESS 0x0000 /* @ECU_Address@VTHC_FDTWVCmd_pct@ */ /end MEASUREMENT
/begin MEASUREMENT VVMC_SensingAccX_G "" FLOAT32_IEEE SWC_FDC_type_CM_single_G 0 0 -65.536 65.536 ECU_ADDRESS 0x0000 /* @ECU_Address@VVMC_SensingAccX_G@ */ /end MEASUREMENT
/begin MEASUREMENT VVMC_MemOffsetAccX_G "" FLOAT32_IEEE SWC_FDC_type_CM_single_G 0 0 -65.536 65.536 ECU_ADDRESS 0x0000 /* @ECU_Address@VVMC_MemOffsetAccX_G@ */ /end MEASUREMENT
/begin MEASUREMENT VVMC_AntiLimitSpd_kph "" FLOAT32_IEEE SWC_FDC_type_CM_single_kph 0 0 -10.0 300.0 ECU_ADDRESS 0x0000 /* @ECU_Address@VVMC_AntiLimitSpd_kph@ */ /end MEASUREMENT
/begin MEASUREMENT VVMC_AccCalcuPIDIGain_mps2 "" FLOAT32_IEEE SWC_FDC_type_CM_single_mps2 0 0 -15.0 10.55 ECU_ADDRESS 0x0000 /* @ECU_Address@VVMC_AccCalcuPIDIGain_mps2@ */ /end MEASUREMENT
/begin MEASUREMENT VVMC_AccCalcuPIDPGain_mps2 "" FLOAT32_IEEE SWC_FDC_type_CM_single_mps2 0 0 -15.0 10.55 ECU_ADDRESS 0x0000 /* @ECU_Address@VVMC_AccCalcuPIDPGain_mps2@ */ /end MEASUREMENT
/begin MEASUREMENT VVMC_AccCalcuPID_mps2 "" FLOAT32_IEEE SWC_FDC_type_CM_single_mps2 0 0 -15.0 10.55 ECU_ADDRESS 0x0000 /* @ECU_Address@VVMC_AccCalcuPID_mps2@ */ /end MEASUREMENT
/begin MEASUREMENT VVMC_ISOAccLimit_mps2 "" FLOAT32_IEEE SWC_FDC_type_CM_single_mps2 0 0 0.0 10.0 ECU_ADDRESS 0x0000 /* @ECU_Address@VVMC_ISOAccLimit_mps2@ */ /end MEASUREMENT
/begin MEASUREMENT VVMC_ISODecLimit_mps2 "" FLOAT32_IEEE SWC_FDC_type_CM_single_mps2 0 0 -10.0 0.0 ECU_ADDRESS 0x0000 /* @ECU_Address@VVMC_ISODecLimit_mps2@ */ /end MEASUREMENT
/begin MEASUREMENT VVMC_ISOJerkLimit_mps3 "" FLOAT32_IEEE SWC_FDC_type_CM_single_mps3 0 0 0.0 10.0 ECU_ADDRESS 0x0000 /* @ECU_Address@VVMC_ISOJerkLimit_mps3@ */ /end MEASUREMENT
/begin MEASUREMENT VVMC_AfterCtrlACCReqAccel_mps2 "" FLOAT32_IEEE SWC_FDC_type_CM_single_mps2 0 0 -15.0 10.55 ECU_ADDRESS 0x0000 /* @ECU_Address@VVMC_AfterCtrlACCReqAccel_mps2@ */ /end MEASUREMENT
/begin MEASUREMENT VVMC_OVRD2ActReqAccelAftSR_mps2 "" FLOAT32_IEEE SWC_FDC_type_CM_single_mps2 0 0 -15.0 15.0 ECU_ADDRESS 0x0000 /* @ECU_Address@VVMC_OVRD2ActReqAccelAftSR_mps2@ */ /end MEASUREMENT
/begin MEASUREMENT VVMC_GRADE_rad "" FLOAT32_IEEE SWC_FDC_type_CM_single_rad 0 0 -100.0 100.0 ECU_ADDRESS 0x0000 /* @ECU_Address@VVMC_GRADE_rad@ */ /end MEASUREMENT
/begin MEASUREMENT VVMC_VehHoldEnReqAccel_mps2 "" FLOAT32_IEEE SWC_FDC_type_CM_single_mps2 0 0 -15.0 10.55 ECU_ADDRESS 0x0000 /* @ECU_Address@VVMC_VehHoldEnReqAccel_mps2@ */ /end MEASUREMENT
/begin MEASUREMENT VVMC_VehHoldDecCtrlBSlopeCal2_mps3 "" FLOAT32_IEEE SWC_FDC_type_CM_single_mps3 0 0 -2000.0 2000.0 ECU_ADDRESS 0x0000 /* @ECU_Address@VVMC_VehHoldDecCtrlBSlopeCal2_mps3@ */ /end MEASUREMENT
/begin MEASUREMENT VVMC_VehHoldDecCtrlBSlopeCal1_mps3 "" FLOAT32_IEEE SWC_FDC_type_CM_single_mps3 0 0 -2000.0 2000.0 ECU_ADDRESS 0x0000 /* @ECU_Address@VVMC_VehHoldDecCtrlBSlopeCal1_mps3@ */ /end MEASUREMENT
/begin MEASUREMENT VVMC_VehHoldDecCtrlBSlope_mps3 "" FLOAT32_IEEE SWC_FDC_type_CM_single_mps3 0 0 -2000.0 2000.0 ECU_ADDRESS 0x0000 /* @ECU_Address@VVMC_VehHoldDecCtrlBSlope_mps3@ */ /end MEASUREMENT
/begin MEASUREMENT VVMC_VehHoldDecCtrlAccel_mps2 "" FLOAT32_IEEE SWC_FDC_type_CM_single_mps2 0 0 -15.0 10.55 ECU_ADDRESS 0x0000 /* @ECU_Address@VVMC_VehHoldDecCtrlAccel_mps2@ */ /end MEASUREMENT
/begin MEASUREMENT VVMC_PreACCReqAcc_mps2 "" FLOAT32_IEEE SWC_FDC_type_CM_single_mps2 0 0 -15.0 10.55 ECU_ADDRESS 0x0000 /* @ECU_Address@VVMC_PreACCReqAcc_mps2@ */ /end MEASUREMENT
/begin MEASUREMENT VVMC_JerkSource_mps2 "" FLOAT32_IEEE SWC_FDC_type_CM_single_mps2 0 0 -10.0 10.0 ECU_ADDRESS 0x0000 /* @ECU_Address@VVMC_JerkSource_mps2@ */ /end MEASUREMENT
/begin MEASUREMENT VVMC_ISOJerkLimitFinal_mps3 "" FLOAT32_IEEE SWC_FDC_type_CM_single_mps3 0 0 0.0 10.0 ECU_ADDRESS 0x0000 /* @ECU_Address@VVMC_ISOJerkLimitFinal_mps3@ */ /end MEASUREMENT
/begin MEASUREMENT VVMC_DISCReqAccAftLim_mps2 "" FLOAT32_IEEE SWC_FDC_type_CM_single_mps2 0 0 -15.0 10.55 ECU_ADDRESS 0x0000 /* @ECU_Address@VVMC_DISCReqAccAftLim_mps2@ */ /end MEASUREMENT
/begin MEASUREMENT VVMC_DISCReqAccAftRepeat_mps2 "" FLOAT32_IEEE SWC_FDC_type_CM_single_mps2 0 0 -15.0 10.55 ECU_ADDRESS 0x0000 /* @ECU_Address@VVMC_DISCReqAccAftRepeat_mps2@ */ /end MEASUREMENT
/begin MEASUREMENT VVMC_ActACCRequiredAccel_mps2 "" FLOAT32_IEEE SWC_FDC_type_CM_single_mps2 0 0 -15.0 10.55 ECU_ADDRESS 0x0000 /* @ECU_Address@VVMC_ActACCRequiredAccel_mps2@ */ /end MEASUREMENT
/begin MEASUREMENT VVMC_LastADASWhlTqCal_Nm "" FLOAT32_IEEE SWC_FDC_type_CM_single_Nm 0 0 -100000.0 100000.0 ECU_ADDRESS 0x0000 /* @ECU_Address@VVMC_LastADASWhlTqCal_Nm@ */ /end MEASUREMENT
/begin MEASUREMENT VVMC_ACCDeltaAccel_mps2 "" FLOAT32_IEEE SWC_FDC_type_CM_single_mps2 0 0 -15.0 15.0 ECU_ADDRESS 0x0000 /* @ECU_Address@VVMC_ACCDeltaAccel_mps2@ */ /end MEASUREMENT
/begin MEASUREMENT VVMC_ActAccDev_mps2 "" FLOAT32_IEEE SWC_FDC_type_CM_single_mps2 0 0 -20.0 20.0 ECU_ADDRESS 0x0000 /* @ECU_Address@VVMC_ActAccDev_mps2@ */ /end MEASUREMENT
/begin MEASUREMENT VVMC_DISCDeltaTqIGain_Nm "" FLOAT32_IEEE SWC_FDC_type_CM_single_Nm 0 0 -20.0 20.0 ECU_ADDRESS 0x0000 /* @ECU_Address@VVMC_DISCDeltaTqIGain_Nm@ */ /end MEASUREMENT
/begin MEASUREMENT VVMC_ADSPosGFBPCTDeltaTq_Nm "" FLOAT32_IEEE SWC_FDC_type_CM_single_Nm 0 0 -100.0 100.0 ECU_ADDRESS 0x0000 /* @ECU_Address@VVMC_ADSPosGFBPCTDeltaTq_Nm@ */ /end MEASUREMENT
/begin MEASUREMENT VVMC_ACCDeltaTqIGain4OVRD_Nm "" FLOAT32_IEEE SWC_FDC_type_CM_single_Nm 0 0 -20.0 20.0 ECU_ADDRESS 0x0000 /* @ECU_Address@VVMC_ACCDeltaTqIGain4OVRD_Nm@ */ /end MEASUREMENT
/begin MEASUREMENT VVMC_ACCDeltaTqIGainOri_Nm "" FLOAT32_IEEE SWC_FDC_type_CM_single_Nm 0 0 -20.0 20.0 ECU_ADDRESS 0x0000 /* @ECU_Address@VVMC_ACCDeltaTqIGainOri_Nm@ */ /end MEASUREMENT
/begin MEASUREMENT VVMC_ACCDeltaTqIGain_Nm "" FLOAT32_IEEE SWC_FDC_type_CM_single_Nm 0 0 -20.0 20.0 ECU_ADDRESS 0x0000 /* @ECU_Address@VVMC_ACCDeltaTqIGain_Nm@ */ /end MEASUREMENT
/begin MEASUREMENT VVMC_ACCActSpdDev_kph "" FLOAT32_IEEE SWC_FDC_type_CM_single_kph 0 0 -200.0 200.0 ECU_ADDRESS 0x0000 /* @ECU_Address@VVMC_ACCActSpdDev_kph@ */ /end MEASUREMENT
/begin MEASUREMENT VVMC_ACCDeltaTqPGain_Nm "" FLOAT32_IEEE SWC_FDC_type_CM_single_Nm 0 0 -20.0 20.0 ECU_ADDRESS 0x0000 /* @ECU_Address@VVMC_ACCDeltaTqPGain_Nm@ */ /end MEASUREMENT
/begin MEASUREMENT VVMC_ACCDeltaTq_Nm "" FLOAT32_IEEE SWC_FDC_type_CM_single_Nm 0 0 -100000.0 100000.0 ECU_ADDRESS 0x0000 /* @ECU_Address@VVMC_ACCDeltaTq_Nm@ */ /end MEASUREMENT
/begin MEASUREMENT VVMC_TMSpdBaseTq_Nm "" FLOAT32_IEEE SWC_FDC_type_CM_single_Nm 0 0 0.0 500.0 ECU_ADDRESS 0x0000 /* @ECU_Address@VVMC_TMSpdBaseTq_Nm@ */ /end MEASUREMENT
/begin MEASUREMENT VVMC_MCPresBaseTq_Nm "" FLOAT32_IEEE SWC_FDC_type_CM_single_Nm 0 0 -500.0 500.0 ECU_ADDRESS 0x0000 /* @ECU_Address@VVMC_MCPresBaseTq_Nm@ */ /end MEASUREMENT
/begin MEASUREMENT VVMC_FrntAxlTrqReqBrk_Nm "" FLOAT32_IEEE SWC_FDC_type_CM_single_Nm 0 0 -100000.0 100000.0 ECU_ADDRESS 0x0000 /* @ECU_Address@VVMC_FrntAxlTrqReqBrk_Nm@ */ /end MEASUREMENT
/begin MEASUREMENT VVMC_RearAxlTrqReqBrk_Nm "" FLOAT32_IEEE SWC_FDC_type_CM_single_Nm 0 0 -100000.0 100000.0 ECU_ADDRESS 0x0000 /* @ECU_Address@VVMC_RearAxlTrqReqBrk_Nm@ */ /end MEASUREMENT
/begin MEASUREMENT VVMC_OriADASWhlTq_Nm "" FLOAT32_IEEE SWC_FDC_type_CM_single_Nm 0 0 -100000.0 100000.0 ECU_ADDRESS 0x0000 /* @ECU_Address@VVMC_OriADASWhlTq_Nm@ */ /end MEASUREMENT
/begin MEASUREMENT VVMC_ActACCReqAcc4ADS_mps2 "" FLOAT32_IEEE SWC_FDC_type_CM_single_mps2 0 0 -15.0 15.0 ECU_ADDRESS 0x0000 /* @ECU_Address@VVMC_ActACCReqAcc4ADS_mps2@ */ /end MEASUREMENT
/begin MEASUREMENT VVMC_ACCRequiredAccel_mps2 "" FLOAT32_IEEE SWC_FDC_type_CM_single_mps2 0 0 -15.0 10.55 ECU_ADDRESS 0x0000 /* @ECU_Address@VVMC_ACCRequiredAccel_mps2@ */ /end MEASUREMENT
/begin MEASUREMENT VVMC_ADASOvrdWhlTqCtrl_Nm "" FLOAT32_IEEE SWC_FDC_type_CM_single_Nm 0 0 -100000.0 100000.0 ECU_ADDRESS 0x0000 /* @ECU_Address@VVMC_ADASOvrdWhlTqCtrl_Nm@ */ /end MEASUREMENT
/begin MEASUREMENT VVMC_ADASOvrdWhlTq_Nm "" FLOAT32_IEEE SWC_FDC_type_CM_single_Nm 0 0 -100000.0 100000.0 ECU_ADDRESS 0x0000 /* @ECU_Address@VVMC_ADASOvrdWhlTq_Nm@ */ /end MEASUREMENT
/begin MEASUREMENT VVMC_ADASWhlTqReqOvrd_Nm "" FLOAT32_IEEE SWC_FDC_type_CM_single_Nm 0 0 -100000.0 100000.0 ECU_ADDRESS 0x0000 /* @ECU_Address@VVMC_ADASWhlTqReqOvrd_Nm@ */ /end MEASUREMENT
/begin MEASUREMENT VVMC_ADASWhlTqCalZeroRgnCtrl_Nm "" FLOAT32_IEEE SWC_FDC_type_CM_single_Nm 0 0 -100000.0 100000.0 ECU_ADDRESS 0x0000 /* @ECU_Address@VVMC_ADASWhlTqCalZeroRgnCtrl_Nm@ */ /end MEASUREMENT
/begin MEASUREMENT VVMC_ACCLowSpdTqEnSpdHi_Nm "" FLOAT32_IEEE SWC_FDC_type_CM_single_Nm 0 0 -100000.0 100000.0 ECU_ADDRESS 0x0000 /* @ECU_Address@VVMC_ACCLowSpdTqEnSpdHi_Nm@ */ /end MEASUREMENT
/begin MEASUREMENT VVMC_ACCLowSpdTqEnSpdLo_Nm "" FLOAT32_IEEE SWC_FDC_type_CM_single_Nm 0 0 -100000.0 100000.0 ECU_ADDRESS 0x0000 /* @ECU_Address@VVMC_ACCLowSpdTqEnSpdLo_Nm@ */ /end MEASUREMENT
/begin MEASUREMENT VVMC_ACCLowSpdTq_Nm "" FLOAT32_IEEE SWC_FDC_type_CM_single_Nm 0 0 -100000.0 100000.0 ECU_ADDRESS 0x0000 /* @ECU_Address@VVMC_ACCLowSpdTq_Nm@ */ /end MEASUREMENT
/begin MEASUREMENT VVMC_ACCLowSpdTqAftFollowESC_Nm "" FLOAT32_IEEE SWC_FDC_type_CM_single_Nm 0 0 -100000.0 100000.0 ECU_ADDRESS 0x0000 /* @ECU_Address@VVMC_ACCLowSpdTqAftFollowESC_Nm@ */ /end MEASUREMENT
/begin MEASUREMENT VVMC_ACCTqRampOutByMCP_Nm "" FLOAT32_IEEE SWC_FDC_type_CM_single_Nm 0 0 -100000.0 100000.0 ECU_ADDRESS 0x0000 /* @ECU_Address@VVMC_ACCTqRampOutByMCP_Nm@ */ /end MEASUREMENT
/begin MEASUREMENT VVMC_ACCTqNegReq_Nm "" FLOAT32_IEEE SWC_FDC_type_CM_single_Nm 0 0 -100000.0 100000.0 ECU_ADDRESS 0x0000 /* @ECU_Address@VVMC_ACCTqNegReq_Nm@ */ /end MEASUREMENT
/begin MEASUREMENT VVMC_ACCTqNegReqNotLowSpd_Nm "" FLOAT32_IEEE SWC_FDC_type_CM_single_Nm 0 0 -100000.0 100000.0 ECU_ADDRESS 0x0000 /* @ECU_Address@VVMC_ACCTqNegReqNotLowSpd_Nm@ */ /end MEASUREMENT
/begin MEASUREMENT VVMC_ADASWhlTqCalNegCMD_Nm "" FLOAT32_IEEE SWC_FDC_type_CM_single_Nm 0 0 -100000.0 100000.0 ECU_ADDRESS 0x0000 /* @ECU_Address@VVMC_ADASWhlTqCalNegCMD_Nm@ */ /end MEASUREMENT
/begin MEASUREMENT VVMC_ADASWhlTqVehHoldBfrSS_Nm "" FLOAT32_IEEE SWC_FDC_type_CM_single_Nm 0 0 -100000.0 100000.0 ECU_ADDRESS 0x0000 /* @ECU_Address@VVMC_ADASWhlTqVehHoldBfrSS_Nm@ */ /end MEASUREMENT
/begin MEASUREMENT VVMC_ADASWhlTqCalVehHoldPosTq_Nm "" FLOAT32_IEEE SWC_FDC_type_CM_single_Nm 0 0 -100000.0 100000.0 ECU_ADDRESS 0x0000 /* @ECU_Address@VVMC_ADASWhlTqCalVehHoldPosTq_Nm@ */ /end MEASUREMENT
/begin MEASUREMENT VVMC_ADASWhlTqCalVehHold_Nm "" FLOAT32_IEEE SWC_FDC_type_CM_single_Nm 0 0 -100000.0 100000.0 ECU_ADDRESS 0x0000 /* @ECU_Address@VVMC_ADASWhlTqCalVehHold_Nm@ */ /end MEASUREMENT
/begin MEASUREMENT VVMC_ADASWhlTqCalAftSafety_Nm "" FLOAT32_IEEE SWC_FDC_type_CM_single_Nm 0 0 -100000.0 100000.0 ECU_ADDRESS 0x0000 /* @ECU_Address@VVMC_ADASWhlTqCalAftSafety_Nm@ */ /end MEASUREMENT
/begin MEASUREMENT VVMC_ADASWhlTqCal_Nm "" FLOAT32_IEEE SWC_FDC_type_CM_single_Nm 0 0 -100000.0 100000.0 ECU_ADDRESS 0x0000 /* @ECU_Address@VVMC_ADASWhlTqCal_Nm@ */ /end MEASUREMENT
/begin MEASUREMENT VVMC_ADASWhlTqReq_Nm "" FLOAT32_IEEE SWC_FDC_type_CM_single_Nm 0 0 -100000.0 100000.0 ECU_ADDRESS 0x0000 /* @ECU_Address@VVMC_ADASWhlTqReq_Nm@ */ /end MEASUREMENT
/begin MEASUREMENT VVMC_CCPGainDeltaTq_Nm "" FLOAT32_IEEE SWC_FDC_type_CM_single_Nm 0 0 -100000.0 100000.0 ECU_ADDRESS 0x0000 /* @ECU_Address@VVMC_CCPGainDeltaTq_Nm@ */ /end MEASUREMENT
/begin MEASUREMENT VVMC_LastCruzWhlTqCal_Nm "" FLOAT32_IEEE SWC_FDC_type_CM_single_Nm 0 0 -100000.0 100000.0 ECU_ADDRESS 0x0000 /* @ECU_Address@VVMC_LastCruzWhlTqCal_Nm@ */ /end MEASUREMENT
/begin MEASUREMENT VVMC_CCIGainDeltaTq_Nm "" FLOAT32_IEEE SWC_FDC_type_CM_single_Nm 0 0 -100000.0 100000.0 ECU_ADDRESS 0x0000 /* @ECU_Address@VVMC_CCIGainDeltaTq_Nm@ */ /end MEASUREMENT
/begin MEASUREMENT VVMC_CruzWhlTqCalAftSafety_Nm "" FLOAT32_IEEE SWC_FDC_type_CM_single_Nm 0 0 -100000.0 100000.0 ECU_ADDRESS 0x0000 /* @ECU_Address@VVMC_CruzWhlTqCalAftSafety_Nm@ */ /end MEASUREMENT
/begin MEASUREMENT VVMC_CruzWhlTqCal_Nm "" FLOAT32_IEEE SWC_FDC_type_CM_single_Nm 0 0 -100000.0 100000.0 ECU_ADDRESS 0x0000 /* @ECU_Address@VVMC_CruzWhlTqCal_Nm@ */ /end MEASUREMENT
/begin MEASUREMENT VVMC_CruzWhlTqReq_Nm "" FLOAT32_IEEE SWC_FDC_type_CM_single_Nm 0 0 -100000.0 100000.0 ECU_ADDRESS 0x0000 /* @ECU_Address@VVMC_CruzWhlTqReq_Nm@ */ /end MEASUREMENT
/begin MEASUREMENT VVMC_MSAPedalOvrd_pct "" FLOAT32_IEEE SWC_FDC_type_CM_single_pct 0 0 0.0 125.0 ECU_ADDRESS 0x0000 /* @ECU_Address@VVMC_MSAPedalOvrd_pct@ */ /end MEASUREMENT
/begin MEASUREMENT VVMC_MSAOvrdWhlTqCal_Nm "" FLOAT32_IEEE SWC_FDC_type_CM_single_Nm 0 0 -100000.0 100000.0 ECU_ADDRESS 0x0000 /* @ECU_Address@VVMC_MSAOvrdWhlTqCal_Nm@ */ /end MEASUREMENT
/begin MEASUREMENT VVMC_MSAPGainDeltaTq_Nm "" FLOAT32_IEEE SWC_FDC_type_CM_single_Nm 0 0 -100000.0 100000.0 ECU_ADDRESS 0x0000 /* @ECU_Address@VVMC_MSAPGainDeltaTq_Nm@ */ /end MEASUREMENT
/begin MEASUREMENT VVMC_MSATqDownEndTq_Nm "" FLOAT32_IEEE SWC_FDC_type_CM_single_Nm 0 0 -100000.0 100000.0 ECU_ADDRESS 0x0000 /* @ECU_Address@VVMC_MSATqDownEndTq_Nm@ */ /end MEASUREMENT
/begin MEASUREMENT VVMC_MSAWhlTqCalDelay_Nm "" FLOAT32_IEEE SWC_FDC_type_CM_single_Nm 0 0 -100000.0 100000.0 ECU_ADDRESS 0x0000 /* @ECU_Address@VVMC_MSAWhlTqCalDelay_Nm@ */ /end MEASUREMENT
/begin MEASUREMENT VVMC_MSATqDownSlope_Nmps "" FLOAT32_IEEE SWC_FDC_type_CM_single_Nmps 0 0 -1.0E+6 1.0E+6 ECU_ADDRESS 0x0000 /* @ECU_Address@VVMC_MSATqDownSlope_Nmps@ */ /end MEASUREMENT
/begin MEASUREMENT VVMC_MSAWhlTqCalAftTqDown_Nm "" FLOAT32_IEEE SWC_FDC_type_CM_single_Nm 0 0 -100000.0 100000.0 ECU_ADDRESS 0x0000 /* @ECU_Address@VVMC_MSAWhlTqCalAftTqDown_Nm@ */ /end MEASUREMENT
/begin MEASUREMENT VVMC_MSAIGainDeltaTq_Nm "" FLOAT32_IEEE SWC_FDC_type_CM_single_Nm 0 0 -100000.0 100000.0 ECU_ADDRESS 0x0000 /* @ECU_Address@VVMC_MSAIGainDeltaTq_Nm@ */ /end MEASUREMENT
/begin MEASUREMENT VVMC_MSAWhlTqCalAftGCtrl_Nm "" FLOAT32_IEEE SWC_FDC_type_CM_single_Nm 0 0 -100000.0 100000.0 ECU_ADDRESS 0x0000 /* @ECU_Address@VVMC_MSAWhlTqCalAftGCtrl_Nm@ */ /end MEASUREMENT
/begin MEASUREMENT VVMC_MSAWhlTqCalNotTqDown_Nm "" FLOAT32_IEEE SWC_FDC_type_CM_single_Nm 0 0 -100000.0 100000.0 ECU_ADDRESS 0x0000 /* @ECU_Address@VVMC_MSAWhlTqCalNotTqDown_Nm@ */ /end MEASUREMENT
/begin MEASUREMENT VVMC_MSAWhlTqCalAftInCtrlSpd_Nm "" FLOAT32_IEEE SWC_FDC_type_CM_single_Nm 0 0 -100000.0 100000.0 ECU_ADDRESS 0x0000 /* @ECU_Address@VVMC_MSAWhlTqCalAftInCtrlSpd_Nm@ */ /end MEASUREMENT
/begin MEASUREMENT VVMC_MSAWhlTqCal_Nm "" FLOAT32_IEEE SWC_FDC_type_CM_single_Nm 0 0 -100000.0 100000.0 ECU_ADDRESS 0x0000 /* @ECU_Address@VVMC_MSAWhlTqCal_Nm@ */ /end MEASUREMENT
/begin MEASUREMENT VVMC_MSAWhlTqReq_Nm "" FLOAT32_IEEE SWC_FDC_type_CM_single_Nm 0 0 -100000.0 100000.0 ECU_ADDRESS 0x0000 /* @ECU_Address@VVMC_MSAWhlTqReq_Nm@ */ /end MEASUREMENT
/begin MEASUREMENT VVMC_VMCWhlTq4RatioCalcu_Nm "" FLOAT32_IEEE SWC_FDC_type_CM_single_Nm 0 0 -100000.0 100000.0 ECU_ADDRESS 0x0000 /* @ECU_Address@VVMC_VMCWhlTq4RatioCalcu_Nm@ */ /end MEASUREMENT
/begin MEASUREMENT VVMC_PedalTqRWhlRatio_rat "" FLOAT32_IEEE SWC_FDC_type_CM_single_rat 0 0 0.0 1.0 ECU_ADDRESS 0x0000 /* @ECU_Address@VVMC_PedalTqRWhlRatio_rat@ */ /end MEASUREMENT
/begin MEASUREMENT VVMC_RearTqRatioBfrSlip_rat "" FLOAT32_IEEE SWC_FDC_type_CM_single_rat 0 0 0.0 1.0 ECU_ADDRESS 0x0000 /* @ECU_Address@VVMC_RearTqRatioBfrSlip_rat@ */ /end MEASUREMENT
/begin MEASUREMENT VVMC_ADASRrWhlTqBfrSlip_Nm "" FLOAT32_IEEE SWC_FDC_type_CM_single_Nm 0 0 -100000.0 100000.0 ECU_ADDRESS 0x0000 /* @ECU_Address@VVMC_ADASRrWhlTqBfrSlip_Nm@ */ /end MEASUREMENT
/begin MEASUREMENT VVMC_FrRrSlipRate_rat "" FLOAT32_IEEE SWC_FDC_type_CM_single_rat 0 0 -1.0 1.0 ECU_ADDRESS 0x0000 /* @ECU_Address@VVMC_FrRrSlipRate_rat@ */ /end MEASUREMENT
/begin MEASUREMENT VVMC_PedalTqRWhlSlipGain_Nm "" FLOAT32_IEEE SWC_FDC_type_CM_single_Nm 0 0 -100000.0 100000.0 ECU_ADDRESS 0x0000 /* @ECU_Address@VVMC_PedalTqRWhlSlipGain_Nm@ */ /end MEASUREMENT
/begin MEASUREMENT VVMC_RearWhlTqSlipGain_Nm "" FLOAT32_IEEE SWC_FDC_type_CM_single_Nm 0 0 -100000.0 100000.0 ECU_ADDRESS 0x0000 /* @ECU_Address@VVMC_RearWhlTqSlipGain_Nm@ */ /end MEASUREMENT
/begin MEASUREMENT VVMC_PedalTqRWhSTRGGain_Nm "" FLOAT32_IEEE SWC_FDC_type_CM_single_Nm 0 0 -100000.0 100000.0 ECU_ADDRESS 0x0000 /* @ECU_Address@VVMC_PedalTqRWhSTRGGain_Nm@ */ /end MEASUREMENT
/begin MEASUREMENT VVMC_RearWhlTqSTRGGain_Nm "" FLOAT32_IEEE SWC_FDC_type_CM_single_Nm 0 0 -100000.0 100000.0 ECU_ADDRESS 0x0000 /* @ECU_Address@VVMC_RearWhlTqSTRGGain_Nm@ */ /end MEASUREMENT
/begin MEASUREMENT VVMC_RearTqRatioAftSlip_rat "" FLOAT32_IEEE SWC_FDC_type_CM_single_rat 0 0 0.0 1.0 ECU_ADDRESS 0x0000 /* @ECU_Address@VVMC_RearTqRatioAftSlip_rat@ */ /end MEASUREMENT
/begin MEASUREMENT VVMC_ADASRrWhlTqAftSlip_Nm "" FLOAT32_IEEE SWC_FDC_type_CM_single_Nm 0 0 -100000.0 100000.0 ECU_ADDRESS 0x0000 /* @ECU_Address@VVMC_ADASRrWhlTqAftSlip_Nm@ */ /end MEASUREMENT
/begin MEASUREMENT VVMC_ADASRrWhlTqAftLim_Nm "" FLOAT32_IEEE SWC_FDC_type_CM_single_Nm 0 0 -100000.0 100000.0 ECU_ADDRESS 0x0000 /* @ECU_Address@VVMC_ADASRrWhlTqAftLim_Nm@ */ /end MEASUREMENT
/begin MEASUREMENT VVMC_ADASFrWhlTqAftSlip_Nm "" FLOAT32_IEEE SWC_FDC_type_CM_single_Nm 0 0 -100000.0 100000.0 ECU_ADDRESS 0x0000 /* @ECU_Address@VVMC_ADASFrWhlTqAftSlip_Nm@ */ /end MEASUREMENT
/begin MEASUREMENT VVMC_ADASFrWhlTqAftLim_Nm "" FLOAT32_IEEE SWC_FDC_type_CM_single_Nm 0 0 -100000.0 100000.0 ECU_ADDRESS 0x0000 /* @ECU_Address@VVMC_ADASFrWhlTqAftLim_Nm@ */ /end MEASUREMENT
/begin MEASUREMENT VVMC_ADASRrWhlTq_Nm "" FLOAT32_IEEE SWC_FDC_type_CM_single_Nm 0 0 -100000.0 100000.0 ECU_ADDRESS 0x0000 /* @ECU_Address@VVMC_ADASRrWhlTq_Nm@ */ /end MEASUREMENT
/begin MEASUREMENT VVMC_RearTqRatio_rat "" FLOAT32_IEEE SWC_FDC_type_CM_single_rat 0 0 0.0 1.0 ECU_ADDRESS 0x0000 /* @ECU_Address@VVMC_RearTqRatio_rat@ */ /end MEASUREMENT
/begin MEASUREMENT VVMC_TimeGapCalcu_s "" FLOAT32_IEEE SWC_FDC_type_CM_single_s 0 0 0.0 25.5 ECU_ADDRESS 0x0000 /* @ECU_Address@VVMC_TimeGapCalcu_s@ */ /end MEASUREMENT
/begin MEASUREMENT VVMC_APSSpeedCMD_kph "" FLOAT32_IEEE SWC_FDC_type_CM_single_kph 0 0 0.0 20.0 ECU_ADDRESS 0x0000 /* @ECU_Address@VVMC_APSSpeedCMD_kph@ */ /end MEASUREMENT
/begin MEASUREMENT VVMC_SensingAccY_G "" FLOAT32_IEEE SWC_FDC_type_CM_single_G 0 0 -65.536 65.536 ECU_ADDRESS 0x0000 /* @ECU_Address@VVMC_SensingAccY_G@ */ /end MEASUREMENT
/begin MEASUREMENT VVMC_MemOffsetAccY_G "" FLOAT32_IEEE SWC_FDC_type_CM_single_G 0 0 -65.536 65.536 ECU_ADDRESS 0x0000 /* @ECU_Address@VVMC_MemOffsetAccY_G@ */ /end MEASUREMENT
/begin MEASUREMENT VVMC_LatESCRegenOut_Gps "" FLOAT32_IEEE SWC_FDC_type_CM_single_Gps 0 0 0.0 4.0 ECU_ADDRESS 0x0000 /* @ECU_Address@VVMC_LatESCRegenOut_Gps@ */ /end MEASUREMENT
/begin MEASUREMENT VVMC_SensingGyroZ_Dps "" FLOAT32_IEEE SWC_FDC_type_CM_single_Dps 0 0 -1966.0 1966.0 ECU_ADDRESS 0x0000 /* @ECU_Address@VVMC_SensingGyroZ_Dps@ */ /end MEASUREMENT
/begin MEASUREMENT VVMC_MemOffsetGyroZ_Dps "" FLOAT32_IEEE SWC_FDC_type_CM_single_Dps 0 0 -1966.0 1966.0 ECU_ADDRESS 0x0000 /* @ECU_Address@VVMC_MemOffsetGyroZ_Dps@ */ /end MEASUREMENT
/begin MEASUREMENT VVMC_ESCRegenOut_Dps "" FLOAT32_IEEE SWC_FDC_type_CM_single_Dps 0 0 -150.0 150.0 ECU_ADDRESS 0x0000 /* @ECU_Address@VVMC_ESCRegenOut_Dps@ */ /end MEASUREMENT
/begin MEASUREMENT VVMC_ESCRegenOutEnSpd_kph "" FLOAT32_IEEE SWC_FDC_type_CM_single_kph 0 0 0.0 300.0 ECU_ADDRESS 0x0000 /* @ECU_Address@VVMC_ESCRegenOutEnSpd_kph@ */ /end MEASUREMENT
/begin MEASUREMENT VVMC_RDCEnSlideRate_pct "" FLOAT32_IEEE SWC_FDC_type_CM_single_pct 0 0 0.0 125.0 ECU_ADDRESS 0x0000 /* @ECU_Address@VVMC_RDCEnSlideRate_pct@ */ /end MEASUREMENT
/begin MEASUREMENT VVMC_RDCDetectTime_s "" FLOAT32_IEEE SWC_FDC_type_CM_single_s 0 0 0.0 7200.0 ECU_ADDRESS 0x0000 /* @ECU_Address@VVMC_RDCDetectTime_s@ */ /end MEASUREMENT
/begin MEASUREMENT VVMC_StESCYaw_Dps "" FLOAT32_IEEE SWC_FDC_type_CM_single_Dps 0 0 -300.0 300.0 ECU_ADDRESS 0x0000 /* @ECU_Address@VVMC_StESCYaw_Dps@ */ /end MEASUREMENT
/begin MEASUREMENT VVMC_StESCYawCom_Dps "" FLOAT32_IEEE SWC_FDC_type_CM_single_Dps 0 0 -300.0 300.0 ECU_ADDRESS 0x0000 /* @ECU_Address@VVMC_StESCYawCom_Dps@ */ /end MEASUREMENT
/begin MEASUREMENT VVMC_ActStESCYaw_Dps "" FLOAT32_IEEE SWC_FDC_type_CM_single_Dps 0 0 -300.0 300.0 ECU_ADDRESS 0x0000 /* @ECU_Address@VVMC_ActStESCYaw_Dps@ */ /end MEASUREMENT
/begin MEASUREMENT VVMC_SensingAccZ_G "" FLOAT32_IEEE SWC_FDC_type_CM_single_G 0 0 -65.536 65.536 ECU_ADDRESS 0x0000 /* @ECU_Address@VVMC_SensingAccZ_G@ */ /end MEASUREMENT
/begin MEASUREMENT VVMC_MemOffsetAccZ_G "" FLOAT32_IEEE SWC_FDC_type_CM_single_G 0 0 -65.536 65.536 ECU_ADDRESS 0x0000 /* @ECU_Address@VVMC_MemOffsetAccZ_G@ */ /end MEASUREMENT
/begin MEASUREMENT VVMC_SensingGyroX_Dps "" FLOAT32_IEEE SWC_FDC_type_CM_single_Dps 0 0 -1966.0 1966.0 ECU_ADDRESS 0x0000 /* @ECU_Address@VVMC_SensingGyroX_Dps@ */ /end MEASUREMENT
/begin MEASUREMENT VVMC_MemOffsetGyroX_Dps "" FLOAT32_IEEE SWC_FDC_type_CM_single_Dps 0 0 -1966.0 1966.0 ECU_ADDRESS 0x0000 /* @ECU_Address@VVMC_MemOffsetGyroX_Dps@ */ /end MEASUREMENT
/begin MEASUREMENT VVMC_SensingGyroY_Dps "" FLOAT32_IEEE SWC_FDC_type_CM_single_Dps 0 0 -1966.0 1966.0 ECU_ADDRESS 0x0000 /* @ECU_Address@VVMC_SensingGyroY_Dps@ */ /end MEASUREMENT
/begin MEASUREMENT VVMC_MemOffsetGyroY_Dps "" FLOAT32_IEEE SWC_FDC_type_CM_single_Dps 0 0 -1966.0 1966.0 ECU_ADDRESS 0x0000 /* @ECU_Address@VVMC_MemOffsetGyroY_Dps@ */ /end MEASUREMENT
/begin MEASUREMENT VVMC_ADASFrWhlTqBfrSlip_Nm "" FLOAT32_IEEE SWC_FDC_type_CM_single_Nm 0 0 -100000.0 100000.0 ECU_ADDRESS 0x0000 /* @ECU_Address@VVMC_ADASFrWhlTqBfrSlip_Nm@ */ /end MEASUREMENT
/begin MEASUREMENT VVMC_ADASFrWhlTq_Nm "" FLOAT32_IEEE SWC_FDC_type_CM_single_Nm 0 0 -100000.0 100000.0 ECU_ADDRESS 0x0000 /* @ECU_Address@VVMC_ADASFrWhlTq_Nm@ */ /end MEASUREMENT
/begin MEASUREMENT VVMC_MeterSpdCalcu_mps "" FLOAT32_IEEE SWC_FDC_type_CM_single_mps 0 0 0.0 80.0 ECU_ADDRESS 0x0000 /* @ECU_Address@VVMC_MeterSpdCalcu_mps@ */ /end MEASUREMENT
/begin MEASUREMENT VVMC_LFWhlSpeedRollAve_kph "" FLOAT32_IEEE SWC_FDC_type_CM_single_kph 0 0 0.0 255.0 ECU_ADDRESS 0x0000 /* @ECU_Address@VVMC_LFWhlSpeedRollAve_kph@ */ /end MEASUREMENT
/begin MEASUREMENT VVMC_RFWhlSpeedRollAve_kph "" FLOAT32_IEEE SWC_FDC_type_CM_single_kph 0 0 0.0 255.0 ECU_ADDRESS 0x0000 /* @ECU_Address@VVMC_RFWhlSpeedRollAve_kph@ */ /end MEASUREMENT
/begin MEASUREMENT VVMC_LRWhlSpeedRollAve_kph "" FLOAT32_IEEE SWC_FDC_type_CM_single_kph 0 0 0.0 255.0 ECU_ADDRESS 0x0000 /* @ECU_Address@VVMC_LRWhlSpeedRollAve_kph@ */ /end MEASUREMENT
/begin MEASUREMENT VVMC_RRWhlSpeedRollAve_kph "" FLOAT32_IEEE SWC_FDC_type_CM_single_kph 0 0 0.0 255.0 ECU_ADDRESS 0x0000 /* @ECU_Address@VVMC_RRWhlSpeedRollAve_kph@ */ /end MEASUREMENT
/begin MEASUREMENT VVMC_ACCConSpdCtrlCMD_mps2 "" FLOAT32_IEEE SWC_FDC_type_CM_single_mps2 0 0 -15.0 10.55 ECU_ADDRESS 0x0000 /* @ECU_Address@VVMC_ACCConSpdCtrlCMD_mps2@ */ /end MEASUREMENT
/begin MEASUREMENT VVMC_DISCConSpdCtrlCMD_mps2 "" FLOAT32_IEEE SWC_FDC_type_CM_single_mps2 0 0 -15.0 10.55 ECU_ADDRESS 0x0000 /* @ECU_Address@VVMC_DISCConSpdCtrlCMD_mps2@ */ /end MEASUREMENT
/begin MEASUREMENT VVMC_LongAccelCalcuByVehSpd_gps "" FLOAT32_IEEE SWC_FDC_type_CM_single_gps 0 0 -20.0 20.0 ECU_ADDRESS 0x0000 /* @ECU_Address@VVMC_LongAccelCalcuByVehSpd_gps@ */ /end MEASUREMENT
/begin MEASUREMENT VVMC_LongAcc_Gps "" FLOAT32_IEEE SWC_FDC_type_CM_single_Gps 0 0 -20.0 20.0 ECU_ADDRESS 0x0000 /* @ECU_Address@VVMC_LongAcc_Gps@ */ /end MEASUREMENT
/begin MEASUREMENT VVMC_CalibratedAccXAftRA_G "" FLOAT32_IEEE SWC_FDC_type_CM_single_G 0 0 -65.536 65.536 ECU_ADDRESS 0x0000 /* @ECU_Address@VVMC_CalibratedAccXAftRA_G@ */ /end MEASUREMENT
/begin MEASUREMENT VTQR_FrntAxlTrqReqBrkRamp_Nm "" FLOAT32_IEEE SWC_FDC_type_CM_single_Nm 0 0 -100000.0 100000.0 ECU_ADDRESS 0x0000 /* @ECU_Address@VTQR_FrntAxlTrqReqBrkRamp_Nm@ */ /end MEASUREMENT
/begin MEASUREMENT VTQR_RampTqCMDGain_c "" FLOAT32_IEEE SWC_FDC_type_CM_single_c 0 0 -1.0 1.0 ECU_ADDRESS 0x0000 /* @ECU_Address@VTQR_RampTqCMDGain_c@ */ /end MEASUREMENT
/begin MEASUREMENT VTQR_ActFEDUTqUpLimit_Nm "" FLOAT32_IEEE SWC_FDC_type_CM_single_Nm 0 0 0.0 100000.0 ECU_ADDRESS 0x0000 /* @ECU_Address@VTQR_ActFEDUTqUpLimit_Nm@ */ /end MEASUREMENT
/begin MEASUREMENT VTQR_FEDUWhlTqReqSmoothDelay_Nm "" FLOAT32_IEEE SWC_FDC_type_CM_single_Nm 0 0 -100000.0 100000.0 ECU_ADDRESS 0x0000 /* @ECU_Address@VTQR_FEDUWhlTqReqSmoothDelay_Nm@ */ /end MEASUREMENT
/begin MEASUREMENT VTQR_REDUWhlTqReqSmoothDelay_Nm "" FLOAT32_IEEE SWC_FDC_type_CM_single_Nm 0 0 -100000.0 100000.0 ECU_ADDRESS 0x0000 /* @ECU_Address@VTQR_REDUWhlTqReqSmoothDelay_Nm@ */ /end MEASUREMENT
/begin MEASUREMENT VTQR_ActFEDUTqLowLimit_Nm "" FLOAT32_IEEE SWC_FDC_type_CM_single_Nm 0 0 -100000.0 100000.0 ECU_ADDRESS 0x0000 /* @ECU_Address@VTQR_ActFEDUTqLowLimit_Nm@ */ /end MEASUREMENT
/begin MEASUREMENT VTQR_NoABSFEDUWhlTqReq_Nm "" FLOAT32_IEEE SWC_FDC_type_CM_single_Nm 0 0 -100000.0 100000.0 ECU_ADDRESS 0x0000 /* @ECU_Address@VTQR_NoABSFEDUWhlTqReq_Nm@ */ /end MEASUREMENT
/begin MEASUREMENT VTQR_ActualFEDUWhlTqReq_Nm "" FLOAT32_IEEE SWC_FDC_type_CM_single_Nm 0 0 -100000.0 100000.0 ECU_ADDRESS 0x0000 /* @ECU_Address@VTQR_ActualFEDUWhlTqReq_Nm@ */ /end MEASUREMENT
/begin MEASUREMENT VTQR_InitFEDUWhlTqReq_Nm "" FLOAT32_IEEE SWC_FDC_type_CM_single_Nm 0 0 -100000.0 100000.0 ECU_ADDRESS 0x0000 /* @ECU_Address@VTQR_InitFEDUWhlTqReq_Nm@ */ /end MEASUREMENT
/begin MEASUREMENT VTQR_FrTMTqReq_Nm "" FLOAT32_IEEE SWC_FDC_type_CM_single_Nm 0 0 -100000.0 100000.0 ECU_ADDRESS 0x0000 /* @ECU_Address@VTQR_FrTMTqReq_Nm@ */ /end MEASUREMENT
/begin MEASUREMENT VTQR_RearAxlTrqReqBrkRamp_Nm "" FLOAT32_IEEE SWC_FDC_type_CM_single_Nm 0 0 -100000.0 100000.0 ECU_ADDRESS 0x0000 /* @ECU_Address@VTQR_RearAxlTrqReqBrkRamp_Nm@ */ /end MEASUREMENT
/begin MEASUREMENT VTQR_ActREDUTqUpLimit_Nm "" FLOAT32_IEEE SWC_FDC_type_CM_single_Nm 0 0 0.0 100000.0 ECU_ADDRESS 0x0000 /* @ECU_Address@VTQR_ActREDUTqUpLimit_Nm@ */ /end MEASUREMENT
/begin MEASUREMENT VTQR_ActREDUTqLowLimit_Nm "" FLOAT32_IEEE SWC_FDC_type_CM_single_Nm 0 0 -100000.0 100000.0 ECU_ADDRESS 0x0000 /* @ECU_Address@VTQR_ActREDUTqLowLimit_Nm@ */ /end MEASUREMENT
/begin MEASUREMENT VTQR_NoABSREDUWhlTqReq_Nm "" FLOAT32_IEEE SWC_FDC_type_CM_single_Nm 0 0 -100000.0 100000.0 ECU_ADDRESS 0x0000 /* @ECU_Address@VTQR_NoABSREDUWhlTqReq_Nm@ */ /end MEASUREMENT
/begin MEASUREMENT VTQR_ActualREDUWhlTqReq_Nm "" FLOAT32_IEEE SWC_FDC_type_CM_single_Nm 0 0 -100000.0 100000.0 ECU_ADDRESS 0x0000 /* @ECU_Address@VTQR_ActualREDUWhlTqReq_Nm@ */ /end MEASUREMENT
/begin MEASUREMENT VTQR_InitREDUWhlTqReq_Nm "" FLOAT32_IEEE SWC_FDC_type_CM_single_Nm 0 0 -100000.0 100000.0 ECU_ADDRESS 0x0000 /* @ECU_Address@VTQR_InitREDUWhlTqReq_Nm@ */ /end MEASUREMENT
/begin MEASUREMENT VTQR_RrTMTqReq_Nm "" FLOAT32_IEEE SWC_FDC_type_CM_single_Nm 0 0 -100000.0 100000.0 ECU_ADDRESS 0x0000 /* @ECU_Address@VTQR_RrTMTqReq_Nm@ */ /end MEASUREMENT
/begin MEASUREMENT VTQR_FrFirstOrderOutTqDelay_Nm "" FLOAT32_IEEE SWC_FDC_type_CM_single_Nm 0 0 -100000.0 100000.0 ECU_ADDRESS 0x0000 /* @ECU_Address@VTQR_FrFirstOrderOutTqDelay_Nm@ */ /end MEASUREMENT
/begin MEASUREMENT VTQR_RrFirstOrderOutTqDelay_Nm "" FLOAT32_IEEE SWC_FDC_type_CM_single_Nm 0 0 -100000.0 100000.0 ECU_ADDRESS 0x0000 /* @ECU_Address@VTQR_RrFirstOrderOutTqDelay_Nm@ */ /end MEASUREMENT
/begin MEASUREMENT VTQD_AWDLoadTrqnsGain_pct "" FLOAT32_IEEE SWC_FDC_type_CM_single_pct 0 0 0.0 300.0 ECU_ADDRESS 0x0000 /* @ECU_Address@VTQD_AWDLoadTrqnsGain_pct@ */ /end MEASUREMENT
/begin MEASUREMENT VTQD_AWDLoadTrqnsGain_c "" FLOAT32_IEEE SWC_FDC_type_CM_single_c 0 0 0.0 1.5 ECU_ADDRESS 0x0000 /* @ECU_Address@VTQD_AWDLoadTrqnsGain_c@ */ /end MEASUREMENT
/begin MEASUREMENT VTQD_OrigRrDriverRatio_rat "" FLOAT32_IEEE SWC_FDC_type_CM_single_rat 0 0 0.0 1.0 ECU_ADDRESS 0x0000 /* @ECU_Address@VTQD_OrigRrDriverRatio_rat@ */ /end MEASUREMENT
/begin MEASUREMENT VTQD_CreepRrTqSpRat_rat "" FLOAT32_IEEE SWC_FDC_type_CM_single_rat 0 0 0.0 1.0 ECU_ADDRESS 0x0000 /* @ECU_Address@VTQD_CreepRrTqSpRat_rat@ */ /end MEASUREMENT
/begin MEASUREMENT VTQD_RrTqSRRateTs_c "" FLOAT32_IEEE SWC_FDC_type_CM_single_c 0 0 0.0 1.0 ECU_ADDRESS 0x0000 /* @ECU_Address@VTQD_RrTqSRRateTs_c@ */ /end MEASUREMENT
/begin MEASUREMENT VTQD_FrEDUSpRat_rat "" FLOAT32_IEEE SWC_FDC_type_CM_single_rat 0 0 0.0 1.0 ECU_ADDRESS 0x0000 /* @ECU_Address@VTQD_FrEDUSpRat_rat@ */ /end MEASUREMENT
/begin MEASUREMENT VTQD_RrEDUSpRat_rat "" FLOAT32_IEEE SWC_FDC_type_CM_single_rat 0 0 0.0 1.0 ECU_ADDRESS 0x0000 /* @ECU_Address@VTQD_RrEDUSpRat_rat@ */ /end MEASUREMENT
/begin MEASUREMENT VTQD_CoordTqDem_Nm "" FLOAT32_IEEE SWC_FDC_type_CM_single_Nm 0 0 -100000.0 100000.0 ECU_ADDRESS 0x0000 /* @ECU_Address@VTQD_CoordTqDem_Nm@ */ /end MEASUREMENT
/begin MEASUREMENT VTQD_CoordTqDemRr_Nm "" FLOAT32_IEEE SWC_FDC_type_CM_single_Nm 0 0 -100000.0 100000.0 ECU_ADDRESS 0x0000 /* @ECU_Address@VTQD_CoordTqDemRr_Nm@ */ /end MEASUREMENT
/begin MEASUREMENT VTQD_FrTCSCompensateTq_Nm "" FLOAT32_IEEE SWC_FDC_type_CM_single_Nm 0 0 -100000.0 100000.0 ECU_ADDRESS 0x0000 /* @ECU_Address@VTQD_FrTCSCompensateTq_Nm@ */ /end MEASUREMENT
/begin MEASUREMENT VTQD_CoordTqDemFr_Nm "" FLOAT32_IEEE SWC_FDC_type_CM_single_Nm 0 0 -100000.0 100000.0 ECU_ADDRESS 0x0000 /* @ECU_Address@VTQD_CoordTqDemFr_Nm@ */ /end MEASUREMENT
/begin MEASUREMENT VTQD_CoordWhlTqDemFr_Nm "" FLOAT32_IEEE SWC_FDC_type_CM_single_Nm 0 0 -100000.0 100000.0 ECU_ADDRESS 0x0000 /* @ECU_Address@VTQD_CoordWhlTqDemFr_Nm@ */ /end MEASUREMENT
/begin MEASUREMENT VTQD_RrTCSCompensateTq_Nm "" FLOAT32_IEEE SWC_FDC_type_CM_single_Nm 0 0 -100000.0 100000.0 ECU_ADDRESS 0x0000 /* @ECU_Address@VTQD_RrTCSCompensateTq_Nm@ */ /end MEASUREMENT
/begin MEASUREMENT VTQD_CoordWhlTqDemRr_Nm "" FLOAT32_IEEE SWC_FDC_type_CM_single_Nm 0 0 -100000.0 100000.0 ECU_ADDRESS 0x0000 /* @ECU_Address@VTQD_CoordWhlTqDemRr_Nm@ */ /end MEASUREMENT
/begin MEASUREMENT VTQD_FrAvailableTqUpLimt_Nm "" FLOAT32_IEEE SWC_FDC_type_CM_single_Nm 0 0 -100000.0 100000.0 ECU_ADDRESS 0x0000 /* @ECU_Address@VTQD_FrAvailableTqUpLimt_Nm@ */ /end MEASUREMENT
/begin MEASUREMENT VTQD_AfterTqMinGain_c "" FLOAT32_IEEE SWC_FDC_type_CM_single_c 0 0 0.0 1.0 ECU_ADDRESS 0x0000 /* @ECU_Address@VTQD_AfterTqMinGain_c@ */ /end MEASUREMENT
/begin MEASUREMENT VTQD_VehSpeed4Cal_kph "" FLOAT32_IEEE SWC_FDC_type_CM_single_kph 0 0 0.0 300.0 ECU_ADDRESS 0x0000 /* @ECU_Address@VTQD_VehSpeed4Cal_kph@ */ /end MEASUREMENT
/begin MEASUREMENT VTQD_LFSlideRate_pct "" FLOAT32_IEEE SWC_FDC_type_CM_single_pct 0 0 -125.0 125.0 ECU_ADDRESS 0x0000 /* @ECU_Address@VTQD_LFSlideRate_pct@ */ /end MEASUREMENT
/begin MEASUREMENT VTQD_RFSlideRate_pct "" FLOAT32_IEEE SWC_FDC_type_CM_single_pct 0 0 -125.0 125.0 ECU_ADDRESS 0x0000 /* @ECU_Address@VTQD_RFSlideRate_pct@ */ /end MEASUREMENT
/begin MEASUREMENT VTQD_FrontSlideRate_pct "" FLOAT32_IEEE SWC_FDC_type_CM_single_pct 0 0 -125.0 125.0 ECU_ADDRESS 0x0000 /* @ECU_Address@VTQD_FrontSlideRate_pct@ */ /end MEASUREMENT
/begin MEASUREMENT VTQD_AfterAvailableTqDemFr_Nm "" FLOAT32_IEEE SWC_FDC_type_CM_single_Nm 0 0 -100000.0 100000.0 ECU_ADDRESS 0x0000 /* @ECU_Address@VTQD_AfterAvailableTqDemFr_Nm@ */ /end MEASUREMENT
/begin MEASUREMENT VTQD_RrAvailableTqUpLimt_Nm "" FLOAT32_IEEE SWC_FDC_type_CM_single_Nm 0 0 -100000.0 100000.0 ECU_ADDRESS 0x0000 /* @ECU_Address@VTQD_RrAvailableTqUpLimt_Nm@ */ /end MEASUREMENT
/begin MEASUREMENT VTQD_LRSlideRate_pct "" FLOAT32_IEEE SWC_FDC_type_CM_single_pct 0 0 -125.0 125.0 ECU_ADDRESS 0x0000 /* @ECU_Address@VTQD_LRSlideRate_pct@ */ /end MEASUREMENT
/begin MEASUREMENT VTQD_RRSlideRate_pct "" FLOAT32_IEEE SWC_FDC_type_CM_single_pct 0 0 -125.0 125.0 ECU_ADDRESS 0x0000 /* @ECU_Address@VTQD_RRSlideRate_pct@ */ /end MEASUREMENT
/begin MEASUREMENT VTQD_RearSlideRate_pct "" FLOAT32_IEEE SWC_FDC_type_CM_single_pct 0 0 -125.0 125.0 ECU_ADDRESS 0x0000 /* @ECU_Address@VTQD_RearSlideRate_pct@ */ /end MEASUREMENT
/begin MEASUREMENT VTQD_AfterAvailableTqDemRr_Nm "" FLOAT32_IEEE SWC_FDC_type_CM_single_Nm 0 0 -100000.0 100000.0 ECU_ADDRESS 0x0000 /* @ECU_Address@VTQD_AfterAvailableTqDemRr_Nm@ */ /end MEASUREMENT
/begin MEASUREMENT VTQD_FrEDUAvailBrkRgnTq_Nm "" FLOAT32_IEEE SWC_FDC_type_CM_single_Nm 0 0 -100000.0 100000.0 ECU_ADDRESS 0x0000 /* @ECU_Address@VTQD_FrEDUAvailBrkRgnTq_Nm@ */ /end MEASUREMENT
/begin MEASUREMENT VTQD_RrEDUAvailBrkRgnTq_Nm "" FLOAT32_IEEE SWC_FDC_type_CM_single_Nm 0 0 -100000.0 100000.0 ECU_ADDRESS 0x0000 /* @ECU_Address@VTQD_RrEDUAvailBrkRgnTq_Nm@ */ /end MEASUREMENT
/begin MEASUREMENT VTQD_FrTMTqDeviation_c "" FLOAT32_IEEE SWC_FDC_type_CM_single_c 0 0 0.0 2.0 ECU_ADDRESS 0x0000 /* @ECU_Address@VTQD_FrTMTqDeviation_c@ */ /end MEASUREMENT
/begin MEASUREMENT VTQD_ActFrTMTqDeviation_c "" FLOAT32_IEEE SWC_FDC_type_CM_single_c 0 0 0.0 2.0 ECU_ADDRESS 0x0000 /* @ECU_Address@VTQD_ActFrTMTqDeviation_c@ */ /end MEASUREMENT
/begin MEASUREMENT VTQD_FrBRegenCal_Nm "" FLOAT32_IEEE SWC_FDC_type_CM_single_Nm 0 0 -100000.0 100000.0 ECU_ADDRESS 0x0000 /* @ECU_Address@VTQD_FrBRegenCal_Nm@ */ /end MEASUREMENT
/begin MEASUREMENT VTQD_FrEDUActTq_Nm "" FLOAT32_IEEE SWC_FDC_type_CM_single_Nm 0 0 -100000.0 100000.0 ECU_ADDRESS 0x0000 /* @ECU_Address@VTQD_FrEDUActTq_Nm@ */ /end MEASUREMENT
/begin MEASUREMENT VTQD_RrTMTqDeviation_c "" FLOAT32_IEEE SWC_FDC_type_CM_single_c 0 0 0.0 2.0 ECU_ADDRESS 0x0000 /* @ECU_Address@VTQD_RrTMTqDeviation_c@ */ /end MEASUREMENT
/begin MEASUREMENT VTQD_ActRrTMTqDeviation_c "" FLOAT32_IEEE SWC_FDC_type_CM_single_c 0 0 0.0 2.0 ECU_ADDRESS 0x0000 /* @ECU_Address@VTQD_ActRrTMTqDeviation_c@ */ /end MEASUREMENT
/begin MEASUREMENT VTQD_RrBRegenCal_Nm "" FLOAT32_IEEE SWC_FDC_type_CM_single_Nm 0 0 -100000.0 100000.0 ECU_ADDRESS 0x0000 /* @ECU_Address@VTQD_RrBRegenCal_Nm@ */ /end MEASUREMENT
/begin MEASUREMENT VTQD_RrEDUActTq_Nm "" FLOAT32_IEEE SWC_FDC_type_CM_single_Nm 0 0 -100000.0 100000.0 ECU_ADDRESS 0x0000 /* @ECU_Address@VTQD_RrEDUActTq_Nm@ */ /end MEASUREMENT
/begin MEASUREMENT VTQD_FrARgnTqDeviation_c "" FLOAT32_IEEE SWC_FDC_type_CM_single_c 0 0 0.0 2.0 ECU_ADDRESS 0x0000 /* @ECU_Address@VTQD_FrARgnTqDeviation_c@ */ /end MEASUREMENT
/begin MEASUREMENT VTQD_FrARegenCal_Nm "" FLOAT32_IEEE SWC_FDC_type_CM_single_Nm 0 0 -100000.0 100000.0 ECU_ADDRESS 0x0000 /* @ECU_Address@VTQD_FrARegenCal_Nm@ */ /end MEASUREMENT
/begin MEASUREMENT VTQD_FrEDURolRgnTq_Nm "" FLOAT32_IEEE SWC_FDC_type_CM_single_Nm 0 0 -100000.0 100000.0 ECU_ADDRESS 0x0000 /* @ECU_Address@VTQD_FrEDURolRgnTq_Nm@ */ /end MEASUREMENT
/begin MEASUREMENT VTQD_RrARgnTqDeviation_c "" FLOAT32_IEEE SWC_FDC_type_CM_single_c 0 0 0.0 2.0 ECU_ADDRESS 0x0000 /* @ECU_Address@VTQD_RrARgnTqDeviation_c@ */ /end MEASUREMENT
/begin MEASUREMENT VTQD_RrARegenCal_Nm "" FLOAT32_IEEE SWC_FDC_type_CM_single_Nm 0 0 -100000.0 100000.0 ECU_ADDRESS 0x0000 /* @ECU_Address@VTQD_RrARegenCal_Nm@ */ /end MEASUREMENT
/begin MEASUREMENT VTQD_RrEDURolRgnTq_Nm "" FLOAT32_IEEE SWC_FDC_type_CM_single_Nm 0 0 -100000.0 100000.0 ECU_ADDRESS 0x0000 /* @ECU_Address@VTQD_RrEDURolRgnTq_Nm@ */ /end MEASUREMENT
/begin MEASUREMENT VTQD_FrIdcMin_A "" FLOAT32_IEEE SWC_FDC_type_CM_single_A 0 0 -1022.0 0.0 ECU_ADDRESS 0x0000 /* @ECU_Address@VTQD_FrIdcMin_A@ */ /end MEASUREMENT
/begin MEASUREMENT VTQD_FrIdcMax_A "" FLOAT32_IEEE SWC_FDC_type_CM_single_A 0 0 0.0 1022.0 ECU_ADDRESS 0x0000 /* @ECU_Address@VTQD_FrIdcMax_A@ */ /end MEASUREMENT
/begin MEASUREMENT VTQD_FrUdcMin_V "" FLOAT32_IEEE SWC_FDC_type_CM_single_V 0 0 0.0 1022.0 ECU_ADDRESS 0x0000 /* @ECU_Address@VTQD_FrUdcMin_V@ */ /end MEASUREMENT
/begin MEASUREMENT VTQD_FrUdcMax_V "" FLOAT32_IEEE SWC_FDC_type_CM_single_V 0 0 0.0 1022.0 ECU_ADDRESS 0x0000 /* @ECU_Address@VTQD_FrUdcMax_V@ */ /end MEASUREMENT
/begin MEASUREMENT VTQD_RrIdcMin_A "" FLOAT32_IEEE SWC_FDC_type_CM_single_A 0 0 -1022.0 0.0 ECU_ADDRESS 0x0000 /* @ECU_Address@VTQD_RrIdcMin_A@ */ /end MEASUREMENT
/begin MEASUREMENT VTQD_RrIdcMax_A "" FLOAT32_IEEE SWC_FDC_type_CM_single_A 0 0 0.0 1022.0 ECU_ADDRESS 0x0000 /* @ECU_Address@VTQD_RrIdcMax_A@ */ /end MEASUREMENT
/begin MEASUREMENT VTQD_RrUdcMin_V "" FLOAT32_IEEE SWC_FDC_type_CM_single_V 0 0 0.0 1022.0 ECU_ADDRESS 0x0000 /* @ECU_Address@VTQD_RrUdcMin_V@ */ /end MEASUREMENT
/begin MEASUREMENT VTQD_RrUdcMax_V "" FLOAT32_IEEE SWC_FDC_type_CM_single_V 0 0 0.0 1022.0 ECU_ADDRESS 0x0000 /* @ECU_Address@VTQD_RrUdcMax_V@ */ /end MEASUREMENT
/begin MEASUREMENT VTQD_MaxWhlSlideRate_pct "" FLOAT32_IEEE SWC_FDC_type_CM_single_pct 0 0 -125.0 125.0 ECU_ADDRESS 0x0000 /* @ECU_Address@VTQD_MaxWhlSlideRate_pct@ */ /end MEASUREMENT
/begin MEASUREMENT VTQD_MinWhlSlideRate_pct "" FLOAT32_IEEE SWC_FDC_type_CM_single_pct 0 0 -125.0 125.0 ECU_ADDRESS 0x0000 /* @ECU_Address@VTQD_MinWhlSlideRate_pct@ */ /end MEASUREMENT
/begin MEASUREMENT VTQD_LeftSlideRate_pct "" FLOAT32_IEEE SWC_FDC_type_CM_single_pct 0 0 -125.0 125.0 ECU_ADDRESS 0x0000 /* @ECU_Address@VTQD_LeftSlideRate_pct@ */ /end MEASUREMENT
/begin MEASUREMENT VTQD_RightSlideRate_pct "" FLOAT32_IEEE SWC_FDC_type_CM_single_pct 0 0 -125.0 125.0 ECU_ADDRESS 0x0000 /* @ECU_Address@VTQD_RightSlideRate_pct@ */ /end MEASUREMENT
/begin MEASUREMENT VTQD_FrMotorPwr_W "" FLOAT32_IEEE SWC_FDC_type_CM_single_W 0 0 -200000.0 200000.0 ECU_ADDRESS 0x0000 /* @ECU_Address@VTQD_FrMotorPwr_W@ */ /end MEASUREMENT
/begin MEASUREMENT VTQD_RrMotorPwr_W "" FLOAT32_IEEE SWC_FDC_type_CM_single_W 0 0 -200000.0 200000.0 ECU_ADDRESS 0x0000 /* @ECU_Address@VTQD_RrMotorPwr_W@ */ /end MEASUREMENT
/begin MEASUREMENT VTQD_SysMotorPower_pct "" FLOAT32_IEEE SWC_FDC_type_CM_single_pct 0 0 -125.0 125.0 ECU_ADDRESS 0x0000 /* @ECU_Address@VTQD_SysMotorPower_pct@ */ /end MEASUREMENT
/begin MEASUREMENT VTQD_SysMotorTorque_pct "" FLOAT32_IEEE SWC_FDC_type_CM_single_pct 0 0 -125.0 125.0 ECU_ADDRESS 0x0000 /* @ECU_Address@VTQD_SysMotorTorque_pct@ */ /end MEASUREMENT
/begin MEASUREMENT VTQD_SysMotorPerform_pct "" FLOAT32_IEEE SWC_FDC_type_CM_single_pct 0 0 -125.0 125.0 ECU_ADDRESS 0x0000 /* @ECU_Address@VTQD_SysMotorPerform_pct@ */ /end MEASUREMENT
/begin MEASUREMENT VTQD_SimSouWaveCMD_pct "" FLOAT32_IEEE SWC_FDC_type_CM_single_pct 0 0 -125.0 125.0 ECU_ADDRESS 0x0000 /* @ECU_Address@VTQD_SimSouWaveCMD_pct@ */ /end MEASUREMENT
/begin MEASUREMENT VTQD_CalMeterSpeed_kph "" FLOAT32_IEEE SWC_FDC_type_CM_single_kph 0 0 0.0 300.0 ECU_ADDRESS 0x0000 /* @ECU_Address@VTQD_CalMeterSpeed_kph@ */ /end MEASUREMENT
/begin MEASUREMENT VTQD_SpdLim4SetSpd_raw32 "" FLOAT32_IEEE SWC_FDC_type_CM_single_raw32 0 0 0.0 254.0 ECU_ADDRESS 0x0000 /* @ECU_Address@VTQD_SpdLim4SetSpd_raw32@ */ /end MEASUREMENT
/begin MEASUREMENT VVMC_AccFSSlect_enum "" UWORD SWC_FDC_type_CM_uint16_enum 0 0 0.0 65535.0 ECU_ADDRESS 0x0000 /* @ECU_Address@VVMC_AccFSSlect_enum@ */ /end MEASUREMENT
/begin MEASUREMENT VVMC_AccFSCalSet_enum "" UWORD SWC_FDC_type_CM_uint16_enum 0 0 0.0 65535.0 ECU_ADDRESS 0x0000 /* @ECU_Address@VVMC_AccFSCalSet_enum@ */ /end MEASUREMENT
/begin MEASUREMENT VVMC_GyroFSSlect_enum "" UWORD SWC_FDC_type_CM_uint16_enum 0 0 0.0 65535.0 ECU_ADDRESS 0x0000 /* @ECU_Address@VVMC_GyroFSSlect_enum@ */ /end MEASUREMENT
/begin MEASUREMENT VVMC_GyroFSCalSet_enum "" UWORD SWC_FDC_type_CM_uint16_enum 0 0 0.0 65535.0 ECU_ADDRESS 0x0000 /* @ECU_Address@VVMC_GyroFSCalSet_enum@ */ /end MEASUREMENT
/begin MEASUREMENT VTPM_Flashchkdatavalid_enum "" UBYTE SWC_FDC_type_CM_uint8_enum 0 0 0.0 255.0 ECU_ADDRESS 0x0000 /* @ECU_Address@VTPM_Flashchkdatavalid_enum@ */ /end MEASUREMENT
/begin MEASUREMENT VTPM_Flashdatavalid_enum "" UBYTE SWC_FDC_type_CM_uint8_enum 0 0 0.0 255.0 ECU_ADDRESS 0x0000 /* @ECU_Address@VTPM_Flashdatavalid_enum@ */ /end MEASUREMENT
/begin MEASUREMENT VTPM_ModelVersion_raw "" UBYTE SWC_FDC_type_CM_uint8_raw 0 0 0.0 255.0 ECU_ADDRESS 0x0000 /* @ECU_Address@VTPM_ModelVersion_raw@ */ /end MEASUREMENT
/begin MEASUREMENT VTPM_ModelVersionChksum_raw "" UBYTE SWC_FDC_type_CM_uint8_raw 0 0 0.0 255.0 ECU_ADDRESS 0x0000 /* @ECU_Address@VTPM_ModelVersionChksum_raw@ */ /end MEASUREMENT
/begin MEASUREMENT VTHC_FDEWP1Cmd_enum "" UBYTE SWC_FDC_type_CM_uint8_enum 0 0 0.0 255.0 ECU_ADDRESS 0x0000 /* @ECU_Address@VTHC_FDEWP1Cmd_enum@ */ /end MEASUREMENT
/begin MEASUREMENT VTHC_FDEWP2Cmd_enum "" UBYTE SWC_FDC_type_CM_uint8_enum 0 0 0.0 255.0 ECU_ADDRESS 0x0000 /* @ECU_Address@VTHC_FDEWP2Cmd_enum@ */ /end MEASUREMENT
/begin MEASUREMENT VTHC_FDEWP3Cmd_enum "" UBYTE SWC_FDC_type_CM_uint8_enum 0 0 0.0 255.0 ECU_ADDRESS 0x0000 /* @ECU_Address@VTHC_FDEWP3Cmd_enum@ */ /end MEASUREMENT
/begin MEASUREMENT VVMC_IntMSACtrlSta_enum "" UBYTE SWC_FDC_type_CM_uint8_enum 0 0 0.0 8.0 ECU_ADDRESS 0x0000 /* @ECU_Address@VVMC_IntMSACtrlSta_enum@ */ /end MEASUREMENT
/begin MEASUREMENT VVMC_CCCtrlSta_enum "" UBYTE SWC_FDC_type_CM_uint8_enum 0 0 0.0 7.0 ECU_ADDRESS 0x0000 /* @ECU_Address@VVMC_CCCtrlSta_enum@ */ /end MEASUREMENT
/begin MEASUREMENT VVMC_VehHoldDeltaAccSta_enum "" UBYTE SWC_FDC_type_CM_uint8_enum 0 0 0.0 2.0 ECU_ADDRESS 0x0000 /* @ECU_Address@VVMC_VehHoldDeltaAccSta_enum@ */ /end MEASUREMENT
/begin MEASUREMENT VVMC_FeatArbitrFinal_enum "" UBYTE SWC_FDC_type_CM_uint8_enum 0 0 0.0 6.0 ECU_ADDRESS 0x0000 /* @ECU_Address@VVMC_FeatArbitrFinal_enum@ */ /end MEASUREMENT
/begin MEASUREMENT VVMC_APSShiftPosnReq_enum "" UBYTE SWC_FDC_type_CM_uint8_enum 0 0 0.0 15.0 ECU_ADDRESS 0x0000 /* @ECU_Address@VVMC_APSShiftPosnReq_enum@ */ /end MEASUREMENT
/begin MEASUREMENT VVMC_AltRDCActive_enum "" UBYTE SWC_FDC_type_CM_uint8_enum 0 0 0.0 15.0 ECU_ADDRESS 0x0000 /* @ECU_Address@VVMC_AltRDCActive_enum@ */ /end MEASUREMENT
/begin MEASUREMENT VVMC_RWDRDCActive_enum "" UBYTE SWC_FDC_type_CM_uint8_enum 0 0 0.0 2.0 ECU_ADDRESS 0x0000 /* @ECU_Address@VVMC_RWDRDCActive_enum@ */ /end MEASUREMENT
/begin MEASUREMENT VTQR_EVDriveMode_enum "" UBYTE SWC_FDC_type_CM_uint8_enum 0 0 0.0 15.0 ECU_ADDRESS 0x0000 /* @ECU_Address@VTQR_EVDriveMode_enum@ */ /end MEASUREMENT
/begin MEASUREMENT VTQD_GearShiftCMD_enum "" UBYTE SWC_FDC_type_CM_uint8_enum 0 0 0.0 7.0 ECU_ADDRESS 0x0000 /* @ECU_Address@VTQD_GearShiftCMD_enum@ */ /end MEASUREMENT
/begin MEASUREMENT VTQD_RegenSWSta_enum "" UBYTE SWC_FDC_type_CM_uint8_enum 0 0 0.0 4.0 ECU_ADDRESS 0x0000 /* @ECU_Address@VTQD_RegenSWSta_enum@ */ /end MEASUREMENT
/begin MEASUREMENT VTQD_ActWhlSkipSta_enum "" UBYTE SWC_FDC_type_CM_uint8_enum 0 0 0.0 15.0 ECU_ADDRESS 0x0000 /* @ECU_Address@VTQD_ActWhlSkipSta_enum@ */ /end MEASUREMENT
/begin MEASUREMENT VTQD_SkipDirect_enum "" UBYTE SWC_FDC_type_CM_uint8_enum 0 0 0.0 15.0 ECU_ADDRESS 0x0000 /* @ECU_Address@VTQD_SkipDirect_enum@ */ /end MEASUREMENT
/begin MEASUREMENT VTQD_TqSource_enum "" UBYTE SWC_FDC_type_CM_uint8_enum 0 0 0.0 15.0 ECU_ADDRESS 0x0000 /* @ECU_Address@VTQD_TqSource_enum@ */ /end MEASUREMENT
/begin MEASUREMENT VTQD_TqSourceFr_enum "" UBYTE SWC_FDC_type_CM_uint8_enum 0 0 0.0 9.0 ECU_ADDRESS 0x0000 /* @ECU_Address@VTQD_TqSourceFr_enum@ */ /end MEASUREMENT
/begin MEASUREMENT VTQD_TqSourceRr_enum "" UBYTE SWC_FDC_type_CM_uint8_enum 0 0 0.0 9.0 ECU_ADDRESS 0x0000 /* @ECU_Address@VTQD_TqSourceRr_enum@ */ /end MEASUREMENT
/begin MEASUREMENT VTQD_PButtonSta_enum "" UBYTE SWC_FDC_type_CM_uint8_enum 0 0 0.0 2.0 ECU_ADDRESS 0x0000 /* @ECU_Address@VTQD_PButtonSta_enum@ */ /end MEASUREMENT
/begin MEASUREMENT VTQD_WhlSkipSta_enum "" UBYTE SWC_FDC_type_CM_uint8_enum 0 0 0.0 15.0 ECU_ADDRESS 0x0000 /* @ECU_Address@VTQD_WhlSkipSta_enum@ */ /end MEASUREMENT
/begin MEASUREMENT VTHC_FDSOV1Cmd_flg "" UBYTE SWC_FDC_type_CM_boolean_flg 0 0 0.0 1.0 ECU_ADDRESS 0x0000 /* @ECU_Address@VTHC_FDSOV1Cmd_flg@ */ /end MEASUREMENT
/begin MEASUREMENT VTHC_FDSOV2Cmd_flg "" UBYTE SWC_FDC_type_CM_boolean_flg 0 0 0.0 1.0 ECU_ADDRESS 0x0000 /* @ECU_Address@VTHC_FDSOV2Cmd_flg@ */ /end MEASUREMENT
/begin MEASUREMENT VTHC_FDSOV3Cmd_flg "" UBYTE SWC_FDC_type_CM_boolean_flg 0 0 0.0 1.0 ECU_ADDRESS 0x0000 /* @ECU_Address@VTHC_FDSOV3Cmd_flg@ */ /end MEASUREMENT
/begin MEASUREMENT VTHC_FDFWVCmd_flg "" UBYTE SWC_FDC_type_CM_boolean_flg 0 0 0.0 1.0 ECU_ADDRESS 0x0000 /* @ECU_Address@VTHC_FDFWVCmd_flg@ */ /end MEASUREMENT
/begin MEASUREMENT VVMC_ACCCtrlAllow_flg "" UBYTE SWC_FDC_type_CM_boolean_flg 0 0 0.0 1.0 ECU_ADDRESS 0x0000 /* @ECU_Address@VVMC_ACCCtrlAllow_flg@ */ /end MEASUREMENT
/begin MEASUREMENT VVMC_ACCCtrlAvail_flg "" UBYTE SWC_FDC_type_CM_boolean_flg 0 0 0.0 1.0 ECU_ADDRESS 0x0000 /* @ECU_Address@VVMC_ACCCtrlAvail_flg@ */ /end MEASUREMENT
/begin MEASUREMENT VVMC_HoodSpdLimitEn_flg "" UBYTE SWC_FDC_type_CM_boolean_flg 0 0 0.0 1.0 ECU_ADDRESS 0x0000 /* @ECU_Address@VVMC_HoodSpdLimitEn_flg@ */ /end MEASUREMENT
/begin MEASUREMENT VVMC_APSCtrlAvail_flg "" UBYTE SWC_FDC_type_CM_boolean_flg 0 0 0.0 1.0 ECU_ADDRESS 0x0000 /* @ECU_Address@VVMC_APSCtrlAvail_flg@ */ /end MEASUREMENT
/begin MEASUREMENT VVMC_APSActive_flg "" UBYTE SWC_FDC_type_CM_boolean_flg 0 0 0.0 1.0 ECU_ADDRESS 0x0000 /* @ECU_Address@VVMC_APSActive_flg@ */ /end MEASUREMENT
/begin MEASUREMENT VVMC_SmartEcoEn_flg "" UBYTE SWC_FDC_type_CM_boolean_flg 0 0 0.0 1.0 ECU_ADDRESS 0x0000 /* @ECU_Address@VVMC_SmartEcoEn_flg@ */ /end MEASUREMENT
/begin MEASUREMENT VVMC_AntiSpdLimEn_flg "" UBYTE SWC_FDC_type_CM_boolean_flg 0 0 0.0 1.0 ECU_ADDRESS 0x0000 /* @ECU_Address@VVMC_AntiSpdLimEn_flg@ */ /end MEASUREMENT
/begin MEASUREMENT VVMC_AntiSpdLimSpdEn_flg "" UBYTE SWC_FDC_type_CM_boolean_flg 0 0 0.0 1.0 ECU_ADDRESS 0x0000 /* @ECU_Address@VVMC_AntiSpdLimSpdEn_flg@ */ /end MEASUREMENT
/begin MEASUREMENT VVMC_AntiSpdLimStaEn_flg "" UBYTE SWC_FDC_type_CM_boolean_flg 0 0 0.0 1.0 ECU_ADDRESS 0x0000 /* @ECU_Address@VVMC_AntiSpdLimStaEn_flg@ */ /end MEASUREMENT
/begin MEASUREMENT VVMC_DISCDecCtrl_flg "" UBYTE SWC_FDC_type_CM_boolean_flg 0 0 0.0 1.0 ECU_ADDRESS 0x0000 /* @ECU_Address@VVMC_DISCDecCtrl_flg@ */ /end MEASUREMENT
/begin MEASUREMENT VVMC_WhlStandstill_flg "" UBYTE SWC_FDC_type_CM_boolean_flg 0 0 0.0 1.0 ECU_ADDRESS 0x0000 /* @ECU_Address@VVMC_WhlStandstill_flg@ */ /end MEASUREMENT
/begin MEASUREMENT VVMC_WhlBackward_flg "" UBYTE SWC_FDC_type_CM_boolean_flg 0 0 0.0 1.0 ECU_ADDRESS 0x0000 /* @ECU_Address@VVMC_WhlBackward_flg@ */ /end MEASUREMENT
/begin MEASUREMENT VVMC_AccelTurnHoldDet_flg "" UBYTE SWC_FDC_type_CM_boolean_flg 0 0 0.0 1.0 ECU_ADDRESS 0x0000 /* @ECU_Address@VVMC_AccelTurnHoldDet_flg@ */ /end MEASUREMENT
/begin MEASUREMENT VVMC_AccAct_flg "" UBYTE SWC_FDC_type_CM_boolean_flg 0 0 0.0 1.0 ECU_ADDRESS 0x0000 /* @ECU_Address@VVMC_AccAct_flg@ */ /end MEASUREMENT
/begin MEASUREMENT VVMC_AbsDeltaSpdNotZero_flg "" UBYTE SWC_FDC_type_CM_boolean_flg 0 0 0.0 1.0 ECU_ADDRESS 0x0000 /* @ECU_Address@VVMC_AbsDeltaSpdNotZero_flg@ */ /end MEASUREMENT
/begin MEASUREMENT VVMC_ADASWhlTqReachLim_flg "" UBYTE SWC_FDC_type_CM_boolean_flg 0 0 0.0 1.0 ECU_ADDRESS 0x0000 /* @ECU_Address@VVMC_ADASWhlTqReachLim_flg@ */ /end MEASUREMENT
/begin MEASUREMENT VVMC_ReqAccelActive_flg "" UBYTE SWC_FDC_type_CM_boolean_flg 0 0 0.0 1.0 ECU_ADDRESS 0x0000 /* @ECU_Address@VVMC_ReqAccelActive_flg@ */ /end MEASUREMENT
/begin MEASUREMENT VVMC_OVRDAccCtrl_flg "" UBYTE SWC_FDC_type_CM_boolean_flg 0 0 0.0 1.0 ECU_ADDRESS 0x0000 /* @ECU_Address@VVMC_OVRDAccCtrl_flg@ */ /end MEASUREMENT
/begin MEASUREMENT VVMC_ADASActive_flg "" UBYTE SWC_FDC_type_CM_boolean_flg 0 0 0.0 1.0 ECU_ADDRESS 0x0000 /* @ECU_Address@VVMC_ADASActive_flg@ */ /end MEASUREMENT
/begin MEASUREMENT VVMC_MCPreBaseTqEn_flg "" UBYTE SWC_FDC_type_CM_boolean_flg 0 0 0.0 1.0 ECU_ADDRESS 0x0000 /* @ECU_Address@VVMC_MCPreBaseTqEn_flg@ */ /end MEASUREMENT
/begin MEASUREMENT VVMC_ADASNegReq_flg "" UBYTE SWC_FDC_type_CM_boolean_flg 0 0 0.0 1.0 ECU_ADDRESS 0x0000 /* @ECU_Address@VVMC_ADASNegReq_flg@ */ /end MEASUREMENT
/begin MEASUREMENT VVMC_ACCVehHoldReq_flg "" UBYTE SWC_FDC_type_CM_boolean_flg 0 0 0.0 1.0 ECU_ADDRESS 0x0000 /* @ECU_Address@VVMC_ACCVehHoldReq_flg@ */ /end MEASUREMENT
/begin MEASUREMENT VVMC_ACCPedalOvrd_flg "" UBYTE SWC_FDC_type_CM_boolean_flg 0 0 0.0 1.0 ECU_ADDRESS 0x0000 /* @ECU_Address@VVMC_ACCPedalOvrd_flg@ */ /end MEASUREMENT
/begin MEASUREMENT VVMC_AccPedalOvrdDISC_flg "" UBYTE SWC_FDC_type_CM_boolean_flg 0 0 0.0 1.0 ECU_ADDRESS 0x0000 /* @ECU_Address@VVMC_AccPedalOvrdDISC_flg@ */ /end MEASUREMENT
/begin MEASUREMENT VVMC_CruzActive_flg "" UBYTE SWC_FDC_type_CM_boolean_flg 0 0 0.0 1.0 ECU_ADDRESS 0x0000 /* @ECU_Address@VVMC_CruzActive_flg@ */ /end MEASUREMENT
/begin MEASUREMENT VVMC_IntMSAActive_flg "" UBYTE SWC_FDC_type_CM_boolean_flg 0 0 0.0 1.0 ECU_ADDRESS 0x0000 /* @ECU_Address@VVMC_IntMSAActive_flg@ */ /end MEASUREMENT
/begin MEASUREMENT VVMC_MSAOvrdProhibit_flg "" UBYTE SWC_FDC_type_CM_boolean_flg 0 0 0.0 1.0 ECU_ADDRESS 0x0000 /* @ECU_Address@VVMC_MSAOvrdProhibit_flg@ */ /end MEASUREMENT
/begin MEASUREMENT VVMC_MSAInCtrlSpd_flg "" UBYTE SWC_FDC_type_CM_boolean_flg 0 0 0.0 1.0 ECU_ADDRESS 0x0000 /* @ECU_Address@VVMC_MSAInCtrlSpd_flg@ */ /end MEASUREMENT
/begin MEASUREMENT VVMC_CCPedalOvrd_flg "" UBYTE SWC_FDC_type_CM_boolean_flg 0 0 0.0 1.0 ECU_ADDRESS 0x0000 /* @ECU_Address@VVMC_CCPedalOvrd_flg@ */ /end MEASUREMENT
/begin MEASUREMENT VVMC_APSEnCMD_flg "" UBYTE SWC_FDC_type_CM_boolean_flg 0 0 0.0 1.0 ECU_ADDRESS 0x0000 /* @ECU_Address@VVMC_APSEnCMD_flg@ */ /end MEASUREMENT
/begin MEASUREMENT VVMC_CAASActive_flg "" UBYTE SWC_FDC_type_CM_boolean_flg 0 0 0.0 1.0 ECU_ADDRESS 0x0000 /* @ECU_Address@VVMC_CAASActive_flg@ */ /end MEASUREMENT
/begin MEASUREMENT VVMC_AllowSetSpd_flg "" UBYTE SWC_FDC_type_CM_boolean_flg 0 0 0.0 1.0 ECU_ADDRESS 0x0000 /* @ECU_Address@VVMC_AllowSetSpd_flg@ */ /end MEASUREMENT
/begin MEASUREMENT VVMC_SetACCDisableAPS_flg "" UBYTE SWC_FDC_type_CM_boolean_flg 0 0 0.0 1.0 ECU_ADDRESS 0x0000 /* @ECU_Address@VVMC_SetACCDisableAPS_flg@ */ /end MEASUREMENT
/begin MEASUREMENT VVMC_CCSpdWar_flg "" UBYTE SWC_FDC_type_CM_boolean_flg 0 0 0.0 1.0 ECU_ADDRESS 0x0000 /* @ECU_Address@VVMC_CCSpdWar_flg@ */ /end MEASUREMENT
/begin MEASUREMENT VVMC_IntMSASpdWar_flg "" UBYTE SWC_FDC_type_CM_boolean_flg 0 0 0.0 1.0 ECU_ADDRESS 0x0000 /* @ECU_Address@VVMC_IntMSASpdWar_flg@ */ /end MEASUREMENT
/begin MEASUREMENT VVMC_ESCSlip_flg "" UBYTE SWC_FDC_type_CM_boolean_flg 0 0 0.0 1.0 ECU_ADDRESS 0x0000 /* @ECU_Address@VVMC_ESCSlip_flg@ */ /end MEASUREMENT
/begin MEASUREMENT VVMC_MSAWhlTqActive_flg "" UBYTE SWC_FDC_type_CM_boolean_flg 0 0 0.0 1.0 ECU_ADDRESS 0x0000 /* @ECU_Address@VVMC_MSAWhlTqActive_flg@ */ /end MEASUREMENT
/begin MEASUREMENT VVMC_TimeGapJudge_flag "" UBYTE SWC_FDC_type_CM_boolean_flag 0 0 0.0 1.0 ECU_ADDRESS 0x0000 /* @ECU_Address@VVMC_TimeGapJudge_flag@ */ /end MEASUREMENT
/begin MEASUREMENT VTQR_FrRampEnable_flg "" UBYTE SWC_FDC_type_CM_boolean_flg 0 0 0.0 1.0 ECU_ADDRESS 0x0000 /* @ECU_Address@VTQR_FrRampEnable_flg@ */ /end MEASUREMENT
/begin MEASUREMENT VTQR_RrRampEnable_flg "" UBYTE SWC_FDC_type_CM_boolean_flg 0 0 0.0 1.0 ECU_ADDRESS 0x0000 /* @ECU_Address@VTQR_RrRampEnable_flg@ */ /end MEASUREMENT
/begin MEASUREMENT VTQR_LaunchEn_flg "" UBYTE SWC_FDC_type_CM_boolean_flg 0 0 0.0 1.0 ECU_ADDRESS 0x0000 /* @ECU_Address@VTQR_LaunchEn_flg@ */ /end MEASUREMENT
/begin MEASUREMENT VTQD_ForceP_flg "" UBYTE SWC_FDC_type_CM_boolean_flg 0 0 0.0 1.0 ECU_ADDRESS 0x0000 /* @ECU_Address@VTQD_ForceP_flg@ */ /end MEASUREMENT
/begin MEASUREMENT VTQD_PBWLockTO_flg "" UBYTE SWC_FDC_type_CM_boolean_flg 0 0 0.0 1.0 ECU_ADDRESS 0x0000 /* @ECU_Address@VTQD_PBWLockTO_flg@ */ /end MEASUREMENT
/begin MEASUREMENT VTQD_PBWUnlockTO_flg "" UBYTE SWC_FDC_type_CM_boolean_flg 0 0 0.0 1.0 ECU_ADDRESS 0x0000 /* @ECU_Address@VTQD_PBWUnlockTO_flg@ */ /end MEASUREMENT
/begin MEASUREMENT VTQD_RegenModeChange_flg "" UBYTE SWC_FDC_type_CM_boolean_flg 0 0 0.0 1.0 ECU_ADDRESS 0x0000 /* @ECU_Address@VTQD_RegenModeChange_flg@ */ /end MEASUREMENT
/begin MEASUREMENT VTQD_LFWhlQuickSkip_flg "" UBYTE SWC_FDC_type_CM_boolean_flg 0 0 0.0 1.0 ECU_ADDRESS 0x0000 /* @ECU_Address@VTQD_LFWhlQuickSkip_flg@ */ /end MEASUREMENT
/begin MEASUREMENT VTQD_LRWhlQuickSkip_flg "" UBYTE SWC_FDC_type_CM_boolean_flg 0 0 0.0 1.0 ECU_ADDRESS 0x0000 /* @ECU_Address@VTQD_LRWhlQuickSkip_flg@ */ /end MEASUREMENT
/begin MEASUREMENT VTQD_RFWhlQuickSkip_flg "" UBYTE SWC_FDC_type_CM_boolean_flg 0 0 0.0 1.0 ECU_ADDRESS 0x0000 /* @ECU_Address@VTQD_RFWhlQuickSkip_flg@ */ /end MEASUREMENT
/begin MEASUREMENT VTQD_RRWhlQuickSkip_flg "" UBYTE SWC_FDC_type_CM_boolean_flg 0 0 0.0 1.0 ECU_ADDRESS 0x0000 /* @ECU_Address@VTQD_RRWhlQuickSkip_flg@ */ /end MEASUREMENT
/begin MEASUREMENT VTQD_AllWhlStable_flg "" UBYTE SWC_FDC_type_CM_boolean_flg 0 0 0.0 1.0 ECU_ADDRESS 0x0000 /* @ECU_Address@VTQD_AllWhlStable_flg@ */ /end MEASUREMENT
/begin MEASUREMENT VTQD_LeftRightWhlSkip_flg "" UBYTE SWC_FDC_type_CM_boolean_flg 0 0 0.0 1.0 ECU_ADDRESS 0x0000 /* @ECU_Address@VTQD_LeftRightWhlSkip_flg@ */ /end MEASUREMENT
/begin MEASUREMENT VTQD_LeftWhlSkip_flg "" UBYTE SWC_FDC_type_CM_boolean_flg 0 0 0.0 1.0 ECU_ADDRESS 0x0000 /* @ECU_Address@VTQD_LeftWhlSkip_flg@ */ /end MEASUREMENT
/begin MEASUREMENT VTQD_RightWhlSkip_flg "" UBYTE SWC_FDC_type_CM_boolean_flg 0 0 0.0 1.0 ECU_ADDRESS 0x0000 /* @ECU_Address@VTQD_RightWhlSkip_flg@ */ /end MEASUREMENT
/begin MEASUREMENT VTQD_FrontRearWhlSkip_flg "" UBYTE SWC_FDC_type_CM_boolean_flg 0 0 0.0 1.0 ECU_ADDRESS 0x0000 /* @ECU_Address@VTQD_FrontRearWhlSkip_flg@ */ /end MEASUREMENT
/begin MEASUREMENT VTQD_FrontWhlSkip_flg "" UBYTE SWC_FDC_type_CM_boolean_flg 0 0 0.0 1.0 ECU_ADDRESS 0x0000 /* @ECU_Address@VTQD_FrontWhlSkip_flg@ */ /end MEASUREMENT
/begin MEASUREMENT VTQD_RearWhlSkip_flg "" UBYTE SWC_FDC_type_CM_boolean_flg 0 0 0.0 1.0 ECU_ADDRESS 0x0000 /* @ECU_Address@VTQD_RearWhlSkip_flg@ */ /end MEASUREMENT
/begin MEASUREMENT VTQD_DiagonalWhlSkip_flg "" UBYTE SWC_FDC_type_CM_boolean_flg 0 0 0.0 1.0 ECU_ADDRESS 0x0000 /* @ECU_Address@VTQD_DiagonalWhlSkip_flg@ */ /end MEASUREMENT
/begin MEASUREMENT VTQD_LFRRWhlSkip_flg "" UBYTE SWC_FDC_type_CM_boolean_flg 0 0 0.0 1.0 ECU_ADDRESS 0x0000 /* @ECU_Address@VTQD_LFRRWhlSkip_flg@ */ /end MEASUREMENT
/begin MEASUREMENT VTQD_RFLRWhlSkip_flg "" UBYTE SWC_FDC_type_CM_boolean_flg 0 0 0.0 1.0 ECU_ADDRESS 0x0000 /* @ECU_Address@VTQD_RFLRWhlSkip_flg@ */ /end MEASUREMENT
/begin MEASUREMENT VTQD_NoSuitbleGear_flg "" UBYTE SWC_FDC_type_CM_boolean_flg 0 0 0.0 1.0 ECU_ADDRESS 0x0000 /* @ECU_Address@VTQD_NoSuitbleGear_flg@ */ /end MEASUREMENT
/begin MEASUREMENT VTQD_ARegenActive_flg "" UBYTE SWC_FDC_type_CM_boolean_flg 0 0 0.0 1.0 ECU_ADDRESS 0x0000 /* @ECU_Address@VTQD_ARegenActive_flg@ */ /end MEASUREMENT
/begin MEASUREMENT VTQD_FrRgnDecrSta_flg "" UBYTE SWC_FDC_type_CM_boolean_flg 0 0 0.0 1.0 ECU_ADDRESS 0x0000 /* @ECU_Address@VTQD_FrRgnDecrSta_flg@ */ /end MEASUREMENT
/begin MEASUREMENT VTQD_RrRgnDecrSta_flg "" UBYTE SWC_FDC_type_CM_boolean_flg 0 0 0.0 1.0 ECU_ADDRESS 0x0000 /* @ECU_Address@VTQD_RrRgnDecrSta_flg@ */ /end MEASUREMENT
/begin MEASUREMENT VTQD_FrWhlTqDemNeg_flg "" UBYTE SWC_FDC_type_CM_boolean_flg 0 0 0.0 1.0 ECU_ADDRESS 0x0000 /* @ECU_Address@VTQD_FrWhlTqDemNeg_flg@ */ /end MEASUREMENT
/begin MEASUREMENT VTQD_RrWhlTqDemNeg_flg "" UBYTE SWC_FDC_type_CM_boolean_flg 0 0 0.0 1.0 ECU_ADDRESS 0x0000 /* @ECU_Address@VTQD_RrWhlTqDemNeg_flg@ */ /end MEASUREMENT
/begin MEASUREMENT VTQD_RgnAbnorSta_flg "" UBYTE SWC_FDC_type_CM_boolean_flg 0 0 0.0 1.0 ECU_ADDRESS 0x0000 /* @ECU_Address@VTQD_RgnAbnorSta_flg@ */ /end MEASUREMENT
/begin MEASUREMENT VTQD_PTCSPermSta_flg "" UBYTE SWC_FDC_type_CM_boolean_flg 0 0 0.0 1.0 ECU_ADDRESS 0x0000 /* @ECU_Address@VTQD_PTCSPermSta_flg@ */ /end MEASUREMENT
/begin MEASUREMENT VTQD_FrRgnPermSta_flg "" UBYTE SWC_FDC_type_CM_boolean_flg 0 0 0.0 1.0 ECU_ADDRESS 0x0000 /* @ECU_Address@VTQD_FrRgnPermSta_flg@ */ /end MEASUREMENT
/begin MEASUREMENT VTQD_RrRgnPermSta_flg "" UBYTE SWC_FDC_type_CM_boolean_flg 0 0 0.0 1.0 ECU_ADDRESS 0x0000 /* @ECU_Address@VTQD_RrRgnPermSta_flg@ */ /end MEASUREMENT
/begin MEASUREMENT VTQD_ExternalTqAllow_flg "" UBYTE SWC_FDC_type_CM_boolean_flg 0 0 0.0 1.0 ECU_ADDRESS 0x0000 /* @ECU_Address@VTQD_ExternalTqAllow_flg@ */ /end MEASUREMENT
/begin MEASUREMENT VTQD_DiagHCrash_flg "" UBYTE SWC_FDC_type_CM_boolean_flg 0 0 0.0 1.0 ECU_ADDRESS 0x0000 /* @ECU_Address@VTQD_DiagHCrash_flg@ */ /end MEASUREMENT
/begin MEASUREMENT VTQD_ReBrakeLPReq_flg "" UBYTE SWC_FDC_type_CM_boolean_flg 0 0 0.0 1.0 ECU_ADDRESS 0x0000 /* @ECU_Address@VTQD_ReBrakeLPReq_flg@ */ /end MEASUREMENT
/begin MEASUREMENT VTQD_ExtShftAllow_flg "" UBYTE SWC_FDC_type_CM_boolean_flg 0 0 0.0 1.0 ECU_ADDRESS 0x0000 /* @ECU_Address@VTQD_ExtShftAllow_flg@ */ /end MEASUREMENT
/begin MEASUREMENT VTQD_ExtDoorAllow_flg "" UBYTE SWC_FDC_type_CM_boolean_flg 0 0 0.0 1.0 ECU_ADDRESS 0x0000 /* @ECU_Address@VTQD_ExtDoorAllow_flg@ */ /end MEASUREMENT
/begin MEASUREMENT VTQD_RgnTqComLim_flg "" UBYTE SWC_FDC_type_CM_boolean_flg 0 0 0.0 1.0 ECU_ADDRESS 0x0000 /* @ECU_Address@VTQD_RgnTqComLim_flg@ */ /end MEASUREMENT
/begin MEASUREMENT VTQD_SWCACCSta_flg "" UBYTE SWC_FDC_type_CM_boolean_flg 0 0 0.0 1.0 ECU_ADDRESS 0x0000 /* @ECU_Address@VTQD_SWCACCSta_flg@ */ /end MEASUREMENT
/begin MEASUREMENT VTQD_SWCResUpSta_flg "" UBYTE SWC_FDC_type_CM_boolean_flg 0 0 0.0 1.0 ECU_ADDRESS 0x0000 /* @ECU_Address@VTQD_SWCResUpSta_flg@ */ /end MEASUREMENT
/begin MEASUREMENT VTQD_SWCSetdownSta_flg "" UBYTE SWC_FDC_type_CM_boolean_flg 0 0 0.0 1.0 ECU_ADDRESS 0x0000 /* @ECU_Address@VTQD_SWCSetdownSta_flg@ */ /end MEASUREMENT
/begin MEASUREMENT VTQD_SWCCancelSta_flg "" UBYTE SWC_FDC_type_CM_boolean_flg 0 0 0.0 1.0 ECU_ADDRESS 0x0000 /* @ECU_Address@VTQD_SWCCancelSta_flg@ */ /end MEASUREMENT
/begin MEASUREMENT VTQD_SWC2LScrollPressSta_flg "" UBYTE SWC_FDC_type_CM_boolean_flg 0 0 0.0 1.0 ECU_ADDRESS 0x0000 /* @ECU_Address@VTQD_SWC2LScrollPressSta_flg@ */ /end MEASUREMENT
/begin MEASUREMENT VTQD_SWC2LADASSta_flg "" UBYTE SWC_FDC_type_CM_boolean_flg 0 0 0.0 1.0 ECU_ADDRESS 0x0000 /* @ECU_Address@VTQD_SWC2LADASSta_flg@ */ /end MEASUREMENT
/begin MEASUREMENT VTQD_SWC2CancelSta_flg "" UBYTE SWC_FDC_type_CM_boolean_flg 0 0 0.0 1.0 ECU_ADDRESS 0x0000 /* @ECU_Address@VTQD_SWC2CancelSta_flg@ */ /end MEASUREMENT
/begin MEASUREMENT VTQD_SWC2ScrollUpSta_flg "" UBYTE SWC_FDC_type_CM_boolean_flg 0 0 0.0 1.0 ECU_ADDRESS 0x0000 /* @ECU_Address@VTQD_SWC2ScrollUpSta_flg@ */ /end MEASUREMENT
/begin MEASUREMENT VTQD_Set2MeterSpd_flg "" UBYTE SWC_FDC_type_CM_boolean_flg 0 0 0.0 1.0 ECU_ADDRESS 0x0000 /* @ECU_Address@VTQD_Set2MeterSpd_flg@ */ /end MEASUREMENT
/begin MEASUREMENT VTQD_SetRoadSpdLim_flg "" UBYTE SWC_FDC_type_CM_boolean_flg 0 0 0.0 1.0 ECU_ADDRESS 0x0000 /* @ECU_Address@VTQD_SetRoadSpdLim_flg@ */ /end MEASUREMENT
/begin MEASUREMENT VTQD_SWC2ScrollDownSta_flg "" UBYTE SWC_FDC_type_CM_boolean_flg 0 0 0.0 1.0 ECU_ADDRESS 0x0000 /* @ECU_Address@VTQD_SWC2ScrollDownSta_flg@ */ /end MEASUREMENT
/begin MEASUREMENT VTQD_SWC2ResUpSta_flg "" UBYTE SWC_FDC_type_CM_boolean_flg 0 0 0.0 1.0 ECU_ADDRESS 0x0000 /* @ECU_Address@VTQD_SWC2ResUpSta_flg@ */ /end MEASUREMENT
/begin MEASUREMENT VTQD_SWC2SetdownSta_flg "" UBYTE SWC_FDC_type_CM_boolean_flg 0 0 0.0 1.0 ECU_ADDRESS 0x0000 /* @ECU_Address@VTQD_SWC2SetdownSta_flg@ */ /end MEASUREMENT
/begin MEASUREMENT VVMC_EstSlopeCal_Deg "" FLOAT32_IEEE SWC_FDC_type_CM_single_Deg 0 0 -180.0 180.0 ECU_ADDRESS 0x0000 /* @ECU_Address@VVMC_EstSlopeCal_Deg@ */ /end MEASUREMENT
/begin COMPU_METHOD SWC_FDC_type_CM_single_C "Q = V" RAT_FUNC "%8.6" "C" COEFFS 0 1 0 0 0 1 /end COMPU_METHOD
/begin COMPU_METHOD SWC_FDC_type_CM_uint8_enum "Q = V" RAT_FUNC "%3.0" "enum" COEFFS 0 1 0 0 0 1 /end COMPU_METHOD
/begin COMPU_METHOD SWC_FDC_type_CM_single_kph "Q = V" RAT_FUNC "%8.6" "kph" COEFFS 0 1 0 0 0 1 /end COMPU_METHOD
/begin COMPU_METHOD SWC_FDC_type_CM_single_Gps "Q = V" RAT_FUNC "%8.6" "Gps" COEFFS 0 1 0 0 0 1 /end COMPU_METHOD
/begin COMPU_METHOD SWC_FDC_type_CM_single_c "Q = V" RAT_FUNC "%8.6" "c" COEFFS 0 1 0 0 0 1 /end COMPU_METHOD
/begin COMPU_METHOD SWC_FDC_type_CM_single_deg "Q = V" RAT_FUNC "%8.6" "deg" COEFFS 0 1 0 0 0 1 /end COMPU_METHOD
/begin COMPU_METHOD SWC_FDC_type_CM_single_pct "Q = V" RAT_FUNC "%8.6" "pct" COEFFS 0 1 0 0 0 1 /end COMPU_METHOD
/begin COMPU_METHOD SWC_FDC_type_CM_single_s "Q = V" RAT_FUNC "%8.6" "s" COEFFS 0 1 0 0 0 1 /end COMPU_METHOD
/begin COMPU_METHOD SWC_FDC_type_CM_single_enum "Q = V" RAT_FUNC "%8.6" "enum" COEFFS 0 1 0 0 0 1 /end COMPU_METHOD
/begin COMPU_METHOD SWC_FDC_type_CM_single_A "Q = V" RAT_FUNC "%8.6" "A" COEFFS 0 1 0 0 0 1 /end COMPU_METHOD
/begin COMPU_METHOD SWC_FDC_type_CM_single_W "Q = V" RAT_FUNC "%8.6" "W" COEFFS 0 1 0 0 0 1 /end COMPU_METHOD
/begin COMPU_METHOD SWC_FDC_type_CM_single_Deg "Q = V" RAT_FUNC "%8.6" "Deg" COEFFS 0 1 0 0 0 1 /end COMPU_METHOD
/begin COMPU_METHOD SWC_FDC_type_CM_single_rpm "Q = V" RAT_FUNC "%8.6" "rpm" COEFFS 0 1 0 0 0 1 /end COMPU_METHOD
/begin COMPU_METHOD SWC_FDC_type_CM_single_kg "Q = V" RAT_FUNC "%8.6" "kg" COEFFS 0 1 0 0 0 1 /end COMPU_METHOD
/begin COMPU_METHOD SWC_FDC_type_CM_single_rat "Q = V" RAT_FUNC "%8.6" "rat" COEFFS 0 1 0 0 0 1 /end COMPU_METHOD
/begin COMPU_METHOD SWC_FDC_type_CM_single_Nm "Q = V" RAT_FUNC "%8.6" "Nm" COEFFS 0 1 0 0 0 1 /end COMPU_METHOD
/begin COMPU_METHOD SWC_FDC_type_CM_single_gain "Q = V" RAT_FUNC "%8.6" "gain" COEFFS 0 1 0 0 0 1 /end COMPU_METHOD
/begin COMPU_METHOD SWC_FDC_type_CM_single_gps "Q = V" RAT_FUNC "%8.6" "gps" COEFFS 0 1 0 0 0 1 /end COMPU_METHOD
/begin COMPU_METHOD SWC_FDC_type_CM_single_mps2 "Q = V" RAT_FUNC "%8.6" "mps2" COEFFS 0 1 0 0 0 1 /end COMPU_METHOD
/begin COMPU_METHOD SWC_FDC_type_CM_single_bar "Q = V" RAT_FUNC "%8.6" "bar" COEFFS 0 1 0 0 0 1 /end COMPU_METHOD
/begin COMPU_METHOD SWC_FDC_type_CM_uint32 "Q = V" RAT_FUNC "%10.0" "" COEFFS 0 1 0 0 0 1 /end COMPU_METHOD
/begin COMPU_METHOD SWC_FDC_type_CM_single_Dps "Q = V" RAT_FUNC "%8.6" "Dps" COEFFS 0 1 0 0 0 1 /end COMPU_METHOD
/begin COMPU_METHOD SWC_FDC_type_CM_single_mps "Q = V" RAT_FUNC "%8.6" "mps" COEFFS 0 1 0 0 0 1 /end COMPU_METHOD
/begin COMPU_METHOD SWC_FDC_type_CM_single_mps3 "Q = V" RAT_FUNC "%8.6" "mps3" COEFFS 0 1 0 0 0 1 /end COMPU_METHOD
/begin COMPU_METHOD SWC_FDC_type_CM_single_K "Q = V" RAT_FUNC "%8.6" "K" COEFFS 0 1 0 0 0 1 /end COMPU_METHOD
/begin COMPU_METHOD SWC_FDC_type_CM_single_kW "Q = V" RAT_FUNC "%8.6" "kW" COEFFS 0 1 0 0 0 1 /end COMPU_METHOD
/begin COMPU_METHOD SWC_FDC_type_CM_single_V "Q = V" RAT_FUNC "%8.6" "V" COEFFS 0 1 0 0 0 1 /end COMPU_METHOD
/begin COMPU_METHOD SWC_FDC_type_CM_single_sec "Q = V" RAT_FUNC "%8.6" "sec" COEFFS 0 1 0 0 0 1 /end COMPU_METHOD
/begin COMPU_METHOD SWC_FDC_type_CM_single_m "Q = V" RAT_FUNC "%8.6" "m" COEFFS 0 1 0 0 0 1 /end COMPU_METHOD
/begin COMPU_METHOD SWC_FDC_type_CM_single_factor "Q = V" RAT_FUNC "%8.6" "factor" COEFFS 0 1 0 0 0 1 /end COMPU_METHOD
/begin COMPU_METHOD SWC_FDC_type_CM_single_Nmps "Q = V" RAT_FUNC "%8.6" "Nmps" COEFFS 0 1 0 0 0 1 /end COMPU_METHOD
/begin COMPU_METHOD SWC_FDC_type_CM_single_raw32 "Q = V" RAT_FUNC "%8.6" "raw32" COEFFS 0 1 0 0 0 1 /end COMPU_METHOD
/begin COMPU_METHOD SWC_FDC_type_CM_uint16_K "Q = V" RAT_FUNC "%5.0" "K" COEFFS 0 1 0 0 0 1 /end COMPU_METHOD
/begin COMPU_METHOD SWC_FDC_type_CM_uint16_enum "Q = V" RAT_FUNC "%5.0" "enum" COEFFS 0 1 0 0 0 1 /end COMPU_METHOD
/begin COMPU_METHOD SWC_FDC_type_CM_boolean_flg "Q = V" RAT_FUNC "%1.0" "flg" COEFFS 0 1 0 0 0 1 /end COMPU_METHOD
/begin COMPU_METHOD SWC_FDC_type_CM_uint8_cnt "Q = V" RAT_FUNC "%3.0" "cnt" COEFFS 0 1 0 0 0 1 /end COMPU_METHOD
/begin COMPU_METHOD SWC_FDC_type_CM_uint8_K "Q = V" RAT_FUNC "%3.0" "K" COEFFS 0 1 0 0 0 1 /end COMPU_METHOD
/begin COMPU_METHOD SWC_FDC_type_CM_uint8_pct "Q = V" RAT_FUNC "%3.0" "pct" COEFFS 0 1 0 0 0 1 /end COMPU_METHOD
/begin COMPU_METHOD SWC_FDC_type_CM_uint8_kph "Q = V" RAT_FUNC "%3.0" "kph" COEFFS 0 1 0 0 0 1 /end COMPU_METHOD
/begin COMPU_METHOD SWC_FDC_type_CM_uint32_raw "Q = V" RAT_FUNC "%10.0" "raw" COEFFS 0 1 0 0 0 1 /end COMPU_METHOD
/begin COMPU_METHOD SWC_FDC_type_CM_single_G "Q = V" RAT_FUNC "%8.6" "G" COEFFS 0 1 0 0 0 1 /end COMPU_METHOD
/begin COMPU_METHOD SWC_FDC_type_CM_single_rad "Q = V" RAT_FUNC "%8.6" "rad" COEFFS 0 1 0 0 0 1 /end COMPU_METHOD
/begin COMPU_METHOD SWC_FDC_type_CM_uint8_raw "Q = V" RAT_FUNC "%3.0" "raw" COEFFS 0 1 0 0 0 1 /end COMPU_METHOD
/begin COMPU_METHOD SWC_FDC_type_CM_boolean_flag "Q = V" RAT_FUNC "%1.0" "flag" COEFFS 0 1 0 0 0 1 /end COMPU_METHOD
/begin GROUP S648_EWP1 "SWC_FDC_type/run_SWC_FDC_RxTx_5ms_sys/APP/THC/ThermalControl/THCM_Conctrl/EWP1"
 /begin REF_CHARACTERISTIC KTHC_EWP3SpdDeice_K KTHC_EWPDcCharge_K KTHC_EWPLv1_K KTHC_EWPLv2_K KTHC_EWPLv3_K KTHC_EWPLv4_K KTHC_EWPLv5_K /end REF_CHARACTERISTIC
/end GROUP
/begin GROUP S648_EWP2 "SWC_FDC_type/run_SWC_FDC_RxTx_5ms_sys/APP/THC/ThermalControl/THCM_Conctrl/EWP2"
 /begin REF_CHARACTERISTIC KTHC_EWP3SpdDeice_K KTHC_EWPDcCharge_K KTHC_EWPLv1_K KTHC_EWPLv2_K KTHC_EWPLv3_K KTHC_EWPLv4_K KTHC_EWPLv5_K /end REF_CHARACTERISTIC
/end GROUP
/begin GROUP S648_EWP3 "SWC_FDC_type/run_SWC_FDC_RxTx_5ms_sys/APP/THC/ThermalControl/THCM_Conctrl/EWP3"
 /begin REF_CHARACTERISTIC KTHC_EWP3SpdDeice_K KTHC_EWPDcCharge_K KTHC_EWPLv1_K KTHC_EWPLv2_K KTHC_EWPLv3_K KTHC_EWPLv4_K KTHC_EWPLv5_K /end REF_CHARACTERISTIC
/end GROUP
/begin GROUP S648_EXV1Ctrl "SWC_FDC_type/run_SWC_FDC_RxTx_5ms_sys/APP/THC/ThermalControl/THCM_Conctrl/EXV1Ctrl"
 /begin REF_CHARACTERISTIC KTHC_EXVBlancePulse_K KTHC_KiEXV1SHDeice_K KTHC_KiEXV1SH_K KTHC_KpEXV1SHDeice_K KTHC_KpEXV1SH_K KTHC_RefrigerantType_enum /end REF_CHARACTERISTIC
/end GROUP
/begin GROUP S648_EXV2Ctrl "SWC_FDC_type/run_SWC_FDC_RxTx_5ms_sys/APP/THC/ThermalControl/THCM_Conctrl/EXV2Ctrl"
 /begin REF_CHARACTERISTIC KTHC_EXVBlancePulse_K KTHC_KiEXV2SHD_K KTHC_KiEXV2SH_K KTHC_KpEXV2SHD_K KTHC_KpEXV2SH_K KTHC_RefrigerantType_enum /end REF_CHARACTERISTIC
/end GROUP
/begin GROUP S648_RadiatorFan "SWC_FDC_type/run_SWC_FDC_RxTx_5ms_sys/APP/THC/ThermalControl/THCM_Conctrl/RadiatorFan"
 /begin REF_CHARACTERISTIC KTHC_FANDefLv_pct KTHC_FANLv1_pct KTHC_FANLv2_pct KTHC_FANLv3_pct KTHC_FANLv4_pct KTHC_FANLv5_pct /end REF_CHARACTERISTIC
/end GROUP
/begin GROUP S648_SensorErrorHandle4 "SWC_FDC_type/run_SWC_FDC_RxTx_5ms_sys/APP/THC/ThermalControl/THCM_Conctrl/SensorErrorHandle4" /begin REF_CHARACTERISTIC KTHC_TevaErrHandleEN_flg /end REF_CHARACTERISTIC /end GROUP
/begin GROUP S648_SensorErrorHandle5 "SWC_FDC_type/run_SWC_FDC_RxTx_5ms_sys/APP/THC/ThermalControl/THCM_Conctrl/SensorErrorHandle5" /begin REF_CHARACTERISTIC KTHC_TevaErrHandleEN_flg /end REF_CHARACTERISTIC /end GROUP
/begin GROUP S648_SensorErrorHandle6 "SWC_FDC_type/run_SWC_FDC_RxTx_5ms_sys/APP/THC/ThermalControl/THCM_Conctrl/SensorErrorHandle6" /begin REF_CHARACTERISTIC KTHC_TevaErrHandleEN_flg /end REF_CHARACTERISTIC /end GROUP
/begin GROUP S648_SensorErrorHandle7 "SWC_FDC_type/run_SWC_FDC_RxTx_5ms_sys/APP/THC/ThermalControl/THCM_Conctrl/SensorErrorHandle7" /begin REF_CHARACTERISTIC KTHC_TevaErrHandleEN_flg /end REF_CHARACTERISTIC /end GROUP
/begin GROUP S648_SensorErrorHandle8 "SWC_FDC_type/run_SWC_FDC_RxTx_5ms_sys/APP/THC/ThermalControl/THCM_Conctrl/SensorErrorHandle8" /begin REF_CHARACTERISTIC KTHC_TevaErrHandleEN_flg /end REF_CHARACTERISTIC /end GROUP
/begin GROUP S648_SensorErrorHandle9 "SWC_FDC_type/run_SWC_FDC_RxTx_5ms_sys/APP/THC/ThermalControl/THCM_Conctrl/SensorErrorHandle9" /begin REF_CHARACTERISTIC KTHC_TevaErrHandleEN_flg /end REF_CHARACTERISTIC /end GROUP
/begin GROUP S648_Subsystem "SWC_FDC_type/run_SWC_FDC_RxTx_5ms_sys/APP/THC/ThermalControl/THCM_Conctrl/Subsystem"
 /begin REF_CHARACTERISTIC KTHC_PBlaceTime1_K KTHC_PBlaceTime2_K KTHC_PBlaceTime3_K KTHC_PBlaceTime4_K /end REF_CHARACTERISTIC
 /begin REF_MEASUREMENT VTHC_FDSOV1Cmd_flg VTHC_FDSOV2Cmd_flg VTHC_FDSOV3Cmd_flg /end REF_MEASUREMENT
/end GROUP
/begin GROUP S648_Subsystem1 "SWC_FDC_type/run_SWC_FDC_RxTx_5ms_sys/APP/THC/ThermalControl/THCM_Conctrl/Subsystem1"
 /begin SUB_GROUP S928_SensorErrorHandle1 S928_SensorErrorHandle2 S928_SensorErrorHandle3 S928_SensorErrorHandle4 S928_SensorErrorHandle5 S928_SensorErrorHandle9 /end SUB_GROUP
 /begin REF_CHARACTERISTIC KTHC_TdiffC_C KTHC_TdiffD_C KTHC_TdiffH_C /end REF_CHARACTERISTIC
/end GROUP
/begin GROUP S648_Subsystem2 "SWC_FDC_type/run_SWC_FDC_RxTx_5ms_sys/APP/THC/ThermalControl/THCM_Conctrl/Subsystem2" /begin SUB_GROUP S929_SensorErrorHandle9 /end SUB_GROUP /begin REF_CHARACTERISTIC KTHC_MotorInTempDefH_C KTHC_MotorInTempDefL_C /end REF_CHARACTERISTIC /end GROUP
/begin GROUP S648_Subsystem3 "SWC_FDC_type/run_SWC_FDC_RxTx_5ms_sys/APP/THC/ThermalControl/THCM_Conctrl/Subsystem3" /begin SUB_GROUP S930_Subsystem1 S930_Subsystem2 S930_Subsystem3 /end SUB_GROUP /begin REF_CHARACTERISTIC KTHC_EWPStopT_cnt KTHC_ValueSWT_cnt /end REF_CHARACTERISTIC
 /begin REF_MEASUREMENT VTHC_FDEWP1Cmd_enum VTHC_FDEWP2Cmd_enum VTHC_FDEWP3Cmd_enum VTHC_FDFWVCmd_flg VTHC_FDTWVCmd_pct /end REF_MEASUREMENT
/end GROUP
/begin GROUP S1041_Subsystem "SWC_FDC_type/run_SWC_FDC_RxTx_5ms_sys/APP/TPM/TPMS/ModelVersion/Subsystem" /begin REF_MEASUREMENT VTPM_ModelVersionChksum_raw VTPM_ModelVersion_raw /end REF_MEASUREMENT /end GROUP
/begin GROUP S1042_GetFlashWheelTemp "SWC_FDC_type/run_SWC_FDC_RxTx_5ms_sys/APP/TPM/TPMS/TPMS/GetFlashWheelTemp" /begin REF_CHARACTERISTIC KTPM_TPMSModelVersionInit_raw /end REF_CHARACTERISTIC /end GROUP
/begin GROUP S1042_Learn "SWC_FDC_type/run_SWC_FDC_RxTx_5ms_sys/APP/TPM/TPMS/TPMS/Learn" /begin SUB_GROUP S1053_AutoLocation S1053_LowerTirePressureCalibration /end SUB_GROUP /end GROUP
/begin GROUP S1042_Send "SWC_FDC_type/run_SWC_FDC_RxTx_5ms_sys/APP/TPM/TPMS/TPMS/Send" /begin SUB_GROUP S1054_Alarm S1054_DATA S1054_ResetAllow_CalibrateAllow /end SUB_GROUP /end GROUP
/begin GROUP S1042_Subsystem "SWC_FDC_type/run_SWC_FDC_RxTx_5ms_sys/APP/TPM/TPMS/TPMS/Subsystem"
 /begin REF_MEASUREMENT VTPM_Flashchkdatavalid_enum VTPM_Flashdatavalid_enum VTPM_WriteChkLFID_raw VTPM_WriteChkLRID_raw VTPM_WriteChkRFID_raw VTPM_WriteChkRRID_raw VTPM_WriteChkfinLFID_raw VTPM_WriteChkfinLRID_raw VTPM_WriteChkfinRFID_raw VTPM_WriteChkfinRRID_raw /end REF_MEASUREMENT
/end GROUP
/begin GROUP S1275_SR_Latch "SWC_FDC_type/run_SWC_FDC_RxTx_5ms_sys/APP/TQD/TorqueDemand/CrashDetect/SR_Latch" /begin REF_MEASUREMENT VTQD_DiagHCrash_flg /end REF_MEASUREMENT /end GROUP
/begin GROUP S1276_GearShiftPosn "SWC_FDC_type/run_SWC_FDC_RxTx_5ms_sys/APP/TQD/TorqueDemand/ShiftModule/GearShiftPosn" /begin SUB_GROUP S1284_Drive_Protection /end SUB_GROUP
 /begin REF_CHARACTERISTIC KTQD_DriveProtVehSpdGain_kph KTQD_ForcePLimitSpd_kph KTQD_OPDHoldAllowGearPSW_flg /end REF_CHARACTERISTIC
 /begin REF_MEASUREMENT VTQD_ForceP_flg VTQD_GearShiftCMD_enum /end REF_MEASUREMENT
/end GROUP
/begin GROUP S1276_P_Button_State_Judge "SWC_FDC_type/run_SWC_FDC_RxTx_5ms_sys/APP/TQD/TorqueDemand/ShiftModule/P_Button_State_Judge" /begin REF_MEASUREMENT VTQD_PButtonSta_enum /end REF_MEASUREMENT /end GROUP
/begin GROUP S1276_SR_Latch "SWC_FDC_type/run_SWC_FDC_RxTx_5ms_sys/APP/TQD/TorqueDemand/ShiftModule/SR_Latch" /begin REF_MEASUREMENT VTQD_PBWLockTO_flg /end REF_MEASUREMENT /end GROUP
/begin GROUP S1276_SR_Latch1 "SWC_FDC_type/run_SWC_FDC_RxTx_5ms_sys/APP/TQD/TorqueDemand/ShiftModule/SR_Latch1" /begin REF_MEASUREMENT VTQD_PBWUnlockTO_flg /end REF_MEASUREMENT /end GROUP
/begin GROUP S1277_New_Wheel_Slide_Rate "SWC_FDC_type/run_SWC_FDC_RxTx_5ms_sys/APP/TQD/TorqueDemand/Signal_convert/New Wheel Slide Rate" /begin REF_CHARACTERISTIC KTQD_NewSlideRateTs_c /end REF_CHARACTERISTIC
 /begin REF_MEASUREMENT VTQD_FrontSlideRate_pct VTQD_LFSlideRate_pct VTQD_LRSlideRate_pct VTQD_LeftSlideRate_pct VTQD_MaxWhlSlideRate_pct VTQD_MinWhlSlideRate_pct VTQD_RFSlideRate_pct VTQD_RRSlideRate_pct VTQD_RearSlideRate_pct VTQD_RightSlideRate_pct VTQD_VehSpeed4Cal_kph /end REF_MEASUREMENT
/end GROUP
/begin GROUP S1277_OUTPUT_ONLY_ON_or_READY "SWC_FDC_type/run_SWC_FDC_RxTx_5ms_sys/APP/TQD/TorqueDemand/Signal_convert/OUTPUT ONLY ON or READY" /begin REF_CHARACTERISTIC KTQD_RegenButEnSpd_kph /end REF_CHARACTERISTIC /end GROUP
/begin GROUP S1277_Regen_Level_Switch_Botton "SWC_FDC_type/run_SWC_FDC_RxTx_5ms_sys/APP/TQD/TorqueDemand/Signal_convert/Regen Level Switch Botton" /begin SUB_GROUP S1317_RegenDOWN S1317_RegenUP /end SUB_GROUP /begin REF_MEASUREMENT VTQD_RegenSWSta_enum /end REF_MEASUREMENT /end GROUP
/begin GROUP S1277_SR_Latch "SWC_FDC_type/run_SWC_FDC_RxTx_5ms_sys/APP/TQD/TorqueDemand/Signal_convert/SR_Latch" /begin REF_MEASUREMENT VTQD_RegenModeChange_flg /end REF_MEASUREMENT /end GROUP
/begin GROUP S1277_SR_Latch8 "SWC_FDC_type/run_SWC_FDC_RxTx_5ms_sys/APP/TQD/TorqueDemand/Signal_convert/SR_Latch8" /begin REF_MEASUREMENT VTQD_RgnTqComLim_flg /end REF_MEASUREMENT /end GROUP
/begin GROUP S1277_SWC2_Subsystem "SWC_FDC_type/run_SWC_FDC_RxTx_5ms_sys/APP/TQD/TorqueDemand/Signal_convert/SWC2_Subsystem"
 /begin SUB_GROUP S1324_L_ScrollPress_Behavior S1324_Road_Speed_Limit_Convert S1324_Speed_Setting_Mode /end SUB_GROUP
 /begin REF_CHARACTERISTIC KTQD_OvrSpdSetDownOffSet_kph KTQD_SpdCtrlMode_enum_ovrdflg KTQD_SpdCtrlMode_enum_ovrdval /end REF_CHARACTERISTIC
 /begin REF_MEASUREMENT VTQD_SWC2CancelSta_flg VTQD_SWC2LADASSta_flg VTQD_SWC2LScrollPressSta_flg VTQD_SWC2ResUpSta_flg VTQD_SWC2ScrollDownSta_flg VTQD_SWC2ScrollUpSta_flg VTQD_SWC2SetdownSta_flg VTQD_Set2MeterSpd_flg VTQD_SetRoadSpdLim_flg VTQD_SpdLim4SetSpd_raw32 /end REF_MEASUREMENT
/end GROUP
/begin GROUP S1277_SWC_Subsystem "SWC_FDC_type/run_SWC_FDC_RxTx_5ms_sys/APP/TQD/TorqueDemand/Signal_convert/SWC_Subsystem"
 /begin SUB_GROUP S1325_SpdCtrlBotton_Behavior S1325_Speed_Setting_Mode S1325_Vehicle_to_Meter_Speed /end SUB_GROUP
 /begin REF_CHARACTERISTIC KTQD_SpdCtrlMode_enum_ovrdflg KTQD_SpdCtrlMode_enum_ovrdval KTQD_Veh2MetSpdHiBand_kph KTQD_Veh2MetSpdLowBand_kph /end REF_CHARACTERISTIC
 /begin REF_MEASUREMENT VTQD_CalMeterSpeed_kph VTQD_SWCACCSta_flg VTQD_SWCCancelSta_flg VTQD_SWCResUpSta_flg VTQD_SWCSetdownSta_flg /end REF_MEASUREMENT
/end GROUP
/begin GROUP S1277_Simulation_Sound_Wave_ "SWC_FDC_type/run_SWC_FDC_RxTx_5ms_sys/APP/TQD/TorqueDemand/Signal_convert/Simulation Sound Wave " /begin SUB_GROUP S1326_RateLimit /end SUB_GROUP
 /begin REF_CHARACTERISTIC KTQD_FrMotorRefPower_kW KTQD_FrUppTheldTrq_Nm KTQD_RrMotorRefPower_kW KTQD_RrUppTheldTrq_Nm KTQD_SimSoundWaveDec_pct KTQD_SimSoundWaveInc_pct KTQD_SimSoundWaveSet_enum /end REF_CHARACTERISTIC
 /begin REF_MEASUREMENT VTQD_FrMotorPwr_W VTQD_RrMotorPwr_W VTQD_SimSouWaveCMD_pct VTQD_SysMotorPerform_pct VTQD_SysMotorPower_pct VTQD_SysMotorTorque_pct /end REF_MEASUREMENT
/end GROUP
/begin GROUP S1277_VehWeightEst "SWC_FDC_type/run_SWC_FDC_RxTx_5ms_sys/APP/TQD/TorqueDemand/Signal_convert/VehWeightEst" /begin SUB_GROUP S1327_Calaulation S1327_Condition S1327_Desicion /end SUB_GROUP /end GROUP
/begin GROUP S1277_Wheel_Status_Judgment "SWC_FDC_type/run_SWC_FDC_RxTx_5ms_sys/APP/TQD/TorqueDemand/Signal_convert/Wheel Status Judgment"
 /begin SUB_GROUP S1328_SR_Latch S1328_SR_Latch1 S1328_SR_Latch10 S1328_SR_Latch11 S1328_SR_Latch12 S1328_SR_Latch13 S1328_SR_Latch14 S1328_SR_Latch15 S1328_SR_Latch16 S1328_SR_Latch17 S1328_SR_Latch18 S1328_SR_Latch19 S1328_SR_Latch2 S1328_SR_Latch20 S1328_SR_Latch21 S1328_SR_Latch22 S1328_SR_Latch23 S1328_SR_Latch24 S1328_SR_Latch25 S1328_SR_Latch3 S1328_SR_Latch4 S1328_SR_Latch5 S1328_SR_Latch6 /end SUB_GROUP
 /begin REF_CHARACTERISTIC KTQD_ActWhlSkipSta_enum_ovrdflg KTQD_ActWhlSkipSta_enum_ovrdval KTQD_EscModeTqLimSpdDev_kph KTQD_EscModeWhlSpdDely_cnt KTQD_FreeWhlDetStableSpd_kph KTQD_WhlEnDetStableSpd_kph KTQD_WhlSpeedStableDev_kph KTQD_WhlStableDetTime_s /end REF_CHARACTERISTIC
 /begin REF_MEASUREMENT VTQD_ActWhlSkipSta_enum VTQD_AllWhlStable_flg VTQD_DiagonalWhlSkip_flg VTQD_FrontRearWhlSkip_flg VTQD_FrontWhlSkip_flg VTQD_LFRRWhlSkip_flg VTQD_LFWhlQuickSkip_flg VTQD_LRWhlQuickSkip_flg VTQD_LeftRightWhlSkip_flg VTQD_LeftWhlSkip_flg VTQD_RFLRWhlSkip_flg VTQD_RFWhlQuickSkip_flg VTQD_RRWhlQuickSkip_flg VTQD_RearWhlSkip_flg VTQD_RightWhlSkip_flg VTQD_SkipDirect_enum VTQD_WhlSkipSta_enum /end REF_MEASUREMENT
/end GROUP
/begin GROUP S1278_AvaliableTqLimit "SWC_FDC_type/run_SWC_FDC_RxTx_5ms_sys/APP/TQD/TorqueDemand/TorqueModule/AvaliableTqLimit"
 /begin SUB_GROUP S1482_If_Action_Subsystem1 S1482_If_Action_Subsystem2 S1482_RateLimit S1482_RateLimit1 S1482_TorqueCapacityCalcalation /end SUB_GROUP
 /begin REF_CHARACTERISTIC KTQD_AvailBRgnTqVSOC_pct KTQD_AvailBrkRgnTqSpd_kph KTQD_BRgnPermDisDelay_s KTQD_FAfterTqCMDGainDec_c KTQD_FAfterTqCMDGainInc_c KTQD_FrBatapCont_factor KTQD_RAfterTqCMDGainDec_c KTQD_RAfterTqCMDGainInc_c KTQD_RrBatapCont_factor MTQD_AfterTqMinGain_Y_c MTQD_FAfterTqCMDGain_Z_c MTQD_RAfterTqCMDGain_Z_c /end REF_CHARACTERISTIC
 /begin REF_MEASUREMENT VTQD_ARegenActive_flg VTQD_AfterAvailableTqDemFr_Nm VTQD_AfterAvailableTqDemRr_Nm VTQD_AfterTqMinGain_c VTQD_FrAvailableTqUpLimt_Nm VTQD_FrEDUAvailBrkRgnTq_Nm VTQD_FrRgnDecrSta_flg VTQD_FrRgnPermSta_flg VTQD_RrAvailableTqUpLimt_Nm VTQD_RrEDUAvailBrkRgnTq_Nm VTQD_RrRgnDecrSta_flg VTQD_RrRgnPermSta_flg /end REF_MEASUREMENT
/end GROUP
/begin GROUP S1278_DriverWhlTqDem "SWC_FDC_type/run_SWC_FDC_RxTx_5ms_sys/APP/TQD/TorqueDemand/TorqueModule/DriverWhlTqDem"
 /begin SUB_GROUP S1483_BOS S1483_Creep S1483_DriverTqCoordination S1483_PedalMapWhlTq S1483_RollingRegenJudge /end SUB_GROUP
/end GROUP
/begin GROUP S1278_ExtTqFuncHandShaking "SWC_FDC_type/run_SWC_FDC_RxTx_5ms_sys/APP/TQD/TorqueDemand/TorqueModule/ExtTqFuncHandShaking"
 /begin REF_CHARACTERISTIC KTQD_ExtDoorAllow_flg_ovrdflg KTQD_ExtDoorAllow_flg_ovrdval KTQD_ExtShftAllow_flg_ovrdflg KTQD_ExtShftAllow_flg_ovrdval KTQD_ExtTqAllow_flg_ovrdflg KTQD_ExtTqAllow_flg_ovrdval /end REF_CHARACTERISTIC
 /begin REF_MEASUREMENT VTQD_ExtDoorAllow_flg VTQD_ExtShftAllow_flg VTQD_ExternalTqAllow_flg /end REF_MEASUREMENT
/end GROUP
/begin GROUP S1278_OPD_Hold "SWC_FDC_type/run_SWC_FDC_RxTx_5ms_sys/APP/TQD/TorqueDemand/TorqueModule/OPD Hold"
 /begin SUB_GROUP S1485_Deceleration_Calculation S1485_OPDHold_Request_ S1485_Parking_Requeest_Backup S1485_Release_Condition S1485_System_Status /end SUB_GROUP
/end GROUP
/begin GROUP S1278_Signal_for_ESC "SWC_FDC_type/run_SWC_FDC_RxTx_5ms_sys/APP/TQD/TorqueDemand/TorqueModule/Signal for ESC"
 /begin REF_CHARACTERISTIC KTQD_AvailBRgnTqVSOC_pct KTQD_BRegenCalEnTq_Nm KTQD_DecideEDUActTqSW_flg KTQD_FrAvailBRgnTqV_flg_ovrdflg KTQD_FrAvailBRgnTqV_flg_ovrdval KTQD_FrBRgnCalLowLim_Nm KTQD_FrBRgnCalUpLim_Nm KTQD_FrEDURollRgnLowTq_Nm KTQD_FrEDURollRgnUpTq_Nm KTQD_PTCSPermSta_flg KTQD_RrAvailBRgnTqV_flg_ovrdflg KTQD_RrAvailBRgnTqV_flg_ovrdval KTQD_RrBRgnCalLowLim_Nm KTQD_RrBRgnCalUpLim_Nm KTQD_RrEDURollRgnLowTq_Nm KTQD_RrEDURollRgnUpTq_Nm KTQD_TMTqDeviationLow_c KTQD_TMTqDeviationUp_c KVMC_ACCReqCMdBond_mps2 /end REF_CHARACTERISTIC
 /begin REF_MEASUREMENT VTQD_ActFrTMTqDeviation_c VTQD_ActRrTMTqDeviation_c VTQD_FrARegenCal_Nm VTQD_FrARgnTqDeviation_c VTQD_FrBRegenCal_Nm VTQD_FrEDUActTq_Nm VTQD_FrEDURolRgnTq_Nm VTQD_FrTMTqDeviation_c VTQD_FrWhlTqDemNeg_flg VTQD_PTCSPermSta_flg VTQD_RgnAbnorSta_flg VTQD_RrARegenCal_Nm VTQD_RrARgnTqDeviation_c VTQD_RrBRegenCal_Nm VTQD_RrEDUActTq_Nm VTQD_RrEDURolRgnTq_Nm VTQD_RrTMTqDeviation_c VTQD_RrWhlTqDemNeg_flg /end REF_MEASUREMENT
/end GROUP
/begin GROUP S1278_Signals_for_BCM "SWC_FDC_type/run_SWC_FDC_RxTx_5ms_sys/APP/TQD/TorqueDemand/TorqueModule/Signals for BCM"
 /begin REF_CHARACTERISTIC KTQD_RegBrkLPOff_c KTQD_RegBrkLPOn_c KVMC_GravityValue_mps2 /end REF_CHARACTERISTIC
 /begin REF_MEASUREMENT VTQD_ReBrakeLPReq_flg /end REF_MEASUREMENT
/end GROUP
/begin GROUP S1278_Signals_for_MCU "SWC_FDC_type/run_SWC_FDC_RxTx_5ms_sys/APP/TQD/TorqueDemand/TorqueModule/Signals for MCU"
 /begin REF_CHARACTERISTIC KTQD_FrIdcMax_A KTQD_FrIdcMin_A KTQD_FrUdcMax_V KTQD_FrUdcMin_V KTQD_RrIdcMax_A KTQD_RrIdcMin_A KTQD_RrUdcMax_V KTQD_RrUdcMin_V /end REF_CHARACTERISTIC
 /begin REF_MEASUREMENT VTQD_FrIdcMax_A VTQD_FrIdcMin_A VTQD_FrUdcMax_V VTQD_FrUdcMin_V VTQD_RrIdcMax_A VTQD_RrIdcMin_A VTQD_RrUdcMax_V VTQD_RrUdcMin_V /end REF_MEASUREMENT
/end GROUP
/begin GROUP S1278_TqCoordination "SWC_FDC_type/run_SWC_FDC_RxTx_5ms_sys/APP/TQD/TorqueDemand/TorqueModule/TqCoordination" /begin SUB_GROUP S1489_Coordinate_NoSuitbleGear_flg /end SUB_GROUP
 /begin REF_MEASUREMENT VTQD_CoordTqDem_Nm VTQD_NoSuitbleGear_flg VTQD_TqSource_enum /end REF_MEASUREMENT
/end GROUP
/begin GROUP S1278_TqDistribution "SWC_FDC_type/run_SWC_FDC_RxTx_5ms_sys/APP/TQD/TorqueDemand/TorqueModule/TqDistribution" /begin SUB_GROUP S1490_AWD_Ratio S1490_RateLimit1 S1490_RateLimit2 /end SUB_GROUP
 /begin REF_CHARACTERISTIC KTQD_AWDWhlTqRatioSW_flg KTQD_FrTCSCompensateSW_flg KTQD_RrTCSCompensateSW_flg KTQD_TCSCompUpLimit_Nm MTQD_AWDLoadTrqnsGain_Z_c MTQD_CreepRrTqSpRat_Z_rat MTQD_ECORrEDUSpRat_Z_rat MTQD_NRMRrEDUSpRat_Z_rat MTQD_RrTqSRRateTs_Y_c MTQD_SPORTRrEDUSpRat_Z_rat /end REF_CHARACTERISTIC
 /begin REF_MEASUREMENT VTQD_AWDLoadTrqnsGain_c VTQD_AWDLoadTrqnsGain_pct VTQD_CoordTqDemFr_Nm VTQD_CoordTqDemRr_Nm VTQD_CoordWhlTqDemFr_Nm VTQD_CoordWhlTqDemRr_Nm VTQD_CreepRrTqSpRat_rat VTQD_FrEDUSpRat_rat VTQD_FrTCSCompensateTq_Nm VTQD_OrigRrDriverRatio_rat VTQD_RrEDUSpRat_rat VTQD_RrTCSCompensateTq_Nm VTQD_RrTqSRRateTs_c VTQD_TqSourceFr_enum VTQD_TqSourceRr_enum /end REF_MEASUREMENT
/end GROUP
/begin GROUP S1644_InverseAndTurnToMotorToq "SWC_FDC_type/run_SWC_FDC_RxTx_5ms_sys/APP/TQR/Determine Torque Request/TorqueArbitrament/InverseAndTurnToMotorToq" /begin SUB_GROUP S1645_SR_Latch S1645_SR_Latch1 /end SUB_GROUP
 /begin REF_CHARACTERISTIC KTQR_FrAbsoluteMTTqDir_flg KTQR_FrTMGearEff_c KTQR_GearChangeTqDSW_flg KTQR_GearChangeTqSW_flg KTQR_GearEnChangeTq_Nm KTQR_NewRampArchSW_flg KTQR_RrAbsoluteMTTqDir_flg KTQR_RrTMGearEff_c /end REF_CHARACTERISTIC
 /begin REF_MEASUREMENT VTQR_FrTMTqReq_Nm VTQR_InitFEDUWhlTqReq_Nm VTQR_InitREDUWhlTqReq_Nm VTQR_RrTMTqReq_Nm /end REF_MEASUREMENT
/end GROUP
/begin GROUP S1644_RampEnableJudge "SWC_FDC_type/run_SWC_FDC_RxTx_5ms_sys/APP/TQR/Determine Torque Request/TorqueArbitrament/RampEnableJudge" /begin SUB_GROUP S1646_SR_Latch3 S1646_SR_Latch4 /end SUB_GROUP
 /begin REF_CHARACTERISTIC KTQR_ACCCancelNoRBC_flg KTQR_ADASCancelBRgnSlopeF_Nmps KTQR_ADASCancelBRgnSlopeR_Nmps KTQR_ADASCancelBRgnSlopeSW_flg KTQR_FinalFEDUTrqLowLim_Nm KTQR_FinalFEDUTrqUpLim_Nm KTQR_FinalREDUTrqLowLim_Nm KTQR_FinalREDUTrqUpLim_Nm KTQR_NewRampArchSW_flg KTQR_TCSActTQRLimSW_flg /end REF_CHARACTERISTIC
 /begin REF_MEASUREMENT VTQR_ActFEDUTqLowLimit_Nm VTQR_ActFEDUTqUpLimit_Nm VTQR_ActREDUTqLowLimit_Nm VTQR_ActREDUTqUpLimit_Nm VTQR_ActualFEDUWhlTqReq_Nm VTQR_ActualREDUWhlTqReq_Nm VTQR_FrRampEnable_flg VTQR_FrntAxlTrqReqBrkRamp_Nm VTQR_NoABSFEDUWhlTqReq_Nm VTQR_NoABSREDUWhlTqReq_Nm VTQR_RearAxlTrqReqBrkRamp_Nm VTQR_RrRampEnable_flg /end REF_MEASUREMENT
/end GROUP
/begin GROUP S1644_TorqueSmooth "SWC_FDC_type/run_SWC_FDC_RxTx_5ms_sys/APP/TQR/Determine Torque Request/TorqueArbitrament/TorqueSmooth"
 /begin SUB_GROUP S1647_FirstOrderFilter S1647_FirstOrderFilter1 S1647_Front_First_order_filter_input_tau_map_and_determination S1647_Front_Torque_zero_point_transfer_boundary_map S1647_Front_Torque_zero_point_transfer_status_determination_ S1647_Front_torque_ramp_limtation_and_determination S1647_Front_wheel_first_order_filter_input_torque_command_determination S1647_Front_wheel_rate_limit_determination S1647_Limit S1647_Limit2 S1647_RateLimit S1647_RateLimit1 S1647_Rear_First_order_filter_input_tau_map_and_determination S1647_Rear_Torque_zero_point_transfer_boundary_map S1647_Rear_Torque_zero_point_transfer_status_determination_ S1647_Rear_torque_ramp_limtation_and_determination S1647_Rear_wheel_first_order_filter_input_torque_command_determination S1647_Rear_wheel_rate_limit_determination /end SUB_GROUP
 /begin REF_CHARACTERISTIC KTQR_LaunchEnPedal_pct KTQR_LaunchEnSpd_kph /end REF_CHARACTERISTIC
 /begin REF_MEASUREMENT VTQR_EVDriveMode_enum VTQR_FEDUWhlTqReqSmoothDelay_Nm VTQR_FrFirstOrderOutTqDelay_Nm VTQR_LaunchEn_flg VTQR_REDUWhlTqReqSmoothDelay_Nm VTQR_RampTqCMDGain_c VTQR_RrFirstOrderOutTqDelay_Nm /end REF_MEASUREMENT
/end GROUP
/begin GROUP S1911_ACC_Control_Allow_Judgement "SWC_FDC_type/run_SWC_FDC_RxTx_5ms_sys/APP/VMC/VMC/ACC_Function/ACC Control Allow Judgement" /begin REF_CHARACTERISTIC KVMC_ExternalTqAllowTime_s /end REF_CHARACTERISTIC /begin REF_MEASUREMENT VVMC_ACCCtrlAllow_flg /end REF_MEASUREMENT /end GROUP
/begin GROUP S1911_ACC_Torque_Source_Determination "SWC_FDC_type/run_SWC_FDC_RxTx_5ms_sys/APP/VMC/VMC/ACC_Function/ACC Torque Source Determination"
 /begin SUB_GROUP S1930_FirstOrderFilter6 S1930_SR_Latch S1930_SR_Latch1 S1930_SR_Latch2 S1930_Triggered_Subsystem2 /end SUB_GROUP
 /begin REF_CHARACTERISTIC KTQD_AWDWhlTqRatioSW_flg KTQD_FrUppTheldTrq_Nm KTQD_RrUppTheldTrq_Nm KVMC_ACCOvrdPedalTqLinearLim_Nm KVMC_ACCOvrdPedalTqRatio_Nm KVMC_ACCOvrdTestSW_flg KVMC_ACCPedalOvrdPosn4Hold_pct KVMC_ACCPedalOvrdPosn_pct KVMC_ACCPedalOvrdResPosn_pct KVMC_ACCPedalOvrdRestTime_s KVMC_ESCLongGBWFilter_raw32 KVMC_TimeGapBandLv1_s KVMC_TimeGapBandLv2_s KVMC_TimeGapBandLv3_s KVMC_TimeGapBandLv4_s KVMC_TimeGapMax_s MVMC_PedalTqRWhSTRGGain_Z_Nm MVMC_PedalTqRWhlRatio_Z_rat MVMC_PedalTqRWhlSlipGain_Z_Nm MVMC_RearWhlTqRatio_Z_rat MVMC_RearWhlTqSTRGGain_Z_Nm MVMC_RearWhlTqSlipGain_Z_Nm /end REF_CHARACTERISTIC
 /begin REF_MEASUREMENT VVMC_ACCPedalOvrd_flg VVMC_ADASFrWhlTqAftLim_Nm VVMC_ADASFrWhlTqAftSlip_Nm VVMC_ADASFrWhlTqBfrSlip_Nm VVMC_ADASFrWhlTq_Nm VVMC_ADASOvrdWhlTqCtrl_Nm VVMC_ADASOvrdWhlTq_Nm VVMC_ADASRrWhlTqAftLim_Nm VVMC_ADASRrWhlTqAftSlip_Nm VVMC_ADASRrWhlTqBfrSlip_Nm VVMC_ADASRrWhlTq_Nm VVMC_ADASWhlTqReqOvrd_Nm VVMC_ADASWhlTqReq_Nm VVMC_AccPedalOvrdDISC_flg VVMC_FrRrSlipRate_rat VVMC_PedalTqRWhSTRGGain_Nm VVMC_PedalTqRWhlRatio_rat VVMC_PedalTqRWhlSlipGain_Nm VVMC_RearTqRatioAftSlip_rat VVMC_RearTqRatioBfrSlip_rat VVMC_RearTqRatio_rat VVMC_RearWhlTqSTRGGain_Nm VVMC_RearWhlTqSlipGain_Nm VVMC_TimeGapCalcu_s VVMC_TimeGapJudge_flag VVMC_VMCWhlTq4RatioCalcu_Nm /end REF_MEASUREMENT
/end GROUP
/begin GROUP S1911_Hand_Shaking "SWC_FDC_type/run_SWC_FDC_RxTx_5ms_sys/APP/VMC/VMC/ACC_Function/Hand Shaking" /begin REF_MEASUREMENT VVMC_ACCCtrlAvail_flg VVMC_ADASActive_flg /end REF_MEASUREMENT /end GROUP
/begin GROUP S1911_VVMC_ADASWhlTqCalVehHoldStandstill_Nm "SWC_FDC_type/run_SWC_FDC_RxTx_5ms_sys/APP/VMC/VMC/ACC_Function/VVMC_ADASWhlTqCalVehHoldStandstill_Nm"
 /begin SUB_GROUP S1932_SR_Latch S1932_SR_Latch1 S1932_SR_Latch2 S1932_SR_Latch3 S1932_SR_Latch4 S1932_SR_Latch5 S1932_SR_Latch6 S1932_Triggered_Subsystem1 S1932_Triggered_Subsystem4 /end SUB_GROUP
 /begin REF_CHARACTERISTIC KTQR_FrTMGearEff_c KTQR_RrTMGearEff_c KVMC_ACCResUpEnAccCMD_mps2 KVMC_ACCResUpEnGrade_Deg KVMC_ACCSpdDevLowLim_kph KVMC_ACCSpdDevUpLim_kph KVMC_ACCTq2ZeroDisMCPress2_bar KVMC_ACCTq2ZeroDisMCPress_bar KVMC_ACCTq2ZeroEnMCPress2_bar KVMC_ACCTq2ZeroEnMCPress_bar KVMC_ADASWhlTqLowerLim_Nm KVMC_ADASWhlTqUpperLim_Nm KVMC_AccDevLowLim_mps2 KVMC_AccDevUpLim_mps2 KVMC_AddBRegen2ACCLoop_flg KVMC_CutOffNegTqSpd_kph KVMC_GravityValue_mps2 KVMC_HillUpResetTMSpd_rpm KVMC_HoldAllowZeroTqGrade_deg KVMC_MaxReqAccel_mps2 KVMC_MinReqAccel_mps2 KVMC_NegReqEnSpd_kph KVMC_NegReqSwEnSlope_Deg KVMC_NegReqSwEnSpd_kph KVMC_OVRD2ActRgnTarget_Nm KVMC_OVRDResSmoothTest_SW KVMC_OVRDResTqDec4Smooth_Nm KVMC_ReqAccelLimitSW_flg KVMC_StandstillTqRamp2ZeroSlope_Nmps KVMC_TqMCPRelFactorHold_Nm KVMC_TqMCPRelFactor_Nm KVMC_TqSafetyCtrl_flg KVMC_VehHoldDecSR_Nm KVMC_VehHoldTqAlwaysIncSW_flg KVMC_VehHoldTqIncMCP_bar KVMC_VehHoldTqIncMinTq_Nm KVMC_ZeroRgnTqSpdCtrlTime_s KVMC_ZeroRgnTqSpd_kph MVMC_ACCDeltaTqIGain4OVRD_Z_Nm MVMC_ACCDeltaTqIGain_Z_Nm MVMC_ACCDeltaTqPGain_Z_Nm MVMC_ADSPosGFBDeltaTq_Z_Nm MVMC_DISCDeltaTqIGain_Z_Nm MVMC_MCPresBaseTq_Y_Nm MVMC_TMSpdBaseTq_Y_Nm MVMC_VehHoldTqIncGain_Y_Nm /end REF_CHARACTERISTIC
 /begin REF_MEASUREMENT VVMC_ACCActSpdDev_kph VVMC_ACCDeltaAccel_mps2 VVMC_ACCDeltaTqIGain4OVRD_Nm VVMC_ACCDeltaTqIGainOri_Nm VVMC_ACCDeltaTqIGain_Nm VVMC_ACCDeltaTqPGain_Nm VVMC_ACCDeltaTq_Nm VVMC_ACCLowSpdTqAftFollowESC_Nm VVMC_ACCLowSpdTqEnSpdHi_Nm VVMC_ACCLowSpdTqEnSpdLo_Nm VVMC_ACCLowSpdTq_Nm VVMC_ACCTqNegReqNotLowSpd_Nm VVMC_ACCTqNegReq_Nm VVMC_ACCTqRampOutByMCP_Nm VVMC_ADASNegReq_flg VVMC_ADASWhlTqCalAftSafety_Nm VVMC_ADASWhlTqCalNegCMD_Nm VVMC_ADASWhlTqCalVehHoldPosTq_Nm VVMC_ADASWhlTqCalVehHold_Nm VVMC_ADASWhlTqCalZeroRgnCtrl_Nm VVMC_ADASWhlTqCal_Nm VVMC_ADASWhlTqVehHoldBfrSS_Nm VVMC_ADSPosGFBPCTDeltaTq_Nm VVMC_ActAccDev_mps2 VVMC_DISCDeltaTqIGain_Nm VVMC_FrntAxlTrqReqBrk_Nm VVMC_LastADASWhlTqCal_Nm VVMC_MCPreBaseTqEn_flg VVMC_MCPresBaseTq_Nm VVMC_OVRDAccCtrl_flg VVMC_OriADASWhlTq_Nm VVMC_RearAxlTrqReqBrk_Nm VVMC_TMSpdBaseTq_Nm /end REF_MEASUREMENT
/end GROUP
/begin GROUP S1912_CAAS_HandShake "SWC_FDC_type/run_SWC_FDC_RxTx_5ms_sys/APP/VMC/VMC/APS function/CAAS HandShake" /begin SUB_GROUP S1973_DelayEnable /end SUB_GROUP
 /begin REF_CHARACTERISTIC KVMC_CAASCtrlAllowTime_s KVMC_CAASEnVehSpd_kph KVMC_CAASVMCReqA_flg_ovrdflg KVMC_CAASVMCReqA_flg_ovrdval /end REF_CHARACTERISTIC
 /begin REF_MEASUREMENT VVMC_CAASActive_flg /end REF_MEASUREMENT
/end GROUP
/begin GROUP S1912_Command_Determination1 "SWC_FDC_type/run_SWC_FDC_RxTx_5ms_sys/APP/VMC/VMC/APS function/Command Determination1"
 /begin REF_MEASUREMENT VVMC_APSEnCMD_flg VVMC_APSShiftPosnReq_enum VVMC_APSSpeedCMD_kph /end REF_MEASUREMENT
/end GROUP
/begin GROUP S1912_Hand_Shake "SWC_FDC_type/run_SWC_FDC_RxTx_5ms_sys/APP/VMC/VMC/APS function/Hand Shake" /begin SUB_GROUP S1975_DelayEnable S1975_DelayEnable1 S1975_DelayEnable2 /end SUB_GROUP
 /begin REF_CHARACTERISTIC KVMC_ExternalDoorAllowTime_s KVMC_ExternalShiftAllowTime_s KVMC_ExternalTqAllowTime_s /end REF_CHARACTERISTIC
 /begin REF_MEASUREMENT VVMC_APSActive_flg VVMC_APSCtrlAvail_flg /end REF_MEASUREMENT
/end GROUP
/begin GROUP S1912_Signal_Rounting1 "SWC_FDC_type/run_SWC_FDC_RxTx_5ms_sys/APP/VMC/VMC/APS function/Signal Rounting1"
 /begin SUB_GROUP S1976_Signal_Determination_VINP_APSDecReqAtest_flg S1976_Signal_Determination_VINP_APSDecReqtest_mps2 S1976_Signal_Determination_VINP_APSReqtest_enum S1976_Signal_Determination_VINP_APSStaSystemtest_enum /end SUB_GROUP
/end GROUP
/begin GROUP S1912_Subsystem "SWC_FDC_type/run_SWC_FDC_RxTx_5ms_sys/APP/VMC/VMC/APS function/Subsystem"
 /begin REF_CHARACTERISTIC KVMC_APSAllowSetACCMCP_bar KVMC_APSAllowSetACCPosn_pct KVMC_AllowSetSpdDist_m KVMC_AllowSetSpdOvrdVal_flg KVMC_AllowSetSpdOvrd_flg KVMC_NotAllowSetSpdDist_m /end REF_CHARACTERISTIC
 /begin REF_MEASUREMENT VVMC_AllowSetSpd_flg VVMC_SetACCDisableAPS_flg /end REF_MEASUREMENT
/end GROUP
/begin GROUP S1913_CCActiveDetermination "SWC_FDC_type/run_SWC_FDC_RxTx_5ms_sys/APP/VMC/VMC/CruiseControlFunction/CCActiveDetermination"
 /begin REF_CHARACTERISTIC KTQD_CCActiveMetSpdHiMPH_mph KTQD_CCActiveMetSpdHi_kph KTQD_CCActiveMetSpdLoMPH_mph KTQD_CCActiveMetSpdLo_kph /end REF_CHARACTERISTIC
 /begin REF_MEASUREMENT VVMC_CCCtrlSta_enum VVMC_CCSpdWar_flg VVMC_CruzActive_flg /end REF_MEASUREMENT
/end GROUP
/begin GROUP S1913_CCDemandTorqueCalculation "SWC_FDC_type/run_SWC_FDC_RxTx_5ms_sys/APP/VMC/VMC/CruiseControlFunction/CCDemandTorqueCalculation"
 /begin REF_CHARACTERISTIC KTQR_FrTMGearEff_c KTQR_RrTMGearEff_c KVMC_AccDevLowLim_mps2 KVMC_AccDevUpLim_mps2 KVMC_CCDISCPGainSW_flg KVMC_CCSpdDevLowLim_kph KVMC_CCSpdDevUpLim_kph KVMC_CCTqLowLim_Nm KVMC_CCTqUpLim_Nm KVMC_GravityValue_mps2 KVMC_TqSafetyCtrl_flg MVMC_DISCDeltaTqIGain_Z_Nm MVMC_DISCDeltaTqPGain_Z_Nm /end REF_CHARACTERISTIC
 /begin REF_MEASUREMENT VVMC_CCIGainDeltaTq_Nm VVMC_CCPGainDeltaTq_Nm VVMC_CruzWhlTqCalAftSafety_Nm VVMC_CruzWhlTqCal_Nm VVMC_LastCruzWhlTqCal_Nm /end REF_MEASUREMENT
/end GROUP
/begin GROUP S1913_CCTorqueSourceDetermination "SWC_FDC_type/run_SWC_FDC_RxTx_5ms_sys/APP/VMC/VMC/CruiseControlFunction/CCTorqueSourceDetermination" /begin SUB_GROUP S1991_SR_Latch /end SUB_GROUP /begin REF_CHARACTERISTIC KVMC_ACCPedalOvrdRestTime_s MVMC_ACCPedalOvrdTqHys_Y_Nm /end REF_CHARACTERISTIC /begin REF_MEASUREMENT VVMC_CCPedalOvrd_flg VVMC_CruzWhlTqReq_Nm /end REF_MEASUREMENT /end GROUP
/begin GROUP S1916_IMU_memorized_offset_result "SWC_FDC_type/run_SWC_FDC_RxTx_5ms_sys/APP/VMC/VMC/IMU/IMU memorized offset result" /begin REF_CHARACTERISTIC KVMC_AccFSCalSet_enum KVMC_GyroFSCalSet_enum /end REF_CHARACTERISTIC
 /begin REF_MEASUREMENT VVMC_AccFSCalSet_enum VVMC_GyroFSCalSet_enum VVMC_MemOffsetAccX_G VVMC_MemOffsetAccY_G VVMC_MemOffsetAccZ_G VVMC_MemOffsetGyroX_Dps VVMC_MemOffsetGyroY_Dps VVMC_MemOffsetGyroZ_Dps /end REF_MEASUREMENT
/end GROUP
/begin GROUP S1916_IMU_sensing_result_ "SWC_FDC_type/run_SWC_FDC_RxTx_5ms_sys/APP/VMC/VMC/IMU/IMU sensing result "
 /begin SUB_GROUP S2006_FirstOrderFilter1 S2006_FirstOrderFilter2 S2006_FirstOrderFilter3 S2006_FirstOrderFilter4 S2006_FirstOrderFilter5 S2006_FirstOrderFilter6 /end SUB_GROUP
 /begin REF_CHARACTERISTIC KVMC_AccFSSlect_enum KVMC_GyroFSSlect_enum KVMC_IMUAccXRollAveLevel_enum KVMC_IMUAccYRollAveLevel_enum KVMC_IMUAccZRollAveLevel_enum KVMC_IMUGxFilter_raw32 KVMC_IMUGyFilter_raw32 KVMC_IMUGyroXRollAveLevel_enum KVMC_IMUGyroYRollAveLevel_enum KVMC_IMUGyroZRollAveLevel_enum KVMC_IMUGzFilter_raw32 KVMC_IMURxFilter_raw32 KVMC_IMURyFilter_raw32 KVMC_IMURzFilter_raw32 /end REF_CHARACTERISTIC
 /begin REF_MEASUREMENT VVMC_AccFSSlect_enum VVMC_CalibratedAccXAftRA_G VVMC_GyroFSSlect_enum VVMC_SensingAccX_G VVMC_SensingAccY_G VVMC_SensingAccZ_G VVMC_SensingGyroX_Dps VVMC_SensingGyroY_Dps VVMC_SensingGyroZ_Dps /end REF_MEASUREMENT
/end GROUP
/begin GROUP S1918_Degrees_to_Radians1 "SWC_FDC_type/run_SWC_FDC_RxTx_5ms_sys/APP/VMC/VMC/Long Acceleration Calculation/Degrees to Radians1" /begin REF_MEASUREMENT VVMC_GRADE_rad /end REF_MEASUREMENT /end GROUP
/begin GROUP S1918_FirstOrderFilter "SWC_FDC_type/run_SWC_FDC_RxTx_5ms_sys/APP/VMC/VMC/Long Acceleration Calculation/FirstOrderFilter" /begin REF_MEASUREMENT VVMC_LongAcc_Gps /end REF_MEASUREMENT /end GROUP
/begin GROUP S1918_FirstOrderFilter8 "SWC_FDC_type/run_SWC_FDC_RxTx_5ms_sys/APP/VMC/VMC/Long Acceleration Calculation/FirstOrderFilter8" /begin REF_MEASUREMENT VVMC_LongAccelCalcuByVehSpd_gps /end REF_MEASUREMENT /end GROUP
/begin GROUP S1919_Anti_Speed_Limitation "SWC_FDC_type/run_SWC_FDC_RxTx_5ms_sys/APP/VMC/VMC/MSA function/Anti-Speed Limitation"
 /begin REF_CHARACTERISTIC KVMC_AntiSpdLimSW_flg KVMC_AntiSpdLim_kph KVMC_SmartEcoLimitSpd_kph KVMC_SmartEcoPlusSW_flg /end REF_CHARACTERISTIC
 /begin REF_MEASUREMENT VVMC_AntiLimitSpd_kph VVMC_AntiSpdLimEn_flg VVMC_AntiSpdLimSpdEn_flg VVMC_AntiSpdLimStaEn_flg VVMC_HoodSpdLimitEn_flg VVMC_SmartEcoEn_flg /end REF_MEASUREMENT
/end GROUP
/begin GROUP S1919_MSAActivationHandshake "SWC_FDC_type/run_SWC_FDC_RxTx_5ms_sys/APP/VMC/VMC/MSA function/MSAActivationHandshake"
 /begin REF_CHARACTERISTIC KTQD_MSAActiveMetSpdHiMPH_mph KTQD_MSAActiveMetSpdHi_kph KTQD_MSAActiveMetSpdLoMPH_mph KTQD_MSAActiveMetSpdLo_kph /end REF_CHARACTERISTIC
 /begin REF_MEASUREMENT VVMC_IntMSAActive_flg VVMC_IntMSACtrlSta_enum VVMC_IntMSASpdWar_flg /end REF_MEASUREMENT
/end GROUP
/begin GROUP S1919_MSADemandTorqueCalculation "SWC_FDC_type/run_SWC_FDC_RxTx_5ms_sys/APP/VMC/VMC/MSA function/MSADemandTorqueCalculation" /begin SUB_GROUP S2026_SR_Latch5 S2026_Triggered_Subsystem /end SUB_GROUP
 /begin REF_CHARACTERISTIC KTQR_FrTMGearEff_c KTQR_RrTMGearEff_c KVMC_AccDevLowLim_mps2 KVMC_AccDevUpLim_mps2 KVMC_GravityValue_mps2 KVMC_MSAEnCtrlTargetAcc_mps2 KVMC_MSAPGainSW_flg KVMC_MSASpdDevLowLim_kph KVMC_MSASpdDevUpLim_kph KVMC_MSATqDownEndTqRatio_pct KVMC_MSATqLowLim_Nm KVMC_MSATqUpLim_Nm MVMC_DISCDeltaTqIGain_Z_Nm MVMC_DISCDeltaTqPGain_Z_Nm MVMC_MSASpdBand_Y_pct MVMC_MSATqDownEndTq_Y_Nm MVMC_MSATqDownTime_Y_s /end REF_CHARACTERISTIC
 /begin REF_MEASUREMENT VVMC_MSAIGainDeltaTq_Nm VVMC_MSAInCtrlSpd_flg VVMC_MSAPGainDeltaTq_Nm VVMC_MSATqDownEndTq_Nm VVMC_MSATqDownSlope_Nmps VVMC_MSAWhlTqCalAftGCtrl_Nm VVMC_MSAWhlTqCalAftInCtrlSpd_Nm VVMC_MSAWhlTqCalAftTqDown_Nm VVMC_MSAWhlTqCalDelay_Nm VVMC_MSAWhlTqCalNotTqDown_Nm VVMC_MSAWhlTqCal_Nm /end REF_MEASUREMENT
/end GROUP
/begin GROUP S1919_MSATorqueSourceDetermination "SWC_FDC_type/run_SWC_FDC_RxTx_5ms_sys/APP/VMC/VMC/MSA function/MSATorqueSourceDetermination" /begin SUB_GROUP S2027_SR_Latch1 S2027_Triggered_Subsystem2 /end SUB_GROUP
 /begin REF_CHARACTERISTIC KVMC_MSAOvrdDetTime_s KVMC_MSAOvrdJudgeSpd_kph KVMC_MSAOvrdResAPSPosn_pct KVMC_MSAOvrdResumeTime_s KVMC_MSAOvrdTqRampSlope_Nmps KVMC_MSATqLowLim_Nm KVMC_MSATqUpLim_Nm MVMC_MSAPedalOvrd_Y_pct MVMC_MSASpdBand_Y_pct /end REF_CHARACTERISTIC
 /begin REF_MEASUREMENT VVMC_MSAOvrdProhibit_flg VVMC_MSAOvrdWhlTqCal_Nm VVMC_MSAPedalOvrd_pct VVMC_MSAWhlTqActive_flg VVMC_MSAWhlTqReq_Nm /end REF_MEASUREMENT
/end GROUP
/begin GROUP S1921_RWD "SWC_FDC_type/run_SWC_FDC_RxTx_5ms_sys/APP/VMC/VMC/RDC Determination/RWD" /begin SUB_GROUP S2060_DelayEnable1 S2060_DelayEnable2 S2060_SR_Latch5 /end SUB_GROUP
 /begin REF_CHARACTERISTIC KVMC_AltRDCActiveSW_flg KVMC_AltRDCActiveTq_Nm KVMC_AltRDCRecTime_s KVMC_ESCRegenTqRecDelay_s MVMC_ESCRegenOutEnSpd_Y_kph MVMC_ESCRegenOut_Z_Dps MVMC_LatESCRegenOut_Z_Gps MVMC_RDCDetectTime_Z_s MVMC_RDCEnSlideRate_Y_pct MVMC_StESCYawCom_Z_Dps MVMC_StESCYaw_Z_Dps /end REF_CHARACTERISTIC
 /begin REF_MEASUREMENT VVMC_ActStESCYaw_Dps VVMC_AltRDCActive_enum VVMC_ESCRegenOutEnSpd_kph VVMC_ESCRegenOut_Dps VVMC_ESCSlip_flg VVMC_LatESCRegenOut_Gps VVMC_RDCDetectTime_s VVMC_RDCEnSlideRate_pct VVMC_RWDRDCActive_enum VVMC_StESCYawCom_Dps VVMC_StESCYaw_Dps /end REF_MEASUREMENT
/end GROUP
/begin GROUP S1922_ISO22179 "SWC_FDC_type/run_SWC_FDC_RxTx_5ms_sys/APP/VMC/VMC/SPD2ACC/ISO22179"
 /begin REF_CHARACTERISTIC KVMC_DISCAccCtrlLimit_mps2 KVMC_DISCDecCtrlJerk_mps3 KVMC_DISCDecCtrlLimit_mps2 MVMC_ISOAccLimit_Y_mps2 MVMC_ISODecLimit_Y_mps2 MVMC_ISOJerk_Y_mps3 /end REF_CHARACTERISTIC
 /begin REF_MEASUREMENT VVMC_DISCDecCtrl_flg VVMC_ISOAccLimit_mps2 VVMC_ISODecLimit_mps2 VVMC_ISOJerkLimit_mps3 /end REF_MEASUREMENT
/end GROUP
/begin GROUP S1922_PID "SWC_FDC_type/run_SWC_FDC_RxTx_5ms_sys/APP/VMC/VMC/SPD2ACC/PID" /begin REF_CHARACTERISTIC KVMC_AccelIGain_enum KVMC_IParm_enum KVMC_PParm_enum /end REF_CHARACTERISTIC
 /begin REF_MEASUREMENT VVMC_AccCalcuPIDIGain_mps2 VVMC_AccCalcuPIDPGain_mps2 VVMC_AccCalcuPID_mps2 VVMC_MeterSpdCalcu_mps /end REF_MEASUREMENT
/end GROUP
/begin GROUP S1922_VVMC_DISReqAcc_mps2 "SWC_FDC_type/run_SWC_FDC_RxTx_5ms_sys/APP/VMC/VMC/SPD2ACC/VVMC_DISReqAcc_mps2"
 /begin SUB_GROUP S2069_SR_Latch1 S2069_SR_Latch10 S2069_SR_Latch11 S2069_SR_Latch12 S2069_SR_Latch13 S2069_SR_Latch14 S2069_SR_Latch15 S2069_SR_Latch17 S2069_SR_Latch2 S2069_SR_Latch3 S2069_SR_Latch4 S2069_SR_Latch5 S2069_SR_Latch9 S2069_Triggered_Subsystem4 S2069_Triggered_Subsystem6 /end SUB_GROUP
 /begin REF_CHARACTERISTIC KVMC_ACCSpdCtrlSW_flg KVMC_ADASWhlTqLimRat_rat KVMC_ADSDecAlwaysShift_flg KVMC_ADSDecRspsRatio_rat KVMC_ADSDecShiftSW_flg KVMC_AGSVReqAccel_mps2 KVMC_AccelCtrlTqLowerLimit_Nm KVMC_CMDRepeatTime_enum KVMC_CallBrkJoinSpd_kph KVMC_DISCDecCtrlJerk_mps3 KVMC_DISCDecNoBrk_flg KVMC_GravityValue_mps2 KVMC_MCPPassHoldDecTime_s KVMC_OVRD2ActRampSW_flg KVMC_ReachSpeedCountTime_s KVMC_ReachSpeedCount_flg KVMC_ReqAccelLowerLimit_mps2 KVMC_ReqBrkInDecSW_flg KVMC_ReqBrkJoinWaitTime_s KVMC_ReqDecelLowerLimit_mps2 KVMC_SPD2ACCLastAccelSourceSW_flg KVMC_SpdCtrlDisBand_kph KVMC_SpdCtrlEnBand_kph KVMC_SpdCtrlReqAccel_mps2 KVMC_SprtAccelCMDSW_flg KVMC_TqAccelCtrlBand_mps2 KVMC_VehHoldCal1BigDeltaAcc_mps2 KVMC_VehHoldDecCtrlBSlope4ATH_mps3 KVMC_VehHoldDecCtrlBSlopeCal1_mps3 KVMC_VehHoldDecCtrlBSlope_mps3 KVMC_VehHoldDecCtrlMaxDec_mps2 KVMC_VehHoldDecCtrl_flg KVMC_VehHoldDelayMCP_bar KVMC_VehHoldDelaySW_flg KVMC_VehHoldDeltaAccDB_mps2 KVMC_VehHoldDist_m KVMC_VehHoldHTimeNoMCPCnt_s KVMC_VehHoldHTimeNoMCP_bar KVMC_VehHoldHoldDecTime_s MVMC_OVRD2ActSR2FCMCMD_Y_mps3 MVMC_ReqBrkJoinDecSR_Y_mps3 MVMC_VehHoldDecCtrlTime2_Y_s MVMC_VehHoldDecCtrlTime_Y_s MVMC_VehHoldMCPPass2_Y_bar MVMC_VehHoldMCPPass_Y_bar /end REF_CHARACTERISTIC
 /begin REF_MEASUREMENT VVMC_ACCConSpdCtrlCMD_mps2 VVMC_ACCRequiredAccel_mps2 VVMC_ACCVehHoldReq_flg VVMC_ADASWhlTqReachLim_flg VVMC_AbsDeltaSpdNotZero_flg VVMC_AccAct_flg VVMC_AccelTurnHoldDet_flg VVMC_ActACCReqAcc4ADS_mps2 VVMC_ActACCRequiredAccel_mps2 VVMC_AfterCtrlACCReqAccel_mps2 VVMC_DISCConSpdCtrlCMD_mps2 VVMC_DISCReqAccAftLim_mps2 VVMC_DISCReqAccAftRepeat_mps2 VVMC_FeatArbitrFinal_enum VVMC_ISOJerkLimitFinal_mps3 VVMC_JerkSource_mps2 VVMC_OVRD2ActReqAccelAftSR_mps2 VVMC_PreACCReqAcc_mps2 VVMC_ReqAccelActive_flg VVMC_VehHoldDecCtrlAccel_mps2 VVMC_VehHoldDecCtrlBSlopeCal1_mps3 VVMC_VehHoldDecCtrlBSlopeCal2_mps3 VVMC_VehHoldDecCtrlBSlope_mps3 VVMC_VehHoldDeltaAccSta_enum VVMC_VehHoldEnReqAccel_mps2 VVMC_WhlBackward_flg VVMC_WhlStandstill_flg /end REF_MEASUREMENT
/end GROUP
/begin GROUP S1923_Estimate_Slope "SWC_FDC_type/run_SWC_FDC_RxTx_5ms_sys/APP/VMC/VMC/SafetyControl/Estimate Slope"
 /begin REF_CHARACTERISTIC KVMC_EstSlopeLongAccelTs_c KVMC_EstSlopeSW_flg KVMC_EstSlopeTs_c KVMC_EstSlopeVehSpdTs_c /end REF_CHARACTERISTIC
 /begin REF_MEASUREMENT VVMC_EstSlopeCal_Deg /end REF_MEASUREMENT
/end GROUP
/begin GROUP S1923_FirstOrderFilter "SWC_FDC_type/run_SWC_FDC_RxTx_5ms_sys/APP/VMC/VMC/SafetyControl/FirstOrderFilter" /begin REF_MEASUREMENT VVMC_RRWhlSpeedRollAve_kph /end REF_MEASUREMENT /end GROUP
/begin GROUP S1923_FirstOrderFilter1 "SWC_FDC_type/run_SWC_FDC_RxTx_5ms_sys/APP/VMC/VMC/SafetyControl/FirstOrderFilter1" /begin REF_MEASUREMENT VVMC_LRWhlSpeedRollAve_kph /end REF_MEASUREMENT /end GROUP
/begin GROUP S1923_FirstOrderFilter2 "SWC_FDC_type/run_SWC_FDC_RxTx_5ms_sys/APP/VMC/VMC/SafetyControl/FirstOrderFilter2" /begin REF_MEASUREMENT VVMC_RFWhlSpeedRollAve_kph /end REF_MEASUREMENT /end GROUP
/begin GROUP S1923_FirstOrderFilter3 "SWC_FDC_type/run_SWC_FDC_RxTx_5ms_sys/APP/VMC/VMC/SafetyControl/FirstOrderFilter3" /begin REF_MEASUREMENT VVMC_LFWhlSpeedRollAve_kph /end REF_MEASUREMENT /end GROUP
/begin GROUP S1284_Drive_Protection "SWC_FDC_type/run_SWC_FDC_RxTx_5ms_sys/APP/TQD/TorqueDemand/ShiftModule/GearShiftPosn/Drive Protection" /begin REF_CHARACTERISTIC KTQD_DriveProtVehSpdGain_kph /end REF_CHARACTERISTIC /end GROUP
/begin GROUP S1483_DriverTqCoordination "SWC_FDC_type/run_SWC_FDC_RxTx_5ms_sys/APP/TQD/TorqueDemand/TorqueModule/DriverWhlTqDem/DriverTqCoordination" /begin REF_CHARACTERISTIC KTQD_EscModeTqLimSpdDev_kph KTQD_EscModeWhlSpdDely_cnt /end REF_CHARACTERISTIC /end GROUP
/begin GROUP S1483_PedalMapWhlTq "SWC_FDC_type/run_SWC_FDC_RxTx_5ms_sys/APP/TQD/TorqueDemand/TorqueModule/DriverWhlTqDem/PedalMapWhlTq" /begin REF_CHARACTERISTIC KVMC_ACCOvrdTestSW_flg /end REF_CHARACTERISTIC /end GROUP
/begin GROUP S1485_Deceleration_Calculation "SWC_FDC_type/run_SWC_FDC_RxTx_5ms_sys/APP/TQD/TorqueDemand/TorqueModule/OPD Hold/Deceleration Calculation" /begin REF_CHARACTERISTIC KVMC_GravityValue_mps2 /end REF_CHARACTERISTIC /end GROUP
/begin GROUP S1485_Parking_Requeest_Backup "SWC_FDC_type/run_SWC_FDC_RxTx_5ms_sys/APP/TQD/TorqueDemand/TorqueModule/OPD Hold/Parking Requeest Backup" /begin REF_CHARACTERISTIC KTQD_OPDHoldAllowGearPSW_flg /end REF_CHARACTERISTIC /end GROUP
/begin GROUP S1647_Front_torque_ramp_limtation_and_determination "SWC_FDC_type/run_SWC_FDC_RxTx_5ms_sys/APP/TQR/Determine Torque Request/TorqueArbitrament/TorqueSmooth/Front torque ramp limtation and determination" /begin REF_CHARACTERISTIC KTQR_FinalFEDUTrqLowLim_Nm KTQR_FinalFEDUTrqUpLim_Nm /end REF_CHARACTERISTIC /end GROUP
/begin GROUP S1647_Front_wheel_first_order_filter_input_torque_command_determination "SWC_FDC_type/run_SWC_FDC_RxTx_5ms_sys/APP/TQR/Determine Torque Request/TorqueArbitrament/TorqueSmooth/Front wheel first order filter input torque command determination" /begin REF_CHARACTERISTIC KTQR_GearChangeTqSW_flg KTQR_NewRampArchSW_flg /end REF_CHARACTERISTIC /end GROUP
/begin GROUP S1647_Rear_torque_ramp_limtation_and_determination "SWC_FDC_type/run_SWC_FDC_RxTx_5ms_sys/APP/TQR/Determine Torque Request/TorqueArbitrament/TorqueSmooth/Rear torque ramp limtation and determination" /begin REF_CHARACTERISTIC KTQR_FinalREDUTrqLowLim_Nm KTQR_FinalREDUTrqUpLim_Nm /end REF_CHARACTERISTIC /end GROUP
/begin GROUP S1647_Rear_wheel_first_order_filter_input_torque_command_determination "SWC_FDC_type/run_SWC_FDC_RxTx_5ms_sys/APP/TQR/Determine Torque Request/TorqueArbitrament/TorqueSmooth/Rear wheel first order filter input torque command determination" /begin REF_CHARACTERISTIC KTQR_GearChangeTqSW_flg KTQR_NewRampArchSW_flg /end REF_CHARACTERISTIC /end GROUP
/begin GROUP S1355_ACC_Speed_Setting_ON "SWC_FDC_type/run_SWC_FDC_RxTx_5ms_sys/APP/TQD/TorqueDemand/Signal_convert/SWC2_Subsystem/Speed Setting Mode/ACC Speed Setting ON" /begin REF_CHARACTERISTIC KVMC_AllowSetSpdDist_m KVMC_NotAllowSetSpdDist_m /end REF_CHARACTERISTIC /end GROUP
/begin GROUP S1355_CC_Speed_Setting_ON "SWC_FDC_type/run_SWC_FDC_RxTx_5ms_sys/APP/TQD/TorqueDemand/Signal_convert/SWC2_Subsystem/Speed Setting Mode/CC Speed Setting ON"
 /begin REF_CHARACTERISTIC KTQD_CCActiveMetSpdHiMPH_mph KTQD_CCActiveMetSpdHi_kph KTQD_CCActiveMetSpdLoMPH_mph KTQD_CCActiveMetSpdLo_kph /end REF_CHARACTERISTIC
/end GROUP
/begin GROUP S1355_MSA_Speed_Setting_ON "SWC_FDC_type/run_SWC_FDC_RxTx_5ms_sys/APP/TQD/TorqueDemand/Signal_convert/SWC2_Subsystem/Speed Setting Mode/MSA Speed Setting ON"
 /begin REF_CHARACTERISTIC KTQD_MSAActiveMetSpdHiMPH_mph KTQD_MSAActiveMetSpdHi_kph KTQD_MSAActiveMetSpdLoMPH_mph KTQD_MSAActiveMetSpdLo_kph /end REF_CHARACTERISTIC
/end GROUP
/begin GROUP S1394_ACC_Speed_Setting_ON "SWC_FDC_type/run_SWC_FDC_RxTx_5ms_sys/APP/TQD/TorqueDemand/Signal_convert/SWC_Subsystem/Speed Setting Mode/ACC Speed Setting ON" /begin REF_CHARACTERISTIC KVMC_AllowSetSpdDist_m KVMC_NotAllowSetSpdDist_m /end REF_CHARACTERISTIC /end GROUP
/begin GROUP S1394_CC_Speed_Setting_ON "SWC_FDC_type/run_SWC_FDC_RxTx_5ms_sys/APP/TQD/TorqueDemand/Signal_convert/SWC_Subsystem/Speed Setting Mode/CC Speed Setting ON"
 /begin REF_CHARACTERISTIC KTQD_CCActiveMetSpdHiMPH_mph KTQD_CCActiveMetSpdHi_kph KTQD_CCActiveMetSpdLoMPH_mph KTQD_CCActiveMetSpdLo_kph /end REF_CHARACTERISTIC
/end GROUP
/begin GROUP S1394_MSA_Speed_Setting_ON "SWC_FDC_type/run_SWC_FDC_RxTx_5ms_sys/APP/TQD/TorqueDemand/Signal_convert/SWC_Subsystem/Speed Setting Mode/MSA Speed Setting ON"
 /begin REF_CHARACTERISTIC KTQD_MSAActiveMetSpdHiMPH_mph KTQD_MSAActiveMetSpdHi_kph KTQD_MSAActiveMetSpdLoMPH_mph KTQD_MSAActiveMetSpdLo_kph /end REF_CHARACTERISTIC
/end GROUP
/begin GROUP S1427_Vehicle_Weight "SWC_FDC_type/run_SWC_FDC_RxTx_5ms_sys/APP/TQD/TorqueDemand/Signal_convert/VehWeightEst/Calaulation/Vehicle Weight" /begin REF_CHARACTERISTIC KTQR_FrTMGearEff_c KTQR_RrTMGearEff_c /end REF_CHARACTERISTIC /end GROUP
/begin GROUP S1499_Motoring "SWC_FDC_type/run_SWC_FDC_RxTx_5ms_sys/APP/TQD/TorqueDemand/TorqueModule/AvaliableTqLimit/TorqueCapacityCalcalation/Motoring" /begin REF_CHARACTERISTIC KTQD_FrUppTheldTrq_Nm KTQD_RrUppTheldTrq_Nm /end REF_CHARACTERISTIC /end GROUP
/end MODULE
/end PROJECT
