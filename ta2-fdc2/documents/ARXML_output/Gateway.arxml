AUTOSAR XML (schema 4-3-0)
package /Gateway
  gateway Gateway_FUSION: ecu=FUSION
    signal-mappings:
      source-signal=ST_CAN4_AirPressureFC2, target-signal=ST_CAN1_AirPressureFC2
      source-signal=ST_CAN4_AirPressureRC1, target-signal=ST_CAN1_AirPressureRC1
      source-signal=ST_CAN4_AirPressurePC3, target-signal=ST_CAN1_AirPressurePC3
      source-signal=ST_CAN4_ParkBrakeSW, target-signal=ST_CAN1_ParkBrakeSW
      source-signal=ST_CAN3_MCUFailGrade, target-signal=ST_CAN2_MCUFailGrade
      source-signal=ST_CAN3_B2VChgMode, target-signal=ST_CAN2_B2VChgMode
      source-signal=ST_CAN3_B2VDCChgConnSta, target-signal=ST_CAN2_B2VDCChgConnSta
      source-signal=ST_CAN3_B2VPChrgConnSta, target-signal=ST_CAN2_B2VPChrgConnSta
      source-signal=ST_CAN3_B2VChgSta, target-signal=ST_CAN2_B2VChgSta
      source-signal=ST_CAN3_B2VSOC, target-signal=ST_CAN2_B2VSOC
      source-signal=ST_CAN3_B2VSOH, target-signal=ST_CAN2_B2VSOH
      source-signal=ST_CAN3_B2VFaultCode, target-signal=ST_CAN2_B2VFaultCode
      source-signal=ST_CAN3_B2VBI1RateHVolt, target-signal=ST_CAN2_B2VBI1RateHVolt
      source-signal=ST_CAN3_B2VBI1BattType, target-signal=ST_CAN2_B2VBI1BattType
      source-signal=ST_CAN3_B2VBI1RateCap, target-signal=ST_CAN2_B2VBI1RateCap
      source-signal=ST_CAN3_B2VBI1RatePower, target-signal=ST_CAN2_B2VBI1RatePower
      source-signal=ST_CAN3_B2THVRlySta, target-signal=ST_CAN2_B2THVRlySta
      source-signal=ST_CAN1_WhlSpeed_FL, target-signal=ST_CAN2_WhlSpeed_FL
      source-signal=ST_CAN1_WhlSpeed_FR, target-signal=ST_CAN2_WhlSpeed_FR
      source-signal=ST_CAN1_WhlSpeed_RL, target-signal=ST_CAN2_WhlSpeed_RL
      source-signal=ST_CAN1_WhlSpeed_RR, target-signal=ST_CAN2_WhlSpeed_RR
      source-signal=ST_CAN1_TransReqGear, target-signal=ST_CAN2_TransReqGear
      source-signal=ST_CAN1_ASC1KneelingInfo, target-signal=ST_CAN2_ASC1KneelingInfo
      source-signal=ST_CAN1_ACTempSetSta, target-signal=ST_CAN2_ACTempSetSta
      source-signal=ST_CAN1_EBSBrakeSw, target-signal=ST_CAN2_EBSBrakeSw
      source-signal=ST_CAN1_ASREngCtrlAtc, target-signal=ST_CAN2_ASREngCtrlAtc
      source-signal=ST_CAN1_ABSFullyOper, target-signal=ST_CAN2_ABSFullyOper
      source-signal=ST_CAN1_EBSAmWarnLampSta, target-signal=ST_CAN2_EBSAmWarnLampSta
      source-signal=ST_CAN1_ASRBrakeCtrlAtc, target-signal=ST_CAN2_ASRBrakeCtrlAtc
      source-signal=ST_CAN1_EBSRedWarnLampSta, target-signal=ST_CAN2_EBSRedWarnLampSta
      source-signal=ST_CAN1_VDCBrakeLightReq, target-signal=ST_CAN2_VDCBrakeLightReq
      source-signal=ST_CAN1_ECASAWarmLampSta, target-signal=ST_CAN2_ECASAWarmLampSta
      source-signal=ST_CAN1_ACMODESta, target-signal=ST_CAN2_ACMODESta
      source-signal=ST_CAN1_LFSensorFail, target-signal=ST_CAN2_LFSensorFail
      source-signal=ST_CAN1_RBOBatWarn, target-signal=ST_CAN2_RBOBatWarn
      source-signal=ST_CAN1_RBIWheelTmpIndi, target-signal=ST_CAN2_RBIWheelTmpIndi
      source-signal=ST_CAN1_LFWheelTmpIndi, target-signal=ST_CAN2_LFWheelTmpIndi
      source-signal=ST_CAN1_LBIPressIndi, target-signal=ST_CAN2_LBIPressIndi
      source-signal=ST_CAN1_RBIBatWarn, target-signal=ST_CAN2_RBIBatWarn
      source-signal=ST_CAN1_LFBatWarn, target-signal=ST_CAN2_LFBatWarn
      source-signal=ST_CAN1_RBIPressIndi, target-signal=ST_CAN2_RBIPressIndi
      source-signal=ST_CAN1_LBOPressIndi, target-signal=ST_CAN2_LBOPressIndi
      source-signal=ST_CAN1_RBISensorFail, target-signal=ST_CAN2_RBISensorFail
      source-signal=ST_CAN1_LBIBatWarn, target-signal=ST_CAN2_LBIBatWarn
      source-signal=ST_CAN1_LBOBatWarn, target-signal=ST_CAN2_LBOBatWarn
      source-signal=ST_CAN1_RBOSensorFail, target-signal=ST_CAN2_RBOSensorFail
      source-signal=ST_CAN1_LBISensorFail, target-signal=ST_CAN2_LBISensorFail
      source-signal=ST_CAN1_RBOPressIndi, target-signal=ST_CAN2_RBOPressIndi
      source-signal=ST_CAN1_LBOSensorFail, target-signal=ST_CAN2_LBOSensorFail
      source-signal=ST_CAN1_RFWheelTmpIndi, target-signal=ST_CAN2_RFWheelTmpIndi
      source-signal=ST_CAN1_RFSensorFail, target-signal=ST_CAN2_RFSensorFail
      source-signal=ST_CAN1_RFBatWarn, target-signal=ST_CAN2_RFBatWarn
      source-signal=ST_CAN1_LBOWheelTmpIndi, target-signal=ST_CAN2_LBOWheelTmpIndi
      source-signal=ST_CAN1_LBIWheelTmpIndi, target-signal=ST_CAN2_LBIWheelTmpIndi
      source-signal=ST_CAN1_TPMSWarnIndi, target-signal=ST_CAN2_TPMSWarnIndi
      source-signal=ST_CAN1_LFPressIndi, target-signal=ST_CAN2_LFPressIndi
      source-signal=ST_CAN1_RFPressIndi, target-signal=ST_CAN2_RFPressIndi
      source-signal=ST_CAN1_RBOWheelTmpIndi, target-signal=ST_CAN2_RBOWheelTmpIndi
      source-signal=ST_CAN1_RFWheelPress, target-signal=ST_CAN2_RFWheelPress
      source-signal=ST_CAN1_LFWheelPress, target-signal=ST_CAN2_LFWheelPress
      source-signal=ST_CAN1_RBOWheelPress, target-signal=ST_CAN2_RBOWheelPress
      source-signal=ST_CAN1_LBOWheelPress, target-signal=ST_CAN2_LBOWheelPress
      source-signal=ST_CAN1_LBIWheelPress, target-signal=ST_CAN2_LBIWheelPress
      source-signal=ST_CAN1_RBIWheelPress, target-signal=ST_CAN2_RBIWheelPress
      source-signal=ST_CAN1_LBOWheelTemp, target-signal=ST_CAN2_LBOWheelTemp
      source-signal=ST_CAN1_LFWheelTemp, target-signal=ST_CAN2_LFWheelTemp
      source-signal=ST_CAN1_RFWheelTemp, target-signal=ST_CAN2_RFWheelTemp
      source-signal=ST_CAN1_LBIWheelTemp, target-signal=ST_CAN2_LBIWheelTemp
      source-signal=ST_CAN1_RBOWheelTemp, target-signal=ST_CAN2_RBOWheelTemp
      source-signal=ST_CAN1_THCM_Faultlv_Sta, target-signal=ST_CAN2_THCM_Faultlv_Sta
      source-signal=ST_CAN4_ZFR_CHASSIS_LiningWearFL_Sta, target-signal=ST_CAN2_ZFR_CHASSIS_LiningWearFL_Sta
      source-signal=ST_CAN4_ZFR_CHASSIS_LiningWearFR_Sta, target-signal=ST_CAN2_ZFR_CHASSIS_LiningWearFR_Sta
      source-signal=ST_CAN4_ZRR_CHASSIS_LiningWearRL_Sta, target-signal=ST_CAN2_ZRR_CHASSIS_LiningWearRL_Sta
      source-signal=ST_CAN4_ZRR_CHASSIS_LiningWearRR_Sta, target-signal=ST_CAN2_ZRR_CHASSIS_LiningWearRR_Sta
      source-signal=ST_CAN4_ParkBrakeSW, target-signal=ST_CAN2_ParkBrakeSW
      source-signal=ST_CAN4_AirPressureRC1, target-signal=ST_CAN2_AirPressureRC1
      source-signal=ST_CAN4_EHPS_ErrLv_Sta, target-signal=ST_CAN2_EHPS_ErrLv_Sta
      source-signal=ST_CAN4_DCDC_En_Sta, target-signal=ST_CAN2_DCDC_En_Sta
