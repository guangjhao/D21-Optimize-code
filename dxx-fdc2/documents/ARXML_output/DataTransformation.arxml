AUTOSAR XML (schema 4-3-0)
package /DataTransformations
  data transformation set DataTransformationSet
    data transformation E2E_PROFILE_01_f1ae109c76f1361fcd300fee8a00ef77_crc0_cntr8_24: transformer-chain=[ComBasedTransformer_24, Technology_E2E_PROFILE_01_f1ae109c76f1361fcd300fee8a00ef77_crc0_cntr8]
    data transformation E2E_PROFILE_01_CAN3_SG_FD3_VCU1: transformer-chain=[ComBasedTransformer_8, Technology_E2E_PROFILE_01_CAN3_SG_FD3_VCU1]
    data transformation E2E_PROFILE_01_CAN3_SG_FD3_VCU1_toNIDEC: transformer-chain=[ComBasedTransformer_8, Technology_E2E_PROFILE_01_CAN3_SG_FD3_VCU1_toNIDEC]
    4 x transformation technology:
      ComBasedTransformer_24: buffer-properties={buffer-computation=compu-rational-coeffs={compu-numerator=24, compu-denominator=1}, header-length=0, in-place=false}, protocol=COMBased, transformer-class=SERIALIZER, version=1
      ComBasedTransformer_8: buffer-properties={buffer-computation=compu-rational-coeffs={compu-numerator=8, compu-denominator=1}, header-length=0, in-place=false}, protocol=COMBased, transformer-class=SERIALIZER, version=1
      Technology_E2E_PROFILE_01_CAN3_SG_FD3_VCU1:
        buffer-properties={header-length=0, in-place=true}
        protocol=E2E
        end-to-end-transformation-description{counter-offset=8, crc-offset=0, data-id-mode=ALL-16-BIT, max-delta-counter=2, max-error-state-init=1, max-error-state-invalid=1, max-error-state-valid=0, max-no-new-or-repeated-data=0, min-ok-state-init=0, min-ok-state-invalid=0, min-ok-state-valid=0, profile-behavior=R-4--2, profile-name=PROFILE_01, sync-counter-init=0, upper-header-bits-to-shift=0, window-size=3}
        transformer-class=SAFETY
        version=1.0.0
      Technology_E2E_PROFILE_01_CAN3_SG_FD3_VCU1_toNIDEC:
        buffer-properties={header-length=0, in-place=true}
        protocol=E2E
        end-to-end-transformation-description{counter-offset=12, crc-offset=0, data-id-mode=ALL-16-BIT, max-delta-counter=2, max-error-state-init=1, max-error-state-invalid=1, max-error-state-valid=0, max-no-new-or-repeated-data=0, min-ok-state-init=0, min-ok-state-invalid=0, min-ok-state-valid=0, profile-behavior=R-4--2, profile-name=PROFILE_01, sync-counter-init=0, upper-header-bits-to-shift=0, window-size=3}
        transformer-class=SAFETY
        version=1.0.0
