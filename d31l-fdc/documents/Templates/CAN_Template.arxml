AUTOSAR XML (schema 4-3-0)
package /PutChannelHere/Frame
  can frame FrameName: frame-length=8
    pdu to frame mapping FD_VCU1: packing-byte-order=little-endian, pdu=FD_VCU1, start-position=0
package /PutChannelHere/PDU
  pdu IPDUName: length=8, minimum-delay=0.0, transmission-mode-true-timing={cyclic-timing=time-period=0.1, event-controlled-timing={number-of-repetitions=1, repetition-period=0.01}}, unused-bit-pattern=0
    mapping SignalGroup: i-signal-group=SignalGroup, start-position=0, transfer-property=SignalGroupTransfer
    mapping Signals: i-signal=Signals, packing-byte-order=big-endian, start-position=375, transfer-property=PENDING
  nm pdu NmPDUName: length=8, nm-data-information=true, nm-vote-information=true, unused-bit-pattern=0
    mapping Signals: i-signal=Nm_Signal, packing-byte-order=big-endian, start-position=16, transfer-property=PENDING
  n pdu NPDUName: length=8
package /PutChannelHere/ISignal
  i signal ISignal: i-signal-type=PRIMITIVE, init-value=constant-reference=Init_ISignal, length=3, base-type=uint8, implementation-data-type=uint8, system-signal=CAN1_PwrSta
package /PutChannelHere/ISignalGroup
  i signal group TargetSignalGroup: i-signal=PwrSta, system-signal-group=SG_FD_VCU1
package /PutChannelHere/Signal
  system signal PwrSta
package /PutChannelHere/SignalGroup
  system signal group TargetSystemSignalGroup: system-signal=PwrSta
package /PutChannelHere/Cluster
  can cluster CANChannel: baudrate=500, can-fd-baudrate=2000
    can physical channel PhysicalChannel: comm-connectors=ConnCAN3
      frame FD_VCU1: id 0x116, can-addressing-mode=STANDARD, can-fd-frame-support=true, can-frame-rx-behavior=CAN-FD, can-frame-tx-behavior=CAN-FD
      pdu triggering PDUTriggerings: pdu=FD_VCU1
package /PutChannelHere/ConstantSpecification
  constant specification SignalInitialValue: value-spec=0
  constant specification SignalGroupInitialValues: value-spec=fields=constant-reference=Init_PwrSta
package /PutChannelHere/ImplementationDataTypes
  impl type SignalGroupDataType: category=STRUCTURE
    element SignalsInSignalGroup: implementation-data-type=uint8
