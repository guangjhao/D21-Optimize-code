ASAP2_VERSION 1 31
/begin PROJECT ProjectName "Project Comment Goes Here"
/begin HEADER "Header Comments go here" /end HEADER
/begin MODULE ModuleName "Module Comment Goes Here"
/begin MOD_COMMON "Mod Common Comment Here" BYTE_ORDER MSB_LAST /end MOD_COMMON
/begin RECORD_LAYOUT Scalar_BOOLEAN FNC_VALUES 1 UBYTE COLUMN_DIR DIRECT /end RECORD_LAYOUT
/begin RECORD_LAYOUT Scalar_UBYTE FNC_VALUES 1 UBYTE COLUMN_DIR DIRECT /end RECORD_LAYOUT
/begin RECORD_LAYOUT Scalar_UWORD FNC_VALUES 1 UWORD COLUMN_DIR DIRECT /end RECORD_LAYOUT
/begin RECORD_LAYOUT Scalar_ULONG FNC_VALUES 1 ULONG COLUMN_DIR DIRECT /end RECORD_LAYOUT
/begin RECORD_LAYOUT Scalar_FLOAT32_IEEE FNC_VALUES 1 FLOAT32_IEEE COLUMN_DIR DIRECT /end RECORD_LAYOUT
/begin RECORD_LAYOUT Lookup2D_X_ULONG AXIS_PTS_X 1 ULONG INDEX_INCR DIRECT /end RECORD_LAYOUT
/begin RECORD_LAYOUT Lookup2D_LONG FNC_VALUES 1 SLONG COLUMN_DIR DIRECT /end RECORD_LAYOUT
/begin RECORD_LAYOUT Lookup2D_X_LONG AXIS_PTS_X 1 SLONG INDEX_INCR DIRECT /end RECORD_LAYOUT
/begin RECORD_LAYOUT Lookup2D_FLOAT32_IEEE FNC_VALUES 1 FLOAT32_IEEE COLUMN_DIR DIRECT /end RECORD_LAYOUT
/begin RECORD_LAYOUT Lookup2D_X_FLOAT32_IEEE AXIS_PTS_X 1 FLOAT32_IEEE INDEX_INCR DIRECT /end RECORD_LAYOUT
/begin RECORD_LAYOUT Lookup2D_FLOAT64_IEEE FNC_VALUES 1 FLOAT64_IEEE COLUMN_DIR DIRECT /end RECORD_LAYOUT
/begin RECORD_LAYOUT Lookup2D_X_FLOAT64_IEEE AXIS_PTS_X 1 FLOAT64_IEEE INDEX_INCR DIRECT /end RECORD_LAYOUT
/begin CHARACTERISTIC KINP_ACCComfortBandLower_mps2_defval "" VALUE 0x0000 /* @ECU_Address@KINP_ACCComfortBandLower_mps2_defval@ */ Scalar_FLOAT32_IEEE 0 SWC_INP_type_CM_single_mps2 -15.0 10.55 /end CHARACTERISTIC
/begin CHARACTERISTIC KINP_ACCComfortBandLower_mps2_ovrdval "" VALUE 0x0000 /* @ECU_Address@KINP_ACCComfortBandLower_mps2_ovrdval@ */ Scalar_FLOAT32_IEEE 0 SWC_INP_type_CM_single_mps2 -15.0 10.55 /end CHARACTERISTIC
/begin CHARACTERISTIC KINP_ACCComfortBandUpper_mps2_defval "" VALUE 0x0000 /* @ECU_Address@KINP_ACCComfortBandUpper_mps2_defval@ */ Scalar_FLOAT32_IEEE 0 SWC_INP_type_CM_single_mps2 -15.0 10.55 /end CHARACTERISTIC
/begin CHARACTERISTIC KINP_ACCComfortBandUpper_mps2_ovrdval "" VALUE 0x0000 /* @ECU_Address@KINP_ACCComfortBandUpper_mps2_ovrdval@ */ Scalar_FLOAT32_IEEE 0 SWC_INP_type_CM_single_mps2 -15.0 10.55 /end CHARACTERISTIC
/begin CHARACTERISTIC KINP_ACCJerkLowerLimit_mps3_defval "" VALUE 0x0000 /* @ECU_Address@KINP_ACCJerkLowerLimit_mps3_defval@ */ Scalar_FLOAT32_IEEE 0 SWC_INP_type_CM_single_mps3 -6.0 6.7 /end CHARACTERISTIC
/begin CHARACTERISTIC KINP_ACCJerkLowerLimit_mps3_ovrdval "" VALUE 0x0000 /* @ECU_Address@KINP_ACCJerkLowerLimit_mps3_ovrdval@ */ Scalar_FLOAT32_IEEE 0 SWC_INP_type_CM_single_mps3 -6.0 6.7 /end CHARACTERISTIC
/begin CHARACTERISTIC KINP_ACCJerkUpperLimit_mps3_defval "" VALUE 0x0000 /* @ECU_Address@KINP_ACCJerkUpperLimit_mps3_defval@ */ Scalar_FLOAT32_IEEE 0 SWC_INP_type_CM_single_mps3 -6.0 6.7 /end CHARACTERISTIC
/begin CHARACTERISTIC KINP_ACCJerkUpperLimit_mps3_ovrdval "" VALUE 0x0000 /* @ECU_Address@KINP_ACCJerkUpperLimit_mps3_ovrdval@ */ Scalar_FLOAT32_IEEE 0 SWC_INP_type_CM_single_mps3 -6.0 6.7 /end CHARACTERISTIC
/begin CHARACTERISTIC KINP_ACCObjDist_m_defval "" VALUE 0x0000 /* @ECU_Address@KINP_ACCObjDist_m_defval@ */ Scalar_FLOAT32_IEEE 0 SWC_INP_type_CM_single_m 0.0 204.6 /end CHARACTERISTIC
/begin CHARACTERISTIC KINP_ACCObjDist_m_ovrdval "" VALUE 0x0000 /* @ECU_Address@KINP_ACCObjDist_m_ovrdval@ */ Scalar_FLOAT32_IEEE 0 SWC_INP_type_CM_single_m 0.0 204.6 /end CHARACTERISTIC
/begin CHARACTERISTIC KINP_ACCObjRelSpd_mps_defval "" VALUE 0x0000 /* @ECU_Address@KINP_ACCObjRelSpd_mps_defval@ */ Scalar_FLOAT32_IEEE 0 SWC_INP_type_CM_single_mps -100.0 104.6 /end CHARACTERISTIC
/begin CHARACTERISTIC KINP_ACCObjRelSpd_mps_ovrdval "" VALUE 0x0000 /* @ECU_Address@KINP_ACCObjRelSpd_mps_ovrdval@ */ Scalar_FLOAT32_IEEE 0 SWC_INP_type_CM_single_mps -100.0 104.6 /end CHARACTERISTIC
/begin CHARACTERISTIC KINP_ACCRequiredAccel_mps2_defval "" VALUE 0x0000 /* @ECU_Address@KINP_ACCRequiredAccel_mps2_defval@ */ Scalar_FLOAT32_IEEE 0 SWC_INP_type_CM_single_mps2 -15.0 10.55 /end CHARACTERISTIC
/begin CHARACTERISTIC KINP_ACCRequiredAccel_mps2_ovrdval "" VALUE 0x0000 /* @ECU_Address@KINP_ACCRequiredAccel_mps2_ovrdval@ */ Scalar_FLOAT32_IEEE 0 SWC_INP_type_CM_single_mps2 -15.0 10.55 /end CHARACTERISTIC
/begin CHARACTERISTIC KINP_ADASAngCtrlTqWeightGain_pct_defval "" VALUE 0x0000 /* @ECU_Address@KINP_ADASAngCtrlTqWeightGain_pct_defval@ */ Scalar_FLOAT32_IEEE 0 SWC_INP_type_CM_single_pct 0.0 102.0 /end CHARACTERISTIC
/begin CHARACTERISTIC KINP_ADASAngCtrlTqWeightGain_pct_ovrdval "" VALUE 0x0000 /* @ECU_Address@KINP_ADASAngCtrlTqWeightGain_pct_ovrdval@ */ Scalar_FLOAT32_IEEE 0 SWC_INP_type_CM_single_pct 0.0 102.0 /end CHARACTERISTIC
/begin CHARACTERISTIC KINP_ADASDesStrWhlAngCtrlCmd_Deg_defval "" VALUE 0x0000 /* @ECU_Address@KINP_ADASDesStrWhlAngCtrlCmd_Deg_defval@ */ Scalar_FLOAT32_IEEE 0 SWC_INP_type_CM_single_Deg -900.0 900.0 /end CHARACTERISTIC
/begin CHARACTERISTIC KINP_ADASDesStrWhlAngCtrlCmd_Deg_ovrdval "" VALUE 0x0000 /* @ECU_Address@KINP_ADASDesStrWhlAngCtrlCmd_Deg_ovrdval@ */ Scalar_FLOAT32_IEEE 0 SWC_INP_type_CM_single_Deg -900.0 900.0 /end CHARACTERISTIC
/begin CHARACTERISTIC KINP_ADASDrvInputTqBoostGain_pct_defval "" VALUE 0x0000 /* @ECU_Address@KINP_ADASDrvInputTqBoostGain_pct_defval@ */ Scalar_FLOAT32_IEEE 0 SWC_INP_type_CM_single_pct 0.0 102.0 /end CHARACTERISTIC
/begin CHARACTERISTIC KINP_ADASDrvInputTqBoostGain_pct_ovrdval "" VALUE 0x0000 /* @ECU_Address@KINP_ADASDrvInputTqBoostGain_pct_ovrdval@ */ Scalar_FLOAT32_IEEE 0 SWC_INP_type_CM_single_pct 0.0 102.0 /end CHARACTERISTIC
/begin CHARACTERISTIC KINP_ADASLanecurveL_raw32_defval "" VALUE 0x0000 /* @ECU_Address@KINP_ADASLanecurveL_raw32_defval@ */ Scalar_FLOAT32_IEEE 0 SWC_INP_type_CM_single_raw32 -0.03 0.03 /end CHARACTERISTIC
/begin CHARACTERISTIC KINP_ADASLanecurveL_raw32_ovrdval "" VALUE 0x0000 /* @ECU_Address@KINP_ADASLanecurveL_raw32_ovrdval@ */ Scalar_FLOAT32_IEEE 0 SWC_INP_type_CM_single_raw32 -0.03 0.03 /end CHARACTERISTIC
/begin CHARACTERISTIC KINP_ADASLanecurveR_raw32_defval "" VALUE 0x0000 /* @ECU_Address@KINP_ADASLanecurveR_raw32_defval@ */ Scalar_FLOAT32_IEEE 0 SWC_INP_type_CM_single_raw32 -0.03 0.03 /end CHARACTERISTIC
/begin CHARACTERISTIC KINP_ADASLanecurveR_raw32_ovrdval "" VALUE 0x0000 /* @ECU_Address@KINP_ADASLanecurveR_raw32_ovrdval@ */ Scalar_FLOAT32_IEEE 0 SWC_INP_type_CM_single_raw32 -0.03 0.03 /end CHARACTERISTIC
/begin CHARACTERISTIC KINP_ADASMaxAngCtrlOutTqLimit_Nm_defval "" VALUE 0x0000 /* @ECU_Address@KINP_ADASMaxAngCtrlOutTqLimit_Nm_defval@ */ Scalar_FLOAT32_IEEE 0 SWC_INP_type_CM_single_Nm 0.0 51.1 /end CHARACTERISTIC
/begin CHARACTERISTIC KINP_ADASMaxAngCtrlOutTqLimit_Nm_ovrdval "" VALUE 0x0000 /* @ECU_Address@KINP_ADASMaxAngCtrlOutTqLimit_Nm_ovrdval@ */ Scalar_FLOAT32_IEEE 0 SWC_INP_type_CM_single_Nm 0.0 51.1 /end CHARACTERISTIC
/begin CHARACTERISTIC KINP_COMPActualPwr_W_defval "" VALUE 0x0000 /* @ECU_Address@KINP_COMPActualPwr_W_defval@ */ Scalar_FLOAT32_IEEE 0 SWC_INP_type_CM_single_W 0.0 6000.0 /end CHARACTERISTIC
/begin CHARACTERISTIC KINP_COMPActualPwr_W_ovrdval "" VALUE 0x0000 /* @ECU_Address@KINP_COMPActualPwr_W_ovrdval@ */ Scalar_FLOAT32_IEEE 0 SWC_INP_type_CM_single_W 0.0 6000.0 /end CHARACTERISTIC
/begin CHARACTERISTIC KINP_COMPConCur_A_defval "" VALUE 0x0000 /* @ECU_Address@KINP_COMPConCur_A_defval@ */ Scalar_FLOAT32_IEEE 0 SWC_INP_type_CM_single_A 0.0 1310.7 /end CHARACTERISTIC
/begin CHARACTERISTIC KINP_COMPConCur_A_ovrdval "" VALUE 0x0000 /* @ECU_Address@KINP_COMPConCur_A_ovrdval@ */ Scalar_FLOAT32_IEEE 0 SWC_INP_type_CM_single_A 0.0 1310.7 /end CHARACTERISTIC
/begin CHARACTERISTIC KINP_COMPConVolt_V_defval "" VALUE 0x0000 /* @ECU_Address@KINP_COMPConVolt_V_defval@ */ Scalar_FLOAT32_IEEE 0 SWC_INP_type_CM_single_V 0.0 1310.7 /end CHARACTERISTIC
/begin CHARACTERISTIC KINP_COMPConVolt_V_ovrdval "" VALUE 0x0000 /* @ECU_Address@KINP_COMPConVolt_V_ovrdval@ */ Scalar_FLOAT32_IEEE 0 SWC_INP_type_CM_single_V 0.0 1310.7 /end CHARACTERISTIC
/begin CHARACTERISTIC KINP_COMPStatorSpd_rpm_defval "" VALUE 0x0000 /* @ECU_Address@KINP_COMPStatorSpd_rpm_defval@ */ Scalar_FLOAT32_IEEE 0 SWC_INP_type_CM_single_rpm 0.0 8500.0 /end CHARACTERISTIC
/begin CHARACTERISTIC KINP_COMPStatorSpd_rpm_ovrdval "" VALUE 0x0000 /* @ECU_Address@KINP_COMPStatorSpd_rpm_ovrdval@ */ Scalar_FLOAT32_IEEE 0 SWC_INP_type_CM_single_rpm 0.0 8500.0 /end CHARACTERISTIC
/begin CHARACTERISTIC KINP_ChargePercentSet_pct_defval "" VALUE 0x0000 /* @ECU_Address@KINP_ChargePercentSet_pct_defval@ */ Scalar_FLOAT32_IEEE 0 SWC_INP_type_CM_single_pct 0.0 100.0 /end CHARACTERISTIC
/begin CHARACTERISTIC KINP_ChargePercentSet_pct_ovrdval "" VALUE 0x0000 /* @ECU_Address@KINP_ChargePercentSet_pct_ovrdval@ */ Scalar_FLOAT32_IEEE 0 SWC_INP_type_CM_single_pct 0.0 100.0 /end CHARACTERISTIC
/begin CHARACTERISTIC KINP_FCMLKAStrToqReq_Nm_defval "" VALUE 0x0000 /* @ECU_Address@KINP_FCMLKAStrToqReq_Nm_defval@ */ Scalar_FLOAT32_IEEE 0 SWC_INP_type_CM_single_Nm -8.0 8.0 /end CHARACTERISTIC
/begin CHARACTERISTIC KINP_FCMLKAStrToqReq_Nm_ovrdval "" VALUE 0x0000 /* @ECU_Address@KINP_FCMLKAStrToqReq_Nm_ovrdval@ */ Scalar_FLOAT32_IEEE 0 SWC_INP_type_CM_single_Nm -8.0 8.0 /end CHARACTERISTIC
/begin CHARACTERISTIC KINP_FrntPTCLeActHeatPwr_W_defval "" VALUE 0x0000 /* @ECU_Address@KINP_FrntPTCLeActHeatPwr_W_defval@ */ Scalar_FLOAT32_IEEE 0 SWC_INP_type_CM_single_W 0.0 6375.0 /end CHARACTERISTIC
/begin CHARACTERISTIC KINP_FrntPTCLeActHeatPwr_W_ovrdval "" VALUE 0x0000 /* @ECU_Address@KINP_FrntPTCLeActHeatPwr_W_ovrdval@ */ Scalar_FLOAT32_IEEE 0 SWC_INP_type_CM_single_W 0.0 6375.0 /end CHARACTERISTIC
/begin CHARACTERISTIC KINP_FrntPTCRearLeActHeatPwr_W_defval "" VALUE 0x0000 /* @ECU_Address@KINP_FrntPTCRearLeActHeatPwr_W_defval@ */ Scalar_FLOAT32_IEEE 0 SWC_INP_type_CM_single_W 0.0 6375.0 /end CHARACTERISTIC
/begin CHARACTERISTIC KINP_FrntPTCRearLeActHeatPwr_W_ovrdval "" VALUE 0x0000 /* @ECU_Address@KINP_FrntPTCRearLeActHeatPwr_W_ovrdval@ */ Scalar_FLOAT32_IEEE 0 SWC_INP_type_CM_single_W 0.0 6375.0 /end CHARACTERISTIC
/begin CHARACTERISTIC KINP_FrntPTCRearRiActHeatPwr_W_defval "" VALUE 0x0000 /* @ECU_Address@KINP_FrntPTCRearRiActHeatPwr_W_defval@ */ Scalar_FLOAT32_IEEE 0 SWC_INP_type_CM_single_W 0.0 6375.0 /end CHARACTERISTIC
/begin CHARACTERISTIC KINP_FrntPTCRearRiActHeatPwr_W_ovrdval "" VALUE 0x0000 /* @ECU_Address@KINP_FrntPTCRearRiActHeatPwr_W_ovrdval@ */ Scalar_FLOAT32_IEEE 0 SWC_INP_type_CM_single_W 0.0 6375.0 /end CHARACTERISTIC
/begin CHARACTERISTIC KINP_FrntPTCRiActHeatPwr_W_defval "" VALUE 0x0000 /* @ECU_Address@KINP_FrntPTCRiActHeatPwr_W_defval@ */ Scalar_FLOAT32_IEEE 0 SWC_INP_type_CM_single_W 0.0 6375.0 /end CHARACTERISTIC
/begin CHARACTERISTIC KINP_FrntPTCRiActHeatPwr_W_ovrdval "" VALUE 0x0000 /* @ECU_Address@KINP_FrntPTCRiActHeatPwr_W_ovrdval@ */ Scalar_FLOAT32_IEEE 0 SWC_INP_type_CM_single_W 0.0 6375.0 /end CHARACTERISTIC
/begin CHARACTERISTIC KINP_LDrvValWdwOpened_pct_defval "" VALUE 0x0000 /* @ECU_Address@KINP_LDrvValWdwOpened_pct_defval@ */ Scalar_FLOAT32_IEEE 0 SWC_INP_type_CM_single_pct 0.0 100.0 /end CHARACTERISTIC
/begin CHARACTERISTIC KINP_LDrvValWdwOpened_pct_ovrdval "" VALUE 0x0000 /* @ECU_Address@KINP_LDrvValWdwOpened_pct_ovrdval@ */ Scalar_FLOAT32_IEEE 0 SWC_INP_type_CM_single_pct 0.0 100.0 /end CHARACTERISTIC
/begin CHARACTERISTIC KINP_LPasValWdwOpened_pct_defval "" VALUE 0x0000 /* @ECU_Address@KINP_LPasValWdwOpened_pct_defval@ */ Scalar_FLOAT32_IEEE 0 SWC_INP_type_CM_single_pct 0.0 100.0 /end CHARACTERISTIC
/begin CHARACTERISTIC KINP_LPasValWdwOpened_pct_ovrdval "" VALUE 0x0000 /* @ECU_Address@KINP_LPasValWdwOpened_pct_ovrdval@ */ Scalar_FLOAT32_IEEE 0 SWC_INP_type_CM_single_pct 0.0 100.0 /end CHARACTERISTIC
/begin CHARACTERISTIC KINP_LRLDValWdwOpened_pct_defval "" VALUE 0x0000 /* @ECU_Address@KINP_LRLDValWdwOpened_pct_defval@ */ Scalar_FLOAT32_IEEE 0 SWC_INP_type_CM_single_pct 0.0 100.0 /end CHARACTERISTIC
/begin CHARACTERISTIC KINP_LRLDValWdwOpened_pct_ovrdval "" VALUE 0x0000 /* @ECU_Address@KINP_LRLDValWdwOpened_pct_ovrdval@ */ Scalar_FLOAT32_IEEE 0 SWC_INP_type_CM_single_pct 0.0 100.0 /end CHARACTERISTIC
/begin CHARACTERISTIC KINP_LRRDValWdwOpened_pct_defval "" VALUE 0x0000 /* @ECU_Address@KINP_LRRDValWdwOpened_pct_defval@ */ Scalar_FLOAT32_IEEE 0 SWC_INP_type_CM_single_pct 0.0 100.0 /end CHARACTERISTIC
/begin CHARACTERISTIC KINP_LRRDValWdwOpened_pct_ovrdval "" VALUE 0x0000 /* @ECU_Address@KINP_LRRDValWdwOpened_pct_ovrdval@ */ Scalar_FLOAT32_IEEE 0 SWC_INP_type_CM_single_pct 0.0 100.0 /end CHARACTERISTIC
/begin CHARACTERISTIC KINP_MELaneCurvDervLt2_raw32_defval "" VALUE 0x0000 /* @ECU_Address@KINP_MELaneCurvDervLt2_raw32_defval@ */ Scalar_FLOAT32_IEEE 0 SWC_INP_type_CM_single_raw32 -0.00013 0.00013214 /end CHARACTERISTIC
/begin CHARACTERISTIC KINP_MELaneCurvDervLt2_raw32_ovrdval "" VALUE 0x0000 /* @ECU_Address@KINP_MELaneCurvDervLt2_raw32_ovrdval@ */ Scalar_FLOAT32_IEEE 0 SWC_INP_type_CM_single_raw32 -0.00013 0.00013214 /end CHARACTERISTIC
/begin CHARACTERISTIC KINP_MELaneCurvDervLt_raw32_defval "" VALUE 0x0000 /* @ECU_Address@KINP_MELaneCurvDervLt_raw32_defval@ */ Scalar_FLOAT32_IEEE 0 SWC_INP_type_CM_single_raw32 -0.00013 0.00013214 /end CHARACTERISTIC
/begin CHARACTERISTIC KINP_MELaneCurvDervLt_raw32_ovrdval "" VALUE 0x0000 /* @ECU_Address@KINP_MELaneCurvDervLt_raw32_ovrdval@ */ Scalar_FLOAT32_IEEE 0 SWC_INP_type_CM_single_raw32 -0.00013 0.00013214 /end CHARACTERISTIC
/begin CHARACTERISTIC KINP_MELaneCurvDervRt2_raw32_defval "" VALUE 0x0000 /* @ECU_Address@KINP_MELaneCurvDervRt2_raw32_defval@ */ Scalar_FLOAT32_IEEE 0 SWC_INP_type_CM_single_raw32 -0.00013 0.00013214 /end CHARACTERISTIC
/begin CHARACTERISTIC KINP_MELaneCurvDervRt2_raw32_ovrdval "" VALUE 0x0000 /* @ECU_Address@KINP_MELaneCurvDervRt2_raw32_ovrdval@ */ Scalar_FLOAT32_IEEE 0 SWC_INP_type_CM_single_raw32 -0.00013 0.00013214 /end CHARACTERISTIC
/begin CHARACTERISTIC KINP_MELaneCurvDervRt_raw32_defval "" VALUE 0x0000 /* @ECU_Address@KINP_MELaneCurvDervRt_raw32_defval@ */ Scalar_FLOAT32_IEEE 0 SWC_INP_type_CM_single_raw32 -0.00013 0.00013214 /end CHARACTERISTIC
/begin CHARACTERISTIC KINP_MELaneCurvDervRt_raw32_ovrdval "" VALUE 0x0000 /* @ECU_Address@KINP_MELaneCurvDervRt_raw32_ovrdval@ */ Scalar_FLOAT32_IEEE 0 SWC_INP_type_CM_single_raw32 -0.00013 0.00013214 /end CHARACTERISTIC
/begin CHARACTERISTIC KINP_MELaneCurvLt2_raw32_defval "" VALUE 0x0000 /* @ECU_Address@KINP_MELaneCurvLt2_raw32_defval@ */ Scalar_FLOAT32_IEEE 0 SWC_INP_type_CM_single_raw32 -0.032 0.033535 /end CHARACTERISTIC
/begin CHARACTERISTIC KINP_MELaneCurvLt2_raw32_ovrdval "" VALUE 0x0000 /* @ECU_Address@KINP_MELaneCurvLt2_raw32_ovrdval@ */ Scalar_FLOAT32_IEEE 0 SWC_INP_type_CM_single_raw32 -0.032 0.033535 /end CHARACTERISTIC
/begin CHARACTERISTIC KINP_MELaneCurvLt_raw32_defval "" VALUE 0x0000 /* @ECU_Address@KINP_MELaneCurvLt_raw32_defval@ */ Scalar_FLOAT32_IEEE 0 SWC_INP_type_CM_single_raw32 -0.032 0.033535 /end CHARACTERISTIC
/begin CHARACTERISTIC KINP_MELaneCurvLt_raw32_ovrdval "" VALUE 0x0000 /* @ECU_Address@KINP_MELaneCurvLt_raw32_ovrdval@ */ Scalar_FLOAT32_IEEE 0 SWC_INP_type_CM_single_raw32 -0.032 0.033535 /end CHARACTERISTIC
/begin CHARACTERISTIC KINP_MELaneCurvRt2_raw32_defval "" VALUE 0x0000 /* @ECU_Address@KINP_MELaneCurvRt2_raw32_defval@ */ Scalar_FLOAT32_IEEE 0 SWC_INP_type_CM_single_raw32 -0.032 0.033535 /end CHARACTERISTIC
/begin CHARACTERISTIC KINP_MELaneCurvRt2_raw32_ovrdval "" VALUE 0x0000 /* @ECU_Address@KINP_MELaneCurvRt2_raw32_ovrdval@ */ Scalar_FLOAT32_IEEE 0 SWC_INP_type_CM_single_raw32 -0.032 0.033535 /end CHARACTERISTIC
/begin CHARACTERISTIC KINP_MELaneCurvRt_raw32_defval "" VALUE 0x0000 /* @ECU_Address@KINP_MELaneCurvRt_raw32_defval@ */ Scalar_FLOAT32_IEEE 0 SWC_INP_type_CM_single_raw32 -0.032 0.033535 /end CHARACTERISTIC
/begin CHARACTERISTIC KINP_MELaneCurvRt_raw32_ovrdval "" VALUE 0x0000 /* @ECU_Address@KINP_MELaneCurvRt_raw32_ovrdval@ */ Scalar_FLOAT32_IEEE 0 SWC_INP_type_CM_single_raw32 -0.032 0.033535 /end CHARACTERISTIC
/begin CHARACTERISTIC KINP_MELaneHeadAngLt2_radians_defval "" VALUE 0x0000 /* @ECU_Address@KINP_MELaneHeadAngLt2_radians_defval@ */ Scalar_FLOAT32_IEEE 0 SWC_INP_type_CM_single_radians -0.5 0.523 /end CHARACTERISTIC
/begin CHARACTERISTIC KINP_MELaneHeadAngLt2_radians_ovrdval "" VALUE 0x0000 /* @ECU_Address@KINP_MELaneHeadAngLt2_radians_ovrdval@ */ Scalar_FLOAT32_IEEE 0 SWC_INP_type_CM_single_radians -0.5 0.523 /end CHARACTERISTIC
/begin CHARACTERISTIC KINP_MELaneHeadAngLt_radians_defval "" VALUE 0x0000 /* @ECU_Address@KINP_MELaneHeadAngLt_radians_defval@ */ Scalar_FLOAT32_IEEE 0 SWC_INP_type_CM_single_radians -0.5 0.523 /end CHARACTERISTIC
/begin CHARACTERISTIC KINP_MELaneHeadAngLt_radians_ovrdval "" VALUE 0x0000 /* @ECU_Address@KINP_MELaneHeadAngLt_radians_ovrdval@ */ Scalar_FLOAT32_IEEE 0 SWC_INP_type_CM_single_radians -0.5 0.523 /end CHARACTERISTIC
/begin CHARACTERISTIC KINP_MELaneHeadAngRt2_radians_defval "" VALUE 0x0000 /* @ECU_Address@KINP_MELaneHeadAngRt2_radians_defval@ */ Scalar_FLOAT32_IEEE 0 SWC_INP_type_CM_single_radians -0.5 0.523 /end CHARACTERISTIC
/begin CHARACTERISTIC KINP_MELaneHeadAngRt2_radians_ovrdval "" VALUE 0x0000 /* @ECU_Address@KINP_MELaneHeadAngRt2_radians_ovrdval@ */ Scalar_FLOAT32_IEEE 0 SWC_INP_type_CM_single_radians -0.5 0.523 /end CHARACTERISTIC
/begin CHARACTERISTIC KINP_MELaneHeadAngRt_radians_defval "" VALUE 0x0000 /* @ECU_Address@KINP_MELaneHeadAngRt_radians_defval@ */ Scalar_FLOAT32_IEEE 0 SWC_INP_type_CM_single_radians -0.5 0.523 /end CHARACTERISTIC
/begin CHARACTERISTIC KINP_MELaneHeadAngRt_radians_ovrdval "" VALUE 0x0000 /* @ECU_Address@KINP_MELaneHeadAngRt_radians_ovrdval@ */ Scalar_FLOAT32_IEEE 0 SWC_INP_type_CM_single_radians -0.5 0.523 /end CHARACTERISTIC
/begin CHARACTERISTIC KINP_MELanePosLt2_m_defval "" VALUE 0x0000 /* @ECU_Address@KINP_MELanePosLt2_m_defval@ */ Scalar_FLOAT32_IEEE 0 SWC_INP_type_CM_single_m -10.0 10.47 /end CHARACTERISTIC
/begin CHARACTERISTIC KINP_MELanePosLt2_m_ovrdval "" VALUE 0x0000 /* @ECU_Address@KINP_MELanePosLt2_m_ovrdval@ */ Scalar_FLOAT32_IEEE 0 SWC_INP_type_CM_single_m -10.0 10.47 /end CHARACTERISTIC
/begin CHARACTERISTIC KINP_MELanePosLt_m_defval "" VALUE 0x0000 /* @ECU_Address@KINP_MELanePosLt_m_defval@ */ Scalar_FLOAT32_IEEE 0 SWC_INP_type_CM_single_m -10.0 10.47 /end CHARACTERISTIC
/begin CHARACTERISTIC KINP_MELanePosLt_m_ovrdval "" VALUE 0x0000 /* @ECU_Address@KINP_MELanePosLt_m_ovrdval@ */ Scalar_FLOAT32_IEEE 0 SWC_INP_type_CM_single_m -10.0 10.47 /end CHARACTERISTIC
/begin CHARACTERISTIC KINP_MELanePosRt2_m_defval "" VALUE 0x0000 /* @ECU_Address@KINP_MELanePosRt2_m_defval@ */ Scalar_FLOAT32_IEEE 0 SWC_INP_type_CM_single_m -10.0 10.47 /end CHARACTERISTIC
/begin CHARACTERISTIC KINP_MELanePosRt2_m_ovrdval "" VALUE 0x0000 /* @ECU_Address@KINP_MELanePosRt2_m_ovrdval@ */ Scalar_FLOAT32_IEEE 0 SWC_INP_type_CM_single_m -10.0 10.47 /end CHARACTERISTIC
/begin CHARACTERISTIC KINP_MELanePosRt_m_defval "" VALUE 0x0000 /* @ECU_Address@KINP_MELanePosRt_m_defval@ */ Scalar_FLOAT32_IEEE 0 SWC_INP_type_CM_single_m -10.0 10.47 /end CHARACTERISTIC
/begin CHARACTERISTIC KINP_MELanePosRt_m_ovrdval "" VALUE 0x0000 /* @ECU_Address@KINP_MELanePosRt_m_ovrdval@ */ Scalar_FLOAT32_IEEE 0 SWC_INP_type_CM_single_m -10.0 10.47 /end CHARACTERISTIC
/begin CHARACTERISTIC KINP_PTC1PowerConsumption_kW_defval "" VALUE 0x0000 /* @ECU_Address@KINP_PTC1PowerConsumption_kW_defval@ */ Scalar_FLOAT32_IEEE 0 SWC_INP_type_CM_single_kW 0.0 25.3 /end CHARACTERISTIC
/begin CHARACTERISTIC KINP_PTC1PowerConsumption_kW_ovrdval "" VALUE 0x0000 /* @ECU_Address@KINP_PTC1PowerConsumption_kW_ovrdval@ */ Scalar_FLOAT32_IEEE 0 SWC_INP_type_CM_single_kW 0.0 25.3 /end CHARACTERISTIC
/begin CHARACTERISTIC KINP_ReserveChargeOFFDay_DAY_defval "" VALUE 0x0000 /* @ECU_Address@KINP_ReserveChargeOFFDay_DAY_defval@ */ Scalar_FLOAT32_IEEE 0 SWC_INP_type_CM_single_DAY 0.0 31.0 /end CHARACTERISTIC
/begin CHARACTERISTIC KINP_ReserveChargeOFFDay_DAY_ovrdval "" VALUE 0x0000 /* @ECU_Address@KINP_ReserveChargeOFFDay_DAY_ovrdval@ */ Scalar_FLOAT32_IEEE 0 SWC_INP_type_CM_single_DAY 0.0 31.0 /end CHARACTERISTIC
/begin CHARACTERISTIC KINP_ReserveChargeOFFHour_hr_defval "" VALUE 0x0000 /* @ECU_Address@KINP_ReserveChargeOFFHour_hr_defval@ */ Scalar_FLOAT32_IEEE 0 SWC_INP_type_CM_single_hr 0.0 23.0 /end CHARACTERISTIC
/begin CHARACTERISTIC KINP_ReserveChargeOFFHour_hr_ovrdval "" VALUE 0x0000 /* @ECU_Address@KINP_ReserveChargeOFFHour_hr_ovrdval@ */ Scalar_FLOAT32_IEEE 0 SWC_INP_type_CM_single_hr 0.0 23.0 /end CHARACTERISTIC
/begin CHARACTERISTIC KINP_ReserveChargeOFFMinute_min_defval "" VALUE 0x0000 /* @ECU_Address@KINP_ReserveChargeOFFMinute_min_defval@ */ Scalar_FLOAT32_IEEE 0 SWC_INP_type_CM_single_min 0.0 59.0 /end CHARACTERISTIC
/begin CHARACTERISTIC KINP_ReserveChargeOFFMinute_min_ovrdval "" VALUE 0x0000 /* @ECU_Address@KINP_ReserveChargeOFFMinute_min_ovrdval@ */ Scalar_FLOAT32_IEEE 0 SWC_INP_type_CM_single_min 0.0 59.0 /end CHARACTERISTIC
/begin CHARACTERISTIC KINP_ReserveChargeOFFMonth_MONTH_defval "" VALUE 0x0000 /* @ECU_Address@KINP_ReserveChargeOFFMonth_MONTH_defval@ */ Scalar_FLOAT32_IEEE 0 SWC_INP_type_CM_single_MONTH 0.0 12.0 /end CHARACTERISTIC
/begin CHARACTERISTIC KINP_ReserveChargeOFFMonth_MONTH_ovrdval "" VALUE 0x0000 /* @ECU_Address@KINP_ReserveChargeOFFMonth_MONTH_ovrdval@ */ Scalar_FLOAT32_IEEE 0 SWC_INP_type_CM_single_MONTH 0.0 12.0 /end CHARACTERISTIC
/begin CHARACTERISTIC KINP_ReserveChargeOFFYear_YEAR_defval "" VALUE 0x0000 /* @ECU_Address@KINP_ReserveChargeOFFYear_YEAR_defval@ */ Scalar_FLOAT32_IEEE 0 SWC_INP_type_CM_single_YEAR 2000.0 2099.0 /end CHARACTERISTIC
/begin CHARACTERISTIC KINP_ReserveChargeOFFYear_YEAR_ovrdval "" VALUE 0x0000 /* @ECU_Address@KINP_ReserveChargeOFFYear_YEAR_ovrdval@ */ Scalar_FLOAT32_IEEE 0 SWC_INP_type_CM_single_YEAR 2000.0 2099.0 /end CHARACTERISTIC
/begin CHARACTERISTIC KINP_ReserveChargeOnDay_DAY_defval "" VALUE 0x0000 /* @ECU_Address@KINP_ReserveChargeOnDay_DAY_defval@ */ Scalar_FLOAT32_IEEE 0 SWC_INP_type_CM_single_DAY 0.0 31.0 /end CHARACTERISTIC
/begin CHARACTERISTIC KINP_ReserveChargeOnDay_DAY_ovrdval "" VALUE 0x0000 /* @ECU_Address@KINP_ReserveChargeOnDay_DAY_ovrdval@ */ Scalar_FLOAT32_IEEE 0 SWC_INP_type_CM_single_DAY 0.0 31.0 /end CHARACTERISTIC
/begin CHARACTERISTIC KINP_ReserveChargeOnHour_hr_defval "" VALUE 0x0000 /* @ECU_Address@KINP_ReserveChargeOnHour_hr_defval@ */ Scalar_FLOAT32_IEEE 0 SWC_INP_type_CM_single_hr 0.0 23.0 /end CHARACTERISTIC
/begin CHARACTERISTIC KINP_ReserveChargeOnHour_hr_ovrdval "" VALUE 0x0000 /* @ECU_Address@KINP_ReserveChargeOnHour_hr_ovrdval@ */ Scalar_FLOAT32_IEEE 0 SWC_INP_type_CM_single_hr 0.0 23.0 /end CHARACTERISTIC
/begin CHARACTERISTIC KINP_ReserveChargeOnMinute_min_defval "" VALUE 0x0000 /* @ECU_Address@KINP_ReserveChargeOnMinute_min_defval@ */ Scalar_FLOAT32_IEEE 0 SWC_INP_type_CM_single_min 0.0 59.0 /end CHARACTERISTIC
/begin CHARACTERISTIC KINP_ReserveChargeOnMinute_min_ovrdval "" VALUE 0x0000 /* @ECU_Address@KINP_ReserveChargeOnMinute_min_ovrdval@ */ Scalar_FLOAT32_IEEE 0 SWC_INP_type_CM_single_min 0.0 59.0 /end CHARACTERISTIC
/begin CHARACTERISTIC KINP_ReserveChargeOnMonth_MONTH_defval "" VALUE 0x0000 /* @ECU_Address@KINP_ReserveChargeOnMonth_MONTH_defval@ */ Scalar_FLOAT32_IEEE 0 SWC_INP_type_CM_single_MONTH 0.0 12.0 /end CHARACTERISTIC
/begin CHARACTERISTIC KINP_ReserveChargeOnMonth_MONTH_ovrdval "" VALUE 0x0000 /* @ECU_Address@KINP_ReserveChargeOnMonth_MONTH_ovrdval@ */ Scalar_FLOAT32_IEEE 0 SWC_INP_type_CM_single_MONTH 0.0 12.0 /end CHARACTERISTIC
/begin CHARACTERISTIC KINP_ReserveChargeOnYear_YEAR_defval "" VALUE 0x0000 /* @ECU_Address@KINP_ReserveChargeOnYear_YEAR_defval@ */ Scalar_FLOAT32_IEEE 0 SWC_INP_type_CM_single_YEAR 2000.0 2099.0 /end CHARACTERISTIC
/begin CHARACTERISTIC KINP_ReserveChargeOnYear_YEAR_ovrdval "" VALUE 0x0000 /* @ECU_Address@KINP_ReserveChargeOnYear_YEAR_ovrdval@ */ Scalar_FLOAT32_IEEE 0 SWC_INP_type_CM_single_YEAR 2000.0 2099.0 /end CHARACTERISTIC
/begin CHARACTERISTIC KINP_TimeSyncFromBSDay_DAY_defval "" VALUE 0x0000 /* @ECU_Address@KINP_TimeSyncFromBSDay_DAY_defval@ */ Scalar_FLOAT32_IEEE 0 SWC_INP_type_CM_single_DAY 0.0 31.0 /end CHARACTERISTIC
/begin CHARACTERISTIC KINP_TimeSyncFromBSDay_DAY_ovrdval "" VALUE 0x0000 /* @ECU_Address@KINP_TimeSyncFromBSDay_DAY_ovrdval@ */ Scalar_FLOAT32_IEEE 0 SWC_INP_type_CM_single_DAY 0.0 31.0 /end CHARACTERISTIC
/begin CHARACTERISTIC KINP_TimeSyncFromBSHour_hr_defval "" VALUE 0x0000 /* @ECU_Address@KINP_TimeSyncFromBSHour_hr_defval@ */ Scalar_FLOAT32_IEEE 0 SWC_INP_type_CM_single_hr 0.0 23.0 /end CHARACTERISTIC
/begin CHARACTERISTIC KINP_TimeSyncFromBSHour_hr_ovrdval "" VALUE 0x0000 /* @ECU_Address@KINP_TimeSyncFromBSHour_hr_ovrdval@ */ Scalar_FLOAT32_IEEE 0 SWC_INP_type_CM_single_hr 0.0 23.0 /end CHARACTERISTIC
/begin CHARACTERISTIC KINP_TimeSyncFromBSMinute_min_defval "" VALUE 0x0000 /* @ECU_Address@KINP_TimeSyncFromBSMinute_min_defval@ */ Scalar_FLOAT32_IEEE 0 SWC_INP_type_CM_single_min 0.0 59.0 /end CHARACTERISTIC
/begin CHARACTERISTIC KINP_TimeSyncFromBSMinute_min_ovrdval "" VALUE 0x0000 /* @ECU_Address@KINP_TimeSyncFromBSMinute_min_ovrdval@ */ Scalar_FLOAT32_IEEE 0 SWC_INP_type_CM_single_min 0.0 59.0 /end CHARACTERISTIC
/begin CHARACTERISTIC KINP_TimeSyncFromBSMonth_MONTH_defval "" VALUE 0x0000 /* @ECU_Address@KINP_TimeSyncFromBSMonth_MONTH_defval@ */ Scalar_FLOAT32_IEEE 0 SWC_INP_type_CM_single_MONTH 0.0 12.0 /end CHARACTERISTIC
/begin CHARACTERISTIC KINP_TimeSyncFromBSMonth_MONTH_ovrdval "" VALUE 0x0000 /* @ECU_Address@KINP_TimeSyncFromBSMonth_MONTH_ovrdval@ */ Scalar_FLOAT32_IEEE 0 SWC_INP_type_CM_single_MONTH 0.0 12.0 /end CHARACTERISTIC
/begin CHARACTERISTIC KINP_TimeSyncFromBSSecond_s_defval "" VALUE 0x0000 /* @ECU_Address@KINP_TimeSyncFromBSSecond_s_defval@ */ Scalar_FLOAT32_IEEE 0 SWC_INP_type_CM_single_s 0.0 59.0 /end CHARACTERISTIC
/begin CHARACTERISTIC KINP_TimeSyncFromBSSecond_s_ovrdval "" VALUE 0x0000 /* @ECU_Address@KINP_TimeSyncFromBSSecond_s_ovrdval@ */ Scalar_FLOAT32_IEEE 0 SWC_INP_type_CM_single_s 0.0 59.0 /end CHARACTERISTIC
/begin CHARACTERISTIC KINP_TimeSyncFromBSYear_YEAR_defval "" VALUE 0x0000 /* @ECU_Address@KINP_TimeSyncFromBSYear_YEAR_defval@ */ Scalar_FLOAT32_IEEE 0 SWC_INP_type_CM_single_YEAR 2000.0 2099.0 /end CHARACTERISTIC
/begin CHARACTERISTIC KINP_TimeSyncFromBSYear_YEAR_ovrdval "" VALUE 0x0000 /* @ECU_Address@KINP_TimeSyncFromBSYear_YEAR_ovrdval@ */ Scalar_FLOAT32_IEEE 0 SWC_INP_type_CM_single_YEAR 2000.0 2099.0 /end CHARACTERISTIC
/begin CHARACTERISTIC KINP_TBOXHWVER_enum_defval "" VALUE 0x0000 /* @ECU_Address@KINP_TBOXHWVER_enum_defval@ */ Scalar_ULONG 0 SWC_INP_type_CM_uint32_enum 0.0 4.294967295E+9 /end CHARACTERISTIC
/begin CHARACTERISTIC KINP_TBOXHWVER_enum_ovrdval "" VALUE 0x0000 /* @ECU_Address@KINP_TBOXHWVER_enum_ovrdval@ */ Scalar_ULONG 0 SWC_INP_type_CM_uint32_enum 0.0 4.294967295E+9 /end CHARACTERISTIC
/begin CHARACTERISTIC KINP_TBOXSWVER_enum_defval "" VALUE 0x0000 /* @ECU_Address@KINP_TBOXSWVER_enum_defval@ */ Scalar_ULONG 0 SWC_INP_type_CM_uint32_enum 0.0 4.294967295E+9 /end CHARACTERISTIC
/begin CHARACTERISTIC KINP_TBOXSWVER_enum_ovrdval "" VALUE 0x0000 /* @ECU_Address@KINP_TBOXSWVER_enum_ovrdval@ */ Scalar_ULONG 0 SWC_INP_type_CM_uint32_enum 0.0 4.294967295E+9 /end CHARACTERISTIC
/begin CHARACTERISTIC KINP_DSEATHWVer_enum_defval "" VALUE 0x0000 /* @ECU_Address@KINP_DSEATHWVer_enum_defval@ */ Scalar_UWORD 0 SWC_INP_type_CM_uint16_enum 0.0 65535.0 /end CHARACTERISTIC
/begin CHARACTERISTIC KINP_DSEATHWVer_enum_ovrdval "" VALUE 0x0000 /* @ECU_Address@KINP_DSEATHWVer_enum_ovrdval@ */ Scalar_UWORD 0 SWC_INP_type_CM_uint16_enum 0.0 65535.0 /end CHARACTERISTIC
/begin CHARACTERISTIC KINP_DSEATSWVer_enum_defval "" VALUE 0x0000 /* @ECU_Address@KINP_DSEATSWVer_enum_defval@ */ Scalar_UWORD 0 SWC_INP_type_CM_uint16_enum 0.0 65535.0 /end CHARACTERISTIC
/begin CHARACTERISTIC KINP_DSEATSWVer_enum_ovrdval "" VALUE 0x0000 /* @ECU_Address@KINP_DSEATSWVer_enum_ovrdval@ */ Scalar_UWORD 0 SWC_INP_type_CM_uint16_enum 0.0 65535.0 /end CHARACTERISTIC
/begin CHARACTERISTIC KINP_PSEATHWVer_enum_defval "" VALUE 0x0000 /* @ECU_Address@KINP_PSEATHWVer_enum_defval@ */ Scalar_UWORD 0 SWC_INP_type_CM_uint16_enum 0.0 65535.0 /end CHARACTERISTIC
/begin CHARACTERISTIC KINP_PSEATHWVer_enum_ovrdval "" VALUE 0x0000 /* @ECU_Address@KINP_PSEATHWVer_enum_ovrdval@ */ Scalar_UWORD 0 SWC_INP_type_CM_uint16_enum 0.0 65535.0 /end CHARACTERISTIC
/begin CHARACTERISTIC KINP_PSEATSWVer_enum_defval "" VALUE 0x0000 /* @ECU_Address@KINP_PSEATSWVer_enum_defval@ */ Scalar_UWORD 0 SWC_INP_type_CM_uint16_enum 0.0 65535.0 /end CHARACTERISTIC
/begin CHARACTERISTIC KINP_PSEATSWVer_enum_ovrdval "" VALUE 0x0000 /* @ECU_Address@KINP_PSEATSWVer_enum_ovrdval@ */ Scalar_UWORD 0 SWC_INP_type_CM_uint16_enum 0.0 65535.0 /end CHARACTERISTIC
/begin CHARACTERISTIC KINP_ACCComfortBandLower_mps2_ovrdflg "" VALUE 0x0000 /* @ECU_Address@KINP_ACCComfortBandLower_mps2_ovrdflg@ */ Scalar_BOOLEAN 0 SWC_INP_type_CM_boolean_flg 0.0 1.0 /end CHARACTERISTIC
/begin CHARACTERISTIC KINP_ACCComfortBandUpper_mps2_ovrdflg "" VALUE 0x0000 /* @ECU_Address@KINP_ACCComfortBandUpper_mps2_ovrdflg@ */ Scalar_BOOLEAN 0 SWC_INP_type_CM_boolean_flg 0.0 1.0 /end CHARACTERISTIC
/begin CHARACTERISTIC KINP_ACCJerkLowerLimit_mps3_ovrdflg "" VALUE 0x0000 /* @ECU_Address@KINP_ACCJerkLowerLimit_mps3_ovrdflg@ */ Scalar_BOOLEAN 0 SWC_INP_type_CM_boolean_flg 0.0 1.0 /end CHARACTERISTIC
/begin CHARACTERISTIC KINP_ACCJerkUpperLimit_mps3_ovrdflg "" VALUE 0x0000 /* @ECU_Address@KINP_ACCJerkUpperLimit_mps3_ovrdflg@ */ Scalar_BOOLEAN 0 SWC_INP_type_CM_boolean_flg 0.0 1.0 /end CHARACTERISTIC
/begin CHARACTERISTIC KINP_ACCObjDist_m_ovrdflg "" VALUE 0x0000 /* @ECU_Address@KINP_ACCObjDist_m_ovrdflg@ */ Scalar_BOOLEAN 0 SWC_INP_type_CM_boolean_flg 0.0 1.0 /end CHARACTERISTIC
/begin CHARACTERISTIC KINP_ACCObjDstLvl_enum_ovrdflg "" VALUE 0x0000 /* @ECU_Address@KINP_ACCObjDstLvl_enum_ovrdflg@ */ Scalar_BOOLEAN 0 SWC_INP_type_CM_boolean_flg 0.0 1.0 /end CHARACTERISTIC
/begin CHARACTERISTIC KINP_ACCObjRelSpd_mps_ovrdflg "" VALUE 0x0000 /* @ECU_Address@KINP_ACCObjRelSpd_mps_ovrdflg@ */ Scalar_BOOLEAN 0 SWC_INP_type_CM_boolean_flg 0.0 1.0 /end CHARACTERISTIC
/begin CHARACTERISTIC KINP_ACCRequiredAccel_mps2_ovrdflg "" VALUE 0x0000 /* @ECU_Address@KINP_ACCRequiredAccel_mps2_ovrdflg@ */ Scalar_BOOLEAN 0 SWC_INP_type_CM_boolean_flg 0.0 1.0 /end CHARACTERISTIC
/begin CHARACTERISTIC KINP_ACCTakeoverReq_flg_defval "" VALUE 0x0000 /* @ECU_Address@KINP_ACCTakeoverReq_flg_defval@ */ Scalar_BOOLEAN 0 SWC_INP_type_CM_boolean_flg 0.0 1.0 /end CHARACTERISTIC
/begin CHARACTERISTIC KINP_ACCTakeoverReq_flg_ovrdflg "" VALUE 0x0000 /* @ECU_Address@KINP_ACCTakeoverReq_flg_ovrdflg@ */ Scalar_BOOLEAN 0 SWC_INP_type_CM_boolean_flg 0.0 1.0 /end CHARACTERISTIC
/begin CHARACTERISTIC KINP_ACCTakeoverReq_flg_ovrdval "" VALUE 0x0000 /* @ECU_Address@KINP_ACCTakeoverReq_flg_ovrdval@ */ Scalar_BOOLEAN 0 SWC_INP_type_CM_boolean_flg 0.0 1.0 /end CHARACTERISTIC
/begin CHARACTERISTIC KINP_ACCVehHoldReq_flg_defval "" VALUE 0x0000 /* @ECU_Address@KINP_ACCVehHoldReq_flg_defval@ */ Scalar_BOOLEAN 0 SWC_INP_type_CM_boolean_flg 0.0 1.0 /end CHARACTERISTIC
/begin CHARACTERISTIC KINP_ACCVehHoldReq_flg_ovrdflg "" VALUE 0x0000 /* @ECU_Address@KINP_ACCVehHoldReq_flg_ovrdflg@ */ Scalar_BOOLEAN 0 SWC_INP_type_CM_boolean_flg 0.0 1.0 /end CHARACTERISTIC
/begin CHARACTERISTIC KINP_ACCVehHoldReq_flg_ovrdval "" VALUE 0x0000 /* @ECU_Address@KINP_ACCVehHoldReq_flg_ovrdval@ */ Scalar_BOOLEAN 0 SWC_INP_type_CM_boolean_flg 0.0 1.0 /end CHARACTERISTIC
/begin CHARACTERISTIC KINP_ACT1ResponseError_flg_defval "" VALUE 0x0000 /* @ECU_Address@KINP_ACT1ResponseError_flg_defval@ */ Scalar_BOOLEAN 0 SWC_INP_type_CM_boolean_flg 0.0 1.0 /end CHARACTERISTIC
/begin CHARACTERISTIC KINP_ACT1ResponseError_flg_ovrdflg "" VALUE 0x0000 /* @ECU_Address@KINP_ACT1ResponseError_flg_ovrdflg@ */ Scalar_BOOLEAN 0 SWC_INP_type_CM_boolean_flg 0.0 1.0 /end CHARACTERISTIC
/begin CHARACTERISTIC KINP_ACT1ResponseError_flg_ovrdval "" VALUE 0x0000 /* @ECU_Address@KINP_ACT1ResponseError_flg_ovrdval@ */ Scalar_BOOLEAN 0 SWC_INP_type_CM_boolean_flg 0.0 1.0 /end CHARACTERISTIC
/begin CHARACTERISTIC KINP_ADASACCSta_enum_ovrdflg "" VALUE 0x0000 /* @ECU_Address@KINP_ADASACCSta_enum_ovrdflg@ */ Scalar_BOOLEAN 0 SWC_INP_type_CM_boolean_flg 0.0 1.0 /end CHARACTERISTIC
/begin CHARACTERISTIC KINP_ADASAEBReq_enum_ovrdflg "" VALUE 0x0000 /* @ECU_Address@KINP_ADASAEBReq_enum_ovrdflg@ */ Scalar_BOOLEAN 0 SWC_INP_type_CM_boolean_flg 0.0 1.0 /end CHARACTERISTIC
/begin CHARACTERISTIC KINP_ADASAEBSta_enum_ovrdflg "" VALUE 0x0000 /* @ECU_Address@KINP_ADASAEBSta_enum_ovrdflg@ */ Scalar_BOOLEAN 0 SWC_INP_type_CM_boolean_flg 0.0 1.0 /end CHARACTERISTIC
/begin CHARACTERISTIC KINP_ADASAngCtrlTqWeightGain_pct_ovrdflg "" VALUE 0x0000 /* @ECU_Address@KINP_ADASAngCtrlTqWeightGain_pct_ovrdflg@ */ Scalar_BOOLEAN 0 SWC_INP_type_CM_boolean_flg 0.0 1.0 /end CHARACTERISTIC
/begin CHARACTERISTIC KINP_ADASCAMSpdLim_enum_ovrdflg "" VALUE 0x0000 /* @ECU_Address@KINP_ADASCAMSpdLim_enum_ovrdflg@ */ Scalar_BOOLEAN 0 SWC_INP_type_CM_boolean_flg 0.0 1.0 /end CHARACTERISTIC
/begin CHARACTERISTIC KINP_ADASDBSReq_enum_ovrdflg "" VALUE 0x0000 /* @ECU_Address@KINP_ADASDBSReq_enum_ovrdflg@ */ Scalar_BOOLEAN 0 SWC_INP_type_CM_boolean_flg 0.0 1.0 /end CHARACTERISTIC
/begin CHARACTERISTIC KINP_ADASDesStrWhlAngCtrlCmd_Deg_ovrdflg "" VALUE 0x0000 /* @ECU_Address@KINP_ADASDesStrWhlAngCtrlCmd_Deg_ovrdflg@ */ Scalar_BOOLEAN 0 SWC_INP_type_CM_boolean_flg 0.0 1.0 /end CHARACTERISTIC
/begin CHARACTERISTIC KINP_ADASDrvInputTqBoostAct_flg_defval "" VALUE 0x0000 /* @ECU_Address@KINP_ADASDrvInputTqBoostAct_flg_defval@ */ Scalar_BOOLEAN 0 SWC_INP_type_CM_boolean_flg 0.0 1.0 /end CHARACTERISTIC
/begin CHARACTERISTIC KINP_ADASDrvInputTqBoostAct_flg_ovrdflg "" VALUE 0x0000 /* @ECU_Address@KINP_ADASDrvInputTqBoostAct_flg_ovrdflg@ */ Scalar_BOOLEAN 0 SWC_INP_type_CM_boolean_flg 0.0 1.0 /end CHARACTERISTIC
/begin CHARACTERISTIC KINP_ADASDrvInputTqBoostAct_flg_ovrdval "" VALUE 0x0000 /* @ECU_Address@KINP_ADASDrvInputTqBoostAct_flg_ovrdval@ */ Scalar_BOOLEAN 0 SWC_INP_type_CM_boolean_flg 0.0 1.0 /end CHARACTERISTIC
/begin CHARACTERISTIC KINP_ADASDrvInputTqBoostGain_pct_ovrdflg "" VALUE 0x0000 /* @ECU_Address@KINP_ADASDrvInputTqBoostGain_pct_ovrdflg@ */ Scalar_BOOLEAN 0 SWC_INP_type_CM_boolean_flg 0.0 1.0 /end CHARACTERISTIC
/begin CHARACTERISTIC KINP_ADASFCWMute_flg_defval "" VALUE 0x0000 /* @ECU_Address@KINP_ADASFCWMute_flg_defval@ */ Scalar_BOOLEAN 0 SWC_INP_type_CM_boolean_flg 0.0 1.0 /end CHARACTERISTIC
/begin CHARACTERISTIC KINP_ADASFCWMute_flg_ovrdflg "" VALUE 0x0000 /* @ECU_Address@KINP_ADASFCWMute_flg_ovrdflg@ */ Scalar_BOOLEAN 0 SWC_INP_type_CM_boolean_flg 0.0 1.0 /end CHARACTERISTIC
/begin CHARACTERISTIC KINP_ADASFCWMute_flg_ovrdval "" VALUE 0x0000 /* @ECU_Address@KINP_ADASFCWMute_flg_ovrdval@ */ Scalar_BOOLEAN 0 SWC_INP_type_CM_boolean_flg 0.0 1.0 /end CHARACTERISTIC
/begin CHARACTERISTIC KINP_ADASFCWSta_enum_ovrdflg "" VALUE 0x0000 /* @ECU_Address@KINP_ADASFCWSta_enum_ovrdflg@ */ Scalar_BOOLEAN 0 SWC_INP_type_CM_boolean_flg 0.0 1.0 /end CHARACTERISTIC
/begin CHARACTERISTIC KINP_ADASFaultSta_flg_defval "" VALUE 0x0000 /* @ECU_Address@KINP_ADASFaultSta_flg_defval@ */ Scalar_BOOLEAN 0 SWC_INP_type_CM_boolean_flg 0.0 1.0 /end CHARACTERISTIC
/begin CHARACTERISTIC KINP_ADASFaultSta_flg_ovrdflg "" VALUE 0x0000 /* @ECU_Address@KINP_ADASFaultSta_flg_ovrdflg@ */ Scalar_BOOLEAN 0 SWC_INP_type_CM_boolean_flg 0.0 1.0 /end CHARACTERISTIC
/begin CHARACTERISTIC KINP_ADASFaultSta_flg_ovrdval "" VALUE 0x0000 /* @ECU_Address@KINP_ADASFaultSta_flg_ovrdval@ */ Scalar_BOOLEAN 0 SWC_INP_type_CM_boolean_flg 0.0 1.0 /end CHARACTERISTIC
/begin CHARACTERISTIC KINP_ADASFltWrnReq_flg_defval "" VALUE 0x0000 /* @ECU_Address@KINP_ADASFltWrnReq_flg_defval@ */ Scalar_BOOLEAN 0 SWC_INP_type_CM_boolean_flg 0.0 1.0 /end CHARACTERISTIC
/begin CHARACTERISTIC KINP_ADASFltWrnReq_flg_ovrdflg "" VALUE 0x0000 /* @ECU_Address@KINP_ADASFltWrnReq_flg_ovrdflg@ */ Scalar_BOOLEAN 0 SWC_INP_type_CM_boolean_flg 0.0 1.0 /end CHARACTERISTIC
/begin CHARACTERISTIC KINP_ADASFltWrnReq_flg_ovrdval "" VALUE 0x0000 /* @ECU_Address@KINP_ADASFltWrnReq_flg_ovrdval@ */ Scalar_BOOLEAN 0 SWC_INP_type_CM_boolean_flg 0.0 1.0 /end CHARACTERISTIC
/begin CHARACTERISTIC KINP_ADASForceIdle_flg_defval "" VALUE 0x0000 /* @ECU_Address@KINP_ADASForceIdle_flg_defval@ */ Scalar_BOOLEAN 0 SWC_INP_type_CM_boolean_flg 0.0 1.0 /end CHARACTERISTIC
/begin CHARACTERISTIC KINP_ADASForceIdle_flg_ovrdflg "" VALUE 0x0000 /* @ECU_Address@KINP_ADASForceIdle_flg_ovrdflg@ */ Scalar_BOOLEAN 0 SWC_INP_type_CM_boolean_flg 0.0 1.0 /end CHARACTERISTIC
/begin CHARACTERISTIC KINP_ADASForceIdle_flg_ovrdval "" VALUE 0x0000 /* @ECU_Address@KINP_ADASForceIdle_flg_ovrdval@ */ Scalar_BOOLEAN 0 SWC_INP_type_CM_boolean_flg 0.0 1.0 /end CHARACTERISTIC
/begin CHARACTERISTIC KINP_ADASISASta_enum_ovrdflg "" VALUE 0x0000 /* @ECU_Address@KINP_ADASISASta_enum_ovrdflg@ */ Scalar_BOOLEAN 0 SWC_INP_type_CM_boolean_flg 0.0 1.0 /end CHARACTERISTIC
/begin CHARACTERISTIC KINP_ADASLDWMute_flg_defval "" VALUE 0x0000 /* @ECU_Address@KINP_ADASLDWMute_flg_defval@ */ Scalar_BOOLEAN 0 SWC_INP_type_CM_boolean_flg 0.0 1.0 /end CHARACTERISTIC
/begin CHARACTERISTIC KINP_ADASLDWMute_flg_ovrdflg "" VALUE 0x0000 /* @ECU_Address@KINP_ADASLDWMute_flg_ovrdflg@ */ Scalar_BOOLEAN 0 SWC_INP_type_CM_boolean_flg 0.0 1.0 /end CHARACTERISTIC
/begin CHARACTERISTIC KINP_ADASLDWMute_flg_ovrdval "" VALUE 0x0000 /* @ECU_Address@KINP_ADASLDWMute_flg_ovrdval@ */ Scalar_BOOLEAN 0 SWC_INP_type_CM_boolean_flg 0.0 1.0 /end CHARACTERISTIC
/begin CHARACTERISTIC KINP_ADASLDWSta_enum_ovrdflg "" VALUE 0x0000 /* @ECU_Address@KINP_ADASLDWSta_enum_ovrdflg@ */ Scalar_BOOLEAN 0 SWC_INP_type_CM_boolean_flg 0.0 1.0 /end CHARACTERISTIC
/begin CHARACTERISTIC KINP_ADASLFCHandsOffWarning_enum_ovrdflg "" VALUE 0x0000 /* @ECU_Address@KINP_ADASLFCHandsOffWarning_enum_ovrdflg@ */ Scalar_BOOLEAN 0 SWC_INP_type_CM_boolean_flg 0.0 1.0 /end CHARACTERISTIC
/begin CHARACTERISTIC KINP_ADASLFCSta_enum_ovrdflg "" VALUE 0x0000 /* @ECU_Address@KINP_ADASLFCSta_enum_ovrdflg@ */ Scalar_BOOLEAN 0 SWC_INP_type_CM_boolean_flg 0.0 1.0 /end CHARACTERISTIC
/begin CHARACTERISTIC KINP_ADASLFCWarnSound_enum_ovrdflg "" VALUE 0x0000 /* @ECU_Address@KINP_ADASLFCWarnSound_enum_ovrdflg@ */ Scalar_BOOLEAN 0 SWC_INP_type_CM_boolean_flg 0.0 1.0 /end CHARACTERISTIC
/begin CHARACTERISTIC KINP_ADASLKASta_enum_ovrdflg "" VALUE 0x0000 /* @ECU_Address@KINP_ADASLKASta_enum_ovrdflg@ */ Scalar_BOOLEAN 0 SWC_INP_type_CM_boolean_flg 0.0 1.0 /end CHARACTERISTIC
/begin CHARACTERISTIC KINP_ADASLaneModeL_enum_ovrdflg "" VALUE 0x0000 /* @ECU_Address@KINP_ADASLaneModeL_enum_ovrdflg@ */ Scalar_BOOLEAN 0 SWC_INP_type_CM_boolean_flg 0.0 1.0 /end CHARACTERISTIC
/begin CHARACTERISTIC KINP_ADASLaneModeR_enum_ovrdflg "" VALUE 0x0000 /* @ECU_Address@KINP_ADASLaneModeR_enum_ovrdflg@ */ Scalar_BOOLEAN 0 SWC_INP_type_CM_boolean_flg 0.0 1.0 /end CHARACTERISTIC
/begin CHARACTERISTIC KINP_ADASLanecurveL_raw32_ovrdflg "" VALUE 0x0000 /* @ECU_Address@KINP_ADASLanecurveL_raw32_ovrdflg@ */ Scalar_BOOLEAN 0 SWC_INP_type_CM_boolean_flg 0.0 1.0 /end CHARACTERISTIC
/begin CHARACTERISTIC KINP_ADASLanecurveR_raw32_ovrdflg "" VALUE 0x0000 /* @ECU_Address@KINP_ADASLanecurveR_raw32_ovrdflg@ */ Scalar_BOOLEAN 0 SWC_INP_type_CM_boolean_flg 0.0 1.0 /end CHARACTERISTIC
/begin CHARACTERISTIC KINP_ADASLanetypeL_enum_ovrdflg "" VALUE 0x0000 /* @ECU_Address@KINP_ADASLanetypeL_enum_ovrdflg@ */ Scalar_BOOLEAN 0 SWC_INP_type_CM_boolean_flg 0.0 1.0 /end CHARACTERISTIC
/begin CHARACTERISTIC KINP_ADASLanetypeR_enum_ovrdflg "" VALUE 0x0000 /* @ECU_Address@KINP_ADASLanetypeR_enum_ovrdflg@ */ Scalar_BOOLEAN 0 SWC_INP_type_CM_boolean_flg 0.0 1.0 /end CHARACTERISTIC
/begin CHARACTERISTIC KINP_ADASMaxAngCtrlOutTqLimit_Nm_ovrdflg "" VALUE 0x0000 /* @ECU_Address@KINP_ADASMaxAngCtrlOutTqLimit_Nm_ovrdflg@ */ Scalar_BOOLEAN 0 SWC_INP_type_CM_boolean_flg 0.0 1.0 /end CHARACTERISTIC
/begin CHARACTERISTIC KINP_ADASSLIFSpdLim_enum_ovrdflg "" VALUE 0x0000 /* @ECU_Address@KINP_ADASSLIFSpdLim_enum_ovrdflg@ */ Scalar_BOOLEAN 0 SWC_INP_type_CM_boolean_flg 0.0 1.0 /end CHARACTERISTIC
/begin CHARACTERISTIC KINP_ADASSLIFSta_enum_ovrdflg "" VALUE 0x0000 /* @ECU_Address@KINP_ADASSLIFSta_enum_ovrdflg@ */ Scalar_BOOLEAN 0 SWC_INP_type_CM_boolean_flg 0.0 1.0 /end CHARACTERISTIC
/begin CHARACTERISTIC KINP_ADASShftPosnReqA_flg_defval "" VALUE 0x0000 /* @ECU_Address@KINP_ADASShftPosnReqA_flg_defval@ */ Scalar_BOOLEAN 0 SWC_INP_type_CM_boolean_flg 0.0 1.0 /end CHARACTERISTIC
/begin CHARACTERISTIC KINP_ADASShftPosnReqA_flg_ovrdflg "" VALUE 0x0000 /* @ECU_Address@KINP_ADASShftPosnReqA_flg_ovrdflg@ */ Scalar_BOOLEAN 0 SWC_INP_type_CM_boolean_flg 0.0 1.0 /end CHARACTERISTIC
/begin CHARACTERISTIC KINP_ADASShftPosnReqA_flg_ovrdval "" VALUE 0x0000 /* @ECU_Address@KINP_ADASShftPosnReqA_flg_ovrdval@ */ Scalar_BOOLEAN 0 SWC_INP_type_CM_boolean_flg 0.0 1.0 /end CHARACTERISTIC
/begin CHARACTERISTIC KINP_ADASShftPosnReq_enum_ovrdflg "" VALUE 0x0000 /* @ECU_Address@KINP_ADASShftPosnReq_enum_ovrdflg@ */ Scalar_BOOLEAN 0 SWC_INP_type_CM_boolean_flg 0.0 1.0 /end CHARACTERISTIC
/begin CHARACTERISTIC KINP_ADASStrWhlAngCtrlStatus_flg_defval "" VALUE 0x0000 /* @ECU_Address@KINP_ADASStrWhlAngCtrlStatus_flg_defval@ */ Scalar_BOOLEAN 0 SWC_INP_type_CM_boolean_flg 0.0 1.0 /end CHARACTERISTIC
/begin CHARACTERISTIC KINP_ADASStrWhlAngCtrlStatus_flg_ovrdflg "" VALUE 0x0000 /* @ECU_Address@KINP_ADASStrWhlAngCtrlStatus_flg_ovrdflg@ */ Scalar_BOOLEAN 0 SWC_INP_type_CM_boolean_flg 0.0 1.0 /end CHARACTERISTIC
/begin CHARACTERISTIC KINP_ADASStrWhlAngCtrlStatus_flg_ovrdval "" VALUE 0x0000 /* @ECU_Address@KINP_ADASStrWhlAngCtrlStatus_flg_ovrdval@ */ Scalar_BOOLEAN 0 SWC_INP_type_CM_boolean_flg 0.0 1.0 /end CHARACTERISTIC
/begin CHARACTERISTIC KINP_ADASVehSpdLim_enum_ovrdflg "" VALUE 0x0000 /* @ECU_Address@KINP_ADASVehSpdLim_enum_ovrdflg@ */ Scalar_BOOLEAN 0 SWC_INP_type_CM_boolean_flg 0.0 1.0 /end CHARACTERISTIC
/begin CHARACTERISTIC KINP_ADASWarningMsg_enum_ovrdflg "" VALUE 0x0000 /* @ECU_Address@KINP_ADASWarningMsg_enum_ovrdflg@ */ Scalar_BOOLEAN 0 SWC_INP_type_CM_boolean_flg 0.0 1.0 /end CHARACTERISTIC
/begin CHARACTERISTIC KINP_ADBVehDst1Val_enum_ovrdflg "" VALUE 0x0000 /* @ECU_Address@KINP_ADBVehDst1Val_enum_ovrdflg@ */ Scalar_BOOLEAN 0 SWC_INP_type_CM_boolean_flg 0.0 1.0 /end CHARACTERISTIC
/begin CHARACTERISTIC KINP_AEBVehHoldReq_flg_defval "" VALUE 0x0000 /* @ECU_Address@KINP_AEBVehHoldReq_flg_defval@ */ Scalar_BOOLEAN 0 SWC_INP_type_CM_boolean_flg 0.0 1.0 /end CHARACTERISTIC
/begin CHARACTERISTIC KINP_AEBVehHoldReq_flg_ovrdflg "" VALUE 0x0000 /* @ECU_Address@KINP_AEBVehHoldReq_flg_ovrdflg@ */ Scalar_BOOLEAN 0 SWC_INP_type_CM_boolean_flg 0.0 1.0 /end CHARACTERISTIC
/begin CHARACTERISTIC KINP_AEBVehHoldReq_flg_ovrdval "" VALUE 0x0000 /* @ECU_Address@KINP_AEBVehHoldReq_flg_ovrdval@ */ Scalar_BOOLEAN 0 SWC_INP_type_CM_boolean_flg 0.0 1.0 /end CHARACTERISTIC
/begin CHARACTERISTIC KINP_AGSActualPosition_enum_ovrdflg "" VALUE 0x0000 /* @ECU_Address@KINP_AGSActualPosition_enum_ovrdflg@ */ Scalar_BOOLEAN 0 SWC_INP_type_CM_boolean_flg 0.0 1.0 /end CHARACTERISTIC
/begin CHARACTERISTIC KINP_COMPActualPwr_W_ovrdflg "" VALUE 0x0000 /* @ECU_Address@KINP_COMPActualPwr_W_ovrdflg@ */ Scalar_BOOLEAN 0 SWC_INP_type_CM_boolean_flg 0.0 1.0 /end CHARACTERISTIC
/begin CHARACTERISTIC KINP_COMPConCur_A_ovrdflg "" VALUE 0x0000 /* @ECU_Address@KINP_COMPConCur_A_ovrdflg@ */ Scalar_BOOLEAN 0 SWC_INP_type_CM_boolean_flg 0.0 1.0 /end CHARACTERISTIC
/begin CHARACTERISTIC KINP_COMPConVolt_V_ovrdflg "" VALUE 0x0000 /* @ECU_Address@KINP_COMPConVolt_V_ovrdflg@ */ Scalar_BOOLEAN 0 SWC_INP_type_CM_boolean_flg 0.0 1.0 /end CHARACTERISTIC
/begin CHARACTERISTIC KINP_COMPStatorSpd_rpm_ovrdflg "" VALUE 0x0000 /* @ECU_Address@KINP_COMPStatorSpd_rpm_ovrdflg@ */ Scalar_BOOLEAN 0 SWC_INP_type_CM_boolean_flg 0.0 1.0 /end CHARACTERISTIC
/begin CHARACTERISTIC KINP_CSWDimSw_flg_defval "" VALUE 0x0000 /* @ECU_Address@KINP_CSWDimSw_flg_defval@ */ Scalar_BOOLEAN 0 SWC_INP_type_CM_boolean_flg 0.0 1.0 /end CHARACTERISTIC
/begin CHARACTERISTIC KINP_CSWDimSw_flg_ovrdflg "" VALUE 0x0000 /* @ECU_Address@KINP_CSWDimSw_flg_ovrdflg@ */ Scalar_BOOLEAN 0 SWC_INP_type_CM_boolean_flg 0.0 1.0 /end CHARACTERISTIC
/begin CHARACTERISTIC KINP_CSWDimSw_flg_ovrdval "" VALUE 0x0000 /* @ECU_Address@KINP_CSWDimSw_flg_ovrdval@ */ Scalar_BOOLEAN 0 SWC_INP_type_CM_boolean_flg 0.0 1.0 /end CHARACTERISTIC
/begin CHARACTERISTIC KINP_CSWFWasSwSta_enum_ovrdflg "" VALUE 0x0000 /* @ECU_Address@KINP_CSWFWasSwSta_enum_ovrdflg@ */ Scalar_BOOLEAN 0 SWC_INP_type_CM_boolean_flg 0.0 1.0 /end CHARACTERISTIC
/begin CHARACTERISTIC KINP_CSWFWipSwSta_enum_ovrdflg "" VALUE 0x0000 /* @ECU_Address@KINP_CSWFWipSwSta_enum_ovrdflg@ */ Scalar_BOOLEAN 0 SWC_INP_type_CM_boolean_flg 0.0 1.0 /end CHARACTERISTIC
/begin CHARACTERISTIC KINP_CSWPassSWSta_flg_defval "" VALUE 0x0000 /* @ECU_Address@KINP_CSWPassSWSta_flg_defval@ */ Scalar_BOOLEAN 0 SWC_INP_type_CM_boolean_flg 0.0 1.0 /end CHARACTERISTIC
/begin CHARACTERISTIC KINP_CSWPassSWSta_flg_ovrdflg "" VALUE 0x0000 /* @ECU_Address@KINP_CSWPassSWSta_flg_ovrdflg@ */ Scalar_BOOLEAN 0 SWC_INP_type_CM_boolean_flg 0.0 1.0 /end CHARACTERISTIC
/begin CHARACTERISTIC KINP_CSWPassSWSta_flg_ovrdval "" VALUE 0x0000 /* @ECU_Address@KINP_CSWPassSWSta_flg_ovrdval@ */ Scalar_BOOLEAN 0 SWC_INP_type_CM_boolean_flg 0.0 1.0 /end CHARACTERISTIC
/begin CHARACTERISTIC KINP_CSWRWasSWSta_enum_ovrdflg "" VALUE 0x0000 /* @ECU_Address@KINP_CSWRWasSWSta_enum_ovrdflg@ */ Scalar_BOOLEAN 0 SWC_INP_type_CM_boolean_flg 0.0 1.0 /end CHARACTERISTIC
/begin CHARACTERISTIC KINP_CSWRWipIntSwSta_enum_ovrdflg "" VALUE 0x0000 /* @ECU_Address@KINP_CSWRWipIntSwSta_enum_ovrdflg@ */ Scalar_BOOLEAN 0 SWC_INP_type_CM_boolean_flg 0.0 1.0 /end CHARACTERISTIC
/begin CHARACTERISTIC KINP_CSWTurnSwSta_enum_ovrdflg "" VALUE 0x0000 /* @ECU_Address@KINP_CSWTurnSwSta_enum_ovrdflg@ */ Scalar_BOOLEAN 0 SWC_INP_type_CM_boolean_flg 0.0 1.0 /end CHARACTERISTIC
/begin CHARACTERISTIC KINP_CameraBlockage_flg_defval "" VALUE 0x0000 /* @ECU_Address@KINP_CameraBlockage_flg_defval@ */ Scalar_BOOLEAN 0 SWC_INP_type_CM_boolean_flg 0.0 1.0 /end CHARACTERISTIC
/begin CHARACTERISTIC KINP_CameraBlockage_flg_ovrdflg "" VALUE 0x0000 /* @ECU_Address@KINP_CameraBlockage_flg_ovrdflg@ */ Scalar_BOOLEAN 0 SWC_INP_type_CM_boolean_flg 0.0 1.0 /end CHARACTERISTIC
/begin CHARACTERISTIC KINP_CameraBlockage_flg_ovrdval "" VALUE 0x0000 /* @ECU_Address@KINP_CameraBlockage_flg_ovrdval@ */ Scalar_BOOLEAN 0 SWC_INP_type_CM_boolean_flg 0.0 1.0 /end CHARACTERISTIC
/begin CHARACTERISTIC KINP_ChargePercentSet_pct_ovrdflg "" VALUE 0x0000 /* @ECU_Address@KINP_ChargePercentSet_pct_ovrdflg@ */ Scalar_BOOLEAN 0 SWC_INP_type_CM_boolean_flg 0.0 1.0 /end CHARACTERISTIC
/begin CHARACTERISTIC KINP_DSEATAntiSta_flg_defval "" VALUE 0x0000 /* @ECU_Address@KINP_DSEATAntiSta_flg_defval@ */ Scalar_BOOLEAN 0 SWC_INP_type_CM_boolean_flg 0.0 1.0 /end CHARACTERISTIC
/begin CHARACTERISTIC KINP_DSEATAntiSta_flg_ovrdflg "" VALUE 0x0000 /* @ECU_Address@KINP_DSEATAntiSta_flg_ovrdflg@ */ Scalar_BOOLEAN 0 SWC_INP_type_CM_boolean_flg 0.0 1.0 /end CHARACTERISTIC
/begin CHARACTERISTIC KINP_DSEATAntiSta_flg_ovrdval "" VALUE 0x0000 /* @ECU_Address@KINP_DSEATAntiSta_flg_ovrdval@ */ Scalar_BOOLEAN 0 SWC_INP_type_CM_boolean_flg 0.0 1.0 /end CHARACTERISTIC
/begin CHARACTERISTIC KINP_DSEATEntryFunSta_flg_defval "" VALUE 0x0000 /* @ECU_Address@KINP_DSEATEntryFunSta_flg_defval@ */ Scalar_BOOLEAN 0 SWC_INP_type_CM_boolean_flg 0.0 1.0 /end CHARACTERISTIC
/begin CHARACTERISTIC KINP_DSEATEntryFunSta_flg_ovrdflg "" VALUE 0x0000 /* @ECU_Address@KINP_DSEATEntryFunSta_flg_ovrdflg@ */ Scalar_BOOLEAN 0 SWC_INP_type_CM_boolean_flg 0.0 1.0 /end CHARACTERISTIC
/begin CHARACTERISTIC KINP_DSEATEntryFunSta_flg_ovrdval "" VALUE 0x0000 /* @ECU_Address@KINP_DSEATEntryFunSta_flg_ovrdval@ */ Scalar_BOOLEAN 0 SWC_INP_type_CM_boolean_flg 0.0 1.0 /end CHARACTERISTIC
/begin CHARACTERISTIC KINP_DSEATErrorSta_flg_defval "" VALUE 0x0000 /* @ECU_Address@KINP_DSEATErrorSta_flg_defval@ */ Scalar_BOOLEAN 0 SWC_INP_type_CM_boolean_flg 0.0 1.0 /end CHARACTERISTIC
/begin CHARACTERISTIC KINP_DSEATErrorSta_flg_ovrdflg "" VALUE 0x0000 /* @ECU_Address@KINP_DSEATErrorSta_flg_ovrdflg@ */ Scalar_BOOLEAN 0 SWC_INP_type_CM_boolean_flg 0.0 1.0 /end CHARACTERISTIC
/begin CHARACTERISTIC KINP_DSEATErrorSta_flg_ovrdval "" VALUE 0x0000 /* @ECU_Address@KINP_DSEATErrorSta_flg_ovrdval@ */ Scalar_BOOLEAN 0 SWC_INP_type_CM_boolean_flg 0.0 1.0 /end CHARACTERISTIC
/begin CHARACTERISTIC KINP_DSEATHWVer_enum_ovrdflg "" VALUE 0x0000 /* @ECU_Address@KINP_DSEATHWVer_enum_ovrdflg@ */ Scalar_BOOLEAN 0 SWC_INP_type_CM_boolean_flg 0.0 1.0 /end CHARACTERISTIC
/begin CHARACTERISTIC KINP_DSEATMode_enum_ovrdflg "" VALUE 0x0000 /* @ECU_Address@KINP_DSEATMode_enum_ovrdflg@ */ Scalar_BOOLEAN 0 SWC_INP_type_CM_boolean_flg 0.0 1.0 /end CHARACTERISTIC
/begin CHARACTERISTIC KINP_DSEATSWVer_enum_ovrdflg "" VALUE 0x0000 /* @ECU_Address@KINP_DSEATSWVer_enum_ovrdflg@ */ Scalar_BOOLEAN 0 SWC_INP_type_CM_boolean_flg 0.0 1.0 /end CHARACTERISTIC
/begin CHARACTERISTIC KINP_DSEATVentSta_enum_ovrdflg "" VALUE 0x0000 /* @ECU_Address@KINP_DSEATVentSta_enum_ovrdflg@ */ Scalar_BOOLEAN 0 SWC_INP_type_CM_boolean_flg 0.0 1.0 /end CHARACTERISTIC
/begin CHARACTERISTIC KINP_DSEATheatersta_enum_ovrdflg "" VALUE 0x0000 /* @ECU_Address@KINP_DSEATheatersta_enum_ovrdflg@ */ Scalar_BOOLEAN 0 SWC_INP_type_CM_boolean_flg 0.0 1.0 /end CHARACTERISTIC
/begin CHARACTERISTIC KINP_EWP1BlockError_enum_ovrdflg "" VALUE 0x0000 /* @ECU_Address@KINP_EWP1BlockError_enum_ovrdflg@ */ Scalar_BOOLEAN 0 SWC_INP_type_CM_boolean_flg 0.0 1.0 /end CHARACTERISTIC
/begin CHARACTERISTIC KINP_EWP1OverCurrError_enum_ovrdflg "" VALUE 0x0000 /* @ECU_Address@KINP_EWP1OverCurrError_enum_ovrdflg@ */ Scalar_BOOLEAN 0 SWC_INP_type_CM_boolean_flg 0.0 1.0 /end CHARACTERISTIC
/begin CHARACTERISTIC KINP_EWP2BlockError_enum_ovrdflg "" VALUE 0x0000 /* @ECU_Address@KINP_EWP2BlockError_enum_ovrdflg@ */ Scalar_BOOLEAN 0 SWC_INP_type_CM_boolean_flg 0.0 1.0 /end CHARACTERISTIC
/begin CHARACTERISTIC KINP_EWP2OverCurrError_enum_ovrdflg "" VALUE 0x0000 /* @ECU_Address@KINP_EWP2OverCurrError_enum_ovrdflg@ */ Scalar_BOOLEAN 0 SWC_INP_type_CM_boolean_flg 0.0 1.0 /end CHARACTERISTIC
/begin CHARACTERISTIC KINP_EWP3BlockError_enum_ovrdflg "" VALUE 0x0000 /* @ECU_Address@KINP_EWP3BlockError_enum_ovrdflg@ */ Scalar_BOOLEAN 0 SWC_INP_type_CM_boolean_flg 0.0 1.0 /end CHARACTERISTIC
/begin CHARACTERISTIC KINP_EWP3OverCurrError_enum_ovrdflg "" VALUE 0x0000 /* @ECU_Address@KINP_EWP3OverCurrError_enum_ovrdflg@ */ Scalar_BOOLEAN 0 SWC_INP_type_CM_boolean_flg 0.0 1.0 /end CHARACTERISTIC
/begin CHARACTERISTIC KINP_FAPWL01LINResponseError_flg_defval "" VALUE 0x0000 /* @ECU_Address@KINP_FAPWL01LINResponseError_flg_defval@ */ Scalar_BOOLEAN 0 SWC_INP_type_CM_boolean_flg 0.0 1.0 /end CHARACTERISTIC
/begin CHARACTERISTIC KINP_FAPWL01LINResponseError_flg_ovrdflg "" VALUE 0x0000 /* @ECU_Address@KINP_FAPWL01LINResponseError_flg_ovrdflg@ */ Scalar_BOOLEAN 0 SWC_INP_type_CM_boolean_flg 0.0 1.0 /end CHARACTERISTIC
/begin CHARACTERISTIC KINP_FAPWL01LINResponseError_flg_ovrdval "" VALUE 0x0000 /* @ECU_Address@KINP_FAPWL01LINResponseError_flg_ovrdval@ */ Scalar_BOOLEAN 0 SWC_INP_type_CM_boolean_flg 0.0 1.0 /end CHARACTERISTIC
/begin CHARACTERISTIC KINP_FCM1Checksum_enum_ovrdflg "" VALUE 0x0000 /* @ECU_Address@KINP_FCM1Checksum_enum_ovrdflg@ */ Scalar_BOOLEAN 0 SWC_INP_type_CM_boolean_flg 0.0 1.0 /end CHARACTERISTIC
/begin CHARACTERISTIC KINP_FCM1LifeCount_enum_ovrdflg "" VALUE 0x0000 /* @ECU_Address@KINP_FCM1LifeCount_enum_ovrdflg@ */ Scalar_BOOLEAN 0 SWC_INP_type_CM_boolean_flg 0.0 1.0 /end CHARACTERISTIC
/begin CHARACTERISTIC KINP_FCM2CSErr_flg_defval "" VALUE 0x0000 /* @ECU_Address@KINP_FCM2CSErr_flg_defval@ */ Scalar_BOOLEAN 0 SWC_INP_type_CM_boolean_flg 0.0 1.0 /end CHARACTERISTIC
/begin CHARACTERISTIC KINP_FCM2CSErr_flg_ovrdflg "" VALUE 0x0000 /* @ECU_Address@KINP_FCM2CSErr_flg_ovrdflg@ */ Scalar_BOOLEAN 0 SWC_INP_type_CM_boolean_flg 0.0 1.0 /end CHARACTERISTIC
/begin CHARACTERISTIC KINP_FCM2CSErr_flg_ovrdval "" VALUE 0x0000 /* @ECU_Address@KINP_FCM2CSErr_flg_ovrdval@ */ Scalar_BOOLEAN 0 SWC_INP_type_CM_boolean_flg 0.0 1.0 /end CHARACTERISTIC
/begin CHARACTERISTIC KINP_FCM2RCErr_flg_defval "" VALUE 0x0000 /* @ECU_Address@KINP_FCM2RCErr_flg_defval@ */ Scalar_BOOLEAN 0 SWC_INP_type_CM_boolean_flg 0.0 1.0 /end CHARACTERISTIC
/begin CHARACTERISTIC KINP_FCM2RCErr_flg_ovrdflg "" VALUE 0x0000 /* @ECU_Address@KINP_FCM2RCErr_flg_ovrdflg@ */ Scalar_BOOLEAN 0 SWC_INP_type_CM_boolean_flg 0.0 1.0 /end CHARACTERISTIC
/begin CHARACTERISTIC KINP_FCM2RCErr_flg_ovrdval "" VALUE 0x0000 /* @ECU_Address@KINP_FCM2RCErr_flg_ovrdval@ */ Scalar_BOOLEAN 0 SWC_INP_type_CM_boolean_flg 0.0 1.0 /end CHARACTERISTIC
/begin CHARACTERISTIC KINP_FCM4CSErr_flg_defval "" VALUE 0x0000 /* @ECU_Address@KINP_FCM4CSErr_flg_defval@ */ Scalar_BOOLEAN 0 SWC_INP_type_CM_boolean_flg 0.0 1.0 /end CHARACTERISTIC
/begin CHARACTERISTIC KINP_FCM4CSErr_flg_ovrdflg "" VALUE 0x0000 /* @ECU_Address@KINP_FCM4CSErr_flg_ovrdflg@ */ Scalar_BOOLEAN 0 SWC_INP_type_CM_boolean_flg 0.0 1.0 /end CHARACTERISTIC
/begin CHARACTERISTIC KINP_FCM4CSErr_flg_ovrdval "" VALUE 0x0000 /* @ECU_Address@KINP_FCM4CSErr_flg_ovrdval@ */ Scalar_BOOLEAN 0 SWC_INP_type_CM_boolean_flg 0.0 1.0 /end CHARACTERISTIC
/begin CHARACTERISTIC KINP_FCM4RCErr_flg_defval "" VALUE 0x0000 /* @ECU_Address@KINP_FCM4RCErr_flg_defval@ */ Scalar_BOOLEAN 0 SWC_INP_type_CM_boolean_flg 0.0 1.0 /end CHARACTERISTIC
/begin CHARACTERISTIC KINP_FCM4RCErr_flg_ovrdflg "" VALUE 0x0000 /* @ECU_Address@KINP_FCM4RCErr_flg_ovrdflg@ */ Scalar_BOOLEAN 0 SWC_INP_type_CM_boolean_flg 0.0 1.0 /end CHARACTERISTIC
/begin CHARACTERISTIC KINP_FCM4RCErr_flg_ovrdval "" VALUE 0x0000 /* @ECU_Address@KINP_FCM4RCErr_flg_ovrdval@ */ Scalar_BOOLEAN 0 SWC_INP_type_CM_boolean_flg 0.0 1.0 /end CHARACTERISTIC
/begin CHARACTERISTIC KINP_FCMACCmode_enum_ovrdflg "" VALUE 0x0000 /* @ECU_Address@KINP_FCMACCmode_enum_ovrdflg@ */ Scalar_BOOLEAN 0 SWC_INP_type_CM_boolean_flg 0.0 1.0 /end CHARACTERISTIC
/begin CHARACTERISTIC KINP_FCMLKAStrToqReq_Nm_ovrdflg "" VALUE 0x0000 /* @ECU_Address@KINP_FCMLKAStrToqReq_Nm_ovrdflg@ */ Scalar_BOOLEAN 0 SWC_INP_type_CM_boolean_flg 0.0 1.0 /end CHARACTERISTIC
/begin CHARACTERISTIC KINP_FCMLKATOIAct_enum_ovrdflg "" VALUE 0x0000 /* @ECU_Address@KINP_FCMLKATOIAct_enum_ovrdflg@ */ Scalar_BOOLEAN 0 SWC_INP_type_CM_boolean_flg 0.0 1.0 /end CHARACTERISTIC
/begin CHARACTERISTIC KINP_FCMLKATOIFault_flg_defval "" VALUE 0x0000 /* @ECU_Address@KINP_FCMLKATOIFault_flg_defval@ */ Scalar_BOOLEAN 0 SWC_INP_type_CM_boolean_flg 0.0 1.0 /end CHARACTERISTIC
/begin CHARACTERISTIC KINP_FCMLKATOIFault_flg_ovrdflg "" VALUE 0x0000 /* @ECU_Address@KINP_FCMLKATOIFault_flg_ovrdflg@ */ Scalar_BOOLEAN 0 SWC_INP_type_CM_boolean_flg 0.0 1.0 /end CHARACTERISTIC
/begin CHARACTERISTIC KINP_FCMLKATOIFault_flg_ovrdval "" VALUE 0x0000 /* @ECU_Address@KINP_FCMLKATOIFault_flg_ovrdval@ */ Scalar_BOOLEAN 0 SWC_INP_type_CM_boolean_flg 0.0 1.0 /end CHARACTERISTIC
/begin CHARACTERISTIC KINP_FGSIntenRspSta_enum_ovrdflg "" VALUE 0x0000 /* @ECU_Address@KINP_FGSIntenRspSta_enum_ovrdflg@ */ Scalar_BOOLEAN 0 SWC_INP_type_CM_boolean_flg 0.0 1.0 /end CHARACTERISTIC
/begin CHARACTERISTIC KINP_ForceLowBeam_enum_ovrdflg "" VALUE 0x0000 /* @ECU_Address@KINP_ForceLowBeam_enum_ovrdflg@ */ Scalar_BOOLEAN 0 SWC_INP_type_CM_boolean_flg 0.0 1.0 /end CHARACTERISTIC
/begin CHARACTERISTIC KINP_FrntPTCLeActHeatPwr_W_ovrdflg "" VALUE 0x0000 /* @ECU_Address@KINP_FrntPTCLeActHeatPwr_W_ovrdflg@ */ Scalar_BOOLEAN 0 SWC_INP_type_CM_boolean_flg 0.0 1.0 /end CHARACTERISTIC
/begin CHARACTERISTIC KINP_FrntPTCRearLeActHeatPwr_W_ovrdflg "" VALUE 0x0000 /* @ECU_Address@KINP_FrntPTCRearLeActHeatPwr_W_ovrdflg@ */ Scalar_BOOLEAN 0 SWC_INP_type_CM_boolean_flg 0.0 1.0 /end CHARACTERISTIC
/begin CHARACTERISTIC KINP_FrntPTCRearRiActHeatPwr_W_ovrdflg "" VALUE 0x0000 /* @ECU_Address@KINP_FrntPTCRearRiActHeatPwr_W_ovrdflg@ */ Scalar_BOOLEAN 0 SWC_INP_type_CM_boolean_flg 0.0 1.0 /end CHARACTERISTIC
/begin CHARACTERISTIC KINP_FrntPTCRiActHeatPwr_W_ovrdflg "" VALUE 0x0000 /* @ECU_Address@KINP_FrntPTCRiActHeatPwr_W_ovrdflg@ */ Scalar_BOOLEAN 0 SWC_INP_type_CM_boolean_flg 0.0 1.0 /end CHARACTERISTIC
/begin CHARACTERISTIC KINP_HazardWarningReq_flg_defval "" VALUE 0x0000 /* @ECU_Address@KINP_HazardWarningReq_flg_defval@ */ Scalar_BOOLEAN 0 SWC_INP_type_CM_boolean_flg 0.0 1.0 /end CHARACTERISTIC
/begin CHARACTERISTIC KINP_HazardWarningReq_flg_ovrdflg "" VALUE 0x0000 /* @ECU_Address@KINP_HazardWarningReq_flg_ovrdflg@ */ Scalar_BOOLEAN 0 SWC_INP_type_CM_boolean_flg 0.0 1.0 /end CHARACTERISTIC
/begin CHARACTERISTIC KINP_HazardWarningReq_flg_ovrdval "" VALUE 0x0000 /* @ECU_Address@KINP_HazardWarningReq_flg_ovrdval@ */ Scalar_BOOLEAN 0 SWC_INP_type_CM_boolean_flg 0.0 1.0 /end CHARACTERISTIC
/begin CHARACTERISTIC KINP_ISAWarningMsg_enum_ovrdflg "" VALUE 0x0000 /* @ECU_Address@KINP_ISAWarningMsg_enum_ovrdflg@ */ Scalar_BOOLEAN 0 SWC_INP_type_CM_boolean_flg 0.0 1.0 /end CHARACTERISTIC
/begin CHARACTERISTIC KINP_LDrvMotorRelayError_flg_defval "" VALUE 0x0000 /* @ECU_Address@KINP_LDrvMotorRelayError_flg_defval@ */ Scalar_BOOLEAN 0 SWC_INP_type_CM_boolean_flg 0.0 1.0 /end CHARACTERISTIC
/begin CHARACTERISTIC KINP_LDrvMotorRelayError_flg_ovrdflg "" VALUE 0x0000 /* @ECU_Address@KINP_LDrvMotorRelayError_flg_ovrdflg@ */ Scalar_BOOLEAN 0 SWC_INP_type_CM_boolean_flg 0.0 1.0 /end CHARACTERISTIC
/begin CHARACTERISTIC KINP_LDrvMotorRelayError_flg_ovrdval "" VALUE 0x0000 /* @ECU_Address@KINP_LDrvMotorRelayError_flg_ovrdval@ */ Scalar_BOOLEAN 0 SWC_INP_type_CM_boolean_flg 0.0 1.0 /end CHARACTERISTIC
/begin CHARACTERISTIC KINP_LDrvMotorRippleError_flg_defval "" VALUE 0x0000 /* @ECU_Address@KINP_LDrvMotorRippleError_flg_defval@ */ Scalar_BOOLEAN 0 SWC_INP_type_CM_boolean_flg 0.0 1.0 /end CHARACTERISTIC
/begin CHARACTERISTIC KINP_LDrvMotorRippleError_flg_ovrdflg "" VALUE 0x0000 /* @ECU_Address@KINP_LDrvMotorRippleError_flg_ovrdflg@ */ Scalar_BOOLEAN 0 SWC_INP_type_CM_boolean_flg 0.0 1.0 /end CHARACTERISTIC
/begin CHARACTERISTIC KINP_LDrvMotorRippleError_flg_ovrdval "" VALUE 0x0000 /* @ECU_Address@KINP_LDrvMotorRippleError_flg_ovrdval@ */ Scalar_BOOLEAN 0 SWC_INP_type_CM_boolean_flg 0.0 1.0 /end CHARACTERISTIC
/begin CHARACTERISTIC KINP_LDrvValWdwOpened_pct_ovrdflg "" VALUE 0x0000 /* @ECU_Address@KINP_LDrvValWdwOpened_pct_ovrdflg@ */ Scalar_BOOLEAN 0 SWC_INP_type_CM_boolean_flg 0.0 1.0 /end CHARACTERISTIC
/begin CHARACTERISTIC KINP_LDrvWdwPositionSts_enum_ovrdflg "" VALUE 0x0000 /* @ECU_Address@KINP_LDrvWdwPositionSts_enum_ovrdflg@ */ Scalar_BOOLEAN 0 SWC_INP_type_CM_boolean_flg 0.0 1.0 /end CHARACTERISTIC
/begin CHARACTERISTIC KINP_LKAHODDisplayWarning_flg_defval "" VALUE 0x0000 /* @ECU_Address@KINP_LKAHODDisplayWarning_flg_defval@ */ Scalar_BOOLEAN 0 SWC_INP_type_CM_boolean_flg 0.0 1.0 /end CHARACTERISTIC
/begin CHARACTERISTIC KINP_LKAHODDisplayWarning_flg_ovrdflg "" VALUE 0x0000 /* @ECU_Address@KINP_LKAHODDisplayWarning_flg_ovrdflg@ */ Scalar_BOOLEAN 0 SWC_INP_type_CM_boolean_flg 0.0 1.0 /end CHARACTERISTIC
/begin CHARACTERISTIC KINP_LKAHODDisplayWarning_flg_ovrdval "" VALUE 0x0000 /* @ECU_Address@KINP_LKAHODDisplayWarning_flg_ovrdval@ */ Scalar_BOOLEAN 0 SWC_INP_type_CM_boolean_flg 0.0 1.0 /end CHARACTERISTIC
/begin CHARACTERISTIC KINP_LKAHODSoundWarning_flg_defval "" VALUE 0x0000 /* @ECU_Address@KINP_LKAHODSoundWarning_flg_defval@ */ Scalar_BOOLEAN 0 SWC_INP_type_CM_boolean_flg 0.0 1.0 /end CHARACTERISTIC
/begin CHARACTERISTIC KINP_LKAHODSoundWarning_flg_ovrdflg "" VALUE 0x0000 /* @ECU_Address@KINP_LKAHODSoundWarning_flg_ovrdflg@ */ Scalar_BOOLEAN 0 SWC_INP_type_CM_boolean_flg 0.0 1.0 /end CHARACTERISTIC
/begin CHARACTERISTIC KINP_LKAHODSoundWarning_flg_ovrdval "" VALUE 0x0000 /* @ECU_Address@KINP_LKAHODSoundWarning_flg_ovrdval@ */ Scalar_BOOLEAN 0 SWC_INP_type_CM_boolean_flg 0.0 1.0 /end CHARACTERISTIC
/begin CHARACTERISTIC KINP_LPasMotorRelayError_flg_defval "" VALUE 0x0000 /* @ECU_Address@KINP_LPasMotorRelayError_flg_defval@ */ Scalar_BOOLEAN 0 SWC_INP_type_CM_boolean_flg 0.0 1.0 /end CHARACTERISTIC
/begin CHARACTERISTIC KINP_LPasMotorRelayError_flg_ovrdflg "" VALUE 0x0000 /* @ECU_Address@KINP_LPasMotorRelayError_flg_ovrdflg@ */ Scalar_BOOLEAN 0 SWC_INP_type_CM_boolean_flg 0.0 1.0 /end CHARACTERISTIC
/begin CHARACTERISTIC KINP_LPasMotorRelayError_flg_ovrdval "" VALUE 0x0000 /* @ECU_Address@KINP_LPasMotorRelayError_flg_ovrdval@ */ Scalar_BOOLEAN 0 SWC_INP_type_CM_boolean_flg 0.0 1.0 /end CHARACTERISTIC
/begin CHARACTERISTIC KINP_LPasMotorRippleError_flg_defval "" VALUE 0x0000 /* @ECU_Address@KINP_LPasMotorRippleError_flg_defval@ */ Scalar_BOOLEAN 0 SWC_INP_type_CM_boolean_flg 0.0 1.0 /end CHARACTERISTIC
/begin CHARACTERISTIC KINP_LPasMotorRippleError_flg_ovrdflg "" VALUE 0x0000 /* @ECU_Address@KINP_LPasMotorRippleError_flg_ovrdflg@ */ Scalar_BOOLEAN 0 SWC_INP_type_CM_boolean_flg 0.0 1.0 /end CHARACTERISTIC
/begin CHARACTERISTIC KINP_LPasMotorRippleError_flg_ovrdval "" VALUE 0x0000 /* @ECU_Address@KINP_LPasMotorRippleError_flg_ovrdval@ */ Scalar_BOOLEAN 0 SWC_INP_type_CM_boolean_flg 0.0 1.0 /end CHARACTERISTIC
/begin CHARACTERISTIC KINP_LPasValWdwOpened_pct_ovrdflg "" VALUE 0x0000 /* @ECU_Address@KINP_LPasValWdwOpened_pct_ovrdflg@ */ Scalar_BOOLEAN 0 SWC_INP_type_CM_boolean_flg 0.0 1.0 /end CHARACTERISTIC
/begin CHARACTERISTIC KINP_LPasWdwPositionSts_enum_ovrdflg "" VALUE 0x0000 /* @ECU_Address@KINP_LPasWdwPositionSts_enum_ovrdflg@ */ Scalar_BOOLEAN 0 SWC_INP_type_CM_boolean_flg 0.0 1.0 /end CHARACTERISTIC
/begin CHARACTERISTIC KINP_LRLDMotorRelayError_flg_defval "" VALUE 0x0000 /* @ECU_Address@KINP_LRLDMotorRelayError_flg_defval@ */ Scalar_BOOLEAN 0 SWC_INP_type_CM_boolean_flg 0.0 1.0 /end CHARACTERISTIC
/begin CHARACTERISTIC KINP_LRLDMotorRelayError_flg_ovrdflg "" VALUE 0x0000 /* @ECU_Address@KINP_LRLDMotorRelayError_flg_ovrdflg@ */ Scalar_BOOLEAN 0 SWC_INP_type_CM_boolean_flg 0.0 1.0 /end CHARACTERISTIC
/begin CHARACTERISTIC KINP_LRLDMotorRelayError_flg_ovrdval "" VALUE 0x0000 /* @ECU_Address@KINP_LRLDMotorRelayError_flg_ovrdval@ */ Scalar_BOOLEAN 0 SWC_INP_type_CM_boolean_flg 0.0 1.0 /end CHARACTERISTIC
/begin CHARACTERISTIC KINP_LRLDMotorRippleError_flg_defval "" VALUE 0x0000 /* @ECU_Address@KINP_LRLDMotorRippleError_flg_defval@ */ Scalar_BOOLEAN 0 SWC_INP_type_CM_boolean_flg 0.0 1.0 /end CHARACTERISTIC
/begin CHARACTERISTIC KINP_LRLDMotorRippleError_flg_ovrdflg "" VALUE 0x0000 /* @ECU_Address@KINP_LRLDMotorRippleError_flg_ovrdflg@ */ Scalar_BOOLEAN 0 SWC_INP_type_CM_boolean_flg 0.0 1.0 /end CHARACTERISTIC
/begin CHARACTERISTIC KINP_LRLDMotorRippleError_flg_ovrdval "" VALUE 0x0000 /* @ECU_Address@KINP_LRLDMotorRippleError_flg_ovrdval@ */ Scalar_BOOLEAN 0 SWC_INP_type_CM_boolean_flg 0.0 1.0 /end CHARACTERISTIC
/begin CHARACTERISTIC KINP_LRLDValWdwOpened_pct_ovrdflg "" VALUE 0x0000 /* @ECU_Address@KINP_LRLDValWdwOpened_pct_ovrdflg@ */ Scalar_BOOLEAN 0 SWC_INP_type_CM_boolean_flg 0.0 1.0 /end CHARACTERISTIC
/begin CHARACTERISTIC KINP_LRLDWdwPositionSts_enum_ovrdflg "" VALUE 0x0000 /* @ECU_Address@KINP_LRLDWdwPositionSts_enum_ovrdflg@ */ Scalar_BOOLEAN 0 SWC_INP_type_CM_boolean_flg 0.0 1.0 /end CHARACTERISTIC
/begin CHARACTERISTIC KINP_LRRDMotorRelayError_flg_defval "" VALUE 0x0000 /* @ECU_Address@KINP_LRRDMotorRelayError_flg_defval@ */ Scalar_BOOLEAN 0 SWC_INP_type_CM_boolean_flg 0.0 1.0 /end CHARACTERISTIC
/begin CHARACTERISTIC KINP_LRRDMotorRelayError_flg_ovrdflg "" VALUE 0x0000 /* @ECU_Address@KINP_LRRDMotorRelayError_flg_ovrdflg@ */ Scalar_BOOLEAN 0 SWC_INP_type_CM_boolean_flg 0.0 1.0 /end CHARACTERISTIC
/begin CHARACTERISTIC KINP_LRRDMotorRelayError_flg_ovrdval "" VALUE 0x0000 /* @ECU_Address@KINP_LRRDMotorRelayError_flg_ovrdval@ */ Scalar_BOOLEAN 0 SWC_INP_type_CM_boolean_flg 0.0 1.0 /end CHARACTERISTIC
/begin CHARACTERISTIC KINP_LRRDMotorRippleError_flg_defval "" VALUE 0x0000 /* @ECU_Address@KINP_LRRDMotorRippleError_flg_defval@ */ Scalar_BOOLEAN 0 SWC_INP_type_CM_boolean_flg 0.0 1.0 /end CHARACTERISTIC
/begin CHARACTERISTIC KINP_LRRDMotorRippleError_flg_ovrdflg "" VALUE 0x0000 /* @ECU_Address@KINP_LRRDMotorRippleError_flg_ovrdflg@ */ Scalar_BOOLEAN 0 SWC_INP_type_CM_boolean_flg 0.0 1.0 /end CHARACTERISTIC
/begin CHARACTERISTIC KINP_LRRDMotorRippleError_flg_ovrdval "" VALUE 0x0000 /* @ECU_Address@KINP_LRRDMotorRippleError_flg_ovrdval@ */ Scalar_BOOLEAN 0 SWC_INP_type_CM_boolean_flg 0.0 1.0 /end CHARACTERISTIC
/begin CHARACTERISTIC KINP_LRRDValWdwOpened_pct_ovrdflg "" VALUE 0x0000 /* @ECU_Address@KINP_LRRDValWdwOpened_pct_ovrdflg@ */ Scalar_BOOLEAN 0 SWC_INP_type_CM_boolean_flg 0.0 1.0 /end CHARACTERISTIC
/begin CHARACTERISTIC KINP_LRRDWdwPositionSts_enum_ovrdflg "" VALUE 0x0000 /* @ECU_Address@KINP_LRRDWdwPositionSts_enum_ovrdflg@ */ Scalar_BOOLEAN 0 SWC_INP_type_CM_boolean_flg 0.0 1.0 /end CHARACTERISTIC
/begin CHARACTERISTIC KINP_LVDAACCStatusInformation_flg_defval "" VALUE 0x0000 /* @ECU_Address@KINP_LVDAACCStatusInformation_flg_defval@ */ Scalar_BOOLEAN 0 SWC_INP_type_CM_boolean_flg 0.0 1.0 /end CHARACTERISTIC
/begin CHARACTERISTIC KINP_LVDAACCStatusInformation_flg_ovrdflg "" VALUE 0x0000 /* @ECU_Address@KINP_LVDAACCStatusInformation_flg_ovrdflg@ */ Scalar_BOOLEAN 0 SWC_INP_type_CM_boolean_flg 0.0 1.0 /end CHARACTERISTIC
/begin CHARACTERISTIC KINP_LVDAACCStatusInformation_flg_ovrdval "" VALUE 0x0000 /* @ECU_Address@KINP_LVDAACCStatusInformation_flg_ovrdval@ */ Scalar_BOOLEAN 0 SWC_INP_type_CM_boolean_flg 0.0 1.0 /end CHARACTERISTIC
/begin CHARACTERISTIC KINP_LVDADisabled_flg_defval "" VALUE 0x0000 /* @ECU_Address@KINP_LVDADisabled_flg_defval@ */ Scalar_BOOLEAN 0 SWC_INP_type_CM_boolean_flg 0.0 1.0 /end CHARACTERISTIC
/begin CHARACTERISTIC KINP_LVDADisabled_flg_ovrdflg "" VALUE 0x0000 /* @ECU_Address@KINP_LVDADisabled_flg_ovrdflg@ */ Scalar_BOOLEAN 0 SWC_INP_type_CM_boolean_flg 0.0 1.0 /end CHARACTERISTIC
/begin CHARACTERISTIC KINP_LVDADisabled_flg_ovrdval "" VALUE 0x0000 /* @ECU_Address@KINP_LVDADisabled_flg_ovrdval@ */ Scalar_BOOLEAN 0 SWC_INP_type_CM_boolean_flg 0.0 1.0 /end CHARACTERISTIC
/begin CHARACTERISTIC KINP_LVDAFailinfo_flg_defval "" VALUE 0x0000 /* @ECU_Address@KINP_LVDAFailinfo_flg_defval@ */ Scalar_BOOLEAN 0 SWC_INP_type_CM_boolean_flg 0.0 1.0 /end CHARACTERISTIC
/begin CHARACTERISTIC KINP_LVDAFailinfo_flg_ovrdflg "" VALUE 0x0000 /* @ECU_Address@KINP_LVDAFailinfo_flg_ovrdflg@ */ Scalar_BOOLEAN 0 SWC_INP_type_CM_boolean_flg 0.0 1.0 /end CHARACTERISTIC
/begin CHARACTERISTIC KINP_LVDAFailinfo_flg_ovrdval "" VALUE 0x0000 /* @ECU_Address@KINP_LVDAFailinfo_flg_ovrdval@ */ Scalar_BOOLEAN 0 SWC_INP_type_CM_boolean_flg 0.0 1.0 /end CHARACTERISTIC
/begin CHARACTERISTIC KINP_LVDAMuteSta_enum_ovrdflg "" VALUE 0x0000 /* @ECU_Address@KINP_LVDAMuteSta_enum_ovrdflg@ */ Scalar_BOOLEAN 0 SWC_INP_type_CM_boolean_flg 0.0 1.0 /end CHARACTERISTIC
/begin CHARACTERISTIC KINP_LVDAWarning_flg_defval "" VALUE 0x0000 /* @ECU_Address@KINP_LVDAWarning_flg_defval@ */ Scalar_BOOLEAN 0 SWC_INP_type_CM_boolean_flg 0.0 1.0 /end CHARACTERISTIC
/begin CHARACTERISTIC KINP_LVDAWarning_flg_ovrdflg "" VALUE 0x0000 /* @ECU_Address@KINP_LVDAWarning_flg_ovrdflg@ */ Scalar_BOOLEAN 0 SWC_INP_type_CM_boolean_flg 0.0 1.0 /end CHARACTERISTIC
/begin CHARACTERISTIC KINP_LVDAWarning_flg_ovrdval "" VALUE 0x0000 /* @ECU_Address@KINP_LVDAWarning_flg_ovrdval@ */ Scalar_BOOLEAN 0 SWC_INP_type_CM_boolean_flg 0.0 1.0 /end CHARACTERISTIC
/begin CHARACTERISTIC KINP_LeftTurnLightReq_flg_defval "" VALUE 0x0000 /* @ECU_Address@KINP_LeftTurnLightReq_flg_defval@ */ Scalar_BOOLEAN 0 SWC_INP_type_CM_boolean_flg 0.0 1.0 /end CHARACTERISTIC
/begin CHARACTERISTIC KINP_LeftTurnLightReq_flg_ovrdflg "" VALUE 0x0000 /* @ECU_Address@KINP_LeftTurnLightReq_flg_ovrdflg@ */ Scalar_BOOLEAN 0 SWC_INP_type_CM_boolean_flg 0.0 1.0 /end CHARACTERISTIC
/begin CHARACTERISTIC KINP_LeftTurnLightReq_flg_ovrdval "" VALUE 0x0000 /* @ECU_Address@KINP_LeftTurnLightReq_flg_ovrdval@ */ Scalar_BOOLEAN 0 SWC_INP_type_CM_boolean_flg 0.0 1.0 /end CHARACTERISTIC
/begin CHARACTERISTIC KINP_MELaneCurvDervLt2_raw32_ovrdflg "" VALUE 0x0000 /* @ECU_Address@KINP_MELaneCurvDervLt2_raw32_ovrdflg@ */ Scalar_BOOLEAN 0 SWC_INP_type_CM_boolean_flg 0.0 1.0 /end CHARACTERISTIC
/begin CHARACTERISTIC KINP_MELaneCurvDervLt_raw32_ovrdflg "" VALUE 0x0000 /* @ECU_Address@KINP_MELaneCurvDervLt_raw32_ovrdflg@ */ Scalar_BOOLEAN 0 SWC_INP_type_CM_boolean_flg 0.0 1.0 /end CHARACTERISTIC
/begin CHARACTERISTIC KINP_MELaneCurvDervRt2_raw32_ovrdflg "" VALUE 0x0000 /* @ECU_Address@KINP_MELaneCurvDervRt2_raw32_ovrdflg@ */ Scalar_BOOLEAN 0 SWC_INP_type_CM_boolean_flg 0.0 1.0 /end CHARACTERISTIC
/begin CHARACTERISTIC KINP_MELaneCurvDervRt_raw32_ovrdflg "" VALUE 0x0000 /* @ECU_Address@KINP_MELaneCurvDervRt_raw32_ovrdflg@ */ Scalar_BOOLEAN 0 SWC_INP_type_CM_boolean_flg 0.0 1.0 /end CHARACTERISTIC
/begin CHARACTERISTIC KINP_MELaneCurvLt2_raw32_ovrdflg "" VALUE 0x0000 /* @ECU_Address@KINP_MELaneCurvLt2_raw32_ovrdflg@ */ Scalar_BOOLEAN 0 SWC_INP_type_CM_boolean_flg 0.0 1.0 /end CHARACTERISTIC
/begin CHARACTERISTIC KINP_MELaneCurvLt_raw32_ovrdflg "" VALUE 0x0000 /* @ECU_Address@KINP_MELaneCurvLt_raw32_ovrdflg@ */ Scalar_BOOLEAN 0 SWC_INP_type_CM_boolean_flg 0.0 1.0 /end CHARACTERISTIC
/begin CHARACTERISTIC KINP_MELaneCurvRt2_raw32_ovrdflg "" VALUE 0x0000 /* @ECU_Address@KINP_MELaneCurvRt2_raw32_ovrdflg@ */ Scalar_BOOLEAN 0 SWC_INP_type_CM_boolean_flg 0.0 1.0 /end CHARACTERISTIC
/begin CHARACTERISTIC KINP_MELaneCurvRt_raw32_ovrdflg "" VALUE 0x0000 /* @ECU_Address@KINP_MELaneCurvRt_raw32_ovrdflg@ */ Scalar_BOOLEAN 0 SWC_INP_type_CM_boolean_flg 0.0 1.0 /end CHARACTERISTIC
/begin CHARACTERISTIC KINP_MELaneHeadAngLt2_radians_ovrdflg "" VALUE 0x0000 /* @ECU_Address@KINP_MELaneHeadAngLt2_radians_ovrdflg@ */ Scalar_BOOLEAN 0 SWC_INP_type_CM_boolean_flg 0.0 1.0 /end CHARACTERISTIC
/begin CHARACTERISTIC KINP_MELaneHeadAngLt_radians_ovrdflg "" VALUE 0x0000 /* @ECU_Address@KINP_MELaneHeadAngLt_radians_ovrdflg@ */ Scalar_BOOLEAN 0 SWC_INP_type_CM_boolean_flg 0.0 1.0 /end CHARACTERISTIC
/begin CHARACTERISTIC KINP_MELaneHeadAngRt2_radians_ovrdflg "" VALUE 0x0000 /* @ECU_Address@KINP_MELaneHeadAngRt2_radians_ovrdflg@ */ Scalar_BOOLEAN 0 SWC_INP_type_CM_boolean_flg 0.0 1.0 /end CHARACTERISTIC
/begin CHARACTERISTIC KINP_MELaneHeadAngRt_radians_ovrdflg "" VALUE 0x0000 /* @ECU_Address@KINP_MELaneHeadAngRt_radians_ovrdflg@ */ Scalar_BOOLEAN 0 SWC_INP_type_CM_boolean_flg 0.0 1.0 /end CHARACTERISTIC
/begin CHARACTERISTIC KINP_MELanePosLt2_m_ovrdflg "" VALUE 0x0000 /* @ECU_Address@KINP_MELanePosLt2_m_ovrdflg@ */ Scalar_BOOLEAN 0 SWC_INP_type_CM_boolean_flg 0.0 1.0 /end CHARACTERISTIC
/begin CHARACTERISTIC KINP_MELanePosLt_m_ovrdflg "" VALUE 0x0000 /* @ECU_Address@KINP_MELanePosLt_m_ovrdflg@ */ Scalar_BOOLEAN 0 SWC_INP_type_CM_boolean_flg 0.0 1.0 /end CHARACTERISTIC
/begin CHARACTERISTIC KINP_MELanePosRt2_m_ovrdflg "" VALUE 0x0000 /* @ECU_Address@KINP_MELanePosRt2_m_ovrdflg@ */ Scalar_BOOLEAN 0 SWC_INP_type_CM_boolean_flg 0.0 1.0 /end CHARACTERISTIC
/begin CHARACTERISTIC KINP_MELanePosRt_m_ovrdflg "" VALUE 0x0000 /* @ECU_Address@KINP_MELanePosRt_m_ovrdflg@ */ Scalar_BOOLEAN 0 SWC_INP_type_CM_boolean_flg 0.0 1.0 /end CHARACTERISTIC
/begin CHARACTERISTIC KINP_PSEATErrorSta_flg_defval "" VALUE 0x0000 /* @ECU_Address@KINP_PSEATErrorSta_flg_defval@ */ Scalar_BOOLEAN 0 SWC_INP_type_CM_boolean_flg 0.0 1.0 /end CHARACTERISTIC
/begin CHARACTERISTIC KINP_PSEATErrorSta_flg_ovrdflg "" VALUE 0x0000 /* @ECU_Address@KINP_PSEATErrorSta_flg_ovrdflg@ */ Scalar_BOOLEAN 0 SWC_INP_type_CM_boolean_flg 0.0 1.0 /end CHARACTERISTIC
/begin CHARACTERISTIC KINP_PSEATErrorSta_flg_ovrdval "" VALUE 0x0000 /* @ECU_Address@KINP_PSEATErrorSta_flg_ovrdval@ */ Scalar_BOOLEAN 0 SWC_INP_type_CM_boolean_flg 0.0 1.0 /end CHARACTERISTIC
/begin CHARACTERISTIC KINP_PSEATHWVer_enum_ovrdflg "" VALUE 0x0000 /* @ECU_Address@KINP_PSEATHWVer_enum_ovrdflg@ */ Scalar_BOOLEAN 0 SWC_INP_type_CM_boolean_flg 0.0 1.0 /end CHARACTERISTIC
/begin CHARACTERISTIC KINP_PSEATMode_enum_ovrdflg "" VALUE 0x0000 /* @ECU_Address@KINP_PSEATMode_enum_ovrdflg@ */ Scalar_BOOLEAN 0 SWC_INP_type_CM_boolean_flg 0.0 1.0 /end CHARACTERISTIC
/begin CHARACTERISTIC KINP_PSEATSWVer_enum_ovrdflg "" VALUE 0x0000 /* @ECU_Address@KINP_PSEATSWVer_enum_ovrdflg@ */ Scalar_BOOLEAN 0 SWC_INP_type_CM_boolean_flg 0.0 1.0 /end CHARACTERISTIC
/begin CHARACTERISTIC KINP_PSEATVentSta_enum_ovrdflg "" VALUE 0x0000 /* @ECU_Address@KINP_PSEATVentSta_enum_ovrdflg@ */ Scalar_BOOLEAN 0 SWC_INP_type_CM_boolean_flg 0.0 1.0 /end CHARACTERISTIC
/begin CHARACTERISTIC KINP_PSEATheatersta_enum_ovrdflg "" VALUE 0x0000 /* @ECU_Address@KINP_PSEATheatersta_enum_ovrdflg@ */ Scalar_BOOLEAN 0 SWC_INP_type_CM_boolean_flg 0.0 1.0 /end CHARACTERISTIC
/begin CHARACTERISTIC KINP_PTC1PowerConsumption_kW_ovrdflg "" VALUE 0x0000 /* @ECU_Address@KINP_PTC1PowerConsumption_kW_ovrdflg@ */ Scalar_BOOLEAN 0 SWC_INP_type_CM_boolean_flg 0.0 1.0 /end CHARACTERISTIC
/begin CHARACTERISTIC KINP_RAPWL01LINResponseError_flg_defval "" VALUE 0x0000 /* @ECU_Address@KINP_RAPWL01LINResponseError_flg_defval@ */ Scalar_BOOLEAN 0 SWC_INP_type_CM_boolean_flg 0.0 1.0 /end CHARACTERISTIC
/begin CHARACTERISTIC KINP_RAPWL01LINResponseError_flg_ovrdflg "" VALUE 0x0000 /* @ECU_Address@KINP_RAPWL01LINResponseError_flg_ovrdflg@ */ Scalar_BOOLEAN 0 SWC_INP_type_CM_boolean_flg 0.0 1.0 /end CHARACTERISTIC
/begin CHARACTERISTIC KINP_RAPWL01LINResponseError_flg_ovrdval "" VALUE 0x0000 /* @ECU_Address@KINP_RAPWL01LINResponseError_flg_ovrdval@ */ Scalar_BOOLEAN 0 SWC_INP_type_CM_boolean_flg 0.0 1.0 /end CHARACTERISTIC
/begin CHARACTERISTIC KINP_RLSLampSta_flg_defval "" VALUE 0x0000 /* @ECU_Address@KINP_RLSLampSta_flg_defval@ */ Scalar_BOOLEAN 0 SWC_INP_type_CM_boolean_flg 0.0 1.0 /end CHARACTERISTIC
/begin CHARACTERISTIC KINP_RLSLampSta_flg_ovrdflg "" VALUE 0x0000 /* @ECU_Address@KINP_RLSLampSta_flg_ovrdflg@ */ Scalar_BOOLEAN 0 SWC_INP_type_CM_boolean_flg 0.0 1.0 /end CHARACTERISTIC
/begin CHARACTERISTIC KINP_RLSLampSta_flg_ovrdval "" VALUE 0x0000 /* @ECU_Address@KINP_RLSLampSta_flg_ovrdval@ */ Scalar_BOOLEAN 0 SWC_INP_type_CM_boolean_flg 0.0 1.0 /end CHARACTERISTIC
/begin CHARACTERISTIC KINP_RLSRainSnrWiperCmd_enum_ovrdflg "" VALUE 0x0000 /* @ECU_Address@KINP_RLSRainSnrWiperCmd_enum_ovrdflg@ */ Scalar_BOOLEAN 0 SWC_INP_type_CM_boolean_flg 0.0 1.0 /end CHARACTERISTIC
/begin CHARACTERISTIC KINP_ReserveChargeOFFDay_DAY_ovrdflg "" VALUE 0x0000 /* @ECU_Address@KINP_ReserveChargeOFFDay_DAY_ovrdflg@ */ Scalar_BOOLEAN 0 SWC_INP_type_CM_boolean_flg 0.0 1.0 /end CHARACTERISTIC
/begin CHARACTERISTIC KINP_ReserveChargeOFFHour_hr_ovrdflg "" VALUE 0x0000 /* @ECU_Address@KINP_ReserveChargeOFFHour_hr_ovrdflg@ */ Scalar_BOOLEAN 0 SWC_INP_type_CM_boolean_flg 0.0 1.0 /end CHARACTERISTIC
/begin CHARACTERISTIC KINP_ReserveChargeOFFMinute_min_ovrdflg "" VALUE 0x0000 /* @ECU_Address@KINP_ReserveChargeOFFMinute_min_ovrdflg@ */ Scalar_BOOLEAN 0 SWC_INP_type_CM_boolean_flg 0.0 1.0 /end CHARACTERISTIC
/begin CHARACTERISTIC KINP_ReserveChargeOFFMonth_MONTH_ovrdflg "" VALUE 0x0000 /* @ECU_Address@KINP_ReserveChargeOFFMonth_MONTH_ovrdflg@ */ Scalar_BOOLEAN 0 SWC_INP_type_CM_boolean_flg 0.0 1.0 /end CHARACTERISTIC
/begin CHARACTERISTIC KINP_ReserveChargeOFFYear_YEAR_ovrdflg "" VALUE 0x0000 /* @ECU_Address@KINP_ReserveChargeOFFYear_YEAR_ovrdflg@ */ Scalar_BOOLEAN 0 SWC_INP_type_CM_boolean_flg 0.0 1.0 /end CHARACTERISTIC
/begin CHARACTERISTIC KINP_ReserveChargeOnDay_DAY_ovrdflg "" VALUE 0x0000 /* @ECU_Address@KINP_ReserveChargeOnDay_DAY_ovrdflg@ */ Scalar_BOOLEAN 0 SWC_INP_type_CM_boolean_flg 0.0 1.0 /end CHARACTERISTIC
/begin CHARACTERISTIC KINP_ReserveChargeOnHour_hr_ovrdflg "" VALUE 0x0000 /* @ECU_Address@KINP_ReserveChargeOnHour_hr_ovrdflg@ */ Scalar_BOOLEAN 0 SWC_INP_type_CM_boolean_flg 0.0 1.0 /end CHARACTERISTIC
/begin CHARACTERISTIC KINP_ReserveChargeOnMinute_min_ovrdflg "" VALUE 0x0000 /* @ECU_Address@KINP_ReserveChargeOnMinute_min_ovrdflg@ */ Scalar_BOOLEAN 0 SWC_INP_type_CM_boolean_flg 0.0 1.0 /end CHARACTERISTIC
/begin CHARACTERISTIC KINP_ReserveChargeOnMonth_MONTH_ovrdflg "" VALUE 0x0000 /* @ECU_Address@KINP_ReserveChargeOnMonth_MONTH_ovrdflg@ */ Scalar_BOOLEAN 0 SWC_INP_type_CM_boolean_flg 0.0 1.0 /end CHARACTERISTIC
/begin CHARACTERISTIC KINP_ReserveChargeOnYear_YEAR_ovrdflg "" VALUE 0x0000 /* @ECU_Address@KINP_ReserveChargeOnYear_YEAR_ovrdflg@ */ Scalar_BOOLEAN 0 SWC_INP_type_CM_boolean_flg 0.0 1.0 /end CHARACTERISTIC
/begin CHARACTERISTIC KINP_RightTurnLightReq_flg_defval "" VALUE 0x0000 /* @ECU_Address@KINP_RightTurnLightReq_flg_defval@ */ Scalar_BOOLEAN 0 SWC_INP_type_CM_boolean_flg 0.0 1.0 /end CHARACTERISTIC
/begin CHARACTERISTIC KINP_RightTurnLightReq_flg_ovrdflg "" VALUE 0x0000 /* @ECU_Address@KINP_RightTurnLightReq_flg_ovrdflg@ */ Scalar_BOOLEAN 0 SWC_INP_type_CM_boolean_flg 0.0 1.0 /end CHARACTERISTIC
/begin CHARACTERISTIC KINP_RightTurnLightReq_flg_ovrdval "" VALUE 0x0000 /* @ECU_Address@KINP_RightTurnLightReq_flg_ovrdval@ */ Scalar_BOOLEAN 0 SWC_INP_type_CM_boolean_flg 0.0 1.0 /end CHARACTERISTIC
/begin CHARACTERISTIC KINP_SRRBSDWarnL_enum_ovrdflg "" VALUE 0x0000 /* @ECU_Address@KINP_SRRBSDWarnL_enum_ovrdflg@ */ Scalar_BOOLEAN 0 SWC_INP_type_CM_boolean_flg 0.0 1.0 /end CHARACTERISTIC
/begin CHARACTERISTIC KINP_SRRBSDWarnR_enum_ovrdflg "" VALUE 0x0000 /* @ECU_Address@KINP_SRRBSDWarnR_enum_ovrdflg@ */ Scalar_BOOLEAN 0 SWC_INP_type_CM_boolean_flg 0.0 1.0 /end CHARACTERISTIC
/begin CHARACTERISTIC KINP_SRRODASoundL_flg_defval "" VALUE 0x0000 /* @ECU_Address@KINP_SRRODASoundL_flg_defval@ */ Scalar_BOOLEAN 0 SWC_INP_type_CM_boolean_flg 0.0 1.0 /end CHARACTERISTIC
/begin CHARACTERISTIC KINP_SRRODASoundL_flg_ovrdflg "" VALUE 0x0000 /* @ECU_Address@KINP_SRRODASoundL_flg_ovrdflg@ */ Scalar_BOOLEAN 0 SWC_INP_type_CM_boolean_flg 0.0 1.0 /end CHARACTERISTIC
/begin CHARACTERISTIC KINP_SRRODASoundL_flg_ovrdval "" VALUE 0x0000 /* @ECU_Address@KINP_SRRODASoundL_flg_ovrdval@ */ Scalar_BOOLEAN 0 SWC_INP_type_CM_boolean_flg 0.0 1.0 /end CHARACTERISTIC
/begin CHARACTERISTIC KINP_SRRODASoundR_flg_defval "" VALUE 0x0000 /* @ECU_Address@KINP_SRRODASoundR_flg_defval@ */ Scalar_BOOLEAN 0 SWC_INP_type_CM_boolean_flg 0.0 1.0 /end CHARACTERISTIC
/begin CHARACTERISTIC KINP_SRRODASoundR_flg_ovrdflg "" VALUE 0x0000 /* @ECU_Address@KINP_SRRODASoundR_flg_ovrdflg@ */ Scalar_BOOLEAN 0 SWC_INP_type_CM_boolean_flg 0.0 1.0 /end CHARACTERISTIC
/begin CHARACTERISTIC KINP_SRRODASoundR_flg_ovrdval "" VALUE 0x0000 /* @ECU_Address@KINP_SRRODASoundR_flg_ovrdval@ */ Scalar_BOOLEAN 0 SWC_INP_type_CM_boolean_flg 0.0 1.0 /end CHARACTERISTIC
/begin CHARACTERISTIC KINP_SRRODAWarnL_enum_ovrdflg "" VALUE 0x0000 /* @ECU_Address@KINP_SRRODAWarnL_enum_ovrdflg@ */ Scalar_BOOLEAN 0 SWC_INP_type_CM_boolean_flg 0.0 1.0 /end CHARACTERISTIC
/begin CHARACTERISTIC KINP_SRRODAWarnR_enum_ovrdflg "" VALUE 0x0000 /* @ECU_Address@KINP_SRRODAWarnR_enum_ovrdflg@ */ Scalar_BOOLEAN 0 SWC_INP_type_CM_boolean_flg 0.0 1.0 /end CHARACTERISTIC
/begin CHARACTERISTIC KINP_SWC2LADASSta_flg_defval "" VALUE 0x0000 /* @ECU_Address@KINP_SWC2LADASSta_flg_defval@ */ Scalar_BOOLEAN 0 SWC_INP_type_CM_boolean_flg 0.0 1.0 /end CHARACTERISTIC
/begin CHARACTERISTIC KINP_SWC2LADASSta_flg_ovrdflg "" VALUE 0x0000 /* @ECU_Address@KINP_SWC2LADASSta_flg_ovrdflg@ */ Scalar_BOOLEAN 0 SWC_INP_type_CM_boolean_flg 0.0 1.0 /end CHARACTERISTIC
/begin CHARACTERISTIC KINP_SWC2LADASSta_flg_ovrdval "" VALUE 0x0000 /* @ECU_Address@KINP_SWC2LADASSta_flg_ovrdval@ */ Scalar_BOOLEAN 0 SWC_INP_type_CM_boolean_flg 0.0 1.0 /end CHARACTERISTIC
/begin CHARACTERISTIC KINP_SWC2LDriveModeSta_flg_defval "" VALUE 0x0000 /* @ECU_Address@KINP_SWC2LDriveModeSta_flg_defval@ */ Scalar_BOOLEAN 0 SWC_INP_type_CM_boolean_flg 0.0 1.0 /end CHARACTERISTIC
/begin CHARACTERISTIC KINP_SWC2LDriveModeSta_flg_ovrdflg "" VALUE 0x0000 /* @ECU_Address@KINP_SWC2LDriveModeSta_flg_ovrdflg@ */ Scalar_BOOLEAN 0 SWC_INP_type_CM_boolean_flg 0.0 1.0 /end CHARACTERISTIC
/begin CHARACTERISTIC KINP_SWC2LDriveModeSta_flg_ovrdval "" VALUE 0x0000 /* @ECU_Address@KINP_SWC2LDriveModeSta_flg_ovrdval@ */ Scalar_BOOLEAN 0 SWC_INP_type_CM_boolean_flg 0.0 1.0 /end CHARACTERISTIC
/begin CHARACTERISTIC KINP_SWC2LHomeSta_flg_defval "" VALUE 0x0000 /* @ECU_Address@KINP_SWC2LHomeSta_flg_defval@ */ Scalar_BOOLEAN 0 SWC_INP_type_CM_boolean_flg 0.0 1.0 /end CHARACTERISTIC
/begin CHARACTERISTIC KINP_SWC2LHomeSta_flg_ovrdflg "" VALUE 0x0000 /* @ECU_Address@KINP_SWC2LHomeSta_flg_ovrdflg@ */ Scalar_BOOLEAN 0 SWC_INP_type_CM_boolean_flg 0.0 1.0 /end CHARACTERISTIC
/begin CHARACTERISTIC KINP_SWC2LHomeSta_flg_ovrdval "" VALUE 0x0000 /* @ECU_Address@KINP_SWC2LHomeSta_flg_ovrdval@ */ Scalar_BOOLEAN 0 SWC_INP_type_CM_boolean_flg 0.0 1.0 /end CHARACTERISTIC
/begin CHARACTERISTIC KINP_SWC2LLeftSta_flg_defval "" VALUE 0x0000 /* @ECU_Address@KINP_SWC2LLeftSta_flg_defval@ */ Scalar_BOOLEAN 0 SWC_INP_type_CM_boolean_flg 0.0 1.0 /end CHARACTERISTIC
/begin CHARACTERISTIC KINP_SWC2LLeftSta_flg_ovrdflg "" VALUE 0x0000 /* @ECU_Address@KINP_SWC2LLeftSta_flg_ovrdflg@ */ Scalar_BOOLEAN 0 SWC_INP_type_CM_boolean_flg 0.0 1.0 /end CHARACTERISTIC
/begin CHARACTERISTIC KINP_SWC2LLeftSta_flg_ovrdval "" VALUE 0x0000 /* @ECU_Address@KINP_SWC2LLeftSta_flg_ovrdval@ */ Scalar_BOOLEAN 0 SWC_INP_type_CM_boolean_flg 0.0 1.0 /end CHARACTERISTIC
/begin CHARACTERISTIC KINP_SWC2LRegenUpSta_flg_defval "" VALUE 0x0000 /* @ECU_Address@KINP_SWC2LRegenUpSta_flg_defval@ */ Scalar_BOOLEAN 0 SWC_INP_type_CM_boolean_flg 0.0 1.0 /end CHARACTERISTIC
/begin CHARACTERISTIC KINP_SWC2LRegenUpSta_flg_ovrdflg "" VALUE 0x0000 /* @ECU_Address@KINP_SWC2LRegenUpSta_flg_ovrdflg@ */ Scalar_BOOLEAN 0 SWC_INP_type_CM_boolean_flg 0.0 1.0 /end CHARACTERISTIC
/begin CHARACTERISTIC KINP_SWC2LRegenUpSta_flg_ovrdval "" VALUE 0x0000 /* @ECU_Address@KINP_SWC2LRegenUpSta_flg_ovrdval@ */ Scalar_BOOLEAN 0 SWC_INP_type_CM_boolean_flg 0.0 1.0 /end CHARACTERISTIC
/begin CHARACTERISTIC KINP_SWC2LRightSta_flg_defval "" VALUE 0x0000 /* @ECU_Address@KINP_SWC2LRightSta_flg_defval@ */ Scalar_BOOLEAN 0 SWC_INP_type_CM_boolean_flg 0.0 1.0 /end CHARACTERISTIC
/begin CHARACTERISTIC KINP_SWC2LRightSta_flg_ovrdflg "" VALUE 0x0000 /* @ECU_Address@KINP_SWC2LRightSta_flg_ovrdflg@ */ Scalar_BOOLEAN 0 SWC_INP_type_CM_boolean_flg 0.0 1.0 /end CHARACTERISTIC
/begin CHARACTERISTIC KINP_SWC2LRightSta_flg_ovrdval "" VALUE 0x0000 /* @ECU_Address@KINP_SWC2LRightSta_flg_ovrdval@ */ Scalar_BOOLEAN 0 SWC_INP_type_CM_boolean_flg 0.0 1.0 /end CHARACTERISTIC
/begin CHARACTERISTIC KINP_SWC2LScrollDownSta_flg_defval "" VALUE 0x0000 /* @ECU_Address@KINP_SWC2LScrollDownSta_flg_defval@ */ Scalar_BOOLEAN 0 SWC_INP_type_CM_boolean_flg 0.0 1.0 /end CHARACTERISTIC
/begin CHARACTERISTIC KINP_SWC2LScrollDownSta_flg_ovrdflg "" VALUE 0x0000 /* @ECU_Address@KINP_SWC2LScrollDownSta_flg_ovrdflg@ */ Scalar_BOOLEAN 0 SWC_INP_type_CM_boolean_flg 0.0 1.0 /end CHARACTERISTIC
/begin CHARACTERISTIC KINP_SWC2LScrollDownSta_flg_ovrdval "" VALUE 0x0000 /* @ECU_Address@KINP_SWC2LScrollDownSta_flg_ovrdval@ */ Scalar_BOOLEAN 0 SWC_INP_type_CM_boolean_flg 0.0 1.0 /end CHARACTERISTIC
/begin CHARACTERISTIC KINP_SWC2LScrollPressSta_flg_defval "" VALUE 0x0000 /* @ECU_Address@KINP_SWC2LScrollPressSta_flg_defval@ */ Scalar_BOOLEAN 0 SWC_INP_type_CM_boolean_flg 0.0 1.0 /end CHARACTERISTIC
/begin CHARACTERISTIC KINP_SWC2LScrollPressSta_flg_ovrdflg "" VALUE 0x0000 /* @ECU_Address@KINP_SWC2LScrollPressSta_flg_ovrdflg@ */ Scalar_BOOLEAN 0 SWC_INP_type_CM_boolean_flg 0.0 1.0 /end CHARACTERISTIC
/begin CHARACTERISTIC KINP_SWC2LScrollPressSta_flg_ovrdval "" VALUE 0x0000 /* @ECU_Address@KINP_SWC2LScrollPressSta_flg_ovrdval@ */ Scalar_BOOLEAN 0 SWC_INP_type_CM_boolean_flg 0.0 1.0 /end CHARACTERISTIC
/begin CHARACTERISTIC KINP_SWC2LScrollUpSta_flg_defval "" VALUE 0x0000 /* @ECU_Address@KINP_SWC2LScrollUpSta_flg_defval@ */ Scalar_BOOLEAN 0 SWC_INP_type_CM_boolean_flg 0.0 1.0 /end CHARACTERISTIC
/begin CHARACTERISTIC KINP_SWC2LScrollUpSta_flg_ovrdflg "" VALUE 0x0000 /* @ECU_Address@KINP_SWC2LScrollUpSta_flg_ovrdflg@ */ Scalar_BOOLEAN 0 SWC_INP_type_CM_boolean_flg 0.0 1.0 /end CHARACTERISTIC
/begin CHARACTERISTIC KINP_SWC2LScrollUpSta_flg_ovrdval "" VALUE 0x0000 /* @ECU_Address@KINP_SWC2LScrollUpSta_flg_ovrdval@ */ Scalar_BOOLEAN 0 SWC_INP_type_CM_boolean_flg 0.0 1.0 /end CHARACTERISTIC
/begin CHARACTERISTIC KINP_SWC2RCustomizeSta_flg_defval "" VALUE 0x0000 /* @ECU_Address@KINP_SWC2RCustomizeSta_flg_defval@ */ Scalar_BOOLEAN 0 SWC_INP_type_CM_boolean_flg 0.0 1.0 /end CHARACTERISTIC
/begin CHARACTERISTIC KINP_SWC2RCustomizeSta_flg_ovrdflg "" VALUE 0x0000 /* @ECU_Address@KINP_SWC2RCustomizeSta_flg_ovrdflg@ */ Scalar_BOOLEAN 0 SWC_INP_type_CM_boolean_flg 0.0 1.0 /end CHARACTERISTIC
/begin CHARACTERISTIC KINP_SWC2RCustomizeSta_flg_ovrdval "" VALUE 0x0000 /* @ECU_Address@KINP_SWC2RCustomizeSta_flg_ovrdval@ */ Scalar_BOOLEAN 0 SWC_INP_type_CM_boolean_flg 0.0 1.0 /end CHARACTERISTIC
/begin CHARACTERISTIC KINP_SWC2RLeftSta_flg_defval "" VALUE 0x0000 /* @ECU_Address@KINP_SWC2RLeftSta_flg_defval@ */ Scalar_BOOLEAN 0 SWC_INP_type_CM_boolean_flg 0.0 1.0 /end CHARACTERISTIC
/begin CHARACTERISTIC KINP_SWC2RLeftSta_flg_ovrdflg "" VALUE 0x0000 /* @ECU_Address@KINP_SWC2RLeftSta_flg_ovrdflg@ */ Scalar_BOOLEAN 0 SWC_INP_type_CM_boolean_flg 0.0 1.0 /end CHARACTERISTIC
/begin CHARACTERISTIC KINP_SWC2RLeftSta_flg_ovrdval "" VALUE 0x0000 /* @ECU_Address@KINP_SWC2RLeftSta_flg_ovrdval@ */ Scalar_BOOLEAN 0 SWC_INP_type_CM_boolean_flg 0.0 1.0 /end CHARACTERISTIC
/begin CHARACTERISTIC KINP_SWC2RPageSwitchSta_flg_defval "" VALUE 0x0000 /* @ECU_Address@KINP_SWC2RPageSwitchSta_flg_defval@ */ Scalar_BOOLEAN 0 SWC_INP_type_CM_boolean_flg 0.0 1.0 /end CHARACTERISTIC
/begin CHARACTERISTIC KINP_SWC2RPageSwitchSta_flg_ovrdflg "" VALUE 0x0000 /* @ECU_Address@KINP_SWC2RPageSwitchSta_flg_ovrdflg@ */ Scalar_BOOLEAN 0 SWC_INP_type_CM_boolean_flg 0.0 1.0 /end CHARACTERISTIC
/begin CHARACTERISTIC KINP_SWC2RPageSwitchSta_flg_ovrdval "" VALUE 0x0000 /* @ECU_Address@KINP_SWC2RPageSwitchSta_flg_ovrdval@ */ Scalar_BOOLEAN 0 SWC_INP_type_CM_boolean_flg 0.0 1.0 /end CHARACTERISTIC
/begin CHARACTERISTIC KINP_SWC2RRegenDownSta_flg_defval "" VALUE 0x0000 /* @ECU_Address@KINP_SWC2RRegenDownSta_flg_defval@ */ Scalar_BOOLEAN 0 SWC_INP_type_CM_boolean_flg 0.0 1.0 /end CHARACTERISTIC
/begin CHARACTERISTIC KINP_SWC2RRegenDownSta_flg_ovrdflg "" VALUE 0x0000 /* @ECU_Address@KINP_SWC2RRegenDownSta_flg_ovrdflg@ */ Scalar_BOOLEAN 0 SWC_INP_type_CM_boolean_flg 0.0 1.0 /end CHARACTERISTIC
/begin CHARACTERISTIC KINP_SWC2RRegenDownSta_flg_ovrdval "" VALUE 0x0000 /* @ECU_Address@KINP_SWC2RRegenDownSta_flg_ovrdval@ */ Scalar_BOOLEAN 0 SWC_INP_type_CM_boolean_flg 0.0 1.0 /end CHARACTERISTIC
/begin CHARACTERISTIC KINP_SWC2RRightSta_flg_defval "" VALUE 0x0000 /* @ECU_Address@KINP_SWC2RRightSta_flg_defval@ */ Scalar_BOOLEAN 0 SWC_INP_type_CM_boolean_flg 0.0 1.0 /end CHARACTERISTIC
/begin CHARACTERISTIC KINP_SWC2RRightSta_flg_ovrdflg "" VALUE 0x0000 /* @ECU_Address@KINP_SWC2RRightSta_flg_ovrdflg@ */ Scalar_BOOLEAN 0 SWC_INP_type_CM_boolean_flg 0.0 1.0 /end CHARACTERISTIC
/begin CHARACTERISTIC KINP_SWC2RRightSta_flg_ovrdval "" VALUE 0x0000 /* @ECU_Address@KINP_SWC2RRightSta_flg_ovrdval@ */ Scalar_BOOLEAN 0 SWC_INP_type_CM_boolean_flg 0.0 1.0 /end CHARACTERISTIC
/begin CHARACTERISTIC KINP_SWC2RScrollDownSta_flg_defval "" VALUE 0x0000 /* @ECU_Address@KINP_SWC2RScrollDownSta_flg_defval@ */ Scalar_BOOLEAN 0 SWC_INP_type_CM_boolean_flg 0.0 1.0 /end CHARACTERISTIC
/begin CHARACTERISTIC KINP_SWC2RScrollDownSta_flg_ovrdflg "" VALUE 0x0000 /* @ECU_Address@KINP_SWC2RScrollDownSta_flg_ovrdflg@ */ Scalar_BOOLEAN 0 SWC_INP_type_CM_boolean_flg 0.0 1.0 /end CHARACTERISTIC
/begin CHARACTERISTIC KINP_SWC2RScrollDownSta_flg_ovrdval "" VALUE 0x0000 /* @ECU_Address@KINP_SWC2RScrollDownSta_flg_ovrdval@ */ Scalar_BOOLEAN 0 SWC_INP_type_CM_boolean_flg 0.0 1.0 /end CHARACTERISTIC
/begin CHARACTERISTIC KINP_SWC2RScrollPressSta_flg_defval "" VALUE 0x0000 /* @ECU_Address@KINP_SWC2RScrollPressSta_flg_defval@ */ Scalar_BOOLEAN 0 SWC_INP_type_CM_boolean_flg 0.0 1.0 /end CHARACTERISTIC
/begin CHARACTERISTIC KINP_SWC2RScrollPressSta_flg_ovrdflg "" VALUE 0x0000 /* @ECU_Address@KINP_SWC2RScrollPressSta_flg_ovrdflg@ */ Scalar_BOOLEAN 0 SWC_INP_type_CM_boolean_flg 0.0 1.0 /end CHARACTERISTIC
/begin CHARACTERISTIC KINP_SWC2RScrollPressSta_flg_ovrdval "" VALUE 0x0000 /* @ECU_Address@KINP_SWC2RScrollPressSta_flg_ovrdval@ */ Scalar_BOOLEAN 0 SWC_INP_type_CM_boolean_flg 0.0 1.0 /end CHARACTERISTIC
/begin CHARACTERISTIC KINP_SWC2RScrollUpSta_flg_defval "" VALUE 0x0000 /* @ECU_Address@KINP_SWC2RScrollUpSta_flg_defval@ */ Scalar_BOOLEAN 0 SWC_INP_type_CM_boolean_flg 0.0 1.0 /end CHARACTERISTIC
/begin CHARACTERISTIC KINP_SWC2RScrollUpSta_flg_ovrdflg "" VALUE 0x0000 /* @ECU_Address@KINP_SWC2RScrollUpSta_flg_ovrdflg@ */ Scalar_BOOLEAN 0 SWC_INP_type_CM_boolean_flg 0.0 1.0 /end CHARACTERISTIC
/begin CHARACTERISTIC KINP_SWC2RScrollUpSta_flg_ovrdval "" VALUE 0x0000 /* @ECU_Address@KINP_SWC2RScrollUpSta_flg_ovrdval@ */ Scalar_BOOLEAN 0 SWC_INP_type_CM_boolean_flg 0.0 1.0 /end CHARACTERISTIC
/begin CHARACTERISTIC KINP_SWC2RVRSta_flg_defval "" VALUE 0x0000 /* @ECU_Address@KINP_SWC2RVRSta_flg_defval@ */ Scalar_BOOLEAN 0 SWC_INP_type_CM_boolean_flg 0.0 1.0 /end CHARACTERISTIC
/begin CHARACTERISTIC KINP_SWC2RVRSta_flg_ovrdflg "" VALUE 0x0000 /* @ECU_Address@KINP_SWC2RVRSta_flg_ovrdflg@ */ Scalar_BOOLEAN 0 SWC_INP_type_CM_boolean_flg 0.0 1.0 /end CHARACTERISTIC
/begin CHARACTERISTIC KINP_SWC2RVRSta_flg_ovrdval "" VALUE 0x0000 /* @ECU_Address@KINP_SWC2RVRSta_flg_ovrdval@ */ Scalar_BOOLEAN 0 SWC_INP_type_CM_boolean_flg 0.0 1.0 /end CHARACTERISTIC
/begin CHARACTERISTIC KINP_SWCACCSta_flg_defval "" VALUE 0x0000 /* @ECU_Address@KINP_SWCACCSta_flg_defval@ */ Scalar_BOOLEAN 0 SWC_INP_type_CM_boolean_flg 0.0 1.0 /end CHARACTERISTIC
/begin CHARACTERISTIC KINP_SWCACCSta_flg_ovrdflg "" VALUE 0x0000 /* @ECU_Address@KINP_SWCACCSta_flg_ovrdflg@ */ Scalar_BOOLEAN 0 SWC_INP_type_CM_boolean_flg 0.0 1.0 /end CHARACTERISTIC
/begin CHARACTERISTIC KINP_SWCACCSta_flg_ovrdval "" VALUE 0x0000 /* @ECU_Address@KINP_SWCACCSta_flg_ovrdval@ */ Scalar_BOOLEAN 0 SWC_INP_type_CM_boolean_flg 0.0 1.0 /end CHARACTERISTIC
/begin CHARACTERISTIC KINP_SWCCANCELSta_flg_defval "" VALUE 0x0000 /* @ECU_Address@KINP_SWCCANCELSta_flg_defval@ */ Scalar_BOOLEAN 0 SWC_INP_type_CM_boolean_flg 0.0 1.0 /end CHARACTERISTIC
/begin CHARACTERISTIC KINP_SWCCANCELSta_flg_ovrdflg "" VALUE 0x0000 /* @ECU_Address@KINP_SWCCANCELSta_flg_ovrdflg@ */ Scalar_BOOLEAN 0 SWC_INP_type_CM_boolean_flg 0.0 1.0 /end CHARACTERISTIC
/begin CHARACTERISTIC KINP_SWCCANCELSta_flg_ovrdval "" VALUE 0x0000 /* @ECU_Address@KINP_SWCCANCELSta_flg_ovrdval@ */ Scalar_BOOLEAN 0 SWC_INP_type_CM_boolean_flg 0.0 1.0 /end CHARACTERISTIC
/begin CHARACTERISTIC KINP_SWCDistanceSta_flg_defval "" VALUE 0x0000 /* @ECU_Address@KINP_SWCDistanceSta_flg_defval@ */ Scalar_BOOLEAN 0 SWC_INP_type_CM_boolean_flg 0.0 1.0 /end CHARACTERISTIC
/begin CHARACTERISTIC KINP_SWCDistanceSta_flg_ovrdflg "" VALUE 0x0000 /* @ECU_Address@KINP_SWCDistanceSta_flg_ovrdflg@ */ Scalar_BOOLEAN 0 SWC_INP_type_CM_boolean_flg 0.0 1.0 /end CHARACTERISTIC
/begin CHARACTERISTIC KINP_SWCDistanceSta_flg_ovrdval "" VALUE 0x0000 /* @ECU_Address@KINP_SWCDistanceSta_flg_ovrdval@ */ Scalar_BOOLEAN 0 SWC_INP_type_CM_boolean_flg 0.0 1.0 /end CHARACTERISTIC
/begin CHARACTERISTIC KINP_SWCDownSta_flg_defval "" VALUE 0x0000 /* @ECU_Address@KINP_SWCDownSta_flg_defval@ */ Scalar_BOOLEAN 0 SWC_INP_type_CM_boolean_flg 0.0 1.0 /end CHARACTERISTIC
/begin CHARACTERISTIC KINP_SWCDownSta_flg_ovrdflg "" VALUE 0x0000 /* @ECU_Address@KINP_SWCDownSta_flg_ovrdflg@ */ Scalar_BOOLEAN 0 SWC_INP_type_CM_boolean_flg 0.0 1.0 /end CHARACTERISTIC
/begin CHARACTERISTIC KINP_SWCDownSta_flg_ovrdval "" VALUE 0x0000 /* @ECU_Address@KINP_SWCDownSta_flg_ovrdval@ */ Scalar_BOOLEAN 0 SWC_INP_type_CM_boolean_flg 0.0 1.0 /end CHARACTERISTIC
/begin CHARACTERISTIC KINP_SWCLKASta_flg_defval "" VALUE 0x0000 /* @ECU_Address@KINP_SWCLKASta_flg_defval@ */ Scalar_BOOLEAN 0 SWC_INP_type_CM_boolean_flg 0.0 1.0 /end CHARACTERISTIC
/begin CHARACTERISTIC KINP_SWCLKASta_flg_ovrdflg "" VALUE 0x0000 /* @ECU_Address@KINP_SWCLKASta_flg_ovrdflg@ */ Scalar_BOOLEAN 0 SWC_INP_type_CM_boolean_flg 0.0 1.0 /end CHARACTERISTIC
/begin CHARACTERISTIC KINP_SWCLKASta_flg_ovrdval "" VALUE 0x0000 /* @ECU_Address@KINP_SWCLKASta_flg_ovrdval@ */ Scalar_BOOLEAN 0 SWC_INP_type_CM_boolean_flg 0.0 1.0 /end CHARACTERISTIC
/begin CHARACTERISTIC KINP_SWCLeftSta_flg_defval "" VALUE 0x0000 /* @ECU_Address@KINP_SWCLeftSta_flg_defval@ */ Scalar_BOOLEAN 0 SWC_INP_type_CM_boolean_flg 0.0 1.0 /end CHARACTERISTIC
/begin CHARACTERISTIC KINP_SWCLeftSta_flg_ovrdflg "" VALUE 0x0000 /* @ECU_Address@KINP_SWCLeftSta_flg_ovrdflg@ */ Scalar_BOOLEAN 0 SWC_INP_type_CM_boolean_flg 0.0 1.0 /end CHARACTERISTIC
/begin CHARACTERISTIC KINP_SWCLeftSta_flg_ovrdval "" VALUE 0x0000 /* @ECU_Address@KINP_SWCLeftSta_flg_ovrdval@ */ Scalar_BOOLEAN 0 SWC_INP_type_CM_boolean_flg 0.0 1.0 /end CHARACTERISTIC
/begin CHARACTERISTIC KINP_SWCRegenDown_flg_defval "" VALUE 0x0000 /* @ECU_Address@KINP_SWCRegenDown_flg_defval@ */ Scalar_BOOLEAN 0 SWC_INP_type_CM_boolean_flg 0.0 1.0 /end CHARACTERISTIC
/begin CHARACTERISTIC KINP_SWCRegenDown_flg_ovrdflg "" VALUE 0x0000 /* @ECU_Address@KINP_SWCRegenDown_flg_ovrdflg@ */ Scalar_BOOLEAN 0 SWC_INP_type_CM_boolean_flg 0.0 1.0 /end CHARACTERISTIC
/begin CHARACTERISTIC KINP_SWCRegenDown_flg_ovrdval "" VALUE 0x0000 /* @ECU_Address@KINP_SWCRegenDown_flg_ovrdval@ */ Scalar_BOOLEAN 0 SWC_INP_type_CM_boolean_flg 0.0 1.0 /end CHARACTERISTIC
/begin CHARACTERISTIC KINP_SWCRegenUp_flg_defval "" VALUE 0x0000 /* @ECU_Address@KINP_SWCRegenUp_flg_defval@ */ Scalar_BOOLEAN 0 SWC_INP_type_CM_boolean_flg 0.0 1.0 /end CHARACTERISTIC
/begin CHARACTERISTIC KINP_SWCRegenUp_flg_ovrdflg "" VALUE 0x0000 /* @ECU_Address@KINP_SWCRegenUp_flg_ovrdflg@ */ Scalar_BOOLEAN 0 SWC_INP_type_CM_boolean_flg 0.0 1.0 /end CHARACTERISTIC
/begin CHARACTERISTIC KINP_SWCRegenUp_flg_ovrdval "" VALUE 0x0000 /* @ECU_Address@KINP_SWCRegenUp_flg_ovrdval@ */ Scalar_BOOLEAN 0 SWC_INP_type_CM_boolean_flg 0.0 1.0 /end CHARACTERISTIC
/begin CHARACTERISTIC KINP_SWCResUpSta_flg_defval "" VALUE 0x0000 /* @ECU_Address@KINP_SWCResUpSta_flg_defval@ */ Scalar_BOOLEAN 0 SWC_INP_type_CM_boolean_flg 0.0 1.0 /end CHARACTERISTIC
/begin CHARACTERISTIC KINP_SWCResUpSta_flg_ovrdflg "" VALUE 0x0000 /* @ECU_Address@KINP_SWCResUpSta_flg_ovrdflg@ */ Scalar_BOOLEAN 0 SWC_INP_type_CM_boolean_flg 0.0 1.0 /end CHARACTERISTIC
/begin CHARACTERISTIC KINP_SWCResUpSta_flg_ovrdval "" VALUE 0x0000 /* @ECU_Address@KINP_SWCResUpSta_flg_ovrdval@ */ Scalar_BOOLEAN 0 SWC_INP_type_CM_boolean_flg 0.0 1.0 /end CHARACTERISTIC
/begin CHARACTERISTIC KINP_SWCRightSta_flg_defval "" VALUE 0x0000 /* @ECU_Address@KINP_SWCRightSta_flg_defval@ */ Scalar_BOOLEAN 0 SWC_INP_type_CM_boolean_flg 0.0 1.0 /end CHARACTERISTIC
/begin CHARACTERISTIC KINP_SWCRightSta_flg_ovrdflg "" VALUE 0x0000 /* @ECU_Address@KINP_SWCRightSta_flg_ovrdflg@ */ Scalar_BOOLEAN 0 SWC_INP_type_CM_boolean_flg 0.0 1.0 /end CHARACTERISTIC
/begin CHARACTERISTIC KINP_SWCRightSta_flg_ovrdval "" VALUE 0x0000 /* @ECU_Address@KINP_SWCRightSta_flg_ovrdval@ */ Scalar_BOOLEAN 0 SWC_INP_type_CM_boolean_flg 0.0 1.0 /end CHARACTERISTIC
/begin CHARACTERISTIC KINP_SWCSetdownSta_flg_defval "" VALUE 0x0000 /* @ECU_Address@KINP_SWCSetdownSta_flg_defval@ */ Scalar_BOOLEAN 0 SWC_INP_type_CM_boolean_flg 0.0 1.0 /end CHARACTERISTIC
/begin CHARACTERISTIC KINP_SWCSetdownSta_flg_ovrdflg "" VALUE 0x0000 /* @ECU_Address@KINP_SWCSetdownSta_flg_ovrdflg@ */ Scalar_BOOLEAN 0 SWC_INP_type_CM_boolean_flg 0.0 1.0 /end CHARACTERISTIC
/begin CHARACTERISTIC KINP_SWCSetdownSta_flg_ovrdval "" VALUE 0x0000 /* @ECU_Address@KINP_SWCSetdownSta_flg_ovrdval@ */ Scalar_BOOLEAN 0 SWC_INP_type_CM_boolean_flg 0.0 1.0 /end CHARACTERISTIC
/begin CHARACTERISTIC KINP_SWCTripSta_flg_defval "" VALUE 0x0000 /* @ECU_Address@KINP_SWCTripSta_flg_defval@ */ Scalar_BOOLEAN 0 SWC_INP_type_CM_boolean_flg 0.0 1.0 /end CHARACTERISTIC
/begin CHARACTERISTIC KINP_SWCTripSta_flg_ovrdflg "" VALUE 0x0000 /* @ECU_Address@KINP_SWCTripSta_flg_ovrdflg@ */ Scalar_BOOLEAN 0 SWC_INP_type_CM_boolean_flg 0.0 1.0 /end CHARACTERISTIC
/begin CHARACTERISTIC KINP_SWCTripSta_flg_ovrdval "" VALUE 0x0000 /* @ECU_Address@KINP_SWCTripSta_flg_ovrdval@ */ Scalar_BOOLEAN 0 SWC_INP_type_CM_boolean_flg 0.0 1.0 /end CHARACTERISTIC
/begin CHARACTERISTIC KINP_SWCUndefinedSta_flg_defval "" VALUE 0x0000 /* @ECU_Address@KINP_SWCUndefinedSta_flg_defval@ */ Scalar_BOOLEAN 0 SWC_INP_type_CM_boolean_flg 0.0 1.0 /end CHARACTERISTIC
/begin CHARACTERISTIC KINP_SWCUndefinedSta_flg_ovrdflg "" VALUE 0x0000 /* @ECU_Address@KINP_SWCUndefinedSta_flg_ovrdflg@ */ Scalar_BOOLEAN 0 SWC_INP_type_CM_boolean_flg 0.0 1.0 /end CHARACTERISTIC
/begin CHARACTERISTIC KINP_SWCUndefinedSta_flg_ovrdval "" VALUE 0x0000 /* @ECU_Address@KINP_SWCUndefinedSta_flg_ovrdval@ */ Scalar_BOOLEAN 0 SWC_INP_type_CM_boolean_flg 0.0 1.0 /end CHARACTERISTIC
/begin CHARACTERISTIC KINP_SWCUpSta_flg_defval "" VALUE 0x0000 /* @ECU_Address@KINP_SWCUpSta_flg_defval@ */ Scalar_BOOLEAN 0 SWC_INP_type_CM_boolean_flg 0.0 1.0 /end CHARACTERISTIC
/begin CHARACTERISTIC KINP_SWCUpSta_flg_ovrdflg "" VALUE 0x0000 /* @ECU_Address@KINP_SWCUpSta_flg_ovrdflg@ */ Scalar_BOOLEAN 0 SWC_INP_type_CM_boolean_flg 0.0 1.0 /end CHARACTERISTIC
/begin CHARACTERISTIC KINP_SWCUpSta_flg_ovrdval "" VALUE 0x0000 /* @ECU_Address@KINP_SWCUpSta_flg_ovrdval@ */ Scalar_BOOLEAN 0 SWC_INP_type_CM_boolean_flg 0.0 1.0 /end CHARACTERISTIC
/begin CHARACTERISTIC KINP_SWCVRSta_flg_defval "" VALUE 0x0000 /* @ECU_Address@KINP_SWCVRSta_flg_defval@ */ Scalar_BOOLEAN 0 SWC_INP_type_CM_boolean_flg 0.0 1.0 /end CHARACTERISTIC
/begin CHARACTERISTIC KINP_SWCVRSta_flg_ovrdflg "" VALUE 0x0000 /* @ECU_Address@KINP_SWCVRSta_flg_ovrdflg@ */ Scalar_BOOLEAN 0 SWC_INP_type_CM_boolean_flg 0.0 1.0 /end CHARACTERISTIC
/begin CHARACTERISTIC KINP_SWCVRSta_flg_ovrdval "" VALUE 0x0000 /* @ECU_Address@KINP_SWCVRSta_flg_ovrdval@ */ Scalar_BOOLEAN 0 SWC_INP_type_CM_boolean_flg 0.0 1.0 /end CHARACTERISTIC
/begin CHARACTERISTIC KINP_SWCmodeSta_flg_defval "" VALUE 0x0000 /* @ECU_Address@KINP_SWCmodeSta_flg_defval@ */ Scalar_BOOLEAN 0 SWC_INP_type_CM_boolean_flg 0.0 1.0 /end CHARACTERISTIC
/begin CHARACTERISTIC KINP_SWCmodeSta_flg_ovrdflg "" VALUE 0x0000 /* @ECU_Address@KINP_SWCmodeSta_flg_ovrdflg@ */ Scalar_BOOLEAN 0 SWC_INP_type_CM_boolean_flg 0.0 1.0 /end CHARACTERISTIC
/begin CHARACTERISTIC KINP_SWCmodeSta_flg_ovrdval "" VALUE 0x0000 /* @ECU_Address@KINP_SWCmodeSta_flg_ovrdval@ */ Scalar_BOOLEAN 0 SWC_INP_type_CM_boolean_flg 0.0 1.0 /end CHARACTERISTIC
/begin CHARACTERISTIC KINP_TBOXHWVER_enum_ovrdflg "" VALUE 0x0000 /* @ECU_Address@KINP_TBOXHWVER_enum_ovrdflg@ */ Scalar_BOOLEAN 0 SWC_INP_type_CM_boolean_flg 0.0 1.0 /end CHARACTERISTIC
/begin CHARACTERISTIC KINP_TBOXSWVER_enum_ovrdflg "" VALUE 0x0000 /* @ECU_Address@KINP_TBOXSWVER_enum_ovrdflg@ */ Scalar_BOOLEAN 0 SWC_INP_type_CM_boolean_flg 0.0 1.0 /end CHARACTERISTIC
/begin CHARACTERISTIC KINP_TargetType_enum_ovrdflg "" VALUE 0x0000 /* @ECU_Address@KINP_TargetType_enum_ovrdflg@ */ Scalar_BOOLEAN 0 SWC_INP_type_CM_boolean_flg 0.0 1.0 /end CHARACTERISTIC
/begin CHARACTERISTIC KINP_TimeGapLevel_enum_ovrdflg "" VALUE 0x0000 /* @ECU_Address@KINP_TimeGapLevel_enum_ovrdflg@ */ Scalar_BOOLEAN 0 SWC_INP_type_CM_boolean_flg 0.0 1.0 /end CHARACTERISTIC
/begin CHARACTERISTIC KINP_TimeSyncFromBSDay_DAY_ovrdflg "" VALUE 0x0000 /* @ECU_Address@KINP_TimeSyncFromBSDay_DAY_ovrdflg@ */ Scalar_BOOLEAN 0 SWC_INP_type_CM_boolean_flg 0.0 1.0 /end CHARACTERISTIC
/begin CHARACTERISTIC KINP_TimeSyncFromBSHour_hr_ovrdflg "" VALUE 0x0000 /* @ECU_Address@KINP_TimeSyncFromBSHour_hr_ovrdflg@ */ Scalar_BOOLEAN 0 SWC_INP_type_CM_boolean_flg 0.0 1.0 /end CHARACTERISTIC
/begin CHARACTERISTIC KINP_TimeSyncFromBSMinute_min_ovrdflg "" VALUE 0x0000 /* @ECU_Address@KINP_TimeSyncFromBSMinute_min_ovrdflg@ */ Scalar_BOOLEAN 0 SWC_INP_type_CM_boolean_flg 0.0 1.0 /end CHARACTERISTIC
/begin CHARACTERISTIC KINP_TimeSyncFromBSMonth_MONTH_ovrdflg "" VALUE 0x0000 /* @ECU_Address@KINP_TimeSyncFromBSMonth_MONTH_ovrdflg@ */ Scalar_BOOLEAN 0 SWC_INP_type_CM_boolean_flg 0.0 1.0 /end CHARACTERISTIC
/begin CHARACTERISTIC KINP_TimeSyncFromBSSecond_s_ovrdflg "" VALUE 0x0000 /* @ECU_Address@KINP_TimeSyncFromBSSecond_s_ovrdflg@ */ Scalar_BOOLEAN 0 SWC_INP_type_CM_boolean_flg 0.0 1.0 /end CHARACTERISTIC
/begin CHARACTERISTIC KINP_TimeSyncFromBSYear_YEAR_ovrdflg "" VALUE 0x0000 /* @ECU_Address@KINP_TimeSyncFromBSYear_YEAR_ovrdflg@ */ Scalar_BOOLEAN 0 SWC_INP_type_CM_boolean_flg 0.0 1.0 /end CHARACTERISTIC
/begin CHARACTERISTIC KINP_ACCObjDstLvl_enum_defval "" VALUE 0x0000 /* @ECU_Address@KINP_ACCObjDstLvl_enum_defval@ */ Scalar_UBYTE 0 SWC_INP_type_CM_uint8_enum 0.0 7.0 /end CHARACTERISTIC
/begin CHARACTERISTIC KINP_ACCObjDstLvl_enum_ovrdval "" VALUE 0x0000 /* @ECU_Address@KINP_ACCObjDstLvl_enum_ovrdval@ */ Scalar_UBYTE 0 SWC_INP_type_CM_uint8_enum 0.0 7.0 /end CHARACTERISTIC
/begin CHARACTERISTIC KINP_ADASACCSta_enum_defval "" VALUE 0x0000 /* @ECU_Address@KINP_ADASACCSta_enum_defval@ */ Scalar_UBYTE 0 SWC_INP_type_CM_uint8_enum 0.0 7.0 /end CHARACTERISTIC
/begin CHARACTERISTIC KINP_ADASACCSta_enum_ovrdval "" VALUE 0x0000 /* @ECU_Address@KINP_ADASACCSta_enum_ovrdval@ */ Scalar_UBYTE 0 SWC_INP_type_CM_uint8_enum 0.0 7.0 /end CHARACTERISTIC
/begin CHARACTERISTIC KINP_ADASAEBReq_enum_defval "" VALUE 0x0000 /* @ECU_Address@KINP_ADASAEBReq_enum_defval@ */ Scalar_UBYTE 0 SWC_INP_type_CM_uint8_enum 0.0 7.0 /end CHARACTERISTIC
/begin CHARACTERISTIC KINP_ADASAEBReq_enum_ovrdval "" VALUE 0x0000 /* @ECU_Address@KINP_ADASAEBReq_enum_ovrdval@ */ Scalar_UBYTE 0 SWC_INP_type_CM_uint8_enum 0.0 7.0 /end CHARACTERISTIC
/begin CHARACTERISTIC KINP_ADASAEBSta_enum_defval "" VALUE 0x0000 /* @ECU_Address@KINP_ADASAEBSta_enum_defval@ */ Scalar_UBYTE 0 SWC_INP_type_CM_uint8_enum 0.0 7.0 /end CHARACTERISTIC
/begin CHARACTERISTIC KINP_ADASAEBSta_enum_ovrdval "" VALUE 0x0000 /* @ECU_Address@KINP_ADASAEBSta_enum_ovrdval@ */ Scalar_UBYTE 0 SWC_INP_type_CM_uint8_enum 0.0 7.0 /end CHARACTERISTIC
/begin CHARACTERISTIC KINP_ADASCAMSpdLim_enum_defval "" VALUE 0x0000 /* @ECU_Address@KINP_ADASCAMSpdLim_enum_defval@ */ Scalar_UBYTE 0 SWC_INP_type_CM_uint8_enum 0.0 31.0 /end CHARACTERISTIC
/begin CHARACTERISTIC KINP_ADASCAMSpdLim_enum_ovrdval "" VALUE 0x0000 /* @ECU_Address@KINP_ADASCAMSpdLim_enum_ovrdval@ */ Scalar_UBYTE 0 SWC_INP_type_CM_uint8_enum 0.0 31.0 /end CHARACTERISTIC
/begin CHARACTERISTIC KINP_ADASDBSReq_enum_defval "" VALUE 0x0000 /* @ECU_Address@KINP_ADASDBSReq_enum_defval@ */ Scalar_UBYTE 0 SWC_INP_type_CM_uint8_enum 0.0 3.0 /end CHARACTERISTIC
/begin CHARACTERISTIC KINP_ADASDBSReq_enum_ovrdval "" VALUE 0x0000 /* @ECU_Address@KINP_ADASDBSReq_enum_ovrdval@ */ Scalar_UBYTE 0 SWC_INP_type_CM_uint8_enum 0.0 3.0 /end CHARACTERISTIC
/begin CHARACTERISTIC KINP_ADASFCWSta_enum_defval "" VALUE 0x0000 /* @ECU_Address@KINP_ADASFCWSta_enum_defval@ */ Scalar_UBYTE 0 SWC_INP_type_CM_uint8_enum 0.0 7.0 /end CHARACTERISTIC
/begin CHARACTERISTIC KINP_ADASFCWSta_enum_ovrdval "" VALUE 0x0000 /* @ECU_Address@KINP_ADASFCWSta_enum_ovrdval@ */ Scalar_UBYTE 0 SWC_INP_type_CM_uint8_enum 0.0 7.0 /end CHARACTERISTIC
/begin CHARACTERISTIC KINP_ADASISASta_enum_defval "" VALUE 0x0000 /* @ECU_Address@KINP_ADASISASta_enum_defval@ */ Scalar_UBYTE 0 SWC_INP_type_CM_uint8_enum 0.0 6.0 /end CHARACTERISTIC
/begin CHARACTERISTIC KINP_ADASISASta_enum_ovrdval "" VALUE 0x0000 /* @ECU_Address@KINP_ADASISASta_enum_ovrdval@ */ Scalar_UBYTE 0 SWC_INP_type_CM_uint8_enum 0.0 6.0 /end CHARACTERISTIC
/begin CHARACTERISTIC KINP_ADASLDWSta_enum_defval "" VALUE 0x0000 /* @ECU_Address@KINP_ADASLDWSta_enum_defval@ */ Scalar_UBYTE 0 SWC_INP_type_CM_uint8_enum 0.0 7.0 /end CHARACTERISTIC
/begin CHARACTERISTIC KINP_ADASLDWSta_enum_ovrdval "" VALUE 0x0000 /* @ECU_Address@KINP_ADASLDWSta_enum_ovrdval@ */ Scalar_UBYTE 0 SWC_INP_type_CM_uint8_enum 0.0 7.0 /end CHARACTERISTIC
/begin CHARACTERISTIC KINP_ADASLFCHandsOffWarning_enum_defval "" VALUE 0x0000 /* @ECU_Address@KINP_ADASLFCHandsOffWarning_enum_defval@ */ Scalar_UBYTE 0 SWC_INP_type_CM_uint8_enum 0.0 3.0 /end CHARACTERISTIC
/begin CHARACTERISTIC KINP_ADASLFCHandsOffWarning_enum_ovrdval "" VALUE 0x0000 /* @ECU_Address@KINP_ADASLFCHandsOffWarning_enum_ovrdval@ */ Scalar_UBYTE 0 SWC_INP_type_CM_uint8_enum 0.0 3.0 /end CHARACTERISTIC
/begin CHARACTERISTIC KINP_ADASLFCSta_enum_defval "" VALUE 0x0000 /* @ECU_Address@KINP_ADASLFCSta_enum_defval@ */ Scalar_UBYTE 0 SWC_INP_type_CM_uint8_enum 0.0 7.0 /end CHARACTERISTIC
/begin CHARACTERISTIC KINP_ADASLFCSta_enum_ovrdval "" VALUE 0x0000 /* @ECU_Address@KINP_ADASLFCSta_enum_ovrdval@ */ Scalar_UBYTE 0 SWC_INP_type_CM_uint8_enum 0.0 7.0 /end CHARACTERISTIC
/begin CHARACTERISTIC KINP_ADASLFCWarnSound_enum_defval "" VALUE 0x0000 /* @ECU_Address@KINP_ADASLFCWarnSound_enum_defval@ */ Scalar_UBYTE 0 SWC_INP_type_CM_uint8_enum 0.0 255.0 /end CHARACTERISTIC
/begin CHARACTERISTIC KINP_ADASLFCWarnSound_enum_ovrdval "" VALUE 0x0000 /* @ECU_Address@KINP_ADASLFCWarnSound_enum_ovrdval@ */ Scalar_UBYTE 0 SWC_INP_type_CM_uint8_enum 0.0 255.0 /end CHARACTERISTIC
/begin CHARACTERISTIC KINP_ADASLKASta_enum_defval "" VALUE 0x0000 /* @ECU_Address@KINP_ADASLKASta_enum_defval@ */ Scalar_UBYTE 0 SWC_INP_type_CM_uint8_enum 0.0 7.0 /end CHARACTERISTIC
/begin CHARACTERISTIC KINP_ADASLKASta_enum_ovrdval "" VALUE 0x0000 /* @ECU_Address@KINP_ADASLKASta_enum_ovrdval@ */ Scalar_UBYTE 0 SWC_INP_type_CM_uint8_enum 0.0 7.0 /end CHARACTERISTIC
/begin CHARACTERISTIC KINP_ADASLaneModeL_enum_defval "" VALUE 0x0000 /* @ECU_Address@KINP_ADASLaneModeL_enum_defval@ */ Scalar_UBYTE 0 SWC_INP_type_CM_uint8_enum 0.0 7.0 /end CHARACTERISTIC
/begin CHARACTERISTIC KINP_ADASLaneModeL_enum_ovrdval "" VALUE 0x0000 /* @ECU_Address@KINP_ADASLaneModeL_enum_ovrdval@ */ Scalar_UBYTE 0 SWC_INP_type_CM_uint8_enum 0.0 7.0 /end CHARACTERISTIC
/begin CHARACTERISTIC KINP_ADASLaneModeR_enum_defval "" VALUE 0x0000 /* @ECU_Address@KINP_ADASLaneModeR_enum_defval@ */ Scalar_UBYTE 0 SWC_INP_type_CM_uint8_enum 0.0 7.0 /end CHARACTERISTIC
/begin CHARACTERISTIC KINP_ADASLaneModeR_enum_ovrdval "" VALUE 0x0000 /* @ECU_Address@KINP_ADASLaneModeR_enum_ovrdval@ */ Scalar_UBYTE 0 SWC_INP_type_CM_uint8_enum 0.0 7.0 /end CHARACTERISTIC
/begin CHARACTERISTIC KINP_ADASLanetypeL_enum_defval "" VALUE 0x0000 /* @ECU_Address@KINP_ADASLanetypeL_enum_defval@ */ Scalar_UBYTE 0 SWC_INP_type_CM_uint8_enum 0.0 2.0 /end CHARACTERISTIC
/begin CHARACTERISTIC KINP_ADASLanetypeL_enum_ovrdval "" VALUE 0x0000 /* @ECU_Address@KINP_ADASLanetypeL_enum_ovrdval@ */ Scalar_UBYTE 0 SWC_INP_type_CM_uint8_enum 0.0 2.0 /end CHARACTERISTIC
/begin CHARACTERISTIC KINP_ADASLanetypeR_enum_defval "" VALUE 0x0000 /* @ECU_Address@KINP_ADASLanetypeR_enum_defval@ */ Scalar_UBYTE 0 SWC_INP_type_CM_uint8_enum 0.0 2.0 /end CHARACTERISTIC
/begin CHARACTERISTIC KINP_ADASLanetypeR_enum_ovrdval "" VALUE 0x0000 /* @ECU_Address@KINP_ADASLanetypeR_enum_ovrdval@ */ Scalar_UBYTE 0 SWC_INP_type_CM_uint8_enum 0.0 2.0 /end CHARACTERISTIC
/begin CHARACTERISTIC KINP_ADASSLIFSpdLim_enum_defval "" VALUE 0x0000 /* @ECU_Address@KINP_ADASSLIFSpdLim_enum_defval@ */ Scalar_UBYTE 0 SWC_INP_type_CM_uint8_enum 0.0 31.0 /end CHARACTERISTIC
/begin CHARACTERISTIC KINP_ADASSLIFSpdLim_enum_ovrdval "" VALUE 0x0000 /* @ECU_Address@KINP_ADASSLIFSpdLim_enum_ovrdval@ */ Scalar_UBYTE 0 SWC_INP_type_CM_uint8_enum 0.0 31.0 /end CHARACTERISTIC
/begin CHARACTERISTIC KINP_ADASSLIFSta_enum_defval "" VALUE 0x0000 /* @ECU_Address@KINP_ADASSLIFSta_enum_defval@ */ Scalar_UBYTE 0 SWC_INP_type_CM_uint8_enum 0.0 5.0 /end CHARACTERISTIC
/begin CHARACTERISTIC KINP_ADASSLIFSta_enum_ovrdval "" VALUE 0x0000 /* @ECU_Address@KINP_ADASSLIFSta_enum_ovrdval@ */ Scalar_UBYTE 0 SWC_INP_type_CM_uint8_enum 0.0 5.0 /end CHARACTERISTIC
/begin CHARACTERISTIC KINP_ADASShftPosnReq_enum_defval "" VALUE 0x0000 /* @ECU_Address@KINP_ADASShftPosnReq_enum_defval@ */ Scalar_UBYTE 0 SWC_INP_type_CM_uint8_enum 0.0 7.0 /end CHARACTERISTIC
/begin CHARACTERISTIC KINP_ADASShftPosnReq_enum_ovrdval "" VALUE 0x0000 /* @ECU_Address@KINP_ADASShftPosnReq_enum_ovrdval@ */ Scalar_UBYTE 0 SWC_INP_type_CM_uint8_enum 0.0 7.0 /end CHARACTERISTIC
/begin CHARACTERISTIC KINP_ADASVehSpdLim_enum_defval "" VALUE 0x0000 /* @ECU_Address@KINP_ADASVehSpdLim_enum_defval@ */ Scalar_UBYTE 0 SWC_INP_type_CM_uint8_enum 0.0 254.0 /end CHARACTERISTIC
/begin CHARACTERISTIC KINP_ADASVehSpdLim_enum_ovrdval "" VALUE 0x0000 /* @ECU_Address@KINP_ADASVehSpdLim_enum_ovrdval@ */ Scalar_UBYTE 0 SWC_INP_type_CM_uint8_enum 0.0 254.0 /end CHARACTERISTIC
/begin CHARACTERISTIC KINP_ADASWarningMsg_enum_defval "" VALUE 0x0000 /* @ECU_Address@KINP_ADASWarningMsg_enum_defval@ */ Scalar_UBYTE 0 SWC_INP_type_CM_uint8_enum 0.0 15.0 /end CHARACTERISTIC
/begin CHARACTERISTIC KINP_ADASWarningMsg_enum_ovrdval "" VALUE 0x0000 /* @ECU_Address@KINP_ADASWarningMsg_enum_ovrdval@ */ Scalar_UBYTE 0 SWC_INP_type_CM_uint8_enum 0.0 15.0 /end CHARACTERISTIC
/begin CHARACTERISTIC KINP_ADBVehDst1Val_enum_defval "" VALUE 0x0000 /* @ECU_Address@KINP_ADBVehDst1Val_enum_defval@ */ Scalar_UBYTE 0 SWC_INP_type_CM_uint8_enum 0.0 15.0 /end CHARACTERISTIC
/begin CHARACTERISTIC KINP_ADBVehDst1Val_enum_ovrdval "" VALUE 0x0000 /* @ECU_Address@KINP_ADBVehDst1Val_enum_ovrdval@ */ Scalar_UBYTE 0 SWC_INP_type_CM_uint8_enum 0.0 15.0 /end CHARACTERISTIC
/begin CHARACTERISTIC KINP_AGSActualPosition_enum_defval "" VALUE 0x0000 /* @ECU_Address@KINP_AGSActualPosition_enum_defval@ */ Scalar_UBYTE 0 SWC_INP_type_CM_uint8_enum 0.0 240.0 /end CHARACTERISTIC
/begin CHARACTERISTIC KINP_AGSActualPosition_enum_ovrdval "" VALUE 0x0000 /* @ECU_Address@KINP_AGSActualPosition_enum_ovrdval@ */ Scalar_UBYTE 0 SWC_INP_type_CM_uint8_enum 0.0 240.0 /end CHARACTERISTIC
/begin CHARACTERISTIC KINP_CSWFWasSwSta_enum_defval "" VALUE 0x0000 /* @ECU_Address@KINP_CSWFWasSwSta_enum_defval@ */ Scalar_UBYTE 0 SWC_INP_type_CM_uint8_enum 0.0 3.0 /end CHARACTERISTIC
/begin CHARACTERISTIC KINP_CSWFWasSwSta_enum_ovrdval "" VALUE 0x0000 /* @ECU_Address@KINP_CSWFWasSwSta_enum_ovrdval@ */ Scalar_UBYTE 0 SWC_INP_type_CM_uint8_enum 0.0 3.0 /end CHARACTERISTIC
/begin CHARACTERISTIC KINP_CSWFWipSwSta_enum_defval "" VALUE 0x0000 /* @ECU_Address@KINP_CSWFWipSwSta_enum_defval@ */ Scalar_UBYTE 0 SWC_INP_type_CM_uint8_enum 0.0 7.0 /end CHARACTERISTIC
/begin CHARACTERISTIC KINP_CSWFWipSwSta_enum_ovrdval "" VALUE 0x0000 /* @ECU_Address@KINP_CSWFWipSwSta_enum_ovrdval@ */ Scalar_UBYTE 0 SWC_INP_type_CM_uint8_enum 0.0 7.0 /end CHARACTERISTIC
/begin CHARACTERISTIC KINP_CSWRWasSWSta_enum_defval "" VALUE 0x0000 /* @ECU_Address@KINP_CSWRWasSWSta_enum_defval@ */ Scalar_UBYTE 0 SWC_INP_type_CM_uint8_enum 0.0 3.0 /end CHARACTERISTIC
/begin CHARACTERISTIC KINP_CSWRWasSWSta_enum_ovrdval "" VALUE 0x0000 /* @ECU_Address@KINP_CSWRWasSWSta_enum_ovrdval@ */ Scalar_UBYTE 0 SWC_INP_type_CM_uint8_enum 0.0 3.0 /end CHARACTERISTIC
/begin CHARACTERISTIC KINP_CSWRWipIntSwSta_enum_defval "" VALUE 0x0000 /* @ECU_Address@KINP_CSWRWipIntSwSta_enum_defval@ */ Scalar_UBYTE 0 SWC_INP_type_CM_uint8_enum 0.0 3.0 /end CHARACTERISTIC
/begin CHARACTERISTIC KINP_CSWRWipIntSwSta_enum_ovrdval "" VALUE 0x0000 /* @ECU_Address@KINP_CSWRWipIntSwSta_enum_ovrdval@ */ Scalar_UBYTE 0 SWC_INP_type_CM_uint8_enum 0.0 3.0 /end CHARACTERISTIC
/begin CHARACTERISTIC KINP_CSWTurnSwSta_enum_defval "" VALUE 0x0000 /* @ECU_Address@KINP_CSWTurnSwSta_enum_defval@ */ Scalar_UBYTE 0 SWC_INP_type_CM_uint8_enum 0.0 3.0 /end CHARACTERISTIC
/begin CHARACTERISTIC KINP_CSWTurnSwSta_enum_ovrdval "" VALUE 0x0000 /* @ECU_Address@KINP_CSWTurnSwSta_enum_ovrdval@ */ Scalar_UBYTE 0 SWC_INP_type_CM_uint8_enum 0.0 3.0 /end CHARACTERISTIC
/begin CHARACTERISTIC KINP_DSEATMode_enum_defval "" VALUE 0x0000 /* @ECU_Address@KINP_DSEATMode_enum_defval@ */ Scalar_UBYTE 0 SWC_INP_type_CM_uint8_enum 0.0 7.0 /end CHARACTERISTIC
/begin CHARACTERISTIC KINP_DSEATMode_enum_ovrdval "" VALUE 0x0000 /* @ECU_Address@KINP_DSEATMode_enum_ovrdval@ */ Scalar_UBYTE 0 SWC_INP_type_CM_uint8_enum 0.0 7.0 /end CHARACTERISTIC
/begin CHARACTERISTIC KINP_DSEATVentSta_enum_defval "" VALUE 0x0000 /* @ECU_Address@KINP_DSEATVentSta_enum_defval@ */ Scalar_UBYTE 0 SWC_INP_type_CM_uint8_enum 0.0 4.0 /end CHARACTERISTIC
/begin CHARACTERISTIC KINP_DSEATVentSta_enum_ovrdval "" VALUE 0x0000 /* @ECU_Address@KINP_DSEATVentSta_enum_ovrdval@ */ Scalar_UBYTE 0 SWC_INP_type_CM_uint8_enum 0.0 4.0 /end CHARACTERISTIC
/begin CHARACTERISTIC KINP_DSEATheatersta_enum_defval "" VALUE 0x0000 /* @ECU_Address@KINP_DSEATheatersta_enum_defval@ */ Scalar_UBYTE 0 SWC_INP_type_CM_uint8_enum 0.0 4.0 /end CHARACTERISTIC
/begin CHARACTERISTIC KINP_DSEATheatersta_enum_ovrdval "" VALUE 0x0000 /* @ECU_Address@KINP_DSEATheatersta_enum_ovrdval@ */ Scalar_UBYTE 0 SWC_INP_type_CM_uint8_enum 0.0 4.0 /end CHARACTERISTIC
/begin CHARACTERISTIC KINP_EWP1BlockError_enum_defval "" VALUE 0x0000 /* @ECU_Address@KINP_EWP1BlockError_enum_defval@ */ Scalar_UBYTE 0 SWC_INP_type_CM_uint8_enum 0.0 3.0 /end CHARACTERISTIC
/begin CHARACTERISTIC KINP_EWP1BlockError_enum_ovrdval "" VALUE 0x0000 /* @ECU_Address@KINP_EWP1BlockError_enum_ovrdval@ */ Scalar_UBYTE 0 SWC_INP_type_CM_uint8_enum 0.0 3.0 /end CHARACTERISTIC
/begin CHARACTERISTIC KINP_EWP1OverCurrError_enum_defval "" VALUE 0x0000 /* @ECU_Address@KINP_EWP1OverCurrError_enum_defval@ */ Scalar_UBYTE 0 SWC_INP_type_CM_uint8_enum 0.0 3.0 /end CHARACTERISTIC
/begin CHARACTERISTIC KINP_EWP1OverCurrError_enum_ovrdval "" VALUE 0x0000 /* @ECU_Address@KINP_EWP1OverCurrError_enum_ovrdval@ */ Scalar_UBYTE 0 SWC_INP_type_CM_uint8_enum 0.0 3.0 /end CHARACTERISTIC
/begin CHARACTERISTIC KINP_EWP2BlockError_enum_defval "" VALUE 0x0000 /* @ECU_Address@KINP_EWP2BlockError_enum_defval@ */ Scalar_UBYTE 0 SWC_INP_type_CM_uint8_enum 0.0 3.0 /end CHARACTERISTIC
/begin CHARACTERISTIC KINP_EWP2BlockError_enum_ovrdval "" VALUE 0x0000 /* @ECU_Address@KINP_EWP2BlockError_enum_ovrdval@ */ Scalar_UBYTE 0 SWC_INP_type_CM_uint8_enum 0.0 3.0 /end CHARACTERISTIC
/begin CHARACTERISTIC KINP_EWP2OverCurrError_enum_defval "" VALUE 0x0000 /* @ECU_Address@KINP_EWP2OverCurrError_enum_defval@ */ Scalar_UBYTE 0 SWC_INP_type_CM_uint8_enum 0.0 3.0 /end CHARACTERISTIC
/begin CHARACTERISTIC KINP_EWP2OverCurrError_enum_ovrdval "" VALUE 0x0000 /* @ECU_Address@KINP_EWP2OverCurrError_enum_ovrdval@ */ Scalar_UBYTE 0 SWC_INP_type_CM_uint8_enum 0.0 3.0 /end CHARACTERISTIC
/begin CHARACTERISTIC KINP_EWP3BlockError_enum_defval "" VALUE 0x0000 /* @ECU_Address@KINP_EWP3BlockError_enum_defval@ */ Scalar_UBYTE 0 SWC_INP_type_CM_uint8_enum 0.0 3.0 /end CHARACTERISTIC
/begin CHARACTERISTIC KINP_EWP3BlockError_enum_ovrdval "" VALUE 0x0000 /* @ECU_Address@KINP_EWP3BlockError_enum_ovrdval@ */ Scalar_UBYTE 0 SWC_INP_type_CM_uint8_enum 0.0 3.0 /end CHARACTERISTIC
/begin CHARACTERISTIC KINP_EWP3OverCurrError_enum_defval "" VALUE 0x0000 /* @ECU_Address@KINP_EWP3OverCurrError_enum_defval@ */ Scalar_UBYTE 0 SWC_INP_type_CM_uint8_enum 0.0 3.0 /end CHARACTERISTIC
/begin CHARACTERISTIC KINP_EWP3OverCurrError_enum_ovrdval "" VALUE 0x0000 /* @ECU_Address@KINP_EWP3OverCurrError_enum_ovrdval@ */ Scalar_UBYTE 0 SWC_INP_type_CM_uint8_enum 0.0 3.0 /end CHARACTERISTIC
/begin CHARACTERISTIC KINP_FCM1Checksum_enum_defval "" VALUE 0x0000 /* @ECU_Address@KINP_FCM1Checksum_enum_defval@ */ Scalar_UBYTE 0 SWC_INP_type_CM_uint8_enum 0.0 255.0 /end CHARACTERISTIC
/begin CHARACTERISTIC KINP_FCM1Checksum_enum_ovrdval "" VALUE 0x0000 /* @ECU_Address@KINP_FCM1Checksum_enum_ovrdval@ */ Scalar_UBYTE 0 SWC_INP_type_CM_uint8_enum 0.0 255.0 /end CHARACTERISTIC
/begin CHARACTERISTIC KINP_FCM1LifeCount_enum_defval "" VALUE 0x0000 /* @ECU_Address@KINP_FCM1LifeCount_enum_defval@ */ Scalar_UBYTE 0 SWC_INP_type_CM_uint8_enum 0.0 14.0 /end CHARACTERISTIC
/begin CHARACTERISTIC KINP_FCM1LifeCount_enum_ovrdval "" VALUE 0x0000 /* @ECU_Address@KINP_FCM1LifeCount_enum_ovrdval@ */ Scalar_UBYTE 0 SWC_INP_type_CM_uint8_enum 0.0 14.0 /end CHARACTERISTIC
/begin CHARACTERISTIC KINP_FCMACCmode_enum_defval "" VALUE 0x0000 /* @ECU_Address@KINP_FCMACCmode_enum_defval@ */ Scalar_UBYTE 0 SWC_INP_type_CM_uint8_enum 0.0 2.0 /end CHARACTERISTIC
/begin CHARACTERISTIC KINP_FCMACCmode_enum_ovrdval "" VALUE 0x0000 /* @ECU_Address@KINP_FCMACCmode_enum_ovrdval@ */ Scalar_UBYTE 0 SWC_INP_type_CM_uint8_enum 0.0 2.0 /end CHARACTERISTIC
/begin CHARACTERISTIC KINP_FCMLKATOIAct_enum_defval "" VALUE 0x0000 /* @ECU_Address@KINP_FCMLKATOIAct_enum_defval@ */ Scalar_UBYTE 0 SWC_INP_type_CM_uint8_enum 0.0 255.0 /end CHARACTERISTIC
/begin CHARACTERISTIC KINP_FCMLKATOIAct_enum_ovrdval "" VALUE 0x0000 /* @ECU_Address@KINP_FCMLKATOIAct_enum_ovrdval@ */ Scalar_UBYTE 0 SWC_INP_type_CM_uint8_enum 0.0 255.0 /end CHARACTERISTIC
/begin CHARACTERISTIC KINP_FGSIntenRspSta_enum_defval "" VALUE 0x0000 /* @ECU_Address@KINP_FGSIntenRspSta_enum_defval@ */ Scalar_UBYTE 0 SWC_INP_type_CM_uint8_enum 0.0 15.0 /end CHARACTERISTIC
/begin CHARACTERISTIC KINP_FGSIntenRspSta_enum_ovrdval "" VALUE 0x0000 /* @ECU_Address@KINP_FGSIntenRspSta_enum_ovrdval@ */ Scalar_UBYTE 0 SWC_INP_type_CM_uint8_enum 0.0 15.0 /end CHARACTERISTIC
/begin CHARACTERISTIC KINP_ForceLowBeam_enum_defval "" VALUE 0x0000 /* @ECU_Address@KINP_ForceLowBeam_enum_defval@ */ Scalar_UBYTE 0 SWC_INP_type_CM_uint8_enum 0.0 2.0 /end CHARACTERISTIC
/begin CHARACTERISTIC KINP_ForceLowBeam_enum_ovrdval "" VALUE 0x0000 /* @ECU_Address@KINP_ForceLowBeam_enum_ovrdval@ */ Scalar_UBYTE 0 SWC_INP_type_CM_uint8_enum 0.0 2.0 /end CHARACTERISTIC
/begin CHARACTERISTIC KINP_ISAWarningMsg_enum_defval "" VALUE 0x0000 /* @ECU_Address@KINP_ISAWarningMsg_enum_defval@ */ Scalar_UBYTE 0 SWC_INP_type_CM_uint8_enum 0.0 6.0 /end CHARACTERISTIC
/begin CHARACTERISTIC KINP_ISAWarningMsg_enum_ovrdval "" VALUE 0x0000 /* @ECU_Address@KINP_ISAWarningMsg_enum_ovrdval@ */ Scalar_UBYTE 0 SWC_INP_type_CM_uint8_enum 0.0 6.0 /end CHARACTERISTIC
/begin CHARACTERISTIC KINP_LDrvWdwPositionSts_enum_defval "" VALUE 0x0000 /* @ECU_Address@KINP_LDrvWdwPositionSts_enum_defval@ */ Scalar_UBYTE 0 SWC_INP_type_CM_uint8_enum 0.0 3.0 /end CHARACTERISTIC
/begin CHARACTERISTIC KINP_LDrvWdwPositionSts_enum_ovrdval "" VALUE 0x0000 /* @ECU_Address@KINP_LDrvWdwPositionSts_enum_ovrdval@ */ Scalar_UBYTE 0 SWC_INP_type_CM_uint8_enum 0.0 3.0 /end CHARACTERISTIC
/begin CHARACTERISTIC KINP_LPasWdwPositionSts_enum_defval "" VALUE 0x0000 /* @ECU_Address@KINP_LPasWdwPositionSts_enum_defval@ */ Scalar_UBYTE 0 SWC_INP_type_CM_uint8_enum 0.0 3.0 /end CHARACTERISTIC
/begin CHARACTERISTIC KINP_LPasWdwPositionSts_enum_ovrdval "" VALUE 0x0000 /* @ECU_Address@KINP_LPasWdwPositionSts_enum_ovrdval@ */ Scalar_UBYTE 0 SWC_INP_type_CM_uint8_enum 0.0 3.0 /end CHARACTERISTIC
/begin CHARACTERISTIC KINP_LRLDWdwPositionSts_enum_defval "" VALUE 0x0000 /* @ECU_Address@KINP_LRLDWdwPositionSts_enum_defval@ */ Scalar_UBYTE 0 SWC_INP_type_CM_uint8_enum 0.0 3.0 /end CHARACTERISTIC
/begin CHARACTERISTIC KINP_LRLDWdwPositionSts_enum_ovrdval "" VALUE 0x0000 /* @ECU_Address@KINP_LRLDWdwPositionSts_enum_ovrdval@ */ Scalar_UBYTE 0 SWC_INP_type_CM_uint8_enum 0.0 3.0 /end CHARACTERISTIC
/begin CHARACTERISTIC KINP_LRRDWdwPositionSts_enum_defval "" VALUE 0x0000 /* @ECU_Address@KINP_LRRDWdwPositionSts_enum_defval@ */ Scalar_UBYTE 0 SWC_INP_type_CM_uint8_enum 0.0 3.0 /end CHARACTERISTIC
/begin CHARACTERISTIC KINP_LRRDWdwPositionSts_enum_ovrdval "" VALUE 0x0000 /* @ECU_Address@KINP_LRRDWdwPositionSts_enum_ovrdval@ */ Scalar_UBYTE 0 SWC_INP_type_CM_uint8_enum 0.0 3.0 /end CHARACTERISTIC
/begin CHARACTERISTIC KINP_LVDAMuteSta_enum_defval "" VALUE 0x0000 /* @ECU_Address@KINP_LVDAMuteSta_enum_defval@ */ Scalar_UBYTE 0 SWC_INP_type_CM_uint8_enum 0.0 3.0 /end CHARACTERISTIC
/begin CHARACTERISTIC KINP_LVDAMuteSta_enum_ovrdval "" VALUE 0x0000 /* @ECU_Address@KINP_LVDAMuteSta_enum_ovrdval@ */ Scalar_UBYTE 0 SWC_INP_type_CM_uint8_enum 0.0 3.0 /end CHARACTERISTIC
/begin CHARACTERISTIC KINP_PSEATMode_enum_defval "" VALUE 0x0000 /* @ECU_Address@KINP_PSEATMode_enum_defval@ */ Scalar_UBYTE 0 SWC_INP_type_CM_uint8_enum 0.0 7.0 /end CHARACTERISTIC
/begin CHARACTERISTIC KINP_PSEATMode_enum_ovrdval "" VALUE 0x0000 /* @ECU_Address@KINP_PSEATMode_enum_ovrdval@ */ Scalar_UBYTE 0 SWC_INP_type_CM_uint8_enum 0.0 7.0 /end CHARACTERISTIC
/begin CHARACTERISTIC KINP_PSEATVentSta_enum_defval "" VALUE 0x0000 /* @ECU_Address@KINP_PSEATVentSta_enum_defval@ */ Scalar_UBYTE 0 SWC_INP_type_CM_uint8_enum 0.0 4.0 /end CHARACTERISTIC
/begin CHARACTERISTIC KINP_PSEATVentSta_enum_ovrdval "" VALUE 0x0000 /* @ECU_Address@KINP_PSEATVentSta_enum_ovrdval@ */ Scalar_UBYTE 0 SWC_INP_type_CM_uint8_enum 0.0 4.0 /end CHARACTERISTIC
/begin CHARACTERISTIC KINP_PSEATheatersta_enum_defval "" VALUE 0x0000 /* @ECU_Address@KINP_PSEATheatersta_enum_defval@ */ Scalar_UBYTE 0 SWC_INP_type_CM_uint8_enum 0.0 4.0 /end CHARACTERISTIC
/begin CHARACTERISTIC KINP_PSEATheatersta_enum_ovrdval "" VALUE 0x0000 /* @ECU_Address@KINP_PSEATheatersta_enum_ovrdval@ */ Scalar_UBYTE 0 SWC_INP_type_CM_uint8_enum 0.0 4.0 /end CHARACTERISTIC
/begin CHARACTERISTIC KINP_RLSRainSnrWiperCmd_enum_defval "" VALUE 0x0000 /* @ECU_Address@KINP_RLSRainSnrWiperCmd_enum_defval@ */ Scalar_UBYTE 0 SWC_INP_type_CM_uint8_enum 0.0 7.0 /end CHARACTERISTIC
/begin CHARACTERISTIC KINP_RLSRainSnrWiperCmd_enum_ovrdval "" VALUE 0x0000 /* @ECU_Address@KINP_RLSRainSnrWiperCmd_enum_ovrdval@ */ Scalar_UBYTE 0 SWC_INP_type_CM_uint8_enum 0.0 7.0 /end CHARACTERISTIC
/begin CHARACTERISTIC KINP_SRRBSDWarnL_enum_defval "" VALUE 0x0000 /* @ECU_Address@KINP_SRRBSDWarnL_enum_defval@ */ Scalar_UBYTE 0 SWC_INP_type_CM_uint8_enum 0.0 3.0 /end CHARACTERISTIC
/begin CHARACTERISTIC KINP_SRRBSDWarnL_enum_ovrdval "" VALUE 0x0000 /* @ECU_Address@KINP_SRRBSDWarnL_enum_ovrdval@ */ Scalar_UBYTE 0 SWC_INP_type_CM_uint8_enum 0.0 3.0 /end CHARACTERISTIC
/begin CHARACTERISTIC KINP_SRRBSDWarnR_enum_defval "" VALUE 0x0000 /* @ECU_Address@KINP_SRRBSDWarnR_enum_defval@ */ Scalar_UBYTE 0 SWC_INP_type_CM_uint8_enum 0.0 3.0 /end CHARACTERISTIC
/begin CHARACTERISTIC KINP_SRRBSDWarnR_enum_ovrdval "" VALUE 0x0000 /* @ECU_Address@KINP_SRRBSDWarnR_enum_ovrdval@ */ Scalar_UBYTE 0 SWC_INP_type_CM_uint8_enum 0.0 3.0 /end CHARACTERISTIC
/begin CHARACTERISTIC KINP_SRRODAWarnL_enum_defval "" VALUE 0x0000 /* @ECU_Address@KINP_SRRODAWarnL_enum_defval@ */ Scalar_UBYTE 0 SWC_INP_type_CM_uint8_enum 0.0 3.0 /end CHARACTERISTIC
/begin CHARACTERISTIC KINP_SRRODAWarnL_enum_ovrdval "" VALUE 0x0000 /* @ECU_Address@KINP_SRRODAWarnL_enum_ovrdval@ */ Scalar_UBYTE 0 SWC_INP_type_CM_uint8_enum 0.0 3.0 /end CHARACTERISTIC
/begin CHARACTERISTIC KINP_SRRODAWarnR_enum_defval "" VALUE 0x0000 /* @ECU_Address@KINP_SRRODAWarnR_enum_defval@ */ Scalar_UBYTE 0 SWC_INP_type_CM_uint8_enum 0.0 3.0 /end CHARACTERISTIC
/begin CHARACTERISTIC KINP_SRRODAWarnR_enum_ovrdval "" VALUE 0x0000 /* @ECU_Address@KINP_SRRODAWarnR_enum_ovrdval@ */ Scalar_UBYTE 0 SWC_INP_type_CM_uint8_enum 0.0 3.0 /end CHARACTERISTIC
/begin CHARACTERISTIC KINP_TargetType_enum_defval "" VALUE 0x0000 /* @ECU_Address@KINP_TargetType_enum_defval@ */ Scalar_UBYTE 0 SWC_INP_type_CM_uint8_enum 0.0 15.0 /end CHARACTERISTIC
/begin CHARACTERISTIC KINP_TargetType_enum_ovrdval "" VALUE 0x0000 /* @ECU_Address@KINP_TargetType_enum_ovrdval@ */ Scalar_UBYTE 0 SWC_INP_type_CM_uint8_enum 0.0 15.0 /end CHARACTERISTIC
/begin CHARACTERISTIC KINP_TimeGapLevel_enum_defval "" VALUE 0x0000 /* @ECU_Address@KINP_TimeGapLevel_enum_defval@ */ Scalar_UBYTE 0 SWC_INP_type_CM_uint8_enum 0.0 7.0 /end CHARACTERISTIC
/begin CHARACTERISTIC KINP_TimeGapLevel_enum_ovrdval "" VALUE 0x0000 /* @ECU_Address@KINP_TimeGapLevel_enum_ovrdval@ */ Scalar_UBYTE 0 SWC_INP_type_CM_uint8_enum 0.0 7.0 /end CHARACTERISTIC
/begin MEASUREMENT VINP_AccelPedal1VolShortHigh_enum "" UBYTE SWC_INP_type_CM_uint8_enum 0 0 0.0 255.0 ECU_ADDRESS 0x0000 /* @ECU_Address@VINP_AccelPedal1VolShortHigh_enum@ */ /end MEASUREMENT
/begin MEASUREMENT VINP_AccelPedal1VolShortLow_enum "" UBYTE SWC_INP_type_CM_uint8_enum 0 0 0.0 255.0 ECU_ADDRESS 0x0000 /* @ECU_Address@VINP_AccelPedal1VolShortLow_enum@ */ /end MEASUREMENT
/begin MEASUREMENT VINP_AccelPedal2VolShortHigh_enum "" UBYTE SWC_INP_type_CM_uint8_enum 0 0 0.0 255.0 ECU_ADDRESS 0x0000 /* @ECU_Address@VINP_AccelPedal2VolShortHigh_enum@ */ /end MEASUREMENT
/begin MEASUREMENT VINP_AccelPedal2VolShortLow_enum "" UBYTE SWC_INP_type_CM_uint8_enum 0 0 0.0 255.0 ECU_ADDRESS 0x0000 /* @ECU_Address@VINP_AccelPedal2VolShortLow_enum@ */ /end MEASUREMENT
/begin COMPU_METHOD SWC_INP_type_CM_single_mps2 "Q = V" RAT_FUNC "%8.6" "mps2" COEFFS 0 1 0 0 0 1 /end COMPU_METHOD
/begin COMPU_METHOD SWC_INP_type_CM_single_mps3 "Q = V" RAT_FUNC "%8.6" "mps3" COEFFS 0 1 0 0 0 1 /end COMPU_METHOD
/begin COMPU_METHOD SWC_INP_type_CM_single_m "Q = V" RAT_FUNC "%8.6" "m" COEFFS 0 1 0 0 0 1 /end COMPU_METHOD
/begin COMPU_METHOD SWC_INP_type_CM_single_mps "Q = V" RAT_FUNC "%8.6" "mps" COEFFS 0 1 0 0 0 1 /end COMPU_METHOD
/begin COMPU_METHOD SWC_INP_type_CM_single_A "Q = V" RAT_FUNC "%8.6" "A" COEFFS 0 1 0 0 0 1 /end COMPU_METHOD
/begin COMPU_METHOD SWC_INP_type_CM_single_pct "Q = V" RAT_FUNC "%8.6" "pct" COEFFS 0 1 0 0 0 1 /end COMPU_METHOD
/begin COMPU_METHOD SWC_INP_type_CM_single_Deg "Q = V" RAT_FUNC "%8.6" "Deg" COEFFS 0 1 0 0 0 1 /end COMPU_METHOD
/begin COMPU_METHOD SWC_INP_type_CM_single_raw32 "Q = V" RAT_FUNC "%8.6" "raw32" COEFFS 0 1 0 0 0 1 /end COMPU_METHOD
/begin COMPU_METHOD SWC_INP_type_CM_single_Nm "Q = V" RAT_FUNC "%8.6" "Nm" COEFFS 0 1 0 0 0 1 /end COMPU_METHOD
/begin COMPU_METHOD SWC_INP_type_CM_single_V "Q = V" RAT_FUNC "%8.6" "V" COEFFS 0 1 0 0 0 1 /end COMPU_METHOD
/begin COMPU_METHOD SWC_INP_type_CM_single_W "Q = V" RAT_FUNC "%8.6" "W" COEFFS 0 1 0 0 0 1 /end COMPU_METHOD
/begin COMPU_METHOD SWC_INP_type_CM_single_rpm "Q = V" RAT_FUNC "%8.6" "rpm" COEFFS 0 1 0 0 0 1 /end COMPU_METHOD
/begin COMPU_METHOD SWC_INP_type_CM_single_s "Q = V" RAT_FUNC "%8.6" "s" COEFFS 0 1 0 0 0 1 /end COMPU_METHOD
/begin COMPU_METHOD SWC_INP_type_CM_single_kW "Q = V" RAT_FUNC "%8.6" "kW" COEFFS 0 1 0 0 0 1 /end COMPU_METHOD
/begin COMPU_METHOD SWC_INP_type_CM_single_DAY "Q = V" RAT_FUNC "%8.6" "DAY" COEFFS 0 1 0 0 0 1 /end COMPU_METHOD
/begin COMPU_METHOD SWC_INP_type_CM_single_hr "Q = V" RAT_FUNC "%8.6" "hr" COEFFS 0 1 0 0 0 1 /end COMPU_METHOD
/begin COMPU_METHOD SWC_INP_type_CM_single_min "Q = V" RAT_FUNC "%8.6" "min" COEFFS 0 1 0 0 0 1 /end COMPU_METHOD
/begin COMPU_METHOD SWC_INP_type_CM_single_MONTH "Q = V" RAT_FUNC "%8.6" "MONTH" COEFFS 0 1 0 0 0 1 /end COMPU_METHOD
/begin COMPU_METHOD SWC_INP_type_CM_single_YEAR "Q = V" RAT_FUNC "%8.6" "YEAR" COEFFS 0 1 0 0 0 1 /end COMPU_METHOD
/begin COMPU_METHOD SWC_INP_type_CM_single_radians "Q = V" RAT_FUNC "%8.6" "radians" COEFFS 0 1 0 0 0 1 /end COMPU_METHOD
/begin COMPU_METHOD SWC_INP_type_CM_uint32_enum "Q = V" RAT_FUNC "%10.0" "enum" COEFFS 0 1 0 0 0 1 /end COMPU_METHOD
/begin COMPU_METHOD SWC_INP_type_CM_uint16_enum "Q = V" RAT_FUNC "%5.0" "enum" COEFFS 0 1 0 0 0 1 /end COMPU_METHOD
/begin COMPU_METHOD SWC_INP_type_CM_boolean_flg "Q = V" RAT_FUNC "%1.0" "flg" COEFFS 0 1 0 0 0 1 /end COMPU_METHOD
/begin COMPU_METHOD SWC_INP_type_CM_uint8_enum "Q = V" RAT_FUNC "%3.0" "enum" COEFFS 0 1 0 0 0 1 /end COMPU_METHOD
/begin GROUP S3311_FrntPTCLeActHeatPwr "SWC_INP_type/run_SWC_INP_5ms_sys/INP/CAN4/SignalCheck/zGW_APTC1/FrntPTCLeActHeatPwr"
 /begin REF_CHARACTERISTIC KINP_FrntPTCLeActHeatPwr_W_defval KINP_FrntPTCLeActHeatPwr_W_ovrdflg KINP_FrntPTCLeActHeatPwr_W_ovrdval /end REF_CHARACTERISTIC
/end GROUP
/begin GROUP S3311_FrntPTCRearLeActHeatPwr "SWC_INP_type/run_SWC_INP_5ms_sys/INP/CAN4/SignalCheck/zGW_APTC1/FrntPTCRearLeActHeatPwr"
 /begin REF_CHARACTERISTIC KINP_FrntPTCRearLeActHeatPwr_W_defval KINP_FrntPTCRearLeActHeatPwr_W_ovrdflg KINP_FrntPTCRearLeActHeatPwr_W_ovrdval /end REF_CHARACTERISTIC
/end GROUP
/begin GROUP S3311_FrntPTCRearRiActHeatPwr "SWC_INP_type/run_SWC_INP_5ms_sys/INP/CAN4/SignalCheck/zGW_APTC1/FrntPTCRearRiActHeatPwr"
 /begin REF_CHARACTERISTIC KINP_FrntPTCRearRiActHeatPwr_W_defval KINP_FrntPTCRearRiActHeatPwr_W_ovrdflg KINP_FrntPTCRearRiActHeatPwr_W_ovrdval /end REF_CHARACTERISTIC
/end GROUP
/begin GROUP S3311_FrntPTCRiActHeatPwr "SWC_INP_type/run_SWC_INP_5ms_sys/INP/CAN4/SignalCheck/zGW_APTC1/FrntPTCRiActHeatPwr"
 /begin REF_CHARACTERISTIC KINP_FrntPTCRiActHeatPwr_W_defval KINP_FrntPTCRiActHeatPwr_W_ovrdflg KINP_FrntPTCRiActHeatPwr_W_ovrdval /end REF_CHARACTERISTIC
/end GROUP
/begin GROUP S3312_COMPActualPwr "SWC_INP_type/run_SWC_INP_5ms_sys/INP/CAN4/SignalCheck/zGW_CANFr1/COMPActualPwr"
 /begin REF_CHARACTERISTIC KINP_COMPActualPwr_W_defval KINP_COMPActualPwr_W_ovrdflg KINP_COMPActualPwr_W_ovrdval /end REF_CHARACTERISTIC
/end GROUP
/begin GROUP S3312_COMPConCur "SWC_INP_type/run_SWC_INP_5ms_sys/INP/CAN4/SignalCheck/zGW_CANFr1/COMPConCur"
 /begin REF_CHARACTERISTIC KINP_COMPConCur_A_defval KINP_COMPConCur_A_ovrdflg KINP_COMPConCur_A_ovrdval /end REF_CHARACTERISTIC
/end GROUP
/begin GROUP S3312_COMPConVolt "SWC_INP_type/run_SWC_INP_5ms_sys/INP/CAN4/SignalCheck/zGW_CANFr1/COMPConVolt"
 /begin REF_CHARACTERISTIC KINP_COMPConVolt_V_defval KINP_COMPConVolt_V_ovrdflg KINP_COMPConVolt_V_ovrdval /end REF_CHARACTERISTIC
/end GROUP
/begin GROUP S3312_COMPStatorSpd "SWC_INP_type/run_SWC_INP_5ms_sys/INP/CAN4/SignalCheck/zGW_CANFr1/COMPStatorSpd"
 /begin REF_CHARACTERISTIC KINP_COMPStatorSpd_rpm_defval KINP_COMPStatorSpd_rpm_ovrdflg KINP_COMPStatorSpd_rpm_ovrdval /end REF_CHARACTERISTIC
/end GROUP
/begin GROUP S3312_PTC1PowerConsumption "SWC_INP_type/run_SWC_INP_5ms_sys/INP/CAN4/SignalCheck/zGW_CANFr1/PTC1PowerConsumption"
 /begin REF_CHARACTERISTIC KINP_PTC1PowerConsumption_kW_defval KINP_PTC1PowerConsumption_kW_ovrdflg KINP_PTC1PowerConsumption_kW_ovrdval /end REF_CHARACTERISTIC
/end GROUP
/begin GROUP S3313_CSWDimSw "SWC_INP_type/run_SWC_INP_5ms_sys/INP/CAN4/SignalCheck/zGW_LINDr1/CSWDimSw"
 /begin REF_CHARACTERISTIC KINP_CSWDimSw_flg_defval KINP_CSWDimSw_flg_ovrdflg KINP_CSWDimSw_flg_ovrdval /end REF_CHARACTERISTIC
/end GROUP
/begin GROUP S3313_CSWFWasSwSta "SWC_INP_type/run_SWC_INP_5ms_sys/INP/CAN4/SignalCheck/zGW_LINDr1/CSWFWasSwSta"
 /begin REF_CHARACTERISTIC KINP_CSWFWasSwSta_enum_defval KINP_CSWFWasSwSta_enum_ovrdflg KINP_CSWFWasSwSta_enum_ovrdval /end REF_CHARACTERISTIC
/end GROUP
/begin GROUP S3313_CSWFWipSwSta "SWC_INP_type/run_SWC_INP_5ms_sys/INP/CAN4/SignalCheck/zGW_LINDr1/CSWFWipSwSta"
 /begin REF_CHARACTERISTIC KINP_CSWFWipSwSta_enum_defval KINP_CSWFWipSwSta_enum_ovrdflg KINP_CSWFWipSwSta_enum_ovrdval /end REF_CHARACTERISTIC
/end GROUP
/begin GROUP S3313_CSWPassSWSta "SWC_INP_type/run_SWC_INP_5ms_sys/INP/CAN4/SignalCheck/zGW_LINDr1/CSWPassSWSta"
 /begin REF_CHARACTERISTIC KINP_CSWPassSWSta_flg_defval KINP_CSWPassSWSta_flg_ovrdflg KINP_CSWPassSWSta_flg_ovrdval /end REF_CHARACTERISTIC
/end GROUP
/begin GROUP S3313_CSWRWasSWSta "SWC_INP_type/run_SWC_INP_5ms_sys/INP/CAN4/SignalCheck/zGW_LINDr1/CSWRWasSWSta"
 /begin REF_CHARACTERISTIC KINP_CSWRWasSWSta_enum_defval KINP_CSWRWasSWSta_enum_ovrdflg KINP_CSWRWasSWSta_enum_ovrdval /end REF_CHARACTERISTIC
/end GROUP
/begin GROUP S3313_CSWRWipIntSwSta "SWC_INP_type/run_SWC_INP_5ms_sys/INP/CAN4/SignalCheck/zGW_LINDr1/CSWRWipIntSwSta"
 /begin REF_CHARACTERISTIC KINP_CSWRWipIntSwSta_enum_defval KINP_CSWRWipIntSwSta_enum_ovrdflg KINP_CSWRWipIntSwSta_enum_ovrdval /end REF_CHARACTERISTIC
/end GROUP
/begin GROUP S3313_CSWTurnSwSta "SWC_INP_type/run_SWC_INP_5ms_sys/INP/CAN4/SignalCheck/zGW_LINDr1/CSWTurnSwSta"
 /begin REF_CHARACTERISTIC KINP_CSWTurnSwSta_enum_defval KINP_CSWTurnSwSta_enum_ovrdflg KINP_CSWTurnSwSta_enum_ovrdval /end REF_CHARACTERISTIC
/end GROUP
/begin GROUP S3313_FAPWL01LINResponseError "SWC_INP_type/run_SWC_INP_5ms_sys/INP/CAN4/SignalCheck/zGW_LINDr1/FAPWL01LINResponseError"
 /begin REF_CHARACTERISTIC KINP_FAPWL01LINResponseError_flg_defval KINP_FAPWL01LINResponseError_flg_ovrdflg KINP_FAPWL01LINResponseError_flg_ovrdval /end REF_CHARACTERISTIC
/end GROUP
/begin GROUP S3313_LDrvMotorRelayError "SWC_INP_type/run_SWC_INP_5ms_sys/INP/CAN4/SignalCheck/zGW_LINDr1/LDrvMotorRelayError"
 /begin REF_CHARACTERISTIC KINP_LDrvMotorRelayError_flg_defval KINP_LDrvMotorRelayError_flg_ovrdflg KINP_LDrvMotorRelayError_flg_ovrdval /end REF_CHARACTERISTIC
/end GROUP
/begin GROUP S3313_LDrvMotorRippleError "SWC_INP_type/run_SWC_INP_5ms_sys/INP/CAN4/SignalCheck/zGW_LINDr1/LDrvMotorRippleError"
 /begin REF_CHARACTERISTIC KINP_LDrvMotorRippleError_flg_defval KINP_LDrvMotorRippleError_flg_ovrdflg KINP_LDrvMotorRippleError_flg_ovrdval /end REF_CHARACTERISTIC
/end GROUP
/begin GROUP S3313_LDrvValWdwOpened "SWC_INP_type/run_SWC_INP_5ms_sys/INP/CAN4/SignalCheck/zGW_LINDr1/LDrvValWdwOpened"
 /begin REF_CHARACTERISTIC KINP_LDrvValWdwOpened_pct_defval KINP_LDrvValWdwOpened_pct_ovrdflg KINP_LDrvValWdwOpened_pct_ovrdval /end REF_CHARACTERISTIC
/end GROUP
/begin GROUP S3313_LDrvWdwPositionSts "SWC_INP_type/run_SWC_INP_5ms_sys/INP/CAN4/SignalCheck/zGW_LINDr1/LDrvWdwPositionSts"
 /begin REF_CHARACTERISTIC KINP_LDrvWdwPositionSts_enum_defval KINP_LDrvWdwPositionSts_enum_ovrdflg KINP_LDrvWdwPositionSts_enum_ovrdval /end REF_CHARACTERISTIC
/end GROUP
/begin GROUP S3313_LPasMotorRelayError "SWC_INP_type/run_SWC_INP_5ms_sys/INP/CAN4/SignalCheck/zGW_LINDr1/LPasMotorRelayError"
 /begin REF_CHARACTERISTIC KINP_LPasMotorRelayError_flg_defval KINP_LPasMotorRelayError_flg_ovrdflg KINP_LPasMotorRelayError_flg_ovrdval /end REF_CHARACTERISTIC
/end GROUP
/begin GROUP S3313_LPasMotorRippleError "SWC_INP_type/run_SWC_INP_5ms_sys/INP/CAN4/SignalCheck/zGW_LINDr1/LPasMotorRippleError"
 /begin REF_CHARACTERISTIC KINP_LPasMotorRippleError_flg_defval KINP_LPasMotorRippleError_flg_ovrdflg KINP_LPasMotorRippleError_flg_ovrdval /end REF_CHARACTERISTIC
/end GROUP
/begin GROUP S3313_LPasValWdwOpened "SWC_INP_type/run_SWC_INP_5ms_sys/INP/CAN4/SignalCheck/zGW_LINDr1/LPasValWdwOpened"
 /begin REF_CHARACTERISTIC KINP_LPasValWdwOpened_pct_defval KINP_LPasValWdwOpened_pct_ovrdflg KINP_LPasValWdwOpened_pct_ovrdval /end REF_CHARACTERISTIC
/end GROUP
/begin GROUP S3313_LPasWdwPositionSts "SWC_INP_type/run_SWC_INP_5ms_sys/INP/CAN4/SignalCheck/zGW_LINDr1/LPasWdwPositionSts"
 /begin REF_CHARACTERISTIC KINP_LPasWdwPositionSts_enum_defval KINP_LPasWdwPositionSts_enum_ovrdflg KINP_LPasWdwPositionSts_enum_ovrdval /end REF_CHARACTERISTIC
/end GROUP
/begin GROUP S3313_LRLDMotorRelayError "SWC_INP_type/run_SWC_INP_5ms_sys/INP/CAN4/SignalCheck/zGW_LINDr1/LRLDMotorRelayError"
 /begin REF_CHARACTERISTIC KINP_LRLDMotorRelayError_flg_defval KINP_LRLDMotorRelayError_flg_ovrdflg KINP_LRLDMotorRelayError_flg_ovrdval /end REF_CHARACTERISTIC
/end GROUP
/begin GROUP S3313_LRLDMotorRippleError "SWC_INP_type/run_SWC_INP_5ms_sys/INP/CAN4/SignalCheck/zGW_LINDr1/LRLDMotorRippleError"
 /begin REF_CHARACTERISTIC KINP_LRLDMotorRippleError_flg_defval KINP_LRLDMotorRippleError_flg_ovrdflg KINP_LRLDMotorRippleError_flg_ovrdval /end REF_CHARACTERISTIC
/end GROUP
/begin GROUP S3313_LRLDValWdwOpened "SWC_INP_type/run_SWC_INP_5ms_sys/INP/CAN4/SignalCheck/zGW_LINDr1/LRLDValWdwOpened"
 /begin REF_CHARACTERISTIC KINP_LRLDValWdwOpened_pct_defval KINP_LRLDValWdwOpened_pct_ovrdflg KINP_LRLDValWdwOpened_pct_ovrdval /end REF_CHARACTERISTIC
/end GROUP
/begin GROUP S3313_LRLDWdwPositionSts "SWC_INP_type/run_SWC_INP_5ms_sys/INP/CAN4/SignalCheck/zGW_LINDr1/LRLDWdwPositionSts"
 /begin REF_CHARACTERISTIC KINP_LRLDWdwPositionSts_enum_defval KINP_LRLDWdwPositionSts_enum_ovrdflg KINP_LRLDWdwPositionSts_enum_ovrdval /end REF_CHARACTERISTIC
/end GROUP
/begin GROUP S3313_LRRDMotorRelayError "SWC_INP_type/run_SWC_INP_5ms_sys/INP/CAN4/SignalCheck/zGW_LINDr1/LRRDMotorRelayError"
 /begin REF_CHARACTERISTIC KINP_LRRDMotorRelayError_flg_defval KINP_LRRDMotorRelayError_flg_ovrdflg KINP_LRRDMotorRelayError_flg_ovrdval /end REF_CHARACTERISTIC
/end GROUP
/begin GROUP S3313_LRRDMotorRippleError "SWC_INP_type/run_SWC_INP_5ms_sys/INP/CAN4/SignalCheck/zGW_LINDr1/LRRDMotorRippleError"
 /begin REF_CHARACTERISTIC KINP_LRRDMotorRippleError_flg_defval KINP_LRRDMotorRippleError_flg_ovrdflg KINP_LRRDMotorRippleError_flg_ovrdval /end REF_CHARACTERISTIC
/end GROUP
/begin GROUP S3313_LRRDValWdwOpened "SWC_INP_type/run_SWC_INP_5ms_sys/INP/CAN4/SignalCheck/zGW_LINDr1/LRRDValWdwOpened"
 /begin REF_CHARACTERISTIC KINP_LRRDValWdwOpened_pct_defval KINP_LRRDValWdwOpened_pct_ovrdflg KINP_LRRDValWdwOpened_pct_ovrdval /end REF_CHARACTERISTIC
/end GROUP
/begin GROUP S3313_LRRDWdwPositionSts "SWC_INP_type/run_SWC_INP_5ms_sys/INP/CAN4/SignalCheck/zGW_LINDr1/LRRDWdwPositionSts"
 /begin REF_CHARACTERISTIC KINP_LRRDWdwPositionSts_enum_defval KINP_LRRDWdwPositionSts_enum_ovrdflg KINP_LRRDWdwPositionSts_enum_ovrdval /end REF_CHARACTERISTIC
/end GROUP
/begin GROUP S3313_RAPWL01LINResponseError "SWC_INP_type/run_SWC_INP_5ms_sys/INP/CAN4/SignalCheck/zGW_LINDr1/RAPWL01LINResponseError"
 /begin REF_CHARACTERISTIC KINP_RAPWL01LINResponseError_flg_defval KINP_RAPWL01LINResponseError_flg_ovrdflg KINP_RAPWL01LINResponseError_flg_ovrdval /end REF_CHARACTERISTIC
/end GROUP
/begin GROUP S3313_RLSLampSta "SWC_INP_type/run_SWC_INP_5ms_sys/INP/CAN4/SignalCheck/zGW_LINDr1/RLSLampSta"
 /begin REF_CHARACTERISTIC KINP_RLSLampSta_flg_defval KINP_RLSLampSta_flg_ovrdflg KINP_RLSLampSta_flg_ovrdval /end REF_CHARACTERISTIC
/end GROUP
/begin GROUP S3313_RLSRainSnrWiperCmd "SWC_INP_type/run_SWC_INP_5ms_sys/INP/CAN4/SignalCheck/zGW_LINDr1/RLSRainSnrWiperCmd"
 /begin REF_CHARACTERISTIC KINP_RLSRainSnrWiperCmd_enum_defval KINP_RLSRainSnrWiperCmd_enum_ovrdflg KINP_RLSRainSnrWiperCmd_enum_ovrdval /end REF_CHARACTERISTIC
/end GROUP
/begin GROUP S3313_SWC2LADASSta "SWC_INP_type/run_SWC_INP_5ms_sys/INP/CAN4/SignalCheck/zGW_LINDr1/SWC2LADASSta"
 /begin REF_CHARACTERISTIC KINP_SWC2LADASSta_flg_defval KINP_SWC2LADASSta_flg_ovrdflg KINP_SWC2LADASSta_flg_ovrdval /end REF_CHARACTERISTIC
/end GROUP
/begin GROUP S3313_SWC2LDriveModeSta "SWC_INP_type/run_SWC_INP_5ms_sys/INP/CAN4/SignalCheck/zGW_LINDr1/SWC2LDriveModeSta"
 /begin REF_CHARACTERISTIC KINP_SWC2LDriveModeSta_flg_defval KINP_SWC2LDriveModeSta_flg_ovrdflg KINP_SWC2LDriveModeSta_flg_ovrdval /end REF_CHARACTERISTIC
/end GROUP
/begin GROUP S3313_SWC2LHomeSta "SWC_INP_type/run_SWC_INP_5ms_sys/INP/CAN4/SignalCheck/zGW_LINDr1/SWC2LHomeSta"
 /begin REF_CHARACTERISTIC KINP_SWC2LHomeSta_flg_defval KINP_SWC2LHomeSta_flg_ovrdflg KINP_SWC2LHomeSta_flg_ovrdval /end REF_CHARACTERISTIC
/end GROUP
/begin GROUP S3313_SWC2LLeftSta "SWC_INP_type/run_SWC_INP_5ms_sys/INP/CAN4/SignalCheck/zGW_LINDr1/SWC2LLeftSta"
 /begin REF_CHARACTERISTIC KINP_SWC2LLeftSta_flg_defval KINP_SWC2LLeftSta_flg_ovrdflg KINP_SWC2LLeftSta_flg_ovrdval /end REF_CHARACTERISTIC
/end GROUP
/begin GROUP S3313_SWC2LRegenUpSta "SWC_INP_type/run_SWC_INP_5ms_sys/INP/CAN4/SignalCheck/zGW_LINDr1/SWC2LRegenUpSta"
 /begin REF_CHARACTERISTIC KINP_SWC2LRegenUpSta_flg_defval KINP_SWC2LRegenUpSta_flg_ovrdflg KINP_SWC2LRegenUpSta_flg_ovrdval /end REF_CHARACTERISTIC
/end GROUP
/begin GROUP S3313_SWC2LRightSta "SWC_INP_type/run_SWC_INP_5ms_sys/INP/CAN4/SignalCheck/zGW_LINDr1/SWC2LRightSta"
 /begin REF_CHARACTERISTIC KINP_SWC2LRightSta_flg_defval KINP_SWC2LRightSta_flg_ovrdflg KINP_SWC2LRightSta_flg_ovrdval /end REF_CHARACTERISTIC
/end GROUP
/begin GROUP S3313_SWC2LScrollDownSta "SWC_INP_type/run_SWC_INP_5ms_sys/INP/CAN4/SignalCheck/zGW_LINDr1/SWC2LScrollDownSta"
 /begin REF_CHARACTERISTIC KINP_SWC2LScrollDownSta_flg_defval KINP_SWC2LScrollDownSta_flg_ovrdflg KINP_SWC2LScrollDownSta_flg_ovrdval /end REF_CHARACTERISTIC
/end GROUP
/begin GROUP S3313_SWC2LScrollPressSta "SWC_INP_type/run_SWC_INP_5ms_sys/INP/CAN4/SignalCheck/zGW_LINDr1/SWC2LScrollPressSta"
 /begin REF_CHARACTERISTIC KINP_SWC2LScrollPressSta_flg_defval KINP_SWC2LScrollPressSta_flg_ovrdflg KINP_SWC2LScrollPressSta_flg_ovrdval /end REF_CHARACTERISTIC
/end GROUP
/begin GROUP S3313_SWC2LScrollUpSta "SWC_INP_type/run_SWC_INP_5ms_sys/INP/CAN4/SignalCheck/zGW_LINDr1/SWC2LScrollUpSta"
 /begin REF_CHARACTERISTIC KINP_SWC2LScrollUpSta_flg_defval KINP_SWC2LScrollUpSta_flg_ovrdflg KINP_SWC2LScrollUpSta_flg_ovrdval /end REF_CHARACTERISTIC
/end GROUP
/begin GROUP S3313_SWC2RCustomizeSta "SWC_INP_type/run_SWC_INP_5ms_sys/INP/CAN4/SignalCheck/zGW_LINDr1/SWC2RCustomizeSta"
 /begin REF_CHARACTERISTIC KINP_SWC2RCustomizeSta_flg_defval KINP_SWC2RCustomizeSta_flg_ovrdflg KINP_SWC2RCustomizeSta_flg_ovrdval /end REF_CHARACTERISTIC
/end GROUP
/begin GROUP S3313_SWC2RLeftSta "SWC_INP_type/run_SWC_INP_5ms_sys/INP/CAN4/SignalCheck/zGW_LINDr1/SWC2RLeftSta"
 /begin REF_CHARACTERISTIC KINP_SWC2RLeftSta_flg_defval KINP_SWC2RLeftSta_flg_ovrdflg KINP_SWC2RLeftSta_flg_ovrdval /end REF_CHARACTERISTIC
/end GROUP
/begin GROUP S3313_SWC2RPageSwitchSta "SWC_INP_type/run_SWC_INP_5ms_sys/INP/CAN4/SignalCheck/zGW_LINDr1/SWC2RPageSwitchSta"
 /begin REF_CHARACTERISTIC KINP_SWC2RPageSwitchSta_flg_defval KINP_SWC2RPageSwitchSta_flg_ovrdflg KINP_SWC2RPageSwitchSta_flg_ovrdval /end REF_CHARACTERISTIC
/end GROUP
/begin GROUP S3313_SWC2RRegenDownSta "SWC_INP_type/run_SWC_INP_5ms_sys/INP/CAN4/SignalCheck/zGW_LINDr1/SWC2RRegenDownSta"
 /begin REF_CHARACTERISTIC KINP_SWC2RRegenDownSta_flg_defval KINP_SWC2RRegenDownSta_flg_ovrdflg KINP_SWC2RRegenDownSta_flg_ovrdval /end REF_CHARACTERISTIC
/end GROUP
/begin GROUP S3313_SWC2RRightSta "SWC_INP_type/run_SWC_INP_5ms_sys/INP/CAN4/SignalCheck/zGW_LINDr1/SWC2RRightSta"
 /begin REF_CHARACTERISTIC KINP_SWC2RRightSta_flg_defval KINP_SWC2RRightSta_flg_ovrdflg KINP_SWC2RRightSta_flg_ovrdval /end REF_CHARACTERISTIC
/end GROUP
/begin GROUP S3313_SWC2RScrollDownSta "SWC_INP_type/run_SWC_INP_5ms_sys/INP/CAN4/SignalCheck/zGW_LINDr1/SWC2RScrollDownSta"
 /begin REF_CHARACTERISTIC KINP_SWC2RScrollDownSta_flg_defval KINP_SWC2RScrollDownSta_flg_ovrdflg KINP_SWC2RScrollDownSta_flg_ovrdval /end REF_CHARACTERISTIC
/end GROUP
/begin GROUP S3313_SWC2RScrollPressSta "SWC_INP_type/run_SWC_INP_5ms_sys/INP/CAN4/SignalCheck/zGW_LINDr1/SWC2RScrollPressSta"
 /begin REF_CHARACTERISTIC KINP_SWC2RScrollPressSta_flg_defval KINP_SWC2RScrollPressSta_flg_ovrdflg KINP_SWC2RScrollPressSta_flg_ovrdval /end REF_CHARACTERISTIC
/end GROUP
/begin GROUP S3313_SWC2RScrollUpSta "SWC_INP_type/run_SWC_INP_5ms_sys/INP/CAN4/SignalCheck/zGW_LINDr1/SWC2RScrollUpSta"
 /begin REF_CHARACTERISTIC KINP_SWC2RScrollUpSta_flg_defval KINP_SWC2RScrollUpSta_flg_ovrdflg KINP_SWC2RScrollUpSta_flg_ovrdval /end REF_CHARACTERISTIC
/end GROUP
/begin GROUP S3313_SWC2RVRSta "SWC_INP_type/run_SWC_INP_5ms_sys/INP/CAN4/SignalCheck/zGW_LINDr1/SWC2RVRSta"
 /begin REF_CHARACTERISTIC KINP_SWC2RVRSta_flg_defval KINP_SWC2RVRSta_flg_ovrdflg KINP_SWC2RVRSta_flg_ovrdval /end REF_CHARACTERISTIC
/end GROUP
/begin GROUP S3313_SWCACCSta "SWC_INP_type/run_SWC_INP_5ms_sys/INP/CAN4/SignalCheck/zGW_LINDr1/SWCACCSta"
 /begin REF_CHARACTERISTIC KINP_SWCACCSta_flg_defval KINP_SWCACCSta_flg_ovrdflg KINP_SWCACCSta_flg_ovrdval /end REF_CHARACTERISTIC
/end GROUP
/begin GROUP S3313_SWCCANCELSta "SWC_INP_type/run_SWC_INP_5ms_sys/INP/CAN4/SignalCheck/zGW_LINDr1/SWCCANCELSta"
 /begin REF_CHARACTERISTIC KINP_SWCCANCELSta_flg_defval KINP_SWCCANCELSta_flg_ovrdflg KINP_SWCCANCELSta_flg_ovrdval /end REF_CHARACTERISTIC
/end GROUP
/begin GROUP S3313_SWCDistanceSta "SWC_INP_type/run_SWC_INP_5ms_sys/INP/CAN4/SignalCheck/zGW_LINDr1/SWCDistanceSta"
 /begin REF_CHARACTERISTIC KINP_SWCDistanceSta_flg_defval KINP_SWCDistanceSta_flg_ovrdflg KINP_SWCDistanceSta_flg_ovrdval /end REF_CHARACTERISTIC
/end GROUP
/begin GROUP S3313_SWCDownSta "SWC_INP_type/run_SWC_INP_5ms_sys/INP/CAN4/SignalCheck/zGW_LINDr1/SWCDownSta"
 /begin REF_CHARACTERISTIC KINP_SWCDownSta_flg_defval KINP_SWCDownSta_flg_ovrdflg KINP_SWCDownSta_flg_ovrdval /end REF_CHARACTERISTIC
/end GROUP
/begin GROUP S3313_SWCLKASta "SWC_INP_type/run_SWC_INP_5ms_sys/INP/CAN4/SignalCheck/zGW_LINDr1/SWCLKASta"
 /begin REF_CHARACTERISTIC KINP_SWCLKASta_flg_defval KINP_SWCLKASta_flg_ovrdflg KINP_SWCLKASta_flg_ovrdval /end REF_CHARACTERISTIC
/end GROUP
/begin GROUP S3313_SWCLeftSta "SWC_INP_type/run_SWC_INP_5ms_sys/INP/CAN4/SignalCheck/zGW_LINDr1/SWCLeftSta"
 /begin REF_CHARACTERISTIC KINP_SWCLeftSta_flg_defval KINP_SWCLeftSta_flg_ovrdflg KINP_SWCLeftSta_flg_ovrdval /end REF_CHARACTERISTIC
/end GROUP
/begin GROUP S3313_SWCRegenDown "SWC_INP_type/run_SWC_INP_5ms_sys/INP/CAN4/SignalCheck/zGW_LINDr1/SWCRegenDown"
 /begin REF_CHARACTERISTIC KINP_SWCRegenDown_flg_defval KINP_SWCRegenDown_flg_ovrdflg KINP_SWCRegenDown_flg_ovrdval /end REF_CHARACTERISTIC
/end GROUP
/begin GROUP S3313_SWCRegenUp "SWC_INP_type/run_SWC_INP_5ms_sys/INP/CAN4/SignalCheck/zGW_LINDr1/SWCRegenUp"
 /begin REF_CHARACTERISTIC KINP_SWCRegenUp_flg_defval KINP_SWCRegenUp_flg_ovrdflg KINP_SWCRegenUp_flg_ovrdval /end REF_CHARACTERISTIC
/end GROUP
/begin GROUP S3313_SWCResUpSta "SWC_INP_type/run_SWC_INP_5ms_sys/INP/CAN4/SignalCheck/zGW_LINDr1/SWCResUpSta"
 /begin REF_CHARACTERISTIC KINP_SWCResUpSta_flg_defval KINP_SWCResUpSta_flg_ovrdflg KINP_SWCResUpSta_flg_ovrdval /end REF_CHARACTERISTIC
/end GROUP
/begin GROUP S3313_SWCRightSta "SWC_INP_type/run_SWC_INP_5ms_sys/INP/CAN4/SignalCheck/zGW_LINDr1/SWCRightSta"
 /begin REF_CHARACTERISTIC KINP_SWCRightSta_flg_defval KINP_SWCRightSta_flg_ovrdflg KINP_SWCRightSta_flg_ovrdval /end REF_CHARACTERISTIC
/end GROUP
/begin GROUP S3313_SWCSetdownSta "SWC_INP_type/run_SWC_INP_5ms_sys/INP/CAN4/SignalCheck/zGW_LINDr1/SWCSetdownSta"
 /begin REF_CHARACTERISTIC KINP_SWCSetdownSta_flg_defval KINP_SWCSetdownSta_flg_ovrdflg KINP_SWCSetdownSta_flg_ovrdval /end REF_CHARACTERISTIC
/end GROUP
/begin GROUP S3313_SWCTripSta "SWC_INP_type/run_SWC_INP_5ms_sys/INP/CAN4/SignalCheck/zGW_LINDr1/SWCTripSta"
 /begin REF_CHARACTERISTIC KINP_SWCTripSta_flg_defval KINP_SWCTripSta_flg_ovrdflg KINP_SWCTripSta_flg_ovrdval /end REF_CHARACTERISTIC
/end GROUP
/begin GROUP S3313_SWCUndefinedSta "SWC_INP_type/run_SWC_INP_5ms_sys/INP/CAN4/SignalCheck/zGW_LINDr1/SWCUndefinedSta"
 /begin REF_CHARACTERISTIC KINP_SWCUndefinedSta_flg_defval KINP_SWCUndefinedSta_flg_ovrdflg KINP_SWCUndefinedSta_flg_ovrdval /end REF_CHARACTERISTIC
/end GROUP
/begin GROUP S3313_SWCUpSta "SWC_INP_type/run_SWC_INP_5ms_sys/INP/CAN4/SignalCheck/zGW_LINDr1/SWCUpSta"
 /begin REF_CHARACTERISTIC KINP_SWCUpSta_flg_defval KINP_SWCUpSta_flg_ovrdflg KINP_SWCUpSta_flg_ovrdval /end REF_CHARACTERISTIC
/end GROUP
/begin GROUP S3313_SWCVRSta "SWC_INP_type/run_SWC_INP_5ms_sys/INP/CAN4/SignalCheck/zGW_LINDr1/SWCVRSta"
 /begin REF_CHARACTERISTIC KINP_SWCVRSta_flg_defval KINP_SWCVRSta_flg_ovrdflg KINP_SWCVRSta_flg_ovrdval /end REF_CHARACTERISTIC
/end GROUP
/begin GROUP S3313_SWCmodeSta "SWC_INP_type/run_SWC_INP_5ms_sys/INP/CAN4/SignalCheck/zGW_LINDr1/SWCmodeSta"
 /begin REF_CHARACTERISTIC KINP_SWCmodeSta_flg_defval KINP_SWCmodeSta_flg_ovrdflg KINP_SWCmodeSta_flg_ovrdval /end REF_CHARACTERISTIC
/end GROUP
/begin GROUP S3314_ACT1ResponseError "SWC_INP_type/run_SWC_INP_5ms_sys/INP/CAN4/SignalCheck/zGW_LINDr2/ACT1ResponseError"
 /begin REF_CHARACTERISTIC KINP_ACT1ResponseError_flg_defval KINP_ACT1ResponseError_flg_ovrdflg KINP_ACT1ResponseError_flg_ovrdval /end REF_CHARACTERISTIC
/end GROUP
/begin GROUP S3315_AGSActualPosition "SWC_INP_type/run_SWC_INP_5ms_sys/INP/CAN4/SignalCheck/zGW_LINFr1/AGSActualPosition"
 /begin REF_CHARACTERISTIC KINP_AGSActualPosition_enum_defval KINP_AGSActualPosition_enum_ovrdflg KINP_AGSActualPosition_enum_ovrdval /end REF_CHARACTERISTIC
/end GROUP
/begin GROUP S3315_FGSIntenRspSta "SWC_INP_type/run_SWC_INP_5ms_sys/INP/CAN4/SignalCheck/zGW_LINFr1/FGSIntenRspSta"
 /begin REF_CHARACTERISTIC KINP_FGSIntenRspSta_enum_defval KINP_FGSIntenRspSta_enum_ovrdflg KINP_FGSIntenRspSta_enum_ovrdval /end REF_CHARACTERISTIC
/end GROUP
/begin GROUP S3316_EWP1BlockError "SWC_INP_type/run_SWC_INP_5ms_sys/INP/CAN4/SignalCheck/zGW_LINFr2/EWP1BlockError"
 /begin REF_CHARACTERISTIC KINP_EWP1BlockError_enum_defval KINP_EWP1BlockError_enum_ovrdflg KINP_EWP1BlockError_enum_ovrdval /end REF_CHARACTERISTIC
/end GROUP
/begin GROUP S3316_EWP1OverCurrError "SWC_INP_type/run_SWC_INP_5ms_sys/INP/CAN4/SignalCheck/zGW_LINFr2/EWP1OverCurrError"
 /begin REF_CHARACTERISTIC KINP_EWP1OverCurrError_enum_defval KINP_EWP1OverCurrError_enum_ovrdflg KINP_EWP1OverCurrError_enum_ovrdval /end REF_CHARACTERISTIC
/end GROUP
/begin GROUP S3316_EWP2BlockError "SWC_INP_type/run_SWC_INP_5ms_sys/INP/CAN4/SignalCheck/zGW_LINFr2/EWP2BlockError"
 /begin REF_CHARACTERISTIC KINP_EWP2BlockError_enum_defval KINP_EWP2BlockError_enum_ovrdflg KINP_EWP2BlockError_enum_ovrdval /end REF_CHARACTERISTIC
/end GROUP
/begin GROUP S3316_EWP2OverCurrError "SWC_INP_type/run_SWC_INP_5ms_sys/INP/CAN4/SignalCheck/zGW_LINFr2/EWP2OverCurrError"
 /begin REF_CHARACTERISTIC KINP_EWP2OverCurrError_enum_defval KINP_EWP2OverCurrError_enum_ovrdflg KINP_EWP2OverCurrError_enum_ovrdval /end REF_CHARACTERISTIC
/end GROUP
/begin GROUP S3316_EWP3BlockError "SWC_INP_type/run_SWC_INP_5ms_sys/INP/CAN4/SignalCheck/zGW_LINFr2/EWP3BlockError"
 /begin REF_CHARACTERISTIC KINP_EWP3BlockError_enum_defval KINP_EWP3BlockError_enum_ovrdflg KINP_EWP3BlockError_enum_ovrdval /end REF_CHARACTERISTIC
/end GROUP
/begin GROUP S3316_EWP3OverCurrError "SWC_INP_type/run_SWC_INP_5ms_sys/INP/CAN4/SignalCheck/zGW_LINFr2/EWP3OverCurrError"
 /begin REF_CHARACTERISTIC KINP_EWP3OverCurrError_enum_defval KINP_EWP3OverCurrError_enum_ovrdflg KINP_EWP3OverCurrError_enum_ovrdval /end REF_CHARACTERISTIC
/end GROUP
/begin GROUP S3317_DSEATAntiSta "SWC_INP_type/run_SWC_INP_5ms_sys/INP/CAN4/SignalCheck/zGW_SEAT1/DSEATAntiSta"
 /begin REF_CHARACTERISTIC KINP_DSEATAntiSta_flg_defval KINP_DSEATAntiSta_flg_ovrdflg KINP_DSEATAntiSta_flg_ovrdval /end REF_CHARACTERISTIC
/end GROUP
/begin GROUP S3317_DSEATEntryFunSta "SWC_INP_type/run_SWC_INP_5ms_sys/INP/CAN4/SignalCheck/zGW_SEAT1/DSEATEntryFunSta"
 /begin REF_CHARACTERISTIC KINP_DSEATEntryFunSta_flg_defval KINP_DSEATEntryFunSta_flg_ovrdflg KINP_DSEATEntryFunSta_flg_ovrdval /end REF_CHARACTERISTIC
/end GROUP
/begin GROUP S3317_DSEATErrorSta "SWC_INP_type/run_SWC_INP_5ms_sys/INP/CAN4/SignalCheck/zGW_SEAT1/DSEATErrorSta"
 /begin REF_CHARACTERISTIC KINP_DSEATErrorSta_flg_defval KINP_DSEATErrorSta_flg_ovrdflg KINP_DSEATErrorSta_flg_ovrdval /end REF_CHARACTERISTIC
/end GROUP
/begin GROUP S3317_DSEATHWVer "SWC_INP_type/run_SWC_INP_5ms_sys/INP/CAN4/SignalCheck/zGW_SEAT1/DSEATHWVer"
 /begin REF_CHARACTERISTIC KINP_DSEATHWVer_enum_defval KINP_DSEATHWVer_enum_ovrdflg KINP_DSEATHWVer_enum_ovrdval /end REF_CHARACTERISTIC
/end GROUP
/begin GROUP S3317_DSEATMode "SWC_INP_type/run_SWC_INP_5ms_sys/INP/CAN4/SignalCheck/zGW_SEAT1/DSEATMode"
 /begin REF_CHARACTERISTIC KINP_DSEATMode_enum_defval KINP_DSEATMode_enum_ovrdflg KINP_DSEATMode_enum_ovrdval /end REF_CHARACTERISTIC
/end GROUP
/begin GROUP S3317_DSEATSWVer "SWC_INP_type/run_SWC_INP_5ms_sys/INP/CAN4/SignalCheck/zGW_SEAT1/DSEATSWVer"
 /begin REF_CHARACTERISTIC KINP_DSEATSWVer_enum_defval KINP_DSEATSWVer_enum_ovrdflg KINP_DSEATSWVer_enum_ovrdval /end REF_CHARACTERISTIC
/end GROUP
/begin GROUP S3317_DSEATVentSta "SWC_INP_type/run_SWC_INP_5ms_sys/INP/CAN4/SignalCheck/zGW_SEAT1/DSEATVentSta"
 /begin REF_CHARACTERISTIC KINP_DSEATVentSta_enum_defval KINP_DSEATVentSta_enum_ovrdflg KINP_DSEATVentSta_enum_ovrdval /end REF_CHARACTERISTIC
/end GROUP
/begin GROUP S3317_DSEATheatersta "SWC_INP_type/run_SWC_INP_5ms_sys/INP/CAN4/SignalCheck/zGW_SEAT1/DSEATheatersta"
 /begin REF_CHARACTERISTIC KINP_DSEATheatersta_enum_defval KINP_DSEATheatersta_enum_ovrdflg KINP_DSEATheatersta_enum_ovrdval /end REF_CHARACTERISTIC
/end GROUP
/begin GROUP S3317_PSEATErrorSta "SWC_INP_type/run_SWC_INP_5ms_sys/INP/CAN4/SignalCheck/zGW_SEAT1/PSEATErrorSta"
 /begin REF_CHARACTERISTIC KINP_PSEATErrorSta_flg_defval KINP_PSEATErrorSta_flg_ovrdflg KINP_PSEATErrorSta_flg_ovrdval /end REF_CHARACTERISTIC
/end GROUP
/begin GROUP S3317_PSEATHWVer "SWC_INP_type/run_SWC_INP_5ms_sys/INP/CAN4/SignalCheck/zGW_SEAT1/PSEATHWVer"
 /begin REF_CHARACTERISTIC KINP_PSEATHWVer_enum_defval KINP_PSEATHWVer_enum_ovrdflg KINP_PSEATHWVer_enum_ovrdval /end REF_CHARACTERISTIC
/end GROUP
/begin GROUP S3317_PSEATMode "SWC_INP_type/run_SWC_INP_5ms_sys/INP/CAN4/SignalCheck/zGW_SEAT1/PSEATMode"
 /begin REF_CHARACTERISTIC KINP_PSEATMode_enum_defval KINP_PSEATMode_enum_ovrdflg KINP_PSEATMode_enum_ovrdval /end REF_CHARACTERISTIC
/end GROUP
/begin GROUP S3317_PSEATSWVer "SWC_INP_type/run_SWC_INP_5ms_sys/INP/CAN4/SignalCheck/zGW_SEAT1/PSEATSWVer"
 /begin REF_CHARACTERISTIC KINP_PSEATSWVer_enum_defval KINP_PSEATSWVer_enum_ovrdflg KINP_PSEATSWVer_enum_ovrdval /end REF_CHARACTERISTIC
/end GROUP
/begin GROUP S3317_PSEATVentSta "SWC_INP_type/run_SWC_INP_5ms_sys/INP/CAN4/SignalCheck/zGW_SEAT1/PSEATVentSta"
 /begin REF_CHARACTERISTIC KINP_PSEATVentSta_enum_defval KINP_PSEATVentSta_enum_ovrdflg KINP_PSEATVentSta_enum_ovrdval /end REF_CHARACTERISTIC
/end GROUP
/begin GROUP S3317_PSEATheatersta "SWC_INP_type/run_SWC_INP_5ms_sys/INP/CAN4/SignalCheck/zGW_SEAT1/PSEATheatersta"
 /begin REF_CHARACTERISTIC KINP_PSEATheatersta_enum_defval KINP_PSEATheatersta_enum_ovrdflg KINP_PSEATheatersta_enum_ovrdval /end REF_CHARACTERISTIC
/end GROUP
/begin GROUP S4599_TimeSyncFromBSDay "SWC_INP_type/run_SWC_INP_5ms_sys/INP/CAN5/SignalCheck/TBOX2/TimeSyncFromBSDay"
 /begin REF_CHARACTERISTIC KINP_TimeSyncFromBSDay_DAY_defval KINP_TimeSyncFromBSDay_DAY_ovrdflg KINP_TimeSyncFromBSDay_DAY_ovrdval /end REF_CHARACTERISTIC
/end GROUP
/begin GROUP S4599_TimeSyncFromBSHour "SWC_INP_type/run_SWC_INP_5ms_sys/INP/CAN5/SignalCheck/TBOX2/TimeSyncFromBSHour"
 /begin REF_CHARACTERISTIC KINP_TimeSyncFromBSHour_hr_defval KINP_TimeSyncFromBSHour_hr_ovrdflg KINP_TimeSyncFromBSHour_hr_ovrdval /end REF_CHARACTERISTIC
/end GROUP
/begin GROUP S4599_TimeSyncFromBSMinute "SWC_INP_type/run_SWC_INP_5ms_sys/INP/CAN5/SignalCheck/TBOX2/TimeSyncFromBSMinute"
 /begin REF_CHARACTERISTIC KINP_TimeSyncFromBSMinute_min_defval KINP_TimeSyncFromBSMinute_min_ovrdflg KINP_TimeSyncFromBSMinute_min_ovrdval /end REF_CHARACTERISTIC
/end GROUP
/begin GROUP S4599_TimeSyncFromBSMonth "SWC_INP_type/run_SWC_INP_5ms_sys/INP/CAN5/SignalCheck/TBOX2/TimeSyncFromBSMonth"
 /begin REF_CHARACTERISTIC KINP_TimeSyncFromBSMonth_MONTH_defval KINP_TimeSyncFromBSMonth_MONTH_ovrdflg KINP_TimeSyncFromBSMonth_MONTH_ovrdval /end REF_CHARACTERISTIC
/end GROUP
/begin GROUP S4599_TimeSyncFromBSSecond "SWC_INP_type/run_SWC_INP_5ms_sys/INP/CAN5/SignalCheck/TBOX2/TimeSyncFromBSSecond"
 /begin REF_CHARACTERISTIC KINP_TimeSyncFromBSSecond_s_defval KINP_TimeSyncFromBSSecond_s_ovrdflg KINP_TimeSyncFromBSSecond_s_ovrdval /end REF_CHARACTERISTIC
/end GROUP
/begin GROUP S4599_TimeSyncFromBSYear "SWC_INP_type/run_SWC_INP_5ms_sys/INP/CAN5/SignalCheck/TBOX2/TimeSyncFromBSYear"
 /begin REF_CHARACTERISTIC KINP_TimeSyncFromBSYear_YEAR_defval KINP_TimeSyncFromBSYear_YEAR_ovrdflg KINP_TimeSyncFromBSYear_YEAR_ovrdval /end REF_CHARACTERISTIC
/end GROUP
/begin GROUP S4600_ChargePercentSet "SWC_INP_type/run_SWC_INP_5ms_sys/INP/CAN5/SignalCheck/TBOX3/ChargePercentSet"
 /begin REF_CHARACTERISTIC KINP_ChargePercentSet_pct_defval KINP_ChargePercentSet_pct_ovrdflg KINP_ChargePercentSet_pct_ovrdval /end REF_CHARACTERISTIC
/end GROUP
/begin GROUP S4600_ReserveChargeOFFDay "SWC_INP_type/run_SWC_INP_5ms_sys/INP/CAN5/SignalCheck/TBOX3/ReserveChargeOFFDay"
 /begin REF_CHARACTERISTIC KINP_ReserveChargeOFFDay_DAY_defval KINP_ReserveChargeOFFDay_DAY_ovrdflg KINP_ReserveChargeOFFDay_DAY_ovrdval /end REF_CHARACTERISTIC
/end GROUP
/begin GROUP S4600_ReserveChargeOFFHour "SWC_INP_type/run_SWC_INP_5ms_sys/INP/CAN5/SignalCheck/TBOX3/ReserveChargeOFFHour"
 /begin REF_CHARACTERISTIC KINP_ReserveChargeOFFHour_hr_defval KINP_ReserveChargeOFFHour_hr_ovrdflg KINP_ReserveChargeOFFHour_hr_ovrdval /end REF_CHARACTERISTIC
/end GROUP
/begin GROUP S4600_ReserveChargeOFFMinute "SWC_INP_type/run_SWC_INP_5ms_sys/INP/CAN5/SignalCheck/TBOX3/ReserveChargeOFFMinute"
 /begin REF_CHARACTERISTIC KINP_ReserveChargeOFFMinute_min_defval KINP_ReserveChargeOFFMinute_min_ovrdflg KINP_ReserveChargeOFFMinute_min_ovrdval /end REF_CHARACTERISTIC
/end GROUP
/begin GROUP S4600_ReserveChargeOFFMonth "SWC_INP_type/run_SWC_INP_5ms_sys/INP/CAN5/SignalCheck/TBOX3/ReserveChargeOFFMonth"
 /begin REF_CHARACTERISTIC KINP_ReserveChargeOFFMonth_MONTH_defval KINP_ReserveChargeOFFMonth_MONTH_ovrdflg KINP_ReserveChargeOFFMonth_MONTH_ovrdval /end REF_CHARACTERISTIC
/end GROUP
/begin GROUP S4600_ReserveChargeOFFYear "SWC_INP_type/run_SWC_INP_5ms_sys/INP/CAN5/SignalCheck/TBOX3/ReserveChargeOFFYear"
 /begin REF_CHARACTERISTIC KINP_ReserveChargeOFFYear_YEAR_defval KINP_ReserveChargeOFFYear_YEAR_ovrdflg KINP_ReserveChargeOFFYear_YEAR_ovrdval /end REF_CHARACTERISTIC
/end GROUP
/begin GROUP S4600_ReserveChargeOnDay "SWC_INP_type/run_SWC_INP_5ms_sys/INP/CAN5/SignalCheck/TBOX3/ReserveChargeOnDay"
 /begin REF_CHARACTERISTIC KINP_ReserveChargeOnDay_DAY_defval KINP_ReserveChargeOnDay_DAY_ovrdflg KINP_ReserveChargeOnDay_DAY_ovrdval /end REF_CHARACTERISTIC
/end GROUP
/begin GROUP S4600_ReserveChargeOnHour "SWC_INP_type/run_SWC_INP_5ms_sys/INP/CAN5/SignalCheck/TBOX3/ReserveChargeOnHour"
 /begin REF_CHARACTERISTIC KINP_ReserveChargeOnHour_hr_defval KINP_ReserveChargeOnHour_hr_ovrdflg KINP_ReserveChargeOnHour_hr_ovrdval /end REF_CHARACTERISTIC
/end GROUP
/begin GROUP S4600_ReserveChargeOnMinute "SWC_INP_type/run_SWC_INP_5ms_sys/INP/CAN5/SignalCheck/TBOX3/ReserveChargeOnMinute"
 /begin REF_CHARACTERISTIC KINP_ReserveChargeOnMinute_min_defval KINP_ReserveChargeOnMinute_min_ovrdflg KINP_ReserveChargeOnMinute_min_ovrdval /end REF_CHARACTERISTIC
/end GROUP
/begin GROUP S4600_ReserveChargeOnMonth "SWC_INP_type/run_SWC_INP_5ms_sys/INP/CAN5/SignalCheck/TBOX3/ReserveChargeOnMonth"
 /begin REF_CHARACTERISTIC KINP_ReserveChargeOnMonth_MONTH_defval KINP_ReserveChargeOnMonth_MONTH_ovrdflg KINP_ReserveChargeOnMonth_MONTH_ovrdval /end REF_CHARACTERISTIC
/end GROUP
/begin GROUP S4600_ReserveChargeOnYear "SWC_INP_type/run_SWC_INP_5ms_sys/INP/CAN5/SignalCheck/TBOX3/ReserveChargeOnYear"
 /begin REF_CHARACTERISTIC KINP_ReserveChargeOnYear_YEAR_defval KINP_ReserveChargeOnYear_YEAR_ovrdflg KINP_ReserveChargeOnYear_YEAR_ovrdval /end REF_CHARACTERISTIC
/end GROUP
/begin GROUP S4600_TBOXHWVER "SWC_INP_type/run_SWC_INP_5ms_sys/INP/CAN5/SignalCheck/TBOX3/TBOXHWVER"
 /begin REF_CHARACTERISTIC KINP_TBOXHWVER_enum_defval KINP_TBOXHWVER_enum_ovrdflg KINP_TBOXHWVER_enum_ovrdval /end REF_CHARACTERISTIC
/end GROUP
/begin GROUP S4600_TBOXSWVER "SWC_INP_type/run_SWC_INP_5ms_sys/INP/CAN5/SignalCheck/TBOX3/TBOXSWVER"
 /begin REF_CHARACTERISTIC KINP_TBOXSWVER_enum_defval KINP_TBOXSWVER_enum_ovrdflg KINP_TBOXSWVER_enum_ovrdval /end REF_CHARACTERISTIC
/end GROUP
/begin GROUP S4719_ACCComfortBandLower "SWC_INP_type/run_SWC_INP_5ms_sys/INP/CAN6/SignalCheck/FCM1/ACCComfortBandLower"
 /begin REF_CHARACTERISTIC KINP_ACCComfortBandLower_mps2_defval KINP_ACCComfortBandLower_mps2_ovrdflg KINP_ACCComfortBandLower_mps2_ovrdval /end REF_CHARACTERISTIC
/end GROUP
/begin GROUP S4719_ACCComfortBandUpper "SWC_INP_type/run_SWC_INP_5ms_sys/INP/CAN6/SignalCheck/FCM1/ACCComfortBandUpper"
 /begin REF_CHARACTERISTIC KINP_ACCComfortBandUpper_mps2_defval KINP_ACCComfortBandUpper_mps2_ovrdflg KINP_ACCComfortBandUpper_mps2_ovrdval /end REF_CHARACTERISTIC
/end GROUP
/begin GROUP S4719_ACCJerkLowerLimit "SWC_INP_type/run_SWC_INP_5ms_sys/INP/CAN6/SignalCheck/FCM1/ACCJerkLowerLimit"
 /begin REF_CHARACTERISTIC KINP_ACCJerkLowerLimit_mps3_defval KINP_ACCJerkLowerLimit_mps3_ovrdflg KINP_ACCJerkLowerLimit_mps3_ovrdval /end REF_CHARACTERISTIC
/end GROUP
/begin GROUP S4719_ACCJerkUpperLimit "SWC_INP_type/run_SWC_INP_5ms_sys/INP/CAN6/SignalCheck/FCM1/ACCJerkUpperLimit"
 /begin REF_CHARACTERISTIC KINP_ACCJerkUpperLimit_mps3_defval KINP_ACCJerkUpperLimit_mps3_ovrdflg KINP_ACCJerkUpperLimit_mps3_ovrdval /end REF_CHARACTERISTIC
/end GROUP
/begin GROUP S4719_ACCObjDist "SWC_INP_type/run_SWC_INP_5ms_sys/INP/CAN6/SignalCheck/FCM1/ACCObjDist"
 /begin REF_CHARACTERISTIC KINP_ACCObjDist_m_defval KINP_ACCObjDist_m_ovrdflg KINP_ACCObjDist_m_ovrdval /end REF_CHARACTERISTIC
/end GROUP
/begin GROUP S4719_ACCObjDstLvl "SWC_INP_type/run_SWC_INP_5ms_sys/INP/CAN6/SignalCheck/FCM1/ACCObjDstLvl"
 /begin REF_CHARACTERISTIC KINP_ACCObjDstLvl_enum_defval KINP_ACCObjDstLvl_enum_ovrdflg KINP_ACCObjDstLvl_enum_ovrdval /end REF_CHARACTERISTIC
/end GROUP
/begin GROUP S4719_ACCObjRelSpd "SWC_INP_type/run_SWC_INP_5ms_sys/INP/CAN6/SignalCheck/FCM1/ACCObjRelSpd"
 /begin REF_CHARACTERISTIC KINP_ACCObjRelSpd_mps_defval KINP_ACCObjRelSpd_mps_ovrdflg KINP_ACCObjRelSpd_mps_ovrdval /end REF_CHARACTERISTIC
/end GROUP
/begin GROUP S4719_ACCRequiredAccel "SWC_INP_type/run_SWC_INP_5ms_sys/INP/CAN6/SignalCheck/FCM1/ACCRequiredAccel"
 /begin REF_CHARACTERISTIC KINP_ACCRequiredAccel_mps2_defval KINP_ACCRequiredAccel_mps2_ovrdflg KINP_ACCRequiredAccel_mps2_ovrdval /end REF_CHARACTERISTIC
/end GROUP
/begin GROUP S4719_ACCTakeoverReq "SWC_INP_type/run_SWC_INP_5ms_sys/INP/CAN6/SignalCheck/FCM1/ACCTakeoverReq"
 /begin REF_CHARACTERISTIC KINP_ACCTakeoverReq_flg_defval KINP_ACCTakeoverReq_flg_ovrdflg KINP_ACCTakeoverReq_flg_ovrdval /end REF_CHARACTERISTIC
/end GROUP
/begin GROUP S4719_ACCVehHoldReq "SWC_INP_type/run_SWC_INP_5ms_sys/INP/CAN6/SignalCheck/FCM1/ACCVehHoldReq"
 /begin REF_CHARACTERISTIC KINP_ACCVehHoldReq_flg_defval KINP_ACCVehHoldReq_flg_ovrdflg KINP_ACCVehHoldReq_flg_ovrdval /end REF_CHARACTERISTIC
/end GROUP
/begin GROUP S4719_ADASACCSta "SWC_INP_type/run_SWC_INP_5ms_sys/INP/CAN6/SignalCheck/FCM1/ADASACCSta"
 /begin REF_CHARACTERISTIC KINP_ADASACCSta_enum_defval KINP_ADASACCSta_enum_ovrdflg KINP_ADASACCSta_enum_ovrdval /end REF_CHARACTERISTIC
/end GROUP
/begin GROUP S4719_ADASAEBReq "SWC_INP_type/run_SWC_INP_5ms_sys/INP/CAN6/SignalCheck/FCM1/ADASAEBReq"
 /begin REF_CHARACTERISTIC KINP_ADASAEBReq_enum_defval KINP_ADASAEBReq_enum_ovrdflg KINP_ADASAEBReq_enum_ovrdval /end REF_CHARACTERISTIC
/end GROUP
/begin GROUP S4719_ADASAEBSta "SWC_INP_type/run_SWC_INP_5ms_sys/INP/CAN6/SignalCheck/FCM1/ADASAEBSta"
 /begin REF_CHARACTERISTIC KINP_ADASAEBSta_enum_defval KINP_ADASAEBSta_enum_ovrdflg KINP_ADASAEBSta_enum_ovrdval /end REF_CHARACTERISTIC
/end GROUP
/begin GROUP S4719_ADASCAMSpdLim "SWC_INP_type/run_SWC_INP_5ms_sys/INP/CAN6/SignalCheck/FCM1/ADASCAMSpdLim"
 /begin REF_CHARACTERISTIC KINP_ADASCAMSpdLim_enum_defval KINP_ADASCAMSpdLim_enum_ovrdflg KINP_ADASCAMSpdLim_enum_ovrdval /end REF_CHARACTERISTIC
/end GROUP
/begin GROUP S4719_ADASDBSReq "SWC_INP_type/run_SWC_INP_5ms_sys/INP/CAN6/SignalCheck/FCM1/ADASDBSReq"
 /begin REF_CHARACTERISTIC KINP_ADASDBSReq_enum_defval KINP_ADASDBSReq_enum_ovrdflg KINP_ADASDBSReq_enum_ovrdval /end REF_CHARACTERISTIC
/end GROUP
/begin GROUP S4719_ADASFCWMute "SWC_INP_type/run_SWC_INP_5ms_sys/INP/CAN6/SignalCheck/FCM1/ADASFCWMute"
 /begin REF_CHARACTERISTIC KINP_ADASFCWMute_flg_defval KINP_ADASFCWMute_flg_ovrdflg KINP_ADASFCWMute_flg_ovrdval /end REF_CHARACTERISTIC
/end GROUP
/begin GROUP S4719_ADASFCWSta "SWC_INP_type/run_SWC_INP_5ms_sys/INP/CAN6/SignalCheck/FCM1/ADASFCWSta"
 /begin REF_CHARACTERISTIC KINP_ADASFCWSta_enum_defval KINP_ADASFCWSta_enum_ovrdflg KINP_ADASFCWSta_enum_ovrdval /end REF_CHARACTERISTIC
/end GROUP
/begin GROUP S4719_ADASFaultSta "SWC_INP_type/run_SWC_INP_5ms_sys/INP/CAN6/SignalCheck/FCM1/ADASFaultSta"
 /begin REF_CHARACTERISTIC KINP_ADASFaultSta_flg_defval KINP_ADASFaultSta_flg_ovrdflg KINP_ADASFaultSta_flg_ovrdval /end REF_CHARACTERISTIC
/end GROUP
/begin GROUP S4719_ADASFltWrnReq "SWC_INP_type/run_SWC_INP_5ms_sys/INP/CAN6/SignalCheck/FCM1/ADASFltWrnReq"
 /begin REF_CHARACTERISTIC KINP_ADASFltWrnReq_flg_defval KINP_ADASFltWrnReq_flg_ovrdflg KINP_ADASFltWrnReq_flg_ovrdval /end REF_CHARACTERISTIC
/end GROUP
/begin GROUP S4719_ADASForceIdle "SWC_INP_type/run_SWC_INP_5ms_sys/INP/CAN6/SignalCheck/FCM1/ADASForceIdle"
 /begin REF_CHARACTERISTIC KINP_ADASForceIdle_flg_defval KINP_ADASForceIdle_flg_ovrdflg KINP_ADASForceIdle_flg_ovrdval /end REF_CHARACTERISTIC
/end GROUP
/begin GROUP S4719_ADASISASta "SWC_INP_type/run_SWC_INP_5ms_sys/INP/CAN6/SignalCheck/FCM1/ADASISASta"
 /begin REF_CHARACTERISTIC KINP_ADASISASta_enum_defval KINP_ADASISASta_enum_ovrdflg KINP_ADASISASta_enum_ovrdval /end REF_CHARACTERISTIC
/end GROUP
/begin GROUP S4719_ADASLDWMute "SWC_INP_type/run_SWC_INP_5ms_sys/INP/CAN6/SignalCheck/FCM1/ADASLDWMute"
 /begin REF_CHARACTERISTIC KINP_ADASLDWMute_flg_defval KINP_ADASLDWMute_flg_ovrdflg KINP_ADASLDWMute_flg_ovrdval /end REF_CHARACTERISTIC
/end GROUP
/begin GROUP S4719_ADASLDWSta "SWC_INP_type/run_SWC_INP_5ms_sys/INP/CAN6/SignalCheck/FCM1/ADASLDWSta"
 /begin REF_CHARACTERISTIC KINP_ADASLDWSta_enum_defval KINP_ADASLDWSta_enum_ovrdflg KINP_ADASLDWSta_enum_ovrdval /end REF_CHARACTERISTIC
/end GROUP
/begin GROUP S4719_ADASLFCHandsOffWarning "SWC_INP_type/run_SWC_INP_5ms_sys/INP/CAN6/SignalCheck/FCM1/ADASLFCHandsOffWarning"
 /begin REF_CHARACTERISTIC KINP_ADASLFCHandsOffWarning_enum_defval KINP_ADASLFCHandsOffWarning_enum_ovrdflg KINP_ADASLFCHandsOffWarning_enum_ovrdval /end REF_CHARACTERISTIC
/end GROUP
/begin GROUP S4719_ADASLFCSta "SWC_INP_type/run_SWC_INP_5ms_sys/INP/CAN6/SignalCheck/FCM1/ADASLFCSta"
 /begin REF_CHARACTERISTIC KINP_ADASLFCSta_enum_defval KINP_ADASLFCSta_enum_ovrdflg KINP_ADASLFCSta_enum_ovrdval /end REF_CHARACTERISTIC
/end GROUP
/begin GROUP S4719_ADASLFCWarnSound "SWC_INP_type/run_SWC_INP_5ms_sys/INP/CAN6/SignalCheck/FCM1/ADASLFCWarnSound"
 /begin REF_CHARACTERISTIC KINP_ADASLFCWarnSound_enum_defval KINP_ADASLFCWarnSound_enum_ovrdflg KINP_ADASLFCWarnSound_enum_ovrdval /end REF_CHARACTERISTIC
/end GROUP
/begin GROUP S4719_ADASLKASta "SWC_INP_type/run_SWC_INP_5ms_sys/INP/CAN6/SignalCheck/FCM1/ADASLKASta"
 /begin REF_CHARACTERISTIC KINP_ADASLKASta_enum_defval KINP_ADASLKASta_enum_ovrdflg KINP_ADASLKASta_enum_ovrdval /end REF_CHARACTERISTIC
/end GROUP
/begin GROUP S4719_ADASLaneModeL "SWC_INP_type/run_SWC_INP_5ms_sys/INP/CAN6/SignalCheck/FCM1/ADASLaneModeL"
 /begin REF_CHARACTERISTIC KINP_ADASLaneModeL_enum_defval KINP_ADASLaneModeL_enum_ovrdflg KINP_ADASLaneModeL_enum_ovrdval /end REF_CHARACTERISTIC
/end GROUP
/begin GROUP S4719_ADASLaneModeR "SWC_INP_type/run_SWC_INP_5ms_sys/INP/CAN6/SignalCheck/FCM1/ADASLaneModeR"
 /begin REF_CHARACTERISTIC KINP_ADASLaneModeR_enum_defval KINP_ADASLaneModeR_enum_ovrdflg KINP_ADASLaneModeR_enum_ovrdval /end REF_CHARACTERISTIC
/end GROUP
/begin GROUP S4719_ADASLanecurveL "SWC_INP_type/run_SWC_INP_5ms_sys/INP/CAN6/SignalCheck/FCM1/ADASLanecurveL"
 /begin REF_CHARACTERISTIC KINP_ADASLanecurveL_raw32_defval KINP_ADASLanecurveL_raw32_ovrdflg KINP_ADASLanecurveL_raw32_ovrdval /end REF_CHARACTERISTIC
/end GROUP
/begin GROUP S4719_ADASLanecurveR "SWC_INP_type/run_SWC_INP_5ms_sys/INP/CAN6/SignalCheck/FCM1/ADASLanecurveR"
 /begin REF_CHARACTERISTIC KINP_ADASLanecurveR_raw32_defval KINP_ADASLanecurveR_raw32_ovrdflg KINP_ADASLanecurveR_raw32_ovrdval /end REF_CHARACTERISTIC
/end GROUP
/begin GROUP S4719_ADASLanetypeL "SWC_INP_type/run_SWC_INP_5ms_sys/INP/CAN6/SignalCheck/FCM1/ADASLanetypeL"
 /begin REF_CHARACTERISTIC KINP_ADASLanetypeL_enum_defval KINP_ADASLanetypeL_enum_ovrdflg KINP_ADASLanetypeL_enum_ovrdval /end REF_CHARACTERISTIC
/end GROUP
/begin GROUP S4719_ADASLanetypeR "SWC_INP_type/run_SWC_INP_5ms_sys/INP/CAN6/SignalCheck/FCM1/ADASLanetypeR"
 /begin REF_CHARACTERISTIC KINP_ADASLanetypeR_enum_defval KINP_ADASLanetypeR_enum_ovrdflg KINP_ADASLanetypeR_enum_ovrdval /end REF_CHARACTERISTIC
/end GROUP
/begin GROUP S4719_ADASSLIFSpdLim "SWC_INP_type/run_SWC_INP_5ms_sys/INP/CAN6/SignalCheck/FCM1/ADASSLIFSpdLim"
 /begin REF_CHARACTERISTIC KINP_ADASSLIFSpdLim_enum_defval KINP_ADASSLIFSpdLim_enum_ovrdflg KINP_ADASSLIFSpdLim_enum_ovrdval /end REF_CHARACTERISTIC
/end GROUP
/begin GROUP S4719_ADASSLIFSta "SWC_INP_type/run_SWC_INP_5ms_sys/INP/CAN6/SignalCheck/FCM1/ADASSLIFSta"
 /begin REF_CHARACTERISTIC KINP_ADASSLIFSta_enum_defval KINP_ADASSLIFSta_enum_ovrdflg KINP_ADASSLIFSta_enum_ovrdval /end REF_CHARACTERISTIC
/end GROUP
/begin GROUP S4719_ADASShftPosnReq "SWC_INP_type/run_SWC_INP_5ms_sys/INP/CAN6/SignalCheck/FCM1/ADASShftPosnReq"
 /begin REF_CHARACTERISTIC KINP_ADASShftPosnReq_enum_defval KINP_ADASShftPosnReq_enum_ovrdflg KINP_ADASShftPosnReq_enum_ovrdval /end REF_CHARACTERISTIC
/end GROUP
/begin GROUP S4719_ADASShftPosnReqA "SWC_INP_type/run_SWC_INP_5ms_sys/INP/CAN6/SignalCheck/FCM1/ADASShftPosnReqA"
 /begin REF_CHARACTERISTIC KINP_ADASShftPosnReqA_flg_defval KINP_ADASShftPosnReqA_flg_ovrdflg KINP_ADASShftPosnReqA_flg_ovrdval /end REF_CHARACTERISTIC
/end GROUP
/begin GROUP S4719_ADASVehSpdLim "SWC_INP_type/run_SWC_INP_5ms_sys/INP/CAN6/SignalCheck/FCM1/ADASVehSpdLim"
 /begin REF_CHARACTERISTIC KINP_ADASVehSpdLim_enum_defval KINP_ADASVehSpdLim_enum_ovrdflg KINP_ADASVehSpdLim_enum_ovrdval /end REF_CHARACTERISTIC
/end GROUP
/begin GROUP S4719_ADASWarningMsg "SWC_INP_type/run_SWC_INP_5ms_sys/INP/CAN6/SignalCheck/FCM1/ADASWarningMsg"
 /begin REF_CHARACTERISTIC KINP_ADASWarningMsg_enum_defval KINP_ADASWarningMsg_enum_ovrdflg KINP_ADASWarningMsg_enum_ovrdval /end REF_CHARACTERISTIC
/end GROUP
/begin GROUP S4719_AEBVehHoldReq "SWC_INP_type/run_SWC_INP_5ms_sys/INP/CAN6/SignalCheck/FCM1/AEBVehHoldReq"
 /begin REF_CHARACTERISTIC KINP_AEBVehHoldReq_flg_defval KINP_AEBVehHoldReq_flg_ovrdflg KINP_AEBVehHoldReq_flg_ovrdval /end REF_CHARACTERISTIC
/end GROUP
/begin GROUP S4719_CameraBlockage "SWC_INP_type/run_SWC_INP_5ms_sys/INP/CAN6/SignalCheck/FCM1/CameraBlockage"
 /begin REF_CHARACTERISTIC KINP_CameraBlockage_flg_defval KINP_CameraBlockage_flg_ovrdflg KINP_CameraBlockage_flg_ovrdval /end REF_CHARACTERISTIC
/end GROUP
/begin GROUP S4719_FCM1Checksum "SWC_INP_type/run_SWC_INP_5ms_sys/INP/CAN6/SignalCheck/FCM1/FCM1Checksum"
 /begin REF_CHARACTERISTIC KINP_FCM1Checksum_enum_defval KINP_FCM1Checksum_enum_ovrdflg KINP_FCM1Checksum_enum_ovrdval /end REF_CHARACTERISTIC
/end GROUP
/begin GROUP S4719_FCM1LifeCount "SWC_INP_type/run_SWC_INP_5ms_sys/INP/CAN6/SignalCheck/FCM1/FCM1LifeCount"
 /begin REF_CHARACTERISTIC KINP_FCM1LifeCount_enum_defval KINP_FCM1LifeCount_enum_ovrdflg KINP_FCM1LifeCount_enum_ovrdval /end REF_CHARACTERISTIC
/end GROUP
/begin GROUP S4719_FCMACCmode "SWC_INP_type/run_SWC_INP_5ms_sys/INP/CAN6/SignalCheck/FCM1/FCMACCmode"
 /begin REF_CHARACTERISTIC KINP_FCMACCmode_enum_defval KINP_FCMACCmode_enum_ovrdflg KINP_FCMACCmode_enum_ovrdval /end REF_CHARACTERISTIC
/end GROUP
/begin GROUP S4719_FCMLKAStrToqReq "SWC_INP_type/run_SWC_INP_5ms_sys/INP/CAN6/SignalCheck/FCM1/FCMLKAStrToqReq"
 /begin REF_CHARACTERISTIC KINP_FCMLKAStrToqReq_Nm_defval KINP_FCMLKAStrToqReq_Nm_ovrdflg KINP_FCMLKAStrToqReq_Nm_ovrdval /end REF_CHARACTERISTIC
/end GROUP
/begin GROUP S4719_FCMLKATOIAct "SWC_INP_type/run_SWC_INP_5ms_sys/INP/CAN6/SignalCheck/FCM1/FCMLKATOIAct"
 /begin REF_CHARACTERISTIC KINP_FCMLKATOIAct_enum_defval KINP_FCMLKATOIAct_enum_ovrdflg KINP_FCMLKATOIAct_enum_ovrdval /end REF_CHARACTERISTIC
/end GROUP
/begin GROUP S4719_FCMLKATOIFault "SWC_INP_type/run_SWC_INP_5ms_sys/INP/CAN6/SignalCheck/FCM1/FCMLKATOIFault"
 /begin REF_CHARACTERISTIC KINP_FCMLKATOIFault_flg_defval KINP_FCMLKATOIFault_flg_ovrdflg KINP_FCMLKATOIFault_flg_ovrdval /end REF_CHARACTERISTIC
/end GROUP
/begin GROUP S4719_ForceLowBeam "SWC_INP_type/run_SWC_INP_5ms_sys/INP/CAN6/SignalCheck/FCM1/ForceLowBeam"
 /begin REF_CHARACTERISTIC KINP_ForceLowBeam_enum_defval KINP_ForceLowBeam_enum_ovrdflg KINP_ForceLowBeam_enum_ovrdval /end REF_CHARACTERISTIC
/end GROUP
/begin GROUP S4719_HazardWarningReq "SWC_INP_type/run_SWC_INP_5ms_sys/INP/CAN6/SignalCheck/FCM1/HazardWarningReq"
 /begin REF_CHARACTERISTIC KINP_HazardWarningReq_flg_defval KINP_HazardWarningReq_flg_ovrdflg KINP_HazardWarningReq_flg_ovrdval /end REF_CHARACTERISTIC
/end GROUP
/begin GROUP S4719_ISAWarningMsg "SWC_INP_type/run_SWC_INP_5ms_sys/INP/CAN6/SignalCheck/FCM1/ISAWarningMsg"
 /begin REF_CHARACTERISTIC KINP_ISAWarningMsg_enum_defval KINP_ISAWarningMsg_enum_ovrdflg KINP_ISAWarningMsg_enum_ovrdval /end REF_CHARACTERISTIC
/end GROUP
/begin GROUP S4719_LKAHODDisplayWarning "SWC_INP_type/run_SWC_INP_5ms_sys/INP/CAN6/SignalCheck/FCM1/LKAHODDisplayWarning"
 /begin REF_CHARACTERISTIC KINP_LKAHODDisplayWarning_flg_defval KINP_LKAHODDisplayWarning_flg_ovrdflg KINP_LKAHODDisplayWarning_flg_ovrdval /end REF_CHARACTERISTIC
/end GROUP
/begin GROUP S4719_LKAHODSoundWarning "SWC_INP_type/run_SWC_INP_5ms_sys/INP/CAN6/SignalCheck/FCM1/LKAHODSoundWarning"
 /begin REF_CHARACTERISTIC KINP_LKAHODSoundWarning_flg_defval KINP_LKAHODSoundWarning_flg_ovrdflg KINP_LKAHODSoundWarning_flg_ovrdval /end REF_CHARACTERISTIC
/end GROUP
/begin GROUP S4719_LVDAACCStatusInformation "SWC_INP_type/run_SWC_INP_5ms_sys/INP/CAN6/SignalCheck/FCM1/LVDAACCStatusInformation"
 /begin REF_CHARACTERISTIC KINP_LVDAACCStatusInformation_flg_defval KINP_LVDAACCStatusInformation_flg_ovrdflg KINP_LVDAACCStatusInformation_flg_ovrdval /end REF_CHARACTERISTIC
/end GROUP
/begin GROUP S4719_LVDADisabled "SWC_INP_type/run_SWC_INP_5ms_sys/INP/CAN6/SignalCheck/FCM1/LVDADisabled"
 /begin REF_CHARACTERISTIC KINP_LVDADisabled_flg_defval KINP_LVDADisabled_flg_ovrdflg KINP_LVDADisabled_flg_ovrdval /end REF_CHARACTERISTIC
/end GROUP
/begin GROUP S4719_LVDAFailinfo "SWC_INP_type/run_SWC_INP_5ms_sys/INP/CAN6/SignalCheck/FCM1/LVDAFailinfo"
 /begin REF_CHARACTERISTIC KINP_LVDAFailinfo_flg_defval KINP_LVDAFailinfo_flg_ovrdflg KINP_LVDAFailinfo_flg_ovrdval /end REF_CHARACTERISTIC
/end GROUP
/begin GROUP S4719_LVDAMuteSta "SWC_INP_type/run_SWC_INP_5ms_sys/INP/CAN6/SignalCheck/FCM1/LVDAMuteSta"
 /begin REF_CHARACTERISTIC KINP_LVDAMuteSta_enum_defval KINP_LVDAMuteSta_enum_ovrdflg KINP_LVDAMuteSta_enum_ovrdval /end REF_CHARACTERISTIC
/end GROUP
/begin GROUP S4719_LVDAWarning "SWC_INP_type/run_SWC_INP_5ms_sys/INP/CAN6/SignalCheck/FCM1/LVDAWarning"
 /begin REF_CHARACTERISTIC KINP_LVDAWarning_flg_defval KINP_LVDAWarning_flg_ovrdflg KINP_LVDAWarning_flg_ovrdval /end REF_CHARACTERISTIC
/end GROUP
/begin GROUP S4719_LeftTurnLightReq "SWC_INP_type/run_SWC_INP_5ms_sys/INP/CAN6/SignalCheck/FCM1/LeftTurnLightReq"
 /begin REF_CHARACTERISTIC KINP_LeftTurnLightReq_flg_defval KINP_LeftTurnLightReq_flg_ovrdflg KINP_LeftTurnLightReq_flg_ovrdval /end REF_CHARACTERISTIC
/end GROUP
/begin GROUP S4719_RightTurnLightReq "SWC_INP_type/run_SWC_INP_5ms_sys/INP/CAN6/SignalCheck/FCM1/RightTurnLightReq"
 /begin REF_CHARACTERISTIC KINP_RightTurnLightReq_flg_defval KINP_RightTurnLightReq_flg_ovrdflg KINP_RightTurnLightReq_flg_ovrdval /end REF_CHARACTERISTIC
/end GROUP
/begin GROUP S4719_TargetType "SWC_INP_type/run_SWC_INP_5ms_sys/INP/CAN6/SignalCheck/FCM1/TargetType"
 /begin REF_CHARACTERISTIC KINP_TargetType_enum_defval KINP_TargetType_enum_ovrdflg KINP_TargetType_enum_ovrdval /end REF_CHARACTERISTIC
/end GROUP
/begin GROUP S4719_TimeGapLevel "SWC_INP_type/run_SWC_INP_5ms_sys/INP/CAN6/SignalCheck/FCM1/TimeGapLevel"
 /begin REF_CHARACTERISTIC KINP_TimeGapLevel_enum_defval KINP_TimeGapLevel_enum_ovrdflg KINP_TimeGapLevel_enum_ovrdval /end REF_CHARACTERISTIC
/end GROUP
/begin GROUP S4720_ADBVehDst1Val "SWC_INP_type/run_SWC_INP_5ms_sys/INP/CAN6/SignalCheck/FCM2/ADBVehDst1Val"
 /begin REF_CHARACTERISTIC KINP_ADBVehDst1Val_enum_defval KINP_ADBVehDst1Val_enum_ovrdflg KINP_ADBVehDst1Val_enum_ovrdval /end REF_CHARACTERISTIC
/end GROUP
/begin GROUP S4720_FCM2CSErr "SWC_INP_type/run_SWC_INP_5ms_sys/INP/CAN6/SignalCheck/FCM2/FCM2CSErr"
 /begin REF_CHARACTERISTIC KINP_FCM2CSErr_flg_defval KINP_FCM2CSErr_flg_ovrdflg KINP_FCM2CSErr_flg_ovrdval /end REF_CHARACTERISTIC
/end GROUP
/begin GROUP S4720_FCM2RCErr "SWC_INP_type/run_SWC_INP_5ms_sys/INP/CAN6/SignalCheck/FCM2/FCM2RCErr"
 /begin REF_CHARACTERISTIC KINP_FCM2RCErr_flg_defval KINP_FCM2RCErr_flg_ovrdflg KINP_FCM2RCErr_flg_ovrdval /end REF_CHARACTERISTIC
/end GROUP
/begin GROUP S4721_MELaneCurvDervLt "SWC_INP_type/run_SWC_INP_5ms_sys/INP/CAN6/SignalCheck/FCM3/MELaneCurvDervLt"
 /begin REF_CHARACTERISTIC KINP_MELaneCurvDervLt_raw32_defval KINP_MELaneCurvDervLt_raw32_ovrdflg KINP_MELaneCurvDervLt_raw32_ovrdval /end REF_CHARACTERISTIC
/end GROUP
/begin GROUP S4721_MELaneCurvDervLt2 "SWC_INP_type/run_SWC_INP_5ms_sys/INP/CAN6/SignalCheck/FCM3/MELaneCurvDervLt2"
 /begin REF_CHARACTERISTIC KINP_MELaneCurvDervLt2_raw32_defval KINP_MELaneCurvDervLt2_raw32_ovrdflg KINP_MELaneCurvDervLt2_raw32_ovrdval /end REF_CHARACTERISTIC
/end GROUP
/begin GROUP S4721_MELaneCurvDervRt "SWC_INP_type/run_SWC_INP_5ms_sys/INP/CAN6/SignalCheck/FCM3/MELaneCurvDervRt"
 /begin REF_CHARACTERISTIC KINP_MELaneCurvDervRt_raw32_defval KINP_MELaneCurvDervRt_raw32_ovrdflg KINP_MELaneCurvDervRt_raw32_ovrdval /end REF_CHARACTERISTIC
/end GROUP
/begin GROUP S4721_MELaneCurvDervRt2 "SWC_INP_type/run_SWC_INP_5ms_sys/INP/CAN6/SignalCheck/FCM3/MELaneCurvDervRt2"
 /begin REF_CHARACTERISTIC KINP_MELaneCurvDervRt2_raw32_defval KINP_MELaneCurvDervRt2_raw32_ovrdflg KINP_MELaneCurvDervRt2_raw32_ovrdval /end REF_CHARACTERISTIC
/end GROUP
/begin GROUP S4721_MELaneCurvLt "SWC_INP_type/run_SWC_INP_5ms_sys/INP/CAN6/SignalCheck/FCM3/MELaneCurvLt"
 /begin REF_CHARACTERISTIC KINP_MELaneCurvLt_raw32_defval KINP_MELaneCurvLt_raw32_ovrdflg KINP_MELaneCurvLt_raw32_ovrdval /end REF_CHARACTERISTIC
/end GROUP
/begin GROUP S4721_MELaneCurvLt2 "SWC_INP_type/run_SWC_INP_5ms_sys/INP/CAN6/SignalCheck/FCM3/MELaneCurvLt2"
 /begin REF_CHARACTERISTIC KINP_MELaneCurvLt2_raw32_defval KINP_MELaneCurvLt2_raw32_ovrdflg KINP_MELaneCurvLt2_raw32_ovrdval /end REF_CHARACTERISTIC
/end GROUP
/begin GROUP S4721_MELaneCurvRt "SWC_INP_type/run_SWC_INP_5ms_sys/INP/CAN6/SignalCheck/FCM3/MELaneCurvRt"
 /begin REF_CHARACTERISTIC KINP_MELaneCurvRt_raw32_defval KINP_MELaneCurvRt_raw32_ovrdflg KINP_MELaneCurvRt_raw32_ovrdval /end REF_CHARACTERISTIC
/end GROUP
/begin GROUP S4721_MELaneCurvRt2 "SWC_INP_type/run_SWC_INP_5ms_sys/INP/CAN6/SignalCheck/FCM3/MELaneCurvRt2"
 /begin REF_CHARACTERISTIC KINP_MELaneCurvRt2_raw32_defval KINP_MELaneCurvRt2_raw32_ovrdflg KINP_MELaneCurvRt2_raw32_ovrdval /end REF_CHARACTERISTIC
/end GROUP
/begin GROUP S4721_MELaneHeadAngLt "SWC_INP_type/run_SWC_INP_5ms_sys/INP/CAN6/SignalCheck/FCM3/MELaneHeadAngLt"
 /begin REF_CHARACTERISTIC KINP_MELaneHeadAngLt_radians_defval KINP_MELaneHeadAngLt_radians_ovrdflg KINP_MELaneHeadAngLt_radians_ovrdval /end REF_CHARACTERISTIC
/end GROUP
/begin GROUP S4721_MELaneHeadAngLt2 "SWC_INP_type/run_SWC_INP_5ms_sys/INP/CAN6/SignalCheck/FCM3/MELaneHeadAngLt2"
 /begin REF_CHARACTERISTIC KINP_MELaneHeadAngLt2_radians_defval KINP_MELaneHeadAngLt2_radians_ovrdflg KINP_MELaneHeadAngLt2_radians_ovrdval /end REF_CHARACTERISTIC
/end GROUP
/begin GROUP S4721_MELaneHeadAngRt "SWC_INP_type/run_SWC_INP_5ms_sys/INP/CAN6/SignalCheck/FCM3/MELaneHeadAngRt"
 /begin REF_CHARACTERISTIC KINP_MELaneHeadAngRt_radians_defval KINP_MELaneHeadAngRt_radians_ovrdflg KINP_MELaneHeadAngRt_radians_ovrdval /end REF_CHARACTERISTIC
/end GROUP
/begin GROUP S4721_MELaneHeadAngRt2 "SWC_INP_type/run_SWC_INP_5ms_sys/INP/CAN6/SignalCheck/FCM3/MELaneHeadAngRt2"
 /begin REF_CHARACTERISTIC KINP_MELaneHeadAngRt2_radians_defval KINP_MELaneHeadAngRt2_radians_ovrdflg KINP_MELaneHeadAngRt2_radians_ovrdval /end REF_CHARACTERISTIC
/end GROUP
/begin GROUP S4721_MELanePosLt "SWC_INP_type/run_SWC_INP_5ms_sys/INP/CAN6/SignalCheck/FCM3/MELanePosLt"
 /begin REF_CHARACTERISTIC KINP_MELanePosLt_m_defval KINP_MELanePosLt_m_ovrdflg KINP_MELanePosLt_m_ovrdval /end REF_CHARACTERISTIC
/end GROUP
/begin GROUP S4721_MELanePosLt2 "SWC_INP_type/run_SWC_INP_5ms_sys/INP/CAN6/SignalCheck/FCM3/MELanePosLt2"
 /begin REF_CHARACTERISTIC KINP_MELanePosLt2_m_defval KINP_MELanePosLt2_m_ovrdflg KINP_MELanePosLt2_m_ovrdval /end REF_CHARACTERISTIC
/end GROUP
/begin GROUP S4721_MELanePosRt "SWC_INP_type/run_SWC_INP_5ms_sys/INP/CAN6/SignalCheck/FCM3/MELanePosRt"
 /begin REF_CHARACTERISTIC KINP_MELanePosRt_m_defval KINP_MELanePosRt_m_ovrdflg KINP_MELanePosRt_m_ovrdval /end REF_CHARACTERISTIC
/end GROUP
/begin GROUP S4721_MELanePosRt2 "SWC_INP_type/run_SWC_INP_5ms_sys/INP/CAN6/SignalCheck/FCM3/MELanePosRt2"
 /begin REF_CHARACTERISTIC KINP_MELanePosRt2_m_defval KINP_MELanePosRt2_m_ovrdflg KINP_MELanePosRt2_m_ovrdval /end REF_CHARACTERISTIC
/end GROUP
/begin GROUP S4722_ADASAngCtrlTqWeightGain "SWC_INP_type/run_SWC_INP_5ms_sys/INP/CAN6/SignalCheck/FCM4/ADASAngCtrlTqWeightGain"
 /begin REF_CHARACTERISTIC KINP_ADASAngCtrlTqWeightGain_pct_defval KINP_ADASAngCtrlTqWeightGain_pct_ovrdflg KINP_ADASAngCtrlTqWeightGain_pct_ovrdval /end REF_CHARACTERISTIC
/end GROUP
/begin GROUP S4722_ADASDesStrWhlAngCtrlCmd "SWC_INP_type/run_SWC_INP_5ms_sys/INP/CAN6/SignalCheck/FCM4/ADASDesStrWhlAngCtrlCmd"
 /begin REF_CHARACTERISTIC KINP_ADASDesStrWhlAngCtrlCmd_Deg_defval KINP_ADASDesStrWhlAngCtrlCmd_Deg_ovrdflg KINP_ADASDesStrWhlAngCtrlCmd_Deg_ovrdval /end REF_CHARACTERISTIC
/end GROUP
/begin GROUP S4722_ADASDrvInputTqBoostAct "SWC_INP_type/run_SWC_INP_5ms_sys/INP/CAN6/SignalCheck/FCM4/ADASDrvInputTqBoostAct"
 /begin REF_CHARACTERISTIC KINP_ADASDrvInputTqBoostAct_flg_defval KINP_ADASDrvInputTqBoostAct_flg_ovrdflg KINP_ADASDrvInputTqBoostAct_flg_ovrdval /end REF_CHARACTERISTIC
/end GROUP
/begin GROUP S4722_ADASDrvInputTqBoostGain "SWC_INP_type/run_SWC_INP_5ms_sys/INP/CAN6/SignalCheck/FCM4/ADASDrvInputTqBoostGain"
 /begin REF_CHARACTERISTIC KINP_ADASDrvInputTqBoostGain_pct_defval KINP_ADASDrvInputTqBoostGain_pct_ovrdflg KINP_ADASDrvInputTqBoostGain_pct_ovrdval /end REF_CHARACTERISTIC
/end GROUP
/begin GROUP S4722_ADASMaxAngCtrlOutTqLimit "SWC_INP_type/run_SWC_INP_5ms_sys/INP/CAN6/SignalCheck/FCM4/ADASMaxAngCtrlOutTqLimit"
 /begin REF_CHARACTERISTIC KINP_ADASMaxAngCtrlOutTqLimit_Nm_defval KINP_ADASMaxAngCtrlOutTqLimit_Nm_ovrdflg KINP_ADASMaxAngCtrlOutTqLimit_Nm_ovrdval /end REF_CHARACTERISTIC
/end GROUP
/begin GROUP S4722_ADASStrWhlAngCtrlStatus "SWC_INP_type/run_SWC_INP_5ms_sys/INP/CAN6/SignalCheck/FCM4/ADASStrWhlAngCtrlStatus"
 /begin REF_CHARACTERISTIC KINP_ADASStrWhlAngCtrlStatus_flg_defval KINP_ADASStrWhlAngCtrlStatus_flg_ovrdflg KINP_ADASStrWhlAngCtrlStatus_flg_ovrdval /end REF_CHARACTERISTIC
/end GROUP
/begin GROUP S4722_FCM4CSErr "SWC_INP_type/run_SWC_INP_5ms_sys/INP/CAN6/SignalCheck/FCM4/FCM4CSErr"
 /begin REF_CHARACTERISTIC KINP_FCM4CSErr_flg_defval KINP_FCM4CSErr_flg_ovrdflg KINP_FCM4CSErr_flg_ovrdval /end REF_CHARACTERISTIC
/end GROUP
/begin GROUP S4722_FCM4RCErr "SWC_INP_type/run_SWC_INP_5ms_sys/INP/CAN6/SignalCheck/FCM4/FCM4RCErr"
 /begin REF_CHARACTERISTIC KINP_FCM4RCErr_flg_defval KINP_FCM4RCErr_flg_ovrdflg KINP_FCM4RCErr_flg_ovrdval /end REF_CHARACTERISTIC
/end GROUP
/begin GROUP S4723_SRRBSDWarnL "SWC_INP_type/run_SWC_INP_5ms_sys/INP/CAN6/SignalCheck/SRR1/SRRBSDWarnL"
 /begin REF_CHARACTERISTIC KINP_SRRBSDWarnL_enum_defval KINP_SRRBSDWarnL_enum_ovrdflg KINP_SRRBSDWarnL_enum_ovrdval /end REF_CHARACTERISTIC
/end GROUP
/begin GROUP S4723_SRRBSDWarnR "SWC_INP_type/run_SWC_INP_5ms_sys/INP/CAN6/SignalCheck/SRR1/SRRBSDWarnR"
 /begin REF_CHARACTERISTIC KINP_SRRBSDWarnR_enum_defval KINP_SRRBSDWarnR_enum_ovrdflg KINP_SRRBSDWarnR_enum_ovrdval /end REF_CHARACTERISTIC
/end GROUP
/begin GROUP S4723_SRRODASoundL "SWC_INP_type/run_SWC_INP_5ms_sys/INP/CAN6/SignalCheck/SRR1/SRRODASoundL"
 /begin REF_CHARACTERISTIC KINP_SRRODASoundL_flg_defval KINP_SRRODASoundL_flg_ovrdflg KINP_SRRODASoundL_flg_ovrdval /end REF_CHARACTERISTIC
/end GROUP
/begin GROUP S4723_SRRODASoundR "SWC_INP_type/run_SWC_INP_5ms_sys/INP/CAN6/SignalCheck/SRR1/SRRODASoundR"
 /begin REF_CHARACTERISTIC KINP_SRRODASoundR_flg_defval KINP_SRRODASoundR_flg_ovrdflg KINP_SRRODASoundR_flg_ovrdval /end REF_CHARACTERISTIC
/end GROUP
/begin GROUP S4723_SRRODAWarnL "SWC_INP_type/run_SWC_INP_5ms_sys/INP/CAN6/SignalCheck/SRR1/SRRODAWarnL"
 /begin REF_CHARACTERISTIC KINP_SRRODAWarnL_enum_defval KINP_SRRODAWarnL_enum_ovrdflg KINP_SRRODAWarnL_enum_ovrdval /end REF_CHARACTERISTIC
/end GROUP
/begin GROUP S4723_SRRODAWarnR "SWC_INP_type/run_SWC_INP_5ms_sys/INP/CAN6/SignalCheck/SRR1/SRRODAWarnR"
 /begin REF_CHARACTERISTIC KINP_SRRODAWarnR_enum_defval KINP_SRRODAWarnR_enum_ovrdflg KINP_SRRODAWarnR_enum_ovrdval /end REF_CHARACTERISTIC
/end GROUP
/begin GROUP S5223_ad_signal_process "SWC_INP_type/run_SWC_INP_5ms_sys/INP/GPIO/Analog/AccelPedal1Vol_V/ad_signal_process" /begin SUB_GROUP S5225_sig_valid_check /end SUB_GROUP /end GROUP
/begin GROUP S5224_ad_signal_process "SWC_INP_type/run_SWC_INP_5ms_sys/INP/GPIO/Analog/AccelPedal2Vol_V/ad_signal_process" /begin SUB_GROUP S5235_sig_valid_check /end SUB_GROUP /end GROUP
/begin GROUP S5225_sig_valid_check "SWC_INP_type/run_SWC_INP_5ms_sys/INP/GPIO/Analog/AccelPedal1Vol_V/ad_signal_process/sig_valid_check"
 /begin REF_MEASUREMENT VINP_AccelPedal1VolShortHigh_enum VINP_AccelPedal1VolShortLow_enum /end REF_MEASUREMENT
/end GROUP
/begin GROUP S5235_sig_valid_check "SWC_INP_type/run_SWC_INP_5ms_sys/INP/GPIO/Analog/AccelPedal2Vol_V/ad_signal_process/sig_valid_check"
 /begin REF_MEASUREMENT VINP_AccelPedal2VolShortHigh_enum VINP_AccelPedal2VolShortLow_enum /end REF_MEASUREMENT
/end GROUP
/end MODULE
/end PROJECT
