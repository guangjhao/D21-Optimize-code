/******************************************************************************
* ASAP2 file: SWC_HALOUT_type.a2l
* Code generation for model "SWC_HALOUT_type".
* Model version : 1.14
* Simulink Coder version : 9.6 (R2021b) 14-May-2021
* C source code generated on : Tue Jun 10 15:19:26 2025
* Target selection: autosar.tlc
* Embedded hardware selection: ARM Compatible->ARM Cortex-M
* Code generation objectives: Unspecified
* Validation result: Not run
* (add additional file header information here)
******************************************************************************/
/* Version 1.51 */
ASAP2_VERSION 1 51
/begin PROJECT ProjectName "Project Comment Goes Here"
/begin HEADER "Header Comments go here" /end HEADER
/begin MODULE ModuleName "Module Comment Goes Here"
/begin MOD_PAR "MOD PAR Comment Goes Here" /end MOD_PAR
/begin IF_DATA XCP
 /begin PROTOCOL_LAYER 0x0100 0x03E8 0x2710 0 0 0 0 0 0xFF 0x00FF BYTE_ORDER_MSB_LAST ADDRESS_GRANULARITY_BYTE COMMUNICATION_MODE_SUPPORTED BLOCK MASTER 0x2B 0x00 SEED_AND_KEY_EXTERNAL_FUNCTION "SeedNKeyXcp.dll" /end PROTOCOL_LAYER
 /begin DAQ DYNAMIC 0x0000 0x0006 0x00 OPTIMISATION_TYPE_DEFAULT ADDRESS_EXTENSION_FREE IDENTIFICATION_FIELD_TYPE_RELATIVE_BYTE GRANULARITY_ODT_ENTRY_SIZE_DAQ_BYTE 0x06 OVERLOAD_INDICATION_PID PRESCALER_SUPPORTED /begin EVENT "1 ms" "" 0x0000 DAQ 0xFF 0x00 0x06 0x00 /end EVENT /begin EVENT "10 ms" "" 0x0001 DAQ 0xFF 0x00 0x06 0x00 /end EVENT /begin EVENT "100 ms" "" 0x0002 DAQ 0xFF 0x00 0x06 0x00 /end EVENT
  /begin EVENT "on SWC_HALOUT_type calculated" "" 0x0003 DAQ 0xFF 0x00 0x06 0x00 /end EVENT
 /end DAQ
/end IF_DATA
/begin MOD_COMMON "Mod Common Comment Here" BYTE_ORDER MSB_LAST ALIGNMENT_BYTE 1 ALIGNMENT_WORD 1 ALIGNMENT_LONG 1 ALIGNMENT_FLOAT32_IEEE 1 ALIGNMENT_FLOAT64_IEEE 1 /end MOD_COMMON
/* SWC_HALOUT_type data */
/begin FUNCTION run_SWC_HALOUT_UDS_10ms "" /begin DEF_CHARACTERISTIC /end DEF_CHARACTERISTIC /begin IN_MEASUREMENT /end IN_MEASUREMENT /begin OUT_MEASUREMENT /end OUT_MEASUREMENT /end FUNCTION
/begin FUNCTION run_SWC_HALOUT_Tx_5ms "" /begin DEF_CHARACTERISTIC /end DEF_CHARACTERISTIC /begin IN_MEASUREMENT /end IN_MEASUREMENT /begin OUT_MEASUREMENT /end OUT_MEASUREMENT /end FUNCTION
/begin FUNCTION run_SWC_HALOUT_Tx_10ms "" /begin DEF_CHARACTERISTIC /end DEF_CHARACTERISTIC /begin IN_MEASUREMENT /end IN_MEASUREMENT /begin OUT_MEASUREMENT /end OUT_MEASUREMENT /end FUNCTION
/begin FUNCTION run_SWC_HALOUT_Tx_5000ms "" /begin DEF_CHARACTERISTIC /end DEF_CHARACTERISTIC /begin IN_MEASUREMENT /end IN_MEASUREMENT /begin OUT_MEASUREMENT /end OUT_MEASUREMENT /end FUNCTION
/begin FUNCTION run_SWC_HALOUT_Tx_500ms "" /begin DEF_CHARACTERISTIC /end DEF_CHARACTERISTIC /begin IN_MEASUREMENT /end IN_MEASUREMENT /begin OUT_MEASUREMENT /end OUT_MEASUREMENT /end FUNCTION
/begin FUNCTION run_SWC_HALOUT_Tx_20ms "" /begin DEF_CHARACTERISTIC /end DEF_CHARACTERISTIC /begin IN_MEASUREMENT /end IN_MEASUREMENT /begin OUT_MEASUREMENT /end OUT_MEASUREMENT /end FUNCTION
/begin FUNCTION run_SWC_HALOUT_Tx_1000ms "" /begin DEF_CHARACTERISTIC /end DEF_CHARACTERISTIC /begin IN_MEASUREMENT /end IN_MEASUREMENT /begin OUT_MEASUREMENT /end OUT_MEASUREMENT /end FUNCTION
/begin FUNCTION run_SWC_HALOUT_Tx_100ms "" /begin DEF_CHARACTERISTIC /end DEF_CHARACTERISTIC /begin IN_MEASUREMENT /end IN_MEASUREMENT /begin OUT_MEASUREMENT /end OUT_MEASUREMENT /end FUNCTION
/begin FUNCTION R_BSCP_outputs_BSCP_outputs "" /begin DEF_CHARACTERISTIC /end DEF_CHARACTERISTIC /begin IN_MEASUREMENT /end IN_MEASUREMENT /begin OUT_MEASUREMENT /end OUT_MEASUREMENT /end FUNCTION
/begin FUNCTION R_BOUTP_outputs_BOUTP_outputs "" /begin DEF_CHARACTERISTIC /end DEF_CHARACTERISTIC /begin IN_MEASUREMENT /end IN_MEASUREMENT /begin OUT_MEASUREMENT /end OUT_MEASUREMENT /end FUNCTION
/begin FUNCTION R_BHAL_SYS_outputs_BHAL_SYS_outputs "" /begin DEF_CHARACTERISTIC /end DEF_CHARACTERISTIC /begin IN_MEASUREMENT /end IN_MEASUREMENT /begin OUT_MEASUREMENT /end OUT_MEASUREMENT /end FUNCTION
/begin FUNCTION R_BHAL_DID_outputs_BHAL_DID_outputs "" /begin DEF_CHARACTERISTIC /end DEF_CHARACTERISTIC /begin IN_MEASUREMENT /end IN_MEASUREMENT /begin OUT_MEASUREMENT /end OUT_MEASUREMENT /end FUNCTION
/begin FUNCTION R_NVMReadCDD_u8Array1024_NVMReadData "" /begin DEF_CHARACTERISTIC /end DEF_CHARACTERISTIC /begin IN_MEASUREMENT /end IN_MEASUREMENT /begin OUT_MEASUREMENT /end OUT_MEASUREMENT /end FUNCTION
/begin FUNCTION P_AppModeReq_requestedMode "" /begin DEF_CHARACTERISTIC /end DEF_CHARACTERISTIC /begin IN_MEASUREMENT /end IN_MEASUREMENT /begin OUT_MEASUREMENT /end OUT_MEASUREMENT /end FUNCTION
/begin FUNCTION P_CAN1_FD1_BCM1_CAN1_SG_FD1_BCM1 "" /begin DEF_CHARACTERISTIC /end DEF_CHARACTERISTIC /begin IN_MEASUREMENT /end IN_MEASUREMENT /begin OUT_MEASUREMENT /end OUT_MEASUREMENT /end FUNCTION
/begin FUNCTION P_CAN1_FD1_VCU1_CAN1_SG_FD1_VCU1 "" /begin DEF_CHARACTERISTIC /end DEF_CHARACTERISTIC /begin IN_MEASUREMENT /end IN_MEASUREMENT /begin OUT_MEASUREMENT /end OUT_MEASUREMENT /end FUNCTION
/begin FUNCTION P_CAN1_FD1_VMC1_CAN1_SG_FD1_VMC1 "" /begin DEF_CHARACTERISTIC /end DEF_CHARACTERISTIC /begin IN_MEASUREMENT /end IN_MEASUREMENT /begin OUT_MEASUREMENT /end OUT_MEASUREMENT /end FUNCTION
/begin FUNCTION P_CAN2_FD2_CE100_0_CAN2_SG_FD2_CE100_0 "" /begin DEF_CHARACTERISTIC /end DEF_CHARACTERISTIC /begin IN_MEASUREMENT /end IN_MEASUREMENT /begin OUT_MEASUREMENT /end OUT_MEASUREMENT /end FUNCTION
/begin FUNCTION P_CAN2_FD2_CE200_1_CAN2_SG_FD2_CE200_1 "" /begin DEF_CHARACTERISTIC /end DEF_CHARACTERISTIC /begin IN_MEASUREMENT /end IN_MEASUREMENT /begin OUT_MEASUREMENT /end OUT_MEASUREMENT /end FUNCTION
/begin FUNCTION P_CAN2_GW2_CE100_0_CAN2_SG_GW2_CE100_0 "" /begin DEF_CHARACTERISTIC /end DEF_CHARACTERISTIC /begin IN_MEASUREMENT /end IN_MEASUREMENT /begin OUT_MEASUREMENT /end OUT_MEASUREMENT /end FUNCTION
/begin FUNCTION P_CAN2_GW2_CE200_0_CAN2_SG_GW2_CE200_0 "" /begin DEF_CHARACTERISTIC /end DEF_CHARACTERISTIC /begin IN_MEASUREMENT /end IN_MEASUREMENT /begin OUT_MEASUREMENT /end OUT_MEASUREMENT /end FUNCTION
/begin FUNCTION P_CAN3_FD3_BCM1_CAN3_SG_FD3_BCM1 "" /begin DEF_CHARACTERISTIC /end DEF_CHARACTERISTIC /begin IN_MEASUREMENT /end IN_MEASUREMENT /begin OUT_MEASUREMENT /end OUT_MEASUREMENT /end FUNCTION
/begin FUNCTION P_CAN3_FD3_V2L1_CAN3_SG_FD3_V2L1 "" /begin DEF_CHARACTERISTIC /end DEF_CHARACTERISTIC /begin IN_MEASUREMENT /end IN_MEASUREMENT /begin OUT_MEASUREMENT /end OUT_MEASUREMENT /end FUNCTION
/begin FUNCTION P_CAN4_FD4_CE100_1_CAN4_SG_FD4_CE100_1 "" /begin DEF_CHARACTERISTIC /end DEF_CHARACTERISTIC /begin IN_MEASUREMENT /end IN_MEASUREMENT /begin OUT_MEASUREMENT /end OUT_MEASUREMENT /end FUNCTION
/begin FUNCTION P_CAN4_FD4_CE200_0_CAN4_SG_FD4_CE200_0 "" /begin DEF_CHARACTERISTIC /end DEF_CHARACTERISTIC /begin IN_MEASUREMENT /end IN_MEASUREMENT /begin OUT_MEASUREMENT /end OUT_MEASUREMENT /end FUNCTION
/begin FUNCTION P_CAN4_GW4_CE100_0_CAN4_SG_GW4_CE100_0 "" /begin DEF_CHARACTERISTIC /end DEF_CHARACTERISTIC /begin IN_MEASUREMENT /end IN_MEASUREMENT /begin OUT_MEASUREMENT /end OUT_MEASUREMENT /end FUNCTION
/begin FUNCTION P_CAN5_FD5_CE100_0_CAN5_SG_FD5_CE100_0 "" /begin DEF_CHARACTERISTIC /end DEF_CHARACTERISTIC /begin IN_MEASUREMENT /end IN_MEASUREMENT /begin OUT_MEASUREMENT /end OUT_MEASUREMENT /end FUNCTION
/begin FUNCTION P_CAN5_FD5_Debug1_CAN5_SG_FD5_Debug1 "" /begin DEF_CHARACTERISTIC /end DEF_CHARACTERISTIC /begin IN_MEASUREMENT /end IN_MEASUREMENT /begin OUT_MEASUREMENT /end OUT_MEASUREMENT /end FUNCTION
/begin FUNCTION P_CAN5_FD5_Debug2_CAN5_SG_FD5_Debug2 "" /begin DEF_CHARACTERISTIC /end DEF_CHARACTERISTIC /begin IN_MEASUREMENT /end IN_MEASUREMENT /begin OUT_MEASUREMENT /end OUT_MEASUREMENT /end FUNCTION
/begin FUNCTION P_CAN6_FD6_BCM1_CAN6_SG_FD6_BCM1 "" /begin DEF_CHARACTERISTIC /end DEF_CHARACTERISTIC /begin IN_MEASUREMENT /end IN_MEASUREMENT /begin OUT_MEASUREMENT /end OUT_MEASUREMENT /end FUNCTION
/begin FUNCTION P_CAN6_FD6_VCU1_CAN6_SG_FD6_VCU1 "" /begin DEF_CHARACTERISTIC /end DEF_CHARACTERISTIC /begin IN_MEASUREMENT /end IN_MEASUREMENT /begin OUT_MEASUREMENT /end OUT_MEASUREMENT /end FUNCTION
/begin FUNCTION P_CAN6_FD6_VMC1_CAN6_SG_FD6_VMC1 "" /begin DEF_CHARACTERISTIC /end DEF_CHARACTERISTIC /begin IN_MEASUREMENT /end IN_MEASUREMENT /begin OUT_MEASUREMENT /end OUT_MEASUREMENT /end FUNCTION
/begin FUNCTION P_CAN6_GW6_CE100_0_CAN6_SG_GW6_CE100_0 "" /begin DEF_CHARACTERISTIC /end DEF_CHARACTERISTIC /begin IN_MEASUREMENT /end IN_MEASUREMENT /begin OUT_MEASUREMENT /end OUT_MEASUREMENT /end FUNCTION
/begin FUNCTION P_CAN1_FD1_APS3_CAN1_SG_FD1_APS3 "" /begin DEF_CHARACTERISTIC /end DEF_CHARACTERISTIC /begin IN_MEASUREMENT /end IN_MEASUREMENT /begin OUT_MEASUREMENT /end OUT_MEASUREMENT /end FUNCTION
/begin FUNCTION P_CAN1_FD1_VCU2_CAN1_SG_FD1_VCU2 "" /begin DEF_CHARACTERISTIC /end DEF_CHARACTERISTIC /begin IN_MEASUREMENT /end IN_MEASUREMENT /begin OUT_MEASUREMENT /end OUT_MEASUREMENT /end FUNCTION
/begin FUNCTION P_CAN1_FD1_VCU3_CAN1_SG_FD1_VCU3 "" /begin DEF_CHARACTERISTIC /end DEF_CHARACTERISTIC /begin IN_MEASUREMENT /end IN_MEASUREMENT /begin OUT_MEASUREMENT /end OUT_MEASUREMENT /end FUNCTION
/begin FUNCTION P_CAN1_VMC_FCM1_CAN1_SG_VMC_FCM1 "" /begin DEF_CHARACTERISTIC /end DEF_CHARACTERISTIC /begin IN_MEASUREMENT /end IN_MEASUREMENT /begin OUT_MEASUREMENT /end OUT_MEASUREMENT /end FUNCTION
/begin FUNCTION P_CAN3_FD3_VCU0_CAN3_SG_FD3_VCU0 "" /begin DEF_CHARACTERISTIC /end DEF_CHARACTERISTIC /begin IN_MEASUREMENT /end IN_MEASUREMENT /begin OUT_MEASUREMENT /end OUT_MEASUREMENT /end FUNCTION
/begin FUNCTION P_CAN3_FD3_VCU2_CAN3_SG_FD3_VCU2 "" /begin DEF_CHARACTERISTIC /end DEF_CHARACTERISTIC /begin IN_MEASUREMENT /end IN_MEASUREMENT /begin OUT_MEASUREMENT /end OUT_MEASUREMENT /end FUNCTION
/begin FUNCTION P_CAN3_FD3_VCU2_toNIDEC_CAN3_SG_FD3_VCU2_toNIDEC "" /begin DEF_CHARACTERISTIC /end DEF_CHARACTERISTIC /begin IN_MEASUREMENT /end IN_MEASUREMENT /begin OUT_MEASUREMENT /end OUT_MEASUREMENT /end FUNCTION
/begin FUNCTION P_CAN3_FD3_VCU5_CAN3_SG_FD3_VCU5 "" /begin DEF_CHARACTERISTIC /end DEF_CHARACTERISTIC /begin IN_MEASUREMENT /end IN_MEASUREMENT /begin OUT_MEASUREMENT /end OUT_MEASUREMENT /end FUNCTION
/begin FUNCTION P_CAN3_GW_ESC1_toNIDEC_CAN3_SG_GW_ESC1_toNIDEC "" /begin DEF_CHARACTERISTIC /end DEF_CHARACTERISTIC /begin IN_MEASUREMENT /end IN_MEASUREMENT /begin OUT_MEASUREMENT /end OUT_MEASUREMENT /end FUNCTION
/begin FUNCTION P_CAN5_FD5_Debug3_CAN5_SG_FD5_Debug3 "" /begin DEF_CHARACTERISTIC /end DEF_CHARACTERISTIC /begin IN_MEASUREMENT /end IN_MEASUREMENT /begin OUT_MEASUREMENT /end OUT_MEASUREMENT /end FUNCTION
/begin FUNCTION P_CAN6_FD6_APS3_CAN6_SG_FD6_APS3 "" /begin DEF_CHARACTERISTIC /end DEF_CHARACTERISTIC /begin IN_MEASUREMENT /end IN_MEASUREMENT /begin OUT_MEASUREMENT /end OUT_MEASUREMENT /end FUNCTION
/begin FUNCTION P_CAN6_FD6_VCU2_CAN6_SG_FD6_VCU2 "" /begin DEF_CHARACTERISTIC /end DEF_CHARACTERISTIC /begin IN_MEASUREMENT /end IN_MEASUREMENT /begin OUT_MEASUREMENT /end OUT_MEASUREMENT /end FUNCTION
/begin FUNCTION P_NVMWrite_NV_FVTDataArray "" /begin DEF_CHARACTERISTIC /end DEF_CHARACTERISTIC /begin IN_MEASUREMENT /end IN_MEASUREMENT /begin OUT_MEASUREMENT /end OUT_MEASUREMENT /end FUNCTION
/begin FUNCTION P_CAN4_FD4_CE100_0_CAN4_SG_FD4_CE100_0 "" /begin DEF_CHARACTERISTIC /end DEF_CHARACTERISTIC /begin IN_MEASUREMENT /end IN_MEASUREMENT /begin OUT_MEASUREMENT /end OUT_MEASUREMENT /end FUNCTION
/begin FUNCTION P_CAN3_FD3_VCU1_toNIDEC_CAN3_SG_FD3_VCU1_toNIDEC "" /begin DEF_CHARACTERISTIC /end DEF_CHARACTERISTIC /begin IN_MEASUREMENT /end IN_MEASUREMENT /begin OUT_MEASUREMENT /end OUT_MEASUREMENT /end FUNCTION
/begin FUNCTION P_CAN3_FD3_VCU1_CAN3_SG_FD3_VCU1 "" /begin DEF_CHARACTERISTIC /end DEF_CHARACTERISTIC /begin IN_MEASUREMENT /end IN_MEASUREMENT /begin OUT_MEASUREMENT /end OUT_MEASUREMENT /end FUNCTION
/begin FUNCTION P_CAN2_FD2_Version_CAN2_SG_FD2_Version "" /begin DEF_CHARACTERISTIC /end DEF_CHARACTERISTIC /begin IN_MEASUREMENT /end IN_MEASUREMENT /begin OUT_MEASUREMENT /end OUT_MEASUREMENT /end FUNCTION
/begin FUNCTION P_CAN1_FD1_VMC2_CAN1_SG_FD1_VMC2 "" /begin DEF_CHARACTERISTIC /end DEF_CHARACTERISTIC /begin IN_MEASUREMENT /end IN_MEASUREMENT /begin OUT_MEASUREMENT /end OUT_MEASUREMENT /end FUNCTION
/begin FUNCTION P_CAN1_FD1_APS2_CAN1_SG_FD1_APS2 "" /begin DEF_CHARACTERISTIC /end DEF_CHARACTERISTIC /begin IN_MEASUREMENT /end IN_MEASUREMENT /begin OUT_MEASUREMENT /end OUT_MEASUREMENT /end FUNCTION
/begin FUNCTION P_CAN2_FD2_C20_0_CAN2_SG_FD2_C20_0 "" /begin DEF_CHARACTERISTIC /end DEF_CHARACTERISTIC /begin IN_MEASUREMENT /end IN_MEASUREMENT /begin OUT_MEASUREMENT /end OUT_MEASUREMENT /end FUNCTION
/begin FUNCTION P_CAN3_GW_IVI6_toNIDEC_CAN3_SG_GW_IVI6_toNIDEC "" /begin DEF_CHARACTERISTIC /end DEF_CHARACTERISTIC /begin IN_MEASUREMENT /end IN_MEASUREMENT /begin OUT_MEASUREMENT /end OUT_MEASUREMENT /end FUNCTION
/begin FUNCTION P_CAN1_FD1_THCM1_CAN1_SG_FD1_THCM1 "" /begin DEF_CHARACTERISTIC /end DEF_CHARACTERISTIC /begin IN_MEASUREMENT /end IN_MEASUREMENT /begin OUT_MEASUREMENT /end OUT_MEASUREMENT /end FUNCTION
/begin FUNCTION P_CAN2_GW2_CE100_1_CAN2_SG_GW2_CE100_1 "" /begin DEF_CHARACTERISTIC /end DEF_CHARACTERISTIC /begin IN_MEASUREMENT /end IN_MEASUREMENT /begin OUT_MEASUREMENT /end OUT_MEASUREMENT /end FUNCTION
/begin FUNCTION P_CAN3_FD3_C100_0_CAN3_SG_FD3_C100_0 "" /begin DEF_CHARACTERISTIC /end DEF_CHARACTERISTIC /begin IN_MEASUREMENT /end IN_MEASUREMENT /begin OUT_MEASUREMENT /end OUT_MEASUREMENT /end FUNCTION
/begin FUNCTION P_CAN5_GW5_CE100_0_CAN5_SG_GW5_CE100_0 "" /begin DEF_CHARACTERISTIC /end DEF_CHARACTERISTIC /begin IN_MEASUREMENT /end IN_MEASUREMENT /begin OUT_MEASUREMENT /end OUT_MEASUREMENT /end FUNCTION
/begin FUNCTION P_WDGCDD "" /begin SUB_FUNCTION run_SWC_HALOUT_AppCallWDG_End_sys /end SUB_FUNCTION /begin DEF_CHARACTERISTIC /end DEF_CHARACTERISTIC /begin IN_MEASUREMENT /end IN_MEASUREMENT /begin OUT_MEASUREMENT /end OUT_MEASUREMENT /end FUNCTION
/begin FUNCTION SWC_HALOUT_type_Init "" /begin SUB_FUNCTION /end SUB_FUNCTION /begin DEF_CHARACTERISTIC /end DEF_CHARACTERISTIC /begin IN_MEASUREMENT /end IN_MEASUREMENT /begin OUT_MEASUREMENT /end OUT_MEASUREMENT /end FUNCTION
/begin FUNCTION run_SWC_HALOUT_AppCallSleep_sys ""
 /begin SUB_FUNCTION P_AppModeReq_requestedMode_write Constant Data_Type_Conversion Data_Type_Conversion1 /end SUB_FUNCTION
 /begin DEF_CHARACTERISTIC /end DEF_CHARACTERISTIC
 /begin IN_MEASUREMENT /end IN_MEASUREMENT
 /begin OUT_MEASUREMENT /end OUT_MEASUREMENT
/end FUNCTION
/begin FUNCTION run_SWC_HALOUT_E2E_Write_CAN3VCU1_sys "" /begin SUB_FUNCTION P_CAN3_FD3_VCU1_CAN3_SG_FD3_VCU1_write /end SUB_FUNCTION /begin DEF_CHARACTERISTIC /end DEF_CHARACTERISTIC /begin IN_MEASUREMENT /end IN_MEASUREMENT /begin OUT_MEASUREMENT /end OUT_MEASUREMENT /end FUNCTION
/begin FUNCTION run_SWC_HALOUT_E2E_Write_CAN3VCU1_toNIDEC_sys "" /begin SUB_FUNCTION P_CAN3_FD3_VCU1_toNIDEC_CAN3_SG_FD3_VCU1_toNIDEC_write /end SUB_FUNCTION /begin DEF_CHARACTERISTIC /end DEF_CHARACTERISTIC /begin IN_MEASUREMENT /end IN_MEASUREMENT /begin OUT_MEASUREMENT /end OUT_MEASUREMENT /end FUNCTION
/begin FUNCTION run_SWC_HALOUT_E2E_Write_CAN4VCU1_sys "" /begin SUB_FUNCTION P_CAN4_FD4_CE100_0_CAN4_SG_FD4_CE100_0_write /end SUB_FUNCTION /begin DEF_CHARACTERISTIC /end DEF_CHARACTERISTIC /begin IN_MEASUREMENT /end IN_MEASUREMENT /begin OUT_MEASUREMENT /end OUT_MEASUREMENT /end FUNCTION
/begin FUNCTION run_SWC_HALOUT_NvmWrite_sys "" /begin SUB_FUNCTION P_NVMWrite_NV_FVTDataArray_write /end SUB_FUNCTION /begin DEF_CHARACTERISTIC /end DEF_CHARACTERISTIC /begin IN_MEASUREMENT /end IN_MEASUREMENT /begin OUT_MEASUREMENT /end OUT_MEASUREMENT /end FUNCTION
/begin FUNCTION run_SWC_HALOUT_Tx_1000ms_sys "" /begin SUB_FUNCTION P_CAN3_GW_IVI6_toNIDEC_CAN3_SG_GW_IVI6_toNIDEC_write /end SUB_FUNCTION /begin DEF_CHARACTERISTIC /end DEF_CHARACTERISTIC /begin IN_MEASUREMENT /end IN_MEASUREMENT /begin OUT_MEASUREMENT /end OUT_MEASUREMENT /end FUNCTION
/begin FUNCTION run_SWC_HALOUT_Tx_100ms_sys ""
 /begin SUB_FUNCTION P_CAN1_FD1_THCM1_CAN1_SG_FD1_THCM1_write P_CAN2_GW2_CE100_1_CAN2_SG_GW2_CE100_1_write P_CAN3_FD3_C100_0_CAN3_SG_FD3_C100_0_write P_CAN5_GW5_CE100_0_CAN5_SG_GW5_CE100_0_write /end SUB_FUNCTION
 /begin DEF_CHARACTERISTIC /end DEF_CHARACTERISTIC
 /begin IN_MEASUREMENT /end IN_MEASUREMENT
 /begin OUT_MEASUREMENT /end OUT_MEASUREMENT
/end FUNCTION
/begin FUNCTION run_SWC_HALOUT_Tx_10ms_sys ""
 /begin SUB_FUNCTION P_CAN1_FD1_APS3_CAN1_SG_FD1_APS3_write P_CAN1_FD1_VCU2_CAN1_SG_FD1_VCU2_write P_CAN1_FD1_VCU3_CAN1_SG_FD1_VCU3_write P_CAN1_VMC_FCM1_CAN1_SG_VMC_FCM1_write P_CAN3_FD3_VCU0_CAN3_SG_FD3_VCU0_write P_CAN3_FD3_VCU2_CAN3_SG_FD3_VCU2_write P_CAN3_FD3_VCU2_toNIDEC_CAN3_SG_FD3_VCU2_toNIDEC_write P_CAN3_FD3_VCU5_CAN3_SG_FD3_VCU5_write P_CAN3_GW_ESC1_toNIDEC_CAN3_SG_GW_ESC1_toNIDEC_write P_CAN5_FD5_Debug3_CAN5_SG_FD5_Debug3_write P_CAN6_FD6_APS3_CAN6_SG_FD6_APS3_write P_CAN6_FD6_VCU2_CAN6_SG_FD6_VCU2_write /end SUB_FUNCTION
 /begin DEF_CHARACTERISTIC /end DEF_CHARACTERISTIC
 /begin IN_MEASUREMENT /end IN_MEASUREMENT
 /begin OUT_MEASUREMENT /end OUT_MEASUREMENT
/end FUNCTION
/begin FUNCTION run_SWC_HALOUT_Tx_20ms_sys ""
 /begin SUB_FUNCTION P_CAN1_FD1_APS2_CAN1_SG_FD1_APS2_write P_CAN2_FD2_C20_0_CAN2_SG_FD2_C20_0_write /end SUB_FUNCTION
 /begin DEF_CHARACTERISTIC /end DEF_CHARACTERISTIC
 /begin IN_MEASUREMENT /end IN_MEASUREMENT
 /begin OUT_MEASUREMENT /end OUT_MEASUREMENT
/end FUNCTION
/begin FUNCTION run_SWC_HALOUT_Tx_5000ms_sys "" /begin SUB_FUNCTION P_CAN2_FD2_Version_CAN2_SG_FD2_Version_write /end SUB_FUNCTION /begin DEF_CHARACTERISTIC /end DEF_CHARACTERISTIC /begin IN_MEASUREMENT /end IN_MEASUREMENT /begin OUT_MEASUREMENT /end OUT_MEASUREMENT /end FUNCTION
/begin FUNCTION run_SWC_HALOUT_Tx_500ms_sys "" /begin SUB_FUNCTION P_CAN1_FD1_VMC2_CAN1_SG_FD1_VMC2_write /end SUB_FUNCTION /begin DEF_CHARACTERISTIC /end DEF_CHARACTERISTIC /begin IN_MEASUREMENT /end IN_MEASUREMENT /begin OUT_MEASUREMENT /end OUT_MEASUREMENT /end FUNCTION
/begin FUNCTION run_SWC_HALOUT_Tx_5ms_sys ""
 /begin SUB_FUNCTION DIDSet_Subsystem HALOUT_AFTER HAL_OUT OUTP_AFTER R_DIDWriteCDD_CSOP_DIDSet_NVMPedalZP R_FDCCDD_Inner_CSOP_FDC_AppCallSleep R_HALOUTCDD_CSOP_AppNmStateReq R_HALOUTCDD_CSOP_ResetPedalZeroPosDone R_HALOUTCDD_CSOP_SetAcoreRebootCmdACK R_HALOUTCDD_CSOP_SleepRequest R_HALOUTCDD_CSOP_TPMSSensorIDRegSetResults R_IOExpOUT_CDD_CSOP_IOExpSetVal R_NVMWriteCDD_Inner_NVM_WriteOperation R_UDSCDD_CSOP_DdmRestartOperationCycle R_UDSCDD_CSOP_SetDTCStatus R_WDGCDD_CSOP_Call_WDG_AppEnd detect_change detect_change1 hcu_main_sched Constant5 Data_Type_Conversion1 Data_Type_Conversion125 Data_Type_Conversion2 Data_Type_Conversion3 Data_Type_Conversion4 Data_Type_Conversion5 R_HALOUTCDD_CSOP_SetHazardIND R_HALOUTCDD_CSOP_SetSysPwrStat NOT Unit_Delay Unit_Delay1 Unit_Delay2 Unit_Delay4 /end SUB_FUNCTION
 /begin DEF_CHARACTERISTIC /end DEF_CHARACTERISTIC
 /begin IN_MEASUREMENT /end IN_MEASUREMENT
 /begin OUT_MEASUREMENT /end OUT_MEASUREMENT
/end FUNCTION
/begin FUNCTION run_SWC_HALOUT_UDS_10ms_sys "" /begin SUB_FUNCTION R_HALINCDD_CSOP_UDS_Main /end SUB_FUNCTION /begin DEF_CHARACTERISTIC /end DEF_CHARACTERISTIC /begin IN_MEASUREMENT /end IN_MEASUREMENT /begin OUT_MEASUREMENT /end OUT_MEASUREMENT /end FUNCTION
/begin FUNCTION run_SWC_HALOUT_AppCallWDG_End_sys "" /begin SUB_FUNCTION /end SUB_FUNCTION /begin DEF_CHARACTERISTIC /end DEF_CHARACTERISTIC /begin IN_MEASUREMENT /end IN_MEASUREMENT /begin OUT_MEASUREMENT /end OUT_MEASUREMENT /end FUNCTION
/begin FUNCTION P_AppModeReq_requestedMode_write "" /begin DEF_CHARACTERISTIC /end DEF_CHARACTERISTIC /begin IN_MEASUREMENT /end IN_MEASUREMENT /begin OUT_MEASUREMENT /end OUT_MEASUREMENT /end FUNCTION
/begin FUNCTION Constant "" /begin DEF_CHARACTERISTIC /end DEF_CHARACTERISTIC /begin IN_MEASUREMENT /end IN_MEASUREMENT /begin OUT_MEASUREMENT /end OUT_MEASUREMENT /end FUNCTION
/begin FUNCTION Data_Type_Conversion "" /begin DEF_CHARACTERISTIC /end DEF_CHARACTERISTIC /begin IN_MEASUREMENT /end IN_MEASUREMENT /begin OUT_MEASUREMENT /end OUT_MEASUREMENT /end FUNCTION
/begin FUNCTION Data_Type_Conversion1 "" /begin DEF_CHARACTERISTIC /end DEF_CHARACTERISTIC /begin IN_MEASUREMENT /end IN_MEASUREMENT /begin OUT_MEASUREMENT /end OUT_MEASUREMENT /end FUNCTION
/begin FUNCTION P_CAN3_FD3_VCU1_CAN3_SG_FD3_VCU1_write "" /begin DEF_CHARACTERISTIC /end DEF_CHARACTERISTIC /begin IN_MEASUREMENT /end IN_MEASUREMENT /begin OUT_MEASUREMENT /end OUT_MEASUREMENT /end FUNCTION
/begin FUNCTION P_CAN3_FD3_VCU1_toNIDEC_CAN3_SG_FD3_VCU1_toNIDEC_write "" /begin DEF_CHARACTERISTIC /end DEF_CHARACTERISTIC /begin IN_MEASUREMENT /end IN_MEASUREMENT /begin OUT_MEASUREMENT /end OUT_MEASUREMENT /end FUNCTION
/begin FUNCTION P_CAN4_FD4_CE100_0_CAN4_SG_FD4_CE100_0_write "" /begin DEF_CHARACTERISTIC /end DEF_CHARACTERISTIC /begin IN_MEASUREMENT /end IN_MEASUREMENT /begin OUT_MEASUREMENT /end OUT_MEASUREMENT /end FUNCTION
/begin FUNCTION P_NVMWrite_NV_FVTDataArray_write "" /begin DEF_CHARACTERISTIC /end DEF_CHARACTERISTIC /begin IN_MEASUREMENT /end IN_MEASUREMENT /begin OUT_MEASUREMENT /end OUT_MEASUREMENT /end FUNCTION
/begin FUNCTION P_CAN3_GW_IVI6_toNIDEC_CAN3_SG_GW_IVI6_toNIDEC_write "" /begin DEF_CHARACTERISTIC /end DEF_CHARACTERISTIC /begin IN_MEASUREMENT /end IN_MEASUREMENT /begin OUT_MEASUREMENT /end OUT_MEASUREMENT /end FUNCTION
/begin FUNCTION P_CAN1_FD1_THCM1_CAN1_SG_FD1_THCM1_write "" /begin DEF_CHARACTERISTIC /end DEF_CHARACTERISTIC /begin IN_MEASUREMENT /end IN_MEASUREMENT /begin OUT_MEASUREMENT /end OUT_MEASUREMENT /end FUNCTION
/begin FUNCTION P_CAN2_GW2_CE100_1_CAN2_SG_GW2_CE100_1_write "" /begin DEF_CHARACTERISTIC /end DEF_CHARACTERISTIC /begin IN_MEASUREMENT /end IN_MEASUREMENT /begin OUT_MEASUREMENT /end OUT_MEASUREMENT /end FUNCTION
/begin FUNCTION P_CAN3_FD3_C100_0_CAN3_SG_FD3_C100_0_write "" /begin DEF_CHARACTERISTIC /end DEF_CHARACTERISTIC /begin IN_MEASUREMENT /end IN_MEASUREMENT /begin OUT_MEASUREMENT /end OUT_MEASUREMENT /end FUNCTION
/begin FUNCTION P_CAN5_GW5_CE100_0_CAN5_SG_GW5_CE100_0_write "" /begin DEF_CHARACTERISTIC /end DEF_CHARACTERISTIC /begin IN_MEASUREMENT /end IN_MEASUREMENT /begin OUT_MEASUREMENT /end OUT_MEASUREMENT /end FUNCTION
/begin FUNCTION P_CAN1_FD1_APS3_CAN1_SG_FD1_APS3_write "" /begin DEF_CHARACTERISTIC /end DEF_CHARACTERISTIC /begin IN_MEASUREMENT /end IN_MEASUREMENT /begin OUT_MEASUREMENT /end OUT_MEASUREMENT /end FUNCTION
/begin FUNCTION P_CAN1_FD1_VCU2_CAN1_SG_FD1_VCU2_write "" /begin DEF_CHARACTERISTIC /end DEF_CHARACTERISTIC /begin IN_MEASUREMENT /end IN_MEASUREMENT /begin OUT_MEASUREMENT /end OUT_MEASUREMENT /end FUNCTION
/begin FUNCTION P_CAN1_FD1_VCU3_CAN1_SG_FD1_VCU3_write "" /begin DEF_CHARACTERISTIC /end DEF_CHARACTERISTIC /begin IN_MEASUREMENT /end IN_MEASUREMENT /begin OUT_MEASUREMENT /end OUT_MEASUREMENT /end FUNCTION
/begin FUNCTION P_CAN1_VMC_FCM1_CAN1_SG_VMC_FCM1_write "" /begin DEF_CHARACTERISTIC /end DEF_CHARACTERISTIC /begin IN_MEASUREMENT /end IN_MEASUREMENT /begin OUT_MEASUREMENT /end OUT_MEASUREMENT /end FUNCTION
/begin FUNCTION P_CAN3_FD3_VCU0_CAN3_SG_FD3_VCU0_write "" /begin DEF_CHARACTERISTIC /end DEF_CHARACTERISTIC /begin IN_MEASUREMENT /end IN_MEASUREMENT /begin OUT_MEASUREMENT /end OUT_MEASUREMENT /end FUNCTION
/begin FUNCTION P_CAN3_FD3_VCU2_CAN3_SG_FD3_VCU2_write "" /begin DEF_CHARACTERISTIC /end DEF_CHARACTERISTIC /begin IN_MEASUREMENT /end IN_MEASUREMENT /begin OUT_MEASUREMENT /end OUT_MEASUREMENT /end FUNCTION
/begin FUNCTION P_CAN3_FD3_VCU2_toNIDEC_CAN3_SG_FD3_VCU2_toNIDEC_write "" /begin DEF_CHARACTERISTIC /end DEF_CHARACTERISTIC /begin IN_MEASUREMENT /end IN_MEASUREMENT /begin OUT_MEASUREMENT /end OUT_MEASUREMENT /end FUNCTION
/begin FUNCTION P_CAN3_FD3_VCU5_CAN3_SG_FD3_VCU5_write "" /begin DEF_CHARACTERISTIC /end DEF_CHARACTERISTIC /begin IN_MEASUREMENT /end IN_MEASUREMENT /begin OUT_MEASUREMENT /end OUT_MEASUREMENT /end FUNCTION
/begin FUNCTION P_CAN3_GW_ESC1_toNIDEC_CAN3_SG_GW_ESC1_toNIDEC_write "" /begin DEF_CHARACTERISTIC /end DEF_CHARACTERISTIC /begin IN_MEASUREMENT /end IN_MEASUREMENT /begin OUT_MEASUREMENT /end OUT_MEASUREMENT /end FUNCTION
/begin FUNCTION P_CAN5_FD5_Debug3_CAN5_SG_FD5_Debug3_write "" /begin DEF_CHARACTERISTIC /end DEF_CHARACTERISTIC /begin IN_MEASUREMENT /end IN_MEASUREMENT /begin OUT_MEASUREMENT /end OUT_MEASUREMENT /end FUNCTION
/begin FUNCTION P_CAN6_FD6_APS3_CAN6_SG_FD6_APS3_write "" /begin DEF_CHARACTERISTIC /end DEF_CHARACTERISTIC /begin IN_MEASUREMENT /end IN_MEASUREMENT /begin OUT_MEASUREMENT /end OUT_MEASUREMENT /end FUNCTION
/begin FUNCTION P_CAN6_FD6_VCU2_CAN6_SG_FD6_VCU2_write "" /begin DEF_CHARACTERISTIC /end DEF_CHARACTERISTIC /begin IN_MEASUREMENT /end IN_MEASUREMENT /begin OUT_MEASUREMENT /end OUT_MEASUREMENT /end FUNCTION
/begin FUNCTION P_CAN1_FD1_APS2_CAN1_SG_FD1_APS2_write "" /begin DEF_CHARACTERISTIC /end DEF_CHARACTERISTIC /begin IN_MEASUREMENT /end IN_MEASUREMENT /begin OUT_MEASUREMENT /end OUT_MEASUREMENT /end FUNCTION
/begin FUNCTION P_CAN2_FD2_C20_0_CAN2_SG_FD2_C20_0_write "" /begin DEF_CHARACTERISTIC /end DEF_CHARACTERISTIC /begin IN_MEASUREMENT /end IN_MEASUREMENT /begin OUT_MEASUREMENT /end OUT_MEASUREMENT /end FUNCTION
/begin FUNCTION P_CAN2_FD2_Version_CAN2_SG_FD2_Version_write "" /begin DEF_CHARACTERISTIC /end DEF_CHARACTERISTIC /begin IN_MEASUREMENT /end IN_MEASUREMENT /begin OUT_MEASUREMENT /end OUT_MEASUREMENT /end FUNCTION
/begin FUNCTION P_CAN1_FD1_VMC2_CAN1_SG_FD1_VMC2_write "" /begin DEF_CHARACTERISTIC /end DEF_CHARACTERISTIC /begin IN_MEASUREMENT /end IN_MEASUREMENT /begin OUT_MEASUREMENT /end OUT_MEASUREMENT /end FUNCTION
/begin FUNCTION DIDSet_Subsystem ""
 /begin SUB_FUNCTION DIDLen DIDLen1 DIDLen10 DIDLen11 DIDLen12 DIDLen13 DIDLen14 DIDLen15 DIDLen16 DIDLen17 DIDLen18 DIDLen19 DIDLen2 DIDLen20 DIDLen21 DIDLen22 DIDLen23 DIDLen24 DIDLen25 DIDLen26 DIDLen27 DIDLen28 DIDLen29 DIDLen3 DIDLen30 DIDLen31 DIDLen32 DIDLen33 DIDLen34 DIDLen35 DIDLen36 DIDLen37 DIDLen38 DIDLen39 DIDLen4 DIDLen40 DIDLen41 DIDLen42 DIDLen43 DIDLen44 DIDLen45 DIDLen46 DIDLen47 DIDLen48 DIDLen49 DIDLen5 DIDLen50 DIDLen51 DIDLen52 DIDLen53 DIDLen54 DIDLen6 DIDLen7 DIDLen8 DIDLen9 DIDNum DIDNum1 DIDNum10 DIDNum11 DIDNum12 DIDNum13 DIDNum14 DIDNum15 DIDNum16 DIDNum17 DIDNum18 DIDNum19 DIDNum2 DIDNum20 DIDNum21 DIDNum22 DIDNum23 DIDNum24 DIDNum25 DIDNum26 DIDNum27 DIDNum28 DIDNum29 DIDNum3 DIDNum30 DIDNum31 DIDNum32 DIDNum33 DIDNum34 DIDNum35 DIDNum36 DIDNum37 DIDNum38 DIDNum39 DIDNum4 DIDNum40 DIDNum41 DIDNum42 DIDNum43 DIDNum44 DIDNum45 DIDNum46 DIDNum47 DIDNum48 DIDNum49 DIDNum5 DIDNum50 DIDNum51 DIDNum52 DIDNum53 DIDNum54 DIDNum6 DIDNum7 DIDNum8 DIDNum9 R_DIDWriteCDD_CSOP_DIDSet_APPD R_DIDWriteCDD_CSOP_DIDSet_APPE R_DIDWriteCDD_CSOP_DIDSet_APPPedalZP R_DIDWriteCDD_CSOP_DIDSet_APSFunConfig R_DIDWriteCDD_CSOP_DIDSet_AutoLock R_DIDWriteCDD_CSOP_DIDSet_AutoWipHSpdEN R_DIDWriteCDD_CSOP_DIDSet_CALID R_DIDWriteCDD_CSOP_DIDSet_CDEODT R_DIDWriteCDD_CSOP_DIDSet_CLRDIST R_DIDWriteCDD_CSOP_DIDSet_DKCBLESta R_DIDWriteCDD_CSOP_DIDSet_DKCKey R_DIDWriteCDD_CSOP_DIDSet_DKCSta R_DIDWriteCDD_CSOP_DIDSet_DRLDis R_DIDWriteCDD_CSOP_DIDSet_DoorNFCAnchorSta R_DIDWriteCDD_CSOP_DIDSet_DynoMode R_DIDWriteCDD_CSOP_DIDSet_ECUNAME R_DIDWriteCDD_CSOP_DIDSet_FDDKCCoordXY R_DIDWriteCDD_CSOP_DIDSet_FMHTimer R_DIDWriteCDD_CSOP_DIDSet_LFLowPresThre R_DIDWriteCDD_CSOP_DIDSet_LFSensorID R_DIDWriteCDD_CSOP_DIDSet_LIDAAnchorSta R_DIDWriteCDD_CSOP_DIDSet_LRLowPresThre R_DIDWriteCDD_CSOP_DIDSet_LRSensorID R_DIDWriteCDD_CSOP_DIDSet_MILDIST R_DIDWriteCDD_CSOP_DIDSet_NUMPSATRIPSFLTMEMCLR R_DIDWriteCDD_CSOP_DIDSet_OBDReq R_DIDWriteCDD_CSOP_DIDSet_ODOMETER R_DIDWriteCDD_CSOP_DIDSet_PKE R_DIDWriteCDD_CSOP_DIDSet_PSA R_DIDWriteCDD_CSOP_DIDSet_ProtocolId R_DIDWriteCDD_CSOP_DIDSet_QTYPSATRIPS R_DIDWriteCDD_CSOP_DIDSet_RFLowPresThre R_DIDWriteCDD_CSOP_DIDSet_RFSensorID R_DIDWriteCDD_CSOP_DIDSet_RRLowPresThre R_DIDWriteCDD_CSOP_DIDSet_RRSensorID R_DIDWriteCDD_CSOP_DIDSet_RUNTM R_DIDWriteCDD_CSOP_DIDSet_SensorMode R_DIDWriteCDD_CSOP_DIDSet_TPMSLearnSta R_DIDWriteCDD_CSOP_DIDSet_TestGroup R_DIDWriteCDD_CSOP_DIDSet_TireSize R_DIDWriteCDD_CSOP_DIDSet_TurnLampFLThreCurr R_DIDWriteCDD_CSOP_DIDSet_TurnLampFRThreCurr R_DIDWriteCDD_CSOP_DIDSet_TurnLampRLThreCurr R_DIDWriteCDD_CSOP_DIDSet_TurnLampRRThreCurr R_DIDWriteCDD_CSOP_DIDSet_UIDSta R_DIDWriteCDD_CSOP_DIDSet_USSConfig R_DIDWriteCDD_CSOP_DIDSet_UWBAnchorSta R_DIDWriteCDD_CSOP_DIDSet_VIN R_DIDWriteCDD_CSOP_DIDSet_VSS R_DIDWriteCDD_CSOP_DIDSet_WhlPres R_DIDWriteCDD_CSOP_DIDSet_WhlSensorBattSta R_DIDWriteCDD_CSOP_DIDSet_WhlTmp R_DIDWriteCDD_CSOP_DIDSet_WipRLSCmdCutFilter R_DIDWriteCDD_CSOP_DIDSet_WipRLSCmdHoldFilter R_DIDWriteCDD_CSOP_DIDSet_XWDMode /end SUB_FUNCTION
 /begin DEF_CHARACTERISTIC /end DEF_CHARACTERISTIC
 /begin IN_MEASUREMENT /end IN_MEASUREMENT
 /begin OUT_MEASUREMENT /end OUT_MEASUREMENT
/end FUNCTION
/begin FUNCTION HALOUT_AFTER ""
 /begin SUB_FUNCTION R_E2E_CAN3_VCU1_CSOP_Write_CAN3_VCU1 R_E2E_CAN3_VCU1_toNIDEC_CSOP_Write_CAN3_VCU1_toNIDEC R_E2E_CAN4_VCU1_CSOP_Write_CAN4_VCU1 /end SUB_FUNCTION
 /begin DEF_CHARACTERISTIC /end DEF_CHARACTERISTIC
 /begin IN_MEASUREMENT /end IN_MEASUREMENT
 /begin OUT_MEASUREMENT /end OUT_MEASUREMENT
/end FUNCTION
/begin FUNCTION HAL_OUT ""
 /begin SUB_FUNCTION CAN1 CAN2 CAN3 CAN4 CAN5 CAN6 CAN_Scheduler Constant Constant1 Constant2 Constant3 Constant4 Constant5 /end SUB_FUNCTION
 /begin DEF_CHARACTERISTIC /end DEF_CHARACTERISTIC
 /begin IN_MEASUREMENT /end IN_MEASUREMENT
 /begin OUT_MEASUREMENT /end OUT_MEASUREMENT
/end FUNCTION
/begin FUNCTION OUTP_AFTER ""
 /begin SUB_FUNCTION ApsOut_GearPosnSig ApsOut_SendChrgPlugStaSig ApsOut_SetFrSensorOnCmd ApsOut_SetFrSensorSwTOCmd ApsOut_SetVehSpdTOCmd ApsOut_VehSpdSig HAL_NvmWriteData_raw DTC_Trigger Header_Array DTC_Array BOUTP_DIDSetData_outputs APM DID_list DTC_list Subsystem5 /end SUB_FUNCTION
 /begin DEF_CHARACTERISTIC /end DEF_CHARACTERISTIC
 /begin IN_MEASUREMENT /end IN_MEASUREMENT
 /begin OUT_MEASUREMENT /end OUT_MEASUREMENT
/end FUNCTION
/begin FUNCTION R_DIDWriteCDD_CSOP_DIDSet_NVMPedalZP "" /begin SUB_FUNCTION DIDLen7 DIDNum7 R_DIDWriteCDD_CSOP_DIDSet_NVMPedalZP /end SUB_FUNCTION /begin DEF_CHARACTERISTIC /end DEF_CHARACTERISTIC /begin IN_MEASUREMENT /end IN_MEASUREMENT /begin OUT_MEASUREMENT /end OUT_MEASUREMENT /end FUNCTION
/begin FUNCTION R_FDCCDD_Inner_CSOP_FDC_AppCallSleep "" /begin SUB_FUNCTION R_FDCCDD_Inner_CSOP_FDC_AppCallSleep /end SUB_FUNCTION /begin DEF_CHARACTERISTIC /end DEF_CHARACTERISTIC /begin IN_MEASUREMENT /end IN_MEASUREMENT /begin OUT_MEASUREMENT /end OUT_MEASUREMENT /end FUNCTION
/begin FUNCTION R_HALOUTCDD_CSOP_AppNmStateReq "" /begin SUB_FUNCTION R_HALOUTCDD_CSOP_AppNmStateReq /end SUB_FUNCTION /begin DEF_CHARACTERISTIC /end DEF_CHARACTERISTIC /begin IN_MEASUREMENT /end IN_MEASUREMENT /begin OUT_MEASUREMENT /end OUT_MEASUREMENT /end FUNCTION
/begin FUNCTION R_HALOUTCDD_CSOP_ResetPedalZeroPosDone "" /begin SUB_FUNCTION R_HALOUTCDD_CSOP_ResetPedalZeroPosDone /end SUB_FUNCTION /begin DEF_CHARACTERISTIC /end DEF_CHARACTERISTIC /begin IN_MEASUREMENT /end IN_MEASUREMENT /begin OUT_MEASUREMENT /end OUT_MEASUREMENT /end FUNCTION
/begin FUNCTION R_HALOUTCDD_CSOP_SetAcoreRebootCmdACK "" /begin SUB_FUNCTION R_HALOUTCDD_CSOP_SetAcoreRebootCmdACK /end SUB_FUNCTION /begin DEF_CHARACTERISTIC /end DEF_CHARACTERISTIC /begin IN_MEASUREMENT /end IN_MEASUREMENT /begin OUT_MEASUREMENT /end OUT_MEASUREMENT /end FUNCTION
/begin FUNCTION R_HALOUTCDD_CSOP_SleepRequest "" /begin SUB_FUNCTION R_HALOUTCDD_CSOP_SleepRequest /end SUB_FUNCTION /begin DEF_CHARACTERISTIC /end DEF_CHARACTERISTIC /begin IN_MEASUREMENT /end IN_MEASUREMENT /begin OUT_MEASUREMENT /end OUT_MEASUREMENT /end FUNCTION
/begin FUNCTION R_HALOUTCDD_CSOP_TPMSSensorIDRegSetResults "" /begin SUB_FUNCTION R_HALOUTCDD_CSOP_TPMSSensorIDRegSetResults /end SUB_FUNCTION /begin DEF_CHARACTERISTIC /end DEF_CHARACTERISTIC /begin IN_MEASUREMENT /end IN_MEASUREMENT /begin OUT_MEASUREMENT /end OUT_MEASUREMENT /end FUNCTION
/begin FUNCTION R_IOExpOUT_CDD_CSOP_IOExpSetVal "" /begin SUB_FUNCTION R_IOExpOUT_CDD_CSOP_IOExpSetVal /end SUB_FUNCTION /begin DEF_CHARACTERISTIC /end DEF_CHARACTERISTIC /begin IN_MEASUREMENT /end IN_MEASUREMENT /begin OUT_MEASUREMENT /end OUT_MEASUREMENT /end FUNCTION
/begin FUNCTION R_NVMWriteCDD_Inner_NVM_WriteOperation "" /begin SUB_FUNCTION R_NVMWriteCDD_Inner_NVM_WriteOperation /end SUB_FUNCTION /begin DEF_CHARACTERISTIC /end DEF_CHARACTERISTIC /begin IN_MEASUREMENT /end IN_MEASUREMENT /begin OUT_MEASUREMENT /end OUT_MEASUREMENT /end FUNCTION
/begin FUNCTION R_UDSCDD_CSOP_DdmRestartOperationCycle "" /begin SUB_FUNCTION R_UDSCDD_CSOP_DdmRestartOperationCycle /end SUB_FUNCTION /begin DEF_CHARACTERISTIC /end DEF_CHARACTERISTIC /begin IN_MEASUREMENT /end IN_MEASUREMENT /begin OUT_MEASUREMENT /end OUT_MEASUREMENT /end FUNCTION
/begin FUNCTION R_UDSCDD_CSOP_SetDTCStatus "" /begin SUB_FUNCTION Out1 R_UDSCDD_CSOP_SetDTCStatus /end SUB_FUNCTION /begin DEF_CHARACTERISTIC /end DEF_CHARACTERISTIC /begin IN_MEASUREMENT /end IN_MEASUREMENT /begin OUT_MEASUREMENT /end OUT_MEASUREMENT /end FUNCTION
/begin FUNCTION R_WDGCDD_CSOP_Call_WDG_AppEnd "" /begin SUB_FUNCTION R_WDGCDD_CSOP_Call_WDG_AppEnd /end SUB_FUNCTION /begin DEF_CHARACTERISTIC /end DEF_CHARACTERISTIC /begin IN_MEASUREMENT /end IN_MEASUREMENT /begin OUT_MEASUREMENT /end OUT_MEASUREMENT /end FUNCTION
/begin FUNCTION detect_change "" /begin SUB_FUNCTION FixPt_Relational_Operator Delay_Input1 /end SUB_FUNCTION /begin DEF_CHARACTERISTIC /end DEF_CHARACTERISTIC /begin IN_MEASUREMENT /end IN_MEASUREMENT /begin OUT_MEASUREMENT /end OUT_MEASUREMENT /end FUNCTION
/begin FUNCTION detect_change1 "" /begin SUB_FUNCTION FixPt_Relational_Operator Delay_Input1 /end SUB_FUNCTION /begin DEF_CHARACTERISTIC /end DEF_CHARACTERISTIC /begin IN_MEASUREMENT /end IN_MEASUREMENT /begin OUT_MEASUREMENT /end OUT_MEASUREMENT /end FUNCTION
/begin FUNCTION hcu_main_sched "" /begin DEF_CHARACTERISTIC /end DEF_CHARACTERISTIC /begin IN_MEASUREMENT /end IN_MEASUREMENT /begin OUT_MEASUREMENT /end OUT_MEASUREMENT /end FUNCTION
/begin FUNCTION Constant5 "" /begin DEF_CHARACTERISTIC /end DEF_CHARACTERISTIC /begin IN_MEASUREMENT /end IN_MEASUREMENT /begin OUT_MEASUREMENT /end OUT_MEASUREMENT /end FUNCTION
/begin FUNCTION Data_Type_Conversion1 "" /begin DEF_CHARACTERISTIC /end DEF_CHARACTERISTIC /begin IN_MEASUREMENT /end IN_MEASUREMENT /begin OUT_MEASUREMENT /end OUT_MEASUREMENT /end FUNCTION
/begin FUNCTION Data_Type_Conversion125 "" /begin DEF_CHARACTERISTIC /end DEF_CHARACTERISTIC /begin IN_MEASUREMENT /end IN_MEASUREMENT /begin OUT_MEASUREMENT /end OUT_MEASUREMENT /end FUNCTION
/begin FUNCTION Data_Type_Conversion2 "" /begin DEF_CHARACTERISTIC /end DEF_CHARACTERISTIC /begin IN_MEASUREMENT /end IN_MEASUREMENT /begin OUT_MEASUREMENT /end OUT_MEASUREMENT /end FUNCTION
/begin FUNCTION Data_Type_Conversion3 "" /begin DEF_CHARACTERISTIC /end DEF_CHARACTERISTIC /begin IN_MEASUREMENT /end IN_MEASUREMENT /begin OUT_MEASUREMENT /end OUT_MEASUREMENT /end FUNCTION
/begin FUNCTION Data_Type_Conversion4 "" /begin DEF_CHARACTERISTIC /end DEF_CHARACTERISTIC /begin IN_MEASUREMENT /end IN_MEASUREMENT /begin OUT_MEASUREMENT /end OUT_MEASUREMENT /end FUNCTION
/begin FUNCTION Data_Type_Conversion5 "" /begin DEF_CHARACTERISTIC /end DEF_CHARACTERISTIC /begin IN_MEASUREMENT /end IN_MEASUREMENT /begin OUT_MEASUREMENT /end OUT_MEASUREMENT /end FUNCTION
/begin FUNCTION R_HALOUTCDD_CSOP_SetHazardIND "" /begin DEF_CHARACTERISTIC /end DEF_CHARACTERISTIC /begin IN_MEASUREMENT /end IN_MEASUREMENT /begin OUT_MEASUREMENT /end OUT_MEASUREMENT /end FUNCTION
/begin FUNCTION R_HALOUTCDD_CSOP_SetSysPwrStat "" /begin DEF_CHARACTERISTIC /end DEF_CHARACTERISTIC /begin IN_MEASUREMENT /end IN_MEASUREMENT /begin OUT_MEASUREMENT /end OUT_MEASUREMENT /end FUNCTION
/begin FUNCTION NOT "" /begin DEF_CHARACTERISTIC /end DEF_CHARACTERISTIC /begin IN_MEASUREMENT /end IN_MEASUREMENT /begin OUT_MEASUREMENT /end OUT_MEASUREMENT /end FUNCTION
/begin FUNCTION Unit_Delay "" /begin DEF_CHARACTERISTIC /end DEF_CHARACTERISTIC /begin IN_MEASUREMENT /end IN_MEASUREMENT /begin OUT_MEASUREMENT /end OUT_MEASUREMENT /end FUNCTION
/begin FUNCTION Unit_Delay1 "" /begin DEF_CHARACTERISTIC /end DEF_CHARACTERISTIC /begin IN_MEASUREMENT /end IN_MEASUREMENT /begin OUT_MEASUREMENT /end OUT_MEASUREMENT /end FUNCTION
/begin FUNCTION Unit_Delay2 "" /begin DEF_CHARACTERISTIC /end DEF_CHARACTERISTIC /begin IN_MEASUREMENT /end IN_MEASUREMENT /begin OUT_MEASUREMENT /end OUT_MEASUREMENT /end FUNCTION
/begin FUNCTION Unit_Delay4 "" /begin DEF_CHARACTERISTIC /end DEF_CHARACTERISTIC /begin IN_MEASUREMENT /end IN_MEASUREMENT /begin OUT_MEASUREMENT /end OUT_MEASUREMENT /end FUNCTION
/begin FUNCTION R_HALINCDD_CSOP_UDS_Main "" /begin DEF_CHARACTERISTIC /end DEF_CHARACTERISTIC /begin IN_MEASUREMENT /end IN_MEASUREMENT /begin OUT_MEASUREMENT /end OUT_MEASUREMENT /end FUNCTION
/begin FUNCTION DIDLen "" /begin DEF_CHARACTERISTIC /end DEF_CHARACTERISTIC /begin IN_MEASUREMENT /end IN_MEASUREMENT /begin OUT_MEASUREMENT /end OUT_MEASUREMENT /end FUNCTION
/begin FUNCTION DIDLen1 "" /begin DEF_CHARACTERISTIC /end DEF_CHARACTERISTIC /begin IN_MEASUREMENT /end IN_MEASUREMENT /begin OUT_MEASUREMENT /end OUT_MEASUREMENT /end FUNCTION
/begin FUNCTION DIDLen10 "" /begin DEF_CHARACTERISTIC /end DEF_CHARACTERISTIC /begin IN_MEASUREMENT /end IN_MEASUREMENT /begin OUT_MEASUREMENT /end OUT_MEASUREMENT /end FUNCTION
/begin FUNCTION DIDLen11 "" /begin DEF_CHARACTERISTIC /end DEF_CHARACTERISTIC /begin IN_MEASUREMENT /end IN_MEASUREMENT /begin OUT_MEASUREMENT /end OUT_MEASUREMENT /end FUNCTION
/begin FUNCTION DIDLen12 "" /begin DEF_CHARACTERISTIC /end DEF_CHARACTERISTIC /begin IN_MEASUREMENT /end IN_MEASUREMENT /begin OUT_MEASUREMENT /end OUT_MEASUREMENT /end FUNCTION
/begin FUNCTION DIDLen13 "" /begin DEF_CHARACTERISTIC /end DEF_CHARACTERISTIC /begin IN_MEASUREMENT /end IN_MEASUREMENT /begin OUT_MEASUREMENT /end OUT_MEASUREMENT /end FUNCTION
/begin FUNCTION DIDLen14 "" /begin DEF_CHARACTERISTIC /end DEF_CHARACTERISTIC /begin IN_MEASUREMENT /end IN_MEASUREMENT /begin OUT_MEASUREMENT /end OUT_MEASUREMENT /end FUNCTION
/begin FUNCTION DIDLen15 "" /begin DEF_CHARACTERISTIC /end DEF_CHARACTERISTIC /begin IN_MEASUREMENT /end IN_MEASUREMENT /begin OUT_MEASUREMENT /end OUT_MEASUREMENT /end FUNCTION
/begin FUNCTION DIDLen16 "" /begin DEF_CHARACTERISTIC /end DEF_CHARACTERISTIC /begin IN_MEASUREMENT /end IN_MEASUREMENT /begin OUT_MEASUREMENT /end OUT_MEASUREMENT /end FUNCTION
/begin FUNCTION DIDLen17 "" /begin DEF_CHARACTERISTIC /end DEF_CHARACTERISTIC /begin IN_MEASUREMENT /end IN_MEASUREMENT /begin OUT_MEASUREMENT /end OUT_MEASUREMENT /end FUNCTION
/begin FUNCTION DIDLen18 "" /begin DEF_CHARACTERISTIC /end DEF_CHARACTERISTIC /begin IN_MEASUREMENT /end IN_MEASUREMENT /begin OUT_MEASUREMENT /end OUT_MEASUREMENT /end FUNCTION
/begin FUNCTION DIDLen19 "" /begin DEF_CHARACTERISTIC /end DEF_CHARACTERISTIC /begin IN_MEASUREMENT /end IN_MEASUREMENT /begin OUT_MEASUREMENT /end OUT_MEASUREMENT /end FUNCTION
/begin FUNCTION DIDLen2 "" /begin DEF_CHARACTERISTIC /end DEF_CHARACTERISTIC /begin IN_MEASUREMENT /end IN_MEASUREMENT /begin OUT_MEASUREMENT /end OUT_MEASUREMENT /end FUNCTION
/begin FUNCTION DIDLen20 "" /begin DEF_CHARACTERISTIC /end DEF_CHARACTERISTIC /begin IN_MEASUREMENT /end IN_MEASUREMENT /begin OUT_MEASUREMENT /end OUT_MEASUREMENT /end FUNCTION
/begin FUNCTION DIDLen21 "" /begin DEF_CHARACTERISTIC /end DEF_CHARACTERISTIC /begin IN_MEASUREMENT /end IN_MEASUREMENT /begin OUT_MEASUREMENT /end OUT_MEASUREMENT /end FUNCTION
/begin FUNCTION DIDLen22 "" /begin DEF_CHARACTERISTIC /end DEF_CHARACTERISTIC /begin IN_MEASUREMENT /end IN_MEASUREMENT /begin OUT_MEASUREMENT /end OUT_MEASUREMENT /end FUNCTION
/begin FUNCTION DIDLen23 "" /begin DEF_CHARACTERISTIC /end DEF_CHARACTERISTIC /begin IN_MEASUREMENT /end IN_MEASUREMENT /begin OUT_MEASUREMENT /end OUT_MEASUREMENT /end FUNCTION
/begin FUNCTION DIDLen24 "" /begin DEF_CHARACTERISTIC /end DEF_CHARACTERISTIC /begin IN_MEASUREMENT /end IN_MEASUREMENT /begin OUT_MEASUREMENT /end OUT_MEASUREMENT /end FUNCTION
/begin FUNCTION DIDLen25 "" /begin DEF_CHARACTERISTIC /end DEF_CHARACTERISTIC /begin IN_MEASUREMENT /end IN_MEASUREMENT /begin OUT_MEASUREMENT /end OUT_MEASUREMENT /end FUNCTION
/begin FUNCTION DIDLen26 "" /begin DEF_CHARACTERISTIC /end DEF_CHARACTERISTIC /begin IN_MEASUREMENT /end IN_MEASUREMENT /begin OUT_MEASUREMENT /end OUT_MEASUREMENT /end FUNCTION
/begin FUNCTION DIDLen27 "" /begin DEF_CHARACTERISTIC /end DEF_CHARACTERISTIC /begin IN_MEASUREMENT /end IN_MEASUREMENT /begin OUT_MEASUREMENT /end OUT_MEASUREMENT /end FUNCTION
/begin FUNCTION DIDLen28 "" /begin DEF_CHARACTERISTIC /end DEF_CHARACTERISTIC /begin IN_MEASUREMENT /end IN_MEASUREMENT /begin OUT_MEASUREMENT /end OUT_MEASUREMENT /end FUNCTION
/begin FUNCTION DIDLen29 "" /begin DEF_CHARACTERISTIC /end DEF_CHARACTERISTIC /begin IN_MEASUREMENT /end IN_MEASUREMENT /begin OUT_MEASUREMENT /end OUT_MEASUREMENT /end FUNCTION
/begin FUNCTION DIDLen3 "" /begin DEF_CHARACTERISTIC /end DEF_CHARACTERISTIC /begin IN_MEASUREMENT /end IN_MEASUREMENT /begin OUT_MEASUREMENT /end OUT_MEASUREMENT /end FUNCTION
/begin FUNCTION DIDLen30 "" /begin DEF_CHARACTERISTIC /end DEF_CHARACTERISTIC /begin IN_MEASUREMENT /end IN_MEASUREMENT /begin OUT_MEASUREMENT /end OUT_MEASUREMENT /end FUNCTION
/begin FUNCTION DIDLen31 "" /begin DEF_CHARACTERISTIC /end DEF_CHARACTERISTIC /begin IN_MEASUREMENT /end IN_MEASUREMENT /begin OUT_MEASUREMENT /end OUT_MEASUREMENT /end FUNCTION
/begin FUNCTION DIDLen32 "" /begin DEF_CHARACTERISTIC /end DEF_CHARACTERISTIC /begin IN_MEASUREMENT /end IN_MEASUREMENT /begin OUT_MEASUREMENT /end OUT_MEASUREMENT /end FUNCTION
/begin FUNCTION DIDLen33 "" /begin DEF_CHARACTERISTIC /end DEF_CHARACTERISTIC /begin IN_MEASUREMENT /end IN_MEASUREMENT /begin OUT_MEASUREMENT /end OUT_MEASUREMENT /end FUNCTION
/begin FUNCTION DIDLen34 "" /begin DEF_CHARACTERISTIC /end DEF_CHARACTERISTIC /begin IN_MEASUREMENT /end IN_MEASUREMENT /begin OUT_MEASUREMENT /end OUT_MEASUREMENT /end FUNCTION
/begin FUNCTION DIDLen35 "" /begin DEF_CHARACTERISTIC /end DEF_CHARACTERISTIC /begin IN_MEASUREMENT /end IN_MEASUREMENT /begin OUT_MEASUREMENT /end OUT_MEASUREMENT /end FUNCTION
/begin FUNCTION DIDLen36 "" /begin DEF_CHARACTERISTIC /end DEF_CHARACTERISTIC /begin IN_MEASUREMENT /end IN_MEASUREMENT /begin OUT_MEASUREMENT /end OUT_MEASUREMENT /end FUNCTION
/begin FUNCTION DIDLen37 "" /begin DEF_CHARACTERISTIC /end DEF_CHARACTERISTIC /begin IN_MEASUREMENT /end IN_MEASUREMENT /begin OUT_MEASUREMENT /end OUT_MEASUREMENT /end FUNCTION
/begin FUNCTION DIDLen38 "" /begin DEF_CHARACTERISTIC /end DEF_CHARACTERISTIC /begin IN_MEASUREMENT /end IN_MEASUREMENT /begin OUT_MEASUREMENT /end OUT_MEASUREMENT /end FUNCTION
/begin FUNCTION DIDLen39 "" /begin DEF_CHARACTERISTIC /end DEF_CHARACTERISTIC /begin IN_MEASUREMENT /end IN_MEASUREMENT /begin OUT_MEASUREMENT /end OUT_MEASUREMENT /end FUNCTION
/begin FUNCTION DIDLen4 "" /begin DEF_CHARACTERISTIC /end DEF_CHARACTERISTIC /begin IN_MEASUREMENT /end IN_MEASUREMENT /begin OUT_MEASUREMENT /end OUT_MEASUREMENT /end FUNCTION
/begin FUNCTION DIDLen40 "" /begin DEF_CHARACTERISTIC /end DEF_CHARACTERISTIC /begin IN_MEASUREMENT /end IN_MEASUREMENT /begin OUT_MEASUREMENT /end OUT_MEASUREMENT /end FUNCTION
/begin FUNCTION DIDLen41 "" /begin DEF_CHARACTERISTIC /end DEF_CHARACTERISTIC /begin IN_MEASUREMENT /end IN_MEASUREMENT /begin OUT_MEASUREMENT /end OUT_MEASUREMENT /end FUNCTION
/begin FUNCTION DIDLen42 "" /begin DEF_CHARACTERISTIC /end DEF_CHARACTERISTIC /begin IN_MEASUREMENT /end IN_MEASUREMENT /begin OUT_MEASUREMENT /end OUT_MEASUREMENT /end FUNCTION
/begin FUNCTION DIDLen43 "" /begin DEF_CHARACTERISTIC /end DEF_CHARACTERISTIC /begin IN_MEASUREMENT /end IN_MEASUREMENT /begin OUT_MEASUREMENT /end OUT_MEASUREMENT /end FUNCTION
/begin FUNCTION DIDLen44 "" /begin DEF_CHARACTERISTIC /end DEF_CHARACTERISTIC /begin IN_MEASUREMENT /end IN_MEASUREMENT /begin OUT_MEASUREMENT /end OUT_MEASUREMENT /end FUNCTION
/begin FUNCTION DIDLen45 "" /begin DEF_CHARACTERISTIC /end DEF_CHARACTERISTIC /begin IN_MEASUREMENT /end IN_MEASUREMENT /begin OUT_MEASUREMENT /end OUT_MEASUREMENT /end FUNCTION
/begin FUNCTION DIDLen46 "" /begin DEF_CHARACTERISTIC /end DEF_CHARACTERISTIC /begin IN_MEASUREMENT /end IN_MEASUREMENT /begin OUT_MEASUREMENT /end OUT_MEASUREMENT /end FUNCTION
/begin FUNCTION DIDLen47 "" /begin DEF_CHARACTERISTIC /end DEF_CHARACTERISTIC /begin IN_MEASUREMENT /end IN_MEASUREMENT /begin OUT_MEASUREMENT /end OUT_MEASUREMENT /end FUNCTION
/begin FUNCTION DIDLen48 "" /begin DEF_CHARACTERISTIC /end DEF_CHARACTERISTIC /begin IN_MEASUREMENT /end IN_MEASUREMENT /begin OUT_MEASUREMENT /end OUT_MEASUREMENT /end FUNCTION
/begin FUNCTION DIDLen49 "" /begin DEF_CHARACTERISTIC /end DEF_CHARACTERISTIC /begin IN_MEASUREMENT /end IN_MEASUREMENT /begin OUT_MEASUREMENT /end OUT_MEASUREMENT /end FUNCTION
/begin FUNCTION DIDLen5 "" /begin DEF_CHARACTERISTIC /end DEF_CHARACTERISTIC /begin IN_MEASUREMENT /end IN_MEASUREMENT /begin OUT_MEASUREMENT /end OUT_MEASUREMENT /end FUNCTION
/begin FUNCTION DIDLen50 "" /begin DEF_CHARACTERISTIC /end DEF_CHARACTERISTIC /begin IN_MEASUREMENT /end IN_MEASUREMENT /begin OUT_MEASUREMENT /end OUT_MEASUREMENT /end FUNCTION
/begin FUNCTION DIDLen51 "" /begin DEF_CHARACTERISTIC /end DEF_CHARACTERISTIC /begin IN_MEASUREMENT /end IN_MEASUREMENT /begin OUT_MEASUREMENT /end OUT_MEASUREMENT /end FUNCTION
/begin FUNCTION DIDLen52 "" /begin DEF_CHARACTERISTIC /end DEF_CHARACTERISTIC /begin IN_MEASUREMENT /end IN_MEASUREMENT /begin OUT_MEASUREMENT /end OUT_MEASUREMENT /end FUNCTION
/begin FUNCTION DIDLen53 "" /begin DEF_CHARACTERISTIC /end DEF_CHARACTERISTIC /begin IN_MEASUREMENT /end IN_MEASUREMENT /begin OUT_MEASUREMENT /end OUT_MEASUREMENT /end FUNCTION
/begin FUNCTION DIDLen54 "" /begin DEF_CHARACTERISTIC /end DEF_CHARACTERISTIC /begin IN_MEASUREMENT /end IN_MEASUREMENT /begin OUT_MEASUREMENT /end OUT_MEASUREMENT /end FUNCTION
/begin FUNCTION DIDLen6 "" /begin DEF_CHARACTERISTIC /end DEF_CHARACTERISTIC /begin IN_MEASUREMENT /end IN_MEASUREMENT /begin OUT_MEASUREMENT /end OUT_MEASUREMENT /end FUNCTION
/begin FUNCTION DIDLen7 "" /begin DEF_CHARACTERISTIC /end DEF_CHARACTERISTIC /begin IN_MEASUREMENT /end IN_MEASUREMENT /begin OUT_MEASUREMENT /end OUT_MEASUREMENT /end FUNCTION
/begin FUNCTION DIDLen8 "" /begin DEF_CHARACTERISTIC /end DEF_CHARACTERISTIC /begin IN_MEASUREMENT /end IN_MEASUREMENT /begin OUT_MEASUREMENT /end OUT_MEASUREMENT /end FUNCTION
/begin FUNCTION DIDLen9 "" /begin DEF_CHARACTERISTIC /end DEF_CHARACTERISTIC /begin IN_MEASUREMENT /end IN_MEASUREMENT /begin OUT_MEASUREMENT /end OUT_MEASUREMENT /end FUNCTION
/begin FUNCTION DIDNum "" /begin DEF_CHARACTERISTIC /end DEF_CHARACTERISTIC /begin IN_MEASUREMENT /end IN_MEASUREMENT /begin OUT_MEASUREMENT /end OUT_MEASUREMENT /end FUNCTION
/begin FUNCTION DIDNum1 "" /begin DEF_CHARACTERISTIC /end DEF_CHARACTERISTIC /begin IN_MEASUREMENT /end IN_MEASUREMENT /begin OUT_MEASUREMENT /end OUT_MEASUREMENT /end FUNCTION
/begin FUNCTION DIDNum10 "" /begin DEF_CHARACTERISTIC /end DEF_CHARACTERISTIC /begin IN_MEASUREMENT /end IN_MEASUREMENT /begin OUT_MEASUREMENT /end OUT_MEASUREMENT /end FUNCTION
/begin FUNCTION DIDNum11 "" /begin DEF_CHARACTERISTIC /end DEF_CHARACTERISTIC /begin IN_MEASUREMENT /end IN_MEASUREMENT /begin OUT_MEASUREMENT /end OUT_MEASUREMENT /end FUNCTION
/begin FUNCTION DIDNum12 "" /begin DEF_CHARACTERISTIC /end DEF_CHARACTERISTIC /begin IN_MEASUREMENT /end IN_MEASUREMENT /begin OUT_MEASUREMENT /end OUT_MEASUREMENT /end FUNCTION
/begin FUNCTION DIDNum13 "" /begin DEF_CHARACTERISTIC /end DEF_CHARACTERISTIC /begin IN_MEASUREMENT /end IN_MEASUREMENT /begin OUT_MEASUREMENT /end OUT_MEASUREMENT /end FUNCTION
/begin FUNCTION DIDNum14 "" /begin DEF_CHARACTERISTIC /end DEF_CHARACTERISTIC /begin IN_MEASUREMENT /end IN_MEASUREMENT /begin OUT_MEASUREMENT /end OUT_MEASUREMENT /end FUNCTION
/begin FUNCTION DIDNum15 "" /begin DEF_CHARACTERISTIC /end DEF_CHARACTERISTIC /begin IN_MEASUREMENT /end IN_MEASUREMENT /begin OUT_MEASUREMENT /end OUT_MEASUREMENT /end FUNCTION
/begin FUNCTION DIDNum16 "" /begin DEF_CHARACTERISTIC /end DEF_CHARACTERISTIC /begin IN_MEASUREMENT /end IN_MEASUREMENT /begin OUT_MEASUREMENT /end OUT_MEASUREMENT /end FUNCTION
/begin FUNCTION DIDNum17 "" /begin DEF_CHARACTERISTIC /end DEF_CHARACTERISTIC /begin IN_MEASUREMENT /end IN_MEASUREMENT /begin OUT_MEASUREMENT /end OUT_MEASUREMENT /end FUNCTION
/begin FUNCTION DIDNum18 "" /begin DEF_CHARACTERISTIC /end DEF_CHARACTERISTIC /begin IN_MEASUREMENT /end IN_MEASUREMENT /begin OUT_MEASUREMENT /end OUT_MEASUREMENT /end FUNCTION
/begin FUNCTION DIDNum19 "" /begin DEF_CHARACTERISTIC /end DEF_CHARACTERISTIC /begin IN_MEASUREMENT /end IN_MEASUREMENT /begin OUT_MEASUREMENT /end OUT_MEASUREMENT /end FUNCTION
/begin FUNCTION DIDNum2 "" /begin DEF_CHARACTERISTIC /end DEF_CHARACTERISTIC /begin IN_MEASUREMENT /end IN_MEASUREMENT /begin OUT_MEASUREMENT /end OUT_MEASUREMENT /end FUNCTION
/begin FUNCTION DIDNum20 "" /begin DEF_CHARACTERISTIC /end DEF_CHARACTERISTIC /begin IN_MEASUREMENT /end IN_MEASUREMENT /begin OUT_MEASUREMENT /end OUT_MEASUREMENT /end FUNCTION
/begin FUNCTION DIDNum21 "" /begin DEF_CHARACTERISTIC /end DEF_CHARACTERISTIC /begin IN_MEASUREMENT /end IN_MEASUREMENT /begin OUT_MEASUREMENT /end OUT_MEASUREMENT /end FUNCTION
/begin FUNCTION DIDNum22 "" /begin DEF_CHARACTERISTIC /end DEF_CHARACTERISTIC /begin IN_MEASUREMENT /end IN_MEASUREMENT /begin OUT_MEASUREMENT /end OUT_MEASUREMENT /end FUNCTION
/begin FUNCTION DIDNum23 "" /begin DEF_CHARACTERISTIC /end DEF_CHARACTERISTIC /begin IN_MEASUREMENT /end IN_MEASUREMENT /begin OUT_MEASUREMENT /end OUT_MEASUREMENT /end FUNCTION
/begin FUNCTION DIDNum24 "" /begin DEF_CHARACTERISTIC /end DEF_CHARACTERISTIC /begin IN_MEASUREMENT /end IN_MEASUREMENT /begin OUT_MEASUREMENT /end OUT_MEASUREMENT /end FUNCTION
/begin FUNCTION DIDNum25 "" /begin DEF_CHARACTERISTIC /end DEF_CHARACTERISTIC /begin IN_MEASUREMENT /end IN_MEASUREMENT /begin OUT_MEASUREMENT /end OUT_MEASUREMENT /end FUNCTION
/begin FUNCTION DIDNum26 "" /begin DEF_CHARACTERISTIC /end DEF_CHARACTERISTIC /begin IN_MEASUREMENT /end IN_MEASUREMENT /begin OUT_MEASUREMENT /end OUT_MEASUREMENT /end FUNCTION
/begin FUNCTION DIDNum27 "" /begin DEF_CHARACTERISTIC /end DEF_CHARACTERISTIC /begin IN_MEASUREMENT /end IN_MEASUREMENT /begin OUT_MEASUREMENT /end OUT_MEASUREMENT /end FUNCTION
/begin FUNCTION DIDNum28 "" /begin DEF_CHARACTERISTIC /end DEF_CHARACTERISTIC /begin IN_MEASUREMENT /end IN_MEASUREMENT /begin OUT_MEASUREMENT /end OUT_MEASUREMENT /end FUNCTION
/begin FUNCTION DIDNum29 "" /begin DEF_CHARACTERISTIC /end DEF_CHARACTERISTIC /begin IN_MEASUREMENT /end IN_MEASUREMENT /begin OUT_MEASUREMENT /end OUT_MEASUREMENT /end FUNCTION
/begin FUNCTION DIDNum3 "" /begin DEF_CHARACTERISTIC /end DEF_CHARACTERISTIC /begin IN_MEASUREMENT /end IN_MEASUREMENT /begin OUT_MEASUREMENT /end OUT_MEASUREMENT /end FUNCTION
/begin FUNCTION DIDNum30 "" /begin DEF_CHARACTERISTIC /end DEF_CHARACTERISTIC /begin IN_MEASUREMENT /end IN_MEASUREMENT /begin OUT_MEASUREMENT /end OUT_MEASUREMENT /end FUNCTION
/begin FUNCTION DIDNum31 "" /begin DEF_CHARACTERISTIC /end DEF_CHARACTERISTIC /begin IN_MEASUREMENT /end IN_MEASUREMENT /begin OUT_MEASUREMENT /end OUT_MEASUREMENT /end FUNCTION
/begin FUNCTION DIDNum32 "" /begin DEF_CHARACTERISTIC /end DEF_CHARACTERISTIC /begin IN_MEASUREMENT /end IN_MEASUREMENT /begin OUT_MEASUREMENT /end OUT_MEASUREMENT /end FUNCTION
/begin FUNCTION DIDNum33 "" /begin DEF_CHARACTERISTIC /end DEF_CHARACTERISTIC /begin IN_MEASUREMENT /end IN_MEASUREMENT /begin OUT_MEASUREMENT /end OUT_MEASUREMENT /end FUNCTION
/begin FUNCTION DIDNum34 "" /begin DEF_CHARACTERISTIC /end DEF_CHARACTERISTIC /begin IN_MEASUREMENT /end IN_MEASUREMENT /begin OUT_MEASUREMENT /end OUT_MEASUREMENT /end FUNCTION
/begin FUNCTION DIDNum35 "" /begin DEF_CHARACTERISTIC /end DEF_CHARACTERISTIC /begin IN_MEASUREMENT /end IN_MEASUREMENT /begin OUT_MEASUREMENT /end OUT_MEASUREMENT /end FUNCTION
/begin FUNCTION DIDNum36 "" /begin DEF_CHARACTERISTIC /end DEF_CHARACTERISTIC /begin IN_MEASUREMENT /end IN_MEASUREMENT /begin OUT_MEASUREMENT /end OUT_MEASUREMENT /end FUNCTION
/begin FUNCTION DIDNum37 "" /begin DEF_CHARACTERISTIC /end DEF_CHARACTERISTIC /begin IN_MEASUREMENT /end IN_MEASUREMENT /begin OUT_MEASUREMENT /end OUT_MEASUREMENT /end FUNCTION
/begin FUNCTION DIDNum38 "" /begin DEF_CHARACTERISTIC /end DEF_CHARACTERISTIC /begin IN_MEASUREMENT /end IN_MEASUREMENT /begin OUT_MEASUREMENT /end OUT_MEASUREMENT /end FUNCTION
/begin FUNCTION DIDNum39 "" /begin DEF_CHARACTERISTIC /end DEF_CHARACTERISTIC /begin IN_MEASUREMENT /end IN_MEASUREMENT /begin OUT_MEASUREMENT /end OUT_MEASUREMENT /end FUNCTION
/begin FUNCTION DIDNum4 "" /begin DEF_CHARACTERISTIC /end DEF_CHARACTERISTIC /begin IN_MEASUREMENT /end IN_MEASUREMENT /begin OUT_MEASUREMENT /end OUT_MEASUREMENT /end FUNCTION
/begin FUNCTION DIDNum40 "" /begin DEF_CHARACTERISTIC /end DEF_CHARACTERISTIC /begin IN_MEASUREMENT /end IN_MEASUREMENT /begin OUT_MEASUREMENT /end OUT_MEASUREMENT /end FUNCTION
/begin FUNCTION DIDNum41 "" /begin DEF_CHARACTERISTIC /end DEF_CHARACTERISTIC /begin IN_MEASUREMENT /end IN_MEASUREMENT /begin OUT_MEASUREMENT /end OUT_MEASUREMENT /end FUNCTION
/begin FUNCTION DIDNum42 "" /begin DEF_CHARACTERISTIC /end DEF_CHARACTERISTIC /begin IN_MEASUREMENT /end IN_MEASUREMENT /begin OUT_MEASUREMENT /end OUT_MEASUREMENT /end FUNCTION
/begin FUNCTION DIDNum43 "" /begin DEF_CHARACTERISTIC /end DEF_CHARACTERISTIC /begin IN_MEASUREMENT /end IN_MEASUREMENT /begin OUT_MEASUREMENT /end OUT_MEASUREMENT /end FUNCTION
/begin FUNCTION DIDNum44 "" /begin DEF_CHARACTERISTIC /end DEF_CHARACTERISTIC /begin IN_MEASUREMENT /end IN_MEASUREMENT /begin OUT_MEASUREMENT /end OUT_MEASUREMENT /end FUNCTION
/begin FUNCTION DIDNum45 "" /begin DEF_CHARACTERISTIC /end DEF_CHARACTERISTIC /begin IN_MEASUREMENT /end IN_MEASUREMENT /begin OUT_MEASUREMENT /end OUT_MEASUREMENT /end FUNCTION
/begin FUNCTION DIDNum46 "" /begin DEF_CHARACTERISTIC /end DEF_CHARACTERISTIC /begin IN_MEASUREMENT /end IN_MEASUREMENT /begin OUT_MEASUREMENT /end OUT_MEASUREMENT /end FUNCTION
/begin FUNCTION DIDNum47 "" /begin DEF_CHARACTERISTIC /end DEF_CHARACTERISTIC /begin IN_MEASUREMENT /end IN_MEASUREMENT /begin OUT_MEASUREMENT /end OUT_MEASUREMENT /end FUNCTION
/begin FUNCTION DIDNum48 "" /begin DEF_CHARACTERISTIC /end DEF_CHARACTERISTIC /begin IN_MEASUREMENT /end IN_MEASUREMENT /begin OUT_MEASUREMENT /end OUT_MEASUREMENT /end FUNCTION
/begin FUNCTION DIDNum49 "" /begin DEF_CHARACTERISTIC /end DEF_CHARACTERISTIC /begin IN_MEASUREMENT /end IN_MEASUREMENT /begin OUT_MEASUREMENT /end OUT_MEASUREMENT /end FUNCTION
/begin FUNCTION DIDNum5 "" /begin DEF_CHARACTERISTIC /end DEF_CHARACTERISTIC /begin IN_MEASUREMENT /end IN_MEASUREMENT /begin OUT_MEASUREMENT /end OUT_MEASUREMENT /end FUNCTION
/begin FUNCTION DIDNum50 "" /begin DEF_CHARACTERISTIC /end DEF_CHARACTERISTIC /begin IN_MEASUREMENT /end IN_MEASUREMENT /begin OUT_MEASUREMENT /end OUT_MEASUREMENT /end FUNCTION
/begin FUNCTION DIDNum51 "" /begin DEF_CHARACTERISTIC /end DEF_CHARACTERISTIC /begin IN_MEASUREMENT /end IN_MEASUREMENT /begin OUT_MEASUREMENT /end OUT_MEASUREMENT /end FUNCTION
/begin FUNCTION DIDNum52 "" /begin DEF_CHARACTERISTIC /end DEF_CHARACTERISTIC /begin IN_MEASUREMENT /end IN_MEASUREMENT /begin OUT_MEASUREMENT /end OUT_MEASUREMENT /end FUNCTION
/begin FUNCTION DIDNum53 "" /begin DEF_CHARACTERISTIC /end DEF_CHARACTERISTIC /begin IN_MEASUREMENT /end IN_MEASUREMENT /begin OUT_MEASUREMENT /end OUT_MEASUREMENT /end FUNCTION
/begin FUNCTION DIDNum54 "" /begin DEF_CHARACTERISTIC /end DEF_CHARACTERISTIC /begin IN_MEASUREMENT /end IN_MEASUREMENT /begin OUT_MEASUREMENT /end OUT_MEASUREMENT /end FUNCTION
/begin FUNCTION DIDNum6 "" /begin DEF_CHARACTERISTIC /end DEF_CHARACTERISTIC /begin IN_MEASUREMENT /end IN_MEASUREMENT /begin OUT_MEASUREMENT /end OUT_MEASUREMENT /end FUNCTION
/begin FUNCTION DIDNum7 "" /begin DEF_CHARACTERISTIC /end DEF_CHARACTERISTIC /begin IN_MEASUREMENT /end IN_MEASUREMENT /begin OUT_MEASUREMENT /end OUT_MEASUREMENT /end FUNCTION
/begin FUNCTION DIDNum8 "" /begin DEF_CHARACTERISTIC /end DEF_CHARACTERISTIC /begin IN_MEASUREMENT /end IN_MEASUREMENT /begin OUT_MEASUREMENT /end OUT_MEASUREMENT /end FUNCTION
/begin FUNCTION DIDNum9 "" /begin DEF_CHARACTERISTIC /end DEF_CHARACTERISTIC /begin IN_MEASUREMENT /end IN_MEASUREMENT /begin OUT_MEASUREMENT /end OUT_MEASUREMENT /end FUNCTION
/begin FUNCTION R_DIDWriteCDD_CSOP_DIDSet_APPD "" /begin DEF_CHARACTERISTIC /end DEF_CHARACTERISTIC /begin IN_MEASUREMENT /end IN_MEASUREMENT /begin OUT_MEASUREMENT /end OUT_MEASUREMENT /end FUNCTION
/begin FUNCTION R_DIDWriteCDD_CSOP_DIDSet_APPE "" /begin DEF_CHARACTERISTIC /end DEF_CHARACTERISTIC /begin IN_MEASUREMENT /end IN_MEASUREMENT /begin OUT_MEASUREMENT /end OUT_MEASUREMENT /end FUNCTION
/begin FUNCTION R_DIDWriteCDD_CSOP_DIDSet_APPPedalZP "" /begin DEF_CHARACTERISTIC /end DEF_CHARACTERISTIC /begin IN_MEASUREMENT /end IN_MEASUREMENT /begin OUT_MEASUREMENT /end OUT_MEASUREMENT /end FUNCTION
/begin FUNCTION R_DIDWriteCDD_CSOP_DIDSet_APSFunConfig "" /begin DEF_CHARACTERISTIC /end DEF_CHARACTERISTIC /begin IN_MEASUREMENT /end IN_MEASUREMENT /begin OUT_MEASUREMENT /end OUT_MEASUREMENT /end FUNCTION
/begin FUNCTION R_DIDWriteCDD_CSOP_DIDSet_AutoLock "" /begin DEF_CHARACTERISTIC /end DEF_CHARACTERISTIC /begin IN_MEASUREMENT /end IN_MEASUREMENT /begin OUT_MEASUREMENT /end OUT_MEASUREMENT /end FUNCTION
/begin FUNCTION R_DIDWriteCDD_CSOP_DIDSet_AutoWipHSpdEN "" /begin DEF_CHARACTERISTIC /end DEF_CHARACTERISTIC /begin IN_MEASUREMENT /end IN_MEASUREMENT /begin OUT_MEASUREMENT /end OUT_MEASUREMENT /end FUNCTION
/begin FUNCTION R_DIDWriteCDD_CSOP_DIDSet_CALID "" /begin DEF_CHARACTERISTIC /end DEF_CHARACTERISTIC /begin IN_MEASUREMENT /end IN_MEASUREMENT /begin OUT_MEASUREMENT /end OUT_MEASUREMENT /end FUNCTION
/begin FUNCTION R_DIDWriteCDD_CSOP_DIDSet_CDEODT "" /begin DEF_CHARACTERISTIC /end DEF_CHARACTERISTIC /begin IN_MEASUREMENT /end IN_MEASUREMENT /begin OUT_MEASUREMENT /end OUT_MEASUREMENT /end FUNCTION
/begin FUNCTION R_DIDWriteCDD_CSOP_DIDSet_CLRDIST "" /begin DEF_CHARACTERISTIC /end DEF_CHARACTERISTIC /begin IN_MEASUREMENT /end IN_MEASUREMENT /begin OUT_MEASUREMENT /end OUT_MEASUREMENT /end FUNCTION
/begin FUNCTION R_DIDWriteCDD_CSOP_DIDSet_DKCBLESta "" /begin DEF_CHARACTERISTIC /end DEF_CHARACTERISTIC /begin IN_MEASUREMENT /end IN_MEASUREMENT /begin OUT_MEASUREMENT /end OUT_MEASUREMENT /end FUNCTION
/begin FUNCTION R_DIDWriteCDD_CSOP_DIDSet_DKCKey "" /begin DEF_CHARACTERISTIC /end DEF_CHARACTERISTIC /begin IN_MEASUREMENT /end IN_MEASUREMENT /begin OUT_MEASUREMENT /end OUT_MEASUREMENT /end FUNCTION
/begin FUNCTION R_DIDWriteCDD_CSOP_DIDSet_DKCSta "" /begin DEF_CHARACTERISTIC /end DEF_CHARACTERISTIC /begin IN_MEASUREMENT /end IN_MEASUREMENT /begin OUT_MEASUREMENT /end OUT_MEASUREMENT /end FUNCTION
/begin FUNCTION R_DIDWriteCDD_CSOP_DIDSet_DRLDis "" /begin DEF_CHARACTERISTIC /end DEF_CHARACTERISTIC /begin IN_MEASUREMENT /end IN_MEASUREMENT /begin OUT_MEASUREMENT /end OUT_MEASUREMENT /end FUNCTION
/begin FUNCTION R_DIDWriteCDD_CSOP_DIDSet_DoorNFCAnchorSta "" /begin DEF_CHARACTERISTIC /end DEF_CHARACTERISTIC /begin IN_MEASUREMENT /end IN_MEASUREMENT /begin OUT_MEASUREMENT /end OUT_MEASUREMENT /end FUNCTION
/begin FUNCTION R_DIDWriteCDD_CSOP_DIDSet_DynoMode "" /begin DEF_CHARACTERISTIC /end DEF_CHARACTERISTIC /begin IN_MEASUREMENT /end IN_MEASUREMENT /begin OUT_MEASUREMENT /end OUT_MEASUREMENT /end FUNCTION
/begin FUNCTION R_DIDWriteCDD_CSOP_DIDSet_ECUNAME "" /begin DEF_CHARACTERISTIC /end DEF_CHARACTERISTIC /begin IN_MEASUREMENT /end IN_MEASUREMENT /begin OUT_MEASUREMENT /end OUT_MEASUREMENT /end FUNCTION
/begin FUNCTION R_DIDWriteCDD_CSOP_DIDSet_FDDKCCoordXY "" /begin DEF_CHARACTERISTIC /end DEF_CHARACTERISTIC /begin IN_MEASUREMENT /end IN_MEASUREMENT /begin OUT_MEASUREMENT /end OUT_MEASUREMENT /end FUNCTION
/begin FUNCTION R_DIDWriteCDD_CSOP_DIDSet_FMHTimer "" /begin DEF_CHARACTERISTIC /end DEF_CHARACTERISTIC /begin IN_MEASUREMENT /end IN_MEASUREMENT /begin OUT_MEASUREMENT /end OUT_MEASUREMENT /end FUNCTION
/begin FUNCTION R_DIDWriteCDD_CSOP_DIDSet_LFLowPresThre "" /begin DEF_CHARACTERISTIC /end DEF_CHARACTERISTIC /begin IN_MEASUREMENT /end IN_MEASUREMENT /begin OUT_MEASUREMENT /end OUT_MEASUREMENT /end FUNCTION
/begin FUNCTION R_DIDWriteCDD_CSOP_DIDSet_LFSensorID "" /begin DEF_CHARACTERISTIC /end DEF_CHARACTERISTIC /begin IN_MEASUREMENT /end IN_MEASUREMENT /begin OUT_MEASUREMENT /end OUT_MEASUREMENT /end FUNCTION
/begin FUNCTION R_DIDWriteCDD_CSOP_DIDSet_LIDAAnchorSta "" /begin DEF_CHARACTERISTIC /end DEF_CHARACTERISTIC /begin IN_MEASUREMENT /end IN_MEASUREMENT /begin OUT_MEASUREMENT /end OUT_MEASUREMENT /end FUNCTION
/begin FUNCTION R_DIDWriteCDD_CSOP_DIDSet_LRLowPresThre "" /begin DEF_CHARACTERISTIC /end DEF_CHARACTERISTIC /begin IN_MEASUREMENT /end IN_MEASUREMENT /begin OUT_MEASUREMENT /end OUT_MEASUREMENT /end FUNCTION
/begin FUNCTION R_DIDWriteCDD_CSOP_DIDSet_LRSensorID "" /begin DEF_CHARACTERISTIC /end DEF_CHARACTERISTIC /begin IN_MEASUREMENT /end IN_MEASUREMENT /begin OUT_MEASUREMENT /end OUT_MEASUREMENT /end FUNCTION
/begin FUNCTION R_DIDWriteCDD_CSOP_DIDSet_MILDIST "" /begin DEF_CHARACTERISTIC /end DEF_CHARACTERISTIC /begin IN_MEASUREMENT /end IN_MEASUREMENT /begin OUT_MEASUREMENT /end OUT_MEASUREMENT /end FUNCTION
/begin FUNCTION R_DIDWriteCDD_CSOP_DIDSet_NUMPSATRIPSFLTMEMCLR "" /begin DEF_CHARACTERISTIC /end DEF_CHARACTERISTIC /begin IN_MEASUREMENT /end IN_MEASUREMENT /begin OUT_MEASUREMENT /end OUT_MEASUREMENT /end FUNCTION
/begin FUNCTION R_DIDWriteCDD_CSOP_DIDSet_OBDReq "" /begin DEF_CHARACTERISTIC /end DEF_CHARACTERISTIC /begin IN_MEASUREMENT /end IN_MEASUREMENT /begin OUT_MEASUREMENT /end OUT_MEASUREMENT /end FUNCTION
/begin FUNCTION R_DIDWriteCDD_CSOP_DIDSet_ODOMETER "" /begin DEF_CHARACTERISTIC /end DEF_CHARACTERISTIC /begin IN_MEASUREMENT /end IN_MEASUREMENT /begin OUT_MEASUREMENT /end OUT_MEASUREMENT /end FUNCTION
/begin FUNCTION R_DIDWriteCDD_CSOP_DIDSet_PKE "" /begin DEF_CHARACTERISTIC /end DEF_CHARACTERISTIC /begin IN_MEASUREMENT /end IN_MEASUREMENT /begin OUT_MEASUREMENT /end OUT_MEASUREMENT /end FUNCTION
/begin FUNCTION R_DIDWriteCDD_CSOP_DIDSet_PSA "" /begin DEF_CHARACTERISTIC /end DEF_CHARACTERISTIC /begin IN_MEASUREMENT /end IN_MEASUREMENT /begin OUT_MEASUREMENT /end OUT_MEASUREMENT /end FUNCTION
/begin FUNCTION R_DIDWriteCDD_CSOP_DIDSet_ProtocolId "" /begin DEF_CHARACTERISTIC /end DEF_CHARACTERISTIC /begin IN_MEASUREMENT /end IN_MEASUREMENT /begin OUT_MEASUREMENT /end OUT_MEASUREMENT /end FUNCTION
/begin FUNCTION R_DIDWriteCDD_CSOP_DIDSet_QTYPSATRIPS "" /begin DEF_CHARACTERISTIC /end DEF_CHARACTERISTIC /begin IN_MEASUREMENT /end IN_MEASUREMENT /begin OUT_MEASUREMENT /end OUT_MEASUREMENT /end FUNCTION
/begin FUNCTION R_DIDWriteCDD_CSOP_DIDSet_RFLowPresThre "" /begin DEF_CHARACTERISTIC /end DEF_CHARACTERISTIC /begin IN_MEASUREMENT /end IN_MEASUREMENT /begin OUT_MEASUREMENT /end OUT_MEASUREMENT /end FUNCTION
/begin FUNCTION R_DIDWriteCDD_CSOP_DIDSet_RFSensorID "" /begin DEF_CHARACTERISTIC /end DEF_CHARACTERISTIC /begin IN_MEASUREMENT /end IN_MEASUREMENT /begin OUT_MEASUREMENT /end OUT_MEASUREMENT /end FUNCTION
/begin FUNCTION R_DIDWriteCDD_CSOP_DIDSet_RRLowPresThre "" /begin DEF_CHARACTERISTIC /end DEF_CHARACTERISTIC /begin IN_MEASUREMENT /end IN_MEASUREMENT /begin OUT_MEASUREMENT /end OUT_MEASUREMENT /end FUNCTION
/begin FUNCTION R_DIDWriteCDD_CSOP_DIDSet_RRSensorID "" /begin DEF_CHARACTERISTIC /end DEF_CHARACTERISTIC /begin IN_MEASUREMENT /end IN_MEASUREMENT /begin OUT_MEASUREMENT /end OUT_MEASUREMENT /end FUNCTION
/begin FUNCTION R_DIDWriteCDD_CSOP_DIDSet_RUNTM "" /begin DEF_CHARACTERISTIC /end DEF_CHARACTERISTIC /begin IN_MEASUREMENT /end IN_MEASUREMENT /begin OUT_MEASUREMENT /end OUT_MEASUREMENT /end FUNCTION
/begin FUNCTION R_DIDWriteCDD_CSOP_DIDSet_SensorMode "" /begin DEF_CHARACTERISTIC /end DEF_CHARACTERISTIC /begin IN_MEASUREMENT /end IN_MEASUREMENT /begin OUT_MEASUREMENT /end OUT_MEASUREMENT /end FUNCTION
/begin FUNCTION R_DIDWriteCDD_CSOP_DIDSet_TPMSLearnSta "" /begin DEF_CHARACTERISTIC /end DEF_CHARACTERISTIC /begin IN_MEASUREMENT /end IN_MEASUREMENT /begin OUT_MEASUREMENT /end OUT_MEASUREMENT /end FUNCTION
/begin FUNCTION R_DIDWriteCDD_CSOP_DIDSet_TestGroup "" /begin DEF_CHARACTERISTIC /end DEF_CHARACTERISTIC /begin IN_MEASUREMENT /end IN_MEASUREMENT /begin OUT_MEASUREMENT /end OUT_MEASUREMENT /end FUNCTION
/begin FUNCTION R_DIDWriteCDD_CSOP_DIDSet_TireSize "" /begin DEF_CHARACTERISTIC /end DEF_CHARACTERISTIC /begin IN_MEASUREMENT /end IN_MEASUREMENT /begin OUT_MEASUREMENT /end OUT_MEASUREMENT /end FUNCTION
/begin FUNCTION R_DIDWriteCDD_CSOP_DIDSet_TurnLampFLThreCurr "" /begin DEF_CHARACTERISTIC /end DEF_CHARACTERISTIC /begin IN_MEASUREMENT /end IN_MEASUREMENT /begin OUT_MEASUREMENT /end OUT_MEASUREMENT /end FUNCTION
/begin FUNCTION R_DIDWriteCDD_CSOP_DIDSet_TurnLampFRThreCurr "" /begin DEF_CHARACTERISTIC /end DEF_CHARACTERISTIC /begin IN_MEASUREMENT /end IN_MEASUREMENT /begin OUT_MEASUREMENT /end OUT_MEASUREMENT /end FUNCTION
/begin FUNCTION R_DIDWriteCDD_CSOP_DIDSet_TurnLampRLThreCurr "" /begin DEF_CHARACTERISTIC /end DEF_CHARACTERISTIC /begin IN_MEASUREMENT /end IN_MEASUREMENT /begin OUT_MEASUREMENT /end OUT_MEASUREMENT /end FUNCTION
/begin FUNCTION R_DIDWriteCDD_CSOP_DIDSet_TurnLampRRThreCurr "" /begin DEF_CHARACTERISTIC /end DEF_CHARACTERISTIC /begin IN_MEASUREMENT /end IN_MEASUREMENT /begin OUT_MEASUREMENT /end OUT_MEASUREMENT /end FUNCTION
/begin FUNCTION R_DIDWriteCDD_CSOP_DIDSet_UIDSta "" /begin DEF_CHARACTERISTIC /end DEF_CHARACTERISTIC /begin IN_MEASUREMENT /end IN_MEASUREMENT /begin OUT_MEASUREMENT /end OUT_MEASUREMENT /end FUNCTION
/begin FUNCTION R_DIDWriteCDD_CSOP_DIDSet_USSConfig "" /begin DEF_CHARACTERISTIC /end DEF_CHARACTERISTIC /begin IN_MEASUREMENT /end IN_MEASUREMENT /begin OUT_MEASUREMENT /end OUT_MEASUREMENT /end FUNCTION
/begin FUNCTION R_DIDWriteCDD_CSOP_DIDSet_UWBAnchorSta "" /begin DEF_CHARACTERISTIC /end DEF_CHARACTERISTIC /begin IN_MEASUREMENT /end IN_MEASUREMENT /begin OUT_MEASUREMENT /end OUT_MEASUREMENT /end FUNCTION
/begin FUNCTION R_DIDWriteCDD_CSOP_DIDSet_VIN "" /begin DEF_CHARACTERISTIC /end DEF_CHARACTERISTIC /begin IN_MEASUREMENT /end IN_MEASUREMENT /begin OUT_MEASUREMENT /end OUT_MEASUREMENT /end FUNCTION
/begin FUNCTION R_DIDWriteCDD_CSOP_DIDSet_VSS "" /begin DEF_CHARACTERISTIC /end DEF_CHARACTERISTIC /begin IN_MEASUREMENT /end IN_MEASUREMENT /begin OUT_MEASUREMENT /end OUT_MEASUREMENT /end FUNCTION
/begin FUNCTION R_DIDWriteCDD_CSOP_DIDSet_WhlPres "" /begin DEF_CHARACTERISTIC /end DEF_CHARACTERISTIC /begin IN_MEASUREMENT /end IN_MEASUREMENT /begin OUT_MEASUREMENT /end OUT_MEASUREMENT /end FUNCTION
/begin FUNCTION R_DIDWriteCDD_CSOP_DIDSet_WhlSensorBattSta "" /begin DEF_CHARACTERISTIC /end DEF_CHARACTERISTIC /begin IN_MEASUREMENT /end IN_MEASUREMENT /begin OUT_MEASUREMENT /end OUT_MEASUREMENT /end FUNCTION
/begin FUNCTION R_DIDWriteCDD_CSOP_DIDSet_WhlTmp "" /begin DEF_CHARACTERISTIC /end DEF_CHARACTERISTIC /begin IN_MEASUREMENT /end IN_MEASUREMENT /begin OUT_MEASUREMENT /end OUT_MEASUREMENT /end FUNCTION
/begin FUNCTION R_DIDWriteCDD_CSOP_DIDSet_WipRLSCmdCutFilter "" /begin DEF_CHARACTERISTIC /end DEF_CHARACTERISTIC /begin IN_MEASUREMENT /end IN_MEASUREMENT /begin OUT_MEASUREMENT /end OUT_MEASUREMENT /end FUNCTION
/begin FUNCTION R_DIDWriteCDD_CSOP_DIDSet_WipRLSCmdHoldFilter "" /begin DEF_CHARACTERISTIC /end DEF_CHARACTERISTIC /begin IN_MEASUREMENT /end IN_MEASUREMENT /begin OUT_MEASUREMENT /end OUT_MEASUREMENT /end FUNCTION
/begin FUNCTION R_DIDWriteCDD_CSOP_DIDSet_XWDMode "" /begin DEF_CHARACTERISTIC /end DEF_CHARACTERISTIC /begin IN_MEASUREMENT /end IN_MEASUREMENT /begin OUT_MEASUREMENT /end OUT_MEASUREMENT /end FUNCTION
/begin FUNCTION R_E2E_CAN3_VCU1_CSOP_Write_CAN3_VCU1 "" /begin SUB_FUNCTION R_E2E_CAN3_VCU1_CSOP_Write_CAN3_VCU1 /end SUB_FUNCTION /begin DEF_CHARACTERISTIC /end DEF_CHARACTERISTIC /begin IN_MEASUREMENT /end IN_MEASUREMENT /begin OUT_MEASUREMENT /end OUT_MEASUREMENT /end FUNCTION
/begin FUNCTION R_E2E_CAN3_VCU1_toNIDEC_CSOP_Write_CAN3_VCU1_toNIDEC "" /begin SUB_FUNCTION R_E2E_CAN3_VCU1_toNIDEC_CSOP_Write_CAN3_VCU1_toNIDEC /end SUB_FUNCTION /begin DEF_CHARACTERISTIC /end DEF_CHARACTERISTIC /begin IN_MEASUREMENT /end IN_MEASUREMENT /begin OUT_MEASUREMENT /end OUT_MEASUREMENT /end FUNCTION
/begin FUNCTION R_E2E_CAN4_VCU1_CSOP_Write_CAN4_VCU1 "" /begin SUB_FUNCTION R_E2E_CAN4_VCU1_CSOP_Write_CAN4_VCU1 /end SUB_FUNCTION /begin DEF_CHARACTERISTIC /end DEF_CHARACTERISTIC /begin IN_MEASUREMENT /end IN_MEASUREMENT /begin OUT_MEASUREMENT /end OUT_MEASUREMENT /end FUNCTION
/begin FUNCTION CAN1 ""
 /begin SUB_FUNCTION DT_CAN1_SG_FD1_APS2 DT_CAN1_SG_FD1_BCM1 DT_CAN1_SG_FD1_THCM1 DT_CAN1_SG_FD1_VCU1 DT_CAN1_SG_FD1_VMC1 DT_CAN1_SG_FD1_VMC2 FD1_APS2_0x210 FD1_APS3_0x238 FD1_APS3_Tx FD1_BCM1_0x216 FD1_THCM1_0x182 FD1_VCU1_0x116 FD1_VCU2_0x154 FD1_VCU2_Tx FD1_VCU3_0x159 FD1_VCU3_Tx FD1_VMC1_0x17F FD1_VMC2_0x77 VMC_FCM1_0x172 VMC_FCM1_Tx Constant Constant1 Constant2 Constant3 /end SUB_FUNCTION
 /begin DEF_CHARACTERISTIC /end DEF_CHARACTERISTIC
 /begin IN_MEASUREMENT /end IN_MEASUREMENT
 /begin OUT_MEASUREMENT /end OUT_MEASUREMENT
/end FUNCTION
/begin FUNCTION CAN2 ""
 /begin SUB_FUNCTION DT_CAN2_SG_FD2_C20_0 DT_CAN2_SG_FD2_CE100_0 DT_CAN2_SG_FD2_CE200_1 DT_CAN2_SG_FD2_Version DT_CAN2_SG_GW2_CE100_0 DT_CAN2_SG_GW2_CE100_1 DT_CAN2_SG_GW2_CE200_0 FD2_C20_0_0x210 FD2_CE100_0_0x117 FD2_CE200_1_0x435 FD2_Version_0x3C3 GW2_CE100_0_0x1C2 GW2_CE100_1_0x357 GW2_CE200_0_0x174 /end SUB_FUNCTION
 /begin DEF_CHARACTERISTIC /end DEF_CHARACTERISTIC
 /begin IN_MEASUREMENT /end IN_MEASUREMENT
 /begin OUT_MEASUREMENT /end OUT_MEASUREMENT
/end FUNCTION
/begin FUNCTION CAN3 ""
 /begin SUB_FUNCTION DT_CAN3_SG_FD3_BCM1 DT_CAN3_SG_FD3_C100_0 DT_CAN3_SG_FD3_V2L1 DT_CAN3_SG_FD3_VCU0 DT_CAN3_SG_FD3_VCU1 DT_CAN3_SG_FD3_VCU1_toNIDEC DT_CAN3_SG_FD3_VCU5 DT_CAN3_SG_GW_ESC1_toNIDEC DT_CAN3_SG_GW_IVI6_toNIDEC FD3_BCM1_0x216 FD3_C100_0_0x182 FD3_V2L1_0x374 FD3_VCU0_0x1F0 FD3_VCU1_0x115 FD3_VCU1_Tx FD3_VCU1_toNIDEC_0x116 FD3_VCU1_toNIDEC_Tx FD3_VCU2_0x153 FD3_VCU2_Tx FD3_VCU2_toNIDEC_0x154 FD3_VCU2_toNIDEC_Tx FD3_VCU5_0x155 GW_ESC1_toNIDEC_0x152 GW_IVI6_toNIDEC_0x49F Constant Constant1 Constant2 Constant3 /end SUB_FUNCTION
 /begin DEF_CHARACTERISTIC /end DEF_CHARACTERISTIC
 /begin IN_MEASUREMENT /end IN_MEASUREMENT
 /begin OUT_MEASUREMENT /end OUT_MEASUREMENT
/end FUNCTION
/begin FUNCTION CAN4 ""
 /begin SUB_FUNCTION E2E_CAN4_SG_FD4_CE100_0_Trigger DT_CAN4_SG_FD4_CE100_1 DT_CAN4_SG_FD4_CE200_0 DT_CAN4_SG_GW4_CE100_0 Detect_Change FD4_CE100_0_0x116 FD4_CE100_0_Tx FD4_CE100_1_0x182 FD4_CE200_0_0x217 Function_Call_Subsystem GW4_CE100_0_0x253 Constant Unit_Delay /end SUB_FUNCTION
 /begin DEF_CHARACTERISTIC /end DEF_CHARACTERISTIC
 /begin IN_MEASUREMENT /end IN_MEASUREMENT
 /begin OUT_MEASUREMENT /end OUT_MEASUREMENT
/end FUNCTION
/begin FUNCTION CAN5 ""
 /begin SUB_FUNCTION DT_CAN5_SG_FD5_CE100_0 DT_CAN5_SG_FD5_Debug1 DT_CAN5_SG_FD5_Debug2 DT_CAN5_SG_FD5_Debug3 DT_CAN5_SG_GW5_CE100_0 FD5_CE100_0_0x118 FD5_Debug1_0x4D0 FD5_Debug2_0x4F7 FD5_Debug3_0x4F3 GW5_CE100_0_0x1C5 /end SUB_FUNCTION
 /begin DEF_CHARACTERISTIC /end DEF_CHARACTERISTIC
 /begin IN_MEASUREMENT /end IN_MEASUREMENT
 /begin OUT_MEASUREMENT /end OUT_MEASUREMENT
/end FUNCTION
/begin FUNCTION CAN6 ""
 /begin SUB_FUNCTION DT_CAN6_SG_FD6_BCM1 DT_CAN6_SG_FD6_VCU1 DT_CAN6_SG_FD6_VMC1 DT_CAN6_SG_GW6_CE100_0 FD6_APS3_0x238 FD6_APS3_Tx FD6_BCM1_0x216 FD6_VCU1_0x116 FD6_VCU2_0x154 FD6_VCU2_Tx FD6_VMC1_0x17F GW6_CE100_0_0x1C6 Constant Constant1 /end SUB_FUNCTION
 /begin DEF_CHARACTERISTIC /end DEF_CHARACTERISTIC
 /begin IN_MEASUREMENT /end IN_MEASUREMENT
 /begin OUT_MEASUREMENT /end OUT_MEASUREMENT
/end FUNCTION
/begin FUNCTION CAN_Scheduler "" /begin DEF_CHARACTERISTIC /end DEF_CHARACTERISTIC /begin IN_MEASUREMENT /end IN_MEASUREMENT /begin OUT_MEASUREMENT /end OUT_MEASUREMENT /end FUNCTION
/begin FUNCTION Constant "" /begin DEF_CHARACTERISTIC KHAL_CAN1TxReq_flg /end DEF_CHARACTERISTIC /begin IN_MEASUREMENT /end IN_MEASUREMENT /begin OUT_MEASUREMENT /end OUT_MEASUREMENT /end FUNCTION
/begin FUNCTION Constant1 "" /begin DEF_CHARACTERISTIC KHAL_CAN2TxReq_flg /end DEF_CHARACTERISTIC /begin IN_MEASUREMENT /end IN_MEASUREMENT /begin OUT_MEASUREMENT /end OUT_MEASUREMENT /end FUNCTION
/begin FUNCTION Constant2 "" /begin DEF_CHARACTERISTIC KHAL_CAN3TxReq_flg /end DEF_CHARACTERISTIC /begin IN_MEASUREMENT /end IN_MEASUREMENT /begin OUT_MEASUREMENT /end OUT_MEASUREMENT /end FUNCTION
/begin FUNCTION Constant3 "" /begin DEF_CHARACTERISTIC KHAL_CAN4TxReq_flg /end DEF_CHARACTERISTIC /begin IN_MEASUREMENT /end IN_MEASUREMENT /begin OUT_MEASUREMENT /end OUT_MEASUREMENT /end FUNCTION
/begin FUNCTION Constant4 "" /begin DEF_CHARACTERISTIC KHAL_CAN5TxReq_flg /end DEF_CHARACTERISTIC /begin IN_MEASUREMENT /end IN_MEASUREMENT /begin OUT_MEASUREMENT /end OUT_MEASUREMENT /end FUNCTION
/begin FUNCTION Constant5 "" /begin DEF_CHARACTERISTIC KHAL_CAN6TxReq_flg /end DEF_CHARACTERISTIC /begin IN_MEASUREMENT /end IN_MEASUREMENT /begin OUT_MEASUREMENT /end OUT_MEASUREMENT /end FUNCTION
/begin FUNCTION ApsOut_GearPosnSig "" /begin DEF_CHARACTERISTIC /end DEF_CHARACTERISTIC /begin IN_MEASUREMENT /end IN_MEASUREMENT /begin OUT_MEASUREMENT /end OUT_MEASUREMENT /end FUNCTION
/begin FUNCTION ApsOut_SendChrgPlugStaSig "" /begin DEF_CHARACTERISTIC /end DEF_CHARACTERISTIC /begin IN_MEASUREMENT /end IN_MEASUREMENT /begin OUT_MEASUREMENT /end OUT_MEASUREMENT /end FUNCTION
/begin FUNCTION ApsOut_SetFrSensorOnCmd "" /begin DEF_CHARACTERISTIC /end DEF_CHARACTERISTIC /begin IN_MEASUREMENT /end IN_MEASUREMENT /begin OUT_MEASUREMENT /end OUT_MEASUREMENT /end FUNCTION
/begin FUNCTION ApsOut_SetFrSensorSwTOCmd "" /begin DEF_CHARACTERISTIC /end DEF_CHARACTERISTIC /begin IN_MEASUREMENT /end IN_MEASUREMENT /begin OUT_MEASUREMENT /end OUT_MEASUREMENT /end FUNCTION
/begin FUNCTION ApsOut_SetVehSpdTOCmd "" /begin DEF_CHARACTERISTIC /end DEF_CHARACTERISTIC /begin IN_MEASUREMENT /end IN_MEASUREMENT /begin OUT_MEASUREMENT /end OUT_MEASUREMENT /end FUNCTION
/begin FUNCTION ApsOut_VehSpdSig "" /begin DEF_CHARACTERISTIC /end DEF_CHARACTERISTIC /begin IN_MEASUREMENT /end IN_MEASUREMENT /begin OUT_MEASUREMENT /end OUT_MEASUREMENT /end FUNCTION
/begin FUNCTION HAL_NvmWriteData_raw "" /begin DEF_CHARACTERISTIC /end DEF_CHARACTERISTIC /begin IN_MEASUREMENT /end IN_MEASUREMENT /begin OUT_MEASUREMENT /end OUT_MEASUREMENT /end FUNCTION
/begin FUNCTION DTC_Trigger "" /begin DEF_CHARACTERISTIC /end DEF_CHARACTERISTIC /begin IN_MEASUREMENT /end IN_MEASUREMENT /begin OUT_MEASUREMENT /end OUT_MEASUREMENT /end FUNCTION
/begin FUNCTION Header_Array "" /begin DEF_CHARACTERISTIC /end DEF_CHARACTERISTIC /begin IN_MEASUREMENT /end IN_MEASUREMENT /begin OUT_MEASUREMENT /end OUT_MEASUREMENT /end FUNCTION
/begin FUNCTION DTC_Array "" /begin DEF_CHARACTERISTIC /end DEF_CHARACTERISTIC /begin IN_MEASUREMENT /end IN_MEASUREMENT /begin OUT_MEASUREMENT /end OUT_MEASUREMENT /end FUNCTION
/begin FUNCTION BOUTP_DIDSetData_outputs "" /begin DEF_CHARACTERISTIC /end DEF_CHARACTERISTIC /begin IN_MEASUREMENT /end IN_MEASUREMENT /begin OUT_MEASUREMENT /end OUT_MEASUREMENT /end FUNCTION
/begin FUNCTION APM "" /begin SUB_FUNCTION /end SUB_FUNCTION /begin DEF_CHARACTERISTIC /end DEF_CHARACTERISTIC /begin IN_MEASUREMENT /end IN_MEASUREMENT /begin OUT_MEASUREMENT /end OUT_MEASUREMENT /end FUNCTION
/begin FUNCTION DID_list ""
 /begin SUB_FUNCTION Bit_Shift Bit_Shift1 Bit_Shift2 Bit_Shift3 Bit_Shift4 Bit_Shift5 SignalPack181 SignalPack182 SignalPack183 SignalPack184 SignalPack185 SignalPack186 SignalPack187 SignalPack188 SignalPack189 SignalPack190 SignalPack191 SignalPack192 SignalPack193 SignalPack194 SignalPack195 SignalPack196 SignalPack197 SignalPack198 SignalPack199 SignalPack200 SignalPack201 SignalPack302 SignalPack323 SignalPack344 SignalPack345 SignalPack346 SignalPack347 SignalPack348 SignalPack349 SignalPack350 SignalPack351 SignalPack352 SignalPack353 convert_in convert_in1 convert_in10 convert_in11 convert_in12 convert_in13 convert_in14 convert_in15 convert_in16 convert_in17 convert_in18 convert_in19 convert_in2 convert_in20 convert_in21 convert_in22 convert_in23 convert_in24 convert_in25 convert_in26 convert_in27 convert_in28 convert_in29 convert_in3 convert_in30 convert_in31 convert_in32 convert_in33 convert_in34 convert_in35 convert_in36 convert_in4 convert_in5 convert_in6 convert_in7 convert_in8 convert_in9 convert_out convert_out1 convert_out100 convert_out101 convert_out2 convert_out3 convert_out56 convert_out57 convert_out58 convert_out59 convert_out61 convert_out62 convert_out63 convert_out64 convert_out65 convert_out66 convert_out67 convert_out68 convert_out69 convert_out70 convert_out72 convert_out73 convert_out74 convert_out75 convert_out76 convert_out77 convert_out78 convert_out90 convert_out94 convert_out97 convert_out98 convert_out99 pct2raw1 pct2raw8 uint16Touint8Array1 uint16Touint8Array10 uint16Touint8Array11 uint16Touint8Array12 uint16Touint8Array13 uint16Touint8Array14 uint16Touint8Array15 uint16Touint8Array16 uint16Touint8Array17 uint16Touint8Array18 uint16Touint8Array19 uint16Touint8Array2 uint16Touint8Array20 uint16Touint8Array21 uint16Touint8Array22 uint16Touint8Array23 uint16Touint8Array24 uint16Touint8Array25 uint16Touint8Array26 uint16Touint8Array27 uint16Touint8Array28 uint16Touint8Array29 uint16Touint8Array3 uint16Touint8Array4 uint16Touint8Array5 uint16Touint8Array6 uint16Touint8Array7 uint16Touint8Array8 uint16Touint8Array9 uint32Touint8Array uint32Touint8Array1 uint32Touint8Array10 uint32Touint8Array11 uint32Touint8Array12 uint32Touint8Array13 uint32Touint8Array14 uint32Touint8Array15 uint32Touint8Array16 uint32Touint8Array17 uint32Touint8Array18 uint32Touint8Array19 uint32Touint8Array2 uint32Touint8Array20 uint32Touint8Array21 uint32Touint8Array22 uint32Touint8Array23 uint32Touint8Array24 uint32Touint8Array25 uint32Touint8Array26 uint32Touint8Array27 uint32Touint8Array28 uint32Touint8Array29 uint32Touint8Array3 uint32Touint8Array30 uint32Touint8Array31 uint32Touint8Array32 uint32Touint8Array33 uint32Touint8Array34 uint32Touint8Array35 uint32Touint8Array36 uint32Touint8Array37 uint32Touint8Array38 uint32Touint8Array39 uint32Touint8Array4 uint32Touint8Array40 uint32Touint8Array41 uint32Touint8Array42 uint32Touint8Array43 uint32Touint8Array44 uint32Touint8Array45 uint32Touint8Array46 uint32Touint8Array47 uint32Touint8Array48 uint32Touint8Array49 uint32Touint8Array5 uint32Touint8Array50 uint32Touint8Array51 uint32Touint8Array52 uint32Touint8Array53 uint32Touint8Array54 uint32Touint8Array55 uint32Touint8Array56 uint32Touint8Array57 uint32Touint8Array58 uint32Touint8Array59 uint32Touint8Array6 uint32Touint8Array60 uint32Touint8Array61 uint32Touint8Array62 uint32Touint8Array63 uint32Touint8Array64 uint32Touint8Array65 uint32Touint8Array66 uint32Touint8Array67 uint32Touint8Array68 uint32Touint8Array69 uint32Touint8Array7 uint32Touint8Array70 uint32Touint8Array71 uint32Touint8Array72 uint32Touint8Array73 uint32Touint8Array74 uint32Touint8Array75 uint32Touint8Array76 uint32Touint8Array77 uint32Touint8Array78 uint32Touint8Array79 uint32Touint8Array8 uint32Touint8Array80 uint32Touint8Array81 uint32Touint8Array82 uint32Touint8Array83 uint32Touint8Array84 uint32Touint8Array85 uint32Touint8Array86 uint32Touint8Array9 Shift_Arithmetic37 Shift_Arithmetic38 Shift_Arithmetic39 Shift_Arithmetic40 Shift_Arithmetic41 Shift_Arithmetic42 Constant Constant1 Constant10 Constant11 Constant12 Constant13 Constant14 Constant15 Constant16 Constant2 Constant3 Constant4 Constant5 Constant6 Constant7 Constant8 Constant9 Data_Type_Conversion Data_Type_Conversion1 Data_Type_Conversion10 Data_Type_Conversion11 Data_Type_Conversion12 Data_Type_Conversion13 Data_Type_Conversion14 Data_Type_Conversion15 Data_Type_Conversion16 Data_Type_Conversion168 Data_Type_Conversion169 Data_Type_Conversion17 Data_Type_Conversion170 Data_Type_Conversion171 Data_Type_Conversion172 Data_Type_Conversion174 Data_Type_Conversion175 Data_Type_Conversion176 Data_Type_Conversion177 Data_Type_Conversion179 Data_Type_Conversion18 Data_Type_Conversion19 Data_Type_Conversion2 Data_Type_Conversion20 Data_Type_Conversion21 Data_Type_Conversion22 Data_Type_Conversion23 Data_Type_Conversion25 Data_Type_Conversion27 Data_Type_Conversion29 Data_Type_Conversion3 Data_Type_Conversion33 Data_Type_Conversion34 Data_Type_Conversion35 Data_Type_Conversion36 Data_Type_Conversion4 Data_Type_Conversion46 Data_Type_Conversion47 Data_Type_Conversion48 Data_Type_Conversion49 Data_Type_Conversion5 Data_Type_Conversion50 Data_Type_Conversion51 Data_Type_Conversion52 Data_Type_Conversion53 Data_Type_Conversion54 Data_Type_Conversion55 Data_Type_Conversion56 Data_Type_Conversion57 Data_Type_Conversion58 Data_Type_Conversion6 Data_Type_Conversion7 Data_Type_Conversion8 Data_Type_Conversion9 UnitConverter237 UnitConverter239 UnitConverter241 UnitConverter242 UnitConverter243 UnitConverter244 UnitConverter245 UnitConverter246 UnitConverter247 UnitConverter248 UnitConverter249 UnitConverter251 UnitConverter253 UnitConverter255 UnitConverter257 UnitConverter258 UnitConverter259 UnitConverter260 UnitConverter261 UnitConverter262 UnitConverter263 UnitConverter264 UnitConverter265 UnitConverter266 UnitConverter267 UnitConverter268 UnitConverter269 UnitConverter270 UnitConverter271 UnitConverter272 UnitConverter273 UnitConverter274 UnitConverter275 UnitConverter276 UnitConverter277 UnitConverter278 UnitConverter389 UnitConverter390 UnitConverter413 UnitConverter414 UnitConverter437 UnitConverter438 UnitConverter439 UnitConverter440 UnitConverter441 UnitConverter442 UnitConverter443 UnitConverter444 UnitConverter445 UnitConverter446 UnitConverter447 UnitConverter448 UnitConverter449 UnitConverter450 UnitConverter451 Multiply1 Multiply2 Logical_Operator1 Switch Switch1 /end SUB_FUNCTION
 /begin DEF_CHARACTERISTIC /end DEF_CHARACTERISTIC
 /begin IN_MEASUREMENT /end IN_MEASUREMENT
 /begin OUT_MEASUREMENT /end OUT_MEASUREMENT
/end FUNCTION
/begin FUNCTION DTC_list ""
 /begin SUB_FUNCTION DTCHeader DTCHeader1 DTCHeader2 DTCHeader3 DTCHeader4 DTCHeader5 DTCHeader6 DTCHeader7 DTCHeader8 DTCHeader9 DTCID_Status DTCID_Status1 DTCID_Status10 DTCID_Status100 DTCID_Status101 DTCID_Status102 DTCID_Status103 DTCID_Status104 DTCID_Status105 DTCID_Status106 DTCID_Status107 DTCID_Status108 DTCID_Status109 DTCID_Status11 DTCID_Status110 DTCID_Status111 DTCID_Status112 DTCID_Status113 DTCID_Status114 DTCID_Status115 DTCID_Status116 DTCID_Status117 DTCID_Status118 DTCID_Status119 DTCID_Status12 DTCID_Status120 DTCID_Status121 DTCID_Status122 DTCID_Status123 DTCID_Status124 DTCID_Status125 DTCID_Status126 DTCID_Status127 DTCID_Status128 DTCID_Status129 DTCID_Status13 DTCID_Status130 DTCID_Status131 DTCID_Status132 DTCID_Status133 DTCID_Status134 DTCID_Status135 DTCID_Status136 DTCID_Status137 DTCID_Status138 DTCID_Status139 DTCID_Status14 DTCID_Status140 DTCID_Status141 DTCID_Status142 DTCID_Status143 DTCID_Status144 DTCID_Status145 DTCID_Status146 DTCID_Status147 DTCID_Status148 DTCID_Status149 DTCID_Status15 DTCID_Status150 DTCID_Status151 DTCID_Status152 DTCID_Status153 DTCID_Status154 DTCID_Status155 DTCID_Status156 DTCID_Status157 DTCID_Status158 DTCID_Status159 DTCID_Status16 DTCID_Status160 DTCID_Status161 DTCID_Status162 DTCID_Status163 DTCID_Status164 DTCID_Status165 DTCID_Status166 DTCID_Status167 DTCID_Status168 DTCID_Status169 DTCID_Status17 DTCID_Status170 DTCID_Status171 DTCID_Status172 DTCID_Status173 DTCID_Status174 DTCID_Status175 DTCID_Status176 DTCID_Status18 DTCID_Status19 DTCID_Status2 DTCID_Status20 DTCID_Status21 DTCID_Status22 DTCID_Status23 DTCID_Status24 DTCID_Status25 DTCID_Status26 DTCID_Status27 DTCID_Status28 DTCID_Status29 DTCID_Status3 DTCID_Status30 DTCID_Status31 DTCID_Status32 DTCID_Status33 DTCID_Status34 DTCID_Status35 DTCID_Status36 DTCID_Status37 DTCID_Status38 DTCID_Status39 DTCID_Status4 DTCID_Status40 DTCID_Status41 DTCID_Status42 DTCID_Status43 DTCID_Status44 DTCID_Status45 DTCID_Status46 DTCID_Status47 DTCID_Status48 DTCID_Status49 DTCID_Status5 DTCID_Status50 DTCID_Status51 DTCID_Status52 DTCID_Status53 DTCID_Status54 DTCID_Status55 DTCID_Status56 DTCID_Status57 DTCID_Status58 DTCID_Status59 DTCID_Status6 DTCID_Status60 DTCID_Status61 DTCID_Status62 DTCID_Status63 DTCID_Status64 DTCID_Status65 DTCID_Status66 DTCID_Status67 DTCID_Status68 DTCID_Status69 DTCID_Status7 DTCID_Status70 DTCID_Status71 DTCID_Status72 DTCID_Status73 DTCID_Status74 DTCID_Status75 DTCID_Status76 DTCID_Status77 DTCID_Status78 DTCID_Status79 DTCID_Status8 DTCID_Status80 DTCID_Status81 DTCID_Status82 DTCID_Status83 DTCID_Status84 DTCID_Status85 DTCID_Status86 DTCID_Status87 DTCID_Status88 DTCID_Status89 DTCID_Status9 DTCID_Status90 DTCID_Status91 DTCID_Status92 DTCID_Status93 DTCID_Status94 DTCID_Status95 DTCID_Status96 DTCID_Status97 DTCID_Status98 DTCID_Status99 detect_change Constant Constant1 Constant10 Constant100 Constant101 Constant102 Constant103 Constant104 Constant105 Constant106 Constant107 Constant108 Constant109 Constant11 Constant110 Constant111 Constant112 Constant113 Constant114 Constant115 Constant116 Constant117 Constant118 Constant119 Constant12 Constant120 Constant121 Constant122 Constant123 Constant124 Constant125 Constant126 Constant127 Constant128 Constant129 Constant13 Constant130 Constant131 Constant132 Constant133 Constant134 Constant135 Constant136 Constant137 Constant138 Constant139 Constant14 Constant140 Constant141 Constant142 Constant143 Constant144 Constant145 Constant146 Constant147 Constant148 Constant149 Constant15 Constant150 Constant151 Constant152 Constant153 Constant154 Constant155 Constant156 Constant157 Constant158 Constant159 Constant16 Constant160 Constant161 Constant162 Constant163 Constant164 Constant165 Constant166 Constant167 Constant168 Constant169 Constant17 Constant170 Constant171 Constant172 Constant173 Constant174 Constant175 Constant176 Constant177 Constant178 Constant179 Constant18 Constant180 Constant181 Constant182 Constant183 Constant184 Constant185 Constant186 Constant187 Constant188 Constant189 Constant19 Constant190 Constant191 Constant192 Constant193 Constant194 Constant195 Constant196 Constant197 Constant198 Constant2 Constant20 Constant200 Constant201 Constant202 Constant203 Constant204 Constant205 Constant206 Constant207 Constant208 Constant209 Constant21 Constant210 Constant211 Constant212 Constant213 Constant214 Constant215 Constant216 Constant217 Constant218 Constant219 Constant22 Constant220 Constant221 Constant23 Constant24 Constant25 Constant26 Constant27 Constant28 Constant29 Constant3 Constant30 Constant31 Constant32 Constant33 Constant34 Constant35 Constant36 Constant37 Constant38 Constant39 Constant4 Constant40 Constant41 Constant42 Constant43 Constant44 Constant45 Constant46 Constant47 Constant48 Constant49 Constant5 Constant50 Constant51 Constant52 Constant53 Constant54 Constant55 Constant56 Constant57 Constant58 Constant59 Constant6 Constant60 Constant61 Constant62 Constant63 Constant64 Constant65 Constant66 Constant67 Constant68 Constant69 Constant7 Constant70 Constant71 Constant72 Constant73 Constant74 Constant75 Constant76 Constant77 Constant78 Constant79 Constant8 Constant80 Constant81 Constant82 Constant83 Constant84 Constant85 Constant86 Constant87 Constant88 Constant89 Constant9 Constant90 Constant91 Constant92 Constant93 Constant94 Constant95 Constant96 Constant97 Constant98 Constant99 DTCID DTCID1 DTCID10 DTCID100 DTCID101 DTCID102 DTCID103 DTCID104 DTCID105 DTCID106 DTCID107 DTCID108 DTCID109 DTCID11 DTCID110 DTCID111 DTCID112 DTCID113 DTCID114 DTCID115 DTCID116 DTCID117 DTCID118 DTCID119 DTCID12 DTCID120 DTCID121 DTCID122 DTCID123 DTCID124 DTCID125 DTCID126 DTCID127 DTCID128 DTCID129 DTCID13 DTCID130 DTCID131 DTCID132 DTCID133 DTCID134 DTCID135 DTCID136 DTCID137 DTCID138 DTCID139 DTCID14 DTCID140 DTCID141 DTCID142 DTCID143 DTCID144 DTCID145 DTCID146 DTCID147 DTCID148 DTCID149 DTCID15 DTCID150 DTCID151 DTCID152 DTCID153 DTCID154 DTCID155 DTCID156 DTCID157 DTCID158 DTCID159 DTCID16 DTCID160 DTCID161 DTCID162 DTCID163 DTCID164 DTCID165 DTCID166 DTCID167 DTCID168 DTCID169 DTCID17 DTCID170 DTCID171 DTCID172 DTCID173 DTCID174 DTCID175 DTCID176 DTCID18 DTCID19 DTCID2 DTCID20 DTCID21 DTCID22 DTCID23 DTCID24 DTCID25 DTCID26 DTCID27 DTCID28 DTCID29 DTCID3 DTCID30 DTCID31 DTCID32 DTCID33 DTCID34 DTCID35 DTCID36 DTCID37 DTCID38 DTCID39 DTCID4 DTCID40 DTCID41 DTCID42 DTCID43 DTCID44 DTCID45 DTCID46 DTCID47 DTCID48 DTCID49 DTCID5 DTCID50 DTCID51 DTCID52 DTCID53 DTCID54 DTCID55 DTCID56 DTCID57 DTCID58 DTCID59 DTCID6 DTCID60 DTCID61 DTCID62 DTCID63 DTCID64 DTCID65 DTCID66 DTCID67 DTCID68 DTCID69 DTCID7 DTCID70 DTCID71 DTCID72 DTCID73 DTCID74 DTCID75 DTCID76 DTCID77 DTCID78 DTCID79 DTCID8 DTCID80 DTCID81 DTCID82 DTCID83 DTCID84 DTCID85 DTCID86 DTCID87 DTCID88 DTCID89 DTCID9 DTCID90 DTCID91 DTCID92 DTCID93 DTCID94 DTCID95 DTCID96 DTCID97 DTCID98 DTCID99 Constant222 UnitConverter OR OR1 OR10 OR11 OR12 OR13 OR14 OR15 OR16 OR17 OR18 OR19 OR2 OR20 OR3 OR4 OR5 OR6 OR7 OR8 OR9 /end SUB_FUNCTION
 /begin DEF_CHARACTERISTIC /end DEF_CHARACTERISTIC
 /begin IN_MEASUREMENT /end IN_MEASUREMENT
 /begin OUT_MEASUREMENT /end OUT_MEASUREMENT
/end FUNCTION
/begin FUNCTION Subsystem5 "" /begin SUB_FUNCTION Enabled_Subsystem /end SUB_FUNCTION /begin DEF_CHARACTERISTIC /end DEF_CHARACTERISTIC /begin IN_MEASUREMENT /end IN_MEASUREMENT /begin OUT_MEASUREMENT /end OUT_MEASUREMENT /end FUNCTION
/begin FUNCTION DIDLen7 "" /begin DEF_CHARACTERISTIC /end DEF_CHARACTERISTIC /begin IN_MEASUREMENT /end IN_MEASUREMENT /begin OUT_MEASUREMENT /end OUT_MEASUREMENT /end FUNCTION
/begin FUNCTION DIDNum7 "" /begin DEF_CHARACTERISTIC /end DEF_CHARACTERISTIC /begin IN_MEASUREMENT /end IN_MEASUREMENT /begin OUT_MEASUREMENT /end OUT_MEASUREMENT /end FUNCTION
/begin FUNCTION R_DIDWriteCDD_CSOP_DIDSet_NVMPedalZP "" /begin DEF_CHARACTERISTIC /end DEF_CHARACTERISTIC /begin IN_MEASUREMENT /end IN_MEASUREMENT /begin OUT_MEASUREMENT /end OUT_MEASUREMENT /end FUNCTION
/begin FUNCTION R_FDCCDD_Inner_CSOP_FDC_AppCallSleep "" /begin DEF_CHARACTERISTIC /end DEF_CHARACTERISTIC /begin IN_MEASUREMENT /end IN_MEASUREMENT /begin OUT_MEASUREMENT /end OUT_MEASUREMENT /end FUNCTION
/begin FUNCTION R_HALOUTCDD_CSOP_AppNmStateReq "" /begin DEF_CHARACTERISTIC /end DEF_CHARACTERISTIC /begin IN_MEASUREMENT /end IN_MEASUREMENT /begin OUT_MEASUREMENT /end OUT_MEASUREMENT /end FUNCTION
/begin FUNCTION R_HALOUTCDD_CSOP_ResetPedalZeroPosDone "" /begin DEF_CHARACTERISTIC /end DEF_CHARACTERISTIC /begin IN_MEASUREMENT /end IN_MEASUREMENT /begin OUT_MEASUREMENT /end OUT_MEASUREMENT /end FUNCTION
/begin FUNCTION R_HALOUTCDD_CSOP_SetAcoreRebootCmdACK "" /begin DEF_CHARACTERISTIC /end DEF_CHARACTERISTIC /begin IN_MEASUREMENT /end IN_MEASUREMENT /begin OUT_MEASUREMENT /end OUT_MEASUREMENT /end FUNCTION
/begin FUNCTION R_HALOUTCDD_CSOP_SleepRequest "" /begin DEF_CHARACTERISTIC /end DEF_CHARACTERISTIC /begin IN_MEASUREMENT /end IN_MEASUREMENT /begin OUT_MEASUREMENT /end OUT_MEASUREMENT /end FUNCTION
/begin FUNCTION R_HALOUTCDD_CSOP_TPMSSensorIDRegSetResults "" /begin DEF_CHARACTERISTIC /end DEF_CHARACTERISTIC /begin IN_MEASUREMENT /end IN_MEASUREMENT /begin OUT_MEASUREMENT /end OUT_MEASUREMENT /end FUNCTION
/begin FUNCTION R_IOExpOUT_CDD_CSOP_IOExpSetVal "" /begin DEF_CHARACTERISTIC /end DEF_CHARACTERISTIC /begin IN_MEASUREMENT /end IN_MEASUREMENT /begin OUT_MEASUREMENT /end OUT_MEASUREMENT /end FUNCTION
/begin FUNCTION R_NVMWriteCDD_Inner_NVM_WriteOperation "" /begin DEF_CHARACTERISTIC /end DEF_CHARACTERISTIC /begin IN_MEASUREMENT /end IN_MEASUREMENT /begin OUT_MEASUREMENT /end OUT_MEASUREMENT /end FUNCTION
/begin FUNCTION R_UDSCDD_CSOP_DdmRestartOperationCycle "" /begin DEF_CHARACTERISTIC /end DEF_CHARACTERISTIC /begin IN_MEASUREMENT /end IN_MEASUREMENT /begin OUT_MEASUREMENT /end OUT_MEASUREMENT /end FUNCTION
/begin FUNCTION Out1 "" /begin DEF_CHARACTERISTIC /end DEF_CHARACTERISTIC /begin IN_MEASUREMENT /end IN_MEASUREMENT /begin OUT_MEASUREMENT /end OUT_MEASUREMENT /end FUNCTION
/begin FUNCTION R_UDSCDD_CSOP_SetDTCStatus "" /begin DEF_CHARACTERISTIC /end DEF_CHARACTERISTIC /begin IN_MEASUREMENT /end IN_MEASUREMENT /begin OUT_MEASUREMENT /end OUT_MEASUREMENT /end FUNCTION
/begin FUNCTION R_WDGCDD_CSOP_Call_WDG_AppEnd "" /begin DEF_CHARACTERISTIC /end DEF_CHARACTERISTIC /begin IN_MEASUREMENT /end IN_MEASUREMENT /begin OUT_MEASUREMENT /end OUT_MEASUREMENT /end FUNCTION
/begin FUNCTION FixPt_Relational_Operator "" /begin DEF_CHARACTERISTIC /end DEF_CHARACTERISTIC /begin IN_MEASUREMENT /end IN_MEASUREMENT /begin OUT_MEASUREMENT /end OUT_MEASUREMENT /end FUNCTION
/begin FUNCTION Delay_Input1 "" /begin DEF_CHARACTERISTIC /end DEF_CHARACTERISTIC /begin IN_MEASUREMENT /end IN_MEASUREMENT /begin OUT_MEASUREMENT /end OUT_MEASUREMENT /end FUNCTION
/begin FUNCTION FixPt_Relational_Operator "" /begin DEF_CHARACTERISTIC /end DEF_CHARACTERISTIC /begin IN_MEASUREMENT /end IN_MEASUREMENT /begin OUT_MEASUREMENT /end OUT_MEASUREMENT /end FUNCTION
/begin FUNCTION Delay_Input1 "" /begin DEF_CHARACTERISTIC /end DEF_CHARACTERISTIC /begin IN_MEASUREMENT /end IN_MEASUREMENT /begin OUT_MEASUREMENT /end OUT_MEASUREMENT /end FUNCTION
/begin FUNCTION R_E2E_CAN3_VCU1_CSOP_Write_CAN3_VCU1 "" /begin DEF_CHARACTERISTIC /end DEF_CHARACTERISTIC /begin IN_MEASUREMENT /end IN_MEASUREMENT /begin OUT_MEASUREMENT /end OUT_MEASUREMENT /end FUNCTION
/begin FUNCTION R_E2E_CAN3_VCU1_toNIDEC_CSOP_Write_CAN3_VCU1_toNIDEC "" /begin DEF_CHARACTERISTIC /end DEF_CHARACTERISTIC /begin IN_MEASUREMENT /end IN_MEASUREMENT /begin OUT_MEASUREMENT /end OUT_MEASUREMENT /end FUNCTION
/begin FUNCTION R_E2E_CAN4_VCU1_CSOP_Write_CAN4_VCU1 "" /begin DEF_CHARACTERISTIC /end DEF_CHARACTERISTIC /begin IN_MEASUREMENT /end IN_MEASUREMENT /begin OUT_MEASUREMENT /end OUT_MEASUREMENT /end FUNCTION
/begin FUNCTION DT_CAN1_SG_FD1_APS2 "" /begin DEF_CHARACTERISTIC /end DEF_CHARACTERISTIC /begin IN_MEASUREMENT /end IN_MEASUREMENT /begin OUT_MEASUREMENT /end OUT_MEASUREMENT /end FUNCTION
/begin FUNCTION DT_CAN1_SG_FD1_BCM1 "" /begin DEF_CHARACTERISTIC /end DEF_CHARACTERISTIC /begin IN_MEASUREMENT /end IN_MEASUREMENT /begin OUT_MEASUREMENT /end OUT_MEASUREMENT /end FUNCTION
/begin FUNCTION DT_CAN1_SG_FD1_THCM1 "" /begin DEF_CHARACTERISTIC /end DEF_CHARACTERISTIC /begin IN_MEASUREMENT /end IN_MEASUREMENT /begin OUT_MEASUREMENT /end OUT_MEASUREMENT /end FUNCTION
/begin FUNCTION DT_CAN1_SG_FD1_VCU1 "" /begin DEF_CHARACTERISTIC /end DEF_CHARACTERISTIC /begin IN_MEASUREMENT /end IN_MEASUREMENT /begin OUT_MEASUREMENT /end OUT_MEASUREMENT /end FUNCTION
/begin FUNCTION DT_CAN1_SG_FD1_VMC1 "" /begin DEF_CHARACTERISTIC /end DEF_CHARACTERISTIC /begin IN_MEASUREMENT /end IN_MEASUREMENT /begin OUT_MEASUREMENT /end OUT_MEASUREMENT /end FUNCTION
/begin FUNCTION DT_CAN1_SG_FD1_VMC2 "" /begin DEF_CHARACTERISTIC /end DEF_CHARACTERISTIC /begin IN_MEASUREMENT /end IN_MEASUREMENT /begin OUT_MEASUREMENT /end OUT_MEASUREMENT /end FUNCTION
/begin FUNCTION FD1_APS2_0x210 ""
 /begin SUB_FUNCTION APSDFLL APSDFLR APSDRLL APSDRLR APSExitCondition APSHWVer APSProgressPCT APSRQDisplay APSSWVer PASAFCL PASAFCR PASAFML PASAFMR PASARCL PASARCR PASARML PASARMR PASChime PASDFCL PASDFCR PASDFML PASDFMR PASDRCL PASDRCR PASDRML PASDRMR PASModOperation PASSNSRLayout PASStaFSys USSStaFCL USSStaFCR USSStaFLL USSStaFLR USSStaFML USSStaFMR USSStaRCL USSStaRCR USSStaRLL USSStaRLR USSStaRML USSStaRMR bus_creator /end SUB_FUNCTION
 /begin DEF_CHARACTERISTIC /end DEF_CHARACTERISTIC
 /begin IN_MEASUREMENT /end IN_MEASUREMENT
 /begin OUT_MEASUREMENT /end OUT_MEASUREMENT
/end FUNCTION
/begin FUNCTION FD1_APS3_0x238 ""
 /begin SUB_FUNCTION FD1_APS3 APS3LifeCount APS3checksum APSDecReq APSDecReqA APSOpenPTG APSReq APSStaSystem Byte_0 Byte_1 Byte_10 Byte_11 Byte_2 Byte_3 Byte_4 Byte_5 Byte_6 Byte_7 Byte_8 Byte_9 CAASSta CRC8_IfAction_Tx FDCAPSActiveSta FDCAPSCaasActiveSta FDCAPSCaasCtrlAvailSta FDCAPSCaasVMCReqACmd FDCAPSCtrlAvailSta FDCAPSShftPosnReqCmd FDCAPSSpeedReqCmd FDCAPSVMCReqACmd FDCRAPSBCMLampCmd FDCRAPSBCMLockReqCmd FDCRAPSErrLv1Flg FDCRAPSPwrReqAvailSta FDCRAPSPwrReqCmd FDCVCURAPSErrLv2Flg FDCVCURAPSErrLv3Flg FDCVMCAPSAngleTarget FDCVMCAPSRqEPSCtrl FDCVMCAPSVRqEPSCtrl RollingCounter_IfAction RollingCounter_IfAction1 SPTGDet SPTGSta bus_creator Byte_12 Byte_13 Byte_14 Byte_15 Constant Constant1 Constant2 Constant3 Constant4 /end SUB_FUNCTION
 /begin DEF_CHARACTERISTIC /end DEF_CHARACTERISTIC
 /begin IN_MEASUREMENT /end IN_MEASUREMENT
 /begin OUT_MEASUREMENT /end OUT_MEASUREMENT
/end FUNCTION
/begin FUNCTION FD1_APS3_Tx "" /begin SUB_FUNCTION Chart Constant Constant3 Data_Type_Conversion Gain Divide /end SUB_FUNCTION /begin DEF_CHARACTERISTIC /end DEF_CHARACTERISTIC /begin IN_MEASUREMENT /end IN_MEASUREMENT /begin OUT_MEASUREMENT /end OUT_MEASUREMENT /end FUNCTION
/begin FUNCTION FD1_BCM1_0x216 ""
 /begin SUB_FUNCTION AllDoorSW AntiTheftSeatFold AntitheftSta BCMBuzzerReq BCMDoorLockSta BrakeLamp CTDCtrl CTDLockSW CTDUnlockSW CrashDetd Dimmer DimmerEN DoorLockIND DrDoorSW FrChargingDoorCtrl FrFogLamp FrWiperH FrWiperL HBeam HazardSW HoodSW HornCtrl LAPMWdwEnable LBSD LBeam LDRL LTurnLP LockSetting MirrorCtrl MirrorDefog PosLamp PsDoorSW RBSD RDRL RLDoorSW RRDoorSW RTurnLP ReverseLamp RoomLampH RoomLampL RrChargingDoorCtrl RrDefog RrFogLamp RrWiper TailgateHDSW TailgateRemote TailgateSW TrunkRel WasherCtrl WiperFixMode bus_creator /end SUB_FUNCTION
 /begin DEF_CHARACTERISTIC /end DEF_CHARACTERISTIC
 /begin IN_MEASUREMENT /end IN_MEASUREMENT
 /begin OUT_MEASUREMENT /end OUT_MEASUREMENT
/end FUNCTION
/begin FUNCTION FD1_THCM1_0x182 ""
 /begin SUB_FUNCTION BatteryMode CCUACLampSts CCUACMaxLampSts CCUAutoLampSts CCUAutoMidLampSts CCUDispalyRequest CCUEcoSts CCUFrtOnOffLampSts CCUHEATMaxLampSts CCURrOnOffLampSts CCUSyncLampSts CabinMode EDriveMode FDAGSCmd FDRecyAutoCmd FrCoolantflow FrCoolanttemp HPThermalRecoveryReq RrCoolantflow RrCoolanttemp sigAirIntenZon1St sigAirIntenZon3St sigAmbAirT sigCbnAirT sigCbnPTCPwrAct sigCbnSolarLeft sigCbnSolarRight sigClmtCmprPwrAct sigClntTHvBattOut sigDfrstSt sigHvacSt sigRecircSt sigSetTempZon1St sigSetTempZon2St sigSetTempZon3St sigWindDirZon1St sigWindDirZon3St bus_creator /end SUB_FUNCTION
 /begin DEF_CHARACTERISTIC /end DEF_CHARACTERISTIC
 /begin IN_MEASUREMENT /end IN_MEASUREMENT
 /begin OUT_MEASUREMENT /end OUT_MEASUREMENT
/end FUNCTION
/begin FUNCTION FD1_VCU1_0x116 ""
 /begin SUB_FUNCTION CCCrlSta EngAGSCloseSta EngActvDmpDisabSta EngCoastDwSta EngPwrLockSta HVPwrSta LVPwrSta MSACrlSta PButtonSta PrkReq PrkReqValid PwrSta ShiftGearPosn VehMalfunLevel XWDMode bus_creator /end SUB_FUNCTION
 /begin DEF_CHARACTERISTIC /end DEF_CHARACTERISTIC
 /begin IN_MEASUREMENT /end IN_MEASUREMENT
 /begin OUT_MEASUREMENT /end OUT_MEASUREMENT
/end FUNCTION
/begin FUNCTION FD1_VCU2_0x154 ""
 /begin SUB_FUNCTION FD1_VCU2 ACCCtrlAvail AccPedalOverride ActAPSPosn Byte_0 Byte_1 Byte_10 Byte_11 Byte_12 Byte_13 Byte_14 Byte_15 Byte_2 Byte_3 Byte_4 Byte_5 Byte_6 CRC8_IfAction_Tx CSVCU2CAN1 DriverTq FrDriverTq RCVCU2CAN1 RollingCounter_IfAction RollingCounter_IfAction1 RrDriverTq VehActPwr bus_creator Byte_7 Byte_8 Byte_9 Constant Constant1 Constant2 Constant3 Constant4 /end SUB_FUNCTION
 /begin DEF_CHARACTERISTIC /end DEF_CHARACTERISTIC
 /begin IN_MEASUREMENT /end IN_MEASUREMENT
 /begin OUT_MEASUREMENT /end OUT_MEASUREMENT
/end FUNCTION
/begin FUNCTION FD1_VCU2_Tx "" /begin SUB_FUNCTION Chart Constant Constant3 Data_Type_Conversion Gain Divide /end SUB_FUNCTION /begin DEF_CHARACTERISTIC /end DEF_CHARACTERISTIC /begin IN_MEASUREMENT /end IN_MEASUREMENT /begin OUT_MEASUREMENT /end OUT_MEASUREMENT /end FUNCTION
/begin FUNCTION FD1_VCU3_0x159 ""
 /begin SUB_FUNCTION FD1_VCU3 Byte_0 Byte_1 Byte_10 Byte_11 Byte_12 Byte_13 Byte_14 Byte_15 Byte_16 Byte_17 Byte_18 Byte_19 Byte_3 Byte_4 Byte_5 Byte_6 Byte_7 Byte_8 Byte_9 CRC8_IfAction_Tx CSVCU3CAN1 EquivAccPedalSWSta FrEDUAvailBrkRgnTq FrEDUAvailBrkRgnTqValid FrEDURealARgnTq FrEDURealDrvOrBRgnTq FrEDUSpd FrEDUSpdValid FrRgnDecrSta FrRgnPermSta PTCSPermSta RCVCU3CAN1 RgnAbnorSta RollingCounter_IfAction RollingCounter_IfAction1 RrEDUAvailBrkRgnTq RrEDUAvailBrkRgnTqValid RrEDURealARgnTq RrEDURealDrvOrBRgnTq RrEDUSpd RrEDUSpdValid RrRgnDecrSta RrRgnPermSta bus_creator Byte_2 Constant Constant1 Constant2 Constant3 Constant4 /end SUB_FUNCTION
 /begin DEF_CHARACTERISTIC /end DEF_CHARACTERISTIC
 /begin IN_MEASUREMENT /end IN_MEASUREMENT
 /begin OUT_MEASUREMENT /end OUT_MEASUREMENT
/end FUNCTION
/begin FUNCTION FD1_VCU3_Tx "" /begin SUB_FUNCTION Chart Constant Constant3 Data_Type_Conversion Gain Divide /end SUB_FUNCTION /begin DEF_CHARACTERISTIC /end DEF_CHARACTERISTIC /begin IN_MEASUREMENT /end IN_MEASUREMENT /begin OUT_MEASUREMENT /end OUT_MEASUREMENT /end FUNCTION
/begin FUNCTION FD1_VMC1_0x17F ""
 /begin SUB_FUNCTION AccCalcuPID CCMSASpdWar DISCButtSta DISCDISCTargetSpd DISCDISCTurn DISCReqAcc DISCSta FeatArbitrFinal FeatArbitrSta FeatReqSpd FeatSetSpdFinalraw32 FrontRearSlipRatioCtrl JerkPCT LatAccCtrl LateralCtrl LimitPCT MeterIndSpeedraw32 RearWhlSlipRatioCtrl SPD2ACCAct SafetyCtrl SingleWhlSlipRatioCtrl TimeGapCalcu VMCACCCtrlAvail VMCAEBCtrlAvail VMCCCCtrlAvail VMCMSACtrlAvail VMCVCUACCCtrlAvail VMCVCUAPSCtrlAvailflg VMCVCUAccPedalOverride VMCVCUCCCrlSta VMCVCUMSACrlSta VehicleSpeedkph VehicleSpeedmph bus_creator /end SUB_FUNCTION
 /begin DEF_CHARACTERISTIC /end DEF_CHARACTERISTIC
 /begin IN_MEASUREMENT /end IN_MEASUREMENT
 /begin OUT_MEASUREMENT /end OUT_MEASUREMENT
/end FUNCTION
/begin FUNCTION FD1_VMC2_0x77 ""
 /begin SUB_FUNCTION FDCVMCRWSActvSta FDCVMCRWSDfctvSta FDCVMCRWSPositionReqCmd FDCVMCSteerFaultReqCmd bus_creator /end SUB_FUNCTION
 /begin DEF_CHARACTERISTIC /end DEF_CHARACTERISTIC
 /begin IN_MEASUREMENT /end IN_MEASUREMENT
 /begin OUT_MEASUREMENT /end OUT_MEASUREMENT
/end FUNCTION
/begin FUNCTION VMC_FCM1_0x172 ""
 /begin SUB_FUNCTION VMC_FCM1 Byte_0 Byte_1 Byte_10 Byte_11 Byte_12 Byte_13 Byte_14 Byte_15 Byte_2 Byte_3 Byte_4 Byte_5 Byte_6 Byte_7 Byte_8 Byte_9 CRC8_IfAction_Tx FDCVMCAngCtrlTqWtGn FDCVMCDMSModeCmd FDCVMCDrInpTqBstAct FDCVMCDrInpTqBstGn FDCVMCMaxAngCtrlOutTqLim RollingCounter_IfAction RollingCounter_IfAction1 VMCACCComfortBandLower VMCACCComfortBandUpper VMCACCJerkLowerLInit VMCACCJerkUpperLInit VMCACCRequiredAccel VMCACCVehHoldReq VMCADASACCSta VMCADASAEBReq VMCADASAEBSta VMCADASDBSReq VMCADASFaultSta VMCAEBVehHoldReq VMCFCM1Checksum VMCFCM1LifeCount VMCFCMLDWFault VMCFCMLDWRequest VMCFCMLKAStrToqReq VMCFCMLKATOIAct VMCFCMLKATOIFault bus_creator Byte_16 Byte_17 Byte_18 Byte_19 Byte_20 Byte_21 Byte_22 Byte_23 Byte_24 Byte_25 Byte_26 Byte_27 Byte_28 Byte_29 Byte_30 Byte_31 Constant Constant1 Constant2 Constant3 Constant4 /end SUB_FUNCTION
 /begin DEF_CHARACTERISTIC /end DEF_CHARACTERISTIC
 /begin IN_MEASUREMENT /end IN_MEASUREMENT
 /begin OUT_MEASUREMENT /end OUT_MEASUREMENT
/end FUNCTION
/begin FUNCTION VMC_FCM1_Tx "" /begin SUB_FUNCTION Chart Constant Constant3 Data_Type_Conversion Gain Divide /end SUB_FUNCTION /begin DEF_CHARACTERISTIC /end DEF_CHARACTERISTIC /begin IN_MEASUREMENT /end IN_MEASUREMENT /begin OUT_MEASUREMENT /end OUT_MEASUREMENT /end FUNCTION
/begin FUNCTION Constant "" /begin DEF_CHARACTERISTIC KHAL_CAN1FD1APS3TxReq_flg /end DEF_CHARACTERISTIC /begin IN_MEASUREMENT /end IN_MEASUREMENT /begin OUT_MEASUREMENT /end OUT_MEASUREMENT /end FUNCTION
/begin FUNCTION Constant1 "" /begin DEF_CHARACTERISTIC KHAL_CAN1FD1VCU2TxReq_flg /end DEF_CHARACTERISTIC /begin IN_MEASUREMENT /end IN_MEASUREMENT /begin OUT_MEASUREMENT /end OUT_MEASUREMENT /end FUNCTION
/begin FUNCTION Constant2 "" /begin DEF_CHARACTERISTIC KHAL_CAN1FD1VCU3TxReq_flg /end DEF_CHARACTERISTIC /begin IN_MEASUREMENT /end IN_MEASUREMENT /begin OUT_MEASUREMENT /end OUT_MEASUREMENT /end FUNCTION
/begin FUNCTION Constant3 "" /begin DEF_CHARACTERISTIC KHAL_CAN1VMCFCM1TxReq_flg /end DEF_CHARACTERISTIC /begin IN_MEASUREMENT /end IN_MEASUREMENT /begin OUT_MEASUREMENT /end OUT_MEASUREMENT /end FUNCTION
/begin FUNCTION DT_CAN2_SG_FD2_C20_0 "" /begin DEF_CHARACTERISTIC /end DEF_CHARACTERISTIC /begin IN_MEASUREMENT /end IN_MEASUREMENT /begin OUT_MEASUREMENT /end OUT_MEASUREMENT /end FUNCTION
/begin FUNCTION DT_CAN2_SG_FD2_CE100_0 "" /begin DEF_CHARACTERISTIC /end DEF_CHARACTERISTIC /begin IN_MEASUREMENT /end IN_MEASUREMENT /begin OUT_MEASUREMENT /end OUT_MEASUREMENT /end FUNCTION
/begin FUNCTION DT_CAN2_SG_FD2_CE200_1 "" /begin DEF_CHARACTERISTIC /end DEF_CHARACTERISTIC /begin IN_MEASUREMENT /end IN_MEASUREMENT /begin OUT_MEASUREMENT /end OUT_MEASUREMENT /end FUNCTION
/begin FUNCTION DT_CAN2_SG_FD2_Version "" /begin DEF_CHARACTERISTIC /end DEF_CHARACTERISTIC /begin IN_MEASUREMENT /end IN_MEASUREMENT /begin OUT_MEASUREMENT /end OUT_MEASUREMENT /end FUNCTION
/begin FUNCTION DT_CAN2_SG_GW2_CE100_0 "" /begin DEF_CHARACTERISTIC /end DEF_CHARACTERISTIC /begin IN_MEASUREMENT /end IN_MEASUREMENT /begin OUT_MEASUREMENT /end OUT_MEASUREMENT /end FUNCTION
/begin FUNCTION DT_CAN2_SG_GW2_CE100_1 "" /begin DEF_CHARACTERISTIC /end DEF_CHARACTERISTIC /begin IN_MEASUREMENT /end IN_MEASUREMENT /begin OUT_MEASUREMENT /end OUT_MEASUREMENT /end FUNCTION
/begin FUNCTION DT_CAN2_SG_GW2_CE200_0 "" /begin DEF_CHARACTERISTIC /end DEF_CHARACTERISTIC /begin IN_MEASUREMENT /end IN_MEASUREMENT /begin OUT_MEASUREMENT /end OUT_MEASUREMENT /end FUNCTION
/begin FUNCTION FD2_C20_0_0x210 ""
 /begin SUB_FUNCTION APSExitCondition APSRQDisplay APSSWVer APSStaSystem CAASSta DISCDISCTargetSpd FDCVCURegenLimIndSta FDCVCURegenModeSta FDCVCUSimSoundCmd FDCVCUSmartEcoSpdLimSta FDCVCUSmartEcoSta FDCVMCSetSpdDispSta FDCVMCSetSpdSta FDCVMCSpdCtrlModeSta FDCVMCSpdCtrlSta PASAFCL PASAFCR PASAFML PASAFMR PASARCL PASARCR PASARML PASARMR PASChime PASDFCL PASDFCR PASDFML PASDFMR PASDRCL PASDRCR PASDRML PASDRMR PASSNSRLayout USSStaFCL USSStaFCR USSStaFLL USSStaFLR USSStaFML USSStaFMR USSStaRCL USSStaRCR USSStaRLL USSStaRLR USSStaRML USSStaRMR VMCVCUCCCrlSta VMCVCUMSACrlSta bus_creator /end SUB_FUNCTION
 /begin DEF_CHARACTERISTIC /end DEF_CHARACTERISTIC
 /begin IN_MEASUREMENT /end IN_MEASUREMENT
 /begin OUT_MEASUREMENT /end OUT_MEASUREMENT
/end FUNCTION
/begin FUNCTION FD2_CE100_0_0x117 ""
 /begin SUB_FUNCTION APMDoorControlSta ActAPSPosn AllDoorSW AntitheftSta BCMDoorLockSta BrakeLamp CCCrlSta CCMSASpdWar CCUACLampSts CCUACMaxLampSts CCUAutoLampSts CCUAutoMidLampSts CCUDispalyRequest CCUEcoSts CCUFrtOnOffLampSts CCURrOnOffLampSts CCUSyncLampSts CoastDwModeStaChk CreepSWSta DISCButtSta DISCSta DemoModeStaChk Dimmer DimmerEN DisengagePFail DoorLockIND DrDoorSW DrSeatSta DynoModeStaChk EDriveSysErrAccPedalErr EDriveSysErrMCUErr EDriveSysErrShifterErr EDriveSysErrVCUErr EVDriveMode EngAGSCloseSta EngActvDmpDisabSta EngCoastDwSta EngPwrLockSta EngagePFail FDABSWarning FDAGSCmd FDBatteryChargeWarning FDCBCMAutoWipHSpdENSta FDCBCMHMIKey1FuncSta FDCBCMHMIKey2FuncSta FDCBCMHMIKey3FuncSta FDCBCMHMIKey4FuncSta FDCBCMHMIKey5FuncSta FDCBCMHMIKey6FuncSta FDCBCMHMIKey7FuncSta FDCBCMHMIKey8FuncSta FDCRAPSErrWarnSta FDCTHCMCLEVentYSta FDCTHCMCLEVentZSta FDCTHCMCLVentSta FDCTHCMCREVentYSta FDCTHCMCREVentZSta FDCTHCMCRVentSta FDCTHCMLEVentModeSta FDCTHCMLEVentYSta FDCTHCMLEVentZSta FDCTHCMLVentSta FDCTHCMPreWPTCHeatSta FDCTHCMREVentModeSta FDCTHCMREVentYSta FDCTHCMREVentZSta FDCTHCMRVentSta FDCV2LIVIV2LDischargCmd FDCVCULVChrgFreqSta FDCVCULVStaDropQuickSta FDCVCULVStaTooLowSta FDCVCUPwrSaveReqCmd FDCVCUTrailerDisOPDSta FDEBMErrSta FDEDriveSystem FDEPBError FDHVBatteryFault FDParkBrakeWarning FDPowerlimitation FDSteeringWarning FDTCSIndicator FDTelltaleFail FalseNPreventSta FeatSetSpdFinalraw32 FollowMe FrFogLamp HBeam HVRlyOpFail HVSysErrIsolationErr HVSysErrPackErr HVSysErrRelayErr HazardSW HoodSW LBSD LBeam LDRL LTurnLP LVChrgFuncStaChk LVSilentChrgReq LVSilentChrgSta LVSysErrPwrOutpErr LimphomeAct LockSetting MCUActDisFail MSACrlSta MeterIndSpeedraw32 PASStaFSys PosLamp PsDoorSW PwrSta PwrStaErr PwrStaONTOIVIPopReq PwrStaONTOIVIPopT RBSD RDRL RLDoorSW RRDoorSW RTurnLP ReqInternalV2LStatusLamp ReqV2LIVIPopup ReqV2LSwOn ReverseLamp RrDefog RrFogLamp ShiftGearPosn SysAllowReadySta SysPwrSta TailgateSW VCUBrkSWSta VCUFLDoorSta VCUFRDoorSta VCUHoodSWSta VCUOPDHold VCURLDoorSta VCURRDoorSta VCUTailgateSWSta VehMalfunLevel XWDMode sigAirIntenZon1St sigAirIntenZon3St sigAmbAirT sigCbnAirT sigDfrstSt sigHvacSt sigRecircSt sigSetTempZon1St sigSetTempZon2St sigSetTempZon3St sigWindDirZon1St sigWindDirZon3St bus_creator /end SUB_FUNCTION
 /begin DEF_CHARACTERISTIC /end DEF_CHARACTERISTIC
 /begin IN_MEASUREMENT /end IN_MEASUREMENT
 /begin OUT_MEASUREMENT /end OUT_MEASUREMENT
/end FUNCTION
/begin FUNCTION FD2_CE200_1_0x435 ""
 /begin SUB_FUNCTION AutoLTips CWheelTips FDCBCMAcc1StaSta FDCBCMAcc2StaSta FDCBCMAcc3StaSta FDCBCMAcc4StaSta FDCBCMAcc5StaSta FDCBCMAmbBrightStaSta FDCBCMAmbColorStaSta FDCBCMAmbDimENSta FDCBCMAmbFunENSta FDCBCMAmbLinkDriStaSta FDCBCMAmbODAENSta FDCBCMAmbPwrWarnENSta FDCBCMAmbWelENSta FDCBCMAutoLockSta FDCBCMAutoUnlockSta FDCBCMCLWinLockDrSta FDCBCMDSEATentryfsetSta FDCBCMFollowMeENFunSta FDCBCMHBeamADBCmd FDCBCMKey10AccSta FDCBCMKey1AccSta FDCBCMKey2AccSta FDCBCMKey3AccSta FDCBCMKey4AccSta FDCBCMKey5AccSta FDCBCMKey6AccSta FDCBCMKey7AccSta FDCBCMKey8AccSta FDCBCMKey9AccSta FDCBCMLockAlarmCmd FDCBCMPTGOpenHeightSta FDCBCMRmLpModeENFunSta FDCBCMTurnSwTSetStaSta FDCBCMUserNowSta FDCBCMWalkInUnLkEnFunSta FDCBCMWalkOutLkEnFunSta FDCDKCDkeyShowIVISta FDCDKCKeyMissSta FDCDKCKeyNumSta FDCDKCKeyTypeSta FDCDKCUIDLowPowerSta FDCFGSAirIntSta FDCFGSFGSChSta FDCFGSIONSWSta FDCSPTGSPTGENFunSta FDCTHCMAPTCForceOFFSta FDCTHCMAPTCWarningSta FDCTHCMAirIntZ3Sta LFBatWarn LFPressIndi LFSensorFail LFWheelDebug LFWheelPSW LFWheelPress LFWheelShield LFWheelTemp LFWheelTmpIndi LRBatWarn LRPressIndi LRSensorFail LRWheelDebug LRWheelPSW LRWheelPress LRWheelShield LRWheelTemp LRWheelTmpIndi RFBatWarn RFPressIndi RFSensorFail RFWheelDebug RFWheelPSW RFWheelPress RFWheelShield RFWheelTemp RFWheelTmpIndi RRBatWarn RRPressIndi RRSensorFail RRWheelDebug RRWheelPSW RRWheelPress RRWheelShield RRWheelTemp RRWheelTmpIndi TPMSCaliButtAllow TPMSResButtAllow TPMSWarnIndi bus_creator /end SUB_FUNCTION
 /begin DEF_CHARACTERISTIC /end DEF_CHARACTERISTIC
 /begin IN_MEASUREMENT /end IN_MEASUREMENT
 /begin OUT_MEASUREMENT /end OUT_MEASUREMENT
/end FUNCTION
/begin FUNCTION FD2_Version_0x3C3 ""
 /begin SUB_FUNCTION FUSIONHWVer1 FUSIONHWVer2 FUSIONHWVer3 FUSIONSWCarModel1 FUSIONSWCarModel2 FUSIONSWCarModel3 FUSIONSWController1 FUSIONSWController2 FUSIONSWCountry1 FUSIONSWCountry2 FUSIONSWECUGen1 FUSIONSWECUGen2 FUSIONSWMajor1 FUSIONSWMajor2 FUSIONSWMinor1 FUSIONSWMinor2 FUSIONSWPatch1 FUSIONSWPatch2 FUSIONSWSHA1 FUSIONSWSHA2 FUSIONSWSHA3 FUSIONSWSHA4 FUSIONSWSHA5 FUSIONSWSHA6 FUSIONSWSHA7 FUSIONSWSHA8 FUSIONSWVar1 FUSIONSWVar2 FUSIONSWVar3 FUSIONSWVar4 FUSIONSWVar5 FUSIONSWchange1 FUSIONSWchange2 FUSIONSWdash1 FUSIONSWdash2 bus_creator /end SUB_FUNCTION
 /begin DEF_CHARACTERISTIC /end DEF_CHARACTERISTIC
 /begin IN_MEASUREMENT /end IN_MEASUREMENT
 /begin OUT_MEASUREMENT /end OUT_MEASUREMENT
/end FUNCTION
/begin FUNCTION GW2_CE100_0_0x1C2 "" /begin SUB_FUNCTION FDCBCMDimSw FDCBCMFWipSwSta FDCBCMTurnSwSta bus_creator /end SUB_FUNCTION /begin DEF_CHARACTERISTIC /end DEF_CHARACTERISTIC /begin IN_MEASUREMENT /end IN_MEASUREMENT /begin OUT_MEASUREMENT /end OUT_MEASUREMENT /end FUNCTION
/begin FUNCTION GW2_CE100_1_0x357 ""
 /begin SUB_FUNCTION FDCBCMWinLFOpenedSta FDCBCMWinLROpenedSta FDCBCMWinRFOpenedSta FDCBCMWinRROpenedSta bus_creator /end SUB_FUNCTION
 /begin DEF_CHARACTERISTIC /end DEF_CHARACTERISTIC
 /begin IN_MEASUREMENT /end IN_MEASUREMENT
 /begin OUT_MEASUREMENT /end OUT_MEASUREMENT
/end FUNCTION
/begin FUNCTION GW2_CE200_0_0x174 "" /begin SUB_FUNCTION FDCBCMTimeGapLevelSta bus_creator /end SUB_FUNCTION /begin DEF_CHARACTERISTIC /end DEF_CHARACTERISTIC /begin IN_MEASUREMENT /end IN_MEASUREMENT /begin OUT_MEASUREMENT /end OUT_MEASUREMENT /end FUNCTION
/begin FUNCTION DT_CAN3_SG_FD3_BCM1 "" /begin DEF_CHARACTERISTIC /end DEF_CHARACTERISTIC /begin IN_MEASUREMENT /end IN_MEASUREMENT /begin OUT_MEASUREMENT /end OUT_MEASUREMENT /end FUNCTION
/begin FUNCTION DT_CAN3_SG_FD3_C100_0 "" /begin DEF_CHARACTERISTIC /end DEF_CHARACTERISTIC /begin IN_MEASUREMENT /end IN_MEASUREMENT /begin OUT_MEASUREMENT /end OUT_MEASUREMENT /end FUNCTION
/begin FUNCTION DT_CAN3_SG_FD3_V2L1 "" /begin DEF_CHARACTERISTIC /end DEF_CHARACTERISTIC /begin IN_MEASUREMENT /end IN_MEASUREMENT /begin OUT_MEASUREMENT /end OUT_MEASUREMENT /end FUNCTION
/begin FUNCTION DT_CAN3_SG_FD3_VCU0 "" /begin DEF_CHARACTERISTIC /end DEF_CHARACTERISTIC /begin IN_MEASUREMENT /end IN_MEASUREMENT /begin OUT_MEASUREMENT /end OUT_MEASUREMENT /end FUNCTION
/begin FUNCTION DT_CAN3_SG_FD3_VCU1 "" /begin DEF_CHARACTERISTIC /end DEF_CHARACTERISTIC /begin IN_MEASUREMENT /end IN_MEASUREMENT /begin OUT_MEASUREMENT /end OUT_MEASUREMENT /end FUNCTION
/begin FUNCTION DT_CAN3_SG_FD3_VCU1_toNIDEC "" /begin DEF_CHARACTERISTIC /end DEF_CHARACTERISTIC /begin IN_MEASUREMENT /end IN_MEASUREMENT /begin OUT_MEASUREMENT /end OUT_MEASUREMENT /end FUNCTION
/begin FUNCTION DT_CAN3_SG_FD3_VCU5 "" /begin DEF_CHARACTERISTIC /end DEF_CHARACTERISTIC /begin IN_MEASUREMENT /end IN_MEASUREMENT /begin OUT_MEASUREMENT /end OUT_MEASUREMENT /end FUNCTION
/begin FUNCTION DT_CAN3_SG_GW_ESC1_toNIDEC "" /begin DEF_CHARACTERISTIC /end DEF_CHARACTERISTIC /begin IN_MEASUREMENT /end IN_MEASUREMENT /begin OUT_MEASUREMENT /end OUT_MEASUREMENT /end FUNCTION
/begin FUNCTION DT_CAN3_SG_GW_IVI6_toNIDEC "" /begin DEF_CHARACTERISTIC /end DEF_CHARACTERISTIC /begin IN_MEASUREMENT /end IN_MEASUREMENT /begin OUT_MEASUREMENT /end OUT_MEASUREMENT /end FUNCTION
/begin FUNCTION FD3_BCM1_0x216 ""
 /begin SUB_FUNCTION AllDoorSW AntiTheftSeatFold AntitheftSta BCMBuzzerReq BCMDoorLockSta BrakeLamp CTDCtrl CTDLockSW CTDUnlockSW CrashDetd Dimmer DimmerEN DoorLockIND DrDoorSW FrChargingDoorCtrl FrFogLamp FrWiperH FrWiperL HBeam HazardSW HoodSW HornCtrl LAPMWdwEnable LBSD LBeam LDRL LTurnLP LockSetting MirrorCtrl MirrorDefog PosLamp PsDoorSW RBSD RDRL RLDoorSW RRDoorSW RTurnLP ReverseLamp RoomLampH RoomLampL RrChargingDoorCtrl RrDefog RrFogLamp RrWiper TailgateHDSW TailgateRemote TailgateSW TrunkRel WasherCtrl WiperFixMode bus_creator /end SUB_FUNCTION
 /begin DEF_CHARACTERISTIC /end DEF_CHARACTERISTIC
 /begin IN_MEASUREMENT /end IN_MEASUREMENT
 /begin OUT_MEASUREMENT /end OUT_MEASUREMENT
/end FUNCTION
/begin FUNCTION FD3_C100_0_0x182 ""
 /begin SUB_FUNCTION BatteryMode FrCoolantflow FrCoolanttemp RrCoolantflow RrCoolanttemp sigCbnPTCPwrAct bus_creator /end SUB_FUNCTION
 /begin DEF_CHARACTERISTIC /end DEF_CHARACTERISTIC
 /begin IN_MEASUREMENT /end IN_MEASUREMENT
 /begin OUT_MEASUREMENT /end OUT_MEASUREMENT
/end FUNCTION
/begin FUNCTION FD3_V2L1_0x374 ""
 /begin SUB_FUNCTION FDCV2LOBCExtrV2LCmd FDCV2LOBCIntrV2LCmd ReqOBCV2LEna ReqV2LIVIPopup ReqV2LSwOn bus_creator /end SUB_FUNCTION
 /begin DEF_CHARACTERISTIC /end DEF_CHARACTERISTIC
 /begin IN_MEASUREMENT /end IN_MEASUREMENT
 /begin OUT_MEASUREMENT /end OUT_MEASUREMENT
/end FUNCTION
/begin FUNCTION FD3_VCU0_0x1F0 ""
 /begin SUB_FUNCTION EVCCAplusPwrUpReq FDADC12VDet FDADC12VDetAvg FDCSYSPmicBootPath FDCVCUActMaxSlideRateSta FDCVCUAllowMovThdOTASta FDCVCUBOSEnableSta FDCVCUBrakeSigMatrixSta FDCVCUBrkPedalPosStaSta FDCVCUCANBrkSW2StaSta FDCVCUDTCCarouselSta FDCVCUEAPS1MinSta FDCVCUEAPS1RawSta FDCVCUEAPS2MinSta FDCVCUEAPS2RawSta FDCVCUForcePCmd FDCVCUFrFirstOrderInpTs FDCVCUFrRateLimitDecSta FDCVCUFrRateLimitIncSta FDCVCULVChrgFreqCntSta FDCVCULVStaDropQukCntSta FDCVCULowIdleAccPedalSta FDCVCUOTAPwrReqOFFChkSta FDCVCUOTAPwrReqStdChkSta FDCVCUPwrReqOTASta FDCVCURWDRDCActiveSta FDCVCURegenTqLimitEnSta FDCVCURrFirstOrderInpTs FDCVCURrRateLimitDecSta FDCVCURrRateLimitIncSta FDCVCUSlideRegenLimTqSta FDCVCUVehActSpdSta FDCVCUVehMalfunLevelSta FDCVMCActStESCYawSta FDCVMCLongAccSta FrTqSource HVRlyOpFail HVTHCMSysAvail LVBattChrgtimeAct LVBattVoltSta LVChrgHoldTAct LVSilentChrgLv LVSilentChrgReq LVSilentChrgSta MCUActDisFail PMMAllowECUSleep PmicBootReason PowerDownFault PowerDownState PowerUpFault PowerUpState PwrDownReq PwrStaConstraint PwrStaONTOIVIPopReq PwrStaONTOIVIPopT PwrStaSelect PwrStaTOSta PwrUpReq RrTqSource SchedChgTOSta SilentChkAllowSleep Subsystem SysAllowReadySta SysPwrSta TCountSta TimerAllowSleep VCUBrkSWSta VCUFLDoorSta VCUFRDoorSta VCURLDoorSta VCURRDoorSta VehHVPwrAvail4THCM WisrBootReason bus_creator /end SUB_FUNCTION
 /begin DEF_CHARACTERISTIC /end DEF_CHARACTERISTIC
 /begin IN_MEASUREMENT /end IN_MEASUREMENT
 /begin OUT_MEASUREMENT /end OUT_MEASUREMENT
/end FUNCTION
/begin FUNCTION FD3_VCU1_0x115 ""
 /begin SUB_FUNCTION APSStaSystem ActiveDischReq CSVCU1 CoastDwModeStaChk DCDCEnaReq DCDCVoltSetpoint DemoModeStaChk DrSeatSta DynoModeStaChk HVBatCnctReq HVSysReadyToCharge LVChrgFuncStaChk MSACrlSta PButtonSta PrkReq PrkReqValid PwrSta RCVCU1 ShiftGearPosn bus_creator /end SUB_FUNCTION
 /begin DEF_CHARACTERISTIC /end DEF_CHARACTERISTIC
 /begin IN_MEASUREMENT /end IN_MEASUREMENT
 /begin OUT_MEASUREMENT /end OUT_MEASUREMENT
/end FUNCTION
/begin FUNCTION FD3_VCU1_Tx ""
 /begin SUB_FUNCTION convert_out detect_change detect_change1 detect_change10 detect_change11 detect_change2 detect_change3 detect_change4 detect_change5 detect_change6 detect_change7 detect_change8 detect_change9 Chart1 Constant Constant3 Data_Type_Conversion Data_Type_Conversion1 Gain OR Divide /end SUB_FUNCTION
 /begin DEF_CHARACTERISTIC /end DEF_CHARACTERISTIC
 /begin IN_MEASUREMENT /end IN_MEASUREMENT
 /begin OUT_MEASUREMENT /end OUT_MEASUREMENT
/end FUNCTION
/begin FUNCTION FD3_VCU1_toNIDEC_0x116 ""
 /begin SUB_FUNCTION ActiveDischReqtoNidec CSVCU1toNidec CoastDwModeStaChktoNidec DCDCEnaReqtoNidec DCDCVoltSetpointtoNidec DemoModeStaChktoNidec DrSeatStatoNidec DynoModeStaChktoNidec FrActvDmpDisabReqtoNidec FrMCUEnaReqtoNidec HVBatCnctReqtoNidec HVSysReadyToChargetoNidec LVChrgFuncStaChktoNidec MSACrlStatoNidec PrkReqtoNidec PwrStatoNidec RCVCU1toNidec RrActvDmpDisabReqtoNidec RrMCUEnaReqtoNidec ShiftGearPosntoNidec bus_creator /end SUB_FUNCTION
 /begin DEF_CHARACTERISTIC /end DEF_CHARACTERISTIC
 /begin IN_MEASUREMENT /end IN_MEASUREMENT
 /begin OUT_MEASUREMENT /end OUT_MEASUREMENT
/end FUNCTION
/begin FUNCTION FD3_VCU1_toNIDEC_Tx ""
 /begin SUB_FUNCTION convert_out detect_change detect_change1 detect_change10 detect_change11 detect_change12 detect_change13 detect_change2 detect_change3 detect_change4 detect_change5 detect_change6 detect_change7 detect_change8 detect_change9 Chart1 Constant Constant3 Data_Type_Conversion Data_Type_Conversion1 Gain OR Divide /end SUB_FUNCTION
 /begin DEF_CHARACTERISTIC /end DEF_CHARACTERISTIC
 /begin IN_MEASUREMENT /end IN_MEASUREMENT
 /begin OUT_MEASUREMENT /end OUT_MEASUREMENT
/end FUNCTION
/begin FUNCTION FD3_VCU2_0x153 ""
 /begin SUB_FUNCTION FD3_VCU2 Byte_0 Byte_1 Byte_10 Byte_11 Byte_12 Byte_13 Byte_14 Byte_15 Byte_16 Byte_17 Byte_18 Byte_19 Byte_2 Byte_20 Byte_21 Byte_22 Byte_23 Byte_24 Byte_3 Byte_4 Byte_5 Byte_6 Byte_7 Byte_8 Byte_9 CRC8_IfAction_Tx CSVCU2CAN1 FrActvDmpDisabReq FrIdcMax FrIdcMin FrMCUEnaReq FrTMTqReq FrTorqMax FrTorqMin FrUdcMax FrUdcMin RCVCU2CAN1 RollingCounter_IfAction RollingCounter_IfAction1 RrActvDmpDisabReq RrIdcMax RrIdcMin RrMCUEnaReq RrTMTqReq RrTorqMax RrTorqMin RrUdcMax RrUdcMin bus_creator Byte_25 Byte_26 Byte_27 Byte_28 Byte_29 Byte_30 Byte_31 Constant Constant1 Constant2 Constant3 Constant4 /end SUB_FUNCTION
 /begin DEF_CHARACTERISTIC /end DEF_CHARACTERISTIC
 /begin IN_MEASUREMENT /end IN_MEASUREMENT
 /begin OUT_MEASUREMENT /end OUT_MEASUREMENT
/end FUNCTION
/begin FUNCTION FD3_VCU2_Tx "" /begin SUB_FUNCTION Chart Constant Constant3 Data_Type_Conversion Gain Divide /end SUB_FUNCTION /begin DEF_CHARACTERISTIC /end DEF_CHARACTERISTIC /begin IN_MEASUREMENT /end IN_MEASUREMENT /begin OUT_MEASUREMENT /end OUT_MEASUREMENT /end FUNCTION
/begin FUNCTION FD3_VCU2_toNIDEC_0x154 ""
 /begin SUB_FUNCTION FD3_VCU2_toNIDEC Byte_0 Byte_1 Byte_10 Byte_11 Byte_12 Byte_13 Byte_14 Byte_15 Byte_16 Byte_17 Byte_18 Byte_19 Byte_2 Byte_20 Byte_21 Byte_22 Byte_23 Byte_3 Byte_4 Byte_5 Byte_6 Byte_7 Byte_8 Byte_9 CRC8_IfAction_Tx CSVCU2CAN1toNidec FrIdcMaxtoNidec FrIdcMintoNidec FrTMTqReqtoNidec FrTorqMaxtoNidec FrTorqMintoNidec FrUdcMaxtoNidec FrUdcMintoNidec RCVCU2CAN1toNidec RollingCounter_IfAction RollingCounter_IfAction1 RrIdcMaxtoNidec RrIdcMintoNidec RrTMTqReqtoNidec RrTorqMaxtoNidec RrTorqMintoNidec RrUdcMaxtoNidec RrUdcMintoNidec bus_creator Constant Constant1 Constant2 Constant3 Constant4 /end SUB_FUNCTION
 /begin DEF_CHARACTERISTIC /end DEF_CHARACTERISTIC
 /begin IN_MEASUREMENT /end IN_MEASUREMENT
 /begin OUT_MEASUREMENT /end OUT_MEASUREMENT
/end FUNCTION
/begin FUNCTION FD3_VCU2_toNIDEC_Tx "" /begin SUB_FUNCTION Chart Constant Constant3 Data_Type_Conversion Gain Divide /end SUB_FUNCTION /begin DEF_CHARACTERISTIC /end DEF_CHARACTERISTIC /begin IN_MEASUREMENT /end IN_MEASUREMENT /begin OUT_MEASUREMENT /end OUT_MEASUREMENT /end FUNCTION
/begin FUNCTION FD3_VCU5_0x155 ""
 /begin SUB_FUNCTION ActAPSPosn FDCVCUFrSpdMaxReq FDCVCUFrSpdMinReq FDCVCUFrTMCtrlModeReq FDCVCUFrTMSpdReq FDCVCUFrTMTqReq FDCVCUFrTqMaxReq FDCVCUFrTqMinReq FDCVCURrSpdMaxReq FDCVCURrSpdMinReq FDCVCURrTMCtrlModeReq FDCVCURrTMSpdReq FDCVCURrTMTqReq FDCVCURrTqMaxReq FDCVCURrTqMinReq FrEDUSpd FrEDUSpdValid RrEDUSpd RrEDUSpdValid bus_creator /end SUB_FUNCTION
 /begin DEF_CHARACTERISTIC /end DEF_CHARACTERISTIC
 /begin IN_MEASUREMENT /end IN_MEASUREMENT
 /begin OUT_MEASUREMENT /end OUT_MEASUREMENT
/end FUNCTION
/begin FUNCTION GW_ESC1_toNIDEC_0x152 "" /begin SUB_FUNCTION VehSpeedtoNidec bus_creator /end SUB_FUNCTION /begin DEF_CHARACTERISTIC /end DEF_CHARACTERISTIC /begin IN_MEASUREMENT /end IN_MEASUREMENT /begin OUT_MEASUREMENT /end OUT_MEASUREMENT /end FUNCTION
/begin FUNCTION GW_IVI6_toNIDEC_0x49F ""
 /begin SUB_FUNCTION IVITimeDaytoNidec IVITimeHourtoNidec IVITimeMinutetoNidec IVITimeMonthtoNidec IVITimeSecondtoNidec bus_creator /end SUB_FUNCTION
 /begin DEF_CHARACTERISTIC /end DEF_CHARACTERISTIC
 /begin IN_MEASUREMENT /end IN_MEASUREMENT
 /begin OUT_MEASUREMENT /end OUT_MEASUREMENT
/end FUNCTION
/begin FUNCTION Constant "" /begin DEF_CHARACTERISTIC KHAL_CAN3FD3VCU1TxReq_flg /end DEF_CHARACTERISTIC /begin IN_MEASUREMENT /end IN_MEASUREMENT /begin OUT_MEASUREMENT /end OUT_MEASUREMENT /end FUNCTION
/begin FUNCTION Constant1 "" /begin DEF_CHARACTERISTIC KHAL_CAN3FD3VCU1toNIDECTxReq_flg /end DEF_CHARACTERISTIC /begin IN_MEASUREMENT /end IN_MEASUREMENT /begin OUT_MEASUREMENT /end OUT_MEASUREMENT /end FUNCTION
/begin FUNCTION Constant2 "" /begin DEF_CHARACTERISTIC KHAL_CAN3FD3VCU2TxReq_flg /end DEF_CHARACTERISTIC /begin IN_MEASUREMENT /end IN_MEASUREMENT /begin OUT_MEASUREMENT /end OUT_MEASUREMENT /end FUNCTION
/begin FUNCTION Constant3 "" /begin DEF_CHARACTERISTIC KHAL_CAN3FD3VCU2toNIDECTxReq_flg /end DEF_CHARACTERISTIC /begin IN_MEASUREMENT /end IN_MEASUREMENT /begin OUT_MEASUREMENT /end OUT_MEASUREMENT /end FUNCTION
/begin FUNCTION E2E_CAN4_SG_FD4_CE100_0_Trigger "" /begin DEF_CHARACTERISTIC /end DEF_CHARACTERISTIC /begin IN_MEASUREMENT /end IN_MEASUREMENT /begin OUT_MEASUREMENT /end OUT_MEASUREMENT /end FUNCTION
/begin FUNCTION DT_CAN4_SG_FD4_CE100_1 "" /begin DEF_CHARACTERISTIC /end DEF_CHARACTERISTIC /begin IN_MEASUREMENT /end IN_MEASUREMENT /begin OUT_MEASUREMENT /end OUT_MEASUREMENT /end FUNCTION
/begin FUNCTION DT_CAN4_SG_FD4_CE200_0 "" /begin DEF_CHARACTERISTIC /end DEF_CHARACTERISTIC /begin IN_MEASUREMENT /end IN_MEASUREMENT /begin OUT_MEASUREMENT /end OUT_MEASUREMENT /end FUNCTION
/begin FUNCTION DT_CAN4_SG_GW4_CE100_0 "" /begin DEF_CHARACTERISTIC /end DEF_CHARACTERISTIC /begin IN_MEASUREMENT /end IN_MEASUREMENT /begin OUT_MEASUREMENT /end OUT_MEASUREMENT /end FUNCTION
/begin FUNCTION Detect_Change "" /begin SUB_FUNCTION FixPt_Relational_Operator Delay_Input1 /end SUB_FUNCTION /begin DEF_CHARACTERISTIC /end DEF_CHARACTERISTIC /begin IN_MEASUREMENT /end IN_MEASUREMENT /begin OUT_MEASUREMENT /end OUT_MEASUREMENT /end FUNCTION
/begin FUNCTION FD4_CE100_0_0x116 ""
 /begin SUB_FUNCTION FD4_CE100_0 APSStaSystem AllDoorSW AntiTheftSeatFold AntitheftSta BCMDoorLockSta BrakeLamp Byte_0 Byte_1 Byte_10 Byte_11 Byte_12 Byte_13 Byte_14 Byte_15 Byte_16 Byte_17 Byte_19 Byte_2 Byte_20 Byte_21 Byte_22 Byte_23 Byte_25 Byte_26 Byte_27 Byte_3 Byte_4 Byte_5 Byte_6 Byte_7 Byte_8 Byte_9 CCCrlSta CRC8_IfAction_Tx CSVCU1CAN4 CTDCtrl CTDLockSW CTDUnlockSW CrashDetd CtrlDrPwrStbA2 CtrlFrBMSCCUCIR CtrlFrEDUINVERTER CtrlFrIRC1 CtrlFrPwrStbA1P DKCAuthSta DKCTimeSN Dimmer DimmerEN DoorLockIND DrDoorSW DrSeatSta EquivAccPedalSWSta FDCVMCVehPitchAngleSta FDDKCVehDataErr FDDKCVehDataSta FDTBOXDTCDataErr FDTBOXDTCDataSta FDTBOXVehDataErr FDTBOXVehDataSta FrChargingDoorCtrl FrFogLamp FrWiperH FrWiperL HBeam HBeamADB HWResetSta HazardSW HoodSW HornCtrl LAPMWdwEnable LBSD LBeam LDRL LTurnLP LampPwr LockSetting MSACrlSta MirrorCtrl MirrorDefog PosLamp PsDoorSW PwrSta RBSD RCVCU1CAN4 RDRL RLDoorSW RRDoorSW RTurnLP ReBrakeLPReq ReverseLamp RollingCounter_IfAction RollingCounter_IfAction1 RoomLampH RoomLampL RrChargingDoorCtrl RrDefog RrFogLamp RrWiper ShiftGearPosn TailgateHDSW TailgateRemote TailgateSW TimeSNDKCFbk TrunkRel WasherCtrl WiperFixMode bus_creator Byte_18 Byte_24 Byte_28 Byte_29 Byte_30 Byte_31 Constant Constant1 Constant2 Constant3 Constant4 /end SUB_FUNCTION
 /begin DEF_CHARACTERISTIC /end DEF_CHARACTERISTIC
 /begin IN_MEASUREMENT /end IN_MEASUREMENT
 /begin OUT_MEASUREMENT /end OUT_MEASUREMENT
/end FUNCTION
/begin FUNCTION FD4_CE100_0_Tx ""
 /begin SUB_FUNCTION convert_out detect_change detect_change1 detect_change10 detect_change11 detect_change12 detect_change13 detect_change14 detect_change15 detect_change16 detect_change17 detect_change18 detect_change19 detect_change2 detect_change20 detect_change23 detect_change24 detect_change25 detect_change26 detect_change27 detect_change28 detect_change29 detect_change3 detect_change30 detect_change31 detect_change32 detect_change33 detect_change34 detect_change35 detect_change36 detect_change37 detect_change38 detect_change39 detect_change4 detect_change40 detect_change41 detect_change42 detect_change43 detect_change44 detect_change45 detect_change46 detect_change47 detect_change48 detect_change49 detect_change5 detect_change50 detect_change51 detect_change52 detect_change53 detect_change54 detect_change55 detect_change56 detect_change57 detect_change6 detect_change7 detect_change8 detect_change9 Chart Constant Constant3 Data_Type_Conversion Data_Type_Conversion1 Gain OR Divide /end SUB_FUNCTION
 /begin DEF_CHARACTERISTIC /end DEF_CHARACTERISTIC
 /begin IN_MEASUREMENT /end IN_MEASUREMENT
 /begin OUT_MEASUREMENT /end OUT_MEASUREMENT
/end FUNCTION
/begin FUNCTION FD4_CE100_1_0x182 ""
 /begin SUB_FUNCTION ACSubMode APTCActFrRiPwr BatLoopActWtFlw BatteryMode CCUACLampSts CCUACMaxLampSts CCUAutoLampSts CCUAutoMidLampSts CCUCbnPreACWkSts CCUCbnPreEstimdTi CCUCbnPreSts CCUDispalyRequest CCUEcoSts CCUFrtOnOffLampSts CCUHEATMaxLampSts CCUHiVoltageReq CCURrOnOffLampSts CCUSyncLampSts CabinMode CoolgFanActDuty DeiceModReq EDriveMode FDAGSCmd FDBlowerCmd FDCTHCMCLEVentYSta FDCTHCMCLEVentZSta FDCTHCMCLVentSta FDCTHCMCREVentYSta FDCTHCMCREVentZSta FDCTHCMCRVentSta FDCTHCMLEVentModeSta FDCTHCMLEVentYSta FDCTHCMLEVentZSta FDCTHCMLVentSta FDCTHCMREVentModeSta FDCTHCMREVentYSta FDCTHCMREVentZSta FDCTHCMRVentSta FDCompCmd FDEWP1Cmd FDEWP2Cmd FDEWP3Cmd FDEXV1Cmd FDEXV2Cmd FDFWVCmd FDFrLeAPTCHeatPwrCmd FDFrRiAPTCHeatPwrCmd FDFrWPTCHeatPwrCmd FDRecyAutoCmd FDRrAPTCHeatPwrCmd FDSOTXVCmd FDSOV1Cmd FDSOV2Cmd FDSOV3Cmd FDTWVCmd FrCoolantflow FrCoolanttemp HPThermalRecoveryReq RrCoolantflow RrCoolanttemp sigAirIntenZon1St sigAirIntenZon3St sigAmbAirT sigCbnAirT sigCbnPTCPwrAct sigCbnSolarLeft sigCbnSolarRight sigClmtCmprPwrAct sigClntTHvBattOut sigDfrstSt sigHvacSt sigRecircSt sigSetTempZon1St sigSetTempZon2St sigSetTempZon3St sigWindDirZon1St sigWindDirZon3St bus_creator /end SUB_FUNCTION
 /begin DEF_CHARACTERISTIC /end DEF_CHARACTERISTIC
 /begin IN_MEASUREMENT /end IN_MEASUREMENT
 /begin OUT_MEASUREMENT /end OUT_MEASUREMENT
/end FUNCTION
/begin FUNCTION FD4_CE200_0_0x217 ""
 /begin SUB_FUNCTION AmbLightBreath1 AmbLightBreath2 AmbLightBreath3 AmbLightBreath4 AmbLightBreath5 AmbLightBreath6 AmbLightBrightness1 AmbLightBrightness2 AmbLightBrightness3 AmbLightBrightness4 AmbLightBrightness5 AmbLightBrightness6 AmbLightColor1 AmbLightColor2 AmbLightColor3 AmbLightColor4 AmbLightColor5 AmbLightColor6 BCMBuzzerReq FDCBCMATCtrlCmd FDCBCMDSEATentryfsetSta FDCBCMDimSw FDCBCMDrHandleLampCmd FDCBCMDrRWdwReqAPSta FDCBCMDrvWdwReqAPSta FDCBCMFWasSwSta FDCBCMFWipSwSta FDCBCMHBeamADBCmd FDCBCMHandleControlCmd FDCBCMHazardINDCmd FDCBCMHoodRelCmd FDCBCMLPSDCtrlCmd FDCBCMLockAlarmCmd FDCBCMOtHandleLampCmd FDCBCMOutModeCmd FDCBCMPTGOpenHeightSta FDCBCMPasWdwReqAPSta FDCBCMPassSWSta FDCBCMPsRWdwReqAPSta FDCBCMRPSDCtrlCmd FDCBCMSettingUpdateReqCmd FDCBCMTurnSwSta FDCBCMTurnSwTSetStaSta FDCBCMUserHeightSetSta FDCBCMUserNowSta FDCDKCCommandToBCMCmd FDCDKCDKeyAreaPESta FDCDKCSPTGDetCmd FDCDKCSPTGOpenCmd FDCFGSAirIntCmd FDCFGSFGSChCmd FDCFGSFuncStaCmd FDCFGSIONCmd FDCTHCMACTInitialCmd FDCTHCMAirIntZ3Sta FDCV2LHVPOBklgtingCmd FDCV2LHVPOLEDStsCmd WelcomeLight bus_creator /end SUB_FUNCTION
 /begin DEF_CHARACTERISTIC /end DEF_CHARACTERISTIC
 /begin IN_MEASUREMENT /end IN_MEASUREMENT
 /begin OUT_MEASUREMENT /end OUT_MEASUREMENT
/end FUNCTION
/begin FUNCTION Function_Call_Subsystem ""
 /begin SUB_FUNCTION TriggerCAN4VCU1_CNT Constant Constant1 Constant2 GreaterThan Add Switch Unit_Delay /end SUB_FUNCTION
 /begin DEF_CHARACTERISTIC /end DEF_CHARACTERISTIC
 /begin IN_MEASUREMENT /end IN_MEASUREMENT
 /begin OUT_MEASUREMENT /end OUT_MEASUREMENT
/end FUNCTION
/begin FUNCTION GW4_CE100_0_0x253 ""
 /begin SUB_FUNCTION FDCBCMDrRWdwCtrlCmd FDCBCMDrvWdwCtrlCmd FDCBCMPasWdwCtrlCmd FDCBCMPsRWdwCtrlCmd FDCBCMSenstivityPosnCmd FDCPTGinnerSW2 bus_creator /end SUB_FUNCTION
 /begin DEF_CHARACTERISTIC /end DEF_CHARACTERISTIC
 /begin IN_MEASUREMENT /end IN_MEASUREMENT
 /begin OUT_MEASUREMENT /end OUT_MEASUREMENT
/end FUNCTION
/begin FUNCTION Constant "" /begin DEF_CHARACTERISTIC KHAL_CAN4FD4CE1000TxReq_flg /end DEF_CHARACTERISTIC /begin IN_MEASUREMENT /end IN_MEASUREMENT /begin OUT_MEASUREMENT /end OUT_MEASUREMENT /end FUNCTION
/begin FUNCTION Unit_Delay "" /begin DEF_CHARACTERISTIC /end DEF_CHARACTERISTIC /begin IN_MEASUREMENT /end IN_MEASUREMENT /begin OUT_MEASUREMENT /end OUT_MEASUREMENT /end FUNCTION
/begin FUNCTION DT_CAN5_SG_FD5_CE100_0 "" /begin DEF_CHARACTERISTIC /end DEF_CHARACTERISTIC /begin IN_MEASUREMENT /end IN_MEASUREMENT /begin OUT_MEASUREMENT /end OUT_MEASUREMENT /end FUNCTION
/begin FUNCTION DT_CAN5_SG_FD5_Debug1 "" /begin DEF_CHARACTERISTIC /end DEF_CHARACTERISTIC /begin IN_MEASUREMENT /end IN_MEASUREMENT /begin OUT_MEASUREMENT /end OUT_MEASUREMENT /end FUNCTION
/begin FUNCTION DT_CAN5_SG_FD5_Debug2 "" /begin DEF_CHARACTERISTIC /end DEF_CHARACTERISTIC /begin IN_MEASUREMENT /end IN_MEASUREMENT /begin OUT_MEASUREMENT /end OUT_MEASUREMENT /end FUNCTION
/begin FUNCTION DT_CAN5_SG_FD5_Debug3 "" /begin DEF_CHARACTERISTIC /end DEF_CHARACTERISTIC /begin IN_MEASUREMENT /end IN_MEASUREMENT /begin OUT_MEASUREMENT /end OUT_MEASUREMENT /end FUNCTION
/begin FUNCTION DT_CAN5_SG_GW5_CE100_0 "" /begin DEF_CHARACTERISTIC /end DEF_CHARACTERISTIC /begin IN_MEASUREMENT /end IN_MEASUREMENT /begin OUT_MEASUREMENT /end OUT_MEASUREMENT /end FUNCTION
/begin FUNCTION FD5_CE100_0_0x118 ""
 /begin SUB_FUNCTION AllDoorSW AntitheftSta BCMDoorLockSta CCUACLampSts CCUCbnPreACWkSts CCUCbnPreEstimdTi CCUCbnPreSts FDTBOXDTCDataErr FDTBOXDTCDataSta FDTBOXVehDataErr FDTBOXVehDataSta HoodSW LowSOCWarn PwrSta ReVehThdChkSta ShiftGearPosn TCountSta TailgateRemote TailgateSW VehMalfunLevel bus_creator /end SUB_FUNCTION
 /begin DEF_CHARACTERISTIC /end DEF_CHARACTERISTIC
 /begin IN_MEASUREMENT /end IN_MEASUREMENT
 /begin OUT_MEASUREMENT /end OUT_MEASUREMENT
/end FUNCTION
/begin FUNCTION FD5_Debug1_0x4D0 ""
 /begin SUB_FUNCTION ID1ALTU ID1LocALTU ID1messageALTU ID2ALTU ID2LocALTU ID2messageALTU ID3ALTU ID3LocALTU ID3messageALTU ID4ALTU ID4LocALTU ID4messageALTU IDinALTU LFSensorMode LRSensorMode RFFATALTU RFSensorMode RRSensorMode S1WheelDebugALTU S2WheelDebugALTU S3WheelDebugALTU S4WheelDebugALTU bus_creator /end SUB_FUNCTION
 /begin DEF_CHARACTERISTIC /end DEF_CHARACTERISTIC
 /begin IN_MEASUREMENT /end IN_MEASUREMENT
 /begin OUT_MEASUREMENT /end OUT_MEASUREMENT
/end FUNCTION
/begin FUNCTION FD5_Debug2_0x4F7 ""
 /begin SUB_FUNCTION FDCDKCA0UWBEventSta FDCDKCAllowSleepSta FDCDKCBLERSSISta FDCDKCBLEdcEventSta FDCDKCCalDistanceSta FDCDKCCommandToBCMCmd FDCDKCCoordinateXSta FDCDKCCoordinateYSta FDCDKCDKeyAreaPESta FDCDKCDKeyAreaPSSta FDCDKCDKeyAreaPTGSta FDCDKCDKeyAreaSPTGSta FDCDKCDKeyWelcomeSta FDCDKCDkeyAreaRAPSSta FDCDKCDkeyShowIVISta FDCDKCKeyMissSta FDCDKCKeyModeSta FDCDKCKeyNumSta FDCDKCKeyTypeSta FDCDKCOutputPCMDModuleSta FDCDKCParkingModeCmd FDCDKCReVehDataSta FDCDKCRemoLeftPSDCmd FDCDKCRemoRightPSDCmd FDCDKCSPTGDetCmd FDCDKCSPTGOpenCmd FDCDKCShippingModeSta FDCDKCUIDBatVoltSta FDCDKCUIDLowPowerSta FDCDKCUWB1DistanceSta FDCDKCUWB1FPPSta FDCDKCUWB1InvalidSta FDCDKCUWB2DistanceSta FDCDKCUWB2FPPSta FDCDKCUWB2InvalidSta FDCDKCUWB3DistanceSta FDCDKCUWB3FPPSta FDCDKCUWB3InvalidSta FDCDKCUWB4DistanceSta FDCDKCUWB4FPPSta FDCDKCUWB4InvalidSta FDCDKCUWB5DistanceSta FDCDKCUWB5FPPSta FDCDKCUWB5InvalidSta FDCDKCUWBDetAreaSta FDCDKCUWBDetPTGAreaSta FDCDKCUWBOnOffSta bus_creator /end SUB_FUNCTION
 /begin DEF_CHARACTERISTIC /end DEF_CHARACTERISTIC
 /begin IN_MEASUREMENT /end IN_MEASUREMENT
 /begin OUT_MEASUREMENT /end OUT_MEASUREMENT
/end FUNCTION
/begin FUNCTION FD5_Debug3_0x4F3 ""
 /begin SUB_FUNCTION FDCVMCActReqAccCmd FDCVMCExtraMSACtrlSta FDCVMCIMUGxCmd FDCVMCIMUGyCmd FDCVMCIMUGzCmd FDCVMCIMUPitchRateCmd FDCVMCIMURollRateCmd FDCVMCIMUYawRateCmd FDCVMCLongAccelCmd bus_creator /end SUB_FUNCTION
 /begin DEF_CHARACTERISTIC /end DEF_CHARACTERISTIC
 /begin IN_MEASUREMENT /end IN_MEASUREMENT
 /begin OUT_MEASUREMENT /end OUT_MEASUREMENT
/end FUNCTION
/begin FUNCTION GW5_CE100_0_0x1C5 ""
 /begin SUB_FUNCTION FDCBCMWinLFOpenedSta FDCBCMWinLROpenedSta FDCBCMWinRFOpenedSta FDCBCMWinRROpenedSta bus_creator /end SUB_FUNCTION
 /begin DEF_CHARACTERISTIC /end DEF_CHARACTERISTIC
 /begin IN_MEASUREMENT /end IN_MEASUREMENT
 /begin OUT_MEASUREMENT /end OUT_MEASUREMENT
/end FUNCTION
/begin FUNCTION DT_CAN6_SG_FD6_BCM1 "" /begin DEF_CHARACTERISTIC /end DEF_CHARACTERISTIC /begin IN_MEASUREMENT /end IN_MEASUREMENT /begin OUT_MEASUREMENT /end OUT_MEASUREMENT /end FUNCTION
/begin FUNCTION DT_CAN6_SG_FD6_VCU1 "" /begin DEF_CHARACTERISTIC /end DEF_CHARACTERISTIC /begin IN_MEASUREMENT /end IN_MEASUREMENT /begin OUT_MEASUREMENT /end OUT_MEASUREMENT /end FUNCTION
/begin FUNCTION DT_CAN6_SG_FD6_VMC1 "" /begin DEF_CHARACTERISTIC /end DEF_CHARACTERISTIC /begin IN_MEASUREMENT /end IN_MEASUREMENT /begin OUT_MEASUREMENT /end OUT_MEASUREMENT /end FUNCTION
/begin FUNCTION DT_CAN6_SG_GW6_CE100_0 "" /begin DEF_CHARACTERISTIC /end DEF_CHARACTERISTIC /begin IN_MEASUREMENT /end IN_MEASUREMENT /begin OUT_MEASUREMENT /end OUT_MEASUREMENT /end FUNCTION
/begin FUNCTION FD6_APS3_0x238 ""
 /begin SUB_FUNCTION FD6_APS3 APS3LifeCount APS3checksum APSDecReq APSDecReqA APSOpenPTG APSReq APSStaSystem Byte_0 Byte_1 Byte_2 Byte_3 Byte_4 Byte_5 Byte_6 Byte_7 CAASSta CRC8_IfAction_Tx FDCVMCAPSAngleTarget FDCVMCAPSRqEPSCtrl FDCVMCAPSVRqEPSCtrl RollingCounter_IfAction RollingCounter_IfAction1 SPTGDet SPTGSta bus_creator Byte_10 Byte_11 Byte_12 Byte_13 Byte_14 Byte_15 Byte_8 Byte_9 Constant Constant1 Constant2 Constant3 Constant4 /end SUB_FUNCTION
 /begin DEF_CHARACTERISTIC /end DEF_CHARACTERISTIC
 /begin IN_MEASUREMENT /end IN_MEASUREMENT
 /begin OUT_MEASUREMENT /end OUT_MEASUREMENT
/end FUNCTION
/begin FUNCTION FD6_APS3_Tx "" /begin SUB_FUNCTION Chart Constant Constant3 Data_Type_Conversion Gain Divide /end SUB_FUNCTION /begin DEF_CHARACTERISTIC /end DEF_CHARACTERISTIC /begin IN_MEASUREMENT /end IN_MEASUREMENT /begin OUT_MEASUREMENT /end OUT_MEASUREMENT /end FUNCTION
/begin FUNCTION FD6_BCM1_0x216 ""
 /begin SUB_FUNCTION AllDoorSW AntiTheftSeatFold AntitheftSta BCMBuzzerReq BCMDoorLockSta BrakeLamp CTDCtrl CTDLockSW CTDUnlockSW CrashDetd Dimmer DimmerEN DoorLockIND DrDoorSW FrChargingDoorCtrl FrFogLamp FrWiperH FrWiperL HBeam HazardSW HoodSW HornCtrl LAPMWdwEnable LBSD LBeam LDRL LTurnLP LockSetting MirrorCtrl MirrorDefog PosLamp PsDoorSW RBSD RDRL RLDoorSW RRDoorSW RTurnLP ReverseLamp RoomLampH RoomLampL RrChargingDoorCtrl RrDefog RrFogLamp RrWiper TailgateHDSW TailgateRemote TailgateSW TrunkRel WasherCtrl WiperFixMode bus_creator /end SUB_FUNCTION
 /begin DEF_CHARACTERISTIC /end DEF_CHARACTERISTIC
 /begin IN_MEASUREMENT /end IN_MEASUREMENT
 /begin OUT_MEASUREMENT /end OUT_MEASUREMENT
/end FUNCTION
/begin FUNCTION FD6_VCU1_0x116 ""
 /begin SUB_FUNCTION CCCrlSta EngAGSCloseSta EngActvDmpDisabSta EngCoastDwSta EngPwrLockSta HVPwrSta LVPwrSta MSACrlSta PButtonSta PrkReq PrkReqValid PwrSta ShiftGearPosn VCUOPDHold VehMalfunLevel XWDMode bus_creator /end SUB_FUNCTION
 /begin DEF_CHARACTERISTIC /end DEF_CHARACTERISTIC
 /begin IN_MEASUREMENT /end IN_MEASUREMENT
 /begin OUT_MEASUREMENT /end OUT_MEASUREMENT
/end FUNCTION
/begin FUNCTION FD6_VCU2_0x154 ""
 /begin SUB_FUNCTION FD6_VCU2 ACCCtrlAvail AccPedalOverride ActAPSPosn Byte_0 Byte_1 Byte_10 Byte_11 Byte_12 Byte_13 Byte_14 Byte_15 Byte_2 Byte_3 Byte_4 Byte_5 Byte_6 CRC8_IfAction_Tx CSVCU2CAN6 DriverTq FrDriverTq RCVCU2CAN6 RollingCounter_IfAction RollingCounter_IfAction1 RrDriverTq VehActPwr bus_creator Byte_7 Byte_8 Byte_9 Constant Constant1 Constant2 Constant3 Constant4 /end SUB_FUNCTION
 /begin DEF_CHARACTERISTIC /end DEF_CHARACTERISTIC
 /begin IN_MEASUREMENT /end IN_MEASUREMENT
 /begin OUT_MEASUREMENT /end OUT_MEASUREMENT
/end FUNCTION
/begin FUNCTION FD6_VCU2_Tx "" /begin SUB_FUNCTION Chart Constant Constant3 Data_Type_Conversion Gain Divide /end SUB_FUNCTION /begin DEF_CHARACTERISTIC /end DEF_CHARACTERISTIC /begin IN_MEASUREMENT /end IN_MEASUREMENT /begin OUT_MEASUREMENT /end OUT_MEASUREMENT /end FUNCTION
/begin FUNCTION FD6_VMC1_0x17F ""
 /begin SUB_FUNCTION AccCalcuPID CCMSASpdWar DISCButtSta DISCDISCTargetSpd DISCDISCTurn DISCReqAcc DISCSta FDCVMCLongAccelCmd FeatArbitrFinal FeatArbitrSta FeatReqSpd FeatSetSpdFinalraw32 FrontRearSlipRatioCtrl JerkPCT LatAccCtrl LateralCtrl LimitPCT MeterIndSpeedraw32 RearWhlSlipRatioCtrl SPD2ACCAct SafetyCtrl SingleWhlSlipRatioCtrl TimeGapCalcu VMCACCCtrlAvail VMCAEBCtrlAvail VMCCCCtrlAvail VMCMSACtrlAvail VMCVCUACCCtrlAvail VMCVCUAPSCtrlAvailflg VMCVCUAccPedalOverride VMCVCUCCCrlSta VMCVCUMSACrlSta VehicleSpeedkph VehicleSpeedmph bus_creator /end SUB_FUNCTION
 /begin DEF_CHARACTERISTIC /end DEF_CHARACTERISTIC
 /begin IN_MEASUREMENT /end IN_MEASUREMENT
 /begin OUT_MEASUREMENT /end OUT_MEASUREMENT
/end FUNCTION
/begin FUNCTION GW6_CE100_0_0x1C6 ""
 /begin SUB_FUNCTION FDCBCMDimSw FDCBCMFWipSwSta FDCBCMLLeftStaCmd FDCBCMLRightStaCmd FDCBCMPassSWSta FDCBCMTurnSwSta FDCVMCSpdCtrlModeSta FDCVMCSpdCtrlSta bus_creator /end SUB_FUNCTION
 /begin DEF_CHARACTERISTIC /end DEF_CHARACTERISTIC
 /begin IN_MEASUREMENT /end IN_MEASUREMENT
 /begin OUT_MEASUREMENT /end OUT_MEASUREMENT
/end FUNCTION
/begin FUNCTION Constant "" /begin DEF_CHARACTERISTIC KHAL_CAN6FD6APS3TxReq_flg /end DEF_CHARACTERISTIC /begin IN_MEASUREMENT /end IN_MEASUREMENT /begin OUT_MEASUREMENT /end OUT_MEASUREMENT /end FUNCTION
/begin FUNCTION Constant1 "" /begin DEF_CHARACTERISTIC KHAL_CAN6FD6VCU2TxReq_flg /end DEF_CHARACTERISTIC /begin IN_MEASUREMENT /end IN_MEASUREMENT /begin OUT_MEASUREMENT /end OUT_MEASUREMENT /end FUNCTION
/begin FUNCTION Bit_Shift "" /begin SUB_FUNCTION bit_shift /end SUB_FUNCTION /begin DEF_CHARACTERISTIC /end DEF_CHARACTERISTIC /begin IN_MEASUREMENT /end IN_MEASUREMENT /begin OUT_MEASUREMENT /end OUT_MEASUREMENT /end FUNCTION
/begin FUNCTION Bit_Shift1 "" /begin SUB_FUNCTION bit_shift /end SUB_FUNCTION /begin DEF_CHARACTERISTIC /end DEF_CHARACTERISTIC /begin IN_MEASUREMENT /end IN_MEASUREMENT /begin OUT_MEASUREMENT /end OUT_MEASUREMENT /end FUNCTION
/begin FUNCTION Bit_Shift2 "" /begin SUB_FUNCTION bit_shift /end SUB_FUNCTION /begin DEF_CHARACTERISTIC /end DEF_CHARACTERISTIC /begin IN_MEASUREMENT /end IN_MEASUREMENT /begin OUT_MEASUREMENT /end OUT_MEASUREMENT /end FUNCTION
/begin FUNCTION Bit_Shift3 "" /begin SUB_FUNCTION bit_shift /end SUB_FUNCTION /begin DEF_CHARACTERISTIC /end DEF_CHARACTERISTIC /begin IN_MEASUREMENT /end IN_MEASUREMENT /begin OUT_MEASUREMENT /end OUT_MEASUREMENT /end FUNCTION
/begin FUNCTION Bit_Shift4 "" /begin SUB_FUNCTION bit_shift /end SUB_FUNCTION /begin DEF_CHARACTERISTIC /end DEF_CHARACTERISTIC /begin IN_MEASUREMENT /end IN_MEASUREMENT /begin OUT_MEASUREMENT /end OUT_MEASUREMENT /end FUNCTION
/begin FUNCTION Bit_Shift5 "" /begin SUB_FUNCTION bit_shift /end SUB_FUNCTION /begin DEF_CHARACTERISTIC /end DEF_CHARACTERISTIC /begin IN_MEASUREMENT /end IN_MEASUREMENT /begin OUT_MEASUREMENT /end OUT_MEASUREMENT /end FUNCTION
/begin FUNCTION SignalPack181 "" /begin SUB_FUNCTION Left_shift Right_shift /end SUB_FUNCTION /begin DEF_CHARACTERISTIC /end DEF_CHARACTERISTIC /begin IN_MEASUREMENT /end IN_MEASUREMENT /begin OUT_MEASUREMENT /end OUT_MEASUREMENT /end FUNCTION
/begin FUNCTION SignalPack182 "" /begin SUB_FUNCTION Left_shift Right_shift /end SUB_FUNCTION /begin DEF_CHARACTERISTIC /end DEF_CHARACTERISTIC /begin IN_MEASUREMENT /end IN_MEASUREMENT /begin OUT_MEASUREMENT /end OUT_MEASUREMENT /end FUNCTION
/begin FUNCTION SignalPack183 "" /begin SUB_FUNCTION Left_shift Right_shift /end SUB_FUNCTION /begin DEF_CHARACTERISTIC /end DEF_CHARACTERISTIC /begin IN_MEASUREMENT /end IN_MEASUREMENT /begin OUT_MEASUREMENT /end OUT_MEASUREMENT /end FUNCTION
/begin FUNCTION SignalPack184 "" /begin SUB_FUNCTION Left_shift Right_shift /end SUB_FUNCTION /begin DEF_CHARACTERISTIC /end DEF_CHARACTERISTIC /begin IN_MEASUREMENT /end IN_MEASUREMENT /begin OUT_MEASUREMENT /end OUT_MEASUREMENT /end FUNCTION
/begin FUNCTION SignalPack185 "" /begin SUB_FUNCTION Left_shift Right_shift /end SUB_FUNCTION /begin DEF_CHARACTERISTIC /end DEF_CHARACTERISTIC /begin IN_MEASUREMENT /end IN_MEASUREMENT /begin OUT_MEASUREMENT /end OUT_MEASUREMENT /end FUNCTION
/begin FUNCTION SignalPack186 "" /begin SUB_FUNCTION Left_shift Right_shift /end SUB_FUNCTION /begin DEF_CHARACTERISTIC /end DEF_CHARACTERISTIC /begin IN_MEASUREMENT /end IN_MEASUREMENT /begin OUT_MEASUREMENT /end OUT_MEASUREMENT /end FUNCTION
/begin FUNCTION SignalPack187 "" /begin SUB_FUNCTION Left_shift Right_shift /end SUB_FUNCTION /begin DEF_CHARACTERISTIC /end DEF_CHARACTERISTIC /begin IN_MEASUREMENT /end IN_MEASUREMENT /begin OUT_MEASUREMENT /end OUT_MEASUREMENT /end FUNCTION
/begin FUNCTION SignalPack188 "" /begin SUB_FUNCTION Left_shift Right_shift /end SUB_FUNCTION /begin DEF_CHARACTERISTIC /end DEF_CHARACTERISTIC /begin IN_MEASUREMENT /end IN_MEASUREMENT /begin OUT_MEASUREMENT /end OUT_MEASUREMENT /end FUNCTION
/begin FUNCTION SignalPack189 "" /begin SUB_FUNCTION Left_shift Right_shift /end SUB_FUNCTION /begin DEF_CHARACTERISTIC /end DEF_CHARACTERISTIC /begin IN_MEASUREMENT /end IN_MEASUREMENT /begin OUT_MEASUREMENT /end OUT_MEASUREMENT /end FUNCTION
/begin FUNCTION SignalPack190 "" /begin SUB_FUNCTION Left_shift Right_shift /end SUB_FUNCTION /begin DEF_CHARACTERISTIC /end DEF_CHARACTERISTIC /begin IN_MEASUREMENT /end IN_MEASUREMENT /begin OUT_MEASUREMENT /end OUT_MEASUREMENT /end FUNCTION
/begin FUNCTION SignalPack191 "" /begin SUB_FUNCTION Left_shift Right_shift /end SUB_FUNCTION /begin DEF_CHARACTERISTIC /end DEF_CHARACTERISTIC /begin IN_MEASUREMENT /end IN_MEASUREMENT /begin OUT_MEASUREMENT /end OUT_MEASUREMENT /end FUNCTION
/begin FUNCTION SignalPack192 "" /begin SUB_FUNCTION Left_shift Right_shift /end SUB_FUNCTION /begin DEF_CHARACTERISTIC /end DEF_CHARACTERISTIC /begin IN_MEASUREMENT /end IN_MEASUREMENT /begin OUT_MEASUREMENT /end OUT_MEASUREMENT /end FUNCTION
/begin FUNCTION SignalPack193 "" /begin SUB_FUNCTION Left_shift Right_shift /end SUB_FUNCTION /begin DEF_CHARACTERISTIC /end DEF_CHARACTERISTIC /begin IN_MEASUREMENT /end IN_MEASUREMENT /begin OUT_MEASUREMENT /end OUT_MEASUREMENT /end FUNCTION
/begin FUNCTION SignalPack194 "" /begin SUB_FUNCTION Left_shift Right_shift /end SUB_FUNCTION /begin DEF_CHARACTERISTIC /end DEF_CHARACTERISTIC /begin IN_MEASUREMENT /end IN_MEASUREMENT /begin OUT_MEASUREMENT /end OUT_MEASUREMENT /end FUNCTION
/begin FUNCTION SignalPack195 "" /begin SUB_FUNCTION Left_shift Right_shift /end SUB_FUNCTION /begin DEF_CHARACTERISTIC /end DEF_CHARACTERISTIC /begin IN_MEASUREMENT /end IN_MEASUREMENT /begin OUT_MEASUREMENT /end OUT_MEASUREMENT /end FUNCTION
/begin FUNCTION SignalPack196 "" /begin SUB_FUNCTION Left_shift Right_shift /end SUB_FUNCTION /begin DEF_CHARACTERISTIC /end DEF_CHARACTERISTIC /begin IN_MEASUREMENT /end IN_MEASUREMENT /begin OUT_MEASUREMENT /end OUT_MEASUREMENT /end FUNCTION
/begin FUNCTION SignalPack197 "" /begin SUB_FUNCTION Left_shift Right_shift /end SUB_FUNCTION /begin DEF_CHARACTERISTIC /end DEF_CHARACTERISTIC /begin IN_MEASUREMENT /end IN_MEASUREMENT /begin OUT_MEASUREMENT /end OUT_MEASUREMENT /end FUNCTION
/begin FUNCTION SignalPack198 "" /begin SUB_FUNCTION Left_shift Right_shift /end SUB_FUNCTION /begin DEF_CHARACTERISTIC /end DEF_CHARACTERISTIC /begin IN_MEASUREMENT /end IN_MEASUREMENT /begin OUT_MEASUREMENT /end OUT_MEASUREMENT /end FUNCTION
/begin FUNCTION SignalPack199 "" /begin SUB_FUNCTION Left_shift Right_shift /end SUB_FUNCTION /begin DEF_CHARACTERISTIC /end DEF_CHARACTERISTIC /begin IN_MEASUREMENT /end IN_MEASUREMENT /begin OUT_MEASUREMENT /end OUT_MEASUREMENT /end FUNCTION
/begin FUNCTION SignalPack200 "" /begin SUB_FUNCTION Left_shift Right_shift /end SUB_FUNCTION /begin DEF_CHARACTERISTIC /end DEF_CHARACTERISTIC /begin IN_MEASUREMENT /end IN_MEASUREMENT /begin OUT_MEASUREMENT /end OUT_MEASUREMENT /end FUNCTION
/begin FUNCTION SignalPack201 "" /begin SUB_FUNCTION Left_shift Right_shift /end SUB_FUNCTION /begin DEF_CHARACTERISTIC /end DEF_CHARACTERISTIC /begin IN_MEASUREMENT /end IN_MEASUREMENT /begin OUT_MEASUREMENT /end OUT_MEASUREMENT /end FUNCTION
/begin FUNCTION SignalPack302 "" /begin SUB_FUNCTION Left_shift Right_shift /end SUB_FUNCTION /begin DEF_CHARACTERISTIC /end DEF_CHARACTERISTIC /begin IN_MEASUREMENT /end IN_MEASUREMENT /begin OUT_MEASUREMENT /end OUT_MEASUREMENT /end FUNCTION
/begin FUNCTION SignalPack323 "" /begin SUB_FUNCTION Left_shift Right_shift /end SUB_FUNCTION /begin DEF_CHARACTERISTIC /end DEF_CHARACTERISTIC /begin IN_MEASUREMENT /end IN_MEASUREMENT /begin OUT_MEASUREMENT /end OUT_MEASUREMENT /end FUNCTION
/begin FUNCTION SignalPack344 "" /begin SUB_FUNCTION Left_shift Right_shift /end SUB_FUNCTION /begin DEF_CHARACTERISTIC /end DEF_CHARACTERISTIC /begin IN_MEASUREMENT /end IN_MEASUREMENT /begin OUT_MEASUREMENT /end OUT_MEASUREMENT /end FUNCTION
/begin FUNCTION SignalPack345 "" /begin SUB_FUNCTION Left_shift Right_shift /end SUB_FUNCTION /begin DEF_CHARACTERISTIC /end DEF_CHARACTERISTIC /begin IN_MEASUREMENT /end IN_MEASUREMENT /begin OUT_MEASUREMENT /end OUT_MEASUREMENT /end FUNCTION
/begin FUNCTION SignalPack346 "" /begin SUB_FUNCTION Left_shift Right_shift /end SUB_FUNCTION /begin DEF_CHARACTERISTIC /end DEF_CHARACTERISTIC /begin IN_MEASUREMENT /end IN_MEASUREMENT /begin OUT_MEASUREMENT /end OUT_MEASUREMENT /end FUNCTION
/begin FUNCTION SignalPack347 "" /begin SUB_FUNCTION Left_shift Right_shift /end SUB_FUNCTION /begin DEF_CHARACTERISTIC /end DEF_CHARACTERISTIC /begin IN_MEASUREMENT /end IN_MEASUREMENT /begin OUT_MEASUREMENT /end OUT_MEASUREMENT /end FUNCTION
/begin FUNCTION SignalPack348 "" /begin SUB_FUNCTION Left_shift Right_shift /end SUB_FUNCTION /begin DEF_CHARACTERISTIC /end DEF_CHARACTERISTIC /begin IN_MEASUREMENT /end IN_MEASUREMENT /begin OUT_MEASUREMENT /end OUT_MEASUREMENT /end FUNCTION
/begin FUNCTION SignalPack349 "" /begin SUB_FUNCTION Left_shift Right_shift /end SUB_FUNCTION /begin DEF_CHARACTERISTIC /end DEF_CHARACTERISTIC /begin IN_MEASUREMENT /end IN_MEASUREMENT /begin OUT_MEASUREMENT /end OUT_MEASUREMENT /end FUNCTION
/begin FUNCTION SignalPack350 "" /begin SUB_FUNCTION Left_shift Right_shift /end SUB_FUNCTION /begin DEF_CHARACTERISTIC /end DEF_CHARACTERISTIC /begin IN_MEASUREMENT /end IN_MEASUREMENT /begin OUT_MEASUREMENT /end OUT_MEASUREMENT /end FUNCTION
/begin FUNCTION SignalPack351 "" /begin SUB_FUNCTION Left_shift Right_shift /end SUB_FUNCTION /begin DEF_CHARACTERISTIC /end DEF_CHARACTERISTIC /begin IN_MEASUREMENT /end IN_MEASUREMENT /begin OUT_MEASUREMENT /end OUT_MEASUREMENT /end FUNCTION
/begin FUNCTION SignalPack352 "" /begin SUB_FUNCTION Left_shift Right_shift /end SUB_FUNCTION /begin DEF_CHARACTERISTIC /end DEF_CHARACTERISTIC /begin IN_MEASUREMENT /end IN_MEASUREMENT /begin OUT_MEASUREMENT /end OUT_MEASUREMENT /end FUNCTION
/begin FUNCTION SignalPack353 "" /begin SUB_FUNCTION Left_shift Right_shift /end SUB_FUNCTION /begin DEF_CHARACTERISTIC /end DEF_CHARACTERISTIC /begin IN_MEASUREMENT /end IN_MEASUREMENT /begin OUT_MEASUREMENT /end OUT_MEASUREMENT /end FUNCTION
/begin FUNCTION convert_in "" /begin SUB_FUNCTION gain offset Product Add /end SUB_FUNCTION /begin DEF_CHARACTERISTIC /end DEF_CHARACTERISTIC /begin IN_MEASUREMENT /end IN_MEASUREMENT /begin OUT_MEASUREMENT /end OUT_MEASUREMENT /end FUNCTION
/begin FUNCTION convert_in1 "" /begin SUB_FUNCTION gain offset /end SUB_FUNCTION /begin DEF_CHARACTERISTIC /end DEF_CHARACTERISTIC /begin IN_MEASUREMENT /end IN_MEASUREMENT /begin OUT_MEASUREMENT /end OUT_MEASUREMENT /end FUNCTION
/begin FUNCTION convert_in10 "" /begin SUB_FUNCTION gain offset /end SUB_FUNCTION /begin DEF_CHARACTERISTIC /end DEF_CHARACTERISTIC /begin IN_MEASUREMENT /end IN_MEASUREMENT /begin OUT_MEASUREMENT /end OUT_MEASUREMENT /end FUNCTION
/begin FUNCTION convert_in11 "" /begin SUB_FUNCTION gain offset /end SUB_FUNCTION /begin DEF_CHARACTERISTIC /end DEF_CHARACTERISTIC /begin IN_MEASUREMENT /end IN_MEASUREMENT /begin OUT_MEASUREMENT /end OUT_MEASUREMENT /end FUNCTION
/begin FUNCTION convert_in12 "" /begin SUB_FUNCTION gain offset Product Add /end SUB_FUNCTION /begin DEF_CHARACTERISTIC /end DEF_CHARACTERISTIC /begin IN_MEASUREMENT /end IN_MEASUREMENT /begin OUT_MEASUREMENT /end OUT_MEASUREMENT /end FUNCTION
/begin FUNCTION convert_in13 "" /begin SUB_FUNCTION gain offset Product Add /end SUB_FUNCTION /begin DEF_CHARACTERISTIC /end DEF_CHARACTERISTIC /begin IN_MEASUREMENT /end IN_MEASUREMENT /begin OUT_MEASUREMENT /end OUT_MEASUREMENT /end FUNCTION
/begin FUNCTION convert_in14 "" /begin SUB_FUNCTION gain offset /end SUB_FUNCTION /begin DEF_CHARACTERISTIC /end DEF_CHARACTERISTIC /begin IN_MEASUREMENT /end IN_MEASUREMENT /begin OUT_MEASUREMENT /end OUT_MEASUREMENT /end FUNCTION
/begin FUNCTION convert_in15 "" /begin SUB_FUNCTION gain offset /end SUB_FUNCTION /begin DEF_CHARACTERISTIC /end DEF_CHARACTERISTIC /begin IN_MEASUREMENT /end IN_MEASUREMENT /begin OUT_MEASUREMENT /end OUT_MEASUREMENT /end FUNCTION
/begin FUNCTION convert_in16 "" /begin SUB_FUNCTION gain offset /end SUB_FUNCTION /begin DEF_CHARACTERISTIC /end DEF_CHARACTERISTIC /begin IN_MEASUREMENT /end IN_MEASUREMENT /begin OUT_MEASUREMENT /end OUT_MEASUREMENT /end FUNCTION
/begin FUNCTION convert_in17 "" /begin SUB_FUNCTION gain offset /end SUB_FUNCTION /begin DEF_CHARACTERISTIC /end DEF_CHARACTERISTIC /begin IN_MEASUREMENT /end IN_MEASUREMENT /begin OUT_MEASUREMENT /end OUT_MEASUREMENT /end FUNCTION
/begin FUNCTION convert_in18 "" /begin SUB_FUNCTION gain offset /end SUB_FUNCTION /begin DEF_CHARACTERISTIC /end DEF_CHARACTERISTIC /begin IN_MEASUREMENT /end IN_MEASUREMENT /begin OUT_MEASUREMENT /end OUT_MEASUREMENT /end FUNCTION
/begin FUNCTION convert_in19 "" /begin SUB_FUNCTION gain offset /end SUB_FUNCTION /begin DEF_CHARACTERISTIC /end DEF_CHARACTERISTIC /begin IN_MEASUREMENT /end IN_MEASUREMENT /begin OUT_MEASUREMENT /end OUT_MEASUREMENT /end FUNCTION
/begin FUNCTION convert_in2 "" /begin SUB_FUNCTION gain offset /end SUB_FUNCTION /begin DEF_CHARACTERISTIC /end DEF_CHARACTERISTIC /begin IN_MEASUREMENT /end IN_MEASUREMENT /begin OUT_MEASUREMENT /end OUT_MEASUREMENT /end FUNCTION
/begin FUNCTION convert_in20 "" /begin SUB_FUNCTION gain offset /end SUB_FUNCTION /begin DEF_CHARACTERISTIC /end DEF_CHARACTERISTIC /begin IN_MEASUREMENT /end IN_MEASUREMENT /begin OUT_MEASUREMENT /end OUT_MEASUREMENT /end FUNCTION
/begin FUNCTION convert_in21 "" /begin SUB_FUNCTION gain offset /end SUB_FUNCTION /begin DEF_CHARACTERISTIC /end DEF_CHARACTERISTIC /begin IN_MEASUREMENT /end IN_MEASUREMENT /begin OUT_MEASUREMENT /end OUT_MEASUREMENT /end FUNCTION
/begin FUNCTION convert_in22 "" /begin SUB_FUNCTION gain offset /end SUB_FUNCTION /begin DEF_CHARACTERISTIC /end DEF_CHARACTERISTIC /begin IN_MEASUREMENT /end IN_MEASUREMENT /begin OUT_MEASUREMENT /end OUT_MEASUREMENT /end FUNCTION
/begin FUNCTION convert_in23 "" /begin SUB_FUNCTION gain offset /end SUB_FUNCTION /begin DEF_CHARACTERISTIC /end DEF_CHARACTERISTIC /begin IN_MEASUREMENT /end IN_MEASUREMENT /begin OUT_MEASUREMENT /end OUT_MEASUREMENT /end FUNCTION
/begin FUNCTION convert_in24 "" /begin SUB_FUNCTION gain offset /end SUB_FUNCTION /begin DEF_CHARACTERISTIC /end DEF_CHARACTERISTIC /begin IN_MEASUREMENT /end IN_MEASUREMENT /begin OUT_MEASUREMENT /end OUT_MEASUREMENT /end FUNCTION
/begin FUNCTION convert_in25 "" /begin SUB_FUNCTION gain offset /end SUB_FUNCTION /begin DEF_CHARACTERISTIC /end DEF_CHARACTERISTIC /begin IN_MEASUREMENT /end IN_MEASUREMENT /begin OUT_MEASUREMENT /end OUT_MEASUREMENT /end FUNCTION
/begin FUNCTION convert_in26 "" /begin SUB_FUNCTION gain offset /end SUB_FUNCTION /begin DEF_CHARACTERISTIC /end DEF_CHARACTERISTIC /begin IN_MEASUREMENT /end IN_MEASUREMENT /begin OUT_MEASUREMENT /end OUT_MEASUREMENT /end FUNCTION
/begin FUNCTION convert_in27 "" /begin SUB_FUNCTION gain offset /end SUB_FUNCTION /begin DEF_CHARACTERISTIC /end DEF_CHARACTERISTIC /begin IN_MEASUREMENT /end IN_MEASUREMENT /begin OUT_MEASUREMENT /end OUT_MEASUREMENT /end FUNCTION
/begin FUNCTION convert_in28 "" /begin SUB_FUNCTION gain offset Product Add /end SUB_FUNCTION /begin DEF_CHARACTERISTIC /end DEF_CHARACTERISTIC /begin IN_MEASUREMENT /end IN_MEASUREMENT /begin OUT_MEASUREMENT /end OUT_MEASUREMENT /end FUNCTION
/begin FUNCTION convert_in29 "" /begin SUB_FUNCTION gain offset Product Add /end SUB_FUNCTION /begin DEF_CHARACTERISTIC /end DEF_CHARACTERISTIC /begin IN_MEASUREMENT /end IN_MEASUREMENT /begin OUT_MEASUREMENT /end OUT_MEASUREMENT /end FUNCTION
/begin FUNCTION convert_in3 "" /begin SUB_FUNCTION gain offset /end SUB_FUNCTION /begin DEF_CHARACTERISTIC /end DEF_CHARACTERISTIC /begin IN_MEASUREMENT /end IN_MEASUREMENT /begin OUT_MEASUREMENT /end OUT_MEASUREMENT /end FUNCTION
/begin FUNCTION convert_in30 "" /begin SUB_FUNCTION gain offset /end SUB_FUNCTION /begin DEF_CHARACTERISTIC /end DEF_CHARACTERISTIC /begin IN_MEASUREMENT /end IN_MEASUREMENT /begin OUT_MEASUREMENT /end OUT_MEASUREMENT /end FUNCTION
/begin FUNCTION convert_in31 "" /begin SUB_FUNCTION gain offset /end SUB_FUNCTION /begin DEF_CHARACTERISTIC /end DEF_CHARACTERISTIC /begin IN_MEASUREMENT /end IN_MEASUREMENT /begin OUT_MEASUREMENT /end OUT_MEASUREMENT /end FUNCTION
/begin FUNCTION convert_in32 "" /begin SUB_FUNCTION gain offset /end SUB_FUNCTION /begin DEF_CHARACTERISTIC /end DEF_CHARACTERISTIC /begin IN_MEASUREMENT /end IN_MEASUREMENT /begin OUT_MEASUREMENT /end OUT_MEASUREMENT /end FUNCTION
/begin FUNCTION convert_in33 "" /begin SUB_FUNCTION gain offset /end SUB_FUNCTION /begin DEF_CHARACTERISTIC /end DEF_CHARACTERISTIC /begin IN_MEASUREMENT /end IN_MEASUREMENT /begin OUT_MEASUREMENT /end OUT_MEASUREMENT /end FUNCTION
/begin FUNCTION convert_in34 "" /begin SUB_FUNCTION gain offset /end SUB_FUNCTION /begin DEF_CHARACTERISTIC /end DEF_CHARACTERISTIC /begin IN_MEASUREMENT /end IN_MEASUREMENT /begin OUT_MEASUREMENT /end OUT_MEASUREMENT /end FUNCTION
/begin FUNCTION convert_in35 "" /begin SUB_FUNCTION gain offset /end SUB_FUNCTION /begin DEF_CHARACTERISTIC /end DEF_CHARACTERISTIC /begin IN_MEASUREMENT /end IN_MEASUREMENT /begin OUT_MEASUREMENT /end OUT_MEASUREMENT /end FUNCTION
/begin FUNCTION convert_in36 "" /begin SUB_FUNCTION gain offset /end SUB_FUNCTION /begin DEF_CHARACTERISTIC /end DEF_CHARACTERISTIC /begin IN_MEASUREMENT /end IN_MEASUREMENT /begin OUT_MEASUREMENT /end OUT_MEASUREMENT /end FUNCTION
/begin FUNCTION convert_in4 "" /begin SUB_FUNCTION gain offset /end SUB_FUNCTION /begin DEF_CHARACTERISTIC /end DEF_CHARACTERISTIC /begin IN_MEASUREMENT /end IN_MEASUREMENT /begin OUT_MEASUREMENT /end OUT_MEASUREMENT /end FUNCTION
/begin FUNCTION convert_in5 "" /begin SUB_FUNCTION gain offset /end SUB_FUNCTION /begin DEF_CHARACTERISTIC /end DEF_CHARACTERISTIC /begin IN_MEASUREMENT /end IN_MEASUREMENT /begin OUT_MEASUREMENT /end OUT_MEASUREMENT /end FUNCTION
/begin FUNCTION convert_in6 "" /begin SUB_FUNCTION gain offset /end SUB_FUNCTION /begin DEF_CHARACTERISTIC /end DEF_CHARACTERISTIC /begin IN_MEASUREMENT /end IN_MEASUREMENT /begin OUT_MEASUREMENT /end OUT_MEASUREMENT /end FUNCTION
/begin FUNCTION convert_in7 "" /begin SUB_FUNCTION gain offset /end SUB_FUNCTION /begin DEF_CHARACTERISTIC /end DEF_CHARACTERISTIC /begin IN_MEASUREMENT /end IN_MEASUREMENT /begin OUT_MEASUREMENT /end OUT_MEASUREMENT /end FUNCTION
/begin FUNCTION convert_in8 "" /begin SUB_FUNCTION gain offset /end SUB_FUNCTION /begin DEF_CHARACTERISTIC /end DEF_CHARACTERISTIC /begin IN_MEASUREMENT /end IN_MEASUREMENT /begin OUT_MEASUREMENT /end OUT_MEASUREMENT /end FUNCTION
/begin FUNCTION convert_in9 "" /begin SUB_FUNCTION gain offset /end SUB_FUNCTION /begin DEF_CHARACTERISTIC /end DEF_CHARACTERISTIC /begin IN_MEASUREMENT /end IN_MEASUREMENT /begin OUT_MEASUREMENT /end OUT_MEASUREMENT /end FUNCTION
/begin FUNCTION convert_out "" /begin SUB_FUNCTION Constant gain offset MinMax Divide Add /end SUB_FUNCTION /begin DEF_CHARACTERISTIC /end DEF_CHARACTERISTIC /begin IN_MEASUREMENT /end IN_MEASUREMENT /begin OUT_MEASUREMENT /end OUT_MEASUREMENT /end FUNCTION
/begin FUNCTION convert_out1 "" /begin SUB_FUNCTION Constant gain offset MinMax Divide Add /end SUB_FUNCTION /begin DEF_CHARACTERISTIC /end DEF_CHARACTERISTIC /begin IN_MEASUREMENT /end IN_MEASUREMENT /begin OUT_MEASUREMENT /end OUT_MEASUREMENT /end FUNCTION
/begin FUNCTION convert_out100 "" /begin SUB_FUNCTION Constant gain offset MinMax Divide Add /end SUB_FUNCTION /begin DEF_CHARACTERISTIC /end DEF_CHARACTERISTIC /begin IN_MEASUREMENT /end IN_MEASUREMENT /begin OUT_MEASUREMENT /end OUT_MEASUREMENT /end FUNCTION
/begin FUNCTION convert_out101 "" /begin SUB_FUNCTION Constant gain offset MinMax Divide Add /end SUB_FUNCTION /begin DEF_CHARACTERISTIC /end DEF_CHARACTERISTIC /begin IN_MEASUREMENT /end IN_MEASUREMENT /begin OUT_MEASUREMENT /end OUT_MEASUREMENT /end FUNCTION
/begin FUNCTION convert_out2 "" /begin SUB_FUNCTION Constant gain offset MinMax Divide Add /end SUB_FUNCTION /begin DEF_CHARACTERISTIC /end DEF_CHARACTERISTIC /begin IN_MEASUREMENT /end IN_MEASUREMENT /begin OUT_MEASUREMENT /end OUT_MEASUREMENT /end FUNCTION
/begin FUNCTION convert_out3 "" /begin SUB_FUNCTION Constant gain offset MinMax Divide Add /end SUB_FUNCTION /begin DEF_CHARACTERISTIC /end DEF_CHARACTERISTIC /begin IN_MEASUREMENT /end IN_MEASUREMENT /begin OUT_MEASUREMENT /end OUT_MEASUREMENT /end FUNCTION
/begin FUNCTION convert_out56 "" /begin SUB_FUNCTION Constant gain offset MinMax Divide Add /end SUB_FUNCTION /begin DEF_CHARACTERISTIC /end DEF_CHARACTERISTIC /begin IN_MEASUREMENT /end IN_MEASUREMENT /begin OUT_MEASUREMENT /end OUT_MEASUREMENT /end FUNCTION
/begin FUNCTION convert_out57 "" /begin SUB_FUNCTION Constant gain offset MinMax Divide Add /end SUB_FUNCTION /begin DEF_CHARACTERISTIC /end DEF_CHARACTERISTIC /begin IN_MEASUREMENT /end IN_MEASUREMENT /begin OUT_MEASUREMENT /end OUT_MEASUREMENT /end FUNCTION
/begin FUNCTION convert_out58 "" /begin SUB_FUNCTION Constant gain offset MinMax Divide Add /end SUB_FUNCTION /begin DEF_CHARACTERISTIC /end DEF_CHARACTERISTIC /begin IN_MEASUREMENT /end IN_MEASUREMENT /begin OUT_MEASUREMENT /end OUT_MEASUREMENT /end FUNCTION
/begin FUNCTION convert_out59 "" /begin SUB_FUNCTION Constant gain offset MinMax Divide Add /end SUB_FUNCTION /begin DEF_CHARACTERISTIC /end DEF_CHARACTERISTIC /begin IN_MEASUREMENT /end IN_MEASUREMENT /begin OUT_MEASUREMENT /end OUT_MEASUREMENT /end FUNCTION
/begin FUNCTION convert_out61 "" /begin SUB_FUNCTION Constant gain offset MinMax Divide Add /end SUB_FUNCTION /begin DEF_CHARACTERISTIC /end DEF_CHARACTERISTIC /begin IN_MEASUREMENT /end IN_MEASUREMENT /begin OUT_MEASUREMENT /end OUT_MEASUREMENT /end FUNCTION
/begin FUNCTION convert_out62 "" /begin SUB_FUNCTION Constant gain offset MinMax Divide Add /end SUB_FUNCTION /begin DEF_CHARACTERISTIC /end DEF_CHARACTERISTIC /begin IN_MEASUREMENT /end IN_MEASUREMENT /begin OUT_MEASUREMENT /end OUT_MEASUREMENT /end FUNCTION
/begin FUNCTION convert_out63 "" /begin SUB_FUNCTION Constant gain offset MinMax Divide Add /end SUB_FUNCTION /begin DEF_CHARACTERISTIC /end DEF_CHARACTERISTIC /begin IN_MEASUREMENT /end IN_MEASUREMENT /begin OUT_MEASUREMENT /end OUT_MEASUREMENT /end FUNCTION
/begin FUNCTION convert_out64 "" /begin SUB_FUNCTION Constant gain offset MinMax Divide Add /end SUB_FUNCTION /begin DEF_CHARACTERISTIC /end DEF_CHARACTERISTIC /begin IN_MEASUREMENT /end IN_MEASUREMENT /begin OUT_MEASUREMENT /end OUT_MEASUREMENT /end FUNCTION
/begin FUNCTION convert_out65 "" /begin SUB_FUNCTION Constant gain offset MinMax Divide Add /end SUB_FUNCTION /begin DEF_CHARACTERISTIC /end DEF_CHARACTERISTIC /begin IN_MEASUREMENT /end IN_MEASUREMENT /begin OUT_MEASUREMENT /end OUT_MEASUREMENT /end FUNCTION
/begin FUNCTION convert_out66 "" /begin SUB_FUNCTION Constant gain offset MinMax Divide Add /end SUB_FUNCTION /begin DEF_CHARACTERISTIC /end DEF_CHARACTERISTIC /begin IN_MEASUREMENT /end IN_MEASUREMENT /begin OUT_MEASUREMENT /end OUT_MEASUREMENT /end FUNCTION
/begin FUNCTION convert_out67 "" /begin SUB_FUNCTION Constant gain offset MinMax Divide Add /end SUB_FUNCTION /begin DEF_CHARACTERISTIC /end DEF_CHARACTERISTIC /begin IN_MEASUREMENT /end IN_MEASUREMENT /begin OUT_MEASUREMENT /end OUT_MEASUREMENT /end FUNCTION
/begin FUNCTION convert_out68 "" /begin SUB_FUNCTION Constant gain offset MinMax Divide Add /end SUB_FUNCTION /begin DEF_CHARACTERISTIC /end DEF_CHARACTERISTIC /begin IN_MEASUREMENT /end IN_MEASUREMENT /begin OUT_MEASUREMENT /end OUT_MEASUREMENT /end FUNCTION
/begin FUNCTION convert_out69 "" /begin SUB_FUNCTION Constant gain offset MinMax Divide Add /end SUB_FUNCTION /begin DEF_CHARACTERISTIC /end DEF_CHARACTERISTIC /begin IN_MEASUREMENT /end IN_MEASUREMENT /begin OUT_MEASUREMENT /end OUT_MEASUREMENT /end FUNCTION
/begin FUNCTION convert_out70 "" /begin SUB_FUNCTION Constant gain offset MinMax Divide Add /end SUB_FUNCTION /begin DEF_CHARACTERISTIC /end DEF_CHARACTERISTIC /begin IN_MEASUREMENT /end IN_MEASUREMENT /begin OUT_MEASUREMENT /end OUT_MEASUREMENT /end FUNCTION
/begin FUNCTION convert_out72 "" /begin SUB_FUNCTION Constant gain offset MinMax Divide Add /end SUB_FUNCTION /begin DEF_CHARACTERISTIC /end DEF_CHARACTERISTIC /begin IN_MEASUREMENT /end IN_MEASUREMENT /begin OUT_MEASUREMENT /end OUT_MEASUREMENT /end FUNCTION
/begin FUNCTION convert_out73 "" /begin SUB_FUNCTION Constant gain offset MinMax Divide Add /end SUB_FUNCTION /begin DEF_CHARACTERISTIC /end DEF_CHARACTERISTIC /begin IN_MEASUREMENT /end IN_MEASUREMENT /begin OUT_MEASUREMENT /end OUT_MEASUREMENT /end FUNCTION
/begin FUNCTION convert_out74 "" /begin SUB_FUNCTION Constant gain offset MinMax Divide Add /end SUB_FUNCTION /begin DEF_CHARACTERISTIC /end DEF_CHARACTERISTIC /begin IN_MEASUREMENT /end IN_MEASUREMENT /begin OUT_MEASUREMENT /end OUT_MEASUREMENT /end FUNCTION
/begin FUNCTION convert_out75 "" /begin SUB_FUNCTION Constant gain offset MinMax Divide Add /end SUB_FUNCTION /begin DEF_CHARACTERISTIC /end DEF_CHARACTERISTIC /begin IN_MEASUREMENT /end IN_MEASUREMENT /begin OUT_MEASUREMENT /end OUT_MEASUREMENT /end FUNCTION
/begin FUNCTION convert_out76 "" /begin SUB_FUNCTION Constant gain offset MinMax Divide Add /end SUB_FUNCTION /begin DEF_CHARACTERISTIC /end DEF_CHARACTERISTIC /begin IN_MEASUREMENT /end IN_MEASUREMENT /begin OUT_MEASUREMENT /end OUT_MEASUREMENT /end FUNCTION
/begin FUNCTION convert_out77 "" /begin SUB_FUNCTION Constant gain offset MinMax Divide Add /end SUB_FUNCTION /begin DEF_CHARACTERISTIC /end DEF_CHARACTERISTIC /begin IN_MEASUREMENT /end IN_MEASUREMENT /begin OUT_MEASUREMENT /end OUT_MEASUREMENT /end FUNCTION
/begin FUNCTION convert_out78 "" /begin SUB_FUNCTION Constant gain offset MinMax Divide Add /end SUB_FUNCTION /begin DEF_CHARACTERISTIC /end DEF_CHARACTERISTIC /begin IN_MEASUREMENT /end IN_MEASUREMENT /begin OUT_MEASUREMENT /end OUT_MEASUREMENT /end FUNCTION
/begin RECORD_LAYOUT Scalar_BOOLEAN FNC_VALUES 1 UBYTE COLUMN_DIR DIRECT /end RECORD_LAYOUT
/begin RECORD_LAYOUT Scalar_BYTE FNC_VALUES 1 SBYTE COLUMN_DIR DIRECT /end RECORD_LAYOUT
/begin RECORD_LAYOUT Scalar_SWORD FNC_VALUES 1 SWORD COLUMN_DIR DIRECT /end RECORD_LAYOUT
/begin CHARACTERISTIC KHAL_CAN1FD1APS3TxReq_flg "" VALUE 0 Scalar_BOOLEAN 0 SWC_HALOUT_type_CM_boolean_flg 0.0 1.0 /end CHARACTERISTIC
/begin CHARACTERISTIC KHAL_CAN1FD1VCU2TxReq_flg "" VALUE 0 Scalar_BOOLEAN 0 SWC_HALOUT_type_CM_boolean_flg 0.0 1.0 /end CHARACTERISTIC
/begin CHARACTERISTIC KHAL_CAN1FD1VCU3TxReq_flg "" VALUE 0 Scalar_BOOLEAN 0 SWC_HALOUT_type_CM_boolean_flg 0.0 1.0 /end CHARACTERISTIC
/begin CHARACTERISTIC KHAL_CAN1TxReq_flg "" VALUE 0 Scalar_BOOLEAN 0 SWC_HALOUT_type_CM_boolean_flg 0.0 1.0 /end CHARACTERISTIC
/begin CHARACTERISTIC KHAL_CAN1VMCFCM1TxReq_flg "" VALUE 0 Scalar_BOOLEAN 0 SWC_HALOUT_type_CM_boolean_flg 0.0 1.0 /end CHARACTERISTIC
/begin CHARACTERISTIC KHAL_CAN2TxReq_flg "" VALUE 0 Scalar_BOOLEAN 0 SWC_HALOUT_type_CM_boolean_flg 0.0 1.0 /end CHARACTERISTIC
/begin CHARACTERISTIC KHAL_CAN3FD3VCU1TxReq_flg "" VALUE 0 Scalar_BOOLEAN 0 SWC_HALOUT_type_CM_boolean_flg 0.0 1.0 /end CHARACTERISTIC
/begin CHARACTERISTIC KHAL_CAN3FD3VCU1toNIDECTxReq_flg "" VALUE 0 Scalar_BOOLEAN 0 SWC_HALOUT_type_CM_boolean_flg 0.0 1.0 /end CHARACTERISTIC
/begin CHARACTERISTIC KHAL_CAN3FD3VCU2TxReq_flg "" VALUE 0 Scalar_BOOLEAN 0 SWC_HALOUT_type_CM_boolean_flg 0.0 1.0 /end CHARACTERISTIC
/begin CHARACTERISTIC KHAL_CAN3FD3VCU2toNIDECTxReq_flg "" VALUE 0 Scalar_BOOLEAN 0 SWC_HALOUT_type_CM_boolean_flg 0.0 1.0 /end CHARACTERISTIC
/begin CHARACTERISTIC KHAL_CAN3TxReq_flg "" VALUE 0 Scalar_BOOLEAN 0 SWC_HALOUT_type_CM_boolean_flg 0.0 1.0 /end CHARACTERISTIC
/begin CHARACTERISTIC KHAL_CAN4FD4CE1000TxReq_flg "" VALUE 0 Scalar_BOOLEAN 0 SWC_HALOUT_type_CM_boolean_flg 0.0 1.0 /end CHARACTERISTIC
/begin CHARACTERISTIC KHAL_CAN4TxReq_flg "" VALUE 0 Scalar_BOOLEAN 0 SWC_HALOUT_type_CM_boolean_flg 0.0 1.0 /end CHARACTERISTIC
/begin CHARACTERISTIC KHAL_CAN5TxReq_flg "" VALUE 0 Scalar_BOOLEAN 0 SWC_HALOUT_type_CM_boolean_flg 0.0 1.0 /end CHARACTERISTIC
/begin CHARACTERISTIC KHAL_CAN6FD6APS3TxReq_flg "" VALUE 0 Scalar_BOOLEAN 0 SWC_HALOUT_type_CM_boolean_flg 0.0 1.0 /end CHARACTERISTIC
/begin CHARACTERISTIC KHAL_CAN6FD6VCU2TxReq_flg "" VALUE 0 Scalar_BOOLEAN 0 SWC_HALOUT_type_CM_boolean_flg 0.0 1.0 /end CHARACTERISTIC
/begin CHARACTERISTIC KHAL_CAN6TxReq_flg "" VALUE 0 Scalar_BOOLEAN 0 SWC_HALOUT_type_CM_boolean_flg 0.0 1.0 /end CHARACTERISTIC
/begin COMPU_METHOD SWC_HALOUT_type_CM_boolean_flg "Q = V" RAT_FUNC "%1.0" "flg" COEFFS 0 1 0 0 0 1 /end COMPU_METHOD
/begin GROUP S14_HAL_OUT "SWC_HALOUT_type/run_SWC_HALOUT_Tx_5ms_sys/HAL_OUT"
 /begin REF_CHARACTERISTIC KHAL_CAN1TxReq_flg KHAL_CAN2TxReq_flg KHAL_CAN3TxReq_flg KHAL_CAN4TxReq_flg KHAL_CAN5TxReq_flg KHAL_CAN6TxReq_flg /end REF_CHARACTERISTIC
/end GROUP
/begin GROUP S19_CAN1 "SWC_HALOUT_type/run_SWC_HALOUT_Tx_5ms_sys/HAL_OUT/CAN1"
 /begin REF_CHARACTERISTIC KHAL_CAN1FD1APS3TxReq_flg KHAL_CAN1FD1VCU2TxReq_flg KHAL_CAN1FD1VCU3TxReq_flg KHAL_CAN1VMCFCM1TxReq_flg /end REF_CHARACTERISTIC
/end GROUP
/begin GROUP S19_CAN3 "SWC_HALOUT_type/run_SWC_HALOUT_Tx_5ms_sys/HAL_OUT/CAN3"
 /begin REF_CHARACTERISTIC KHAL_CAN3FD3VCU1TxReq_flg KHAL_CAN3FD3VCU1toNIDECTxReq_flg KHAL_CAN3FD3VCU2TxReq_flg KHAL_CAN3FD3VCU2toNIDECTxReq_flg /end REF_CHARACTERISTIC
/end GROUP
/begin GROUP S19_CAN4 "SWC_HALOUT_type/run_SWC_HALOUT_Tx_5ms_sys/HAL_OUT/CAN4" /begin REF_CHARACTERISTIC KHAL_CAN4FD4CE1000TxReq_flg /end REF_CHARACTERISTIC /end GROUP
/begin GROUP S19_CAN6 "SWC_HALOUT_type/run_SWC_HALOUT_Tx_5ms_sys/HAL_OUT/CAN6" /begin REF_CHARACTERISTIC KHAL_CAN6FD6APS3TxReq_flg KHAL_CAN6FD6VCU2TxReq_flg /end REF_CHARACTERISTIC /end GROUP
/end MODULE
/end PROJECT
/* (add any file trailer comments here) */ /* EOF SWC_HALOUT_type.a2l */
