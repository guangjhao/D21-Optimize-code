ASAP2_VERSION 1 31
/begin PROJECT ProjectName "Project Comment Goes Here"
/begin HEADER "Header Comments go here" /end HEADER
/begin MODULE ModuleName "Module Comment Goes Here"
/begin MOD_COMMON "Mod Common Comment Here" BYTE_ORDER MSB_LAST /end MOD_COMMON
/begin RECORD_LAYOUT Scalar_BOOLEAN FNC_VALUES 1 UBYTE COLUMN_DIR DIRECT /end RECORD_LAYOUT
/begin RECORD_LAYOUT Scalar_UBYTE FNC_VALUES 1 UBYTE COLUMN_DIR DIRECT /end RECORD_LAYOUT
/begin RECORD_LAYOUT Scalar_UWORD FNC_VALUES 1 UWORD COLUMN_DIR DIRECT /end RECORD_LAYOUT
/begin RECORD_LAYOUT Scalar_FLOAT32_IEEE FNC_VALUES 1 FLOAT32_IEEE COLUMN_DIR DIRECT /end RECORD_LAYOUT
/begin RECORD_LAYOUT Lookup1D_FLOAT64_IEEE FNC_VALUES 1 FLOAT64_IEEE COLUMN_DIR DIRECT /end RECORD_LAYOUT
/begin RECORD_LAYOUT Lookup1D_X_FLOAT64_IEEE AXIS_PTS_X 1 FLOAT64_IEEE INDEX_INCR DIRECT /end RECORD_LAYOUT
/begin RECORD_LAYOUT Lookup2D_BOOLEAN FNC_VALUES 1 UBYTE COLUMN_DIR DIRECT /end RECORD_LAYOUT
/begin RECORD_LAYOUT Lookup2D_X_BOOLEAN AXIS_PTS_X 1 UBYTE INDEX_INCR DIRECT /end RECORD_LAYOUT
/begin RECORD_LAYOUT Lookup2D_UBYTE FNC_VALUES 1 UBYTE COLUMN_DIR DIRECT /end RECORD_LAYOUT
/begin RECORD_LAYOUT Lookup2D_X_UBYTE AXIS_PTS_X 1 UBYTE INDEX_INCR DIRECT /end RECORD_LAYOUT
/begin RECORD_LAYOUT Lookup2D_BYTE FNC_VALUES 1 SBYTE COLUMN_DIR DIRECT /end RECORD_LAYOUT
/begin CHARACTERISTIC KINP_ACChrgCurrDis_A_defval "" VALUE 0x0000 /* @ECU_Address@KINP_ACChrgCurrDis_A_defval@ */ Scalar_FLOAT32_IEEE 0 SWC_INP_type_CM_single_A -1000.0 2276.5 /end CHARACTERISTIC
/begin CHARACTERISTIC KINP_ACChrgCurrDis_A_ovrdval "" VALUE 0x0000 /* @ECU_Address@KINP_ACChrgCurrDis_A_ovrdval@ */ Scalar_FLOAT32_IEEE 0 SWC_INP_type_CM_single_A -1000.0 2276.5 /end CHARACTERISTIC
/begin CHARACTERISTIC KINP_CellTempAvg_C_defval "" VALUE 0x0000 /* @ECU_Address@KINP_CellTempAvg_C_defval@ */ Scalar_FLOAT32_IEEE 0 SWC_INP_type_CM_single_C -40.0 213.0 /end CHARACTERISTIC
/begin CHARACTERISTIC KINP_CellTempAvg_C_ovrdval "" VALUE 0x0000 /* @ECU_Address@KINP_CellTempAvg_C_ovrdval@ */ Scalar_FLOAT32_IEEE 0 SWC_INP_type_CM_single_C -40.0 213.0 /end CHARACTERISTIC
/begin CHARACTERISTIC KINP_DCDCAuxCur_A_defval "" VALUE 0x0000 /* @ECU_Address@KINP_DCDCAuxCur_A_defval@ */ Scalar_FLOAT32_IEEE 0 SWC_INP_type_CM_single_A 0.0 409.5 /end CHARACTERISTIC
/begin CHARACTERISTIC KINP_DCDCAuxCur_A_ovrdval "" VALUE 0x0000 /* @ECU_Address@KINP_DCDCAuxCur_A_ovrdval@ */ Scalar_FLOAT32_IEEE 0 SWC_INP_type_CM_single_A 0.0 409.5 /end CHARACTERISTIC
/begin CHARACTERISTIC KINP_DCDCAuxVolt_V_defval "" VALUE 0x0000 /* @ECU_Address@KINP_DCDCAuxVolt_V_defval@ */ Scalar_FLOAT32_IEEE 0 SWC_INP_type_CM_single_V 8.0 19.938 /end CHARACTERISTIC
/begin CHARACTERISTIC KINP_DCDCAuxVolt_V_ovrdval "" VALUE 0x0000 /* @ECU_Address@KINP_DCDCAuxVolt_V_ovrdval@ */ Scalar_FLOAT32_IEEE 0 SWC_INP_type_CM_single_V 8.0 19.938 /end CHARACTERISTIC
/begin CHARACTERISTIC KINP_DCDCHVCur_A_defval "" VALUE 0x0000 /* @ECU_Address@KINP_DCDCHVCur_A_defval@ */ Scalar_FLOAT32_IEEE 0 SWC_INP_type_CM_single_A 0.0 20.46 /end CHARACTERISTIC
/begin CHARACTERISTIC KINP_DCDCHVCur_A_ovrdval "" VALUE 0x0000 /* @ECU_Address@KINP_DCDCHVCur_A_ovrdval@ */ Scalar_FLOAT32_IEEE 0 SWC_INP_type_CM_single_A 0.0 20.46 /end CHARACTERISTIC
/begin CHARACTERISTIC KINP_DCDCInVoltInf_V_defval "" VALUE 0x0000 /* @ECU_Address@KINP_DCDCInVoltInf_V_defval@ */ Scalar_FLOAT32_IEEE 0 SWC_INP_type_CM_single_V 0.0 1023.5 /end CHARACTERISTIC
/begin CHARACTERISTIC KINP_DCDCInVoltInf_V_ovrdval "" VALUE 0x0000 /* @ECU_Address@KINP_DCDCInVoltInf_V_ovrdval@ */ Scalar_FLOAT32_IEEE 0 SWC_INP_type_CM_single_V 0.0 1023.5 /end CHARACTERISTIC
/begin CHARACTERISTIC KINP_DCDCTemp_C_defval "" VALUE 0x0000 /* @ECU_Address@KINP_DCDCTemp_C_defval@ */ Scalar_FLOAT32_IEEE 0 SWC_INP_type_CM_single_C -48.0 142.5 /end CHARACTERISTIC
/begin CHARACTERISTIC KINP_DCDCTemp_C_ovrdval "" VALUE 0x0000 /* @ECU_Address@KINP_DCDCTemp_C_ovrdval@ */ Scalar_FLOAT32_IEEE 0 SWC_INP_type_CM_single_C -48.0 142.5 /end CHARACTERISTIC
/begin CHARACTERISTIC KINP_FrCoolanttempReqNidec_C_defval "" VALUE 0x0000 /* @ECU_Address@KINP_FrCoolanttempReqNidec_C_defval@ */ Scalar_FLOAT32_IEEE 0 SWC_INP_type_CM_single_C -40.0 214.0 /end CHARACTERISTIC
/begin CHARACTERISTIC KINP_FrCoolanttempReqNidec_C_ovrdval "" VALUE 0x0000 /* @ECU_Address@KINP_FrCoolanttempReqNidec_C_ovrdval@ */ Scalar_FLOAT32_IEEE 0 SWC_INP_type_CM_single_C -40.0 214.0 /end CHARACTERISTIC
/begin CHARACTERISTIC KINP_FrCoolanttempReq_C_defval "" VALUE 0x0000 /* @ECU_Address@KINP_FrCoolanttempReq_C_defval@ */ Scalar_FLOAT32_IEEE 0 SWC_INP_type_CM_single_C -40.0 214.0 /end CHARACTERISTIC
/begin CHARACTERISTIC KINP_FrCoolanttempReq_C_ovrdval "" VALUE 0x0000 /* @ECU_Address@KINP_FrCoolanttempReq_C_ovrdval@ */ Scalar_FLOAT32_IEEE 0 SWC_INP_type_CM_single_C -40.0 214.0 /end CHARACTERISTIC
/begin CHARACTERISTIC KINP_FrEDURealTMTqNidec_Nm_defval "" VALUE 0x0000 /* @ECU_Address@KINP_FrEDURealTMTqNidec_Nm_defval@ */ Scalar_FLOAT32_IEEE 0 SWC_INP_type_CM_single_Nm -1022.0 1022.0 /end CHARACTERISTIC
/begin CHARACTERISTIC KINP_FrEDURealTMTqNidec_Nm_ovrdval "" VALUE 0x0000 /* @ECU_Address@KINP_FrEDURealTMTqNidec_Nm_ovrdval@ */ Scalar_FLOAT32_IEEE 0 SWC_INP_type_CM_single_Nm -1022.0 1022.0 /end CHARACTERISTIC
/begin CHARACTERISTIC KINP_FrEDURealTMTq_Nm_defval "" VALUE 0x0000 /* @ECU_Address@KINP_FrEDURealTMTq_Nm_defval@ */ Scalar_FLOAT32_IEEE 0 SWC_INP_type_CM_single_Nm -1022.0 5531.5 /end CHARACTERISTIC
/begin CHARACTERISTIC KINP_FrEDURealTMTq_Nm_ovrdval "" VALUE 0x0000 /* @ECU_Address@KINP_FrEDURealTMTq_Nm_ovrdval@ */ Scalar_FLOAT32_IEEE 0 SWC_INP_type_CM_single_Nm -1022.0 5531.5 /end CHARACTERISTIC
/begin CHARACTERISTIC KINP_FrEDUTqReqFbkNidec_Nm_defval "" VALUE 0x0000 /* @ECU_Address@KINP_FrEDUTqReqFbkNidec_Nm_defval@ */ Scalar_FLOAT32_IEEE 0 SWC_INP_type_CM_single_Nm -1022.0 1022.0 /end CHARACTERISTIC
/begin CHARACTERISTIC KINP_FrEDUTqReqFbkNidec_Nm_ovrdval "" VALUE 0x0000 /* @ECU_Address@KINP_FrEDUTqReqFbkNidec_Nm_ovrdval@ */ Scalar_FLOAT32_IEEE 0 SWC_INP_type_CM_single_Nm -1022.0 1022.0 /end CHARACTERISTIC
/begin CHARACTERISTIC KINP_FrEDUTqReqFbk_Nm_defval "" VALUE 0x0000 /* @ECU_Address@KINP_FrEDUTqReqFbk_Nm_defval@ */ Scalar_FLOAT32_IEEE 0 SWC_INP_type_CM_single_Nm -1022.0 1022.0 /end CHARACTERISTIC
/begin CHARACTERISTIC KINP_FrEDUTqReqFbk_Nm_ovrdval "" VALUE 0x0000 /* @ECU_Address@KINP_FrEDUTqReqFbk_Nm_ovrdval@ */ Scalar_FLOAT32_IEEE 0 SWC_INP_type_CM_single_Nm -1022.0 1022.0 /end CHARACTERISTIC
/begin CHARACTERISTIC KINP_FrEOPSpdSetNidec_rpm_defval "" VALUE 0x0000 /* @ECU_Address@KINP_FrEOPSpdSetNidec_rpm_defval@ */ Scalar_FLOAT32_IEEE 0 SWC_INP_type_CM_single_rpm 0.0 4000.0 /end CHARACTERISTIC
/begin CHARACTERISTIC KINP_FrEOPSpdSetNidec_rpm_ovrdval "" VALUE 0x0000 /* @ECU_Address@KINP_FrEOPSpdSetNidec_rpm_ovrdval@ */ Scalar_FLOAT32_IEEE 0 SWC_INP_type_CM_single_rpm 0.0 4000.0 /end CHARACTERISTIC
/begin CHARACTERISTIC KINP_FrLLCTemp_C_defval "" VALUE 0x0000 /* @ECU_Address@KINP_FrLLCTemp_C_defval@ */ Scalar_FLOAT32_IEEE 0 SWC_INP_type_CM_single_C -40.0 214.0 /end CHARACTERISTIC
/begin CHARACTERISTIC KINP_FrLLCTemp_C_ovrdval "" VALUE 0x0000 /* @ECU_Address@KINP_FrLLCTemp_C_ovrdval@ */ Scalar_FLOAT32_IEEE 0 SWC_INP_type_CM_single_C -40.0 214.0 /end CHARACTERISTIC
/begin CHARACTERISTIC KINP_FrLLCflowReq_Lpmin_defval "" VALUE 0x0000 /* @ECU_Address@KINP_FrLLCflowReq_Lpmin_defval@ */ Scalar_FLOAT32_IEEE 0 SWC_INP_type_CM_single_Lpmin 0.0 15.5 /end CHARACTERISTIC
/begin CHARACTERISTIC KINP_FrLLCflowReq_Lpmin_ovrdval "" VALUE 0x0000 /* @ECU_Address@KINP_FrLLCflowReq_Lpmin_ovrdval@ */ Scalar_FLOAT32_IEEE 0 SWC_INP_type_CM_single_Lpmin 0.0 15.5 /end CHARACTERISTIC
/begin CHARACTERISTIC KINP_FrMCUBATNidec_V_defval "" VALUE 0x0000 /* @ECU_Address@KINP_FrMCUBATNidec_V_defval@ */ Scalar_FLOAT32_IEEE 0 SWC_INP_type_CM_single_V 0.0 25.4 /end CHARACTERISTIC
/begin CHARACTERISTIC KINP_FrMCUBATNidec_V_ovrdval "" VALUE 0x0000 /* @ECU_Address@KINP_FrMCUBATNidec_V_ovrdval@ */ Scalar_FLOAT32_IEEE 0 SWC_INP_type_CM_single_V 0.0 25.4 /end CHARACTERISTIC
/begin CHARACTERISTIC KINP_FrMCUBAT_V_defval "" VALUE 0x0000 /* @ECU_Address@KINP_FrMCUBAT_V_defval@ */ Scalar_FLOAT32_IEEE 0 SWC_INP_type_CM_single_V 0.0 25.4 /end CHARACTERISTIC
/begin CHARACTERISTIC KINP_FrMCUBAT_V_ovrdval "" VALUE 0x0000 /* @ECU_Address@KINP_FrMCUBAT_V_ovrdval@ */ Scalar_FLOAT32_IEEE 0 SWC_INP_type_CM_single_V 0.0 25.4 /end CHARACTERISTIC
/begin CHARACTERISTIC KINP_FrMCUDCBusCurrNidec_A_defval "" VALUE 0x0000 /* @ECU_Address@KINP_FrMCUDCBusCurrNidec_A_defval@ */ Scalar_FLOAT32_IEEE 0 SWC_INP_type_CM_single_A -1500.0 1500.0 /end CHARACTERISTIC
/begin CHARACTERISTIC KINP_FrMCUDCBusCurrNidec_A_ovrdval "" VALUE 0x0000 /* @ECU_Address@KINP_FrMCUDCBusCurrNidec_A_ovrdval@ */ Scalar_FLOAT32_IEEE 0 SWC_INP_type_CM_single_A -1500.0 1500.0 /end CHARACTERISTIC
/begin CHARACTERISTIC KINP_FrMCUDCBusCurr_A_defval "" VALUE 0x0000 /* @ECU_Address@KINP_FrMCUDCBusCurr_A_defval@ */ Scalar_FLOAT32_IEEE 0 SWC_INP_type_CM_single_A -1500.0 1500.0 /end CHARACTERISTIC
/begin CHARACTERISTIC KINP_FrMCUDCBusCurr_A_ovrdval "" VALUE 0x0000 /* @ECU_Address@KINP_FrMCUDCBusCurr_A_ovrdval@ */ Scalar_FLOAT32_IEEE 0 SWC_INP_type_CM_single_A -1500.0 1500.0 /end CHARACTERISTIC
/begin CHARACTERISTIC KINP_FrMCUDCBusVoltNidec_V_defval "" VALUE 0x0000 /* @ECU_Address@KINP_FrMCUDCBusVoltNidec_V_defval@ */ Scalar_FLOAT32_IEEE 0 SWC_INP_type_CM_single_V 0.0 4000.0 /end CHARACTERISTIC
/begin CHARACTERISTIC KINP_FrMCUDCBusVoltNidec_V_ovrdval "" VALUE 0x0000 /* @ECU_Address@KINP_FrMCUDCBusVoltNidec_V_ovrdval@ */ Scalar_FLOAT32_IEEE 0 SWC_INP_type_CM_single_V 0.0 4000.0 /end CHARACTERISTIC
/begin CHARACTERISTIC KINP_FrMCUDCBusVolt_V_defval "" VALUE 0x0000 /* @ECU_Address@KINP_FrMCUDCBusVolt_V_defval@ */ Scalar_FLOAT32_IEEE 0 SWC_INP_type_CM_single_V 0.0 4000.0 /end CHARACTERISTIC
/begin CHARACTERISTIC KINP_FrMCUDCBusVolt_V_ovrdval "" VALUE 0x0000 /* @ECU_Address@KINP_FrMCUDCBusVolt_V_ovrdval@ */ Scalar_FLOAT32_IEEE 0 SWC_INP_type_CM_single_V 0.0 4000.0 /end CHARACTERISTIC
/begin CHARACTERISTIC KINP_FrMCUTempNidec_C_defval "" VALUE 0x0000 /* @ECU_Address@KINP_FrMCUTempNidec_C_defval@ */ Scalar_FLOAT32_IEEE 0 SWC_INP_type_CM_single_C -40.0 254.0 /end CHARACTERISTIC
/begin CHARACTERISTIC KINP_FrMCUTempNidec_C_ovrdval "" VALUE 0x0000 /* @ECU_Address@KINP_FrMCUTempNidec_C_ovrdval@ */ Scalar_FLOAT32_IEEE 0 SWC_INP_type_CM_single_C -40.0 254.0 /end CHARACTERISTIC
/begin CHARACTERISTIC KINP_FrMCUTemp_C_defval "" VALUE 0x0000 /* @ECU_Address@KINP_FrMCUTemp_C_defval@ */ Scalar_FLOAT32_IEEE 0 SWC_INP_type_CM_single_C -40.0 254.0 /end CHARACTERISTIC
/begin CHARACTERISTIC KINP_FrMCUTemp_C_ovrdval "" VALUE 0x0000 /* @ECU_Address@KINP_FrMCUTemp_C_ovrdval@ */ Scalar_FLOAT32_IEEE 0 SWC_INP_type_CM_single_C -40.0 254.0 /end CHARACTERISTIC
/begin CHARACTERISTIC KINP_FrMotorAvailTqNidec_Nm_defval "" VALUE 0x0000 /* @ECU_Address@KINP_FrMotorAvailTqNidec_Nm_defval@ */ Scalar_FLOAT32_IEEE 0 SWC_INP_type_CM_single_Nm 0.0 1022.0 /end CHARACTERISTIC
/begin CHARACTERISTIC KINP_FrMotorAvailTqNidec_Nm_ovrdval "" VALUE 0x0000 /* @ECU_Address@KINP_FrMotorAvailTqNidec_Nm_ovrdval@ */ Scalar_FLOAT32_IEEE 0 SWC_INP_type_CM_single_Nm 0.0 1022.0 /end CHARACTERISTIC
/begin CHARACTERISTIC KINP_FrMotorAvailTq_Nm_defval "" VALUE 0x0000 /* @ECU_Address@KINP_FrMotorAvailTq_Nm_defval@ */ Scalar_FLOAT32_IEEE 0 SWC_INP_type_CM_single_Nm 0.0 1022.0 /end CHARACTERISTIC
/begin CHARACTERISTIC KINP_FrMotorAvailTq_Nm_ovrdval "" VALUE 0x0000 /* @ECU_Address@KINP_FrMotorAvailTq_Nm_ovrdval@ */ Scalar_FLOAT32_IEEE 0 SWC_INP_type_CM_single_Nm 0.0 1022.0 /end CHARACTERISTIC
/begin CHARACTERISTIC KINP_FrRegenAvailTqNidec_Nm_defval "" VALUE 0x0000 /* @ECU_Address@KINP_FrRegenAvailTqNidec_Nm_defval@ */ Scalar_FLOAT32_IEEE 0 SWC_INP_type_CM_single_Nm -1022.0 0.0 /end CHARACTERISTIC
/begin CHARACTERISTIC KINP_FrRegenAvailTqNidec_Nm_ovrdval "" VALUE 0x0000 /* @ECU_Address@KINP_FrRegenAvailTqNidec_Nm_ovrdval@ */ Scalar_FLOAT32_IEEE 0 SWC_INP_type_CM_single_Nm -1022.0 0.0 /end CHARACTERISTIC
/begin CHARACTERISTIC KINP_FrRegenAvailTq_Nm_defval "" VALUE 0x0000 /* @ECU_Address@KINP_FrRegenAvailTq_Nm_defval@ */ Scalar_FLOAT32_IEEE 0 SWC_INP_type_CM_single_Nm -1022.0 0.0 /end CHARACTERISTIC
/begin CHARACTERISTIC KINP_FrRegenAvailTq_Nm_ovrdval "" VALUE 0x0000 /* @ECU_Address@KINP_FrRegenAvailTq_Nm_ovrdval@ */ Scalar_FLOAT32_IEEE 0 SWC_INP_type_CM_single_Nm -1022.0 0.0 /end CHARACTERISTIC
/begin CHARACTERISTIC KINP_FrTMSpdNidec_rpm_defval "" VALUE 0x0000 /* @ECU_Address@KINP_FrTMSpdNidec_rpm_defval@ */ Scalar_FLOAT32_IEEE 0 SWC_INP_type_CM_single_rpm -17000.0 17000.0 /end CHARACTERISTIC
/begin CHARACTERISTIC KINP_FrTMSpdNidec_rpm_ovrdval "" VALUE 0x0000 /* @ECU_Address@KINP_FrTMSpdNidec_rpm_ovrdval@ */ Scalar_FLOAT32_IEEE 0 SWC_INP_type_CM_single_rpm -17000.0 17000.0 /end CHARACTERISTIC
/begin CHARACTERISTIC KINP_FrTMSpd_rpm_defval "" VALUE 0x0000 /* @ECU_Address@KINP_FrTMSpd_rpm_defval@ */ Scalar_FLOAT32_IEEE 0 SWC_INP_type_CM_single_rpm -18000.0 18000.0 /end CHARACTERISTIC
/begin CHARACTERISTIC KINP_FrTMSpd_rpm_ovrdval "" VALUE 0x0000 /* @ECU_Address@KINP_FrTMSpd_rpm_ovrdval@ */ Scalar_FLOAT32_IEEE 0 SWC_INP_type_CM_single_rpm -18000.0 18000.0 /end CHARACTERISTIC
/begin CHARACTERISTIC KINP_FrTMTempNidec_C_defval "" VALUE 0x0000 /* @ECU_Address@KINP_FrTMTempNidec_C_defval@ */ Scalar_FLOAT32_IEEE 0 SWC_INP_type_CM_single_C -40.0 254.0 /end CHARACTERISTIC
/begin CHARACTERISTIC KINP_FrTMTempNidec_C_ovrdval "" VALUE 0x0000 /* @ECU_Address@KINP_FrTMTempNidec_C_ovrdval@ */ Scalar_FLOAT32_IEEE 0 SWC_INP_type_CM_single_C -40.0 254.0 /end CHARACTERISTIC
/begin CHARACTERISTIC KINP_FrTMTemp_C_defval "" VALUE 0x0000 /* @ECU_Address@KINP_FrTMTemp_C_defval@ */ Scalar_FLOAT32_IEEE 0 SWC_INP_type_CM_single_C -40.0 254.0 /end CHARACTERISTIC
/begin CHARACTERISTIC KINP_FrTMTemp_C_ovrdval "" VALUE 0x0000 /* @ECU_Address@KINP_FrTMTemp_C_ovrdval@ */ Scalar_FLOAT32_IEEE 0 SWC_INP_type_CM_single_C -40.0 254.0 /end CHARACTERISTIC
/begin CHARACTERISTIC KINP_FrTMidNidec_A_defval "" VALUE 0x0000 /* @ECU_Address@KINP_FrTMidNidec_A_defval@ */ Scalar_FLOAT32_IEEE 0 SWC_INP_type_CM_single_A -1500.0 1500.0 /end CHARACTERISTIC
/begin CHARACTERISTIC KINP_FrTMidNidec_A_ovrdval "" VALUE 0x0000 /* @ECU_Address@KINP_FrTMidNidec_A_ovrdval@ */ Scalar_FLOAT32_IEEE 0 SWC_INP_type_CM_single_A -1500.0 1500.0 /end CHARACTERISTIC
/begin CHARACTERISTIC KINP_FrTMid_A_defval "" VALUE 0x0000 /* @ECU_Address@KINP_FrTMid_A_defval@ */ Scalar_FLOAT32_IEEE 0 SWC_INP_type_CM_single_A -1500.0 1500.0 /end CHARACTERISTIC
/begin CHARACTERISTIC KINP_FrTMid_A_ovrdval "" VALUE 0x0000 /* @ECU_Address@KINP_FrTMid_A_ovrdval@ */ Scalar_FLOAT32_IEEE 0 SWC_INP_type_CM_single_A -1500.0 1500.0 /end CHARACTERISTIC
/begin CHARACTERISTIC KINP_FrTMiqNidec_A_defval "" VALUE 0x0000 /* @ECU_Address@KINP_FrTMiqNidec_A_defval@ */ Scalar_FLOAT32_IEEE 0 SWC_INP_type_CM_single_A -1500.0 1500.0 /end CHARACTERISTIC
/begin CHARACTERISTIC KINP_FrTMiqNidec_A_ovrdval "" VALUE 0x0000 /* @ECU_Address@KINP_FrTMiqNidec_A_ovrdval@ */ Scalar_FLOAT32_IEEE 0 SWC_INP_type_CM_single_A -1500.0 1500.0 /end CHARACTERISTIC
/begin CHARACTERISTIC KINP_FrTMiq_A_defval "" VALUE 0x0000 /* @ECU_Address@KINP_FrTMiq_A_defval@ */ Scalar_FLOAT32_IEEE 0 SWC_INP_type_CM_single_A -1500.0 1500.0 /end CHARACTERISTIC
/begin CHARACTERISTIC KINP_FrTMiq_A_ovrdval "" VALUE 0x0000 /* @ECU_Address@KINP_FrTMiq_A_ovrdval@ */ Scalar_FLOAT32_IEEE 0 SWC_INP_type_CM_single_A -1500.0 1500.0 /end CHARACTERISTIC
/begin CHARACTERISTIC KINP_HVBCellVoltMax_mV_defval "" VALUE 0x0000 /* @ECU_Address@KINP_HVBCellVoltMax_mV_defval@ */ Scalar_FLOAT32_IEEE 0 SWC_INP_type_CM_single_mV 0.0 65533.0 /end CHARACTERISTIC
/begin CHARACTERISTIC KINP_HVBCellVoltMax_mV_ovrdval "" VALUE 0x0000 /* @ECU_Address@KINP_HVBCellVoltMax_mV_ovrdval@ */ Scalar_FLOAT32_IEEE 0 SWC_INP_type_CM_single_mV 0.0 65533.0 /end CHARACTERISTIC
/begin CHARACTERISTIC KINP_HVBCellVoltMin_mV_defval "" VALUE 0x0000 /* @ECU_Address@KINP_HVBCellVoltMin_mV_defval@ */ Scalar_FLOAT32_IEEE 0 SWC_INP_type_CM_single_mV 0.0 65533.0 /end CHARACTERISTIC
/begin CHARACTERISTIC KINP_HVBCellVoltMin_mV_ovrdval "" VALUE 0x0000 /* @ECU_Address@KINP_HVBCellVoltMin_mV_ovrdval@ */ Scalar_FLOAT32_IEEE 0 SWC_INP_type_CM_single_mV 0.0 65533.0 /end CHARACTERISTIC
/begin CHARACTERISTIC KINP_HVBChrgPwrTotal_kWh_defval "" VALUE 0x0000 /* @ECU_Address@KINP_HVBChrgPwrTotal_kWh_defval@ */ Scalar_FLOAT32_IEEE 0 SWC_INP_type_CM_single_kWh 0.0 262143.0 /end CHARACTERISTIC
/begin CHARACTERISTIC KINP_HVBChrgPwrTotal_kWh_ovrdval "" VALUE 0x0000 /* @ECU_Address@KINP_HVBChrgPwrTotal_kWh_ovrdval@ */ Scalar_FLOAT32_IEEE 0 SWC_INP_type_CM_single_kWh 0.0 262143.0 /end CHARACTERISTIC
/begin CHARACTERISTIC KINP_HVBChrgPwr_kWh_defval "" VALUE 0x0000 /* @ECU_Address@KINP_HVBChrgPwr_kWh_defval@ */ Scalar_FLOAT32_IEEE 0 SWC_INP_type_CM_single_kWh 0.0 102.2 /end CHARACTERISTIC
/begin CHARACTERISTIC KINP_HVBChrgPwr_kWh_ovrdval "" VALUE 0x0000 /* @ECU_Address@KINP_HVBChrgPwr_kWh_ovrdval@ */ Scalar_FLOAT32_IEEE 0 SWC_INP_type_CM_single_kWh 0.0 102.2 /end CHARACTERISTIC
/begin CHARACTERISTIC KINP_HVBDrvPwrTotal_kWh_defval "" VALUE 0x0000 /* @ECU_Address@KINP_HVBDrvPwrTotal_kWh_defval@ */ Scalar_FLOAT32_IEEE 0 SWC_INP_type_CM_single_kWh 0.0 262143.0 /end CHARACTERISTIC
/begin CHARACTERISTIC KINP_HVBDrvPwrTotal_kWh_ovrdval "" VALUE 0x0000 /* @ECU_Address@KINP_HVBDrvPwrTotal_kWh_ovrdval@ */ Scalar_FLOAT32_IEEE 0 SWC_INP_type_CM_single_kWh 0.0 262143.0 /end CHARACTERISTIC
/begin CHARACTERISTIC KINP_HVBDrvPwr_kWh_defval "" VALUE 0x0000 /* @ECU_Address@KINP_HVBDrvPwr_kWh_defval@ */ Scalar_FLOAT32_IEEE 0 SWC_INP_type_CM_single_kWh 0.0 102.2 /end CHARACTERISTIC
/begin CHARACTERISTIC KINP_HVBDrvPwr_kWh_ovrdval "" VALUE 0x0000 /* @ECU_Address@KINP_HVBDrvPwr_kWh_ovrdval@ */ Scalar_FLOAT32_IEEE 0 SWC_INP_type_CM_single_kWh 0.0 102.2 /end CHARACTERISTIC
/begin CHARACTERISTIC KINP_HVBFullChrgPwr_kWh_defval "" VALUE 0x0000 /* @ECU_Address@KINP_HVBFullChrgPwr_kWh_defval@ */ Scalar_FLOAT32_IEEE 0 SWC_INP_type_CM_single_kWh 0.0 102.2 /end CHARACTERISTIC
/begin CHARACTERISTIC KINP_HVBFullChrgPwr_kWh_ovrdval "" VALUE 0x0000 /* @ECU_Address@KINP_HVBFullChrgPwr_kWh_ovrdval@ */ Scalar_FLOAT32_IEEE 0 SWC_INP_type_CM_single_kWh 0.0 102.2 /end CHARACTERISTIC
/begin CHARACTERISTIC KINP_HVBIsoImpedenceN_Megaohm_defval "" VALUE 0x0000 /* @ECU_Address@KINP_HVBIsoImpedenceN_Megaohm_defval@ */ Scalar_FLOAT32_IEEE 0 SWC_INP_type_CM_single_Megaohm 0.0 327.66 /end CHARACTERISTIC
/begin CHARACTERISTIC KINP_HVBIsoImpedenceN_Megaohm_ovrdval "" VALUE 0x0000 /* @ECU_Address@KINP_HVBIsoImpedenceN_Megaohm_ovrdval@ */ Scalar_FLOAT32_IEEE 0 SWC_INP_type_CM_single_Megaohm 0.0 327.66 /end CHARACTERISTIC
/begin CHARACTERISTIC KINP_HVBIsoImpedenceP_Megaohm_defval "" VALUE 0x0000 /* @ECU_Address@KINP_HVBIsoImpedenceP_Megaohm_defval@ */ Scalar_FLOAT32_IEEE 0 SWC_INP_type_CM_single_Megaohm 0.0 327.66 /end CHARACTERISTIC
/begin CHARACTERISTIC KINP_HVBIsoImpedenceP_Megaohm_ovrdval "" VALUE 0x0000 /* @ECU_Address@KINP_HVBIsoImpedenceP_Megaohm_ovrdval@ */ Scalar_FLOAT32_IEEE 0 SWC_INP_type_CM_single_Megaohm 0.0 327.66 /end CHARACTERISTIC
/begin CHARACTERISTIC KINP_HVBMTempMax_C_defval "" VALUE 0x0000 /* @ECU_Address@KINP_HVBMTempMax_C_defval@ */ Scalar_FLOAT32_IEEE 0 SWC_INP_type_CM_single_C -40.0 213.0 /end CHARACTERISTIC
/begin CHARACTERISTIC KINP_HVBMTempMax_C_ovrdval "" VALUE 0x0000 /* @ECU_Address@KINP_HVBMTempMax_C_ovrdval@ */ Scalar_FLOAT32_IEEE 0 SWC_INP_type_CM_single_C -40.0 213.0 /end CHARACTERISTIC
/begin CHARACTERISTIC KINP_HVBMTempMin_C_defval "" VALUE 0x0000 /* @ECU_Address@KINP_HVBMTempMin_C_defval@ */ Scalar_FLOAT32_IEEE 0 SWC_INP_type_CM_single_C -40.0 213.0 /end CHARACTERISTIC
/begin CHARACTERISTIC KINP_HVBMTempMin_C_ovrdval "" VALUE 0x0000 /* @ECU_Address@KINP_HVBMTempMin_C_ovrdval@ */ Scalar_FLOAT32_IEEE 0 SWC_INP_type_CM_single_C -40.0 213.0 /end CHARACTERISTIC
/begin CHARACTERISTIC KINP_HVBPwrAvailChrg30_kW_defval "" VALUE 0x0000 /* @ECU_Address@KINP_HVBPwrAvailChrg30_kW_defval@ */ Scalar_FLOAT32_IEEE 0 SWC_INP_type_CM_single_kW 0.0 819.0 /end CHARACTERISTIC
/begin CHARACTERISTIC KINP_HVBPwrAvailChrg30_kW_ovrdval "" VALUE 0x0000 /* @ECU_Address@KINP_HVBPwrAvailChrg30_kW_ovrdval@ */ Scalar_FLOAT32_IEEE 0 SWC_INP_type_CM_single_kW 0.0 819.0 /end CHARACTERISTIC
/begin CHARACTERISTIC KINP_HVBPwrAvailChrg60_kW_defval "" VALUE 0x0000 /* @ECU_Address@KINP_HVBPwrAvailChrg60_kW_defval@ */ Scalar_FLOAT32_IEEE 0 SWC_INP_type_CM_single_kW 0.0 819.0 /end CHARACTERISTIC
/begin CHARACTERISTIC KINP_HVBPwrAvailChrg60_kW_ovrdval "" VALUE 0x0000 /* @ECU_Address@KINP_HVBPwrAvailChrg60_kW_ovrdval@ */ Scalar_FLOAT32_IEEE 0 SWC_INP_type_CM_single_kW 0.0 819.0 /end CHARACTERISTIC
/begin CHARACTERISTIC KINP_HVBPwrAvailChrg_kW_defval "" VALUE 0x0000 /* @ECU_Address@KINP_HVBPwrAvailChrg_kW_defval@ */ Scalar_FLOAT32_IEEE 0 SWC_INP_type_CM_single_kW 0.0 819.0 /end CHARACTERISTIC
/begin CHARACTERISTIC KINP_HVBPwrAvailChrg_kW_ovrdval "" VALUE 0x0000 /* @ECU_Address@KINP_HVBPwrAvailChrg_kW_ovrdval@ */ Scalar_FLOAT32_IEEE 0 SWC_INP_type_CM_single_kW 0.0 819.0 /end CHARACTERISTIC
/begin CHARACTERISTIC KINP_HVBPwrAvailDchrg30_kW_defval "" VALUE 0x0000 /* @ECU_Address@KINP_HVBPwrAvailDchrg30_kW_defval@ */ Scalar_FLOAT32_IEEE 0 SWC_INP_type_CM_single_kW 0.0 819.0 /end CHARACTERISTIC
/begin CHARACTERISTIC KINP_HVBPwrAvailDchrg30_kW_ovrdval "" VALUE 0x0000 /* @ECU_Address@KINP_HVBPwrAvailDchrg30_kW_ovrdval@ */ Scalar_FLOAT32_IEEE 0 SWC_INP_type_CM_single_kW 0.0 819.0 /end CHARACTERISTIC
/begin CHARACTERISTIC KINP_HVBPwrAvailDchrg60_kW_defval "" VALUE 0x0000 /* @ECU_Address@KINP_HVBPwrAvailDchrg60_kW_defval@ */ Scalar_FLOAT32_IEEE 0 SWC_INP_type_CM_single_kW 0.0 819.0 /end CHARACTERISTIC
/begin CHARACTERISTIC KINP_HVBPwrAvailDchrg60_kW_ovrdval "" VALUE 0x0000 /* @ECU_Address@KINP_HVBPwrAvailDchrg60_kW_ovrdval@ */ Scalar_FLOAT32_IEEE 0 SWC_INP_type_CM_single_kW 0.0 819.0 /end CHARACTERISTIC
/begin CHARACTERISTIC KINP_HVBPwrAvailDchrg_kW_defval "" VALUE 0x0000 /* @ECU_Address@KINP_HVBPwrAvailDchrg_kW_defval@ */ Scalar_FLOAT32_IEEE 0 SWC_INP_type_CM_single_kW 0.0 819.0 /end CHARACTERISTIC
/begin CHARACTERISTIC KINP_HVBPwrAvailDchrg_kW_ovrdval "" VALUE 0x0000 /* @ECU_Address@KINP_HVBPwrAvailDchrg_kW_ovrdval@ */ Scalar_FLOAT32_IEEE 0 SWC_INP_type_CM_single_kW 0.0 819.0 /end CHARACTERISTIC
/begin CHARACTERISTIC KINP_HVBSOH_pct_defval "" VALUE 0x0000 /* @ECU_Address@KINP_HVBSOH_pct_defval@ */ Scalar_FLOAT32_IEEE 0 SWC_INP_type_CM_single_pct 0.0 100.0 /end CHARACTERISTIC
/begin CHARACTERISTIC KINP_HVBSOH_pct_ovrdval "" VALUE 0x0000 /* @ECU_Address@KINP_HVBSOH_pct_ovrdval@ */ Scalar_FLOAT32_IEEE 0 SWC_INP_type_CM_single_pct 0.0 100.0 /end CHARACTERISTIC
/begin CHARACTERISTIC KINP_HVBattCurr_A_defval "" VALUE 0x0000 /* @ECU_Address@KINP_HVBattCurr_A_defval@ */ Scalar_FLOAT32_IEEE 0 SWC_INP_type_CM_single_A -1000.0 2276.5 /end CHARACTERISTIC
/begin CHARACTERISTIC KINP_HVBattCurr_A_ovrdval "" VALUE 0x0000 /* @ECU_Address@KINP_HVBattCurr_A_ovrdval@ */ Scalar_FLOAT32_IEEE 0 SWC_INP_type_CM_single_A -1000.0 2276.5 /end CHARACTERISTIC
/begin CHARACTERISTIC KINP_HVBattPackVolt_V_defval "" VALUE 0x0000 /* @ECU_Address@KINP_HVBattPackVolt_V_defval@ */ Scalar_FLOAT32_IEEE 0 SWC_INP_type_CM_single_V 0.0 819.0 /end CHARACTERISTIC
/begin CHARACTERISTIC KINP_HVBattPackVolt_V_ovrdval "" VALUE 0x0000 /* @ECU_Address@KINP_HVBattPackVolt_V_ovrdval@ */ Scalar_FLOAT32_IEEE 0 SWC_INP_type_CM_single_V 0.0 819.0 /end CHARACTERISTIC
/begin CHARACTERISTIC KINP_HVBattSOCDis_pct_defval "" VALUE 0x0000 /* @ECU_Address@KINP_HVBattSOCDis_pct_defval@ */ Scalar_FLOAT32_IEEE 0 SWC_INP_type_CM_single_pct 0.0 100.0 /end CHARACTERISTIC
/begin CHARACTERISTIC KINP_HVBattSOCDis_pct_ovrdval "" VALUE 0x0000 /* @ECU_Address@KINP_HVBattSOCDis_pct_ovrdval@ */ Scalar_FLOAT32_IEEE 0 SWC_INP_type_CM_single_pct 0.0 100.0 /end CHARACTERISTIC
/begin CHARACTERISTIC KINP_HVBattSOC_pct_defval "" VALUE 0x0000 /* @ECU_Address@KINP_HVBattSOC_pct_defval@ */ Scalar_FLOAT32_IEEE 0 SWC_INP_type_CM_single_pct 0.0 100.0 /end CHARACTERISTIC
/begin CHARACTERISTIC KINP_HVBattSOC_pct_ovrdval "" VALUE 0x0000 /* @ECU_Address@KINP_HVBattSOC_pct_ovrdval@ */ Scalar_FLOAT32_IEEE 0 SWC_INP_type_CM_single_pct 0.0 100.0 /end CHARACTERISTIC
/begin CHARACTERISTIC KINP_HVBattVolt_V_defval "" VALUE 0x0000 /* @ECU_Address@KINP_HVBattVolt_V_defval@ */ Scalar_FLOAT32_IEEE 0 SWC_INP_type_CM_single_V 0.0 819.0 /end CHARACTERISTIC
/begin CHARACTERISTIC KINP_HVBattVolt_V_ovrdval "" VALUE 0x0000 /* @ECU_Address@KINP_HVBattVolt_V_ovrdval@ */ Scalar_FLOAT32_IEEE 0 SWC_INP_type_CM_single_V 0.0 819.0 /end CHARACTERISTIC
/begin CHARACTERISTIC KINP_HVInVolt_V_defval "" VALUE 0x0000 /* @ECU_Address@KINP_HVInVolt_V_defval@ */ Scalar_FLOAT32_IEEE 0 SWC_INP_type_CM_single_V 0.0 819.0 /end CHARACTERISTIC
/begin CHARACTERISTIC KINP_HVInVolt_V_ovrdval "" VALUE 0x0000 /* @ECU_Address@KINP_HVInVolt_V_ovrdval@ */ Scalar_FLOAT32_IEEE 0 SWC_INP_type_CM_single_V 0.0 819.0 /end CHARACTERISTIC
/begin CHARACTERISTIC KINP_IVIRBlowerZSta_pct_defval "" VALUE 0x0000 /* @ECU_Address@KINP_IVIRBlowerZSta_pct_defval@ */ Scalar_FLOAT32_IEEE 0 SWC_INP_type_CM_single_pct 0.0 127.0 /end CHARACTERISTIC
/begin CHARACTERISTIC KINP_IVIRBlowerZSta_pct_ovrdval "" VALUE 0x0000 /* @ECU_Address@KINP_IVIRBlowerZSta_pct_ovrdval@ */ Scalar_FLOAT32_IEEE 0 SWC_INP_type_CM_single_pct 0.0 127.0 /end CHARACTERISTIC
/begin CHARACTERISTIC KINP_LVBattDet12V_V_defval "" VALUE 0x0000 /* @ECU_Address@KINP_LVBattDet12V_V_defval@ */ Scalar_FLOAT32_IEEE 0 SWC_INP_type_CM_single_V 0.0 25.4 /end CHARACTERISTIC
/begin CHARACTERISTIC KINP_LVBattDet12V_V_ovrdval "" VALUE 0x0000 /* @ECU_Address@KINP_LVBattDet12V_V_ovrdval@ */ Scalar_FLOAT32_IEEE 0 SWC_INP_type_CM_single_V 0.0 25.4 /end CHARACTERISTIC
/begin CHARACTERISTIC KINP_MCUBFRealPwrKwSta_kW_defval "" VALUE 0x0000 /* @ECU_Address@KINP_MCUBFRealPwrKwSta_kW_defval@ */ Scalar_FLOAT32_IEEE 0 SWC_INP_type_CM_single_kW -530.0 6023.4 /end CHARACTERISTIC
/begin CHARACTERISTIC KINP_MCUBFRealPwrKwSta_kW_ovrdval "" VALUE 0x0000 /* @ECU_Address@KINP_MCUBFRealPwrKwSta_kW_ovrdval@ */ Scalar_FLOAT32_IEEE 0 SWC_INP_type_CM_single_kW -530.0 6023.4 /end CHARACTERISTIC
/begin CHARACTERISTIC KINP_MCUBRRealPwrKwSta_kW_defval "" VALUE 0x0000 /* @ECU_Address@KINP_MCUBRRealPwrKwSta_kW_defval@ */ Scalar_FLOAT32_IEEE 0 SWC_INP_type_CM_single_kW -530.0 6023.4 /end CHARACTERISTIC
/begin CHARACTERISTIC KINP_MCUBRRealPwrKwSta_kW_ovrdval "" VALUE 0x0000 /* @ECU_Address@KINP_MCUBRRealPwrKwSta_kW_ovrdval@ */ Scalar_FLOAT32_IEEE 0 SWC_INP_type_CM_single_kW -530.0 6023.4 /end CHARACTERISTIC
/begin CHARACTERISTIC KINP_METERKPHCalcu_kph_defval "" VALUE 0x0000 /* @ECU_Address@KINP_METERKPHCalcu_kph_defval@ */ Scalar_FLOAT32_IEEE 0 SWC_INP_type_CM_single_kph 0.0 254.0 /end CHARACTERISTIC
/begin CHARACTERISTIC KINP_METERKPHCalcu_kph_ovrdval "" VALUE 0x0000 /* @ECU_Address@KINP_METERKPHCalcu_kph_ovrdval@ */ Scalar_FLOAT32_IEEE 0 SWC_INP_type_CM_single_kph 0.0 254.0 /end CHARACTERISTIC
/begin CHARACTERISTIC KINP_OBCACCSLimit_A_defval "" VALUE 0x0000 /* @ECU_Address@KINP_OBCACCSLimit_A_defval@ */ Scalar_FLOAT32_IEEE 0 SWC_INP_type_CM_single_A 0.0 80.0 /end CHARACTERISTIC
/begin CHARACTERISTIC KINP_OBCACCSLimit_A_ovrdval "" VALUE 0x0000 /* @ECU_Address@KINP_OBCACCSLimit_A_ovrdval@ */ Scalar_FLOAT32_IEEE 0 SWC_INP_type_CM_single_A 0.0 80.0 /end CHARACTERISTIC
/begin CHARACTERISTIC KINP_OBCACCurrInf_A_defval "" VALUE 0x0000 /* @ECU_Address@KINP_OBCACCurrInf_A_defval@ */ Scalar_FLOAT32_IEEE 0 SWC_INP_type_CM_single_A -40.0 87.75 /end CHARACTERISTIC
/begin CHARACTERISTIC KINP_OBCACCurrInf_A_ovrdval "" VALUE 0x0000 /* @ECU_Address@KINP_OBCACCurrInf_A_ovrdval@ */ Scalar_FLOAT32_IEEE 0 SWC_INP_type_CM_single_A -40.0 87.75 /end CHARACTERISTIC
/begin CHARACTERISTIC KINP_OBCACVoltInf_V_defval "" VALUE 0x0000 /* @ECU_Address@KINP_OBCACVoltInf_V_defval@ */ Scalar_FLOAT32_IEEE 0 SWC_INP_type_CM_single_V 0.0 409.4 /end CHARACTERISTIC
/begin CHARACTERISTIC KINP_OBCACVoltInf_V_ovrdval "" VALUE 0x0000 /* @ECU_Address@KINP_OBCACVoltInf_V_ovrdval@ */ Scalar_FLOAT32_IEEE 0 SWC_INP_type_CM_single_V 0.0 409.4 /end CHARACTERISTIC
/begin CHARACTERISTIC KINP_OBCDCCurLm_A_defval "" VALUE 0x0000 /* @ECU_Address@KINP_OBCDCCurLm_A_defval@ */ Scalar_FLOAT32_IEEE 0 SWC_INP_type_CM_single_A -25.5 76.7 /end CHARACTERISTIC
/begin CHARACTERISTIC KINP_OBCDCCurLm_A_ovrdval "" VALUE 0x0000 /* @ECU_Address@KINP_OBCDCCurLm_A_ovrdval@ */ Scalar_FLOAT32_IEEE 0 SWC_INP_type_CM_single_A -25.5 76.7 /end CHARACTERISTIC
/begin CHARACTERISTIC KINP_OBCDCCurrInf_A_defval "" VALUE 0x0000 /* @ECU_Address@KINP_OBCDCCurrInf_A_defval@ */ Scalar_FLOAT32_IEEE 0 SWC_INP_type_CM_single_A -25.5 76.7 /end CHARACTERISTIC
/begin CHARACTERISTIC KINP_OBCDCCurrInf_A_ovrdval "" VALUE 0x0000 /* @ECU_Address@KINP_OBCDCCurrInf_A_ovrdval@ */ Scalar_FLOAT32_IEEE 0 SWC_INP_type_CM_single_A -25.5 76.7 /end CHARACTERISTIC
/begin CHARACTERISTIC KINP_OBCDCVoltInf_V_defval "" VALUE 0x0000 /* @ECU_Address@KINP_OBCDCVoltInf_V_defval@ */ Scalar_FLOAT32_IEEE 0 SWC_INP_type_CM_single_V 0.0 1228.2 /end CHARACTERISTIC
/begin CHARACTERISTIC KINP_OBCDCVoltInf_V_ovrdval "" VALUE 0x0000 /* @ECU_Address@KINP_OBCDCVoltInf_V_ovrdval@ */ Scalar_FLOAT32_IEEE 0 SWC_INP_type_CM_single_V 0.0 1228.2 /end CHARACTERISTIC
/begin CHARACTERISTIC KINP_OBCDCVoltLm_V_defval "" VALUE 0x0000 /* @ECU_Address@KINP_OBCDCVoltLm_V_defval@ */ Scalar_FLOAT32_IEEE 0 SWC_INP_type_CM_single_V 0.0 819.0 /end CHARACTERISTIC
/begin CHARACTERISTIC KINP_OBCDCVoltLm_V_ovrdval "" VALUE 0x0000 /* @ECU_Address@KINP_OBCDCVoltLm_V_ovrdval@ */ Scalar_FLOAT32_IEEE 0 SWC_INP_type_CM_single_V 0.0 819.0 /end CHARACTERISTIC
/begin CHARACTERISTIC KINP_OBCTemp_C_defval "" VALUE 0x0000 /* @ECU_Address@KINP_OBCTemp_C_defval@ */ Scalar_FLOAT32_IEEE 0 SWC_INP_type_CM_single_C -48.0 105.3 /end CHARACTERISTIC
/begin CHARACTERISTIC KINP_OBCTemp_C_ovrdval "" VALUE 0x0000 /* @ECU_Address@KINP_OBCTemp_C_ovrdval@ */ Scalar_FLOAT32_IEEE 0 SWC_INP_type_CM_single_C -48.0 105.3 /end CHARACTERISTIC
/begin CHARACTERISTIC KINP_ODOMETER_km_defval "" VALUE 0x0000 /* @ECU_Address@KINP_ODOMETER_km_defval@ */ Scalar_FLOAT32_IEEE 0 SWC_INP_type_CM_single_km 0.0 999999.9 /end CHARACTERISTIC
/begin CHARACTERISTIC KINP_ODOMETER_km_ovrdval "" VALUE 0x0000 /* @ECU_Address@KINP_ODOMETER_km_ovrdval@ */ Scalar_FLOAT32_IEEE 0 SWC_INP_type_CM_single_km 0.0 999999.9 /end CHARACTERISTIC
/begin CHARACTERISTIC KINP_RemainChrgTime_min_defval "" VALUE 0x0000 /* @ECU_Address@KINP_RemainChrgTime_min_defval@ */ Scalar_FLOAT32_IEEE 0 SWC_INP_type_CM_single_min 0.0 4094.0 /end CHARACTERISTIC
/begin CHARACTERISTIC KINP_RemainChrgTime_min_ovrdval "" VALUE 0x0000 /* @ECU_Address@KINP_RemainChrgTime_min_ovrdval@ */ Scalar_FLOAT32_IEEE 0 SWC_INP_type_CM_single_min 0.0 4094.0 /end CHARACTERISTIC
/begin CHARACTERISTIC KINP_RrCoolanttempReq_cnt_defval "" VALUE 0x0000 /* @ECU_Address@KINP_RrCoolanttempReq_cnt_defval@ */ Scalar_FLOAT32_IEEE 0 SWC_INP_type_CM_single_cnt -40.0 214.0 /end CHARACTERISTIC
/begin CHARACTERISTIC KINP_RrCoolanttempReq_cnt_ovrdval "" VALUE 0x0000 /* @ECU_Address@KINP_RrCoolanttempReq_cnt_ovrdval@ */ Scalar_FLOAT32_IEEE 0 SWC_INP_type_CM_single_cnt -40.0 214.0 /end CHARACTERISTIC
/begin CHARACTERISTIC KINP_RrEDURealTMTq_Nm_defval "" VALUE 0x0000 /* @ECU_Address@KINP_RrEDURealTMTq_Nm_defval@ */ Scalar_FLOAT32_IEEE 0 SWC_INP_type_CM_single_Nm -1022.0 5531.5 /end CHARACTERISTIC
/begin CHARACTERISTIC KINP_RrEDURealTMTq_Nm_ovrdval "" VALUE 0x0000 /* @ECU_Address@KINP_RrEDURealTMTq_Nm_ovrdval@ */ Scalar_FLOAT32_IEEE 0 SWC_INP_type_CM_single_Nm -1022.0 5531.5 /end CHARACTERISTIC
/begin CHARACTERISTIC KINP_RrEDUTqReqFbk_Nm_defval "" VALUE 0x0000 /* @ECU_Address@KINP_RrEDUTqReqFbk_Nm_defval@ */ Scalar_FLOAT32_IEEE 0 SWC_INP_type_CM_single_Nm -1022.0 1022.0 /end CHARACTERISTIC
/begin CHARACTERISTIC KINP_RrEDUTqReqFbk_Nm_ovrdval "" VALUE 0x0000 /* @ECU_Address@KINP_RrEDUTqReqFbk_Nm_ovrdval@ */ Scalar_FLOAT32_IEEE 0 SWC_INP_type_CM_single_Nm -1022.0 1022.0 /end CHARACTERISTIC
/begin CHARACTERISTIC KINP_RrLLCTemp_C_defval "" VALUE 0x0000 /* @ECU_Address@KINP_RrLLCTemp_C_defval@ */ Scalar_FLOAT32_IEEE 0 SWC_INP_type_CM_single_C -40.0 214.0 /end CHARACTERISTIC
/begin CHARACTERISTIC KINP_RrLLCTemp_C_ovrdval "" VALUE 0x0000 /* @ECU_Address@KINP_RrLLCTemp_C_ovrdval@ */ Scalar_FLOAT32_IEEE 0 SWC_INP_type_CM_single_C -40.0 214.0 /end CHARACTERISTIC
/begin CHARACTERISTIC KINP_RrLLCflowReq_Lpmin_defval "" VALUE 0x0000 /* @ECU_Address@KINP_RrLLCflowReq_Lpmin_defval@ */ Scalar_FLOAT32_IEEE 0 SWC_INP_type_CM_single_Lpmin 0.0 15.5 /end CHARACTERISTIC
/begin CHARACTERISTIC KINP_RrLLCflowReq_Lpmin_ovrdval "" VALUE 0x0000 /* @ECU_Address@KINP_RrLLCflowReq_Lpmin_ovrdval@ */ Scalar_FLOAT32_IEEE 0 SWC_INP_type_CM_single_Lpmin 0.0 15.5 /end CHARACTERISTIC
/begin CHARACTERISTIC KINP_RrMCUBAT_V_defval "" VALUE 0x0000 /* @ECU_Address@KINP_RrMCUBAT_V_defval@ */ Scalar_FLOAT32_IEEE 0 SWC_INP_type_CM_single_V 0.0 25.4 /end CHARACTERISTIC
/begin CHARACTERISTIC KINP_RrMCUBAT_V_ovrdval "" VALUE 0x0000 /* @ECU_Address@KINP_RrMCUBAT_V_ovrdval@ */ Scalar_FLOAT32_IEEE 0 SWC_INP_type_CM_single_V 0.0 25.4 /end CHARACTERISTIC
/begin CHARACTERISTIC KINP_RrMCUDCBusCurr_A_defval "" VALUE 0x0000 /* @ECU_Address@KINP_RrMCUDCBusCurr_A_defval@ */ Scalar_FLOAT32_IEEE 0 SWC_INP_type_CM_single_A -1500.0 1500.0 /end CHARACTERISTIC
/begin CHARACTERISTIC KINP_RrMCUDCBusCurr_A_ovrdval "" VALUE 0x0000 /* @ECU_Address@KINP_RrMCUDCBusCurr_A_ovrdval@ */ Scalar_FLOAT32_IEEE 0 SWC_INP_type_CM_single_A -1500.0 1500.0 /end CHARACTERISTIC
/begin CHARACTERISTIC KINP_RrMCUDCBusVolt_V_defval "" VALUE 0x0000 /* @ECU_Address@KINP_RrMCUDCBusVolt_V_defval@ */ Scalar_FLOAT32_IEEE 0 SWC_INP_type_CM_single_V 0.0 4000.0 /end CHARACTERISTIC
/begin CHARACTERISTIC KINP_RrMCUDCBusVolt_V_ovrdval "" VALUE 0x0000 /* @ECU_Address@KINP_RrMCUDCBusVolt_V_ovrdval@ */ Scalar_FLOAT32_IEEE 0 SWC_INP_type_CM_single_V 0.0 4000.0 /end CHARACTERISTIC
/begin CHARACTERISTIC KINP_RrMCUTemp_C_defval "" VALUE 0x0000 /* @ECU_Address@KINP_RrMCUTemp_C_defval@ */ Scalar_FLOAT32_IEEE 0 SWC_INP_type_CM_single_C -40.0 254.0 /end CHARACTERISTIC
/begin CHARACTERISTIC KINP_RrMCUTemp_C_ovrdval "" VALUE 0x0000 /* @ECU_Address@KINP_RrMCUTemp_C_ovrdval@ */ Scalar_FLOAT32_IEEE 0 SWC_INP_type_CM_single_C -40.0 254.0 /end CHARACTERISTIC
/begin CHARACTERISTIC KINP_RrMotorAvailTq_Nm_defval "" VALUE 0x0000 /* @ECU_Address@KINP_RrMotorAvailTq_Nm_defval@ */ Scalar_FLOAT32_IEEE 0 SWC_INP_type_CM_single_Nm 0.0 1022.0 /end CHARACTERISTIC
/begin CHARACTERISTIC KINP_RrMotorAvailTq_Nm_ovrdval "" VALUE 0x0000 /* @ECU_Address@KINP_RrMotorAvailTq_Nm_ovrdval@ */ Scalar_FLOAT32_IEEE 0 SWC_INP_type_CM_single_Nm 0.0 1022.0 /end CHARACTERISTIC
/begin CHARACTERISTIC KINP_RrRegenAvailTq_Nm_defval "" VALUE 0x0000 /* @ECU_Address@KINP_RrRegenAvailTq_Nm_defval@ */ Scalar_FLOAT32_IEEE 0 SWC_INP_type_CM_single_Nm -1022.0 0.0 /end CHARACTERISTIC
/begin CHARACTERISTIC KINP_RrRegenAvailTq_Nm_ovrdval "" VALUE 0x0000 /* @ECU_Address@KINP_RrRegenAvailTq_Nm_ovrdval@ */ Scalar_FLOAT32_IEEE 0 SWC_INP_type_CM_single_Nm -1022.0 0.0 /end CHARACTERISTIC
/begin CHARACTERISTIC KINP_RrTMSpd_rpm_defval "" VALUE 0x0000 /* @ECU_Address@KINP_RrTMSpd_rpm_defval@ */ Scalar_FLOAT32_IEEE 0 SWC_INP_type_CM_single_rpm -18000.0 18000.0 /end CHARACTERISTIC
/begin CHARACTERISTIC KINP_RrTMSpd_rpm_ovrdval "" VALUE 0x0000 /* @ECU_Address@KINP_RrTMSpd_rpm_ovrdval@ */ Scalar_FLOAT32_IEEE 0 SWC_INP_type_CM_single_rpm -18000.0 18000.0 /end CHARACTERISTIC
/begin CHARACTERISTIC KINP_RrTMTemp_C_defval "" VALUE 0x0000 /* @ECU_Address@KINP_RrTMTemp_C_defval@ */ Scalar_FLOAT32_IEEE 0 SWC_INP_type_CM_single_C -40.0 254.0 /end CHARACTERISTIC
/begin CHARACTERISTIC KINP_RrTMTemp_C_ovrdval "" VALUE 0x0000 /* @ECU_Address@KINP_RrTMTemp_C_ovrdval@ */ Scalar_FLOAT32_IEEE 0 SWC_INP_type_CM_single_C -40.0 254.0 /end CHARACTERISTIC
/begin CHARACTERISTIC KINP_RrTMid_A_defval "" VALUE 0x0000 /* @ECU_Address@KINP_RrTMid_A_defval@ */ Scalar_FLOAT32_IEEE 0 SWC_INP_type_CM_single_A -1500.0 1500.0 /end CHARACTERISTIC
/begin CHARACTERISTIC KINP_RrTMid_A_ovrdval "" VALUE 0x0000 /* @ECU_Address@KINP_RrTMid_A_ovrdval@ */ Scalar_FLOAT32_IEEE 0 SWC_INP_type_CM_single_A -1500.0 1500.0 /end CHARACTERISTIC
/begin CHARACTERISTIC KINP_RrTMiq_A_defval "" VALUE 0x0000 /* @ECU_Address@KINP_RrTMiq_A_defval@ */ Scalar_FLOAT32_IEEE 0 SWC_INP_type_CM_single_A -1500.0 1500.0 /end CHARACTERISTIC
/begin CHARACTERISTIC KINP_RrTMiq_A_ovrdval "" VALUE 0x0000 /* @ECU_Address@KINP_RrTMiq_A_ovrdval@ */ Scalar_FLOAT32_IEEE 0 SWC_INP_type_CM_single_A -1500.0 1500.0 /end CHARACTERISTIC
/begin CHARACTERISTIC KINP_FrMCUHWVer_enum_defval "" VALUE 0x0000 /* @ECU_Address@KINP_FrMCUHWVer_enum_defval@ */ Scalar_UWORD 0 SWC_INP_type_CM_uint16_enum 0.0 65535.0 /end CHARACTERISTIC
/begin CHARACTERISTIC KINP_FrMCUHWVer_enum_ovrdval "" VALUE 0x0000 /* @ECU_Address@KINP_FrMCUHWVer_enum_ovrdval@ */ Scalar_UWORD 0 SWC_INP_type_CM_uint16_enum 0.0 65535.0 /end CHARACTERISTIC
/begin CHARACTERISTIC KINP_FrMCUSWVer_enum_defval "" VALUE 0x0000 /* @ECU_Address@KINP_FrMCUSWVer_enum_defval@ */ Scalar_UWORD 0 SWC_INP_type_CM_uint16_enum 0.0 65535.0 /end CHARACTERISTIC
/begin CHARACTERISTIC KINP_FrMCUSWVer_enum_ovrdval "" VALUE 0x0000 /* @ECU_Address@KINP_FrMCUSWVer_enum_ovrdval@ */ Scalar_UWORD 0 SWC_INP_type_CM_uint16_enum 0.0 65535.0 /end CHARACTERISTIC
/begin CHARACTERISTIC KINP_RrMCU3HWVer_enum_defval "" VALUE 0x0000 /* @ECU_Address@KINP_RrMCU3HWVer_enum_defval@ */ Scalar_UWORD 0 SWC_INP_type_CM_uint16_enum 0.0 65535.0 /end CHARACTERISTIC
/begin CHARACTERISTIC KINP_RrMCU3HWVer_enum_ovrdval "" VALUE 0x0000 /* @ECU_Address@KINP_RrMCU3HWVer_enum_ovrdval@ */ Scalar_UWORD 0 SWC_INP_type_CM_uint16_enum 0.0 65535.0 /end CHARACTERISTIC
/begin CHARACTERISTIC KINP_RrMCU3SWVer_enum_defval "" VALUE 0x0000 /* @ECU_Address@KINP_RrMCU3SWVer_enum_defval@ */ Scalar_UWORD 0 SWC_INP_type_CM_uint16_enum 0.0 65535.0 /end CHARACTERISTIC
/begin CHARACTERISTIC KINP_RrMCU3SWVer_enum_ovrdval "" VALUE 0x0000 /* @ECU_Address@KINP_RrMCU3SWVer_enum_ovrdval@ */ Scalar_UWORD 0 SWC_INP_type_CM_uint16_enum 0.0 65535.0 /end CHARACTERISTIC
/begin CHARACTERISTIC KINP_ACChrgCurrDis_A_ovrdflg "" VALUE 0x0000 /* @ECU_Address@KINP_ACChrgCurrDis_A_ovrdflg@ */ Scalar_BOOLEAN 0 SWC_INP_type_CM_boolean_flg 0.0 1.0 /end CHARACTERISTIC
/begin CHARACTERISTIC KINP_BMS1CSErr_flg_defval "" VALUE 0x0000 /* @ECU_Address@KINP_BMS1CSErr_flg_defval@ */ Scalar_BOOLEAN 0 SWC_INP_type_CM_boolean_flg 0.0 1.0 /end CHARACTERISTIC
/begin CHARACTERISTIC KINP_BMS1CSErr_flg_ovrdflg "" VALUE 0x0000 /* @ECU_Address@KINP_BMS1CSErr_flg_ovrdflg@ */ Scalar_BOOLEAN 0 SWC_INP_type_CM_boolean_flg 0.0 1.0 /end CHARACTERISTIC
/begin CHARACTERISTIC KINP_BMS1CSErr_flg_ovrdval "" VALUE 0x0000 /* @ECU_Address@KINP_BMS1CSErr_flg_ovrdval@ */ Scalar_BOOLEAN 0 SWC_INP_type_CM_boolean_flg 0.0 1.0 /end CHARACTERISTIC
/begin CHARACTERISTIC KINP_BMS1RCErr_flg_defval "" VALUE 0x0000 /* @ECU_Address@KINP_BMS1RCErr_flg_defval@ */ Scalar_BOOLEAN 0 SWC_INP_type_CM_boolean_flg 0.0 1.0 /end CHARACTERISTIC
/begin CHARACTERISTIC KINP_BMS1RCErr_flg_ovrdflg "" VALUE 0x0000 /* @ECU_Address@KINP_BMS1RCErr_flg_ovrdflg@ */ Scalar_BOOLEAN 0 SWC_INP_type_CM_boolean_flg 0.0 1.0 /end CHARACTERISTIC
/begin CHARACTERISTIC KINP_BMS1RCErr_flg_ovrdval "" VALUE 0x0000 /* @ECU_Address@KINP_BMS1RCErr_flg_ovrdval@ */ Scalar_BOOLEAN 0 SWC_INP_type_CM_boolean_flg 0.0 1.0 /end CHARACTERISTIC
/begin CHARACTERISTIC KINP_BMS6CSErr_flg_defval "" VALUE 0x0000 /* @ECU_Address@KINP_BMS6CSErr_flg_defval@ */ Scalar_BOOLEAN 0 SWC_INP_type_CM_boolean_flg 0.0 1.0 /end CHARACTERISTIC
/begin CHARACTERISTIC KINP_BMS6CSErr_flg_ovrdflg "" VALUE 0x0000 /* @ECU_Address@KINP_BMS6CSErr_flg_ovrdflg@ */ Scalar_BOOLEAN 0 SWC_INP_type_CM_boolean_flg 0.0 1.0 /end CHARACTERISTIC
/begin CHARACTERISTIC KINP_BMS6CSErr_flg_ovrdval "" VALUE 0x0000 /* @ECU_Address@KINP_BMS6CSErr_flg_ovrdval@ */ Scalar_BOOLEAN 0 SWC_INP_type_CM_boolean_flg 0.0 1.0 /end CHARACTERISTIC
/begin CHARACTERISTIC KINP_BMS6RCErr_flg_defval "" VALUE 0x0000 /* @ECU_Address@KINP_BMS6RCErr_flg_defval@ */ Scalar_BOOLEAN 0 SWC_INP_type_CM_boolean_flg 0.0 1.0 /end CHARACTERISTIC
/begin CHARACTERISTIC KINP_BMS6RCErr_flg_ovrdflg "" VALUE 0x0000 /* @ECU_Address@KINP_BMS6RCErr_flg_ovrdflg@ */ Scalar_BOOLEAN 0 SWC_INP_type_CM_boolean_flg 0.0 1.0 /end CHARACTERISTIC
/begin CHARACTERISTIC KINP_BMS6RCErr_flg_ovrdval "" VALUE 0x0000 /* @ECU_Address@KINP_BMS6RCErr_flg_ovrdval@ */ Scalar_BOOLEAN 0 SWC_INP_type_CM_boolean_flg 0.0 1.0 /end CHARACTERISTIC
/begin CHARACTERISTIC KINP_BMSChckSum1_enum_ovrdflg "" VALUE 0x0000 /* @ECU_Address@KINP_BMSChckSum1_enum_ovrdflg@ */ Scalar_BOOLEAN 0 SWC_INP_type_CM_boolean_flg 0.0 1.0 /end CHARACTERISTIC
/begin CHARACTERISTIC KINP_BMSChckSum_enum_ovrdflg "" VALUE 0x0000 /* @ECU_Address@KINP_BMSChckSum_enum_ovrdflg@ */ Scalar_BOOLEAN 0 SWC_INP_type_CM_boolean_flg 0.0 1.0 /end CHARACTERISTIC
/begin CHARACTERISTIC KINP_BMSREADY_flg_defval "" VALUE 0x0000 /* @ECU_Address@KINP_BMSREADY_flg_defval@ */ Scalar_BOOLEAN 0 SWC_INP_type_CM_boolean_flg 0.0 1.0 /end CHARACTERISTIC
/begin CHARACTERISTIC KINP_BMSREADY_flg_ovrdflg "" VALUE 0x0000 /* @ECU_Address@KINP_BMSREADY_flg_ovrdflg@ */ Scalar_BOOLEAN 0 SWC_INP_type_CM_boolean_flg 0.0 1.0 /end CHARACTERISTIC
/begin CHARACTERISTIC KINP_BMSREADY_flg_ovrdval "" VALUE 0x0000 /* @ECU_Address@KINP_BMSREADY_flg_ovrdval@ */ Scalar_BOOLEAN 0 SWC_INP_type_CM_boolean_flg 0.0 1.0 /end CHARACTERISTIC
/begin CHARACTERISTIC KINP_BMSRolCnct1_enum_ovrdflg "" VALUE 0x0000 /* @ECU_Address@KINP_BMSRolCnct1_enum_ovrdflg@ */ Scalar_BOOLEAN 0 SWC_INP_type_CM_boolean_flg 0.0 1.0 /end CHARACTERISTIC
/begin CHARACTERISTIC KINP_BMSRolCnct_enum_ovrdflg "" VALUE 0x0000 /* @ECU_Address@KINP_BMSRolCnct_enum_ovrdflg@ */ Scalar_BOOLEAN 0 SWC_INP_type_CM_boolean_flg 0.0 1.0 /end CHARACTERISTIC
/begin CHARACTERISTIC KINP_BMSWarn1_flg_defval "" VALUE 0x0000 /* @ECU_Address@KINP_BMSWarn1_flg_defval@ */ Scalar_BOOLEAN 0 SWC_INP_type_CM_boolean_flg 0.0 1.0 /end CHARACTERISTIC
/begin CHARACTERISTIC KINP_BMSWarn1_flg_ovrdflg "" VALUE 0x0000 /* @ECU_Address@KINP_BMSWarn1_flg_ovrdflg@ */ Scalar_BOOLEAN 0 SWC_INP_type_CM_boolean_flg 0.0 1.0 /end CHARACTERISTIC
/begin CHARACTERISTIC KINP_BMSWarn1_flg_ovrdval "" VALUE 0x0000 /* @ECU_Address@KINP_BMSWarn1_flg_ovrdval@ */ Scalar_BOOLEAN 0 SWC_INP_type_CM_boolean_flg 0.0 1.0 /end CHARACTERISTIC
/begin CHARACTERISTIC KINP_BMSWarn2_flg_defval "" VALUE 0x0000 /* @ECU_Address@KINP_BMSWarn2_flg_defval@ */ Scalar_BOOLEAN 0 SWC_INP_type_CM_boolean_flg 0.0 1.0 /end CHARACTERISTIC
/begin CHARACTERISTIC KINP_BMSWarn2_flg_ovrdflg "" VALUE 0x0000 /* @ECU_Address@KINP_BMSWarn2_flg_ovrdflg@ */ Scalar_BOOLEAN 0 SWC_INP_type_CM_boolean_flg 0.0 1.0 /end CHARACTERISTIC
/begin CHARACTERISTIC KINP_BMSWarn2_flg_ovrdval "" VALUE 0x0000 /* @ECU_Address@KINP_BMSWarn2_flg_ovrdval@ */ Scalar_BOOLEAN 0 SWC_INP_type_CM_boolean_flg 0.0 1.0 /end CHARACTERISTIC
/begin CHARACTERISTIC KINP_BMSWarn3_flg_defval "" VALUE 0x0000 /* @ECU_Address@KINP_BMSWarn3_flg_defval@ */ Scalar_BOOLEAN 0 SWC_INP_type_CM_boolean_flg 0.0 1.0 /end CHARACTERISTIC
/begin CHARACTERISTIC KINP_BMSWarn3_flg_ovrdflg "" VALUE 0x0000 /* @ECU_Address@KINP_BMSWarn3_flg_ovrdflg@ */ Scalar_BOOLEAN 0 SWC_INP_type_CM_boolean_flg 0.0 1.0 /end CHARACTERISTIC
/begin CHARACTERISTIC KINP_BMSWarn3_flg_ovrdval "" VALUE 0x0000 /* @ECU_Address@KINP_BMSWarn3_flg_ovrdval@ */ Scalar_BOOLEAN 0 SWC_INP_type_CM_boolean_flg 0.0 1.0 /end CHARACTERISTIC
/begin CHARACTERISTIC KINP_BMSWarn4_flg_defval "" VALUE 0x0000 /* @ECU_Address@KINP_BMSWarn4_flg_defval@ */ Scalar_BOOLEAN 0 SWC_INP_type_CM_boolean_flg 0.0 1.0 /end CHARACTERISTIC
/begin CHARACTERISTIC KINP_BMSWarn4_flg_ovrdflg "" VALUE 0x0000 /* @ECU_Address@KINP_BMSWarn4_flg_ovrdflg@ */ Scalar_BOOLEAN 0 SWC_INP_type_CM_boolean_flg 0.0 1.0 /end CHARACTERISTIC
/begin CHARACTERISTIC KINP_BMSWarn4_flg_ovrdval "" VALUE 0x0000 /* @ECU_Address@KINP_BMSWarn4_flg_ovrdval@ */ Scalar_BOOLEAN 0 SWC_INP_type_CM_boolean_flg 0.0 1.0 /end CHARACTERISTIC
/begin CHARACTERISTIC KINP_BMSWarn5_flg_defval "" VALUE 0x0000 /* @ECU_Address@KINP_BMSWarn5_flg_defval@ */ Scalar_BOOLEAN 0 SWC_INP_type_CM_boolean_flg 0.0 1.0 /end CHARACTERISTIC
/begin CHARACTERISTIC KINP_BMSWarn5_flg_ovrdflg "" VALUE 0x0000 /* @ECU_Address@KINP_BMSWarn5_flg_ovrdflg@ */ Scalar_BOOLEAN 0 SWC_INP_type_CM_boolean_flg 0.0 1.0 /end CHARACTERISTIC
/begin CHARACTERISTIC KINP_BMSWarn5_flg_ovrdval "" VALUE 0x0000 /* @ECU_Address@KINP_BMSWarn5_flg_ovrdval@ */ Scalar_BOOLEAN 0 SWC_INP_type_CM_boolean_flg 0.0 1.0 /end CHARACTERISTIC
/begin CHARACTERISTIC KINP_BMSWarn6_flg_defval "" VALUE 0x0000 /* @ECU_Address@KINP_BMSWarn6_flg_defval@ */ Scalar_BOOLEAN 0 SWC_INP_type_CM_boolean_flg 0.0 1.0 /end CHARACTERISTIC
/begin CHARACTERISTIC KINP_BMSWarn6_flg_ovrdflg "" VALUE 0x0000 /* @ECU_Address@KINP_BMSWarn6_flg_ovrdflg@ */ Scalar_BOOLEAN 0 SWC_INP_type_CM_boolean_flg 0.0 1.0 /end CHARACTERISTIC
/begin CHARACTERISTIC KINP_BMSWarn6_flg_ovrdval "" VALUE 0x0000 /* @ECU_Address@KINP_BMSWarn6_flg_ovrdval@ */ Scalar_BOOLEAN 0 SWC_INP_type_CM_boolean_flg 0.0 1.0 /end CHARACTERISTIC
/begin CHARACTERISTIC KINP_BMSWarn7_flg_defval "" VALUE 0x0000 /* @ECU_Address@KINP_BMSWarn7_flg_defval@ */ Scalar_BOOLEAN 0 SWC_INP_type_CM_boolean_flg 0.0 1.0 /end CHARACTERISTIC
/begin CHARACTERISTIC KINP_BMSWarn7_flg_ovrdflg "" VALUE 0x0000 /* @ECU_Address@KINP_BMSWarn7_flg_ovrdflg@ */ Scalar_BOOLEAN 0 SWC_INP_type_CM_boolean_flg 0.0 1.0 /end CHARACTERISTIC
/begin CHARACTERISTIC KINP_BMSWarn7_flg_ovrdval "" VALUE 0x0000 /* @ECU_Address@KINP_BMSWarn7_flg_ovrdval@ */ Scalar_BOOLEAN 0 SWC_INP_type_CM_boolean_flg 0.0 1.0 /end CHARACTERISTIC
/begin CHARACTERISTIC KINP_BMSWarn8_flg_defval "" VALUE 0x0000 /* @ECU_Address@KINP_BMSWarn8_flg_defval@ */ Scalar_BOOLEAN 0 SWC_INP_type_CM_boolean_flg 0.0 1.0 /end CHARACTERISTIC
/begin CHARACTERISTIC KINP_BMSWarn8_flg_ovrdflg "" VALUE 0x0000 /* @ECU_Address@KINP_BMSWarn8_flg_ovrdflg@ */ Scalar_BOOLEAN 0 SWC_INP_type_CM_boolean_flg 0.0 1.0 /end CHARACTERISTIC
/begin CHARACTERISTIC KINP_BMSWarn8_flg_ovrdval "" VALUE 0x0000 /* @ECU_Address@KINP_BMSWarn8_flg_ovrdval@ */ Scalar_BOOLEAN 0 SWC_INP_type_CM_boolean_flg 0.0 1.0 /end CHARACTERISTIC
/begin CHARACTERISTIC KINP_CCU1CSErr_flg_defval "" VALUE 0x0000 /* @ECU_Address@KINP_CCU1CSErr_flg_defval@ */ Scalar_BOOLEAN 0 SWC_INP_type_CM_boolean_flg 0.0 1.0 /end CHARACTERISTIC
/begin CHARACTERISTIC KINP_CCU1CSErr_flg_ovrdflg "" VALUE 0x0000 /* @ECU_Address@KINP_CCU1CSErr_flg_ovrdflg@ */ Scalar_BOOLEAN 0 SWC_INP_type_CM_boolean_flg 0.0 1.0 /end CHARACTERISTIC
/begin CHARACTERISTIC KINP_CCU1CSErr_flg_ovrdval "" VALUE 0x0000 /* @ECU_Address@KINP_CCU1CSErr_flg_ovrdval@ */ Scalar_BOOLEAN 0 SWC_INP_type_CM_boolean_flg 0.0 1.0 /end CHARACTERISTIC
/begin CHARACTERISTIC KINP_CCU1RCErr_flg_defval "" VALUE 0x0000 /* @ECU_Address@KINP_CCU1RCErr_flg_defval@ */ Scalar_BOOLEAN 0 SWC_INP_type_CM_boolean_flg 0.0 1.0 /end CHARACTERISTIC
/begin CHARACTERISTIC KINP_CCU1RCErr_flg_ovrdflg "" VALUE 0x0000 /* @ECU_Address@KINP_CCU1RCErr_flg_ovrdflg@ */ Scalar_BOOLEAN 0 SWC_INP_type_CM_boolean_flg 0.0 1.0 /end CHARACTERISTIC
/begin CHARACTERISTIC KINP_CCU1RCErr_flg_ovrdval "" VALUE 0x0000 /* @ECU_Address@KINP_CCU1RCErr_flg_ovrdval@ */ Scalar_BOOLEAN 0 SWC_INP_type_CM_boolean_flg 0.0 1.0 /end CHARACTERISTIC
/begin CHARACTERISTIC KINP_CCU2CSErr_flg_defval "" VALUE 0x0000 /* @ECU_Address@KINP_CCU2CSErr_flg_defval@ */ Scalar_BOOLEAN 0 SWC_INP_type_CM_boolean_flg 0.0 1.0 /end CHARACTERISTIC
/begin CHARACTERISTIC KINP_CCU2CSErr_flg_ovrdflg "" VALUE 0x0000 /* @ECU_Address@KINP_CCU2CSErr_flg_ovrdflg@ */ Scalar_BOOLEAN 0 SWC_INP_type_CM_boolean_flg 0.0 1.0 /end CHARACTERISTIC
/begin CHARACTERISTIC KINP_CCU2CSErr_flg_ovrdval "" VALUE 0x0000 /* @ECU_Address@KINP_CCU2CSErr_flg_ovrdval@ */ Scalar_BOOLEAN 0 SWC_INP_type_CM_boolean_flg 0.0 1.0 /end CHARACTERISTIC
/begin CHARACTERISTIC KINP_CCU2RCErr_flg_defval "" VALUE 0x0000 /* @ECU_Address@KINP_CCU2RCErr_flg_defval@ */ Scalar_BOOLEAN 0 SWC_INP_type_CM_boolean_flg 0.0 1.0 /end CHARACTERISTIC
/begin CHARACTERISTIC KINP_CCU2RCErr_flg_ovrdflg "" VALUE 0x0000 /* @ECU_Address@KINP_CCU2RCErr_flg_ovrdflg@ */ Scalar_BOOLEAN 0 SWC_INP_type_CM_boolean_flg 0.0 1.0 /end CHARACTERISTIC
/begin CHARACTERISTIC KINP_CCU2RCErr_flg_ovrdval "" VALUE 0x0000 /* @ECU_Address@KINP_CCU2RCErr_flg_ovrdval@ */ Scalar_BOOLEAN 0 SWC_INP_type_CM_boolean_flg 0.0 1.0 /end CHARACTERISTIC
/begin CHARACTERISTIC KINP_CSCCU1_enum_ovrdflg "" VALUE 0x0000 /* @ECU_Address@KINP_CSCCU1_enum_ovrdflg@ */ Scalar_BOOLEAN 0 SWC_INP_type_CM_boolean_flg 0.0 1.0 /end CHARACTERISTIC
/begin CHARACTERISTIC KINP_CSCCU2_enum_ovrdflg "" VALUE 0x0000 /* @ECU_Address@KINP_CSCCU2_enum_ovrdflg@ */ Scalar_BOOLEAN 0 SWC_INP_type_CM_boolean_flg 0.0 1.0 /end CHARACTERISTIC
/begin CHARACTERISTIC KINP_CellTempAvg_C_ovrdflg "" VALUE 0x0000 /* @ECU_Address@KINP_CellTempAvg_C_ovrdflg@ */ Scalar_BOOLEAN 0 SWC_INP_type_CM_boolean_flg 0.0 1.0 /end CHARACTERISTIC
/begin CHARACTERISTIC KINP_ChrgInLockReq_enum_ovrdflg "" VALUE 0x0000 /* @ECU_Address@KINP_ChrgInLockReq_enum_ovrdflg@ */ Scalar_BOOLEAN 0 SWC_INP_type_CM_boolean_flg 0.0 1.0 /end CHARACTERISTIC
/begin CHARACTERISTIC KINP_ChrgPlugSta_enum_ovrdflg "" VALUE 0x0000 /* @ECU_Address@KINP_ChrgPlugSta_enum_ovrdflg@ */ Scalar_BOOLEAN 0 SWC_INP_type_CM_boolean_flg 0.0 1.0 /end CHARACTERISTIC
/begin CHARACTERISTIC KINP_DCDCAuxCur_A_ovrdflg "" VALUE 0x0000 /* @ECU_Address@KINP_DCDCAuxCur_A_ovrdflg@ */ Scalar_BOOLEAN 0 SWC_INP_type_CM_boolean_flg 0.0 1.0 /end CHARACTERISTIC
/begin CHARACTERISTIC KINP_DCDCAuxVolt_V_ovrdflg "" VALUE 0x0000 /* @ECU_Address@KINP_DCDCAuxVolt_V_ovrdflg@ */ Scalar_BOOLEAN 0 SWC_INP_type_CM_boolean_flg 0.0 1.0 /end CHARACTERISTIC
/begin CHARACTERISTIC KINP_DCDCEnaSta_flg_defval "" VALUE 0x0000 /* @ECU_Address@KINP_DCDCEnaSta_flg_defval@ */ Scalar_BOOLEAN 0 SWC_INP_type_CM_boolean_flg 0.0 1.0 /end CHARACTERISTIC
/begin CHARACTERISTIC KINP_DCDCEnaSta_flg_ovrdflg "" VALUE 0x0000 /* @ECU_Address@KINP_DCDCEnaSta_flg_ovrdflg@ */ Scalar_BOOLEAN 0 SWC_INP_type_CM_boolean_flg 0.0 1.0 /end CHARACTERISTIC
/begin CHARACTERISTIC KINP_DCDCEnaSta_flg_ovrdval "" VALUE 0x0000 /* @ECU_Address@KINP_DCDCEnaSta_flg_ovrdval@ */ Scalar_BOOLEAN 0 SWC_INP_type_CM_boolean_flg 0.0 1.0 /end CHARACTERISTIC
/begin CHARACTERISTIC KINP_DCDCFaultSta_enum_ovrdflg "" VALUE 0x0000 /* @ECU_Address@KINP_DCDCFaultSta_enum_ovrdflg@ */ Scalar_BOOLEAN 0 SWC_INP_type_CM_boolean_flg 0.0 1.0 /end CHARACTERISTIC
/begin CHARACTERISTIC KINP_DCDCHVCur_A_ovrdflg "" VALUE 0x0000 /* @ECU_Address@KINP_DCDCHVCur_A_ovrdflg@ */ Scalar_BOOLEAN 0 SWC_INP_type_CM_boolean_flg 0.0 1.0 /end CHARACTERISTIC
/begin CHARACTERISTIC KINP_DCDCInVoltInf_V_ovrdflg "" VALUE 0x0000 /* @ECU_Address@KINP_DCDCInVoltInf_V_ovrdflg@ */ Scalar_BOOLEAN 0 SWC_INP_type_CM_boolean_flg 0.0 1.0 /end CHARACTERISTIC
/begin CHARACTERISTIC KINP_DCDCPreCompleted_enum_ovrdflg "" VALUE 0x0000 /* @ECU_Address@KINP_DCDCPreCompleted_enum_ovrdflg@ */ Scalar_BOOLEAN 0 SWC_INP_type_CM_boolean_flg 0.0 1.0 /end CHARACTERISTIC
/begin CHARACTERISTIC KINP_DCDCReady4Pre_flg_defval "" VALUE 0x0000 /* @ECU_Address@KINP_DCDCReady4Pre_flg_defval@ */ Scalar_BOOLEAN 0 SWC_INP_type_CM_boolean_flg 0.0 1.0 /end CHARACTERISTIC
/begin CHARACTERISTIC KINP_DCDCReady4Pre_flg_ovrdflg "" VALUE 0x0000 /* @ECU_Address@KINP_DCDCReady4Pre_flg_ovrdflg@ */ Scalar_BOOLEAN 0 SWC_INP_type_CM_boolean_flg 0.0 1.0 /end CHARACTERISTIC
/begin CHARACTERISTIC KINP_DCDCReady4Pre_flg_ovrdval "" VALUE 0x0000 /* @ECU_Address@KINP_DCDCReady4Pre_flg_ovrdval@ */ Scalar_BOOLEAN 0 SWC_INP_type_CM_boolean_flg 0.0 1.0 /end CHARACTERISTIC
/begin CHARACTERISTIC KINP_DCDCTemp_C_ovrdflg "" VALUE 0x0000 /* @ECU_Address@KINP_DCDCTemp_C_ovrdflg@ */ Scalar_BOOLEAN 0 SWC_INP_type_CM_boolean_flg 0.0 1.0 /end CHARACTERISTIC
/begin CHARACTERISTIC KINP_DisChrgPlugErr_enum_ovrdflg "" VALUE 0x0000 /* @ECU_Address@KINP_DisChrgPlugErr_enum_ovrdflg@ */ Scalar_BOOLEAN 0 SWC_INP_type_CM_boolean_flg 0.0 1.0 /end CHARACTERISTIC
/begin CHARACTERISTIC KINP_EBMErrSta_enum_ovrdflg "" VALUE 0x0000 /* @ECU_Address@KINP_EBMErrSta_enum_ovrdflg@ */ Scalar_BOOLEAN 0 SWC_INP_type_CM_boolean_flg 0.0 1.0 /end CHARACTERISTIC
/begin CHARACTERISTIC KINP_EBMRLampSta_enum_ovrdflg "" VALUE 0x0000 /* @ECU_Address@KINP_EBMRLampSta_enum_ovrdflg@ */ Scalar_BOOLEAN 0 SWC_INP_type_CM_boolean_flg 0.0 1.0 /end CHARACTERISTIC
/begin CHARACTERISTIC KINP_ExtChrgSta_enum_ovrdflg "" VALUE 0x0000 /* @ECU_Address@KINP_ExtChrgSta_enum_ovrdflg@ */ Scalar_BOOLEAN 0 SWC_INP_type_CM_boolean_flg 0.0 1.0 /end CHARACTERISTIC
/begin CHARACTERISTIC KINP_FireDetErr_flg_defval "" VALUE 0x0000 /* @ECU_Address@KINP_FireDetErr_flg_defval@ */ Scalar_BOOLEAN 0 SWC_INP_type_CM_boolean_flg 0.0 1.0 /end CHARACTERISTIC
/begin CHARACTERISTIC KINP_FireDetErr_flg_ovrdflg "" VALUE 0x0000 /* @ECU_Address@KINP_FireDetErr_flg_ovrdflg@ */ Scalar_BOOLEAN 0 SWC_INP_type_CM_boolean_flg 0.0 1.0 /end CHARACTERISTIC
/begin CHARACTERISTIC KINP_FireDetErr_flg_ovrdval "" VALUE 0x0000 /* @ECU_Address@KINP_FireDetErr_flg_ovrdval@ */ Scalar_BOOLEAN 0 SWC_INP_type_CM_boolean_flg 0.0 1.0 /end CHARACTERISTIC
/begin CHARACTERISTIC KINP_FrActvDmpDisabStaNidec_flg_defval "" VALUE 0x0000 /* @ECU_Address@KINP_FrActvDmpDisabStaNidec_flg_defval@ */ Scalar_BOOLEAN 0 SWC_INP_type_CM_boolean_flg 0.0 1.0 /end CHARACTERISTIC
/begin CHARACTERISTIC KINP_FrActvDmpDisabStaNidec_flg_ovrdflg "" VALUE 0x0000 /* @ECU_Address@KINP_FrActvDmpDisabStaNidec_flg_ovrdflg@ */ Scalar_BOOLEAN 0 SWC_INP_type_CM_boolean_flg 0.0 1.0 /end CHARACTERISTIC
/begin CHARACTERISTIC KINP_FrActvDmpDisabStaNidec_flg_ovrdval "" VALUE 0x0000 /* @ECU_Address@KINP_FrActvDmpDisabStaNidec_flg_ovrdval@ */ Scalar_BOOLEAN 0 SWC_INP_type_CM_boolean_flg 0.0 1.0 /end CHARACTERISTIC
/begin CHARACTERISTIC KINP_FrActvDmpDisabSta_flg_defval "" VALUE 0x0000 /* @ECU_Address@KINP_FrActvDmpDisabSta_flg_defval@ */ Scalar_BOOLEAN 0 SWC_INP_type_CM_boolean_flg 0.0 1.0 /end CHARACTERISTIC
/begin CHARACTERISTIC KINP_FrActvDmpDisabSta_flg_ovrdflg "" VALUE 0x0000 /* @ECU_Address@KINP_FrActvDmpDisabSta_flg_ovrdflg@ */ Scalar_BOOLEAN 0 SWC_INP_type_CM_boolean_flg 0.0 1.0 /end CHARACTERISTIC
/begin CHARACTERISTIC KINP_FrActvDmpDisabSta_flg_ovrdval "" VALUE 0x0000 /* @ECU_Address@KINP_FrActvDmpDisabSta_flg_ovrdval@ */ Scalar_BOOLEAN 0 SWC_INP_type_CM_boolean_flg 0.0 1.0 /end CHARACTERISTIC
/begin CHARACTERISTIC KINP_FrCoolanttempReqNidec_C_ovrdflg "" VALUE 0x0000 /* @ECU_Address@KINP_FrCoolanttempReqNidec_C_ovrdflg@ */ Scalar_BOOLEAN 0 SWC_INP_type_CM_boolean_flg 0.0 1.0 /end CHARACTERISTIC
/begin CHARACTERISTIC KINP_FrCoolanttempReq_C_ovrdflg "" VALUE 0x0000 /* @ECU_Address@KINP_FrCoolanttempReq_C_ovrdflg@ */ Scalar_BOOLEAN 0 SWC_INP_type_CM_boolean_flg 0.0 1.0 /end CHARACTERISTIC
/begin CHARACTERISTIC KINP_FrEDUDrtStaNidec_flg_defval "" VALUE 0x0000 /* @ECU_Address@KINP_FrEDUDrtStaNidec_flg_defval@ */ Scalar_BOOLEAN 0 SWC_INP_type_CM_boolean_flg 0.0 1.0 /end CHARACTERISTIC
/begin CHARACTERISTIC KINP_FrEDUDrtStaNidec_flg_ovrdflg "" VALUE 0x0000 /* @ECU_Address@KINP_FrEDUDrtStaNidec_flg_ovrdflg@ */ Scalar_BOOLEAN 0 SWC_INP_type_CM_boolean_flg 0.0 1.0 /end CHARACTERISTIC
/begin CHARACTERISTIC KINP_FrEDUDrtStaNidec_flg_ovrdval "" VALUE 0x0000 /* @ECU_Address@KINP_FrEDUDrtStaNidec_flg_ovrdval@ */ Scalar_BOOLEAN 0 SWC_INP_type_CM_boolean_flg 0.0 1.0 /end CHARACTERISTIC
/begin CHARACTERISTIC KINP_FrEDUDrtSta_flg_defval "" VALUE 0x0000 /* @ECU_Address@KINP_FrEDUDrtSta_flg_defval@ */ Scalar_BOOLEAN 0 SWC_INP_type_CM_boolean_flg 0.0 1.0 /end CHARACTERISTIC
/begin CHARACTERISTIC KINP_FrEDUDrtSta_flg_ovrdflg "" VALUE 0x0000 /* @ECU_Address@KINP_FrEDUDrtSta_flg_ovrdflg@ */ Scalar_BOOLEAN 0 SWC_INP_type_CM_boolean_flg 0.0 1.0 /end CHARACTERISTIC
/begin CHARACTERISTIC KINP_FrEDUDrtSta_flg_ovrdval "" VALUE 0x0000 /* @ECU_Address@KINP_FrEDUDrtSta_flg_ovrdval@ */ Scalar_BOOLEAN 0 SWC_INP_type_CM_boolean_flg 0.0 1.0 /end CHARACTERISTIC
/begin CHARACTERISTIC KINP_FrEDUOpratingStaNidec_flg_defval "" VALUE 0x0000 /* @ECU_Address@KINP_FrEDUOpratingStaNidec_flg_defval@ */ Scalar_BOOLEAN 0 SWC_INP_type_CM_boolean_flg 0.0 1.0 /end CHARACTERISTIC
/begin CHARACTERISTIC KINP_FrEDUOpratingStaNidec_flg_ovrdflg "" VALUE 0x0000 /* @ECU_Address@KINP_FrEDUOpratingStaNidec_flg_ovrdflg@ */ Scalar_BOOLEAN 0 SWC_INP_type_CM_boolean_flg 0.0 1.0 /end CHARACTERISTIC
/begin CHARACTERISTIC KINP_FrEDUOpratingStaNidec_flg_ovrdval "" VALUE 0x0000 /* @ECU_Address@KINP_FrEDUOpratingStaNidec_flg_ovrdval@ */ Scalar_BOOLEAN 0 SWC_INP_type_CM_boolean_flg 0.0 1.0 /end CHARACTERISTIC
/begin CHARACTERISTIC KINP_FrEDUOpratingSta_flg_defval "" VALUE 0x0000 /* @ECU_Address@KINP_FrEDUOpratingSta_flg_defval@ */ Scalar_BOOLEAN 0 SWC_INP_type_CM_boolean_flg 0.0 1.0 /end CHARACTERISTIC
/begin CHARACTERISTIC KINP_FrEDUOpratingSta_flg_ovrdflg "" VALUE 0x0000 /* @ECU_Address@KINP_FrEDUOpratingSta_flg_ovrdflg@ */ Scalar_BOOLEAN 0 SWC_INP_type_CM_boolean_flg 0.0 1.0 /end CHARACTERISTIC
/begin CHARACTERISTIC KINP_FrEDUOpratingSta_flg_ovrdval "" VALUE 0x0000 /* @ECU_Address@KINP_FrEDUOpratingSta_flg_ovrdval@ */ Scalar_BOOLEAN 0 SWC_INP_type_CM_boolean_flg 0.0 1.0 /end CHARACTERISTIC
/begin CHARACTERISTIC KINP_FrEDURealTMTqNidec_Nm_ovrdflg "" VALUE 0x0000 /* @ECU_Address@KINP_FrEDURealTMTqNidec_Nm_ovrdflg@ */ Scalar_BOOLEAN 0 SWC_INP_type_CM_boolean_flg 0.0 1.0 /end CHARACTERISTIC
/begin CHARACTERISTIC KINP_FrEDURealTMTq_Nm_ovrdflg "" VALUE 0x0000 /* @ECU_Address@KINP_FrEDURealTMTq_Nm_ovrdflg@ */ Scalar_BOOLEAN 0 SWC_INP_type_CM_boolean_flg 0.0 1.0 /end CHARACTERISTIC
/begin CHARACTERISTIC KINP_FrEDURotateDirctionNidec_enum_ovrdflg "" VALUE 0x0000 /* @ECU_Address@KINP_FrEDURotateDirctionNidec_enum_ovrdflg@ */ Scalar_BOOLEAN 0 SWC_INP_type_CM_boolean_flg 0.0 1.0 /end CHARACTERISTIC
/begin CHARACTERISTIC KINP_FrEDURotateDirction_enum_ovrdflg "" VALUE 0x0000 /* @ECU_Address@KINP_FrEDURotateDirction_enum_ovrdflg@ */ Scalar_BOOLEAN 0 SWC_INP_type_CM_boolean_flg 0.0 1.0 /end CHARACTERISTIC
/begin CHARACTERISTIC KINP_FrEDUTqReqFbkNidec_Nm_ovrdflg "" VALUE 0x0000 /* @ECU_Address@KINP_FrEDUTqReqFbkNidec_Nm_ovrdflg@ */ Scalar_BOOLEAN 0 SWC_INP_type_CM_boolean_flg 0.0 1.0 /end CHARACTERISTIC
/begin CHARACTERISTIC KINP_FrEDUTqReqFbk_Nm_ovrdflg "" VALUE 0x0000 /* @ECU_Address@KINP_FrEDUTqReqFbk_Nm_ovrdflg@ */ Scalar_BOOLEAN 0 SWC_INP_type_CM_boolean_flg 0.0 1.0 /end CHARACTERISTIC
/begin CHARACTERISTIC KINP_FrEOPSpdSetNidec_rpm_ovrdflg "" VALUE 0x0000 /* @ECU_Address@KINP_FrEOPSpdSetNidec_rpm_ovrdflg@ */ Scalar_BOOLEAN 0 SWC_INP_type_CM_boolean_flg 0.0 1.0 /end CHARACTERISTIC
/begin CHARACTERISTIC KINP_FrFailcode1Nidec_enum_ovrdflg "" VALUE 0x0000 /* @ECU_Address@KINP_FrFailcode1Nidec_enum_ovrdflg@ */ Scalar_BOOLEAN 0 SWC_INP_type_CM_boolean_flg 0.0 1.0 /end CHARACTERISTIC
/begin CHARACTERISTIC KINP_FrFailcode1_enum_ovrdflg "" VALUE 0x0000 /* @ECU_Address@KINP_FrFailcode1_enum_ovrdflg@ */ Scalar_BOOLEAN 0 SWC_INP_type_CM_boolean_flg 0.0 1.0 /end CHARACTERISTIC
/begin CHARACTERISTIC KINP_FrFailcode2Nidec_enum_ovrdflg "" VALUE 0x0000 /* @ECU_Address@KINP_FrFailcode2Nidec_enum_ovrdflg@ */ Scalar_BOOLEAN 0 SWC_INP_type_CM_boolean_flg 0.0 1.0 /end CHARACTERISTIC
/begin CHARACTERISTIC KINP_FrFailcode2_enum_ovrdflg "" VALUE 0x0000 /* @ECU_Address@KINP_FrFailcode2_enum_ovrdflg@ */ Scalar_BOOLEAN 0 SWC_INP_type_CM_boolean_flg 0.0 1.0 /end CHARACTERISTIC
/begin CHARACTERISTIC KINP_FrFailcodehistory1Nidec_enum_ovrdflg "" VALUE 0x0000 /* @ECU_Address@KINP_FrFailcodehistory1Nidec_enum_ovrdflg@ */ Scalar_BOOLEAN 0 SWC_INP_type_CM_boolean_flg 0.0 1.0 /end CHARACTERISTIC
/begin CHARACTERISTIC KINP_FrFailcodehistory1_enum_ovrdflg "" VALUE 0x0000 /* @ECU_Address@KINP_FrFailcodehistory1_enum_ovrdflg@ */ Scalar_BOOLEAN 0 SWC_INP_type_CM_boolean_flg 0.0 1.0 /end CHARACTERISTIC
/begin CHARACTERISTIC KINP_FrFailcodehistory2_enum_ovrdflg "" VALUE 0x0000 /* @ECU_Address@KINP_FrFailcodehistory2_enum_ovrdflg@ */ Scalar_BOOLEAN 0 SWC_INP_type_CM_boolean_flg 0.0 1.0 /end CHARACTERISTIC
/begin CHARACTERISTIC KINP_FrLLCTemp_C_ovrdflg "" VALUE 0x0000 /* @ECU_Address@KINP_FrLLCTemp_C_ovrdflg@ */ Scalar_BOOLEAN 0 SWC_INP_type_CM_boolean_flg 0.0 1.0 /end CHARACTERISTIC
/begin CHARACTERISTIC KINP_FrLLCflowReq_Lpmin_ovrdflg "" VALUE 0x0000 /* @ECU_Address@KINP_FrLLCflowReq_Lpmin_ovrdflg@ */ Scalar_BOOLEAN 0 SWC_INP_type_CM_boolean_flg 0.0 1.0 /end CHARACTERISTIC
/begin CHARACTERISTIC KINP_FrMCU1ChksumNidec_enum_ovrdflg "" VALUE 0x0000 /* @ECU_Address@KINP_FrMCU1ChksumNidec_enum_ovrdflg@ */ Scalar_BOOLEAN 0 SWC_INP_type_CM_boolean_flg 0.0 1.0 /end CHARACTERISTIC
/begin CHARACTERISTIC KINP_FrMCU1Chksum_enum_ovrdflg "" VALUE 0x0000 /* @ECU_Address@KINP_FrMCU1Chksum_enum_ovrdflg@ */ Scalar_BOOLEAN 0 SWC_INP_type_CM_boolean_flg 0.0 1.0 /end CHARACTERISTIC
/begin CHARACTERISTIC KINP_FrMCU1RolCntNidec_enum_ovrdflg "" VALUE 0x0000 /* @ECU_Address@KINP_FrMCU1RolCntNidec_enum_ovrdflg@ */ Scalar_BOOLEAN 0 SWC_INP_type_CM_boolean_flg 0.0 1.0 /end CHARACTERISTIC
/begin CHARACTERISTIC KINP_FrMCU1RolCnt_enum_ovrdflg "" VALUE 0x0000 /* @ECU_Address@KINP_FrMCU1RolCnt_enum_ovrdflg@ */ Scalar_BOOLEAN 0 SWC_INP_type_CM_boolean_flg 0.0 1.0 /end CHARACTERISTIC
/begin CHARACTERISTIC KINP_FrMCUBATNidec_V_ovrdflg "" VALUE 0x0000 /* @ECU_Address@KINP_FrMCUBATNidec_V_ovrdflg@ */ Scalar_BOOLEAN 0 SWC_INP_type_CM_boolean_flg 0.0 1.0 /end CHARACTERISTIC
/begin CHARACTERISTIC KINP_FrMCUBAT_V_ovrdflg "" VALUE 0x0000 /* @ECU_Address@KINP_FrMCUBAT_V_ovrdflg@ */ Scalar_BOOLEAN 0 SWC_INP_type_CM_boolean_flg 0.0 1.0 /end CHARACTERISTIC
/begin CHARACTERISTIC KINP_FrMCUDCBusCurrNidec_A_ovrdflg "" VALUE 0x0000 /* @ECU_Address@KINP_FrMCUDCBusCurrNidec_A_ovrdflg@ */ Scalar_BOOLEAN 0 SWC_INP_type_CM_boolean_flg 0.0 1.0 /end CHARACTERISTIC
/begin CHARACTERISTIC KINP_FrMCUDCBusCurr_A_ovrdflg "" VALUE 0x0000 /* @ECU_Address@KINP_FrMCUDCBusCurr_A_ovrdflg@ */ Scalar_BOOLEAN 0 SWC_INP_type_CM_boolean_flg 0.0 1.0 /end CHARACTERISTIC
/begin CHARACTERISTIC KINP_FrMCUDCBusVoltNidec_V_ovrdflg "" VALUE 0x0000 /* @ECU_Address@KINP_FrMCUDCBusVoltNidec_V_ovrdflg@ */ Scalar_BOOLEAN 0 SWC_INP_type_CM_boolean_flg 0.0 1.0 /end CHARACTERISTIC
/begin CHARACTERISTIC KINP_FrMCUDCBusVolt_V_ovrdflg "" VALUE 0x0000 /* @ECU_Address@KINP_FrMCUDCBusVolt_V_ovrdflg@ */ Scalar_BOOLEAN 0 SWC_INP_type_CM_boolean_flg 0.0 1.0 /end CHARACTERISTIC
/begin CHARACTERISTIC KINP_FrMCUDischrgStaNidec_flg_defval "" VALUE 0x0000 /* @ECU_Address@KINP_FrMCUDischrgStaNidec_flg_defval@ */ Scalar_BOOLEAN 0 SWC_INP_type_CM_boolean_flg 0.0 1.0 /end CHARACTERISTIC
/begin CHARACTERISTIC KINP_FrMCUDischrgStaNidec_flg_ovrdflg "" VALUE 0x0000 /* @ECU_Address@KINP_FrMCUDischrgStaNidec_flg_ovrdflg@ */ Scalar_BOOLEAN 0 SWC_INP_type_CM_boolean_flg 0.0 1.0 /end CHARACTERISTIC
/begin CHARACTERISTIC KINP_FrMCUDischrgStaNidec_flg_ovrdval "" VALUE 0x0000 /* @ECU_Address@KINP_FrMCUDischrgStaNidec_flg_ovrdval@ */ Scalar_BOOLEAN 0 SWC_INP_type_CM_boolean_flg 0.0 1.0 /end CHARACTERISTIC
/begin CHARACTERISTIC KINP_FrMCUDischrgSta_flg_defval "" VALUE 0x0000 /* @ECU_Address@KINP_FrMCUDischrgSta_flg_defval@ */ Scalar_BOOLEAN 0 SWC_INP_type_CM_boolean_flg 0.0 1.0 /end CHARACTERISTIC
/begin CHARACTERISTIC KINP_FrMCUDischrgSta_flg_ovrdflg "" VALUE 0x0000 /* @ECU_Address@KINP_FrMCUDischrgSta_flg_ovrdflg@ */ Scalar_BOOLEAN 0 SWC_INP_type_CM_boolean_flg 0.0 1.0 /end CHARACTERISTIC
/begin CHARACTERISTIC KINP_FrMCUDischrgSta_flg_ovrdval "" VALUE 0x0000 /* @ECU_Address@KINP_FrMCUDischrgSta_flg_ovrdval@ */ Scalar_BOOLEAN 0 SWC_INP_type_CM_boolean_flg 0.0 1.0 /end CHARACTERISTIC
/begin CHARACTERISTIC KINP_FrMCUEnaStaNidec_flg_defval "" VALUE 0x0000 /* @ECU_Address@KINP_FrMCUEnaStaNidec_flg_defval@ */ Scalar_BOOLEAN 0 SWC_INP_type_CM_boolean_flg 0.0 1.0 /end CHARACTERISTIC
/begin CHARACTERISTIC KINP_FrMCUEnaStaNidec_flg_ovrdflg "" VALUE 0x0000 /* @ECU_Address@KINP_FrMCUEnaStaNidec_flg_ovrdflg@ */ Scalar_BOOLEAN 0 SWC_INP_type_CM_boolean_flg 0.0 1.0 /end CHARACTERISTIC
/begin CHARACTERISTIC KINP_FrMCUEnaStaNidec_flg_ovrdval "" VALUE 0x0000 /* @ECU_Address@KINP_FrMCUEnaStaNidec_flg_ovrdval@ */ Scalar_BOOLEAN 0 SWC_INP_type_CM_boolean_flg 0.0 1.0 /end CHARACTERISTIC
/begin CHARACTERISTIC KINP_FrMCUEnaSta_flg_defval "" VALUE 0x0000 /* @ECU_Address@KINP_FrMCUEnaSta_flg_defval@ */ Scalar_BOOLEAN 0 SWC_INP_type_CM_boolean_flg 0.0 1.0 /end CHARACTERISTIC
/begin CHARACTERISTIC KINP_FrMCUEnaSta_flg_ovrdflg "" VALUE 0x0000 /* @ECU_Address@KINP_FrMCUEnaSta_flg_ovrdflg@ */ Scalar_BOOLEAN 0 SWC_INP_type_CM_boolean_flg 0.0 1.0 /end CHARACTERISTIC
/begin CHARACTERISTIC KINP_FrMCUEnaSta_flg_ovrdval "" VALUE 0x0000 /* @ECU_Address@KINP_FrMCUEnaSta_flg_ovrdval@ */ Scalar_BOOLEAN 0 SWC_INP_type_CM_boolean_flg 0.0 1.0 /end CHARACTERISTIC
/begin CHARACTERISTIC KINP_FrMCUErrNidec_enum_ovrdflg "" VALUE 0x0000 /* @ECU_Address@KINP_FrMCUErrNidec_enum_ovrdflg@ */ Scalar_BOOLEAN 0 SWC_INP_type_CM_boolean_flg 0.0 1.0 /end CHARACTERISTIC
/begin CHARACTERISTIC KINP_FrMCUErr_enum_ovrdflg "" VALUE 0x0000 /* @ECU_Address@KINP_FrMCUErr_enum_ovrdflg@ */ Scalar_BOOLEAN 0 SWC_INP_type_CM_boolean_flg 0.0 1.0 /end CHARACTERISTIC
/begin CHARACTERISTIC KINP_FrMCUHWVer_enum_ovrdflg "" VALUE 0x0000 /* @ECU_Address@KINP_FrMCUHWVer_enum_ovrdflg@ */ Scalar_BOOLEAN 0 SWC_INP_type_CM_boolean_flg 0.0 1.0 /end CHARACTERISTIC
/begin CHARACTERISTIC KINP_FrMCUIGNstaNidec_flg_defval "" VALUE 0x0000 /* @ECU_Address@KINP_FrMCUIGNstaNidec_flg_defval@ */ Scalar_BOOLEAN 0 SWC_INP_type_CM_boolean_flg 0.0 1.0 /end CHARACTERISTIC
/begin CHARACTERISTIC KINP_FrMCUIGNstaNidec_flg_ovrdflg "" VALUE 0x0000 /* @ECU_Address@KINP_FrMCUIGNstaNidec_flg_ovrdflg@ */ Scalar_BOOLEAN 0 SWC_INP_type_CM_boolean_flg 0.0 1.0 /end CHARACTERISTIC
/begin CHARACTERISTIC KINP_FrMCUIGNstaNidec_flg_ovrdval "" VALUE 0x0000 /* @ECU_Address@KINP_FrMCUIGNstaNidec_flg_ovrdval@ */ Scalar_BOOLEAN 0 SWC_INP_type_CM_boolean_flg 0.0 1.0 /end CHARACTERISTIC
/begin CHARACTERISTIC KINP_FrMCUIGNsta_flg_defval "" VALUE 0x0000 /* @ECU_Address@KINP_FrMCUIGNsta_flg_defval@ */ Scalar_BOOLEAN 0 SWC_INP_type_CM_boolean_flg 0.0 1.0 /end CHARACTERISTIC
/begin CHARACTERISTIC KINP_FrMCUIGNsta_flg_ovrdflg "" VALUE 0x0000 /* @ECU_Address@KINP_FrMCUIGNsta_flg_ovrdflg@ */ Scalar_BOOLEAN 0 SWC_INP_type_CM_boolean_flg 0.0 1.0 /end CHARACTERISTIC
/begin CHARACTERISTIC KINP_FrMCUIGNsta_flg_ovrdval "" VALUE 0x0000 /* @ECU_Address@KINP_FrMCUIGNsta_flg_ovrdval@ */ Scalar_BOOLEAN 0 SWC_INP_type_CM_boolean_flg 0.0 1.0 /end CHARACTERISTIC
/begin CHARACTERISTIC KINP_FrMCUReady4PreNidec_flg_defval "" VALUE 0x0000 /* @ECU_Address@KINP_FrMCUReady4PreNidec_flg_defval@ */ Scalar_BOOLEAN 0 SWC_INP_type_CM_boolean_flg 0.0 1.0 /end CHARACTERISTIC
/begin CHARACTERISTIC KINP_FrMCUReady4PreNidec_flg_ovrdflg "" VALUE 0x0000 /* @ECU_Address@KINP_FrMCUReady4PreNidec_flg_ovrdflg@ */ Scalar_BOOLEAN 0 SWC_INP_type_CM_boolean_flg 0.0 1.0 /end CHARACTERISTIC
/begin CHARACTERISTIC KINP_FrMCUReady4PreNidec_flg_ovrdval "" VALUE 0x0000 /* @ECU_Address@KINP_FrMCUReady4PreNidec_flg_ovrdval@ */ Scalar_BOOLEAN 0 SWC_INP_type_CM_boolean_flg 0.0 1.0 /end CHARACTERISTIC
/begin CHARACTERISTIC KINP_FrMCUReady4Pre_flg_defval "" VALUE 0x0000 /* @ECU_Address@KINP_FrMCUReady4Pre_flg_defval@ */ Scalar_BOOLEAN 0 SWC_INP_type_CM_boolean_flg 0.0 1.0 /end CHARACTERISTIC
/begin CHARACTERISTIC KINP_FrMCUReady4Pre_flg_ovrdflg "" VALUE 0x0000 /* @ECU_Address@KINP_FrMCUReady4Pre_flg_ovrdflg@ */ Scalar_BOOLEAN 0 SWC_INP_type_CM_boolean_flg 0.0 1.0 /end CHARACTERISTIC
/begin CHARACTERISTIC KINP_FrMCUReady4Pre_flg_ovrdval "" VALUE 0x0000 /* @ECU_Address@KINP_FrMCUReady4Pre_flg_ovrdval@ */ Scalar_BOOLEAN 0 SWC_INP_type_CM_boolean_flg 0.0 1.0 /end CHARACTERISTIC
/begin CHARACTERISTIC KINP_FrMCUReadyNidec_flg_defval "" VALUE 0x0000 /* @ECU_Address@KINP_FrMCUReadyNidec_flg_defval@ */ Scalar_BOOLEAN 0 SWC_INP_type_CM_boolean_flg 0.0 1.0 /end CHARACTERISTIC
/begin CHARACTERISTIC KINP_FrMCUReadyNidec_flg_ovrdflg "" VALUE 0x0000 /* @ECU_Address@KINP_FrMCUReadyNidec_flg_ovrdflg@ */ Scalar_BOOLEAN 0 SWC_INP_type_CM_boolean_flg 0.0 1.0 /end CHARACTERISTIC
/begin CHARACTERISTIC KINP_FrMCUReadyNidec_flg_ovrdval "" VALUE 0x0000 /* @ECU_Address@KINP_FrMCUReadyNidec_flg_ovrdval@ */ Scalar_BOOLEAN 0 SWC_INP_type_CM_boolean_flg 0.0 1.0 /end CHARACTERISTIC
/begin CHARACTERISTIC KINP_FrMCUReady_flg_defval "" VALUE 0x0000 /* @ECU_Address@KINP_FrMCUReady_flg_defval@ */ Scalar_BOOLEAN 0 SWC_INP_type_CM_boolean_flg 0.0 1.0 /end CHARACTERISTIC
/begin CHARACTERISTIC KINP_FrMCUReady_flg_ovrdflg "" VALUE 0x0000 /* @ECU_Address@KINP_FrMCUReady_flg_ovrdflg@ */ Scalar_BOOLEAN 0 SWC_INP_type_CM_boolean_flg 0.0 1.0 /end CHARACTERISTIC
/begin CHARACTERISTIC KINP_FrMCUReady_flg_ovrdval "" VALUE 0x0000 /* @ECU_Address@KINP_FrMCUReady_flg_ovrdval@ */ Scalar_BOOLEAN 0 SWC_INP_type_CM_boolean_flg 0.0 1.0 /end CHARACTERISTIC
/begin CHARACTERISTIC KINP_FrMCUSWVer_enum_ovrdflg "" VALUE 0x0000 /* @ECU_Address@KINP_FrMCUSWVer_enum_ovrdflg@ */ Scalar_BOOLEAN 0 SWC_INP_type_CM_boolean_flg 0.0 1.0 /end CHARACTERISTIC
/begin CHARACTERISTIC KINP_FrMCUSysStaNidec_enum_ovrdflg "" VALUE 0x0000 /* @ECU_Address@KINP_FrMCUSysStaNidec_enum_ovrdflg@ */ Scalar_BOOLEAN 0 SWC_INP_type_CM_boolean_flg 0.0 1.0 /end CHARACTERISTIC
/begin CHARACTERISTIC KINP_FrMCUSysSta_enum_ovrdflg "" VALUE 0x0000 /* @ECU_Address@KINP_FrMCUSysSta_enum_ovrdflg@ */ Scalar_BOOLEAN 0 SWC_INP_type_CM_boolean_flg 0.0 1.0 /end CHARACTERISTIC
/begin CHARACTERISTIC KINP_FrMCUTempNidec_C_ovrdflg "" VALUE 0x0000 /* @ECU_Address@KINP_FrMCUTempNidec_C_ovrdflg@ */ Scalar_BOOLEAN 0 SWC_INP_type_CM_boolean_flg 0.0 1.0 /end CHARACTERISTIC
/begin CHARACTERISTIC KINP_FrMCUTempWarn_enum_ovrdflg "" VALUE 0x0000 /* @ECU_Address@KINP_FrMCUTempWarn_enum_ovrdflg@ */ Scalar_BOOLEAN 0 SWC_INP_type_CM_boolean_flg 0.0 1.0 /end CHARACTERISTIC
/begin CHARACTERISTIC KINP_FrMCUTemp_C_ovrdflg "" VALUE 0x0000 /* @ECU_Address@KINP_FrMCUTemp_C_ovrdflg@ */ Scalar_BOOLEAN 0 SWC_INP_type_CM_boolean_flg 0.0 1.0 /end CHARACTERISTIC
/begin CHARACTERISTIC KINP_FrMotorAvailTqNidec_Nm_ovrdflg "" VALUE 0x0000 /* @ECU_Address@KINP_FrMotorAvailTqNidec_Nm_ovrdflg@ */ Scalar_BOOLEAN 0 SWC_INP_type_CM_boolean_flg 0.0 1.0 /end CHARACTERISTIC
/begin CHARACTERISTIC KINP_FrMotorAvailTq_Nm_ovrdflg "" VALUE 0x0000 /* @ECU_Address@KINP_FrMotorAvailTq_Nm_ovrdflg@ */ Scalar_BOOLEAN 0 SWC_INP_type_CM_boolean_flg 0.0 1.0 /end CHARACTERISTIC
/begin CHARACTERISTIC KINP_FrRegenAvailTqNidec_Nm_ovrdflg "" VALUE 0x0000 /* @ECU_Address@KINP_FrRegenAvailTqNidec_Nm_ovrdflg@ */ Scalar_BOOLEAN 0 SWC_INP_type_CM_boolean_flg 0.0 1.0 /end CHARACTERISTIC
/begin CHARACTERISTIC KINP_FrRegenAvailTq_Nm_ovrdflg "" VALUE 0x0000 /* @ECU_Address@KINP_FrRegenAvailTq_Nm_ovrdflg@ */ Scalar_BOOLEAN 0 SWC_INP_type_CM_boolean_flg 0.0 1.0 /end CHARACTERISTIC
/begin CHARACTERISTIC KINP_FrTMSpdNidec_rpm_ovrdflg "" VALUE 0x0000 /* @ECU_Address@KINP_FrTMSpdNidec_rpm_ovrdflg@ */ Scalar_BOOLEAN 0 SWC_INP_type_CM_boolean_flg 0.0 1.0 /end CHARACTERISTIC
/begin CHARACTERISTIC KINP_FrTMSpd_rpm_ovrdflg "" VALUE 0x0000 /* @ECU_Address@KINP_FrTMSpd_rpm_ovrdflg@ */ Scalar_BOOLEAN 0 SWC_INP_type_CM_boolean_flg 0.0 1.0 /end CHARACTERISTIC
/begin CHARACTERISTIC KINP_FrTMTempNidec_C_ovrdflg "" VALUE 0x0000 /* @ECU_Address@KINP_FrTMTempNidec_C_ovrdflg@ */ Scalar_BOOLEAN 0 SWC_INP_type_CM_boolean_flg 0.0 1.0 /end CHARACTERISTIC
/begin CHARACTERISTIC KINP_FrTMTempWarn_enum_ovrdflg "" VALUE 0x0000 /* @ECU_Address@KINP_FrTMTempWarn_enum_ovrdflg@ */ Scalar_BOOLEAN 0 SWC_INP_type_CM_boolean_flg 0.0 1.0 /end CHARACTERISTIC
/begin CHARACTERISTIC KINP_FrTMTemp_C_ovrdflg "" VALUE 0x0000 /* @ECU_Address@KINP_FrTMTemp_C_ovrdflg@ */ Scalar_BOOLEAN 0 SWC_INP_type_CM_boolean_flg 0.0 1.0 /end CHARACTERISTIC
/begin CHARACTERISTIC KINP_FrTMidNidec_A_ovrdflg "" VALUE 0x0000 /* @ECU_Address@KINP_FrTMidNidec_A_ovrdflg@ */ Scalar_BOOLEAN 0 SWC_INP_type_CM_boolean_flg 0.0 1.0 /end CHARACTERISTIC
/begin CHARACTERISTIC KINP_FrTMid_A_ovrdflg "" VALUE 0x0000 /* @ECU_Address@KINP_FrTMid_A_ovrdflg@ */ Scalar_BOOLEAN 0 SWC_INP_type_CM_boolean_flg 0.0 1.0 /end CHARACTERISTIC
/begin CHARACTERISTIC KINP_FrTMiqNidec_A_ovrdflg "" VALUE 0x0000 /* @ECU_Address@KINP_FrTMiqNidec_A_ovrdflg@ */ Scalar_BOOLEAN 0 SWC_INP_type_CM_boolean_flg 0.0 1.0 /end CHARACTERISTIC
/begin CHARACTERISTIC KINP_FrTMiq_A_ovrdflg "" VALUE 0x0000 /* @ECU_Address@KINP_FrTMiq_A_ovrdflg@ */ Scalar_BOOLEAN 0 SWC_INP_type_CM_boolean_flg 0.0 1.0 /end CHARACTERISTIC
/begin CHARACTERISTIC KINP_HVBCellVoltMax_mV_ovrdflg "" VALUE 0x0000 /* @ECU_Address@KINP_HVBCellVoltMax_mV_ovrdflg@ */ Scalar_BOOLEAN 0 SWC_INP_type_CM_boolean_flg 0.0 1.0 /end CHARACTERISTIC
/begin CHARACTERISTIC KINP_HVBCellVoltMin_mV_ovrdflg "" VALUE 0x0000 /* @ECU_Address@KINP_HVBCellVoltMin_mV_ovrdflg@ */ Scalar_BOOLEAN 0 SWC_INP_type_CM_boolean_flg 0.0 1.0 /end CHARACTERISTIC
/begin CHARACTERISTIC KINP_HVBChrgErr_enum_ovrdflg "" VALUE 0x0000 /* @ECU_Address@KINP_HVBChrgErr_enum_ovrdflg@ */ Scalar_BOOLEAN 0 SWC_INP_type_CM_boolean_flg 0.0 1.0 /end CHARACTERISTIC
/begin CHARACTERISTIC KINP_HVBChrgPwrTotal_kWh_ovrdflg "" VALUE 0x0000 /* @ECU_Address@KINP_HVBChrgPwrTotal_kWh_ovrdflg@ */ Scalar_BOOLEAN 0 SWC_INP_type_CM_boolean_flg 0.0 1.0 /end CHARACTERISTIC
/begin CHARACTERISTIC KINP_HVBChrgPwr_kWh_ovrdflg "" VALUE 0x0000 /* @ECU_Address@KINP_HVBChrgPwr_kWh_ovrdflg@ */ Scalar_BOOLEAN 0 SWC_INP_type_CM_boolean_flg 0.0 1.0 /end CHARACTERISTIC
/begin CHARACTERISTIC KINP_HVBContactorSta_flg_defval "" VALUE 0x0000 /* @ECU_Address@KINP_HVBContactorSta_flg_defval@ */ Scalar_BOOLEAN 0 SWC_INP_type_CM_boolean_flg 0.0 1.0 /end CHARACTERISTIC
/begin CHARACTERISTIC KINP_HVBContactorSta_flg_ovrdflg "" VALUE 0x0000 /* @ECU_Address@KINP_HVBContactorSta_flg_ovrdflg@ */ Scalar_BOOLEAN 0 SWC_INP_type_CM_boolean_flg 0.0 1.0 /end CHARACTERISTIC
/begin CHARACTERISTIC KINP_HVBContactorSta_flg_ovrdval "" VALUE 0x0000 /* @ECU_Address@KINP_HVBContactorSta_flg_ovrdval@ */ Scalar_BOOLEAN 0 SWC_INP_type_CM_boolean_flg 0.0 1.0 /end CHARACTERISTIC
/begin CHARACTERISTIC KINP_HVBDrvPwrTotal_kWh_ovrdflg "" VALUE 0x0000 /* @ECU_Address@KINP_HVBDrvPwrTotal_kWh_ovrdflg@ */ Scalar_BOOLEAN 0 SWC_INP_type_CM_boolean_flg 0.0 1.0 /end CHARACTERISTIC
/begin CHARACTERISTIC KINP_HVBDrvPwr_kWh_ovrdflg "" VALUE 0x0000 /* @ECU_Address@KINP_HVBDrvPwr_kWh_ovrdflg@ */ Scalar_BOOLEAN 0 SWC_INP_type_CM_boolean_flg 0.0 1.0 /end CHARACTERISTIC
/begin CHARACTERISTIC KINP_HVBFullChrgPwr_kWh_ovrdflg "" VALUE 0x0000 /* @ECU_Address@KINP_HVBFullChrgPwr_kWh_ovrdflg@ */ Scalar_BOOLEAN 0 SWC_INP_type_CM_boolean_flg 0.0 1.0 /end CHARACTERISTIC
/begin CHARACTERISTIC KINP_HVBHVILErr_flg_defval "" VALUE 0x0000 /* @ECU_Address@KINP_HVBHVILErr_flg_defval@ */ Scalar_BOOLEAN 0 SWC_INP_type_CM_boolean_flg 0.0 1.0 /end CHARACTERISTIC
/begin CHARACTERISTIC KINP_HVBHVILErr_flg_ovrdflg "" VALUE 0x0000 /* @ECU_Address@KINP_HVBHVILErr_flg_ovrdflg@ */ Scalar_BOOLEAN 0 SWC_INP_type_CM_boolean_flg 0.0 1.0 /end CHARACTERISTIC
/begin CHARACTERISTIC KINP_HVBHVILErr_flg_ovrdval "" VALUE 0x0000 /* @ECU_Address@KINP_HVBHVILErr_flg_ovrdval@ */ Scalar_BOOLEAN 0 SWC_INP_type_CM_boolean_flg 0.0 1.0 /end CHARACTERISTIC
/begin CHARACTERISTIC KINP_HVBIsoImpedenceN_Megaohm_ovrdflg "" VALUE 0x0000 /* @ECU_Address@KINP_HVBIsoImpedenceN_Megaohm_ovrdflg@ */ Scalar_BOOLEAN 0 SWC_INP_type_CM_boolean_flg 0.0 1.0 /end CHARACTERISTIC
/begin CHARACTERISTIC KINP_HVBIsoImpedenceP_Megaohm_ovrdflg "" VALUE 0x0000 /* @ECU_Address@KINP_HVBIsoImpedenceP_Megaohm_ovrdflg@ */ Scalar_BOOLEAN 0 SWC_INP_type_CM_boolean_flg 0.0 1.0 /end CHARACTERISTIC
/begin CHARACTERISTIC KINP_HVBMTempMax_C_ovrdflg "" VALUE 0x0000 /* @ECU_Address@KINP_HVBMTempMax_C_ovrdflg@ */ Scalar_BOOLEAN 0 SWC_INP_type_CM_boolean_flg 0.0 1.0 /end CHARACTERISTIC
/begin CHARACTERISTIC KINP_HVBMTempMin_C_ovrdflg "" VALUE 0x0000 /* @ECU_Address@KINP_HVBMTempMin_C_ovrdflg@ */ Scalar_BOOLEAN 0 SWC_INP_type_CM_boolean_flg 0.0 1.0 /end CHARACTERISTIC
/begin CHARACTERISTIC KINP_HVBOvrTempErr_flg_defval "" VALUE 0x0000 /* @ECU_Address@KINP_HVBOvrTempErr_flg_defval@ */ Scalar_BOOLEAN 0 SWC_INP_type_CM_boolean_flg 0.0 1.0 /end CHARACTERISTIC
/begin CHARACTERISTIC KINP_HVBOvrTempErr_flg_ovrdflg "" VALUE 0x0000 /* @ECU_Address@KINP_HVBOvrTempErr_flg_ovrdflg@ */ Scalar_BOOLEAN 0 SWC_INP_type_CM_boolean_flg 0.0 1.0 /end CHARACTERISTIC
/begin CHARACTERISTIC KINP_HVBOvrTempErr_flg_ovrdval "" VALUE 0x0000 /* @ECU_Address@KINP_HVBOvrTempErr_flg_ovrdval@ */ Scalar_BOOLEAN 0 SWC_INP_type_CM_boolean_flg 0.0 1.0 /end CHARACTERISTIC
/begin CHARACTERISTIC KINP_HVBOvrTempWarn_enum_ovrdflg "" VALUE 0x0000 /* @ECU_Address@KINP_HVBOvrTempWarn_enum_ovrdflg@ */ Scalar_BOOLEAN 0 SWC_INP_type_CM_boolean_flg 0.0 1.0 /end CHARACTERISTIC
/begin CHARACTERISTIC KINP_HVBPreheatPrecoolSta_enum_ovrdflg "" VALUE 0x0000 /* @ECU_Address@KINP_HVBPreheatPrecoolSta_enum_ovrdflg@ */ Scalar_BOOLEAN 0 SWC_INP_type_CM_boolean_flg 0.0 1.0 /end CHARACTERISTIC
/begin CHARACTERISTIC KINP_HVBPwrAvailChrg30_kW_ovrdflg "" VALUE 0x0000 /* @ECU_Address@KINP_HVBPwrAvailChrg30_kW_ovrdflg@ */ Scalar_BOOLEAN 0 SWC_INP_type_CM_boolean_flg 0.0 1.0 /end CHARACTERISTIC
/begin CHARACTERISTIC KINP_HVBPwrAvailChrg60_kW_ovrdflg "" VALUE 0x0000 /* @ECU_Address@KINP_HVBPwrAvailChrg60_kW_ovrdflg@ */ Scalar_BOOLEAN 0 SWC_INP_type_CM_boolean_flg 0.0 1.0 /end CHARACTERISTIC
/begin CHARACTERISTIC KINP_HVBPwrAvailChrg_kW_ovrdflg "" VALUE 0x0000 /* @ECU_Address@KINP_HVBPwrAvailChrg_kW_ovrdflg@ */ Scalar_BOOLEAN 0 SWC_INP_type_CM_boolean_flg 0.0 1.0 /end CHARACTERISTIC
/begin CHARACTERISTIC KINP_HVBPwrAvailDchrg30_kW_ovrdflg "" VALUE 0x0000 /* @ECU_Address@KINP_HVBPwrAvailDchrg30_kW_ovrdflg@ */ Scalar_BOOLEAN 0 SWC_INP_type_CM_boolean_flg 0.0 1.0 /end CHARACTERISTIC
/begin CHARACTERISTIC KINP_HVBPwrAvailDchrg60_kW_ovrdflg "" VALUE 0x0000 /* @ECU_Address@KINP_HVBPwrAvailDchrg60_kW_ovrdflg@ */ Scalar_BOOLEAN 0 SWC_INP_type_CM_boolean_flg 0.0 1.0 /end CHARACTERISTIC
/begin CHARACTERISTIC KINP_HVBPwrAvailDchrg_kW_ovrdflg "" VALUE 0x0000 /* @ECU_Address@KINP_HVBPwrAvailDchrg_kW_ovrdflg@ */ Scalar_BOOLEAN 0 SWC_INP_type_CM_boolean_flg 0.0 1.0 /end CHARACTERISTIC
/begin CHARACTERISTIC KINP_HVBSOH_pct_ovrdflg "" VALUE 0x0000 /* @ECU_Address@KINP_HVBSOH_pct_ovrdflg@ */ Scalar_BOOLEAN 0 SWC_INP_type_CM_boolean_flg 0.0 1.0 /end CHARACTERISTIC
/begin CHARACTERISTIC KINP_HVBattCurr_A_ovrdflg "" VALUE 0x0000 /* @ECU_Address@KINP_HVBattCurr_A_ovrdflg@ */ Scalar_BOOLEAN 0 SWC_INP_type_CM_boolean_flg 0.0 1.0 /end CHARACTERISTIC
/begin CHARACTERISTIC KINP_HVBattErr_flg_defval "" VALUE 0x0000 /* @ECU_Address@KINP_HVBattErr_flg_defval@ */ Scalar_BOOLEAN 0 SWC_INP_type_CM_boolean_flg 0.0 1.0 /end CHARACTERISTIC
/begin CHARACTERISTIC KINP_HVBattErr_flg_ovrdflg "" VALUE 0x0000 /* @ECU_Address@KINP_HVBattErr_flg_ovrdflg@ */ Scalar_BOOLEAN 0 SWC_INP_type_CM_boolean_flg 0.0 1.0 /end CHARACTERISTIC
/begin CHARACTERISTIC KINP_HVBattErr_flg_ovrdval "" VALUE 0x0000 /* @ECU_Address@KINP_HVBattErr_flg_ovrdval@ */ Scalar_BOOLEAN 0 SWC_INP_type_CM_boolean_flg 0.0 1.0 /end CHARACTERISTIC
/begin CHARACTERISTIC KINP_HVBattPackVolt_V_ovrdflg "" VALUE 0x0000 /* @ECU_Address@KINP_HVBattPackVolt_V_ovrdflg@ */ Scalar_BOOLEAN 0 SWC_INP_type_CM_boolean_flg 0.0 1.0 /end CHARACTERISTIC
/begin CHARACTERISTIC KINP_HVBattReady4Pre_enum_ovrdflg "" VALUE 0x0000 /* @ECU_Address@KINP_HVBattReady4Pre_enum_ovrdflg@ */ Scalar_BOOLEAN 0 SWC_INP_type_CM_boolean_flg 0.0 1.0 /end CHARACTERISTIC
/begin CHARACTERISTIC KINP_HVBattSOCDis_pct_ovrdflg "" VALUE 0x0000 /* @ECU_Address@KINP_HVBattSOCDis_pct_ovrdflg@ */ Scalar_BOOLEAN 0 SWC_INP_type_CM_boolean_flg 0.0 1.0 /end CHARACTERISTIC
/begin CHARACTERISTIC KINP_HVBattSOC_pct_ovrdflg "" VALUE 0x0000 /* @ECU_Address@KINP_HVBattSOC_pct_ovrdflg@ */ Scalar_BOOLEAN 0 SWC_INP_type_CM_boolean_flg 0.0 1.0 /end CHARACTERISTIC
/begin CHARACTERISTIC KINP_HVBattVolt_V_ovrdflg "" VALUE 0x0000 /* @ECU_Address@KINP_HVBattVolt_V_ovrdflg@ */ Scalar_BOOLEAN 0 SWC_INP_type_CM_boolean_flg 0.0 1.0 /end CHARACTERISTIC
/begin CHARACTERISTIC KINP_HVILSta_flg_defval "" VALUE 0x0000 /* @ECU_Address@KINP_HVILSta_flg_defval@ */ Scalar_BOOLEAN 0 SWC_INP_type_CM_boolean_flg 0.0 1.0 /end CHARACTERISTIC
/begin CHARACTERISTIC KINP_HVILSta_flg_ovrdflg "" VALUE 0x0000 /* @ECU_Address@KINP_HVILSta_flg_ovrdflg@ */ Scalar_BOOLEAN 0 SWC_INP_type_CM_boolean_flg 0.0 1.0 /end CHARACTERISTIC
/begin CHARACTERISTIC KINP_HVILSta_flg_ovrdval "" VALUE 0x0000 /* @ECU_Address@KINP_HVILSta_flg_ovrdval@ */ Scalar_BOOLEAN 0 SWC_INP_type_CM_boolean_flg 0.0 1.0 /end CHARACTERISTIC
/begin CHARACTERISTIC KINP_HVInVolt_V_ovrdflg "" VALUE 0x0000 /* @ECU_Address@KINP_HVInVolt_V_ovrdflg@ */ Scalar_BOOLEAN 0 SWC_INP_type_CM_boolean_flg 0.0 1.0 /end CHARACTERISTIC
/begin CHARACTERISTIC KINP_IVIRBlowerZSta_pct_ovrdflg "" VALUE 0x0000 /* @ECU_Address@KINP_IVIRBlowerZSta_pct_ovrdflg@ */ Scalar_BOOLEAN 0 SWC_INP_type_CM_boolean_flg 0.0 1.0 /end CHARACTERISTIC
/begin CHARACTERISTIC KINP_IVIRSEATventCmd_enum_ovrdflg "" VALUE 0x0000 /* @ECU_Address@KINP_IVIRSEATventCmd_enum_ovrdflg@ */ Scalar_BOOLEAN 0 SWC_INP_type_CM_boolean_flg 0.0 1.0 /end CHARACTERISTIC
/begin CHARACTERISTIC KINP_IVISnowModeCmd_flg_defval "" VALUE 0x0000 /* @ECU_Address@KINP_IVISnowModeCmd_flg_defval@ */ Scalar_BOOLEAN 0 SWC_INP_type_CM_boolean_flg 0.0 1.0 /end CHARACTERISTIC
/begin CHARACTERISTIC KINP_IVISnowModeCmd_flg_ovrdflg "" VALUE 0x0000 /* @ECU_Address@KINP_IVISnowModeCmd_flg_ovrdflg@ */ Scalar_BOOLEAN 0 SWC_INP_type_CM_boolean_flg 0.0 1.0 /end CHARACTERISTIC
/begin CHARACTERISTIC KINP_IVISnowModeCmd_flg_ovrdval "" VALUE 0x0000 /* @ECU_Address@KINP_IVISnowModeCmd_flg_ovrdval@ */ Scalar_BOOLEAN 0 SWC_INP_type_CM_boolean_flg 0.0 1.0 /end CHARACTERISTIC
/begin CHARACTERISTIC KINP_IVIUserTakeOverAPSSta_flg_defval "" VALUE 0x0000 /* @ECU_Address@KINP_IVIUserTakeOverAPSSta_flg_defval@ */ Scalar_BOOLEAN 0 SWC_INP_type_CM_boolean_flg 0.0 1.0 /end CHARACTERISTIC
/begin CHARACTERISTIC KINP_IVIUserTakeOverAPSSta_flg_ovrdflg "" VALUE 0x0000 /* @ECU_Address@KINP_IVIUserTakeOverAPSSta_flg_ovrdflg@ */ Scalar_BOOLEAN 0 SWC_INP_type_CM_boolean_flg 0.0 1.0 /end CHARACTERISTIC
/begin CHARACTERISTIC KINP_IVIUserTakeOverAPSSta_flg_ovrdval "" VALUE 0x0000 /* @ECU_Address@KINP_IVIUserTakeOverAPSSta_flg_ovrdval@ */ Scalar_BOOLEAN 0 SWC_INP_type_CM_boolean_flg 0.0 1.0 /end CHARACTERISTIC
/begin CHARACTERISTIC KINP_IVIZon1WindDirSWReqSta_flg_defval "" VALUE 0x0000 /* @ECU_Address@KINP_IVIZon1WindDirSWReqSta_flg_defval@ */ Scalar_BOOLEAN 0 SWC_INP_type_CM_boolean_flg 0.0 1.0 /end CHARACTERISTIC
/begin CHARACTERISTIC KINP_IVIZon1WindDirSWReqSta_flg_ovrdflg "" VALUE 0x0000 /* @ECU_Address@KINP_IVIZon1WindDirSWReqSta_flg_ovrdflg@ */ Scalar_BOOLEAN 0 SWC_INP_type_CM_boolean_flg 0.0 1.0 /end CHARACTERISTIC
/begin CHARACTERISTIC KINP_IVIZon1WindDirSWReqSta_flg_ovrdval "" VALUE 0x0000 /* @ECU_Address@KINP_IVIZon1WindDirSWReqSta_flg_ovrdval@ */ Scalar_BOOLEAN 0 SWC_INP_type_CM_boolean_flg 0.0 1.0 /end CHARACTERISTIC
/begin CHARACTERISTIC KINP_LVBattDet12V_V_ovrdflg "" VALUE 0x0000 /* @ECU_Address@KINP_LVBattDet12V_V_ovrdflg@ */ Scalar_BOOLEAN 0 SWC_INP_type_CM_boolean_flg 0.0 1.0 /end CHARACTERISTIC
/begin CHARACTERISTIC KINP_MCUBF1CSErr_flg_defval "" VALUE 0x0000 /* @ECU_Address@KINP_MCUBF1CSErr_flg_defval@ */ Scalar_BOOLEAN 0 SWC_INP_type_CM_boolean_flg 0.0 1.0 /end CHARACTERISTIC
/begin CHARACTERISTIC KINP_MCUBF1CSErr_flg_ovrdflg "" VALUE 0x0000 /* @ECU_Address@KINP_MCUBF1CSErr_flg_ovrdflg@ */ Scalar_BOOLEAN 0 SWC_INP_type_CM_boolean_flg 0.0 1.0 /end CHARACTERISTIC
/begin CHARACTERISTIC KINP_MCUBF1CSErr_flg_ovrdval "" VALUE 0x0000 /* @ECU_Address@KINP_MCUBF1CSErr_flg_ovrdval@ */ Scalar_BOOLEAN 0 SWC_INP_type_CM_boolean_flg 0.0 1.0 /end CHARACTERISTIC
/begin CHARACTERISTIC KINP_MCUBF1RCErr_flg_defval "" VALUE 0x0000 /* @ECU_Address@KINP_MCUBF1RCErr_flg_defval@ */ Scalar_BOOLEAN 0 SWC_INP_type_CM_boolean_flg 0.0 1.0 /end CHARACTERISTIC
/begin CHARACTERISTIC KINP_MCUBF1RCErr_flg_ovrdflg "" VALUE 0x0000 /* @ECU_Address@KINP_MCUBF1RCErr_flg_ovrdflg@ */ Scalar_BOOLEAN 0 SWC_INP_type_CM_boolean_flg 0.0 1.0 /end CHARACTERISTIC
/begin CHARACTERISTIC KINP_MCUBF1RCErr_flg_ovrdval "" VALUE 0x0000 /* @ECU_Address@KINP_MCUBF1RCErr_flg_ovrdval@ */ Scalar_BOOLEAN 0 SWC_INP_type_CM_boolean_flg 0.0 1.0 /end CHARACTERISTIC
/begin CHARACTERISTIC KINP_MCUBFLLCTempWarnSta_enum_ovrdflg "" VALUE 0x0000 /* @ECU_Address@KINP_MCUBFLLCTempWarnSta_enum_ovrdflg@ */ Scalar_BOOLEAN 0 SWC_INP_type_CM_boolean_flg 0.0 1.0 /end CHARACTERISTIC
/begin CHARACTERISTIC KINP_MCUBFRealPwrKwSta_kW_ovrdflg "" VALUE 0x0000 /* @ECU_Address@KINP_MCUBFRealPwrKwSta_kW_ovrdflg@ */ Scalar_BOOLEAN 0 SWC_INP_type_CM_boolean_flg 0.0 1.0 /end CHARACTERISTIC
/begin CHARACTERISTIC KINP_MCUBR1CSErr_flg_defval "" VALUE 0x0000 /* @ECU_Address@KINP_MCUBR1CSErr_flg_defval@ */ Scalar_BOOLEAN 0 SWC_INP_type_CM_boolean_flg 0.0 1.0 /end CHARACTERISTIC
/begin CHARACTERISTIC KINP_MCUBR1CSErr_flg_ovrdflg "" VALUE 0x0000 /* @ECU_Address@KINP_MCUBR1CSErr_flg_ovrdflg@ */ Scalar_BOOLEAN 0 SWC_INP_type_CM_boolean_flg 0.0 1.0 /end CHARACTERISTIC
/begin CHARACTERISTIC KINP_MCUBR1CSErr_flg_ovrdval "" VALUE 0x0000 /* @ECU_Address@KINP_MCUBR1CSErr_flg_ovrdval@ */ Scalar_BOOLEAN 0 SWC_INP_type_CM_boolean_flg 0.0 1.0 /end CHARACTERISTIC
/begin CHARACTERISTIC KINP_MCUBR1RCErr_flg_defval "" VALUE 0x0000 /* @ECU_Address@KINP_MCUBR1RCErr_flg_defval@ */ Scalar_BOOLEAN 0 SWC_INP_type_CM_boolean_flg 0.0 1.0 /end CHARACTERISTIC
/begin CHARACTERISTIC KINP_MCUBR1RCErr_flg_ovrdflg "" VALUE 0x0000 /* @ECU_Address@KINP_MCUBR1RCErr_flg_ovrdflg@ */ Scalar_BOOLEAN 0 SWC_INP_type_CM_boolean_flg 0.0 1.0 /end CHARACTERISTIC
/begin CHARACTERISTIC KINP_MCUBR1RCErr_flg_ovrdval "" VALUE 0x0000 /* @ECU_Address@KINP_MCUBR1RCErr_flg_ovrdval@ */ Scalar_BOOLEAN 0 SWC_INP_type_CM_boolean_flg 0.0 1.0 /end CHARACTERISTIC
/begin CHARACTERISTIC KINP_MCUBRLLCTempWarnSta_enum_ovrdflg "" VALUE 0x0000 /* @ECU_Address@KINP_MCUBRLLCTempWarnSta_enum_ovrdflg@ */ Scalar_BOOLEAN 0 SWC_INP_type_CM_boolean_flg 0.0 1.0 /end CHARACTERISTIC
/begin CHARACTERISTIC KINP_MCUBRRealPwrKwSta_kW_ovrdflg "" VALUE 0x0000 /* @ECU_Address@KINP_MCUBRRealPwrKwSta_kW_ovrdflg@ */ Scalar_BOOLEAN 0 SWC_INP_type_CM_boolean_flg 0.0 1.0 /end CHARACTERISTIC
/begin CHARACTERISTIC KINP_MCUNF1CSErr_flg_defval "" VALUE 0x0000 /* @ECU_Address@KINP_MCUNF1CSErr_flg_defval@ */ Scalar_BOOLEAN 0 SWC_INP_type_CM_boolean_flg 0.0 1.0 /end CHARACTERISTIC
/begin CHARACTERISTIC KINP_MCUNF1CSErr_flg_ovrdflg "" VALUE 0x0000 /* @ECU_Address@KINP_MCUNF1CSErr_flg_ovrdflg@ */ Scalar_BOOLEAN 0 SWC_INP_type_CM_boolean_flg 0.0 1.0 /end CHARACTERISTIC
/begin CHARACTERISTIC KINP_MCUNF1CSErr_flg_ovrdval "" VALUE 0x0000 /* @ECU_Address@KINP_MCUNF1CSErr_flg_ovrdval@ */ Scalar_BOOLEAN 0 SWC_INP_type_CM_boolean_flg 0.0 1.0 /end CHARACTERISTIC
/begin CHARACTERISTIC KINP_MCUNF1RCErr_flg_defval "" VALUE 0x0000 /* @ECU_Address@KINP_MCUNF1RCErr_flg_defval@ */ Scalar_BOOLEAN 0 SWC_INP_type_CM_boolean_flg 0.0 1.0 /end CHARACTERISTIC
/begin CHARACTERISTIC KINP_MCUNF1RCErr_flg_ovrdflg "" VALUE 0x0000 /* @ECU_Address@KINP_MCUNF1RCErr_flg_ovrdflg@ */ Scalar_BOOLEAN 0 SWC_INP_type_CM_boolean_flg 0.0 1.0 /end CHARACTERISTIC
/begin CHARACTERISTIC KINP_MCUNF1RCErr_flg_ovrdval "" VALUE 0x0000 /* @ECU_Address@KINP_MCUNF1RCErr_flg_ovrdval@ */ Scalar_BOOLEAN 0 SWC_INP_type_CM_boolean_flg 0.0 1.0 /end CHARACTERISTIC
/begin CHARACTERISTIC KINP_MCUWarnFNidec_enum_ovrdflg "" VALUE 0x0000 /* @ECU_Address@KINP_MCUWarnFNidec_enum_ovrdflg@ */ Scalar_BOOLEAN 0 SWC_INP_type_CM_boolean_flg 0.0 1.0 /end CHARACTERISTIC
/begin CHARACTERISTIC KINP_MCUWarnF_enum_ovrdflg "" VALUE 0x0000 /* @ECU_Address@KINP_MCUWarnF_enum_ovrdflg@ */ Scalar_BOOLEAN 0 SWC_INP_type_CM_boolean_flg 0.0 1.0 /end CHARACTERISTIC
/begin CHARACTERISTIC KINP_MCUWarnR_enum_ovrdflg "" VALUE 0x0000 /* @ECU_Address@KINP_MCUWarnR_enum_ovrdflg@ */ Scalar_BOOLEAN 0 SWC_INP_type_CM_boolean_flg 0.0 1.0 /end CHARACTERISTIC
/begin CHARACTERISTIC KINP_METERKPHCalcu_kph_ovrdflg "" VALUE 0x0000 /* @ECU_Address@KINP_METERKPHCalcu_kph_ovrdflg@ */ Scalar_BOOLEAN 0 SWC_INP_type_CM_boolean_flg 0.0 1.0 /end CHARACTERISTIC
/begin CHARACTERISTIC KINP_MainRlyNegSta_enum_ovrdflg "" VALUE 0x0000 /* @ECU_Address@KINP_MainRlyNegSta_enum_ovrdflg@ */ Scalar_BOOLEAN 0 SWC_INP_type_CM_boolean_flg 0.0 1.0 /end CHARACTERISTIC
/begin CHARACTERISTIC KINP_MainRlyPosSta_enum_ovrdflg "" VALUE 0x0000 /* @ECU_Address@KINP_MainRlyPosSta_enum_ovrdflg@ */ Scalar_BOOLEAN 0 SWC_INP_type_CM_boolean_flg 0.0 1.0 /end CHARACTERISTIC
/begin CHARACTERISTIC KINP_MaxCellTempNum_enum_ovrdflg "" VALUE 0x0000 /* @ECU_Address@KINP_MaxCellTempNum_enum_ovrdflg@ */ Scalar_BOOLEAN 0 SWC_INP_type_CM_boolean_flg 0.0 1.0 /end CHARACTERISTIC
/begin CHARACTERISTIC KINP_MaxCellVoltNum_enum_ovrdflg "" VALUE 0x0000 /* @ECU_Address@KINP_MaxCellVoltNum_enum_ovrdflg@ */ Scalar_BOOLEAN 0 SWC_INP_type_CM_boolean_flg 0.0 1.0 /end CHARACTERISTIC
/begin CHARACTERISTIC KINP_MinCellTempNum_enum_ovrdflg "" VALUE 0x0000 /* @ECU_Address@KINP_MinCellTempNum_enum_ovrdflg@ */ Scalar_BOOLEAN 0 SWC_INP_type_CM_boolean_flg 0.0 1.0 /end CHARACTERISTIC
/begin CHARACTERISTIC KINP_MinCellVoltNum_enum_ovrdflg "" VALUE 0x0000 /* @ECU_Address@KINP_MinCellVoltNum_enum_ovrdflg@ */ Scalar_BOOLEAN 0 SWC_INP_type_CM_boolean_flg 0.0 1.0 /end CHARACTERISTIC
/begin CHARACTERISTIC KINP_OBCACCSLimit_A_ovrdflg "" VALUE 0x0000 /* @ECU_Address@KINP_OBCACCSLimit_A_ovrdflg@ */ Scalar_BOOLEAN 0 SWC_INP_type_CM_boolean_flg 0.0 1.0 /end CHARACTERISTIC
/begin CHARACTERISTIC KINP_OBCACCurLim_enum_ovrdflg "" VALUE 0x0000 /* @ECU_Address@KINP_OBCACCurLim_enum_ovrdflg@ */ Scalar_BOOLEAN 0 SWC_INP_type_CM_boolean_flg 0.0 1.0 /end CHARACTERISTIC
/begin CHARACTERISTIC KINP_OBCACCurrInf_A_ovrdflg "" VALUE 0x0000 /* @ECU_Address@KINP_OBCACCurrInf_A_ovrdflg@ */ Scalar_BOOLEAN 0 SWC_INP_type_CM_boolean_flg 0.0 1.0 /end CHARACTERISTIC
/begin CHARACTERISTIC KINP_OBCACVoltInf_V_ovrdflg "" VALUE 0x0000 /* @ECU_Address@KINP_OBCACVoltInf_V_ovrdflg@ */ Scalar_BOOLEAN 0 SWC_INP_type_CM_boolean_flg 0.0 1.0 /end CHARACTERISTIC
/begin CHARACTERISTIC KINP_OBCDCCurLm_A_ovrdflg "" VALUE 0x0000 /* @ECU_Address@KINP_OBCDCCurLm_A_ovrdflg@ */ Scalar_BOOLEAN 0 SWC_INP_type_CM_boolean_flg 0.0 1.0 /end CHARACTERISTIC
/begin CHARACTERISTIC KINP_OBCDCCurrInf_A_ovrdflg "" VALUE 0x0000 /* @ECU_Address@KINP_OBCDCCurrInf_A_ovrdflg@ */ Scalar_BOOLEAN 0 SWC_INP_type_CM_boolean_flg 0.0 1.0 /end CHARACTERISTIC
/begin CHARACTERISTIC KINP_OBCDCVoltInf_V_ovrdflg "" VALUE 0x0000 /* @ECU_Address@KINP_OBCDCVoltInf_V_ovrdflg@ */ Scalar_BOOLEAN 0 SWC_INP_type_CM_boolean_flg 0.0 1.0 /end CHARACTERISTIC
/begin CHARACTERISTIC KINP_OBCDCVoltLm_V_ovrdflg "" VALUE 0x0000 /* @ECU_Address@KINP_OBCDCVoltLm_V_ovrdflg@ */ Scalar_BOOLEAN 0 SWC_INP_type_CM_boolean_flg 0.0 1.0 /end CHARACTERISTIC
/begin CHARACTERISTIC KINP_OBCEnaSta_flg_defval "" VALUE 0x0000 /* @ECU_Address@KINP_OBCEnaSta_flg_defval@ */ Scalar_BOOLEAN 0 SWC_INP_type_CM_boolean_flg 0.0 1.0 /end CHARACTERISTIC
/begin CHARACTERISTIC KINP_OBCEnaSta_flg_ovrdflg "" VALUE 0x0000 /* @ECU_Address@KINP_OBCEnaSta_flg_ovrdflg@ */ Scalar_BOOLEAN 0 SWC_INP_type_CM_boolean_flg 0.0 1.0 /end CHARACTERISTIC
/begin CHARACTERISTIC KINP_OBCEnaSta_flg_ovrdval "" VALUE 0x0000 /* @ECU_Address@KINP_OBCEnaSta_flg_ovrdval@ */ Scalar_BOOLEAN 0 SWC_INP_type_CM_boolean_flg 0.0 1.0 /end CHARACTERISTIC
/begin CHARACTERISTIC KINP_OBCFaultSta_enum_ovrdflg "" VALUE 0x0000 /* @ECU_Address@KINP_OBCFaultSta_enum_ovrdflg@ */ Scalar_BOOLEAN 0 SWC_INP_type_CM_boolean_flg 0.0 1.0 /end CHARACTERISTIC
/begin CHARACTERISTIC KINP_OBCPluginSta_flg_defval "" VALUE 0x0000 /* @ECU_Address@KINP_OBCPluginSta_flg_defval@ */ Scalar_BOOLEAN 0 SWC_INP_type_CM_boolean_flg 0.0 1.0 /end CHARACTERISTIC
/begin CHARACTERISTIC KINP_OBCPluginSta_flg_ovrdflg "" VALUE 0x0000 /* @ECU_Address@KINP_OBCPluginSta_flg_ovrdflg@ */ Scalar_BOOLEAN 0 SWC_INP_type_CM_boolean_flg 0.0 1.0 /end CHARACTERISTIC
/begin CHARACTERISTIC KINP_OBCPluginSta_flg_ovrdval "" VALUE 0x0000 /* @ECU_Address@KINP_OBCPluginSta_flg_ovrdval@ */ Scalar_BOOLEAN 0 SWC_INP_type_CM_boolean_flg 0.0 1.0 /end CHARACTERISTIC
/begin CHARACTERISTIC KINP_OBCPreCompleted_enum_ovrdflg "" VALUE 0x0000 /* @ECU_Address@KINP_OBCPreCompleted_enum_ovrdflg@ */ Scalar_BOOLEAN 0 SWC_INP_type_CM_boolean_flg 0.0 1.0 /end CHARACTERISTIC
/begin CHARACTERISTIC KINP_OBCReady4Pre_flg_defval "" VALUE 0x0000 /* @ECU_Address@KINP_OBCReady4Pre_flg_defval@ */ Scalar_BOOLEAN 0 SWC_INP_type_CM_boolean_flg 0.0 1.0 /end CHARACTERISTIC
/begin CHARACTERISTIC KINP_OBCReady4Pre_flg_ovrdflg "" VALUE 0x0000 /* @ECU_Address@KINP_OBCReady4Pre_flg_ovrdflg@ */ Scalar_BOOLEAN 0 SWC_INP_type_CM_boolean_flg 0.0 1.0 /end CHARACTERISTIC
/begin CHARACTERISTIC KINP_OBCReady4Pre_flg_ovrdval "" VALUE 0x0000 /* @ECU_Address@KINP_OBCReady4Pre_flg_ovrdval@ */ Scalar_BOOLEAN 0 SWC_INP_type_CM_boolean_flg 0.0 1.0 /end CHARACTERISTIC
/begin CHARACTERISTIC KINP_OBCTemp_C_ovrdflg "" VALUE 0x0000 /* @ECU_Address@KINP_OBCTemp_C_ovrdflg@ */ Scalar_BOOLEAN 0 SWC_INP_type_CM_boolean_flg 0.0 1.0 /end CHARACTERISTIC
/begin CHARACTERISTIC KINP_OBCV2LSta_enum_ovrdflg "" VALUE 0x0000 /* @ECU_Address@KINP_OBCV2LSta_enum_ovrdflg@ */ Scalar_BOOLEAN 0 SWC_INP_type_CM_boolean_flg 0.0 1.0 /end CHARACTERISTIC
/begin CHARACTERISTIC KINP_OBCWakeup4Plugin_flg_defval "" VALUE 0x0000 /* @ECU_Address@KINP_OBCWakeup4Plugin_flg_defval@ */ Scalar_BOOLEAN 0 SWC_INP_type_CM_boolean_flg 0.0 1.0 /end CHARACTERISTIC
/begin CHARACTERISTIC KINP_OBCWakeup4Plugin_flg_ovrdflg "" VALUE 0x0000 /* @ECU_Address@KINP_OBCWakeup4Plugin_flg_ovrdflg@ */ Scalar_BOOLEAN 0 SWC_INP_type_CM_boolean_flg 0.0 1.0 /end CHARACTERISTIC
/begin CHARACTERISTIC KINP_OBCWakeup4Plugin_flg_ovrdval "" VALUE 0x0000 /* @ECU_Address@KINP_OBCWakeup4Plugin_flg_ovrdval@ */ Scalar_BOOLEAN 0 SWC_INP_type_CM_boolean_flg 0.0 1.0 /end CHARACTERISTIC
/begin CHARACTERISTIC KINP_ODOMETER_km_ovrdflg "" VALUE 0x0000 /* @ECU_Address@KINP_ODOMETER_km_ovrdflg@ */ Scalar_BOOLEAN 0 SWC_INP_type_CM_boolean_flg 0.0 1.0 /end CHARACTERISTIC
/begin CHARACTERISTIC KINP_RCCCU1_enum_ovrdflg "" VALUE 0x0000 /* @ECU_Address@KINP_RCCCU1_enum_ovrdflg@ */ Scalar_BOOLEAN 0 SWC_INP_type_CM_boolean_flg 0.0 1.0 /end CHARACTERISTIC
/begin CHARACTERISTIC KINP_RCCCU2_enum_ovrdflg "" VALUE 0x0000 /* @ECU_Address@KINP_RCCCU2_enum_ovrdflg@ */ Scalar_BOOLEAN 0 SWC_INP_type_CM_boolean_flg 0.0 1.0 /end CHARACTERISTIC
/begin CHARACTERISTIC KINP_RemainChrgTime_min_ovrdflg "" VALUE 0x0000 /* @ECU_Address@KINP_RemainChrgTime_min_ovrdflg@ */ Scalar_BOOLEAN 0 SWC_INP_type_CM_boolean_flg 0.0 1.0 /end CHARACTERISTIC
/begin CHARACTERISTIC KINP_RrActvDmpDisabSta_flg_defval "" VALUE 0x0000 /* @ECU_Address@KINP_RrActvDmpDisabSta_flg_defval@ */ Scalar_BOOLEAN 0 SWC_INP_type_CM_boolean_flg 0.0 1.0 /end CHARACTERISTIC
/begin CHARACTERISTIC KINP_RrActvDmpDisabSta_flg_ovrdflg "" VALUE 0x0000 /* @ECU_Address@KINP_RrActvDmpDisabSta_flg_ovrdflg@ */ Scalar_BOOLEAN 0 SWC_INP_type_CM_boolean_flg 0.0 1.0 /end CHARACTERISTIC
/begin CHARACTERISTIC KINP_RrActvDmpDisabSta_flg_ovrdval "" VALUE 0x0000 /* @ECU_Address@KINP_RrActvDmpDisabSta_flg_ovrdval@ */ Scalar_BOOLEAN 0 SWC_INP_type_CM_boolean_flg 0.0 1.0 /end CHARACTERISTIC
/begin CHARACTERISTIC KINP_RrCoolanttempReq_cnt_ovrdflg "" VALUE 0x0000 /* @ECU_Address@KINP_RrCoolanttempReq_cnt_ovrdflg@ */ Scalar_BOOLEAN 0 SWC_INP_type_CM_boolean_flg 0.0 1.0 /end CHARACTERISTIC
/begin CHARACTERISTIC KINP_RrEDUDrtSta_flg_defval "" VALUE 0x0000 /* @ECU_Address@KINP_RrEDUDrtSta_flg_defval@ */ Scalar_BOOLEAN 0 SWC_INP_type_CM_boolean_flg 0.0 1.0 /end CHARACTERISTIC
/begin CHARACTERISTIC KINP_RrEDUDrtSta_flg_ovrdflg "" VALUE 0x0000 /* @ECU_Address@KINP_RrEDUDrtSta_flg_ovrdflg@ */ Scalar_BOOLEAN 0 SWC_INP_type_CM_boolean_flg 0.0 1.0 /end CHARACTERISTIC
/begin CHARACTERISTIC KINP_RrEDUDrtSta_flg_ovrdval "" VALUE 0x0000 /* @ECU_Address@KINP_RrEDUDrtSta_flg_ovrdval@ */ Scalar_BOOLEAN 0 SWC_INP_type_CM_boolean_flg 0.0 1.0 /end CHARACTERISTIC
/begin CHARACTERISTIC KINP_RrEDUOpratingSta_flg_defval "" VALUE 0x0000 /* @ECU_Address@KINP_RrEDUOpratingSta_flg_defval@ */ Scalar_BOOLEAN 0 SWC_INP_type_CM_boolean_flg 0.0 1.0 /end CHARACTERISTIC
/begin CHARACTERISTIC KINP_RrEDUOpratingSta_flg_ovrdflg "" VALUE 0x0000 /* @ECU_Address@KINP_RrEDUOpratingSta_flg_ovrdflg@ */ Scalar_BOOLEAN 0 SWC_INP_type_CM_boolean_flg 0.0 1.0 /end CHARACTERISTIC
/begin CHARACTERISTIC KINP_RrEDUOpratingSta_flg_ovrdval "" VALUE 0x0000 /* @ECU_Address@KINP_RrEDUOpratingSta_flg_ovrdval@ */ Scalar_BOOLEAN 0 SWC_INP_type_CM_boolean_flg 0.0 1.0 /end CHARACTERISTIC
/begin CHARACTERISTIC KINP_RrEDURealTMTq_Nm_ovrdflg "" VALUE 0x0000 /* @ECU_Address@KINP_RrEDURealTMTq_Nm_ovrdflg@ */ Scalar_BOOLEAN 0 SWC_INP_type_CM_boolean_flg 0.0 1.0 /end CHARACTERISTIC
/begin CHARACTERISTIC KINP_RrEDURotateDirction_enum_ovrdflg "" VALUE 0x0000 /* @ECU_Address@KINP_RrEDURotateDirction_enum_ovrdflg@ */ Scalar_BOOLEAN 0 SWC_INP_type_CM_boolean_flg 0.0 1.0 /end CHARACTERISTIC
/begin CHARACTERISTIC KINP_RrEDUTqReqFbk_Nm_ovrdflg "" VALUE 0x0000 /* @ECU_Address@KINP_RrEDUTqReqFbk_Nm_ovrdflg@ */ Scalar_BOOLEAN 0 SWC_INP_type_CM_boolean_flg 0.0 1.0 /end CHARACTERISTIC
/begin CHARACTERISTIC KINP_RrFailcode1_enum_ovrdflg "" VALUE 0x0000 /* @ECU_Address@KINP_RrFailcode1_enum_ovrdflg@ */ Scalar_BOOLEAN 0 SWC_INP_type_CM_boolean_flg 0.0 1.0 /end CHARACTERISTIC
/begin CHARACTERISTIC KINP_RrFailcode2_enum_ovrdflg "" VALUE 0x0000 /* @ECU_Address@KINP_RrFailcode2_enum_ovrdflg@ */ Scalar_BOOLEAN 0 SWC_INP_type_CM_boolean_flg 0.0 1.0 /end CHARACTERISTIC
/begin CHARACTERISTIC KINP_RrFailcodehistory1_enum_ovrdflg "" VALUE 0x0000 /* @ECU_Address@KINP_RrFailcodehistory1_enum_ovrdflg@ */ Scalar_BOOLEAN 0 SWC_INP_type_CM_boolean_flg 0.0 1.0 /end CHARACTERISTIC
/begin CHARACTERISTIC KINP_RrFailcodehistory2_enum_ovrdflg "" VALUE 0x0000 /* @ECU_Address@KINP_RrFailcodehistory2_enum_ovrdflg@ */ Scalar_BOOLEAN 0 SWC_INP_type_CM_boolean_flg 0.0 1.0 /end CHARACTERISTIC
/begin CHARACTERISTIC KINP_RrLLCTemp_C_ovrdflg "" VALUE 0x0000 /* @ECU_Address@KINP_RrLLCTemp_C_ovrdflg@ */ Scalar_BOOLEAN 0 SWC_INP_type_CM_boolean_flg 0.0 1.0 /end CHARACTERISTIC
/begin CHARACTERISTIC KINP_RrLLCflowReq_Lpmin_ovrdflg "" VALUE 0x0000 /* @ECU_Address@KINP_RrLLCflowReq_Lpmin_ovrdflg@ */ Scalar_BOOLEAN 0 SWC_INP_type_CM_boolean_flg 0.0 1.0 /end CHARACTERISTIC
/begin CHARACTERISTIC KINP_RrMCU1Chksum_enum_ovrdflg "" VALUE 0x0000 /* @ECU_Address@KINP_RrMCU1Chksum_enum_ovrdflg@ */ Scalar_BOOLEAN 0 SWC_INP_type_CM_boolean_flg 0.0 1.0 /end CHARACTERISTIC
/begin CHARACTERISTIC KINP_RrMCU1RolCnt_enum_ovrdflg "" VALUE 0x0000 /* @ECU_Address@KINP_RrMCU1RolCnt_enum_ovrdflg@ */ Scalar_BOOLEAN 0 SWC_INP_type_CM_boolean_flg 0.0 1.0 /end CHARACTERISTIC
/begin CHARACTERISTIC KINP_RrMCU3HWVer_enum_ovrdflg "" VALUE 0x0000 /* @ECU_Address@KINP_RrMCU3HWVer_enum_ovrdflg@ */ Scalar_BOOLEAN 0 SWC_INP_type_CM_boolean_flg 0.0 1.0 /end CHARACTERISTIC
/begin CHARACTERISTIC KINP_RrMCU3SWVer_enum_ovrdflg "" VALUE 0x0000 /* @ECU_Address@KINP_RrMCU3SWVer_enum_ovrdflg@ */ Scalar_BOOLEAN 0 SWC_INP_type_CM_boolean_flg 0.0 1.0 /end CHARACTERISTIC
/begin CHARACTERISTIC KINP_RrMCUBAT_V_ovrdflg "" VALUE 0x0000 /* @ECU_Address@KINP_RrMCUBAT_V_ovrdflg@ */ Scalar_BOOLEAN 0 SWC_INP_type_CM_boolean_flg 0.0 1.0 /end CHARACTERISTIC
/begin CHARACTERISTIC KINP_RrMCUDCBusCurr_A_ovrdflg "" VALUE 0x0000 /* @ECU_Address@KINP_RrMCUDCBusCurr_A_ovrdflg@ */ Scalar_BOOLEAN 0 SWC_INP_type_CM_boolean_flg 0.0 1.0 /end CHARACTERISTIC
/begin CHARACTERISTIC KINP_RrMCUDCBusVolt_V_ovrdflg "" VALUE 0x0000 /* @ECU_Address@KINP_RrMCUDCBusVolt_V_ovrdflg@ */ Scalar_BOOLEAN 0 SWC_INP_type_CM_boolean_flg 0.0 1.0 /end CHARACTERISTIC
/begin CHARACTERISTIC KINP_RrMCUDischrgSta_flg_defval "" VALUE 0x0000 /* @ECU_Address@KINP_RrMCUDischrgSta_flg_defval@ */ Scalar_BOOLEAN 0 SWC_INP_type_CM_boolean_flg 0.0 1.0 /end CHARACTERISTIC
/begin CHARACTERISTIC KINP_RrMCUDischrgSta_flg_ovrdflg "" VALUE 0x0000 /* @ECU_Address@KINP_RrMCUDischrgSta_flg_ovrdflg@ */ Scalar_BOOLEAN 0 SWC_INP_type_CM_boolean_flg 0.0 1.0 /end CHARACTERISTIC
/begin CHARACTERISTIC KINP_RrMCUDischrgSta_flg_ovrdval "" VALUE 0x0000 /* @ECU_Address@KINP_RrMCUDischrgSta_flg_ovrdval@ */ Scalar_BOOLEAN 0 SWC_INP_type_CM_boolean_flg 0.0 1.0 /end CHARACTERISTIC
/begin CHARACTERISTIC KINP_RrMCUEnaSta_flg_defval "" VALUE 0x0000 /* @ECU_Address@KINP_RrMCUEnaSta_flg_defval@ */ Scalar_BOOLEAN 0 SWC_INP_type_CM_boolean_flg 0.0 1.0 /end CHARACTERISTIC
/begin CHARACTERISTIC KINP_RrMCUEnaSta_flg_ovrdflg "" VALUE 0x0000 /* @ECU_Address@KINP_RrMCUEnaSta_flg_ovrdflg@ */ Scalar_BOOLEAN 0 SWC_INP_type_CM_boolean_flg 0.0 1.0 /end CHARACTERISTIC
/begin CHARACTERISTIC KINP_RrMCUEnaSta_flg_ovrdval "" VALUE 0x0000 /* @ECU_Address@KINP_RrMCUEnaSta_flg_ovrdval@ */ Scalar_BOOLEAN 0 SWC_INP_type_CM_boolean_flg 0.0 1.0 /end CHARACTERISTIC
/begin CHARACTERISTIC KINP_RrMCUErr_enum_ovrdflg "" VALUE 0x0000 /* @ECU_Address@KINP_RrMCUErr_enum_ovrdflg@ */ Scalar_BOOLEAN 0 SWC_INP_type_CM_boolean_flg 0.0 1.0 /end CHARACTERISTIC
/begin CHARACTERISTIC KINP_RrMCUIGNsta_flg_defval "" VALUE 0x0000 /* @ECU_Address@KINP_RrMCUIGNsta_flg_defval@ */ Scalar_BOOLEAN 0 SWC_INP_type_CM_boolean_flg 0.0 1.0 /end CHARACTERISTIC
/begin CHARACTERISTIC KINP_RrMCUIGNsta_flg_ovrdflg "" VALUE 0x0000 /* @ECU_Address@KINP_RrMCUIGNsta_flg_ovrdflg@ */ Scalar_BOOLEAN 0 SWC_INP_type_CM_boolean_flg 0.0 1.0 /end CHARACTERISTIC
/begin CHARACTERISTIC KINP_RrMCUIGNsta_flg_ovrdval "" VALUE 0x0000 /* @ECU_Address@KINP_RrMCUIGNsta_flg_ovrdval@ */ Scalar_BOOLEAN 0 SWC_INP_type_CM_boolean_flg 0.0 1.0 /end CHARACTERISTIC
/begin CHARACTERISTIC KINP_RrMCUReady4Pre_flg_defval "" VALUE 0x0000 /* @ECU_Address@KINP_RrMCUReady4Pre_flg_defval@ */ Scalar_BOOLEAN 0 SWC_INP_type_CM_boolean_flg 0.0 1.0 /end CHARACTERISTIC
/begin CHARACTERISTIC KINP_RrMCUReady4Pre_flg_ovrdflg "" VALUE 0x0000 /* @ECU_Address@KINP_RrMCUReady4Pre_flg_ovrdflg@ */ Scalar_BOOLEAN 0 SWC_INP_type_CM_boolean_flg 0.0 1.0 /end CHARACTERISTIC
/begin CHARACTERISTIC KINP_RrMCUReady4Pre_flg_ovrdval "" VALUE 0x0000 /* @ECU_Address@KINP_RrMCUReady4Pre_flg_ovrdval@ */ Scalar_BOOLEAN 0 SWC_INP_type_CM_boolean_flg 0.0 1.0 /end CHARACTERISTIC
/begin CHARACTERISTIC KINP_RrMCUReady_flg_defval "" VALUE 0x0000 /* @ECU_Address@KINP_RrMCUReady_flg_defval@ */ Scalar_BOOLEAN 0 SWC_INP_type_CM_boolean_flg 0.0 1.0 /end CHARACTERISTIC
/begin CHARACTERISTIC KINP_RrMCUReady_flg_ovrdflg "" VALUE 0x0000 /* @ECU_Address@KINP_RrMCUReady_flg_ovrdflg@ */ Scalar_BOOLEAN 0 SWC_INP_type_CM_boolean_flg 0.0 1.0 /end CHARACTERISTIC
/begin CHARACTERISTIC KINP_RrMCUReady_flg_ovrdval "" VALUE 0x0000 /* @ECU_Address@KINP_RrMCUReady_flg_ovrdval@ */ Scalar_BOOLEAN 0 SWC_INP_type_CM_boolean_flg 0.0 1.0 /end CHARACTERISTIC
/begin CHARACTERISTIC KINP_RrMCUSysSta_enum_ovrdflg "" VALUE 0x0000 /* @ECU_Address@KINP_RrMCUSysSta_enum_ovrdflg@ */ Scalar_BOOLEAN 0 SWC_INP_type_CM_boolean_flg 0.0 1.0 /end CHARACTERISTIC
/begin CHARACTERISTIC KINP_RrMCUTempWarn_enum_ovrdflg "" VALUE 0x0000 /* @ECU_Address@KINP_RrMCUTempWarn_enum_ovrdflg@ */ Scalar_BOOLEAN 0 SWC_INP_type_CM_boolean_flg 0.0 1.0 /end CHARACTERISTIC
/begin CHARACTERISTIC KINP_RrMCUTemp_C_ovrdflg "" VALUE 0x0000 /* @ECU_Address@KINP_RrMCUTemp_C_ovrdflg@ */ Scalar_BOOLEAN 0 SWC_INP_type_CM_boolean_flg 0.0 1.0 /end CHARACTERISTIC
/begin CHARACTERISTIC KINP_RrMotorAvailTq_Nm_ovrdflg "" VALUE 0x0000 /* @ECU_Address@KINP_RrMotorAvailTq_Nm_ovrdflg@ */ Scalar_BOOLEAN 0 SWC_INP_type_CM_boolean_flg 0.0 1.0 /end CHARACTERISTIC
/begin CHARACTERISTIC KINP_RrRegenAvailTq_Nm_ovrdflg "" VALUE 0x0000 /* @ECU_Address@KINP_RrRegenAvailTq_Nm_ovrdflg@ */ Scalar_BOOLEAN 0 SWC_INP_type_CM_boolean_flg 0.0 1.0 /end CHARACTERISTIC
/begin CHARACTERISTIC KINP_RrTMSpd_rpm_ovrdflg "" VALUE 0x0000 /* @ECU_Address@KINP_RrTMSpd_rpm_ovrdflg@ */ Scalar_BOOLEAN 0 SWC_INP_type_CM_boolean_flg 0.0 1.0 /end CHARACTERISTIC
/begin CHARACTERISTIC KINP_RrTMTempWarn_enum_ovrdflg "" VALUE 0x0000 /* @ECU_Address@KINP_RrTMTempWarn_enum_ovrdflg@ */ Scalar_BOOLEAN 0 SWC_INP_type_CM_boolean_flg 0.0 1.0 /end CHARACTERISTIC
/begin CHARACTERISTIC KINP_RrTMTemp_C_ovrdflg "" VALUE 0x0000 /* @ECU_Address@KINP_RrTMTemp_C_ovrdflg@ */ Scalar_BOOLEAN 0 SWC_INP_type_CM_boolean_flg 0.0 1.0 /end CHARACTERISTIC
/begin CHARACTERISTIC KINP_RrTMid_A_ovrdflg "" VALUE 0x0000 /* @ECU_Address@KINP_RrTMid_A_ovrdflg@ */ Scalar_BOOLEAN 0 SWC_INP_type_CM_boolean_flg 0.0 1.0 /end CHARACTERISTIC
/begin CHARACTERISTIC KINP_RrTMiq_A_ovrdflg "" VALUE 0x0000 /* @ECU_Address@KINP_RrTMiq_A_ovrdflg@ */ Scalar_BOOLEAN 0 SWC_INP_type_CM_boolean_flg 0.0 1.0 /end CHARACTERISTIC
/begin CHARACTERISTIC KINP_V2LSta_enum_ovrdflg "" VALUE 0x0000 /* @ECU_Address@KINP_V2LSta_enum_ovrdflg@ */ Scalar_BOOLEAN 0 SWC_INP_type_CM_boolean_flg 0.0 1.0 /end CHARACTERISTIC
/begin CHARACTERISTIC KINP_BMSChckSum1_enum_defval "" VALUE 0x0000 /* @ECU_Address@KINP_BMSChckSum1_enum_defval@ */ Scalar_UBYTE 0 SWC_INP_type_CM_uint8_enum 0.0 255.0 /end CHARACTERISTIC
/begin CHARACTERISTIC KINP_BMSChckSum1_enum_ovrdval "" VALUE 0x0000 /* @ECU_Address@KINP_BMSChckSum1_enum_ovrdval@ */ Scalar_UBYTE 0 SWC_INP_type_CM_uint8_enum 0.0 255.0 /end CHARACTERISTIC
/begin CHARACTERISTIC KINP_BMSChckSum_enum_defval "" VALUE 0x0000 /* @ECU_Address@KINP_BMSChckSum_enum_defval@ */ Scalar_UBYTE 0 SWC_INP_type_CM_uint8_enum 0.0 255.0 /end CHARACTERISTIC
/begin CHARACTERISTIC KINP_BMSChckSum_enum_ovrdval "" VALUE 0x0000 /* @ECU_Address@KINP_BMSChckSum_enum_ovrdval@ */ Scalar_UBYTE 0 SWC_INP_type_CM_uint8_enum 0.0 255.0 /end CHARACTERISTIC
/begin CHARACTERISTIC KINP_BMSRolCnct1_enum_defval "" VALUE 0x0000 /* @ECU_Address@KINP_BMSRolCnct1_enum_defval@ */ Scalar_UBYTE 0 SWC_INP_type_CM_uint8_enum 0.0 14.0 /end CHARACTERISTIC
/begin CHARACTERISTIC KINP_BMSRolCnct1_enum_ovrdval "" VALUE 0x0000 /* @ECU_Address@KINP_BMSRolCnct1_enum_ovrdval@ */ Scalar_UBYTE 0 SWC_INP_type_CM_uint8_enum 0.0 14.0 /end CHARACTERISTIC
/begin CHARACTERISTIC KINP_BMSRolCnct_enum_defval "" VALUE 0x0000 /* @ECU_Address@KINP_BMSRolCnct_enum_defval@ */ Scalar_UBYTE 0 SWC_INP_type_CM_uint8_enum 0.0 14.0 /end CHARACTERISTIC
/begin CHARACTERISTIC KINP_BMSRolCnct_enum_ovrdval "" VALUE 0x0000 /* @ECU_Address@KINP_BMSRolCnct_enum_ovrdval@ */ Scalar_UBYTE 0 SWC_INP_type_CM_uint8_enum 0.0 14.0 /end CHARACTERISTIC
/begin CHARACTERISTIC KINP_CSCCU1_enum_defval "" VALUE 0x0000 /* @ECU_Address@KINP_CSCCU1_enum_defval@ */ Scalar_UBYTE 0 SWC_INP_type_CM_uint8_enum 0.0 255.0 /end CHARACTERISTIC
/begin CHARACTERISTIC KINP_CSCCU1_enum_ovrdval "" VALUE 0x0000 /* @ECU_Address@KINP_CSCCU1_enum_ovrdval@ */ Scalar_UBYTE 0 SWC_INP_type_CM_uint8_enum 0.0 255.0 /end CHARACTERISTIC
/begin CHARACTERISTIC KINP_CSCCU2_enum_defval "" VALUE 0x0000 /* @ECU_Address@KINP_CSCCU2_enum_defval@ */ Scalar_UBYTE 0 SWC_INP_type_CM_uint8_enum 0.0 255.0 /end CHARACTERISTIC
/begin CHARACTERISTIC KINP_CSCCU2_enum_ovrdval "" VALUE 0x0000 /* @ECU_Address@KINP_CSCCU2_enum_ovrdval@ */ Scalar_UBYTE 0 SWC_INP_type_CM_uint8_enum 0.0 255.0 /end CHARACTERISTIC
/begin CHARACTERISTIC KINP_ChrgInLockReq_enum_defval "" VALUE 0x0000 /* @ECU_Address@KINP_ChrgInLockReq_enum_defval@ */ Scalar_UBYTE 0 SWC_INP_type_CM_uint8_enum 0.0 2.0 /end CHARACTERISTIC
/begin CHARACTERISTIC KINP_ChrgInLockReq_enum_ovrdval "" VALUE 0x0000 /* @ECU_Address@KINP_ChrgInLockReq_enum_ovrdval@ */ Scalar_UBYTE 0 SWC_INP_type_CM_uint8_enum 0.0 2.0 /end CHARACTERISTIC
/begin CHARACTERISTIC KINP_ChrgPlugSta_enum_defval "" VALUE 0x0000 /* @ECU_Address@KINP_ChrgPlugSta_enum_defval@ */ Scalar_UBYTE 0 SWC_INP_type_CM_uint8_enum 0.0 3.0 /end CHARACTERISTIC
/begin CHARACTERISTIC KINP_ChrgPlugSta_enum_ovrdval "" VALUE 0x0000 /* @ECU_Address@KINP_ChrgPlugSta_enum_ovrdval@ */ Scalar_UBYTE 0 SWC_INP_type_CM_uint8_enum 0.0 3.0 /end CHARACTERISTIC
/begin CHARACTERISTIC KINP_DCDCFaultSta_enum_defval "" VALUE 0x0000 /* @ECU_Address@KINP_DCDCFaultSta_enum_defval@ */ Scalar_UBYTE 0 SWC_INP_type_CM_uint8_enum 0.0 3.0 /end CHARACTERISTIC
/begin CHARACTERISTIC KINP_DCDCFaultSta_enum_ovrdval "" VALUE 0x0000 /* @ECU_Address@KINP_DCDCFaultSta_enum_ovrdval@ */ Scalar_UBYTE 0 SWC_INP_type_CM_uint8_enum 0.0 3.0 /end CHARACTERISTIC
/begin CHARACTERISTIC KINP_DCDCPreCompleted_enum_defval "" VALUE 0x0000 /* @ECU_Address@KINP_DCDCPreCompleted_enum_defval@ */ Scalar_UBYTE 0 SWC_INP_type_CM_uint8_enum 0.0 2.0 /end CHARACTERISTIC
/begin CHARACTERISTIC KINP_DCDCPreCompleted_enum_ovrdval "" VALUE 0x0000 /* @ECU_Address@KINP_DCDCPreCompleted_enum_ovrdval@ */ Scalar_UBYTE 0 SWC_INP_type_CM_uint8_enum 0.0 2.0 /end CHARACTERISTIC
/begin CHARACTERISTIC KINP_DisChrgPlugErr_enum_defval "" VALUE 0x0000 /* @ECU_Address@KINP_DisChrgPlugErr_enum_defval@ */ Scalar_UBYTE 0 SWC_INP_type_CM_uint8_enum 0.0 3.0 /end CHARACTERISTIC
/begin CHARACTERISTIC KINP_DisChrgPlugErr_enum_ovrdval "" VALUE 0x0000 /* @ECU_Address@KINP_DisChrgPlugErr_enum_ovrdval@ */ Scalar_UBYTE 0 SWC_INP_type_CM_uint8_enum 0.0 3.0 /end CHARACTERISTIC
/begin CHARACTERISTIC KINP_EBMErrSta_enum_defval "" VALUE 0x0000 /* @ECU_Address@KINP_EBMErrSta_enum_defval@ */ Scalar_UBYTE 0 SWC_INP_type_CM_uint8_enum 0.0 2.0 /end CHARACTERISTIC
/begin CHARACTERISTIC KINP_EBMErrSta_enum_ovrdval "" VALUE 0x0000 /* @ECU_Address@KINP_EBMErrSta_enum_ovrdval@ */ Scalar_UBYTE 0 SWC_INP_type_CM_uint8_enum 0.0 2.0 /end CHARACTERISTIC
/begin CHARACTERISTIC KINP_EBMRLampSta_enum_defval "" VALUE 0x0000 /* @ECU_Address@KINP_EBMRLampSta_enum_defval@ */ Scalar_UBYTE 0 SWC_INP_type_CM_uint8_enum 0.0 2.0 /end CHARACTERISTIC
/begin CHARACTERISTIC KINP_EBMRLampSta_enum_ovrdval "" VALUE 0x0000 /* @ECU_Address@KINP_EBMRLampSta_enum_ovrdval@ */ Scalar_UBYTE 0 SWC_INP_type_CM_uint8_enum 0.0 2.0 /end CHARACTERISTIC
/begin CHARACTERISTIC KINP_ExtChrgSta_enum_defval "" VALUE 0x0000 /* @ECU_Address@KINP_ExtChrgSta_enum_defval@ */ Scalar_UBYTE 0 SWC_INP_type_CM_uint8_enum 0.0 3.0 /end CHARACTERISTIC
/begin CHARACTERISTIC KINP_ExtChrgSta_enum_ovrdval "" VALUE 0x0000 /* @ECU_Address@KINP_ExtChrgSta_enum_ovrdval@ */ Scalar_UBYTE 0 SWC_INP_type_CM_uint8_enum 0.0 3.0 /end CHARACTERISTIC
/begin CHARACTERISTIC KINP_FrEDURotateDirctionNidec_enum_defval "" VALUE 0x0000 /* @ECU_Address@KINP_FrEDURotateDirctionNidec_enum_defval@ */ Scalar_UBYTE 0 SWC_INP_type_CM_uint8_enum 0.0 2.0 /end CHARACTERISTIC
/begin CHARACTERISTIC KINP_FrEDURotateDirctionNidec_enum_ovrdval "" VALUE 0x0000 /* @ECU_Address@KINP_FrEDURotateDirctionNidec_enum_ovrdval@ */ Scalar_UBYTE 0 SWC_INP_type_CM_uint8_enum 0.0 2.0 /end CHARACTERISTIC
/begin CHARACTERISTIC KINP_FrEDURotateDirction_enum_defval "" VALUE 0x0000 /* @ECU_Address@KINP_FrEDURotateDirction_enum_defval@ */ Scalar_UBYTE 0 SWC_INP_type_CM_uint8_enum 0.0 2.0 /end CHARACTERISTIC
/begin CHARACTERISTIC KINP_FrEDURotateDirction_enum_ovrdval "" VALUE 0x0000 /* @ECU_Address@KINP_FrEDURotateDirction_enum_ovrdval@ */ Scalar_UBYTE 0 SWC_INP_type_CM_uint8_enum 0.0 2.0 /end CHARACTERISTIC
/begin CHARACTERISTIC KINP_FrFailcode1Nidec_enum_defval "" VALUE 0x0000 /* @ECU_Address@KINP_FrFailcode1Nidec_enum_defval@ */ Scalar_UBYTE 0 SWC_INP_type_CM_uint8_enum 0.0 255.0 /end CHARACTERISTIC
/begin CHARACTERISTIC KINP_FrFailcode1Nidec_enum_ovrdval "" VALUE 0x0000 /* @ECU_Address@KINP_FrFailcode1Nidec_enum_ovrdval@ */ Scalar_UBYTE 0 SWC_INP_type_CM_uint8_enum 0.0 255.0 /end CHARACTERISTIC
/begin CHARACTERISTIC KINP_FrFailcode1_enum_defval "" VALUE 0x0000 /* @ECU_Address@KINP_FrFailcode1_enum_defval@ */ Scalar_UBYTE 0 SWC_INP_type_CM_uint8_enum 0.0 255.0 /end CHARACTERISTIC
/begin CHARACTERISTIC KINP_FrFailcode1_enum_ovrdval "" VALUE 0x0000 /* @ECU_Address@KINP_FrFailcode1_enum_ovrdval@ */ Scalar_UBYTE 0 SWC_INP_type_CM_uint8_enum 0.0 255.0 /end CHARACTERISTIC
/begin CHARACTERISTIC KINP_FrFailcode2Nidec_enum_defval "" VALUE 0x0000 /* @ECU_Address@KINP_FrFailcode2Nidec_enum_defval@ */ Scalar_UBYTE 0 SWC_INP_type_CM_uint8_enum 0.0 255.0 /end CHARACTERISTIC
/begin CHARACTERISTIC KINP_FrFailcode2Nidec_enum_ovrdval "" VALUE 0x0000 /* @ECU_Address@KINP_FrFailcode2Nidec_enum_ovrdval@ */ Scalar_UBYTE 0 SWC_INP_type_CM_uint8_enum 0.0 255.0 /end CHARACTERISTIC
/begin CHARACTERISTIC KINP_FrFailcode2_enum_defval "" VALUE 0x0000 /* @ECU_Address@KINP_FrFailcode2_enum_defval@ */ Scalar_UBYTE 0 SWC_INP_type_CM_uint8_enum 0.0 255.0 /end CHARACTERISTIC
/begin CHARACTERISTIC KINP_FrFailcode2_enum_ovrdval "" VALUE 0x0000 /* @ECU_Address@KINP_FrFailcode2_enum_ovrdval@ */ Scalar_UBYTE 0 SWC_INP_type_CM_uint8_enum 0.0 255.0 /end CHARACTERISTIC
/begin CHARACTERISTIC KINP_FrFailcodehistory1Nidec_enum_defval "" VALUE 0x0000 /* @ECU_Address@KINP_FrFailcodehistory1Nidec_enum_defval@ */ Scalar_UBYTE 0 SWC_INP_type_CM_uint8_enum 0.0 2.0 /end CHARACTERISTIC
/begin CHARACTERISTIC KINP_FrFailcodehistory1Nidec_enum_ovrdval "" VALUE 0x0000 /* @ECU_Address@KINP_FrFailcodehistory1Nidec_enum_ovrdval@ */ Scalar_UBYTE 0 SWC_INP_type_CM_uint8_enum 0.0 2.0 /end CHARACTERISTIC
/begin CHARACTERISTIC KINP_FrFailcodehistory1_enum_defval "" VALUE 0x0000 /* @ECU_Address@KINP_FrFailcodehistory1_enum_defval@ */ Scalar_UBYTE 0 SWC_INP_type_CM_uint8_enum 0.0 2.0 /end CHARACTERISTIC
/begin CHARACTERISTIC KINP_FrFailcodehistory1_enum_ovrdval "" VALUE 0x0000 /* @ECU_Address@KINP_FrFailcodehistory1_enum_ovrdval@ */ Scalar_UBYTE 0 SWC_INP_type_CM_uint8_enum 0.0 2.0 /end CHARACTERISTIC
/begin CHARACTERISTIC KINP_FrFailcodehistory2_enum_defval "" VALUE 0x0000 /* @ECU_Address@KINP_FrFailcodehistory2_enum_defval@ */ Scalar_UBYTE 0 SWC_INP_type_CM_uint8_enum 0.0 2.0 /end CHARACTERISTIC
/begin CHARACTERISTIC KINP_FrFailcodehistory2_enum_ovrdval "" VALUE 0x0000 /* @ECU_Address@KINP_FrFailcodehistory2_enum_ovrdval@ */ Scalar_UBYTE 0 SWC_INP_type_CM_uint8_enum 0.0 2.0 /end CHARACTERISTIC
/begin CHARACTERISTIC KINP_FrMCU1ChksumNidec_enum_defval "" VALUE 0x0000 /* @ECU_Address@KINP_FrMCU1ChksumNidec_enum_defval@ */ Scalar_UBYTE 0 SWC_INP_type_CM_uint8_enum 0.0 255.0 /end CHARACTERISTIC
/begin CHARACTERISTIC KINP_FrMCU1ChksumNidec_enum_ovrdval "" VALUE 0x0000 /* @ECU_Address@KINP_FrMCU1ChksumNidec_enum_ovrdval@ */ Scalar_UBYTE 0 SWC_INP_type_CM_uint8_enum 0.0 255.0 /end CHARACTERISTIC
/begin CHARACTERISTIC KINP_FrMCU1Chksum_enum_defval "" VALUE 0x0000 /* @ECU_Address@KINP_FrMCU1Chksum_enum_defval@ */ Scalar_UBYTE 0 SWC_INP_type_CM_uint8_enum 0.0 255.0 /end CHARACTERISTIC
/begin CHARACTERISTIC KINP_FrMCU1Chksum_enum_ovrdval "" VALUE 0x0000 /* @ECU_Address@KINP_FrMCU1Chksum_enum_ovrdval@ */ Scalar_UBYTE 0 SWC_INP_type_CM_uint8_enum 0.0 255.0 /end CHARACTERISTIC
/begin CHARACTERISTIC KINP_FrMCU1RolCntNidec_enum_defval "" VALUE 0x0000 /* @ECU_Address@KINP_FrMCU1RolCntNidec_enum_defval@ */ Scalar_UBYTE 0 SWC_INP_type_CM_uint8_enum 0.0 15.0 /end CHARACTERISTIC
/begin CHARACTERISTIC KINP_FrMCU1RolCntNidec_enum_ovrdval "" VALUE 0x0000 /* @ECU_Address@KINP_FrMCU1RolCntNidec_enum_ovrdval@ */ Scalar_UBYTE 0 SWC_INP_type_CM_uint8_enum 0.0 15.0 /end CHARACTERISTIC
/begin CHARACTERISTIC KINP_FrMCU1RolCnt_enum_defval "" VALUE 0x0000 /* @ECU_Address@KINP_FrMCU1RolCnt_enum_defval@ */ Scalar_UBYTE 0 SWC_INP_type_CM_uint8_enum 0.0 14.0 /end CHARACTERISTIC
/begin CHARACTERISTIC KINP_FrMCU1RolCnt_enum_ovrdval "" VALUE 0x0000 /* @ECU_Address@KINP_FrMCU1RolCnt_enum_ovrdval@ */ Scalar_UBYTE 0 SWC_INP_type_CM_uint8_enum 0.0 14.0 /end CHARACTERISTIC
/begin CHARACTERISTIC KINP_FrMCUErrNidec_enum_defval "" VALUE 0x0000 /* @ECU_Address@KINP_FrMCUErrNidec_enum_defval@ */ Scalar_UBYTE 0 SWC_INP_type_CM_uint8_enum 0.0 255.0 /end CHARACTERISTIC
/begin CHARACTERISTIC KINP_FrMCUErrNidec_enum_ovrdval "" VALUE 0x0000 /* @ECU_Address@KINP_FrMCUErrNidec_enum_ovrdval@ */ Scalar_UBYTE 0 SWC_INP_type_CM_uint8_enum 0.0 255.0 /end CHARACTERISTIC
/begin CHARACTERISTIC KINP_FrMCUErr_enum_defval "" VALUE 0x0000 /* @ECU_Address@KINP_FrMCUErr_enum_defval@ */ Scalar_UBYTE 0 SWC_INP_type_CM_uint8_enum 0.0 255.0 /end CHARACTERISTIC
/begin CHARACTERISTIC KINP_FrMCUErr_enum_ovrdval "" VALUE 0x0000 /* @ECU_Address@KINP_FrMCUErr_enum_ovrdval@ */ Scalar_UBYTE 0 SWC_INP_type_CM_uint8_enum 0.0 255.0 /end CHARACTERISTIC
/begin CHARACTERISTIC KINP_FrMCUSysStaNidec_enum_defval "" VALUE 0x0000 /* @ECU_Address@KINP_FrMCUSysStaNidec_enum_defval@ */ Scalar_UBYTE 0 SWC_INP_type_CM_uint8_enum 0.0 15.0 /end CHARACTERISTIC
/begin CHARACTERISTIC KINP_FrMCUSysStaNidec_enum_ovrdval "" VALUE 0x0000 /* @ECU_Address@KINP_FrMCUSysStaNidec_enum_ovrdval@ */ Scalar_UBYTE 0 SWC_INP_type_CM_uint8_enum 0.0 15.0 /end CHARACTERISTIC
/begin CHARACTERISTIC KINP_FrMCUSysSta_enum_defval "" VALUE 0x0000 /* @ECU_Address@KINP_FrMCUSysSta_enum_defval@ */ Scalar_UBYTE 0 SWC_INP_type_CM_uint8_enum 0.0 15.0 /end CHARACTERISTIC
/begin CHARACTERISTIC KINP_FrMCUSysSta_enum_ovrdval "" VALUE 0x0000 /* @ECU_Address@KINP_FrMCUSysSta_enum_ovrdval@ */ Scalar_UBYTE 0 SWC_INP_type_CM_uint8_enum 0.0 15.0 /end CHARACTERISTIC
/begin CHARACTERISTIC KINP_FrMCUTempWarn_enum_defval "" VALUE 0x0000 /* @ECU_Address@KINP_FrMCUTempWarn_enum_defval@ */ Scalar_UBYTE 0 SWC_INP_type_CM_uint8_enum 0.0 3.0 /end CHARACTERISTIC
/begin CHARACTERISTIC KINP_FrMCUTempWarn_enum_ovrdval "" VALUE 0x0000 /* @ECU_Address@KINP_FrMCUTempWarn_enum_ovrdval@ */ Scalar_UBYTE 0 SWC_INP_type_CM_uint8_enum 0.0 3.0 /end CHARACTERISTIC
/begin CHARACTERISTIC KINP_FrTMTempWarn_enum_defval "" VALUE 0x0000 /* @ECU_Address@KINP_FrTMTempWarn_enum_defval@ */ Scalar_UBYTE 0 SWC_INP_type_CM_uint8_enum 0.0 3.0 /end CHARACTERISTIC
/begin CHARACTERISTIC KINP_FrTMTempWarn_enum_ovrdval "" VALUE 0x0000 /* @ECU_Address@KINP_FrTMTempWarn_enum_ovrdval@ */ Scalar_UBYTE 0 SWC_INP_type_CM_uint8_enum 0.0 3.0 /end CHARACTERISTIC
/begin CHARACTERISTIC KINP_HVBChrgErr_enum_defval "" VALUE 0x0000 /* @ECU_Address@KINP_HVBChrgErr_enum_defval@ */ Scalar_UBYTE 0 SWC_INP_type_CM_uint8_enum 0.0 255.0 /end CHARACTERISTIC
/begin CHARACTERISTIC KINP_HVBChrgErr_enum_ovrdval "" VALUE 0x0000 /* @ECU_Address@KINP_HVBChrgErr_enum_ovrdval@ */ Scalar_UBYTE 0 SWC_INP_type_CM_uint8_enum 0.0 255.0 /end CHARACTERISTIC
/begin CHARACTERISTIC KINP_HVBOvrTempWarn_enum_defval "" VALUE 0x0000 /* @ECU_Address@KINP_HVBOvrTempWarn_enum_defval@ */ Scalar_UBYTE 0 SWC_INP_type_CM_uint8_enum 0.0 2.0 /end CHARACTERISTIC
/begin CHARACTERISTIC KINP_HVBOvrTempWarn_enum_ovrdval "" VALUE 0x0000 /* @ECU_Address@KINP_HVBOvrTempWarn_enum_ovrdval@ */ Scalar_UBYTE 0 SWC_INP_type_CM_uint8_enum 0.0 2.0 /end CHARACTERISTIC
/begin CHARACTERISTIC KINP_HVBPreheatPrecoolSta_enum_defval "" VALUE 0x0000 /* @ECU_Address@KINP_HVBPreheatPrecoolSta_enum_defval@ */ Scalar_UBYTE 0 SWC_INP_type_CM_uint8_enum 0.0 2.0 /end CHARACTERISTIC
/begin CHARACTERISTIC KINP_HVBPreheatPrecoolSta_enum_ovrdval "" VALUE 0x0000 /* @ECU_Address@KINP_HVBPreheatPrecoolSta_enum_ovrdval@ */ Scalar_UBYTE 0 SWC_INP_type_CM_uint8_enum 0.0 2.0 /end CHARACTERISTIC
/begin CHARACTERISTIC KINP_HVBattReady4Pre_enum_defval "" VALUE 0x0000 /* @ECU_Address@KINP_HVBattReady4Pre_enum_defval@ */ Scalar_UBYTE 0 SWC_INP_type_CM_uint8_enum 0.0 2.0 /end CHARACTERISTIC
/begin CHARACTERISTIC KINP_HVBattReady4Pre_enum_ovrdval "" VALUE 0x0000 /* @ECU_Address@KINP_HVBattReady4Pre_enum_ovrdval@ */ Scalar_UBYTE 0 SWC_INP_type_CM_uint8_enum 0.0 2.0 /end CHARACTERISTIC
/begin CHARACTERISTIC KINP_IVIRSEATventCmd_enum_defval "" VALUE 0x0000 /* @ECU_Address@KINP_IVIRSEATventCmd_enum_defval@ */ Scalar_UBYTE 0 SWC_INP_type_CM_uint8_enum 0.0 7.0 /end CHARACTERISTIC
/begin CHARACTERISTIC KINP_IVIRSEATventCmd_enum_ovrdval "" VALUE 0x0000 /* @ECU_Address@KINP_IVIRSEATventCmd_enum_ovrdval@ */ Scalar_UBYTE 0 SWC_INP_type_CM_uint8_enum 0.0 7.0 /end CHARACTERISTIC
/begin CHARACTERISTIC KINP_MCUBFLLCTempWarnSta_enum_defval "" VALUE 0x0000 /* @ECU_Address@KINP_MCUBFLLCTempWarnSta_enum_defval@ */ Scalar_UBYTE 0 SWC_INP_type_CM_uint8_enum 0.0 3.0 /end CHARACTERISTIC
/begin CHARACTERISTIC KINP_MCUBFLLCTempWarnSta_enum_ovrdval "" VALUE 0x0000 /* @ECU_Address@KINP_MCUBFLLCTempWarnSta_enum_ovrdval@ */ Scalar_UBYTE 0 SWC_INP_type_CM_uint8_enum 0.0 3.0 /end CHARACTERISTIC
/begin CHARACTERISTIC KINP_MCUBRLLCTempWarnSta_enum_defval "" VALUE 0x0000 /* @ECU_Address@KINP_MCUBRLLCTempWarnSta_enum_defval@ */ Scalar_UBYTE 0 SWC_INP_type_CM_uint8_enum 0.0 3.0 /end CHARACTERISTIC
/begin CHARACTERISTIC KINP_MCUBRLLCTempWarnSta_enum_ovrdval "" VALUE 0x0000 /* @ECU_Address@KINP_MCUBRLLCTempWarnSta_enum_ovrdval@ */ Scalar_UBYTE 0 SWC_INP_type_CM_uint8_enum 0.0 3.0 /end CHARACTERISTIC
/begin CHARACTERISTIC KINP_MCUWarnFNidec_enum_defval "" VALUE 0x0000 /* @ECU_Address@KINP_MCUWarnFNidec_enum_defval@ */ Scalar_UBYTE 0 SWC_INP_type_CM_uint8_enum 0.0 7.0 /end CHARACTERISTIC
/begin CHARACTERISTIC KINP_MCUWarnFNidec_enum_ovrdval "" VALUE 0x0000 /* @ECU_Address@KINP_MCUWarnFNidec_enum_ovrdval@ */ Scalar_UBYTE 0 SWC_INP_type_CM_uint8_enum 0.0 7.0 /end CHARACTERISTIC
/begin CHARACTERISTIC KINP_MCUWarnF_enum_defval "" VALUE 0x0000 /* @ECU_Address@KINP_MCUWarnF_enum_defval@ */ Scalar_UBYTE 0 SWC_INP_type_CM_uint8_enum 0.0 7.0 /end CHARACTERISTIC
/begin CHARACTERISTIC KINP_MCUWarnF_enum_ovrdval "" VALUE 0x0000 /* @ECU_Address@KINP_MCUWarnF_enum_ovrdval@ */ Scalar_UBYTE 0 SWC_INP_type_CM_uint8_enum 0.0 7.0 /end CHARACTERISTIC
/begin CHARACTERISTIC KINP_MCUWarnR_enum_defval "" VALUE 0x0000 /* @ECU_Address@KINP_MCUWarnR_enum_defval@ */ Scalar_UBYTE 0 SWC_INP_type_CM_uint8_enum 0.0 7.0 /end CHARACTERISTIC
/begin CHARACTERISTIC KINP_MCUWarnR_enum_ovrdval "" VALUE 0x0000 /* @ECU_Address@KINP_MCUWarnR_enum_ovrdval@ */ Scalar_UBYTE 0 SWC_INP_type_CM_uint8_enum 0.0 7.0 /end CHARACTERISTIC
/begin CHARACTERISTIC KINP_MainRlyNegSta_enum_defval "" VALUE 0x0000 /* @ECU_Address@KINP_MainRlyNegSta_enum_defval@ */ Scalar_UBYTE 0 SWC_INP_type_CM_uint8_enum 0.0 255.0 /end CHARACTERISTIC
/begin CHARACTERISTIC KINP_MainRlyNegSta_enum_ovrdval "" VALUE 0x0000 /* @ECU_Address@KINP_MainRlyNegSta_enum_ovrdval@ */ Scalar_UBYTE 0 SWC_INP_type_CM_uint8_enum 0.0 255.0 /end CHARACTERISTIC
/begin CHARACTERISTIC KINP_MainRlyPosSta_enum_defval "" VALUE 0x0000 /* @ECU_Address@KINP_MainRlyPosSta_enum_defval@ */ Scalar_UBYTE 0 SWC_INP_type_CM_uint8_enum 0.0 255.0 /end CHARACTERISTIC
/begin CHARACTERISTIC KINP_MainRlyPosSta_enum_ovrdval "" VALUE 0x0000 /* @ECU_Address@KINP_MainRlyPosSta_enum_ovrdval@ */ Scalar_UBYTE 0 SWC_INP_type_CM_uint8_enum 0.0 255.0 /end CHARACTERISTIC
/begin CHARACTERISTIC KINP_MaxCellTempNum_enum_defval "" VALUE 0x0000 /* @ECU_Address@KINP_MaxCellTempNum_enum_defval@ */ Scalar_UBYTE 0 SWC_INP_type_CM_uint8_enum 0.0 253.0 /end CHARACTERISTIC
/begin CHARACTERISTIC KINP_MaxCellTempNum_enum_ovrdval "" VALUE 0x0000 /* @ECU_Address@KINP_MaxCellTempNum_enum_ovrdval@ */ Scalar_UBYTE 0 SWC_INP_type_CM_uint8_enum 0.0 253.0 /end CHARACTERISTIC
/begin CHARACTERISTIC KINP_MaxCellVoltNum_enum_defval "" VALUE 0x0000 /* @ECU_Address@KINP_MaxCellVoltNum_enum_defval@ */ Scalar_UBYTE 0 SWC_INP_type_CM_uint8_enum 0.0 253.0 /end CHARACTERISTIC
/begin CHARACTERISTIC KINP_MaxCellVoltNum_enum_ovrdval "" VALUE 0x0000 /* @ECU_Address@KINP_MaxCellVoltNum_enum_ovrdval@ */ Scalar_UBYTE 0 SWC_INP_type_CM_uint8_enum 0.0 253.0 /end CHARACTERISTIC
/begin CHARACTERISTIC KINP_MinCellTempNum_enum_defval "" VALUE 0x0000 /* @ECU_Address@KINP_MinCellTempNum_enum_defval@ */ Scalar_UBYTE 0 SWC_INP_type_CM_uint8_enum 0.0 253.0 /end CHARACTERISTIC
/begin CHARACTERISTIC KINP_MinCellTempNum_enum_ovrdval "" VALUE 0x0000 /* @ECU_Address@KINP_MinCellTempNum_enum_ovrdval@ */ Scalar_UBYTE 0 SWC_INP_type_CM_uint8_enum 0.0 253.0 /end CHARACTERISTIC
/begin CHARACTERISTIC KINP_MinCellVoltNum_enum_defval "" VALUE 0x0000 /* @ECU_Address@KINP_MinCellVoltNum_enum_defval@ */ Scalar_UBYTE 0 SWC_INP_type_CM_uint8_enum 0.0 253.0 /end CHARACTERISTIC
/begin CHARACTERISTIC KINP_MinCellVoltNum_enum_ovrdval "" VALUE 0x0000 /* @ECU_Address@KINP_MinCellVoltNum_enum_ovrdval@ */ Scalar_UBYTE 0 SWC_INP_type_CM_uint8_enum 0.0 253.0 /end CHARACTERISTIC
/begin CHARACTERISTIC KINP_OBCACCurLim_enum_defval "" VALUE 0x0000 /* @ECU_Address@KINP_OBCACCurLim_enum_defval@ */ Scalar_UBYTE 0 SWC_INP_type_CM_uint8_enum 0.0 3.0 /end CHARACTERISTIC
/begin CHARACTERISTIC KINP_OBCACCurLim_enum_ovrdval "" VALUE 0x0000 /* @ECU_Address@KINP_OBCACCurLim_enum_ovrdval@ */ Scalar_UBYTE 0 SWC_INP_type_CM_uint8_enum 0.0 3.0 /end CHARACTERISTIC
/begin CHARACTERISTIC KINP_OBCFaultSta_enum_defval "" VALUE 0x0000 /* @ECU_Address@KINP_OBCFaultSta_enum_defval@ */ Scalar_UBYTE 0 SWC_INP_type_CM_uint8_enum 0.0 3.0 /end CHARACTERISTIC
/begin CHARACTERISTIC KINP_OBCFaultSta_enum_ovrdval "" VALUE 0x0000 /* @ECU_Address@KINP_OBCFaultSta_enum_ovrdval@ */ Scalar_UBYTE 0 SWC_INP_type_CM_uint8_enum 0.0 3.0 /end CHARACTERISTIC
/begin CHARACTERISTIC KINP_OBCPreCompleted_enum_defval "" VALUE 0x0000 /* @ECU_Address@KINP_OBCPreCompleted_enum_defval@ */ Scalar_UBYTE 0 SWC_INP_type_CM_uint8_enum 0.0 2.0 /end CHARACTERISTIC
/begin CHARACTERISTIC KINP_OBCPreCompleted_enum_ovrdval "" VALUE 0x0000 /* @ECU_Address@KINP_OBCPreCompleted_enum_ovrdval@ */ Scalar_UBYTE 0 SWC_INP_type_CM_uint8_enum 0.0 2.0 /end CHARACTERISTIC
/begin CHARACTERISTIC KINP_OBCV2LSta_enum_defval "" VALUE 0x0000 /* @ECU_Address@KINP_OBCV2LSta_enum_defval@ */ Scalar_UBYTE 0 SWC_INP_type_CM_uint8_enum 0.0 2.0 /end CHARACTERISTIC
/begin CHARACTERISTIC KINP_OBCV2LSta_enum_ovrdval "" VALUE 0x0000 /* @ECU_Address@KINP_OBCV2LSta_enum_ovrdval@ */ Scalar_UBYTE 0 SWC_INP_type_CM_uint8_enum 0.0 2.0 /end CHARACTERISTIC
/begin CHARACTERISTIC KINP_RCCCU1_enum_defval "" VALUE 0x0000 /* @ECU_Address@KINP_RCCCU1_enum_defval@ */ Scalar_UBYTE 0 SWC_INP_type_CM_uint8_enum 0.0 14.0 /end CHARACTERISTIC
/begin CHARACTERISTIC KINP_RCCCU1_enum_ovrdval "" VALUE 0x0000 /* @ECU_Address@KINP_RCCCU1_enum_ovrdval@ */ Scalar_UBYTE 0 SWC_INP_type_CM_uint8_enum 0.0 14.0 /end CHARACTERISTIC
/begin CHARACTERISTIC KINP_RCCCU2_enum_defval "" VALUE 0x0000 /* @ECU_Address@KINP_RCCCU2_enum_defval@ */ Scalar_UBYTE 0 SWC_INP_type_CM_uint8_enum 0.0 14.0 /end CHARACTERISTIC
/begin CHARACTERISTIC KINP_RCCCU2_enum_ovrdval "" VALUE 0x0000 /* @ECU_Address@KINP_RCCCU2_enum_ovrdval@ */ Scalar_UBYTE 0 SWC_INP_type_CM_uint8_enum 0.0 14.0 /end CHARACTERISTIC
/begin CHARACTERISTIC KINP_RrEDURotateDirction_enum_defval "" VALUE 0x0000 /* @ECU_Address@KINP_RrEDURotateDirction_enum_defval@ */ Scalar_UBYTE 0 SWC_INP_type_CM_uint8_enum 0.0 2.0 /end CHARACTERISTIC
/begin CHARACTERISTIC KINP_RrEDURotateDirction_enum_ovrdval "" VALUE 0x0000 /* @ECU_Address@KINP_RrEDURotateDirction_enum_ovrdval@ */ Scalar_UBYTE 0 SWC_INP_type_CM_uint8_enum 0.0 2.0 /end CHARACTERISTIC
/begin CHARACTERISTIC KINP_RrFailcode1_enum_defval "" VALUE 0x0000 /* @ECU_Address@KINP_RrFailcode1_enum_defval@ */ Scalar_UBYTE 0 SWC_INP_type_CM_uint8_enum 0.0 255.0 /end CHARACTERISTIC
/begin CHARACTERISTIC KINP_RrFailcode1_enum_ovrdval "" VALUE 0x0000 /* @ECU_Address@KINP_RrFailcode1_enum_ovrdval@ */ Scalar_UBYTE 0 SWC_INP_type_CM_uint8_enum 0.0 255.0 /end CHARACTERISTIC
/begin CHARACTERISTIC KINP_RrFailcode2_enum_defval "" VALUE 0x0000 /* @ECU_Address@KINP_RrFailcode2_enum_defval@ */ Scalar_UBYTE 0 SWC_INP_type_CM_uint8_enum 0.0 255.0 /end CHARACTERISTIC
/begin CHARACTERISTIC KINP_RrFailcode2_enum_ovrdval "" VALUE 0x0000 /* @ECU_Address@KINP_RrFailcode2_enum_ovrdval@ */ Scalar_UBYTE 0 SWC_INP_type_CM_uint8_enum 0.0 255.0 /end CHARACTERISTIC
/begin CHARACTERISTIC KINP_RrFailcodehistory1_enum_defval "" VALUE 0x0000 /* @ECU_Address@KINP_RrFailcodehistory1_enum_defval@ */ Scalar_UBYTE 0 SWC_INP_type_CM_uint8_enum 0.0 2.0 /end CHARACTERISTIC
/begin CHARACTERISTIC KINP_RrFailcodehistory1_enum_ovrdval "" VALUE 0x0000 /* @ECU_Address@KINP_RrFailcodehistory1_enum_ovrdval@ */ Scalar_UBYTE 0 SWC_INP_type_CM_uint8_enum 0.0 2.0 /end CHARACTERISTIC
/begin CHARACTERISTIC KINP_RrFailcodehistory2_enum_defval "" VALUE 0x0000 /* @ECU_Address@KINP_RrFailcodehistory2_enum_defval@ */ Scalar_UBYTE 0 SWC_INP_type_CM_uint8_enum 0.0 2.0 /end CHARACTERISTIC
/begin CHARACTERISTIC KINP_RrFailcodehistory2_enum_ovrdval "" VALUE 0x0000 /* @ECU_Address@KINP_RrFailcodehistory2_enum_ovrdval@ */ Scalar_UBYTE 0 SWC_INP_type_CM_uint8_enum 0.0 2.0 /end CHARACTERISTIC
/begin CHARACTERISTIC KINP_RrMCU1Chksum_enum_defval "" VALUE 0x0000 /* @ECU_Address@KINP_RrMCU1Chksum_enum_defval@ */ Scalar_UBYTE 0 SWC_INP_type_CM_uint8_enum 0.0 255.0 /end CHARACTERISTIC
/begin CHARACTERISTIC KINP_RrMCU1Chksum_enum_ovrdval "" VALUE 0x0000 /* @ECU_Address@KINP_RrMCU1Chksum_enum_ovrdval@ */ Scalar_UBYTE 0 SWC_INP_type_CM_uint8_enum 0.0 255.0 /end CHARACTERISTIC
/begin CHARACTERISTIC KINP_RrMCU1RolCnt_enum_defval "" VALUE 0x0000 /* @ECU_Address@KINP_RrMCU1RolCnt_enum_defval@ */ Scalar_UBYTE 0 SWC_INP_type_CM_uint8_enum 0.0 14.0 /end CHARACTERISTIC
/begin CHARACTERISTIC KINP_RrMCU1RolCnt_enum_ovrdval "" VALUE 0x0000 /* @ECU_Address@KINP_RrMCU1RolCnt_enum_ovrdval@ */ Scalar_UBYTE 0 SWC_INP_type_CM_uint8_enum 0.0 14.0 /end CHARACTERISTIC
/begin CHARACTERISTIC KINP_RrMCUErr_enum_defval "" VALUE 0x0000 /* @ECU_Address@KINP_RrMCUErr_enum_defval@ */ Scalar_UBYTE 0 SWC_INP_type_CM_uint8_enum 0.0 255.0 /end CHARACTERISTIC
/begin CHARACTERISTIC KINP_RrMCUErr_enum_ovrdval "" VALUE 0x0000 /* @ECU_Address@KINP_RrMCUErr_enum_ovrdval@ */ Scalar_UBYTE 0 SWC_INP_type_CM_uint8_enum 0.0 255.0 /end CHARACTERISTIC
/begin CHARACTERISTIC KINP_RrMCUSysSta_enum_defval "" VALUE 0x0000 /* @ECU_Address@KINP_RrMCUSysSta_enum_defval@ */ Scalar_UBYTE 0 SWC_INP_type_CM_uint8_enum 0.0 15.0 /end CHARACTERISTIC
/begin CHARACTERISTIC KINP_RrMCUSysSta_enum_ovrdval "" VALUE 0x0000 /* @ECU_Address@KINP_RrMCUSysSta_enum_ovrdval@ */ Scalar_UBYTE 0 SWC_INP_type_CM_uint8_enum 0.0 15.0 /end CHARACTERISTIC
/begin CHARACTERISTIC KINP_RrMCUTempWarn_enum_defval "" VALUE 0x0000 /* @ECU_Address@KINP_RrMCUTempWarn_enum_defval@ */ Scalar_UBYTE 0 SWC_INP_type_CM_uint8_enum 0.0 3.0 /end CHARACTERISTIC
/begin CHARACTERISTIC KINP_RrMCUTempWarn_enum_ovrdval "" VALUE 0x0000 /* @ECU_Address@KINP_RrMCUTempWarn_enum_ovrdval@ */ Scalar_UBYTE 0 SWC_INP_type_CM_uint8_enum 0.0 3.0 /end CHARACTERISTIC
/begin CHARACTERISTIC KINP_RrTMTempWarn_enum_defval "" VALUE 0x0000 /* @ECU_Address@KINP_RrTMTempWarn_enum_defval@ */ Scalar_UBYTE 0 SWC_INP_type_CM_uint8_enum 0.0 3.0 /end CHARACTERISTIC
/begin CHARACTERISTIC KINP_RrTMTempWarn_enum_ovrdval "" VALUE 0x0000 /* @ECU_Address@KINP_RrTMTempWarn_enum_ovrdval@ */ Scalar_UBYTE 0 SWC_INP_type_CM_uint8_enum 0.0 3.0 /end CHARACTERISTIC
/begin CHARACTERISTIC KINP_V2LSta_enum_defval "" VALUE 0x0000 /* @ECU_Address@KINP_V2LSta_enum_defval@ */ Scalar_UBYTE 0 SWC_INP_type_CM_uint8_enum 0.0 3.0 /end CHARACTERISTIC
/begin CHARACTERISTIC KINP_V2LSta_enum_ovrdval "" VALUE 0x0000 /* @ECU_Address@KINP_V2LSta_enum_ovrdval@ */ Scalar_UBYTE 0 SWC_INP_type_CM_uint8_enum 0.0 3.0 /end CHARACTERISTIC
/begin COMPU_METHOD SWC_INP_type_CM_single_A "Q = V" RAT_FUNC "%8.6" "A" COEFFS 0 1 0 0 0 1 /end COMPU_METHOD
/begin COMPU_METHOD SWC_INP_type_CM_single_pct "Q = V" RAT_FUNC "%8.6" "pct" COEFFS 0 1 0 0 0 1 /end COMPU_METHOD
/begin COMPU_METHOD SWC_INP_type_CM_single_Nm "Q = V" RAT_FUNC "%8.6" "Nm" COEFFS 0 1 0 0 0 1 /end COMPU_METHOD
/begin COMPU_METHOD SWC_INP_type_CM_single_kph "Q = V" RAT_FUNC "%8.6" "kph" COEFFS 0 1 0 0 0 1 /end COMPU_METHOD
/begin COMPU_METHOD SWC_INP_type_CM_single_V "Q = V" RAT_FUNC "%8.6" "V" COEFFS 0 1 0 0 0 1 /end COMPU_METHOD
/begin COMPU_METHOD SWC_INP_type_CM_single_C "Q = V" RAT_FUNC "%8.6" "C" COEFFS 0 1 0 0 0 1 /end COMPU_METHOD
/begin COMPU_METHOD SWC_INP_type_CM_single_rpm "Q = V" RAT_FUNC "%8.6" "rpm" COEFFS 0 1 0 0 0 1 /end COMPU_METHOD
/begin COMPU_METHOD SWC_INP_type_CM_single_Lpmin "Q = V" RAT_FUNC "%8.6" "Lpmin" COEFFS 0 1 0 0 0 1 /end COMPU_METHOD
/begin COMPU_METHOD SWC_INP_type_CM_single_mV "Q = V" RAT_FUNC "%8.6" "mV" COEFFS 0 1 0 0 0 1 /end COMPU_METHOD
/begin COMPU_METHOD SWC_INP_type_CM_single_kWh "Q = V" RAT_FUNC "%8.6" "kWh" COEFFS 0 1 0 0 0 1 /end COMPU_METHOD
/begin COMPU_METHOD SWC_INP_type_CM_single_Megaohm "Q = V" RAT_FUNC "%8.6" "Megaohm" COEFFS 0 1 0 0 0 1 /end COMPU_METHOD
/begin COMPU_METHOD SWC_INP_type_CM_single_kW "Q = V" RAT_FUNC "%8.6" "kW" COEFFS 0 1 0 0 0 1 /end COMPU_METHOD
/begin COMPU_METHOD SWC_INP_type_CM_single_min "Q = V" RAT_FUNC "%8.6" "min" COEFFS 0 1 0 0 0 1 /end COMPU_METHOD
/begin COMPU_METHOD SWC_INP_type_CM_single_km "Q = V" RAT_FUNC "%8.6" "km" COEFFS 0 1 0 0 0 1 /end COMPU_METHOD
/begin COMPU_METHOD SWC_INP_type_CM_single_cnt "Q = V" RAT_FUNC "%8.6" "cnt" COEFFS 0 1 0 0 0 1 /end COMPU_METHOD
/begin COMPU_METHOD SWC_INP_type_CM_uint16_enum "Q = V" RAT_FUNC "%5.0" "enum" COEFFS 0 1 0 0 0 1 /end COMPU_METHOD
/begin COMPU_METHOD SWC_INP_type_CM_boolean_flg "Q = V" RAT_FUNC "%1.0" "flg" COEFFS 0 1 0 0 0 1 /end COMPU_METHOD
/begin COMPU_METHOD SWC_INP_type_CM_uint8_enum "Q = V" RAT_FUNC "%3.0" "enum" COEFFS 0 1 0 0 0 1 /end COMPU_METHOD
/begin GROUP S775_IVIRBlowerZSta "SWC_INP_type/run_SWC_INP_5ms_sys/INP/CAN2/SignalCheck/IVI3/IVIRBlowerZSta"
 /begin REF_CHARACTERISTIC KINP_IVIRBlowerZSta_pct_defval KINP_IVIRBlowerZSta_pct_ovrdflg KINP_IVIRBlowerZSta_pct_ovrdval /end REF_CHARACTERISTIC
/end GROUP
/begin GROUP S775_IVIRSEATventCmd "SWC_INP_type/run_SWC_INP_5ms_sys/INP/CAN2/SignalCheck/IVI3/IVIRSEATventCmd"
 /begin REF_CHARACTERISTIC KINP_IVIRSEATventCmd_enum_defval KINP_IVIRSEATventCmd_enum_ovrdflg KINP_IVIRSEATventCmd_enum_ovrdval /end REF_CHARACTERISTIC
/end GROUP
/begin GROUP S775_IVISnowModeCmd "SWC_INP_type/run_SWC_INP_5ms_sys/INP/CAN2/SignalCheck/IVI3/IVISnowModeCmd"
 /begin REF_CHARACTERISTIC KINP_IVISnowModeCmd_flg_defval KINP_IVISnowModeCmd_flg_ovrdflg KINP_IVISnowModeCmd_flg_ovrdval /end REF_CHARACTERISTIC
/end GROUP
/begin GROUP S775_IVIUserTakeOverAPSSta "SWC_INP_type/run_SWC_INP_5ms_sys/INP/CAN2/SignalCheck/IVI3/IVIUserTakeOverAPSSta"
 /begin REF_CHARACTERISTIC KINP_IVIUserTakeOverAPSSta_flg_defval KINP_IVIUserTakeOverAPSSta_flg_ovrdflg KINP_IVIUserTakeOverAPSSta_flg_ovrdval /end REF_CHARACTERISTIC
/end GROUP
/begin GROUP S775_IVIZon1WindDirSWReqSta "SWC_INP_type/run_SWC_INP_5ms_sys/INP/CAN2/SignalCheck/IVI3/IVIZon1WindDirSWReqSta"
 /begin REF_CHARACTERISTIC KINP_IVIZon1WindDirSWReqSta_flg_defval KINP_IVIZon1WindDirSWReqSta_flg_ovrdflg KINP_IVIZon1WindDirSWReqSta_flg_ovrdval /end REF_CHARACTERISTIC
/end GROUP
/begin GROUP S776_METERKPHCalcu "SWC_INP_type/run_SWC_INP_5ms_sys/INP/CAN2/SignalCheck/METER1/METERKPHCalcu"
 /begin REF_CHARACTERISTIC KINP_METERKPHCalcu_kph_defval KINP_METERKPHCalcu_kph_ovrdflg KINP_METERKPHCalcu_kph_ovrdval /end REF_CHARACTERISTIC
/end GROUP
/begin GROUP S776_ODOMETER "SWC_INP_type/run_SWC_INP_5ms_sys/INP/CAN2/SignalCheck/METER1/ODOMETER"
 /begin REF_CHARACTERISTIC KINP_ODOMETER_km_defval KINP_ODOMETER_km_ovrdflg KINP_ODOMETER_km_ovrdval /end REF_CHARACTERISTIC
/end GROUP
/begin GROUP S1819_BMS1CSErr "SWC_INP_type/run_SWC_INP_5ms_sys/INP/CAN3/SignalCheck/BMS1/BMS1CSErr"
 /begin REF_CHARACTERISTIC KINP_BMS1CSErr_flg_defval KINP_BMS1CSErr_flg_ovrdflg KINP_BMS1CSErr_flg_ovrdval /end REF_CHARACTERISTIC
/end GROUP
/begin GROUP S1819_BMS1RCErr "SWC_INP_type/run_SWC_INP_5ms_sys/INP/CAN3/SignalCheck/BMS1/BMS1RCErr"
 /begin REF_CHARACTERISTIC KINP_BMS1RCErr_flg_defval KINP_BMS1RCErr_flg_ovrdflg KINP_BMS1RCErr_flg_ovrdval /end REF_CHARACTERISTIC
/end GROUP
/begin GROUP S1819_BMSChckSum1 "SWC_INP_type/run_SWC_INP_5ms_sys/INP/CAN3/SignalCheck/BMS1/BMSChckSum1"
 /begin REF_CHARACTERISTIC KINP_BMSChckSum1_enum_defval KINP_BMSChckSum1_enum_ovrdflg KINP_BMSChckSum1_enum_ovrdval /end REF_CHARACTERISTIC
/end GROUP
/begin GROUP S1819_BMSRolCnct1 "SWC_INP_type/run_SWC_INP_5ms_sys/INP/CAN3/SignalCheck/BMS1/BMSRolCnct1"
 /begin REF_CHARACTERISTIC KINP_BMSRolCnct1_enum_defval KINP_BMSRolCnct1_enum_ovrdflg KINP_BMSRolCnct1_enum_ovrdval /end REF_CHARACTERISTIC
/end GROUP
/begin GROUP S1819_HVBPwrAvailChrg "SWC_INP_type/run_SWC_INP_5ms_sys/INP/CAN3/SignalCheck/BMS1/HVBPwrAvailChrg"
 /begin REF_CHARACTERISTIC KINP_HVBPwrAvailChrg_kW_defval KINP_HVBPwrAvailChrg_kW_ovrdflg KINP_HVBPwrAvailChrg_kW_ovrdval /end REF_CHARACTERISTIC
/end GROUP
/begin GROUP S1819_HVBPwrAvailChrg30 "SWC_INP_type/run_SWC_INP_5ms_sys/INP/CAN3/SignalCheck/BMS1/HVBPwrAvailChrg30"
 /begin REF_CHARACTERISTIC KINP_HVBPwrAvailChrg30_kW_defval KINP_HVBPwrAvailChrg30_kW_ovrdflg KINP_HVBPwrAvailChrg30_kW_ovrdval /end REF_CHARACTERISTIC
/end GROUP
/begin GROUP S1819_HVBPwrAvailChrg60 "SWC_INP_type/run_SWC_INP_5ms_sys/INP/CAN3/SignalCheck/BMS1/HVBPwrAvailChrg60"
 /begin REF_CHARACTERISTIC KINP_HVBPwrAvailChrg60_kW_defval KINP_HVBPwrAvailChrg60_kW_ovrdflg KINP_HVBPwrAvailChrg60_kW_ovrdval /end REF_CHARACTERISTIC
/end GROUP
/begin GROUP S1819_HVBPwrAvailDchrg "SWC_INP_type/run_SWC_INP_5ms_sys/INP/CAN3/SignalCheck/BMS1/HVBPwrAvailDchrg"
 /begin REF_CHARACTERISTIC KINP_HVBPwrAvailDchrg_kW_defval KINP_HVBPwrAvailDchrg_kW_ovrdflg KINP_HVBPwrAvailDchrg_kW_ovrdval /end REF_CHARACTERISTIC
/end GROUP
/begin GROUP S1819_HVBPwrAvailDchrg30 "SWC_INP_type/run_SWC_INP_5ms_sys/INP/CAN3/SignalCheck/BMS1/HVBPwrAvailDchrg30"
 /begin REF_CHARACTERISTIC KINP_HVBPwrAvailDchrg30_kW_defval KINP_HVBPwrAvailDchrg30_kW_ovrdflg KINP_HVBPwrAvailDchrg30_kW_ovrdval /end REF_CHARACTERISTIC
/end GROUP
/begin GROUP S1819_HVBPwrAvailDchrg60 "SWC_INP_type/run_SWC_INP_5ms_sys/INP/CAN3/SignalCheck/BMS1/HVBPwrAvailDchrg60"
 /begin REF_CHARACTERISTIC KINP_HVBPwrAvailDchrg60_kW_defval KINP_HVBPwrAvailDchrg60_kW_ovrdflg KINP_HVBPwrAvailDchrg60_kW_ovrdval /end REF_CHARACTERISTIC
/end GROUP
/begin GROUP S1819_HVBattCurr "SWC_INP_type/run_SWC_INP_5ms_sys/INP/CAN3/SignalCheck/BMS1/HVBattCurr"
 /begin REF_CHARACTERISTIC KINP_HVBattCurr_A_defval KINP_HVBattCurr_A_ovrdflg KINP_HVBattCurr_A_ovrdval /end REF_CHARACTERISTIC
/end GROUP
/begin GROUP S1819_HVBattVolt "SWC_INP_type/run_SWC_INP_5ms_sys/INP/CAN3/SignalCheck/BMS1/HVBattVolt"
 /begin REF_CHARACTERISTIC KINP_HVBattVolt_V_defval KINP_HVBattVolt_V_ovrdflg KINP_HVBattVolt_V_ovrdval /end REF_CHARACTERISTIC
/end GROUP
/begin GROUP S1820_ACChrgCurrDis "SWC_INP_type/run_SWC_INP_5ms_sys/INP/CAN3/SignalCheck/BMS3/ACChrgCurrDis"
 /begin REF_CHARACTERISTIC KINP_ACChrgCurrDis_A_defval KINP_ACChrgCurrDis_A_ovrdflg KINP_ACChrgCurrDis_A_ovrdval /end REF_CHARACTERISTIC
/end GROUP
/begin GROUP S1820_FireDetErr "SWC_INP_type/run_SWC_INP_5ms_sys/INP/CAN3/SignalCheck/BMS3/FireDetErr"
 /begin REF_CHARACTERISTIC KINP_FireDetErr_flg_defval KINP_FireDetErr_flg_ovrdflg KINP_FireDetErr_flg_ovrdval /end REF_CHARACTERISTIC
/end GROUP
/begin GROUP S1820_HVBChrgPwr "SWC_INP_type/run_SWC_INP_5ms_sys/INP/CAN3/SignalCheck/BMS3/HVBChrgPwr"
 /begin REF_CHARACTERISTIC KINP_HVBChrgPwr_kWh_defval KINP_HVBChrgPwr_kWh_ovrdflg KINP_HVBChrgPwr_kWh_ovrdval /end REF_CHARACTERISTIC
/end GROUP
/begin GROUP S1820_HVBChrgPwrTotal "SWC_INP_type/run_SWC_INP_5ms_sys/INP/CAN3/SignalCheck/BMS3/HVBChrgPwrTotal"
 /begin REF_CHARACTERISTIC KINP_HVBChrgPwrTotal_kWh_defval KINP_HVBChrgPwrTotal_kWh_ovrdflg KINP_HVBChrgPwrTotal_kWh_ovrdval /end REF_CHARACTERISTIC
/end GROUP
/begin GROUP S1820_HVBDrvPwr "SWC_INP_type/run_SWC_INP_5ms_sys/INP/CAN3/SignalCheck/BMS3/HVBDrvPwr"
 /begin REF_CHARACTERISTIC KINP_HVBDrvPwr_kWh_defval KINP_HVBDrvPwr_kWh_ovrdflg KINP_HVBDrvPwr_kWh_ovrdval /end REF_CHARACTERISTIC
/end GROUP
/begin GROUP S1820_HVBDrvPwrTotal "SWC_INP_type/run_SWC_INP_5ms_sys/INP/CAN3/SignalCheck/BMS3/HVBDrvPwrTotal"
 /begin REF_CHARACTERISTIC KINP_HVBDrvPwrTotal_kWh_defval KINP_HVBDrvPwrTotal_kWh_ovrdflg KINP_HVBDrvPwrTotal_kWh_ovrdval /end REF_CHARACTERISTIC
/end GROUP
/begin GROUP S1820_HVBFullChrgPwr "SWC_INP_type/run_SWC_INP_5ms_sys/INP/CAN3/SignalCheck/BMS3/HVBFullChrgPwr"
 /begin REF_CHARACTERISTIC KINP_HVBFullChrgPwr_kWh_defval KINP_HVBFullChrgPwr_kWh_ovrdflg KINP_HVBFullChrgPwr_kWh_ovrdval /end REF_CHARACTERISTIC
/end GROUP
/begin GROUP S1820_HVBIsoImpedenceN "SWC_INP_type/run_SWC_INP_5ms_sys/INP/CAN3/SignalCheck/BMS3/HVBIsoImpedenceN"
 /begin REF_CHARACTERISTIC KINP_HVBIsoImpedenceN_Megaohm_defval KINP_HVBIsoImpedenceN_Megaohm_ovrdflg KINP_HVBIsoImpedenceN_Megaohm_ovrdval /end REF_CHARACTERISTIC
/end GROUP
/begin GROUP S1820_HVBIsoImpedenceP "SWC_INP_type/run_SWC_INP_5ms_sys/INP/CAN3/SignalCheck/BMS3/HVBIsoImpedenceP"
 /begin REF_CHARACTERISTIC KINP_HVBIsoImpedenceP_Megaohm_defval KINP_HVBIsoImpedenceP_Megaohm_ovrdflg KINP_HVBIsoImpedenceP_Megaohm_ovrdval /end REF_CHARACTERISTIC
/end GROUP
/begin GROUP S1820_HVBSOH "SWC_INP_type/run_SWC_INP_5ms_sys/INP/CAN3/SignalCheck/BMS3/HVBSOH"
 /begin REF_CHARACTERISTIC KINP_HVBSOH_pct_defval KINP_HVBSOH_pct_ovrdflg KINP_HVBSOH_pct_ovrdval /end REF_CHARACTERISTIC
/end GROUP
/begin GROUP S1820_HVBattErr "SWC_INP_type/run_SWC_INP_5ms_sys/INP/CAN3/SignalCheck/BMS3/HVBattErr"
 /begin REF_CHARACTERISTIC KINP_HVBattErr_flg_defval KINP_HVBattErr_flg_ovrdflg KINP_HVBattErr_flg_ovrdval /end REF_CHARACTERISTIC
/end GROUP
/begin GROUP S1820_HVBattPackVolt "SWC_INP_type/run_SWC_INP_5ms_sys/INP/CAN3/SignalCheck/BMS3/HVBattPackVolt"
 /begin REF_CHARACTERISTIC KINP_HVBattPackVolt_V_defval KINP_HVBattPackVolt_V_ovrdflg KINP_HVBattPackVolt_V_ovrdval /end REF_CHARACTERISTIC
/end GROUP
/begin GROUP S1820_HVBattSOC "SWC_INP_type/run_SWC_INP_5ms_sys/INP/CAN3/SignalCheck/BMS3/HVBattSOC"
 /begin REF_CHARACTERISTIC KINP_HVBattSOC_pct_defval KINP_HVBattSOC_pct_ovrdflg KINP_HVBattSOC_pct_ovrdval /end REF_CHARACTERISTIC
/end GROUP
/begin GROUP S1820_HVBattSOCDis "SWC_INP_type/run_SWC_INP_5ms_sys/INP/CAN3/SignalCheck/BMS3/HVBattSOCDis"
 /begin REF_CHARACTERISTIC KINP_HVBattSOCDis_pct_defval KINP_HVBattSOCDis_pct_ovrdflg KINP_HVBattSOCDis_pct_ovrdval /end REF_CHARACTERISTIC
/end GROUP
/begin GROUP S1820_RemainChrgTime "SWC_INP_type/run_SWC_INP_5ms_sys/INP/CAN3/SignalCheck/BMS3/RemainChrgTime"
 /begin REF_CHARACTERISTIC KINP_RemainChrgTime_min_defval KINP_RemainChrgTime_min_ovrdflg KINP_RemainChrgTime_min_ovrdval /end REF_CHARACTERISTIC
/end GROUP
/begin GROUP S1821_CellTempAvg "SWC_INP_type/run_SWC_INP_5ms_sys/INP/CAN3/SignalCheck/BMS4/CellTempAvg"
 /begin REF_CHARACTERISTIC KINP_CellTempAvg_C_defval KINP_CellTempAvg_C_ovrdflg KINP_CellTempAvg_C_ovrdval /end REF_CHARACTERISTIC
/end GROUP
/begin GROUP S1821_HVBCellVoltMax "SWC_INP_type/run_SWC_INP_5ms_sys/INP/CAN3/SignalCheck/BMS4/HVBCellVoltMax"
 /begin REF_CHARACTERISTIC KINP_HVBCellVoltMax_mV_defval KINP_HVBCellVoltMax_mV_ovrdflg KINP_HVBCellVoltMax_mV_ovrdval /end REF_CHARACTERISTIC
/end GROUP
/begin GROUP S1821_HVBCellVoltMin "SWC_INP_type/run_SWC_INP_5ms_sys/INP/CAN3/SignalCheck/BMS4/HVBCellVoltMin"
 /begin REF_CHARACTERISTIC KINP_HVBCellVoltMin_mV_defval KINP_HVBCellVoltMin_mV_ovrdflg KINP_HVBCellVoltMin_mV_ovrdval /end REF_CHARACTERISTIC
/end GROUP
/begin GROUP S1821_HVBMTempMax "SWC_INP_type/run_SWC_INP_5ms_sys/INP/CAN3/SignalCheck/BMS4/HVBMTempMax"
 /begin REF_CHARACTERISTIC KINP_HVBMTempMax_C_defval KINP_HVBMTempMax_C_ovrdflg KINP_HVBMTempMax_C_ovrdval /end REF_CHARACTERISTIC
/end GROUP
/begin GROUP S1821_HVBMTempMin "SWC_INP_type/run_SWC_INP_5ms_sys/INP/CAN3/SignalCheck/BMS4/HVBMTempMin"
 /begin REF_CHARACTERISTIC KINP_HVBMTempMin_C_defval KINP_HVBMTempMin_C_ovrdflg KINP_HVBMTempMin_C_ovrdval /end REF_CHARACTERISTIC
/end GROUP
/begin GROUP S1821_MaxCellTempNum "SWC_INP_type/run_SWC_INP_5ms_sys/INP/CAN3/SignalCheck/BMS4/MaxCellTempNum"
 /begin REF_CHARACTERISTIC KINP_MaxCellTempNum_enum_defval KINP_MaxCellTempNum_enum_ovrdflg KINP_MaxCellTempNum_enum_ovrdval /end REF_CHARACTERISTIC
/end GROUP
/begin GROUP S1821_MaxCellVoltNum "SWC_INP_type/run_SWC_INP_5ms_sys/INP/CAN3/SignalCheck/BMS4/MaxCellVoltNum"
 /begin REF_CHARACTERISTIC KINP_MaxCellVoltNum_enum_defval KINP_MaxCellVoltNum_enum_ovrdflg KINP_MaxCellVoltNum_enum_ovrdval /end REF_CHARACTERISTIC
/end GROUP
/begin GROUP S1821_MinCellTempNum "SWC_INP_type/run_SWC_INP_5ms_sys/INP/CAN3/SignalCheck/BMS4/MinCellTempNum"
 /begin REF_CHARACTERISTIC KINP_MinCellTempNum_enum_defval KINP_MinCellTempNum_enum_ovrdflg KINP_MinCellTempNum_enum_ovrdval /end REF_CHARACTERISTIC
/end GROUP
/begin GROUP S1821_MinCellVoltNum "SWC_INP_type/run_SWC_INP_5ms_sys/INP/CAN3/SignalCheck/BMS4/MinCellVoltNum"
 /begin REF_CHARACTERISTIC KINP_MinCellVoltNum_enum_defval KINP_MinCellVoltNum_enum_ovrdflg KINP_MinCellVoltNum_enum_ovrdval /end REF_CHARACTERISTIC
/end GROUP
/begin GROUP S1822_HVInVolt "SWC_INP_type/run_SWC_INP_5ms_sys/INP/CAN3/SignalCheck/BMS5/HVInVolt"
 /begin REF_CHARACTERISTIC KINP_HVInVolt_V_defval KINP_HVInVolt_V_ovrdflg KINP_HVInVolt_V_ovrdval /end REF_CHARACTERISTIC
/end GROUP
/begin GROUP S1822_LVBattDet12V "SWC_INP_type/run_SWC_INP_5ms_sys/INP/CAN3/SignalCheck/BMS5/LVBattDet12V"
 /begin REF_CHARACTERISTIC KINP_LVBattDet12V_V_defval KINP_LVBattDet12V_V_ovrdflg KINP_LVBattDet12V_V_ovrdval /end REF_CHARACTERISTIC
/end GROUP
/begin GROUP S1822_OBCACCSLimit "SWC_INP_type/run_SWC_INP_5ms_sys/INP/CAN3/SignalCheck/BMS5/OBCACCSLimit"
 /begin REF_CHARACTERISTIC KINP_OBCACCSLimit_A_defval KINP_OBCACCSLimit_A_ovrdflg KINP_OBCACCSLimit_A_ovrdval /end REF_CHARACTERISTIC
/end GROUP
/begin GROUP S1822_OBCDCCurLm "SWC_INP_type/run_SWC_INP_5ms_sys/INP/CAN3/SignalCheck/BMS5/OBCDCCurLm"
 /begin REF_CHARACTERISTIC KINP_OBCDCCurLm_A_defval KINP_OBCDCCurLm_A_ovrdflg KINP_OBCDCCurLm_A_ovrdval /end REF_CHARACTERISTIC
/end GROUP
/begin GROUP S1822_OBCDCVoltLm "SWC_INP_type/run_SWC_INP_5ms_sys/INP/CAN3/SignalCheck/BMS5/OBCDCVoltLm"
 /begin REF_CHARACTERISTIC KINP_OBCDCVoltLm_V_defval KINP_OBCDCVoltLm_V_ovrdflg KINP_OBCDCVoltLm_V_ovrdval /end REF_CHARACTERISTIC
/end GROUP
/begin GROUP S1823_BMS6CSErr "SWC_INP_type/run_SWC_INP_5ms_sys/INP/CAN3/SignalCheck/BMS6/BMS6CSErr"
 /begin REF_CHARACTERISTIC KINP_BMS6CSErr_flg_defval KINP_BMS6CSErr_flg_ovrdflg KINP_BMS6CSErr_flg_ovrdval /end REF_CHARACTERISTIC
/end GROUP
/begin GROUP S1823_BMS6RCErr "SWC_INP_type/run_SWC_INP_5ms_sys/INP/CAN3/SignalCheck/BMS6/BMS6RCErr"
 /begin REF_CHARACTERISTIC KINP_BMS6RCErr_flg_defval KINP_BMS6RCErr_flg_ovrdflg KINP_BMS6RCErr_flg_ovrdval /end REF_CHARACTERISTIC
/end GROUP
/begin GROUP S1823_BMSChckSum "SWC_INP_type/run_SWC_INP_5ms_sys/INP/CAN3/SignalCheck/BMS6/BMSChckSum"
 /begin REF_CHARACTERISTIC KINP_BMSChckSum_enum_defval KINP_BMSChckSum_enum_ovrdflg KINP_BMSChckSum_enum_ovrdval /end REF_CHARACTERISTIC
/end GROUP
/begin GROUP S1823_BMSREADY "SWC_INP_type/run_SWC_INP_5ms_sys/INP/CAN3/SignalCheck/BMS6/BMSREADY"
 /begin REF_CHARACTERISTIC KINP_BMSREADY_flg_defval KINP_BMSREADY_flg_ovrdflg KINP_BMSREADY_flg_ovrdval /end REF_CHARACTERISTIC
/end GROUP
/begin GROUP S1823_BMSRolCnct "SWC_INP_type/run_SWC_INP_5ms_sys/INP/CAN3/SignalCheck/BMS6/BMSRolCnct"
 /begin REF_CHARACTERISTIC KINP_BMSRolCnct_enum_defval KINP_BMSRolCnct_enum_ovrdflg KINP_BMSRolCnct_enum_ovrdval /end REF_CHARACTERISTIC
/end GROUP
/begin GROUP S1823_BMSWarn1 "SWC_INP_type/run_SWC_INP_5ms_sys/INP/CAN3/SignalCheck/BMS6/BMSWarn1"
 /begin REF_CHARACTERISTIC KINP_BMSWarn1_flg_defval KINP_BMSWarn1_flg_ovrdflg KINP_BMSWarn1_flg_ovrdval /end REF_CHARACTERISTIC
/end GROUP
/begin GROUP S1823_BMSWarn2 "SWC_INP_type/run_SWC_INP_5ms_sys/INP/CAN3/SignalCheck/BMS6/BMSWarn2"
 /begin REF_CHARACTERISTIC KINP_BMSWarn2_flg_defval KINP_BMSWarn2_flg_ovrdflg KINP_BMSWarn2_flg_ovrdval /end REF_CHARACTERISTIC
/end GROUP
/begin GROUP S1823_BMSWarn3 "SWC_INP_type/run_SWC_INP_5ms_sys/INP/CAN3/SignalCheck/BMS6/BMSWarn3"
 /begin REF_CHARACTERISTIC KINP_BMSWarn3_flg_defval KINP_BMSWarn3_flg_ovrdflg KINP_BMSWarn3_flg_ovrdval /end REF_CHARACTERISTIC
/end GROUP
/begin GROUP S1823_BMSWarn4 "SWC_INP_type/run_SWC_INP_5ms_sys/INP/CAN3/SignalCheck/BMS6/BMSWarn4"
 /begin REF_CHARACTERISTIC KINP_BMSWarn4_flg_defval KINP_BMSWarn4_flg_ovrdflg KINP_BMSWarn4_flg_ovrdval /end REF_CHARACTERISTIC
/end GROUP
/begin GROUP S1823_BMSWarn5 "SWC_INP_type/run_SWC_INP_5ms_sys/INP/CAN3/SignalCheck/BMS6/BMSWarn5"
 /begin REF_CHARACTERISTIC KINP_BMSWarn5_flg_defval KINP_BMSWarn5_flg_ovrdflg KINP_BMSWarn5_flg_ovrdval /end REF_CHARACTERISTIC
/end GROUP
/begin GROUP S1823_BMSWarn6 "SWC_INP_type/run_SWC_INP_5ms_sys/INP/CAN3/SignalCheck/BMS6/BMSWarn6"
 /begin REF_CHARACTERISTIC KINP_BMSWarn6_flg_defval KINP_BMSWarn6_flg_ovrdflg KINP_BMSWarn6_flg_ovrdval /end REF_CHARACTERISTIC
/end GROUP
/begin GROUP S1823_BMSWarn7 "SWC_INP_type/run_SWC_INP_5ms_sys/INP/CAN3/SignalCheck/BMS6/BMSWarn7"
 /begin REF_CHARACTERISTIC KINP_BMSWarn7_flg_defval KINP_BMSWarn7_flg_ovrdflg KINP_BMSWarn7_flg_ovrdval /end REF_CHARACTERISTIC
/end GROUP
/begin GROUP S1823_BMSWarn8 "SWC_INP_type/run_SWC_INP_5ms_sys/INP/CAN3/SignalCheck/BMS6/BMSWarn8"
 /begin REF_CHARACTERISTIC KINP_BMSWarn8_flg_defval KINP_BMSWarn8_flg_ovrdflg KINP_BMSWarn8_flg_ovrdval /end REF_CHARACTERISTIC
/end GROUP
/begin GROUP S1823_ChrgInLockReq "SWC_INP_type/run_SWC_INP_5ms_sys/INP/CAN3/SignalCheck/BMS6/ChrgInLockReq"
 /begin REF_CHARACTERISTIC KINP_ChrgInLockReq_enum_defval KINP_ChrgInLockReq_enum_ovrdflg KINP_ChrgInLockReq_enum_ovrdval /end REF_CHARACTERISTIC
/end GROUP
/begin GROUP S1823_ChrgPlugSta "SWC_INP_type/run_SWC_INP_5ms_sys/INP/CAN3/SignalCheck/BMS6/ChrgPlugSta"
 /begin REF_CHARACTERISTIC KINP_ChrgPlugSta_enum_defval KINP_ChrgPlugSta_enum_ovrdflg KINP_ChrgPlugSta_enum_ovrdval /end REF_CHARACTERISTIC
/end GROUP
/begin GROUP S1823_DisChrgPlugErr "SWC_INP_type/run_SWC_INP_5ms_sys/INP/CAN3/SignalCheck/BMS6/DisChrgPlugErr"
 /begin REF_CHARACTERISTIC KINP_DisChrgPlugErr_enum_defval KINP_DisChrgPlugErr_enum_ovrdflg KINP_DisChrgPlugErr_enum_ovrdval /end REF_CHARACTERISTIC
/end GROUP
/begin GROUP S1823_ExtChrgSta "SWC_INP_type/run_SWC_INP_5ms_sys/INP/CAN3/SignalCheck/BMS6/ExtChrgSta"
 /begin REF_CHARACTERISTIC KINP_ExtChrgSta_enum_defval KINP_ExtChrgSta_enum_ovrdflg KINP_ExtChrgSta_enum_ovrdval /end REF_CHARACTERISTIC
/end GROUP
/begin GROUP S1823_HVBChrgErr "SWC_INP_type/run_SWC_INP_5ms_sys/INP/CAN3/SignalCheck/BMS6/HVBChrgErr"
 /begin REF_CHARACTERISTIC KINP_HVBChrgErr_enum_defval KINP_HVBChrgErr_enum_ovrdflg KINP_HVBChrgErr_enum_ovrdval /end REF_CHARACTERISTIC
/end GROUP
/begin GROUP S1823_HVBContactorSta "SWC_INP_type/run_SWC_INP_5ms_sys/INP/CAN3/SignalCheck/BMS6/HVBContactorSta"
 /begin REF_CHARACTERISTIC KINP_HVBContactorSta_flg_defval KINP_HVBContactorSta_flg_ovrdflg KINP_HVBContactorSta_flg_ovrdval /end REF_CHARACTERISTIC
/end GROUP
/begin GROUP S1823_HVBHVILErr "SWC_INP_type/run_SWC_INP_5ms_sys/INP/CAN3/SignalCheck/BMS6/HVBHVILErr"
 /begin REF_CHARACTERISTIC KINP_HVBHVILErr_flg_defval KINP_HVBHVILErr_flg_ovrdflg KINP_HVBHVILErr_flg_ovrdval /end REF_CHARACTERISTIC
/end GROUP
/begin GROUP S1823_HVBOvrTempErr "SWC_INP_type/run_SWC_INP_5ms_sys/INP/CAN3/SignalCheck/BMS6/HVBOvrTempErr"
 /begin REF_CHARACTERISTIC KINP_HVBOvrTempErr_flg_defval KINP_HVBOvrTempErr_flg_ovrdflg KINP_HVBOvrTempErr_flg_ovrdval /end REF_CHARACTERISTIC
/end GROUP
/begin GROUP S1823_HVBOvrTempWarn "SWC_INP_type/run_SWC_INP_5ms_sys/INP/CAN3/SignalCheck/BMS6/HVBOvrTempWarn"
 /begin REF_CHARACTERISTIC KINP_HVBOvrTempWarn_enum_defval KINP_HVBOvrTempWarn_enum_ovrdflg KINP_HVBOvrTempWarn_enum_ovrdval /end REF_CHARACTERISTIC
/end GROUP
/begin GROUP S1823_HVBPreheatPrecoolSta "SWC_INP_type/run_SWC_INP_5ms_sys/INP/CAN3/SignalCheck/BMS6/HVBPreheatPrecoolSta"
 /begin REF_CHARACTERISTIC KINP_HVBPreheatPrecoolSta_enum_defval KINP_HVBPreheatPrecoolSta_enum_ovrdflg KINP_HVBPreheatPrecoolSta_enum_ovrdval /end REF_CHARACTERISTIC
/end GROUP
/begin GROUP S1823_HVBattReady4Pre "SWC_INP_type/run_SWC_INP_5ms_sys/INP/CAN3/SignalCheck/BMS6/HVBattReady4Pre"
 /begin REF_CHARACTERISTIC KINP_HVBattReady4Pre_enum_defval KINP_HVBattReady4Pre_enum_ovrdflg KINP_HVBattReady4Pre_enum_ovrdval /end REF_CHARACTERISTIC
/end GROUP
/begin GROUP S1823_HVILSta "SWC_INP_type/run_SWC_INP_5ms_sys/INP/CAN3/SignalCheck/BMS6/HVILSta"
 /begin REF_CHARACTERISTIC KINP_HVILSta_flg_defval KINP_HVILSta_flg_ovrdflg KINP_HVILSta_flg_ovrdval /end REF_CHARACTERISTIC
/end GROUP
/begin GROUP S1823_V2LSta "SWC_INP_type/run_SWC_INP_5ms_sys/INP/CAN3/SignalCheck/BMS6/V2LSta"
 /begin REF_CHARACTERISTIC KINP_V2LSta_enum_defval KINP_V2LSta_enum_ovrdflg KINP_V2LSta_enum_ovrdval /end REF_CHARACTERISTIC
/end GROUP
/begin GROUP S1824_MainRlyNegSta "SWC_INP_type/run_SWC_INP_5ms_sys/INP/CAN3/SignalCheck/BMS8/MainRlyNegSta"
 /begin REF_CHARACTERISTIC KINP_MainRlyNegSta_enum_defval KINP_MainRlyNegSta_enum_ovrdflg KINP_MainRlyNegSta_enum_ovrdval /end REF_CHARACTERISTIC
/end GROUP
/begin GROUP S1824_MainRlyPosSta "SWC_INP_type/run_SWC_INP_5ms_sys/INP/CAN3/SignalCheck/BMS8/MainRlyPosSta"
 /begin REF_CHARACTERISTIC KINP_MainRlyPosSta_enum_defval KINP_MainRlyPosSta_enum_ovrdflg KINP_MainRlyPosSta_enum_ovrdval /end REF_CHARACTERISTIC
/end GROUP
/begin GROUP S1825_CCU1CSErr "SWC_INP_type/run_SWC_INP_5ms_sys/INP/CAN3/SignalCheck/CCU1/CCU1CSErr"
 /begin REF_CHARACTERISTIC KINP_CCU1CSErr_flg_defval KINP_CCU1CSErr_flg_ovrdflg KINP_CCU1CSErr_flg_ovrdval /end REF_CHARACTERISTIC
/end GROUP
/begin GROUP S1825_CCU1RCErr "SWC_INP_type/run_SWC_INP_5ms_sys/INP/CAN3/SignalCheck/CCU1/CCU1RCErr"
 /begin REF_CHARACTERISTIC KINP_CCU1RCErr_flg_defval KINP_CCU1RCErr_flg_ovrdflg KINP_CCU1RCErr_flg_ovrdval /end REF_CHARACTERISTIC
/end GROUP
/begin GROUP S1825_CSCCU1 "SWC_INP_type/run_SWC_INP_5ms_sys/INP/CAN3/SignalCheck/CCU1/CSCCU1"
 /begin REF_CHARACTERISTIC KINP_CSCCU1_enum_defval KINP_CSCCU1_enum_ovrdflg KINP_CSCCU1_enum_ovrdval /end REF_CHARACTERISTIC
/end GROUP
/begin GROUP S1825_DCDCAuxCur "SWC_INP_type/run_SWC_INP_5ms_sys/INP/CAN3/SignalCheck/CCU1/DCDCAuxCur"
 /begin REF_CHARACTERISTIC KINP_DCDCAuxCur_A_defval KINP_DCDCAuxCur_A_ovrdflg KINP_DCDCAuxCur_A_ovrdval /end REF_CHARACTERISTIC
/end GROUP
/begin GROUP S1825_DCDCAuxVolt "SWC_INP_type/run_SWC_INP_5ms_sys/INP/CAN3/SignalCheck/CCU1/DCDCAuxVolt"
 /begin REF_CHARACTERISTIC KINP_DCDCAuxVolt_V_defval KINP_DCDCAuxVolt_V_ovrdflg KINP_DCDCAuxVolt_V_ovrdval /end REF_CHARACTERISTIC
/end GROUP
/begin GROUP S1825_DCDCHVCur "SWC_INP_type/run_SWC_INP_5ms_sys/INP/CAN3/SignalCheck/CCU1/DCDCHVCur"
 /begin REF_CHARACTERISTIC KINP_DCDCHVCur_A_defval KINP_DCDCHVCur_A_ovrdflg KINP_DCDCHVCur_A_ovrdval /end REF_CHARACTERISTIC
/end GROUP
/begin GROUP S1825_DCDCInVoltInf "SWC_INP_type/run_SWC_INP_5ms_sys/INP/CAN3/SignalCheck/CCU1/DCDCInVoltInf"
 /begin REF_CHARACTERISTIC KINP_DCDCInVoltInf_V_defval KINP_DCDCInVoltInf_V_ovrdflg KINP_DCDCInVoltInf_V_ovrdval /end REF_CHARACTERISTIC
/end GROUP
/begin GROUP S1825_DCDCPreCompleted "SWC_INP_type/run_SWC_INP_5ms_sys/INP/CAN3/SignalCheck/CCU1/DCDCPreCompleted"
 /begin REF_CHARACTERISTIC KINP_DCDCPreCompleted_enum_defval KINP_DCDCPreCompleted_enum_ovrdflg KINP_DCDCPreCompleted_enum_ovrdval /end REF_CHARACTERISTIC
/end GROUP
/begin GROUP S1825_OBCDCCurrInf "SWC_INP_type/run_SWC_INP_5ms_sys/INP/CAN3/SignalCheck/CCU1/OBCDCCurrInf"
 /begin REF_CHARACTERISTIC KINP_OBCDCCurrInf_A_defval KINP_OBCDCCurrInf_A_ovrdflg KINP_OBCDCCurrInf_A_ovrdval /end REF_CHARACTERISTIC
/end GROUP
/begin GROUP S1825_OBCDCVoltInf "SWC_INP_type/run_SWC_INP_5ms_sys/INP/CAN3/SignalCheck/CCU1/OBCDCVoltInf"
 /begin REF_CHARACTERISTIC KINP_OBCDCVoltInf_V_defval KINP_OBCDCVoltInf_V_ovrdflg KINP_OBCDCVoltInf_V_ovrdval /end REF_CHARACTERISTIC
/end GROUP
/begin GROUP S1825_OBCPreCompleted "SWC_INP_type/run_SWC_INP_5ms_sys/INP/CAN3/SignalCheck/CCU1/OBCPreCompleted"
 /begin REF_CHARACTERISTIC KINP_OBCPreCompleted_enum_defval KINP_OBCPreCompleted_enum_ovrdflg KINP_OBCPreCompleted_enum_ovrdval /end REF_CHARACTERISTIC
/end GROUP
/begin GROUP S1825_OBCWakeup4Plugin "SWC_INP_type/run_SWC_INP_5ms_sys/INP/CAN3/SignalCheck/CCU1/OBCWakeup4Plugin"
 /begin REF_CHARACTERISTIC KINP_OBCWakeup4Plugin_flg_defval KINP_OBCWakeup4Plugin_flg_ovrdflg KINP_OBCWakeup4Plugin_flg_ovrdval /end REF_CHARACTERISTIC
/end GROUP
/begin GROUP S1825_RCCCU1 "SWC_INP_type/run_SWC_INP_5ms_sys/INP/CAN3/SignalCheck/CCU1/RCCCU1"
 /begin REF_CHARACTERISTIC KINP_RCCCU1_enum_defval KINP_RCCCU1_enum_ovrdflg KINP_RCCCU1_enum_ovrdval /end REF_CHARACTERISTIC
/end GROUP
/begin GROUP S1826_CCU2CSErr "SWC_INP_type/run_SWC_INP_5ms_sys/INP/CAN3/SignalCheck/CCU2/CCU2CSErr"
 /begin REF_CHARACTERISTIC KINP_CCU2CSErr_flg_defval KINP_CCU2CSErr_flg_ovrdflg KINP_CCU2CSErr_flg_ovrdval /end REF_CHARACTERISTIC
/end GROUP
/begin GROUP S1826_CCU2RCErr "SWC_INP_type/run_SWC_INP_5ms_sys/INP/CAN3/SignalCheck/CCU2/CCU2RCErr"
 /begin REF_CHARACTERISTIC KINP_CCU2RCErr_flg_defval KINP_CCU2RCErr_flg_ovrdflg KINP_CCU2RCErr_flg_ovrdval /end REF_CHARACTERISTIC
/end GROUP
/begin GROUP S1826_CSCCU2 "SWC_INP_type/run_SWC_INP_5ms_sys/INP/CAN3/SignalCheck/CCU2/CSCCU2"
 /begin REF_CHARACTERISTIC KINP_CSCCU2_enum_defval KINP_CSCCU2_enum_ovrdflg KINP_CSCCU2_enum_ovrdval /end REF_CHARACTERISTIC
/end GROUP
/begin GROUP S1826_DCDCEnaSta "SWC_INP_type/run_SWC_INP_5ms_sys/INP/CAN3/SignalCheck/CCU2/DCDCEnaSta"
 /begin REF_CHARACTERISTIC KINP_DCDCEnaSta_flg_defval KINP_DCDCEnaSta_flg_ovrdflg KINP_DCDCEnaSta_flg_ovrdval /end REF_CHARACTERISTIC
/end GROUP
/begin GROUP S1826_DCDCFaultSta "SWC_INP_type/run_SWC_INP_5ms_sys/INP/CAN3/SignalCheck/CCU2/DCDCFaultSta"
 /begin REF_CHARACTERISTIC KINP_DCDCFaultSta_enum_defval KINP_DCDCFaultSta_enum_ovrdflg KINP_DCDCFaultSta_enum_ovrdval /end REF_CHARACTERISTIC
/end GROUP
/begin GROUP S1826_DCDCReady4Pre "SWC_INP_type/run_SWC_INP_5ms_sys/INP/CAN3/SignalCheck/CCU2/DCDCReady4Pre"
 /begin REF_CHARACTERISTIC KINP_DCDCReady4Pre_flg_defval KINP_DCDCReady4Pre_flg_ovrdflg KINP_DCDCReady4Pre_flg_ovrdval /end REF_CHARACTERISTIC
/end GROUP
/begin GROUP S1826_DCDCTemp "SWC_INP_type/run_SWC_INP_5ms_sys/INP/CAN3/SignalCheck/CCU2/DCDCTemp"
 /begin REF_CHARACTERISTIC KINP_DCDCTemp_C_defval KINP_DCDCTemp_C_ovrdflg KINP_DCDCTemp_C_ovrdval /end REF_CHARACTERISTIC
/end GROUP
/begin GROUP S1826_OBCACCurLim "SWC_INP_type/run_SWC_INP_5ms_sys/INP/CAN3/SignalCheck/CCU2/OBCACCurLim"
 /begin REF_CHARACTERISTIC KINP_OBCACCurLim_enum_defval KINP_OBCACCurLim_enum_ovrdflg KINP_OBCACCurLim_enum_ovrdval /end REF_CHARACTERISTIC
/end GROUP
/begin GROUP S1826_OBCACCurrInf "SWC_INP_type/run_SWC_INP_5ms_sys/INP/CAN3/SignalCheck/CCU2/OBCACCurrInf"
 /begin REF_CHARACTERISTIC KINP_OBCACCurrInf_A_defval KINP_OBCACCurrInf_A_ovrdflg KINP_OBCACCurrInf_A_ovrdval /end REF_CHARACTERISTIC
/end GROUP
/begin GROUP S1826_OBCACVoltInf "SWC_INP_type/run_SWC_INP_5ms_sys/INP/CAN3/SignalCheck/CCU2/OBCACVoltInf"
 /begin REF_CHARACTERISTIC KINP_OBCACVoltInf_V_defval KINP_OBCACVoltInf_V_ovrdflg KINP_OBCACVoltInf_V_ovrdval /end REF_CHARACTERISTIC
/end GROUP
/begin GROUP S1826_OBCEnaSta "SWC_INP_type/run_SWC_INP_5ms_sys/INP/CAN3/SignalCheck/CCU2/OBCEnaSta"
 /begin REF_CHARACTERISTIC KINP_OBCEnaSta_flg_defval KINP_OBCEnaSta_flg_ovrdflg KINP_OBCEnaSta_flg_ovrdval /end REF_CHARACTERISTIC
/end GROUP
/begin GROUP S1826_OBCFaultSta "SWC_INP_type/run_SWC_INP_5ms_sys/INP/CAN3/SignalCheck/CCU2/OBCFaultSta"
 /begin REF_CHARACTERISTIC KINP_OBCFaultSta_enum_defval KINP_OBCFaultSta_enum_ovrdflg KINP_OBCFaultSta_enum_ovrdval /end REF_CHARACTERISTIC
/end GROUP
/begin GROUP S1826_OBCPluginSta "SWC_INP_type/run_SWC_INP_5ms_sys/INP/CAN3/SignalCheck/CCU2/OBCPluginSta"
 /begin REF_CHARACTERISTIC KINP_OBCPluginSta_flg_defval KINP_OBCPluginSta_flg_ovrdflg KINP_OBCPluginSta_flg_ovrdval /end REF_CHARACTERISTIC
/end GROUP
/begin GROUP S1826_OBCReady4Pre "SWC_INP_type/run_SWC_INP_5ms_sys/INP/CAN3/SignalCheck/CCU2/OBCReady4Pre"
 /begin REF_CHARACTERISTIC KINP_OBCReady4Pre_flg_defval KINP_OBCReady4Pre_flg_ovrdflg KINP_OBCReady4Pre_flg_ovrdval /end REF_CHARACTERISTIC
/end GROUP
/begin GROUP S1826_OBCTemp "SWC_INP_type/run_SWC_INP_5ms_sys/INP/CAN3/SignalCheck/CCU2/OBCTemp"
 /begin REF_CHARACTERISTIC KINP_OBCTemp_C_defval KINP_OBCTemp_C_ovrdflg KINP_OBCTemp_C_ovrdval /end REF_CHARACTERISTIC
/end GROUP
/begin GROUP S1826_OBCV2LSta "SWC_INP_type/run_SWC_INP_5ms_sys/INP/CAN3/SignalCheck/CCU2/OBCV2LSta"
 /begin REF_CHARACTERISTIC KINP_OBCV2LSta_enum_defval KINP_OBCV2LSta_enum_ovrdflg KINP_OBCV2LSta_enum_ovrdval /end REF_CHARACTERISTIC
/end GROUP
/begin GROUP S1826_RCCCU2 "SWC_INP_type/run_SWC_INP_5ms_sys/INP/CAN3/SignalCheck/CCU2/RCCCU2"
 /begin REF_CHARACTERISTIC KINP_RCCCU2_enum_defval KINP_RCCCU2_enum_ovrdflg KINP_RCCCU2_enum_ovrdval /end REF_CHARACTERISTIC
/end GROUP
/begin GROUP S1827_EBMErrSta "SWC_INP_type/run_SWC_INP_5ms_sys/INP/CAN3/SignalCheck/EBM1/EBMErrSta"
 /begin REF_CHARACTERISTIC KINP_EBMErrSta_enum_defval KINP_EBMErrSta_enum_ovrdflg KINP_EBMErrSta_enum_ovrdval /end REF_CHARACTERISTIC
/end GROUP
/begin GROUP S1827_EBMRLampSta "SWC_INP_type/run_SWC_INP_5ms_sys/INP/CAN3/SignalCheck/EBM1/EBMRLampSta"
 /begin REF_CHARACTERISTIC KINP_EBMRLampSta_enum_defval KINP_EBMRLampSta_enum_ovrdflg KINP_EBMRLampSta_enum_ovrdval /end REF_CHARACTERISTIC
/end GROUP
/begin GROUP S1828_FrActvDmpDisabSta "SWC_INP_type/run_SWC_INP_5ms_sys/INP/CAN3/SignalCheck/MCU_B_F1/FrActvDmpDisabSta"
 /begin REF_CHARACTERISTIC KINP_FrActvDmpDisabSta_flg_defval KINP_FrActvDmpDisabSta_flg_ovrdflg KINP_FrActvDmpDisabSta_flg_ovrdval /end REF_CHARACTERISTIC
/end GROUP
/begin GROUP S1828_FrEDUDrtSta "SWC_INP_type/run_SWC_INP_5ms_sys/INP/CAN3/SignalCheck/MCU_B_F1/FrEDUDrtSta"
 /begin REF_CHARACTERISTIC KINP_FrEDUDrtSta_flg_defval KINP_FrEDUDrtSta_flg_ovrdflg KINP_FrEDUDrtSta_flg_ovrdval /end REF_CHARACTERISTIC
/end GROUP
/begin GROUP S1828_FrEDUOpratingSta "SWC_INP_type/run_SWC_INP_5ms_sys/INP/CAN3/SignalCheck/MCU_B_F1/FrEDUOpratingSta"
 /begin REF_CHARACTERISTIC KINP_FrEDUOpratingSta_flg_defval KINP_FrEDUOpratingSta_flg_ovrdflg KINP_FrEDUOpratingSta_flg_ovrdval /end REF_CHARACTERISTIC
/end GROUP
/begin GROUP S1828_FrEDURealTMTq "SWC_INP_type/run_SWC_INP_5ms_sys/INP/CAN3/SignalCheck/MCU_B_F1/FrEDURealTMTq"
 /begin REF_CHARACTERISTIC KINP_FrEDURealTMTq_Nm_defval KINP_FrEDURealTMTq_Nm_ovrdflg KINP_FrEDURealTMTq_Nm_ovrdval /end REF_CHARACTERISTIC
/end GROUP
/begin GROUP S1828_FrEDURotateDirction "SWC_INP_type/run_SWC_INP_5ms_sys/INP/CAN3/SignalCheck/MCU_B_F1/FrEDURotateDirction"
 /begin REF_CHARACTERISTIC KINP_FrEDURotateDirction_enum_defval KINP_FrEDURotateDirction_enum_ovrdflg KINP_FrEDURotateDirction_enum_ovrdval /end REF_CHARACTERISTIC
/end GROUP
/begin GROUP S1828_FrEDUTqReqFbk "SWC_INP_type/run_SWC_INP_5ms_sys/INP/CAN3/SignalCheck/MCU_B_F1/FrEDUTqReqFbk"
 /begin REF_CHARACTERISTIC KINP_FrEDUTqReqFbk_Nm_defval KINP_FrEDUTqReqFbk_Nm_ovrdflg KINP_FrEDUTqReqFbk_Nm_ovrdval /end REF_CHARACTERISTIC
/end GROUP
/begin GROUP S1828_FrMCU1Chksum "SWC_INP_type/run_SWC_INP_5ms_sys/INP/CAN3/SignalCheck/MCU_B_F1/FrMCU1Chksum"
 /begin REF_CHARACTERISTIC KINP_FrMCU1Chksum_enum_defval KINP_FrMCU1Chksum_enum_ovrdflg KINP_FrMCU1Chksum_enum_ovrdval /end REF_CHARACTERISTIC
/end GROUP
/begin GROUP S1828_FrMCU1RolCnt "SWC_INP_type/run_SWC_INP_5ms_sys/INP/CAN3/SignalCheck/MCU_B_F1/FrMCU1RolCnt"
 /begin REF_CHARACTERISTIC KINP_FrMCU1RolCnt_enum_defval KINP_FrMCU1RolCnt_enum_ovrdflg KINP_FrMCU1RolCnt_enum_ovrdval /end REF_CHARACTERISTIC
/end GROUP
/begin GROUP S1828_FrMCUBAT "SWC_INP_type/run_SWC_INP_5ms_sys/INP/CAN3/SignalCheck/MCU_B_F1/FrMCUBAT"
 /begin REF_CHARACTERISTIC KINP_FrMCUBAT_V_defval KINP_FrMCUBAT_V_ovrdflg KINP_FrMCUBAT_V_ovrdval /end REF_CHARACTERISTIC
/end GROUP
/begin GROUP S1828_FrMCUDCBusCurr "SWC_INP_type/run_SWC_INP_5ms_sys/INP/CAN3/SignalCheck/MCU_B_F1/FrMCUDCBusCurr"
 /begin REF_CHARACTERISTIC KINP_FrMCUDCBusCurr_A_defval KINP_FrMCUDCBusCurr_A_ovrdflg KINP_FrMCUDCBusCurr_A_ovrdval /end REF_CHARACTERISTIC
/end GROUP
/begin GROUP S1828_FrMCUDCBusVolt "SWC_INP_type/run_SWC_INP_5ms_sys/INP/CAN3/SignalCheck/MCU_B_F1/FrMCUDCBusVolt"
 /begin REF_CHARACTERISTIC KINP_FrMCUDCBusVolt_V_defval KINP_FrMCUDCBusVolt_V_ovrdflg KINP_FrMCUDCBusVolt_V_ovrdval /end REF_CHARACTERISTIC
/end GROUP
/begin GROUP S1828_FrMCUDischrgSta "SWC_INP_type/run_SWC_INP_5ms_sys/INP/CAN3/SignalCheck/MCU_B_F1/FrMCUDischrgSta"
 /begin REF_CHARACTERISTIC KINP_FrMCUDischrgSta_flg_defval KINP_FrMCUDischrgSta_flg_ovrdflg KINP_FrMCUDischrgSta_flg_ovrdval /end REF_CHARACTERISTIC
/end GROUP
/begin GROUP S1828_FrMCUEnaSta "SWC_INP_type/run_SWC_INP_5ms_sys/INP/CAN3/SignalCheck/MCU_B_F1/FrMCUEnaSta"
 /begin REF_CHARACTERISTIC KINP_FrMCUEnaSta_flg_defval KINP_FrMCUEnaSta_flg_ovrdflg KINP_FrMCUEnaSta_flg_ovrdval /end REF_CHARACTERISTIC
/end GROUP
/begin GROUP S1828_FrMCUErr "SWC_INP_type/run_SWC_INP_5ms_sys/INP/CAN3/SignalCheck/MCU_B_F1/FrMCUErr"
 /begin REF_CHARACTERISTIC KINP_FrMCUErr_enum_defval KINP_FrMCUErr_enum_ovrdflg KINP_FrMCUErr_enum_ovrdval /end REF_CHARACTERISTIC
/end GROUP
/begin GROUP S1828_FrMCUIGNsta "SWC_INP_type/run_SWC_INP_5ms_sys/INP/CAN3/SignalCheck/MCU_B_F1/FrMCUIGNsta"
 /begin REF_CHARACTERISTIC KINP_FrMCUIGNsta_flg_defval KINP_FrMCUIGNsta_flg_ovrdflg KINP_FrMCUIGNsta_flg_ovrdval /end REF_CHARACTERISTIC
/end GROUP
/begin GROUP S1828_FrMCUReady "SWC_INP_type/run_SWC_INP_5ms_sys/INP/CAN3/SignalCheck/MCU_B_F1/FrMCUReady"
 /begin REF_CHARACTERISTIC KINP_FrMCUReady_flg_defval KINP_FrMCUReady_flg_ovrdflg KINP_FrMCUReady_flg_ovrdval /end REF_CHARACTERISTIC
/end GROUP
/begin GROUP S1828_FrMCUReady4Pre "SWC_INP_type/run_SWC_INP_5ms_sys/INP/CAN3/SignalCheck/MCU_B_F1/FrMCUReady4Pre"
 /begin REF_CHARACTERISTIC KINP_FrMCUReady4Pre_flg_defval KINP_FrMCUReady4Pre_flg_ovrdflg KINP_FrMCUReady4Pre_flg_ovrdval /end REF_CHARACTERISTIC
/end GROUP
/begin GROUP S1828_FrMCUSysSta "SWC_INP_type/run_SWC_INP_5ms_sys/INP/CAN3/SignalCheck/MCU_B_F1/FrMCUSysSta"
 /begin REF_CHARACTERISTIC KINP_FrMCUSysSta_enum_defval KINP_FrMCUSysSta_enum_ovrdflg KINP_FrMCUSysSta_enum_ovrdval /end REF_CHARACTERISTIC
/end GROUP
/begin GROUP S1828_FrMCUTemp "SWC_INP_type/run_SWC_INP_5ms_sys/INP/CAN3/SignalCheck/MCU_B_F1/FrMCUTemp"
 /begin REF_CHARACTERISTIC KINP_FrMCUTemp_C_defval KINP_FrMCUTemp_C_ovrdflg KINP_FrMCUTemp_C_ovrdval /end REF_CHARACTERISTIC
/end GROUP
/begin GROUP S1828_FrMotorAvailTq "SWC_INP_type/run_SWC_INP_5ms_sys/INP/CAN3/SignalCheck/MCU_B_F1/FrMotorAvailTq"
 /begin REF_CHARACTERISTIC KINP_FrMotorAvailTq_Nm_defval KINP_FrMotorAvailTq_Nm_ovrdflg KINP_FrMotorAvailTq_Nm_ovrdval /end REF_CHARACTERISTIC
/end GROUP
/begin GROUP S1828_FrRegenAvailTq "SWC_INP_type/run_SWC_INP_5ms_sys/INP/CAN3/SignalCheck/MCU_B_F1/FrRegenAvailTq"
 /begin REF_CHARACTERISTIC KINP_FrRegenAvailTq_Nm_defval KINP_FrRegenAvailTq_Nm_ovrdflg KINP_FrRegenAvailTq_Nm_ovrdval /end REF_CHARACTERISTIC
/end GROUP
/begin GROUP S1828_FrTMSpd "SWC_INP_type/run_SWC_INP_5ms_sys/INP/CAN3/SignalCheck/MCU_B_F1/FrTMSpd"
 /begin REF_CHARACTERISTIC KINP_FrTMSpd_rpm_defval KINP_FrTMSpd_rpm_ovrdflg KINP_FrTMSpd_rpm_ovrdval /end REF_CHARACTERISTIC
/end GROUP
/begin GROUP S1828_FrTMTemp "SWC_INP_type/run_SWC_INP_5ms_sys/INP/CAN3/SignalCheck/MCU_B_F1/FrTMTemp"
 /begin REF_CHARACTERISTIC KINP_FrTMTemp_C_defval KINP_FrTMTemp_C_ovrdflg KINP_FrTMTemp_C_ovrdval /end REF_CHARACTERISTIC
/end GROUP
/begin GROUP S1828_FrTMid "SWC_INP_type/run_SWC_INP_5ms_sys/INP/CAN3/SignalCheck/MCU_B_F1/FrTMid"
 /begin REF_CHARACTERISTIC KINP_FrTMid_A_defval KINP_FrTMid_A_ovrdflg KINP_FrTMid_A_ovrdval /end REF_CHARACTERISTIC
/end GROUP
/begin GROUP S1828_FrTMiq "SWC_INP_type/run_SWC_INP_5ms_sys/INP/CAN3/SignalCheck/MCU_B_F1/FrTMiq"
 /begin REF_CHARACTERISTIC KINP_FrTMiq_A_defval KINP_FrTMiq_A_ovrdflg KINP_FrTMiq_A_ovrdval /end REF_CHARACTERISTIC
/end GROUP
/begin GROUP S1828_MCUBF1CSErr "SWC_INP_type/run_SWC_INP_5ms_sys/INP/CAN3/SignalCheck/MCU_B_F1/MCUBF1CSErr"
 /begin REF_CHARACTERISTIC KINP_MCUBF1CSErr_flg_defval KINP_MCUBF1CSErr_flg_ovrdflg KINP_MCUBF1CSErr_flg_ovrdval /end REF_CHARACTERISTIC
/end GROUP
/begin GROUP S1828_MCUBF1RCErr "SWC_INP_type/run_SWC_INP_5ms_sys/INP/CAN3/SignalCheck/MCU_B_F1/MCUBF1RCErr"
 /begin REF_CHARACTERISTIC KINP_MCUBF1RCErr_flg_defval KINP_MCUBF1RCErr_flg_ovrdflg KINP_MCUBF1RCErr_flg_ovrdval /end REF_CHARACTERISTIC
/end GROUP
/begin GROUP S1828_MCUBFRealPwrKwSta "SWC_INP_type/run_SWC_INP_5ms_sys/INP/CAN3/SignalCheck/MCU_B_F1/MCUBFRealPwrKwSta"
 /begin REF_CHARACTERISTIC KINP_MCUBFRealPwrKwSta_kW_defval KINP_MCUBFRealPwrKwSta_kW_ovrdflg KINP_MCUBFRealPwrKwSta_kW_ovrdval /end REF_CHARACTERISTIC
/end GROUP
/begin GROUP S1828_MCUWarnF "SWC_INP_type/run_SWC_INP_5ms_sys/INP/CAN3/SignalCheck/MCU_B_F1/MCUWarnF"
 /begin REF_CHARACTERISTIC KINP_MCUWarnF_enum_defval KINP_MCUWarnF_enum_ovrdflg KINP_MCUWarnF_enum_ovrdval /end REF_CHARACTERISTIC
/end GROUP
/begin GROUP S1829_FrCoolanttempReq "SWC_INP_type/run_SWC_INP_5ms_sys/INP/CAN3/SignalCheck/MCU_B_F2/FrCoolanttempReq"
 /begin REF_CHARACTERISTIC KINP_FrCoolanttempReq_C_defval KINP_FrCoolanttempReq_C_ovrdflg KINP_FrCoolanttempReq_C_ovrdval /end REF_CHARACTERISTIC
/end GROUP
/begin GROUP S1829_FrFailcode1 "SWC_INP_type/run_SWC_INP_5ms_sys/INP/CAN3/SignalCheck/MCU_B_F2/FrFailcode1"
 /begin REF_CHARACTERISTIC KINP_FrFailcode1_enum_defval KINP_FrFailcode1_enum_ovrdflg KINP_FrFailcode1_enum_ovrdval /end REF_CHARACTERISTIC
/end GROUP
/begin GROUP S1829_FrFailcode2 "SWC_INP_type/run_SWC_INP_5ms_sys/INP/CAN3/SignalCheck/MCU_B_F2/FrFailcode2"
 /begin REF_CHARACTERISTIC KINP_FrFailcode2_enum_defval KINP_FrFailcode2_enum_ovrdflg KINP_FrFailcode2_enum_ovrdval /end REF_CHARACTERISTIC
/end GROUP
/begin GROUP S1829_FrFailcodehistory1 "SWC_INP_type/run_SWC_INP_5ms_sys/INP/CAN3/SignalCheck/MCU_B_F2/FrFailcodehistory1"
 /begin REF_CHARACTERISTIC KINP_FrFailcodehistory1_enum_defval KINP_FrFailcodehistory1_enum_ovrdflg KINP_FrFailcodehistory1_enum_ovrdval /end REF_CHARACTERISTIC
/end GROUP
/begin GROUP S1829_FrFailcodehistory2 "SWC_INP_type/run_SWC_INP_5ms_sys/INP/CAN3/SignalCheck/MCU_B_F2/FrFailcodehistory2"
 /begin REF_CHARACTERISTIC KINP_FrFailcodehistory2_enum_defval KINP_FrFailcodehistory2_enum_ovrdflg KINP_FrFailcodehistory2_enum_ovrdval /end REF_CHARACTERISTIC
/end GROUP
/begin GROUP S1829_FrLLCTemp "SWC_INP_type/run_SWC_INP_5ms_sys/INP/CAN3/SignalCheck/MCU_B_F2/FrLLCTemp"
 /begin REF_CHARACTERISTIC KINP_FrLLCTemp_C_defval KINP_FrLLCTemp_C_ovrdflg KINP_FrLLCTemp_C_ovrdval /end REF_CHARACTERISTIC
/end GROUP
/begin GROUP S1829_FrLLCflowReq "SWC_INP_type/run_SWC_INP_5ms_sys/INP/CAN3/SignalCheck/MCU_B_F2/FrLLCflowReq"
 /begin REF_CHARACTERISTIC KINP_FrLLCflowReq_Lpmin_defval KINP_FrLLCflowReq_Lpmin_ovrdflg KINP_FrLLCflowReq_Lpmin_ovrdval /end REF_CHARACTERISTIC
/end GROUP
/begin GROUP S1829_FrMCUHWVer "SWC_INP_type/run_SWC_INP_5ms_sys/INP/CAN3/SignalCheck/MCU_B_F2/FrMCUHWVer"
 /begin REF_CHARACTERISTIC KINP_FrMCUHWVer_enum_defval KINP_FrMCUHWVer_enum_ovrdflg KINP_FrMCUHWVer_enum_ovrdval /end REF_CHARACTERISTIC
/end GROUP
/begin GROUP S1829_FrMCUSWVer "SWC_INP_type/run_SWC_INP_5ms_sys/INP/CAN3/SignalCheck/MCU_B_F2/FrMCUSWVer"
 /begin REF_CHARACTERISTIC KINP_FrMCUSWVer_enum_defval KINP_FrMCUSWVer_enum_ovrdflg KINP_FrMCUSWVer_enum_ovrdval /end REF_CHARACTERISTIC
/end GROUP
/begin GROUP S1829_FrMCUTempWarn "SWC_INP_type/run_SWC_INP_5ms_sys/INP/CAN3/SignalCheck/MCU_B_F2/FrMCUTempWarn"
 /begin REF_CHARACTERISTIC KINP_FrMCUTempWarn_enum_defval KINP_FrMCUTempWarn_enum_ovrdflg KINP_FrMCUTempWarn_enum_ovrdval /end REF_CHARACTERISTIC
/end GROUP
/begin GROUP S1829_FrTMTempWarn "SWC_INP_type/run_SWC_INP_5ms_sys/INP/CAN3/SignalCheck/MCU_B_F2/FrTMTempWarn"
 /begin REF_CHARACTERISTIC KINP_FrTMTempWarn_enum_defval KINP_FrTMTempWarn_enum_ovrdflg KINP_FrTMTempWarn_enum_ovrdval /end REF_CHARACTERISTIC
/end GROUP
/begin GROUP S1829_MCUBFLLCTempWarnSta "SWC_INP_type/run_SWC_INP_5ms_sys/INP/CAN3/SignalCheck/MCU_B_F2/MCUBFLLCTempWarnSta"
 /begin REF_CHARACTERISTIC KINP_MCUBFLLCTempWarnSta_enum_defval KINP_MCUBFLLCTempWarnSta_enum_ovrdflg KINP_MCUBFLLCTempWarnSta_enum_ovrdval /end REF_CHARACTERISTIC
/end GROUP
/begin GROUP S1830_MCUBR1CSErr "SWC_INP_type/run_SWC_INP_5ms_sys/INP/CAN3/SignalCheck/MCU_B_R1/MCUBR1CSErr"
 /begin REF_CHARACTERISTIC KINP_MCUBR1CSErr_flg_defval KINP_MCUBR1CSErr_flg_ovrdflg KINP_MCUBR1CSErr_flg_ovrdval /end REF_CHARACTERISTIC
/end GROUP
/begin GROUP S1830_MCUBR1RCErr "SWC_INP_type/run_SWC_INP_5ms_sys/INP/CAN3/SignalCheck/MCU_B_R1/MCUBR1RCErr"
 /begin REF_CHARACTERISTIC KINP_MCUBR1RCErr_flg_defval KINP_MCUBR1RCErr_flg_ovrdflg KINP_MCUBR1RCErr_flg_ovrdval /end REF_CHARACTERISTIC
/end GROUP
/begin GROUP S1830_MCUBRRealPwrKwSta "SWC_INP_type/run_SWC_INP_5ms_sys/INP/CAN3/SignalCheck/MCU_B_R1/MCUBRRealPwrKwSta"
 /begin REF_CHARACTERISTIC KINP_MCUBRRealPwrKwSta_kW_defval KINP_MCUBRRealPwrKwSta_kW_ovrdflg KINP_MCUBRRealPwrKwSta_kW_ovrdval /end REF_CHARACTERISTIC
/end GROUP
/begin GROUP S1830_MCUWarnR "SWC_INP_type/run_SWC_INP_5ms_sys/INP/CAN3/SignalCheck/MCU_B_R1/MCUWarnR"
 /begin REF_CHARACTERISTIC KINP_MCUWarnR_enum_defval KINP_MCUWarnR_enum_ovrdflg KINP_MCUWarnR_enum_ovrdval /end REF_CHARACTERISTIC
/end GROUP
/begin GROUP S1830_RrActvDmpDisabSta "SWC_INP_type/run_SWC_INP_5ms_sys/INP/CAN3/SignalCheck/MCU_B_R1/RrActvDmpDisabSta"
 /begin REF_CHARACTERISTIC KINP_RrActvDmpDisabSta_flg_defval KINP_RrActvDmpDisabSta_flg_ovrdflg KINP_RrActvDmpDisabSta_flg_ovrdval /end REF_CHARACTERISTIC
/end GROUP
/begin GROUP S1830_RrEDUDrtSta "SWC_INP_type/run_SWC_INP_5ms_sys/INP/CAN3/SignalCheck/MCU_B_R1/RrEDUDrtSta"
 /begin REF_CHARACTERISTIC KINP_RrEDUDrtSta_flg_defval KINP_RrEDUDrtSta_flg_ovrdflg KINP_RrEDUDrtSta_flg_ovrdval /end REF_CHARACTERISTIC
/end GROUP
/begin GROUP S1830_RrEDUOpratingSta "SWC_INP_type/run_SWC_INP_5ms_sys/INP/CAN3/SignalCheck/MCU_B_R1/RrEDUOpratingSta"
 /begin REF_CHARACTERISTIC KINP_RrEDUOpratingSta_flg_defval KINP_RrEDUOpratingSta_flg_ovrdflg KINP_RrEDUOpratingSta_flg_ovrdval /end REF_CHARACTERISTIC
/end GROUP
/begin GROUP S1830_RrEDURealTMTq "SWC_INP_type/run_SWC_INP_5ms_sys/INP/CAN3/SignalCheck/MCU_B_R1/RrEDURealTMTq"
 /begin REF_CHARACTERISTIC KINP_RrEDURealTMTq_Nm_defval KINP_RrEDURealTMTq_Nm_ovrdflg KINP_RrEDURealTMTq_Nm_ovrdval /end REF_CHARACTERISTIC
/end GROUP
/begin GROUP S1830_RrEDURotateDirction "SWC_INP_type/run_SWC_INP_5ms_sys/INP/CAN3/SignalCheck/MCU_B_R1/RrEDURotateDirction"
 /begin REF_CHARACTERISTIC KINP_RrEDURotateDirction_enum_defval KINP_RrEDURotateDirction_enum_ovrdflg KINP_RrEDURotateDirction_enum_ovrdval /end REF_CHARACTERISTIC
/end GROUP
/begin GROUP S1830_RrEDUTqReqFbk "SWC_INP_type/run_SWC_INP_5ms_sys/INP/CAN3/SignalCheck/MCU_B_R1/RrEDUTqReqFbk"
 /begin REF_CHARACTERISTIC KINP_RrEDUTqReqFbk_Nm_defval KINP_RrEDUTqReqFbk_Nm_ovrdflg KINP_RrEDUTqReqFbk_Nm_ovrdval /end REF_CHARACTERISTIC
/end GROUP
/begin GROUP S1830_RrMCU1Chksum "SWC_INP_type/run_SWC_INP_5ms_sys/INP/CAN3/SignalCheck/MCU_B_R1/RrMCU1Chksum"
 /begin REF_CHARACTERISTIC KINP_RrMCU1Chksum_enum_defval KINP_RrMCU1Chksum_enum_ovrdflg KINP_RrMCU1Chksum_enum_ovrdval /end REF_CHARACTERISTIC
/end GROUP
/begin GROUP S1830_RrMCU1RolCnt "SWC_INP_type/run_SWC_INP_5ms_sys/INP/CAN3/SignalCheck/MCU_B_R1/RrMCU1RolCnt"
 /begin REF_CHARACTERISTIC KINP_RrMCU1RolCnt_enum_defval KINP_RrMCU1RolCnt_enum_ovrdflg KINP_RrMCU1RolCnt_enum_ovrdval /end REF_CHARACTERISTIC
/end GROUP
/begin GROUP S1830_RrMCUBAT "SWC_INP_type/run_SWC_INP_5ms_sys/INP/CAN3/SignalCheck/MCU_B_R1/RrMCUBAT"
 /begin REF_CHARACTERISTIC KINP_RrMCUBAT_V_defval KINP_RrMCUBAT_V_ovrdflg KINP_RrMCUBAT_V_ovrdval /end REF_CHARACTERISTIC
/end GROUP
/begin GROUP S1830_RrMCUDCBusCurr "SWC_INP_type/run_SWC_INP_5ms_sys/INP/CAN3/SignalCheck/MCU_B_R1/RrMCUDCBusCurr"
 /begin REF_CHARACTERISTIC KINP_RrMCUDCBusCurr_A_defval KINP_RrMCUDCBusCurr_A_ovrdflg KINP_RrMCUDCBusCurr_A_ovrdval /end REF_CHARACTERISTIC
/end GROUP
/begin GROUP S1830_RrMCUDCBusVolt "SWC_INP_type/run_SWC_INP_5ms_sys/INP/CAN3/SignalCheck/MCU_B_R1/RrMCUDCBusVolt"
 /begin REF_CHARACTERISTIC KINP_RrMCUDCBusVolt_V_defval KINP_RrMCUDCBusVolt_V_ovrdflg KINP_RrMCUDCBusVolt_V_ovrdval /end REF_CHARACTERISTIC
/end GROUP
/begin GROUP S1830_RrMCUDischrgSta "SWC_INP_type/run_SWC_INP_5ms_sys/INP/CAN3/SignalCheck/MCU_B_R1/RrMCUDischrgSta"
 /begin REF_CHARACTERISTIC KINP_RrMCUDischrgSta_flg_defval KINP_RrMCUDischrgSta_flg_ovrdflg KINP_RrMCUDischrgSta_flg_ovrdval /end REF_CHARACTERISTIC
/end GROUP
/begin GROUP S1830_RrMCUEnaSta "SWC_INP_type/run_SWC_INP_5ms_sys/INP/CAN3/SignalCheck/MCU_B_R1/RrMCUEnaSta"
 /begin REF_CHARACTERISTIC KINP_RrMCUEnaSta_flg_defval KINP_RrMCUEnaSta_flg_ovrdflg KINP_RrMCUEnaSta_flg_ovrdval /end REF_CHARACTERISTIC
/end GROUP
/begin GROUP S1830_RrMCUErr "SWC_INP_type/run_SWC_INP_5ms_sys/INP/CAN3/SignalCheck/MCU_B_R1/RrMCUErr"
 /begin REF_CHARACTERISTIC KINP_RrMCUErr_enum_defval KINP_RrMCUErr_enum_ovrdflg KINP_RrMCUErr_enum_ovrdval /end REF_CHARACTERISTIC
/end GROUP
/begin GROUP S1830_RrMCUIGNsta "SWC_INP_type/run_SWC_INP_5ms_sys/INP/CAN3/SignalCheck/MCU_B_R1/RrMCUIGNsta"
 /begin REF_CHARACTERISTIC KINP_RrMCUIGNsta_flg_defval KINP_RrMCUIGNsta_flg_ovrdflg KINP_RrMCUIGNsta_flg_ovrdval /end REF_CHARACTERISTIC
/end GROUP
/begin GROUP S1830_RrMCUReady "SWC_INP_type/run_SWC_INP_5ms_sys/INP/CAN3/SignalCheck/MCU_B_R1/RrMCUReady"
 /begin REF_CHARACTERISTIC KINP_RrMCUReady_flg_defval KINP_RrMCUReady_flg_ovrdflg KINP_RrMCUReady_flg_ovrdval /end REF_CHARACTERISTIC
/end GROUP
/begin GROUP S1830_RrMCUReady4Pre "SWC_INP_type/run_SWC_INP_5ms_sys/INP/CAN3/SignalCheck/MCU_B_R1/RrMCUReady4Pre"
 /begin REF_CHARACTERISTIC KINP_RrMCUReady4Pre_flg_defval KINP_RrMCUReady4Pre_flg_ovrdflg KINP_RrMCUReady4Pre_flg_ovrdval /end REF_CHARACTERISTIC
/end GROUP
/begin GROUP S1830_RrMCUSysSta "SWC_INP_type/run_SWC_INP_5ms_sys/INP/CAN3/SignalCheck/MCU_B_R1/RrMCUSysSta"
 /begin REF_CHARACTERISTIC KINP_RrMCUSysSta_enum_defval KINP_RrMCUSysSta_enum_ovrdflg KINP_RrMCUSysSta_enum_ovrdval /end REF_CHARACTERISTIC
/end GROUP
/begin GROUP S1830_RrMCUTemp "SWC_INP_type/run_SWC_INP_5ms_sys/INP/CAN3/SignalCheck/MCU_B_R1/RrMCUTemp"
 /begin REF_CHARACTERISTIC KINP_RrMCUTemp_C_defval KINP_RrMCUTemp_C_ovrdflg KINP_RrMCUTemp_C_ovrdval /end REF_CHARACTERISTIC
/end GROUP
/begin GROUP S1830_RrMotorAvailTq "SWC_INP_type/run_SWC_INP_5ms_sys/INP/CAN3/SignalCheck/MCU_B_R1/RrMotorAvailTq"
 /begin REF_CHARACTERISTIC KINP_RrMotorAvailTq_Nm_defval KINP_RrMotorAvailTq_Nm_ovrdflg KINP_RrMotorAvailTq_Nm_ovrdval /end REF_CHARACTERISTIC
/end GROUP
/begin GROUP S1830_RrRegenAvailTq "SWC_INP_type/run_SWC_INP_5ms_sys/INP/CAN3/SignalCheck/MCU_B_R1/RrRegenAvailTq"
 /begin REF_CHARACTERISTIC KINP_RrRegenAvailTq_Nm_defval KINP_RrRegenAvailTq_Nm_ovrdflg KINP_RrRegenAvailTq_Nm_ovrdval /end REF_CHARACTERISTIC
/end GROUP
/begin GROUP S1830_RrTMSpd "SWC_INP_type/run_SWC_INP_5ms_sys/INP/CAN3/SignalCheck/MCU_B_R1/RrTMSpd"
 /begin REF_CHARACTERISTIC KINP_RrTMSpd_rpm_defval KINP_RrTMSpd_rpm_ovrdflg KINP_RrTMSpd_rpm_ovrdval /end REF_CHARACTERISTIC
/end GROUP
/begin GROUP S1830_RrTMTemp "SWC_INP_type/run_SWC_INP_5ms_sys/INP/CAN3/SignalCheck/MCU_B_R1/RrTMTemp"
 /begin REF_CHARACTERISTIC KINP_RrTMTemp_C_defval KINP_RrTMTemp_C_ovrdflg KINP_RrTMTemp_C_ovrdval /end REF_CHARACTERISTIC
/end GROUP
/begin GROUP S1830_RrTMid "SWC_INP_type/run_SWC_INP_5ms_sys/INP/CAN3/SignalCheck/MCU_B_R1/RrTMid"
 /begin REF_CHARACTERISTIC KINP_RrTMid_A_defval KINP_RrTMid_A_ovrdflg KINP_RrTMid_A_ovrdval /end REF_CHARACTERISTIC
/end GROUP
/begin GROUP S1830_RrTMiq "SWC_INP_type/run_SWC_INP_5ms_sys/INP/CAN3/SignalCheck/MCU_B_R1/RrTMiq"
 /begin REF_CHARACTERISTIC KINP_RrTMiq_A_defval KINP_RrTMiq_A_ovrdflg KINP_RrTMiq_A_ovrdval /end REF_CHARACTERISTIC
/end GROUP
/begin GROUP S1831_MCUBRLLCTempWarnSta "SWC_INP_type/run_SWC_INP_5ms_sys/INP/CAN3/SignalCheck/MCU_B_R2/MCUBRLLCTempWarnSta"
 /begin REF_CHARACTERISTIC KINP_MCUBRLLCTempWarnSta_enum_defval KINP_MCUBRLLCTempWarnSta_enum_ovrdflg KINP_MCUBRLLCTempWarnSta_enum_ovrdval /end REF_CHARACTERISTIC
/end GROUP
/begin GROUP S1831_RrCoolanttempReq "SWC_INP_type/run_SWC_INP_5ms_sys/INP/CAN3/SignalCheck/MCU_B_R2/RrCoolanttempReq"
 /begin REF_CHARACTERISTIC KINP_RrCoolanttempReq_cnt_defval KINP_RrCoolanttempReq_cnt_ovrdflg KINP_RrCoolanttempReq_cnt_ovrdval /end REF_CHARACTERISTIC
/end GROUP
/begin GROUP S1831_RrFailcode1 "SWC_INP_type/run_SWC_INP_5ms_sys/INP/CAN3/SignalCheck/MCU_B_R2/RrFailcode1"
 /begin REF_CHARACTERISTIC KINP_RrFailcode1_enum_defval KINP_RrFailcode1_enum_ovrdflg KINP_RrFailcode1_enum_ovrdval /end REF_CHARACTERISTIC
/end GROUP
/begin GROUP S1831_RrFailcode2 "SWC_INP_type/run_SWC_INP_5ms_sys/INP/CAN3/SignalCheck/MCU_B_R2/RrFailcode2"
 /begin REF_CHARACTERISTIC KINP_RrFailcode2_enum_defval KINP_RrFailcode2_enum_ovrdflg KINP_RrFailcode2_enum_ovrdval /end REF_CHARACTERISTIC
/end GROUP
/begin GROUP S1831_RrFailcodehistory1 "SWC_INP_type/run_SWC_INP_5ms_sys/INP/CAN3/SignalCheck/MCU_B_R2/RrFailcodehistory1"
 /begin REF_CHARACTERISTIC KINP_RrFailcodehistory1_enum_defval KINP_RrFailcodehistory1_enum_ovrdflg KINP_RrFailcodehistory1_enum_ovrdval /end REF_CHARACTERISTIC
/end GROUP
/begin GROUP S1831_RrFailcodehistory2 "SWC_INP_type/run_SWC_INP_5ms_sys/INP/CAN3/SignalCheck/MCU_B_R2/RrFailcodehistory2"
 /begin REF_CHARACTERISTIC KINP_RrFailcodehistory2_enum_defval KINP_RrFailcodehistory2_enum_ovrdflg KINP_RrFailcodehistory2_enum_ovrdval /end REF_CHARACTERISTIC
/end GROUP
/begin GROUP S1831_RrLLCTemp "SWC_INP_type/run_SWC_INP_5ms_sys/INP/CAN3/SignalCheck/MCU_B_R2/RrLLCTemp"
 /begin REF_CHARACTERISTIC KINP_RrLLCTemp_C_defval KINP_RrLLCTemp_C_ovrdflg KINP_RrLLCTemp_C_ovrdval /end REF_CHARACTERISTIC
/end GROUP
/begin GROUP S1831_RrLLCflowReq "SWC_INP_type/run_SWC_INP_5ms_sys/INP/CAN3/SignalCheck/MCU_B_R2/RrLLCflowReq"
 /begin REF_CHARACTERISTIC KINP_RrLLCflowReq_Lpmin_defval KINP_RrLLCflowReq_Lpmin_ovrdflg KINP_RrLLCflowReq_Lpmin_ovrdval /end REF_CHARACTERISTIC
/end GROUP
/begin GROUP S1831_RrMCU3HWVer "SWC_INP_type/run_SWC_INP_5ms_sys/INP/CAN3/SignalCheck/MCU_B_R2/RrMCU3HWVer"
 /begin REF_CHARACTERISTIC KINP_RrMCU3HWVer_enum_defval KINP_RrMCU3HWVer_enum_ovrdflg KINP_RrMCU3HWVer_enum_ovrdval /end REF_CHARACTERISTIC
/end GROUP
/begin GROUP S1831_RrMCU3SWVer "SWC_INP_type/run_SWC_INP_5ms_sys/INP/CAN3/SignalCheck/MCU_B_R2/RrMCU3SWVer"
 /begin REF_CHARACTERISTIC KINP_RrMCU3SWVer_enum_defval KINP_RrMCU3SWVer_enum_ovrdflg KINP_RrMCU3SWVer_enum_ovrdval /end REF_CHARACTERISTIC
/end GROUP
/begin GROUP S1831_RrMCUTempWarn "SWC_INP_type/run_SWC_INP_5ms_sys/INP/CAN3/SignalCheck/MCU_B_R2/RrMCUTempWarn"
 /begin REF_CHARACTERISTIC KINP_RrMCUTempWarn_enum_defval KINP_RrMCUTempWarn_enum_ovrdflg KINP_RrMCUTempWarn_enum_ovrdval /end REF_CHARACTERISTIC
/end GROUP
/begin GROUP S1831_RrTMTempWarn "SWC_INP_type/run_SWC_INP_5ms_sys/INP/CAN3/SignalCheck/MCU_B_R2/RrTMTempWarn"
 /begin REF_CHARACTERISTIC KINP_RrTMTempWarn_enum_defval KINP_RrTMTempWarn_enum_ovrdflg KINP_RrTMTempWarn_enum_ovrdval /end REF_CHARACTERISTIC
/end GROUP
/begin GROUP S1832_FrActvDmpDisabStaNidec "SWC_INP_type/run_SWC_INP_5ms_sys/INP/CAN3/SignalCheck/MCU_N_F1/FrActvDmpDisabStaNidec"
 /begin REF_CHARACTERISTIC KINP_FrActvDmpDisabStaNidec_flg_defval KINP_FrActvDmpDisabStaNidec_flg_ovrdflg KINP_FrActvDmpDisabStaNidec_flg_ovrdval /end REF_CHARACTERISTIC
/end GROUP
/begin GROUP S1832_FrEDUDrtStaNidec "SWC_INP_type/run_SWC_INP_5ms_sys/INP/CAN3/SignalCheck/MCU_N_F1/FrEDUDrtStaNidec"
 /begin REF_CHARACTERISTIC KINP_FrEDUDrtStaNidec_flg_defval KINP_FrEDUDrtStaNidec_flg_ovrdflg KINP_FrEDUDrtStaNidec_flg_ovrdval /end REF_CHARACTERISTIC
/end GROUP
/begin GROUP S1832_FrEDUOpratingStaNidec "SWC_INP_type/run_SWC_INP_5ms_sys/INP/CAN3/SignalCheck/MCU_N_F1/FrEDUOpratingStaNidec"
 /begin REF_CHARACTERISTIC KINP_FrEDUOpratingStaNidec_flg_defval KINP_FrEDUOpratingStaNidec_flg_ovrdflg KINP_FrEDUOpratingStaNidec_flg_ovrdval /end REF_CHARACTERISTIC
/end GROUP
/begin GROUP S1832_FrEDURealTMTqNidec "SWC_INP_type/run_SWC_INP_5ms_sys/INP/CAN3/SignalCheck/MCU_N_F1/FrEDURealTMTqNidec"
 /begin REF_CHARACTERISTIC KINP_FrEDURealTMTqNidec_Nm_defval KINP_FrEDURealTMTqNidec_Nm_ovrdflg KINP_FrEDURealTMTqNidec_Nm_ovrdval /end REF_CHARACTERISTIC
/end GROUP
/begin GROUP S1832_FrEDURotateDirctionNidec "SWC_INP_type/run_SWC_INP_5ms_sys/INP/CAN3/SignalCheck/MCU_N_F1/FrEDURotateDirctionNidec"
 /begin REF_CHARACTERISTIC KINP_FrEDURotateDirctionNidec_enum_defval KINP_FrEDURotateDirctionNidec_enum_ovrdflg KINP_FrEDURotateDirctionNidec_enum_ovrdval /end REF_CHARACTERISTIC
/end GROUP
/begin GROUP S1832_FrEDUTqReqFbkNidec "SWC_INP_type/run_SWC_INP_5ms_sys/INP/CAN3/SignalCheck/MCU_N_F1/FrEDUTqReqFbkNidec"
 /begin REF_CHARACTERISTIC KINP_FrEDUTqReqFbkNidec_Nm_defval KINP_FrEDUTqReqFbkNidec_Nm_ovrdflg KINP_FrEDUTqReqFbkNidec_Nm_ovrdval /end REF_CHARACTERISTIC
/end GROUP
/begin GROUP S1832_FrMCU1ChksumNidec "SWC_INP_type/run_SWC_INP_5ms_sys/INP/CAN3/SignalCheck/MCU_N_F1/FrMCU1ChksumNidec"
 /begin REF_CHARACTERISTIC KINP_FrMCU1ChksumNidec_enum_defval KINP_FrMCU1ChksumNidec_enum_ovrdflg KINP_FrMCU1ChksumNidec_enum_ovrdval /end REF_CHARACTERISTIC
/end GROUP
/begin GROUP S1832_FrMCU1RolCntNidec "SWC_INP_type/run_SWC_INP_5ms_sys/INP/CAN3/SignalCheck/MCU_N_F1/FrMCU1RolCntNidec"
 /begin REF_CHARACTERISTIC KINP_FrMCU1RolCntNidec_enum_defval KINP_FrMCU1RolCntNidec_enum_ovrdflg KINP_FrMCU1RolCntNidec_enum_ovrdval /end REF_CHARACTERISTIC
/end GROUP
/begin GROUP S1832_FrMCUBATNidec "SWC_INP_type/run_SWC_INP_5ms_sys/INP/CAN3/SignalCheck/MCU_N_F1/FrMCUBATNidec"
 /begin REF_CHARACTERISTIC KINP_FrMCUBATNidec_V_defval KINP_FrMCUBATNidec_V_ovrdflg KINP_FrMCUBATNidec_V_ovrdval /end REF_CHARACTERISTIC
/end GROUP
/begin GROUP S1832_FrMCUDCBusCurrNidec "SWC_INP_type/run_SWC_INP_5ms_sys/INP/CAN3/SignalCheck/MCU_N_F1/FrMCUDCBusCurrNidec"
 /begin REF_CHARACTERISTIC KINP_FrMCUDCBusCurrNidec_A_defval KINP_FrMCUDCBusCurrNidec_A_ovrdflg KINP_FrMCUDCBusCurrNidec_A_ovrdval /end REF_CHARACTERISTIC
/end GROUP
/begin GROUP S1832_FrMCUDCBusVoltNidec "SWC_INP_type/run_SWC_INP_5ms_sys/INP/CAN3/SignalCheck/MCU_N_F1/FrMCUDCBusVoltNidec"
 /begin REF_CHARACTERISTIC KINP_FrMCUDCBusVoltNidec_V_defval KINP_FrMCUDCBusVoltNidec_V_ovrdflg KINP_FrMCUDCBusVoltNidec_V_ovrdval /end REF_CHARACTERISTIC
/end GROUP
/begin GROUP S1832_FrMCUDischrgStaNidec "SWC_INP_type/run_SWC_INP_5ms_sys/INP/CAN3/SignalCheck/MCU_N_F1/FrMCUDischrgStaNidec"
 /begin REF_CHARACTERISTIC KINP_FrMCUDischrgStaNidec_flg_defval KINP_FrMCUDischrgStaNidec_flg_ovrdflg KINP_FrMCUDischrgStaNidec_flg_ovrdval /end REF_CHARACTERISTIC
/end GROUP
/begin GROUP S1832_FrMCUEnaStaNidec "SWC_INP_type/run_SWC_INP_5ms_sys/INP/CAN3/SignalCheck/MCU_N_F1/FrMCUEnaStaNidec"
 /begin REF_CHARACTERISTIC KINP_FrMCUEnaStaNidec_flg_defval KINP_FrMCUEnaStaNidec_flg_ovrdflg KINP_FrMCUEnaStaNidec_flg_ovrdval /end REF_CHARACTERISTIC
/end GROUP
/begin GROUP S1832_FrMCUErrNidec "SWC_INP_type/run_SWC_INP_5ms_sys/INP/CAN3/SignalCheck/MCU_N_F1/FrMCUErrNidec"
 /begin REF_CHARACTERISTIC KINP_FrMCUErrNidec_enum_defval KINP_FrMCUErrNidec_enum_ovrdflg KINP_FrMCUErrNidec_enum_ovrdval /end REF_CHARACTERISTIC
/end GROUP
/begin GROUP S1832_FrMCUIGNstaNidec "SWC_INP_type/run_SWC_INP_5ms_sys/INP/CAN3/SignalCheck/MCU_N_F1/FrMCUIGNstaNidec"
 /begin REF_CHARACTERISTIC KINP_FrMCUIGNstaNidec_flg_defval KINP_FrMCUIGNstaNidec_flg_ovrdflg KINP_FrMCUIGNstaNidec_flg_ovrdval /end REF_CHARACTERISTIC
/end GROUP
/begin GROUP S1832_FrMCUReady4PreNidec "SWC_INP_type/run_SWC_INP_5ms_sys/INP/CAN3/SignalCheck/MCU_N_F1/FrMCUReady4PreNidec"
 /begin REF_CHARACTERISTIC KINP_FrMCUReady4PreNidec_flg_defval KINP_FrMCUReady4PreNidec_flg_ovrdflg KINP_FrMCUReady4PreNidec_flg_ovrdval /end REF_CHARACTERISTIC
/end GROUP
/begin GROUP S1832_FrMCUReadyNidec "SWC_INP_type/run_SWC_INP_5ms_sys/INP/CAN3/SignalCheck/MCU_N_F1/FrMCUReadyNidec"
 /begin REF_CHARACTERISTIC KINP_FrMCUReadyNidec_flg_defval KINP_FrMCUReadyNidec_flg_ovrdflg KINP_FrMCUReadyNidec_flg_ovrdval /end REF_CHARACTERISTIC
/end GROUP
/begin GROUP S1832_FrMCUSysStaNidec "SWC_INP_type/run_SWC_INP_5ms_sys/INP/CAN3/SignalCheck/MCU_N_F1/FrMCUSysStaNidec"
 /begin REF_CHARACTERISTIC KINP_FrMCUSysStaNidec_enum_defval KINP_FrMCUSysStaNidec_enum_ovrdflg KINP_FrMCUSysStaNidec_enum_ovrdval /end REF_CHARACTERISTIC
/end GROUP
/begin GROUP S1832_FrMCUTempNidec "SWC_INP_type/run_SWC_INP_5ms_sys/INP/CAN3/SignalCheck/MCU_N_F1/FrMCUTempNidec"
 /begin REF_CHARACTERISTIC KINP_FrMCUTempNidec_C_defval KINP_FrMCUTempNidec_C_ovrdflg KINP_FrMCUTempNidec_C_ovrdval /end REF_CHARACTERISTIC
/end GROUP
/begin GROUP S1832_FrMotorAvailTqNidec "SWC_INP_type/run_SWC_INP_5ms_sys/INP/CAN3/SignalCheck/MCU_N_F1/FrMotorAvailTqNidec"
 /begin REF_CHARACTERISTIC KINP_FrMotorAvailTqNidec_Nm_defval KINP_FrMotorAvailTqNidec_Nm_ovrdflg KINP_FrMotorAvailTqNidec_Nm_ovrdval /end REF_CHARACTERISTIC
/end GROUP
/begin GROUP S1832_FrRegenAvailTqNidec "SWC_INP_type/run_SWC_INP_5ms_sys/INP/CAN3/SignalCheck/MCU_N_F1/FrRegenAvailTqNidec"
 /begin REF_CHARACTERISTIC KINP_FrRegenAvailTqNidec_Nm_defval KINP_FrRegenAvailTqNidec_Nm_ovrdflg KINP_FrRegenAvailTqNidec_Nm_ovrdval /end REF_CHARACTERISTIC
/end GROUP
/begin GROUP S1832_FrTMSpdNidec "SWC_INP_type/run_SWC_INP_5ms_sys/INP/CAN3/SignalCheck/MCU_N_F1/FrTMSpdNidec"
 /begin REF_CHARACTERISTIC KINP_FrTMSpdNidec_rpm_defval KINP_FrTMSpdNidec_rpm_ovrdflg KINP_FrTMSpdNidec_rpm_ovrdval /end REF_CHARACTERISTIC
/end GROUP
/begin GROUP S1832_FrTMTempNidec "SWC_INP_type/run_SWC_INP_5ms_sys/INP/CAN3/SignalCheck/MCU_N_F1/FrTMTempNidec"
 /begin REF_CHARACTERISTIC KINP_FrTMTempNidec_C_defval KINP_FrTMTempNidec_C_ovrdflg KINP_FrTMTempNidec_C_ovrdval /end REF_CHARACTERISTIC
/end GROUP
/begin GROUP S1832_FrTMidNidec "SWC_INP_type/run_SWC_INP_5ms_sys/INP/CAN3/SignalCheck/MCU_N_F1/FrTMidNidec"
 /begin REF_CHARACTERISTIC KINP_FrTMidNidec_A_defval KINP_FrTMidNidec_A_ovrdflg KINP_FrTMidNidec_A_ovrdval /end REF_CHARACTERISTIC
/end GROUP
/begin GROUP S1832_FrTMiqNidec "SWC_INP_type/run_SWC_INP_5ms_sys/INP/CAN3/SignalCheck/MCU_N_F1/FrTMiqNidec"
 /begin REF_CHARACTERISTIC KINP_FrTMiqNidec_A_defval KINP_FrTMiqNidec_A_ovrdflg KINP_FrTMiqNidec_A_ovrdval /end REF_CHARACTERISTIC
/end GROUP
/begin GROUP S1832_MCUNF1CSErr "SWC_INP_type/run_SWC_INP_5ms_sys/INP/CAN3/SignalCheck/MCU_N_F1/MCUNF1CSErr"
 /begin REF_CHARACTERISTIC KINP_MCUNF1CSErr_flg_defval KINP_MCUNF1CSErr_flg_ovrdflg KINP_MCUNF1CSErr_flg_ovrdval /end REF_CHARACTERISTIC
/end GROUP
/begin GROUP S1832_MCUNF1RCErr "SWC_INP_type/run_SWC_INP_5ms_sys/INP/CAN3/SignalCheck/MCU_N_F1/MCUNF1RCErr"
 /begin REF_CHARACTERISTIC KINP_MCUNF1RCErr_flg_defval KINP_MCUNF1RCErr_flg_ovrdflg KINP_MCUNF1RCErr_flg_ovrdval /end REF_CHARACTERISTIC
/end GROUP
/begin GROUP S1832_MCUWarnFNidec "SWC_INP_type/run_SWC_INP_5ms_sys/INP/CAN3/SignalCheck/MCU_N_F1/MCUWarnFNidec"
 /begin REF_CHARACTERISTIC KINP_MCUWarnFNidec_enum_defval KINP_MCUWarnFNidec_enum_ovrdflg KINP_MCUWarnFNidec_enum_ovrdval /end REF_CHARACTERISTIC
/end GROUP
/begin GROUP S1833_FrCoolanttempReqNidec "SWC_INP_type/run_SWC_INP_5ms_sys/INP/CAN3/SignalCheck/MCU_N_F2/FrCoolanttempReqNidec"
 /begin REF_CHARACTERISTIC KINP_FrCoolanttempReqNidec_C_defval KINP_FrCoolanttempReqNidec_C_ovrdflg KINP_FrCoolanttempReqNidec_C_ovrdval /end REF_CHARACTERISTIC
/end GROUP
/begin GROUP S1833_FrEOPSpdSetNidec "SWC_INP_type/run_SWC_INP_5ms_sys/INP/CAN3/SignalCheck/MCU_N_F2/FrEOPSpdSetNidec"
 /begin REF_CHARACTERISTIC KINP_FrEOPSpdSetNidec_rpm_defval KINP_FrEOPSpdSetNidec_rpm_ovrdflg KINP_FrEOPSpdSetNidec_rpm_ovrdval /end REF_CHARACTERISTIC
/end GROUP
/begin GROUP S1833_FrFailcode1Nidec "SWC_INP_type/run_SWC_INP_5ms_sys/INP/CAN3/SignalCheck/MCU_N_F2/FrFailcode1Nidec"
 /begin REF_CHARACTERISTIC KINP_FrFailcode1Nidec_enum_defval KINP_FrFailcode1Nidec_enum_ovrdflg KINP_FrFailcode1Nidec_enum_ovrdval /end REF_CHARACTERISTIC
/end GROUP
/begin GROUP S1833_FrFailcode2Nidec "SWC_INP_type/run_SWC_INP_5ms_sys/INP/CAN3/SignalCheck/MCU_N_F2/FrFailcode2Nidec"
 /begin REF_CHARACTERISTIC KINP_FrFailcode2Nidec_enum_defval KINP_FrFailcode2Nidec_enum_ovrdflg KINP_FrFailcode2Nidec_enum_ovrdval /end REF_CHARACTERISTIC
/end GROUP
/begin GROUP S1833_FrFailcodehistory1Nidec "SWC_INP_type/run_SWC_INP_5ms_sys/INP/CAN3/SignalCheck/MCU_N_F2/FrFailcodehistory1Nidec"
 /begin REF_CHARACTERISTIC KINP_FrFailcodehistory1Nidec_enum_defval KINP_FrFailcodehistory1Nidec_enum_ovrdflg KINP_FrFailcodehistory1Nidec_enum_ovrdval /end REF_CHARACTERISTIC
/end GROUP
/end MODULE
/end PROJECT
