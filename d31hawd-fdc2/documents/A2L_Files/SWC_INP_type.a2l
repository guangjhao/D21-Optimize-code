ASAP2_VERSION 1 31
/begin PROJECT ProjectName "Project Comment Goes Here"
/begin HEADER "Header Comments go here" /end HEADER
/begin MODULE ModuleName "Module Comment Goes Here"
/begin MOD_COMMON "Mod Common Comment Here" BYTE_ORDER MSB_LAST /end MOD_COMMON
/begin RECORD_LAYOUT Scalar_BOOLEAN FNC_VALUES 1 UBYTE COLUMN_DIR DIRECT /end RECORD_LAYOUT
/begin RECORD_LAYOUT Scalar_UBYTE FNC_VALUES 1 UBYTE COLUMN_DIR DIRECT /end RECORD_LAYOUT
/begin RECORD_LAYOUT Scalar_ULONG FNC_VALUES 1 ULONG COLUMN_DIR DIRECT /end RECORD_LAYOUT
/begin RECORD_LAYOUT Scalar_FLOAT32_IEEE FNC_VALUES 1 FLOAT32_IEEE COLUMN_DIR DIRECT /end RECORD_LAYOUT
/begin RECORD_LAYOUT Lookup1D_BYTE FNC_VALUES 1 SBYTE COLUMN_DIR DIRECT /end RECORD_LAYOUT
/begin RECORD_LAYOUT Lookup1D_X_BYTE AXIS_PTS_X 1 SBYTE INDEX_INCR DIRECT /end RECORD_LAYOUT
/begin RECORD_LAYOUT Lookup1D_UBYTE FNC_VALUES 1 UBYTE COLUMN_DIR DIRECT /end RECORD_LAYOUT
/begin RECORD_LAYOUT Lookup1D_X_UBYTE AXIS_PTS_X 1 UBYTE INDEX_INCR DIRECT /end RECORD_LAYOUT
/begin RECORD_LAYOUT Lookup1D_UWORD FNC_VALUES 1 UWORD COLUMN_DIR DIRECT /end RECORD_LAYOUT
/begin RECORD_LAYOUT Lookup1D_X_UWORD AXIS_PTS_X 1 UWORD INDEX_INCR DIRECT /end RECORD_LAYOUT
/begin RECORD_LAYOUT Lookup1D_WORD FNC_VALUES 1 SWORD COLUMN_DIR DIRECT /end RECORD_LAYOUT
/begin CHARACTERISTIC KINP_AccelPedal1Vol_V_defval "" VALUE 0x0000 /* @ECU_Address@KINP_AccelPedal1Vol_V_defval@ */ Scalar_FLOAT32_IEEE 0 SWC_INP_type_CM_single_V 0.0 10.0 /end CHARACTERISTIC
/begin CHARACTERISTIC KINP_AccelPedal1Vol_V_limlow "" VALUE 0x0000 /* @ECU_Address@KINP_AccelPedal1Vol_V_limlow@ */ Scalar_FLOAT32_IEEE 0 SWC_INP_type_CM_single_V 0.0 10.0 /end CHARACTERISTIC
/begin CHARACTERISTIC KINP_AccelPedal1Vol_V_limupr "" VALUE 0x0000 /* @ECU_Address@KINP_AccelPedal1Vol_V_limupr@ */ Scalar_FLOAT32_IEEE 0 SWC_INP_type_CM_single_V 0.0 10.0 /end CHARACTERISTIC
/begin CHARACTERISTIC KINP_AccelPedal1Vol_V_ovrdval "" VALUE 0x0000 /* @ECU_Address@KINP_AccelPedal1Vol_V_ovrdval@ */ Scalar_FLOAT32_IEEE 0 SWC_INP_type_CM_single_V 0.0 10.0 /end CHARACTERISTIC
/begin CHARACTERISTIC KINP_AccelPedal1Vol_V_srvcval "" VALUE 0x0000 /* @ECU_Address@KINP_AccelPedal1Vol_V_srvcval@ */ Scalar_FLOAT32_IEEE 0 SWC_INP_type_CM_single_V 0.0 10.0 /end CHARACTERISTIC
/begin CHARACTERISTIC KINP_AccelPedal1Vol_V_tcfilt "" VALUE 0x0000 /* @ECU_Address@KINP_AccelPedal1Vol_V_tcfilt@ */ Scalar_FLOAT32_IEEE 0 SWC_INP_type_CM_single_tc 0.0 1.0 /end CHARACTERISTIC
/begin CHARACTERISTIC KINP_AccelPedal2Vol_V_defval "" VALUE 0x0000 /* @ECU_Address@KINP_AccelPedal2Vol_V_defval@ */ Scalar_FLOAT32_IEEE 0 SWC_INP_type_CM_single_V 0.0 10.0 /end CHARACTERISTIC
/begin CHARACTERISTIC KINP_AccelPedal2Vol_V_limlow "" VALUE 0x0000 /* @ECU_Address@KINP_AccelPedal2Vol_V_limlow@ */ Scalar_FLOAT32_IEEE 0 SWC_INP_type_CM_single_V 0.0 10.0 /end CHARACTERISTIC
/begin CHARACTERISTIC KINP_AccelPedal2Vol_V_limupr "" VALUE 0x0000 /* @ECU_Address@KINP_AccelPedal2Vol_V_limupr@ */ Scalar_FLOAT32_IEEE 0 SWC_INP_type_CM_single_V 0.0 10.0 /end CHARACTERISTIC
/begin CHARACTERISTIC KINP_AccelPedal2Vol_V_ovrdval "" VALUE 0x0000 /* @ECU_Address@KINP_AccelPedal2Vol_V_ovrdval@ */ Scalar_FLOAT32_IEEE 0 SWC_INP_type_CM_single_V 0.0 10.0 /end CHARACTERISTIC
/begin CHARACTERISTIC KINP_AccelPedal2Vol_V_srvcval "" VALUE 0x0000 /* @ECU_Address@KINP_AccelPedal2Vol_V_srvcval@ */ Scalar_FLOAT32_IEEE 0 SWC_INP_type_CM_single_V 0.0 10.0 /end CHARACTERISTIC
/begin CHARACTERISTIC KINP_AccelPedal2Vol_V_tcfilt "" VALUE 0x0000 /* @ECU_Address@KINP_AccelPedal2Vol_V_tcfilt@ */ Scalar_FLOAT32_IEEE 0 SWC_INP_type_CM_single_tc 0.0 1.0 /end CHARACTERISTIC
/begin CHARACTERISTIC KINP_FrntAxlTrqReqDrv_Nm_defval "" VALUE 0x0000 /* @ECU_Address@KINP_FrntAxlTrqReqDrv_Nm_defval@ */ Scalar_FLOAT32_IEEE 0 SWC_INP_type_CM_single_Nm 0.0 5300.0 /end CHARACTERISTIC
/begin CHARACTERISTIC KINP_FrntAxlTrqReqDrv_Nm_ovrdval "" VALUE 0x0000 /* @ECU_Address@KINP_FrntAxlTrqReqDrv_Nm_ovrdval@ */ Scalar_FLOAT32_IEEE 0 SWC_INP_type_CM_single_Nm 0.0 5300.0 /end CHARACTERISTIC
/begin CHARACTERISTIC KINP_GRADE_Deg_defval "" VALUE 0x0000 /* @ECU_Address@KINP_GRADE_Deg_defval@ */ Scalar_FLOAT32_IEEE 0 SWC_INP_type_CM_single_Deg -45.0 45.0 /end CHARACTERISTIC
/begin CHARACTERISTIC KINP_GRADE_Deg_ovrdval "" VALUE 0x0000 /* @ECU_Address@KINP_GRADE_Deg_ovrdval@ */ Scalar_FLOAT32_IEEE 0 SWC_INP_type_CM_single_Deg -45.0 45.0 /end CHARACTERISTIC
/begin CHARACTERISTIC KINP_LFRawWhlSpeed_kph_defval "" VALUE 0x0000 /* @ECU_Address@KINP_LFRawWhlSpeed_kph_defval@ */ Scalar_FLOAT32_IEEE 0 SWC_INP_type_CM_single_kph 0.0 255.9375 /end CHARACTERISTIC
/begin CHARACTERISTIC KINP_LFRawWhlSpeed_kph_ovrdval "" VALUE 0x0000 /* @ECU_Address@KINP_LFRawWhlSpeed_kph_ovrdval@ */ Scalar_FLOAT32_IEEE 0 SWC_INP_type_CM_single_kph 0.0 255.9375 /end CHARACTERISTIC
/begin CHARACTERISTIC KINP_LRRawWhlSpeed_kph_defval "" VALUE 0x0000 /* @ECU_Address@KINP_LRRawWhlSpeed_kph_defval@ */ Scalar_FLOAT32_IEEE 0 SWC_INP_type_CM_single_kph 0.0 255.9375 /end CHARACTERISTIC
/begin CHARACTERISTIC KINP_LRRawWhlSpeed_kph_ovrdval "" VALUE 0x0000 /* @ECU_Address@KINP_LRRawWhlSpeed_kph_ovrdval@ */ Scalar_FLOAT32_IEEE 0 SWC_INP_type_CM_single_kph 0.0 255.9375 /end CHARACTERISTIC
/begin CHARACTERISTIC KINP_RFRawWhlSpeed_kph_defval "" VALUE 0x0000 /* @ECU_Address@KINP_RFRawWhlSpeed_kph_defval@ */ Scalar_FLOAT32_IEEE 0 SWC_INP_type_CM_single_kph 0.0 255.9375 /end CHARACTERISTIC
/begin CHARACTERISTIC KINP_RFRawWhlSpeed_kph_ovrdval "" VALUE 0x0000 /* @ECU_Address@KINP_RFRawWhlSpeed_kph_ovrdval@ */ Scalar_FLOAT32_IEEE 0 SWC_INP_type_CM_single_kph 0.0 255.9375 /end CHARACTERISTIC
/begin CHARACTERISTIC KINP_RRRawWhlSpeed_kph_defval "" VALUE 0x0000 /* @ECU_Address@KINP_RRRawWhlSpeed_kph_defval@ */ Scalar_FLOAT32_IEEE 0 SWC_INP_type_CM_single_kph 0.0 255.9375 /end CHARACTERISTIC
/begin CHARACTERISTIC KINP_RRRawWhlSpeed_kph_ovrdval "" VALUE 0x0000 /* @ECU_Address@KINP_RRRawWhlSpeed_kph_ovrdval@ */ Scalar_FLOAT32_IEEE 0 SWC_INP_type_CM_single_kph 0.0 255.9375 /end CHARACTERISTIC
/begin CHARACTERISTIC KINP_RearAxlTrqReqDrv_Nm_defval "" VALUE 0x0000 /* @ECU_Address@KINP_RearAxlTrqReqDrv_Nm_defval@ */ Scalar_FLOAT32_IEEE 0 SWC_INP_type_CM_single_Nm 0.0 5300.0 /end CHARACTERISTIC
/begin CHARACTERISTIC KINP_RearAxlTrqReqDrv_Nm_ovrdval "" VALUE 0x0000 /* @ECU_Address@KINP_RearAxlTrqReqDrv_Nm_ovrdval@ */ Scalar_FLOAT32_IEEE 0 SWC_INP_type_CM_single_Nm 0.0 5300.0 /end CHARACTERISTIC
/begin CHARACTERISTIC KINP_SASAngle_Deg_defval "" VALUE 0x0000 /* @ECU_Address@KINP_SASAngle_Deg_defval@ */ Scalar_FLOAT32_IEEE 0 SWC_INP_type_CM_single_Deg -900.0 900.0 /end CHARACTERISTIC
/begin CHARACTERISTIC KINP_SASAngle_Deg_ovrdval "" VALUE 0x0000 /* @ECU_Address@KINP_SASAngle_Deg_ovrdval@ */ Scalar_FLOAT32_IEEE 0 SWC_INP_type_CM_single_Deg -900.0 900.0 /end CHARACTERISTIC
/begin CHARACTERISTIC KINP_SASSpeed_degps_defval "" VALUE 0x0000 /* @ECU_Address@KINP_SASSpeed_degps_defval@ */ Scalar_FLOAT32_IEEE 0 SWC_INP_type_CM_single_degps 0.0 1020.0 /end CHARACTERISTIC
/begin CHARACTERISTIC KINP_SASSpeed_degps_ovrdval "" VALUE 0x0000 /* @ECU_Address@KINP_SASSpeed_degps_ovrdval@ */ Scalar_FLOAT32_IEEE 0 SWC_INP_type_CM_single_degps 0.0 1020.0 /end CHARACTERISTIC
/begin CHARACTERISTIC KINP_LFID_raw_ovrdval "" VALUE 0x0000 /* @ECU_Address@KINP_LFID_raw_ovrdval@ */ Scalar_ULONG 0 SWC_INP_type_CM_uint32_raw 0.0 4.294967295E+9 /end CHARACTERISTIC
/begin CHARACTERISTIC KINP_LFID_raw_ovrflg "" VALUE 0x0000 /* @ECU_Address@KINP_LFID_raw_ovrflg@ */ Scalar_ULONG 0 SWC_INP_type_CM_uint32_raw 0.0 4.294967295E+9 /end CHARACTERISTIC
/begin CHARACTERISTIC KINP_LRID_raw_ovrdval "" VALUE 0x0000 /* @ECU_Address@KINP_LRID_raw_ovrdval@ */ Scalar_ULONG 0 SWC_INP_type_CM_uint32_raw 0.0 4.294967295E+9 /end CHARACTERISTIC
/begin CHARACTERISTIC KINP_RFID_raw_ovrdval "" VALUE 0x0000 /* @ECU_Address@KINP_RFID_raw_ovrdval@ */ Scalar_ULONG 0 SWC_INP_type_CM_uint32_raw 0.0 4.294967295E+9 /end CHARACTERISTIC
/begin CHARACTERISTIC KINP_RRID_raw_ovrdval "" VALUE 0x0000 /* @ECU_Address@KINP_RRID_raw_ovrdval@ */ Scalar_ULONG 0 SWC_INP_type_CM_uint32_raw 0.0 4.294967295E+9 /end CHARACTERISTIC
/begin CHARACTERISTIC KINP_TPMSID_raw_ovrdval "" VALUE 0x0000 /* @ECU_Address@KINP_TPMSID_raw_ovrdval@ */ Scalar_ULONG 0 SWC_INP_type_CM_uint32_raw 0.0 4.294967295E+9 /end CHARACTERISTIC
/begin CHARACTERISTIC KINP_ABM1CSErr_flg_defval "" VALUE 0x0000 /* @ECU_Address@KINP_ABM1CSErr_flg_defval@ */ Scalar_BOOLEAN 0 SWC_INP_type_CM_boolean_flg 0.0 1.0 /end CHARACTERISTIC
/begin CHARACTERISTIC KINP_ABM1CSErr_flg_ovrdflg "" VALUE 0x0000 /* @ECU_Address@KINP_ABM1CSErr_flg_ovrdflg@ */ Scalar_BOOLEAN 0 SWC_INP_type_CM_boolean_flg 0.0 1.0 /end CHARACTERISTIC
/begin CHARACTERISTIC KINP_ABM1CSErr_flg_ovrdval "" VALUE 0x0000 /* @ECU_Address@KINP_ABM1CSErr_flg_ovrdval@ */ Scalar_BOOLEAN 0 SWC_INP_type_CM_boolean_flg 0.0 1.0 /end CHARACTERISTIC
/begin CHARACTERISTIC KINP_ABM1RCErr_flg_defval "" VALUE 0x0000 /* @ECU_Address@KINP_ABM1RCErr_flg_defval@ */ Scalar_BOOLEAN 0 SWC_INP_type_CM_boolean_flg 0.0 1.0 /end CHARACTERISTIC
/begin CHARACTERISTIC KINP_ABM1RCErr_flg_ovrdflg "" VALUE 0x0000 /* @ECU_Address@KINP_ABM1RCErr_flg_ovrdflg@ */ Scalar_BOOLEAN 0 SWC_INP_type_CM_boolean_flg 0.0 1.0 /end CHARACTERISTIC
/begin CHARACTERISTIC KINP_ABM1RCErr_flg_ovrdval "" VALUE 0x0000 /* @ECU_Address@KINP_ABM1RCErr_flg_ovrdval@ */ Scalar_BOOLEAN 0 SWC_INP_type_CM_boolean_flg 0.0 1.0 /end CHARACTERISTIC
/begin CHARACTERISTIC KINP_ABMPassengerODSSta_flg_defval "" VALUE 0x0000 /* @ECU_Address@KINP_ABMPassengerODSSta_flg_defval@ */ Scalar_BOOLEAN 0 SWC_INP_type_CM_boolean_flg 0.0 1.0 /end CHARACTERISTIC
/begin CHARACTERISTIC KINP_ABMPassengerODSSta_flg_ovrdflg "" VALUE 0x0000 /* @ECU_Address@KINP_ABMPassengerODSSta_flg_ovrdflg@ */ Scalar_BOOLEAN 0 SWC_INP_type_CM_boolean_flg 0.0 1.0 /end CHARACTERISTIC
/begin CHARACTERISTIC KINP_ABMPassengerODSSta_flg_ovrdval "" VALUE 0x0000 /* @ECU_Address@KINP_ABMPassengerODSSta_flg_ovrdval@ */ Scalar_BOOLEAN 0 SWC_INP_type_CM_boolean_flg 0.0 1.0 /end CHARACTERISTIC
/begin CHARACTERISTIC KINP_ABMRearPassengerCTRODSSta_flg_defval "" VALUE 0x0000 /* @ECU_Address@KINP_ABMRearPassengerCTRODSSta_flg_defval@ */ Scalar_BOOLEAN 0 SWC_INP_type_CM_boolean_flg 0.0 1.0 /end CHARACTERISTIC
/begin CHARACTERISTIC KINP_ABMRearPassengerCTRODSSta_flg_ovrdflg "" VALUE 0x0000 /* @ECU_Address@KINP_ABMRearPassengerCTRODSSta_flg_ovrdflg@ */ Scalar_BOOLEAN 0 SWC_INP_type_CM_boolean_flg 0.0 1.0 /end CHARACTERISTIC
/begin CHARACTERISTIC KINP_ABMRearPassengerCTRODSSta_flg_ovrdval "" VALUE 0x0000 /* @ECU_Address@KINP_ABMRearPassengerCTRODSSta_flg_ovrdval@ */ Scalar_BOOLEAN 0 SWC_INP_type_CM_boolean_flg 0.0 1.0 /end CHARACTERISTIC
/begin CHARACTERISTIC KINP_ABMRearPassengerLHODSSta_flg_defval "" VALUE 0x0000 /* @ECU_Address@KINP_ABMRearPassengerLHODSSta_flg_defval@ */ Scalar_BOOLEAN 0 SWC_INP_type_CM_boolean_flg 0.0 1.0 /end CHARACTERISTIC
/begin CHARACTERISTIC KINP_ABMRearPassengerLHODSSta_flg_ovrdflg "" VALUE 0x0000 /* @ECU_Address@KINP_ABMRearPassengerLHODSSta_flg_ovrdflg@ */ Scalar_BOOLEAN 0 SWC_INP_type_CM_boolean_flg 0.0 1.0 /end CHARACTERISTIC
/begin CHARACTERISTIC KINP_ABMRearPassengerLHODSSta_flg_ovrdval "" VALUE 0x0000 /* @ECU_Address@KINP_ABMRearPassengerLHODSSta_flg_ovrdval@ */ Scalar_BOOLEAN 0 SWC_INP_type_CM_boolean_flg 0.0 1.0 /end CHARACTERISTIC
/begin CHARACTERISTIC KINP_ABMRearPassengerRHODSSta_flg_defval "" VALUE 0x0000 /* @ECU_Address@KINP_ABMRearPassengerRHODSSta_flg_defval@ */ Scalar_BOOLEAN 0 SWC_INP_type_CM_boolean_flg 0.0 1.0 /end CHARACTERISTIC
/begin CHARACTERISTIC KINP_ABMRearPassengerRHODSSta_flg_ovrdflg "" VALUE 0x0000 /* @ECU_Address@KINP_ABMRearPassengerRHODSSta_flg_ovrdflg@ */ Scalar_BOOLEAN 0 SWC_INP_type_CM_boolean_flg 0.0 1.0 /end CHARACTERISTIC
/begin CHARACTERISTIC KINP_ABMRearPassengerRHODSSta_flg_ovrdval "" VALUE 0x0000 /* @ECU_Address@KINP_ABMRearPassengerRHODSSta_flg_ovrdval@ */ Scalar_BOOLEAN 0 SWC_INP_type_CM_boolean_flg 0.0 1.0 /end CHARACTERISTIC
/begin CHARACTERISTIC KINP_ABSActive_flg_defval "" VALUE 0x0000 /* @ECU_Address@KINP_ABSActive_flg_defval@ */ Scalar_BOOLEAN 0 SWC_INP_type_CM_boolean_flg 0.0 1.0 /end CHARACTERISTIC
/begin CHARACTERISTIC KINP_ABSActive_flg_ovrdflg "" VALUE 0x0000 /* @ECU_Address@KINP_ABSActive_flg_ovrdflg@ */ Scalar_BOOLEAN 0 SWC_INP_type_CM_boolean_flg 0.0 1.0 /end CHARACTERISTIC
/begin CHARACTERISTIC KINP_ABSActive_flg_ovrdval "" VALUE 0x0000 /* @ECU_Address@KINP_ABSActive_flg_ovrdval@ */ Scalar_BOOLEAN 0 SWC_INP_type_CM_boolean_flg 0.0 1.0 /end CHARACTERISTIC
/begin CHARACTERISTIC KINP_ABSFailed_flg_defval "" VALUE 0x0000 /* @ECU_Address@KINP_ABSFailed_flg_defval@ */ Scalar_BOOLEAN 0 SWC_INP_type_CM_boolean_flg 0.0 1.0 /end CHARACTERISTIC
/begin CHARACTERISTIC KINP_ABSFailed_flg_ovrdflg "" VALUE 0x0000 /* @ECU_Address@KINP_ABSFailed_flg_ovrdflg@ */ Scalar_BOOLEAN 0 SWC_INP_type_CM_boolean_flg 0.0 1.0 /end CHARACTERISTIC
/begin CHARACTERISTIC KINP_ABSFailed_flg_ovrdval "" VALUE 0x0000 /* @ECU_Address@KINP_ABSFailed_flg_ovrdval@ */ Scalar_BOOLEAN 0 SWC_INP_type_CM_boolean_flg 0.0 1.0 /end CHARACTERISTIC
/begin CHARACTERISTIC KINP_ABSWnlmpSta_flg_defval "" VALUE 0x0000 /* @ECU_Address@KINP_ABSWnlmpSta_flg_defval@ */ Scalar_BOOLEAN 0 SWC_INP_type_CM_boolean_flg 0.0 1.0 /end CHARACTERISTIC
/begin CHARACTERISTIC KINP_ABSWnlmpSta_flg_ovrdflg "" VALUE 0x0000 /* @ECU_Address@KINP_ABSWnlmpSta_flg_ovrdflg@ */ Scalar_BOOLEAN 0 SWC_INP_type_CM_boolean_flg 0.0 1.0 /end CHARACTERISTIC
/begin CHARACTERISTIC KINP_ABSWnlmpSta_flg_ovrdval "" VALUE 0x0000 /* @ECU_Address@KINP_ABSWnlmpSta_flg_ovrdval@ */ Scalar_BOOLEAN 0 SWC_INP_type_CM_boolean_flg 0.0 1.0 /end CHARACTERISTIC
/begin CHARACTERISTIC KINP_AVHActive_flg_defval "" VALUE 0x0000 /* @ECU_Address@KINP_AVHActive_flg_defval@ */ Scalar_BOOLEAN 0 SWC_INP_type_CM_boolean_flg 0.0 1.0 /end CHARACTERISTIC
/begin CHARACTERISTIC KINP_AVHActive_flg_ovrdflg "" VALUE 0x0000 /* @ECU_Address@KINP_AVHActive_flg_ovrdflg@ */ Scalar_BOOLEAN 0 SWC_INP_type_CM_boolean_flg 0.0 1.0 /end CHARACTERISTIC
/begin CHARACTERISTIC KINP_AVHActive_flg_ovrdval "" VALUE 0x0000 /* @ECU_Address@KINP_AVHActive_flg_ovrdval@ */ Scalar_BOOLEAN 0 SWC_INP_type_CM_boolean_flg 0.0 1.0 /end CHARACTERISTIC
/begin CHARACTERISTIC KINP_AVHFailed_flg_defval "" VALUE 0x0000 /* @ECU_Address@KINP_AVHFailed_flg_defval@ */ Scalar_BOOLEAN 0 SWC_INP_type_CM_boolean_flg 0.0 1.0 /end CHARACTERISTIC
/begin CHARACTERISTIC KINP_AVHFailed_flg_ovrdflg "" VALUE 0x0000 /* @ECU_Address@KINP_AVHFailed_flg_ovrdflg@ */ Scalar_BOOLEAN 0 SWC_INP_type_CM_boolean_flg 0.0 1.0 /end CHARACTERISTIC
/begin CHARACTERISTIC KINP_AVHFailed_flg_ovrdval "" VALUE 0x0000 /* @ECU_Address@KINP_AVHFailed_flg_ovrdval@ */ Scalar_BOOLEAN 0 SWC_INP_type_CM_boolean_flg 0.0 1.0 /end CHARACTERISTIC
/begin CHARACTERISTIC KINP_AccelPedal1Vol_V_ovrdflg "" VALUE 0x0000 /* @ECU_Address@KINP_AccelPedal1Vol_V_ovrdflg@ */ Scalar_BOOLEAN 0 SWC_INP_type_CM_boolean_flg 0.0 1.0 /end CHARACTERISTIC
/begin CHARACTERISTIC KINP_AccelPedal1Vol_V_srvcflg "" VALUE 0x0000 /* @ECU_Address@KINP_AccelPedal1Vol_V_srvcflg@ */ Scalar_BOOLEAN 0 SWC_INP_type_CM_boolean_flg 0.0 1.0 /end CHARACTERISTIC
/begin CHARACTERISTIC KINP_AccelPedal2Vol_V_ovrdflg "" VALUE 0x0000 /* @ECU_Address@KINP_AccelPedal2Vol_V_ovrdflg@ */ Scalar_BOOLEAN 0 SWC_INP_type_CM_boolean_flg 0.0 1.0 /end CHARACTERISTIC
/begin CHARACTERISTIC KINP_AccelPedal2Vol_V_srvcflg "" VALUE 0x0000 /* @ECU_Address@KINP_AccelPedal2Vol_V_srvcflg@ */ Scalar_BOOLEAN 0 SWC_INP_type_CM_boolean_flg 0.0 1.0 /end CHARACTERISTIC
/begin CHARACTERISTIC KINP_AcoreReadyToSlp_flg_ovrdflg "" VALUE 0x0000 /* @ECU_Address@KINP_AcoreReadyToSlp_flg_ovrdflg@ */ Scalar_BOOLEAN 0 SWC_INP_type_CM_boolean_flg 0.0 1.0 /end CHARACTERISTIC
/begin CHARACTERISTIC KINP_AcoreReadyToSlp_flg_ovrdval "" VALUE 0x0000 /* @ECU_Address@KINP_AcoreReadyToSlp_flg_ovrdval@ */ Scalar_BOOLEAN 0 SWC_INP_type_CM_boolean_flg 0.0 1.0 /end CHARACTERISTIC
/begin CHARACTERISTIC KINP_AirBagFailCmd_flg_defval "" VALUE 0x0000 /* @ECU_Address@KINP_AirBagFailCmd_flg_defval@ */ Scalar_BOOLEAN 0 SWC_INP_type_CM_boolean_flg 0.0 1.0 /end CHARACTERISTIC
/begin CHARACTERISTIC KINP_AirBagFailCmd_flg_ovrdflg "" VALUE 0x0000 /* @ECU_Address@KINP_AirBagFailCmd_flg_ovrdflg@ */ Scalar_BOOLEAN 0 SWC_INP_type_CM_boolean_flg 0.0 1.0 /end CHARACTERISTIC
/begin CHARACTERISTIC KINP_AirBagFailCmd_flg_ovrdval "" VALUE 0x0000 /* @ECU_Address@KINP_AirBagFailCmd_flg_ovrdval@ */ Scalar_BOOLEAN 0 SWC_INP_type_CM_boolean_flg 0.0 1.0 /end CHARACTERISTIC
/begin CHARACTERISTIC KINP_AmberWnlmpSta_flg_defval "" VALUE 0x0000 /* @ECU_Address@KINP_AmberWnlmpSta_flg_defval@ */ Scalar_BOOLEAN 0 SWC_INP_type_CM_boolean_flg 0.0 1.0 /end CHARACTERISTIC
/begin CHARACTERISTIC KINP_AmberWnlmpSta_flg_ovrdflg "" VALUE 0x0000 /* @ECU_Address@KINP_AmberWnlmpSta_flg_ovrdflg@ */ Scalar_BOOLEAN 0 SWC_INP_type_CM_boolean_flg 0.0 1.0 /end CHARACTERISTIC
/begin CHARACTERISTIC KINP_AmberWnlmpSta_flg_ovrdval "" VALUE 0x0000 /* @ECU_Address@KINP_AmberWnlmpSta_flg_ovrdval@ */ Scalar_BOOLEAN 0 SWC_INP_type_CM_boolean_flg 0.0 1.0 /end CHARACTERISTIC
/begin CHARACTERISTIC KINP_BTCSActive_flg_defval "" VALUE 0x0000 /* @ECU_Address@KINP_BTCSActive_flg_defval@ */ Scalar_BOOLEAN 0 SWC_INP_type_CM_boolean_flg 0.0 1.0 /end CHARACTERISTIC
/begin CHARACTERISTIC KINP_BTCSActive_flg_ovrdflg "" VALUE 0x0000 /* @ECU_Address@KINP_BTCSActive_flg_ovrdflg@ */ Scalar_BOOLEAN 0 SWC_INP_type_CM_boolean_flg 0.0 1.0 /end CHARACTERISTIC
/begin CHARACTERISTIC KINP_BTCSActive_flg_ovrdval "" VALUE 0x0000 /* @ECU_Address@KINP_BTCSActive_flg_ovrdval@ */ Scalar_BOOLEAN 0 SWC_INP_type_CM_boolean_flg 0.0 1.0 /end CHARACTERISTIC
/begin CHARACTERISTIC KINP_BrakeLampSW_flg_inverse "" VALUE 0x0000 /* @ECU_Address@KINP_BrakeLampSW_flg_inverse@ */ Scalar_BOOLEAN 0 SWC_INP_type_CM_boolean_flg 0.0 1.0 /end CHARACTERISTIC
/begin CHARACTERISTIC KINP_BrakeLampSW_flg_ovrdflg "" VALUE 0x0000 /* @ECU_Address@KINP_BrakeLampSW_flg_ovrdflg@ */ Scalar_BOOLEAN 0 SWC_INP_type_CM_boolean_flg 0.0 1.0 /end CHARACTERISTIC
/begin CHARACTERISTIC KINP_BrakeLampSW_flg_ovrdval "" VALUE 0x0000 /* @ECU_Address@KINP_BrakeLampSW_flg_ovrdval@ */ Scalar_BOOLEAN 0 SWC_INP_type_CM_boolean_flg 0.0 1.0 /end CHARACTERISTIC
/begin CHARACTERISTIC KINP_BrakeLampSW_flg_srvcflg "" VALUE 0x0000 /* @ECU_Address@KINP_BrakeLampSW_flg_srvcflg@ */ Scalar_BOOLEAN 0 SWC_INP_type_CM_boolean_flg 0.0 1.0 /end CHARACTERISTIC
/begin CHARACTERISTIC KINP_BrakeLampSW_flg_srvcval "" VALUE 0x0000 /* @ECU_Address@KINP_BrakeLampSW_flg_srvcval@ */ Scalar_BOOLEAN 0 SWC_INP_type_CM_boolean_flg 0.0 1.0 /end CHARACTERISTIC
/begin CHARACTERISTIC KINP_BrakeSWGPIO_flg_inverse "" VALUE 0x0000 /* @ECU_Address@KINP_BrakeSWGPIO_flg_inverse@ */ Scalar_BOOLEAN 0 SWC_INP_type_CM_boolean_flg 0.0 1.0 /end CHARACTERISTIC
/begin CHARACTERISTIC KINP_BrakeSWGPIO_flg_ovrdflg "" VALUE 0x0000 /* @ECU_Address@KINP_BrakeSWGPIO_flg_ovrdflg@ */ Scalar_BOOLEAN 0 SWC_INP_type_CM_boolean_flg 0.0 1.0 /end CHARACTERISTIC
/begin CHARACTERISTIC KINP_BrakeSWGPIO_flg_ovrdval "" VALUE 0x0000 /* @ECU_Address@KINP_BrakeSWGPIO_flg_ovrdval@ */ Scalar_BOOLEAN 0 SWC_INP_type_CM_boolean_flg 0.0 1.0 /end CHARACTERISTIC
/begin CHARACTERISTIC KINP_BrakeSWGPIO_flg_srvcflg "" VALUE 0x0000 /* @ECU_Address@KINP_BrakeSWGPIO_flg_srvcflg@ */ Scalar_BOOLEAN 0 SWC_INP_type_CM_boolean_flg 0.0 1.0 /end CHARACTERISTIC
/begin CHARACTERISTIC KINP_BrakeSWGPIO_flg_srvcval "" VALUE 0x0000 /* @ECU_Address@KINP_BrakeSWGPIO_flg_srvcval@ */ Scalar_BOOLEAN 0 SWC_INP_type_CM_boolean_flg 0.0 1.0 /end CHARACTERISTIC
/begin CHARACTERISTIC KINP_CAN1BusOff_flg_ovrdflg "" VALUE 0x0000 /* @ECU_Address@KINP_CAN1BusOff_flg_ovrdflg@ */ Scalar_BOOLEAN 0 SWC_INP_type_CM_boolean_flg 0.0 1.0 /end CHARACTERISTIC
/begin CHARACTERISTIC KINP_CAN1BusOff_flg_ovrdval "" VALUE 0x0000 /* @ECU_Address@KINP_CAN1BusOff_flg_ovrdval@ */ Scalar_BOOLEAN 0 SWC_INP_type_CM_boolean_flg 0.0 1.0 /end CHARACTERISTIC
/begin CHARACTERISTIC KINP_CAN2BusOff_flg_ovrdflg "" VALUE 0x0000 /* @ECU_Address@KINP_CAN2BusOff_flg_ovrdflg@ */ Scalar_BOOLEAN 0 SWC_INP_type_CM_boolean_flg 0.0 1.0 /end CHARACTERISTIC
/begin CHARACTERISTIC KINP_CAN2BusOff_flg_ovrdval "" VALUE 0x0000 /* @ECU_Address@KINP_CAN2BusOff_flg_ovrdval@ */ Scalar_BOOLEAN 0 SWC_INP_type_CM_boolean_flg 0.0 1.0 /end CHARACTERISTIC
/begin CHARACTERISTIC KINP_CANMsgInvalidABM1_flg_ovrdflg "" VALUE 0x0000 /* @ECU_Address@KINP_CANMsgInvalidABM1_flg_ovrdflg@ */ Scalar_BOOLEAN 0 SWC_INP_type_CM_boolean_flg 0.0 1.0 /end CHARACTERISTIC
/begin CHARACTERISTIC KINP_CANMsgInvalidABM1_flg_ovrdval "" VALUE 0x0000 /* @ECU_Address@KINP_CANMsgInvalidABM1_flg_ovrdval@ */ Scalar_BOOLEAN 0 SWC_INP_type_CM_boolean_flg 0.0 1.0 /end CHARACTERISTIC
/begin CHARACTERISTIC KINP_CANMsgInvalidBMS1_flg_ovrdflg "" VALUE 0x0000 /* @ECU_Address@KINP_CANMsgInvalidBMS1_flg_ovrdflg@ */ Scalar_BOOLEAN 0 SWC_INP_type_CM_boolean_flg 0.0 1.0 /end CHARACTERISTIC
/begin CHARACTERISTIC KINP_CANMsgInvalidBMS1_flg_ovrdval "" VALUE 0x0000 /* @ECU_Address@KINP_CANMsgInvalidBMS1_flg_ovrdval@ */ Scalar_BOOLEAN 0 SWC_INP_type_CM_boolean_flg 0.0 1.0 /end CHARACTERISTIC
/begin CHARACTERISTIC KINP_CANMsgInvalidBMS3_flg_ovrdflg "" VALUE 0x0000 /* @ECU_Address@KINP_CANMsgInvalidBMS3_flg_ovrdflg@ */ Scalar_BOOLEAN 0 SWC_INP_type_CM_boolean_flg 0.0 1.0 /end CHARACTERISTIC
/begin CHARACTERISTIC KINP_CANMsgInvalidBMS3_flg_ovrdval "" VALUE 0x0000 /* @ECU_Address@KINP_CANMsgInvalidBMS3_flg_ovrdval@ */ Scalar_BOOLEAN 0 SWC_INP_type_CM_boolean_flg 0.0 1.0 /end CHARACTERISTIC
/begin CHARACTERISTIC KINP_CANMsgInvalidBMS4_flg_ovrdflg "" VALUE 0x0000 /* @ECU_Address@KINP_CANMsgInvalidBMS4_flg_ovrdflg@ */ Scalar_BOOLEAN 0 SWC_INP_type_CM_boolean_flg 0.0 1.0 /end CHARACTERISTIC
/begin CHARACTERISTIC KINP_CANMsgInvalidBMS4_flg_ovrdval "" VALUE 0x0000 /* @ECU_Address@KINP_CANMsgInvalidBMS4_flg_ovrdval@ */ Scalar_BOOLEAN 0 SWC_INP_type_CM_boolean_flg 0.0 1.0 /end CHARACTERISTIC
/begin CHARACTERISTIC KINP_CANMsgInvalidBMS5_flg_ovrdflg "" VALUE 0x0000 /* @ECU_Address@KINP_CANMsgInvalidBMS5_flg_ovrdflg@ */ Scalar_BOOLEAN 0 SWC_INP_type_CM_boolean_flg 0.0 1.0 /end CHARACTERISTIC
/begin CHARACTERISTIC KINP_CANMsgInvalidBMS5_flg_ovrdval "" VALUE 0x0000 /* @ECU_Address@KINP_CANMsgInvalidBMS5_flg_ovrdval@ */ Scalar_BOOLEAN 0 SWC_INP_type_CM_boolean_flg 0.0 1.0 /end CHARACTERISTIC
/begin CHARACTERISTIC KINP_CANMsgInvalidBMS6_flg_ovrdflg "" VALUE 0x0000 /* @ECU_Address@KINP_CANMsgInvalidBMS6_flg_ovrdflg@ */ Scalar_BOOLEAN 0 SWC_INP_type_CM_boolean_flg 0.0 1.0 /end CHARACTERISTIC
/begin CHARACTERISTIC KINP_CANMsgInvalidBMS6_flg_ovrdval "" VALUE 0x0000 /* @ECU_Address@KINP_CANMsgInvalidBMS6_flg_ovrdval@ */ Scalar_BOOLEAN 0 SWC_INP_type_CM_boolean_flg 0.0 1.0 /end CHARACTERISTIC
/begin CHARACTERISTIC KINP_CANMsgInvalidBMS8_flg_ovrdflg "" VALUE 0x0000 /* @ECU_Address@KINP_CANMsgInvalidBMS8_flg_ovrdflg@ */ Scalar_BOOLEAN 0 SWC_INP_type_CM_boolean_flg 0.0 1.0 /end CHARACTERISTIC
/begin CHARACTERISTIC KINP_CANMsgInvalidBMS8_flg_ovrdval "" VALUE 0x0000 /* @ECU_Address@KINP_CANMsgInvalidBMS8_flg_ovrdval@ */ Scalar_BOOLEAN 0 SWC_INP_type_CM_boolean_flg 0.0 1.0 /end CHARACTERISTIC
/begin CHARACTERISTIC KINP_CANMsgInvalidBodyZoneDR1_flg_ovrdflg "" VALUE 0x0000 /* @ECU_Address@KINP_CANMsgInvalidBodyZoneDR1_flg_ovrdflg@ */ Scalar_BOOLEAN 0 SWC_INP_type_CM_boolean_flg 0.0 1.0 /end CHARACTERISTIC
/begin CHARACTERISTIC KINP_CANMsgInvalidBodyZoneDR1_flg_ovrdval "" VALUE 0x0000 /* @ECU_Address@KINP_CANMsgInvalidBodyZoneDR1_flg_ovrdval@ */ Scalar_BOOLEAN 0 SWC_INP_type_CM_boolean_flg 0.0 1.0 /end CHARACTERISTIC
/begin CHARACTERISTIC KINP_CANMsgInvalidBodyZoneDR2_flg_ovrdflg "" VALUE 0x0000 /* @ECU_Address@KINP_CANMsgInvalidBodyZoneDR2_flg_ovrdflg@ */ Scalar_BOOLEAN 0 SWC_INP_type_CM_boolean_flg 0.0 1.0 /end CHARACTERISTIC
/begin CHARACTERISTIC KINP_CANMsgInvalidBodyZoneDR2_flg_ovrdval "" VALUE 0x0000 /* @ECU_Address@KINP_CANMsgInvalidBodyZoneDR2_flg_ovrdval@ */ Scalar_BOOLEAN 0 SWC_INP_type_CM_boolean_flg 0.0 1.0 /end CHARACTERISTIC
/begin CHARACTERISTIC KINP_CANMsgInvalidBodyZonePS1_flg_ovrdflg "" VALUE 0x0000 /* @ECU_Address@KINP_CANMsgInvalidBodyZonePS1_flg_ovrdflg@ */ Scalar_BOOLEAN 0 SWC_INP_type_CM_boolean_flg 0.0 1.0 /end CHARACTERISTIC
/begin CHARACTERISTIC KINP_CANMsgInvalidBodyZonePS1_flg_ovrdval "" VALUE 0x0000 /* @ECU_Address@KINP_CANMsgInvalidBodyZonePS1_flg_ovrdval@ */ Scalar_BOOLEAN 0 SWC_INP_type_CM_boolean_flg 0.0 1.0 /end CHARACTERISTIC
/begin CHARACTERISTIC KINP_CANMsgInvalidBodyZonePS2_flg_ovrdflg "" VALUE 0x0000 /* @ECU_Address@KINP_CANMsgInvalidBodyZonePS2_flg_ovrdflg@ */ Scalar_BOOLEAN 0 SWC_INP_type_CM_boolean_flg 0.0 1.0 /end CHARACTERISTIC
/begin CHARACTERISTIC KINP_CANMsgInvalidBodyZonePS2_flg_ovrdval "" VALUE 0x0000 /* @ECU_Address@KINP_CANMsgInvalidBodyZonePS2_flg_ovrdval@ */ Scalar_BOOLEAN 0 SWC_INP_type_CM_boolean_flg 0.0 1.0 /end CHARACTERISTIC
/begin CHARACTERISTIC KINP_CANMsgInvalidCCU1_flg_ovrdflg "" VALUE 0x0000 /* @ECU_Address@KINP_CANMsgInvalidCCU1_flg_ovrdflg@ */ Scalar_BOOLEAN 0 SWC_INP_type_CM_boolean_flg 0.0 1.0 /end CHARACTERISTIC
/begin CHARACTERISTIC KINP_CANMsgInvalidCCU1_flg_ovrdval "" VALUE 0x0000 /* @ECU_Address@KINP_CANMsgInvalidCCU1_flg_ovrdval@ */ Scalar_BOOLEAN 0 SWC_INP_type_CM_boolean_flg 0.0 1.0 /end CHARACTERISTIC
/begin CHARACTERISTIC KINP_CANMsgInvalidCCU2_flg_ovrdflg "" VALUE 0x0000 /* @ECU_Address@KINP_CANMsgInvalidCCU2_flg_ovrdflg@ */ Scalar_BOOLEAN 0 SWC_INP_type_CM_boolean_flg 0.0 1.0 /end CHARACTERISTIC
/begin CHARACTERISTIC KINP_CANMsgInvalidCCU2_flg_ovrdval "" VALUE 0x0000 /* @ECU_Address@KINP_CANMsgInvalidCCU2_flg_ovrdval@ */ Scalar_BOOLEAN 0 SWC_INP_type_CM_boolean_flg 0.0 1.0 /end CHARACTERISTIC
/begin CHARACTERISTIC KINP_CANMsgInvalidDKC1_flg_ovrdflg "" VALUE 0x0000 /* @ECU_Address@KINP_CANMsgInvalidDKC1_flg_ovrdflg@ */ Scalar_BOOLEAN 0 SWC_INP_type_CM_boolean_flg 0.0 1.0 /end CHARACTERISTIC
/begin CHARACTERISTIC KINP_CANMsgInvalidDKC1_flg_ovrdval "" VALUE 0x0000 /* @ECU_Address@KINP_CANMsgInvalidDKC1_flg_ovrdval@ */ Scalar_BOOLEAN 0 SWC_INP_type_CM_boolean_flg 0.0 1.0 /end CHARACTERISTIC
/begin CHARACTERISTIC KINP_CANMsgInvalidDKC2_flg_ovrdflg "" VALUE 0x0000 /* @ECU_Address@KINP_CANMsgInvalidDKC2_flg_ovrdflg@ */ Scalar_BOOLEAN 0 SWC_INP_type_CM_boolean_flg 0.0 1.0 /end CHARACTERISTIC
/begin CHARACTERISTIC KINP_CANMsgInvalidDKC2_flg_ovrdval "" VALUE 0x0000 /* @ECU_Address@KINP_CANMsgInvalidDKC2_flg_ovrdval@ */ Scalar_BOOLEAN 0 SWC_INP_type_CM_boolean_flg 0.0 1.0 /end CHARACTERISTIC
/begin CHARACTERISTIC KINP_CANMsgInvalidEBM1_flg_ovrdflg "" VALUE 0x0000 /* @ECU_Address@KINP_CANMsgInvalidEBM1_flg_ovrdflg@ */ Scalar_BOOLEAN 0 SWC_INP_type_CM_boolean_flg 0.0 1.0 /end CHARACTERISTIC
/begin CHARACTERISTIC KINP_CANMsgInvalidEBM1_flg_ovrdval "" VALUE 0x0000 /* @ECU_Address@KINP_CANMsgInvalidEBM1_flg_ovrdval@ */ Scalar_BOOLEAN 0 SWC_INP_type_CM_boolean_flg 0.0 1.0 /end CHARACTERISTIC
/begin CHARACTERISTIC KINP_CANMsgInvalidEPB1_flg_ovrdflg "" VALUE 0x0000 /* @ECU_Address@KINP_CANMsgInvalidEPB1_flg_ovrdflg@ */ Scalar_BOOLEAN 0 SWC_INP_type_CM_boolean_flg 0.0 1.0 /end CHARACTERISTIC
/begin CHARACTERISTIC KINP_CANMsgInvalidEPB1_flg_ovrdval "" VALUE 0x0000 /* @ECU_Address@KINP_CANMsgInvalidEPB1_flg_ovrdval@ */ Scalar_BOOLEAN 0 SWC_INP_type_CM_boolean_flg 0.0 1.0 /end CHARACTERISTIC
/begin CHARACTERISTIC KINP_CANMsgInvalidEPS1_flg_ovrdflg "" VALUE 0x0000 /* @ECU_Address@KINP_CANMsgInvalidEPS1_flg_ovrdflg@ */ Scalar_BOOLEAN 0 SWC_INP_type_CM_boolean_flg 0.0 1.0 /end CHARACTERISTIC
/begin CHARACTERISTIC KINP_CANMsgInvalidEPS1_flg_ovrdval "" VALUE 0x0000 /* @ECU_Address@KINP_CANMsgInvalidEPS1_flg_ovrdval@ */ Scalar_BOOLEAN 0 SWC_INP_type_CM_boolean_flg 0.0 1.0 /end CHARACTERISTIC
/begin CHARACTERISTIC KINP_CANMsgInvalidESC1_flg_ovrdflg "" VALUE 0x0000 /* @ECU_Address@KINP_CANMsgInvalidESC1_flg_ovrdflg@ */ Scalar_BOOLEAN 0 SWC_INP_type_CM_boolean_flg 0.0 1.0 /end CHARACTERISTIC
/begin CHARACTERISTIC KINP_CANMsgInvalidESC1_flg_ovrdval "" VALUE 0x0000 /* @ECU_Address@KINP_CANMsgInvalidESC1_flg_ovrdval@ */ Scalar_BOOLEAN 0 SWC_INP_type_CM_boolean_flg 0.0 1.0 /end CHARACTERISTIC
/begin CHARACTERISTIC KINP_CANMsgInvalidESC5_flg_ovrdflg "" VALUE 0x0000 /* @ECU_Address@KINP_CANMsgInvalidESC5_flg_ovrdflg@ */ Scalar_BOOLEAN 0 SWC_INP_type_CM_boolean_flg 0.0 1.0 /end CHARACTERISTIC
/begin CHARACTERISTIC KINP_CANMsgInvalidESC5_flg_ovrdval "" VALUE 0x0000 /* @ECU_Address@KINP_CANMsgInvalidESC5_flg_ovrdval@ */ Scalar_BOOLEAN 0 SWC_INP_type_CM_boolean_flg 0.0 1.0 /end CHARACTERISTIC
/begin CHARACTERISTIC KINP_CANMsgInvalidFCM1_flg_ovrdflg "" VALUE 0x0000 /* @ECU_Address@KINP_CANMsgInvalidFCM1_flg_ovrdflg@ */ Scalar_BOOLEAN 0 SWC_INP_type_CM_boolean_flg 0.0 1.0 /end CHARACTERISTIC
/begin CHARACTERISTIC KINP_CANMsgInvalidFCM1_flg_ovrdval "" VALUE 0x0000 /* @ECU_Address@KINP_CANMsgInvalidFCM1_flg_ovrdval@ */ Scalar_BOOLEAN 0 SWC_INP_type_CM_boolean_flg 0.0 1.0 /end CHARACTERISTIC
/begin CHARACTERISTIC KINP_CANMsgInvalidFCM2_flg_ovrdflg "" VALUE 0x0000 /* @ECU_Address@KINP_CANMsgInvalidFCM2_flg_ovrdflg@ */ Scalar_BOOLEAN 0 SWC_INP_type_CM_boolean_flg 0.0 1.0 /end CHARACTERISTIC
/begin CHARACTERISTIC KINP_CANMsgInvalidFCM2_flg_ovrdval "" VALUE 0x0000 /* @ECU_Address@KINP_CANMsgInvalidFCM2_flg_ovrdval@ */ Scalar_BOOLEAN 0 SWC_INP_type_CM_boolean_flg 0.0 1.0 /end CHARACTERISTIC
/begin CHARACTERISTIC KINP_CANMsgInvalidFCM3_flg_ovrdflg "" VALUE 0x0000 /* @ECU_Address@KINP_CANMsgInvalidFCM3_flg_ovrdflg@ */ Scalar_BOOLEAN 0 SWC_INP_type_CM_boolean_flg 0.0 1.0 /end CHARACTERISTIC
/begin CHARACTERISTIC KINP_CANMsgInvalidFCM3_flg_ovrdval "" VALUE 0x0000 /* @ECU_Address@KINP_CANMsgInvalidFCM3_flg_ovrdval@ */ Scalar_BOOLEAN 0 SWC_INP_type_CM_boolean_flg 0.0 1.0 /end CHARACTERISTIC
/begin CHARACTERISTIC KINP_CANMsgInvalidFCM4_flg_ovrdflg "" VALUE 0x0000 /* @ECU_Address@KINP_CANMsgInvalidFCM4_flg_ovrdflg@ */ Scalar_BOOLEAN 0 SWC_INP_type_CM_boolean_flg 0.0 1.0 /end CHARACTERISTIC
/begin CHARACTERISTIC KINP_CANMsgInvalidFCM4_flg_ovrdval "" VALUE 0x0000 /* @ECU_Address@KINP_CANMsgInvalidFCM4_flg_ovrdval@ */ Scalar_BOOLEAN 0 SWC_INP_type_CM_boolean_flg 0.0 1.0 /end CHARACTERISTIC
/begin CHARACTERISTIC KINP_CANMsgInvalidHMI1_flg_ovrdflg "" VALUE 0x0000 /* @ECU_Address@KINP_CANMsgInvalidHMI1_flg_ovrdflg@ */ Scalar_BOOLEAN 0 SWC_INP_type_CM_boolean_flg 0.0 1.0 /end CHARACTERISTIC
/begin CHARACTERISTIC KINP_CANMsgInvalidHMI1_flg_ovrdval "" VALUE 0x0000 /* @ECU_Address@KINP_CANMsgInvalidHMI1_flg_ovrdval@ */ Scalar_BOOLEAN 0 SWC_INP_type_CM_boolean_flg 0.0 1.0 /end CHARACTERISTIC
/begin CHARACTERISTIC KINP_CANMsgInvalidIVI1_flg_ovrdflg "" VALUE 0x0000 /* @ECU_Address@KINP_CANMsgInvalidIVI1_flg_ovrdflg@ */ Scalar_BOOLEAN 0 SWC_INP_type_CM_boolean_flg 0.0 1.0 /end CHARACTERISTIC
/begin CHARACTERISTIC KINP_CANMsgInvalidIVI1_flg_ovrdval "" VALUE 0x0000 /* @ECU_Address@KINP_CANMsgInvalidIVI1_flg_ovrdval@ */ Scalar_BOOLEAN 0 SWC_INP_type_CM_boolean_flg 0.0 1.0 /end CHARACTERISTIC
/begin CHARACTERISTIC KINP_CANMsgInvalidIVI2_flg_ovrdflg "" VALUE 0x0000 /* @ECU_Address@KINP_CANMsgInvalidIVI2_flg_ovrdflg@ */ Scalar_BOOLEAN 0 SWC_INP_type_CM_boolean_flg 0.0 1.0 /end CHARACTERISTIC
/begin CHARACTERISTIC KINP_CANMsgInvalidIVI2_flg_ovrdval "" VALUE 0x0000 /* @ECU_Address@KINP_CANMsgInvalidIVI2_flg_ovrdval@ */ Scalar_BOOLEAN 0 SWC_INP_type_CM_boolean_flg 0.0 1.0 /end CHARACTERISTIC
/begin CHARACTERISTIC KINP_CANMsgInvalidIVI3_flg_ovrdflg "" VALUE 0x0000 /* @ECU_Address@KINP_CANMsgInvalidIVI3_flg_ovrdflg@ */ Scalar_BOOLEAN 0 SWC_INP_type_CM_boolean_flg 0.0 1.0 /end CHARACTERISTIC
/begin CHARACTERISTIC KINP_CANMsgInvalidIVI3_flg_ovrdval "" VALUE 0x0000 /* @ECU_Address@KINP_CANMsgInvalidIVI3_flg_ovrdval@ */ Scalar_BOOLEAN 0 SWC_INP_type_CM_boolean_flg 0.0 1.0 /end CHARACTERISTIC
/begin CHARACTERISTIC KINP_CANMsgInvalidMCUBF1_flg_ovrdflg "" VALUE 0x0000 /* @ECU_Address@KINP_CANMsgInvalidMCUBF1_flg_ovrdflg@ */ Scalar_BOOLEAN 0 SWC_INP_type_CM_boolean_flg 0.0 1.0 /end CHARACTERISTIC
/begin CHARACTERISTIC KINP_CANMsgInvalidMCUBF1_flg_ovrdval "" VALUE 0x0000 /* @ECU_Address@KINP_CANMsgInvalidMCUBF1_flg_ovrdval@ */ Scalar_BOOLEAN 0 SWC_INP_type_CM_boolean_flg 0.0 1.0 /end CHARACTERISTIC
/begin CHARACTERISTIC KINP_CANMsgInvalidMCUBF2_flg_ovrdflg "" VALUE 0x0000 /* @ECU_Address@KINP_CANMsgInvalidMCUBF2_flg_ovrdflg@ */ Scalar_BOOLEAN 0 SWC_INP_type_CM_boolean_flg 0.0 1.0 /end CHARACTERISTIC
/begin CHARACTERISTIC KINP_CANMsgInvalidMCUBF2_flg_ovrdval "" VALUE 0x0000 /* @ECU_Address@KINP_CANMsgInvalidMCUBF2_flg_ovrdval@ */ Scalar_BOOLEAN 0 SWC_INP_type_CM_boolean_flg 0.0 1.0 /end CHARACTERISTIC
/begin CHARACTERISTIC KINP_CANMsgInvalidMCUBR1_flg_ovrdflg "" VALUE 0x0000 /* @ECU_Address@KINP_CANMsgInvalidMCUBR1_flg_ovrdflg@ */ Scalar_BOOLEAN 0 SWC_INP_type_CM_boolean_flg 0.0 1.0 /end CHARACTERISTIC
/begin CHARACTERISTIC KINP_CANMsgInvalidMCUBR1_flg_ovrdval "" VALUE 0x0000 /* @ECU_Address@KINP_CANMsgInvalidMCUBR1_flg_ovrdval@ */ Scalar_BOOLEAN 0 SWC_INP_type_CM_boolean_flg 0.0 1.0 /end CHARACTERISTIC
/begin CHARACTERISTIC KINP_CANMsgInvalidMCUBR2_flg_ovrdflg "" VALUE 0x0000 /* @ECU_Address@KINP_CANMsgInvalidMCUBR2_flg_ovrdflg@ */ Scalar_BOOLEAN 0 SWC_INP_type_CM_boolean_flg 0.0 1.0 /end CHARACTERISTIC
/begin CHARACTERISTIC KINP_CANMsgInvalidMCUBR2_flg_ovrdval "" VALUE 0x0000 /* @ECU_Address@KINP_CANMsgInvalidMCUBR2_flg_ovrdval@ */ Scalar_BOOLEAN 0 SWC_INP_type_CM_boolean_flg 0.0 1.0 /end CHARACTERISTIC
/begin CHARACTERISTIC KINP_CANMsgInvalidMCUNF1_flg_ovrdflg "" VALUE 0x0000 /* @ECU_Address@KINP_CANMsgInvalidMCUNF1_flg_ovrdflg@ */ Scalar_BOOLEAN 0 SWC_INP_type_CM_boolean_flg 0.0 1.0 /end CHARACTERISTIC
/begin CHARACTERISTIC KINP_CANMsgInvalidMCUNF1_flg_ovrdval "" VALUE 0x0000 /* @ECU_Address@KINP_CANMsgInvalidMCUNF1_flg_ovrdval@ */ Scalar_BOOLEAN 0 SWC_INP_type_CM_boolean_flg 0.0 1.0 /end CHARACTERISTIC
/begin CHARACTERISTIC KINP_CANMsgInvalidMCUNF2_flg_ovrdflg "" VALUE 0x0000 /* @ECU_Address@KINP_CANMsgInvalidMCUNF2_flg_ovrdflg@ */ Scalar_BOOLEAN 0 SWC_INP_type_CM_boolean_flg 0.0 1.0 /end CHARACTERISTIC
/begin CHARACTERISTIC KINP_CANMsgInvalidMCUNF2_flg_ovrdval "" VALUE 0x0000 /* @ECU_Address@KINP_CANMsgInvalidMCUNF2_flg_ovrdval@ */ Scalar_BOOLEAN 0 SWC_INP_type_CM_boolean_flg 0.0 1.0 /end CHARACTERISTIC
/begin CHARACTERISTIC KINP_CANMsgInvalidMCUNF3_flg_ovrdflg "" VALUE 0x0000 /* @ECU_Address@KINP_CANMsgInvalidMCUNF3_flg_ovrdflg@ */ Scalar_BOOLEAN 0 SWC_INP_type_CM_boolean_flg 0.0 1.0 /end CHARACTERISTIC
/begin CHARACTERISTIC KINP_CANMsgInvalidMCUNF3_flg_ovrdval "" VALUE 0x0000 /* @ECU_Address@KINP_CANMsgInvalidMCUNF3_flg_ovrdval@ */ Scalar_BOOLEAN 0 SWC_INP_type_CM_boolean_flg 0.0 1.0 /end CHARACTERISTIC
/begin CHARACTERISTIC KINP_CANMsgInvalidMCUNR1_flg_ovrdflg "" VALUE 0x0000 /* @ECU_Address@KINP_CANMsgInvalidMCUNR1_flg_ovrdflg@ */ Scalar_BOOLEAN 0 SWC_INP_type_CM_boolean_flg 0.0 1.0 /end CHARACTERISTIC
/begin CHARACTERISTIC KINP_CANMsgInvalidMCUNR1_flg_ovrdval "" VALUE 0x0000 /* @ECU_Address@KINP_CANMsgInvalidMCUNR1_flg_ovrdval@ */ Scalar_BOOLEAN 0 SWC_INP_type_CM_boolean_flg 0.0 1.0 /end CHARACTERISTIC
/begin CHARACTERISTIC KINP_CANMsgInvalidMCUNR2_flg_ovrdflg "" VALUE 0x0000 /* @ECU_Address@KINP_CANMsgInvalidMCUNR2_flg_ovrdflg@ */ Scalar_BOOLEAN 0 SWC_INP_type_CM_boolean_flg 0.0 1.0 /end CHARACTERISTIC
/begin CHARACTERISTIC KINP_CANMsgInvalidMCUNR2_flg_ovrdval "" VALUE 0x0000 /* @ECU_Address@KINP_CANMsgInvalidMCUNR2_flg_ovrdval@ */ Scalar_BOOLEAN 0 SWC_INP_type_CM_boolean_flg 0.0 1.0 /end CHARACTERISTIC
/begin CHARACTERISTIC KINP_CANMsgInvalidMCUNR3_flg_ovrdflg "" VALUE 0x0000 /* @ECU_Address@KINP_CANMsgInvalidMCUNR3_flg_ovrdflg@ */ Scalar_BOOLEAN 0 SWC_INP_type_CM_boolean_flg 0.0 1.0 /end CHARACTERISTIC
/begin CHARACTERISTIC KINP_CANMsgInvalidMCUNR3_flg_ovrdval "" VALUE 0x0000 /* @ECU_Address@KINP_CANMsgInvalidMCUNR3_flg_ovrdval@ */ Scalar_BOOLEAN 0 SWC_INP_type_CM_boolean_flg 0.0 1.0 /end CHARACTERISTIC
/begin CHARACTERISTIC KINP_CANMsgInvalidMETER1_flg_ovrdflg "" VALUE 0x0000 /* @ECU_Address@KINP_CANMsgInvalidMETER1_flg_ovrdflg@ */ Scalar_BOOLEAN 0 SWC_INP_type_CM_boolean_flg 0.0 1.0 /end CHARACTERISTIC
/begin CHARACTERISTIC KINP_CANMsgInvalidMETER1_flg_ovrdval "" VALUE 0x0000 /* @ECU_Address@KINP_CANMsgInvalidMETER1_flg_ovrdval@ */ Scalar_BOOLEAN 0 SWC_INP_type_CM_boolean_flg 0.0 1.0 /end CHARACTERISTIC
/begin CHARACTERISTIC KINP_CANMsgInvalidPTG1_flg_ovrdflg "" VALUE 0x0000 /* @ECU_Address@KINP_CANMsgInvalidPTG1_flg_ovrdflg@ */ Scalar_BOOLEAN 0 SWC_INP_type_CM_boolean_flg 0.0 1.0 /end CHARACTERISTIC
/begin CHARACTERISTIC KINP_CANMsgInvalidPTG1_flg_ovrdval "" VALUE 0x0000 /* @ECU_Address@KINP_CANMsgInvalidPTG1_flg_ovrdval@ */ Scalar_BOOLEAN 0 SWC_INP_type_CM_boolean_flg 0.0 1.0 /end CHARACTERISTIC
/begin CHARACTERISTIC KINP_CANMsgInvalidSRR1_flg_ovrdflg "" VALUE 0x0000 /* @ECU_Address@KINP_CANMsgInvalidSRR1_flg_ovrdflg@ */ Scalar_BOOLEAN 0 SWC_INP_type_CM_boolean_flg 0.0 1.0 /end CHARACTERISTIC
/begin CHARACTERISTIC KINP_CANMsgInvalidSRR1_flg_ovrdval "" VALUE 0x0000 /* @ECU_Address@KINP_CANMsgInvalidSRR1_flg_ovrdval@ */ Scalar_BOOLEAN 0 SWC_INP_type_CM_boolean_flg 0.0 1.0 /end CHARACTERISTIC
/begin CHARACTERISTIC KINP_CANMsgInvalidShifter1_flg_ovrdflg "" VALUE 0x0000 /* @ECU_Address@KINP_CANMsgInvalidShifter1_flg_ovrdflg@ */ Scalar_BOOLEAN 0 SWC_INP_type_CM_boolean_flg 0.0 1.0 /end CHARACTERISTIC
/begin CHARACTERISTIC KINP_CANMsgInvalidShifter1_flg_ovrdval "" VALUE 0x0000 /* @ECU_Address@KINP_CANMsgInvalidShifter1_flg_ovrdval@ */ Scalar_BOOLEAN 0 SWC_INP_type_CM_boolean_flg 0.0 1.0 /end CHARACTERISTIC
/begin CHARACTERISTIC KINP_CANMsgInvalidShifter2_flg_ovrdflg "" VALUE 0x0000 /* @ECU_Address@KINP_CANMsgInvalidShifter2_flg_ovrdflg@ */ Scalar_BOOLEAN 0 SWC_INP_type_CM_boolean_flg 0.0 1.0 /end CHARACTERISTIC
/begin CHARACTERISTIC KINP_CANMsgInvalidShifter2_flg_ovrdval "" VALUE 0x0000 /* @ECU_Address@KINP_CANMsgInvalidShifter2_flg_ovrdval@ */ Scalar_BOOLEAN 0 SWC_INP_type_CM_boolean_flg 0.0 1.0 /end CHARACTERISTIC
/begin CHARACTERISTIC KINP_CANMsgInvalidTBOX2_flg_ovrdflg "" VALUE 0x0000 /* @ECU_Address@KINP_CANMsgInvalidTBOX2_flg_ovrdflg@ */ Scalar_BOOLEAN 0 SWC_INP_type_CM_boolean_flg 0.0 1.0 /end CHARACTERISTIC
/begin CHARACTERISTIC KINP_CANMsgInvalidTBOX2_flg_ovrdval "" VALUE 0x0000 /* @ECU_Address@KINP_CANMsgInvalidTBOX2_flg_ovrdval@ */ Scalar_BOOLEAN 0 SWC_INP_type_CM_boolean_flg 0.0 1.0 /end CHARACTERISTIC
/begin CHARACTERISTIC KINP_CANMsgInvalidTBOX3_flg_ovrdflg "" VALUE 0x0000 /* @ECU_Address@KINP_CANMsgInvalidTBOX3_flg_ovrdflg@ */ Scalar_BOOLEAN 0 SWC_INP_type_CM_boolean_flg 0.0 1.0 /end CHARACTERISTIC
/begin CHARACTERISTIC KINP_CANMsgInvalidTBOX3_flg_ovrdval "" VALUE 0x0000 /* @ECU_Address@KINP_CANMsgInvalidTBOX3_flg_ovrdval@ */ Scalar_BOOLEAN 0 SWC_INP_type_CM_boolean_flg 0.0 1.0 /end CHARACTERISTIC
/begin CHARACTERISTIC KINP_CANMsgInvalidZONEDR1_flg_ovrdflg "" VALUE 0x0000 /* @ECU_Address@KINP_CANMsgInvalidZONEDR1_flg_ovrdflg@ */ Scalar_BOOLEAN 0 SWC_INP_type_CM_boolean_flg 0.0 1.0 /end CHARACTERISTIC
/begin CHARACTERISTIC KINP_CANMsgInvalidZONEDR1_flg_ovrdval "" VALUE 0x0000 /* @ECU_Address@KINP_CANMsgInvalidZONEDR1_flg_ovrdval@ */ Scalar_BOOLEAN 0 SWC_INP_type_CM_boolean_flg 0.0 1.0 /end CHARACTERISTIC
/begin CHARACTERISTIC KINP_CANMsgInvalidZONEDRVCU_flg_ovrdflg "" VALUE 0x0000 /* @ECU_Address@KINP_CANMsgInvalidZONEDRVCU_flg_ovrdflg@ */ Scalar_BOOLEAN 0 SWC_INP_type_CM_boolean_flg 0.0 1.0 /end CHARACTERISTIC
/begin CHARACTERISTIC KINP_CANMsgInvalidZONEDRVCU_flg_ovrdval "" VALUE 0x0000 /* @ECU_Address@KINP_CANMsgInvalidZONEDRVCU_flg_ovrdval@ */ Scalar_BOOLEAN 0 SWC_INP_type_CM_boolean_flg 0.0 1.0 /end CHARACTERISTIC
/begin CHARACTERISTIC KINP_CANMsgInvalidZONEFR1_flg_ovrdflg "" VALUE 0x0000 /* @ECU_Address@KINP_CANMsgInvalidZONEFR1_flg_ovrdflg@ */ Scalar_BOOLEAN 0 SWC_INP_type_CM_boolean_flg 0.0 1.0 /end CHARACTERISTIC
/begin CHARACTERISTIC KINP_CANMsgInvalidZONEFR1_flg_ovrdval "" VALUE 0x0000 /* @ECU_Address@KINP_CANMsgInvalidZONEFR1_flg_ovrdval@ */ Scalar_BOOLEAN 0 SWC_INP_type_CM_boolean_flg 0.0 1.0 /end CHARACTERISTIC
/begin CHARACTERISTIC KINP_CANMsgInvalidZONEFRVCU_flg_ovrdflg "" VALUE 0x0000 /* @ECU_Address@KINP_CANMsgInvalidZONEFRVCU_flg_ovrdflg@ */ Scalar_BOOLEAN 0 SWC_INP_type_CM_boolean_flg 0.0 1.0 /end CHARACTERISTIC
/begin CHARACTERISTIC KINP_CANMsgInvalidZONEFRVCU_flg_ovrdval "" VALUE 0x0000 /* @ECU_Address@KINP_CANMsgInvalidZONEFRVCU_flg_ovrdval@ */ Scalar_BOOLEAN 0 SWC_INP_type_CM_boolean_flg 0.0 1.0 /end CHARACTERISTIC
/begin CHARACTERISTIC KINP_CANMsgInvalideBST1_flg_ovrdflg "" VALUE 0x0000 /* @ECU_Address@KINP_CANMsgInvalideBST1_flg_ovrdflg@ */ Scalar_BOOLEAN 0 SWC_INP_type_CM_boolean_flg 0.0 1.0 /end CHARACTERISTIC
/begin CHARACTERISTIC KINP_CANMsgInvalideBST1_flg_ovrdval "" VALUE 0x0000 /* @ECU_Address@KINP_CANMsgInvalideBST1_flg_ovrdval@ */ Scalar_BOOLEAN 0 SWC_INP_type_CM_boolean_flg 0.0 1.0 /end CHARACTERISTIC
/begin CHARACTERISTIC KINP_CANMsgInvalidzGWAPTC1_flg_ovrdflg "" VALUE 0x0000 /* @ECU_Address@KINP_CANMsgInvalidzGWAPTC1_flg_ovrdflg@ */ Scalar_BOOLEAN 0 SWC_INP_type_CM_boolean_flg 0.0 1.0 /end CHARACTERISTIC
/begin CHARACTERISTIC KINP_CANMsgInvalidzGWAPTC1_flg_ovrdval "" VALUE 0x0000 /* @ECU_Address@KINP_CANMsgInvalidzGWAPTC1_flg_ovrdval@ */ Scalar_BOOLEAN 0 SWC_INP_type_CM_boolean_flg 0.0 1.0 /end CHARACTERISTIC
/begin CHARACTERISTIC KINP_CANMsgInvalidzGWCANFr1_flg_ovrdflg "" VALUE 0x0000 /* @ECU_Address@KINP_CANMsgInvalidzGWCANFr1_flg_ovrdflg@ */ Scalar_BOOLEAN 0 SWC_INP_type_CM_boolean_flg 0.0 1.0 /end CHARACTERISTIC
/begin CHARACTERISTIC KINP_CANMsgInvalidzGWCANFr1_flg_ovrdval "" VALUE 0x0000 /* @ECU_Address@KINP_CANMsgInvalidzGWCANFr1_flg_ovrdval@ */ Scalar_BOOLEAN 0 SWC_INP_type_CM_boolean_flg 0.0 1.0 /end CHARACTERISTIC
/begin CHARACTERISTIC KINP_CANMsgInvalidzGWLINDr1_flg_ovrdflg "" VALUE 0x0000 /* @ECU_Address@KINP_CANMsgInvalidzGWLINDr1_flg_ovrdflg@ */ Scalar_BOOLEAN 0 SWC_INP_type_CM_boolean_flg 0.0 1.0 /end CHARACTERISTIC
/begin CHARACTERISTIC KINP_CANMsgInvalidzGWLINDr1_flg_ovrdval "" VALUE 0x0000 /* @ECU_Address@KINP_CANMsgInvalidzGWLINDr1_flg_ovrdval@ */ Scalar_BOOLEAN 0 SWC_INP_type_CM_boolean_flg 0.0 1.0 /end CHARACTERISTIC
/begin CHARACTERISTIC KINP_CANMsgInvalidzGWLINDr2_flg_ovrdflg "" VALUE 0x0000 /* @ECU_Address@KINP_CANMsgInvalidzGWLINDr2_flg_ovrdflg@ */ Scalar_BOOLEAN 0 SWC_INP_type_CM_boolean_flg 0.0 1.0 /end CHARACTERISTIC
/begin CHARACTERISTIC KINP_CANMsgInvalidzGWLINDr2_flg_ovrdval "" VALUE 0x0000 /* @ECU_Address@KINP_CANMsgInvalidzGWLINDr2_flg_ovrdval@ */ Scalar_BOOLEAN 0 SWC_INP_type_CM_boolean_flg 0.0 1.0 /end CHARACTERISTIC
/begin CHARACTERISTIC KINP_CANMsgInvalidzGWLINFr1_flg_ovrdflg "" VALUE 0x0000 /* @ECU_Address@KINP_CANMsgInvalidzGWLINFr1_flg_ovrdflg@ */ Scalar_BOOLEAN 0 SWC_INP_type_CM_boolean_flg 0.0 1.0 /end CHARACTERISTIC
/begin CHARACTERISTIC KINP_CANMsgInvalidzGWLINFr1_flg_ovrdval "" VALUE 0x0000 /* @ECU_Address@KINP_CANMsgInvalidzGWLINFr1_flg_ovrdval@ */ Scalar_BOOLEAN 0 SWC_INP_type_CM_boolean_flg 0.0 1.0 /end CHARACTERISTIC
/begin CHARACTERISTIC KINP_CANMsgInvalidzGWLINFr2_flg_ovrdflg "" VALUE 0x0000 /* @ECU_Address@KINP_CANMsgInvalidzGWLINFr2_flg_ovrdflg@ */ Scalar_BOOLEAN 0 SWC_INP_type_CM_boolean_flg 0.0 1.0 /end CHARACTERISTIC
/begin CHARACTERISTIC KINP_CANMsgInvalidzGWLINFr2_flg_ovrdval "" VALUE 0x0000 /* @ECU_Address@KINP_CANMsgInvalidzGWLINFr2_flg_ovrdval@ */ Scalar_BOOLEAN 0 SWC_INP_type_CM_boolean_flg 0.0 1.0 /end CHARACTERISTIC
/begin CHARACTERISTIC KINP_CANMsgInvalidzGWSEAT1_flg_ovrdflg "" VALUE 0x0000 /* @ECU_Address@KINP_CANMsgInvalidzGWSEAT1_flg_ovrdflg@ */ Scalar_BOOLEAN 0 SWC_INP_type_CM_boolean_flg 0.0 1.0 /end CHARACTERISTIC
/begin CHARACTERISTIC KINP_CANMsgInvalidzGWSEAT1_flg_ovrdval "" VALUE 0x0000 /* @ECU_Address@KINP_CANMsgInvalidzGWSEAT1_flg_ovrdval@ */ Scalar_BOOLEAN 0 SWC_INP_type_CM_boolean_flg 0.0 1.0 /end CHARACTERISTIC
/begin CHARACTERISTIC KINP_CentralDoorLockSW_flg_inverse "" VALUE 0x0000 /* @ECU_Address@KINP_CentralDoorLockSW_flg_inverse@ */ Scalar_BOOLEAN 0 SWC_INP_type_CM_boolean_flg 0.0 1.0 /end CHARACTERISTIC
/begin CHARACTERISTIC KINP_CentralDoorLockSW_flg_ovrdflg "" VALUE 0x0000 /* @ECU_Address@KINP_CentralDoorLockSW_flg_ovrdflg@ */ Scalar_BOOLEAN 0 SWC_INP_type_CM_boolean_flg 0.0 1.0 /end CHARACTERISTIC
/begin CHARACTERISTIC KINP_CentralDoorLockSW_flg_ovrdval "" VALUE 0x0000 /* @ECU_Address@KINP_CentralDoorLockSW_flg_ovrdval@ */ Scalar_BOOLEAN 0 SWC_INP_type_CM_boolean_flg 0.0 1.0 /end CHARACTERISTIC
/begin CHARACTERISTIC KINP_CentralDoorLockSW_flg_srvcflg "" VALUE 0x0000 /* @ECU_Address@KINP_CentralDoorLockSW_flg_srvcflg@ */ Scalar_BOOLEAN 0 SWC_INP_type_CM_boolean_flg 0.0 1.0 /end CHARACTERISTIC
/begin CHARACTERISTIC KINP_CentralDoorLockSW_flg_srvcval "" VALUE 0x0000 /* @ECU_Address@KINP_CentralDoorLockSW_flg_srvcval@ */ Scalar_BOOLEAN 0 SWC_INP_type_CM_boolean_flg 0.0 1.0 /end CHARACTERISTIC
/begin CHARACTERISTIC KINP_ChecksumABM1_enum_ovrdflg "" VALUE 0x0000 /* @ECU_Address@KINP_ChecksumABM1_enum_ovrdflg@ */ Scalar_BOOLEAN 0 SWC_INP_type_CM_boolean_flg 0.0 1.0 /end CHARACTERISTIC
/begin CHARACTERISTIC KINP_CrashOutputSts_enum_ovrdflg "" VALUE 0x0000 /* @ECU_Address@KINP_CrashOutputSts_enum_ovrdflg@ */ Scalar_BOOLEAN 0 SWC_INP_type_CM_boolean_flg 0.0 1.0 /end CHARACTERISTIC
/begin CHARACTERISTIC KINP_CrashSignalGPIO_flg_inverse "" VALUE 0x0000 /* @ECU_Address@KINP_CrashSignalGPIO_flg_inverse@ */ Scalar_BOOLEAN 0 SWC_INP_type_CM_boolean_flg 0.0 1.0 /end CHARACTERISTIC
/begin CHARACTERISTIC KINP_CrashSignalGPIO_flg_ovrdflg "" VALUE 0x0000 /* @ECU_Address@KINP_CrashSignalGPIO_flg_ovrdflg@ */ Scalar_BOOLEAN 0 SWC_INP_type_CM_boolean_flg 0.0 1.0 /end CHARACTERISTIC
/begin CHARACTERISTIC KINP_CrashSignalGPIO_flg_ovrdval "" VALUE 0x0000 /* @ECU_Address@KINP_CrashSignalGPIO_flg_ovrdval@ */ Scalar_BOOLEAN 0 SWC_INP_type_CM_boolean_flg 0.0 1.0 /end CHARACTERISTIC
/begin CHARACTERISTIC KINP_CrashSignalGPIO_flg_srvcflg "" VALUE 0x0000 /* @ECU_Address@KINP_CrashSignalGPIO_flg_srvcflg@ */ Scalar_BOOLEAN 0 SWC_INP_type_CM_boolean_flg 0.0 1.0 /end CHARACTERISTIC
/begin CHARACTERISTIC KINP_CrashSignalGPIO_flg_srvcval "" VALUE 0x0000 /* @ECU_Address@KINP_CrashSignalGPIO_flg_srvcval@ */ Scalar_BOOLEAN 0 SWC_INP_type_CM_boolean_flg 0.0 1.0 /end CHARACTERISTIC
/begin CHARACTERISTIC KINP_DOASta_flg_defval "" VALUE 0x0000 /* @ECU_Address@KINP_DOASta_flg_defval@ */ Scalar_BOOLEAN 0 SWC_INP_type_CM_boolean_flg 0.0 1.0 /end CHARACTERISTIC
/begin CHARACTERISTIC KINP_DOASta_flg_ovrdflg "" VALUE 0x0000 /* @ECU_Address@KINP_DOASta_flg_ovrdflg@ */ Scalar_BOOLEAN 0 SWC_INP_type_CM_boolean_flg 0.0 1.0 /end CHARACTERISTIC
/begin CHARACTERISTIC KINP_DOASta_flg_ovrdval "" VALUE 0x0000 /* @ECU_Address@KINP_DOASta_flg_ovrdval@ */ Scalar_BOOLEAN 0 SWC_INP_type_CM_boolean_flg 0.0 1.0 /end CHARACTERISTIC
/begin CHARACTERISTIC KINP_DrDoorSW_flg_inverse "" VALUE 0x0000 /* @ECU_Address@KINP_DrDoorSW_flg_inverse@ */ Scalar_BOOLEAN 0 SWC_INP_type_CM_boolean_flg 0.0 1.0 /end CHARACTERISTIC
/begin CHARACTERISTIC KINP_DrDoorSW_flg_ovrdflg "" VALUE 0x0000 /* @ECU_Address@KINP_DrDoorSW_flg_ovrdflg@ */ Scalar_BOOLEAN 0 SWC_INP_type_CM_boolean_flg 0.0 1.0 /end CHARACTERISTIC
/begin CHARACTERISTIC KINP_DrDoorSW_flg_ovrdval "" VALUE 0x0000 /* @ECU_Address@KINP_DrDoorSW_flg_ovrdval@ */ Scalar_BOOLEAN 0 SWC_INP_type_CM_boolean_flg 0.0 1.0 /end CHARACTERISTIC
/begin CHARACTERISTIC KINP_DrDoorSW_flg_srvcflg "" VALUE 0x0000 /* @ECU_Address@KINP_DrDoorSW_flg_srvcflg@ */ Scalar_BOOLEAN 0 SWC_INP_type_CM_boolean_flg 0.0 1.0 /end CHARACTERISTIC
/begin CHARACTERISTIC KINP_DrDoorSW_flg_srvcval "" VALUE 0x0000 /* @ECU_Address@KINP_DrDoorSW_flg_srvcval@ */ Scalar_BOOLEAN 0 SWC_INP_type_CM_boolean_flg 0.0 1.0 /end CHARACTERISTIC
/begin CHARACTERISTIC KINP_DriIntend_enum_ovrdflg "" VALUE 0x0000 /* @ECU_Address@KINP_DriIntend_enum_ovrdflg@ */ Scalar_BOOLEAN 0 SWC_INP_type_CM_boolean_flg 0.0 1.0 /end CHARACTERISTIC
/begin CHARACTERISTIC KINP_DriverSeatBeltCmd_flg_defval "" VALUE 0x0000 /* @ECU_Address@KINP_DriverSeatBeltCmd_flg_defval@ */ Scalar_BOOLEAN 0 SWC_INP_type_CM_boolean_flg 0.0 1.0 /end CHARACTERISTIC
/begin CHARACTERISTIC KINP_DriverSeatBeltCmd_flg_ovrdflg "" VALUE 0x0000 /* @ECU_Address@KINP_DriverSeatBeltCmd_flg_ovrdflg@ */ Scalar_BOOLEAN 0 SWC_INP_type_CM_boolean_flg 0.0 1.0 /end CHARACTERISTIC
/begin CHARACTERISTIC KINP_DriverSeatBeltCmd_flg_ovrdval "" VALUE 0x0000 /* @ECU_Address@KINP_DriverSeatBeltCmd_flg_ovrdval@ */ Scalar_BOOLEAN 0 SWC_INP_type_CM_boolean_flg 0.0 1.0 /end CHARACTERISTIC
/begin CHARACTERISTIC KINP_EBDActive_flg_defval "" VALUE 0x0000 /* @ECU_Address@KINP_EBDActive_flg_defval@ */ Scalar_BOOLEAN 0 SWC_INP_type_CM_boolean_flg 0.0 1.0 /end CHARACTERISTIC
/begin CHARACTERISTIC KINP_EBDActive_flg_ovrdflg "" VALUE 0x0000 /* @ECU_Address@KINP_EBDActive_flg_ovrdflg@ */ Scalar_BOOLEAN 0 SWC_INP_type_CM_boolean_flg 0.0 1.0 /end CHARACTERISTIC
/begin CHARACTERISTIC KINP_EBDActive_flg_ovrdval "" VALUE 0x0000 /* @ECU_Address@KINP_EBDActive_flg_ovrdval@ */ Scalar_BOOLEAN 0 SWC_INP_type_CM_boolean_flg 0.0 1.0 /end CHARACTERISTIC
/begin CHARACTERISTIC KINP_EBDFailed_flg_defval "" VALUE 0x0000 /* @ECU_Address@KINP_EBDFailed_flg_defval@ */ Scalar_BOOLEAN 0 SWC_INP_type_CM_boolean_flg 0.0 1.0 /end CHARACTERISTIC
/begin CHARACTERISTIC KINP_EBDFailed_flg_ovrdflg "" VALUE 0x0000 /* @ECU_Address@KINP_EBDFailed_flg_ovrdflg@ */ Scalar_BOOLEAN 0 SWC_INP_type_CM_boolean_flg 0.0 1.0 /end CHARACTERISTIC
/begin CHARACTERISTIC KINP_EBDFailed_flg_ovrdval "" VALUE 0x0000 /* @ECU_Address@KINP_EBDFailed_flg_ovrdval@ */ Scalar_BOOLEAN 0 SWC_INP_type_CM_boolean_flg 0.0 1.0 /end CHARACTERISTIC
/begin CHARACTERISTIC KINP_EPB1CSErr_flg_defval "" VALUE 0x0000 /* @ECU_Address@KINP_EPB1CSErr_flg_defval@ */ Scalar_BOOLEAN 0 SWC_INP_type_CM_boolean_flg 0.0 1.0 /end CHARACTERISTIC
/begin CHARACTERISTIC KINP_EPB1CSErr_flg_ovrdflg "" VALUE 0x0000 /* @ECU_Address@KINP_EPB1CSErr_flg_ovrdflg@ */ Scalar_BOOLEAN 0 SWC_INP_type_CM_boolean_flg 0.0 1.0 /end CHARACTERISTIC
/begin CHARACTERISTIC KINP_EPB1CSErr_flg_ovrdval "" VALUE 0x0000 /* @ECU_Address@KINP_EPB1CSErr_flg_ovrdval@ */ Scalar_BOOLEAN 0 SWC_INP_type_CM_boolean_flg 0.0 1.0 /end CHARACTERISTIC
/begin CHARACTERISTIC KINP_EPB1RCErr_flg_defval "" VALUE 0x0000 /* @ECU_Address@KINP_EPB1RCErr_flg_defval@ */ Scalar_BOOLEAN 0 SWC_INP_type_CM_boolean_flg 0.0 1.0 /end CHARACTERISTIC
/begin CHARACTERISTIC KINP_EPB1RCErr_flg_ovrdflg "" VALUE 0x0000 /* @ECU_Address@KINP_EPB1RCErr_flg_ovrdflg@ */ Scalar_BOOLEAN 0 SWC_INP_type_CM_boolean_flg 0.0 1.0 /end CHARACTERISTIC
/begin CHARACTERISTIC KINP_EPB1RCErr_flg_ovrdval "" VALUE 0x0000 /* @ECU_Address@KINP_EPB1RCErr_flg_ovrdval@ */ Scalar_BOOLEAN 0 SWC_INP_type_CM_boolean_flg 0.0 1.0 /end CHARACTERISTIC
/begin CHARACTERISTIC KINP_EPB1RC_enum_ovrdflg "" VALUE 0x0000 /* @ECU_Address@KINP_EPB1RC_enum_ovrdflg@ */ Scalar_BOOLEAN 0 SWC_INP_type_CM_boolean_flg 0.0 1.0 /end CHARACTERISTIC
/begin CHARACTERISTIC KINP_EPBCarWashMode_flg_defval "" VALUE 0x0000 /* @ECU_Address@KINP_EPBCarWashMode_flg_defval@ */ Scalar_BOOLEAN 0 SWC_INP_type_CM_boolean_flg 0.0 1.0 /end CHARACTERISTIC
/begin CHARACTERISTIC KINP_EPBCarWashMode_flg_ovrdflg "" VALUE 0x0000 /* @ECU_Address@KINP_EPBCarWashMode_flg_ovrdflg@ */ Scalar_BOOLEAN 0 SWC_INP_type_CM_boolean_flg 0.0 1.0 /end CHARACTERISTIC
/begin CHARACTERISTIC KINP_EPBCarWashMode_flg_ovrdval "" VALUE 0x0000 /* @ECU_Address@KINP_EPBCarWashMode_flg_ovrdval@ */ Scalar_BOOLEAN 0 SWC_INP_type_CM_boolean_flg 0.0 1.0 /end CHARACTERISTIC
/begin CHARACTERISTIC KINP_EPBErrSta_enum_ovrdflg "" VALUE 0x0000 /* @ECU_Address@KINP_EPBErrSta_enum_ovrdflg@ */ Scalar_BOOLEAN 0 SWC_INP_type_CM_boolean_flg 0.0 1.0 /end CHARACTERISTIC
/begin CHARACTERISTIC KINP_EPBExtApplyAvail_flg_defval "" VALUE 0x0000 /* @ECU_Address@KINP_EPBExtApplyAvail_flg_defval@ */ Scalar_BOOLEAN 0 SWC_INP_type_CM_boolean_flg 0.0 1.0 /end CHARACTERISTIC
/begin CHARACTERISTIC KINP_EPBExtApplyAvail_flg_ovrdflg "" VALUE 0x0000 /* @ECU_Address@KINP_EPBExtApplyAvail_flg_ovrdflg@ */ Scalar_BOOLEAN 0 SWC_INP_type_CM_boolean_flg 0.0 1.0 /end CHARACTERISTIC
/begin CHARACTERISTIC KINP_EPBExtApplyAvail_flg_ovrdval "" VALUE 0x0000 /* @ECU_Address@KINP_EPBExtApplyAvail_flg_ovrdval@ */ Scalar_BOOLEAN 0 SWC_INP_type_CM_boolean_flg 0.0 1.0 /end CHARACTERISTIC
/begin CHARACTERISTIC KINP_EPBExtReleaseAvail_flg_defval "" VALUE 0x0000 /* @ECU_Address@KINP_EPBExtReleaseAvail_flg_defval@ */ Scalar_BOOLEAN 0 SWC_INP_type_CM_boolean_flg 0.0 1.0 /end CHARACTERISTIC
/begin CHARACTERISTIC KINP_EPBExtReleaseAvail_flg_ovrdflg "" VALUE 0x0000 /* @ECU_Address@KINP_EPBExtReleaseAvail_flg_ovrdflg@ */ Scalar_BOOLEAN 0 SWC_INP_type_CM_boolean_flg 0.0 1.0 /end CHARACTERISTIC
/begin CHARACTERISTIC KINP_EPBExtReleaseAvail_flg_ovrdval "" VALUE 0x0000 /* @ECU_Address@KINP_EPBExtReleaseAvail_flg_ovrdval@ */ Scalar_BOOLEAN 0 SWC_INP_type_CM_boolean_flg 0.0 1.0 /end CHARACTERISTIC
/begin CHARACTERISTIC KINP_EPBSta_enum_ovrdflg "" VALUE 0x0000 /* @ECU_Address@KINP_EPBSta_enum_ovrdflg@ */ Scalar_BOOLEAN 0 SWC_INP_type_CM_boolean_flg 0.0 1.0 /end CHARACTERISTIC
/begin CHARACTERISTIC KINP_EPS1CSErr_flg_defval "" VALUE 0x0000 /* @ECU_Address@KINP_EPS1CSErr_flg_defval@ */ Scalar_BOOLEAN 0 SWC_INP_type_CM_boolean_flg 0.0 1.0 /end CHARACTERISTIC
/begin CHARACTERISTIC KINP_EPS1CSErr_flg_ovrdflg "" VALUE 0x0000 /* @ECU_Address@KINP_EPS1CSErr_flg_ovrdflg@ */ Scalar_BOOLEAN 0 SWC_INP_type_CM_boolean_flg 0.0 1.0 /end CHARACTERISTIC
/begin CHARACTERISTIC KINP_EPS1CSErr_flg_ovrdval "" VALUE 0x0000 /* @ECU_Address@KINP_EPS1CSErr_flg_ovrdval@ */ Scalar_BOOLEAN 0 SWC_INP_type_CM_boolean_flg 0.0 1.0 /end CHARACTERISTIC
/begin CHARACTERISTIC KINP_EPS1RCErr_flg_defval "" VALUE 0x0000 /* @ECU_Address@KINP_EPS1RCErr_flg_defval@ */ Scalar_BOOLEAN 0 SWC_INP_type_CM_boolean_flg 0.0 1.0 /end CHARACTERISTIC
/begin CHARACTERISTIC KINP_EPS1RCErr_flg_ovrdflg "" VALUE 0x0000 /* @ECU_Address@KINP_EPS1RCErr_flg_ovrdflg@ */ Scalar_BOOLEAN 0 SWC_INP_type_CM_boolean_flg 0.0 1.0 /end CHARACTERISTIC
/begin CHARACTERISTIC KINP_EPS1RCErr_flg_ovrdval "" VALUE 0x0000 /* @ECU_Address@KINP_EPS1RCErr_flg_ovrdval@ */ Scalar_BOOLEAN 0 SWC_INP_type_CM_boolean_flg 0.0 1.0 /end CHARACTERISTIC
/begin CHARACTERISTIC KINP_EPSAOIControl_enum_ovrdflg "" VALUE 0x0000 /* @ECU_Address@KINP_EPSAOIControl_enum_ovrdflg@ */ Scalar_BOOLEAN 0 SWC_INP_type_CM_boolean_flg 0.0 1.0 /end CHARACTERISTIC
/begin CHARACTERISTIC KINP_EPSRC_enum_ovrdflg "" VALUE 0x0000 /* @ECU_Address@KINP_EPSRC_enum_ovrdflg@ */ Scalar_BOOLEAN 0 SWC_INP_type_CM_boolean_flg 0.0 1.0 /end CHARACTERISTIC
/begin CHARACTERISTIC KINP_ESC1CSErr_flg_defval "" VALUE 0x0000 /* @ECU_Address@KINP_ESC1CSErr_flg_defval@ */ Scalar_BOOLEAN 0 SWC_INP_type_CM_boolean_flg 0.0 1.0 /end CHARACTERISTIC
/begin CHARACTERISTIC KINP_ESC1CSErr_flg_ovrdflg "" VALUE 0x0000 /* @ECU_Address@KINP_ESC1CSErr_flg_ovrdflg@ */ Scalar_BOOLEAN 0 SWC_INP_type_CM_boolean_flg 0.0 1.0 /end CHARACTERISTIC
/begin CHARACTERISTIC KINP_ESC1CSErr_flg_ovrdval "" VALUE 0x0000 /* @ECU_Address@KINP_ESC1CSErr_flg_ovrdval@ */ Scalar_BOOLEAN 0 SWC_INP_type_CM_boolean_flg 0.0 1.0 /end CHARACTERISTIC
/begin CHARACTERISTIC KINP_ESC1CS_enum_ovrdflg "" VALUE 0x0000 /* @ECU_Address@KINP_ESC1CS_enum_ovrdflg@ */ Scalar_BOOLEAN 0 SWC_INP_type_CM_boolean_flg 0.0 1.0 /end CHARACTERISTIC
/begin CHARACTERISTIC KINP_ESC1RCErr_flg_defval "" VALUE 0x0000 /* @ECU_Address@KINP_ESC1RCErr_flg_defval@ */ Scalar_BOOLEAN 0 SWC_INP_type_CM_boolean_flg 0.0 1.0 /end CHARACTERISTIC
/begin CHARACTERISTIC KINP_ESC1RCErr_flg_ovrdflg "" VALUE 0x0000 /* @ECU_Address@KINP_ESC1RCErr_flg_ovrdflg@ */ Scalar_BOOLEAN 0 SWC_INP_type_CM_boolean_flg 0.0 1.0 /end CHARACTERISTIC
/begin CHARACTERISTIC KINP_ESC1RCErr_flg_ovrdval "" VALUE 0x0000 /* @ECU_Address@KINP_ESC1RCErr_flg_ovrdval@ */ Scalar_BOOLEAN 0 SWC_INP_type_CM_boolean_flg 0.0 1.0 /end CHARACTERISTIC
/begin CHARACTERISTIC KINP_ESC1RC_enum_ovrdflg "" VALUE 0x0000 /* @ECU_Address@KINP_ESC1RC_enum_ovrdflg@ */ Scalar_BOOLEAN 0 SWC_INP_type_CM_boolean_flg 0.0 1.0 /end CHARACTERISTIC
/begin CHARACTERISTIC KINP_ESCActive_flg_defval "" VALUE 0x0000 /* @ECU_Address@KINP_ESCActive_flg_defval@ */ Scalar_BOOLEAN 0 SWC_INP_type_CM_boolean_flg 0.0 1.0 /end CHARACTERISTIC
/begin CHARACTERISTIC KINP_ESCActive_flg_ovrdflg "" VALUE 0x0000 /* @ECU_Address@KINP_ESCActive_flg_ovrdflg@ */ Scalar_BOOLEAN 0 SWC_INP_type_CM_boolean_flg 0.0 1.0 /end CHARACTERISTIC
/begin CHARACTERISTIC KINP_ESCActive_flg_ovrdval "" VALUE 0x0000 /* @ECU_Address@KINP_ESCActive_flg_ovrdval@ */ Scalar_BOOLEAN 0 SWC_INP_type_CM_boolean_flg 0.0 1.0 /end CHARACTERISTIC
/begin CHARACTERISTIC KINP_ESCBeepReq_flg_defval "" VALUE 0x0000 /* @ECU_Address@KINP_ESCBeepReq_flg_defval@ */ Scalar_BOOLEAN 0 SWC_INP_type_CM_boolean_flg 0.0 1.0 /end CHARACTERISTIC
/begin CHARACTERISTIC KINP_ESCBeepReq_flg_ovrdflg "" VALUE 0x0000 /* @ECU_Address@KINP_ESCBeepReq_flg_ovrdflg@ */ Scalar_BOOLEAN 0 SWC_INP_type_CM_boolean_flg 0.0 1.0 /end CHARACTERISTIC
/begin CHARACTERISTIC KINP_ESCBeepReq_flg_ovrdval "" VALUE 0x0000 /* @ECU_Address@KINP_ESCBeepReq_flg_ovrdval@ */ Scalar_BOOLEAN 0 SWC_INP_type_CM_boolean_flg 0.0 1.0 /end CHARACTERISTIC
/begin CHARACTERISTIC KINP_ESCFailed_flg_defval "" VALUE 0x0000 /* @ECU_Address@KINP_ESCFailed_flg_defval@ */ Scalar_BOOLEAN 0 SWC_INP_type_CM_boolean_flg 0.0 1.0 /end CHARACTERISTIC
/begin CHARACTERISTIC KINP_ESCFailed_flg_ovrdflg "" VALUE 0x0000 /* @ECU_Address@KINP_ESCFailed_flg_ovrdflg@ */ Scalar_BOOLEAN 0 SWC_INP_type_CM_boolean_flg 0.0 1.0 /end CHARACTERISTIC
/begin CHARACTERISTIC KINP_ESCFailed_flg_ovrdval "" VALUE 0x0000 /* @ECU_Address@KINP_ESCFailed_flg_ovrdval@ */ Scalar_BOOLEAN 0 SWC_INP_type_CM_boolean_flg 0.0 1.0 /end CHARACTERISTIC
/begin CHARACTERISTIC KINP_ESCOFFStatus_enum_ovrdflg "" VALUE 0x0000 /* @ECU_Address@KINP_ESCOFFStatus_enum_ovrdflg@ */ Scalar_BOOLEAN 0 SWC_INP_type_CM_boolean_flg 0.0 1.0 /end CHARACTERISTIC
/begin CHARACTERISTIC KINP_ESCOfflmpSta_flg_defval "" VALUE 0x0000 /* @ECU_Address@KINP_ESCOfflmpSta_flg_defval@ */ Scalar_BOOLEAN 0 SWC_INP_type_CM_boolean_flg 0.0 1.0 /end CHARACTERISTIC
/begin CHARACTERISTIC KINP_ESCOfflmpSta_flg_ovrdflg "" VALUE 0x0000 /* @ECU_Address@KINP_ESCOfflmpSta_flg_ovrdflg@ */ Scalar_BOOLEAN 0 SWC_INP_type_CM_boolean_flg 0.0 1.0 /end CHARACTERISTIC
/begin CHARACTERISTIC KINP_ESCOfflmpSta_flg_ovrdval "" VALUE 0x0000 /* @ECU_Address@KINP_ESCOfflmpSta_flg_ovrdval@ */ Scalar_BOOLEAN 0 SWC_INP_type_CM_boolean_flg 0.0 1.0 /end CHARACTERISTIC
/begin CHARACTERISTIC KINP_ESCWnlmpSta_enum_ovrdflg "" VALUE 0x0000 /* @ECU_Address@KINP_ESCWnlmpSta_enum_ovrdflg@ */ Scalar_BOOLEAN 0 SWC_INP_type_CM_boolean_flg 0.0 1.0 /end CHARACTERISTIC
/begin CHARACTERISTIC KINP_ESSActive_flg_defval "" VALUE 0x0000 /* @ECU_Address@KINP_ESSActive_flg_defval@ */ Scalar_BOOLEAN 0 SWC_INP_type_CM_boolean_flg 0.0 1.0 /end CHARACTERISTIC
/begin CHARACTERISTIC KINP_ESSActive_flg_ovrdflg "" VALUE 0x0000 /* @ECU_Address@KINP_ESSActive_flg_ovrdflg@ */ Scalar_BOOLEAN 0 SWC_INP_type_CM_boolean_flg 0.0 1.0 /end CHARACTERISTIC
/begin CHARACTERISTIC KINP_ESSActive_flg_ovrdval "" VALUE 0x0000 /* @ECU_Address@KINP_ESSActive_flg_ovrdval@ */ Scalar_BOOLEAN 0 SWC_INP_type_CM_boolean_flg 0.0 1.0 /end CHARACTERISTIC
/begin CHARACTERISTIC KINP_EpasFailed_enum_ovrdflg "" VALUE 0x0000 /* @ECU_Address@KINP_EpasFailed_enum_ovrdflg@ */ Scalar_BOOLEAN 0 SWC_INP_type_CM_boolean_flg 0.0 1.0 /end CHARACTERISTIC
/begin CHARACTERISTIC KINP_EvccAplusPwrUpReq_flg_ovrdflg "" VALUE 0x0000 /* @ECU_Address@KINP_EvccAplusPwrUpReq_flg_ovrdflg@ */ Scalar_BOOLEAN 0 SWC_INP_type_CM_boolean_flg 0.0 1.0 /end CHARACTERISTIC
/begin CHARACTERISTIC KINP_EvccAplusPwrUpReq_flg_ovrdval "" VALUE 0x0000 /* @ECU_Address@KINP_EvccAplusPwrUpReq_flg_ovrdval@ */ Scalar_BOOLEAN 0 SWC_INP_type_CM_boolean_flg 0.0 1.0 /end CHARACTERISTIC
/begin CHARACTERISTIC KINP_FrPTCSActive_flg_defval "" VALUE 0x0000 /* @ECU_Address@KINP_FrPTCSActive_flg_defval@ */ Scalar_BOOLEAN 0 SWC_INP_type_CM_boolean_flg 0.0 1.0 /end CHARACTERISTIC
/begin CHARACTERISTIC KINP_FrPTCSActive_flg_ovrdflg "" VALUE 0x0000 /* @ECU_Address@KINP_FrPTCSActive_flg_ovrdflg@ */ Scalar_BOOLEAN 0 SWC_INP_type_CM_boolean_flg 0.0 1.0 /end CHARACTERISTIC
/begin CHARACTERISTIC KINP_FrPTCSActive_flg_ovrdval "" VALUE 0x0000 /* @ECU_Address@KINP_FrPTCSActive_flg_ovrdval@ */ Scalar_BOOLEAN 0 SWC_INP_type_CM_boolean_flg 0.0 1.0 /end CHARACTERISTIC
/begin CHARACTERISTIC KINP_FrntAxlTrqReqDrv_Nm_ovrdflg "" VALUE 0x0000 /* @ECU_Address@KINP_FrntAxlTrqReqDrv_Nm_ovrdflg@ */ Scalar_BOOLEAN 0 SWC_INP_type_CM_boolean_flg 0.0 1.0 /end CHARACTERISTIC
/begin CHARACTERISTIC KINP_GRADE_Deg_ovrdflg "" VALUE 0x0000 /* @ECU_Address@KINP_GRADE_Deg_ovrdflg@ */ Scalar_BOOLEAN 0 SWC_INP_type_CM_boolean_flg 0.0 1.0 /end CHARACTERISTIC
/begin CHARACTERISTIC KINP_HBBActive_flg_defval "" VALUE 0x0000 /* @ECU_Address@KINP_HBBActive_flg_defval@ */ Scalar_BOOLEAN 0 SWC_INP_type_CM_boolean_flg 0.0 1.0 /end CHARACTERISTIC
/begin CHARACTERISTIC KINP_HBBActive_flg_ovrdflg "" VALUE 0x0000 /* @ECU_Address@KINP_HBBActive_flg_ovrdflg@ */ Scalar_BOOLEAN 0 SWC_INP_type_CM_boolean_flg 0.0 1.0 /end CHARACTERISTIC
/begin CHARACTERISTIC KINP_HBBActive_flg_ovrdval "" VALUE 0x0000 /* @ECU_Address@KINP_HBBActive_flg_ovrdval@ */ Scalar_BOOLEAN 0 SWC_INP_type_CM_boolean_flg 0.0 1.0 /end CHARACTERISTIC
/begin CHARACTERISTIC KINP_HBBFailed_flg_defval "" VALUE 0x0000 /* @ECU_Address@KINP_HBBFailed_flg_defval@ */ Scalar_BOOLEAN 0 SWC_INP_type_CM_boolean_flg 0.0 1.0 /end CHARACTERISTIC
/begin CHARACTERISTIC KINP_HBBFailed_flg_ovrdflg "" VALUE 0x0000 /* @ECU_Address@KINP_HBBFailed_flg_ovrdflg@ */ Scalar_BOOLEAN 0 SWC_INP_type_CM_boolean_flg 0.0 1.0 /end CHARACTERISTIC
/begin CHARACTERISTIC KINP_HBBFailed_flg_ovrdval "" VALUE 0x0000 /* @ECU_Address@KINP_HBBFailed_flg_ovrdval@ */ Scalar_BOOLEAN 0 SWC_INP_type_CM_boolean_flg 0.0 1.0 /end CHARACTERISTIC
/begin CHARACTERISTIC KINP_HDDActive_flg_defval "" VALUE 0x0000 /* @ECU_Address@KINP_HDDActive_flg_defval@ */ Scalar_BOOLEAN 0 SWC_INP_type_CM_boolean_flg 0.0 1.0 /end CHARACTERISTIC
/begin CHARACTERISTIC KINP_HDDActive_flg_ovrdflg "" VALUE 0x0000 /* @ECU_Address@KINP_HDDActive_flg_ovrdflg@ */ Scalar_BOOLEAN 0 SWC_INP_type_CM_boolean_flg 0.0 1.0 /end CHARACTERISTIC
/begin CHARACTERISTIC KINP_HDDActive_flg_ovrdval "" VALUE 0x0000 /* @ECU_Address@KINP_HDDActive_flg_ovrdval@ */ Scalar_BOOLEAN 0 SWC_INP_type_CM_boolean_flg 0.0 1.0 /end CHARACTERISTIC
/begin CHARACTERISTIC KINP_HDDFailed_flg_defval "" VALUE 0x0000 /* @ECU_Address@KINP_HDDFailed_flg_defval@ */ Scalar_BOOLEAN 0 SWC_INP_type_CM_boolean_flg 0.0 1.0 /end CHARACTERISTIC
/begin CHARACTERISTIC KINP_HDDFailed_flg_ovrdflg "" VALUE 0x0000 /* @ECU_Address@KINP_HDDFailed_flg_ovrdflg@ */ Scalar_BOOLEAN 0 SWC_INP_type_CM_boolean_flg 0.0 1.0 /end CHARACTERISTIC
/begin CHARACTERISTIC KINP_HDDFailed_flg_ovrdval "" VALUE 0x0000 /* @ECU_Address@KINP_HDDFailed_flg_ovrdval@ */ Scalar_BOOLEAN 0 SWC_INP_type_CM_boolean_flg 0.0 1.0 /end CHARACTERISTIC
/begin CHARACTERISTIC KINP_HSAActive_flg_defval "" VALUE 0x0000 /* @ECU_Address@KINP_HSAActive_flg_defval@ */ Scalar_BOOLEAN 0 SWC_INP_type_CM_boolean_flg 0.0 1.0 /end CHARACTERISTIC
/begin CHARACTERISTIC KINP_HSAActive_flg_ovrdflg "" VALUE 0x0000 /* @ECU_Address@KINP_HSAActive_flg_ovrdflg@ */ Scalar_BOOLEAN 0 SWC_INP_type_CM_boolean_flg 0.0 1.0 /end CHARACTERISTIC
/begin CHARACTERISTIC KINP_HSAActive_flg_ovrdval "" VALUE 0x0000 /* @ECU_Address@KINP_HSAActive_flg_ovrdval@ */ Scalar_BOOLEAN 0 SWC_INP_type_CM_boolean_flg 0.0 1.0 /end CHARACTERISTIC
/begin CHARACTERISTIC KINP_HSAFailed_flg_defval "" VALUE 0x0000 /* @ECU_Address@KINP_HSAFailed_flg_defval@ */ Scalar_BOOLEAN 0 SWC_INP_type_CM_boolean_flg 0.0 1.0 /end CHARACTERISTIC
/begin CHARACTERISTIC KINP_HSAFailed_flg_ovrdflg "" VALUE 0x0000 /* @ECU_Address@KINP_HSAFailed_flg_ovrdflg@ */ Scalar_BOOLEAN 0 SWC_INP_type_CM_boolean_flg 0.0 1.0 /end CHARACTERISTIC
/begin CHARACTERISTIC KINP_HSAFailed_flg_ovrdval "" VALUE 0x0000 /* @ECU_Address@KINP_HSAFailed_flg_ovrdval@ */ Scalar_BOOLEAN 0 SWC_INP_type_CM_boolean_flg 0.0 1.0 /end CHARACTERISTIC
/begin CHARACTERISTIC KINP_HazardSW_flg_inverse "" VALUE 0x0000 /* @ECU_Address@KINP_HazardSW_flg_inverse@ */ Scalar_BOOLEAN 0 SWC_INP_type_CM_boolean_flg 0.0 1.0 /end CHARACTERISTIC
/begin CHARACTERISTIC KINP_HazardSW_flg_ovrdflg "" VALUE 0x0000 /* @ECU_Address@KINP_HazardSW_flg_ovrdflg@ */ Scalar_BOOLEAN 0 SWC_INP_type_CM_boolean_flg 0.0 1.0 /end CHARACTERISTIC
/begin CHARACTERISTIC KINP_HazardSW_flg_ovrdval "" VALUE 0x0000 /* @ECU_Address@KINP_HazardSW_flg_ovrdval@ */ Scalar_BOOLEAN 0 SWC_INP_type_CM_boolean_flg 0.0 1.0 /end CHARACTERISTIC
/begin CHARACTERISTIC KINP_HazardSW_flg_srvcflg "" VALUE 0x0000 /* @ECU_Address@KINP_HazardSW_flg_srvcflg@ */ Scalar_BOOLEAN 0 SWC_INP_type_CM_boolean_flg 0.0 1.0 /end CHARACTERISTIC
/begin CHARACTERISTIC KINP_HazardSW_flg_srvcval "" VALUE 0x0000 /* @ECU_Address@KINP_HazardSW_flg_srvcval@ */ Scalar_BOOLEAN 0 SWC_INP_type_CM_boolean_flg 0.0 1.0 /end CHARACTERISTIC
/begin CHARACTERISTIC KINP_HoodSW_flg_inverse "" VALUE 0x0000 /* @ECU_Address@KINP_HoodSW_flg_inverse@ */ Scalar_BOOLEAN 0 SWC_INP_type_CM_boolean_flg 0.0 1.0 /end CHARACTERISTIC
/begin CHARACTERISTIC KINP_HoodSW_flg_ovrdflg "" VALUE 0x0000 /* @ECU_Address@KINP_HoodSW_flg_ovrdflg@ */ Scalar_BOOLEAN 0 SWC_INP_type_CM_boolean_flg 0.0 1.0 /end CHARACTERISTIC
/begin CHARACTERISTIC KINP_HoodSW_flg_ovrdval "" VALUE 0x0000 /* @ECU_Address@KINP_HoodSW_flg_ovrdval@ */ Scalar_BOOLEAN 0 SWC_INP_type_CM_boolean_flg 0.0 1.0 /end CHARACTERISTIC
/begin CHARACTERISTIC KINP_HoodSW_flg_srvcflg "" VALUE 0x0000 /* @ECU_Address@KINP_HoodSW_flg_srvcflg@ */ Scalar_BOOLEAN 0 SWC_INP_type_CM_boolean_flg 0.0 1.0 /end CHARACTERISTIC
/begin CHARACTERISTIC KINP_HoodSW_flg_srvcval "" VALUE 0x0000 /* @ECU_Address@KINP_HoodSW_flg_srvcval@ */ Scalar_BOOLEAN 0 SWC_INP_type_CM_boolean_flg 0.0 1.0 /end CHARACTERISTIC
/begin CHARACTERISTIC KINP_LFPulseCountV_flg_defval "" VALUE 0x0000 /* @ECU_Address@KINP_LFPulseCountV_flg_defval@ */ Scalar_BOOLEAN 0 SWC_INP_type_CM_boolean_flg 0.0 1.0 /end CHARACTERISTIC
/begin CHARACTERISTIC KINP_LFPulseCountV_flg_ovrdflg "" VALUE 0x0000 /* @ECU_Address@KINP_LFPulseCountV_flg_ovrdflg@ */ Scalar_BOOLEAN 0 SWC_INP_type_CM_boolean_flg 0.0 1.0 /end CHARACTERISTIC
/begin CHARACTERISTIC KINP_LFPulseCountV_flg_ovrdval "" VALUE 0x0000 /* @ECU_Address@KINP_LFPulseCountV_flg_ovrdval@ */ Scalar_BOOLEAN 0 SWC_INP_type_CM_boolean_flg 0.0 1.0 /end CHARACTERISTIC
/begin CHARACTERISTIC KINP_LFPulseCount_enum_ovrdflg "" VALUE 0x0000 /* @ECU_Address@KINP_LFPulseCount_enum_ovrdflg@ */ Scalar_BOOLEAN 0 SWC_INP_type_CM_boolean_flg 0.0 1.0 /end CHARACTERISTIC
/begin CHARACTERISTIC KINP_LFRawWhlSpeedV_flg_defval "" VALUE 0x0000 /* @ECU_Address@KINP_LFRawWhlSpeedV_flg_defval@ */ Scalar_BOOLEAN 0 SWC_INP_type_CM_boolean_flg 0.0 1.0 /end CHARACTERISTIC
/begin CHARACTERISTIC KINP_LFRawWhlSpeedV_flg_ovrdflg "" VALUE 0x0000 /* @ECU_Address@KINP_LFRawWhlSpeedV_flg_ovrdflg@ */ Scalar_BOOLEAN 0 SWC_INP_type_CM_boolean_flg 0.0 1.0 /end CHARACTERISTIC
/begin CHARACTERISTIC KINP_LFRawWhlSpeedV_flg_ovrdval "" VALUE 0x0000 /* @ECU_Address@KINP_LFRawWhlSpeedV_flg_ovrdval@ */ Scalar_BOOLEAN 0 SWC_INP_type_CM_boolean_flg 0.0 1.0 /end CHARACTERISTIC
/begin CHARACTERISTIC KINP_LFRawWhlSpeed_kph_ovrdflg "" VALUE 0x0000 /* @ECU_Address@KINP_LFRawWhlSpeed_kph_ovrdflg@ */ Scalar_BOOLEAN 0 SWC_INP_type_CM_boolean_flg 0.0 1.0 /end CHARACTERISTIC
/begin CHARACTERISTIC KINP_LFWhlRotDir_enum_ovrdflg "" VALUE 0x0000 /* @ECU_Address@KINP_LFWhlRotDir_enum_ovrdflg@ */ Scalar_BOOLEAN 0 SWC_INP_type_CM_boolean_flg 0.0 1.0 /end CHARACTERISTIC
/begin CHARACTERISTIC KINP_LRPulseCountV_flg_defval "" VALUE 0x0000 /* @ECU_Address@KINP_LRPulseCountV_flg_defval@ */ Scalar_BOOLEAN 0 SWC_INP_type_CM_boolean_flg 0.0 1.0 /end CHARACTERISTIC
/begin CHARACTERISTIC KINP_LRPulseCountV_flg_ovrdflg "" VALUE 0x0000 /* @ECU_Address@KINP_LRPulseCountV_flg_ovrdflg@ */ Scalar_BOOLEAN 0 SWC_INP_type_CM_boolean_flg 0.0 1.0 /end CHARACTERISTIC
/begin CHARACTERISTIC KINP_LRPulseCountV_flg_ovrdval "" VALUE 0x0000 /* @ECU_Address@KINP_LRPulseCountV_flg_ovrdval@ */ Scalar_BOOLEAN 0 SWC_INP_type_CM_boolean_flg 0.0 1.0 /end CHARACTERISTIC
/begin CHARACTERISTIC KINP_LRPulseCount_enum_ovrdflg "" VALUE 0x0000 /* @ECU_Address@KINP_LRPulseCount_enum_ovrdflg@ */ Scalar_BOOLEAN 0 SWC_INP_type_CM_boolean_flg 0.0 1.0 /end CHARACTERISTIC
/begin CHARACTERISTIC KINP_LRRawWhlSpeedV_flg_defval "" VALUE 0x0000 /* @ECU_Address@KINP_LRRawWhlSpeedV_flg_defval@ */ Scalar_BOOLEAN 0 SWC_INP_type_CM_boolean_flg 0.0 1.0 /end CHARACTERISTIC
/begin CHARACTERISTIC KINP_LRRawWhlSpeedV_flg_ovrdflg "" VALUE 0x0000 /* @ECU_Address@KINP_LRRawWhlSpeedV_flg_ovrdflg@ */ Scalar_BOOLEAN 0 SWC_INP_type_CM_boolean_flg 0.0 1.0 /end CHARACTERISTIC
/begin CHARACTERISTIC KINP_LRRawWhlSpeedV_flg_ovrdval "" VALUE 0x0000 /* @ECU_Address@KINP_LRRawWhlSpeedV_flg_ovrdval@ */ Scalar_BOOLEAN 0 SWC_INP_type_CM_boolean_flg 0.0 1.0 /end CHARACTERISTIC
/begin CHARACTERISTIC KINP_LRRawWhlSpeed_kph_ovrdflg "" VALUE 0x0000 /* @ECU_Address@KINP_LRRawWhlSpeed_kph_ovrdflg@ */ Scalar_BOOLEAN 0 SWC_INP_type_CM_boolean_flg 0.0 1.0 /end CHARACTERISTIC
/begin CHARACTERISTIC KINP_LRWhlRotDir_enum_ovrdflg "" VALUE 0x0000 /* @ECU_Address@KINP_LRWhlRotDir_enum_ovrdflg@ */ Scalar_BOOLEAN 0 SWC_INP_type_CM_boolean_flg 0.0 1.0 /end CHARACTERISTIC
/begin CHARACTERISTIC KINP_LifeCountABM1_enum_ovrdflg "" VALUE 0x0000 /* @ECU_Address@KINP_LifeCountABM1_enum_ovrdflg@ */ Scalar_BOOLEAN 0 SWC_INP_type_CM_boolean_flg 0.0 1.0 /end CHARACTERISTIC
/begin CHARACTERISTIC KINP_PABSwitchCmd_flg_defval "" VALUE 0x0000 /* @ECU_Address@KINP_PABSwitchCmd_flg_defval@ */ Scalar_BOOLEAN 0 SWC_INP_type_CM_boolean_flg 0.0 1.0 /end CHARACTERISTIC
/begin CHARACTERISTIC KINP_PABSwitchCmd_flg_ovrdflg "" VALUE 0x0000 /* @ECU_Address@KINP_PABSwitchCmd_flg_ovrdflg@ */ Scalar_BOOLEAN 0 SWC_INP_type_CM_boolean_flg 0.0 1.0 /end CHARACTERISTIC
/begin CHARACTERISTIC KINP_PABSwitchCmd_flg_ovrdval "" VALUE 0x0000 /* @ECU_Address@KINP_PABSwitchCmd_flg_ovrdval@ */ Scalar_BOOLEAN 0 SWC_INP_type_CM_boolean_flg 0.0 1.0 /end CHARACTERISTIC
/begin CHARACTERISTIC KINP_PBAActive_flg_defval "" VALUE 0x0000 /* @ECU_Address@KINP_PBAActive_flg_defval@ */ Scalar_BOOLEAN 0 SWC_INP_type_CM_boolean_flg 0.0 1.0 /end CHARACTERISTIC
/begin CHARACTERISTIC KINP_PBAActive_flg_ovrdflg "" VALUE 0x0000 /* @ECU_Address@KINP_PBAActive_flg_ovrdflg@ */ Scalar_BOOLEAN 0 SWC_INP_type_CM_boolean_flg 0.0 1.0 /end CHARACTERISTIC
/begin CHARACTERISTIC KINP_PBAActive_flg_ovrdval "" VALUE 0x0000 /* @ECU_Address@KINP_PBAActive_flg_ovrdval@ */ Scalar_BOOLEAN 0 SWC_INP_type_CM_boolean_flg 0.0 1.0 /end CHARACTERISTIC
/begin CHARACTERISTIC KINP_PBAFailed_flg_defval "" VALUE 0x0000 /* @ECU_Address@KINP_PBAFailed_flg_defval@ */ Scalar_BOOLEAN 0 SWC_INP_type_CM_boolean_flg 0.0 1.0 /end CHARACTERISTIC
/begin CHARACTERISTIC KINP_PBAFailed_flg_ovrdflg "" VALUE 0x0000 /* @ECU_Address@KINP_PBAFailed_flg_ovrdflg@ */ Scalar_BOOLEAN 0 SWC_INP_type_CM_boolean_flg 0.0 1.0 /end CHARACTERISTIC
/begin CHARACTERISTIC KINP_PBAFailed_flg_ovrdval "" VALUE 0x0000 /* @ECU_Address@KINP_PBAFailed_flg_ovrdval@ */ Scalar_BOOLEAN 0 SWC_INP_type_CM_boolean_flg 0.0 1.0 /end CHARACTERISTIC
/begin CHARACTERISTIC KINP_PsDoorSW_flg_inverse "" VALUE 0x0000 /* @ECU_Address@KINP_PsDoorSW_flg_inverse@ */ Scalar_BOOLEAN 0 SWC_INP_type_CM_boolean_flg 0.0 1.0 /end CHARACTERISTIC
/begin CHARACTERISTIC KINP_PsDoorSW_flg_ovrdflg "" VALUE 0x0000 /* @ECU_Address@KINP_PsDoorSW_flg_ovrdflg@ */ Scalar_BOOLEAN 0 SWC_INP_type_CM_boolean_flg 0.0 1.0 /end CHARACTERISTIC
/begin CHARACTERISTIC KINP_PsDoorSW_flg_ovrdval "" VALUE 0x0000 /* @ECU_Address@KINP_PsDoorSW_flg_ovrdval@ */ Scalar_BOOLEAN 0 SWC_INP_type_CM_boolean_flg 0.0 1.0 /end CHARACTERISTIC
/begin CHARACTERISTIC KINP_PsDoorSW_flg_srvcflg "" VALUE 0x0000 /* @ECU_Address@KINP_PsDoorSW_flg_srvcflg@ */ Scalar_BOOLEAN 0 SWC_INP_type_CM_boolean_flg 0.0 1.0 /end CHARACTERISTIC
/begin CHARACTERISTIC KINP_PsDoorSW_flg_srvcval "" VALUE 0x0000 /* @ECU_Address@KINP_PsDoorSW_flg_srvcval@ */ Scalar_BOOLEAN 0 SWC_INP_type_CM_boolean_flg 0.0 1.0 /end CHARACTERISTIC
/begin CHARACTERISTIC KINP_PsngrSeatBeltCmd_flg_defval "" VALUE 0x0000 /* @ECU_Address@KINP_PsngrSeatBeltCmd_flg_defval@ */ Scalar_BOOLEAN 0 SWC_INP_type_CM_boolean_flg 0.0 1.0 /end CHARACTERISTIC
/begin CHARACTERISTIC KINP_PsngrSeatBeltCmd_flg_ovrdflg "" VALUE 0x0000 /* @ECU_Address@KINP_PsngrSeatBeltCmd_flg_ovrdflg@ */ Scalar_BOOLEAN 0 SWC_INP_type_CM_boolean_flg 0.0 1.0 /end CHARACTERISTIC
/begin CHARACTERISTIC KINP_PsngrSeatBeltCmd_flg_ovrdval "" VALUE 0x0000 /* @ECU_Address@KINP_PsngrSeatBeltCmd_flg_ovrdval@ */ Scalar_BOOLEAN 0 SWC_INP_type_CM_boolean_flg 0.0 1.0 /end CHARACTERISTIC
/begin CHARACTERISTIC KINP_RCenterSeatBeltCmd_flg_defval "" VALUE 0x0000 /* @ECU_Address@KINP_RCenterSeatBeltCmd_flg_defval@ */ Scalar_BOOLEAN 0 SWC_INP_type_CM_boolean_flg 0.0 1.0 /end CHARACTERISTIC
/begin CHARACTERISTIC KINP_RCenterSeatBeltCmd_flg_ovrdflg "" VALUE 0x0000 /* @ECU_Address@KINP_RCenterSeatBeltCmd_flg_ovrdflg@ */ Scalar_BOOLEAN 0 SWC_INP_type_CM_boolean_flg 0.0 1.0 /end CHARACTERISTIC
/begin CHARACTERISTIC KINP_RCenterSeatBeltCmd_flg_ovrdval "" VALUE 0x0000 /* @ECU_Address@KINP_RCenterSeatBeltCmd_flg_ovrdval@ */ Scalar_BOOLEAN 0 SWC_INP_type_CM_boolean_flg 0.0 1.0 /end CHARACTERISTIC
/begin CHARACTERISTIC KINP_RDriverSeatBeltCmd_flg_defval "" VALUE 0x0000 /* @ECU_Address@KINP_RDriverSeatBeltCmd_flg_defval@ */ Scalar_BOOLEAN 0 SWC_INP_type_CM_boolean_flg 0.0 1.0 /end CHARACTERISTIC
/begin CHARACTERISTIC KINP_RDriverSeatBeltCmd_flg_ovrdflg "" VALUE 0x0000 /* @ECU_Address@KINP_RDriverSeatBeltCmd_flg_ovrdflg@ */ Scalar_BOOLEAN 0 SWC_INP_type_CM_boolean_flg 0.0 1.0 /end CHARACTERISTIC
/begin CHARACTERISTIC KINP_RDriverSeatBeltCmd_flg_ovrdval "" VALUE 0x0000 /* @ECU_Address@KINP_RDriverSeatBeltCmd_flg_ovrdval@ */ Scalar_BOOLEAN 0 SWC_INP_type_CM_boolean_flg 0.0 1.0 /end CHARACTERISTIC
/begin CHARACTERISTIC KINP_RFPulseCountV_flg_defval "" VALUE 0x0000 /* @ECU_Address@KINP_RFPulseCountV_flg_defval@ */ Scalar_BOOLEAN 0 SWC_INP_type_CM_boolean_flg 0.0 1.0 /end CHARACTERISTIC
/begin CHARACTERISTIC KINP_RFPulseCountV_flg_ovrdflg "" VALUE 0x0000 /* @ECU_Address@KINP_RFPulseCountV_flg_ovrdflg@ */ Scalar_BOOLEAN 0 SWC_INP_type_CM_boolean_flg 0.0 1.0 /end CHARACTERISTIC
/begin CHARACTERISTIC KINP_RFPulseCountV_flg_ovrdval "" VALUE 0x0000 /* @ECU_Address@KINP_RFPulseCountV_flg_ovrdval@ */ Scalar_BOOLEAN 0 SWC_INP_type_CM_boolean_flg 0.0 1.0 /end CHARACTERISTIC
/begin CHARACTERISTIC KINP_RFPulseCount_enum_ovrdflg "" VALUE 0x0000 /* @ECU_Address@KINP_RFPulseCount_enum_ovrdflg@ */ Scalar_BOOLEAN 0 SWC_INP_type_CM_boolean_flg 0.0 1.0 /end CHARACTERISTIC
/begin CHARACTERISTIC KINP_RFRawWhlSpeedV_flg_defval "" VALUE 0x0000 /* @ECU_Address@KINP_RFRawWhlSpeedV_flg_defval@ */ Scalar_BOOLEAN 0 SWC_INP_type_CM_boolean_flg 0.0 1.0 /end CHARACTERISTIC
/begin CHARACTERISTIC KINP_RFRawWhlSpeedV_flg_ovrdflg "" VALUE 0x0000 /* @ECU_Address@KINP_RFRawWhlSpeedV_flg_ovrdflg@ */ Scalar_BOOLEAN 0 SWC_INP_type_CM_boolean_flg 0.0 1.0 /end CHARACTERISTIC
/begin CHARACTERISTIC KINP_RFRawWhlSpeedV_flg_ovrdval "" VALUE 0x0000 /* @ECU_Address@KINP_RFRawWhlSpeedV_flg_ovrdval@ */ Scalar_BOOLEAN 0 SWC_INP_type_CM_boolean_flg 0.0 1.0 /end CHARACTERISTIC
/begin CHARACTERISTIC KINP_RFRawWhlSpeed_kph_ovrdflg "" VALUE 0x0000 /* @ECU_Address@KINP_RFRawWhlSpeed_kph_ovrdflg@ */ Scalar_BOOLEAN 0 SWC_INP_type_CM_boolean_flg 0.0 1.0 /end CHARACTERISTIC
/begin CHARACTERISTIC KINP_RFWhlRotDir_enum_ovrdflg "" VALUE 0x0000 /* @ECU_Address@KINP_RFWhlRotDir_enum_ovrdflg@ */ Scalar_BOOLEAN 0 SWC_INP_type_CM_boolean_flg 0.0 1.0 /end CHARACTERISTIC
/begin CHARACTERISTIC KINP_RLDoorSW_flg_inverse "" VALUE 0x0000 /* @ECU_Address@KINP_RLDoorSW_flg_inverse@ */ Scalar_BOOLEAN 0 SWC_INP_type_CM_boolean_flg 0.0 1.0 /end CHARACTERISTIC
/begin CHARACTERISTIC KINP_RLDoorSW_flg_ovrdflg "" VALUE 0x0000 /* @ECU_Address@KINP_RLDoorSW_flg_ovrdflg@ */ Scalar_BOOLEAN 0 SWC_INP_type_CM_boolean_flg 0.0 1.0 /end CHARACTERISTIC
/begin CHARACTERISTIC KINP_RLDoorSW_flg_ovrdval "" VALUE 0x0000 /* @ECU_Address@KINP_RLDoorSW_flg_ovrdval@ */ Scalar_BOOLEAN 0 SWC_INP_type_CM_boolean_flg 0.0 1.0 /end CHARACTERISTIC
/begin CHARACTERISTIC KINP_RLDoorSW_flg_srvcflg "" VALUE 0x0000 /* @ECU_Address@KINP_RLDoorSW_flg_srvcflg@ */ Scalar_BOOLEAN 0 SWC_INP_type_CM_boolean_flg 0.0 1.0 /end CHARACTERISTIC
/begin CHARACTERISTIC KINP_RLDoorSW_flg_srvcval "" VALUE 0x0000 /* @ECU_Address@KINP_RLDoorSW_flg_srvcval@ */ Scalar_BOOLEAN 0 SWC_INP_type_CM_boolean_flg 0.0 1.0 /end CHARACTERISTIC
/begin CHARACTERISTIC KINP_RPsngrSeatBeltCmd_flg_defval "" VALUE 0x0000 /* @ECU_Address@KINP_RPsngrSeatBeltCmd_flg_defval@ */ Scalar_BOOLEAN 0 SWC_INP_type_CM_boolean_flg 0.0 1.0 /end CHARACTERISTIC
/begin CHARACTERISTIC KINP_RPsngrSeatBeltCmd_flg_ovrdflg "" VALUE 0x0000 /* @ECU_Address@KINP_RPsngrSeatBeltCmd_flg_ovrdflg@ */ Scalar_BOOLEAN 0 SWC_INP_type_CM_boolean_flg 0.0 1.0 /end CHARACTERISTIC
/begin CHARACTERISTIC KINP_RPsngrSeatBeltCmd_flg_ovrdval "" VALUE 0x0000 /* @ECU_Address@KINP_RPsngrSeatBeltCmd_flg_ovrdval@ */ Scalar_BOOLEAN 0 SWC_INP_type_CM_boolean_flg 0.0 1.0 /end CHARACTERISTIC
/begin CHARACTERISTIC KINP_RRDoorSW_flg_inverse "" VALUE 0x0000 /* @ECU_Address@KINP_RRDoorSW_flg_inverse@ */ Scalar_BOOLEAN 0 SWC_INP_type_CM_boolean_flg 0.0 1.0 /end CHARACTERISTIC
/begin CHARACTERISTIC KINP_RRDoorSW_flg_ovrdflg "" VALUE 0x0000 /* @ECU_Address@KINP_RRDoorSW_flg_ovrdflg@ */ Scalar_BOOLEAN 0 SWC_INP_type_CM_boolean_flg 0.0 1.0 /end CHARACTERISTIC
/begin CHARACTERISTIC KINP_RRDoorSW_flg_ovrdval "" VALUE 0x0000 /* @ECU_Address@KINP_RRDoorSW_flg_ovrdval@ */ Scalar_BOOLEAN 0 SWC_INP_type_CM_boolean_flg 0.0 1.0 /end CHARACTERISTIC
/begin CHARACTERISTIC KINP_RRDoorSW_flg_srvcflg "" VALUE 0x0000 /* @ECU_Address@KINP_RRDoorSW_flg_srvcflg@ */ Scalar_BOOLEAN 0 SWC_INP_type_CM_boolean_flg 0.0 1.0 /end CHARACTERISTIC
/begin CHARACTERISTIC KINP_RRDoorSW_flg_srvcval "" VALUE 0x0000 /* @ECU_Address@KINP_RRDoorSW_flg_srvcval@ */ Scalar_BOOLEAN 0 SWC_INP_type_CM_boolean_flg 0.0 1.0 /end CHARACTERISTIC
/begin CHARACTERISTIC KINP_RRPulseCountV_flg_defval "" VALUE 0x0000 /* @ECU_Address@KINP_RRPulseCountV_flg_defval@ */ Scalar_BOOLEAN 0 SWC_INP_type_CM_boolean_flg 0.0 1.0 /end CHARACTERISTIC
/begin CHARACTERISTIC KINP_RRPulseCountV_flg_ovrdflg "" VALUE 0x0000 /* @ECU_Address@KINP_RRPulseCountV_flg_ovrdflg@ */ Scalar_BOOLEAN 0 SWC_INP_type_CM_boolean_flg 0.0 1.0 /end CHARACTERISTIC
/begin CHARACTERISTIC KINP_RRPulseCountV_flg_ovrdval "" VALUE 0x0000 /* @ECU_Address@KINP_RRPulseCountV_flg_ovrdval@ */ Scalar_BOOLEAN 0 SWC_INP_type_CM_boolean_flg 0.0 1.0 /end CHARACTERISTIC
/begin CHARACTERISTIC KINP_RRPulseCount_enum_ovrdflg "" VALUE 0x0000 /* @ECU_Address@KINP_RRPulseCount_enum_ovrdflg@ */ Scalar_BOOLEAN 0 SWC_INP_type_CM_boolean_flg 0.0 1.0 /end CHARACTERISTIC
/begin CHARACTERISTIC KINP_RRRawWhlSpeedV_flg_defval "" VALUE 0x0000 /* @ECU_Address@KINP_RRRawWhlSpeedV_flg_defval@ */ Scalar_BOOLEAN 0 SWC_INP_type_CM_boolean_flg 0.0 1.0 /end CHARACTERISTIC
/begin CHARACTERISTIC KINP_RRRawWhlSpeedV_flg_ovrdflg "" VALUE 0x0000 /* @ECU_Address@KINP_RRRawWhlSpeedV_flg_ovrdflg@ */ Scalar_BOOLEAN 0 SWC_INP_type_CM_boolean_flg 0.0 1.0 /end CHARACTERISTIC
/begin CHARACTERISTIC KINP_RRRawWhlSpeedV_flg_ovrdval "" VALUE 0x0000 /* @ECU_Address@KINP_RRRawWhlSpeedV_flg_ovrdval@ */ Scalar_BOOLEAN 0 SWC_INP_type_CM_boolean_flg 0.0 1.0 /end CHARACTERISTIC
/begin CHARACTERISTIC KINP_RRRawWhlSpeed_kph_ovrdflg "" VALUE 0x0000 /* @ECU_Address@KINP_RRRawWhlSpeed_kph_ovrdflg@ */ Scalar_BOOLEAN 0 SWC_INP_type_CM_boolean_flg 0.0 1.0 /end CHARACTERISTIC
/begin CHARACTERISTIC KINP_RRWhlRotDir_enum_ovrdflg "" VALUE 0x0000 /* @ECU_Address@KINP_RRWhlRotDir_enum_ovrdflg@ */ Scalar_BOOLEAN 0 SWC_INP_type_CM_boolean_flg 0.0 1.0 /end CHARACTERISTIC
/begin CHARACTERISTIC KINP_RearAxlTrqReqDrv_Nm_ovrdflg "" VALUE 0x0000 /* @ECU_Address@KINP_RearAxlTrqReqDrv_Nm_ovrdflg@ */ Scalar_BOOLEAN 0 SWC_INP_type_CM_boolean_flg 0.0 1.0 /end CHARACTERISTIC
/begin CHARACTERISTIC KINP_RedWnlmpSta_flg_defval "" VALUE 0x0000 /* @ECU_Address@KINP_RedWnlmpSta_flg_defval@ */ Scalar_BOOLEAN 0 SWC_INP_type_CM_boolean_flg 0.0 1.0 /end CHARACTERISTIC
/begin CHARACTERISTIC KINP_RedWnlmpSta_flg_ovrdflg "" VALUE 0x0000 /* @ECU_Address@KINP_RedWnlmpSta_flg_ovrdflg@ */ Scalar_BOOLEAN 0 SWC_INP_type_CM_boolean_flg 0.0 1.0 /end CHARACTERISTIC
/begin CHARACTERISTIC KINP_RedWnlmpSta_flg_ovrdval "" VALUE 0x0000 /* @ECU_Address@KINP_RedWnlmpSta_flg_ovrdval@ */ Scalar_BOOLEAN 0 SWC_INP_type_CM_boolean_flg 0.0 1.0 /end CHARACTERISTIC
/begin CHARACTERISTIC KINP_RrPTCSActive_flg_defval "" VALUE 0x0000 /* @ECU_Address@KINP_RrPTCSActive_flg_defval@ */ Scalar_BOOLEAN 0 SWC_INP_type_CM_boolean_flg 0.0 1.0 /end CHARACTERISTIC
/begin CHARACTERISTIC KINP_RrPTCSActive_flg_ovrdflg "" VALUE 0x0000 /* @ECU_Address@KINP_RrPTCSActive_flg_ovrdflg@ */ Scalar_BOOLEAN 0 SWC_INP_type_CM_boolean_flg 0.0 1.0 /end CHARACTERISTIC
/begin CHARACTERISTIC KINP_RrPTCSActive_flg_ovrdval "" VALUE 0x0000 /* @ECU_Address@KINP_RrPTCSActive_flg_ovrdval@ */ Scalar_BOOLEAN 0 SWC_INP_type_CM_boolean_flg 0.0 1.0 /end CHARACTERISTIC
/begin CHARACTERISTIC KINP_SASAngle_Deg_ovrdflg "" VALUE 0x0000 /* @ECU_Address@KINP_SASAngle_Deg_ovrdflg@ */ Scalar_BOOLEAN 0 SWC_INP_type_CM_boolean_flg 0.0 1.0 /end CHARACTERISTIC
/begin CHARACTERISTIC KINP_SASCAL_flg_defval "" VALUE 0x0000 /* @ECU_Address@KINP_SASCAL_flg_defval@ */ Scalar_BOOLEAN 0 SWC_INP_type_CM_boolean_flg 0.0 1.0 /end CHARACTERISTIC
/begin CHARACTERISTIC KINP_SASCAL_flg_ovrdflg "" VALUE 0x0000 /* @ECU_Address@KINP_SASCAL_flg_ovrdflg@ */ Scalar_BOOLEAN 0 SWC_INP_type_CM_boolean_flg 0.0 1.0 /end CHARACTERISTIC
/begin CHARACTERISTIC KINP_SASCAL_flg_ovrdval "" VALUE 0x0000 /* @ECU_Address@KINP_SASCAL_flg_ovrdval@ */ Scalar_BOOLEAN 0 SWC_INP_type_CM_boolean_flg 0.0 1.0 /end CHARACTERISTIC
/begin CHARACTERISTIC KINP_SASSpeedValid_flg_defval "" VALUE 0x0000 /* @ECU_Address@KINP_SASSpeedValid_flg_defval@ */ Scalar_BOOLEAN 0 SWC_INP_type_CM_boolean_flg 0.0 1.0 /end CHARACTERISTIC
/begin CHARACTERISTIC KINP_SASSpeedValid_flg_ovrdflg "" VALUE 0x0000 /* @ECU_Address@KINP_SASSpeedValid_flg_ovrdflg@ */ Scalar_BOOLEAN 0 SWC_INP_type_CM_boolean_flg 0.0 1.0 /end CHARACTERISTIC
/begin CHARACTERISTIC KINP_SASSpeedValid_flg_ovrdval "" VALUE 0x0000 /* @ECU_Address@KINP_SASSpeedValid_flg_ovrdval@ */ Scalar_BOOLEAN 0 SWC_INP_type_CM_boolean_flg 0.0 1.0 /end CHARACTERISTIC
/begin CHARACTERISTIC KINP_SASSpeed_degps_ovrdflg "" VALUE 0x0000 /* @ECU_Address@KINP_SASSpeed_degps_ovrdflg@ */ Scalar_BOOLEAN 0 SWC_INP_type_CM_boolean_flg 0.0 1.0 /end CHARACTERISTIC
/begin CHARACTERISTIC KINP_SASV_flg_defval "" VALUE 0x0000 /* @ECU_Address@KINP_SASV_flg_defval@ */ Scalar_BOOLEAN 0 SWC_INP_type_CM_boolean_flg 0.0 1.0 /end CHARACTERISTIC
/begin CHARACTERISTIC KINP_SASV_flg_ovrdflg "" VALUE 0x0000 /* @ECU_Address@KINP_SASV_flg_ovrdflg@ */ Scalar_BOOLEAN 0 SWC_INP_type_CM_boolean_flg 0.0 1.0 /end CHARACTERISTIC
/begin CHARACTERISTIC KINP_SASV_flg_ovrdval "" VALUE 0x0000 /* @ECU_Address@KINP_SASV_flg_ovrdval@ */ Scalar_BOOLEAN 0 SWC_INP_type_CM_boolean_flg 0.0 1.0 /end CHARACTERISTIC
/begin CHARACTERISTIC KINP_SeatSW_flg_inverse "" VALUE 0x0000 /* @ECU_Address@KINP_SeatSW_flg_inverse@ */ Scalar_BOOLEAN 0 SWC_INP_type_CM_boolean_flg 0.0 1.0 /end CHARACTERISTIC
/begin CHARACTERISTIC KINP_SeatSW_flg_ovrdflg "" VALUE 0x0000 /* @ECU_Address@KINP_SeatSW_flg_ovrdflg@ */ Scalar_BOOLEAN 0 SWC_INP_type_CM_boolean_flg 0.0 1.0 /end CHARACTERISTIC
/begin CHARACTERISTIC KINP_SeatSW_flg_ovrdval "" VALUE 0x0000 /* @ECU_Address@KINP_SeatSW_flg_ovrdval@ */ Scalar_BOOLEAN 0 SWC_INP_type_CM_boolean_flg 0.0 1.0 /end CHARACTERISTIC
/begin CHARACTERISTIC KINP_SeatSW_flg_srvcflg "" VALUE 0x0000 /* @ECU_Address@KINP_SeatSW_flg_srvcflg@ */ Scalar_BOOLEAN 0 SWC_INP_type_CM_boolean_flg 0.0 1.0 /end CHARACTERISTIC
/begin CHARACTERISTIC KINP_SeatSW_flg_srvcval "" VALUE 0x0000 /* @ECU_Address@KINP_SeatSW_flg_srvcval@ */ Scalar_BOOLEAN 0 SWC_INP_type_CM_boolean_flg 0.0 1.0 /end CHARACTERISTIC
/begin CHARACTERISTIC KINP_TLHPsngrSeatBeltCmd_flg_defval "" VALUE 0x0000 /* @ECU_Address@KINP_TLHPsngrSeatBeltCmd_flg_defval@ */ Scalar_BOOLEAN 0 SWC_INP_type_CM_boolean_flg 0.0 1.0 /end CHARACTERISTIC
/begin CHARACTERISTIC KINP_TLHPsngrSeatBeltCmd_flg_ovrdflg "" VALUE 0x0000 /* @ECU_Address@KINP_TLHPsngrSeatBeltCmd_flg_ovrdflg@ */ Scalar_BOOLEAN 0 SWC_INP_type_CM_boolean_flg 0.0 1.0 /end CHARACTERISTIC
/begin CHARACTERISTIC KINP_TLHPsngrSeatBeltCmd_flg_ovrdval "" VALUE 0x0000 /* @ECU_Address@KINP_TLHPsngrSeatBeltCmd_flg_ovrdval@ */ Scalar_BOOLEAN 0 SWC_INP_type_CM_boolean_flg 0.0 1.0 /end CHARACTERISTIC
/begin CHARACTERISTIC KINP_TPMSBattLow_flg_ovrdval "" VALUE 0x0000 /* @ECU_Address@KINP_TPMSBattLow_flg_ovrdval@ */ Scalar_BOOLEAN 0 SWC_INP_type_CM_boolean_flg 0.0 1.0 /end CHARACTERISTIC
/begin CHARACTERISTIC KINP_TPMSBattLow_flg_ovrflg "" VALUE 0x0000 /* @ECU_Address@KINP_TPMSBattLow_flg_ovrflg@ */ Scalar_BOOLEAN 0 SWC_INP_type_CM_boolean_flg 0.0 1.0 /end CHARACTERISTIC
/begin CHARACTERISTIC KINP_TPMSCRCCalc_crc_ovrdflg "" VALUE 0x0000 /* @ECU_Address@KINP_TPMSCRCCalc_crc_ovrdflg@ */ Scalar_BOOLEAN 0 SWC_INP_type_CM_boolean_flg 0.0 1.0 /end CHARACTERISTIC
/begin CHARACTERISTIC KINP_TPMSCRC_crc_ovrdflg "" VALUE 0x0000 /* @ECU_Address@KINP_TPMSCRC_crc_ovrdflg@ */ Scalar_BOOLEAN 0 SWC_INP_type_CM_boolean_flg 0.0 1.0 /end CHARACTERISTIC
/begin CHARACTERISTIC KINP_TPMSDataIn_flg_ovrdflg "" VALUE 0x0000 /* @ECU_Address@KINP_TPMSDataIn_flg_ovrdflg@ */ Scalar_BOOLEAN 0 SWC_INP_type_CM_boolean_flg 0.0 1.0 /end CHARACTERISTIC
/begin CHARACTERISTIC KINP_TPMSDataIn_flg_ovrdval "" VALUE 0x0000 /* @ECU_Address@KINP_TPMSDataIn_flg_ovrdval@ */ Scalar_BOOLEAN 0 SWC_INP_type_CM_boolean_flg 0.0 1.0 /end CHARACTERISTIC
/begin CHARACTERISTIC KINP_TPMSFAT_flg_ovrdval "" VALUE 0x0000 /* @ECU_Address@KINP_TPMSFAT_flg_ovrdval@ */ Scalar_BOOLEAN 0 SWC_INP_type_CM_boolean_flg 0.0 1.0 /end CHARACTERISTIC
/begin CHARACTERISTIC KINP_TPMSFAT_flg_ovrflg "" VALUE 0x0000 /* @ECU_Address@KINP_TPMSFAT_flg_ovrflg@ */ Scalar_BOOLEAN 0 SWC_INP_type_CM_boolean_flg 0.0 1.0 /end CHARACTERISTIC
/begin CHARACTERISTIC KINP_TPMSID_raw_ovrdflg "" VALUE 0x0000 /* @ECU_Address@KINP_TPMSID_raw_ovrdflg@ */ Scalar_BOOLEAN 0 SWC_INP_type_CM_boolean_flg 0.0 1.0 /end CHARACTERISTIC
/begin CHARACTERISTIC KINP_TPMSPressureMi_raw_ovrdflg "" VALUE 0x0000 /* @ECU_Address@KINP_TPMSPressureMi_raw_ovrdflg@ */ Scalar_BOOLEAN 0 SWC_INP_type_CM_boolean_flg 0.0 1.0 /end CHARACTERISTIC
/begin CHARACTERISTIC KINP_TPMSSta_enum_ovrdflg "" VALUE 0x0000 /* @ECU_Address@KINP_TPMSSta_enum_ovrdflg@ */ Scalar_BOOLEAN 0 SWC_INP_type_CM_boolean_flg 0.0 1.0 /end CHARACTERISTIC
/begin CHARACTERISTIC KINP_TPMSStorge_flg_ovrdval "" VALUE 0x0000 /* @ECU_Address@KINP_TPMSStorge_flg_ovrdval@ */ Scalar_BOOLEAN 0 SWC_INP_type_CM_boolean_flg 0.0 1.0 /end CHARACTERISTIC
/begin CHARACTERISTIC KINP_TPMSStorge_flg_ovrflg "" VALUE 0x0000 /* @ECU_Address@KINP_TPMSStorge_flg_ovrflg@ */ Scalar_BOOLEAN 0 SWC_INP_type_CM_boolean_flg 0.0 1.0 /end CHARACTERISTIC
/begin CHARACTERISTIC KINP_TPMSTemp_raw_ovrdflg "" VALUE 0x0000 /* @ECU_Address@KINP_TPMSTemp_raw_ovrdflg@ */ Scalar_BOOLEAN 0 SWC_INP_type_CM_boolean_flg 0.0 1.0 /end CHARACTERISTIC
/begin CHARACTERISTIC KINP_TRHPsngrSeatBeltCmd_flg_defval "" VALUE 0x0000 /* @ECU_Address@KINP_TRHPsngrSeatBeltCmd_flg_defval@ */ Scalar_BOOLEAN 0 SWC_INP_type_CM_boolean_flg 0.0 1.0 /end CHARACTERISTIC
/begin CHARACTERISTIC KINP_TRHPsngrSeatBeltCmd_flg_ovrdflg "" VALUE 0x0000 /* @ECU_Address@KINP_TRHPsngrSeatBeltCmd_flg_ovrdflg@ */ Scalar_BOOLEAN 0 SWC_INP_type_CM_boolean_flg 0.0 1.0 /end CHARACTERISTIC
/begin CHARACTERISTIC KINP_TRHPsngrSeatBeltCmd_flg_ovrdval "" VALUE 0x0000 /* @ECU_Address@KINP_TRHPsngrSeatBeltCmd_flg_ovrdval@ */ Scalar_BOOLEAN 0 SWC_INP_type_CM_boolean_flg 0.0 1.0 /end CHARACTERISTIC
/begin CHARACTERISTIC KINP_TailgateSW_flg_inverse "" VALUE 0x0000 /* @ECU_Address@KINP_TailgateSW_flg_inverse@ */ Scalar_BOOLEAN 0 SWC_INP_type_CM_boolean_flg 0.0 1.0 /end CHARACTERISTIC
/begin CHARACTERISTIC KINP_TailgateSW_flg_ovrdflg "" VALUE 0x0000 /* @ECU_Address@KINP_TailgateSW_flg_ovrdflg@ */ Scalar_BOOLEAN 0 SWC_INP_type_CM_boolean_flg 0.0 1.0 /end CHARACTERISTIC
/begin CHARACTERISTIC KINP_TailgateSW_flg_ovrdval "" VALUE 0x0000 /* @ECU_Address@KINP_TailgateSW_flg_ovrdval@ */ Scalar_BOOLEAN 0 SWC_INP_type_CM_boolean_flg 0.0 1.0 /end CHARACTERISTIC
/begin CHARACTERISTIC KINP_TailgateSW_flg_srvcflg "" VALUE 0x0000 /* @ECU_Address@KINP_TailgateSW_flg_srvcflg@ */ Scalar_BOOLEAN 0 SWC_INP_type_CM_boolean_flg 0.0 1.0 /end CHARACTERISTIC
/begin CHARACTERISTIC KINP_TailgateSW_flg_srvcval "" VALUE 0x0000 /* @ECU_Address@KINP_TailgateSW_flg_srvcval@ */ Scalar_BOOLEAN 0 SWC_INP_type_CM_boolean_flg 0.0 1.0 /end CHARACTERISTIC
/begin CHARACTERISTIC KINP_TrunkHanSW_flg_inverse "" VALUE 0x0000 /* @ECU_Address@KINP_TrunkHanSW_flg_inverse@ */ Scalar_BOOLEAN 0 SWC_INP_type_CM_boolean_flg 0.0 1.0 /end CHARACTERISTIC
/begin CHARACTERISTIC KINP_TrunkHanSW_flg_ovrdflg "" VALUE 0x0000 /* @ECU_Address@KINP_TrunkHanSW_flg_ovrdflg@ */ Scalar_BOOLEAN 0 SWC_INP_type_CM_boolean_flg 0.0 1.0 /end CHARACTERISTIC
/begin CHARACTERISTIC KINP_TrunkHanSW_flg_ovrdval "" VALUE 0x0000 /* @ECU_Address@KINP_TrunkHanSW_flg_ovrdval@ */ Scalar_BOOLEAN 0 SWC_INP_type_CM_boolean_flg 0.0 1.0 /end CHARACTERISTIC
/begin CHARACTERISTIC KINP_TrunkHanSW_flg_srvcflg "" VALUE 0x0000 /* @ECU_Address@KINP_TrunkHanSW_flg_srvcflg@ */ Scalar_BOOLEAN 0 SWC_INP_type_CM_boolean_flg 0.0 1.0 /end CHARACTERISTIC
/begin CHARACTERISTIC KINP_TrunkHanSW_flg_srvcval "" VALUE 0x0000 /* @ECU_Address@KINP_TrunkHanSW_flg_srvcval@ */ Scalar_BOOLEAN 0 SWC_INP_type_CM_boolean_flg 0.0 1.0 /end CHARACTERISTIC
/begin CHARACTERISTIC KINP_AccelPedal1Vol_V_fftdec "" VALUE 0x0000 /* @ECU_Address@KINP_AccelPedal1Vol_V_fftdec@ */ Scalar_UBYTE 0 SWC_INP_type_CM_uint8_cnt 0.0 255.0 /end CHARACTERISTIC
/begin CHARACTERISTIC KINP_AccelPedal1Vol_V_fftinc "" VALUE 0x0000 /* @ECU_Address@KINP_AccelPedal1Vol_V_fftinc@ */ Scalar_UBYTE 0 SWC_INP_type_CM_uint8_cnt 0.0 255.0 /end CHARACTERISTIC
/begin CHARACTERISTIC KINP_AccelPedal1Vol_V_fftlim "" VALUE 0x0000 /* @ECU_Address@KINP_AccelPedal1Vol_V_fftlim@ */ Scalar_UBYTE 0 SWC_INP_type_CM_uint8_cnt 0.0 255.0 /end CHARACTERISTIC
/begin CHARACTERISTIC KINP_AccelPedal2Vol_V_fftdec "" VALUE 0x0000 /* @ECU_Address@KINP_AccelPedal2Vol_V_fftdec@ */ Scalar_UBYTE 0 SWC_INP_type_CM_uint8_cnt 0.0 255.0 /end CHARACTERISTIC
/begin CHARACTERISTIC KINP_AccelPedal2Vol_V_fftinc "" VALUE 0x0000 /* @ECU_Address@KINP_AccelPedal2Vol_V_fftinc@ */ Scalar_UBYTE 0 SWC_INP_type_CM_uint8_cnt 0.0 255.0 /end CHARACTERISTIC
/begin CHARACTERISTIC KINP_AccelPedal2Vol_V_fftlim "" VALUE 0x0000 /* @ECU_Address@KINP_AccelPedal2Vol_V_fftlim@ */ Scalar_UBYTE 0 SWC_INP_type_CM_uint8_cnt 0.0 255.0 /end CHARACTERISTIC
/begin CHARACTERISTIC KINP_AllowMovThd_OTA_enum_ovrdflg "" VALUE 0x0000 /* @ECU_Address@KINP_AllowMovThd_OTA_enum_ovrdflg@ */ Scalar_UBYTE 0 SWC_INP_type_CM_uint8_flg 0.0 1.0 /end CHARACTERISTIC
/begin CHARACTERISTIC KINP_AllowMovThd_OTA_enum_ovrdval "" VALUE 0x0000 /* @ECU_Address@KINP_AllowMovThd_OTA_enum_ovrdval@ */ Scalar_UBYTE 0 SWC_INP_type_CM_uint8_enum 0.0 255.0 /end CHARACTERISTIC
/begin CHARACTERISTIC KINP_BrakeLampSW_flg_debdec "" VALUE 0x0000 /* @ECU_Address@KINP_BrakeLampSW_flg_debdec@ */ Scalar_UBYTE 0 SWC_INP_type_CM_uint8_cnt 0.0 255.0 /end CHARACTERISTIC
/begin CHARACTERISTIC KINP_BrakeLampSW_flg_debinc "" VALUE 0x0000 /* @ECU_Address@KINP_BrakeLampSW_flg_debinc@ */ Scalar_UBYTE 0 SWC_INP_type_CM_uint8_cnt 0.0 255.0 /end CHARACTERISTIC
/begin CHARACTERISTIC KINP_BrakeLampSW_flg_deblim "" VALUE 0x0000 /* @ECU_Address@KINP_BrakeLampSW_flg_deblim@ */ Scalar_UBYTE 0 SWC_INP_type_CM_uint8_cnt 0.0 255.0 /end CHARACTERISTIC
/begin CHARACTERISTIC KINP_BrakeSWGPIO_flg_debdec "" VALUE 0x0000 /* @ECU_Address@KINP_BrakeSWGPIO_flg_debdec@ */ Scalar_UBYTE 0 SWC_INP_type_CM_uint8_cnt 0.0 255.0 /end CHARACTERISTIC
/begin CHARACTERISTIC KINP_BrakeSWGPIO_flg_debinc "" VALUE 0x0000 /* @ECU_Address@KINP_BrakeSWGPIO_flg_debinc@ */ Scalar_UBYTE 0 SWC_INP_type_CM_uint8_cnt 0.0 255.0 /end CHARACTERISTIC
/begin CHARACTERISTIC KINP_BrakeSWGPIO_flg_deblim "" VALUE 0x0000 /* @ECU_Address@KINP_BrakeSWGPIO_flg_deblim@ */ Scalar_UBYTE 0 SWC_INP_type_CM_uint8_cnt 0.0 255.0 /end CHARACTERISTIC
/begin CHARACTERISTIC KINP_CentralDoorLockSW_flg_debdec "" VALUE 0x0000 /* @ECU_Address@KINP_CentralDoorLockSW_flg_debdec@ */ Scalar_UBYTE 0 SWC_INP_type_CM_uint8_cnt 0.0 255.0 /end CHARACTERISTIC
/begin CHARACTERISTIC KINP_CentralDoorLockSW_flg_debinc "" VALUE 0x0000 /* @ECU_Address@KINP_CentralDoorLockSW_flg_debinc@ */ Scalar_UBYTE 0 SWC_INP_type_CM_uint8_cnt 0.0 255.0 /end CHARACTERISTIC
/begin CHARACTERISTIC KINP_CentralDoorLockSW_flg_deblim "" VALUE 0x0000 /* @ECU_Address@KINP_CentralDoorLockSW_flg_deblim@ */ Scalar_UBYTE 0 SWC_INP_type_CM_uint8_cnt 0.0 255.0 /end CHARACTERISTIC
/begin CHARACTERISTIC KINP_ChecksumABM1_enum_defval "" VALUE 0x0000 /* @ECU_Address@KINP_ChecksumABM1_enum_defval@ */ Scalar_UBYTE 0 SWC_INP_type_CM_uint8_enum 0.0 255.0 /end CHARACTERISTIC
/begin CHARACTERISTIC KINP_ChecksumABM1_enum_ovrdval "" VALUE 0x0000 /* @ECU_Address@KINP_ChecksumABM1_enum_ovrdval@ */ Scalar_UBYTE 0 SWC_INP_type_CM_uint8_enum 0.0 255.0 /end CHARACTERISTIC
/begin CHARACTERISTIC KINP_CrashOutputSts_enum_defval "" VALUE 0x0000 /* @ECU_Address@KINP_CrashOutputSts_enum_defval@ */ Scalar_UBYTE 0 SWC_INP_type_CM_uint8_enum 0.0 255.0 /end CHARACTERISTIC
/begin CHARACTERISTIC KINP_CrashOutputSts_enum_ovrdval "" VALUE 0x0000 /* @ECU_Address@KINP_CrashOutputSts_enum_ovrdval@ */ Scalar_UBYTE 0 SWC_INP_type_CM_uint8_enum 0.0 255.0 /end CHARACTERISTIC
/begin CHARACTERISTIC KINP_CrashSignalGPIO_flg_debdec "" VALUE 0x0000 /* @ECU_Address@KINP_CrashSignalGPIO_flg_debdec@ */ Scalar_UBYTE 0 SWC_INP_type_CM_uint8_cnt 0.0 255.0 /end CHARACTERISTIC
/begin CHARACTERISTIC KINP_CrashSignalGPIO_flg_debinc "" VALUE 0x0000 /* @ECU_Address@KINP_CrashSignalGPIO_flg_debinc@ */ Scalar_UBYTE 0 SWC_INP_type_CM_uint8_cnt 0.0 255.0 /end CHARACTERISTIC
/begin CHARACTERISTIC KINP_CrashSignalGPIO_flg_deblim "" VALUE 0x0000 /* @ECU_Address@KINP_CrashSignalGPIO_flg_deblim@ */ Scalar_UBYTE 0 SWC_INP_type_CM_uint8_cnt 0.0 255.0 /end CHARACTERISTIC
/begin CHARACTERISTIC KINP_DrDoorSW_flg_debdec "" VALUE 0x0000 /* @ECU_Address@KINP_DrDoorSW_flg_debdec@ */ Scalar_UBYTE 0 SWC_INP_type_CM_uint8_cnt 0.0 255.0 /end CHARACTERISTIC
/begin CHARACTERISTIC KINP_DrDoorSW_flg_debinc "" VALUE 0x0000 /* @ECU_Address@KINP_DrDoorSW_flg_debinc@ */ Scalar_UBYTE 0 SWC_INP_type_CM_uint8_cnt 0.0 255.0 /end CHARACTERISTIC
/begin CHARACTERISTIC KINP_DrDoorSW_flg_deblim "" VALUE 0x0000 /* @ECU_Address@KINP_DrDoorSW_flg_deblim@ */ Scalar_UBYTE 0 SWC_INP_type_CM_uint8_cnt 0.0 255.0 /end CHARACTERISTIC
/begin CHARACTERISTIC KINP_DriIntend_enum_defval "" VALUE 0x0000 /* @ECU_Address@KINP_DriIntend_enum_defval@ */ Scalar_UBYTE 0 SWC_INP_type_CM_uint8_enum 0.0 2.0 /end CHARACTERISTIC
/begin CHARACTERISTIC KINP_DriIntend_enum_ovrdval "" VALUE 0x0000 /* @ECU_Address@KINP_DriIntend_enum_ovrdval@ */ Scalar_UBYTE 0 SWC_INP_type_CM_uint8_enum 0.0 2.0 /end CHARACTERISTIC
/begin CHARACTERISTIC KINP_EPB1RC_enum_defval "" VALUE 0x0000 /* @ECU_Address@KINP_EPB1RC_enum_defval@ */ Scalar_UBYTE 0 SWC_INP_type_CM_uint8_enum 0.0 14.0 /end CHARACTERISTIC
/begin CHARACTERISTIC KINP_EPB1RC_enum_ovrdval "" VALUE 0x0000 /* @ECU_Address@KINP_EPB1RC_enum_ovrdval@ */ Scalar_UBYTE 0 SWC_INP_type_CM_uint8_enum 0.0 14.0 /end CHARACTERISTIC
/begin CHARACTERISTIC KINP_EPBErrSta_enum_defval "" VALUE 0x0000 /* @ECU_Address@KINP_EPBErrSta_enum_defval@ */ Scalar_UBYTE 0 SWC_INP_type_CM_uint8_enum 0.0 2.0 /end CHARACTERISTIC
/begin CHARACTERISTIC KINP_EPBErrSta_enum_ovrdval "" VALUE 0x0000 /* @ECU_Address@KINP_EPBErrSta_enum_ovrdval@ */ Scalar_UBYTE 0 SWC_INP_type_CM_uint8_enum 0.0 2.0 /end CHARACTERISTIC
/begin CHARACTERISTIC KINP_EPBSta_enum_defval "" VALUE 0x0000 /* @ECU_Address@KINP_EPBSta_enum_defval@ */ Scalar_UBYTE 0 SWC_INP_type_CM_uint8_enum 0.0 4.0 /end CHARACTERISTIC
/begin CHARACTERISTIC KINP_EPBSta_enum_ovrdval "" VALUE 0x0000 /* @ECU_Address@KINP_EPBSta_enum_ovrdval@ */ Scalar_UBYTE 0 SWC_INP_type_CM_uint8_enum 0.0 4.0 /end CHARACTERISTIC
/begin CHARACTERISTIC KINP_EPSAOIControl_enum_defval "" VALUE 0x0000 /* @ECU_Address@KINP_EPSAOIControl_enum_defval@ */ Scalar_UBYTE 0 SWC_INP_type_CM_uint8_enum 0.0 3.0 /end CHARACTERISTIC
/begin CHARACTERISTIC KINP_EPSAOIControl_enum_ovrdval "" VALUE 0x0000 /* @ECU_Address@KINP_EPSAOIControl_enum_ovrdval@ */ Scalar_UBYTE 0 SWC_INP_type_CM_uint8_enum 0.0 3.0 /end CHARACTERISTIC
/begin CHARACTERISTIC KINP_EPSRC_enum_defval "" VALUE 0x0000 /* @ECU_Address@KINP_EPSRC_enum_defval@ */ Scalar_UBYTE 0 SWC_INP_type_CM_uint8_enum 0.0 14.0 /end CHARACTERISTIC
/begin CHARACTERISTIC KINP_EPSRC_enum_ovrdval "" VALUE 0x0000 /* @ECU_Address@KINP_EPSRC_enum_ovrdval@ */ Scalar_UBYTE 0 SWC_INP_type_CM_uint8_enum 0.0 14.0 /end CHARACTERISTIC
/begin CHARACTERISTIC KINP_ESC1CS_enum_defval "" VALUE 0x0000 /* @ECU_Address@KINP_ESC1CS_enum_defval@ */ Scalar_UBYTE 0 SWC_INP_type_CM_uint8_enum 0.0 255.0 /end CHARACTERISTIC
/begin CHARACTERISTIC KINP_ESC1CS_enum_ovrdval "" VALUE 0x0000 /* @ECU_Address@KINP_ESC1CS_enum_ovrdval@ */ Scalar_UBYTE 0 SWC_INP_type_CM_uint8_enum 0.0 255.0 /end CHARACTERISTIC
/begin CHARACTERISTIC KINP_ESC1RC_enum_defval "" VALUE 0x0000 /* @ECU_Address@KINP_ESC1RC_enum_defval@ */ Scalar_UBYTE 0 SWC_INP_type_CM_uint8_enum 0.0 14.0 /end CHARACTERISTIC
/begin CHARACTERISTIC KINP_ESC1RC_enum_ovrdval "" VALUE 0x0000 /* @ECU_Address@KINP_ESC1RC_enum_ovrdval@ */ Scalar_UBYTE 0 SWC_INP_type_CM_uint8_enum 0.0 14.0 /end CHARACTERISTIC
/begin CHARACTERISTIC KINP_ESCOFFStatus_enum_defval "" VALUE 0x0000 /* @ECU_Address@KINP_ESCOFFStatus_enum_defval@ */ Scalar_UBYTE 0 SWC_INP_type_CM_uint8_enum 0.0 2.0 /end CHARACTERISTIC
/begin CHARACTERISTIC KINP_ESCOFFStatus_enum_ovrdval "" VALUE 0x0000 /* @ECU_Address@KINP_ESCOFFStatus_enum_ovrdval@ */ Scalar_UBYTE 0 SWC_INP_type_CM_uint8_enum 0.0 2.0 /end CHARACTERISTIC
/begin CHARACTERISTIC KINP_ESCWnlmpSta_enum_defval "" VALUE 0x0000 /* @ECU_Address@KINP_ESCWnlmpSta_enum_defval@ */ Scalar_UBYTE 0 SWC_INP_type_CM_uint8_enum 0.0 2.0 /end CHARACTERISTIC
/begin CHARACTERISTIC KINP_ESCWnlmpSta_enum_ovrdval "" VALUE 0x0000 /* @ECU_Address@KINP_ESCWnlmpSta_enum_ovrdval@ */ Scalar_UBYTE 0 SWC_INP_type_CM_uint8_enum 0.0 2.0 /end CHARACTERISTIC
/begin CHARACTERISTIC KINP_EpasFailed_enum_defval "" VALUE 0x0000 /* @ECU_Address@KINP_EpasFailed_enum_defval@ */ Scalar_UBYTE 0 SWC_INP_type_CM_uint8_enum 0.0 2.0 /end CHARACTERISTIC
/begin CHARACTERISTIC KINP_EpasFailed_enum_ovrdval "" VALUE 0x0000 /* @ECU_Address@KINP_EpasFailed_enum_ovrdval@ */ Scalar_UBYTE 0 SWC_INP_type_CM_uint8_enum 0.0 2.0 /end CHARACTERISTIC
/begin CHARACTERISTIC KINP_HazardSW_flg_debdec "" VALUE 0x0000 /* @ECU_Address@KINP_HazardSW_flg_debdec@ */ Scalar_UBYTE 0 SWC_INP_type_CM_uint8_cnt 0.0 255.0 /end CHARACTERISTIC
/begin CHARACTERISTIC KINP_HazardSW_flg_debinc "" VALUE 0x0000 /* @ECU_Address@KINP_HazardSW_flg_debinc@ */ Scalar_UBYTE 0 SWC_INP_type_CM_uint8_cnt 0.0 255.0 /end CHARACTERISTIC
/begin CHARACTERISTIC KINP_HazardSW_flg_deblim "" VALUE 0x0000 /* @ECU_Address@KINP_HazardSW_flg_deblim@ */ Scalar_UBYTE 0 SWC_INP_type_CM_uint8_cnt 0.0 255.0 /end CHARACTERISTIC
/begin CHARACTERISTIC KINP_HoodSW_flg_debdec "" VALUE 0x0000 /* @ECU_Address@KINP_HoodSW_flg_debdec@ */ Scalar_UBYTE 0 SWC_INP_type_CM_uint8_cnt 0.0 255.0 /end CHARACTERISTIC
/begin CHARACTERISTIC KINP_HoodSW_flg_debinc "" VALUE 0x0000 /* @ECU_Address@KINP_HoodSW_flg_debinc@ */ Scalar_UBYTE 0 SWC_INP_type_CM_uint8_cnt 0.0 255.0 /end CHARACTERISTIC
/begin CHARACTERISTIC KINP_HoodSW_flg_deblim "" VALUE 0x0000 /* @ECU_Address@KINP_HoodSW_flg_deblim@ */ Scalar_UBYTE 0 SWC_INP_type_CM_uint8_cnt 0.0 255.0 /end CHARACTERISTIC
/begin CHARACTERISTIC KINP_LFPulseCount_enum_defval "" VALUE 0x0000 /* @ECU_Address@KINP_LFPulseCount_enum_defval@ */ Scalar_UBYTE 0 SWC_INP_type_CM_uint8_enum 0.0 255.0 /end CHARACTERISTIC
/begin CHARACTERISTIC KINP_LFPulseCount_enum_ovrdval "" VALUE 0x0000 /* @ECU_Address@KINP_LFPulseCount_enum_ovrdval@ */ Scalar_UBYTE 0 SWC_INP_type_CM_uint8_enum 0.0 255.0 /end CHARACTERISTIC
/begin CHARACTERISTIC KINP_LFWhlRotDir_enum_defval "" VALUE 0x0000 /* @ECU_Address@KINP_LFWhlRotDir_enum_defval@ */ Scalar_UBYTE 0 SWC_INP_type_CM_uint8_enum 0.0 3.0 /end CHARACTERISTIC
/begin CHARACTERISTIC KINP_LFWhlRotDir_enum_ovrdval "" VALUE 0x0000 /* @ECU_Address@KINP_LFWhlRotDir_enum_ovrdval@ */ Scalar_UBYTE 0 SWC_INP_type_CM_uint8_enum 0.0 3.0 /end CHARACTERISTIC
/begin CHARACTERISTIC KINP_LRPulseCount_enum_defval "" VALUE 0x0000 /* @ECU_Address@KINP_LRPulseCount_enum_defval@ */ Scalar_UBYTE 0 SWC_INP_type_CM_uint8_enum 0.0 255.0 /end CHARACTERISTIC
/begin CHARACTERISTIC KINP_LRPulseCount_enum_ovrdval "" VALUE 0x0000 /* @ECU_Address@KINP_LRPulseCount_enum_ovrdval@ */ Scalar_UBYTE 0 SWC_INP_type_CM_uint8_enum 0.0 255.0 /end CHARACTERISTIC
/begin CHARACTERISTIC KINP_LRWhlRotDir_enum_defval "" VALUE 0x0000 /* @ECU_Address@KINP_LRWhlRotDir_enum_defval@ */ Scalar_UBYTE 0 SWC_INP_type_CM_uint8_enum 0.0 3.0 /end CHARACTERISTIC
/begin CHARACTERISTIC KINP_LRWhlRotDir_enum_ovrdval "" VALUE 0x0000 /* @ECU_Address@KINP_LRWhlRotDir_enum_ovrdval@ */ Scalar_UBYTE 0 SWC_INP_type_CM_uint8_enum 0.0 3.0 /end CHARACTERISTIC
/begin CHARACTERISTIC KINP_LifeCountABM1_enum_defval "" VALUE 0x0000 /* @ECU_Address@KINP_LifeCountABM1_enum_defval@ */ Scalar_UBYTE 0 SWC_INP_type_CM_uint8_enum 0.0 14.0 /end CHARACTERISTIC
/begin CHARACTERISTIC KINP_LifeCountABM1_enum_ovrdval "" VALUE 0x0000 /* @ECU_Address@KINP_LifeCountABM1_enum_ovrdval@ */ Scalar_UBYTE 0 SWC_INP_type_CM_uint8_enum 0.0 14.0 /end CHARACTERISTIC
/begin CHARACTERISTIC KINP_PsDoorSW_flg_debdec "" VALUE 0x0000 /* @ECU_Address@KINP_PsDoorSW_flg_debdec@ */ Scalar_UBYTE 0 SWC_INP_type_CM_uint8_cnt 0.0 255.0 /end CHARACTERISTIC
/begin CHARACTERISTIC KINP_PsDoorSW_flg_debinc "" VALUE 0x0000 /* @ECU_Address@KINP_PsDoorSW_flg_debinc@ */ Scalar_UBYTE 0 SWC_INP_type_CM_uint8_cnt 0.0 255.0 /end CHARACTERISTIC
/begin CHARACTERISTIC KINP_PsDoorSW_flg_deblim "" VALUE 0x0000 /* @ECU_Address@KINP_PsDoorSW_flg_deblim@ */ Scalar_UBYTE 0 SWC_INP_type_CM_uint8_cnt 0.0 255.0 /end CHARACTERISTIC
/begin CHARACTERISTIC KINP_PwrReq_OTA_enum_ovrdflg "" VALUE 0x0000 /* @ECU_Address@KINP_PwrReq_OTA_enum_ovrdflg@ */ Scalar_UBYTE 0 SWC_INP_type_CM_uint8_flg 0.0 1.0 /end CHARACTERISTIC
/begin CHARACTERISTIC KINP_PwrReq_OTA_enum_ovrdval "" VALUE 0x0000 /* @ECU_Address@KINP_PwrReq_OTA_enum_ovrdval@ */ Scalar_UBYTE 0 SWC_INP_type_CM_uint8_enum 0.0 255.0 /end CHARACTERISTIC
/begin CHARACTERISTIC KINP_RFPulseCount_enum_defval "" VALUE 0x0000 /* @ECU_Address@KINP_RFPulseCount_enum_defval@ */ Scalar_UBYTE 0 SWC_INP_type_CM_uint8_enum 0.0 255.0 /end CHARACTERISTIC
/begin CHARACTERISTIC KINP_RFPulseCount_enum_ovrdval "" VALUE 0x0000 /* @ECU_Address@KINP_RFPulseCount_enum_ovrdval@ */ Scalar_UBYTE 0 SWC_INP_type_CM_uint8_enum 0.0 255.0 /end CHARACTERISTIC
/begin CHARACTERISTIC KINP_RFWhlRotDir_enum_defval "" VALUE 0x0000 /* @ECU_Address@KINP_RFWhlRotDir_enum_defval@ */ Scalar_UBYTE 0 SWC_INP_type_CM_uint8_enum 0.0 3.0 /end CHARACTERISTIC
/begin CHARACTERISTIC KINP_RFWhlRotDir_enum_ovrdval "" VALUE 0x0000 /* @ECU_Address@KINP_RFWhlRotDir_enum_ovrdval@ */ Scalar_UBYTE 0 SWC_INP_type_CM_uint8_enum 0.0 3.0 /end CHARACTERISTIC
/begin CHARACTERISTIC KINP_RLDoorSW_flg_debdec "" VALUE 0x0000 /* @ECU_Address@KINP_RLDoorSW_flg_debdec@ */ Scalar_UBYTE 0 SWC_INP_type_CM_uint8_cnt 0.0 255.0 /end CHARACTERISTIC
/begin CHARACTERISTIC KINP_RLDoorSW_flg_debinc "" VALUE 0x0000 /* @ECU_Address@KINP_RLDoorSW_flg_debinc@ */ Scalar_UBYTE 0 SWC_INP_type_CM_uint8_cnt 0.0 255.0 /end CHARACTERISTIC
/begin CHARACTERISTIC KINP_RLDoorSW_flg_deblim "" VALUE 0x0000 /* @ECU_Address@KINP_RLDoorSW_flg_deblim@ */ Scalar_UBYTE 0 SWC_INP_type_CM_uint8_cnt 0.0 255.0 /end CHARACTERISTIC
/begin CHARACTERISTIC KINP_RRDoorSW_flg_debdec "" VALUE 0x0000 /* @ECU_Address@KINP_RRDoorSW_flg_debdec@ */ Scalar_UBYTE 0 SWC_INP_type_CM_uint8_cnt 0.0 255.0 /end CHARACTERISTIC
/begin CHARACTERISTIC KINP_RRDoorSW_flg_debinc "" VALUE 0x0000 /* @ECU_Address@KINP_RRDoorSW_flg_debinc@ */ Scalar_UBYTE 0 SWC_INP_type_CM_uint8_cnt 0.0 255.0 /end CHARACTERISTIC
/begin CHARACTERISTIC KINP_RRDoorSW_flg_deblim "" VALUE 0x0000 /* @ECU_Address@KINP_RRDoorSW_flg_deblim@ */ Scalar_UBYTE 0 SWC_INP_type_CM_uint8_cnt 0.0 255.0 /end CHARACTERISTIC
/begin CHARACTERISTIC KINP_RRPulseCount_enum_defval "" VALUE 0x0000 /* @ECU_Address@KINP_RRPulseCount_enum_defval@ */ Scalar_UBYTE 0 SWC_INP_type_CM_uint8_enum 0.0 255.0 /end CHARACTERISTIC
/begin CHARACTERISTIC KINP_RRPulseCount_enum_ovrdval "" VALUE 0x0000 /* @ECU_Address@KINP_RRPulseCount_enum_ovrdval@ */ Scalar_UBYTE 0 SWC_INP_type_CM_uint8_enum 0.0 255.0 /end CHARACTERISTIC
/begin CHARACTERISTIC KINP_RRWhlRotDir_enum_defval "" VALUE 0x0000 /* @ECU_Address@KINP_RRWhlRotDir_enum_defval@ */ Scalar_UBYTE 0 SWC_INP_type_CM_uint8_enum 0.0 3.0 /end CHARACTERISTIC
/begin CHARACTERISTIC KINP_RRWhlRotDir_enum_ovrdval "" VALUE 0x0000 /* @ECU_Address@KINP_RRWhlRotDir_enum_ovrdval@ */ Scalar_UBYTE 0 SWC_INP_type_CM_uint8_enum 0.0 3.0 /end CHARACTERISTIC
/begin CHARACTERISTIC KINP_SeatSW_flg_debdec "" VALUE 0x0000 /* @ECU_Address@KINP_SeatSW_flg_debdec@ */ Scalar_UBYTE 0 SWC_INP_type_CM_uint8_cnt 0.0 255.0 /end CHARACTERISTIC
/begin CHARACTERISTIC KINP_SeatSW_flg_debinc "" VALUE 0x0000 /* @ECU_Address@KINP_SeatSW_flg_debinc@ */ Scalar_UBYTE 0 SWC_INP_type_CM_uint8_cnt 0.0 255.0 /end CHARACTERISTIC
/begin CHARACTERISTIC KINP_SeatSW_flg_deblim "" VALUE 0x0000 /* @ECU_Address@KINP_SeatSW_flg_deblim@ */ Scalar_UBYTE 0 SWC_INP_type_CM_uint8_cnt 0.0 255.0 /end CHARACTERISTIC
/begin CHARACTERISTIC KINP_TPMSCRCCalc_crc_ovrdval "" VALUE 0x0000 /* @ECU_Address@KINP_TPMSCRCCalc_crc_ovrdval@ */ Scalar_UBYTE 0 SWC_INP_type_CM_uint8_crc 0.0 255.0 /end CHARACTERISTIC
/begin CHARACTERISTIC KINP_TPMSCRC_crc_ovrdval "" VALUE 0x0000 /* @ECU_Address@KINP_TPMSCRC_crc_ovrdval@ */ Scalar_UBYTE 0 SWC_INP_type_CM_uint8_crc 0.0 255.0 /end CHARACTERISTIC
/begin CHARACTERISTIC KINP_TPMSPressureMi_raw_ovrdval "" VALUE 0x0000 /* @ECU_Address@KINP_TPMSPressureMi_raw_ovrdval@ */ Scalar_UBYTE 0 SWC_INP_type_CM_uint8_raw 0.0 255.0 /end CHARACTERISTIC
/begin CHARACTERISTIC KINP_TPMSPressure_raw_ovrdflg "" VALUE 0x0000 /* @ECU_Address@KINP_TPMSPressure_raw_ovrdflg@ */ Scalar_UBYTE 0 SWC_INP_type_CM_uint8_flg 0.0 1.0 /end CHARACTERISTIC
/begin CHARACTERISTIC KINP_TPMSPressure_raw_ovrdval "" VALUE 0x0000 /* @ECU_Address@KINP_TPMSPressure_raw_ovrdval@ */ Scalar_UBYTE 0 SWC_INP_type_CM_uint8_raw 0.0 255.0 /end CHARACTERISTIC
/begin CHARACTERISTIC KINP_TPMSSta_enum_ovrdval "" VALUE 0x0000 /* @ECU_Address@KINP_TPMSSta_enum_ovrdval@ */ Scalar_UBYTE 0 SWC_INP_type_CM_uint8_enum 0.0 255.0 /end CHARACTERISTIC
/begin CHARACTERISTIC KINP_TPMSTemp_raw_ovrdval "" VALUE 0x0000 /* @ECU_Address@KINP_TPMSTemp_raw_ovrdval@ */ Scalar_UBYTE 0 SWC_INP_type_CM_uint8_raw 0.0 255.0 /end CHARACTERISTIC
/begin CHARACTERISTIC KINP_TailgateSW_flg_debdec "" VALUE 0x0000 /* @ECU_Address@KINP_TailgateSW_flg_debdec@ */ Scalar_UBYTE 0 SWC_INP_type_CM_uint8_cnt 0.0 255.0 /end CHARACTERISTIC
/begin CHARACTERISTIC KINP_TailgateSW_flg_debinc "" VALUE 0x0000 /* @ECU_Address@KINP_TailgateSW_flg_debinc@ */ Scalar_UBYTE 0 SWC_INP_type_CM_uint8_cnt 0.0 255.0 /end CHARACTERISTIC
/begin CHARACTERISTIC KINP_TailgateSW_flg_deblim "" VALUE 0x0000 /* @ECU_Address@KINP_TailgateSW_flg_deblim@ */ Scalar_UBYTE 0 SWC_INP_type_CM_uint8_cnt 0.0 255.0 /end CHARACTERISTIC
/begin CHARACTERISTIC KINP_TrunkHanSW_flg_debdec "" VALUE 0x0000 /* @ECU_Address@KINP_TrunkHanSW_flg_debdec@ */ Scalar_UBYTE 0 SWC_INP_type_CM_uint8_cnt 0.0 255.0 /end CHARACTERISTIC
/begin CHARACTERISTIC KINP_TrunkHanSW_flg_debinc "" VALUE 0x0000 /* @ECU_Address@KINP_TrunkHanSW_flg_debinc@ */ Scalar_UBYTE 0 SWC_INP_type_CM_uint8_cnt 0.0 255.0 /end CHARACTERISTIC
/begin CHARACTERISTIC KINP_TrunkHanSW_flg_deblim "" VALUE 0x0000 /* @ECU_Address@KINP_TrunkHanSW_flg_deblim@ */ Scalar_UBYTE 0 SWC_INP_type_CM_uint8_cnt 0.0 255.0 /end CHARACTERISTIC
/begin MEASUREMENT VINP_TPMSID_raw "" ULONG SWC_INP_type_CM_uint32_raw 0 0 0.0 4.294967295E+9 ECU_ADDRESS 0x0000 /* @ECU_Address@VINP_TPMSID_raw@ */ /end MEASUREMENT
/begin MEASUREMENT VINP_LFID_raw "" ULONG SWC_INP_type_CM_uint32_raw 0 0 0.0 4.294967295E+9 ECU_ADDRESS 0x0000 /* @ECU_Address@VINP_LFID_raw@ */ /end MEASUREMENT
/begin MEASUREMENT VINP_RFID_raw "" ULONG SWC_INP_type_CM_uint32_raw 0 0 0.0 4.294967295E+9 ECU_ADDRESS 0x0000 /* @ECU_Address@VINP_RFID_raw@ */ /end MEASUREMENT
/begin MEASUREMENT VINP_LRID_raw "" ULONG SWC_INP_type_CM_uint32_raw 0 0 0.0 4.294967295E+9 ECU_ADDRESS 0x0000 /* @ECU_Address@VINP_LRID_raw@ */ /end MEASUREMENT
/begin MEASUREMENT VINP_RRID_raw "" ULONG SWC_INP_type_CM_uint32_raw 0 0 0.0 4.294967295E+9 ECU_ADDRESS 0x0000 /* @ECU_Address@VINP_RRID_raw@ */ /end MEASUREMENT
/begin MEASUREMENT VINP_PwrReq_OTA_enum "" UBYTE SWC_INP_type_CM_uint8_OTA_enum 0 0 0.0 255.0 ECU_ADDRESS 0x0000 /* @ECU_Address@VINP_PwrReq_OTA_enum@ */ /end MEASUREMENT
/begin MEASUREMENT VINP_AllowMovThd_OTA_enum "" UBYTE SWC_INP_type_CM_uint8_OTA_enum 0 0 0.0 255.0 ECU_ADDRESS 0x0000 /* @ECU_Address@VINP_AllowMovThd_OTA_enum@ */ /end MEASUREMENT
/begin MEASUREMENT VINP_TPMSPressure_raw "" UBYTE SWC_INP_type_CM_uint8_raw 0 0 0.0 255.0 ECU_ADDRESS 0x0000 /* @ECU_Address@VINP_TPMSPressure_raw@ */ /end MEASUREMENT
/begin MEASUREMENT VINP_TPMSTemp_raw "" UBYTE SWC_INP_type_CM_uint8_raw 0 0 0.0 255.0 ECU_ADDRESS 0x0000 /* @ECU_Address@VINP_TPMSTemp_raw@ */ /end MEASUREMENT
/begin MEASUREMENT VINP_TPMSSta_enum "" UBYTE SWC_INP_type_CM_uint8_enum 0 0 0.0 255.0 ECU_ADDRESS 0x0000 /* @ECU_Address@VINP_TPMSSta_enum@ */ /end MEASUREMENT
/begin MEASUREMENT VINP_TPMSPressureMi_raw "" UBYTE SWC_INP_type_CM_uint8_raw 0 0 0.0 255.0 ECU_ADDRESS 0x0000 /* @ECU_Address@VINP_TPMSPressureMi_raw@ */ /end MEASUREMENT
/begin MEASUREMENT VINP_TPMSCRC_crc "" UBYTE SWC_INP_type_CM_uint8_crc 0 0 0.0 255.0 ECU_ADDRESS 0x0000 /* @ECU_Address@VINP_TPMSCRC_crc@ */ /end MEASUREMENT
/begin MEASUREMENT VINP_TPMSCRCCalc_crc "" UBYTE SWC_INP_type_CM_uint8_crc 0 0 0.0 255.0 ECU_ADDRESS 0x0000 /* @ECU_Address@VINP_TPMSCRCCalc_crc@ */ /end MEASUREMENT
/begin MEASUREMENT VINP_AcoreReadyToSlp_flg "" UBYTE SWC_INP_type_CM_boolean_flg 0 0 0.0 1.0 ECU_ADDRESS 0x0000 /* @ECU_Address@VINP_AcoreReadyToSlp_flg@ */ /end MEASUREMENT
/begin MEASUREMENT VINP_EvccAplusPwrUpReq_flg "" UBYTE SWC_INP_type_CM_boolean_flg 0 0 0.0 1.0 ECU_ADDRESS 0x0000 /* @ECU_Address@VINP_EvccAplusPwrUpReq_flg@ */ /end MEASUREMENT
/begin MEASUREMENT VINP_CAN1BusOff_flg "" UBYTE SWC_INP_type_CM_boolean_flg 0 0 0.0 1.0 ECU_ADDRESS 0x0000 /* @ECU_Address@VINP_CAN1BusOff_flg@ */ /end MEASUREMENT
/begin MEASUREMENT VINP_CAN2BusOff_flg "" UBYTE SWC_INP_type_CM_boolean_flg 0 0 0.0 1.0 ECU_ADDRESS 0x0000 /* @ECU_Address@VINP_CAN2BusOff_flg@ */ /end MEASUREMENT
/begin MEASUREMENT VINP_TPMSDataIn_flg "" UBYTE SWC_INP_type_CM_boolean_flg 0 0 0.0 1.0 ECU_ADDRESS 0x0000 /* @ECU_Address@VINP_TPMSDataIn_flg@ */ /end MEASUREMENT
/begin MEASUREMENT VINP_TPMSFAT_flg "" UBYTE SWC_INP_type_CM_boolean_flg 0 0 0.0 1.0 ECU_ADDRESS 0x0000 /* @ECU_Address@VINP_TPMSFAT_flg@ */ /end MEASUREMENT
/begin MEASUREMENT VINP_TPMSBattLow_flg "" UBYTE SWC_INP_type_CM_boolean_flg 0 0 0.0 1.0 ECU_ADDRESS 0x0000 /* @ECU_Address@VINP_TPMSBattLow_flg@ */ /end MEASUREMENT
/begin MEASUREMENT VINP_TPMSStorge_flg "" UBYTE SWC_INP_type_CM_boolean_flg 0 0 0.0 1.0 ECU_ADDRESS 0x0000 /* @ECU_Address@VINP_TPMSStorge_flg@ */ /end MEASUREMENT
/begin COMPU_METHOD SWC_INP_type_CM_single_Deg "Q = V" RAT_FUNC "%8.6" "Deg" COEFFS 0 1 0 0 0 1 /end COMPU_METHOD
/begin COMPU_METHOD SWC_INP_type_CM_single_Nm "Q = V" RAT_FUNC "%8.6" "Nm" COEFFS 0 1 0 0 0 1 /end COMPU_METHOD
/begin COMPU_METHOD SWC_INP_type_CM_single_kph "Q = V" RAT_FUNC "%8.6" "kph" COEFFS 0 1 0 0 0 1 /end COMPU_METHOD
/begin COMPU_METHOD SWC_INP_type_CM_single_V "Q = V" RAT_FUNC "%8.6" "V" COEFFS 0 1 0 0 0 1 /end COMPU_METHOD
/begin COMPU_METHOD SWC_INP_type_CM_single_tc "Q = V" RAT_FUNC "%8.6" "tc" COEFFS 0 1 0 0 0 1 /end COMPU_METHOD
/begin COMPU_METHOD SWC_INP_type_CM_single_degps "Q = V" RAT_FUNC "%8.6" "degps" COEFFS 0 1 0 0 0 1 /end COMPU_METHOD
/begin COMPU_METHOD SWC_INP_type_CM_uint32_raw "Q = V" RAT_FUNC "%10.0" "raw" COEFFS 0 1 0 0 0 1 /end COMPU_METHOD
/begin COMPU_METHOD SWC_INP_type_CM_boolean_flg "Q = V" RAT_FUNC "%1.0" "flg" COEFFS 0 1 0 0 0 1 /end COMPU_METHOD
/begin COMPU_METHOD SWC_INP_type_CM_uint8_enum "Q = V" RAT_FUNC "%3.0" "enum" COEFFS 0 1 0 0 0 1 /end COMPU_METHOD
/begin COMPU_METHOD SWC_INP_type_CM_uint8_cnt "Q = V" RAT_FUNC "%3.0" "cnt" COEFFS 0 1 0 0 0 1 /end COMPU_METHOD
/begin COMPU_METHOD SWC_INP_type_CM_uint8_flg "Q = V" RAT_FUNC "%3.0" "flg" COEFFS 0 1 0 0 0 1 /end COMPU_METHOD
/begin COMPU_METHOD SWC_INP_type_CM_uint8_crc "Q = V" RAT_FUNC "%3.0" "crc" COEFFS 0 1 0 0 0 1 /end COMPU_METHOD
/begin COMPU_METHOD SWC_INP_type_CM_uint8_raw "Q = V" RAT_FUNC "%3.0" "raw" COEFFS 0 1 0 0 0 1 /end COMPU_METHOD
/begin COMPU_METHOD SWC_INP_type_CM_uint8_OTA_enum "Q = V" RAT_FUNC "%3.0" "OTA_enum" COEFFS 0 1 0 0 0 1 /end COMPU_METHOD
/begin GROUP S16_Subsystem4 "SWC_INP_type/run_SWC_INP_5ms_sys/INP/SYS/Subsystem4" /begin REF_CHARACTERISTIC KINP_PwrReq_OTA_enum_ovrdflg KINP_PwrReq_OTA_enum_ovrdval /end REF_CHARACTERISTIC /begin REF_MEASUREMENT VINP_PwrReq_OTA_enum /end REF_MEASUREMENT /end GROUP
/begin GROUP S16_Subsystem5 "SWC_INP_type/run_SWC_INP_5ms_sys/INP/SYS/Subsystem5"
 /begin REF_CHARACTERISTIC KINP_AllowMovThd_OTA_enum_ovrdflg KINP_AllowMovThd_OTA_enum_ovrdval /end REF_CHARACTERISTIC
 /begin REF_MEASUREMENT VINP_AllowMovThd_OTA_enum /end REF_MEASUREMENT
/end GROUP
/begin GROUP S16_Subsystem6 "SWC_INP_type/run_SWC_INP_5ms_sys/INP/SYS/Subsystem6"
 /begin REF_CHARACTERISTIC KINP_EvccAplusPwrUpReq_flg_ovrdflg KINP_EvccAplusPwrUpReq_flg_ovrdval /end REF_CHARACTERISTIC
 /begin REF_MEASUREMENT VINP_EvccAplusPwrUpReq_flg /end REF_MEASUREMENT
/end GROUP
/begin GROUP S16_Subsystem7 "SWC_INP_type/run_SWC_INP_5ms_sys/INP/SYS/Subsystem7"
 /begin REF_CHARACTERISTIC KINP_AcoreReadyToSlp_flg_ovrdflg KINP_AcoreReadyToSlp_flg_ovrdval /end REF_CHARACTERISTIC
 /begin REF_MEASUREMENT VINP_AcoreReadyToSlp_flg /end REF_MEASUREMENT
/end GROUP
/begin GROUP S16_Subsystem8 "SWC_INP_type/run_SWC_INP_5ms_sys/INP/SYS/Subsystem8" /begin REF_CHARACTERISTIC KINP_CAN1BusOff_flg_ovrdflg KINP_CAN1BusOff_flg_ovrdval /end REF_CHARACTERISTIC /begin REF_MEASUREMENT VINP_CAN1BusOff_flg /end REF_MEASUREMENT /end GROUP
/begin GROUP S16_Subsystem9 "SWC_INP_type/run_SWC_INP_5ms_sys/INP/SYS/Subsystem9" /begin REF_CHARACTERISTIC KINP_CAN2BusOff_flg_ovrdflg KINP_CAN2BusOff_flg_ovrdval /end REF_CHARACTERISTIC /begin REF_MEASUREMENT VINP_CAN2BusOff_flg /end REF_MEASUREMENT /end GROUP
/begin GROUP S17_Subsystem "SWC_INP_type/run_SWC_INP_5ms_sys/INP/TPMS/Subsystem" /begin REF_CHARACTERISTIC KINP_TPMSDataIn_flg_ovrdflg KINP_TPMSDataIn_flg_ovrdval /end REF_CHARACTERISTIC /begin REF_MEASUREMENT VINP_TPMSDataIn_flg /end REF_MEASUREMENT /end GROUP
/begin GROUP S17_Subsystem1 "SWC_INP_type/run_SWC_INP_5ms_sys/INP/TPMS/Subsystem1" /begin REF_CHARACTERISTIC KINP_TPMSID_raw_ovrdflg KINP_TPMSID_raw_ovrdval /end REF_CHARACTERISTIC /begin REF_MEASUREMENT VINP_TPMSID_raw /end REF_MEASUREMENT /end GROUP
/begin GROUP S17_Subsystem10 "SWC_INP_type/run_SWC_INP_5ms_sys/INP/TPMS/Subsystem10" /begin REF_CHARACTERISTIC KINP_TPMSStorge_flg_ovrdval KINP_TPMSStorge_flg_ovrflg /end REF_CHARACTERISTIC /begin REF_MEASUREMENT VINP_TPMSStorge_flg /end REF_MEASUREMENT /end GROUP
/begin GROUP S17_Subsystem11 "SWC_INP_type/run_SWC_INP_5ms_sys/INP/TPMS/Subsystem11" /begin REF_CHARACTERISTIC KINP_LFID_raw_ovrdval KINP_LFID_raw_ovrflg /end REF_CHARACTERISTIC /begin REF_MEASUREMENT VINP_LFID_raw /end REF_MEASUREMENT /end GROUP
/begin GROUP S17_Subsystem12 "SWC_INP_type/run_SWC_INP_5ms_sys/INP/TPMS/Subsystem12" /begin REF_CHARACTERISTIC KINP_RFID_raw_ovrdval /end REF_CHARACTERISTIC /begin REF_MEASUREMENT VINP_RFID_raw /end REF_MEASUREMENT /end GROUP
/begin GROUP S17_Subsystem13 "SWC_INP_type/run_SWC_INP_5ms_sys/INP/TPMS/Subsystem13" /begin REF_CHARACTERISTIC KINP_LRID_raw_ovrdval /end REF_CHARACTERISTIC /begin REF_MEASUREMENT VINP_LRID_raw /end REF_MEASUREMENT /end GROUP
/begin GROUP S17_Subsystem14 "SWC_INP_type/run_SWC_INP_5ms_sys/INP/TPMS/Subsystem14" /begin REF_CHARACTERISTIC KINP_RRID_raw_ovrdval /end REF_CHARACTERISTIC /begin REF_MEASUREMENT VINP_RRID_raw /end REF_MEASUREMENT /end GROUP
/begin GROUP S17_Subsystem2 "SWC_INP_type/run_SWC_INP_5ms_sys/INP/TPMS/Subsystem2"
 /begin REF_CHARACTERISTIC KINP_TPMSPressure_raw_ovrdflg KINP_TPMSPressure_raw_ovrdval /end REF_CHARACTERISTIC
 /begin REF_MEASUREMENT VINP_TPMSPressure_raw /end REF_MEASUREMENT
/end GROUP
/begin GROUP S17_Subsystem3 "SWC_INP_type/run_SWC_INP_5ms_sys/INP/TPMS/Subsystem3" /begin REF_CHARACTERISTIC KINP_TPMSTemp_raw_ovrdflg KINP_TPMSTemp_raw_ovrdval /end REF_CHARACTERISTIC /begin REF_MEASUREMENT VINP_TPMSTemp_raw /end REF_MEASUREMENT /end GROUP
/begin GROUP S17_Subsystem4 "SWC_INP_type/run_SWC_INP_5ms_sys/INP/TPMS/Subsystem4" /begin REF_CHARACTERISTIC KINP_TPMSSta_enum_ovrdflg KINP_TPMSSta_enum_ovrdval /end REF_CHARACTERISTIC /begin REF_MEASUREMENT VINP_TPMSSta_enum /end REF_MEASUREMENT /end GROUP
/begin GROUP S17_Subsystem5 "SWC_INP_type/run_SWC_INP_5ms_sys/INP/TPMS/Subsystem5"
 /begin REF_CHARACTERISTIC KINP_TPMSPressureMi_raw_ovrdflg KINP_TPMSPressureMi_raw_ovrdval /end REF_CHARACTERISTIC
 /begin REF_MEASUREMENT VINP_TPMSPressureMi_raw /end REF_MEASUREMENT
/end GROUP
/begin GROUP S17_Subsystem6 "SWC_INP_type/run_SWC_INP_5ms_sys/INP/TPMS/Subsystem6" /begin REF_CHARACTERISTIC KINP_TPMSCRC_crc_ovrdflg KINP_TPMSCRC_crc_ovrdval /end REF_CHARACTERISTIC /begin REF_MEASUREMENT VINP_TPMSCRC_crc /end REF_MEASUREMENT /end GROUP
/begin GROUP S17_Subsystem7 "SWC_INP_type/run_SWC_INP_5ms_sys/INP/TPMS/Subsystem7" /begin REF_CHARACTERISTIC KINP_TPMSCRCCalc_crc_ovrdflg KINP_TPMSCRCCalc_crc_ovrdval /end REF_CHARACTERISTIC /begin REF_MEASUREMENT VINP_TPMSCRCCalc_crc /end REF_MEASUREMENT /end GROUP
/begin GROUP S17_Subsystem8 "SWC_INP_type/run_SWC_INP_5ms_sys/INP/TPMS/Subsystem8" /begin REF_CHARACTERISTIC KINP_TPMSFAT_flg_ovrdval KINP_TPMSFAT_flg_ovrflg /end REF_CHARACTERISTIC /begin REF_MEASUREMENT VINP_TPMSFAT_flg /end REF_MEASUREMENT /end GROUP
/begin GROUP S17_Subsystem9 "SWC_INP_type/run_SWC_INP_5ms_sys/INP/TPMS/Subsystem9" /begin REF_CHARACTERISTIC KINP_TPMSBattLow_flg_ovrdval KINP_TPMSBattLow_flg_ovrflg /end REF_CHARACTERISTIC /begin REF_MEASUREMENT VINP_TPMSBattLow_flg /end REF_MEASUREMENT /end GROUP
/begin GROUP S76_CANMsgInvalidABM1 "SWC_INP_type/run_SWC_INP_5ms_sys/INP/CAN1/CommunicationCheck/CANMsgInvalidABM1"
 /begin REF_CHARACTERISTIC KINP_CANMsgInvalidABM1_flg_ovrdflg KINP_CANMsgInvalidABM1_flg_ovrdval /end REF_CHARACTERISTIC
/end GROUP
/begin GROUP S76_CANMsgInvalidEPB1 "SWC_INP_type/run_SWC_INP_5ms_sys/INP/CAN1/CommunicationCheck/CANMsgInvalidEPB1"
 /begin REF_CHARACTERISTIC KINP_CANMsgInvalidEPB1_flg_ovrdflg KINP_CANMsgInvalidEPB1_flg_ovrdval /end REF_CHARACTERISTIC
/end GROUP
/begin GROUP S76_CANMsgInvalidEPS1 "SWC_INP_type/run_SWC_INP_5ms_sys/INP/CAN1/CommunicationCheck/CANMsgInvalidEPS1"
 /begin REF_CHARACTERISTIC KINP_CANMsgInvalidEPS1_flg_ovrdflg KINP_CANMsgInvalidEPS1_flg_ovrdval /end REF_CHARACTERISTIC
/end GROUP
/begin GROUP S76_CANMsgInvalidESC1 "SWC_INP_type/run_SWC_INP_5ms_sys/INP/CAN1/CommunicationCheck/CANMsgInvalidESC1"
 /begin REF_CHARACTERISTIC KINP_CANMsgInvalidESC1_flg_ovrdflg KINP_CANMsgInvalidESC1_flg_ovrdval /end REF_CHARACTERISTIC
/end GROUP
/begin GROUP S76_CANMsgInvalidESC5 "SWC_INP_type/run_SWC_INP_5ms_sys/INP/CAN1/CommunicationCheck/CANMsgInvalidESC5"
 /begin REF_CHARACTERISTIC KINP_CANMsgInvalidESC5_flg_ovrdflg KINP_CANMsgInvalidESC5_flg_ovrdval /end REF_CHARACTERISTIC
/end GROUP
/begin GROUP S76_CANMsgInvalideBST1 "SWC_INP_type/run_SWC_INP_5ms_sys/INP/CAN1/CommunicationCheck/CANMsgInvalideBST1"
 /begin REF_CHARACTERISTIC KINP_CANMsgInvalideBST1_flg_ovrdflg KINP_CANMsgInvalideBST1_flg_ovrdval /end REF_CHARACTERISTIC
/end GROUP
/begin GROUP S78_ABM1 "SWC_INP_type/run_SWC_INP_5ms_sys/INP/CAN1/SignalCheck/ABM1"
 /begin SUB_GROUP S103_ABM1CSErr S103_ABM1RCErr S103_ABMPassengerODSSta S103_ABMRearPassengerCTRODSSta S103_ABMRearPassengerLHODSSta S103_ABMRearPassengerRHODSSta S103_AirBagFailCmd S103_ChecksumABM1 S103_CrashOutputSts S103_DriverSeatBeltCmd S103_LifeCountABM1 S103_PABSwitchCmd S103_PsngrSeatBeltCmd S103_RCenterSeatBeltCmd S103_RDriverSeatBeltCmd S103_RPsngrSeatBeltCmd S103_TLHPsngrSeatBeltCmd S103_TRHPsngrSeatBeltCmd /end SUB_GROUP
/end GROUP
/begin GROUP S78_EPB1 "SWC_INP_type/run_SWC_INP_5ms_sys/INP/CAN1/SignalCheck/EPB1"
 /begin SUB_GROUP S104_DOASta S104_EPB1CSErr S104_EPB1RC S104_EPB1RCErr S104_EPBCarWashMode S104_EPBErrSta S104_EPBExtApplyAvail S104_EPBExtReleaseAvail S104_EPBSta /end SUB_GROUP
/end GROUP
/begin GROUP S78_EPS1 "SWC_INP_type/run_SWC_INP_5ms_sys/INP/CAN1/SignalCheck/EPS1"
 /begin SUB_GROUP S105_DriIntend S105_EPS1CSErr S105_EPS1RCErr S105_EPSAOIControl S105_EPSRC S105_EpasFailed S105_SASAngle S105_SASCAL S105_SASSpeed S105_SASSpeedValid S105_SASV /end SUB_GROUP
/end GROUP
/begin GROUP S78_ESC1 "SWC_INP_type/run_SWC_INP_5ms_sys/INP/CAN1/SignalCheck/ESC1"
 /begin SUB_GROUP S106_ABSActive S106_ABSFailed S106_ABSWnlmpSta S106_AVHActive S106_AVHFailed S106_AmberWnlmpSta S106_BTCSActive S106_EBDActive S106_EBDFailed S106_ESC1CS S106_ESC1CSErr S106_ESC1RC S106_ESC1RCErr S106_ESCActive S106_ESCBeepReq S106_ESCFailed S106_ESCOFFStatus S106_ESCOfflmpSta S106_ESCWnlmpSta S106_ESSActive S106_FrPTCSActive S106_FrntAxlTrqReqDrv S106_GRADE S106_HBBActive S106_HBBFailed S106_HDDActive S106_HDDFailed S106_HSAActive S106_HSAFailed S106_LFPulseCount S106_LFPulseCountV S106_LFRawWhlSpeed S106_LFRawWhlSpeedV S106_LFWhlRotDir S106_LRPulseCount S106_LRPulseCountV S106_LRRawWhlSpeed S106_LRRawWhlSpeedV S106_LRWhlRotDir S106_PBAActive S106_PBAFailed S106_RFPulseCount S106_RFPulseCountV S106_RFRawWhlSpeed S106_RFRawWhlSpeedV S106_RFWhlRotDir S106_RRPulseCount S106_RRPulseCountV S106_RRRawWhlSpeed S106_RRRawWhlSpeedV S106_RRWhlRotDir S106_RearAxlTrqReqDrv S106_RedWnlmpSta S106_RrPTCSActive S106_TCSActive S106_TCSFailed S106_VehSpeed /end SUB_GROUP
/end GROUP
/begin GROUP S78_ESC5 "SWC_INP_type/run_SWC_INP_5ms_sys/INP/CAN1/SignalCheck/ESC5"
 /begin SUB_GROUP S107_ACCAvail S107_AEBAvail S107_ActBrkLampSta S107_BrkDiscTempSta S107_BrkPedalPos S107_BrkPedalPosSta S107_BrkSwSta S107_BrkSwV S107_ESC5CS S107_ESC5CSErr S107_ESC5RC S107_ESC5RCErr S107_ESCADASSta S107_ESCAPSSta S107_ESCStandstill S107_FrRBCActive S107_FrntAxlTrqReqBrk S107_LatAccel S107_LatAccelV S107_LongAccel S107_LongAccelV S107_MCPressure S107_MCPressureV S107_MeterIndVehSpeed S107_RDCActive S107_RearAxlTrqReqBrk S107_RrRBCActive S107_YawRate S107_YawRateV /end SUB_GROUP
/end GROUP
/begin GROUP S78_eBST1 "SWC_INP_type/run_SWC_INP_5ms_sys/INP/CAN1/SignalCheck/eBST1"
 /begin SUB_GROUP S108_LowBrakeFluidSta S108_eBSTAmberWnlmpSta S108_eBSTBeepReq S108_eBSTRedWnlmpSta /end SUB_GROUP
/end GROUP
/begin GROUP S749_CANMsgInvalidHMI1 "SWC_INP_type/run_SWC_INP_5ms_sys/INP/CAN2/CommunicationCheck/CANMsgInvalidHMI1"
 /begin REF_CHARACTERISTIC KINP_CANMsgInvalidHMI1_flg_ovrdflg KINP_CANMsgInvalidHMI1_flg_ovrdval /end REF_CHARACTERISTIC
/end GROUP
/begin GROUP S749_CANMsgInvalidIVI1 "SWC_INP_type/run_SWC_INP_5ms_sys/INP/CAN2/CommunicationCheck/CANMsgInvalidIVI1"
 /begin REF_CHARACTERISTIC KINP_CANMsgInvalidIVI1_flg_ovrdflg KINP_CANMsgInvalidIVI1_flg_ovrdval /end REF_CHARACTERISTIC
/end GROUP
/begin GROUP S749_CANMsgInvalidIVI2 "SWC_INP_type/run_SWC_INP_5ms_sys/INP/CAN2/CommunicationCheck/CANMsgInvalidIVI2"
 /begin REF_CHARACTERISTIC KINP_CANMsgInvalidIVI2_flg_ovrdflg KINP_CANMsgInvalidIVI2_flg_ovrdval /end REF_CHARACTERISTIC
/end GROUP
/begin GROUP S749_CANMsgInvalidIVI3 "SWC_INP_type/run_SWC_INP_5ms_sys/INP/CAN2/CommunicationCheck/CANMsgInvalidIVI3"
 /begin REF_CHARACTERISTIC KINP_CANMsgInvalidIVI3_flg_ovrdflg KINP_CANMsgInvalidIVI3_flg_ovrdval /end REF_CHARACTERISTIC
/end GROUP
/begin GROUP S749_CANMsgInvalidMETER1 "SWC_INP_type/run_SWC_INP_5ms_sys/INP/CAN2/CommunicationCheck/CANMsgInvalidMETER1"
 /begin REF_CHARACTERISTIC KINP_CANMsgInvalidMETER1_flg_ovrdflg KINP_CANMsgInvalidMETER1_flg_ovrdval /end REF_CHARACTERISTIC
/end GROUP
/begin GROUP S751_HMI1 "SWC_INP_type/run_SWC_INP_5ms_sys/INP/CAN2/SignalCheck/HMI1"
 /begin SUB_GROUP S772_HMIACAirIntMCmd S772_HMIACAirIntPCmd S772_HMIACAutoBtnCmd S772_HMIACBtnCmd S772_HMIACFrDefogBtnCmd S772_HMIACRecycleBtnCmd S772_HMIACWindDirMCmd S772_HMIACWindDirPCmd S772_HMIAutoInterLightCmd S772_HMIBCMPostDefogBtnCmd S772_HMIZLSetTMCmd S772_HMIZLSetTPCmd S772_HMIZRSetTMCmd S772_HMIZRSetTPCmd /end SUB_GROUP
/end GROUP
/begin GROUP S751_IVI1 "SWC_INP_type/run_SWC_INP_5ms_sys/INP/CAN2/SignalCheck/IVI1"
 /begin SUB_GROUP S773_AmbLighLowBatAlertSW S773_AmbLighSafetyAlertSW S773_AmbLightBrightnessSet S773_AmbLightColorSet S773_AmbLightDimInDarkSW S773_AmbLightSW S773_AmbLightWlcmLightSW S773_FCPFrEvtBtnACMaxReq S773_FCPFrEvtBtnACReq S773_FCPFrEvtBtnAutoReq S773_FCPFrEvtBtnSyncReq S773_IVIAutoWipHSpdSWCmd S773_IVICLWinLockDoorSWSta S773_IVICreateAccReqSta S773_IVIDelAccReqSta S773_IVIDrivingLockSWSta S773_IVIEPSForceCmd S773_IVIFrTrunkUnlockReqSta S773_IVILinkAccReqSta S773_IVILinkAccSta S773_IVILinkKeySta S773_IVILocatedSTA S773_IVILockSoundSWSta S773_IVIMirrorFoldedSWSta S773_IVISWCVibModeSta S773_IVISilentChrgAlertSta S773_IVIStoppingUnlockSWSta S773_IVITimeCheck S773_IVITimeDay S773_IVITimeHour S773_IVITimeMinute S773_IVITimeMonth S773_IVITimeSecond S773_IVITimeYear S773_IVIWPTCSWSta S773_IVIsigScreenReqSta S773_LINKtoDrive S773_OpenDrOpenWdoSW S773_PWCONTINUEUSE S773_SmartEcoModeSW S773_UserSet /end SUB_GROUP
/end GROUP
/begin GROUP S751_IVI2 "SWC_INP_type/run_SWC_INP_5ms_sys/INP/CAN2/SignalCheck/IVI2"
 /begin SUB_GROUP S774_ACChgCurSet S774_AVMErrSTA S774_AVMOFFRecButt S774_AVMParkingmode S774_AVMparkingcancel S774_AVMparkingexcute S774_ApproachUnlockSW S774_CAASSw S774_CDLLockButt S774_CDLUnlockButt S774_DSEATantiset S774_DSEATentryfunset S774_DSEATventreq S774_Distanceunit S774_ESCSWCmd S774_FSOffSw S774_FollowMeSW S774_GPSLAT S774_GPSLONG S774_HeadLampSW S774_HoodLatchSW S774_IVIACCAdaptiveSta S774_IVIAirIntZ3Cmd S774_IVICarWashModeCmd S774_IVIChargePortSWSta S774_IVICreepSWReq S774_IVIDSEATFroEdgeHeightCmd S774_IVIDSEATHeaterCmd S774_IVIDSEATHeightCmd S774_IVIDSEATMemory1Sta S774_IVIDSEATMemory2Sta S774_IVIDSEATMemoryOPTCLSSta S774_IVIDSEATReclineCmd S774_IVIDSEATSlideCmd S774_IVIFGSAirIntCmd S774_IVIFGSChCmd S774_IVIIONSWCmd S774_IVIISAOffsetSpd S774_IVINightModeSta S774_IVIPSEATHeaterCmd S774_IVIPSEATReclineCmd S774_IVIPSEATSlideCmd S774_IVIPTGModeSW S774_IVIPTGOpenHeight S774_IVIPTGStaSW S774_IVIPTGUSStaSW S774_IVIPWModeReq S774_IVIPwrLockSW S774_IVIPwroffreq S774_IVIRRDefReq S774_IVIReqV2L S774_IVISWCRUndefinedSta S774_IVIScreen S774_IVIStartChgreq S774_IVIStatus S774_IVIStopChgreq S774_IVITrailerCheckReqSta S774_IVITrailerModeSWSta S774_IVITriggerreq S774_IVIUnlockChgreq S774_IVIWIMAINSW S774_LDrvControlCommand S774_LPasControlCommand S774_LRLDControlCommand S774_LRRDControlCommand S774_LightShowStartReq S774_LightShowStopReq S774_MFRDNBrightReq S774_OFFACMODE S774_PSEATventreq S774_PerdV2L S774_RFogLampSW S774_RollModeSWCmd S774_RoomLampMode S774_SOCADJBUTT S774_SOCLimitSet S774_SOCV2LLimit S774_SchedChgStart S774_SchedChgStop S774_SchedChgbutt S774_SchedChglimit S774_SchedChgwake S774_SenstivityPosition S774_SetUnlockSingle S774_TCSSWCmd S774_TPMSCaliButt S774_TPMSResButt S774_TurnSwTimeSet S774_WalkawayLockSW S774_WlcmLightMode S774_sigAirIntenZon1Req S774_sigDfrstReq S774_sigFaceReq S774_sigFootReq S774_sigRecircReq S774_sigSetTempZon1Req S774_sigSetTempZon2Req /end SUB_GROUP
/end GROUP
/begin GROUP S751_IVI3 "SWC_INP_type/run_SWC_INP_5ms_sys/INP/CAN2/SignalCheck/IVI3"
 /begin SUB_GROUP S775_IVICLBlowerYSta S775_IVICLBlowerZSta S775_IVICRBlowerYSta S775_IVICRBlowerZSta S775_IVIHMICustmiFunSta S775_IVIHMICustmiKEYSta S775_IVILBlowerModeSta S775_IVILBlowerYSta S775_IVILBlowerZSta S775_IVILSEATventCmd S775_IVIMLFMostCmd S775_IVIMLFootLiftCmd S775_IVIMLNapModeCmd S775_IVIMLReclinerCmd S775_IVIMLRestoreCmd S775_IVIMLSEATventCmd S775_IVIMLSeatLiftCmd S775_IVIMLSldRestoreCmd S775_IVIMLSliderCmd S775_IVIMLZeroGravityCmd S775_IVIMRFMostCmd S775_IVIMRFootLiftCmd S775_IVIMRNapModeCmd S775_IVIMRReclinerCmd S775_IVIMRRestoreCmd S775_IVIMRSEATventCmd S775_IVIMRSeatLiftCmd S775_IVIMRSldRestoreCmd S775_IVIMRSliderCmd S775_IVIMRZeroGravityCmd S775_IVIRBlowerModeSta S775_IVIRBlowerYSta S775_IVIRBlowerZSta S775_IVIRSEATventCmd S775_IVISnowModeCmd S775_IVIUserTakeOverAPSSta S775_IVIZon1WindDirSWReqSta /end SUB_GROUP
/end GROUP
/begin GROUP S751_METER1 "SWC_INP_type/run_SWC_INP_5ms_sys/INP/CAN2/SignalCheck/METER1" /begin SUB_GROUP S776_METERKPHCalcu S776_ODOMETER /end SUB_GROUP /end GROUP
/begin GROUP S1732_CANMsgInvalidBMS1 "SWC_INP_type/run_SWC_INP_5ms_sys/INP/CAN3/CommunicationCheck/CANMsgInvalidBMS1"
 /begin REF_CHARACTERISTIC KINP_CANMsgInvalidBMS1_flg_ovrdflg KINP_CANMsgInvalidBMS1_flg_ovrdval /end REF_CHARACTERISTIC
/end GROUP
/begin GROUP S1732_CANMsgInvalidBMS3 "SWC_INP_type/run_SWC_INP_5ms_sys/INP/CAN3/CommunicationCheck/CANMsgInvalidBMS3"
 /begin REF_CHARACTERISTIC KINP_CANMsgInvalidBMS3_flg_ovrdflg KINP_CANMsgInvalidBMS3_flg_ovrdval /end REF_CHARACTERISTIC
/end GROUP
/begin GROUP S1732_CANMsgInvalidBMS4 "SWC_INP_type/run_SWC_INP_5ms_sys/INP/CAN3/CommunicationCheck/CANMsgInvalidBMS4"
 /begin REF_CHARACTERISTIC KINP_CANMsgInvalidBMS4_flg_ovrdflg KINP_CANMsgInvalidBMS4_flg_ovrdval /end REF_CHARACTERISTIC
/end GROUP
/begin GROUP S1732_CANMsgInvalidBMS5 "SWC_INP_type/run_SWC_INP_5ms_sys/INP/CAN3/CommunicationCheck/CANMsgInvalidBMS5"
 /begin REF_CHARACTERISTIC KINP_CANMsgInvalidBMS5_flg_ovrdflg KINP_CANMsgInvalidBMS5_flg_ovrdval /end REF_CHARACTERISTIC
/end GROUP
/begin GROUP S1732_CANMsgInvalidBMS6 "SWC_INP_type/run_SWC_INP_5ms_sys/INP/CAN3/CommunicationCheck/CANMsgInvalidBMS6"
 /begin REF_CHARACTERISTIC KINP_CANMsgInvalidBMS6_flg_ovrdflg KINP_CANMsgInvalidBMS6_flg_ovrdval /end REF_CHARACTERISTIC
/end GROUP
/begin GROUP S1732_CANMsgInvalidBMS8 "SWC_INP_type/run_SWC_INP_5ms_sys/INP/CAN3/CommunicationCheck/CANMsgInvalidBMS8"
 /begin REF_CHARACTERISTIC KINP_CANMsgInvalidBMS8_flg_ovrdflg KINP_CANMsgInvalidBMS8_flg_ovrdval /end REF_CHARACTERISTIC
/end GROUP
/begin GROUP S1732_CANMsgInvalidCCU1 "SWC_INP_type/run_SWC_INP_5ms_sys/INP/CAN3/CommunicationCheck/CANMsgInvalidCCU1"
 /begin REF_CHARACTERISTIC KINP_CANMsgInvalidCCU1_flg_ovrdflg KINP_CANMsgInvalidCCU1_flg_ovrdval /end REF_CHARACTERISTIC
/end GROUP
/begin GROUP S1732_CANMsgInvalidCCU2 "SWC_INP_type/run_SWC_INP_5ms_sys/INP/CAN3/CommunicationCheck/CANMsgInvalidCCU2"
 /begin REF_CHARACTERISTIC KINP_CANMsgInvalidCCU2_flg_ovrdflg KINP_CANMsgInvalidCCU2_flg_ovrdval /end REF_CHARACTERISTIC
/end GROUP
/begin GROUP S1732_CANMsgInvalidEBM1 "SWC_INP_type/run_SWC_INP_5ms_sys/INP/CAN3/CommunicationCheck/CANMsgInvalidEBM1"
 /begin REF_CHARACTERISTIC KINP_CANMsgInvalidEBM1_flg_ovrdflg KINP_CANMsgInvalidEBM1_flg_ovrdval /end REF_CHARACTERISTIC
/end GROUP
/begin GROUP S1732_CANMsgInvalidMCUBF1 "SWC_INP_type/run_SWC_INP_5ms_sys/INP/CAN3/CommunicationCheck/CANMsgInvalidMCUBF1"
 /begin REF_CHARACTERISTIC KINP_CANMsgInvalidMCUBF1_flg_ovrdflg KINP_CANMsgInvalidMCUBF1_flg_ovrdval /end REF_CHARACTERISTIC
/end GROUP
/begin GROUP S1732_CANMsgInvalidMCUBF2 "SWC_INP_type/run_SWC_INP_5ms_sys/INP/CAN3/CommunicationCheck/CANMsgInvalidMCUBF2"
 /begin REF_CHARACTERISTIC KINP_CANMsgInvalidMCUBF2_flg_ovrdflg KINP_CANMsgInvalidMCUBF2_flg_ovrdval /end REF_CHARACTERISTIC
/end GROUP
/begin GROUP S1732_CANMsgInvalidMCUBR1 "SWC_INP_type/run_SWC_INP_5ms_sys/INP/CAN3/CommunicationCheck/CANMsgInvalidMCUBR1"
 /begin REF_CHARACTERISTIC KINP_CANMsgInvalidMCUBR1_flg_ovrdflg KINP_CANMsgInvalidMCUBR1_flg_ovrdval /end REF_CHARACTERISTIC
/end GROUP
/begin GROUP S1732_CANMsgInvalidMCUBR2 "SWC_INP_type/run_SWC_INP_5ms_sys/INP/CAN3/CommunicationCheck/CANMsgInvalidMCUBR2"
 /begin REF_CHARACTERISTIC KINP_CANMsgInvalidMCUBR2_flg_ovrdflg KINP_CANMsgInvalidMCUBR2_flg_ovrdval /end REF_CHARACTERISTIC
/end GROUP
/begin GROUP S1732_CANMsgInvalidMCUNF1 "SWC_INP_type/run_SWC_INP_5ms_sys/INP/CAN3/CommunicationCheck/CANMsgInvalidMCUNF1"
 /begin REF_CHARACTERISTIC KINP_CANMsgInvalidMCUNF1_flg_ovrdflg KINP_CANMsgInvalidMCUNF1_flg_ovrdval /end REF_CHARACTERISTIC
/end GROUP
/begin GROUP S1732_CANMsgInvalidMCUNF2 "SWC_INP_type/run_SWC_INP_5ms_sys/INP/CAN3/CommunicationCheck/CANMsgInvalidMCUNF2"
 /begin REF_CHARACTERISTIC KINP_CANMsgInvalidMCUNF2_flg_ovrdflg KINP_CANMsgInvalidMCUNF2_flg_ovrdval /end REF_CHARACTERISTIC
/end GROUP
/begin GROUP S1732_CANMsgInvalidMCUNF3 "SWC_INP_type/run_SWC_INP_5ms_sys/INP/CAN3/CommunicationCheck/CANMsgInvalidMCUNF3"
 /begin REF_CHARACTERISTIC KINP_CANMsgInvalidMCUNF3_flg_ovrdflg KINP_CANMsgInvalidMCUNF3_flg_ovrdval /end REF_CHARACTERISTIC
/end GROUP
/begin GROUP S1732_CANMsgInvalidMCUNR1 "SWC_INP_type/run_SWC_INP_5ms_sys/INP/CAN3/CommunicationCheck/CANMsgInvalidMCUNR1"
 /begin REF_CHARACTERISTIC KINP_CANMsgInvalidMCUNR1_flg_ovrdflg KINP_CANMsgInvalidMCUNR1_flg_ovrdval /end REF_CHARACTERISTIC
/end GROUP
/begin GROUP S1732_CANMsgInvalidMCUNR2 "SWC_INP_type/run_SWC_INP_5ms_sys/INP/CAN3/CommunicationCheck/CANMsgInvalidMCUNR2"
 /begin REF_CHARACTERISTIC KINP_CANMsgInvalidMCUNR2_flg_ovrdflg KINP_CANMsgInvalidMCUNR2_flg_ovrdval /end REF_CHARACTERISTIC
/end GROUP
/begin GROUP S1732_CANMsgInvalidMCUNR3 "SWC_INP_type/run_SWC_INP_5ms_sys/INP/CAN3/CommunicationCheck/CANMsgInvalidMCUNR3"
 /begin REF_CHARACTERISTIC KINP_CANMsgInvalidMCUNR3_flg_ovrdflg KINP_CANMsgInvalidMCUNR3_flg_ovrdval /end REF_CHARACTERISTIC
/end GROUP
/begin GROUP S1732_CANMsgInvalidShifter1 "SWC_INP_type/run_SWC_INP_5ms_sys/INP/CAN3/CommunicationCheck/CANMsgInvalidShifter1"
 /begin REF_CHARACTERISTIC KINP_CANMsgInvalidShifter1_flg_ovrdflg KINP_CANMsgInvalidShifter1_flg_ovrdval /end REF_CHARACTERISTIC
/end GROUP
/begin GROUP S1732_CANMsgInvalidShifter2 "SWC_INP_type/run_SWC_INP_5ms_sys/INP/CAN3/CommunicationCheck/CANMsgInvalidShifter2"
 /begin REF_CHARACTERISTIC KINP_CANMsgInvalidShifter2_flg_ovrdflg KINP_CANMsgInvalidShifter2_flg_ovrdval /end REF_CHARACTERISTIC
/end GROUP
/begin GROUP S1734_BMS1 "SWC_INP_type/run_SWC_INP_5ms_sys/INP/CAN3/SignalCheck/BMS1"
 /begin SUB_GROUP S1819_BMS1CSErr S1819_BMS1RCErr S1819_BMSChckSum1 S1819_BMSRolCnct1 S1819_HVBPwrAvailChrg S1819_HVBPwrAvailChrg30 S1819_HVBPwrAvailChrg60 S1819_HVBPwrAvailDchrg S1819_HVBPwrAvailDchrg30 S1819_HVBPwrAvailDchrg60 S1819_HVBattCurr S1819_HVBattVolt /end SUB_GROUP
/end GROUP
/begin GROUP S1734_BMS3 "SWC_INP_type/run_SWC_INP_5ms_sys/INP/CAN3/SignalCheck/BMS3"
 /begin SUB_GROUP S1820_ACChrgCurrDis S1820_FireDetErr S1820_HVBChrgPwr S1820_HVBChrgPwrTotal S1820_HVBDrvPwr S1820_HVBDrvPwrTotal S1820_HVBFullChrgPwr S1820_HVBIsoImpedenceN S1820_HVBIsoImpedenceP S1820_HVBSOH S1820_HVBattErr S1820_HVBattPackVolt S1820_HVBattSOC S1820_HVBattSOCDis S1820_RemainChrgTime /end SUB_GROUP
/end GROUP
/begin GROUP S1734_BMS4 "SWC_INP_type/run_SWC_INP_5ms_sys/INP/CAN3/SignalCheck/BMS4"
 /begin SUB_GROUP S1821_CellTempAvg S1821_HVBCellVoltMax S1821_HVBCellVoltMin S1821_HVBMTempMax S1821_HVBMTempMin S1821_MaxCellTempNum S1821_MaxCellVoltNum S1821_MinCellTempNum S1821_MinCellVoltNum /end SUB_GROUP
/end GROUP
/begin GROUP S1734_BMS5 "SWC_INP_type/run_SWC_INP_5ms_sys/INP/CAN3/SignalCheck/BMS5"
 /begin SUB_GROUP S1822_HVInVolt S1822_LVBattDet12V S1822_OBCACCSLimit S1822_OBCDCCurLm S1822_OBCDCVoltLm /end SUB_GROUP
/end GROUP
/begin GROUP S1734_BMS6 "SWC_INP_type/run_SWC_INP_5ms_sys/INP/CAN3/SignalCheck/BMS6"
 /begin SUB_GROUP S1823_BMS6CSErr S1823_BMS6RCErr S1823_BMSChckSum S1823_BMSREADY S1823_BMSRolCnct S1823_BMSWarn1 S1823_BMSWarn2 S1823_BMSWarn3 S1823_BMSWarn4 S1823_BMSWarn5 S1823_BMSWarn6 S1823_BMSWarn7 S1823_BMSWarn8 S1823_ChrgInLockReq S1823_ChrgPlugSta S1823_DisChrgPlugErr S1823_ExtChrgSta S1823_HVBChrgErr S1823_HVBContactorSta S1823_HVBHVILErr S1823_HVBOvrTempErr S1823_HVBOvrTempWarn S1823_HVBPreheatPrecoolSta S1823_HVBattReady4Pre S1823_HVILSta S1823_V2LSta /end SUB_GROUP
/end GROUP
/begin GROUP S1734_BMS8 "SWC_INP_type/run_SWC_INP_5ms_sys/INP/CAN3/SignalCheck/BMS8" /begin SUB_GROUP S1824_MainRlyNegSta S1824_MainRlyPosSta /end SUB_GROUP /end GROUP
/begin GROUP S1734_CCU1 "SWC_INP_type/run_SWC_INP_5ms_sys/INP/CAN3/SignalCheck/CCU1"
 /begin SUB_GROUP S1825_CCU1CSErr S1825_CCU1RCErr S1825_CSCCU1 S1825_DCDCAuxCur S1825_DCDCAuxVolt S1825_DCDCHVCur S1825_DCDCInVoltInf S1825_DCDCPreCompleted S1825_OBCDCCurrInf S1825_OBCDCVoltInf S1825_OBCPreCompleted S1825_OBCWakeup4Plugin S1825_RCCCU1 /end SUB_GROUP
/end GROUP
/begin GROUP S1734_CCU2 "SWC_INP_type/run_SWC_INP_5ms_sys/INP/CAN3/SignalCheck/CCU2"
 /begin SUB_GROUP S1826_CCU2CSErr S1826_CCU2RCErr S1826_CSCCU2 S1826_DCDCEnaSta S1826_DCDCFaultSta S1826_DCDCReady4Pre S1826_DCDCTemp S1826_OBCACCurLim S1826_OBCACCurrInf S1826_OBCACVoltInf S1826_OBCEnaSta S1826_OBCFaultSta S1826_OBCPluginSta S1826_OBCReady4Pre S1826_OBCTemp S1826_OBCV2LSta S1826_RCCCU2 /end SUB_GROUP
/end GROUP
/begin GROUP S1734_EBM1 "SWC_INP_type/run_SWC_INP_5ms_sys/INP/CAN3/SignalCheck/EBM1" /begin SUB_GROUP S1827_EBMErrSta S1827_EBMRLampSta /end SUB_GROUP /end GROUP
/begin GROUP S1734_MCU_B_F1 "SWC_INP_type/run_SWC_INP_5ms_sys/INP/CAN3/SignalCheck/MCU_B_F1"
 /begin SUB_GROUP S1828_FrActvDmpDisabSta S1828_FrEDUDrtSta S1828_FrEDUOpratingSta S1828_FrEDURealTMTq S1828_FrEDURotateDirction S1828_FrEDUTqReqFbk S1828_FrMCU1Chksum S1828_FrMCU1RolCnt S1828_FrMCUBAT S1828_FrMCUDCBusCurr S1828_FrMCUDCBusVolt S1828_FrMCUDischrgSta S1828_FrMCUEnaSta S1828_FrMCUErr S1828_FrMCUIGNsta S1828_FrMCUReady S1828_FrMCUReady4Pre S1828_FrMCUSysSta S1828_FrMCUTemp S1828_FrMotorAvailTq S1828_FrRegenAvailTq S1828_FrTMSpd S1828_FrTMTemp S1828_FrTMid S1828_FrTMiq S1828_MCUBF1CSErr S1828_MCUBF1RCErr S1828_MCUBFRealPwrKwSta S1828_MCUWarnF /end SUB_GROUP
/end GROUP
/begin GROUP S1734_MCU_B_F2 "SWC_INP_type/run_SWC_INP_5ms_sys/INP/CAN3/SignalCheck/MCU_B_F2"
 /begin SUB_GROUP S1829_FrCoolanttempReq S1829_FrFailcode1 S1829_FrFailcode2 S1829_FrFailcodehistory1 S1829_FrFailcodehistory2 S1829_FrLLCTemp S1829_FrLLCflowReq S1829_FrMCUHWVer S1829_FrMCUSWVer S1829_FrMCUTempWarn S1829_FrTMTempWarn S1829_MCUBFLLCTempWarnSta /end SUB_GROUP
/end GROUP
/begin GROUP S1734_MCU_B_R1 "SWC_INP_type/run_SWC_INP_5ms_sys/INP/CAN3/SignalCheck/MCU_B_R1"
 /begin SUB_GROUP S1830_MCUBR1CSErr S1830_MCUBR1RCErr S1830_MCUBRRealPwrKwSta S1830_MCUWarnR S1830_RrActvDmpDisabSta S1830_RrEDUDrtSta S1830_RrEDUOpratingSta S1830_RrEDURealTMTq S1830_RrEDURotateDirction S1830_RrEDUTqReqFbk S1830_RrMCU1Chksum S1830_RrMCU1RolCnt S1830_RrMCUBAT S1830_RrMCUDCBusCurr S1830_RrMCUDCBusVolt S1830_RrMCUDischrgSta S1830_RrMCUEnaSta S1830_RrMCUErr S1830_RrMCUIGNsta S1830_RrMCUReady S1830_RrMCUReady4Pre S1830_RrMCUSysSta S1830_RrMCUTemp S1830_RrMotorAvailTq S1830_RrRegenAvailTq S1830_RrTMSpd S1830_RrTMTemp S1830_RrTMid S1830_RrTMiq /end SUB_GROUP
/end GROUP
/begin GROUP S1734_MCU_B_R2 "SWC_INP_type/run_SWC_INP_5ms_sys/INP/CAN3/SignalCheck/MCU_B_R2"
 /begin SUB_GROUP S1831_MCUBRLLCTempWarnSta S1831_RrCoolanttempReq S1831_RrFailcode1 S1831_RrFailcode2 S1831_RrFailcodehistory1 S1831_RrFailcodehistory2 S1831_RrLLCTemp S1831_RrLLCflowReq S1831_RrMCU3HWVer S1831_RrMCU3SWVer S1831_RrMCUTempWarn S1831_RrTMTempWarn /end SUB_GROUP
/end GROUP
/begin GROUP S1734_MCU_N_F1 "SWC_INP_type/run_SWC_INP_5ms_sys/INP/CAN3/SignalCheck/MCU_N_F1"
 /begin SUB_GROUP S1832_FrActvDmpDisabStaNidec S1832_FrEDUDrtStaNidec S1832_FrEDUOpratingStaNidec S1832_FrEDURealTMTqNidec S1832_FrEDURotateDirctionNidec S1832_FrEDUTqReqFbkNidec S1832_FrMCU1ChksumNidec S1832_FrMCU1RolCntNidec S1832_FrMCUBATNidec S1832_FrMCUDCBusCurrNidec S1832_FrMCUDCBusVoltNidec S1832_FrMCUDischrgStaNidec S1832_FrMCUEnaStaNidec S1832_FrMCUErrNidec S1832_FrMCUIGNstaNidec S1832_FrMCUReady4PreNidec S1832_FrMCUReadyNidec S1832_FrMCUSysStaNidec S1832_FrMCUTempNidec S1832_FrMotorAvailTqNidec S1832_FrRegenAvailTqNidec S1832_FrTMSpdNidec S1832_FrTMTempNidec S1832_FrTMidNidec S1832_FrTMiqNidec S1832_MCUNF1CSErr S1832_MCUNF1RCErr S1832_MCUWarnFNidec /end SUB_GROUP
/end GROUP
/begin GROUP S1734_MCU_N_F2 "SWC_INP_type/run_SWC_INP_5ms_sys/INP/CAN3/SignalCheck/MCU_N_F2"
 /begin SUB_GROUP S1833_FrCoolanttempReqNidec S1833_FrEOPSpdSetNidec S1833_FrFailcode1Nidec S1833_FrFailcode2Nidec S1833_FrFailcodehistory1Nidec S1833_FrFailcodehistory2Nidec S1833_FrLLCTempNidec S1833_FrLLCflowReqNidec S1833_FrMCUTempWarnNidec S1833_FrTMTempWarnNidec /end SUB_GROUP
/end GROUP
/begin GROUP S1734_MCU_N_F3 "SWC_INP_type/run_SWC_INP_5ms_sys/INP/CAN3/SignalCheck/MCU_N_F3" /begin SUB_GROUP S1834_FrMCUHWVerNidec S1834_FrMCUSWVerNidec /end SUB_GROUP /end GROUP
/begin GROUP S1734_MCU_N_R1 "SWC_INP_type/run_SWC_INP_5ms_sys/INP/CAN3/SignalCheck/MCU_N_R1"
 /begin SUB_GROUP S1835_MCUNR1CSErr S1835_MCUNR1RCErr S1835_MCUWarnRNidec S1835_RrActvDmpDisabStaNidec S1835_RrEDUDrtStaNidec S1835_RrEDUOpratingStaNidec S1835_RrEDURealTMTqNidec S1835_RrEDURotateDirctionNidec S1835_RrEDUTqReqFbkNidec S1835_RrMCU1ChksumNidec S1835_RrMCU1RolCntNidec S1835_RrMCUBATNidec S1835_RrMCUDCBusCurrNidec S1835_RrMCUDCBusVoltNidec S1835_RrMCUDischrgStaNidec S1835_RrMCUEnaStaNidec S1835_RrMCUErrNidec S1835_RrMCUIGNstaNidec S1835_RrMCUReady4PreNidec S1835_RrMCUReadyNidec S1835_RrMCUSysStaNidec S1835_RrMCUTempNidec S1835_RrMotorAvailTqNidec S1835_RrRegenAvailTqNidec S1835_RrTMSpdNidec S1835_RrTMTempNidec S1835_RrTMidNidec S1835_RrTMiqNidec /end SUB_GROUP
/end GROUP
/begin GROUP S1734_MCU_N_R2 "SWC_INP_type/run_SWC_INP_5ms_sys/INP/CAN3/SignalCheck/MCU_N_R2"
 /begin SUB_GROUP S1836_RrCoolanttempReqNidec S1836_RrEOPSpdSetNidec S1836_RrFailcode1Nidec S1836_RrFailcode2Nidec S1836_RrFailcodehistory1Nidec S1836_RrFailcodehistory2Nidec S1836_RrLLCTempNidec S1836_RrLLCflowReqNidec S1836_RrMCUTempWarnNidec S1836_RrTMTempWarnNidec /end SUB_GROUP
/end GROUP
/begin GROUP S1734_MCU_N_R3 "SWC_INP_type/run_SWC_INP_5ms_sys/INP/CAN3/SignalCheck/MCU_N_R3" /begin SUB_GROUP S1837_RrMCU3HWVerNidec S1837_RrMCU3SWVerNidec /end SUB_GROUP /end GROUP
/begin GROUP S1734_Shifter1 "SWC_INP_type/run_SWC_INP_5ms_sys/INP/CAN3/SignalCheck/Shifter1"
 /begin SUB_GROUP S1838_Shifter1CSErr S1838_Shifter1RCErr S1838_ShifterCRC8 S1838_ShifterFailsta S1838_ShifterHandleCmd S1838_ShifterRC /end SUB_GROUP
/end GROUP
/begin GROUP S1734_Shifter2 "SWC_INP_type/run_SWC_INP_5ms_sys/INP/CAN3/SignalCheck/Shifter2"
 /begin SUB_GROUP S1839_CSW2DimSwSta S1839_CSW2FWasSwSta S1839_CSW2FWipSwSta S1839_CSW2PassSWSta S1839_CSW2RWipWasSwSta S1839_CSW2TurnSwSta S1839_Shifter2CSErr S1839_Shifter2RCErr /end SUB_GROUP
/end GROUP
/begin GROUP S3225_CANMsgInvalidBodyZoneDR1 "SWC_INP_type/run_SWC_INP_5ms_sys/INP/CAN4/CommunicationCheck/CANMsgInvalidBodyZoneDR1"
 /begin REF_CHARACTERISTIC KINP_CANMsgInvalidBodyZoneDR1_flg_ovrdflg KINP_CANMsgInvalidBodyZoneDR1_flg_ovrdval /end REF_CHARACTERISTIC
/end GROUP
/begin GROUP S3225_CANMsgInvalidBodyZoneDR2 "SWC_INP_type/run_SWC_INP_5ms_sys/INP/CAN4/CommunicationCheck/CANMsgInvalidBodyZoneDR2"
 /begin REF_CHARACTERISTIC KINP_CANMsgInvalidBodyZoneDR2_flg_ovrdflg KINP_CANMsgInvalidBodyZoneDR2_flg_ovrdval /end REF_CHARACTERISTIC
/end GROUP
/begin GROUP S3225_CANMsgInvalidBodyZonePS1 "SWC_INP_type/run_SWC_INP_5ms_sys/INP/CAN4/CommunicationCheck/CANMsgInvalidBodyZonePS1"
 /begin REF_CHARACTERISTIC KINP_CANMsgInvalidBodyZonePS1_flg_ovrdflg KINP_CANMsgInvalidBodyZonePS1_flg_ovrdval /end REF_CHARACTERISTIC
/end GROUP
/begin GROUP S3225_CANMsgInvalidBodyZonePS2 "SWC_INP_type/run_SWC_INP_5ms_sys/INP/CAN4/CommunicationCheck/CANMsgInvalidBodyZonePS2"
 /begin REF_CHARACTERISTIC KINP_CANMsgInvalidBodyZonePS2_flg_ovrdflg KINP_CANMsgInvalidBodyZonePS2_flg_ovrdval /end REF_CHARACTERISTIC
/end GROUP
/begin GROUP S3225_CANMsgInvalidDKC1 "SWC_INP_type/run_SWC_INP_5ms_sys/INP/CAN4/CommunicationCheck/CANMsgInvalidDKC1"
 /begin REF_CHARACTERISTIC KINP_CANMsgInvalidDKC1_flg_ovrdflg KINP_CANMsgInvalidDKC1_flg_ovrdval /end REF_CHARACTERISTIC
/end GROUP
/begin GROUP S3225_CANMsgInvalidDKC2 "SWC_INP_type/run_SWC_INP_5ms_sys/INP/CAN4/CommunicationCheck/CANMsgInvalidDKC2"
 /begin REF_CHARACTERISTIC KINP_CANMsgInvalidDKC2_flg_ovrdflg KINP_CANMsgInvalidDKC2_flg_ovrdval /end REF_CHARACTERISTIC
/end GROUP
/begin GROUP S3225_CANMsgInvalidPTG1 "SWC_INP_type/run_SWC_INP_5ms_sys/INP/CAN4/CommunicationCheck/CANMsgInvalidPTG1"
 /begin REF_CHARACTERISTIC KINP_CANMsgInvalidPTG1_flg_ovrdflg KINP_CANMsgInvalidPTG1_flg_ovrdval /end REF_CHARACTERISTIC
/end GROUP
/begin GROUP S3225_CANMsgInvalidZONEDR1 "SWC_INP_type/run_SWC_INP_5ms_sys/INP/CAN4/CommunicationCheck/CANMsgInvalidZONEDR1"
 /begin REF_CHARACTERISTIC KINP_CANMsgInvalidZONEDR1_flg_ovrdflg KINP_CANMsgInvalidZONEDR1_flg_ovrdval /end REF_CHARACTERISTIC
/end GROUP
/begin GROUP S3225_CANMsgInvalidZONEDRVCU "SWC_INP_type/run_SWC_INP_5ms_sys/INP/CAN4/CommunicationCheck/CANMsgInvalidZONEDRVCU"
 /begin REF_CHARACTERISTIC KINP_CANMsgInvalidZONEDRVCU_flg_ovrdflg KINP_CANMsgInvalidZONEDRVCU_flg_ovrdval /end REF_CHARACTERISTIC
/end GROUP
/begin GROUP S3225_CANMsgInvalidZONEFR1 "SWC_INP_type/run_SWC_INP_5ms_sys/INP/CAN4/CommunicationCheck/CANMsgInvalidZONEFR1"
 /begin REF_CHARACTERISTIC KINP_CANMsgInvalidZONEFR1_flg_ovrdflg KINP_CANMsgInvalidZONEFR1_flg_ovrdval /end REF_CHARACTERISTIC
/end GROUP
/begin GROUP S3225_CANMsgInvalidZONEFRVCU "SWC_INP_type/run_SWC_INP_5ms_sys/INP/CAN4/CommunicationCheck/CANMsgInvalidZONEFRVCU"
 /begin REF_CHARACTERISTIC KINP_CANMsgInvalidZONEFRVCU_flg_ovrdflg KINP_CANMsgInvalidZONEFRVCU_flg_ovrdval /end REF_CHARACTERISTIC
/end GROUP
/begin GROUP S3225_CANMsgInvalidzGWAPTC1 "SWC_INP_type/run_SWC_INP_5ms_sys/INP/CAN4/CommunicationCheck/CANMsgInvalidzGWAPTC1"
 /begin REF_CHARACTERISTIC KINP_CANMsgInvalidzGWAPTC1_flg_ovrdflg KINP_CANMsgInvalidzGWAPTC1_flg_ovrdval /end REF_CHARACTERISTIC
/end GROUP
/begin GROUP S3225_CANMsgInvalidzGWCANFr1 "SWC_INP_type/run_SWC_INP_5ms_sys/INP/CAN4/CommunicationCheck/CANMsgInvalidzGWCANFr1"
 /begin REF_CHARACTERISTIC KINP_CANMsgInvalidzGWCANFr1_flg_ovrdflg KINP_CANMsgInvalidzGWCANFr1_flg_ovrdval /end REF_CHARACTERISTIC
/end GROUP
/begin GROUP S3225_CANMsgInvalidzGWLINDr1 "SWC_INP_type/run_SWC_INP_5ms_sys/INP/CAN4/CommunicationCheck/CANMsgInvalidzGWLINDr1"
 /begin REF_CHARACTERISTIC KINP_CANMsgInvalidzGWLINDr1_flg_ovrdflg KINP_CANMsgInvalidzGWLINDr1_flg_ovrdval /end REF_CHARACTERISTIC
/end GROUP
/begin GROUP S3225_CANMsgInvalidzGWLINDr2 "SWC_INP_type/run_SWC_INP_5ms_sys/INP/CAN4/CommunicationCheck/CANMsgInvalidzGWLINDr2"
 /begin REF_CHARACTERISTIC KINP_CANMsgInvalidzGWLINDr2_flg_ovrdflg KINP_CANMsgInvalidzGWLINDr2_flg_ovrdval /end REF_CHARACTERISTIC
/end GROUP
/begin GROUP S3225_CANMsgInvalidzGWLINFr1 "SWC_INP_type/run_SWC_INP_5ms_sys/INP/CAN4/CommunicationCheck/CANMsgInvalidzGWLINFr1"
 /begin REF_CHARACTERISTIC KINP_CANMsgInvalidzGWLINFr1_flg_ovrdflg KINP_CANMsgInvalidzGWLINFr1_flg_ovrdval /end REF_CHARACTERISTIC
/end GROUP
/begin GROUP S3225_CANMsgInvalidzGWLINFr2 "SWC_INP_type/run_SWC_INP_5ms_sys/INP/CAN4/CommunicationCheck/CANMsgInvalidzGWLINFr2"
 /begin REF_CHARACTERISTIC KINP_CANMsgInvalidzGWLINFr2_flg_ovrdflg KINP_CANMsgInvalidzGWLINFr2_flg_ovrdval /end REF_CHARACTERISTIC
/end GROUP
/begin GROUP S3225_CANMsgInvalidzGWSEAT1 "SWC_INP_type/run_SWC_INP_5ms_sys/INP/CAN4/CommunicationCheck/CANMsgInvalidzGWSEAT1"
 /begin REF_CHARACTERISTIC KINP_CANMsgInvalidzGWSEAT1_flg_ovrdflg KINP_CANMsgInvalidzGWSEAT1_flg_ovrdval /end REF_CHARACTERISTIC
/end GROUP
/begin GROUP S3227_BodyZone_DR1 "SWC_INP_type/run_SWC_INP_5ms_sys/INP/CAN4/SignalCheck/BodyZone_DR1"
 /begin SUB_GROUP S3300_BDDSEATAntiSta S3300_BDDSEATEntryFunSta S3300_BDDSEATErrorSta S3300_BDDSEATMemSetSta S3300_BDDSEATModeSta S3300_BDDSEATVentSta S3300_BDDSEATheaterSta /end SUB_GROUP
/end GROUP
/begin GROUP S3227_BodyZone_DR2 "SWC_INP_type/run_SWC_INP_5ms_sys/INP/CAN4/SignalCheck/BodyZone_DR2"
 /begin SUB_GROUP S3301_BDAPMWinFOpenedSta S3301_BDAPMWinROpenedSta S3301_BDDoorFHandleCloseSta S3301_BDDoorRHandleCloseSta /end SUB_GROUP
/end GROUP
/begin GROUP S3227_BodyZone_PS1 "SWC_INP_type/run_SWC_INP_5ms_sys/INP/CAN4/SignalCheck/BodyZone_PS1"
 /begin SUB_GROUP S3302_BPPSEATErrorSta S3302_BPPSEATModeSta S3302_BPPSEATVentSta S3302_BPPSEATheaterSta S3302_BPPTGActiveSta S3302_BPPTGExistSta S3302_BPPTGInsideSW1Sta S3302_BPPTGInsideSW2Sta S3302_BPPTGIsSetHeightSta S3302_BPPTGLeftHallPosnSta S3302_BPPTGOpenRatioSta S3302_BPPTGRDILCmd S3302_BPPTGSysSta /end SUB_GROUP
/end GROUP
/begin GROUP S3227_BodyZone_PS2 "SWC_INP_type/run_SWC_INP_5ms_sys/INP/CAN4/SignalCheck/BodyZone_PS2"
 /begin SUB_GROUP S3303_BPAPMWinFOpenedSta S3303_BPAPMWinROpenedSta S3303_BPDoorFHandleCloseSta S3303_BPDoorRHandleCloseSta S3303_BPSEATLVentSta S3303_BPSEATMLVentSta S3303_BPSEATMRVentSta S3303_BPSEATRVentSta /end SUB_GROUP
/end GROUP
/begin GROUP S3227_DKC1 "SWC_INP_type/run_SWC_INP_5ms_sys/INP/CAN4/SignalCheck/DKC1"
 /begin SUB_GROUP S3304_DKCKeyNumSta S3304_DKCKeyTypeSta S3304_DKCPDkeyAreaRAPSSta S3304_DKCParkingModeCmd S3304_DKCReVehData S3304_PCommandToBCM S3304_PCommandToPTG S3304_PDKeyAreaLockUnlock S3304_PDKeyAreaPS S3304_PDKeyAreaPTG S3304_PDKeyWelcome S3304_PDkeyShowIVI S3304_PKeyMiss S3304_PKeyMode S3304_PUIDLowPower /end SUB_GROUP
/end GROUP
/begin GROUP S3227_DKC2 "SWC_INP_type/run_SWC_INP_5ms_sys/INP/CAN4/SignalCheck/DKC2"
 /begin SUB_GROUP S3305_EncryptionDATA063 S3305_EncryptionDATA64127 S3305_RandomNumberX /end SUB_GROUP
/end GROUP
/begin GROUP S3227_PTG1 "SWC_INP_type/run_SWC_INP_5ms_sys/INP/CAN4/SignalCheck/PTG1"
 /begin SUB_GROUP S3306_PTGActiveSta S3306_PTGAutoStaus S3306_PTGExist S3306_PTGHWVer S3306_PTGInnerSW2 S3306_PTGIsSetHeight S3306_PTGOpenRatio S3306_PTGRDILSta S3306_PTGSWVer S3306_PTGSysSta /end SUB_GROUP
/end GROUP
/begin GROUP S3227_ZONE_DR1 "SWC_INP_type/run_SWC_INP_5ms_sys/INP/CAN4/SignalCheck/ZONE_DR1"
 /begin SUB_GROUP S3307_DrLockSta S3307_MIRRORFOLDSW S3307_RLTurnLPErr S3307_RLTurnLampC S3307_RRTurnLPErr S3307_RRTurnLampC S3307_RWiperAS S3307_RWiperProtection /end SUB_GROUP
/end GROUP
/begin GROUP S3227_ZONE_DR_VCU "SWC_INP_type/run_SWC_INP_5ms_sys/INP/CAN4/SignalCheck/ZONE_DR_VCU"
 /begin SUB_GROUP S3308_BlowerErr S3308_DrPMMLVOutPErrLmp S3308_DrPMMSysErrLmp S3308_DrSCPSysErrLmp S3308_DrStdAErrSta S3308_LeftHallPos S3308_SolarL S3308_SolarLErr S3308_SolarR S3308_SolarRErr S3308_TFaceL S3308_TFaceLErr S3308_TFaceR S3308_TFaceRErr S3308_TFaceRr S3308_TFaceRrErr S3308_TFootL S3308_TFootLErr S3308_TFootR S3308_TFootRErr S3308_TFootRr S3308_TFootRrErr S3308_Tevap S3308_TevapErr S3308_Tincar S3308_TincarErr S3308_ZoneDrMalfunLevel /end SUB_GROUP
/end GROUP
/begin GROUP S3227_ZONE_FR1 "SWC_INP_type/run_SWC_INP_5ms_sys/INP/CAN4/SignalCheck/ZONE_FR1"
 /begin SUB_GROUP S3309_ChargeInletLockSta S3309_CompProEN S3309_FLTurnLPErr S3309_FLTurnLampC S3309_FLTurnLightWarning S3309_FRTurnLPErr S3309_FRTurnLampC S3309_FRTurnLightWarning S3309_FWiperAS S3309_FWiperProtection S3309_LADBHibeamIndication S3309_LADBOperationStatus S3309_LADBWarning S3309_LAHBWarning S3309_LDRLWarning S3309_LLBWarning S3309_LpositionLampWarning S3309_RADBHibeamIndication S3309_RADBOperationStatus S3309_RADBWarning S3309_RAHBWarning S3309_RDRLWarning S3309_RLBWarning S3309_RpositionLampWarning S3309_TrailerCheck S3309_TrailerModeSta S3309_ZFRBCMChargerDoorSWSta S3309_ZFRBCMHRLTurnLPNormalSta S3309_ZFRBCMHRRTurnLPHNormalSta S3309_ZFRTHCMCLEVentActYSta S3309_ZFRTHCMCREVentActYSta S3309_ZFRTHCMLEVentActYSta S3309_ZFRTHCMREVentActYSta /end SUB_GROUP
/end GROUP
/begin GROUP S3227_ZONE_FR_VCU "SWC_INP_type/run_SWC_INP_5ms_sys/INP/CAN4/SignalCheck/ZONE_FR_VCU"
 /begin SUB_GROUP S3310_AGSErr S3310_BatInTemp S3310_BatInTempErr S3310_BatOutTemp S3310_COMPErr S3310_EACProtectEnable S3310_EWP3Err S3310_EXV1Err S3310_EXV2Err S3310_FanErr S3310_FrPMMLimpHomeActReq S3310_MotorInTemp S3310_MotorInTempErr S3310_MotorOutTemp S3310_MotorOutTempErr S3310_PTHighP S3310_PTHighPErr S3310_PTHighTact S3310_PTHighTactErr S3310_PTLowP1 S3310_PTLowP1Err S3310_PTLowP2 S3310_PTLowP2Err S3310_PTLowT1 S3310_PTLowT1Err S3310_PTLowT2 S3310_PTLowT2Err S3310_SOTXVErr S3310_SOV1Err S3310_SOV2Err S3310_SOV3Err S3310_Tamb S3310_TambErr /end SUB_GROUP
/end GROUP
/begin GROUP S3227_zGW_APTC1 "SWC_INP_type/run_SWC_INP_5ms_sys/INP/CAN4/SignalCheck/zGW_APTC1"
 /begin SUB_GROUP S3311_FrntPTCLeActHeatPwr S3311_FrntPTCRearLeActHeatPwr S3311_FrntPTCRearRiActHeatPwr S3311_FrntPTCRiActHeatPwr /end SUB_GROUP
/end GROUP
/begin GROUP S3227_zGW_CANFr1 "SWC_INP_type/run_SWC_INP_5ms_sys/INP/CAN4/SignalCheck/zGW_CANFr1"
 /begin SUB_GROUP S3312_COMPActualPwr S3312_COMPConCur S3312_COMPConVolt S3312_COMPStatorSpd S3312_PTC1PowerConsumption /end SUB_GROUP
/end GROUP
/begin GROUP S3227_zGW_LINDr1 "SWC_INP_type/run_SWC_INP_5ms_sys/INP/CAN4/SignalCheck/zGW_LINDr1"
 /begin SUB_GROUP S3313_CSWDimSw S3313_CSWFWasSwSta S3313_CSWFWipSwSta S3313_CSWPassSWSta S3313_CSWRWasSWSta S3313_CSWRWipIntSwSta S3313_CSWTurnSwSta S3313_FAPWL01LINResponseError S3313_LDrvMotorRelayError S3313_LDrvMotorRippleError S3313_LDrvValWdwOpened S3313_LDrvWdwPositionSts S3313_LPasMotorRelayError S3313_LPasMotorRippleError S3313_LPasValWdwOpened S3313_LPasWdwPositionSts S3313_LRLDMotorRelayError S3313_LRLDMotorRippleError S3313_LRLDValWdwOpened S3313_LRLDWdwPositionSts S3313_LRRDMotorRelayError S3313_LRRDMotorRippleError S3313_LRRDValWdwOpened S3313_LRRDWdwPositionSts S3313_RAPWL01LINResponseError S3313_RLSLampSta S3313_RLSRainSnrWiperCmd S3313_SWC2LADASSta S3313_SWC2LDriveModeSta S3313_SWC2LHomeSta S3313_SWC2LLeftSta S3313_SWC2LRegenUpSta S3313_SWC2LRightSta S3313_SWC2LScrollDownSta S3313_SWC2LScrollPressSta S3313_SWC2LScrollUpSta S3313_SWC2RCustomizeSta S3313_SWC2RLeftSta S3313_SWC2RPageSwitchSta S3313_SWC2RRegenDownSta S3313_SWC2RRightSta S3313_SWC2RScrollDownSta S3313_SWC2RScrollPressSta S3313_SWC2RScrollUpSta S3313_SWC2RVRSta S3313_SWCACCSta S3313_SWCCANCELSta S3313_SWCDistanceSta S3313_SWCDownSta S3313_SWCLKASta S3313_SWCLeftSta S3313_SWCRegenDown S3313_SWCRegenUp S3313_SWCResUpSta S3313_SWCRightSta S3313_SWCSetdownSta S3313_SWCTripSta S3313_SWCUndefinedSta S3313_SWCUpSta S3313_SWCVRSta S3313_SWCmodeSta /end SUB_GROUP
/end GROUP
/begin GROUP S3227_zGW_LINDr2 "SWC_INP_type/run_SWC_INP_5ms_sys/INP/CAN4/SignalCheck/zGW_LINDr2" /begin SUB_GROUP S3314_ACT1ResponseError /end SUB_GROUP /end GROUP
/begin GROUP S3227_zGW_LINFr1 "SWC_INP_type/run_SWC_INP_5ms_sys/INP/CAN4/SignalCheck/zGW_LINFr1" /begin SUB_GROUP S3315_AGSActualPosition S3315_FGSIntenRspSta /end SUB_GROUP /end GROUP
/begin GROUP S3227_zGW_LINFr2 "SWC_INP_type/run_SWC_INP_5ms_sys/INP/CAN4/SignalCheck/zGW_LINFr2"
 /begin SUB_GROUP S3316_EWP1BlockError S3316_EWP1OverCurrError S3316_EWP2BlockError S3316_EWP2OverCurrError S3316_EWP3BlockError S3316_EWP3OverCurrError /end SUB_GROUP
/end GROUP
/begin GROUP S3227_zGW_SEAT1 "SWC_INP_type/run_SWC_INP_5ms_sys/INP/CAN4/SignalCheck/zGW_SEAT1"
 /begin SUB_GROUP S3317_DSEATAntiSta S3317_DSEATEntryFunSta S3317_DSEATErrorSta S3317_DSEATHWVer S3317_DSEATMode S3317_DSEATSWVer S3317_DSEATVentSta S3317_DSEATheatersta S3317_PSEATErrorSta S3317_PSEATHWVer S3317_PSEATMode S3317_PSEATSWVer S3317_PSEATVentSta S3317_PSEATheatersta /end SUB_GROUP
/end GROUP
/begin GROUP S4588_CANMsgInvalidTBOX2 "SWC_INP_type/run_SWC_INP_5ms_sys/INP/CAN5/CommunicationCheck/CANMsgInvalidTBOX2"
 /begin REF_CHARACTERISTIC KINP_CANMsgInvalidTBOX2_flg_ovrdflg KINP_CANMsgInvalidTBOX2_flg_ovrdval /end REF_CHARACTERISTIC
/end GROUP
/begin GROUP S4588_CANMsgInvalidTBOX3 "SWC_INP_type/run_SWC_INP_5ms_sys/INP/CAN5/CommunicationCheck/CANMsgInvalidTBOX3"
 /begin REF_CHARACTERISTIC KINP_CANMsgInvalidTBOX3_flg_ovrdflg KINP_CANMsgInvalidTBOX3_flg_ovrdval /end REF_CHARACTERISTIC
/end GROUP
/begin GROUP S4590_TBOX2 "SWC_INP_type/run_SWC_INP_5ms_sys/INP/CAN5/SignalCheck/TBOX2"
 /begin SUB_GROUP S4599_TimeSyncFromBSDay S4599_TimeSyncFromBSHour S4599_TimeSyncFromBSMinute S4599_TimeSyncFromBSMonth S4599_TimeSyncFromBSSecond S4599_TimeSyncFromBSYear /end SUB_GROUP
/end GROUP
/begin GROUP S4590_TBOX3 "SWC_INP_type/run_SWC_INP_5ms_sys/INP/CAN5/SignalCheck/TBOX3"
 /begin SUB_GROUP S4600_ChargePercentSet S4600_ReserveChargeOFFDay S4600_ReserveChargeOFFHour S4600_ReserveChargeOFFMinute S4600_ReserveChargeOFFMonth S4600_ReserveChargeOFFYear S4600_ReserveChargeOnDay S4600_ReserveChargeOnHour S4600_ReserveChargeOnMinute S4600_ReserveChargeOnMonth S4600_ReserveChargeOnYear S4600_TBOXHWVER S4600_TBOXSWVER /end SUB_GROUP
/end GROUP
/begin GROUP S4696_CANMsgInvalidFCM1 "SWC_INP_type/run_SWC_INP_5ms_sys/INP/CAN6/CommunicationCheck/CANMsgInvalidFCM1"
 /begin REF_CHARACTERISTIC KINP_CANMsgInvalidFCM1_flg_ovrdflg KINP_CANMsgInvalidFCM1_flg_ovrdval /end REF_CHARACTERISTIC
/end GROUP
/begin GROUP S4696_CANMsgInvalidFCM2 "SWC_INP_type/run_SWC_INP_5ms_sys/INP/CAN6/CommunicationCheck/CANMsgInvalidFCM2"
 /begin REF_CHARACTERISTIC KINP_CANMsgInvalidFCM2_flg_ovrdflg KINP_CANMsgInvalidFCM2_flg_ovrdval /end REF_CHARACTERISTIC
/end GROUP
/begin GROUP S4696_CANMsgInvalidFCM3 "SWC_INP_type/run_SWC_INP_5ms_sys/INP/CAN6/CommunicationCheck/CANMsgInvalidFCM3"
 /begin REF_CHARACTERISTIC KINP_CANMsgInvalidFCM3_flg_ovrdflg KINP_CANMsgInvalidFCM3_flg_ovrdval /end REF_CHARACTERISTIC
/end GROUP
/begin GROUP S4696_CANMsgInvalidFCM4 "SWC_INP_type/run_SWC_INP_5ms_sys/INP/CAN6/CommunicationCheck/CANMsgInvalidFCM4"
 /begin REF_CHARACTERISTIC KINP_CANMsgInvalidFCM4_flg_ovrdflg KINP_CANMsgInvalidFCM4_flg_ovrdval /end REF_CHARACTERISTIC
/end GROUP
/begin GROUP S4696_CANMsgInvalidSRR1 "SWC_INP_type/run_SWC_INP_5ms_sys/INP/CAN6/CommunicationCheck/CANMsgInvalidSRR1"
 /begin REF_CHARACTERISTIC KINP_CANMsgInvalidSRR1_flg_ovrdflg KINP_CANMsgInvalidSRR1_flg_ovrdval /end REF_CHARACTERISTIC
/end GROUP
/begin GROUP S4698_FCM1 "SWC_INP_type/run_SWC_INP_5ms_sys/INP/CAN6/SignalCheck/FCM1"
 /begin SUB_GROUP S4719_ACCComfortBandLower S4719_ACCComfortBandUpper S4719_ACCJerkLowerLimit S4719_ACCJerkUpperLimit S4719_ACCObjDist S4719_ACCObjDstLvl S4719_ACCObjRelSpd S4719_ACCRequiredAccel S4719_ACCTakeoverReq S4719_ACCVehHoldReq S4719_ADASACCSta S4719_ADASAEBReq S4719_ADASAEBSta S4719_ADASCAMSpdLim S4719_ADASDBSReq S4719_ADASFCWMute S4719_ADASFCWSta S4719_ADASFaultSta S4719_ADASFltWrnReq S4719_ADASForceIdle S4719_ADASISASta S4719_ADASLDWMute S4719_ADASLDWSta S4719_ADASLFCHandsOffWarning S4719_ADASLFCSta S4719_ADASLFCWarnSound S4719_ADASLKASta S4719_ADASLaneModeL S4719_ADASLaneModeR S4719_ADASLanecurveL S4719_ADASLanecurveR S4719_ADASLanetypeL S4719_ADASLanetypeR S4719_ADASSLIFSpdLim S4719_ADASSLIFSta S4719_ADASShftPosnReq S4719_ADASShftPosnReqA S4719_ADASVehSpdLim S4719_ADASWarningMsg S4719_AEBVehHoldReq S4719_CameraBlockage S4719_FCM1Checksum S4719_FCM1LifeCount S4719_FCMACCmode S4719_FCMLKAStrToqReq S4719_FCMLKATOIAct S4719_FCMLKATOIFault S4719_ForceLowBeam S4719_HazardWarningReq S4719_ISAWarningMsg S4719_LKAHODDisplayWarning S4719_LKAHODSoundWarning S4719_LVDAACCStatusInformation S4719_LVDADisabled S4719_LVDAFailinfo S4719_LVDAMuteSta S4719_LVDAWarning S4719_LeftTurnLightReq S4719_RightTurnLightReq S4719_TargetType S4719_TimeGapLevel /end SUB_GROUP
/end GROUP
/begin GROUP S4698_FCM2 "SWC_INP_type/run_SWC_INP_5ms_sys/INP/CAN6/SignalCheck/FCM2" /begin SUB_GROUP S4720_ADBVehDst1Val S4720_FCM2CSErr S4720_FCM2RCErr /end SUB_GROUP /end GROUP
/begin GROUP S4698_FCM3 "SWC_INP_type/run_SWC_INP_5ms_sys/INP/CAN6/SignalCheck/FCM3"
 /begin SUB_GROUP S4721_MELaneCurvDervLt S4721_MELaneCurvDervLt2 S4721_MELaneCurvDervRt S4721_MELaneCurvDervRt2 S4721_MELaneCurvLt S4721_MELaneCurvLt2 S4721_MELaneCurvRt S4721_MELaneCurvRt2 S4721_MELaneHeadAngLt S4721_MELaneHeadAngLt2 S4721_MELaneHeadAngRt S4721_MELaneHeadAngRt2 S4721_MELanePosLt S4721_MELanePosLt2 S4721_MELanePosRt S4721_MELanePosRt2 /end SUB_GROUP
/end GROUP
/begin GROUP S4698_FCM4 "SWC_INP_type/run_SWC_INP_5ms_sys/INP/CAN6/SignalCheck/FCM4"
 /begin SUB_GROUP S4722_ADASAngCtrlTqWeightGain S4722_ADASDesStrWhlAngCtrlCmd S4722_ADASDrvInputTqBoostAct S4722_ADASDrvInputTqBoostGain S4722_ADASMaxAngCtrlOutTqLimit S4722_ADASStrWhlAngCtrlStatus S4722_FCM4CSErr S4722_FCM4RCErr /end SUB_GROUP
/end GROUP
/begin GROUP S4698_SRR1 "SWC_INP_type/run_SWC_INP_5ms_sys/INP/CAN6/SignalCheck/SRR1"
 /begin SUB_GROUP S4723_SRRBSDWarnL S4723_SRRBSDWarnR S4723_SRRODASoundL S4723_SRRODASoundR S4723_SRRODAWarnL S4723_SRRODAWarnR /end SUB_GROUP
/end GROUP
/begin GROUP S5221_AccelPedal1Vol_V "SWC_INP_type/run_SWC_INP_5ms_sys/INP/GPIO/Analog/AccelPedal1Vol_V" /begin SUB_GROUP S5223_ad_signal_process /end SUB_GROUP
 /begin REF_CHARACTERISTIC KINP_AccelPedal1Vol_V_defval KINP_AccelPedal1Vol_V_fftdec KINP_AccelPedal1Vol_V_fftinc KINP_AccelPedal1Vol_V_fftlim KINP_AccelPedal1Vol_V_limlow KINP_AccelPedal1Vol_V_limupr KINP_AccelPedal1Vol_V_ovrdflg KINP_AccelPedal1Vol_V_ovrdval KINP_AccelPedal1Vol_V_srvcflg KINP_AccelPedal1Vol_V_srvcval KINP_AccelPedal1Vol_V_tcfilt /end REF_CHARACTERISTIC
/end GROUP
/begin GROUP S5221_AccelPedal2Vol_V "SWC_INP_type/run_SWC_INP_5ms_sys/INP/GPIO/Analog/AccelPedal2Vol_V" /begin SUB_GROUP S5224_ad_signal_process /end SUB_GROUP
 /begin REF_CHARACTERISTIC KINP_AccelPedal2Vol_V_defval KINP_AccelPedal2Vol_V_fftdec KINP_AccelPedal2Vol_V_fftinc KINP_AccelPedal2Vol_V_fftlim KINP_AccelPedal2Vol_V_limlow KINP_AccelPedal2Vol_V_limupr KINP_AccelPedal2Vol_V_ovrdflg KINP_AccelPedal2Vol_V_ovrdval KINP_AccelPedal2Vol_V_srvcflg KINP_AccelPedal2Vol_V_srvcval KINP_AccelPedal2Vol_V_tcfilt /end REF_CHARACTERISTIC
/end GROUP
/begin GROUP S5222_BrakeLampSW "SWC_INP_type/run_SWC_INP_5ms_sys/INP/GPIO/Digital/BrakeLampSW"
 /begin REF_CHARACTERISTIC KINP_BrakeLampSW_flg_debdec KINP_BrakeLampSW_flg_debinc KINP_BrakeLampSW_flg_deblim KINP_BrakeLampSW_flg_inverse KINP_BrakeLampSW_flg_ovrdflg KINP_BrakeLampSW_flg_ovrdval KINP_BrakeLampSW_flg_srvcflg KINP_BrakeLampSW_flg_srvcval /end REF_CHARACTERISTIC
/end GROUP
/begin GROUP S5222_BrakeSWGPIO "SWC_INP_type/run_SWC_INP_5ms_sys/INP/GPIO/Digital/BrakeSWGPIO"
 /begin REF_CHARACTERISTIC KINP_BrakeSWGPIO_flg_debdec KINP_BrakeSWGPIO_flg_debinc KINP_BrakeSWGPIO_flg_deblim KINP_BrakeSWGPIO_flg_inverse KINP_BrakeSWGPIO_flg_ovrdflg KINP_BrakeSWGPIO_flg_ovrdval KINP_BrakeSWGPIO_flg_srvcflg KINP_BrakeSWGPIO_flg_srvcval /end REF_CHARACTERISTIC
/end GROUP
/begin GROUP S5222_CentralDoorLockSW "SWC_INP_type/run_SWC_INP_5ms_sys/INP/GPIO/Digital/CentralDoorLockSW"
 /begin REF_CHARACTERISTIC KINP_CentralDoorLockSW_flg_debdec KINP_CentralDoorLockSW_flg_debinc KINP_CentralDoorLockSW_flg_deblim KINP_CentralDoorLockSW_flg_inverse KINP_CentralDoorLockSW_flg_ovrdflg KINP_CentralDoorLockSW_flg_ovrdval KINP_CentralDoorLockSW_flg_srvcflg KINP_CentralDoorLockSW_flg_srvcval /end REF_CHARACTERISTIC
/end GROUP
/begin GROUP S5222_CrashSignalGPIO "SWC_INP_type/run_SWC_INP_5ms_sys/INP/GPIO/Digital/CrashSignalGPIO"
 /begin REF_CHARACTERISTIC KINP_CrashSignalGPIO_flg_debdec KINP_CrashSignalGPIO_flg_debinc KINP_CrashSignalGPIO_flg_deblim KINP_CrashSignalGPIO_flg_inverse KINP_CrashSignalGPIO_flg_ovrdflg KINP_CrashSignalGPIO_flg_ovrdval KINP_CrashSignalGPIO_flg_srvcflg KINP_CrashSignalGPIO_flg_srvcval /end REF_CHARACTERISTIC
/end GROUP
/begin GROUP S5222_DrDoorSW "SWC_INP_type/run_SWC_INP_5ms_sys/INP/GPIO/Digital/DrDoorSW"
 /begin REF_CHARACTERISTIC KINP_DrDoorSW_flg_debdec KINP_DrDoorSW_flg_debinc KINP_DrDoorSW_flg_deblim KINP_DrDoorSW_flg_inverse KINP_DrDoorSW_flg_ovrdflg KINP_DrDoorSW_flg_ovrdval KINP_DrDoorSW_flg_srvcflg KINP_DrDoorSW_flg_srvcval /end REF_CHARACTERISTIC
/end GROUP
/begin GROUP S5222_HazardSW "SWC_INP_type/run_SWC_INP_5ms_sys/INP/GPIO/Digital/HazardSW"
 /begin REF_CHARACTERISTIC KINP_HazardSW_flg_debdec KINP_HazardSW_flg_debinc KINP_HazardSW_flg_deblim KINP_HazardSW_flg_inverse KINP_HazardSW_flg_ovrdflg KINP_HazardSW_flg_ovrdval KINP_HazardSW_flg_srvcflg KINP_HazardSW_flg_srvcval /end REF_CHARACTERISTIC
/end GROUP
/begin GROUP S5222_HoodSW "SWC_INP_type/run_SWC_INP_5ms_sys/INP/GPIO/Digital/HoodSW"
 /begin REF_CHARACTERISTIC KINP_HoodSW_flg_debdec KINP_HoodSW_flg_debinc KINP_HoodSW_flg_deblim KINP_HoodSW_flg_inverse KINP_HoodSW_flg_ovrdflg KINP_HoodSW_flg_ovrdval KINP_HoodSW_flg_srvcflg KINP_HoodSW_flg_srvcval /end REF_CHARACTERISTIC
/end GROUP
/begin GROUP S5222_PsDoorSW "SWC_INP_type/run_SWC_INP_5ms_sys/INP/GPIO/Digital/PsDoorSW"
 /begin REF_CHARACTERISTIC KINP_PsDoorSW_flg_debdec KINP_PsDoorSW_flg_debinc KINP_PsDoorSW_flg_deblim KINP_PsDoorSW_flg_inverse KINP_PsDoorSW_flg_ovrdflg KINP_PsDoorSW_flg_ovrdval KINP_PsDoorSW_flg_srvcflg KINP_PsDoorSW_flg_srvcval /end REF_CHARACTERISTIC
/end GROUP
/begin GROUP S5222_RLDoorSW "SWC_INP_type/run_SWC_INP_5ms_sys/INP/GPIO/Digital/RLDoorSW"
 /begin REF_CHARACTERISTIC KINP_RLDoorSW_flg_debdec KINP_RLDoorSW_flg_debinc KINP_RLDoorSW_flg_deblim KINP_RLDoorSW_flg_inverse KINP_RLDoorSW_flg_ovrdflg KINP_RLDoorSW_flg_ovrdval KINP_RLDoorSW_flg_srvcflg KINP_RLDoorSW_flg_srvcval /end REF_CHARACTERISTIC
/end GROUP
/begin GROUP S5222_RRDoorSW "SWC_INP_type/run_SWC_INP_5ms_sys/INP/GPIO/Digital/RRDoorSW"
 /begin REF_CHARACTERISTIC KINP_RRDoorSW_flg_debdec KINP_RRDoorSW_flg_debinc KINP_RRDoorSW_flg_deblim KINP_RRDoorSW_flg_inverse KINP_RRDoorSW_flg_ovrdflg KINP_RRDoorSW_flg_ovrdval KINP_RRDoorSW_flg_srvcflg KINP_RRDoorSW_flg_srvcval /end REF_CHARACTERISTIC
/end GROUP
/begin GROUP S5222_SeatSW "SWC_INP_type/run_SWC_INP_5ms_sys/INP/GPIO/Digital/SeatSW"
 /begin REF_CHARACTERISTIC KINP_SeatSW_flg_debdec KINP_SeatSW_flg_debinc KINP_SeatSW_flg_deblim KINP_SeatSW_flg_inverse KINP_SeatSW_flg_ovrdflg KINP_SeatSW_flg_ovrdval KINP_SeatSW_flg_srvcflg KINP_SeatSW_flg_srvcval /end REF_CHARACTERISTIC
/end GROUP
/begin GROUP S5222_TailgateSW "SWC_INP_type/run_SWC_INP_5ms_sys/INP/GPIO/Digital/TailgateSW"
 /begin REF_CHARACTERISTIC KINP_TailgateSW_flg_debdec KINP_TailgateSW_flg_debinc KINP_TailgateSW_flg_deblim KINP_TailgateSW_flg_inverse KINP_TailgateSW_flg_ovrdflg KINP_TailgateSW_flg_ovrdval KINP_TailgateSW_flg_srvcflg KINP_TailgateSW_flg_srvcval /end REF_CHARACTERISTIC
/end GROUP
/begin GROUP S5222_TrunkHanSW "SWC_INP_type/run_SWC_INP_5ms_sys/INP/GPIO/Digital/TrunkHanSW"
 /begin REF_CHARACTERISTIC KINP_TrunkHanSW_flg_debdec KINP_TrunkHanSW_flg_debinc KINP_TrunkHanSW_flg_deblim KINP_TrunkHanSW_flg_inverse KINP_TrunkHanSW_flg_ovrdflg KINP_TrunkHanSW_flg_ovrdval KINP_TrunkHanSW_flg_srvcflg KINP_TrunkHanSW_flg_srvcval /end REF_CHARACTERISTIC
/end GROUP
/begin GROUP S103_ABM1CSErr "SWC_INP_type/run_SWC_INP_5ms_sys/INP/CAN1/SignalCheck/ABM1/ABM1CSErr"
 /begin REF_CHARACTERISTIC KINP_ABM1CSErr_flg_defval KINP_ABM1CSErr_flg_ovrdflg KINP_ABM1CSErr_flg_ovrdval /end REF_CHARACTERISTIC
/end GROUP
/begin GROUP S103_ABM1RCErr "SWC_INP_type/run_SWC_INP_5ms_sys/INP/CAN1/SignalCheck/ABM1/ABM1RCErr"
 /begin REF_CHARACTERISTIC KINP_ABM1RCErr_flg_defval KINP_ABM1RCErr_flg_ovrdflg KINP_ABM1RCErr_flg_ovrdval /end REF_CHARACTERISTIC
/end GROUP
/begin GROUP S103_ABMPassengerODSSta "SWC_INP_type/run_SWC_INP_5ms_sys/INP/CAN1/SignalCheck/ABM1/ABMPassengerODSSta"
 /begin REF_CHARACTERISTIC KINP_ABMPassengerODSSta_flg_defval KINP_ABMPassengerODSSta_flg_ovrdflg KINP_ABMPassengerODSSta_flg_ovrdval /end REF_CHARACTERISTIC
/end GROUP
/begin GROUP S103_ABMRearPassengerCTRODSSta "SWC_INP_type/run_SWC_INP_5ms_sys/INP/CAN1/SignalCheck/ABM1/ABMRearPassengerCTRODSSta"
 /begin REF_CHARACTERISTIC KINP_ABMRearPassengerCTRODSSta_flg_defval KINP_ABMRearPassengerCTRODSSta_flg_ovrdflg KINP_ABMRearPassengerCTRODSSta_flg_ovrdval /end REF_CHARACTERISTIC
/end GROUP
/begin GROUP S103_ABMRearPassengerLHODSSta "SWC_INP_type/run_SWC_INP_5ms_sys/INP/CAN1/SignalCheck/ABM1/ABMRearPassengerLHODSSta"
 /begin REF_CHARACTERISTIC KINP_ABMRearPassengerLHODSSta_flg_defval KINP_ABMRearPassengerLHODSSta_flg_ovrdflg KINP_ABMRearPassengerLHODSSta_flg_ovrdval /end REF_CHARACTERISTIC
/end GROUP
/begin GROUP S103_ABMRearPassengerRHODSSta "SWC_INP_type/run_SWC_INP_5ms_sys/INP/CAN1/SignalCheck/ABM1/ABMRearPassengerRHODSSta"
 /begin REF_CHARACTERISTIC KINP_ABMRearPassengerRHODSSta_flg_defval KINP_ABMRearPassengerRHODSSta_flg_ovrdflg KINP_ABMRearPassengerRHODSSta_flg_ovrdval /end REF_CHARACTERISTIC
/end GROUP
/begin GROUP S103_AirBagFailCmd "SWC_INP_type/run_SWC_INP_5ms_sys/INP/CAN1/SignalCheck/ABM1/AirBagFailCmd"
 /begin REF_CHARACTERISTIC KINP_AirBagFailCmd_flg_defval KINP_AirBagFailCmd_flg_ovrdflg KINP_AirBagFailCmd_flg_ovrdval /end REF_CHARACTERISTIC
/end GROUP
/begin GROUP S103_ChecksumABM1 "SWC_INP_type/run_SWC_INP_5ms_sys/INP/CAN1/SignalCheck/ABM1/ChecksumABM1"
 /begin REF_CHARACTERISTIC KINP_ChecksumABM1_enum_defval KINP_ChecksumABM1_enum_ovrdflg KINP_ChecksumABM1_enum_ovrdval /end REF_CHARACTERISTIC
/end GROUP
/begin GROUP S103_CrashOutputSts "SWC_INP_type/run_SWC_INP_5ms_sys/INP/CAN1/SignalCheck/ABM1/CrashOutputSts"
 /begin REF_CHARACTERISTIC KINP_CrashOutputSts_enum_defval KINP_CrashOutputSts_enum_ovrdflg KINP_CrashOutputSts_enum_ovrdval /end REF_CHARACTERISTIC
/end GROUP
/begin GROUP S103_DriverSeatBeltCmd "SWC_INP_type/run_SWC_INP_5ms_sys/INP/CAN1/SignalCheck/ABM1/DriverSeatBeltCmd"
 /begin REF_CHARACTERISTIC KINP_DriverSeatBeltCmd_flg_defval KINP_DriverSeatBeltCmd_flg_ovrdflg KINP_DriverSeatBeltCmd_flg_ovrdval /end REF_CHARACTERISTIC
/end GROUP
/begin GROUP S103_LifeCountABM1 "SWC_INP_type/run_SWC_INP_5ms_sys/INP/CAN1/SignalCheck/ABM1/LifeCountABM1"
 /begin REF_CHARACTERISTIC KINP_LifeCountABM1_enum_defval KINP_LifeCountABM1_enum_ovrdflg KINP_LifeCountABM1_enum_ovrdval /end REF_CHARACTERISTIC
/end GROUP
/begin GROUP S103_PABSwitchCmd "SWC_INP_type/run_SWC_INP_5ms_sys/INP/CAN1/SignalCheck/ABM1/PABSwitchCmd"
 /begin REF_CHARACTERISTIC KINP_PABSwitchCmd_flg_defval KINP_PABSwitchCmd_flg_ovrdflg KINP_PABSwitchCmd_flg_ovrdval /end REF_CHARACTERISTIC
/end GROUP
/begin GROUP S103_PsngrSeatBeltCmd "SWC_INP_type/run_SWC_INP_5ms_sys/INP/CAN1/SignalCheck/ABM1/PsngrSeatBeltCmd"
 /begin REF_CHARACTERISTIC KINP_PsngrSeatBeltCmd_flg_defval KINP_PsngrSeatBeltCmd_flg_ovrdflg KINP_PsngrSeatBeltCmd_flg_ovrdval /end REF_CHARACTERISTIC
/end GROUP
/begin GROUP S103_RCenterSeatBeltCmd "SWC_INP_type/run_SWC_INP_5ms_sys/INP/CAN1/SignalCheck/ABM1/RCenterSeatBeltCmd"
 /begin REF_CHARACTERISTIC KINP_RCenterSeatBeltCmd_flg_defval KINP_RCenterSeatBeltCmd_flg_ovrdflg KINP_RCenterSeatBeltCmd_flg_ovrdval /end REF_CHARACTERISTIC
/end GROUP
/begin GROUP S103_RDriverSeatBeltCmd "SWC_INP_type/run_SWC_INP_5ms_sys/INP/CAN1/SignalCheck/ABM1/RDriverSeatBeltCmd"
 /begin REF_CHARACTERISTIC KINP_RDriverSeatBeltCmd_flg_defval KINP_RDriverSeatBeltCmd_flg_ovrdflg KINP_RDriverSeatBeltCmd_flg_ovrdval /end REF_CHARACTERISTIC
/end GROUP
/begin GROUP S103_RPsngrSeatBeltCmd "SWC_INP_type/run_SWC_INP_5ms_sys/INP/CAN1/SignalCheck/ABM1/RPsngrSeatBeltCmd"
 /begin REF_CHARACTERISTIC KINP_RPsngrSeatBeltCmd_flg_defval KINP_RPsngrSeatBeltCmd_flg_ovrdflg KINP_RPsngrSeatBeltCmd_flg_ovrdval /end REF_CHARACTERISTIC
/end GROUP
/begin GROUP S103_TLHPsngrSeatBeltCmd "SWC_INP_type/run_SWC_INP_5ms_sys/INP/CAN1/SignalCheck/ABM1/TLHPsngrSeatBeltCmd"
 /begin REF_CHARACTERISTIC KINP_TLHPsngrSeatBeltCmd_flg_defval KINP_TLHPsngrSeatBeltCmd_flg_ovrdflg KINP_TLHPsngrSeatBeltCmd_flg_ovrdval /end REF_CHARACTERISTIC
/end GROUP
/begin GROUP S103_TRHPsngrSeatBeltCmd "SWC_INP_type/run_SWC_INP_5ms_sys/INP/CAN1/SignalCheck/ABM1/TRHPsngrSeatBeltCmd"
 /begin REF_CHARACTERISTIC KINP_TRHPsngrSeatBeltCmd_flg_defval KINP_TRHPsngrSeatBeltCmd_flg_ovrdflg KINP_TRHPsngrSeatBeltCmd_flg_ovrdval /end REF_CHARACTERISTIC
/end GROUP
/begin GROUP S104_DOASta "SWC_INP_type/run_SWC_INP_5ms_sys/INP/CAN1/SignalCheck/EPB1/DOASta"
 /begin REF_CHARACTERISTIC KINP_DOASta_flg_defval KINP_DOASta_flg_ovrdflg KINP_DOASta_flg_ovrdval /end REF_CHARACTERISTIC
/end GROUP
/begin GROUP S104_EPB1CSErr "SWC_INP_type/run_SWC_INP_5ms_sys/INP/CAN1/SignalCheck/EPB1/EPB1CSErr"
 /begin REF_CHARACTERISTIC KINP_EPB1CSErr_flg_defval KINP_EPB1CSErr_flg_ovrdflg KINP_EPB1CSErr_flg_ovrdval /end REF_CHARACTERISTIC
/end GROUP
/begin GROUP S104_EPB1RC "SWC_INP_type/run_SWC_INP_5ms_sys/INP/CAN1/SignalCheck/EPB1/EPB1RC"
 /begin REF_CHARACTERISTIC KINP_EPB1RC_enum_defval KINP_EPB1RC_enum_ovrdflg KINP_EPB1RC_enum_ovrdval /end REF_CHARACTERISTIC
/end GROUP
/begin GROUP S104_EPB1RCErr "SWC_INP_type/run_SWC_INP_5ms_sys/INP/CAN1/SignalCheck/EPB1/EPB1RCErr"
 /begin REF_CHARACTERISTIC KINP_EPB1RCErr_flg_defval KINP_EPB1RCErr_flg_ovrdflg KINP_EPB1RCErr_flg_ovrdval /end REF_CHARACTERISTIC
/end GROUP
/begin GROUP S104_EPBCarWashMode "SWC_INP_type/run_SWC_INP_5ms_sys/INP/CAN1/SignalCheck/EPB1/EPBCarWashMode"
 /begin REF_CHARACTERISTIC KINP_EPBCarWashMode_flg_defval KINP_EPBCarWashMode_flg_ovrdflg KINP_EPBCarWashMode_flg_ovrdval /end REF_CHARACTERISTIC
/end GROUP
/begin GROUP S104_EPBErrSta "SWC_INP_type/run_SWC_INP_5ms_sys/INP/CAN1/SignalCheck/EPB1/EPBErrSta"
 /begin REF_CHARACTERISTIC KINP_EPBErrSta_enum_defval KINP_EPBErrSta_enum_ovrdflg KINP_EPBErrSta_enum_ovrdval /end REF_CHARACTERISTIC
/end GROUP
/begin GROUP S104_EPBExtApplyAvail "SWC_INP_type/run_SWC_INP_5ms_sys/INP/CAN1/SignalCheck/EPB1/EPBExtApplyAvail"
 /begin REF_CHARACTERISTIC KINP_EPBExtApplyAvail_flg_defval KINP_EPBExtApplyAvail_flg_ovrdflg KINP_EPBExtApplyAvail_flg_ovrdval /end REF_CHARACTERISTIC
/end GROUP
/begin GROUP S104_EPBExtReleaseAvail "SWC_INP_type/run_SWC_INP_5ms_sys/INP/CAN1/SignalCheck/EPB1/EPBExtReleaseAvail"
 /begin REF_CHARACTERISTIC KINP_EPBExtReleaseAvail_flg_defval KINP_EPBExtReleaseAvail_flg_ovrdflg KINP_EPBExtReleaseAvail_flg_ovrdval /end REF_CHARACTERISTIC
/end GROUP
/begin GROUP S104_EPBSta "SWC_INP_type/run_SWC_INP_5ms_sys/INP/CAN1/SignalCheck/EPB1/EPBSta"
 /begin REF_CHARACTERISTIC KINP_EPBSta_enum_defval KINP_EPBSta_enum_ovrdflg KINP_EPBSta_enum_ovrdval /end REF_CHARACTERISTIC
/end GROUP
/begin GROUP S105_DriIntend "SWC_INP_type/run_SWC_INP_5ms_sys/INP/CAN1/SignalCheck/EPS1/DriIntend"
 /begin REF_CHARACTERISTIC KINP_DriIntend_enum_defval KINP_DriIntend_enum_ovrdflg KINP_DriIntend_enum_ovrdval /end REF_CHARACTERISTIC
/end GROUP
/begin GROUP S105_EPS1CSErr "SWC_INP_type/run_SWC_INP_5ms_sys/INP/CAN1/SignalCheck/EPS1/EPS1CSErr"
 /begin REF_CHARACTERISTIC KINP_EPS1CSErr_flg_defval KINP_EPS1CSErr_flg_ovrdflg KINP_EPS1CSErr_flg_ovrdval /end REF_CHARACTERISTIC
/end GROUP
/begin GROUP S105_EPS1RCErr "SWC_INP_type/run_SWC_INP_5ms_sys/INP/CAN1/SignalCheck/EPS1/EPS1RCErr"
 /begin REF_CHARACTERISTIC KINP_EPS1RCErr_flg_defval KINP_EPS1RCErr_flg_ovrdflg KINP_EPS1RCErr_flg_ovrdval /end REF_CHARACTERISTIC
/end GROUP
/begin GROUP S105_EPSAOIControl "SWC_INP_type/run_SWC_INP_5ms_sys/INP/CAN1/SignalCheck/EPS1/EPSAOIControl"
 /begin REF_CHARACTERISTIC KINP_EPSAOIControl_enum_defval KINP_EPSAOIControl_enum_ovrdflg KINP_EPSAOIControl_enum_ovrdval /end REF_CHARACTERISTIC
/end GROUP
/begin GROUP S105_EPSRC "SWC_INP_type/run_SWC_INP_5ms_sys/INP/CAN1/SignalCheck/EPS1/EPSRC"
 /begin REF_CHARACTERISTIC KINP_EPSRC_enum_defval KINP_EPSRC_enum_ovrdflg KINP_EPSRC_enum_ovrdval /end REF_CHARACTERISTIC
/end GROUP
/begin GROUP S105_EpasFailed "SWC_INP_type/run_SWC_INP_5ms_sys/INP/CAN1/SignalCheck/EPS1/EpasFailed"
 /begin REF_CHARACTERISTIC KINP_EpasFailed_enum_defval KINP_EpasFailed_enum_ovrdflg KINP_EpasFailed_enum_ovrdval /end REF_CHARACTERISTIC
/end GROUP
/begin GROUP S105_SASAngle "SWC_INP_type/run_SWC_INP_5ms_sys/INP/CAN1/SignalCheck/EPS1/SASAngle"
 /begin REF_CHARACTERISTIC KINP_SASAngle_Deg_defval KINP_SASAngle_Deg_ovrdflg KINP_SASAngle_Deg_ovrdval /end REF_CHARACTERISTIC
/end GROUP
/begin GROUP S105_SASCAL "SWC_INP_type/run_SWC_INP_5ms_sys/INP/CAN1/SignalCheck/EPS1/SASCAL"
 /begin REF_CHARACTERISTIC KINP_SASCAL_flg_defval KINP_SASCAL_flg_ovrdflg KINP_SASCAL_flg_ovrdval /end REF_CHARACTERISTIC
/end GROUP
/begin GROUP S105_SASSpeed "SWC_INP_type/run_SWC_INP_5ms_sys/INP/CAN1/SignalCheck/EPS1/SASSpeed"
 /begin REF_CHARACTERISTIC KINP_SASSpeed_degps_defval KINP_SASSpeed_degps_ovrdflg KINP_SASSpeed_degps_ovrdval /end REF_CHARACTERISTIC
/end GROUP
/begin GROUP S105_SASSpeedValid "SWC_INP_type/run_SWC_INP_5ms_sys/INP/CAN1/SignalCheck/EPS1/SASSpeedValid"
 /begin REF_CHARACTERISTIC KINP_SASSpeedValid_flg_defval KINP_SASSpeedValid_flg_ovrdflg KINP_SASSpeedValid_flg_ovrdval /end REF_CHARACTERISTIC
/end GROUP
/begin GROUP S105_SASV "SWC_INP_type/run_SWC_INP_5ms_sys/INP/CAN1/SignalCheck/EPS1/SASV"
 /begin REF_CHARACTERISTIC KINP_SASV_flg_defval KINP_SASV_flg_ovrdflg KINP_SASV_flg_ovrdval /end REF_CHARACTERISTIC
/end GROUP
/begin GROUP S106_ABSActive "SWC_INP_type/run_SWC_INP_5ms_sys/INP/CAN1/SignalCheck/ESC1/ABSActive"
 /begin REF_CHARACTERISTIC KINP_ABSActive_flg_defval KINP_ABSActive_flg_ovrdflg KINP_ABSActive_flg_ovrdval /end REF_CHARACTERISTIC
/end GROUP
/begin GROUP S106_ABSFailed "SWC_INP_type/run_SWC_INP_5ms_sys/INP/CAN1/SignalCheck/ESC1/ABSFailed"
 /begin REF_CHARACTERISTIC KINP_ABSFailed_flg_defval KINP_ABSFailed_flg_ovrdflg KINP_ABSFailed_flg_ovrdval /end REF_CHARACTERISTIC
/end GROUP
/begin GROUP S106_ABSWnlmpSta "SWC_INP_type/run_SWC_INP_5ms_sys/INP/CAN1/SignalCheck/ESC1/ABSWnlmpSta"
 /begin REF_CHARACTERISTIC KINP_ABSWnlmpSta_flg_defval KINP_ABSWnlmpSta_flg_ovrdflg KINP_ABSWnlmpSta_flg_ovrdval /end REF_CHARACTERISTIC
/end GROUP
/begin GROUP S106_AVHActive "SWC_INP_type/run_SWC_INP_5ms_sys/INP/CAN1/SignalCheck/ESC1/AVHActive"
 /begin REF_CHARACTERISTIC KINP_AVHActive_flg_defval KINP_AVHActive_flg_ovrdflg KINP_AVHActive_flg_ovrdval /end REF_CHARACTERISTIC
/end GROUP
/begin GROUP S106_AVHFailed "SWC_INP_type/run_SWC_INP_5ms_sys/INP/CAN1/SignalCheck/ESC1/AVHFailed"
 /begin REF_CHARACTERISTIC KINP_AVHFailed_flg_defval KINP_AVHFailed_flg_ovrdflg KINP_AVHFailed_flg_ovrdval /end REF_CHARACTERISTIC
/end GROUP
/begin GROUP S106_AmberWnlmpSta "SWC_INP_type/run_SWC_INP_5ms_sys/INP/CAN1/SignalCheck/ESC1/AmberWnlmpSta"
 /begin REF_CHARACTERISTIC KINP_AmberWnlmpSta_flg_defval KINP_AmberWnlmpSta_flg_ovrdflg KINP_AmberWnlmpSta_flg_ovrdval /end REF_CHARACTERISTIC
/end GROUP
/begin GROUP S106_BTCSActive "SWC_INP_type/run_SWC_INP_5ms_sys/INP/CAN1/SignalCheck/ESC1/BTCSActive"
 /begin REF_CHARACTERISTIC KINP_BTCSActive_flg_defval KINP_BTCSActive_flg_ovrdflg KINP_BTCSActive_flg_ovrdval /end REF_CHARACTERISTIC
/end GROUP
/begin GROUP S106_EBDActive "SWC_INP_type/run_SWC_INP_5ms_sys/INP/CAN1/SignalCheck/ESC1/EBDActive"
 /begin REF_CHARACTERISTIC KINP_EBDActive_flg_defval KINP_EBDActive_flg_ovrdflg KINP_EBDActive_flg_ovrdval /end REF_CHARACTERISTIC
/end GROUP
/begin GROUP S106_EBDFailed "SWC_INP_type/run_SWC_INP_5ms_sys/INP/CAN1/SignalCheck/ESC1/EBDFailed"
 /begin REF_CHARACTERISTIC KINP_EBDFailed_flg_defval KINP_EBDFailed_flg_ovrdflg KINP_EBDFailed_flg_ovrdval /end REF_CHARACTERISTIC
/end GROUP
/begin GROUP S106_ESC1CS "SWC_INP_type/run_SWC_INP_5ms_sys/INP/CAN1/SignalCheck/ESC1/ESC1CS"
 /begin REF_CHARACTERISTIC KINP_ESC1CS_enum_defval KINP_ESC1CS_enum_ovrdflg KINP_ESC1CS_enum_ovrdval /end REF_CHARACTERISTIC
/end GROUP
/begin GROUP S106_ESC1CSErr "SWC_INP_type/run_SWC_INP_5ms_sys/INP/CAN1/SignalCheck/ESC1/ESC1CSErr"
 /begin REF_CHARACTERISTIC KINP_ESC1CSErr_flg_defval KINP_ESC1CSErr_flg_ovrdflg KINP_ESC1CSErr_flg_ovrdval /end REF_CHARACTERISTIC
/end GROUP
/begin GROUP S106_ESC1RC "SWC_INP_type/run_SWC_INP_5ms_sys/INP/CAN1/SignalCheck/ESC1/ESC1RC"
 /begin REF_CHARACTERISTIC KINP_ESC1RC_enum_defval KINP_ESC1RC_enum_ovrdflg KINP_ESC1RC_enum_ovrdval /end REF_CHARACTERISTIC
/end GROUP
/begin GROUP S106_ESC1RCErr "SWC_INP_type/run_SWC_INP_5ms_sys/INP/CAN1/SignalCheck/ESC1/ESC1RCErr"
 /begin REF_CHARACTERISTIC KINP_ESC1RCErr_flg_defval KINP_ESC1RCErr_flg_ovrdflg KINP_ESC1RCErr_flg_ovrdval /end REF_CHARACTERISTIC
/end GROUP
/begin GROUP S106_ESCActive "SWC_INP_type/run_SWC_INP_5ms_sys/INP/CAN1/SignalCheck/ESC1/ESCActive"
 /begin REF_CHARACTERISTIC KINP_ESCActive_flg_defval KINP_ESCActive_flg_ovrdflg KINP_ESCActive_flg_ovrdval /end REF_CHARACTERISTIC
/end GROUP
/begin GROUP S106_ESCBeepReq "SWC_INP_type/run_SWC_INP_5ms_sys/INP/CAN1/SignalCheck/ESC1/ESCBeepReq"
 /begin REF_CHARACTERISTIC KINP_ESCBeepReq_flg_defval KINP_ESCBeepReq_flg_ovrdflg KINP_ESCBeepReq_flg_ovrdval /end REF_CHARACTERISTIC
/end GROUP
/begin GROUP S106_ESCFailed "SWC_INP_type/run_SWC_INP_5ms_sys/INP/CAN1/SignalCheck/ESC1/ESCFailed"
 /begin REF_CHARACTERISTIC KINP_ESCFailed_flg_defval KINP_ESCFailed_flg_ovrdflg KINP_ESCFailed_flg_ovrdval /end REF_CHARACTERISTIC
/end GROUP
/begin GROUP S106_ESCOFFStatus "SWC_INP_type/run_SWC_INP_5ms_sys/INP/CAN1/SignalCheck/ESC1/ESCOFFStatus"
 /begin REF_CHARACTERISTIC KINP_ESCOFFStatus_enum_defval KINP_ESCOFFStatus_enum_ovrdflg KINP_ESCOFFStatus_enum_ovrdval /end REF_CHARACTERISTIC
/end GROUP
/begin GROUP S106_ESCOfflmpSta "SWC_INP_type/run_SWC_INP_5ms_sys/INP/CAN1/SignalCheck/ESC1/ESCOfflmpSta"
 /begin REF_CHARACTERISTIC KINP_ESCOfflmpSta_flg_defval KINP_ESCOfflmpSta_flg_ovrdflg KINP_ESCOfflmpSta_flg_ovrdval /end REF_CHARACTERISTIC
/end GROUP
/begin GROUP S106_ESCWnlmpSta "SWC_INP_type/run_SWC_INP_5ms_sys/INP/CAN1/SignalCheck/ESC1/ESCWnlmpSta"
 /begin REF_CHARACTERISTIC KINP_ESCWnlmpSta_enum_defval KINP_ESCWnlmpSta_enum_ovrdflg KINP_ESCWnlmpSta_enum_ovrdval /end REF_CHARACTERISTIC
/end GROUP
/begin GROUP S106_ESSActive "SWC_INP_type/run_SWC_INP_5ms_sys/INP/CAN1/SignalCheck/ESC1/ESSActive"
 /begin REF_CHARACTERISTIC KINP_ESSActive_flg_defval KINP_ESSActive_flg_ovrdflg KINP_ESSActive_flg_ovrdval /end REF_CHARACTERISTIC
/end GROUP
/begin GROUP S106_FrPTCSActive "SWC_INP_type/run_SWC_INP_5ms_sys/INP/CAN1/SignalCheck/ESC1/FrPTCSActive"
 /begin REF_CHARACTERISTIC KINP_FrPTCSActive_flg_defval KINP_FrPTCSActive_flg_ovrdflg KINP_FrPTCSActive_flg_ovrdval /end REF_CHARACTERISTIC
/end GROUP
/begin GROUP S106_FrntAxlTrqReqDrv "SWC_INP_type/run_SWC_INP_5ms_sys/INP/CAN1/SignalCheck/ESC1/FrntAxlTrqReqDrv"
 /begin REF_CHARACTERISTIC KINP_FrntAxlTrqReqDrv_Nm_defval KINP_FrntAxlTrqReqDrv_Nm_ovrdflg KINP_FrntAxlTrqReqDrv_Nm_ovrdval /end REF_CHARACTERISTIC
/end GROUP
/begin GROUP S106_GRADE "SWC_INP_type/run_SWC_INP_5ms_sys/INP/CAN1/SignalCheck/ESC1/GRADE"
 /begin REF_CHARACTERISTIC KINP_GRADE_Deg_defval KINP_GRADE_Deg_ovrdflg KINP_GRADE_Deg_ovrdval /end REF_CHARACTERISTIC
/end GROUP
/begin GROUP S106_HBBActive "SWC_INP_type/run_SWC_INP_5ms_sys/INP/CAN1/SignalCheck/ESC1/HBBActive"
 /begin REF_CHARACTERISTIC KINP_HBBActive_flg_defval KINP_HBBActive_flg_ovrdflg KINP_HBBActive_flg_ovrdval /end REF_CHARACTERISTIC
/end GROUP
/begin GROUP S106_HBBFailed "SWC_INP_type/run_SWC_INP_5ms_sys/INP/CAN1/SignalCheck/ESC1/HBBFailed"
 /begin REF_CHARACTERISTIC KINP_HBBFailed_flg_defval KINP_HBBFailed_flg_ovrdflg KINP_HBBFailed_flg_ovrdval /end REF_CHARACTERISTIC
/end GROUP
/begin GROUP S106_HDDActive "SWC_INP_type/run_SWC_INP_5ms_sys/INP/CAN1/SignalCheck/ESC1/HDDActive"
 /begin REF_CHARACTERISTIC KINP_HDDActive_flg_defval KINP_HDDActive_flg_ovrdflg KINP_HDDActive_flg_ovrdval /end REF_CHARACTERISTIC
/end GROUP
/begin GROUP S106_HDDFailed "SWC_INP_type/run_SWC_INP_5ms_sys/INP/CAN1/SignalCheck/ESC1/HDDFailed"
 /begin REF_CHARACTERISTIC KINP_HDDFailed_flg_defval KINP_HDDFailed_flg_ovrdflg KINP_HDDFailed_flg_ovrdval /end REF_CHARACTERISTIC
/end GROUP
/begin GROUP S106_HSAActive "SWC_INP_type/run_SWC_INP_5ms_sys/INP/CAN1/SignalCheck/ESC1/HSAActive"
 /begin REF_CHARACTERISTIC KINP_HSAActive_flg_defval KINP_HSAActive_flg_ovrdflg KINP_HSAActive_flg_ovrdval /end REF_CHARACTERISTIC
/end GROUP
/begin GROUP S106_HSAFailed "SWC_INP_type/run_SWC_INP_5ms_sys/INP/CAN1/SignalCheck/ESC1/HSAFailed"
 /begin REF_CHARACTERISTIC KINP_HSAFailed_flg_defval KINP_HSAFailed_flg_ovrdflg KINP_HSAFailed_flg_ovrdval /end REF_CHARACTERISTIC
/end GROUP
/begin GROUP S106_LFPulseCount "SWC_INP_type/run_SWC_INP_5ms_sys/INP/CAN1/SignalCheck/ESC1/LFPulseCount"
 /begin REF_CHARACTERISTIC KINP_LFPulseCount_enum_defval KINP_LFPulseCount_enum_ovrdflg KINP_LFPulseCount_enum_ovrdval /end REF_CHARACTERISTIC
/end GROUP
/begin GROUP S106_LFPulseCountV "SWC_INP_type/run_SWC_INP_5ms_sys/INP/CAN1/SignalCheck/ESC1/LFPulseCountV"
 /begin REF_CHARACTERISTIC KINP_LFPulseCountV_flg_defval KINP_LFPulseCountV_flg_ovrdflg KINP_LFPulseCountV_flg_ovrdval /end REF_CHARACTERISTIC
/end GROUP
/begin GROUP S106_LFRawWhlSpeed "SWC_INP_type/run_SWC_INP_5ms_sys/INP/CAN1/SignalCheck/ESC1/LFRawWhlSpeed"
 /begin REF_CHARACTERISTIC KINP_LFRawWhlSpeed_kph_defval KINP_LFRawWhlSpeed_kph_ovrdflg KINP_LFRawWhlSpeed_kph_ovrdval /end REF_CHARACTERISTIC
/end GROUP
/begin GROUP S106_LFRawWhlSpeedV "SWC_INP_type/run_SWC_INP_5ms_sys/INP/CAN1/SignalCheck/ESC1/LFRawWhlSpeedV"
 /begin REF_CHARACTERISTIC KINP_LFRawWhlSpeedV_flg_defval KINP_LFRawWhlSpeedV_flg_ovrdflg KINP_LFRawWhlSpeedV_flg_ovrdval /end REF_CHARACTERISTIC
/end GROUP
/begin GROUP S106_LFWhlRotDir "SWC_INP_type/run_SWC_INP_5ms_sys/INP/CAN1/SignalCheck/ESC1/LFWhlRotDir"
 /begin REF_CHARACTERISTIC KINP_LFWhlRotDir_enum_defval KINP_LFWhlRotDir_enum_ovrdflg KINP_LFWhlRotDir_enum_ovrdval /end REF_CHARACTERISTIC
/end GROUP
/begin GROUP S106_LRPulseCount "SWC_INP_type/run_SWC_INP_5ms_sys/INP/CAN1/SignalCheck/ESC1/LRPulseCount"
 /begin REF_CHARACTERISTIC KINP_LRPulseCount_enum_defval KINP_LRPulseCount_enum_ovrdflg KINP_LRPulseCount_enum_ovrdval /end REF_CHARACTERISTIC
/end GROUP
/begin GROUP S106_LRPulseCountV "SWC_INP_type/run_SWC_INP_5ms_sys/INP/CAN1/SignalCheck/ESC1/LRPulseCountV"
 /begin REF_CHARACTERISTIC KINP_LRPulseCountV_flg_defval KINP_LRPulseCountV_flg_ovrdflg KINP_LRPulseCountV_flg_ovrdval /end REF_CHARACTERISTIC
/end GROUP
/begin GROUP S106_LRRawWhlSpeed "SWC_INP_type/run_SWC_INP_5ms_sys/INP/CAN1/SignalCheck/ESC1/LRRawWhlSpeed"
 /begin REF_CHARACTERISTIC KINP_LRRawWhlSpeed_kph_defval KINP_LRRawWhlSpeed_kph_ovrdflg KINP_LRRawWhlSpeed_kph_ovrdval /end REF_CHARACTERISTIC
/end GROUP
/begin GROUP S106_LRRawWhlSpeedV "SWC_INP_type/run_SWC_INP_5ms_sys/INP/CAN1/SignalCheck/ESC1/LRRawWhlSpeedV"
 /begin REF_CHARACTERISTIC KINP_LRRawWhlSpeedV_flg_defval KINP_LRRawWhlSpeedV_flg_ovrdflg KINP_LRRawWhlSpeedV_flg_ovrdval /end REF_CHARACTERISTIC
/end GROUP
/begin GROUP S106_LRWhlRotDir "SWC_INP_type/run_SWC_INP_5ms_sys/INP/CAN1/SignalCheck/ESC1/LRWhlRotDir"
 /begin REF_CHARACTERISTIC KINP_LRWhlRotDir_enum_defval KINP_LRWhlRotDir_enum_ovrdflg KINP_LRWhlRotDir_enum_ovrdval /end REF_CHARACTERISTIC
/end GROUP
/begin GROUP S106_PBAActive "SWC_INP_type/run_SWC_INP_5ms_sys/INP/CAN1/SignalCheck/ESC1/PBAActive"
 /begin REF_CHARACTERISTIC KINP_PBAActive_flg_defval KINP_PBAActive_flg_ovrdflg KINP_PBAActive_flg_ovrdval /end REF_CHARACTERISTIC
/end GROUP
/begin GROUP S106_PBAFailed "SWC_INP_type/run_SWC_INP_5ms_sys/INP/CAN1/SignalCheck/ESC1/PBAFailed"
 /begin REF_CHARACTERISTIC KINP_PBAFailed_flg_defval KINP_PBAFailed_flg_ovrdflg KINP_PBAFailed_flg_ovrdval /end REF_CHARACTERISTIC
/end GROUP
/begin GROUP S106_RFPulseCount "SWC_INP_type/run_SWC_INP_5ms_sys/INP/CAN1/SignalCheck/ESC1/RFPulseCount"
 /begin REF_CHARACTERISTIC KINP_RFPulseCount_enum_defval KINP_RFPulseCount_enum_ovrdflg KINP_RFPulseCount_enum_ovrdval /end REF_CHARACTERISTIC
/end GROUP
/begin GROUP S106_RFPulseCountV "SWC_INP_type/run_SWC_INP_5ms_sys/INP/CAN1/SignalCheck/ESC1/RFPulseCountV"
 /begin REF_CHARACTERISTIC KINP_RFPulseCountV_flg_defval KINP_RFPulseCountV_flg_ovrdflg KINP_RFPulseCountV_flg_ovrdval /end REF_CHARACTERISTIC
/end GROUP
/begin GROUP S106_RFRawWhlSpeed "SWC_INP_type/run_SWC_INP_5ms_sys/INP/CAN1/SignalCheck/ESC1/RFRawWhlSpeed"
 /begin REF_CHARACTERISTIC KINP_RFRawWhlSpeed_kph_defval KINP_RFRawWhlSpeed_kph_ovrdflg KINP_RFRawWhlSpeed_kph_ovrdval /end REF_CHARACTERISTIC
/end GROUP
/begin GROUP S106_RFRawWhlSpeedV "SWC_INP_type/run_SWC_INP_5ms_sys/INP/CAN1/SignalCheck/ESC1/RFRawWhlSpeedV"
 /begin REF_CHARACTERISTIC KINP_RFRawWhlSpeedV_flg_defval KINP_RFRawWhlSpeedV_flg_ovrdflg KINP_RFRawWhlSpeedV_flg_ovrdval /end REF_CHARACTERISTIC
/end GROUP
/begin GROUP S106_RFWhlRotDir "SWC_INP_type/run_SWC_INP_5ms_sys/INP/CAN1/SignalCheck/ESC1/RFWhlRotDir"
 /begin REF_CHARACTERISTIC KINP_RFWhlRotDir_enum_defval KINP_RFWhlRotDir_enum_ovrdflg KINP_RFWhlRotDir_enum_ovrdval /end REF_CHARACTERISTIC
/end GROUP
/begin GROUP S106_RRPulseCount "SWC_INP_type/run_SWC_INP_5ms_sys/INP/CAN1/SignalCheck/ESC1/RRPulseCount"
 /begin REF_CHARACTERISTIC KINP_RRPulseCount_enum_defval KINP_RRPulseCount_enum_ovrdflg KINP_RRPulseCount_enum_ovrdval /end REF_CHARACTERISTIC
/end GROUP
/begin GROUP S106_RRPulseCountV "SWC_INP_type/run_SWC_INP_5ms_sys/INP/CAN1/SignalCheck/ESC1/RRPulseCountV"
 /begin REF_CHARACTERISTIC KINP_RRPulseCountV_flg_defval KINP_RRPulseCountV_flg_ovrdflg KINP_RRPulseCountV_flg_ovrdval /end REF_CHARACTERISTIC
/end GROUP
/begin GROUP S106_RRRawWhlSpeed "SWC_INP_type/run_SWC_INP_5ms_sys/INP/CAN1/SignalCheck/ESC1/RRRawWhlSpeed"
 /begin REF_CHARACTERISTIC KINP_RRRawWhlSpeed_kph_defval KINP_RRRawWhlSpeed_kph_ovrdflg KINP_RRRawWhlSpeed_kph_ovrdval /end REF_CHARACTERISTIC
/end GROUP
/begin GROUP S106_RRRawWhlSpeedV "SWC_INP_type/run_SWC_INP_5ms_sys/INP/CAN1/SignalCheck/ESC1/RRRawWhlSpeedV"
 /begin REF_CHARACTERISTIC KINP_RRRawWhlSpeedV_flg_defval KINP_RRRawWhlSpeedV_flg_ovrdflg KINP_RRRawWhlSpeedV_flg_ovrdval /end REF_CHARACTERISTIC
/end GROUP
/begin GROUP S106_RRWhlRotDir "SWC_INP_type/run_SWC_INP_5ms_sys/INP/CAN1/SignalCheck/ESC1/RRWhlRotDir"
 /begin REF_CHARACTERISTIC KINP_RRWhlRotDir_enum_defval KINP_RRWhlRotDir_enum_ovrdflg KINP_RRWhlRotDir_enum_ovrdval /end REF_CHARACTERISTIC
/end GROUP
/begin GROUP S106_RearAxlTrqReqDrv "SWC_INP_type/run_SWC_INP_5ms_sys/INP/CAN1/SignalCheck/ESC1/RearAxlTrqReqDrv"
 /begin REF_CHARACTERISTIC KINP_RearAxlTrqReqDrv_Nm_defval KINP_RearAxlTrqReqDrv_Nm_ovrdflg KINP_RearAxlTrqReqDrv_Nm_ovrdval /end REF_CHARACTERISTIC
/end GROUP
/begin GROUP S106_RedWnlmpSta "SWC_INP_type/run_SWC_INP_5ms_sys/INP/CAN1/SignalCheck/ESC1/RedWnlmpSta"
 /begin REF_CHARACTERISTIC KINP_RedWnlmpSta_flg_defval KINP_RedWnlmpSta_flg_ovrdflg KINP_RedWnlmpSta_flg_ovrdval /end REF_CHARACTERISTIC
/end GROUP
/begin GROUP S106_RrPTCSActive "SWC_INP_type/run_SWC_INP_5ms_sys/INP/CAN1/SignalCheck/ESC1/RrPTCSActive"
 /begin REF_CHARACTERISTIC KINP_RrPTCSActive_flg_defval KINP_RrPTCSActive_flg_ovrdflg KINP_RrPTCSActive_flg_ovrdval /end REF_CHARACTERISTIC
/end GROUP
/end MODULE
/end PROJECT
