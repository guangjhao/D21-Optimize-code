ASAP2_VERSION 1 31
/begin PROJECT ProjectName "Project Comment Goes Here"
/begin HEADER "Header Comments go here" /end HEADER
/begin MODULE ModuleName "Module Comment Goes Here"
/begin MOD_COMMON "Mod Common Comment Here" BYTE_ORDER MSB_LAST /end MOD_COMMON
/begin RECORD_LAYOUT Scalar_BOOLEAN FNC_VALUES 1 UBYTE COLUMN_DIR DIRECT /end RECORD_LAYOUT
/begin RECORD_LAYOUT Scalar_LONG FNC_VALUES 1 SLONG COLUMN_DIR DIRECT /end RECORD_LAYOUT
/begin RECORD_LAYOUT Scalar_FLOAT32_IEEE FNC_VALUES 1 FLOAT32_IEEE COLUMN_DIR DIRECT /end RECORD_LAYOUT
/begin RECORD_LAYOUT Scalar_FLOAT64_IEEE FNC_VALUES 1 FLOAT64_IEEE COLUMN_DIR DIRECT /end RECORD_LAYOUT
/begin RECORD_LAYOUT Lookup1D_BOOLEAN FNC_VALUES 1 UBYTE COLUMN_DIR DIRECT /end RECORD_LAYOUT
/begin RECORD_LAYOUT Lookup1D_X_BOOLEAN AXIS_PTS_X 1 UBYTE INDEX_INCR DIRECT /end RECORD_LAYOUT
/begin RECORD_LAYOUT Lookup1D_BYTE FNC_VALUES 1 SBYTE COLUMN_DIR DIRECT /end RECORD_LAYOUT
/begin RECORD_LAYOUT Lookup1D_X_BYTE AXIS_PTS_X 1 SBYTE INDEX_INCR DIRECT /end RECORD_LAYOUT
/begin RECORD_LAYOUT Lookup1D_UBYTE FNC_VALUES 1 UBYTE COLUMN_DIR DIRECT /end RECORD_LAYOUT
/begin RECORD_LAYOUT Lookup1D_X_UBYTE AXIS_PTS_X 1 UBYTE INDEX_INCR DIRECT /end RECORD_LAYOUT
/begin RECORD_LAYOUT Lookup1D_UWORD FNC_VALUES 1 UWORD COLUMN_DIR DIRECT /end RECORD_LAYOUT
/begin RECORD_LAYOUT Lookup1D_X_UWORD AXIS_PTS_X 1 UWORD INDEX_INCR DIRECT /end RECORD_LAYOUT
/begin RECORD_LAYOUT Lookup1D_WORD FNC_VALUES 1 SWORD COLUMN_DIR DIRECT /end RECORD_LAYOUT
/begin RECORD_LAYOUT Lookup1D_X_WORD AXIS_PTS_X 1 SWORD INDEX_INCR DIRECT /end RECORD_LAYOUT
/begin RECORD_LAYOUT Lookup1D_ULONG FNC_VALUES 1 ULONG COLUMN_DIR DIRECT /end RECORD_LAYOUT
/begin RECORD_LAYOUT Lookup1D_X_ULONG AXIS_PTS_X 1 ULONG INDEX_INCR DIRECT /end RECORD_LAYOUT
/begin RECORD_LAYOUT Lookup1D_SLONG FNC_VALUES 1 SLONG COLUMN_DIR DIRECT /end RECORD_LAYOUT
/begin RECORD_LAYOUT Lookup1D_X_LONG AXIS_PTS_X 1 SLONG INDEX_INCR DIRECT /end RECORD_LAYOUT
/begin RECORD_LAYOUT Lookup1D_FLOAT32_IEEE FNC_VALUES 1 FLOAT32_IEEE COLUMN_DIR DIRECT /end RECORD_LAYOUT
/begin RECORD_LAYOUT Lookup1D_X_FLOAT32_IEEE AXIS_PTS_X 1 FLOAT32_IEEE INDEX_INCR DIRECT /end RECORD_LAYOUT
/begin RECORD_LAYOUT Lookup1D_FLOAT64_IEEE FNC_VALUES 1 FLOAT64_IEEE COLUMN_DIR DIRECT /end RECORD_LAYOUT
/begin RECORD_LAYOUT Lookup1D_X_FLOAT64_IEEE AXIS_PTS_X 1 FLOAT64_IEEE INDEX_INCR DIRECT /end RECORD_LAYOUT
/begin RECORD_LAYOUT Lookup2D_BOOLEAN FNC_VALUES 1 UBYTE COLUMN_DIR DIRECT /end RECORD_LAYOUT
/begin RECORD_LAYOUT Lookup2D_X_BOOLEAN AXIS_PTS_X 1 UBYTE INDEX_INCR DIRECT /end RECORD_LAYOUT
/begin RECORD_LAYOUT Lookup2D_UBYTE FNC_VALUES 1 UBYTE COLUMN_DIR DIRECT /end RECORD_LAYOUT
/begin RECORD_LAYOUT Lookup2D_X_UBYTE AXIS_PTS_X 1 UBYTE INDEX_INCR DIRECT /end RECORD_LAYOUT
/begin RECORD_LAYOUT Lookup2D_BYTE FNC_VALUES 1 SBYTE COLUMN_DIR DIRECT /end RECORD_LAYOUT
/begin RECORD_LAYOUT Lookup2D_X_BYTE AXIS_PTS_X 1 SBYTE INDEX_INCR DIRECT /end RECORD_LAYOUT
/begin RECORD_LAYOUT Lookup2D_UWORD FNC_VALUES 1 UWORD COLUMN_DIR DIRECT /end RECORD_LAYOUT
/begin RECORD_LAYOUT Lookup2D_X_UWORD AXIS_PTS_X 1 UWORD INDEX_INCR DIRECT /end RECORD_LAYOUT
/begin RECORD_LAYOUT Lookup2D_WORD FNC_VALUES 1 SWORD COLUMN_DIR DIRECT /end RECORD_LAYOUT
/begin RECORD_LAYOUT Lookup2D_X_WORD AXIS_PTS_X 1 SWORD INDEX_INCR DIRECT /end RECORD_LAYOUT
/begin RECORD_LAYOUT Lookup2D_ULONG FNC_VALUES 1 ULONG COLUMN_DIR DIRECT /end RECORD_LAYOUT
/begin RECORD_LAYOUT Lookup2D_X_ULONG AXIS_PTS_X 1 ULONG INDEX_INCR DIRECT /end RECORD_LAYOUT
/begin RECORD_LAYOUT Lookup2D_LONG FNC_VALUES 1 SLONG COLUMN_DIR DIRECT /end RECORD_LAYOUT
/begin RECORD_LAYOUT Lookup2D_X_LONG AXIS_PTS_X 1 SLONG INDEX_INCR DIRECT /end RECORD_LAYOUT
/begin RECORD_LAYOUT Lookup2D_FLOAT32_IEEE FNC_VALUES 1 FLOAT32_IEEE COLUMN_DIR DIRECT /end RECORD_LAYOUT
/begin RECORD_LAYOUT Lookup2D_X_FLOAT32_IEEE AXIS_PTS_X 1 FLOAT32_IEEE INDEX_INCR DIRECT /end RECORD_LAYOUT
/begin RECORD_LAYOUT Lookup2D_FLOAT64_IEEE FNC_VALUES 1 FLOAT64_IEEE COLUMN_DIR DIRECT /end RECORD_LAYOUT
/begin RECORD_LAYOUT Lookup2D_X_FLOAT64_IEEE AXIS_PTS_X 1 FLOAT64_IEEE INDEX_INCR DIRECT /end RECORD_LAYOUT
/begin CHARACTERISTIC KHAL_CAN6FCM2E2E_flg "" VALUE 0x0000 /* @ECU_Address@KHAL_CAN6FCM2E2E_flg@ */ Scalar_BOOLEAN 0 SWC_HALIN_type_CM_boolean_flg 0.0 1.0 /end CHARACTERISTIC
/begin CHARACTERISTIC KHAL_CAN6FCM4E2E_flg "" VALUE 0x0000 /* @ECU_Address@KHAL_CAN6FCM4E2E_flg@ */ Scalar_BOOLEAN 0 SWC_HALIN_type_CM_boolean_flg 0.0 1.0 /end CHARACTERISTIC
/begin MEASUREMENT VHAL_SASAngle_Deg "" FLOAT32_IEEE SWC_HALIN_type_CM_single_Deg 0 0 -900.0 900.0 ECU_ADDRESS 0x0000 /* @ECU_Address@VHAL_SASAngle_Deg@ */ /end MEASUREMENT
/begin MEASUREMENT VHAL_SASSpeed_degps "" FLOAT32_IEEE SWC_HALIN_type_CM_single_degps 0 0 0.0 1020.0 ECU_ADDRESS 0x0000 /* @ECU_Address@VHAL_SASSpeed_degps@ */ /end MEASUREMENT
/begin MEASUREMENT VHAL_FrntAxlTrqReqDrv_Nm "" FLOAT32_IEEE SWC_HALIN_type_CM_single_Nm 0 0 0.0 5300.0 ECU_ADDRESS 0x0000 /* @ECU_Address@VHAL_FrntAxlTrqReqDrv_Nm@ */ /end MEASUREMENT
/begin MEASUREMENT VHAL_GRADE_Deg "" FLOAT32_IEEE SWC_HALIN_type_CM_single_Deg 0 0 -45.0 45.0 ECU_ADDRESS 0x0000 /* @ECU_Address@VHAL_GRADE_Deg@ */ /end MEASUREMENT
/begin MEASUREMENT VHAL_LFRawWhlSpeed_kph "" FLOAT32_IEEE SWC_HALIN_type_CM_single_kph 0 0 0.0 255.9375 ECU_ADDRESS 0x0000 /* @ECU_Address@VHAL_LFRawWhlSpeed_kph@ */ /end MEASUREMENT
/begin MEASUREMENT VHAL_LRRawWhlSpeed_kph "" FLOAT32_IEEE SWC_HALIN_type_CM_single_kph 0 0 0.0 255.9375 ECU_ADDRESS 0x0000 /* @ECU_Address@VHAL_LRRawWhlSpeed_kph@ */ /end MEASUREMENT
/begin MEASUREMENT VHAL_RFRawWhlSpeed_kph "" FLOAT32_IEEE SWC_HALIN_type_CM_single_kph 0 0 0.0 255.9375 ECU_ADDRESS 0x0000 /* @ECU_Address@VHAL_RFRawWhlSpeed_kph@ */ /end MEASUREMENT
/begin MEASUREMENT VHAL_RRRawWhlSpeed_kph "" FLOAT32_IEEE SWC_HALIN_type_CM_single_kph 0 0 0.0 255.9375 ECU_ADDRESS 0x0000 /* @ECU_Address@VHAL_RRRawWhlSpeed_kph@ */ /end MEASUREMENT
/begin MEASUREMENT VHAL_RearAxlTrqReqDrv_Nm "" FLOAT32_IEEE SWC_HALIN_type_CM_single_Nm 0 0 0.0 5300.0 ECU_ADDRESS 0x0000 /* @ECU_Address@VHAL_RearAxlTrqReqDrv_Nm@ */ /end MEASUREMENT
/begin MEASUREMENT VHAL_VehSpeed_kph "" FLOAT32_IEEE SWC_HALIN_type_CM_single_kph 0 0 0.0 255.875 ECU_ADDRESS 0x0000 /* @ECU_Address@VHAL_VehSpeed_kph@ */ /end MEASUREMENT
/begin MEASUREMENT VHAL_BrkPedalPos_pct "" FLOAT32_IEEE SWC_HALIN_type_CM_single_pct 0 0 0.0 100.0 ECU_ADDRESS 0x0000 /* @ECU_Address@VHAL_BrkPedalPos_pct@ */ /end MEASUREMENT
/begin MEASUREMENT VHAL_FrntAxlTrqReqBrk_Nm "" FLOAT32_IEEE SWC_HALIN_type_CM_single_Nm 0 0 -5300.0 0.0 ECU_ADDRESS 0x0000 /* @ECU_Address@VHAL_FrntAxlTrqReqBrk_Nm@ */ /end MEASUREMENT
/begin MEASUREMENT VHAL_LatAccel_Gps "" FLOAT32_IEEE SWC_HALIN_type_CM_single_Gps 0 0 -1.27 1.27 ECU_ADDRESS 0x0000 /* @ECU_Address@VHAL_LatAccel_Gps@ */ /end MEASUREMENT
/begin MEASUREMENT VHAL_LongAccel_Gps "" FLOAT32_IEEE SWC_HALIN_type_CM_single_Gps 0 0 -1.27 1.27 ECU_ADDRESS 0x0000 /* @ECU_Address@VHAL_LongAccel_Gps@ */ /end MEASUREMENT
/begin MEASUREMENT VHAL_MCPressure_bar "" FLOAT32_IEEE SWC_HALIN_type_CM_single_bar 0 0 -9.7 195.0 ECU_ADDRESS 0x0000 /* @ECU_Address@VHAL_MCPressure_bar@ */ /end MEASUREMENT
/begin MEASUREMENT VHAL_MeterIndVehSpeed_kph "" FLOAT32_IEEE SWC_HALIN_type_CM_single_kph 0 0 0.0 300.0 ECU_ADDRESS 0x0000 /* @ECU_Address@VHAL_MeterIndVehSpeed_kph@ */ /end MEASUREMENT
/begin MEASUREMENT VHAL_RearAxlTrqReqBrk_Nm "" FLOAT32_IEEE SWC_HALIN_type_CM_single_Nm 0 0 -5300.0 0.0 ECU_ADDRESS 0x0000 /* @ECU_Address@VHAL_RearAxlTrqReqBrk_Nm@ */ /end MEASUREMENT
/begin MEASUREMENT VHAL_YawRate_degps "" FLOAT32_IEEE SWC_HALIN_type_CM_single_degps 0 0 -100.0 100.0 ECU_ADDRESS 0x0000 /* @ECU_Address@VHAL_YawRate_degps@ */ /end MEASUREMENT
/begin MEASUREMENT VHAL_IVITimeYear_YEAR "" FLOAT32_IEEE SWC_HALIN_type_CM_single_YEAR 0 0 2000.0 2127.0 ECU_ADDRESS 0x0000 /* @ECU_Address@VHAL_IVITimeYear_YEAR@ */ /end MEASUREMENT
/begin MEASUREMENT VHAL_ACChgCurSet_A "" FLOAT32_IEEE SWC_HALIN_type_CM_single_A 0 0 5.0 132.0 ECU_ADDRESS 0x0000 /* @ECU_Address@VHAL_ACChgCurSet_A@ */ /end MEASUREMENT
/begin MEASUREMENT VHAL_SOCLimitSet_pct "" FLOAT32_IEEE SWC_HALIN_type_CM_single_pct 0 0 50.0 100.0 ECU_ADDRESS 0x0000 /* @ECU_Address@VHAL_SOCLimitSet_pct@ */ /end MEASUREMENT
/begin MEASUREMENT VHAL_SchedChglimit_pct "" FLOAT32_IEEE SWC_HALIN_type_CM_single_pct 0 0 50.0 100.0 ECU_ADDRESS 0x0000 /* @ECU_Address@VHAL_SchedChglimit_pct@ */ /end MEASUREMENT
/begin MEASUREMENT VHAL_sigSetTempZon1Req_C "" FLOAT32_IEEE SWC_HALIN_type_CM_single_C 0 0 17.0 32.0 ECU_ADDRESS 0x0000 /* @ECU_Address@VHAL_sigSetTempZon1Req_C@ */ /end MEASUREMENT
/begin MEASUREMENT VHAL_sigSetTempZon2Req_C "" FLOAT32_IEEE SWC_HALIN_type_CM_single_C 0 0 17.0 32.0 ECU_ADDRESS 0x0000 /* @ECU_Address@VHAL_sigSetTempZon2Req_C@ */ /end MEASUREMENT
/begin MEASUREMENT VHAL_ODOMETER_km "" FLOAT32_IEEE SWC_HALIN_type_CM_single_km 0 0 0.0 999999.9 ECU_ADDRESS 0x0000 /* @ECU_Address@VHAL_ODOMETER_km@ */ /end MEASUREMENT
/begin MEASUREMENT VHAL_HVBPwrAvailChrg_kW "" FLOAT32_IEEE SWC_HALIN_type_CM_single_kW 0 0 0.0 819.0 ECU_ADDRESS 0x0000 /* @ECU_Address@VHAL_HVBPwrAvailChrg_kW@ */ /end MEASUREMENT
/begin MEASUREMENT VHAL_HVBPwrAvailChrg30_kW "" FLOAT32_IEEE SWC_HALIN_type_CM_single_kW 0 0 0.0 819.0 ECU_ADDRESS 0x0000 /* @ECU_Address@VHAL_HVBPwrAvailChrg30_kW@ */ /end MEASUREMENT
/begin MEASUREMENT VHAL_HVBPwrAvailChrg60_kW "" FLOAT32_IEEE SWC_HALIN_type_CM_single_kW 0 0 0.0 819.0 ECU_ADDRESS 0x0000 /* @ECU_Address@VHAL_HVBPwrAvailChrg60_kW@ */ /end MEASUREMENT
/begin MEASUREMENT VHAL_HVBPwrAvailDchrg_kW "" FLOAT32_IEEE SWC_HALIN_type_CM_single_kW 0 0 0.0 819.0 ECU_ADDRESS 0x0000 /* @ECU_Address@VHAL_HVBPwrAvailDchrg_kW@ */ /end MEASUREMENT
/begin MEASUREMENT VHAL_HVBPwrAvailDchrg30_kW "" FLOAT32_IEEE SWC_HALIN_type_CM_single_kW 0 0 0.0 819.0 ECU_ADDRESS 0x0000 /* @ECU_Address@VHAL_HVBPwrAvailDchrg30_kW@ */ /end MEASUREMENT
/begin MEASUREMENT VHAL_HVBPwrAvailDchrg60_kW "" FLOAT32_IEEE SWC_HALIN_type_CM_single_kW 0 0 0.0 819.0 ECU_ADDRESS 0x0000 /* @ECU_Address@VHAL_HVBPwrAvailDchrg60_kW@ */ /end MEASUREMENT
/begin MEASUREMENT VHAL_HVBattCurr_A "" FLOAT32_IEEE SWC_HALIN_type_CM_single_A 0 0 -1000.0 2276.5 ECU_ADDRESS 0x0000 /* @ECU_Address@VHAL_HVBattCurr_A@ */ /end MEASUREMENT
/begin MEASUREMENT VHAL_HVBattVolt_V "" FLOAT32_IEEE SWC_HALIN_type_CM_single_V 0 0 0.0 819.0 ECU_ADDRESS 0x0000 /* @ECU_Address@VHAL_HVBattVolt_V@ */ /end MEASUREMENT
/begin MEASUREMENT VHAL_ACChrgCurrDis_A "" FLOAT32_IEEE SWC_HALIN_type_CM_single_A 0 0 -1000.0 2276.5 ECU_ADDRESS 0x0000 /* @ECU_Address@VHAL_ACChrgCurrDis_A@ */ /end MEASUREMENT
/begin MEASUREMENT VHAL_HVBChrgPwr_kWh "" FLOAT32_IEEE SWC_HALIN_type_CM_single_kWh 0 0 0.0 102.2 ECU_ADDRESS 0x0000 /* @ECU_Address@VHAL_HVBChrgPwr_kWh@ */ /end MEASUREMENT
/begin MEASUREMENT VHAL_HVBDrvPwr_kWh "" FLOAT32_IEEE SWC_HALIN_type_CM_single_kWh 0 0 0.0 102.2 ECU_ADDRESS 0x0000 /* @ECU_Address@VHAL_HVBDrvPwr_kWh@ */ /end MEASUREMENT
/begin MEASUREMENT VHAL_HVBFullChrgPwr_kWh "" FLOAT32_IEEE SWC_HALIN_type_CM_single_kWh 0 0 0.0 102.2 ECU_ADDRESS 0x0000 /* @ECU_Address@VHAL_HVBFullChrgPwr_kWh@ */ /end MEASUREMENT
/begin MEASUREMENT VHAL_HVBIsoImpedenceN_Megaohm "" FLOAT32_IEEE SWC_HALIN_type_CM_single_Megaohm 0 0 0.0 327.66 ECU_ADDRESS 0x0000 /* @ECU_Address@VHAL_HVBIsoImpedenceN_Megaohm@ */ /end MEASUREMENT
/begin MEASUREMENT VHAL_HVBIsoImpedenceP_Megaohm "" FLOAT32_IEEE SWC_HALIN_type_CM_single_Megaohm 0 0 0.0 327.66 ECU_ADDRESS 0x0000 /* @ECU_Address@VHAL_HVBIsoImpedenceP_Megaohm@ */ /end MEASUREMENT
/begin MEASUREMENT VHAL_HVBSOH_pct "" FLOAT32_IEEE SWC_HALIN_type_CM_single_pct 0 0 0.0 100.0 ECU_ADDRESS 0x0000 /* @ECU_Address@VHAL_HVBSOH_pct@ */ /end MEASUREMENT
/begin MEASUREMENT VHAL_HVBattPackVolt_V "" FLOAT32_IEEE SWC_HALIN_type_CM_single_V 0 0 0.0 819.0 ECU_ADDRESS 0x0000 /* @ECU_Address@VHAL_HVBattPackVolt_V@ */ /end MEASUREMENT
/begin MEASUREMENT VHAL_HVBattSOC_pct "" FLOAT32_IEEE SWC_HALIN_type_CM_single_pct 0 0 0.0 100.0 ECU_ADDRESS 0x0000 /* @ECU_Address@VHAL_HVBattSOC_pct@ */ /end MEASUREMENT
/begin MEASUREMENT VHAL_HVBattSOCDis_pct "" FLOAT32_IEEE SWC_HALIN_type_CM_single_pct 0 0 0.0 100.0 ECU_ADDRESS 0x0000 /* @ECU_Address@VHAL_HVBattSOCDis_pct@ */ /end MEASUREMENT
/begin MEASUREMENT VHAL_CellTempAvg_C "" FLOAT32_IEEE SWC_HALIN_type_CM_single_C 0 0 -40.0 213.0 ECU_ADDRESS 0x0000 /* @ECU_Address@VHAL_CellTempAvg_C@ */ /end MEASUREMENT
/begin MEASUREMENT VHAL_HVBMTempMax_C "" FLOAT32_IEEE SWC_HALIN_type_CM_single_C 0 0 -40.0 213.0 ECU_ADDRESS 0x0000 /* @ECU_Address@VHAL_HVBMTempMax_C@ */ /end MEASUREMENT
/begin MEASUREMENT VHAL_HVBMTempMin_C "" FLOAT32_IEEE SWC_HALIN_type_CM_single_C 0 0 -40.0 213.0 ECU_ADDRESS 0x0000 /* @ECU_Address@VHAL_HVBMTempMin_C@ */ /end MEASUREMENT
/begin MEASUREMENT VHAL_HVInVolt_V "" FLOAT32_IEEE SWC_HALIN_type_CM_single_V 0 0 0.0 819.0 ECU_ADDRESS 0x0000 /* @ECU_Address@VHAL_HVInVolt_V@ */ /end MEASUREMENT
/begin MEASUREMENT VHAL_LVBattDet12V_V "" FLOAT32_IEEE SWC_HALIN_type_CM_single_V 0 0 0.0 25.4 ECU_ADDRESS 0x0000 /* @ECU_Address@VHAL_LVBattDet12V_V@ */ /end MEASUREMENT
/begin MEASUREMENT VHAL_OBCDCCurLm_A "" FLOAT32_IEEE SWC_HALIN_type_CM_single_A 0 0 -25.5 76.7 ECU_ADDRESS 0x0000 /* @ECU_Address@VHAL_OBCDCCurLm_A@ */ /end MEASUREMENT
/begin MEASUREMENT VHAL_OBCDCVoltLm_V "" FLOAT32_IEEE SWC_HALIN_type_CM_single_V 0 0 0.0 819.0 ECU_ADDRESS 0x0000 /* @ECU_Address@VHAL_OBCDCVoltLm_V@ */ /end MEASUREMENT
/begin MEASUREMENT VHAL_DCDCAuxCur_A "" FLOAT32_IEEE SWC_HALIN_type_CM_single_A 0 0 0.0 409.5 ECU_ADDRESS 0x0000 /* @ECU_Address@VHAL_DCDCAuxCur_A@ */ /end MEASUREMENT
/begin MEASUREMENT VHAL_DCDCAuxVolt_V "" FLOAT32_IEEE SWC_HALIN_type_CM_single_V 0 0 8.0 19.938 ECU_ADDRESS 0x0000 /* @ECU_Address@VHAL_DCDCAuxVolt_V@ */ /end MEASUREMENT
/begin MEASUREMENT VHAL_DCDCHVCur_A "" FLOAT32_IEEE SWC_HALIN_type_CM_single_A 0 0 0.0 20.46 ECU_ADDRESS 0x0000 /* @ECU_Address@VHAL_DCDCHVCur_A@ */ /end MEASUREMENT
/begin MEASUREMENT VHAL_DCDCInVoltInf_V "" FLOAT32_IEEE SWC_HALIN_type_CM_single_V 0 0 0.0 1023.5 ECU_ADDRESS 0x0000 /* @ECU_Address@VHAL_DCDCInVoltInf_V@ */ /end MEASUREMENT
/begin MEASUREMENT VHAL_OBCDCCurrInf_A "" FLOAT32_IEEE SWC_HALIN_type_CM_single_A 0 0 -25.5 76.7 ECU_ADDRESS 0x0000 /* @ECU_Address@VHAL_OBCDCCurrInf_A@ */ /end MEASUREMENT
/begin MEASUREMENT VHAL_OBCDCVoltInf_V "" FLOAT32_IEEE SWC_HALIN_type_CM_single_V 0 0 0.0 1228.2 ECU_ADDRESS 0x0000 /* @ECU_Address@VHAL_OBCDCVoltInf_V@ */ /end MEASUREMENT
/begin MEASUREMENT VHAL_DCDCTemp_C "" FLOAT32_IEEE SWC_HALIN_type_CM_single_C 0 0 -48.0 142.5 ECU_ADDRESS 0x0000 /* @ECU_Address@VHAL_DCDCTemp_C@ */ /end MEASUREMENT
/begin MEASUREMENT VHAL_OBCACCurrInf_A "" FLOAT32_IEEE SWC_HALIN_type_CM_single_A 0 0 -40.0 87.75 ECU_ADDRESS 0x0000 /* @ECU_Address@VHAL_OBCACCurrInf_A@ */ /end MEASUREMENT
/begin MEASUREMENT VHAL_OBCACVoltInf_V "" FLOAT32_IEEE SWC_HALIN_type_CM_single_V 0 0 0.0 409.4 ECU_ADDRESS 0x0000 /* @ECU_Address@VHAL_OBCACVoltInf_V@ */ /end MEASUREMENT
/begin MEASUREMENT VHAL_OBCTemp_C "" FLOAT32_IEEE SWC_HALIN_type_CM_single_C 0 0 -48.0 105.3 ECU_ADDRESS 0x0000 /* @ECU_Address@VHAL_OBCTemp_C@ */ /end MEASUREMENT
/begin MEASUREMENT VHAL_FrEDURealTMTq_Nm "" FLOAT32_IEEE SWC_HALIN_type_CM_single_Nm 0 0 -1022.0 5531.5 ECU_ADDRESS 0x0000 /* @ECU_Address@VHAL_FrEDURealTMTq_Nm@ */ /end MEASUREMENT
/begin MEASUREMENT VHAL_FrEDUTqReqFbk_Nm "" FLOAT32_IEEE SWC_HALIN_type_CM_single_Nm 0 0 -1022.0 1022.0 ECU_ADDRESS 0x0000 /* @ECU_Address@VHAL_FrEDUTqReqFbk_Nm@ */ /end MEASUREMENT
/begin MEASUREMENT VHAL_FrMCUBAT_V "" FLOAT32_IEEE SWC_HALIN_type_CM_single_V 0 0 0.0 25.4 ECU_ADDRESS 0x0000 /* @ECU_Address@VHAL_FrMCUBAT_V@ */ /end MEASUREMENT
/begin MEASUREMENT VHAL_FrMCUDCBusCurr_A "" FLOAT32_IEEE SWC_HALIN_type_CM_single_A 0 0 -1500.0 1500.0 ECU_ADDRESS 0x0000 /* @ECU_Address@VHAL_FrMCUDCBusCurr_A@ */ /end MEASUREMENT
/begin MEASUREMENT VHAL_FrMCUDCBusVolt_V "" FLOAT32_IEEE SWC_HALIN_type_CM_single_V 0 0 0.0 4000.0 ECU_ADDRESS 0x0000 /* @ECU_Address@VHAL_FrMCUDCBusVolt_V@ */ /end MEASUREMENT
/begin MEASUREMENT VHAL_FrMCUTemp_C "" FLOAT32_IEEE SWC_HALIN_type_CM_single_C 0 0 -40.0 254.0 ECU_ADDRESS 0x0000 /* @ECU_Address@VHAL_FrMCUTemp_C@ */ /end MEASUREMENT
/begin MEASUREMENT VHAL_FrRegenAvailTq_Nm "" FLOAT32_IEEE SWC_HALIN_type_CM_single_Nm 0 0 -1022.0 0.0 ECU_ADDRESS 0x0000 /* @ECU_Address@VHAL_FrRegenAvailTq_Nm@ */ /end MEASUREMENT
/begin MEASUREMENT VHAL_FrTMSpd_rpm "" FLOAT32_IEEE SWC_HALIN_type_CM_single_rpm 0 0 -18000.0 18000.0 ECU_ADDRESS 0x0000 /* @ECU_Address@VHAL_FrTMSpd_rpm@ */ /end MEASUREMENT
/begin MEASUREMENT VHAL_FrTMTemp_C "" FLOAT32_IEEE SWC_HALIN_type_CM_single_C 0 0 -40.0 254.0 ECU_ADDRESS 0x0000 /* @ECU_Address@VHAL_FrTMTemp_C@ */ /end MEASUREMENT
/begin MEASUREMENT VHAL_FrTMid_A "" FLOAT32_IEEE SWC_HALIN_type_CM_single_A 0 0 -1500.0 1500.0 ECU_ADDRESS 0x0000 /* @ECU_Address@VHAL_FrTMid_A@ */ /end MEASUREMENT
/begin MEASUREMENT VHAL_FrTMiq_A "" FLOAT32_IEEE SWC_HALIN_type_CM_single_A 0 0 -1500.0 1500.0 ECU_ADDRESS 0x0000 /* @ECU_Address@VHAL_FrTMiq_A@ */ /end MEASUREMENT
/begin MEASUREMENT VHAL_MCUBFRealPwrKwSta_kW "" FLOAT32_IEEE SWC_HALIN_type_CM_single_kW 0 0 -530.0 6023.4 ECU_ADDRESS 0x0000 /* @ECU_Address@VHAL_MCUBFRealPwrKwSta_kW@ */ /end MEASUREMENT
/begin MEASUREMENT VHAL_FrCoolanttempReq_C "" FLOAT32_IEEE SWC_HALIN_type_CM_single_C 0 0 -40.0 214.0 ECU_ADDRESS 0x0000 /* @ECU_Address@VHAL_FrCoolanttempReq_C@ */ /end MEASUREMENT
/begin MEASUREMENT VHAL_FrLLCTemp_C "" FLOAT32_IEEE SWC_HALIN_type_CM_single_C 0 0 -40.0 214.0 ECU_ADDRESS 0x0000 /* @ECU_Address@VHAL_FrLLCTemp_C@ */ /end MEASUREMENT
/begin MEASUREMENT VHAL_FrLLCflowReq_Lpmin "" FLOAT32_IEEE SWC_HALIN_type_CM_single_Lpmin 0 0 0.0 15.5 ECU_ADDRESS 0x0000 /* @ECU_Address@VHAL_FrLLCflowReq_Lpmin@ */ /end MEASUREMENT
/begin MEASUREMENT VHAL_MCUBRRealPwrKwSta_kW "" FLOAT32_IEEE SWC_HALIN_type_CM_single_kW 0 0 -530.0 6023.4 ECU_ADDRESS 0x0000 /* @ECU_Address@VHAL_MCUBRRealPwrKwSta_kW@ */ /end MEASUREMENT
/begin MEASUREMENT VHAL_RrEDURealTMTq_Nm "" FLOAT32_IEEE SWC_HALIN_type_CM_single_Nm 0 0 -1022.0 5531.5 ECU_ADDRESS 0x0000 /* @ECU_Address@VHAL_RrEDURealTMTq_Nm@ */ /end MEASUREMENT
/begin MEASUREMENT VHAL_RrEDUTqReqFbk_Nm "" FLOAT32_IEEE SWC_HALIN_type_CM_single_Nm 0 0 -1022.0 1022.0 ECU_ADDRESS 0x0000 /* @ECU_Address@VHAL_RrEDUTqReqFbk_Nm@ */ /end MEASUREMENT
/begin MEASUREMENT VHAL_RrMCUBAT_V "" FLOAT32_IEEE SWC_HALIN_type_CM_single_V 0 0 0.0 25.4 ECU_ADDRESS 0x0000 /* @ECU_Address@VHAL_RrMCUBAT_V@ */ /end MEASUREMENT
/begin MEASUREMENT VHAL_RrMCUDCBusCurr_A "" FLOAT32_IEEE SWC_HALIN_type_CM_single_A 0 0 -1500.0 1500.0 ECU_ADDRESS 0x0000 /* @ECU_Address@VHAL_RrMCUDCBusCurr_A@ */ /end MEASUREMENT
/begin MEASUREMENT VHAL_RrMCUDCBusVolt_V "" FLOAT32_IEEE SWC_HALIN_type_CM_single_V 0 0 0.0 4000.0 ECU_ADDRESS 0x0000 /* @ECU_Address@VHAL_RrMCUDCBusVolt_V@ */ /end MEASUREMENT
/begin MEASUREMENT VHAL_RrMCUTemp_C "" FLOAT32_IEEE SWC_HALIN_type_CM_single_C 0 0 -40.0 254.0 ECU_ADDRESS 0x0000 /* @ECU_Address@VHAL_RrMCUTemp_C@ */ /end MEASUREMENT
/begin MEASUREMENT VHAL_RrRegenAvailTq_Nm "" FLOAT32_IEEE SWC_HALIN_type_CM_single_Nm 0 0 -1022.0 0.0 ECU_ADDRESS 0x0000 /* @ECU_Address@VHAL_RrRegenAvailTq_Nm@ */ /end MEASUREMENT
/begin MEASUREMENT VHAL_RrTMSpd_rpm "" FLOAT32_IEEE SWC_HALIN_type_CM_single_rpm 0 0 -18000.0 18000.0 ECU_ADDRESS 0x0000 /* @ECU_Address@VHAL_RrTMSpd_rpm@ */ /end MEASUREMENT
/begin MEASUREMENT VHAL_RrTMTemp_C "" FLOAT32_IEEE SWC_HALIN_type_CM_single_C 0 0 -40.0 254.0 ECU_ADDRESS 0x0000 /* @ECU_Address@VHAL_RrTMTemp_C@ */ /end MEASUREMENT
/begin MEASUREMENT VHAL_RrTMid_A "" FLOAT32_IEEE SWC_HALIN_type_CM_single_A 0 0 -1500.0 1500.0 ECU_ADDRESS 0x0000 /* @ECU_Address@VHAL_RrTMid_A@ */ /end MEASUREMENT
/begin MEASUREMENT VHAL_RrTMiq_A "" FLOAT32_IEEE SWC_HALIN_type_CM_single_A 0 0 -1500.0 1500.0 ECU_ADDRESS 0x0000 /* @ECU_Address@VHAL_RrTMiq_A@ */ /end MEASUREMENT
/begin MEASUREMENT VHAL_RrCoolanttempReq_cnt "" FLOAT32_IEEE SWC_HALIN_type_CM_single_cnt 0 0 -40.0 214.0 ECU_ADDRESS 0x0000 /* @ECU_Address@VHAL_RrCoolanttempReq_cnt@ */ /end MEASUREMENT
/begin MEASUREMENT VHAL_RrLLCTemp_C "" FLOAT32_IEEE SWC_HALIN_type_CM_single_C 0 0 -40.0 214.0 ECU_ADDRESS 0x0000 /* @ECU_Address@VHAL_RrLLCTemp_C@ */ /end MEASUREMENT
/begin MEASUREMENT VHAL_RrLLCflowReq_Lpmin "" FLOAT32_IEEE SWC_HALIN_type_CM_single_Lpmin 0 0 0.0 15.5 ECU_ADDRESS 0x0000 /* @ECU_Address@VHAL_RrLLCflowReq_Lpmin@ */ /end MEASUREMENT
/begin MEASUREMENT VHAL_FrEDURealTMTqNidec_Nm "" FLOAT32_IEEE SWC_HALIN_type_CM_single_Nm 0 0 -1022.0 1022.0 ECU_ADDRESS 0x0000 /* @ECU_Address@VHAL_FrEDURealTMTqNidec_Nm@ */ /end MEASUREMENT
/begin MEASUREMENT VHAL_FrEDUTqReqFbkNidec_Nm "" FLOAT32_IEEE SWC_HALIN_type_CM_single_Nm 0 0 -1022.0 1022.0 ECU_ADDRESS 0x0000 /* @ECU_Address@VHAL_FrEDUTqReqFbkNidec_Nm@ */ /end MEASUREMENT
/begin MEASUREMENT VHAL_FrMCUBATNidec_V "" FLOAT32_IEEE SWC_HALIN_type_CM_single_V 0 0 0.0 25.4 ECU_ADDRESS 0x0000 /* @ECU_Address@VHAL_FrMCUBATNidec_V@ */ /end MEASUREMENT
/begin MEASUREMENT VHAL_FrMCUDCBusCurrNidec_A "" FLOAT32_IEEE SWC_HALIN_type_CM_single_A 0 0 -1500.0 1500.0 ECU_ADDRESS 0x0000 /* @ECU_Address@VHAL_FrMCUDCBusCurrNidec_A@ */ /end MEASUREMENT
/begin MEASUREMENT VHAL_FrMCUDCBusVoltNidec_V "" FLOAT32_IEEE SWC_HALIN_type_CM_single_V 0 0 0.0 4000.0 ECU_ADDRESS 0x0000 /* @ECU_Address@VHAL_FrMCUDCBusVoltNidec_V@ */ /end MEASUREMENT
/begin MEASUREMENT VHAL_FrMCUTempNidec_C "" FLOAT32_IEEE SWC_HALIN_type_CM_single_C 0 0 -40.0 254.0 ECU_ADDRESS 0x0000 /* @ECU_Address@VHAL_FrMCUTempNidec_C@ */ /end MEASUREMENT
/begin MEASUREMENT VHAL_FrRegenAvailTqNidec_Nm "" FLOAT32_IEEE SWC_HALIN_type_CM_single_Nm 0 0 -1022.0 0.0 ECU_ADDRESS 0x0000 /* @ECU_Address@VHAL_FrRegenAvailTqNidec_Nm@ */ /end MEASUREMENT
/begin MEASUREMENT VHAL_FrTMSpdNidec_rpm "" FLOAT32_IEEE SWC_HALIN_type_CM_single_rpm 0 0 -17000.0 17000.0 ECU_ADDRESS 0x0000 /* @ECU_Address@VHAL_FrTMSpdNidec_rpm@ */ /end MEASUREMENT
/begin MEASUREMENT VHAL_FrTMTempNidec_C "" FLOAT32_IEEE SWC_HALIN_type_CM_single_C 0 0 -40.0 254.0 ECU_ADDRESS 0x0000 /* @ECU_Address@VHAL_FrTMTempNidec_C@ */ /end MEASUREMENT
/begin MEASUREMENT VHAL_FrTMidNidec_A "" FLOAT32_IEEE SWC_HALIN_type_CM_single_A 0 0 -1500.0 1500.0 ECU_ADDRESS 0x0000 /* @ECU_Address@VHAL_FrTMidNidec_A@ */ /end MEASUREMENT
/begin MEASUREMENT VHAL_FrTMiqNidec_A "" FLOAT32_IEEE SWC_HALIN_type_CM_single_A 0 0 -1500.0 1500.0 ECU_ADDRESS 0x0000 /* @ECU_Address@VHAL_FrTMiqNidec_A@ */ /end MEASUREMENT
/begin MEASUREMENT VHAL_FrCoolanttempReqNidec_C "" FLOAT32_IEEE SWC_HALIN_type_CM_single_C 0 0 -40.0 214.0 ECU_ADDRESS 0x0000 /* @ECU_Address@VHAL_FrCoolanttempReqNidec_C@ */ /end MEASUREMENT
/begin MEASUREMENT VHAL_FrLLCTempNidec_C "" FLOAT32_IEEE SWC_HALIN_type_CM_single_C 0 0 -40.0 214.0 ECU_ADDRESS 0x0000 /* @ECU_Address@VHAL_FrLLCTempNidec_C@ */ /end MEASUREMENT
/begin MEASUREMENT VHAL_FrLLCflowReqNidec_Lpmin "" FLOAT32_IEEE SWC_HALIN_type_CM_single_Lpmin 0 0 0.0 15.5 ECU_ADDRESS 0x0000 /* @ECU_Address@VHAL_FrLLCflowReqNidec_Lpmin@ */ /end MEASUREMENT
/begin MEASUREMENT VHAL_RrEDURealTMTqNidec_Nm "" FLOAT32_IEEE SWC_HALIN_type_CM_single_Nm 0 0 -1022.0 1022.0 ECU_ADDRESS 0x0000 /* @ECU_Address@VHAL_RrEDURealTMTqNidec_Nm@ */ /end MEASUREMENT
/begin MEASUREMENT VHAL_RrEDUTqReqFbkNidec_Nm "" FLOAT32_IEEE SWC_HALIN_type_CM_single_Nm 0 0 -1022.0 1022.0 ECU_ADDRESS 0x0000 /* @ECU_Address@VHAL_RrEDUTqReqFbkNidec_Nm@ */ /end MEASUREMENT
/begin MEASUREMENT VHAL_RrMCUBATNidec_V "" FLOAT32_IEEE SWC_HALIN_type_CM_single_V 0 0 0.0 25.4 ECU_ADDRESS 0x0000 /* @ECU_Address@VHAL_RrMCUBATNidec_V@ */ /end MEASUREMENT
/begin MEASUREMENT VHAL_RrMCUDCBusCurrNidec_A "" FLOAT32_IEEE SWC_HALIN_type_CM_single_A 0 0 -1500.0 1500.0 ECU_ADDRESS 0x0000 /* @ECU_Address@VHAL_RrMCUDCBusCurrNidec_A@ */ /end MEASUREMENT
/begin MEASUREMENT VHAL_RrMCUDCBusVoltNidec_V "" FLOAT32_IEEE SWC_HALIN_type_CM_single_V 0 0 0.0 4000.0 ECU_ADDRESS 0x0000 /* @ECU_Address@VHAL_RrMCUDCBusVoltNidec_V@ */ /end MEASUREMENT
/begin MEASUREMENT VHAL_RrMCUTempNidec_C "" FLOAT32_IEEE SWC_HALIN_type_CM_single_C 0 0 -40.0 254.0 ECU_ADDRESS 0x0000 /* @ECU_Address@VHAL_RrMCUTempNidec_C@ */ /end MEASUREMENT
/begin MEASUREMENT VHAL_RrRegenAvailTqNidec_Nm "" FLOAT32_IEEE SWC_HALIN_type_CM_single_Nm 0 0 -1022.0 0.0 ECU_ADDRESS 0x0000 /* @ECU_Address@VHAL_RrRegenAvailTqNidec_Nm@ */ /end MEASUREMENT
/begin MEASUREMENT VHAL_RrTMSpdNidec_rpm "" FLOAT32_IEEE SWC_HALIN_type_CM_single_rpm 0 0 -17000.0 17000.0 ECU_ADDRESS 0x0000 /* @ECU_Address@VHAL_RrTMSpdNidec_rpm@ */ /end MEASUREMENT
/begin MEASUREMENT VHAL_RrTMTempNidec_C "" FLOAT32_IEEE SWC_HALIN_type_CM_single_C 0 0 -40.0 254.0 ECU_ADDRESS 0x0000 /* @ECU_Address@VHAL_RrTMTempNidec_C@ */ /end MEASUREMENT
/begin MEASUREMENT VHAL_RrTMidNidec_A "" FLOAT32_IEEE SWC_HALIN_type_CM_single_A 0 0 -1500.0 1500.0 ECU_ADDRESS 0x0000 /* @ECU_Address@VHAL_RrTMidNidec_A@ */ /end MEASUREMENT
/begin MEASUREMENT VHAL_RrTMiqNidec_A "" FLOAT32_IEEE SWC_HALIN_type_CM_single_A 0 0 -1500.0 1500.0 ECU_ADDRESS 0x0000 /* @ECU_Address@VHAL_RrTMiqNidec_A@ */ /end MEASUREMENT
/begin MEASUREMENT VHAL_RrCoolanttempReqNidec_cnt "" FLOAT32_IEEE SWC_HALIN_type_CM_single_cnt 0 0 -40.0 214.0 ECU_ADDRESS 0x0000 /* @ECU_Address@VHAL_RrCoolanttempReqNidec_cnt@ */ /end MEASUREMENT
/begin MEASUREMENT VHAL_RrLLCTempNidec_C "" FLOAT32_IEEE SWC_HALIN_type_CM_single_C 0 0 -40.0 214.0 ECU_ADDRESS 0x0000 /* @ECU_Address@VHAL_RrLLCTempNidec_C@ */ /end MEASUREMENT
/begin MEASUREMENT VHAL_RrLLCflowReqNidec_Lpmin "" FLOAT32_IEEE SWC_HALIN_type_CM_single_Lpmin 0 0 0.0 15.5 ECU_ADDRESS 0x0000 /* @ECU_Address@VHAL_RrLLCflowReqNidec_Lpmin@ */ /end MEASUREMENT
/begin MEASUREMENT VHAL_RLTurnLampC_mA "" FLOAT32_IEEE SWC_HALIN_type_CM_single_mA 0 0 0.0 2550.0 ECU_ADDRESS 0x0000 /* @ECU_Address@VHAL_RLTurnLampC_mA@ */ /end MEASUREMENT
/begin MEASUREMENT VHAL_RRTurnLampC_mA "" FLOAT32_IEEE SWC_HALIN_type_CM_single_mA 0 0 0.0 2550.0 ECU_ADDRESS 0x0000 /* @ECU_Address@VHAL_RRTurnLampC_mA@ */ /end MEASUREMENT
/begin MEASUREMENT VHAL_SolarL_W "" FLOAT32_IEEE SWC_HALIN_type_CM_single_W 0 0 0.0 1265.0 ECU_ADDRESS 0x0000 /* @ECU_Address@VHAL_SolarL_W@ */ /end MEASUREMENT
/begin MEASUREMENT VHAL_SolarR_W "" FLOAT32_IEEE SWC_HALIN_type_CM_single_W 0 0 0.0 1265.0 ECU_ADDRESS 0x0000 /* @ECU_Address@VHAL_SolarR_W@ */ /end MEASUREMENT
/begin MEASUREMENT VHAL_TFaceL_C "" FLOAT32_IEEE SWC_HALIN_type_CM_single_C 0 0 -40.0 85.0 ECU_ADDRESS 0x0000 /* @ECU_Address@VHAL_TFaceL_C@ */ /end MEASUREMENT
/begin MEASUREMENT VHAL_TFaceR_C "" FLOAT32_IEEE SWC_HALIN_type_CM_single_C 0 0 -40.0 85.0 ECU_ADDRESS 0x0000 /* @ECU_Address@VHAL_TFaceR_C@ */ /end MEASUREMENT
/begin MEASUREMENT VHAL_TFaceRr_C "" FLOAT32_IEEE SWC_HALIN_type_CM_single_C 0 0 -40.0 85.0 ECU_ADDRESS 0x0000 /* @ECU_Address@VHAL_TFaceRr_C@ */ /end MEASUREMENT
/begin MEASUREMENT VHAL_TFootL_C "" FLOAT32_IEEE SWC_HALIN_type_CM_single_C 0 0 -40.0 85.0 ECU_ADDRESS 0x0000 /* @ECU_Address@VHAL_TFootL_C@ */ /end MEASUREMENT
/begin MEASUREMENT VHAL_TFootR_C "" FLOAT32_IEEE SWC_HALIN_type_CM_single_C 0 0 -40.0 85.0 ECU_ADDRESS 0x0000 /* @ECU_Address@VHAL_TFootR_C@ */ /end MEASUREMENT
/begin MEASUREMENT VHAL_TFootRr_C "" FLOAT32_IEEE SWC_HALIN_type_CM_single_C 0 0 -40.0 85.0 ECU_ADDRESS 0x0000 /* @ECU_Address@VHAL_TFootRr_C@ */ /end MEASUREMENT
/begin MEASUREMENT VHAL_Tevap_C "" FLOAT32_IEEE SWC_HALIN_type_CM_single_C 0 0 -40.0 85.0 ECU_ADDRESS 0x0000 /* @ECU_Address@VHAL_Tevap_C@ */ /end MEASUREMENT
/begin MEASUREMENT VHAL_Tincar_C "" FLOAT32_IEEE SWC_HALIN_type_CM_single_C 0 0 -40.0 85.0 ECU_ADDRESS 0x0000 /* @ECU_Address@VHAL_Tincar_C@ */ /end MEASUREMENT
/begin MEASUREMENT VHAL_FLTurnLampC_mA "" FLOAT32_IEEE SWC_HALIN_type_CM_single_mA 0 0 0.0 2550.0 ECU_ADDRESS 0x0000 /* @ECU_Address@VHAL_FLTurnLampC_mA@ */ /end MEASUREMENT
/begin MEASUREMENT VHAL_FRTurnLampC_mA "" FLOAT32_IEEE SWC_HALIN_type_CM_single_mA 0 0 0.0 2550.0 ECU_ADDRESS 0x0000 /* @ECU_Address@VHAL_FRTurnLampC_mA@ */ /end MEASUREMENT
/begin MEASUREMENT VHAL_BatInTemp_C "" FLOAT32_IEEE SWC_HALIN_type_CM_single_C 0 0 -40.0 85.0 ECU_ADDRESS 0x0000 /* @ECU_Address@VHAL_BatInTemp_C@ */ /end MEASUREMENT
/begin MEASUREMENT VHAL_BatOutTemp_C "" FLOAT32_IEEE SWC_HALIN_type_CM_single_C 0 0 -40.0 85.0 ECU_ADDRESS 0x0000 /* @ECU_Address@VHAL_BatOutTemp_C@ */ /end MEASUREMENT
/begin MEASUREMENT VHAL_MotorInTemp_C "" FLOAT32_IEEE SWC_HALIN_type_CM_single_C 0 0 -40.0 85.0 ECU_ADDRESS 0x0000 /* @ECU_Address@VHAL_MotorInTemp_C@ */ /end MEASUREMENT
/begin MEASUREMENT VHAL_MotorOutTemp_C "" FLOAT32_IEEE SWC_HALIN_type_CM_single_C 0 0 -40.0 85.0 ECU_ADDRESS 0x0000 /* @ECU_Address@VHAL_MotorOutTemp_C@ */ /end MEASUREMENT
/begin MEASUREMENT VHAL_PTHighTact_C "" FLOAT32_IEEE SWC_HALIN_type_CM_single_C 0 0 -40.0 140.0 ECU_ADDRESS 0x0000 /* @ECU_Address@VHAL_PTHighTact_C@ */ /end MEASUREMENT
/begin MEASUREMENT VHAL_PTLowT1_C "" FLOAT32_IEEE SWC_HALIN_type_CM_single_C 0 0 -40.0 85.0 ECU_ADDRESS 0x0000 /* @ECU_Address@VHAL_PTLowT1_C@ */ /end MEASUREMENT
/begin MEASUREMENT VHAL_PTLowT2_C "" FLOAT32_IEEE SWC_HALIN_type_CM_single_C 0 0 -40.0 85.0 ECU_ADDRESS 0x0000 /* @ECU_Address@VHAL_PTLowT2_C@ */ /end MEASUREMENT
/begin MEASUREMENT VHAL_Tamb_C "" FLOAT32_IEEE SWC_HALIN_type_CM_single_C 0 0 -40.0 85.0 ECU_ADDRESS 0x0000 /* @ECU_Address@VHAL_Tamb_C@ */ /end MEASUREMENT
/begin MEASUREMENT VHAL_FrntPTCLeActHeatPwr_W "" FLOAT32_IEEE SWC_HALIN_type_CM_single_W 0 0 0.0 6375.0 ECU_ADDRESS 0x0000 /* @ECU_Address@VHAL_FrntPTCLeActHeatPwr_W@ */ /end MEASUREMENT
/begin MEASUREMENT VHAL_FrntPTCRearLeActHeatPwr_W "" FLOAT32_IEEE SWC_HALIN_type_CM_single_W 0 0 0.0 6375.0 ECU_ADDRESS 0x0000 /* @ECU_Address@VHAL_FrntPTCRearLeActHeatPwr_W@ */ /end MEASUREMENT
/begin MEASUREMENT VHAL_FrntPTCRearRiActHeatPwr_W "" FLOAT32_IEEE SWC_HALIN_type_CM_single_W 0 0 0.0 6375.0 ECU_ADDRESS 0x0000 /* @ECU_Address@VHAL_FrntPTCRearRiActHeatPwr_W@ */ /end MEASUREMENT
/begin MEASUREMENT VHAL_FrntPTCRiActHeatPwr_W "" FLOAT32_IEEE SWC_HALIN_type_CM_single_W 0 0 0.0 6375.0 ECU_ADDRESS 0x0000 /* @ECU_Address@VHAL_FrntPTCRiActHeatPwr_W@ */ /end MEASUREMENT
/begin MEASUREMENT VHAL_COMPConCur_A "" FLOAT32_IEEE SWC_HALIN_type_CM_single_A 0 0 0.0 1310.7 ECU_ADDRESS 0x0000 /* @ECU_Address@VHAL_COMPConCur_A@ */ /end MEASUREMENT
/begin MEASUREMENT VHAL_COMPConVolt_V "" FLOAT32_IEEE SWC_HALIN_type_CM_single_V 0 0 0.0 1310.7 ECU_ADDRESS 0x0000 /* @ECU_Address@VHAL_COMPConVolt_V@ */ /end MEASUREMENT
/begin MEASUREMENT VHAL_PTC1PowerConsumption_kW "" FLOAT32_IEEE SWC_HALIN_type_CM_single_kW 0 0 0.0 25.3 ECU_ADDRESS 0x0000 /* @ECU_Address@VHAL_PTC1PowerConsumption_kW@ */ /end MEASUREMENT
/begin MEASUREMENT VHAL_TimeSyncFromBSYear_YEAR "" FLOAT32_IEEE SWC_HALIN_type_CM_single_YEAR 0 0 2000.0 2099.0 ECU_ADDRESS 0x0000 /* @ECU_Address@VHAL_TimeSyncFromBSYear_YEAR@ */ /end MEASUREMENT
/begin MEASUREMENT VHAL_ReserveChargeOFFYear_YEAR "" FLOAT32_IEEE SWC_HALIN_type_CM_single_YEAR 0 0 2000.0 2099.0 ECU_ADDRESS 0x0000 /* @ECU_Address@VHAL_ReserveChargeOFFYear_YEAR@ */ /end MEASUREMENT
/begin MEASUREMENT VHAL_ReserveChargeOnYear_YEAR "" FLOAT32_IEEE SWC_HALIN_type_CM_single_YEAR 0 0 2000.0 2099.0 ECU_ADDRESS 0x0000 /* @ECU_Address@VHAL_ReserveChargeOnYear_YEAR@ */ /end MEASUREMENT
/begin MEASUREMENT VHAL_ACCComfortBandLower_mps2 "" FLOAT32_IEEE SWC_HALIN_type_CM_single_mps2 0 0 -15.0 10.55 ECU_ADDRESS 0x0000 /* @ECU_Address@VHAL_ACCComfortBandLower_mps2@ */ /end MEASUREMENT
/begin MEASUREMENT VHAL_ACCComfortBandUpper_mps2 "" FLOAT32_IEEE SWC_HALIN_type_CM_single_mps2 0 0 -15.0 10.55 ECU_ADDRESS 0x0000 /* @ECU_Address@VHAL_ACCComfortBandUpper_mps2@ */ /end MEASUREMENT
/begin MEASUREMENT VHAL_ACCJerkLowerLimit_mps3 "" FLOAT32_IEEE SWC_HALIN_type_CM_single_mps3 0 0 -6.0 6.7 ECU_ADDRESS 0x0000 /* @ECU_Address@VHAL_ACCJerkLowerLimit_mps3@ */ /end MEASUREMENT
/begin MEASUREMENT VHAL_ACCJerkUpperLimit_mps3 "" FLOAT32_IEEE SWC_HALIN_type_CM_single_mps3 0 0 -6.0 6.7 ECU_ADDRESS 0x0000 /* @ECU_Address@VHAL_ACCJerkUpperLimit_mps3@ */ /end MEASUREMENT
/begin MEASUREMENT VHAL_ACCObjDist_m "" FLOAT32_IEEE SWC_HALIN_type_CM_single_m 0 0 0.0 204.6 ECU_ADDRESS 0x0000 /* @ECU_Address@VHAL_ACCObjDist_m@ */ /end MEASUREMENT
/begin MEASUREMENT VHAL_ACCObjRelSpd_mps "" FLOAT32_IEEE SWC_HALIN_type_CM_single_mps 0 0 -100.0 104.6 ECU_ADDRESS 0x0000 /* @ECU_Address@VHAL_ACCObjRelSpd_mps@ */ /end MEASUREMENT
/begin MEASUREMENT VHAL_ACCRequiredAccel_mps2 "" FLOAT32_IEEE SWC_HALIN_type_CM_single_mps2 0 0 -15.0 10.55 ECU_ADDRESS 0x0000 /* @ECU_Address@VHAL_ACCRequiredAccel_mps2@ */ /end MEASUREMENT
/begin MEASUREMENT VHAL_ADASLanecurveL_raw32 "" FLOAT32_IEEE SWC_HALIN_type_CM_single_raw32 0 0 -0.03 0.03 ECU_ADDRESS 0x0000 /* @ECU_Address@VHAL_ADASLanecurveL_raw32@ */ /end MEASUREMENT
/begin MEASUREMENT VHAL_ADASLanecurveR_raw32 "" FLOAT32_IEEE SWC_HALIN_type_CM_single_raw32 0 0 -0.03 0.03 ECU_ADDRESS 0x0000 /* @ECU_Address@VHAL_ADASLanecurveR_raw32@ */ /end MEASUREMENT
/begin MEASUREMENT VHAL_FCMLKAStrToqReq_Nm "" FLOAT32_IEEE SWC_HALIN_type_CM_single_Nm 0 0 -8.0 8.0 ECU_ADDRESS 0x0000 /* @ECU_Address@VHAL_FCMLKAStrToqReq_Nm@ */ /end MEASUREMENT
/begin MEASUREMENT VHAL_MELaneCurvDervLt_raw32 "" FLOAT32_IEEE SWC_HALIN_type_CM_single_raw32 0 0 -0.00013 0.00013214 ECU_ADDRESS 0x0000 /* @ECU_Address@VHAL_MELaneCurvDervLt_raw32@ */ /end MEASUREMENT
/begin MEASUREMENT VHAL_MELaneCurvDervLt2_raw32 "" FLOAT32_IEEE SWC_HALIN_type_CM_single_raw32 0 0 -0.00013 0.00013214 ECU_ADDRESS 0x0000 /* @ECU_Address@VHAL_MELaneCurvDervLt2_raw32@ */ /end MEASUREMENT
/begin MEASUREMENT VHAL_MELaneCurvDervRt_raw32 "" FLOAT32_IEEE SWC_HALIN_type_CM_single_raw32 0 0 -0.00013 0.00013214 ECU_ADDRESS 0x0000 /* @ECU_Address@VHAL_MELaneCurvDervRt_raw32@ */ /end MEASUREMENT
/begin MEASUREMENT VHAL_MELaneCurvDervRt2_raw32 "" FLOAT32_IEEE SWC_HALIN_type_CM_single_raw32 0 0 -0.00013 0.00013214 ECU_ADDRESS 0x0000 /* @ECU_Address@VHAL_MELaneCurvDervRt2_raw32@ */ /end MEASUREMENT
/begin MEASUREMENT VHAL_MELaneCurvLt_raw32 "" FLOAT32_IEEE SWC_HALIN_type_CM_single_raw32 0 0 -0.032 0.033535 ECU_ADDRESS 0x0000 /* @ECU_Address@VHAL_MELaneCurvLt_raw32@ */ /end MEASUREMENT
/begin MEASUREMENT VHAL_MELaneCurvLt2_raw32 "" FLOAT32_IEEE SWC_HALIN_type_CM_single_raw32 0 0 -0.032 0.033535 ECU_ADDRESS 0x0000 /* @ECU_Address@VHAL_MELaneCurvLt2_raw32@ */ /end MEASUREMENT
/begin MEASUREMENT VHAL_MELaneCurvRt_raw32 "" FLOAT32_IEEE SWC_HALIN_type_CM_single_raw32 0 0 -0.032 0.033535 ECU_ADDRESS 0x0000 /* @ECU_Address@VHAL_MELaneCurvRt_raw32@ */ /end MEASUREMENT
/begin MEASUREMENT VHAL_MELaneCurvRt2_raw32 "" FLOAT32_IEEE SWC_HALIN_type_CM_single_raw32 0 0 -0.032 0.033535 ECU_ADDRESS 0x0000 /* @ECU_Address@VHAL_MELaneCurvRt2_raw32@ */ /end MEASUREMENT
/begin MEASUREMENT VHAL_MELaneHeadAngLt_radians "" FLOAT32_IEEE SWC_HALIN_type_CM_single_radians 0 0 -0.5 0.523 ECU_ADDRESS 0x0000 /* @ECU_Address@VHAL_MELaneHeadAngLt_radians@ */ /end MEASUREMENT
/begin MEASUREMENT VHAL_MELaneHeadAngLt2_radians "" FLOAT32_IEEE SWC_HALIN_type_CM_single_radians 0 0 -0.5 0.523 ECU_ADDRESS 0x0000 /* @ECU_Address@VHAL_MELaneHeadAngLt2_radians@ */ /end MEASUREMENT
/begin MEASUREMENT VHAL_MELaneHeadAngRt_radians "" FLOAT32_IEEE SWC_HALIN_type_CM_single_radians 0 0 -0.5 0.523 ECU_ADDRESS 0x0000 /* @ECU_Address@VHAL_MELaneHeadAngRt_radians@ */ /end MEASUREMENT
/begin MEASUREMENT VHAL_MELaneHeadAngRt2_radians "" FLOAT32_IEEE SWC_HALIN_type_CM_single_radians 0 0 -0.5 0.523 ECU_ADDRESS 0x0000 /* @ECU_Address@VHAL_MELaneHeadAngRt2_radians@ */ /end MEASUREMENT
/begin MEASUREMENT VHAL_MELanePosLt_m "" FLOAT32_IEEE SWC_HALIN_type_CM_single_m 0 0 -10.0 10.47 ECU_ADDRESS 0x0000 /* @ECU_Address@VHAL_MELanePosLt_m@ */ /end MEASUREMENT
/begin MEASUREMENT VHAL_MELanePosLt2_m "" FLOAT32_IEEE SWC_HALIN_type_CM_single_m 0 0 -10.0 10.47 ECU_ADDRESS 0x0000 /* @ECU_Address@VHAL_MELanePosLt2_m@ */ /end MEASUREMENT
/begin MEASUREMENT VHAL_MELanePosRt_m "" FLOAT32_IEEE SWC_HALIN_type_CM_single_m 0 0 -10.0 10.47 ECU_ADDRESS 0x0000 /* @ECU_Address@VHAL_MELanePosRt_m@ */ /end MEASUREMENT
/begin MEASUREMENT VHAL_MELanePosRt2_m "" FLOAT32_IEEE SWC_HALIN_type_CM_single_m 0 0 -10.0 10.47 ECU_ADDRESS 0x0000 /* @ECU_Address@VHAL_MELanePosRt2_m@ */ /end MEASUREMENT
/begin MEASUREMENT VHAL_ADASAngCtrlTqWeightGain_pct "" FLOAT32_IEEE SWC_HALIN_type_CM_single_pct 0 0 0.0 102.0 ECU_ADDRESS 0x0000 /* @ECU_Address@VHAL_ADASAngCtrlTqWeightGain_pct@ */ /end MEASUREMENT
/begin MEASUREMENT VHAL_ADASDesStrWhlAngCtrlCmd_Deg "" FLOAT32_IEEE SWC_HALIN_type_CM_single_Deg 0 0 -900.0 900.0 ECU_ADDRESS 0x0000 /* @ECU_Address@VHAL_ADASDesStrWhlAngCtrlCmd_Deg@ */ /end MEASUREMENT
/begin MEASUREMENT VHAL_ADASDrvInputTqBoostGain_pct "" FLOAT32_IEEE SWC_HALIN_type_CM_single_pct 0 0 0.0 102.0 ECU_ADDRESS 0x0000 /* @ECU_Address@VHAL_ADASDrvInputTqBoostGain_pct@ */ /end MEASUREMENT
/begin MEASUREMENT VHAL_ADASMaxAngCtrlOutTqLimit_Nm "" FLOAT32_IEEE SWC_HALIN_type_CM_single_Nm 0 0 0.0 51.1 ECU_ADDRESS 0x0000 /* @ECU_Address@VHAL_ADASMaxAngCtrlOutTqLimit_Nm@ */ /end MEASUREMENT
/begin MEASUREMENT VHAL_LeftHallPos_enum "" UWORD SWC_HALIN_type_CM_uint16_enum 0 0 0.0 4095.0 ECU_ADDRESS 0x0000 /* @ECU_Address@VHAL_LeftHallPos_enum@ */ /end MEASUREMENT
/begin MEASUREMENT VHAL_DSEATHWVer_enum "" UWORD SWC_HALIN_type_CM_uint16_enum 0 0 0.0 65535.0 ECU_ADDRESS 0x0000 /* @ECU_Address@VHAL_DSEATHWVer_enum@ */ /end MEASUREMENT
/begin MEASUREMENT VHAL_DSEATSWVer_enum "" UWORD SWC_HALIN_type_CM_uint16_enum 0 0 0.0 65535.0 ECU_ADDRESS 0x0000 /* @ECU_Address@VHAL_DSEATSWVer_enum@ */ /end MEASUREMENT
/begin MEASUREMENT VHAL_PSEATHWVer_enum "" UWORD SWC_HALIN_type_CM_uint16_enum 0 0 0.0 65535.0 ECU_ADDRESS 0x0000 /* @ECU_Address@VHAL_PSEATHWVer_enum@ */ /end MEASUREMENT
/begin MEASUREMENT VHAL_PSEATSWVer_enum "" UWORD SWC_HALIN_type_CM_uint16_enum 0 0 0.0 65535.0 ECU_ADDRESS 0x0000 /* @ECU_Address@VHAL_PSEATSWVer_enum@ */ /end MEASUREMENT
/begin MEASUREMENT VHAL_BlowerErr_enum "" UBYTE SWC_HALIN_type_CM_uint8_enum 0 0 0.0 3.0 ECU_ADDRESS 0x0000 /* @ECU_Address@VHAL_BlowerErr_enum@ */ /end MEASUREMENT
/begin MEASUREMENT VHAL_SolarLErr_enum "" UBYTE SWC_HALIN_type_CM_uint8_enum 0 0 0.0 3.0 ECU_ADDRESS 0x0000 /* @ECU_Address@VHAL_SolarLErr_enum@ */ /end MEASUREMENT
/begin MEASUREMENT VHAL_SolarRErr_enum "" UBYTE SWC_HALIN_type_CM_uint8_enum 0 0 0.0 3.0 ECU_ADDRESS 0x0000 /* @ECU_Address@VHAL_SolarRErr_enum@ */ /end MEASUREMENT
/begin MEASUREMENT VHAL_TFaceLErr_enum "" UBYTE SWC_HALIN_type_CM_uint8_enum 0 0 0.0 3.0 ECU_ADDRESS 0x0000 /* @ECU_Address@VHAL_TFaceLErr_enum@ */ /end MEASUREMENT
/begin MEASUREMENT VHAL_TFaceRErr_enum "" UBYTE SWC_HALIN_type_CM_uint8_enum 0 0 0.0 3.0 ECU_ADDRESS 0x0000 /* @ECU_Address@VHAL_TFaceRErr_enum@ */ /end MEASUREMENT
/begin MEASUREMENT VHAL_TFaceRrErr_enum "" UBYTE SWC_HALIN_type_CM_uint8_enum 0 0 0.0 3.0 ECU_ADDRESS 0x0000 /* @ECU_Address@VHAL_TFaceRrErr_enum@ */ /end MEASUREMENT
/begin MEASUREMENT VHAL_TFootLErr_enum "" UBYTE SWC_HALIN_type_CM_uint8_enum 0 0 0.0 3.0 ECU_ADDRESS 0x0000 /* @ECU_Address@VHAL_TFootLErr_enum@ */ /end MEASUREMENT
/begin MEASUREMENT VHAL_TFootRErr_enum "" UBYTE SWC_HALIN_type_CM_uint8_enum 0 0 0.0 3.0 ECU_ADDRESS 0x0000 /* @ECU_Address@VHAL_TFootRErr_enum@ */ /end MEASUREMENT
/begin MEASUREMENT VHAL_TFootRrErr_enum "" UBYTE SWC_HALIN_type_CM_uint8_enum 0 0 0.0 3.0 ECU_ADDRESS 0x0000 /* @ECU_Address@VHAL_TFootRrErr_enum@ */ /end MEASUREMENT
/begin MEASUREMENT VHAL_TevapErr_enum "" UBYTE SWC_HALIN_type_CM_uint8_enum 0 0 0.0 3.0 ECU_ADDRESS 0x0000 /* @ECU_Address@VHAL_TevapErr_enum@ */ /end MEASUREMENT
/begin MEASUREMENT VHAL_TincarErr_enum "" UBYTE SWC_HALIN_type_CM_uint8_enum 0 0 0.0 3.0 ECU_ADDRESS 0x0000 /* @ECU_Address@VHAL_TincarErr_enum@ */ /end MEASUREMENT
/begin MEASUREMENT VHAL_ZoneDrMalfunLevel_enum "" UBYTE SWC_HALIN_type_CM_uint8_enum 0 0 0.0 5.0 ECU_ADDRESS 0x0000 /* @ECU_Address@VHAL_ZoneDrMalfunLevel_enum@ */ /end MEASUREMENT
/begin MEASUREMENT VHAL_TrailerModeSta_enum "" UBYTE SWC_HALIN_type_CM_uint8_enum 0 0 0.0 3.0 ECU_ADDRESS 0x0000 /* @ECU_Address@VHAL_TrailerModeSta_enum@ */ /end MEASUREMENT
/begin MEASUREMENT VHAL_AGSErr_enum "" UBYTE SWC_HALIN_type_CM_uint8_enum 0 0 0.0 3.0 ECU_ADDRESS 0x0000 /* @ECU_Address@VHAL_AGSErr_enum@ */ /end MEASUREMENT
/begin MEASUREMENT VHAL_BatInTempErr_enum "" UBYTE SWC_HALIN_type_CM_uint8_enum 0 0 0.0 3.0 ECU_ADDRESS 0x0000 /* @ECU_Address@VHAL_BatInTempErr_enum@ */ /end MEASUREMENT
/begin MEASUREMENT VHAL_COMPErr_enum "" UBYTE SWC_HALIN_type_CM_uint8_enum 0 0 0.0 3.0 ECU_ADDRESS 0x0000 /* @ECU_Address@VHAL_COMPErr_enum@ */ /end MEASUREMENT
/begin MEASUREMENT VHAL_EACProtectEnable_enum "" UBYTE SWC_HALIN_type_CM_uint8_enum 0 0 0.0 2.0 ECU_ADDRESS 0x0000 /* @ECU_Address@VHAL_EACProtectEnable_enum@ */ /end MEASUREMENT
/begin MEASUREMENT VHAL_EWP3Err_enum "" UBYTE SWC_HALIN_type_CM_uint8_enum 0 0 0.0 3.0 ECU_ADDRESS 0x0000 /* @ECU_Address@VHAL_EWP3Err_enum@ */ /end MEASUREMENT
/begin MEASUREMENT VHAL_EXV1Err_enum "" UBYTE SWC_HALIN_type_CM_uint8_enum 0 0 0.0 3.0 ECU_ADDRESS 0x0000 /* @ECU_Address@VHAL_EXV1Err_enum@ */ /end MEASUREMENT
/begin MEASUREMENT VHAL_EXV2Err_enum "" UBYTE SWC_HALIN_type_CM_uint8_enum 0 0 0.0 3.0 ECU_ADDRESS 0x0000 /* @ECU_Address@VHAL_EXV2Err_enum@ */ /end MEASUREMENT
/begin MEASUREMENT VHAL_FanErr_enum "" UBYTE SWC_HALIN_type_CM_uint8_enum 0 0 0.0 3.0 ECU_ADDRESS 0x0000 /* @ECU_Address@VHAL_FanErr_enum@ */ /end MEASUREMENT
/begin MEASUREMENT VHAL_MotorInTempErr_enum "" UBYTE SWC_HALIN_type_CM_uint8_enum 0 0 0.0 3.0 ECU_ADDRESS 0x0000 /* @ECU_Address@VHAL_MotorInTempErr_enum@ */ /end MEASUREMENT
/begin MEASUREMENT VHAL_MotorOutTempErr_enum "" UBYTE SWC_HALIN_type_CM_uint8_enum 0 0 0.0 3.0 ECU_ADDRESS 0x0000 /* @ECU_Address@VHAL_MotorOutTempErr_enum@ */ /end MEASUREMENT
/begin MEASUREMENT VHAL_PTHighPErr_enum "" UBYTE SWC_HALIN_type_CM_uint8_enum 0 0 0.0 3.0 ECU_ADDRESS 0x0000 /* @ECU_Address@VHAL_PTHighPErr_enum@ */ /end MEASUREMENT
/begin MEASUREMENT VHAL_PTHighTactErr_enum "" UBYTE SWC_HALIN_type_CM_uint8_enum 0 0 0.0 3.0 ECU_ADDRESS 0x0000 /* @ECU_Address@VHAL_PTHighTactErr_enum@ */ /end MEASUREMENT
/begin MEASUREMENT VHAL_PTLowP1Err_enum "" UBYTE SWC_HALIN_type_CM_uint8_enum 0 0 0.0 3.0 ECU_ADDRESS 0x0000 /* @ECU_Address@VHAL_PTLowP1Err_enum@ */ /end MEASUREMENT
/begin MEASUREMENT VHAL_PTLowP2Err_enum "" UBYTE SWC_HALIN_type_CM_uint8_enum 0 0 0.0 3.0 ECU_ADDRESS 0x0000 /* @ECU_Address@VHAL_PTLowP2Err_enum@ */ /end MEASUREMENT
/begin MEASUREMENT VHAL_PTLowT1Err_enum "" UBYTE SWC_HALIN_type_CM_uint8_enum 0 0 0.0 3.0 ECU_ADDRESS 0x0000 /* @ECU_Address@VHAL_PTLowT1Err_enum@ */ /end MEASUREMENT
/begin MEASUREMENT VHAL_PTLowT2Err_enum "" UBYTE SWC_HALIN_type_CM_uint8_enum 0 0 0.0 3.0 ECU_ADDRESS 0x0000 /* @ECU_Address@VHAL_PTLowT2Err_enum@ */ /end MEASUREMENT
/begin MEASUREMENT VHAL_SOTXVErr_enum "" UBYTE SWC_HALIN_type_CM_uint8_enum 0 0 0.0 3.0 ECU_ADDRESS 0x0000 /* @ECU_Address@VHAL_SOTXVErr_enum@ */ /end MEASUREMENT
/begin MEASUREMENT VHAL_SOV1Err_enum "" UBYTE SWC_HALIN_type_CM_uint8_enum 0 0 0.0 3.0 ECU_ADDRESS 0x0000 /* @ECU_Address@VHAL_SOV1Err_enum@ */ /end MEASUREMENT
/begin MEASUREMENT VHAL_SOV2Err_enum "" UBYTE SWC_HALIN_type_CM_uint8_enum 0 0 0.0 3.0 ECU_ADDRESS 0x0000 /* @ECU_Address@VHAL_SOV2Err_enum@ */ /end MEASUREMENT
/begin MEASUREMENT VHAL_SOV3Err_enum "" UBYTE SWC_HALIN_type_CM_uint8_enum 0 0 0.0 3.0 ECU_ADDRESS 0x0000 /* @ECU_Address@VHAL_SOV3Err_enum@ */ /end MEASUREMENT
/begin MEASUREMENT VHAL_TambErr_enum "" UBYTE SWC_HALIN_type_CM_uint8_enum 0 0 0.0 3.0 ECU_ADDRESS 0x0000 /* @ECU_Address@VHAL_TambErr_enum@ */ /end MEASUREMENT
/begin MEASUREMENT VHAL_CSWFWasSwSta_enum "" UBYTE SWC_HALIN_type_CM_uint8_enum 0 0 0.0 3.0 ECU_ADDRESS 0x0000 /* @ECU_Address@VHAL_CSWFWasSwSta_enum@ */ /end MEASUREMENT
/begin MEASUREMENT VHAL_CSWFWipSwSta_enum "" UBYTE SWC_HALIN_type_CM_uint8_enum 0 0 0.0 7.0 ECU_ADDRESS 0x0000 /* @ECU_Address@VHAL_CSWFWipSwSta_enum@ */ /end MEASUREMENT
/begin MEASUREMENT VHAL_CSWRWasSWSta_enum "" UBYTE SWC_HALIN_type_CM_uint8_enum 0 0 0.0 3.0 ECU_ADDRESS 0x0000 /* @ECU_Address@VHAL_CSWRWasSWSta_enum@ */ /end MEASUREMENT
/begin MEASUREMENT VHAL_CSWRWipIntSwSta_enum "" UBYTE SWC_HALIN_type_CM_uint8_enum 0 0 0.0 3.0 ECU_ADDRESS 0x0000 /* @ECU_Address@VHAL_CSWRWipIntSwSta_enum@ */ /end MEASUREMENT
/begin MEASUREMENT VHAL_CSWTurnSwSta_enum "" UBYTE SWC_HALIN_type_CM_uint8_enum 0 0 0.0 3.0 ECU_ADDRESS 0x0000 /* @ECU_Address@VHAL_CSWTurnSwSta_enum@ */ /end MEASUREMENT
/begin MEASUREMENT VHAL_LDrvWdwPositionSts_enum "" UBYTE SWC_HALIN_type_CM_uint8_enum 0 0 0.0 3.0 ECU_ADDRESS 0x0000 /* @ECU_Address@VHAL_LDrvWdwPositionSts_enum@ */ /end MEASUREMENT
/begin MEASUREMENT VHAL_LPasWdwPositionSts_enum "" UBYTE SWC_HALIN_type_CM_uint8_enum 0 0 0.0 3.0 ECU_ADDRESS 0x0000 /* @ECU_Address@VHAL_LPasWdwPositionSts_enum@ */ /end MEASUREMENT
/begin MEASUREMENT VHAL_LRLDWdwPositionSts_enum "" UBYTE SWC_HALIN_type_CM_uint8_enum 0 0 0.0 3.0 ECU_ADDRESS 0x0000 /* @ECU_Address@VHAL_LRLDWdwPositionSts_enum@ */ /end MEASUREMENT
/begin MEASUREMENT VHAL_LRRDWdwPositionSts_enum "" UBYTE SWC_HALIN_type_CM_uint8_enum 0 0 0.0 3.0 ECU_ADDRESS 0x0000 /* @ECU_Address@VHAL_LRRDWdwPositionSts_enum@ */ /end MEASUREMENT
/begin MEASUREMENT VHAL_RLSRainSnrWiperCmd_enum "" UBYTE SWC_HALIN_type_CM_uint8_enum 0 0 0.0 7.0 ECU_ADDRESS 0x0000 /* @ECU_Address@VHAL_RLSRainSnrWiperCmd_enum@ */ /end MEASUREMENT
/begin MEASUREMENT VHAL_AGSActualPosition_enum "" UBYTE SWC_HALIN_type_CM_uint8_enum 0 0 0.0 240.0 ECU_ADDRESS 0x0000 /* @ECU_Address@VHAL_AGSActualPosition_enum@ */ /end MEASUREMENT
/begin MEASUREMENT VHAL_FGSIntenRspSta_enum "" UBYTE SWC_HALIN_type_CM_uint8_enum 0 0 0.0 15.0 ECU_ADDRESS 0x0000 /* @ECU_Address@VHAL_FGSIntenRspSta_enum@ */ /end MEASUREMENT
/begin MEASUREMENT VHAL_EWP1BlockError_enum "" UBYTE SWC_HALIN_type_CM_uint8_enum 0 0 0.0 3.0 ECU_ADDRESS 0x0000 /* @ECU_Address@VHAL_EWP1BlockError_enum@ */ /end MEASUREMENT
/begin MEASUREMENT VHAL_EWP1OverCurrError_enum "" UBYTE SWC_HALIN_type_CM_uint8_enum 0 0 0.0 3.0 ECU_ADDRESS 0x0000 /* @ECU_Address@VHAL_EWP1OverCurrError_enum@ */ /end MEASUREMENT
/begin MEASUREMENT VHAL_EWP2BlockError_enum "" UBYTE SWC_HALIN_type_CM_uint8_enum 0 0 0.0 3.0 ECU_ADDRESS 0x0000 /* @ECU_Address@VHAL_EWP2BlockError_enum@ */ /end MEASUREMENT
/begin MEASUREMENT VHAL_EWP2OverCurrError_enum "" UBYTE SWC_HALIN_type_CM_uint8_enum 0 0 0.0 3.0 ECU_ADDRESS 0x0000 /* @ECU_Address@VHAL_EWP2OverCurrError_enum@ */ /end MEASUREMENT
/begin MEASUREMENT VHAL_EWP3BlockError_enum "" UBYTE SWC_HALIN_type_CM_uint8_enum 0 0 0.0 3.0 ECU_ADDRESS 0x0000 /* @ECU_Address@VHAL_EWP3BlockError_enum@ */ /end MEASUREMENT
/begin MEASUREMENT VHAL_EWP3OverCurrError_enum "" UBYTE SWC_HALIN_type_CM_uint8_enum 0 0 0.0 3.0 ECU_ADDRESS 0x0000 /* @ECU_Address@VHAL_EWP3OverCurrError_enum@ */ /end MEASUREMENT
/begin MEASUREMENT VHAL_DSEATMode_enum "" UBYTE SWC_HALIN_type_CM_uint8_enum 0 0 0.0 7.0 ECU_ADDRESS 0x0000 /* @ECU_Address@VHAL_DSEATMode_enum@ */ /end MEASUREMENT
/begin MEASUREMENT VHAL_DSEATVentSta_enum "" UBYTE SWC_HALIN_type_CM_uint8_enum 0 0 0.0 4.0 ECU_ADDRESS 0x0000 /* @ECU_Address@VHAL_DSEATVentSta_enum@ */ /end MEASUREMENT
/begin MEASUREMENT VHAL_DSEATheatersta_enum "" UBYTE SWC_HALIN_type_CM_uint8_enum 0 0 0.0 4.0 ECU_ADDRESS 0x0000 /* @ECU_Address@VHAL_DSEATheatersta_enum@ */ /end MEASUREMENT
/begin MEASUREMENT VHAL_PSEATMode_enum "" UBYTE SWC_HALIN_type_CM_uint8_enum 0 0 0.0 7.0 ECU_ADDRESS 0x0000 /* @ECU_Address@VHAL_PSEATMode_enum@ */ /end MEASUREMENT
/begin MEASUREMENT VHAL_PSEATVentSta_enum "" UBYTE SWC_HALIN_type_CM_uint8_enum 0 0 0.0 4.0 ECU_ADDRESS 0x0000 /* @ECU_Address@VHAL_PSEATVentSta_enum@ */ /end MEASUREMENT
/begin MEASUREMENT VHAL_PSEATheatersta_enum "" UBYTE SWC_HALIN_type_CM_uint8_enum 0 0 0.0 4.0 ECU_ADDRESS 0x0000 /* @ECU_Address@VHAL_PSEATheatersta_enum@ */ /end MEASUREMENT
/begin MEASUREMENT VHAL_ABM1CSErr_flg "" UBYTE SWC_HALIN_type_CM_boolean_flg 0 0 0.0 1.0 ECU_ADDRESS 0x0000 /* @ECU_Address@VHAL_ABM1CSErr_flg@ */ /end MEASUREMENT
/begin MEASUREMENT VHAL_ABM1RCErr_flg "" UBYTE SWC_HALIN_type_CM_boolean_flg 0 0 0.0 1.0 ECU_ADDRESS 0x0000 /* @ECU_Address@VHAL_ABM1RCErr_flg@ */ /end MEASUREMENT
/begin MEASUREMENT VHAL_EPB1CSErr_flg "" UBYTE SWC_HALIN_type_CM_boolean_flg 0 0 0.0 1.0 ECU_ADDRESS 0x0000 /* @ECU_Address@VHAL_EPB1CSErr_flg@ */ /end MEASUREMENT
/begin MEASUREMENT VHAL_EPB1RCErr_flg "" UBYTE SWC_HALIN_type_CM_boolean_flg 0 0 0.0 1.0 ECU_ADDRESS 0x0000 /* @ECU_Address@VHAL_EPB1RCErr_flg@ */ /end MEASUREMENT
/begin MEASUREMENT VHAL_EPS1CSErr_flg "" UBYTE SWC_HALIN_type_CM_boolean_flg 0 0 0.0 1.0 ECU_ADDRESS 0x0000 /* @ECU_Address@VHAL_EPS1CSErr_flg@ */ /end MEASUREMENT
/begin MEASUREMENT VHAL_EPS1RCErr_flg "" UBYTE SWC_HALIN_type_CM_boolean_flg 0 0 0.0 1.0 ECU_ADDRESS 0x0000 /* @ECU_Address@VHAL_EPS1RCErr_flg@ */ /end MEASUREMENT
/begin MEASUREMENT VHAL_ESC1CSErr_flg "" UBYTE SWC_HALIN_type_CM_boolean_flg 0 0 0.0 1.0 ECU_ADDRESS 0x0000 /* @ECU_Address@VHAL_ESC1CSErr_flg@ */ /end MEASUREMENT
/begin MEASUREMENT VHAL_ESC1RCErr_flg "" UBYTE SWC_HALIN_type_CM_boolean_flg 0 0 0.0 1.0 ECU_ADDRESS 0x0000 /* @ECU_Address@VHAL_ESC1RCErr_flg@ */ /end MEASUREMENT
/begin MEASUREMENT VHAL_ESC5CSErr_flg "" UBYTE SWC_HALIN_type_CM_boolean_flg 0 0 0.0 1.0 ECU_ADDRESS 0x0000 /* @ECU_Address@VHAL_ESC5CSErr_flg@ */ /end MEASUREMENT
/begin MEASUREMENT VHAL_ESC5RCErr_flg "" UBYTE SWC_HALIN_type_CM_boolean_flg 0 0 0.0 1.0 ECU_ADDRESS 0x0000 /* @ECU_Address@VHAL_ESC5RCErr_flg@ */ /end MEASUREMENT
/begin MEASUREMENT VHAL_BMS1CSErr_flg "" UBYTE SWC_HALIN_type_CM_boolean_flg 0 0 0.0 1.0 ECU_ADDRESS 0x0000 /* @ECU_Address@VHAL_BMS1CSErr_flg@ */ /end MEASUREMENT
/begin MEASUREMENT VHAL_BMS1RCErr_flg "" UBYTE SWC_HALIN_type_CM_boolean_flg 0 0 0.0 1.0 ECU_ADDRESS 0x0000 /* @ECU_Address@VHAL_BMS1RCErr_flg@ */ /end MEASUREMENT
/begin MEASUREMENT VHAL_BMS6CSErr_flg "" UBYTE SWC_HALIN_type_CM_boolean_flg 0 0 0.0 1.0 ECU_ADDRESS 0x0000 /* @ECU_Address@VHAL_BMS6CSErr_flg@ */ /end MEASUREMENT
/begin MEASUREMENT VHAL_BMS6RCErr_flg "" UBYTE SWC_HALIN_type_CM_boolean_flg 0 0 0.0 1.0 ECU_ADDRESS 0x0000 /* @ECU_Address@VHAL_BMS6RCErr_flg@ */ /end MEASUREMENT
/begin MEASUREMENT VHAL_CCU1CSErr_flg "" UBYTE SWC_HALIN_type_CM_boolean_flg 0 0 0.0 1.0 ECU_ADDRESS 0x0000 /* @ECU_Address@VHAL_CCU1CSErr_flg@ */ /end MEASUREMENT
/begin MEASUREMENT VHAL_CCU1RCErr_flg "" UBYTE SWC_HALIN_type_CM_boolean_flg 0 0 0.0 1.0 ECU_ADDRESS 0x0000 /* @ECU_Address@VHAL_CCU1RCErr_flg@ */ /end MEASUREMENT
/begin MEASUREMENT VHAL_CCU2CSErr_flg "" UBYTE SWC_HALIN_type_CM_boolean_flg 0 0 0.0 1.0 ECU_ADDRESS 0x0000 /* @ECU_Address@VHAL_CCU2CSErr_flg@ */ /end MEASUREMENT
/begin MEASUREMENT VHAL_CCU2RCErr_flg "" UBYTE SWC_HALIN_type_CM_boolean_flg 0 0 0.0 1.0 ECU_ADDRESS 0x0000 /* @ECU_Address@VHAL_CCU2RCErr_flg@ */ /end MEASUREMENT
/begin MEASUREMENT VHAL_MCUBF1CSErr_flg "" UBYTE SWC_HALIN_type_CM_boolean_flg 0 0 0.0 1.0 ECU_ADDRESS 0x0000 /* @ECU_Address@VHAL_MCUBF1CSErr_flg@ */ /end MEASUREMENT
/begin MEASUREMENT VHAL_MCUBF1RCErr_flg "" UBYTE SWC_HALIN_type_CM_boolean_flg 0 0 0.0 1.0 ECU_ADDRESS 0x0000 /* @ECU_Address@VHAL_MCUBF1RCErr_flg@ */ /end MEASUREMENT
/begin MEASUREMENT VHAL_MCUBR1CSErr_flg "" UBYTE SWC_HALIN_type_CM_boolean_flg 0 0 0.0 1.0 ECU_ADDRESS 0x0000 /* @ECU_Address@VHAL_MCUBR1CSErr_flg@ */ /end MEASUREMENT
/begin MEASUREMENT VHAL_MCUBR1RCErr_flg "" UBYTE SWC_HALIN_type_CM_boolean_flg 0 0 0.0 1.0 ECU_ADDRESS 0x0000 /* @ECU_Address@VHAL_MCUBR1RCErr_flg@ */ /end MEASUREMENT
/begin MEASUREMENT VHAL_MCUNF1CSErr_flg "" UBYTE SWC_HALIN_type_CM_boolean_flg 0 0 0.0 1.0 ECU_ADDRESS 0x0000 /* @ECU_Address@VHAL_MCUNF1CSErr_flg@ */ /end MEASUREMENT
/begin MEASUREMENT VHAL_MCUNF1RCErr_flg "" UBYTE SWC_HALIN_type_CM_boolean_flg 0 0 0.0 1.0 ECU_ADDRESS 0x0000 /* @ECU_Address@VHAL_MCUNF1RCErr_flg@ */ /end MEASUREMENT
/begin MEASUREMENT VHAL_MCUNR1CSErr_flg "" UBYTE SWC_HALIN_type_CM_boolean_flg 0 0 0.0 1.0 ECU_ADDRESS 0x0000 /* @ECU_Address@VHAL_MCUNR1CSErr_flg@ */ /end MEASUREMENT
/begin MEASUREMENT VHAL_MCUNR1RCErr_flg "" UBYTE SWC_HALIN_type_CM_boolean_flg 0 0 0.0 1.0 ECU_ADDRESS 0x0000 /* @ECU_Address@VHAL_MCUNR1RCErr_flg@ */ /end MEASUREMENT
/begin MEASUREMENT VHAL_Shifter1CSErr_flg "" UBYTE SWC_HALIN_type_CM_boolean_flg 0 0 0.0 1.0 ECU_ADDRESS 0x0000 /* @ECU_Address@VHAL_Shifter1CSErr_flg@ */ /end MEASUREMENT
/begin MEASUREMENT VHAL_Shifter1RCErr_flg "" UBYTE SWC_HALIN_type_CM_boolean_flg 0 0 0.0 1.0 ECU_ADDRESS 0x0000 /* @ECU_Address@VHAL_Shifter1RCErr_flg@ */ /end MEASUREMENT
/begin MEASUREMENT VHAL_Shifter2CSErr_flg "" UBYTE SWC_HALIN_type_CM_boolean_flg 0 0 0.0 1.0 ECU_ADDRESS 0x0000 /* @ECU_Address@VHAL_Shifter2CSErr_flg@ */ /end MEASUREMENT
/begin MEASUREMENT VHAL_Shifter2RCErr_flg "" UBYTE SWC_HALIN_type_CM_boolean_flg 0 0 0.0 1.0 ECU_ADDRESS 0x0000 /* @ECU_Address@VHAL_Shifter2RCErr_flg@ */ /end MEASUREMENT
/begin MEASUREMENT VHAL_CANMsgInvalidZONEFR1_flg "" UBYTE SWC_HALIN_type_CM_boolean_flg 0 0 0.0 1.0 ECU_ADDRESS 0x0000 /* @ECU_Address@VHAL_CANMsgInvalidZONEFR1_flg@ */ /end MEASUREMENT
/begin MEASUREMENT VHAL_CANMsgInvalidZONEFRVCU_flg "" UBYTE SWC_HALIN_type_CM_boolean_flg 0 0 0.0 1.0 ECU_ADDRESS 0x0000 /* @ECU_Address@VHAL_CANMsgInvalidZONEFRVCU_flg@ */ /end MEASUREMENT
/begin MEASUREMENT VHAL_CANMsgInvalidzGWAPTC1_flg "" UBYTE SWC_HALIN_type_CM_boolean_flg 0 0 0.0 1.0 ECU_ADDRESS 0x0000 /* @ECU_Address@VHAL_CANMsgInvalidzGWAPTC1_flg@ */ /end MEASUREMENT
/begin MEASUREMENT VHAL_CANMsgInvalidzGWCANFr1_flg "" UBYTE SWC_HALIN_type_CM_boolean_flg 0 0 0.0 1.0 ECU_ADDRESS 0x0000 /* @ECU_Address@VHAL_CANMsgInvalidzGWCANFr1_flg@ */ /end MEASUREMENT
/begin MEASUREMENT VHAL_CANMsgInvalidzGWLINDr1_flg "" UBYTE SWC_HALIN_type_CM_boolean_flg 0 0 0.0 1.0 ECU_ADDRESS 0x0000 /* @ECU_Address@VHAL_CANMsgInvalidzGWLINDr1_flg@ */ /end MEASUREMENT
/begin MEASUREMENT VHAL_CANMsgInvalidzGWLINDr2_flg "" UBYTE SWC_HALIN_type_CM_boolean_flg 0 0 0.0 1.0 ECU_ADDRESS 0x0000 /* @ECU_Address@VHAL_CANMsgInvalidzGWLINDr2_flg@ */ /end MEASUREMENT
/begin MEASUREMENT VHAL_CANMsgInvalidzGWLINFr1_flg "" UBYTE SWC_HALIN_type_CM_boolean_flg 0 0 0.0 1.0 ECU_ADDRESS 0x0000 /* @ECU_Address@VHAL_CANMsgInvalidzGWLINFr1_flg@ */ /end MEASUREMENT
/begin MEASUREMENT VHAL_CANMsgInvalidzGWLINFr2_flg "" UBYTE SWC_HALIN_type_CM_boolean_flg 0 0 0.0 1.0 ECU_ADDRESS 0x0000 /* @ECU_Address@VHAL_CANMsgInvalidzGWLINFr2_flg@ */ /end MEASUREMENT
/begin MEASUREMENT VHAL_CANMsgInvalidzGWSEAT1_flg "" UBYTE SWC_HALIN_type_CM_boolean_flg 0 0 0.0 1.0 ECU_ADDRESS 0x0000 /* @ECU_Address@VHAL_CANMsgInvalidzGWSEAT1_flg@ */ /end MEASUREMENT
/begin MEASUREMENT VHAL_CANMsgInvalidTBOX2_flg "" UBYTE SWC_HALIN_type_CM_boolean_flg 0 0 0.0 1.0 ECU_ADDRESS 0x0000 /* @ECU_Address@VHAL_CANMsgInvalidTBOX2_flg@ */ /end MEASUREMENT
/begin MEASUREMENT VHAL_CANMsgInvalidTBOX3_flg "" UBYTE SWC_HALIN_type_CM_boolean_flg 0 0 0.0 1.0 ECU_ADDRESS 0x0000 /* @ECU_Address@VHAL_CANMsgInvalidTBOX3_flg@ */ /end MEASUREMENT
/begin MEASUREMENT VHAL_FCM2CSErr_flg "" UBYTE SWC_HALIN_type_CM_boolean_flg 0 0 0.0 1.0 ECU_ADDRESS 0x0000 /* @ECU_Address@VHAL_FCM2CSErr_flg@ */ /end MEASUREMENT
/begin MEASUREMENT VHAL_FCM2RCErr_flg "" UBYTE SWC_HALIN_type_CM_boolean_flg 0 0 0.0 1.0 ECU_ADDRESS 0x0000 /* @ECU_Address@VHAL_FCM2RCErr_flg@ */ /end MEASUREMENT
/begin MEASUREMENT VHAL_FCM4CSErr_flg "" UBYTE SWC_HALIN_type_CM_boolean_flg 0 0 0.0 1.0 ECU_ADDRESS 0x0000 /* @ECU_Address@VHAL_FCM4CSErr_flg@ */ /end MEASUREMENT
/begin MEASUREMENT VHAL_FCM4RCErr_flg "" UBYTE SWC_HALIN_type_CM_boolean_flg 0 0 0.0 1.0 ECU_ADDRESS 0x0000 /* @ECU_Address@VHAL_FCM4RCErr_flg@ */ /end MEASUREMENT
/begin MEASUREMENT VHAL_CANMsgInvalidFCM1_flg "" UBYTE SWC_HALIN_type_CM_boolean_flg 0 0 0.0 1.0 ECU_ADDRESS 0x0000 /* @ECU_Address@VHAL_CANMsgInvalidFCM1_flg@ */ /end MEASUREMENT
/begin MEASUREMENT VHAL_CANMsgInvalidFCM2_flg "" UBYTE SWC_HALIN_type_CM_boolean_flg 0 0 0.0 1.0 ECU_ADDRESS 0x0000 /* @ECU_Address@VHAL_CANMsgInvalidFCM2_flg@ */ /end MEASUREMENT
/begin MEASUREMENT VHAL_CANMsgInvalidFCM3_flg "" UBYTE SWC_HALIN_type_CM_boolean_flg 0 0 0.0 1.0 ECU_ADDRESS 0x0000 /* @ECU_Address@VHAL_CANMsgInvalidFCM3_flg@ */ /end MEASUREMENT
/begin MEASUREMENT VHAL_CANMsgInvalidFCM4_flg "" UBYTE SWC_HALIN_type_CM_boolean_flg 0 0 0.0 1.0 ECU_ADDRESS 0x0000 /* @ECU_Address@VHAL_CANMsgInvalidFCM4_flg@ */ /end MEASUREMENT
/begin MEASUREMENT VHAL_CANMsgInvalidSRR1_flg "" UBYTE SWC_HALIN_type_CM_boolean_flg 0 0 0.0 1.0 ECU_ADDRESS 0x0000 /* @ECU_Address@VHAL_CANMsgInvalidSRR1_flg@ */ /end MEASUREMENT
/begin COMPU_METHOD SWC_HALIN_type_CM_boolean_flg "Q = V" RAT_FUNC "%1.0" "flg" COEFFS 0 1 0 0 0 1 /end COMPU_METHOD
/begin COMPU_METHOD SWC_HALIN_type_CM_single_Deg "Q = V" RAT_FUNC "%8.6" "Deg" COEFFS 0 1 0 0 0 1 /end COMPU_METHOD
/begin COMPU_METHOD SWC_HALIN_type_CM_single_degps "Q = V" RAT_FUNC "%8.6" "degps" COEFFS 0 1 0 0 0 1 /end COMPU_METHOD
/begin COMPU_METHOD SWC_HALIN_type_CM_single_Nm "Q = V" RAT_FUNC "%8.6" "Nm" COEFFS 0 1 0 0 0 1 /end COMPU_METHOD
/begin COMPU_METHOD SWC_HALIN_type_CM_single_kph "Q = V" RAT_FUNC "%8.6" "kph" COEFFS 0 1 0 0 0 1 /end COMPU_METHOD
/begin COMPU_METHOD SWC_HALIN_type_CM_single_pct "Q = V" RAT_FUNC "%8.6" "pct" COEFFS 0 1 0 0 0 1 /end COMPU_METHOD
/begin COMPU_METHOD SWC_HALIN_type_CM_single_Gps "Q = V" RAT_FUNC "%8.6" "Gps" COEFFS 0 1 0 0 0 1 /end COMPU_METHOD
/begin COMPU_METHOD SWC_HALIN_type_CM_single_bar "Q = V" RAT_FUNC "%8.6" "bar" COEFFS 0 1 0 0 0 1 /end COMPU_METHOD
/begin COMPU_METHOD SWC_HALIN_type_CM_single_YEAR "Q = V" RAT_FUNC "%8.6" "YEAR" COEFFS 0 1 0 0 0 1 /end COMPU_METHOD
/begin COMPU_METHOD SWC_HALIN_type_CM_single_A "Q = V" RAT_FUNC "%8.6" "A" COEFFS 0 1 0 0 0 1 /end COMPU_METHOD
/begin COMPU_METHOD SWC_HALIN_type_CM_single_C "Q = V" RAT_FUNC "%8.6" "C" COEFFS 0 1 0 0 0 1 /end COMPU_METHOD
/begin COMPU_METHOD SWC_HALIN_type_CM_single_km "Q = V" RAT_FUNC "%8.6" "km" COEFFS 0 1 0 0 0 1 /end COMPU_METHOD
/begin COMPU_METHOD SWC_HALIN_type_CM_single_kW "Q = V" RAT_FUNC "%8.6" "kW" COEFFS 0 1 0 0 0 1 /end COMPU_METHOD
/begin COMPU_METHOD SWC_HALIN_type_CM_single_V "Q = V" RAT_FUNC "%8.6" "V" COEFFS 0 1 0 0 0 1 /end COMPU_METHOD
/begin COMPU_METHOD SWC_HALIN_type_CM_single_kWh "Q = V" RAT_FUNC "%8.6" "kWh" COEFFS 0 1 0 0 0 1 /end COMPU_METHOD
/begin COMPU_METHOD SWC_HALIN_type_CM_single_Megaohm "Q = V" RAT_FUNC "%8.6" "Megaohm" COEFFS 0 1 0 0 0 1 /end COMPU_METHOD
/begin COMPU_METHOD SWC_HALIN_type_CM_single_rpm "Q = V" RAT_FUNC "%8.6" "rpm" COEFFS 0 1 0 0 0 1 /end COMPU_METHOD
/begin COMPU_METHOD SWC_HALIN_type_CM_single_Lpmin "Q = V" RAT_FUNC "%8.6" "Lpmin" COEFFS 0 1 0 0 0 1 /end COMPU_METHOD
/begin COMPU_METHOD SWC_HALIN_type_CM_single_cnt "Q = V" RAT_FUNC "%8.6" "cnt" COEFFS 0 1 0 0 0 1 /end COMPU_METHOD
/begin COMPU_METHOD SWC_HALIN_type_CM_single_W "Q = V" RAT_FUNC "%8.6" "W" COEFFS 0 1 0 0 0 1 /end COMPU_METHOD
/begin COMPU_METHOD SWC_HALIN_type_CM_single_mA "Q = V" RAT_FUNC "%8.6" "mA" COEFFS 0 1 0 0 0 1 /end COMPU_METHOD
/begin COMPU_METHOD SWC_HALIN_type_CM_single_mps2 "Q = V" RAT_FUNC "%8.6" "mps2" COEFFS 0 1 0 0 0 1 /end COMPU_METHOD
/begin COMPU_METHOD SWC_HALIN_type_CM_single_mps3 "Q = V" RAT_FUNC "%8.6" "mps3" COEFFS 0 1 0 0 0 1 /end COMPU_METHOD
/begin COMPU_METHOD SWC_HALIN_type_CM_single_m "Q = V" RAT_FUNC "%8.6" "m" COEFFS 0 1 0 0 0 1 /end COMPU_METHOD
/begin COMPU_METHOD SWC_HALIN_type_CM_single_mps "Q = V" RAT_FUNC "%8.6" "mps" COEFFS 0 1 0 0 0 1 /end COMPU_METHOD
/begin COMPU_METHOD SWC_HALIN_type_CM_single_raw32 "Q = V" RAT_FUNC "%8.6" "raw32" COEFFS 0 1 0 0 0 1 /end COMPU_METHOD
/begin COMPU_METHOD SWC_HALIN_type_CM_single_radians "Q = V" RAT_FUNC "%8.6" "radians" COEFFS 0 1 0 0 0 1 /end COMPU_METHOD
/begin COMPU_METHOD SWC_HALIN_type_CM_uint16_enum "Q = V" RAT_FUNC "%5.0" "enum" COEFFS 0 1 0 0 0 1 /end COMPU_METHOD
/begin COMPU_METHOD SWC_HALIN_type_CM_uint8_enum "Q = V" RAT_FUNC "%3.0" "enum" COEFFS 0 1 0 0 0 1 /end COMPU_METHOD
/begin GROUP S12_VHAL_CANMsgInvalidZONEFR1_flg "SWC_HALIN_type/run_SWC_HALIN_Rx_5ms_sys/HAL_IN/CAN4/VHAL_CANMsgInvalidZONEFR1_flg" /begin REF_MEASUREMENT VHAL_CANMsgInvalidZONEFR1_flg /end REF_MEASUREMENT /end GROUP
/begin GROUP S12_VHAL_CANMsgInvalidZONEFRVCU_flg "SWC_HALIN_type/run_SWC_HALIN_Rx_5ms_sys/HAL_IN/CAN4/VHAL_CANMsgInvalidZONEFRVCU_flg" /begin REF_MEASUREMENT VHAL_CANMsgInvalidZONEFRVCU_flg /end REF_MEASUREMENT /end GROUP
/begin GROUP S12_VHAL_CANMsgInvalidzGWAPTC1_flg "SWC_HALIN_type/run_SWC_HALIN_Rx_5ms_sys/HAL_IN/CAN4/VHAL_CANMsgInvalidzGWAPTC1_flg" /begin REF_MEASUREMENT VHAL_CANMsgInvalidzGWAPTC1_flg /end REF_MEASUREMENT /end GROUP
/begin GROUP S12_VHAL_CANMsgInvalidzGWCANFr1_flg "SWC_HALIN_type/run_SWC_HALIN_Rx_5ms_sys/HAL_IN/CAN4/VHAL_CANMsgInvalidzGWCANFr1_flg" /begin REF_MEASUREMENT VHAL_CANMsgInvalidzGWCANFr1_flg /end REF_MEASUREMENT /end GROUP
/begin GROUP S12_VHAL_CANMsgInvalidzGWLINDr1_flg "SWC_HALIN_type/run_SWC_HALIN_Rx_5ms_sys/HAL_IN/CAN4/VHAL_CANMsgInvalidzGWLINDr1_flg" /begin REF_MEASUREMENT VHAL_CANMsgInvalidzGWLINDr1_flg /end REF_MEASUREMENT /end GROUP
/begin GROUP S12_VHAL_CANMsgInvalidzGWLINDr2_flg "SWC_HALIN_type/run_SWC_HALIN_Rx_5ms_sys/HAL_IN/CAN4/VHAL_CANMsgInvalidzGWLINDr2_flg" /begin REF_MEASUREMENT VHAL_CANMsgInvalidzGWLINDr2_flg /end REF_MEASUREMENT /end GROUP
/begin GROUP S12_VHAL_CANMsgInvalidzGWLINFr1_flg "SWC_HALIN_type/run_SWC_HALIN_Rx_5ms_sys/HAL_IN/CAN4/VHAL_CANMsgInvalidzGWLINFr1_flg" /begin REF_MEASUREMENT VHAL_CANMsgInvalidzGWLINFr1_flg /end REF_MEASUREMENT /end GROUP
/begin GROUP S12_VHAL_CANMsgInvalidzGWLINFr2_flg "SWC_HALIN_type/run_SWC_HALIN_Rx_5ms_sys/HAL_IN/CAN4/VHAL_CANMsgInvalidzGWLINFr2_flg" /begin REF_MEASUREMENT VHAL_CANMsgInvalidzGWLINFr2_flg /end REF_MEASUREMENT /end GROUP
/begin GROUP S12_VHAL_CANMsgInvalidzGWSEAT1_flg "SWC_HALIN_type/run_SWC_HALIN_Rx_5ms_sys/HAL_IN/CAN4/VHAL_CANMsgInvalidzGWSEAT1_flg" /begin REF_MEASUREMENT VHAL_CANMsgInvalidzGWSEAT1_flg /end REF_MEASUREMENT /end GROUP
/begin GROUP S12_ZONE_DR1 "SWC_HALIN_type/run_SWC_HALIN_Rx_5ms_sys/HAL_IN/CAN4/ZONE_DR1" /begin SUB_GROUP S1060_RLTurnLampC S1060_RRTurnLampC /end SUB_GROUP /end GROUP
/begin GROUP S12_ZONE_DR_VCU "SWC_HALIN_type/run_SWC_HALIN_Rx_5ms_sys/HAL_IN/CAN4/ZONE_DR_VCU"
 /begin SUB_GROUP S1061_BlowerErr S1061_LeftHallPos S1061_SolarL S1061_SolarLErr S1061_SolarR S1061_SolarRErr S1061_TFaceL S1061_TFaceLErr S1061_TFaceR S1061_TFaceRErr S1061_TFaceRr S1061_TFaceRrErr S1061_TFootL S1061_TFootLErr S1061_TFootR S1061_TFootRErr S1061_TFootRr S1061_TFootRrErr S1061_Tevap S1061_TevapErr S1061_Tincar S1061_TincarErr S1061_ZoneDrMalfunLevel /end SUB_GROUP
/end GROUP
/begin GROUP S12_ZONE_FR1 "SWC_HALIN_type/run_SWC_HALIN_Rx_5ms_sys/HAL_IN/CAN4/ZONE_FR1" /begin SUB_GROUP S1062_FLTurnLampC S1062_FRTurnLampC S1062_TrailerModeSta /end SUB_GROUP /end GROUP
/begin GROUP S12_ZONE_FR_VCU "SWC_HALIN_type/run_SWC_HALIN_Rx_5ms_sys/HAL_IN/CAN4/ZONE_FR_VCU"
 /begin SUB_GROUP S1063_AGSErr S1063_BatInTemp S1063_BatInTempErr S1063_BatOutTemp S1063_COMPErr S1063_EACProtectEnable S1063_EWP3Err S1063_EXV1Err S1063_EXV2Err S1063_FanErr S1063_MotorInTemp S1063_MotorInTempErr S1063_MotorOutTemp S1063_MotorOutTempErr S1063_PTHighPErr S1063_PTHighTact S1063_PTHighTactErr S1063_PTLowP1Err S1063_PTLowP2Err S1063_PTLowT1 S1063_PTLowT1Err S1063_PTLowT2 S1063_PTLowT2Err S1063_SOTXVErr S1063_SOV1Err S1063_SOV2Err S1063_SOV3Err S1063_Tamb S1063_TambErr /end SUB_GROUP
/end GROUP
/begin GROUP S12_zGW_APTC1 "SWC_HALIN_type/run_SWC_HALIN_Rx_5ms_sys/HAL_IN/CAN4/zGW_APTC1"
 /begin SUB_GROUP S1064_FrntPTCLeActHeatPwr S1064_FrntPTCRearLeActHeatPwr S1064_FrntPTCRearRiActHeatPwr S1064_FrntPTCRiActHeatPwr /end SUB_GROUP
/end GROUP
/begin GROUP S12_zGW_CANFr1 "SWC_HALIN_type/run_SWC_HALIN_Rx_5ms_sys/HAL_IN/CAN4/zGW_CANFr1"
 /begin SUB_GROUP S1065_COMPConCur S1065_COMPConVolt S1065_PTC1PowerConsumption /end SUB_GROUP
/end GROUP
/begin GROUP S12_zGW_LINDr1 "SWC_HALIN_type/run_SWC_HALIN_Rx_5ms_sys/HAL_IN/CAN4/zGW_LINDr1"
 /begin SUB_GROUP S1066_CSWFWasSwSta S1066_CSWFWipSwSta S1066_CSWRWasSWSta S1066_CSWRWipIntSwSta S1066_CSWTurnSwSta S1066_LDrvWdwPositionSts S1066_LPasWdwPositionSts S1066_LRLDWdwPositionSts S1066_LRRDWdwPositionSts S1066_RLSRainSnrWiperCmd /end SUB_GROUP
/end GROUP
/begin GROUP S12_zGW_LINFr1 "SWC_HALIN_type/run_SWC_HALIN_Rx_5ms_sys/HAL_IN/CAN4/zGW_LINFr1" /begin SUB_GROUP S1068_AGSActualPosition S1068_FGSIntenRspSta /end SUB_GROUP /end GROUP
/begin GROUP S12_zGW_LINFr2 "SWC_HALIN_type/run_SWC_HALIN_Rx_5ms_sys/HAL_IN/CAN4/zGW_LINFr2"
 /begin SUB_GROUP S1069_EWP1BlockError S1069_EWP1OverCurrError S1069_EWP2BlockError S1069_EWP2OverCurrError S1069_EWP3BlockError S1069_EWP3OverCurrError /end SUB_GROUP
/end GROUP
/begin GROUP S12_zGW_SEAT1 "SWC_HALIN_type/run_SWC_HALIN_Rx_5ms_sys/HAL_IN/CAN4/zGW_SEAT1"
 /begin SUB_GROUP S1070_DSEATHWVer S1070_DSEATMode S1070_DSEATSWVer S1070_DSEATVentSta S1070_DSEATheatersta S1070_PSEATHWVer S1070_PSEATMode S1070_PSEATSWVer S1070_PSEATVentSta S1070_PSEATheatersta /end SUB_GROUP
/end GROUP
/begin GROUP S13_TBOX2 "SWC_HALIN_type/run_SWC_HALIN_Rx_5ms_sys/HAL_IN/CAN5/TBOX2" /begin SUB_GROUP S1372_TimeSyncFromBSYear /end SUB_GROUP /end GROUP
/begin GROUP S13_TBOX3 "SWC_HALIN_type/run_SWC_HALIN_Rx_5ms_sys/HAL_IN/CAN5/TBOX3" /begin SUB_GROUP S1373_ReserveChargeOFFYear S1373_ReserveChargeOnYear /end SUB_GROUP /end GROUP
/begin GROUP S13_VHAL_CANMsgInvalidTBOX2_flg "SWC_HALIN_type/run_SWC_HALIN_Rx_5ms_sys/HAL_IN/CAN5/VHAL_CANMsgInvalidTBOX2_flg" /begin REF_MEASUREMENT VHAL_CANMsgInvalidTBOX2_flg /end REF_MEASUREMENT /end GROUP
/begin GROUP S13_VHAL_CANMsgInvalidTBOX3_flg "SWC_HALIN_type/run_SWC_HALIN_Rx_5ms_sys/HAL_IN/CAN5/VHAL_CANMsgInvalidTBOX3_flg" /begin REF_MEASUREMENT VHAL_CANMsgInvalidTBOX3_flg /end REF_MEASUREMENT /end GROUP
/begin GROUP S14_FCM1 "SWC_HALIN_type/run_SWC_HALIN_Rx_5ms_sys/HAL_IN/CAN6/FCM1"
 /begin SUB_GROUP S1400_ACCComfortBandLower S1400_ACCComfortBandUpper S1400_ACCJerkLowerLimit S1400_ACCJerkUpperLimit S1400_ACCObjDist S1400_ACCObjRelSpd S1400_ACCRequiredAccel S1400_ADASLanecurveL S1400_ADASLanecurveR S1400_FCMLKAStrToqReq /end SUB_GROUP
/end GROUP
/begin GROUP S14_FCM2 "SWC_HALIN_type/run_SWC_HALIN_Rx_5ms_sys/HAL_IN/CAN6/FCM2" /begin SUB_GROUP S1401_DDM_CS_RC_Comparison /end SUB_GROUP /begin REF_CHARACTERISTIC KHAL_CAN6FCM2E2E_flg /end REF_CHARACTERISTIC /end GROUP
/begin GROUP S14_FCM3 "SWC_HALIN_type/run_SWC_HALIN_Rx_5ms_sys/HAL_IN/CAN6/FCM3"
 /begin SUB_GROUP S1402_MELaneCurvDervLt S1402_MELaneCurvDervLt2 S1402_MELaneCurvDervRt S1402_MELaneCurvDervRt2 S1402_MELaneCurvLt S1402_MELaneCurvLt2 S1402_MELaneCurvRt S1402_MELaneCurvRt2 S1402_MELaneHeadAngLt S1402_MELaneHeadAngLt2 S1402_MELaneHeadAngRt S1402_MELaneHeadAngRt2 S1402_MELanePosLt S1402_MELanePosLt2 S1402_MELanePosRt S1402_MELanePosRt2 /end SUB_GROUP
/end GROUP
/begin GROUP S14_FCM4 "SWC_HALIN_type/run_SWC_HALIN_Rx_5ms_sys/HAL_IN/CAN6/FCM4"
 /begin SUB_GROUP S1403_ADASAngCtrlTqWeightGain S1403_ADASDesStrWhlAngCtrlCmd S1403_ADASDrvInputTqBoostGain S1403_ADASMaxAngCtrlOutTqLimit S1403_DDM_CS_RC_Comparison /end SUB_GROUP
 /begin REF_CHARACTERISTIC KHAL_CAN6FCM4E2E_flg /end REF_CHARACTERISTIC
/end GROUP
/begin GROUP S14_VHAL_CANMsgInvalidFCM1_flg "SWC_HALIN_type/run_SWC_HALIN_Rx_5ms_sys/HAL_IN/CAN6/VHAL_CANMsgInvalidFCM1_flg" /begin REF_MEASUREMENT VHAL_CANMsgInvalidFCM1_flg /end REF_MEASUREMENT /end GROUP
/begin GROUP S14_VHAL_CANMsgInvalidFCM2_flg "SWC_HALIN_type/run_SWC_HALIN_Rx_5ms_sys/HAL_IN/CAN6/VHAL_CANMsgInvalidFCM2_flg" /begin REF_MEASUREMENT VHAL_CANMsgInvalidFCM2_flg /end REF_MEASUREMENT /end GROUP
/begin GROUP S14_VHAL_CANMsgInvalidFCM3_flg "SWC_HALIN_type/run_SWC_HALIN_Rx_5ms_sys/HAL_IN/CAN6/VHAL_CANMsgInvalidFCM3_flg" /begin REF_MEASUREMENT VHAL_CANMsgInvalidFCM3_flg /end REF_MEASUREMENT /end GROUP
/begin GROUP S14_VHAL_CANMsgInvalidFCM4_flg "SWC_HALIN_type/run_SWC_HALIN_Rx_5ms_sys/HAL_IN/CAN6/VHAL_CANMsgInvalidFCM4_flg" /begin REF_MEASUREMENT VHAL_CANMsgInvalidFCM4_flg /end REF_MEASUREMENT /end GROUP
/begin GROUP S14_VHAL_CANMsgInvalidSRR1_flg "SWC_HALIN_type/run_SWC_HALIN_Rx_5ms_sys/HAL_IN/CAN6/VHAL_CANMsgInvalidSRR1_flg" /begin REF_MEASUREMENT VHAL_CANMsgInvalidSRR1_flg /end REF_MEASUREMENT /end GROUP
/begin GROUP S15_DDM_CS_RC_Comparison "SWC_HALIN_type/run_SWC_HALIN_Rx_5ms_sys/HAL_IN/CAN1/ABM1/DDM_CS&RC_Comparison" /begin SUB_GROUP S34_CRC8_Compare /end SUB_GROUP /end GROUP
/begin GROUP S16_DDM_CS_RC_Comparison "SWC_HALIN_type/run_SWC_HALIN_Rx_5ms_sys/HAL_IN/CAN1/EPB1/DDM_CS&RC_Comparison" /begin SUB_GROUP S59_CRC8_Compare /end SUB_GROUP /end GROUP
/begin GROUP S17_DDM_CS_RC_Comparison "SWC_HALIN_type/run_SWC_HALIN_Rx_5ms_sys/HAL_IN/CAN1/EPS1/DDM_CS&RC_Comparison" /begin SUB_GROUP S82_CRC8_Compare /end SUB_GROUP /end GROUP
/begin GROUP S17_SASAngle "SWC_HALIN_type/run_SWC_HALIN_Rx_5ms_sys/HAL_IN/CAN1/EPS1/SASAngle" /begin SUB_GROUP S88_convert_in /end SUB_GROUP /end GROUP
/begin GROUP S17_SASSpeed "SWC_HALIN_type/run_SWC_HALIN_Rx_5ms_sys/HAL_IN/CAN1/EPS1/SASSpeed" /begin SUB_GROUP S90_convert_in /end SUB_GROUP /end GROUP
/begin GROUP S18_DDM_CS_RC_Comparison "SWC_HALIN_type/run_SWC_HALIN_Rx_5ms_sys/HAL_IN/CAN1/ESC1/DDM_CS&RC_Comparison" /begin SUB_GROUP S116_CRC8_Compare /end SUB_GROUP /end GROUP
/begin GROUP S18_FrntAxlTrqReqDrv "SWC_HALIN_type/run_SWC_HALIN_Rx_5ms_sys/HAL_IN/CAN1/ESC1/FrntAxlTrqReqDrv" /begin SUB_GROUP S129_convert_in /end SUB_GROUP /end GROUP
/begin GROUP S18_GRADE "SWC_HALIN_type/run_SWC_HALIN_Rx_5ms_sys/HAL_IN/CAN1/ESC1/GRADE" /begin SUB_GROUP S130_convert_in /end SUB_GROUP /end GROUP
/begin GROUP S18_LFRawWhlSpeed "SWC_HALIN_type/run_SWC_HALIN_Rx_5ms_sys/HAL_IN/CAN1/ESC1/LFRawWhlSpeed" /begin SUB_GROUP S139_convert_in /end SUB_GROUP /end GROUP
/begin GROUP S18_LRRawWhlSpeed "SWC_HALIN_type/run_SWC_HALIN_Rx_5ms_sys/HAL_IN/CAN1/ESC1/LRRawWhlSpeed" /begin SUB_GROUP S144_convert_in /end SUB_GROUP /end GROUP
/begin GROUP S18_RFRawWhlSpeed "SWC_HALIN_type/run_SWC_HALIN_Rx_5ms_sys/HAL_IN/CAN1/ESC1/RFRawWhlSpeed" /begin SUB_GROUP S152_convert_in /end SUB_GROUP /end GROUP
/begin GROUP S18_RRRawWhlSpeed "SWC_HALIN_type/run_SWC_HALIN_Rx_5ms_sys/HAL_IN/CAN1/ESC1/RRRawWhlSpeed" /begin SUB_GROUP S157_convert_in /end SUB_GROUP /end GROUP
/begin GROUP S18_RearAxlTrqReqDrv "SWC_HALIN_type/run_SWC_HALIN_Rx_5ms_sys/HAL_IN/CAN1/ESC1/RearAxlTrqReqDrv" /begin SUB_GROUP S160_convert_in /end SUB_GROUP /end GROUP
/begin GROUP S18_VehSpeed "SWC_HALIN_type/run_SWC_HALIN_Rx_5ms_sys/HAL_IN/CAN1/ESC1/VehSpeed" /begin SUB_GROUP S165_convert_in /end SUB_GROUP /end GROUP
/begin GROUP S19_BrkPedalPos "SWC_HALIN_type/run_SWC_HALIN_Rx_5ms_sys/HAL_IN/CAN1/ESC5/BrkPedalPos" /begin SUB_GROUP S192_convert_in /end SUB_GROUP /end GROUP
/begin GROUP S19_DDM_CS_RC_Comparison "SWC_HALIN_type/run_SWC_HALIN_Rx_5ms_sys/HAL_IN/CAN1/ESC5/DDM_CS&RC_Comparison" /begin SUB_GROUP S196_CRC8_Compare /end SUB_GROUP /end GROUP
/begin GROUP S19_FrntAxlTrqReqBrk "SWC_HALIN_type/run_SWC_HALIN_Rx_5ms_sys/HAL_IN/CAN1/ESC5/FrntAxlTrqReqBrk" /begin SUB_GROUP S203_convert_in /end SUB_GROUP /end GROUP
/begin GROUP S19_LatAccel "SWC_HALIN_type/run_SWC_HALIN_Rx_5ms_sys/HAL_IN/CAN1/ESC5/LatAccel" /begin SUB_GROUP S204_convert_in /end SUB_GROUP /end GROUP
/begin GROUP S19_LongAccel "SWC_HALIN_type/run_SWC_HALIN_Rx_5ms_sys/HAL_IN/CAN1/ESC5/LongAccel" /begin SUB_GROUP S206_convert_in /end SUB_GROUP /end GROUP
/begin GROUP S19_MCPressure "SWC_HALIN_type/run_SWC_HALIN_Rx_5ms_sys/HAL_IN/CAN1/ESC5/MCPressure" /begin SUB_GROUP S208_convert_in /end SUB_GROUP /end GROUP
/begin GROUP S19_MeterIndVehSpeed "SWC_HALIN_type/run_SWC_HALIN_Rx_5ms_sys/HAL_IN/CAN1/ESC5/MeterIndVehSpeed" /begin SUB_GROUP S211_convert_in /end SUB_GROUP /end GROUP
/begin GROUP S19_RearAxlTrqReqBrk "SWC_HALIN_type/run_SWC_HALIN_Rx_5ms_sys/HAL_IN/CAN1/ESC5/RearAxlTrqReqBrk" /begin SUB_GROUP S213_convert_in /end SUB_GROUP /end GROUP
/begin GROUP S19_YawRate "SWC_HALIN_type/run_SWC_HALIN_Rx_5ms_sys/HAL_IN/CAN1/ESC5/YawRate" /begin SUB_GROUP S215_convert_in /end SUB_GROUP /end GROUP
/begin GROUP S250_IVITimeYear "SWC_HALIN_type/run_SWC_HALIN_Rx_5ms_sys/HAL_IN/CAN2/IVI1/IVITimeYear" /begin SUB_GROUP S306_convert_in /end SUB_GROUP /end GROUP
/begin GROUP S251_ACChgCurSet "SWC_HALIN_type/run_SWC_HALIN_Rx_5ms_sys/HAL_IN/CAN2/IVI2/ACChgCurSet" /begin SUB_GROUP S315_convert_in /end SUB_GROUP /end GROUP
/begin GROUP S251_SOCLimitSet "SWC_HALIN_type/run_SWC_HALIN_Rx_5ms_sys/HAL_IN/CAN2/IVI2/SOCLimitSet" /begin SUB_GROUP S390_convert_in /end SUB_GROUP /end GROUP
/begin GROUP S251_SchedChglimit "SWC_HALIN_type/run_SWC_HALIN_Rx_5ms_sys/HAL_IN/CAN2/IVI2/SchedChglimit" /begin SUB_GROUP S395_convert_in /end SUB_GROUP /end GROUP
/begin GROUP S251_sigSetTempZon1Req "SWC_HALIN_type/run_SWC_HALIN_Rx_5ms_sys/HAL_IN/CAN2/IVI2/sigSetTempZon1Req" /begin SUB_GROUP S410_convert_in /end SUB_GROUP /end GROUP
/begin GROUP S251_sigSetTempZon2Req "SWC_HALIN_type/run_SWC_HALIN_Rx_5ms_sys/HAL_IN/CAN2/IVI2/sigSetTempZon2Req" /begin SUB_GROUP S411_convert_in /end SUB_GROUP /end GROUP
/begin GROUP S253_ODOMETER "SWC_HALIN_type/run_SWC_HALIN_Rx_5ms_sys/HAL_IN/CAN2/METER1/ODOMETER" /begin SUB_GROUP S455_convert_in /end SUB_GROUP /end GROUP
/begin GROUP S462_DDM_CS_RC_Comparison "SWC_HALIN_type/run_SWC_HALIN_Rx_5ms_sys/HAL_IN/CAN3/BMS1/DDM_CS&RC_Comparison" /begin SUB_GROUP S506_CRC8_Compare /end SUB_GROUP /end GROUP
/begin GROUP S462_HVBPwrAvailChrg "SWC_HALIN_type/run_SWC_HALIN_Rx_5ms_sys/HAL_IN/CAN3/BMS1/HVBPwrAvailChrg" /begin SUB_GROUP S507_convert_in /end SUB_GROUP /end GROUP
/begin GROUP S462_HVBPwrAvailChrg30 "SWC_HALIN_type/run_SWC_HALIN_Rx_5ms_sys/HAL_IN/CAN3/BMS1/HVBPwrAvailChrg30" /begin SUB_GROUP S508_convert_in /end SUB_GROUP /end GROUP
/begin GROUP S462_HVBPwrAvailChrg60 "SWC_HALIN_type/run_SWC_HALIN_Rx_5ms_sys/HAL_IN/CAN3/BMS1/HVBPwrAvailChrg60" /begin SUB_GROUP S509_convert_in /end SUB_GROUP /end GROUP
/begin GROUP S462_HVBPwrAvailDchrg "SWC_HALIN_type/run_SWC_HALIN_Rx_5ms_sys/HAL_IN/CAN3/BMS1/HVBPwrAvailDchrg" /begin SUB_GROUP S510_convert_in /end SUB_GROUP /end GROUP
/begin GROUP S462_HVBPwrAvailDchrg30 "SWC_HALIN_type/run_SWC_HALIN_Rx_5ms_sys/HAL_IN/CAN3/BMS1/HVBPwrAvailDchrg30" /begin SUB_GROUP S511_convert_in /end SUB_GROUP /end GROUP
/begin GROUP S462_HVBPwrAvailDchrg60 "SWC_HALIN_type/run_SWC_HALIN_Rx_5ms_sys/HAL_IN/CAN3/BMS1/HVBPwrAvailDchrg60" /begin SUB_GROUP S512_convert_in /end SUB_GROUP /end GROUP
/begin GROUP S462_HVBattCurr "SWC_HALIN_type/run_SWC_HALIN_Rx_5ms_sys/HAL_IN/CAN3/BMS1/HVBattCurr" /begin SUB_GROUP S513_convert_in /end SUB_GROUP /end GROUP
/begin GROUP S462_HVBattVolt "SWC_HALIN_type/run_SWC_HALIN_Rx_5ms_sys/HAL_IN/CAN3/BMS1/HVBattVolt" /begin SUB_GROUP S514_convert_in /end SUB_GROUP /end GROUP
/begin GROUP S463_ACChrgCurrDis "SWC_HALIN_type/run_SWC_HALIN_Rx_5ms_sys/HAL_IN/CAN3/BMS3/ACChrgCurrDis" /begin SUB_GROUP S538_convert_in /end SUB_GROUP /end GROUP
/begin GROUP S463_HVBChrgPwr "SWC_HALIN_type/run_SWC_HALIN_Rx_5ms_sys/HAL_IN/CAN3/BMS3/HVBChrgPwr" /begin SUB_GROUP S540_convert_in /end SUB_GROUP /end GROUP
/begin GROUP S463_HVBDrvPwr "SWC_HALIN_type/run_SWC_HALIN_Rx_5ms_sys/HAL_IN/CAN3/BMS3/HVBDrvPwr" /begin SUB_GROUP S542_convert_in /end SUB_GROUP /end GROUP
/begin GROUP S463_HVBFullChrgPwr "SWC_HALIN_type/run_SWC_HALIN_Rx_5ms_sys/HAL_IN/CAN3/BMS3/HVBFullChrgPwr" /begin SUB_GROUP S544_convert_in /end SUB_GROUP /end GROUP
/begin GROUP S463_HVBIsoImpedenceN "SWC_HALIN_type/run_SWC_HALIN_Rx_5ms_sys/HAL_IN/CAN3/BMS3/HVBIsoImpedenceN" /begin SUB_GROUP S545_convert_in /end SUB_GROUP /end GROUP
/begin GROUP S463_HVBIsoImpedenceP "SWC_HALIN_type/run_SWC_HALIN_Rx_5ms_sys/HAL_IN/CAN3/BMS3/HVBIsoImpedenceP" /begin SUB_GROUP S546_convert_in /end SUB_GROUP /end GROUP
/begin GROUP S463_HVBSOH "SWC_HALIN_type/run_SWC_HALIN_Rx_5ms_sys/HAL_IN/CAN3/BMS3/HVBSOH" /begin SUB_GROUP S547_convert_in /end SUB_GROUP /end GROUP
/begin GROUP S463_HVBattPackVolt "SWC_HALIN_type/run_SWC_HALIN_Rx_5ms_sys/HAL_IN/CAN3/BMS3/HVBattPackVolt" /begin SUB_GROUP S549_convert_in /end SUB_GROUP /end GROUP
/begin GROUP S463_HVBattSOC "SWC_HALIN_type/run_SWC_HALIN_Rx_5ms_sys/HAL_IN/CAN3/BMS3/HVBattSOC" /begin SUB_GROUP S550_convert_in /end SUB_GROUP /end GROUP
/begin GROUP S463_HVBattSOCDis "SWC_HALIN_type/run_SWC_HALIN_Rx_5ms_sys/HAL_IN/CAN3/BMS3/HVBattSOCDis" /begin SUB_GROUP S551_convert_in /end SUB_GROUP /end GROUP
/begin GROUP S464_CellTempAvg "SWC_HALIN_type/run_SWC_HALIN_Rx_5ms_sys/HAL_IN/CAN3/BMS4/CellTempAvg" /begin SUB_GROUP S563_convert_in /end SUB_GROUP /end GROUP
/begin GROUP S464_HVBMTempMax "SWC_HALIN_type/run_SWC_HALIN_Rx_5ms_sys/HAL_IN/CAN3/BMS4/HVBMTempMax" /begin SUB_GROUP S566_convert_in /end SUB_GROUP /end GROUP
/begin GROUP S464_HVBMTempMin "SWC_HALIN_type/run_SWC_HALIN_Rx_5ms_sys/HAL_IN/CAN3/BMS4/HVBMTempMin" /begin SUB_GROUP S567_convert_in /end SUB_GROUP /end GROUP
/begin GROUP S465_HVInVolt "SWC_HALIN_type/run_SWC_HALIN_Rx_5ms_sys/HAL_IN/CAN3/BMS5/HVInVolt" /begin SUB_GROUP S575_convert_in /end SUB_GROUP /end GROUP
/begin GROUP S465_LVBattDet12V "SWC_HALIN_type/run_SWC_HALIN_Rx_5ms_sys/HAL_IN/CAN3/BMS5/LVBattDet12V" /begin SUB_GROUP S576_convert_in /end SUB_GROUP /end GROUP
/begin GROUP S465_OBCDCCurLm "SWC_HALIN_type/run_SWC_HALIN_Rx_5ms_sys/HAL_IN/CAN3/BMS5/OBCDCCurLm" /begin SUB_GROUP S578_convert_in /end SUB_GROUP /end GROUP
/begin GROUP S465_OBCDCVoltLm "SWC_HALIN_type/run_SWC_HALIN_Rx_5ms_sys/HAL_IN/CAN3/BMS5/OBCDCVoltLm" /begin SUB_GROUP S579_convert_in /end SUB_GROUP /end GROUP
/begin GROUP S466_DDM_CS_RC_Comparison "SWC_HALIN_type/run_SWC_HALIN_Rx_5ms_sys/HAL_IN/CAN3/BMS6/DDM_CS&RC_Comparison" /begin SUB_GROUP S597_CRC8_Compare /end SUB_GROUP /end GROUP
/begin GROUP S468_DCDCAuxCur "SWC_HALIN_type/run_SWC_HALIN_Rx_5ms_sys/HAL_IN/CAN3/CCU1/DCDCAuxCur" /begin SUB_GROUP S627_convert_in /end SUB_GROUP /end GROUP
/begin GROUP S468_DCDCAuxVolt "SWC_HALIN_type/run_SWC_HALIN_Rx_5ms_sys/HAL_IN/CAN3/CCU1/DCDCAuxVolt" /begin SUB_GROUP S628_convert_in /end SUB_GROUP /end GROUP
/begin GROUP S468_DCDCHVCur "SWC_HALIN_type/run_SWC_HALIN_Rx_5ms_sys/HAL_IN/CAN3/CCU1/DCDCHVCur" /begin SUB_GROUP S629_convert_in /end SUB_GROUP /end GROUP
/begin GROUP S468_DCDCInVoltInf "SWC_HALIN_type/run_SWC_HALIN_Rx_5ms_sys/HAL_IN/CAN3/CCU1/DCDCInVoltInf" /begin SUB_GROUP S630_convert_in /end SUB_GROUP /end GROUP
/begin GROUP S468_DDM_CS_RC_Comparison "SWC_HALIN_type/run_SWC_HALIN_Rx_5ms_sys/HAL_IN/CAN3/CCU1/DDM_CS&RC_Comparison" /begin SUB_GROUP S632_CRC8_Compare /end SUB_GROUP /end GROUP
/begin GROUP S468_OBCDCCurrInf "SWC_HALIN_type/run_SWC_HALIN_Rx_5ms_sys/HAL_IN/CAN3/CCU1/OBCDCCurrInf" /begin SUB_GROUP S634_convert_in /end SUB_GROUP /end GROUP
/begin GROUP S468_OBCDCVoltInf "SWC_HALIN_type/run_SWC_HALIN_Rx_5ms_sys/HAL_IN/CAN3/CCU1/OBCDCVoltInf" /begin SUB_GROUP S635_convert_in /end SUB_GROUP /end GROUP
/begin GROUP S469_DCDCTemp "SWC_HALIN_type/run_SWC_HALIN_Rx_5ms_sys/HAL_IN/CAN3/CCU2/DCDCTemp" /begin SUB_GROUP S663_convert_in /end SUB_GROUP /end GROUP
/begin GROUP S469_DDM_CS_RC_Comparison "SWC_HALIN_type/run_SWC_HALIN_Rx_5ms_sys/HAL_IN/CAN3/CCU2/DDM_CS&RC_Comparison" /begin SUB_GROUP S664_CRC8_Compare /end SUB_GROUP /end GROUP
/begin GROUP S469_OBCACCurrInf "SWC_HALIN_type/run_SWC_HALIN_Rx_5ms_sys/HAL_IN/CAN3/CCU2/OBCACCurrInf" /begin SUB_GROUP S667_convert_in /end SUB_GROUP /end GROUP
/begin GROUP S469_OBCACVoltInf "SWC_HALIN_type/run_SWC_HALIN_Rx_5ms_sys/HAL_IN/CAN3/CCU2/OBCACVoltInf" /begin SUB_GROUP S668_convert_in /end SUB_GROUP /end GROUP
/begin GROUP S469_OBCTemp "SWC_HALIN_type/run_SWC_HALIN_Rx_5ms_sys/HAL_IN/CAN3/CCU2/OBCTemp" /begin SUB_GROUP S673_convert_in /end SUB_GROUP /end GROUP
/begin GROUP S471_DDM_CS_RC_Comparison "SWC_HALIN_type/run_SWC_HALIN_Rx_5ms_sys/HAL_IN/CAN3/MCU_B_F1/DDM_CS&RC_Comparison" /begin SUB_GROUP S696_CRC8_Compare /end SUB_GROUP /end GROUP
/begin GROUP S471_FrEDURealTMTq "SWC_HALIN_type/run_SWC_HALIN_Rx_5ms_sys/HAL_IN/CAN3/MCU_B_F1/FrEDURealTMTq" /begin SUB_GROUP S700_convert_in /end SUB_GROUP /end GROUP
/begin GROUP S471_FrEDUTqReqFbk "SWC_HALIN_type/run_SWC_HALIN_Rx_5ms_sys/HAL_IN/CAN3/MCU_B_F1/FrEDUTqReqFbk" /begin SUB_GROUP S702_convert_in /end SUB_GROUP /end GROUP
/begin GROUP S471_FrMCUBAT "SWC_HALIN_type/run_SWC_HALIN_Rx_5ms_sys/HAL_IN/CAN3/MCU_B_F1/FrMCUBAT" /begin SUB_GROUP S705_convert_in /end SUB_GROUP /end GROUP
/begin GROUP S471_FrMCUDCBusCurr "SWC_HALIN_type/run_SWC_HALIN_Rx_5ms_sys/HAL_IN/CAN3/MCU_B_F1/FrMCUDCBusCurr" /begin SUB_GROUP S706_convert_in /end SUB_GROUP /end GROUP
/begin GROUP S471_FrMCUDCBusVolt "SWC_HALIN_type/run_SWC_HALIN_Rx_5ms_sys/HAL_IN/CAN3/MCU_B_F1/FrMCUDCBusVolt" /begin SUB_GROUP S707_convert_in /end SUB_GROUP /end GROUP
/begin GROUP S471_FrMCUTemp "SWC_HALIN_type/run_SWC_HALIN_Rx_5ms_sys/HAL_IN/CAN3/MCU_B_F1/FrMCUTemp" /begin SUB_GROUP S715_convert_in /end SUB_GROUP /end GROUP
/begin GROUP S471_FrRegenAvailTq "SWC_HALIN_type/run_SWC_HALIN_Rx_5ms_sys/HAL_IN/CAN3/MCU_B_F1/FrRegenAvailTq" /begin SUB_GROUP S717_convert_in /end SUB_GROUP /end GROUP
/begin GROUP S471_FrTMSpd "SWC_HALIN_type/run_SWC_HALIN_Rx_5ms_sys/HAL_IN/CAN3/MCU_B_F1/FrTMSpd" /begin SUB_GROUP S718_convert_in /end SUB_GROUP /end GROUP
/begin GROUP S471_FrTMTemp "SWC_HALIN_type/run_SWC_HALIN_Rx_5ms_sys/HAL_IN/CAN3/MCU_B_F1/FrTMTemp" /begin SUB_GROUP S719_convert_in /end SUB_GROUP /end GROUP
/begin GROUP S471_FrTMid "SWC_HALIN_type/run_SWC_HALIN_Rx_5ms_sys/HAL_IN/CAN3/MCU_B_F1/FrTMid" /begin SUB_GROUP S720_convert_in /end SUB_GROUP /end GROUP
/begin GROUP S471_FrTMiq "SWC_HALIN_type/run_SWC_HALIN_Rx_5ms_sys/HAL_IN/CAN3/MCU_B_F1/FrTMiq" /begin SUB_GROUP S721_convert_in /end SUB_GROUP /end GROUP
/begin GROUP S471_MCUBFRealPwrKwSta "SWC_HALIN_type/run_SWC_HALIN_Rx_5ms_sys/HAL_IN/CAN3/MCU_B_F1/MCUBFRealPwrKwSta" /begin SUB_GROUP S722_convert_in /end SUB_GROUP /end GROUP
/begin GROUP S472_FrCoolanttempReq "SWC_HALIN_type/run_SWC_HALIN_Rx_5ms_sys/HAL_IN/CAN3/MCU_B_F2/FrCoolanttempReq" /begin SUB_GROUP S751_convert_in /end SUB_GROUP /end GROUP
/begin GROUP S472_FrLLCTemp "SWC_HALIN_type/run_SWC_HALIN_Rx_5ms_sys/HAL_IN/CAN3/MCU_B_F2/FrLLCTemp" /begin SUB_GROUP S756_convert_in /end SUB_GROUP /end GROUP
/begin GROUP S472_FrLLCflowReq "SWC_HALIN_type/run_SWC_HALIN_Rx_5ms_sys/HAL_IN/CAN3/MCU_B_F2/FrLLCflowReq" /begin SUB_GROUP S757_convert_in /end SUB_GROUP /end GROUP
/begin GROUP S473_DDM_CS_RC_Comparison "SWC_HALIN_type/run_SWC_HALIN_Rx_5ms_sys/HAL_IN/CAN3/MCU_B_R1/DDM_CS&RC_Comparison" /begin SUB_GROUP S766_CRC8_Compare /end SUB_GROUP /end GROUP
/begin GROUP S473_MCUBRRealPwrKwSta "SWC_HALIN_type/run_SWC_HALIN_Rx_5ms_sys/HAL_IN/CAN3/MCU_B_R1/MCUBRRealPwrKwSta" /begin SUB_GROUP S767_convert_in /end SUB_GROUP /end GROUP
/begin GROUP S473_RrEDURealTMTq "SWC_HALIN_type/run_SWC_HALIN_Rx_5ms_sys/HAL_IN/CAN3/MCU_B_R1/RrEDURealTMTq" /begin SUB_GROUP S773_convert_in /end SUB_GROUP /end GROUP
/begin GROUP S473_RrEDUTqReqFbk "SWC_HALIN_type/run_SWC_HALIN_Rx_5ms_sys/HAL_IN/CAN3/MCU_B_R1/RrEDUTqReqFbk" /begin SUB_GROUP S775_convert_in /end SUB_GROUP /end GROUP
/begin GROUP S473_RrMCUBAT "SWC_HALIN_type/run_SWC_HALIN_Rx_5ms_sys/HAL_IN/CAN3/MCU_B_R1/RrMCUBAT" /begin SUB_GROUP S778_convert_in /end SUB_GROUP /end GROUP
/begin GROUP S473_RrMCUDCBusCurr "SWC_HALIN_type/run_SWC_HALIN_Rx_5ms_sys/HAL_IN/CAN3/MCU_B_R1/RrMCUDCBusCurr" /begin SUB_GROUP S779_convert_in /end SUB_GROUP /end GROUP
/begin GROUP S473_RrMCUDCBusVolt "SWC_HALIN_type/run_SWC_HALIN_Rx_5ms_sys/HAL_IN/CAN3/MCU_B_R1/RrMCUDCBusVolt" /begin SUB_GROUP S780_convert_in /end SUB_GROUP /end GROUP
/begin GROUP S473_RrMCUTemp "SWC_HALIN_type/run_SWC_HALIN_Rx_5ms_sys/HAL_IN/CAN3/MCU_B_R1/RrMCUTemp" /begin SUB_GROUP S788_convert_in /end SUB_GROUP /end GROUP
/begin GROUP S473_RrRegenAvailTq "SWC_HALIN_type/run_SWC_HALIN_Rx_5ms_sys/HAL_IN/CAN3/MCU_B_R1/RrRegenAvailTq" /begin SUB_GROUP S790_convert_in /end SUB_GROUP /end GROUP
/begin GROUP S473_RrTMSpd "SWC_HALIN_type/run_SWC_HALIN_Rx_5ms_sys/HAL_IN/CAN3/MCU_B_R1/RrTMSpd" /begin SUB_GROUP S791_convert_in /end SUB_GROUP /end GROUP
/begin GROUP S473_RrTMTemp "SWC_HALIN_type/run_SWC_HALIN_Rx_5ms_sys/HAL_IN/CAN3/MCU_B_R1/RrTMTemp" /begin SUB_GROUP S792_convert_in /end SUB_GROUP /end GROUP
/begin GROUP S473_RrTMid "SWC_HALIN_type/run_SWC_HALIN_Rx_5ms_sys/HAL_IN/CAN3/MCU_B_R1/RrTMid" /begin SUB_GROUP S793_convert_in /end SUB_GROUP /end GROUP
/begin GROUP S473_RrTMiq "SWC_HALIN_type/run_SWC_HALIN_Rx_5ms_sys/HAL_IN/CAN3/MCU_B_R1/RrTMiq" /begin SUB_GROUP S794_convert_in /end SUB_GROUP /end GROUP
/begin GROUP S474_RrCoolanttempReq "SWC_HALIN_type/run_SWC_HALIN_Rx_5ms_sys/HAL_IN/CAN3/MCU_B_R2/RrCoolanttempReq" /begin SUB_GROUP S822_convert_in /end SUB_GROUP /end GROUP
/begin GROUP S474_RrLLCTemp "SWC_HALIN_type/run_SWC_HALIN_Rx_5ms_sys/HAL_IN/CAN3/MCU_B_R2/RrLLCTemp" /begin SUB_GROUP S827_convert_in /end SUB_GROUP /end GROUP
/begin GROUP S474_RrLLCflowReq "SWC_HALIN_type/run_SWC_HALIN_Rx_5ms_sys/HAL_IN/CAN3/MCU_B_R2/RrLLCflowReq" /begin SUB_GROUP S828_convert_in /end SUB_GROUP /end GROUP
/begin GROUP S475_DDM_CS_RC_Comparison "SWC_HALIN_type/run_SWC_HALIN_Rx_5ms_sys/HAL_IN/CAN3/MCU_N_F1/DDM_CS&RC_Comparison" /begin SUB_GROUP S836_CRC8_Compare /end SUB_GROUP /end GROUP
/begin GROUP S475_FrEDURealTMTqNidec "SWC_HALIN_type/run_SWC_HALIN_Rx_5ms_sys/HAL_IN/CAN3/MCU_N_F1/FrEDURealTMTqNidec" /begin SUB_GROUP S840_convert_in /end SUB_GROUP /end GROUP
/begin GROUP S475_FrEDUTqReqFbkNidec "SWC_HALIN_type/run_SWC_HALIN_Rx_5ms_sys/HAL_IN/CAN3/MCU_N_F1/FrEDUTqReqFbkNidec" /begin SUB_GROUP S842_convert_in /end SUB_GROUP /end GROUP
/begin GROUP S475_FrMCUBATNidec "SWC_HALIN_type/run_SWC_HALIN_Rx_5ms_sys/HAL_IN/CAN3/MCU_N_F1/FrMCUBATNidec" /begin SUB_GROUP S845_convert_in /end SUB_GROUP /end GROUP
/begin GROUP S475_FrMCUDCBusCurrNidec "SWC_HALIN_type/run_SWC_HALIN_Rx_5ms_sys/HAL_IN/CAN3/MCU_N_F1/FrMCUDCBusCurrNidec" /begin SUB_GROUP S846_convert_in /end SUB_GROUP /end GROUP
/begin GROUP S475_FrMCUDCBusVoltNidec "SWC_HALIN_type/run_SWC_HALIN_Rx_5ms_sys/HAL_IN/CAN3/MCU_N_F1/FrMCUDCBusVoltNidec" /begin SUB_GROUP S847_convert_in /end SUB_GROUP /end GROUP
/begin GROUP S475_FrMCUTempNidec "SWC_HALIN_type/run_SWC_HALIN_Rx_5ms_sys/HAL_IN/CAN3/MCU_N_F1/FrMCUTempNidec" /begin SUB_GROUP S855_convert_in /end SUB_GROUP /end GROUP
/begin GROUP S475_FrRegenAvailTqNidec "SWC_HALIN_type/run_SWC_HALIN_Rx_5ms_sys/HAL_IN/CAN3/MCU_N_F1/FrRegenAvailTqNidec" /begin SUB_GROUP S857_convert_in /end SUB_GROUP /end GROUP
/begin GROUP S475_FrTMSpdNidec "SWC_HALIN_type/run_SWC_HALIN_Rx_5ms_sys/HAL_IN/CAN3/MCU_N_F1/FrTMSpdNidec" /begin SUB_GROUP S858_convert_in /end SUB_GROUP /end GROUP
/begin GROUP S475_FrTMTempNidec "SWC_HALIN_type/run_SWC_HALIN_Rx_5ms_sys/HAL_IN/CAN3/MCU_N_F1/FrTMTempNidec" /begin SUB_GROUP S859_convert_in /end SUB_GROUP /end GROUP
/begin GROUP S475_FrTMidNidec "SWC_HALIN_type/run_SWC_HALIN_Rx_5ms_sys/HAL_IN/CAN3/MCU_N_F1/FrTMidNidec" /begin SUB_GROUP S860_convert_in /end SUB_GROUP /end GROUP
/begin GROUP S475_FrTMiqNidec "SWC_HALIN_type/run_SWC_HALIN_Rx_5ms_sys/HAL_IN/CAN3/MCU_N_F1/FrTMiqNidec" /begin SUB_GROUP S861_convert_in /end SUB_GROUP /end GROUP
/begin GROUP S476_FrCoolanttempReqNidec "SWC_HALIN_type/run_SWC_HALIN_Rx_5ms_sys/HAL_IN/CAN3/MCU_N_F2/FrCoolanttempReqNidec" /begin SUB_GROUP S889_convert_in /end SUB_GROUP /end GROUP
/begin GROUP S476_FrLLCTempNidec "SWC_HALIN_type/run_SWC_HALIN_Rx_5ms_sys/HAL_IN/CAN3/MCU_N_F2/FrLLCTempNidec" /begin SUB_GROUP S895_convert_in /end SUB_GROUP /end GROUP
/begin GROUP S476_FrLLCflowReqNidec "SWC_HALIN_type/run_SWC_HALIN_Rx_5ms_sys/HAL_IN/CAN3/MCU_N_F2/FrLLCflowReqNidec" /begin SUB_GROUP S896_convert_in /end SUB_GROUP /end GROUP
/begin GROUP S478_DDM_CS_RC_Comparison "SWC_HALIN_type/run_SWC_HALIN_Rx_5ms_sys/HAL_IN/CAN3/MCU_N_R1/DDM_CS&RC_Comparison" /begin SUB_GROUP S904_CRC8_Compare /end SUB_GROUP /end GROUP
/begin GROUP S478_RrEDURealTMTqNidec "SWC_HALIN_type/run_SWC_HALIN_Rx_5ms_sys/HAL_IN/CAN3/MCU_N_R1/RrEDURealTMTqNidec" /begin SUB_GROUP S910_convert_in /end SUB_GROUP /end GROUP
/begin GROUP S478_RrEDUTqReqFbkNidec "SWC_HALIN_type/run_SWC_HALIN_Rx_5ms_sys/HAL_IN/CAN3/MCU_N_R1/RrEDUTqReqFbkNidec" /begin SUB_GROUP S912_convert_in /end SUB_GROUP /end GROUP
/begin GROUP S478_RrMCUBATNidec "SWC_HALIN_type/run_SWC_HALIN_Rx_5ms_sys/HAL_IN/CAN3/MCU_N_R1/RrMCUBATNidec" /begin SUB_GROUP S915_convert_in /end SUB_GROUP /end GROUP
/begin GROUP S478_RrMCUDCBusCurrNidec "SWC_HALIN_type/run_SWC_HALIN_Rx_5ms_sys/HAL_IN/CAN3/MCU_N_R1/RrMCUDCBusCurrNidec" /begin SUB_GROUP S916_convert_in /end SUB_GROUP /end GROUP
/begin GROUP S478_RrMCUDCBusVoltNidec "SWC_HALIN_type/run_SWC_HALIN_Rx_5ms_sys/HAL_IN/CAN3/MCU_N_R1/RrMCUDCBusVoltNidec" /begin SUB_GROUP S917_convert_in /end SUB_GROUP /end GROUP
/begin GROUP S478_RrMCUTempNidec "SWC_HALIN_type/run_SWC_HALIN_Rx_5ms_sys/HAL_IN/CAN3/MCU_N_R1/RrMCUTempNidec" /begin SUB_GROUP S925_convert_in /end SUB_GROUP /end GROUP
/begin GROUP S478_RrRegenAvailTqNidec "SWC_HALIN_type/run_SWC_HALIN_Rx_5ms_sys/HAL_IN/CAN3/MCU_N_R1/RrRegenAvailTqNidec" /begin SUB_GROUP S927_convert_in /end SUB_GROUP /end GROUP
/begin GROUP S478_RrTMSpdNidec "SWC_HALIN_type/run_SWC_HALIN_Rx_5ms_sys/HAL_IN/CAN3/MCU_N_R1/RrTMSpdNidec" /begin SUB_GROUP S928_convert_in /end SUB_GROUP /end GROUP
/begin GROUP S478_RrTMTempNidec "SWC_HALIN_type/run_SWC_HALIN_Rx_5ms_sys/HAL_IN/CAN3/MCU_N_R1/RrTMTempNidec" /begin SUB_GROUP S929_convert_in /end SUB_GROUP /end GROUP
/begin GROUP S478_RrTMidNidec "SWC_HALIN_type/run_SWC_HALIN_Rx_5ms_sys/HAL_IN/CAN3/MCU_N_R1/RrTMidNidec" /begin SUB_GROUP S930_convert_in /end SUB_GROUP /end GROUP
/begin GROUP S478_RrTMiqNidec "SWC_HALIN_type/run_SWC_HALIN_Rx_5ms_sys/HAL_IN/CAN3/MCU_N_R1/RrTMiqNidec" /begin SUB_GROUP S931_convert_in /end SUB_GROUP /end GROUP
/begin GROUP S479_RrCoolanttempReqNidec "SWC_HALIN_type/run_SWC_HALIN_Rx_5ms_sys/HAL_IN/CAN3/MCU_N_R2/RrCoolanttempReqNidec" /begin SUB_GROUP S957_convert_in /end SUB_GROUP /end GROUP
/begin GROUP S479_RrLLCTempNidec "SWC_HALIN_type/run_SWC_HALIN_Rx_5ms_sys/HAL_IN/CAN3/MCU_N_R2/RrLLCTempNidec" /begin SUB_GROUP S963_convert_in /end SUB_GROUP /end GROUP
/begin GROUP S479_RrLLCflowReqNidec "SWC_HALIN_type/run_SWC_HALIN_Rx_5ms_sys/HAL_IN/CAN3/MCU_N_R2/RrLLCflowReqNidec" /begin SUB_GROUP S964_convert_in /end SUB_GROUP /end GROUP
/begin GROUP S481_DDM_CS_RC_Comparison "SWC_HALIN_type/run_SWC_HALIN_Rx_5ms_sys/HAL_IN/CAN3/Shifter1/DDM_CS&RC_Comparison" /begin SUB_GROUP S972_CRC8_Compare /end SUB_GROUP /end GROUP
/begin GROUP S482_DDM_CS_RC_Comparison "SWC_HALIN_type/run_SWC_HALIN_Rx_5ms_sys/HAL_IN/CAN3/Shifter2/DDM_CS&RC_Comparison" /begin SUB_GROUP S998_CRC8_Compare /end SUB_GROUP /end GROUP
/begin GROUP S1060_RLTurnLampC "SWC_HALIN_type/run_SWC_HALIN_Rx_5ms_sys/HAL_IN/CAN4/ZONE_DR1/RLTurnLampC" /begin SUB_GROUP S1152_convert_in /end SUB_GROUP /end GROUP
/begin GROUP S1060_RRTurnLampC "SWC_HALIN_type/run_SWC_HALIN_Rx_5ms_sys/HAL_IN/CAN4/ZONE_DR1/RRTurnLampC" /begin SUB_GROUP S1154_convert_in /end SUB_GROUP /end GROUP
/begin GROUP S1061_BlowerErr "SWC_HALIN_type/run_SWC_HALIN_Rx_5ms_sys/HAL_IN/CAN4/ZONE_DR_VCU/BlowerErr" /begin REF_MEASUREMENT VHAL_BlowerErr_enum /end REF_MEASUREMENT /end GROUP
/begin GROUP S1061_LeftHallPos "SWC_HALIN_type/run_SWC_HALIN_Rx_5ms_sys/HAL_IN/CAN4/ZONE_DR_VCU/LeftHallPos" /begin REF_MEASUREMENT VHAL_LeftHallPos_enum /end REF_MEASUREMENT /end GROUP
/begin GROUP S1061_SolarL "SWC_HALIN_type/run_SWC_HALIN_Rx_5ms_sys/HAL_IN/CAN4/ZONE_DR_VCU/SolarL" /begin SUB_GROUP S1165_convert_in /end SUB_GROUP /end GROUP
/begin GROUP S1061_SolarLErr "SWC_HALIN_type/run_SWC_HALIN_Rx_5ms_sys/HAL_IN/CAN4/ZONE_DR_VCU/SolarLErr" /begin REF_MEASUREMENT VHAL_SolarLErr_enum /end REF_MEASUREMENT /end GROUP
/begin GROUP S1061_SolarR "SWC_HALIN_type/run_SWC_HALIN_Rx_5ms_sys/HAL_IN/CAN4/ZONE_DR_VCU/SolarR" /begin SUB_GROUP S1167_convert_in /end SUB_GROUP /end GROUP
/begin GROUP S1061_SolarRErr "SWC_HALIN_type/run_SWC_HALIN_Rx_5ms_sys/HAL_IN/CAN4/ZONE_DR_VCU/SolarRErr" /begin REF_MEASUREMENT VHAL_SolarRErr_enum /end REF_MEASUREMENT /end GROUP
/begin GROUP S1061_TFaceL "SWC_HALIN_type/run_SWC_HALIN_Rx_5ms_sys/HAL_IN/CAN4/ZONE_DR_VCU/TFaceL" /begin SUB_GROUP S1169_convert_in /end SUB_GROUP /end GROUP
/begin GROUP S1061_TFaceLErr "SWC_HALIN_type/run_SWC_HALIN_Rx_5ms_sys/HAL_IN/CAN4/ZONE_DR_VCU/TFaceLErr" /begin REF_MEASUREMENT VHAL_TFaceLErr_enum /end REF_MEASUREMENT /end GROUP
/begin GROUP S1061_TFaceR "SWC_HALIN_type/run_SWC_HALIN_Rx_5ms_sys/HAL_IN/CAN4/ZONE_DR_VCU/TFaceR" /begin SUB_GROUP S1171_convert_in /end SUB_GROUP /end GROUP
/begin GROUP S1061_TFaceRErr "SWC_HALIN_type/run_SWC_HALIN_Rx_5ms_sys/HAL_IN/CAN4/ZONE_DR_VCU/TFaceRErr" /begin REF_MEASUREMENT VHAL_TFaceRErr_enum /end REF_MEASUREMENT /end GROUP
/begin GROUP S1061_TFaceRr "SWC_HALIN_type/run_SWC_HALIN_Rx_5ms_sys/HAL_IN/CAN4/ZONE_DR_VCU/TFaceRr" /begin SUB_GROUP S1173_convert_in /end SUB_GROUP /end GROUP
/begin GROUP S1061_TFaceRrErr "SWC_HALIN_type/run_SWC_HALIN_Rx_5ms_sys/HAL_IN/CAN4/ZONE_DR_VCU/TFaceRrErr" /begin REF_MEASUREMENT VHAL_TFaceRrErr_enum /end REF_MEASUREMENT /end GROUP
/begin GROUP S1061_TFootL "SWC_HALIN_type/run_SWC_HALIN_Rx_5ms_sys/HAL_IN/CAN4/ZONE_DR_VCU/TFootL" /begin SUB_GROUP S1175_convert_in /end SUB_GROUP /end GROUP
/begin GROUP S1061_TFootLErr "SWC_HALIN_type/run_SWC_HALIN_Rx_5ms_sys/HAL_IN/CAN4/ZONE_DR_VCU/TFootLErr" /begin REF_MEASUREMENT VHAL_TFootLErr_enum /end REF_MEASUREMENT /end GROUP
/begin GROUP S1061_TFootR "SWC_HALIN_type/run_SWC_HALIN_Rx_5ms_sys/HAL_IN/CAN4/ZONE_DR_VCU/TFootR" /begin SUB_GROUP S1177_convert_in /end SUB_GROUP /end GROUP
/begin GROUP S1061_TFootRErr "SWC_HALIN_type/run_SWC_HALIN_Rx_5ms_sys/HAL_IN/CAN4/ZONE_DR_VCU/TFootRErr" /begin REF_MEASUREMENT VHAL_TFootRErr_enum /end REF_MEASUREMENT /end GROUP
/begin GROUP S1061_TFootRr "SWC_HALIN_type/run_SWC_HALIN_Rx_5ms_sys/HAL_IN/CAN4/ZONE_DR_VCU/TFootRr" /begin SUB_GROUP S1179_convert_in /end SUB_GROUP /end GROUP
/begin GROUP S1061_TFootRrErr "SWC_HALIN_type/run_SWC_HALIN_Rx_5ms_sys/HAL_IN/CAN4/ZONE_DR_VCU/TFootRrErr" /begin REF_MEASUREMENT VHAL_TFootRrErr_enum /end REF_MEASUREMENT /end GROUP
/begin GROUP S1061_Tevap "SWC_HALIN_type/run_SWC_HALIN_Rx_5ms_sys/HAL_IN/CAN4/ZONE_DR_VCU/Tevap" /begin SUB_GROUP S1181_convert_in /end SUB_GROUP /end GROUP
/begin GROUP S1061_TevapErr "SWC_HALIN_type/run_SWC_HALIN_Rx_5ms_sys/HAL_IN/CAN4/ZONE_DR_VCU/TevapErr" /begin REF_MEASUREMENT VHAL_TevapErr_enum /end REF_MEASUREMENT /end GROUP
/begin GROUP S1061_Tincar "SWC_HALIN_type/run_SWC_HALIN_Rx_5ms_sys/HAL_IN/CAN4/ZONE_DR_VCU/Tincar" /begin SUB_GROUP S1183_convert_in /end SUB_GROUP /end GROUP
/begin GROUP S1061_TincarErr "SWC_HALIN_type/run_SWC_HALIN_Rx_5ms_sys/HAL_IN/CAN4/ZONE_DR_VCU/TincarErr" /begin REF_MEASUREMENT VHAL_TincarErr_enum /end REF_MEASUREMENT /end GROUP
/begin GROUP S1061_ZoneDrMalfunLevel "SWC_HALIN_type/run_SWC_HALIN_Rx_5ms_sys/HAL_IN/CAN4/ZONE_DR_VCU/ZoneDrMalfunLevel" /begin REF_MEASUREMENT VHAL_ZoneDrMalfunLevel_enum /end REF_MEASUREMENT /end GROUP
/begin GROUP S1062_FLTurnLampC "SWC_HALIN_type/run_SWC_HALIN_Rx_5ms_sys/HAL_IN/CAN4/ZONE_FR1/FLTurnLampC" /begin SUB_GROUP S1199_convert_in /end SUB_GROUP /end GROUP
/begin GROUP S1062_FRTurnLampC "SWC_HALIN_type/run_SWC_HALIN_Rx_5ms_sys/HAL_IN/CAN4/ZONE_FR1/FRTurnLampC" /begin SUB_GROUP S1202_convert_in /end SUB_GROUP /end GROUP
/begin GROUP S1062_TrailerModeSta "SWC_HALIN_type/run_SWC_HALIN_Rx_5ms_sys/HAL_IN/CAN4/ZONE_FR1/TrailerModeSta" /begin REF_MEASUREMENT VHAL_TrailerModeSta_enum /end REF_MEASUREMENT /end GROUP
/begin GROUP S1063_AGSErr "SWC_HALIN_type/run_SWC_HALIN_Rx_5ms_sys/HAL_IN/CAN4/ZONE_FR_VCU/AGSErr" /begin REF_MEASUREMENT VHAL_AGSErr_enum /end REF_MEASUREMENT /end GROUP
/begin GROUP S1063_BatInTemp "SWC_HALIN_type/run_SWC_HALIN_Rx_5ms_sys/HAL_IN/CAN4/ZONE_FR_VCU/BatInTemp" /begin SUB_GROUP S1232_convert_in /end SUB_GROUP /end GROUP
/begin GROUP S1063_BatInTempErr "SWC_HALIN_type/run_SWC_HALIN_Rx_5ms_sys/HAL_IN/CAN4/ZONE_FR_VCU/BatInTempErr" /begin REF_MEASUREMENT VHAL_BatInTempErr_enum /end REF_MEASUREMENT /end GROUP
/begin GROUP S1063_BatOutTemp "SWC_HALIN_type/run_SWC_HALIN_Rx_5ms_sys/HAL_IN/CAN4/ZONE_FR_VCU/BatOutTemp" /begin SUB_GROUP S1234_convert_in /end SUB_GROUP /end GROUP
/begin GROUP S1063_COMPErr "SWC_HALIN_type/run_SWC_HALIN_Rx_5ms_sys/HAL_IN/CAN4/ZONE_FR_VCU/COMPErr" /begin REF_MEASUREMENT VHAL_COMPErr_enum /end REF_MEASUREMENT /end GROUP
/begin GROUP S1063_EACProtectEnable "SWC_HALIN_type/run_SWC_HALIN_Rx_5ms_sys/HAL_IN/CAN4/ZONE_FR_VCU/EACProtectEnable" /begin REF_MEASUREMENT VHAL_EACProtectEnable_enum /end REF_MEASUREMENT /end GROUP
/begin GROUP S1063_EWP3Err "SWC_HALIN_type/run_SWC_HALIN_Rx_5ms_sys/HAL_IN/CAN4/ZONE_FR_VCU/EWP3Err" /begin REF_MEASUREMENT VHAL_EWP3Err_enum /end REF_MEASUREMENT /end GROUP
/begin GROUP S1063_EXV1Err "SWC_HALIN_type/run_SWC_HALIN_Rx_5ms_sys/HAL_IN/CAN4/ZONE_FR_VCU/EXV1Err" /begin REF_MEASUREMENT VHAL_EXV1Err_enum /end REF_MEASUREMENT /end GROUP
/begin GROUP S1063_EXV2Err "SWC_HALIN_type/run_SWC_HALIN_Rx_5ms_sys/HAL_IN/CAN4/ZONE_FR_VCU/EXV2Err" /begin REF_MEASUREMENT VHAL_EXV2Err_enum /end REF_MEASUREMENT /end GROUP
/begin GROUP S1063_FanErr "SWC_HALIN_type/run_SWC_HALIN_Rx_5ms_sys/HAL_IN/CAN4/ZONE_FR_VCU/FanErr" /begin REF_MEASUREMENT VHAL_FanErr_enum /end REF_MEASUREMENT /end GROUP
/begin GROUP S1063_MotorInTemp "SWC_HALIN_type/run_SWC_HALIN_Rx_5ms_sys/HAL_IN/CAN4/ZONE_FR_VCU/MotorInTemp" /begin SUB_GROUP S1242_convert_in /end SUB_GROUP /end GROUP
/begin GROUP S1063_MotorInTempErr "SWC_HALIN_type/run_SWC_HALIN_Rx_5ms_sys/HAL_IN/CAN4/ZONE_FR_VCU/MotorInTempErr" /begin REF_MEASUREMENT VHAL_MotorInTempErr_enum /end REF_MEASUREMENT /end GROUP
/begin GROUP S1063_MotorOutTemp "SWC_HALIN_type/run_SWC_HALIN_Rx_5ms_sys/HAL_IN/CAN4/ZONE_FR_VCU/MotorOutTemp" /begin SUB_GROUP S1244_convert_in /end SUB_GROUP /end GROUP
/begin GROUP S1063_MotorOutTempErr "SWC_HALIN_type/run_SWC_HALIN_Rx_5ms_sys/HAL_IN/CAN4/ZONE_FR_VCU/MotorOutTempErr" /begin REF_MEASUREMENT VHAL_MotorOutTempErr_enum /end REF_MEASUREMENT /end GROUP
/begin GROUP S1063_PTHighPErr "SWC_HALIN_type/run_SWC_HALIN_Rx_5ms_sys/HAL_IN/CAN4/ZONE_FR_VCU/PTHighPErr" /begin REF_MEASUREMENT VHAL_PTHighPErr_enum /end REF_MEASUREMENT /end GROUP
/begin GROUP S1063_PTHighTact "SWC_HALIN_type/run_SWC_HALIN_Rx_5ms_sys/HAL_IN/CAN4/ZONE_FR_VCU/PTHighTact" /begin SUB_GROUP S1248_convert_in /end SUB_GROUP /end GROUP
/begin GROUP S1063_PTHighTactErr "SWC_HALIN_type/run_SWC_HALIN_Rx_5ms_sys/HAL_IN/CAN4/ZONE_FR_VCU/PTHighTactErr" /begin REF_MEASUREMENT VHAL_PTHighTactErr_enum /end REF_MEASUREMENT /end GROUP
/begin GROUP S1063_PTLowP1Err "SWC_HALIN_type/run_SWC_HALIN_Rx_5ms_sys/HAL_IN/CAN4/ZONE_FR_VCU/PTLowP1Err" /begin REF_MEASUREMENT VHAL_PTLowP1Err_enum /end REF_MEASUREMENT /end GROUP
/begin GROUP S1063_PTLowP2Err "SWC_HALIN_type/run_SWC_HALIN_Rx_5ms_sys/HAL_IN/CAN4/ZONE_FR_VCU/PTLowP2Err" /begin REF_MEASUREMENT VHAL_PTLowP2Err_enum /end REF_MEASUREMENT /end GROUP
/begin GROUP S1063_PTLowT1 "SWC_HALIN_type/run_SWC_HALIN_Rx_5ms_sys/HAL_IN/CAN4/ZONE_FR_VCU/PTLowT1" /begin SUB_GROUP S1254_convert_in /end SUB_GROUP /end GROUP
/begin GROUP S1063_PTLowT1Err "SWC_HALIN_type/run_SWC_HALIN_Rx_5ms_sys/HAL_IN/CAN4/ZONE_FR_VCU/PTLowT1Err" /begin REF_MEASUREMENT VHAL_PTLowT1Err_enum /end REF_MEASUREMENT /end GROUP
/begin GROUP S1063_PTLowT2 "SWC_HALIN_type/run_SWC_HALIN_Rx_5ms_sys/HAL_IN/CAN4/ZONE_FR_VCU/PTLowT2" /begin SUB_GROUP S1256_convert_in /end SUB_GROUP /end GROUP
/begin GROUP S1063_PTLowT2Err "SWC_HALIN_type/run_SWC_HALIN_Rx_5ms_sys/HAL_IN/CAN4/ZONE_FR_VCU/PTLowT2Err" /begin REF_MEASUREMENT VHAL_PTLowT2Err_enum /end REF_MEASUREMENT /end GROUP
/begin GROUP S1063_SOTXVErr "SWC_HALIN_type/run_SWC_HALIN_Rx_5ms_sys/HAL_IN/CAN4/ZONE_FR_VCU/SOTXVErr" /begin REF_MEASUREMENT VHAL_SOTXVErr_enum /end REF_MEASUREMENT /end GROUP
/begin GROUP S1063_SOV1Err "SWC_HALIN_type/run_SWC_HALIN_Rx_5ms_sys/HAL_IN/CAN4/ZONE_FR_VCU/SOV1Err" /begin REF_MEASUREMENT VHAL_SOV1Err_enum /end REF_MEASUREMENT /end GROUP
/begin GROUP S1063_SOV2Err "SWC_HALIN_type/run_SWC_HALIN_Rx_5ms_sys/HAL_IN/CAN4/ZONE_FR_VCU/SOV2Err" /begin REF_MEASUREMENT VHAL_SOV2Err_enum /end REF_MEASUREMENT /end GROUP
/begin GROUP S1063_SOV3Err "SWC_HALIN_type/run_SWC_HALIN_Rx_5ms_sys/HAL_IN/CAN4/ZONE_FR_VCU/SOV3Err" /begin REF_MEASUREMENT VHAL_SOV3Err_enum /end REF_MEASUREMENT /end GROUP
/begin GROUP S1063_Tamb "SWC_HALIN_type/run_SWC_HALIN_Rx_5ms_sys/HAL_IN/CAN4/ZONE_FR_VCU/Tamb" /begin SUB_GROUP S1262_convert_in /end SUB_GROUP /end GROUP
/begin GROUP S1063_TambErr "SWC_HALIN_type/run_SWC_HALIN_Rx_5ms_sys/HAL_IN/CAN4/ZONE_FR_VCU/TambErr" /begin REF_MEASUREMENT VHAL_TambErr_enum /end REF_MEASUREMENT /end GROUP
/begin GROUP S1064_FrntPTCLeActHeatPwr "SWC_HALIN_type/run_SWC_HALIN_Rx_5ms_sys/HAL_IN/CAN4/zGW_APTC1/FrntPTCLeActHeatPwr" /begin SUB_GROUP S1272_convert_in /end SUB_GROUP /end GROUP
/begin GROUP S1064_FrntPTCRearLeActHeatPwr "SWC_HALIN_type/run_SWC_HALIN_Rx_5ms_sys/HAL_IN/CAN4/zGW_APTC1/FrntPTCRearLeActHeatPwr" /begin SUB_GROUP S1273_convert_in /end SUB_GROUP /end GROUP
/begin GROUP S1064_FrntPTCRearRiActHeatPwr "SWC_HALIN_type/run_SWC_HALIN_Rx_5ms_sys/HAL_IN/CAN4/zGW_APTC1/FrntPTCRearRiActHeatPwr" /begin SUB_GROUP S1274_convert_in /end SUB_GROUP /end GROUP
/begin GROUP S1064_FrntPTCRiActHeatPwr "SWC_HALIN_type/run_SWC_HALIN_Rx_5ms_sys/HAL_IN/CAN4/zGW_APTC1/FrntPTCRiActHeatPwr" /begin SUB_GROUP S1275_convert_in /end SUB_GROUP /end GROUP
/begin GROUP S1065_COMPConCur "SWC_HALIN_type/run_SWC_HALIN_Rx_5ms_sys/HAL_IN/CAN4/zGW_CANFr1/COMPConCur" /begin SUB_GROUP S1281_convert_in /end SUB_GROUP /end GROUP
/begin GROUP S1065_COMPConVolt "SWC_HALIN_type/run_SWC_HALIN_Rx_5ms_sys/HAL_IN/CAN4/zGW_CANFr1/COMPConVolt" /begin SUB_GROUP S1282_convert_in /end SUB_GROUP /end GROUP
/begin GROUP S1065_PTC1PowerConsumption "SWC_HALIN_type/run_SWC_HALIN_Rx_5ms_sys/HAL_IN/CAN4/zGW_CANFr1/PTC1PowerConsumption" /begin SUB_GROUP S1284_convert_in /end SUB_GROUP /end GROUP
/begin GROUP S1066_CSWFWasSwSta "SWC_HALIN_type/run_SWC_HALIN_Rx_5ms_sys/HAL_IN/CAN4/zGW_LINDr1/CSWFWasSwSta" /begin REF_MEASUREMENT VHAL_CSWFWasSwSta_enum /end REF_MEASUREMENT /end GROUP
/begin GROUP S1066_CSWFWipSwSta "SWC_HALIN_type/run_SWC_HALIN_Rx_5ms_sys/HAL_IN/CAN4/zGW_LINDr1/CSWFWipSwSta" /begin REF_MEASUREMENT VHAL_CSWFWipSwSta_enum /end REF_MEASUREMENT /end GROUP
/begin GROUP S1066_CSWRWasSWSta "SWC_HALIN_type/run_SWC_HALIN_Rx_5ms_sys/HAL_IN/CAN4/zGW_LINDr1/CSWRWasSWSta" /begin REF_MEASUREMENT VHAL_CSWRWasSWSta_enum /end REF_MEASUREMENT /end GROUP
/begin GROUP S1066_CSWRWipIntSwSta "SWC_HALIN_type/run_SWC_HALIN_Rx_5ms_sys/HAL_IN/CAN4/zGW_LINDr1/CSWRWipIntSwSta" /begin REF_MEASUREMENT VHAL_CSWRWipIntSwSta_enum /end REF_MEASUREMENT /end GROUP
/begin GROUP S1066_CSWTurnSwSta "SWC_HALIN_type/run_SWC_HALIN_Rx_5ms_sys/HAL_IN/CAN4/zGW_LINDr1/CSWTurnSwSta" /begin REF_MEASUREMENT VHAL_CSWTurnSwSta_enum /end REF_MEASUREMENT /end GROUP
/begin GROUP S1066_LDrvWdwPositionSts "SWC_HALIN_type/run_SWC_HALIN_Rx_5ms_sys/HAL_IN/CAN4/zGW_LINDr1/LDrvWdwPositionSts" /begin REF_MEASUREMENT VHAL_LDrvWdwPositionSts_enum /end REF_MEASUREMENT /end GROUP
/begin GROUP S1066_LPasWdwPositionSts "SWC_HALIN_type/run_SWC_HALIN_Rx_5ms_sys/HAL_IN/CAN4/zGW_LINDr1/LPasWdwPositionSts" /begin REF_MEASUREMENT VHAL_LPasWdwPositionSts_enum /end REF_MEASUREMENT /end GROUP
/begin GROUP S1066_LRLDWdwPositionSts "SWC_HALIN_type/run_SWC_HALIN_Rx_5ms_sys/HAL_IN/CAN4/zGW_LINDr1/LRLDWdwPositionSts" /begin REF_MEASUREMENT VHAL_LRLDWdwPositionSts_enum /end REF_MEASUREMENT /end GROUP
/begin GROUP S1066_LRRDWdwPositionSts "SWC_HALIN_type/run_SWC_HALIN_Rx_5ms_sys/HAL_IN/CAN4/zGW_LINDr1/LRRDWdwPositionSts" /begin REF_MEASUREMENT VHAL_LRRDWdwPositionSts_enum /end REF_MEASUREMENT /end GROUP
/begin GROUP S1066_RLSRainSnrWiperCmd "SWC_HALIN_type/run_SWC_HALIN_Rx_5ms_sys/HAL_IN/CAN4/zGW_LINDr1/RLSRainSnrWiperCmd" /begin REF_MEASUREMENT VHAL_RLSRainSnrWiperCmd_enum /end REF_MEASUREMENT /end GROUP
/begin GROUP S1068_AGSActualPosition "SWC_HALIN_type/run_SWC_HALIN_Rx_5ms_sys/HAL_IN/CAN4/zGW_LINFr1/AGSActualPosition" /begin REF_MEASUREMENT VHAL_AGSActualPosition_enum /end REF_MEASUREMENT /end GROUP
/begin GROUP S1068_FGSIntenRspSta "SWC_HALIN_type/run_SWC_HALIN_Rx_5ms_sys/HAL_IN/CAN4/zGW_LINFr1/FGSIntenRspSta" /begin REF_MEASUREMENT VHAL_FGSIntenRspSta_enum /end REF_MEASUREMENT /end GROUP
/begin GROUP S1069_EWP1BlockError "SWC_HALIN_type/run_SWC_HALIN_Rx_5ms_sys/HAL_IN/CAN4/zGW_LINFr2/EWP1BlockError" /begin REF_MEASUREMENT VHAL_EWP1BlockError_enum /end REF_MEASUREMENT /end GROUP
/begin GROUP S1069_EWP1OverCurrError "SWC_HALIN_type/run_SWC_HALIN_Rx_5ms_sys/HAL_IN/CAN4/zGW_LINFr2/EWP1OverCurrError" /begin REF_MEASUREMENT VHAL_EWP1OverCurrError_enum /end REF_MEASUREMENT /end GROUP
/begin GROUP S1069_EWP2BlockError "SWC_HALIN_type/run_SWC_HALIN_Rx_5ms_sys/HAL_IN/CAN4/zGW_LINFr2/EWP2BlockError" /begin REF_MEASUREMENT VHAL_EWP2BlockError_enum /end REF_MEASUREMENT /end GROUP
/begin GROUP S1069_EWP2OverCurrError "SWC_HALIN_type/run_SWC_HALIN_Rx_5ms_sys/HAL_IN/CAN4/zGW_LINFr2/EWP2OverCurrError" /begin REF_MEASUREMENT VHAL_EWP2OverCurrError_enum /end REF_MEASUREMENT /end GROUP
/begin GROUP S1069_EWP3BlockError "SWC_HALIN_type/run_SWC_HALIN_Rx_5ms_sys/HAL_IN/CAN4/zGW_LINFr2/EWP3BlockError" /begin REF_MEASUREMENT VHAL_EWP3BlockError_enum /end REF_MEASUREMENT /end GROUP
/begin GROUP S1069_EWP3OverCurrError "SWC_HALIN_type/run_SWC_HALIN_Rx_5ms_sys/HAL_IN/CAN4/zGW_LINFr2/EWP3OverCurrError" /begin REF_MEASUREMENT VHAL_EWP3OverCurrError_enum /end REF_MEASUREMENT /end GROUP
/begin GROUP S1070_DSEATHWVer "SWC_HALIN_type/run_SWC_HALIN_Rx_5ms_sys/HAL_IN/CAN4/zGW_SEAT1/DSEATHWVer" /begin REF_MEASUREMENT VHAL_DSEATHWVer_enum /end REF_MEASUREMENT /end GROUP
/begin GROUP S1070_DSEATMode "SWC_HALIN_type/run_SWC_HALIN_Rx_5ms_sys/HAL_IN/CAN4/zGW_SEAT1/DSEATMode" /begin REF_MEASUREMENT VHAL_DSEATMode_enum /end REF_MEASUREMENT /end GROUP
/begin GROUP S1070_DSEATSWVer "SWC_HALIN_type/run_SWC_HALIN_Rx_5ms_sys/HAL_IN/CAN4/zGW_SEAT1/DSEATSWVer" /begin REF_MEASUREMENT VHAL_DSEATSWVer_enum /end REF_MEASUREMENT /end GROUP
/begin GROUP S1070_DSEATVentSta "SWC_HALIN_type/run_SWC_HALIN_Rx_5ms_sys/HAL_IN/CAN4/zGW_SEAT1/DSEATVentSta" /begin REF_MEASUREMENT VHAL_DSEATVentSta_enum /end REF_MEASUREMENT /end GROUP
/begin GROUP S1070_DSEATheatersta "SWC_HALIN_type/run_SWC_HALIN_Rx_5ms_sys/HAL_IN/CAN4/zGW_SEAT1/DSEATheatersta" /begin REF_MEASUREMENT VHAL_DSEATheatersta_enum /end REF_MEASUREMENT /end GROUP
/begin GROUP S1070_PSEATHWVer "SWC_HALIN_type/run_SWC_HALIN_Rx_5ms_sys/HAL_IN/CAN4/zGW_SEAT1/PSEATHWVer" /begin REF_MEASUREMENT VHAL_PSEATHWVer_enum /end REF_MEASUREMENT /end GROUP
/begin GROUP S1070_PSEATMode "SWC_HALIN_type/run_SWC_HALIN_Rx_5ms_sys/HAL_IN/CAN4/zGW_SEAT1/PSEATMode" /begin REF_MEASUREMENT VHAL_PSEATMode_enum /end REF_MEASUREMENT /end GROUP
/begin GROUP S1070_PSEATSWVer "SWC_HALIN_type/run_SWC_HALIN_Rx_5ms_sys/HAL_IN/CAN4/zGW_SEAT1/PSEATSWVer" /begin REF_MEASUREMENT VHAL_PSEATSWVer_enum /end REF_MEASUREMENT /end GROUP
/begin GROUP S1070_PSEATVentSta "SWC_HALIN_type/run_SWC_HALIN_Rx_5ms_sys/HAL_IN/CAN4/zGW_SEAT1/PSEATVentSta" /begin REF_MEASUREMENT VHAL_PSEATVentSta_enum /end REF_MEASUREMENT /end GROUP
/begin GROUP S1070_PSEATheatersta "SWC_HALIN_type/run_SWC_HALIN_Rx_5ms_sys/HAL_IN/CAN4/zGW_SEAT1/PSEATheatersta" /begin REF_MEASUREMENT VHAL_PSEATheatersta_enum /end REF_MEASUREMENT /end GROUP
/begin GROUP S1372_TimeSyncFromBSYear "SWC_HALIN_type/run_SWC_HALIN_Rx_5ms_sys/HAL_IN/CAN5/TBOX2/TimeSyncFromBSYear" /begin SUB_GROUP S1381_convert_in /end SUB_GROUP /end GROUP
/begin GROUP S1373_ReserveChargeOFFYear "SWC_HALIN_type/run_SWC_HALIN_Rx_5ms_sys/HAL_IN/CAN5/TBOX3/ReserveChargeOFFYear" /begin SUB_GROUP S1388_convert_in /end SUB_GROUP /end GROUP
/begin GROUP S1373_ReserveChargeOnYear "SWC_HALIN_type/run_SWC_HALIN_Rx_5ms_sys/HAL_IN/CAN5/TBOX3/ReserveChargeOnYear" /begin SUB_GROUP S1393_convert_in /end SUB_GROUP /end GROUP
/begin GROUP S1400_ACCComfortBandLower "SWC_HALIN_type/run_SWC_HALIN_Rx_5ms_sys/HAL_IN/CAN6/FCM1/ACCComfortBandLower" /begin SUB_GROUP S1410_convert_in /end SUB_GROUP /end GROUP
/begin GROUP S1400_ACCComfortBandUpper "SWC_HALIN_type/run_SWC_HALIN_Rx_5ms_sys/HAL_IN/CAN6/FCM1/ACCComfortBandUpper" /begin SUB_GROUP S1411_convert_in /end SUB_GROUP /end GROUP
/begin GROUP S1400_ACCJerkLowerLimit "SWC_HALIN_type/run_SWC_HALIN_Rx_5ms_sys/HAL_IN/CAN6/FCM1/ACCJerkLowerLimit" /begin SUB_GROUP S1412_convert_in /end SUB_GROUP /end GROUP
/begin GROUP S1400_ACCJerkUpperLimit "SWC_HALIN_type/run_SWC_HALIN_Rx_5ms_sys/HAL_IN/CAN6/FCM1/ACCJerkUpperLimit" /begin SUB_GROUP S1413_convert_in /end SUB_GROUP /end GROUP
/begin GROUP S1400_ACCObjDist "SWC_HALIN_type/run_SWC_HALIN_Rx_5ms_sys/HAL_IN/CAN6/FCM1/ACCObjDist" /begin SUB_GROUP S1414_convert_in /end SUB_GROUP /end GROUP
/begin GROUP S1400_ACCObjRelSpd "SWC_HALIN_type/run_SWC_HALIN_Rx_5ms_sys/HAL_IN/CAN6/FCM1/ACCObjRelSpd" /begin SUB_GROUP S1416_convert_in /end SUB_GROUP /end GROUP
/begin GROUP S1400_ACCRequiredAccel "SWC_HALIN_type/run_SWC_HALIN_Rx_5ms_sys/HAL_IN/CAN6/FCM1/ACCRequiredAccel" /begin SUB_GROUP S1417_convert_in /end SUB_GROUP /end GROUP
/begin GROUP S1400_ADASLanecurveL "SWC_HALIN_type/run_SWC_HALIN_Rx_5ms_sys/HAL_IN/CAN6/FCM1/ADASLanecurveL" /begin SUB_GROUP S1439_convert_in /end SUB_GROUP /end GROUP
/begin GROUP S1400_ADASLanecurveR "SWC_HALIN_type/run_SWC_HALIN_Rx_5ms_sys/HAL_IN/CAN6/FCM1/ADASLanecurveR" /begin SUB_GROUP S1440_convert_in /end SUB_GROUP /end GROUP
/begin GROUP S1400_FCMLKAStrToqReq "SWC_HALIN_type/run_SWC_HALIN_Rx_5ms_sys/HAL_IN/CAN6/FCM1/FCMLKAStrToqReq" /begin SUB_GROUP S1454_convert_in /end SUB_GROUP /end GROUP
/begin GROUP S1401_DDM_CS_RC_Comparison "SWC_HALIN_type/run_SWC_HALIN_Rx_5ms_sys/HAL_IN/CAN6/FCM2/DDM_CS&RC_Comparison" /begin SUB_GROUP S1482_CRC8_Compare /end SUB_GROUP /end GROUP
/begin GROUP S1402_MELaneCurvDervLt "SWC_HALIN_type/run_SWC_HALIN_Rx_5ms_sys/HAL_IN/CAN6/FCM3/MELaneCurvDervLt" /begin SUB_GROUP S1498_convert_in /end SUB_GROUP /end GROUP
/begin GROUP S1402_MELaneCurvDervLt2 "SWC_HALIN_type/run_SWC_HALIN_Rx_5ms_sys/HAL_IN/CAN6/FCM3/MELaneCurvDervLt2" /begin SUB_GROUP S1499_convert_in /end SUB_GROUP /end GROUP
/begin GROUP S1402_MELaneCurvDervRt "SWC_HALIN_type/run_SWC_HALIN_Rx_5ms_sys/HAL_IN/CAN6/FCM3/MELaneCurvDervRt" /begin SUB_GROUP S1500_convert_in /end SUB_GROUP /end GROUP
/begin GROUP S1402_MELaneCurvDervRt2 "SWC_HALIN_type/run_SWC_HALIN_Rx_5ms_sys/HAL_IN/CAN6/FCM3/MELaneCurvDervRt2" /begin SUB_GROUP S1501_convert_in /end SUB_GROUP /end GROUP
/begin GROUP S1402_MELaneCurvLt "SWC_HALIN_type/run_SWC_HALIN_Rx_5ms_sys/HAL_IN/CAN6/FCM3/MELaneCurvLt" /begin SUB_GROUP S1502_convert_in /end SUB_GROUP /end GROUP
/begin GROUP S1402_MELaneCurvLt2 "SWC_HALIN_type/run_SWC_HALIN_Rx_5ms_sys/HAL_IN/CAN6/FCM3/MELaneCurvLt2" /begin SUB_GROUP S1503_convert_in /end SUB_GROUP /end GROUP
/begin GROUP S1402_MELaneCurvRt "SWC_HALIN_type/run_SWC_HALIN_Rx_5ms_sys/HAL_IN/CAN6/FCM3/MELaneCurvRt" /begin SUB_GROUP S1504_convert_in /end SUB_GROUP /end GROUP
/begin GROUP S1402_MELaneCurvRt2 "SWC_HALIN_type/run_SWC_HALIN_Rx_5ms_sys/HAL_IN/CAN6/FCM3/MELaneCurvRt2" /begin SUB_GROUP S1505_convert_in /end SUB_GROUP /end GROUP
/begin GROUP S1402_MELaneHeadAngLt "SWC_HALIN_type/run_SWC_HALIN_Rx_5ms_sys/HAL_IN/CAN6/FCM3/MELaneHeadAngLt" /begin SUB_GROUP S1506_convert_in /end SUB_GROUP /end GROUP
/begin GROUP S1402_MELaneHeadAngLt2 "SWC_HALIN_type/run_SWC_HALIN_Rx_5ms_sys/HAL_IN/CAN6/FCM3/MELaneHeadAngLt2" /begin SUB_GROUP S1507_convert_in /end SUB_GROUP /end GROUP
/begin GROUP S1402_MELaneHeadAngRt "SWC_HALIN_type/run_SWC_HALIN_Rx_5ms_sys/HAL_IN/CAN6/FCM3/MELaneHeadAngRt" /begin SUB_GROUP S1508_convert_in /end SUB_GROUP /end GROUP
/begin GROUP S1402_MELaneHeadAngRt2 "SWC_HALIN_type/run_SWC_HALIN_Rx_5ms_sys/HAL_IN/CAN6/FCM3/MELaneHeadAngRt2" /begin SUB_GROUP S1509_convert_in /end SUB_GROUP /end GROUP
/begin GROUP S1402_MELanePosLt "SWC_HALIN_type/run_SWC_HALIN_Rx_5ms_sys/HAL_IN/CAN6/FCM3/MELanePosLt" /begin SUB_GROUP S1510_convert_in /end SUB_GROUP /end GROUP
/begin GROUP S1402_MELanePosLt2 "SWC_HALIN_type/run_SWC_HALIN_Rx_5ms_sys/HAL_IN/CAN6/FCM3/MELanePosLt2" /begin SUB_GROUP S1511_convert_in /end SUB_GROUP /end GROUP
/begin GROUP S1402_MELanePosRt "SWC_HALIN_type/run_SWC_HALIN_Rx_5ms_sys/HAL_IN/CAN6/FCM3/MELanePosRt" /begin SUB_GROUP S1512_convert_in /end SUB_GROUP /end GROUP
/begin GROUP S1402_MELanePosRt2 "SWC_HALIN_type/run_SWC_HALIN_Rx_5ms_sys/HAL_IN/CAN6/FCM3/MELanePosRt2" /begin SUB_GROUP S1513_convert_in /end SUB_GROUP /end GROUP
/begin GROUP S1403_ADASAngCtrlTqWeightGain "SWC_HALIN_type/run_SWC_HALIN_Rx_5ms_sys/HAL_IN/CAN6/FCM4/ADASAngCtrlTqWeightGain" /begin SUB_GROUP S1530_convert_in /end SUB_GROUP /end GROUP
/begin GROUP S1403_ADASDesStrWhlAngCtrlCmd "SWC_HALIN_type/run_SWC_HALIN_Rx_5ms_sys/HAL_IN/CAN6/FCM4/ADASDesStrWhlAngCtrlCmd" /begin SUB_GROUP S1531_convert_in /end SUB_GROUP /end GROUP
/begin GROUP S1403_ADASDrvInputTqBoostGain "SWC_HALIN_type/run_SWC_HALIN_Rx_5ms_sys/HAL_IN/CAN6/FCM4/ADASDrvInputTqBoostGain" /begin SUB_GROUP S1533_convert_in /end SUB_GROUP /end GROUP
/begin GROUP S1403_ADASMaxAngCtrlOutTqLimit "SWC_HALIN_type/run_SWC_HALIN_Rx_5ms_sys/HAL_IN/CAN6/FCM4/ADASMaxAngCtrlOutTqLimit" /begin SUB_GROUP S1534_convert_in /end SUB_GROUP /end GROUP
/begin GROUP S1403_DDM_CS_RC_Comparison "SWC_HALIN_type/run_SWC_HALIN_Rx_5ms_sys/HAL_IN/CAN6/FCM4/DDM_CS&RC_Comparison" /begin SUB_GROUP S1536_CRC8_Compare /end SUB_GROUP /end GROUP
/begin GROUP S34_CRC8_Compare "SWC_HALIN_type/run_SWC_HALIN_Rx_5ms_sys/HAL_IN/CAN1/ABM1/DDM_CS&RC_Comparison/CRC8_Compare" /begin REF_MEASUREMENT VHAL_ABM1CSErr_flg VHAL_ABM1RCErr_flg /end REF_MEASUREMENT /end GROUP
/begin GROUP S59_CRC8_Compare "SWC_HALIN_type/run_SWC_HALIN_Rx_5ms_sys/HAL_IN/CAN1/EPB1/DDM_CS&RC_Comparison/CRC8_Compare" /begin REF_MEASUREMENT VHAL_EPB1CSErr_flg VHAL_EPB1RCErr_flg /end REF_MEASUREMENT /end GROUP
/begin GROUP S82_CRC8_Compare "SWC_HALIN_type/run_SWC_HALIN_Rx_5ms_sys/HAL_IN/CAN1/EPS1/DDM_CS&RC_Comparison/CRC8_Compare" /begin REF_MEASUREMENT VHAL_EPS1CSErr_flg VHAL_EPS1RCErr_flg /end REF_MEASUREMENT /end GROUP
/begin GROUP S88_convert_in "SWC_HALIN_type/run_SWC_HALIN_Rx_5ms_sys/HAL_IN/CAN1/EPS1/SASAngle/convert_in" /begin REF_MEASUREMENT VHAL_SASAngle_Deg /end REF_MEASUREMENT /end GROUP
/begin GROUP S90_convert_in "SWC_HALIN_type/run_SWC_HALIN_Rx_5ms_sys/HAL_IN/CAN1/EPS1/SASSpeed/convert_in" /begin REF_MEASUREMENT VHAL_SASSpeed_degps /end REF_MEASUREMENT /end GROUP
/begin GROUP S116_CRC8_Compare "SWC_HALIN_type/run_SWC_HALIN_Rx_5ms_sys/HAL_IN/CAN1/ESC1/DDM_CS&RC_Comparison/CRC8_Compare" /begin REF_MEASUREMENT VHAL_ESC1CSErr_flg VHAL_ESC1RCErr_flg /end REF_MEASUREMENT /end GROUP
/begin GROUP S129_convert_in "SWC_HALIN_type/run_SWC_HALIN_Rx_5ms_sys/HAL_IN/CAN1/ESC1/FrntAxlTrqReqDrv/convert_in" /begin REF_MEASUREMENT VHAL_FrntAxlTrqReqDrv_Nm /end REF_MEASUREMENT /end GROUP
/begin GROUP S130_convert_in "SWC_HALIN_type/run_SWC_HALIN_Rx_5ms_sys/HAL_IN/CAN1/ESC1/GRADE/convert_in" /begin REF_MEASUREMENT VHAL_GRADE_Deg /end REF_MEASUREMENT /end GROUP
/begin GROUP S139_convert_in "SWC_HALIN_type/run_SWC_HALIN_Rx_5ms_sys/HAL_IN/CAN1/ESC1/LFRawWhlSpeed/convert_in" /begin REF_MEASUREMENT VHAL_LFRawWhlSpeed_kph /end REF_MEASUREMENT /end GROUP
/begin GROUP S144_convert_in "SWC_HALIN_type/run_SWC_HALIN_Rx_5ms_sys/HAL_IN/CAN1/ESC1/LRRawWhlSpeed/convert_in" /begin REF_MEASUREMENT VHAL_LRRawWhlSpeed_kph /end REF_MEASUREMENT /end GROUP
/begin GROUP S152_convert_in "SWC_HALIN_type/run_SWC_HALIN_Rx_5ms_sys/HAL_IN/CAN1/ESC1/RFRawWhlSpeed/convert_in" /begin REF_MEASUREMENT VHAL_RFRawWhlSpeed_kph /end REF_MEASUREMENT /end GROUP
/begin GROUP S157_convert_in "SWC_HALIN_type/run_SWC_HALIN_Rx_5ms_sys/HAL_IN/CAN1/ESC1/RRRawWhlSpeed/convert_in" /begin REF_MEASUREMENT VHAL_RRRawWhlSpeed_kph /end REF_MEASUREMENT /end GROUP
/begin GROUP S160_convert_in "SWC_HALIN_type/run_SWC_HALIN_Rx_5ms_sys/HAL_IN/CAN1/ESC1/RearAxlTrqReqDrv/convert_in" /begin REF_MEASUREMENT VHAL_RearAxlTrqReqDrv_Nm /end REF_MEASUREMENT /end GROUP
/begin GROUP S165_convert_in "SWC_HALIN_type/run_SWC_HALIN_Rx_5ms_sys/HAL_IN/CAN1/ESC1/VehSpeed/convert_in" /begin REF_MEASUREMENT VHAL_VehSpeed_kph /end REF_MEASUREMENT /end GROUP
/begin GROUP S192_convert_in "SWC_HALIN_type/run_SWC_HALIN_Rx_5ms_sys/HAL_IN/CAN1/ESC5/BrkPedalPos/convert_in" /begin REF_MEASUREMENT VHAL_BrkPedalPos_pct /end REF_MEASUREMENT /end GROUP
/begin GROUP S196_CRC8_Compare "SWC_HALIN_type/run_SWC_HALIN_Rx_5ms_sys/HAL_IN/CAN1/ESC5/DDM_CS&RC_Comparison/CRC8_Compare" /begin REF_MEASUREMENT VHAL_ESC5CSErr_flg VHAL_ESC5RCErr_flg /end REF_MEASUREMENT /end GROUP
/begin GROUP S203_convert_in "SWC_HALIN_type/run_SWC_HALIN_Rx_5ms_sys/HAL_IN/CAN1/ESC5/FrntAxlTrqReqBrk/convert_in" /begin REF_MEASUREMENT VHAL_FrntAxlTrqReqBrk_Nm /end REF_MEASUREMENT /end GROUP
/begin GROUP S204_convert_in "SWC_HALIN_type/run_SWC_HALIN_Rx_5ms_sys/HAL_IN/CAN1/ESC5/LatAccel/convert_in" /begin REF_MEASUREMENT VHAL_LatAccel_Gps /end REF_MEASUREMENT /end GROUP
/begin GROUP S206_convert_in "SWC_HALIN_type/run_SWC_HALIN_Rx_5ms_sys/HAL_IN/CAN1/ESC5/LongAccel/convert_in" /begin REF_MEASUREMENT VHAL_LongAccel_Gps /end REF_MEASUREMENT /end GROUP
/begin GROUP S208_convert_in "SWC_HALIN_type/run_SWC_HALIN_Rx_5ms_sys/HAL_IN/CAN1/ESC5/MCPressure/convert_in" /begin REF_MEASUREMENT VHAL_MCPressure_bar /end REF_MEASUREMENT /end GROUP
/begin GROUP S211_convert_in "SWC_HALIN_type/run_SWC_HALIN_Rx_5ms_sys/HAL_IN/CAN1/ESC5/MeterIndVehSpeed/convert_in" /begin REF_MEASUREMENT VHAL_MeterIndVehSpeed_kph /end REF_MEASUREMENT /end GROUP
/begin GROUP S213_convert_in "SWC_HALIN_type/run_SWC_HALIN_Rx_5ms_sys/HAL_IN/CAN1/ESC5/RearAxlTrqReqBrk/convert_in" /begin REF_MEASUREMENT VHAL_RearAxlTrqReqBrk_Nm /end REF_MEASUREMENT /end GROUP
/begin GROUP S215_convert_in "SWC_HALIN_type/run_SWC_HALIN_Rx_5ms_sys/HAL_IN/CAN1/ESC5/YawRate/convert_in" /begin REF_MEASUREMENT VHAL_YawRate_degps /end REF_MEASUREMENT /end GROUP
/begin GROUP S306_convert_in "SWC_HALIN_type/run_SWC_HALIN_Rx_5ms_sys/HAL_IN/CAN2/IVI1/IVITimeYear/convert_in" /begin REF_MEASUREMENT VHAL_IVITimeYear_YEAR /end REF_MEASUREMENT /end GROUP
/begin GROUP S315_convert_in "SWC_HALIN_type/run_SWC_HALIN_Rx_5ms_sys/HAL_IN/CAN2/IVI2/ACChgCurSet/convert_in" /begin REF_MEASUREMENT VHAL_ACChgCurSet_A /end REF_MEASUREMENT /end GROUP
/begin GROUP S390_convert_in "SWC_HALIN_type/run_SWC_HALIN_Rx_5ms_sys/HAL_IN/CAN2/IVI2/SOCLimitSet/convert_in" /begin REF_MEASUREMENT VHAL_SOCLimitSet_pct /end REF_MEASUREMENT /end GROUP
/begin GROUP S395_convert_in "SWC_HALIN_type/run_SWC_HALIN_Rx_5ms_sys/HAL_IN/CAN2/IVI2/SchedChglimit/convert_in" /begin REF_MEASUREMENT VHAL_SchedChglimit_pct /end REF_MEASUREMENT /end GROUP
/begin GROUP S410_convert_in "SWC_HALIN_type/run_SWC_HALIN_Rx_5ms_sys/HAL_IN/CAN2/IVI2/sigSetTempZon1Req/convert_in" /begin REF_MEASUREMENT VHAL_sigSetTempZon1Req_C /end REF_MEASUREMENT /end GROUP
/begin GROUP S411_convert_in "SWC_HALIN_type/run_SWC_HALIN_Rx_5ms_sys/HAL_IN/CAN2/IVI2/sigSetTempZon2Req/convert_in" /begin REF_MEASUREMENT VHAL_sigSetTempZon2Req_C /end REF_MEASUREMENT /end GROUP
/begin GROUP S455_convert_in "SWC_HALIN_type/run_SWC_HALIN_Rx_5ms_sys/HAL_IN/CAN2/METER1/ODOMETER/convert_in" /begin REF_MEASUREMENT VHAL_ODOMETER_km /end REF_MEASUREMENT /end GROUP
/begin GROUP S506_CRC8_Compare "SWC_HALIN_type/run_SWC_HALIN_Rx_5ms_sys/HAL_IN/CAN3/BMS1/DDM_CS&RC_Comparison/CRC8_Compare" /begin REF_MEASUREMENT VHAL_BMS1CSErr_flg VHAL_BMS1RCErr_flg /end REF_MEASUREMENT /end GROUP
/begin GROUP S507_convert_in "SWC_HALIN_type/run_SWC_HALIN_Rx_5ms_sys/HAL_IN/CAN3/BMS1/HVBPwrAvailChrg/convert_in" /begin REF_MEASUREMENT VHAL_HVBPwrAvailChrg_kW /end REF_MEASUREMENT /end GROUP
/begin GROUP S508_convert_in "SWC_HALIN_type/run_SWC_HALIN_Rx_5ms_sys/HAL_IN/CAN3/BMS1/HVBPwrAvailChrg30/convert_in" /begin REF_MEASUREMENT VHAL_HVBPwrAvailChrg30_kW /end REF_MEASUREMENT /end GROUP
/begin GROUP S509_convert_in "SWC_HALIN_type/run_SWC_HALIN_Rx_5ms_sys/HAL_IN/CAN3/BMS1/HVBPwrAvailChrg60/convert_in" /begin REF_MEASUREMENT VHAL_HVBPwrAvailChrg60_kW /end REF_MEASUREMENT /end GROUP
/begin GROUP S510_convert_in "SWC_HALIN_type/run_SWC_HALIN_Rx_5ms_sys/HAL_IN/CAN3/BMS1/HVBPwrAvailDchrg/convert_in" /begin REF_MEASUREMENT VHAL_HVBPwrAvailDchrg_kW /end REF_MEASUREMENT /end GROUP
/begin GROUP S511_convert_in "SWC_HALIN_type/run_SWC_HALIN_Rx_5ms_sys/HAL_IN/CAN3/BMS1/HVBPwrAvailDchrg30/convert_in" /begin REF_MEASUREMENT VHAL_HVBPwrAvailDchrg30_kW /end REF_MEASUREMENT /end GROUP
/begin GROUP S512_convert_in "SWC_HALIN_type/run_SWC_HALIN_Rx_5ms_sys/HAL_IN/CAN3/BMS1/HVBPwrAvailDchrg60/convert_in" /begin REF_MEASUREMENT VHAL_HVBPwrAvailDchrg60_kW /end REF_MEASUREMENT /end GROUP
/begin GROUP S513_convert_in "SWC_HALIN_type/run_SWC_HALIN_Rx_5ms_sys/HAL_IN/CAN3/BMS1/HVBattCurr/convert_in" /begin REF_MEASUREMENT VHAL_HVBattCurr_A /end REF_MEASUREMENT /end GROUP
/begin GROUP S514_convert_in "SWC_HALIN_type/run_SWC_HALIN_Rx_5ms_sys/HAL_IN/CAN3/BMS1/HVBattVolt/convert_in" /begin REF_MEASUREMENT VHAL_HVBattVolt_V /end REF_MEASUREMENT /end GROUP
/begin GROUP S538_convert_in "SWC_HALIN_type/run_SWC_HALIN_Rx_5ms_sys/HAL_IN/CAN3/BMS3/ACChrgCurrDis/convert_in" /begin REF_MEASUREMENT VHAL_ACChrgCurrDis_A /end REF_MEASUREMENT /end GROUP
/begin GROUP S540_convert_in "SWC_HALIN_type/run_SWC_HALIN_Rx_5ms_sys/HAL_IN/CAN3/BMS3/HVBChrgPwr/convert_in" /begin REF_MEASUREMENT VHAL_HVBChrgPwr_kWh /end REF_MEASUREMENT /end GROUP
/begin GROUP S542_convert_in "SWC_HALIN_type/run_SWC_HALIN_Rx_5ms_sys/HAL_IN/CAN3/BMS3/HVBDrvPwr/convert_in" /begin REF_MEASUREMENT VHAL_HVBDrvPwr_kWh /end REF_MEASUREMENT /end GROUP
/begin GROUP S544_convert_in "SWC_HALIN_type/run_SWC_HALIN_Rx_5ms_sys/HAL_IN/CAN3/BMS3/HVBFullChrgPwr/convert_in" /begin REF_MEASUREMENT VHAL_HVBFullChrgPwr_kWh /end REF_MEASUREMENT /end GROUP
/begin GROUP S545_convert_in "SWC_HALIN_type/run_SWC_HALIN_Rx_5ms_sys/HAL_IN/CAN3/BMS3/HVBIsoImpedenceN/convert_in" /begin REF_MEASUREMENT VHAL_HVBIsoImpedenceN_Megaohm /end REF_MEASUREMENT /end GROUP
/begin GROUP S546_convert_in "SWC_HALIN_type/run_SWC_HALIN_Rx_5ms_sys/HAL_IN/CAN3/BMS3/HVBIsoImpedenceP/convert_in" /begin REF_MEASUREMENT VHAL_HVBIsoImpedenceP_Megaohm /end REF_MEASUREMENT /end GROUP
/begin GROUP S547_convert_in "SWC_HALIN_type/run_SWC_HALIN_Rx_5ms_sys/HAL_IN/CAN3/BMS3/HVBSOH/convert_in" /begin REF_MEASUREMENT VHAL_HVBSOH_pct /end REF_MEASUREMENT /end GROUP
/begin GROUP S549_convert_in "SWC_HALIN_type/run_SWC_HALIN_Rx_5ms_sys/HAL_IN/CAN3/BMS3/HVBattPackVolt/convert_in" /begin REF_MEASUREMENT VHAL_HVBattPackVolt_V /end REF_MEASUREMENT /end GROUP
/begin GROUP S550_convert_in "SWC_HALIN_type/run_SWC_HALIN_Rx_5ms_sys/HAL_IN/CAN3/BMS3/HVBattSOC/convert_in" /begin REF_MEASUREMENT VHAL_HVBattSOC_pct /end REF_MEASUREMENT /end GROUP
/begin GROUP S551_convert_in "SWC_HALIN_type/run_SWC_HALIN_Rx_5ms_sys/HAL_IN/CAN3/BMS3/HVBattSOCDis/convert_in" /begin REF_MEASUREMENT VHAL_HVBattSOCDis_pct /end REF_MEASUREMENT /end GROUP
/begin GROUP S563_convert_in "SWC_HALIN_type/run_SWC_HALIN_Rx_5ms_sys/HAL_IN/CAN3/BMS4/CellTempAvg/convert_in" /begin REF_MEASUREMENT VHAL_CellTempAvg_C /end REF_MEASUREMENT /end GROUP
/begin GROUP S566_convert_in "SWC_HALIN_type/run_SWC_HALIN_Rx_5ms_sys/HAL_IN/CAN3/BMS4/HVBMTempMax/convert_in" /begin REF_MEASUREMENT VHAL_HVBMTempMax_C /end REF_MEASUREMENT /end GROUP
/begin GROUP S567_convert_in "SWC_HALIN_type/run_SWC_HALIN_Rx_5ms_sys/HAL_IN/CAN3/BMS4/HVBMTempMin/convert_in" /begin REF_MEASUREMENT VHAL_HVBMTempMin_C /end REF_MEASUREMENT /end GROUP
/begin GROUP S575_convert_in "SWC_HALIN_type/run_SWC_HALIN_Rx_5ms_sys/HAL_IN/CAN3/BMS5/HVInVolt/convert_in" /begin REF_MEASUREMENT VHAL_HVInVolt_V /end REF_MEASUREMENT /end GROUP
/begin GROUP S576_convert_in "SWC_HALIN_type/run_SWC_HALIN_Rx_5ms_sys/HAL_IN/CAN3/BMS5/LVBattDet12V/convert_in" /begin REF_MEASUREMENT VHAL_LVBattDet12V_V /end REF_MEASUREMENT /end GROUP
/begin GROUP S578_convert_in "SWC_HALIN_type/run_SWC_HALIN_Rx_5ms_sys/HAL_IN/CAN3/BMS5/OBCDCCurLm/convert_in" /begin REF_MEASUREMENT VHAL_OBCDCCurLm_A /end REF_MEASUREMENT /end GROUP
/begin GROUP S579_convert_in "SWC_HALIN_type/run_SWC_HALIN_Rx_5ms_sys/HAL_IN/CAN3/BMS5/OBCDCVoltLm/convert_in" /begin REF_MEASUREMENT VHAL_OBCDCVoltLm_V /end REF_MEASUREMENT /end GROUP
/begin GROUP S597_CRC8_Compare "SWC_HALIN_type/run_SWC_HALIN_Rx_5ms_sys/HAL_IN/CAN3/BMS6/DDM_CS&RC_Comparison/CRC8_Compare" /begin REF_MEASUREMENT VHAL_BMS6CSErr_flg VHAL_BMS6RCErr_flg /end REF_MEASUREMENT /end GROUP
/begin GROUP S627_convert_in "SWC_HALIN_type/run_SWC_HALIN_Rx_5ms_sys/HAL_IN/CAN3/CCU1/DCDCAuxCur/convert_in" /begin REF_MEASUREMENT VHAL_DCDCAuxCur_A /end REF_MEASUREMENT /end GROUP
/begin GROUP S628_convert_in "SWC_HALIN_type/run_SWC_HALIN_Rx_5ms_sys/HAL_IN/CAN3/CCU1/DCDCAuxVolt/convert_in" /begin REF_MEASUREMENT VHAL_DCDCAuxVolt_V /end REF_MEASUREMENT /end GROUP
/begin GROUP S629_convert_in "SWC_HALIN_type/run_SWC_HALIN_Rx_5ms_sys/HAL_IN/CAN3/CCU1/DCDCHVCur/convert_in" /begin REF_MEASUREMENT VHAL_DCDCHVCur_A /end REF_MEASUREMENT /end GROUP
/begin GROUP S630_convert_in "SWC_HALIN_type/run_SWC_HALIN_Rx_5ms_sys/HAL_IN/CAN3/CCU1/DCDCInVoltInf/convert_in" /begin REF_MEASUREMENT VHAL_DCDCInVoltInf_V /end REF_MEASUREMENT /end GROUP
/begin GROUP S632_CRC8_Compare "SWC_HALIN_type/run_SWC_HALIN_Rx_5ms_sys/HAL_IN/CAN3/CCU1/DDM_CS&RC_Comparison/CRC8_Compare" /begin REF_MEASUREMENT VHAL_CCU1CSErr_flg VHAL_CCU1RCErr_flg /end REF_MEASUREMENT /end GROUP
/begin GROUP S634_convert_in "SWC_HALIN_type/run_SWC_HALIN_Rx_5ms_sys/HAL_IN/CAN3/CCU1/OBCDCCurrInf/convert_in" /begin REF_MEASUREMENT VHAL_OBCDCCurrInf_A /end REF_MEASUREMENT /end GROUP
/begin GROUP S635_convert_in "SWC_HALIN_type/run_SWC_HALIN_Rx_5ms_sys/HAL_IN/CAN3/CCU1/OBCDCVoltInf/convert_in" /begin REF_MEASUREMENT VHAL_OBCDCVoltInf_V /end REF_MEASUREMENT /end GROUP
/begin GROUP S663_convert_in "SWC_HALIN_type/run_SWC_HALIN_Rx_5ms_sys/HAL_IN/CAN3/CCU2/DCDCTemp/convert_in" /begin REF_MEASUREMENT VHAL_DCDCTemp_C /end REF_MEASUREMENT /end GROUP
/begin GROUP S664_CRC8_Compare "SWC_HALIN_type/run_SWC_HALIN_Rx_5ms_sys/HAL_IN/CAN3/CCU2/DDM_CS&RC_Comparison/CRC8_Compare" /begin REF_MEASUREMENT VHAL_CCU2CSErr_flg VHAL_CCU2RCErr_flg /end REF_MEASUREMENT /end GROUP
/begin GROUP S667_convert_in "SWC_HALIN_type/run_SWC_HALIN_Rx_5ms_sys/HAL_IN/CAN3/CCU2/OBCACCurrInf/convert_in" /begin REF_MEASUREMENT VHAL_OBCACCurrInf_A /end REF_MEASUREMENT /end GROUP
/begin GROUP S668_convert_in "SWC_HALIN_type/run_SWC_HALIN_Rx_5ms_sys/HAL_IN/CAN3/CCU2/OBCACVoltInf/convert_in" /begin REF_MEASUREMENT VHAL_OBCACVoltInf_V /end REF_MEASUREMENT /end GROUP
/begin GROUP S673_convert_in "SWC_HALIN_type/run_SWC_HALIN_Rx_5ms_sys/HAL_IN/CAN3/CCU2/OBCTemp/convert_in" /begin REF_MEASUREMENT VHAL_OBCTemp_C /end REF_MEASUREMENT /end GROUP
/begin GROUP S696_CRC8_Compare "SWC_HALIN_type/run_SWC_HALIN_Rx_5ms_sys/HAL_IN/CAN3/MCU_B_F1/DDM_CS&RC_Comparison/CRC8_Compare" /begin REF_MEASUREMENT VHAL_MCUBF1CSErr_flg VHAL_MCUBF1RCErr_flg /end REF_MEASUREMENT /end GROUP
/begin GROUP S700_convert_in "SWC_HALIN_type/run_SWC_HALIN_Rx_5ms_sys/HAL_IN/CAN3/MCU_B_F1/FrEDURealTMTq/convert_in" /begin REF_MEASUREMENT VHAL_FrEDURealTMTq_Nm /end REF_MEASUREMENT /end GROUP
/begin GROUP S702_convert_in "SWC_HALIN_type/run_SWC_HALIN_Rx_5ms_sys/HAL_IN/CAN3/MCU_B_F1/FrEDUTqReqFbk/convert_in" /begin REF_MEASUREMENT VHAL_FrEDUTqReqFbk_Nm /end REF_MEASUREMENT /end GROUP
/begin GROUP S705_convert_in "SWC_HALIN_type/run_SWC_HALIN_Rx_5ms_sys/HAL_IN/CAN3/MCU_B_F1/FrMCUBAT/convert_in" /begin REF_MEASUREMENT VHAL_FrMCUBAT_V /end REF_MEASUREMENT /end GROUP
/begin GROUP S706_convert_in "SWC_HALIN_type/run_SWC_HALIN_Rx_5ms_sys/HAL_IN/CAN3/MCU_B_F1/FrMCUDCBusCurr/convert_in" /begin REF_MEASUREMENT VHAL_FrMCUDCBusCurr_A /end REF_MEASUREMENT /end GROUP
/begin GROUP S707_convert_in "SWC_HALIN_type/run_SWC_HALIN_Rx_5ms_sys/HAL_IN/CAN3/MCU_B_F1/FrMCUDCBusVolt/convert_in" /begin REF_MEASUREMENT VHAL_FrMCUDCBusVolt_V /end REF_MEASUREMENT /end GROUP
/begin GROUP S715_convert_in "SWC_HALIN_type/run_SWC_HALIN_Rx_5ms_sys/HAL_IN/CAN3/MCU_B_F1/FrMCUTemp/convert_in" /begin REF_MEASUREMENT VHAL_FrMCUTemp_C /end REF_MEASUREMENT /end GROUP
/begin GROUP S717_convert_in "SWC_HALIN_type/run_SWC_HALIN_Rx_5ms_sys/HAL_IN/CAN3/MCU_B_F1/FrRegenAvailTq/convert_in" /begin REF_MEASUREMENT VHAL_FrRegenAvailTq_Nm /end REF_MEASUREMENT /end GROUP
/begin GROUP S718_convert_in "SWC_HALIN_type/run_SWC_HALIN_Rx_5ms_sys/HAL_IN/CAN3/MCU_B_F1/FrTMSpd/convert_in" /begin REF_MEASUREMENT VHAL_FrTMSpd_rpm /end REF_MEASUREMENT /end GROUP
/begin GROUP S719_convert_in "SWC_HALIN_type/run_SWC_HALIN_Rx_5ms_sys/HAL_IN/CAN3/MCU_B_F1/FrTMTemp/convert_in" /begin REF_MEASUREMENT VHAL_FrTMTemp_C /end REF_MEASUREMENT /end GROUP
/begin GROUP S720_convert_in "SWC_HALIN_type/run_SWC_HALIN_Rx_5ms_sys/HAL_IN/CAN3/MCU_B_F1/FrTMid/convert_in" /begin REF_MEASUREMENT VHAL_FrTMid_A /end REF_MEASUREMENT /end GROUP
/begin GROUP S721_convert_in "SWC_HALIN_type/run_SWC_HALIN_Rx_5ms_sys/HAL_IN/CAN3/MCU_B_F1/FrTMiq/convert_in" /begin REF_MEASUREMENT VHAL_FrTMiq_A /end REF_MEASUREMENT /end GROUP
/begin GROUP S722_convert_in "SWC_HALIN_type/run_SWC_HALIN_Rx_5ms_sys/HAL_IN/CAN3/MCU_B_F1/MCUBFRealPwrKwSta/convert_in" /begin REF_MEASUREMENT VHAL_MCUBFRealPwrKwSta_kW /end REF_MEASUREMENT /end GROUP
/begin GROUP S751_convert_in "SWC_HALIN_type/run_SWC_HALIN_Rx_5ms_sys/HAL_IN/CAN3/MCU_B_F2/FrCoolanttempReq/convert_in" /begin REF_MEASUREMENT VHAL_FrCoolanttempReq_C /end REF_MEASUREMENT /end GROUP
/begin GROUP S756_convert_in "SWC_HALIN_type/run_SWC_HALIN_Rx_5ms_sys/HAL_IN/CAN3/MCU_B_F2/FrLLCTemp/convert_in" /begin REF_MEASUREMENT VHAL_FrLLCTemp_C /end REF_MEASUREMENT /end GROUP
/begin GROUP S757_convert_in "SWC_HALIN_type/run_SWC_HALIN_Rx_5ms_sys/HAL_IN/CAN3/MCU_B_F2/FrLLCflowReq/convert_in" /begin REF_MEASUREMENT VHAL_FrLLCflowReq_Lpmin /end REF_MEASUREMENT /end GROUP
/begin GROUP S766_CRC8_Compare "SWC_HALIN_type/run_SWC_HALIN_Rx_5ms_sys/HAL_IN/CAN3/MCU_B_R1/DDM_CS&RC_Comparison/CRC8_Compare" /begin REF_MEASUREMENT VHAL_MCUBR1CSErr_flg VHAL_MCUBR1RCErr_flg /end REF_MEASUREMENT /end GROUP
/begin GROUP S767_convert_in "SWC_HALIN_type/run_SWC_HALIN_Rx_5ms_sys/HAL_IN/CAN3/MCU_B_R1/MCUBRRealPwrKwSta/convert_in" /begin REF_MEASUREMENT VHAL_MCUBRRealPwrKwSta_kW /end REF_MEASUREMENT /end GROUP
/begin GROUP S773_convert_in "SWC_HALIN_type/run_SWC_HALIN_Rx_5ms_sys/HAL_IN/CAN3/MCU_B_R1/RrEDURealTMTq/convert_in" /begin REF_MEASUREMENT VHAL_RrEDURealTMTq_Nm /end REF_MEASUREMENT /end GROUP
/begin GROUP S775_convert_in "SWC_HALIN_type/run_SWC_HALIN_Rx_5ms_sys/HAL_IN/CAN3/MCU_B_R1/RrEDUTqReqFbk/convert_in" /begin REF_MEASUREMENT VHAL_RrEDUTqReqFbk_Nm /end REF_MEASUREMENT /end GROUP
/begin GROUP S778_convert_in "SWC_HALIN_type/run_SWC_HALIN_Rx_5ms_sys/HAL_IN/CAN3/MCU_B_R1/RrMCUBAT/convert_in" /begin REF_MEASUREMENT VHAL_RrMCUBAT_V /end REF_MEASUREMENT /end GROUP
/begin GROUP S779_convert_in "SWC_HALIN_type/run_SWC_HALIN_Rx_5ms_sys/HAL_IN/CAN3/MCU_B_R1/RrMCUDCBusCurr/convert_in" /begin REF_MEASUREMENT VHAL_RrMCUDCBusCurr_A /end REF_MEASUREMENT /end GROUP
/begin GROUP S780_convert_in "SWC_HALIN_type/run_SWC_HALIN_Rx_5ms_sys/HAL_IN/CAN3/MCU_B_R1/RrMCUDCBusVolt/convert_in" /begin REF_MEASUREMENT VHAL_RrMCUDCBusVolt_V /end REF_MEASUREMENT /end GROUP
/begin GROUP S788_convert_in "SWC_HALIN_type/run_SWC_HALIN_Rx_5ms_sys/HAL_IN/CAN3/MCU_B_R1/RrMCUTemp/convert_in" /begin REF_MEASUREMENT VHAL_RrMCUTemp_C /end REF_MEASUREMENT /end GROUP
/begin GROUP S790_convert_in "SWC_HALIN_type/run_SWC_HALIN_Rx_5ms_sys/HAL_IN/CAN3/MCU_B_R1/RrRegenAvailTq/convert_in" /begin REF_MEASUREMENT VHAL_RrRegenAvailTq_Nm /end REF_MEASUREMENT /end GROUP
/begin GROUP S791_convert_in "SWC_HALIN_type/run_SWC_HALIN_Rx_5ms_sys/HAL_IN/CAN3/MCU_B_R1/RrTMSpd/convert_in" /begin REF_MEASUREMENT VHAL_RrTMSpd_rpm /end REF_MEASUREMENT /end GROUP
/begin GROUP S792_convert_in "SWC_HALIN_type/run_SWC_HALIN_Rx_5ms_sys/HAL_IN/CAN3/MCU_B_R1/RrTMTemp/convert_in" /begin REF_MEASUREMENT VHAL_RrTMTemp_C /end REF_MEASUREMENT /end GROUP
/begin GROUP S793_convert_in "SWC_HALIN_type/run_SWC_HALIN_Rx_5ms_sys/HAL_IN/CAN3/MCU_B_R1/RrTMid/convert_in" /begin REF_MEASUREMENT VHAL_RrTMid_A /end REF_MEASUREMENT /end GROUP
/begin GROUP S794_convert_in "SWC_HALIN_type/run_SWC_HALIN_Rx_5ms_sys/HAL_IN/CAN3/MCU_B_R1/RrTMiq/convert_in" /begin REF_MEASUREMENT VHAL_RrTMiq_A /end REF_MEASUREMENT /end GROUP
/begin GROUP S822_convert_in "SWC_HALIN_type/run_SWC_HALIN_Rx_5ms_sys/HAL_IN/CAN3/MCU_B_R2/RrCoolanttempReq/convert_in" /begin REF_MEASUREMENT VHAL_RrCoolanttempReq_cnt /end REF_MEASUREMENT /end GROUP
/begin GROUP S827_convert_in "SWC_HALIN_type/run_SWC_HALIN_Rx_5ms_sys/HAL_IN/CAN3/MCU_B_R2/RrLLCTemp/convert_in" /begin REF_MEASUREMENT VHAL_RrLLCTemp_C /end REF_MEASUREMENT /end GROUP
/begin GROUP S828_convert_in "SWC_HALIN_type/run_SWC_HALIN_Rx_5ms_sys/HAL_IN/CAN3/MCU_B_R2/RrLLCflowReq/convert_in" /begin REF_MEASUREMENT VHAL_RrLLCflowReq_Lpmin /end REF_MEASUREMENT /end GROUP
/begin GROUP S836_CRC8_Compare "SWC_HALIN_type/run_SWC_HALIN_Rx_5ms_sys/HAL_IN/CAN3/MCU_N_F1/DDM_CS&RC_Comparison/CRC8_Compare" /begin REF_MEASUREMENT VHAL_MCUNF1CSErr_flg VHAL_MCUNF1RCErr_flg /end REF_MEASUREMENT /end GROUP
/begin GROUP S840_convert_in "SWC_HALIN_type/run_SWC_HALIN_Rx_5ms_sys/HAL_IN/CAN3/MCU_N_F1/FrEDURealTMTqNidec/convert_in" /begin REF_MEASUREMENT VHAL_FrEDURealTMTqNidec_Nm /end REF_MEASUREMENT /end GROUP
/begin GROUP S842_convert_in "SWC_HALIN_type/run_SWC_HALIN_Rx_5ms_sys/HAL_IN/CAN3/MCU_N_F1/FrEDUTqReqFbkNidec/convert_in" /begin REF_MEASUREMENT VHAL_FrEDUTqReqFbkNidec_Nm /end REF_MEASUREMENT /end GROUP
/begin GROUP S845_convert_in "SWC_HALIN_type/run_SWC_HALIN_Rx_5ms_sys/HAL_IN/CAN3/MCU_N_F1/FrMCUBATNidec/convert_in" /begin REF_MEASUREMENT VHAL_FrMCUBATNidec_V /end REF_MEASUREMENT /end GROUP
/begin GROUP S846_convert_in "SWC_HALIN_type/run_SWC_HALIN_Rx_5ms_sys/HAL_IN/CAN3/MCU_N_F1/FrMCUDCBusCurrNidec/convert_in" /begin REF_MEASUREMENT VHAL_FrMCUDCBusCurrNidec_A /end REF_MEASUREMENT /end GROUP
/begin GROUP S847_convert_in "SWC_HALIN_type/run_SWC_HALIN_Rx_5ms_sys/HAL_IN/CAN3/MCU_N_F1/FrMCUDCBusVoltNidec/convert_in" /begin REF_MEASUREMENT VHAL_FrMCUDCBusVoltNidec_V /end REF_MEASUREMENT /end GROUP
/begin GROUP S855_convert_in "SWC_HALIN_type/run_SWC_HALIN_Rx_5ms_sys/HAL_IN/CAN3/MCU_N_F1/FrMCUTempNidec/convert_in" /begin REF_MEASUREMENT VHAL_FrMCUTempNidec_C /end REF_MEASUREMENT /end GROUP
/begin GROUP S857_convert_in "SWC_HALIN_type/run_SWC_HALIN_Rx_5ms_sys/HAL_IN/CAN3/MCU_N_F1/FrRegenAvailTqNidec/convert_in" /begin REF_MEASUREMENT VHAL_FrRegenAvailTqNidec_Nm /end REF_MEASUREMENT /end GROUP
/begin GROUP S858_convert_in "SWC_HALIN_type/run_SWC_HALIN_Rx_5ms_sys/HAL_IN/CAN3/MCU_N_F1/FrTMSpdNidec/convert_in" /begin REF_MEASUREMENT VHAL_FrTMSpdNidec_rpm /end REF_MEASUREMENT /end GROUP
/begin GROUP S859_convert_in "SWC_HALIN_type/run_SWC_HALIN_Rx_5ms_sys/HAL_IN/CAN3/MCU_N_F1/FrTMTempNidec/convert_in" /begin REF_MEASUREMENT VHAL_FrTMTempNidec_C /end REF_MEASUREMENT /end GROUP
/begin GROUP S860_convert_in "SWC_HALIN_type/run_SWC_HALIN_Rx_5ms_sys/HAL_IN/CAN3/MCU_N_F1/FrTMidNidec/convert_in" /begin REF_MEASUREMENT VHAL_FrTMidNidec_A /end REF_MEASUREMENT /end GROUP
/begin GROUP S861_convert_in "SWC_HALIN_type/run_SWC_HALIN_Rx_5ms_sys/HAL_IN/CAN3/MCU_N_F1/FrTMiqNidec/convert_in" /begin REF_MEASUREMENT VHAL_FrTMiqNidec_A /end REF_MEASUREMENT /end GROUP
/begin GROUP S889_convert_in "SWC_HALIN_type/run_SWC_HALIN_Rx_5ms_sys/HAL_IN/CAN3/MCU_N_F2/FrCoolanttempReqNidec/convert_in" /begin REF_MEASUREMENT VHAL_FrCoolanttempReqNidec_C /end REF_MEASUREMENT /end GROUP
/begin GROUP S895_convert_in "SWC_HALIN_type/run_SWC_HALIN_Rx_5ms_sys/HAL_IN/CAN3/MCU_N_F2/FrLLCTempNidec/convert_in" /begin REF_MEASUREMENT VHAL_FrLLCTempNidec_C /end REF_MEASUREMENT /end GROUP
/begin GROUP S896_convert_in "SWC_HALIN_type/run_SWC_HALIN_Rx_5ms_sys/HAL_IN/CAN3/MCU_N_F2/FrLLCflowReqNidec/convert_in" /begin REF_MEASUREMENT VHAL_FrLLCflowReqNidec_Lpmin /end REF_MEASUREMENT /end GROUP
/begin GROUP S904_CRC8_Compare "SWC_HALIN_type/run_SWC_HALIN_Rx_5ms_sys/HAL_IN/CAN3/MCU_N_R1/DDM_CS&RC_Comparison/CRC8_Compare" /begin REF_MEASUREMENT VHAL_MCUNR1CSErr_flg VHAL_MCUNR1RCErr_flg /end REF_MEASUREMENT /end GROUP
/begin GROUP S910_convert_in "SWC_HALIN_type/run_SWC_HALIN_Rx_5ms_sys/HAL_IN/CAN3/MCU_N_R1/RrEDURealTMTqNidec/convert_in" /begin REF_MEASUREMENT VHAL_RrEDURealTMTqNidec_Nm /end REF_MEASUREMENT /end GROUP
/begin GROUP S912_convert_in "SWC_HALIN_type/run_SWC_HALIN_Rx_5ms_sys/HAL_IN/CAN3/MCU_N_R1/RrEDUTqReqFbkNidec/convert_in" /begin REF_MEASUREMENT VHAL_RrEDUTqReqFbkNidec_Nm /end REF_MEASUREMENT /end GROUP
/begin GROUP S915_convert_in "SWC_HALIN_type/run_SWC_HALIN_Rx_5ms_sys/HAL_IN/CAN3/MCU_N_R1/RrMCUBATNidec/convert_in" /begin REF_MEASUREMENT VHAL_RrMCUBATNidec_V /end REF_MEASUREMENT /end GROUP
/begin GROUP S916_convert_in "SWC_HALIN_type/run_SWC_HALIN_Rx_5ms_sys/HAL_IN/CAN3/MCU_N_R1/RrMCUDCBusCurrNidec/convert_in" /begin REF_MEASUREMENT VHAL_RrMCUDCBusCurrNidec_A /end REF_MEASUREMENT /end GROUP
/begin GROUP S917_convert_in "SWC_HALIN_type/run_SWC_HALIN_Rx_5ms_sys/HAL_IN/CAN3/MCU_N_R1/RrMCUDCBusVoltNidec/convert_in" /begin REF_MEASUREMENT VHAL_RrMCUDCBusVoltNidec_V /end REF_MEASUREMENT /end GROUP
/begin GROUP S925_convert_in "SWC_HALIN_type/run_SWC_HALIN_Rx_5ms_sys/HAL_IN/CAN3/MCU_N_R1/RrMCUTempNidec/convert_in" /begin REF_MEASUREMENT VHAL_RrMCUTempNidec_C /end REF_MEASUREMENT /end GROUP
/begin GROUP S927_convert_in "SWC_HALIN_type/run_SWC_HALIN_Rx_5ms_sys/HAL_IN/CAN3/MCU_N_R1/RrRegenAvailTqNidec/convert_in" /begin REF_MEASUREMENT VHAL_RrRegenAvailTqNidec_Nm /end REF_MEASUREMENT /end GROUP
/begin GROUP S928_convert_in "SWC_HALIN_type/run_SWC_HALIN_Rx_5ms_sys/HAL_IN/CAN3/MCU_N_R1/RrTMSpdNidec/convert_in" /begin REF_MEASUREMENT VHAL_RrTMSpdNidec_rpm /end REF_MEASUREMENT /end GROUP
/begin GROUP S929_convert_in "SWC_HALIN_type/run_SWC_HALIN_Rx_5ms_sys/HAL_IN/CAN3/MCU_N_R1/RrTMTempNidec/convert_in" /begin REF_MEASUREMENT VHAL_RrTMTempNidec_C /end REF_MEASUREMENT /end GROUP
/begin GROUP S930_convert_in "SWC_HALIN_type/run_SWC_HALIN_Rx_5ms_sys/HAL_IN/CAN3/MCU_N_R1/RrTMidNidec/convert_in" /begin REF_MEASUREMENT VHAL_RrTMidNidec_A /end REF_MEASUREMENT /end GROUP
/begin GROUP S931_convert_in "SWC_HALIN_type/run_SWC_HALIN_Rx_5ms_sys/HAL_IN/CAN3/MCU_N_R1/RrTMiqNidec/convert_in" /begin REF_MEASUREMENT VHAL_RrTMiqNidec_A /end REF_MEASUREMENT /end GROUP
/begin GROUP S957_convert_in "SWC_HALIN_type/run_SWC_HALIN_Rx_5ms_sys/HAL_IN/CAN3/MCU_N_R2/RrCoolanttempReqNidec/convert_in" /begin REF_MEASUREMENT VHAL_RrCoolanttempReqNidec_cnt /end REF_MEASUREMENT /end GROUP
/begin GROUP S963_convert_in "SWC_HALIN_type/run_SWC_HALIN_Rx_5ms_sys/HAL_IN/CAN3/MCU_N_R2/RrLLCTempNidec/convert_in" /begin REF_MEASUREMENT VHAL_RrLLCTempNidec_C /end REF_MEASUREMENT /end GROUP
/begin GROUP S964_convert_in "SWC_HALIN_type/run_SWC_HALIN_Rx_5ms_sys/HAL_IN/CAN3/MCU_N_R2/RrLLCflowReqNidec/convert_in" /begin REF_MEASUREMENT VHAL_RrLLCflowReqNidec_Lpmin /end REF_MEASUREMENT /end GROUP
/begin GROUP S972_CRC8_Compare "SWC_HALIN_type/run_SWC_HALIN_Rx_5ms_sys/HAL_IN/CAN3/Shifter1/DDM_CS&RC_Comparison/CRC8_Compare" /begin REF_MEASUREMENT VHAL_Shifter1CSErr_flg VHAL_Shifter1RCErr_flg /end REF_MEASUREMENT /end GROUP
/begin GROUP S998_CRC8_Compare "SWC_HALIN_type/run_SWC_HALIN_Rx_5ms_sys/HAL_IN/CAN3/Shifter2/DDM_CS&RC_Comparison/CRC8_Compare" /begin REF_MEASUREMENT VHAL_Shifter2CSErr_flg VHAL_Shifter2RCErr_flg /end REF_MEASUREMENT /end GROUP
/begin GROUP S1152_convert_in "SWC_HALIN_type/run_SWC_HALIN_Rx_5ms_sys/HAL_IN/CAN4/ZONE_DR1/RLTurnLampC/convert_in" /begin REF_MEASUREMENT VHAL_RLTurnLampC_mA /end REF_MEASUREMENT /end GROUP
/begin GROUP S1154_convert_in "SWC_HALIN_type/run_SWC_HALIN_Rx_5ms_sys/HAL_IN/CAN4/ZONE_DR1/RRTurnLampC/convert_in" /begin REF_MEASUREMENT VHAL_RRTurnLampC_mA /end REF_MEASUREMENT /end GROUP
/begin GROUP S1165_convert_in "SWC_HALIN_type/run_SWC_HALIN_Rx_5ms_sys/HAL_IN/CAN4/ZONE_DR_VCU/SolarL/convert_in" /begin REF_MEASUREMENT VHAL_SolarL_W /end REF_MEASUREMENT /end GROUP
/begin GROUP S1167_convert_in "SWC_HALIN_type/run_SWC_HALIN_Rx_5ms_sys/HAL_IN/CAN4/ZONE_DR_VCU/SolarR/convert_in" /begin REF_MEASUREMENT VHAL_SolarR_W /end REF_MEASUREMENT /end GROUP
/begin GROUP S1169_convert_in "SWC_HALIN_type/run_SWC_HALIN_Rx_5ms_sys/HAL_IN/CAN4/ZONE_DR_VCU/TFaceL/convert_in" /begin REF_MEASUREMENT VHAL_TFaceL_C /end REF_MEASUREMENT /end GROUP
/begin GROUP S1171_convert_in "SWC_HALIN_type/run_SWC_HALIN_Rx_5ms_sys/HAL_IN/CAN4/ZONE_DR_VCU/TFaceR/convert_in" /begin REF_MEASUREMENT VHAL_TFaceR_C /end REF_MEASUREMENT /end GROUP
/begin GROUP S1173_convert_in "SWC_HALIN_type/run_SWC_HALIN_Rx_5ms_sys/HAL_IN/CAN4/ZONE_DR_VCU/TFaceRr/convert_in" /begin REF_MEASUREMENT VHAL_TFaceRr_C /end REF_MEASUREMENT /end GROUP
/begin GROUP S1175_convert_in "SWC_HALIN_type/run_SWC_HALIN_Rx_5ms_sys/HAL_IN/CAN4/ZONE_DR_VCU/TFootL/convert_in" /begin REF_MEASUREMENT VHAL_TFootL_C /end REF_MEASUREMENT /end GROUP
/begin GROUP S1177_convert_in "SWC_HALIN_type/run_SWC_HALIN_Rx_5ms_sys/HAL_IN/CAN4/ZONE_DR_VCU/TFootR/convert_in" /begin REF_MEASUREMENT VHAL_TFootR_C /end REF_MEASUREMENT /end GROUP
/begin GROUP S1179_convert_in "SWC_HALIN_type/run_SWC_HALIN_Rx_5ms_sys/HAL_IN/CAN4/ZONE_DR_VCU/TFootRr/convert_in" /begin REF_MEASUREMENT VHAL_TFootRr_C /end REF_MEASUREMENT /end GROUP
/begin GROUP S1181_convert_in "SWC_HALIN_type/run_SWC_HALIN_Rx_5ms_sys/HAL_IN/CAN4/ZONE_DR_VCU/Tevap/convert_in" /begin REF_MEASUREMENT VHAL_Tevap_C /end REF_MEASUREMENT /end GROUP
/begin GROUP S1183_convert_in "SWC_HALIN_type/run_SWC_HALIN_Rx_5ms_sys/HAL_IN/CAN4/ZONE_DR_VCU/Tincar/convert_in" /begin REF_MEASUREMENT VHAL_Tincar_C /end REF_MEASUREMENT /end GROUP
/begin GROUP S1199_convert_in "SWC_HALIN_type/run_SWC_HALIN_Rx_5ms_sys/HAL_IN/CAN4/ZONE_FR1/FLTurnLampC/convert_in" /begin REF_MEASUREMENT VHAL_FLTurnLampC_mA /end REF_MEASUREMENT /end GROUP
/begin GROUP S1202_convert_in "SWC_HALIN_type/run_SWC_HALIN_Rx_5ms_sys/HAL_IN/CAN4/ZONE_FR1/FRTurnLampC/convert_in" /begin REF_MEASUREMENT VHAL_FRTurnLampC_mA /end REF_MEASUREMENT /end GROUP
/begin GROUP S1232_convert_in "SWC_HALIN_type/run_SWC_HALIN_Rx_5ms_sys/HAL_IN/CAN4/ZONE_FR_VCU/BatInTemp/convert_in" /begin REF_MEASUREMENT VHAL_BatInTemp_C /end REF_MEASUREMENT /end GROUP
/begin GROUP S1234_convert_in "SWC_HALIN_type/run_SWC_HALIN_Rx_5ms_sys/HAL_IN/CAN4/ZONE_FR_VCU/BatOutTemp/convert_in" /begin REF_MEASUREMENT VHAL_BatOutTemp_C /end REF_MEASUREMENT /end GROUP
/begin GROUP S1242_convert_in "SWC_HALIN_type/run_SWC_HALIN_Rx_5ms_sys/HAL_IN/CAN4/ZONE_FR_VCU/MotorInTemp/convert_in" /begin REF_MEASUREMENT VHAL_MotorInTemp_C /end REF_MEASUREMENT /end GROUP
/begin GROUP S1244_convert_in "SWC_HALIN_type/run_SWC_HALIN_Rx_5ms_sys/HAL_IN/CAN4/ZONE_FR_VCU/MotorOutTemp/convert_in" /begin REF_MEASUREMENT VHAL_MotorOutTemp_C /end REF_MEASUREMENT /end GROUP
/begin GROUP S1248_convert_in "SWC_HALIN_type/run_SWC_HALIN_Rx_5ms_sys/HAL_IN/CAN4/ZONE_FR_VCU/PTHighTact/convert_in" /begin REF_MEASUREMENT VHAL_PTHighTact_C /end REF_MEASUREMENT /end GROUP
/begin GROUP S1254_convert_in "SWC_HALIN_type/run_SWC_HALIN_Rx_5ms_sys/HAL_IN/CAN4/ZONE_FR_VCU/PTLowT1/convert_in" /begin REF_MEASUREMENT VHAL_PTLowT1_C /end REF_MEASUREMENT /end GROUP
/begin GROUP S1256_convert_in "SWC_HALIN_type/run_SWC_HALIN_Rx_5ms_sys/HAL_IN/CAN4/ZONE_FR_VCU/PTLowT2/convert_in" /begin REF_MEASUREMENT VHAL_PTLowT2_C /end REF_MEASUREMENT /end GROUP
/begin GROUP S1262_convert_in "SWC_HALIN_type/run_SWC_HALIN_Rx_5ms_sys/HAL_IN/CAN4/ZONE_FR_VCU/Tamb/convert_in" /begin REF_MEASUREMENT VHAL_Tamb_C /end REF_MEASUREMENT /end GROUP
/begin GROUP S1272_convert_in "SWC_HALIN_type/run_SWC_HALIN_Rx_5ms_sys/HAL_IN/CAN4/zGW_APTC1/FrntPTCLeActHeatPwr/convert_in" /begin REF_MEASUREMENT VHAL_FrntPTCLeActHeatPwr_W /end REF_MEASUREMENT /end GROUP
/begin GROUP S1273_convert_in "SWC_HALIN_type/run_SWC_HALIN_Rx_5ms_sys/HAL_IN/CAN4/zGW_APTC1/FrntPTCRearLeActHeatPwr/convert_in" /begin REF_MEASUREMENT VHAL_FrntPTCRearLeActHeatPwr_W /end REF_MEASUREMENT /end GROUP
/begin GROUP S1274_convert_in "SWC_HALIN_type/run_SWC_HALIN_Rx_5ms_sys/HAL_IN/CAN4/zGW_APTC1/FrntPTCRearRiActHeatPwr/convert_in" /begin REF_MEASUREMENT VHAL_FrntPTCRearRiActHeatPwr_W /end REF_MEASUREMENT /end GROUP
/begin GROUP S1275_convert_in "SWC_HALIN_type/run_SWC_HALIN_Rx_5ms_sys/HAL_IN/CAN4/zGW_APTC1/FrntPTCRiActHeatPwr/convert_in" /begin REF_MEASUREMENT VHAL_FrntPTCRiActHeatPwr_W /end REF_MEASUREMENT /end GROUP
/begin GROUP S1281_convert_in "SWC_HALIN_type/run_SWC_HALIN_Rx_5ms_sys/HAL_IN/CAN4/zGW_CANFr1/COMPConCur/convert_in" /begin REF_MEASUREMENT VHAL_COMPConCur_A /end REF_MEASUREMENT /end GROUP
/begin GROUP S1282_convert_in "SWC_HALIN_type/run_SWC_HALIN_Rx_5ms_sys/HAL_IN/CAN4/zGW_CANFr1/COMPConVolt/convert_in" /begin REF_MEASUREMENT VHAL_COMPConVolt_V /end REF_MEASUREMENT /end GROUP
/begin GROUP S1284_convert_in "SWC_HALIN_type/run_SWC_HALIN_Rx_5ms_sys/HAL_IN/CAN4/zGW_CANFr1/PTC1PowerConsumption/convert_in" /begin REF_MEASUREMENT VHAL_PTC1PowerConsumption_kW /end REF_MEASUREMENT /end GROUP
/begin GROUP S1381_convert_in "SWC_HALIN_type/run_SWC_HALIN_Rx_5ms_sys/HAL_IN/CAN5/TBOX2/TimeSyncFromBSYear/convert_in" /begin REF_MEASUREMENT VHAL_TimeSyncFromBSYear_YEAR /end REF_MEASUREMENT /end GROUP
/begin GROUP S1388_convert_in "SWC_HALIN_type/run_SWC_HALIN_Rx_5ms_sys/HAL_IN/CAN5/TBOX3/ReserveChargeOFFYear/convert_in" /begin REF_MEASUREMENT VHAL_ReserveChargeOFFYear_YEAR /end REF_MEASUREMENT /end GROUP
/begin GROUP S1393_convert_in "SWC_HALIN_type/run_SWC_HALIN_Rx_5ms_sys/HAL_IN/CAN5/TBOX3/ReserveChargeOnYear/convert_in" /begin REF_MEASUREMENT VHAL_ReserveChargeOnYear_YEAR /end REF_MEASUREMENT /end GROUP
/begin GROUP S1410_convert_in "SWC_HALIN_type/run_SWC_HALIN_Rx_5ms_sys/HAL_IN/CAN6/FCM1/ACCComfortBandLower/convert_in" /begin REF_MEASUREMENT VHAL_ACCComfortBandLower_mps2 /end REF_MEASUREMENT /end GROUP
/begin GROUP S1411_convert_in "SWC_HALIN_type/run_SWC_HALIN_Rx_5ms_sys/HAL_IN/CAN6/FCM1/ACCComfortBandUpper/convert_in" /begin REF_MEASUREMENT VHAL_ACCComfortBandUpper_mps2 /end REF_MEASUREMENT /end GROUP
/begin GROUP S1412_convert_in "SWC_HALIN_type/run_SWC_HALIN_Rx_5ms_sys/HAL_IN/CAN6/FCM1/ACCJerkLowerLimit/convert_in" /begin REF_MEASUREMENT VHAL_ACCJerkLowerLimit_mps3 /end REF_MEASUREMENT /end GROUP
/begin GROUP S1413_convert_in "SWC_HALIN_type/run_SWC_HALIN_Rx_5ms_sys/HAL_IN/CAN6/FCM1/ACCJerkUpperLimit/convert_in" /begin REF_MEASUREMENT VHAL_ACCJerkUpperLimit_mps3 /end REF_MEASUREMENT /end GROUP
/begin GROUP S1414_convert_in "SWC_HALIN_type/run_SWC_HALIN_Rx_5ms_sys/HAL_IN/CAN6/FCM1/ACCObjDist/convert_in" /begin REF_MEASUREMENT VHAL_ACCObjDist_m /end REF_MEASUREMENT /end GROUP
/begin GROUP S1416_convert_in "SWC_HALIN_type/run_SWC_HALIN_Rx_5ms_sys/HAL_IN/CAN6/FCM1/ACCObjRelSpd/convert_in" /begin REF_MEASUREMENT VHAL_ACCObjRelSpd_mps /end REF_MEASUREMENT /end GROUP
/begin GROUP S1417_convert_in "SWC_HALIN_type/run_SWC_HALIN_Rx_5ms_sys/HAL_IN/CAN6/FCM1/ACCRequiredAccel/convert_in" /begin REF_MEASUREMENT VHAL_ACCRequiredAccel_mps2 /end REF_MEASUREMENT /end GROUP
/begin GROUP S1439_convert_in "SWC_HALIN_type/run_SWC_HALIN_Rx_5ms_sys/HAL_IN/CAN6/FCM1/ADASLanecurveL/convert_in" /begin REF_MEASUREMENT VHAL_ADASLanecurveL_raw32 /end REF_MEASUREMENT /end GROUP
/begin GROUP S1440_convert_in "SWC_HALIN_type/run_SWC_HALIN_Rx_5ms_sys/HAL_IN/CAN6/FCM1/ADASLanecurveR/convert_in" /begin REF_MEASUREMENT VHAL_ADASLanecurveR_raw32 /end REF_MEASUREMENT /end GROUP
/begin GROUP S1454_convert_in "SWC_HALIN_type/run_SWC_HALIN_Rx_5ms_sys/HAL_IN/CAN6/FCM1/FCMLKAStrToqReq/convert_in" /begin REF_MEASUREMENT VHAL_FCMLKAStrToqReq_Nm /end REF_MEASUREMENT /end GROUP
/begin GROUP S1482_CRC8_Compare "SWC_HALIN_type/run_SWC_HALIN_Rx_5ms_sys/HAL_IN/CAN6/FCM2/DDM_CS&RC_Comparison/CRC8_Compare" /begin REF_MEASUREMENT VHAL_FCM2CSErr_flg VHAL_FCM2RCErr_flg /end REF_MEASUREMENT /end GROUP
/begin GROUP S1498_convert_in "SWC_HALIN_type/run_SWC_HALIN_Rx_5ms_sys/HAL_IN/CAN6/FCM3/MELaneCurvDervLt/convert_in" /begin REF_MEASUREMENT VHAL_MELaneCurvDervLt_raw32 /end REF_MEASUREMENT /end GROUP
/begin GROUP S1499_convert_in "SWC_HALIN_type/run_SWC_HALIN_Rx_5ms_sys/HAL_IN/CAN6/FCM3/MELaneCurvDervLt2/convert_in" /begin REF_MEASUREMENT VHAL_MELaneCurvDervLt2_raw32 /end REF_MEASUREMENT /end GROUP
/begin GROUP S1500_convert_in "SWC_HALIN_type/run_SWC_HALIN_Rx_5ms_sys/HAL_IN/CAN6/FCM3/MELaneCurvDervRt/convert_in" /begin REF_MEASUREMENT VHAL_MELaneCurvDervRt_raw32 /end REF_MEASUREMENT /end GROUP
/begin GROUP S1501_convert_in "SWC_HALIN_type/run_SWC_HALIN_Rx_5ms_sys/HAL_IN/CAN6/FCM3/MELaneCurvDervRt2/convert_in" /begin REF_MEASUREMENT VHAL_MELaneCurvDervRt2_raw32 /end REF_MEASUREMENT /end GROUP
/begin GROUP S1502_convert_in "SWC_HALIN_type/run_SWC_HALIN_Rx_5ms_sys/HAL_IN/CAN6/FCM3/MELaneCurvLt/convert_in" /begin REF_MEASUREMENT VHAL_MELaneCurvLt_raw32 /end REF_MEASUREMENT /end GROUP
/begin GROUP S1503_convert_in "SWC_HALIN_type/run_SWC_HALIN_Rx_5ms_sys/HAL_IN/CAN6/FCM3/MELaneCurvLt2/convert_in" /begin REF_MEASUREMENT VHAL_MELaneCurvLt2_raw32 /end REF_MEASUREMENT /end GROUP
/begin GROUP S1504_convert_in "SWC_HALIN_type/run_SWC_HALIN_Rx_5ms_sys/HAL_IN/CAN6/FCM3/MELaneCurvRt/convert_in" /begin REF_MEASUREMENT VHAL_MELaneCurvRt_raw32 /end REF_MEASUREMENT /end GROUP
/begin GROUP S1505_convert_in "SWC_HALIN_type/run_SWC_HALIN_Rx_5ms_sys/HAL_IN/CAN6/FCM3/MELaneCurvRt2/convert_in" /begin REF_MEASUREMENT VHAL_MELaneCurvRt2_raw32 /end REF_MEASUREMENT /end GROUP
/begin GROUP S1506_convert_in "SWC_HALIN_type/run_SWC_HALIN_Rx_5ms_sys/HAL_IN/CAN6/FCM3/MELaneHeadAngLt/convert_in" /begin REF_MEASUREMENT VHAL_MELaneHeadAngLt_radians /end REF_MEASUREMENT /end GROUP
/begin GROUP S1507_convert_in "SWC_HALIN_type/run_SWC_HALIN_Rx_5ms_sys/HAL_IN/CAN6/FCM3/MELaneHeadAngLt2/convert_in" /begin REF_MEASUREMENT VHAL_MELaneHeadAngLt2_radians /end REF_MEASUREMENT /end GROUP
/begin GROUP S1508_convert_in "SWC_HALIN_type/run_SWC_HALIN_Rx_5ms_sys/HAL_IN/CAN6/FCM3/MELaneHeadAngRt/convert_in" /begin REF_MEASUREMENT VHAL_MELaneHeadAngRt_radians /end REF_MEASUREMENT /end GROUP
/begin GROUP S1509_convert_in "SWC_HALIN_type/run_SWC_HALIN_Rx_5ms_sys/HAL_IN/CAN6/FCM3/MELaneHeadAngRt2/convert_in" /begin REF_MEASUREMENT VHAL_MELaneHeadAngRt2_radians /end REF_MEASUREMENT /end GROUP
/begin GROUP S1510_convert_in "SWC_HALIN_type/run_SWC_HALIN_Rx_5ms_sys/HAL_IN/CAN6/FCM3/MELanePosLt/convert_in" /begin REF_MEASUREMENT VHAL_MELanePosLt_m /end REF_MEASUREMENT /end GROUP
/begin GROUP S1511_convert_in "SWC_HALIN_type/run_SWC_HALIN_Rx_5ms_sys/HAL_IN/CAN6/FCM3/MELanePosLt2/convert_in" /begin REF_MEASUREMENT VHAL_MELanePosLt2_m /end REF_MEASUREMENT /end GROUP
/begin GROUP S1512_convert_in "SWC_HALIN_type/run_SWC_HALIN_Rx_5ms_sys/HAL_IN/CAN6/FCM3/MELanePosRt/convert_in" /begin REF_MEASUREMENT VHAL_MELanePosRt_m /end REF_MEASUREMENT /end GROUP
/begin GROUP S1513_convert_in "SWC_HALIN_type/run_SWC_HALIN_Rx_5ms_sys/HAL_IN/CAN6/FCM3/MELanePosRt2/convert_in" /begin REF_MEASUREMENT VHAL_MELanePosRt2_m /end REF_MEASUREMENT /end GROUP
/begin GROUP S1530_convert_in "SWC_HALIN_type/run_SWC_HALIN_Rx_5ms_sys/HAL_IN/CAN6/FCM4/ADASAngCtrlTqWeightGain/convert_in" /begin REF_MEASUREMENT VHAL_ADASAngCtrlTqWeightGain_pct /end REF_MEASUREMENT /end GROUP
/begin GROUP S1531_convert_in "SWC_HALIN_type/run_SWC_HALIN_Rx_5ms_sys/HAL_IN/CAN6/FCM4/ADASDesStrWhlAngCtrlCmd/convert_in" /begin REF_MEASUREMENT VHAL_ADASDesStrWhlAngCtrlCmd_Deg /end REF_MEASUREMENT /end GROUP
/begin GROUP S1533_convert_in "SWC_HALIN_type/run_SWC_HALIN_Rx_5ms_sys/HAL_IN/CAN6/FCM4/ADASDrvInputTqBoostGain/convert_in" /begin REF_MEASUREMENT VHAL_ADASDrvInputTqBoostGain_pct /end REF_MEASUREMENT /end GROUP
/begin GROUP S1534_convert_in "SWC_HALIN_type/run_SWC_HALIN_Rx_5ms_sys/HAL_IN/CAN6/FCM4/ADASMaxAngCtrlOutTqLimit/convert_in" /begin REF_MEASUREMENT VHAL_ADASMaxAngCtrlOutTqLimit_Nm /end REF_MEASUREMENT /end GROUP
/begin GROUP S1536_CRC8_Compare "SWC_HALIN_type/run_SWC_HALIN_Rx_5ms_sys/HAL_IN/CAN6/FCM4/DDM_CS&RC_Comparison/CRC8_Compare" /begin REF_MEASUREMENT VHAL_FCM4CSErr_flg VHAL_FCM4RCErr_flg /end REF_MEASUREMENT /end GROUP
/end MODULE
/end PROJECT
