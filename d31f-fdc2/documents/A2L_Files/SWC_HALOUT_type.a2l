ASAP2_VERSION 1 51
/begin PROJECT ProjectName "Project Comment Goes Here"
/begin HEADER "Header Comments go here" /end HEADER
/begin MODULE ModuleName "Module Comment Goes Here"
/begin MOD_COMMON "Mod Common Comment Here" BYTE_ORDER MSB_LAST ALIGNMENT_BYTE 1 ALIGNMENT_WORD 1 ALIGNMENT_LONG 1 ALIGNMENT_FLOAT32_IEEE 1 ALIGNMENT_FLOAT64_IEEE 1 /end MOD_COMMON
/begin FUNCTION VMCACCVehHoldReq "" /begin SUB_FUNCTION Data_Type_Conversion /end SUB_FUNCTION /begin DEF_CHARACTERISTIC /end DEF_CHARACTERISTIC /begin IN_MEASUREMENT /end IN_MEASUREMENT /begin OUT_MEASUREMENT /end OUT_MEASUREMENT /end FUNCTION
/begin FUNCTION VMCADASACCSta "" /begin SUB_FUNCTION /end SUB_FUNCTION /begin DEF_CHARACTERISTIC /end DEF_CHARACTERISTIC /begin IN_MEASUREMENT /end IN_MEASUREMENT /begin OUT_MEASUREMENT /end OUT_MEASUREMENT /end FUNCTION
/begin FUNCTION VMCADASAEBReq "" /begin SUB_FUNCTION /end SUB_FUNCTION /begin DEF_CHARACTERISTIC /end DEF_CHARACTERISTIC /begin IN_MEASUREMENT /end IN_MEASUREMENT /begin OUT_MEASUREMENT /end OUT_MEASUREMENT /end FUNCTION
/begin FUNCTION VMCADASAEBSta "" /begin SUB_FUNCTION /end SUB_FUNCTION /begin DEF_CHARACTERISTIC /end DEF_CHARACTERISTIC /begin IN_MEASUREMENT /end IN_MEASUREMENT /begin OUT_MEASUREMENT /end OUT_MEASUREMENT /end FUNCTION
/begin FUNCTION VMCADASDBSReq "" /begin SUB_FUNCTION /end SUB_FUNCTION /begin DEF_CHARACTERISTIC /end DEF_CHARACTERISTIC /begin IN_MEASUREMENT /end IN_MEASUREMENT /begin OUT_MEASUREMENT /end OUT_MEASUREMENT /end FUNCTION
/begin FUNCTION VMCADASFaultSta "" /begin SUB_FUNCTION Data_Type_Conversion /end SUB_FUNCTION /begin DEF_CHARACTERISTIC /end DEF_CHARACTERISTIC /begin IN_MEASUREMENT /end IN_MEASUREMENT /begin OUT_MEASUREMENT /end OUT_MEASUREMENT /end FUNCTION
/begin FUNCTION VMCAEBVehHoldReq "" /begin SUB_FUNCTION Data_Type_Conversion /end SUB_FUNCTION /begin DEF_CHARACTERISTIC /end DEF_CHARACTERISTIC /begin IN_MEASUREMENT /end IN_MEASUREMENT /begin OUT_MEASUREMENT /end OUT_MEASUREMENT /end FUNCTION
/begin FUNCTION VMCFCM1Checksum "" /begin SUB_FUNCTION /end SUB_FUNCTION /begin DEF_CHARACTERISTIC /end DEF_CHARACTERISTIC /begin IN_MEASUREMENT /end IN_MEASUREMENT /begin OUT_MEASUREMENT /end OUT_MEASUREMENT /end FUNCTION
/begin FUNCTION VMCFCM1LifeCount "" /begin SUB_FUNCTION /end SUB_FUNCTION /begin DEF_CHARACTERISTIC /end DEF_CHARACTERISTIC /begin IN_MEASUREMENT /end IN_MEASUREMENT /begin OUT_MEASUREMENT /end OUT_MEASUREMENT /end FUNCTION
/begin FUNCTION VMCFCMLDWFault "" /begin SUB_FUNCTION Data_Type_Conversion /end SUB_FUNCTION /begin DEF_CHARACTERISTIC /end DEF_CHARACTERISTIC /begin IN_MEASUREMENT /end IN_MEASUREMENT /begin OUT_MEASUREMENT /end OUT_MEASUREMENT /end FUNCTION
/begin FUNCTION VMCFCMLDWRequest "" /begin SUB_FUNCTION /end SUB_FUNCTION /begin DEF_CHARACTERISTIC /end DEF_CHARACTERISTIC /begin IN_MEASUREMENT /end IN_MEASUREMENT /begin OUT_MEASUREMENT /end OUT_MEASUREMENT /end FUNCTION
/begin FUNCTION VMCFCMLKAStrToqReq "" /begin SUB_FUNCTION convert_out Data_Type_Conversion /end SUB_FUNCTION /begin DEF_CHARACTERISTIC /end DEF_CHARACTERISTIC /begin IN_MEASUREMENT /end IN_MEASUREMENT /begin OUT_MEASUREMENT /end OUT_MEASUREMENT /end FUNCTION
/begin FUNCTION VMCFCMLKATOIAct "" /begin SUB_FUNCTION /end SUB_FUNCTION /begin DEF_CHARACTERISTIC /end DEF_CHARACTERISTIC /begin IN_MEASUREMENT /end IN_MEASUREMENT /begin OUT_MEASUREMENT /end OUT_MEASUREMENT /end FUNCTION
/begin FUNCTION VMCFCMLKATOIFault "" /begin SUB_FUNCTION Data_Type_Conversion /end SUB_FUNCTION /begin DEF_CHARACTERISTIC /end DEF_CHARACTERISTIC /begin IN_MEASUREMENT /end IN_MEASUREMENT /begin OUT_MEASUREMENT /end OUT_MEASUREMENT /end FUNCTION
/begin FUNCTION bus_creator "" /begin DEF_CHARACTERISTIC /end DEF_CHARACTERISTIC /begin IN_MEASUREMENT /end IN_MEASUREMENT /begin OUT_MEASUREMENT /end OUT_MEASUREMENT /end FUNCTION
/begin FUNCTION Byte_16 "" /begin DEF_CHARACTERISTIC /end DEF_CHARACTERISTIC /begin IN_MEASUREMENT /end IN_MEASUREMENT /begin OUT_MEASUREMENT /end OUT_MEASUREMENT /end FUNCTION
/begin FUNCTION Byte_17 "" /begin DEF_CHARACTERISTIC /end DEF_CHARACTERISTIC /begin IN_MEASUREMENT /end IN_MEASUREMENT /begin OUT_MEASUREMENT /end OUT_MEASUREMENT /end FUNCTION
/begin FUNCTION Byte_18 "" /begin DEF_CHARACTERISTIC /end DEF_CHARACTERISTIC /begin IN_MEASUREMENT /end IN_MEASUREMENT /begin OUT_MEASUREMENT /end OUT_MEASUREMENT /end FUNCTION
/begin FUNCTION Byte_19 "" /begin DEF_CHARACTERISTIC /end DEF_CHARACTERISTIC /begin IN_MEASUREMENT /end IN_MEASUREMENT /begin OUT_MEASUREMENT /end OUT_MEASUREMENT /end FUNCTION
/begin FUNCTION Byte_20 "" /begin DEF_CHARACTERISTIC /end DEF_CHARACTERISTIC /begin IN_MEASUREMENT /end IN_MEASUREMENT /begin OUT_MEASUREMENT /end OUT_MEASUREMENT /end FUNCTION
/begin FUNCTION Byte_21 "" /begin DEF_CHARACTERISTIC /end DEF_CHARACTERISTIC /begin IN_MEASUREMENT /end IN_MEASUREMENT /begin OUT_MEASUREMENT /end OUT_MEASUREMENT /end FUNCTION
/begin FUNCTION Byte_22 "" /begin DEF_CHARACTERISTIC /end DEF_CHARACTERISTIC /begin IN_MEASUREMENT /end IN_MEASUREMENT /begin OUT_MEASUREMENT /end OUT_MEASUREMENT /end FUNCTION
/begin FUNCTION Byte_23 "" /begin DEF_CHARACTERISTIC /end DEF_CHARACTERISTIC /begin IN_MEASUREMENT /end IN_MEASUREMENT /begin OUT_MEASUREMENT /end OUT_MEASUREMENT /end FUNCTION
/begin FUNCTION Byte_24 "" /begin DEF_CHARACTERISTIC /end DEF_CHARACTERISTIC /begin IN_MEASUREMENT /end IN_MEASUREMENT /begin OUT_MEASUREMENT /end OUT_MEASUREMENT /end FUNCTION
/begin FUNCTION Byte_25 "" /begin DEF_CHARACTERISTIC /end DEF_CHARACTERISTIC /begin IN_MEASUREMENT /end IN_MEASUREMENT /begin OUT_MEASUREMENT /end OUT_MEASUREMENT /end FUNCTION
/begin FUNCTION Byte_26 "" /begin DEF_CHARACTERISTIC /end DEF_CHARACTERISTIC /begin IN_MEASUREMENT /end IN_MEASUREMENT /begin OUT_MEASUREMENT /end OUT_MEASUREMENT /end FUNCTION
/begin FUNCTION Byte_27 "" /begin DEF_CHARACTERISTIC /end DEF_CHARACTERISTIC /begin IN_MEASUREMENT /end IN_MEASUREMENT /begin OUT_MEASUREMENT /end OUT_MEASUREMENT /end FUNCTION
/begin FUNCTION Byte_28 "" /begin DEF_CHARACTERISTIC /end DEF_CHARACTERISTIC /begin IN_MEASUREMENT /end IN_MEASUREMENT /begin OUT_MEASUREMENT /end OUT_MEASUREMENT /end FUNCTION
/begin FUNCTION Byte_29 "" /begin DEF_CHARACTERISTIC /end DEF_CHARACTERISTIC /begin IN_MEASUREMENT /end IN_MEASUREMENT /begin OUT_MEASUREMENT /end OUT_MEASUREMENT /end FUNCTION
/begin FUNCTION Byte_30 "" /begin DEF_CHARACTERISTIC /end DEF_CHARACTERISTIC /begin IN_MEASUREMENT /end IN_MEASUREMENT /begin OUT_MEASUREMENT /end OUT_MEASUREMENT /end FUNCTION
/begin FUNCTION Byte_31 "" /begin DEF_CHARACTERISTIC /end DEF_CHARACTERISTIC /begin IN_MEASUREMENT /end IN_MEASUREMENT /begin OUT_MEASUREMENT /end OUT_MEASUREMENT /end FUNCTION
/begin FUNCTION Constant "" /begin DEF_CHARACTERISTIC KHAL_CAN1VMCFCM1E2E_flg /end DEF_CHARACTERISTIC /begin IN_MEASUREMENT /end IN_MEASUREMENT /begin OUT_MEASUREMENT /end OUT_MEASUREMENT /end FUNCTION
/begin FUNCTION Constant1 "" /begin DEF_CHARACTERISTIC /end DEF_CHARACTERISTIC /begin IN_MEASUREMENT /end IN_MEASUREMENT /begin OUT_MEASUREMENT /end OUT_MEASUREMENT /end FUNCTION
/begin FUNCTION Constant2 "" /begin DEF_CHARACTERISTIC /end DEF_CHARACTERISTIC /begin IN_MEASUREMENT /end IN_MEASUREMENT /begin OUT_MEASUREMENT /end OUT_MEASUREMENT /end FUNCTION
/begin FUNCTION Constant3 "" /begin DEF_CHARACTERISTIC KHAL_CAN1VMCFCM1E2E_flg /end DEF_CHARACTERISTIC /begin IN_MEASUREMENT /end IN_MEASUREMENT /begin OUT_MEASUREMENT /end OUT_MEASUREMENT /end FUNCTION
/begin FUNCTION Constant4 "" /begin DEF_CHARACTERISTIC KHAL_CAN1VMCFCM1E2E_flg /end DEF_CHARACTERISTIC /begin IN_MEASUREMENT /end IN_MEASUREMENT /begin OUT_MEASUREMENT /end OUT_MEASUREMENT /end FUNCTION
/begin FUNCTION Chart "" /begin DEF_CHARACTERISTIC /end DEF_CHARACTERISTIC /begin IN_MEASUREMENT /end IN_MEASUREMENT /begin OUT_MEASUREMENT /end OUT_MEASUREMENT /end FUNCTION
/begin FUNCTION Constant "" /begin DEF_CHARACTERISTIC /end DEF_CHARACTERISTIC /begin IN_MEASUREMENT /end IN_MEASUREMENT /begin OUT_MEASUREMENT /end OUT_MEASUREMENT /end FUNCTION
/begin FUNCTION Constant3 "" /begin DEF_CHARACTERISTIC /end DEF_CHARACTERISTIC /begin IN_MEASUREMENT /end IN_MEASUREMENT /begin OUT_MEASUREMENT /end OUT_MEASUREMENT /end FUNCTION
/begin FUNCTION Data_Type_Conversion "" /begin DEF_CHARACTERISTIC /end DEF_CHARACTERISTIC /begin IN_MEASUREMENT /end IN_MEASUREMENT /begin OUT_MEASUREMENT /end OUT_MEASUREMENT /end FUNCTION
/begin FUNCTION Gain "" /begin DEF_CHARACTERISTIC /end DEF_CHARACTERISTIC /begin IN_MEASUREMENT /end IN_MEASUREMENT /begin OUT_MEASUREMENT /end OUT_MEASUREMENT /end FUNCTION
/begin FUNCTION Divide "" /begin DEF_CHARACTERISTIC /end DEF_CHARACTERISTIC /begin IN_MEASUREMENT /end IN_MEASUREMENT /begin OUT_MEASUREMENT /end OUT_MEASUREMENT /end FUNCTION
/begin FUNCTION APSExitCondition "" /begin SUB_FUNCTION /end SUB_FUNCTION /begin DEF_CHARACTERISTIC /end DEF_CHARACTERISTIC /begin IN_MEASUREMENT /end IN_MEASUREMENT /begin OUT_MEASUREMENT /end OUT_MEASUREMENT /end FUNCTION
/begin FUNCTION APSRQDisplay "" /begin SUB_FUNCTION /end SUB_FUNCTION /begin DEF_CHARACTERISTIC /end DEF_CHARACTERISTIC /begin IN_MEASUREMENT /end IN_MEASUREMENT /begin OUT_MEASUREMENT /end OUT_MEASUREMENT /end FUNCTION
/begin FUNCTION APSSWVer "" /begin SUB_FUNCTION /end SUB_FUNCTION /begin DEF_CHARACTERISTIC /end DEF_CHARACTERISTIC /begin IN_MEASUREMENT /end IN_MEASUREMENT /begin OUT_MEASUREMENT /end OUT_MEASUREMENT /end FUNCTION
/begin FUNCTION APSStaSystem "" /begin SUB_FUNCTION /end SUB_FUNCTION /begin DEF_CHARACTERISTIC /end DEF_CHARACTERISTIC /begin IN_MEASUREMENT /end IN_MEASUREMENT /begin OUT_MEASUREMENT /end OUT_MEASUREMENT /end FUNCTION
/begin FUNCTION CAASSta "" /begin SUB_FUNCTION /end SUB_FUNCTION /begin DEF_CHARACTERISTIC /end DEF_CHARACTERISTIC /begin IN_MEASUREMENT /end IN_MEASUREMENT /begin OUT_MEASUREMENT /end OUT_MEASUREMENT /end FUNCTION
/begin FUNCTION DISCDISCTargetSpd "" /begin SUB_FUNCTION convert_out Data_Type_Conversion /end SUB_FUNCTION /begin DEF_CHARACTERISTIC /end DEF_CHARACTERISTIC /begin IN_MEASUREMENT /end IN_MEASUREMENT /begin OUT_MEASUREMENT /end OUT_MEASUREMENT /end FUNCTION
/begin FUNCTION FDCVCURegenLimIndSta "" /begin SUB_FUNCTION Data_Type_Conversion /end SUB_FUNCTION /begin DEF_CHARACTERISTIC /end DEF_CHARACTERISTIC /begin IN_MEASUREMENT /end IN_MEASUREMENT /begin OUT_MEASUREMENT /end OUT_MEASUREMENT /end FUNCTION
/begin FUNCTION FDCVCURegenModeSta "" /begin SUB_FUNCTION /end SUB_FUNCTION /begin DEF_CHARACTERISTIC /end DEF_CHARACTERISTIC /begin IN_MEASUREMENT /end IN_MEASUREMENT /begin OUT_MEASUREMENT /end OUT_MEASUREMENT /end FUNCTION
/begin FUNCTION FDCVCUSimSoundCmd "" /begin SUB_FUNCTION convert_out Data_Type_Conversion /end SUB_FUNCTION /begin DEF_CHARACTERISTIC /end DEF_CHARACTERISTIC /begin IN_MEASUREMENT /end IN_MEASUREMENT /begin OUT_MEASUREMENT /end OUT_MEASUREMENT /end FUNCTION
/begin FUNCTION FDCVCUSmartEcoSpdLimSta "" /begin SUB_FUNCTION Data_Type_Conversion /end SUB_FUNCTION /begin DEF_CHARACTERISTIC /end DEF_CHARACTERISTIC /begin IN_MEASUREMENT /end IN_MEASUREMENT /begin OUT_MEASUREMENT /end OUT_MEASUREMENT /end FUNCTION
/begin FUNCTION FDCVCUSmartEcoSta "" /begin SUB_FUNCTION /end SUB_FUNCTION /begin DEF_CHARACTERISTIC /end DEF_CHARACTERISTIC /begin IN_MEASUREMENT /end IN_MEASUREMENT /begin OUT_MEASUREMENT /end OUT_MEASUREMENT /end FUNCTION
/begin FUNCTION FDCVMCSetSpdDispSta "" /begin SUB_FUNCTION /end SUB_FUNCTION /begin DEF_CHARACTERISTIC /end DEF_CHARACTERISTIC /begin IN_MEASUREMENT /end IN_MEASUREMENT /begin OUT_MEASUREMENT /end OUT_MEASUREMENT /end FUNCTION
/begin FUNCTION FDCVMCSetSpdSta "" /begin SUB_FUNCTION Data_Type_Conversion /end SUB_FUNCTION /begin DEF_CHARACTERISTIC /end DEF_CHARACTERISTIC /begin IN_MEASUREMENT /end IN_MEASUREMENT /begin OUT_MEASUREMENT /end OUT_MEASUREMENT /end FUNCTION
/begin FUNCTION FDCVMCSpdCtrlModeSta "" /begin SUB_FUNCTION /end SUB_FUNCTION /begin DEF_CHARACTERISTIC /end DEF_CHARACTERISTIC /begin IN_MEASUREMENT /end IN_MEASUREMENT /begin OUT_MEASUREMENT /end OUT_MEASUREMENT /end FUNCTION
/begin FUNCTION FDCVMCSpdCtrlSta "" /begin SUB_FUNCTION Data_Type_Conversion /end SUB_FUNCTION /begin DEF_CHARACTERISTIC /end DEF_CHARACTERISTIC /begin IN_MEASUREMENT /end IN_MEASUREMENT /begin OUT_MEASUREMENT /end OUT_MEASUREMENT /end FUNCTION
/begin FUNCTION PASAFCL "" /begin SUB_FUNCTION /end SUB_FUNCTION /begin DEF_CHARACTERISTIC /end DEF_CHARACTERISTIC /begin IN_MEASUREMENT /end IN_MEASUREMENT /begin OUT_MEASUREMENT /end OUT_MEASUREMENT /end FUNCTION
/begin FUNCTION PASAFCR "" /begin SUB_FUNCTION /end SUB_FUNCTION /begin DEF_CHARACTERISTIC /end DEF_CHARACTERISTIC /begin IN_MEASUREMENT /end IN_MEASUREMENT /begin OUT_MEASUREMENT /end OUT_MEASUREMENT /end FUNCTION
/begin FUNCTION PASAFML "" /begin SUB_FUNCTION /end SUB_FUNCTION /begin DEF_CHARACTERISTIC /end DEF_CHARACTERISTIC /begin IN_MEASUREMENT /end IN_MEASUREMENT /begin OUT_MEASUREMENT /end OUT_MEASUREMENT /end FUNCTION
/begin FUNCTION PASAFMR "" /begin SUB_FUNCTION /end SUB_FUNCTION /begin DEF_CHARACTERISTIC /end DEF_CHARACTERISTIC /begin IN_MEASUREMENT /end IN_MEASUREMENT /begin OUT_MEASUREMENT /end OUT_MEASUREMENT /end FUNCTION
/begin FUNCTION PASARCL "" /begin SUB_FUNCTION /end SUB_FUNCTION /begin DEF_CHARACTERISTIC /end DEF_CHARACTERISTIC /begin IN_MEASUREMENT /end IN_MEASUREMENT /begin OUT_MEASUREMENT /end OUT_MEASUREMENT /end FUNCTION
/begin FUNCTION PASARCR "" /begin SUB_FUNCTION /end SUB_FUNCTION /begin DEF_CHARACTERISTIC /end DEF_CHARACTERISTIC /begin IN_MEASUREMENT /end IN_MEASUREMENT /begin OUT_MEASUREMENT /end OUT_MEASUREMENT /end FUNCTION
/begin FUNCTION PASARML "" /begin SUB_FUNCTION /end SUB_FUNCTION /begin DEF_CHARACTERISTIC /end DEF_CHARACTERISTIC /begin IN_MEASUREMENT /end IN_MEASUREMENT /begin OUT_MEASUREMENT /end OUT_MEASUREMENT /end FUNCTION
/begin FUNCTION PASARMR "" /begin SUB_FUNCTION /end SUB_FUNCTION /begin DEF_CHARACTERISTIC /end DEF_CHARACTERISTIC /begin IN_MEASUREMENT /end IN_MEASUREMENT /begin OUT_MEASUREMENT /end OUT_MEASUREMENT /end FUNCTION
/begin FUNCTION PASChime "" /begin SUB_FUNCTION /end SUB_FUNCTION /begin DEF_CHARACTERISTIC /end DEF_CHARACTERISTIC /begin IN_MEASUREMENT /end IN_MEASUREMENT /begin OUT_MEASUREMENT /end OUT_MEASUREMENT /end FUNCTION
/begin FUNCTION PASDFCL "" /begin SUB_FUNCTION /end SUB_FUNCTION /begin DEF_CHARACTERISTIC /end DEF_CHARACTERISTIC /begin IN_MEASUREMENT /end IN_MEASUREMENT /begin OUT_MEASUREMENT /end OUT_MEASUREMENT /end FUNCTION
/begin FUNCTION PASDFCR "" /begin SUB_FUNCTION /end SUB_FUNCTION /begin DEF_CHARACTERISTIC /end DEF_CHARACTERISTIC /begin IN_MEASUREMENT /end IN_MEASUREMENT /begin OUT_MEASUREMENT /end OUT_MEASUREMENT /end FUNCTION
/begin FUNCTION PASDFML "" /begin SUB_FUNCTION /end SUB_FUNCTION /begin DEF_CHARACTERISTIC /end DEF_CHARACTERISTIC /begin IN_MEASUREMENT /end IN_MEASUREMENT /begin OUT_MEASUREMENT /end OUT_MEASUREMENT /end FUNCTION
/begin FUNCTION PASDFMR "" /begin SUB_FUNCTION /end SUB_FUNCTION /begin DEF_CHARACTERISTIC /end DEF_CHARACTERISTIC /begin IN_MEASUREMENT /end IN_MEASUREMENT /begin OUT_MEASUREMENT /end OUT_MEASUREMENT /end FUNCTION
/begin FUNCTION PASDRCL "" /begin SUB_FUNCTION /end SUB_FUNCTION /begin DEF_CHARACTERISTIC /end DEF_CHARACTERISTIC /begin IN_MEASUREMENT /end IN_MEASUREMENT /begin OUT_MEASUREMENT /end OUT_MEASUREMENT /end FUNCTION
/begin FUNCTION PASDRCR "" /begin SUB_FUNCTION /end SUB_FUNCTION /begin DEF_CHARACTERISTIC /end DEF_CHARACTERISTIC /begin IN_MEASUREMENT /end IN_MEASUREMENT /begin OUT_MEASUREMENT /end OUT_MEASUREMENT /end FUNCTION
/begin FUNCTION PASDRML "" /begin SUB_FUNCTION /end SUB_FUNCTION /begin DEF_CHARACTERISTIC /end DEF_CHARACTERISTIC /begin IN_MEASUREMENT /end IN_MEASUREMENT /begin OUT_MEASUREMENT /end OUT_MEASUREMENT /end FUNCTION
/begin FUNCTION PASDRMR "" /begin SUB_FUNCTION /end SUB_FUNCTION /begin DEF_CHARACTERISTIC /end DEF_CHARACTERISTIC /begin IN_MEASUREMENT /end IN_MEASUREMENT /begin OUT_MEASUREMENT /end OUT_MEASUREMENT /end FUNCTION
/begin FUNCTION PASSNSRLayout "" /begin SUB_FUNCTION /end SUB_FUNCTION /begin DEF_CHARACTERISTIC /end DEF_CHARACTERISTIC /begin IN_MEASUREMENT /end IN_MEASUREMENT /begin OUT_MEASUREMENT /end OUT_MEASUREMENT /end FUNCTION
/begin FUNCTION USSStaFCL "" /begin SUB_FUNCTION Data_Type_Conversion /end SUB_FUNCTION /begin DEF_CHARACTERISTIC /end DEF_CHARACTERISTIC /begin IN_MEASUREMENT /end IN_MEASUREMENT /begin OUT_MEASUREMENT /end OUT_MEASUREMENT /end FUNCTION
/begin FUNCTION USSStaFCR "" /begin SUB_FUNCTION Data_Type_Conversion /end SUB_FUNCTION /begin DEF_CHARACTERISTIC /end DEF_CHARACTERISTIC /begin IN_MEASUREMENT /end IN_MEASUREMENT /begin OUT_MEASUREMENT /end OUT_MEASUREMENT /end FUNCTION
/begin FUNCTION USSStaFLL "" /begin SUB_FUNCTION Data_Type_Conversion /end SUB_FUNCTION /begin DEF_CHARACTERISTIC /end DEF_CHARACTERISTIC /begin IN_MEASUREMENT /end IN_MEASUREMENT /begin OUT_MEASUREMENT /end OUT_MEASUREMENT /end FUNCTION
/begin FUNCTION USSStaFLR "" /begin SUB_FUNCTION Data_Type_Conversion /end SUB_FUNCTION /begin DEF_CHARACTERISTIC /end DEF_CHARACTERISTIC /begin IN_MEASUREMENT /end IN_MEASUREMENT /begin OUT_MEASUREMENT /end OUT_MEASUREMENT /end FUNCTION
/begin FUNCTION USSStaFML "" /begin SUB_FUNCTION Data_Type_Conversion /end SUB_FUNCTION /begin DEF_CHARACTERISTIC /end DEF_CHARACTERISTIC /begin IN_MEASUREMENT /end IN_MEASUREMENT /begin OUT_MEASUREMENT /end OUT_MEASUREMENT /end FUNCTION
/begin FUNCTION USSStaFMR "" /begin SUB_FUNCTION Data_Type_Conversion /end SUB_FUNCTION /begin DEF_CHARACTERISTIC /end DEF_CHARACTERISTIC /begin IN_MEASUREMENT /end IN_MEASUREMENT /begin OUT_MEASUREMENT /end OUT_MEASUREMENT /end FUNCTION
/begin FUNCTION USSStaRCL "" /begin SUB_FUNCTION Data_Type_Conversion /end SUB_FUNCTION /begin DEF_CHARACTERISTIC /end DEF_CHARACTERISTIC /begin IN_MEASUREMENT /end IN_MEASUREMENT /begin OUT_MEASUREMENT /end OUT_MEASUREMENT /end FUNCTION
/begin FUNCTION USSStaRCR "" /begin SUB_FUNCTION Data_Type_Conversion /end SUB_FUNCTION /begin DEF_CHARACTERISTIC /end DEF_CHARACTERISTIC /begin IN_MEASUREMENT /end IN_MEASUREMENT /begin OUT_MEASUREMENT /end OUT_MEASUREMENT /end FUNCTION
/begin FUNCTION USSStaRLL "" /begin SUB_FUNCTION Data_Type_Conversion /end SUB_FUNCTION /begin DEF_CHARACTERISTIC /end DEF_CHARACTERISTIC /begin IN_MEASUREMENT /end IN_MEASUREMENT /begin OUT_MEASUREMENT /end OUT_MEASUREMENT /end FUNCTION
/begin FUNCTION USSStaRLR "" /begin SUB_FUNCTION Data_Type_Conversion /end SUB_FUNCTION /begin DEF_CHARACTERISTIC /end DEF_CHARACTERISTIC /begin IN_MEASUREMENT /end IN_MEASUREMENT /begin OUT_MEASUREMENT /end OUT_MEASUREMENT /end FUNCTION
/begin FUNCTION USSStaRML "" /begin SUB_FUNCTION Data_Type_Conversion /end SUB_FUNCTION /begin DEF_CHARACTERISTIC /end DEF_CHARACTERISTIC /begin IN_MEASUREMENT /end IN_MEASUREMENT /begin OUT_MEASUREMENT /end OUT_MEASUREMENT /end FUNCTION
/begin FUNCTION USSStaRMR "" /begin SUB_FUNCTION Data_Type_Conversion /end SUB_FUNCTION /begin DEF_CHARACTERISTIC /end DEF_CHARACTERISTIC /begin IN_MEASUREMENT /end IN_MEASUREMENT /begin OUT_MEASUREMENT /end OUT_MEASUREMENT /end FUNCTION
/begin FUNCTION VMCVCUCCCrlSta "" /begin SUB_FUNCTION /end SUB_FUNCTION /begin DEF_CHARACTERISTIC /end DEF_CHARACTERISTIC /begin IN_MEASUREMENT /end IN_MEASUREMENT /begin OUT_MEASUREMENT /end OUT_MEASUREMENT /end FUNCTION
/begin FUNCTION VMCVCUMSACrlSta "" /begin SUB_FUNCTION /end SUB_FUNCTION /begin DEF_CHARACTERISTIC /end DEF_CHARACTERISTIC /begin IN_MEASUREMENT /end IN_MEASUREMENT /begin OUT_MEASUREMENT /end OUT_MEASUREMENT /end FUNCTION
/begin FUNCTION bus_creator "" /begin DEF_CHARACTERISTIC /end DEF_CHARACTERISTIC /begin IN_MEASUREMENT /end IN_MEASUREMENT /begin OUT_MEASUREMENT /end OUT_MEASUREMENT /end FUNCTION
/begin FUNCTION APMDoorControlSta "" /begin SUB_FUNCTION Data_Type_Conversion /end SUB_FUNCTION /begin DEF_CHARACTERISTIC /end DEF_CHARACTERISTIC /begin IN_MEASUREMENT /end IN_MEASUREMENT /begin OUT_MEASUREMENT /end OUT_MEASUREMENT /end FUNCTION
/begin FUNCTION ActAPSPosn "" /begin SUB_FUNCTION convert_out Data_Type_Conversion /end SUB_FUNCTION /begin DEF_CHARACTERISTIC /end DEF_CHARACTERISTIC /begin IN_MEASUREMENT /end IN_MEASUREMENT /begin OUT_MEASUREMENT /end OUT_MEASUREMENT /end FUNCTION
/begin FUNCTION AllDoorSW "" /begin SUB_FUNCTION Data_Type_Conversion /end SUB_FUNCTION /begin DEF_CHARACTERISTIC /end DEF_CHARACTERISTIC /begin IN_MEASUREMENT /end IN_MEASUREMENT /begin OUT_MEASUREMENT /end OUT_MEASUREMENT /end FUNCTION
/begin FUNCTION AntitheftSta "" /begin SUB_FUNCTION /end SUB_FUNCTION /begin DEF_CHARACTERISTIC /end DEF_CHARACTERISTIC /begin IN_MEASUREMENT /end IN_MEASUREMENT /begin OUT_MEASUREMENT /end OUT_MEASUREMENT /end FUNCTION
/begin FUNCTION BCMDoorLockSta "" /begin SUB_FUNCTION Data_Type_Conversion /end SUB_FUNCTION /begin DEF_CHARACTERISTIC /end DEF_CHARACTERISTIC /begin IN_MEASUREMENT /end IN_MEASUREMENT /begin OUT_MEASUREMENT /end OUT_MEASUREMENT /end FUNCTION
/begin FUNCTION BrakeLamp "" /begin SUB_FUNCTION Data_Type_Conversion /end SUB_FUNCTION /begin DEF_CHARACTERISTIC /end DEF_CHARACTERISTIC /begin IN_MEASUREMENT /end IN_MEASUREMENT /begin OUT_MEASUREMENT /end OUT_MEASUREMENT /end FUNCTION
/begin FUNCTION CCCrlSta "" /begin SUB_FUNCTION /end SUB_FUNCTION /begin DEF_CHARACTERISTIC /end DEF_CHARACTERISTIC /begin IN_MEASUREMENT /end IN_MEASUREMENT /begin OUT_MEASUREMENT /end OUT_MEASUREMENT /end FUNCTION
/begin FUNCTION CCMSASpdWar "" /begin SUB_FUNCTION Data_Type_Conversion /end SUB_FUNCTION /begin DEF_CHARACTERISTIC /end DEF_CHARACTERISTIC /begin IN_MEASUREMENT /end IN_MEASUREMENT /begin OUT_MEASUREMENT /end OUT_MEASUREMENT /end FUNCTION
/begin FUNCTION CCUACLampSts "" /begin SUB_FUNCTION Data_Type_Conversion /end SUB_FUNCTION /begin DEF_CHARACTERISTIC /end DEF_CHARACTERISTIC /begin IN_MEASUREMENT /end IN_MEASUREMENT /begin OUT_MEASUREMENT /end OUT_MEASUREMENT /end FUNCTION
/begin FUNCTION CCUACMaxLampSts "" /begin SUB_FUNCTION Data_Type_Conversion /end SUB_FUNCTION /begin DEF_CHARACTERISTIC /end DEF_CHARACTERISTIC /begin IN_MEASUREMENT /end IN_MEASUREMENT /begin OUT_MEASUREMENT /end OUT_MEASUREMENT /end FUNCTION
/begin FUNCTION CCUAutoLampSts "" /begin SUB_FUNCTION Data_Type_Conversion /end SUB_FUNCTION /begin DEF_CHARACTERISTIC /end DEF_CHARACTERISTIC /begin IN_MEASUREMENT /end IN_MEASUREMENT /begin OUT_MEASUREMENT /end OUT_MEASUREMENT /end FUNCTION
/begin FUNCTION CCUAutoMidLampSts "" /begin SUB_FUNCTION /end SUB_FUNCTION /begin DEF_CHARACTERISTIC /end DEF_CHARACTERISTIC /begin IN_MEASUREMENT /end IN_MEASUREMENT /begin OUT_MEASUREMENT /end OUT_MEASUREMENT /end FUNCTION
/begin FUNCTION CCUDispalyRequest "" /begin SUB_FUNCTION /end SUB_FUNCTION /begin DEF_CHARACTERISTIC /end DEF_CHARACTERISTIC /begin IN_MEASUREMENT /end IN_MEASUREMENT /begin OUT_MEASUREMENT /end OUT_MEASUREMENT /end FUNCTION
/begin FUNCTION CCUEcoSts "" /begin SUB_FUNCTION /end SUB_FUNCTION /begin DEF_CHARACTERISTIC /end DEF_CHARACTERISTIC /begin IN_MEASUREMENT /end IN_MEASUREMENT /begin OUT_MEASUREMENT /end OUT_MEASUREMENT /end FUNCTION
/begin FUNCTION CCUFrtOnOffLampSts "" /begin SUB_FUNCTION /end SUB_FUNCTION /begin DEF_CHARACTERISTIC /end DEF_CHARACTERISTIC /begin IN_MEASUREMENT /end IN_MEASUREMENT /begin OUT_MEASUREMENT /end OUT_MEASUREMENT /end FUNCTION
/begin FUNCTION CCURrOnOffLampSts "" /begin SUB_FUNCTION /end SUB_FUNCTION /begin DEF_CHARACTERISTIC /end DEF_CHARACTERISTIC /begin IN_MEASUREMENT /end IN_MEASUREMENT /begin OUT_MEASUREMENT /end OUT_MEASUREMENT /end FUNCTION
/begin FUNCTION CCUSyncLampSts "" /begin SUB_FUNCTION Data_Type_Conversion /end SUB_FUNCTION /begin DEF_CHARACTERISTIC /end DEF_CHARACTERISTIC /begin IN_MEASUREMENT /end IN_MEASUREMENT /begin OUT_MEASUREMENT /end OUT_MEASUREMENT /end FUNCTION
/begin FUNCTION CoastDwModeStaChk "" /begin SUB_FUNCTION /end SUB_FUNCTION /begin DEF_CHARACTERISTIC /end DEF_CHARACTERISTIC /begin IN_MEASUREMENT /end IN_MEASUREMENT /begin OUT_MEASUREMENT /end OUT_MEASUREMENT /end FUNCTION
/begin FUNCTION CreepSWSta "" /begin SUB_FUNCTION Data_Type_Conversion /end SUB_FUNCTION /begin DEF_CHARACTERISTIC /end DEF_CHARACTERISTIC /begin IN_MEASUREMENT /end IN_MEASUREMENT /begin OUT_MEASUREMENT /end OUT_MEASUREMENT /end FUNCTION
/begin FUNCTION DISCButtSta "" /begin SUB_FUNCTION Data_Type_Conversion /end SUB_FUNCTION /begin DEF_CHARACTERISTIC /end DEF_CHARACTERISTIC /begin IN_MEASUREMENT /end IN_MEASUREMENT /begin OUT_MEASUREMENT /end OUT_MEASUREMENT /end FUNCTION
/begin FUNCTION DISCSta "" /begin SUB_FUNCTION /end SUB_FUNCTION /begin DEF_CHARACTERISTIC /end DEF_CHARACTERISTIC /begin IN_MEASUREMENT /end IN_MEASUREMENT /begin OUT_MEASUREMENT /end OUT_MEASUREMENT /end FUNCTION
/begin FUNCTION DemoModeStaChk "" /begin SUB_FUNCTION /end SUB_FUNCTION /begin DEF_CHARACTERISTIC /end DEF_CHARACTERISTIC /begin IN_MEASUREMENT /end IN_MEASUREMENT /begin OUT_MEASUREMENT /end OUT_MEASUREMENT /end FUNCTION
/begin FUNCTION Dimmer "" /begin SUB_FUNCTION Data_Type_Conversion /end SUB_FUNCTION /begin DEF_CHARACTERISTIC /end DEF_CHARACTERISTIC /begin IN_MEASUREMENT /end IN_MEASUREMENT /begin OUT_MEASUREMENT /end OUT_MEASUREMENT /end FUNCTION
/begin FUNCTION DimmerEN "" /begin SUB_FUNCTION Data_Type_Conversion /end SUB_FUNCTION /begin DEF_CHARACTERISTIC /end DEF_CHARACTERISTIC /begin IN_MEASUREMENT /end IN_MEASUREMENT /begin OUT_MEASUREMENT /end OUT_MEASUREMENT /end FUNCTION
/begin FUNCTION DisengagePFail "" /begin SUB_FUNCTION Data_Type_Conversion /end SUB_FUNCTION /begin DEF_CHARACTERISTIC /end DEF_CHARACTERISTIC /begin IN_MEASUREMENT /end IN_MEASUREMENT /begin OUT_MEASUREMENT /end OUT_MEASUREMENT /end FUNCTION
/begin FUNCTION DoorLockIND "" /begin SUB_FUNCTION Data_Type_Conversion /end SUB_FUNCTION /begin DEF_CHARACTERISTIC /end DEF_CHARACTERISTIC /begin IN_MEASUREMENT /end IN_MEASUREMENT /begin OUT_MEASUREMENT /end OUT_MEASUREMENT /end FUNCTION
/begin FUNCTION DrDoorSW "" /begin SUB_FUNCTION Data_Type_Conversion /end SUB_FUNCTION /begin DEF_CHARACTERISTIC /end DEF_CHARACTERISTIC /begin IN_MEASUREMENT /end IN_MEASUREMENT /begin OUT_MEASUREMENT /end OUT_MEASUREMENT /end FUNCTION
/begin FUNCTION DrSeatSta "" /begin SUB_FUNCTION /end SUB_FUNCTION /begin DEF_CHARACTERISTIC /end DEF_CHARACTERISTIC /begin IN_MEASUREMENT /end IN_MEASUREMENT /begin OUT_MEASUREMENT /end OUT_MEASUREMENT /end FUNCTION
/begin FUNCTION DynoModeStaChk "" /begin SUB_FUNCTION /end SUB_FUNCTION /begin DEF_CHARACTERISTIC /end DEF_CHARACTERISTIC /begin IN_MEASUREMENT /end IN_MEASUREMENT /begin OUT_MEASUREMENT /end OUT_MEASUREMENT /end FUNCTION
/begin FUNCTION EDriveSysErrAccPedalErr "" /begin SUB_FUNCTION /end SUB_FUNCTION /begin DEF_CHARACTERISTIC /end DEF_CHARACTERISTIC /begin IN_MEASUREMENT /end IN_MEASUREMENT /begin OUT_MEASUREMENT /end OUT_MEASUREMENT /end FUNCTION
/begin FUNCTION EDriveSysErrMCUErr "" /begin SUB_FUNCTION /end SUB_FUNCTION /begin DEF_CHARACTERISTIC /end DEF_CHARACTERISTIC /begin IN_MEASUREMENT /end IN_MEASUREMENT /begin OUT_MEASUREMENT /end OUT_MEASUREMENT /end FUNCTION
/begin FUNCTION EDriveSysErrShifterErr "" /begin SUB_FUNCTION Data_Type_Conversion /end SUB_FUNCTION /begin DEF_CHARACTERISTIC /end DEF_CHARACTERISTIC /begin IN_MEASUREMENT /end IN_MEASUREMENT /begin OUT_MEASUREMENT /end OUT_MEASUREMENT /end FUNCTION
/begin FUNCTION EDriveSysErrVCUErr "" /begin SUB_FUNCTION Data_Type_Conversion /end SUB_FUNCTION /begin DEF_CHARACTERISTIC /end DEF_CHARACTERISTIC /begin IN_MEASUREMENT /end IN_MEASUREMENT /begin OUT_MEASUREMENT /end OUT_MEASUREMENT /end FUNCTION
/begin FUNCTION EVDriveMode "" /begin SUB_FUNCTION /end SUB_FUNCTION /begin DEF_CHARACTERISTIC /end DEF_CHARACTERISTIC /begin IN_MEASUREMENT /end IN_MEASUREMENT /begin OUT_MEASUREMENT /end OUT_MEASUREMENT /end FUNCTION
/begin FUNCTION EngAGSCloseSta "" /begin SUB_FUNCTION /end SUB_FUNCTION /begin DEF_CHARACTERISTIC /end DEF_CHARACTERISTIC /begin IN_MEASUREMENT /end IN_MEASUREMENT /begin OUT_MEASUREMENT /end OUT_MEASUREMENT /end FUNCTION
/begin FUNCTION EngActvDmpDisabSta "" /begin SUB_FUNCTION /end SUB_FUNCTION /begin DEF_CHARACTERISTIC /end DEF_CHARACTERISTIC /begin IN_MEASUREMENT /end IN_MEASUREMENT /begin OUT_MEASUREMENT /end OUT_MEASUREMENT /end FUNCTION
/begin FUNCTION EngCoastDwSta "" /begin SUB_FUNCTION /end SUB_FUNCTION /begin DEF_CHARACTERISTIC /end DEF_CHARACTERISTIC /begin IN_MEASUREMENT /end IN_MEASUREMENT /begin OUT_MEASUREMENT /end OUT_MEASUREMENT /end FUNCTION
/begin FUNCTION EngPwrLockSta "" /begin SUB_FUNCTION /end SUB_FUNCTION /begin DEF_CHARACTERISTIC /end DEF_CHARACTERISTIC /begin IN_MEASUREMENT /end IN_MEASUREMENT /begin OUT_MEASUREMENT /end OUT_MEASUREMENT /end FUNCTION
/begin FUNCTION EngagePFail "" /begin SUB_FUNCTION Data_Type_Conversion /end SUB_FUNCTION /begin DEF_CHARACTERISTIC /end DEF_CHARACTERISTIC /begin IN_MEASUREMENT /end IN_MEASUREMENT /begin OUT_MEASUREMENT /end OUT_MEASUREMENT /end FUNCTION
/begin FUNCTION FDABSWarning "" /begin SUB_FUNCTION /end SUB_FUNCTION /begin DEF_CHARACTERISTIC /end DEF_CHARACTERISTIC /begin IN_MEASUREMENT /end IN_MEASUREMENT /begin OUT_MEASUREMENT /end OUT_MEASUREMENT /end FUNCTION
/begin FUNCTION FDAGSCmd "" /begin SUB_FUNCTION /end SUB_FUNCTION /begin DEF_CHARACTERISTIC /end DEF_CHARACTERISTIC /begin IN_MEASUREMENT /end IN_MEASUREMENT /begin OUT_MEASUREMENT /end OUT_MEASUREMENT /end FUNCTION
/begin FUNCTION FDBatteryChargeWarning "" /begin SUB_FUNCTION /end SUB_FUNCTION /begin DEF_CHARACTERISTIC /end DEF_CHARACTERISTIC /begin IN_MEASUREMENT /end IN_MEASUREMENT /begin OUT_MEASUREMENT /end OUT_MEASUREMENT /end FUNCTION
/begin FUNCTION FDCBCMAutoWipHSpdENSta "" /begin SUB_FUNCTION Data_Type_Conversion /end SUB_FUNCTION /begin DEF_CHARACTERISTIC /end DEF_CHARACTERISTIC /begin IN_MEASUREMENT /end IN_MEASUREMENT /begin OUT_MEASUREMENT /end OUT_MEASUREMENT /end FUNCTION
/begin FUNCTION FDCBCMHMIKey1FuncSta "" /begin SUB_FUNCTION /end SUB_FUNCTION /begin DEF_CHARACTERISTIC /end DEF_CHARACTERISTIC /begin IN_MEASUREMENT /end IN_MEASUREMENT /begin OUT_MEASUREMENT /end OUT_MEASUREMENT /end FUNCTION
/begin FUNCTION FDCBCMHMIKey2FuncSta "" /begin SUB_FUNCTION /end SUB_FUNCTION /begin DEF_CHARACTERISTIC /end DEF_CHARACTERISTIC /begin IN_MEASUREMENT /end IN_MEASUREMENT /begin OUT_MEASUREMENT /end OUT_MEASUREMENT /end FUNCTION
/begin FUNCTION FDCBCMHMIKey3FuncSta "" /begin SUB_FUNCTION /end SUB_FUNCTION /begin DEF_CHARACTERISTIC /end DEF_CHARACTERISTIC /begin IN_MEASUREMENT /end IN_MEASUREMENT /begin OUT_MEASUREMENT /end OUT_MEASUREMENT /end FUNCTION
/begin FUNCTION FDCBCMHMIKey4FuncSta "" /begin SUB_FUNCTION /end SUB_FUNCTION /begin DEF_CHARACTERISTIC /end DEF_CHARACTERISTIC /begin IN_MEASUREMENT /end IN_MEASUREMENT /begin OUT_MEASUREMENT /end OUT_MEASUREMENT /end FUNCTION
/begin FUNCTION FDCBCMHMIKey5FuncSta "" /begin SUB_FUNCTION /end SUB_FUNCTION /begin DEF_CHARACTERISTIC /end DEF_CHARACTERISTIC /begin IN_MEASUREMENT /end IN_MEASUREMENT /begin OUT_MEASUREMENT /end OUT_MEASUREMENT /end FUNCTION
/begin FUNCTION FDCBCMHMIKey6FuncSta "" /begin SUB_FUNCTION /end SUB_FUNCTION /begin DEF_CHARACTERISTIC /end DEF_CHARACTERISTIC /begin IN_MEASUREMENT /end IN_MEASUREMENT /begin OUT_MEASUREMENT /end OUT_MEASUREMENT /end FUNCTION
/begin FUNCTION FDCBCMHMIKey7FuncSta "" /begin SUB_FUNCTION /end SUB_FUNCTION /begin DEF_CHARACTERISTIC /end DEF_CHARACTERISTIC /begin IN_MEASUREMENT /end IN_MEASUREMENT /begin OUT_MEASUREMENT /end OUT_MEASUREMENT /end FUNCTION
/begin FUNCTION FDCBCMHMIKey8FuncSta "" /begin SUB_FUNCTION /end SUB_FUNCTION /begin DEF_CHARACTERISTIC /end DEF_CHARACTERISTIC /begin IN_MEASUREMENT /end IN_MEASUREMENT /begin OUT_MEASUREMENT /end OUT_MEASUREMENT /end FUNCTION
/begin FUNCTION FDCRAPSErrWarnSta "" /begin SUB_FUNCTION /end SUB_FUNCTION /begin DEF_CHARACTERISTIC /end DEF_CHARACTERISTIC /begin IN_MEASUREMENT /end IN_MEASUREMENT /begin OUT_MEASUREMENT /end OUT_MEASUREMENT /end FUNCTION
/begin FUNCTION FDCTHCMCLEVentYSta "" /begin SUB_FUNCTION /end SUB_FUNCTION /begin DEF_CHARACTERISTIC /end DEF_CHARACTERISTIC /begin IN_MEASUREMENT /end IN_MEASUREMENT /begin OUT_MEASUREMENT /end OUT_MEASUREMENT /end FUNCTION
/begin FUNCTION FDCTHCMCLEVentZSta "" /begin SUB_FUNCTION /end SUB_FUNCTION /begin DEF_CHARACTERISTIC /end DEF_CHARACTERISTIC /begin IN_MEASUREMENT /end IN_MEASUREMENT /begin OUT_MEASUREMENT /end OUT_MEASUREMENT /end FUNCTION
/begin FUNCTION FDCTHCMCLVentSta "" /begin SUB_FUNCTION Data_Type_Conversion /end SUB_FUNCTION /begin DEF_CHARACTERISTIC /end DEF_CHARACTERISTIC /begin IN_MEASUREMENT /end IN_MEASUREMENT /begin OUT_MEASUREMENT /end OUT_MEASUREMENT /end FUNCTION
/begin FUNCTION FDCTHCMCREVentYSta "" /begin SUB_FUNCTION /end SUB_FUNCTION /begin DEF_CHARACTERISTIC /end DEF_CHARACTERISTIC /begin IN_MEASUREMENT /end IN_MEASUREMENT /begin OUT_MEASUREMENT /end OUT_MEASUREMENT /end FUNCTION
/begin FUNCTION FDCTHCMCREVentZSta "" /begin SUB_FUNCTION /end SUB_FUNCTION /begin DEF_CHARACTERISTIC /end DEF_CHARACTERISTIC /begin IN_MEASUREMENT /end IN_MEASUREMENT /begin OUT_MEASUREMENT /end OUT_MEASUREMENT /end FUNCTION
/begin FUNCTION FDCTHCMCRVentSta "" /begin SUB_FUNCTION Data_Type_Conversion /end SUB_FUNCTION /begin DEF_CHARACTERISTIC /end DEF_CHARACTERISTIC /begin IN_MEASUREMENT /end IN_MEASUREMENT /begin OUT_MEASUREMENT /end OUT_MEASUREMENT /end FUNCTION
/begin FUNCTION FDCTHCMLEVentModeSta "" /begin SUB_FUNCTION /end SUB_FUNCTION /begin DEF_CHARACTERISTIC /end DEF_CHARACTERISTIC /begin IN_MEASUREMENT /end IN_MEASUREMENT /begin OUT_MEASUREMENT /end OUT_MEASUREMENT /end FUNCTION
/begin FUNCTION FDCTHCMLEVentYSta "" /begin SUB_FUNCTION /end SUB_FUNCTION /begin DEF_CHARACTERISTIC /end DEF_CHARACTERISTIC /begin IN_MEASUREMENT /end IN_MEASUREMENT /begin OUT_MEASUREMENT /end OUT_MEASUREMENT /end FUNCTION
/begin FUNCTION FDCTHCMLEVentZSta "" /begin SUB_FUNCTION /end SUB_FUNCTION /begin DEF_CHARACTERISTIC /end DEF_CHARACTERISTIC /begin IN_MEASUREMENT /end IN_MEASUREMENT /begin OUT_MEASUREMENT /end OUT_MEASUREMENT /end FUNCTION
/begin FUNCTION FDCTHCMLVentSta "" /begin SUB_FUNCTION /end SUB_FUNCTION /begin DEF_CHARACTERISTIC /end DEF_CHARACTERISTIC /begin IN_MEASUREMENT /end IN_MEASUREMENT /begin OUT_MEASUREMENT /end OUT_MEASUREMENT /end FUNCTION
/begin FUNCTION FDCTHCMPreWPTCHeatSta "" /begin SUB_FUNCTION /end SUB_FUNCTION /begin DEF_CHARACTERISTIC /end DEF_CHARACTERISTIC /begin IN_MEASUREMENT /end IN_MEASUREMENT /begin OUT_MEASUREMENT /end OUT_MEASUREMENT /end FUNCTION
/begin FUNCTION FDCTHCMREVentModeSta "" /begin SUB_FUNCTION /end SUB_FUNCTION /begin DEF_CHARACTERISTIC /end DEF_CHARACTERISTIC /begin IN_MEASUREMENT /end IN_MEASUREMENT /begin OUT_MEASUREMENT /end OUT_MEASUREMENT /end FUNCTION
/begin FUNCTION FDCTHCMREVentYSta "" /begin SUB_FUNCTION /end SUB_FUNCTION /begin DEF_CHARACTERISTIC /end DEF_CHARACTERISTIC /begin IN_MEASUREMENT /end IN_MEASUREMENT /begin OUT_MEASUREMENT /end OUT_MEASUREMENT /end FUNCTION
/begin FUNCTION FDCTHCMREVentZSta "" /begin SUB_FUNCTION /end SUB_FUNCTION /begin DEF_CHARACTERISTIC /end DEF_CHARACTERISTIC /begin IN_MEASUREMENT /end IN_MEASUREMENT /begin OUT_MEASUREMENT /end OUT_MEASUREMENT /end FUNCTION
/begin FUNCTION FDCTHCMRVentSta "" /begin SUB_FUNCTION /end SUB_FUNCTION /begin DEF_CHARACTERISTIC /end DEF_CHARACTERISTIC /begin IN_MEASUREMENT /end IN_MEASUREMENT /begin OUT_MEASUREMENT /end OUT_MEASUREMENT /end FUNCTION
/begin FUNCTION FDCV2LIVIV2LDischargCmd "" /begin SUB_FUNCTION /end SUB_FUNCTION /begin DEF_CHARACTERISTIC /end DEF_CHARACTERISTIC /begin IN_MEASUREMENT /end IN_MEASUREMENT /begin OUT_MEASUREMENT /end OUT_MEASUREMENT /end FUNCTION
/begin FUNCTION FDCVCULVChrgFreqSta "" /begin SUB_FUNCTION /end SUB_FUNCTION /begin DEF_CHARACTERISTIC /end DEF_CHARACTERISTIC /begin IN_MEASUREMENT /end IN_MEASUREMENT /begin OUT_MEASUREMENT /end OUT_MEASUREMENT /end FUNCTION
/begin FUNCTION FDCVCULVStaDropQuickSta "" /begin SUB_FUNCTION /end SUB_FUNCTION /begin DEF_CHARACTERISTIC /end DEF_CHARACTERISTIC /begin IN_MEASUREMENT /end IN_MEASUREMENT /begin OUT_MEASUREMENT /end OUT_MEASUREMENT /end FUNCTION
/begin FUNCTION FDCVCULVStaTooLowSta "" /begin SUB_FUNCTION /end SUB_FUNCTION /begin DEF_CHARACTERISTIC /end DEF_CHARACTERISTIC /begin IN_MEASUREMENT /end IN_MEASUREMENT /begin OUT_MEASUREMENT /end OUT_MEASUREMENT /end FUNCTION
/begin FUNCTION FDCVCUPwrSaveReqCmd "" /begin SUB_FUNCTION /end SUB_FUNCTION /begin DEF_CHARACTERISTIC /end DEF_CHARACTERISTIC /begin IN_MEASUREMENT /end IN_MEASUREMENT /begin OUT_MEASUREMENT /end OUT_MEASUREMENT /end FUNCTION
/begin FUNCTION FDCVCUTrailerDisOPDSta "" /begin SUB_FUNCTION Data_Type_Conversion /end SUB_FUNCTION /begin DEF_CHARACTERISTIC /end DEF_CHARACTERISTIC /begin IN_MEASUREMENT /end IN_MEASUREMENT /begin OUT_MEASUREMENT /end OUT_MEASUREMENT /end FUNCTION
/begin FUNCTION FDEBMErrSta "" /begin SUB_FUNCTION /end SUB_FUNCTION /begin DEF_CHARACTERISTIC /end DEF_CHARACTERISTIC /begin IN_MEASUREMENT /end IN_MEASUREMENT /begin OUT_MEASUREMENT /end OUT_MEASUREMENT /end FUNCTION
/begin FUNCTION FDEDriveSystem "" /begin SUB_FUNCTION /end SUB_FUNCTION /begin DEF_CHARACTERISTIC /end DEF_CHARACTERISTIC /begin IN_MEASUREMENT /end IN_MEASUREMENT /begin OUT_MEASUREMENT /end OUT_MEASUREMENT /end FUNCTION
/begin FUNCTION FDEPBError "" /begin SUB_FUNCTION /end SUB_FUNCTION /begin DEF_CHARACTERISTIC /end DEF_CHARACTERISTIC /begin IN_MEASUREMENT /end IN_MEASUREMENT /begin OUT_MEASUREMENT /end OUT_MEASUREMENT /end FUNCTION
/begin FUNCTION FDHVBatteryFault "" /begin SUB_FUNCTION /end SUB_FUNCTION /begin DEF_CHARACTERISTIC /end DEF_CHARACTERISTIC /begin IN_MEASUREMENT /end IN_MEASUREMENT /begin OUT_MEASUREMENT /end OUT_MEASUREMENT /end FUNCTION
/begin FUNCTION FDParkBrakeWarning "" /begin SUB_FUNCTION /end SUB_FUNCTION /begin DEF_CHARACTERISTIC /end DEF_CHARACTERISTIC /begin IN_MEASUREMENT /end IN_MEASUREMENT /begin OUT_MEASUREMENT /end OUT_MEASUREMENT /end FUNCTION
/begin FUNCTION FDPowerlimitation "" /begin SUB_FUNCTION /end SUB_FUNCTION /begin DEF_CHARACTERISTIC /end DEF_CHARACTERISTIC /begin IN_MEASUREMENT /end IN_MEASUREMENT /begin OUT_MEASUREMENT /end OUT_MEASUREMENT /end FUNCTION
/begin FUNCTION FDSteeringWarning "" /begin SUB_FUNCTION /end SUB_FUNCTION /begin DEF_CHARACTERISTIC /end DEF_CHARACTERISTIC /begin IN_MEASUREMENT /end IN_MEASUREMENT /begin OUT_MEASUREMENT /end OUT_MEASUREMENT /end FUNCTION
/begin FUNCTION FDTCSIndicator "" /begin SUB_FUNCTION /end SUB_FUNCTION /begin DEF_CHARACTERISTIC /end DEF_CHARACTERISTIC /begin IN_MEASUREMENT /end IN_MEASUREMENT /begin OUT_MEASUREMENT /end OUT_MEASUREMENT /end FUNCTION
/begin FUNCTION FDTelltaleFail "" /begin SUB_FUNCTION /end SUB_FUNCTION /begin DEF_CHARACTERISTIC /end DEF_CHARACTERISTIC /begin IN_MEASUREMENT /end IN_MEASUREMENT /begin OUT_MEASUREMENT /end OUT_MEASUREMENT /end FUNCTION
/begin FUNCTION FalseNPreventSta "" /begin SUB_FUNCTION Data_Type_Conversion /end SUB_FUNCTION /begin DEF_CHARACTERISTIC /end DEF_CHARACTERISTIC /begin IN_MEASUREMENT /end IN_MEASUREMENT /begin OUT_MEASUREMENT /end OUT_MEASUREMENT /end FUNCTION
/begin FUNCTION FeatSetSpdFinalraw32 "" /begin SUB_FUNCTION Data_Type_Conversion /end SUB_FUNCTION /begin DEF_CHARACTERISTIC /end DEF_CHARACTERISTIC /begin IN_MEASUREMENT /end IN_MEASUREMENT /begin OUT_MEASUREMENT /end OUT_MEASUREMENT /end FUNCTION
/begin FUNCTION FollowMe "" /begin SUB_FUNCTION Data_Type_Conversion /end SUB_FUNCTION /begin DEF_CHARACTERISTIC /end DEF_CHARACTERISTIC /begin IN_MEASUREMENT /end IN_MEASUREMENT /begin OUT_MEASUREMENT /end OUT_MEASUREMENT /end FUNCTION
/begin FUNCTION FrFogLamp "" /begin SUB_FUNCTION /end SUB_FUNCTION /begin DEF_CHARACTERISTIC /end DEF_CHARACTERISTIC /begin IN_MEASUREMENT /end IN_MEASUREMENT /begin OUT_MEASUREMENT /end OUT_MEASUREMENT /end FUNCTION
/begin FUNCTION HBeam "" /begin SUB_FUNCTION Data_Type_Conversion /end SUB_FUNCTION /begin DEF_CHARACTERISTIC /end DEF_CHARACTERISTIC /begin IN_MEASUREMENT /end IN_MEASUREMENT /begin OUT_MEASUREMENT /end OUT_MEASUREMENT /end FUNCTION
/begin FUNCTION HVRlyOpFail "" /begin SUB_FUNCTION Data_Type_Conversion /end SUB_FUNCTION /begin DEF_CHARACTERISTIC /end DEF_CHARACTERISTIC /begin IN_MEASUREMENT /end IN_MEASUREMENT /begin OUT_MEASUREMENT /end OUT_MEASUREMENT /end FUNCTION
/begin FUNCTION HVSysErrIsolationErr "" /begin SUB_FUNCTION /end SUB_FUNCTION /begin DEF_CHARACTERISTIC /end DEF_CHARACTERISTIC /begin IN_MEASUREMENT /end IN_MEASUREMENT /begin OUT_MEASUREMENT /end OUT_MEASUREMENT /end FUNCTION
/begin FUNCTION HVSysErrPackErr "" /begin SUB_FUNCTION /end SUB_FUNCTION /begin DEF_CHARACTERISTIC /end DEF_CHARACTERISTIC /begin IN_MEASUREMENT /end IN_MEASUREMENT /begin OUT_MEASUREMENT /end OUT_MEASUREMENT /end FUNCTION
/begin FUNCTION HVSysErrRelayErr "" /begin SUB_FUNCTION /end SUB_FUNCTION /begin DEF_CHARACTERISTIC /end DEF_CHARACTERISTIC /begin IN_MEASUREMENT /end IN_MEASUREMENT /begin OUT_MEASUREMENT /end OUT_MEASUREMENT /end FUNCTION
/begin FUNCTION HazardSW "" /begin SUB_FUNCTION Data_Type_Conversion /end SUB_FUNCTION /begin DEF_CHARACTERISTIC /end DEF_CHARACTERISTIC /begin IN_MEASUREMENT /end IN_MEASUREMENT /begin OUT_MEASUREMENT /end OUT_MEASUREMENT /end FUNCTION
/begin FUNCTION HoodSW "" /begin SUB_FUNCTION Data_Type_Conversion /end SUB_FUNCTION /begin DEF_CHARACTERISTIC /end DEF_CHARACTERISTIC /begin IN_MEASUREMENT /end IN_MEASUREMENT /begin OUT_MEASUREMENT /end OUT_MEASUREMENT /end FUNCTION
/begin FUNCTION LBSD "" /begin SUB_FUNCTION Data_Type_Conversion /end SUB_FUNCTION /begin DEF_CHARACTERISTIC /end DEF_CHARACTERISTIC /begin IN_MEASUREMENT /end IN_MEASUREMENT /begin OUT_MEASUREMENT /end OUT_MEASUREMENT /end FUNCTION
/begin FUNCTION LBeam "" /begin SUB_FUNCTION Data_Type_Conversion /end SUB_FUNCTION /begin DEF_CHARACTERISTIC /end DEF_CHARACTERISTIC /begin IN_MEASUREMENT /end IN_MEASUREMENT /begin OUT_MEASUREMENT /end OUT_MEASUREMENT /end FUNCTION
/begin FUNCTION LDRL "" /begin SUB_FUNCTION Data_Type_Conversion /end SUB_FUNCTION /begin DEF_CHARACTERISTIC /end DEF_CHARACTERISTIC /begin IN_MEASUREMENT /end IN_MEASUREMENT /begin OUT_MEASUREMENT /end OUT_MEASUREMENT /end FUNCTION
/begin FUNCTION LTurnLP "" /begin SUB_FUNCTION Data_Type_Conversion /end SUB_FUNCTION /begin DEF_CHARACTERISTIC /end DEF_CHARACTERISTIC /begin IN_MEASUREMENT /end IN_MEASUREMENT /begin OUT_MEASUREMENT /end OUT_MEASUREMENT /end FUNCTION
/begin FUNCTION LVChrgFuncStaChk "" /begin SUB_FUNCTION /end SUB_FUNCTION /begin DEF_CHARACTERISTIC /end DEF_CHARACTERISTIC /begin IN_MEASUREMENT /end IN_MEASUREMENT /begin OUT_MEASUREMENT /end OUT_MEASUREMENT /end FUNCTION
/begin FUNCTION LVSilentChrgReq "" /begin SUB_FUNCTION Data_Type_Conversion /end SUB_FUNCTION /begin DEF_CHARACTERISTIC /end DEF_CHARACTERISTIC /begin IN_MEASUREMENT /end IN_MEASUREMENT /begin OUT_MEASUREMENT /end OUT_MEASUREMENT /end FUNCTION
/begin FUNCTION LVSilentChrgSta "" /begin SUB_FUNCTION /end SUB_FUNCTION /begin DEF_CHARACTERISTIC /end DEF_CHARACTERISTIC /begin IN_MEASUREMENT /end IN_MEASUREMENT /begin OUT_MEASUREMENT /end OUT_MEASUREMENT /end FUNCTION
/begin FUNCTION LVSysErrPwrOutpErr "" /begin SUB_FUNCTION Data_Type_Conversion /end SUB_FUNCTION /begin DEF_CHARACTERISTIC /end DEF_CHARACTERISTIC /begin IN_MEASUREMENT /end IN_MEASUREMENT /begin OUT_MEASUREMENT /end OUT_MEASUREMENT /end FUNCTION
/begin FUNCTION LimphomeAct "" /begin SUB_FUNCTION Data_Type_Conversion /end SUB_FUNCTION /begin DEF_CHARACTERISTIC /end DEF_CHARACTERISTIC /begin IN_MEASUREMENT /end IN_MEASUREMENT /begin OUT_MEASUREMENT /end OUT_MEASUREMENT /end FUNCTION
/begin FUNCTION LockSetting "" /begin SUB_FUNCTION Data_Type_Conversion /end SUB_FUNCTION /begin DEF_CHARACTERISTIC /end DEF_CHARACTERISTIC /begin IN_MEASUREMENT /end IN_MEASUREMENT /begin OUT_MEASUREMENT /end OUT_MEASUREMENT /end FUNCTION
/begin FUNCTION MCUActDisFail "" /begin SUB_FUNCTION Data_Type_Conversion /end SUB_FUNCTION /begin DEF_CHARACTERISTIC /end DEF_CHARACTERISTIC /begin IN_MEASUREMENT /end IN_MEASUREMENT /begin OUT_MEASUREMENT /end OUT_MEASUREMENT /end FUNCTION
/begin FUNCTION MSACrlSta "" /begin SUB_FUNCTION /end SUB_FUNCTION /begin DEF_CHARACTERISTIC /end DEF_CHARACTERISTIC /begin IN_MEASUREMENT /end IN_MEASUREMENT /begin OUT_MEASUREMENT /end OUT_MEASUREMENT /end FUNCTION
/begin FUNCTION MeterIndSpeedraw32 "" /begin SUB_FUNCTION Data_Type_Conversion /end SUB_FUNCTION /begin DEF_CHARACTERISTIC /end DEF_CHARACTERISTIC /begin IN_MEASUREMENT /end IN_MEASUREMENT /begin OUT_MEASUREMENT /end OUT_MEASUREMENT /end FUNCTION
/begin FUNCTION PASStaFSys "" /begin SUB_FUNCTION Data_Type_Conversion /end SUB_FUNCTION /begin DEF_CHARACTERISTIC /end DEF_CHARACTERISTIC /begin IN_MEASUREMENT /end IN_MEASUREMENT /begin OUT_MEASUREMENT /end OUT_MEASUREMENT /end FUNCTION
/begin FUNCTION PosLamp "" /begin SUB_FUNCTION Data_Type_Conversion /end SUB_FUNCTION /begin DEF_CHARACTERISTIC /end DEF_CHARACTERISTIC /begin IN_MEASUREMENT /end IN_MEASUREMENT /begin OUT_MEASUREMENT /end OUT_MEASUREMENT /end FUNCTION
/begin FUNCTION PsDoorSW "" /begin SUB_FUNCTION Data_Type_Conversion /end SUB_FUNCTION /begin DEF_CHARACTERISTIC /end DEF_CHARACTERISTIC /begin IN_MEASUREMENT /end IN_MEASUREMENT /begin OUT_MEASUREMENT /end OUT_MEASUREMENT /end FUNCTION
/begin FUNCTION PwrSta "" /begin SUB_FUNCTION /end SUB_FUNCTION /begin DEF_CHARACTERISTIC /end DEF_CHARACTERISTIC /begin IN_MEASUREMENT /end IN_MEASUREMENT /begin OUT_MEASUREMENT /end OUT_MEASUREMENT /end FUNCTION
/begin FUNCTION PwrStaErr "" /begin SUB_FUNCTION /end SUB_FUNCTION /begin DEF_CHARACTERISTIC /end DEF_CHARACTERISTIC /begin IN_MEASUREMENT /end IN_MEASUREMENT /begin OUT_MEASUREMENT /end OUT_MEASUREMENT /end FUNCTION
/begin FUNCTION PwrStaONTOIVIPopReq "" /begin SUB_FUNCTION Data_Type_Conversion /end SUB_FUNCTION /begin DEF_CHARACTERISTIC /end DEF_CHARACTERISTIC /begin IN_MEASUREMENT /end IN_MEASUREMENT /begin OUT_MEASUREMENT /end OUT_MEASUREMENT /end FUNCTION
/begin FUNCTION PwrStaONTOIVIPopT "" /begin SUB_FUNCTION Data_Type_Conversion /end SUB_FUNCTION /begin DEF_CHARACTERISTIC /end DEF_CHARACTERISTIC /begin IN_MEASUREMENT /end IN_MEASUREMENT /begin OUT_MEASUREMENT /end OUT_MEASUREMENT /end FUNCTION
/begin FUNCTION RBSD "" /begin SUB_FUNCTION Data_Type_Conversion /end SUB_FUNCTION /begin DEF_CHARACTERISTIC /end DEF_CHARACTERISTIC /begin IN_MEASUREMENT /end IN_MEASUREMENT /begin OUT_MEASUREMENT /end OUT_MEASUREMENT /end FUNCTION
/begin FUNCTION RDRL "" /begin SUB_FUNCTION Data_Type_Conversion /end SUB_FUNCTION /begin DEF_CHARACTERISTIC /end DEF_CHARACTERISTIC /begin IN_MEASUREMENT /end IN_MEASUREMENT /begin OUT_MEASUREMENT /end OUT_MEASUREMENT /end FUNCTION
/begin FUNCTION RLDoorSW "" /begin SUB_FUNCTION Data_Type_Conversion /end SUB_FUNCTION /begin DEF_CHARACTERISTIC /end DEF_CHARACTERISTIC /begin IN_MEASUREMENT /end IN_MEASUREMENT /begin OUT_MEASUREMENT /end OUT_MEASUREMENT /end FUNCTION
/begin FUNCTION RRDoorSW "" /begin SUB_FUNCTION Data_Type_Conversion /end SUB_FUNCTION /begin DEF_CHARACTERISTIC /end DEF_CHARACTERISTIC /begin IN_MEASUREMENT /end IN_MEASUREMENT /begin OUT_MEASUREMENT /end OUT_MEASUREMENT /end FUNCTION
/begin FUNCTION RTurnLP "" /begin SUB_FUNCTION Data_Type_Conversion /end SUB_FUNCTION /begin DEF_CHARACTERISTIC /end DEF_CHARACTERISTIC /begin IN_MEASUREMENT /end IN_MEASUREMENT /begin OUT_MEASUREMENT /end OUT_MEASUREMENT /end FUNCTION
/begin FUNCTION ReqInternalV2LStatusLamp "" /begin SUB_FUNCTION /end SUB_FUNCTION /begin DEF_CHARACTERISTIC /end DEF_CHARACTERISTIC /begin IN_MEASUREMENT /end IN_MEASUREMENT /begin OUT_MEASUREMENT /end OUT_MEASUREMENT /end FUNCTION
/begin FUNCTION ReqV2LIVIPopup "" /begin SUB_FUNCTION /end SUB_FUNCTION /begin DEF_CHARACTERISTIC /end DEF_CHARACTERISTIC /begin IN_MEASUREMENT /end IN_MEASUREMENT /begin OUT_MEASUREMENT /end OUT_MEASUREMENT /end FUNCTION
/begin FUNCTION ReqV2LSwOn "" /begin SUB_FUNCTION /end SUB_FUNCTION /begin DEF_CHARACTERISTIC /end DEF_CHARACTERISTIC /begin IN_MEASUREMENT /end IN_MEASUREMENT /begin OUT_MEASUREMENT /end OUT_MEASUREMENT /end FUNCTION
/begin FUNCTION ReverseLamp "" /begin SUB_FUNCTION Data_Type_Conversion /end SUB_FUNCTION /begin DEF_CHARACTERISTIC /end DEF_CHARACTERISTIC /begin IN_MEASUREMENT /end IN_MEASUREMENT /begin OUT_MEASUREMENT /end OUT_MEASUREMENT /end FUNCTION
/begin FUNCTION RrDefog "" /begin SUB_FUNCTION Data_Type_Conversion /end SUB_FUNCTION /begin DEF_CHARACTERISTIC /end DEF_CHARACTERISTIC /begin IN_MEASUREMENT /end IN_MEASUREMENT /begin OUT_MEASUREMENT /end OUT_MEASUREMENT /end FUNCTION
/begin FUNCTION RrFogLamp "" /begin SUB_FUNCTION Data_Type_Conversion /end SUB_FUNCTION /begin DEF_CHARACTERISTIC /end DEF_CHARACTERISTIC /begin IN_MEASUREMENT /end IN_MEASUREMENT /begin OUT_MEASUREMENT /end OUT_MEASUREMENT /end FUNCTION
/begin FUNCTION ShiftGearPosn "" /begin SUB_FUNCTION /end SUB_FUNCTION /begin DEF_CHARACTERISTIC /end DEF_CHARACTERISTIC /begin IN_MEASUREMENT /end IN_MEASUREMENT /begin OUT_MEASUREMENT /end OUT_MEASUREMENT /end FUNCTION
/begin FUNCTION SysAllowReadySta "" /begin SUB_FUNCTION Data_Type_Conversion /end SUB_FUNCTION /begin DEF_CHARACTERISTIC /end DEF_CHARACTERISTIC /begin IN_MEASUREMENT /end IN_MEASUREMENT /begin OUT_MEASUREMENT /end OUT_MEASUREMENT /end FUNCTION
/begin FUNCTION SysPwrSta "" /begin SUB_FUNCTION /end SUB_FUNCTION /begin DEF_CHARACTERISTIC /end DEF_CHARACTERISTIC /begin IN_MEASUREMENT /end IN_MEASUREMENT /begin OUT_MEASUREMENT /end OUT_MEASUREMENT /end FUNCTION
/begin FUNCTION TailgateSW "" /begin SUB_FUNCTION Data_Type_Conversion /end SUB_FUNCTION /begin DEF_CHARACTERISTIC /end DEF_CHARACTERISTIC /begin IN_MEASUREMENT /end IN_MEASUREMENT /begin OUT_MEASUREMENT /end OUT_MEASUREMENT /end FUNCTION
/begin FUNCTION VCUBrkSWSta "" /begin SUB_FUNCTION /end SUB_FUNCTION /begin DEF_CHARACTERISTIC /end DEF_CHARACTERISTIC /begin IN_MEASUREMENT /end IN_MEASUREMENT /begin OUT_MEASUREMENT /end OUT_MEASUREMENT /end FUNCTION
/begin FUNCTION VCUFLDoorSta "" /begin SUB_FUNCTION Data_Type_Conversion /end SUB_FUNCTION /begin DEF_CHARACTERISTIC /end DEF_CHARACTERISTIC /begin IN_MEASUREMENT /end IN_MEASUREMENT /begin OUT_MEASUREMENT /end OUT_MEASUREMENT /end FUNCTION
/begin FUNCTION VCUFRDoorSta "" /begin SUB_FUNCTION Data_Type_Conversion /end SUB_FUNCTION /begin DEF_CHARACTERISTIC /end DEF_CHARACTERISTIC /begin IN_MEASUREMENT /end IN_MEASUREMENT /begin OUT_MEASUREMENT /end OUT_MEASUREMENT /end FUNCTION
/begin FUNCTION VCUHoodSWSta "" /begin SUB_FUNCTION Data_Type_Conversion /end SUB_FUNCTION /begin DEF_CHARACTERISTIC /end DEF_CHARACTERISTIC /begin IN_MEASUREMENT /end IN_MEASUREMENT /begin OUT_MEASUREMENT /end OUT_MEASUREMENT /end FUNCTION
/begin FUNCTION VCUOPDHold "" /begin SUB_FUNCTION Data_Type_Conversion /end SUB_FUNCTION /begin DEF_CHARACTERISTIC /end DEF_CHARACTERISTIC /begin IN_MEASUREMENT /end IN_MEASUREMENT /begin OUT_MEASUREMENT /end OUT_MEASUREMENT /end FUNCTION
/begin FUNCTION VCURLDoorSta "" /begin SUB_FUNCTION Data_Type_Conversion /end SUB_FUNCTION /begin DEF_CHARACTERISTIC /end DEF_CHARACTERISTIC /begin IN_MEASUREMENT /end IN_MEASUREMENT /begin OUT_MEASUREMENT /end OUT_MEASUREMENT /end FUNCTION
/begin FUNCTION VCURRDoorSta "" /begin SUB_FUNCTION Data_Type_Conversion /end SUB_FUNCTION /begin DEF_CHARACTERISTIC /end DEF_CHARACTERISTIC /begin IN_MEASUREMENT /end IN_MEASUREMENT /begin OUT_MEASUREMENT /end OUT_MEASUREMENT /end FUNCTION
/begin FUNCTION VCUTailgateSWSta "" /begin SUB_FUNCTION Data_Type_Conversion /end SUB_FUNCTION /begin DEF_CHARACTERISTIC /end DEF_CHARACTERISTIC /begin IN_MEASUREMENT /end IN_MEASUREMENT /begin OUT_MEASUREMENT /end OUT_MEASUREMENT /end FUNCTION
/begin FUNCTION VehMalfunLevel "" /begin SUB_FUNCTION /end SUB_FUNCTION /begin DEF_CHARACTERISTIC /end DEF_CHARACTERISTIC /begin IN_MEASUREMENT /end IN_MEASUREMENT /begin OUT_MEASUREMENT /end OUT_MEASUREMENT /end FUNCTION
/begin FUNCTION XWDMode "" /begin SUB_FUNCTION /end SUB_FUNCTION /begin DEF_CHARACTERISTIC /end DEF_CHARACTERISTIC /begin IN_MEASUREMENT /end IN_MEASUREMENT /begin OUT_MEASUREMENT /end OUT_MEASUREMENT /end FUNCTION
/begin FUNCTION sigAirIntenZon1St "" /begin SUB_FUNCTION /end SUB_FUNCTION /begin DEF_CHARACTERISTIC /end DEF_CHARACTERISTIC /begin IN_MEASUREMENT /end IN_MEASUREMENT /begin OUT_MEASUREMENT /end OUT_MEASUREMENT /end FUNCTION
/begin FUNCTION sigAirIntenZon3St "" /begin SUB_FUNCTION /end SUB_FUNCTION /begin DEF_CHARACTERISTIC /end DEF_CHARACTERISTIC /begin IN_MEASUREMENT /end IN_MEASUREMENT /begin OUT_MEASUREMENT /end OUT_MEASUREMENT /end FUNCTION
/begin FUNCTION sigAmbAirT "" /begin SUB_FUNCTION convert_out Data_Type_Conversion /end SUB_FUNCTION /begin DEF_CHARACTERISTIC /end DEF_CHARACTERISTIC /begin IN_MEASUREMENT /end IN_MEASUREMENT /begin OUT_MEASUREMENT /end OUT_MEASUREMENT /end FUNCTION
/begin FUNCTION sigCbnAirT "" /begin SUB_FUNCTION convert_out Data_Type_Conversion /end SUB_FUNCTION /begin DEF_CHARACTERISTIC /end DEF_CHARACTERISTIC /begin IN_MEASUREMENT /end IN_MEASUREMENT /begin OUT_MEASUREMENT /end OUT_MEASUREMENT /end FUNCTION
/begin FUNCTION sigDfrstSt "" /begin SUB_FUNCTION Data_Type_Conversion /end SUB_FUNCTION /begin DEF_CHARACTERISTIC /end DEF_CHARACTERISTIC /begin IN_MEASUREMENT /end IN_MEASUREMENT /begin OUT_MEASUREMENT /end OUT_MEASUREMENT /end FUNCTION
/begin FUNCTION sigHvacSt "" /begin SUB_FUNCTION /end SUB_FUNCTION /begin DEF_CHARACTERISTIC /end DEF_CHARACTERISTIC /begin IN_MEASUREMENT /end IN_MEASUREMENT /begin OUT_MEASUREMENT /end OUT_MEASUREMENT /end FUNCTION
/begin FUNCTION sigRecircSt "" /begin SUB_FUNCTION Data_Type_Conversion /end SUB_FUNCTION /begin DEF_CHARACTERISTIC /end DEF_CHARACTERISTIC /begin IN_MEASUREMENT /end IN_MEASUREMENT /begin OUT_MEASUREMENT /end OUT_MEASUREMENT /end FUNCTION
/begin FUNCTION sigSetTempZon1St "" /begin SUB_FUNCTION convert_out Data_Type_Conversion /end SUB_FUNCTION /begin DEF_CHARACTERISTIC /end DEF_CHARACTERISTIC /begin IN_MEASUREMENT /end IN_MEASUREMENT /begin OUT_MEASUREMENT /end OUT_MEASUREMENT /end FUNCTION
/begin FUNCTION sigSetTempZon2St "" /begin SUB_FUNCTION convert_out Data_Type_Conversion /end SUB_FUNCTION /begin DEF_CHARACTERISTIC /end DEF_CHARACTERISTIC /begin IN_MEASUREMENT /end IN_MEASUREMENT /begin OUT_MEASUREMENT /end OUT_MEASUREMENT /end FUNCTION
/begin FUNCTION sigSetTempZon3St "" /begin SUB_FUNCTION convert_out Data_Type_Conversion /end SUB_FUNCTION /begin DEF_CHARACTERISTIC /end DEF_CHARACTERISTIC /begin IN_MEASUREMENT /end IN_MEASUREMENT /begin OUT_MEASUREMENT /end OUT_MEASUREMENT /end FUNCTION
/begin FUNCTION sigWindDirZon1St "" /begin SUB_FUNCTION /end SUB_FUNCTION /begin DEF_CHARACTERISTIC /end DEF_CHARACTERISTIC /begin IN_MEASUREMENT /end IN_MEASUREMENT /begin OUT_MEASUREMENT /end OUT_MEASUREMENT /end FUNCTION
/begin FUNCTION sigWindDirZon3St "" /begin SUB_FUNCTION /end SUB_FUNCTION /begin DEF_CHARACTERISTIC /end DEF_CHARACTERISTIC /begin IN_MEASUREMENT /end IN_MEASUREMENT /begin OUT_MEASUREMENT /end OUT_MEASUREMENT /end FUNCTION
/begin FUNCTION bus_creator "" /begin DEF_CHARACTERISTIC /end DEF_CHARACTERISTIC /begin IN_MEASUREMENT /end IN_MEASUREMENT /begin OUT_MEASUREMENT /end OUT_MEASUREMENT /end FUNCTION
/begin FUNCTION AutoLTips "" /begin SUB_FUNCTION /end SUB_FUNCTION /begin DEF_CHARACTERISTIC /end DEF_CHARACTERISTIC /begin IN_MEASUREMENT /end IN_MEASUREMENT /begin OUT_MEASUREMENT /end OUT_MEASUREMENT /end FUNCTION
/begin FUNCTION CWheelTips "" /begin SUB_FUNCTION /end SUB_FUNCTION /begin DEF_CHARACTERISTIC /end DEF_CHARACTERISTIC /begin IN_MEASUREMENT /end IN_MEASUREMENT /begin OUT_MEASUREMENT /end OUT_MEASUREMENT /end FUNCTION
/begin FUNCTION FDCBCMAcc1StaSta "" /begin SUB_FUNCTION /end SUB_FUNCTION /begin DEF_CHARACTERISTIC /end DEF_CHARACTERISTIC /begin IN_MEASUREMENT /end IN_MEASUREMENT /begin OUT_MEASUREMENT /end OUT_MEASUREMENT /end FUNCTION
/begin FUNCTION FDCBCMAcc2StaSta "" /begin SUB_FUNCTION /end SUB_FUNCTION /begin DEF_CHARACTERISTIC /end DEF_CHARACTERISTIC /begin IN_MEASUREMENT /end IN_MEASUREMENT /begin OUT_MEASUREMENT /end OUT_MEASUREMENT /end FUNCTION
/begin FUNCTION FDCBCMAcc3StaSta "" /begin SUB_FUNCTION /end SUB_FUNCTION /begin DEF_CHARACTERISTIC /end DEF_CHARACTERISTIC /begin IN_MEASUREMENT /end IN_MEASUREMENT /begin OUT_MEASUREMENT /end OUT_MEASUREMENT /end FUNCTION
/begin FUNCTION FDCBCMAcc4StaSta "" /begin SUB_FUNCTION /end SUB_FUNCTION /begin DEF_CHARACTERISTIC /end DEF_CHARACTERISTIC /begin IN_MEASUREMENT /end IN_MEASUREMENT /begin OUT_MEASUREMENT /end OUT_MEASUREMENT /end FUNCTION
/begin FUNCTION FDCBCMAcc5StaSta "" /begin SUB_FUNCTION /end SUB_FUNCTION /begin DEF_CHARACTERISTIC /end DEF_CHARACTERISTIC /begin IN_MEASUREMENT /end IN_MEASUREMENT /begin OUT_MEASUREMENT /end OUT_MEASUREMENT /end FUNCTION
/begin FUNCTION FDCBCMAmbBrightStaSta "" /begin SUB_FUNCTION /end SUB_FUNCTION /begin DEF_CHARACTERISTIC /end DEF_CHARACTERISTIC /begin IN_MEASUREMENT /end IN_MEASUREMENT /begin OUT_MEASUREMENT /end OUT_MEASUREMENT /end FUNCTION
/begin FUNCTION FDCBCMAmbColorStaSta "" /begin SUB_FUNCTION /end SUB_FUNCTION /begin DEF_CHARACTERISTIC /end DEF_CHARACTERISTIC /begin IN_MEASUREMENT /end IN_MEASUREMENT /begin OUT_MEASUREMENT /end OUT_MEASUREMENT /end FUNCTION
/begin FUNCTION FDCBCMAmbDimENSta "" /begin SUB_FUNCTION Data_Type_Conversion /end SUB_FUNCTION /begin DEF_CHARACTERISTIC /end DEF_CHARACTERISTIC /begin IN_MEASUREMENT /end IN_MEASUREMENT /begin OUT_MEASUREMENT /end OUT_MEASUREMENT /end FUNCTION
/begin FUNCTION FDCBCMAmbFunENSta "" /begin SUB_FUNCTION Data_Type_Conversion /end SUB_FUNCTION /begin DEF_CHARACTERISTIC /end DEF_CHARACTERISTIC /begin IN_MEASUREMENT /end IN_MEASUREMENT /begin OUT_MEASUREMENT /end OUT_MEASUREMENT /end FUNCTION
/begin FUNCTION FDCBCMAmbLinkDriStaSta "" /begin SUB_FUNCTION Data_Type_Conversion /end SUB_FUNCTION /begin DEF_CHARACTERISTIC /end DEF_CHARACTERISTIC /begin IN_MEASUREMENT /end IN_MEASUREMENT /begin OUT_MEASUREMENT /end OUT_MEASUREMENT /end FUNCTION
/begin FUNCTION FDCBCMAmbODAENSta "" /begin SUB_FUNCTION Data_Type_Conversion /end SUB_FUNCTION /begin DEF_CHARACTERISTIC /end DEF_CHARACTERISTIC /begin IN_MEASUREMENT /end IN_MEASUREMENT /begin OUT_MEASUREMENT /end OUT_MEASUREMENT /end FUNCTION
/begin FUNCTION FDCBCMAmbPwrWarnENSta "" /begin SUB_FUNCTION Data_Type_Conversion /end SUB_FUNCTION /begin DEF_CHARACTERISTIC /end DEF_CHARACTERISTIC /begin IN_MEASUREMENT /end IN_MEASUREMENT /begin OUT_MEASUREMENT /end OUT_MEASUREMENT /end FUNCTION
/begin FUNCTION FDCBCMAmbWelENSta "" /begin SUB_FUNCTION Data_Type_Conversion /end SUB_FUNCTION /begin DEF_CHARACTERISTIC /end DEF_CHARACTERISTIC /begin IN_MEASUREMENT /end IN_MEASUREMENT /begin OUT_MEASUREMENT /end OUT_MEASUREMENT /end FUNCTION
/begin FUNCTION FDCBCMAutoLockSta "" /begin SUB_FUNCTION Data_Type_Conversion /end SUB_FUNCTION /begin DEF_CHARACTERISTIC /end DEF_CHARACTERISTIC /begin IN_MEASUREMENT /end IN_MEASUREMENT /begin OUT_MEASUREMENT /end OUT_MEASUREMENT /end FUNCTION
/begin FUNCTION FDCBCMAutoUnlockSta "" /begin SUB_FUNCTION Data_Type_Conversion /end SUB_FUNCTION /begin DEF_CHARACTERISTIC /end DEF_CHARACTERISTIC /begin IN_MEASUREMENT /end IN_MEASUREMENT /begin OUT_MEASUREMENT /end OUT_MEASUREMENT /end FUNCTION
/begin FUNCTION FDCBCMCLWinLockDrSta "" /begin SUB_FUNCTION Data_Type_Conversion /end SUB_FUNCTION /begin DEF_CHARACTERISTIC /end DEF_CHARACTERISTIC /begin IN_MEASUREMENT /end IN_MEASUREMENT /begin OUT_MEASUREMENT /end OUT_MEASUREMENT /end FUNCTION
/begin FUNCTION FDCBCMDSEATentryfsetSta "" /begin SUB_FUNCTION /end SUB_FUNCTION /begin DEF_CHARACTERISTIC /end DEF_CHARACTERISTIC /begin IN_MEASUREMENT /end IN_MEASUREMENT /begin OUT_MEASUREMENT /end OUT_MEASUREMENT /end FUNCTION
/begin FUNCTION FDCBCMFollowMeENFunSta "" /begin SUB_FUNCTION Data_Type_Conversion /end SUB_FUNCTION /begin DEF_CHARACTERISTIC /end DEF_CHARACTERISTIC /begin IN_MEASUREMENT /end IN_MEASUREMENT /begin OUT_MEASUREMENT /end OUT_MEASUREMENT /end FUNCTION
/begin FUNCTION FDCBCMHBeamADBCmd "" /begin SUB_FUNCTION /end SUB_FUNCTION /begin DEF_CHARACTERISTIC /end DEF_CHARACTERISTIC /begin IN_MEASUREMENT /end IN_MEASUREMENT /begin OUT_MEASUREMENT /end OUT_MEASUREMENT /end FUNCTION
/begin FUNCTION FDCBCMKey10AccSta "" /begin SUB_FUNCTION /end SUB_FUNCTION /begin DEF_CHARACTERISTIC /end DEF_CHARACTERISTIC /begin IN_MEASUREMENT /end IN_MEASUREMENT /begin OUT_MEASUREMENT /end OUT_MEASUREMENT /end FUNCTION
/begin FUNCTION FDCBCMKey1AccSta "" /begin SUB_FUNCTION /end SUB_FUNCTION /begin DEF_CHARACTERISTIC /end DEF_CHARACTERISTIC /begin IN_MEASUREMENT /end IN_MEASUREMENT /begin OUT_MEASUREMENT /end OUT_MEASUREMENT /end FUNCTION
/begin FUNCTION FDCBCMKey2AccSta "" /begin SUB_FUNCTION /end SUB_FUNCTION /begin DEF_CHARACTERISTIC /end DEF_CHARACTERISTIC /begin IN_MEASUREMENT /end IN_MEASUREMENT /begin OUT_MEASUREMENT /end OUT_MEASUREMENT /end FUNCTION
/begin FUNCTION FDCBCMKey3AccSta "" /begin SUB_FUNCTION /end SUB_FUNCTION /begin DEF_CHARACTERISTIC /end DEF_CHARACTERISTIC /begin IN_MEASUREMENT /end IN_MEASUREMENT /begin OUT_MEASUREMENT /end OUT_MEASUREMENT /end FUNCTION
/begin FUNCTION FDCBCMKey4AccSta "" /begin SUB_FUNCTION /end SUB_FUNCTION /begin DEF_CHARACTERISTIC /end DEF_CHARACTERISTIC /begin IN_MEASUREMENT /end IN_MEASUREMENT /begin OUT_MEASUREMENT /end OUT_MEASUREMENT /end FUNCTION
/begin FUNCTION FDCBCMKey5AccSta "" /begin SUB_FUNCTION /end SUB_FUNCTION /begin DEF_CHARACTERISTIC /end DEF_CHARACTERISTIC /begin IN_MEASUREMENT /end IN_MEASUREMENT /begin OUT_MEASUREMENT /end OUT_MEASUREMENT /end FUNCTION
/begin FUNCTION FDCBCMKey6AccSta "" /begin SUB_FUNCTION /end SUB_FUNCTION /begin DEF_CHARACTERISTIC /end DEF_CHARACTERISTIC /begin IN_MEASUREMENT /end IN_MEASUREMENT /begin OUT_MEASUREMENT /end OUT_MEASUREMENT /end FUNCTION
/begin FUNCTION FDCBCMKey7AccSta "" /begin SUB_FUNCTION /end SUB_FUNCTION /begin DEF_CHARACTERISTIC /end DEF_CHARACTERISTIC /begin IN_MEASUREMENT /end IN_MEASUREMENT /begin OUT_MEASUREMENT /end OUT_MEASUREMENT /end FUNCTION
/begin FUNCTION FDCBCMKey8AccSta "" /begin SUB_FUNCTION /end SUB_FUNCTION /begin DEF_CHARACTERISTIC /end DEF_CHARACTERISTIC /begin IN_MEASUREMENT /end IN_MEASUREMENT /begin OUT_MEASUREMENT /end OUT_MEASUREMENT /end FUNCTION
/begin FUNCTION FDCBCMKey9AccSta "" /begin SUB_FUNCTION /end SUB_FUNCTION /begin DEF_CHARACTERISTIC /end DEF_CHARACTERISTIC /begin IN_MEASUREMENT /end IN_MEASUREMENT /begin OUT_MEASUREMENT /end OUT_MEASUREMENT /end FUNCTION
/begin FUNCTION FDCBCMLockAlarmCmd "" /begin SUB_FUNCTION /end SUB_FUNCTION /begin DEF_CHARACTERISTIC /end DEF_CHARACTERISTIC /begin IN_MEASUREMENT /end IN_MEASUREMENT /begin OUT_MEASUREMENT /end OUT_MEASUREMENT /end FUNCTION
/begin FUNCTION FDCBCMPTGOpenHeightSta "" /begin SUB_FUNCTION /end SUB_FUNCTION /begin DEF_CHARACTERISTIC /end DEF_CHARACTERISTIC /begin IN_MEASUREMENT /end IN_MEASUREMENT /begin OUT_MEASUREMENT /end OUT_MEASUREMENT /end FUNCTION
/begin FUNCTION FDCBCMRmLpModeENFunSta "" /begin SUB_FUNCTION Data_Type_Conversion /end SUB_FUNCTION /begin DEF_CHARACTERISTIC /end DEF_CHARACTERISTIC /begin IN_MEASUREMENT /end IN_MEASUREMENT /begin OUT_MEASUREMENT /end OUT_MEASUREMENT /end FUNCTION
/begin FUNCTION FDCBCMTurnSwTSetStaSta "" /begin SUB_FUNCTION /end SUB_FUNCTION /begin DEF_CHARACTERISTIC /end DEF_CHARACTERISTIC /begin IN_MEASUREMENT /end IN_MEASUREMENT /begin OUT_MEASUREMENT /end OUT_MEASUREMENT /end FUNCTION
/begin FUNCTION FDCBCMUserNowSta "" /begin SUB_FUNCTION /end SUB_FUNCTION /begin DEF_CHARACTERISTIC /end DEF_CHARACTERISTIC /begin IN_MEASUREMENT /end IN_MEASUREMENT /begin OUT_MEASUREMENT /end OUT_MEASUREMENT /end FUNCTION
/begin FUNCTION FDCBCMWalkInUnLkEnFunSta "" /begin SUB_FUNCTION Data_Type_Conversion /end SUB_FUNCTION /begin DEF_CHARACTERISTIC /end DEF_CHARACTERISTIC /begin IN_MEASUREMENT /end IN_MEASUREMENT /begin OUT_MEASUREMENT /end OUT_MEASUREMENT /end FUNCTION
/begin FUNCTION FDCBCMWalkOutLkEnFunSta "" /begin SUB_FUNCTION Data_Type_Conversion /end SUB_FUNCTION /begin DEF_CHARACTERISTIC /end DEF_CHARACTERISTIC /begin IN_MEASUREMENT /end IN_MEASUREMENT /begin OUT_MEASUREMENT /end OUT_MEASUREMENT /end FUNCTION
/begin FUNCTION FDCDKCDkeyShowIVISta "" /begin SUB_FUNCTION /end SUB_FUNCTION /begin DEF_CHARACTERISTIC /end DEF_CHARACTERISTIC /begin IN_MEASUREMENT /end IN_MEASUREMENT /begin OUT_MEASUREMENT /end OUT_MEASUREMENT /end FUNCTION
/begin FUNCTION FDCDKCKeyMissSta "" /begin SUB_FUNCTION Data_Type_Conversion /end SUB_FUNCTION /begin DEF_CHARACTERISTIC /end DEF_CHARACTERISTIC /begin IN_MEASUREMENT /end IN_MEASUREMENT /begin OUT_MEASUREMENT /end OUT_MEASUREMENT /end FUNCTION
/begin FUNCTION FDCDKCKeyNumSta "" /begin SUB_FUNCTION /end SUB_FUNCTION /begin DEF_CHARACTERISTIC /end DEF_CHARACTERISTIC /begin IN_MEASUREMENT /end IN_MEASUREMENT /begin OUT_MEASUREMENT /end OUT_MEASUREMENT /end FUNCTION
/begin FUNCTION FDCDKCKeyTypeSta "" /begin SUB_FUNCTION /end SUB_FUNCTION /begin DEF_CHARACTERISTIC /end DEF_CHARACTERISTIC /begin IN_MEASUREMENT /end IN_MEASUREMENT /begin OUT_MEASUREMENT /end OUT_MEASUREMENT /end FUNCTION
/begin FUNCTION FDCDKCUIDLowPowerSta "" /begin SUB_FUNCTION Data_Type_Conversion /end SUB_FUNCTION /begin DEF_CHARACTERISTIC /end DEF_CHARACTERISTIC /begin IN_MEASUREMENT /end IN_MEASUREMENT /begin OUT_MEASUREMENT /end OUT_MEASUREMENT /end FUNCTION
/begin FUNCTION FDCFGSAirIntSta "" /begin SUB_FUNCTION /end SUB_FUNCTION /begin DEF_CHARACTERISTIC /end DEF_CHARACTERISTIC /begin IN_MEASUREMENT /end IN_MEASUREMENT /begin OUT_MEASUREMENT /end OUT_MEASUREMENT /end FUNCTION
/begin FUNCTION FDCFGSFGSChSta "" /begin SUB_FUNCTION /end SUB_FUNCTION /begin DEF_CHARACTERISTIC /end DEF_CHARACTERISTIC /begin IN_MEASUREMENT /end IN_MEASUREMENT /begin OUT_MEASUREMENT /end OUT_MEASUREMENT /end FUNCTION
/begin FUNCTION FDCFGSIONSWSta "" /begin SUB_FUNCTION Data_Type_Conversion /end SUB_FUNCTION /begin DEF_CHARACTERISTIC /end DEF_CHARACTERISTIC /begin IN_MEASUREMENT /end IN_MEASUREMENT /begin OUT_MEASUREMENT /end OUT_MEASUREMENT /end FUNCTION
/begin FUNCTION FDCSPTGSPTGENFunSta "" /begin SUB_FUNCTION Data_Type_Conversion /end SUB_FUNCTION /begin DEF_CHARACTERISTIC /end DEF_CHARACTERISTIC /begin IN_MEASUREMENT /end IN_MEASUREMENT /begin OUT_MEASUREMENT /end OUT_MEASUREMENT /end FUNCTION
/begin FUNCTION FDCTHCMAPTCForceOFFSta "" /begin SUB_FUNCTION Data_Type_Conversion /end SUB_FUNCTION /begin DEF_CHARACTERISTIC /end DEF_CHARACTERISTIC /begin IN_MEASUREMENT /end IN_MEASUREMENT /begin OUT_MEASUREMENT /end OUT_MEASUREMENT /end FUNCTION
/begin FUNCTION FDCTHCMAPTCWarningSta "" /begin SUB_FUNCTION /end SUB_FUNCTION /begin DEF_CHARACTERISTIC /end DEF_CHARACTERISTIC /begin IN_MEASUREMENT /end IN_MEASUREMENT /begin OUT_MEASUREMENT /end OUT_MEASUREMENT /end FUNCTION
/begin FUNCTION FDCTHCMAirIntZ3Sta "" /begin SUB_FUNCTION /end SUB_FUNCTION /begin DEF_CHARACTERISTIC /end DEF_CHARACTERISTIC /begin IN_MEASUREMENT /end IN_MEASUREMENT /begin OUT_MEASUREMENT /end OUT_MEASUREMENT /end FUNCTION
/begin FUNCTION LFBatWarn "" /begin SUB_FUNCTION Data_Type_Conversion /end SUB_FUNCTION /begin DEF_CHARACTERISTIC /end DEF_CHARACTERISTIC /begin IN_MEASUREMENT /end IN_MEASUREMENT /begin OUT_MEASUREMENT /end OUT_MEASUREMENT /end FUNCTION
/begin FUNCTION LFPressIndi "" /begin SUB_FUNCTION /end SUB_FUNCTION /begin DEF_CHARACTERISTIC /end DEF_CHARACTERISTIC /begin IN_MEASUREMENT /end IN_MEASUREMENT /begin OUT_MEASUREMENT /end OUT_MEASUREMENT /end FUNCTION
/begin FUNCTION LFSensorFail "" /begin SUB_FUNCTION Data_Type_Conversion /end SUB_FUNCTION /begin DEF_CHARACTERISTIC /end DEF_CHARACTERISTIC /begin IN_MEASUREMENT /end IN_MEASUREMENT /begin OUT_MEASUREMENT /end OUT_MEASUREMENT /end FUNCTION
/begin FUNCTION LFWheelDebug "" /begin SUB_FUNCTION Data_Type_Conversion /end SUB_FUNCTION /begin DEF_CHARACTERISTIC /end DEF_CHARACTERISTIC /begin IN_MEASUREMENT /end IN_MEASUREMENT /begin OUT_MEASUREMENT /end OUT_MEASUREMENT /end FUNCTION
/begin FUNCTION LFWheelPSW "" /begin SUB_FUNCTION /end SUB_FUNCTION /begin DEF_CHARACTERISTIC /end DEF_CHARACTERISTIC /begin IN_MEASUREMENT /end IN_MEASUREMENT /begin OUT_MEASUREMENT /end OUT_MEASUREMENT /end FUNCTION
/begin FUNCTION LFWheelPress "" /begin SUB_FUNCTION /end SUB_FUNCTION /begin DEF_CHARACTERISTIC /end DEF_CHARACTERISTIC /begin IN_MEASUREMENT /end IN_MEASUREMENT /begin OUT_MEASUREMENT /end OUT_MEASUREMENT /end FUNCTION
/begin FUNCTION LFWheelShield "" /begin SUB_FUNCTION /end SUB_FUNCTION /begin DEF_CHARACTERISTIC /end DEF_CHARACTERISTIC /begin IN_MEASUREMENT /end IN_MEASUREMENT /begin OUT_MEASUREMENT /end OUT_MEASUREMENT /end FUNCTION
/begin FUNCTION LFWheelTemp "" /begin SUB_FUNCTION convert_out Data_Type_Conversion /end SUB_FUNCTION /begin DEF_CHARACTERISTIC /end DEF_CHARACTERISTIC /begin IN_MEASUREMENT /end IN_MEASUREMENT /begin OUT_MEASUREMENT /end OUT_MEASUREMENT /end FUNCTION
/begin FUNCTION LFWheelTmpIndi "" /begin SUB_FUNCTION Data_Type_Conversion /end SUB_FUNCTION /begin DEF_CHARACTERISTIC /end DEF_CHARACTERISTIC /begin IN_MEASUREMENT /end IN_MEASUREMENT /begin OUT_MEASUREMENT /end OUT_MEASUREMENT /end FUNCTION
/begin FUNCTION LRBatWarn "" /begin SUB_FUNCTION Data_Type_Conversion /end SUB_FUNCTION /begin DEF_CHARACTERISTIC /end DEF_CHARACTERISTIC /begin IN_MEASUREMENT /end IN_MEASUREMENT /begin OUT_MEASUREMENT /end OUT_MEASUREMENT /end FUNCTION
/begin FUNCTION LRPressIndi "" /begin SUB_FUNCTION /end SUB_FUNCTION /begin DEF_CHARACTERISTIC /end DEF_CHARACTERISTIC /begin IN_MEASUREMENT /end IN_MEASUREMENT /begin OUT_MEASUREMENT /end OUT_MEASUREMENT /end FUNCTION
/begin FUNCTION LRSensorFail "" /begin SUB_FUNCTION Data_Type_Conversion /end SUB_FUNCTION /begin DEF_CHARACTERISTIC /end DEF_CHARACTERISTIC /begin IN_MEASUREMENT /end IN_MEASUREMENT /begin OUT_MEASUREMENT /end OUT_MEASUREMENT /end FUNCTION
/begin FUNCTION LRWheelDebug "" /begin SUB_FUNCTION Data_Type_Conversion /end SUB_FUNCTION /begin DEF_CHARACTERISTIC /end DEF_CHARACTERISTIC /begin IN_MEASUREMENT /end IN_MEASUREMENT /begin OUT_MEASUREMENT /end OUT_MEASUREMENT /end FUNCTION
/begin FUNCTION LRWheelPSW "" /begin SUB_FUNCTION /end SUB_FUNCTION /begin DEF_CHARACTERISTIC /end DEF_CHARACTERISTIC /begin IN_MEASUREMENT /end IN_MEASUREMENT /begin OUT_MEASUREMENT /end OUT_MEASUREMENT /end FUNCTION
/begin FUNCTION LRWheelPress "" /begin SUB_FUNCTION /end SUB_FUNCTION /begin DEF_CHARACTERISTIC /end DEF_CHARACTERISTIC /begin IN_MEASUREMENT /end IN_MEASUREMENT /begin OUT_MEASUREMENT /end OUT_MEASUREMENT /end FUNCTION
/begin FUNCTION LRWheelShield "" /begin SUB_FUNCTION /end SUB_FUNCTION /begin DEF_CHARACTERISTIC /end DEF_CHARACTERISTIC /begin IN_MEASUREMENT /end IN_MEASUREMENT /begin OUT_MEASUREMENT /end OUT_MEASUREMENT /end FUNCTION
/begin FUNCTION LRWheelTemp "" /begin SUB_FUNCTION convert_out Data_Type_Conversion /end SUB_FUNCTION /begin DEF_CHARACTERISTIC /end DEF_CHARACTERISTIC /begin IN_MEASUREMENT /end IN_MEASUREMENT /begin OUT_MEASUREMENT /end OUT_MEASUREMENT /end FUNCTION
/begin FUNCTION LRWheelTmpIndi "" /begin SUB_FUNCTION Data_Type_Conversion /end SUB_FUNCTION /begin DEF_CHARACTERISTIC /end DEF_CHARACTERISTIC /begin IN_MEASUREMENT /end IN_MEASUREMENT /begin OUT_MEASUREMENT /end OUT_MEASUREMENT /end FUNCTION
/begin FUNCTION RFBatWarn "" /begin SUB_FUNCTION Data_Type_Conversion /end SUB_FUNCTION /begin DEF_CHARACTERISTIC /end DEF_CHARACTERISTIC /begin IN_MEASUREMENT /end IN_MEASUREMENT /begin OUT_MEASUREMENT /end OUT_MEASUREMENT /end FUNCTION
/begin FUNCTION RFPressIndi "" /begin SUB_FUNCTION /end SUB_FUNCTION /begin DEF_CHARACTERISTIC /end DEF_CHARACTERISTIC /begin IN_MEASUREMENT /end IN_MEASUREMENT /begin OUT_MEASUREMENT /end OUT_MEASUREMENT /end FUNCTION
/begin FUNCTION RFSensorFail "" /begin SUB_FUNCTION Data_Type_Conversion /end SUB_FUNCTION /begin DEF_CHARACTERISTIC /end DEF_CHARACTERISTIC /begin IN_MEASUREMENT /end IN_MEASUREMENT /begin OUT_MEASUREMENT /end OUT_MEASUREMENT /end FUNCTION
/begin FUNCTION RFWheelDebug "" /begin SUB_FUNCTION Data_Type_Conversion /end SUB_FUNCTION /begin DEF_CHARACTERISTIC /end DEF_CHARACTERISTIC /begin IN_MEASUREMENT /end IN_MEASUREMENT /begin OUT_MEASUREMENT /end OUT_MEASUREMENT /end FUNCTION
/begin FUNCTION RFWheelPSW "" /begin SUB_FUNCTION /end SUB_FUNCTION /begin DEF_CHARACTERISTIC /end DEF_CHARACTERISTIC /begin IN_MEASUREMENT /end IN_MEASUREMENT /begin OUT_MEASUREMENT /end OUT_MEASUREMENT /end FUNCTION
/begin FUNCTION RFWheelPress "" /begin SUB_FUNCTION /end SUB_FUNCTION /begin DEF_CHARACTERISTIC /end DEF_CHARACTERISTIC /begin IN_MEASUREMENT /end IN_MEASUREMENT /begin OUT_MEASUREMENT /end OUT_MEASUREMENT /end FUNCTION
/begin FUNCTION RFWheelShield "" /begin SUB_FUNCTION /end SUB_FUNCTION /begin DEF_CHARACTERISTIC /end DEF_CHARACTERISTIC /begin IN_MEASUREMENT /end IN_MEASUREMENT /begin OUT_MEASUREMENT /end OUT_MEASUREMENT /end FUNCTION
/begin FUNCTION RFWheelTemp "" /begin SUB_FUNCTION convert_out Data_Type_Conversion /end SUB_FUNCTION /begin DEF_CHARACTERISTIC /end DEF_CHARACTERISTIC /begin IN_MEASUREMENT /end IN_MEASUREMENT /begin OUT_MEASUREMENT /end OUT_MEASUREMENT /end FUNCTION
/begin FUNCTION RFWheelTmpIndi "" /begin SUB_FUNCTION Data_Type_Conversion /end SUB_FUNCTION /begin DEF_CHARACTERISTIC /end DEF_CHARACTERISTIC /begin IN_MEASUREMENT /end IN_MEASUREMENT /begin OUT_MEASUREMENT /end OUT_MEASUREMENT /end FUNCTION
/begin FUNCTION RRBatWarn "" /begin SUB_FUNCTION Data_Type_Conversion /end SUB_FUNCTION /begin DEF_CHARACTERISTIC /end DEF_CHARACTERISTIC /begin IN_MEASUREMENT /end IN_MEASUREMENT /begin OUT_MEASUREMENT /end OUT_MEASUREMENT /end FUNCTION
/begin FUNCTION RRPressIndi "" /begin SUB_FUNCTION /end SUB_FUNCTION /begin DEF_CHARACTERISTIC /end DEF_CHARACTERISTIC /begin IN_MEASUREMENT /end IN_MEASUREMENT /begin OUT_MEASUREMENT /end OUT_MEASUREMENT /end FUNCTION
/begin FUNCTION RRSensorFail "" /begin SUB_FUNCTION Data_Type_Conversion /end SUB_FUNCTION /begin DEF_CHARACTERISTIC /end DEF_CHARACTERISTIC /begin IN_MEASUREMENT /end IN_MEASUREMENT /begin OUT_MEASUREMENT /end OUT_MEASUREMENT /end FUNCTION
/begin FUNCTION RRWheelDebug "" /begin SUB_FUNCTION Data_Type_Conversion /end SUB_FUNCTION /begin DEF_CHARACTERISTIC /end DEF_CHARACTERISTIC /begin IN_MEASUREMENT /end IN_MEASUREMENT /begin OUT_MEASUREMENT /end OUT_MEASUREMENT /end FUNCTION
/begin FUNCTION RRWheelPSW "" /begin SUB_FUNCTION /end SUB_FUNCTION /begin DEF_CHARACTERISTIC /end DEF_CHARACTERISTIC /begin IN_MEASUREMENT /end IN_MEASUREMENT /begin OUT_MEASUREMENT /end OUT_MEASUREMENT /end FUNCTION
/begin FUNCTION RRWheelPress "" /begin SUB_FUNCTION /end SUB_FUNCTION /begin DEF_CHARACTERISTIC /end DEF_CHARACTERISTIC /begin IN_MEASUREMENT /end IN_MEASUREMENT /begin OUT_MEASUREMENT /end OUT_MEASUREMENT /end FUNCTION
/begin FUNCTION RRWheelShield "" /begin SUB_FUNCTION /end SUB_FUNCTION /begin DEF_CHARACTERISTIC /end DEF_CHARACTERISTIC /begin IN_MEASUREMENT /end IN_MEASUREMENT /begin OUT_MEASUREMENT /end OUT_MEASUREMENT /end FUNCTION
/begin FUNCTION RRWheelTemp "" /begin SUB_FUNCTION convert_out Data_Type_Conversion /end SUB_FUNCTION /begin DEF_CHARACTERISTIC /end DEF_CHARACTERISTIC /begin IN_MEASUREMENT /end IN_MEASUREMENT /begin OUT_MEASUREMENT /end OUT_MEASUREMENT /end FUNCTION
/begin FUNCTION RRWheelTmpIndi "" /begin SUB_FUNCTION Data_Type_Conversion /end SUB_FUNCTION /begin DEF_CHARACTERISTIC /end DEF_CHARACTERISTIC /begin IN_MEASUREMENT /end IN_MEASUREMENT /begin OUT_MEASUREMENT /end OUT_MEASUREMENT /end FUNCTION
/begin FUNCTION TPMSCaliButtAllow "" /begin SUB_FUNCTION Data_Type_Conversion /end SUB_FUNCTION /begin DEF_CHARACTERISTIC /end DEF_CHARACTERISTIC /begin IN_MEASUREMENT /end IN_MEASUREMENT /begin OUT_MEASUREMENT /end OUT_MEASUREMENT /end FUNCTION
/begin FUNCTION TPMSResButtAllow "" /begin SUB_FUNCTION Data_Type_Conversion /end SUB_FUNCTION /begin DEF_CHARACTERISTIC /end DEF_CHARACTERISTIC /begin IN_MEASUREMENT /end IN_MEASUREMENT /begin OUT_MEASUREMENT /end OUT_MEASUREMENT /end FUNCTION
/begin FUNCTION TPMSWarnIndi "" /begin SUB_FUNCTION /end SUB_FUNCTION /begin DEF_CHARACTERISTIC /end DEF_CHARACTERISTIC /begin IN_MEASUREMENT /end IN_MEASUREMENT /begin OUT_MEASUREMENT /end OUT_MEASUREMENT /end FUNCTION
/begin FUNCTION bus_creator "" /begin DEF_CHARACTERISTIC /end DEF_CHARACTERISTIC /begin IN_MEASUREMENT /end IN_MEASUREMENT /begin OUT_MEASUREMENT /end OUT_MEASUREMENT /end FUNCTION
/begin FUNCTION FUSIONHWVer1 "" /begin SUB_FUNCTION /end SUB_FUNCTION /begin DEF_CHARACTERISTIC /end DEF_CHARACTERISTIC /begin IN_MEASUREMENT /end IN_MEASUREMENT /begin OUT_MEASUREMENT /end OUT_MEASUREMENT /end FUNCTION
/begin FUNCTION FUSIONHWVer2 "" /begin SUB_FUNCTION /end SUB_FUNCTION /begin DEF_CHARACTERISTIC /end DEF_CHARACTERISTIC /begin IN_MEASUREMENT /end IN_MEASUREMENT /begin OUT_MEASUREMENT /end OUT_MEASUREMENT /end FUNCTION
/begin FUNCTION FUSIONHWVer3 "" /begin SUB_FUNCTION /end SUB_FUNCTION /begin DEF_CHARACTERISTIC /end DEF_CHARACTERISTIC /begin IN_MEASUREMENT /end IN_MEASUREMENT /begin OUT_MEASUREMENT /end OUT_MEASUREMENT /end FUNCTION
/begin FUNCTION FUSIONSWCarModel1 "" /begin SUB_FUNCTION /end SUB_FUNCTION /begin DEF_CHARACTERISTIC /end DEF_CHARACTERISTIC /begin IN_MEASUREMENT /end IN_MEASUREMENT /begin OUT_MEASUREMENT /end OUT_MEASUREMENT /end FUNCTION
/begin FUNCTION FUSIONSWCarModel2 "" /begin SUB_FUNCTION /end SUB_FUNCTION /begin DEF_CHARACTERISTIC /end DEF_CHARACTERISTIC /begin IN_MEASUREMENT /end IN_MEASUREMENT /begin OUT_MEASUREMENT /end OUT_MEASUREMENT /end FUNCTION
/begin FUNCTION FUSIONSWCarModel3 "" /begin SUB_FUNCTION /end SUB_FUNCTION /begin DEF_CHARACTERISTIC /end DEF_CHARACTERISTIC /begin IN_MEASUREMENT /end IN_MEASUREMENT /begin OUT_MEASUREMENT /end OUT_MEASUREMENT /end FUNCTION
/begin FUNCTION FUSIONSWController1 "" /begin SUB_FUNCTION /end SUB_FUNCTION /begin DEF_CHARACTERISTIC /end DEF_CHARACTERISTIC /begin IN_MEASUREMENT /end IN_MEASUREMENT /begin OUT_MEASUREMENT /end OUT_MEASUREMENT /end FUNCTION
/begin FUNCTION FUSIONSWController2 "" /begin SUB_FUNCTION /end SUB_FUNCTION /begin DEF_CHARACTERISTIC /end DEF_CHARACTERISTIC /begin IN_MEASUREMENT /end IN_MEASUREMENT /begin OUT_MEASUREMENT /end OUT_MEASUREMENT /end FUNCTION
/begin FUNCTION FUSIONSWCountry1 "" /begin SUB_FUNCTION /end SUB_FUNCTION /begin DEF_CHARACTERISTIC /end DEF_CHARACTERISTIC /begin IN_MEASUREMENT /end IN_MEASUREMENT /begin OUT_MEASUREMENT /end OUT_MEASUREMENT /end FUNCTION
/begin FUNCTION FUSIONSWCountry2 "" /begin SUB_FUNCTION /end SUB_FUNCTION /begin DEF_CHARACTERISTIC /end DEF_CHARACTERISTIC /begin IN_MEASUREMENT /end IN_MEASUREMENT /begin OUT_MEASUREMENT /end OUT_MEASUREMENT /end FUNCTION
/begin FUNCTION FUSIONSWECUGen1 "" /begin SUB_FUNCTION /end SUB_FUNCTION /begin DEF_CHARACTERISTIC /end DEF_CHARACTERISTIC /begin IN_MEASUREMENT /end IN_MEASUREMENT /begin OUT_MEASUREMENT /end OUT_MEASUREMENT /end FUNCTION
/begin FUNCTION FUSIONSWECUGen2 "" /begin SUB_FUNCTION /end SUB_FUNCTION /begin DEF_CHARACTERISTIC /end DEF_CHARACTERISTIC /begin IN_MEASUREMENT /end IN_MEASUREMENT /begin OUT_MEASUREMENT /end OUT_MEASUREMENT /end FUNCTION
/begin FUNCTION FUSIONSWMajor1 "" /begin SUB_FUNCTION /end SUB_FUNCTION /begin DEF_CHARACTERISTIC /end DEF_CHARACTERISTIC /begin IN_MEASUREMENT /end IN_MEASUREMENT /begin OUT_MEASUREMENT /end OUT_MEASUREMENT /end FUNCTION
/begin FUNCTION FUSIONSWMajor2 "" /begin SUB_FUNCTION /end SUB_FUNCTION /begin DEF_CHARACTERISTIC /end DEF_CHARACTERISTIC /begin IN_MEASUREMENT /end IN_MEASUREMENT /begin OUT_MEASUREMENT /end OUT_MEASUREMENT /end FUNCTION
/begin FUNCTION FUSIONSWMinor1 "" /begin SUB_FUNCTION /end SUB_FUNCTION /begin DEF_CHARACTERISTIC /end DEF_CHARACTERISTIC /begin IN_MEASUREMENT /end IN_MEASUREMENT /begin OUT_MEASUREMENT /end OUT_MEASUREMENT /end FUNCTION
/begin FUNCTION FUSIONSWMinor2 "" /begin SUB_FUNCTION /end SUB_FUNCTION /begin DEF_CHARACTERISTIC /end DEF_CHARACTERISTIC /begin IN_MEASUREMENT /end IN_MEASUREMENT /begin OUT_MEASUREMENT /end OUT_MEASUREMENT /end FUNCTION
/begin FUNCTION FUSIONSWPatch1 "" /begin SUB_FUNCTION /end SUB_FUNCTION /begin DEF_CHARACTERISTIC /end DEF_CHARACTERISTIC /begin IN_MEASUREMENT /end IN_MEASUREMENT /begin OUT_MEASUREMENT /end OUT_MEASUREMENT /end FUNCTION
/begin FUNCTION FUSIONSWPatch2 "" /begin SUB_FUNCTION /end SUB_FUNCTION /begin DEF_CHARACTERISTIC /end DEF_CHARACTERISTIC /begin IN_MEASUREMENT /end IN_MEASUREMENT /begin OUT_MEASUREMENT /end OUT_MEASUREMENT /end FUNCTION
/begin FUNCTION FUSIONSWSHA1 "" /begin SUB_FUNCTION /end SUB_FUNCTION /begin DEF_CHARACTERISTIC /end DEF_CHARACTERISTIC /begin IN_MEASUREMENT /end IN_MEASUREMENT /begin OUT_MEASUREMENT /end OUT_MEASUREMENT /end FUNCTION
/begin FUNCTION FUSIONSWSHA2 "" /begin SUB_FUNCTION /end SUB_FUNCTION /begin DEF_CHARACTERISTIC /end DEF_CHARACTERISTIC /begin IN_MEASUREMENT /end IN_MEASUREMENT /begin OUT_MEASUREMENT /end OUT_MEASUREMENT /end FUNCTION
/begin FUNCTION FUSIONSWSHA3 "" /begin SUB_FUNCTION /end SUB_FUNCTION /begin DEF_CHARACTERISTIC /end DEF_CHARACTERISTIC /begin IN_MEASUREMENT /end IN_MEASUREMENT /begin OUT_MEASUREMENT /end OUT_MEASUREMENT /end FUNCTION
/begin FUNCTION FUSIONSWSHA4 "" /begin SUB_FUNCTION /end SUB_FUNCTION /begin DEF_CHARACTERISTIC /end DEF_CHARACTERISTIC /begin IN_MEASUREMENT /end IN_MEASUREMENT /begin OUT_MEASUREMENT /end OUT_MEASUREMENT /end FUNCTION
/begin FUNCTION FUSIONSWSHA5 "" /begin SUB_FUNCTION /end SUB_FUNCTION /begin DEF_CHARACTERISTIC /end DEF_CHARACTERISTIC /begin IN_MEASUREMENT /end IN_MEASUREMENT /begin OUT_MEASUREMENT /end OUT_MEASUREMENT /end FUNCTION
/begin FUNCTION FUSIONSWSHA6 "" /begin SUB_FUNCTION /end SUB_FUNCTION /begin DEF_CHARACTERISTIC /end DEF_CHARACTERISTIC /begin IN_MEASUREMENT /end IN_MEASUREMENT /begin OUT_MEASUREMENT /end OUT_MEASUREMENT /end FUNCTION
/begin FUNCTION FUSIONSWSHA7 "" /begin SUB_FUNCTION /end SUB_FUNCTION /begin DEF_CHARACTERISTIC /end DEF_CHARACTERISTIC /begin IN_MEASUREMENT /end IN_MEASUREMENT /begin OUT_MEASUREMENT /end OUT_MEASUREMENT /end FUNCTION
/begin FUNCTION FUSIONSWSHA8 "" /begin SUB_FUNCTION /end SUB_FUNCTION /begin DEF_CHARACTERISTIC /end DEF_CHARACTERISTIC /begin IN_MEASUREMENT /end IN_MEASUREMENT /begin OUT_MEASUREMENT /end OUT_MEASUREMENT /end FUNCTION
/begin FUNCTION FUSIONSWVar1 "" /begin SUB_FUNCTION /end SUB_FUNCTION /begin DEF_CHARACTERISTIC /end DEF_CHARACTERISTIC /begin IN_MEASUREMENT /end IN_MEASUREMENT /begin OUT_MEASUREMENT /end OUT_MEASUREMENT /end FUNCTION
/begin FUNCTION FUSIONSWVar2 "" /begin SUB_FUNCTION /end SUB_FUNCTION /begin DEF_CHARACTERISTIC /end DEF_CHARACTERISTIC /begin IN_MEASUREMENT /end IN_MEASUREMENT /begin OUT_MEASUREMENT /end OUT_MEASUREMENT /end FUNCTION
/begin FUNCTION FUSIONSWVar3 "" /begin SUB_FUNCTION /end SUB_FUNCTION /begin DEF_CHARACTERISTIC /end DEF_CHARACTERISTIC /begin IN_MEASUREMENT /end IN_MEASUREMENT /begin OUT_MEASUREMENT /end OUT_MEASUREMENT /end FUNCTION
/begin FUNCTION FUSIONSWVar4 "" /begin SUB_FUNCTION /end SUB_FUNCTION /begin DEF_CHARACTERISTIC /end DEF_CHARACTERISTIC /begin IN_MEASUREMENT /end IN_MEASUREMENT /begin OUT_MEASUREMENT /end OUT_MEASUREMENT /end FUNCTION
/begin FUNCTION FUSIONSWVar5 "" /begin SUB_FUNCTION /end SUB_FUNCTION /begin DEF_CHARACTERISTIC /end DEF_CHARACTERISTIC /begin IN_MEASUREMENT /end IN_MEASUREMENT /begin OUT_MEASUREMENT /end OUT_MEASUREMENT /end FUNCTION
/begin FUNCTION FUSIONSWchange1 "" /begin SUB_FUNCTION /end SUB_FUNCTION /begin DEF_CHARACTERISTIC /end DEF_CHARACTERISTIC /begin IN_MEASUREMENT /end IN_MEASUREMENT /begin OUT_MEASUREMENT /end OUT_MEASUREMENT /end FUNCTION
/begin FUNCTION FUSIONSWchange2 "" /begin SUB_FUNCTION /end SUB_FUNCTION /begin DEF_CHARACTERISTIC /end DEF_CHARACTERISTIC /begin IN_MEASUREMENT /end IN_MEASUREMENT /begin OUT_MEASUREMENT /end OUT_MEASUREMENT /end FUNCTION
/begin FUNCTION FUSIONSWdash1 "" /begin SUB_FUNCTION /end SUB_FUNCTION /begin DEF_CHARACTERISTIC /end DEF_CHARACTERISTIC /begin IN_MEASUREMENT /end IN_MEASUREMENT /begin OUT_MEASUREMENT /end OUT_MEASUREMENT /end FUNCTION
/begin FUNCTION FUSIONSWdash2 "" /begin SUB_FUNCTION /end SUB_FUNCTION /begin DEF_CHARACTERISTIC /end DEF_CHARACTERISTIC /begin IN_MEASUREMENT /end IN_MEASUREMENT /begin OUT_MEASUREMENT /end OUT_MEASUREMENT /end FUNCTION
/begin FUNCTION bus_creator "" /begin DEF_CHARACTERISTIC /end DEF_CHARACTERISTIC /begin IN_MEASUREMENT /end IN_MEASUREMENT /begin OUT_MEASUREMENT /end OUT_MEASUREMENT /end FUNCTION
/begin FUNCTION FDCBCMDimSw "" /begin SUB_FUNCTION Data_Type_Conversion /end SUB_FUNCTION /begin DEF_CHARACTERISTIC /end DEF_CHARACTERISTIC /begin IN_MEASUREMENT /end IN_MEASUREMENT /begin OUT_MEASUREMENT /end OUT_MEASUREMENT /end FUNCTION
/begin FUNCTION FDCBCMFWipSwSta "" /begin SUB_FUNCTION /end SUB_FUNCTION /begin DEF_CHARACTERISTIC /end DEF_CHARACTERISTIC /begin IN_MEASUREMENT /end IN_MEASUREMENT /begin OUT_MEASUREMENT /end OUT_MEASUREMENT /end FUNCTION
/begin FUNCTION FDCBCMTurnSwSta "" /begin SUB_FUNCTION /end SUB_FUNCTION /begin DEF_CHARACTERISTIC /end DEF_CHARACTERISTIC /begin IN_MEASUREMENT /end IN_MEASUREMENT /begin OUT_MEASUREMENT /end OUT_MEASUREMENT /end FUNCTION
/begin FUNCTION bus_creator "" /begin DEF_CHARACTERISTIC /end DEF_CHARACTERISTIC /begin IN_MEASUREMENT /end IN_MEASUREMENT /begin OUT_MEASUREMENT /end OUT_MEASUREMENT /end FUNCTION
/begin FUNCTION FDCBCMWinLFOpenedSta "" /begin SUB_FUNCTION /end SUB_FUNCTION /begin DEF_CHARACTERISTIC /end DEF_CHARACTERISTIC /begin IN_MEASUREMENT /end IN_MEASUREMENT /begin OUT_MEASUREMENT /end OUT_MEASUREMENT /end FUNCTION
/begin FUNCTION FDCBCMWinLROpenedSta "" /begin SUB_FUNCTION /end SUB_FUNCTION /begin DEF_CHARACTERISTIC /end DEF_CHARACTERISTIC /begin IN_MEASUREMENT /end IN_MEASUREMENT /begin OUT_MEASUREMENT /end OUT_MEASUREMENT /end FUNCTION
/begin FUNCTION FDCBCMWinRFOpenedSta "" /begin SUB_FUNCTION /end SUB_FUNCTION /begin DEF_CHARACTERISTIC /end DEF_CHARACTERISTIC /begin IN_MEASUREMENT /end IN_MEASUREMENT /begin OUT_MEASUREMENT /end OUT_MEASUREMENT /end FUNCTION
/begin FUNCTION FDCBCMWinRROpenedSta "" /begin SUB_FUNCTION /end SUB_FUNCTION /begin DEF_CHARACTERISTIC /end DEF_CHARACTERISTIC /begin IN_MEASUREMENT /end IN_MEASUREMENT /begin OUT_MEASUREMENT /end OUT_MEASUREMENT /end FUNCTION
/begin FUNCTION bus_creator "" /begin DEF_CHARACTERISTIC /end DEF_CHARACTERISTIC /begin IN_MEASUREMENT /end IN_MEASUREMENT /begin OUT_MEASUREMENT /end OUT_MEASUREMENT /end FUNCTION
/begin FUNCTION FDCBCMTimeGapLevelSta "" /begin SUB_FUNCTION /end SUB_FUNCTION /begin DEF_CHARACTERISTIC /end DEF_CHARACTERISTIC /begin IN_MEASUREMENT /end IN_MEASUREMENT /begin OUT_MEASUREMENT /end OUT_MEASUREMENT /end FUNCTION
/begin FUNCTION bus_creator "" /begin DEF_CHARACTERISTIC /end DEF_CHARACTERISTIC /begin IN_MEASUREMENT /end IN_MEASUREMENT /begin OUT_MEASUREMENT /end OUT_MEASUREMENT /end FUNCTION
/begin FUNCTION AllDoorSW "" /begin SUB_FUNCTION Data_Type_Conversion /end SUB_FUNCTION /begin DEF_CHARACTERISTIC /end DEF_CHARACTERISTIC /begin IN_MEASUREMENT /end IN_MEASUREMENT /begin OUT_MEASUREMENT /end OUT_MEASUREMENT /end FUNCTION
/begin FUNCTION AntiTheftSeatFold "" /begin SUB_FUNCTION Data_Type_Conversion /end SUB_FUNCTION /begin DEF_CHARACTERISTIC /end DEF_CHARACTERISTIC /begin IN_MEASUREMENT /end IN_MEASUREMENT /begin OUT_MEASUREMENT /end OUT_MEASUREMENT /end FUNCTION
/begin FUNCTION AntitheftSta "" /begin SUB_FUNCTION /end SUB_FUNCTION /begin DEF_CHARACTERISTIC /end DEF_CHARACTERISTIC /begin IN_MEASUREMENT /end IN_MEASUREMENT /begin OUT_MEASUREMENT /end OUT_MEASUREMENT /end FUNCTION
/begin FUNCTION BCMBuzzerReq "" /begin SUB_FUNCTION Data_Type_Conversion /end SUB_FUNCTION /begin DEF_CHARACTERISTIC /end DEF_CHARACTERISTIC /begin IN_MEASUREMENT /end IN_MEASUREMENT /begin OUT_MEASUREMENT /end OUT_MEASUREMENT /end FUNCTION
/begin FUNCTION BCMDoorLockSta "" /begin SUB_FUNCTION Data_Type_Conversion /end SUB_FUNCTION /begin DEF_CHARACTERISTIC /end DEF_CHARACTERISTIC /begin IN_MEASUREMENT /end IN_MEASUREMENT /begin OUT_MEASUREMENT /end OUT_MEASUREMENT /end FUNCTION
/begin FUNCTION BrakeLamp "" /begin SUB_FUNCTION Data_Type_Conversion /end SUB_FUNCTION /begin DEF_CHARACTERISTIC /end DEF_CHARACTERISTIC /begin IN_MEASUREMENT /end IN_MEASUREMENT /begin OUT_MEASUREMENT /end OUT_MEASUREMENT /end FUNCTION
/begin FUNCTION CTDCtrl "" /begin SUB_FUNCTION /end SUB_FUNCTION /begin DEF_CHARACTERISTIC /end DEF_CHARACTERISTIC /begin IN_MEASUREMENT /end IN_MEASUREMENT /begin OUT_MEASUREMENT /end OUT_MEASUREMENT /end FUNCTION
/begin FUNCTION CTDLockSW "" /begin SUB_FUNCTION Data_Type_Conversion /end SUB_FUNCTION /begin DEF_CHARACTERISTIC /end DEF_CHARACTERISTIC /begin IN_MEASUREMENT /end IN_MEASUREMENT /begin OUT_MEASUREMENT /end OUT_MEASUREMENT /end FUNCTION
/begin FUNCTION CTDUnlockSW "" /begin SUB_FUNCTION /end SUB_FUNCTION /begin DEF_CHARACTERISTIC /end DEF_CHARACTERISTIC /begin IN_MEASUREMENT /end IN_MEASUREMENT /begin OUT_MEASUREMENT /end OUT_MEASUREMENT /end FUNCTION
/begin FUNCTION CrashDetd "" /begin SUB_FUNCTION Data_Type_Conversion /end SUB_FUNCTION /begin DEF_CHARACTERISTIC /end DEF_CHARACTERISTIC /begin IN_MEASUREMENT /end IN_MEASUREMENT /begin OUT_MEASUREMENT /end OUT_MEASUREMENT /end FUNCTION
/begin FUNCTION Dimmer "" /begin SUB_FUNCTION Data_Type_Conversion /end SUB_FUNCTION /begin DEF_CHARACTERISTIC /end DEF_CHARACTERISTIC /begin IN_MEASUREMENT /end IN_MEASUREMENT /begin OUT_MEASUREMENT /end OUT_MEASUREMENT /end FUNCTION
/begin FUNCTION DimmerEN "" /begin SUB_FUNCTION Data_Type_Conversion /end SUB_FUNCTION /begin DEF_CHARACTERISTIC /end DEF_CHARACTERISTIC /begin IN_MEASUREMENT /end IN_MEASUREMENT /begin OUT_MEASUREMENT /end OUT_MEASUREMENT /end FUNCTION
/begin FUNCTION DoorLockIND "" /begin SUB_FUNCTION Data_Type_Conversion /end SUB_FUNCTION /begin DEF_CHARACTERISTIC /end DEF_CHARACTERISTIC /begin IN_MEASUREMENT /end IN_MEASUREMENT /begin OUT_MEASUREMENT /end OUT_MEASUREMENT /end FUNCTION
/begin FUNCTION DrDoorSW "" /begin SUB_FUNCTION Data_Type_Conversion /end SUB_FUNCTION /begin DEF_CHARACTERISTIC /end DEF_CHARACTERISTIC /begin IN_MEASUREMENT /end IN_MEASUREMENT /begin OUT_MEASUREMENT /end OUT_MEASUREMENT /end FUNCTION
/begin FUNCTION FrChargingDoorCtrl "" /begin SUB_FUNCTION /end SUB_FUNCTION /begin DEF_CHARACTERISTIC /end DEF_CHARACTERISTIC /begin IN_MEASUREMENT /end IN_MEASUREMENT /begin OUT_MEASUREMENT /end OUT_MEASUREMENT /end FUNCTION
/begin FUNCTION FrFogLamp "" /begin SUB_FUNCTION /end SUB_FUNCTION /begin DEF_CHARACTERISTIC /end DEF_CHARACTERISTIC /begin IN_MEASUREMENT /end IN_MEASUREMENT /begin OUT_MEASUREMENT /end OUT_MEASUREMENT /end FUNCTION
/begin FUNCTION FrWiperH "" /begin SUB_FUNCTION Data_Type_Conversion /end SUB_FUNCTION /begin DEF_CHARACTERISTIC /end DEF_CHARACTERISTIC /begin IN_MEASUREMENT /end IN_MEASUREMENT /begin OUT_MEASUREMENT /end OUT_MEASUREMENT /end FUNCTION
/begin FUNCTION FrWiperL "" /begin SUB_FUNCTION Data_Type_Conversion /end SUB_FUNCTION /begin DEF_CHARACTERISTIC /end DEF_CHARACTERISTIC /begin IN_MEASUREMENT /end IN_MEASUREMENT /begin OUT_MEASUREMENT /end OUT_MEASUREMENT /end FUNCTION
/begin FUNCTION HBeam "" /begin SUB_FUNCTION Data_Type_Conversion /end SUB_FUNCTION /begin DEF_CHARACTERISTIC /end DEF_CHARACTERISTIC /begin IN_MEASUREMENT /end IN_MEASUREMENT /begin OUT_MEASUREMENT /end OUT_MEASUREMENT /end FUNCTION
/begin FUNCTION HazardSW "" /begin SUB_FUNCTION Data_Type_Conversion /end SUB_FUNCTION /begin DEF_CHARACTERISTIC /end DEF_CHARACTERISTIC /begin IN_MEASUREMENT /end IN_MEASUREMENT /begin OUT_MEASUREMENT /end OUT_MEASUREMENT /end FUNCTION
/begin FUNCTION HoodSW "" /begin SUB_FUNCTION Data_Type_Conversion /end SUB_FUNCTION /begin DEF_CHARACTERISTIC /end DEF_CHARACTERISTIC /begin IN_MEASUREMENT /end IN_MEASUREMENT /begin OUT_MEASUREMENT /end OUT_MEASUREMENT /end FUNCTION
/begin FUNCTION HornCtrl "" /begin SUB_FUNCTION Data_Type_Conversion /end SUB_FUNCTION /begin DEF_CHARACTERISTIC /end DEF_CHARACTERISTIC /begin IN_MEASUREMENT /end IN_MEASUREMENT /begin OUT_MEASUREMENT /end OUT_MEASUREMENT /end FUNCTION
/begin FUNCTION LAPMWdwEnable "" /begin SUB_FUNCTION /end SUB_FUNCTION /begin DEF_CHARACTERISTIC /end DEF_CHARACTERISTIC /begin IN_MEASUREMENT /end IN_MEASUREMENT /begin OUT_MEASUREMENT /end OUT_MEASUREMENT /end FUNCTION
/begin FUNCTION LBSD "" /begin SUB_FUNCTION Data_Type_Conversion /end SUB_FUNCTION /begin DEF_CHARACTERISTIC /end DEF_CHARACTERISTIC /begin IN_MEASUREMENT /end IN_MEASUREMENT /begin OUT_MEASUREMENT /end OUT_MEASUREMENT /end FUNCTION
/begin FUNCTION LBeam "" /begin SUB_FUNCTION Data_Type_Conversion /end SUB_FUNCTION /begin DEF_CHARACTERISTIC /end DEF_CHARACTERISTIC /begin IN_MEASUREMENT /end IN_MEASUREMENT /begin OUT_MEASUREMENT /end OUT_MEASUREMENT /end FUNCTION
/begin FUNCTION LDRL "" /begin SUB_FUNCTION Data_Type_Conversion /end SUB_FUNCTION /begin DEF_CHARACTERISTIC /end DEF_CHARACTERISTIC /begin IN_MEASUREMENT /end IN_MEASUREMENT /begin OUT_MEASUREMENT /end OUT_MEASUREMENT /end FUNCTION
/begin FUNCTION LTurnLP "" /begin SUB_FUNCTION Data_Type_Conversion /end SUB_FUNCTION /begin DEF_CHARACTERISTIC /end DEF_CHARACTERISTIC /begin IN_MEASUREMENT /end IN_MEASUREMENT /begin OUT_MEASUREMENT /end OUT_MEASUREMENT /end FUNCTION
/begin FUNCTION LockSetting "" /begin SUB_FUNCTION Data_Type_Conversion /end SUB_FUNCTION /begin DEF_CHARACTERISTIC /end DEF_CHARACTERISTIC /begin IN_MEASUREMENT /end IN_MEASUREMENT /begin OUT_MEASUREMENT /end OUT_MEASUREMENT /end FUNCTION
/begin FUNCTION MirrorCtrl "" /begin SUB_FUNCTION /end SUB_FUNCTION /begin DEF_CHARACTERISTIC /end DEF_CHARACTERISTIC /begin IN_MEASUREMENT /end IN_MEASUREMENT /begin OUT_MEASUREMENT /end OUT_MEASUREMENT /end FUNCTION
/begin FUNCTION MirrorDefog "" /begin SUB_FUNCTION Data_Type_Conversion /end SUB_FUNCTION /begin DEF_CHARACTERISTIC /end DEF_CHARACTERISTIC /begin IN_MEASUREMENT /end IN_MEASUREMENT /begin OUT_MEASUREMENT /end OUT_MEASUREMENT /end FUNCTION
/begin FUNCTION PosLamp "" /begin SUB_FUNCTION Data_Type_Conversion /end SUB_FUNCTION /begin DEF_CHARACTERISTIC /end DEF_CHARACTERISTIC /begin IN_MEASUREMENT /end IN_MEASUREMENT /begin OUT_MEASUREMENT /end OUT_MEASUREMENT /end FUNCTION
/begin FUNCTION PsDoorSW "" /begin SUB_FUNCTION Data_Type_Conversion /end SUB_FUNCTION /begin DEF_CHARACTERISTIC /end DEF_CHARACTERISTIC /begin IN_MEASUREMENT /end IN_MEASUREMENT /begin OUT_MEASUREMENT /end OUT_MEASUREMENT /end FUNCTION
/begin FUNCTION RBSD "" /begin SUB_FUNCTION Data_Type_Conversion /end SUB_FUNCTION /begin DEF_CHARACTERISTIC /end DEF_CHARACTERISTIC /begin IN_MEASUREMENT /end IN_MEASUREMENT /begin OUT_MEASUREMENT /end OUT_MEASUREMENT /end FUNCTION
/begin FUNCTION RDRL "" /begin SUB_FUNCTION Data_Type_Conversion /end SUB_FUNCTION /begin DEF_CHARACTERISTIC /end DEF_CHARACTERISTIC /begin IN_MEASUREMENT /end IN_MEASUREMENT /begin OUT_MEASUREMENT /end OUT_MEASUREMENT /end FUNCTION
/begin FUNCTION RLDoorSW "" /begin SUB_FUNCTION Data_Type_Conversion /end SUB_FUNCTION /begin DEF_CHARACTERISTIC /end DEF_CHARACTERISTIC /begin IN_MEASUREMENT /end IN_MEASUREMENT /begin OUT_MEASUREMENT /end OUT_MEASUREMENT /end FUNCTION
/begin FUNCTION RRDoorSW "" /begin SUB_FUNCTION Data_Type_Conversion /end SUB_FUNCTION /begin DEF_CHARACTERISTIC /end DEF_CHARACTERISTIC /begin IN_MEASUREMENT /end IN_MEASUREMENT /begin OUT_MEASUREMENT /end OUT_MEASUREMENT /end FUNCTION
/begin FUNCTION RTurnLP "" /begin SUB_FUNCTION Data_Type_Conversion /end SUB_FUNCTION /begin DEF_CHARACTERISTIC /end DEF_CHARACTERISTIC /begin IN_MEASUREMENT /end IN_MEASUREMENT /begin OUT_MEASUREMENT /end OUT_MEASUREMENT /end FUNCTION
/begin FUNCTION ReverseLamp "" /begin SUB_FUNCTION Data_Type_Conversion /end SUB_FUNCTION /begin DEF_CHARACTERISTIC /end DEF_CHARACTERISTIC /begin IN_MEASUREMENT /end IN_MEASUREMENT /begin OUT_MEASUREMENT /end OUT_MEASUREMENT /end FUNCTION
/begin FUNCTION RoomLampH "" /begin SUB_FUNCTION Data_Type_Conversion /end SUB_FUNCTION /begin DEF_CHARACTERISTIC /end DEF_CHARACTERISTIC /begin IN_MEASUREMENT /end IN_MEASUREMENT /begin OUT_MEASUREMENT /end OUT_MEASUREMENT /end FUNCTION
/begin FUNCTION RoomLampL "" /begin SUB_FUNCTION Data_Type_Conversion /end SUB_FUNCTION /begin DEF_CHARACTERISTIC /end DEF_CHARACTERISTIC /begin IN_MEASUREMENT /end IN_MEASUREMENT /begin OUT_MEASUREMENT /end OUT_MEASUREMENT /end FUNCTION
/begin FUNCTION RrChargingDoorCtrl "" /begin SUB_FUNCTION /end SUB_FUNCTION /begin DEF_CHARACTERISTIC /end DEF_CHARACTERISTIC /begin IN_MEASUREMENT /end IN_MEASUREMENT /begin OUT_MEASUREMENT /end OUT_MEASUREMENT /end FUNCTION
/begin FUNCTION RrDefog "" /begin SUB_FUNCTION Data_Type_Conversion /end SUB_FUNCTION /begin DEF_CHARACTERISTIC /end DEF_CHARACTERISTIC /begin IN_MEASUREMENT /end IN_MEASUREMENT /begin OUT_MEASUREMENT /end OUT_MEASUREMENT /end FUNCTION
/begin FUNCTION RrFogLamp "" /begin SUB_FUNCTION Data_Type_Conversion /end SUB_FUNCTION /begin DEF_CHARACTERISTIC /end DEF_CHARACTERISTIC /begin IN_MEASUREMENT /end IN_MEASUREMENT /begin OUT_MEASUREMENT /end OUT_MEASUREMENT /end FUNCTION
/begin FUNCTION RrWiper "" /begin SUB_FUNCTION Data_Type_Conversion /end SUB_FUNCTION /begin DEF_CHARACTERISTIC /end DEF_CHARACTERISTIC /begin IN_MEASUREMENT /end IN_MEASUREMENT /begin OUT_MEASUREMENT /end OUT_MEASUREMENT /end FUNCTION
/begin FUNCTION TailgateHDSW "" /begin SUB_FUNCTION Data_Type_Conversion /end SUB_FUNCTION /begin DEF_CHARACTERISTIC /end DEF_CHARACTERISTIC /begin IN_MEASUREMENT /end IN_MEASUREMENT /begin OUT_MEASUREMENT /end OUT_MEASUREMENT /end FUNCTION
/begin FUNCTION TailgateRemote "" /begin SUB_FUNCTION /end SUB_FUNCTION /begin DEF_CHARACTERISTIC /end DEF_CHARACTERISTIC /begin IN_MEASUREMENT /end IN_MEASUREMENT /begin OUT_MEASUREMENT /end OUT_MEASUREMENT /end FUNCTION
/begin FUNCTION TailgateSW "" /begin SUB_FUNCTION Data_Type_Conversion /end SUB_FUNCTION /begin DEF_CHARACTERISTIC /end DEF_CHARACTERISTIC /begin IN_MEASUREMENT /end IN_MEASUREMENT /begin OUT_MEASUREMENT /end OUT_MEASUREMENT /end FUNCTION
/begin FUNCTION TrunkRel "" /begin SUB_FUNCTION Data_Type_Conversion /end SUB_FUNCTION /begin DEF_CHARACTERISTIC /end DEF_CHARACTERISTIC /begin IN_MEASUREMENT /end IN_MEASUREMENT /begin OUT_MEASUREMENT /end OUT_MEASUREMENT /end FUNCTION
/begin FUNCTION WasherCtrl "" /begin SUB_FUNCTION /end SUB_FUNCTION /begin DEF_CHARACTERISTIC /end DEF_CHARACTERISTIC /begin IN_MEASUREMENT /end IN_MEASUREMENT /begin OUT_MEASUREMENT /end OUT_MEASUREMENT /end FUNCTION
/begin FUNCTION WiperFixMode "" /begin SUB_FUNCTION Data_Type_Conversion /end SUB_FUNCTION /begin DEF_CHARACTERISTIC /end DEF_CHARACTERISTIC /begin IN_MEASUREMENT /end IN_MEASUREMENT /begin OUT_MEASUREMENT /end OUT_MEASUREMENT /end FUNCTION
/begin FUNCTION bus_creator "" /begin DEF_CHARACTERISTIC /end DEF_CHARACTERISTIC /begin IN_MEASUREMENT /end IN_MEASUREMENT /begin OUT_MEASUREMENT /end OUT_MEASUREMENT /end FUNCTION
/begin FUNCTION BatteryMode "" /begin SUB_FUNCTION /end SUB_FUNCTION /begin DEF_CHARACTERISTIC /end DEF_CHARACTERISTIC /begin IN_MEASUREMENT /end IN_MEASUREMENT /begin OUT_MEASUREMENT /end OUT_MEASUREMENT /end FUNCTION
/begin FUNCTION FrCoolantflow "" /begin SUB_FUNCTION convert_out Data_Type_Conversion /end SUB_FUNCTION /begin DEF_CHARACTERISTIC /end DEF_CHARACTERISTIC /begin IN_MEASUREMENT /end IN_MEASUREMENT /begin OUT_MEASUREMENT /end OUT_MEASUREMENT /end FUNCTION
/begin FUNCTION FrCoolanttemp "" /begin SUB_FUNCTION convert_out Data_Type_Conversion /end SUB_FUNCTION /begin DEF_CHARACTERISTIC /end DEF_CHARACTERISTIC /begin IN_MEASUREMENT /end IN_MEASUREMENT /begin OUT_MEASUREMENT /end OUT_MEASUREMENT /end FUNCTION
/begin FUNCTION RrCoolantflow "" /begin SUB_FUNCTION convert_out Data_Type_Conversion /end SUB_FUNCTION /begin DEF_CHARACTERISTIC /end DEF_CHARACTERISTIC /begin IN_MEASUREMENT /end IN_MEASUREMENT /begin OUT_MEASUREMENT /end OUT_MEASUREMENT /end FUNCTION
/begin FUNCTION RrCoolanttemp "" /begin SUB_FUNCTION convert_out Data_Type_Conversion /end SUB_FUNCTION /begin DEF_CHARACTERISTIC /end DEF_CHARACTERISTIC /begin IN_MEASUREMENT /end IN_MEASUREMENT /begin OUT_MEASUREMENT /end OUT_MEASUREMENT /end FUNCTION
/begin FUNCTION sigCbnPTCPwrAct "" /begin SUB_FUNCTION convert_out Data_Type_Conversion /end SUB_FUNCTION /begin DEF_CHARACTERISTIC /end DEF_CHARACTERISTIC /begin IN_MEASUREMENT /end IN_MEASUREMENT /begin OUT_MEASUREMENT /end OUT_MEASUREMENT /end FUNCTION
/begin FUNCTION bus_creator "" /begin DEF_CHARACTERISTIC /end DEF_CHARACTERISTIC /begin IN_MEASUREMENT /end IN_MEASUREMENT /begin OUT_MEASUREMENT /end OUT_MEASUREMENT /end FUNCTION
/begin FUNCTION FDCV2LOBCExtrV2LCmd "" /begin SUB_FUNCTION /end SUB_FUNCTION /begin DEF_CHARACTERISTIC /end DEF_CHARACTERISTIC /begin IN_MEASUREMENT /end IN_MEASUREMENT /begin OUT_MEASUREMENT /end OUT_MEASUREMENT /end FUNCTION
/begin FUNCTION FDCV2LOBCIntrV2LCmd "" /begin SUB_FUNCTION /end SUB_FUNCTION /begin DEF_CHARACTERISTIC /end DEF_CHARACTERISTIC /begin IN_MEASUREMENT /end IN_MEASUREMENT /begin OUT_MEASUREMENT /end OUT_MEASUREMENT /end FUNCTION
/begin FUNCTION ReqOBCV2LEna "" /begin SUB_FUNCTION /end SUB_FUNCTION /begin DEF_CHARACTERISTIC /end DEF_CHARACTERISTIC /begin IN_MEASUREMENT /end IN_MEASUREMENT /begin OUT_MEASUREMENT /end OUT_MEASUREMENT /end FUNCTION
/begin FUNCTION ReqV2LIVIPopup "" /begin SUB_FUNCTION /end SUB_FUNCTION /begin DEF_CHARACTERISTIC /end DEF_CHARACTERISTIC /begin IN_MEASUREMENT /end IN_MEASUREMENT /begin OUT_MEASUREMENT /end OUT_MEASUREMENT /end FUNCTION
/begin FUNCTION ReqV2LSwOn "" /begin SUB_FUNCTION /end SUB_FUNCTION /begin DEF_CHARACTERISTIC /end DEF_CHARACTERISTIC /begin IN_MEASUREMENT /end IN_MEASUREMENT /begin OUT_MEASUREMENT /end OUT_MEASUREMENT /end FUNCTION
/begin FUNCTION bus_creator "" /begin DEF_CHARACTERISTIC /end DEF_CHARACTERISTIC /begin IN_MEASUREMENT /end IN_MEASUREMENT /begin OUT_MEASUREMENT /end OUT_MEASUREMENT /end FUNCTION
/begin FUNCTION EVCCAplusPwrUpReq "" /begin SUB_FUNCTION Data_Type_Conversion /end SUB_FUNCTION /begin DEF_CHARACTERISTIC /end DEF_CHARACTERISTIC /begin IN_MEASUREMENT /end IN_MEASUREMENT /begin OUT_MEASUREMENT /end OUT_MEASUREMENT /end FUNCTION
/begin FUNCTION FDADC12VDet "" /begin SUB_FUNCTION convert_out Data_Type_Conversion /end SUB_FUNCTION /begin DEF_CHARACTERISTIC /end DEF_CHARACTERISTIC /begin IN_MEASUREMENT /end IN_MEASUREMENT /begin OUT_MEASUREMENT /end OUT_MEASUREMENT /end FUNCTION
/begin FUNCTION FDADC12VDetAvg "" /begin SUB_FUNCTION convert_out Data_Type_Conversion /end SUB_FUNCTION /begin DEF_CHARACTERISTIC /end DEF_CHARACTERISTIC /begin IN_MEASUREMENT /end IN_MEASUREMENT /begin OUT_MEASUREMENT /end OUT_MEASUREMENT /end FUNCTION
/begin FUNCTION FDCSYSPmicBootPath "" /begin SUB_FUNCTION /end SUB_FUNCTION /begin DEF_CHARACTERISTIC /end DEF_CHARACTERISTIC /begin IN_MEASUREMENT /end IN_MEASUREMENT /begin OUT_MEASUREMENT /end OUT_MEASUREMENT /end FUNCTION
/begin FUNCTION FDCVCUActMaxSlideRateSta "" /begin SUB_FUNCTION convert_out Data_Type_Conversion /end SUB_FUNCTION /begin DEF_CHARACTERISTIC /end DEF_CHARACTERISTIC /begin IN_MEASUREMENT /end IN_MEASUREMENT /begin OUT_MEASUREMENT /end OUT_MEASUREMENT /end FUNCTION
/begin FUNCTION FDCVCUAllowMovThdOTASta "" /begin SUB_FUNCTION /end SUB_FUNCTION /begin DEF_CHARACTERISTIC /end DEF_CHARACTERISTIC /begin IN_MEASUREMENT /end IN_MEASUREMENT /begin OUT_MEASUREMENT /end OUT_MEASUREMENT /end FUNCTION
/begin FUNCTION FDCVCUBOSEnableSta "" /begin SUB_FUNCTION Data_Type_Conversion /end SUB_FUNCTION /begin DEF_CHARACTERISTIC /end DEF_CHARACTERISTIC /begin IN_MEASUREMENT /end IN_MEASUREMENT /begin OUT_MEASUREMENT /end OUT_MEASUREMENT /end FUNCTION
/begin FUNCTION FDCVCUBrakeSigMatrixSta "" /begin SUB_FUNCTION /end SUB_FUNCTION /begin DEF_CHARACTERISTIC /end DEF_CHARACTERISTIC /begin IN_MEASUREMENT /end IN_MEASUREMENT /begin OUT_MEASUREMENT /end OUT_MEASUREMENT /end FUNCTION
/begin FUNCTION FDCVCUBrkPedalPosStaSta "" /begin SUB_FUNCTION /end SUB_FUNCTION /begin DEF_CHARACTERISTIC /end DEF_CHARACTERISTIC /begin IN_MEASUREMENT /end IN_MEASUREMENT /begin OUT_MEASUREMENT /end OUT_MEASUREMENT /end FUNCTION
/begin FUNCTION FDCVCUCANBrkSW2StaSta "" /begin SUB_FUNCTION /end SUB_FUNCTION /begin DEF_CHARACTERISTIC /end DEF_CHARACTERISTIC /begin IN_MEASUREMENT /end IN_MEASUREMENT /begin OUT_MEASUREMENT /end OUT_MEASUREMENT /end FUNCTION
/begin FUNCTION FDCVCUDTCCarouselSta "" /begin SUB_FUNCTION /end SUB_FUNCTION /begin DEF_CHARACTERISTIC /end DEF_CHARACTERISTIC /begin IN_MEASUREMENT /end IN_MEASUREMENT /begin OUT_MEASUREMENT /end OUT_MEASUREMENT /end FUNCTION
/begin FUNCTION FDCVCUEAPS1MinSta "" /begin SUB_FUNCTION convert_out Data_Type_Conversion /end SUB_FUNCTION /begin DEF_CHARACTERISTIC /end DEF_CHARACTERISTIC /begin IN_MEASUREMENT /end IN_MEASUREMENT /begin OUT_MEASUREMENT /end OUT_MEASUREMENT /end FUNCTION
/begin FUNCTION FDCVCUEAPS1RawSta "" /begin SUB_FUNCTION convert_out Data_Type_Conversion /end SUB_FUNCTION /begin DEF_CHARACTERISTIC /end DEF_CHARACTERISTIC /begin IN_MEASUREMENT /end IN_MEASUREMENT /begin OUT_MEASUREMENT /end OUT_MEASUREMENT /end FUNCTION
/begin FUNCTION FDCVCUEAPS2MinSta "" /begin SUB_FUNCTION convert_out Data_Type_Conversion /end SUB_FUNCTION /begin DEF_CHARACTERISTIC /end DEF_CHARACTERISTIC /begin IN_MEASUREMENT /end IN_MEASUREMENT /begin OUT_MEASUREMENT /end OUT_MEASUREMENT /end FUNCTION
/begin FUNCTION FDCVCUEAPS2RawSta "" /begin SUB_FUNCTION convert_out Data_Type_Conversion /end SUB_FUNCTION /begin DEF_CHARACTERISTIC /end DEF_CHARACTERISTIC /begin IN_MEASUREMENT /end IN_MEASUREMENT /begin OUT_MEASUREMENT /end OUT_MEASUREMENT /end FUNCTION
/begin FUNCTION FDCVCUForcePCmd "" /begin SUB_FUNCTION Data_Type_Conversion /end SUB_FUNCTION /begin DEF_CHARACTERISTIC /end DEF_CHARACTERISTIC /begin IN_MEASUREMENT /end IN_MEASUREMENT /begin OUT_MEASUREMENT /end OUT_MEASUREMENT /end FUNCTION
/begin FUNCTION FDCVCUFrFirstOrderInpTs "" /begin SUB_FUNCTION convert_out Data_Type_Conversion /end SUB_FUNCTION /begin DEF_CHARACTERISTIC /end DEF_CHARACTERISTIC /begin IN_MEASUREMENT /end IN_MEASUREMENT /begin OUT_MEASUREMENT /end OUT_MEASUREMENT /end FUNCTION
/begin FUNCTION FDCVCUFrRateLimitDecSta "" /begin SUB_FUNCTION convert_out Data_Type_Conversion /end SUB_FUNCTION /begin DEF_CHARACTERISTIC /end DEF_CHARACTERISTIC /begin IN_MEASUREMENT /end IN_MEASUREMENT /begin OUT_MEASUREMENT /end OUT_MEASUREMENT /end FUNCTION
/begin FUNCTION FDCVCUFrRateLimitIncSta "" /begin SUB_FUNCTION convert_out Data_Type_Conversion /end SUB_FUNCTION /begin DEF_CHARACTERISTIC /end DEF_CHARACTERISTIC /begin IN_MEASUREMENT /end IN_MEASUREMENT /begin OUT_MEASUREMENT /end OUT_MEASUREMENT /end FUNCTION
/begin FUNCTION FDCVCULVChrgFreqCntSta "" /begin SUB_FUNCTION Data_Type_Conversion /end SUB_FUNCTION /begin DEF_CHARACTERISTIC /end DEF_CHARACTERISTIC /begin IN_MEASUREMENT /end IN_MEASUREMENT /begin OUT_MEASUREMENT /end OUT_MEASUREMENT /end FUNCTION
/begin FUNCTION FDCVCULVStaDropQukCntSta "" /begin SUB_FUNCTION /end SUB_FUNCTION /begin DEF_CHARACTERISTIC /end DEF_CHARACTERISTIC /begin IN_MEASUREMENT /end IN_MEASUREMENT /begin OUT_MEASUREMENT /end OUT_MEASUREMENT /end FUNCTION
/begin FUNCTION FDCVCULowIdleAccPedalSta "" /begin SUB_FUNCTION Data_Type_Conversion /end SUB_FUNCTION /begin DEF_CHARACTERISTIC /end DEF_CHARACTERISTIC /begin IN_MEASUREMENT /end IN_MEASUREMENT /begin OUT_MEASUREMENT /end OUT_MEASUREMENT /end FUNCTION
/begin FUNCTION FDCVCUOTAPwrReqOFFChkSta "" /begin SUB_FUNCTION /end SUB_FUNCTION /begin DEF_CHARACTERISTIC /end DEF_CHARACTERISTIC /begin IN_MEASUREMENT /end IN_MEASUREMENT /begin OUT_MEASUREMENT /end OUT_MEASUREMENT /end FUNCTION
/begin FUNCTION FDCVCUOTAPwrReqStdChkSta "" /begin SUB_FUNCTION /end SUB_FUNCTION /begin DEF_CHARACTERISTIC /end DEF_CHARACTERISTIC /begin IN_MEASUREMENT /end IN_MEASUREMENT /begin OUT_MEASUREMENT /end OUT_MEASUREMENT /end FUNCTION
/begin FUNCTION FDCVCUPwrReqOTASta "" /begin SUB_FUNCTION /end SUB_FUNCTION /begin DEF_CHARACTERISTIC /end DEF_CHARACTERISTIC /begin IN_MEASUREMENT /end IN_MEASUREMENT /begin OUT_MEASUREMENT /end OUT_MEASUREMENT /end FUNCTION
/begin FUNCTION FDCVCURWDRDCActiveSta "" /begin SUB_FUNCTION /end SUB_FUNCTION /begin DEF_CHARACTERISTIC /end DEF_CHARACTERISTIC /begin IN_MEASUREMENT /end IN_MEASUREMENT /begin OUT_MEASUREMENT /end OUT_MEASUREMENT /end FUNCTION
/begin FUNCTION FDCVCURegenTqLimitEnSta "" /begin SUB_FUNCTION Data_Type_Conversion /end SUB_FUNCTION /begin DEF_CHARACTERISTIC /end DEF_CHARACTERISTIC /begin IN_MEASUREMENT /end IN_MEASUREMENT /begin OUT_MEASUREMENT /end OUT_MEASUREMENT /end FUNCTION
/begin FUNCTION FDCVCURrFirstOrderInpTs "" /begin SUB_FUNCTION convert_out Data_Type_Conversion /end SUB_FUNCTION /begin DEF_CHARACTERISTIC /end DEF_CHARACTERISTIC /begin IN_MEASUREMENT /end IN_MEASUREMENT /begin OUT_MEASUREMENT /end OUT_MEASUREMENT /end FUNCTION
/begin FUNCTION FDCVCURrRateLimitDecSta "" /begin SUB_FUNCTION convert_out Data_Type_Conversion /end SUB_FUNCTION /begin DEF_CHARACTERISTIC /end DEF_CHARACTERISTIC /begin IN_MEASUREMENT /end IN_MEASUREMENT /begin OUT_MEASUREMENT /end OUT_MEASUREMENT /end FUNCTION
/begin FUNCTION FDCVCURrRateLimitIncSta "" /begin SUB_FUNCTION convert_out Data_Type_Conversion /end SUB_FUNCTION /begin DEF_CHARACTERISTIC /end DEF_CHARACTERISTIC /begin IN_MEASUREMENT /end IN_MEASUREMENT /begin OUT_MEASUREMENT /end OUT_MEASUREMENT /end FUNCTION
/begin FUNCTION FDCVCUSlideRegenLimTqSta "" /begin SUB_FUNCTION convert_out Data_Type_Conversion /end SUB_FUNCTION /begin DEF_CHARACTERISTIC /end DEF_CHARACTERISTIC /begin IN_MEASUREMENT /end IN_MEASUREMENT /begin OUT_MEASUREMENT /end OUT_MEASUREMENT /end FUNCTION
/begin FUNCTION FDCVCUVehActSpdSta "" /begin SUB_FUNCTION convert_out Data_Type_Conversion /end SUB_FUNCTION /begin DEF_CHARACTERISTIC /end DEF_CHARACTERISTIC /begin IN_MEASUREMENT /end IN_MEASUREMENT /begin OUT_MEASUREMENT /end OUT_MEASUREMENT /end FUNCTION
/begin FUNCTION FDCVCUVehMalfunLevelSta "" /begin SUB_FUNCTION /end SUB_FUNCTION /begin DEF_CHARACTERISTIC /end DEF_CHARACTERISTIC /begin IN_MEASUREMENT /end IN_MEASUREMENT /begin OUT_MEASUREMENT /end OUT_MEASUREMENT /end FUNCTION
/begin FUNCTION FDCVMCActStESCYawSta "" /begin SUB_FUNCTION convert_out Data_Type_Conversion /end SUB_FUNCTION /begin DEF_CHARACTERISTIC /end DEF_CHARACTERISTIC /begin IN_MEASUREMENT /end IN_MEASUREMENT /begin OUT_MEASUREMENT /end OUT_MEASUREMENT /end FUNCTION
/begin FUNCTION FDCVMCLongAccSta "" /begin SUB_FUNCTION convert_out Data_Type_Conversion /end SUB_FUNCTION /begin DEF_CHARACTERISTIC /end DEF_CHARACTERISTIC /begin IN_MEASUREMENT /end IN_MEASUREMENT /begin OUT_MEASUREMENT /end OUT_MEASUREMENT /end FUNCTION
/begin FUNCTION FrTqSource "" /begin SUB_FUNCTION /end SUB_FUNCTION /begin DEF_CHARACTERISTIC /end DEF_CHARACTERISTIC /begin IN_MEASUREMENT /end IN_MEASUREMENT /begin OUT_MEASUREMENT /end OUT_MEASUREMENT /end FUNCTION
/begin FUNCTION HVRlyOpFail "" /begin SUB_FUNCTION Data_Type_Conversion /end SUB_FUNCTION /begin DEF_CHARACTERISTIC /end DEF_CHARACTERISTIC /begin IN_MEASUREMENT /end IN_MEASUREMENT /begin OUT_MEASUREMENT /end OUT_MEASUREMENT /end FUNCTION
/begin FUNCTION HVTHCMSysAvail "" /begin SUB_FUNCTION /end SUB_FUNCTION /begin DEF_CHARACTERISTIC /end DEF_CHARACTERISTIC /begin IN_MEASUREMENT /end IN_MEASUREMENT /begin OUT_MEASUREMENT /end OUT_MEASUREMENT /end FUNCTION
/begin FUNCTION LVBattChrgtimeAct "" /begin SUB_FUNCTION Data_Type_Conversion /end SUB_FUNCTION /begin DEF_CHARACTERISTIC /end DEF_CHARACTERISTIC /begin IN_MEASUREMENT /end IN_MEASUREMENT /begin OUT_MEASUREMENT /end OUT_MEASUREMENT /end FUNCTION
/begin FUNCTION LVBattVoltSta "" /begin SUB_FUNCTION /end SUB_FUNCTION /begin DEF_CHARACTERISTIC /end DEF_CHARACTERISTIC /begin IN_MEASUREMENT /end IN_MEASUREMENT /begin OUT_MEASUREMENT /end OUT_MEASUREMENT /end FUNCTION
/begin FUNCTION LVChrgHoldTAct "" /begin SUB_FUNCTION Data_Type_Conversion /end SUB_FUNCTION /begin DEF_CHARACTERISTIC /end DEF_CHARACTERISTIC /begin IN_MEASUREMENT /end IN_MEASUREMENT /begin OUT_MEASUREMENT /end OUT_MEASUREMENT /end FUNCTION
/begin FUNCTION LVSilentChrgLv "" /begin SUB_FUNCTION /end SUB_FUNCTION /begin DEF_CHARACTERISTIC /end DEF_CHARACTERISTIC /begin IN_MEASUREMENT /end IN_MEASUREMENT /begin OUT_MEASUREMENT /end OUT_MEASUREMENT /end FUNCTION
/begin FUNCTION LVSilentChrgReq "" /begin SUB_FUNCTION Data_Type_Conversion /end SUB_FUNCTION /begin DEF_CHARACTERISTIC /end DEF_CHARACTERISTIC /begin IN_MEASUREMENT /end IN_MEASUREMENT /begin OUT_MEASUREMENT /end OUT_MEASUREMENT /end FUNCTION
/begin FUNCTION LVSilentChrgSta "" /begin SUB_FUNCTION /end SUB_FUNCTION /begin DEF_CHARACTERISTIC /end DEF_CHARACTERISTIC /begin IN_MEASUREMENT /end IN_MEASUREMENT /begin OUT_MEASUREMENT /end OUT_MEASUREMENT /end FUNCTION
/begin FUNCTION MCUActDisFail "" /begin SUB_FUNCTION Data_Type_Conversion /end SUB_FUNCTION /begin DEF_CHARACTERISTIC /end DEF_CHARACTERISTIC /begin IN_MEASUREMENT /end IN_MEASUREMENT /begin OUT_MEASUREMENT /end OUT_MEASUREMENT /end FUNCTION
/begin FUNCTION PMMAllowECUSleep "" /begin SUB_FUNCTION Data_Type_Conversion /end SUB_FUNCTION /begin DEF_CHARACTERISTIC /end DEF_CHARACTERISTIC /begin IN_MEASUREMENT /end IN_MEASUREMENT /begin OUT_MEASUREMENT /end OUT_MEASUREMENT /end FUNCTION
/begin FUNCTION PmicBootReason "" /begin SUB_FUNCTION /end SUB_FUNCTION /begin DEF_CHARACTERISTIC /end DEF_CHARACTERISTIC /begin IN_MEASUREMENT /end IN_MEASUREMENT /begin OUT_MEASUREMENT /end OUT_MEASUREMENT /end FUNCTION
/begin FUNCTION PowerDownFault "" /begin SUB_FUNCTION /end SUB_FUNCTION /begin DEF_CHARACTERISTIC /end DEF_CHARACTERISTIC /begin IN_MEASUREMENT /end IN_MEASUREMENT /begin OUT_MEASUREMENT /end OUT_MEASUREMENT /end FUNCTION
/begin FUNCTION PowerDownState "" /begin SUB_FUNCTION /end SUB_FUNCTION /begin DEF_CHARACTERISTIC /end DEF_CHARACTERISTIC /begin IN_MEASUREMENT /end IN_MEASUREMENT /begin OUT_MEASUREMENT /end OUT_MEASUREMENT /end FUNCTION
/begin FUNCTION PowerUpFault "" /begin SUB_FUNCTION /end SUB_FUNCTION /begin DEF_CHARACTERISTIC /end DEF_CHARACTERISTIC /begin IN_MEASUREMENT /end IN_MEASUREMENT /begin OUT_MEASUREMENT /end OUT_MEASUREMENT /end FUNCTION
/begin FUNCTION PowerUpState "" /begin SUB_FUNCTION /end SUB_FUNCTION /begin DEF_CHARACTERISTIC /end DEF_CHARACTERISTIC /begin IN_MEASUREMENT /end IN_MEASUREMENT /begin OUT_MEASUREMENT /end OUT_MEASUREMENT /end FUNCTION
/begin FUNCTION PwrDownReq "" /begin SUB_FUNCTION /end SUB_FUNCTION /begin DEF_CHARACTERISTIC /end DEF_CHARACTERISTIC /begin IN_MEASUREMENT /end IN_MEASUREMENT /begin OUT_MEASUREMENT /end OUT_MEASUREMENT /end FUNCTION
/begin FUNCTION PwrStaConstraint "" /begin SUB_FUNCTION /end SUB_FUNCTION /begin DEF_CHARACTERISTIC /end DEF_CHARACTERISTIC /begin IN_MEASUREMENT /end IN_MEASUREMENT /begin OUT_MEASUREMENT /end OUT_MEASUREMENT /end FUNCTION
/begin FUNCTION PwrStaONTOIVIPopReq "" /begin SUB_FUNCTION Data_Type_Conversion /end SUB_FUNCTION /begin DEF_CHARACTERISTIC /end DEF_CHARACTERISTIC /begin IN_MEASUREMENT /end IN_MEASUREMENT /begin OUT_MEASUREMENT /end OUT_MEASUREMENT /end FUNCTION
/begin FUNCTION PwrStaONTOIVIPopT "" /begin SUB_FUNCTION Data_Type_Conversion /end SUB_FUNCTION /begin DEF_CHARACTERISTIC /end DEF_CHARACTERISTIC /begin IN_MEASUREMENT /end IN_MEASUREMENT /begin OUT_MEASUREMENT /end OUT_MEASUREMENT /end FUNCTION
/begin FUNCTION PwrStaSelect "" /begin SUB_FUNCTION /end SUB_FUNCTION /begin DEF_CHARACTERISTIC /end DEF_CHARACTERISTIC /begin IN_MEASUREMENT /end IN_MEASUREMENT /begin OUT_MEASUREMENT /end OUT_MEASUREMENT /end FUNCTION
/begin FUNCTION PwrStaTOSta "" /begin SUB_FUNCTION /end SUB_FUNCTION /begin DEF_CHARACTERISTIC /end DEF_CHARACTERISTIC /begin IN_MEASUREMENT /end IN_MEASUREMENT /begin OUT_MEASUREMENT /end OUT_MEASUREMENT /end FUNCTION
/begin FUNCTION PwrUpReq "" /begin SUB_FUNCTION /end SUB_FUNCTION /begin DEF_CHARACTERISTIC /end DEF_CHARACTERISTIC /begin IN_MEASUREMENT /end IN_MEASUREMENT /begin OUT_MEASUREMENT /end OUT_MEASUREMENT /end FUNCTION
/begin FUNCTION RrTqSource "" /begin SUB_FUNCTION /end SUB_FUNCTION /begin DEF_CHARACTERISTIC /end DEF_CHARACTERISTIC /begin IN_MEASUREMENT /end IN_MEASUREMENT /begin OUT_MEASUREMENT /end OUT_MEASUREMENT /end FUNCTION
/begin FUNCTION SchedChgTOSta "" /begin SUB_FUNCTION /end SUB_FUNCTION /begin DEF_CHARACTERISTIC /end DEF_CHARACTERISTIC /begin IN_MEASUREMENT /end IN_MEASUREMENT /begin OUT_MEASUREMENT /end OUT_MEASUREMENT /end FUNCTION
/begin FUNCTION SilentChkAllowSleep "" /begin SUB_FUNCTION Data_Type_Conversion /end SUB_FUNCTION /begin DEF_CHARACTERISTIC /end DEF_CHARACTERISTIC /begin IN_MEASUREMENT /end IN_MEASUREMENT /begin OUT_MEASUREMENT /end OUT_MEASUREMENT /end FUNCTION
/begin FUNCTION Subsystem ""
 /begin SUB_FUNCTION Shift_Arithmetic6 Shift_Arithmetic7 Shift_Arithmetic8 Gain Saturation Saturation1 Saturation2 Saturation3 /end SUB_FUNCTION
 /begin DEF_CHARACTERISTIC /end DEF_CHARACTERISTIC
 /begin IN_MEASUREMENT /end IN_MEASUREMENT
 /begin OUT_MEASUREMENT /end OUT_MEASUREMENT
/end FUNCTION
/begin FUNCTION SysAllowReadySta "" /begin SUB_FUNCTION Data_Type_Conversion /end SUB_FUNCTION /begin DEF_CHARACTERISTIC /end DEF_CHARACTERISTIC /begin IN_MEASUREMENT /end IN_MEASUREMENT /begin OUT_MEASUREMENT /end OUT_MEASUREMENT /end FUNCTION
/begin FUNCTION SysPwrSta "" /begin SUB_FUNCTION /end SUB_FUNCTION /begin DEF_CHARACTERISTIC /end DEF_CHARACTERISTIC /begin IN_MEASUREMENT /end IN_MEASUREMENT /begin OUT_MEASUREMENT /end OUT_MEASUREMENT /end FUNCTION
/begin FUNCTION TCountSta "" /begin SUB_FUNCTION /end SUB_FUNCTION /begin DEF_CHARACTERISTIC /end DEF_CHARACTERISTIC /begin IN_MEASUREMENT /end IN_MEASUREMENT /begin OUT_MEASUREMENT /end OUT_MEASUREMENT /end FUNCTION
/begin FUNCTION TimerAllowSleep "" /begin SUB_FUNCTION Data_Type_Conversion /end SUB_FUNCTION /begin DEF_CHARACTERISTIC /end DEF_CHARACTERISTIC /begin IN_MEASUREMENT /end IN_MEASUREMENT /begin OUT_MEASUREMENT /end OUT_MEASUREMENT /end FUNCTION
/begin FUNCTION VCUBrkSWSta "" /begin SUB_FUNCTION /end SUB_FUNCTION /begin DEF_CHARACTERISTIC /end DEF_CHARACTERISTIC /begin IN_MEASUREMENT /end IN_MEASUREMENT /begin OUT_MEASUREMENT /end OUT_MEASUREMENT /end FUNCTION
/begin FUNCTION VCUFLDoorSta "" /begin SUB_FUNCTION Data_Type_Conversion /end SUB_FUNCTION /begin DEF_CHARACTERISTIC /end DEF_CHARACTERISTIC /begin IN_MEASUREMENT /end IN_MEASUREMENT /begin OUT_MEASUREMENT /end OUT_MEASUREMENT /end FUNCTION
/begin FUNCTION VCUFRDoorSta "" /begin SUB_FUNCTION Data_Type_Conversion /end SUB_FUNCTION /begin DEF_CHARACTERISTIC /end DEF_CHARACTERISTIC /begin IN_MEASUREMENT /end IN_MEASUREMENT /begin OUT_MEASUREMENT /end OUT_MEASUREMENT /end FUNCTION
/begin FUNCTION VCURLDoorSta "" /begin SUB_FUNCTION Data_Type_Conversion /end SUB_FUNCTION /begin DEF_CHARACTERISTIC /end DEF_CHARACTERISTIC /begin IN_MEASUREMENT /end IN_MEASUREMENT /begin OUT_MEASUREMENT /end OUT_MEASUREMENT /end FUNCTION
/begin FUNCTION VCURRDoorSta "" /begin SUB_FUNCTION Data_Type_Conversion /end SUB_FUNCTION /begin DEF_CHARACTERISTIC /end DEF_CHARACTERISTIC /begin IN_MEASUREMENT /end IN_MEASUREMENT /begin OUT_MEASUREMENT /end OUT_MEASUREMENT /end FUNCTION
/begin FUNCTION VehHVPwrAvail4THCM "" /begin SUB_FUNCTION convert_out Data_Type_Conversion /end SUB_FUNCTION /begin DEF_CHARACTERISTIC /end DEF_CHARACTERISTIC /begin IN_MEASUREMENT /end IN_MEASUREMENT /begin OUT_MEASUREMENT /end OUT_MEASUREMENT /end FUNCTION
/begin FUNCTION WisrBootReason "" /begin SUB_FUNCTION /end SUB_FUNCTION /begin DEF_CHARACTERISTIC /end DEF_CHARACTERISTIC /begin IN_MEASUREMENT /end IN_MEASUREMENT /begin OUT_MEASUREMENT /end OUT_MEASUREMENT /end FUNCTION
/begin FUNCTION bus_creator "" /begin DEF_CHARACTERISTIC /end DEF_CHARACTERISTIC /begin IN_MEASUREMENT /end IN_MEASUREMENT /begin OUT_MEASUREMENT /end OUT_MEASUREMENT /end FUNCTION
/begin FUNCTION APSStaSystem "" /begin SUB_FUNCTION /end SUB_FUNCTION /begin DEF_CHARACTERISTIC /end DEF_CHARACTERISTIC /begin IN_MEASUREMENT /end IN_MEASUREMENT /begin OUT_MEASUREMENT /end OUT_MEASUREMENT /end FUNCTION
/begin FUNCTION ActiveDischReq "" /begin SUB_FUNCTION Data_Type_Conversion /end SUB_FUNCTION /begin DEF_CHARACTERISTIC /end DEF_CHARACTERISTIC /begin IN_MEASUREMENT /end IN_MEASUREMENT /begin OUT_MEASUREMENT /end OUT_MEASUREMENT /end FUNCTION
/begin FUNCTION CSVCU1 "" /begin SUB_FUNCTION /end SUB_FUNCTION /begin DEF_CHARACTERISTIC /end DEF_CHARACTERISTIC /begin IN_MEASUREMENT /end IN_MEASUREMENT /begin OUT_MEASUREMENT /end OUT_MEASUREMENT /end FUNCTION
/begin FUNCTION CoastDwModeStaChk "" /begin SUB_FUNCTION /end SUB_FUNCTION /begin DEF_CHARACTERISTIC /end DEF_CHARACTERISTIC /begin IN_MEASUREMENT /end IN_MEASUREMENT /begin OUT_MEASUREMENT /end OUT_MEASUREMENT /end FUNCTION
/begin FUNCTION DCDCEnaReq "" /begin SUB_FUNCTION Data_Type_Conversion /end SUB_FUNCTION /begin DEF_CHARACTERISTIC /end DEF_CHARACTERISTIC /begin IN_MEASUREMENT /end IN_MEASUREMENT /begin OUT_MEASUREMENT /end OUT_MEASUREMENT /end FUNCTION
/begin FUNCTION DCDCVoltSetpoint "" /begin SUB_FUNCTION convert_out Data_Type_Conversion /end SUB_FUNCTION /begin DEF_CHARACTERISTIC /end DEF_CHARACTERISTIC /begin IN_MEASUREMENT /end IN_MEASUREMENT /begin OUT_MEASUREMENT /end OUT_MEASUREMENT /end FUNCTION
/begin FUNCTION DemoModeStaChk "" /begin SUB_FUNCTION /end SUB_FUNCTION /begin DEF_CHARACTERISTIC /end DEF_CHARACTERISTIC /begin IN_MEASUREMENT /end IN_MEASUREMENT /begin OUT_MEASUREMENT /end OUT_MEASUREMENT /end FUNCTION
/begin FUNCTION DrSeatSta "" /begin SUB_FUNCTION /end SUB_FUNCTION /begin DEF_CHARACTERISTIC /end DEF_CHARACTERISTIC /begin IN_MEASUREMENT /end IN_MEASUREMENT /begin OUT_MEASUREMENT /end OUT_MEASUREMENT /end FUNCTION
/begin FUNCTION DynoModeStaChk "" /begin SUB_FUNCTION /end SUB_FUNCTION /begin DEF_CHARACTERISTIC /end DEF_CHARACTERISTIC /begin IN_MEASUREMENT /end IN_MEASUREMENT /begin OUT_MEASUREMENT /end OUT_MEASUREMENT /end FUNCTION
/begin FUNCTION HVBatCnctReq "" /begin SUB_FUNCTION Data_Type_Conversion /end SUB_FUNCTION /begin DEF_CHARACTERISTIC /end DEF_CHARACTERISTIC /begin IN_MEASUREMENT /end IN_MEASUREMENT /begin OUT_MEASUREMENT /end OUT_MEASUREMENT /end FUNCTION
/begin FUNCTION HVSysReadyToCharge "" /begin SUB_FUNCTION /end SUB_FUNCTION /begin DEF_CHARACTERISTIC /end DEF_CHARACTERISTIC /begin IN_MEASUREMENT /end IN_MEASUREMENT /begin OUT_MEASUREMENT /end OUT_MEASUREMENT /end FUNCTION
/begin FUNCTION LVChrgFuncStaChk "" /begin SUB_FUNCTION /end SUB_FUNCTION /begin DEF_CHARACTERISTIC /end DEF_CHARACTERISTIC /begin IN_MEASUREMENT /end IN_MEASUREMENT /begin OUT_MEASUREMENT /end OUT_MEASUREMENT /end FUNCTION
/begin FUNCTION MSACrlSta "" /begin SUB_FUNCTION /end SUB_FUNCTION /begin DEF_CHARACTERISTIC /end DEF_CHARACTERISTIC /begin IN_MEASUREMENT /end IN_MEASUREMENT /begin OUT_MEASUREMENT /end OUT_MEASUREMENT /end FUNCTION
/begin FUNCTION PButtonSta "" /begin SUB_FUNCTION /end SUB_FUNCTION /begin DEF_CHARACTERISTIC /end DEF_CHARACTERISTIC /begin IN_MEASUREMENT /end IN_MEASUREMENT /begin OUT_MEASUREMENT /end OUT_MEASUREMENT /end FUNCTION
/begin FUNCTION PrkReq "" /begin SUB_FUNCTION Data_Type_Conversion /end SUB_FUNCTION /begin DEF_CHARACTERISTIC /end DEF_CHARACTERISTIC /begin IN_MEASUREMENT /end IN_MEASUREMENT /begin OUT_MEASUREMENT /end OUT_MEASUREMENT /end FUNCTION
/begin FUNCTION PrkReqValid "" /begin SUB_FUNCTION /end SUB_FUNCTION /begin DEF_CHARACTERISTIC /end DEF_CHARACTERISTIC /begin IN_MEASUREMENT /end IN_MEASUREMENT /begin OUT_MEASUREMENT /end OUT_MEASUREMENT /end FUNCTION
/begin FUNCTION PwrSta "" /begin SUB_FUNCTION /end SUB_FUNCTION /begin DEF_CHARACTERISTIC /end DEF_CHARACTERISTIC /begin IN_MEASUREMENT /end IN_MEASUREMENT /begin OUT_MEASUREMENT /end OUT_MEASUREMENT /end FUNCTION
/begin FUNCTION RCVCU1 "" /begin SUB_FUNCTION /end SUB_FUNCTION /begin DEF_CHARACTERISTIC /end DEF_CHARACTERISTIC /begin IN_MEASUREMENT /end IN_MEASUREMENT /begin OUT_MEASUREMENT /end OUT_MEASUREMENT /end FUNCTION
/begin FUNCTION ShiftGearPosn "" /begin SUB_FUNCTION /end SUB_FUNCTION /begin DEF_CHARACTERISTIC /end DEF_CHARACTERISTIC /begin IN_MEASUREMENT /end IN_MEASUREMENT /begin OUT_MEASUREMENT /end OUT_MEASUREMENT /end FUNCTION
/begin FUNCTION bus_creator "" /begin DEF_CHARACTERISTIC /end DEF_CHARACTERISTIC /begin IN_MEASUREMENT /end IN_MEASUREMENT /begin OUT_MEASUREMENT /end OUT_MEASUREMENT /end FUNCTION
/begin FUNCTION convert_out "" /begin SUB_FUNCTION Constant gain offset MinMax Divide Add /end SUB_FUNCTION /begin DEF_CHARACTERISTIC /end DEF_CHARACTERISTIC /begin IN_MEASUREMENT /end IN_MEASUREMENT /begin OUT_MEASUREMENT /end OUT_MEASUREMENT /end FUNCTION
/begin FUNCTION detect_change "" /begin SUB_FUNCTION FixPt_Relational_Operator Delay_Input1 /end SUB_FUNCTION /begin DEF_CHARACTERISTIC /end DEF_CHARACTERISTIC /begin IN_MEASUREMENT /end IN_MEASUREMENT /begin OUT_MEASUREMENT /end OUT_MEASUREMENT /end FUNCTION
/begin FUNCTION detect_change1 "" /begin SUB_FUNCTION FixPt_Relational_Operator Delay_Input1 /end SUB_FUNCTION /begin DEF_CHARACTERISTIC /end DEF_CHARACTERISTIC /begin IN_MEASUREMENT /end IN_MEASUREMENT /begin OUT_MEASUREMENT /end OUT_MEASUREMENT /end FUNCTION
/begin FUNCTION detect_change10 "" /begin SUB_FUNCTION FixPt_Relational_Operator Delay_Input1 /end SUB_FUNCTION /begin DEF_CHARACTERISTIC /end DEF_CHARACTERISTIC /begin IN_MEASUREMENT /end IN_MEASUREMENT /begin OUT_MEASUREMENT /end OUT_MEASUREMENT /end FUNCTION
/begin FUNCTION detect_change11 "" /begin SUB_FUNCTION FixPt_Relational_Operator Delay_Input1 /end SUB_FUNCTION /begin DEF_CHARACTERISTIC /end DEF_CHARACTERISTIC /begin IN_MEASUREMENT /end IN_MEASUREMENT /begin OUT_MEASUREMENT /end OUT_MEASUREMENT /end FUNCTION
/begin FUNCTION detect_change2 "" /begin SUB_FUNCTION FixPt_Relational_Operator Delay_Input1 /end SUB_FUNCTION /begin DEF_CHARACTERISTIC /end DEF_CHARACTERISTIC /begin IN_MEASUREMENT /end IN_MEASUREMENT /begin OUT_MEASUREMENT /end OUT_MEASUREMENT /end FUNCTION
/begin FUNCTION detect_change3 "" /begin SUB_FUNCTION FixPt_Relational_Operator Delay_Input1 /end SUB_FUNCTION /begin DEF_CHARACTERISTIC /end DEF_CHARACTERISTIC /begin IN_MEASUREMENT /end IN_MEASUREMENT /begin OUT_MEASUREMENT /end OUT_MEASUREMENT /end FUNCTION
/begin FUNCTION detect_change4 "" /begin SUB_FUNCTION FixPt_Relational_Operator Delay_Input1 /end SUB_FUNCTION /begin DEF_CHARACTERISTIC /end DEF_CHARACTERISTIC /begin IN_MEASUREMENT /end IN_MEASUREMENT /begin OUT_MEASUREMENT /end OUT_MEASUREMENT /end FUNCTION
/begin FUNCTION detect_change5 "" /begin SUB_FUNCTION FixPt_Relational_Operator Delay_Input1 /end SUB_FUNCTION /begin DEF_CHARACTERISTIC /end DEF_CHARACTERISTIC /begin IN_MEASUREMENT /end IN_MEASUREMENT /begin OUT_MEASUREMENT /end OUT_MEASUREMENT /end FUNCTION
/begin FUNCTION detect_change6 "" /begin SUB_FUNCTION FixPt_Relational_Operator Delay_Input1 /end SUB_FUNCTION /begin DEF_CHARACTERISTIC /end DEF_CHARACTERISTIC /begin IN_MEASUREMENT /end IN_MEASUREMENT /begin OUT_MEASUREMENT /end OUT_MEASUREMENT /end FUNCTION
/begin FUNCTION detect_change7 "" /begin SUB_FUNCTION FixPt_Relational_Operator Delay_Input1 /end SUB_FUNCTION /begin DEF_CHARACTERISTIC /end DEF_CHARACTERISTIC /begin IN_MEASUREMENT /end IN_MEASUREMENT /begin OUT_MEASUREMENT /end OUT_MEASUREMENT /end FUNCTION
/begin FUNCTION detect_change8 "" /begin SUB_FUNCTION FixPt_Relational_Operator Delay_Input1 /end SUB_FUNCTION /begin DEF_CHARACTERISTIC /end DEF_CHARACTERISTIC /begin IN_MEASUREMENT /end IN_MEASUREMENT /begin OUT_MEASUREMENT /end OUT_MEASUREMENT /end FUNCTION
/begin FUNCTION detect_change9 "" /begin SUB_FUNCTION FixPt_Relational_Operator Delay_Input1 /end SUB_FUNCTION /begin DEF_CHARACTERISTIC /end DEF_CHARACTERISTIC /begin IN_MEASUREMENT /end IN_MEASUREMENT /begin OUT_MEASUREMENT /end OUT_MEASUREMENT /end FUNCTION
/begin FUNCTION Chart1 "" /begin DEF_CHARACTERISTIC /end DEF_CHARACTERISTIC /begin IN_MEASUREMENT /end IN_MEASUREMENT /begin OUT_MEASUREMENT /end OUT_MEASUREMENT /end FUNCTION
/begin FUNCTION Constant "" /begin DEF_CHARACTERISTIC /end DEF_CHARACTERISTIC /begin IN_MEASUREMENT /end IN_MEASUREMENT /begin OUT_MEASUREMENT /end OUT_MEASUREMENT /end FUNCTION
/begin FUNCTION Constant3 "" /begin DEF_CHARACTERISTIC /end DEF_CHARACTERISTIC /begin IN_MEASUREMENT /end IN_MEASUREMENT /begin OUT_MEASUREMENT /end OUT_MEASUREMENT /end FUNCTION
/begin FUNCTION Data_Type_Conversion "" /begin DEF_CHARACTERISTIC /end DEF_CHARACTERISTIC /begin IN_MEASUREMENT /end IN_MEASUREMENT /begin OUT_MEASUREMENT /end OUT_MEASUREMENT /end FUNCTION
/begin FUNCTION Data_Type_Conversion1 "" /begin DEF_CHARACTERISTIC /end DEF_CHARACTERISTIC /begin IN_MEASUREMENT /end IN_MEASUREMENT /begin OUT_MEASUREMENT /end OUT_MEASUREMENT /end FUNCTION
/begin FUNCTION Gain "" /begin DEF_CHARACTERISTIC /end DEF_CHARACTERISTIC /begin IN_MEASUREMENT /end IN_MEASUREMENT /begin OUT_MEASUREMENT /end OUT_MEASUREMENT /end FUNCTION
/begin FUNCTION OR "" /begin DEF_CHARACTERISTIC /end DEF_CHARACTERISTIC /begin IN_MEASUREMENT /end IN_MEASUREMENT /begin OUT_MEASUREMENT /end OUT_MEASUREMENT /end FUNCTION
/begin FUNCTION Divide "" /begin DEF_CHARACTERISTIC /end DEF_CHARACTERISTIC /begin IN_MEASUREMENT /end IN_MEASUREMENT /begin OUT_MEASUREMENT /end OUT_MEASUREMENT /end FUNCTION
/begin FUNCTION ActiveDischReqtoNidec "" /begin SUB_FUNCTION Data_Type_Conversion /end SUB_FUNCTION /begin DEF_CHARACTERISTIC /end DEF_CHARACTERISTIC /begin IN_MEASUREMENT /end IN_MEASUREMENT /begin OUT_MEASUREMENT /end OUT_MEASUREMENT /end FUNCTION
/begin FUNCTION CSVCU1toNidec "" /begin SUB_FUNCTION /end SUB_FUNCTION /begin DEF_CHARACTERISTIC /end DEF_CHARACTERISTIC /begin IN_MEASUREMENT /end IN_MEASUREMENT /begin OUT_MEASUREMENT /end OUT_MEASUREMENT /end FUNCTION
/begin FUNCTION CoastDwModeStaChktoNidec "" /begin SUB_FUNCTION /end SUB_FUNCTION /begin DEF_CHARACTERISTIC /end DEF_CHARACTERISTIC /begin IN_MEASUREMENT /end IN_MEASUREMENT /begin OUT_MEASUREMENT /end OUT_MEASUREMENT /end FUNCTION
/begin FUNCTION DCDCEnaReqtoNidec "" /begin SUB_FUNCTION Data_Type_Conversion /end SUB_FUNCTION /begin DEF_CHARACTERISTIC /end DEF_CHARACTERISTIC /begin IN_MEASUREMENT /end IN_MEASUREMENT /begin OUT_MEASUREMENT /end OUT_MEASUREMENT /end FUNCTION
/begin FUNCTION DCDCVoltSetpointtoNidec "" /begin SUB_FUNCTION convert_out Data_Type_Conversion /end SUB_FUNCTION /begin DEF_CHARACTERISTIC /end DEF_CHARACTERISTIC /begin IN_MEASUREMENT /end IN_MEASUREMENT /begin OUT_MEASUREMENT /end OUT_MEASUREMENT /end FUNCTION
/begin FUNCTION DemoModeStaChktoNidec "" /begin SUB_FUNCTION /end SUB_FUNCTION /begin DEF_CHARACTERISTIC /end DEF_CHARACTERISTIC /begin IN_MEASUREMENT /end IN_MEASUREMENT /begin OUT_MEASUREMENT /end OUT_MEASUREMENT /end FUNCTION
/begin FUNCTION DrSeatStatoNidec "" /begin SUB_FUNCTION /end SUB_FUNCTION /begin DEF_CHARACTERISTIC /end DEF_CHARACTERISTIC /begin IN_MEASUREMENT /end IN_MEASUREMENT /begin OUT_MEASUREMENT /end OUT_MEASUREMENT /end FUNCTION
/begin FUNCTION DynoModeStaChktoNidec "" /begin SUB_FUNCTION /end SUB_FUNCTION /begin DEF_CHARACTERISTIC /end DEF_CHARACTERISTIC /begin IN_MEASUREMENT /end IN_MEASUREMENT /begin OUT_MEASUREMENT /end OUT_MEASUREMENT /end FUNCTION
/begin FUNCTION FrActvDmpDisabReqtoNidec "" /begin SUB_FUNCTION Data_Type_Conversion /end SUB_FUNCTION /begin DEF_CHARACTERISTIC /end DEF_CHARACTERISTIC /begin IN_MEASUREMENT /end IN_MEASUREMENT /begin OUT_MEASUREMENT /end OUT_MEASUREMENT /end FUNCTION
/begin FUNCTION FrMCUEnaReqtoNidec "" /begin SUB_FUNCTION Data_Type_Conversion /end SUB_FUNCTION /begin DEF_CHARACTERISTIC /end DEF_CHARACTERISTIC /begin IN_MEASUREMENT /end IN_MEASUREMENT /begin OUT_MEASUREMENT /end OUT_MEASUREMENT /end FUNCTION
/begin FUNCTION HVBatCnctReqtoNidec "" /begin SUB_FUNCTION Data_Type_Conversion /end SUB_FUNCTION /begin DEF_CHARACTERISTIC /end DEF_CHARACTERISTIC /begin IN_MEASUREMENT /end IN_MEASUREMENT /begin OUT_MEASUREMENT /end OUT_MEASUREMENT /end FUNCTION
/begin FUNCTION HVSysReadyToChargetoNidec "" /begin SUB_FUNCTION /end SUB_FUNCTION /begin DEF_CHARACTERISTIC /end DEF_CHARACTERISTIC /begin IN_MEASUREMENT /end IN_MEASUREMENT /begin OUT_MEASUREMENT /end OUT_MEASUREMENT /end FUNCTION
/begin FUNCTION LVChrgFuncStaChktoNidec "" /begin SUB_FUNCTION /end SUB_FUNCTION /begin DEF_CHARACTERISTIC /end DEF_CHARACTERISTIC /begin IN_MEASUREMENT /end IN_MEASUREMENT /begin OUT_MEASUREMENT /end OUT_MEASUREMENT /end FUNCTION
/begin FUNCTION MSACrlStatoNidec "" /begin SUB_FUNCTION /end SUB_FUNCTION /begin DEF_CHARACTERISTIC /end DEF_CHARACTERISTIC /begin IN_MEASUREMENT /end IN_MEASUREMENT /begin OUT_MEASUREMENT /end OUT_MEASUREMENT /end FUNCTION
/begin FUNCTION PrkReqtoNidec "" /begin SUB_FUNCTION Data_Type_Conversion /end SUB_FUNCTION /begin DEF_CHARACTERISTIC /end DEF_CHARACTERISTIC /begin IN_MEASUREMENT /end IN_MEASUREMENT /begin OUT_MEASUREMENT /end OUT_MEASUREMENT /end FUNCTION
/begin FUNCTION PwrStatoNidec "" /begin SUB_FUNCTION /end SUB_FUNCTION /begin DEF_CHARACTERISTIC /end DEF_CHARACTERISTIC /begin IN_MEASUREMENT /end IN_MEASUREMENT /begin OUT_MEASUREMENT /end OUT_MEASUREMENT /end FUNCTION
/begin FUNCTION RCVCU1toNidec "" /begin SUB_FUNCTION /end SUB_FUNCTION /begin DEF_CHARACTERISTIC /end DEF_CHARACTERISTIC /begin IN_MEASUREMENT /end IN_MEASUREMENT /begin OUT_MEASUREMENT /end OUT_MEASUREMENT /end FUNCTION
/begin FUNCTION RrActvDmpDisabReqtoNidec "" /begin SUB_FUNCTION Data_Type_Conversion /end SUB_FUNCTION /begin DEF_CHARACTERISTIC /end DEF_CHARACTERISTIC /begin IN_MEASUREMENT /end IN_MEASUREMENT /begin OUT_MEASUREMENT /end OUT_MEASUREMENT /end FUNCTION
/begin FUNCTION RrMCUEnaReqtoNidec "" /begin SUB_FUNCTION Data_Type_Conversion /end SUB_FUNCTION /begin DEF_CHARACTERISTIC /end DEF_CHARACTERISTIC /begin IN_MEASUREMENT /end IN_MEASUREMENT /begin OUT_MEASUREMENT /end OUT_MEASUREMENT /end FUNCTION
/begin FUNCTION ShiftGearPosntoNidec "" /begin SUB_FUNCTION /end SUB_FUNCTION /begin DEF_CHARACTERISTIC /end DEF_CHARACTERISTIC /begin IN_MEASUREMENT /end IN_MEASUREMENT /begin OUT_MEASUREMENT /end OUT_MEASUREMENT /end FUNCTION
/begin FUNCTION bus_creator "" /begin DEF_CHARACTERISTIC /end DEF_CHARACTERISTIC /begin IN_MEASUREMENT /end IN_MEASUREMENT /begin OUT_MEASUREMENT /end OUT_MEASUREMENT /end FUNCTION
/begin FUNCTION convert_out "" /begin SUB_FUNCTION Constant gain offset MinMax Divide Add /end SUB_FUNCTION /begin DEF_CHARACTERISTIC /end DEF_CHARACTERISTIC /begin IN_MEASUREMENT /end IN_MEASUREMENT /begin OUT_MEASUREMENT /end OUT_MEASUREMENT /end FUNCTION
/begin FUNCTION detect_change "" /begin SUB_FUNCTION FixPt_Relational_Operator Delay_Input1 /end SUB_FUNCTION /begin DEF_CHARACTERISTIC /end DEF_CHARACTERISTIC /begin IN_MEASUREMENT /end IN_MEASUREMENT /begin OUT_MEASUREMENT /end OUT_MEASUREMENT /end FUNCTION
/begin FUNCTION detect_change1 "" /begin SUB_FUNCTION FixPt_Relational_Operator Delay_Input1 /end SUB_FUNCTION /begin DEF_CHARACTERISTIC /end DEF_CHARACTERISTIC /begin IN_MEASUREMENT /end IN_MEASUREMENT /begin OUT_MEASUREMENT /end OUT_MEASUREMENT /end FUNCTION
/begin FUNCTION detect_change10 "" /begin SUB_FUNCTION FixPt_Relational_Operator Delay_Input1 /end SUB_FUNCTION /begin DEF_CHARACTERISTIC /end DEF_CHARACTERISTIC /begin IN_MEASUREMENT /end IN_MEASUREMENT /begin OUT_MEASUREMENT /end OUT_MEASUREMENT /end FUNCTION
/begin FUNCTION detect_change11 "" /begin SUB_FUNCTION FixPt_Relational_Operator Delay_Input1 /end SUB_FUNCTION /begin DEF_CHARACTERISTIC /end DEF_CHARACTERISTIC /begin IN_MEASUREMENT /end IN_MEASUREMENT /begin OUT_MEASUREMENT /end OUT_MEASUREMENT /end FUNCTION
/begin FUNCTION detect_change12 "" /begin SUB_FUNCTION FixPt_Relational_Operator Delay_Input1 /end SUB_FUNCTION /begin DEF_CHARACTERISTIC /end DEF_CHARACTERISTIC /begin IN_MEASUREMENT /end IN_MEASUREMENT /begin OUT_MEASUREMENT /end OUT_MEASUREMENT /end FUNCTION
/begin FUNCTION detect_change13 "" /begin SUB_FUNCTION FixPt_Relational_Operator Delay_Input1 /end SUB_FUNCTION /begin DEF_CHARACTERISTIC /end DEF_CHARACTERISTIC /begin IN_MEASUREMENT /end IN_MEASUREMENT /begin OUT_MEASUREMENT /end OUT_MEASUREMENT /end FUNCTION
/begin FUNCTION detect_change2 "" /begin SUB_FUNCTION FixPt_Relational_Operator Delay_Input1 /end SUB_FUNCTION /begin DEF_CHARACTERISTIC /end DEF_CHARACTERISTIC /begin IN_MEASUREMENT /end IN_MEASUREMENT /begin OUT_MEASUREMENT /end OUT_MEASUREMENT /end FUNCTION
/begin FUNCTION detect_change3 "" /begin SUB_FUNCTION FixPt_Relational_Operator Delay_Input1 /end SUB_FUNCTION /begin DEF_CHARACTERISTIC /end DEF_CHARACTERISTIC /begin IN_MEASUREMENT /end IN_MEASUREMENT /begin OUT_MEASUREMENT /end OUT_MEASUREMENT /end FUNCTION
/begin FUNCTION detect_change4 "" /begin SUB_FUNCTION FixPt_Relational_Operator Delay_Input1 /end SUB_FUNCTION /begin DEF_CHARACTERISTIC /end DEF_CHARACTERISTIC /begin IN_MEASUREMENT /end IN_MEASUREMENT /begin OUT_MEASUREMENT /end OUT_MEASUREMENT /end FUNCTION
/begin FUNCTION detect_change5 "" /begin SUB_FUNCTION FixPt_Relational_Operator Delay_Input1 /end SUB_FUNCTION /begin DEF_CHARACTERISTIC /end DEF_CHARACTERISTIC /begin IN_MEASUREMENT /end IN_MEASUREMENT /begin OUT_MEASUREMENT /end OUT_MEASUREMENT /end FUNCTION
/begin FUNCTION detect_change6 "" /begin SUB_FUNCTION FixPt_Relational_Operator Delay_Input1 /end SUB_FUNCTION /begin DEF_CHARACTERISTIC /end DEF_CHARACTERISTIC /begin IN_MEASUREMENT /end IN_MEASUREMENT /begin OUT_MEASUREMENT /end OUT_MEASUREMENT /end FUNCTION
/begin FUNCTION detect_change7 "" /begin SUB_FUNCTION FixPt_Relational_Operator Delay_Input1 /end SUB_FUNCTION /begin DEF_CHARACTERISTIC /end DEF_CHARACTERISTIC /begin IN_MEASUREMENT /end IN_MEASUREMENT /begin OUT_MEASUREMENT /end OUT_MEASUREMENT /end FUNCTION
/begin FUNCTION detect_change8 "" /begin SUB_FUNCTION FixPt_Relational_Operator Delay_Input1 /end SUB_FUNCTION /begin DEF_CHARACTERISTIC /end DEF_CHARACTERISTIC /begin IN_MEASUREMENT /end IN_MEASUREMENT /begin OUT_MEASUREMENT /end OUT_MEASUREMENT /end FUNCTION
/begin FUNCTION detect_change9 "" /begin SUB_FUNCTION FixPt_Relational_Operator Delay_Input1 /end SUB_FUNCTION /begin DEF_CHARACTERISTIC /end DEF_CHARACTERISTIC /begin IN_MEASUREMENT /end IN_MEASUREMENT /begin OUT_MEASUREMENT /end OUT_MEASUREMENT /end FUNCTION
/begin FUNCTION Chart1 "" /begin DEF_CHARACTERISTIC /end DEF_CHARACTERISTIC /begin IN_MEASUREMENT /end IN_MEASUREMENT /begin OUT_MEASUREMENT /end OUT_MEASUREMENT /end FUNCTION
/begin FUNCTION Constant "" /begin DEF_CHARACTERISTIC /end DEF_CHARACTERISTIC /begin IN_MEASUREMENT /end IN_MEASUREMENT /begin OUT_MEASUREMENT /end OUT_MEASUREMENT /end FUNCTION
/begin FUNCTION Constant3 "" /begin DEF_CHARACTERISTIC /end DEF_CHARACTERISTIC /begin IN_MEASUREMENT /end IN_MEASUREMENT /begin OUT_MEASUREMENT /end OUT_MEASUREMENT /end FUNCTION
/begin FUNCTION Data_Type_Conversion "" /begin DEF_CHARACTERISTIC /end DEF_CHARACTERISTIC /begin IN_MEASUREMENT /end IN_MEASUREMENT /begin OUT_MEASUREMENT /end OUT_MEASUREMENT /end FUNCTION
/begin FUNCTION Data_Type_Conversion1 "" /begin DEF_CHARACTERISTIC /end DEF_CHARACTERISTIC /begin IN_MEASUREMENT /end IN_MEASUREMENT /begin OUT_MEASUREMENT /end OUT_MEASUREMENT /end FUNCTION
/begin FUNCTION Gain "" /begin DEF_CHARACTERISTIC /end DEF_CHARACTERISTIC /begin IN_MEASUREMENT /end IN_MEASUREMENT /begin OUT_MEASUREMENT /end OUT_MEASUREMENT /end FUNCTION
/begin FUNCTION OR "" /begin DEF_CHARACTERISTIC /end DEF_CHARACTERISTIC /begin IN_MEASUREMENT /end IN_MEASUREMENT /begin OUT_MEASUREMENT /end OUT_MEASUREMENT /end FUNCTION
/begin FUNCTION Divide "" /begin DEF_CHARACTERISTIC /end DEF_CHARACTERISTIC /begin IN_MEASUREMENT /end IN_MEASUREMENT /begin OUT_MEASUREMENT /end OUT_MEASUREMENT /end FUNCTION
/begin FUNCTION FD3_VCU2 "" /begin DEF_CHARACTERISTIC /end DEF_CHARACTERISTIC /begin IN_MEASUREMENT /end IN_MEASUREMENT /begin OUT_MEASUREMENT /end OUT_MEASUREMENT /end FUNCTION
/begin FUNCTION Byte_0 "" /begin SUB_FUNCTION SignalPack /end SUB_FUNCTION /begin DEF_CHARACTERISTIC /end DEF_CHARACTERISTIC /begin IN_MEASUREMENT /end IN_MEASUREMENT /begin OUT_MEASUREMENT /end OUT_MEASUREMENT /end FUNCTION
/begin FUNCTION Byte_1 "" /begin SUB_FUNCTION SignalPack /end SUB_FUNCTION /begin DEF_CHARACTERISTIC /end DEF_CHARACTERISTIC /begin IN_MEASUREMENT /end IN_MEASUREMENT /begin OUT_MEASUREMENT /end OUT_MEASUREMENT /end FUNCTION
/begin FUNCTION Byte_10 "" /begin SUB_FUNCTION SignalPack UnitConverter UnitConverter1 /end SUB_FUNCTION /begin DEF_CHARACTERISTIC /end DEF_CHARACTERISTIC /begin IN_MEASUREMENT /end IN_MEASUREMENT /begin OUT_MEASUREMENT /end OUT_MEASUREMENT /end FUNCTION
/begin FUNCTION Byte_11 "" /begin SUB_FUNCTION SignalPack UnitConverter UnitConverter1 /end SUB_FUNCTION /begin DEF_CHARACTERISTIC /end DEF_CHARACTERISTIC /begin IN_MEASUREMENT /end IN_MEASUREMENT /begin OUT_MEASUREMENT /end OUT_MEASUREMENT /end FUNCTION
/begin FUNCTION Byte_12 ""
 /begin SUB_FUNCTION SignalPack SignalPack1 UnitConverter UnitConverter1 UnitConverter2 UnitConverter3 /end SUB_FUNCTION
 /begin DEF_CHARACTERISTIC /end DEF_CHARACTERISTIC
 /begin IN_MEASUREMENT /end IN_MEASUREMENT
 /begin OUT_MEASUREMENT /end OUT_MEASUREMENT
/end FUNCTION
/begin FUNCTION Byte_13 "" /begin SUB_FUNCTION SignalPack UnitConverter UnitConverter1 /end SUB_FUNCTION /begin DEF_CHARACTERISTIC /end DEF_CHARACTERISTIC /begin IN_MEASUREMENT /end IN_MEASUREMENT /begin OUT_MEASUREMENT /end OUT_MEASUREMENT /end FUNCTION
/begin FUNCTION Byte_14 "" /begin SUB_FUNCTION SignalPack convert_out UnitConverter UnitConverter1 /end SUB_FUNCTION /begin DEF_CHARACTERISTIC /end DEF_CHARACTERISTIC /begin IN_MEASUREMENT /end IN_MEASUREMENT /begin OUT_MEASUREMENT /end OUT_MEASUREMENT /end FUNCTION
/begin FUNCTION Byte_15 "" /begin SUB_FUNCTION SignalPack convert_out UnitConverter UnitConverter1 /end SUB_FUNCTION /begin DEF_CHARACTERISTIC /end DEF_CHARACTERISTIC /begin IN_MEASUREMENT /end IN_MEASUREMENT /begin OUT_MEASUREMENT /end OUT_MEASUREMENT /end FUNCTION
/begin FUNCTION Byte_16 "" /begin SUB_FUNCTION SignalPack convert_out UnitConverter UnitConverter1 /end SUB_FUNCTION /begin DEF_CHARACTERISTIC /end DEF_CHARACTERISTIC /begin IN_MEASUREMENT /end IN_MEASUREMENT /begin OUT_MEASUREMENT /end OUT_MEASUREMENT /end FUNCTION
/begin FUNCTION Byte_17 "" /begin SUB_FUNCTION SignalPack convert_out UnitConverter UnitConverter1 /end SUB_FUNCTION /begin DEF_CHARACTERISTIC /end DEF_CHARACTERISTIC /begin IN_MEASUREMENT /end IN_MEASUREMENT /begin OUT_MEASUREMENT /end OUT_MEASUREMENT /end FUNCTION
/begin FUNCTION Byte_18 "" /begin SUB_FUNCTION SignalPack UnitConverter UnitConverter1 /end SUB_FUNCTION /begin DEF_CHARACTERISTIC /end DEF_CHARACTERISTIC /begin IN_MEASUREMENT /end IN_MEASUREMENT /begin OUT_MEASUREMENT /end OUT_MEASUREMENT /end FUNCTION
/begin FUNCTION Byte_19 ""
 /begin SUB_FUNCTION SignalPack SignalPack1 convert_out UnitConverter UnitConverter1 UnitConverter2 UnitConverter3 /end SUB_FUNCTION
 /begin DEF_CHARACTERISTIC /end DEF_CHARACTERISTIC
 /begin IN_MEASUREMENT /end IN_MEASUREMENT
 /begin OUT_MEASUREMENT /end OUT_MEASUREMENT
/end FUNCTION
/begin FUNCTION Byte_2 "" /begin SUB_FUNCTION SignalPack UnitConverter UnitConverter1 /end SUB_FUNCTION /begin DEF_CHARACTERISTIC /end DEF_CHARACTERISTIC /begin IN_MEASUREMENT /end IN_MEASUREMENT /begin OUT_MEASUREMENT /end OUT_MEASUREMENT /end FUNCTION
/begin FUNCTION Byte_20 "" /begin SUB_FUNCTION SignalPack convert_out UnitConverter UnitConverter1 /end SUB_FUNCTION /begin DEF_CHARACTERISTIC /end DEF_CHARACTERISTIC /begin IN_MEASUREMENT /end IN_MEASUREMENT /begin OUT_MEASUREMENT /end OUT_MEASUREMENT /end FUNCTION
/begin FUNCTION Byte_21 "" /begin SUB_FUNCTION SignalPack UnitConverter /end SUB_FUNCTION /begin DEF_CHARACTERISTIC /end DEF_CHARACTERISTIC /begin IN_MEASUREMENT /end IN_MEASUREMENT /begin OUT_MEASUREMENT /end OUT_MEASUREMENT /end FUNCTION
/begin FUNCTION Byte_22 ""
 /begin SUB_FUNCTION SignalPack SignalPack1 convert_out UnitConverter UnitConverter2 UnitConverter3 /end SUB_FUNCTION
 /begin DEF_CHARACTERISTIC /end DEF_CHARACTERISTIC
 /begin IN_MEASUREMENT /end IN_MEASUREMENT
 /begin OUT_MEASUREMENT /end OUT_MEASUREMENT
/end FUNCTION
/begin FUNCTION Byte_23 "" /begin SUB_FUNCTION SignalPack convert_out UnitConverter UnitConverter1 /end SUB_FUNCTION /begin DEF_CHARACTERISTIC /end DEF_CHARACTERISTIC /begin IN_MEASUREMENT /end IN_MEASUREMENT /begin OUT_MEASUREMENT /end OUT_MEASUREMENT /end FUNCTION
/begin FUNCTION Byte_24 ""
 /begin SUB_FUNCTION SignalPack SignalPack1 SignalPack2 SignalPack3 UnitConverter1 UnitConverter3 UnitConverter5 UnitConverter7 /end SUB_FUNCTION
 /begin DEF_CHARACTERISTIC /end DEF_CHARACTERISTIC
 /begin IN_MEASUREMENT /end IN_MEASUREMENT
 /begin OUT_MEASUREMENT /end OUT_MEASUREMENT
/end FUNCTION
/begin FUNCTION Byte_3 ""
 /begin SUB_FUNCTION SignalPack SignalPack1 convert_out UnitConverter UnitConverter1 UnitConverter2 UnitConverter3 /end SUB_FUNCTION
 /begin DEF_CHARACTERISTIC /end DEF_CHARACTERISTIC
 /begin IN_MEASUREMENT /end IN_MEASUREMENT
 /begin OUT_MEASUREMENT /end OUT_MEASUREMENT
/end FUNCTION
/begin FUNCTION Byte_4 "" /begin SUB_FUNCTION SignalPack convert_out UnitConverter UnitConverter1 /end SUB_FUNCTION /begin DEF_CHARACTERISTIC /end DEF_CHARACTERISTIC /begin IN_MEASUREMENT /end IN_MEASUREMENT /begin OUT_MEASUREMENT /end OUT_MEASUREMENT /end FUNCTION
/begin FUNCTION Byte_5 "" /begin SUB_FUNCTION SignalPack UnitConverter /end SUB_FUNCTION /begin DEF_CHARACTERISTIC /end DEF_CHARACTERISTIC /begin IN_MEASUREMENT /end IN_MEASUREMENT /begin OUT_MEASUREMENT /end OUT_MEASUREMENT /end FUNCTION
/begin FUNCTION Byte_6 ""
 /begin SUB_FUNCTION SignalPack SignalPack1 convert_out UnitConverter UnitConverter2 UnitConverter3 /end SUB_FUNCTION
 /begin DEF_CHARACTERISTIC /end DEF_CHARACTERISTIC
 /begin IN_MEASUREMENT /end IN_MEASUREMENT
 /begin OUT_MEASUREMENT /end OUT_MEASUREMENT
/end FUNCTION
/begin FUNCTION Byte_7 "" /begin SUB_FUNCTION SignalPack convert_out UnitConverter UnitConverter1 /end SUB_FUNCTION /begin DEF_CHARACTERISTIC /end DEF_CHARACTERISTIC /begin IN_MEASUREMENT /end IN_MEASUREMENT /begin OUT_MEASUREMENT /end OUT_MEASUREMENT /end FUNCTION
/begin FUNCTION Byte_8 "" /begin SUB_FUNCTION SignalPack UnitConverter UnitConverter1 /end SUB_FUNCTION /begin DEF_CHARACTERISTIC /end DEF_CHARACTERISTIC /begin IN_MEASUREMENT /end IN_MEASUREMENT /begin OUT_MEASUREMENT /end OUT_MEASUREMENT /end FUNCTION
/begin FUNCTION Byte_9 ""
 /begin SUB_FUNCTION SignalPack SignalPack1 UnitConverter UnitConverter1 UnitConverter2 UnitConverter3 /end SUB_FUNCTION
 /begin DEF_CHARACTERISTIC /end DEF_CHARACTERISTIC
 /begin IN_MEASUREMENT /end IN_MEASUREMENT
 /begin OUT_MEASUREMENT /end OUT_MEASUREMENT
/end FUNCTION
/begin FUNCTION CRC8_IfAction_Tx ""
 /begin SUB_FUNCTION If_Action_Subsystem If_Action_Subsystem1 Data_Type_Conversion If Merge /end SUB_FUNCTION
 /begin DEF_CHARACTERISTIC /end DEF_CHARACTERISTIC
 /begin IN_MEASUREMENT /end IN_MEASUREMENT
 /begin OUT_MEASUREMENT /end OUT_MEASUREMENT
/end FUNCTION
/begin FUNCTION CSVCU2CAN1 "" /begin SUB_FUNCTION /end SUB_FUNCTION /begin DEF_CHARACTERISTIC /end DEF_CHARACTERISTIC /begin IN_MEASUREMENT /end IN_MEASUREMENT /begin OUT_MEASUREMENT /end OUT_MEASUREMENT /end FUNCTION
/begin FUNCTION FrActvDmpDisabReq "" /begin SUB_FUNCTION Data_Type_Conversion /end SUB_FUNCTION /begin DEF_CHARACTERISTIC /end DEF_CHARACTERISTIC /begin IN_MEASUREMENT /end IN_MEASUREMENT /begin OUT_MEASUREMENT /end OUT_MEASUREMENT /end FUNCTION
/begin FUNCTION FrIdcMax "" /begin SUB_FUNCTION Data_Type_Conversion /end SUB_FUNCTION /begin DEF_CHARACTERISTIC /end DEF_CHARACTERISTIC /begin IN_MEASUREMENT /end IN_MEASUREMENT /begin OUT_MEASUREMENT /end OUT_MEASUREMENT /end FUNCTION
/begin FUNCTION FrIdcMin "" /begin SUB_FUNCTION convert_out Data_Type_Conversion /end SUB_FUNCTION /begin DEF_CHARACTERISTIC /end DEF_CHARACTERISTIC /begin IN_MEASUREMENT /end IN_MEASUREMENT /begin OUT_MEASUREMENT /end OUT_MEASUREMENT /end FUNCTION
/begin FUNCTION FrMCUEnaReq "" /begin SUB_FUNCTION Data_Type_Conversion /end SUB_FUNCTION /begin DEF_CHARACTERISTIC /end DEF_CHARACTERISTIC /begin IN_MEASUREMENT /end IN_MEASUREMENT /begin OUT_MEASUREMENT /end OUT_MEASUREMENT /end FUNCTION
/begin FUNCTION FrTMTqReq "" /begin SUB_FUNCTION convert_out Data_Type_Conversion /end SUB_FUNCTION /begin DEF_CHARACTERISTIC /end DEF_CHARACTERISTIC /begin IN_MEASUREMENT /end IN_MEASUREMENT /begin OUT_MEASUREMENT /end OUT_MEASUREMENT /end FUNCTION
/begin FUNCTION FrTorqMax "" /begin SUB_FUNCTION /end SUB_FUNCTION /begin DEF_CHARACTERISTIC /end DEF_CHARACTERISTIC /begin IN_MEASUREMENT /end IN_MEASUREMENT /begin OUT_MEASUREMENT /end OUT_MEASUREMENT /end FUNCTION
/begin FUNCTION FrTorqMin "" /begin SUB_FUNCTION convert_out Data_Type_Conversion /end SUB_FUNCTION /begin DEF_CHARACTERISTIC /end DEF_CHARACTERISTIC /begin IN_MEASUREMENT /end IN_MEASUREMENT /begin OUT_MEASUREMENT /end OUT_MEASUREMENT /end FUNCTION
/begin FUNCTION FrUdcMax "" /begin SUB_FUNCTION Data_Type_Conversion /end SUB_FUNCTION /begin DEF_CHARACTERISTIC /end DEF_CHARACTERISTIC /begin IN_MEASUREMENT /end IN_MEASUREMENT /begin OUT_MEASUREMENT /end OUT_MEASUREMENT /end FUNCTION
/begin FUNCTION FrUdcMin "" /begin SUB_FUNCTION Data_Type_Conversion /end SUB_FUNCTION /begin DEF_CHARACTERISTIC /end DEF_CHARACTERISTIC /begin IN_MEASUREMENT /end IN_MEASUREMENT /begin OUT_MEASUREMENT /end OUT_MEASUREMENT /end FUNCTION
/begin FUNCTION RCVCU2CAN1 "" /begin SUB_FUNCTION /end SUB_FUNCTION /begin DEF_CHARACTERISTIC /end DEF_CHARACTERISTIC /begin IN_MEASUREMENT /end IN_MEASUREMENT /begin OUT_MEASUREMENT /end OUT_MEASUREMENT /end FUNCTION
/begin FUNCTION RollingCounter_IfAction ""
 /begin SUB_FUNCTION Constant1 Constant65 Constant66 Constant67 Equal34 Add2 Switch Switch5 Unit_Delay5 /end SUB_FUNCTION
 /begin DEF_CHARACTERISTIC /end DEF_CHARACTERISTIC
 /begin IN_MEASUREMENT /end IN_MEASUREMENT
 /begin OUT_MEASUREMENT /end OUT_MEASUREMENT
/end FUNCTION
/begin FUNCTION RollingCounter_IfAction1 ""
 /begin SUB_FUNCTION Constant1 Constant65 Constant66 Constant67 Equal34 Add2 Switch Switch5 Unit_Delay5 /end SUB_FUNCTION
 /begin DEF_CHARACTERISTIC /end DEF_CHARACTERISTIC
 /begin IN_MEASUREMENT /end IN_MEASUREMENT
 /begin OUT_MEASUREMENT /end OUT_MEASUREMENT
/end FUNCTION
/begin FUNCTION RrActvDmpDisabReq "" /begin SUB_FUNCTION Data_Type_Conversion /end SUB_FUNCTION /begin DEF_CHARACTERISTIC /end DEF_CHARACTERISTIC /begin IN_MEASUREMENT /end IN_MEASUREMENT /begin OUT_MEASUREMENT /end OUT_MEASUREMENT /end FUNCTION
/begin FUNCTION RrIdcMax "" /begin SUB_FUNCTION Data_Type_Conversion /end SUB_FUNCTION /begin DEF_CHARACTERISTIC /end DEF_CHARACTERISTIC /begin IN_MEASUREMENT /end IN_MEASUREMENT /begin OUT_MEASUREMENT /end OUT_MEASUREMENT /end FUNCTION
/begin FUNCTION RrIdcMin "" /begin SUB_FUNCTION convert_out Data_Type_Conversion /end SUB_FUNCTION /begin DEF_CHARACTERISTIC /end DEF_CHARACTERISTIC /begin IN_MEASUREMENT /end IN_MEASUREMENT /begin OUT_MEASUREMENT /end OUT_MEASUREMENT /end FUNCTION
/begin FUNCTION RrMCUEnaReq "" /begin SUB_FUNCTION Data_Type_Conversion /end SUB_FUNCTION /begin DEF_CHARACTERISTIC /end DEF_CHARACTERISTIC /begin IN_MEASUREMENT /end IN_MEASUREMENT /begin OUT_MEASUREMENT /end OUT_MEASUREMENT /end FUNCTION
/begin FUNCTION RrTMTqReq "" /begin SUB_FUNCTION convert_out Data_Type_Conversion /end SUB_FUNCTION /begin DEF_CHARACTERISTIC /end DEF_CHARACTERISTIC /begin IN_MEASUREMENT /end IN_MEASUREMENT /begin OUT_MEASUREMENT /end OUT_MEASUREMENT /end FUNCTION
/begin FUNCTION RrTorqMax "" /begin SUB_FUNCTION /end SUB_FUNCTION /begin DEF_CHARACTERISTIC /end DEF_CHARACTERISTIC /begin IN_MEASUREMENT /end IN_MEASUREMENT /begin OUT_MEASUREMENT /end OUT_MEASUREMENT /end FUNCTION
/begin FUNCTION RrTorqMin "" /begin SUB_FUNCTION convert_out Data_Type_Conversion /end SUB_FUNCTION /begin DEF_CHARACTERISTIC /end DEF_CHARACTERISTIC /begin IN_MEASUREMENT /end IN_MEASUREMENT /begin OUT_MEASUREMENT /end OUT_MEASUREMENT /end FUNCTION
/begin FUNCTION RrUdcMax "" /begin SUB_FUNCTION Data_Type_Conversion /end SUB_FUNCTION /begin DEF_CHARACTERISTIC /end DEF_CHARACTERISTIC /begin IN_MEASUREMENT /end IN_MEASUREMENT /begin OUT_MEASUREMENT /end OUT_MEASUREMENT /end FUNCTION
/begin FUNCTION RrUdcMin "" /begin SUB_FUNCTION Data_Type_Conversion /end SUB_FUNCTION /begin DEF_CHARACTERISTIC /end DEF_CHARACTERISTIC /begin IN_MEASUREMENT /end IN_MEASUREMENT /begin OUT_MEASUREMENT /end OUT_MEASUREMENT /end FUNCTION
/begin FUNCTION bus_creator "" /begin DEF_CHARACTERISTIC /end DEF_CHARACTERISTIC /begin IN_MEASUREMENT /end IN_MEASUREMENT /begin OUT_MEASUREMENT /end OUT_MEASUREMENT /end FUNCTION
/begin FUNCTION Byte_25 "" /begin DEF_CHARACTERISTIC /end DEF_CHARACTERISTIC /begin IN_MEASUREMENT /end IN_MEASUREMENT /begin OUT_MEASUREMENT /end OUT_MEASUREMENT /end FUNCTION
/begin FUNCTION Byte_26 "" /begin DEF_CHARACTERISTIC /end DEF_CHARACTERISTIC /begin IN_MEASUREMENT /end IN_MEASUREMENT /begin OUT_MEASUREMENT /end OUT_MEASUREMENT /end FUNCTION
/begin FUNCTION Byte_27 "" /begin DEF_CHARACTERISTIC /end DEF_CHARACTERISTIC /begin IN_MEASUREMENT /end IN_MEASUREMENT /begin OUT_MEASUREMENT /end OUT_MEASUREMENT /end FUNCTION
/begin FUNCTION Byte_28 "" /begin DEF_CHARACTERISTIC /end DEF_CHARACTERISTIC /begin IN_MEASUREMENT /end IN_MEASUREMENT /begin OUT_MEASUREMENT /end OUT_MEASUREMENT /end FUNCTION
/begin FUNCTION Byte_29 "" /begin DEF_CHARACTERISTIC /end DEF_CHARACTERISTIC /begin IN_MEASUREMENT /end IN_MEASUREMENT /begin OUT_MEASUREMENT /end OUT_MEASUREMENT /end FUNCTION
/begin FUNCTION Byte_30 "" /begin DEF_CHARACTERISTIC /end DEF_CHARACTERISTIC /begin IN_MEASUREMENT /end IN_MEASUREMENT /begin OUT_MEASUREMENT /end OUT_MEASUREMENT /end FUNCTION
/begin FUNCTION Byte_31 "" /begin DEF_CHARACTERISTIC /end DEF_CHARACTERISTIC /begin IN_MEASUREMENT /end IN_MEASUREMENT /begin OUT_MEASUREMENT /end OUT_MEASUREMENT /end FUNCTION
/begin FUNCTION Constant "" /begin DEF_CHARACTERISTIC KHAL_CAN3FD3VCU2E2E_flg /end DEF_CHARACTERISTIC /begin IN_MEASUREMENT /end IN_MEASUREMENT /begin OUT_MEASUREMENT /end OUT_MEASUREMENT /end FUNCTION
/begin FUNCTION Constant1 "" /begin DEF_CHARACTERISTIC /end DEF_CHARACTERISTIC /begin IN_MEASUREMENT /end IN_MEASUREMENT /begin OUT_MEASUREMENT /end OUT_MEASUREMENT /end FUNCTION
/begin FUNCTION Constant2 "" /begin DEF_CHARACTERISTIC /end DEF_CHARACTERISTIC /begin IN_MEASUREMENT /end IN_MEASUREMENT /begin OUT_MEASUREMENT /end OUT_MEASUREMENT /end FUNCTION
/begin FUNCTION Constant3 "" /begin DEF_CHARACTERISTIC KHAL_CAN3FD3VCU2E2E_flg /end DEF_CHARACTERISTIC /begin IN_MEASUREMENT /end IN_MEASUREMENT /begin OUT_MEASUREMENT /end OUT_MEASUREMENT /end FUNCTION
/begin FUNCTION Constant4 "" /begin DEF_CHARACTERISTIC KHAL_CAN3FD3VCU2E2E_flg /end DEF_CHARACTERISTIC /begin IN_MEASUREMENT /end IN_MEASUREMENT /begin OUT_MEASUREMENT /end OUT_MEASUREMENT /end FUNCTION
/begin FUNCTION Chart "" /begin DEF_CHARACTERISTIC /end DEF_CHARACTERISTIC /begin IN_MEASUREMENT /end IN_MEASUREMENT /begin OUT_MEASUREMENT /end OUT_MEASUREMENT /end FUNCTION
/begin FUNCTION Constant "" /begin DEF_CHARACTERISTIC /end DEF_CHARACTERISTIC /begin IN_MEASUREMENT /end IN_MEASUREMENT /begin OUT_MEASUREMENT /end OUT_MEASUREMENT /end FUNCTION
/begin FUNCTION Constant3 "" /begin DEF_CHARACTERISTIC /end DEF_CHARACTERISTIC /begin IN_MEASUREMENT /end IN_MEASUREMENT /begin OUT_MEASUREMENT /end OUT_MEASUREMENT /end FUNCTION
/begin FUNCTION Data_Type_Conversion "" /begin DEF_CHARACTERISTIC /end DEF_CHARACTERISTIC /begin IN_MEASUREMENT /end IN_MEASUREMENT /begin OUT_MEASUREMENT /end OUT_MEASUREMENT /end FUNCTION
/begin FUNCTION Gain "" /begin DEF_CHARACTERISTIC /end DEF_CHARACTERISTIC /begin IN_MEASUREMENT /end IN_MEASUREMENT /begin OUT_MEASUREMENT /end OUT_MEASUREMENT /end FUNCTION
/begin FUNCTION Divide "" /begin DEF_CHARACTERISTIC /end DEF_CHARACTERISTIC /begin IN_MEASUREMENT /end IN_MEASUREMENT /begin OUT_MEASUREMENT /end OUT_MEASUREMENT /end FUNCTION
/begin FUNCTION FD3_VCU2_toNIDEC "" /begin DEF_CHARACTERISTIC /end DEF_CHARACTERISTIC /begin IN_MEASUREMENT /end IN_MEASUREMENT /begin OUT_MEASUREMENT /end OUT_MEASUREMENT /end FUNCTION
/begin FUNCTION Byte_0 "" /begin SUB_FUNCTION SignalPack /end SUB_FUNCTION /begin DEF_CHARACTERISTIC /end DEF_CHARACTERISTIC /begin IN_MEASUREMENT /end IN_MEASUREMENT /begin OUT_MEASUREMENT /end OUT_MEASUREMENT /end FUNCTION
/begin FUNCTION Byte_1 "" /begin SUB_FUNCTION SignalPack /end SUB_FUNCTION /begin DEF_CHARACTERISTIC /end DEF_CHARACTERISTIC /begin IN_MEASUREMENT /end IN_MEASUREMENT /begin OUT_MEASUREMENT /end OUT_MEASUREMENT /end FUNCTION
/begin FUNCTION Byte_10 "" /begin SUB_FUNCTION SignalPack UnitConverter UnitConverter1 /end SUB_FUNCTION /begin DEF_CHARACTERISTIC /end DEF_CHARACTERISTIC /begin IN_MEASUREMENT /end IN_MEASUREMENT /begin OUT_MEASUREMENT /end OUT_MEASUREMENT /end FUNCTION
/begin FUNCTION Byte_11 "" /begin SUB_FUNCTION SignalPack UnitConverter UnitConverter1 /end SUB_FUNCTION /begin DEF_CHARACTERISTIC /end DEF_CHARACTERISTIC /begin IN_MEASUREMENT /end IN_MEASUREMENT /begin OUT_MEASUREMENT /end OUT_MEASUREMENT /end FUNCTION
/begin FUNCTION Byte_12 ""
 /begin SUB_FUNCTION SignalPack SignalPack1 UnitConverter UnitConverter1 UnitConverter2 UnitConverter3 /end SUB_FUNCTION
 /begin DEF_CHARACTERISTIC /end DEF_CHARACTERISTIC
 /begin IN_MEASUREMENT /end IN_MEASUREMENT
 /begin OUT_MEASUREMENT /end OUT_MEASUREMENT
/end FUNCTION
/begin FUNCTION Byte_13 "" /begin SUB_FUNCTION SignalPack UnitConverter UnitConverter1 /end SUB_FUNCTION /begin DEF_CHARACTERISTIC /end DEF_CHARACTERISTIC /begin IN_MEASUREMENT /end IN_MEASUREMENT /begin OUT_MEASUREMENT /end OUT_MEASUREMENT /end FUNCTION
/begin FUNCTION Byte_14 "" /begin SUB_FUNCTION SignalPack convert_out UnitConverter UnitConverter1 /end SUB_FUNCTION /begin DEF_CHARACTERISTIC /end DEF_CHARACTERISTIC /begin IN_MEASUREMENT /end IN_MEASUREMENT /begin OUT_MEASUREMENT /end OUT_MEASUREMENT /end FUNCTION
/begin FUNCTION Byte_15 "" /begin SUB_FUNCTION SignalPack convert_out UnitConverter UnitConverter1 /end SUB_FUNCTION /begin DEF_CHARACTERISTIC /end DEF_CHARACTERISTIC /begin IN_MEASUREMENT /end IN_MEASUREMENT /begin OUT_MEASUREMENT /end OUT_MEASUREMENT /end FUNCTION
/begin FUNCTION Byte_16 "" /begin SUB_FUNCTION SignalPack convert_out UnitConverter UnitConverter1 /end SUB_FUNCTION /begin DEF_CHARACTERISTIC /end DEF_CHARACTERISTIC /begin IN_MEASUREMENT /end IN_MEASUREMENT /begin OUT_MEASUREMENT /end OUT_MEASUREMENT /end FUNCTION
/begin FUNCTION Byte_17 "" /begin SUB_FUNCTION SignalPack convert_out UnitConverter UnitConverter1 /end SUB_FUNCTION /begin DEF_CHARACTERISTIC /end DEF_CHARACTERISTIC /begin IN_MEASUREMENT /end IN_MEASUREMENT /begin OUT_MEASUREMENT /end OUT_MEASUREMENT /end FUNCTION
/begin FUNCTION Byte_18 "" /begin SUB_FUNCTION SignalPack UnitConverter UnitConverter1 /end SUB_FUNCTION /begin DEF_CHARACTERISTIC /end DEF_CHARACTERISTIC /begin IN_MEASUREMENT /end IN_MEASUREMENT /begin OUT_MEASUREMENT /end OUT_MEASUREMENT /end FUNCTION
/begin FUNCTION Byte_19 ""
 /begin SUB_FUNCTION SignalPack SignalPack1 convert_out UnitConverter UnitConverter1 UnitConverter2 UnitConverter3 /end SUB_FUNCTION
 /begin DEF_CHARACTERISTIC /end DEF_CHARACTERISTIC
 /begin IN_MEASUREMENT /end IN_MEASUREMENT
 /begin OUT_MEASUREMENT /end OUT_MEASUREMENT
/end FUNCTION
/begin FUNCTION Byte_2 "" /begin SUB_FUNCTION SignalPack UnitConverter UnitConverter1 /end SUB_FUNCTION /begin DEF_CHARACTERISTIC /end DEF_CHARACTERISTIC /begin IN_MEASUREMENT /end IN_MEASUREMENT /begin OUT_MEASUREMENT /end OUT_MEASUREMENT /end FUNCTION
/begin FUNCTION Byte_20 "" /begin SUB_FUNCTION SignalPack convert_out UnitConverter UnitConverter1 /end SUB_FUNCTION /begin DEF_CHARACTERISTIC /end DEF_CHARACTERISTIC /begin IN_MEASUREMENT /end IN_MEASUREMENT /begin OUT_MEASUREMENT /end OUT_MEASUREMENT /end FUNCTION
/begin FUNCTION Byte_21 "" /begin SUB_FUNCTION SignalPack UnitConverter /end SUB_FUNCTION /begin DEF_CHARACTERISTIC /end DEF_CHARACTERISTIC /begin IN_MEASUREMENT /end IN_MEASUREMENT /begin OUT_MEASUREMENT /end OUT_MEASUREMENT /end FUNCTION
/begin FUNCTION Byte_22 ""
 /begin SUB_FUNCTION SignalPack SignalPack1 convert_out UnitConverter UnitConverter2 UnitConverter3 /end SUB_FUNCTION
 /begin DEF_CHARACTERISTIC /end DEF_CHARACTERISTIC
 /begin IN_MEASUREMENT /end IN_MEASUREMENT
 /begin OUT_MEASUREMENT /end OUT_MEASUREMENT
/end FUNCTION
/begin FUNCTION Byte_23 "" /begin SUB_FUNCTION SignalPack convert_out UnitConverter UnitConverter1 /end SUB_FUNCTION /begin DEF_CHARACTERISTIC /end DEF_CHARACTERISTIC /begin IN_MEASUREMENT /end IN_MEASUREMENT /begin OUT_MEASUREMENT /end OUT_MEASUREMENT /end FUNCTION
/begin FUNCTION Byte_3 ""
 /begin SUB_FUNCTION SignalPack SignalPack1 convert_out UnitConverter UnitConverter1 UnitConverter2 UnitConverter3 /end SUB_FUNCTION
 /begin DEF_CHARACTERISTIC /end DEF_CHARACTERISTIC
 /begin IN_MEASUREMENT /end IN_MEASUREMENT
 /begin OUT_MEASUREMENT /end OUT_MEASUREMENT
/end FUNCTION
/begin FUNCTION Byte_4 "" /begin SUB_FUNCTION SignalPack convert_out UnitConverter UnitConverter1 /end SUB_FUNCTION /begin DEF_CHARACTERISTIC /end DEF_CHARACTERISTIC /begin IN_MEASUREMENT /end IN_MEASUREMENT /begin OUT_MEASUREMENT /end OUT_MEASUREMENT /end FUNCTION
/begin FUNCTION Byte_5 "" /begin SUB_FUNCTION SignalPack UnitConverter /end SUB_FUNCTION /begin DEF_CHARACTERISTIC /end DEF_CHARACTERISTIC /begin IN_MEASUREMENT /end IN_MEASUREMENT /begin OUT_MEASUREMENT /end OUT_MEASUREMENT /end FUNCTION
/begin FUNCTION Byte_6 ""
 /begin SUB_FUNCTION SignalPack SignalPack1 convert_out UnitConverter UnitConverter2 UnitConverter3 /end SUB_FUNCTION
 /begin DEF_CHARACTERISTIC /end DEF_CHARACTERISTIC
 /begin IN_MEASUREMENT /end IN_MEASUREMENT
 /begin OUT_MEASUREMENT /end OUT_MEASUREMENT
/end FUNCTION
/begin FUNCTION Byte_7 "" /begin SUB_FUNCTION SignalPack convert_out UnitConverter UnitConverter1 /end SUB_FUNCTION /begin DEF_CHARACTERISTIC /end DEF_CHARACTERISTIC /begin IN_MEASUREMENT /end IN_MEASUREMENT /begin OUT_MEASUREMENT /end OUT_MEASUREMENT /end FUNCTION
/begin FUNCTION Byte_8 "" /begin SUB_FUNCTION SignalPack UnitConverter UnitConverter1 /end SUB_FUNCTION /begin DEF_CHARACTERISTIC /end DEF_CHARACTERISTIC /begin IN_MEASUREMENT /end IN_MEASUREMENT /begin OUT_MEASUREMENT /end OUT_MEASUREMENT /end FUNCTION
/begin FUNCTION Byte_9 ""
 /begin SUB_FUNCTION SignalPack SignalPack1 UnitConverter UnitConverter1 UnitConverter2 UnitConverter3 /end SUB_FUNCTION
 /begin DEF_CHARACTERISTIC /end DEF_CHARACTERISTIC
 /begin IN_MEASUREMENT /end IN_MEASUREMENT
 /begin OUT_MEASUREMENT /end OUT_MEASUREMENT
/end FUNCTION
/begin FUNCTION CRC8_IfAction_Tx ""
 /begin SUB_FUNCTION If_Action_Subsystem If_Action_Subsystem1 Data_Type_Conversion If Merge /end SUB_FUNCTION
 /begin DEF_CHARACTERISTIC /end DEF_CHARACTERISTIC
 /begin IN_MEASUREMENT /end IN_MEASUREMENT
 /begin OUT_MEASUREMENT /end OUT_MEASUREMENT
/end FUNCTION
/begin FUNCTION CSVCU2CAN1toNidec "" /begin SUB_FUNCTION /end SUB_FUNCTION /begin DEF_CHARACTERISTIC /end DEF_CHARACTERISTIC /begin IN_MEASUREMENT /end IN_MEASUREMENT /begin OUT_MEASUREMENT /end OUT_MEASUREMENT /end FUNCTION
/begin FUNCTION FrIdcMaxtoNidec "" /begin SUB_FUNCTION Data_Type_Conversion /end SUB_FUNCTION /begin DEF_CHARACTERISTIC /end DEF_CHARACTERISTIC /begin IN_MEASUREMENT /end IN_MEASUREMENT /begin OUT_MEASUREMENT /end OUT_MEASUREMENT /end FUNCTION
/begin FUNCTION FrIdcMintoNidec "" /begin SUB_FUNCTION convert_out Data_Type_Conversion /end SUB_FUNCTION /begin DEF_CHARACTERISTIC /end DEF_CHARACTERISTIC /begin IN_MEASUREMENT /end IN_MEASUREMENT /begin OUT_MEASUREMENT /end OUT_MEASUREMENT /end FUNCTION
/begin RECORD_LAYOUT Scalar_BOOLEAN FNC_VALUES 1 UBYTE COLUMN_DIR DIRECT /end RECORD_LAYOUT
/begin RECORD_LAYOUT Lookup1D_X_BOOLEAN AXIS_PTS_X 1 UBYTE INDEX_INCR DIRECT /end RECORD_LAYOUT
/begin RECORD_LAYOUT Lookup1D_BYTE FNC_VALUES 1 SBYTE COLUMN_DIR DIRECT /end RECORD_LAYOUT
/begin RECORD_LAYOUT Lookup1D_X_BYTE AXIS_PTS_X 1 SBYTE INDEX_INCR DIRECT /end RECORD_LAYOUT
/begin CHARACTERISTIC KHAL_CAN1VMCFCM1E2E_flg "" VALUE 0 Scalar_BOOLEAN 0 SWC_HALOUT_type_CM_boolean_flg 0.0 1.0 /end CHARACTERISTIC
/begin CHARACTERISTIC KHAL_CAN3FD3VCU2E2E_flg "" VALUE 0 Scalar_BOOLEAN 0 SWC_HALOUT_type_CM_boolean_flg 0.0 1.0 /end CHARACTERISTIC
/begin COMPU_METHOD SWC_HALOUT_type_CM_boolean_flg "Q = V" RAT_FUNC "%1.0" "flg" COEFFS 0 1 0 0 0 1 /end COMPU_METHOD
/begin GROUP S39_VMC_FCM1_0x172 "SWC_HALOUT_type/run_SWC_HALOUT_Tx_5ms_sys/HAL_OUT/CAN1/VMC_FCM1_0x172" /begin REF_CHARACTERISTIC KHAL_CAN1VMCFCM1E2E_flg /end REF_CHARACTERISTIC /end GROUP
/begin GROUP S41_FD3_VCU2_0x153 "SWC_HALOUT_type/run_SWC_HALOUT_Tx_5ms_sys/HAL_OUT/CAN3/FD3_VCU2_0x153" /begin REF_CHARACTERISTIC KHAL_CAN3FD3VCU2E2E_flg /end REF_CHARACTERISTIC /end GROUP
/end MODULE
/end PROJECT
