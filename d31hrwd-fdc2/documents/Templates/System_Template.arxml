AUTOSAR XML (schema 4-3-0)
package /SysEnv_ARPkg
  system SystemName: category=SYSTEM_DESCRIPTION, ecu-extract-version=1.0.0, system-version=1.0.0
    system mapping SystemMapping
      sw-impl-mappings:
        12 x swc to impl mapping:
          BswMTest_ImplMapping: component-implementation=Impl_BswMTest_type, component=root_FDC.BswMTest
          SWC_APS_ImplMapping: component-implementation=Impl_SWC_APS_type, component=root_FDC.SWC_APS
          SWC_CDD_ImplMapping: component-implementation=Impl_SWC_CDD_type, component=root_FDC.SWC_CDD
          SWC_DID_ImplMapping: component-implementation=Impl_SWC_DID_type, component=root_FDC.SWC_DID
          SWC_FDC_ImplMapping: component-implementation=Impl_SWC_FDC_type, component=root_FDC.SWC_FDC
          SWC_IMU_ImplMapping: component-implementation=Impl_SWC_IMU_type, component=root_FDC.SWC_IMU
          SWC_NVM_ImplMapping: component-implementation=Impl_SWC_NVM_type, component=root_FDC.SWC_NVM
          SWC_UDS_ImplMapping: component-implementation=Impl_SWC_UDS_type, component=root_FDC.SWC_UDS
          SWC_VES_ImplMapping: component-implementation=Impl_SWC_VES_type, component=root_FDC.SWC_VES
          SWC_UART_ImplMapping: component-implementation=Impl_SWC_UART_type, component=root_FDC.SWC_UART
          SWC_IOEXP_ImplMapping: component-implementation=Impl_SWC_IOEXP_type, component=root_FDC.SWC_IOEXP
          SWC_CGW_ImplMapping: component-implementation=Impl_SWC_CGW_type, component=root_FDC.SWC_CGW
      sw-mappings:
        swc to ecu mapping SWC_ECUMapping: ecu-instance=FUSION
          component:
            root_FDC.SWC_FDC
            root_FDC.SWC_CDD
            root_FDC.SWC_VES
            root_FDC.BswMTest
            root_FDC.SWC_NVM
            root_FDC.SWC_UDS
            root_FDC.SWC_IMU
            root_FDC.SWC_UART
            root_FDC.SWC_DID
            root_FDC.SWC_IOEXP
            root_FDC.SWC_APS
            root_FDC.SWC_CGW
    system mapping SignalMappings: sender-receiver-to-signal-group-mapping{communication-direction=OUT, data-element=SWC_FDC.root_FDC.P_CAN1_FD_BCM1.CAN1_SG_FD_BCM1, signal-group=CAN1_SG_FD_BCM1, type-mapping=sender-rec-record-type-mapping=sender-rec-record-element-mapping{implementation-record-element=CAN1_AllDoorSW, system-signal=CAN1_AllDoorSW}}
    root-software-compositions:
      root sw composition prototype root_FDC: flat-map=root_FDC_FlatMap, software-composition=Comp_FDC_main
  flat map root_FDC_FlatMap
    flat instance descriptor FlatIns_FDC: upstream-reference=root_FDC.SWC_FDC, ecu-extract-reference=root_FDC.SWC_FDC
