ASAP2_VERSION 1 31
/begin PROJECT ProjectName "Project Comment Goes Here"
/begin HEADER "Header Comments go here" /end HEADER
/begin MODULE ModuleName "Module Comment Goes Here"
/begin MOD_COMMON "Mod Common Comment Here" BYTE_ORDER MSB_LAST /end MOD_COMMON
/begin RECORD_LAYOUT Scalar_BOOLEAN FNC_VALUES 1 UBYTE COLUMN_DIR DIRECT /end RECORD_LAYOUT
/begin RECORD_LAYOUT Scalar_UBYTE FNC_VALUES 1 UBYTE COLUMN_DIR DIRECT /end RECORD_LAYOUT
/begin RECORD_LAYOUT Scalar_FLOAT32_IEEE FNC_VALUES 1 FLOAT32_IEEE COLUMN_DIR DIRECT /end RECORD_LAYOUT
/begin RECORD_LAYOUT Lookup2D_UBYTE FNC_VALUES 1 UBYTE COLUMN_DIR DIRECT /end RECORD_LAYOUT
/begin RECORD_LAYOUT Lookup2D_X_UBYTE AXIS_PTS_X 1 UBYTE INDEX_INCR DIRECT /end RECORD_LAYOUT
/begin RECORD_LAYOUT Lookup2D_BYTE FNC_VALUES 1 SBYTE COLUMN_DIR DIRECT /end RECORD_LAYOUT
/begin RECORD_LAYOUT Lookup2D_X_BYTE AXIS_PTS_X 1 SBYTE INDEX_INCR DIRECT /end RECORD_LAYOUT
/begin RECORD_LAYOUT Lookup2D_UWORD FNC_VALUES 1 UWORD COLUMN_DIR DIRECT /end RECORD_LAYOUT
/begin RECORD_LAYOUT Lookup2D_X_UWORD AXIS_PTS_X 1 UWORD INDEX_INCR DIRECT /end RECORD_LAYOUT
/begin RECORD_LAYOUT Lookup2D_WORD FNC_VALUES 1 SWORD COLUMN_DIR DIRECT /end RECORD_LAYOUT
/begin RECORD_LAYOUT Lookup2D_X_WORD AXIS_PTS_X 1 SWORD INDEX_INCR DIRECT /end RECORD_LAYOUT
/begin RECORD_LAYOUT Lookup2D_ULONG FNC_VALUES 1 ULONG COLUMN_DIR DIRECT /end RECORD_LAYOUT
/begin RECORD_LAYOUT Lookup2D_X_ULONG AXIS_PTS_X 1 ULONG INDEX_INCR DIRECT /end RECORD_LAYOUT
/begin RECORD_LAYOUT Lookup2D_LONG FNC_VALUES 1 SLONG COLUMN_DIR DIRECT /end RECORD_LAYOUT
/begin RECORD_LAYOUT Lookup2D_X_LONG AXIS_PTS_X 1 SLONG INDEX_INCR DIRECT /end RECORD_LAYOUT
/begin RECORD_LAYOUT Lookup2D_FLOAT32_IEEE FNC_VALUES 1 FLOAT32_IEEE COLUMN_DIR DIRECT /end RECORD_LAYOUT
/begin RECORD_LAYOUT Lookup2D_X_FLOAT32_IEEE AXIS_PTS_X 1 FLOAT32_IEEE INDEX_INCR DIRECT /end RECORD_LAYOUT
/begin RECORD_LAYOUT Lookup2D_FLOAT64_IEEE FNC_VALUES 1 FLOAT64_IEEE COLUMN_DIR DIRECT /end RECORD_LAYOUT
/begin RECORD_LAYOUT Lookup2D_X_FLOAT64_IEEE AXIS_PTS_X 1 FLOAT64_IEEE INDEX_INCR DIRECT /end RECORD_LAYOUT
/begin CHARACTERISTIC KINP_ACAmbTemp_C_defval "" VALUE 0x0000 /* @ECU_Address@KINP_ACAmbTemp_C_defval@ */ Scalar_FLOAT32_IEEE 0 SWC_INP_type_CM_single_C -20.0 1735.0 /end CHARACTERISTIC
/begin CHARACTERISTIC KINP_ACAmbTemp_C_ovrdval "" VALUE 0x0000 /* @ECU_Address@KINP_ACAmbTemp_C_ovrdval@ */ Scalar_FLOAT32_IEEE 0 SWC_INP_type_CM_single_C -20.0 1735.0 /end CHARACTERISTIC
/begin CHARACTERISTIC KINP_ACTempSetSta_C_defval "" VALUE 0x0000 /* @ECU_Address@KINP_ACTempSetSta_C_defval@ */ Scalar_FLOAT32_IEEE 0 SWC_INP_type_CM_single_C -40.0 215.0 /end CHARACTERISTIC
/begin CHARACTERISTIC KINP_ACTempSetSta_C_ovrdval "" VALUE 0x0000 /* @ECU_Address@KINP_ACTempSetSta_C_ovrdval@ */ Scalar_FLOAT32_IEEE 0 SWC_INP_type_CM_single_C -40.0 215.0 /end CHARACTERISTIC
/begin CHARACTERISTIC KINP_AirPressureFC2_kPa_defval "" VALUE 0x0000 /* @ECU_Address@KINP_AirPressureFC2_kPa_defval@ */ Scalar_FLOAT32_IEEE 0 SWC_INP_type_CM_single_kPa 0.0 2008.0 /end CHARACTERISTIC
/begin CHARACTERISTIC KINP_AirPressureFC2_kPa_ovrdval "" VALUE 0x0000 /* @ECU_Address@KINP_AirPressureFC2_kPa_ovrdval@ */ Scalar_FLOAT32_IEEE 0 SWC_INP_type_CM_single_kPa 0.0 2008.0 /end CHARACTERISTIC
/begin CHARACTERISTIC KINP_AirPressurePC3_kPa_defval "" VALUE 0x0000 /* @ECU_Address@KINP_AirPressurePC3_kPa_defval@ */ Scalar_FLOAT32_IEEE 0 SWC_INP_type_CM_single_kPa 0.0 2000.0 /end CHARACTERISTIC
/begin CHARACTERISTIC KINP_AirPressurePC3_kPa_ovrdval "" VALUE 0x0000 /* @ECU_Address@KINP_AirPressurePC3_kPa_ovrdval@ */ Scalar_FLOAT32_IEEE 0 SWC_INP_type_CM_single_kPa 0.0 2000.0 /end CHARACTERISTIC
/begin CHARACTERISTIC KINP_AirPressureRC1_kPa_defval "" VALUE 0x0000 /* @ECU_Address@KINP_AirPressureRC1_kPa_defval@ */ Scalar_FLOAT32_IEEE 0 SWC_INP_type_CM_single_kPa 0.0 2008.0 /end CHARACTERISTIC
/begin CHARACTERISTIC KINP_AirPressureRC1_kPa_ovrdval "" VALUE 0x0000 /* @ECU_Address@KINP_AirPressureRC1_kPa_ovrdval@ */ Scalar_FLOAT32_IEEE 0 SWC_INP_type_CM_single_kPa 0.0 2008.0 /end CHARACTERISTIC
/begin CHARACTERISTIC KINP_B2VAPlsDischgCurr_A_defval "" VALUE 0x0000 /* @ECU_Address@KINP_B2VAPlsDischgCurr_A_defval@ */ Scalar_FLOAT32_IEEE 0 SWC_INP_type_CM_single_A 0.0 6553.5 /end CHARACTERISTIC
/begin CHARACTERISTIC KINP_B2VAPlsDischgCurr_A_ovrdval "" VALUE 0x0000 /* @ECU_Address@KINP_B2VAPlsDischgCurr_A_ovrdval@ */ Scalar_FLOAT32_IEEE 0 SWC_INP_type_CM_single_A 0.0 6553.5 /end CHARACTERISTIC
/begin CHARACTERISTIC KINP_B2VAvaPlsChgCurr_A_defval "" VALUE 0x0000 /* @ECU_Address@KINP_B2VAvaPlsChgCurr_A_defval@ */ Scalar_FLOAT32_IEEE 0 SWC_INP_type_CM_single_A 0.0 6553.5 /end CHARACTERISTIC
/begin CHARACTERISTIC KINP_B2VAvaPlsChgCurr_A_ovrdval "" VALUE 0x0000 /* @ECU_Address@KINP_B2VAvaPlsChgCurr_A_ovrdval@ */ Scalar_FLOAT32_IEEE 0 SWC_INP_type_CM_single_A 0.0 6553.5 /end CHARACTERISTIC
/begin CHARACTERISTIC KINP_B2VCellMinVol_V_defval "" VALUE 0x0000 /* @ECU_Address@KINP_B2VCellMinVol_V_defval@ */ Scalar_FLOAT32_IEEE 0 SWC_INP_type_CM_single_V 0.0 65.535 /end CHARACTERISTIC
/begin CHARACTERISTIC KINP_B2VCellMinVol_V_ovrdval "" VALUE 0x0000 /* @ECU_Address@KINP_B2VCellMinVol_V_ovrdval@ */ Scalar_FLOAT32_IEEE 0 SWC_INP_type_CM_single_V 0.0 65.535 /end CHARACTERISTIC
/begin CHARACTERISTIC KINP_B2VPackCurr_A_defval "" VALUE 0x0000 /* @ECU_Address@KINP_B2VPackCurr_A_defval@ */ Scalar_FLOAT32_IEEE 0 SWC_INP_type_CM_single_A -1000.0 1000.0 /end CHARACTERISTIC
/begin CHARACTERISTIC KINP_B2VPackCurr_A_ovrdval "" VALUE 0x0000 /* @ECU_Address@KINP_B2VPackCurr_A_ovrdval@ */ Scalar_FLOAT32_IEEE 0 SWC_INP_type_CM_single_A -1000.0 1000.0 /end CHARACTERISTIC
/begin CHARACTERISTIC KINP_B2VPackInsideVol_V_defval "" VALUE 0x0000 /* @ECU_Address@KINP_B2VPackInsideVol_V_defval@ */ Scalar_FLOAT32_IEEE 0 SWC_INP_type_CM_single_V 0.0 1000.0 /end CHARACTERISTIC
/begin CHARACTERISTIC KINP_B2VPackInsideVol_V_ovrdval "" VALUE 0x0000 /* @ECU_Address@KINP_B2VPackInsideVol_V_ovrdval@ */ Scalar_FLOAT32_IEEE 0 SWC_INP_type_CM_single_V 0.0 1000.0 /end CHARACTERISTIC
/begin CHARACTERISTIC KINP_B2VSOC_pct_defval "" VALUE 0x0000 /* @ECU_Address@KINP_B2VSOC_pct_defval@ */ Scalar_FLOAT32_IEEE 0 SWC_INP_type_CM_single_pct 0.0 100.0 /end CHARACTERISTIC
/begin CHARACTERISTIC KINP_B2VSOC_pct_ovrdval "" VALUE 0x0000 /* @ECU_Address@KINP_B2VSOC_pct_ovrdval@ */ Scalar_FLOAT32_IEEE 0 SWC_INP_type_CM_single_pct 0.0 100.0 /end CHARACTERISTIC
/begin CHARACTERISTIC KINP_BrakePedalPos_pct_defval "" VALUE 0x0000 /* @ECU_Address@KINP_BrakePedalPos_pct_defval@ */ Scalar_FLOAT32_IEEE 0 SWC_INP_type_CM_single_pct 0.0 100.0 /end CHARACTERISTIC
/begin CHARACTERISTIC KINP_BrakePedalPos_pct_ovrdval "" VALUE 0x0000 /* @ECU_Address@KINP_BrakePedalPos_pct_ovrdval@ */ Scalar_FLOAT32_IEEE 0 SWC_INP_type_CM_single_pct 0.0 100.0 /end CHARACTERISTIC
/begin CHARACTERISTIC KINP_DCDCOutVolSta_V_defval "" VALUE 0x0000 /* @ECU_Address@KINP_DCDCOutVolSta_V_defval@ */ Scalar_FLOAT32_IEEE 0 SWC_INP_type_CM_single_V 0.0 1000.0 /end CHARACTERISTIC
/begin CHARACTERISTIC KINP_DCDCOutVolSta_V_ovrdval "" VALUE 0x0000 /* @ECU_Address@KINP_DCDCOutVolSta_V_ovrdval@ */ Scalar_FLOAT32_IEEE 0 SWC_INP_type_CM_single_V 0.0 1000.0 /end CHARACTERISTIC
/begin CHARACTERISTIC KINP_DCDCTempSta_C_defval "" VALUE 0x0000 /* @ECU_Address@KINP_DCDCTempSta_C_defval@ */ Scalar_FLOAT32_IEEE 0 SWC_INP_type_CM_single_C -40.0 200.0 /end CHARACTERISTIC
/begin CHARACTERISTIC KINP_DCDCTempSta_C_ovrdval "" VALUE 0x0000 /* @ECU_Address@KINP_DCDCTempSta_C_ovrdval@ */ Scalar_FLOAT32_IEEE 0 SWC_INP_type_CM_single_C -40.0 200.0 /end CHARACTERISTIC
/begin CHARACTERISTIC KINP_EACInvTempSta_C_defval "" VALUE 0x0000 /* @ECU_Address@KINP_EACInvTempSta_C_defval@ */ Scalar_FLOAT32_IEEE 0 SWC_INP_type_CM_single_C -40.0 150.0 /end CHARACTERISTIC
/begin CHARACTERISTIC KINP_EACInvTempSta_C_ovrdval "" VALUE 0x0000 /* @ECU_Address@KINP_EACInvTempSta_C_ovrdval@ */ Scalar_FLOAT32_IEEE 0 SWC_INP_type_CM_single_C -40.0 150.0 /end CHARACTERISTIC
/begin CHARACTERISTIC KINP_EHPSInvTempSta_C_defval "" VALUE 0x0000 /* @ECU_Address@KINP_EHPSInvTempSta_C_defval@ */ Scalar_FLOAT32_IEEE 0 SWC_INP_type_CM_single_C -40.0 150.0 /end CHARACTERISTIC
/begin CHARACTERISTIC KINP_EHPSInvTempSta_C_ovrdval "" VALUE 0x0000 /* @ECU_Address@KINP_EHPSInvTempSta_C_ovrdval@ */ Scalar_FLOAT32_IEEE 0 SWC_INP_type_CM_single_C -40.0 150.0 /end CHARACTERISTIC
/begin CHARACTERISTIC KINP_EHPSMotorSpdSta_rpm_defval "" VALUE 0x0000 /* @ECU_Address@KINP_EHPSMotorSpdSta_rpm_defval@ */ Scalar_FLOAT32_IEEE 0 SWC_INP_type_CM_single_rpm -5000.0 5000.0 /end CHARACTERISTIC
/begin CHARACTERISTIC KINP_EHPSMotorSpdSta_rpm_ovrdval "" VALUE 0x0000 /* @ECU_Address@KINP_EHPSMotorSpdSta_rpm_ovrdval@ */ Scalar_FLOAT32_IEEE 0 SWC_INP_type_CM_single_rpm -5000.0 5000.0 /end CHARACTERISTIC
/begin CHARACTERISTIC KINP_EM1ReqTorqHRlsBrk_pct_defval "" VALUE 0x0000 /* @ECU_Address@KINP_EM1ReqTorqHRlsBrk_pct_defval@ */ Scalar_FLOAT32_IEEE 0 SWC_INP_type_CM_single_pct 0.0 15.0 /end CHARACTERISTIC
/begin CHARACTERISTIC KINP_EM1ReqTorqHRlsBrk_pct_ovrdval "" VALUE 0x0000 /* @ECU_Address@KINP_EM1ReqTorqHRlsBrk_pct_ovrdval@ */ Scalar_FLOAT32_IEEE 0 SWC_INP_type_CM_single_pct 0.0 15.0 /end CHARACTERISTIC
/begin CHARACTERISTIC KINP_EM1ReqTorqHRlsDri_pct_defval "" VALUE 0x0000 /* @ECU_Address@KINP_EM1ReqTorqHRlsDri_pct_defval@ */ Scalar_FLOAT32_IEEE 0 SWC_INP_type_CM_single_pct 0.0 15.0 /end CHARACTERISTIC
/begin CHARACTERISTIC KINP_EM1ReqTorqHRlsDri_pct_ovrdval "" VALUE 0x0000 /* @ECU_Address@KINP_EM1ReqTorqHRlsDri_pct_ovrdval@ */ Scalar_FLOAT32_IEEE 0 SWC_INP_type_CM_single_pct 0.0 15.0 /end CHARACTERISTIC
/begin CHARACTERISTIC KINP_EM1ReqTorqLimBrk_pct_defval "" VALUE 0x0000 /* @ECU_Address@KINP_EM1ReqTorqLimBrk_pct_defval@ */ Scalar_FLOAT32_IEEE 0 SWC_INP_type_CM_single_pct -125.0 125.0 /end CHARACTERISTIC
/begin CHARACTERISTIC KINP_EM1ReqTorqLimBrk_pct_ovrdval "" VALUE 0x0000 /* @ECU_Address@KINP_EM1ReqTorqLimBrk_pct_ovrdval@ */ Scalar_FLOAT32_IEEE 0 SWC_INP_type_CM_single_pct -125.0 125.0 /end CHARACTERISTIC
/begin CHARACTERISTIC KINP_EM1ReqTorqLimDriv_pct_defval "" VALUE 0x0000 /* @ECU_Address@KINP_EM1ReqTorqLimDriv_pct_defval@ */ Scalar_FLOAT32_IEEE 0 SWC_INP_type_CM_single_pct -125.0 125.0 /end CHARACTERISTIC
/begin CHARACTERISTIC KINP_EM1ReqTorqLimDriv_pct_ovrdval "" VALUE 0x0000 /* @ECU_Address@KINP_EM1ReqTorqLimDriv_pct_ovrdval@ */ Scalar_FLOAT32_IEEE 0 SWC_INP_type_CM_single_pct -125.0 125.0 /end CHARACTERISTIC
/begin CHARACTERISTIC KINP_EngRetSel_pct_defval "" VALUE 0x0000 /* @ECU_Address@KINP_EngRetSel_pct_defval@ */ Scalar_FLOAT32_IEEE 0 SWC_INP_type_CM_single_pct 0.0 100.0 /end CHARACTERISTIC
/begin CHARACTERISTIC KINP_EngRetSel_pct_ovrdval "" VALUE 0x0000 /* @ECU_Address@KINP_EngRetSel_pct_ovrdval@ */ Scalar_FLOAT32_IEEE 0 SWC_INP_type_CM_single_pct 0.0 100.0 /end CHARACTERISTIC
/begin CHARACTERISTIC KINP_FASpeed_kph_defval "" VALUE 0x0000 /* @ECU_Address@KINP_FASpeed_kph_defval@ */ Scalar_FLOAT32_IEEE 0 SWC_INP_type_CM_single_kph 0.0 255.9961 /end CHARACTERISTIC
/begin CHARACTERISTIC KINP_FASpeed_kph_ovrdval "" VALUE 0x0000 /* @ECU_Address@KINP_FASpeed_kph_ovrdval@ */ Scalar_FLOAT32_IEEE 0 SWC_INP_type_CM_single_kph 0.0 255.9961 /end CHARACTERISTIC
/begin CHARACTERISTIC KINP_MCUDCCur_A_defval "" VALUE 0x0000 /* @ECU_Address@KINP_MCUDCCur_A_defval@ */ Scalar_FLOAT32_IEEE 0 SWC_INP_type_CM_single_A -1000.0 1000.0 /end CHARACTERISTIC
/begin CHARACTERISTIC KINP_MCUDCCur_A_ovrdval "" VALUE 0x0000 /* @ECU_Address@KINP_MCUDCCur_A_ovrdval@ */ Scalar_FLOAT32_IEEE 0 SWC_INP_type_CM_single_A -1000.0 1000.0 /end CHARACTERISTIC
/begin CHARACTERISTIC KINP_MCUDCVol_V_defval "" VALUE 0x0000 /* @ECU_Address@KINP_MCUDCVol_V_defval@ */ Scalar_FLOAT32_IEEE 0 SWC_INP_type_CM_single_V 0.0 1000.0 /end CHARACTERISTIC
/begin CHARACTERISTIC KINP_MCUDCVol_V_ovrdval "" VALUE 0x0000 /* @ECU_Address@KINP_MCUDCVol_V_ovrdval@ */ Scalar_FLOAT32_IEEE 0 SWC_INP_type_CM_single_V 0.0 1000.0 /end CHARACTERISTIC
/begin CHARACTERISTIC KINP_MCUTemp_C_defval "" VALUE 0x0000 /* @ECU_Address@KINP_MCUTemp_C_defval@ */ Scalar_FLOAT32_IEEE 0 SWC_INP_type_CM_single_C -40.0 215.0 /end CHARACTERISTIC
/begin CHARACTERISTIC KINP_MCUTemp_C_ovrdval "" VALUE 0x0000 /* @ECU_Address@KINP_MCUTemp_C_ovrdval@ */ Scalar_FLOAT32_IEEE 0 SWC_INP_type_CM_single_C -40.0 215.0 /end CHARACTERISTIC
/begin CHARACTERISTIC KINP_MCUTrqLimHi_Nm_defval "" VALUE 0x0000 /* @ECU_Address@KINP_MCUTrqLimHi_Nm_defval@ */ Scalar_FLOAT32_IEEE 0 SWC_INP_type_CM_single_Nm 0.0 5000.0 /end CHARACTERISTIC
/begin CHARACTERISTIC KINP_MCUTrqLimHi_Nm_ovrdval "" VALUE 0x0000 /* @ECU_Address@KINP_MCUTrqLimHi_Nm_ovrdval@ */ Scalar_FLOAT32_IEEE 0 SWC_INP_type_CM_single_Nm 0.0 5000.0 /end CHARACTERISTIC
/begin CHARACTERISTIC KINP_MCUTrqLimLo_Nm_defval "" VALUE 0x0000 /* @ECU_Address@KINP_MCUTrqLimLo_Nm_defval@ */ Scalar_FLOAT32_IEEE 0 SWC_INP_type_CM_single_Nm -5000.0 0.0 /end CHARACTERISTIC
/begin CHARACTERISTIC KINP_MCUTrqLimLo_Nm_ovrdval "" VALUE 0x0000 /* @ECU_Address@KINP_MCUTrqLimLo_Nm_ovrdval@ */ Scalar_FLOAT32_IEEE 0 SWC_INP_type_CM_single_Nm -5000.0 0.0 /end CHARACTERISTIC
/begin CHARACTERISTIC KINP_MotorSpd_rpm_defval "" VALUE 0x0000 /* @ECU_Address@KINP_MotorSpd_rpm_defval@ */ Scalar_FLOAT32_IEEE 0 SWC_INP_type_CM_single_rpm -15000.0 15000.0 /end CHARACTERISTIC
/begin CHARACTERISTIC KINP_MotorSpd_rpm_ovrdval "" VALUE 0x0000 /* @ECU_Address@KINP_MotorSpd_rpm_ovrdval@ */ Scalar_FLOAT32_IEEE 0 SWC_INP_type_CM_single_rpm -15000.0 15000.0 /end CHARACTERISTIC
/begin CHARACTERISTIC KINP_MotorTemp_C_defval "" VALUE 0x0000 /* @ECU_Address@KINP_MotorTemp_C_defval@ */ Scalar_FLOAT32_IEEE 0 SWC_INP_type_CM_single_C -40.0 215.0 /end CHARACTERISTIC
/begin CHARACTERISTIC KINP_MotorTemp_C_ovrdval "" VALUE 0x0000 /* @ECU_Address@KINP_MotorTemp_C_ovrdval@ */ Scalar_FLOAT32_IEEE 0 SWC_INP_type_CM_single_C -40.0 215.0 /end CHARACTERISTIC
/begin CHARACTERISTIC KINP_MotorTrq_Nm_defval "" VALUE 0x0000 /* @ECU_Address@KINP_MotorTrq_Nm_defval@ */ Scalar_FLOAT32_IEEE 0 SWC_INP_type_CM_single_Nm -5000.0 5000.0 /end CHARACTERISTIC
/begin CHARACTERISTIC KINP_MotorTrq_Nm_ovrdval "" VALUE 0x0000 /* @ECU_Address@KINP_MotorTrq_Nm_ovrdval@ */ Scalar_FLOAT32_IEEE 0 SWC_INP_type_CM_single_Nm -5000.0 5000.0 /end CHARACTERISTIC
/begin CHARACTERISTIC KINP_RelaSpdFALWheel_kph_defval "" VALUE 0x0000 /* @ECU_Address@KINP_RelaSpdFALWheel_kph_defval@ */ Scalar_FLOAT32_IEEE 0 SWC_INP_type_CM_single_kph -7.8125 7.8125 /end CHARACTERISTIC
/begin CHARACTERISTIC KINP_RelaSpdFALWheel_kph_ovrdval "" VALUE 0x0000 /* @ECU_Address@KINP_RelaSpdFALWheel_kph_ovrdval@ */ Scalar_FLOAT32_IEEE 0 SWC_INP_type_CM_single_kph -7.8125 7.8125 /end CHARACTERISTIC
/begin CHARACTERISTIC KINP_RelaSpdFARWheel_kph_defval "" VALUE 0x0000 /* @ECU_Address@KINP_RelaSpdFARWheel_kph_defval@ */ Scalar_FLOAT32_IEEE 0 SWC_INP_type_CM_single_kph -7.8125 7.8125 /end CHARACTERISTIC
/begin CHARACTERISTIC KINP_RelaSpdFARWheel_kph_ovrdval "" VALUE 0x0000 /* @ECU_Address@KINP_RelaSpdFARWheel_kph_ovrdval@ */ Scalar_FLOAT32_IEEE 0 SWC_INP_type_CM_single_kph -7.8125 7.8125 /end CHARACTERISTIC
/begin CHARACTERISTIC KINP_SACtrlBrakeCtrl_SA_defval "" VALUE 0x0000 /* @ECU_Address@KINP_SACtrlBrakeCtrl_SA_defval@ */ Scalar_FLOAT32_IEEE 0 SWC_INP_type_CM_single_SA 0.0 255.0 /end CHARACTERISTIC
/begin CHARACTERISTIC KINP_SACtrlBrakeCtrl_SA_ovrdval "" VALUE 0x0000 /* @ECU_Address@KINP_SACtrlBrakeCtrl_SA_ovrdval@ */ Scalar_FLOAT32_IEEE 0 SWC_INP_type_CM_single_SA 0.0 255.0 /end CHARACTERISTIC
/begin CHARACTERISTIC KINP_WhlSpeedFL_kph_defval "" VALUE 0x0000 /* @ECU_Address@KINP_WhlSpeedFL_kph_defval@ */ Scalar_FLOAT32_IEEE 0 SWC_INP_type_CM_single_kph 0.0 255.9961 /end CHARACTERISTIC
/begin CHARACTERISTIC KINP_WhlSpeedFL_kph_ovrdval "" VALUE 0x0000 /* @ECU_Address@KINP_WhlSpeedFL_kph_ovrdval@ */ Scalar_FLOAT32_IEEE 0 SWC_INP_type_CM_single_kph 0.0 255.9961 /end CHARACTERISTIC
/begin CHARACTERISTIC KINP_XBRAcltnLimit_mps2_defval "" VALUE 0x0000 /* @ECU_Address@KINP_XBRAcltnLimit_mps2_defval@ */ Scalar_FLOAT32_IEEE 0 SWC_INP_type_CM_single_mps2 -12.5 12.5 /end CHARACTERISTIC
/begin CHARACTERISTIC KINP_XBRAcltnLimit_mps2_ovrdval "" VALUE 0x0000 /* @ECU_Address@KINP_XBRAcltnLimit_mps2_ovrdval@ */ Scalar_FLOAT32_IEEE 0 SWC_INP_type_CM_single_mps2 -12.5 12.5 /end CHARACTERISTIC
/begin CHARACTERISTIC KINP_ZFRBCMLFTurnLpCSta_A_defval "" VALUE 0x0000 /* @ECU_Address@KINP_ZFRBCMLFTurnLpCSta_A_defval@ */ Scalar_FLOAT32_IEEE 0 SWC_INP_type_CM_single_A 0.0 6.375 /end CHARACTERISTIC
/begin CHARACTERISTIC KINP_ZFRBCMLFTurnLpCSta_A_ovrdval "" VALUE 0x0000 /* @ECU_Address@KINP_ZFRBCMLFTurnLpCSta_A_ovrdval@ */ Scalar_FLOAT32_IEEE 0 SWC_INP_type_CM_single_A 0.0 6.375 /end CHARACTERISTIC
/begin CHARACTERISTIC KINP_ZFRBCMLightSensorVSta_V_defval "" VALUE 0x0000 /* @ECU_Address@KINP_ZFRBCMLightSensorVSta_V_defval@ */ Scalar_FLOAT32_IEEE 0 SWC_INP_type_CM_single_V 0.0 4.998 /end CHARACTERISTIC
/begin CHARACTERISTIC KINP_ZFRBCMLightSensorVSta_V_ovrdval "" VALUE 0x0000 /* @ECU_Address@KINP_ZFRBCMLightSensorVSta_V_ovrdval@ */ Scalar_FLOAT32_IEEE 0 SWC_INP_type_CM_single_V 0.0 4.998 /end CHARACTERISTIC
/begin CHARACTERISTIC KINP_ZFRBCMRFTurnLpCSta_A_defval "" VALUE 0x0000 /* @ECU_Address@KINP_ZFRBCMRFTurnLpCSta_A_defval@ */ Scalar_FLOAT32_IEEE 0 SWC_INP_type_CM_single_A 0.0 6.375 /end CHARACTERISTIC
/begin CHARACTERISTIC KINP_ZFRBCMRFTurnLpCSta_A_ovrdval "" VALUE 0x0000 /* @ECU_Address@KINP_ZFRBCMRFTurnLpCSta_A_ovrdval@ */ Scalar_FLOAT32_IEEE 0 SWC_INP_type_CM_single_A 0.0 6.375 /end CHARACTERISTIC
/begin CHARACTERISTIC KINP_ZRRBCMLRTurnLpCSta_A_defval "" VALUE 0x0000 /* @ECU_Address@KINP_ZRRBCMLRTurnLpCSta_A_defval@ */ Scalar_FLOAT32_IEEE 0 SWC_INP_type_CM_single_A 0.0 6.375 /end CHARACTERISTIC
/begin CHARACTERISTIC KINP_ZRRBCMLRTurnLpCSta_A_ovrdval "" VALUE 0x0000 /* @ECU_Address@KINP_ZRRBCMLRTurnLpCSta_A_ovrdval@ */ Scalar_FLOAT32_IEEE 0 SWC_INP_type_CM_single_A 0.0 6.375 /end CHARACTERISTIC
/begin CHARACTERISTIC KINP_ZRRBCMRRTurnLpCSta_A_defval "" VALUE 0x0000 /* @ECU_Address@KINP_ZRRBCMRRTurnLpCSta_A_defval@ */ Scalar_FLOAT32_IEEE 0 SWC_INP_type_CM_single_A 0.0 6.375 /end CHARACTERISTIC
/begin CHARACTERISTIC KINP_ZRRBCMRRTurnLpCSta_A_ovrdval "" VALUE 0x0000 /* @ECU_Address@KINP_ZRRBCMRRTurnLpCSta_A_ovrdval@ */ Scalar_FLOAT32_IEEE 0 SWC_INP_type_CM_single_A 0.0 6.375 /end CHARACTERISTIC
/begin CHARACTERISTIC KINP_ABSFullyOper_enum_ovrdflg "" VALUE 0x0000 /* @ECU_Address@KINP_ABSFullyOper_enum_ovrdflg@ */ Scalar_BOOLEAN 0 SWC_INP_type_CM_boolean_flg 0.0 1.0 /end CHARACTERISTIC
/begin CHARACTERISTIC KINP_ABSOffroadSw_enum_ovrdflg "" VALUE 0x0000 /* @ECU_Address@KINP_ABSOffroadSw_enum_ovrdflg@ */ Scalar_BOOLEAN 0 SWC_INP_type_CM_boolean_flg 0.0 1.0 /end CHARACTERISTIC
/begin CHARACTERISTIC KINP_ACAmbTemp_C_ovrdflg "" VALUE 0x0000 /* @ECU_Address@KINP_ACAmbTemp_C_ovrdflg@ */ Scalar_BOOLEAN 0 SWC_INP_type_CM_boolean_flg 0.0 1.0 /end CHARACTERISTIC
/begin CHARACTERISTIC KINP_ACFanSpdSta_enum_ovrdflg "" VALUE 0x0000 /* @ECU_Address@KINP_ACFanSpdSta_enum_ovrdflg@ */ Scalar_BOOLEAN 0 SWC_INP_type_CM_boolean_flg 0.0 1.0 /end CHARACTERISTIC
/begin CHARACTERISTIC KINP_ACTempSetSta_C_ovrdflg "" VALUE 0x0000 /* @ECU_Address@KINP_ACTempSetSta_C_ovrdflg@ */ Scalar_BOOLEAN 0 SWC_INP_type_CM_boolean_flg 0.0 1.0 /end CHARACTERISTIC
/begin CHARACTERISTIC KINP_ASC1KneelingInfo_enum_ovrdflg "" VALUE 0x0000 /* @ECU_Address@KINP_ASC1KneelingInfo_enum_ovrdflg@ */ Scalar_BOOLEAN 0 SWC_INP_type_CM_boolean_flg 0.0 1.0 /end CHARACTERISTIC
/begin CHARACTERISTIC KINP_ASRBrakeCtrlAtc_enum_ovrdflg "" VALUE 0x0000 /* @ECU_Address@KINP_ASRBrakeCtrlAtc_enum_ovrdflg@ */ Scalar_BOOLEAN 0 SWC_INP_type_CM_boolean_flg 0.0 1.0 /end CHARACTERISTIC
/begin CHARACTERISTIC KINP_ASREngCtrlAtc_enum_ovrdflg "" VALUE 0x0000 /* @ECU_Address@KINP_ASREngCtrlAtc_enum_ovrdflg@ */ Scalar_BOOLEAN 0 SWC_INP_type_CM_boolean_flg 0.0 1.0 /end CHARACTERISTIC
/begin CHARACTERISTIC KINP_ASRHillHolderSw_enum_ovrdflg "" VALUE 0x0000 /* @ECU_Address@KINP_ASRHillHolderSw_enum_ovrdflg@ */ Scalar_BOOLEAN 0 SWC_INP_type_CM_boolean_flg 0.0 1.0 /end CHARACTERISTIC
/begin CHARACTERISTIC KINP_ASROffroadSw_enum_ovrdflg "" VALUE 0x0000 /* @ECU_Address@KINP_ASROffroadSw_enum_ovrdflg@ */ Scalar_BOOLEAN 0 SWC_INP_type_CM_boolean_flg 0.0 1.0 /end CHARACTERISTIC
/begin CHARACTERISTIC KINP_ATCASRInfoSig_enum_ovrdflg "" VALUE 0x0000 /* @ECU_Address@KINP_ATCASRInfoSig_enum_ovrdflg@ */ Scalar_BOOLEAN 0 SWC_INP_type_CM_boolean_flg 0.0 1.0 /end CHARACTERISTIC
/begin CHARACTERISTIC KINP_AcltrInterlockSw_enum_ovrdflg "" VALUE 0x0000 /* @ECU_Address@KINP_AcltrInterlockSw_enum_ovrdflg@ */ Scalar_BOOLEAN 0 SWC_INP_type_CM_boolean_flg 0.0 1.0 /end CHARACTERISTIC
/begin CHARACTERISTIC KINP_AirPressureFC2_kPa_ovrdflg "" VALUE 0x0000 /* @ECU_Address@KINP_AirPressureFC2_kPa_ovrdflg@ */ Scalar_BOOLEAN 0 SWC_INP_type_CM_boolean_flg 0.0 1.0 /end CHARACTERISTIC
/begin CHARACTERISTIC KINP_AirPressurePC3_kPa_ovrdflg "" VALUE 0x0000 /* @ECU_Address@KINP_AirPressurePC3_kPa_ovrdflg@ */ Scalar_BOOLEAN 0 SWC_INP_type_CM_boolean_flg 0.0 1.0 /end CHARACTERISTIC
/begin CHARACTERISTIC KINP_AirPressureRC1_kPa_ovrdflg "" VALUE 0x0000 /* @ECU_Address@KINP_AirPressureRC1_kPa_ovrdflg@ */ Scalar_BOOLEAN 0 SWC_INP_type_CM_boolean_flg 0.0 1.0 /end CHARACTERISTIC
/begin CHARACTERISTIC KINP_AntiLBrakABSAct_enum_ovrdflg "" VALUE 0x0000 /* @ECU_Address@KINP_AntiLBrakABSAct_enum_ovrdflg@ */ Scalar_BOOLEAN 0 SWC_INP_type_CM_boolean_flg 0.0 1.0 /end CHARACTERISTIC
/begin CHARACTERISTIC KINP_AtvDisChgEnFbk_flg_defval "" VALUE 0x0000 /* @ECU_Address@KINP_AtvDisChgEnFbk_flg_defval@ */ Scalar_BOOLEAN 0 SWC_INP_type_CM_boolean_flg 0.0 1.0 /end CHARACTERISTIC
/begin CHARACTERISTIC KINP_AtvDisChgEnFbk_flg_ovrdflg "" VALUE 0x0000 /* @ECU_Address@KINP_AtvDisChgEnFbk_flg_ovrdflg@ */ Scalar_BOOLEAN 0 SWC_INP_type_CM_boolean_flg 0.0 1.0 /end CHARACTERISTIC
/begin CHARACTERISTIC KINP_AtvDisChgEnFbk_flg_ovrdval "" VALUE 0x0000 /* @ECU_Address@KINP_AtvDisChgEnFbk_flg_ovrdval@ */ Scalar_BOOLEAN 0 SWC_INP_type_CM_boolean_flg 0.0 1.0 /end CHARACTERISTIC
/begin CHARACTERISTIC KINP_B2THVRlySta_enum_ovrdflg "" VALUE 0x0000 /* @ECU_Address@KINP_B2THVRlySta_enum_ovrdflg@ */ Scalar_BOOLEAN 0 SWC_INP_type_CM_boolean_flg 0.0 1.0 /end CHARACTERISTIC
/begin CHARACTERISTIC KINP_B2VACChgConnSta_flg_defval "" VALUE 0x0000 /* @ECU_Address@KINP_B2VACChgConnSta_flg_defval@ */ Scalar_BOOLEAN 0 SWC_INP_type_CM_boolean_flg 0.0 1.0 /end CHARACTERISTIC
/begin CHARACTERISTIC KINP_B2VACChgConnSta_flg_ovrdflg "" VALUE 0x0000 /* @ECU_Address@KINP_B2VACChgConnSta_flg_ovrdflg@ */ Scalar_BOOLEAN 0 SWC_INP_type_CM_boolean_flg 0.0 1.0 /end CHARACTERISTIC
/begin CHARACTERISTIC KINP_B2VACChgConnSta_flg_ovrdval "" VALUE 0x0000 /* @ECU_Address@KINP_B2VACChgConnSta_flg_ovrdval@ */ Scalar_BOOLEAN 0 SWC_INP_type_CM_boolean_flg 0.0 1.0 /end CHARACTERISTIC
/begin CHARACTERISTIC KINP_B2VACChgNegRlySta_enum_ovrdflg "" VALUE 0x0000 /* @ECU_Address@KINP_B2VACChgNegRlySta_enum_ovrdflg@ */ Scalar_BOOLEAN 0 SWC_INP_type_CM_boolean_flg 0.0 1.0 /end CHARACTERISTIC
/begin CHARACTERISTIC KINP_B2VACChgPosRlySta_enum_ovrdflg "" VALUE 0x0000 /* @ECU_Address@KINP_B2VACChgPosRlySta_enum_ovrdflg@ */ Scalar_BOOLEAN 0 SWC_INP_type_CM_boolean_flg 0.0 1.0 /end CHARACTERISTIC
/begin CHARACTERISTIC KINP_B2VAPlsDischgCurr_A_ovrdflg "" VALUE 0x0000 /* @ECU_Address@KINP_B2VAPlsDischgCurr_A_ovrdflg@ */ Scalar_BOOLEAN 0 SWC_INP_type_CM_boolean_flg 0.0 1.0 /end CHARACTERISTIC
/begin CHARACTERISTIC KINP_B2VAvaPlsChgCurr_A_ovrdflg "" VALUE 0x0000 /* @ECU_Address@KINP_B2VAvaPlsChgCurr_A_ovrdflg@ */ Scalar_BOOLEAN 0 SWC_INP_type_CM_boolean_flg 0.0 1.0 /end CHARACTERISTIC
/begin CHARACTERISTIC KINP_B2VBI1BattType_enum_ovrdflg "" VALUE 0x0000 /* @ECU_Address@KINP_B2VBI1BattType_enum_ovrdflg@ */ Scalar_BOOLEAN 0 SWC_INP_type_CM_boolean_flg 0.0 1.0 /end CHARACTERISTIC
/begin CHARACTERISTIC KINP_B2VBMUHVSta_enum_ovrdflg "" VALUE 0x0000 /* @ECU_Address@KINP_B2VBMUHVSta_enum_ovrdflg@ */ Scalar_BOOLEAN 0 SWC_INP_type_CM_boolean_flg 0.0 1.0 /end CHARACTERISTIC
/begin CHARACTERISTIC KINP_B2VCellMinVol_V_ovrdflg "" VALUE 0x0000 /* @ECU_Address@KINP_B2VCellMinVol_V_ovrdflg@ */ Scalar_BOOLEAN 0 SWC_INP_type_CM_boolean_flg 0.0 1.0 /end CHARACTERISTIC
/begin CHARACTERISTIC KINP_B2VChgMode_enum_ovrdflg "" VALUE 0x0000 /* @ECU_Address@KINP_B2VChgMode_enum_ovrdflg@ */ Scalar_BOOLEAN 0 SWC_INP_type_CM_boolean_flg 0.0 1.0 /end CHARACTERISTIC
/begin CHARACTERISTIC KINP_B2VChgSta_enum_ovrdflg "" VALUE 0x0000 /* @ECU_Address@KINP_B2VChgSta_enum_ovrdflg@ */ Scalar_BOOLEAN 0 SWC_INP_type_CM_boolean_flg 0.0 1.0 /end CHARACTERISTIC
/begin CHARACTERISTIC KINP_B2VDCChgConnSta_enum_ovrdflg "" VALUE 0x0000 /* @ECU_Address@KINP_B2VDCChgConnSta_enum_ovrdflg@ */ Scalar_BOOLEAN 0 SWC_INP_type_CM_boolean_flg 0.0 1.0 /end CHARACTERISTIC
/begin CHARACTERISTIC KINP_B2VDCChgN1RlySta_enum_ovrdflg "" VALUE 0x0000 /* @ECU_Address@KINP_B2VDCChgN1RlySta_enum_ovrdflg@ */ Scalar_BOOLEAN 0 SWC_INP_type_CM_boolean_flg 0.0 1.0 /end CHARACTERISTIC
/begin CHARACTERISTIC KINP_B2VDCChgP1RlySta_enum_ovrdflg "" VALUE 0x0000 /* @ECU_Address@KINP_B2VDCChgP1RlySta_enum_ovrdflg@ */ Scalar_BOOLEAN 0 SWC_INP_type_CM_boolean_flg 0.0 1.0 /end CHARACTERISTIC
/begin CHARACTERISTIC KINP_B2VFaultCode_enum_ovrdflg "" VALUE 0x0000 /* @ECU_Address@KINP_B2VFaultCode_enum_ovrdflg@ */ Scalar_BOOLEAN 0 SWC_INP_type_CM_boolean_flg 0.0 1.0 /end CHARACTERISTIC
/begin CHARACTERISTIC KINP_B2VFaultLv_enum_ovrdflg "" VALUE 0x0000 /* @ECU_Address@KINP_B2VFaultLv_enum_ovrdflg@ */ Scalar_BOOLEAN 0 SWC_INP_type_CM_boolean_flg 0.0 1.0 /end CHARACTERISTIC
/begin CHARACTERISTIC KINP_B2VHVILFault_flg_defval "" VALUE 0x0000 /* @ECU_Address@KINP_B2VHVILFault_flg_defval@ */ Scalar_BOOLEAN 0 SWC_INP_type_CM_boolean_flg 0.0 1.0 /end CHARACTERISTIC
/begin CHARACTERISTIC KINP_B2VHVILFault_flg_ovrdflg "" VALUE 0x0000 /* @ECU_Address@KINP_B2VHVILFault_flg_ovrdflg@ */ Scalar_BOOLEAN 0 SWC_INP_type_CM_boolean_flg 0.0 1.0 /end CHARACTERISTIC
/begin CHARACTERISTIC KINP_B2VHVILFault_flg_ovrdval "" VALUE 0x0000 /* @ECU_Address@KINP_B2VHVILFault_flg_ovrdval@ */ Scalar_BOOLEAN 0 SWC_INP_type_CM_boolean_flg 0.0 1.0 /end CHARACTERISTIC
/begin CHARACTERISTIC KINP_B2VMainNegRlySta_enum_ovrdflg "" VALUE 0x0000 /* @ECU_Address@KINP_B2VMainNegRlySta_enum_ovrdflg@ */ Scalar_BOOLEAN 0 SWC_INP_type_CM_boolean_flg 0.0 1.0 /end CHARACTERISTIC
/begin CHARACTERISTIC KINP_B2VMinTempPos_enum_ovrdflg "" VALUE 0x0000 /* @ECU_Address@KINP_B2VMinTempPos_enum_ovrdflg@ */ Scalar_BOOLEAN 0 SWC_INP_type_CM_boolean_flg 0.0 1.0 /end CHARACTERISTIC
/begin CHARACTERISTIC KINP_B2VPackCurr_A_ovrdflg "" VALUE 0x0000 /* @ECU_Address@KINP_B2VPackCurr_A_ovrdflg@ */ Scalar_BOOLEAN 0 SWC_INP_type_CM_boolean_flg 0.0 1.0 /end CHARACTERISTIC
/begin CHARACTERISTIC KINP_B2VPackInsideVol_V_ovrdflg "" VALUE 0x0000 /* @ECU_Address@KINP_B2VPackInsideVol_V_ovrdflg@ */ Scalar_BOOLEAN 0 SWC_INP_type_CM_boolean_flg 0.0 1.0 /end CHARACTERISTIC
/begin CHARACTERISTIC KINP_B2VRqHVPwrOff_enum_ovrdflg "" VALUE 0x0000 /* @ECU_Address@KINP_B2VRqHVPwrOff_enum_ovrdflg@ */ Scalar_BOOLEAN 0 SWC_INP_type_CM_boolean_flg 0.0 1.0 /end CHARACTERISTIC
/begin CHARACTERISTIC KINP_B2VSOC_pct_ovrdflg "" VALUE 0x0000 /* @ECU_Address@KINP_B2VSOC_pct_ovrdflg@ */ Scalar_BOOLEAN 0 SWC_INP_type_CM_boolean_flg 0.0 1.0 /end CHARACTERISTIC
/begin CHARACTERISTIC KINP_BrakePedalPos_pct_ovrdflg "" VALUE 0x0000 /* @ECU_Address@KINP_BrakePedalPos_pct_ovrdflg@ */ Scalar_BOOLEAN 0 SWC_INP_type_CM_boolean_flg 0.0 1.0 /end CHARACTERISTIC
/begin CHARACTERISTIC KINP_BrkTempeWarn_enum_ovrdflg "" VALUE 0x0000 /* @ECU_Address@KINP_BrkTempeWarn_enum_ovrdflg@ */ Scalar_BOOLEAN 0 SWC_INP_type_CM_boolean_flg 0.0 1.0 /end CHARACTERISTIC
/begin CHARACTERISTIC KINP_DCDCEnSta_enum_ovrdflg "" VALUE 0x0000 /* @ECU_Address@KINP_DCDCEnSta_enum_ovrdflg@ */ Scalar_BOOLEAN 0 SWC_INP_type_CM_boolean_flg 0.0 1.0 /end CHARACTERISTIC
/begin CHARACTERISTIC KINP_DCDCErrLvSta_enum_ovrdflg "" VALUE 0x0000 /* @ECU_Address@KINP_DCDCErrLvSta_enum_ovrdflg@ */ Scalar_BOOLEAN 0 SWC_INP_type_CM_boolean_flg 0.0 1.0 /end CHARACTERISTIC
/begin CHARACTERISTIC KINP_DCDCOutVolSta_V_ovrdflg "" VALUE 0x0000 /* @ECU_Address@KINP_DCDCOutVolSta_V_ovrdflg@ */ Scalar_BOOLEAN 0 SWC_INP_type_CM_boolean_flg 0.0 1.0 /end CHARACTERISTIC
/begin CHARACTERISTIC KINP_DCDCTempSta_C_ovrdflg "" VALUE 0x0000 /* @ECU_Address@KINP_DCDCTempSta_C_ovrdflg@ */ Scalar_BOOLEAN 0 SWC_INP_type_CM_boolean_flg 0.0 1.0 /end CHARACTERISTIC
/begin CHARACTERISTIC KINP_DrivDirF_enum_ovrdflg "" VALUE 0x0000 /* @ECU_Address@KINP_DrivDirF_enum_ovrdflg@ */ Scalar_BOOLEAN 0 SWC_INP_type_CM_boolean_flg 0.0 1.0 /end CHARACTERISTIC
/begin CHARACTERISTIC KINP_EACEnSta_enum_ovrdflg "" VALUE 0x0000 /* @ECU_Address@KINP_EACEnSta_enum_ovrdflg@ */ Scalar_BOOLEAN 0 SWC_INP_type_CM_boolean_flg 0.0 1.0 /end CHARACTERISTIC
/begin CHARACTERISTIC KINP_EACErrLvSta_enum_ovrdflg "" VALUE 0x0000 /* @ECU_Address@KINP_EACErrLvSta_enum_ovrdflg@ */ Scalar_BOOLEAN 0 SWC_INP_type_CM_boolean_flg 0.0 1.0 /end CHARACTERISTIC
/begin CHARACTERISTIC KINP_EACInvTempSta_C_ovrdflg "" VALUE 0x0000 /* @ECU_Address@KINP_EACInvTempSta_C_ovrdflg@ */ Scalar_BOOLEAN 0 SWC_INP_type_CM_boolean_flg 0.0 1.0 /end CHARACTERISTIC
/begin CHARACTERISTIC KINP_EBSAmWarnLampSta_enum_ovrdflg "" VALUE 0x0000 /* @ECU_Address@KINP_EBSAmWarnLampSta_enum_ovrdflg@ */ Scalar_BOOLEAN 0 SWC_INP_type_CM_boolean_flg 0.0 1.0 /end CHARACTERISTIC
/begin CHARACTERISTIC KINP_EBSBrakeSw_enum_ovrdflg "" VALUE 0x0000 /* @ECU_Address@KINP_EBSBrakeSw_enum_ovrdflg@ */ Scalar_BOOLEAN 0 SWC_INP_type_CM_boolean_flg 0.0 1.0 /end CHARACTERISTIC
/begin CHARACTERISTIC KINP_EBSRedWarnLampSta_enum_ovrdflg "" VALUE 0x0000 /* @ECU_Address@KINP_EBSRedWarnLampSta_enum_ovrdflg@ */ Scalar_BOOLEAN 0 SWC_INP_type_CM_boolean_flg 0.0 1.0 /end CHARACTERISTIC
/begin CHARACTERISTIC KINP_ECASAWarmLampSta_enum_ovrdflg "" VALUE 0x0000 /* @ECU_Address@KINP_ECASAWarmLampSta_enum_ovrdflg@ */ Scalar_BOOLEAN 0 SWC_INP_type_CM_boolean_flg 0.0 1.0 /end CHARACTERISTIC
/begin CHARACTERISTIC KINP_EHPSEnSta_enum_ovrdflg "" VALUE 0x0000 /* @ECU_Address@KINP_EHPSEnSta_enum_ovrdflg@ */ Scalar_BOOLEAN 0 SWC_INP_type_CM_boolean_flg 0.0 1.0 /end CHARACTERISTIC
/begin CHARACTERISTIC KINP_EHPSErrLvSta_enum_ovrdflg "" VALUE 0x0000 /* @ECU_Address@KINP_EHPSErrLvSta_enum_ovrdflg@ */ Scalar_BOOLEAN 0 SWC_INP_type_CM_boolean_flg 0.0 1.0 /end CHARACTERISTIC
/begin CHARACTERISTIC KINP_EHPSInvTempSta_C_ovrdflg "" VALUE 0x0000 /* @ECU_Address@KINP_EHPSInvTempSta_C_ovrdflg@ */ Scalar_BOOLEAN 0 SWC_INP_type_CM_boolean_flg 0.0 1.0 /end CHARACTERISTIC
/begin CHARACTERISTIC KINP_EHPSMotorSpdSta_rpm_ovrdflg "" VALUE 0x0000 /* @ECU_Address@KINP_EHPSMotorSpdSta_rpm_ovrdflg@ */ Scalar_BOOLEAN 0 SWC_INP_type_CM_boolean_flg 0.0 1.0 /end CHARACTERISTIC
/begin CHARACTERISTIC KINP_EM1CS_enum_ovrdflg "" VALUE 0x0000 /* @ECU_Address@KINP_EM1CS_enum_ovrdflg@ */ Scalar_BOOLEAN 0 SWC_INP_type_CM_boolean_flg 0.0 1.0 /end CHARACTERISTIC
/begin CHARACTERISTIC KINP_EM1Cnt_enum_ovrdflg "" VALUE 0x0000 /* @ECU_Address@KINP_EM1Cnt_enum_ovrdflg@ */ Scalar_BOOLEAN 0 SWC_INP_type_CM_boolean_flg 0.0 1.0 /end CHARACTERISTIC
/begin CHARACTERISTIC KINP_EM1OvrCtrlMBrk_enum_ovrdflg "" VALUE 0x0000 /* @ECU_Address@KINP_EM1OvrCtrlMBrk_enum_ovrdflg@ */ Scalar_BOOLEAN 0 SWC_INP_type_CM_boolean_flg 0.0 1.0 /end CHARACTERISTIC
/begin CHARACTERISTIC KINP_EM1OvrCtrlMDriv_enum_ovrdflg "" VALUE 0x0000 /* @ECU_Address@KINP_EM1OvrCtrlMDriv_enum_ovrdflg@ */ Scalar_BOOLEAN 0 SWC_INP_type_CM_boolean_flg 0.0 1.0 /end CHARACTERISTIC
/begin CHARACTERISTIC KINP_EM1OvrCtrlMPriBrk_enum_ovrdflg "" VALUE 0x0000 /* @ECU_Address@KINP_EM1OvrCtrlMPriBrk_enum_ovrdflg@ */ Scalar_BOOLEAN 0 SWC_INP_type_CM_boolean_flg 0.0 1.0 /end CHARACTERISTIC
/begin CHARACTERISTIC KINP_EM1ReqTorqHRlsBrk_pct_ovrdflg "" VALUE 0x0000 /* @ECU_Address@KINP_EM1ReqTorqHRlsBrk_pct_ovrdflg@ */ Scalar_BOOLEAN 0 SWC_INP_type_CM_boolean_flg 0.0 1.0 /end CHARACTERISTIC
/begin CHARACTERISTIC KINP_EM1ReqTorqHRlsDri_pct_ovrdflg "" VALUE 0x0000 /* @ECU_Address@KINP_EM1ReqTorqHRlsDri_pct_ovrdflg@ */ Scalar_BOOLEAN 0 SWC_INP_type_CM_boolean_flg 0.0 1.0 /end CHARACTERISTIC
/begin CHARACTERISTIC KINP_EM1ReqTorqLimBrk_pct_ovrdflg "" VALUE 0x0000 /* @ECU_Address@KINP_EM1ReqTorqLimBrk_pct_ovrdflg@ */ Scalar_BOOLEAN 0 SWC_INP_type_CM_boolean_flg 0.0 1.0 /end CHARACTERISTIC
/begin CHARACTERISTIC KINP_EM1ReqTorqLimDriv_pct_ovrdflg "" VALUE 0x0000 /* @ECU_Address@KINP_EM1ReqTorqLimDriv_pct_ovrdflg@ */ Scalar_BOOLEAN 0 SWC_INP_type_CM_boolean_flg 0.0 1.0 /end CHARACTERISTIC
/begin CHARACTERISTIC KINP_EWPPEFault_enum_ovrdflg "" VALUE 0x0000 /* @ECU_Address@KINP_EWPPEFault_enum_ovrdflg@ */ Scalar_BOOLEAN 0 SWC_INP_type_CM_boolean_flg 0.0 1.0 /end CHARACTERISTIC
/begin CHARACTERISTIC KINP_EngAuxShutdownSw_enum_ovrdflg "" VALUE 0x0000 /* @ECU_Address@KINP_EngAuxShutdownSw_enum_ovrdflg@ */ Scalar_BOOLEAN 0 SWC_INP_type_CM_boolean_flg 0.0 1.0 /end CHARACTERISTIC
/begin CHARACTERISTIC KINP_EngDerateSw_enum_ovrdflg "" VALUE 0x0000 /* @ECU_Address@KINP_EngDerateSw_enum_ovrdflg@ */ Scalar_BOOLEAN 0 SWC_INP_type_CM_boolean_flg 0.0 1.0 /end CHARACTERISTIC
/begin CHARACTERISTIC KINP_EngRetSel_pct_ovrdflg "" VALUE 0x0000 /* @ECU_Address@KINP_EngRetSel_pct_ovrdflg@ */ Scalar_BOOLEAN 0 SWC_INP_type_CM_boolean_flg 0.0 1.0 /end CHARACTERISTIC
/begin CHARACTERISTIC KINP_FASpeed_kph_ovrdflg "" VALUE 0x0000 /* @ECU_Address@KINP_FASpeed_kph_ovrdflg@ */ Scalar_BOOLEAN 0 SWC_INP_type_CM_boolean_flg 0.0 1.0 /end CHARACTERISTIC
/begin CHARACTERISTIC KINP_FDCCHASSISVCUEACPressSta_flg_defval "" VALUE 0x0000 /* @ECU_Address@KINP_FDCCHASSISVCUEACPressSta_flg_defval@ */ Scalar_BOOLEAN 0 SWC_INP_type_CM_boolean_flg 0.0 1.0 /end CHARACTERISTIC
/begin CHARACTERISTIC KINP_FDCCHASSISVCUEACPressSta_flg_ovrdflg "" VALUE 0x0000 /* @ECU_Address@KINP_FDCCHASSISVCUEACPressSta_flg_ovrdflg@ */ Scalar_BOOLEAN 0 SWC_INP_type_CM_boolean_flg 0.0 1.0 /end CHARACTERISTIC
/begin CHARACTERISTIC KINP_FDCCHASSISVCUEACPressSta_flg_ovrdval "" VALUE 0x0000 /* @ECU_Address@KINP_FDCCHASSISVCUEACPressSta_flg_ovrdval@ */ Scalar_BOOLEAN 0 SWC_INP_type_CM_boolean_flg 0.0 1.0 /end CHARACTERISTIC
/begin CHARACTERISTIC KINP_FndBrkUse_enum_ovrdflg "" VALUE 0x0000 /* @ECU_Address@KINP_FndBrkUse_enum_ovrdflg@ */ Scalar_BOOLEAN 0 SWC_INP_type_CM_boolean_flg 0.0 1.0 /end CHARACTERISTIC
/begin CHARACTERISTIC KINP_HaltBrakeSw_enum_ovrdflg "" VALUE 0x0000 /* @ECU_Address@KINP_HaltBrakeSw_enum_ovrdflg@ */ Scalar_BOOLEAN 0 SWC_INP_type_CM_boolean_flg 0.0 1.0 /end CHARACTERISTIC
/begin CHARACTERISTIC KINP_HaltBrkMode_enum_ovrdflg "" VALUE 0x0000 /* @ECU_Address@KINP_HaltBrkMode_enum_ovrdflg@ */ Scalar_BOOLEAN 0 SWC_INP_type_CM_boolean_flg 0.0 1.0 /end CHARACTERISTIC
/begin CHARACTERISTIC KINP_HillHolderMode_enum_ovrdflg "" VALUE 0x0000 /* @ECU_Address@KINP_HillHolderMode_enum_ovrdflg@ */ Scalar_BOOLEAN 0 SWC_INP_type_CM_boolean_flg 0.0 1.0 /end CHARACTERISTIC
/begin CHARACTERISTIC KINP_IVIACFanSpdReqCmd_enum_ovrdflg "" VALUE 0x0000 /* @ECU_Address@KINP_IVIACFanSpdReqCmd_enum_ovrdflg@ */ Scalar_BOOLEAN 0 SWC_INP_type_CM_boolean_flg 0.0 1.0 /end CHARACTERISTIC
/begin CHARACTERISTIC KINP_MCUCtrlMdSta_enum_ovrdflg "" VALUE 0x0000 /* @ECU_Address@KINP_MCUCtrlMdSta_enum_ovrdflg@ */ Scalar_BOOLEAN 0 SWC_INP_type_CM_boolean_flg 0.0 1.0 /end CHARACTERISTIC
/begin CHARACTERISTIC KINP_MCUDCCur_A_ovrdflg "" VALUE 0x0000 /* @ECU_Address@KINP_MCUDCCur_A_ovrdflg@ */ Scalar_BOOLEAN 0 SWC_INP_type_CM_boolean_flg 0.0 1.0 /end CHARACTERISTIC
/begin CHARACTERISTIC KINP_MCUDCVol_V_ovrdflg "" VALUE 0x0000 /* @ECU_Address@KINP_MCUDCVol_V_ovrdflg@ */ Scalar_BOOLEAN 0 SWC_INP_type_CM_boolean_flg 0.0 1.0 /end CHARACTERISTIC
/begin CHARACTERISTIC KINP_MCUFailCode_enum_ovrdflg "" VALUE 0x0000 /* @ECU_Address@KINP_MCUFailCode_enum_ovrdflg@ */ Scalar_BOOLEAN 0 SWC_INP_type_CM_boolean_flg 0.0 1.0 /end CHARACTERISTIC
/begin CHARACTERISTIC KINP_MCUFailGrade_enum_ovrdflg "" VALUE 0x0000 /* @ECU_Address@KINP_MCUFailGrade_enum_ovrdflg@ */ Scalar_BOOLEAN 0 SWC_INP_type_CM_boolean_flg 0.0 1.0 /end CHARACTERISTIC
/begin CHARACTERISTIC KINP_MCUIGBTEnFbk_flg_defval "" VALUE 0x0000 /* @ECU_Address@KINP_MCUIGBTEnFbk_flg_defval@ */ Scalar_BOOLEAN 0 SWC_INP_type_CM_boolean_flg 0.0 1.0 /end CHARACTERISTIC
/begin CHARACTERISTIC KINP_MCUIGBTEnFbk_flg_ovrdflg "" VALUE 0x0000 /* @ECU_Address@KINP_MCUIGBTEnFbk_flg_ovrdflg@ */ Scalar_BOOLEAN 0 SWC_INP_type_CM_boolean_flg 0.0 1.0 /end CHARACTERISTIC
/begin CHARACTERISTIC KINP_MCUIGBTEnFbk_flg_ovrdval "" VALUE 0x0000 /* @ECU_Address@KINP_MCUIGBTEnFbk_flg_ovrdval@ */ Scalar_BOOLEAN 0 SWC_INP_type_CM_boolean_flg 0.0 1.0 /end CHARACTERISTIC
/begin CHARACTERISTIC KINP_MCUTemp_C_ovrdflg "" VALUE 0x0000 /* @ECU_Address@KINP_MCUTemp_C_ovrdflg@ */ Scalar_BOOLEAN 0 SWC_INP_type_CM_boolean_flg 0.0 1.0 /end CHARACTERISTIC
/begin CHARACTERISTIC KINP_MCUTrqLimHi_Nm_ovrdflg "" VALUE 0x0000 /* @ECU_Address@KINP_MCUTrqLimHi_Nm_ovrdflg@ */ Scalar_BOOLEAN 0 SWC_INP_type_CM_boolean_flg 0.0 1.0 /end CHARACTERISTIC
/begin CHARACTERISTIC KINP_MCUTrqLimLo_Nm_ovrdflg "" VALUE 0x0000 /* @ECU_Address@KINP_MCUTrqLimLo_Nm_ovrdflg@ */ Scalar_BOOLEAN 0 SWC_INP_type_CM_boolean_flg 0.0 1.0 /end CHARACTERISTIC
/begin CHARACTERISTIC KINP_MotorSpd_rpm_ovrdflg "" VALUE 0x0000 /* @ECU_Address@KINP_MotorSpd_rpm_ovrdflg@ */ Scalar_BOOLEAN 0 SWC_INP_type_CM_boolean_flg 0.0 1.0 /end CHARACTERISTIC
/begin CHARACTERISTIC KINP_MotorTemp_C_ovrdflg "" VALUE 0x0000 /* @ECU_Address@KINP_MotorTemp_C_ovrdflg@ */ Scalar_BOOLEAN 0 SWC_INP_type_CM_boolean_flg 0.0 1.0 /end CHARACTERISTIC
/begin CHARACTERISTIC KINP_MotorTrq_Nm_ovrdflg "" VALUE 0x0000 /* @ECU_Address@KINP_MotorTrq_Nm_ovrdflg@ */ Scalar_BOOLEAN 0 SWC_INP_type_CM_boolean_flg 0.0 1.0 /end CHARACTERISTIC
/begin CHARACTERISTIC KINP_PDUACRlySta_enum_ovrdflg "" VALUE 0x0000 /* @ECU_Address@KINP_PDUACRlySta_enum_ovrdflg@ */ Scalar_BOOLEAN 0 SWC_INP_type_CM_boolean_flg 0.0 1.0 /end CHARACTERISTIC
/begin CHARACTERISTIC KINP_PDUDCDCEACEHPSHVLoopSta_enum_ovrdflg "" VALUE 0x0000 /* @ECU_Address@KINP_PDUDCDCEACEHPSHVLoopSta_enum_ovrdflg@ */ Scalar_BOOLEAN 0 SWC_INP_type_CM_boolean_flg 0.0 1.0 /end CHARACTERISTIC
/begin CHARACTERISTIC KINP_PDUDCDCEACEHPSPreRlySta_enum_ovrdflg "" VALUE 0x0000 /* @ECU_Address@KINP_PDUDCDCEACEHPSPreRlySta_enum_ovrdflg@ */ Scalar_BOOLEAN 0 SWC_INP_type_CM_boolean_flg 0.0 1.0 /end CHARACTERISTIC
/begin CHARACTERISTIC KINP_PDUDCDCEACEHPSRlySta_enum_ovrdflg "" VALUE 0x0000 /* @ECU_Address@KINP_PDUDCDCEACEHPSRlySta_enum_ovrdflg@ */ Scalar_BOOLEAN 0 SWC_INP_type_CM_boolean_flg 0.0 1.0 /end CHARACTERISTIC
/begin CHARACTERISTIC KINP_PDUHVILSta_enum_ovrdflg "" VALUE 0x0000 /* @ECU_Address@KINP_PDUHVILSta_enum_ovrdflg@ */ Scalar_BOOLEAN 0 SWC_INP_type_CM_boolean_flg 0.0 1.0 /end CHARACTERISTIC
/begin CHARACTERISTIC KINP_PDUMCUHVLoopSta_enum_ovrdflg "" VALUE 0x0000 /* @ECU_Address@KINP_PDUMCUHVLoopSta_enum_ovrdflg@ */ Scalar_BOOLEAN 0 SWC_INP_type_CM_boolean_flg 0.0 1.0 /end CHARACTERISTIC
/begin CHARACTERISTIC KINP_PDUMCUPosRlySta_enum_ovrdflg "" VALUE 0x0000 /* @ECU_Address@KINP_PDUMCUPosRlySta_enum_ovrdflg@ */ Scalar_BOOLEAN 0 SWC_INP_type_CM_boolean_flg 0.0 1.0 /end CHARACTERISTIC
/begin CHARACTERISTIC KINP_PDUMCUPreRlySta_enum_ovrdflg "" VALUE 0x0000 /* @ECU_Address@KINP_PDUMCUPreRlySta_enum_ovrdflg@ */ Scalar_BOOLEAN 0 SWC_INP_type_CM_boolean_flg 0.0 1.0 /end CHARACTERISTIC
/begin CHARACTERISTIC KINP_PDUSelfChkSta_enum_ovrdflg "" VALUE 0x0000 /* @ECU_Address@KINP_PDUSelfChkSta_enum_ovrdflg@ */ Scalar_BOOLEAN 0 SWC_INP_type_CM_boolean_flg 0.0 1.0 /end CHARACTERISTIC
/begin CHARACTERISTIC KINP_ParkBrakeSW_enum_ovrdflg "" VALUE 0x0000 /* @ECU_Address@KINP_ParkBrakeSW_enum_ovrdflg@ */ Scalar_BOOLEAN 0 SWC_INP_type_CM_boolean_flg 0.0 1.0 /end CHARACTERISTIC
/begin CHARACTERISTIC KINP_ParkBrkActuFAct_enum_ovrdflg "" VALUE 0x0000 /* @ECU_Address@KINP_ParkBrkActuFAct_enum_ovrdflg@ */ Scalar_BOOLEAN 0 SWC_INP_type_CM_boolean_flg 0.0 1.0 /end CHARACTERISTIC
/begin CHARACTERISTIC KINP_PushButton_flg_inverse "" VALUE 0x0000 /* @ECU_Address@KINP_PushButton_flg_inverse@ */ Scalar_BOOLEAN 0 SWC_INP_type_CM_boolean_flg 0.0 1.0 /end CHARACTERISTIC
/begin CHARACTERISTIC KINP_PushButton_flg_ovrdflg "" VALUE 0x0000 /* @ECU_Address@KINP_PushButton_flg_ovrdflg@ */ Scalar_BOOLEAN 0 SWC_INP_type_CM_boolean_flg 0.0 1.0 /end CHARACTERISTIC
/begin CHARACTERISTIC KINP_PushButton_flg_ovrdval "" VALUE 0x0000 /* @ECU_Address@KINP_PushButton_flg_ovrdval@ */ Scalar_BOOLEAN 0 SWC_INP_type_CM_boolean_flg 0.0 1.0 /end CHARACTERISTIC
/begin CHARACTERISTIC KINP_PushButton_flg_srvcflg "" VALUE 0x0000 /* @ECU_Address@KINP_PushButton_flg_srvcflg@ */ Scalar_BOOLEAN 0 SWC_INP_type_CM_boolean_flg 0.0 1.0 /end CHARACTERISTIC
/begin CHARACTERISTIC KINP_PushButton_flg_srvcval "" VALUE 0x0000 /* @ECU_Address@KINP_PushButton_flg_srvcval@ */ Scalar_BOOLEAN 0 SWC_INP_type_CM_boolean_flg 0.0 1.0 /end CHARACTERISTIC
/begin CHARACTERISTIC KINP_RelaSpdFALWheel_kph_ovrdflg "" VALUE 0x0000 /* @ECU_Address@KINP_RelaSpdFALWheel_kph_ovrdflg@ */ Scalar_BOOLEAN 0 SWC_INP_type_CM_boolean_flg 0.0 1.0 /end CHARACTERISTIC
/begin CHARACTERISTIC KINP_RelaSpdFARWheel_kph_ovrdflg "" VALUE 0x0000 /* @ECU_Address@KINP_RelaSpdFARWheel_kph_ovrdflg@ */ Scalar_BOOLEAN 0 SWC_INP_type_CM_boolean_flg 0.0 1.0 /end CHARACTERISTIC
/begin CHARACTERISTIC KINP_RightTurnSW_flg_inverse "" VALUE 0x0000 /* @ECU_Address@KINP_RightTurnSW_flg_inverse@ */ Scalar_BOOLEAN 0 SWC_INP_type_CM_boolean_flg 0.0 1.0 /end CHARACTERISTIC
/begin CHARACTERISTIC KINP_RightTurnSW_flg_ovrdflg "" VALUE 0x0000 /* @ECU_Address@KINP_RightTurnSW_flg_ovrdflg@ */ Scalar_BOOLEAN 0 SWC_INP_type_CM_boolean_flg 0.0 1.0 /end CHARACTERISTIC
/begin CHARACTERISTIC KINP_RightTurnSW_flg_ovrdval "" VALUE 0x0000 /* @ECU_Address@KINP_RightTurnSW_flg_ovrdval@ */ Scalar_BOOLEAN 0 SWC_INP_type_CM_boolean_flg 0.0 1.0 /end CHARACTERISTIC
/begin CHARACTERISTIC KINP_RightTurnSW_flg_srvcflg "" VALUE 0x0000 /* @ECU_Address@KINP_RightTurnSW_flg_srvcflg@ */ Scalar_BOOLEAN 0 SWC_INP_type_CM_boolean_flg 0.0 1.0 /end CHARACTERISTIC
/begin CHARACTERISTIC KINP_RightTurnSW_flg_srvcval "" VALUE 0x0000 /* @ECU_Address@KINP_RightTurnSW_flg_srvcval@ */ Scalar_BOOLEAN 0 SWC_INP_type_CM_boolean_flg 0.0 1.0 /end CHARACTERISTIC
/begin CHARACTERISTIC KINP_RmAccelEnSw_enum_ovrdflg "" VALUE 0x0000 /* @ECU_Address@KINP_RmAccelEnSw_enum_ovrdflg@ */ Scalar_BOOLEAN 0 SWC_INP_type_CM_boolean_flg 0.0 1.0 /end CHARACTERISTIC
/begin CHARACTERISTIC KINP_SACtrlBrakeCtrl_SA_ovrdflg "" VALUE 0x0000 /* @ECU_Address@KINP_SACtrlBrakeCtrl_SA_ovrdflg@ */ Scalar_BOOLEAN 0 SWC_INP_type_CM_boolean_flg 0.0 1.0 /end CHARACTERISTIC
/begin CHARACTERISTIC KINP_SeatSW_flg_inverse "" VALUE 0x0000 /* @ECU_Address@KINP_SeatSW_flg_inverse@ */ Scalar_BOOLEAN 0 SWC_INP_type_CM_boolean_flg 0.0 1.0 /end CHARACTERISTIC
/begin CHARACTERISTIC KINP_SeatSW_flg_ovrdflg "" VALUE 0x0000 /* @ECU_Address@KINP_SeatSW_flg_ovrdflg@ */ Scalar_BOOLEAN 0 SWC_INP_type_CM_boolean_flg 0.0 1.0 /end CHARACTERISTIC
/begin CHARACTERISTIC KINP_SeatSW_flg_ovrdval "" VALUE 0x0000 /* @ECU_Address@KINP_SeatSW_flg_ovrdval@ */ Scalar_BOOLEAN 0 SWC_INP_type_CM_boolean_flg 0.0 1.0 /end CHARACTERISTIC
/begin CHARACTERISTIC KINP_SeatSW_flg_srvcflg "" VALUE 0x0000 /* @ECU_Address@KINP_SeatSW_flg_srvcflg@ */ Scalar_BOOLEAN 0 SWC_INP_type_CM_boolean_flg 0.0 1.0 /end CHARACTERISTIC
/begin CHARACTERISTIC KINP_SeatSW_flg_srvcval "" VALUE 0x0000 /* @ECU_Address@KINP_SeatSW_flg_srvcval@ */ Scalar_BOOLEAN 0 SWC_INP_type_CM_boolean_flg 0.0 1.0 /end CHARACTERISTIC
/begin CHARACTERISTIC KINP_TM2BFaultCode_enum_ovrdflg "" VALUE 0x0000 /* @ECU_Address@KINP_TM2BFaultCode_enum_ovrdflg@ */ Scalar_BOOLEAN 0 SWC_INP_type_CM_boolean_flg 0.0 1.0 /end CHARACTERISTIC
/begin CHARACTERISTIC KINP_TailgateSW_flg_inverse "" VALUE 0x0000 /* @ECU_Address@KINP_TailgateSW_flg_inverse@ */ Scalar_BOOLEAN 0 SWC_INP_type_CM_boolean_flg 0.0 1.0 /end CHARACTERISTIC
/begin CHARACTERISTIC KINP_TailgateSW_flg_ovrdflg "" VALUE 0x0000 /* @ECU_Address@KINP_TailgateSW_flg_ovrdflg@ */ Scalar_BOOLEAN 0 SWC_INP_type_CM_boolean_flg 0.0 1.0 /end CHARACTERISTIC
/begin CHARACTERISTIC KINP_TailgateSW_flg_ovrdval "" VALUE 0x0000 /* @ECU_Address@KINP_TailgateSW_flg_ovrdval@ */ Scalar_BOOLEAN 0 SWC_INP_type_CM_boolean_flg 0.0 1.0 /end CHARACTERISTIC
/begin CHARACTERISTIC KINP_TailgateSW_flg_srvcflg "" VALUE 0x0000 /* @ECU_Address@KINP_TailgateSW_flg_srvcflg@ */ Scalar_BOOLEAN 0 SWC_INP_type_CM_boolean_flg 0.0 1.0 /end CHARACTERISTIC
/begin CHARACTERISTIC KINP_TailgateSW_flg_srvcval "" VALUE 0x0000 /* @ECU_Address@KINP_TailgateSW_flg_srvcval@ */ Scalar_BOOLEAN 0 SWC_INP_type_CM_boolean_flg 0.0 1.0 /end CHARACTERISTIC
/begin CHARACTERISTIC KINP_TractCtrlOvrSw_enum_ovrdflg "" VALUE 0x0000 /* @ECU_Address@KINP_TractCtrlOvrSw_enum_ovrdflg@ */ Scalar_BOOLEAN 0 SWC_INP_type_CM_boolean_flg 0.0 1.0 /end CHARACTERISTIC
/begin CHARACTERISTIC KINP_TrailerABSSta_enum_ovrdflg "" VALUE 0x0000 /* @ECU_Address@KINP_TrailerABSSta_enum_ovrdflg@ */ Scalar_BOOLEAN 0 SWC_INP_type_CM_boolean_flg 0.0 1.0 /end CHARACTERISTIC
/begin CHARACTERISTIC KINP_TrailerABSWarnSig_enum_ovrdflg "" VALUE 0x0000 /* @ECU_Address@KINP_TrailerABSWarnSig_enum_ovrdflg@ */ Scalar_BOOLEAN 0 SWC_INP_type_CM_boolean_flg 0.0 1.0 /end CHARACTERISTIC
/begin CHARACTERISTIC KINP_TransReqGear_enum_ovrdflg "" VALUE 0x0000 /* @ECU_Address@KINP_TransReqGear_enum_ovrdflg@ */ Scalar_BOOLEAN 0 SWC_INP_type_CM_boolean_flg 0.0 1.0 /end CHARACTERISTIC
/begin CHARACTERISTIC KINP_TrunkHanSW_flg_inverse "" VALUE 0x0000 /* @ECU_Address@KINP_TrunkHanSW_flg_inverse@ */ Scalar_BOOLEAN 0 SWC_INP_type_CM_boolean_flg 0.0 1.0 /end CHARACTERISTIC
/begin CHARACTERISTIC KINP_TrunkHanSW_flg_ovrdflg "" VALUE 0x0000 /* @ECU_Address@KINP_TrunkHanSW_flg_ovrdflg@ */ Scalar_BOOLEAN 0 SWC_INP_type_CM_boolean_flg 0.0 1.0 /end CHARACTERISTIC
/begin CHARACTERISTIC KINP_TrunkHanSW_flg_ovrdval "" VALUE 0x0000 /* @ECU_Address@KINP_TrunkHanSW_flg_ovrdval@ */ Scalar_BOOLEAN 0 SWC_INP_type_CM_boolean_flg 0.0 1.0 /end CHARACTERISTIC
/begin CHARACTERISTIC KINP_TrunkHanSW_flg_srvcflg "" VALUE 0x0000 /* @ECU_Address@KINP_TrunkHanSW_flg_srvcflg@ */ Scalar_BOOLEAN 0 SWC_INP_type_CM_boolean_flg 0.0 1.0 /end CHARACTERISTIC
/begin CHARACTERISTIC KINP_TrunkHanSW_flg_srvcval "" VALUE 0x0000 /* @ECU_Address@KINP_TrunkHanSW_flg_srvcval@ */ Scalar_BOOLEAN 0 SWC_INP_type_CM_boolean_flg 0.0 1.0 /end CHARACTERISTIC
/begin CHARACTERISTIC KINP_WhlSpeedFL_kph_ovrdflg "" VALUE 0x0000 /* @ECU_Address@KINP_WhlSpeedFL_kph_ovrdflg@ */ Scalar_BOOLEAN 0 SWC_INP_type_CM_boolean_flg 0.0 1.0 /end CHARACTERISTIC
/begin CHARACTERISTIC KINP_XBRAcltnLimit_mps2_ovrdflg "" VALUE 0x0000 /* @ECU_Address@KINP_XBRAcltnLimit_mps2_ovrdflg@ */ Scalar_BOOLEAN 0 SWC_INP_type_CM_boolean_flg 0.0 1.0 /end CHARACTERISTIC
/begin CHARACTERISTIC KINP_XBRActtrlMode_enum_ovrdflg "" VALUE 0x0000 /* @ECU_Address@KINP_XBRActtrlMode_enum_ovrdflg@ */ Scalar_BOOLEAN 0 SWC_INP_type_CM_boolean_flg 0.0 1.0 /end CHARACTERISTIC
/begin CHARACTERISTIC KINP_XBRSysSta_enum_ovrdflg "" VALUE 0x0000 /* @ECU_Address@KINP_XBRSysSta_enum_ovrdflg@ */ Scalar_BOOLEAN 0 SWC_INP_type_CM_boolean_flg 0.0 1.0 /end CHARACTERISTIC
/begin CHARACTERISTIC KINP_ZFRBCMAutoLightSWSta_flg_defval "" VALUE 0x0000 /* @ECU_Address@KINP_ZFRBCMAutoLightSWSta_flg_defval@ */ Scalar_BOOLEAN 0 SWC_INP_type_CM_boolean_flg 0.0 1.0 /end CHARACTERISTIC
/begin CHARACTERISTIC KINP_ZFRBCMAutoLightSWSta_flg_ovrdflg "" VALUE 0x0000 /* @ECU_Address@KINP_ZFRBCMAutoLightSWSta_flg_ovrdflg@ */ Scalar_BOOLEAN 0 SWC_INP_type_CM_boolean_flg 0.0 1.0 /end CHARACTERISTIC
/begin CHARACTERISTIC KINP_ZFRBCMAutoLightSWSta_flg_ovrdval "" VALUE 0x0000 /* @ECU_Address@KINP_ZFRBCMAutoLightSWSta_flg_ovrdval@ */ Scalar_BOOLEAN 0 SWC_INP_type_CM_boolean_flg 0.0 1.0 /end CHARACTERISTIC
/begin CHARACTERISTIC KINP_ZFRBCMBrakeSta_flg_defval "" VALUE 0x0000 /* @ECU_Address@KINP_ZFRBCMBrakeSta_flg_defval@ */ Scalar_BOOLEAN 0 SWC_INP_type_CM_boolean_flg 0.0 1.0 /end CHARACTERISTIC
/begin CHARACTERISTIC KINP_ZFRBCMBrakeSta_flg_ovrdflg "" VALUE 0x0000 /* @ECU_Address@KINP_ZFRBCMBrakeSta_flg_ovrdflg@ */ Scalar_BOOLEAN 0 SWC_INP_type_CM_boolean_flg 0.0 1.0 /end CHARACTERISTIC
/begin CHARACTERISTIC KINP_ZFRBCMBrakeSta_flg_ovrdval "" VALUE 0x0000 /* @ECU_Address@KINP_ZFRBCMBrakeSta_flg_ovrdval@ */ Scalar_BOOLEAN 0 SWC_INP_type_CM_boolean_flg 0.0 1.0 /end CHARACTERISTIC
/begin CHARACTERISTIC KINP_ZFRBCMHBeamSWSta_flg_defval "" VALUE 0x0000 /* @ECU_Address@KINP_ZFRBCMHBeamSWSta_flg_defval@ */ Scalar_BOOLEAN 0 SWC_INP_type_CM_boolean_flg 0.0 1.0 /end CHARACTERISTIC
/begin CHARACTERISTIC KINP_ZFRBCMHBeamSWSta_flg_ovrdflg "" VALUE 0x0000 /* @ECU_Address@KINP_ZFRBCMHBeamSWSta_flg_ovrdflg@ */ Scalar_BOOLEAN 0 SWC_INP_type_CM_boolean_flg 0.0 1.0 /end CHARACTERISTIC
/begin CHARACTERISTIC KINP_ZFRBCMHBeamSWSta_flg_ovrdval "" VALUE 0x0000 /* @ECU_Address@KINP_ZFRBCMHBeamSWSta_flg_ovrdval@ */ Scalar_BOOLEAN 0 SWC_INP_type_CM_boolean_flg 0.0 1.0 /end CHARACTERISTIC
/begin CHARACTERISTIC KINP_ZFRBCMHeadLpSWSta_flg_defval "" VALUE 0x0000 /* @ECU_Address@KINP_ZFRBCMHeadLpSWSta_flg_defval@ */ Scalar_BOOLEAN 0 SWC_INP_type_CM_boolean_flg 0.0 1.0 /end CHARACTERISTIC
/begin CHARACTERISTIC KINP_ZFRBCMHeadLpSWSta_flg_ovrdflg "" VALUE 0x0000 /* @ECU_Address@KINP_ZFRBCMHeadLpSWSta_flg_ovrdflg@ */ Scalar_BOOLEAN 0 SWC_INP_type_CM_boolean_flg 0.0 1.0 /end CHARACTERISTIC
/begin CHARACTERISTIC KINP_ZFRBCMHeadLpSWSta_flg_ovrdval "" VALUE 0x0000 /* @ECU_Address@KINP_ZFRBCMHeadLpSWSta_flg_ovrdval@ */ Scalar_BOOLEAN 0 SWC_INP_type_CM_boolean_flg 0.0 1.0 /end CHARACTERISTIC
/begin CHARACTERISTIC KINP_ZFRBCMLFTurnLpCSta_A_ovrdflg "" VALUE 0x0000 /* @ECU_Address@KINP_ZFRBCMLFTurnLpCSta_A_ovrdflg@ */ Scalar_BOOLEAN 0 SWC_INP_type_CM_boolean_flg 0.0 1.0 /end CHARACTERISTIC
/begin CHARACTERISTIC KINP_ZFRBCMLightSensorVSta_V_ovrdflg "" VALUE 0x0000 /* @ECU_Address@KINP_ZFRBCMLightSensorVSta_V_ovrdflg@ */ Scalar_BOOLEAN 0 SWC_INP_type_CM_boolean_flg 0.0 1.0 /end CHARACTERISTIC
/begin CHARACTERISTIC KINP_ZFRBCMPLampSta_flg_defval "" VALUE 0x0000 /* @ECU_Address@KINP_ZFRBCMPLampSta_flg_defval@ */ Scalar_BOOLEAN 0 SWC_INP_type_CM_boolean_flg 0.0 1.0 /end CHARACTERISTIC
/begin CHARACTERISTIC KINP_ZFRBCMPLampSta_flg_ovrdflg "" VALUE 0x0000 /* @ECU_Address@KINP_ZFRBCMPLampSta_flg_ovrdflg@ */ Scalar_BOOLEAN 0 SWC_INP_type_CM_boolean_flg 0.0 1.0 /end CHARACTERISTIC
/begin CHARACTERISTIC KINP_ZFRBCMPLampSta_flg_ovrdval "" VALUE 0x0000 /* @ECU_Address@KINP_ZFRBCMPLampSta_flg_ovrdval@ */ Scalar_BOOLEAN 0 SWC_INP_type_CM_boolean_flg 0.0 1.0 /end CHARACTERISTIC
/begin CHARACTERISTIC KINP_ZFRBCMRFTurnLpCSta_A_ovrdflg "" VALUE 0x0000 /* @ECU_Address@KINP_ZFRBCMRFTurnLpCSta_A_ovrdflg@ */ Scalar_BOOLEAN 0 SWC_INP_type_CM_boolean_flg 0.0 1.0 /end CHARACTERISTIC
/begin CHARACTERISTIC KINP_ZFRBCMRFogLpSWSta_flg_defval "" VALUE 0x0000 /* @ECU_Address@KINP_ZFRBCMRFogLpSWSta_flg_defval@ */ Scalar_BOOLEAN 0 SWC_INP_type_CM_boolean_flg 0.0 1.0 /end CHARACTERISTIC
/begin CHARACTERISTIC KINP_ZFRBCMRFogLpSWSta_flg_ovrdflg "" VALUE 0x0000 /* @ECU_Address@KINP_ZFRBCMRFogLpSWSta_flg_ovrdflg@ */ Scalar_BOOLEAN 0 SWC_INP_type_CM_boolean_flg 0.0 1.0 /end CHARACTERISTIC
/begin CHARACTERISTIC KINP_ZFRBCMRFogLpSWSta_flg_ovrdval "" VALUE 0x0000 /* @ECU_Address@KINP_ZFRBCMRFogLpSWSta_flg_ovrdval@ */ Scalar_BOOLEAN 0 SWC_INP_type_CM_boolean_flg 0.0 1.0 /end CHARACTERISTIC
/begin CHARACTERISTIC KINP_ZFRBCMSeatbeltSta_flg_defval "" VALUE 0x0000 /* @ECU_Address@KINP_ZFRBCMSeatbeltSta_flg_defval@ */ Scalar_BOOLEAN 0 SWC_INP_type_CM_boolean_flg 0.0 1.0 /end CHARACTERISTIC
/begin CHARACTERISTIC KINP_ZFRBCMSeatbeltSta_flg_ovrdflg "" VALUE 0x0000 /* @ECU_Address@KINP_ZFRBCMSeatbeltSta_flg_ovrdflg@ */ Scalar_BOOLEAN 0 SWC_INP_type_CM_boolean_flg 0.0 1.0 /end CHARACTERISTIC
/begin CHARACTERISTIC KINP_ZFRBCMSeatbeltSta_flg_ovrdval "" VALUE 0x0000 /* @ECU_Address@KINP_ZFRBCMSeatbeltSta_flg_ovrdval@ */ Scalar_BOOLEAN 0 SWC_INP_type_CM_boolean_flg 0.0 1.0 /end CHARACTERISTIC
/begin CHARACTERISTIC KINP_ZFRBCMWasherSWSta_flg_defval "" VALUE 0x0000 /* @ECU_Address@KINP_ZFRBCMWasherSWSta_flg_defval@ */ Scalar_BOOLEAN 0 SWC_INP_type_CM_boolean_flg 0.0 1.0 /end CHARACTERISTIC
/begin CHARACTERISTIC KINP_ZFRBCMWasherSWSta_flg_ovrdflg "" VALUE 0x0000 /* @ECU_Address@KINP_ZFRBCMWasherSWSta_flg_ovrdflg@ */ Scalar_BOOLEAN 0 SWC_INP_type_CM_boolean_flg 0.0 1.0 /end CHARACTERISTIC
/begin CHARACTERISTIC KINP_ZFRBCMWasherSWSta_flg_ovrdval "" VALUE 0x0000 /* @ECU_Address@KINP_ZFRBCMWasherSWSta_flg_ovrdval@ */ Scalar_BOOLEAN 0 SWC_INP_type_CM_boolean_flg 0.0 1.0 /end CHARACTERISTIC
/begin CHARACTERISTIC KINP_ZFRBCMWiperASSta_flg_defval "" VALUE 0x0000 /* @ECU_Address@KINP_ZFRBCMWiperASSta_flg_defval@ */ Scalar_BOOLEAN 0 SWC_INP_type_CM_boolean_flg 0.0 1.0 /end CHARACTERISTIC
/begin CHARACTERISTIC KINP_ZFRBCMWiperASSta_flg_ovrdflg "" VALUE 0x0000 /* @ECU_Address@KINP_ZFRBCMWiperASSta_flg_ovrdflg@ */ Scalar_BOOLEAN 0 SWC_INP_type_CM_boolean_flg 0.0 1.0 /end CHARACTERISTIC
/begin CHARACTERISTIC KINP_ZFRBCMWiperASSta_flg_ovrdval "" VALUE 0x0000 /* @ECU_Address@KINP_ZFRBCMWiperASSta_flg_ovrdval@ */ Scalar_BOOLEAN 0 SWC_INP_type_CM_boolean_flg 0.0 1.0 /end CHARACTERISTIC
/begin CHARACTERISTIC KINP_ZFRBCMWiperHSWSta_flg_defval "" VALUE 0x0000 /* @ECU_Address@KINP_ZFRBCMWiperHSWSta_flg_defval@ */ Scalar_BOOLEAN 0 SWC_INP_type_CM_boolean_flg 0.0 1.0 /end CHARACTERISTIC
/begin CHARACTERISTIC KINP_ZFRBCMWiperHSWSta_flg_ovrdflg "" VALUE 0x0000 /* @ECU_Address@KINP_ZFRBCMWiperHSWSta_flg_ovrdflg@ */ Scalar_BOOLEAN 0 SWC_INP_type_CM_boolean_flg 0.0 1.0 /end CHARACTERISTIC
/begin CHARACTERISTIC KINP_ZFRBCMWiperHSWSta_flg_ovrdval "" VALUE 0x0000 /* @ECU_Address@KINP_ZFRBCMWiperHSWSta_flg_ovrdval@ */ Scalar_BOOLEAN 0 SWC_INP_type_CM_boolean_flg 0.0 1.0 /end CHARACTERISTIC
/begin CHARACTERISTIC KINP_ZFRBCMWiperLSWSta_flg_defval "" VALUE 0x0000 /* @ECU_Address@KINP_ZFRBCMWiperLSWSta_flg_defval@ */ Scalar_BOOLEAN 0 SWC_INP_type_CM_boolean_flg 0.0 1.0 /end CHARACTERISTIC
/begin CHARACTERISTIC KINP_ZFRBCMWiperLSWSta_flg_ovrdflg "" VALUE 0x0000 /* @ECU_Address@KINP_ZFRBCMWiperLSWSta_flg_ovrdflg@ */ Scalar_BOOLEAN 0 SWC_INP_type_CM_boolean_flg 0.0 1.0 /end CHARACTERISTIC
/begin CHARACTERISTIC KINP_ZFRBCMWiperLSWSta_flg_ovrdval "" VALUE 0x0000 /* @ECU_Address@KINP_ZFRBCMWiperLSWSta_flg_ovrdval@ */ Scalar_BOOLEAN 0 SWC_INP_type_CM_boolean_flg 0.0 1.0 /end CHARACTERISTIC
/begin CHARACTERISTIC KINP_ZRRBCMAllDoorSta_enum_ovrdflg "" VALUE 0x0000 /* @ECU_Address@KINP_ZRRBCMAllDoorSta_enum_ovrdflg@ */ Scalar_BOOLEAN 0 SWC_INP_type_CM_boolean_flg 0.0 1.0 /end CHARACTERISTIC
/begin CHARACTERISTIC KINP_ZRRBCMCallingSWSta_flg_defval "" VALUE 0x0000 /* @ECU_Address@KINP_ZRRBCMCallingSWSta_flg_defval@ */ Scalar_BOOLEAN 0 SWC_INP_type_CM_boolean_flg 0.0 1.0 /end CHARACTERISTIC
/begin CHARACTERISTIC KINP_ZRRBCMCallingSWSta_flg_ovrdflg "" VALUE 0x0000 /* @ECU_Address@KINP_ZRRBCMCallingSWSta_flg_ovrdflg@ */ Scalar_BOOLEAN 0 SWC_INP_type_CM_boolean_flg 0.0 1.0 /end CHARACTERISTIC
/begin CHARACTERISTIC KINP_ZRRBCMCallingSWSta_flg_ovrdval "" VALUE 0x0000 /* @ECU_Address@KINP_ZRRBCMCallingSWSta_flg_ovrdval@ */ Scalar_BOOLEAN 0 SWC_INP_type_CM_boolean_flg 0.0 1.0 /end CHARACTERISTIC
/begin CHARACTERISTIC KINP_ZRRBCMLRTurnLpCSta_A_ovrdflg "" VALUE 0x0000 /* @ECU_Address@KINP_ZRRBCMLRTurnLpCSta_A_ovrdflg@ */ Scalar_BOOLEAN 0 SWC_INP_type_CM_boolean_flg 0.0 1.0 /end CHARACTERISTIC
/begin CHARACTERISTIC KINP_ZRRBCMPLampSta_flg_defval "" VALUE 0x0000 /* @ECU_Address@KINP_ZRRBCMPLampSta_flg_defval@ */ Scalar_BOOLEAN 0 SWC_INP_type_CM_boolean_flg 0.0 1.0 /end CHARACTERISTIC
/begin CHARACTERISTIC KINP_ZRRBCMPLampSta_flg_ovrdflg "" VALUE 0x0000 /* @ECU_Address@KINP_ZRRBCMPLampSta_flg_ovrdflg@ */ Scalar_BOOLEAN 0 SWC_INP_type_CM_boolean_flg 0.0 1.0 /end CHARACTERISTIC
/begin CHARACTERISTIC KINP_ZRRBCMPLampSta_flg_ovrdval "" VALUE 0x0000 /* @ECU_Address@KINP_ZRRBCMPLampSta_flg_ovrdval@ */ Scalar_BOOLEAN 0 SWC_INP_type_CM_boolean_flg 0.0 1.0 /end CHARACTERISTIC
/begin CHARACTERISTIC KINP_ZRRBCMRRTurnLpCSta_A_ovrdflg "" VALUE 0x0000 /* @ECU_Address@KINP_ZRRBCMRRTurnLpCSta_A_ovrdflg@ */ Scalar_BOOLEAN 0 SWC_INP_type_CM_boolean_flg 0.0 1.0 /end CHARACTERISTIC
/begin CHARACTERISTIC KINP_ZRRBCMSTOPSW2Sta_flg_defval "" VALUE 0x0000 /* @ECU_Address@KINP_ZRRBCMSTOPSW2Sta_flg_defval@ */ Scalar_BOOLEAN 0 SWC_INP_type_CM_boolean_flg 0.0 1.0 /end CHARACTERISTIC
/begin CHARACTERISTIC KINP_ZRRBCMSTOPSW2Sta_flg_ovrdflg "" VALUE 0x0000 /* @ECU_Address@KINP_ZRRBCMSTOPSW2Sta_flg_ovrdflg@ */ Scalar_BOOLEAN 0 SWC_INP_type_CM_boolean_flg 0.0 1.0 /end CHARACTERISTIC
/begin CHARACTERISTIC KINP_ZRRBCMSTOPSW2Sta_flg_ovrdval "" VALUE 0x0000 /* @ECU_Address@KINP_ZRRBCMSTOPSW2Sta_flg_ovrdval@ */ Scalar_BOOLEAN 0 SWC_INP_type_CM_boolean_flg 0.0 1.0 /end CHARACTERISTIC
/begin CHARACTERISTIC KINP_ZRRBCMSTOPSWSta_flg_defval "" VALUE 0x0000 /* @ECU_Address@KINP_ZRRBCMSTOPSWSta_flg_defval@ */ Scalar_BOOLEAN 0 SWC_INP_type_CM_boolean_flg 0.0 1.0 /end CHARACTERISTIC
/begin CHARACTERISTIC KINP_ZRRBCMSTOPSWSta_flg_ovrdflg "" VALUE 0x0000 /* @ECU_Address@KINP_ZRRBCMSTOPSWSta_flg_ovrdflg@ */ Scalar_BOOLEAN 0 SWC_INP_type_CM_boolean_flg 0.0 1.0 /end CHARACTERISTIC
/begin CHARACTERISTIC KINP_ZRRBCMSTOPSWSta_flg_ovrdval "" VALUE 0x0000 /* @ECU_Address@KINP_ZRRBCMSTOPSWSta_flg_ovrdval@ */ Scalar_BOOLEAN 0 SWC_INP_type_CM_boolean_flg 0.0 1.0 /end CHARACTERISTIC
/begin CHARACTERISTIC KINP_ABSFullyOper_enum_defval "" VALUE 0x0000 /* @ECU_Address@KINP_ABSFullyOper_enum_defval@ */ Scalar_UBYTE 0 SWC_INP_type_CM_uint8_enum 0.0 3.0 /end CHARACTERISTIC
/begin CHARACTERISTIC KINP_ABSFullyOper_enum_ovrdval "" VALUE 0x0000 /* @ECU_Address@KINP_ABSFullyOper_enum_ovrdval@ */ Scalar_UBYTE 0 SWC_INP_type_CM_uint8_enum 0.0 3.0 /end CHARACTERISTIC
/begin CHARACTERISTIC KINP_ABSOffroadSw_enum_defval "" VALUE 0x0000 /* @ECU_Address@KINP_ABSOffroadSw_enum_defval@ */ Scalar_UBYTE 0 SWC_INP_type_CM_uint8_enum 0.0 3.0 /end CHARACTERISTIC
/begin CHARACTERISTIC KINP_ABSOffroadSw_enum_ovrdval "" VALUE 0x0000 /* @ECU_Address@KINP_ABSOffroadSw_enum_ovrdval@ */ Scalar_UBYTE 0 SWC_INP_type_CM_uint8_enum 0.0 3.0 /end CHARACTERISTIC
/begin CHARACTERISTIC KINP_ACFanSpdSta_enum_defval "" VALUE 0x0000 /* @ECU_Address@KINP_ACFanSpdSta_enum_defval@ */ Scalar_UBYTE 0 SWC_INP_type_CM_uint8_enum 0.0 3.0 /end CHARACTERISTIC
/begin CHARACTERISTIC KINP_ACFanSpdSta_enum_ovrdval "" VALUE 0x0000 /* @ECU_Address@KINP_ACFanSpdSta_enum_ovrdval@ */ Scalar_UBYTE 0 SWC_INP_type_CM_uint8_enum 0.0 3.0 /end CHARACTERISTIC
/begin CHARACTERISTIC KINP_ASC1KneelingInfo_enum_defval "" VALUE 0x0000 /* @ECU_Address@KINP_ASC1KneelingInfo_enum_defval@ */ Scalar_UBYTE 0 SWC_INP_type_CM_uint8_enum 0.0 15.0 /end CHARACTERISTIC
/begin CHARACTERISTIC KINP_ASC1KneelingInfo_enum_ovrdval "" VALUE 0x0000 /* @ECU_Address@KINP_ASC1KneelingInfo_enum_ovrdval@ */ Scalar_UBYTE 0 SWC_INP_type_CM_uint8_enum 0.0 15.0 /end CHARACTERISTIC
/begin CHARACTERISTIC KINP_ASRBrakeCtrlAtc_enum_defval "" VALUE 0x0000 /* @ECU_Address@KINP_ASRBrakeCtrlAtc_enum_defval@ */ Scalar_UBYTE 0 SWC_INP_type_CM_uint8_enum 0.0 3.0 /end CHARACTERISTIC
/begin CHARACTERISTIC KINP_ASRBrakeCtrlAtc_enum_ovrdval "" VALUE 0x0000 /* @ECU_Address@KINP_ASRBrakeCtrlAtc_enum_ovrdval@ */ Scalar_UBYTE 0 SWC_INP_type_CM_uint8_enum 0.0 3.0 /end CHARACTERISTIC
/begin CHARACTERISTIC KINP_ASREngCtrlAtc_enum_defval "" VALUE 0x0000 /* @ECU_Address@KINP_ASREngCtrlAtc_enum_defval@ */ Scalar_UBYTE 0 SWC_INP_type_CM_uint8_enum 0.0 3.0 /end CHARACTERISTIC
/begin CHARACTERISTIC KINP_ASREngCtrlAtc_enum_ovrdval "" VALUE 0x0000 /* @ECU_Address@KINP_ASREngCtrlAtc_enum_ovrdval@ */ Scalar_UBYTE 0 SWC_INP_type_CM_uint8_enum 0.0 3.0 /end CHARACTERISTIC
/begin CHARACTERISTIC KINP_ASRHillHolderSw_enum_defval "" VALUE 0x0000 /* @ECU_Address@KINP_ASRHillHolderSw_enum_defval@ */ Scalar_UBYTE 0 SWC_INP_type_CM_uint8_enum 0.0 3.0 /end CHARACTERISTIC
/begin CHARACTERISTIC KINP_ASRHillHolderSw_enum_ovrdval "" VALUE 0x0000 /* @ECU_Address@KINP_ASRHillHolderSw_enum_ovrdval@ */ Scalar_UBYTE 0 SWC_INP_type_CM_uint8_enum 0.0 3.0 /end CHARACTERISTIC
/begin CHARACTERISTIC KINP_ASROffroadSw_enum_defval "" VALUE 0x0000 /* @ECU_Address@KINP_ASROffroadSw_enum_defval@ */ Scalar_UBYTE 0 SWC_INP_type_CM_uint8_enum 0.0 3.0 /end CHARACTERISTIC
/begin CHARACTERISTIC KINP_ASROffroadSw_enum_ovrdval "" VALUE 0x0000 /* @ECU_Address@KINP_ASROffroadSw_enum_ovrdval@ */ Scalar_UBYTE 0 SWC_INP_type_CM_uint8_enum 0.0 3.0 /end CHARACTERISTIC
/begin CHARACTERISTIC KINP_ATCASRInfoSig_enum_defval "" VALUE 0x0000 /* @ECU_Address@KINP_ATCASRInfoSig_enum_defval@ */ Scalar_UBYTE 0 SWC_INP_type_CM_uint8_enum 0.0 3.0 /end CHARACTERISTIC
/begin CHARACTERISTIC KINP_ATCASRInfoSig_enum_ovrdval "" VALUE 0x0000 /* @ECU_Address@KINP_ATCASRInfoSig_enum_ovrdval@ */ Scalar_UBYTE 0 SWC_INP_type_CM_uint8_enum 0.0 3.0 /end CHARACTERISTIC
/begin CHARACTERISTIC KINP_AcltrInterlockSw_enum_defval "" VALUE 0x0000 /* @ECU_Address@KINP_AcltrInterlockSw_enum_defval@ */ Scalar_UBYTE 0 SWC_INP_type_CM_uint8_enum 0.0 3.0 /end CHARACTERISTIC
/begin CHARACTERISTIC KINP_AcltrInterlockSw_enum_ovrdval "" VALUE 0x0000 /* @ECU_Address@KINP_AcltrInterlockSw_enum_ovrdval@ */ Scalar_UBYTE 0 SWC_INP_type_CM_uint8_enum 0.0 3.0 /end CHARACTERISTIC
/begin CHARACTERISTIC KINP_AntiLBrakABSAct_enum_defval "" VALUE 0x0000 /* @ECU_Address@KINP_AntiLBrakABSAct_enum_defval@ */ Scalar_UBYTE 0 SWC_INP_type_CM_uint8_enum 0.0 3.0 /end CHARACTERISTIC
/begin CHARACTERISTIC KINP_AntiLBrakABSAct_enum_ovrdval "" VALUE 0x0000 /* @ECU_Address@KINP_AntiLBrakABSAct_enum_ovrdval@ */ Scalar_UBYTE 0 SWC_INP_type_CM_uint8_enum 0.0 3.0 /end CHARACTERISTIC
/begin CHARACTERISTIC KINP_B2THVRlySta_enum_defval "" VALUE 0x0000 /* @ECU_Address@KINP_B2THVRlySta_enum_defval@ */ Scalar_UBYTE 0 SWC_INP_type_CM_uint8_enum 0.0 3.0 /end CHARACTERISTIC
/begin CHARACTERISTIC KINP_B2THVRlySta_enum_ovrdval "" VALUE 0x0000 /* @ECU_Address@KINP_B2THVRlySta_enum_ovrdval@ */ Scalar_UBYTE 0 SWC_INP_type_CM_uint8_enum 0.0 3.0 /end CHARACTERISTIC
/begin CHARACTERISTIC KINP_B2VACChgNegRlySta_enum_defval "" VALUE 0x0000 /* @ECU_Address@KINP_B2VACChgNegRlySta_enum_defval@ */ Scalar_UBYTE 0 SWC_INP_type_CM_uint8_enum 0.0 3.0 /end CHARACTERISTIC
/begin CHARACTERISTIC KINP_B2VACChgNegRlySta_enum_ovrdval "" VALUE 0x0000 /* @ECU_Address@KINP_B2VACChgNegRlySta_enum_ovrdval@ */ Scalar_UBYTE 0 SWC_INP_type_CM_uint8_enum 0.0 3.0 /end CHARACTERISTIC
/begin CHARACTERISTIC KINP_B2VACChgPosRlySta_enum_defval "" VALUE 0x0000 /* @ECU_Address@KINP_B2VACChgPosRlySta_enum_defval@ */ Scalar_UBYTE 0 SWC_INP_type_CM_uint8_enum 0.0 3.0 /end CHARACTERISTIC
/begin CHARACTERISTIC KINP_B2VACChgPosRlySta_enum_ovrdval "" VALUE 0x0000 /* @ECU_Address@KINP_B2VACChgPosRlySta_enum_ovrdval@ */ Scalar_UBYTE 0 SWC_INP_type_CM_uint8_enum 0.0 3.0 /end CHARACTERISTIC
/begin CHARACTERISTIC KINP_B2VBI1BattType_enum_defval "" VALUE 0x0000 /* @ECU_Address@KINP_B2VBI1BattType_enum_defval@ */ Scalar_UBYTE 0 SWC_INP_type_CM_uint8_enum 0.0 15.0 /end CHARACTERISTIC
/begin CHARACTERISTIC KINP_B2VBI1BattType_enum_ovrdval "" VALUE 0x0000 /* @ECU_Address@KINP_B2VBI1BattType_enum_ovrdval@ */ Scalar_UBYTE 0 SWC_INP_type_CM_uint8_enum 0.0 15.0 /end CHARACTERISTIC
/begin CHARACTERISTIC KINP_B2VBMUHVSta_enum_defval "" VALUE 0x0000 /* @ECU_Address@KINP_B2VBMUHVSta_enum_defval@ */ Scalar_UBYTE 0 SWC_INP_type_CM_uint8_enum 0.0 3.0 /end CHARACTERISTIC
/begin CHARACTERISTIC KINP_B2VBMUHVSta_enum_ovrdval "" VALUE 0x0000 /* @ECU_Address@KINP_B2VBMUHVSta_enum_ovrdval@ */ Scalar_UBYTE 0 SWC_INP_type_CM_uint8_enum 0.0 3.0 /end CHARACTERISTIC
/begin CHARACTERISTIC KINP_B2VChgMode_enum_defval "" VALUE 0x0000 /* @ECU_Address@KINP_B2VChgMode_enum_defval@ */ Scalar_UBYTE 0 SWC_INP_type_CM_uint8_enum 0.0 3.0 /end CHARACTERISTIC
/begin CHARACTERISTIC KINP_B2VChgMode_enum_ovrdval "" VALUE 0x0000 /* @ECU_Address@KINP_B2VChgMode_enum_ovrdval@ */ Scalar_UBYTE 0 SWC_INP_type_CM_uint8_enum 0.0 3.0 /end CHARACTERISTIC
/begin CHARACTERISTIC KINP_B2VChgSta_enum_defval "" VALUE 0x0000 /* @ECU_Address@KINP_B2VChgSta_enum_defval@ */ Scalar_UBYTE 0 SWC_INP_type_CM_uint8_enum 0.0 3.0 /end CHARACTERISTIC
/begin CHARACTERISTIC KINP_B2VChgSta_enum_ovrdval "" VALUE 0x0000 /* @ECU_Address@KINP_B2VChgSta_enum_ovrdval@ */ Scalar_UBYTE 0 SWC_INP_type_CM_uint8_enum 0.0 3.0 /end CHARACTERISTIC
/begin CHARACTERISTIC KINP_B2VDCChgConnSta_enum_defval "" VALUE 0x0000 /* @ECU_Address@KINP_B2VDCChgConnSta_enum_defval@ */ Scalar_UBYTE 0 SWC_INP_type_CM_uint8_enum 0.0 3.0 /end CHARACTERISTIC
/begin CHARACTERISTIC KINP_B2VDCChgConnSta_enum_ovrdval "" VALUE 0x0000 /* @ECU_Address@KINP_B2VDCChgConnSta_enum_ovrdval@ */ Scalar_UBYTE 0 SWC_INP_type_CM_uint8_enum 0.0 3.0 /end CHARACTERISTIC
/begin CHARACTERISTIC KINP_B2VDCChgN1RlySta_enum_defval "" VALUE 0x0000 /* @ECU_Address@KINP_B2VDCChgN1RlySta_enum_defval@ */ Scalar_UBYTE 0 SWC_INP_type_CM_uint8_enum 0.0 3.0 /end CHARACTERISTIC
/begin CHARACTERISTIC KINP_B2VDCChgN1RlySta_enum_ovrdval "" VALUE 0x0000 /* @ECU_Address@KINP_B2VDCChgN1RlySta_enum_ovrdval@ */ Scalar_UBYTE 0 SWC_INP_type_CM_uint8_enum 0.0 3.0 /end CHARACTERISTIC
/begin CHARACTERISTIC KINP_B2VDCChgP1RlySta_enum_defval "" VALUE 0x0000 /* @ECU_Address@KINP_B2VDCChgP1RlySta_enum_defval@ */ Scalar_UBYTE 0 SWC_INP_type_CM_uint8_enum 0.0 3.0 /end CHARACTERISTIC
/begin CHARACTERISTIC KINP_B2VDCChgP1RlySta_enum_ovrdval "" VALUE 0x0000 /* @ECU_Address@KINP_B2VDCChgP1RlySta_enum_ovrdval@ */ Scalar_UBYTE 0 SWC_INP_type_CM_uint8_enum 0.0 3.0 /end CHARACTERISTIC
/begin CHARACTERISTIC KINP_B2VFaultCode_enum_defval "" VALUE 0x0000 /* @ECU_Address@KINP_B2VFaultCode_enum_defval@ */ Scalar_UBYTE 0 SWC_INP_type_CM_uint8_enum 0.0 255.0 /end CHARACTERISTIC
/begin CHARACTERISTIC KINP_B2VFaultCode_enum_ovrdval "" VALUE 0x0000 /* @ECU_Address@KINP_B2VFaultCode_enum_ovrdval@ */ Scalar_UBYTE 0 SWC_INP_type_CM_uint8_enum 0.0 255.0 /end CHARACTERISTIC
/begin CHARACTERISTIC KINP_B2VFaultLv_enum_defval "" VALUE 0x0000 /* @ECU_Address@KINP_B2VFaultLv_enum_defval@ */ Scalar_UBYTE 0 SWC_INP_type_CM_uint8_enum 0.0 3.0 /end CHARACTERISTIC
/begin CHARACTERISTIC KINP_B2VFaultLv_enum_ovrdval "" VALUE 0x0000 /* @ECU_Address@KINP_B2VFaultLv_enum_ovrdval@ */ Scalar_UBYTE 0 SWC_INP_type_CM_uint8_enum 0.0 3.0 /end CHARACTERISTIC
/begin CHARACTERISTIC KINP_B2VMainNegRlySta_enum_defval "" VALUE 0x0000 /* @ECU_Address@KINP_B2VMainNegRlySta_enum_defval@ */ Scalar_UBYTE 0 SWC_INP_type_CM_uint8_enum 0.0 3.0 /end CHARACTERISTIC
/begin CHARACTERISTIC KINP_B2VMainNegRlySta_enum_ovrdval "" VALUE 0x0000 /* @ECU_Address@KINP_B2VMainNegRlySta_enum_ovrdval@ */ Scalar_UBYTE 0 SWC_INP_type_CM_uint8_enum 0.0 3.0 /end CHARACTERISTIC
/begin CHARACTERISTIC KINP_B2VMinTempPos_enum_defval "" VALUE 0x0000 /* @ECU_Address@KINP_B2VMinTempPos_enum_defval@ */ Scalar_UBYTE 0 SWC_INP_type_CM_uint8_enum 0.0 255.0 /end CHARACTERISTIC
/begin CHARACTERISTIC KINP_B2VMinTempPos_enum_ovrdval "" VALUE 0x0000 /* @ECU_Address@KINP_B2VMinTempPos_enum_ovrdval@ */ Scalar_UBYTE 0 SWC_INP_type_CM_uint8_enum 0.0 255.0 /end CHARACTERISTIC
/begin CHARACTERISTIC KINP_B2VRqHVPwrOff_enum_defval "" VALUE 0x0000 /* @ECU_Address@KINP_B2VRqHVPwrOff_enum_defval@ */ Scalar_UBYTE 0 SWC_INP_type_CM_uint8_enum 0.0 3.0 /end CHARACTERISTIC
/begin CHARACTERISTIC KINP_B2VRqHVPwrOff_enum_ovrdval "" VALUE 0x0000 /* @ECU_Address@KINP_B2VRqHVPwrOff_enum_ovrdval@ */ Scalar_UBYTE 0 SWC_INP_type_CM_uint8_enum 0.0 3.0 /end CHARACTERISTIC
/begin CHARACTERISTIC KINP_BrkTempeWarn_enum_defval "" VALUE 0x0000 /* @ECU_Address@KINP_BrkTempeWarn_enum_defval@ */ Scalar_UBYTE 0 SWC_INP_type_CM_uint8_enum 0.0 3.0 /end CHARACTERISTIC
/begin CHARACTERISTIC KINP_BrkTempeWarn_enum_ovrdval "" VALUE 0x0000 /* @ECU_Address@KINP_BrkTempeWarn_enum_ovrdval@ */ Scalar_UBYTE 0 SWC_INP_type_CM_uint8_enum 0.0 3.0 /end CHARACTERISTIC
/begin CHARACTERISTIC KINP_DCDCEnSta_enum_defval "" VALUE 0x0000 /* @ECU_Address@KINP_DCDCEnSta_enum_defval@ */ Scalar_UBYTE 0 SWC_INP_type_CM_uint8_enum 0.0 3.0 /end CHARACTERISTIC
/begin CHARACTERISTIC KINP_DCDCEnSta_enum_ovrdval "" VALUE 0x0000 /* @ECU_Address@KINP_DCDCEnSta_enum_ovrdval@ */ Scalar_UBYTE 0 SWC_INP_type_CM_uint8_enum 0.0 3.0 /end CHARACTERISTIC
/begin CHARACTERISTIC KINP_DCDCErrLvSta_enum_defval "" VALUE 0x0000 /* @ECU_Address@KINP_DCDCErrLvSta_enum_defval@ */ Scalar_UBYTE 0 SWC_INP_type_CM_uint8_enum 0.0 7.0 /end CHARACTERISTIC
/begin CHARACTERISTIC KINP_DCDCErrLvSta_enum_ovrdval "" VALUE 0x0000 /* @ECU_Address@KINP_DCDCErrLvSta_enum_ovrdval@ */ Scalar_UBYTE 0 SWC_INP_type_CM_uint8_enum 0.0 7.0 /end CHARACTERISTIC
/begin CHARACTERISTIC KINP_DrivDirF_enum_defval "" VALUE 0x0000 /* @ECU_Address@KINP_DrivDirF_enum_defval@ */ Scalar_UBYTE 0 SWC_INP_type_CM_uint8_enum 0.0 3.0 /end CHARACTERISTIC
/begin CHARACTERISTIC KINP_DrivDirF_enum_ovrdval "" VALUE 0x0000 /* @ECU_Address@KINP_DrivDirF_enum_ovrdval@ */ Scalar_UBYTE 0 SWC_INP_type_CM_uint8_enum 0.0 3.0 /end CHARACTERISTIC
/begin CHARACTERISTIC KINP_EACEnSta_enum_defval "" VALUE 0x0000 /* @ECU_Address@KINP_EACEnSta_enum_defval@ */ Scalar_UBYTE 0 SWC_INP_type_CM_uint8_enum 0.0 3.0 /end CHARACTERISTIC
/begin CHARACTERISTIC KINP_EACEnSta_enum_ovrdval "" VALUE 0x0000 /* @ECU_Address@KINP_EACEnSta_enum_ovrdval@ */ Scalar_UBYTE 0 SWC_INP_type_CM_uint8_enum 0.0 3.0 /end CHARACTERISTIC
/begin CHARACTERISTIC KINP_EACErrLvSta_enum_defval "" VALUE 0x0000 /* @ECU_Address@KINP_EACErrLvSta_enum_defval@ */ Scalar_UBYTE 0 SWC_INP_type_CM_uint8_enum 0.0 7.0 /end CHARACTERISTIC
/begin CHARACTERISTIC KINP_EACErrLvSta_enum_ovrdval "" VALUE 0x0000 /* @ECU_Address@KINP_EACErrLvSta_enum_ovrdval@ */ Scalar_UBYTE 0 SWC_INP_type_CM_uint8_enum 0.0 7.0 /end CHARACTERISTIC
/begin CHARACTERISTIC KINP_EBSAmWarnLampSta_enum_defval "" VALUE 0x0000 /* @ECU_Address@KINP_EBSAmWarnLampSta_enum_defval@ */ Scalar_UBYTE 0 SWC_INP_type_CM_uint8_enum 0.0 3.0 /end CHARACTERISTIC
/begin CHARACTERISTIC KINP_EBSAmWarnLampSta_enum_ovrdval "" VALUE 0x0000 /* @ECU_Address@KINP_EBSAmWarnLampSta_enum_ovrdval@ */ Scalar_UBYTE 0 SWC_INP_type_CM_uint8_enum 0.0 3.0 /end CHARACTERISTIC
/begin CHARACTERISTIC KINP_EBSBrakeSw_enum_defval "" VALUE 0x0000 /* @ECU_Address@KINP_EBSBrakeSw_enum_defval@ */ Scalar_UBYTE 0 SWC_INP_type_CM_uint8_enum 0.0 3.0 /end CHARACTERISTIC
/begin CHARACTERISTIC KINP_EBSBrakeSw_enum_ovrdval "" VALUE 0x0000 /* @ECU_Address@KINP_EBSBrakeSw_enum_ovrdval@ */ Scalar_UBYTE 0 SWC_INP_type_CM_uint8_enum 0.0 3.0 /end CHARACTERISTIC
/begin CHARACTERISTIC KINP_EBSRedWarnLampSta_enum_defval "" VALUE 0x0000 /* @ECU_Address@KINP_EBSRedWarnLampSta_enum_defval@ */ Scalar_UBYTE 0 SWC_INP_type_CM_uint8_enum 0.0 3.0 /end CHARACTERISTIC
/begin CHARACTERISTIC KINP_EBSRedWarnLampSta_enum_ovrdval "" VALUE 0x0000 /* @ECU_Address@KINP_EBSRedWarnLampSta_enum_ovrdval@ */ Scalar_UBYTE 0 SWC_INP_type_CM_uint8_enum 0.0 3.0 /end CHARACTERISTIC
/begin CHARACTERISTIC KINP_ECASAWarmLampSta_enum_defval "" VALUE 0x0000 /* @ECU_Address@KINP_ECASAWarmLampSta_enum_defval@ */ Scalar_UBYTE 0 SWC_INP_type_CM_uint8_enum 0.0 3.0 /end CHARACTERISTIC
/begin CHARACTERISTIC KINP_ECASAWarmLampSta_enum_ovrdval "" VALUE 0x0000 /* @ECU_Address@KINP_ECASAWarmLampSta_enum_ovrdval@ */ Scalar_UBYTE 0 SWC_INP_type_CM_uint8_enum 0.0 3.0 /end CHARACTERISTIC
/begin CHARACTERISTIC KINP_EHPSEnSta_enum_defval "" VALUE 0x0000 /* @ECU_Address@KINP_EHPSEnSta_enum_defval@ */ Scalar_UBYTE 0 SWC_INP_type_CM_uint8_enum 0.0 3.0 /end CHARACTERISTIC
/begin CHARACTERISTIC KINP_EHPSEnSta_enum_ovrdval "" VALUE 0x0000 /* @ECU_Address@KINP_EHPSEnSta_enum_ovrdval@ */ Scalar_UBYTE 0 SWC_INP_type_CM_uint8_enum 0.0 3.0 /end CHARACTERISTIC
/begin CHARACTERISTIC KINP_EHPSErrLvSta_enum_defval "" VALUE 0x0000 /* @ECU_Address@KINP_EHPSErrLvSta_enum_defval@ */ Scalar_UBYTE 0 SWC_INP_type_CM_uint8_enum 0.0 7.0 /end CHARACTERISTIC
/begin CHARACTERISTIC KINP_EHPSErrLvSta_enum_ovrdval "" VALUE 0x0000 /* @ECU_Address@KINP_EHPSErrLvSta_enum_ovrdval@ */ Scalar_UBYTE 0 SWC_INP_type_CM_uint8_enum 0.0 7.0 /end CHARACTERISTIC
/begin CHARACTERISTIC KINP_EM1CS_enum_defval "" VALUE 0x0000 /* @ECU_Address@KINP_EM1CS_enum_defval@ */ Scalar_UBYTE 0 SWC_INP_type_CM_uint8_enum 0.0 7.0 /end CHARACTERISTIC
/begin CHARACTERISTIC KINP_EM1CS_enum_ovrdval "" VALUE 0x0000 /* @ECU_Address@KINP_EM1CS_enum_ovrdval@ */ Scalar_UBYTE 0 SWC_INP_type_CM_uint8_enum 0.0 7.0 /end CHARACTERISTIC
/begin CHARACTERISTIC KINP_EM1Cnt_enum_defval "" VALUE 0x0000 /* @ECU_Address@KINP_EM1Cnt_enum_defval@ */ Scalar_UBYTE 0 SWC_INP_type_CM_uint8_enum 0.0 7.0 /end CHARACTERISTIC
/begin CHARACTERISTIC KINP_EM1Cnt_enum_ovrdval "" VALUE 0x0000 /* @ECU_Address@KINP_EM1Cnt_enum_ovrdval@ */ Scalar_UBYTE 0 SWC_INP_type_CM_uint8_enum 0.0 7.0 /end CHARACTERISTIC
/begin CHARACTERISTIC KINP_EM1OvrCtrlMBrk_enum_defval "" VALUE 0x0000 /* @ECU_Address@KINP_EM1OvrCtrlMBrk_enum_defval@ */ Scalar_UBYTE 0 SWC_INP_type_CM_uint8_enum 0.0 3.0 /end CHARACTERISTIC
/begin CHARACTERISTIC KINP_EM1OvrCtrlMBrk_enum_ovrdval "" VALUE 0x0000 /* @ECU_Address@KINP_EM1OvrCtrlMBrk_enum_ovrdval@ */ Scalar_UBYTE 0 SWC_INP_type_CM_uint8_enum 0.0 3.0 /end CHARACTERISTIC
/begin CHARACTERISTIC KINP_EM1OvrCtrlMDriv_enum_defval "" VALUE 0x0000 /* @ECU_Address@KINP_EM1OvrCtrlMDriv_enum_defval@ */ Scalar_UBYTE 0 SWC_INP_type_CM_uint8_enum 0.0 3.0 /end CHARACTERISTIC
/begin CHARACTERISTIC KINP_EM1OvrCtrlMDriv_enum_ovrdval "" VALUE 0x0000 /* @ECU_Address@KINP_EM1OvrCtrlMDriv_enum_ovrdval@ */ Scalar_UBYTE 0 SWC_INP_type_CM_uint8_enum 0.0 3.0 /end CHARACTERISTIC
/begin CHARACTERISTIC KINP_EM1OvrCtrlMPriBrk_enum_defval "" VALUE 0x0000 /* @ECU_Address@KINP_EM1OvrCtrlMPriBrk_enum_defval@ */ Scalar_UBYTE 0 SWC_INP_type_CM_uint8_enum 0.0 3.0 /end CHARACTERISTIC
/begin CHARACTERISTIC KINP_EM1OvrCtrlMPriBrk_enum_ovrdval "" VALUE 0x0000 /* @ECU_Address@KINP_EM1OvrCtrlMPriBrk_enum_ovrdval@ */ Scalar_UBYTE 0 SWC_INP_type_CM_uint8_enum 0.0 3.0 /end CHARACTERISTIC
/begin CHARACTERISTIC KINP_EWPPEFault_enum_defval "" VALUE 0x0000 /* @ECU_Address@KINP_EWPPEFault_enum_defval@ */ Scalar_UBYTE 0 SWC_INP_type_CM_uint8_enum 0.0 255.0 /end CHARACTERISTIC
/begin CHARACTERISTIC KINP_EWPPEFault_enum_ovrdval "" VALUE 0x0000 /* @ECU_Address@KINP_EWPPEFault_enum_ovrdval@ */ Scalar_UBYTE 0 SWC_INP_type_CM_uint8_enum 0.0 255.0 /end CHARACTERISTIC
/begin CHARACTERISTIC KINP_EngAuxShutdownSw_enum_defval "" VALUE 0x0000 /* @ECU_Address@KINP_EngAuxShutdownSw_enum_defval@ */ Scalar_UBYTE 0 SWC_INP_type_CM_uint8_enum 0.0 3.0 /end CHARACTERISTIC
/begin CHARACTERISTIC KINP_EngAuxShutdownSw_enum_ovrdval "" VALUE 0x0000 /* @ECU_Address@KINP_EngAuxShutdownSw_enum_ovrdval@ */ Scalar_UBYTE 0 SWC_INP_type_CM_uint8_enum 0.0 3.0 /end CHARACTERISTIC
/begin CHARACTERISTIC KINP_EngDerateSw_enum_defval "" VALUE 0x0000 /* @ECU_Address@KINP_EngDerateSw_enum_defval@ */ Scalar_UBYTE 0 SWC_INP_type_CM_uint8_enum 0.0 3.0 /end CHARACTERISTIC
/begin CHARACTERISTIC KINP_EngDerateSw_enum_ovrdval "" VALUE 0x0000 /* @ECU_Address@KINP_EngDerateSw_enum_ovrdval@ */ Scalar_UBYTE 0 SWC_INP_type_CM_uint8_enum 0.0 3.0 /end CHARACTERISTIC
/begin CHARACTERISTIC KINP_FndBrkUse_enum_defval "" VALUE 0x0000 /* @ECU_Address@KINP_FndBrkUse_enum_defval@ */ Scalar_UBYTE 0 SWC_INP_type_CM_uint8_enum 0.0 3.0 /end CHARACTERISTIC
/begin CHARACTERISTIC KINP_FndBrkUse_enum_ovrdval "" VALUE 0x0000 /* @ECU_Address@KINP_FndBrkUse_enum_ovrdval@ */ Scalar_UBYTE 0 SWC_INP_type_CM_uint8_enum 0.0 3.0 /end CHARACTERISTIC
/begin CHARACTERISTIC KINP_HaltBrakeSw_enum_defval "" VALUE 0x0000 /* @ECU_Address@KINP_HaltBrakeSw_enum_defval@ */ Scalar_UBYTE 0 SWC_INP_type_CM_uint8_enum 0.0 3.0 /end CHARACTERISTIC
/begin CHARACTERISTIC KINP_HaltBrakeSw_enum_ovrdval "" VALUE 0x0000 /* @ECU_Address@KINP_HaltBrakeSw_enum_ovrdval@ */ Scalar_UBYTE 0 SWC_INP_type_CM_uint8_enum 0.0 3.0 /end CHARACTERISTIC
/begin CHARACTERISTIC KINP_HaltBrkMode_enum_defval "" VALUE 0x0000 /* @ECU_Address@KINP_HaltBrkMode_enum_defval@ */ Scalar_UBYTE 0 SWC_INP_type_CM_uint8_enum 0.0 7.0 /end CHARACTERISTIC
/begin CHARACTERISTIC KINP_HaltBrkMode_enum_ovrdval "" VALUE 0x0000 /* @ECU_Address@KINP_HaltBrkMode_enum_ovrdval@ */ Scalar_UBYTE 0 SWC_INP_type_CM_uint8_enum 0.0 7.0 /end CHARACTERISTIC
/begin CHARACTERISTIC KINP_HillHolderMode_enum_defval "" VALUE 0x0000 /* @ECU_Address@KINP_HillHolderMode_enum_defval@ */ Scalar_UBYTE 0 SWC_INP_type_CM_uint8_enum 0.0 7.0 /end CHARACTERISTIC
/begin CHARACTERISTIC KINP_HillHolderMode_enum_ovrdval "" VALUE 0x0000 /* @ECU_Address@KINP_HillHolderMode_enum_ovrdval@ */ Scalar_UBYTE 0 SWC_INP_type_CM_uint8_enum 0.0 7.0 /end CHARACTERISTIC
/begin CHARACTERISTIC KINP_IVIACFanSpdReqCmd_enum_defval "" VALUE 0x0000 /* @ECU_Address@KINP_IVIACFanSpdReqCmd_enum_defval@ */ Scalar_UBYTE 0 SWC_INP_type_CM_uint8_enum 0.0 3.0 /end CHARACTERISTIC
/begin CHARACTERISTIC KINP_IVIACFanSpdReqCmd_enum_ovrdval "" VALUE 0x0000 /* @ECU_Address@KINP_IVIACFanSpdReqCmd_enum_ovrdval@ */ Scalar_UBYTE 0 SWC_INP_type_CM_uint8_enum 0.0 3.0 /end CHARACTERISTIC
/begin CHARACTERISTIC KINP_MCUCtrlMdSta_enum_defval "" VALUE 0x0000 /* @ECU_Address@KINP_MCUCtrlMdSta_enum_defval@ */ Scalar_UBYTE 0 SWC_INP_type_CM_uint8_enum 0.0 3.0 /end CHARACTERISTIC
/begin CHARACTERISTIC KINP_MCUCtrlMdSta_enum_ovrdval "" VALUE 0x0000 /* @ECU_Address@KINP_MCUCtrlMdSta_enum_ovrdval@ */ Scalar_UBYTE 0 SWC_INP_type_CM_uint8_enum 0.0 3.0 /end CHARACTERISTIC
/begin CHARACTERISTIC KINP_MCUFailCode_enum_defval "" VALUE 0x0000 /* @ECU_Address@KINP_MCUFailCode_enum_defval@ */ Scalar_UBYTE 0 SWC_INP_type_CM_uint8_enum 0.0 255.0 /end CHARACTERISTIC
/begin CHARACTERISTIC KINP_MCUFailCode_enum_ovrdval "" VALUE 0x0000 /* @ECU_Address@KINP_MCUFailCode_enum_ovrdval@ */ Scalar_UBYTE 0 SWC_INP_type_CM_uint8_enum 0.0 255.0 /end CHARACTERISTIC
/begin CHARACTERISTIC KINP_MCUFailGrade_enum_defval "" VALUE 0x0000 /* @ECU_Address@KINP_MCUFailGrade_enum_defval@ */ Scalar_UBYTE 0 SWC_INP_type_CM_uint8_enum 0.0 15.0 /end CHARACTERISTIC
/begin CHARACTERISTIC KINP_MCUFailGrade_enum_ovrdval "" VALUE 0x0000 /* @ECU_Address@KINP_MCUFailGrade_enum_ovrdval@ */ Scalar_UBYTE 0 SWC_INP_type_CM_uint8_enum 0.0 15.0 /end CHARACTERISTIC
/begin CHARACTERISTIC KINP_PDUACRlySta_enum_defval "" VALUE 0x0000 /* @ECU_Address@KINP_PDUACRlySta_enum_defval@ */ Scalar_UBYTE 0 SWC_INP_type_CM_uint8_enum 0.0 3.0 /end CHARACTERISTIC
/begin CHARACTERISTIC KINP_PDUACRlySta_enum_ovrdval "" VALUE 0x0000 /* @ECU_Address@KINP_PDUACRlySta_enum_ovrdval@ */ Scalar_UBYTE 0 SWC_INP_type_CM_uint8_enum 0.0 3.0 /end CHARACTERISTIC
/begin CHARACTERISTIC KINP_PDUDCDCEACEHPSHVLoopSta_enum_defval "" VALUE 0x0000 /* @ECU_Address@KINP_PDUDCDCEACEHPSHVLoopSta_enum_defval@ */ Scalar_UBYTE 0 SWC_INP_type_CM_uint8_enum 0.0 3.0 /end CHARACTERISTIC
/begin CHARACTERISTIC KINP_PDUDCDCEACEHPSHVLoopSta_enum_ovrdval "" VALUE 0x0000 /* @ECU_Address@KINP_PDUDCDCEACEHPSHVLoopSta_enum_ovrdval@ */ Scalar_UBYTE 0 SWC_INP_type_CM_uint8_enum 0.0 3.0 /end CHARACTERISTIC
/begin CHARACTERISTIC KINP_PDUDCDCEACEHPSPreRlySta_enum_defval "" VALUE 0x0000 /* @ECU_Address@KINP_PDUDCDCEACEHPSPreRlySta_enum_defval@ */ Scalar_UBYTE 0 SWC_INP_type_CM_uint8_enum 0.0 3.0 /end CHARACTERISTIC
/begin CHARACTERISTIC KINP_PDUDCDCEACEHPSPreRlySta_enum_ovrdval "" VALUE 0x0000 /* @ECU_Address@KINP_PDUDCDCEACEHPSPreRlySta_enum_ovrdval@ */ Scalar_UBYTE 0 SWC_INP_type_CM_uint8_enum 0.0 3.0 /end CHARACTERISTIC
/begin CHARACTERISTIC KINP_PDUDCDCEACEHPSRlySta_enum_defval "" VALUE 0x0000 /* @ECU_Address@KINP_PDUDCDCEACEHPSRlySta_enum_defval@ */ Scalar_UBYTE 0 SWC_INP_type_CM_uint8_enum 0.0 3.0 /end CHARACTERISTIC
/begin CHARACTERISTIC KINP_PDUDCDCEACEHPSRlySta_enum_ovrdval "" VALUE 0x0000 /* @ECU_Address@KINP_PDUDCDCEACEHPSRlySta_enum_ovrdval@ */ Scalar_UBYTE 0 SWC_INP_type_CM_uint8_enum 0.0 3.0 /end CHARACTERISTIC
/begin CHARACTERISTIC KINP_PDUHVILSta_enum_defval "" VALUE 0x0000 /* @ECU_Address@KINP_PDUHVILSta_enum_defval@ */ Scalar_UBYTE 0 SWC_INP_type_CM_uint8_enum 0.0 3.0 /end CHARACTERISTIC
/begin CHARACTERISTIC KINP_PDUHVILSta_enum_ovrdval "" VALUE 0x0000 /* @ECU_Address@KINP_PDUHVILSta_enum_ovrdval@ */ Scalar_UBYTE 0 SWC_INP_type_CM_uint8_enum 0.0 3.0 /end CHARACTERISTIC
/begin CHARACTERISTIC KINP_PDUMCUHVLoopSta_enum_defval "" VALUE 0x0000 /* @ECU_Address@KINP_PDUMCUHVLoopSta_enum_defval@ */ Scalar_UBYTE 0 SWC_INP_type_CM_uint8_enum 0.0 3.0 /end CHARACTERISTIC
/begin CHARACTERISTIC KINP_PDUMCUHVLoopSta_enum_ovrdval "" VALUE 0x0000 /* @ECU_Address@KINP_PDUMCUHVLoopSta_enum_ovrdval@ */ Scalar_UBYTE 0 SWC_INP_type_CM_uint8_enum 0.0 3.0 /end CHARACTERISTIC
/begin CHARACTERISTIC KINP_PDUMCUPosRlySta_enum_defval "" VALUE 0x0000 /* @ECU_Address@KINP_PDUMCUPosRlySta_enum_defval@ */ Scalar_UBYTE 0 SWC_INP_type_CM_uint8_enum 0.0 3.0 /end CHARACTERISTIC
/begin CHARACTERISTIC KINP_PDUMCUPosRlySta_enum_ovrdval "" VALUE 0x0000 /* @ECU_Address@KINP_PDUMCUPosRlySta_enum_ovrdval@ */ Scalar_UBYTE 0 SWC_INP_type_CM_uint8_enum 0.0 3.0 /end CHARACTERISTIC
/begin CHARACTERISTIC KINP_PDUMCUPreRlySta_enum_defval "" VALUE 0x0000 /* @ECU_Address@KINP_PDUMCUPreRlySta_enum_defval@ */ Scalar_UBYTE 0 SWC_INP_type_CM_uint8_enum 0.0 3.0 /end CHARACTERISTIC
/begin CHARACTERISTIC KINP_PDUMCUPreRlySta_enum_ovrdval "" VALUE 0x0000 /* @ECU_Address@KINP_PDUMCUPreRlySta_enum_ovrdval@ */ Scalar_UBYTE 0 SWC_INP_type_CM_uint8_enum 0.0 3.0 /end CHARACTERISTIC
/begin CHARACTERISTIC KINP_PDUSelfChkSta_enum_defval "" VALUE 0x0000 /* @ECU_Address@KINP_PDUSelfChkSta_enum_defval@ */ Scalar_UBYTE 0 SWC_INP_type_CM_uint8_enum 0.0 3.0 /end CHARACTERISTIC
/begin CHARACTERISTIC KINP_PDUSelfChkSta_enum_ovrdval "" VALUE 0x0000 /* @ECU_Address@KINP_PDUSelfChkSta_enum_ovrdval@ */ Scalar_UBYTE 0 SWC_INP_type_CM_uint8_enum 0.0 3.0 /end CHARACTERISTIC
/begin CHARACTERISTIC KINP_ParkBrakeSW_enum_defval "" VALUE 0x0000 /* @ECU_Address@KINP_ParkBrakeSW_enum_defval@ */ Scalar_UBYTE 0 SWC_INP_type_CM_uint8_enum 0.0 3.0 /end CHARACTERISTIC
/begin CHARACTERISTIC KINP_ParkBrakeSW_enum_ovrdval "" VALUE 0x0000 /* @ECU_Address@KINP_ParkBrakeSW_enum_ovrdval@ */ Scalar_UBYTE 0 SWC_INP_type_CM_uint8_enum 0.0 3.0 /end CHARACTERISTIC
/begin CHARACTERISTIC KINP_ParkBrkActuFAct_enum_defval "" VALUE 0x0000 /* @ECU_Address@KINP_ParkBrkActuFAct_enum_defval@ */ Scalar_UBYTE 0 SWC_INP_type_CM_uint8_enum 0.0 3.0 /end CHARACTERISTIC
/begin CHARACTERISTIC KINP_ParkBrkActuFAct_enum_ovrdval "" VALUE 0x0000 /* @ECU_Address@KINP_ParkBrkActuFAct_enum_ovrdval@ */ Scalar_UBYTE 0 SWC_INP_type_CM_uint8_enum 0.0 3.0 /end CHARACTERISTIC
/begin CHARACTERISTIC KINP_PushButton_flg_debdec "" VALUE 0x0000 /* @ECU_Address@KINP_PushButton_flg_debdec@ */ Scalar_UBYTE 0 SWC_INP_type_CM_uint8_cnt 0.0 255.0 /end CHARACTERISTIC
/begin CHARACTERISTIC KINP_PushButton_flg_debinc "" VALUE 0x0000 /* @ECU_Address@KINP_PushButton_flg_debinc@ */ Scalar_UBYTE 0 SWC_INP_type_CM_uint8_cnt 0.0 255.0 /end CHARACTERISTIC
/begin CHARACTERISTIC KINP_PushButton_flg_deblim "" VALUE 0x0000 /* @ECU_Address@KINP_PushButton_flg_deblim@ */ Scalar_UBYTE 0 SWC_INP_type_CM_uint8_cnt 0.0 255.0 /end CHARACTERISTIC
/begin CHARACTERISTIC KINP_RightTurnSW_flg_debdec "" VALUE 0x0000 /* @ECU_Address@KINP_RightTurnSW_flg_debdec@ */ Scalar_UBYTE 0 SWC_INP_type_CM_uint8_cnt 0.0 255.0 /end CHARACTERISTIC
/begin CHARACTERISTIC KINP_RightTurnSW_flg_debinc "" VALUE 0x0000 /* @ECU_Address@KINP_RightTurnSW_flg_debinc@ */ Scalar_UBYTE 0 SWC_INP_type_CM_uint8_cnt 0.0 255.0 /end CHARACTERISTIC
/begin CHARACTERISTIC KINP_RightTurnSW_flg_deblim "" VALUE 0x0000 /* @ECU_Address@KINP_RightTurnSW_flg_deblim@ */ Scalar_UBYTE 0 SWC_INP_type_CM_uint8_cnt 0.0 255.0 /end CHARACTERISTIC
/begin CHARACTERISTIC KINP_RmAccelEnSw_enum_defval "" VALUE 0x0000 /* @ECU_Address@KINP_RmAccelEnSw_enum_defval@ */ Scalar_UBYTE 0 SWC_INP_type_CM_uint8_enum 0.0 3.0 /end CHARACTERISTIC
/begin CHARACTERISTIC KINP_RmAccelEnSw_enum_ovrdval "" VALUE 0x0000 /* @ECU_Address@KINP_RmAccelEnSw_enum_ovrdval@ */ Scalar_UBYTE 0 SWC_INP_type_CM_uint8_enum 0.0 3.0 /end CHARACTERISTIC
/begin CHARACTERISTIC KINP_SeatSW_flg_debdec "" VALUE 0x0000 /* @ECU_Address@KINP_SeatSW_flg_debdec@ */ Scalar_UBYTE 0 SWC_INP_type_CM_uint8_cnt 0.0 255.0 /end CHARACTERISTIC
/begin CHARACTERISTIC KINP_SeatSW_flg_debinc "" VALUE 0x0000 /* @ECU_Address@KINP_SeatSW_flg_debinc@ */ Scalar_UBYTE 0 SWC_INP_type_CM_uint8_cnt 0.0 255.0 /end CHARACTERISTIC
/begin CHARACTERISTIC KINP_SeatSW_flg_deblim "" VALUE 0x0000 /* @ECU_Address@KINP_SeatSW_flg_deblim@ */ Scalar_UBYTE 0 SWC_INP_type_CM_uint8_cnt 0.0 255.0 /end CHARACTERISTIC
/begin CHARACTERISTIC KINP_TM2BFaultCode_enum_defval "" VALUE 0x0000 /* @ECU_Address@KINP_TM2BFaultCode_enum_defval@ */ Scalar_UBYTE 0 SWC_INP_type_CM_uint8_enum 0.0 63.0 /end CHARACTERISTIC
/begin CHARACTERISTIC KINP_TM2BFaultCode_enum_ovrdval "" VALUE 0x0000 /* @ECU_Address@KINP_TM2BFaultCode_enum_ovrdval@ */ Scalar_UBYTE 0 SWC_INP_type_CM_uint8_enum 0.0 63.0 /end CHARACTERISTIC
/begin CHARACTERISTIC KINP_TailgateSW_flg_debdec "" VALUE 0x0000 /* @ECU_Address@KINP_TailgateSW_flg_debdec@ */ Scalar_UBYTE 0 SWC_INP_type_CM_uint8_cnt 0.0 255.0 /end CHARACTERISTIC
/begin CHARACTERISTIC KINP_TailgateSW_flg_debinc "" VALUE 0x0000 /* @ECU_Address@KINP_TailgateSW_flg_debinc@ */ Scalar_UBYTE 0 SWC_INP_type_CM_uint8_cnt 0.0 255.0 /end CHARACTERISTIC
/begin CHARACTERISTIC KINP_TailgateSW_flg_deblim "" VALUE 0x0000 /* @ECU_Address@KINP_TailgateSW_flg_deblim@ */ Scalar_UBYTE 0 SWC_INP_type_CM_uint8_cnt 0.0 255.0 /end CHARACTERISTIC
/begin CHARACTERISTIC KINP_TractCtrlOvrSw_enum_defval "" VALUE 0x0000 /* @ECU_Address@KINP_TractCtrlOvrSw_enum_defval@ */ Scalar_UBYTE 0 SWC_INP_type_CM_uint8_enum 0.0 3.0 /end CHARACTERISTIC
/begin CHARACTERISTIC KINP_TractCtrlOvrSw_enum_ovrdval "" VALUE 0x0000 /* @ECU_Address@KINP_TractCtrlOvrSw_enum_ovrdval@ */ Scalar_UBYTE 0 SWC_INP_type_CM_uint8_enum 0.0 3.0 /end CHARACTERISTIC
/begin CHARACTERISTIC KINP_TrailerABSSta_enum_defval "" VALUE 0x0000 /* @ECU_Address@KINP_TrailerABSSta_enum_defval@ */ Scalar_UBYTE 0 SWC_INP_type_CM_uint8_enum 0.0 3.0 /end CHARACTERISTIC
/begin CHARACTERISTIC KINP_TrailerABSSta_enum_ovrdval "" VALUE 0x0000 /* @ECU_Address@KINP_TrailerABSSta_enum_ovrdval@ */ Scalar_UBYTE 0 SWC_INP_type_CM_uint8_enum 0.0 3.0 /end CHARACTERISTIC
/begin CHARACTERISTIC KINP_TrailerABSWarnSig_enum_defval "" VALUE 0x0000 /* @ECU_Address@KINP_TrailerABSWarnSig_enum_defval@ */ Scalar_UBYTE 0 SWC_INP_type_CM_uint8_enum 0.0 3.0 /end CHARACTERISTIC
/begin CHARACTERISTIC KINP_TrailerABSWarnSig_enum_ovrdval "" VALUE 0x0000 /* @ECU_Address@KINP_TrailerABSWarnSig_enum_ovrdval@ */ Scalar_UBYTE 0 SWC_INP_type_CM_uint8_enum 0.0 3.0 /end CHARACTERISTIC
/begin CHARACTERISTIC KINP_TransReqGear_enum_defval "" VALUE 0x0000 /* @ECU_Address@KINP_TransReqGear_enum_defval@ */ Scalar_UBYTE 0 SWC_INP_type_CM_uint8_enum 0.0 255.0 /end CHARACTERISTIC
/begin CHARACTERISTIC KINP_TransReqGear_enum_ovrdval "" VALUE 0x0000 /* @ECU_Address@KINP_TransReqGear_enum_ovrdval@ */ Scalar_UBYTE 0 SWC_INP_type_CM_uint8_enum 0.0 255.0 /end CHARACTERISTIC
/begin CHARACTERISTIC KINP_TrunkHanSW_flg_debdec "" VALUE 0x0000 /* @ECU_Address@KINP_TrunkHanSW_flg_debdec@ */ Scalar_UBYTE 0 SWC_INP_type_CM_uint8_cnt 0.0 255.0 /end CHARACTERISTIC
/begin CHARACTERISTIC KINP_TrunkHanSW_flg_debinc "" VALUE 0x0000 /* @ECU_Address@KINP_TrunkHanSW_flg_debinc@ */ Scalar_UBYTE 0 SWC_INP_type_CM_uint8_cnt 0.0 255.0 /end CHARACTERISTIC
/begin CHARACTERISTIC KINP_TrunkHanSW_flg_deblim "" VALUE 0x0000 /* @ECU_Address@KINP_TrunkHanSW_flg_deblim@ */ Scalar_UBYTE 0 SWC_INP_type_CM_uint8_cnt 0.0 255.0 /end CHARACTERISTIC
/begin CHARACTERISTIC KINP_XBRActtrlMode_enum_defval "" VALUE 0x0000 /* @ECU_Address@KINP_XBRActtrlMode_enum_defval@ */ Scalar_UBYTE 0 SWC_INP_type_CM_uint8_enum 0.0 15.0 /end CHARACTERISTIC
/begin CHARACTERISTIC KINP_XBRActtrlMode_enum_ovrdval "" VALUE 0x0000 /* @ECU_Address@KINP_XBRActtrlMode_enum_ovrdval@ */ Scalar_UBYTE 0 SWC_INP_type_CM_uint8_enum 0.0 15.0 /end CHARACTERISTIC
/begin CHARACTERISTIC KINP_XBRSysSta_enum_defval "" VALUE 0x0000 /* @ECU_Address@KINP_XBRSysSta_enum_defval@ */ Scalar_UBYTE 0 SWC_INP_type_CM_uint8_enum 0.0 3.0 /end CHARACTERISTIC
/begin CHARACTERISTIC KINP_XBRSysSta_enum_ovrdval "" VALUE 0x0000 /* @ECU_Address@KINP_XBRSysSta_enum_ovrdval@ */ Scalar_UBYTE 0 SWC_INP_type_CM_uint8_enum 0.0 3.0 /end CHARACTERISTIC
/begin CHARACTERISTIC KINP_ZRRBCMAllDoorSta_enum_defval "" VALUE 0x0000 /* @ECU_Address@KINP_ZRRBCMAllDoorSta_enum_defval@ */ Scalar_UBYTE 0 SWC_INP_type_CM_uint8_enum 0.0 15.0 /end CHARACTERISTIC
/begin CHARACTERISTIC KINP_ZRRBCMAllDoorSta_enum_ovrdval "" VALUE 0x0000 /* @ECU_Address@KINP_ZRRBCMAllDoorSta_enum_ovrdval@ */ Scalar_UBYTE 0 SWC_INP_type_CM_uint8_enum 0.0 15.0 /end CHARACTERISTIC
/begin MEASUREMENT VINP_AccelPedal1VolShortHigh_enum "" UBYTE SWC_INP_type_CM_uint8_enum 0 0 0.0 255.0 ECU_ADDRESS 0x0000 /* @ECU_Address@VINP_AccelPedal1VolShortHigh_enum@ */ /end MEASUREMENT
/begin MEASUREMENT VINP_AccelPedal1VolShortLow_enum "" UBYTE SWC_INP_type_CM_uint8_enum 0 0 0.0 255.0 ECU_ADDRESS 0x0000 /* @ECU_Address@VINP_AccelPedal1VolShortLow_enum@ */ /end MEASUREMENT
/begin MEASUREMENT VINP_AccelPedal2VolShortHigh_enum "" UBYTE SWC_INP_type_CM_uint8_enum 0 0 0.0 255.0 ECU_ADDRESS 0x0000 /* @ECU_Address@VINP_AccelPedal2VolShortHigh_enum@ */ /end MEASUREMENT
/begin MEASUREMENT VINP_AccelPedal2VolShortLow_enum "" UBYTE SWC_INP_type_CM_uint8_enum 0 0 0.0 255.0 ECU_ADDRESS 0x0000 /* @ECU_Address@VINP_AccelPedal2VolShortLow_enum@ */ /end MEASUREMENT
/begin COMPU_METHOD SWC_INP_type_CM_single_C "Q = V" RAT_FUNC "%8.6" "C" COEFFS 0 1 0 0 0 1 /end COMPU_METHOD
/begin COMPU_METHOD SWC_INP_type_CM_single_mps2 "Q = V" RAT_FUNC "%8.6" "mps2" COEFFS 0 1 0 0 0 1 /end COMPU_METHOD
/begin COMPU_METHOD SWC_INP_type_CM_single_pct "Q = V" RAT_FUNC "%8.6" "pct" COEFFS 0 1 0 0 0 1 /end COMPU_METHOD
/begin COMPU_METHOD SWC_INP_type_CM_single_kph "Q = V" RAT_FUNC "%8.6" "kph" COEFFS 0 1 0 0 0 1 /end COMPU_METHOD
/begin COMPU_METHOD SWC_INP_type_CM_single_V "Q = V" RAT_FUNC "%8.6" "V" COEFFS 0 1 0 0 0 1 /end COMPU_METHOD
/begin COMPU_METHOD SWC_INP_type_CM_single_kPa "Q = V" RAT_FUNC "%8.6" "kPa" COEFFS 0 1 0 0 0 1 /end COMPU_METHOD
/begin COMPU_METHOD SWC_INP_type_CM_single_A "Q = V" RAT_FUNC "%8.6" "A" COEFFS 0 1 0 0 0 1 /end COMPU_METHOD
/begin COMPU_METHOD SWC_INP_type_CM_single_rpm "Q = V" RAT_FUNC "%8.6" "rpm" COEFFS 0 1 0 0 0 1 /end COMPU_METHOD
/begin COMPU_METHOD SWC_INP_type_CM_single_Nm "Q = V" RAT_FUNC "%8.6" "Nm" COEFFS 0 1 0 0 0 1 /end COMPU_METHOD
/begin COMPU_METHOD SWC_INP_type_CM_single_SA "Q = V" RAT_FUNC "%8.6" "SA" COEFFS 0 1 0 0 0 1 /end COMPU_METHOD
/begin COMPU_METHOD SWC_INP_type_CM_boolean_flg "Q = V" RAT_FUNC "%1.0" "flg" COEFFS 0 1 0 0 0 1 /end COMPU_METHOD
/begin COMPU_METHOD SWC_INP_type_CM_uint8_enum "Q = V" RAT_FUNC "%3.0" "enum" COEFFS 0 1 0 0 0 1 /end COMPU_METHOD
/begin COMPU_METHOD SWC_INP_type_CM_uint8_cnt "Q = V" RAT_FUNC "%3.0" "cnt" COEFFS 0 1 0 0 0 1 /end COMPU_METHOD
/begin GROUP S920_PushButton "SWC_INP_type/run_SWC_INP_5ms_sys/INP/GPIO/Digital/PushButton"
 /begin REF_CHARACTERISTIC KINP_PushButton_flg_debdec KINP_PushButton_flg_debinc KINP_PushButton_flg_deblim KINP_PushButton_flg_inverse KINP_PushButton_flg_ovrdflg KINP_PushButton_flg_ovrdval KINP_PushButton_flg_srvcflg KINP_PushButton_flg_srvcval /end REF_CHARACTERISTIC
/end GROUP
/begin GROUP S920_RightTurnSW "SWC_INP_type/run_SWC_INP_5ms_sys/INP/GPIO/Digital/RightTurnSW"
 /begin REF_CHARACTERISTIC KINP_RightTurnSW_flg_debdec KINP_RightTurnSW_flg_debinc KINP_RightTurnSW_flg_deblim KINP_RightTurnSW_flg_inverse KINP_RightTurnSW_flg_ovrdflg KINP_RightTurnSW_flg_ovrdval KINP_RightTurnSW_flg_srvcflg KINP_RightTurnSW_flg_srvcval /end REF_CHARACTERISTIC
/end GROUP
/begin GROUP S920_SeatSW "SWC_INP_type/run_SWC_INP_5ms_sys/INP/GPIO/Digital/SeatSW"
 /begin REF_CHARACTERISTIC KINP_SeatSW_flg_debdec KINP_SeatSW_flg_debinc KINP_SeatSW_flg_deblim KINP_SeatSW_flg_inverse KINP_SeatSW_flg_ovrdflg KINP_SeatSW_flg_ovrdval KINP_SeatSW_flg_srvcflg KINP_SeatSW_flg_srvcval /end REF_CHARACTERISTIC
/end GROUP
/begin GROUP S920_TailgateSW "SWC_INP_type/run_SWC_INP_5ms_sys/INP/GPIO/Digital/TailgateSW"
 /begin REF_CHARACTERISTIC KINP_TailgateSW_flg_debdec KINP_TailgateSW_flg_debinc KINP_TailgateSW_flg_deblim KINP_TailgateSW_flg_inverse KINP_TailgateSW_flg_ovrdflg KINP_TailgateSW_flg_ovrdval KINP_TailgateSW_flg_srvcflg KINP_TailgateSW_flg_srvcval /end REF_CHARACTERISTIC
/end GROUP
/begin GROUP S920_TrunkHanSW "SWC_INP_type/run_SWC_INP_5ms_sys/INP/GPIO/Digital/TrunkHanSW"
 /begin REF_CHARACTERISTIC KINP_TrunkHanSW_flg_debdec KINP_TrunkHanSW_flg_debinc KINP_TrunkHanSW_flg_deblim KINP_TrunkHanSW_flg_inverse KINP_TrunkHanSW_flg_ovrdflg KINP_TrunkHanSW_flg_ovrdval KINP_TrunkHanSW_flg_srvcflg KINP_TrunkHanSW_flg_srvcval /end REF_CHARACTERISTIC
/end GROUP
/begin GROUP S125_ACAmbTemp "SWC_INP_type/run_SWC_INP_5ms_sys/INP/CAN1/SignalCheck/AC_BTMS_C1000_0/ACAmbTemp"
 /begin REF_CHARACTERISTIC KINP_ACAmbTemp_C_defval KINP_ACAmbTemp_C_ovrdflg KINP_ACAmbTemp_C_ovrdval /end REF_CHARACTERISTIC
/end GROUP
/begin GROUP S126_ACFanSpdSta "SWC_INP_type/run_SWC_INP_5ms_sys/INP/CAN1/SignalCheck/AC_BTMS_C1000_1/ACFanSpdSta"
 /begin REF_CHARACTERISTIC KINP_ACFanSpdSta_enum_defval KINP_ACFanSpdSta_enum_ovrdflg KINP_ACFanSpdSta_enum_ovrdval /end REF_CHARACTERISTIC
/end GROUP
/begin GROUP S127_TM2BFaultCode "SWC_INP_type/run_SWC_INP_5ms_sys/INP/CAN1/SignalCheck/AC_BTMS_C1000_4/TM2BFaultCode"
 /begin REF_CHARACTERISTIC KINP_TM2BFaultCode_enum_defval KINP_TM2BFaultCode_enum_ovrdflg KINP_TM2BFaultCode_enum_ovrdval /end REF_CHARACTERISTIC
/end GROUP
/begin GROUP S128_ACTempSetSta "SWC_INP_type/run_SWC_INP_5ms_sys/INP/CAN1/SignalCheck/AC_BTMS_C5000_0/ACTempSetSta"
 /begin REF_CHARACTERISTIC KINP_ACTempSetSta_C_defval KINP_ACTempSetSta_C_ovrdflg KINP_ACTempSetSta_C_ovrdval /end REF_CHARACTERISTIC
/end GROUP
/begin GROUP S129_ASC1KneelingInfo "SWC_INP_type/run_SWC_INP_5ms_sys/INP/CAN1/SignalCheck/ASC1_A/ASC1KneelingInfo"
 /begin REF_CHARACTERISTIC KINP_ASC1KneelingInfo_enum_defval KINP_ASC1KneelingInfo_enum_ovrdflg KINP_ASC1KneelingInfo_enum_ovrdval /end REF_CHARACTERISTIC
/end GROUP
/begin GROUP S130_ABSFullyOper "SWC_INP_type/run_SWC_INP_5ms_sys/INP/CAN1/SignalCheck/EBC1/ABSFullyOper"
 /begin REF_CHARACTERISTIC KINP_ABSFullyOper_enum_defval KINP_ABSFullyOper_enum_ovrdflg KINP_ABSFullyOper_enum_ovrdval /end REF_CHARACTERISTIC
/end GROUP
/begin GROUP S130_ABSOffroadSw "SWC_INP_type/run_SWC_INP_5ms_sys/INP/CAN1/SignalCheck/EBC1/ABSOffroadSw"
 /begin REF_CHARACTERISTIC KINP_ABSOffroadSw_enum_defval KINP_ABSOffroadSw_enum_ovrdflg KINP_ABSOffroadSw_enum_ovrdval /end REF_CHARACTERISTIC
/end GROUP
/begin GROUP S130_ASRBrakeCtrlAtc "SWC_INP_type/run_SWC_INP_5ms_sys/INP/CAN1/SignalCheck/EBC1/ASRBrakeCtrlAtc"
 /begin REF_CHARACTERISTIC KINP_ASRBrakeCtrlAtc_enum_defval KINP_ASRBrakeCtrlAtc_enum_ovrdflg KINP_ASRBrakeCtrlAtc_enum_ovrdval /end REF_CHARACTERISTIC
/end GROUP
/begin GROUP S130_ASREngCtrlAtc "SWC_INP_type/run_SWC_INP_5ms_sys/INP/CAN1/SignalCheck/EBC1/ASREngCtrlAtc"
 /begin REF_CHARACTERISTIC KINP_ASREngCtrlAtc_enum_defval KINP_ASREngCtrlAtc_enum_ovrdflg KINP_ASREngCtrlAtc_enum_ovrdval /end REF_CHARACTERISTIC
/end GROUP
/begin GROUP S130_ASRHillHolderSw "SWC_INP_type/run_SWC_INP_5ms_sys/INP/CAN1/SignalCheck/EBC1/ASRHillHolderSw"
 /begin REF_CHARACTERISTIC KINP_ASRHillHolderSw_enum_defval KINP_ASRHillHolderSw_enum_ovrdflg KINP_ASRHillHolderSw_enum_ovrdval /end REF_CHARACTERISTIC
/end GROUP
/begin GROUP S130_ASROffroadSw "SWC_INP_type/run_SWC_INP_5ms_sys/INP/CAN1/SignalCheck/EBC1/ASROffroadSw"
 /begin REF_CHARACTERISTIC KINP_ASROffroadSw_enum_defval KINP_ASROffroadSw_enum_ovrdflg KINP_ASROffroadSw_enum_ovrdval /end REF_CHARACTERISTIC
/end GROUP
/begin GROUP S130_ATCASRInfoSig "SWC_INP_type/run_SWC_INP_5ms_sys/INP/CAN1/SignalCheck/EBC1/ATCASRInfoSig"
 /begin REF_CHARACTERISTIC KINP_ATCASRInfoSig_enum_defval KINP_ATCASRInfoSig_enum_ovrdflg KINP_ATCASRInfoSig_enum_ovrdval /end REF_CHARACTERISTIC
/end GROUP
/begin GROUP S130_AcltrInterlockSw "SWC_INP_type/run_SWC_INP_5ms_sys/INP/CAN1/SignalCheck/EBC1/AcltrInterlockSw"
 /begin REF_CHARACTERISTIC KINP_AcltrInterlockSw_enum_defval KINP_AcltrInterlockSw_enum_ovrdflg KINP_AcltrInterlockSw_enum_ovrdval /end REF_CHARACTERISTIC
/end GROUP
/begin GROUP S130_AntiLBrakABSAct "SWC_INP_type/run_SWC_INP_5ms_sys/INP/CAN1/SignalCheck/EBC1/AntiLBrakABSAct"
 /begin REF_CHARACTERISTIC KINP_AntiLBrakABSAct_enum_defval KINP_AntiLBrakABSAct_enum_ovrdflg KINP_AntiLBrakABSAct_enum_ovrdval /end REF_CHARACTERISTIC
/end GROUP
/begin GROUP S130_BrakePedalPos "SWC_INP_type/run_SWC_INP_5ms_sys/INP/CAN1/SignalCheck/EBC1/BrakePedalPos"
 /begin REF_CHARACTERISTIC KINP_BrakePedalPos_pct_defval KINP_BrakePedalPos_pct_ovrdflg KINP_BrakePedalPos_pct_ovrdval /end REF_CHARACTERISTIC
/end GROUP
/begin GROUP S130_EBSAmWarnLampSta "SWC_INP_type/run_SWC_INP_5ms_sys/INP/CAN1/SignalCheck/EBC1/EBSAmWarnLampSta"
 /begin REF_CHARACTERISTIC KINP_EBSAmWarnLampSta_enum_defval KINP_EBSAmWarnLampSta_enum_ovrdflg KINP_EBSAmWarnLampSta_enum_ovrdval /end REF_CHARACTERISTIC
/end GROUP
/begin GROUP S130_EBSBrakeSw "SWC_INP_type/run_SWC_INP_5ms_sys/INP/CAN1/SignalCheck/EBC1/EBSBrakeSw"
 /begin REF_CHARACTERISTIC KINP_EBSBrakeSw_enum_defval KINP_EBSBrakeSw_enum_ovrdflg KINP_EBSBrakeSw_enum_ovrdval /end REF_CHARACTERISTIC
/end GROUP
/begin GROUP S130_EBSRedWarnLampSta "SWC_INP_type/run_SWC_INP_5ms_sys/INP/CAN1/SignalCheck/EBC1/EBSRedWarnLampSta"
 /begin REF_CHARACTERISTIC KINP_EBSRedWarnLampSta_enum_defval KINP_EBSRedWarnLampSta_enum_ovrdflg KINP_EBSRedWarnLampSta_enum_ovrdval /end REF_CHARACTERISTIC
/end GROUP
/begin GROUP S130_EngAuxShutdownSw "SWC_INP_type/run_SWC_INP_5ms_sys/INP/CAN1/SignalCheck/EBC1/EngAuxShutdownSw"
 /begin REF_CHARACTERISTIC KINP_EngAuxShutdownSw_enum_defval KINP_EngAuxShutdownSw_enum_ovrdflg KINP_EngAuxShutdownSw_enum_ovrdval /end REF_CHARACTERISTIC
/end GROUP
/begin GROUP S130_EngDerateSw "SWC_INP_type/run_SWC_INP_5ms_sys/INP/CAN1/SignalCheck/EBC1/EngDerateSw"
 /begin REF_CHARACTERISTIC KINP_EngDerateSw_enum_defval KINP_EngDerateSw_enum_ovrdflg KINP_EngDerateSw_enum_ovrdval /end REF_CHARACTERISTIC
/end GROUP
/begin GROUP S130_EngRetSel "SWC_INP_type/run_SWC_INP_5ms_sys/INP/CAN1/SignalCheck/EBC1/EngRetSel"
 /begin REF_CHARACTERISTIC KINP_EngRetSel_pct_defval KINP_EngRetSel_pct_ovrdflg KINP_EngRetSel_pct_ovrdval /end REF_CHARACTERISTIC
/end GROUP
/begin GROUP S130_HaltBrakeSw "SWC_INP_type/run_SWC_INP_5ms_sys/INP/CAN1/SignalCheck/EBC1/HaltBrakeSw"
 /begin REF_CHARACTERISTIC KINP_HaltBrakeSw_enum_defval KINP_HaltBrakeSw_enum_ovrdflg KINP_HaltBrakeSw_enum_ovrdval /end REF_CHARACTERISTIC
/end GROUP
/begin GROUP S130_RmAccelEnSw "SWC_INP_type/run_SWC_INP_5ms_sys/INP/CAN1/SignalCheck/EBC1/RmAccelEnSw"
 /begin REF_CHARACTERISTIC KINP_RmAccelEnSw_enum_defval KINP_RmAccelEnSw_enum_ovrdflg KINP_RmAccelEnSw_enum_ovrdval /end REF_CHARACTERISTIC
/end GROUP
/begin GROUP S130_SACtrlBrakeCtrl "SWC_INP_type/run_SWC_INP_5ms_sys/INP/CAN1/SignalCheck/EBC1/SACtrlBrakeCtrl"
 /begin REF_CHARACTERISTIC KINP_SACtrlBrakeCtrl_SA_defval KINP_SACtrlBrakeCtrl_SA_ovrdflg KINP_SACtrlBrakeCtrl_SA_ovrdval /end REF_CHARACTERISTIC
/end GROUP
/begin GROUP S130_TractCtrlOvrSw "SWC_INP_type/run_SWC_INP_5ms_sys/INP/CAN1/SignalCheck/EBC1/TractCtrlOvrSw"
 /begin REF_CHARACTERISTIC KINP_TractCtrlOvrSw_enum_defval KINP_TractCtrlOvrSw_enum_ovrdflg KINP_TractCtrlOvrSw_enum_ovrdval /end REF_CHARACTERISTIC
/end GROUP
/begin GROUP S130_TrailerABSSta "SWC_INP_type/run_SWC_INP_5ms_sys/INP/CAN1/SignalCheck/EBC1/TrailerABSSta"
 /begin REF_CHARACTERISTIC KINP_TrailerABSSta_enum_defval KINP_TrailerABSSta_enum_ovrdflg KINP_TrailerABSSta_enum_ovrdval /end REF_CHARACTERISTIC
/end GROUP
/begin GROUP S130_TrailerABSWarnSig "SWC_INP_type/run_SWC_INP_5ms_sys/INP/CAN1/SignalCheck/EBC1/TrailerABSWarnSig"
 /begin REF_CHARACTERISTIC KINP_TrailerABSWarnSig_enum_defval KINP_TrailerABSWarnSig_enum_ovrdflg KINP_TrailerABSWarnSig_enum_ovrdval /end REF_CHARACTERISTIC
/end GROUP
/begin GROUP S131_FASpeed "SWC_INP_type/run_SWC_INP_5ms_sys/INP/CAN1/SignalCheck/EBC2/FASpeed"
 /begin REF_CHARACTERISTIC KINP_FASpeed_kph_defval KINP_FASpeed_kph_ovrdflg KINP_FASpeed_kph_ovrdval /end REF_CHARACTERISTIC
/end GROUP
/begin GROUP S131_RelaSpdFALWheel "SWC_INP_type/run_SWC_INP_5ms_sys/INP/CAN1/SignalCheck/EBC2/RelaSpdFALWheel"
 /begin REF_CHARACTERISTIC KINP_RelaSpdFALWheel_kph_defval KINP_RelaSpdFALWheel_kph_ovrdflg KINP_RelaSpdFALWheel_kph_ovrdval /end REF_CHARACTERISTIC
/end GROUP
/begin GROUP S131_RelaSpdFARWheel "SWC_INP_type/run_SWC_INP_5ms_sys/INP/CAN1/SignalCheck/EBC2/RelaSpdFARWheel"
 /begin REF_CHARACTERISTIC KINP_RelaSpdFARWheel_kph_defval KINP_RelaSpdFARWheel_kph_ovrdflg KINP_RelaSpdFARWheel_kph_ovrdval /end REF_CHARACTERISTIC
/end GROUP
/begin GROUP S132_BrkTempeWarn "SWC_INP_type/run_SWC_INP_5ms_sys/INP/CAN1/SignalCheck/EBC5/BrkTempeWarn"
 /begin REF_CHARACTERISTIC KINP_BrkTempeWarn_enum_defval KINP_BrkTempeWarn_enum_ovrdflg KINP_BrkTempeWarn_enum_ovrdval /end REF_CHARACTERISTIC
/end GROUP
/begin GROUP S132_FndBrkUse "SWC_INP_type/run_SWC_INP_5ms_sys/INP/CAN1/SignalCheck/EBC5/FndBrkUse"
 /begin REF_CHARACTERISTIC KINP_FndBrkUse_enum_defval KINP_FndBrkUse_enum_ovrdflg KINP_FndBrkUse_enum_ovrdval /end REF_CHARACTERISTIC
/end GROUP
/begin GROUP S132_HaltBrkMode "SWC_INP_type/run_SWC_INP_5ms_sys/INP/CAN1/SignalCheck/EBC5/HaltBrkMode"
 /begin REF_CHARACTERISTIC KINP_HaltBrkMode_enum_defval KINP_HaltBrkMode_enum_ovrdflg KINP_HaltBrkMode_enum_ovrdval /end REF_CHARACTERISTIC
/end GROUP
/begin GROUP S132_HillHolderMode "SWC_INP_type/run_SWC_INP_5ms_sys/INP/CAN1/SignalCheck/EBC5/HillHolderMode"
 /begin REF_CHARACTERISTIC KINP_HillHolderMode_enum_defval KINP_HillHolderMode_enum_ovrdflg KINP_HillHolderMode_enum_ovrdval /end REF_CHARACTERISTIC
/end GROUP
/begin GROUP S132_ParkBrkActuFAct "SWC_INP_type/run_SWC_INP_5ms_sys/INP/CAN1/SignalCheck/EBC5/ParkBrkActuFAct"
 /begin REF_CHARACTERISTIC KINP_ParkBrkActuFAct_enum_defval KINP_ParkBrkActuFAct_enum_ovrdflg KINP_ParkBrkActuFAct_enum_ovrdval /end REF_CHARACTERISTIC
/end GROUP
/begin GROUP S132_XBRAcltnLimit "SWC_INP_type/run_SWC_INP_5ms_sys/INP/CAN1/SignalCheck/EBC5/XBRAcltnLimit"
 /begin REF_CHARACTERISTIC KINP_XBRAcltnLimit_mps2_defval KINP_XBRAcltnLimit_mps2_ovrdflg KINP_XBRAcltnLimit_mps2_ovrdval /end REF_CHARACTERISTIC
/end GROUP
/begin GROUP S132_XBRActtrlMode "SWC_INP_type/run_SWC_INP_5ms_sys/INP/CAN1/SignalCheck/EBC5/XBRActtrlMode"
 /begin REF_CHARACTERISTIC KINP_XBRActtrlMode_enum_defval KINP_XBRActtrlMode_enum_ovrdflg KINP_XBRActtrlMode_enum_ovrdval /end REF_CHARACTERISTIC
/end GROUP
/begin GROUP S132_XBRSysSta "SWC_INP_type/run_SWC_INP_5ms_sys/INP/CAN1/SignalCheck/EBC5/XBRSysSta"
 /begin REF_CHARACTERISTIC KINP_XBRSysSta_enum_defval KINP_XBRSysSta_enum_ovrdflg KINP_XBRSysSta_enum_ovrdval /end REF_CHARACTERISTIC
/end GROUP
/begin GROUP S133_ECASAWarmLampSta "SWC_INP_type/run_SWC_INP_5ms_sys/INP/CAN1/SignalCheck/ECAS_DM1/ECASAWarmLampSta"
 /begin REF_CHARACTERISTIC KINP_ECASAWarmLampSta_enum_defval KINP_ECASAWarmLampSta_enum_ovrdflg KINP_ECASAWarmLampSta_enum_ovrdval /end REF_CHARACTERISTIC
/end GROUP
/begin GROUP S134_EM1CS "SWC_INP_type/run_SWC_INP_5ms_sys/INP/CAN1/SignalCheck/EMC1_EM1/EM1CS"
 /begin REF_CHARACTERISTIC KINP_EM1CS_enum_defval KINP_EM1CS_enum_ovrdflg KINP_EM1CS_enum_ovrdval /end REF_CHARACTERISTIC
/end GROUP
/begin GROUP S134_EM1Cnt "SWC_INP_type/run_SWC_INP_5ms_sys/INP/CAN1/SignalCheck/EMC1_EM1/EM1Cnt"
 /begin REF_CHARACTERISTIC KINP_EM1Cnt_enum_defval KINP_EM1Cnt_enum_ovrdflg KINP_EM1Cnt_enum_ovrdval /end REF_CHARACTERISTIC
/end GROUP
/begin GROUP S134_EM1OvrCtrlMBrk "SWC_INP_type/run_SWC_INP_5ms_sys/INP/CAN1/SignalCheck/EMC1_EM1/EM1OvrCtrlMBrk"
 /begin REF_CHARACTERISTIC KINP_EM1OvrCtrlMBrk_enum_defval KINP_EM1OvrCtrlMBrk_enum_ovrdflg KINP_EM1OvrCtrlMBrk_enum_ovrdval /end REF_CHARACTERISTIC
/end GROUP
/begin GROUP S134_EM1OvrCtrlMDriv "SWC_INP_type/run_SWC_INP_5ms_sys/INP/CAN1/SignalCheck/EMC1_EM1/EM1OvrCtrlMDriv"
 /begin REF_CHARACTERISTIC KINP_EM1OvrCtrlMDriv_enum_defval KINP_EM1OvrCtrlMDriv_enum_ovrdflg KINP_EM1OvrCtrlMDriv_enum_ovrdval /end REF_CHARACTERISTIC
/end GROUP
/begin GROUP S134_EM1OvrCtrlMPriBrk "SWC_INP_type/run_SWC_INP_5ms_sys/INP/CAN1/SignalCheck/EMC1_EM1/EM1OvrCtrlMPriBrk"
 /begin REF_CHARACTERISTIC KINP_EM1OvrCtrlMPriBrk_enum_defval KINP_EM1OvrCtrlMPriBrk_enum_ovrdflg KINP_EM1OvrCtrlMPriBrk_enum_ovrdval /end REF_CHARACTERISTIC
/end GROUP
/begin GROUP S134_EM1ReqTorqHRlsBrk "SWC_INP_type/run_SWC_INP_5ms_sys/INP/CAN1/SignalCheck/EMC1_EM1/EM1ReqTorqHRlsBrk"
 /begin REF_CHARACTERISTIC KINP_EM1ReqTorqHRlsBrk_pct_defval KINP_EM1ReqTorqHRlsBrk_pct_ovrdflg KINP_EM1ReqTorqHRlsBrk_pct_ovrdval /end REF_CHARACTERISTIC
/end GROUP
/begin GROUP S134_EM1ReqTorqHRlsDri "SWC_INP_type/run_SWC_INP_5ms_sys/INP/CAN1/SignalCheck/EMC1_EM1/EM1ReqTorqHRlsDri"
 /begin REF_CHARACTERISTIC KINP_EM1ReqTorqHRlsDri_pct_defval KINP_EM1ReqTorqHRlsDri_pct_ovrdflg KINP_EM1ReqTorqHRlsDri_pct_ovrdval /end REF_CHARACTERISTIC
/end GROUP
/begin GROUP S134_EM1ReqTorqLimBrk "SWC_INP_type/run_SWC_INP_5ms_sys/INP/CAN1/SignalCheck/EMC1_EM1/EM1ReqTorqLimBrk"
 /begin REF_CHARACTERISTIC KINP_EM1ReqTorqLimBrk_pct_defval KINP_EM1ReqTorqLimBrk_pct_ovrdflg KINP_EM1ReqTorqLimBrk_pct_ovrdval /end REF_CHARACTERISTIC
/end GROUP
/begin GROUP S134_EM1ReqTorqLimDriv "SWC_INP_type/run_SWC_INP_5ms_sys/INP/CAN1/SignalCheck/EMC1_EM1/EM1ReqTorqLimDriv"
 /begin REF_CHARACTERISTIC KINP_EM1ReqTorqLimDriv_pct_defval KINP_EM1ReqTorqLimDriv_pct_ovrdflg KINP_EM1ReqTorqLimDriv_pct_ovrdval /end REF_CHARACTERISTIC
/end GROUP
/begin GROUP S135_WhlSpeedFL "SWC_INP_type/run_SWC_INP_5ms_sys/INP/CAN1/SignalCheck/HRW/WhlSpeedFL"
 /begin REF_CHARACTERISTIC KINP_WhlSpeedFL_kph_defval KINP_WhlSpeedFL_kph_ovrdflg KINP_WhlSpeedFL_kph_ovrdval /end REF_CHARACTERISTIC
/end GROUP
/begin GROUP S136_DrivDirF "SWC_INP_type/run_SWC_INP_5ms_sys/INP/CAN1/SignalCheck/TC1/DrivDirF"
 /begin REF_CHARACTERISTIC KINP_DrivDirF_enum_defval KINP_DrivDirF_enum_ovrdflg KINP_DrivDirF_enum_ovrdval /end REF_CHARACTERISTIC
/end GROUP
/begin GROUP S136_TransReqGear "SWC_INP_type/run_SWC_INP_5ms_sys/INP/CAN1/SignalCheck/TC1/TransReqGear"
 /begin REF_CHARACTERISTIC KINP_TransReqGear_enum_defval KINP_TransReqGear_enum_ovrdflg KINP_TransReqGear_enum_ovrdval /end REF_CHARACTERISTIC
/end GROUP
/begin GROUP S399_IVIACFanSpdReqCmd "SWC_INP_type/run_SWC_INP_5ms_sys/INP/CAN2/SignalCheck/IVI_C100_0/IVIACFanSpdReqCmd"
 /begin REF_CHARACTERISTIC KINP_IVIACFanSpdReqCmd_enum_defval KINP_IVIACFanSpdReqCmd_enum_ovrdflg KINP_IVIACFanSpdReqCmd_enum_ovrdval /end REF_CHARACTERISTIC
/end GROUP
/begin GROUP S456_B2THVRlySta "SWC_INP_type/run_SWC_INP_5ms_sys/INP/CAN3/SignalCheck/B2TM_Info/B2THVRlySta"
 /begin REF_CHARACTERISTIC KINP_B2THVRlySta_enum_defval KINP_B2THVRlySta_enum_ovrdflg KINP_B2THVRlySta_enum_ovrdval /end REF_CHARACTERISTIC
/end GROUP
/begin GROUP S457_B2VBI1BattType "SWC_INP_type/run_SWC_INP_5ms_sys/INP/CAN3/SignalCheck/B2V_BattInfo1/B2VBI1BattType"
 /begin REF_CHARACTERISTIC KINP_B2VBI1BattType_enum_defval KINP_B2VBI1BattType_enum_ovrdflg KINP_B2VBI1BattType_enum_ovrdval /end REF_CHARACTERISTIC
/end GROUP
/begin GROUP S458_B2VAPlsDischgCurr "SWC_INP_type/run_SWC_INP_5ms_sys/INP/CAN3/SignalCheck/B2V_CurrentLimit/B2VAPlsDischgCurr"
 /begin REF_CHARACTERISTIC KINP_B2VAPlsDischgCurr_A_defval KINP_B2VAPlsDischgCurr_A_ovrdflg KINP_B2VAPlsDischgCurr_A_ovrdval /end REF_CHARACTERISTIC
/end GROUP
/begin GROUP S458_B2VAvaPlsChgCurr "SWC_INP_type/run_SWC_INP_5ms_sys/INP/CAN3/SignalCheck/B2V_CurrentLimit/B2VAvaPlsChgCurr"
 /begin REF_CHARACTERISTIC KINP_B2VAvaPlsChgCurr_A_defval KINP_B2VAvaPlsChgCurr_A_ovrdflg KINP_B2VAvaPlsChgCurr_A_ovrdval /end REF_CHARACTERISTIC
/end GROUP
/begin GROUP S459_B2VHVILFault "SWC_INP_type/run_SWC_INP_5ms_sys/INP/CAN3/SignalCheck/B2V_Fult1_32960/B2VHVILFault"
 /begin REF_CHARACTERISTIC KINP_B2VHVILFault_flg_defval KINP_B2VHVILFault_flg_ovrdflg KINP_B2VHVILFault_flg_ovrdval /end REF_CHARACTERISTIC
/end GROUP
/begin GROUP S460_B2VACChgConnSta "SWC_INP_type/run_SWC_INP_5ms_sys/INP/CAN3/SignalCheck/B2V_ST1/B2VACChgConnSta"
 /begin REF_CHARACTERISTIC KINP_B2VACChgConnSta_flg_defval KINP_B2VACChgConnSta_flg_ovrdflg KINP_B2VACChgConnSta_flg_ovrdval /end REF_CHARACTERISTIC
/end GROUP
/begin GROUP S460_B2VACChgNegRlySta "SWC_INP_type/run_SWC_INP_5ms_sys/INP/CAN3/SignalCheck/B2V_ST1/B2VACChgNegRlySta"
 /begin REF_CHARACTERISTIC KINP_B2VACChgNegRlySta_enum_defval KINP_B2VACChgNegRlySta_enum_ovrdflg KINP_B2VACChgNegRlySta_enum_ovrdval /end REF_CHARACTERISTIC
/end GROUP
/begin GROUP S460_B2VACChgPosRlySta "SWC_INP_type/run_SWC_INP_5ms_sys/INP/CAN3/SignalCheck/B2V_ST1/B2VACChgPosRlySta"
 /begin REF_CHARACTERISTIC KINP_B2VACChgPosRlySta_enum_defval KINP_B2VACChgPosRlySta_enum_ovrdflg KINP_B2VACChgPosRlySta_enum_ovrdval /end REF_CHARACTERISTIC
/end GROUP
/begin GROUP S460_B2VBMUHVSta "SWC_INP_type/run_SWC_INP_5ms_sys/INP/CAN3/SignalCheck/B2V_ST1/B2VBMUHVSta"
 /begin REF_CHARACTERISTIC KINP_B2VBMUHVSta_enum_defval KINP_B2VBMUHVSta_enum_ovrdflg KINP_B2VBMUHVSta_enum_ovrdval /end REF_CHARACTERISTIC
/end GROUP
/begin GROUP S460_B2VChgMode "SWC_INP_type/run_SWC_INP_5ms_sys/INP/CAN3/SignalCheck/B2V_ST1/B2VChgMode"
 /begin REF_CHARACTERISTIC KINP_B2VChgMode_enum_defval KINP_B2VChgMode_enum_ovrdflg KINP_B2VChgMode_enum_ovrdval /end REF_CHARACTERISTIC
/end GROUP
/begin GROUP S460_B2VChgSta "SWC_INP_type/run_SWC_INP_5ms_sys/INP/CAN3/SignalCheck/B2V_ST1/B2VChgSta"
 /begin REF_CHARACTERISTIC KINP_B2VChgSta_enum_defval KINP_B2VChgSta_enum_ovrdflg KINP_B2VChgSta_enum_ovrdval /end REF_CHARACTERISTIC
/end GROUP
/begin GROUP S460_B2VDCChgConnSta "SWC_INP_type/run_SWC_INP_5ms_sys/INP/CAN3/SignalCheck/B2V_ST1/B2VDCChgConnSta"
 /begin REF_CHARACTERISTIC KINP_B2VDCChgConnSta_enum_defval KINP_B2VDCChgConnSta_enum_ovrdflg KINP_B2VDCChgConnSta_enum_ovrdval /end REF_CHARACTERISTIC
/end GROUP
/begin GROUP S460_B2VDCChgN1RlySta "SWC_INP_type/run_SWC_INP_5ms_sys/INP/CAN3/SignalCheck/B2V_ST1/B2VDCChgN1RlySta"
 /begin REF_CHARACTERISTIC KINP_B2VDCChgN1RlySta_enum_defval KINP_B2VDCChgN1RlySta_enum_ovrdflg KINP_B2VDCChgN1RlySta_enum_ovrdval /end REF_CHARACTERISTIC
/end GROUP
/begin GROUP S460_B2VDCChgP1RlySta "SWC_INP_type/run_SWC_INP_5ms_sys/INP/CAN3/SignalCheck/B2V_ST1/B2VDCChgP1RlySta"
 /begin REF_CHARACTERISTIC KINP_B2VDCChgP1RlySta_enum_defval KINP_B2VDCChgP1RlySta_enum_ovrdflg KINP_B2VDCChgP1RlySta_enum_ovrdval /end REF_CHARACTERISTIC
/end GROUP
/begin GROUP S460_B2VMainNegRlySta "SWC_INP_type/run_SWC_INP_5ms_sys/INP/CAN3/SignalCheck/B2V_ST1/B2VMainNegRlySta"
 /begin REF_CHARACTERISTIC KINP_B2VMainNegRlySta_enum_defval KINP_B2VMainNegRlySta_enum_ovrdflg KINP_B2VMainNegRlySta_enum_ovrdval /end REF_CHARACTERISTIC
/end GROUP
/begin GROUP S461_B2VFaultCode "SWC_INP_type/run_SWC_INP_5ms_sys/INP/CAN3/SignalCheck/B2V_ST2/B2VFaultCode"
 /begin REF_CHARACTERISTIC KINP_B2VFaultCode_enum_defval KINP_B2VFaultCode_enum_ovrdflg KINP_B2VFaultCode_enum_ovrdval /end REF_CHARACTERISTIC
/end GROUP
/begin GROUP S461_B2VFaultLv "SWC_INP_type/run_SWC_INP_5ms_sys/INP/CAN3/SignalCheck/B2V_ST2/B2VFaultLv"
 /begin REF_CHARACTERISTIC KINP_B2VFaultLv_enum_defval KINP_B2VFaultLv_enum_ovrdflg KINP_B2VFaultLv_enum_ovrdval /end REF_CHARACTERISTIC
/end GROUP
/begin GROUP S461_B2VPackCurr "SWC_INP_type/run_SWC_INP_5ms_sys/INP/CAN3/SignalCheck/B2V_ST2/B2VPackCurr"
 /begin REF_CHARACTERISTIC KINP_B2VPackCurr_A_defval KINP_B2VPackCurr_A_ovrdflg KINP_B2VPackCurr_A_ovrdval /end REF_CHARACTERISTIC
/end GROUP
/begin GROUP S461_B2VPackInsideVol "SWC_INP_type/run_SWC_INP_5ms_sys/INP/CAN3/SignalCheck/B2V_ST2/B2VPackInsideVol"
 /begin REF_CHARACTERISTIC KINP_B2VPackInsideVol_V_defval KINP_B2VPackInsideVol_V_ovrdflg KINP_B2VPackInsideVol_V_ovrdval /end REF_CHARACTERISTIC
/end GROUP
/begin GROUP S461_B2VRqHVPwrOff "SWC_INP_type/run_SWC_INP_5ms_sys/INP/CAN3/SignalCheck/B2V_ST2/B2VRqHVPwrOff"
 /begin REF_CHARACTERISTIC KINP_B2VRqHVPwrOff_enum_defval KINP_B2VRqHVPwrOff_enum_ovrdflg KINP_B2VRqHVPwrOff_enum_ovrdval /end REF_CHARACTERISTIC
/end GROUP
/begin GROUP S461_B2VSOC "SWC_INP_type/run_SWC_INP_5ms_sys/INP/CAN3/SignalCheck/B2V_ST2/B2VSOC"
 /begin REF_CHARACTERISTIC KINP_B2VSOC_pct_defval KINP_B2VSOC_pct_ovrdflg KINP_B2VSOC_pct_ovrdval /end REF_CHARACTERISTIC
/end GROUP
/begin GROUP S462_B2VMinTempPos "SWC_INP_type/run_SWC_INP_5ms_sys/INP/CAN3/SignalCheck/B2V_ST4/B2VMinTempPos"
 /begin REF_CHARACTERISTIC KINP_B2VMinTempPos_enum_defval KINP_B2VMinTempPos_enum_ovrdflg KINP_B2VMinTempPos_enum_ovrdval /end REF_CHARACTERISTIC
/end GROUP
/begin GROUP S463_B2VCellMinVol "SWC_INP_type/run_SWC_INP_5ms_sys/INP/CAN3/SignalCheck/B2V_ST5/B2VCellMinVol"
 /begin REF_CHARACTERISTIC KINP_B2VCellMinVol_V_defval KINP_B2VCellMinVol_V_ovrdflg KINP_B2VCellMinVol_V_ovrdval /end REF_CHARACTERISTIC
/end GROUP
/begin GROUP S464_EWPPEFault "SWC_INP_type/run_SWC_INP_5ms_sys/INP/CAN3/SignalCheck/EWP1/EWPPEFault"
 /begin REF_CHARACTERISTIC KINP_EWPPEFault_enum_defval KINP_EWPPEFault_enum_ovrdflg KINP_EWPPEFault_enum_ovrdval /end REF_CHARACTERISTIC
/end GROUP
/begin GROUP S465_AtvDisChgEnFbk "SWC_INP_type/run_SWC_INP_5ms_sys/INP/CAN3/SignalCheck/TM_MCUSta1/AtvDisChgEnFbk"
 /begin REF_CHARACTERISTIC KINP_AtvDisChgEnFbk_flg_defval KINP_AtvDisChgEnFbk_flg_ovrdflg KINP_AtvDisChgEnFbk_flg_ovrdval /end REF_CHARACTERISTIC
/end GROUP
/begin GROUP S465_MCUCtrlMdSta "SWC_INP_type/run_SWC_INP_5ms_sys/INP/CAN3/SignalCheck/TM_MCUSta1/MCUCtrlMdSta"
 /begin REF_CHARACTERISTIC KINP_MCUCtrlMdSta_enum_defval KINP_MCUCtrlMdSta_enum_ovrdflg KINP_MCUCtrlMdSta_enum_ovrdval /end REF_CHARACTERISTIC
/end GROUP
/begin GROUP S465_MCUIGBTEnFbk "SWC_INP_type/run_SWC_INP_5ms_sys/INP/CAN3/SignalCheck/TM_MCUSta1/MCUIGBTEnFbk"
 /begin REF_CHARACTERISTIC KINP_MCUIGBTEnFbk_flg_defval KINP_MCUIGBTEnFbk_flg_ovrdflg KINP_MCUIGBTEnFbk_flg_ovrdval /end REF_CHARACTERISTIC
/end GROUP
/begin GROUP S465_MotorSpd "SWC_INP_type/run_SWC_INP_5ms_sys/INP/CAN3/SignalCheck/TM_MCUSta1/MotorSpd"
 /begin REF_CHARACTERISTIC KINP_MotorSpd_rpm_defval KINP_MotorSpd_rpm_ovrdflg KINP_MotorSpd_rpm_ovrdval /end REF_CHARACTERISTIC
/end GROUP
/begin GROUP S465_MotorTrq "SWC_INP_type/run_SWC_INP_5ms_sys/INP/CAN3/SignalCheck/TM_MCUSta1/MotorTrq"
 /begin REF_CHARACTERISTIC KINP_MotorTrq_Nm_defval KINP_MotorTrq_Nm_ovrdflg KINP_MotorTrq_Nm_ovrdval /end REF_CHARACTERISTIC
/end GROUP
/begin GROUP S466_MCUFailGrade "SWC_INP_type/run_SWC_INP_5ms_sys/INP/CAN3/SignalCheck/TM_MCUSta2/MCUFailGrade"
 /begin REF_CHARACTERISTIC KINP_MCUFailGrade_enum_defval KINP_MCUFailGrade_enum_ovrdflg KINP_MCUFailGrade_enum_ovrdval /end REF_CHARACTERISTIC
/end GROUP
/begin GROUP S466_MCUTemp "SWC_INP_type/run_SWC_INP_5ms_sys/INP/CAN3/SignalCheck/TM_MCUSta2/MCUTemp"
 /begin REF_CHARACTERISTIC KINP_MCUTemp_C_defval KINP_MCUTemp_C_ovrdflg KINP_MCUTemp_C_ovrdval /end REF_CHARACTERISTIC
/end GROUP
/begin GROUP S466_MCUTrqLimHi "SWC_INP_type/run_SWC_INP_5ms_sys/INP/CAN3/SignalCheck/TM_MCUSta2/MCUTrqLimHi"
 /begin REF_CHARACTERISTIC KINP_MCUTrqLimHi_Nm_defval KINP_MCUTrqLimHi_Nm_ovrdflg KINP_MCUTrqLimHi_Nm_ovrdval /end REF_CHARACTERISTIC
/end GROUP
/begin GROUP S466_MCUTrqLimLo "SWC_INP_type/run_SWC_INP_5ms_sys/INP/CAN3/SignalCheck/TM_MCUSta2/MCUTrqLimLo"
 /begin REF_CHARACTERISTIC KINP_MCUTrqLimLo_Nm_defval KINP_MCUTrqLimLo_Nm_ovrdflg KINP_MCUTrqLimLo_Nm_ovrdval /end REF_CHARACTERISTIC
/end GROUP
/begin GROUP S466_MotorTemp "SWC_INP_type/run_SWC_INP_5ms_sys/INP/CAN3/SignalCheck/TM_MCUSta2/MotorTemp"
 /begin REF_CHARACTERISTIC KINP_MotorTemp_C_defval KINP_MotorTemp_C_ovrdflg KINP_MotorTemp_C_ovrdval /end REF_CHARACTERISTIC
/end GROUP
/begin GROUP S467_MCUDCCur "SWC_INP_type/run_SWC_INP_5ms_sys/INP/CAN3/SignalCheck/TM_MCUSta3/MCUDCCur"
 /begin REF_CHARACTERISTIC KINP_MCUDCCur_A_defval KINP_MCUDCCur_A_ovrdflg KINP_MCUDCCur_A_ovrdval /end REF_CHARACTERISTIC
/end GROUP
/begin GROUP S467_MCUDCVol "SWC_INP_type/run_SWC_INP_5ms_sys/INP/CAN3/SignalCheck/TM_MCUSta3/MCUDCVol"
 /begin REF_CHARACTERISTIC KINP_MCUDCVol_V_defval KINP_MCUDCVol_V_ovrdflg KINP_MCUDCVol_V_ovrdval /end REF_CHARACTERISTIC
/end GROUP
/begin GROUP S467_MCUFailCode "SWC_INP_type/run_SWC_INP_5ms_sys/INP/CAN3/SignalCheck/TM_MCUSta3/MCUFailCode"
 /begin REF_CHARACTERISTIC KINP_MCUFailCode_enum_defval KINP_MCUFailCode_enum_ovrdflg KINP_MCUFailCode_enum_ovrdval /end REF_CHARACTERISTIC
/end GROUP
/begin GROUP S676_ParkBrakeSW "SWC_INP_type/run_SWC_INP_5ms_sys/INP/CAN4/SignalCheck/ZFR_C100_0/ParkBrakeSW"
 /begin REF_CHARACTERISTIC KINP_ParkBrakeSW_enum_defval KINP_ParkBrakeSW_enum_ovrdflg KINP_ParkBrakeSW_enum_ovrdval /end REF_CHARACTERISTIC
/end GROUP
/begin GROUP S677_AirPressureFC2 "SWC_INP_type/run_SWC_INP_5ms_sys/INP/CAN4/SignalCheck/ZFR_CE100_0/AirPressureFC2"
 /begin REF_CHARACTERISTIC KINP_AirPressureFC2_kPa_defval KINP_AirPressureFC2_kPa_ovrdflg KINP_AirPressureFC2_kPa_ovrdval /end REF_CHARACTERISTIC
/end GROUP
/begin GROUP S677_ZFRBCMAutoLightSWSta "SWC_INP_type/run_SWC_INP_5ms_sys/INP/CAN4/SignalCheck/ZFR_CE100_0/ZFRBCMAutoLightSWSta"
 /begin REF_CHARACTERISTIC KINP_ZFRBCMAutoLightSWSta_flg_defval KINP_ZFRBCMAutoLightSWSta_flg_ovrdflg KINP_ZFRBCMAutoLightSWSta_flg_ovrdval /end REF_CHARACTERISTIC
/end GROUP
/begin GROUP S677_ZFRBCMBrakeSta "SWC_INP_type/run_SWC_INP_5ms_sys/INP/CAN4/SignalCheck/ZFR_CE100_0/ZFRBCMBrakeSta"
 /begin REF_CHARACTERISTIC KINP_ZFRBCMBrakeSta_flg_defval KINP_ZFRBCMBrakeSta_flg_ovrdflg KINP_ZFRBCMBrakeSta_flg_ovrdval /end REF_CHARACTERISTIC
/end GROUP
/begin GROUP S677_ZFRBCMHBeamSWSta "SWC_INP_type/run_SWC_INP_5ms_sys/INP/CAN4/SignalCheck/ZFR_CE100_0/ZFRBCMHBeamSWSta"
 /begin REF_CHARACTERISTIC KINP_ZFRBCMHBeamSWSta_flg_defval KINP_ZFRBCMHBeamSWSta_flg_ovrdflg KINP_ZFRBCMHBeamSWSta_flg_ovrdval /end REF_CHARACTERISTIC
/end GROUP
/begin GROUP S677_ZFRBCMHeadLpSWSta "SWC_INP_type/run_SWC_INP_5ms_sys/INP/CAN4/SignalCheck/ZFR_CE100_0/ZFRBCMHeadLpSWSta"
 /begin REF_CHARACTERISTIC KINP_ZFRBCMHeadLpSWSta_flg_defval KINP_ZFRBCMHeadLpSWSta_flg_ovrdflg KINP_ZFRBCMHeadLpSWSta_flg_ovrdval /end REF_CHARACTERISTIC
/end GROUP
/begin GROUP S677_ZFRBCMLFTurnLpCSta "SWC_INP_type/run_SWC_INP_5ms_sys/INP/CAN4/SignalCheck/ZFR_CE100_0/ZFRBCMLFTurnLpCSta"
 /begin REF_CHARACTERISTIC KINP_ZFRBCMLFTurnLpCSta_A_defval KINP_ZFRBCMLFTurnLpCSta_A_ovrdflg KINP_ZFRBCMLFTurnLpCSta_A_ovrdval /end REF_CHARACTERISTIC
/end GROUP
/begin GROUP S677_ZFRBCMLightSensorVSta "SWC_INP_type/run_SWC_INP_5ms_sys/INP/CAN4/SignalCheck/ZFR_CE100_0/ZFRBCMLightSensorVSta"
 /begin REF_CHARACTERISTIC KINP_ZFRBCMLightSensorVSta_V_defval KINP_ZFRBCMLightSensorVSta_V_ovrdflg KINP_ZFRBCMLightSensorVSta_V_ovrdval /end REF_CHARACTERISTIC
/end GROUP
/begin GROUP S677_ZFRBCMPLampSta "SWC_INP_type/run_SWC_INP_5ms_sys/INP/CAN4/SignalCheck/ZFR_CE100_0/ZFRBCMPLampSta"
 /begin REF_CHARACTERISTIC KINP_ZFRBCMPLampSta_flg_defval KINP_ZFRBCMPLampSta_flg_ovrdflg KINP_ZFRBCMPLampSta_flg_ovrdval /end REF_CHARACTERISTIC
/end GROUP
/begin GROUP S677_ZFRBCMRFTurnLpCSta "SWC_INP_type/run_SWC_INP_5ms_sys/INP/CAN4/SignalCheck/ZFR_CE100_0/ZFRBCMRFTurnLpCSta"
 /begin REF_CHARACTERISTIC KINP_ZFRBCMRFTurnLpCSta_A_defval KINP_ZFRBCMRFTurnLpCSta_A_ovrdflg KINP_ZFRBCMRFTurnLpCSta_A_ovrdval /end REF_CHARACTERISTIC
/end GROUP
/begin GROUP S677_ZFRBCMRFogLpSWSta "SWC_INP_type/run_SWC_INP_5ms_sys/INP/CAN4/SignalCheck/ZFR_CE100_0/ZFRBCMRFogLpSWSta"
 /begin REF_CHARACTERISTIC KINP_ZFRBCMRFogLpSWSta_flg_defval KINP_ZFRBCMRFogLpSWSta_flg_ovrdflg KINP_ZFRBCMRFogLpSWSta_flg_ovrdval /end REF_CHARACTERISTIC
/end GROUP
/begin GROUP S677_ZFRBCMSeatbeltSta "SWC_INP_type/run_SWC_INP_5ms_sys/INP/CAN4/SignalCheck/ZFR_CE100_0/ZFRBCMSeatbeltSta"
 /begin REF_CHARACTERISTIC KINP_ZFRBCMSeatbeltSta_flg_defval KINP_ZFRBCMSeatbeltSta_flg_ovrdflg KINP_ZFRBCMSeatbeltSta_flg_ovrdval /end REF_CHARACTERISTIC
/end GROUP
/begin GROUP S677_ZFRBCMWasherSWSta "SWC_INP_type/run_SWC_INP_5ms_sys/INP/CAN4/SignalCheck/ZFR_CE100_0/ZFRBCMWasherSWSta"
 /begin REF_CHARACTERISTIC KINP_ZFRBCMWasherSWSta_flg_defval KINP_ZFRBCMWasherSWSta_flg_ovrdflg KINP_ZFRBCMWasherSWSta_flg_ovrdval /end REF_CHARACTERISTIC
/end GROUP
/begin GROUP S677_ZFRBCMWiperASSta "SWC_INP_type/run_SWC_INP_5ms_sys/INP/CAN4/SignalCheck/ZFR_CE100_0/ZFRBCMWiperASSta"
 /begin REF_CHARACTERISTIC KINP_ZFRBCMWiperASSta_flg_defval KINP_ZFRBCMWiperASSta_flg_ovrdflg KINP_ZFRBCMWiperASSta_flg_ovrdval /end REF_CHARACTERISTIC
/end GROUP
/begin GROUP S677_ZFRBCMWiperHSWSta "SWC_INP_type/run_SWC_INP_5ms_sys/INP/CAN4/SignalCheck/ZFR_CE100_0/ZFRBCMWiperHSWSta"
 /begin REF_CHARACTERISTIC KINP_ZFRBCMWiperHSWSta_flg_defval KINP_ZFRBCMWiperHSWSta_flg_ovrdflg KINP_ZFRBCMWiperHSWSta_flg_ovrdval /end REF_CHARACTERISTIC
/end GROUP
/begin GROUP S677_ZFRBCMWiperLSWSta "SWC_INP_type/run_SWC_INP_5ms_sys/INP/CAN4/SignalCheck/ZFR_CE100_0/ZFRBCMWiperLSWSta"
 /begin REF_CHARACTERISTIC KINP_ZFRBCMWiperLSWSta_flg_defval KINP_ZFRBCMWiperLSWSta_flg_ovrdflg KINP_ZFRBCMWiperLSWSta_flg_ovrdval /end REF_CHARACTERISTIC
/end GROUP
/begin GROUP S678_ZRRBCMAllDoorSta "SWC_INP_type/run_SWC_INP_5ms_sys/INP/CAN4/SignalCheck/ZRR_CE100_0/ZRRBCMAllDoorSta"
 /begin REF_CHARACTERISTIC KINP_ZRRBCMAllDoorSta_enum_defval KINP_ZRRBCMAllDoorSta_enum_ovrdflg KINP_ZRRBCMAllDoorSta_enum_ovrdval /end REF_CHARACTERISTIC
/end GROUP
/begin GROUP S679_AirPressurePC3 "SWC_INP_type/run_SWC_INP_5ms_sys/INP/CAN4/SignalCheck/ZRR_CE100_1/AirPressurePC3"
 /begin REF_CHARACTERISTIC KINP_AirPressurePC3_kPa_defval KINP_AirPressurePC3_kPa_ovrdflg KINP_AirPressurePC3_kPa_ovrdval /end REF_CHARACTERISTIC
/end GROUP
/begin GROUP S679_AirPressureRC1 "SWC_INP_type/run_SWC_INP_5ms_sys/INP/CAN4/SignalCheck/ZRR_CE100_1/AirPressureRC1"
 /begin REF_CHARACTERISTIC KINP_AirPressureRC1_kPa_defval KINP_AirPressureRC1_kPa_ovrdflg KINP_AirPressureRC1_kPa_ovrdval /end REF_CHARACTERISTIC
/end GROUP
/begin GROUP S679_FDCCHASSISVCUEACPressSta "SWC_INP_type/run_SWC_INP_5ms_sys/INP/CAN4/SignalCheck/ZRR_CE100_1/FDCCHASSISVCUEACPressSta"
 /begin REF_CHARACTERISTIC KINP_FDCCHASSISVCUEACPressSta_flg_defval KINP_FDCCHASSISVCUEACPressSta_flg_ovrdflg KINP_FDCCHASSISVCUEACPressSta_flg_ovrdval /end REF_CHARACTERISTIC
/end GROUP
/begin GROUP S679_ZRRBCMCallingSWSta "SWC_INP_type/run_SWC_INP_5ms_sys/INP/CAN4/SignalCheck/ZRR_CE100_1/ZRRBCMCallingSWSta"
 /begin REF_CHARACTERISTIC KINP_ZRRBCMCallingSWSta_flg_defval KINP_ZRRBCMCallingSWSta_flg_ovrdflg KINP_ZRRBCMCallingSWSta_flg_ovrdval /end REF_CHARACTERISTIC
/end GROUP
/begin GROUP S679_ZRRBCMLRTurnLpCSta "SWC_INP_type/run_SWC_INP_5ms_sys/INP/CAN4/SignalCheck/ZRR_CE100_1/ZRRBCMLRTurnLpCSta"
 /begin REF_CHARACTERISTIC KINP_ZRRBCMLRTurnLpCSta_A_defval KINP_ZRRBCMLRTurnLpCSta_A_ovrdflg KINP_ZRRBCMLRTurnLpCSta_A_ovrdval /end REF_CHARACTERISTIC
/end GROUP
/begin GROUP S679_ZRRBCMPLampSta "SWC_INP_type/run_SWC_INP_5ms_sys/INP/CAN4/SignalCheck/ZRR_CE100_1/ZRRBCMPLampSta"
 /begin REF_CHARACTERISTIC KINP_ZRRBCMPLampSta_flg_defval KINP_ZRRBCMPLampSta_flg_ovrdflg KINP_ZRRBCMPLampSta_flg_ovrdval /end REF_CHARACTERISTIC
/end GROUP
/begin GROUP S679_ZRRBCMRRTurnLpCSta "SWC_INP_type/run_SWC_INP_5ms_sys/INP/CAN4/SignalCheck/ZRR_CE100_1/ZRRBCMRRTurnLpCSta"
 /begin REF_CHARACTERISTIC KINP_ZRRBCMRRTurnLpCSta_A_defval KINP_ZRRBCMRRTurnLpCSta_A_ovrdflg KINP_ZRRBCMRRTurnLpCSta_A_ovrdval /end REF_CHARACTERISTIC
/end GROUP
/begin GROUP S679_ZRRBCMSTOPSW2Sta "SWC_INP_type/run_SWC_INP_5ms_sys/INP/CAN4/SignalCheck/ZRR_CE100_1/ZRRBCMSTOPSW2Sta"
 /begin REF_CHARACTERISTIC KINP_ZRRBCMSTOPSW2Sta_flg_defval KINP_ZRRBCMSTOPSW2Sta_flg_ovrdflg KINP_ZRRBCMSTOPSW2Sta_flg_ovrdval /end REF_CHARACTERISTIC
/end GROUP
/begin GROUP S679_ZRRBCMSTOPSWSta "SWC_INP_type/run_SWC_INP_5ms_sys/INP/CAN4/SignalCheck/ZRR_CE100_1/ZRRBCMSTOPSWSta"
 /begin REF_CHARACTERISTIC KINP_ZRRBCMSTOPSWSta_flg_defval KINP_ZRRBCMSTOPSWSta_flg_ovrdflg KINP_ZRRBCMSTOPSWSta_flg_ovrdval /end REF_CHARACTERISTIC
/end GROUP
/begin GROUP S680_DCDCEnSta "SWC_INP_type/run_SWC_INP_5ms_sys/INP/CAN4/SignalCheck/zGW_CANRr1_C50_0/DCDCEnSta"
 /begin REF_CHARACTERISTIC KINP_DCDCEnSta_enum_defval KINP_DCDCEnSta_enum_ovrdflg KINP_DCDCEnSta_enum_ovrdval /end REF_CHARACTERISTIC
/end GROUP
/begin GROUP S680_DCDCErrLvSta "SWC_INP_type/run_SWC_INP_5ms_sys/INP/CAN4/SignalCheck/zGW_CANRr1_C50_0/DCDCErrLvSta"
 /begin REF_CHARACTERISTIC KINP_DCDCErrLvSta_enum_defval KINP_DCDCErrLvSta_enum_ovrdflg KINP_DCDCErrLvSta_enum_ovrdval /end REF_CHARACTERISTIC
/end GROUP
/begin GROUP S680_DCDCOutVolSta "SWC_INP_type/run_SWC_INP_5ms_sys/INP/CAN4/SignalCheck/zGW_CANRr1_C50_0/DCDCOutVolSta"
 /begin REF_CHARACTERISTIC KINP_DCDCOutVolSta_V_defval KINP_DCDCOutVolSta_V_ovrdflg KINP_DCDCOutVolSta_V_ovrdval /end REF_CHARACTERISTIC
/end GROUP
/begin GROUP S680_DCDCTempSta "SWC_INP_type/run_SWC_INP_5ms_sys/INP/CAN4/SignalCheck/zGW_CANRr1_C50_0/DCDCTempSta"
 /begin REF_CHARACTERISTIC KINP_DCDCTempSta_C_defval KINP_DCDCTempSta_C_ovrdflg KINP_DCDCTempSta_C_ovrdval /end REF_CHARACTERISTIC
/end GROUP
/begin GROUP S680_EACEnSta "SWC_INP_type/run_SWC_INP_5ms_sys/INP/CAN4/SignalCheck/zGW_CANRr1_C50_0/EACEnSta"
 /begin REF_CHARACTERISTIC KINP_EACEnSta_enum_defval KINP_EACEnSta_enum_ovrdflg KINP_EACEnSta_enum_ovrdval /end REF_CHARACTERISTIC
/end GROUP
/begin GROUP S680_EACErrLvSta "SWC_INP_type/run_SWC_INP_5ms_sys/INP/CAN4/SignalCheck/zGW_CANRr1_C50_0/EACErrLvSta"
 /begin REF_CHARACTERISTIC KINP_EACErrLvSta_enum_defval KINP_EACErrLvSta_enum_ovrdflg KINP_EACErrLvSta_enum_ovrdval /end REF_CHARACTERISTIC
/end GROUP
/begin GROUP S680_EACInvTempSta "SWC_INP_type/run_SWC_INP_5ms_sys/INP/CAN4/SignalCheck/zGW_CANRr1_C50_0/EACInvTempSta"
 /begin REF_CHARACTERISTIC KINP_EACInvTempSta_C_defval KINP_EACInvTempSta_C_ovrdflg KINP_EACInvTempSta_C_ovrdval /end REF_CHARACTERISTIC
/end GROUP
/begin GROUP S680_EHPSEnSta "SWC_INP_type/run_SWC_INP_5ms_sys/INP/CAN4/SignalCheck/zGW_CANRr1_C50_0/EHPSEnSta"
 /begin REF_CHARACTERISTIC KINP_EHPSEnSta_enum_defval KINP_EHPSEnSta_enum_ovrdflg KINP_EHPSEnSta_enum_ovrdval /end REF_CHARACTERISTIC
/end GROUP
/begin GROUP S680_EHPSErrLvSta "SWC_INP_type/run_SWC_INP_5ms_sys/INP/CAN4/SignalCheck/zGW_CANRr1_C50_0/EHPSErrLvSta"
 /begin REF_CHARACTERISTIC KINP_EHPSErrLvSta_enum_defval KINP_EHPSErrLvSta_enum_ovrdflg KINP_EHPSErrLvSta_enum_ovrdval /end REF_CHARACTERISTIC
/end GROUP
/begin GROUP S680_EHPSInvTempSta "SWC_INP_type/run_SWC_INP_5ms_sys/INP/CAN4/SignalCheck/zGW_CANRr1_C50_0/EHPSInvTempSta"
 /begin REF_CHARACTERISTIC KINP_EHPSInvTempSta_C_defval KINP_EHPSInvTempSta_C_ovrdflg KINP_EHPSInvTempSta_C_ovrdval /end REF_CHARACTERISTIC
/end GROUP
/begin GROUP S680_EHPSMotorSpdSta "SWC_INP_type/run_SWC_INP_5ms_sys/INP/CAN4/SignalCheck/zGW_CANRr1_C50_0/EHPSMotorSpdSta"
 /begin REF_CHARACTERISTIC KINP_EHPSMotorSpdSta_rpm_defval KINP_EHPSMotorSpdSta_rpm_ovrdflg KINP_EHPSMotorSpdSta_rpm_ovrdval /end REF_CHARACTERISTIC
/end GROUP
/begin GROUP S680_PDUACRlySta "SWC_INP_type/run_SWC_INP_5ms_sys/INP/CAN4/SignalCheck/zGW_CANRr1_C50_0/PDUACRlySta"
 /begin REF_CHARACTERISTIC KINP_PDUACRlySta_enum_defval KINP_PDUACRlySta_enum_ovrdflg KINP_PDUACRlySta_enum_ovrdval /end REF_CHARACTERISTIC
/end GROUP
/begin GROUP S680_PDUDCDCEACEHPSHVLoopSta "SWC_INP_type/run_SWC_INP_5ms_sys/INP/CAN4/SignalCheck/zGW_CANRr1_C50_0/PDUDCDCEACEHPSHVLoopSta"
 /begin REF_CHARACTERISTIC KINP_PDUDCDCEACEHPSHVLoopSta_enum_defval KINP_PDUDCDCEACEHPSHVLoopSta_enum_ovrdflg KINP_PDUDCDCEACEHPSHVLoopSta_enum_ovrdval /end REF_CHARACTERISTIC
/end GROUP
/begin GROUP S680_PDUDCDCEACEHPSPreRlySta "SWC_INP_type/run_SWC_INP_5ms_sys/INP/CAN4/SignalCheck/zGW_CANRr1_C50_0/PDUDCDCEACEHPSPreRlySta"
 /begin REF_CHARACTERISTIC KINP_PDUDCDCEACEHPSPreRlySta_enum_defval KINP_PDUDCDCEACEHPSPreRlySta_enum_ovrdflg KINP_PDUDCDCEACEHPSPreRlySta_enum_ovrdval /end REF_CHARACTERISTIC
/end GROUP
/begin GROUP S680_PDUDCDCEACEHPSRlySta "SWC_INP_type/run_SWC_INP_5ms_sys/INP/CAN4/SignalCheck/zGW_CANRr1_C50_0/PDUDCDCEACEHPSRlySta"
 /begin REF_CHARACTERISTIC KINP_PDUDCDCEACEHPSRlySta_enum_defval KINP_PDUDCDCEACEHPSRlySta_enum_ovrdflg KINP_PDUDCDCEACEHPSRlySta_enum_ovrdval /end REF_CHARACTERISTIC
/end GROUP
/begin GROUP S680_PDUHVILSta "SWC_INP_type/run_SWC_INP_5ms_sys/INP/CAN4/SignalCheck/zGW_CANRr1_C50_0/PDUHVILSta"
 /begin REF_CHARACTERISTIC KINP_PDUHVILSta_enum_defval KINP_PDUHVILSta_enum_ovrdflg KINP_PDUHVILSta_enum_ovrdval /end REF_CHARACTERISTIC
/end GROUP
/begin GROUP S680_PDUMCUHVLoopSta "SWC_INP_type/run_SWC_INP_5ms_sys/INP/CAN4/SignalCheck/zGW_CANRr1_C50_0/PDUMCUHVLoopSta"
 /begin REF_CHARACTERISTIC KINP_PDUMCUHVLoopSta_enum_defval KINP_PDUMCUHVLoopSta_enum_ovrdflg KINP_PDUMCUHVLoopSta_enum_ovrdval /end REF_CHARACTERISTIC
/end GROUP
/begin GROUP S680_PDUMCUPosRlySta "SWC_INP_type/run_SWC_INP_5ms_sys/INP/CAN4/SignalCheck/zGW_CANRr1_C50_0/PDUMCUPosRlySta"
 /begin REF_CHARACTERISTIC KINP_PDUMCUPosRlySta_enum_defval KINP_PDUMCUPosRlySta_enum_ovrdflg KINP_PDUMCUPosRlySta_enum_ovrdval /end REF_CHARACTERISTIC
/end GROUP
/begin GROUP S680_PDUMCUPreRlySta "SWC_INP_type/run_SWC_INP_5ms_sys/INP/CAN4/SignalCheck/zGW_CANRr1_C50_0/PDUMCUPreRlySta"
 /begin REF_CHARACTERISTIC KINP_PDUMCUPreRlySta_enum_defval KINP_PDUMCUPreRlySta_enum_ovrdflg KINP_PDUMCUPreRlySta_enum_ovrdval /end REF_CHARACTERISTIC
/end GROUP
/begin GROUP S680_PDUSelfChkSta "SWC_INP_type/run_SWC_INP_5ms_sys/INP/CAN4/SignalCheck/zGW_CANRr1_C50_0/PDUSelfChkSta"
 /begin REF_CHARACTERISTIC KINP_PDUSelfChkSta_enum_defval KINP_PDUSelfChkSta_enum_ovrdflg KINP_PDUSelfChkSta_enum_ovrdval /end REF_CHARACTERISTIC
/end GROUP
/begin GROUP S921_ad_signal_process "SWC_INP_type/run_SWC_INP_5ms_sys/INP/GPIO/Analog/AccelPedal1Vol_V/ad_signal_process" /begin SUB_GROUP S923_sig_valid_check /end SUB_GROUP /end GROUP
/begin GROUP S922_ad_signal_process "SWC_INP_type/run_SWC_INP_5ms_sys/INP/GPIO/Analog/AccelPedal2Vol_V/ad_signal_process" /begin SUB_GROUP S933_sig_valid_check /end SUB_GROUP /end GROUP
/begin GROUP S923_sig_valid_check "SWC_INP_type/run_SWC_INP_5ms_sys/INP/GPIO/Analog/AccelPedal1Vol_V/ad_signal_process/sig_valid_check"
 /begin REF_MEASUREMENT VINP_AccelPedal1VolShortHigh_enum VINP_AccelPedal1VolShortLow_enum /end REF_MEASUREMENT
/end GROUP
/begin GROUP S933_sig_valid_check "SWC_INP_type/run_SWC_INP_5ms_sys/INP/GPIO/Analog/AccelPedal2Vol_V/ad_signal_process/sig_valid_check"
 /begin REF_MEASUREMENT VINP_AccelPedal2VolShortHigh_enum VINP_AccelPedal2VolShortLow_enum /end REF_MEASUREMENT
/end GROUP
/end MODULE
/end PROJECT
