/******************************************************************************
* ASAP2 file: SWC_V2L_type.a2l
* Code generation for model "SWC_V2L_type".
* Model version : 1.15
* Simulink Coder version : 9.6 (R2021b) 14-May-2021
* C source code generated on : Fri May 9 14:43:59 2025
* Target selection: autosar.tlc
* Embedded hardware selection: ARM Compatible->ARM Cortex-M
* Code generation objectives: Unspecified
* Validation result: Not run
* (add additional file header information here)
******************************************************************************/ ASAP2_VERSION 1 31
/* Version 1.31 */
/begin PROJECT ProjectName "Project Comment Goes Here"
/begin HEADER "Header Comments go here" /end HEADER
/begin MODULE ModuleName "Module Comment Goes Here"
/begin MOD_PAR "MOD PAR Comment Goes Here" /end MOD_PAR
/begin MOD_COMMON "Mod Common Comment Here" BYTE_ORDER MSB_LAST /end MOD_COMMON
/begin RECORD_LAYOUT Scalar_BOOLEAN FNC_VALUES 1 UBYTE COLUMN_DIR DIRECT /end RECORD_LAYOUT
/begin RECORD_LAYOUT Scalar_UBYTE FNC_VALUES 1 UBYTE COLUMN_DIR DIRECT /end RECORD_LAYOUT
/begin RECORD_LAYOUT Scalar_BYTE FNC_VALUES 1 SBYTE COLUMN_DIR DIRECT /end RECORD_LAYOUT
/begin RECORD_LAYOUT Scalar_UWORD FNC_VALUES 1 UWORD COLUMN_DIR DIRECT /end RECORD_LAYOUT
/begin RECORD_LAYOUT Scalar_SWORD FNC_VALUES 1 SWORD COLUMN_DIR DIRECT /end RECORD_LAYOUT
/begin RECORD_LAYOUT Scalar_ULONG FNC_VALUES 1 ULONG COLUMN_DIR DIRECT /end RECORD_LAYOUT
/begin RECORD_LAYOUT Scalar_LONG FNC_VALUES 1 SLONG COLUMN_DIR DIRECT /end RECORD_LAYOUT
/begin RECORD_LAYOUT Scalar_FLOAT32_IEEE FNC_VALUES 1 FLOAT32_IEEE COLUMN_DIR DIRECT /end RECORD_LAYOUT
/begin RECORD_LAYOUT Scalar_FLOAT64_IEEE FNC_VALUES 1 FLOAT64_IEEE COLUMN_DIR DIRECT /end RECORD_LAYOUT
/begin RECORD_LAYOUT Lookup1D_BOOLEAN FNC_VALUES 1 UBYTE COLUMN_DIR DIRECT /end RECORD_LAYOUT
/begin RECORD_LAYOUT Lookup1D_X_BOOLEAN AXIS_PTS_X 1 UBYTE INDEX_INCR DIRECT /end RECORD_LAYOUT
/begin RECORD_LAYOUT Lookup1D_BYTE FNC_VALUES 1 SBYTE COLUMN_DIR DIRECT /end RECORD_LAYOUT
/begin RECORD_LAYOUT Lookup1D_X_BYTE AXIS_PTS_X 1 SBYTE INDEX_INCR DIRECT /end RECORD_LAYOUT
/begin RECORD_LAYOUT Lookup1D_UBYTE FNC_VALUES 1 UBYTE COLUMN_DIR DIRECT /end RECORD_LAYOUT
/begin RECORD_LAYOUT Lookup1D_X_UBYTE AXIS_PTS_X 1 UBYTE INDEX_INCR DIRECT /end RECORD_LAYOUT
/begin RECORD_LAYOUT Lookup1D_UWORD FNC_VALUES 1 UWORD COLUMN_DIR DIRECT /end RECORD_LAYOUT
/begin RECORD_LAYOUT Lookup1D_X_UWORD AXIS_PTS_X 1 UWORD INDEX_INCR DIRECT /end RECORD_LAYOUT
/begin RECORD_LAYOUT Lookup1D_WORD FNC_VALUES 1 SWORD COLUMN_DIR DIRECT /end RECORD_LAYOUT
/begin RECORD_LAYOUT Lookup1D_X_WORD AXIS_PTS_X 1 SWORD INDEX_INCR DIRECT /end RECORD_LAYOUT
/begin RECORD_LAYOUT Lookup1D_ULONG FNC_VALUES 1 ULONG COLUMN_DIR DIRECT /end RECORD_LAYOUT
/begin RECORD_LAYOUT Lookup1D_X_ULONG AXIS_PTS_X 1 ULONG INDEX_INCR DIRECT /end RECORD_LAYOUT
/begin RECORD_LAYOUT Lookup1D_SLONG FNC_VALUES 1 SLONG COLUMN_DIR DIRECT /end RECORD_LAYOUT
/begin RECORD_LAYOUT Lookup1D_X_LONG AXIS_PTS_X 1 SLONG INDEX_INCR DIRECT /end RECORD_LAYOUT
/begin RECORD_LAYOUT Lookup1D_FLOAT32_IEEE FNC_VALUES 1 FLOAT32_IEEE COLUMN_DIR DIRECT /end RECORD_LAYOUT
/begin RECORD_LAYOUT Lookup1D_X_FLOAT32_IEEE AXIS_PTS_X 1 FLOAT32_IEEE INDEX_INCR DIRECT /end RECORD_LAYOUT
/begin RECORD_LAYOUT Lookup1D_FLOAT64_IEEE FNC_VALUES 1 FLOAT64_IEEE COLUMN_DIR DIRECT /end RECORD_LAYOUT
/begin RECORD_LAYOUT Lookup1D_X_FLOAT64_IEEE AXIS_PTS_X 1 FLOAT64_IEEE INDEX_INCR DIRECT /end RECORD_LAYOUT
/begin RECORD_LAYOUT Lookup2D_BOOLEAN FNC_VALUES 1 UBYTE COLUMN_DIR DIRECT /end RECORD_LAYOUT
/begin RECORD_LAYOUT Lookup2D_X_BOOLEAN AXIS_PTS_X 1 UBYTE INDEX_INCR DIRECT /end RECORD_LAYOUT
/begin RECORD_LAYOUT Lookup2D_UBYTE FNC_VALUES 1 UBYTE COLUMN_DIR DIRECT /end RECORD_LAYOUT
/begin RECORD_LAYOUT Lookup2D_X_UBYTE AXIS_PTS_X 1 UBYTE INDEX_INCR DIRECT /end RECORD_LAYOUT
/begin RECORD_LAYOUT Lookup2D_BYTE FNC_VALUES 1 SBYTE COLUMN_DIR DIRECT /end RECORD_LAYOUT
/begin RECORD_LAYOUT Lookup2D_X_BYTE AXIS_PTS_X 1 SBYTE INDEX_INCR DIRECT /end RECORD_LAYOUT
/begin RECORD_LAYOUT Lookup2D_UWORD FNC_VALUES 1 UWORD COLUMN_DIR DIRECT /end RECORD_LAYOUT
/begin RECORD_LAYOUT Lookup2D_X_UWORD AXIS_PTS_X 1 UWORD INDEX_INCR DIRECT /end RECORD_LAYOUT
/begin RECORD_LAYOUT Lookup2D_WORD FNC_VALUES 1 SWORD COLUMN_DIR DIRECT /end RECORD_LAYOUT
/begin RECORD_LAYOUT Lookup2D_X_WORD AXIS_PTS_X 1 SWORD INDEX_INCR DIRECT /end RECORD_LAYOUT
/begin RECORD_LAYOUT Lookup2D_ULONG FNC_VALUES 1 ULONG COLUMN_DIR DIRECT /end RECORD_LAYOUT
/begin RECORD_LAYOUT Lookup2D_X_ULONG AXIS_PTS_X 1 ULONG INDEX_INCR DIRECT /end RECORD_LAYOUT
/begin RECORD_LAYOUT Lookup2D_LONG FNC_VALUES 1 SLONG COLUMN_DIR DIRECT /end RECORD_LAYOUT
/begin RECORD_LAYOUT Lookup2D_X_LONG AXIS_PTS_X 1 SLONG INDEX_INCR DIRECT /end RECORD_LAYOUT
/begin RECORD_LAYOUT Lookup2D_FLOAT32_IEEE FNC_VALUES 1 FLOAT32_IEEE COLUMN_DIR DIRECT /end RECORD_LAYOUT
/begin RECORD_LAYOUT Lookup2D_X_FLOAT32_IEEE AXIS_PTS_X 1 FLOAT32_IEEE INDEX_INCR DIRECT /end RECORD_LAYOUT
/begin RECORD_LAYOUT Lookup2D_FLOAT64_IEEE FNC_VALUES 1 FLOAT64_IEEE COLUMN_DIR DIRECT /end RECORD_LAYOUT
/begin RECORD_LAYOUT Lookup2D_X_FLOAT64_IEEE AXIS_PTS_X 1 FLOAT64_IEEE INDEX_INCR DIRECT /end RECORD_LAYOUT
/begin CHARACTERISTIC MV2L_SOCV2LLimit_Y_pct "" /* Characteristic Type */ CURVE 0x0000 /* @ECU_Address@MV2L_SOCV2LLimit_Y_pct@ */ Lookup1D_FLOAT32_IEEE /* Maxdiff */ 0 SWC_V2L_type_CM_single_pct 0.0 80.0
 /begin AXIS_DESCR /* Description of X-Axis Points */ /* Axis Type */ COM_AXIS /* Reference to Input */ NO_INPUT_QUANTITY SWC_V2L_type_CM_single_pct /* Number of Axis Pts */ 16 0.0 15.0 AXIS_PTS_REF AV2L_SOCV2LLimit_X_pct /end AXIS_DESCR
/end CHARACTERISTIC
/begin AXIS_PTS AV2L_SOCV2LLimit_X_pct "" 0x0000 /* @ECU_Address@AV2L_SOCV2LLimit_X_pct@ */ /* Input Quantity */ NO_INPUT_QUANTITY Lookup1D_X_FLOAT32_IEEE 0 SWC_V2L_type_CM_single_pct /* Number of Axis Pts */ 16 0.0 15.0 /end AXIS_PTS
/begin CHARACTERISTIC KV2L_HVBattSOCLimit_pct "" VALUE 0x0000 /* @ECU_Address@KV2L_HVBattSOCLimit_pct@ */ Scalar_FLOAT32_IEEE 0 SWC_V2L_type_CM_single_pct 0.0 20.0 /end CHARACTERISTIC
/begin CHARACTERISTIC KV2L_HVPOGrpUpperLimit_pct "" VALUE 0x0000 /* @ECU_Address@KV2L_HVPOGrpUpperLimit_pct@ */ Scalar_FLOAT32_IEEE 0 SWC_V2L_type_CM_single_pct 0.0 100.0 /end CHARACTERISTIC
/begin CHARACTERISTIC KV2L_HVPOGrplowerLimit_pct "" VALUE 0x0000 /* @ECU_Address@KV2L_HVPOGrplowerLimit_pct@ */ Scalar_FLOAT32_IEEE 0 SWC_V2L_type_CM_single_pct 0.0 100.0 /end CHARACTERISTIC
/begin CHARACTERISTIC KV2L_OBCACCurrInfLimit_A "" VALUE 0x0000 /* @ECU_Address@KV2L_OBCACCurrInfLimit_A@ */ Scalar_FLOAT32_IEEE 0 SWC_V2L_type_CM_single_A -40.0 87.75 /end CHARACTERISTIC
/begin CHARACTERISTIC KV2L_SOCV2LSetLimit_pct "" VALUE 0x0000 /* @ECU_Address@KV2L_SOCV2LSetLimit_pct@ */ Scalar_FLOAT32_IEEE 0 SWC_V2L_type_CM_single_pct 0.0 20.0 /end CHARACTERISTIC
/begin CHARACTERISTIC KV2L_HVPOGrpCheckOvrd_flg "" VALUE 0x0000 /* @ECU_Address@KV2L_HVPOGrpCheckOvrd_flg@ */ Scalar_BOOLEAN 0 SWC_V2L_type_CM_boolean_flg 0.0 1.0 /end CHARACTERISTIC
/begin MEASUREMENT VV2L_PerdV2LSet_s "" FLOAT32_IEEE SWC_V2L_type_CM_single_s 0 0 0.0 28800.0 ECU_ADDRESS 0x0000 /* @ECU_Address@VV2L_PerdV2LSet_s@ */ /end MEASUREMENT
/begin MEASUREMENT VV2L_SOCV2LLimit_pct "" FLOAT32_IEEE SWC_V2L_type_CM_single_pct 0 0 0.0 80.0 ECU_ADDRESS 0x0000 /* @ECU_Address@VV2L_SOCV2LLimit_pct@ */ /end MEASUREMENT
/begin MEASUREMENT VV2L_ReqV2LIVIPopup_enum "" UBYTE SWC_V2L_type_CM_uint8_enum 0 0 0.0 255.0 ECU_ADDRESS 0x0000 /* @ECU_Address@VV2L_ReqV2LIVIPopup_enum@ */ /end MEASUREMENT
/begin MEASUREMENT VV2L_ReqV2LIVIDisChrg_enum "" UBYTE SWC_V2L_type_CM_uint8_enum 0 0 0.0 255.0 ECU_ADDRESS 0x0000 /* @ECU_Address@VV2L_ReqV2LIVIDisChrg_enum@ */ /end MEASUREMENT
/begin MEASUREMENT VV2L_ReqOBCIntrV2LEna_enum "" UBYTE SWC_V2L_type_CM_uint8_enum 0 0 0.0 255.0 ECU_ADDRESS 0x0000 /* @ECU_Address@VV2L_ReqOBCIntrV2LEna_enum@ */ /end MEASUREMENT
/begin MEASUREMENT VV2L_HVPO120VGrpALDSt_enum "" UBYTE SWC_V2L_type_CM_uint8_enum 0 0 0.0 255.0 ECU_ADDRESS 0x0000 /* @ECU_Address@VV2L_HVPO120VGrpALDSt_enum@ */ /end MEASUREMENT
/begin MEASUREMENT VV2L_HVPO120VGrpBLDSt_enum "" UBYTE SWC_V2L_type_CM_uint8_enum 0 0 0.0 255.0 ECU_ADDRESS 0x0000 /* @ECU_Address@VV2L_HVPO120VGrpBLDSt_enum@ */ /end MEASUREMENT
/begin MEASUREMENT VV2L_ReqIntrV2LIVIPopup_enum "" UBYTE SWC_V2L_type_CM_uint8_enum 0 0 0.0 255.0 ECU_ADDRESS 0x0000 /* @ECU_Address@VV2L_ReqIntrV2LIVIPopup_enum@ */ /end MEASUREMENT
/begin MEASUREMENT VV2L_ReqOBCExtrV2LEna_enum "" UBYTE SWC_V2L_type_CM_uint8_enum 0 0 0.0 255.0 ECU_ADDRESS 0x0000 /* @ECU_Address@VV2L_ReqOBCExtrV2LEna_enum@ */ /end MEASUREMENT
/begin MEASUREMENT VV2L_ReqExtrV2LIVIPopup_enum "" UBYTE SWC_V2L_type_CM_uint8_enum 0 0 0.0 255.0 ECU_ADDRESS 0x0000 /* @ECU_Address@VV2L_ReqExtrV2LIVIPopup_enum@ */ /end MEASUREMENT
/begin MEASUREMENT VV2L_ReqOBCV2LEna_enum "" UBYTE SWC_V2L_type_CM_uint8_enum 0 0 0.0 255.0 ECU_ADDRESS 0x0000 /* @ECU_Address@VV2L_ReqOBCV2LEna_enum@ */ /end MEASUREMENT
/begin MEASUREMENT VV2L_HVPOGrpCheck_flg "" UBYTE SWC_V2L_type_CM_boolean_flg 0 0 0.0 1.0 ECU_ADDRESS 0x0000 /* @ECU_Address@VV2L_HVPOGrpCheck_flg@ */ /end MEASUREMENT
/begin MEASUREMENT VV2L_PerdV2LTimer_s "" FLOAT32_IEEE SWC_V2L_type_CM_single_s 0 0 0.0 28800.0 ECU_ADDRESS 0x0000 /* @ECU_Address@VV2L_PerdV2LTimer_s@ */ /end MEASUREMENT
/begin COMPU_METHOD SWC_V2L_type_CM_single_pct "Q = V" RAT_FUNC "%8.6" "pct" COEFFS 0 1 0 0 0 1 /end COMPU_METHOD
/begin COMPU_METHOD SWC_V2L_type_CM_single_A "Q = V" RAT_FUNC "%8.6" "A" COEFFS 0 1 0 0 0 1 /end COMPU_METHOD
/begin COMPU_METHOD SWC_V2L_type_CM_boolean_flg "Q = V" RAT_FUNC "%1.0" "flg" COEFFS 0 1 0 0 0 1 /end COMPU_METHOD
/begin COMPU_METHOD SWC_V2L_type_CM_single_s "Q = V" RAT_FUNC "%8.6" "s" COEFFS 0 1 0 0 0 1 /end COMPU_METHOD
/begin COMPU_METHOD SWC_V2L_type_CM_uint8_enum "Q = V" RAT_FUNC "%3.0" "enum" COEFFS 0 1 0 0 0 1 /end COMPU_METHOD
/begin GROUP SWC_V2L_type "SWC_V2L_type" /* Root */ ROOT /begin SUB_GROUP Root_run_SWC_V2L_10ms_sys /end SUB_GROUP /end GROUP
/begin GROUP Root_run_SWC_V2L_10ms_sys "SWC_V2L_type/run_SWC_V2L_10ms_sys" /begin SUB_GROUP S2_V2L /end SUB_GROUP /end GROUP
/begin GROUP S2_V2L "SWC_V2L_type/run_SWC_V2L_10ms_sys/V2L" /begin SUB_GROUP S3_Subsystem /end SUB_GROUP /end GROUP
/begin GROUP S3_Subsystem "SWC_V2L_type/run_SWC_V2L_10ms_sys/V2L/Subsystem"
 /begin REF_CHARACTERISTIC KV2L_HVBattSOCLimit_pct KV2L_HVPOGrpCheckOvrd_flg KV2L_HVPOGrpUpperLimit_pct KV2L_HVPOGrplowerLimit_pct KV2L_OBCACCurrInfLimit_A KV2L_SOCV2LSetLimit_pct MV2L_SOCV2LLimit_Y_pct /end REF_CHARACTERISTIC
 /begin REF_MEASUREMENT VV2L_HVPO120VGrpALDSt_enum VV2L_HVPO120VGrpBLDSt_enum VV2L_HVPOGrpCheck_flg VV2L_PerdV2LSet_s VV2L_PerdV2LTimer_s VV2L_ReqExtrV2LIVIPopup_enum VV2L_ReqIntrV2LIVIPopup_enum VV2L_ReqOBCExtrV2LEna_enum VV2L_ReqOBCIntrV2LEna_enum VV2L_ReqOBCV2LEna_enum VV2L_ReqV2LIVIDisChrg_enum VV2L_ReqV2LIVIPopup_enum VV2L_SOCV2LLimit_pct /end REF_MEASUREMENT
/end GROUP
/end MODULE
/end PROJECT
/* (add any file trailer comments here) */
/* EOF SWC_V2L_type.a2l */
